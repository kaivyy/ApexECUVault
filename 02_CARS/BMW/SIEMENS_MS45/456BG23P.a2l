ASAP2_VERSION 1 31
/begin PROJECT MS45 "BMW Motorsteuerung R6"
/begin HEADER "_default_HeaderComment" PROJECT_NO _56 /end HEADER
/begin MODULE _default_ModuleName "_default_ModuleLongIdentifier"
/begin MOD_COMMON "_default_ModCommonComment" DEPOSIT ABSOLUTE BYTE_ORDER MSB_FIRST ALIGNMENT_BYTE 1 ALIGNMENT_WORD 2 ALIGNMENT_LONG 4 ALIGNMENT_FLOAT32_IEEE 4 ALIGNMENT_FLOAT64_IEEE 8 /end MOD_COMMON
/begin MEASUREMENT iga_av_1[0] "Intermediate ignition angle till gradiant limitation after start is terminated" UBYTE _CNV_A_R_LINEAR_____203_CM 1 100. -35.625 60. DISPLAY_IDENTIFIER IGA_AV_1_0 ECU_ADDRESS 0x3fe282 FORMAT "%5.1" /end MEASUREMENT
/begin MEASUREMENT iga_av_1[1] "Intermediate ignition angle till gradiant limitation after start is terminated" UBYTE _CNV_A_R_LINEAR_____203_CM 1 100. -35.625 60. DISPLAY_IDENTIFIER IGA_AV_1_1 ECU_ADDRESS 0x3fe283 FORMAT "%5.1" /end MEASUREMENT
/begin MEASUREMENT iga_av_1[2] "Intermediate ignition angle till gradiant limitation after start is terminated" UBYTE _CNV_A_R_LINEAR_____203_CM 1 100. -35.625 60. DISPLAY_IDENTIFIER IGA_AV_1_2 ECU_ADDRESS 0x3fe284 FORMAT "%5.1" /end MEASUREMENT
/begin MEASUREMENT iga_av_1[3] "Intermediate ignition angle till gradiant limitation after start is terminated" UBYTE _CNV_A_R_LINEAR_____203_CM 1 100. -35.625 60. DISPLAY_IDENTIFIER IGA_AV_1_3 ECU_ADDRESS 0x3fe285 FORMAT "%5.1" /end MEASUREMENT
/begin MEASUREMENT iga_av_1[4] "Intermediate ignition angle till gradiant limitation after start is terminated" UBYTE _CNV_A_R_LINEAR_____203_CM 1 100. -35.625 60. DISPLAY_IDENTIFIER IGA_AV_1_4 ECU_ADDRESS 0x3fe286 FORMAT "%5.1" /end MEASUREMENT
/begin MEASUREMENT iga_av_1[5] "Intermediate ignition angle till gradiant limitation after start is terminated" UBYTE _CNV_A_R_LINEAR_____203_CM 1 100. -35.625 60. DISPLAY_IDENTIFIER IGA_AV_1_5 ECU_ADDRESS 0x3fe287 FORMAT "%5.1" /end MEASUREMENT
/begin MEASUREMENT iga[0] "Basic ignition angle application correction and knock control included" UBYTE _CNV_A_R_LINEAR_____203_CM 1 100. -35.625 60. DISPLAY_IDENTIFIER IGA_0 ECU_ADDRESS 0x3fe272 FORMAT "%5.1" /end MEASUREMENT
/begin MEASUREMENT iga[1] "Basic ignition angle application correction and knock control included" UBYTE _CNV_A_R_LINEAR_____203_CM 1 100. -35.625 60. DISPLAY_IDENTIFIER IGA_1 ECU_ADDRESS 0x3fe273 FORMAT "%5.1" /end MEASUREMENT
/begin MEASUREMENT iga[2] "Basic ignition angle application correction and knock control included" UBYTE _CNV_A_R_LINEAR_____203_CM 1 100. -35.625 60. DISPLAY_IDENTIFIER IGA_2 ECU_ADDRESS 0x3fe274 FORMAT "%5.1" /end MEASUREMENT
/begin MEASUREMENT iga[3] "Basic ignition angle application correction and knock control included" UBYTE _CNV_A_R_LINEAR_____203_CM 1 100. -35.625 60. DISPLAY_IDENTIFIER IGA_3 ECU_ADDRESS 0x3fe275 FORMAT "%5.1" /end MEASUREMENT
/begin MEASUREMENT iga[4] "Basic ignition angle application correction and knock control included" UBYTE _CNV_A_R_LINEAR_____203_CM 1 100. -35.625 60. DISPLAY_IDENTIFIER IGA_4 ECU_ADDRESS 0x3fe276 FORMAT "%5.1" /end MEASUREMENT
/begin MEASUREMENT iga[5] "Basic ignition angle application correction and knock control included" UBYTE _CNV_A_R_LINEAR_____203_CM 1 100. -35.625 60. DISPLAY_IDENTIFIER IGA_5 ECU_ADDRESS 0x3fe277 FORMAT "%5.1" /end MEASUREMENT
/begin MEASUREMENT iga_min "Minimum ignition Angle" UBYTE _CNV_A_R_LINEAR_____203_CM 1 100. -35.625 60. DISPLAY_IDENTIFIER IGA_MIN ECU_ADDRESS 0x3fe27e FORMAT "%5.1" /end MEASUREMENT
/begin MEASUREMENT eff_iga_bas_cor "Ignition efficiency  basic ignition angle" UWORD _CNV_A_R_LINEAR_____21_CM 1 100. 0. 1.99996948 DISPLAY_IDENTIFIER EFF_IGA_BAS_COR ECU_ADDRESS 0x3fd436 BYTE_ORDER MSB_LAST FORMAT "%7.5" /end MEASUREMENT
/begin MEASUREMENT eff_iga_ron_98_1 "Ignition efficiency actual ignition angle" UWORD _CNV_A_R_LINEAR_____21_CM 1 100. 0. 1.99996948 DISPLAY_IDENTIFIER EFF_IGA_RON_98_1 ECU_ADDRESS 0x3fd440 BYTE_ORDER MSB_LAST FORMAT "%7.5" /end MEASUREMENT
/begin MEASUREMENT eff_iga_ron_98_2 "Ignition efficiency actual ignition angle" UWORD _CNV_A_R_LINEAR_____21_CM 1 100. 0. 1.99996948 DISPLAY_IDENTIFIER EFF_IGA_RON_98_2 ECU_ADDRESS 0x3fd444 BYTE_ORDER MSB_LAST FORMAT "%7.5" /end MEASUREMENT
/begin MEASUREMENT eff_iga_av_1 "Ignition efficiency actual ignition angle bank selective" UWORD _CNV_A_R_LINEAR_____21_CM 1 100. 0. 1.99996948 DISPLAY_IDENTIFIER EFF_IGA_AV_1 ECU_ADDRESS 0x3fd442 BYTE_ORDER MSB_LAST FORMAT "%7.5" /end MEASUREMENT
/begin MEASUREMENT eff_iga_av_2 "Ignition efficiency actual ignition angle bank selective" UWORD _CNV_A_R_LINEAR_____21_CM 1 100. 0. 1.99996948 DISPLAY_IDENTIFIER EFF_IGA_AV_2 ECU_ADDRESS 0x3fd446 BYTE_ORDER MSB_LAST FORMAT "%7.5" /end MEASUREMENT
/begin MEASUREMENT eff_iga_min "Ignition efficiency minimum ignition angle" UWORD _CNV_A_R_LINEAR_____21_CM 1 100. 0. 1.99996948 DISPLAY_IDENTIFIER EFF_IGA_MIN ECU_ADDRESS 0x3fd43c BYTE_ORDER MSB_LAST FORMAT "%7.5" /end MEASUREMENT
/begin MEASUREMENT iga_bas_cor_knk_add "Basic corrected ignition angle knock  mean value IGA_MV_ADJ_KNK included" UBYTE _CNV_A_R_LINEAR_____203_CM 1 100. -35.625 60. DISPLAY_IDENTIFIER IGA_BAS_COR_KNK_ADD ECU_ADDRESS 0x3fe28e FORMAT "%5.1" /end MEASUREMENT
/begin MEASUREMENT iga_av_mv_1 "Mean value of actual ignition angle" UBYTE _CNV_A_R_LINEAR_____203_CM 1 100. -35.625 60. DISPLAY_IDENTIFIER IGA_AV_MV_1 ECU_ADDRESS 0x3fe29b FORMAT "%5.1" /end MEASUREMENT
/begin MEASUREMENT iga_av_mv_2 "Mean value of actual ignition angle" UBYTE _CNV_A_R_LINEAR_____203_CM 1 100. -35.625 60. DISPLAY_IDENTIFIER IGA_AV_MV_2 ECU_ADDRESS 0x3fe29e FORMAT "%5.1" /end MEASUREMENT
/begin MEASUREMENT iga_dif_bas "Difference of basic ignition angle to reference ignition angle" UBYTE _CNV_A_R_LINEAR_____204_CM 1 100. 0. -95.625 DISPLAY_IDENTIFIER IGA_DIF_BAS ECU_ADDRESS 0x3fe293 FORMAT "%5.1" /end MEASUREMENT
/begin MEASUREMENT iga_dif_av_1 "Difference of actual ignition angle to reference ignition angle" UBYTE _CNV_A_R_LINEAR_____204_CM 1 100. 0. -95.625 DISPLAY_IDENTIFIER IGA_DIF_AV_1 ECU_ADDRESS 0x3fe29c FORMAT "%5.1" /end MEASUREMENT
/begin MEASUREMENT iga_dif_av_2 "Difference of actual ignition angle to reference ignition angle" UBYTE _CNV_A_R_LINEAR_____204_CM 1 100. 0. -95.625 DISPLAY_IDENTIFIER IGA_DIF_AV_2 ECU_ADDRESS 0x3fe29f FORMAT "%5.1" /end MEASUREMENT
/begin MEASUREMENT iga_dif_ron_98_1 "Difference of actual ignition angle to reference ignition angle" UBYTE _CNV_A_R_LINEAR_____204_CM 1 100. 0. -95.625 DISPLAY_IDENTIFIER IGA_DIF_RON_98_1 ECU_ADDRESS 0x3fe29d FORMAT "%5.1" /end MEASUREMENT
/begin MEASUREMENT iga_dif_ron_98_2 "Difference of actual ignition angle to reference ignition angle" UBYTE _CNV_A_R_LINEAR_____204_CM 1 100. 0. -95.625 DISPLAY_IDENTIFIER IGA_DIF_RON_98_2 ECU_ADDRESS 0x3fe2a0 FORMAT "%5.1" /end MEASUREMENT
/begin MEASUREMENT iga_mv_knk_fil "Filtered mean knock correction" SBYTE _CNV_A_R_LINEAR_____82_CM 1 100. -48. 47.625 DISPLAY_IDENTIFIER IGA_MV_KNK_FIL ECU_ADDRESS 0x3fe29a FORMAT "%5.1" /end MEASUREMENT
/begin MEASUREMENT iga_bas_cor_knk_fil "Corrected basic ignition angle with mean knock correction" UBYTE _CNV_A_R_LINEAR_____203_CM 1 100. -35.625 60. DISPLAY_IDENTIFIER IGA_BAS_COR_KNK_FIL ECU_ADDRESS 0x3fe296 FORMAT "%5.1" /end MEASUREMENT
/begin MEASUREMENT eff_iga_bas_cor_knk_fil "Ignition efficiency referenced to IGA_BAS_COR_KNK_FIL" UWORD _CNV_A_R_LINEAR_____21_CM 1 100. 0. 1.99996948 DISPLAY_IDENTIFIER EFF_IGA_BAS_COR_KNK_FIL ECU_ADDRESS 0x3fd43e BYTE_ORDER MSB_LAST FORMAT "%7.5" /end MEASUREMENT
/begin MEASUREMENT lv_iga_grd_act "FLag for ignition angle gradient limitation out of start active" UBYTE _CNV_S_2_RANGE______0_CM 1 100. 0. 1. DISPLAY_IDENTIFIER LV_IGA_GRD_ACT ECU_ADDRESS 0x3fe281 /end MEASUREMENT
/begin CHARACTERISTIC c_crlc_iga_knk "Correlation constant knock correction filter" VALUE 0x0062c _REC_VAL_20_u1 0.9960940000000002 _CNV_A_R_LINEAR_____50_CM 0. 0.996094 DISPLAY_IDENTIFIER C_CRLC_IGA_KNK FORMAT "%5.3" /end CHARACTERISTIC
/begin MEASUREMENT iga_dif_bas_knk_fil "Difference of IGA_BAS_COR_KNK_FIL to reference ignition angle" UBYTE _CNV_A_R_LINEAR_____204_CM 1 100. 0. -95.625 DISPLAY_IDENTIFIER IGA_DIF_BAS_KNK_FIL ECU_ADDRESS 0x3fe280 FORMAT "%5.1" /end MEASUREMENT
/begin CHARACTERISTIC c_cycnr_iga_es "Number of cycles for wich ignition is maintained after detection of LV_IGK = 0" VALUE 0x00678 _REC_VAL_20_u1 15. _CNV_A_R_LINEAR_____1_CM 0. 15. DISPLAY_IDENTIFIER C_CYCNR_IGA_ES FORMAT "%2.0" /end CHARACTERISTIC
/begin MEASUREMENT iga_igc[0] "Ignition angle applied on cylinder CYL" UBYTE _CNV_A_R_LINEAR_____203_CM 1 100. -35.625 60. DISPLAY_IDENTIFIER IGA_IGC_0 ECU_ADDRESS 0x3fe26c FORMAT "%5.1" /end MEASUREMENT
/begin MEASUREMENT iga_igc[1] "Ignition angle applied on cylinder CYL" UBYTE _CNV_A_R_LINEAR_____203_CM 1 100. -35.625 60. DISPLAY_IDENTIFIER IGA_IGC_1 ECU_ADDRESS 0x3fe26d FORMAT "%5.1" /end MEASUREMENT
/begin MEASUREMENT iga_igc[2] "Ignition angle applied on cylinder CYL" UBYTE _CNV_A_R_LINEAR_____203_CM 1 100. -35.625 60. DISPLAY_IDENTIFIER IGA_IGC_2 ECU_ADDRESS 0x3fe26e FORMAT "%5.1" /end MEASUREMENT
/begin MEASUREMENT iga_igc[3] "Ignition angle applied on cylinder CYL" UBYTE _CNV_A_R_LINEAR_____203_CM 1 100. -35.625 60. DISPLAY_IDENTIFIER IGA_IGC_3 ECU_ADDRESS 0x3fe26f FORMAT "%5.1" /end MEASUREMENT
/begin MEASUREMENT iga_igc[4] "Ignition angle applied on cylinder CYL" UBYTE _CNV_A_R_LINEAR_____203_CM 1 100. -35.625 60. DISPLAY_IDENTIFIER IGA_IGC_4 ECU_ADDRESS 0x3fe270 FORMAT "%5.1" /end MEASUREMENT
/begin MEASUREMENT iga_igc[5] "Ignition angle applied on cylinder CYL" UBYTE _CNV_A_R_LINEAR_____203_CM 1 100. -35.625 60. DISPLAY_IDENTIFIER IGA_IGC_5 ECU_ADDRESS 0x3fe271 FORMAT "%5.1" /end MEASUREMENT
/begin MEASUREMENT iga_wout_knk[0] "actual ignition angle" UBYTE _CNV_A_R_LINEAR_____203_CM 1 100. -35.625 60. DISPLAY_IDENTIFIER IGA_WOUT_KNK_0 ECU_ADDRESS 0x3fe278 FORMAT "%5.1" /end MEASUREMENT
/begin MEASUREMENT iga_wout_knk[1] "actual ignition angle" UBYTE _CNV_A_R_LINEAR_____203_CM 1 100. -35.625 60. DISPLAY_IDENTIFIER IGA_WOUT_KNK_1 ECU_ADDRESS 0x3fe279 FORMAT "%5.1" /end MEASUREMENT
/begin MEASUREMENT iga_wout_knk[2] "actual ignition angle" UBYTE _CNV_A_R_LINEAR_____203_CM 1 100. -35.625 60. DISPLAY_IDENTIFIER IGA_WOUT_KNK_2 ECU_ADDRESS 0x3fe27a FORMAT "%5.1" /end MEASUREMENT
/begin MEASUREMENT iga_wout_knk[3] "actual ignition angle" UBYTE _CNV_A_R_LINEAR_____203_CM 1 100. -35.625 60. DISPLAY_IDENTIFIER IGA_WOUT_KNK_3 ECU_ADDRESS 0x3fe27b FORMAT "%5.1" /end MEASUREMENT
/begin MEASUREMENT iga_wout_knk[4] "actual ignition angle" UBYTE _CNV_A_R_LINEAR_____203_CM 1 100. -35.625 60. DISPLAY_IDENTIFIER IGA_WOUT_KNK_4 ECU_ADDRESS 0x3fe27c FORMAT "%5.1" /end MEASUREMENT
/begin MEASUREMENT iga_wout_knk[5] "actual ignition angle" UBYTE _CNV_A_R_LINEAR_____203_CM 1 100. -35.625 60. DISPLAY_IDENTIFIER IGA_WOUT_KNK_5 ECU_ADDRESS 0x3fe27d FORMAT "%5.1" /end MEASUREMENT
/begin CHARACTERISTIC lc_iga_st_ena "Logical constant for seperated start ignition angle" VALUE 0x00f29 _REC_VAL_20_u1 1. _CNV_A_R_LINEAR_____22_CM 0. 1. DISPLAY_IDENTIFIER LC_IGA_ST_ENA FORMAT "%1.0" /end CHARACTERISTIC
/begin CHARACTERISTIC lc_inh_iga_tra_knk_eff "Logical constant to exclude IGA_TRA_KNK from efficiency calculation" VALUE 0x00f37 _REC_VAL_20_u1 1. _CNV_A_R_LINEAR_____22_CM 0. 1. DISPLAY_IDENTIFIER LC_INH_IGA_TRA_KNK_EFF FORMAT "%1.0" /end CHARACTERISTIC
/begin CHARACTERISTIC ip_iga_lgrd_ast "Gradient limitation IGA after start phase" CURVE 0x00c68 _REC_CUR_20_u1_u1 95.625 _CNV_A_R_LINEAR_____82_CM 0. 95.625 DISPLAY_IDENTIFIER IP_IGA_LGRD_AST FORMAT "%5.2"
 /begin AXIS_DESCR COM_AXIS tco _CNV_A_R_LINEAR_____12_CM 8 -48. 142.5 FORMAT "%5.1" AXIS_PTS_REF ldpm_tco_1_igsp /end AXIS_DESCR
/end CHARACTERISTIC
/begin MEASUREMENT eff_iga_av "Ignition efficiency actual ignition angle" UWORD _CNV_A_R_LINEAR_____21_CM 1 100. 0. 1.99996948 DISPLAY_IDENTIFIER EFF_IGA_AV ECU_ADDRESS 0x3fd438 BYTE_ORDER MSB_LAST FORMAT "%7.5" /end MEASUREMENT
/begin MEASUREMENT eff_iga_av_can "Ignition efficiency actual ignition angle for CAN" UWORD _CNV_A_R_LINEAR_____21_CM 1 100. 0. 1.99996948 DISPLAY_IDENTIFIER EFF_IGA_AV_CAN ECU_ADDRESS 0x3fd43a BYTE_ORDER MSB_LAST FORMAT "%7.5" /end MEASUREMENT
/begin MEASUREMENT iga_sp_max_1 "Maximum ignition angle depending on torque intervention" UBYTE _CNV_A_R_LINEAR_____203_CM 1 100. -35.625 60. DISPLAY_IDENTIFIER IGA_SP_MAX_1 ECU_ADDRESS 0x3fe28f FORMAT "%5.1" /end MEASUREMENT
/begin MEASUREMENT iga_sp_max_1_can "Maximum ignition angle depending on torque intervention" UBYTE _CNV_A_R_LINEAR_____203_CM 1 100. -35.625 60. DISPLAY_IDENTIFIER IGA_SP_MAX_1_CAN ECU_ADDRESS 0x3fe290 FORMAT "%5.1" /end MEASUREMENT
/begin MEASUREMENT iga_av_mv "Mean value of actual ignition angle" UBYTE _CNV_A_R_LINEAR_____203_CM 1 100. -35.625 60. DISPLAY_IDENTIFIER IGA_AV_MV ECU_ADDRESS 0x3fe27f FORMAT "%5.1" /end MEASUREMENT
/begin MEASUREMENT iga_av_mv_can "Mean value of actual ignition angle" UBYTE _CNV_A_R_LINEAR_____203_CM 1 100. -35.625 60. DISPLAY_IDENTIFIER IGA_AV_MV_CAN ECU_ADDRESS 0x3fe292 FORMAT "%5.1" /end MEASUREMENT
/begin MEASUREMENT iga_dif_av "Difference of actual ignition angle to reference ignition angle" UBYTE _CNV_A_R_LINEAR_____204_CM 1 100. 0. -95.625 DISPLAY_IDENTIFIER IGA_DIF_AV ECU_ADDRESS 0x3fe294 FORMAT "%5.1" /end MEASUREMENT
/begin MEASUREMENT iga_dif_av_can "Difference of actual ignition angle to reference ignition angle for CAN" UBYTE _CNV_A_R_LINEAR_____204_CM 1 100. 0. -95.625 DISPLAY_IDENTIFIER IGA_DIF_AV_CAN ECU_ADDRESS 0x3fe295 FORMAT "%5.1" /end MEASUREMENT
/begin CHARACTERISTIC c_iga_ini "Init value for ignition angle" VALUE 0x00706 _REC_VAL_20_u1 95.625 _CNV_A_R_LINEAR_____203_CM -35.625 60. DISPLAY_IDENTIFIER C_IGA_INI FORMAT "%5.1" /end CHARACTERISTIC
/begin CHARACTERISTIC lc_iga_man "Logical constant for stratified mode" VALUE 0x00f28 _REC_VAL_20_u1 1. _CNV_A_R_LINEAR_____22_CM 0. 1. DISPLAY_IDENTIFIER LC_IGA_MAN FORMAT "%1.0" /end CHARACTERISTIC
/begin CHARACTERISTIC c_iga_as "Spark retard by application system global" VALUE 0x00384 _REC_VAL_20_s1 95.625 _CNV_A_R_LINEAR_____82_CM -48. 47.625 DISPLAY_IDENTIFIER C_IGA_AS FORMAT "%5.1" /end CHARACTERISTIC
/begin CHARACTERISTIC c_iga_man "Constant for stratified mode" VALUE 0x00707 _REC_VAL_20_u1 95.625 _CNV_A_R_LINEAR_____203_CM -35.625 60. DISPLAY_IDENTIFIER C_IGA_MAN FORMAT "%5.1" /end CHARACTERISTIC
/begin CHARACTERISTIC c_iga_as_cyl[0] "Spark retard by application system cyl. 0" VALUE 0x00385 _REC_VAL_20_s1 4.78125 _CNV_A_R_LINEAR_____82_CM -48. 47.625 DISPLAY_IDENTIFIER C_IGA_AS_CYL_0 FORMAT "%5.1" /end CHARACTERISTIC
/begin CHARACTERISTIC c_iga_as_cyl[1] "Spark retard by application system cyl. 1" VALUE 0x00386 _REC_VAL_20_s1 4.78125 _CNV_A_R_LINEAR_____82_CM -48. 47.625 DISPLAY_IDENTIFIER C_IGA_AS_CYL_1 FORMAT "%5.1" /end CHARACTERISTIC
/begin CHARACTERISTIC c_iga_as_cyl[2] "Spark retard by application system cyl. 2" VALUE 0x00387 _REC_VAL_20_s1 4.78125 _CNV_A_R_LINEAR_____82_CM -48. 47.625 DISPLAY_IDENTIFIER C_IGA_AS_CYL_2 FORMAT "%5.1" /end CHARACTERISTIC
/begin CHARACTERISTIC c_iga_as_cyl[3] "Spark retard by application system cyl. 3" VALUE 0x00388 _REC_VAL_20_s1 4.78125 _CNV_A_R_LINEAR_____82_CM -48. 47.625 DISPLAY_IDENTIFIER C_IGA_AS_CYL_3 FORMAT "%5.1" /end CHARACTERISTIC
/begin CHARACTERISTIC c_iga_as_cyl[4] "Spark retard by application system cyl. 4" VALUE 0x00389 _REC_VAL_20_s1 4.78125 _CNV_A_R_LINEAR_____82_CM -48. 47.625 DISPLAY_IDENTIFIER C_IGA_AS_CYL_4 FORMAT "%5.1" /end CHARACTERISTIC
/begin CHARACTERISTIC c_iga_as_cyl[5] "Spark retard by application system cyl. 5" VALUE 0x0038a _REC_VAL_20_s1 4.78125 _CNV_A_R_LINEAR_____82_CM -48. 47.625 DISPLAY_IDENTIFIER C_IGA_AS_CYL_5 FORMAT "%5.1" /end CHARACTERISTIC
/begin CHARACTERISTIC ipm_eff_iga__iga_dif "Basic Ignition Efficiency" CURVE 0x1084a _REC_CUR_20_u2_u1 1.99996948 _CNV_A_R_LINEAR_____21_CM 0. 1.99996948 DISPLAY_IDENTIFIER IPM_EFF_IGA__IGA_DIF FORMAT "%7.5"
 /begin AXIS_DESCR COM_AXIS iga_dif_min _CNV_A_R_LINEAR_____204_CM 16 0. -95.625 FORMAT "%5.1" AXIS_PTS_REF ldp_iga_dif_eff_iga /end AXIS_DESCR
/end CHARACTERISTIC
/begin AXIS_PTS ldp_iga_dif_eff_iga "" 0x07b4d iga_dif_min _REC_AXS_20_u1 -95.625 _CNV_A_R_LINEAR_____204_CM 16 0. -95.625 DISPLAY_IDENTIFIER LDP_IGA_DIF_EFF_IGA FORMAT "%5.1" /end AXIS_PTS
/begin AXIS_PTS ldpm_tco_1_igsp "" 0x0819c tco _REC_AXS_20_u1 190.5 _CNV_A_R_LINEAR_____12_CM 8 -48. 142.5 DISPLAY_IDENTIFIER LDPM_TCO_1_IGSP FORMAT "%5.1" /end AXIS_PTS
/begin CHARACTERISTIC c_iga_min_etc_lih "Absolute possible spark retard at ETC_LIH" VALUE 0x0070a _REC_VAL_20_u1 95.625 _CNV_A_R_LINEAR_____203_CM -35.625 60. DISPLAY_IDENTIFIER C_IGA_MIN_ETC_LIH FORMAT "%5.1" /end CHARACTERISTIC
/begin MEASUREMENT iga_bas_cor "Corrected basic ignition angle" UBYTE _CNV_A_R_LINEAR_____203_CM 1 100. -35.625 60. DISPLAY_IDENTIFIER IGA_BAS_COR ECU_ADDRESS 0x3fe2a3 FORMAT "%5.1" /end MEASUREMENT
/begin MEASUREMENT iga_bas_ivvt "basic ignition angle including influences of IVVT" UBYTE _CNV_A_R_LINEAR_____203_CM 1 100. -35.625 60. DISPLAY_IDENTIFIER IGA_BAS_IVVT ECU_ADDRESS 0x3fe2a4 FORMAT "%5.1" /end MEASUREMENT
/begin MEASUREMENT iga_bas_lamb_cor "additive LAMBDA correction of IGA_BAS_IVVT" SBYTE _CNV_A_R_LINEAR_____82_CM 1 100. -48. 47.625 DISPLAY_IDENTIFIER IGA_BAS_LAMB_COR ECU_ADDRESS 0x3fe2a7 FORMAT "%5.1" /end MEASUREMENT
/begin MEASUREMENT iga_bas_ivvt_ofs "additive basic ignition angle of influences of valve overlap" UBYTE _CNV_A_R_LINEAR_____203_CM 1 100. -35.625 60. DISPLAY_IDENTIFIER IGA_BAS_IVVT_OFS ECU_ADDRESS 0x3fe2a5 FORMAT "%5.1" /end MEASUREMENT
/begin MEASUREMENT iga_bas_ron "basic ignition angle of RON factor" UBYTE _CNV_A_R_LINEAR_____203_CM 1 100. -35.625 60. DISPLAY_IDENTIFIER IGA_BAS_RON ECU_ADDRESS 0x3fe2a6 FORMAT "%5.1" /end MEASUREMENT
/begin CHARACTERISTIC c_iga_bas_add_max "IGA max offset (VANOS)" VALUE 0x006ff _REC_VAL_20_u1 95.625 _CNV_A_R_LINEAR_____203_CM -35.625 60. DISPLAY_IDENTIFIER C_IGA_BAS_ADD_MAX FORMAT "%5.1" /end CHARACTERISTIC
/begin CHARACTERISTIC c_iga_bas_add_min "IGA min offset (VANOS)" VALUE 0x00700 _REC_VAL_20_u1 95.625 _CNV_A_R_LINEAR_____203_CM -35.625 60. DISPLAY_IDENTIFIER C_IGA_BAS_ADD_MIN FORMAT "%5.1" /end CHARACTERISTIC
/begin CHARACTERISTIC ip_iga_bas_ron_91__n__maf "Basic ignition angle for RON 91" MAP 0x05c6c _REC_MAP_20_u1_u2_u2 95.625 _CNV_A_R_LINEAR_____203_CM -35.625 60. DISPLAY_IDENTIFIER IP_IGA_BAS_RON_91__N__MAF FORMAT "%5.1"
 /begin AXIS_DESCR COM_AXIS n _CNV_A_R_LINEAR_____11_CM 20 0. 8160. FORMAT "%4.0" AXIS_PTS_REF ldpm_n_14 /end AXIS_DESCR
 /begin AXIS_DESCR COM_AXIS maf _CNV_A_R_LINEAR_____106_CM 16 0. 1389. FORMAT "%7.2" AXIS_PTS_REF ldpm_maf_2 /end AXIS_DESCR
/end CHARACTERISTIC
/begin CHARACTERISTIC ip_iga_bas_add_max_ivvt__n__maf "Basic ignition angle offset VO max" MAP 0x059ac _REC_MAP_20_u1_u2_u2 95.625 _CNV_A_R_LINEAR_____203_CM -35.625 60. DISPLAY_IDENTIFIER IP_IGA_BAS_ADD_MAX__IVVT__N__MAF FORMAT "%5.1"
 /begin AXIS_DESCR COM_AXIS n _CNV_A_R_LINEAR_____11_CM 20 0. 8160. FORMAT "%4.0" AXIS_PTS_REF ldpm_n_14 /end AXIS_DESCR
 /begin AXIS_DESCR COM_AXIS maf _CNV_A_R_LINEAR_____106_CM 16 0. 1389. FORMAT "%7.2" AXIS_PTS_REF ldpm_maf_2 /end AXIS_DESCR
/end CHARACTERISTIC
/begin CHARACTERISTIC ip_iga_bas_add_min_ivvt__n__maf "Basic ignition offset VO min" MAP 0x05aec _REC_MAP_20_u1_u2_u2 95.625 _CNV_A_R_LINEAR_____203_CM -35.625 60. DISPLAY_IDENTIFIER IP_IGA_BAS_ADD_MIN__IVVT__N__MAF FORMAT "%5.1"
 /begin AXIS_DESCR COM_AXIS n _CNV_A_R_LINEAR_____11_CM 20 0. 8160. FORMAT "%4.0" AXIS_PTS_REF ldpm_n_14 /end AXIS_DESCR
 /begin AXIS_DESCR COM_AXIS maf _CNV_A_R_LINEAR_____106_CM 16 0. 1389. FORMAT "%7.2" AXIS_PTS_REF ldpm_maf_2 /end AXIS_DESCR
/end CHARACTERISTIC
/begin CHARACTERISTIC ip_iga_bas_lamb__lamb_sp "additive lambda setpoint correction of IGA_BAS" CURVE 0x00c28 _REC_CUR_20_u1_u2 4.78125 _CNV_A_R_LINEAR_____205_CM -48. 47.625 DISPLAY_IDENTIFIER IP_IGA_BAS_LAMB_LAMB_SP FORMAT "%5.1"
 /begin AXIS_DESCR COM_AXIS lamb_sp _CNV_A_R_LINEAR_____164_CM 8 0. 31.99902344 FORMAT "%7.4" AXIS_PTS_REF ldp_lamb_sp__iga_bas_lamb /end AXIS_DESCR
/end CHARACTERISTIC
/begin CHARACTERISTIC ip_iga_bas__n__maf "Basic ignition angle IVVT passive" MAP 0x0586c _REC_MAP_20_u1_u2_u2 95.625 _CNV_A_R_LINEAR_____203_CM -35.625 60. DISPLAY_IDENTIFIER IP_IGA_BAS__N__MAF FORMAT "%5.1"
 /begin AXIS_DESCR COM_AXIS n _CNV_A_R_LINEAR_____11_CM 20 0. 8160. FORMAT "%4.0" AXIS_PTS_REF ldpm_n_14 /end AXIS_DESCR
 /begin AXIS_DESCR COM_AXIS maf _CNV_A_R_LINEAR_____106_CM 16 0. 1389. FORMAT "%7.2" AXIS_PTS_REF ldpm_maf_2 /end AXIS_DESCR
/end CHARACTERISTIC
/begin AXIS_PTS ldp_lamb_sp__iga_bas_lamb "" 0x10b5a lamb_sp _REC_AXS_20_u2 31.99902344 _CNV_A_R_LINEAR_____164_CM 8 0. 31.99902344 DISPLAY_IDENTIFIER LDP_LAMB_SP__IGA_BAS_LAMB FORMAT "%7.4" /end AXIS_PTS
/begin CHARACTERISTIC ip_iga_bas_ron_98__n__maf "Basic ignition angle for RON 98" MAP 0x05dac _REC_MAP_20_u1_u2_u2 95.625 _CNV_A_R_LINEAR_____203_CM -35.625 60. DISPLAY_IDENTIFIER IP_IGA_BAS_RON_98__N__MAF FORMAT "%5.1"
 /begin AXIS_DESCR COM_AXIS n _CNV_A_R_LINEAR_____11_CM 20 0. 8160. FORMAT "%4.0" AXIS_PTS_REF ldpm_n_14 /end AXIS_DESCR
 /begin AXIS_DESCR COM_AXIS maf _CNV_A_R_LINEAR_____106_CM 16 0. 1389. FORMAT "%7.2" AXIS_PTS_REF ldpm_maf_2 /end AXIS_DESCR
/end CHARACTERISTIC
/begin AXIS_PTS ldpm_n_14 "" 0x11872 n _REC_AXS_20_u2 8160. _CNV_A_R_LINEAR_____11_CM 20 0. 8160. DISPLAY_IDENTIFIER LDPM_N_14 FORMAT "%4.0" /end AXIS_PTS
/begin AXIS_PTS ldpm_maf_2 "" 0x116e0 maf _REC_AXS_20_u2 69.45 _CNV_A_R_LINEAR_____106_CM 16 0. 1389. DISPLAY_IDENTIFIER LDPM_MAF_2 FORMAT "%7.2" /end AXIS_PTS
/begin MEASUREMENT tq_add_ch "torque reserve for catalyst heating" SWORD _CNV_A_R_LINEAR_____55_CM 1 100. -1024. 1023.96875 DISPLAY_IDENTIFIER TQ_ADD_CH ECU_ADDRESS 0x3fd448 BYTE_ORDER MSB_LAST FORMAT "%6.2" /end MEASUREMENT
/begin MEASUREMENT iga_ch_bas "latest desired IGA for catalyst heating" UBYTE _CNV_A_R_LINEAR_____203_CM 1 100. -35.625 60. DISPLAY_IDENTIFIER IGA_CH_BAS ECU_ADDRESS 0x3fe2a8 FORMAT "%5.1" /end MEASUREMENT
/begin MEASUREMENT iga_dif_ch_bas "difference IGA_REF_COR - IGA_CH_BAS" UBYTE _CNV_A_R_LINEAR_____204_CM 1 100. 0. -95.625 DISPLAY_IDENTIFIER IGA_DIF_CH_BAS ECU_ADDRESS 0x3fe2a9 FORMAT "%5.1" /end MEASUREMENT
/begin MEASUREMENT eff_iga_ch_bas "IGA efficiency with IGA_CH_BAS" UWORD _CNV_A_R_LINEAR_____21_CM 1 100. 0. 1.99996948 DISPLAY_IDENTIFIER EFF_IGA_CH_BAS ECU_ADDRESS 0x3fd44a BYTE_ORDER MSB_LAST FORMAT "%7.5" /end MEASUREMENT
/begin MEASUREMENT tq_add_ch_bas "maximum torque reserve for catalyst heating" SWORD _CNV_A_R_LINEAR_____55_CM 1 100. -1024. 1023.96875 DISPLAY_IDENTIFIER TQ_ADD_CH_BAS ECU_ADDRESS 0x3fd44c BYTE_ORDER MSB_LAST FORMAT "%8.2" /end MEASUREMENT
/begin MEASUREMENT fac_red_tq_add_ch "reduction of TQ_ADD_CH_BAS" UBYTE _CNV_A_R_LINEAR_____29_CM 1 100. 0. 0.99610001 DISPLAY_IDENTIFIER FAC_RED_TQ_ADD_CH ECU_ADDRESS 0x3fe2ad FORMAT "%5.3" /end MEASUREMENT
/begin MEASUREMENT fac_deac_ch_dri "interpolation factor concerning 'drive train engaged'" UBYTE _CNV_A_R_LINEAR_____29_CM 1 100. 0. 0.99610001 DISPLAY_IDENTIFIER FAC_DEAC_CH_DRI ECU_ADDRESS 0x3fe2ae FORMAT "%5.3" /end MEASUREMENT
/begin MEASUREMENT tq_add_ch_red "unfiltered torque reserve for catalyst heating" SWORD _CNV_A_R_LINEAR_____55_CM 1 100. -1024. 1023.96875 DISPLAY_IDENTIFIER TQ_ADD_CH_RED ECU_ADDRESS 0x3fd44e BYTE_ORDER MSB_LAST FORMAT "%8.2" /end MEASUREMENT
/begin CHARACTERISTIC ip_fac_iga_ch_tco "interpolation factor latest IGA" CURVE 0x00af3 _REC_CUR_20_u1_u1 0.99610001 _CNV_A_R_LINEAR_____29_CM 0. 0.99610001 DISPLAY_IDENTIFIER IP_FAC_IGA_CH_TCO FORMAT "%5.3"
 /begin AXIS_DESCR COM_AXIS tco _CNV_A_R_LINEAR_____12_CM 8 -48. 142.5 FORMAT "%6.2" AXIS_PTS_REF ldp_tco__fac_iga_ch_tco /end AXIS_DESCR
/end CHARACTERISTIC
/begin CHARACTERISTIC ip_iga_ch_cold_is_alter "latest IGA cold engine, first idle phases and alternator switched on" CURVE 0x00c38 _REC_CUR_20_u1_u1 95.625 _CNV_A_R_LINEAR_____203_CM -35.625 60. DISPLAY_IDENTIFIER IP_IGA_CH_COLD_IS_ALTER FORMAT "%5.1"
 /begin AXIS_DESCR COM_AXIS n_32 _CNV_A_R_LINEAR_____16_CM 8 0. 8160. FORMAT "%4.0" AXIS_PTS_REF ldpm_n_32_2_iga /end AXIS_DESCR
/end CHARACTERISTIC
/begin CHARACTERISTIC ip_iga_ch_cold_is "latest IGA cold engine, first idle phases and alternator switched off" CURVE 0x00c30 _REC_CUR_20_u1_u1 95.625 _CNV_A_R_LINEAR_____203_CM -35.625 60. DISPLAY_IDENTIFIER IP_IGA_CH_COLD_IS FORMAT "%5.1"
 /begin AXIS_DESCR COM_AXIS n_32 _CNV_A_R_LINEAR_____16_CM 8 0. 8160. FORMAT "%4.0" AXIS_PTS_REF ldpm_n_32_2_iga /end AXIS_DESCR
/end CHARACTERISTIC
/begin CHARACTERISTIC ip_iga_ch_hot_is_alter "latest IGA warm engine, first idle phases and alternator switched on" CURVE 0x00c48 _REC_CUR_20_u1_u1 95.625 _CNV_A_R_LINEAR_____203_CM -35.625 60. DISPLAY_IDENTIFIER IP_IGA_CH_HOT_IS_ALTER FORMAT "%5.1"
 /begin AXIS_DESCR COM_AXIS n_32 _CNV_A_R_LINEAR_____16_CM 8 0. 8160. FORMAT "%4.0" AXIS_PTS_REF ldpm_n_32_2_iga /end AXIS_DESCR
/end CHARACTERISTIC
/begin CHARACTERISTIC ip_iga_ch_hot_is "latest IGA warm engine, first idle phases and alternator switched off" CURVE 0x00c40 _REC_CUR_20_u1_u1 95.625 _CNV_A_R_LINEAR_____203_CM -35.625 60. DISPLAY_IDENTIFIER IP_IGA_CH_HOT_IS FORMAT "%5.1"
 /begin AXIS_DESCR COM_AXIS n_32 _CNV_A_R_LINEAR_____16_CM 8 0. 8160. FORMAT "%4.0" AXIS_PTS_REF ldpm_n_32_2_iga /end AXIS_DESCR
/end CHARACTERISTIC
/begin CHARACTERISTIC ip_fac_red_ch_mt "reduction map manual transmission vehicle, valid in later idle phases and part load" MAP 0x051ea _REC_MAP_20_u1_u2_u1 0.99610001 _CNV_A_R_LINEAR_____29_CM 0. 0.99610001 DISPLAY_IDENTIFIER IP_FAC_RED_CH_MT FORMAT "%5.3"
 /begin AXIS_DESCR COM_AXIS t_ast _CNV_A_R_LINEAR_____24_CM 8 0. 6553.5 FORMAT "%6.1" AXIS_PTS_REF ldpm_t_ast_1_iga /end AXIS_DESCR
 /begin AXIS_DESCR COM_AXIS tco_st _CNV_A_R_LINEAR_____12_CM 8 -48. 142.5 FORMAT "%5.1" AXIS_PTS_REF ldpm_tco_st_1_iga /end AXIS_DESCR
/end CHARACTERISTIC
/begin CHARACTERISTIC ip_fac_red_ch_ctr_km "reduction map depending on km counter" CURVE 0x00b60 _REC_CUR_20_u1_u2 0.99610001 _CNV_A_R_LINEAR_____29_CM 0. 0.99610001 DISPLAY_IDENTIFIER IP_FAC_RED_CH_CTR_KM FORMAT "%5.3"
 /begin AXIS_DESCR COM_AXIS ctr_km_can _CNV_A_R_LINEAR_____88_CM 4 0. 655350. FORMAT "%7.0" AXIS_PTS_REF ldpm_ctr_km_can_1 /end AXIS_DESCR
/end CHARACTERISTIC
/begin CHARACTERISTIC ip_fac_red_ch_at "reduction map automatic transmission vehicle, valid in later idle phases and part load" MAP 0x0512a _REC_MAP_20_u1_u2_u1 0.99610001 _CNV_A_R_LINEAR_____29_CM 0. 0.99610001 DISPLAY_IDENTIFIER IP_FAC_RED_CH_AT FORMAT "%5.3"
 /begin AXIS_DESCR COM_AXIS t_ast _CNV_A_R_LINEAR_____24_CM 8 0. 6553.5 FORMAT "%6.1" AXIS_PTS_REF ldpm_t_ast_1_iga /end AXIS_DESCR
 /begin AXIS_DESCR COM_AXIS tco_st _CNV_A_R_LINEAR_____12_CM 8 -48. 142.5 FORMAT "%5.1" AXIS_PTS_REF ldpm_tco_st_1_iga /end AXIS_DESCR
/end CHARACTERISTIC
/begin CHARACTERISTIC ip_fac_red_ch_is "reduction map drive train not engaged, valid in first idle phases" MAP 0x0516a _REC_MAP_20_u1_u2_u1 0.99610001 _CNV_A_R_LINEAR_____29_CM 0. 0.99610001 DISPLAY_IDENTIFIER IP_FAC_RED_CH_IS FORMAT "%5.3"
 /begin AXIS_DESCR COM_AXIS t_ast _CNV_A_R_LINEAR_____24_CM 8 0. 6553.5 FORMAT "%6.1" AXIS_PTS_REF ldpm_t_ast_1_iga /end AXIS_DESCR
 /begin AXIS_DESCR COM_AXIS tco_st _CNV_A_R_LINEAR_____12_CM 8 -48. 142.5 FORMAT "%5.1" AXIS_PTS_REF ldpm_tco_st_1_iga /end AXIS_DESCR
/end CHARACTERISTIC
/begin CHARACTERISTIC ip_fac_red_ch_is_dri "reduction map drive train engaged, valid in first idle phases" MAP 0x051aa _REC_MAP_20_u1_u2_u1 0.99610001 _CNV_A_R_LINEAR_____29_CM 0. 0.99610001 DISPLAY_IDENTIFIER IP_FAC_RED_CH_IS_DRI FORMAT "%5.3"
 /begin AXIS_DESCR COM_AXIS t_ast _CNV_A_R_LINEAR_____24_CM 8 0. 6553.5 FORMAT "%6.1" AXIS_PTS_REF ldpm_t_ast_1_iga /end AXIS_DESCR
 /begin AXIS_DESCR COM_AXIS tco_st _CNV_A_R_LINEAR_____12_CM 8 -48. 142.5 FORMAT "%5.1" AXIS_PTS_REF ldpm_tco_st_1_iga /end AXIS_DESCR
/end CHARACTERISTIC
/begin CHARACTERISTIC ip_crlc_tq_add_ch "correlation constant" CURVE 0x00a64 _REC_CUR_20_u1_u2 0.99610001 _CNV_A_R_LINEAR_____29_CM 0. 0.99610001 DISPLAY_IDENTIFIER IP_CRLC_TQ_ADD_CH FORMAT "%5.3"
 /begin AXIS_DESCR COM_AXIS fac_tq_req_clu _CNV_A_R_LINEAR_____21_CM 4 0. 1.99996948 FORMAT "%7.5" AXIS_PTS_REF ldp_fac_tq_req_clu__crlc_tq_add /end AXIS_DESCR
/end CHARACTERISTIC
/begin CHARACTERISTIC c_t_deac_ch_tq_add "duration of deactivation ramp" VALUE 0x017d2 _REC_VAL_20_u2 655.34 _CNV_A_R_LINEAR_____4_CM 1.e-002 655.35 DISPLAY_IDENTIFIER C_T_DEAC_CH_TQ_ADD FORMAT "%5.2" /end CHARACTERISTIC
/begin AXIS_PTS ldp_tco__fac_iga_ch_tco "" 0x07d7a tco _REC_AXS_20_u1 190.5 _CNV_A_R_LINEAR_____12_CM 8 -48. 142.5 DISPLAY_IDENTIFIER LDP_TCO__FAC_IGA_CH_TCO FORMAT "%6.2" /end AXIS_PTS
/begin AXIS_PTS ldpm_n_32_1_iga "" 0x0800d n_32 _REC_AXS_20_u1 8160. _CNV_A_R_LINEAR_____16_CM 8 0. 8160. DISPLAY_IDENTIFIER LDPM_N_32_1_IGA FORMAT "%4.0" /end AXIS_PTS
/begin AXIS_PTS ldpm_t_ast_1_iga "" 0x11adc t_ast _REC_AXS_20_u2 6553.5 _CNV_A_R_LINEAR_____24_CM 8 0. 6553.5 DISPLAY_IDENTIFIER LDPM_T_AST_1_IGA FORMAT "%6.1" /end AXIS_PTS
/begin AXIS_PTS ldpm_tco_st_1_iga "" 0x0822f tco_st _REC_AXS_20_u1 190.5 _CNV_A_R_LINEAR_____12_CM 8 -48. 142.5 DISPLAY_IDENTIFIER LDPM_TCO_ST_1_IGA FORMAT "%5.1" /end AXIS_PTS
/begin AXIS_PTS ldp_fac_tq_req_clu__crlc_tq_add "" 0x10aba fac_tq_req_clu _REC_AXS_20_u2 1.99996948 _CNV_A_R_LINEAR_____21_CM 4 0. 1.99996948 DISPLAY_IDENTIFIER LDP_FAC_TQ_REQ_CLU__CRLC_TQ_ADD FORMAT "%7.5" /end AXIS_PTS
/begin AXIS_PTS ldpm_n_32_2_iga "" 0x08035 n_32 _REC_AXS_20_u1 8160. _CNV_A_R_LINEAR_____16_CM 8 0. 8160. DISPLAY_IDENTIFIER LDPM_N_32_2_IGA FORMAT "%4.0" /end AXIS_PTS
/begin AXIS_PTS ldpm_maf_hb_1_iga "" 0x07f9f maf _REC_AXS_20_u1 1389. _CNV_A_R_LINEAR_____27_CM 8 0. 1389. DISPLAY_IDENTIFIER LDPM_MAF_HB_1_IGA FORMAT "%4.0" /end AXIS_PTS
/begin MEASUREMENT fac_deac_ch "deactivation ramp at function termination" UBYTE _CNV_A_R_LINEAR_____29_CM 1 100. 0. 0.99610001 DISPLAY_IDENTIFIER FAC_DEAC_CH ECU_ADDRESS 0x3fe2ac FORMAT "%5.3" /end MEASUREMENT
/begin MEASUREMENT fac_deac_ch_is "ramp from IS(_ALTER) to PL during idling" UBYTE _CNV_A_R_LINEAR_____29_CM 1 100. 0. 0.99610001 DISPLAY_IDENTIFIER FAC_DEAC_CH_IS ECU_ADDRESS 0x3fe2ab FORMAT "%5.3" /end MEASUREMENT
/begin MEASUREMENT fac_ch_is_alter "ramp after change of B_genoff" UBYTE _CNV_A_R_LINEAR_____29_CM 1 100. 0. 0.99610001 DISPLAY_IDENTIFIER FAC_CH_IS_ALTER ECU_ADDRESS 0x3fe2aa FORMAT "%5.3" /end MEASUREMENT
/begin CHARACTERISTIC c_t_dri_ch "duration of ramp LV_DRI change" VALUE 0x01828 _REC_VAL_20_u2 655.35 _CNV_A_R_LINEAR_____4_CM 0. 655.35 DISPLAY_IDENTIFIER C_T_DRI_CH FORMAT "%6.2" /end CHARACTERISTIC
/begin CHARACTERISTIC c_t_ch_is_alter "duration of ramp IGA_CH_BAS_IS to / _IS_ALTER" VALUE 0x017c4 _REC_VAL_20_u2 655.35 _CNV_A_R_LINEAR_____4_CM 0. 655.35 DISPLAY_IDENTIFIER C_T_CH_IS_ALTER FORMAT "%6.2" /end CHARACTERISTIC
/begin CHARACTERISTIC c_t_deac_ch_is "duration of ramp IGA_CH_BAS_IS to / _PL during idle phase" VALUE 0x017d0 _REC_VAL_20_u2 655.35 _CNV_A_R_LINEAR_____4_CM 0. 655.35 DISPLAY_IDENTIFIER C_T_DEAC_CH_IS FORMAT "%6.2" /end CHARACTERISTIC
/begin CHARACTERISTIC ip_iga_ch_hot_pl "latest IGA warm engine, later idle phases and part load" MAP 0x05f90 _REC_MAP_20_u1_u1_u1 95.625 _CNV_A_R_LINEAR_____203_CM -35.625 60. DISPLAY_IDENTIFIER IP_IGA_CH_HOT_PL FORMAT "%5.1"
 /begin AXIS_DESCR COM_AXIS n_32 _CNV_A_R_LINEAR_____16_CM 8 0. 8160. FORMAT "%4.0" AXIS_PTS_REF ldpm_n_32_1_iga /end AXIS_DESCR
 /begin AXIS_DESCR COM_AXIS maf _CNV_A_R_LINEAR_____27_CM 8 0. 1389. FORMAT "%4.0" AXIS_PTS_REF ldpm_maf_hb_1_iga /end AXIS_DESCR
/end CHARACTERISTIC
/begin CHARACTERISTIC ip_iga_ch_hot_pl_wout_cat "latest IGA warm engine, later idle phases and part load, vehicle variant without catalytic converter" MAP 0x05fd0 _REC_MAP_20_u1_u1_u1 95.625 _CNV_A_R_LINEAR_____203_CM -35.625 60. DISPLAY_IDENTIFIER IP_IGA_CH_HOT_PL_WOUT_CAT FORMAT "%5.1"
 /begin AXIS_DESCR COM_AXIS n_32 _CNV_A_R_LINEAR_____16_CM 8 0. 8160. FORMAT "%4.0" AXIS_PTS_REF ldpm_n_32_1_iga /end AXIS_DESCR
 /begin AXIS_DESCR COM_AXIS maf _CNV_A_R_LINEAR_____27_CM 8 0. 1389. FORMAT "%4.0" AXIS_PTS_REF ldpm_maf_hb_1_iga /end AXIS_DESCR
/end CHARACTERISTIC
/begin CHARACTERISTIC ip_iga_ch_cold_pl "latest IGA cold engine, later idle phases and part load" MAP 0x05f10 _REC_MAP_20_u1_u1_u1 95.625 _CNV_A_R_LINEAR_____203_CM -35.625 60. DISPLAY_IDENTIFIER IP_IGA_CH_COLD_PL FORMAT "%5.1"
 /begin AXIS_DESCR COM_AXIS n_32 _CNV_A_R_LINEAR_____16_CM 8 0. 8160. FORMAT "%4.0" AXIS_PTS_REF ldpm_n_32_1_iga /end AXIS_DESCR
 /begin AXIS_DESCR COM_AXIS maf _CNV_A_R_LINEAR_____27_CM 8 0. 1389. FORMAT "%4.0" AXIS_PTS_REF ldpm_maf_hb_1_iga /end AXIS_DESCR
/end CHARACTERISTIC
/begin CHARACTERISTIC ip_iga_ch_cold_pl_wout_cat "latest IGA cold engine, later idle phases and part load, vehicle variant without catalytic converter" MAP 0x05f50 _REC_MAP_20_u1_u1_u1 95.625 _CNV_A_R_LINEAR_____203_CM -35.625 60. DISPLAY_IDENTIFIER IP_IGA_CH_COLD_PL_WOUT_CAT FORMAT "%5.1"
 /begin AXIS_DESCR COM_AXIS n_32 _CNV_A_R_LINEAR_____16_CM 8 0. 8160. FORMAT "%4.0" AXIS_PTS_REF ldpm_n_32_1_iga /end AXIS_DESCR
 /begin AXIS_DESCR COM_AXIS maf _CNV_A_R_LINEAR_____27_CM 8 0. 1389. FORMAT "%4.0" AXIS_PTS_REF ldpm_maf_hb_1_iga /end AXIS_DESCR
/end CHARACTERISTIC
/begin MEASUREMENT iga_bas_temp_cor "additive temperature correction of IGA_BAS_IVVT" SBYTE _CNV_A_R_LINEAR_____82_CM 1 100. -48. 47.625 DISPLAY_IDENTIFIER IGA_BAS_TEMP_COR ECU_ADDRESS 0x3fe2ba FORMAT "%5.1" /end MEASUREMENT
/begin CHARACTERISTIC ip_iga_bas_temp_cor__tco__tia "Maximum ignition angle correction for temperature effects" MAP 0x05eec _REC_MAP_20_u1_u1_u1 95.625 _CNV_A_R_LINEAR_____205_CM -48. 47.625 DISPLAY_IDENTIFIER IP_IGA_BAS_TEMP_COR__TCO__TIA FORMAT "%5.1"
 /begin AXIS_DESCR COM_AXIS tco _CNV_A_R_LINEAR_____12_CM 6 -48. 142.5 FORMAT "%5.1" AXIS_PTS_REF ldp_tco__iga_bas_temp_cor /end AXIS_DESCR
 /begin AXIS_DESCR COM_AXIS tia _CNV_A_R_LINEAR_____12_CM 6 -48. 142.5 FORMAT "%5.1" AXIS_PTS_REF ldp_tia__iga_bas_temp_cor /end AXIS_DESCR
/end CHARACTERISTIC
/begin CHARACTERISTIC ip_fac_iga_pos__n_32__maf "Weighting factor on ignition angle correction for temperature effects" MAP 0x04e82 _REC_MAP_20_u1_u1_u1 0.9960940000000002 _CNV_A_R_LINEAR_____50_CM 0. 0.996094 DISPLAY_IDENTIFIER IP_FAC_IGA_POS__N_32__MAF FORMAT "%5.3"
 /begin AXIS_DESCR COM_AXIS n_32 _CNV_A_R_LINEAR_____16_CM 8 0. 8160. FORMAT "%4.0" AXIS_PTS_REF ldpm_n_32_fac_iga_pos_neg /end AXIS_DESCR
 /begin AXIS_DESCR COM_AXIS maf _CNV_A_R_LINEAR_____27_CM 6 0. 1389. FORMAT "%4.0" AXIS_PTS_REF ldp_maf_fac_iga_pos_neg /end AXIS_DESCR
/end CHARACTERISTIC
/begin CHARACTERISTIC ip_fac_iga_neg__n_32__maf "Weighting factor on ignition angle correction for temperature effects" MAP 0x04e52 _REC_MAP_20_u1_u1_u1 0.9960940000000002 _CNV_A_R_LINEAR_____50_CM 0. 0.996094 DISPLAY_IDENTIFIER IP_FAC_IGA_NEG__N_32__MAF FORMAT "%5.3"
 /begin AXIS_DESCR COM_AXIS n_32 _CNV_A_R_LINEAR_____16_CM 8 0. 8160. FORMAT "%4.0" AXIS_PTS_REF ldpm_n_32_fac_iga_pos_neg /end AXIS_DESCR
 /begin AXIS_DESCR COM_AXIS maf _CNV_A_R_LINEAR_____27_CM 6 0. 1389. FORMAT "%4.0" AXIS_PTS_REF ldp_maf_fac_iga_pos_neg /end AXIS_DESCR
/end CHARACTERISTIC
/begin AXIS_PTS ldp_tco__iga_bas_temp_cor "" 0x0114a tco _REC_AXS_20_u1 190.5 _CNV_A_R_LINEAR_____12_CM 6 -48. 142.5 DISPLAY_IDENTIFIER LDP_TCO__IGA_BAS_TEMP_COR FORMAT "%5.1" /end AXIS_PTS
/begin AXIS_PTS ldp_tia__iga_bas_temp_cor "" 0x011ec tia _REC_AXS_20_u1 28.575 _CNV_A_R_LINEAR_____12_CM 6 -48. 142.5 DISPLAY_IDENTIFIER LDP_TIA__IGA_BAS_TEMP_COR FORMAT "%5.1" /end AXIS_PTS
/begin AXIS_PTS ldpm_n_32_fac_iga_pos_neg "" 0x080cc n_32 _REC_AXS_20_u1 8160. _CNV_A_R_LINEAR_____16_CM 8 0. 8160. DISPLAY_IDENTIFIER LDPM_N_32_FAC_IGA_POS_NEG FORMAT "%4.0" /end AXIS_PTS
/begin AXIS_PTS ldp_maf_fac_iga_pos_neg "" 0x00ff7 maf _REC_AXS_20_u1 1389. _CNV_A_R_LINEAR_____27_CM 6 0. 1389. DISPLAY_IDENTIFIER LDP_MAF_FAC_IGA_POS_NEG FORMAT "%4.0" /end AXIS_PTS
/begin MEASUREMENT iga_dif_min "Difference of minimum ignition angle to reference ignition angle" UBYTE _CNV_A_R_LINEAR_____204_CM 1 100. 0. -95.625 DISPLAY_IDENTIFIER IGA_DIF_MIN ECU_ADDRESS 0x3fe2bc FORMAT "%5.1" /end MEASUREMENT
/begin MEASUREMENT iga_dif_min_delta "Extra retard on IGA_DIF_MIN in case of torque intervention" UBYTE _CNV_A_R_LINEAR_____204_CM 1 100. 0. -95.625 DISPLAY_IDENTIFIER IGA_DIF_MIN_DELTA ECU_ADDRESS 0x3fe2bd FORMAT "%5.1" /end MEASUREMENT
/begin MEASUREMENT lv_iga_dif_min_delta_act "Flag to enable and declare the acting of the extra retard on IGA_DIF_MIN" UBYTE _CNV_S_2_RANGE______0_CM 1 100. 0. 1. DISPLAY_IDENTIFIER LV_IGA_DIF_MIN_DELTA_ACT ECU_ADDRESS 0x3fe2cc /end MEASUREMENT
/begin MEASUREMENT iga_dif_min_ast "Intermediate variable: correction on IGA_DIF_MIN for combustion cycles after start management" SBYTE _CNV_A_R_LINEAR_____82_CM 1 100. -48. 47.625 DISPLAY_IDENTIFIER IGA_DIF_MIN_AST ECU_ADDRESS 0x3fe2be FORMAT "%5.1" /end MEASUREMENT
/begin CHARACTERISTIC c_iga_dif_min_delta_temp_ena "Maintaining time of extra retard on IGA_DIF_MIN" VALUE 0x00704 _REC_VAL_20_u1 2.55 _CNV_A_R_LINEAR_____4_CM 0. 2.55 DISPLAY_IDENTIFIER C_IGA_DIF_MIN_DELTA_TEMP_ENA FORMAT "%4.2" /end CHARACTERISTIC
/begin CHARACTERISTIC c_iga_dif_min_delta_lgrd "Step gradient limitation after extra spark retard on IGA_DIF_MIN" VALUE 0x00702 _REC_VAL_20_u1 -95.625 _CNV_A_R_LINEAR_____204_CM 0. -95.625 DISPLAY_IDENTIFIER C_IGA_DIF_MIN_DELTA_LGRD FORMAT "%5.1" /end CHARACTERISTIC
/begin CHARACTERISTIC ip_iga_dif_min_tco "TCO correction for minimum ignition angle" CURVE 0x00c50 _REC_CUR_20_u1_u1 95.625 _CNV_A_R_LINEAR_____205_CM -48. 47.625 DISPLAY_IDENTIFIER IP_IGA_DIF_MIN_TCO FORMAT "%5.1"
 /begin AXIS_DESCR COM_AXIS tco _CNV_A_R_LINEAR_____12_CM 8 -48. 142.5 FORMAT "%5.1" AXIS_PTS_REF ldpm_tco_1_igsp /end AXIS_DESCR
/end CHARACTERISTIC
/begin CHARACTERISTIC ip_iga_dif_min_delta "Extra spark retard on minimum ignition angle in case of torque intervention" MAP 0x060f0 _REC_MAP_20_u1_u1_u1 -95.625 _CNV_A_R_LINEAR_____204_CM 0. -95.625 DISPLAY_IDENTIFIER IP_IGA_DIF_MIN_DELTA FORMAT "%5.1"
 /begin AXIS_DESCR COM_AXIS n_32 _CNV_A_R_LINEAR_____16_CM 8 0. 8160. FORMAT "%4.0" AXIS_PTS_REF ldpm_n_32_2_igsp /end AXIS_DESCR
 /begin AXIS_DESCR COM_AXIS maf _CNV_A_R_LINEAR_____27_CM 6 0. 1389. FORMAT "%4.0" AXIS_PTS_REF ldpm_maf_hb_2_igsp /end AXIS_DESCR
/end CHARACTERISTIC
/begin CHARACTERISTIC c_iga_dif_min_delta_temp_dis "Disable time of extra spark retard on IGA_DIF_MIN after end of gradient return" VALUE 0x00703 _REC_VAL_20_u1 2.55 _CNV_A_R_LINEAR_____4_CM 0. 2.55 DISPLAY_IDENTIFIER C_IGA_DIF_MIN_DELTA_TEMP_DIS FORMAT "%4.2" /end CHARACTERISTIC
/begin AXIS_PTS ldpm_cyc_cast_ip_iga_dif_min "" 0x11608 cyc_cast _REC_AXS_20_u2 65535. _CNV_A_R_LINEAR_____1_CM 8 0. 65535. DISPLAY_IDENTIFIER LDPM_CYC_CAST_IP_IGA_DIF_MIN FORMAT "%5.0" /end AXIS_PTS
/begin AXIS_PTS ldpm_n_32_2_igsp "" 0x0803e n_32 _REC_AXS_20_u1 8160. _CNV_A_R_LINEAR_____16_CM 8 0. 8160. DISPLAY_IDENTIFIER LDPM_N_32_2_IGSP FORMAT "%4.0" /end AXIS_PTS
/begin AXIS_PTS ldpm_maf_hb_2_igsp "" 0x012f8 maf _REC_AXS_20_u1 1389. _CNV_A_R_LINEAR_____27_CM 6 0. 1389. DISPLAY_IDENTIFIER LDPM_MAF_HB_2_IGSP FORMAT "%4.0" /end AXIS_PTS
/begin CHARACTERISTIC ip_iga_dif_min_cyc_mt "Correction on minimum ignition angle for combustion cycles after start for automatic transmission" MAP 0x060b0 _REC_MAP_20_u1_u2_u1 95.625 _CNV_A_R_LINEAR_____205_CM -48. 47.625 DISPLAY_IDENTIFIER IP_IGA_DIF_MIN_CYC_MT FORMAT "%5.1"
 /begin AXIS_DESCR COM_AXIS cyc_cast _CNV_A_R_LINEAR_____1_CM 8 0. 65535. FORMAT "%5.0" AXIS_PTS_REF ldpm_cyc_cast_ip_iga_dif_min /end AXIS_DESCR
 /begin AXIS_DESCR COM_AXIS tco _CNV_A_R_LINEAR_____12_CM 8 -48. 142.5 FORMAT "%5.1" AXIS_PTS_REF ldpm_tco_1_igsp /end AXIS_DESCR
/end CHARACTERISTIC
/begin CHARACTERISTIC ip_iga_dif_min_cyc_at "Correction on minimum ignition angle for combustion cycles after start for manual transmission" MAP 0x06070 _REC_MAP_20_u1_u2_u1 95.625 _CNV_A_R_LINEAR_____205_CM -48. 47.625 DISPLAY_IDENTIFIER IP_IGA_DIF_MIN_CYC_AT FORMAT "%5.1"
 /begin AXIS_DESCR COM_AXIS cyc_cast _CNV_A_R_LINEAR_____1_CM 8 0. 65535. FORMAT "%5.0" AXIS_PTS_REF ldpm_cyc_cast_ip_iga_dif_min /end AXIS_DESCR
 /begin AXIS_DESCR COM_AXIS tco _CNV_A_R_LINEAR_____12_CM 8 -48. 142.5 FORMAT "%5.1" AXIS_PTS_REF ldpm_tco_1_igsp /end AXIS_DESCR
/end CHARACTERISTIC
/begin AXIS_PTS ldp_amp_ip_iga_dif_min_cyc_amp "" 0x108c2 amp _REC_AXS_20_u2 5434. _CNV_A_R_LINEAR_____49_CM 6 0. 5434. DISPLAY_IDENTIFIER LDP_AMP_IP_IGA_DIF_MIN_CYC_AMP FORMAT "%7.2" /end AXIS_PTS
/begin CHARACTERISTIC ip_iga_dif_min_cyc_amp_at "Attitude correction on minimum ignition angle for after start for automatic transmission" MAP 0x06010 _REC_MAP_20_u1_u2_u1 95.625 _CNV_A_R_LINEAR_____205_CM -48. 47.625 DISPLAY_IDENTIFIER IP_IGA_DIF_MIN_CYC_AMP_AT FORMAT "%5.1"
 /begin AXIS_DESCR COM_AXIS amp _CNV_A_R_LINEAR_____49_CM 6 0. 5434. FORMAT "%7.2" AXIS_PTS_REF ldp_amp_ip_iga_dif_min_cyc_amp /end AXIS_DESCR
 /begin AXIS_DESCR COM_AXIS tco _CNV_A_R_LINEAR_____12_CM 8 -48. 142.5 FORMAT "%5.1" AXIS_PTS_REF ldpm_tco_1_igsp /end AXIS_DESCR
/end CHARACTERISTIC
/begin CHARACTERISTIC ip_iga_dif_min_cyc_amp_mt "Attitude correction on minimum ignition angle for after start for manual transmission" MAP 0x06040 _REC_MAP_20_u1_u2_u1 95.625 _CNV_A_R_LINEAR_____205_CM -48. 47.625 DISPLAY_IDENTIFIER IP_IGA_DIF_MIN_CYC_AMP_MT FORMAT "%5.1"
 /begin AXIS_DESCR COM_AXIS amp _CNV_A_R_LINEAR_____49_CM 6 0. 5434. FORMAT "%7.2" AXIS_PTS_REF ldp_amp_ip_iga_dif_min_cyc_amp /end AXIS_DESCR
 /begin AXIS_DESCR COM_AXIS tco _CNV_A_R_LINEAR_____12_CM 8 -48. 142.5 FORMAT "%5.1" AXIS_PTS_REF ldpm_tco_1_igsp /end AXIS_DESCR
/end CHARACTERISTIC
/begin MEASUREMENT lv_iga_min_ext "Flag to enable external IGA_MIN" UBYTE _CNV_S_2_RANGE______0_CM 1 100. 0. 1. DISPLAY_IDENTIFIER LV_IGA_MIN_EXT ECU_ADDRESS 0x3fe2ce /end MEASUREMENT
/begin MEASUREMENT iga_min_bas "Basic minimum ignition angle" UBYTE _CNV_A_R_LINEAR_____203_CM 1 100. -35.625 60. DISPLAY_IDENTIFIER IGA_MIN_BAS ECU_ADDRESS 0x3fe2bf FORMAT "%5.1" /end MEASUREMENT
/begin MEASUREMENT iga_min_bas_1 "Intermediate value: Basic minimum ignition angle" UBYTE _CNV_A_R_LINEAR_____203_CM 1 100. -35.625 60. DISPLAY_IDENTIFIER IGA_MIN_BAS_1 ECU_ADDRESS 0x3fe2c0 FORMAT "%5.1" /end MEASUREMENT
/begin MEASUREMENT iga_min_bas_ext "Intermediate value: Basic minimum ignition angle" UBYTE _CNV_A_R_LINEAR_____203_CM 1 100. -35.625 60. DISPLAY_IDENTIFIER IGA_MIN_BAS_EXT ECU_ADDRESS 0x3fe2c2 FORMAT "%5.1" /end MEASUREMENT
/begin MEASUREMENT iga_min_bas_int "Intermediate value: Basic minimum ignition angle" UBYTE _CNV_A_R_LINEAR_____203_CM 1 100. -35.625 60. DISPLAY_IDENTIFIER IGA_MIN_BAS_INT ECU_ADDRESS 0x3fe2c4 FORMAT "%5.1" /end MEASUREMENT
/begin CHARACTERISTIC ip_iga_min_n_maf_ext "Basic minimum ignition angle difference value" MAP 0x06170 _REC_MAP_20_u1_u1_u1 95.625 _CNV_A_R_LINEAR_____203_CM -35.625 60. DISPLAY_IDENTIFIER IP_IGA_MIN_N_MAF_EXT FORMAT "%5.1"
 /begin AXIS_DESCR COM_AXIS n_32 _CNV_A_R_LINEAR_____16_CM 8 0. 8160. FORMAT "%4.0" AXIS_PTS_REF ldpm_n_32_2_igsp /end AXIS_DESCR
 /begin AXIS_DESCR COM_AXIS maf _CNV_A_R_LINEAR_____27_CM 6 0. 1389. FORMAT "%4.0" AXIS_PTS_REF ldpm_maf_hb_2_igsp /end AXIS_DESCR
/end CHARACTERISTIC
/begin CHARACTERISTIC ip_iga_dif_min_tco_ext "TCO correction for minimum ignition angle" CURVE 0x00c58 _REC_CUR_20_u1_u1 95.625 _CNV_A_R_LINEAR_____205_CM -48. 47.625 DISPLAY_IDENTIFIER IP_IGA_DIF_MIN_TCO_EXT FORMAT "%5.1"
 /begin AXIS_DESCR COM_AXIS tco _CNV_A_R_LINEAR_____12_CM 8 -48. 142.5 FORMAT "%5.1" AXIS_PTS_REF ldpm_tco_1_igsp /end AXIS_DESCR
/end CHARACTERISTIC
/begin CHARACTERISTIC ip_iga_min_n_maf "Basic minimum ignition angle difference value" MAP 0x06140 _REC_MAP_20_u1_u1_u1 95.625 _CNV_A_R_LINEAR_____203_CM -35.625 60. DISPLAY_IDENTIFIER IP_IGA_MIN_N_MAF FORMAT "%5.1"
 /begin AXIS_DESCR COM_AXIS n_32 _CNV_A_R_LINEAR_____16_CM 8 0. 8160. FORMAT "%4.0" AXIS_PTS_REF ldpm_n_32_2_igsp /end AXIS_DESCR
 /begin AXIS_DESCR COM_AXIS maf _CNV_A_R_LINEAR_____27_CM 6 0. 1389. FORMAT "%4.0" AXIS_PTS_REF ldpm_maf_hb_2_igsp /end AXIS_DESCR
/end CHARACTERISTIC
/begin CHARACTERISTIC ip_fac_iga_min_tco_ext "Scaling TCO correction for minimum ignition angle" MAP 0x04df2 _REC_MAP_20_u1_u1_u1 0.9960940000000002 _CNV_A_R_LINEAR_____50_CM 0. 0.996094 DISPLAY_IDENTIFIER IP_FAC_IGA_MIN_TCO_EXT FORMAT "%5.3"
 /begin AXIS_DESCR COM_AXIS n_32 _CNV_A_R_LINEAR_____16_CM 8 0. 8160. FORMAT "%4.0" AXIS_PTS_REF ldpm_n_32_2_igsp /end AXIS_DESCR
 /begin AXIS_DESCR COM_AXIS maf _CNV_A_R_LINEAR_____27_CM 6 0. 1389. FORMAT "%4.0" AXIS_PTS_REF ldpm_maf_hb_2_igsp /end AXIS_DESCR
/end CHARACTERISTIC
/begin CHARACTERISTIC ip_fac_iga_dif_ast "Scaling N_DIF correction for minimum ignition angle after start" CURVE 0x00afb _REC_CUR_20_u1_u2 1.9921875 _CNV_A_R_LINEAR_____115_CM 0. 1.9921875 DISPLAY_IDENTIFIER IP_FAC_IGA_DIF_AST FORMAT "%5.3"
 /begin AXIS_DESCR COM_AXIS n_dif _CNV_A_R_LINEAR_____206_CM 8 -32768. 32767. FORMAT "%6.0" AXIS_PTS_REF ldpm_n_dif_igsp /end AXIS_DESCR
/end CHARACTERISTIC
/begin CHARACTERISTIC ip_t_iga_min_puc "Scaling N_32 correction for minimum ignition angle after start" CURVE 0x00df9 _REC_CUR_20_u1_u1 2.55 _CNV_A_R_LINEAR_____4_CM 0. 2.55 DISPLAY_IDENTIFIER IP_T_IGA_MIN_PUC FORMAT "%4.2"
 /begin AXIS_DESCR COM_AXIS n_32 _CNV_A_R_LINEAR_____16_CM 8 0. 8160. FORMAT "%4.0" AXIS_PTS_REF ldpm_n_32_2_igsp /end AXIS_DESCR
/end CHARACTERISTIC
/begin CHARACTERISTIC c_iga_dif_min_bas_lgrd "Step gradient limitation" VALUE 0x00701 _REC_VAL_20_u1 95.625 _CNV_A_R_LINEAR_____82_CM 0. 95.625 DISPLAY_IDENTIFIER C_IGA_DIF_MIN_BAS_LGRD FORMAT "%5.2" /end CHARACTERISTIC
/begin CHARACTERISTIC c_iga_min_puc_lgrd "Step gradient limitation" VALUE 0x0070b _REC_VAL_20_u1 95.625 _CNV_A_R_LINEAR_____82_CM 0. 95.625 DISPLAY_IDENTIFIER C_IGA_MIN_PUC_LGRD FORMAT "%5.2" /end CHARACTERISTIC
/begin MEASUREMENT iga_min_bas_puc "Intermediate value: Basic minimum ignition angle" UBYTE _CNV_A_R_LINEAR_____203_CM 1 100. -35.625 60. DISPLAY_IDENTIFIER IGA_MIN_BAS_PUC ECU_ADDRESS 0x3fe2c3 FORMAT "%5.1" /end MEASUREMENT
/begin MEASUREMENT iga_min_bas_pu "Intermediate value: PU minimum ignition angle" UBYTE _CNV_A_R_LINEAR_____203_CM 1 100. -35.625 60. DISPLAY_IDENTIFIER IGA_MIN_BAS_PU ECU_ADDRESS 0x3fe2c1 FORMAT "%5.1" /end MEASUREMENT
/begin CHARACTERISTIC ip_fac_iga_min_tco_pu "Scaling TCO correction for minimum ignition angle" MAP 0x04e22 _REC_MAP_20_u1_u1_u1 0.9960940000000002 _CNV_A_R_LINEAR_____50_CM 0. 0.996094 DISPLAY_IDENTIFIER IP_FAC_IGA_MIN_TCO_PU FORMAT "%5.3"
 /begin AXIS_DESCR COM_AXIS n_32 _CNV_A_R_LINEAR_____16_CM 8 0. 8160. FORMAT "%4.0" AXIS_PTS_REF ldpm_n_32_2_igsp /end AXIS_DESCR
 /begin AXIS_DESCR COM_AXIS maf _CNV_A_R_LINEAR_____27_CM 6 0. 1389. FORMAT "%4.0" AXIS_PTS_REF ldpm_maf_hb_2_igsp /end AXIS_DESCR
/end CHARACTERISTIC
/begin CHARACTERISTIC ip_iga_dif_min_tco_pu "TCO correction for minimum ignition angle" CURVE 0x00c60 _REC_CUR_20_u1_u1 95.625 _CNV_A_R_LINEAR_____205_CM -48. 47.625 DISPLAY_IDENTIFIER IP_IGA_DIF_MIN_TCO_PU FORMAT "%5.1"
 /begin AXIS_DESCR COM_AXIS tco _CNV_A_R_LINEAR_____12_CM 8 -48. 142.5 FORMAT "%5.1" AXIS_PTS_REF ldpm_tco_1_igsp /end AXIS_DESCR
/end CHARACTERISTIC
/begin CHARACTERISTIC ip_iga_min_n_maf_pu "Basic minimum ignition angle difference value" MAP 0x061a0 _REC_MAP_20_u1_u1_u1 95.625 _CNV_A_R_LINEAR_____203_CM -35.625 60. DISPLAY_IDENTIFIER IP_IGA_MIN_N_MAF_PU FORMAT "%5.1"
 /begin AXIS_DESCR COM_AXIS n_32 _CNV_A_R_LINEAR_____16_CM 8 0. 8160. FORMAT "%4.0" AXIS_PTS_REF ldpm_n_32_2_igsp /end AXIS_DESCR
 /begin AXIS_DESCR COM_AXIS maf _CNV_A_R_LINEAR_____27_CM 6 0. 1389. FORMAT "%4.0" AXIS_PTS_REF ldpm_maf_hb_2_igsp /end AXIS_DESCR
/end CHARACTERISTIC
/begin AXIS_PTS ldpm_n_dif_igsp "" 0x11992 n_dif _REC_AXS_20_u2 65535. _CNV_A_R_LINEAR_____206_CM 8 -32768. 32767. DISPLAY_IDENTIFIER LDPM_N_DIF_IGSP FORMAT "%6.0" /end AXIS_PTS
/begin CHARACTERISTIC ip_fac_iga_min_tco "Scaling TCO correction for minimum ignition angle" MAP 0x04dc2 _REC_MAP_20_u1_u1_u1 0.9960940000000002 _CNV_A_R_LINEAR_____50_CM 0. 0.996094 DISPLAY_IDENTIFIER IP_FAC_IGA_MIN_TCO FORMAT "%5.3"
 /begin AXIS_DESCR COM_AXIS n_32 _CNV_A_R_LINEAR_____16_CM 8 0. 8160. FORMAT "%4.0" AXIS_PTS_REF ldpm_n_32_2_igsp /end AXIS_DESCR
 /begin AXIS_DESCR COM_AXIS maf _CNV_A_R_LINEAR_____27_CM 6 0. 1389. FORMAT "%4.0" AXIS_PTS_REF ldpm_maf_hb_2_igsp /end AXIS_DESCR
/end CHARACTERISTIC
/begin CHARACTERISTIC ip_fac_iga_dif_min_amp "Scaling TCO correction for minimum ignition angle" CURVE 0x00b03 _REC_CUR_20_u1_u2 0.9960940000000002 _CNV_A_R_LINEAR_____50_CM 0. 0.996094 DISPLAY_IDENTIFIER IP_FAC_IGA_DIF_MIN_AMP FORMAT "%5.3"
 /begin AXIS_DESCR COM_AXIS cyc_cast _CNV_A_R_LINEAR_____1_CM 8 0. 65535. FORMAT "%5.0" AXIS_PTS_REF ldpm_cyc_cast_ip_iga_dif_min /end AXIS_DESCR
/end CHARACTERISTIC
/begin MEASUREMENT lv_mpl_iga_act "Status for multiple advance active" UBYTE _CNV_S_2_RANGE______5_CM 1 100. 0. 1. DISPLAY_IDENTIFIER LV_MPL_IGA_ACT ECU_ADDRESS 0x3fe2d2 BIT_MASK 0x1 /end MEASUREMENT
/begin MEASUREMENT td_mpl_dly "Spark duration" UBYTE _CNV_A_R_LINEAR_____198_CM 1 100. 0. 1.02 DISPLAY_IDENTIFIER TD_MPL_DLY ECU_ADDRESS 0x3fe2d3 FORMAT "%5.3" /end MEASUREMENT
/begin MEASUREMENT td_mpl "Dwell time with multiple spark" UWORD _CNV_A_R_LINEAR_____198_CM 1 100. 0. 50. DISPLAY_IDENTIFIER TD_MPL ECU_ADDRESS 0x3fd458 BYTE_ORDER MSB_LAST FORMAT "%7.4" /end MEASUREMENT
/begin MEASUREMENT ign_mpl_nr "Number of maximum allowed multiple sparks" UBYTE _CNV_A_R_LINEAR_____1_CM 1 100. 0. 255. DISPLAY_IDENTIFIER IGN_MPL_NR ECU_ADDRESS 0x3fe2d4 FORMAT "%3.0" /end MEASUREMENT
/begin CHARACTERISTIC c_tco_max_mpl_is "Max. Coolant Temp. at start to have multiple spark during idle" VALUE 0x00879 _REC_VAL_20_u1 190.5 _CNV_A_R_LINEAR_____12_CM -48. 142.5 DISPLAY_IDENTIFIER C_TCO_MAX_MPL_IS FORMAT "%5.1" /end CHARACTERISTIC
/begin CHARACTERISTIC c_tco_max_mpl_st "Max. Coolant Temp. at start to have multiple spark during engine start" VALUE 0x0087a _REC_VAL_20_u1 190.5 _CNV_A_R_LINEAR_____12_CM -48. 142.5 DISPLAY_IDENTIFIER C_TCO_MAX_MPL_ST FORMAT "%5.1" /end CHARACTERISTIC
/begin CHARACTERISTIC c_vb_max_mpl "Max. Battery voltage to have multiple spark (requested valve 16V)" VALUE 0x00926 _REC_VAL_20_u1 25.8984 _CNV_A_R_LINEAR_____34_CM 0. 25.8984 DISPLAY_IDENTIFIER C_VB_MAX_MPL FORMAT "%3.1" /end CHARACTERISTIC
/begin CHARACTERISTIC c_td_t_mpl "Minimum time between two ignition" VALUE 0x008b0 _REC_VAL_20_u1 1.02 _CNV_A_R_LINEAR_____198_CM 0. 1.02 DISPLAY_IDENTIFIER C_TD_T_MPL FORMAT "%5.3" /end CHARACTERISTIC
/begin CHARACTERISTIC c_n_max_ign_mpl "Maximum engine speed for multipla spark at idle" VALUE 0x00774 _REC_VAL_20_u1 408. _CNV_A_R_LINEAR_____16_CM 0. 8160. DISPLAY_IDENTIFIER C_N_MAX_IGN_MPL FORMAT "%4.0" /end CHARACTERISTIC
/begin CHARACTERISTIC ip_nr_mpl_st "Dwell time for multiple spark" CURVE 0x00d42 _REC_CUR_20_u1_u1 255. _CNV_A_R_LINEAR_____1_CM 0. 255. DISPLAY_IDENTIFIER IP_NR_MPL_ST FORMAT "%3.0"
 /begin AXIS_DESCR COM_AXIS tco _CNV_A_R_LINEAR_____12_CM 8 -48. 142.5 FORMAT "%5.1" AXIS_PTS_REF ldp_tco__nr_mpl_st /end AXIS_DESCR
/end CHARACTERISTIC
/begin CHARACTERISTIC ip_nr_mpl_is "Number of successive ignition sparks for idle" CURVE 0x00d3a _REC_CUR_20_u1_u1 255. _CNV_A_R_LINEAR_____1_CM 0. 255. DISPLAY_IDENTIFIER IP_NR_MPL_IS FORMAT "%3.0"
 /begin AXIS_DESCR COM_AXIS tco _CNV_A_R_LINEAR_____12_CM 8 -48. 142.5 FORMAT "%5.1" AXIS_PTS_REF ldp_tco__nr_mpl_is /end AXIS_DESCR
/end CHARACTERISTIC
/begin AXIS_PTS ldp_tco__nr_mpl_st "" 0x07dc2 tco _REC_AXS_20_u1 190.5 _CNV_A_R_LINEAR_____12_CM 8 -48. 142.5 DISPLAY_IDENTIFIER LDP_TCO__NR_MPL_ST FORMAT "%5.1" /end AXIS_PTS
/begin AXIS_PTS ldp_tco__nr_mpl_is "" 0x07db9 tco _REC_AXS_20_u1 190.5 _CNV_A_R_LINEAR_____12_CM 8 -48. 142.5 DISPLAY_IDENTIFIER LDP_TCO__NR_MPL_IS FORMAT "%5.1" /end AXIS_PTS
/begin CHARACTERISTIC ip_td_mpl "Dwell time for multiple spark" CURVE 0x0ebe2 _REC_CUR_20_u2_u2 50. _CNV_A_R_LINEAR_____198_CM 0. 50. DISPLAY_IDENTIFIER IP_TD_MPL FORMAT "%7.4"
 /begin AXIS_DESCR COM_AXIS vb _CNV_A_R_LINEAR_____207_CM 8 0. 28.7055 FORMAT "%5.2" AXIS_PTS_REF ldpm_vb__td /end AXIS_DESCR
/end CHARACTERISTIC
/begin AXIS_PTS ldpm_vb__td "" 0x11c8c vb _REC_AXS_20_u2 28.7055 _CNV_A_R_LINEAR_____207_CM 8 0. 28.7055 DISPLAY_IDENTIFIER LDPM_VB__TD FORMAT "%5.2" /end AXIS_PTS
/begin CHARACTERISTIC ip_iga_ref__n__maf "Basic reference ignition angle at max. spread" MAP 0x06210 _REC_MAP_20_u1_u1_u2 4.78125 _CNV_A_R_LINEAR_____203_CM -35.625 60. DISPLAY_IDENTIFIER IP_IGA_REF FORMAT "%5.1"
 /begin AXIS_DESCR COM_AXIS n_32 _CNV_A_R_LINEAR_____16_CM 16 0. 8160. FORMAT "%4.0" AXIS_PTS_REF ldpm_n_32_100 /end AXIS_DESCR
 /begin AXIS_DESCR COM_AXIS maf _CNV_A_R_LINEAR_____106_CM 12 0. 1389. FORMAT "%7.2" AXIS_PTS_REF ldpm_maf_100 /end AXIS_DESCR
/end CHARACTERISTIC
/begin CHARACTERISTIC ip_iga_ref_lamb__lamb_sp "additive lambda setpoint correction of IGA_REF" CURVE 0x00c76 _REC_CUR_20_u1_u2 95.625 _CNV_A_R_LINEAR_____205_CM -48. 47.625 DISPLAY_IDENTIFIER IP_IGA_REF_LAMB__LAMB_SP FORMAT "%5.1"
 /begin AXIS_DESCR COM_AXIS lamb_sp _CNV_A_R_LINEAR_____164_CM 8 0. 31.99902344 FORMAT "%7.4" AXIS_PTS_REF ldp_lamb_sp_iga_ref_lamb /end AXIS_DESCR
/end CHARACTERISTIC
/begin MEASUREMENT iga_ref_cor "corrected reference ignition angle" UBYTE _CNV_A_R_LINEAR_____203_CM 1 100. -35.625 60. DISPLAY_IDENTIFIER IGA_REF_COR ECU_ADDRESS 0x3fe2d5 FORMAT "%5.1" /end MEASUREMENT
/begin MEASUREMENT iga_ref_temp_cor "additive temperature correction of IGA_REF" SBYTE _CNV_A_R_LINEAR_____82_CM 1 100. -48. 47.625 DISPLAY_IDENTIFIER IGA_REF_TEMP_COR ECU_ADDRESS 0x3fe2d8 FORMAT "%5.1" /end MEASUREMENT
/begin MEASUREMENT iga_ref_vvt_cor "additive valve timing correction of IGA_REF" SBYTE _CNV_A_R_LINEAR_____82_CM 1 100. -48. 47.625 DISPLAY_IDENTIFIER IGA_REF_VVT_COR ECU_ADDRESS 0x3fe2d7 FORMAT "%5.1" /end MEASUREMENT
/begin MEASUREMENT iga_ref_egr_cor "additive EGR correction of IGA_REF" SBYTE _CNV_A_R_LINEAR_____82_CM 1 100. -48. 47.625 DISPLAY_IDENTIFIER IGA_REF_EGR_COR ECU_ADDRESS 0x3fe2d6 FORMAT "%5.1" /end MEASUREMENT
/begin CHARACTERISTIC ip_iga_ref_temp__n__maf "Max. reference ignition angle adjustment due to temperature influence" MAP 0x063e0 _REC_MAP_20_u1_u1_u1 95.625 _CNV_A_R_LINEAR_____205_CM -48. 47.625 DISPLAY_IDENTIFIER IP_IGA_REF_TEMP__N__MAF FORMAT "%5.1"
 /begin AXIS_DESCR COM_AXIS n_32 _CNV_A_R_LINEAR_____16_CM 8 0. 8160. FORMAT "%4.0" AXIS_PTS_REF ldp_n_iga_ref_temp /end AXIS_DESCR
 /begin AXIS_DESCR COM_AXIS maf _CNV_A_R_LINEAR_____27_CM 6 0. 1389. FORMAT "%4.0" AXIS_PTS_REF ldp_maf_iga_ref_temp /end AXIS_DESCR
/end CHARACTERISTIC
/begin CHARACTERISTIC ip_iga_ref_vvt__n__maf "basis for additive valve timing correction of IGA_REF" MAP 0x06434 _REC_MAP_20_u1_u1_u1 95.625 _CNV_A_R_LINEAR_____205_CM -48. 47.625 DISPLAY_IDENTIFIER IP_IGA_REF_VVT__N__MAF FORMAT "%5.1"
 /begin AXIS_DESCR COM_AXIS n_32 _CNV_A_R_LINEAR_____16_CM 16 0. 8160. FORMAT "%4.0" AXIS_PTS_REF ldp_n__iga_ref_vvt /end AXIS_DESCR
 /begin AXIS_DESCR COM_AXIS maf _CNV_A_R_LINEAR_____27_CM 12 0. 1389. FORMAT "%4.0" AXIS_PTS_REF ldp_maf__iga_ref_vvt /end AXIS_DESCR
/end CHARACTERISTIC
/begin CHARACTERISTIC ip_iga_ref_temp_fac__tia__tco "Correction factor for reference IGA temperature correction" MAP 0x06410 _REC_MAP_20_u1_u1_u1 1.9921875 _CNV_A_R_LINEAR_____208_CM -1. 0.9921875 DISPLAY_IDENTIFIER IP_IGA_REF_TEMP_FAC FORMAT "%5.3"
 /begin AXIS_DESCR COM_AXIS tia _CNV_A_R_LINEAR_____12_CM 6 -48. 142.5 FORMAT "%5.1" AXIS_PTS_REF ldp_tia__iga_ref_temp_fac /end AXIS_DESCR
 /begin AXIS_DESCR COM_AXIS tco _CNV_A_R_LINEAR_____12_CM 6 -48. 142.5 FORMAT "%5.1" AXIS_PTS_REF ldp_tco__iga_ref_temp_fac /end AXIS_DESCR
/end CHARACTERISTIC
/begin CHARACTERISTIC ip_iga_ref_egr_fac__n__maf "factor for EGR correction of IGA_REF" MAP 0x062d0 _REC_MAP_20_u1_u1_u2 1.9921875 _CNV_A_R_LINEAR_____115_CM 0. 1.9921875 DISPLAY_IDENTIFIER IP_IGA_REF_EGR_FAC FORMAT "%5.3"
 /begin AXIS_DESCR COM_AXIS n_32 _CNV_A_R_LINEAR_____16_CM 12 0. 8160. FORMAT "%4.0" AXIS_PTS_REF ldpm_n_32_ip_egr_ratio /end AXIS_DESCR
 /begin AXIS_DESCR COM_AXIS maf _CNV_A_R_LINEAR_____106_CM 12 0. 1389. FORMAT "%7.2" AXIS_PTS_REF ldpm_maf_ip_egr_ratio /end AXIS_DESCR
/end CHARACTERISTIC
/begin CHARACTERISTIC ip_iga_ref_egr "basis for EGR correection of IGA_REF" CURVE 0x00c70 _REC_CUR_20_u1_u2 95.625 _CNV_A_R_LINEAR_____205_CM -48. 47.625 DISPLAY_IDENTIFIER IP_IGA_REF_EGR FORMAT "%5.1"
 /begin AXIS_DESCR COM_AXIS egr_ratio_cor _CNV_A_R_LINEAR_____9_CM 6 0. 99.99847412 AXIS_PTS_REF ldp_egr_ratio_cor__iga_ref_egr /end AXIS_DESCR
/end CHARACTERISTIC
/begin CHARACTERISTIC ip_fac_iga_ref_port "port flap position correction of IGA_REF" CURVE 0x00b0b _REC_CUR_20_u1_u2 0.9960940000000002 _CNV_A_R_LINEAR_____50_CM 0. 0.996094 DISPLAY_IDENTIFIER IP_FAC_IGA_REF_PORT FORMAT "%5.3"
 /begin AXIS_DESCR COM_AXIS port_av _CNV_A_R_LINEAR_____209_CM 8 0. 99.99847412 AXIS_PTS_REF ldp_port_av__fac_iga_bas_port /end AXIS_DESCR
/end CHARACTERISTIC
/begin CHARACTERISTIC ip_fac_iga_ref_egr_lamb "factor for EGR_RATIO list of data points" MAP 0x04eb2 _REC_MAP_20_u1_u1_u2 0.9960940000000002 _CNV_A_R_LINEAR_____50_CM 0. 0.996094 DISPLAY_IDENTIFIER IP_FAC_IGA_REF_EGR_LAMB FORMAT "%5.3"
 /begin AXIS_DESCR COM_AXIS n_32 _CNV_A_R_LINEAR_____16_CM 12 0. 8160. FORMAT "%4.0" AXIS_PTS_REF ldpm_n_32_ip_egr_ratio /end AXIS_DESCR
 /begin AXIS_DESCR COM_AXIS maf _CNV_A_R_LINEAR_____106_CM 12 0. 1389. FORMAT "%7.2" AXIS_PTS_REF ldpm_maf_ip_egr_ratio /end AXIS_DESCR
/end CHARACTERISTIC
/begin CHARACTERISTIC ip_iga_ref_port "basic map for additive port flap position correction of IGA_REF" MAP 0x063a0 _REC_MAP_20_u1_u1_u2 95.625 _CNV_A_R_LINEAR_____205_CM -48. 47.625 DISPLAY_IDENTIFIER IP_IGA_REF_PORT FORMAT "%5.1"
 /begin AXIS_DESCR COM_AXIS n_32 _CNV_A_R_LINEAR_____16_CM 8 0. 8160. FORMAT "%4.0" AXIS_PTS_REF ldp_n_32__iga_bas_port /end AXIS_DESCR
 /begin AXIS_DESCR COM_AXIS maf _CNV_A_R_LINEAR_____106_CM 8 0. 1389. FORMAT "%7.2" AXIS_PTS_REF ldp_maf__iga_ref_port /end AXIS_DESCR
/end CHARACTERISTIC
/begin AXIS_PTS ldp_lamb_sp_iga_ref_lamb "" 0x10b6c lamb_sp _REC_AXS_20_u2 31.99902344 _CNV_A_R_LINEAR_____164_CM 8 0. 31.99902344 DISPLAY_IDENTIFIER LDP_LAMB_SP_IGA_REF_LAMB FORMAT "%7.4" /end AXIS_PTS
/begin AXIS_PTS ldp_n_iga_ref_temp "" 0x07cf6 n_32 _REC_AXS_20_u1 8160. _CNV_A_R_LINEAR_____16_CM 8 0. 8160. DISPLAY_IDENTIFIER LDP_N_IGA_REF_TEMP FORMAT "%4.0" /end AXIS_PTS
/begin AXIS_PTS ldp_maf_iga_ref_temp "" 0x01003 maf _REC_AXS_20_u1 1389. _CNV_A_R_LINEAR_____27_CM 6 0. 1389. DISPLAY_IDENTIFIER LDP_MAF_IGA_REF_TEMP FORMAT "%4.0" /end AXIS_PTS
/begin AXIS_PTS ldp_tia__iga_ref_temp_fac "" 0x011f3 tia _REC_AXS_20_u1 190.5 _CNV_A_R_LINEAR_____12_CM 6 -48. 142.5 DISPLAY_IDENTIFIER LDP_TIA__IGA_REF_TEMP_FAC FORMAT "%5.1" /end AXIS_PTS
/begin AXIS_PTS ldp_n__iga_ref_vvt "" 0x07cb5 n_32 _REC_AXS_20_u1 8160. _CNV_A_R_LINEAR_____16_CM 16 0. 8160. DISPLAY_IDENTIFIER LDP_N__IGA_REF_VVT FORMAT "%4.0" /end AXIS_PTS
/begin AXIS_PTS ldp_tco__iga_ref_temp_fac "" 0x01151 tco _REC_AXS_20_u1 190.5 _CNV_A_R_LINEAR_____12_CM 6 -48. 142.5 DISPLAY_IDENTIFIER LDP_TCO__IGA_REF_TEMP_FAC FORMAT "%5.1" /end AXIS_PTS
/begin AXIS_PTS ldp_maf__iga_ref_vvt "" 0x07b67 maf _REC_AXS_20_u1 1389. _CNV_A_R_LINEAR_____27_CM 12 0. 1389. DISPLAY_IDENTIFIER LDP_MAF__IGA_REF_VVT FORMAT "%4.0" /end AXIS_PTS
/begin AXIS_PTS ldp_egr_ratio_cor__iga_ref_egr "" 0x10a70 egr_ratio_cor _REC_AXS_20_u2 99.99847412 _CNV_A_R_LINEAR_____9_CM 6 0. 99.99847412 DISPLAY_IDENTIFIER LDP_EGR_RATIO_COR__IGA_REF_EGR /end AXIS_PTS
/begin AXIS_PTS ldp_maf__iga_ref_port "" 0x10b88 maf _REC_AXS_20_u2 1389. _CNV_A_R_LINEAR_____106_CM 8 0. 1389. DISPLAY_IDENTIFIER LDP_MAF__IGA_REF_PORT FORMAT "%7.2" /end AXIS_PTS
/begin AXIS_PTS ldp_n_32__iga_bas_port "" 0x07be8 n_32 _REC_AXS_20_u1 8160. _CNV_A_R_LINEAR_____16_CM 8 0. 8160. DISPLAY_IDENTIFIER LDP_N_32__IGA_BAS_PORT FORMAT "%4.0" /end AXIS_PTS
/begin AXIS_PTS ldp_port_av__fac_iga_bas_port "" 0x11060 port_av _REC_AXS_20_u2 99.99847412 _CNV_A_R_LINEAR_____209_CM 8 0. 99.99847412 DISPLAY_IDENTIFIER LDP_PORT_AV__FAC_IGA_BAS_PORT /end AXIS_PTS
/begin MEASUREMENT egr_ratio_cor "Corrected EGR ratio" UWORD _CNV_A_R_LINEAR_____9_CM 1 100. 0. 99.99847412 DISPLAY_IDENTIFIER EGR_RATIO_COR ECU_ADDRESS 0x3fd45a BYTE_ORDER MSB_LAST /end MEASUREMENT
/begin MEASUREMENT iga_ref_lamb_cor "additive Lambda correction of IGA_REF" SBYTE _CNV_A_R_LINEAR_____82_CM 1 100. -48. 47.625 DISPLAY_IDENTIFIER IGA_REF_LAMB_COR ECU_ADDRESS 0x3fe2d9 FORMAT "%5.1" /end MEASUREMENT
/begin MEASUREMENT iga_ref_port_cor "additive port-flap correction of IGA_REF" SBYTE _CNV_A_R_LINEAR_____82_CM 1 100. -48. 47.625 DISPLAY_IDENTIFIER IGA_REF_PORT_COR ECU_ADDRESS 0x3fe2da FORMAT "%5.1" /end MEASUREMENT
/begin CHARACTERISTIC ip_iga_dif_sp__eff_iga_sp "Setpoint spark retard for torque setpoint" CURVE 0x06130 _REC_CUR_20_u1_u2 -95.625 _CNV_A_R_LINEAR_____204_CM 0. -95.625 DISPLAY_IDENTIFIER IP_IGA_DIF_SP__EFF_IGA_SP FORMAT "%5.1"
 /begin AXIS_DESCR COM_AXIS eff_iga_sp _CNV_A_R_LINEAR_____21_CM 16 0. 1.99996948 FORMAT "%7.5" AXIS_PTS_REF ldp_eff_iga_sp_iga_dif_sp /end AXIS_DESCR
/end CHARACTERISTIC
/begin MEASUREMENT iga_dif_sp "Setpoint subtrahend ignition angle" UBYTE _CNV_A_R_LINEAR_____204_CM 1 100. 0. -95.625 DISPLAY_IDENTIFIER IGA_DIF_SP ECU_ADDRESS 0x3fe2de FORMAT "%5.1" /end MEASUREMENT
/begin MEASUREMENT lv_tq_iga_act "Logical variable torque intervention by spark retard is active" UBYTE _CNV_S_2_RANGE______0_CM 1 100. 0. 1. DISPLAY_IDENTIFIER LV_TQ_IGA_ACT ECU_ADDRESS 0x3fe2df /end MEASUREMENT
/begin MEASUREMENT lv_tq_iga_req "Logical variable torque intervention by spark retard is request" UBYTE _CNV_S_2_RANGE______0_CM 1 100. 0. 1. DISPLAY_IDENTIFIER LV_TQ_IGA_REQ ECU_ADDRESS 0x3fe2e1 BIT_MASK 0x1 /end MEASUREMENT
/begin CHARACTERISTIC lc_tq_iga_inh "Logical constant inhibition torque intervention by spark retard" VALUE 0x00f87 _REC_VAL_20_u1 1. _CNV_A_R_LINEAR_____22_CM 0. 1. DISPLAY_IDENTIFIER LC_TQ_IGA_INH FORMAT "%1.0" /end CHARACTERISTIC
/begin CHARACTERISTIC c_eff_iga_thd_1 "Threshold ignition efficiency for deactivation spark retard" VALUE 0x01534 _REC_VAL_20_u2 1.99996948 _CNV_A_R_LINEAR_____21_CM 0. 1.99996948 DISPLAY_IDENTIFIER C_EFF_IGA_THD_1 FORMAT "%7.5" /end CHARACTERISTIC
/begin CHARACTERISTIC c_eff_iga_thd_aj "Threshold ignition efficiency for deactivation spark retard in anti-jerk intervention" VALUE 0x01536 _REC_VAL_20_u2 1.99996948 _CNV_A_R_LINEAR_____21_CM 0. 1.99996948 DISPLAY_IDENTIFIER C_EFF_IGA_THD_AJ FORMAT "%7.5" /end CHARACTERISTIC
/begin CHARACTERISTIC c_eff_iga_thd_is "Threshold ignition efficiency for deactivation spark retard" VALUE 0x01538 _REC_VAL_20_u2 1.99996948 _CNV_A_R_LINEAR_____21_CM 0. 1.99996948 DISPLAY_IDENTIFIER C_EFF_IGA_THD_IS FORMAT "%7.5" /end CHARACTERISTIC
/begin AXIS_PTS ldp_eff_iga_sp_iga_dif_sp "" 0x10a10 eff_iga_sp _REC_AXS_20_u2 1.99996948 _CNV_A_R_LINEAR_____21_CM 16 0. 1.99996948 DISPLAY_IDENTIFIER LDP_EFF_IGA_SP_IGA_DIF_SP FORMAT "%7.5" /end AXIS_PTS
/begin MEASUREMENT eff_iga_sp "Setpoint ignition efficiency" UWORD _CNV_A_R_LINEAR_____21_CM 1 100. 0. 1.99996948 DISPLAY_IDENTIFIER EFF_IGA_SP ECU_ADDRESS 0x3fd45c BYTE_ORDER MSB_LAST FORMAT "%7.5" /end MEASUREMENT
/begin MEASUREMENT eff_iga_sp_can "Setpoint ignition efficiency for CAN" UWORD _CNV_A_R_LINEAR_____21_CM 1 100. 0. 1.99996948 DISPLAY_IDENTIFIER EFF_IGA_SP_CAN ECU_ADDRESS 0x3fd460 BYTE_ORDER MSB_LAST FORMAT "%7.5" /end MEASUREMENT
/begin MEASUREMENT eff_iga_sp_1 "Setpoint ignition efficiency" UWORD _CNV_A_R_LINEAR_____21_CM 1 100. 0. 1.99996948 DISPLAY_IDENTIFIER EFF_IGA_SP_1 ECU_ADDRESS 0x3fd45e BYTE_ORDER MSB_LAST FORMAT "%7.5" /end MEASUREMENT
/begin MEASUREMENT eff_iga_sp_1_can "Setpoint ignition efficiency for CAN" UWORD _CNV_A_R_LINEAR_____21_CM 1 100. 0. 1.99996948 DISPLAY_IDENTIFIER EFF_IGA_SP_1_CAN ECU_ADDRESS 0x3fd462 BYTE_ORDER MSB_LAST FORMAT "%7.5" /end MEASUREMENT
/begin MEASUREMENT iga_sp "Setpoint ignition angle from torque management" UBYTE _CNV_A_R_LINEAR_____203_CM 1 100. -35.625 60. DISPLAY_IDENTIFIER IGA_SP ECU_ADDRESS 0x3fe2dc FORMAT "%5.1" /end MEASUREMENT
/begin MEASUREMENT iga_sp_can "Setpoint ignition angle from torque management for CAN" UBYTE _CNV_A_R_LINEAR_____203_CM 1 100. -35.625 60. DISPLAY_IDENTIFIER IGA_SP_CAN ECU_ADDRESS 0x3fe2dd FORMAT "%5.1" /end MEASUREMENT
/begin MEASUREMENT iga_st "Basic ignition angle at start" UBYTE _CNV_A_R_LINEAR_____203_CM 1 100. -35.625 60. DISPLAY_IDENTIFIER IGA_ST ECU_ADDRESS 0x3fe2e2 FORMAT "%5.1" /end MEASUREMENT
/begin CHARACTERISTIC ip_iga_st_bas "Basic ignition angle at start" MAP 0x064f4 _REC_MAP_20_u1_u2_u1 4.78125 _CNV_A_R_LINEAR_____203_CM -35.625 60. DISPLAY_IDENTIFIER IP_IGA_ST_BAS FORMAT "%5.1"
 /begin AXIS_DESCR COM_AXIS n _CNV_A_R_LINEAR_____11_CM 6 0. 8160. FORMAT "%4.0" AXIS_PTS_REF ldp_n_ip_iga_st_bas /end AXIS_DESCR
 /begin AXIS_DESCR COM_AXIS tco _CNV_A_R_LINEAR_____12_CM 8 -48. 142.5 FORMAT "%5.1" AXIS_PTS_REF ldpm_tco_1_igsp /end AXIS_DESCR
/end CHARACTERISTIC
/begin CHARACTERISTIC ip_iga_st_cyc_st_cor "Basic ignition angle at start" MAP 0x06524 _REC_MAP_20_u1_u1_u1 4.78125 _CNV_A_R_LINEAR_____205_CM -48. 47.625 DISPLAY_IDENTIFIER IP_IGA_ST_CYC_ST_COR FORMAT "%5.1"
 /begin AXIS_DESCR COM_AXIS cycnr_st _CNV_A_R_LINEAR_____1_CM 6 0. 255. FORMAT "%3.0" AXIS_PTS_REF ldp_cyc_st_ip_iga_st_cyc_st_cor /end AXIS_DESCR
 /begin AXIS_DESCR COM_AXIS tco _CNV_A_R_LINEAR_____12_CM 8 -48. 142.5 FORMAT "%5.1" AXIS_PTS_REF ldpm_tco_1_igsp /end AXIS_DESCR
/end CHARACTERISTIC
/begin CHARACTERISTIC ip_iga_st_amp_cor "Basic ignition angle at start" CURVE 0x00c7e _REC_CUR_20_u1_u2 4.78125 _CNV_A_R_LINEAR_____205_CM -48. 47.625 DISPLAY_IDENTIFIER IP_IGA_ST_AMP_COR FORMAT "%5.1"
 /begin AXIS_DESCR COM_AXIS amp _CNV_A_R_LINEAR_____49_CM 6 0. 5434. FORMAT "%7.2" AXIS_PTS_REF ldp_amp_ip_iga_st_amp_cor /end AXIS_DESCR
/end CHARACTERISTIC
/begin AXIS_PTS ldp_cyc_st_ip_iga_st_cyc_st_cor "" 0x00fa7 cycnr_st _REC_AXS_20_u1 255. _CNV_A_R_LINEAR_____1_CM 6 0. 255. DISPLAY_IDENTIFIER LDP_CYC_ST_IP_IGA_ST_CYC_ST_COR FORMAT "%3.0" /end AXIS_PTS
/begin AXIS_PTS ldp_n_ip_iga_st_bas "" 0x10f76 n _REC_AXS_20_u2 8160. _CNV_A_R_LINEAR_____11_CM 6 0. 8160. DISPLAY_IDENTIFIER LDP_N_IP_IGA_ST_BAS FORMAT "%4.0" /end AXIS_PTS
/begin AXIS_PTS ldp_amp_ip_iga_st_amp_cor "" 0x108d0 amp _REC_AXS_20_u2 5434. _CNV_A_R_LINEAR_____49_CM 6 0. 5434. DISPLAY_IDENTIFIER LDP_AMP_IP_IGA_ST_AMP_COR FORMAT "%7.2" /end AXIS_PTS
/begin CHARACTERISTIC c_td_ini "initial value for dwell time control" VALUE 0x018cc _REC_VAL_20_u2 10. _CNV_A_R_LINEAR_____198_CM 0. 10. DISPLAY_IDENTIFIER C_TD_INI FORMAT "%5.2" /end CHARACTERISTIC
/begin CHARACTERISTIC c_td_as "Application intervention" VALUE 0x0039b _REC_VAL_20_s1 16.32 _CNV_A_R_LINEAR_____210_CM -8.192 8.128 DISPLAY_IDENTIFIER C_TD_AS FORMAT "%6.2" /end CHARACTERISTIC
/begin MEASUREMENT td_max_wdt "Maximum executable dwell time" UWORD _CNV_A_R_LINEAR_____198_CM 1 100. 0. 50. DISPLAY_IDENTIFIER TD_MAX_WDT ECU_ADDRESS 0x3fd466 BYTE_ORDER MSB_LAST FORMAT "%7.4" /end MEASUREMENT
/begin MEASUREMENT td "Nominal dwell time" UWORD _CNV_A_R_LINEAR_____198_CM 1 100. 0. 50. DISPLAY_IDENTIFIER TD ECU_ADDRESS 0x3fd464 BYTE_ORDER MSB_LAST FORMAT "%7.4" /end MEASUREMENT
/begin CHARACTERISTIC ip_td__vb "Dwell time correction versus battery voltage" CURVE 0x0ebd2 _REC_CUR_20_u2_u2 10. _CNV_A_R_LINEAR_____198_CM 0. 10. DISPLAY_IDENTIFIER IP_TD__VB FORMAT "%5.2"
 /begin AXIS_DESCR COM_AXIS vb _CNV_A_R_LINEAR_____207_CM 8 0. 28.7055 FORMAT "%5.2" AXIS_PTS_REF ldpm_vb__td /end AXIS_DESCR
/end CHARACTERISTIC
/begin MEASUREMENT iga_min_teg "minimum ignition angle" UBYTE _CNV_A_R_LINEAR_____203_CM 1 100. -35.625 60. DISPLAY_IDENTIFIER IGA_MIN_TEG ECU_ADDRESS 0x3fe2e3 FORMAT "%5.1" /end MEASUREMENT
/begin MEASUREMENT iga_dif_min_teg "Difference of minimum ignition angle with reference one - TEG correction included" UBYTE _CNV_A_R_LINEAR_____204_CM 1 100. 0. -95.625 DISPLAY_IDENTIFIER IGA_DIF_MIN_TEG ECU_ADDRESS 0x3fe2e4 FORMAT "%5.1" /end MEASUREMENT
/begin MEASUREMENT eff_iga_min_teg "Ignition efficiency minimum ignition angle with TEG correction" UWORD _CNV_A_R_LINEAR_____21_CM 1 100. 0. 1.99996948 DISPLAY_IDENTIFIER EFF_IGA_MIN_TEG ECU_ADDRESS 0x3fd468 BYTE_ORDER MSB_LAST FORMAT "%7.5" /end MEASUREMENT
/begin CHARACTERISTIC c_teg_max_iga_hys "Hysterisis on exhaust gas temperature for spark retard control" VALUE 0x018ea _REC_VAL_20_u2 2047. _CNV_A_R_LINEAR_____7_CM 0. 2047. DISPLAY_IDENTIFIER C_TEG_MAX_IGA_HYS FORMAT "%7.2" /end CHARACTERISTIC
/begin CHARACTERISTIC c_teg_max_iga "Maximum allowable exhaust gas temperature for spark retard control" VALUE 0x018e8 _REC_VAL_20_u2 2047. _CNV_A_R_LINEAR_____7_CM 0. 2047. DISPLAY_IDENTIFIER C_TEG_MAX_IGA FORMAT "%7.2" /end CHARACTERISTIC
/begin CHARACTERISTIC ip_iga_dif_min_teg__teg "Minimum ignition angle versus exhaust gas temperature" CURVE 0x06120 _REC_CUR_20_u1_u2 -95.625 _CNV_A_R_LINEAR_____204_CM 0. -95.625 DISPLAY_IDENTIFIER IP_IGA_DIF_MIN_TEG__TEG FORMAT "%5.1"
 /begin AXIS_DESCR COM_AXIS teg_dyn_hys _CNV_A_R_LINEAR_____7_CM 16 0. 2047. FORMAT "%7.2" AXIS_PTS_REF ldp_teg_dyn_hys /end AXIS_DESCR
/end CHARACTERISTIC
/begin MEASUREMENT teg_dyn_hys "Temperature of exhaust gas with hysterisis for IGA_MIN limitation" UWORD _CNV_A_R_LINEAR_____7_CM 1 100. 0. 2047. DISPLAY_IDENTIFIER TEG_DYN_HYS ECU_ADDRESS 0x3fd46c BYTE_ORDER MSB_LAST FORMAT "%7.2" /end MEASUREMENT
/begin MEASUREMENT teg_cat_up_mdl_max "Maximal temperature of exhaust gas between all cylinder bank" UWORD _CNV_A_R_LINEAR_____7_CM 1 100. 0. 2047. DISPLAY_IDENTIFIER TEG_CAT_UP_MDL_MAX ECU_ADDRESS 0x3fd46a BYTE_ORDER MSB_LAST FORMAT "%7.2" /end MEASUREMENT
/begin AXIS_PTS ldp_teg_dyn_hys "" 0x111ba teg_dyn_hys _REC_AXS_20_u2 2047. _CNV_A_R_LINEAR_____7_CM 16 0. 2047. DISPLAY_IDENTIFIER LDP_TEG_DYN_HYS FORMAT "%7.2" /end AXIS_PTS
/begin AXIS_PTS ldpm_ctr_km_can_1 "" 0x115d8 ctr_km_can _REC_AXS_20_u2 655350. _CNV_A_R_LINEAR_____88_CM 4 0. 655350. DISPLAY_IDENTIFIER LDPM_CTR_KM_CAN_1 FORMAT "%7.0" /end AXIS_PTS
/begin CHARACTERISTIC c_cycnr_ad2_dec_knk "Cycle counter for adjustment into retard direction" VALUE 0x0151c _REC_VAL_20_u2 65535. _CNV_A_R_LINEAR_____248_CM 0. 65535. DISPLAY_IDENTIFIER C_CYCNR_AD2_DEC_KNK FORMAT "%5.0" /end CHARACTERISTIC
/begin CHARACTERISTIC ip_maf_min_knk__n__tco "Air-mass Threshold Release KNK" MAP 0x06988 _REC_MAP_20_u1_u1_u1 1389. _CNV_A_R_LINEAR_____27_CM 0. 1389. DISPLAY_IDENTIFIER IP_MAF_MIN_KNK FORMAT "%4.0"
 /begin AXIS_DESCR COM_AXIS n_32 _CNV_A_R_LINEAR_____16_CM 8 0. 8160. FORMAT "%4.0" AXIS_PTS_REF ldpm_n_3_9 /end AXIS_DESCR
 /begin AXIS_DESCR COM_AXIS tco _CNV_A_R_LINEAR_____12_CM 4 -48. 142.5 FORMAT "%3.0" AXIS_PTS_REF ldp_tco__maf_min_knk /end AXIS_DESCR
/end CHARACTERISTIC
/begin CHARACTERISTIC id_iga_ad1_knk_size__n__maf "Table for the definition of the size and the LDP division of Adaptation table circuit 1" MAP 0x03d70 _REC_MAP_20_u1_u1_u1 48. _CNV_A_R_LINEAR_____205_CM -48. 0. DISPLAY_IDENTIFIER ID_IGA_AD1_KNK_SIZE FORMAT "%6.2"
 /begin AXIS_DESCR COM_AXIS n_knk _CNV_A_R_LINEAR_____16_CM 8 0. 8160. FORMAT "%4.0" AXIS_PTS_REF ldpm_n_iga_ad /end AXIS_DESCR
 /begin AXIS_DESCR COM_AXIS maf_knk _CNV_A_R_LINEAR_____27_CM 6 0. 1389. FORMAT "%7.2" AXIS_PTS_REF ldpm_maf_iga_ad /end AXIS_DESCR
/end CHARACTERISTIC
/begin CHARACTERISTIC id_iga_dec_knk_1__n "Spark retard at recognised knocking, Intensity 1" CURVE 0x009d0 _REC_CUR_20_u1_u1 47.25 _CNV_A_R_LINEAR_____136_CM 0.375 47.625 DISPLAY_IDENTIFIER ID_IGA_DEC_KNK_1 FORMAT "%4.1"
 /begin AXIS_DESCR COM_AXIS n_knk _CNV_A_R_LINEAR_____16_CM 3 0. 8160. FORMAT "%4.0" AXIS_PTS_REF ldpm_n_4_9 /end AXIS_DESCR
/end CHARACTERISTIC
/begin CHARACTERISTIC id_iga_dec_knk_2__n "Spark retard at recognised knocking, Intensity 2" CURVE 0x009d3 _REC_CUR_20_u1_u1 47.25 _CNV_A_R_LINEAR_____136_CM 0.375 47.625 DISPLAY_IDENTIFIER ID_IGA_DEC_KNK_2 FORMAT "%4.1"
 /begin AXIS_DESCR COM_AXIS n_knk _CNV_A_R_LINEAR_____16_CM 3 0. 8160. FORMAT "%4.0" AXIS_PTS_REF ldpm_n_4_9 /end AXIS_DESCR
/end CHARACTERISTIC
/begin CHARACTERISTIC id_maf_min_ad_knk__n "Air-mass Threshold for Knock Adaptation" CURVE 0x009d6 _REC_CUR_20_u1_u1 1389. _CNV_A_R_LINEAR_____27_CM 0. 1389. DISPLAY_IDENTIFIER ID_MAF_MIN_AD_KNK__N FORMAT "%4.0"
 /begin AXIS_DESCR COM_AXIS n_knk _CNV_A_R_LINEAR_____16_CM 8 0. 8160. FORMAT "%4.0" AXIS_PTS_REF ldpm_n_iga_ad /end AXIS_DESCR
/end CHARACTERISTIC
/begin CHARACTERISTIC id_n_grd_max_knk__n "Speed Gradient for dynamic identification" CURVE 0x009de _REC_CUR_20_u1_u1 4064. _CNV_A_R_LINEAR_____51_CM 0. 4064. DISPLAY_IDENTIFIER ID_N_GRD_MAX_KNK__N FORMAT "%4.0"
 /begin AXIS_DESCR COM_AXIS n_knk _CNV_A_R_LINEAR_____16_CM 8 0. 8160. FORMAT "%4.0" AXIS_PTS_REF ldpm_n_iga_ad /end AXIS_DESCR
/end CHARACTERISTIC
/begin CHARACTERISTIC ip_iga_inc_knk__n "Re-set Increment KNK" CURVE 0x01ae6 _REC_CUR_20_u2_u1 47.99707032000001 _CNV_A_R_LINEAR_____249_CM 1.46484e-003 47.99853516 DISPLAY_IDENTIFIER IP_IGA_INC_KNK FORMAT "%8.5"
 /begin AXIS_DESCR COM_AXIS n_knk _CNV_A_R_LINEAR_____16_CM 4 0. 8160. FORMAT "%4.0" AXIS_PTS_REF ldpm_n_fil_frq_knk /end AXIS_DESCR
/end CHARACTERISTIC
/begin MEASUREMENT iga_ad1_knk[0] "Actual Adaptation value for Cyl. x (Adaptation circuit 1)" UBYTE _CNV_A_R_LINEAR_____205_CM 1 100. -48. 0. DISPLAY_IDENTIFIER IGA_AD1_KNK_0 ECU_ADDRESS 0x3fd49e FORMAT "%5.1" /end MEASUREMENT
/begin MEASUREMENT iga_ad1_knk[1] "Actual Adaptation value for Cyl. x (Adaptation circuit 1)" UBYTE _CNV_A_R_LINEAR_____205_CM 1 100. -48. 0. DISPLAY_IDENTIFIER IGA_AD1_KNK_1 ECU_ADDRESS 0x3fd4a0 FORMAT "%5.1" /end MEASUREMENT
/begin MEASUREMENT iga_ad1_knk[2] "Actual Adaptation value for Cyl. x (Adaptation circuit 1)" UBYTE _CNV_A_R_LINEAR_____205_CM 1 100. -48. 0. DISPLAY_IDENTIFIER IGA_AD1_KNK_2 ECU_ADDRESS 0x3fd4a2 FORMAT "%5.1" /end MEASUREMENT
/begin MEASUREMENT iga_ad1_knk[3] "Actual Adaptation value for Cyl. x (Adaptation circuit 1)" UBYTE _CNV_A_R_LINEAR_____205_CM 1 100. -48. 0. DISPLAY_IDENTIFIER IGA_AD1_KNK_3 ECU_ADDRESS 0x3fd4a4 FORMAT "%5.1" /end MEASUREMENT
/begin MEASUREMENT iga_ad1_knk[4] "Actual Adaptation value for Cyl. x (Adaptation circuit 1)" UBYTE _CNV_A_R_LINEAR_____205_CM 1 100. -48. 0. DISPLAY_IDENTIFIER IGA_AD1_KNK_4 ECU_ADDRESS 0x3fd4a6 FORMAT "%5.1" /end MEASUREMENT
/begin MEASUREMENT iga_ad1_knk[5] "Actual Adaptation value for Cyl. x (Adaptation circuit 1)" UBYTE _CNV_A_R_LINEAR_____205_CM 1 100. -48. 0. DISPLAY_IDENTIFIER IGA_AD1_KNK_5 ECU_ADDRESS 0x3fd4a8 FORMAT "%5.1" /end MEASUREMENT
/begin MEASUREMENT iga_ad2_knk "Adaptation spark retard due to Adaptation circuit 2" UBYTE _CNV_A_R_LINEAR_____205_CM 1 100. -48. 0. DISPLAY_IDENTIFIER IGA_AD2_KNK ECU_ADDRESS 0x3fe31e FORMAT "%4.1" /end MEASUREMENT
/begin MEASUREMENT iga_knk[0] "Spark retard through knock control without Adaptation(cylinder individual)" UBYTE _CNV_A_R_LINEAR_____205_CM 1 100. -48. 0. DISPLAY_IDENTIFIER IGA_KNK_0 ECU_ADDRESS 0x3fd492 FORMAT "%7.3" /end MEASUREMENT
/begin MEASUREMENT iga_knk[1] "Spark retard through knock control without Adaptation(cylinder individual)" UBYTE _CNV_A_R_LINEAR_____205_CM 1 100. -48. 0. DISPLAY_IDENTIFIER IGA_KNK_1 ECU_ADDRESS 0x3fd494 FORMAT "%7.3" /end MEASUREMENT
/begin MEASUREMENT iga_knk[2] "Spark retard through knock control without Adaptation(cylinder individual)" UBYTE _CNV_A_R_LINEAR_____205_CM 1 100. -48. 0. DISPLAY_IDENTIFIER IGA_KNK_2 ECU_ADDRESS 0x3fd496 FORMAT "%7.3" /end MEASUREMENT
/begin MEASUREMENT iga_knk[3] "Spark retard through knock control without Adaptation(cylinder individual)" UBYTE _CNV_A_R_LINEAR_____205_CM 1 100. -48. 0. DISPLAY_IDENTIFIER IGA_KNK_3 ECU_ADDRESS 0x3fd498 FORMAT "%7.3" /end MEASUREMENT
/begin MEASUREMENT iga_knk[4] "Spark retard through knock control without Adaptation(cylinder individual)" UBYTE _CNV_A_R_LINEAR_____205_CM 1 100. -48. 0. DISPLAY_IDENTIFIER IGA_KNK_4 ECU_ADDRESS 0x3fd49a FORMAT "%7.3" /end MEASUREMENT
/begin MEASUREMENT iga_knk[5] "Spark retard through knock control without Adaptation(cylinder individual)" UBYTE _CNV_A_R_LINEAR_____205_CM 1 100. -48. 0. DISPLAY_IDENTIFIER IGA_KNK_5 ECU_ADDRESS 0x3fd49c FORMAT "%7.3" /end MEASUREMENT
/begin MEASUREMENT knk_thd[0] "Knock Threshold cylinder x" UBYTE _CNV_A_R_LINEAR_____44_CM 1 100. 0. 4.998 DISPLAY_IDENTIFIER KNK_THD_0 ECU_ADDRESS 0x3fe320 FORMAT "%6.4" /end MEASUREMENT
/begin MEASUREMENT knk_thd[1] "Knock Threshold cylinder x" UBYTE _CNV_A_R_LINEAR_____44_CM 1 100. 0. 4.998 DISPLAY_IDENTIFIER KNK_THD_1 ECU_ADDRESS 0x3fe321 FORMAT "%6.4" /end MEASUREMENT
/begin MEASUREMENT knk_thd[2] "Knock Threshold cylinder x" UBYTE _CNV_A_R_LINEAR_____44_CM 1 100. 0. 4.998 DISPLAY_IDENTIFIER KNK_THD_2 ECU_ADDRESS 0x3fe322 FORMAT "%6.4" /end MEASUREMENT
/begin MEASUREMENT knk_thd[3] "Knock Threshold cylinder x" UBYTE _CNV_A_R_LINEAR_____44_CM 1 100. 0. 4.998 DISPLAY_IDENTIFIER KNK_THD_3 ECU_ADDRESS 0x3fe323 FORMAT "%6.4" /end MEASUREMENT
/begin MEASUREMENT knk_thd[4] "Knock Threshold cylinder x" UBYTE _CNV_A_R_LINEAR_____44_CM 1 100. 0. 4.998 DISPLAY_IDENTIFIER KNK_THD_4 ECU_ADDRESS 0x3fe324 FORMAT "%6.4" /end MEASUREMENT
/begin MEASUREMENT knk_thd[5] "Knock Threshold cylinder x" UBYTE _CNV_A_R_LINEAR_____44_CM 1 100. 0. 4.998 DISPLAY_IDENTIFIER KNK_THD_5 ECU_ADDRESS 0x3fe325 FORMAT "%6.4" /end MEASUREMENT
/begin MEASUREMENT knks_cmd_fil[0] "Knock Filter Frequency and Reference Filter Frequency Cyl.x" UBYTE _CNV_A_R_LINEAR_____1_CM 1 100. 0. 63. DISPLAY_IDENTIFIER KNKS_CMD_FIL_0 ECU_ADDRESS 0x3fe306 FORMAT "%2.0" /end MEASUREMENT
/begin MEASUREMENT knks_cmd_fil[1] "Knock Filter Frequency and Reference Filter Frequency Cyl.x" UBYTE _CNV_A_R_LINEAR_____1_CM 1 100. 0. 63. DISPLAY_IDENTIFIER KNKS_CMD_FIL_1 ECU_ADDRESS 0x3fe307 FORMAT "%2.0" /end MEASUREMENT
/begin MEASUREMENT knks_cmd_fil[2] "Knock Filter Frequency and Reference Filter Frequency Cyl.x" UBYTE _CNV_A_R_LINEAR_____1_CM 1 100. 0. 63. DISPLAY_IDENTIFIER KNKS_CMD_FIL_2 ECU_ADDRESS 0x3fe308 FORMAT "%2.0" /end MEASUREMENT
/begin MEASUREMENT knks_cmd_fil[3] "Knock Filter Frequency and Reference Filter Frequency Cyl.x" UBYTE _CNV_A_R_LINEAR_____1_CM 1 100. 0. 63. DISPLAY_IDENTIFIER KNKS_CMD_FIL_3 ECU_ADDRESS 0x3fe309 FORMAT "%2.0" /end MEASUREMENT
/begin MEASUREMENT knks_cmd_fil[4] "Knock Filter Frequency and Reference Filter Frequency Cyl.x" UBYTE _CNV_A_R_LINEAR_____1_CM 1 100. 0. 63. DISPLAY_IDENTIFIER KNKS_CMD_FIL_4 ECU_ADDRESS 0x3fe30a FORMAT "%2.0" /end MEASUREMENT
/begin MEASUREMENT knks_cmd_fil[5] "Knock Filter Frequency and Reference Filter Frequency Cyl.x" UBYTE _CNV_A_R_LINEAR_____1_CM 1 100. 0. 63. DISPLAY_IDENTIFIER KNKS_CMD_FIL_5 ECU_ADDRESS 0x3fe30b FORMAT "%2.0" /end MEASUREMENT
/begin MEASUREMENT knkwb[0] "Beginning of Measurement Window Cyl.x" UWORD _CNV_A_R_LINEAR_____82_CM 1 100. 0. 108. DISPLAY_IDENTIFIER KNKWB_0 ECU_ADDRESS 0x3fd47a BYTE_ORDER MSB_LAST FORMAT "%5.1" /end MEASUREMENT
/begin MEASUREMENT knkwb[1] "Beginning of Measurement Window Cyl.x" UWORD _CNV_A_R_LINEAR_____82_CM 1 100. 0. 108. DISPLAY_IDENTIFIER KNKWB_1 ECU_ADDRESS 0x3fd47c BYTE_ORDER MSB_LAST FORMAT "%5.1" /end MEASUREMENT
/begin MEASUREMENT knkwb[2] "Beginning of Measurement Window Cyl.x" UWORD _CNV_A_R_LINEAR_____82_CM 1 100. 0. 108. DISPLAY_IDENTIFIER KNKWB_2 ECU_ADDRESS 0x3fd47e BYTE_ORDER MSB_LAST FORMAT "%5.1" /end MEASUREMENT
/begin MEASUREMENT knkwb[3] "Beginning of Measurement Window Cyl.x" UWORD _CNV_A_R_LINEAR_____82_CM 1 100. 0. 108. DISPLAY_IDENTIFIER KNKWB_3 ECU_ADDRESS 0x3fd480 BYTE_ORDER MSB_LAST FORMAT "%5.1" /end MEASUREMENT
/begin MEASUREMENT knkwb[4] "Beginning of Measurement Window Cyl.x" UWORD _CNV_A_R_LINEAR_____82_CM 1 100. 0. 108. DISPLAY_IDENTIFIER KNKWB_4 ECU_ADDRESS 0x3fd482 BYTE_ORDER MSB_LAST FORMAT "%5.1" /end MEASUREMENT
/begin MEASUREMENT knkwb[5] "Beginning of Measurement Window Cyl.x" UWORD _CNV_A_R_LINEAR_____82_CM 1 100. 0. 108. DISPLAY_IDENTIFIER KNKWB_5 ECU_ADDRESS 0x3fd484 BYTE_ORDER MSB_LAST FORMAT "%5.1" /end MEASUREMENT
/begin MEASUREMENT knkwe[0] "End of Measurement Window Cyl.x" UWORD _CNV_A_R_LINEAR_____82_CM 1 100. 0.375 114. DISPLAY_IDENTIFIER KNKWE_0 ECU_ADDRESS 0x3fd486 BYTE_ORDER MSB_LAST FORMAT "%5.1" /end MEASUREMENT
/begin MEASUREMENT knkwe[1] "End of Measurement Window Cyl.x" UWORD _CNV_A_R_LINEAR_____82_CM 1 100. 0.375 114. DISPLAY_IDENTIFIER KNKWE_1 ECU_ADDRESS 0x3fd488 BYTE_ORDER MSB_LAST FORMAT "%5.1" /end MEASUREMENT
/begin MEASUREMENT knkwe[2] "End of Measurement Window Cyl.x" UWORD _CNV_A_R_LINEAR_____82_CM 1 100. 0.375 114. DISPLAY_IDENTIFIER KNKWE_2 ECU_ADDRESS 0x3fd48a BYTE_ORDER MSB_LAST FORMAT "%5.1" /end MEASUREMENT
/begin MEASUREMENT knkwe[3] "End of Measurement Window Cyl.x" UWORD _CNV_A_R_LINEAR_____82_CM 1 100. 0.375 114. DISPLAY_IDENTIFIER KNKWE_3 ECU_ADDRESS 0x3fd48c BYTE_ORDER MSB_LAST FORMAT "%5.1" /end MEASUREMENT
/begin MEASUREMENT knkwe[4] "End of Measurement Window Cyl.x" UWORD _CNV_A_R_LINEAR_____82_CM 1 100. 0.375 114. DISPLAY_IDENTIFIER KNKWE_4 ECU_ADDRESS 0x3fd48e BYTE_ORDER MSB_LAST FORMAT "%5.1" /end MEASUREMENT
/begin MEASUREMENT knkwe[5] "End of Measurement Window Cyl.x" UWORD _CNV_A_R_LINEAR_____82_CM 1 100. 0.375 114. DISPLAY_IDENTIFIER KNKWE_5 ECU_ADDRESS 0x3fd490 BYTE_ORDER MSB_LAST FORMAT "%5.1" /end MEASUREMENT
/begin MEASUREMENT lv_knk_ad1_ena "Knock Adaptation circuit 1 enabled" UBYTE _CNV_S_2_RANGE______5_CM 1 100. 0. 1. DISPLAY_IDENTIFIER LV_KNK_AD1_ENA ECU_ADDRESS 0x3fe327 BIT_MASK 0x1 /end MEASUREMENT
/begin MEASUREMENT lv_knk_ad2_ena "Knock Adaptation circuit 2 enabled" UBYTE _CNV_S_2_RANGE______5_CM 1 100. 0. 1. DISPLAY_IDENTIFIER LV_KNK_AD2_ENA ECU_ADDRESS 0x3fe33b BIT_MASK 0x1 /end MEASUREMENT
/begin MEASUREMENT lv_knk_ctl_ena "Boolean for knock control enabled" UBYTE _CNV_S_2_RANGE______5_CM 1 100. 0. 1. DISPLAY_IDENTIFIER LV_KNK_CTL_ENA ECU_ADDRESS 0x3fe326 BIT_MASK 0x1 /end MEASUREMENT
/begin MEASUREMENT lv_knk_tra_maf "Logical variable for Load Dynamic Function active or passive" UBYTE _CNV_S_2_RANGE______5_CM 1 100. 0. 1. DISPLAY_IDENTIFIER LV_KNK_TRA_MAF ECU_ADDRESS 0x3fe33a BIT_MASK 0x1 /end MEASUREMENT
/begin MEASUREMENT maf_knk "Mass air flow with hysteresis" UBYTE _CNV_A_R_LINEAR_____27_CM 1 100. 0. 1389. DISPLAY_IDENTIFIER MAF_KNK ECU_ADDRESS 0x3fe2fe FORMAT "%7.2" /end MEASUREMENT
/begin MEASUREMENT n_knk "Engine speed with hysteresis" UBYTE _CNV_A_R_LINEAR_____16_CM 1 100. 0. 8160. DISPLAY_IDENTIFIER N_KNK ECU_ADDRESS 0x3fe329 FORMAT "%4.0" /end MEASUREMENT
/begin MEASUREMENT nl[0] "Floating mean value of the noise signal" UWORD _CNV_A_R_LINEAR_____250_CM 1 100. 0. 4.99992371 DISPLAY_IDENTIFIER NL_0 ECU_ADDRESS 0x3fd46e BYTE_ORDER MSB_LAST FORMAT "%7.5" /end MEASUREMENT
/begin MEASUREMENT nl[1] "Floating mean value of the noise signal" UWORD _CNV_A_R_LINEAR_____250_CM 1 100. 0. 4.99992371 DISPLAY_IDENTIFIER NL_1 ECU_ADDRESS 0x3fd470 BYTE_ORDER MSB_LAST FORMAT "%7.5" /end MEASUREMENT
/begin MEASUREMENT nl[2] "Floating mean value of the noise signal" UWORD _CNV_A_R_LINEAR_____250_CM 1 100. 0. 4.99992371 DISPLAY_IDENTIFIER NL_2 ECU_ADDRESS 0x3fd472 BYTE_ORDER MSB_LAST FORMAT "%7.5" /end MEASUREMENT
/begin MEASUREMENT nl[3] "Floating mean value of the noise signal" UWORD _CNV_A_R_LINEAR_____250_CM 1 100. 0. 4.99992371 DISPLAY_IDENTIFIER NL_3 ECU_ADDRESS 0x3fd474 BYTE_ORDER MSB_LAST FORMAT "%7.5" /end MEASUREMENT
/begin MEASUREMENT nl[4] "Floating mean value of the noise signal" UWORD _CNV_A_R_LINEAR_____250_CM 1 100. 0. 4.99992371 DISPLAY_IDENTIFIER NL_4 ECU_ADDRESS 0x3fd476 BYTE_ORDER MSB_LAST FORMAT "%7.5" /end MEASUREMENT
/begin MEASUREMENT nl[5] "Floating mean value of the noise signal" UWORD _CNV_A_R_LINEAR_____250_CM 1 100. 0. 4.99992371 DISPLAY_IDENTIFIER NL_5 ECU_ADDRESS 0x3fd478 BYTE_ORDER MSB_LAST FORMAT "%7.5" /end MEASUREMENT
/begin CHARACTERISTIC c_cycnr_ad2_inc_knk "Cycle counter for adjustment into advance direction" VALUE 0x0151e _REC_VAL_20_u2 65535. _CNV_A_R_LINEAR_____248_CM 0. 65535. DISPLAY_IDENTIFIER C_CYCNR_AD2_INC_KNK FORMAT "%5.0" /end CHARACTERISTIC
/begin CHARACTERISTIC c_fac_tra_knk "correction factor for load dynamic active" VALUE 0x006e1 _REC_VAL_20_u1 6.96875 _CNV_A_R_LINEAR_____235_CM 1. 7.96875 DISPLAY_IDENTIFIER C_FAC_TRA_KNK FORMAT "%5.3" /end CHARACTERISTIC
/begin CHARACTERISTIC c_iga_ad1_fac_dec_knk "Factor to control the speed of knock Adaptation circuit 1 in retard direction" VALUE 0x006f4 _REC_VAL_20_u1 0.9960940000000002 _CNV_A_R_LINEAR_____50_CM 0. 0.996094 DISPLAY_IDENTIFIER C_IGA_AD1_FAC_DEC_KNK FORMAT "%5.3" /end CHARACTERISTIC
/begin CHARACTERISTIC c_iga_ad1_fac_fast_knk "factor for fast knock Adaptation" VALUE 0x006f5 _REC_VAL_20_u1 3.984375 _CNV_A_R_LINEAR_____251_CM 0. 3.984375 DISPLAY_IDENTIFIER C_IGA_AD1_FAC_FAST_KNK FORMAT "%5.3" /end CHARACTERISTIC
/begin CHARACTERISTIC c_iga_ad1_fac_inc_knk "Factor to control the speed of knock Adaptation circuit 1 in advance direction" VALUE 0x006f6 _REC_VAL_20_u1 0.9960940000000002 _CNV_A_R_LINEAR_____50_CM 0. 0.996094 DISPLAY_IDENTIFIER C_IGA_AD1_FAC_INC_KNK FORMAT "%5.3" /end CHARACTERISTIC
/begin CHARACTERISTIC c_iga_ad1_inc_knk "Increment of adapted retardation values during post operating phase" VALUE 0x006f7 _REC_VAL_20_u1 48. _CNV_A_R_LINEAR_____82_CM 0. 48. DISPLAY_IDENTIFIER C_IGA_AD1_INC_KNK FORMAT "%4.1" /end CHARACTERISTIC
/begin CHARACTERISTIC c_iga_ad1_lgrd_neg_knk "Change limitation in retard direction for Adaptation circuit 1 while crossing from one operating point to another" VALUE 0x006f8 _REC_VAL_20_u1 11.90625 _CNV_A_R_LINEAR_____252_CM 9.375e-002 12. DISPLAY_IDENTIFIER C_IGA_AD1_LGRD_NEG_KNK /end CHARACTERISTIC
/begin CHARACTERISTIC c_iga_ad1_lgrd_pos_knk "Change limitation in advance direction for Adaptation circuit 1 while crossing from one operating point to another" VALUE 0x006f9 _REC_VAL_20_u1 11.90625 _CNV_A_R_LINEAR_____252_CM 9.375e-002 12. DISPLAY_IDENTIFIER C_IGA_AD1_LGRD_POS_KNK /end CHARACTERISTIC
/begin CHARACTERISTIC c_iga_ad1_thd_dec_knk "" VALUE 0x00383 _REC_VAL_20_s1 24. _CNV_A_R_LINEAR_____82_CM -12. 12. DISPLAY_IDENTIFIER C_IGA_AD1_THD_DEC_KNK FORMAT "%3.1" /end CHARACTERISTIC
/begin CHARACTERISTIC c_iga_ad1_thd_fast_knk "" VALUE 0x006fa _REC_VAL_20_u1 23.625 _CNV_A_R_LINEAR_____82_CM 0.375 24. DISPLAY_IDENTIFIER C_IGA_AD1_THD_FAST_KNK FORMAT "%3.1" /end CHARACTERISTIC
/begin CHARACTERISTIC c_iga_ad2_max_knk "maximum threshold of IGA_AD2_KNK in retard direction" VALUE 0x006fc _REC_VAL_20_u1 48. _CNV_A_R_LINEAR_____205_CM -48. 0. DISPLAY_IDENTIFIER C_IGA_AD2_MAX_KNK FORMAT "%4.1" /end CHARACTERISTIC
/begin CHARACTERISTIC c_iga_ad2_thd_dec_knk "Threshold for adjustment of adaptive ignition angle into retard direction" VALUE 0x006fd _REC_VAL_20_u1 48. _CNV_A_R_LINEAR_____205_CM -48. 0. DISPLAY_IDENTIFIER C_IGA_AD2_THD_DEC_KNK FORMAT "%4.1" /end CHARACTERISTIC
/begin CHARACTERISTIC c_iga_ad2_thd_inc_knk "Threshold for adjustment of adaptive ignition angle into advance direction" VALUE 0x006fe _REC_VAL_20_u1 48. _CNV_A_R_LINEAR_____205_CM -48. 0. DISPLAY_IDENTIFIER C_IGA_AD2_THD_INC_KNK FORMAT "%4.1" /end CHARACTERISTIC
/begin CHARACTERISTIC c_iga_dif_min_max_knk "Control excursion limit valid for spark advance and spark retard " VALUE 0x00705 _REC_VAL_20_u1 48. _CNV_A_R_LINEAR_____82_CM 0. 48. DISPLAY_IDENTIFIER C_IGA_DIF_MIN_MAX_KNK FORMAT "%4.1" /end CHARACTERISTIC
/begin CHARACTERISTIC c_iga_lgrd_3 "gradient limitation when  underspending knock load threshold" VALUE 0x015d4 _REC_VAL_20_u2 47.625 _CNV_A_R_LINEAR_____253_CM 0.375 48. DISPLAY_IDENTIFIER C_IGA_LGRD_3 /end CHARACTERISTIC
/begin CHARACTERISTIC c_maf_iga_hys_knk "Air-Mass Hysteresis for Knock Control" VALUE 0x00723 _REC_VAL_20_u1 1389. _CNV_A_R_LINEAR_____27_CM 0. 1389. DISPLAY_IDENTIFIER C_MAF_IGA_HYS_KNK FORMAT "%4.0" /end CHARACTERISTIC
/begin CHARACTERISTIC c_n_iga_hys_knk "Speed Hysteresis for Knock Control" VALUE 0x0076c _REC_VAL_20_u1 8160. _CNV_A_R_LINEAR_____16_CM 0. 8160. DISPLAY_IDENTIFIER C_N_IGA_HYS_KNK FORMAT "%4.0" /end CHARACTERISTIC
/begin CHARACTERISTIC c_nl_crlc "Averaging Constant for Noise Value Calculation" VALUE 0x00792 _REC_VAL_20_u1 0.9960940000000002 _CNV_A_R_LINEAR_____50_CM 0. 0.996094 DISPLAY_IDENTIFIER C_NL_CRLC FORMAT "%5.3" /end CHARACTERISTIC
/begin CHARACTERISTIC c_nl_crlc_tra "Averaging Constant for Noise Value Calculation for Transient Case" VALUE 0x00793 _REC_VAL_20_u1 0.9960940000000002 _CNV_A_R_LINEAR_____50_CM 0. 0.996094 DISPLAY_IDENTIFIER C_NL_CRLC_TRA FORMAT "%5.3" /end CHARACTERISTIC
/begin CHARACTERISTIC c_swi_ad_knk "calculation of Adaptation circuit 1 and 2 enabled" VALUE 0x007d3 _REC_VAL_20_u1 1. _CNV_A_R_LINEAR_____1_CM 0. 1. DISPLAY_IDENTIFIER C_SWI_AD_KNK FORMAT "%2.0" /end CHARACTERISTIC
/begin MEASUREMENT lv_knk_tra_n "Logical variable for Engine Speed Dynamic Function active or passive" UBYTE _CNV_S_2_RANGE______5_CM 1 100. 0. 1. DISPLAY_IDENTIFIER LV_KNK_TRA_N ECU_ADDRESS 0x3fe339 BIT_MASK 0x1 /end MEASUREMENT
/begin MEASUREMENT iga_adj_knk[0] "Total spark retard through knock control with Adaptation (cylinder individual)" UBYTE _CNV_A_R_LINEAR_____205_CM 1 100. -48. 0. DISPLAY_IDENTIFIER IGA_ADJ_KNK_0_ ECU_ADDRESS 0x3fe318 FORMAT "%5.1" /end MEASUREMENT
/begin MEASUREMENT iga_adj_knk[1] "Total spark retard through knock control with Adaptation (cylinder individual)" UBYTE _CNV_A_R_LINEAR_____205_CM 1 100. -48. 0. DISPLAY_IDENTIFIER IGA_ADJ_KNK_1_ ECU_ADDRESS 0x3fe319 FORMAT "%5.1" /end MEASUREMENT
/begin MEASUREMENT iga_adj_knk[2] "Total spark retard through knock control with Adaptation (cylinder individual)" UBYTE _CNV_A_R_LINEAR_____205_CM 1 100. -48. 0. DISPLAY_IDENTIFIER IGA_ADJ_KNK_2_ ECU_ADDRESS 0x3fe31a FORMAT "%5.1" /end MEASUREMENT
/begin MEASUREMENT iga_adj_knk[3] "Total spark retard through knock control with Adaptation (cylinder individual)" UBYTE _CNV_A_R_LINEAR_____205_CM 1 100. -48. 0. DISPLAY_IDENTIFIER IGA_ADJ_KNK_3_ ECU_ADDRESS 0x3fe31b FORMAT "%5.1" /end MEASUREMENT
/begin MEASUREMENT iga_adj_knk[4] "Total spark retard through knock control with Adaptation (cylinder individual)" UBYTE _CNV_A_R_LINEAR_____205_CM 1 100. -48. 0. DISPLAY_IDENTIFIER IGA_ADJ_KNK_4_ ECU_ADDRESS 0x3fe31c FORMAT "%5.1" /end MEASUREMENT
/begin MEASUREMENT iga_adj_knk[5] "Total spark retard through knock control with Adaptation (cylinder individual)" UBYTE _CNV_A_R_LINEAR_____205_CM 1 100. -48. 0. DISPLAY_IDENTIFIER IGA_ADJ_KNK_5_ ECU_ADDRESS 0x3fe31d FORMAT "%5.1" /end MEASUREMENT
/begin MEASUREMENT iga_adj_max_knk "Total spark retard through knock control with Adaptation (cylinder individual)" UBYTE _CNV_A_R_LINEAR_____203_CM 1 100. -35.625 60. DISPLAY_IDENTIFIER IGA_ADJ_MAX_KNK ECU_ADDRESS 0x3fe32a FORMAT "%5.1" /end MEASUREMENT
/begin MEASUREMENT dly_iga_adj_knk_diag "inhibition time for knock Adaptation" UBYTE _CNV_A_R_LINEAR_____24_CM 1 100. 0. 25.5 DISPLAY_IDENTIFIER DLY_IGA_ADJ_KNK_DIAG ECU_ADDRESS 0x3fe32c FORMAT "%4.1" /end MEASUREMENT
/begin MEASUREMENT iga_mv_adj_knk "meanvalue of actual retard adjustment with Adaptation values" UBYTE _CNV_A_R_LINEAR_____205_CM 1 100. -48. 0. DISPLAY_IDENTIFIER IGA_MV_ADJ_KNK ECU_ADDRESS 0x3fe31f FORMAT "%4.1" /end MEASUREMENT
/begin MEASUREMENT cyl_id_knk "cylinder number for knock control" UBYTE _CNV_A_R_LINEAR_____1_CM 1 100. 0. 255. DISPLAY_IDENTIFIER CYL_ID_KNK ECU_ADDRESS 0x3fe2ff FORMAT "%3.0" /end MEASUREMENT
/begin MEASUREMENT lv_knk "Logical variable for recognition of knock" UBYTE _CNV_S_2_RANGE______5_CM 1 100. 0. 1. DISPLAY_IDENTIFIER LV_KNK ECU_ADDRESS 0x3fe328 BIT_MASK 0x1 /end MEASUREMENT
/begin MEASUREMENT iga_mv_knk "meanvalue of actual retard adjustment without Adaptation values" UBYTE _CNV_A_R_LINEAR_____205_CM 1 100. -48. 0. DISPLAY_IDENTIFIER IGA_MV_KNK ECU_ADDRESS 0x3fe32d FORMAT "%4.1" /end MEASUREMENT
/begin MEASUREMENT fac_iga_max_knk "Weighting factor for the max. spark retard against coolant" UBYTE _CNV_A_R_LINEAR_____50_CM 1 100. 0. 0.996094 DISPLAY_IDENTIFIER FAC_IGA_MAX_KNK ECU_ADDRESS 0x3fe32b FORMAT "%5.3" /end MEASUREMENT
/begin MEASUREMENT knks_cmd_gain[0] "Amplification precontrol Cyl.x" UBYTE _CNV_A_R_LINEAR_____1_CM 1 100. 0. 63. DISPLAY_IDENTIFIER KNKS_CMD_GAIN_0 ECU_ADDRESS 0x3fe312 FORMAT "%2.0" /end MEASUREMENT
/begin MEASUREMENT knks_cmd_gain[1] "Amplification precontrol Cyl.x" UBYTE _CNV_A_R_LINEAR_____1_CM 1 100. 0. 63. DISPLAY_IDENTIFIER KNKS_CMD_GAIN_1 ECU_ADDRESS 0x3fe313 FORMAT "%2.0" /end MEASUREMENT
/begin MEASUREMENT knks_cmd_gain[2] "Amplification precontrol Cyl.x" UBYTE _CNV_A_R_LINEAR_____1_CM 1 100. 0. 63. DISPLAY_IDENTIFIER KNKS_CMD_GAIN_2 ECU_ADDRESS 0x3fe314 FORMAT "%2.0" /end MEASUREMENT
/begin MEASUREMENT knks_cmd_gain[3] "Amplification precontrol Cyl.x" UBYTE _CNV_A_R_LINEAR_____1_CM 1 100. 0. 63. DISPLAY_IDENTIFIER KNKS_CMD_GAIN_3 ECU_ADDRESS 0x3fe315 FORMAT "%2.0" /end MEASUREMENT
/begin MEASUREMENT knks_cmd_gain[4] "Amplification precontrol Cyl.x" UBYTE _CNV_A_R_LINEAR_____1_CM 1 100. 0. 63. DISPLAY_IDENTIFIER KNKS_CMD_GAIN_4 ECU_ADDRESS 0x3fe316 FORMAT "%2.0" /end MEASUREMENT
/begin MEASUREMENT knks_cmd_gain[5] "Amplification precontrol Cyl.x" UBYTE _CNV_A_R_LINEAR_____1_CM 1 100. 0. 63. DISPLAY_IDENTIFIER KNKS_CMD_GAIN_5 ECU_ADDRESS 0x3fe317 FORMAT "%2.0" /end MEASUREMENT
/begin MEASUREMENT knks_cmd_int[0] "Integration time constant Cyl.x" UBYTE _CNV_A_R_LINEAR_____1_CM 1 100. 0. 31. DISPLAY_IDENTIFIER KNKS_CMD_INT_0 ECU_ADDRESS 0x3fe30c FORMAT "%2.0" /end MEASUREMENT
/begin MEASUREMENT knks_cmd_int[1] "Integration time constant Cyl.x" UBYTE _CNV_A_R_LINEAR_____1_CM 1 100. 0. 31. DISPLAY_IDENTIFIER KNKS_CMD_INT_1 ECU_ADDRESS 0x3fe30d FORMAT "%2.0" /end MEASUREMENT
/begin MEASUREMENT knks_cmd_int[2] "Integration time constant Cyl.x" UBYTE _CNV_A_R_LINEAR_____1_CM 1 100. 0. 31. DISPLAY_IDENTIFIER KNKS_CMD_INT_2 ECU_ADDRESS 0x3fe30e FORMAT "%2.0" /end MEASUREMENT
/begin MEASUREMENT knks_cmd_int[3] "Integration time constant Cyl.x" UBYTE _CNV_A_R_LINEAR_____1_CM 1 100. 0. 31. DISPLAY_IDENTIFIER KNKS_CMD_INT_3 ECU_ADDRESS 0x3fe30f FORMAT "%2.0" /end MEASUREMENT
/begin MEASUREMENT knks_cmd_int[4] "Integration time constant Cyl.x" UBYTE _CNV_A_R_LINEAR_____1_CM 1 100. 0. 31. DISPLAY_IDENTIFIER KNKS_CMD_INT_4 ECU_ADDRESS 0x3fe310 FORMAT "%2.0" /end MEASUREMENT
/begin MEASUREMENT knks_cmd_int[5] "Integration time constant Cyl.x" UBYTE _CNV_A_R_LINEAR_____1_CM 1 100. 0. 31. DISPLAY_IDENTIFIER KNKS_CMD_INT_5 ECU_ADDRESS 0x3fe311 FORMAT "%2.0" /end MEASUREMENT
/begin CHARACTERISTIC ip_fac_ad_knk_tco__tco "Weighting factor Adaptation circuit 1 an 2 via coolant temperature" CURVE 0x00a98 _REC_CUR_20_u1_u1 0.9960940000000002 _CNV_A_R_LINEAR_____50_CM 0. 0.996094 DISPLAY_IDENTIFIER IP_FAC_AD_KNK_TCO__TCO FORMAT "%5.3"
 /begin AXIS_DESCR COM_AXIS tco _CNV_A_R_LINEAR_____12_CM 2 -48. 142.5 FORMAT "%6.2" AXIS_PTS_REF ldp_tco__fac_ad_knk_tco /end AXIS_DESCR
/end CHARACTERISTIC
/begin MEASUREMENT iga_ad1_ad2_knk[0] "Adaptation value for Cyl. x (Adaptation circuit 1 and 2)" UBYTE _CNV_A_R_LINEAR_____205_CM 1 100. -48. 0. DISPLAY_IDENTIFIER IGA_AD1_AD2_KNK_0_ ECU_ADDRESS 0x3fd4aa FORMAT "%5.1" /end MEASUREMENT
/begin MEASUREMENT iga_ad1_ad2_knk[1] "Adaptation value for Cyl. x (Adaptation circuit 1 and 2)" UBYTE _CNV_A_R_LINEAR_____205_CM 1 100. -48. 0. DISPLAY_IDENTIFIER IGA_AD1_AD2_KNK_1_ ECU_ADDRESS 0x3fd4ac FORMAT "%5.1" /end MEASUREMENT
/begin MEASUREMENT iga_ad1_ad2_knk[2] "Adaptation value for Cyl. x (Adaptation circuit 1 and 2)" UBYTE _CNV_A_R_LINEAR_____205_CM 1 100. -48. 0. DISPLAY_IDENTIFIER IGA_AD1_AD2_KNK_2_ ECU_ADDRESS 0x3fd4ae FORMAT "%5.1" /end MEASUREMENT
/begin MEASUREMENT iga_ad1_ad2_knk[3] "Adaptation value for Cyl. x (Adaptation circuit 1 and 2)" UBYTE _CNV_A_R_LINEAR_____205_CM 1 100. -48. 0. DISPLAY_IDENTIFIER IGA_AD1_AD2_KNK_3_ ECU_ADDRESS 0x3fd4b0 FORMAT "%5.1" /end MEASUREMENT
/begin MEASUREMENT iga_ad1_ad2_knk[4] "Adaptation value for Cyl. x (Adaptation circuit 1 and 2)" UBYTE _CNV_A_R_LINEAR_____205_CM 1 100. -48. 0. DISPLAY_IDENTIFIER IGA_AD1_AD2_KNK_4_ ECU_ADDRESS 0x3fd4b2 FORMAT "%5.1" /end MEASUREMENT
/begin MEASUREMENT iga_ad1_ad2_knk[5] "Adaptation value for Cyl. x (Adaptation circuit 1 and 2)" UBYTE _CNV_A_R_LINEAR_____205_CM 1 100. -48. 0. DISPLAY_IDENTIFIER IGA_AD1_AD2_KNK_5_ ECU_ADDRESS 0x3fd4b4 FORMAT "%5.1" /end MEASUREMENT
/begin CHARACTERISTIC id_cycnr_fac_tra_knk__n "Cycle counter during which the Load Dynamic Function stays active after triggering" CURVE 0x00992 _REC_CUR_20_u1_u1 255. _CNV_A_R_LINEAR_____1_CM 0. 255. DISPLAY_IDENTIFIER ID_CYCNR_FAC_TRA_KNK FORMAT "%3.0"
 /begin AXIS_DESCR COM_AXIS n_knk _CNV_A_R_LINEAR_____16_CM 4 0. 8160. FORMAT "%4.0" AXIS_PTS_REF ldpm_n_6_4 /end AXIS_DESCR
/end CHARACTERISTIC
/begin CHARACTERISTIC ip_knkwb_1__n__maf "Beginning of Measurement Window Cyl.2" MAP 0x0b856 _REC_MAP_20_u2_u1_u1 108. _CNV_A_R_LINEAR_____82_CM 0. 108. DISPLAY_IDENTIFIER IP_KNKWB_1__N__MAF FORMAT "%5.1"
 /begin AXIS_DESCR COM_AXIS n_knk _CNV_A_R_LINEAR_____16_CM 10 0. 8160. FORMAT "%4.0" AXIS_PTS_REF ldpm_n_knkwb /end AXIS_DESCR
 /begin AXIS_DESCR COM_AXIS maf_knk _CNV_A_R_LINEAR_____27_CM 4 0. 1389. FORMAT "%4.0" AXIS_PTS_REF ldpm_maf_knkwb /end AXIS_DESCR
/end CHARACTERISTIC
/begin CHARACTERISTIC ip_gain_knk_1__n__maf "Amplification precontrol Cyl.2" MAP 0x0572c _REC_MAP_20_u1_u1_u1 63. _CNV_A_R_LINEAR_____1_CM 0. 63. DISPLAY_IDENTIFIER IP_GAIN_KNK_1__N__MAF FORMAT "%2.0"
 /begin AXIS_DESCR COM_AXIS n_knk _CNV_A_R_LINEAR_____16_CM 16 0. 8160. FORMAT "%4.0" AXIS_PTS_REF ldpm_n_2_9 /end AXIS_DESCR
 /begin AXIS_DESCR COM_AXIS maf_knk _CNV_A_R_LINEAR_____27_CM 4 0. 1389. FORMAT "%4.0" AXIS_PTS_REF ldpm_maf_1_9 /end AXIS_DESCR
/end CHARACTERISTIC
/begin CHARACTERISTIC ip_fac_thd_knk_0__n__maf "Knock Factor Table Cyl. 1" MAP 0x0534c _REC_MAP_20_u1_u1_u1 7.96875 _CNV_A_R_LINEAR_____235_CM 0. 7.96875 DISPLAY_IDENTIFIER IP_FAC_THD_KNK_0__N__MAF FORMAT "%4.2"
 /begin AXIS_DESCR COM_AXIS n_knk _CNV_A_R_LINEAR_____16_CM 16 0. 8160. FORMAT "%4.0" AXIS_PTS_REF ldpm_n_2_9 /end AXIS_DESCR
 /begin AXIS_DESCR COM_AXIS maf_knk _CNV_A_R_LINEAR_____27_CM 4 0. 1389. FORMAT "%4.0" AXIS_PTS_REF ldpm_maf_1_9 /end AXIS_DESCR
/end CHARACTERISTIC
/begin CHARACTERISTIC ip_fac_thd_knk_1__n__maf "Knock Factor Table Cyl. 2" MAP 0x0538c _REC_MAP_20_u1_u1_u1 7.96875 _CNV_A_R_LINEAR_____235_CM 0. 7.96875 DISPLAY_IDENTIFIER IP_FAC_THD_KNK_1__N__MAF FORMAT "%4.2"
 /begin AXIS_DESCR COM_AXIS n_knk _CNV_A_R_LINEAR_____16_CM 16 0. 8160. FORMAT "%4.0" AXIS_PTS_REF ldpm_n_2_9 /end AXIS_DESCR
 /begin AXIS_DESCR COM_AXIS maf_knk _CNV_A_R_LINEAR_____27_CM 4 0. 1389. FORMAT "%4.0" AXIS_PTS_REF ldpm_maf_1_9 /end AXIS_DESCR
/end CHARACTERISTIC
/begin CHARACTERISTIC ip_fac_thd_knk_2__n__maf "Knock Factor Table Cyl. 3" MAP 0x053cc _REC_MAP_20_u1_u1_u1 7.96875 _CNV_A_R_LINEAR_____235_CM 0. 7.96875 DISPLAY_IDENTIFIER IP_FAC_THD_KNK_2__N__MAF FORMAT "%4.2"
 /begin AXIS_DESCR COM_AXIS n_knk _CNV_A_R_LINEAR_____16_CM 16 0. 8160. FORMAT "%4.0" AXIS_PTS_REF ldpm_n_2_9 /end AXIS_DESCR
 /begin AXIS_DESCR COM_AXIS maf_knk _CNV_A_R_LINEAR_____27_CM 4 0. 1389. FORMAT "%4.0" AXIS_PTS_REF ldpm_maf_1_9 /end AXIS_DESCR
/end CHARACTERISTIC
/begin CHARACTERISTIC ip_fac_thd_knk_3__n__maf "Knock Factor Table Cyl. 4" MAP 0x0540c _REC_MAP_20_u1_u1_u1 7.96875 _CNV_A_R_LINEAR_____235_CM 0. 7.96875 DISPLAY_IDENTIFIER IP_FAC_THD_KNK_3__N__MAF FORMAT "%4.2"
 /begin AXIS_DESCR COM_AXIS n_knk _CNV_A_R_LINEAR_____16_CM 16 0. 8160. FORMAT "%4.0" AXIS_PTS_REF ldpm_n_2_9 /end AXIS_DESCR
 /begin AXIS_DESCR COM_AXIS maf_knk _CNV_A_R_LINEAR_____27_CM 4 0. 1389. FORMAT "%4.0" AXIS_PTS_REF ldpm_maf_1_9 /end AXIS_DESCR
/end CHARACTERISTIC
/begin CHARACTERISTIC ip_fac_thd_knk_4__n__maf "Knock Factor Table Cyl. 5" MAP 0x0544c _REC_MAP_20_u1_u1_u1 7.96875 _CNV_A_R_LINEAR_____235_CM 0. 7.96875 DISPLAY_IDENTIFIER IP_FAC_THD_KNK_4__N__MAF FORMAT "%4.2"
 /begin AXIS_DESCR COM_AXIS n_knk _CNV_A_R_LINEAR_____16_CM 16 0. 8160. FORMAT "%4.0" AXIS_PTS_REF ldpm_n_2_9 /end AXIS_DESCR
 /begin AXIS_DESCR COM_AXIS maf_knk _CNV_A_R_LINEAR_____27_CM 4 0. 1389. FORMAT "%4.0" AXIS_PTS_REF ldpm_maf_1_9 /end AXIS_DESCR
/end CHARACTERISTIC
/begin CHARACTERISTIC ip_fac_thd_knk_5__n__maf "Knock Factor Table Cyl. 6" MAP 0x0548c _REC_MAP_20_u1_u1_u1 7.96875 _CNV_A_R_LINEAR_____235_CM 0. 7.96875 DISPLAY_IDENTIFIER IP_FAC_THD_KNK_5__N__MAF FORMAT "%4.2"
 /begin AXIS_DESCR COM_AXIS n_knk _CNV_A_R_LINEAR_____16_CM 16 0. 8160. FORMAT "%4.0" AXIS_PTS_REF ldpm_n_2_9 /end AXIS_DESCR
 /begin AXIS_DESCR COM_AXIS maf_knk _CNV_A_R_LINEAR_____27_CM 4 0. 1389. FORMAT "%4.0" AXIS_PTS_REF ldpm_maf_1_9 /end AXIS_DESCR
/end CHARACTERISTIC
/begin CHARACTERISTIC ip_knk_thd_add__n "Knock summand" CURVE 0x06714 _REC_CUR_20_u1_u1 5.1 _CNV_A_R_LINEAR_____254_CM -2.56 2.54 DISPLAY_IDENTIFIER IP_KNK_THD_ADD__N FORMAT "%4.2"
 /begin AXIS_DESCR COM_AXIS n_knk _CNV_A_R_LINEAR_____16_CM 16 0. 8160. FORMAT "%4.0" AXIS_PTS_REF ldpm_n_2_9 /end AXIS_DESCR
/end CHARACTERISTIC
/begin CHARACTERISTIC c_nl_min "Minimum noise value" VALUE 0x00795 _REC_VAL_20_u1 4.998 _CNV_A_R_LINEAR_____44_CM 0. 4.998 DISPLAY_IDENTIFIER C_NL_MIN FORMAT "%5.3" /end CHARACTERISTIC
/begin CHARACTERISTIC id_maf_dif_tra_knk__n "Throttle Position Gradient for Load Dynamik Recognition" CURVE 0x004e6 _REC_CUR_20_s2_u1 1388.978806 _CNV_A_R_LINEAR_____255_CM -694.5 694.478806 DISPLAY_IDENTIFIER ID_MAF_DIF_TRA_KNK__N FORMAT "%7.2"
 /begin AXIS_DESCR COM_AXIS n_knk _CNV_A_R_LINEAR_____16_CM 4 0. 8160. FORMAT "%4.0" AXIS_PTS_REF ldpm_n_6_4 /end AXIS_DESCR
/end CHARACTERISTIC
/begin CHARACTERISTIC ip_iga_bas_max_knk__n__maf "Maximum value for spark retard" MAP 0x05c2c _REC_MAP_20_u1_u1_u1 95.625 _CNV_A_R_LINEAR_____203_CM -35.625 60. DISPLAY_IDENTIFIER IP_IGA_BAS_MAX_KNK__N__MAF FORMAT "%5.1"
 /begin AXIS_DESCR COM_AXIS n_32 _CNV_A_R_LINEAR_____16_CM 8 0. 8160. FORMAT "%4.0" AXIS_PTS_REF ldpm_n_iga_max_knk /end AXIS_DESCR
 /begin AXIS_DESCR COM_AXIS maf _CNV_A_R_LINEAR_____27_CM 8 0. 1389. FORMAT "%4.0" AXIS_PTS_REF ldpm_maf_iga_max_knk /end AXIS_DESCR
/end CHARACTERISTIC
/begin CHARACTERISTIC ip_iga_ofs_max_knk__n__maf "Maximum value for spark retard" MAP 0x061d0 _REC_MAP_20_u1_u1_u1 95.625 _CNV_A_R_LINEAR_____205_CM -48. 47.625 DISPLAY_IDENTIFIER IP_IGA_OFS_MAX_KNK__N__MAF FORMAT "%5.1"
 /begin AXIS_DESCR COM_AXIS n_32 _CNV_A_R_LINEAR_____16_CM 8 0. 8160. FORMAT "%4.0" AXIS_PTS_REF ldpm_n_iga_max_knk /end AXIS_DESCR
 /begin AXIS_DESCR COM_AXIS maf _CNV_A_R_LINEAR_____27_CM 8 0. 1389. FORMAT "%4.0" AXIS_PTS_REF ldpm_maf_iga_max_knk /end AXIS_DESCR
/end CHARACTERISTIC
/begin CHARACTERISTIC ip_fac_iga_max_knk__tco__tia "Weighting factor for the max. spark retard against coolant" MAP 0x04db2 _REC_MAP_20_u1_u1_u1 0.9960940000000002 _CNV_A_R_LINEAR_____50_CM 0. 0.996094 DISPLAY_IDENTIFIER IP_FAC_IGA_MAX_KNK__TCO__TIA FORMAT "%5.3"
 /begin AXIS_DESCR COM_AXIS tco _CNV_A_R_LINEAR_____12_CM 4 -48. 142.5 FORMAT "%5.1" AXIS_PTS_REF ldp_tco__fac_iga_max_knk /end AXIS_DESCR
 /begin AXIS_DESCR COM_AXIS tia _CNV_A_R_LINEAR_____12_CM 4 -48. 142.5 FORMAT "%5.1" AXIS_PTS_REF ldp_tia__fac_iga_max_knk /end AXIS_DESCR
/end CHARACTERISTIC
/begin CHARACTERISTIC c_iga_ad1_thd_inc_knk "" VALUE 0x006fb _REC_VAL_20_u1 23.625 _CNV_A_R_LINEAR_____205_CM -24. -0.375 DISPLAY_IDENTIFIER C_IGA_AD1_THD_INC_KNK FORMAT "%3.1" /end CHARACTERISTIC
/begin CHARACTERISTIC c_tco_ad1_min_knk "minimum TCO threshold for knock adaptation circuit 1" VALUE 0x00856 _REC_VAL_20_u1 190.5 _CNV_A_R_LINEAR_____12_CM -48. 142.5 DISPLAY_IDENTIFIER C_TCO_AD1_MIN_KNK FORMAT "%5.1" /end CHARACTERISTIC
/begin CHARACTERISTIC c_tco_ad2_min_knk "minimum TCO threshold for knock adaptation circuit 2" VALUE 0x00858 _REC_VAL_20_u1 190.5 _CNV_A_R_LINEAR_____12_CM -48. 142.5 DISPLAY_IDENTIFIER C_TCO_AD2_MIN_KNK FORMAT "%5.1" /end CHARACTERISTIC
/begin CHARACTERISTIC c_tco_ad1_max_knk "maximum TCO threshold for knock adaptation circuit 1" VALUE 0x00855 _REC_VAL_20_u1 190.5 _CNV_A_R_LINEAR_____12_CM -48. 142.5 DISPLAY_IDENTIFIER C_TCO_AD1_MAX_KNK FORMAT "%5.1" /end CHARACTERISTIC
/begin CHARACTERISTIC c_tco_ad2_max_knk "maximum TCO threshold for knock adaptation circuit 2" VALUE 0x00857 _REC_VAL_20_u1 190.5 _CNV_A_R_LINEAR_____12_CM -48. 142.5 DISPLAY_IDENTIFIER C_TCO_AD2_MAX_KNK FORMAT "%5.1" /end CHARACTERISTIC
/begin AXIS_PTS ldp_tco__maf_min_knk "" 0x0116b tco _REC_AXS_20_u1 190.5 _CNV_A_R_LINEAR_____12_CM 4 -48. 142.5 DISPLAY_IDENTIFIER LDP_TCO__MAF_MIN_KNK FORMAT "%3.0" /end AXIS_PTS
/begin AXIS_PTS ldpm_n_3_9 "" 0x08124 n_32 _REC_AXS_20_u1 8160. _CNV_A_R_LINEAR_____16_CM 8 0. 8160. DISPLAY_IDENTIFIER LDPM_N_3_9 FORMAT "%4.0" /end AXIS_PTS
/begin AXIS_PTS ldpm_n_4_9 "" 0x0137a n_knk _REC_AXS_20_u1 8160. _CNV_A_R_LINEAR_____16_CM 3 0. 8160. DISPLAY_IDENTIFIER LDPM_N_4_9 FORMAT "%4.0" /end AXIS_PTS
/begin AXIS_PTS ldp_tco__fac_ad_knk_tco "" 0x0113d tco _REC_AXS_20_u1 190.5 _CNV_A_R_LINEAR_____12_CM 2 -48. 142.5 DISPLAY_IDENTIFIER LDP_TCO__FAC_AD_KNK_TCO FORMAT "%6.2" /end AXIS_PTS
/begin AXIS_PTS ldpm_n_6_4 "" 0x0137e n_knk _REC_AXS_20_u1 8160. _CNV_A_R_LINEAR_____16_CM 4 0. 8160. DISPLAY_IDENTIFIER LDPM_N_6_4 FORMAT "%4.0" /end AXIS_PTS
/begin AXIS_PTS ldpm_n_iga_max_knk "" 0x08148 n_32 _REC_AXS_20_u1 8160. _CNV_A_R_LINEAR_____16_CM 8 0. 8160. DISPLAY_IDENTIFIER LDPM_N_IGA_MAX_KNK FORMAT "%4.0" /end AXIS_PTS
/begin AXIS_PTS ldpm_maf_iga_max_knk "" 0x07fc3 maf _REC_AXS_20_u1 1389. _CNV_A_R_LINEAR_____27_CM 8 0. 1389. DISPLAY_IDENTIFIER LDPM_MAF_IGA_MAX_KNK FORMAT "%4.0" /end AXIS_PTS
/begin AXIS_PTS ldp_tco__fac_iga_max_knk "" 0x01140 tco _REC_AXS_20_u1 190.5 _CNV_A_R_LINEAR_____12_CM 4 -48. 142.5 DISPLAY_IDENTIFIER LDP_TCO__FAC_IGA_MAX_KNK FORMAT "%5.1" /end AXIS_PTS
/begin AXIS_PTS ldp_tia__fac_iga_max_knk "" 0x011e2 tia _REC_AXS_20_u1 190.5 _CNV_A_R_LINEAR_____12_CM 4 -48. 142.5 DISPLAY_IDENTIFIER LDP_TIA__FAC_IGA_MAX_KNK FORMAT "%5.1" /end AXIS_PTS
/begin CHARACTERISTIC c_knk_thd_max "Maximum knock threshold" VALUE 0x00715 _REC_VAL_20_u1 4.998 _CNV_A_R_LINEAR_____44_CM 0. 4.998 DISPLAY_IDENTIFIER C_KNK_THD_MAX FORMAT "%4.2" /end CHARACTERISTIC
/begin CHARACTERISTIC iga_ad1_knk_5__n__maf "" MAP 0x3fe996 _REC_MAP_20_u1_u1_u1 48. _CNV_A_R_LINEAR_____205_CM -48. 0. READ_ONLY DISPLAY_IDENTIFIER IGA_AD1_KNK_5__N__MAF FORMAT "%6.2" MAX_REFRESH 4 100
 /begin AXIS_DESCR COM_AXIS n_knk _CNV_A_R_LINEAR_____16_CM 8 0. 8160. FORMAT "%4.0" AXIS_PTS_REF ldpm_n_iga_ad /end AXIS_DESCR
 /begin AXIS_DESCR COM_AXIS maf_knk _CNV_A_R_LINEAR_____27_CM 6 0. 1389. FORMAT "%7.2" AXIS_PTS_REF ldpm_maf_iga_ad /end AXIS_DESCR
/end CHARACTERISTIC
/begin CHARACTERISTIC iga_ad1_knk_4__n__maf "" MAP 0x3fe966 _REC_MAP_20_u1_u1_u1 48. _CNV_A_R_LINEAR_____205_CM -48. 0. READ_ONLY DISPLAY_IDENTIFIER IGA_AD1_KNK_4__N__MAF FORMAT "%6.2" MAX_REFRESH 4 100
 /begin AXIS_DESCR COM_AXIS n_knk _CNV_A_R_LINEAR_____16_CM 8 0. 8160. FORMAT "%4.0" AXIS_PTS_REF ldpm_n_iga_ad /end AXIS_DESCR
 /begin AXIS_DESCR COM_AXIS maf_knk _CNV_A_R_LINEAR_____27_CM 6 0. 1389. FORMAT "%7.2" AXIS_PTS_REF ldpm_maf_iga_ad /end AXIS_DESCR
/end CHARACTERISTIC
/begin CHARACTERISTIC iga_ad1_knk_3__n__maf "" MAP 0x3fe936 _REC_MAP_20_u1_u1_u1 48. _CNV_A_R_LINEAR_____205_CM -48. 0. READ_ONLY DISPLAY_IDENTIFIER IGA_AD1_KNK_3__N__MAF FORMAT "%6.2" MAX_REFRESH 4 100
 /begin AXIS_DESCR COM_AXIS n_knk _CNV_A_R_LINEAR_____16_CM 8 0. 8160. FORMAT "%4.0" AXIS_PTS_REF ldpm_n_iga_ad /end AXIS_DESCR
 /begin AXIS_DESCR COM_AXIS maf_knk _CNV_A_R_LINEAR_____27_CM 6 0. 1389. FORMAT "%7.2" AXIS_PTS_REF ldpm_maf_iga_ad /end AXIS_DESCR
/end CHARACTERISTIC
/begin CHARACTERISTIC iga_ad1_knk_2__n__maf "" MAP 0x3fe906 _REC_MAP_20_u1_u1_u1 48. _CNV_A_R_LINEAR_____205_CM -48. 0. READ_ONLY DISPLAY_IDENTIFIER IGA_AD1_KNK_2__N__MAF FORMAT "%6.2" MAX_REFRESH 4 100
 /begin AXIS_DESCR COM_AXIS n_knk _CNV_A_R_LINEAR_____16_CM 8 0. 8160. FORMAT "%4.0" AXIS_PTS_REF ldpm_n_iga_ad /end AXIS_DESCR
 /begin AXIS_DESCR COM_AXIS maf_knk _CNV_A_R_LINEAR_____27_CM 6 0. 1389. FORMAT "%7.2" AXIS_PTS_REF ldpm_maf_iga_ad /end AXIS_DESCR
/end CHARACTERISTIC
/begin AXIS_PTS ldpm_n_iga_ad "" 0x0813f n_knk _REC_AXS_20_u1 8160. _CNV_A_R_LINEAR_____16_CM 8 0. 8160. DISPLAY_IDENTIFIER LDPM_N_IGA_AD FORMAT "%4.0" /end AXIS_PTS
/begin CHARACTERISTIC iga_ad1_knk_1__n__maf "" MAP 0x3fe8d6 _REC_MAP_20_u1_u1_u1 48. _CNV_A_R_LINEAR_____205_CM -48. 0. READ_ONLY DISPLAY_IDENTIFIER IGA_AD1_KNK_1__N__MAF FORMAT "%6.2" MAX_REFRESH 4 100
 /begin AXIS_DESCR COM_AXIS n_knk _CNV_A_R_LINEAR_____16_CM 8 0. 8160. FORMAT "%4.0" AXIS_PTS_REF ldpm_n_iga_ad /end AXIS_DESCR
 /begin AXIS_DESCR COM_AXIS maf_knk _CNV_A_R_LINEAR_____27_CM 6 0. 1389. FORMAT "%7.2" AXIS_PTS_REF ldpm_maf_iga_ad /end AXIS_DESCR
/end CHARACTERISTIC
/begin CHARACTERISTIC iga_ad1_knk_0__n__maf "" MAP 0x3fe8a6 _REC_MAP_20_u1_u1_u1 48. _CNV_A_R_LINEAR_____205_CM -48. 0. READ_ONLY DISPLAY_IDENTIFIER IGA_AD1_KNK_0__N__MAF FORMAT "%6.2" MAX_REFRESH 4 100
 /begin AXIS_DESCR COM_AXIS n_knk _CNV_A_R_LINEAR_____16_CM 8 0. 8160. FORMAT "%4.0" AXIS_PTS_REF ldpm_n_iga_ad /end AXIS_DESCR
 /begin AXIS_DESCR COM_AXIS maf_knk _CNV_A_R_LINEAR_____27_CM 6 0. 1389. FORMAT "%7.2" AXIS_PTS_REF ldpm_maf_iga_ad /end AXIS_DESCR
/end CHARACTERISTIC
/begin AXIS_PTS ldpm_maf_iga_ad "" 0x012ff maf_knk _REC_AXS_20_u1 1389. _CNV_A_R_LINEAR_____27_CM 6 0. 1389. DISPLAY_IDENTIFIER LDPM_MAF_IGA_AD FORMAT "%7.2" /end AXIS_PTS
/begin AXIS_PTS ldpm_n_2_9 "" 0x07feb n_knk _REC_AXS_20_u1 8160. _CNV_A_R_LINEAR_____16_CM 16 0. 8160. DISPLAY_IDENTIFIER LDPM_N_2_9 FORMAT "%4.0" /end AXIS_PTS
/begin AXIS_PTS ldpm_n_knkwb "" 0x08151 n_knk _REC_AXS_20_u1 8160. _CNV_A_R_LINEAR_____16_CM 10 0. 8160. DISPLAY_IDENTIFIER LDPM_N_KNKWB FORMAT "%4.0" /end AXIS_PTS
/begin AXIS_PTS ldpm_maf_knkwb "" 0x01306 maf_knk _REC_AXS_20_u1 1389. _CNV_A_R_LINEAR_____27_CM 4 0. 1389. DISPLAY_IDENTIFIER LDPM_MAF_KNKWB FORMAT "%4.0" /end AXIS_PTS
/begin AXIS_PTS ldpm_n_fil_frq_knk "" 0x0138a n_knk _REC_AXS_20_u1 8160. _CNV_A_R_LINEAR_____16_CM 4 0. 8160. DISPLAY_IDENTIFIER LDPM_N_FIL_FRQ_KNK FORMAT "%4.0" /end AXIS_PTS
/begin AXIS_PTS ldpm_maf_1_9 "" 0x012f3 maf_knk _REC_AXS_20_u1 69.45 _CNV_A_R_LINEAR_____27_CM 4 0. 1389. DISPLAY_IDENTIFIER LDPM_MAF_1_9 FORMAT "%4.0" /end AXIS_PTS
/begin CHARACTERISTIC c_maf_min_knk_ad2 "min. mass air for Adaptation circuit 2" VALUE 0x00726 _REC_VAL_20_u1 416.7 _CNV_A_R_LINEAR_____27_CM 0. 1389. DISPLAY_IDENTIFIER C_MAF_MIN_KNK_AD2 FORMAT "%4.0" /end CHARACTERISTIC
/begin MEASUREMENT knk_ctl_dis "knock control disabled due to malfunctions" UBYTE _CNV_S_2_RANGE______5_CM 1 100. 0. 1. DISPLAY_IDENTIFIER KNK_CTL_DIS ECU_ADDRESS 0x3fe33f /end MEASUREMENT
/begin MEASUREMENT lv_knk_ad_rd_ena "reading from Adaptation table enabled" UBYTE _CNV_S_2_RANGE______5_CM 1 100. 0. 1. DISPLAY_IDENTIFIER LV_KNK_AD_RD_ENA ECU_ADDRESS 0x3fe342 /end MEASUREMENT
/begin MEASUREMENT knk_ad1_dis "Adaptation circuit 1 disabled" UBYTE _CNV_S_2_RANGE______5_CM 1 100. 0. 1. DISPLAY_IDENTIFIER KNK_AD1_DIS ECU_ADDRESS 0x3fe340 /end MEASUREMENT
/begin MEASUREMENT knk_ad2_dis "Adaptation circuit 2 disabled" UBYTE _CNV_S_2_RANGE______5_CM 1 100. 0. 1. DISPLAY_IDENTIFIER KNK_AD2_DIS ECU_ADDRESS 0x3fe341 /end MEASUREMENT
/begin CHARACTERISTIC c_tco_ad_min_ron "Bottom limit TCO" VALUE 0x0085b _REC_VAL_20_u1 190.5 _CNV_A_R_LINEAR_____12_CM -48. 142.5 DISPLAY_IDENTIFIER C_TCO_AD_MIN_RON FORMAT "%5.1" /end CHARACTERISTIC
/begin CHARACTERISTIC c_cycnr_ad_rtd_knk "Number of combustion cycles for  RON adjustment" VALUE 0x01520 _REC_VAL_20_u2 65535. _CNV_A_R_LINEAR_____256_CM 0. 65535. DISPLAY_IDENTIFIER C_CYCNR_AD_RTD_KNK FORMAT "%5.0" /end CHARACTERISTIC
/begin CHARACTERISTIC c_iga_min_ad "MIN limit IGA for RON adjustment" VALUE 0x00709 _REC_VAL_20_u1 48. _CNV_A_R_LINEAR_____205_CM -48. 0. DISPLAY_IDENTIFIER C_IGA_MIN_AD FORMAT "%5.1" /end CHARACTERISTIC
/begin CHARACTERISTIC c_iga_max_ad "MAX limit IGA for RON adjustment" VALUE 0x00708 _REC_VAL_20_u1 48. _CNV_A_R_LINEAR_____205_CM -48. 0. DISPLAY_IDENTIFIER C_IGA_MAX_AD FORMAT "%5.1" /end CHARACTERISTIC
/begin CHARACTERISTIC c_cycnr_fac_ron "Adjustment value for RON incrementation  " VALUE 0x00677 _REC_VAL_20_u1 254. _CNV_A_R_LINEAR_____1_CM 1. 255. DISPLAY_IDENTIFIER C_CYCNR_FAC_RON FORMAT "%3.0" /end CHARACTERISTIC
/begin CHARACTERISTIC c_tco_fac_ron_min "TCO-Threshold RON Factor  changing after initialisation cold" VALUE 0x00872 _REC_VAL_20_u1 190.5 _CNV_A_R_LINEAR_____12_CM -48. 142.5 DISPLAY_IDENTIFIER C_TCO_FAC_RON_MIN FORMAT "%5.1" /end CHARACTERISTIC
/begin CHARACTERISTIC c_tco_fac_ron_max "TCO-Threshold RON Factor  changing after initialisation hot" VALUE 0x00871 _REC_VAL_20_u1 190.5 _CNV_A_R_LINEAR_____12_CM -48. 142.5 DISPLAY_IDENTIFIER C_TCO_FAC_RON_MAX FORMAT "%5.1" /end CHARACTERISTIC
/begin CHARACTERISTIC c_fac_ron_ad_cold "Factor moving to ® RON_98 after ECU initialisation" VALUE 0x006d8 _REC_VAL_20_u1 1.99220002 _CNV_A_R_LINEAR_____39_CM 0. 1.99220002 DISPLAY_IDENTIFIER C_FAC_RON_AD_COLD FORMAT "%5.3" /end CHARACTERISTIC
/begin CHARACTERISTIC c_fac_ron_ad_hot "Factor moving to ® RON_91 after ECU initialisation" VALUE 0x006d9 _REC_VAL_20_u1 1.99220002 _CNV_A_R_LINEAR_____39_CM 0. 1.99220002 DISPLAY_IDENTIFIER C_FAC_RON_AD_HOT FORMAT "%5.3" /end CHARACTERISTIC
/begin CHARACTERISTIC id_maf_min_knk_ad_2__n_32 "MAF-theshold for activation  RON-Adaptation" CURVE 0x03ddc _REC_CUR_20_u1_u1 1389. _CNV_A_R_LINEAR_____27_CM 0. 1389. DISPLAY_IDENTIFIER ID_MAF_MIN_KNK_AD_2__N_32 FORMAT "%4.0"
 /begin AXIS_DESCR COM_AXIS n_32 _CNV_A_R_LINEAR_____16_CM 16 0. 8160. FORMAT "%4.0" AXIS_PTS_REF ldp_n_32__maf_min_knk_ad_2 /end AXIS_DESCR
/end CHARACTERISTIC
/begin CHARACTERISTIC ip_fac_ron_inc__n_32 "RON-factor increment " CURVE 0x01ad0 _REC_CUR_20_u2_u1 0.99998474 _CNV_A_R_LINEAR_____37_CM 0. 0.99998474 DISPLAY_IDENTIFIER IP_FAC_RON_INC__N FORMAT "%7.5"
 /begin AXIS_DESCR COM_AXIS n_32 _CNV_A_R_LINEAR_____16_CM 4 0. 8160. FORMAT "%4.0" AXIS_PTS_REF ldpm_n_32_3_iga /end AXIS_DESCR
/end CHARACTERISTIC
/begin CHARACTERISTIC ip_fac_ron_dec__n_32 "RON factor decrement" CURVE 0x01ac8 _REC_CUR_20_u2_u1 0.99998474 _CNV_A_R_LINEAR_____37_CM 0. 0.99998474 DISPLAY_IDENTIFIER IP_FAC_RON_DEC__N FORMAT "%7.5"
 /begin AXIS_DESCR COM_AXIS n_32 _CNV_A_R_LINEAR_____16_CM 4 0. 8160. FORMAT "%4.0" AXIS_PTS_REF ldpm_n_32_3_iga /end AXIS_DESCR
/end CHARACTERISTIC
/begin CHARACTERISTIC ip_fac_ron_ad_max__tia__tco "Threshold for RON Factor = 1 recognition for the whole  driving cycle" MAP 0x052fa _REC_MAP_20_u1_u1_u1 0.9960940000000002 _CNV_A_R_LINEAR_____50_CM 0. 0.996094 DISPLAY_IDENTIFIER IP_FAC_RON_AD_MAX__TIA__TCO FORMAT "%5.3"
 /begin AXIS_DESCR COM_AXIS tia _CNV_A_R_LINEAR_____12_CM 4 -48. 142.5 FORMAT "%5.1" AXIS_PTS_REF ldp_tia__ip_fac_ron_ad_max /end AXIS_DESCR
 /begin AXIS_DESCR COM_AXIS tco _CNV_A_R_LINEAR_____12_CM 4 -48. 142.5 FORMAT "%5.1" AXIS_PTS_REF ldp_tco__ip_fac_ron_ad_max /end AXIS_DESCR
/end CHARACTERISTIC
/begin MEASUREMENT fac_ron_ad "Adaptive RON factor" UWORD _CNV_A_R_LINEAR_____37_CM 1 100. 0. 0.99998474 DISPLAY_IDENTIFIER FAC_RON_AD ECU_ADDRESS 0x3fd4be BYTE_ORDER MSB_LAST FORMAT "%7.5" /end MEASUREMENT
/begin MEASUREMENT lv_fac_ron_ad_act "Adaptive RON factor" UBYTE _CNV_S_2_RANGE______0_CM 1 100. 0. 1. DISPLAY_IDENTIFIER LV_FAC_RON_AD_ACT ECU_ADDRESS 0x3fe343 /end MEASUREMENT
/begin AXIS_PTS ldp_n_32__maf_min_knk_ad_2 "" 0x07c38 n_32 _REC_AXS_20_u1 8160. _CNV_A_R_LINEAR_____16_CM 16 0. 8160. DISPLAY_IDENTIFIER LDP_N_32__MAF_MIN_KNK_AD_2 FORMAT "%4.0" /end AXIS_PTS
/begin AXIS_PTS ldp_tia__ip_fac_ron_ad_max "" 0x011fa tia _REC_AXS_20_u1 190.5 _CNV_A_R_LINEAR_____12_CM 4 -48. 142.5 DISPLAY_IDENTIFIER LDP_TIA__IP_FAC_RON_AD_MAX FORMAT "%5.1" /end AXIS_PTS
/begin AXIS_PTS ldp_tco__ip_fac_ron_ad_max "" 0x01158 tco _REC_AXS_20_u1 190.5 _CNV_A_R_LINEAR_____12_CM 4 -48. 142.5 DISPLAY_IDENTIFIER LDP_TCO__IP_FAC_RON_AD_MAX FORMAT "%5.1" /end AXIS_PTS
/begin AXIS_PTS ldpm_n_32_3_iga "" 0x01330 n_32 _REC_AXS_20_u1 8160. _CNV_A_R_LINEAR_____16_CM 4 0. 8160. DISPLAY_IDENTIFIER LDPM_N_32_3_IGA FORMAT "%4.0" /end AXIS_PTS
/begin MEASUREMENT iga_tra_knk "Spark retard till high TPS_GRD or MAP_DRV1 applied to engnie" UBYTE _CNV_A_R_LINEAR_____205_CM 1 100. -48. 0. DISPLAY_IDENTIFIER IGA_TRA_KNK ECU_ADDRESS 0x3fe345 FORMAT "%5.1" /end MEASUREMENT
/begin MEASUREMENT iga_tra_knk_inter "Spark retard till high TPS_GRD or MAP_DRV1 intermediate" UBYTE _CNV_A_R_LINEAR_____205_CM 1 100. -48. 0. DISPLAY_IDENTIFIER IGA_TRA_KNK_INTER ECU_ADDRESS 0x3fe348 FORMAT "%5.1" /end MEASUREMENT
/begin MEASUREMENT lv_iga_tra_knk "Flag for instationary correction avtive" UBYTE _CNV_S_2_RANGE______0_CM 1 100. 0. 1. DISPLAY_IDENTIFIER LV_IGA_TRA_KNK ECU_ADDRESS 0x3fe346 /end MEASUREMENT
/begin MEASUREMENT ctr_cyc_iga_tra_knk_dly "Cycle counter for delay period before ignition intervention" UBYTE _CNV_A_R_LINEAR_____1_CM 1 100. 0. 255. DISPLAY_IDENTIFIER CTR_CYC_IGA_TRA_KNK_DLY ECU_ADDRESS 0x3fe349 FORMAT "%3.0" /end MEASUREMENT
/begin MEASUREMENT ctr_cyc_iga_tra_knk_act "Cycle counter during active ignition intervention" UBYTE _CNV_A_R_LINEAR_____1_CM 1 100. 0. 255. DISPLAY_IDENTIFIER CTR_CYC_IGA_TRA_KNK_ACT ECU_ADDRESS 0x3fe34a FORMAT "%3.0" /end MEASUREMENT
/begin MEASUREMENT ctr_cyc_iga_tra_knk_wait "Cycle counter for delay time before follow up ignition intervention" UBYTE _CNV_A_R_LINEAR_____1_CM 1 100. 0. 255. DISPLAY_IDENTIFIER CTR_CYC_IGA_TRA_KNK_WAIT ECU_ADDRESS 0x3fe34b FORMAT "%3.0" /end MEASUREMENT
/begin MEASUREMENT state_iga_tra_knk "State of ignition angle intervention for knock prevention" UBYTE _CNV_S_6_STATE_IGA__257_CM 1 100. 0. 5. DISPLAY_IDENTIFIER STATE_IGA_TRA_KNK ECU_ADDRESS 0x3fe34c /end MEASUREMENT
/begin CHARACTERISTIC id_tps_grd_iga_tra_knk "TPS_GRD-threshold for activation of the IGA retard adjustment" CURVE 0x00a20 _REC_CUR_20_u1_u1 2987.5 _CNV_A_R_LINEAR_____52_CM 0. 2987.5 DISPLAY_IDENTIFIER ID_TPS_GRD_IGA_TRA_KNK FORMAT "%6.1"
 /begin AXIS_DESCR COM_AXIS n_32 _CNV_A_R_LINEAR_____16_CM 4 0. 8160. FORMAT "%4.0" AXIS_PTS_REF ldpm_n_32_7 /end AXIS_DESCR
/end CHARACTERISTIC
/begin CHARACTERISTIC id_map_drv1_iga_tra_knk "MAP_DRV1-threshold for activation of the IGA retard adjustment" CURVE 0x004ee _REC_CUR_20_s2_u1 165.8 _CNV_A_R_LINEAR_____258_CM -82.90000000000001 82.90000000000001 DISPLAY_IDENTIFIER ID_MAP_DRV1_IGA_TRA_KNK FORMAT "%7.3"
 /begin AXIS_DESCR COM_AXIS n_32 _CNV_A_R_LINEAR_____16_CM 4 0. 8160. FORMAT "%4.0" AXIS_PTS_REF ldpm_n_32_7 /end AXIS_DESCR
/end CHARACTERISTIC
/begin CHARACTERISTIC ip_iga_tra_knk "Ignition adjustment angle in retard direction" MAP 0x06554 _REC_MAP_20_u1_u1_u1 48. _CNV_A_R_LINEAR_____205_CM -48. 0. DISPLAY_IDENTIFIER IP_IGA_TRA_KNK FORMAT "%5.1"
 /begin AXIS_DESCR COM_AXIS maf _CNV_A_R_LINEAR_____27_CM 4 0. 1389. FORMAT "%4.0" AXIS_PTS_REF ldp_maf_iga__iga_tra_knk /end AXIS_DESCR
 /begin AXIS_DESCR COM_AXIS n_32 _CNV_A_R_LINEAR_____16_CM 4 0. 8160. FORMAT "%4.0" AXIS_PTS_REF ldpm_n_32_7 /end AXIS_DESCR
/end CHARACTERISTIC
/begin CHARACTERISTIC ip_fac_iga_tra "TIA correction factor" MAP 0x04f42 _REC_MAP_20_u1_u1_u1 0.99610001 _CNV_A_R_LINEAR_____29_CM 0. 0.99610001 DISPLAY_IDENTIFIER IP_FAC_IGA_TRA FORMAT "%5.3"
 /begin AXIS_DESCR COM_AXIS tia _CNV_A_R_LINEAR_____12_CM 4 -48. 142.5 FORMAT "%5.1" AXIS_PTS_REF ldp_tia_fac_iga_tra /end AXIS_DESCR
 /begin AXIS_DESCR COM_AXIS fac_ron_ad _CNV_A_R_LINEAR_____29_CM 3 0. 0.99610001 FORMAT "%5.3" AXIS_PTS_REF ldp_fac_ron_ad_fac_iga_tra /end AXIS_DESCR
/end CHARACTERISTIC
/begin CHARACTERISTIC ip_fac_iga_tra_gear_mt "GEAR/VS correction factor" MAP 0x04f72 _REC_MAP_20_u1_u1_u1 0.99610001 _CNV_A_R_LINEAR_____29_CM 0. 0.99610001 DISPLAY_IDENTIFIER IP_FAC_IGA_TRA_GEAR_MT FORMAT "%5.3"
 /begin AXIS_DESCR COM_AXIS vs _CNV_A_R_LINEAR_____23_CM 6 0. 255. FORMAT "%3.0" AXIS_PTS_REF ldp_vs_fac_iga_tra_gear_mt /end AXIS_DESCR
 /begin AXIS_DESCR COM_AXIS gear _CNV_A_R_LINEAR_____1_CM 6 0. 7. FORMAT "%2.0" AXIS_PTS_REF ldpm_gear_1 /end AXIS_DESCR
/end CHARACTERISTIC
/begin CHARACTERISTIC ip_fac_iga_tra_gear_at "GEAR/VS correction factor" MAP 0x04f4e _REC_MAP_20_u1_u1_u1 0.99610001 _CNV_A_R_LINEAR_____29_CM 0. 0.99610001 DISPLAY_IDENTIFIER IP_FAC_IGA_TRA_GEAR_AT FORMAT "%5.3"
 /begin AXIS_DESCR COM_AXIS vs _CNV_A_R_LINEAR_____23_CM 6 0. 255. FORMAT "%3.0" AXIS_PTS_REF ldp_vs_fac_iga_tra_gear_at /end AXIS_DESCR
 /begin AXIS_DESCR COM_AXIS gear _CNV_A_R_LINEAR_____1_CM 6 0. 7. FORMAT "%2.0" AXIS_PTS_REF ldpm_gear_1 /end AXIS_DESCR
/end CHARACTERISTIC
/begin CHARACTERISTIC id_cyc_iga_tra_knk_dly "Delay after the load dynamics has been triggered initially" CURVE 0x0098a _REC_CUR_20_u1_u1 255. _CNV_A_R_LINEAR_____1_CM 0. 255. DISPLAY_IDENTIFIER ID_CYC_IGA_TRA_KNK_DLY FORMAT "%3.0"
 /begin AXIS_DESCR COM_AXIS n_32 _CNV_A_R_LINEAR_____16_CM 4 0. 8160. FORMAT "%4.0" AXIS_PTS_REF ldpm_n_32_7 /end AXIS_DESCR
/end CHARACTERISTIC
/begin CHARACTERISTIC ip_iga_tra_inc "IGA limitation gradient for controlled reset of the ignition angle adjustment IP_IGA_TRA_KNK__N__MAF" CURVE 0x01aee _REC_CUR_20_u2_u1 47.99707032000001 _CNV_A_R_LINEAR_____259_CM 1.46484e-003 47.99853516 DISPLAY_IDENTIFIER IP_IGA_TRA_INC
 /begin AXIS_DESCR COM_AXIS n_32 _CNV_A_R_LINEAR_____16_CM 4 0. 8160. FORMAT "%4.0" AXIS_PTS_REF ldpm_n_32_7 /end AXIS_DESCR
/end CHARACTERISTIC
/begin CHARACTERISTIC id_cyc_iga_tra_knk_act "Number of cycles for ignition angle adjustment active" CURVE 0x00986 _REC_CUR_20_u1_u1 255. _CNV_A_R_LINEAR_____1_CM 0. 255. DISPLAY_IDENTIFIER ID_CYC_IGA_TRA_KNK_ACT FORMAT "%3.0"
 /begin AXIS_DESCR COM_AXIS n_32 _CNV_A_R_LINEAR_____16_CM 4 0. 8160. FORMAT "%4.0" AXIS_PTS_REF ldpm_n_32_7 /end AXIS_DESCR
/end CHARACTERISTIC
/begin CHARACTERISTIC id_cyc_iga_tra_knk_wait "Delay between two ignition angle interventions due to load dynamics" CURVE 0x0098e _REC_CUR_20_u1_u1 255. _CNV_A_R_LINEAR_____1_CM 0. 255. DISPLAY_IDENTIFIER ID_CYC_IGA_TRA_KNK_WAIT FORMAT "%3.0"
 /begin AXIS_DESCR COM_AXIS n_32 _CNV_A_R_LINEAR_____16_CM 4 0. 8160. FORMAT "%4.0" AXIS_PTS_REF ldpm_n_32_7 /end AXIS_DESCR
/end CHARACTERISTIC
/begin CHARACTERISTIC c_n_min_iga_tra_cs "Engine speed threshold for load dynamics IGA" VALUE 0x0170c _REC_VAL_20_u2 8160. _CNV_A_R_LINEAR_____11_CM 0. 8160. DISPLAY_IDENTIFIER C_N_MIN_IGA_TRA_CS FORMAT "%4.0" /end CHARACTERISTIC
/begin AXIS_PTS ldp_maf_iga__iga_tra_knk "" 0x00ffe maf _REC_AXS_20_u1 1389. _CNV_A_R_LINEAR_____27_CM 4 0. 1389. DISPLAY_IDENTIFIER LDP_MAF_IGA__IGA_TRA_KNK FORMAT "%4.0" /end AXIS_PTS
/begin AXIS_PTS ldpm_n_32_7 "" 0x01341 n_32 _REC_AXS_20_u1 8160. _CNV_A_R_LINEAR_____16_CM 4 0. 8160. DISPLAY_IDENTIFIER LDPM_N_32_7 FORMAT "%4.0" /end AXIS_PTS
/begin AXIS_PTS ldp_fac_ron_ad_fac_iga_tra "" 0x00fba fac_ron_ad _REC_AXS_20_u1 0.99610001 _CNV_A_R_LINEAR_____29_CM 3 0. 0.99610001 DISPLAY_IDENTIFIER LDP_FAC_RON_AD_FAC_IGA_TRA FORMAT "%5.3" /end AXIS_PTS
/begin AXIS_PTS ldp_tia_fac_iga_tra "" 0x011ff tia _REC_AXS_20_u1 190.5 _CNV_A_R_LINEAR_____12_CM 4 -48. 142.5 DISPLAY_IDENTIFIER LDP_TIA_FAC_IGA_TRA FORMAT "%5.1" /end AXIS_PTS
/begin AXIS_PTS ldpm_gear_1 "" 0x012e4 gear _REC_AXS_20_u1 7. _CNV_A_R_LINEAR_____1_CM 6 0. 7. DISPLAY_IDENTIFIER LDPM_GEAR_1 FORMAT "%2.0" /end AXIS_PTS
/begin AXIS_PTS ldp_vs_fac_iga_tra_gear_mt "" 0x012a1 vs _REC_AXS_20_u1 255. _CNV_A_R_LINEAR_____23_CM 6 0. 255. DISPLAY_IDENTIFIER LDP_VS_FAC_IGA_TRA_GEAR_MT FORMAT "%3.0" /end AXIS_PTS
/begin AXIS_PTS ldp_vs_fac_iga_tra_gear_at "" 0x0129a vs _REC_AXS_20_u1 255. _CNV_A_R_LINEAR_____23_CM 6 0. 255. DISPLAY_IDENTIFIER LDP_VS_FAC_IGA_TRA_GEAR_AT FORMAT "%3.0" /end AXIS_PTS
/begin CHARACTERISTIC c_mff_fac "Constannt for stoichiometric air/fuel ratio (=1/14.7)" VALUE 0x016c2 _REC_VAL_20_u2 0.125 _CNV_A_R_LINEAR_____356_CM 0. 0.125 DISPLAY_IDENTIFIER C_MFF_FAC FORMAT "%7.5" /end CHARACTERISTIC
/begin MEASUREMENT mff_bas "Basic injection fuel mass flow (homogenious charge)" UWORD _CNV_A_R_LINEAR_____106_CM 1 100. 0. 1389. DISPLAY_IDENTIFIER MFF_BAS ECU_ADDRESS 0x3fd4c8 BYTE_ORDER MSB_LAST FORMAT "%7.2" /end MEASUREMENT
/begin AXIS_PTS ldpm_n_tooth__eoi_st "" 0x11a52 n_tooth _REC_AXS_20_u2 816. _CNV_A_R_LINEAR_____11_CM 4 0. 8160. DISPLAY_IDENTIFIER LDPM_N_TOOTH__EOI_ST FORMAT "%4.0" /end AXIS_PTS
/begin AXIS_PTS ldpm_tco__eoi_tco "" 0x081c1 tco _REC_AXS_20_u1 19.05 _CNV_A_R_LINEAR_____12_CM 8 -48. 142.5 DISPLAY_IDENTIFIER LDPM_TCO__EOI_TCO FORMAT "%5.1" /end AXIS_PTS
/begin CHARACTERISTIC ip_eoi_h_prs_cst "Basic map end of injection at high pressure cold start" MAP 0x0a996 _REC_MAP_20_u2_u1_u2 720. _CNV_A_R_LINEAR_____82_CM 0. 720. DISPLAY_IDENTIFIER IP_EOI_H_PRS_CST FORMAT "%6.2"
 /begin AXIS_DESCR COM_AXIS tco _CNV_A_R_LINEAR_____12_CM 8 -48. 142.5 FORMAT "%5.1" AXIS_PTS_REF ldpm_tco__eoi_tco /end AXIS_DESCR
 /begin AXIS_DESCR COM_AXIS n_tooth _CNV_A_R_LINEAR_____11_CM 4 0. 8160. FORMAT "%4.0" AXIS_PTS_REF ldpm_n_tooth__eoi_st /end AXIS_DESCR
/end CHARACTERISTIC
/begin CHARACTERISTIC ip_eoi_l_prs_cst "Basic map end of injection at low pressure cold start" MAP 0x0a9d6 _REC_MAP_20_u2_u1_u2 720. _CNV_A_R_LINEAR_____82_CM 0. 720. DISPLAY_IDENTIFIER IP_EOI_L_PRS_CST FORMAT "%6.2"
 /begin AXIS_DESCR COM_AXIS tco _CNV_A_R_LINEAR_____12_CM 8 -48. 142.5 FORMAT "%5.1" AXIS_PTS_REF ldpm_tco__eoi_tco /end AXIS_DESCR
 /begin AXIS_DESCR COM_AXIS n_tooth _CNV_A_R_LINEAR_____11_CM 4 0. 8160. FORMAT "%4.0" AXIS_PTS_REF ldpm_n_tooth__eoi_st /end AXIS_DESCR
/end CHARACTERISTIC
/begin MEASUREMENT opg_sp_st_isa "ISAPWM setpoint at start" UWORD _CNV_A_R_LINEAR_____9_CM 1 100. 0. 99.99847412 DISPLAY_IDENTIFIER OPG_SP_ST_ISA ECU_ADDRESS 0x3fd81c BYTE_ORDER MSB_LAST /end MEASUREMENT
/begin MEASUREMENT opg_rel_st "relative ISAPWM setpoint at start" UWORD _CNV_A_R_LINEAR_____9_CM 1 100. 0. 99.99847412 DISPLAY_IDENTIFIER OPG_REL_ST ECU_ADDRESS 0x3fd81e BYTE_ORDER MSB_LAST /end MEASUREMENT
/begin CHARACTERISTIC ip_opg_rel_st_isa_at "Specified relative ISAPWM setpoint at start" MAP 0x0cfb2 _REC_MAP_20_u2_u2_u1 99.99847412 _CNV_A_R_LINEAR_____9_CM 0. 99.99847412 DISPLAY_IDENTIFIER IP_OPG_REL_ST_ISA_AT
 /begin AXIS_DESCR COM_AXIS n _CNV_A_R_LINEAR_____11_CM 8 0. 8160. FORMAT "%4.0" AXIS_PTS_REF ldpm_n_1_thro /end AXIS_DESCR
 /begin AXIS_DESCR COM_AXIS tco _CNV_A_R_LINEAR_____12_CM 8 -48. 142.5 FORMAT "%5.1" AXIS_PTS_REF ldpm_tco_1_thro /end AXIS_DESCR
/end CHARACTERISTIC
/begin CHARACTERISTIC ip_opg_rel_st_isa_mt "Specified relative ISAPWM setpoint at start" MAP 0x0d032 _REC_MAP_20_u2_u2_u1 99.99847412 _CNV_A_R_LINEAR_____9_CM 0. 99.99847412 DISPLAY_IDENTIFIER IP_OPG_REL_ST_ISA_MT
 /begin AXIS_DESCR COM_AXIS n _CNV_A_R_LINEAR_____11_CM 8 0. 8160. FORMAT "%4.0" AXIS_PTS_REF ldpm_n_1_thro /end AXIS_DESCR
 /begin AXIS_DESCR COM_AXIS tco _CNV_A_R_LINEAR_____12_CM 8 -48. 142.5 FORMAT "%5.1" AXIS_PTS_REF ldpm_tco_1_thro /end AXIS_DESCR
/end CHARACTERISTIC
/begin CHARACTERISTIC ip_opg_rel_st_isa_pv "correction of the ralative ISAPWM setpoint at start via driver's demand" CURVE 0x0d0b2 _REC_CUR_20_u2_u1 99.99847412 _CNV_A_R_LINEAR_____9_CM 0. 99.99847412 DISPLAY_IDENTIFIER IP_OPG_REL_ST_ISA_PV
 /begin AXIS_DESCR COM_AXIS pv_av _CNV_A_R_LINEAR_____10_CM 6 0. 99.609375 FORMAT "%4.1" AXIS_PTS_REF ldp_pv_av_ip_opg_rel_st_isa_pv /end AXIS_DESCR
/end CHARACTERISTIC
/begin CHARACTERISTIC ip_fac_tia_opg_st_isa "TIA correction of the relative ISAPWM setpoint at start" CURVE 0x00be0 _REC_CUR_20_u1_u1 1.99220002 _CNV_A_R_LINEAR_____39_CM 0. 1.99220002 DISPLAY_IDENTIFIER IP_FAC_TIA_OPG_ST_ISA FORMAT "%5.3"
 /begin AXIS_DESCR COM_AXIS tia _CNV_A_R_LINEAR_____12_CM 6 -48. 142.5 FORMAT "%5.1" AXIS_PTS_REF ldp_tia_ip_fac_tia_opg_st_isa /end AXIS_DESCR
/end CHARACTERISTIC
/begin CHARACTERISTIC ip_fac_amp_opg_st_isa "Altitude correction of the relative ISAPWM setpoint at start" MAP 0x04bfe _REC_MAP_20_u1_u2_u2 1.99220002 _CNV_A_R_LINEAR_____39_CM 0. 1.99220002 DISPLAY_IDENTIFIER IP_FAC_AMP_OPG_ST_ISA FORMAT "%5.3"
 /begin AXIS_DESCR COM_AXIS n _CNV_A_R_LINEAR_____11_CM 8 0. 8160. FORMAT "%4.0" AXIS_PTS_REF ldpm_n_1_thro /end AXIS_DESCR
 /begin AXIS_DESCR COM_AXIS amp _CNV_A_R_LINEAR_____49_CM 6 0. 5434. FORMAT "%7.2" AXIS_PTS_REF ldp_amp_ip_fac_amp_opg_st_isa /end AXIS_DESCR
/end CHARACTERISTIC
/begin CHARACTERISTIC ip_opg_sp_st_isa "ISAPWM at start" MAP 0x0d0be _REC_MAP_20_u2_u2_u2 99.99847412 _CNV_A_R_LINEAR_____9_CM 0. 99.99847412 DISPLAY_IDENTIFIER IP_OPG_SP_ST_ISA
 /begin AXIS_DESCR COM_AXIS n _CNV_A_R_LINEAR_____11_CM 8 0. 8160. FORMAT "%4.0" AXIS_PTS_REF ldpm_n_1_thro /end AXIS_DESCR
 /begin AXIS_DESCR COM_AXIS opg_rel_st _CNV_A_R_LINEAR_____9_CM 12 0. 99.99847412 AXIS_PTS_REF ldp_opg_rel_st_ip_opg_sp_st_isa /end AXIS_DESCR
/end CHARACTERISTIC
/begin AXIS_PTS ldp_opg_rel_st_ip_opg_sp_st_isa "" 0x11046 opg_rel_st _REC_AXS_20_u2 99.99847412 _CNV_A_R_LINEAR_____9_CM 12 0. 99.99847412 DISPLAY_IDENTIFIER LDP_OPG_REL_ST_IP_OPG_SP_ST_ISA /end AXIS_PTS
/begin AXIS_PTS ldp_amp_ip_fac_amp_opg_st_isa "" 0x108b4 amp _REC_AXS_20_u2 5434. _CNV_A_R_LINEAR_____49_CM 6 0. 5434. DISPLAY_IDENTIFIER LDP_AMP_IP_FAC_AMP_OPG_ST_ISA FORMAT "%7.2" /end AXIS_PTS
/begin AXIS_PTS ldp_tia_ip_fac_tia_opg_st_isa "" 0x01212 tia _REC_AXS_20_u1 190.5 _CNV_A_R_LINEAR_____12_CM 6 -48. 142.5 DISPLAY_IDENTIFIER LDP_TIA_IP_FAC_TIA_OPG_ST_ISA FORMAT "%5.1" /end AXIS_PTS
/begin AXIS_PTS ldp_pv_av_ip_opg_rel_st_isa_pv "" 0x010f0 pv_av _REC_AXS_20_u1 99.609375 _CNV_A_R_LINEAR_____10_CM 6 0. 99.609375 DISPLAY_IDENTIFIER LDP_PV_AV_IP_OPG_REL_ST_ISA_PV FORMAT "%4.1" /end AXIS_PTS
/begin CHARACTERISTIC ip_ti_st_amp_fac__amp "Cranking injection time correction upon ambient pressure" CURVE 0x00e50 _REC_CUR_20_u1_u2 9.9610001e-002 _CNV_A_R_LINEAR_____39_CM 0. 1.99220002 DISPLAY_IDENTIFIER IP_TI_ST_AMP_FAC__AMP FORMAT "%5.3"
 /begin AXIS_DESCR COM_AXIS amp_mes _CNV_A_R_LINEAR_____49_CM 6 0. 5434. FORMAT "%7.2" AXIS_PTS_REF ldp_amp_mes_ti_st_amp_fac /end AXIS_DESCR
/end CHARACTERISTIC
/begin AXIS_PTS ldp_amp_mes_ti_st_amp_fac "" 0x108fa amp_mes _REC_AXS_20_u2 5434. _CNV_A_R_LINEAR_____49_CM 6 0. 5434. DISPLAY_IDENTIFIER LDP_AMP_MES_TI_ST_AMP_FAC FORMAT "%7.2" /end AXIS_PTS
/begin MEASUREMENT ti_cast "Cold post start injection time correction" UWORD _CNV_A_R_LINEAR_____125_CM 1 100. 0. 4. DISPLAY_IDENTIFIER TI_CAST ECU_ADDRESS 0x3fd52e BYTE_ORDER MSB_LAST FORMAT "%6.4" /end MEASUREMENT
/begin CHARACTERISTIC ip_ti_deac_cast__cyc_cast__tco "Deactivation factor of post start enrichment" MAP 0x0763f _REC_MAP_20_u1_u2_u1 9.960940000000002e-002 _CNV_A_R_LINEAR_____50_CM 0. 0.996094 DISPLAY_IDENTIFIER IP_TI_DEAC_CAST__CYC_CAST__TCO FORMAT "%5.3"
 /begin AXIS_DESCR COM_AXIS cyc_cast _CNV_A_R_LINEAR_____1_CM 8 0. 65535. FORMAT "%5.0" AXIS_PTS_REF ldp_cyc_cast_ip_ti_deac_cast /end AXIS_DESCR
 /begin AXIS_DESCR COM_AXIS tco _CNV_A_R_LINEAR_____12_CM 10 -48. 142.5 FORMAT "%5.1" AXIS_PTS_REF ldpm_tco__mff_deac_cst /end AXIS_DESCR
/end CHARACTERISTIC
/begin MEASUREMENT lv_ast_end "logical bit for \"After-start end\"" UBYTE _CNV_S_2_RANGE______0_CM 1 100. 0. 1. DISPLAY_IDENTIFIER LV_AST_END ECU_ADDRESS 0x3fe371 BIT_MASK 0x1 /end MEASUREMENT
/begin AXIS_PTS ldp_cyc_cast_ip_ti_deac_cast "" 0x109f4 cyc_cast _REC_AXS_20_u2 65535. _CNV_A_R_LINEAR_____1_CM 8 0. 65535. DISPLAY_IDENTIFIER LDP_CYC_CAST_IP_TI_DEAC_CAST FORMAT "%5.0" /end AXIS_PTS
/begin AXIS_PTS ldp_tia_ip_ti_cast "" 0x01220 tia _REC_AXS_20_u1 28.575 _CNV_A_R_LINEAR_____12_CM 2 -48. 142.5 DISPLAY_IDENTIFIER LDP_TIA_IP_TI_CAST FORMAT "%5.1" /end AXIS_PTS
/begin AXIS_PTS ldp_fac_cor_ti_cast "" 0x00fb5 online_dummy _REC_AXS_20_u1 0.298830003 _CNV_A_R_LINEAR_____39_CM 4 0. 1.99220002 DISPLAY_IDENTIFIER LDP_FAC_COR_TI_CAST FORMAT "%5.3" /end AXIS_PTS
/begin AXIS_PTS ldp_map__ti_cast_fac_map "" 0x10dd4 map _REC_AXS_20_u2 815.1 _CNV_A_R_LINEAR_____49_CM 6 0. 5434. DISPLAY_IDENTIFIER LDP_MAP__TI_CAST_FAC_MAP FORMAT "%7.2" /end AXIS_PTS
/begin CHARACTERISTIC ip_ti_cast__tia__tco "Initialization value of post start enrichment factor" MAP 0x07603 _REC_MAP_20_u1_u1_u1 0.3984375 _CNV_A_R_LINEAR_____127_CM 0. 3.984375 DISPLAY_IDENTIFIER IP_TI_CAST__TIA__TCO FORMAT "%4.2"
 /begin AXIS_DESCR COM_AXIS tia _CNV_A_R_LINEAR_____12_CM 2 -48. 142.5 FORMAT "%5.1" AXIS_PTS_REF ldp_tia_ip_ti_cast /end AXIS_DESCR
 /begin AXIS_DESCR COM_AXIS tco _CNV_A_R_LINEAR_____12_CM 10 -48. 142.5 FORMAT "%5.1" AXIS_PTS_REF ldpm_tco__mff_deac_cst /end AXIS_DESCR
/end CHARACTERISTIC
/begin AXIS_PTS ldpm_tco__mff_deac_cst "" 0x081e5 tco _REC_AXS_20_u1 19.05 _CNV_A_R_LINEAR_____12_CM 10 -48. 142.5 DISPLAY_IDENTIFIER LDPM_TCO__MFF_DEAC_CST FORMAT "%5.1" /end AXIS_PTS
/begin CHARACTERISTIC ip_ti_cast_fac_tco "" MAP 0x07617 _REC_MAP_20_u1_u1_u1 0.199220002 _CNV_A_R_LINEAR_____39_CM 0. 1.99220002 DISPLAY_IDENTIFIER IP_TI_CAST_FAC_TCO FORMAT "%5.3"
 /begin AXIS_DESCR COM_AXIS online_dummy _CNV_A_R_LINEAR_____39_CM 4 0. 1.99220002 FORMAT "%5.3" AXIS_PTS_REF ldp_fac_cor_ti_cast /end AXIS_DESCR
 /begin AXIS_DESCR COM_AXIS tco _CNV_A_R_LINEAR_____12_CM 10 -48. 142.5 FORMAT "%5.1" AXIS_PTS_REF ldpm_tco__mff_deac_cst /end AXIS_DESCR
/end CHARACTERISTIC
/begin CHARACTERISTIC ip_ti_cast_fac_map "" CURVE 0x00e47 _REC_CUR_20_u1_u2 9.960940000000002e-002 _CNV_A_R_LINEAR_____50_CM 0. 0.996094 DISPLAY_IDENTIFIER IP_TI_CAST_FAC_MAP FORMAT "%5.3"
 /begin AXIS_DESCR COM_AXIS map _CNV_A_R_LINEAR_____49_CM 6 0. 5434. FORMAT "%7.2" AXIS_PTS_REF ldp_map__ti_cast_fac_map /end AXIS_DESCR
/end CHARACTERISTIC
/begin MEASUREMENT mff_sp "Mass fuel flow setpoint after combustion selection" UWORD _CNV_A_R_LINEAR_____106_CM 1 100. 0. 1389. DISPLAY_IDENTIFIER MFF_SP ECU_ADDRESS 0x3fd536 BYTE_ORDER MSB_LAST FORMAT "%7.2" /end MEASUREMENT
/begin MEASUREMENT ti_add_dly "Injector dead time correction" SWORD _CNV_A_R_LINEAR_____198_CM 1 100. -131.072 131.068 DISPLAY_IDENTIFIER TI_ADD_DLY ECU_ADDRESS 0x3fd538 BYTE_ORDER MSB_LAST FORMAT "%8.3" /end MEASUREMENT
/begin CHARACTERISTIC ip_ti_add_dly "Injector dead time correction" MAP 0x0f3ee _REC_MAP_20_u2_u1_u2 26.214 _CNV_A_R_LINEAR_____439_CM -131.072 131.068 DISPLAY_IDENTIFIER IP_TI_ADD_DLY FORMAT "%6.2"
 /begin AXIS_DESCR COM_AXIS vb _CNV_A_R_LINEAR_____34_CM 8 0. 25.8984 FORMAT "%3.1" AXIS_PTS_REF ldp_vb__ti_add_dly /end AXIS_DESCR
 /begin AXIS_DESCR COM_AXIS fup _CNV_A_R_LINEAR_____199_CM 6 0. 173888. FORMAT "%6.0" AXIS_PTS_REF ldp_fup_map_dif__ti_add_dly /end AXIS_DESCR
/end CHARACTERISTIC
/begin AXIS_PTS ldp_vb__ti_add_dly "" 0x07ed2 vb _REC_AXS_20_u1 3.107808 _CNV_A_R_LINEAR_____34_CM 8 0. 25.8984 DISPLAY_IDENTIFIER LDP_VB__TI_ADD_DLY FORMAT "%3.1" /end AXIS_PTS
/begin AXIS_PTS ldp_fup_map_dif__ti_add_dly "Injector dead time correction" 0x10aec fup _REC_AXS_20_u2 17388.8 _CNV_A_R_LINEAR_____199_CM 6 0. 173888. DISPLAY_IDENTIFIER LDP_FUP_MAP_DIF__TI_ADD_DLY FORMAT "%6.0" /end AXIS_PTS
/begin CHARACTERISTIC c_eoi_lim "Latest possible EOI" VALUE 0x01556 _REC_VAL_20_u2 720. _CNV_A_R_LINEAR_____82_CM 0. 720. DISPLAY_IDENTIFIER C_EOI_LIM FORMAT "%6.2" /end CHARACTERISTIC
/begin MEASUREMENT soi_hom "start of injection for homogeneous combustion mode" UWORD _CNV_A_R_LINEAR_____82_CM 1 100. 0. 720. DISPLAY_IDENTIFIER SOI_HOM ECU_ADDRESS 0x3fd54a BYTE_ORDER MSB_LAST FORMAT "%6.2" /end MEASUREMENT
/begin MEASUREMENT eoi_hom_clc "calculated end of injection for homogeneous combustion mode" UWORD _CNV_A_R_LINEAR_____82_CM 1 100. 0. 720. DISPLAY_IDENTIFIER EOI_HOM_CLC ECU_ADDRESS 0x3fd56a BYTE_ORDER MSB_LAST FORMAT "%6.2" /end MEASUREMENT
/begin MEASUREMENT eoi_tco "Temperature correction for end of injection" UWORD _CNV_A_R_LINEAR_____82_CM 1 100. 0. 720. DISPLAY_IDENTIFIER EOI_TCO ECU_ADDRESS 0x3fd56c BYTE_ORDER MSB_LAST FORMAT "%6.2" /end MEASUREMENT
/begin MEASUREMENT ti_hom_max_cst "Maximum injection time to fulfill required C_SOI_MIN_CST_H_PRS / C_SOI_MIN_CST_L_PRS" UWORD _CNV_A_R_LINEAR_____198_CM 1 100. 0. 262.14 DISPLAY_IDENTIFIER TI_HOM_MAX_CST ECU_ADDRESS 0x3fd54c BYTE_ORDER MSB_LAST FORMAT "%7.3" /end MEASUREMENT
/begin CHARACTERISTIC lc_eoi_hom_man "switch for using the manual setpoint for EOI" VALUE 0x00f22 _REC_VAL_20_u1 1. _CNV_S_2_RANGE______5_CM 0. 1. DISPLAY_IDENTIFIER LC_EOI_HOM_MAN /end CHARACTERISTIC
/begin CHARACTERISTIC c_eoi_hom_man "manual setpoint for EOI" VALUE 0x01554 _REC_VAL_20_u2 720. _CNV_A_R_LINEAR_____82_CM 0. 720. DISPLAY_IDENTIFIER C_EOI_HOM_MAN FORMAT "%6.2" /end CHARACTERISTIC
/begin CHARACTERISTIC c_soi_min_cst_l_prs "minimum start of injection angle during low pressure start" VALUE 0x01790 _REC_VAL_20_u2 720. _CNV_A_R_LINEAR_____82_CM 0. 720. DISPLAY_IDENTIFIER C_SOI_MIN_CST_L_PRS FORMAT "%6.2" /end CHARACTERISTIC
/begin CHARACTERISTIC c_soi_min_cst_h_prs "minimum start of injection angle during high pressure start" VALUE 0x0178e _REC_VAL_20_u2 720. _CNV_A_R_LINEAR_____82_CM 0. 720. DISPLAY_IDENTIFIER C_SOI_MIN_CST_H_PRS FORMAT "%6.2" /end CHARACTERISTIC
/begin CHARACTERISTIC ip_eoi_tco "Coolant temperature correction EOI" CURVE 0x0aa26 _REC_CUR_20_u2_u1 720. _CNV_A_R_LINEAR_____82_CM 0. 720. DISPLAY_IDENTIFIER IP_EOI_TCO FORMAT "%6.2"
 /begin AXIS_DESCR COM_AXIS tco _CNV_A_R_LINEAR_____12_CM 8 -48. 142.5 FORMAT "%5.1" AXIS_PTS_REF ldpm_tco__eoi_tco /end AXIS_DESCR
/end CHARACTERISTIC
/begin MEASUREMENT eoi_bas "Basic map end of injection versus engine speed and injection time" UWORD _CNV_A_R_LINEAR_____82_CM 1 100. 0. 720. DISPLAY_IDENTIFIER EOI_BAS ECU_ADDRESS 0x3fd568 BYTE_ORDER MSB_LAST FORMAT "%6.2" /end MEASUREMENT
/begin CHARACTERISTIC c_eoi_as "EOI-correction of application system" VALUE 0x003ee _REC_VAL_20_s2 1440. _CNV_A_R_LINEAR_____82_CM -720. 720. DISPLAY_IDENTIFIER C_EOI_AS FORMAT "%6.1" /end CHARACTERISTIC
/begin CHARACTERISTIC lc_eoi_cor_ivvt_vvl "switch to activate (1) or deactivate (0) the EOI-correction for inlet-CWM-position and variable valve lift" VALUE 0x00f21 _REC_VAL_20_u1 1. _CNV_A_R_LINEAR_____1_CM 0. 1. DISPLAY_IDENTIFIER LC_EOI_COR_IVVT_VVL FORMAT "%2.0" /end CHARACTERISTIC
/begin CHARACTERISTIC ip_cam_op_in_vvl__vlft_av "inlet valve opening angle vs. actual inlet valve lift" CURVE 0x08ca8 _REC_CUR_20_u2_u2 1535.9765625 _CNV_A_R_LINEAR_____347_CM -768. 767.9765625 DISPLAY_IDENTIFIER IP_CAM_OP_IN_VVL__VLFT_AV FORMAT "%7.2"
 /begin AXIS_DESCR COM_AXIS online_dummy _CNV_A_R_LINEAR_____441_CM 6 0. 65.535 AXIS_PTS_REF ldp_vlft_av__cam_op_in_vvl /end AXIS_DESCR
/end CHARACTERISTIC
/begin MEASUREMENT eoi_lim "latest possible EOI" UWORD _CNV_A_R_LINEAR_____82_CM 1 100. 0. 720. DISPLAY_IDENTIFIER EOI_LIM ECU_ADDRESS 0x3fd54e BYTE_ORDER MSB_LAST FORMAT "%6.2" /end MEASUREMENT
/begin MEASUREMENT cam_op_in_vvl "actual value inlet valve opening angle" SWORD _CNV_A_R_LINEAR_____227_CM 1 100. -768. 767.9765625 DISPLAY_IDENTIFIER CAM_OP_IN_VVL ECU_ADDRESS 0x3fd570 BYTE_ORDER MSB_LAST FORMAT "%7.2" /end MEASUREMENT
/begin MEASUREMENT eoi_ivvt_vvl "Correction for inlet-CAM-position and inlet valve opening angle" UWORD _CNV_A_R_LINEAR_____82_CM 1 100. 0. 720. DISPLAY_IDENTIFIER EOI_IVVT_VVL ECU_ADDRESS 0x3fd572 BYTE_ORDER MSB_LAST FORMAT "%6.2" /end MEASUREMENT
/begin AXIS_PTS ldp_vlft_av__cam_op_in_vvl "" 0x114e4 online_dummy _REC_AXS_20_u2 65.535 _CNV_A_R_LINEAR_____441_CM 6 0. 65.535 DISPLAY_IDENTIFIER LDP_VLFT_AV__CAM_OP_IN_VVL /end AXIS_PTS
/begin CHARACTERISTIC ip_eoi_bas "Basic map end of injection" MAP 0x0a85e _REC_MAP_20_u2_u1_u2 720. _CNV_A_R_LINEAR_____82_CM 0. 720. DISPLAY_IDENTIFIER IP_EOI_BAS FORMAT "%6.2"
 /begin AXIS_DESCR COM_AXIS n_32 _CNV_A_R_LINEAR_____16_CM 12 0. 8160. FORMAT "%4.0" AXIS_PTS_REF ldp_n_32__eoi_bas /end AXIS_DESCR
 /begin AXIS_DESCR COM_AXIS ti_hom_1 _CNV_A_R_LINEAR_____198_CM 10 0. 262.14 FORMAT "%7.3" AXIS_PTS_REF ldp_ti_hom__eoi_bas /end AXIS_DESCR
/end CHARACTERISTIC
/begin CHARACTERISTIC ip_eoi_bas_is "Basic map end of injection" MAP 0x0a94e _REC_MAP_20_u2_u1_u2 720. _CNV_A_R_LINEAR_____82_CM 0. 720. DISPLAY_IDENTIFIER IP_EOI_BAS_IS FORMAT "%6.2"
 /begin AXIS_DESCR COM_AXIS n_32 _CNV_A_R_LINEAR_____16_CM 6 0. 8160. FORMAT "%4.0" AXIS_PTS_REF ldp_n_32__eoi_bas_is /end AXIS_DESCR
 /begin AXIS_DESCR COM_AXIS ti_hom_1 _CNV_A_R_LINEAR_____198_CM 6 0. 262.14 FORMAT "%7.3" AXIS_PTS_REF ldp_ti_hom__eoi_bas_is /end AXIS_DESCR
/end CHARACTERISTIC
/begin AXIS_PTS ldp_n_32__eoi_bas "" 0x07bc0 n_32 _REC_AXS_20_u1 816. _CNV_A_R_LINEAR_____16_CM 12 0. 8160. DISPLAY_IDENTIFIER LDP_N_32__EOI_BAS FORMAT "%4.0" /end AXIS_PTS
/begin AXIS_PTS ldp_n_32__eoi_bas_is "" 0x0101d n_32 _REC_AXS_20_u1 816. _CNV_A_R_LINEAR_____16_CM 6 0. 8160. DISPLAY_IDENTIFIER LDP_N_32__EOI_BAS_IS FORMAT "%4.0" /end AXIS_PTS
/begin AXIS_PTS ldp_ti_hom__eoi_bas "" 0x11218 ti_hom_1 _REC_AXS_20_u2 26.214 _CNV_A_R_LINEAR_____198_CM 10 0. 262.14 DISPLAY_IDENTIFIER LDP_TI_HOM__EOI_BAS FORMAT "%7.3" /end AXIS_PTS
/begin AXIS_PTS ldp_ti_hom__eoi_bas_is "" 0x1122e ti_hom_1 _REC_AXS_20_u2 26.214 _CNV_A_R_LINEAR_____198_CM 6 0. 262.14 DISPLAY_IDENTIFIER LDP_TI_HOM__EOI_BAS_IS FORMAT "%7.3" /end AXIS_PTS
/begin CHARACTERISTIC ip_ti_st_rest "Cold start reduction factor in case of re-start with no engine stop time T_ES available" CURVE 0x00e56 _REC_CUR_20_u1_u1 0.199220002 _CNV_A_R_LINEAR_____29_CM 0. 0.99610001 DISPLAY_IDENTIFIER IP_TI_ST_REST FORMAT "%5.3"
 /begin AXIS_DESCR COM_AXIS tco _CNV_A_R_LINEAR_____12_CM 8 -48. 142.5 FORMAT "%5.1" AXIS_PTS_REF ldpm_tco__ti_st_rest /end AXIS_DESCR
/end CHARACTERISTIC
/begin CHARACTERISTIC ip_rest "Considering the shut-off time for re-start calculation" CURVE 0x00da7 _REC_CUR_20_u1_u2 0.199220002 _CNV_A_R_LINEAR_____29_CM 0. 0.99610001 DISPLAY_IDENTIFIER IP_REST FORMAT "%5.3"
 /begin AXIS_DESCR COM_AXIS t_es _CNV_A_R_LINEAR_____97_CM 8 0. 65535. FORMAT "%5.0" AXIS_PTS_REF ldp_t_es__rest /end AXIS_DESCR
/end CHARACTERISTIC
/begin CHARACTERISTIC ip_fac_rest "Considering coolant stop temperature and after start time for re-start calculation" MAP 0x052ba _REC_MAP_20_u1_u2_u1 0.199220002 _CNV_A_R_LINEAR_____29_CM 0. 0.99610001 DISPLAY_IDENTIFIER IP_FAC_REST FORMAT "%5.3"
 /begin AXIS_DESCR COM_AXIS t_ast_rest _CNV_A_R_LINEAR_____24_CM 8 0. 6553.5 FORMAT "%6.1" AXIS_PTS_REF ldp_t_ast_rest /end AXIS_DESCR
 /begin AXIS_DESCR COM_AXIS tco_stop _CNV_A_R_LINEAR_____12_CM 8 -48. 142.5 FORMAT "%5.1" AXIS_PTS_REF ldp_tco_stop__fac_rest /end AXIS_DESCR
/end CHARACTERISTIC
/begin CHARACTERISTIC ip_fac_stall "Special cold start reduction factor in case of re-start after engine stall out" CURVE 0x00b74 _REC_CUR_20_u1_u1 0.199220002 _CNV_A_R_LINEAR_____29_CM 0. 0.99610001 DISPLAY_IDENTIFIER IP_FAC_STALL FORMAT "%5.3"
 /begin AXIS_DESCR COM_AXIS tco _CNV_A_R_LINEAR_____12_CM 8 -48. 142.5 FORMAT "%5.1" AXIS_PTS_REF ldpm_tco__fac_stall /end AXIS_DESCR
/end CHARACTERISTIC
/begin AXIS_PTS ldpm_tco__ti_st_rest "" 0x081f9 tco _REC_AXS_20_u1 28.575 _CNV_A_R_LINEAR_____12_CM 8 -48. 142.5 DISPLAY_IDENTIFIER LDPM_TCO__TI_ST_REST FORMAT "%5.1" /end AXIS_PTS
/begin AXIS_PTS ldp_tco_stop__fac_rest "" 0x07e42 tco_stop _REC_AXS_20_u1 28.575 _CNV_A_R_LINEAR_____12_CM 8 -48. 142.5 DISPLAY_IDENTIFIER LDP_TCO_STOP__FAC_REST FORMAT "%5.1" /end AXIS_PTS
/begin AXIS_PTS ldpm_tco__fac_stall "" 0x081d3 tco _REC_AXS_20_u1 28.575 _CNV_A_R_LINEAR_____12_CM 8 -48. 142.5 DISPLAY_IDENTIFIER LDPM_TCO__FAC_STALL FORMAT "%5.1" /end AXIS_PTS
/begin AXIS_PTS ldp_t_es__rest "" 0x1119a t_es _REC_AXS_20_u2 9830.25 _CNV_A_R_LINEAR_____97_CM 8 0. 65535. DISPLAY_IDENTIFIER LDP_T_ES__REST FORMAT "%5.0" /end AXIS_PTS
/begin AXIS_PTS ldp_t_ast_rest "" 0x1117a t_ast_rest _REC_AXS_20_u2 983.025 _CNV_A_R_LINEAR_____24_CM 8 0. 6553.5 DISPLAY_IDENTIFIER LDP_T_AST_REST FORMAT "%6.1" /end AXIS_PTS
/begin CHARACTERISTIC ip_ti_wup__n__maf "TI warm up correction" MAP 0x0794b _REC_MAP_20_u1_u1_u1 0.1494141 _CNV_A_R_LINEAR_____50_CM 0. 0.996094 DISPLAY_IDENTIFIER IP_TI_WUP__N__MAF FORMAT "%5.3"
 /begin AXIS_DESCR COM_AXIS maf _CNV_A_R_LINEAR_____27_CM 8 0. 1389. FORMAT "%4.0" AXIS_PTS_REF ldpm_maf_hb__ti_wup /end AXIS_DESCR
 /begin AXIS_DESCR COM_AXIS n_32 _CNV_A_R_LINEAR_____16_CM 8 0. 8160. FORMAT "%4.0" AXIS_PTS_REF ldpm_n_32__ti_wup /end AXIS_DESCR
/end CHARACTERISTIC
/begin MEASUREMENT ti_wup_1 "Warm-up enrichment part, intermediate value" UWORD _CNV_A_R_LINEAR_____125_CM 1 100. 0. 4. DISPLAY_IDENTIFIER TI_WUP_1 ECU_ADDRESS 0x3fd596 BYTE_ORDER MSB_LAST FORMAT "%6.4" /end MEASUREMENT
/begin MEASUREMENT ti_wup "Warm-up injection time correction" UWORD _CNV_A_R_LINEAR_____125_CM 1 100. 0. 4. DISPLAY_IDENTIFIER TI_WUP ECU_ADDRESS 0x3fd594 BYTE_ORDER MSB_LAST FORMAT "%6.4" /end MEASUREMENT
/begin MEASUREMENT ti_temp "Warm-up enrichment part, intermediate, permanent part" UWORD _CNV_A_R_LINEAR_____125_CM 1 100. 0. 4. DISPLAY_IDENTIFIER TI_TEMP ECU_ADDRESS 0x3fd598 BYTE_ORDER MSB_LAST FORMAT "%6.4" /end MEASUREMENT
/begin CHARACTERISTIC ip_ti_tco_wup__tco__tco_st "TCO/TCO_ST-dependent warm up correction" MAP 0x078f3 _REC_MAP_20_u1_u1_u1 0.199220002 _CNV_A_R_LINEAR_____39_CM 0. 1.99220002 DISPLAY_IDENTIFIER IP_TI_TCO_WUP__TCO__TCO_ST FORMAT "%5.3"
 /begin AXIS_DESCR COM_AXIS tco_st _CNV_A_R_LINEAR_____12_CM 3 -48. 142.5 FORMAT "%5.1" AXIS_PTS_REF ldp_tco_st__ti_tco_wup /end AXIS_DESCR
 /begin AXIS_DESCR COM_AXIS tco _CNV_A_R_LINEAR_____12_CM 8 -48. 142.5 FORMAT "%5.1" AXIS_PTS_REF ldpm_tco__ti_wup /end AXIS_DESCR
/end CHARACTERISTIC
/begin CHARACTERISTIC ip_ti_vo_wup__tco__vo "TCO/VO dependent warm up correction" MAP 0x0790b _REC_MAP_20_u1_u1_u1 0.1 _CNV_A_R_LINEAR_____115_CM 0.5 1.5 DISPLAY_IDENTIFIER IP_TI_VO_WUP__TCO__VO FORMAT "%5.3"
 /begin AXIS_DESCR COM_AXIS vo _CNV_A_R_LINEAR_____82_CM 8 0. 95.625 FORMAT "%5.2" AXIS_PTS_REF ldp_vo__ti_vo_wup /end AXIS_DESCR
 /begin AXIS_DESCR COM_AXIS tco _CNV_A_R_LINEAR_____12_CM 8 -48. 142.5 FORMAT "%5.1" AXIS_PTS_REF ldpm_tco__ti_wup /end AXIS_DESCR
/end CHARACTERISTIC
/begin CHARACTERISTIC ip_ti_fac_n_map "Injection time weighting for temperature influence f(operating point)" MAP 0x0768f _REC_MAP_20_u1_u2_u1 9.9610001e-002 _CNV_A_R_LINEAR_____29_CM 0. 0.99610001 DISPLAY_IDENTIFIER IP_TI_FAC_N_MAP FORMAT "%5.3"
 /begin AXIS_DESCR COM_AXIS map _CNV_A_R_LINEAR_____49_CM 8 0. 5434. FORMAT "%7.2" AXIS_PTS_REF ldp_map__ti_fac_n_map /end AXIS_DESCR
 /begin AXIS_DESCR COM_AXIS n_32 _CNV_A_R_LINEAR_____16_CM 8 0. 8160. FORMAT "%4.0" AXIS_PTS_REF ldp_n_32__ti_fac_n_map /end AXIS_DESCR
/end CHARACTERISTIC
/begin CHARACTERISTIC ip_ti_fac_tia_toil "Injection time weighting for temperature influence f(TIA, TOIL)" MAP 0x077cf _REC_MAP_20_u1_u1_u1 0.199220002 _CNV_A_R_LINEAR_____39_CM 0. 1.99220002 DISPLAY_IDENTIFIER IP_TI_FAC_TIA_TOIL FORMAT "%5.3"
 /begin AXIS_DESCR COM_AXIS tia _CNV_A_R_LINEAR_____12_CM 6 -48. 142.5 FORMAT "%5.1" AXIS_PTS_REF ldp_tia_ti_fac_tia_toil /end AXIS_DESCR
 /begin AXIS_DESCR COM_AXIS toil _CNV_A_R_LINEAR_____15_CM 6 -40. 160. FORMAT "%3.0" AXIS_PTS_REF ldp_toil_ti_fac_tia_toil /end AXIS_DESCR
/end CHARACTERISTIC
/begin CHARACTERISTIC ip_ti_fac_tco "Injection time weighting for temperature influence f(coolant temperature)" CURVE 0x00e4d _REC_CUR_20_u1_u1 9.9610001e-002 _CNV_A_R_LINEAR_____29_CM 0. 0.99610001 DISPLAY_IDENTIFIER IP_TI_FAC_TCO FORMAT "%5.3"
 /begin AXIS_DESCR COM_AXIS tco _CNV_A_R_LINEAR_____12_CM 3 -48. 142.5 FORMAT "%5.1" AXIS_PTS_REF ldp_tco__ti_fac_tco /end AXIS_DESCR
/end CHARACTERISTIC
/begin AXIS_PTS ldpm_maf_hb__ti_wup "" 0x07fa8 maf _REC_AXS_20_u1 1389. _CNV_A_R_LINEAR_____27_CM 8 0. 1389. DISPLAY_IDENTIFIER LDPM_MAF_HB__TI_WUP FORMAT "%4.0" /end AXIS_PTS
/begin AXIS_PTS ldpm_tco__ti_wup "" 0x08202 tco _REC_AXS_20_u1 190.5 _CNV_A_R_LINEAR_____12_CM 8 -48. 142.5 DISPLAY_IDENTIFIER LDPM_TCO__TI_WUP FORMAT "%5.1" /end AXIS_PTS
/begin AXIS_PTS ldp_tco_st__ti_tco_wup "" 0x011a2 tco_st _REC_AXS_20_u1 190.5 _CNV_A_R_LINEAR_____12_CM 3 -48. 142.5 DISPLAY_IDENTIFIER LDP_TCO_ST__TI_TCO_WUP FORMAT "%5.1" /end AXIS_PTS
/begin AXIS_PTS ldp_vo__ti_vo_wup "" 0x07ee4 vo _REC_AXS_20_u1 95.625 _CNV_A_R_LINEAR_____82_CM 8 0. 95.625 DISPLAY_IDENTIFIER LDP_VO__TI_VO_WUP FORMAT "%5.2" /end AXIS_PTS
/begin AXIS_PTS ldpm_n_32__ti_wup "" 0x080a4 n_32 _REC_AXS_20_u1 8160. _CNV_A_R_LINEAR_____16_CM 8 0. 8160. DISPLAY_IDENTIFIER LDPM_N_32__TI_WUP FORMAT "%4.0" /end AXIS_PTS
/begin AXIS_PTS ldp_map_dif__fac_ti_vo_wup "" 0x10df4 online_dummy _REC_AXS_20_u2 5434. _CNV_A_R_LINEAR_____49_CM 8 0. 5434. DISPLAY_IDENTIFIER LDP_MAP_DIF__FAC_TI_VO_WUP FORMAT "%7.2" /end AXIS_PTS
/begin AXIS_PTS ldp_map__ti_fac_n_map "" 0x10de2 map _REC_AXS_20_u2 5434. _CNV_A_R_LINEAR_____49_CM 8 0. 5434. DISPLAY_IDENTIFIER LDP_MAP__TI_FAC_N_MAP FORMAT "%7.2" /end AXIS_PTS
/begin AXIS_PTS ldp_n_32__ti_fac_n_map "" 0x07c52 n_32 _REC_AXS_20_u1 8160. _CNV_A_R_LINEAR_____16_CM 8 0. 8160. DISPLAY_IDENTIFIER LDP_N_32__TI_FAC_N_MAP FORMAT "%4.0" /end AXIS_PTS
/begin AXIS_PTS ldp_toil_ti_fac_tia_toil "" 0x0124e toil _REC_AXS_20_u1 200. _CNV_A_R_LINEAR_____15_CM 6 -40. 160. DISPLAY_IDENTIFIER LDP_TOIL_TI_FAC_TIA_TOIL FORMAT "%3.0" /end AXIS_PTS
/begin AXIS_PTS ldp_tia_ti_fac_tia_toil "" 0x0122a tia _REC_AXS_20_u1 190.5 _CNV_A_R_LINEAR_____12_CM 6 -48. 142.5 DISPLAY_IDENTIFIER LDP_TIA_TI_FAC_TIA_TOIL FORMAT "%5.1" /end AXIS_PTS
/begin AXIS_PTS ldp_tco__ti_fac_tco "" 0x01185 tco _REC_AXS_20_u1 190.5 _CNV_A_R_LINEAR_____12_CM 3 -48. 142.5 DISPLAY_IDENTIFIER LDP_TCO__TI_FAC_TCO FORMAT "%5.1" /end AXIS_PTS
/begin CHARACTERISTIC ip_fac_ti_vo_wup "Factor map for TCO/VO dependent warm up correction" MAP 0x054cc _REC_MAP_20_u1_u2_u1 0.199220002 _CNV_A_R_LINEAR_____39_CM 0. 1.99220002 DISPLAY_IDENTIFIER IP_FAC_TI_VO_WUP FORMAT "%5.3"
 /begin AXIS_DESCR COM_AXIS online_dummy _CNV_A_R_LINEAR_____49_CM 8 0. 5434. FORMAT "%7.2" AXIS_PTS_REF ldp_map_dif__fac_ti_vo_wup /end AXIS_DESCR
 /begin AXIS_DESCR COM_AXIS n_32 _CNV_A_R_LINEAR_____16_CM 8 0. 8160. FORMAT "%4.0" AXIS_PTS_REF ldpm_n_32__ti_wup /end AXIS_DESCR
/end CHARACTERISTIC
/begin CHARACTERISTIC ip_fac_ti_tco_wup "warm up basic factor" CURVE 0x00bd2 _REC_CUR_20_u1_u1 0.199220002 _CNV_A_R_LINEAR_____39_CM 0. 1.99220002 DISPLAY_IDENTIFIER IP_FAC_TI_TCO_WUP FORMAT "%5.3"
 /begin AXIS_DESCR COM_AXIS tco _CNV_A_R_LINEAR_____12_CM 8 -48. 142.5 FORMAT "%5.1" AXIS_PTS_REF ldpm_tco__ti_wup /end AXIS_DESCR
/end CHARACTERISTIC
/begin MEASUREMENT tps_sp_st "TPS setpoint at start" UWORD _CNV_A_R_LINEAR_____53_CM 1 100. 0. 119.5 DISPLAY_IDENTIFIER TPS_SP_ST ECU_ADDRESS 0x3fd7c4 BYTE_ORDER MSB_LAST FORMAT "%7.3" /end MEASUREMENT
/begin MEASUREMENT tps_rel_st "" UWORD _CNV_A_R_LINEAR_____9_CM 1 100. 0. 99.99847412 DISPLAY_IDENTIFIER TPS_REL_ST ECU_ADDRESS 0x3fd7c6 BYTE_ORDER MSB_LAST /end MEASUREMENT
/begin CHARACTERISTIC ip_tps_rel_st_at "Specified relative TPS setpoint at start" MAP 0x0f59a _REC_MAP_20_u2_u2_u1 99.99847412 _CNV_A_R_LINEAR_____9_CM 0. 99.99847412 DISPLAY_IDENTIFIER IP_TPS_REL_ST_AT
 /begin AXIS_DESCR COM_AXIS n _CNV_A_R_LINEAR_____11_CM 8 0. 8160. FORMAT "%4.0" AXIS_PTS_REF ldpm_n_1_thro /end AXIS_DESCR
 /begin AXIS_DESCR COM_AXIS tco _CNV_A_R_LINEAR_____12_CM 8 -48. 142.5 FORMAT "%5.1" AXIS_PTS_REF ldpm_tco_1_thro /end AXIS_DESCR
/end CHARACTERISTIC
/begin CHARACTERISTIC ip_tps_rel_st_mt "Specified relative TPS setpoint at start" MAP 0x0f61a _REC_MAP_20_u2_u2_u1 99.99847412 _CNV_A_R_LINEAR_____9_CM 0. 99.99847412 DISPLAY_IDENTIFIER IP_TPS_REL_ST_MT
 /begin AXIS_DESCR COM_AXIS n _CNV_A_R_LINEAR_____11_CM 8 0. 8160. FORMAT "%4.0" AXIS_PTS_REF ldpm_n_1_thro /end AXIS_DESCR
 /begin AXIS_DESCR COM_AXIS tco _CNV_A_R_LINEAR_____12_CM 8 -48. 142.5 FORMAT "%5.1" AXIS_PTS_REF ldpm_tco_1_thro /end AXIS_DESCR
/end CHARACTERISTIC
/begin CHARACTERISTIC ip_tps_rel_st_pv "correction of the ralative TPS setpoint at start via driver's demand" CURVE 0x0f69a _REC_CUR_20_u2_u1 99.99847412 _CNV_A_R_LINEAR_____9_CM 0. 99.99847412 DISPLAY_IDENTIFIER IP_TPS_REL_ST_PV
 /begin AXIS_DESCR COM_AXIS pv_av _CNV_A_R_LINEAR_____10_CM 6 0. 99.609375 FORMAT "%4.1" AXIS_PTS_REF ldp_pv_av_ip_tps_sp_st_pv /end AXIS_DESCR
/end CHARACTERISTIC
/begin CHARACTERISTIC ip_fac_amp_tps_rel_st "Altitude correction of the relative TPS setpoint at start" MAP 0x04c2e _REC_MAP_20_u1_u2_u2 1.99220002 _CNV_A_R_LINEAR_____39_CM 0. 1.99220002 DISPLAY_IDENTIFIER IP_FAC_AMP_TPS_REL_ST FORMAT "%5.3"
 /begin AXIS_DESCR COM_AXIS n _CNV_A_R_LINEAR_____11_CM 8 0. 8160. FORMAT "%4.0" AXIS_PTS_REF ldpm_n_1_thro /end AXIS_DESCR
 /begin AXIS_DESCR COM_AXIS amp _CNV_A_R_LINEAR_____49_CM 6 0. 5434. FORMAT "%7.2" AXIS_PTS_REF ldp_amp_ip_tps_sp_st_amp /end AXIS_DESCR
/end CHARACTERISTIC
/begin CHARACTERISTIC ip_tps_sp_st "TPS setpoint at start" MAP 0x0f7a2 _REC_MAP_20_u2_u2_u2 119.5 _CNV_A_R_LINEAR_____447_CM 0. 119.5 DISPLAY_IDENTIFIER IP_TPS_SP_ST FORMAT "%7.3"
 /begin AXIS_DESCR COM_AXIS n _CNV_A_R_LINEAR_____11_CM 8 0. 8160. FORMAT "%4.0" AXIS_PTS_REF ldpm_n_1_thro /end AXIS_DESCR
 /begin AXIS_DESCR COM_AXIS tps_rel_st _CNV_A_R_LINEAR_____9_CM 12 0. 99.99847412 AXIS_PTS_REF ldp_tps_rel_st_ip_tps_sp_st /end AXIS_DESCR
/end CHARACTERISTIC
/begin CHARACTERISTIC ip_fac_tia_tps_rel_st "TIA correction of the relative TPS setpoint at start" CURVE 0x00be6 _REC_CUR_20_u1_u1 1.99220002 _CNV_A_R_LINEAR_____39_CM 0. 1.99220002 DISPLAY_IDENTIFIER IP_FAC_TIA_TPS_REL_ST FORMAT "%5.3"
 /begin AXIS_DESCR COM_AXIS tia _CNV_A_R_LINEAR_____12_CM 6 -48. 142.5 FORMAT "%5.1" AXIS_PTS_REF ldp_tia_ip_fac_tia_tps_sp_st /end AXIS_DESCR
/end CHARACTERISTIC
/begin AXIS_PTS ldp_pv_av_ip_tps_sp_st_pv "" 0x010f7 pv_av _REC_AXS_20_u1 99.609375 _CNV_A_R_LINEAR_____10_CM 6 0. 99.609375 DISPLAY_IDENTIFIER LDP_PV_AV_IP_TPS_SP_ST_PV FORMAT "%4.1" /end AXIS_PTS
/begin AXIS_PTS ldp_tia_ip_fac_tia_tps_sp_st "" 0x01219 tia _REC_AXS_20_u1 190.5 _CNV_A_R_LINEAR_____12_CM 6 -48. 142.5 DISPLAY_IDENTIFIER LDP_TIA_IP_FAC_TIA_TPS_SP_ST FORMAT "%5.1" /end AXIS_PTS
/begin AXIS_PTS ldp_amp_ip_tps_sp_st_amp "" 0x108ec amp _REC_AXS_20_u2 5434. _CNV_A_R_LINEAR_____49_CM 6 0. 5434. DISPLAY_IDENTIFIER LDP_AMP_IP_TPS_SP_ST_AMP FORMAT "%7.2" /end AXIS_PTS
/begin AXIS_PTS ldp_tps_rel_st_ip_tps_sp_st "" 0x112b0 tps_rel_st _REC_AXS_20_u2 99.99847412 _CNV_A_R_LINEAR_____9_CM 12 0. 99.99847412 DISPLAY_IDENTIFIER LDP_TPS_REL_ST_IP_TPS_SP_ST /end AXIS_PTS
/begin MEASUREMENT tps_sp_pwl "Throttle position setpoint during post operating phase" UWORD _CNV_A_R_LINEAR_____53_CM 1 100. 0. 119.5 DISPLAY_IDENTIFIER TPS_SP_PWL ECU_ADDRESS 0x3fd7b2 BYTE_ORDER MSB_LAST FORMAT "%7.3" /end MEASUREMENT
/begin MEASUREMENT lv_tps_pwl "Bit for throttle position" UBYTE _CNV_S_2_RANGE______5_CM 1 100. 0. 1. DISPLAY_IDENTIFIER LV_TPS_PWL ECU_ADDRESS 0x3fe505 /end MEASUREMENT
/begin CHARACTERISTIC c_tps_sp_pwl_lgrd "Gradiant limitation TPS" VALUE 0x0195c _REC_VAL_20_u2 119.5 _CNV_A_R_LINEAR_____454_CM 0. 119.5 DISPLAY_IDENTIFIER C_TPS_SP_PWL_LGRD FORMAT "%7.3" /end CHARACTERISTIC
/begin CHARACTERISTIC c_tps_sp_pwl_up "Threshold opening after power latch" VALUE 0x0195e _REC_VAL_20_u2 119.5 _CNV_A_R_LINEAR_____53_CM 0. 119.5 DISPLAY_IDENTIFIER C_TPS_SP_PWL_UP FORMAT "%7.3" /end CHARACTERISTIC
/begin CHARACTERISTIC c_tps_sp_as_man "Throttle position setpoint manual" VALUE 0x01948 _REC_VAL_20_u2 119.5 _CNV_A_R_LINEAR_____53_CM 0. 119.5 DISPLAY_IDENTIFIER C_TPS_SP_AS_MAN FORMAT "%7.3" /end CHARACTERISTIC
/begin CHARACTERISTIC c_tps_sp_ext_adj_ena "Variable enabled for throttle position setpoint manual or about PV_AV" VALUE 0x008f7 _REC_VAL_20_u1 3. _CNV_A_R_LINEAR_____1_CM 0. 3. DISPLAY_IDENTIFIER C_TPS_SP_EXT_ADJ_ENA FORMAT "%2.0" /end CHARACTERISTIC
/begin CHARACTERISTIC c_pv_av_ext_adj_min "Min. threshold for external ajustment about PV_AV" VALUE 0x007a3 _REC_VAL_20_u1 99.609375 _CNV_A_R_LINEAR_____10_CM 0. 99.609375 DISPLAY_IDENTIFIER C_PV_AV_EXT_ADJ_MIN FORMAT "%4.1" /end CHARACTERISTIC
/begin CHARACTERISTIC ip_tps_sp_pwl "throttle position setpoint during post operating phase" CURVE 0x01b74 _REC_CUR_20_u2_u1 119.5 _CNV_A_R_LINEAR_____53_CM 0. 119.5 DISPLAY_IDENTIFIER IP_TPS_SP_PWL FORMAT "%7.3"
 /begin AXIS_DESCR COM_AXIS n_32 _CNV_A_R_LINEAR_____16_CM 4 0. 8160. FORMAT "%4.0" AXIS_PTS_REF ldp_n_32_tps_sp_pwl /end AXIS_DESCR
/end CHARACTERISTIC
/begin MEASUREMENT tps_sp_ext_adj "Throttle position setpint of external device" UWORD _CNV_A_R_LINEAR_____53_CM 1 100. 0. 119.5 DISPLAY_IDENTIFIER TPS_SP_EXT_ADJ ECU_ADDRESS 0x3fd7b0 BYTE_ORDER MSB_LAST FORMAT "%7.3" /end MEASUREMENT
/begin MEASUREMENT tps_sp_ext_adj_1 "Throttle position setpint of external device about PV_AV" UWORD _CNV_A_R_LINEAR_____53_CM 1 100. 0. 119.5 DISPLAY_IDENTIFIER TPS_SP_EXT_ADJ_1 ECU_ADDRESS 0x3fd7b4 BYTE_ORDER MSB_LAST FORMAT "%7.3" /end MEASUREMENT
/begin MEASUREMENT lv_tps_sp_ext_adj "Bit active for external input of throtle position setpoint" UBYTE _CNV_S_2_RANGE______0_CM 1 100. 0. 1. DISPLAY_IDENTIFIER LV_TPS_SP_EXT_ADJ ECU_ADDRESS 0x3fe504 /end MEASUREMENT
/begin MEASUREMENT lv_tps_sp_ext_adj_1 "Bit active for external input of throtle position setpoint for PV_AV setpoint" UBYTE _CNV_S_2_RANGE______0_CM 1 100. 0. 1. DISPLAY_IDENTIFIER LV_TPS_SP_EXT_ADJ_1 ECU_ADDRESS 0x3fe506 /end MEASUREMENT
/begin CHARACTERISTIC ip_tps_sp_ext_adj "external adjustment setpoint" CURVE 0x0f6b6 _REC_CUR_20_u2_u1 119.5 _CNV_A_R_LINEAR_____53_CM 0. 119.5 DISPLAY_IDENTIFIER IP_TPS_SP_EXT_ADJ FORMAT "%7.3"
 /begin AXIS_DESCR COM_AXIS pv_av _CNV_A_R_LINEAR_____10_CM 6 0. 99.609375 FORMAT "%4.1" AXIS_PTS_REF ldp_pv_av__tps_sp_ext /end AXIS_DESCR
/end CHARACTERISTIC
/begin MEASUREMENT tps_sp_es "Throttle position setpoint for engine stopped" UWORD _CNV_A_R_LINEAR_____53_CM 1 100. 0. 119.5 DISPLAY_IDENTIFIER TPS_SP_ES ECU_ADDRESS 0x3fd7ae BYTE_ORDER MSB_LAST FORMAT "%7.3" /end MEASUREMENT
/begin CHARACTERISTIC ip_tps_sp_es "Throttle position setpoint for engine stopped" CURVE 0x0f6a6 _REC_CUR_20_u2_u1 119.5 _CNV_A_R_LINEAR_____53_CM 0. 119.5 DISPLAY_IDENTIFIER IP_TPS_SP_ES FORMAT "%7.3"
 /begin AXIS_DESCR COM_AXIS tco _CNV_A_R_LINEAR_____12_CM 8 -48. 142.5 FORMAT "%5.1" AXIS_PTS_REF ldpm_tco_1_thro /end AXIS_DESCR
/end CHARACTERISTIC
/begin AXIS_PTS ldp_n_32_tps_sp_pwl "" 0x010b4 n_32 _REC_AXS_20_u1 816. _CNV_A_R_LINEAR_____16_CM 4 0. 8160. DISPLAY_IDENTIFIER LDP_N_32_TPS_SP_PWL FORMAT "%4.0" /end AXIS_PTS
/begin AXIS_PTS ldp_pv_av__tps_sp_ext "" 0x010e9 pv_av _REC_AXS_20_u1 99.609375 _CNV_A_R_LINEAR_____10_CM 6 0. 99.609375 DISPLAY_IDENTIFIER LDP_PV_AV__TPS_SP_EXT FORMAT "%4.1" /end AXIS_PTS
/begin CHARACTERISTIC c_t_mtc_isa_off "Active time periodThrottle position setpoint" VALUE 0x0082f _REC_VAL_20_u1 255. _CNV_A_R_LINEAR_____30_CM 0. 255. DISPLAY_IDENTIFIER C_T_MTC_ISA_OFF FORMAT "%3.0" /end CHARACTERISTIC
/begin AXIS_PTS ldpm_tco_1_thro "" 0x081a5 tco _REC_AXS_20_u1 190.5 _CNV_A_R_LINEAR_____12_CM 8 -48. 142.5 DISPLAY_IDENTIFIER LDPM_TCO_1_THRO FORMAT "%5.1" /end AXIS_PTS
/begin AXIS_PTS ldpm_n_32_100 "" 0x07ffc n_32 _REC_AXS_20_u1 8160. _CNV_A_R_LINEAR_____16_CM 16 0. 8160. DISPLAY_IDENTIFIER LDPM_N_32_100 FORMAT "%4.0" /end AXIS_PTS
/begin AXIS_PTS ldpm_maf_100 "" 0x116a2 maf _REC_AXS_20_u2 1389. _CNV_A_R_LINEAR_____106_CM 12 0. 1389. DISPLAY_IDENTIFIER LDPM_MAF_100 FORMAT "%7.2" /end AXIS_PTS
/begin AXIS_PTS ldpm_n_32_ip_egr_ratio "" 0x080e7 n_32 _REC_AXS_20_u1 8160. _CNV_A_R_LINEAR_____16_CM 12 0. 8160. DISPLAY_IDENTIFIER LDPM_N_32_IP_EGR_RATIO FORMAT "%4.0" /end AXIS_PTS
/begin AXIS_PTS ldpm_maf_ip_egr_ratio "" 0x11786 maf _REC_AXS_20_u2 1389. _CNV_A_R_LINEAR_____106_CM 12 0. 1389. DISPLAY_IDENTIFIER LDPM_MAF_IP_EGR_RATIO FORMAT "%7.2" /end AXIS_PTS
/begin AXIS_PTS ldpm_n_1_thro "" 0x118ae n _REC_AXS_20_u2 8160. _CNV_A_R_LINEAR_____11_CM 8 0. 8160. DISPLAY_IDENTIFIER LDPM_N_1_THRO FORMAT "%4.0" /end AXIS_PTS
/begin MEASUREMENT eoi_hom "end of injection for homogeneous combustion mode" UWORD _CNV_A_R_LINEAR_____82_CM 1 100. 0. 720. DISPLAY_IDENTIFIER EOI_HOM ECU_ADDRESS 0x3fb392 BYTE_ORDER MSB_LAST FORMAT "%6.2" /end MEASUREMENT
/begin CHARACTERISTIC id_fil_frq_knk_1__n "Knock Filter Frequency and Reference Filter Frequency Cyl.2" CURVE 0x009bc _REC_CUR_20_u1_u1 63. _CNV_A_R_LINEAR_____1_CM 0. 63. DISPLAY_IDENTIFIER ID_FIL_FRQ_KNK_1 FORMAT "%2.0"
 /begin AXIS_DESCR COM_AXIS n_knk _CNV_A_R_LINEAR_____16_CM 4 0. 8160. FORMAT "%4.0" AXIS_PTS_REF ldpm_n_fil_frq_knk /end AXIS_DESCR
/end CHARACTERISTIC
/begin CHARACTERISTIC id_fil_frq_knk_2__n "Knock Filter Frequency and Reference Filter Frequency Cyl.3" CURVE 0x009c0 _REC_CUR_20_u1_u1 63. _CNV_A_R_LINEAR_____1_CM 0. 63. DISPLAY_IDENTIFIER ID_FIL_FRQ_KNK_2 FORMAT "%2.0"
 /begin AXIS_DESCR COM_AXIS n_knk _CNV_A_R_LINEAR_____16_CM 4 0. 8160. FORMAT "%4.0" AXIS_PTS_REF ldpm_n_fil_frq_knk /end AXIS_DESCR
/end CHARACTERISTIC
/begin CHARACTERISTIC id_fil_frq_knk_3__n "Knock Filter Frequency and Reference Filter Frequency Cyl.4" CURVE 0x009c4 _REC_CUR_20_u1_u1 63. _CNV_A_R_LINEAR_____1_CM 0. 63. DISPLAY_IDENTIFIER ID_FIL_FRQ_KNK_3 FORMAT "%2.0"
 /begin AXIS_DESCR COM_AXIS n_knk _CNV_A_R_LINEAR_____16_CM 4 0. 8160. FORMAT "%4.0" AXIS_PTS_REF ldpm_n_fil_frq_knk /end AXIS_DESCR
/end CHARACTERISTIC
/begin MEASUREMENT knks[0] "" UWORD _CNV_A_R_LINEAR_____250_CM 1 100. 0. 4.99992371 DISPLAY_IDENTIFIER KNKS_0 ECU_ADDRESS 0x3fb398 BYTE_ORDER MSB_LAST FORMAT "%7.5" /end MEASUREMENT
/begin MEASUREMENT knks[1] "" UWORD _CNV_A_R_LINEAR_____250_CM 1 100. 0. 4.99992371 DISPLAY_IDENTIFIER KNKS_1 ECU_ADDRESS 0x3fb39a BYTE_ORDER MSB_LAST FORMAT "%7.5" /end MEASUREMENT
/begin MEASUREMENT knks[2] "" UWORD _CNV_A_R_LINEAR_____250_CM 1 100. 0. 4.99992371 DISPLAY_IDENTIFIER KNKS_2 ECU_ADDRESS 0x3fb39c BYTE_ORDER MSB_LAST FORMAT "%7.5" /end MEASUREMENT
/begin MEASUREMENT knks[3] "" UWORD _CNV_A_R_LINEAR_____250_CM 1 100. 0. 4.99992371 DISPLAY_IDENTIFIER KNKS_3 ECU_ADDRESS 0x3fb39e BYTE_ORDER MSB_LAST FORMAT "%7.5" /end MEASUREMENT
/begin MEASUREMENT knks[4] "" UWORD _CNV_A_R_LINEAR_____250_CM 1 100. 0. 4.99992371 DISPLAY_IDENTIFIER KNKS_4 ECU_ADDRESS 0x3fb3a0 BYTE_ORDER MSB_LAST FORMAT "%7.5" /end MEASUREMENT
/begin MEASUREMENT knks[5] "" UWORD _CNV_A_R_LINEAR_____250_CM 1 100. 0. 4.99992371 DISPLAY_IDENTIFIER KNKS_5 ECU_ADDRESS 0x3fb3a2 BYTE_ORDER MSB_LAST FORMAT "%7.5" /end MEASUREMENT
/begin CHARACTERISTIC id_fil_frq_knk_0__n "Knock Filter Frequency and Reference Filter Frequency Cyl.1" CURVE 0x009b8 _REC_CUR_20_u1_u1 63. _CNV_A_R_LINEAR_____1_CM 0. 63. DISPLAY_IDENTIFIER ID_FIL_FRQ_KNK_0 FORMAT "%2.0"
 /begin AXIS_DESCR COM_AXIS n_knk _CNV_A_R_LINEAR_____16_CM 4 0. 8160. FORMAT "%4.0" AXIS_PTS_REF ldpm_n_fil_frq_knk /end AXIS_DESCR
/end CHARACTERISTIC
/begin CHARACTERISTIC id_fil_frq_knk_4__n "Knock Filter Frequency and Reference Filter Frequency Cyl.5" CURVE 0x009c8 _REC_CUR_20_u1_u1 63. _CNV_A_R_LINEAR_____1_CM 0. 63. DISPLAY_IDENTIFIER ID_FIL_FRQ_KNK_4 FORMAT "%2.0"
 /begin AXIS_DESCR COM_AXIS n_knk _CNV_A_R_LINEAR_____16_CM 4 0. 8160. FORMAT "%4.0" AXIS_PTS_REF ldpm_n_fil_frq_knk /end AXIS_DESCR
/end CHARACTERISTIC
/begin CHARACTERISTIC id_fil_frq_knk_5__n "Knock Filter Frequency and Reference Filter Frequency Cyl.6" CURVE 0x009cc _REC_CUR_20_u1_u1 63. _CNV_A_R_LINEAR_____1_CM 0. 63. DISPLAY_IDENTIFIER ID_FIL_FRQ_KNK_5 FORMAT "%2.0"
 /begin AXIS_DESCR COM_AXIS n_knk _CNV_A_R_LINEAR_____16_CM 4 0. 8160. FORMAT "%4.0" AXIS_PTS_REF ldpm_n_fil_frq_knk /end AXIS_DESCR
/end CHARACTERISTIC
/begin CHARACTERISTIC ip_knkwb_2__n__maf "Beginning of Measurement Window Cyl.3" MAP 0x0b8a6 _REC_MAP_20_u2_u1_u1 108. _CNV_A_R_LINEAR_____82_CM 0. 108. DISPLAY_IDENTIFIER IP_KNKWB_2__N__MAF FORMAT "%5.1"
 /begin AXIS_DESCR COM_AXIS n_knk _CNV_A_R_LINEAR_____16_CM 10 0. 8160. FORMAT "%4.0" AXIS_PTS_REF ldpm_n_knkwb /end AXIS_DESCR
 /begin AXIS_DESCR COM_AXIS maf_knk _CNV_A_R_LINEAR_____27_CM 4 0. 1389. FORMAT "%4.0" AXIS_PTS_REF ldpm_maf_knkwb /end AXIS_DESCR
/end CHARACTERISTIC
/begin CHARACTERISTIC ip_knkwb_3__n__maf "Beginning of Measurement Window Cyl.4" MAP 0x0b8f6 _REC_MAP_20_u2_u1_u1 108. _CNV_A_R_LINEAR_____82_CM 0. 108. DISPLAY_IDENTIFIER IP_KNKWB_3__N__MAF FORMAT "%5.1"
 /begin AXIS_DESCR COM_AXIS n_knk _CNV_A_R_LINEAR_____16_CM 10 0. 8160. FORMAT "%4.0" AXIS_PTS_REF ldpm_n_knkwb /end AXIS_DESCR
 /begin AXIS_DESCR COM_AXIS maf_knk _CNV_A_R_LINEAR_____27_CM 4 0. 1389. FORMAT "%4.0" AXIS_PTS_REF ldpm_maf_knkwb /end AXIS_DESCR
/end CHARACTERISTIC
/begin CHARACTERISTIC ip_knkwb_4__n__maf "Beginning of Measurement Window Cyl.5" MAP 0x0b946 _REC_MAP_20_u2_u1_u1 108. _CNV_A_R_LINEAR_____82_CM 0. 108. DISPLAY_IDENTIFIER IP_KNKWB_4__N__MAF FORMAT "%5.1"
 /begin AXIS_DESCR COM_AXIS n_knk _CNV_A_R_LINEAR_____16_CM 10 0. 8160. FORMAT "%4.0" AXIS_PTS_REF ldpm_n_knkwb /end AXIS_DESCR
 /begin AXIS_DESCR COM_AXIS maf_knk _CNV_A_R_LINEAR_____27_CM 4 0. 1389. FORMAT "%4.0" AXIS_PTS_REF ldpm_maf_knkwb /end AXIS_DESCR
/end CHARACTERISTIC
/begin CHARACTERISTIC ip_knkwb_5__n__maf "Beginning of Measurement Window Cyl.6" MAP 0x0b996 _REC_MAP_20_u2_u1_u1 108. _CNV_A_R_LINEAR_____82_CM 0. 108. DISPLAY_IDENTIFIER IP_KNKWB_5__N__MAF FORMAT "%5.1"
 /begin AXIS_DESCR COM_AXIS n_knk _CNV_A_R_LINEAR_____16_CM 10 0. 8160. FORMAT "%4.0" AXIS_PTS_REF ldpm_n_knkwb /end AXIS_DESCR
 /begin AXIS_DESCR COM_AXIS maf_knk _CNV_A_R_LINEAR_____27_CM 4 0. 1389. FORMAT "%4.0" AXIS_PTS_REF ldpm_maf_knkwb /end AXIS_DESCR
/end CHARACTERISTIC
/begin CHARACTERISTIC ip_knkwe_0__n__maf "End of Measurement Window Cyl.1" MAP 0x0b9e6 _REC_MAP_20_u2_u1_u1 113.625 _CNV_A_R_LINEAR_____82_CM 0.375 114. DISPLAY_IDENTIFIER IP_KNKWE_0__N__MAF FORMAT "%5.1"
 /begin AXIS_DESCR COM_AXIS n_knk _CNV_A_R_LINEAR_____16_CM 10 0. 8160. FORMAT "%4.0" AXIS_PTS_REF ldpm_n_knkwb /end AXIS_DESCR
 /begin AXIS_DESCR COM_AXIS maf_knk _CNV_A_R_LINEAR_____27_CM 4 0. 1389. FORMAT "%4.0" AXIS_PTS_REF ldpm_maf_knkwb /end AXIS_DESCR
/end CHARACTERISTIC
/begin CHARACTERISTIC ip_knkwe_1__n__maf "End of Measurement Window Cyl.2" MAP 0x0ba36 _REC_MAP_20_u2_u1_u1 113.625 _CNV_A_R_LINEAR_____82_CM 0.375 114. DISPLAY_IDENTIFIER IP_KNKWE_1__N__MAF FORMAT "%5.1"
 /begin AXIS_DESCR COM_AXIS n_knk _CNV_A_R_LINEAR_____16_CM 10 0. 8160. FORMAT "%4.0" AXIS_PTS_REF ldpm_n_knkwb /end AXIS_DESCR
 /begin AXIS_DESCR COM_AXIS maf_knk _CNV_A_R_LINEAR_____27_CM 4 0. 1389. FORMAT "%4.0" AXIS_PTS_REF ldpm_maf_knkwb /end AXIS_DESCR
/end CHARACTERISTIC
/begin CHARACTERISTIC ip_knkwe_2__n__maf "End of Measurement Window Cyl.3" MAP 0x0ba86 _REC_MAP_20_u2_u1_u1 113.625 _CNV_A_R_LINEAR_____82_CM 0.375 114. DISPLAY_IDENTIFIER IP_KNKWE_2__N__MAF FORMAT "%5.1"
 /begin AXIS_DESCR COM_AXIS n_knk _CNV_A_R_LINEAR_____16_CM 10 0. 8160. FORMAT "%4.0" AXIS_PTS_REF ldpm_n_knkwb /end AXIS_DESCR
 /begin AXIS_DESCR COM_AXIS maf_knk _CNV_A_R_LINEAR_____27_CM 4 0. 1389. FORMAT "%4.0" AXIS_PTS_REF ldpm_maf_knkwb /end AXIS_DESCR
/end CHARACTERISTIC
/begin CHARACTERISTIC ip_knkwe_3__n__maf "End of Measurement Window Cyl.4" MAP 0x0bad6 _REC_MAP_20_u2_u1_u1 113.625 _CNV_A_R_LINEAR_____82_CM 0.375 114. DISPLAY_IDENTIFIER IP_KNKWE_3__N__MAF FORMAT "%5.1"
 /begin AXIS_DESCR COM_AXIS n_knk _CNV_A_R_LINEAR_____16_CM 10 0. 8160. FORMAT "%4.0" AXIS_PTS_REF ldpm_n_knkwb /end AXIS_DESCR
 /begin AXIS_DESCR COM_AXIS maf_knk _CNV_A_R_LINEAR_____27_CM 4 0. 1389. FORMAT "%4.0" AXIS_PTS_REF ldpm_maf_knkwb /end AXIS_DESCR
/end CHARACTERISTIC
/begin CHARACTERISTIC ip_knkwe_4__n__maf "End of Measurement Window Cyl.5" MAP 0x0bb26 _REC_MAP_20_u2_u1_u1 113.625 _CNV_A_R_LINEAR_____82_CM 0.375 114. DISPLAY_IDENTIFIER IP_KNKWE_4__N__MAF FORMAT "%5.1"
 /begin AXIS_DESCR COM_AXIS n_knk _CNV_A_R_LINEAR_____16_CM 10 0. 8160. FORMAT "%4.0" AXIS_PTS_REF ldpm_n_knkwb /end AXIS_DESCR
 /begin AXIS_DESCR COM_AXIS maf_knk _CNV_A_R_LINEAR_____27_CM 4 0. 1389. FORMAT "%4.0" AXIS_PTS_REF ldpm_maf_knkwb /end AXIS_DESCR
/end CHARACTERISTIC
/begin CHARACTERISTIC ip_knkwe_5__n__maf "End of Measurement Window Cyl.6" MAP 0x0bb76 _REC_MAP_20_u2_u1_u1 113.625 _CNV_A_R_LINEAR_____82_CM 0.375 114. DISPLAY_IDENTIFIER IP_KNKWE_5__N__MAF FORMAT "%5.1"
 /begin AXIS_DESCR COM_AXIS n_knk _CNV_A_R_LINEAR_____16_CM 10 0. 8160. FORMAT "%4.0" AXIS_PTS_REF ldpm_n_knkwb /end AXIS_DESCR
 /begin AXIS_DESCR COM_AXIS maf_knk _CNV_A_R_LINEAR_____27_CM 4 0. 1389. FORMAT "%4.0" AXIS_PTS_REF ldpm_maf_knkwb /end AXIS_DESCR
/end CHARACTERISTIC
/begin CHARACTERISTIC ip_gain_knk_0__n__maf "Amplification precontrol Cyl.1" MAP 0x056ec _REC_MAP_20_u1_u1_u1 63. _CNV_A_R_LINEAR_____1_CM 0. 63. DISPLAY_IDENTIFIER IP_GAIN_KNK_0__N__MAF FORMAT "%2.0"
 /begin AXIS_DESCR COM_AXIS n_knk _CNV_A_R_LINEAR_____16_CM 16 0. 8160. FORMAT "%4.0" AXIS_PTS_REF ldpm_n_2_9 /end AXIS_DESCR
 /begin AXIS_DESCR COM_AXIS maf_knk _CNV_A_R_LINEAR_____27_CM 4 0. 1389. FORMAT "%4.0" AXIS_PTS_REF ldpm_maf_1_9 /end AXIS_DESCR
/end CHARACTERISTIC
/begin CHARACTERISTIC ip_gain_knk_2__n__maf "Amplification precontrol Cyl.3" MAP 0x0576c _REC_MAP_20_u1_u1_u1 63. _CNV_A_R_LINEAR_____1_CM 0. 63. DISPLAY_IDENTIFIER IP_GAIN_KNK_2__N__MAF FORMAT "%2.0"
 /begin AXIS_DESCR COM_AXIS n_knk _CNV_A_R_LINEAR_____16_CM 16 0. 8160. FORMAT "%4.0" AXIS_PTS_REF ldpm_n_2_9 /end AXIS_DESCR
 /begin AXIS_DESCR COM_AXIS maf_knk _CNV_A_R_LINEAR_____27_CM 4 0. 1389. FORMAT "%4.0" AXIS_PTS_REF ldpm_maf_1_9 /end AXIS_DESCR
/end CHARACTERISTIC
/begin CHARACTERISTIC ip_gain_knk_3__n__maf "Amplification precontrol Cyl.4" MAP 0x057ac _REC_MAP_20_u1_u1_u1 63. _CNV_A_R_LINEAR_____1_CM 0. 63. DISPLAY_IDENTIFIER IP_GAIN_KNK_3__N__MAF FORMAT "%2.0"
 /begin AXIS_DESCR COM_AXIS n_knk _CNV_A_R_LINEAR_____16_CM 16 0. 8160. FORMAT "%4.0" AXIS_PTS_REF ldpm_n_2_9 /end AXIS_DESCR
 /begin AXIS_DESCR COM_AXIS maf_knk _CNV_A_R_LINEAR_____27_CM 4 0. 1389. FORMAT "%4.0" AXIS_PTS_REF ldpm_maf_1_9 /end AXIS_DESCR
/end CHARACTERISTIC
/begin CHARACTERISTIC ip_gain_knk_4__n__maf "Amplification precontrol Cyl.5" MAP 0x057ec _REC_MAP_20_u1_u1_u1 63. _CNV_A_R_LINEAR_____1_CM 0. 63. DISPLAY_IDENTIFIER IP_GAIN_KNK_4__N__MAF FORMAT "%2.0"
 /begin AXIS_DESCR COM_AXIS n_knk _CNV_A_R_LINEAR_____16_CM 16 0. 8160. FORMAT "%4.0" AXIS_PTS_REF ldpm_n_2_9 /end AXIS_DESCR
 /begin AXIS_DESCR COM_AXIS maf_knk _CNV_A_R_LINEAR_____27_CM 4 0. 1389. FORMAT "%4.0" AXIS_PTS_REF ldpm_maf_1_9 /end AXIS_DESCR
/end CHARACTERISTIC
/begin CHARACTERISTIC ip_gain_knk_5__n__maf "Amplification precontrol Cyl.6" MAP 0x0582c _REC_MAP_20_u1_u1_u1 63. _CNV_A_R_LINEAR_____1_CM 0. 63. DISPLAY_IDENTIFIER IP_GAIN_KNK_5__N__MAF FORMAT "%2.0"
 /begin AXIS_DESCR COM_AXIS n_knk _CNV_A_R_LINEAR_____16_CM 16 0. 8160. FORMAT "%4.0" AXIS_PTS_REF ldpm_n_2_9 /end AXIS_DESCR
 /begin AXIS_DESCR COM_AXIS maf_knk _CNV_A_R_LINEAR_____27_CM 4 0. 1389. FORMAT "%4.0" AXIS_PTS_REF ldpm_maf_1_9 /end AXIS_DESCR
/end CHARACTERISTIC
/begin CHARACTERISTIC ip_itc_knk_0__n__maf "Integration time constant Cyl.1" MAP 0x06564 _REC_MAP_20_u1_u1_u1 31. _CNV_A_R_LINEAR_____1_CM 0. 31. DISPLAY_IDENTIFIER IP_ITC_KNK_0__N__MAF FORMAT "%2.0"
 /begin AXIS_DESCR COM_AXIS n_knk _CNV_A_R_LINEAR_____16_CM 16 0. 8160. FORMAT "%4.0" AXIS_PTS_REF ldpm_n_2_9 /end AXIS_DESCR
 /begin AXIS_DESCR COM_AXIS maf_knk _CNV_A_R_LINEAR_____27_CM 4 0. 1389. FORMAT "%4.0" AXIS_PTS_REF ldpm_maf_1_9 /end AXIS_DESCR
/end CHARACTERISTIC
/begin CHARACTERISTIC ip_itc_knk_1__n__maf "Integration time constant Cyl.2" MAP 0x065a4 _REC_MAP_20_u1_u1_u1 31. _CNV_A_R_LINEAR_____1_CM 0. 31. DISPLAY_IDENTIFIER IP_ITC_KNK_1__N__MAF FORMAT "%2.0"
 /begin AXIS_DESCR COM_AXIS n_knk _CNV_A_R_LINEAR_____16_CM 16 0. 8160. FORMAT "%4.0" AXIS_PTS_REF ldpm_n_2_9 /end AXIS_DESCR
 /begin AXIS_DESCR COM_AXIS maf_knk _CNV_A_R_LINEAR_____27_CM 4 0. 1389. FORMAT "%4.0" AXIS_PTS_REF ldpm_maf_1_9 /end AXIS_DESCR
/end CHARACTERISTIC
/begin CHARACTERISTIC ip_itc_knk_2__n__maf "Integration time constant Cyl.3" MAP 0x065e4 _REC_MAP_20_u1_u1_u1 31. _CNV_A_R_LINEAR_____1_CM 0. 31. DISPLAY_IDENTIFIER IP_ITC_KNK_2__N__MAF FORMAT "%2.0"
 /begin AXIS_DESCR COM_AXIS n_knk _CNV_A_R_LINEAR_____16_CM 16 0. 8160. FORMAT "%4.0" AXIS_PTS_REF ldpm_n_2_9 /end AXIS_DESCR
 /begin AXIS_DESCR COM_AXIS maf_knk _CNV_A_R_LINEAR_____27_CM 4 0. 1389. FORMAT "%4.0" AXIS_PTS_REF ldpm_maf_1_9 /end AXIS_DESCR
/end CHARACTERISTIC
/begin CHARACTERISTIC ip_itc_knk_3__n__maf "Integration time constant Cyl.4" MAP 0x06624 _REC_MAP_20_u1_u1_u1 31. _CNV_A_R_LINEAR_____1_CM 0. 31. DISPLAY_IDENTIFIER IP_ITC_KNK_3__N__MAF FORMAT "%2.0"
 /begin AXIS_DESCR COM_AXIS n_knk _CNV_A_R_LINEAR_____16_CM 16 0. 8160. FORMAT "%4.0" AXIS_PTS_REF ldpm_n_2_9 /end AXIS_DESCR
 /begin AXIS_DESCR COM_AXIS maf_knk _CNV_A_R_LINEAR_____27_CM 4 0. 1389. FORMAT "%4.0" AXIS_PTS_REF ldpm_maf_1_9 /end AXIS_DESCR
/end CHARACTERISTIC
/begin CHARACTERISTIC ip_itc_knk_4__n__maf "Integration time constant Cyl.5" MAP 0x06664 _REC_MAP_20_u1_u1_u1 31. _CNV_A_R_LINEAR_____1_CM 0. 31. DISPLAY_IDENTIFIER IP_ITC_KNK_4__N__MAF FORMAT "%2.0"
 /begin AXIS_DESCR COM_AXIS n_knk _CNV_A_R_LINEAR_____16_CM 16 0. 8160. FORMAT "%4.0" AXIS_PTS_REF ldpm_n_2_9 /end AXIS_DESCR
 /begin AXIS_DESCR COM_AXIS maf_knk _CNV_A_R_LINEAR_____27_CM 4 0. 1389. FORMAT "%4.0" AXIS_PTS_REF ldpm_maf_1_9 /end AXIS_DESCR
/end CHARACTERISTIC
/begin CHARACTERISTIC ip_itc_knk_5__n__maf "Integration time constant Cyl.6" MAP 0x066a4 _REC_MAP_20_u1_u1_u1 31. _CNV_A_R_LINEAR_____1_CM 0. 31. DISPLAY_IDENTIFIER IP_ITC_KNK_5__N__MAF FORMAT "%2.0"
 /begin AXIS_DESCR COM_AXIS n_knk _CNV_A_R_LINEAR_____16_CM 16 0. 8160. FORMAT "%4.0" AXIS_PTS_REF ldpm_n_2_9 /end AXIS_DESCR
 /begin AXIS_DESCR COM_AXIS maf_knk _CNV_A_R_LINEAR_____27_CM 4 0. 1389. FORMAT "%4.0" AXIS_PTS_REF ldpm_maf_1_9 /end AXIS_DESCR
/end CHARACTERISTIC
/begin CHARACTERISTIC ip_knkwb_0__n__maf "Beginning of Measurement Window Cyl.1" MAP 0x0b806 _REC_MAP_20_u2_u1_u1 108. _CNV_A_R_LINEAR_____82_CM 0. 108. DISPLAY_IDENTIFIER IP_KNKWB_0__N__MAF FORMAT "%5.1"
 /begin AXIS_DESCR COM_AXIS n_knk _CNV_A_R_LINEAR_____16_CM 10 0. 8160. FORMAT "%4.0" AXIS_PTS_REF ldpm_n_knkwb /end AXIS_DESCR
 /begin AXIS_DESCR COM_AXIS maf_knk _CNV_A_R_LINEAR_____27_CM 4 0. 1389. FORMAT "%4.0" AXIS_PTS_REF ldpm_maf_knkwb /end AXIS_DESCR
/end CHARACTERISTIC
/begin COMPU_METHOD _CNV_S_2_RANGE______0_CM "" TAB_VERB "%6.3" "[-]" COMPU_TAB_REF _CNV_S_2_RANGE______0 /end COMPU_METHOD
/begin COMPU_VTAB _CNV_S_2_RANGE______0 "" TAB_VERB 2 0 "0" 1 "1" /end COMPU_VTAB
/begin COMPU_METHOD _CNV_A_R_LINEAR_____1_CM "" RAT_FUNC "%6.3" "-" COEFFS 0 1. 0. 0 0 1 /end COMPU_METHOD
/begin COMPU_METHOD _CNV_A_R_LINEAR_____4_CM "" RAT_FUNC "%6.3" "s" COEFFS 0 100. 0. 0 0 1 /end COMPU_METHOD
/begin COMPU_METHOD _CNV_S_2_RANGE______5_CM "" TAB_VERB "%6.3" "-" COMPU_TAB_REF _CNV_S_2_RANGE______5 /end COMPU_METHOD
/begin COMPU_VTAB _CNV_S_2_RANGE______5 "" TAB_VERB 2 0 "0" 1 "1" /end COMPU_VTAB
/begin COMPU_METHOD _CNV_A_R_LINEAR_____7_CM "" RAT_FUNC "%6.3" "°C" COEFFS 0 16. 0. 0 0 1 /end COMPU_METHOD
/begin COMPU_METHOD _CNV_A_R_LINEAR_____9_CM "" RAT_FUNC "%6.3" "%" COEFFS 0 655.3600000071681 0. 0 0 1 /end COMPU_METHOD
/begin COMPU_METHOD _CNV_A_R_LINEAR_____10_CM "" RAT_FUNC "%6.3" "%" COEFFS 0 2.56 0. 0 0 1 /end COMPU_METHOD
/begin COMPU_METHOD _CNV_A_R_LINEAR_____11_CM "" RAT_FUNC "%6.3" "rpm" COEFFS 0 1. 0. 0 0 1 /end COMPU_METHOD
/begin COMPU_METHOD _CNV_A_R_LINEAR_____12_CM "" RAT_FUNC "%6.3" "°C" COEFFS 0 1.333333333333333 64. 0 0 1 /end COMPU_METHOD
/begin COMPU_METHOD _CNV_A_R_LINEAR_____15_CM "" RAT_FUNC "%6.3" "°C" COEFFS 0 1. 40. 0 0 1 /end COMPU_METHOD
/begin COMPU_METHOD _CNV_A_R_LINEAR_____16_CM "" RAT_FUNC "%6.3" "rpm" COEFFS 0 3.125e-002 0. 0 0 1 /end COMPU_METHOD
/begin COMPU_METHOD _CNV_A_R_LINEAR_____21_CM "" RAT_FUNC "%6.3" "-" COEFFS 0 32768.00003968061 0. 0 0 1 /end COMPU_METHOD
/begin COMPU_METHOD _CNV_A_R_LINEAR_____22_CM "" RAT_FUNC "%6.3" "[-]" COEFFS 0 1. 0. 0 0 1 /end COMPU_METHOD
/begin COMPU_METHOD _CNV_A_R_LINEAR_____23_CM "" RAT_FUNC "%6.3" "km/h" COEFFS 0 1. 0. 0 0 1 /end COMPU_METHOD
/begin COMPU_METHOD _CNV_A_R_LINEAR_____24_CM "" RAT_FUNC "%6.3" "s" COEFFS 0 10. 0. 0 0 1 /end COMPU_METHOD
/begin COMPU_METHOD _CNV_A_R_LINEAR_____27_CM "" RAT_FUNC "%6.3" "mg/stk" COEFFS 0 0.183585313174946 0. 0 0 1 /end COMPU_METHOD
/begin COMPU_METHOD _CNV_A_R_LINEAR_____29_CM "" RAT_FUNC "%6.3" "-" COEFFS 0 255.9983911655618 0. 0 0 1 /end COMPU_METHOD
/begin COMPU_METHOD _CNV_A_R_LINEAR_____30_CM "" RAT_FUNC "%6.3" "s" COEFFS 0 1. 0. 0 0 1 /end COMPU_METHOD
/begin COMPU_METHOD _CNV_A_R_LINEAR_____34_CM "" RAT_FUNC "%6.3" "V" COEFFS 0 9.846168103048838 0. 0 0 1 /end COMPU_METHOD
/begin COMPU_METHOD _CNV_A_R_LINEAR_____37_CM "" RAT_FUNC "%6.3" "-" COEFFS 0 65536.00007936121 0. 0 0 1 /end COMPU_METHOD
/begin COMPU_METHOD _CNV_A_R_LINEAR_____39_CM "" RAT_FUNC "%6.3" "-" COEFFS 0 127.9991955827809 0. 0 0 1 /end COMPU_METHOD
/begin COMPU_METHOD _CNV_A_R_LINEAR_____44_CM "" RAT_FUNC "%6.3" "V" COEFFS 0 51.0204081632653 0. 0 0 1 /end COMPU_METHOD
/begin COMPU_METHOD _CNV_A_R_LINEAR_____49_CM "" RAT_FUNC "%6.3" "hPa" COEFFS 0 12.06017666543982 0. 0 0 1 /end COMPU_METHOD
/begin COMPU_METHOD _CNV_A_R_LINEAR_____50_CM "" RAT_FUNC "%6.3" "[-]" COEFFS 0 255.9999357490357 0. 0 0 1 /end COMPU_METHOD
/begin COMPU_METHOD _CNV_A_R_LINEAR_____51_CM "" RAT_FUNC "%6.3" "rpm/s" COEFFS 0 3.125e-002 0. 0 0 1 /end COMPU_METHOD
/begin COMPU_METHOD _CNV_A_R_LINEAR_____52_CM "" RAT_FUNC "%6.3" "°TPS/s" COEFFS 0 8.535564853556485e-002 0. 0 0 1 /end COMPU_METHOD
/begin COMPU_METHOD _CNV_A_R_LINEAR_____53_CM "" RAT_FUNC "%6.3" "°TPS" COEFFS 0 137.0962343096234 0. 0 0 1 /end COMPU_METHOD
/begin COMPU_METHOD _CNV_A_R_LINEAR_____55_CM "" RAT_FUNC "%6.3" "Nm" COEFFS 0 32. 0. 0 0 1 /end COMPU_METHOD
/begin COMPU_METHOD _CNV_A_R_LINEAR_____82_CM "" RAT_FUNC "%6.3" "°CRK" COEFFS 0 2.666666666666667 0. 0 0 1 /end COMPU_METHOD
/begin COMPU_METHOD _CNV_A_R_LINEAR_____88_CM "" RAT_FUNC "%6.3" "km" COEFFS 0 0.1 0. 0 0 1 /end COMPU_METHOD
/begin COMPU_METHOD _CNV_A_R_LINEAR_____97_CM "" RAT_FUNC "%6.3" "min" COEFFS 0 1. 0. 0 0 1 /end COMPU_METHOD
/begin COMPU_METHOD _CNV_A_R_LINEAR_____106_CM "" RAT_FUNC "%6.3" "mg/stk" COEFFS 0 47.18142548596112 0. 0 0 1 /end COMPU_METHOD
/begin COMPU_METHOD _CNV_A_R_LINEAR_____115_CM "" RAT_FUNC "%6.3" "-" COEFFS 0 128. 0. 0 0 1 /end COMPU_METHOD
/begin COMPU_METHOD _CNV_A_R_LINEAR_____125_CM "" RAT_FUNC "%6.3" "-" COEFFS 0 16383.75 0. 0 0 1 /end COMPU_METHOD
/begin COMPU_METHOD _CNV_A_R_LINEAR_____127_CM "" RAT_FUNC "%6.3" "[-]" COEFFS 0 64. 0. 0 0 1 /end COMPU_METHOD
/begin COMPU_METHOD _CNV_A_R_LINEAR_____136_CM "" RAT_FUNC "%6.3" "-" COEFFS 0 2.666666666666667 0. 0 0 1 /end COMPU_METHOD
/begin COMPU_METHOD _CNV_A_R_LINEAR_____164_CM "" RAT_FUNC "%6.3" "-" COEFFS 0 1023.999999919998 0. 0 0 1 /end COMPU_METHOD
/begin COMPU_METHOD _CNV_A_R_LINEAR_____198_CM "" RAT_FUNC "%6.3" "ms" COEFFS 0 250. 0. 0 0 1 /end COMPU_METHOD
/begin COMPU_METHOD _CNV_A_R_LINEAR_____199_CM "" RAT_FUNC "%6.3" "hPa" COEFFS 0 0.3768805207949945 0. 0 0 1 /end COMPU_METHOD
/begin COMPU_METHOD _CNV_A_R_LINEAR_____203_CM "" RAT_FUNC "%6.3" "°CRK" COEFFS 0 2.666666666666667 95. 0 0 1 /end COMPU_METHOD
/begin COMPU_METHOD _CNV_A_R_LINEAR_____204_CM "" RAT_FUNC "%6.3" "°CRK" COEFFS 0 -2.666666666666667 0. 0 0 1 /end COMPU_METHOD
/begin COMPU_METHOD _CNV_A_R_LINEAR_____205_CM "" RAT_FUNC "%6.3" "°CRK" COEFFS 0 2.666666666666667 128. 0 0 1 /end COMPU_METHOD
/begin COMPU_METHOD _CNV_A_R_LINEAR_____206_CM "" RAT_FUNC "%6.3" "rpm" COEFFS 0 1. 32768. 0 0 1 /end COMPU_METHOD
/begin COMPU_METHOD _CNV_A_R_LINEAR_____207_CM "" RAT_FUNC "%6.3" "V" COEFFS 0 35.63776976537597 0. 0 0 1 /end COMPU_METHOD
/begin COMPU_METHOD _CNV_A_R_LINEAR_____208_CM "" RAT_FUNC "%6.3" "-" COEFFS 0 128. 128. 0 0 1 /end COMPU_METHOD
/begin COMPU_METHOD _CNV_A_R_LINEAR_____209_CM "" RAT_FUNC "%6.3" "°PORT" COEFFS 0 655.3600000071681 0. 0 0 1 /end COMPU_METHOD
/begin COMPU_METHOD _CNV_A_R_LINEAR_____210_CM "" RAT_FUNC "%6.3" "ms" COEFFS 0 15.625 0. 0 0 1 /end COMPU_METHOD
/begin COMPU_METHOD _CNV_A_R_LINEAR_____227_CM "" RAT_FUNC "%6.3" "°CRK" COEFFS 0 42.66666666666666 0. 0 0 1 /end COMPU_METHOD
/begin COMPU_METHOD _CNV_A_R_LINEAR_____235_CM "" RAT_FUNC "%6.3" "-" COEFFS 0 32. 0. 0 0 1 /end COMPU_METHOD
/begin COMPU_METHOD _CNV_A_R_LINEAR_____248_CM "" RAT_FUNC "%6.3" "°CRK" COEFFS 0 1. 0. 0 0 1 /end COMPU_METHOD
/begin COMPU_METHOD _CNV_A_R_LINEAR_____249_CM "" RAT_FUNC "%6.3" "-" COEFFS 0 682.6666665599934 2.560156259323598e-006 0 0 1 /end COMPU_METHOD
/begin COMPU_METHOD _CNV_A_R_LINEAR_____250_CM "" RAT_FUNC "%6.3" "V" COEFFS 0 13107.19998965744 0. 0 0 1 /end COMPU_METHOD
/begin COMPU_METHOD _CNV_A_R_LINEAR_____251_CM "" RAT_FUNC "%6.3" "°CRK/wcyc" COEFFS 0 64. 0. 0 0 1 /end COMPU_METHOD
/begin COMPU_METHOD _CNV_A_R_LINEAR_____252_CM "" RAT_FUNC "%6.3" "°CRK/wcyc" COEFFS 0 10.66666666666667 0. 0 0 1 /end COMPU_METHOD
/begin COMPU_METHOD _CNV_A_R_LINEAR_____253_CM "" RAT_FUNC "%6.3" "°CRK" COEFFS 0 682.6456692913386 7.874015748029706e-003 0 0 1 /end COMPU_METHOD
/begin COMPU_METHOD _CNV_A_R_LINEAR_____254_CM "" RAT_FUNC "%6.3" "V" COEFFS 0 50. 128. 0 0 1 /end COMPU_METHOD
/begin COMPU_METHOD _CNV_A_R_LINEAR_____255_CM "" RAT_FUNC "%6.3" "mg/stk" COEFFS 0 47.18214541280769 -1.080506262951531e-005 0 0 1 /end COMPU_METHOD
/begin COMPU_METHOD _CNV_A_R_LINEAR_____256_CM "" RAT_FUNC "%6.3" "*wcyc" COEFFS 0 1. 0. 0 0 1 /end COMPU_METHOD
/begin COMPU_METHOD _CNV_S_6_STATE_IGA__257_CM "" TAB_VERB "%6.3" "[-]" COMPU_TAB_REF _CNV_S_6_STATE_IGA__257 /end COMPU_METHOD
/begin COMPU_VTAB _CNV_S_6_STATE_IGA__257 "" TAB_VERB 6 0 "INIT" 1 "TRIGGER" 2 "DELAY" 3 "ACTIVE" 4 "RAMP" 5 "WAIT" /end COMPU_VTAB
/begin COMPU_METHOD _CNV_A_R_LINEAR_____258_CM "" RAT_FUNC "%6.3" "hPa/ms" COEFFS 0 395.2653799758745 -0.5 0 0 1 /end COMPU_METHOD
/begin COMPU_METHOD _CNV_A_R_LINEAR_____259_CM "" RAT_FUNC "%6.3" "°CRK/wcyc" COEFFS 0 682.6666665599934 2.560156259323598e-006 0 0 1 /end COMPU_METHOD
/begin COMPU_METHOD _CNV_A_R_LINEAR_____347_CM "" RAT_FUNC "%6.3" "°CRK" COEFFS 0 42.66666666666666 32768. 0 0 1 /end COMPU_METHOD
/begin COMPU_METHOD _CNV_A_R_LINEAR_____356_CM "" RAT_FUNC "%6.3" "-" COEFFS 0 524280. 0. 0 0 1 /end COMPU_METHOD
/begin COMPU_METHOD _CNV_A_R_LINEAR_____439_CM "" RAT_FUNC "%6.3" "ms" COEFFS 0 250. 32768. 0 0 1 /end COMPU_METHOD
/begin COMPU_METHOD _CNV_A_R_LINEAR_____441_CM "" RAT_FUNC "%6.3" "mm" COEFFS 0 1000. 0. 0 0 1 /end COMPU_METHOD
/begin COMPU_METHOD _CNV_A_R_LINEAR_____447_CM "" RAT_FUNC "%6.3" "°TPS" COEFFS 0 548.4100418410042 0. 0 0 1 /end COMPU_METHOD
/begin COMPU_METHOD _CNV_A_R_LINEAR_____454_CM "" RAT_FUNC "%6.3" "°TPS/10ms" COEFFS 0 137.0962343096234 0. 0 0 1 /end COMPU_METHOD
/begin RECORD_LAYOUT _REC_VAL_20_u1 FNC_VALUES 1 UBYTE COLUMN_DIR DIRECT /end RECORD_LAYOUT
/begin RECORD_LAYOUT _REC_VAL_20_u2 FNC_VALUES 1 UWORD COLUMN_DIR DIRECT /end RECORD_LAYOUT
/begin RECORD_LAYOUT _REC_CUR_20_u2_u1 FNC_VALUES 1 UWORD COLUMN_DIR DIRECT /end RECORD_LAYOUT
/begin RECORD_LAYOUT _REC_AXS_20_u1 NO_AXIS_PTS_X 1 UBYTE AXIS_PTS_X 2 UBYTE INDEX_INCR DIRECT /end RECORD_LAYOUT
/begin RECORD_LAYOUT _REC_MAP_20_u1_u1_u1 FNC_VALUES 1 UBYTE COLUMN_DIR DIRECT /end RECORD_LAYOUT
/begin RECORD_LAYOUT _REC_CUR_20_u1_u1 FNC_VALUES 1 UBYTE COLUMN_DIR DIRECT /end RECORD_LAYOUT
/begin RECORD_LAYOUT _REC_AXS_20_u2 NO_AXIS_PTS_X 1 UWORD AXIS_PTS_X 2 UWORD INDEX_INCR DIRECT /end RECORD_LAYOUT
/begin RECORD_LAYOUT _REC_MAP_20_u1_u1_u2 FNC_VALUES 1 UBYTE COLUMN_DIR DIRECT /end RECORD_LAYOUT
/begin RECORD_LAYOUT _REC_MAP_20_u2_u2_u1 FNC_VALUES 1 UWORD COLUMN_DIR DIRECT /end RECORD_LAYOUT
/begin RECORD_LAYOUT _REC_CUR_20_u1_u2 FNC_VALUES 1 UBYTE COLUMN_DIR DIRECT /end RECORD_LAYOUT
/begin RECORD_LAYOUT _REC_MAP_20_u2_u1_u1 FNC_VALUES 1 UWORD COLUMN_DIR DIRECT /end RECORD_LAYOUT
/begin RECORD_LAYOUT _REC_CUR_20_u2_u2 FNC_VALUES 1 UWORD COLUMN_DIR DIRECT /end RECORD_LAYOUT
/begin RECORD_LAYOUT _REC_VAL_20_s1 FNC_VALUES 1 SBYTE COLUMN_DIR DIRECT /end RECORD_LAYOUT
/begin RECORD_LAYOUT _REC_VAL_20_s2 FNC_VALUES 1 SWORD COLUMN_DIR DIRECT /end RECORD_LAYOUT
/begin RECORD_LAYOUT _REC_MAP_20_u2_u1_u2 FNC_VALUES 1 UWORD COLUMN_DIR DIRECT /end RECORD_LAYOUT
/begin RECORD_LAYOUT _REC_MAP_20_u1_u2_u2 FNC_VALUES 1 UBYTE COLUMN_DIR DIRECT /end RECORD_LAYOUT
/begin RECORD_LAYOUT _REC_MAP_20_u2_u2_u2 FNC_VALUES 1 UWORD COLUMN_DIR DIRECT /end RECORD_LAYOUT
/begin RECORD_LAYOUT _REC_MAP_20_u1_u2_u1 FNC_VALUES 1 UBYTE COLUMN_DIR DIRECT /end RECORD_LAYOUT
/begin RECORD_LAYOUT _REC_CUR_20_s2_u1 FNC_VALUES 1 SWORD COLUMN_DIR DIRECT /end RECORD_LAYOUT
/begin FUNCTION ETC_Application_incidences_throt "_Application incidences throttle position setpoint selection"
 /begin DEF_CHARACTERISTIC c_tps_sp_pwl_lgrd c_tps_sp_pwl_up c_tps_sp_as_man c_tps_sp_ext_adj_ena c_pv_av_ext_adj_min ip_tps_sp_pwl ip_tps_sp_ext_adj ip_tps_sp_es c_t_mtc_isa_off /end DEF_CHARACTERISTIC
 /begin OUT_MEASUREMENT tps_sp_pwl lv_tps_pwl tps_sp_ext_adj tps_sp_ext_adj_1 lv_tps_sp_ext_adj lv_tps_sp_ext_adj_1 tps_sp_es /end OUT_MEASUREMENT
/end FUNCTION
/begin FUNCTION ETC_Throttle_setpoint_calculatio "_Throttle setpoint calculation at start"
 /begin DEF_CHARACTERISTIC ip_tps_rel_st_at ip_tps_rel_st_mt ip_tps_rel_st_pv ip_fac_amp_tps_rel_st ip_tps_sp_st ip_fac_tia_tps_rel_st /end DEF_CHARACTERISTIC
 /begin OUT_MEASUREMENT tps_sp_st tps_rel_st /end OUT_MEASUREMENT
/end FUNCTION
/begin FUNCTION ETC_Idle_speed_actuator_opening_ "_Idle speed actuator opening at start"
 /begin DEF_CHARACTERISTIC ip_opg_rel_st_isa_at ip_opg_rel_st_isa_mt ip_opg_rel_st_isa_pv ip_fac_tia_opg_st_isa ip_fac_amp_opg_st_isa ip_opg_sp_st_isa /end DEF_CHARACTERISTIC
 /begin OUT_MEASUREMENT opg_sp_st_isa opg_rel_st /end OUT_MEASUREMENT
/end FUNCTION
/begin FUNCTION IGA_Ignition_Angle "IGA"
 /begin SUB_FUNCTION IGA_Ignition_angle_general IGA_Dwell_time_control_open_loop IGA_Ignition_with_multiple_spark IGA_Corrected_basic_ignition_ang IGA_Setpoint_ignition_angle IGA_Minimum_ignition_angle IGA_Basic_ignition_angle_at_star IGA_KnockControl IGA_Ignition_angle_for_stratifie IGA_Corrected_Reference_Ignition IGA_Ignition_angle_correction_du IGA_Temperature_Correction IGA_RON_Adaptation IGA_Minimum_IGA_limitation_for_e IGA_Catalyst_heating_correction IGA_Load_dynamics_correction /end SUB_FUNCTION
/end FUNCTION
/begin FUNCTION IGA_Ignition_angle_general "_Ignition angle general"
 /begin DEF_CHARACTERISTIC c_crlc_iga_knk c_cycnr_iga_es lc_iga_st_ena lc_inh_iga_tra_knk_eff ip_iga_lgrd_ast c_iga_ini lc_iga_man c_iga_as c_iga_man c_iga_as_cyl[0] c_iga_as_cyl[1] c_iga_as_cyl[2] c_iga_as_cyl[3] c_iga_as_cyl[4] c_iga_as_cyl[5] ipm_eff_iga__iga_dif c_iga_min_etc_lih /end DEF_CHARACTERISTIC
 /begin OUT_MEASUREMENT iga_av_1[0] iga_av_1[1] iga_av_1[2] iga_av_1[3] iga_av_1[4] iga_av_1[5] iga[0] iga[1] iga[2] iga[3] iga[4] iga[5] iga_min eff_iga_bas_cor eff_iga_ron_98_1 eff_iga_ron_98_2 eff_iga_av_1 eff_iga_av_2 eff_iga_min iga_bas_cor_knk_add iga_av_mv_1 iga_av_mv_2 iga_dif_bas iga_dif_av_1 iga_dif_av_2 iga_dif_ron_98_1 iga_dif_ron_98_2 iga_mv_knk_fil iga_bas_cor_knk_fil eff_iga_bas_cor_knk_fil lv_iga_grd_act iga_dif_bas_knk_fil iga_igc[0] iga_igc[1] iga_igc[2] iga_igc[3] iga_igc[4] iga_igc[5] iga_wout_knk[0] iga_wout_knk[1] iga_wout_knk[2] iga_wout_knk[3] iga_wout_knk[4] iga_wout_knk[5] eff_iga_av eff_iga_av_can iga_sp_max_1 iga_sp_max_1_can iga_av_mv iga_av_mv_can iga_dif_av iga_dif_av_can /end OUT_MEASUREMENT
/end FUNCTION
/begin FUNCTION IGA_Dwell_time_control_open_loop "_Dwell time control open loop" /begin DEF_CHARACTERISTIC c_td_ini c_td_as ip_td__vb /end DEF_CHARACTERISTIC /begin OUT_MEASUREMENT td_max_wdt td /end OUT_MEASUREMENT /end FUNCTION
/begin FUNCTION IGA_Ignition_with_multiple_spark "_Ignition with multiple spark"
 /begin DEF_CHARACTERISTIC c_tco_max_mpl_is c_tco_max_mpl_st c_vb_max_mpl c_td_t_mpl c_n_max_ign_mpl ip_nr_mpl_st ip_nr_mpl_is ldp_tco__nr_mpl_st ldp_tco__nr_mpl_is ip_td_mpl /end DEF_CHARACTERISTIC
 /begin OUT_MEASUREMENT lv_mpl_iga_act td_mpl_dly td_mpl ign_mpl_nr /end OUT_MEASUREMENT
/end FUNCTION
/begin FUNCTION IGA_Corrected_basic_ignition_ang "_Corrected basic ignition angle"
 /begin DEF_CHARACTERISTIC c_iga_bas_add_max c_iga_bas_add_min ip_iga_bas_ron_91__n__maf ip_iga_bas_add_max_ivvt__n__maf ip_iga_bas_add_min_ivvt__n__maf ip_iga_bas_lamb__lamb_sp ip_iga_bas__n__maf ip_iga_bas_ron_98__n__maf /end DEF_CHARACTERISTIC
 /begin OUT_MEASUREMENT iga_bas_cor iga_bas_ivvt iga_bas_lamb_cor iga_bas_ivvt_ofs iga_bas_ron /end OUT_MEASUREMENT
/end FUNCTION
/begin FUNCTION IGA_Setpoint_ignition_angle "_Setpoint ignition angle"
 /begin DEF_CHARACTERISTIC ip_iga_dif_sp__eff_iga_sp lc_tq_iga_inh c_eff_iga_thd_1 c_eff_iga_thd_aj c_eff_iga_thd_is /end DEF_CHARACTERISTIC
 /begin OUT_MEASUREMENT iga_dif_sp lv_tq_iga_act lv_tq_iga_req eff_iga_sp eff_iga_sp_can eff_iga_sp_1 eff_iga_sp_1_can iga_sp iga_sp_can /end OUT_MEASUREMENT
/end FUNCTION
/begin FUNCTION IGA_Minimum_ignition_angle "_Minimum ignition angle"
 /begin DEF_CHARACTERISTIC c_iga_dif_min_delta_temp_ena c_iga_dif_min_delta_lgrd ip_iga_dif_min_tco ip_iga_dif_min_delta c_iga_dif_min_delta_temp_dis ip_iga_dif_min_cyc_mt ip_iga_dif_min_cyc_at ip_iga_dif_min_cyc_amp_at ip_iga_dif_min_cyc_amp_mt ip_iga_min_n_maf_ext ip_iga_dif_min_tco_ext ip_iga_min_n_maf ip_fac_iga_min_tco_ext ip_fac_iga_dif_ast ip_t_iga_min_puc c_iga_dif_min_bas_lgrd c_iga_min_puc_lgrd ip_fac_iga_min_tco_pu ip_iga_dif_min_tco_pu ip_iga_min_n_maf_pu ip_fac_iga_min_tco ip_fac_iga_dif_min_amp /end DEF_CHARACTERISTIC
 /begin OUT_MEASUREMENT iga_dif_min iga_dif_min_delta lv_iga_dif_min_delta_act iga_dif_min_ast lv_iga_min_ext iga_min_bas iga_min_bas_1 iga_min_bas_ext iga_min_bas_int iga_min_bas_puc iga_min_bas_pu /end OUT_MEASUREMENT
/end FUNCTION
/begin FUNCTION IGA_Basic_ignition_angle_at_star "_Basic ignition angle at start" /begin DEF_CHARACTERISTIC ip_iga_st_bas ip_iga_st_cyc_st_cor ip_iga_st_amp_cor /end DEF_CHARACTERISTIC /begin OUT_MEASUREMENT iga_st /end OUT_MEASUREMENT /end FUNCTION
/begin FUNCTION IGA_KnockControl "_KnockControl"
 /begin DEF_CHARACTERISTIC c_cycnr_ad2_dec_knk ip_maf_min_knk__n__tco id_iga_ad1_knk_size__n__maf id_iga_dec_knk_1__n id_iga_dec_knk_2__n id_maf_min_ad_knk__n id_n_grd_max_knk__n ip_iga_inc_knk__n c_cycnr_ad2_inc_knk c_fac_tra_knk c_iga_ad1_fac_dec_knk c_iga_ad1_fac_fast_knk c_iga_ad1_fac_inc_knk c_iga_ad1_inc_knk c_iga_ad1_lgrd_neg_knk c_iga_ad1_lgrd_pos_knk c_iga_ad1_thd_dec_knk c_iga_ad1_thd_fast_knk c_iga_ad2_max_knk c_iga_ad2_thd_dec_knk c_iga_ad2_thd_inc_knk c_iga_dif_min_max_knk c_iga_lgrd_3 c_maf_iga_hys_knk c_n_iga_hys_knk c_nl_crlc c_nl_crlc_tra c_swi_ad_knk ip_fac_ad_knk_tco__tco id_cycnr_fac_tra_knk__n ip_knkwb_1__n__maf ip_gain_knk_1__n__maf ip_fac_thd_knk_0__n__maf ip_fac_thd_knk_1__n__maf ip_fac_thd_knk_2__n__maf ip_fac_thd_knk_3__n__maf ip_fac_thd_knk_4__n__maf ip_fac_thd_knk_5__n__maf ip_knk_thd_add__n c_nl_min id_maf_dif_tra_knk__n ip_iga_bas_max_knk__n__maf ip_iga_ofs_max_knk__n__maf ip_fac_iga_max_knk__tco__tia c_iga_ad1_thd_inc_knk c_tco_ad1_min_knk c_tco_ad2_min_knk c_tco_ad1_max_knk c_tco_ad2_max_knk ldp_tco__maf_min_knk ldpm_n_3_9 ldp_tco__fac_ad_knk_tco c_knk_thd_max iga_ad1_knk_5__n__maf iga_ad1_knk_4__n__maf iga_ad1_knk_3__n__maf iga_ad1_knk_2__n__maf ldpm_n_iga_ad iga_ad1_knk_1__n__maf iga_ad1_knk_0__n__maf ldpm_maf_iga_ad ldpm_n_knkwb ldpm_maf_knkwb ldpm_n_fil_frq_knk c_maf_min_knk_ad2 id_fil_frq_knk_1__n id_fil_frq_knk_2__n id_fil_frq_knk_3__n id_fil_frq_knk_0__n id_fil_frq_knk_4__n id_fil_frq_knk_5__n ip_knkwb_2__n__maf ip_knkwb_3__n__maf ip_knkwb_4__n__maf ip_knkwb_5__n__maf ip_knkwe_0__n__maf ip_knkwe_1__n__maf ip_knkwe_2__n__maf ip_knkwe_3__n__maf ip_knkwe_4__n__maf ip_knkwe_5__n__maf ip_gain_knk_0__n__maf ip_gain_knk_2__n__maf ip_gain_knk_3__n__maf ip_gain_knk_4__n__maf ip_gain_knk_5__n__maf ip_itc_knk_0__n__maf ip_itc_knk_1__n__maf ip_itc_knk_2__n__maf ip_itc_knk_3__n__maf ip_itc_knk_4__n__maf ip_itc_knk_5__n__maf ip_knkwb_0__n__maf /end DEF_CHARACTERISTIC
 /begin OUT_MEASUREMENT iga_ad1_knk[0] iga_ad1_knk[1] iga_ad1_knk[2] iga_ad1_knk[3] iga_ad1_knk[4] iga_ad1_knk[5] iga_ad2_knk iga_knk[0] iga_knk[1] iga_knk[2] iga_knk[3] iga_knk[4] iga_knk[5] knk_thd[0] knk_thd[1] knk_thd[2] knk_thd[3] knk_thd[4] knk_thd[5] knks_cmd_fil[0] knks_cmd_fil[1] knks_cmd_fil[2] knks_cmd_fil[3] knks_cmd_fil[4] knks_cmd_fil[5] knkwb[0] knkwb[1] knkwb[2] knkwb[3] knkwb[4] knkwb[5] knkwe[0] knkwe[1] knkwe[2] knkwe[3] knkwe[4] knkwe[5] lv_knk_ad1_ena lv_knk_ad2_ena lv_knk_ctl_ena lv_knk_tra_maf maf_knk n_knk nl[0] nl[1] nl[2] nl[3] nl[4] nl[5] lv_knk_tra_n iga_adj_knk[0] iga_adj_knk[1] iga_adj_knk[2] iga_adj_knk[3] iga_adj_knk[4] iga_adj_knk[5] iga_adj_max_knk dly_iga_adj_knk_diag iga_mv_adj_knk cyl_id_knk lv_knk iga_mv_knk fac_iga_max_knk knks_cmd_gain[0] knks_cmd_gain[1] knks_cmd_gain[2] knks_cmd_gain[3] knks_cmd_gain[4] knks_cmd_gain[5] knks_cmd_int[0] knks_cmd_int[1] knks_cmd_int[2] knks_cmd_int[3] knks_cmd_int[4] knks_cmd_int[5] iga_ad1_ad2_knk[0] iga_ad1_ad2_knk[1] iga_ad1_ad2_knk[2] iga_ad1_ad2_knk[3] iga_ad1_ad2_knk[4] iga_ad1_ad2_knk[5] knk_ctl_dis lv_knk_ad_rd_ena knk_ad1_dis knk_ad2_dis knks[0] knks[1] knks[2] knks[3] knks[4] knks[5] /end OUT_MEASUREMENT
/end FUNCTION
/begin FUNCTION IGA_Ignition_angle_for_stratifie "_Ignition angle for stratified mode" /end FUNCTION
/begin FUNCTION IGA_Corrected_Reference_Ignition "_Corrected Reference Ignition Angle"
 /begin DEF_CHARACTERISTIC ip_iga_ref__n__maf ip_iga_ref_lamb__lamb_sp ip_iga_ref_temp__n__maf ip_iga_ref_vvt__n__maf ip_iga_ref_temp_fac__tia__tco ip_iga_ref_egr_fac__n__maf ip_iga_ref_egr ip_fac_iga_ref_port ip_fac_iga_ref_egr_lamb ip_iga_ref_port /end DEF_CHARACTERISTIC
 /begin OUT_MEASUREMENT iga_ref_cor iga_ref_temp_cor iga_ref_vvt_cor iga_ref_egr_cor egr_ratio_cor iga_ref_lamb_cor iga_ref_port_cor /end OUT_MEASUREMENT
/end FUNCTION
/begin FUNCTION IGA_Ignition_angle_correction_du "_Ignition angle correction due to EGR" /end FUNCTION
/begin FUNCTION IGA_Temperature_Correction "_Temperature Correction"
 /begin DEF_CHARACTERISTIC ip_iga_bas_temp_cor__tco__tia ip_fac_iga_pos__n_32__maf ip_fac_iga_neg__n_32__maf /end DEF_CHARACTERISTIC
 /begin OUT_MEASUREMENT iga_bas_temp_cor /end OUT_MEASUREMENT
/end FUNCTION
/begin FUNCTION IGA_RON_Adaptation "_RON Adaptation"
 /begin DEF_CHARACTERISTIC c_tco_ad_min_ron c_cycnr_ad_rtd_knk c_iga_min_ad c_iga_max_ad c_cycnr_fac_ron c_tco_fac_ron_min c_tco_fac_ron_max c_fac_ron_ad_cold c_fac_ron_ad_hot id_maf_min_knk_ad_2__n_32 ip_fac_ron_inc__n_32 ip_fac_ron_dec__n_32 ip_fac_ron_ad_max__tia__tco /end DEF_CHARACTERISTIC
 /begin OUT_MEASUREMENT fac_ron_ad lv_fac_ron_ad_act /end OUT_MEASUREMENT
/end FUNCTION
/begin FUNCTION IGA_Minimum_IGA_limitation_for_e "_Minimum IGA limitation for exhaust gas temperature protection" /begin DEF_CHARACTERISTIC c_teg_max_iga_hys c_teg_max_iga ip_iga_dif_min_teg__teg /end DEF_CHARACTERISTIC
 /begin OUT_MEASUREMENT iga_min_teg iga_dif_min_teg eff_iga_min_teg teg_dyn_hys teg_cat_up_mdl_max /end OUT_MEASUREMENT
/end FUNCTION
/begin FUNCTION IGA_Catalyst_heating_correction "_Catalyst heating correction"
 /begin DEF_CHARACTERISTIC ip_fac_iga_ch_tco ip_iga_ch_cold_is_alter ip_iga_ch_cold_is ip_iga_ch_hot_is_alter ip_iga_ch_hot_is ip_fac_red_ch_mt ip_fac_red_ch_ctr_km ip_fac_red_ch_at ip_fac_red_ch_is ip_fac_red_ch_is_dri ip_crlc_tq_add_ch c_t_deac_ch_tq_add c_t_dri_ch c_t_ch_is_alter c_t_deac_ch_is ip_iga_ch_hot_pl ip_iga_ch_hot_pl_wout_cat ip_iga_ch_cold_pl ip_iga_ch_cold_pl_wout_cat /end DEF_CHARACTERISTIC
 /begin OUT_MEASUREMENT tq_add_ch iga_ch_bas iga_dif_ch_bas eff_iga_ch_bas tq_add_ch_bas fac_red_tq_add_ch fac_deac_ch_dri tq_add_ch_red fac_deac_ch fac_deac_ch_is fac_ch_is_alter /end OUT_MEASUREMENT
/end FUNCTION
/begin FUNCTION IGA_Load_dynamics_correction "_Load dynamics correction"
 /begin DEF_CHARACTERISTIC id_tps_grd_iga_tra_knk id_map_drv1_iga_tra_knk ip_iga_tra_knk ip_fac_iga_tra ip_fac_iga_tra_gear_mt ip_fac_iga_tra_gear_at id_cyc_iga_tra_knk_dly ip_iga_tra_inc id_cyc_iga_tra_knk_act id_cyc_iga_tra_knk_wait c_n_min_iga_tra_cs /end DEF_CHARACTERISTIC
 /begin OUT_MEASUREMENT iga_tra_knk iga_tra_knk_inter lv_iga_tra_knk ctr_cyc_iga_tra_knk_dly ctr_cyc_iga_tra_knk_act ctr_cyc_iga_tra_knk_wait state_iga_tra_knk /end OUT_MEASUREMENT
/end FUNCTION
/begin FUNCTION INJ_Injection "INJ"
 /begin SUB_FUNCTION INJ_General_Calculation_of_Fuel_ INJ_Injection_phase INJ_Start_injection_time_for_sta INJ_Injector_dead_time_correctio INJ_Cold_post_start_correction INJ_Warm_up_correction INJ_Catalyst_heating_correction INJ_High_torque_request_enrichme INJ_Wall_film_correction_TI_ADD_ INJ_Cylinder_shut_off INJ_Upstream_oxygen_sensor_signa INJ_Upstream_oxygen_sensor_heate INJ_Lambda_control_A_F_Feedback_ INJ_Lambda_control_correction_TI INJ_Application_incidence_for_th INJ_Downstream_fuel_trim_regulat INJ_Detection_of_limited_dynamic INJ_Downstream_oxygen_sensor_sig INJ_Downstream_oxygen_sensor_hea INJ_Injection_fuel_setpoint_for_ INJ_Injection_pressure_correctio INJ_Lambda_coordination INJ_Lambda_Catalyst_overheating_ INJ_Conversion_MFF_to_TI INJ_Basic_Lambda_Setpoint_includ INJ_Ambient_pressure_correction INJ_Lambda_setpoint_for_catalyst INJ_Injection_Pressure_Correctio INJ_Injection_setpoint_for_strat INJ_Mass_Fuel_Flow_Setpoint_for_ INJ_LAMB_RATIO_calculation INJ_Catalyst_heating_with_second INJ_Injection_Time_Correction_by INJ_Transformation_layer_for_bas INJ_Upstream_oxygen_sensor_inter INJ_Downstream_oxygen_sensor_int INJ_Exhaust_Gas_temperature_mode INJ_Detection_of_dew_point INJ_Cylinder_selective_mixture_c INJ_Injection_at_restart_fuel_fe INJ_Catalyst_enrichment_function INJ_Application_incidences_for_c INJ_Fuel_mass_setpoint_and_pre_i INJ_Application_Incidences_for_D INJ_Application_incidences_for_u INJ_Application_incidences_for_d INJ_Lambda_Adaptation INJ_Injection_Phase_for_Stratifi INJ_Restart_function INJ_MFF_Split_Up_for_DUI_at_Stra INJ_Application_incidences_for_i INJ_Application_incidences_for_s INJ_Upstream_oxygen_sensor_opera INJ_Downstream_oxygen_sensor_ope INJ_Application_incidence_exhaus INJ_Lambda_Setpoint_for_Single_C INJ_CO_adjustment_at_idling INJ_Application_incidences_for_C INJ_Inhibition_Conditions_for_OB INJ_Application_specific_conditi INJ_Inhibition_conditions_for_OB /end SUB_FUNCTION
/end FUNCTION
/begin FUNCTION INJ_General_Calculation_of_Fuel_ "_General Calculation of Fuel Inj Time"
 /begin DEF_CHARACTERISTIC c_mff_fac ip_ti_st_amp_fac__amp ip_ti_deac_cast__cyc_cast__tco ip_ti_cast__tia__tco ip_ti_add_dly ip_ti_st_rest ip_rest ip_fac_rest ip_fac_stall /end DEF_CHARACTERISTIC
 /begin OUT_MEASUREMENT mff_bas ti_cast lv_ast_end mff_sp ti_add_dly /end OUT_MEASUREMENT
/end FUNCTION
/begin FUNCTION INJ_Injection_phase "_Injection phase"
 /begin DEF_CHARACTERISTIC ip_eoi_h_prs_cst ip_eoi_l_prs_cst c_eoi_lim lc_eoi_hom_man c_eoi_hom_man c_soi_min_cst_l_prs c_soi_min_cst_h_prs ip_eoi_tco c_eoi_as lc_eoi_cor_ivvt_vvl ip_cam_op_in_vvl__vlft_av ip_eoi_bas ip_eoi_bas_is /end DEF_CHARACTERISTIC
 /begin OUT_MEASUREMENT soi_hom eoi_hom_clc eoi_tco ti_hom_max_cst eoi_bas eoi_lim cam_op_in_vvl eoi_ivvt_vvl eoi_hom /end OUT_MEASUREMENT
/end FUNCTION
/begin FUNCTION INJ_Start_injection_time_for_sta "_Start injection time for start injection amount" /end FUNCTION
/begin FUNCTION INJ_Injector_dead_time_correctio "_Injector dead time correction" /end FUNCTION
/begin FUNCTION INJ_Cold_post_start_correction "_Cold post start correction" /begin DEF_CHARACTERISTIC ip_ti_cast_fac_tco ip_ti_cast_fac_map /end DEF_CHARACTERISTIC /end FUNCTION
/begin FUNCTION INJ_Warm_up_correction "_Warm up correction"
 /begin DEF_CHARACTERISTIC ip_ti_wup__n__maf ip_ti_tco_wup__tco__tco_st ip_ti_vo_wup__tco__vo ip_ti_fac_n_map ip_ti_fac_tia_toil ip_ti_fac_tco ip_fac_ti_vo_wup ip_fac_ti_tco_wup /end DEF_CHARACTERISTIC
 /begin OUT_MEASUREMENT ti_wup_1 ti_wup ti_temp /end OUT_MEASUREMENT
/end FUNCTION
/end MODULE
/end PROJECT
