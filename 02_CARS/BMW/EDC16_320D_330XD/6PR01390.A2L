ASAP2_VERSION 1 3
/begin PROJECT P390 "BMW DDE6.2 6-Zylinder VR0.1 15.03.2004 CAN11/12H"
/begin HEADER "" VERSION "VR0.1_6Z_CAN11/12H" PROJECT_NO P390 /end HEADER
/begin MODULE DIM ""
/begin MOD_COMMON "" BYTE_ORDER MSB_FIRST ALIGNMENT_BYTE 1 ALIGNMENT_WORD 2 ALIGNMENT_LONG 4 ALIGNMENT_FLOAT32_IEEE 4 /end MOD_COMMON
/begin CHARACTERISTIC EGSys_AlpFreeCnvtTube_C "Wärmeübertragungskoeffizient am Abgasrohr aufgrund freier Konvektion" VAL_BLK 0xCED10 Kwb_Ws16 999.9000 ThermalCoEff 0.1000000 1000.000 FORMAT "%8.3" EXTENDED_LIMITS -3276.800 3276.700 NUMBER 2 /end CHARACTERISTIC
/begin CHARACTERISTIC EGSys_cpChrg_C "Wärmekapazität Turbolader" VALUE 0xCEC3C Kw_Ws16 3000.000 HeatCapacity 0.00 3000.000 FORMAT "%8.3" EXTENDED_LIMITS -3276.800 3276.700 /end CHARACTERISTIC
/begin CHARACTERISTIC EGSys_cpTube_C "Wärmekapazität Abgasrohr" VAL_BLK 0xCED14 Kwb_Ws16 2999.900 HeatCapacity 0.1000000 3000.000 FORMAT "%8.3" EXTENDED_LIMITS -3276.800 3276.700 NUMBER 2 /end CHARACTERISTIC
/begin CHARACTERISTIC EGSys_etaChrg_MAP "Kennfeld Gesamtwirkungsgrad Turbolader" MAP 0xCEC3E Kf_Xs16_Ys16_Ws16 0.9998779 Fact 0.0001220703 1.000000 FORMAT "%8.6" EXTENDED_LIMITS -4.000000 3.999878
 /begin AXIS_DESCR STD_AXIS AFSCD_dmAirPerTime AirMassPerTime 8 0.00 1000.000 FORMAT "%8.3" EXTENDED_LIMITS -3276.800 3276.700 DEPOSIT ABSOLUTE /end AXIS_DESCR
 /begin AXIS_DESCR STD_AXIS EGSys_rPresCmpr_mp Fact 8 0.00 8.000000 FORMAT "%8.6" EXTENDED_LIMITS -4.000000 3.999878 DEPOSIT ABSOLUTE /end AXIS_DESCR
/end CHARACTERISTIC
/begin CHARACTERISTIC EGSys_lDiamTube_C "Durchmesser Abgasrohr" VAL_BLK 0xCED18 Kwb_Ws16 99.99219 Length1 0.007812500 100.0000 FORMAT "%8.4" EXTENDED_LIMITS -256.0000 255.9922 NUMBER 2 /end CHARACTERISTIC
/begin CHARACTERISTIC EGSys_lLngthTube_C "Länge Abgasrohr" VAL_BLK 0xCED1C Kwb_Ws16 99.99219 Length1 0.007812500 100.0000 FORMAT "%8.4" EXTENDED_LIMITS -256.0000 255.9922 NUMBER 2 /end CHARACTERISTIC
/begin CHARACTERISTIC EGSys_NuTubeEnv_CUR "Nusselt-Zahl Abgasrohr-Aussenumströmung (nicht applizierbar)" CURVE 0xCED20 Kl_Xs16_Ws16 5309.000 OneToOne 0.00 5309.000 FORMAT "%8.3" EXTENDED_LIMITS -32768.00 32767.00 READ_ONLY
 /begin AXIS_DESCR STD_AXIS EGSys_ReTubeEnvInpCrv_mp OneToOne 8 0.00 3750.000 FORMAT "%8.3" EXTENDED_LIMITS -32768.00 32767.00 DEPOSIT ABSOLUTE /end AXIS_DESCR
/end CHARACTERISTIC
/begin CHARACTERISTIC EGSys_NuTube_CUR "Nusselt-Zahl für Abgasrohrdurchströmung (nicht applizierbar)" CURVE 0xCED42 Kl_Xs16_Ws16 1130.000 OneToOne 0.00 1130.000 FORMAT "%8.3" EXTENDED_LIMITS -32768.00 32767.00 READ_ONLY
 /begin AXIS_DESCR STD_AXIS EGSys_ReTubeInpCrv_mp ReynoldsNum 8 0.00 800000.0 FORMAT "%8.1" EXTENDED_LIMITS -3276800. 3276700. DEPOSIT ABSOLUTE /end AXIS_DESCR
/end CHARACTERISTIC
/begin CHARACTERISTIC EGSys_tiChrgPT1_C "Feste thermische Zeitkonstante Turbolader" VALUE 0xCECE4 Kw_Wu32 4294.9663 TimeDelay_s 0.0010000001 4294.9673 FORMAT "%9.4" EXTENDED_LIMITS 0.0000010000000 4294.9673 /end CHARACTERISTIC
/begin CHARACTERISTIC EGSys_pValDfl_C "Vorgabewert Umgebungsdruck für Turboladermodell" VALUE 0xCECE8 Kw_Ws16 3000.000 Pres_hPa 500.0000 3500.000 FORMAT "%8.3" EXTENDED_LIMITS -32768.00 32767.00 /end CHARACTERISTIC
/begin CHARACTERISTIC EGSys_rSqTube_C "Anteil der vom Fahrtwind beaufschlagten Oberfläche Abgasrohr" VAL_BLK 0xCED64 Kwb_Ws16 3.800049 Fact 0.09997559 3.900024 FORMAT "%8.6" EXTENDED_LIMITS -4.000000 3.999878 NUMBER 2 /end CHARACTERISTIC
/begin CHARACTERISTIC EGSys_rTempAdbt_CUR "Kennlinie für die adiabatische Zustandänderung der Temperatur (nicht applizierbar)" CURVE 0xCECEA Kl_Xs16_Ws16 0.4000244 Fact 1.000000 1.400024 FORMAT "%8.6" EXTENDED_LIMITS -4.000000 3.999878 READ_ONLY
 /begin AXIS_DESCR STD_AXIS EGSys_rPresCmpr_mp Fact 8 1.000000 8.000000 FORMAT "%8.6" EXTENDED_LIMITS -4.000000 3.999878 DEPOSIT ABSOLUTE /end AXIS_DESCR
/end CHARACTERISTIC
/begin CHARACTERISTIC EGSys_swtTimeChrg_C "Schalter zur Verwendung fester oder variabler thermischer Zeitkonstante für Turbolader (1 = fest, 0 = variabel)" VALUE 0xCED0C Kw_Wu8 1.000 OneToOne 0.00 1.000 FORMAT "%5.3" EXTENDED_LIMITS 0.00 255.0 /end CHARACTERISTIC
/begin CHARACTERISTIC EGSys_tEGPstTrbnDfl_C "Ersatzwert Turbinentemperatur im Fehlerfall" VALUE 0xCED0E Kw_Ws16 950.000 Temp_Cels -50.140 899.860 FORMAT "%8.3" EXTENDED_LIMITS -3549.940 3003.560 /end CHARACTERISTIC
/begin CHARACTERISTIC EGSys_tEGTubeDfl_C "Ersatzwert Abgastemperatur im Abgasrohr" VAL_BLK 0xCED68 Kwb_Ws16 950.000 Temp_Cels -50.140 899.860 FORMAT "%8.3" EXTENDED_LIMITS -3549.940 3003.560 NUMBER 2 /end CHARACTERISTIC
/begin CHARACTERISTIC EGSys_tTubeDfl_C "Ersatzwert Abgasrohr-Temperatur" VAL_BLK 0xCED6C Kwb_Ws16 950.000 Temp_Cels -50.140 899.860 FORMAT "%8.3" EXTENDED_LIMITS -3549.940 3003.560 NUMBER 2 /end CHARACTERISTIC
/begin CHARACTERISTIC EGSys_tTubeIKi_C "I-Verstärkung Integrator zur Abgasrohr-Temperaturmodellierung" VALUE 0xCED70 Kw_Wu32 4.00003045797 Ki_Kelv_Sec 0.00 4.00003045797 FORMAT "%13.11" EXTENDED_LIMITS 0.00 9999999.99767 /end CHARACTERISTIC
/begin CHARACTERISTIC EGSys_tTubeIKiPos_C "I-Verstärkung Integrator Abgasrohr-Temperaturmodellierung für pos. Großsignalbereich" VALUE 0xCED74 Kw_Wu32 4.00003045797 Ki_Kelv_Sec 0.00 4.00003045797 FORMAT "%13.11" EXTENDED_LIMITS 0.00 9999999.99767 /end CHARACTERISTIC
/begin CHARACTERISTIC EGSys_tTubeIKiNeg_C "I-Verstärkung Integrator Abgasrohr-Temperaturmodellierung für neg. Großsignalbereich" VALUE 0xCED78 Kw_Wu32 4.00003045797 Ki_Kelv_Sec 0.00 4.00003045797 FORMAT "%13.11" EXTENDED_LIMITS 0.00 9999999.99767 /end CHARACTERISTIC
/begin CHARACTERISTIC EGSys_tTubeIWinPos_C "Obere Kleinstwertgrenze Integrator zur Abgasrohr-Temperaturmodellierung" VALUE 0xCED7C Kw_Ws16 65535.00 OneToOne -32768.00 32767.00 FORMAT "%8.2" READ_ONLY /end CHARACTERISTIC
/begin CHARACTERISTIC EGSys_tTubeIWinNeg_C "Untere Kleinstwertgrenze Integrator zur Abgasrohr-Temperaturmodellierung" VALUE 0xCED7E Kw_Ws16 65535.00 OneToOne -32768.00 32767.00 FORMAT "%8.2" READ_ONLY /end CHARACTERISTIC
/begin CHARACTERISTIC EGT_facKiAMPT_MAP "Grundwert I-Anteil des Reglereingriffs über Luftmasse" MAP 0xCED94 Kf_Xs16_Ys16_Ws16 0.06000046 Ki_Temp2EGTFact 0.00 0.06000046 FORMAT "%10.8" EXTENDED_LIMITS -0.03814697 0.03814581
 /begin AXIS_DESCR STD_AXIS Eng_nAvrg EngN 8 0.00 6000.000 FORMAT "%8.3" EXTENDED_LIMITS -32768.00 32767.00 DEPOSIT ABSOLUTE /end AXIS_DESCR
 /begin AXIS_DESCR STD_AXIS InjCtl_qSetUnBal InjMassCyc 8 0.00 327.6700 FORMAT "%8.4" EXTENDED_LIMITS -327.6800 327.6700 DEPOSIT ABSOLUTE /end AXIS_DESCR
/end CHARACTERISTIC
/begin CHARACTERISTIC EGT_facKiInrTempGvnr_C "Korrekturfaktor des I-Anteils bei Großsignalverstärkung des inneren Reglers" VALUE 0xCEE38 Kw_Wu32 4.00000000000 Fact1 0.00 4.00000000000 FORMAT "%13.11" EXTENDED_LIMITS 0.00 33554431.9922 /end CHARACTERISTIC
/begin CHARACTERISTIC EGT_facKiOutrTempGvnr_C "Korrekturfaktor des I-Anteils bei Großsignalvertsärkung des äußeren Reglers" VALUE 0xCEE3C Kw_Wu32 4.00000000000 Fact1 0.00 4.00000000000 FORMAT "%13.11" EXTENDED_LIMITS 0.00 33554431.9922 /end CHARACTERISTIC
/begin CHARACTERISTIC EGT_facKiQntPoI1_MAP "Grundwert I-Anteil des äußeren Reglers bei Eingriff über Einspritzung" MAP 0xCEE40 Kf_Xs16_Ys16_Ws16 0.06000046 Ki_Temp2EGTFact 0.00 0.06000046 FORMAT "%10.8" EXTENDED_LIMITS -0.03814697 0.03814581
 /begin AXIS_DESCR STD_AXIS Eng_nAvrg EngN 8 0.00 6000.000 FORMAT "%8.3" EXTENDED_LIMITS -32768.00 32767.00 DEPOSIT ABSOLUTE /end AXIS_DESCR
 /begin AXIS_DESCR STD_AXIS InjCtl_qSetUnBal InjMassCyc 8 0.00 327.6700 FORMAT "%8.4" EXTENDED_LIMITS -327.6800 327.6700 DEPOSIT ABSOLUTE /end AXIS_DESCR
/end CHARACTERISTIC
/begin CHARACTERISTIC EGT_facKiQntPoI2_MAP "Grundwert I-Anteil des inneren Reglers bei Eingriff über Einspritzung" MAP 0xCEEE4 Kf_Xs16_Ys16_Ws16 0.06000046 Ki_Temp2EGTFact 0.00 0.06000046 FORMAT "%10.8" EXTENDED_LIMITS -0.03814697 0.03814581
 /begin AXIS_DESCR STD_AXIS Eng_nAvrg EngN 8 0.00 6000.000 FORMAT "%8.3" EXTENDED_LIMITS -32768.00 32767.00 DEPOSIT ABSOLUTE /end AXIS_DESCR
 /begin AXIS_DESCR STD_AXIS InjCtl_qSetUnBal InjMassCyc 8 0.00 327.6700 FORMAT "%8.4" EXTENDED_LIMITS -327.6800 327.6700 DEPOSIT ABSOLUTE /end AXIS_DESCR
/end CHARACTERISTIC
/begin CHARACTERISTIC EGT_facKiTempInrCor_MAP "Grundwert I-Anteil des inneren Reglers bei Eingriff über Temperatursollwert" MAP 0xCEF88 Kf_Xs16_Ys16_Ws16 0.06000046 Ki_Temp2EGTFact 0.00 0.06000046 FORMAT "%10.8" EXTENDED_LIMITS -0.03814697 0.03814581
 /begin AXIS_DESCR STD_AXIS Eng_nAvrg EngN 8 0.00 6000.000 FORMAT "%8.3" EXTENDED_LIMITS -32768.00 32767.00 DEPOSIT ABSOLUTE /end AXIS_DESCR
 /begin AXIS_DESCR STD_AXIS InjCtl_qSetUnBal InjMassCyc 8 0.00 327.6700 FORMAT "%8.4" EXTENDED_LIMITS -327.6800 327.6700 DEPOSIT ABSOLUTE /end AXIS_DESCR
/end CHARACTERISTIC
/begin CHARACTERISTIC EGT_facKpAMPT_MAP "Grundwert P-Anteil des inneren Reglers bei Eingriff über Luftmasse" MAP 0xCF02C Kf_Xs16_Ys16_Ws16 0.06000000 Kp_Temp2EGTFact 0.00 0.06000000 FORMAT "%10.8" EXTENDED_LIMITS -0.6400000 0.6399805
 /begin AXIS_DESCR STD_AXIS Eng_nAvrg EngN 8 0.00 6000.000 FORMAT "%8.3" EXTENDED_LIMITS -32768.00 32767.00 DEPOSIT ABSOLUTE /end AXIS_DESCR
 /begin AXIS_DESCR STD_AXIS InjCtl_qSetUnBal InjMassCyc 8 0.00 327.6700 FORMAT "%8.4" EXTENDED_LIMITS -327.6800 327.6700 DEPOSIT ABSOLUTE /end AXIS_DESCR
/end CHARACTERISTIC
/begin CHARACTERISTIC EGT_facKpInrTempGvnr_C "Korrekturfaktor P-Anteil bei Großsignalverstärkung des inneren Reglers" VALUE 0xCF0D0 Kw_Ws32 4.00000000000 Fact1 0.00 4.00000000000 FORMAT "%13.11" EXTENDED_LIMITS -16777216.0000 16777215.9922 /end CHARACTERISTIC
/begin CHARACTERISTIC EGT_facKpOutrTempGvnr_C "Korrekturfaktor P-Anteil bei Großsignalverstärkung des äußeren Reglers" VALUE 0xCF0D4 Kw_Ws32 4.00000000000 Fact1 0.00 4.00000000000 FORMAT "%13.11" EXTENDED_LIMITS -16777216.0000 16777215.9922 /end CHARACTERISTIC
/begin CHARACTERISTIC EGT_facKpQntPoI1_MAP "Grundwert P-Anteil des äußeren Reglers bei Eingriff über Einspritzung" MAP 0xCF0D8 Kf_Xs16_Ys16_Ws16 0.06000000 Kp_Temp2EGTFact 0.00 0.06000000 FORMAT "%10.8" EXTENDED_LIMITS -0.6400000 0.6399805
 /begin AXIS_DESCR STD_AXIS Eng_nAvrg EngN 8 0.00 6000.000 FORMAT "%8.3" EXTENDED_LIMITS -32768.00 32767.00 DEPOSIT ABSOLUTE /end AXIS_DESCR
 /begin AXIS_DESCR STD_AXIS InjCtl_qSetUnBal InjMassCyc 8 0.00 327.6700 FORMAT "%8.4" EXTENDED_LIMITS -327.6800 327.6700 DEPOSIT ABSOLUTE /end AXIS_DESCR
/end CHARACTERISTIC
/begin CHARACTERISTIC EGT_facKpQntPoI2_MAP "Grundwert P-Anteil des inneren Reglers bei Eingriff über Einspritzung" MAP 0xCF17C Kf_Xs16_Ys16_Ws16 0.06000000 Kp_Temp2EGTFact 0.00 0.06000000 FORMAT "%10.8" EXTENDED_LIMITS -0.6400000 0.6399805
 /begin AXIS_DESCR STD_AXIS Eng_nAvrg EngN 8 0.00 6000.000 FORMAT "%8.3" EXTENDED_LIMITS -32768.00 32767.00 DEPOSIT ABSOLUTE /end AXIS_DESCR
 /begin AXIS_DESCR STD_AXIS InjCtl_qSetUnBal InjMassCyc 8 0.00 327.6700 FORMAT "%8.4" EXTENDED_LIMITS -327.6800 327.6700 DEPOSIT ABSOLUTE /end AXIS_DESCR
/end CHARACTERISTIC
/begin CHARACTERISTIC EGT_facKpTempInrCor_MAP "Grundwert P-Anteil des inneren Reglers bei Eingriff über Temperatursollwert" MAP 0xCF220 Kf_Xs16_Ys16_Ws16 0.06000000 Kp_Temp2EGTFact 0.00 0.06000000 FORMAT "%10.8" EXTENDED_LIMITS -0.6400000 0.6399805
 /begin AXIS_DESCR STD_AXIS Eng_nAvrg EngN 8 0.00 6000.000 FORMAT "%8.3" EXTENDED_LIMITS -32768.00 32767.00 DEPOSIT ABSOLUTE /end AXIS_DESCR
 /begin AXIS_DESCR STD_AXIS InjCtl_qSetUnBal InjMassCyc 8 0.00 327.6700 FORMAT "%8.4" EXTENDED_LIMITS -327.6800 327.6700 DEPOSIT ABSOLUTE /end AXIS_DESCR
/end CHARACTERISTIC
/begin CHARACTERISTIC EGT_facQntPoI2Rmp_CUR "Anpassung Rampenwert an PoI2" CURVE 0xD0A28 Kl_Xs16_Ws16 1.000000 EGTSwt_S16 0.00 1.000000 FORMAT "%8.6" EXTENDED_LIMITS -2.000000 1.999939
 /begin AXIS_DESCR STD_AXIS EGT_facRmp_mp EGTSwt_S16 3 0.00 1.000000 FORMAT "%8.6" EXTENDED_LIMITS -2.000000 1.999939 DEPOSIT ABSOLUTE /end AXIS_DESCR
/end CHARACTERISTIC
/begin CHARACTERISTIC EGT_mAirDesTempGvnrMnl_C "Manueller Defaultwert für Luftmassensollwertkorektur" VALUE 0xD0A36 Kw_Ws16 10000.00 AirMassPerCyl -5000.000 5000.000 FORMAT "%8.3" EXTENDED_LIMITS -3276.800 3276.700 /end CHARACTERISTIC
/begin CHARACTERISTIC EGT_mAirLmbd_CUR "Luftmassenkorrektur über Lambdawert" CURVE 0xD0A38 Kl_Xs16_Ws16 10000.00 AirMassPerCyl -5000.000 5000.000 FORMAT "%8.3" EXTENDED_LIMITS -3276.800 3276.700
 /begin AXIS_DESCR STD_AXIS PFlt_rLmbd lambda 8 0.00 7.000000 FORMAT "%8.6" EXTENDED_LIMITS -32.76800 32.76700 DEPOSIT ABSOLUTE /end AXIS_DESCR
/end CHARACTERISTIC
/begin CHARACTERISTIC EGT_mAirTempGvnrMax_MAP "Maximal mögliche Luftmassensollwertkorrektur" MAP 0xCF2C4 Kf_Xs16_Ys16_Ws16 5000.000 AirMassPerCyl 0.00 5000.000 FORMAT "%8.3" EXTENDED_LIMITS -3276.800 3276.700
 /begin AXIS_DESCR STD_AXIS Eng_nAvrg EngN 16 0.00 6000.000 FORMAT "%8.3" EXTENDED_LIMITS -32768.00 32767.00 DEPOSIT ABSOLUTE /end AXIS_DESCR
 /begin AXIS_DESCR STD_AXIS InjCtl_qSetUnBal InjMassCyc 16 0.00 327.6700 FORMAT "%8.4" EXTENDED_LIMITS -327.6800 327.6700 DEPOSIT ABSOLUTE /end AXIS_DESCR
/end CHARACTERISTIC
/begin CHARACTERISTIC EGT_mAirTempGvnrMin_MAP "Minimal mögliche Luftmassensollwertkorrektur" MAP 0xCF508 Kf_Xs16_Ys16_Ws16 5000.000 AirMassPerCyl -5000.000 0.00 FORMAT "%8.3" EXTENDED_LIMITS -3276.800 3276.700
 /begin AXIS_DESCR STD_AXIS Eng_nAvrg EngN 16 0.00 6000.000 FORMAT "%8.3" EXTENDED_LIMITS -32768.00 32767.00 DEPOSIT ABSOLUTE /end AXIS_DESCR
 /begin AXIS_DESCR STD_AXIS InjCtl_qSetUnBal InjMassCyc 16 0.00 327.6700 FORMAT "%8.4" EXTENDED_LIMITS -327.6800 327.6700 DEPOSIT ABSOLUTE /end AXIS_DESCR
/end CHARACTERISTIC
/begin CHARACTERISTIC EGT_phiPoI1TempGvnr_MAP "Additive Winkelkorrektur der verzögerten Nacheinspritzung" MAP 0xD0A5A Kf_Xs16_Ys16_Ws16 399.9844 AngleCrS -199.9922 199.9922 FORMAT "%8.4" EXTENDED_LIMITS -768.0000 767.9766
 /begin AXIS_DESCR STD_AXIS Eng_nAvrg EngN 8 0.00 6000.000 FORMAT "%8.3" EXTENDED_LIMITS -32768.00 32767.00 DEPOSIT ABSOLUTE /end AXIS_DESCR
 /begin AXIS_DESCR STD_AXIS InjCtl_qSetUnBal InjMassCyc 8 0.00 327.6700 FORMAT "%8.4" EXTENDED_LIMITS -327.6800 327.6700 DEPOSIT ABSOLUTE /end AXIS_DESCR
/end CHARACTERISTIC
/begin CHARACTERISTIC EGT_qHCQntPoI1_CUR "Einspritzmengenkorrektur für HC-Dosierventil" CURVE 0xD0AFE Kl_Xs16_Ws16 400.0000 InjMassInj -200.0000 200.0000 FORMAT "%8.4" EXTENDED_LIMITS -327.6800 327.6700
 /begin AXIS_DESCR STD_AXIS EGT_qPoI1OutrTempGvnr InjMassInj 1 -200.0000 200.0000 FORMAT "%8.4" EXTENDED_LIMITS -327.6800 327.6700 DEPOSIT ABSOLUTE /end AXIS_DESCR
/end CHARACTERISTIC
/begin CHARACTERISTIC EGT_qPoI1Min_C "Minimalwert der angelagerten Nacheinspritzung" VALUE 0xCF74C Kw_Ws16 327.6700 InjMassInj 0.00 327.6700 FORMAT "%8.4" EXTENDED_LIMITS -327.6800 327.6700 /end CHARACTERISTIC
/begin CHARACTERISTIC EGT_qPoI1TempGvnrMax_MAP "Maximal mögliche Korrektur der angelagerten Nacheinspritzung" MAP 0xCF74E Kf_Xs16_Ys16_Ws16 200.0000 InjMassInj 0.00 200.0000 FORMAT "%8.4" EXTENDED_LIMITS -327.6800 327.6700
 /begin AXIS_DESCR STD_AXIS Eng_nAvrg EngN 16 0.00 6000.000 FORMAT "%8.3" EXTENDED_LIMITS -32768.00 32767.00 DEPOSIT ABSOLUTE /end AXIS_DESCR
 /begin AXIS_DESCR STD_AXIS InjCtl_qSetUnBal InjMassCyc 16 0.00 327.6700 FORMAT "%8.4" EXTENDED_LIMITS -327.6800 327.6700 DEPOSIT ABSOLUTE /end AXIS_DESCR
/end CHARACTERISTIC
/begin CHARACTERISTIC EGT_qPoI1TempGvnrMin_MAP "Minimal mögliche Korrektur der angelagerten Nacheinspritzung" MAP 0xCF992 Kf_Xs16_Ys16_Ws16 200.0000 InjMassInj -200.0000 0.00 FORMAT "%8.4" EXTENDED_LIMITS -327.6800 327.6700
 /begin AXIS_DESCR STD_AXIS Eng_nAvrg EngN 16 0.00 6000.000 FORMAT "%8.3" EXTENDED_LIMITS -32768.00 32767.00 DEPOSIT ABSOLUTE /end AXIS_DESCR
 /begin AXIS_DESCR STD_AXIS InjCtl_qSetUnBal InjMassCyc 16 0.00 327.6700 FORMAT "%8.4" EXTENDED_LIMITS -327.6800 327.6700 DEPOSIT ABSOLUTE /end AXIS_DESCR
/end CHARACTERISTIC
/begin CHARACTERISTIC EGT_qPoI1TempGvnrMnl_C "Manueller Defaultwert der angelagerten Nacheinspritzung" VALUE 0xD0B04 Kw_Ws16 400.0000 InjMassInj -200.0000 200.0000 FORMAT "%8.4" EXTENDED_LIMITS -327.6800 327.6700 /end CHARACTERISTIC
/begin CHARACTERISTIC EGT_qPoI2Min_C "Minimalwert der angelagerten Nacheinspritzung" VALUE 0xCFBD6 Kw_Ws16 327.6700 InjMassInj 0.00 327.6700 FORMAT "%8.4" EXTENDED_LIMITS -327.6800 327.6700 /end CHARACTERISTIC
/begin CHARACTERISTIC EGT_qPoI2TempGvnrMax_MAP "Maximal mögliche Korrekturmenge der angelagerten Nacheinspritzung" MAP 0xCFBD8 Kf_Xs16_Ys16_Ws16 200.0000 InjMassInj 0.00 200.0000 FORMAT "%8.4" EXTENDED_LIMITS -327.6800 327.6700
 /begin AXIS_DESCR STD_AXIS Eng_nAvrg EngN 16 0.00 6000.000 FORMAT "%8.3" EXTENDED_LIMITS -32768.00 32767.00 DEPOSIT ABSOLUTE /end AXIS_DESCR
 /begin AXIS_DESCR STD_AXIS InjCtl_qSetUnBal InjMassCyc 16 0.00 327.6700 FORMAT "%8.4" EXTENDED_LIMITS -327.6800 327.6700 DEPOSIT ABSOLUTE /end AXIS_DESCR
/end CHARACTERISTIC
/begin CHARACTERISTIC EGT_qPoI2TempGvnrMin_MAP "Minimal mögliche Korrekturmenge der angelagerten Nacheinspritzung" MAP 0xCFE1C Kf_Xs16_Ys16_Ws16 200.0000 InjMassInj -200.0000 0.00 FORMAT "%8.4" EXTENDED_LIMITS -327.6800 327.6700
 /begin AXIS_DESCR STD_AXIS Eng_nAvrg EngN 16 0.00 6000.000 FORMAT "%8.3" EXTENDED_LIMITS -32768.00 32767.00 DEPOSIT ABSOLUTE /end AXIS_DESCR
 /begin AXIS_DESCR STD_AXIS InjCtl_qSetUnBal InjMassCyc 16 0.00 327.6700 FORMAT "%8.4" EXTENDED_LIMITS -327.6800 327.6700 DEPOSIT ABSOLUTE /end AXIS_DESCR
/end CHARACTERISTIC
/begin CHARACTERISTIC EGT_qPoI2TempGvnrMnl_C "Manueller Defaultwert der angelagerten Nacheinspritzung" VALUE 0xD0B06 Kw_Ws16 400.0000 InjMassInj -200.0000 200.0000 FORMAT "%8.4" EXTENDED_LIMITS -327.6800 327.6700 /end CHARACTERISTIC
/begin CHARACTERISTIC EGT_rInrDvtThres_C "Schwelle für Großsignalverstärkung des inneren Reglers" VALUE 0xD0060 Kw_Ws16 6.000000 EGTFact -3.000000 3.000000 FORMAT "%8.6" EXTENDED_LIMITS -32.76800 32.76700 /end CHARACTERISTIC
/begin CHARACTERISTIC EGT_rOutrDvtThres_C "Schwelle für Großsignalverstärkung des äußeren Regelkreises" VALUE 0xD0062 Kw_Ws16 6.000000 EGTFact -3.000000 3.000000 FORMAT "%8.6" EXTENDED_LIMITS -32.76800 32.76700 /end CHARACTERISTIC
/begin CHARACTERISTIC EGT_stMskClsThrVlv_C "Bitmaske Anforderung maximale Androsselung" VALUE 0xD0064 Kw_Wu32 2147483647.00 OneToOne 0.00 2147483647.00 FORMAT "%13.2" EXTENDED_LIMITS 0.00 4294967295.00 /end CHARACTERISTIC
/begin CHARACTERISTIC EGT_stMskInrTempGvnr_C "Maske Aktivierung innerer Regelkreis" VALUE 0xD0A0C Kw_Wu32 2147483647.00 OneToOne 0.00 2147483647.00 FORMAT "%13.2" EXTENDED_LIMITS 0.00 4294967295.00 /end CHARACTERISTIC
/begin CHARACTERISTIC EGT_stMskOutrTempGvnr_C "Maske Aktivierung äußerer Regelkreis" VALUE 0xD0A10 Kw_Wu32 2147483647.00 OneToOne 0.00 2147483647.00 FORMAT "%13.2" EXTENDED_LIMITS 0.00 4294967295.00 /end CHARACTERISTIC
/begin CHARACTERISTIC EGT_stRgnLckMsk_C "Maske zur Blockierung und Aktivierung der Regenerationsmaßnahmen" VALUE 0xCED80 Kw_Wu32 2147483647.00 OneToOne 0.00 2147483647.00 FORMAT "%13.2" EXTENDED_LIMITS 0.00 4294967295.00 /end CHARACTERISTIC
/begin CHARACTERISTIC EGT_stTSync_Vector "#SSD Konfigurationslabel für Bypass" VALUE 0xC3096 Kw_Wu8 255.0 OneToOne 0.00 255.0 FORMAT "%5.1" /end CHARACTERISTIC
/begin CHARACTERISTIC EGT_stTSync_Channel "#SSD Konfigurationslabels für Bypass" VALUE 0xC3097 Kw_Wu8 255.0 OneToOne 0.00 255.0 FORMAT "%5.1" /end CHARACTERISTIC
/begin CHARACTERISTIC EGT_swtBiTrbTempGvnr_C "Bi-Turbo Schalter (Bi-Turbo-Betrieb-> 1, kein Bi-Turbo-> 0)" VALUE 0xD0068 Kw_Wu8 1.000 OneToOne 0.00 1.000 FORMAT "%5.3" EXTENDED_LIMITS 0.00 255.0 /end CHARACTERISTIC
/begin CHARACTERISTIC EGT_swtInrTempOutr_C "Innerer Regelkreis im stand-alone aktiv (=1), Regler in Kaskade (=0)" VALUE 0xD0069 Kw_Wu8 1.000 OneToOne 0.00 1.000 FORMAT "%5.3" EXTENDED_LIMITS 0.00 255.0 /end CHARACTERISTIC
/begin CHARACTERISTIC EGT_swtQntPoI1HC_C "Umschaltung: 1= angelagerte Nacheinspritzung, 0 = HC Dosierventil" VALUE 0xD0B08 Kw_Wu8 1.000 OneToOne 0.00 1.000 FORMAT "%5.3" EXTENDED_LIMITS 0.00 255.0 /end CHARACTERISTIC
/begin CHARACTERISTIC EGT_swtRgnLckRst_C "Schalter zum Rücksetzen der Verriegelung der Regenerationsmaßnahmen bei kritischer Ölverdünnungszeit (1: reset, 0: no reset)" VALUE 0xCED84 Kw_Wu8 1.000 OneToOne 0.00 1.000 FORMAT "%5.3" EXTENDED_LIMITS 0.00 255.0 /end CHARACTERISTIC
/begin CHARACTERISTIC EGT_swtServiceVal_C "Serviceschalter zur Rücksetzung nach Ölwechsel (1: Reset, 0: kein Reset)" VALUE 0xCED85 Kw_Wu8 1.000 OneToOne 0.00 1.000 FORMAT "%5.3" EXTENDED_LIMITS 0.00 255.0 /end CHARACTERISTIC
/begin CHARACTERISTIC EGT_swtTempInrDes_C "Schalttr zweischen kundenspezifischem Sollwert (=1) und innerem Regelkreis (=0)" VALUE 0xD04F8 Kw_Wu8 1.000 OneToOne 0.00 1.000 FORMAT "%5.3" EXTENDED_LIMITS 0.00 255.0 /end CHARACTERISTIC
/begin CHARACTERISTIC EGT_swtTempOutrDes_C "Schaltet zwischen kundenspezifischem Sollwert (=1) und äußerem Regelkreis (=0)" VALUE 0xD04F9 Kw_Wu8 1.000 OneToOne 0.00 1.000 FORMAT "%5.3" EXTENDED_LIMITS 0.00 255.0 /end CHARACTERISTIC
/begin CHARACTERISTIC EGT_swtTempTurbPre_C "Schalter für Umschaltung Temperatur vor Turbine (1: innererRegelkreis, 0: Temperatur vor Oxikat)" VALUE 0xD04FA Kw_Wu8 1.000 OneToOne 0.00 1.000 FORMAT "%5.3" EXTENDED_LIMITS 0.00 255.0 /end CHARACTERISTIC
/begin CHARACTERISTIC EGT_tiHiLoTempGvnr_C "Entprellzeit der Aktivierungsschwellen (high -> low) der Reglerkreise" VALUE 0xD0A14 Kw_Wu16 30.00000 Time_s 0.00 30.00000 FORMAT "%8.5" EXTENDED_LIMITS 0.00 655.3500 /end CHARACTERISTIC
/begin CHARACTERISTIC EGT_tiLoHiTempGvnr_C "Entprellzeit für Aktivierungsschwellen (low -> high) der Reglerkreise" VALUE 0xD0A16 Kw_Wu16 30.00000 Time_s 0.00 30.00000 FORMAT "%8.5" EXTENDED_LIMITS 0.00 655.3500 /end CHARACTERISTIC
/begin CHARACTERISTIC EGT_tInrCorTempGvnrMax_MAP "Maximal erlaubte Sollwertkorrektur des inneren Regelkreises" MAP 0xD006A Kf_Xs16_Ys16_Ws16 1600.000 TempDiff_Cels -100.0000 1500.000 FORMAT "%8.3" EXTENDED_LIMITS -3276.800 3276.700
 /begin AXIS_DESCR STD_AXIS Eng_nAvrg EngN 16 0.00 6000.000 FORMAT "%8.3" EXTENDED_LIMITS -32768.00 32767.00 DEPOSIT ABSOLUTE /end AXIS_DESCR
 /begin AXIS_DESCR STD_AXIS InjCtl_qSetUnBal InjMassCyc 16 0.00 327.6700 FORMAT "%8.4" EXTENDED_LIMITS -327.6800 327.6700 DEPOSIT ABSOLUTE /end AXIS_DESCR
/end CHARACTERISTIC
/begin CHARACTERISTIC EGT_tInrCorTempGvnrMin_MAP "Minimal erlaubte Sollwertkorrektur des inneren Regelkreises" MAP 0xD02AE Kf_Xs16_Ys16_Ws16 1500.000 TempDiff_Cels -1500.000 0.00 FORMAT "%8.3" EXTENDED_LIMITS -3276.800 3276.700
 /begin AXIS_DESCR STD_AXIS Eng_nAvrg EngN 16 0.00 6000.000 FORMAT "%8.3" EXTENDED_LIMITS -32768.00 32767.00 DEPOSIT ABSOLUTE /end AXIS_DESCR
 /begin AXIS_DESCR STD_AXIS InjCtl_qSetUnBal InjMassCyc 16 0.00 327.6700 FORMAT "%8.4" EXTENDED_LIMITS -327.6800 327.6700 DEPOSIT ABSOLUTE /end AXIS_DESCR
/end CHARACTERISTIC
/begin CHARACTERISTIC EGT_tInrDesTempTurb_CUR "Sollwertkorrektur des inneren Regelkreises in Abhängigkeit der Temperatur vor Turbolader" CURVE 0xD04FC Kl_Xs16_Ws16 1600.000 TempDiff_Cels -100.0000 1500.000 FORMAT "%8.3" EXTENDED_LIMITS -3276.800 3276.700
 /begin AXIS_DESCR STD_AXIS PFlt_tTurbPre Temp_Cels 8 -50.140 899.860 FORMAT "%8.3" EXTENDED_LIMITS -3549.940 3003.560 DEPOSIT ABSOLUTE /end AXIS_DESCR
/end CHARACTERISTIC
/begin CHARACTERISTIC EGT_tInrDes_MAP "Grundwert der Solltemperatur des inneren Regelkreises" MAP 0xD051E Kf_Xs16_Ys16_Ws16 950.000 Temp_Cels -50.140 899.860 FORMAT "%8.3" EXTENDED_LIMITS -3549.940 3003.560
 /begin AXIS_DESCR STD_AXIS Eng_nAvrg EngN 16 0.00 6000.000 FORMAT "%8.3" EXTENDED_LIMITS -32768.00 32767.00 DEPOSIT ABSOLUTE /end AXIS_DESCR
 /begin AXIS_DESCR STD_AXIS InjCtl_qSetUnBal InjMassCyc 16 0.00 327.6700 FORMAT "%8.4" EXTENDED_LIMITS -327.6800 327.6700 DEPOSIT ABSOLUTE /end AXIS_DESCR
/end CHARACTERISTIC
/begin CHARACTERISTIC EGT_tInrThresDwn_C "Untere Temperaturschwelle des inneren Regelkreises" VALUE 0xD0A18 Kw_Ws16 950.000 Temp_Cels -50.140 899.860 FORMAT "%8.3" EXTENDED_LIMITS -3549.940 3003.560 /end CHARACTERISTIC
/begin CHARACTERISTIC EGT_tInrThresUp_C "Obere Temperaturschwelle des inneren Regelkreises" VALUE 0xD0A1A Kw_Ws16 950.000 Temp_Cels -50.140 899.860 FORMAT "%8.3" EXTENDED_LIMITS -3549.940 3003.560 /end CHARACTERISTIC
/begin CHARACTERISTIC EGT_tiPoI1TThres_C "Wartezeit für Freigabe PoI1" VALUE 0xD04F4 Kw_Wu32 100.000000000 Time_s 0.00 100.000000000 FORMAT "%13.9" EXTENDED_LIMITS 0.00 42949672.9500 /end CHARACTERISTIC
/begin CHARACTERISTIC EGT_tiPoI2TempGvnr_MAP "Additive Winkelkorrektur der Nacheinspritzung" MAP 0xD0B0A Kf_Xs16_Ys16_Ws16 18000.00 InjTime_us -13000.00 5000.00 FORMAT "%8.2" EXTENDED_LIMITS -32768.00 32767.00
 /begin AXIS_DESCR STD_AXIS Eng_nAvrg EngN 8 0.00 6000.000 FORMAT "%8.3" EXTENDED_LIMITS -32768.00 32767.00 DEPOSIT ABSOLUTE /end AXIS_DESCR
 /begin AXIS_DESCR STD_AXIS InjCtl_qSetUnBal InjMassCyc 8 0.00 327.6700 FORMAT "%8.4" EXTENDED_LIMITS -327.6800 327.6700 DEPOSIT ABSOLUTE /end AXIS_DESCR
/end CHARACTERISTIC
/begin CHARACTERISTIC EGT_tiPoIHiLoTempGvnr_C "Entprellzeit für Nacheinspritzung (high -> low)" VALUE 0xD0A1C Kw_Wu16 30.00000 Time_s 0.00 30.00000 FORMAT "%8.5" EXTENDED_LIMITS 0.00 655.3500 /end CHARACTERISTIC
/begin CHARACTERISTIC EGT_tiPoILoHiTempGvnr_C "Entprellzeit für Nacheinspritzung (low -> high)" VALUE 0xD0A1E Kw_Wu16 30.00000 Time_s 0.00 30.00000 FORMAT "%8.5" EXTENDED_LIMITS 0.00 655.3500 /end CHARACTERISTIC
/begin CHARACTERISTIC EGT_tiRgnOilDilMax_C "Maximalschwelle für kritische Ölverdünnungszeit" VALUE 0xCED88 Kw_Wu32 500.000000000 Time_s 0.00 500.000000000 FORMAT "%13.9" EXTENDED_LIMITS 0.00 42949672.9500 /end CHARACTERISTIC
/begin CHARACTERISTIC EGT_tiRgnOilDilSubs_C "EEPROM Ersatzwert für kritische Ölverdünnungszeit" VALUE 0xCED8C Kw_Wu32 500.000000000 Time_s 0.00 500.000000000 FORMAT "%13.9" EXTENDED_LIMITS 0.00 42949672.9500 /end CHARACTERISTIC
/begin CHARACTERISTIC EGT_tiRmpSlpMax_C "Maximale Rampenlaufzeit für EGT-Mehrfachschalter" VALUE 0xCED90 Kw_Wu32 15.391030303030304 TimeEGTRmp 0.99296969696969695 16.384000000000000 FORMAT "%19.16" EXTENDED_LIMITS 0.000000015258789066052715 65.536000000000001 /end CHARACTERISTIC
/begin CHARACTERISTIC EGT_tiRmpSlpTempGvnr_C "Rampenzeit für Temperaturregler" VALUE 0xD0BB0 Kw_Wu32 31.775030303030302 TimeEGTRmp 0.99296969696969695 32.768000000000001 FORMAT "%19.16" EXTENDED_LIMITS 0.000000015258789066052715 65.536000000000001 /end CHARACTERISTIC
/begin CHARACTERISTIC EGT_tOutrDesMflO2_CUR "Sollwertkorrektur des äußeren Regelkreises in Abhängigkeit des Sauerstoffmasssenstromes" CURVE 0xD0762 Kl_Xs16_Ws16 1600.000 TempDiff_Cels -100.0000 1500.000 FORMAT "%8.3" EXTENDED_LIMITS -3276.800 3276.700
 /begin AXIS_DESCR STD_AXIS PFlt_dmO2Aprx AirMassPerTime 8 0.00 300.0000 FORMAT "%8.4" EXTENDED_LIMITS -3276.800 3276.700 DEPOSIT ABSOLUTE /end AXIS_DESCR
/end CHARACTERISTIC
/begin CHARACTERISTIC EGT_tOutrDesMsSot_CUR "Sollwertkorrektur des äußeren Regelkreises in Abhängigkeit der Rußmassenbeladung des Partikelfilters" CURVE 0xD0784 Kl_Xs16_Ws16 1600.000 TempDiff_Cels -100.0000 1500.000 FORMAT "%8.3" EXTENDED_LIMITS -3276.800 3276.700
 /begin AXIS_DESCR STD_AXIS PFlt_mSot mSoot_g 8 0.00 300.0000 FORMAT "%8.4" EXTENDED_LIMITS -327.6800 327.6700 DEPOSIT ABSOLUTE /end AXIS_DESCR
/end CHARACTERISTIC
/begin CHARACTERISTIC EGT_tOutrDesTempPst_CUR "Sollwertkorrektur in Abhängigkeit der Temperatur unterhalb Oxidationskatalysator" CURVE 0xD07A6 Kl_Xs16_Ws16 1600.000 TempDiff_Cels -100.0000 1500.000 FORMAT "%8.3" EXTENDED_LIMITS -3276.800 3276.700
 /begin AXIS_DESCR STD_AXIS PFlt_tOxiPst Temp_Cels 8 -50.140 899.860 FORMAT "%8.3" EXTENDED_LIMITS -3549.940 3003.560 DEPOSIT ABSOLUTE /end AXIS_DESCR
/end CHARACTERISTIC
/begin CHARACTERISTIC EGT_tOutrDes_MAP "Grundsollwert des äußeren Regelkreises" MAP 0xD07C8 Kf_Xs16_Ys16_Ws16 950.000 Temp_Cels -50.140 899.860 FORMAT "%8.3" EXTENDED_LIMITS -3549.940 3003.560
 /begin AXIS_DESCR STD_AXIS Eng_nAvrg EngN 16 0.00 6000.000 FORMAT "%8.3" EXTENDED_LIMITS -32768.00 32767.00 DEPOSIT ABSOLUTE /end AXIS_DESCR
 /begin AXIS_DESCR STD_AXIS InjCtl_qSetUnBal InjMassCyc 16 0.00 327.6700 FORMAT "%8.4" EXTENDED_LIMITS -327.6800 327.6700 DEPOSIT ABSOLUTE /end AXIS_DESCR
/end CHARACTERISTIC
/begin CHARACTERISTIC EGT_tOutrThresDwn_C "Untere Temperaturschwelle des äußeren Regelkreises" VALUE 0xD0A20 Kw_Ws16 950.000 Temp_Cels -50.140 899.860 FORMAT "%8.3" EXTENDED_LIMITS -3549.940 3003.560 /end CHARACTERISTIC
/begin CHARACTERISTIC EGT_tOutrThresUp_C "Obere Temperaturschwelle des äußeren Regelkreises" VALUE 0xD0A22 Kw_Ws16 950.000 Temp_Cels -50.140 899.860 FORMAT "%8.3" EXTENDED_LIMITS -3549.940 3003.560 /end CHARACTERISTIC
/begin CHARACTERISTIC EGT_tOxiPreThresBrn_C "Untere Schwelle Temperatur vor Oxidationskatalysator des äußeren Regelkreises" VALUE 0xD0A24 Kw_Ws16 950.000 Temp_Cels -50.140 899.860 FORMAT "%8.3" EXTENDED_LIMITS -3549.940 3003.560 /end CHARACTERISTIC
/begin CHARACTERISTIC EMCCD_uSRCMinActVal1_C "SRC-Min-Wert für EMCCD-1 analogue eingang" VALUE 0xD0BB4 Kw_Ws16 5200.391 Volt 0.00 5200.391 FORMAT "%8.3" EXTENDED_LIMITS -160156.4 160151.5 /end CHARACTERISTIC
/begin CHARACTERISTIC EMCCD_uSRCMaxActVal1_C "SRC-Max-Wert für EMCCD-1 analogue eingang" VALUE 0xD0BB6 Kw_Ws16 5200.391 Volt 0.00 5200.391 FORMAT "%8.3" EXTENDED_LIMITS -160156.4 160151.5 /end CHARACTERISTIC
/begin CHARACTERISTIC EMCCD_iLinActVal1_CUR "Analogeingang" CURVE 0xD0BB8 Kl_Xs16_Ws16 5000.000 Curr 0.00 5000.000 FORMAT "%8.3" EXTENDED_LIMITS -32768.00 32767.00
 /begin AXIS_DESCR STD_AXIS EMCCD_uRawActVal1_mp Volt 2 0.00 5200.391 FORMAT "%8.3" EXTENDED_LIMITS -160156.4 160151.5 DEPOSIT ABSOLUTE /end AXIS_DESCR
/end CHARACTERISTIC
/begin CHARACTERISTIC EMCCD_uSRCMinActVal2_C "SRC-Min-Wert für EMCCD-2 analogue eingang" VALUE 0xD0BC2 Kw_Ws16 5200.391 Volt 0.00 5200.391 FORMAT "%8.3" EXTENDED_LIMITS -160156.4 160151.5 /end CHARACTERISTIC
/begin CHARACTERISTIC EMCCD_uSRCMaxActVal2_C "SRC-Max-Wert für EMCCD-2 analogue eingang" VALUE 0xD0BC4 Kw_Ws16 5200.391 Volt 0.00 5200.391 FORMAT "%8.3" EXTENDED_LIMITS -160156.4 160151.5 /end CHARACTERISTIC
/begin CHARACTERISTIC EMCCD_iLinActVal2_CUR "Analogeingang" CURVE 0xD0BC6 Kl_Xs16_Ws16 5000.000 Curr 0.00 5000.000 FORMAT "%8.3" EXTENDED_LIMITS -32768.00 32767.00
 /begin AXIS_DESCR STD_AXIS EMCCD_uRawActVal2_mp Volt 2 0.00 5200.391 FORMAT "%8.3" EXTENDED_LIMITS -160156.4 160151.5 DEPOSIT ABSOLUTE /end AXIS_DESCR
/end CHARACTERISTIC
/begin CHARACTERISTIC EMCCD_ctPwrStgOnMax1_C "Maximaler Zähler für Powerstage On im Fehlerfall" VALUE 0xD0BD0 Kw_Wu16 65535.00 OneToOne 0.00 65535.00 FORMAT "%8.2" /end CHARACTERISTIC
/begin CHARACTERISTIC EMCCD_ctPwrStgOnMax2_C "Maximaler Zähler für Powerstage On im Fehlerfall" VALUE 0xD0BD2 Kw_Wu16 65535.00 OneToOne 0.00 65535.00 FORMAT "%8.2" /end CHARACTERISTIC
/begin CHARACTERISTIC EMCCD_dcycCurrOff_MAP "Berechnung des Strom AUS-Tastverhältnisses bei Strom-Regellogik" MAP 0xD0BD4 Kf_Xs16_Ys16_Ws16 655.3500 DtyCyc -327.6800 327.6700 FORMAT "%8.4"
 /begin AXIS_DESCR STD_AXIS BattCD_u Volt_Batt 7 0.00 28602.15 FORMAT "%8.2" EXTENDED_LIMITS -640625.6 640606.1 DEPOSIT ABSOLUTE /end AXIS_DESCR
 /begin AXIS_DESCR STD_AXIS EMCCD_resAct1 Resist 16 0.00 5000.000 FORMAT "%8.3" EXTENDED_LIMITS -3276.800 3276.700 DEPOSIT ABSOLUTE /end AXIS_DESCR
/end CHARACTERISTIC
/begin CHARACTERISTIC EMCCD_dcycCurrOnHi_MAP "Berechnung des Haltestrom-Tastverhältnisses bei Strom-Regellogik" MAP 0xD0CE6 Kf_Xs16_Ys16_Ws16 655.3500 DtyCyc -327.6800 327.6700 FORMAT "%8.4"
 /begin AXIS_DESCR STD_AXIS BattCD_u Volt_Batt 7 0.00 28602.15 FORMAT "%8.2" EXTENDED_LIMITS -640625.6 640606.1 DEPOSIT ABSOLUTE /end AXIS_DESCR
 /begin AXIS_DESCR STD_AXIS EMCCD_resAct1 Resist 16 0.00 5000.000 FORMAT "%8.3" EXTENDED_LIMITS -3276.800 3276.700 DEPOSIT ABSOLUTE /end AXIS_DESCR
/end CHARACTERISTIC
/begin CHARACTERISTIC EMCCD_dcycCurrOnLow_MAP "Berechnung des Startstrom-Tastverhältnisses bei Strom-Regellogik" MAP 0xD0DF8 Kf_Xs16_Ys16_Ws16 655.3500 DtyCyc -327.6800 327.6700 FORMAT "%8.4"
 /begin AXIS_DESCR STD_AXIS BattCD_u Volt_Batt 7 0.00 28602.15 FORMAT "%8.2" EXTENDED_LIMITS -640625.6 640606.1 DEPOSIT ABSOLUTE /end AXIS_DESCR
 /begin AXIS_DESCR STD_AXIS EMCCD_resAct1 Resist 16 0.00 5000.000 FORMAT "%8.3" EXTENDED_LIMITS -3276.800 3276.700 DEPOSIT ABSOLUTE /end AXIS_DESCR
/end CHARACTERISTIC
/begin CHARACTERISTIC EMCCD_dcycMax_C "Max-Wert" VALUE 0xD0F0A Kw_Ws16 655.3500 DtyCyc -327.6800 327.6700 FORMAT "%8.4" /end CHARACTERISTIC
/begin CHARACTERISTIC EMCCD_dcycMin_C "Min-Wert" VALUE 0xD0F0C Kw_Ws16 655.3500 DtyCyc -327.6800 327.6700 FORMAT "%8.4" /end CHARACTERISTIC
/begin CHARACTERISTIC EMCCD_dcycWarmUp_MAP "Berechnung des Aufwärmungsstrom-Tastverhältnisses bei Strom-Regellogik" MAP 0xD0F0E Kf_Xs16_Ys16_Ws16 655.3500 DtyCyc -327.6800 327.6700 FORMAT "%8.4"
 /begin AXIS_DESCR STD_AXIS Eng_tEng Temp_Cels 15 -50.14000 199.8600 FORMAT "%8.4" EXTENDED_LIMITS -3549.940 3003.560 DEPOSIT ABSOLUTE /end AXIS_DESCR
 /begin AXIS_DESCR STD_AXIS EATSCD_tAir Temp_Cels 15 -50.14000 199.8600 FORMAT "%8.4" EXTENDED_LIMITS -3549.940 3003.560 DEPOSIT ABSOLUTE /end AXIS_DESCR
/end CHARACTERISTIC
/begin CHARACTERISTIC EMCCD_DebExcTempDef1_C "Zeit bis defekt für EXC_TEMP Fehler" VALUE 0xD1110 Kw_Wu16 655350.0 Time_ms 0.00 655350.0 FORMAT "%8.1" /end CHARACTERISTIC
/begin CHARACTERISTIC EMCCD_DebExcTempOk1_C "Heilungszeit für EXC_TEMP Fehler" VALUE 0xD1112 Kw_Wu16 655350.0 Time_ms 0.00 655350.0 FORMAT "%8.1" /end CHARACTERISTIC
/begin CHARACTERISTIC EMCCD_DebExcTempDef2_C "Zeit bis defekt für EXC_TEMP Fehler" VALUE 0xD1114 Kw_Wu16 655350.0 Time_ms 0.00 655350.0 FORMAT "%8.1" /end CHARACTERISTIC
/begin CHARACTERISTIC EMCCD_DebExcTempOk2_C "Heilungszeit für EXC_TEMP Fehler" VALUE 0xD1116 Kw_Wu16 655350.0 Time_ms 0.00 655350.0 FORMAT "%8.1" /end CHARACTERISTIC
/begin CHARACTERISTIC EMCCD_DebNoLoadDef1_C "Zeit bis defekt für NO_LOAD Fehler" VALUE 0xD1118 Kw_Wu16 655350.0 Time_ms 0.00 655350.0 FORMAT "%8.1" /end CHARACTERISTIC
/begin CHARACTERISTIC EMCCD_DebNoLoadOk1_C "Heilungszeit für NO_LOAD Fehler" VALUE 0xD111A Kw_Wu16 655350.0 Time_ms 0.00 655350.0 FORMAT "%8.1" /end CHARACTERISTIC
/begin CHARACTERISTIC EMCCD_DebNoLoadDef2_C "Zeit bis defekt für NO_LOAD Fehler" VALUE 0xD111C Kw_Wu16 655350.0 Time_ms 0.00 655350.0 FORMAT "%8.1" /end CHARACTERISTIC
/begin CHARACTERISTIC EMCCD_DebNoLoadOk2_C "Heilungszeit für NO_LOAD Fehler" VALUE 0xD111E Kw_Wu16 655350.0 Time_ms 0.00 655350.0 FORMAT "%8.1" /end CHARACTERISTIC
/begin CHARACTERISTIC EMCCD_DebShortCircBatDef1_C "Zeit bis defekt für SC_BAT Fehler" VALUE 0xD1120 Kw_Wu16 655350.0 Time_ms 0.00 655350.0 FORMAT "%8.1" /end CHARACTERISTIC
/begin CHARACTERISTIC EMCCD_DebShortCircBatOk1_C "Heilungszeit für SC_BAT Fehler" VALUE 0xD1122 Kw_Wu16 655350.0 Time_ms 0.00 655350.0 FORMAT "%8.1" /end CHARACTERISTIC
/begin CHARACTERISTIC EMCCD_DebShortCircBatDef2_C "Zeit bis defekt für SC_BAT Fehler" VALUE 0xD1124 Kw_Wu16 655350.0 Time_ms 0.00 655350.0 FORMAT "%8.1" /end CHARACTERISTIC
/begin CHARACTERISTIC EMCCD_DebShortCircBatOk2_C "Heilungszeit für SC_BAT Fehler" VALUE 0xD1126 Kw_Wu16 655350.0 Time_ms 0.00 655350.0 FORMAT "%8.1" /end CHARACTERISTIC
/begin CHARACTERISTIC EMCCD_DebShortCircGndDef1_C "Zeit bis defekt für SC_GND Fehler" VALUE 0xD1128 Kw_Wu16 655350.0 Time_ms 0.00 655350.0 FORMAT "%8.1" /end CHARACTERISTIC
/begin CHARACTERISTIC EMCCD_DebShortCircGndOk1_C "Heilungszeit für SC_GND Fehler" VALUE 0xD112A Kw_Wu16 655350.0 Time_ms 0.00 655350.0 FORMAT "%8.1" /end CHARACTERISTIC
/begin CHARACTERISTIC EMCCD_DebShortCircGndDef2_C "Zeit bis defekt für SC_GND Fehler" VALUE 0xD112C Kw_Wu16 655350.0 Time_ms 0.00 655350.0 FORMAT "%8.1" /end CHARACTERISTIC
/begin CHARACTERISTIC EMCCD_DebShortCircGndOk2_C "Heilungszeit für SC_GND Fehler" VALUE 0xD112E Kw_Wu16 655350.0 Time_ms 0.00 655350.0 FORMAT "%8.1" /end CHARACTERISTIC
/begin CHARACTERISTIC EMCCD_DebSRCHighDef1_C "Zeit bis defekt für SRC_HIGH Fehler" VALUE 0xD1130 Kw_Wu16 655350.0 Time_ms 0.00 655350.0 FORMAT "%8.1" /end CHARACTERISTIC
/begin CHARACTERISTIC EMCCD_DebSRCHighOk1_C "Heilungszeit für SRC_HIGH Fehler" VALUE 0xD1132 Kw_Wu16 655350.0 Time_ms 0.00 655350.0 FORMAT "%8.1" /end CHARACTERISTIC
/begin CHARACTERISTIC EMCCD_DebSRCHighDef2_C "Zeit bis defekt für SRC_HIGH Fehler" VALUE 0xD1134 Kw_Wu16 655350.0 Time_ms 0.00 655350.0 FORMAT "%8.1" /end CHARACTERISTIC
/begin CHARACTERISTIC EMCCD_DebSRCHighOk2_C "Heilungszeit für SRC_HIGH Fehler" VALUE 0xD1136 Kw_Wu16 655350.0 Time_ms 0.00 655350.0 FORMAT "%8.1" /end CHARACTERISTIC
/begin CHARACTERISTIC EMCCD_DebSRCLowDef1_C "Zeit bis defekt für SRC_LOW Fehler" VALUE 0xD1138 Kw_Wu16 655350.0 Time_ms 0.00 655350.0 FORMAT "%8.1" /end CHARACTERISTIC
/begin CHARACTERISTIC EMCCD_DebSRCLowOk1_C "Heilungszeit für SRC_LOW Fehler" VALUE 0xD113A Kw_Wu16 655350.0 Time_ms 0.00 655350.0 FORMAT "%8.1" /end CHARACTERISTIC
/begin CHARACTERISTIC EMCCD_DebSRCLowDef2_C "Zeit bis defekt für SRC_LOW Fehler" VALUE 0xD113C Kw_Wu16 655350.0 Time_ms 0.00 655350.0 FORMAT "%8.1" /end CHARACTERISTIC
/begin CHARACTERISTIC EMCCD_DebSRCLowOk2_C "Heilungszeit für SRC_LOW Fehler" VALUE 0xD113E Kw_Wu16 655350.0 Time_ms 0.00 655350.0 FORMAT "%8.1" /end CHARACTERISTIC
/begin CHARACTERISTIC EMCCD_dtRmpSlpUpActVal1_C "Aufwärts-Schritt für Rampe" VALUE 0xD1140 Kw_Wu32 65535999.9847 RmpCurr 0.00 65535999.9847 FORMAT "%13.4" /end CHARACTERISTIC
/begin CHARACTERISTIC EMCCD_dtRmpSlpDwnActVal1_C "Abw.-Schritt fuer Rampe" VALUE 0xD1144 Kw_Wu32 65535999.9847 RmpCurr 0.00 65535999.9847 FORMAT "%13.4" /end CHARACTERISTIC
/begin CHARACTERISTIC EMCCD_dtRmpSlpUpActVal2_C "Aufwärts-Schritt für Rampe" VALUE 0xD1148 Kw_Wu32 65535999.9847 RmpCurr 0.00 65535999.9847 FORMAT "%13.4" /end CHARACTERISTIC
/begin CHARACTERISTIC EMCCD_dtRmpSlpDwnActVal2_C "Abw.-Schritt fuer Rampe" VALUE 0xD114C Kw_Wu32 65535999.9847 RmpCurr 0.00 65535999.9847 FORMAT "%13.4" /end CHARACTERISTIC
/begin CHARACTERISTIC EMCCD_numAdc1_C "Applikationsparameter zur Auswahl des analogen Eingangssignals für EMCCD-1" VALUE 0xD1150 Kw_Wu8 46.0000000000 NumPinAdc 0.00 46.0000000000 FORMAT "%13.10" /end CHARACTERISTIC
/begin CHARACTERISTIC EMCCD_numAdc2_C "Applikationsparameter zur Auswahl des analogen Eingangssignals für EMCCD-2" VALUE 0xD1151 Kw_Wu8 46.0000000000 NumPinAdc 0.00 46.0000000000 FORMAT "%13.10" /end CHARACTERISTIC
/begin CHARACTERISTIC EMCCD_numDiaOut1_C "Parameter zur Pin-Auswahl der Hardware-Diagnose" VALUE 0xD1152 Kw_Wu8 35.0000000000 NumPinDia 0.00 35.0000000000 FORMAT "%13.10" /end CHARACTERISTIC
/begin CHARACTERISTIC EMCCD_numDiaOut2_C "Parameter zur Pin-Auswahl der Hardware-Diagnose" VALUE 0xD1153 Kw_Wu8 35.0000000000 NumPinDia 0.00 35.0000000000 FORMAT "%13.10" /end CHARACTERISTIC
/begin CHARACTERISTIC EMCCD_numPwmOut1_C "Parameter für Auswahl Hardware Endstufen-Pin des PWM-Signals EMCCD-1" VALUE 0xD1154 Kw_Wu8 13.0000000000 NumPinPwmOut 0.00 13.0000000000 FORMAT "%13.10" /end CHARACTERISTIC
/begin CHARACTERISTIC EMCCD_numPwmOut2_C "Parameter für Auswahl Hardware Endstufen-Pin des PWM-Signals EMCCD-2" VALUE 0xD1155 Kw_Wu8 13.0000000000 NumPinPwmOut 0.00 13.0000000000 FORMAT "%13.10" /end CHARACTERISTIC
/begin CHARACTERISTIC EMCCD_tiActValPT1_1_C "Zeitkonstante für  PT1-Filter  für EMCCD-1 analogue eingang" VALUE 0xD1158 Kw_Wu32 4294.9663 TimeDelay_s 0.0010000001 4294.9673 FORMAT "%9.4" EXTENDED_LIMITS 0.0000010000000 4294.9673 /end CHARACTERISTIC
/begin CHARACTERISTIC EMCCD_tiActValPT1_2_C "Zeitkonstante für  PT1-Filter  für EMCCD-2 analogue eingang" VALUE 0xD115C Kw_Wu32 4294.9663 TimeDelay_s 0.0010000001 4294.9673 FORMAT "%9.4" EXTENDED_LIMITS 0.0000010000000 4294.9673 /end CHARACTERISTIC
/begin CHARACTERISTIC EMCCD_stInvOut1_C "Label zur Invertierung der Endstufe" VALUE 0xD1160 Kw_Wu8 1.000 OneToOne 0.00 1.000 FORMAT "%5.3" EXTENDED_LIMITS 0.00 255.0 /end CHARACTERISTIC
/begin CHARACTERISTIC EMCCD_tiPer1_C "Aggregatelagersteuerung Endstufenausgangs Periode" VALUE 0xD1162 Kw_Ws16 6553.500 Period -3276.800 3276.700 FORMAT "%8.3" /end CHARACTERISTIC
/begin CHARACTERISTIC EMCCD_stInvOut2_C "Label zur Invertierung der Endstufe" VALUE 0xD1164 Kw_Wu8 1.000 OneToOne 0.00 1.000 FORMAT "%5.3" EXTENDED_LIMITS 0.00 255.0 /end CHARACTERISTIC
/begin CHARACTERISTIC EMCCD_tiPer2_C "Aggregatelagersteuerung Endstufenausgangs Periode" VALUE 0xD1166 Kw_Ws16 6553.500 Period -3276.800 3276.700 FORMAT "%8.3" /end CHARACTERISTIC
/begin CHARACTERISTIC EMCCD_stSPICtl1_C "Schalter ob Endstufe SPI kontrollierbar = 1 oder nicht SPI kontrollierbar = 0" VALUE 0xD1168 Kw_Wu8 1.000 OneToOne 0.00 1.000 FORMAT "%5.3" EXTENDED_LIMITS 0.00 255.0 /end CHARACTERISTIC
/begin CHARACTERISTIC EMCCD_stSPICtl2_C "Schalter ob Endstufe SPI kontrollierbar = 1 oder nicht SPI kontrollierbar = 0" VALUE 0xD1169 Kw_Wu8 1.000 OneToOne 0.00 1.000 FORMAT "%5.3" EXTENDED_LIMITS 0.00 255.0 /end CHARACTERISTIC
/begin CHARACTERISTIC EMCCD_swtRegOn_C "Auswahl der Strom-Regellogik zur Berechnung des Ausgangs-Tastverhältnisses (0: standard Logik, 1: derzeitiger Governor)" VALUE 0xD116A Kw_Wu8 255.0 OneToOne 0.00 255.0 FORMAT "%5.1" /end CHARACTERISTIC
/begin CHARACTERISTIC EMCCD_tiBtwTst1_C "Zeitabstand, in dem die Endstufe im Fehlerfall getestet wird" VALUE 0xD116C Kw_Wu16 29980.00 Time_ms 20.00000 30000.00 FORMAT "%8.2" EXTENDED_LIMITS 0.00 655350.0 /end CHARACTERISTIC
/begin CHARACTERISTIC EMCCD_tiBtwTst2_C "Zeitabstand, in dem die Endstufe im Fehlerfall getestet wird" VALUE 0xD116E Kw_Wu16 29980.00 Time_ms 20.00000 30000.00 FORMAT "%8.2" EXTENDED_LIMITS 0.00 655350.0 /end CHARACTERISTIC
/begin CHARACTERISTIC EMCCD_tiCurrOnHi_C "Zeit, für die der Startsstrom bei Strom-Regellogik betätigt werden soll" VALUE 0xD1170 Kw_Wu16 655.3500 Time_s 0.00 655.3500 FORMAT "%8.4" /end CHARACTERISTIC
/begin CHARACTERISTIC EMCCD_tiPwrStgOn1_C "Zeit für welche die Endstufe im Fehlerfall eingeschalten wird (nur nicht SPI kontrolliert)" VALUE 0xD1172 Kw_Wu16 655140.0 Time_ms 0.00 655140.0 FORMAT "%8.1" EXTENDED_LIMITS 0.00 655350.0 /end CHARACTERISTIC
/begin CHARACTERISTIC EMCCD_tiPwrStgOn2_C "Zeit für welche die Endstufe im Fehlerfall eingeschalten wird (nur nicht SPI kontrolliert)" VALUE 0xD1174 Kw_Wu16 655140.0 Time_ms 0.00 655140.0 FORMAT "%8.1" EXTENDED_LIMITS 0.00 655350.0 /end CHARACTERISTIC
/begin CHARACTERISTIC EMCCD_tiWarmUp_C "Zeit, für die der Strom, der durch Aufwärmungskennfeld berechnet wird, betätigt werden soll" VALUE 0xD1176 Kw_Wu16 655.3500 Time_s 0.00 655.3500 FORMAT "%8.4" /end CHARACTERISTIC
/begin CHARACTERISTIC EMCCD_stSensIDWordActVal1_C "Statuswort für zustandsübergreifende Antwort der EMCCD-1 analogue eingang im Fehlerfall" VALUE 0xD1178 Kw_Wu16 65535.00 OneToOne 0.00 65535.00 FORMAT "%8.2" /end CHARACTERISTIC
/begin CHARACTERISTIC EMCCD_iDflActVal1_C "Vorgabewert für EMCCD-1 analogue eingang" VALUE 0xD117A Kw_Ws16 5000.000 Curr 0.00 5000.000 FORMAT "%8.3" EXTENDED_LIMITS -32768.00 32767.00 /end CHARACTERISTIC
/begin CHARACTERISTIC EMCCD_stSensIDWordActVal2_C "Statuswort für zustandsübergreifende Antwort der EMCCD-2 analogue eingang im Fehlerfall" VALUE 0xD117C Kw_Wu16 65535.00 OneToOne 0.00 65535.00 FORMAT "%8.2" /end CHARACTERISTIC
/begin CHARACTERISTIC EMCCD_iDflActVal2_C "Vorgabewert für EMCCD-2 analogue eingang" VALUE 0xD117E Kw_Ws16 5000.000 Curr 0.00 5000.000 FORMAT "%8.3" EXTENDED_LIMITS -32768.00 32767.00 /end CHARACTERISTIC
/begin CHARACTERISTIC EngM_ctOfsCaSCrS_C "#SSD Anzahl von Interrupts mit CaS/CrS Verdrehung (> EngM_phiDelta_C) im WAIT_PHASE State bis Verdreherkennung" VALUE 0xD13E0 Kw_Wu8 255.0 default 0.00 255.0 FORMAT "%5.1" /end CHARACTERISTIC
/begin CHARACTERISTIC EngM_ctPhWhlRev_C "#SSD Anzahl von Phasenradumdrehungen bis zum Abbruch der Plausibilitätsprüfung" VALUE 0xD13E1 Kw_Wu8 255.0 default 0.00 255.0 FORMAT "%5.1" /end CHARACTERISTIC
/begin CHARACTERISTIC EngM_ctPostSync_C "#SSD Anzahl statischer Interrupts bis zum Verlassen des Zustands POST" VALUE 0xD13E2 Kw_Wu8 255.0 default 0.00 255.0 FORMAT "%5.1" /end CHARACTERISTIC
/begin CHARACTERISTIC EngM_ctPwrStgOnMax1_C "Maximaler Zähler für Powerstage On im Fehlerfall" VALUE 0xD1180 Kw_Wu16 65535.00 OneToOne 0.00 65535.00 FORMAT "%8.2" /end CHARACTERISTIC
/begin CHARACTERISTIC EngM_ctPwrStgOnMax2_C "Maximaler Zähler für Powerstage On im Fehlerfall" VALUE 0xD1182 Kw_Wu16 65535.00 OneToOne 0.00 65535.00 FORMAT "%8.2" /end CHARACTERISTIC
/begin CHARACTERISTIC EngM_ctReSync_C "#SSD Max. Anzahl von Versuchen das System umzusynchronisieren" VALUE 0xD13E3 Kw_Wu8 255.0 default 0.00 255.0 FORMAT "%5.1" /end CHARACTERISTIC
/begin CHARACTERISTIC EngM_ctSpdtoZero_C "#SSD Anzahl Timeoutinterrupts bis Motordrehzahl  = Null" VALUE 0xD1408 Kw_Wu16 65535.00 OneToOne 0.00 65535.00 FORMAT "%8.2" /end CHARACTERISTIC
/begin CHARACTERISTIC EngM_ctVerSync_C "#SSD Anzahl der MAIN, PILOT, UPDATE, SEGMENT  Interrupts zur Plausibilisierung der Nockenwelle mit der Kurbelwelle" VALUE 0xD13E4 Kw_Wu8 255.0 default 0.00 255.0 FORMAT "%5.1" /end CHARACTERISTIC
/begin CHARACTERISTIC EngM_DebIncCaSErrSigDef_C "#SSD Inkrementdefektentprellung  für Nockenwellen-Signalstörung" VALUE 0xD140A Kw_Wu16 65535.00 OneToOne 0.00 65535.00 FORMAT "%8.2" /end CHARACTERISTIC
/begin CHARACTERISTIC EngM_DebIncCaSErrSigOK_C "#SSD Inkrementheilungsentprellung bis NW-Position gueltig" VALUE 0xD140C Kw_Wu16 65535.00 OneToOne 0.00 65535.00 FORMAT "%8.2" /end CHARACTERISTIC
/begin CHARACTERISTIC EngM_DebIncCaSNoSigDef_C "#SSD Inkrementdefektentprellung für Nockenwellen-Signalausfall" VALUE 0xD140E Kw_Wu16 65535.00 OneToOne 0.00 65535.00 FORMAT "%8.2" /end CHARACTERISTIC
/begin CHARACTERISTIC EngM_DebIncCrSErrSigDef_C "#SSD Inkrementdefektentprellung für gestörtes Kurbelwellen-Signal" VALUE 0xD1410 Kw_Wu16 65535.00 OneToOne 0.00 65535.00 FORMAT "%8.2" /end CHARACTERISTIC
/begin CHARACTERISTIC EngM_DebIncCrSErrSigOK_C "#SSD Inkrementheilungsprellung für gestörtes Kurbelwellen-Signal" VALUE 0xD1412 Kw_Wu16 65535.00 OneToOne 0.00 65535.00 FORMAT "%8.2" /end CHARACTERISTIC
/begin CHARACTERISTIC EngM_DebIncOfsSigCaSCrSDef_C "#SSD Inkremententprellung zur Unterdrückung doppelter Fehlereinträge von Signal Störung / Verdrehung" VALUE 0xD1414 Kw_Wu16 65535.00 OneToOne 0.00 65535.00 FORMAT "%8.2" /end CHARACTERISTIC
/begin CHARACTERISTIC EngM_DebPhCrSErrSigDef_C "#SSD Entprellung des Kurbelwellensignalausfalls über die Anzahl von Nockenwellenzaehnen" VALUE 0xD1416 Kw_Wu16 65535.00 OneToOne 0.00 65535.00 FORMAT "%8.2" /end CHARACTERISTIC
/begin CHARACTERISTIC EngM_dLimitCond_ASD_CA "#SSD Abschrankbedingung fuer die ASD-Task" VAL_BLK 0xD13B8 Kwb_Wu8 255.0 OneToOne 0.00 255.0 FORMAT "%5.1" NUMBER 3 /end CHARACTERISTIC
/begin CHARACTERISTIC EngM_dLimitCond_Common_CA "#SSD Abschrankbedingung fuer die Common-Task" VAL_BLK 0xD13BB Kwb_Wu8 255.0 OneToOne 0.00 255.0 FORMAT "%5.1" NUMBER 3 /end CHARACTERISTIC
/begin CHARACTERISTIC EngM_dLimitCond_FBC_CA "#SSD Abschrankbedingung fuer die FBC-Task" VAL_BLK 0xD13BE Kwb_Wu8 255.0 OneToOne 0.00 255.0 FORMAT "%5.1" NUMBER 3 /end CHARACTERISTIC
/begin CHARACTERISTIC EngM_dLimitCond_Joint_CA "#SSD Abschrankbedingung fuer die Joint-Task" VAL_BLK 0xD13C1 Kwb_Wu8 255.0 OneToOne 0.00 255.0 FORMAT "%5.1" NUMBER 3 /end CHARACTERISTIC
/begin CHARACTERISTIC EngM_dLimitCond_LiGov_CA "#SSD Abschrankbedingung fuer die LiGov-Task" VAL_BLK 0xD13C4 Kwb_Wu8 255.0 OneToOne 0.00 255.0 FORMAT "%5.1" NUMBER 3 /end CHARACTERISTIC
/begin CHARACTERISTIC EngM_dLimitCond_Pilot_CA "#SSD Abschrankbedingung fuer die Pilot-Task" VAL_BLK 0xD13C7 Kwb_Wu8 255.0 OneToOne 0.00 255.0 FORMAT "%5.1" NUMBER 3 /end CHARACTERISTIC
/begin CHARACTERISTIC EngM_dtrqFrcPDiffUp_C "Negative Rampensteigung für Umschaltung auf Drehmomentverlust bei erkanntem Systemfehler" VALUE 0xD1494 Kw_Wu32 6553649.99847 RmpTrq -50.0000000000 6553599.99847 FORMAT "%13.5" EXTENDED_LIMITS 0.00 6553599.99847 /end CHARACTERISTIC
/begin CHARACTERISTIC EngM_dtrqFrcPDiffDwn_C "Negative Rampensteigung für Umschaltung auf Drehmomentverlust bei geheiltem Systemfehler" VALUE 0xD1498 Kw_Wu32 6553649.99847 RmpTrq -50.0000000000 6553599.99847 FORMAT "%13.5" EXTENDED_LIMITS 0.00 6553599.99847 /end CHARACTERISTIC
/begin CHARACTERISTIC EngM_facT1Reliabl_C "Multiplikationsfaktor für Zuverlässigkeitsbestimmung der Reibmomentenadaption" VALUE 0xD1708 Kw_Wu8 255.0 OneToOne 0.00 255.0 FORMAT "%5.1" /end CHARACTERISTIC
/begin CHARACTERISTIC EngM_facTrqFrcPDiff_CUR "Faktor zur Korrektur Momentenverlust aufgrund Differenzdruck über Partikelfilter nach Einbau eines Partikelfilters" CURVE 0xD149C Kl_Xs16_Ws16 512.0000 Fact1 -256.0000 256.0000 FORMAT "%8.4" EXTENDED_LIMITS -256.0000 255.9922
 /begin AXIS_DESCR STD_AXIS Eng_nAvrg EngN 8 0.00 5000.000 FORMAT "%8.3" EXTENDED_LIMITS -32768.00 32767.00 DEPOSIT ABSOLUTE /end AXIS_DESCR
/end CHARACTERISTIC
/begin CHARACTERISTIC EngM_tiFltACoff_C "Adaptionsfilterzeitkonstante für Zustand ""Klima aus"" der Reibmomentenadaption" VALUE 0xD170C Kw_Wu32 4294.9673 TimeDelay_s 0.0000010000000 4294.9673 FORMAT "%9.4" /end CHARACTERISTIC
/begin CHARACTERISTIC EngM_tiFltACon_C "Adaptionsfilterzeitkonstante für Zustand ""Klima an"" der Reibmomentenadaption" VALUE 0xD1710 Kw_Wu32 4294.9673 TimeDelay_s 0.0000010000000 4294.9673 FORMAT "%9.4" /end CHARACTERISTIC
/begin CHARACTERISTIC EngM_HldCurr_MAP "Kennfeld um das Tastverhältnis der Haltephase für die Motorlagersteuerung zu bestimmen - abhängig von Eng_tEng und BattCD_u" MAP 0xD1184 Kf_Xs16_Ys16_Ws16 655.3500 DtyCyc -327.6800 327.6700 FORMAT "%8.4"
 /begin AXIS_DESCR STD_AXIS BattCD_u Volt_Batt 6 0.00 28602.15 FORMAT "%8.2" EXTENDED_LIMITS -640625.6 640606.1 DEPOSIT ABSOLUTE /end AXIS_DESCR
 /begin AXIS_DESCR STD_AXIS Eng_tEng Temp_Cels 15 -50.14000 199.8600 FORMAT "%8.4" EXTENDED_LIMITS -3549.940 3003.560 DEPOSIT ABSOLUTE /end AXIS_DESCR
/end CHARACTERISTIC
/begin CHARACTERISTIC EngM_nAvrgHysDelta_C "speed threshold for calculating Hysterisis lower limit" VALUE 0xD141C Kw_Ws16 6000.000 EngN 0.00 6000.000 FORMAT "%8.3" EXTENDED_LIMITS -32768.00 32767.00 /end CHARACTERISTIC
/begin CHARACTERISTIC EngM_nAvrgHysHigh_CUR "curve for max. cutout speed = f ( engine-temp. )" CURVE 0xD141E Kl_Xs16_Ws16 6000.000 EngN 0.00 6000.000 FORMAT "%8.3" EXTENDED_LIMITS -32768.00 32767.00
 /begin AXIS_DESCR STD_AXIS Eng_tEng Temp_Cels 25 -50.14000 199.8600 FORMAT "%8.4" EXTENDED_LIMITS -3549.940 3003.560 DEPOSIT ABSOLUTE /end AXIS_DESCR
/end CHARACTERISTIC
/begin CHARACTERISTIC EngM_nAvrgLim_C "Engine speed limiting  value" VALUE 0xD1484 Kw_Ws16 6000.000 EngN 0.00 6000.000 FORMAT "%8.3" EXTENDED_LIMITS -32768.00 32767.00 /end CHARACTERISTIC
/begin CHARACTERISTIC EngM_nLimitInj_C "#SSD Drehzahlschwelle zur Abschrankung der Mengen- und Ansteuerbeginnberechnung" VALUE 0xD13CA Kw_Wu16 6000.000 EngN 0.00 6000.000 FORMAT "%8.3" EXTENDED_LIMITS 0.00 65535.00 /end CHARACTERISTIC
/begin CHARACTERISTIC EngM_nLimitThreshHyst_CA "#SSD Hysteresebreite der Abschrankdrehzahl" VAL_BLK 0xD13CC Kwb_Wu16 600.0000 EngN 0.00 600.0000 FORMAT "%8.4" EXTENDED_LIMITS 0.00 65535.00 NUMBER 3 /end CHARACTERISTIC
/begin CHARACTERISTIC EngM_nLimitThresh_CA "#SSD Drehzahlschwellen zur Taskabschrankung" VAL_BLK 0xD13D2 Kwb_Wu16 6000.000 EngN 0.00 6000.000 FORMAT "%8.3" EXTENDED_LIMITS 0.00 65535.00 NUMBER 3 /end CHARACTERISTIC
/begin CHARACTERISTIC EngM_nLISetDiffOffs_C "Maximale zulässige Leerlaufreglerabweichung für Reibmomentenadaption" VALUE 0xD1714 Kw_Wu16 50.00000 EngN 0.00 50.00000 FORMAT "%8.5" EXTENDED_LIMITS 0.00 65535.00 /end CHARACTERISTIC
/begin CHARACTERISTIC EngM_nMaxStrtBackUp_C "#SSD Max. Drehzahl für Start nur mit Nockenwellensignal" VALUE 0xD1418 Kw_Ws16 300.0000 EngN 900.0000 1200.000 FORMAT "%8.3" EXTENDED_LIMITS -32768.00 32767.00 /end CHARACTERISTIC
/begin CHARACTERISTIC EngM_nMaxStrt_C "#SSD Motordrehzahl unterhalb dieser Schwelle; Einspritzung für redundanten Start mit Kurbelwelle ist erlaubt" VALUE 0xD13E6 Kw_Ws16 65535.00 EngN -32768.00 32767.00 FORMAT "%8.2" /end CHARACTERISTIC
/begin CHARACTERISTIC EngM_nMinDiag_C "#SSD Nockenwellendiagnose ab minimale Motordrehzahl" VALUE 0xC0618 Kw_Ws16 480.0000 EngN 20.00000 500.0000 FORMAT "%8.4" EXTENDED_LIMITS -32768.00 32767.00 /end CHARACTERISTIC
/begin CHARACTERISTIC EngM_nSwtCoMa_C "#SSD Schwellendrehzahl für die Umschaltung der Aufrufreihenfolge von Common- und MainInj-Task" VALUE 0xD13D8 Kw_Wu16 6000.000 EngN 0.00 6000.000 FORMAT "%8.3" EXTENDED_LIMITS 0.00 65535.00 /end CHARACTERISTIC
/begin CHARACTERISTIC EngM_numLimitInj_C "#SSD Berechnungshäufigkeit bei aktiver Abschrankung der Mengen- und Ansteuerbeginnberechnung" VALUE 0xD13DA Kw_Wu8 9.000 OneToOne 1.000 10.00 FORMAT "%5.2" EXTENDED_LIMITS 0.00 255.0 /end CHARACTERISTIC
/begin CHARACTERISTIC EngM_numPin_C "#SSD Zuordnungstabelle phyikalischer Zylinder zu SG-Endstufe (SG-Pin)" VAL_BLK 0xC05FC Kwb_Wu8 255.0 OneToOne 0.00 255.0 FORMAT "%5.1" NUMBER 6 /end CHARACTERISTIC
/begin CHARACTERISTIC EngM_numTDSig_C "Ausgangspin für TD-Signal über DIO" VALUE 0xD1490 Kw_Wu8 11.0000000000 NumPinDioOut 0.00 11.0000000000 FORMAT "%13.10" /end CHARACTERISTIC
/begin CHARACTERISTIC EngM_numTrqFrc_C "Parameter für die Auswahl einer Motortemperatur aus dem Temperaturfeld Eng_tFld für die Reibmomentenberechnung" VALUE 0xD14BE Kw_Wu8 2.00000000000 EngTempFldSel 0.00 2.00000000000 FORMAT "%13.11" /end CHARACTERISTIC
/begin CHARACTERISTIC EngM_nWaitIncSig_C "#SSD Inkrementdrehzahl ab der das Signal im Start ausgeblendet wird" VALUE 0xD13E8 Kw_Ws16 6000.000 EngN 0.00 6000.000 FORMAT "%8.3" EXTENDED_LIMITS -32768.00 32767.00 /end CHARACTERISTIC
/begin CHARACTERISTIC EngM_phiDelayPhNoSig_C "#SSD Winkelverzoegerung für die Erkennung kein Nockenwellensignal" VALUE 0xD13EA Kw_Ws16 720.0000 AngleCrS 0.00 720.0000 FORMAT "%8.4" EXTENDED_LIMITS -768.0000 767.9766 /end CHARACTERISTIC
/begin CHARACTERISTIC EngM_phiDeltaExtSync_C "#SSD Toleranz zwischen Kurbelwelle und Nockenwelle bei freigeschalteten CAN-Synchronisation" VALUE 0xD13EC Kw_Ws16 720.0000 AngleCrS 0.00 720.0000 FORMAT "%8.4" EXTENDED_LIMITS -768.0000 767.9766 /end CHARACTERISTIC
/begin CHARACTERISTIC EngM_phiDelta_C "#SSD Toleranz zwischen Kurbelwelle und Nockenwelle" VALUE 0xD13EE Kw_Ws16 720.0000 AngleCrS 0.00 720.0000 FORMAT "%8.4" EXTENDED_LIMITS -768.0000 767.9766 /end CHARACTERISTIC
/begin CHARACTERISTIC EngM_phiFrstInjInt_C "#SSD Position des ersten Interrupts vor OT zur Berechnung der ersten Einspritzung" VALUE 0xD13F0 Kw_Ws16 0.00 AngleCrS 739.9922 739.9922 FORMAT "%8.4" EXTENDED_LIMITS -768.0000 767.9766 /end CHARACTERISTIC
/begin CHARACTERISTIC EngM_phiInt_C "#SSD Positionen der stat. Interrupts vor jedem OT" VAL_BLK 0xD13F2 Kwb_Ws16 720.0000 AngleCrS 0.00 720.0000 FORMAT "%8.4" EXTENDED_LIMITS -768.0000 767.9766 NUMBER 5 /end CHARACTERISTIC
/begin CHARACTERISTIC EngM_phiMax_C "#SSD Max. physikalischer Winkel im System" VALUE 0xC0604 Kw_Ws32 360.000000000 AngleCrS 360.000000000 720.000000000 FORMAT "%13.9" EXTENDED_LIMITS -50331648.0000 50331647.9766 /end CHARACTERISTIC
/begin CHARACTERISTIC EngM_phiTDC_C "#SSD Vektor der OT-Winkel aller Zylinder" VAL_BLK 0xC0608 Kwb_Ws16 720.0000 AngleCrS 0.00 720.0000 FORMAT "%8.4" EXTENDED_LIMITS -768.0000 767.9766 NUMBER 6 /end CHARACTERISTIC
/begin CHARACTERISTIC EngM_RetCurr_MAP "Kennfeld um das Tastverhältnis der Fangphase der Motorlagersteuerung zu bestimmen - abhängig von Eng_tEng und BattCD_u" MAP 0xD1266 Kf_Xs16_Ys16_Ws16 655.3500 DtyCyc -327.6800 327.6700 FORMAT "%8.4"
 /begin AXIS_DESCR STD_AXIS BattCD_u Volt_Batt 6 0.00 28602.15 FORMAT "%8.2" EXTENDED_LIMITS -640625.6 640606.1 DEPOSIT ABSOLUTE /end AXIS_DESCR
 /begin AXIS_DESCR STD_AXIS Eng_tEng Temp_Cels 15 -50.14000 199.8600 FORMAT "%8.4" EXTENDED_LIMITS -3549.940 3003.560 DEPOSIT ABSOLUTE /end AXIS_DESCR
/end CHARACTERISTIC
/begin CHARACTERISTIC EngM_stBackUpVar_C "#SSD Variante: 0->Wechsel in BU-mode erfolgt bei einen Timeout von CrSCD  1->Wechsel erfolgt sobald Fehlerpf. CrS1 gesetzt ist" VALUE 0xD141A Kw_Wu8 1.000 OneToOne 0.00 1.000 FORMAT "%5.3" EXTENDED_LIMITS 0.00 255.0 /end CHARACTERISTIC
/begin CHARACTERISTIC EngM_stChkPN_C "Auswahlschalter:  Abfrage P/N-Status für Adaptionsfreigabe" VALUE 0xD1716 Kw_Wu8 1.000 OneToOne 0.00 1.000 FORMAT "%5.3" EXTENDED_LIMITS 0.00 255.0 /end CHARACTERISTIC
/begin CHARACTERISTIC EngM_stEnaBackUp_C "#SSD Schalter zur Aktivierung des Betriebsmodus nur mit Nockenwellensignal" VALUE 0xD141B Kw_Wu8 1.000 OneToOne 0.00 1.000 FORMAT "%5.3" EXTENDED_LIMITS 0.00 255.0 /end CHARACTERISTIC
/begin CHARACTERISTIC EngM_stOutHard_C "Hard control Bearing" VALUE 0xD1486 Kw_Wu8 1.000 OneToOne 0.00 1.000 FORMAT "%5.3" EXTENDED_LIMITS 0.00 255.0 /end CHARACTERISTIC
/begin CHARACTERISTIC EngM_stOutSoft_C "soft control Bearing" VALUE 0xD1487 Kw_Wu8 1.000 OneToOne 0.00 1.000 FORMAT "%5.3" EXTENDED_LIMITS 0.00 255.0 /end CHARACTERISTIC
/begin CHARACTERISTIC EngM_stSyncBefGap_C "#SSD Synchronisation ohne  Luecke" VALUE 0xD13FC Kw_Wu8 1.000 OneToOne 0.00 1.000 FORMAT "%5.3" EXTENDED_LIMITS 0.00 255.0 /end CHARACTERISTIC
/begin CHARACTERISTIC EngM_swtExitOfs_C "#SSD Aussprungbedingung aus dem SYNC_OFFSET State (0x00: Keyless Go, 0x01: Kl. 15 AUS/EIN, 0x10: SYNC_VERIFY_INC)" VALUE 0xD13FD Kw_Wu8 255.0 default 0.00 255.0 FORMAT "%5.1" /end CHARACTERISTIC
/begin CHARACTERISTIC EngM_swtFirSeqFBC_C "#SSD Schalter zur Auswahl der FBC Zählweise (1 = geometrisch gezählt, 0 = nach Zündreihenfolge gezählt)" VALUE 0xD13FE Kw_Wu8 1.000 default 0.00 1.000 FORMAT "%5.3" EXTENDED_LIMITS 0.00 255.0 /end CHARACTERISTIC
/begin CHARACTERISTIC EngM_swtNumCylVal_C "#SSD Zylinderanzahl, bei Applikation nicht verändern" VALUE 0xD13DB Kw_Wu8 3.000 OneToOne 3.000 6.000 FORMAT "%5.3" EXTENDED_LIMITS 0.00 255.0 /end CHARACTERISTIC
/begin CHARACTERISTIC EngM_swtNumCylType_C "#SSD Sw-Schaltertyp für Zylinderanzahl" VALUE 0xD13DC Kw_Wu8 2.000 OneToOne 0.00 2.000 FORMAT "%5.3" EXTENDED_LIMITS 0.00 255.0 /end CHARACTERISTIC
/begin CHARACTERISTIC EngM_swtSyncViaCAN_C "#SSD Ein-, Ausschalten 1/0 der Master-Slave Synchronisation via CAN" VALUE 0xD13FF Kw_Wu8 1.000 OneToOne 0.00 1.000 FORMAT "%5.3" EXTENDED_LIMITS 0.00 255.0 /end CHARACTERISTIC
/begin CHARACTERISTIC EngM_tAdptMin_C "Minimalmotortemperatur für Reibmomentenadaption" VALUE 0xD1718 Kw_Wu16 950.000 Temp_Cels -50.140 899.860 FORMAT "%8.3" EXTENDED_LIMITS -273.1400 6280.360 /end CHARACTERISTIC
/begin CHARACTERISTIC EngM_tEngMax_C "Obere Motortemperaturgrenze für die Motorlagersteuerungsansteuerung" VALUE 0xD1348 Kw_Ws16 250.0000 Temp_Cels -50.1400 199.8600 FORMAT "%8.4" EXTENDED_LIMITS -3549.940 3003.560 /end CHARACTERISTIC
/begin CHARACTERISTIC EngM_tEngMin_C "Untere Temperaturschwelle für die Motorlagersteuerungsansteuerung" VALUE 0xD134A Kw_Ws16 250.0000 Temp_Cels -50.1400 199.8600 FORMAT "%8.4" EXTENDED_LIMITS -3549.940 3003.560 /end CHARACTERISTIC
/begin CHARACTERISTIC EngM_tiCpuTimeOut_C "#SSD CPU timeout Periode" VALUE 0xC0614 Kw_Wu32 100000.000000 TimeDT 0.00 100000.000000 FORMAT "%13.6" EXTENDED_LIMITS 0.00 4294967295.00 /end CHARACTERISTIC
/begin CHARACTERISTIC EngM_tiDiffInt_C "#SSD Minimaler Abstand swischen zwei stat. Interrupts" VALUE 0xD1400 Kw_Wu32 1228361874.73 TimeSys_us 0.00 1228361874.73 FORMAT "%13.2" /end CHARACTERISTIC
/begin CHARACTERISTIC EngM_tiEngMntCtl_C "Zeitintervall zum Umschalten zwischen den Tastverhältnissen der Halte und der Fangphase" VALUE 0xD134C Kw_Wu16 655.3500 Time_s 0.00 655.3500 FORMAT "%8.4" /end CHARACTERISTIC
/begin CHARACTERISTIC EngM_tiHardAftrGear_C "time after which the ramp is activated for gear state" VALUE 0xD1488 Kw_Wu16 655.3500 Time_s 0.00 655.3500 FORMAT "%8.4" /end CHARACTERISTIC
/begin CHARACTERISTIC EngM_tiRelAdpt_C "Entprellzeit für Übergang NO_ADAPT --> ADAPT der Reibmomentenadaption" VALUE 0xD171A Kw_Wu16 655350.0 TimeDeb 0.00 655350.0 FORMAT "%8.1" /end CHARACTERISTIC
/begin CHARACTERISTIC EngM_tiSoftAftrStrt_C "time after which the ramp is activated for engine state" VALUE 0xD148A Kw_Wu16 655.3500 Time_s 0.00 655.3500 FORMAT "%8.4" /end CHARACTERISTIC
/begin CHARACTERISTIC EngM_tiWaitIncSig_C "#SSD Zeit zum Ausblenden des Inkrementsignals im Start" VALUE 0xD1404 Kw_Wu16 20000.00 Time_ms 0.00 20000.00 FORMAT "%8.2" EXTENDED_LIMITS 0.00 655350.0 /end CHARACTERISTIC
/begin CHARACTERISTIC EngM_trqFrcPDiffMin_C "Untere Begrenzung des Drehmomentenverlustes durch Abgasgegendruck aufgrund eingebautem Partikelfilter" VALUE 0xD14C0 Kw_Ws16 600.0000 Trq -300.0000 300.0000 FORMAT "%8.4" EXTENDED_LIMITS -3276.800 3276.700 /end CHARACTERISTIC
/begin CHARACTERISTIC EngM_trqFrc_Vector "#SSD Bypass Label für EngM_trqFrc (nicht verändern !)" VALUE 0xC3098 Kw_Wu8 255.0 OneToOne 0.00 255.0 FORMAT "%5.1" /end CHARACTERISTIC
/begin CHARACTERISTIC EngM_trqFrc_Channel "#SSD Bypass Label for EngM_trqFrc (nicht verändern !)" VALUE 0xC3099 Kw_Wu8 255.0 OneToOne 0.00 255.0 FORMAT "%5.1" /end CHARACTERISTIC
/begin CHARACTERISTIC EngM_trqFrc_MAP "Schleppkennfeld, Reibkennfeld" MAP 0xD14C2 Kf_Xs16_Ys16_Ws16 6553.500 Trq -3276.800 3276.700 FORMAT "%8.3"
 /begin AXIS_DESCR STD_AXIS Eng_nAvrg EngN 16 0.00 32767.00 FORMAT "%8.2" EXTENDED_LIMITS -32768.00 32767.00 DEPOSIT ABSOLUTE /end AXIS_DESCR
 /begin AXIS_DESCR STD_AXIS EngM_tTrqFrc_mp Temp_Cels 16 -50.140 899.860 FORMAT "%8.3" EXTENDED_LIMITS -3549.940 3003.560 DEPOSIT ABSOLUTE /end AXIS_DESCR
/end CHARACTERISTIC
/begin CHARACTERISTIC EngM_uBattMax_C "Obere Batteriespannungsgrenze für die Motorlageransteuerung" VALUE 0xD134E Kw_Ws16 17008.80 Volt_Batt 0.00 17008.80 FORMAT "%8.2" EXTENDED_LIMITS -640625.6 640606.1 /end CHARACTERISTIC
/begin CHARACTERISTIC EngM_uBattMin_C "Untere Batteriespannungsgrenze für die Motorlageransteuerung" VALUE 0xD1350 Kw_Ws16 2991.202 Volt_Batt 0.00 2991.202 FORMAT "%8.3" EXTENDED_LIMITS -640625.6 640606.1 /end CHARACTERISTIC
/begin CHARACTERISTIC EngM_vLimRefuse_C "Schwellgeschwindigkeit für Zustandsübergang REFUSE_ADAPT --> NO_ADAPT der Reibmomentenadaption" VALUE 0xD171C Kw_Wu16 655.3500 Vel 0.00 655.3500 FORMAT "%8.4" /end CHARACTERISTIC
/begin CHARACTERISTIC EngM_vThresAdpt_C "vehicle speed threshold for release of adaption" VALUE 0xD171E Kw_Wu16 655.3500 Vel 0.00 655.3500 FORMAT "%8.4" /end CHARACTERISTIC
/begin CHARACTERISTIC EngM_vVSSCDHysHigh_C "high threshold for vechile speed hysteresis" VALUE 0xD148C Kw_Ws16 300.0000 Vel 0.00 300.0000 FORMAT "%8.4" EXTENDED_LIMITS -327.6800 327.6700 /end CHARACTERISTIC
/begin CHARACTERISTIC EngM_vVSSCDHysLow_C "low threshold for vechile speed hysteresis" VALUE 0xD148E Kw_Ws16 300.0000 Vel 0.00 300.0000 FORMAT "%8.4" EXTENDED_LIMITS -327.6800 327.6700 /end CHARACTERISTIC
/begin CHARACTERISTIC EngPrt_dTrqLimUp_C "ramp slope up" VALUE 0xD1720 Kw_Wu32 6553594.99817 RmpTrq 5.00030517578 6553599.99847 FORMAT "%13.5" EXTENDED_LIMITS 0.00 6553599.99847 /end CHARACTERISTIC
/begin CHARACTERISTIC EngPrt_dTrqLimDown_C "ramp slope down" VALUE 0xD1724 Kw_Wu32 6553594.99817 RmpTrq 5.00030517578 6553599.99847 FORMAT "%13.5" EXTENDED_LIMITS 0.00 6553599.99847 /end CHARACTERISTIC
/begin CHARACTERISTIC EngPrt_facAPSPrv_MAP "Kennfeld für Überhitzungsschutz in Abhängigkeit des Atmosphärendrucks" MAP 0xD1728 Kf_Xs16_Ys16_Ws16 3.999878 Fact 0.00 3.999878 FORMAT "%8.6" EXTENDED_LIMITS -4.000000 3.999878
 /begin AXIS_DESCR STD_AXIS APSCD_pVal Pres_hPa 9 -32768.00 32767.00 FORMAT "%8.2" DEPOSIT ABSOLUTE /end AXIS_DESCR
 /begin AXIS_DESCR STD_AXIS Eng_nAvrg EngN 9 0.00 32767.00 FORMAT "%8.2" EXTENDED_LIMITS -32768.00 32767.00 DEPOSIT ABSOLUTE /end AXIS_DESCR
/end CHARACTERISTIC
/begin CHARACTERISTIC EngPrt_facOvhtPrvCT_CUR "Überhitzungsschutz-Kennlinie Kühlwassertemperatur in Faktor" CURVE 0xD1ADE Kl_Xs16_Ws16 1.000000 Fact 0.00 1.000000 FORMAT "%8.6" EXTENDED_LIMITS -4.000000 3.999878
 /begin AXIS_DESCR STD_AXIS CTSCD_tClnt Temp_Cels 25 -50.14000 199.8600 FORMAT "%8.4" EXTENDED_LIMITS -3549.940 3003.560 DEPOSIT ABSOLUTE /end AXIS_DESCR
/end CHARACTERISTIC
/begin CHARACTERISTIC EngPrt_facOvhtPrvFT_CUR "Überhitzungsschutz-Kennlinie Kraftstofftemperatur in Faktor" CURVE 0xD1B44 Kl_Xs16_Ws16 1.000000 Fact 0.00 1.000000 FORMAT "%8.6" EXTENDED_LIMITS -4.000000 3.999878
 /begin AXIS_DESCR STD_AXIS FTSCD_tFuel Temp_Cels 25 -50.14000 199.8600 FORMAT "%8.4" EXTENDED_LIMITS -3549.940 3003.560 DEPOSIT ABSOLUTE /end AXIS_DESCR
/end CHARACTERISTIC
/begin CHARACTERISTIC EngPrt_facOvhtPrvOT_CUR "Überhitzungsschutz-Kennlinie Motoröltemperatur in Faktor" CURVE 0xD1BAA Kl_Xs16_Ws16 1.000000 Fact 0.00 1.000000 FORMAT "%8.6" EXTENDED_LIMITS -4.000000 3.999878
 /begin AXIS_DESCR STD_AXIS OTSCD_tEngOil Temp_Cels 25 -50.14000 199.8600 FORMAT "%8.4" EXTENDED_LIMITS -3549.940 3003.560 DEPOSIT ABSOLUTE /end AXIS_DESCR
/end CHARACTERISTIC
/begin CHARACTERISTIC EngPrt_facOvhtPrv_MAP "Map for overheating prevention factor of engine" MAP 0xD17F2 Kf_Xs16_Ys16_Ws16 3.999878 Fact 0.00 3.999878 FORMAT "%8.6" EXTENDED_LIMITS -4.000000 3.999878
 /begin AXIS_DESCR STD_AXIS Eng_tEng Temp_Cels 7 -50.140 899.860 FORMAT "%8.3" EXTENDED_LIMITS -3549.940 3003.560 DEPOSIT ABSOLUTE /end AXIS_DESCR
 /begin AXIS_DESCR STD_AXIS VSSCD_v Vel 7 0.00 327.6700 FORMAT "%8.4" EXTENDED_LIMITS -327.6800 327.6700 DEPOSIT ABSOLUTE /end AXIS_DESCR
/end CHARACTERISTIC
/begin CHARACTERISTIC EngPrt_nOvrSpd_C "#SSD Schwelle für Überdrehzahlerkennung" VALUE 0xD1874 Kw_Ws16 6000.000 EngN 0.00 6000.000 FORMAT "%8.3" EXTENDED_LIMITS -32768.00 32767.00 /end CHARACTERISTIC
/begin CHARACTERISTIC EngPrt_nTrqShutOff_C "threshold value of engine speed for fly wheel oscillation detection" VALUE 0xD1AD8 Kw_Ws16 6000.000 EngN 0.00 6000.000 FORMAT "%8.3" EXTENDED_LIMITS -32768.00 32767.00 /end CHARACTERISTIC
/begin CHARACTERISTIC EngPrt_pAPSPrvDfl_C "Default-Wert bei Ausfall des Atmosphärendrucksensors" VALUE 0xD1876 Kw_Ws16 3500.000 Pres_hPa 0.00 3500.000 FORMAT "%8.3" EXTENDED_LIMITS -32768.00 32767.00 /end CHARACTERISTIC
/begin CHARACTERISTIC EngPrt_qOvhtPrvNRng_MAP "Überhitzungsschutz-Kennfeld für Drehzahl" MAP 0xD1C10 Kf_Xs16_Ys16_Ws16 327.6700 InjMass 0.00 327.6700 FORMAT "%8.4" EXTENDED_LIMITS -327.6800 327.6700
 /begin AXIS_DESCR STD_AXIS Eng_nAvrg EngN 16 40.00000 6000.000 FORMAT "%8.3" EXTENDED_LIMITS -32768.00 32767.00 DEPOSIT ABSOLUTE /end AXIS_DESCR
 /begin AXIS_DESCR STD_AXIS EngPrt_facOvhtPrv_mp Fact 16 0.00 1.000000 FORMAT "%8.6" EXTENDED_LIMITS -4.000000 3.999878 DEPOSIT ABSOLUTE /end AXIS_DESCR
/end CHARACTERISTIC
/begin CHARACTERISTIC EngPrt_qOvhtPrvVRng_MAP "Überhitzungsschutz-Kennfeld für Fahrzeuggeschwindigkeit" MAP 0xD1E54 Kf_Xs16_Ys16_Ws16 327.6700 InjMass 0.00 327.6700 FORMAT "%8.4" EXTENDED_LIMITS -327.6800 327.6700
 /begin AXIS_DESCR STD_AXIS EngPrt_facOvhtPrv_mp Fact 16 0.00 1.000000 FORMAT "%8.6" EXTENDED_LIMITS -4.000000 3.999878 DEPOSIT ABSOLUTE /end AXIS_DESCR
 /begin AXIS_DESCR STD_AXIS VSSCD_v Vel 16 0.00 300.0000 FORMAT "%8.4" EXTENDED_LIMITS -327.6800 327.6700 DEPOSIT ABSOLUTE /end AXIS_DESCR
/end CHARACTERISTIC
/begin CHARACTERISTIC EngPrt_qPrtLim_Vector "#SSD Bypass Label, nicht ändern!" VALUE 0xC309A Kw_Wu8 255.0 OneToOne 0.00 255.0 FORMAT "%5.1" /end CHARACTERISTIC
/begin CHARACTERISTIC EngPrt_qPrtLim_Channel "#SSD Bypass Label, nicht ändern!" VALUE 0xC309B Kw_Wu8 255.0 OneToOne 0.00 255.0 FORMAT "%5.1" /end CHARACTERISTIC
/begin CHARACTERISTIC EngPrt_dtrqUpCBLim_C "Positiv rampensteigung fuer Drehmomentbegrenzung bei Verdichterbypass oeffnen" VALUE 0xD1878 Kw_Wu32 6553594.99817 RmpTrq 5.00030517578 6553599.99847 FORMAT "%13.5" EXTENDED_LIMITS 0.00 6553599.99847 /end CHARACTERISTIC
/begin CHARACTERISTIC EngPrt_dtrqDwnCBLim_C "Negativ rampensteigung fuer Drehmomentbegrenzung bei Verdichterbypass oeffnen" VALUE 0xD187C Kw_Wu32 6553594.99817 RmpTrq 5.00030517578 6553599.99847 FORMAT "%13.5" EXTENDED_LIMITS 0.00 6553599.99847 /end CHARACTERISTIC
/begin CHARACTERISTIC EngPrt_dtrqUpNLim_C "Rampenanstieg von Ersatzkennlinie auf Normalkennlinie der Motordrehzahlbegrenzung" VALUE 0xD1880 Kw_Wu32 6553594.99817 RmpTrq 5.00030517578 6553599.99847 FORMAT "%13.5" EXTENDED_LIMITS 0.00 6553599.99847 /end CHARACTERISTIC
/begin CHARACTERISTIC EngPrt_dtrqDwnNLim_C "Rampenanstieg von Normalkennlinie zur Ersatzkennlinie der Motordrehzahlbegrenzung" VALUE 0xD1884 Kw_Wu32 6553594.99817 RmpTrq 5.00030517578 6553599.99847 FORMAT "%13.5" EXTENDED_LIMITS 0.00 6553599.99847 /end CHARACTERISTIC
/begin CHARACTERISTIC EngPrt_rVnDAMax_C "Maximum v/n Verhältnis" VALUE 0xD1888 Kw_Ws16 0.3276700 VelToN 0.00 0.3276700 FORMAT "%9.7" EXTENDED_LIMITS -0.3276800 0.3276700 /end CHARACTERISTIC
/begin CHARACTERISTIC EngPrt_rVnDAMin_C "Minimum v/n Verhältnis" VALUE 0xD188A Kw_Ws16 0.3276700 VelToN 0.00 0.3276700 FORMAT "%9.7" EXTENDED_LIMITS -0.3276800 0.3276700 /end CHARACTERISTIC
/begin CHARACTERISTIC EngPrt_rVnTrqMax_C "Maximum v/n Verhältnis" VALUE 0xD188C Kw_Ws16 0.3276700 VelToN 0.00 0.3276700 FORMAT "%9.7" EXTENDED_LIMITS -0.3276800 0.3276700 /end CHARACTERISTIC
/begin CHARACTERISTIC EngPrt_rVnTrqMin_C "Minimum v/n Verhältnis" VALUE 0xD188E Kw_Ws16 0.3276700 VelToN 0.00 0.3276700 FORMAT "%9.7" EXTENDED_LIMITS -0.3276800 0.3276700 /end CHARACTERISTIC
/begin CHARACTERISTIC EngPrt_swtTrqGear_CUR "applizierbare Gänge: Wert = 0 nicht aktiv; Wert = 1 aktiv" CURVE 0xD1890 Kl_Xs16_Ws16 32767.00 OneToOne 0.00 32767.00 FORMAT "%8.2" EXTENDED_LIMITS -32768.00 32767.00
 /begin AXIS_DESCR STD_AXIS Gearbx_stGear OneToOne 8 -1.000 127.0 FORMAT "%5.1" EXTENDED_LIMITS -128.0 127.0 DEPOSIT ABSOLUTE /end AXIS_DESCR
/end CHARACTERISTIC
/begin CHARACTERISTIC EngPrt_trqCBLim1_CUR "Drehmomentbegrenzung bei geoeffnetem Verdichterbypass" CURVE 0xD18B2 Kl_Xs16_Ws16 3276.700 Trq 0.00 3276.700 FORMAT "%8.3" EXTENDED_LIMITS -3276.800 3276.700
 /begin AXIS_DESCR STD_AXIS Eng_nAvrg EngN 20 0.00 32767.00 FORMAT "%8.2" EXTENDED_LIMITS -32768.00 32767.00 DEPOSIT ABSOLUTE /end AXIS_DESCR
/end CHARACTERISTIC
/begin CHARACTERISTIC EngPrt_trqCBLim_CUR "Drehmomentbegrenzung bei geoeffnetem Verdichterbypass" CURVE 0xD1904 Kl_Xs16_Ws16 3276.700 Trq 0.00 3276.700 FORMAT "%8.3" EXTENDED_LIMITS -3276.800 3276.700
 /begin AXIS_DESCR STD_AXIS Eng_nAvrg EngN 20 0.00 32767.00 FORMAT "%8.2" EXTENDED_LIMITS -32768.00 32767.00 DEPOSIT ABSOLUTE /end AXIS_DESCR
/end CHARACTERISTIC
/begin CHARACTERISTIC EngPrt_trqLim1_CUR "Momentenbegrenzungskurve für AT mit geschlossener Wandlerkupplung und aktueller Gang muß in EngPrt_swtTrqGear_CUR 1 sein." CURVE 0xD1956 Kl_Xs16_Ws16 3276.700 Trq 0.00 3276.700 FORMAT "%8.3" EXTENDED_LIMITS -3276.800 3276.700
 /begin AXIS_DESCR STD_AXIS Eng_nAvrg EngN 21 0.00 32767.00 FORMAT "%8.2" EXTENDED_LIMITS -32768.00 32767.00 DEPOSIT ABSOLUTE /end AXIS_DESCR
/end CHARACTERISTIC
/begin CHARACTERISTIC EngPrt_trqLimDA_CUR "Anfahrdrehmomentenbegrenzungskennlinie" CURVE 0xD19AC Kl_Xs16_Ws16 3276.700 Trq 0.00 3276.700 FORMAT "%8.3" EXTENDED_LIMITS -3276.800 3276.700
 /begin AXIS_DESCR STD_AXIS Eng_nAvrg EngN 21 0.00 32767.00 FORMAT "%8.2" EXTENDED_LIMITS -32768.00 32767.00 DEPOSIT ABSOLUTE /end AXIS_DESCR
/end CHARACTERISTIC
/begin CHARACTERISTIC EngPrt_trqLim_CUR "Kennlinie die Drehmomentbegrenzung (je nach Application inneres oder äußeres Motormoment)" CURVE 0xD1A02 Kl_Xs16_Ws16 3276.700 Trq 0.00 3276.700 FORMAT "%8.3" EXTENDED_LIMITS -3276.800 3276.700
 /begin AXIS_DESCR STD_AXIS Eng_nAvrg EngN 21 0.00 32767.00 FORMAT "%8.2" EXTENDED_LIMITS -32768.00 32767.00 DEPOSIT ABSOLUTE /end AXIS_DESCR
/end CHARACTERISTIC
/begin CHARACTERISTIC EngPrt_trqNLimSpr_CUR "Kennlinie für Motordrehzahlbegrenzung bei Systemfehler (als Begrenzungsmoment)" CURVE 0xD1A58 Kl_Xs16_Ws16 3276.700 Trq 0.00 3276.700 FORMAT "%8.3" EXTENDED_LIMITS -3276.800 3276.700
 /begin AXIS_DESCR STD_AXIS Eng_nAvrg EngN 10 0.00 32767.00 FORMAT "%8.2" EXTENDED_LIMITS -32768.00 32767.00 DEPOSIT ABSOLUTE /end AXIS_DESCR
/end CHARACTERISTIC
/begin CHARACTERISTIC EngPrt_trqNLim_CUR "Kennlinie für Drehzahlbegrenzung im Normalbetrieb (inneres Motormoment)" CURVE 0xD1A82 Kl_Xs16_Ws16 3276.700 Trq 0.00 3276.700 FORMAT "%8.3" EXTENDED_LIMITS -3276.800 3276.700
 /begin AXIS_DESCR STD_AXIS Eng_nAvrg EngN 21 0.00 32767.00 FORMAT "%8.2" EXTENDED_LIMITS -32768.00 32767.00 DEPOSIT ABSOLUTE /end AXIS_DESCR
/end CHARACTERISTIC
/begin CHARACTERISTIC EngPrt_trqNLim_Vector "#SSD Bypass Label, nicht ändern!" VALUE 0xC309C Kw_Wu8 255.0 OneToOne 0.00 255.0 FORMAT "%5.1" /end CHARACTERISTIC
/begin CHARACTERISTIC EngPrt_trqNLim_Channel "#SSD Bypass Label, nicht ändern!" VALUE 0xC309D Kw_Wu8 255.0 OneToOne 0.00 255.0 FORMAT "%5.1" /end CHARACTERISTIC
/begin CHARACTERISTIC EngPrt_trqPrtLim_Vector "#SSD Bypass Label, nicht ändern!" VALUE 0xC309E Kw_Wu8 255.0 OneToOne 0.00 255.0 FORMAT "%5.1" /end CHARACTERISTIC
/begin CHARACTERISTIC EngPrt_trqPrtLim_Channel "#SSD Bypass Label, nicht ändern!" VALUE 0xC309F Kw_Wu8 255.0 OneToOne 0.00 255.0 FORMAT "%5.1" /end CHARACTERISTIC
/begin CHARACTERISTIC Eng_ctEngSpdDiffCalc_C "Anzahl der Drehzahlwerte zur Mittelung" VALUE 0xD1354 Kw_Wu8 4.000 OneToOne 1.000 5.000 FORMAT "%5.3" EXTENDED_LIMITS 0.00 255.0 /end CHARACTERISTIC
/begin CHARACTERISTIC Eng_tiOvrTemp2_C "Zeitverzögerung Übertemperatur 2" VALUE 0xD13B4 Kw_Ws16 655.3500 Time_s -327.6800 327.6700 FORMAT "%8.4" /end CHARACTERISTIC
/begin CHARACTERISTIC Eng_tiOvrTemp_C "Zeitverzögerung Übertemperatur 1" VALUE 0xD13B6 Kw_Ws16 655.3500 Time_s -327.6800 327.6700 FORMAT "%8.4" /end CHARACTERISTIC
/begin CHARACTERISTIC Eng_tOvrHi2_C "high hysteresis limit for setting of overheat status" VALUE 0xD1356 Kw_Ws16 250.0000 Temp_Cels -50.14000 199.8600 FORMAT "%8.4" EXTENDED_LIMITS -3549.940 3003.560 /end CHARACTERISTIC
/begin CHARACTERISTIC Eng_tOvrHi_C "Obere Hystereseschwelle für Erkennung Übertemperatur" VALUE 0xD1358 Kw_Ws16 250.0000 Temp_Cels -50.14000 199.8600 FORMAT "%8.4" EXTENDED_LIMITS -3549.940 3003.560 /end CHARACTERISTIC
/begin CHARACTERISTIC Eng_tOvrLo2_C "low hysteresis limit for setting of overheat status" VALUE 0xD135A Kw_Ws16 250.0000 Temp_Cels -50.14000 199.8600 FORMAT "%8.4" EXTENDED_LIMITS -3549.940 3003.560 /end CHARACTERISTIC
/begin CHARACTERISTIC Eng_tOvrLo_C "Untere Hystereseschwelle für Erkennung Übertemperatur" VALUE 0xD135C Kw_Ws16 250.0000 Temp_Cels -50.14000 199.8600 FORMAT "%8.4" EXTENDED_LIMITS -3549.940 3003.560 /end CHARACTERISTIC
/begin CHARACTERISTIC Eng_trqSpd_CUR "Drehmomentkennlinie" CURVE 0xD135E Kl_Xs16_Ws16 3276.700 Trq 0.00 3276.700 FORMAT "%8.3" EXTENDED_LIMITS -3276.800 3276.700
 /begin AXIS_DESCR STD_AXIS Eng_nAvrg EngN 21 0.00 6000.000 FORMAT "%8.3" EXTENDED_LIMITS -32768.00 32767.00 DEPOSIT ABSOLUTE /end AXIS_DESCR
/end CHARACTERISTIC
/begin CHARACTERISTIC ErLpCD_ctMilPwrStgOnMax_C "Maximaler Zähler für Powerstage On im Fehlerfall" VALUE 0xD2098 Kw_Wu16 65535.00 OneToOne 0.00 65535.00 FORMAT "%8.2" /end CHARACTERISTIC
/begin CHARACTERISTIC ErLpCD_ctSysLmpPwrStgOnMax_C "Maximaler Zähler für Powerstage On im Fehlerfall" VALUE 0xD209A Kw_Wu16 65535.00 OneToOne 0.00 65535.00 FORMAT "%8.2" /end CHARACTERISTIC
/begin CHARACTERISTIC ErLpCD_tiDefMil_C "Zeit für MIL Defekterkennung (Endstufenüberwachung)" VALUE 0xD209C Kw_Wu16 655350.0 Time_ms 0.00 655350.0 FORMAT "%8.1" /end CHARACTERISTIC
/begin CHARACTERISTIC ErLpCD_tiOkMil_C "Zeit für MIL in Ordnung Erkennung (Endstufenüberwachung)" VALUE 0xD209E Kw_Wu16 655350.0 Time_ms 0.00 655350.0 FORMAT "%8.1" /end CHARACTERISTIC
/begin CHARACTERISTIC ErLpCD_nThresMil_C "Drehzahlgrenze für MIL-Test" VALUE 0xD20A0 Kw_Ws16 65535.00 EngN -32768.00 32767.00 FORMAT "%8.2" /end CHARACTERISTIC
/begin CHARACTERISTIC ErLpCD_tiMaxMil_C "Zeitgrenze für MIL-Test" VALUE 0xD20A2 Kw_Wu16 655350.0 Time_ms 0.00 655350.0 FORMAT "%8.1" /end CHARACTERISTIC
/begin CHARACTERISTIC ErLpCD_tiMilTst_C "zusätzliche MIL Test Zeit nach Überschreiten Drehzahlschwelle" VALUE 0xD20A4 Kw_Wu16 655350.0 Time_ms 0.00 655350.0 FORMAT "%8.1" /end CHARACTERISTIC
/begin CHARACTERISTIC ErLpCD_tiDelMil_C "Verzögerung der MIL Anzeige nach Lampentest" VALUE 0xD20A6 Kw_Wu16 655350.0 Time_ms 0.00 655350.0 FORMAT "%8.1" /end CHARACTERISTIC
/begin CHARACTERISTIC ErLpCD_tiBlkMil_C "halbe Zeit der MIL Blink Periodedauer" VALUE 0xD20A8 Kw_Wu16 655350.0 Time_ms 0.00 655350.0 FORMAT "%8.1" /end CHARACTERISTIC
/begin CHARACTERISTIC ErLpCD_swtMilEna_C "MIL Freigabe Schalter (0 = abgeschaltet; 1 = eingeschaltet)" VALUE 0xD20AA Kw_Wu8 1.000 OneToOne 0.00 1.000 FORMAT "%5.3" EXTENDED_LIMITS 0.00 255.0 /end CHARACTERISTIC
/begin CHARACTERISTIC ErLpCD_numDiaErrLmp_C "#SSD application parameter for error lamp diagnostic signal" VALUE 0xD20AC Kw_Wu8 35.0000000000 NumPinDia 0.00 35.0000000000 FORMAT "%13.10" /end CHARACTERISTIC
/begin CHARACTERISTIC ErLpCD_numDiaSysLmp_C "#SSD application parameter for system lamp diagnostic signal" VALUE 0xD20AD Kw_Wu8 35.0000000000 NumPinDia 0.00 35.0000000000 FORMAT "%13.10" /end CHARACTERISTIC
/begin CHARACTERISTIC ErLpCD_numDioOutErrLmp_C "#SSD application parameter for error lamp" VALUE 0xD20AE Kw_Wu8 11.0000000000 NumPinDioOut 0.00 11.0000000000 FORMAT "%13.10" /end CHARACTERISTIC
/begin CHARACTERISTIC ErLpCD_numDioOutSysLmp_C "#SSD application parameter for system lamp" VALUE 0xD20AF Kw_Wu8 11.0000000000 NumPinDioOut 0.00 11.0000000000 FORMAT "%13.10" /end CHARACTERISTIC
/begin CHARACTERISTIC ErLpCD_stRdy_C "Status der readyness function" VALUE 0xD20B0 Kw_Wu8 1.000 OneToOne 0.00 1.000 FORMAT "%5.3" EXTENDED_LIMITS 0.00 255.0 /end CHARACTERISTIC
/begin CHARACTERISTIC ErLpCD_tiRdy_C "Maximale Zeit für das Prüfen der readiness via MIL" VALUE 0xD20B2 Kw_Wu16 655350.0 Time_ms 0.00 655350.0 FORMAT "%8.1" /end CHARACTERISTIC
/begin CHARACTERISTIC ErLpCD_tiBlkOn_C "Dauer Lampe ein während der Blinkphase" VALUE 0xD20B4 Kw_Wu16 655350.0 Time_ms 0.00 655350.0 FORMAT "%8.1" /end CHARACTERISTIC
/begin CHARACTERISTIC ErLpCD_tiBlkOff_C "Dauer Lampe aus während der Blinkphase" VALUE 0xD20B6 Kw_Wu16 655350.0 Time_ms 0.00 655350.0 FORMAT "%8.1" /end CHARACTERISTIC
/begin CHARACTERISTIC ErLpCD_stMilSPICtl_C "0 = Non SPI powerstage )" VALUE 0xD20B8 Kw_Wu8 1.000 OneToOne 0.00 1.000 FORMAT "%5.3" EXTENDED_LIMITS 0.00 255.0 /end CHARACTERISTIC
/begin CHARACTERISTIC ErLpCD_stPwrStgActvLmp_C "Spezifikation des Abschaltverhaltens der Lamp-Endstufe" VALUE 0xD20B9 Kw_Wu8 255.0 OneToOne 0.00 255.0 FORMAT "%5.1" /end CHARACTERISTIC
/begin CHARACTERISTIC ErLpCD_stPwrStgActvMil_C "Spezifikation des Abschaltverhaltens der MIL-Endstufe" VALUE 0xD20BA Kw_Wu8 255.0 OneToOne 0.00 255.0 FORMAT "%5.1" /end CHARACTERISTIC
/begin CHARACTERISTIC ErLpCD_stPwrStgDiaLmp_C "Spezifikation des Diagnoseabschaltverhaltens der Lamp-Endstufe" VALUE 0xD20BB Kw_Wu8 255.0 OneToOne 0.00 255.0 FORMAT "%5.1" /end CHARACTERISTIC
/begin CHARACTERISTIC ErLpCD_stPwrStgDiaMil_C "Spezifikation des Diagnoseabschaltverhaltens der MIL-Endstufe" VALUE 0xD20BC Kw_Wu8 255.0 OneToOne 0.00 255.0 FORMAT "%5.1" /end CHARACTERISTIC
/begin CHARACTERISTIC ErLpCD_stSysLmpSPICtl_C "0 = Non SPI powerstage )" VALUE 0xD20BD Kw_Wu8 1.000 OneToOne 0.00 1.000 FORMAT "%5.3" EXTENDED_LIMITS 0.00 255.0 /end CHARACTERISTIC
/begin CHARACTERISTIC ErLpCD_swtSysEqGlwLmp_C "SysLamp entspricht Glühlampe (Signalumleitung) (0 = abgeschaltet; 1 = eingeschaltet)" VALUE 0xD20BE Kw_Wu8 1.000 OneToOne 0.00 1.000 FORMAT "%5.3" EXTENDED_LIMITS 0.00 255.0 /end CHARACTERISTIC
/begin CHARACTERISTIC ErLpCD_tiDefSysLmp_C "Zeit für SysLamp Defekterkennung (Endstufenüberwachung)" VALUE 0xD20C0 Kw_Wu16 655350.0 Time_ms 0.00 655350.0 FORMAT "%8.1" /end CHARACTERISTIC
/begin CHARACTERISTIC ErLpCD_tiOkSysLmp_C "Zeit für SysLamp in Ordnung Erkennung (Endstufenüberwachung)" VALUE 0xD20C2 Kw_Wu16 655350.0 Time_ms 0.00 655350.0 FORMAT "%8.1" /end CHARACTERISTIC
/begin CHARACTERISTIC ErLpCD_nThresSysLmp_C "Drehzahlgrenze für SysLamp-Test" VALUE 0xD20C4 Kw_Ws16 65535.00 EngN -32768.00 32767.00 FORMAT "%8.2" /end CHARACTERISTIC
/begin CHARACTERISTIC ErLpCD_tiMaxSysLmp_C "Zeitgrenze für SysLamp-Test" VALUE 0xD20C6 Kw_Wu16 655350.0 Time_ms 0.00 655350.0 FORMAT "%8.1" /end CHARACTERISTIC
/begin CHARACTERISTIC ErLpCD_tiTstSysLmp_C "zusätzliche SysLamp Test Zeit nach Überschreiten Drehzahlschwelle" VALUE 0xD20C8 Kw_Wu16 655350.0 Time_ms 0.00 655350.0 FORMAT "%8.1" /end CHARACTERISTIC
/begin CHARACTERISTIC ErLpCD_tiDelSysLmp_C "Verzögerung der SysLamp Anzeige nach Lampentest" VALUE 0xD20CA Kw_Wu16 655350.0 Time_ms 0.00 655350.0 FORMAT "%8.1" /end CHARACTERISTIC
/begin CHARACTERISTIC ErLpCD_tiBlkSysLmp_C "halbe Zeit der SysLamp Blink Periodedauer" VALUE 0xD20CC Kw_Wu16 655350.0 Time_ms 0.00 655350.0 FORMAT "%8.1" /end CHARACTERISTIC
/begin CHARACTERISTIC ErLpCD_swtSysLmpEna_C "SysLamp Freigabe Schalter (0 = abgeschaltet; 1 = eingeschaltet)" VALUE 0xD20CE Kw_Wu8 1.000 OneToOne 0.00 1.000 FORMAT "%5.3" EXTENDED_LIMITS 0.00 255.0 /end CHARACTERISTIC
/begin CHARACTERISTIC ErLpCD_tiBtwTstMil_C "Zeitabstand, in dem die Endstufe im Fehlerfall getestet wird" VALUE 0xD20D0 Kw_Wu16 655140.0 Time_ms 0.00 655140.0 FORMAT "%8.1" EXTENDED_LIMITS 0.00 655350.0 /end CHARACTERISTIC
/begin CHARACTERISTIC ErLpCD_tiBtwTstSysLmp_C "Zeitabstand, in dem die Endstufe im Fehlerfall getestet wird" VALUE 0xD20D2 Kw_Wu16 655140.0 Time_ms 0.00 655140.0 FORMAT "%8.1" EXTENDED_LIMITS 0.00 655350.0 /end CHARACTERISTIC
/begin CHARACTERISTIC ErLpCD_tiMilPwrStgOn_C "Zeit für welche die Endstufe im Fehlerfall eingeschalten wird (nur nicht SPI kontrolliert)" VALUE 0xD20D4 Kw_Wu16 655140.0 Time_ms 0.00 655140.0 FORMAT "%8.1" EXTENDED_LIMITS 0.00 655350.0 /end CHARACTERISTIC
/begin CHARACTERISTIC ErLpCD_tiSysLmpPwrStgOn_C "Zeit für welche die Endstufe im Fehlerfall eingeschalten wird (nur nicht SPI kontrolliert)" VALUE 0xD20D6 Kw_Wu16 655140.0 Time_ms 0.00 655140.0 FORMAT "%8.1" EXTENDED_LIMITS 0.00 655350.0 /end CHARACTERISTIC
/begin CHARACTERISTIC ESS_nBattMin_C "#SSD Wert der geforderten Drehzahl nach Freigabe" VALUE 0xD20E0 Kw_Ws16 38768.00 EngN -32768.00 6000.000 FORMAT "%8.2" EXTENDED_LIMITS -32768.00 32767.00 /end CHARACTERISTIC
/begin CHARACTERISTIC ESS_nLIBattThres_C "Schwelle Drehzahl zur Aktivierung der Drehzahlforderung" VALUE 0xD20D8 Kw_Ws16 38768.00 EngN -32768.00 6000.000 FORMAT "%8.2" EXTENDED_LIMITS -32768.00 32767.00 /end CHARACTERISTIC
/begin CHARACTERISTIC ESS_nMinThres_C "Drehzahlschwelle zur Verhinderung eines Momentensprungs" VALUE 0xD20DA Kw_Ws16 38768.00 EngN -32768.00 6000.000 FORMAT "%8.2" EXTENDED_LIMITS -32768.00 32767.00 /end CHARACTERISTIC
/begin CHARACTERISTIC ESS_tiDelayUBattFFRes_C "Zeit bis Rücknahme der Drehzahlforderung nach Deaktivierung" VALUE 0xD20E2 Kw_Ws16 655.3500 Time_s -327.6800 327.6700 FORMAT "%8.4" /end CHARACTERISTIC
/begin CHARACTERISTIC ESS_tiDelayUBattFFSet_C "Zeit bis Freigabe der Drehzahlforderung nach Aktivierung" VALUE 0xD20DC Kw_Ws16 655.3500 Time_s -327.6800 327.6700 FORMAT "%8.4" /end CHARACTERISTIC
/begin CHARACTERISTIC ESS_uLIBattThresFFRes_C "Schwelle Batteriespannung zur Deaktivierung der Drehzahlforderung" VALUE 0xD20E4 Kw_Ws16 1281232. Volt_Batt -640625.6 640606.1 FORMAT "%8.1" /end CHARACTERISTIC
/begin CHARACTERISTIC ESS_uLIBattThresFFSet_C "Schwelle Batteriespannung zur Aktivierung der Drehzahlforderung" VALUE 0xD20DE Kw_Ws16 1281232. Volt_Batt -640625.6 640606.1 FORMAT "%8.1" /end CHARACTERISTIC
/begin CHARACTERISTIC ETClb_ctDflLrn_CA "Defaultwerte für die applikative Änderung der Lernzykluszähler der Ansteuerdauerkalibrierung für die ZFC" VAL_BLK 0xD213C Kwb_Wu16 65535.00 OneToOne 0.00 65535.00 FORMAT "%8.2" NUMBER 3 /end CHARACTERISTIC
/begin CHARACTERISTIC ETClb_ctLrnThres2_C "Anzahl Lernzyklen bis zur Freigabe der Ansteuerdauerkorrektur der Nullmengenkalibrierung im Zustand Rollen Schnelllernen" VALUE 0xD20E6 Kw_Wu16 65535.00 OneToOne 0.00 65535.00 FORMAT "%8.2" /end CHARACTERISTIC
/begin CHARACTERISTIC ETClb_ctLrnThresQck_C "Anzahl der Lernzyklen für die Freigabe der Ansteuerdauerkorrektur durch die Ansteurdauerkalibrierung bei Schnellkalibrierung" VALUE 0xD20E8 Kw_Wu16 65535.00 OneToOne 0.00 65535.00 FORMAT "%8.2" /end CHARACTERISTIC
/begin CHARACTERISTIC ETClb_ctLrnThres_C "Anzahl der Lernzyklen für die Freigabe der Ansteuerdauerkorrektur durch die Ansteurdauerkalibrierung" VALUE 0xD20EA Kw_Wu16 65535.00 OneToOne 0.00 65535.00 FORMAT "%8.2" /end CHARACTERISTIC
/begin CHARACTERISTIC ETClb_DebETFltMaxDefect_C "Entprellzeit der Defekterkennung der Überschreitung der maximalen gefilterten Ansteuerdauer von der Ansteuerdauerkalibrierung" VALUE 0xD2142 Kw_Wu16 0.00 OneToOne 1.000000 1.000000 FORMAT "%8.6" EXTENDED_LIMITS 0.00 65535.00 /end CHARACTERISTIC
/begin CHARACTERISTIC ETClb_DebETFltMaxOk_C "Entprellzeit der Intakterkennung der Überschreitung der maximalen gefilterten Ansteuerdauer von der Ansteuerdauerkalibrierung" VALUE 0xD2144 Kw_Wu16 0.00 OneToOne 0.00 0.00 FORMAT "%8.2" EXTENDED_LIMITS 0.00 65535.00 /end CHARACTERISTIC
/begin CHARACTERISTIC ETClb_DebETFltMinDefect_C "Entprellzeit der Defekterkennung der Unterschreitung der minimalen gefilterten Ansteuerdauer von der Ansteuerdauerkalibrierung" VALUE 0xD2146 Kw_Wu16 0.00 OneToOne 1.000000 1.000000 FORMAT "%8.6" EXTENDED_LIMITS 0.00 65535.00 /end CHARACTERISTIC
/begin CHARACTERISTIC ETClb_DebETFltMinOk_C "Entprellzeit der Intakterkennung der Unterschreitung der minimalen gefilterten Ansteuerdauer von der Ansteuerdauerkalibrierung" VALUE 0xD2148 Kw_Wu16 0.00 OneToOne 0.00 0.00 FORMAT "%8.2" EXTENDED_LIMITS 0.00 65535.00 /end CHARACTERISTIC
/begin CHARACTERISTIC ETClb_DebETMaxDefect_C "#SSD Entprellzeit der Defekterkennung der Überschreitung der maximalen Ansteuerdauer von der Ansteuerdauerkalibrierung" VALUE 0xD2120 Kw_Wu16 65535.00 OneToOne 0.00 65535.00 FORMAT "%8.2" /end CHARACTERISTIC
/begin CHARACTERISTIC ETClb_DebETMaxOk_C "#SSD Entprellzeit der Intakterkennung der Überschreitung der maximalen Ansteuerdauer von der Ansteuerdauerkalibrierung" VALUE 0xD2122 Kw_Wu16 65535.00 OneToOne 0.00 65535.00 FORMAT "%8.2" /end CHARACTERISTIC
/begin CHARACTERISTIC ETClb_DebETMinDefect_C "#SSD Entprellzeit der Defekterkennung der Unterschreitung der minimalen Ansteuerdauer von der Ansteuerdauerkalibrierung" VALUE 0xD2124 Kw_Wu16 65535.00 OneToOne 0.00 65535.00 FORMAT "%8.2" /end CHARACTERISTIC
/begin CHARACTERISTIC ETClb_DebETMinOk_C "#SSD Entprellzeit der Intakterkennung der Unterschreitung der minimalen Ansteuerdauer von der Ansteuerdauerkalibrierung" VALUE 0xD2126 Kw_Wu16 65535.00 OneToOne 0.00 65535.00 FORMAT "%8.2" /end CHARACTERISTIC
/begin CHARACTERISTIC ETClb_dpRailLim_CA "Raildruck-Kalibrierpunkt abhängige max. Abweichung des Raildrucks für die Nullmengenkalibrierung" VAL_BLK 0xD20EC Kwb_Ws16 2000.000 Pres_Rail 0.00 2000.000 FORMAT "%5.3" EXTENDED_LIMITS -3276.800 3276.700 NUMBER 3 /end CHARACTERISTIC
/begin CHARACTERISTIC ETClb_dtiDflETFlt0_CA "Defaultwerte für die gefilterte Ansteuerdauerdifferenz der Ansteuerdauerkalibrierung für den Raildruck-Kalibrierpunkt 0" VAL_BLK 0xD214A Kwb_Ws16 5200.000 InjTime_us -200.0000 5000.000 FORMAT "%8.3" EXTENDED_LIMITS -32768.00 32767.00 NUMBER 6 /end CHARACTERISTIC
/begin CHARACTERISTIC ETClb_dtiDflETFlt1_CA "Defaultwerte für die gefilterte Ansteuerdauerdifferenz der Ansteuerdauerkalibrierung für den Raildruck-Kalibrierpunkt 1" VAL_BLK 0xD2156 Kwb_Ws16 5200.000 InjTime_us -200.0000 5000.000 FORMAT "%8.3" EXTENDED_LIMITS -32768.00 32767.00 NUMBER 6 /end CHARACTERISTIC
/begin CHARACTERISTIC ETClb_dtiDflETFlt2_CA "Defaultwerte für die gefilterte Ansteuerdauerdifferenz der Ansteuerdauerkalibrierung für den Raildruck-Kalibrierpunkt 2" VAL_BLK 0xD2162 Kwb_Ws16 5200.000 InjTime_us -200.0000 5000.000 FORMAT "%8.3" EXTENDED_LIMITS -32768.00 32767.00 NUMBER 6 /end CHARACTERISTIC
/begin CHARACTERISTIC ETClb_facFlt2_C "Filterkonstante Ansteuerdauerkorrektur der Nullmengenkalibrierung im Zustand Rollen Schnelllernen" VALUE 0xD20F2 Kw_Wu16 1.000000 Fact 0.00 1.000000 FORMAT "%8.6" EXTENDED_LIMITS 0.00 7.999878 /end CHARACTERISTIC
/begin CHARACTERISTIC ETClb_facFltQck_C "Filterkonstante für die Ansteuerdauerdifferenz der Ansteuerdauerkalibrierung bei Schnellkalibrierung" VALUE 0xD20F4 Kw_Wu16 1.000000 Fact 0.00 1.000000 FORMAT "%8.6" EXTENDED_LIMITS 0.00 7.999878 /end CHARACTERISTIC
/begin CHARACTERISTIC ETClb_facFlt_C "Filterkonstante für die Ansteuerdauerdifferenz der Ansteuerdauerkalibrierung" VALUE 0xD20F6 Kw_Wu16 1.000000 Fact 0.00 1.000000 FORMAT "%8.6" EXTENDED_LIMITS 0.00 7.999878 /end CHARACTERISTIC
/begin CHARACTERISTIC ETClb_numCyclMeas_C "#SSD Anzahl der Einspritzzyklen für die Messung der Ansteuerdauerkalibrierung" VALUE 0xD20F8 Kw_Wu16 65535.00 OneToOne 0.00 65535.00 FORMAT "%8.2" /end CHARACTERISTIC
/begin CHARACTERISTIC ETClb_numCyclNoDyn_C "Anzahl der Einspritzzyklen bis die Ansteuerdauekalibrierung den maximalen Drehzahlanstieg prüft" VALUE 0xD20FA Kw_Wu16 65535.00 OneToOne 0.00 65535.00 FORMAT "%8.2" /end CHARACTERISTIC
/begin CHARACTERISTIC ETClb_numCyclStartEnergize_C "#SSD Anzahl der Einspritzzyklen bis die Ansteuerdauerkalibrierung für die Messung eingeschwungen ist" VALUE 0xD20FC Kw_Wu16 65535.00 OneToOne 0.00 65535.00 FORMAT "%8.2" /end CHARACTERISTIC
/begin CHARACTERISTIC ETClb_numDflCylCur_CA "Testwerte für die aktuellen Zylinder der Ansteuerdauerkalibrierung für jeden Raildruck-Kalibrierpunkt" VAL_BLK 0xD216E Kwb_Wu8 5.000 OneToOne 1.000 6.000 FORMAT "%5.3" EXTENDED_LIMITS 0.00 255.0 NUMBER 3 /end CHARACTERISTIC
/begin CHARACTERISTIC ETClb_pRailSet_CA "#SSD Raildruck-Kalibrierpunkte für die Ansteuerdauerkalibrierung" VAL_BLK 0xD20FE Kwb_Ws16 2000.000 Pres_Rail 0.00 2000.000 FORMAT "%5.3" EXTENDED_LIMITS -3276.800 3276.700 NUMBER 3 /end CHARACTERISTIC
/begin CHARACTERISTIC ETClb_SigThres_CA "#SSD Raildurck-Kalibrierpunkt abhänge Signalschwelle der Nullmengenkalibrierung" VAL_BLK 0xD2104 Kwb_Ws16 200.0000 OneToOne 0.00 200.0000 FORMAT "%8.4" EXTENDED_LIMITS -32768.00 32767.00 NUMBER 3 /end CHARACTERISTIC
/begin CHARACTERISTIC ETClb_swtCorActvVal_C "Applikativer Wert des SW-Schalters für die Ansteuerdauerkorrektur (0: Korrektur aus, 1: ein)" VALUE 0xD210A Kw_Wu8 1.000 OneToOne 0.00 1.000 FORMAT "%5.3" EXTENDED_LIMITS 0.00 255.0 /end CHARACTERISTIC
/begin CHARACTERISTIC ETClb_swtCorActvType_C "Typ des SW-Schalters für die Ansteuerdauerkorrektur der Nullmengenkalibrierung" VALUE 0xD210B Kw_Wu8 2.000 OneToOne 0.00 2.000 FORMAT "%5.3" EXTENDED_LIMITS 0.00 255.0 /end CHARACTERISTIC
/begin CHARACTERISTIC ETClb_swtDflQckClb_C "Testwert zum Umschalten auf Schnellkalibrierung der Ansteuerdauerkalibrierung" VALUE 0xD2171 Kw_Wu8 1.000 OneToOne 0.00 1.000 FORMAT "%5.3" EXTENDED_LIMITS 0.00 255.0 /end CHARACTERISTIC
/begin CHARACTERISTIC ETClb_swtWrDflVal_C "Aktivierung zum schreiben der Testwerte für die Ansteuerdauerkalibrierung bei Wechsel von 0 nach 1" VALUE 0xD210C Kw_Wu8 1.000 OneToOne 0.00 1.000 FORMAT "%5.3" EXTENDED_LIMITS 0.00 255.0 /end CHARACTERISTIC
/begin CHARACTERISTIC ETClb_tiDflETCur_CA "Testwert der aktuellen Ansteuerdauer für die Ansteuerdauerkalibrierung bei jedem Raildruck-Kalibrierpunkt" VAL_BLK 0xD2172 Kwb_Ws16 4850.000 InjTime_us 150.0000 5000.000 FORMAT "%8.3" EXTENDED_LIMITS -32768.00 32767.00 NUMBER 3 /end CHARACTERISTIC
/begin CHARACTERISTIC ETClb_tiDflInjInit_C "Defaultwert für die applikative Änderung des Ininitialisierungswerts des Injektor-Betriebsstundenzählers" VALUE 0xD2178 Kw_Wu32 4294967295.00 OneToOne 0.00 4294967295.00 FORMAT "%13.2" /end CHARACTERISTIC
/begin CHARACTERISTIC ETClb_tiETOfs_CA "Offset der max. gefilterten Ansteuerdauer zur max. Ansteuerdauer für jeden Raildruck-Kalibrierpunkt" VAL_BLK 0xD217C Kwb_Ws16 5000.0000 InjTime_us 0.00 5000.0000 FORMAT "%8.4" EXTENDED_LIMITS -32768.00 32767.00 NUMBER 3 /end CHARACTERISTIC
/begin CHARACTERISTIC ETClb_tiETStep_CA "Schrittweite der Ansteuerdauer für die Anhebung oder Senkung der Ansteuerdauer von der Ansteuerdauer-Kalibrierung" VAL_BLK 0xD2128 Kwb_Ws16 5000.000 InjTime_us 0.00 5000.000 FORMAT "%8.3" EXTENDED_LIMITS -32768.00 32767.00 NUMBER 3 /end CHARACTERISTIC
/begin CHARACTERISTIC ETClb_tiET_MAX_CA "#SSD Maximale Ansteuerdauer der Einspritzungen für die Ansteuerdauerkalibrierung für jeden Raildruck-Kalibirierpunkt" VAL_BLK 0xD212E Kwb_Ws16 32767.00 InjTime_us 0.00 32767.00 FORMAT "%8.2" EXTENDED_LIMITS -32768.00 32767.00 NUMBER 3 /end CHARACTERISTIC
/begin CHARACTERISTIC ETClb_tiET_MIN_CA "#SSD Minimale Ansteuerdauer der Einspritzungen für die Ansteuerdauerkalibrierung für jeden Raildruck-Kalibirierpunkt" VAL_BLK 0xD2134 Kwb_Ws16 32767.00 InjTime_us 0.00 32767.00 FORMAT "%8.2" EXTENDED_LIMITS -32768.00 32767.00 NUMBER 3 /end CHARACTERISTIC
/begin CHARACTERISTIC ETClb_volEffectiveMin_CA "#SSD Menge der Wirkgrenze für die Ansteuerdauerkalibrierung" VAL_BLK 0xD210E Kwb_Ws16 100.0000 InjQntInj 0.00 100.0000 FORMAT "%8.4" EXTENDED_LIMITS -327.6800 327.6700 NUMBER 3 /end CHARACTERISTIC
/begin CHARACTERISTIC ETClb_vStartClb_CA "Minimale Fahrzeuggeschwindigkeit zum Starten der Ansteuerdauerkalibrierung bei jedem Raildruck-Kalibrierpunkt" VAL_BLK 0xD2114 Kwb_Ws16 200.0000 Vel 0.00 200.0000 FORMAT "%8.4" EXTENDED_LIMITS -327.6800 327.6700 NUMBER 3 /end CHARACTERISTIC
/begin CHARACTERISTIC ETClb_vStopClb_CA "Minimale Fahrzeuggeschwindigkeit der Ansteuerdauerkalibrierung bei jedem Raildruck-Kalibrierpunkt" VAL_BLK 0xD211A Kwb_Ws16 200.0000 Vel 0.00 200.0000 FORMAT "%8.4" EXTENDED_LIMITS -327.6800 327.6700 NUMBER 3 /end CHARACTERISTIC
/begin CHARACTERISTIC FanCD_ctPwrStgOnMax_C "Maximaler Zähler für Powerstage On im Fehlerfall" VALUE 0xD2184 Kw_Wu16 65535.00 OneToOne 0.00 65535.00 FORMAT "%8.2" /end CHARACTERISTIC
/begin CHARACTERISTIC FanCD_DebExcTempDef_C "Fehlerentprellzeit für Fehler Übertemperatur" VALUE 0xD2186 Kw_Wu16 655350.0 Time_ms 0.00 655350.0 FORMAT "%8.1" /end CHARACTERISTIC
/begin CHARACTERISTIC FanCD_DebExcTempOk_C "Heilungsentprellzeit für Fehler Übertemperatur" VALUE 0xD2188 Kw_Wu16 655350.0 Time_ms 0.00 655350.0 FORMAT "%8.1" /end CHARACTERISTIC
/begin CHARACTERISTIC FanCD_tiDebDia1Def_C "Fehlerentprellzeit für Lüfter Diagnose erstes Zeitfenster" VALUE 0xD218A Kw_Wu16 655350.0 Time_ms 0.00 655350.0 FORMAT "%8.1" /end CHARACTERISTIC
/begin CHARACTERISTIC FanCD_tiDebDia1Ok_C "Fehlerheilzeit für Lüfter Diagnose erstes Zeitfenster" VALUE 0xD218C Kw_Wu16 655350.0 Time_ms 0.00 655350.0 FORMAT "%8.1" /end CHARACTERISTIC
/begin CHARACTERISTIC FanCD_tiDebDia2Def_C "Fehlerentprellzeit für Lüfter Diagnose zweites Zeitfenster" VALUE 0xD218E Kw_Wu16 655350.0 Time_ms 0.00 655350.0 FORMAT "%8.1" /end CHARACTERISTIC
/begin CHARACTERISTIC FanCD_tiDebDia2Ok_C "Fehlerheilzeit für Lüfter Diagnose zweites Zeitfenster" VALUE 0xD2190 Kw_Wu16 655350.0 Time_ms 0.00 655350.0 FORMAT "%8.1" /end CHARACTERISTIC
/begin CHARACTERISTIC FanCD_tiDebDia3Def_C "Fehlerentprellzeit für Lüfter Diagnose drittes Zeitfenster" VALUE 0xD2192 Kw_Wu16 655350.0 Time_ms 0.00 655350.0 FORMAT "%8.1" /end CHARACTERISTIC
/begin CHARACTERISTIC FanCD_tiDebDia3Ok_C "Fehlerheilzeit für Lüfter Diagnose drittes Zeitfenster" VALUE 0xD2194 Kw_Wu16 655350.0 Time_ms 0.00 655350.0 FORMAT "%8.1" /end CHARACTERISTIC
/begin CHARACTERISTIC FanCD_DebNoLoadDef_C "Defektentprellung für den Lastabfall des Lüfters" VALUE 0xD2196 Kw_Wu16 655350.0 Time_ms 0.00 655350.0 FORMAT "%8.1" /end CHARACTERISTIC
/begin CHARACTERISTIC FanCD_DebNoLoadOk_C "Heilungsentprellung für den Lastabfall des Lüfters" VALUE 0xD2198 Kw_Wu16 655350.0 Time_ms 0.00 655350.0 FORMAT "%8.1" /end CHARACTERISTIC
/begin CHARACTERISTIC FanCD_DebShortCircBatDef_C "Entprelldauer für Fehler Kurzschluss zur Batterie" VALUE 0xD219A Kw_Wu16 655350.0 Time_ms 0.00 655350.0 FORMAT "%8.1" /end CHARACTERISTIC
/begin CHARACTERISTIC FanCD_DebShortCircBatOk_C "Heilungsdauer für Fehler Kurzschluss zur Batterie" VALUE 0xD219C Kw_Wu16 655350.0 Time_ms 0.00 655350.0 FORMAT "%8.1" /end CHARACTERISTIC
/begin CHARACTERISTIC FanCD_DebShortCircGndDef_C "#SSD Entprelldauer für Fehler Kurzschluss zur Masse" VALUE 0xD219E Kw_Wu16 655350.0 Time_ms 0.00 655350.0 FORMAT "%8.1" /end CHARACTERISTIC
/begin CHARACTERISTIC FanCD_DebShortCircGndOk_C "Heilungsdauer für Fehler Kurzschluss zur Masse" VALUE 0xD21A0 Kw_Wu16 655350.0 Time_ms 0.00 655350.0 FORMAT "%8.1" /end CHARACTERISTIC
/begin CHARACTERISTIC FanCD_numDia_C "#SSD Applikationsparameter fuer Luefter Komponententreiber" VALUE 0xD21A2 Kw_Wu8 35.0000000000 NumPinDia 0.00 35.0000000000 FORMAT "%13.10" /end CHARACTERISTIC
/begin CHARACTERISTIC FanCD_numPwmOut_C "#SSD Applikationsparameter fuer Luefter" VALUE 0xD21A3 Kw_Wu8 13.0000000000 NumPinPwmOut 0.00 13.0000000000 FORMAT "%13.10" /end CHARACTERISTIC
/begin CHARACTERISTIC FanCD_stInvOut_C "Invertierungsparameter der PWM-Endstufe" VALUE 0xD21A4 Kw_Wu8 1.000 OneToOne 0.00 1.000 FORMAT "%5.3" EXTENDED_LIMITS 0.00 255.0 /end CHARACTERISTIC
/begin CHARACTERISTIC FanCD_stSPICtl_C "Schalter ob Endstufe SPI kontrollierbar = 1 oder nicht SPI kontrollierbar = 0" VALUE 0xD21A5 Kw_Wu8 1.000 OneToOne 0.00 1.000 FORMAT "%5.3" EXTENDED_LIMITS 0.00 255.0 /end CHARACTERISTIC
/begin CHARACTERISTIC FanCD_tiBtwTst_C "#SSD Zeitabstand, in dem im Fehlerfall die Endstufe getestet wird" VALUE 0xD21A6 Kw_Wu16 29980.00 Time_ms 20.00000 30000.00 FORMAT "%8.2" EXTENDED_LIMITS 0.00 655350.0 /end CHARACTERISTIC
/begin CHARACTERISTIC FanCD_tiFanCtlr1Max_C "Maximum des ersten Signalfensters für Fehlersignale des Lüfter-SG" VALUE 0xD21A8 Kw_Wu16 655350.0 Time_ms 0.00 655350.0 FORMAT "%8.1" /end CHARACTERISTIC
/begin CHARACTERISTIC FanCD_tiFanCtlr1Min_C "Minimum des ersten Signalfensters für Fehlersignale des Lüfter-SG" VALUE 0xD21AA Kw_Wu16 655350.0 Time_ms 0.00 655350.0 FORMAT "%8.1" /end CHARACTERISTIC
/begin CHARACTERISTIC FanCD_tiFanCtlr2Max_C "#SSD Maximum des zweiten Signalfensters für Fehlersignale des Lüfter-SG" VALUE 0xD21AC Kw_Wu16 655350.0 Time_ms 0.00 655350.0 FORMAT "%8.1" /end CHARACTERISTIC
/begin CHARACTERISTIC FanCD_tiFanCtlr2Min_C "#SSD Minimum des zweiten Signalfensters für Fehlersignale des Lüfter-SG" VALUE 0xD21AE Kw_Wu16 655350.0 Time_ms 0.00 655350.0 FORMAT "%8.1" /end CHARACTERISTIC
/begin CHARACTERISTIC FanCD_tiFanCtlr3Max_C "#SSD Maximum des dritten Signalfensters für Fehlersignale des Lüfter-SG" VALUE 0xD21B0 Kw_Wu16 655350.0 Time_ms 0.00 655350.0 FORMAT "%8.1" /end CHARACTERISTIC
/begin CHARACTERISTIC FanCD_tiFanCtlr3Min_C "#SSD Minimum des dritten Signalfensters für Fehlersignale des Lüfter-SG" VALUE 0xD21B2 Kw_Wu16 655350.0 Time_ms 0.00 655350.0 FORMAT "%8.1" /end CHARACTERISTIC
/begin CHARACTERISTIC FanCD_tiPwrStgOn_C "Zeit für welche die Endstufe im Fehlerfall eingeschalten wird (nur nicht SPI kontrolliert)" VALUE 0xD21B4 Kw_Wu16 655140.0 Time_ms 0.00 655140.0 FORMAT "%8.1" EXTENDED_LIMITS 0.00 655350.0 /end CHARACTERISTIC
/begin CHARACTERISTIC EngPrt_tiFWOscDetDebDef_C "Debounce time for fly wheel oscillation defect detection" VALUE 0xD1ADA Kw_Wu16 2000.000 TimeDeb 0.00 2000.000 FORMAT "%8.3" EXTENDED_LIMITS 0.00 655350.0 /end CHARACTERISTIC
/begin CHARACTERISTIC EngPrt_tiFWOscDetDebOk_C "Debounce time for fly wheel oscillation defect healing" VALUE 0xD1ADC Kw_Wu16 2000.000 TimeDeb 0.00 2000.000 FORMAT "%8.3" EXTENDED_LIMITS 0.00 655350.0 /end CHARACTERISTIC
/begin MEASUREMENT EGSys_AlpEGTube_mp "Wärmeübertragungskoeffizient zwischen Abgas und Abgasrohr" SWORD ThermalCoEff 1 100 -3276.800 3276.700 FORMAT "%8.3" ARRAY_SIZE 2 ECU_ADDRESS 0x8FEDB0 /end MEASUREMENT
/begin MEASUREMENT EGSys_AlpTubeEnv_mp "Wärmeübertragungskoeffizient zwischen Abgasrohr und Umgebung" SWORD ThermalCoEff 1 100 -3276.800 3276.700 FORMAT "%8.3" ARRAY_SIZE 2 ECU_ADDRESS 0x8FEDB4 /end MEASUREMENT
/begin MEASUREMENT EGSys_cndHtEGi_mp "Wärmeleitfähigkeit Abgas im Rohr" SWORD Fact 1 100 -4.000000 3.999878 FORMAT "%8.6" ARRAY_SIZE 2 ECU_ADDRESS 0x8FEDB8 /end MEASUREMENT
/begin MEASUREMENT EGSys_cndHtEGo_mp "Wärmeleitfähigkeit Luft ausserhalb des Rohres" SWORD Fact 1 100 -4.000000 3.999878 FORMAT "%8.6" ARRAY_SIZE 2 ECU_ADDRESS 0x8FEDBC /end MEASUREMENT
/begin MEASUREMENT EGSys_cpEGTrbn_mp "Spezifische Wärmekapazität Abgas in Turbine" SWORD SpecificHeat 1 100 -3.276800 3.276700 FORMAT "%8.6" ECU_ADDRESS 0x8FEDA4 /end MEASUREMENT
/begin MEASUREMENT EGSys_cpEGTube_mp "Spezifsche Wärmekapazität Abgas im Abgasrohr" SWORD SpecificHeat 1 100 -3.276800 3.276700 FORMAT "%8.6" ARRAY_SIZE 2 ECU_ADDRESS 0x8FEDC0 /end MEASUREMENT
/begin MEASUREMENT EGSys_dtTube_mp "Temperaturänderung Abgasrohr" SWORD Temp_Kelv_Sec 1 100 -327.6800 327.6700 FORMAT "%8.4" ARRAY_SIZE 2 ECU_ADDRESS 0x8FEDC4 /end MEASUREMENT
/begin MEASUREMENT EGSys_dwTubeIn_mp "Eintretender Wärmestrom Abgasrohr" SLONG Pwr1 1 100 -214748364.800 214748364.700 FORMAT "%13.3" ARRAY_SIZE 2 ECU_ADDRESS 0x8FEDC8 /end MEASUREMENT
/begin MEASUREMENT EGSys_dwTubeOut_mp "Austretender Wärmestrom Abgasrohr" SLONG Pwr1 1 100 -214748364.800 214748364.700 FORMAT "%13.3" ARRAY_SIZE 2 ECU_ADDRESS 0x8FEDD0 /end MEASUREMENT
/begin MEASUREMENT EGSys_dwTube_mp "Wärmeänderung Abgasrohr" SLONG Pwr1 1 100 -214748364.800 214748364.700 FORMAT "%13.3" ARRAY_SIZE 2 ECU_ADDRESS 0x8FEDD8 /end MEASUREMENT
/begin MEASUREMENT EGSys_etaChrg_mp "Gesamtwirkungsgrad Turbolader" SWORD Fact 1 100 -4.000000 3.999878 FORMAT "%8.6" ECU_ADDRESS 0x8FEDA6 /end MEASUREMENT
/begin MEASUREMENT EGSys_facPT1Chrg_mp "Variabler Faktor für thermische Zeitkonstante Lader" SWORD Fact_PT1 1 100 -256.0000 255.9922 FORMAT "%8.4" ECU_ADDRESS 0x8FEDA8 /end MEASUREMENT
/begin MEASUREMENT EGSys_NuTubeEnv_mp "Nusselt-Zahl Aussenumströmung Abgasrohr" SWORD OneToOne 1 100 -32768.00 32767.00 FORMAT "%8.2" ARRAY_SIZE 2 ECU_ADDRESS 0x8FEDE0 /end MEASUREMENT
/begin MEASUREMENT EGSys_NuTube_mp "Nusselt-Zahl im Abgasrohr" SWORD OneToOne 1 100 -32768.00 32767.00 FORMAT "%8.2" ARRAY_SIZE 2 ECU_ADDRESS 0x8FEDE4 /end MEASUREMENT
/begin MEASUREMENT EGSys_pwrCmpr_mp "Verdichterleistung" SWORD Pwr 1 100 -308831.1 308821.7 FORMAT "%8.1" ECU_ADDRESS 0x8FEDAA /end MEASUREMENT
/begin MEASUREMENT EGSys_ReTubeEnvInpCrv_mp "Messpunkt Eingangswert Kurve EGSys_NuTubeEnv_CUR" SWORD OneToOne 1 100 -32768.00 32767.00 FORMAT "%8.2" ECU_ADDRESS 0x8FEDE8 /end MEASUREMENT
/begin MEASUREMENT EGSys_ReTubeEnv_mp "Reynolds-Zahl Aussenumströmung Abgasrohr" SWORD OneToOne 1 100 -32768.00 32767.00 FORMAT "%8.2" ARRAY_SIZE 2 ECU_ADDRESS 0x8FEDEA /end MEASUREMENT
/begin MEASUREMENT EGSys_ReTubeInpCrv_mp "Messpunkt Eingang Kurve EGSys_NuTube_CUR" SWORD ReynoldsNum 1 100 -3276800. 3276700. FORMAT "%8.0" ECU_ADDRESS 0x8FEDEE /end MEASUREMENT
/begin MEASUREMENT EGSys_ReTube_mp "Reynolds-Zahl im Abgasrohr" SWORD ReynoldsNum 1 100 -3276800. 3276700. FORMAT "%8.0" ARRAY_SIZE 2 ECU_ADDRESS 0x8FEDF0 /end MEASUREMENT
/begin MEASUREMENT EGSys_rPresCmpr_mp "Verdichterdruckverhältnis" SWORD Fact 1 100 -4.000000 3.999878 FORMAT "%8.6" ECU_ADDRESS 0x8FEDAC /end MEASUREMENT
/begin MEASUREMENT EGSys_rTempClnt_mp "Verhältnis Motorübertemperatur Motorstart / -stop" SWORD Fact 1 100 -4.000000 3.999878 FORMAT "%8.6" ECU_ADDRESS 0x8FED90 /end MEASUREMENT
/begin MEASUREMENT EGSys_rTimeNSC_mp "Verhältnis Standzeit zu Halbwertszeit NSC" SWORD Fact1 1 100 -256.0000 255.9922 FORMAT "%8.4" ECU_ADDRESS 0x8FED92 /end MEASUREMENT
/begin MEASUREMENT EGSys_rTimeOxiCat_mp "Verhältnis Standzeit zu Halbwertszeit Oxidationskatalysator" SWORD Fact1 1 100 -256.0000 255.9922 FORMAT "%8.4" ECU_ADDRESS 0x8FED94 /end MEASUREMENT
/begin MEASUREMENT EGSys_rTimeTrb_mp "Verhältnis-Stillstand-Zeit / Halbzeit-Periode turbocharger" SWORD Fact1 1 100 -256.0000 255.9922 FORMAT "%8.4" ECU_ADDRESS 0x8FED96 /end MEASUREMENT
/begin MEASUREMENT EGSys_sqTube_mp "Oberfläche Abgasrohr" SWORD Area 1 100 -4.000000 3.999878 FORMAT "%8.6" ARRAY_SIZE 2 ECU_ADDRESS 0x8FEDF4 /end MEASUREMENT
/begin MEASUREMENT EGSys_tAvrgEGTrbn_mp "Mittlere Abgastemperatur in Turbine" SWORD Temp_Cels 1 100 -50.140 899.860 FORMAT "%8.3" ECU_ADDRESS 0x8FEDAE /end MEASUREMENT
/begin MEASUREMENT EGSys_tAvrgEGTube_mp "Mittlere Abgastemperatur im Abgasrohr" SWORD Temp_Cels 1 100 -50.140 899.860 FORMAT "%8.3" ARRAY_SIZE 2 ECU_ADDRESS 0x8FEDF8 /end MEASUREMENT
/begin MEASUREMENT EGSys_tDiffEGTube_mp "Temperaturdifferenz Abgas / Abgasrohr" SWORD TempDiff_Cels 1 100 -3276.800 3276.700 FORMAT "%8.3" ARRAY_SIZE 2 ECU_ADDRESS 0x8FEDFC /end MEASUREMENT
/begin MEASUREMENT EGSys_tDiffTubeEnv_mp "Temperaturdifferenz Abgasrohr / Umgebung" SWORD TempDiff_Cels 1 100 -3276.800 3276.700 FORMAT "%8.3" ARRAY_SIZE 2 ECU_ADDRESS 0x8FEE00 /end MEASUREMENT
/begin MEASUREMENT EGSys_tEGPstTrbn "Abgas-Temperatur nach Turbolader" SWORD Temp_Cels 1 100 -50.140 899.860 FORMAT "%8.3" ECU_ADDRESS 0x7F8C2A /end MEASUREMENT
/begin MEASUREMENT EGSys_tEGPstTube "Abgastemperatur am Abgasrohr-Auslass" SWORD Temp_Cels 1 100 -50.140 899.860 FORMAT "%8.3" ARRAY_SIZE 2 ECU_ADDRESS 0x7F91B8 /end MEASUREMENT
/begin MEASUREMENT EGSys_tExcClntStrtCs_mp "Motorübertemperatur bei Motorstart" SWORD TempDiff_Cels 1 100 -3276.800 3276.700 FORMAT "%8.3" ECU_ADDRESS 0x8FED98 /end MEASUREMENT
/begin MEASUREMENT EGSys_tiClg_mp "Abkühlzeit" ULONG Time_s 1 100 0.00 42949672.9500 FORMAT "%13.4" ECU_ADDRESS 0x8FED9C /end MEASUREMENT
/begin MEASUREMENT EGSys_tiRefClg_mp "Referenz-Abkühlzeit aus Motor-Abkühlung" ULONG Time_s 1 100 0.00 42949672.9500 FORMAT "%13.4" ECU_ADDRESS 0x8FEDA0 /end MEASUREMENT
/begin MEASUREMENT EGSys_tMidEGTube_mp "Mittlere Temperatur zwischen Abgas und Abgasrohrwand" SWORD Temp_Cels 1 100 -50.140 899.860 FORMAT "%8.3" ARRAY_SIZE 2 ECU_ADDRESS 0x8FEE04 /end MEASUREMENT
/begin MEASUREMENT EGSys_tMidTubeEnv_mp "Mittlere Temperatur zwischen Abgasrohr und Umgebung" SWORD Temp_Cels 1 100 -50.140 899.860 FORMAT "%8.3" ARRAY_SIZE 2 ECU_ADDRESS 0x8FEE08 /end MEASUREMENT
/begin MEASUREMENT EGSys_tTube "Wandtemperatur Abgasrohr" SWORD Temp_Cels 1 100 -50.140 899.860 FORMAT "%8.3" ARRAY_SIZE 2 ECU_ADDRESS 0x7F91BC /end MEASUREMENT
/begin MEASUREMENT EGT_facRmpVal "Zentraler Rampenwert (drehzahlsynchron)" SWORD EGTSwt_S16 1 100 -2.000000 1.999939 FORMAT "%8.6" ECU_ADDRESS 0x7F8C3A /end MEASUREMENT
/begin MEASUREMENT EGT_facRmpValTempGvnr_mp "aktueller Rampenwert des EGT Temperaturreglers" ULONG EGTSwt 1 100 0.00 262.143999939 FORMAT "%13.9" ECU_ADDRESS 0x8FEE48 /end MEASUREMENT
/begin MEASUREMENT EGT_facRmp_mp "Rampenwert für Umwandlung 32bit -> 16bit" SWORD EGTSwt_S16 1 100 -2.000000 1.999939 FORMAT "%8.6" ECU_ADDRESS 0x8FEE4C /end MEASUREMENT
/begin MEASUREMENT EGT_mAirDesInrTempGvnr "Additive Luftmassensollwertkorrektur" SWORD AirMassPerCyl 1 100 -3276.800 3276.700 FORMAT "%8.3" ECU_ADDRESS 0x7F8C3C /end MEASUREMENT
/begin MEASUREMENT EGT_mAirDesTempGvnr "Temperaturreglerkorrektur für den Luftmassensollwert" SWORD AirMassPerCyl 1 100 -3276.800 3276.700 FORMAT "%8.3" ECU_ADDRESS 0x7F8C3E /end MEASUREMENT
/begin MEASUREMENT EGT_mAirLmbdTempGvnr_mp "Luftmassenkorrektur durch Lambda" SWORD AirMassPerCyl 1 100 -3276.800 3276.700 FORMAT "%8.3" ECU_ADDRESS 0x8FEE4E /end MEASUREMENT
/begin MEASUREMENT EGT_mAirTempGvnrMin_mp "Minimal mögliche Luftmassensollwertkorrektur" SWORD AirMassPerCyl 1 100 -3276.800 3276.700 FORMAT "%8.3" ECU_ADDRESS 0x8FEE1C /end MEASUREMENT
/begin MEASUREMENT EGT_mAirTempGvnrRng_mp "Korrekturbereich der Luftmassensollwertkorrektur" SWORD AirMassPerCyl 1 100 -3276.800 3276.700 FORMAT "%8.3" ECU_ADDRESS 0x8FEE1E /end MEASUREMENT
/begin MEASUREMENT EGT_phiPoI1TempGvnr "Additive Winkelkorrektur der verzögerten Nacheinspritzung" SWORD AngleCrS 1 100 -768.0000 767.9766 FORMAT "%8.4" ECU_ADDRESS 0x7F8C40 /end MEASUREMENT
/begin MEASUREMENT EGT_qHCTempGvnr "Additive Einpritzmengenkorrektur des HC-Dosierventils" SWORD InjMassInj 1 100 -327.6800 327.6700 FORMAT "%8.4" ECU_ADDRESS 0x7F8C42 /end MEASUREMENT
/begin MEASUREMENT EGT_qPoI1Min_mp "Minimal erlaubte Korrektur der angelagerten Nacheinspritzung" SWORD InjMassInj 1 100 -327.6800 327.6700 FORMAT "%8.4" ECU_ADDRESS 0x8FEE20 /end MEASUREMENT
/begin MEASUREMENT EGT_qPoI1OutrTempGvnr "Additive Korrektur der angelagerten Nacheinspritzung" SWORD InjMassInj 1 100 -327.6800 327.6700 FORMAT "%8.4" ECU_ADDRESS 0x7F8C44 /end MEASUREMENT
/begin MEASUREMENT EGT_qPoI1Rng_mp "Korrekturbereich der angelagerten Nacheinspritzung" SWORD InjMassInj 1 100 -327.6800 327.6700 FORMAT "%8.4" ECU_ADDRESS 0x8FEE22 /end MEASUREMENT
/begin MEASUREMENT EGT_qPoI1TempGvnr "EGT Temperaturregler PoI1 Menge während einer Regeneration" SWORD InjMassInj 1 100 -327.6800 327.6700 FORMAT "%8.4" ECU_ADDRESS 0x7F8C46 /end MEASUREMENT
/begin MEASUREMENT EGT_qPoI2InrTempGvnr "Additive fortgeschrittene Nacheinspritzmengenkorrektur" SWORD InjMassInj 1 100 -327.6800 327.6700 FORMAT "%8.4" ECU_ADDRESS 0x7F8C48 /end MEASUREMENT
/begin MEASUREMENT EGT_qPoI2Min_mp "Minimal erlaubte Korrekturmenge der angelagerten Nacheinspritzung" SWORD InjMassInj 1 100 -327.6800 327.6700 FORMAT "%8.4" ECU_ADDRESS 0x8FEE24 /end MEASUREMENT
/begin MEASUREMENT EGT_qPoI2Rng_mp "Korrekturbereich der Einpritzmengenkorrektur" SWORD InjMassInj 1 100 -327.6800 327.6700 FORMAT "%8.4" ECU_ADDRESS 0x8FEE26 /end MEASUREMENT
/begin MEASUREMENT EGT_qPoI2TempGvnr "EGT Temperaturreglerkorrektur der angelagerten Nacheinspritzung 2 während einer Partikelfilterregeneration" SWORD InjMassInj 1 100 -327.6800 327.6700 FORMAT "%8.4" ECU_ADDRESS 0x7F8C4A /end MEASUREMENT
/begin MEASUREMENT EGT_rIInrTempGvnr_mp "Reglerausgang des inneren Regelkreises: I-Anteil" SWORD EGTFact 1 100 -32.76800 32.76700 FORMAT "%8.5" ECU_ADDRESS 0x8FEE28 /end MEASUREMENT
/begin MEASUREMENT EGT_rInrTempGvnr_mp "Reglerausgang des inneren Regelkreises" SWORD EGTFact 1 100 -32.76800 32.76700 FORMAT "%8.5" ECU_ADDRESS 0x8FEE2A /end MEASUREMENT
/begin MEASUREMENT EGT_rIOutrTempGvnr_mp "Reglerausgang der äußeren Regelkreises: I-Anteil" SWORD EGTFact 1 100 -32.76800 32.76700 FORMAT "%8.5" ECU_ADDRESS 0x8FEE2C /end MEASUREMENT
/begin MEASUREMENT EGT_rOutrTempGvnr_mp "Regelerausgang des äußeren Regelkreises" SWORD EGTFact 1 100 -32.76800 32.76700 FORMAT "%8.5" ECU_ADDRESS 0x8FEE2E /end MEASUREMENT
/begin MEASUREMENT EGT_rPInrTempGvnr_mp "Regelerausgnag des inneren Regelkreises: P-Anteil" SWORD EGTFact 1 100 -32.76800 32.76700 FORMAT "%8.5" ECU_ADDRESS 0x8FEE30 /end MEASUREMENT
/begin MEASUREMENT EGT_rPOutrTempGvnr_mp "Reglerausgang des äußeren Regelkreises: P-Anteil" SWORD EGTFact 1 100 -32.76800 32.76700 FORMAT "%8.5" ECU_ADDRESS 0x8FEE32 /end MEASUREMENT
/begin MEASUREMENT EGT_rStyInrTempGvnr_mp "Modellierten stationärer Reglerausgang des inneren Regelkreises" SWORD EGTFact 1 100 -32.76800 32.76700 FORMAT "%8.5" ECU_ADDRESS 0x8FEE34 /end MEASUREMENT
/begin MEASUREMENT EGT_rStyOutrTempGvnr_mp "Modellierter stationärer Reglerausgang des äußeren Regelkreises" SWORD EGTFact 1 100 -32.76800 32.76700 FORMAT "%8.5" ECU_ADDRESS 0x8FEE36 /end MEASUREMENT
/begin MEASUREMENT EGT_st "Regenerationsanforderung für Abgasnachbehandlung (drehzahlsynchron)" ULONG OneToOne 1 100 0.00 4294967295.00 FORMAT "%13.2" ECU_ADDRESS 0x7F91C4 /end MEASUREMENT
/begin MEASUREMENT EGT_stClsThrVlv_mp "Maximale Androsselung aktiv" UBYTE OneToOne 1 100 0.00 255.0 FORMAT "%5.1" ECU_ADDRESS 0x8FEE38 /end MEASUREMENT
/begin MEASUREMENT EGT_stCoRgn "Innerer Zustand des Regenerationskoordinator (drehzahlsynchron)" UBYTE OneToOne 1 100 0.00 255.0 FORMAT "%5.1" ECU_ADDRESS 0x7F8860 /end MEASUREMENT
/begin MEASUREMENT EGT_stCoRgnOld_mp "Alter Wert für den inneren Zustand des Regenerationkoordinators" UBYTE OneToOne 1 100 0.00 255.0 FORMAT "%5.1" ECU_ADDRESS 0x8FEE0C /end MEASUREMENT
/begin MEASUREMENT EGT_stCoRgnTSync "Innerer Zustand des Regenerationskoordinator (zeitsynchron)" UBYTE OneToOne 1 100 0.00 255.0 FORMAT "%5.1" ECU_ADDRESS 0x7F8861 /end MEASUREMENT
/begin MEASUREMENT EGT_stDel "Verzögerte Regenerationsanforderung für Abgasnachbehandlung (drehzahl synchron)" UBYTE OneToOne 1 100 0.00 255.0 FORMAT "%5.1" ECU_ADDRESS 0x7F91C8 /end MEASUREMENT
/begin MEASUREMENT EGT_stLck "Status EGT_stTSync-Kopiervorgang (drehzahlsynchron)" UBYTE OneToOne 1 100 0.00 255.0 FORMAT "%5.1" ECU_ADDRESS 0x7F8862 /end MEASUREMENT
/begin MEASUREMENT EGT_stRgnOilDil_mp "Status Bit Bedingungen erfüllt für Ölverdünnung" UBYTE OneToOne 1 100 0.00 255.0 FORMAT "%5.1" ECU_ADDRESS 0x8FEE0D /end MEASUREMENT
/begin MEASUREMENT EGT_stTempGvnr "Status des Abgastemperaturreglers" UWORD OneToOne 1 100 0.00 65535.00 FORMAT "%8.2" ECU_ADDRESS 0x7F8C4C /end MEASUREMENT
/begin MEASUREMENT EGT_stTSync "Regenerationsanforderung für Abgasnachbehandlung (zeitsynchron)" ULONG OneToOne 1 100 0.00 4294967295.00 FORMAT "%13.2" ECU_ADDRESS 0x7F91CC /end MEASUREMENT
/begin MEASUREMENT EGT_stTSyncDes_mp "Regeneration demand for exhaust gas treatment for state machine" ULONG OneToOne 1 100 0.00 4294967295.00 FORMAT "%13.2" ECU_ADDRESS 0x8FEE10 /end MEASUREMENT
/begin MEASUREMENT EGT_stTSyncLck "Status Kopieren der Regenerationsanforderung (zeit-synchron)" UBYTE OneToOne 1 100 0.00 255.0 FORMAT "%5.1" ECU_ADDRESS 0x7F8863 /end MEASUREMENT
/begin MEASUREMENT EGT_swtRgnLck_mp "Schalter zur Unterdrückung der Regenerationsmaßnahmen" UBYTE OneToOne 1 100 0.00 255.0 FORMAT "%5.1" ECU_ADDRESS 0x8FEE14 /end MEASUREMENT
/begin MEASUREMENT EGT_tInrCorMax_mp "Maximal erlaubte Korrektur des inneren Regelkreises" SWORD TempDiff_Cels 1 100 -3276.800 3276.700 FORMAT "%8.3" ECU_ADDRESS 0x8FEE3A /end MEASUREMENT
/begin MEASUREMENT EGT_tInrCorRng_mp "Korrekturbereich der Sollwertkorrektur des inneren Regelkreises" SWORD TempDiff_Cels 1 100 -3276.800 3276.700 FORMAT "%8.3" ECU_ADDRESS 0x8FEE3C /end MEASUREMENT
/begin MEASUREMENT EGT_tInrDesCorTempGvnr "Solllwertkorrektur der inneren Kaskade" SWORD TempDiff_Cels 1 100 -3276.800 3276.700 FORMAT "%8.3" ECU_ADDRESS 0x7F8C52 /end MEASUREMENT
/begin MEASUREMENT EGT_tInrDesTempGvnr "Sollwert für den inneren Abgastemperaturregelkreis" SWORD Temp_Cels 1 100 -50.140 899.860 FORMAT "%8.3" ECU_ADDRESS 0x7F8C56 /end MEASUREMENT
/begin MEASUREMENT EGT_tInrDvtTempGvnr_mp "Reglerabweichung des inneren Regelkreises" SWORD TempDiff_Cels 1 100 -3276.800 3276.700 FORMAT "%8.3" ECU_ADDRESS 0x8FEE3E /end MEASUREMENT
/begin MEASUREMENT EGT_tInrTempGvnr "Aktueller Wert des inneren Abgastemperaturreglers" SWORD Temp_Cels 1 100 -50.140 899.860 FORMAT "%8.3" ECU_ADDRESS 0x7F8C58 /end MEASUREMENT
/begin MEASUREMENT EGT_tiPoI1ActvCnt_mp "Wartezeit aktive PoI1" ULONG Time_s 1 100 0.00 42949672.9500 FORMAT "%13.4" ECU_ADDRESS 0x8FEE40 /end MEASUREMENT
/begin MEASUREMENT EGT_tiPoI2TempGvnr "Additive Einspritzzeitkorrektur" SWORD InjTime_us 1 100 -32768.00 32767.00 FORMAT "%8.2" ECU_ADDRESS 0x7F8C60 /end MEASUREMENT
/begin MEASUREMENT EGT_tiRgn "Zeit seit letzter Änderung von EGT_st (drehzahlsynchron)" ULONG Time_s 1 100 0.00 42949672.9500 FORMAT "%13.4" ECU_ADDRESS 0x7F91D0 /end MEASUREMENT
/begin MEASUREMENT EGT_tiRgnOilDil "Kritische Zeit für Ölverdünnung" ULONG Time_s 1 100 0.00 42949672.9500 FORMAT "%13.4" ECU_ADDRESS 0x7F91D4 /end MEASUREMENT
/begin MEASUREMENT EGT_tiRgnTSync "Zeit seit letzter Änderung von EGT_st (zeitsynchron)" ULONG Time_s 1 100 0.00 42949672.9500 FORMAT "%13.4" ECU_ADDRESS 0x7F91D8 /end MEASUREMENT
/begin MEASUREMENT EGT_tiRgnTSyncPre_mp "Gesamtzeit seit letzter EGT-Statusänderung" ULONG Time_s 1 100 0.00 42949672.9500 FORMAT "%13.4" ECU_ADDRESS 0x8FEE18 /end MEASUREMENT
/begin MEASUREMENT EGT_tiRmpSlpMax "Maximale Rampenlaufzeit für EGT-Mehrfachschalter" ULONG TimeEGTRmp 1 100 0.000000015258789066052715 65.536000000000001 FORMAT "%19.16" ECU_ADDRESS 0x7F91DC /end MEASUREMENT
/begin MEASUREMENT EGT_tOutrDesTempGvnr "Sollwert des äußeren Abgastemperaturregelkreises" SWORD Temp_Cels 1 100 -50.140 899.860 FORMAT "%8.3" ECU_ADDRESS 0x7F8C5C /end MEASUREMENT
/begin MEASUREMENT EGT_tOutrDvtTempGvnr_mp "Reglerabweichung des äußeren Regelkreises" SWORD TempDiff_Cels 1 100 -3276.800 3276.700 FORMAT "%8.3" ECU_ADDRESS 0x8FEE44 /end MEASUREMENT
/begin MEASUREMENT EGT_tOutrTempGvnr "Aktueller Wert des äußeren Abgastemperaturregelkreises" SWORD Temp_Cels 1 100 -50.140 899.860 FORMAT "%8.3" ECU_ADDRESS 0x7F8C5E /end MEASUREMENT
/begin MEASUREMENT EMCCD_dcycCurrOff1_mp "Ausgang des Tastverhältnisses bei Strom AUS der EMCCD1-PWM-Endstufe bei der Strom-Regellogik" SWORD DtyCyc 1 100 -327.6800 327.6700 FORMAT "%8.4" ECU_ADDRESS 0x8FEE50 /end MEASUREMENT
/begin MEASUREMENT EMCCD_dcycCurrOff2_mp "Ausgang des Tastverhältnisses bei Strom AUS der EMCCD2-PWM-Endstufe bei der Strom-Regellogik" SWORD DtyCyc 1 100 -327.6800 327.6700 FORMAT "%8.4" ECU_ADDRESS 0x8FEE52 /end MEASUREMENT
/begin MEASUREMENT EMCCD_dcycCurrOn1_mp "Ausgang des Tastverhältnisses bei Strom EIN der EMCCD1-PWM-Endstufe bei der Strom-Regellogik" SWORD DtyCyc 1 100 -327.6800 327.6700 FORMAT "%8.4" ECU_ADDRESS 0x8FEE54 /end MEASUREMENT
/begin MEASUREMENT EMCCD_dcycCurrOn2_mp "Ausgang des Tastverhältnisses bei Strom EIN der EMCCD2-PWM-Endstufe bei der Strom-Regellogik" SWORD DtyCyc 1 100 -327.6800 327.6700 FORMAT "%8.4" ECU_ADDRESS 0x8FEE56 /end MEASUREMENT
/begin MEASUREMENT EMCCD_dcycMntCtlOut1_mp "Ausgang des Tastverhältnisses nach Begrenzung der EMCCD1-PWM-Endstufe bei der Strom-Regellogik" SWORD DtyCyc 1 100 -327.6800 327.6700 FORMAT "%8.4" ECU_ADDRESS 0x8FEE58 /end MEASUREMENT
/begin MEASUREMENT EMCCD_dcycMntCtlOut2_mp "Ausgang des Tastverhältnisses nach Begrenzung der EMCCD2-PWM-Endstufe bei der Strom-Regellogik" SWORD DtyCyc 1 100 -327.6800 327.6700 FORMAT "%8.4" ECU_ADDRESS 0x8FEE5A /end MEASUREMENT
/begin MEASUREMENT EMCCD_dcycOut1_mp "Ausgang des Tastverhältnisses ohne Begrenzung der EMCCD1-PWM-Endstufe bei der Strom-Regellogik" SWORD DtyCyc 1 100 -327.6800 327.6700 FORMAT "%8.4" ECU_ADDRESS 0x8FEE5C /end MEASUREMENT
/begin MEASUREMENT EMCCD_dcycOut2_mp "Ausgang des Tastverhältnisses ohne Begrenzung der EMCCD2-PWM-Endstufe bei der Strom-Regellogik" SWORD DtyCyc 1 100 -327.6800 327.6700 FORMAT "%8.4" ECU_ADDRESS 0x8FEE5E /end MEASUREMENT
/begin MEASUREMENT EMCCD_iActVal1 "An EMCCD1-PWM-Endstufe gemessener Strom bei der Strom-Regellogik" SWORD Curr 1 100 -32768.00 32767.00 FORMAT "%8.2" ECU_ADDRESS 0x7F8C62 /end MEASUREMENT
/begin MEASUREMENT EMCCD_iActVal2 "An EMCCD2-PWM-Endstufe gemessener Strom bei der Strom-Regellogik" SWORD Curr 1 100 -32768.00 32767.00 FORMAT "%8.2" ECU_ADDRESS 0x7F8C64 /end MEASUREMENT
/begin MEASUREMENT EMCCD_iActValFlt1_mp "An EMCCD1-PWM-Endstufe gemessener gefilterter Strom bei der Strom-Regellogik" SWORD Curr 1 100 -32768.00 32767.00 FORMAT "%8.2" ECU_ADDRESS 0x8FEE60 /end MEASUREMENT
/begin MEASUREMENT EMCCD_iActValFlt2_mp "An EMCCD2-PWM-Endstufe gemessener gefilterter Strom bei der Strom-Regellogik" SWORD Curr 1 100 -32768.00 32767.00 FORMAT "%8.2" ECU_ADDRESS 0x8FEE62 /end MEASUREMENT
/begin MEASUREMENT EMCCD_resAct1 "Widerstand bei der EMCCD1-PWM-Endstufe bei der Strom-Regellogik" SWORD Resist 1 100 -3276.800 3276.700 FORMAT "%8.3" ECU_ADDRESS 0x7F8C66 /end MEASUREMENT
/begin MEASUREMENT EMCCD_resAct2 "An EMCCD2-PWM-Endstufe gemessener Strom bei der Strom-Regellogik" SWORD Resist 1 100 -3276.800 3276.700 FORMAT "%8.3" ECU_ADDRESS 0x7F8C68 /end MEASUREMENT
/begin MEASUREMENT EMCCD_rHWE1_mp "Ausgang des Tastverhälnisses der EMCCD1-PWD-Endstufe" SWORD DtyCyc 1 100 -327.6800 327.6700 FORMAT "%8.4" ECU_ADDRESS 0x8FEE64 /end MEASUREMENT
/begin MEASUREMENT EMCCD_rHWE2_mp "Ausgang des Tastverhälnisses der EMCCD2-PWD-Endstufe" SWORD DtyCyc 1 100 -327.6800 327.6700 FORMAT "%8.4" ECU_ADDRESS 0x8FEE66 /end MEASUREMENT
/begin MEASUREMENT EMCCD_stOut_mp "Feststellung, ob im Start- oder Haltestromzustand" UBYTE OneToOne 1 100 0.00 255.0 FORMAT "%5.1" ECU_ADDRESS 0x8FEE68 /end MEASUREMENT
/begin MEASUREMENT EMCCD_uRawActVal1_mp "Bei der EMCCD1-PWM-Endstufe gemessener Spannungsrohwert bei Strom-Regellogik" SWORD Volt 1 100 -160156.4 160151.5 FORMAT "%8.1" ECU_ADDRESS 0x8FEE6A /end MEASUREMENT
/begin MEASUREMENT EMCCD_uRawActVal2_mp "Bei der EMCCD2-PWM-Endstufe gemessener Spannungsrohwert bei Strom-Regellogik" SWORD Volt 1 100 -160156.4 160151.5 FORMAT "%8.1" ECU_ADDRESS 0x8FEE6C /end MEASUREMENT
/begin MEASUREMENT EngMon_stShOffIrrCmb "Abschaltbotschaft an Abschaltkoordinator auf Grund irregulärer Verbrennung" UBYTE OneToOne 1 100 0.00 255.0 FORMAT "%5.1" ECU_ADDRESS 0x7F8877 /end MEASUREMENT
/begin MEASUREMENT EngM_ctIncErrSigDiagCaSDef_mp "Inkrementezaehlerstand zur Erkennung gestörtes Nockenwellensignal" UWORD OneToOne 1 100 0.00 65535.00 FORMAT "%8.2" ECU_ADDRESS 0x8FEE84 /end MEASUREMENT
/begin MEASUREMENT EngM_ctIncErrSigDiagCaSOk_mp "Inkrementezaehlerstand zur Erkennung gestörtes Nockenwellensignal geheilt" UWORD OneToOne 1 100 0.00 65535.00 FORMAT "%8.2" ECU_ADDRESS 0x8FEE86 /end MEASUREMENT
/begin MEASUREMENT EngM_ctIncErrSigDiagCrSDef_mp "Inkrementezaehlerstand zur Erkennung eines gestörten Kurbelwellensignal" UWORD OneToOne 1 100 0.00 65535.00 FORMAT "%8.2" ECU_ADDRESS 0x8FEE88 /end MEASUREMENT
/begin MEASUREMENT EngM_ctIncErrSigDiagCrSOK_mp "Inkrementezaehlerstand zur Erkennung Kurbelwellensignal ohne Störungen" UWORD OneToOne 1 100 0.00 65535.00 FORMAT "%8.2" ECU_ADDRESS 0x8FEE8A /end MEASUREMENT
/begin MEASUREMENT EngM_ctIncErrSigDiagmaxCaSDef_mp "maximaler Inkrementezaehlerstand bei Erkennung gestörtes Nockenwellensignal" UWORD OneToOne 1 100 0.00 65535.00 FORMAT "%8.2" ECU_ADDRESS 0x8FEE8C /end MEASUREMENT
/begin MEASUREMENT EngM_ctIncErrSigDiagmaxCaSOk_mp "maximaler Inkrementezaehlerstand bei Erkennung gestörtes Nockenwellensignal geheilt" UWORD OneToOne 1 100 0.00 65535.00 FORMAT "%8.2" ECU_ADDRESS 0x8FEE8E /end MEASUREMENT
/begin MEASUREMENT EngM_ctIncErrSigDiagmaxCrSDef_mp "maximeler Inkrementezaehlerstand bei Erkennung gestörtes Kurbelwellensignal" UWORD OneToOne 1 100 0.00 65535.00 FORMAT "%8.2" ECU_ADDRESS 0x8FEE90 /end MEASUREMENT
/begin MEASUREMENT EngM_ctIncNoSigDiagCaS_mp "Inkrementezaehlerstand zur Erkennung ausgefallenes Nockenwellensignal" UWORD OneToOne 1 100 0.00 65535.00 FORMAT "%8.2" ECU_ADDRESS 0x8FEE92 /end MEASUREMENT
/begin MEASUREMENT EngM_ctIncNoSigDiagmaxCaS_mp "maximaler Inkrementezaehlerstand bei Erkennung ausgefallenes Nockenwellensignal" UWORD OneToOne 1 100 0.00 65535.00 FORMAT "%8.2" ECU_ADDRESS 0x8FEE94 /end MEASUREMENT
/begin MEASUREMENT EngM_ctIntOvrLoad_mp "Anzahl der statischen Interrupts, bei denen der zeitliche Abstand zu kurz ist" UBYTE OneToOne 1 100 0.00 255.0 FORMAT "%5.1" ECU_ADDRESS 0x8FEE6F /end MEASUREMENT
/begin MEASUREMENT EngM_ctPhErrSigDiagCrSDef_mp "Anzahl Nockenwellenzaehne zur Erkennung eines gestörten Kurbelwellensignal" UWORD OneToOne 1 100 0.00 65535.00 FORMAT "%8.2" ECU_ADDRESS 0x8FEE96 /end MEASUREMENT
/begin MEASUREMENT EngM_ctPhErrSigDiagmaxCrSDef_mp "maximale Anzahl Nockenwellenzaehne bei Erkennung ausgefallenes Kurbelwellensignal" UWORD OneToOne 1 100 0.00 65535.00 FORMAT "%8.2" ECU_ADDRESS 0x8FEE98 /end MEASUREMENT
/begin MEASUREMENT EngM_ctPostSync_mp "Interruptzähler im State EngM_stSync = 64 (Post-Synchron)" UBYTE OneToOne 1 100 0.00 255.0 FORMAT "%5.1" ECU_ADDRESS 0x8FEE70 /end MEASUREMENT
/begin MEASUREMENT EngM_ctReSync_mp "Resynchronisationszähler, wird bei jeder Resynchronisation inkrementiert" UBYTE OneToOne 1 100 0.00 255.0 FORMAT "%5.1" ECU_ADDRESS 0x8FEE71 /end MEASUREMENT
/begin MEASUREMENT EngM_ctSpdtoZero_mp "Zähler Timeoutinterrupts bis Motordrehzahl  = Null" ULONG OneToOne 1 100 0.00 4294967295.00 FORMAT "%13.2" ECU_ADDRESS 0x8FEE9C /end MEASUREMENT
/begin MEASUREMENT EngM_ctVerSync_mp "Verif.zähler der Sync; Anzahl der MAIN, PILOT, UPDATE, SEGMENT Interrupts zur Plaus. der NW mit der KW" UBYTE OneToOne 1 100 0.00 255.0 FORMAT "%5.1" ECU_ADDRESS 0x8FEE72 /end MEASUREMENT
/begin MEASUREMENT EngM_nAvrgHysHigh_mp "engine speed hysteresis higher limit" SWORD EngN 1 100 -32768.00 32767.00 FORMAT "%8.2" ECU_ADDRESS 0x8FEEA0 /end MEASUREMENT
/begin MEASUREMENT EngM_nAvrgHysLow_mp "engine speed hysteresis lower limit" SWORD EngN 1 100 -32768.00 32767.00 FORMAT "%8.2" ECU_ADDRESS 0x8FEEA2 /end MEASUREMENT
/begin MEASUREMENT EngM_nDyn "dynamische Drehzahl" SWORD EngN 1 100 -32768.00 32767.00 FORMAT "%8.2" ECU_ADDRESS 0x7F8C78 /end MEASUREMENT
/begin MEASUREMENT EngM_nLISetDiff_mp "Betrag Leerlaufreglerabweichung" SWORD EngN 1 100 -32768.00 32767.00 FORMAT "%8.2" ECU_ADDRESS 0x8FEEB2 /end MEASUREMENT
/begin MEASUREMENT EngM_numCyl "Zylinderanzahl" UBYTE OneToOne 1 100 0.00 255.0 FORMAT "%5.1" ECU_ADDRESS 0x7F8866 /end MEASUREMENT
/begin MEASUREMENT EngM_numInt "Interreupt-Klasse" UBYTE OneToOne 1 100 0.00 255.0 FORMAT "%5.1" ECU_ADDRESS 0x7F8868 /end MEASUREMENT
/begin MEASUREMENT EngM_numLastTDC "Vorhergehender Zünd-OT" UBYTE OneToOne 1 100 0.00 255.0 FORMAT "%5.1" ECU_ADDRESS 0x7F8869 /end MEASUREMENT
/begin MEASUREMENT EngM_numRevCnt_mp "Zähler der Kurbelwellenumdrehungen" UWORD OneToOne 1 100 0.00 65535.00 FORMAT "%8.2" ECU_ADDRESS 0x8FEE74 /end MEASUREMENT
/begin MEASUREMENT EngM_numSyncTDC "Zylindernummer an dem die Synchronisation erkannt wurde" UBYTE OneToOne 1 100 0.00 255.0 FORMAT "%5.1" ECU_ADDRESS 0x7F886A /end MEASUREMENT
/begin MEASUREMENT EngM_numTDC "Aktueller Zünd-OT" UBYTE OneToOne 1 100 0.00 255.0 FORMAT "%5.1" ECU_ADDRESS 0x7F886B /end MEASUREMENT
/begin MEASUREMENT EngM_phiDiffTDC "Winkel zwischen TDC1 und dem in der Zündreihenfolge nächsten TDC auf diesem Steuergerät" SWORD AngleCrS 1 100 -768.0000 767.9766 FORMAT "%8.4" ECU_ADDRESS 0x7F8C7A /end MEASUREMENT
/begin MEASUREMENT EngM_phiInt "aktuelle Interrupt-Position" SWORD AngleCrS 1 100 -768.0000 767.9766 FORMAT "%8.4" ECU_ADDRESS 0x7F8C7C /end MEASUREMENT
/begin MEASUREMENT EngM_phiIntExt "aktuelle Interrupt-Position, extern vom Master zum Slave über CAN" SWORD AngleCrS 1 100 -768.0000 767.9766 FORMAT "%8.4" ECU_ADDRESS 0x7F8C7E /end MEASUREMENT
/begin MEASUREMENT EngM_phiIntExtCorr_mp "aktuelle Winkelposition an der Masterseite nach der Korrektur im Slave-Steuergerät" SWORD AngleCrS 1 100 -768.0000 767.9766 FORMAT "%8.4" ECU_ADDRESS 0x8FEE76 /end MEASUREMENT
/begin MEASUREMENT EngM_phiTDC "OT-Position der aktuellen Zumessung" SWORD AngleCrS 1 100 -768.0000 767.9766 FORMAT "%8.4" ECU_ADDRESS 0x7F8C82 /end MEASUREMENT
/begin MEASUREMENT EngM_rCurrProf_mp "" SWORD DtyCyc 1 100 -327.6800 327.6700 FORMAT "%8.4" ECU_ADDRESS 0x8FEEA4 /end MEASUREMENT
/begin MEASUREMENT EngM_SchedDelta_mp "Sprungweite in der Schedule-Tabelle" UBYTE OneToOne 1 100 0.00 255.0 FORMAT "%5.1" ECU_ADDRESS 0x8FEE78 /end MEASUREMENT
/begin MEASUREMENT EngM_SchedIndex_mp "Anzahl der abgearbeiteten Anweisungen der Schedule-Sequenz" UBYTE OneToOne 1 100 0.00 255.0 FORMAT "%5.1" ECU_ADDRESS 0x8FEE79 /end MEASUREMENT
/begin MEASUREMENT EngM_SchedLimitInt_mp "Nummer des Abschrankintervalls" UBYTE OneToOne 1 100 0.00 255.0 FORMAT "%5.1" ECU_ADDRESS 0x8FEE7A /end MEASUREMENT
/begin MEASUREMENT EngM_SchedSegID_mp "Nummer des Segments vor dem Interrupt" UBYTE OneToOne 1 100 0.00 255.0 FORMAT "%5.1" ECU_ADDRESS 0x8FEE7B /end MEASUREMENT
/begin MEASUREMENT EngM_stAdpt "Zustand Reibmomentenadaption" UBYTE OneToOne 1 100 0.00 255.0 FORMAT "%5.1" ECU_ADDRESS 0x7F886C /end MEASUREMENT
/begin MEASUREMENT EngM_stCaSExt "Statusinformation CaSCD_stPhaseSig_mp vom Mastersteuergeraet über CAN" UWORD OneToOne 1 100 0.00 65535.00 FORMAT "%8.2" ECU_ADDRESS 0x7F8C84 /end MEASUREMENT
/begin MEASUREMENT EngM_stCaSVerifyDiag "Statusinformation der Diagnose aus den VERIFY Zustand" UBYTE OneToOne 1 100 0.00 255.0 FORMAT "%5.1" ECU_ADDRESS 0x7F886D /end MEASUREMENT
/begin MEASUREMENT EngM_stEngMntCtl_mp "status of error bit values" UBYTE OneToOne 1 100 0.00 255.0 FORMAT "%5.1" ECU_ADDRESS 0x8FEEA6 /end MEASUREMENT
/begin MEASUREMENT EngM_stErrCanExt "CAN-Errorstatus der Botschaft MS_PHI_SNYC extern vom Master mit: EngM_phiIntExt, EngM_stNextExt" UBYTE OneToOne 1 100 0.00 255.0 FORMAT "%5.1" ECU_ADDRESS 0x7F886E /end MEASUREMENT
/begin MEASUREMENT EngM_stEvent "Interruptereignis" UBYTE OneToOne 1 100 0.00 255.0 FORMAT "%5.1" ECU_ADDRESS 0x7F886F /end MEASUREMENT
/begin MEASUREMENT EngM_stEventEnable_mp "n-synchrone Interrupts freigegeben" UWORD OneToOne 1 100 0.00 65535.00 FORMAT "%8.2" ECU_ADDRESS 0x8FEE7C /end MEASUREMENT
/begin MEASUREMENT EngM_stEventServed_mp "Aktuell bediente Interrupts" UWORD OneToOne 1 100 0.00 65535.00 FORMAT "%8.2" ECU_ADDRESS 0x8FEE7E /end MEASUREMENT
/begin MEASUREMENT EngM_stGbxRel_mp "Status Freigabebedingung: Antriebsstrang offen" UBYTE OneToOne 1 100 0.00 255.0 FORMAT "%5.1" ECU_ADDRESS 0x8FEEB4 /end MEASUREMENT
/begin MEASUREMENT EngM_stGenRel_mp "Status generelle Freigabebedingungen für Reibmomentenadaption" UBYTE OneToOne 1 100 0.00 255.0 FORMAT "%5.1" ECU_ADDRESS 0x8FEEB5 /end MEASUREMENT
/begin MEASUREMENT EngM_stInjCharSetVal "Zeigt den Zustand der erlaubten Einspritzungen" UBYTE OneToOne 1 100 0.00 255.0 FORMAT "%5.1" ECU_ADDRESS 0x7F8870 /end MEASUREMENT
/begin MEASUREMENT EngM_stNDiffRng_mp "Status Leerlaufreglerabweichung innerhalb zulässiger Schwellwerte" UBYTE OneToOne 1 100 0.00 255.0 FORMAT "%5.1" ECU_ADDRESS 0x8FEEB6 /end MEASUREMENT
/begin MEASUREMENT EngM_stNext "Meta-Status der KW- und NW-Ereignisverwaltung (Motorpositions-Management), ohne Interim-Zustände" UBYTE OneToOne 1 100 0.00 255.0 FORMAT "%5.1" ECU_ADDRESS 0x7F8871 /end MEASUREMENT
/begin MEASUREMENT EngM_stNextExt "Meta-Status der KW- und NW-Ereignisverwaltung, ohne Interim-Zustände, extern vom Master zum Slave über CAN" UBYTE OneToOne 1 100 0.00 255.0 FORMAT "%5.1" ECU_ADDRESS 0x7F8872 /end MEASUREMENT
/begin MEASUREMENT EngM_stOut "state of engine bearing depending on engine speed, engine temperature and gear state" UBYTE OneToOne 1 100 0.00 255.0 FORMAT "%5.1" ECU_ADDRESS 0x7F8873 /end MEASUREMENT
/begin MEASUREMENT EngM_stReliablAdpt "Zuverlässigkeitsstatus des adaptierten Verlustmoments" UBYTE OneToOne 1 100 0.00 255.0 FORMAT "%5.1" ECU_ADDRESS 0x7F8874 /end MEASUREMENT
/begin MEASUREMENT EngM_stSpd "Status der Motordrehzahl" UBYTE OneToOne 1 100 0.00 255.0 FORMAT "%5.1" ECU_ADDRESS 0x7F8875 /end MEASUREMENT
/begin MEASUREMENT EngM_stSync "Meta-Status der KW- und NW-Ereignisverwaltung (Motorpositions-Management)" UBYTE OneToOne 1 100 0.00 255.0 FORMAT "%5.1" ECU_ADDRESS 0x7F8876 /end MEASUREMENT
/begin MEASUREMENT EngM_stTrqFrcPDiffErr_mp "Statusmesspunkt für Ersatzdrehmomentverlust im Systemfehlerefall" UBYTE OneToOne 1 100 0.00 255.0 FORMAT "%5.1" ECU_ADDRESS 0x8FEEA7 /end MEASUREMENT
/begin MEASUREMENT EngM_tiDiffInt_mp "Differenz zwischen zwei statische interrupts" ULONG TimeSys_us 1 100 0.00 1228361874.73 FORMAT "%13.2" ECU_ADDRESS 0x8FEE80 /end MEASUREMENT
/begin MEASUREMENT EngM_tiSeg "Segmentzeit" UWORD TimeDT 1 100 0.00 65535.00 FORMAT "%8.2" ECU_ADDRESS 0x7F8C86 /end MEASUREMENT
/begin MEASUREMENT EngM_tiSegLimAvrg "gemittelte beschränkte Segmentzeit" UWORD TimeDT 1 100 0.00 65535.00 FORMAT "%8.2" ECU_ADDRESS 0x7F8C88 /end MEASUREMENT
/begin MEASUREMENT EngM_tiSegTwo "Dauer der vergangenen beiden Segmente" UWORD TimeDT 1 100 0.00 65535.00 FORMAT "%8.2" ECU_ADDRESS 0x7F8C8A /end MEASUREMENT
/begin MEASUREMENT EngM_trqDiffAdpt "Adaptiertes Differenzmoment" SWORD Trq 1 100 -3276.800 3276.700 FORMAT "%8.3" ECU_ADDRESS 0x7F8C8C /end MEASUREMENT
/begin MEASUREMENT EngM_trqFltACoff_mp "Adaptionsfilter-Ausgang für Zustand ""Klima Kompressor aus""" SWORD Trq 1 100 -3276.800 3276.700 FORMAT "%8.3" ECU_ADDRESS 0x8FEEB8 /end MEASUREMENT
/begin MEASUREMENT EngM_trqFltACon_mp "Adaptionsfilter-Ausgang für Zustand ""Klimakompressor an""" SWORD Trq 1 100 -3276.800 3276.700 FORMAT "%8.3" ECU_ADDRESS 0x8FEEBA /end MEASUREMENT
/begin MEASUREMENT EngM_trqFrc "aktuelles Reibmoment" SWORD Trq 1 100 -3276.800 3276.700 FORMAT "%8.3" ECU_ADDRESS 0x7F8C8E /end MEASUREMENT
/begin MEASUREMENT EngM_trqFrcPDiffLim_mp "limitierter Momentenverlust aufgrund Differenzdruck über Partikelfilter" SWORD Trq 1 100 -3276.800 3276.700 FORMAT "%8.3" ECU_ADDRESS 0x8FEEA8 /end MEASUREMENT
/begin MEASUREMENT EngM_trqFrcPDiffRaw_mp "Rohwert des Momentenverlustes aufgrund Differenzdruck über Partikelfilter" SWORD Trq 1 100 -3276.800 3276.700 FORMAT "%8.3" ECU_ADDRESS 0x8FEEAA /end MEASUREMENT
/begin MEASUREMENT EngM_trqFrcPDiff_mp "Momentenverlust aufgrund Differenzdruck über Partikelfilter" SWORD Trq 1 100 -3276.800 3276.700 FORMAT "%8.3" ECU_ADDRESS 0x8FEEAC /end MEASUREMENT
/begin MEASUREMENT EngM_trqFrcT_mp "ausgewählte Temperature zur Berechnung Reibmoment" SWORD Trq 1 100 -3276.800 3276.700 FORMAT "%8.3" ECU_ADDRESS 0x8FEEAE /end MEASUREMENT
/begin MEASUREMENT EngM_trqLossAdpt "Adaptiertes Gesamtverlustmoment des Motors" SWORD Trq 1 100 -3276.800 3276.700 FORMAT "%8.3" ECU_ADDRESS 0x7F8C90 /end MEASUREMENT
/begin MEASUREMENT EngM_trqLossCompl_mp "komplettes Motor-Verlustmoment" SWORD Trq 1 100 -3276.800 3276.700 FORMAT "%8.3" ECU_ADDRESS 0x8FEEBC /end MEASUREMENT
/begin MEASUREMENT EngM_trqLossDiff_mp "Differenzverlustmoment der Reibmomenten-Adaption" SWORD Trq 1 100 -3276.800 3276.700 FORMAT "%8.3" ECU_ADDRESS 0x8FEEBE /end MEASUREMENT
/begin MEASUREMENT EngM_tTrqFrc_mp "Ausgewählte Temperatur für die Reibmomentenberechnung" SWORD Temp_Cels 1 100 -50.140 899.860 FORMAT "%8.3" ECU_ADDRESS 0x8FEEB0 /end MEASUREMENT
/begin MEASUREMENT EngPrt_facOvhtPrvCT_mp "Faktor aus Kühlmitteltemperatur" SWORD Fact 1 100 -4.000000 3.999878 FORMAT "%8.6" ECU_ADDRESS 0x8FEEC0 /end MEASUREMENT
/begin MEASUREMENT EngPrt_facOvhtPrvFT_mp "Faktor aus Kraftstofftemperatur" SWORD Fact 1 100 -4.000000 3.999878 FORMAT "%8.6" ECU_ADDRESS 0x8FEEC2 /end MEASUREMENT
/begin MEASUREMENT EngPrt_facOvhtPrvOT_mp "Faktor aus Motoröltemperatur" SWORD Fact 1 100 -4.000000 3.999878 FORMAT "%8.6" ECU_ADDRESS 0x8FEEC4 /end MEASUREMENT
/begin MEASUREMENT EngPrt_facOvhtPrv_mp "Minimum der Temperaturfaktoren" SWORD Fact 1 100 -4.000000 3.999878 FORMAT "%8.6" ECU_ADDRESS 0x8FEEC6 /end MEASUREMENT
/begin MEASUREMENT EngPrt_facPrtLim "Motorschutzbegrenzungsfaktor" SWORD Fact 1 100 -4.000000 3.999878 FORMAT "%8.6" ECU_ADDRESS 0x7F8C92 /end MEASUREMENT
/begin MEASUREMENT EngPrt_qOvhtPrvNRng_mp "Begrenzungsmenge auf Grund der mittleren Drehzahl" SWORD InjMass 1 100 -327.6800 327.6700 FORMAT "%8.4" ECU_ADDRESS 0x8FEEC8 /end MEASUREMENT
/begin MEASUREMENT EngPrt_qOvhtPrvVRng_mp "Begrenzungsmenge auf Grund der Fahrzeuggeschwindigkeit" SWORD InjMass 1 100 -327.6800 327.6700 FORMAT "%8.4" ECU_ADDRESS 0x8FEECA /end MEASUREMENT
/begin MEASUREMENT EngPrt_qPrtLim "Begrenzungmenge zum thermischen Motorschutz" SWORD InjMass 1 100 -327.6800 327.6700 FORMAT "%8.4" ECU_ADDRESS 0x7F8C94 /end MEASUREMENT
/begin MEASUREMENT EngPrt_stFWOscDet "Status of fly wheel oscillation detection" UBYTE OneToOne 1 100 0.00 255.0 FORMAT "%5.1" ECU_ADDRESS 0x7F8878 /end MEASUREMENT
/begin MEASUREMENT EngPrt_stOvrSpd "Überdrehzahl-Status" UBYTE OneToOne 1 100 0.00 255.0 FORMAT "%5.1" ECU_ADDRESS 0x7F8879 /end MEASUREMENT
/begin MEASUREMENT EngPrt_stTrqRampSwitch_mp "status of rampswitch" UWORD OneToOne 1 100 0.00 65535.00 FORMAT "%8.2" ECU_ADDRESS 0x8FEECC /end MEASUREMENT
/begin MEASUREMENT EngPrt_trqLim "Begrenzungsmoment zum Schutz vor zu hohem Drehmoment (als inneres Motormoment)" SWORD Trq 1 100 -3276.800 3276.700 FORMAT "%8.3" ECU_ADDRESS 0x7F8C96 /end MEASUREMENT
/begin MEASUREMENT EngPrt_trqLimPrvLim_mp "" SWORD Trq 1 100 -3276.800 3276.700 FORMAT "%8.3" ECU_ADDRESS 0x8FEECE /end MEASUREMENT
/begin MEASUREMENT EngPrt_trqNLim "Begrenzungsmoment zum Schutz vor zu hoher Drehzahl (als inneres Motormoment)" SWORD Trq 1 100 -3276.800 3276.700 FORMAT "%8.3" ECU_ADDRESS 0x7F8C98 /end MEASUREMENT
/begin MEASUREMENT EngPrt_trqOvhtPrv "Begrenzungsmoment für Überhitzungsschutz" SWORD Trq 1 100 -3276.800 3276.700 FORMAT "%8.3" ECU_ADDRESS 0x7F8C9A /end MEASUREMENT
/begin MEASUREMENT EngPrt_trqPrtLim "resultierendes Begrenzungsmoment für Motormechanikschutz (inneres Motormoment)" SWORD Trq 1 100 -3276.800 3276.700 FORMAT "%8.3" ECU_ADDRESS 0x7F8C9C /end MEASUREMENT
/begin MEASUREMENT EngPrt_trqRamLim1_mp "Ausgang der Sekunde rampswitch" SWORD Trq 1 100 -3276.800 3276.700 FORMAT "%8.3" ECU_ADDRESS 0x8FEED0 /end MEASUREMENT
/begin MEASUREMENT EngPrt_trqRamLim_mp "Ausgang von erstem rampswitch" SWORD Trq 1 100 -3276.800 3276.700 FORMAT "%8.3" ECU_ADDRESS 0x8FEED2 /end MEASUREMENT
/begin MEASUREMENT Eng_dnAvrg "gemittelte Drehzahländerung pro Sekunde" SWORD dn_dZ20 1 100 -327680.0 327670.0 FORMAT "%8.1" ECU_ADDRESS 0x7F8C9E /end MEASUREMENT
/begin MEASUREMENT Eng_nAvrg "mittlere Motordrehzahl" SWORD EngN 1 100 -32768.00 32767.00 FORMAT "%8.2" ECU_ADDRESS 0x7F8CA0 /end MEASUREMENT
/begin MEASUREMENT Eng_nCurr "aktuelle Motordrehzahl" SWORD EngN 1 100 -32768.00 32767.00 FORMAT "%8.2" ECU_ADDRESS 0x7F8CA2 /end MEASUREMENT
/begin MEASUREMENT Eng_stOvrTemp "Status Übertemperatur" UBYTE OneToOne 1 100 0.00 255.0 FORMAT "%5.1" ECU_ADDRESS 0x7F887A /end MEASUREMENT
/begin MEASUREMENT Eng_stOvrTemp2 "Status Übertemperatur 2" UBYTE OneToOne 1 100 0.00 255.0 FORMAT "%5.1" ECU_ADDRESS 0x7F887B /end MEASUREMENT
/begin MEASUREMENT Eng_stOvrTemp_mp "Status Übertemperatur" UBYTE OneToOne 1 100 0.00 255.0 FORMAT "%5.1" ECU_ADDRESS 0x8FEE6E /end MEASUREMENT
/begin MEASUREMENT Eng_tEng "Motortemperatur" SWORD Temp_Cels 1 100 -50.140 899.860 FORMAT "%8.3" ECU_ADDRESS 0x7F8CA4 /end MEASUREMENT
/begin MEASUREMENT Eng_tFld "Motortemperatur-Feld" SWORD Temp_Cels 1 100 -50.140 899.860 FORMAT "%8.3" ARRAY_SIZE 3 ECU_ADDRESS 0x7F92AC /end MEASUREMENT
/begin MEASUREMENT Eng_trqCrvMax "maximales Moment des Momentenintervalls (über Drehzahl)" SWORD Trq 1 100 -3276.800 3276.700 FORMAT "%8.3" ECU_ADDRESS 0x7F8CAA /end MEASUREMENT
/begin MEASUREMENT Eng_tStrt "Motortemperatur beim Start" SWORD Temp_Cels 1 100 -50.140 899.860 FORMAT "%8.3" ECU_ADDRESS 0x7F8CA6 /end MEASUREMENT
/begin MEASUREMENT ErLpCD_OrdGlwLmp "Message vom Fehlerlampen Handler and Glühzeitsteuerung, steuert die Glühlampe bei Systemlampenfehlern an." UBYTE OneToOne 1 100 0.00 255.0 FORMAT "%5.1" ECU_ADDRESS 0x7F887C /end MEASUREMENT
/begin MEASUREMENT ErLpCD_stMil "Gesamtatus der MIL und Status der Aktivierungsquellen" UBYTE OneToOne 1 100 0.00 255.0 FORMAT "%5.1" ECU_ADDRESS 0x7F887D /end MEASUREMENT
/begin MEASUREMENT ErLpCD_stMilLmpTst "Status der MIL während Lampentest" UBYTE OneToOne 1 100 0.00 255.0 FORMAT "%5.1" ECU_ADDRESS 0x7F887E /end MEASUREMENT
/begin MEASUREMENT ErLpCD_stMilReq "Status der externen MIL Ansteuerungs Anforderung (Achtung: wechselt während der Ansteuerung dauernd den Zustand)" UBYTE OneToOne 1 100 0.00 255.0 FORMAT "%5.1" ECU_ADDRESS 0x7F887F /end MEASUREMENT
/begin MEASUREMENT ErLpCD_stSysLmp "Gesamtatus der System Lampe und Status der Aktivierungsquellen" UBYTE OneToOne 1 100 0.00 255.0 FORMAT "%5.1" ECU_ADDRESS 0x7F8880 /end MEASUREMENT
/begin MEASUREMENT ErLpCD_stSysLmpReq "Status der externen Systemlampen  Ansteuerungs Anforderung (Achtung: wechselt während der Ansteuerung dauernd den Zustand)" UBYTE OneToOne 1 100 0.00 255.0 FORMAT "%5.1" ECU_ADDRESS 0x7F8881 /end MEASUREMENT
/begin MEASUREMENT ErLpCD_stTstMIL_mp "Testzustand und Fehlerspeicheranforderung der MIL" UBYTE OneToOne 1 100 0.00 255.0 FORMAT "%5.1" ECU_ADDRESS 0x8FEED4 /end MEASUREMENT
/begin MEASUREMENT ErLpCD_stTstSysLmp_mp "Testzustand und Anforderung durch Fehlerspeicher für Systemlampe" UBYTE OneToOne 1 100 0.00 255.0 FORMAT "%5.1" ECU_ADDRESS 0x8FEED5 /end MEASUREMENT
/begin MEASUREMENT ESS_nBattMin "Leerlaufdrehzahl wegen schwacher Batterie" SWORD EngN 1 100 -32768.00 32767.00 FORMAT "%8.2" ECU_ADDRESS 0x7F8C6A /end MEASUREMENT
/begin MEASUREMENT ESS_nMax "Hoechstdrehzahl für ESS" SWORD EngN 1 100 -32768.00 32767.00 FORMAT "%8.2" ECU_ADDRESS 0x7F8C6C /end MEASUREMENT
/begin MEASUREMENT ESS_nMin "Leerlaufdrehzahl aus ESS" SWORD EngN 1 100 -32768.00 32767.00 FORMAT "%8.2" ECU_ADDRESS 0x7F8C6E /end MEASUREMENT
/begin MEASUREMENT ESS_pwrDes "Leistungsbedarf aller Aggregate des Bordnetzes" SWORD Pwr 1 100 -308831.1 308821.7 FORMAT "%8.1" ECU_ADDRESS 0x7F8C70 /end MEASUREMENT
/begin MEASUREMENT ESS_pwrLead "Vorhaltleistung des el. Bordnetzes" SWORD Pwr 1 100 -308831.1 308821.7 FORMAT "%8.1" ECU_ADDRESS 0x7F8C72 /end MEASUREMENT
/begin MEASUREMENT ETClb_ctInjCycl_mp "Aktuelle Anzahl der Einspritzzyklen für die Ansteuerdauerkalibrierung" UWORD OneToOne 1 100 0.00 65535.00 FORMAT "%8.2" ECU_ADDRESS 0x8FEF04 /end MEASUREMENT
/begin MEASUREMENT ETClb_ctLrn_mp "Lernzykluszähler für jeden Raildruck-Kalibrierpunkt der Ansteuerdauerkalibrierung" UWORD OneToOne 1 100 0.00 65535.00 FORMAT "%8.2" ARRAY_SIZE 3 ECU_ADDRESS 0x6F8090 /end MEASUREMENT
/begin MEASUREMENT ETClb_dtiETFlt0_mp "Gefilterte Ansteuerdauerdifferenz der Ansteuerdauerkalibrierung für jeden Zylinder beim Raildruck-Kalibrierpunkt 0" SWORD InjTime_us 1 100 -32768.00 32767.00 FORMAT "%8.2" ARRAY_SIZE 6 ECU_ADDRESS 0x6F8096 /end MEASUREMENT
/begin MEASUREMENT ETClb_dtiETFlt1_mp "Gefilterte Ansteuerdauerdifferenz der Ansteuerdauerkalibrierung für jeden Zylinder beim Raildruck-Kalibrierpunkt 1" SWORD InjTime_us 1 100 -32768.00 32767.00 FORMAT "%8.2" ARRAY_SIZE 6 ECU_ADDRESS 0x6F80A2 /end MEASUREMENT
/begin MEASUREMENT ETClb_dtiETFlt2_mp "Gefilterte Ansteuerdauerdifferenz der Ansteuerdauerkalibrierung für jeden Zylinder beim Raildruck-Kalibrierpunkt 2" SWORD InjTime_us 1 100 -32768.00 32767.00 FORMAT "%8.2" ARRAY_SIZE 6 ECU_ADDRESS 0x6F80AE /end MEASUREMENT
/begin MEASUREMENT ETClb_numCylCur_mp "Aktueller Zylinder für die Ansteuerdauerkalibrierung bei jedem Raildruck-Kalibrierpunkt" UBYTE OneToOne 1 100 0.00 255.0 FORMAT "%5.1" ARRAY_SIZE 3 ECU_ADDRESS 0x8FEED6 /end MEASUREMENT
/begin MEASUREMENT ETClb_numPres_mp "Aktueller Raildruck-Kalibrierpunkt der Ansteuerdauerkalibrierung" UBYTE OneToOne 1 100 0.00 255.0 FORMAT "%5.1" ECU_ADDRESS 0x8FEF06 /end MEASUREMENT
/begin MEASUREMENT ETClb_numRailPresClbPnt_mp "Anzahl der Raildruck-Kalibrierpunkte für die Ansteuerdauerkalibrierung" UBYTE OneToOne 1 100 0.00 255.0 FORMAT "%5.1" ECU_ADDRESS 0x8FEF07 /end MEASUREMENT
/begin MEASUREMENT ETClb_stCor "Statusanzeige der Freigaben für die Ansteuerdauerkorrektur der Nullmengenkalibrierung" UBYTE OneToOne 1 100 0.00 255.0 FORMAT "%5.1" ECU_ADDRESS 0x7F8864 /end MEASUREMENT
/begin MEASUREMENT ETClb_stDemCor_mp "Anforderung der Ansteuerdauerkorrektur der Ansteuerdauerkalibrierung" UBYTE OneToOne 1 100 0.00 255.0 FORMAT "%5.1" ECU_ADDRESS 0x8FEF08 /end MEASUREMENT
/begin MEASUREMENT ETClb_stEvalResult_mp "Ergebnis der Ansteuerdauerkalibrierungs-Einspritzungen" UBYTE ETClb_Eval_Rslt 1 100 0.00 2.00000000000 FORMAT "%13.11" ECU_ADDRESS 0x8FEF0C /end MEASUREMENT
/begin MEASUREMENT ETClb_stEval_mp "Zustand des Zustandsautomaten zur Auswertung der Ansteuerdauerkalibrierung" UBYTE ETClb_Eval_State 1 100 0.00 2.00000000000 FORMAT "%13.11" ARRAY_SIZE 3 ECU_ADDRESS 0x8FEF09 /end MEASUREMENT
/begin MEASUREMENT ETClb_stRailpClbPntErr_mp "Status der Begrenzung der Ansteuerdauer der ZFC Kalibrierung für jeden Raildruck-Kalibrierpunkt" UBYTE OneToOne 1 100 0.00 255.0 FORMAT "%5.1" ARRAY_SIZE 6 ECU_ADDRESS 0x6F80C4 /end MEASUREMENT
/begin MEASUREMENT ETClb_stRlsCylCor_mp "Zylinderspezifische Freigabe der Ansteuerdauerkorrektur der Ansteuerdauerkalibrierung" UBYTE OneToOne 1 100 0.00 255.0 FORMAT "%5.1" ECU_ADDRESS 0x6F80C2 /end MEASUREMENT
/begin MEASUREMENT ETClb_st_mp "Zustand der Ansteuerdauerkalibrierung" UBYTE ETClb_State 1 100 0.00 4.00000000000 FORMAT "%13.11" ECU_ADDRESS 0x6F80C3 /end MEASUREMENT
/begin MEASUREMENT ETClb_swtCorActv "SW-Schalter zur Aktivierung der Ansteuerdauerkorrektur der Nullmengenkalibrierung" UBYTE OneToOne 1 100 0.00 255.0 FORMAT "%5.1" ECU_ADDRESS 0x7F8865 /end MEASUREMENT
/begin MEASUREMENT ETClb_swtQckClb_mp "Anzeiger der Umschaltung auf schnelle Ansteuerdauerkalibrierung" UBYTE OneToOne 1 100 0.00 255.0 FORMAT "%5.1" ECU_ADDRESS 0x6F80BA /end MEASUREMENT
/begin MEASUREMENT ETClb_tiETChkCor0_mp "Ansteuerdauer der Nullmenge der ZFC nach Korrektur durch die IMA für Raildruck-Kalibrierpunkt 0" SWORD InjTime_us 1 100 -32768.00 32767.00 FORMAT "%8.2" ARRAY_SIZE 6 ECU_ADDRESS 0x8FEF0E /end MEASUREMENT
/begin MEASUREMENT ETClb_tiETChkCor1_mp "Ansteuerdauer der Nullmenge der ZFC nach Korrektur durch die IMA für Raildruck-Kalibrierpunkt 1" SWORD InjTime_us 1 100 -32768.00 32767.00 FORMAT "%8.2" ARRAY_SIZE 6 ECU_ADDRESS 0x8FEF1A /end MEASUREMENT
/begin MEASUREMENT ETClb_tiETChkCor2_mp "Ansteuerdauer der Nullmenge der ZFC nach Korrektur durch die IMA für Raildruck-Kalibrierpunkt 2" SWORD InjTime_us 1 100 -32768.00 32767.00 FORMAT "%8.2" ARRAY_SIZE 6 ECU_ADDRESS 0x8FEF26 /end MEASUREMENT
/begin MEASUREMENT ETClb_tiETCor0_mp "Ansteuerdauerkorrekturwert der Ansteuerdauer-Kalibrierung für den Raildruck-Kalibrierpunkt 0" SWORD InjTime_us 1 100 -32768.00 32767.00 FORMAT "%8.2" ARRAY_SIZE 6 ECU_ADDRESS 0x8FEEDA /end MEASUREMENT
/begin MEASUREMENT ETClb_tiETCor1_mp "Ansteuerdauerkorrekturwert der Ansteuerdauer-Kalibrierung für den Raildruck-Kalibrierpunkt 1" SWORD InjTime_us 1 100 -32768.00 32767.00 FORMAT "%8.2" ARRAY_SIZE 6 ECU_ADDRESS 0x8FEEE6 /end MEASUREMENT
/begin MEASUREMENT ETClb_tiETCor2_mp "Ansteuerdauerkorrekturwert der Ansteuerdauer-Kalibrierung für den Raildruck-Kalibrierpunkt 2" SWORD InjTime_us 1 100 -32768.00 32767.00 FORMAT "%8.2" ARRAY_SIZE 6 ECU_ADDRESS 0x8FEEF2 /end MEASUREMENT
/begin MEASUREMENT ETClb_tiETCur_mp "Aktuelle Ansteuerdauer der Ansteuerdauer-Kalibrierung für jeden Raildruck-Kalibrierpunkt" SWORD InjTime_us 1 100 -32768.00 32767.00 FORMAT "%8.2" ARRAY_SIZE 3 ECU_ADDRESS 0x8FEEFE /end MEASUREMENT
/begin MEASUREMENT ETClb_tiETMinEff_mp "Ansteuerdauer der Nullmenge des aktuellen Zylinder fuer jeden Raildruck-Kalibrierpunkt" SWORD InjTime_us 1 100 -32768.00 32767.00 FORMAT "%8.2" ARRAY_SIZE 3 ECU_ADDRESS 0x6F80BC /end MEASUREMENT
/begin MEASUREMENT FanCD_dcycRaw_mp "fanspeed transfered to dutycycle" SWORD DtyCyc 1 100 -327.6800 327.6700 FORMAT "%8.4" ECU_ADDRESS 0x6F80CA /end MEASUREMENT
/begin FUNCTION egsys_tstrtcalc_uic ""
 /begin OUT_MEASUREMENT EGSys_rTempClnt_mp EGSys_rTimeNSC_mp EGSys_rTimeOxiCat_mp EGSys_rTimeTrb_mp EGSys_tExcClntStrtCs_mp EGSys_tiClg_mp EGSys_tiRefClg_mp /end OUT_MEASUREMENT
/end FUNCTION
/begin FUNCTION egsys_ttrbmod ""
 /begin DEF_CHARACTERISTIC EGSys_cpChrg_C EGSys_etaChrg_MAP EGSys_tiChrgPT1_C EGSys_pValDfl_C EGSys_rTempAdbt_CUR EGSys_swtTimeChrg_C EGSys_tEGPstTrbnDfl_C /end DEF_CHARACTERISTIC
 /begin IN_MEASUREMENT AFSCD_dmAirPerTime EGSys_rPresCmpr_mp /end IN_MEASUREMENT
/end FUNCTION
/begin FUNCTION egsys_ttrbmod_msg "" /begin OUT_MEASUREMENT EGSys_tEGPstTrbn /end OUT_MEASUREMENT /end FUNCTION
/begin FUNCTION egsys_ttrbmod_uic ""
 /begin OUT_MEASUREMENT EGSys_cpEGTrbn_mp EGSys_etaChrg_mp EGSys_facPT1Chrg_mp EGSys_pwrCmpr_mp EGSys_rPresCmpr_mp EGSys_tAvrgEGTrbn_mp /end OUT_MEASUREMENT
/end FUNCTION
/begin FUNCTION egsys_ttubemod "Temperaturmodell für Abgasrohr"
 /begin DEF_CHARACTERISTIC EGSys_AlpFreeCnvtTube_C EGSys_cpTube_C EGSys_lDiamTube_C EGSys_lLngthTube_C EGSys_NuTubeEnv_CUR EGSys_NuTube_CUR EGSys_rSqTube_C EGSys_tEGTubeDfl_C EGSys_tTubeDfl_C EGSys_tTubeIKi_C EGSys_tTubeIKiPos_C EGSys_tTubeIKiNeg_C EGSys_tTubeIWinPos_C EGSys_tTubeIWinNeg_C /end DEF_CHARACTERISTIC
 /begin OUT_MEASUREMENT EGSys_AlpEGTube_mp EGSys_AlpTubeEnv_mp EGSys_cndHtEGi_mp EGSys_cndHtEGo_mp EGSys_cpEGTube_mp EGSys_dtTube_mp EGSys_dwTubeIn_mp EGSys_dwTubeOut_mp EGSys_dwTube_mp EGSys_NuTubeEnv_mp EGSys_NuTube_mp EGSys_ReTubeEnvInpCrv_mp EGSys_ReTubeEnv_mp EGSys_ReTubeInpCrv_mp EGSys_ReTube_mp EGSys_sqTube_mp EGSys_tAvrgEGTube_mp EGSys_tDiffEGTube_mp EGSys_tDiffTubeEnv_mp EGSys_tMidEGTube_mp EGSys_tMidTubeEnv_mp /end OUT_MEASUREMENT
/end FUNCTION
/begin FUNCTION egsys_ttubemod_msg "" /begin OUT_MEASUREMENT EGSys_tEGPstTube EGSys_tTube /end OUT_MEASUREMENT /end FUNCTION
/begin FUNCTION egsys_ttubemod_uic "" /end FUNCTION
/begin FUNCTION egt_corgntsync "Regenerationskoordinator Abgasnachbehandlung (zeitsynchron)"
 /begin DEF_CHARACTERISTIC EGT_stRgnLckMsk_C EGT_swtRgnLckRst_C EGT_swtServiceVal_C EGT_tiRgnOilDilMax_C EGT_tiRgnOilDilSubs_C EGT_tiRmpSlpMax_C /end DEF_CHARACTERISTIC
/end FUNCTION
/begin FUNCTION egt_corgntsync_msg ""
 /begin OUT_MEASUREMENT EGT_stCoRgnTSync EGT_stDel EGT_stTSync EGT_stTSyncLck EGT_tiRgnOilDil EGT_tiRgnTSync EGT_tiRmpSlpMax /end OUT_MEASUREMENT
/end FUNCTION
/begin FUNCTION egt_corgntsync_uic "" /begin DEF_CHARACTERISTIC EGT_stTSync_Vector EGT_stTSync_Channel /end DEF_CHARACTERISTIC
 /begin OUT_MEASUREMENT EGT_stCoRgnOld_mp EGT_stRgnOilDil_mp EGT_stTSyncDes_mp EGT_swtRgnLck_mp EGT_tiRgnTSyncPre_mp /end OUT_MEASUREMENT
/end FUNCTION
/begin FUNCTION egt_corgn_msg "" /begin OUT_MEASUREMENT EGT_facRmpVal EGT_st EGT_stCoRgn EGT_stLck EGT_tiRgn /end OUT_MEASUREMENT /end FUNCTION
/begin FUNCTION egt_corgn_uic "" /end FUNCTION
/begin FUNCTION egt_tempgvnr "EGT temperature governor"
 /begin DEF_CHARACTERISTIC EGT_facKiAMPT_MAP EGT_facKiInrTempGvnr_C EGT_facKiOutrTempGvnr_C EGT_facKiQntPoI1_MAP EGT_facKiQntPoI2_MAP EGT_facKiTempInrCor_MAP EGT_facKpAMPT_MAP EGT_facKpInrTempGvnr_C EGT_facKpOutrTempGvnr_C EGT_facKpQntPoI1_MAP EGT_facKpQntPoI2_MAP EGT_facKpTempInrCor_MAP EGT_mAirTempGvnrMax_MAP EGT_mAirTempGvnrMin_MAP EGT_qPoI1Min_C EGT_qPoI1TempGvnrMax_MAP EGT_qPoI1TempGvnrMin_MAP EGT_qPoI2Min_C EGT_qPoI2TempGvnrMax_MAP EGT_qPoI2TempGvnrMin_MAP EGT_rInrDvtThres_C EGT_rOutrDvtThres_C EGT_stMskClsThrVlv_C EGT_swtBiTrbTempGvnr_C EGT_swtInrTempOutr_C EGT_tInrCorTempGvnrMax_MAP EGT_tInrCorTempGvnrMin_MAP EGT_tiPoI1TThres_C /end DEF_CHARACTERISTIC
 /begin IN_MEASUREMENT Eng_nAvrg InjCtl_qSetUnBal /end IN_MEASUREMENT
/end FUNCTION
/begin FUNCTION egt_tempgvnrdesval "Sollwertbildung des Abgastemperaturreglers"
 /begin DEF_CHARACTERISTIC EGT_swtTempInrDes_C EGT_swtTempOutrDes_C EGT_swtTempTurbPre_C EGT_tInrDesTempTurb_CUR EGT_tInrDes_MAP EGT_tOutrDesMflO2_CUR EGT_tOutrDesMsSot_CUR EGT_tOutrDesTempPst_CUR EGT_tOutrDes_MAP /end DEF_CHARACTERISTIC
 /begin IN_MEASUREMENT Eng_nAvrg InjCtl_qSetUnBal PFlt_dmO2Aprx PFlt_mSot PFlt_tOxiPst PFlt_tTurbPre /end IN_MEASUREMENT
/end FUNCTION
/begin FUNCTION egt_tempgvnrdesval_msg ""
 /begin OUT_MEASUREMENT EGT_tInrDesTempGvnr EGT_tInrTempGvnr EGT_tOutrDesTempGvnr EGT_tOutrTempGvnr /end OUT_MEASUREMENT
/end FUNCTION
/begin FUNCTION egt_tempgvnrdesval_uic "" /end FUNCTION
/begin FUNCTION egt_tempgvnrmonitor "Überwachung des Abgastemperaturreglers"
 /begin DEF_CHARACTERISTIC EGT_stMskInrTempGvnr_C EGT_stMskOutrTempGvnr_C EGT_tiHiLoTempGvnr_C EGT_tiLoHiTempGvnr_C EGT_tInrThresDwn_C EGT_tInrThresUp_C EGT_tiPoIHiLoTempGvnr_C EGT_tiPoILoHiTempGvnr_C EGT_tOutrThresDwn_C EGT_tOutrThresUp_C EGT_tOxiPreThresBrn_C /end DEF_CHARACTERISTIC
/end FUNCTION
/begin FUNCTION egt_tempgvnrmonitor_msg "" /begin OUT_MEASUREMENT EGT_stTempGvnr /end OUT_MEASUREMENT /end FUNCTION
/begin FUNCTION egt_tempgvnrmonitor_uic "" /end FUNCTION
/begin FUNCTION egt_tempgvnroutval "Ausgabeschnittstelle der Abgastemperaturregelung"
 /begin DEF_CHARACTERISTIC EGT_facQntPoI2Rmp_CUR EGT_mAirDesTempGvnrMnl_C EGT_mAirLmbd_CUR EGT_phiPoI1TempGvnr_MAP EGT_qHCQntPoI1_CUR EGT_qPoI1TempGvnrMnl_C EGT_qPoI2TempGvnrMnl_C EGT_swtQntPoI1HC_C EGT_tiPoI2TempGvnr_MAP EGT_tiRmpSlpTempGvnr_C /end DEF_CHARACTERISTIC
 /begin IN_MEASUREMENT EGT_facRmp_mp EGT_qPoI1OutrTempGvnr Eng_nAvrg InjCtl_qSetUnBal PFlt_rLmbd /end IN_MEASUREMENT
/end FUNCTION
/begin FUNCTION egt_tempgvnroutval_msg ""
 /begin OUT_MEASUREMENT EGT_mAirDesTempGvnr EGT_phiPoI1TempGvnr EGT_qHCTempGvnr EGT_qPoI1TempGvnr EGT_qPoI2TempGvnr EGT_tiPoI2TempGvnr /end OUT_MEASUREMENT
/end FUNCTION
/begin FUNCTION egt_tempgvnroutval_uic ""
 /begin OUT_MEASUREMENT EGT_facRmpValTempGvnr_mp EGT_facRmp_mp EGT_mAirLmbdTempGvnr_mp /end OUT_MEASUREMENT
/end FUNCTION
/begin FUNCTION egt_tempgvnr_msg ""
 /begin OUT_MEASUREMENT EGT_mAirDesInrTempGvnr EGT_qPoI1OutrTempGvnr EGT_qPoI2InrTempGvnr EGT_tInrDesCorTempGvnr /end OUT_MEASUREMENT
/end FUNCTION
/begin FUNCTION egt_tempgvnr_uic ""
 /begin OUT_MEASUREMENT EGT_mAirTempGvnrMin_mp EGT_mAirTempGvnrRng_mp EGT_qPoI1Min_mp EGT_qPoI1Rng_mp EGT_qPoI2Min_mp EGT_qPoI2Rng_mp EGT_rIInrTempGvnr_mp EGT_rInrTempGvnr_mp EGT_rIOutrTempGvnr_mp EGT_rOutrTempGvnr_mp EGT_rPInrTempGvnr_mp EGT_rPOutrTempGvnr_mp EGT_rStyInrTempGvnr_mp EGT_rStyOutrTempGvnr_mp EGT_stClsThrVlv_mp EGT_tInrCorMax_mp EGT_tInrCorRng_mp EGT_tInrDvtTempGvnr_mp EGT_tiPoI1ActvCnt_mp EGT_tOutrDvtTempGvnr_mp /end OUT_MEASUREMENT
/end FUNCTION
/begin FUNCTION emccd "Komponententreiber der Motorlagersteuerung"
 /begin DEF_CHARACTERISTIC EMCCD_uSRCMinActVal1_C EMCCD_uSRCMaxActVal1_C EMCCD_iLinActVal1_CUR EMCCD_uSRCMinActVal2_C EMCCD_uSRCMaxActVal2_C EMCCD_iLinActVal2_CUR EMCCD_ctPwrStgOnMax1_C EMCCD_ctPwrStgOnMax2_C EMCCD_dcycCurrOff_MAP EMCCD_dcycCurrOnHi_MAP EMCCD_dcycCurrOnLow_MAP EMCCD_dcycMax_C EMCCD_dcycMin_C EMCCD_dcycWarmUp_MAP EMCCD_DebExcTempDef1_C EMCCD_DebExcTempOk1_C EMCCD_DebExcTempDef2_C EMCCD_DebExcTempOk2_C EMCCD_DebNoLoadDef1_C EMCCD_DebNoLoadOk1_C EMCCD_DebNoLoadDef2_C EMCCD_DebNoLoadOk2_C EMCCD_DebShortCircBatDef1_C EMCCD_DebShortCircBatOk1_C EMCCD_DebShortCircBatDef2_C EMCCD_DebShortCircBatOk2_C EMCCD_DebShortCircGndDef1_C EMCCD_DebShortCircGndOk1_C EMCCD_DebShortCircGndDef2_C EMCCD_DebShortCircGndOk2_C EMCCD_DebSRCHighDef1_C EMCCD_DebSRCHighOk1_C EMCCD_DebSRCHighDef2_C EMCCD_DebSRCHighOk2_C EMCCD_DebSRCLowDef1_C EMCCD_DebSRCLowOk1_C EMCCD_DebSRCLowDef2_C EMCCD_DebSRCLowOk2_C EMCCD_dtRmpSlpUpActVal1_C EMCCD_dtRmpSlpDwnActVal1_C EMCCD_dtRmpSlpUpActVal2_C EMCCD_dtRmpSlpDwnActVal2_C EMCCD_numAdc1_C EMCCD_numAdc2_C EMCCD_numDiaOut1_C EMCCD_numDiaOut2_C EMCCD_numPwmOut1_C EMCCD_numPwmOut2_C EMCCD_tiActValPT1_1_C EMCCD_tiActValPT1_2_C EMCCD_stInvOut1_C EMCCD_tiPer1_C EMCCD_stInvOut2_C EMCCD_tiPer2_C EMCCD_stSPICtl1_C EMCCD_stSPICtl2_C EMCCD_swtRegOn_C EMCCD_tiBtwTst1_C EMCCD_tiBtwTst2_C EMCCD_tiCurrOnHi_C EMCCD_tiPwrStgOn1_C EMCCD_tiPwrStgOn2_C EMCCD_tiWarmUp_C EMCCD_stSensIDWordActVal1_C EMCCD_iDflActVal1_C EMCCD_stSensIDWordActVal2_C EMCCD_iDflActVal2_C EngM_ctPwrStgOnMax1_C EngM_ctPwrStgOnMax2_C EngM_HldCurr_MAP EngM_RetCurr_MAP EngM_tEngMax_C EngM_tEngMin_C EngM_tiEngMntCtl_C EngM_uBattMax_C EngM_uBattMin_C /end DEF_CHARACTERISTIC
 /begin IN_MEASUREMENT BattCD_u EATSCD_tAir EMCCD_resAct1 EMCCD_uRawActVal1_mp EMCCD_uRawActVal2_mp Eng_tEng /end IN_MEASUREMENT
/end FUNCTION
/begin FUNCTION emccd_msg "" /begin OUT_MEASUREMENT EMCCD_iActVal1 EMCCD_iActVal2 EMCCD_resAct1 EMCCD_resAct2 /end OUT_MEASUREMENT /end FUNCTION
/begin FUNCTION emccd_uic ""
 /begin OUT_MEASUREMENT EMCCD_dcycCurrOff1_mp EMCCD_dcycCurrOff2_mp EMCCD_dcycCurrOn1_mp EMCCD_dcycCurrOn2_mp EMCCD_dcycMntCtlOut1_mp EMCCD_dcycMntCtlOut2_mp EMCCD_dcycOut1_mp EMCCD_dcycOut2_mp EMCCD_iActValFlt1_mp EMCCD_iActValFlt2_mp EMCCD_rHWE1_mp EMCCD_rHWE2_mp EMCCD_stOut_mp EMCCD_uRawActVal1_mp EMCCD_uRawActVal2_mp /end OUT_MEASUREMENT
/end FUNCTION
/begin FUNCTION eng "Motor"
 /begin DEF_CHARACTERISTIC Eng_ctEngSpdDiffCalc_C Eng_tOvrHi2_C Eng_tOvrHi_C Eng_tOvrLo2_C Eng_tOvrLo_C Eng_trqSpd_CUR /end DEF_CHARACTERISTIC
 /begin IN_MEASUREMENT Eng_nAvrg /end IN_MEASUREMENT
/end FUNCTION
/begin FUNCTION engm "Motormechanik"
 /begin DEF_CHARACTERISTIC EngM_dLimitCond_ASD_CA EngM_dLimitCond_Common_CA EngM_dLimitCond_FBC_CA EngM_dLimitCond_Joint_CA EngM_dLimitCond_LiGov_CA EngM_dLimitCond_Pilot_CA EngM_nLimitInj_C EngM_nLimitThreshHyst_CA EngM_nLimitThresh_CA EngM_nSwtCoMa_C EngM_numLimitInj_C EngM_swtNumCylVal_C EngM_swtNumCylType_C /end DEF_CHARACTERISTIC
/end FUNCTION
/begin FUNCTION engmon_irrcmb "Verbrennungserkennung mit Lambdasonde" /end FUNCTION
/begin FUNCTION engmon_irrcmb_msg "" /begin OUT_MEASUREMENT EngMon_stShOffIrrCmb /end OUT_MEASUREMENT /end FUNCTION
/begin FUNCTION engmon_irrcmb_uic "" /end FUNCTION
/begin FUNCTION engm_ang ""
 /begin DEF_CHARACTERISTIC EngM_ctOfsCaSCrS_C EngM_ctPhWhlRev_C EngM_ctPostSync_C EngM_ctReSync_C EngM_ctVerSync_C EngM_nMaxStrt_C EngM_numPin_C EngM_nWaitIncSig_C EngM_phiDelayPhNoSig_C EngM_phiDeltaExtSync_C EngM_phiDelta_C EngM_phiFrstInjInt_C EngM_phiInt_C EngM_phiMax_C EngM_phiTDC_C EngM_stSyncBefGap_C EngM_swtExitOfs_C EngM_swtFirSeqFBC_C EngM_swtSyncViaCAN_C EngM_tiCpuTimeOut_C EngM_tiDiffInt_C EngM_tiWaitIncSig_C /end DEF_CHARACTERISTIC
/end FUNCTION
/begin FUNCTION engm_angdiag "Diagnose des Kurbelwellen- und Nockenwellensignals"
 /begin DEF_CHARACTERISTIC EngM_ctSpdtoZero_C EngM_DebIncCaSErrSigDef_C EngM_DebIncCaSErrSigOK_C EngM_DebIncCaSNoSigDef_C EngM_DebIncCrSErrSigDef_C EngM_DebIncCrSErrSigOK_C EngM_DebIncOfsSigCaSCrSDef_C EngM_DebPhCrSErrSigDef_C EngM_nMinDiag_C /end DEF_CHARACTERISTIC
/end FUNCTION
/begin FUNCTION engm_angdiag_uic ""
 /begin OUT_MEASUREMENT EngM_ctIncErrSigDiagCaSDef_mp EngM_ctIncErrSigDiagCaSOk_mp EngM_ctIncErrSigDiagCrSDef_mp EngM_ctIncErrSigDiagCrSOK_mp EngM_ctIncErrSigDiagmaxCaSDef_mp EngM_ctIncErrSigDiagmaxCaSOk_mp EngM_ctIncErrSigDiagmaxCrSDef_mp EngM_ctIncNoSigDiagCaS_mp EngM_ctIncNoSigDiagmaxCaS_mp EngM_ctPhErrSigDiagCrSDef_mp EngM_ctPhErrSigDiagmaxCrSDef_mp EngM_ctSpdtoZero_mp /end OUT_MEASUREMENT
/end FUNCTION
/begin FUNCTION engm_ang_msg ""
 /begin OUT_MEASUREMENT EngM_nDyn EngM_numInt EngM_numLastTDC EngM_numSyncTDC EngM_numTDC EngM_phiDiffTDC EngM_phiInt EngM_phiIntExt EngM_phiTDC EngM_stCaSExt EngM_stCaSVerifyDiag EngM_stErrCanExt EngM_stEvent EngM_stInjCharSetVal EngM_stNext EngM_stNextExt EngM_stSync EngM_tiSeg EngM_tiSegLimAvrg EngM_tiSegTwo /end OUT_MEASUREMENT
/end FUNCTION
/begin FUNCTION engm_ang_uic ""
 /begin OUT_MEASUREMENT EngM_ctIntOvrLoad_mp EngM_ctPostSync_mp EngM_ctReSync_mp EngM_ctVerSync_mp EngM_numRevCnt_mp EngM_phiIntExtCorr_mp EngM_SchedDelta_mp EngM_SchedIndex_mp EngM_SchedLimitInt_mp EngM_SchedSegID_mp EngM_stEventEnable_mp EngM_stEventServed_mp EngM_tiDiffInt_mp /end OUT_MEASUREMENT
/end FUNCTION
/begin FUNCTION engm_backup "Start und Betrieb des Motors nur mit Nockenwellensignal"
 /begin DEF_CHARACTERISTIC EngM_nMaxStrtBackUp_C EngM_stBackUpVar_C EngM_stEnaBackUp_C /end DEF_CHARACTERISTIC
/end FUNCTION
/begin FUNCTION engm_backup_uic "" /end FUNCTION
/begin FUNCTION engm_engmntctl "Motorlagersteuerung"
 /begin DEF_CHARACTERISTIC EngM_nAvrgHysDelta_C EngM_nAvrgHysHigh_CUR EngM_nAvrgLim_C EngM_stOutHard_C EngM_stOutSoft_C EngM_tiHardAftrGear_C EngM_tiSoftAftrStrt_C EngM_vVSSCDHysHigh_C EngM_vVSSCDHysLow_C /end DEF_CHARACTERISTIC
 /begin IN_MEASUREMENT Eng_tEng /end IN_MEASUREMENT
/end FUNCTION
/begin FUNCTION engm_engmntctl_msg "" /begin OUT_MEASUREMENT EngM_stOut /end OUT_MEASUREMENT /end FUNCTION
/begin FUNCTION engm_engmntctl_uic ""
 /begin OUT_MEASUREMENT EngM_nAvrgHysHigh_mp EngM_nAvrgHysLow_mp EngM_rCurrProf_mp EngM_stEngMntCtl_mp /end OUT_MEASUREMENT
/end FUNCTION
/begin FUNCTION engm_msg "" /begin OUT_MEASUREMENT EngM_numCyl EngM_stSpd /end OUT_MEASUREMENT /end FUNCTION
/begin FUNCTION engm_soptst "" /end FUNCTION
/begin FUNCTION engm_tdsig "" /begin DEF_CHARACTERISTIC EngM_numTDSig_C /end DEF_CHARACTERISTIC /end FUNCTION
/begin FUNCTION engm_trqfrc "aktuelles Reibmoment"
 /begin DEF_CHARACTERISTIC EngM_dtrqFrcPDiffUp_C EngM_dtrqFrcPDiffDwn_C EngM_facTrqFrcPDiff_CUR EngM_numTrqFrc_C EngM_trqFrcPDiffMin_C EngM_trqFrc_MAP /end DEF_CHARACTERISTIC
 /begin IN_MEASUREMENT EngM_tTrqFrc_mp Eng_nAvrg /end IN_MEASUREMENT
/end FUNCTION
/begin FUNCTION engm_trqfrcadpt "Reibmomentenadaption"
 /begin DEF_CHARACTERISTIC EngM_facT1Reliabl_C EngM_tiFltACoff_C EngM_tiFltACon_C EngM_nLISetDiffOffs_C EngM_stChkPN_C EngM_tAdptMin_C EngM_tiRelAdpt_C EngM_vLimRefuse_C EngM_vThresAdpt_C /end DEF_CHARACTERISTIC
/end FUNCTION
/begin FUNCTION engm_trqfrcadpt_msg ""
 /begin OUT_MEASUREMENT EngM_stAdpt EngM_stReliablAdpt EngM_trqDiffAdpt EngM_trqLossAdpt /end OUT_MEASUREMENT
/end FUNCTION
/begin FUNCTION engm_trqfrcadpt_uic ""
 /begin OUT_MEASUREMENT EngM_nLISetDiff_mp EngM_stGbxRel_mp EngM_stGenRel_mp EngM_stNDiffRng_mp EngM_trqFltACoff_mp EngM_trqFltACon_mp EngM_trqLossCompl_mp EngM_trqLossDiff_mp /end OUT_MEASUREMENT
/end FUNCTION
/begin FUNCTION engm_trqfrc_msg "" /begin OUT_MEASUREMENT EngM_trqFrc /end OUT_MEASUREMENT /end FUNCTION
/begin FUNCTION engm_trqfrc_uic "" /begin DEF_CHARACTERISTIC EngM_trqFrc_Vector EngM_trqFrc_Channel /end DEF_CHARACTERISTIC
 /begin OUT_MEASUREMENT EngM_stTrqFrcPDiffErr_mp EngM_trqFrcPDiffLim_mp EngM_trqFrcPDiffRaw_mp EngM_trqFrcPDiff_mp EngM_trqFrcT_mp EngM_tTrqFrc_mp /end OUT_MEASUREMENT
/end FUNCTION
/begin FUNCTION engm_uic "" /end FUNCTION
/begin FUNCTION engprt "Motormechanikschutz"
 /begin DEF_CHARACTERISTIC EngPrt_dTrqLimUp_C EngPrt_dTrqLimDown_C EngPrt_facAPSPrv_MAP EngPrt_facOvhtPrv_MAP EngPrt_nOvrSpd_C EngPrt_pAPSPrvDfl_C EngPrt_dtrqUpCBLim_C EngPrt_dtrqDwnCBLim_C EngPrt_dtrqUpNLim_C EngPrt_dtrqDwnNLim_C EngPrt_rVnDAMax_C EngPrt_rVnDAMin_C EngPrt_rVnTrqMax_C EngPrt_rVnTrqMin_C EngPrt_swtTrqGear_CUR EngPrt_trqCBLim1_CUR EngPrt_trqCBLim_CUR EngPrt_trqLim1_CUR EngPrt_trqLimDA_CUR EngPrt_trqLim_CUR EngPrt_trqNLimSpr_CUR EngPrt_trqNLim_CUR /end DEF_CHARACTERISTIC
 /begin IN_MEASUREMENT APSCD_pVal Eng_nAvrg Eng_tEng Gearbx_stGear VSSCD_v /end IN_MEASUREMENT
/end FUNCTION
/begin FUNCTION engprt_fwoscdet ""
 /begin DEF_CHARACTERISTIC EngPrt_nTrqShutOff_C EngPrt_tiFWOscDetDebDef_C EngPrt_tiFWOscDetDebOk_C /end DEF_CHARACTERISTIC
/end FUNCTION
/begin FUNCTION engprt_fwoscdet_msg "" /begin OUT_MEASUREMENT EngPrt_stFWOscDet /end OUT_MEASUREMENT /end FUNCTION
/begin FUNCTION engprt_fwoscdet_uic "" /end FUNCTION
/begin FUNCTION engprt_msg ""
 /begin OUT_MEASUREMENT EngPrt_facPrtLim EngPrt_stOvrSpd EngPrt_trqLim EngPrt_trqNLim EngPrt_trqOvhtPrv EngPrt_trqPrtLim /end OUT_MEASUREMENT
/end FUNCTION
/begin FUNCTION engprt_prtlim_var_uic "" /end FUNCTION
/begin FUNCTION engprt_qprtlim "Begrenzungmenge zum thermischen Motorschutz"
 /begin DEF_CHARACTERISTIC EngPrt_facOvhtPrvCT_CUR EngPrt_facOvhtPrvFT_CUR EngPrt_facOvhtPrvOT_CUR EngPrt_qOvhtPrvNRng_MAP EngPrt_qOvhtPrvVRng_MAP /end DEF_CHARACTERISTIC
 /begin IN_MEASUREMENT CTSCD_tClnt EngPrt_facOvhtPrv_mp Eng_nAvrg FTSCD_tFuel OTSCD_tEngOil VSSCD_v /end IN_MEASUREMENT
/end FUNCTION
/begin FUNCTION engprt_qprtlim_msg "" /begin OUT_MEASUREMENT EngPrt_qPrtLim /end OUT_MEASUREMENT /end FUNCTION
/begin FUNCTION engprt_qprtlim_uic "" /begin DEF_CHARACTERISTIC EngPrt_qPrtLim_Vector EngPrt_qPrtLim_Channel /end DEF_CHARACTERISTIC
 /begin OUT_MEASUREMENT EngPrt_facOvhtPrvCT_mp EngPrt_facOvhtPrvFT_mp EngPrt_facOvhtPrvOT_mp EngPrt_facOvhtPrv_mp EngPrt_qOvhtPrvNRng_mp EngPrt_qOvhtPrvVRng_mp /end OUT_MEASUREMENT
/end FUNCTION
/begin FUNCTION engprt_uic ""
 /begin DEF_CHARACTERISTIC EngPrt_trqNLim_Vector EngPrt_trqNLim_Channel EngPrt_trqPrtLim_Vector EngPrt_trqPrtLim_Channel /end DEF_CHARACTERISTIC
 /begin OUT_MEASUREMENT EngPrt_stTrqRampSwitch_mp EngPrt_trqLimPrvLim_mp EngPrt_trqRamLim1_mp EngPrt_trqRamLim_mp /end OUT_MEASUREMENT
/end FUNCTION
/begin FUNCTION engprt_var_msg "" /end FUNCTION
/begin FUNCTION eng_msg ""
 /begin OUT_MEASUREMENT Eng_dnAvrg Eng_nAvrg Eng_nCurr Eng_stOvrTemp Eng_stOvrTemp2 Eng_trqCrvMax /end OUT_MEASUREMENT
/end FUNCTION
/begin FUNCTION eng_teng "Motortemperatur" /begin DEF_CHARACTERISTIC Eng_tiOvrTemp2_C Eng_tiOvrTemp_C /end DEF_CHARACTERISTIC /end FUNCTION
/begin FUNCTION eng_teng_msg "" /begin OUT_MEASUREMENT Eng_tEng Eng_tFld Eng_tStrt /end OUT_MEASUREMENT /end FUNCTION
/begin FUNCTION eng_teng_uic "" /begin OUT_MEASUREMENT Eng_stOvrTemp_mp /end OUT_MEASUREMENT /end FUNCTION
/begin FUNCTION erlpcd "Fehlerlampe Komponententreiber"
 /begin DEF_CHARACTERISTIC ErLpCD_ctMilPwrStgOnMax_C ErLpCD_ctSysLmpPwrStgOnMax_C ErLpCD_tiDefMil_C ErLpCD_tiOkMil_C ErLpCD_nThresMil_C ErLpCD_tiMaxMil_C ErLpCD_tiMilTst_C ErLpCD_tiDelMil_C ErLpCD_tiBlkMil_C ErLpCD_swtMilEna_C ErLpCD_numDiaErrLmp_C ErLpCD_numDiaSysLmp_C ErLpCD_numDioOutErrLmp_C ErLpCD_numDioOutSysLmp_C ErLpCD_stRdy_C ErLpCD_tiRdy_C ErLpCD_tiBlkOn_C ErLpCD_tiBlkOff_C ErLpCD_stMilSPICtl_C ErLpCD_stPwrStgActvLmp_C ErLpCD_stPwrStgActvMil_C ErLpCD_stPwrStgDiaLmp_C ErLpCD_stPwrStgDiaMil_C ErLpCD_stSysLmpSPICtl_C ErLpCD_swtSysEqGlwLmp_C ErLpCD_tiDefSysLmp_C ErLpCD_tiOkSysLmp_C ErLpCD_nThresSysLmp_C ErLpCD_tiMaxSysLmp_C ErLpCD_tiTstSysLmp_C ErLpCD_tiDelSysLmp_C ErLpCD_tiBlkSysLmp_C ErLpCD_swtSysLmpEna_C ErLpCD_tiBtwTstMil_C ErLpCD_tiBtwTstSysLmp_C ErLpCD_tiMilPwrStgOn_C ErLpCD_tiSysLmpPwrStgOn_C /end DEF_CHARACTERISTIC
/end FUNCTION
/begin FUNCTION erlpcd_msg ""
 /begin OUT_MEASUREMENT ErLpCD_OrdGlwLmp ErLpCD_stMil ErLpCD_stMilLmpTst ErLpCD_stMilReq ErLpCD_stSysLmp ErLpCD_stSysLmpReq /end OUT_MEASUREMENT
/end FUNCTION
/begin FUNCTION erlpcd_uic "" /begin OUT_MEASUREMENT ErLpCD_stTstMIL_mp ErLpCD_stTstSysLmp_mp /end OUT_MEASUREMENT /end FUNCTION
/begin FUNCTION ess_getnmin "Leerlaufanhebung bei schwacher Batterie"
 /begin DEF_CHARACTERISTIC ESS_nLIBattThres_C ESS_nMinThres_C ESS_tiDelayUBattFFSet_C ESS_uLIBattThresFFSet_C /end DEF_CHARACTERISTIC
/end FUNCTION
/begin FUNCTION ess_getnmin_uic "" /end FUNCTION
/begin FUNCTION ess_getnmin_var ""
 /begin DEF_CHARACTERISTIC ESS_nBattMin_C ESS_tiDelayUBattFFRes_C ESS_uLIBattThresFFRes_C /end DEF_CHARACTERISTIC
/end FUNCTION
/begin FUNCTION ess_getnmin_var_uic "" /end FUNCTION
/begin FUNCTION ess_msg "" /begin OUT_MEASUREMENT ESS_nBattMin ESS_nMax ESS_nMin ESS_pwrDes ESS_pwrLead /end OUT_MEASUREMENT /end FUNCTION
/begin FUNCTION ess_updatedem "" /end FUNCTION
/begin FUNCTION ess_updatedem_uic "" /end FUNCTION
/begin FUNCTION etclb_calibration "Ansteuerdauer Kalibrierung"
 /begin DEF_CHARACTERISTIC ETClb_ctLrnThres2_C ETClb_ctLrnThresQck_C ETClb_ctLrnThres_C ETClb_dpRailLim_CA ETClb_facFlt2_C ETClb_facFltQck_C ETClb_facFlt_C ETClb_numCyclMeas_C ETClb_numCyclNoDyn_C ETClb_numCyclStartEnergize_C ETClb_pRailSet_CA ETClb_SigThres_CA ETClb_swtCorActvVal_C ETClb_swtCorActvType_C ETClb_swtWrDflVal_C ETClb_volEffectiveMin_CA ETClb_vStartClb_CA ETClb_vStopClb_CA /end DEF_CHARACTERISTIC
 /begin OUT_MEASUREMENT ETClb_ctLrn_mp ETClb_dtiETFlt0_mp ETClb_dtiETFlt1_mp ETClb_dtiETFlt2_mp ETClb_numCylCur_mp ETClb_swtQckClb_mp ETClb_tiETCor0_mp ETClb_tiETCor1_mp ETClb_tiETCor2_mp ETClb_tiETCur_mp ETClb_tiETMinEff_mp /end OUT_MEASUREMENT
/end FUNCTION
/begin FUNCTION etclb_calibration_msg "" /begin OUT_MEASUREMENT ETClb_stCor ETClb_swtCorActv /end OUT_MEASUREMENT /end FUNCTION
/begin FUNCTION etclb_calibration_uic ""
 /begin OUT_MEASUREMENT ETClb_ctInjCycl_mp ETClb_numPres_mp ETClb_numRailPresClbPnt_mp ETClb_stDemCor_mp ETClb_stRlsCylCor_mp ETClb_st_mp /end OUT_MEASUREMENT
/end FUNCTION
/begin FUNCTION etclb_eval "Auswertung von Einspritzungen fuer die Ansteuerdauer Kalibrierung"
 /begin DEF_CHARACTERISTIC ETClb_DebETMaxDefect_C ETClb_DebETMaxOk_C ETClb_DebETMinDefect_C ETClb_DebETMinOk_C ETClb_tiETStep_CA ETClb_tiET_MAX_CA ETClb_tiET_MIN_CA /end DEF_CHARACTERISTIC
 /begin OUT_MEASUREMENT ETClb_stEval_mp ETClb_stRailpClbPntErr_mp /end OUT_MEASUREMENT
/end FUNCTION
/begin FUNCTION etclb_eval_uic "" /begin OUT_MEASUREMENT ETClb_stEvalResult_mp /end OUT_MEASUREMENT /end FUNCTION
/begin FUNCTION etclb_lib ""
 /begin DEF_CHARACTERISTIC ETClb_ctDflLrn_CA ETClb_DebETFltMaxDefect_C ETClb_DebETFltMaxOk_C ETClb_DebETFltMinDefect_C ETClb_DebETFltMinOk_C ETClb_dtiDflETFlt0_CA ETClb_dtiDflETFlt1_CA ETClb_dtiDflETFlt2_CA ETClb_numDflCylCur_CA ETClb_swtDflQckClb_C ETClb_tiDflETCur_CA ETClb_tiDflInjInit_C ETClb_tiETOfs_CA /end DEF_CHARACTERISTIC
 /begin OUT_MEASUREMENT ETClb_tiETChkCor0_mp ETClb_tiETChkCor1_mp ETClb_tiETChkCor2_mp /end OUT_MEASUREMENT
/end FUNCTION
/begin FUNCTION etclb_lib_uic "" /end FUNCTION
/begin FUNCTION fancd_co "Komponententreiber Lüfter Koordination"
 /begin DEF_CHARACTERISTIC FanCD_ctPwrStgOnMax_C FanCD_DebExcTempDef_C FanCD_DebExcTempOk_C FanCD_tiDebDia1Def_C FanCD_tiDebDia1Ok_C FanCD_tiDebDia2Def_C FanCD_tiDebDia2Ok_C FanCD_tiDebDia3Def_C FanCD_tiDebDia3Ok_C FanCD_DebNoLoadDef_C FanCD_DebNoLoadOk_C FanCD_DebShortCircBatDef_C FanCD_DebShortCircBatOk_C FanCD_DebShortCircGndDef_C FanCD_DebShortCircGndOk_C FanCD_numDia_C FanCD_numPwmOut_C FanCD_stInvOut_C FanCD_stSPICtl_C FanCD_tiBtwTst_C FanCD_tiFanCtlr1Max_C FanCD_tiFanCtlr1Min_C FanCD_tiFanCtlr2Max_C FanCD_tiFanCtlr2Min_C FanCD_tiFanCtlr3Max_C FanCD_tiFanCtlr3Min_C FanCD_tiPwrStgOn_C /end DEF_CHARACTERISTIC
/end FUNCTION
/begin FUNCTION fancd_co_uic "" /begin OUT_MEASUREMENT FanCD_dcycRaw_mp /end OUT_MEASUREMENT /end FUNCTION
/begin FUNCTION fancd_msg "" /end FUNCTION
/begin COMPU_METHOD AirMassPerCyl "Luftmasse pro Zylinder" RAT_FUNC "%6.3" "mg/Hub" COEFFS 0 10 0 0 0 1 /end COMPU_METHOD
/begin COMPU_METHOD AirMassPerTime "Luftmasse pro Zeit" RAT_FUNC "%6.3" "Kg/h" COEFFS 0 10 0 0 0 1 /end COMPU_METHOD
/begin COMPU_METHOD AngleCrS "Winkel Kurbelwelle" RAT_FUNC "%6.4" "deg CrS" COEFFS 0 42.6666666666667 0 0 0 1 /end COMPU_METHOD
/begin COMPU_METHOD Area "Flaeche mit hoher Aufloesung" RAT_FUNC "%6.5" "m*m" COEFFS 0 8192 0 0 0 1 /end COMPU_METHOD
/begin COMPU_METHOD Curr "Strom" RAT_FUNC "%6.2" "mA" COEFFS 0 1 0 0 0 1 /end COMPU_METHOD
/begin COMPU_METHOD dn_dZ20 "Motorbeschleunigung pro Zeit (dn/dt) (im 20 ms Raster)" RAT_FUNC "%6.1" "rmp/s" COEFFS 0 0.1 0 0 0 1 /end COMPU_METHOD
/begin COMPU_METHOD DtyCyc "Tastverhaeltnis" RAT_FUNC "%6.4" "%" COEFFS 0 100 0 0 0 1 /end COMPU_METHOD
/begin COMPU_METHOD EGTFact "Umrechnung für EGT_TempGvnr Ausgabeschnittstellen und Messpunkte" RAT_FUNC "%6.5" "-" COEFFS 0 1000 0 0 0 1 /end COMPU_METHOD
/begin COMPU_METHOD EGTSwt "Umrechnung für EGT Rampenschalter (1 / 1000*2^14 )" RAT_FUNC "%10.9" "-" COEFFS 0 16384000 0 0 0 1 /end COMPU_METHOD
/begin COMPU_METHOD EGTSwt_S16 "Faktor (0...1) für sint16 Type mit 0.000061 Auflösung" RAT_FUNC "%7.6" "-" COEFFS 0 16384 0 0 0 1 /end COMPU_METHOD
/begin COMPU_METHOD EngN "Motordrehzahl" RAT_FUNC "%6.2" "rpm" COEFFS 0 1 0 0 0 1 /end COMPU_METHOD
/begin COMPU_METHOD EngTempFldSel "Verbale Umrechnung für Auswahl aus dem Motortemperatur-Feld Eng_tFld" TAB_VERB "%6.3" "-" COMPU_TAB_REF EngTempFldSel /end COMPU_METHOD
/begin COMPU_VTAB EngTempFldSel "Verbale Umrechnung für Auswahl aus dem Motortemperatur-Feld Eng_tFld" TAB_VERB 3 0 "Coolant_Temperature" 1 "Oil_Temperature" 2 "Eng_tEng" /end COMPU_VTAB
/begin COMPU_METHOD ETClb_Eval_Rslt "Umrechnung der Zustände der  Ansteuerdauerkalibrierungsauswertung" TAB_VERB "%6.3" "-" COMPU_TAB_REF ETClb_Eval_Rslt /end COMPU_METHOD
/begin COMPU_VTAB ETClb_Eval_Rslt "Umrechnung der Zustände der  Ansteuerdauerkalibrierungsauswertung" TAB_VERB 3 0 "ZFC_ST_CLB_CONT" 1 "ZFC_ST_CLB_END" 2 "ZFC_ST_CLB_ERR" /end COMPU_VTAB
/begin COMPU_METHOD ETClb_Eval_State "Umrechnung der Zustände der Ausgabe des Zustandsautomaten der Evaluierung der Nullmengenkalibrierung" TAB_VERB "%6.3" "-" COMPU_TAB_REF ETClb_Eval_State /end COMPU_METHOD
/begin COMPU_VTAB ETClb_Eval_State "Umrechnung der Zustände der Ausgabe des Zustandsautomaten der Evaluierung der Nullmengenkalibrierung" TAB_VERB 3 0 "ETCLB_ST_EVAL_INIT" 1 "ETCLB_ST_EVAL_ADD" 2 "ETCLB_ST_EVAL_SUB" /end COMPU_VTAB
/begin COMPU_METHOD ETClb_State "Zustand des Zusandsautmaten der Ansteuerdauerkalibrierung" TAB_VERB "%6.3" "-" COMPU_TAB_REF ETClb_State /end COMPU_METHOD
/begin COMPU_VTAB ETClb_State "Zustand des Zusandsautmaten der Ansteuerdauerkalibrierung" TAB_VERB 5 0 "ETCLB_ST_NOT_ACTV" 1 "ETCLB_ST_START_ENERGIZE" 2 "ETCLB_ST_MEASURE" 3 "ETCLB_ST_EVALUATE" 4 "ETCLB_ST_DELAY" /end COMPU_VTAB
/begin COMPU_METHOD Fact "Faktor mit Auflösung 1 / 8192, hauptsächlich für einen Faktorenbereich 0...1 verwendet" RAT_FUNC "%6.5" "-" COEFFS 0 8192 0 0 0 1 /end COMPU_METHOD
/begin COMPU_METHOD Fact1 "Faktor mit Auflösung 0,01 (100 mal höherer Bereich als Fact)" RAT_FUNC "%6.4" "-" COEFFS 0 128 0 0 0 1 /end COMPU_METHOD
/begin COMPU_METHOD Fact_PT1 "Faktor um die Zeitkonstante eines PT1 filters festzulegen (Taupunktermittlung)" RAT_FUNC "%6.4" "W/K" COEFFS 0 128 0 0 0 1 /end COMPU_METHOD
/begin COMPU_METHOD Frequency_PA "Frequenz" RAT_FUNC "%6.2" "Hz" COEFFS 0 1 0 0 0 1 /end COMPU_METHOD
/begin COMPU_METHOD HeatCapacity "Waermekapazitaet einer Substanz" RAT_FUNC "%6.3" "J/K" COEFFS 0 10 0 0 0 1 /end COMPU_METHOD
/begin COMPU_METHOD InjMass "Einspritzmenge" RAT_FUNC "%6.4" "mg/hub" COEFFS 0 100 0 0 0 1 /end COMPU_METHOD
/begin COMPU_METHOD InjMassCorr "Korrektureinspritzmenge" RAT_FUNC "%6.5" "mg/hub" COEFFS 0 1000 0 0 0 1 /end COMPU_METHOD
/begin COMPU_METHOD InjMassCyc "Einspritzmenge pro Zyklus (mg/Zyklus)" RAT_FUNC "%6.4" "mg/cyc" COEFFS 0 100 0 0 0 1 /end COMPU_METHOD
/begin COMPU_METHOD InjMassInj "Einspritzmenge pro Einspritzung (mg/Einspritzung)" RAT_FUNC "%6.4" "mg/inj" COEFFS 0 100 0 0 0 1 /end COMPU_METHOD
/begin COMPU_METHOD InjMassNSlp "Steigung der Korrektureinspritzmenge aufgrund der Drehzahlrichtung" RAT_FUNC "%7.6" "(mg/hub)/rpm" COEFFS 0 10000 0 0 0 1 /end COMPU_METHOD
/begin COMPU_METHOD InjQntInj "Einspritzmenge der einzelnen Einspritzung" RAT_FUNC "%6.4" "mm^3/inj" COEFFS 0 100 0 0 0 1 /end COMPU_METHOD
/begin COMPU_METHOD InjTime_us "Zeit in Microsekunden für das Einspritztiming" RAT_FUNC "%6.2" "us" COEFFS 0 1 0 0 0 1 /end COMPU_METHOD
/begin COMPU_METHOD Ki_Kelv_Sec "Verstärkungskonstante für Integrator für zeitliche Ableitung der Temperatur" RAT_FUNC "%6.4" "1/s" COEFFS 0 429.4967296 0 0 0 1 /end COMPU_METHOD
/begin COMPU_METHOD Ki_Temp2EGTFact "Umrechnung für die Integrator Verstärkung des PI Reglers im EGT_TempGvnr [1/K]" RAT_FUNC "%8.7" "1/(K*s)" COEFFS 0 858993.4592 0 0 0 1 /end COMPU_METHOD
/begin COMPU_METHOD Kp_Temp2EGTFact "Umrechnung für die Proportional Verstärkung des PI Reglers im EGT_TempGvnr [1/K]" RAT_FUNC "%7.6" "1/K" COEFFS 0 51200 0 0 0 1 /end COMPU_METHOD
/begin COMPU_METHOD lambda "Lambda" RAT_FUNC "%6.5" "-" COEFFS 0 1000 0 0 0 1 /end COMPU_METHOD
/begin COMPU_METHOD Length1 "Abstand in Meter" RAT_FUNC "%6.4" "m" COEFFS 0 128 0 0 0 1 /end COMPU_METHOD
/begin COMPU_METHOD mSoot_g "Rußmasse [g]" RAT_FUNC "%6.4" "g" COEFFS 0 100 0 0 0 1 /end COMPU_METHOD
/begin COMPU_METHOD NumPinAdc "verbale Umrechnung für ADC Signale" TAB_VERB "%6.3" "-" COMPU_TAB_REF NumPinAdc /end COMPU_METHOD
/begin COMPU_VTAB NumPinAdc "verbale Umrechnung für ADC Signale" TAB_VERB 47 0 "Water_Temperature_Sensor_182" 1 "Intake_Air_Temperature_Sensor_157" 2 "Charge_Air_Temperature_Sensor_183" 3 "Exhaust_Temperature_Sensor_2_134" 4 "Exhaust_Temperature_Sensor_1_158" 5 "1st_APP_Sensor_252" 6 "2nd_APP_Sensor_239" 7 "ADC_REF" 8 "Boost_Pressure_Sensor_154" 9 "Atmospheric_Pressure_Sensor" 10 "Battery_Voltage_Sensor" 11 "Rail_Pressure_Sensor_156" 12 "Rail_Pressure_Peak_Value_156" 13 "Booster_Voltage_Sensor" 14 "Current_MeUn_Sensor" 15 "Current_PCV_Sensor" 16 "Voltage_Bank_1" 17 "Voltage_Bank_2" 18 "Pressure_Upstream_Particle_Filter_159" 19 "Engine_Oil_Pressure_110" 20 "Temperature_ECU_PCB" 21 "Voltage_Lambda_Ua" 22 "Voltage_Lambda_Ri" 23 "EMCCD_Current_Governor1_124" 24 "EMCCD_Current_Governor2_121" 25 "ADC_DUMMY_A_NOT_USED" 26 "ADC_DUMMY_NOT_USED" 27 "Charge_Actuator_Event_0" 28 "Voltage_Piezo_Actuator_Bank_2_Event_0" 29 "Voltage_Piezo_Actuator_Bank_1_Event_0" 30 "Charge_Actuator_Event_1" 31 "Voltage_Piezo_Actuator_Bank_2_Event_1" 32 "Voltage_Piezo_Actuator_Bank_1_Event_1" 33 "Charge_Actuator_Event_2" 34 "Voltage_Piezo_Actuator_Bank_2_Event_2" 35 "Voltage_Piezo_Actuator_Bank_1_Event_2" 36 "Charge_Actuator_Event_3" 37 "Voltage_Piezo_Actuator_Bank_2_Event_3" 38 "Voltage_Piezo_Actuator_Bank_1_Event_3" 39 "Charge_Actuator_Event_4" 40 "Voltage_Piezo_Actuator_Bank_2_Event_4" 41 "Voltage_Piezo_Actuator_Bank_1_Event_4" 42 "Charge_Actuator_Event_5" 43 "Voltage_Piezo_Actuator_Bank_2_Event_5" 44 "Voltage_Piezo_Actuator_Bank_1_Event_5" 45 "Booster_Voltage_Piezo" 46 "Piezo_Voltage" /end COMPU_VTAB
/begin COMPU_METHOD NumPinDia "Verbale Umrechnung für Diagnose Signale" TAB_VERB "%6.3" "-" COMPU_TAB_REF NumPinDia /end COMPU_METHOD
/begin COMPU_VTAB NumPinDia "Verbale Umrechnung für Diagnose Signale" TAB_VERB 36 0 "CJ945_Diagnostic_Signal" 1 "AC_Compressor_DiaSig" 2 "Fuel_Pump_DiaSig" 3 "Starter_234" 4 "Oil_Pressure_Lamp_Switch_245" 5 "Engine_Bay_Air_Flaps_123" 6 "Glow_Relay_Diagnostic_Signal1" 7 "reserved Glow_Relay_Diagnostic_Signal2" 8 "Ebox_Fan_Actuator_Diagnostic_Signal_219" 9 "Dummy_Actuator_Diagnostic_Signal" 10 "Twostage_TurboLoading_SW_DiaSig" 11 "DIO_OUT_DIAGNOSTIC_DUMMY_NOT_USED" 12 "1st_Pressure_Control_Valve_Diagnostic_Signal_172" 13 "2nd_Pressure_Control_Valve_Diagnostic_Signal_172" 14 "1st_Metering_Unit_Diagnostic_Signal_171" 15 "2nd_Metering_Unit_Diagnostic_Signal_171" 16 "Boost_Pressure_Actuator_Diagnostic_Signal_193" 17 "Boost_Pressure_Actuator_Diagnostic_Signal_193_2" 18 "EGR_Actuator_Diagnostic_Signal_194" 19 "EGR_Actuator_Diagnostic_Signal2" 20 "Variable_Swirl_Actuator_Diagnostic_Signal_195" 21 "Throttle_Valve_Diagnostic_Signal_196" 22 "Throttle_Valve2_Diagnostic_Signal_196" 23 "FAN_240" 24 "Add_On_Heater_244" 25 "EngM_Bearing_Actuator_Diagnostic_Signal_124" 26 "EngM_Bearing_Actuator_Diagnostic_Signal_121" 27 "Low pressure stage BPA_Diagnostic_Signal_117" 28 "Shuttr_Actuator_Diagnostic_Signal_231" 29 "PWM_DIAGNOSTIC_DUMMY_NOT_USED" 30 "1st_Sensor_Supply_Voltage_DiaSig" 31 "2nd_Sensor_Supply_Voltage_DiaSig" 32 "3rd_Sensor_Supply_Voltage_DiaSig" 33 "4th_Sensor_Supply_Voltage_DiaSig" 34 "5th_Sensor_Supply_Voltage_DiaSig" 35 "6th_Sensor_Supply_Voltage_DiaSig" /end COMPU_VTAB
/begin COMPU_METHOD NumPinDioOut "Verbale Umrechnung für Digitalausgang Signale" TAB_VERB "%6.3" "-" COMPU_TAB_REF NumPinDioOut /end COMPU_METHOD
/begin COMPU_VTAB NumPinDioOut "Verbale Umrechnung für Digitalausgang Signale" TAB_VERB 12 0 "Main_Relay_220(144)" 1 "AC_Compressor" 2 "Fuel_Pump_232" 3 "Starter_234" 4 "OPS_Lamp_245" 5 "EBAF_123" 6 "Ebox_Fan_Actuator_219" 7 "Shuttr_Actuator_Digital_231" 8 "STATREG_PSOFF_Bit" 9 "Twostage_TurboLoading_120" 10 "TD_Signal_253" 11 "DIO_OUT_DUMMY_NOT_USED" /end COMPU_VTAB
/begin COMPU_METHOD NumPinPwmOut "Verbale Umrechnung für PWM-Ausgang Signale" TAB_VERB "%6.3" "-" COMPU_TAB_REF NumPinPwmOut /end COMPU_METHOD
/begin COMPU_VTAB NumPinPwmOut "Verbale Umrechnung für PWM-Ausgang Signale" TAB_VERB 14 0 "Boost_Pressure_Actuator_193" 1 "EGR_Actuator_194" 2 "PCV_Actuator_172" 3 "MeUn_Actuator_171" 4 "Variable_Swirl_Actuator_195" 5 "Fan_Actuator_240" 6 "Add_On_Heater_244" 7 "EngM_Bearing_Actuator_124" 8 "EngM_Bearing_Actuator_121" 9 "Throttle_Valve_196" 10 "LSU_Heater_PWMOutput" 11 "Low pressure stage BPA_117" 12 "Shuttr_Actuator_PWM_231" 13 "PWM_DUMMY_NOT_USED" /end COMPU_VTAB
/begin COMPU_METHOD OneToOne "eins zu eins (physikalischer Wert ist gleich dem internen Wert)" RAT_FUNC "%6.2" "-" COEFFS 0 1 0 0 0 1 /end COMPU_METHOD
/begin COMPU_METHOD Period "Periodendauer" RAT_FUNC "%6.3" "ms" COEFFS 0 10 0 0 0 1 /end COMPU_METHOD
/begin COMPU_METHOD Pres_hPa "Druck (angezeigt in [hPa])" RAT_FUNC "%6.2" "hPa" COEFFS 0 1 0 0 0 1 /end COMPU_METHOD
/begin COMPU_METHOD Pres_Rail "Raildruck in hPa" RAT_FUNC "%4.3" "bar" COEFFS 0 10.000000 0 0 0 1 /end COMPU_METHOD
/begin COMPU_METHOD Pwr "Leistung" RAT_FUNC "%6.2" "W" COEFFS 0 0.10610329539459 0 0 0 1 /end COMPU_METHOD
/begin COMPU_METHOD Pwr1 "Leistung mit Hoher Aufloesung" RAT_FUNC "%6.3" "W" COEFFS 0 10 0 0 0 1 /end COMPU_METHOD
/begin COMPU_METHOD Resist "Widerstand" RAT_FUNC "%6.3" "Ohm" COEFFS 0 10 0 0 0 1 /end COMPU_METHOD
/begin COMPU_METHOD ReynoldsNum "Reynolds Nummer um den thermischen Koeffizienten zu bestimmen" RAT_FUNC "%6.0" "-" COEFFS 0 0.01 0 0 0 1 /end COMPU_METHOD
/begin COMPU_METHOD RmpCurr "Current ramp gradient in [ mA/s ] for BPA Current Feedback" RAT_FUNC "%6.4" "mA/s" COEFFS 0 65.536 0 0 0 1 /end COMPU_METHOD
/begin COMPU_METHOD RmpTrq "Rampengradient für Motormoment" RAT_FUNC "%6.4" "Nm/s" COEFFS 0 655.36 0 0 0 1 /end COMPU_METHOD
/begin COMPU_METHOD SpecificHeat "spezifische Waermekapazitaet einer Substanz" RAT_FUNC "%7.6" "J/g/K" COEFFS 0 10000 0 0 0 1 /end COMPU_METHOD
/begin COMPU_METHOD TempDiff_Cels "difference/offset temperature displayed in degree celcius" RAT_FUNC "%6.3" "deg C" COEFFS 0 10 0 0 0 1 /end COMPU_METHOD
/begin COMPU_METHOD Temp_Cels "Temperatur dargestellt in °C (gleiche interne Darstellung wie Temp_Kelv)" RAT_FUNC "%6.1" "deg C" COEFFS 0 10 2731.4 0 0 1 /end COMPU_METHOD
/begin COMPU_METHOD Temp_Kelv_Sec "Temperaturaenderungsrate" RAT_FUNC "%6.4" "K/s" COEFFS 0 100 0 0 0 1 /end COMPU_METHOD
/begin COMPU_METHOD ThermalCoEff "Waermekoeffiziens einer Substanz" RAT_FUNC "%6.3" "W/m/m/K" COEFFS 0 10 0 0 0 1 /end COMPU_METHOD
/begin COMPU_METHOD TimeDeb "Entprellzeit in Millisekunden für Libraryfunktion Debounce" RAT_FUNC "%6.1" "ms" COEFFS 0 0.1 0 0 0 1 /end COMPU_METHOD
/begin COMPU_METHOD TimeDelay_s "Zeitkonstante T1 (in s) für PT1, DT1, etc." RAT_FUNC "%9.3" "s" COEFFS 0 0 1 0 0.00023283064365387 0 /end COMPU_METHOD
/begin COMPU_METHOD TimeDT "Abtastzeit (in us) für Library Regler, Filter, etc." RAT_FUNC "%6.2" "us" COEFFS 0 1 0 0 0 1 /end COMPU_METHOD
/begin COMPU_METHOD TimeEGTRmp "Umrechnung  Zeit in Rampensteigung,  Verwendet in EGT-Bibliothek" RAT_FUNC "%6.3" "s" COEFFS 0 0 1 0 0.0152587890625 0 /end COMPU_METHOD
/begin COMPU_METHOD TimeSys_us "Zeit in [us] mit Systemzeit-Auflösung" RAT_FUNC "%6.3" "us" COEFFS 0 3.4965 0 0 0 1 /end COMPU_METHOD
/begin COMPU_METHOD Time_ms "Zeit in ms für Fehlerentprellung (DSM) und SW-Timer" RAT_FUNC "%6.1" "ms" COEFFS 0 0.1 0 0 0 1 /end COMPU_METHOD
/begin COMPU_METHOD Time_s "Zeit in s für Fehlerentprellung (DSM) und SW-Timer" RAT_FUNC "%6.4" "s" COEFFS 0 100 0 0 0 1 /end COMPU_METHOD
/begin COMPU_METHOD Trq "Motormoment" RAT_FUNC "%6.3" "Nm" COEFFS 0 10 0 0 0 1 /end COMPU_METHOD
/begin COMPU_METHOD Vel "Fahrzeuggeschwindigkeit, gleiche interne Auflösung wie Vel_SI" RAT_FUNC "%6.4" "km/h" COEFFS 0 100 0 0 0 1 /end COMPU_METHOD
/begin COMPU_METHOD VelToN "Verhältnis Fahrzeuggeschwindigkeit zu Motordrehzahl v/n" RAT_FUNC "%8.7" "(km/h)/rpm" COEFFS 0 100000 0 0 0 1 /end COMPU_METHOD
/begin COMPU_METHOD Volt "Spannung in V (von ADC)" RAT_FUNC "%6.2" "mV" COEFFS 0 0.2046 0 0 0 1 /end COMPU_METHOD
/begin COMPU_METHOD Volt_Batt "Batteriespannung" RAT_FUNC "%6.1" "mV" COEFFS 0 0.05115 0 0 0 1 /end COMPU_METHOD
/begin COMPU_METHOD default "" RAT_FUNC "%6.2" "-" COEFFS 0 1 0 0 0 1 /end COMPU_METHOD
/begin RECORD_LAYOUT Kf_Xs16_Ys16_Ws16 NO_AXIS_PTS_X 1 SWORD NO_AXIS_PTS_Y 2 SWORD AXIS_PTS_X 3 SWORD INDEX_INCR DIRECT AXIS_PTS_Y 4 SWORD INDEX_INCR DIRECT FNC_VALUES 5 SWORD COLUMN_DIR DIRECT /end RECORD_LAYOUT
/begin RECORD_LAYOUT Kl_Xs16_Ws16 NO_AXIS_PTS_X 1 SWORD AXIS_PTS_X 2 SWORD INDEX_INCR DIRECT FNC_VALUES 3 SWORD COLUMN_DIR DIRECT /end RECORD_LAYOUT
/begin RECORD_LAYOUT Kwb_Ws16 FNC_VALUES 1 SWORD COLUMN_DIR DIRECT /end RECORD_LAYOUT
/begin RECORD_LAYOUT Kwb_Wu16 FNC_VALUES 1 UWORD COLUMN_DIR DIRECT /end RECORD_LAYOUT
/begin RECORD_LAYOUT Kwb_Wu8 FNC_VALUES 1 UBYTE COLUMN_DIR DIRECT /end RECORD_LAYOUT
/begin RECORD_LAYOUT Kw_Ws16 FNC_VALUES 1 SWORD COLUMN_DIR DIRECT /end RECORD_LAYOUT
/begin RECORD_LAYOUT Kw_Ws32 FNC_VALUES 1 SLONG COLUMN_DIR DIRECT /end RECORD_LAYOUT
/begin RECORD_LAYOUT Kw_Wu16 FNC_VALUES 1 UWORD COLUMN_DIR DIRECT /end RECORD_LAYOUT
/begin RECORD_LAYOUT Kw_Wu32 FNC_VALUES 1 ULONG COLUMN_DIR DIRECT /end RECORD_LAYOUT
/begin RECORD_LAYOUT Kw_Wu8 FNC_VALUES 1 UBYTE COLUMN_DIR DIRECT /end RECORD_LAYOUT
/end MODULE
/end PROJECT
