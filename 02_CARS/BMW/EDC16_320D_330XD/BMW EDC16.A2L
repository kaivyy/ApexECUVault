ASAP2_VERSION 1 3
/begin PROJECT P383 "BMW DDE6.3 8-Zylinder V9E.3 11.10.2004 CAN12H"
/begin HEADER "" VERSION "V9E.3_8Z_CAN12H" PROJECT_NO P383 /end HEADER
/begin MODULE DIM ""
/begin MOD_COMMON "" BYTE_ORDER MSB_FIRST ALIGNMENT_BYTE 1 ALIGNMENT_WORD 2 ALIGNMENT_LONG 4 ALIGNMENT_FLOAT32_IEEE 4 /end MOD_COMMON
/begin CHARACTERISTIC PCR_I1AdPCVKi_C "Grundwert der I-Verstaerkung des I-Reglers bei Kleinsignalen" VALUE 0xF00D4 Kw_Wu32 999999.999767 Ki 0.00 999999.999767 FORMAT "%13.6" /end CHARACTERISTIC
/begin CHARACTERISTIC PCR_I1AdPCVKiPos_C "Grundwert der I-Verstaerkung des I-Reglers bei positiven Grossesignalen" VALUE 0xF00D8 Kw_Wu32 999999.999767 Ki 0.00 999999.999767 FORMAT "%13.6" /end CHARACTERISTIC
/begin CHARACTERISTIC PCR_I1AdPCVKiNeg_C "Grundwert der I-Verstaerkung des I-Reglers bei negativen Grossesignalen" VALUE 0xF00DC Kw_Wu32 999999.999767 Ki 0.00 999999.999767 FORMAT "%13.6" /end CHARACTERISTIC
/begin CHARACTERISTIC PCR_rI1AdPCVWinPos_C "obere Kleinsignalgrenze des I-Reglers" VALUE 0xF00E0 Kw_Ws16 799.9878 Prc -400.0000 399.9878 FORMAT "%8.4" /end CHARACTERISTIC
/begin CHARACTERISTIC PCR_rI1AdPCVWinNeg_C "untere Kleinsignalgrenze des I-Reglers" VALUE 0xF00E2 Kw_Ws16 799.9878 Prc -400.0000 399.9878 FORMAT "%8.4" /end CHARACTERISTIC
/begin CHARACTERISTIC PCR_I2AdPCVKi_C "Grundwert der I-Verstaerkung des I-Reglers bei Kleinsignalen" VALUE 0xF00E4 Kw_Wu32 999999.999767 Ki 0.00 999999.999767 FORMAT "%13.6" /end CHARACTERISTIC
/begin CHARACTERISTIC PCR_I2AdPCVKiPos_C "Grundwert der I-Verstaerkung des I-Reglers bei positiven Grossesignalen" VALUE 0xF00E8 Kw_Wu32 999999.999767 Ki 0.00 999999.999767 FORMAT "%13.6" /end CHARACTERISTIC
/begin CHARACTERISTIC PCR_I2AdPCVKiNeg_C "Grundwert der I-Verstaerkung des I-Reglers bei negativen Grossesignalen" VALUE 0xF00EC Kw_Wu32 999999.999767 Ki 0.00 999999.999767 FORMAT "%13.6" /end CHARACTERISTIC
/begin CHARACTERISTIC PCR_rI2AdPCVWinPos_C "obere Kleinsignalgrenze des I-Reglers" VALUE 0xF00F0 Kw_Ws16 799.9878 Prc -400.0000 399.9878 FORMAT "%8.4" /end CHARACTERISTIC
/begin CHARACTERISTIC PCR_rI2AdPCVWinNeg_C "untere Kleinsignalgrenze des I-Reglers" VALUE 0xF00F2 Kw_Ws16 799.9878 Prc -400.0000 399.9878 FORMAT "%8.4" /end CHARACTERISTIC
/begin CHARACTERISTIC PCR_I3AdPCVKi_C "Grundwert der I-Verstaerkung des I-Reglers bei Kleinsignalen" VALUE 0xF00F4 Kw_Wu32 999999.999767 Ki 0.00 999999.999767 FORMAT "%13.6" /end CHARACTERISTIC
/begin CHARACTERISTIC PCR_I3AdPCVKiPos_C "Grundwert der I-Verstaerkung des I-Reglers bei positiven Grossesignalen" VALUE 0xF00F8 Kw_Wu32 999999.999767 Ki 0.00 999999.999767 FORMAT "%13.6" /end CHARACTERISTIC
/begin CHARACTERISTIC PCR_I3AdPCVKiNeg_C "Grundwert der I-Verstaerkung des I-Reglers bei negativen Grossesignalen" VALUE 0xF00FC Kw_Wu32 999999.999767 Ki 0.00 999999.999767 FORMAT "%13.6" /end CHARACTERISTIC
/begin CHARACTERISTIC PCR_rI3AdPCVWinPos_C "obere Kleinsignalgrenze des I-Reglers" VALUE 0xF0100 Kw_Ws16 799.9878 Prc -400.0000 399.9878 FORMAT "%8.4" /end CHARACTERISTIC
/begin CHARACTERISTIC PCR_rI3AdPCVWinNeg_C "untere Kleinsignalgrenze des I-Reglers" VALUE 0xF0102 Kw_Ws16 799.9878 Prc -400.0000 399.9878 FORMAT "%8.4" /end CHARACTERISTIC
/begin CHARACTERISTIC PCR_I4AdPCVKi_C "Grundwert der I-Verstaerkung des I-Reglers bei Kleinsignalen" VALUE 0xF0104 Kw_Wu32 999999.999767 Ki 0.00 999999.999767 FORMAT "%13.6" /end CHARACTERISTIC
/begin CHARACTERISTIC PCR_I4AdPCVKiPos_C "Grundwert der I-Verstaerkung des I-Reglers bei positiven Grossesignalen" VALUE 0xF0108 Kw_Wu32 999999.999767 Ki 0.00 999999.999767 FORMAT "%13.6" /end CHARACTERISTIC
/begin CHARACTERISTIC PCR_I4AdPCVKiNeg_C "Grundwert der I-Verstaerkung des I-Reglers bei negativen Grossesignalen" VALUE 0xF010C Kw_Wu32 999999.999767 Ki 0.00 999999.999767 FORMAT "%13.6" /end CHARACTERISTIC
/begin CHARACTERISTIC PCR_rI4AdPCVWinPos_C "obere Kleinsignalgrenze des I-Reglers" VALUE 0xF0110 Kw_Ws16 799.9878 Prc -400.0000 399.9878 FORMAT "%8.4" /end CHARACTERISTIC
/begin CHARACTERISTIC PCR_rI4AdPCVWinNeg_C "untere Kleinsignalgrenze des I-Reglers" VALUE 0xF0112 Kw_Ws16 799.9878 Prc -400.0000 399.9878 FORMAT "%8.4" /end CHARACTERISTIC
/begin CHARACTERISTIC PCR_tiDT1DesCld_C "Verzögerungszeitkonstante der dynamischen Sollwertbildung bei kaltem Motor" VALUE 0xEF5AC Kw_Wu32 4294.9663 TimeDelay_s 0.0010000001 4294.9673 FORMAT "%9.4" EXTENDED_LIMITS 0.0000010000000 4294.9673 /end CHARACTERISTIC
/begin CHARACTERISTIC PCR_DKdDesCld_C "Kleinsignalverstärkung der dynamischen Sollwertbildung bei kaltem Motor" VALUE 0xEF5B0 Kw_Ws32 65535.9999847 Kd -32768.0000000 32767.9999847 FORMAT "%13.7" /end CHARACTERISTIC
/begin CHARACTERISTIC PCR_DKdPosDesCld_C "Positive Großsignalverstärkung der dynamischen Sollwertbildung bei kaltem Motor" VALUE 0xEF5B4 Kw_Ws32 65535.9999847 Kd -32768.0000000 32767.9999847 FORMAT "%13.7" /end CHARACTERISTIC
/begin CHARACTERISTIC PCR_DKdNegDesCld_C "Negative Großsignalverstärkung der dynamischen Sollwertbildung bei kaltem Motor" VALUE 0xEF5B8 Kw_Ws32 65535.9999847 Kd -32768.0000000 32767.9999847 FORMAT "%13.7" /end CHARACTERISTIC
/begin CHARACTERISTIC PCR_dpDWinPosDesCld_C "Positive Kleinsignalgrenze bei kaltem Motor" VALUE 0xEF5BC Kw_Ws16 65535.00 Pres_hPa -32768.00 32767.00 FORMAT "%8.2" /end CHARACTERISTIC
/begin CHARACTERISTIC PCR_dpDWinNegDesCld_C "Negative Kleinsignalgrenze bei kaltem Motor" VALUE 0xEF5BE Kw_Ws16 65535.00 Pres_hPa -32768.00 32767.00 FORMAT "%8.2" /end CHARACTERISTIC
/begin CHARACTERISTIC PCR_ctAirPerTimeFrq_C "Anzahl der Abtastungen der erfassten Frischluftmasse für die diskrete Fouriertransformation" VALUE 0xF27B8 Kw_Wu8 9.000 OneToOne 1.000 10.00 FORMAT "%5.2" EXTENDED_LIMITS 0.00 255.0 /end CHARACTERISTIC
/begin CHARACTERISTIC PCR_DebLPDvtNegDef_C "Vorentprellzeit für Erkennung negativer bleibender Regelabw." VALUE 0xF20E8 Kw_Wu16 655350.0 Time_ms 0.00 655350.0 FORMAT "%8.1" /end CHARACTERISTIC
/begin CHARACTERISTIC PCR_DebLPDvtNegOk_C "Vorentprellzeit für Heilung bei negativer bleibender Regelabw." VALUE 0xF20EA Kw_Wu16 655350.0 Time_ms 0.00 655350.0 FORMAT "%8.1" /end CHARACTERISTIC
/begin CHARACTERISTIC PCR_DebLPDvtPosDef_C "Vorentprellzeit für Erkennung positiver bleibender Regelabw." VALUE 0xF20EC Kw_Wu16 655350.0 Time_ms 0.00 655350.0 FORMAT "%8.1" /end CHARACTERISTIC
/begin CHARACTERISTIC PCR_DebLPDvtPosOk_C "Vorentprellzeit für Heilung bei positiver bleibender Regelabw." VALUE 0xF20EE Kw_Wu16 655350.0 Time_ms 0.00 655350.0 FORMAT "%8.1" /end CHARACTERISTIC
/begin CHARACTERISTIC PCR_DebSRCHighDef_C "Defektzeit SRC-high" VALUE 0xF2210 Kw_Wu16 655350.0 Time_ms 0.00 655350.0 FORMAT "%8.1" /end CHARACTERISTIC
/begin CHARACTERISTIC PCR_DebSRCHighOk_C "Heilungszeit SRC-high" VALUE 0xF2212 Kw_Wu16 655350.0 Time_ms 0.00 655350.0 FORMAT "%8.1" /end CHARACTERISTIC
/begin CHARACTERISTIC PCR_DebSRCLowDef_C "Defektzeit SRC-low" VALUE 0xF2214 Kw_Wu16 655350.0 Time_ms 0.00 655350.0 FORMAT "%8.1" /end CHARACTERISTIC
/begin CHARACTERISTIC PCR_DebSRCLowOk_C "Heilungszeit SRC-low" VALUE 0xF2216 Kw_Wu16 655350.0 Time_ms 0.00 655350.0 FORMAT "%8.1" /end CHARACTERISTIC
/begin CHARACTERISTIC PCR_dlyPT1_C "Zeitkonstante der Sollwertverzögerung für I-Anteil" VALUE 0xF0114 Kw_Wu32 4294.9663 TimeDelay_s 0.0010000001 4294.9673 FORMAT "%9.4" EXTENDED_LIMITS 0.0000010000000 4294.9673 /end CHARACTERISTIC
/begin CHARACTERISTIC PCR_dnAvrgAdPCVLim_C "Maximale Grenze fuer Motordrehzahl Beschleunigung" VALUE 0xF0118 Kw_Ws16 655350.0 dn_dZ20 -327680.0 327670.0 FORMAT "%8.1" /end CHARACTERISTIC
/begin CHARACTERISTIC PCR_tiDnCorrDT1_C "Time delay for DT1 (engine-speed gradient calculation)" VALUE 0xF011C Kw_Wu32 4294.9673 TimeDelay_s 0.0000010000000 4294.9673 FORMAT "%9.4" /end CHARACTERISTIC
/begin CHARACTERISTIC PCR_DnCorrDKd_C "Gain for DT1 (engine-speed gradient calculation)" VALUE 0xF0120 Kw_Ws32 32767.9999924 Kd_rpm2dndt -16384.0000000 16383.9999924 FORMAT "%13.7" /end CHARACTERISTIC
/begin CHARACTERISTIC PCR_dnSurgeCtlRel_C "Max. Limit für Drehzahlbeschl. bei Erkennung gleicher Status" VALUE 0xF24E0 Kw_Ws16 655350.0 dn_dZ20 -327680.0 327670.0 FORMAT "%8.1" /end CHARACTERISTIC
/begin CHARACTERISTIC PCR_dpBDes_C "Derivative of desired boost pressure" VALUE 0xEF5C0 Kw_Ws16 8000.000 dp_dZ20 -4000.000 4000.000 FORMAT "%8.3" EXTENDED_LIMITS -327680.0 327670.0 /end CHARACTERISTIC
/begin CHARACTERISTIC PCR_tiDpCorrDT1_C "Zeitverzögerung für die D-Parameterkorrektur aus dem Ladedruckgradienten" VALUE 0xF0124 Kw_Wu32 4294.9673 TimeDelay_s 0.0000010000000 4294.9673 FORMAT "%9.4" /end CHARACTERISTIC
/begin CHARACTERISTIC PCR_dpCorrDKd_C "Faktor für D-Parameter Korrektur generiert aus dem Ladedruckgradient" VALUE 0xF0128 Kw_Ws32 32767.9999924 Kd_Pres2dpdt -16384.0000000 16383.9999924 FORMAT "%13.7" /end CHARACTERISTIC
/begin CHARACTERISTIC PCR_dpSlpLimDwn_C "Down slope" VALUE 0xEF5C4 Kw_Wu32 65535949.9817 RmpPres_hPa 50.0030517578 65535999.9847 FORMAT "%13.4" EXTENDED_LIMITS 0.00 65535999.9847 /end CHARACTERISTIC
/begin CHARACTERISTIC PCR_dpSlpLimUp_C "Up slope" VALUE 0xEF5C8 Kw_Wu32 65535949.9817 RmpPres_hPa 50.0030517578 65535999.9847 FORMAT "%13.4" EXTENDED_LIMITS 0.00 65535999.9847 /end CHARACTERISTIC
/begin CHARACTERISTIC PCR_dpSurgeCtlRmpUp_C "Anti Surge Rampensteigung AUF" VALUE 0xF24E4 Kw_Wu32 65535999.9847 RmpPres_hPa 0.00 65535999.9847 FORMAT "%13.4" /end CHARACTERISTIC
/begin CHARACTERISTIC PCR_dpSurgeCtlRmpDwn_C "Anti Surge Rampensteigung AB" VALUE 0xF24E8 Kw_Wu32 65535999.9847 RmpPres_hPa 0.00 65535999.9847 FORMAT "%13.4" /end CHARACTERISTIC
/begin CHARACTERISTIC PCR_dqCtlAdPCVLim_C "Maximale Grenze fuer Einspritzmenge" VALUE 0xF012C Kw_Ws16 32767.50 InjMassPerSec_20ms -16384.00 16383.50 FORMAT "%8.2" /end CHARACTERISTIC
/begin CHARACTERISTIC PCR_tiAdPCVqCtlDT1_C "Zeitkonstante T1 des PT1-Filters im DT1-Filter" VALUE 0xF0130 Kw_Wu32 4294.9663 TimeDelay_s 0.0010000001 4294.9673 FORMAT "%9.4" EXTENDED_LIMITS 0.0000010000000 4294.9673 /end CHARACTERISTIC
/begin CHARACTERISTIC PCR_DKdAdPCVqCtlDT1_C "Differentiationsfaktor Kd (fuer Kd=0.02 gilt y(k)=exp(-Ts/T1)*y(k-1)+(x(k)-x(k-1)))" VALUE 0xF0134 Kw_Ws32 10.0000000000 Kd 0.00 10.0000000000 FORMAT "%13.10" EXTENDED_LIMITS -32768.0000000 32767.9999847 /end CHARACTERISTIC
/begin CHARACTERISTIC PCR_dqDes_C "Application constant for derivative of desired fuel quantity" VALUE 0xEF5CC Kw_Ws16 200.0000 InjMassPerSec_20ms 0.00 200.0000 FORMAT "%8.4" EXTENDED_LIMITS -16384.00 16383.50 /end CHARACTERISTIC
/begin CHARACTERISTIC PCR_dqSurgeCtlRel_C "Max. Limit für Einspritzmengengradienten bei Erkennung gleicher Status" VALUE 0xF24EC Kw_Ws16 32767.50 InjMassPerSec_20ms -16384.00 16383.50 FORMAT "%8.2" /end CHARACTERISTIC
/begin CHARACTERISTIC PCR_drAdPCVCtlRmpUp_C "Rampensteigung (steigend) für Ausgabewert der adaptiven Vorsteuerung" VALUE 0xF0138 Kw_Wu32 799998.699874 RmpPrc 1.29994004965 799999.999814 FORMAT "%13.6" EXTENDED_LIMITS 0.00 799999.999814 /end CHARACTERISTIC
/begin CHARACTERISTIC PCR_drAdPCVCtlRmpDwn_C "Rampensteigung (fallend) für Ausgabewert der adaptiven Vorsteuerung" VALUE 0xF013C Kw_Wu32 799998.699874 RmpPrc 1.29994004965 799999.999814 FORMAT "%13.6" EXTENDED_LIMITS 0.00 799999.999814 /end CHARACTERISTIC
/begin CHARACTERISTIC PCR_drAPP1UnFlt_C "Application constant for ratio of Accelerator pedal 1 position unfiltered value" VALUE 0xEF5CE Kw_Ws16 100.0977 PrcPerSec 0.00 100.0977 FORMAT "%8.4" EXTENDED_LIMITS -20000.00 19999.39 /end CHARACTERISTIC
/begin CHARACTERISTIC PCR_drBPALPRmpUp_C "Positive Rampensteigung" VALUE 0xF0B14 Kw_Wu32 799999.999814 RmpPrc 0.00 799999.999814 FORMAT "%13.6" /end CHARACTERISTIC
/begin CHARACTERISTIC PCR_drBPALPRmpDwn_C "Negative Rampensteigung" VALUE 0xF0B18 Kw_Wu32 799999.999814 RmpPrc 0.00 799999.999814 FORMAT "%13.6" /end CHARACTERISTIC
/begin CHARACTERISTIC PCR_drBPGovMaxDynUp_C "Rate of increase of dynamic correction for maximum allowable PCR governor output" VALUE 0xF0140 Kw_Wu32 100.000016391 RmpPrc 0.00 100.000016391 FORMAT "%13.9" EXTENDED_LIMITS 0.00 799999.999814 /end CHARACTERISTIC
/begin CHARACTERISTIC PCR_drBPGovMaxDynDn_C "Rate of decrease of dynamic correction for maximum allowable PCR governor output" VALUE 0xF0144 Kw_Wu32 100.000016391 RmpPrc 0.00 100.000016391 FORMAT "%13.9" EXTENDED_LIMITS 0.00 799999.999814 /end CHARACTERISTIC
/begin CHARACTERISTIC PCR_drPIRmpUp_C "ositive Rampsteigung für PI Anteil" VALUE 0xF0148 Kw_Wu32 799998.699874 RmpPrc 1.29994004965 799999.999814 FORMAT "%13.6" EXTENDED_LIMITS 0.00 799999.999814 /end CHARACTERISTIC
/begin CHARACTERISTIC PCR_drPIRmpDwn_C "Negative Rampsteigung für PI Anteil" VALUE 0xF014C Kw_Wu32 799998.699874 RmpPrc 1.29994004965 799999.999814 FORMAT "%13.6" EXTENDED_LIMITS 0.00 799999.999814 /end CHARACTERISTIC
/begin CHARACTERISTIC PCR_drSurgeCtlRmpUp_C "Anti Surge Rampensteigung AUF" VALUE 0xF24F0 Kw_Wu32 799999.999814 RmpPrc 0.00 799999.999814 FORMAT "%13.6" /end CHARACTERISTIC
/begin CHARACTERISTIC PCR_drSurgeCtlRmpDwn_C "Anti Surge Rampensteigung AB" VALUE 0xF24F4 Kw_Wu32 799999.999814 RmpPrc 0.00 799999.999814 FORMAT "%13.6" /end CHARACTERISTIC
/begin CHARACTERISTIC PCR_tiBDesRaw_C "Reciprocal of time delay" VALUE 0xEF5D0 Kw_Wu32 4294.9663 TimeDelay_s 0.0010000001 4294.9673 FORMAT "%9.4" EXTENDED_LIMITS 0.0000010000000 4294.9673 /end CHARACTERISTIC
/begin CHARACTERISTIC PCR_dpBDesRaw_C "Differentialer Faktor" VALUE 0xEF5D4 Kw_Ws32 8000.00000000 Kd_Pres2dpdt -4000.00000000 4000.00000000 FORMAT "%13.8" EXTENDED_LIMITS -16384.0000000 16383.9999924 /end CHARACTERISTIC
/begin CHARACTERISTIC PCR_tiDT1qDes_C "Time delay factor for the DT1 filter for desired fuel quantity" VALUE 0xEF5D8 Kw_Wu32 4294.9663 TimeDelay_s 0.0010000001 4294.9673 FORMAT "%9.4" EXTENDED_LIMITS 0.0000010000000 4294.9673 /end CHARACTERISTIC
/begin CHARACTERISTIC PCR_DKdqDes_C "Differential factor for DT1 filter for desired fuel quantity" VALUE 0xEF5DC Kw_Ws32 10.0000000000 Kd 0.00 10.0000000000 FORMAT "%13.10" EXTENDED_LIMITS -32768.0000000 32767.9999847 /end CHARACTERISTIC
/begin CHARACTERISTIC PCR_tiDT1rAPP1_C "time delay for DT1 filter for Accelerator pedal 1 position" VALUE 0xEF5E0 Kw_Wu32 4294.9663 TimeDelay_s 0.0010000001 4294.9673 FORMAT "%9.4" EXTENDED_LIMITS 0.0000010000000 4294.9673 /end CHARACTERISTIC
/begin CHARACTERISTIC PCR_DKdrAPP1_C "Derivative factor for DT1 Filter for Accelerator pedal 1 position" VALUE 0xEF5E4 Kw_Ws32 10.0000000000 Kd 0.00 10.0000000000 FORMAT "%13.10" EXTENDED_LIMITS -32768.0000000 32767.9999847 /end CHARACTERISTIC
/begin CHARACTERISTIC PCR_tiDT1LP_C "Verzoegerungszeitkonstante fuer das DT1-Glied des PIDT1-Reglers" VALUE 0xF0B1C Kw_Wu32 4294.9663 TimeDelay_s 0.0010000001 4294.9673 FORMAT "%9.4" EXTENDED_LIMITS 0.0000010000000 4294.9673 /end CHARACTERISTIC
/begin CHARACTERISTIC PCR_DKdLP_C "Grundwert der D-Verstaerkung des PIDT1-Reglers bei Kleinsignalen" VALUE 0xF0B20 Kw_Ws32 9.99999996275 Kd_Pres_hPa2Prc 0.00 9.99999996275 FORMAT "%13.10" EXTENDED_LIMITS -400.000000000 399.999999814 /end CHARACTERISTIC
/begin CHARACTERISTIC PCR_DKdPosLP_C "Grundwert der D-Verstaerkung des PIDT1-Reglers bei positiven Groszsignalen" VALUE 0xF0B24 Kw_Ws32 9.99999996275 Kd_Pres_hPa2Prc 0.00 9.99999996275 FORMAT "%13.10" EXTENDED_LIMITS -400.000000000 399.999999814 /end CHARACTERISTIC
/begin CHARACTERISTIC PCR_DKdNegLP_C "Grundwert der  D-Verstaerkung des PIDT1-Reglers bei negativen Groszsignalen" VALUE 0xF0B28 Kw_Ws32 9.99999996275 Kd_Pres_hPa2Prc 0.00 9.99999996275 FORMAT "%13.10" EXTENDED_LIMITS -400.000000000 399.999999814 /end CHARACTERISTIC
/begin CHARACTERISTIC PCR_pDWinPosLP_C "obere Kleinsignalgrenze fuer das I-Glied des PIDT1-Reglers" VALUE 0xF0B2C Kw_Ws16 10000.00 Pres_hPa -5000.000 5000.000 FORMAT "%8.3" EXTENDED_LIMITS -32768.00 32767.00 /end CHARACTERISTIC
/begin CHARACTERISTIC PCR_pDWinNegLP_C "untere Kleinsignalgrenze fuer das DT1-Glied des PIDT1-Reglers" VALUE 0xF0B2E Kw_Ws16 10000.00 Pres_hPa -5000.000 5000.000 FORMAT "%8.3" EXTENDED_LIMITS -32768.00 32767.00 /end CHARACTERISTIC
/begin CHARACTERISTIC PCR_DT1_C "Verzögerungszeitkonstante für das DT1-Glied des PIDT1-Reglers" VALUE 0xF0150 Kw_Wu32 4294.9663 TimeDelay_s 0.0010000001 4294.9673 FORMAT "%9.4" EXTENDED_LIMITS 0.0000010000000 4294.9673 /end CHARACTERISTIC
/begin CHARACTERISTIC PCR_DKd_C "Grundwert der D-Verstärkung des PIDT1-Reglers bei Kleinsignalen" VALUE 0xF0154 Kw_Ws32 9.99999996275 Kd_Pres_hPa2Prc 0.00 9.99999996275 FORMAT "%13.10" EXTENDED_LIMITS -400.000000000 399.999999814 /end CHARACTERISTIC
/begin CHARACTERISTIC PCR_DKdPos_C "Grundwert der D-Verstärkung des PIDT1-Reglers bei positiven Großssignalen" VALUE 0xF0158 Kw_Ws32 9.99999996275 Kd_Pres_hPa2Prc 0.00 9.99999996275 FORMAT "%13.10" EXTENDED_LIMITS -400.000000000 399.999999814 /end CHARACTERISTIC
/begin CHARACTERISTIC PCR_DKdNeg_C "Grundwert der D-Verstärkung des PIDT1-Reglers bei negativen Großsignalen" VALUE 0xF015C Kw_Ws32 9.99999996275 Kd_Pres_hPa2Prc 0.00 9.99999996275 FORMAT "%13.10" EXTENDED_LIMITS -400.000000000 399.999999814 /end CHARACTERISTIC
/begin CHARACTERISTIC PCR_pDWinPos_C "Obere Kleinsignalgrenze für das DT1-Glied des PIDT1-Reglers" VALUE 0xF0160 Kw_Ws16 10000.00 Pres_hPa -5000.000 5000.000 FORMAT "%8.3" EXTENDED_LIMITS -32768.00 32767.00 /end CHARACTERISTIC
/begin CHARACTERISTIC PCR_pDWinNeg_C "Untere Kleinsignalgrenze für das DT1-Glied des PIDT1-Reglers" VALUE 0xF0162 Kw_Ws16 10000.00 Pres_hPa -5000.000 5000.000 FORMAT "%8.3" EXTENDED_LIMITS -32768.00 32767.00 /end CHARACTERISTIC
/begin CHARACTERISTIC PCR_facAirPerTimeAmplMax_C "Obere Grenzwert für die Turboladerpumpgrenzerkennung" VALUE 0xF27BA Kw_Ws16 2047.938 FactM 0.00 2047.938 FORMAT "%8.3" EXTENDED_LIMITS -2048.000 2047.938 /end CHARACTERISTIC
/begin CHARACTERISTIC PCR_facAirPerTimeAmplMin_C "Untere Grenzwert für die Turboladerpumpgrenzerkennung" VALUE 0xF27BC Kw_Ws16 2047.938 FactM 0.00 2047.938 FORMAT "%8.3" EXTENDED_LIMITS -2048.000 2047.938 /end CHARACTERISTIC
/begin CHARACTERISTIC PCR_facATRgn_CUR "Kennlinie für lufttemperaturabhängigen Korrekturwert bei Regenerationsbetrieb" CURVE 0xEF5E8 Kl_Xs16_Ws16 3.000000 Fact 0.00 3.000000 FORMAT "%8.6" EXTENDED_LIMITS -4.000000 3.999878
 /begin AXIS_DESCR STD_AXIS IATSCD_tAir Temp_Cels 6 -50.14000 199.8600 FORMAT "%8.4" EXTENDED_LIMITS -3549.940 3003.560 DEPOSIT ABSOLUTE /end AXIS_DESCR
/end CHARACTERISTIC
/begin CHARACTERISTIC PCR_facBPGovMaxCorr_CUR "Correction factor(MAX)of D-parameter according to engine speed and particle filter soot mass" CURVE 0xF0164 Kl_Xs16_Ws16 5.000000 Fact1 0.00 5.000000 FORMAT "%8.6" EXTENDED_LIMITS -256.0000 255.9922
 /begin AXIS_DESCR STD_AXIS PFlt_resFlowRaw Res_hPaHrPerCM 8 0.00 25.00000 FORMAT "%8.5" EXTENDED_LIMITS -32.76800 32.76700 DEPOSIT ABSOLUTE /end AXIS_DESCR
/end CHARACTERISTIC
/begin CHARACTERISTIC PCR_facCnv_CUR "Kennlinie zur Amplitudenhöhe der oszillierenden Frischluftmasse beim Laderpumpen" CURVE 0xF27BE Kl_Xs16_Ws16 1.000000 FactM 0.00 1.000000 FORMAT "%8.6" EXTENDED_LIMITS -2048.000 2047.938
 /begin AXIS_DESCR STD_AXIS PCR_facAirPerTimeAmplFlt_mp FactM 10 -2048.000 2047.938 FORMAT "%8.3" DEPOSIT ABSOLUTE /end AXIS_DESCR
/end CHARACTERISTIC
/begin CHARACTERISTIC PCR_facCtQ_MAP "Kennfeld für Kühlwassertemperaturkorrekturfaktor de Sollwertberechnung" MAP 0xEF602 Kf_Xs16_Ys16_Ws16 7.999878 Fact -4.000000 3.999878 FORMAT "%8.6"
 /begin AXIS_DESCR STD_AXIS CTSCD_tClnt Temp_Cels 2 -50.1400 199.8600 FORMAT "%8.4" EXTENDED_LIMITS -3549.940 3003.560 DEPOSIT ABSOLUTE /end AXIS_DESCR
 /begin AXIS_DESCR STD_AXIS PCR_qDes InjMass 2 0.00 200.0000 FORMAT "%8.4" EXTENDED_LIMITS -327.6800 327.6700 DEPOSIT ABSOLUTE /end AXIS_DESCR
/end CHARACTERISTIC
/begin CHARACTERISTIC PCR_facDnCorr_CUR "Curve for Correction factor based on the engine-speed gradient" CURVE 0xF0186 Kl_Xs16_Ws16 511.9922 Fact1 -256.0000 255.9922 FORMAT "%8.4"
 /begin AXIS_DESCR STD_AXIS PCR_dn_mp dn_dZ20 6 -6000.000 6000.000 FORMAT "%8.3" EXTENDED_LIMITS -327680.0 327670.0 DEPOSIT ABSOLUTE /end AXIS_DESCR
/end CHARACTERISTIC
/begin CHARACTERISTIC PCR_facDpCorr_CUR "Korrekturfaktor für D-Parameter Korrektur aus dem Ladedruckgradienten" CURVE 0xF01A0 Kl_Xs16_Ws16 511.9922 Fact1 -256.0000 255.9922 FORMAT "%8.4"
 /begin AXIS_DESCR STD_AXIS PCR_dpBGDev_mp dp_dZ20 8 -350000.0 350000.0 FORMAT "%8.1" EXTENDED_LIMITS -327680.0 327670.0 DEPOSIT ABSOLUTE /end AXIS_DESCR
/end CHARACTERISTIC
/begin CHARACTERISTIC PCR_facD_MAP "Kennfeld für Adaptionsfaktor der D-Verstärkung" MAP 0xF01C2 Kf_Xs16_Ys16_Ws16 50.00000 Fact1 0.00 50.00000 FORMAT "%8.5" EXTENDED_LIMITS -256.0000 255.9922
 /begin AXIS_DESCR STD_AXIS Eng_nAvrg EngN 10 0.00 8000.000 FORMAT "%8.3" EXTENDED_LIMITS -32768.00 32767.00 DEPOSIT ABSOLUTE /end AXIS_DESCR
 /begin AXIS_DESCR STD_AXIS InjCtl_qCurr InjMassCyc 4 0.00 200.0000 FORMAT "%8.4" EXTENDED_LIMITS -327.6800 327.6700 DEPOSIT ABSOLUTE /end AXIS_DESCR
/end CHARACTERISTIC
/begin CHARACTERISTIC PCR_facIAT_CUR "Lufttemperaturabhängiger Faktor für Sollwertbildung" CURVE 0xEF616 Kl_Xs16_Ws16 3.000000 Fact 0.00 3.000000 FORMAT "%8.6" EXTENDED_LIMITS -4.000000 3.999878
 /begin AXIS_DESCR STD_AXIS CTSCD_tClnt Temp_Cels 6 -50.14000 199.8600 FORMAT "%8.4" EXTENDED_LIMITS -3549.940 3003.560 DEPOSIT ABSOLUTE /end AXIS_DESCR
/end CHARACTERISTIC
/begin CHARACTERISTIC PCR_facI_MAP "Kennfeld für Adaptionsfaktor der I-Verstärkung" MAP 0xF0232 Kf_Xs16_Ys16_Ws16 50.00000 Fact1 0.00 50.00000 FORMAT "%8.5" EXTENDED_LIMITS -256.0000 255.9922
 /begin AXIS_DESCR STD_AXIS Eng_nAvrg EngN 10 0.00 8000.000 FORMAT "%8.3" EXTENDED_LIMITS -32768.00 32767.00 DEPOSIT ABSOLUTE /end AXIS_DESCR
 /begin AXIS_DESCR STD_AXIS InjCtl_qCurr InjMassCyc 4 0.00 200.0000 FORMAT "%8.4" EXTENDED_LIMITS -327.6800 327.6700 DEPOSIT ABSOLUTE /end AXIS_DESCR
/end CHARACTERISTIC
/begin CHARACTERISTIC PCR_facN_CUR "Gewichtungsfaktor über Drehzahl für Athmosphärendruckkorrektur" CURVE 0xEF630 Kl_Xs16_Ws16 1.000000 Fact 0.00 1.000000 FORMAT "%8.6" EXTENDED_LIMITS -4.000000 3.999878
 /begin AXIS_DESCR STD_AXIS Eng_nAvrg EngN 6 0.00 6000.000 FORMAT "%8.3" EXTENDED_LIMITS -32768.00 32767.00 DEPOSIT ABSOLUTE /end AXIS_DESCR
/end CHARACTERISTIC
/begin CHARACTERISTIC PCR_facP_MAP "Kennfeld für Adaptionsfaktor der P-Verstärkung" MAP 0xF02A2 Kf_Xs16_Ys16_Ws16 50.00000 Fact1 0.00 50.00000 FORMAT "%8.5" EXTENDED_LIMITS -256.0000 255.9922
 /begin AXIS_DESCR STD_AXIS Eng_nAvrg EngN 10 0.00 8000.000 FORMAT "%8.3" EXTENDED_LIMITS -32768.00 32767.00 DEPOSIT ABSOLUTE /end AXIS_DESCR
 /begin AXIS_DESCR STD_AXIS InjCtl_qCurr InjMassCyc 4 0.00 200.0000 FORMAT "%8.4" EXTENDED_LIMITS -327.6800 327.6700 DEPOSIT ABSOLUTE /end AXIS_DESCR
/end CHARACTERISTIC
/begin CHARACTERISTIC PCR_facresFlowRawCorr_MAP "Regler D-Parameter Korrektur über Drehzahl und CSF Stroemungswiderstand" MAP 0xF0312 Kf_Xs16_Ys16_Ws16 5.000000 Fact1 0.00 5.000000 FORMAT "%8.6" EXTENDED_LIMITS -256.0000 255.9922
 /begin AXIS_DESCR STD_AXIS Eng_nAvrg EngN 10 0.00 8000.000 FORMAT "%8.3" EXTENDED_LIMITS -32768.00 32767.00 DEPOSIT ABSOLUTE /end AXIS_DESCR
 /begin AXIS_DESCR STD_AXIS PFlt_resFlowRaw Res_hPaHrPerCM 8 0.00 25.00000 FORMAT "%8.5" EXTENDED_LIMITS -32.76800 32.76700 DEPOSIT ABSOLUTE /end AXIS_DESCR
/end CHARACTERISTIC
/begin CHARACTERISTIC PCR_facSin_CUR "Sinusfunktion als Kennlinie" CURVE 0xF27E8 Kl_Xs16_Ws16 1.000000 Fact 0.00 1.000000 FORMAT "%8.6" EXTENDED_LIMITS -4.000000 3.999878 READ_ONLY
 /begin AXIS_DESCR STD_AXIS PCR_facSinIn_mp Fact1 11 -256.0000 255.9922 FORMAT "%8.4" DEPOSIT ABSOLUTE /end AXIS_DESCR
/end CHARACTERISTIC
/begin CHARACTERISTIC PCR_facSqr_CUR "Quadratwurzelfunktion als Kennlinie" CURVE 0xF2816 Kl_Xs16_Ws16 2047.938 FactM 0.00 2047.938 FORMAT "%8.3" EXTENDED_LIMITS -2048.000 2047.938 READ_ONLY
 /begin AXIS_DESCR STD_AXIS PCR_facSqrIn_mp FactM 19 0.00 2047.938 FORMAT "%8.3" EXTENDED_LIMITS -2048.000 2047.938 DEPOSIT ABSOLUTE /end AXIS_DESCR
/end CHARACTERISTIC
/begin CHARACTERISTIC PCR_facSurgeDes_MAP "Kennfeld für Sollwert Luftmassenschwingung" MAP 0xF24F8 Kf_Xs16_Ys16_Ws16 4095.938 FactM -2048.000 2047.938 FORMAT "%8.3"
 /begin AXIS_DESCR STD_AXIS Eng_nAvrg EngN 6 0.00 6000.000 FORMAT "%8.3" EXTENDED_LIMITS -32768.00 32767.00 DEPOSIT ABSOLUTE /end AXIS_DESCR
 /begin AXIS_DESCR STD_AXIS APSCD_pLinVal Pres_hPa 4 0.00 3500.000 FORMAT "%8.3" EXTENDED_LIMITS -32768.00 32767.00 DEPOSIT ABSOLUTE /end AXIS_DESCR
/end CHARACTERISTIC
/begin CHARACTERISTIC PCR_facSurgeI_MAP "Kennfeld für Adaptionsfaktor der I-Verstärkung" MAP 0xF2540 Kf_Xs16_Ys16_Ws16 511.9922 Fact1 -256.0000 255.9922 FORMAT "%8.4"
 /begin AXIS_DESCR STD_AXIS Eng_nAvrg EngN 6 0.00 6000.000 FORMAT "%8.3" EXTENDED_LIMITS -32768.00 32767.00 DEPOSIT ABSOLUTE /end AXIS_DESCR
 /begin AXIS_DESCR STD_AXIS APSCD_pLinVal Pres_hPa 4 0.00 3500.000 FORMAT "%8.3" EXTENDED_LIMITS -32768.00 32767.00 DEPOSIT ABSOLUTE /end AXIS_DESCR
/end CHARACTERISTIC
/begin CHARACTERISTIC PCR_facSurgeP_MAP "Kennfeld für Adaptionsfaktor der P-Verstärkung" MAP 0xF2588 Kf_Xs16_Ys16_Ws16 511.9922 Fact1 -256.0000 255.9922 FORMAT "%8.4"
 /begin AXIS_DESCR STD_AXIS Eng_nAvrg EngN 6 0.00 6000.000 FORMAT "%8.3" EXTENDED_LIMITS -32768.00 32767.00 DEPOSIT ABSOLUTE /end AXIS_DESCR
 /begin AXIS_DESCR STD_AXIS APSCD_pLinVal Pres_hPa 4 0.00 3500.000 FORMAT "%8.3" EXTENDED_LIMITS -32768.00 32767.00 DEPOSIT ABSOLUTE /end AXIS_DESCR
/end CHARACTERISTIC
/begin CHARACTERISTIC PCR_IKiLP_C "Grundwert der I-Verstaerkung des PIDT1-Reglers bei Kleinsignalen" VALUE 0xF0B30 Kw_Wu32 12207.0312472 Ki_Pres_hPa2Prc 0.00 12207.0312472 FORMAT "%13.7" /end CHARACTERISTIC
/begin CHARACTERISTIC PCR_IKiPosLP_C "Grundwert der I-Verstaerkung des PIDT1-Reglers bei positiven Groszsignalen" VALUE 0xF0B34 Kw_Wu32 12207.0312472 Ki_Pres_hPa2Prc 0.00 12207.0312472 FORMAT "%13.7" /end CHARACTERISTIC
/begin CHARACTERISTIC PCR_IKiNegLP_C "Grundwert der I-Verstaerkung des PIDT1-Reglers bei negativen Groszsignalen" VALUE 0xF0B38 Kw_Wu32 12207.0312472 Ki_Pres_hPa2Prc 0.00 12207.0312472 FORMAT "%13.7" /end CHARACTERISTIC
/begin CHARACTERISTIC PCR_pIWinPosLP_C "obere Kleinsignalgrenze fuer das I-Glied des PIDT1-Reglers" VALUE 0xF0B3C Kw_Ws16 65535.00 Pres_hPa -32768.00 32767.00 FORMAT "%8.2" /end CHARACTERISTIC
/begin CHARACTERISTIC PCR_pIWinNegLP_C "untere Kleinsignalgrenze fuer das I-Glied des PIDT1-Reglers" VALUE 0xF0B3E Kw_Ws16 65535.00 Pres_hPa -32768.00 32767.00 FORMAT "%8.2" /end CHARACTERISTIC
/begin CHARACTERISTIC PCR_tiSurgeCtlQDT1_C "Zeitabschnitt für den Filter DT1 für InjCtl_qRaw" VALUE 0xF25D0 Kw_Wu32 4294.9663 TimeDelay_s 0.0010000001 4294.9673 FORMAT "%9.4" EXTENDED_LIMITS 0.0000010000000 4294.9673 /end CHARACTERISTIC
/begin CHARACTERISTIC PCR_DKdSurgeCtlQDT1_C "Applikationslabel für kd" VALUE 0xF25D4 Kw_Ws32 79999.9999814 Kd_InjMass2Prc -40000.0000000 39999.9999814 FORMAT "%13.7" /end CHARACTERISTIC
/begin CHARACTERISTIC PCR_ISurgeKi_C "Grundwert der I-Verstärkung des PI-Reglers bei Kleinsignalen" VALUE 0xF25D8 Kw_Wu32 15999999.9963 Ki_Pres_fac2hPa 0.00 15999999.9963 FORMAT "%13.4" /end CHARACTERISTIC
/begin CHARACTERISTIC PCR_ISurgeKiPos_C "Grundwert der I-Verstärkung des PI-Reglers bei pos.Großsignalen" VALUE 0xF25DC Kw_Wu32 15999999.9963 Ki_Pres_fac2hPa 0.00 15999999.9963 FORMAT "%13.4" /end CHARACTERISTIC
/begin CHARACTERISTIC PCR_ISurgeKiNeg_C "Grundwert der I-Verstärkung des PI-Reglers bei neg.Großsignalen" VALUE 0xF25E0 Kw_Wu32 15999999.9963 Ki_Pres_fac2hPa 0.00 15999999.9963 FORMAT "%13.4" /end CHARACTERISTIC
/begin CHARACTERISTIC PCR_facSurgeIWinPos_C "Obere Kleinsignalgrenze für das P-Glied des AntiSurge-Reglers" VALUE 0xF25E4 Kw_Ws16 4095.938 FactM -2048.000 2047.938 FORMAT "%8.3" /end CHARACTERISTIC
/begin CHARACTERISTIC PCR_facSurgeIWinNeg_C "Untere Kleinsignalgrenze für das P-Glied des AntiSurge-Reglers" VALUE 0xF25E6 Kw_Ws16 4095.938 FactM -2048.000 2047.938 FORMAT "%8.3" /end CHARACTERISTIC
/begin CHARACTERISTIC PCR_IKi_C "Grundwert der I-Verstärkung des PIDT1-Reglers bei Kleinsignalen" VALUE 0xF03DC Kw_Wu32 12207.0312472 Ki_Pres_hPa2Prc 0.00 12207.0312472 FORMAT "%13.7" /end CHARACTERISTIC
/begin CHARACTERISTIC PCR_IKiPos_C "Grundwert der I-Verstärkung des PIDT1-Reglers bei positiven Großsignalen" VALUE 0xF03E0 Kw_Wu32 12207.0312472 Ki_Pres_hPa2Prc 0.00 12207.0312472 FORMAT "%13.7" /end CHARACTERISTIC
/begin CHARACTERISTIC PCR_IKiNeg_C "Grundwert der I-Verstärkung des PIDT1-Reglers bei negativen Großsignalen" VALUE 0xF03E4 Kw_Wu32 12207.0312472 Ki_Pres_hPa2Prc 0.00 12207.0312472 FORMAT "%13.7" /end CHARACTERISTIC
/begin CHARACTERISTIC PCR_pIWinPos_C "Obere Kleinsignalgrenze für das I-Glied des PIDT1-Reglers" VALUE 0xF03E8 Kw_Ws16 65535.00 Pres_hPa -32768.00 32767.00 FORMAT "%8.2" /end CHARACTERISTIC
/begin CHARACTERISTIC PCR_pIWinNeg_C "Untere Kleinsignalgrenze für das I-Glied des PIDT1-Reglers" VALUE 0xF03EA Kw_Ws16 65535.00 Pres_hPa -32768.00 32767.00 FORMAT "%8.2" /end CHARACTERISTIC
/begin CHARACTERISTIC PCR_mskNoAdPCVVal_C "Maske zur Auswahl der Bedingungen, die zu einem Ignorieren der Lernwerte fuehren" VALUE 0xF03EC Kw_Wu16 65535.00 OneToOne 0.00 65535.00 FORMAT "%8.2" /end CHARACTERISTIC
/begin CHARACTERISTIC PCR_mskResetVal_C "Maske zur Auswahl der Bedingungen, die zu einem Reset der Lernwerte fuehren" VALUE 0xF03EE Kw_Wu16 65535.00 OneToOne 0.00 65535.00 FORMAT "%8.2" /end CHARACTERISTIC
/begin CHARACTERISTIC PCR_mskStopLearning_C "Maske zur Auswahl der Bedingungen, die zu einem Stop des Lernalgorithmus fuehren" VALUE 0xF03F0 Kw_Wu16 65535.00 OneToOne 0.00 65535.00 FORMAT "%8.2" /end CHARACTERISTIC
/begin CHARACTERISTIC PCR_nAvrgAdPCV1_C "Wert der Drehzahl des ersten Referenz-Betriebspunktes" VALUE 0xF03F2 Kw_Ws16 6000.000 EngN 0.00 6000.000 FORMAT "%8.3" EXTENDED_LIMITS -32768.00 32767.00 /end CHARACTERISTIC
/begin CHARACTERISTIC PCR_nAvrgAdPCV2_C "Wert der Drehzahl des zweiten Referenz-Betriebspunktes" VALUE 0xF03F4 Kw_Ws16 6000.000 EngN 0.00 6000.000 FORMAT "%8.3" EXTENDED_LIMITS -32768.00 32767.00 /end CHARACTERISTIC
/begin CHARACTERISTIC PCR_nCoStart_C "untere Drehzahlgrenze für Kaltstarterkennung-Vorgabewert" VALUE 0xF2218 Kw_Ws16 65535.00 EngN -32768.00 32767.00 FORMAT "%8.2" /end CHARACTERISTIC
/begin CHARACTERISTIC PCR_nCoStrtHigh_C "obere Drehzahlgrenze für Kaltstarterkennung-Vorgabewert" VALUE 0xF221A Kw_Ws16 5960.000 EngN 40.00000 6000.000 FORMAT "%8.3" EXTENDED_LIMITS -32768.00 32767.00 /end CHARACTERISTIC
/begin CHARACTERISTIC PCR_nLimMax_C "Upper threshold for engine speed." VALUE 0xEF64A Kw_Ws16 6000.000 EngN 0.00 6000.000 FORMAT "%8.3" EXTENDED_LIMITS -32768.00 32767.00 /end CHARACTERISTIC
/begin CHARACTERISTIC PCR_nLimMin_C "Lower threshold for engine speed." VALUE 0xEF64C Kw_Ws16 6000.000 EngN 0.00 6000.000 FORMAT "%8.3" EXTENDED_LIMITS -32768.00 32767.00 /end CHARACTERISTIC
/begin CHARACTERISTIC PCR_nLPWrkSph2_C "obere Drehzahlgrenze des Arbeitsbereichs 2" VALUE 0xF20F0 Kw_Ws16 5960.000 EngN 40.00000 6000.000 FORMAT "%8.3" EXTENDED_LIMITS -32768.00 32767.00 /end CHARACTERISTIC
/begin CHARACTERISTIC PCR_nLPWrkSph3_C "obere Drehzahlgrenze des Arbeitsbereichs 3" VALUE 0xF20F2 Kw_Ws16 5960.000 EngN 40.00000 6000.000 FORMAT "%8.3" EXTENDED_LIMITS -32768.00 32767.00 /end CHARACTERISTIC
/begin CHARACTERISTIC PCR_nPCVMax_C "Maximale Drehzahl bei Verwendung des PCVs" VALUE 0xF03F6 Kw_Ws16 6000.000 EngN 0.00 6000.000 FORMAT "%8.3" EXTENDED_LIMITS -32768.00 32767.00 /end CHARACTERISTIC
/begin CHARACTERISTIC PCR_nPCVMin_C "Minimale Drehzahl bei Verwendung des PCVs" VALUE 0xF03F8 Kw_Ws16 6000.000 EngN 0.00 6000.000 FORMAT "%8.3" EXTENDED_LIMITS -32768.00 32767.00 /end CHARACTERISTIC
/begin CHARACTERISTIC PCR_nWrkSph1_C "obere Drehzahlgrenze des Arbeitsbereiches 1" VALUE 0xF221C Kw_Ws16 8000.000 EngN 0.00 8000.000 FORMAT "%8.3" EXTENDED_LIMITS -32768.00 32767.00 /end CHARACTERISTIC
/begin CHARACTERISTIC PCR_nWrkSph2_C "Drehzahlgrenze zwischen den Arbeitsbereichen 2 und 3" VALUE 0xF221E Kw_Ws16 8000.000 EngN 0.00 8000.000 FORMAT "%8.3" EXTENDED_LIMITS -32768.00 32767.00 /end CHARACTERISTIC
/begin CHARACTERISTIC PCR_nWrkSph3_C "Drehzahlgrenze zwischen den Arbeitsbereichen 3 und 4" VALUE 0xF2220 Kw_Ws16 8000.000 EngN 0.00 8000.000 FORMAT "%8.3" EXTENDED_LIMITS -32768.00 32767.00 /end CHARACTERISTIC
/begin CHARACTERISTIC PCR_pAPQCmpnRgn_MAP "Kennfeld für atmosphärendruckabhängigen Korrekturwert bei Regenerationsbetrieb" MAP 0xEF64E Kf_Xs16_Ys16_Ws16 4400.000 Pres_hPa -400.0000 4000.000 FORMAT "%8.3" EXTENDED_LIMITS -32768.00 32767.00
 /begin AXIS_DESCR STD_AXIS APSCD_pVal Pres_hPa 6 0.00 4000.000 FORMAT "%8.3" EXTENDED_LIMITS -32768.00 32767.00 DEPOSIT ABSOLUTE /end AXIS_DESCR
 /begin AXIS_DESCR STD_AXIS PCR_qDes InjMass 6 0.00 200.0000 FORMAT "%8.4" EXTENDED_LIMITS -327.6800 327.6700 DEPOSIT ABSOLUTE /end AXIS_DESCR
/end CHARACTERISTIC
/begin CHARACTERISTIC PCR_pAPQCmpn_MAP "Kennfeld für atmosphärendruckabhängige Kompensation für Sollwertberechnung" MAP 0xEF6B2 Kf_Xs16_Ys16_Ws16 8000.000 Pres_hPa -4000.000 4000.000 FORMAT "%8.3" EXTENDED_LIMITS -32768.00 32767.00
 /begin AXIS_DESCR STD_AXIS APSCD_pVal Pres_hPa 6 0.00 4000.000 FORMAT "%8.3" EXTENDED_LIMITS -32768.00 32767.00 DEPOSIT ABSOLUTE /end AXIS_DESCR
 /begin AXIS_DESCR STD_AXIS PCR_qDes InjMass 6 0.00 200.0000 FORMAT "%8.4" EXTENDED_LIMITS -327.6800 327.6700 DEPOSIT ABSOLUTE /end AXIS_DESCR
/end CHARACTERISTIC
/begin CHARACTERISTIC PCR_pBDesBasFDC_MAP "base desired boost pressure map for sport mode" MAP 0xEF716 Kf_Xs16_Ys16_Ws16 4000.000 Pres_hPa 0.00 4000.000 FORMAT "%8.3" EXTENDED_LIMITS -32768.00 32767.00
 /begin AXIS_DESCR STD_AXIS Eng_nAvrg EngN 2 0.00 8000.000 FORMAT "%8.3" EXTENDED_LIMITS -32768.00 32767.00 DEPOSIT ABSOLUTE /end AXIS_DESCR
 /begin AXIS_DESCR STD_AXIS PCR_qDes InjMass 2 0.00 200.0000 FORMAT "%8.4" EXTENDED_LIMITS -327.6800 327.6700 DEPOSIT ABSOLUTE /end AXIS_DESCR
/end CHARACTERISTIC
/begin CHARACTERISTIC PCR_pBDesBasRgn1_MAP "Erstes Regenerationskennfeld zur Ermittlung des Ladedruckbasissollwerts" MAP 0xEF72A Kf_Xs16_Ys16_Ws16 4000.000 Pres_hPa 0.00 4000.000 FORMAT "%8.3" EXTENDED_LIMITS -32768.00 32767.00
 /begin AXIS_DESCR STD_AXIS Eng_nAvrg EngN 16 0.00 8000.000 FORMAT "%8.3" EXTENDED_LIMITS -32768.00 32767.00 DEPOSIT ABSOLUTE /end AXIS_DESCR
 /begin AXIS_DESCR STD_AXIS PCR_qDes InjMass 16 0.00 200.0000 FORMAT "%8.4" EXTENDED_LIMITS -327.6800 327.6700 DEPOSIT ABSOLUTE /end AXIS_DESCR
/end CHARACTERISTIC
/begin CHARACTERISTIC PCR_pBDesBasRgn2_MAP "Zweites Regenerationskennfeld zur Ermittlung des Ladedruckbasissollwerts" MAP 0xEF96E Kf_Xs16_Ys16_Ws16 4000.000 Pres_hPa 0.00 4000.000 FORMAT "%8.3" EXTENDED_LIMITS -32768.00 32767.00
 /begin AXIS_DESCR STD_AXIS Eng_nAvrg EngN 16 0.00 8000.000 FORMAT "%8.3" EXTENDED_LIMITS -32768.00 32767.00 DEPOSIT ABSOLUTE /end AXIS_DESCR
 /begin AXIS_DESCR STD_AXIS PCR_qDes InjMass 16 0.00 200.0000 FORMAT "%8.4" EXTENDED_LIMITS -327.6800 327.6700 DEPOSIT ABSOLUTE /end AXIS_DESCR
/end CHARACTERISTIC
/begin CHARACTERISTIC PCR_pBDesLPRgn1_MAP "Kennfeld zum Ladedrucksollwert bei niedrigem Druck in regenaration1" MAP 0xF0B40 Kf_Xs16_Ys16_Ws16 4000.000 Pres_hPa 0.00 4000.000 FORMAT "%8.3" EXTENDED_LIMITS -32768.00 32767.00
 /begin AXIS_DESCR STD_AXIS Eng_nAvrg EngN 16 0.00 8000.000 FORMAT "%8.3" EXTENDED_LIMITS -32768.00 32767.00 DEPOSIT ABSOLUTE /end AXIS_DESCR
 /begin AXIS_DESCR STD_AXIS PCR_qDes InjMass 16 0.00 200.0000 FORMAT "%8.4" EXTENDED_LIMITS -327.6800 327.6700 DEPOSIT ABSOLUTE /end AXIS_DESCR
/end CHARACTERISTIC
/begin CHARACTERISTIC PCR_pBDesLPRgn2_MAP "Kennfeld zum Ladedrucksollwert bei niedrigem Druck in Regeneration 2" MAP 0xF0D84 Kf_Xs16_Ys16_Ws16 4000.000 Pres_hPa 0.00 4000.000 FORMAT "%8.3" EXTENDED_LIMITS -32768.00 32767.00
 /begin AXIS_DESCR STD_AXIS Eng_nAvrg EngN 16 0.00 8000.000 FORMAT "%8.3" EXTENDED_LIMITS -32768.00 32767.00 DEPOSIT ABSOLUTE /end AXIS_DESCR
 /begin AXIS_DESCR STD_AXIS PCR_qDes InjMass 16 0.00 200.0000 FORMAT "%8.4" EXTENDED_LIMITS -327.6800 327.6700 DEPOSIT ABSOLUTE /end AXIS_DESCR
/end CHARACTERISTIC
/begin CHARACTERISTIC PCR_pBDesLP_MAP " KF Ladedruck-Sollwert bei Kompressorbypass offen" MAP 0xF0FC8 Kf_Xs16_Ys16_Ws16 4000.000 Pres_hPa 0.00 4000.000 FORMAT "%8.3" EXTENDED_LIMITS -32768.00 32767.00
 /begin AXIS_DESCR STD_AXIS Eng_nAvrg EngN 16 0.00 8000.000 FORMAT "%8.3" EXTENDED_LIMITS -32768.00 32767.00 DEPOSIT ABSOLUTE /end AXIS_DESCR
 /begin AXIS_DESCR STD_AXIS PCR_qDes InjMass 16 0.00 200.0000 FORMAT "%8.4" EXTENDED_LIMITS -327.6800 327.6700 DEPOSIT ABSOLUTE /end AXIS_DESCR
/end CHARACTERISTIC
/begin CHARACTERISTIC PCR_pBDesMaxAPLP_MAP "KF max Ladedruck bei Kompressorbypass offen" MAP 0xF120C Kf_Xs16_Ys16_Ws16 4000.000 Pres_hPa 0.00 4000.000 FORMAT "%8.3" EXTENDED_LIMITS -32768.00 32767.00
 /begin AXIS_DESCR STD_AXIS Eng_nAvrg EngN 10 0.00 8000.000 FORMAT "%8.3" EXTENDED_LIMITS -32768.00 32767.00 DEPOSIT ABSOLUTE /end AXIS_DESCR
 /begin AXIS_DESCR STD_AXIS APSCD_pVal Pres_hPa 10 0.00 4000.000 FORMAT "%8.3" EXTENDED_LIMITS -32768.00 32767.00 DEPOSIT ABSOLUTE /end AXIS_DESCR
/end CHARACTERISTIC
/begin CHARACTERISTIC PCR_pBGDevAdPCVLim_C "Maximale Grenze fuer die Regler-Abweichung" VALUE 0xF03FA Kw_Ws16 65535.00 Pres_hPa -32768.00 32767.00 FORMAT "%8.2" /end CHARACTERISTIC
/begin CHARACTERISTIC PCR_pBGDevMaxOffset_C "Max. Regelabweichung PCR - Offset während DSC-Eingriff (eingefrorener Leadpfad)" VALUE 0xF2222 Kw_Ws16 65535.00 Pres_hPa -32768.00 32767.00 FORMAT "%8.2" /end CHARACTERISTIC
/begin CHARACTERISTIC PCR_pBGDevMax_MAP "Kennfeld der Obergrenze für Erkennung einer bleibenden Regelabweichung" MAP 0xF2224 Kf_Xs16_Ys16_Ws16 4000.000 Pres_hPa 0.00 4000.000 FORMAT "%8.3" EXTENDED_LIMITS -32768.00 32767.00
 /begin AXIS_DESCR STD_AXIS Eng_nAvrg EngN 4 0.00 6000.000 FORMAT "%8.3" EXTENDED_LIMITS -32768.00 32767.00 DEPOSIT ABSOLUTE /end AXIS_DESCR
 /begin AXIS_DESCR STD_AXIS InjCtl_qCurr InjMassCyc 4 0.00 327.6700 FORMAT "%8.4" EXTENDED_LIMITS -327.6800 327.6700 DEPOSIT ABSOLUTE /end AXIS_DESCR
/end CHARACTERISTIC
/begin CHARACTERISTIC PCR_pBGDevMinOffset_C "neg. Regelabweichung PCR - Offset während DSC-Eingriff (eingefrorener Leadpfad)" VALUE 0xF2258 Kw_Ws16 65535.00 Pres_hPa -32768.00 32767.00 FORMAT "%8.2" /end CHARACTERISTIC
/begin CHARACTERISTIC PCR_pBGDevMin_MAP "Untergrenze für Erkennung einer bleibenden Regelabweichung" MAP 0xF225A Kf_Xs16_Ys16_Ws16 4300.000 Pres_hPa -300.0000 4000.000 FORMAT "%8.3" EXTENDED_LIMITS -32768.00 32767.00
 /begin AXIS_DESCR STD_AXIS Eng_nAvrg EngN 4 0.00 6000.000 FORMAT "%8.3" EXTENDED_LIMITS -32768.00 32767.00 DEPOSIT ABSOLUTE /end AXIS_DESCR
 /begin AXIS_DESCR STD_AXIS InjCtl_qCurr InjMassCyc 4 0.00 327.6700 FORMAT "%8.4" EXTENDED_LIMITS -327.6800 327.6700 DEPOSIT ABSOLUTE /end AXIS_DESCR
/end CHARACTERISTIC
/begin CHARACTERISTIC PCR_pBSurgeCtlVal_MAP "Kennfeld Steuerwert" MAP 0xF25E8 Kf_Xs16_Ys16_Ws16 65535.00 Pres_hPa -32768.00 32767.00 FORMAT "%8.2"
 /begin AXIS_DESCR STD_AXIS Eng_nAvrg EngN 6 0.00 6000.000 FORMAT "%8.3" EXTENDED_LIMITS -32768.00 32767.00 DEPOSIT ABSOLUTE /end AXIS_DESCR
 /begin AXIS_DESCR STD_AXIS APSCD_pLinVal Pres_hPa 6 0.00 3500.000 FORMAT "%8.3" EXTENDED_LIMITS -32768.00 32767.00 DEPOSIT ABSOLUTE /end AXIS_DESCR
/end CHARACTERISTIC
/begin CHARACTERISTIC PCR_pBSurgeDesMax_MAP "Kennfeld zur Bestimmung der max. zulässigen Stellgröße" MAP 0xF264C Kf_Xs16_Ys16_Ws16 65535.00 Pres_hPa -32768.00 32767.00 FORMAT "%8.2"
 /begin AXIS_DESCR STD_AXIS Eng_nAvrg EngN 5 0.00 6000.000 FORMAT "%8.3" EXTENDED_LIMITS -32768.00 32767.00 DEPOSIT ABSOLUTE /end AXIS_DESCR
 /begin AXIS_DESCR STD_AXIS APSCD_pLinVal Pres_hPa 5 0.00 3500.000 FORMAT "%8.3" EXTENDED_LIMITS -32768.00 32767.00 DEPOSIT ABSOLUTE /end AXIS_DESCR
/end CHARACTERISTIC
/begin CHARACTERISTIC PCR_pBSurgeDesMin_MAP "Kennfeld zur Bestimmung der min. zulässigen Stellgröße" MAP 0xF2696 Kf_Xs16_Ys16_Ws16 65535.00 Pres_hPa -32768.00 32767.00 FORMAT "%8.2"
 /begin AXIS_DESCR STD_AXIS Eng_nAvrg EngN 5 0.00 6000.000 FORMAT "%8.3" EXTENDED_LIMITS -32768.00 32767.00 DEPOSIT ABSOLUTE /end AXIS_DESCR
 /begin AXIS_DESCR STD_AXIS APSCD_pLinVal Pres_hPa 5 0.00 3500.000 FORMAT "%8.3" EXTENDED_LIMITS -32768.00 32767.00 DEPOSIT ABSOLUTE /end AXIS_DESCR
/end CHARACTERISTIC
/begin CHARACTERISTIC PCR_pBSurgeDes_CUR "Kennlinie für Sollwert Ladedruck zur Reduktion Laderpumpen" CURVE 0xF26E0 Kl_Xs16_Ws16 65535.00 Pres_hPa -32768.00 32767.00 FORMAT "%8.2"
 /begin AXIS_DESCR STD_AXIS PCR_pBSurgePICtlLim_mp Pres_hPa 2 -32768.00 32767.00 FORMAT "%8.2" DEPOSIT ABSOLUTE /end AXIS_DESCR
/end CHARACTERISTIC
/begin CHARACTERISTIC PCR_pDesAdd_Vector "Bypass-Label für additiven Bypass von PCR_pBDes (Nicht verstellen!)" VALUE 0xC3996 Kw_Wu8 255.0 OneToOne 0.00 255.0 FORMAT "%5.1" /end CHARACTERISTIC
/begin CHARACTERISTIC PCR_pDesAdd_Channel "Bypass-Label für additiven Bypass von PCR_pBDes (Nicht verstellen!)" VALUE 0xC3997 Kw_Wu8 255.0 OneToOne 0.00 255.0 FORMAT "%5.1" /end CHARACTERISTIC
/begin CHARACTERISTIC PCR_pDesBas_MAP "Kennfeld für die Grundwertbestimmung des Ladedruckbasissollwerts" MAP 0xEFBB2 Kf_Xs16_Ys16_Ws16 4000.000 Pres_hPa 0.00 4000.000 FORMAT "%8.3" EXTENDED_LIMITS -32768.00 32767.00
 /begin AXIS_DESCR STD_AXIS Eng_nAvrg EngN 16 0.00 8000.000 FORMAT "%8.3" EXTENDED_LIMITS -32768.00 32767.00 DEPOSIT ABSOLUTE /end AXIS_DESCR
 /begin AXIS_DESCR STD_AXIS PCR_qDes InjMass 16 0.00 200.0000 FORMAT "%8.4" EXTENDED_LIMITS -327.6800 327.6700 DEPOSIT ABSOLUTE /end AXIS_DESCR
/end CHARACTERISTIC
/begin CHARACTERISTIC PCR_pDesMaxAP_MAP "Größter erlaubter Ladedrucksollwert in Abhängigkeit vom Luftdruck" MAP 0xEFDF6 Kf_Xs16_Ys16_Ws16 4000.000 Pres_hPa 0.00 4000.000 FORMAT "%8.3" EXTENDED_LIMITS -32768.00 32767.00
 /begin AXIS_DESCR STD_AXIS Eng_nAvrg EngN 16 0.00 8000.000 FORMAT "%8.3" EXTENDED_LIMITS -32768.00 32767.00 DEPOSIT ABSOLUTE /end AXIS_DESCR
 /begin AXIS_DESCR STD_AXIS APSCD_pVal Pres_hPa 16 0.00 4000.000 FORMAT "%8.3" EXTENDED_LIMITS -32768.00 32767.00 DEPOSIT ABSOLUTE /end AXIS_DESCR
/end CHARACTERISTIC
/begin CHARACTERISTIC PCR_pDesMax_C "Größter erlaubter Ladedrucksollwert" VALUE 0xF003A Kw_Ws16 4000.000 Pres_hPa 0.00 4000.000 FORMAT "%8.3" EXTENDED_LIMITS -32768.00 32767.00 /end CHARACTERISTIC
/begin CHARACTERISTIC PCR_pDesMin_C "Kleinster erlaubter Ladedrucksollwert" VALUE 0xF003C Kw_Ws16 4000.000 Pres_hPa 0.00 4000.000 FORMAT "%8.3" EXTENDED_LIMITS -32768.00 32767.00 /end CHARACTERISTIC
/begin CHARACTERISTIC PCR_pDes_Vector "Bypass-Label für PCR_pBDes (Nicht verstellen!)" VALUE 0xC3998 Kw_Wu8 255.0 OneToOne 0.00 255.0 FORMAT "%5.1" /end CHARACTERISTIC
/begin CHARACTERISTIC PCR_pDes_Channel "Bypass-Label für PCR_pBDes (Nicht verstellen!)" VALUE 0xC3999 Kw_Wu8 255.0 OneToOne 0.00 255.0 FORMAT "%5.1" /end CHARACTERISTIC
/begin CHARACTERISTIC PCR_pDvtSurgeCtlRel_C "Max. Limit für Stellerabweichung bei Erkennung gleicher Status" VALUE 0xF26EA Kw_Ws16 65535.00 Pres_hPa -32768.00 32767.00 FORMAT "%8.2" /end CHARACTERISTIC
/begin CHARACTERISTIC PCR_pFltValLim_C "Maximale Grenze fuer Ladedruck" VALUE 0xF03FC Kw_Ws16 65535.00 Pres_hPa -32768.00 32767.00 FORMAT "%8.2" /end CHARACTERISTIC
/begin CHARACTERISTIC PCR_pLPDvtMaxOffset_C "Offset für Obergrenze für Erkennung einer bleibenden Regelabweichung" VALUE 0xF20F4 Kw_Ws16 65535.00 Pres_hPa -32768.00 32767.00 FORMAT "%8.2" /end CHARACTERISTIC
/begin CHARACTERISTIC PCR_pLPDvtMax_MAP "Obergrenze für Erkennung einer bleibenden Regelabweichung" MAP 0xF20F6 Kf_Xs16_Ys16_Ws16 4000.000 Pres_hPa 0.00 4000.000 FORMAT "%8.3" EXTENDED_LIMITS -32768.00 32767.00
 /begin AXIS_DESCR STD_AXIS Eng_nAvrg EngN 4 0.00 6000.000 FORMAT "%8.3" EXTENDED_LIMITS -32768.00 32767.00 DEPOSIT ABSOLUTE /end AXIS_DESCR
 /begin AXIS_DESCR STD_AXIS InjCtl_qCurr InjMassCyc 4 0.00 327.6700 FORMAT "%8.4" EXTENDED_LIMITS -327.6800 327.6700 DEPOSIT ABSOLUTE /end AXIS_DESCR
/end CHARACTERISTIC
/begin CHARACTERISTIC PCR_pLPDvtMinOffset_C "Offset für Untergrenze für Erkennung einer bleibenden Regelabweichung" VALUE 0xF212A Kw_Ws16 65535.00 Pres_hPa -32768.00 32767.00 FORMAT "%8.2" /end CHARACTERISTIC
/begin CHARACTERISTIC PCR_pLPDvtMin_MAP "Untergrenze für Erkennung einer bleibenden Regelabweichung Niederdruckstufe" MAP 0xF212C Kf_Xs16_Ys16_Ws16 4300.000 Pres_hPa -300.0000 4000.000 FORMAT "%8.3" EXTENDED_LIMITS -32768.00 32767.00
 /begin AXIS_DESCR STD_AXIS Eng_nAvrg EngN 4 0.00 6000.000 FORMAT "%8.3" EXTENDED_LIMITS -32768.00 32767.00 DEPOSIT ABSOLUTE /end AXIS_DESCR
 /begin AXIS_DESCR STD_AXIS InjCtl_qCurr InjMassCyc 4 0.00 327.6700 FORMAT "%8.4" EXTENDED_LIMITS -327.6800 327.6700 DEPOSIT ABSOLUTE /end AXIS_DESCR
/end CHARACTERISTIC
/begin CHARACTERISTIC PCR_PKpLP_C "Grundwert der P-Verstaerkung des PIDT1-Reglers bei Kleinsignalen" VALUE 0xF1300 Kw_Wu32 799.999999814 Kp_Pres_hPa2Prc 0.00 799.999999814 FORMAT "%13.9" /end CHARACTERISTIC
/begin CHARACTERISTIC PCR_PKpPosLP_C "Grundwert der P-Verstaerkung des PIDT1-Reglers bei positiven Groszsignalen" VALUE 0xF1304 Kw_Wu32 799.999999814 Kp_Pres_hPa2Prc 0.00 799.999999814 FORMAT "%13.9" /end CHARACTERISTIC
/begin CHARACTERISTIC PCR_PKpNegLP_C "Grundwert der P-Verstaerkung des PIDT1-Reglers bei negativen Groszsignalen" VALUE 0xF1308 Kw_Wu32 799.999999814 Kp_Pres_hPa2Prc 0.00 799.999999814 FORMAT "%13.9" /end CHARACTERISTIC
/begin CHARACTERISTIC PCR_pPWinPosLP_C "obere Kleinsignalgrenze fuer das P-Glied des PIDT1-Reglers" VALUE 0xF130C Kw_Ws16 65535.00 Pres_hPa -32768.00 32767.00 FORMAT "%8.2" /end CHARACTERISTIC
/begin CHARACTERISTIC PCR_pPWinNegLP_C "untere Kleinsignalgrenze fuer das P-Glied des PIDT1-Reglers" VALUE 0xF130E Kw_Ws16 65535.00 Pres_hPa -32768.00 32767.00 FORMAT "%8.2" /end CHARACTERISTIC
/begin CHARACTERISTIC PCR_pNQCtCmpn_MAP "Kennfeld für Kühlwassertemperaturkorrekturwert für Sollwertberechnung" MAP 0xF003E Kf_Xs16_Ys16_Ws16 4000.000 Pres_hPa 0.00 4000.000 FORMAT "%8.3" EXTENDED_LIMITS -32768.00 32767.00
 /begin AXIS_DESCR STD_AXIS Eng_nAvrg EngN 6 0.00 8000.000 FORMAT "%8.3" EXTENDED_LIMITS -32768.00 32767.00 DEPOSIT ABSOLUTE /end AXIS_DESCR
 /begin AXIS_DESCR STD_AXIS PCR_qDes InjMass 6 0.00 200.0000 FORMAT "%8.4" EXTENDED_LIMITS -327.6800 327.6700 DEPOSIT ABSOLUTE /end AXIS_DESCR
/end CHARACTERISTIC
/begin CHARACTERISTIC PCR_tiDebPreSurgeDetLoHi_C "Entprellenzeit für Tief zur Höhe" VALUE 0xF2864 Kw_Wu16 655140.0 TimeDeb 0.00 655140.0 FORMAT "%8.1" EXTENDED_LIMITS 0.00 655350.0 /end CHARACTERISTIC
/begin CHARACTERISTIC PCR_tiDebPreSurgeDetHiLo_C "Entprellenzeit für Höhe zum Tief" VALUE 0xF2866 Kw_Wu16 655140.0 TimeDeb 0.00 655140.0 FORMAT "%8.1" EXTENDED_LIMITS 0.00 655350.0 /end CHARACTERISTIC
/begin CHARACTERISTIC PCR_pSurgeARWIMin_C "minimal zulässige ARW ant-surge regler" VALUE 0xF26EC Kw_Ws16 7000.000 Pres_hPa -3500.000 3500.000 FORMAT "%8.3" EXTENDED_LIMITS -32768.00 32767.00 /end CHARACTERISTIC
/begin CHARACTERISTIC PCR_PSurgeKp_C "Grundwert der P-Verstärkung des PI-Reglers bei Kleinsigna-len" VALUE 0xF26F0 Kw_Wu32 1048575.99976 Kp_Pres_fac2hPa 0.00 1048575.99976 FORMAT "%13.5" /end CHARACTERISTIC
/begin CHARACTERISTIC PCR_PSurgeKpPos_C "Grundwert der P-Verstärkung des PI-Reglers bei pos.Großsignalen" VALUE 0xF26F4 Kw_Wu32 1048575.99976 Kp_Pres_fac2hPa 0.00 1048575.99976 FORMAT "%13.5" /end CHARACTERISTIC
/begin CHARACTERISTIC PCR_PSurgeKpNeg_C "Grundwert der P-Verstärkung des PI-Reglers bei neg.Großsignalen" VALUE 0xF26F8 Kw_Wu32 1048575.99976 Kp_Pres_fac2hPa 0.00 1048575.99976 FORMAT "%13.5" /end CHARACTERISTIC
/begin CHARACTERISTIC PCR_facSurgePWinPos_C "Obere Kleinsignalgrenze für das P-Glied des AntiSurge-Reglers" VALUE 0xF26FC Kw_Ws16 4095.938 FactM -2048.000 2047.938 FORMAT "%8.3" /end CHARACTERISTIC
/begin CHARACTERISTIC PCR_facSurgePWinNeg_C "Untere Kleinsignalgrenze für das P-Glied des AntiSurge-Reglers" VALUE 0xF26FE Kw_Ws16 4095.938 FactM -2048.000 2047.938 FORMAT "%8.3" /end CHARACTERISTIC
/begin CHARACTERISTIC PCR_pValAdPCVMax_C "Maximale Grenze für Luftdruck" VALUE 0xF03FE Kw_Ws16 65535.00 Pres_hPa -32768.00 32767.00 FORMAT "%8.2" /end CHARACTERISTIC
/begin CHARACTERISTIC PCR_pValAdPCVMin_C "Minimale Grenze fuer Luftdruck" VALUE 0xF0400 Kw_Ws16 65535.00 Pres_hPa -32768.00 32767.00 FORMAT "%8.2" /end CHARACTERISTIC
/begin CHARACTERISTIC PCR_PKp_C "Grundwert der P-Verstärkung des PIDT1-Reglers bei Kleinsignalen" VALUE 0xF0404 Kw_Wu32 799.999999814 Kp_Pres_hPa2Prc 0.00 799.999999814 FORMAT "%13.9" /end CHARACTERISTIC
/begin CHARACTERISTIC PCR_PKpPos_C "Grundwert der P-Verstärkung des PIDT1-Reglers bei positiven Großsignalen" VALUE 0xF0408 Kw_Wu32 799.999999814 Kp_Pres_hPa2Prc 0.00 799.999999814 FORMAT "%13.9" /end CHARACTERISTIC
/begin CHARACTERISTIC PCR_PKpNeg_C "Grundwert der P-Verstärkung des PIDT1-Reglers bei negativen Großsignalen" VALUE 0xF040C Kw_Wu32 799.999999814 Kp_Pres_hPa2Prc 0.00 799.999999814 FORMAT "%13.9" /end CHARACTERISTIC
/begin CHARACTERISTIC PCR_pPWinPos_C "Obere Kleinsignalgrenze für das P-Glied des PIDT1-Reglers" VALUE 0xF0410 Kw_Ws16 65535.00 Pres_hPa -32768.00 32767.00 FORMAT "%8.2" /end CHARACTERISTIC
/begin CHARACTERISTIC PCR_pPWinNeg_C "Untere Kleinsignalgrenze für das P-Glied des PIDT1-Reglers" VALUE 0xF0412 Kw_Ws16 65535.00 Pres_hPa -32768.00 32767.00 FORMAT "%8.2" /end CHARACTERISTIC
/begin CHARACTERISTIC PCR_qClutchThres_C "Mengenschwellwert für Kupplungserkennung" VALUE 0xF228E Kw_Ws16 200.0000 InjMass 0.00 200.0000 FORMAT "%8.4" EXTENDED_LIMITS -327.6800 327.6700 /end CHARACTERISTIC
/begin CHARACTERISTIC PCR_qClutchThres_CUR "Drehzahlabhängige Mengenschwelle zur Kupplungserkennung" CURVE 0xF2290 Kl_Xs16_Ws16 327.6700 InjMassCyc 0.00 327.6700 FORMAT "%8.4" EXTENDED_LIMITS -327.6800 327.6700
 /begin AXIS_DESCR STD_AXIS Eng_nAvrg EngN 4 40.00000 6000.000 FORMAT "%8.3" EXTENDED_LIMITS -32768.00 32767.00 DEPOSIT ABSOLUTE /end AXIS_DESCR
/end CHARACTERISTIC
/begin CHARACTERISTIC PCR_qCtlAdPCV1_C "Wert der Einspritzmenge des ersten Referenz-Betriebspunktes" VALUE 0xF0414 Kw_Ws16 327.6700 InjMassCyc 0.00 327.6700 FORMAT "%8.4" EXTENDED_LIMITS -327.6800 327.6700 /end CHARACTERISTIC
/begin CHARACTERISTIC PCR_qCtlAdPCV2_C "Wert der Einspritzmenge des zweiten Referenz-Betriebspunktes" VALUE 0xF0416 Kw_Ws16 327.6700 InjMassCyc 0.00 327.6700 FORMAT "%8.4" EXTENDED_LIMITS -327.6800 327.6700 /end CHARACTERISTIC
/begin CHARACTERISTIC PCR_qLPClutchThres_CUR "Drehzahlabhängige Mengenschwelle zur Kupplungserkennung(Niederdruckstufe)" CURVE 0xF2160 Kl_Xs16_Ws16 327.6700 InjMassCyc 0.00 327.6700 FORMAT "%8.4" EXTENDED_LIMITS -327.6800 327.6700
 /begin AXIS_DESCR STD_AXIS Eng_nAvrg EngN 4 40.00000 6000.000 FORMAT "%8.3" EXTENDED_LIMITS -32768.00 32767.00 DEPOSIT ABSOLUTE /end AXIS_DESCR
/end CHARACTERISTIC
/begin CHARACTERISTIC PCR_qLPGvnrOffRgn_CUR "Mengenkennlinie für Reglerabschaltschwelle in Abhängigkeit von der Drehzahl bei Regenerationsbetrieb(Niederdruckstufe)" CURVE 0xF2172 Kl_Xs16_Ws16 200.0000 InjMass 0.00 200.0000 FORMAT "%8.4" EXTENDED_LIMITS -327.6800 327.6700
 /begin AXIS_DESCR STD_AXIS Eng_nAvrg EngN 8 0.00 8000.000 FORMAT "%8.3" EXTENDED_LIMITS -32768.00 32767.00 DEPOSIT ABSOLUTE /end AXIS_DESCR
/end CHARACTERISTIC
/begin CHARACTERISTIC PCR_qLPGvnrOff_CUR "Einspritzmengenkennlinie für Abschaltschwelle im Normalmodus(Niederdruckstufe)" CURVE 0xF2194 Kl_Xs16_Ws16 200.0000 InjMass 0.00 200.0000 FORMAT "%8.4" EXTENDED_LIMITS -327.6800 327.6700
 /begin AXIS_DESCR STD_AXIS Eng_nAvrg EngN 8 0.00 8000.000 FORMAT "%8.3" EXTENDED_LIMITS -32768.00 32767.00 DEPOSIT ABSOLUTE /end AXIS_DESCR
/end CHARACTERISTIC
/begin CHARACTERISTIC PCR_qLPGvnrOnRgn_CUR "Mengenkennlinie für Reglereinschaltschwelle in Abhängigkeit von der Drehzahl bei Regenerationsbetrieb(Niederdruckstufe)" CURVE 0xF21B6 Kl_Xs16_Ws16 200.0000 InjMass 0.00 200.0000 FORMAT "%8.4" EXTENDED_LIMITS -327.6800 327.6700
 /begin AXIS_DESCR STD_AXIS Eng_nAvrg EngN 8 0.00 8000.000 FORMAT "%8.3" EXTENDED_LIMITS -32768.00 32767.00 DEPOSIT ABSOLUTE /end AXIS_DESCR
/end CHARACTERISTIC
/begin CHARACTERISTIC PCR_qLPGvnrOn_CUR "Einspritzmengenkennlinie für Einschaltschwelle im Normalmodus(Niederdruckstufe)" CURVE 0xF21D8 Kl_Xs16_Ws16 200.0000 InjMass 0.00 200.0000 FORMAT "%8.4" EXTENDED_LIMITS -327.6800 327.6700
 /begin AXIS_DESCR STD_AXIS Eng_nAvrg EngN 8 0.00 8000.000 FORMAT "%8.3" EXTENDED_LIMITS -32768.00 32767.00 DEPOSIT ABSOLUTE /end AXIS_DESCR
/end CHARACTERISTIC
/begin CHARACTERISTIC PCR_qLPWrkSph2_C "obere Mengengrenze des Arbeitsbereichs 2" VALUE 0xF21FA Kw_Ws16 200.0000 InjMass 0.00 200.0000 FORMAT "%8.4" EXTENDED_LIMITS -327.6800 327.6700 /end CHARACTERISTIC
/begin CHARACTERISTIC PCR_qLPWrkSph3_C "obere Mengengrenze des Arbeitsbereichs 3" VALUE 0xF21FC Kw_Ws16 200.0000 InjMass 0.00 200.0000 FORMAT "%8.4" EXTENDED_LIMITS -327.6800 327.6700 /end CHARACTERISTIC
/begin CHARACTERISTIC PCR_qPCVMax_C "Maximale Einspritzmenge bei Verwendung des PCVs" VALUE 0xF0418 Kw_Ws16 327.6700 InjMassCyc 0.00 327.6700 FORMAT "%8.4" EXTENDED_LIMITS -327.6800 327.6700 /end CHARACTERISTIC
/begin CHARACTERISTIC PCR_qPCVMin_C "Minimale Einspritzmenge bei Verwendung des PCVs" VALUE 0xF041A Kw_Ws16 327.6700 InjMassCyc 0.00 327.6700 FORMAT "%8.4" EXTENDED_LIMITS -327.6800 327.6700 /end CHARACTERISTIC
/begin CHARACTERISTIC PCR_qRgtOffRgn_CUR "Mengenkennlinie für Reglerabschaltschwelle in Abhängigkeit von der Drehzahl für Partikelfilter Regeneration" CURVE 0xF22A2 Kl_Xs16_Ws16 200.0000 InjMass 0.00 200.0000 FORMAT "%8.4" EXTENDED_LIMITS -327.6800 327.6700
 /begin AXIS_DESCR STD_AXIS Eng_nAvrg EngN 9 0.00 8000.000 FORMAT "%8.3" EXTENDED_LIMITS -32768.00 32767.00 DEPOSIT ABSOLUTE /end AXIS_DESCR
/end CHARACTERISTIC
/begin CHARACTERISTIC PCR_qRgtOff_CUR "Mengenkennlinie für Reglerabschaltschwelle in Abhängigkeit von der Drehzahl" CURVE 0xF22C8 Kl_Xs16_Ws16 200.0000 InjMass 0.00 200.0000 FORMAT "%8.4" EXTENDED_LIMITS -327.6800 327.6700
 /begin AXIS_DESCR STD_AXIS Eng_nAvrg EngN 9 0.00 8000.000 FORMAT "%8.3" EXTENDED_LIMITS -32768.00 32767.00 DEPOSIT ABSOLUTE /end AXIS_DESCR
/end CHARACTERISTIC
/begin CHARACTERISTIC PCR_qRgtOnRgn_CUR "Mengenkennlinie für Reglereinschaltschwelle in Abhängigkeit von der Drehzahl für Partikelfilter Regeneration" CURVE 0xF22EE Kl_Xs16_Ws16 200.0000 InjMass 0.00 200.0000 FORMAT "%8.4" EXTENDED_LIMITS -327.6800 327.6700
 /begin AXIS_DESCR STD_AXIS Eng_nAvrg EngN 9 0.00 8000.000 FORMAT "%8.3" EXTENDED_LIMITS -32768.00 32767.00 DEPOSIT ABSOLUTE /end AXIS_DESCR
/end CHARACTERISTIC
/begin CHARACTERISTIC PCR_qRgtOn_CUR "Mengenkennlinie für Reglereinschaltschwelle in Abhängigkeit von der Drehzahl" CURVE 0xF2314 Kl_Xs16_Ws16 200.0000 InjMass 0.00 200.0000 FORMAT "%8.4" EXTENDED_LIMITS -327.6800 327.6700
 /begin AXIS_DESCR STD_AXIS Eng_nAvrg EngN 9 0.00 8000.000 FORMAT "%8.3" EXTENDED_LIMITS -32768.00 32767.00 DEPOSIT ABSOLUTE /end AXIS_DESCR
/end CHARACTERISTIC
/begin CHARACTERISTIC PCR_qWrkSph2_C "obere Mengengrenze des Arbeitsbereichs 2" VALUE 0xF233A Kw_Ws16 200.0000 InjMass 0.00 200.0000 FORMAT "%8.4" EXTENDED_LIMITS -327.6800 327.6700 /end CHARACTERISTIC
/begin CHARACTERISTIC PCR_qWrkSph3_C "Einspritzmengengrenze zwischen den Arbeitsbereichen 2 und 3" VALUE 0xF233C Kw_Ws16 200.0000 InjMass 0.00 200.0000 FORMAT "%8.4" EXTENDED_LIMITS -327.6800 327.6700 /end CHARACTERISTIC
/begin CHARACTERISTIC PCR_rAdPCVCtlValMax_C "Maximale Grenze fuer Adaptives Vorsteuerkennfeld" VALUE 0xF041C Kw_Ws16 100.0000 Prc 0.00 100.0000 FORMAT "%8.4" EXTENDED_LIMITS -400.0000 399.9878 /end CHARACTERISTIC
/begin CHARACTERISTIC PCR_rAdPCVCtlValMin_C "Minimale Grenze fuer Adaptives Vorsteuerkennfeld" VALUE 0xF041E Kw_Ws16 100.0000 Prc 0.00 100.0000 FORMAT "%8.4" EXTENDED_LIMITS -400.0000 399.9878 /end CHARACTERISTIC
/begin CHARACTERISTIC PCR_rARWIMin_C "Minimum value in case of ""Anti-Reset-Windup""" VALUE 0xF0B10 Kw_Ws16 100.0000 Prc 0.00 100.0000 FORMAT "%8.4" EXTENDED_LIMITS -400.0000 399.9878 /end CHARACTERISTIC
/begin CHARACTERISTIC PCR_rBPACDAdd_Vector "Bypass-Label für additiven Bypass von PCR_rBPACD (Nicht verstellen!)" VALUE 0xC399A Kw_Wu8 255.0 OneToOne 0.00 255.0 FORMAT "%5.1" /end CHARACTERISTIC
/begin CHARACTERISTIC PCR_rBPACDAdd_Channel "Bypass-Label für additiven Bypass von PCR_rBPACD (Nicht verstellen!)" VALUE 0xC399B Kw_Wu8 255.0 OneToOne 0.00 255.0 FORMAT "%5.1" /end CHARACTERISTIC
/begin CHARACTERISTIC PCR_rBPACD_Vector "Bypass-Label für PCR_rBPACD (Nicht verstellen!)" VALUE 0xC399C Kw_Wu8 255.0 OneToOne 0.00 255.0 FORMAT "%5.1" /end CHARACTERISTIC
/begin CHARACTERISTIC PCR_rBPACD_Channel "Bypass-Label für PCR_rBPACD (Nicht verstellen!)" VALUE 0xC399D Kw_Wu8 255.0 OneToOne 0.00 255.0 FORMAT "%5.1" /end CHARACTERISTIC
/begin CHARACTERISTIC PCR_rBPBasLPRgn1_MAP "1. RGN Map für LPA" MAP 0xF1310 Kf_Xs16_Ys16_Ws16 100.0000 Prc 0.00 100.0000 FORMAT "%8.4" EXTENDED_LIMITS -400.0000 399.9878
 /begin AXIS_DESCR STD_AXIS Eng_nAvrg EngN 16 0.00 8000.000 FORMAT "%8.3" EXTENDED_LIMITS -32768.00 32767.00 DEPOSIT ABSOLUTE /end AXIS_DESCR
 /begin AXIS_DESCR STD_AXIS PCR_qDes InjMass 16 0.00 200.0000 FORMAT "%8.4" EXTENDED_LIMITS -327.6800 327.6700 DEPOSIT ABSOLUTE /end AXIS_DESCR
/end CHARACTERISTIC
/begin CHARACTERISTIC PCR_rBPBasLPRgn2_MAP "2. RGN Map für LPA" MAP 0xF1554 Kf_Xs16_Ys16_Ws16 100.0000 Prc 0.00 100.0000 FORMAT "%8.4" EXTENDED_LIMITS -400.0000 399.9878
 /begin AXIS_DESCR STD_AXIS Eng_nAvrg EngN 16 0.00 8000.000 FORMAT "%8.3" EXTENDED_LIMITS -32768.00 32767.00 DEPOSIT ABSOLUTE /end AXIS_DESCR
 /begin AXIS_DESCR STD_AXIS PCR_qDes InjMass 16 0.00 200.0000 FORMAT "%8.4" EXTENDED_LIMITS -327.6800 327.6700 DEPOSIT ABSOLUTE /end AXIS_DESCR
/end CHARACTERISTIC
/begin CHARACTERISTIC PCR_rBPBasLP_MAP "KF TV an steller(LPA) bei Kompressorbypass geschlossen" MAP 0xF1798 Kf_Xs16_Ys16_Ws16 100.0000 Prc 0.00 100.0000 FORMAT "%8.4" EXTENDED_LIMITS -400.0000 399.9878
 /begin AXIS_DESCR STD_AXIS Eng_nAvrg EngN 16 0.00 8000.000 FORMAT "%8.3" EXTENDED_LIMITS -32768.00 32767.00 DEPOSIT ABSOLUTE /end AXIS_DESCR
 /begin AXIS_DESCR STD_AXIS PCR_qDes InjMass 16 0.00 200.0000 FORMAT "%8.4" EXTENDED_LIMITS -327.6800 327.6700 DEPOSIT ABSOLUTE /end AXIS_DESCR
/end CHARACTERISTIC
/begin CHARACTERISTIC PCR_rBPGovMaxCorr_MAP "Correction factor(MAX) of D-parameter according to engine speed and particle filter soot mass" MAP 0xF0420 Kf_Xs16_Ys16_Ws16 100.0000 Prc 0.00 100.0000 FORMAT "%8.4" EXTENDED_LIMITS -400.0000 399.9878
 /begin AXIS_DESCR STD_AXIS Eng_nAvrg EngN 16 0.00 8000.000 FORMAT "%8.3" EXTENDED_LIMITS -32768.00 32767.00 DEPOSIT ABSOLUTE /end AXIS_DESCR
 /begin AXIS_DESCR STD_AXIS PCR_qReal InjMassCyc 10 0.00 100.0000 FORMAT "%8.4" EXTENDED_LIMITS -327.6800 327.6700 DEPOSIT ABSOLUTE /end AXIS_DESCR
/end CHARACTERISTIC
/begin CHARACTERISTIC PCR_rBPGovMaxDynCorr_MAP "MAP für dynamische Korrektur des BP-Regler-Maximums" MAP 0xF0598 Kf_Xs16_Ys16_Ws16 100.0000 Prc 0.00 100.0000 FORMAT "%8.4" EXTENDED_LIMITS -400.0000 399.9878
 /begin AXIS_DESCR STD_AXIS APSCD_pVal Pres_hPa 8 0.00 4000.000 FORMAT "%8.3" EXTENDED_LIMITS -32768.00 32767.00 DEPOSIT ABSOLUTE /end AXIS_DESCR
 /begin AXIS_DESCR STD_AXIS Eng_nAvrg EngN 8 40.00000 6000.000 FORMAT "%8.3" EXTENDED_LIMITS -32768.00 32767.00 DEPOSIT ABSOLUTE /end AXIS_DESCR
/end CHARACTERISTIC
/begin CHARACTERISTIC PCR_rBPGovMaxDynEnd_C "Ramp correction end value for maximum allowable PCR governor output" VALUE 0xF063C Kw_Ws16 100.0000 Prc 0.00 100.0000 FORMAT "%8.4" EXTENDED_LIMITS -400.0000 399.9878 /end CHARACTERISTIC
/begin CHARACTERISTIC PCR_rBPGovMaxDynStrt_C "Ramp correction start value for maximum allowable PCR governor output" VALUE 0xF063E Kw_Ws16 100.0000 Prc 0.00 100.0000 FORMAT "%8.4" EXTENDED_LIMITS -400.0000 399.9878 /end CHARACTERISTIC
/begin CHARACTERISTIC PCR_rBPGovMaxDyn_MAP "Map for Maximum allowable PCR output for actuator" MAP 0xF0640 Kf_Xs16_Ys16_Ws16 100.0000 Prc 0.00 100.0000 FORMAT "%8.4" EXTENDED_LIMITS -400.0000 399.9878
 /begin AXIS_DESCR STD_AXIS Eng_nAvrg EngN 8 40.00000 6000.000 FORMAT "%8.3" EXTENDED_LIMITS -32768.00 32767.00 DEPOSIT ABSOLUTE /end AXIS_DESCR
 /begin AXIS_DESCR STD_AXIS PCR_qReal InjMassCyc 8 0.00 100.0000 FORMAT "%8.4" EXTENDED_LIMITS -327.6800 327.6700 DEPOSIT ABSOLUTE /end AXIS_DESCR
/end CHARACTERISTIC
/begin CHARACTERISTIC PCR_rBPRglBasLPRgn1_MAP "KF fuer Vorsteuertastverhaeltnis" MAP 0xF19DC Kf_Xs16_Ys16_Ws16 100.0000 Prc 0.00 100.0000 FORMAT "%8.4" EXTENDED_LIMITS -400.0000 399.9878
 /begin AXIS_DESCR STD_AXIS Eng_nAvrg EngN 16 0.00 8000.000 FORMAT "%8.3" EXTENDED_LIMITS -32768.00 32767.00 DEPOSIT ABSOLUTE /end AXIS_DESCR
 /begin AXIS_DESCR STD_AXIS PCR_qDes InjMass 16 0.00 200.0000 FORMAT "%8.4" EXTENDED_LIMITS -327.6800 327.6700 DEPOSIT ABSOLUTE /end AXIS_DESCR
/end CHARACTERISTIC
/begin CHARACTERISTIC PCR_rBPRglBasLPRgn2_MAP "KF fuer Vorsteuertastverhaeltnis" MAP 0xF1C20 Kf_Xs16_Ys16_Ws16 100.0000 Prc 0.00 100.0000 FORMAT "%8.4" EXTENDED_LIMITS -400.0000 399.9878
 /begin AXIS_DESCR STD_AXIS Eng_nAvrg EngN 16 0.00 8000.000 FORMAT "%8.3" EXTENDED_LIMITS -32768.00 32767.00 DEPOSIT ABSOLUTE /end AXIS_DESCR
 /begin AXIS_DESCR STD_AXIS PCR_qDes InjMass 16 0.00 200.0000 FORMAT "%8.4" EXTENDED_LIMITS -327.6800 327.6700 DEPOSIT ABSOLUTE /end AXIS_DESCR
/end CHARACTERISTIC
/begin CHARACTERISTIC PCR_rBPRglBasLP_MAP "KF fuer Vorsteuertastverhaeltnis" MAP 0xF1E64 Kf_Xs16_Ys16_Ws16 100.0000 Prc 0.00 100.0000 FORMAT "%8.4" EXTENDED_LIMITS -400.0000 399.9878
 /begin AXIS_DESCR STD_AXIS Eng_nAvrg EngN 16 0.00 8000.000 FORMAT "%8.3" EXTENDED_LIMITS -32768.00 32767.00 DEPOSIT ABSOLUTE /end AXIS_DESCR
 /begin AXIS_DESCR STD_AXIS PCR_qDes InjMass 16 0.00 200.0000 FORMAT "%8.4" EXTENDED_LIMITS -327.6800 327.6700 DEPOSIT ABSOLUTE /end AXIS_DESCR
/end CHARACTERISTIC
/begin CHARACTERISTIC PCR_rCBOpn_C "Stellgroesze fuer den Ladedrucksteller bei geoeffnetem Verdichterbypass" VALUE 0xF233E Kw_Ws16 799.9878 Prc -400.0000 399.9878 FORMAT "%8.4" /end CHARACTERISTIC
/begin CHARACTERISTIC PCR_rDflVal04_C "Default Verhältnis für 'Default Schalter' prio 4" VALUE 0xF2340 Kw_Ws16 799.9878 Prc -400.0000 399.9878 FORMAT "%8.4" /end CHARACTERISTIC
/begin CHARACTERISTIC PCR_rDflVal05_C "Default Verhältnis für 'Default Schalter' prio 5" VALUE 0xF2342 Kw_Ws16 799.9878 Prc -400.0000 399.9878 FORMAT "%8.4" /end CHARACTERISTIC
/begin CHARACTERISTIC PCR_rDflVal06_C "Defaultwert 6 für relative Stellung des Ladedruckstellers" VALUE 0xF2344 Kw_Ws16 799.9878 Prc -400.0000 399.9878 FORMAT "%8.4" /end CHARACTERISTIC
/begin CHARACTERISTIC PCR_rDflVal12_C "Defaultwert 12 für relative Stellung des Ladedruckstellers" VALUE 0xF2346 Kw_Ws16 799.9878 Prc -400.0000 399.9878 FORMAT "%8.4" /end CHARACTERISTIC
/begin CHARACTERISTIC PCR_rDflVal15_MAP "Default value map for the output of the two actuators" MAP 0xF2348 Kf_Xs16_Ys16_Ws16 300.0000 Prc -100.0000 200.0000 FORMAT "%8.4" EXTENDED_LIMITS -400.0000 399.9878
 /begin AXIS_DESCR STD_AXIS Eng_nAvrg EngN 8 0.00 6000.000 FORMAT "%8.3" EXTENDED_LIMITS -32768.00 32767.00 DEPOSIT ABSOLUTE /end AXIS_DESCR
 /begin AXIS_DESCR STD_AXIS PCR_qReal InjMassCyc 8 0.00 327.6700 FORMAT "%8.4" EXTENDED_LIMITS -327.6800 327.6700 DEPOSIT ABSOLUTE /end AXIS_DESCR
/end CHARACTERISTIC
/begin CHARACTERISTIC PCR_rDflVal18Rgn_MAP "Vorgabewert bei Kupplung und Regeneration" MAP 0xF23EC Kf_Xs16_Ys16_Ws16 100.0000 Prc 0.00 100.0000 FORMAT "%8.4" EXTENDED_LIMITS -400.0000 399.9878
 /begin AXIS_DESCR STD_AXIS Eng_nAvrg EngN 8 0.00 6000.000 FORMAT "%8.3" EXTENDED_LIMITS -32768.00 32767.00 DEPOSIT ABSOLUTE /end AXIS_DESCR
 /begin AXIS_DESCR STD_AXIS PCR_qReal InjMassCyc 8 0.00 327.6700 FORMAT "%8.4" EXTENDED_LIMITS -327.6800 327.6700 DEPOSIT ABSOLUTE /end AXIS_DESCR
/end CHARACTERISTIC
/begin CHARACTERISTIC PCR_rDflVal18_C "Defaultwert 18 für relative Stellung des Ladedruckstellers" VALUE 0xF2490 Kw_Ws16 799.9878 Prc -400.0000 399.9878 FORMAT "%8.4" /end CHARACTERISTIC
/begin CHARACTERISTIC PCR_rDflVal24_C "Defaultwert 24 für relative Stellung des Ladedruckstellers" VALUE 0xF2492 Kw_Ws16 799.9878 Prc -400.0000 399.9878 FORMAT "%8.4" /end CHARACTERISTIC
/begin CHARACTERISTIC PCR_rDistAdPCV1_C "Verzerrung eingang des I1-Reglers" VALUE 0xF06E4 Kw_Ws16 100.0000 Prc 0.00 100.0000 FORMAT "%8.4" EXTENDED_LIMITS -400.0000 399.9878 /end CHARACTERISTIC
/begin CHARACTERISTIC PCR_rDistAdPCV2_C "Verzerrung eingang des I2-Reglers" VALUE 0xF06E6 Kw_Ws16 100.0000 Prc 0.00 100.0000 FORMAT "%8.4" EXTENDED_LIMITS -400.0000 399.9878 /end CHARACTERISTIC
/begin CHARACTERISTIC PCR_rDistAdPCV3_C "Verzerrung eingang des I3-Reglers" VALUE 0xF06E8 Kw_Ws16 100.0000 Prc 0.00 100.0000 FORMAT "%8.4" EXTENDED_LIMITS -400.0000 399.9878 /end CHARACTERISTIC
/begin CHARACTERISTIC PCR_rDistAdPCV4_C "Verzerrung eingang des I4-Reglers" VALUE 0xF06EA Kw_Ws16 100.0000 Prc 0.00 100.0000 FORMAT "%8.4" EXTENDED_LIMITS -400.0000 399.9878 /end CHARACTERISTIC
/begin CHARACTERISTIC PCR_rDt1InitLP_C "Initialisierungs-Wert fuer DT1-Regler" VALUE 0xF20A8 Kw_Ws16 200.0000 Prc -100.0000 100.0000 FORMAT "%8.4" EXTENDED_LIMITS -400.0000 399.9878 /end CHARACTERISTIC
/begin CHARACTERISTIC PCR_rGovMaxLP_C "Maximale Grenze fuer Regler Ausgang" VALUE 0xF20AA Kw_Ws16 200.0000 Prc -100.0000 100.0000 FORMAT "%8.4" EXTENDED_LIMITS -400.0000 399.9878 /end CHARACTERISTIC
/begin CHARACTERISTIC PCR_rGovMinLP_C "Minimale Grenze fuer Regler Ausgang" VALUE 0xF20AC Kw_Ws16 200.0000 Prc -100.0000 100.0000 FORMAT "%8.4" EXTENDED_LIMITS -400.0000 399.9878 /end CHARACTERISTIC
/begin CHARACTERISTIC PCR_rGvnrMax_CUR "Kennlinie zur Bestimmung der maximal zulässigen Stellgroesse aus dem Verbrauch" CURVE 0xF06EC Kl_Xs16_Ws16 300.0000 Prc -100.0000 200.0000 FORMAT "%8.4" EXTENDED_LIMITS -400.0000 399.9878
 /begin AXIS_DESCR STD_AXIS CoEng_dvolFlConsum FlConsum_l_h 16 0.00 327.6700 FORMAT "%8.4" EXTENDED_LIMITS -327.6800 327.6700 DEPOSIT ABSOLUTE /end AXIS_DESCR
/end CHARACTERISTIC
/begin CHARACTERISTIC PCR_rGvnrMax_MAP "Kennfeld/Kennlinie zur Bestimmung der maximal zulässigen Stellgröße aus Drehzahl und Einspritzmenge" MAP 0xF072E Kf_Xs16_Ys16_Ws16 300.0000 Prc -100.0000 200.0000 FORMAT "%8.4" EXTENDED_LIMITS -400.0000 399.9878
 /begin AXIS_DESCR STD_AXIS Eng_nAvrg EngN 16 0.00 8000.000 FORMAT "%8.3" EXTENDED_LIMITS -32768.00 32767.00 DEPOSIT ABSOLUTE /end AXIS_DESCR
 /begin AXIS_DESCR STD_AXIS PCR_qReal InjMassCyc 16 0.00 200.0000 FORMAT "%8.4" EXTENDED_LIMITS -327.6800 327.6700 DEPOSIT ABSOLUTE /end AXIS_DESCR
/end CHARACTERISTIC
/begin CHARACTERISTIC PCR_rGvnrMin_CUR "Kennlinie zur Bestimmung der minimal zulässigen Stellgoesse aus dem Verbrauch" CURVE 0xF0972 Kl_Xs16_Ws16 300.0000 Prc -100.0000 200.0000 FORMAT "%8.4" EXTENDED_LIMITS -400.0000 399.9878
 /begin AXIS_DESCR STD_AXIS CoEng_dvolFlConsum FlConsum_l_h 2 0.00 327.6700 FORMAT "%8.4" EXTENDED_LIMITS -327.6800 327.6700 DEPOSIT ABSOLUTE /end AXIS_DESCR
/end CHARACTERISTIC
/begin CHARACTERISTIC PCR_rGvnrMin_MAP "Kennfeld/Kennlinie zur Bestimmung der minimal zulässigen Stellgröße aus Drehzahl und Einspritzmenge" MAP 0xF097C Kf_Xs16_Ys16_Ws16 300.0000 Prc -100.0000 200.0000 FORMAT "%8.4" EXTENDED_LIMITS -400.0000 399.9878
 /begin AXIS_DESCR STD_AXIS Eng_nAvrg EngN 4 0.00 8000.000 FORMAT "%8.3" EXTENDED_LIMITS -32768.00 32767.00 DEPOSIT ABSOLUTE /end AXIS_DESCR
 /begin AXIS_DESCR STD_AXIS PCR_qReal InjMassCyc 4 0.00 200.0000 FORMAT "%8.4" EXTENDED_LIMITS -327.6800 327.6700 DEPOSIT ABSOLUTE /end AXIS_DESCR
/end CHARACTERISTIC
/begin CHARACTERISTIC PCR_rIInitLP_C "Initialisierungs-Wert fuer PI-Regler" VALUE 0xF20AE Kw_Ws16 200.0000 Prc -100.0000 100.0000 FORMAT "%8.4" EXTENDED_LIMITS -400.0000 399.9878 /end CHARACTERISTIC
/begin CHARACTERISTIC PCR_rLPDflVal09_C "Vorgabewert 9 für Regelungsausgang" VALUE 0xF21FE Kw_Ws16 799.9878 Prc -400.0000 399.9878 FORMAT "%8.4" /end CHARACTERISTIC
/begin CHARACTERISTIC PCR_rLPDflVal12_C "Vorgabewert 12 für Regelungsausgang" VALUE 0xF2200 Kw_Ws16 799.9878 Prc -400.0000 399.9878 FORMAT "%8.4" /end CHARACTERISTIC
/begin CHARACTERISTIC PCR_rLPDflVal18_C "Vorgabewert 18 für Regelungsausgang" VALUE 0xF2202 Kw_Ws16 799.9878 Prc -400.0000 399.9878 FORMAT "%8.4" /end CHARACTERISTIC
/begin CHARACTERISTIC PCR_rMaxLP_C "Maximale Grenze fuer PID + Vorsteuertastverhaeltnis Ausgang" VALUE 0xF20B0 Kw_Ws16 200.0000 Prc -100.0000 100.0000 FORMAT "%8.4" EXTENDED_LIMITS -400.0000 399.9878 /end CHARACTERISTIC
/begin CHARACTERISTIC PCR_rMinLP_C "Minimale Grenze fuer PID + Vorsteuertastverhaeltnis Ausgang" VALUE 0xF20B2 Kw_Ws16 200.0000 Prc -100.0000 100.0000 FORMAT "%8.4" EXTENDED_LIMITS -400.0000 399.9878 /end CHARACTERISTIC
/begin CHARACTERISTIC PCR_rOutIMaxLP_MAP "Limitierung des I-Reglers für LP-Betrieb" MAP 0xF20B4 Kf_Xs16_Ys16_Ws16 5.004883 Prc 0.00 5.004883 FORMAT "%8.6" EXTENDED_LIMITS -400.0000 399.9878
 /begin AXIS_DESCR STD_AXIS BPSCD_dFltValDT1 dp_dZ10 4 -350000.0 350000.0 FORMAT "%8.1" EXTENDED_LIMITS -327680.0 327670.0 DEPOSIT ABSOLUTE /end AXIS_DESCR
 /begin AXIS_DESCR STD_AXIS Eng_nAvrg EngN 2 40.00000 6000.000 FORMAT "%8.3" EXTENDED_LIMITS -32768.00 32767.00 DEPOSIT ABSOLUTE /end AXIS_DESCR
/end CHARACTERISTIC
/begin CHARACTERISTIC PCR_rOutIMax_MAP "Kennfeld zur Limitierung des I-Reglers über Drehzahl und differentzierten gefilterteren Werts des Ladedrucks" MAP 0xF09B0 Kf_Xs16_Ys16_Ws16 5.004883 Prc 0.00 5.004883 FORMAT "%8.6" EXTENDED_LIMITS -400.0000 399.9878
 /begin AXIS_DESCR STD_AXIS BPSCD_dFltValDT1 dp_dZ10 8 -350000.0 350000.0 FORMAT "%8.1" EXTENDED_LIMITS -327680.0 327670.0 DEPOSIT ABSOLUTE /end AXIS_DESCR
 /begin AXIS_DESCR STD_AXIS InjCtl_qCurr InjMassCyc 8 0.00 200.0000 FORMAT "%8.4" EXTENDED_LIMITS -327.6800 327.6700 DEPOSIT ABSOLUTE /end AXIS_DESCR
/end CHARACTERISTIC
/begin CHARACTERISTIC PCR_rOutIMin_MAP "Kennfeld zur Minimal Begrenzung des I-Regler" MAP 0xF0A54 Kf_Xs16_Ys16_Ws16 5.004883 Prc 0.00 5.004883 FORMAT "%8.6" EXTENDED_LIMITS -400.0000 399.9878
 /begin AXIS_DESCR STD_AXIS BPSCD_dFltValDT1 dp_dZ10 8 -350000.0 350000.0 FORMAT "%8.1" EXTENDED_LIMITS -327680.0 327670.0 DEPOSIT ABSOLUTE /end AXIS_DESCR
 /begin AXIS_DESCR STD_AXIS InjCtl_qCurr InjMassCyc 8 0.00 200.0000 FORMAT "%8.4" EXTENDED_LIMITS -327.6800 327.6700 DEPOSIT ABSOLUTE /end AXIS_DESCR
/end CHARACTERISTIC
/begin CHARACTERISTIC PCR_rSurgeGvnrOff_CUR "Wert" CURVE 0xF2700 Kl_Xs16_Ws16 799.9878 Prc -400.0000 399.9878 FORMAT "%8.4"
 /begin AXIS_DESCR STD_AXIS Eng_nAvrg EngN 5 0.00 6000.000 FORMAT "%8.3" EXTENDED_LIMITS -32768.00 32767.00 DEPOSIT ABSOLUTE /end AXIS_DESCR
/end CHARACTERISTIC
/begin CHARACTERISTIC PCR_rSurgeGvnrOn_MAP "Kennfeld" MAP 0xF2716 Kf_Xs16_Ys16_Ws16 100.0000 Prc 0.00 100.0000 FORMAT "%8.4" EXTENDED_LIMITS -400.0000 399.9878
 /begin AXIS_DESCR STD_AXIS Eng_nAvrg EngN 6 0.00 6000.000 FORMAT "%8.3" EXTENDED_LIMITS -32768.00 32767.00 DEPOSIT ABSOLUTE /end AXIS_DESCR
 /begin AXIS_DESCR STD_AXIS APSCD_pLinVal Pres_hPa 4 -32768.00 32767.00 FORMAT "%8.2" DEPOSIT ABSOLUTE /end AXIS_DESCR
/end CHARACTERISTIC
/begin CHARACTERISTIC PCR_rSurgeGvnr_MAP "kennlinie für Ladedrucksteuersignal aus AntiSurge-Regler Eingangsgrößen" MAP 0xF275E Kf_Xs16_Ys16_Ws16 100.0000 Prc 0.00 100.0000 FORMAT "%8.4" EXTENDED_LIMITS -400.0000 399.9878
 /begin AXIS_DESCR STD_AXIS PCR_pBSurgePICtlLim_mp Pres_hPa 5 -32768.00 32767.00 FORMAT "%8.2" DEPOSIT ABSOLUTE /end AXIS_DESCR
 /begin AXIS_DESCR STD_AXIS Eng_nAvrg EngN 5 0.00 6000.000 FORMAT "%8.3" EXTENDED_LIMITS -32768.00 32767.00 DEPOSIT ABSOLUTE /end AXIS_DESCR
/end CHARACTERISTIC
/begin CHARACTERISTIC PCR_stAdPCVReset_C "Status fuer die eeprom Spiegel-Werte neu zu fassen" VALUE 0xF0AF8 Kw_Wu8 255.0 OneToOne 0.00 255.0 FORMAT "%5.1" /end CHARACTERISTIC
/begin CHARACTERISTIC PCR_stClutchRgnMsk_C "Maske für die Aktivierung bei Kupplung und Regeneration" VALUE 0xF2494 Kw_Wu32 4294967295.00 OneToOne 0.00 4294967295.00 FORMAT "%13.2" /end CHARACTERISTIC
/begin CHARACTERISTIC PCR_stCmpntActv_C "Deaktivierung der Überwachung auf bleibende Reglerabweichung bei Endstufenabschaltung" VALUE 0xF2498 Kw_Wu16 65535.00 OneToOne 0.00 65535.00 FORMAT "%8.2" /end CHARACTERISTIC
/begin CHARACTERISTIC PCR_stInhGvnrDvt_C "Statuswort zur Verriegelung der Überwachung der Regelabweichung während Stellertest" VALUE 0xF249A Kw_Wu16 65535.00 OneToOne 0.00 65535.00 FORMAT "%8.2" /end CHARACTERISTIC
/begin CHARACTERISTIC PCR_stLPMonCur_C "Schalter für EGT" VALUE 0xF2204 Kw_Wu32 4294967295.00 OneToOne 0.00 4294967295.00 FORMAT "%13.2" /end CHARACTERISTIC
/begin CHARACTERISTIC PCR_stMonCur_C "Bit Mask for EGT_st" VALUE 0xF249C Kw_Wu32 4294967295.00 OneToOne 0.00 4294967295.00 FORMAT "%13.2" /end CHARACTERISTIC
/begin CHARACTERISTIC PCR_stRgnMsk1_C "applizierbare Bitmaske für erstes Regenerationskennfeld" VALUE 0xF00A4 Kw_Wu32 4294967295.00 OneToOne 0.00 4294967295.00 FORMAT "%13.2" /end CHARACTERISTIC
/begin CHARACTERISTIC PCR_stRgnMsk2_C "applizierbare Bitmaske für zweites Regenerationskennfeld" VALUE 0xF00A8 Kw_Wu32 4294967295.00 OneToOne 0.00 4294967295.00 FORMAT "%13.2" /end CHARACTERISTIC
/begin CHARACTERISTIC PCR_stRgnMskLP1_C "Erste Maske für Auswahl LPGov Regeneration Mode" VALUE 0xF20D4 Kw_Wu32 4294967295.00 OneToOne 0.00 4294967295.00 FORMAT "%13.2" /end CHARACTERISTIC
/begin CHARACTERISTIC PCR_stRgnMskLP2_C "Zweite Maske für Auswahl LPGov Regeneration Mode" VALUE 0xF20D8 Kw_Wu32 4294967295.00 OneToOne 0.00 4294967295.00 FORMAT "%13.2" /end CHARACTERISTIC
/begin CHARACTERISTIC PCR_tiDebSurge1_C "Parameter 1 für die Entprellung der Erkennung oszillierende Luftmasse mit großer Amplitude" VALUE 0xF2868 Kw_Wu16 655140.0 TimeDeb 0.00 655140.0 FORMAT "%8.1" EXTENDED_LIMITS 0.00 655350.0 /end CHARACTERISTIC
/begin CHARACTERISTIC PCR_tiDebSurge2_C "Parameter 2 für die Entprellung der Erkennung oszillierende Luftmasse mit großer Amplitude" VALUE 0xF286A Kw_Wu16 655140.0 TimeDeb 0.00 655140.0 FORMAT "%8.1" EXTENDED_LIMITS 0.00 655350.0 /end CHARACTERISTIC
/begin CHARACTERISTIC PCR_tiSurgeDetMDT12_C "Zeitabschnitt für die zweiten DT1-filter" VALUE 0xF286C Kw_Wu32 4294.9663 TimeDelay_s 0.0010000001 4294.9673 FORMAT "%9.4" EXTENDED_LIMITS 0.0000010000000 4294.9673 /end CHARACTERISTIC
/begin CHARACTERISTIC PCR_DKdSurgeDetMDT12_C "Applikationslabel für kd" VALUE 0xF2870 Kw_Ws32 65535.9999847 Kd -32768.0000000 32767.9999847 FORMAT "%13.7" /end CHARACTERISTIC
/begin CHARACTERISTIC PCR_tiSurgeDetMDT1_C "Zeitabschnitt für die DT1-filter" VALUE 0xF2874 Kw_Wu32 4294.9663 TimeDelay_s 0.0010000001 4294.9673 FORMAT "%9.4" EXTENDED_LIMITS 0.0000010000000 4294.9673 /end CHARACTERISTIC
/begin CHARACTERISTIC PCR_DKdSurgeDetMDT1_C "Applikationslabel für kd" VALUE 0xF2878 Kw_Ws32 65535.9999847 Kd -32768.0000000 32767.9999847 FORMAT "%13.7" /end CHARACTERISTIC
/begin CHARACTERISTIC PCR_tiSurgeGvnrPT1_C "Parameter für PT1-Glied für Tiefpassfilterung der Regelabwei-chung für I Anteil" VALUE 0xF27A8 Kw_Wu32 4294.9663 TimeDelay_s 0.0010000001 4294.9673 FORMAT "%9.4" EXTENDED_LIMITS 0.0000010000000 4294.9673 /end CHARACTERISTIC
/begin CHARACTERISTIC PCR_swtActSlpLim_C "Schalter Status Sollwert AbfallBegrenzung (1: PWG/Menge, 0: Ladedrucksollwert)" VALUE 0xF00AC Kw_Wu8 255.0 OneToOne 0.00 255.0 FORMAT "%5.1" /end CHARACTERISTIC
/begin CHARACTERISTIC PCR_swtAdPCVrLim_C "Schalter Status Stop Lernen - Anhebung / Absenkung adaptiver Vorsteuerwertes (0: >0, 1: <0)" VALUE 0xF0AF9 Kw_Wu8 255.0 OneToOne 0.00 255.0 FORMAT "%5.1" /end CHARACTERISTIC
/begin CHARACTERISTIC PCR_swtAirPerTimeDet_C "Schalter zur Auswahl der Erfassung der Luftmassenschwingung mittels DFT oder PT1" VALUE 0xF287C Kw_Wu8 1.000 OneToOne 0.00 1.000 FORMAT "%5.3" EXTENDED_LIMITS 0.00 255.0 /end CHARACTERISTIC
/begin CHARACTERISTIC PCR_swtARWMode_C "Schalter für ""Anti-Reset-Windup""- Massnahme (0: einfrieren, 1: rückrechnen)" VALUE 0xF0B12 Kw_Wu8 1.000 OneToOne 0.00 1.000 FORMAT "%5.3" EXTENDED_LIMITS 0.00 255.0 /end CHARACTERISTIC
/begin CHARACTERISTIC PCR_swtFacCnv_C "Schalter zur Umschaltung des Faktors mit Konversion" VALUE 0xF287D Kw_Wu8 1.000 OneToOne 0.00 1.000 FORMAT "%5.3" EXTENDED_LIMITS 0.00 255.0 /end CHARACTERISTIC
/begin CHARACTERISTIC PCR_swtIDevType_C "Deviation I/P  Integrator selection switch (0: Zusatzfunktion aktiviert, 1: deaktiviert)" VALUE 0xF0AFA Kw_Wu8 255.0 OneToOne 0.00 255.0 FORMAT "%5.1" /end CHARACTERISTIC
/begin CHARACTERISTIC PCR_swtLimMpCrVal_C "Schalter zur Auswahl der Größen, aus denen der Stellgrößenbereich bestimmt wird (1: Verbrauch, 0: Drehzahl und Einspritzmenge)" VALUE 0xF0AFB Kw_Wu8 0.00 OneToOne 1.000 1.000 FORMAT "%5.3" EXTENDED_LIMITS 0.00 255.0 /end CHARACTERISTIC
/begin CHARACTERISTIC PCR_swtLimMpCrType_C "Schaltertyp zur Auswahl der Größen, aus denen der zulässige Stellgrößenbereich bestimmt wird" VALUE 0xF0AFC Kw_Wu8 0.00 OneToOne 0.00 0.00 FORMAT "%5.2" EXTENDED_LIMITS 0.00 255.0 /end CHARACTERISTIC
/begin CHARACTERISTIC PCR_swtLimSelVal_C "Auswahl Größen f. Bestimmung des zuläss. Stellgrößenbereichs (P263:bei Init. gelesen)(0:PCR_swtLimSel_CSTR; 1:Eng_nAvrg,qInjCtl)" VALUE 0xF0AFD Kw_Wu8 0.00 OneToOne 1.000 1.000 FORMAT "%5.3" EXTENDED_LIMITS 0.00 255.0 /end CHARACTERISTIC
/begin CHARACTERISTIC PCR_swtLimSelType_C "Schaltertyp zur Auswahl der Größen, aus denen der zulässige Stellgrößenbereich bestimmt wird" VALUE 0xF0AFE Kw_Wu8 0.00 OneToOne 0.00 0.00 FORMAT "%5.2" EXTENDED_LIMITS 0.00 255.0 /end CHARACTERISTIC
/begin CHARACTERISTIC PCR_swtLPV8_C "Schalter zur Erkennung des Defaultwertes aufgrund der Prioritätsbasis" VALUE 0xF2208 Kw_Wu8 255.0 OneToOne 0.00 255.0 FORMAT "%5.1" /end CHARACTERISTIC
/begin CHARACTERISTIC PCR_swtQntDesVal_C "Mengeneingangswunsch bei der Sollwertberechnung (1: akt Einspritzmenge, 2: Rohwert, 3: Berechnet, 4: CurrCor, d: RawCor)" VALUE 0xF00AD Kw_Wu8 4.000 OneToOne 1.000 5.000 FORMAT "%5.3" EXTENDED_LIMITS 0.00 255.0 /end CHARACTERISTIC
/begin CHARACTERISTIC PCR_swtQntDesType_C "Schaltertyp für Mengeneingangswunsch bei der Sollwertberechnung" VALUE 0xF00AE Kw_Wu8 1.000 OneToOne 1.000 2.000 FORMAT "%5.3" EXTENDED_LIMITS 0.00 255.0 /end CHARACTERISTIC
/begin CHARACTERISTIC PCR_swtRawCur_C "Auswahl der Einspritzmenge - 0: Rohwert oder 1: aktueller Wert" VALUE 0xF0AFF Kw_Wu8 255.0 OneToOne 0.00 255.0 FORMAT "%5.1" /end CHARACTERISTIC
/begin CHARACTERISTIC PCR_swtRelAbsVal_C "Schalterwert zur  Auswahl zwischen Absolut- und Relativdruckregelung  (0: absolut, 1: relativ)" VALUE 0xF0B00 Kw_Wu8 1.000 OneToOne 0.00 1.000 FORMAT "%5.3" EXTENDED_LIMITS 0.00 255.0 /end CHARACTERISTIC
/begin CHARACTERISTIC PCR_swtRelAbsType_C "Softwareschalter Typ zur  Auswahl zwischen Absolut- und Relativdruckregelung" VALUE 0xF0B01 Kw_Wu8 1.000 OneToOne 1.000 2.000 FORMAT "%5.3" EXTENDED_LIMITS 0.00 255.0 /end CHARACTERISTIC
/begin CHARACTERISTIC PCR_swtSlpLimInputType_C "Switch for selection of Slope limitation type" VALUE 0xF00AF Kw_Wu8 255.0 OneToOne 0.00 255.0 FORMAT "%5.1" /end CHARACTERISTIC
/begin CHARACTERISTIC PCR_swtSurgeARWMode_C "Schalter für ""Anti-Reset-Windup""- Massnahme (0: einfrieren, 1: rückrechnen)" VALUE 0xF27AC Kw_Wu8 1.000 OneToOne 0.00 1.000 FORMAT "%5.3" EXTENDED_LIMITS 0.00 255.0 /end CHARACTERISTIC
/begin CHARACTERISTIC PCR_swtSurgeGvnrSel_C "Shalter zum AntiSurge-Regler (Bit0 - PCR_stPreSurge: 1: on, 0: off Bit1: PCR_stSurge: 1: on, 0: off)" VALUE 0xF27AD Kw_Wu8 255.0 OneToOne 0.00 255.0 FORMAT "%5.1" /end CHARACTERISTIC
/begin CHARACTERISTIC PCR_swtV8_C "Schalter für Vorgabewert DflVal24 bei 8 Zyl. (1: verwende Vorgabewert, 0: verwende Standardwert)" VALUE 0xF24A0 Kw_Wu8 255.0 OneToOne 0.00 255.0 FORMAT "%5.1" /end CHARACTERISTIC
/begin CHARACTERISTIC PCR_tAirAdPCVMax_C "Maximale Grenze fuer Kuehlmitteltemperatur" VALUE 0xF0B02 Kw_Ws16 950.000 Temp_Cels -50.140 899.860 FORMAT "%8.3" EXTENDED_LIMITS -3549.940 3003.560 /end CHARACTERISTIC
/begin CHARACTERISTIC PCR_tAirAdPCVMin_C "Minimale Grenze fuer  Lufttemperatur" VALUE 0xF0B04 Kw_Ws16 950.000 Temp_Cels -50.140 899.860 FORMAT "%8.3" EXTENDED_LIMITS -3549.940 3003.560 /end CHARACTERISTIC
/begin CHARACTERISTIC PCR_tClntAdPCVLim_C "Minimale Grenze fuer Kuehlmittel temperatur" VALUE 0xF0B06 Kw_Ws16 950.000 Temp_Cels -50.140 899.860 FORMAT "%8.3" EXTENDED_LIMITS -3549.940 3003.560 /end CHARACTERISTIC
/begin CHARACTERISTIC PCR_tClntThres_C "Kühlwassertemperaturschwelle zur Parametersatzumschaltung bei der Berechnung des dyn. Anteils" VALUE 0xF00B0 Kw_Ws16 950.000 Temp_Cels -50.140 899.860 FORMAT "%8.3" EXTENDED_LIMITS -3549.940 3003.560 /end CHARACTERISTIC
/begin CHARACTERISTIC PCR_tiHiLoAdPCVRelCond0_C "Entprellzeit der Aktivierung Releasecondition 0 (RegelabweiRegelabweichung) der adaptiven Vorsteuerung" VALUE 0xF0B08 Kw_Wu16 655350.0 TimeDeb 0.00 655350.0 FORMAT "%8.1" /end CHARACTERISTIC
/begin CHARACTERISTIC PCR_tiLoHiAdPCVRelCond0_C "Entprellzeit der Deaktivierung Releasecondition 0 (RegelabweiRegelabweichung)der adaptiven Vorsteuerung" VALUE 0xF0B0A Kw_Wu16 655350.0 TimeDeb 0.00 655350.0 FORMAT "%8.1" /end CHARACTERISTIC
/begin CHARACTERISTIC PCR_tiHiLoAdPCVRelCond3_C "Entprellzeit der Deaktivierung Releasecondition 3 RegelabweiRegelabweichung) der adaptiven Vorsteuerung" VALUE 0xF0B0C Kw_Wu16 655350.0 TimeDeb 0.00 655350.0 FORMAT "%8.1" /end CHARACTERISTIC
/begin CHARACTERISTIC PCR_tiLoHiAdPCVRelCond3_C "Entprellzeit der Aktivierung Releasecondition 3 RegelabweiRegelabweichung)der adaptiven Vorsteuerung" VALUE 0xF0B0E Kw_Wu16 655350.0 TimeDeb 0.00 655350.0 FORMAT "%8.1" /end CHARACTERISTIC
/begin CHARACTERISTIC PCR_tiAirPerTimeAmplFlt_C "Parameter für PT1-Glied für Tiefpassfilterung der Amplitude der oszillierenden Frischluftmasse nach der DFT" VALUE 0xF2880 Kw_Wu32 4294967.3 TimeDelay_ms 0.0010000000 4294967.3 FORMAT "%9.1" /end CHARACTERISTIC
/begin CHARACTERISTIC PCR_tiAirPTCtlFlt1_C "Parameter für PT1-Glied für Tiefpassfilterung der Amplitude der oszillierenden FrischluftmasseCtl-Flt1" VALUE 0xF2884 Kw_Wu32 4294967.3 TimeDelay_ms 0.0010000000 4294967.3 FORMAT "%9.1" /end CHARACTERISTIC
/begin CHARACTERISTIC PCR_tiAirPTCtlFlt2_C "Parameter für PT1-Glied für Tiefpassfilterung der Amplitude der oszillierenden FrischluftmasseCtl-Flt2" VALUE 0xF2888 Kw_Wu32 4294967.3 TimeDelay_ms 0.0010000000 4294967.3 FORMAT "%9.1" /end CHARACTERISTIC
/begin CHARACTERISTIC PCR_tiAirPTCtlFlt3_C "Parameter for PT1-Glied for low-pass filtering of the amplitude of the" VALUE 0xF288C Kw_Wu32 4294967.3 TimeDelay_ms 0.0010000000 4294967.3 FORMAT "%9.1" /end CHARACTERISTIC
/begin CHARACTERISTIC PCR_tiBDesSlpLim_C "Time duration for which desired boost pressure value is through the ramp." VALUE 0xF00B2 Kw_Wu16 655.3500 Time_s 0.00 655.3500 FORMAT "%8.4" /end CHARACTERISTIC
/begin CHARACTERISTIC PCR_tiClutchDebHighLow_C "Entprellzeit für Kupplungssignalüberwachung von High/Low-Wechsel" VALUE 0xF24A2 Kw_Wu16 655350.0 TimeDeb 0.00 655350.0 FORMAT "%8.1" /end CHARACTERISTIC
/begin CHARACTERISTIC PCR_tiClutchDebLowHigh_C "Entprellzeit für Kupplungssignalüberwachung von Low/High-Wechsel" VALUE 0xF24A4 Kw_Wu16 655350.0 TimeDeb 0.00 655350.0 FORMAT "%8.1" /end CHARACTERISTIC
/begin CHARACTERISTIC PCR_tiCoStrt_CUR "Kennlinie für die Zeit, die die Regelung nach Startabwurf abgeschaltet bleibt" CURVE 0xF24A6 Kl_Xs16_Ws16 33000.00 Time_ms 0.00 33000.00 FORMAT "%8.2" EXTENDED_LIMITS -327680.0 327670.0
 /begin AXIS_DESCR STD_AXIS CTSCD_tClnt Temp_Cels 6 -50.1400 199.8600 FORMAT "%8.4" EXTENDED_LIMITS -3549.940 3003.560 DEPOSIT ABSOLUTE /end AXIS_DESCR
/end CHARACTERISTIC
/begin CHARACTERISTIC PCR_tiGvnrDelOff_CUR "stellt das swith weg von der Verzögerung des Reglers in der" CURVE 0xF24C0 Kl_Xs16_Ws16 20.00000 Time_s 0.00 20.00000 FORMAT "%8.5" EXTENDED_LIMITS -327.6800 327.6700
 /begin AXIS_DESCR STD_AXIS Eng_nAvrg EngN 6 0.00 6000.000 FORMAT "%8.3" EXTENDED_LIMITS -32768.00 32767.00 DEPOSIT ABSOLUTE /end AXIS_DESCR
/end CHARACTERISTIC
/begin CHARACTERISTIC PCR_tiLPClutchDebHighLow_C "Deaktivierungszeit für Kupplungserkennung" VALUE 0xF220A Kw_Wu16 655350.0 TimeDeb 0.00 655350.0 FORMAT "%8.1" /end CHARACTERISTIC
/begin CHARACTERISTIC PCR_tiLPClutchDebLowHigh_C "Aktivierungs-(Verzögerungss-)zeit für Kupplungserkennung" VALUE 0xF220C Kw_Wu16 655350.0 TimeDeb 0.00 655350.0 FORMAT "%8.1" /end CHARACTERISTIC
/begin CHARACTERISTIC PCR_tiRmpMswt_C "Rampenlaufzeit für Mehrfachumschalter" VAL_BLK 0xF00B4 Kwb_Wu32 65.535999984741210 EGTRmp 0.000000015258789066052715 65.536000000000001 FORMAT "%19.16" NUMBER 3 /end CHARACTERISTIC
/begin CHARACTERISTIC PCR_tiRmpSlp_C "Rampensteigungen für EGT_RgnSwt" VAL_BLK 0xF20DC Kwb_Wu32 65.535999984741210 EGTRmp 0.000000015258789066052715 65.536000000000001 FORMAT "%19.16" NUMBER 3 /end CHARACTERISTIC
/begin CHARACTERISTIC PCR_tiStrtDelayInit_C "Inititalisierungswert der Zeit, die der PCR nach dem Startabfall abgeschaltet bleibt" VALUE 0xF24DA Kw_Wu16 655350.0 Time_ms 0.00 655350.0 FORMAT "%8.1" /end CHARACTERISTIC
/begin CHARACTERISTIC PCR_tiSurgeCtlHiLoRel3_C "Zeit für Statuswechsel niedrig" VALUE 0xF27AE Kw_Wu16 655350.0 TimeDeb 0.00 655350.0 FORMAT "%8.1" /end CHARACTERISTIC
/begin CHARACTERISTIC PCR_tiSurgeCtlLoHiRel3_C "Zeit für Statuswechsel hoch" VALUE 0xF27B0 Kw_Wu16 655350.0 TimeDeb 0.00 655350.0 FORMAT "%8.1" /end CHARACTERISTIC
/begin CHARACTERISTIC PCR_tiSurgeCtlHiLoRelAll_C "Zeit für Statuswechsel niedrig" VALUE 0xF27B2 Kw_Wu16 655350.0 TimeDeb 0.00 655350.0 FORMAT "%8.1" /end CHARACTERISTIC
/begin CHARACTERISTIC PCR_tiSurgeCtlLoHiRelAll_C "Zeit für Statuswechsel hoch" VALUE 0xF27B4 Kw_Wu16 655350.0 TimeDeb 0.00 655350.0 FORMAT "%8.1" /end CHARACTERISTIC
/begin CHARACTERISTIC PCR_vClutch_C "Geschwindigkeitsgrenze für Kuplungsüberwachung" VALUE 0xF24DC Kw_Ws16 300.0000 Vel 0.00 300.0000 FORMAT "%8.4" EXTENDED_LIMITS -327.6800 327.6700 /end CHARACTERISTIC
/begin CHARACTERISTIC PCR_vLPClutch_C "Geschwindigkeitsschwelle für Kupplungssignal überwachung" VALUE 0xF220E Kw_Ws16 300.0000 Vel 0.00 300.0000 FORMAT "%8.4" EXTENDED_LIMITS -327.6800 327.6700 /end CHARACTERISTIC
/begin CHARACTERISTIC PCR_tiDT1DesWrm_C "Verzögerungszeitkonstante der dynamischen Sollwertbildung bei warmem Motor" VALUE 0xF00C0 Kw_Wu32 4294.9663 TimeDelay_s 0.0010000001 4294.9673 FORMAT "%9.4" EXTENDED_LIMITS 0.0000010000000 4294.9673 /end CHARACTERISTIC
/begin CHARACTERISTIC PCR_DKdDesWrm_C "Kleinsignalverstärkung der dynamischen Sollwertbildung bei warmem Motor" VALUE 0xF00C4 Kw_Ws32 65535.9999847 Kd -32768.0000000 32767.9999847 FORMAT "%13.7" /end CHARACTERISTIC
/begin CHARACTERISTIC PCR_DKdPosDesWrm_C "Positive Großsignalverstärkung der dynamischen Sollwertbildung bei warmem Motor" VALUE 0xF00C8 Kw_Ws32 65535.9999847 Kd -32768.0000000 32767.9999847 FORMAT "%13.7" /end CHARACTERISTIC
/begin CHARACTERISTIC PCR_DKdNegDesWrm_C "Negative Großsignalverstärkung der dynamischen Sollwertbildung bei warmem Motor" VALUE 0xF00CC Kw_Ws32 65535.9999847 Kd -32768.0000000 32767.9999847 FORMAT "%13.7" /end CHARACTERISTIC
/begin CHARACTERISTIC PCR_dpDWinPosDesWrm_C "Positive Kleinsignalgrenze bei warmem Motor" VALUE 0xF00D0 Kw_Ws16 65535.00 Pres_hPa -32768.00 32767.00 FORMAT "%8.2" /end CHARACTERISTIC
/begin CHARACTERISTIC PCR_dpDWinNegDesWrm_C "Negative Kleinsignalgrenze bei warmem Motor" VALUE 0xF00D2 Kw_Ws16 65535.00 Pres_hPa -32768.00 32767.00 FORMAT "%8.2" /end CHARACTERISTIC
/begin CHARACTERISTIC PCVCD_uSRCMin_C "Signal Range Check Min-Wert" VALUE 0xF29A8 Kw_Ws16 5200.391 Volt 0.00 5200.391 FORMAT "%8.3" EXTENDED_LIMITS -160156.4 160151.5 /end CHARACTERISTIC
/begin CHARACTERISTIC PCVCD_uSRCMax_C "Signal Range Check Max-Wert" VALUE 0xF29AA Kw_Ws16 5200.391 Volt 0.00 5200.391 FORMAT "%8.3" EXTENDED_LIMITS -160156.4 160151.5 /end CHARACTERISTIC
/begin CHARACTERISTIC PCVCD_iLin_CUR "Analogeingang, Linearisierungskennlinie" CURVE 0xF29AC Kl_Xs16_Ws16 5000.000 Curr 0.00 5000.000 FORMAT "%8.3" EXTENDED_LIMITS -32768.00 32767.00
 /begin AXIS_DESCR STD_AXIS PCVCD_uRawVal_mp Volt 2 0.00 5200.391 FORMAT "%8.3" EXTENDED_LIMITS -160156.4 160151.5 DEPOSIT ABSOLUTE /end AXIS_DESCR
/end CHARACTERISTIC
/begin CHARACTERISTIC PCVCD_ctPwrStgOnMax_C "maximale Anzahl von Endstufen-Einschaltungen pro Fahrzyklus bei SCB oder Übertemperatur" VALUE 0xF29B6 Kw_Wu16 65535.00 OneToOne 0.00 65535.00 FORMAT "%8.2" /end CHARACTERISTIC
/begin CHARACTERISTIC PCVCD_dcycMax_C "Max-Wert, Ausgangstastverhältnis" VALUE 0xF29B8 Kw_Ws16 100.0000 DtyCyc 0.00 100.0000 FORMAT "%8.4" EXTENDED_LIMITS -327.6800 327.6700 /end CHARACTERISTIC
/begin CHARACTERISTIC PCVCD_dcycMin_C "Min-Wert, Ausgangstastverhältnis" VALUE 0xF29BA Kw_Ws16 100.0000 DtyCyc 0.00 100.0000 FORMAT "%8.4" EXTENDED_LIMITS -327.6800 327.6700 /end CHARACTERISTIC
/begin CHARACTERISTIC PCVCD_dcycSetValLin_CUR "Linearisierungskurve des Tastverhältnisses des Druckregelventils" CURVE 0xF29BC Kl_Xs16_Ws16 100.0000 DtyCyc 0.00 100.0000 FORMAT "%8.4" EXTENDED_LIMITS -327.6800 327.6700
 /begin AXIS_DESCR STD_AXIS PCVCD_dcycSetVal_mp DtyCyc 8 -327.6800 327.6700 FORMAT "%8.4" DEPOSIT ABSOLUTE /end AXIS_DESCR
/end CHARACTERISTIC
/begin CHARACTERISTIC PCVCD_DebExcTempDef_C "Fehlerentprellzeit Uebertemperatur" VALUE 0xF29DE Kw_Wu16 655350.0 Time_ms 0.00 655350.0 FORMAT "%8.1" /end CHARACTERISTIC
/begin CHARACTERISTIC PCVCD_DebExcTempOk_C "Heilungsentprellzeit Uebertemperatur" VALUE 0xF29E0 Kw_Wu16 655350.0 Time_ms 0.00 655350.0 FORMAT "%8.1" /end CHARACTERISTIC
/begin CHARACTERISTIC PCVCD_DebNoLoadDef_C "Fehlerentprellzeit Leerlauf" VALUE 0xF29E2 Kw_Wu16 655350.0 Time_ms 0.00 655350.0 FORMAT "%8.1" /end CHARACTERISTIC
/begin CHARACTERISTIC PCVCD_DebNoLoadOk_C "Heilungszeit Leerlauf" VALUE 0xF29E4 Kw_Wu16 655350.0 Time_ms 0.00 655350.0 FORMAT "%8.1" /end CHARACTERISTIC
/begin CHARACTERISTIC PCVCD_DebShortCircBatDef_C "Fehlerentprellzeit Kurzschluss Batterie" VALUE 0xF29E6 Kw_Wu16 655350.0 Time_ms 0.00 655350.0 FORMAT "%8.1" /end CHARACTERISTIC
/begin CHARACTERISTIC PCVCD_DebShortCircBatOk_C "Heilungsentprellzeit Kurzschluss Batterie" VALUE 0xF29E8 Kw_Wu16 655350.0 Time_ms 0.00 655350.0 FORMAT "%8.1" /end CHARACTERISTIC
/begin CHARACTERISTIC PCVCD_DebShortCircGndDef_C "Fehlerentprellzeit Kurzschluss Masse" VALUE 0xF29EA Kw_Wu16 655350.0 Time_ms 0.00 655350.0 FORMAT "%8.1" /end CHARACTERISTIC
/begin CHARACTERISTIC PCVCD_DebShortCircGndOk_C "Heilungsentprellzeit Kurzschluss Masse" VALUE 0xF29EC Kw_Wu16 655350.0 Time_ms 0.00 655350.0 FORMAT "%8.1" /end CHARACTERISTIC
/begin CHARACTERISTIC PCVCD_DebSRCHighDef_C "Fehlerentprellzeit für Analogeingang SRC-High Fehler" VALUE 0xF29EE Kw_Wu16 655350.0 Time_ms 0.00 655350.0 FORMAT "%8.1" /end CHARACTERISTIC
/begin CHARACTERISTIC PCVCD_DebSRCHighOk_C "Heilungsentprellzeit für Analogeingang SRC-High Fehler" VALUE 0xF29F0 Kw_Wu16 655350.0 Time_ms 0.00 655350.0 FORMAT "%8.1" /end CHARACTERISTIC
/begin CHARACTERISTIC PCVCD_DebSRCLowDef_C "Fehlerentprellzeit Analogeingang SRC-Low Fehler" VALUE 0xF29F2 Kw_Wu16 655350.0 Time_ms 0.00 655350.0 FORMAT "%8.1" /end CHARACTERISTIC
/begin CHARACTERISTIC PCVCD_DebSRCLowOk_C "Heilungsentprellzeit für Analogeingang SRC-Low Fehler" VALUE 0xF29F4 Kw_Wu16 655350.0 Time_ms 0.00 655350.0 FORMAT "%8.1" /end CHARACTERISTIC
/begin CHARACTERISTIC PCVCD_facIGovInit_CUR "Initialisierungsfaktor für I-Anteil des Stromreglers als Funktion der Systemtemperatur" CURVE 0xF29F6 Kl_Xs16_Ws16 2.000000 Fact 0.00 2.000000 FORMAT "%8.6" EXTENDED_LIMITS -4.000000 3.999878
 /begin AXIS_DESCR STD_AXIS FlSys_t Temp_Cels 4 -50.14000 199.8600 FORMAT "%8.4" EXTENDED_LIMITS -3549.940 3003.560 DEPOSIT ABSOLUTE /end AXIS_DESCR
/end CHARACTERISTIC
/begin CHARACTERISTIC PCVCD_facIGovMax_C "maximaler I-Anteil" VALUE 0xF2A08 Kw_Ws16 1.000000 Fact 1.000000 2.000000 FORMAT "%8.6" EXTENDED_LIMITS -4.000000 3.999878 /end CHARACTERISTIC
/begin CHARACTERISTIC PCVCD_facIGovMin_C "minimaler I-Anteil" VALUE 0xF2A0A Kw_Ws16 0.5000000 Fact 0.5000000 1.000000 FORMAT "%8.6" EXTENDED_LIMITS -4.000000 3.999878 /end CHARACTERISTIC
/begin CHARACTERISTIC PCVCD_tiFlt1PT1_C "PT1 Filterzeitkonstante für Strom-Istwert" VALUE 0xF2A0C Kw_Wu32 4294.9673 TimeDelay_s 0.0000010000000 4294.9673 FORMAT "%9.4" /end CHARACTERISTIC
/begin CHARACTERISTIC PCVCD_tiFlt2PT1_C "PT1 Filterzeitkonstante für Strom-Sollwert" VALUE 0xF2A10 Kw_Wu32 4294.9673 TimeDelay_s 0.0000010000000 4294.9673 FORMAT "%9.4" /end CHARACTERISTIC
/begin CHARACTERISTIC PCVCD_tiIGovDT1_C "DT1 Zeitkonstante" VALUE 0xF2A14 Kw_Wu32 4294.9673 TimeDelay_s 0.0000010000000 4294.9673 FORMAT "%9.4" /end CHARACTERISTIC
/begin CHARACTERISTIC PCVCD_IGovDKd_C "DT1 Differenziationsfaktor" VALUE 0xF2A18 Kw_Ws32 65535.9999847 Kd -32768.0000000 32767.9999847 FORMAT "%13.7" /end CHARACTERISTIC
/begin CHARACTERISTIC PCVCD_IGovIKi_C "I-Glied, Kleinsignalverstärkung" VALUE 0xF2A1C Kw_Wu32 122.070312472 Ki_curr2fact 0.00 122.070312472 FORMAT "%13.9" /end CHARACTERISTIC
/begin CHARACTERISTIC PCVCD_IGovIKiPos_C "I-Glied, Verstärkung für positive Großsignale" VALUE 0xF2A20 Kw_Wu32 122.070312472 Ki_curr2fact 0.00 122.070312472 FORMAT "%13.9" /end CHARACTERISTIC
/begin CHARACTERISTIC PCVCD_IGovIKiNeg_C "I_Glied, Verstärkung für negative Großsignale" VALUE 0xF2A24 Kw_Wu32 122.070312472 Ki_curr2fact 0.00 122.070312472 FORMAT "%13.9" /end CHARACTERISTIC
/begin CHARACTERISTIC PCVCD_iIGovIWinPos_C "I-Glied, Kleinsignalfenster positiv" VALUE 0xF2A28 Kw_Ws16 65535.00 Curr -32768.00 32767.00 FORMAT "%8.2" /end CHARACTERISTIC
/begin CHARACTERISTIC PCVCD_iIGovIWinNeg_C "I_Glied, Kleinsignalfenster negativ" VALUE 0xF2A2A Kw_Ws16 65535.00 Curr -32768.00 32767.00 FORMAT "%8.2" /end CHARACTERISTIC
/begin CHARACTERISTIC PCVCD_tiFltPT1Init_C "PT1 Filterzeitkonstante während Initialisierungsphase des Stromreglers" VALUE 0xF2A2C Kw_Wu32 4294.9673 TimeDelay_s 0.0000010000000 4294.9673 FORMAT "%9.4" /end CHARACTERISTIC
/begin CHARACTERISTIC PCVCD_numAdc_C "Parameter für die Auswahl des Analogkanals für das Druckregelventil" VALUE 0xF2A30 Kw_Wu8 60.0000000000 NumPinAdc 0.00 60.0000000000 FORMAT "%13.10" /end CHARACTERISTIC
/begin CHARACTERISTIC PCVCD_numDia1_C "Parameter für Zuordnung der Diagnose zur 1. Endstufe des Druckregelventils" VALUE 0xF2A31 Kw_Wu8 33.0000000000 NumPinDia 0.00 33.0000000000 FORMAT "%13.10" /end CHARACTERISTIC
/begin CHARACTERISTIC PCVCD_numDia2_C "Parameter für Zuordnung der Diagnose zur 2. Endstufe des Druckregelventils" VALUE 0xF2A32 Kw_Wu8 33.0000000000 NumPinDia 0.00 33.0000000000 FORMAT "%13.10" /end CHARACTERISTIC
/begin CHARACTERISTIC PCVCD_numPwmOut_C "Parameter für die Auswahl des Hardware-Pins für das Druckregelventil" VALUE 0xF2A33 Kw_Wu8 13.0000000000 NumPinPwmOut 0.00 13.0000000000 FORMAT "%13.10" /end CHARACTERISTIC
/begin CHARACTERISTIC PCVCD_stInvOut_C "Invertierungsparameter der PWM Endstufe" VALUE 0xF2A34 Kw_Wu8 1.000 OneToOne 0.00 1.000 FORMAT "%5.3" EXTENDED_LIMITS 0.00 255.0 /end CHARACTERISTIC
/begin CHARACTERISTIC PCVCD_tiPer_C "Periodendauer der PWM-Endstufe" VALUE 0xF2A36 Kw_Ws16 9.900000 Period 0.1000000 10.00000 FORMAT "%8.5" EXTENDED_LIMITS -3276.800 3276.700 /end CHARACTERISTIC
/begin CHARACTERISTIC PCVCD_resCoil_C "Widerstandswert der DRV-Spule" VALUE 0xF2A38 Kw_Ws16 5000.000 Resist_1 0.00 5000.000 FORMAT "%8.3" EXTENDED_LIMITS -32768.00 32767.00 /end CHARACTERISTIC
/begin CHARACTERISTIC PCVCD_stPwrStgDia_C "Statuswort zur Spezifikation des Abschaltverhaltens der Endstufenfehlerdiagnose Druckregelventil" VALUE 0xF2A3A Kw_Wu8 255.0 OneToOne 0.00 255.0 FORMAT "%5.1" /end CHARACTERISTIC
/begin CHARACTERISTIC PCVCD_stSPICtl_C "Parameter zur Anzeige der verwendeten Endstufenart ( 1 =SPI fähige Endstufe, 0 = nicht SPI fähige Endstufe )" VALUE 0xF2A3B Kw_Wu8 1.000 OneToOne 0.00 1.000 FORMAT "%5.3" EXTENDED_LIMITS 0.00 255.0 /end CHARACTERISTIC
/begin CHARACTERISTIC PCVCD_swtCtlStateVal_C "CP1: 0: konstant Stromregelung, 1: nur wenn Raildruckregler im gesteuerten Betrieb ist" VALUE 0xF2A3C Kw_Wu8 0.00 OneToOne 0.00 0.00 FORMAT "%5.2" EXTENDED_LIMITS 0.00 255.0 /end CHARACTERISTIC
/begin CHARACTERISTIC PCVCD_swtCtlStateType_C "CP1: Auswahl, Schalterwert aus Datensatz oder EEPROM" VALUE 0xF2A3D Kw_Wu8 1.000 OneToOne 1.000 2.000 FORMAT "%5.3" EXTENDED_LIMITS 0.00 255.0 /end CHARACTERISTIC
/begin CHARACTERISTIC PCVCD_swt_C "allgemeine Schalterfunktionen der Endstufe Druckregelventil (bit0: 0...Batteriespannungskorrektur aus, 1...ein; bit1-7: Reserve)" VALUE 0xF2A3E Kw_Wu8 255.0 OneToOne 0.00 255.0 FORMAT "%5.1" /end CHARACTERISTIC
/begin CHARACTERISTIC PCVCD_tiBtwTst_C "Zeitabstand zwischen zwei Testimpulsen zum Test der Endstufe im Fehlerfall" VALUE 0xF2A40 Kw_Wu16 29990.00 Time_ms 10.00000 30000.00 FORMAT "%8.2" EXTENDED_LIMITS 0.00 655350.0 /end CHARACTERISTIC
/begin CHARACTERISTIC PCVCD_tiIGovInit_C "maximale Zeitdauer der Initialisierungsphase für den Stromregler" VALUE 0xF2A42 Kw_Wu16 655350.0 Time_ms 0.00 655350.0 FORMAT "%8.1" /end CHARACTERISTIC
/begin CHARACTERISTIC PCVCD_tiPwrStgOn_C "Zeit, für welche die Endstufe beim Fall der nicht SPI fähige Endstufe eingeschaltet wird." VALUE 0xF2A44 Kw_Wu16 655140.0 Time_ms 0.00 655140.0 FORMAT "%8.1" EXTENDED_LIMITS 0.00 655350.0 /end CHARACTERISTIC
/begin CHARACTERISTIC PCVCD_tiDebSigDefSigTst_C "Fehlerentprellzeit fuer Fehlerpfad Dfp_PCVCD_SigTst" VALUE 0xF2A46 Kw_Wu16 655350.0 Time_ms 0.00 655350.0 FORMAT "%8.1" /end CHARACTERISTIC
/begin CHARACTERISTIC PCVCD_tiDebSigOkSigTst_C "Heliungsentprellzeit fuer Fehlerpfad Dfp_PCVCD_SigTst" VALUE 0xF2A48 Kw_Wu16 655350.0 Time_ms 0.00 655350.0 FORMAT "%8.1" /end CHARACTERISTIC
/begin CHARACTERISTIC PCV_dvolLeak_CUR "Leckage des Druckregelventils" CURVE 0xF292C Kl_Xs16_Ws16 150000.0 Qp_mm3_sec 0.00 150000.0 FORMAT "%8.1" EXTENDED_LIMITS -327680.0 327670.0
 /begin AXIS_DESCR STD_AXIS Rail_pSetPoint Pres_Rail 6 0.00 2000.000 FORMAT "%5.3" EXTENDED_LIMITS -3276.800 3276.700 DEPOSIT ABSOLUTE /end AXIS_DESCR
/end CHARACTERISTIC
/begin CHARACTERISTIC PCV_dvolUpLim_CUR "Maximaler Durchfluss der Pumpe als Funktion der Drehzahl" CURVE 0xF2890 Kl_Xs16_Ws16 100000.0 Qp_mm3_sec 0.00 100000.0 FORMAT "%8.1" EXTENDED_LIMITS -327680.0 327670.0
 /begin AXIS_DESCR STD_AXIS Eng_nAvrg EngN 10 -10000.00 50000.00 FORMAT "%8.2" EXTENDED_LIMITS -32768.00 32767.00 DEPOSIT ABSOLUTE /end AXIS_DESCR
/end CHARACTERISTIC
/begin CHARACTERISTIC PCV_facAdaptDiffI_C "Faktor der maximalen Abweichung zwischen Soll- und Iststrom durch das PCV, ab dem die Adaption durchgeführt wird" VALUE 0xF28BA Kw_Ws16 1.000000 Fact 0.00 1.000000 FORMAT "%8.6" EXTENDED_LIMITS -4.000000 3.999878 /end CHARACTERISTIC
/begin CHARACTERISTIC PCV_facAdaptDiff_C "Faktor der maximalen Abweichung zwischen Railsoll- und Railistdruck, ab der die Adaption durchgeführt wird" VALUE 0xF28BC Kw_Ws16 1.000000 Fact 0.00 1.000000 FORMAT "%8.6" EXTENDED_LIMITS -4.000000 3.999878 /end CHARACTERISTIC
/begin CHARACTERISTIC PCV_facAdaptFlowMin_C "Mindestwert für den Durchflusskorrektur-Faktor des PCV" VALUE 0xF28BE Kw_Ws16 2.000000 Fact 0.00 2.000000 FORMAT "%8.6" EXTENDED_LIMITS -4.000000 3.999878 /end CHARACTERISTIC
/begin CHARACTERISTIC PCV_facAdaptFlow_MAP "Durchflusskorrektur-Faktor für die PCV-Kennlinie als Funktion vom Durchfluss durch das PCV und dem Raildruck" MAP 0xF28C0 Kf_Xs16_Ys16_Ws16 2.000000 Fact 0.00 2.000000 FORMAT "%8.6" EXTENDED_LIMITS -4.000000 3.999878
 /begin AXIS_DESCR STD_AXIS RailCD_pPeak Pres_Rail 6 0.00 2000.000 FORMAT "%5.3" EXTENDED_LIMITS -3276.800 3276.700 DEPOSIT ABSOLUTE /end AXIS_DESCR
 /begin AXIS_DESCR STD_AXIS PCV_dvolFlow_mp Qp_mm3_sec 4 -10000.00 50000.00 FORMAT "%8.2" EXTENDED_LIMITS -327680.0 327670.0 DEPOSIT ABSOLUTE /end AXIS_DESCR
/end CHARACTERISTIC
/begin CHARACTERISTIC PCV_facAdaptMax_C "Maximalwert des Adaptionsfaktors des PCV" VALUE 0xF2908 Kw_Ws16 2.000000 Fact 0.00 2.000000 FORMAT "%8.6" EXTENDED_LIMITS -4.000000 3.999878 /end CHARACTERISTIC
/begin CHARACTERISTIC PCV_facAdaptMin_C "Minimalwert des Adaptionsfaktors des PCV" VALUE 0xF290A Kw_Ws16 2.000000 Fact 0.00 2.000000 FORMAT "%8.6" EXTENDED_LIMITS -4.000000 3.999878 /end CHARACTERISTIC
/begin CHARACTERISTIC PCV_facAdaptWgh_C "Gewichtungsfaktor für die Berechnung des Adaptionsfaktors des PCV" VALUE 0xF290C Kw_Ws16 20.00000 Fact2 0.00 20.00000 FORMAT "%8.5" EXTENDED_LIMITS -2048.000 2047.938 /end CHARACTERISTIC
/begin CHARACTERISTIC PCV_iCnvPress_CUR "Kennlinie zur Umrechnung von Raildruck in elektrischen Strom" CURVE 0xF2946 Kl_Xs16_Ws16 5000.000 Curr 0.00 5000.000 FORMAT "%8.3" EXTENDED_LIMITS -32768.00 32767.00
 /begin AXIS_DESCR STD_AXIS Rail_pPCVSet Pres_Rail 10 0.00 2000.000 FORMAT "%5.3" EXTENDED_LIMITS -3276.800 3276.700 DEPOSIT ABSOLUTE /end AXIS_DESCR
/end CHARACTERISTIC
/begin CHARACTERISTIC PCV_iSetClose_CUR "Strom zum Schließen des Druckregelventils ohne dieses zu entprellen" CURVE 0xF2970 Kl_Xs16_Ws16 5000.000 Curr 0.00 5000.000 FORMAT "%8.3" EXTENDED_LIMITS -32768.00 32767.00
 /begin AXIS_DESCR STD_AXIS CTSCD_tClnt Temp_Cels 8 -50.14000 199.8600 FORMAT "%8.4" EXTENDED_LIMITS -3549.940 3003.560 DEPOSIT ABSOLUTE /end AXIS_DESCR
/end CHARACTERISTIC
/begin CHARACTERISTIC PCV_iSetMaxBattHi_C "Reduzierter Maximalstrom für das Druckregelventil bei erhöhter Batteriespannung" VALUE 0xF2992 Kw_Ws16 5000.000 Curr 0.00 5000.000 FORMAT "%8.3" EXTENDED_LIMITS -32768.00 32767.00 /end CHARACTERISTIC
/begin CHARACTERISTIC PCV_iSetMax_C "Sollstrom während des  Hochdrucktests" VALUE 0xF2994 Kw_Ws16 5000.000 Curr 0.00 5000.000 FORMAT "%8.3" EXTENDED_LIMITS -32768.00 32767.00 /end CHARACTERISTIC
/begin CHARACTERISTIC PCV_iSetMin_C "Minimal zulässiger Strom des Druckregelventils" VALUE 0xF2996 Kw_Ws16 65535.00 Curr -32768.00 32767.00 FORMAT "%8.2" /end CHARACTERISTIC
/begin CHARACTERISTIC PCV_iSet_Vector "Bypass-Label für PCV_iSet (Nicht verstellen!)" VALUE 0xC399E Kw_Wu8 255.0 OneToOne 0.00 255.0 FORMAT "%5.1" /end CHARACTERISTIC
/begin CHARACTERISTIC PCV_iSet_Channel "Bypass-Label für PCV_iSet, nicht editieren!" VALUE 0xC399F Kw_Wu8 255.0 OneToOne 0.00 255.0 FORMAT "%5.1" /end CHARACTERISTIC
/begin CHARACTERISTIC PCV_nSetClose_C "Drehzahlschwelle zum Verlassen des Zustandes PCV_stActrOut == PCV_CLOSE_MODE (0x20)" VALUE 0xF2998 Kw_Ws16 65535.00 EngN -32768.00 32767.00 FORMAT "%8.2" /end CHARACTERISTIC
/begin CHARACTERISTIC PCV_numAdaptSum_C "Anzahl der Funktionsaufrufe der PCV-Adaption im Zustand PCV_ADAPT_SUM_UP" VALUE 0xF290E Kw_Wu16 20.00000 OneToOne 0.00 20.00000 FORMAT "%8.5" EXTENDED_LIMITS 0.00 65535.00 /end CHARACTERISTIC
/begin CHARACTERISTIC PCV_numAdaptThres_C "Anzahl der Adaptionen, die bei beliebigem Raildruck durchgeführt werden" VALUE 0xF2910 Kw_Wu16 100.0000 OneToOne 0.00 100.0000 FORMAT "%8.4" EXTENDED_LIMITS 0.00 65535.00 /end CHARACTERISTIC
/begin CHARACTERISTIC PCV_numAdapt_C "Anzahl der Funktionsaufrufe der PCV-Adaption im Zustand PCV_ADAPT_STABLE" VALUE 0xF2912 Kw_Wu16 100.0000 OneToOne 0.00 100.0000 FORMAT "%8.4" EXTENDED_LIMITS 0.00 65535.00 /end CHARACTERISTIC
/begin CHARACTERISTIC PCV_pAdaptThresDec_C "Differenzdruck, um den die Druckschwelle reduziert wird, wenn die letzte Adaption zu lange zurück liegt" VALUE 0xF2914 Kw_Ws16 6553.500 Pres_Rail -3276.800 3276.700 FORMAT "%5.3" /end CHARACTERISTIC
/begin CHARACTERISTIC PCV_pAdaptThresMax_C "Maximaler Raildruck für die Adaptions-Freigabe" VALUE 0xF2916 Kw_Ws16 6553.500 Pres_Rail -3276.800 3276.700 FORMAT "%5.3" /end CHARACTERISTIC
/begin CHARACTERISTIC PCV_pAdaptThresMin_C "Minimaler Raildruck für die Adaptions-Freigabe" VALUE 0xF2918 Kw_Ws16 6553.500 Pres_Rail -3276.800 3276.700 FORMAT "%5.3" /end CHARACTERISTIC
/begin CHARACTERISTIC PCV_pAdaptThres_C "Maximaler Wert für die Druckschwelle, ab der die Adaption durchgeführt wird" VALUE 0xF291A Kw_Ws16 5276.800 Pres_Rail -3276.800 2000.000 FORMAT "%5.3" EXTENDED_LIMITS -3276.800 3276.700 /end CHARACTERISTIC
/begin CHARACTERISTIC PCV_swtAdaptCPC_C "Schalter für die Freigabe der Adaption im CPC-Betrieb" VALUE 0xF291C Kw_Wu8 255.0 OneToOne 0.00 255.0 FORMAT "%5.1" /end CHARACTERISTIC
/begin CHARACTERISTIC PCV_swtAdaptFlow_C "Schalter für die Freigabe der Durchflusswertberechnung" VALUE 0xF291D Kw_Wu8 255.0 OneToOne 0.00 255.0 FORMAT "%5.1" /end CHARACTERISTIC
/begin CHARACTERISTIC PCV_swtAdaptRst_C "Schalter für das Zurücksetzen der Adaptionswerte" VALUE 0xF291E Kw_Wu8 255.0 OneToOne 0.00 255.0 FORMAT "%5.1" /end CHARACTERISTIC
/begin CHARACTERISTIC PCV_swtAdapt_C "Schalter für die Freigabe der Adaptionswertberechnung" VALUE 0xF291F Kw_Wu8 255.0 OneToOne 0.00 255.0 FORMAT "%5.1" /end CHARACTERISTIC
/begin CHARACTERISTIC PCV_swtClose_C "Schalter zur Wahl der Motorstarterkennung" VALUE 0xF299A Kw_Wu8 255.0 OneToOne 0.00 255.0 FORMAT "%5.1" /end CHARACTERISTIC
/begin CHARACTERISTIC PCV_tFuelAdaptMax_C "Maximale Kraftstofftemperatur, bis zu der die Adaption durchgeführt wird" VALUE 0xF2920 Kw_Ws16 250.0000 Temp_Cels -50.1400 199.8600 FORMAT "%8.4" EXTENDED_LIMITS -3549.940 3003.560 /end CHARACTERISTIC
/begin CHARACTERISTIC PCV_tFuelAdaptMin_C "Minimale Kraftstofftemperatur, ab der die Adaption durchgeführt wird" VALUE 0xF2922 Kw_Ws16 250.0000 Temp_Cels -50.1400 199.8600 FORMAT "%8.4" EXTENDED_LIMITS -3549.940 3003.560 /end CHARACTERISTIC
/begin CHARACTERISTIC PCV_tiAdaptMax_C "Maximale Zeitspanne, die zwischen zwei Adaptionsvorgängen ohne Absenkung der Raildruckschwelle vergehen darf" VALUE 0xF2924 Kw_Wu32 650000.000000 TimeEngOn 0.00 650000.000000 FORMAT "%13.6" EXTENDED_LIMITS 0.00 4294967295.00 /end CHARACTERISTIC
/begin CHARACTERISTIC PCV_tiDurClose_C "Zeitdauer zum sicheren Schließen des Druckregelventils" VALUE 0xF299C Kw_Wu16 655350.0 Time_ms 0.00 655350.0 FORMAT "%8.1" /end CHARACTERISTIC
/begin CHARACTERISTIC PCV_tiSetCloseMax_C "maximale Verweilzeit im Zustand PCV_stActrOut == PCV_CLOSE_MODE (0x20)" VALUE 0xF299E Kw_Wu16 655350.0 Time_ms 0.00 655350.0 FORMAT "%8.1" /end CHARACTERISTIC
/begin CHARACTERISTIC PCV_tiWaitClose_C "Verzögerunszeit bis das Druckregelventil nach Erkennen von Motorstart geschlossen ist" VALUE 0xF29A0 Kw_Wu16 655350.0 Time_ms 0.00 655350.0 FORMAT "%8.1" /end CHARACTERISTIC
/begin CHARACTERISTIC PCV_tSwtMeUn_C "Temperaturschwelle für die Freigabe der Botschaft PCV_stAdaptMeUn" VALUE 0xF2928 Kw_Ws16 250.0000 Temp_Cels -50.1400 199.8600 FORMAT "%8.4" EXTENDED_LIMITS -3549.940 3003.560 /end CHARACTERISTIC
/begin CHARACTERISTIC PCV_uBattHi_C "Obere Batteriespannungsschwelle zum Umschalten auf reduzierten Maixmalstrom" VALUE 0xF29A2 Kw_Ws16 1281232. Volt_Batt -640625.6 640606.1 FORMAT "%8.1" /end CHARACTERISTIC
/begin CHARACTERISTIC PCV_uBattLo_C "Untere Batteriespannungsschwelle zum Rückschalten auf PCV_iSetMax_C" VALUE 0xF29A4 Kw_Ws16 1281232. Volt_Batt -640625.6 640606.1 FORMAT "%8.1" /end CHARACTERISTIC
/begin CHARACTERISTIC PFltCD_uSRCMinTPreB1_C "Minimalwert SRC-Überwachung von PFltCD_uRawTempPreB1" VALUE 0xF5FE8 Kw_Ws16 5200.391 Volt 0.00 5200.391 FORMAT "%8.3" EXTENDED_LIMITS -160156.4 160151.5 /end CHARACTERISTIC
/begin CHARACTERISTIC PFltCD_uSRCMaxTPreB1_C "Maximalwert SRC-Überwachung von PFltCD_uRawTempPreB1" VALUE 0xF5FEA Kw_Ws16 5200.391 Volt 0.00 5200.391 FORMAT "%8.3" EXTENDED_LIMITS -160156.4 160151.5 /end CHARACTERISTIC
/begin CHARACTERISTIC PFltCD_tLinPreB1_CUR "Linearisierungskennlinie für Temperatur vor Partikelfilter" CURVE 0xF5FEC Kl_Xs16_Ws16 950.000 Temp_Cels -50.140 899.860 FORMAT "%8.3" EXTENDED_LIMITS -3549.940 3003.560
 /begin AXIS_DESCR STD_AXIS PFltCD_uRawTempPreBnk_mp Volt 16 0.00 160151.5 FORMAT "%8.1" EXTENDED_LIMITS -160156.4 160151.5 DEPOSIT ABSOLUTE /end AXIS_DESCR
/end CHARACTERISTIC
/begin CHARACTERISTIC PFltCD_uSRCMinTPreB2_C "Minimalwert SRC-Überwachung von PFltCD_uRawTempPreB2" VALUE 0xF602E Kw_Ws16 5200.391 Volt 0.00 5200.391 FORMAT "%8.3" EXTENDED_LIMITS -160156.4 160151.5 /end CHARACTERISTIC
/begin CHARACTERISTIC PFltCD_uSRCMaxTPreB2_C "Maximalwert SRC-Überwachung von PFltCD_uRawTempPreB2" VALUE 0xF6030 Kw_Ws16 5200.391 Volt 0.00 5200.391 FORMAT "%8.3" EXTENDED_LIMITS -160156.4 160151.5 /end CHARACTERISTIC
/begin CHARACTERISTIC PFltCD_tLinPreB2_CUR "Linearisierungskennlinie für Temperatur vor Partikelfilter" CURVE 0xF6032 Kl_Xs16_Ws16 950.000 Temp_Cels -50.140 899.860 FORMAT "%8.3" EXTENDED_LIMITS -3549.940 3003.560
 /begin AXIS_DESCR STD_AXIS PFltCD_uRawTempPreBnk_mp Volt 16 0.00 160151.5 FORMAT "%8.1" EXTENDED_LIMITS -160156.4 160151.5 DEPOSIT ABSOLUTE /end AXIS_DESCR
/end CHARACTERISTIC
/begin CHARACTERISTIC PFltCD_uSRCMinPPreB1_C "Minimaler roher Wert für die Minutefehlererkennung für Abgasdruck-Sensor für Bank1" VALUE 0xF5F34 Kw_Ws16 5200.391 Volt 0.00 5200.391 FORMAT "%8.3" EXTENDED_LIMITS -160156.4 160151.5 /end CHARACTERISTIC
/begin CHARACTERISTIC PFltCD_uSRCMaxPPreB1_C "Maximaler roher Wert für die maximale Fehlererkennung für Abgasdruck-Sensor für Bank1" VALUE 0xF5F36 Kw_Ws16 5200.391 Volt 0.00 5200.391 FORMAT "%8.3" EXTENDED_LIMITS -160156.4 160151.5 /end CHARACTERISTIC
/begin CHARACTERISTIC PFltCD_pLinPreB1_CUR "Linearisierungskennlinie des Abgasdrucks vor dem Partikelfilter für Bank1" CURVE 0xF5F38 Kl_Xs16_Ws16 3500.000 Pres_hPa 0.00 3500.000 FORMAT "%8.3" EXTENDED_LIMITS -32768.00 32767.00
 /begin AXIS_DESCR STD_AXIS PFltCD_uRawPresPreBnk_mp Volt 8 0.00 5200.391 FORMAT "%8.3" EXTENDED_LIMITS -160156.4 160151.5 DEPOSIT ABSOLUTE /end AXIS_DESCR
/end CHARACTERISTIC
/begin CHARACTERISTIC PFltCD_uSRCMinPPreB2_C "Minimaler roher Wert für die Minutefehlererkennung für Abgasdruck-Sensor für Bank2" VALUE 0xF5F5A Kw_Ws16 5200.391 Volt 0.00 5200.391 FORMAT "%8.3" EXTENDED_LIMITS -160156.4 160151.5 /end CHARACTERISTIC
/begin CHARACTERISTIC PFltCD_uSRCMaxPPreB2_C "Maximaler roher Wert für die maximale Fehlererkennung für Abgasdruck-Sensor für Bank2" VALUE 0xF5F5C Kw_Ws16 5200.391 Volt 0.00 5200.391 FORMAT "%8.3" EXTENDED_LIMITS -160156.4 160151.5 /end CHARACTERISTIC
/begin CHARACTERISTIC PFltCD_pLinPreB2_CUR "Linearisierungskennlinie des Abgasdrucks vor dem Partikelfilter für Bank2" CURVE 0xF5F5E Kl_Xs16_Ws16 3500.000 Pres_hPa 0.00 3500.000 FORMAT "%8.3" EXTENDED_LIMITS -32768.00 32767.00
 /begin AXIS_DESCR STD_AXIS PFltCD_uRawPresPreBnk_mp Volt 8 0.00 5200.391 FORMAT "%8.3" EXTENDED_LIMITS -160156.4 160151.5 DEPOSIT ABSOLUTE /end AXIS_DESCR
/end CHARACTERISTIC
/begin CHARACTERISTIC PFltCD_DebSigPPreDef_C "Fehlerentprellzeit Signal-Fehler über CAN für pre  Partikelfilter druck" VALUE 0xF5F80 Kw_Wu16 655350.0 Time_ms 0.00 655350.0 FORMAT "%8.1" /end CHARACTERISTIC
/begin CHARACTERISTIC PFltCD_DebSigPPreOk_C "Heilungsentprellzeit Signal-Fehler über CAN für pre  Partikelfilter druck" VALUE 0xF5F82 Kw_Wu16 655350.0 Time_ms 0.00 655350.0 FORMAT "%8.1" /end CHARACTERISTIC
/begin CHARACTERISTIC PFltCD_DebSRCHighPPreDef_C "Fehlerentprellzeit SRC_High-Fehler für  pre Partikelfilter  druck" VALUE 0xF5F84 Kw_Wu16 655350.0 Time_ms 0.00 655350.0 FORMAT "%8.1" /end CHARACTERISTIC
/begin CHARACTERISTIC PFltCD_DebSRCHighPPreOk_C "Heilungsentprellzeit SRC_High für pre Partikelfilter  druck" VALUE 0xF5F86 Kw_Wu16 655350.0 Time_ms 0.00 655350.0 FORMAT "%8.1" /end CHARACTERISTIC
/begin CHARACTERISTIC PFltCD_DebSRCHighDefTPre_C "Fehlerentprellzeit SRC-High-Fehler für die Abgastemperatur vor dem Partikelfilter" VALUE 0xF6074 Kw_Wu16 655350.0 Time_ms 0.00 655350.0 FORMAT "%8.1" /end CHARACTERISTIC
/begin CHARACTERISTIC PFltCD_DebSRCHighOkTPre_C "Heilungsentprellzeit SRC-High für die Abgastemperatur vor dem Partikelfilter" VALUE 0xF6076 Kw_Wu16 655350.0 Time_ms 0.00 655350.0 FORMAT "%8.1" /end CHARACTERISTIC
/begin CHARACTERISTIC PFltCD_DebSRCLowPPreDef_C "Fehlerentprellzeit SRC_Low-Fehler für  pre Partikelfilter  druck" VALUE 0xF5F88 Kw_Wu16 655350.0 Time_ms 0.00 655350.0 FORMAT "%8.1" /end CHARACTERISTIC
/begin CHARACTERISTIC PFltCD_DebSRCLowPPreOk_C "Heilungsentprellzeit SRC_Low für pre Partikelfilter  druck" VALUE 0xF5F8A Kw_Wu16 655350.0 Time_ms 0.00 655350.0 FORMAT "%8.1" /end CHARACTERISTIC
/begin CHARACTERISTIC PFltCD_DebSRCLowDefTPre_C "Fehlerentprellzeit SRC-Low-Fehler für die Abgastemperatur vor dem Partikelfilter" VALUE 0xF6078 Kw_Wu16 655350.0 Time_ms 0.00 655350.0 FORMAT "%8.1" /end CHARACTERISTIC
/begin CHARACTERISTIC PFltCD_DebSRCLowOkTPre_C "Heilungsentprellzeit SRC-Low für die Abgastemperatur vor dem Partikelfilter" VALUE 0xF607A Kw_Wu16 655350.0 Time_ms 0.00 655350.0 FORMAT "%8.1" /end CHARACTERISTIC
/begin CHARACTERISTIC PFltCD_dtRmpSlpUpPPre_C "Rampensteigung bei Heilung/Vorgabewert für Absolutdrucksensor vor dem Partikelfilter" VALUE 0xF5F8C Kw_Wu32 65535999.9847 RmpPres_hPa 0.00 65535999.9847 FORMAT "%13.4" /end CHARACTERISTIC
/begin CHARACTERISTIC PFltCD_dtRmpSlpDwnPPre_C "Rampensteigung bei Heilung/Vorgabewert für Abolutdrucksensor vor dem Partikelfilter" VALUE 0xF5F90 Kw_Wu32 65535999.9847 RmpPres_hPa 0.00 65535999.9847 FORMAT "%13.4" /end CHARACTERISTIC
/begin CHARACTERISTIC PFltCD_dtRmpSlpUpPre_C "Aufw.-Schritt für Rampe der Abgastemperatur vor dem Partikelfilter" VALUE 0xF607C Kw_Wu32 6553599.99847 RmpTemp 0.00 6553599.99847 FORMAT "%13.5" /end CHARACTERISTIC
/begin CHARACTERISTIC PFltCD_dtRmpSlpDwnPre_C "Abw.-Schritt für Rampe der Abgastemperatur vor dem Partikelfilter" VALUE 0xF6080 Kw_Wu32 6553599.99847 RmpTemp 0.00 6553599.99847 FORMAT "%13.5" /end CHARACTERISTIC
/begin CHARACTERISTIC PFltCD_facPreCor_CUR "" CURVE 0xF6084 Kl_Xs16_Ws16 7.999878 Fact -4.000000 3.999878 FORMAT "%8.6"
 /begin AXIS_DESCR STD_AXIS PFlt_dvol CubMtrPerHr 16 -3276.800 3276.700 FORMAT "%8.3" DEPOSIT ABSOLUTE /end AXIS_DESCR
/end CHARACTERISTIC
/begin CHARACTERISTIC PFLTCD_numAdc2B1_C " Zahl zur Auswahl des ADC-Kanals" VALUE 0xF5F94 Kw_Wu8 60.0000000000 NumPinAdc 0.00 60.0000000000 FORMAT "%13.10" /end CHARACTERISTIC
/begin CHARACTERISTIC PFLTCD_numAdc2B2_C "Zahl zur Auswahl des ADC-Kanals" VALUE 0xF5F95 Kw_Wu8 60.0000000000 NumPinAdc 0.00 60.0000000000 FORMAT "%13.10" /end CHARACTERISTIC
/begin CHARACTERISTIC PFltCD_numTempPreADCB1_C "Zahl zur Auswahl des ADC-Kanals" VALUE 0xF60C6 Kw_Wu8 60.0000000000 NumPinAdc 0.00 60.0000000000 FORMAT "%13.10" /end CHARACTERISTIC
/begin CHARACTERISTIC PFltCD_numTempPreADCB2_C "Zahl zur Auswahl des ADC-Kanals" VALUE 0xF60C7 Kw_Wu8 60.0000000000 NumPinAdc 0.00 60.0000000000 FORMAT "%13.10" /end CHARACTERISTIC
/begin CHARACTERISTIC PFltCD_pPreCor_CUR "Druck vor Partikelfilter" CURVE 0xF5F96 Kl_Xs16_Ws16 3500.000 Pres_hPa 0.00 3500.000 FORMAT "%8.3" EXTENDED_LIMITS -32768.00 32767.00
 /begin AXIS_DESCR STD_AXIS PFlt_dvol CubMtrPerHr 16 0.00 3000.000 FORMAT "%8.3" EXTENDED_LIMITS -3276.800 3276.700 DEPOSIT ABSOLUTE /end AXIS_DESCR
/end CHARACTERISTIC
/begin CHARACTERISTIC PFltCD_tiPPrePT1B1_C "Zeitkonstante des Filters PT1 für PFltCD_pPreB1" VALUE 0xF5FD8 Kw_Wu32 4294.9663 TimeDelay_s 0.0010000001 4294.9673 FORMAT "%9.4" EXTENDED_LIMITS 0.0000010000000 4294.9673 /end CHARACTERISTIC
/begin CHARACTERISTIC PFltCD_tiPPrePT1B2_C "Zeitkonstante des Filters PT1 für PFltCD_pPreB2" VALUE 0xF5FDC Kw_Wu32 4294.9663 TimeDelay_s 0.0010000001 4294.9673 FORMAT "%9.4" EXTENDED_LIMITS 0.0000010000000 4294.9673 /end CHARACTERISTIC
/begin CHARACTERISTIC PFltCD_swtActvTPre_C "Aktivierung/Deaktivierung  des Komponententreibers für Abgastemperatur vor  Partikelfilter." VALUE 0xF60C8 Kw_Wu8 1.000 OneToOne 0.00 1.000 FORMAT "%5.3" EXTENDED_LIMITS 0.00 255.0 /end CHARACTERISTIC
/begin CHARACTERISTIC PFltCD_swtSigPPre_C "Wahlschalter für Eingangssignal des pre Partikelfilter druck sensor" VALUE 0xF5FE0 Kw_Wu8 1.000 OneToOne 0.00 1.000 FORMAT "%5.3" EXTENDED_LIMITS 0.00 255.0 /end CHARACTERISTIC
/begin CHARACTERISTIC PFltCD_stSensIDWordPPre_C "Geberkennwort für Abgasdruck vor dem Partikelfilter" VALUE 0xF5FE2 Kw_Wu16 65535.00 OneToOne 0.00 65535.00 FORMAT "%8.2" /end CHARACTERISTIC
/begin CHARACTERISTIC PFltCD_pDflPre_C "Vorgabewert für Absolutdruck vor dem Partikelfilter" VALUE 0xF5FE4 Kw_Ws16 3500.000 Pres_hPa 0.00 3500.000 FORMAT "%8.3" EXTENDED_LIMITS -32768.00 32767.00 /end CHARACTERISTIC
/begin CHARACTERISTIC PFltCD_stSensIDWordTPre_C "Geberkennwort für Abgastemperatur vor dem Partikelfilter" VALUE 0xF60CA Kw_Wu16 65535.00 OneToOne 0.00 65535.00 FORMAT "%8.2" /end CHARACTERISTIC
/begin CHARACTERISTIC PFltCD_tDflPre_C "Vorgabewert für die Abgastemperatur vor dem Partikelfilter" VALUE 0xF60CC Kw_Ws16 950.000 Temp_Cels -50.140 899.860 FORMAT "%8.3" EXTENDED_LIMITS -3549.940 3003.560 /end CHARACTERISTIC
/begin MEASUREMENT PCR_bpMap_mp "Calculation of the correction factor based on atmospheric factor" UBYTE OneToOne 1 100 0.00 255.0 FORMAT "%5.1" ECU_ADDRESS 0x8FEEB3 /end MEASUREMENT
/begin MEASUREMENT PCR_DKd_mp "Kleinsignalverstärkung des Regler-DT1-Anteils" SLONG Kd_Pres2Prc 1 100 -400.000000000 399.999999814 FORMAT "%12.9" ECU_ADDRESS 0x8FEEF4 /end MEASUREMENT
/begin MEASUREMENT PCR_dnAvrgNeg_mp "Rate of change of engine speed in negative direction" SWORD dn_dZ20 1 100 -327680.0 327670.0 FORMAT "%8.1" ECU_ADDRESS 0x8FEEA0 /end MEASUREMENT
/begin MEASUREMENT PCR_dnSurgeHigh_mp "Higher limit for hysteresis to monitor rate of change of Eng_nAvrg for Anti-Surge LIGov" SWORD dn_dZ20 1 100 -327680.0 327670.0 FORMAT "%8.1" ECU_ADDRESS 0x8FEEA2 /end MEASUREMENT
/begin MEASUREMENT PCR_dnSurgeLow_mp "Lower limit for hysteresis to monitor rate of change of Eng_nAvrg for Anti-Surge LIGov" SWORD dn_dZ20 1 100 -327680.0 327670.0 FORMAT "%8.1" ECU_ADDRESS 0x8FEEA4 /end MEASUREMENT
/begin MEASUREMENT PCR_dn_mp "value of engine speed gradient" SWORD dn_dZ20 1 100 -327680.0 327670.0 FORMAT "%8.1" ECU_ADDRESS 0x8FEEF8 /end MEASUREMENT
/begin MEASUREMENT PCR_dpBDesRaw_mp "Derivative of unlimited desired boost pressure with preconttrol" SWORD dp_dZ20 1 100 -327680.0 327670.0 FORMAT "%8.1" ECU_ADDRESS 0x8FEEB4 /end MEASUREMENT
/begin MEASUREMENT PCR_dpBGDev_mp "Ladedruckgradient" SWORD dp_dZ20 1 100 -327680.0 327670.0 FORMAT "%8.1" ECU_ADDRESS 0x8FEEFA /end MEASUREMENT
/begin MEASUREMENT PCR_dqCtlA "Ableitung der Kraftstoffmasse" SWORD InjMassPerSec_20ms 1 100 -16384.00 16383.50 FORMAT "%8.2" ECU_ADDRESS 0x7F910E /end MEASUREMENT
/begin MEASUREMENT PCR_dqDes_mp "Einspritzmengen-Änderung" SWORD InjMassPerSec_20ms 1 100 -16384.00 16383.50 FORMAT "%8.2" ECU_ADDRESS 0x8FEEB6 /end MEASUREMENT
/begin MEASUREMENT PCR_dqInjCtlQRaw_mp "Ausgang von DT1-filter" SWORD InjMassPerSec_20ms 1 100 -16384.00 16383.50 FORMAT "%8.2" ECU_ADDRESS 0x6F828C /end MEASUREMENT
/begin MEASUREMENT PCR_drAPP1UnFlt_mp "Measuring point for ratio of Accelerator pedal 1 position - Unfiltered value" SWORD PrcPerSec 1 100 -20000.00 19999.39 FORMAT "%8.2" ECU_ADDRESS 0x8FEEB8 /end MEASUREMENT
/begin MEASUREMENT PCR_facAdPCVc1_mp "Faktor c1 zur Bestimmung des VorSteuerkennfeldes der Ladedruckregelung" SWORD Fact 1 100 -4.000000 3.999878 FORMAT "%8.6" ECU_ADDRESS 0x8FEEFC /end MEASUREMENT
/begin MEASUREMENT PCR_facAdPCVc2_mp "Faktor c2 zur Bestimmung des VorSteuerkennfeldes der Ladedruckregelung" SWORD Fact 1 100 -4.000000 3.999878 FORMAT "%8.6" ECU_ADDRESS 0x8FEEFE /end MEASUREMENT
/begin MEASUREMENT PCR_facAdPCVc3_mp "Faktor c3 zur Bestimmung des VorSteuerkennfeldes der Ladedruckregelung" SWORD Fact 1 100 -4.000000 3.999878 FORMAT "%8.6" ECU_ADDRESS 0x8FEF00 /end MEASUREMENT
/begin MEASUREMENT PCR_facAdPCVc4_mp "Faktor c4 zur Bestimmung des VorSteuerkennfeldes der Ladedruckregelung" SWORD Fact 1 100 -4.000000 3.999878 FORMAT "%8.6" ECU_ADDRESS 0x8FEF02 /end MEASUREMENT
/begin MEASUREMENT PCR_facAdPCVrx_mp "Faktor rx zur Bestimmung des VorSteuerkennfeldes der Ladedruckregelung" SWORD Fact 1 100 -4.000000 3.999878 FORMAT "%8.6" ECU_ADDRESS 0x8FEF04 /end MEASUREMENT
/begin MEASUREMENT PCR_facAdPCVry_mp "Faktor ry zur Bestimmung des VorSteuerkennfeldes der Ladedruckregelung" SWORD Fact 1 100 -4.000000 3.999878 FORMAT "%8.6" ECU_ADDRESS 0x8FEF06 /end MEASUREMENT
/begin MEASUREMENT PCR_facAirAmplFlt_mp "Amplitudenhöhe der oszillierenden Frischluftmasse beim Laderpumpen" SWORD FactM 1 100 -2048.000 2047.938 FORMAT "%8.3" ECU_ADDRESS 0x8FEFAA /end MEASUREMENT
/begin MEASUREMENT PCR_facAirDTAbsAmpl2_mp "Faktor des Absolutwerts von zweitem PT1 - filtern" SWORD FactM 1 100 -2048.000 2047.938 FORMAT "%8.3" ECU_ADDRESS 0x8FEFAC /end MEASUREMENT
/begin MEASUREMENT PCR_facAirDTAmpl12_mp "Messender Punkt für Ausgang zweiter DT1-filter" SWORD FactM 1 100 -2048.000 2047.938 FORMAT "%8.3" ECU_ADDRESS 0x8FEFAE /end MEASUREMENT
/begin MEASUREMENT PCR_facAirPerTimeAmplFlt "Amplitudenhöhe der oszillierenden Frischluftmasse beim La-derpumpen tiefpassgefiltert" SWORD FactM 1 100 -2048.000 2047.938 FORMAT "%8.3" ECU_ADDRESS 0x7F9110 /end MEASUREMENT
/begin MEASUREMENT PCR_facAirPerTimeAmplFlt_mp "Amplitudenhöhe der oszillierenden Frischluftmasse beim Laderpumpen nach DFT tiefpassgefilter (PT1)" SWORD FactM 1 100 -2048.000 2047.938 FORMAT "%8.3" ECU_ADDRESS 0x8FEFB0 /end MEASUREMENT
/begin MEASUREMENT PCR_facAirPerTimeAmpl_mp "Amplitudenhöhe der oszillierenden Frischluftmasse beim Laderpumpen nach DFT" SWORD FactM 1 100 -2048.000 2047.938 FORMAT "%8.3" ECU_ADDRESS 0x8FEFB2 /end MEASUREMENT
/begin MEASUREMENT PCR_facAirPTAmpl12_mp "Maßpunkt für das otput zweiter PT1-filter" SWORD FactM 1 100 -2048.000 2047.938 FORMAT "%8.3" ECU_ADDRESS 0x8FEFB4 /end MEASUREMENT
/begin MEASUREMENT PCR_facAirPTAmpl1_mp "Amplitudenhöhe der oszillierenden Frischluftmasse beim Laderpumpen (nach PT1-Ctl1)" SWORD FactM 1 100 -2048.000 2047.938 FORMAT "%8.3" ECU_ADDRESS 0x8FEFB6 /end MEASUREMENT
/begin MEASUREMENT PCR_facAirPTAmpl2Flt_mp "Amplitudenhöhe der oszillierenden Frischluftmasse beim Laderpumpen (nach PT1-Ctl2)" SWORD FactM 1 100 -2048.000 2047.938 FORMAT "%8.3" ECU_ADDRESS 0x8FEFB8 /end MEASUREMENT
/begin MEASUREMENT PCR_facAirPTAmpl2_mp "Amplitudenhöhe der oszillierenden Frischluftmasse beim Laderpumpen (früher PT1-Ctl2)" SWORD FactM 1 100 -2048.000 2047.938 FORMAT "%8.3" ECU_ADDRESS 0x8FEFBA /end MEASUREMENT
/begin MEASUREMENT PCR_facATRgn_mp "lufttemperaturabhängigerKorrekturfactor bei Regenerationsbetrieb" SWORD Fact 1 100 -4.000000 3.999878 FORMAT "%8.6" ECU_ADDRESS 0x8FEEBA /end MEASUREMENT
/begin MEASUREMENT PCR_facAT_mp "Lufttemperaturabhängiger Faktor für Sollwertberechnung" SWORD Fact 1 100 -4.000000 3.999878 FORMAT "%8.6" ECU_ADDRESS 0x8FEEBC /end MEASUREMENT
/begin MEASUREMENT PCR_facCosCoeffDFT_mp "Kosinuskoeffizient der Fouriertransformation" SLONG FactM 1 100 -134217728.000 134217727.938 FORMAT "%13.3" ECU_ADDRESS 0x8FEFBC /end MEASUREMENT
/begin MEASUREMENT PCR_facCtQ_mp "Kühltemperaturabhängiger Faktor für Sollwertberechnung" SWORD Fact 1 100 -4.000000 3.999878 FORMAT "%8.6" ECU_ADDRESS 0x8FEEBE /end MEASUREMENT
/begin MEASUREMENT PCR_facD1_mp "Adaptionsfaktor für Regler-D-Verstärkung" SWORD Fact1 1 100 -256.0000 255.9922 FORMAT "%8.4" ECU_ADDRESS 0x8FEF08 /end MEASUREMENT
/begin MEASUREMENT PCR_facDnCorr_mp "corrective factor based on engine speed gradient" SWORD Fact1 1 100 -256.0000 255.9922 FORMAT "%8.4" ECU_ADDRESS 0x8FEF0A /end MEASUREMENT
/begin MEASUREMENT PCR_facDpCorr_mp "Korrekturfaktor für D-Parameter Korrektur aus dem Ladedruckgradienten" SWORD Fact1 1 100 -256.0000 255.9922 FORMAT "%8.4" ECU_ADDRESS 0x8FEF0C /end MEASUREMENT
/begin MEASUREMENT PCR_facD_mp "Adaptionsfaktor für Regler-D-Verstärkung" SWORD Fact1 1 100 -256.0000 255.9922 FORMAT "%8.4" ECU_ADDRESS 0x8FEF0E /end MEASUREMENT
/begin MEASUREMENT PCR_facI_mp "Adaptionsfaktor für Regler-I-Verstärkung" SWORD Fact1 1 100 -256.0000 255.9922 FORMAT "%8.4" ECU_ADDRESS 0x8FEF10 /end MEASUREMENT
/begin MEASUREMENT PCR_facN_mp "Faktor für Berücksichtigung der Drehzahl DesValCalc" SWORD Fact 1 100 -4.000000 3.999878 FORMAT "%8.6" ECU_ADDRESS 0x8FEEC0 /end MEASUREMENT
/begin MEASUREMENT PCR_facP_mp "Adaptionsfaktor für Regler-P-Verstärkung" SWORD Fact1 1 100 -256.0000 255.9922 FORMAT "%8.4" ECU_ADDRESS 0x8FEF12 /end MEASUREMENT
/begin MEASUREMENT PCR_facresFlowRawCorr_mp "Regler D-Parameter Korrektur über Drehzahl und CSF Stroemungswiderstand" SWORD Fact1 1 100 -256.0000 255.9922 FORMAT "%8.4" ECU_ADDRESS 0x8FEF14 /end MEASUREMENT
/begin MEASUREMENT PCR_facSGDevI_mp "I Regelabweichung AntiSurge-Regler" SWORD FactM 1 100 -2048.000 2047.938 FORMAT "%8.3" ECU_ADDRESS 0x8FEF8C /end MEASUREMENT
/begin MEASUREMENT PCR_facSinCoeffDFT_mp "Sinuskoeffizient der Fouriertransformation" SLONG FactM 1 100 -134217728.000 134217727.938 FORMAT "%13.3" ECU_ADDRESS 0x8FEFC0 /end MEASUREMENT
/begin MEASUREMENT PCR_facSinIn_mp "Kennlinieeingangsgröße für den Ersatz der Sinusfunktion durch die Kennlinie" SWORD Fact1 1 100 -256.0000 255.9922 FORMAT "%8.4" ECU_ADDRESS 0x8FEFC4 /end MEASUREMENT
/begin MEASUREMENT PCR_facSinOut_mp "Kennlinieausgangsgröße für den Ersatz der Sinusfunktion durch Kennlinie" SWORD Fact 1 100 -4.000000 3.999878 FORMAT "%8.6" ECU_ADDRESS 0x8FEFC6 /end MEASUREMENT
/begin MEASUREMENT PCR_facSqrIn_mp "Kennlinieeingangsgröße für den Ersatz der Quadratwurzelfunktion durch die Kennlinie" SWORD FactM 1 100 -2048.000 2047.938 FORMAT "%8.3" ECU_ADDRESS 0x8FEFC8 /end MEASUREMENT
/begin MEASUREMENT PCR_facSurgeDes_mp "Sollwert Luftmassenschwingung(AntiSurge-Regler)" SWORD FactM 1 100 -2048.000 2047.938 FORMAT "%8.3" ECU_ADDRESS 0x8FEF8E /end MEASUREMENT
/begin MEASUREMENT PCR_facSurgeGvnrDev_mp "Regelabweichung AntiSurge-Regler" SWORD FactM 1 100 -2048.000 2047.938 FORMAT "%8.3" ECU_ADDRESS 0x8FEF90 /end MEASUREMENT
/begin MEASUREMENT PCR_facSurgeI_mp "Adaptionsfaktor für I-Reglerverstärkung" SWORD Fact1 1 100 -256.0000 255.9922 FORMAT "%8.4" ECU_ADDRESS 0x8FEF92 /end MEASUREMENT
/begin MEASUREMENT PCR_facSurgeP_mp "Adaptionsfaktor für P-Reglerverstärkung" SWORD Fact1 1 100 -256.0000 255.9922 FORMAT "%8.4" ECU_ADDRESS 0x8FEF94 /end MEASUREMENT
/begin MEASUREMENT PCR_pAPQCmpnRgn_mp "atmosphärendruckabhängigen Korrekturwert bei Regenerationsbetrieb" SWORD Pres 1 100 -32768.00 32767.00 FORMAT "%9.2" ECU_ADDRESS 0x8FEEC2 /end MEASUREMENT
/begin MEASUREMENT PCR_pAPQCmpn_mp "luftdruckabhängige Kompensation für Sollwertbildung" SWORD Pres 1 100 -32768.00 32767.00 FORMAT "%9.2" ECU_ADDRESS 0x8FEEC4 /end MEASUREMENT
/begin MEASUREMENT PCR_pBasMAP_mp "stationärer Ladedrucksollwert aus Basiskennfeld" SWORD Pres 1 100 -32768.00 32767.00 FORMAT "%9.2" ECU_ADDRESS 0x8FEEC6 /end MEASUREMENT
/begin MEASUREMENT PCR_pBDesAPCorrRgn1_mp "in Abhängigkeit des atmosphärendruck korrigierter Sollwert aus erstem Regenerationskennfeld" SWORD Pres 1 100 -32768.00 32767.00 FORMAT "%9.2" ECU_ADDRESS 0x8FEEC8 /end MEASUREMENT
/begin MEASUREMENT PCR_pBDesAPCorrRgn2_mp "in Abhängigkeit des atmosphärendrucks korrigierter Sollwert aus zweitem Regenerationskennfeld" SWORD Pres 1 100 -32768.00 32767.00 FORMAT "%9.2" ECU_ADDRESS 0x8FEECA /end MEASUREMENT
/begin MEASUREMENT PCR_pBDesAPCorr_mp "Luftdruckabhängige Korrektur des Ladedrucksollwerts" SWORD Pres 1 100 -32768.00 32767.00 FORMAT "%9.2" ECU_ADDRESS 0x8FEECC /end MEASUREMENT
/begin MEASUREMENT PCR_pBDesATCorrRgn1_mp "korrigierter Ladedrucksollwert aus Regenerationskennfeld 1" SWORD Pres 1 100 -32768.00 32767.00 FORMAT "%9.2" ECU_ADDRESS 0x8FEECE /end MEASUREMENT
/begin MEASUREMENT PCR_pBDesATCorrRgn2_mp "korriegerter Ladedrucksollwert aus zweitem Regenerationskennfeld 2" SWORD Pres 1 100 -32768.00 32767.00 FORMAT "%9.2" ECU_ADDRESS 0x8FEED0 /end MEASUREMENT
/begin MEASUREMENT PCR_pBDesATCorr_mp "Bezüglich Lufttemperatur korrigierter Ladedrucksollwert" SWORD Pres 1 100 -32768.00 32767.00 FORMAT "%9.2" ECU_ADDRESS 0x8FEED2 /end MEASUREMENT
/begin MEASUREMENT PCR_pBDesCtCorr_mp "Kühltemperaturkorrigierter Wert des Ladedrucksollwerts" SWORD Pres 1 100 -32768.00 32767.00 FORMAT "%9.2" ECU_ADDRESS 0x8FEED4 /end MEASUREMENT
/begin MEASUREMENT PCR_pBDesDyn_mp "Dynamischer Teil des Ladedrucksollwerts" SWORD Pres_hPa 1 100 -32768.00 32767.00 FORMAT "%8.2" ECU_ADDRESS 0x8FEED6 /end MEASUREMENT
/begin MEASUREMENT PCR_pBDesFlt_mp "Output value from PT1 Filter" SWORD Pres_hPa 1 100 -32768.00 32767.00 FORMAT "%8.2" ECU_ADDRESS 0x8FEF16 /end MEASUREMENT
/begin MEASUREMENT PCR_pBDesLPUnLim_mp "Ladedrucksollwert EGT-Rampenausgang" SWORD Pres_hPa 1 100 -32768.00 32767.00 FORMAT "%8.2" ECU_ADDRESS 0x8FEF5A /end MEASUREMENT
/begin MEASUREMENT PCR_pBDesLP_mp "Gewuenschter Ladedrucksollwert" SWORD Pres_hPa 1 100 -32768.00 32767.00 FORMAT "%8.2" ECU_ADDRESS 0x6F8282 /end MEASUREMENT
/begin MEASUREMENT PCR_pBDesMaxAP_mp "Größter erlaubter Ladedrucksollwert in Abhängigkeit vom Luftdruck" SWORD Pres 1 100 -32768.00 32767.00 FORMAT "%9.2" ECU_ADDRESS 0x8FEED8 /end MEASUREMENT
/begin MEASUREMENT PCR_pBDesNCorr_mp "Boost press. value corr. by eng. spd. fac." SWORD Pres 1 100 -32768.00 32767.00 FORMAT "%9.2" ECU_ADDRESS 0x8FEEDA /end MEASUREMENT
/begin MEASUREMENT PCR_pBDesRaw2_mp "Unlimited desired boost pressure with rampcontrol." SWORD Pres_hPa 1 100 -32768.00 32767.00 FORMAT "%8.2" ECU_ADDRESS 0x8FEEDC /end MEASUREMENT
/begin MEASUREMENT PCR_pBDesRaw3_mp "roher Sollwert für den Anti-Ruckel-Regler" SWORD Pres_hPa 1 100 -32768.00 32767.00 FORMAT "%8.2" ECU_ADDRESS 0x8FEEDE /end MEASUREMENT
/begin MEASUREMENT PCR_pBDesRaw_mp "Unbegrenzter Ladedrucksollwert mit Vorsteuerung" SWORD Pres_hPa 1 100 -32768.00 32767.00 FORMAT "%8.2" ECU_ADDRESS 0x8FEEE0 /end MEASUREMENT
/begin MEASUREMENT PCR_pBDesStat_mp "Stationärer Teil des Ladedrucksollwerts" SWORD Pres 1 100 -32768.00 32767.00 FORMAT "%9.2" ECU_ADDRESS 0x8FEEE2 /end MEASUREMENT
/begin MEASUREMENT PCR_pBDes_mp "gewälter unbegrenzerter Ladedrucksollwert" SWORD Pres 1 100 -32768.00 32767.00 FORMAT "%9.2" ECU_ADDRESS 0x8FEEE4 /end MEASUREMENT
/begin MEASUREMENT PCR_pBGDev "Regelabweichung" SWORD Pres_hPa 1 100 -32768.00 32767.00 FORMAT "%8.2" ECU_ADDRESS 0x7F9116 /end MEASUREMENT
/begin MEASUREMENT PCR_pBGDev2_mp "Deviation I/P for Integrator" SWORD Pres_hPa 1 100 -32768.00 32767.00 FORMAT "%8.2" ECU_ADDRESS 0x8FEF18 /end MEASUREMENT
/begin MEASUREMENT PCR_pBGDevI_mp "Regelabweichung für I-Anteil" SWORD Pres_hPa 1 100 -32768.00 32767.00 FORMAT "%8.2" ECU_ADDRESS 0x8FEF1A /end MEASUREMENT
/begin MEASUREMENT PCR_pBGDevMaxRaw_mp "messpunkt für Erkennung einer bleibenden Regelabweichung" SWORD Pres_hPa 1 100 -32768.00 32767.00 FORMAT "%8.2" ECU_ADDRESS 0x8FEF7C /end MEASUREMENT
/begin MEASUREMENT PCR_pBGDevMax_mp "Maximale Reglerabweichung" SWORD Pres_hPa 1 100 -32768.00 32767.00 FORMAT "%8.2" ECU_ADDRESS 0x6F8288 /end MEASUREMENT
/begin MEASUREMENT PCR_pBGDevMinRaw_mp "messpunkt für Erkennung einer bleibenden Regelabweichung" SWORD Pres_hPa 1 100 -32768.00 32767.00 FORMAT "%8.2" ECU_ADDRESS 0x8FEF7E /end MEASUREMENT
/begin MEASUREMENT PCR_pBGDevMin_mp "negative deviation threshold with offset" SWORD Pres_hPa 1 100 -32768.00 32767.00 FORMAT "%8.2" ECU_ADDRESS 0x6F828A /end MEASUREMENT
/begin MEASUREMENT PCR_pBGDvtLP "Regelabweichung" SWORD Pres_hPa 1 100 -32768.00 32767.00 FORMAT "%8.2" ECU_ADDRESS 0x7F9118 /end MEASUREMENT
/begin MEASUREMENT PCR_pBSurgeCtlVal_mp "Steuerwert" SWORD Pres_hPa 1 100 -32768.00 32767.00 FORMAT "%8.2" ECU_ADDRESS 0x8FEF96 /end MEASUREMENT
/begin MEASUREMENT PCR_pBSurgeDes "Sollwert Ladedruck zur Reduktion Laderpumpen" SWORD Pres_hPa 1 100 -32768.00 32767.00 FORMAT "%8.2" ECU_ADDRESS 0x7F911A /end MEASUREMENT
/begin MEASUREMENT PCR_pBSurgeDesMax_mp "maximal zulässige Reglerstellgröße AntiSurge-Regler" SWORD Pres_hPa 1 100 -32768.00 32767.00 FORMAT "%8.2" ECU_ADDRESS 0x8FEF98 /end MEASUREMENT
/begin MEASUREMENT PCR_pBSurgeDesMin_mp "minimal zulässige Reglerstellgröße AntiSurge-Regler" SWORD Pres_hPa 1 100 -32768.00 32767.00 FORMAT "%8.2" ECU_ADDRESS 0x8FEF9A /end MEASUREMENT
/begin MEASUREMENT PCR_pBSurgeDesRaw_mp "Tastverhältnis CpBVlv geschlossen EGT-Rampenausgang" SWORD Pres_hPa 1 100 -32768.00 32767.00 FORMAT "%8.2" ECU_ADDRESS 0x8FEF9C /end MEASUREMENT
/begin MEASUREMENT PCR_pBSurgePICtlLim_mp "PI-Anteil des PI-Regler" SWORD Pres_hPa 1 100 -32768.00 32767.00 FORMAT "%8.2" ECU_ADDRESS 0x8FEF9E /end MEASUREMENT
/begin MEASUREMENT PCR_pBSurgePICtl_mp "PI-Anteil des PI-Regler" SWORD Pres_hPa 1 100 -32768.00 32767.00 FORMAT "%8.2" ECU_ADDRESS 0x8FEFA0 /end MEASUREMENT
/begin MEASUREMENT PCR_pDesByp_mp "Bypass-Label, Kopie von PCR_pBDes" SWORD Pres_hPa 1 100 -32768.00 32767.00 FORMAT "%8.2" ECU_ADDRESS 0x8FEEE6 /end MEASUREMENT
/begin MEASUREMENT PCR_pDesVal "Ladedrucksollwert" SWORD Pres_hPa 1 100 -32768.00 32767.00 FORMAT "%8.2" ECU_ADDRESS 0x7F911C /end MEASUREMENT
/begin MEASUREMENT PCR_pLPDvtMaxRaw_mp "Max. Schwelle für Regelabweichung Niederdruckstufe (vor Offset)" SWORD Pres_hPa 1 100 -32768.00 32767.00 FORMAT "%8.2" ECU_ADDRESS 0x8FEF70 /end MEASUREMENT
/begin MEASUREMENT PCR_pLPDvtMax_mp "Maximale Schwelle für Regelabweichung Niederdruckstufe" SWORD Pres_hPa 1 100 -32768.00 32767.00 FORMAT "%8.2" ECU_ADDRESS 0x6F8284 /end MEASUREMENT
/begin MEASUREMENT PCR_pLPDvtMinRaw_mp " Min. Schwelle für Regelabweichung Niederdruckstufe(vor Offset)" SWORD Pres_hPa 1 100 -32768.00 32767.00 FORMAT "%8.2" ECU_ADDRESS 0x8FEF72 /end MEASUREMENT
/begin MEASUREMENT PCR_pLPDvtMin_mp "Minimale Schwelle für Regelabweichung Niederdruckstufe" SWORD Pres_hPa 1 100 -32768.00 32767.00 FORMAT "%8.2" ECU_ADDRESS 0x6F8286 /end MEASUREMENT
/begin MEASUREMENT PCR_pNQCtCmpn_mp "Korrekturwert für Kühlwassertemperaturkorrektur für Sollwertberechnung" SWORD Pres 1 100 -32768.00 32767.00 FORMAT "%9.2" ECU_ADDRESS 0x8FEEE8 /end MEASUREMENT
/begin MEASUREMENT PCR_pRgnMAP1_mp "stationärer Ladedrucksollwert aus erstem Regenerationskennfeld" SWORD Pres 1 100 -32768.00 32767.00 FORMAT "%9.2" ECU_ADDRESS 0x8FEEEA /end MEASUREMENT
/begin MEASUREMENT PCR_pRgnMAP2_mp "stationärer Ladedrucksollwert aus zweitem Regenerationskennfeld" SWORD Pres 1 100 -32768.00 32767.00 FORMAT "%9.2" ECU_ADDRESS 0x8FEEEC /end MEASUREMENT
/begin MEASUREMENT PCR_pSOutI_mp "I-Anteil des PI-Regler" SWORD Pres_hPa 1 100 -32768.00 32767.00 FORMAT "%8.2" ECU_ADDRESS 0x8FEFA2 /end MEASUREMENT
/begin MEASUREMENT PCR_pSOutP_mp "P-Anteil des PI-Regler" SWORD Pres_hPa 1 100 -32768.00 32767.00 FORMAT "%8.2" ECU_ADDRESS 0x8FEFA4 /end MEASUREMENT
/begin MEASUREMENT PCR_pSurgestI_mp "I-Anteil des PI-Regler" SWORD Pres_hPa 1 100 -32768.00 32767.00 FORMAT "%8.2" ECU_ADDRESS 0x8FEFA6 /end MEASUREMENT
/begin MEASUREMENT PCR_qDes "Einspritzmenge für Sollwertbildung" SWORD InjMass 1 100 -327.6800 327.6700 FORMAT "%8.4" ECU_ADDRESS 0x7F9120 /end MEASUREMENT
/begin MEASUREMENT PCR_qDesFrmMngTrqInr_mp "Desired quantity based on FrmMng_trqInr and FMTC_etaCurr" SWORD InjMassCyc 1 100 -327.6800 327.6700 FORMAT "%8.4" ECU_ADDRESS 0x8FEEEE /end MEASUREMENT
/begin MEASUREMENT PCR_qLPGvnrOff_mp "Einspritzmenge für Reglerabschaltschwelle(Niederdruckstufe)" SWORD InjMass 1 100 -327.6800 327.6700 FORMAT "%8.4" ECU_ADDRESS 0x8FEF74 /end MEASUREMENT
/begin MEASUREMENT PCR_qLPGvnrOn_mp "Einspritzmenge für Reglereinschaltschwelle(Niederdruckstufe)" SWORD InjMass 1 100 -327.6800 327.6700 FORMAT "%8.4" ECU_ADDRESS 0x8FEF76 /end MEASUREMENT
/begin MEASUREMENT PCR_qReal "Injection quantity after switching" SWORD InjMassCyc 1 100 -327.6800 327.6700 FORMAT "%8.4" ECU_ADDRESS 0x7F9122 /end MEASUREMENT
/begin MEASUREMENT PCR_qSurgeHigh_mp "Higher quantity limit for hysteresis of Anti-Surge LIGov" SWORD InjMass 1 100 -327.6800 327.6700 FORMAT "%8.4" ECU_ADDRESS 0x8FEEA6 /end MEASUREMENT
/begin MEASUREMENT PCR_qSurgeLow_mp "Lower quantity limit for hysteresis of Anti-Surge LIGov" SWORD InjMass 1 100 -327.6800 327.6700 FORMAT "%8.4" ECU_ADDRESS 0x8FEEA8 /end MEASUREMENT
/begin MEASUREMENT PCR_rAdPCVCtlValLim "" SWORD Prc 1 100 -400.0000 399.9878 FORMAT "%8.4" ECU_ADDRESS 0x7F9124 /end MEASUREMENT
/begin MEASUREMENT PCR_rAdPCVCtlVal_mp "Adaption des VorSteuerkennfeldes der Ladedruckregelung" SWORD Prc 1 100 -400.0000 399.9878 FORMAT "%8.4" ECU_ADDRESS 0x8FEF1C /end MEASUREMENT
/begin MEASUREMENT PCR_rAdPCVI1_mp "Eingang in den I1-Regler nach Multiplizieren mit C1" SWORD Prc 1 100 -400.0000 399.9878 FORMAT "%8.4" ECU_ADDRESS 0x8FEF1E /end MEASUREMENT
/begin MEASUREMENT PCR_rAdPCVI2_mp "Eingang in den I2-Regler nach Multiplizieren mit C2" SWORD Prc 1 100 -400.0000 399.9878 FORMAT "%8.4" ECU_ADDRESS 0x8FEF20 /end MEASUREMENT
/begin MEASUREMENT PCR_rAdPCVI3_mp "Eingang in den I3-Regler nach Multiplizieren mit C3" SWORD Prc 1 100 -400.0000 399.9878 FORMAT "%8.4" ECU_ADDRESS 0x8FEF22 /end MEASUREMENT
/begin MEASUREMENT PCR_rAdPCVI4_mp "Eingang in den I4-Regler nach Multiplizieren mit C4" SWORD Prc 1 100 -400.0000 399.9878 FORMAT "%8.4" ECU_ADDRESS 0x8FEF24 /end MEASUREMENT
/begin MEASUREMENT PCR_rBPA "Stellgröße für den Ladedrucksteller" SWORD Prc 1 100 -400.0000 399.9878 FORMAT "%8.4" ECU_ADDRESS 0x7F9126 /end MEASUREMENT
/begin MEASUREMENT PCR_rBPA2 "Ratio2 of valve lift for boost pressure actuator" SWORD Prc 1 100 -400.0000 399.9878 FORMAT "%8.4" ECU_ADDRESS 0x7F9128 /end MEASUREMENT
/begin MEASUREMENT PCR_rBPACDByp_mp "Bypass-Label, Kopie von PCR_rBPACD" SWORD Prc 1 100 -400.0000 399.9878 FORMAT "%8.4" ECU_ADDRESS 0x8FEF80 /end MEASUREMENT
/begin MEASUREMENT PCR_rBPALP "TV Rohwert an Niederdruckstufensteller" SWORD Prc 1 100 -400.0000 399.9878 FORMAT "%8.4" ECU_ADDRESS 0x7F912A /end MEASUREMENT
/begin MEASUREMENT PCR_rBPALP2 "Stellgröße für den 2. Ladedrucksteller" SWORD Prc 1 100 -400.0000 399.9878 FORMAT "%8.4" ECU_ADDRESS 0x7F912C /end MEASUREMENT
/begin MEASUREMENT PCR_rBPBasLP_mp "Vorsteuerungstastverhältnis EGT Rampenausgang" SWORD Prc 1 100 -400.0000 399.9878 FORMAT "%8.4" ECU_ADDRESS 0x8FEF5C /end MEASUREMENT
/begin MEASUREMENT PCR_rBPGovMax "Maximal zulässige Reglerstellgröße" SWORD Prc 1 100 -400.0000 399.9878 FORMAT "%8.4" ECU_ADDRESS 0x7F912E /end MEASUREMENT
/begin MEASUREMENT PCR_rBPGovMaxDynRamp_mp "Ramp correction to Maximum allowable PCR governer output" SWORD Prc 1 100 -400.0000 399.9878 FORMAT "%8.4" ECU_ADDRESS 0x6F8274 /end MEASUREMENT
/begin MEASUREMENT PCR_rBPGovMaxDyn_mp "Maximum allowable PCR governer output before ramp correction" SWORD Prc 1 100 -400.0000 399.9878 FORMAT "%8.4" ECU_ADDRESS 0x6F8276 /end MEASUREMENT
/begin MEASUREMENT PCR_rBPGovMaxVal1_mp "Maximum allowable PCR governer output without dynamic correction" SWORD Prc 1 100 -400.0000 399.9878 FORMAT "%8.4" ECU_ADDRESS 0x6F8278 /end MEASUREMENT
/begin MEASUREMENT PCR_rBPGovMaxVal2_mp "Maximum allowable PCR governer output with dynamic correction" SWORD Prc 1 100 -400.0000 399.9878 FORMAT "%8.4" ECU_ADDRESS 0x6F827A /end MEASUREMENT
/begin MEASUREMENT PCR_rBPGovMax_mp "Maximal zulässige Reglerstellgröße" SWORD Prc 1 100 -400.0000 399.9878 FORMAT "%8.4" ECU_ADDRESS 0x6F827C /end MEASUREMENT
/begin MEASUREMENT PCR_rBPGovMin "Minimal zulässige Reglerstellgröße" SWORD Prc 1 100 -400.0000 399.9878 FORMAT "%8.4" ECU_ADDRESS 0x7F9130 /end MEASUREMENT
/begin MEASUREMENT PCR_rBPGovMin_mp "Minimal zulässige Reglerstellgröße" SWORD Prc 1 100 -400.0000 399.9878 FORMAT "%8.4" ECU_ADDRESS 0x6F827E /end MEASUREMENT
/begin MEASUREMENT PCR_rBPGvnrUnLim1_mp "Ladedrucksteller- Tastverhältnis 1 (unbegrenzt)" SWORD Prc 1 100 -400.0000 399.9878 FORMAT "%8.4" ECU_ADDRESS 0x8FEF26 /end MEASUREMENT
/begin MEASUREMENT PCR_rBPGvnrUnLim2_mp "Ladedrucksteller- Tastverhältnis 2 (unbegrenzt)" SWORD Prc 1 100 -400.0000 399.9878 FORMAT "%8.4" ECU_ADDRESS 0x8FEF28 /end MEASUREMENT
/begin MEASUREMENT PCR_rBPLim "limited boost pressure actuator value" SWORD Prc 1 100 -400.0000 399.9878 FORMAT "%8.4" ECU_ADDRESS 0x7F9132 /end MEASUREMENT
/begin MEASUREMENT PCR_rBPLim_mp "limited value of PID output" SWORD Prc 1 100 -400.0000 399.9878 FORMAT "%8.4" ECU_ADDRESS 0x8FEF2A /end MEASUREMENT
/begin MEASUREMENT PCR_rBPRglBasLP_mp "Vorgabewert bei betätigter Kupplung" SWORD Prc 1 100 -400.0000 399.9878 FORMAT "%8.4" ECU_ADDRESS 0x8FEF5E /end MEASUREMENT
/begin MEASUREMENT PCR_rDflVal18_mp "Vorgabewer wenn Kupplung getreten" SWORD Prc 1 100 -400.0000 399.9878 FORMAT "%8.4" ECU_ADDRESS 0x8FEF82 /end MEASUREMENT
/begin MEASUREMENT PCR_rGovMaxCorr_mp "Korrektur LDR-TV aus Stroemungswiderstand PFlt" SWORD Prc 1 100 -400.0000 399.9878 FORMAT "%8.4" ECU_ADDRESS 0x8FEF2C /end MEASUREMENT
/begin MEASUREMENT PCR_rGvnr "Reglerstellgröße für den Ladedruck" SWORD Prc 1 100 -400.0000 399.9878 FORMAT "%8.4" ECU_ADDRESS 0x7F913A /end MEASUREMENT
/begin MEASUREMENT PCR_rGvnr2 "Ratio 2 of valve lift from governor with PCR Balancing governor" SWORD Prc 1 100 -400.0000 399.9878 FORMAT "%8.4" ECU_ADDRESS 0x7F913C /end MEASUREMENT
/begin MEASUREMENT PCR_rGvnrLP "Stellgröße des Ladedruckreglers LP - Steller 1" SWORD Prc 1 100 -400.0000 399.9878 FORMAT "%8.4" ECU_ADDRESS 0x7F913E /end MEASUREMENT
/begin MEASUREMENT PCR_rGvnrSurge "roher Steuerwert für den Anti-Ruckel-Regler" SWORD Prc 1 100 -400.0000 399.9878 FORMAT "%8.4" ECU_ADDRESS 0x7F9142 /end MEASUREMENT
/begin MEASUREMENT PCR_rGvnrSurgeRaw_mp "PID-Ausgabe" SWORD Prc 1 100 -400.0000 399.9878 FORMAT "%8.4" ECU_ADDRESS 0x6F828E /end MEASUREMENT
/begin MEASUREMENT PCR_rInitI1AdPCV_mp "Initialisationswerte fuer I1-Regler" SWORD Prc 1 100 -400.0000 399.9878 FORMAT "%8.4" ECU_ADDRESS 0x8FEF2E /end MEASUREMENT
/begin MEASUREMENT PCR_rInitI2AdPCV_mp "Initialisationswerte fuer I2-Regler" SWORD Prc 1 100 -400.0000 399.9878 FORMAT "%8.4" ECU_ADDRESS 0x8FEF30 /end MEASUREMENT
/begin MEASUREMENT PCR_rInitI3AdPCV_mp "Initialisationswerte fuer I3-Regler" SWORD Prc 1 100 -400.0000 399.9878 FORMAT "%8.4" ECU_ADDRESS 0x8FEF32 /end MEASUREMENT
/begin MEASUREMENT PCR_rInitI4AdPCV_mp "Initialisationswerte fuer I4-Regler" SWORD Prc 1 100 -400.0000 399.9878 FORMAT "%8.4" ECU_ADDRESS 0x8FEF34 /end MEASUREMENT
/begin MEASUREMENT PCR_rOutAdPCVI1_mp "Ausgang Des I1-Regler" SWORD Prc 1 100 -400.0000 399.9878 FORMAT "%8.4" ECU_ADDRESS 0x8FEF36 /end MEASUREMENT
/begin MEASUREMENT PCR_rOutAdPCVI2_mp "Ausgang Des I2-Regler" SWORD Prc 1 100 -400.0000 399.9878 FORMAT "%8.4" ECU_ADDRESS 0x8FEF38 /end MEASUREMENT
/begin MEASUREMENT PCR_rOutAdPCVI3_mp "Ausgang Des I3-Regler" SWORD Prc 1 100 -400.0000 399.9878 FORMAT "%8.4" ECU_ADDRESS 0x8FEF3A /end MEASUREMENT
/begin MEASUREMENT PCR_rOutAdPCVI4_mp "Ausgang Des I4-Regler" SWORD Prc 1 100 -400.0000 399.9878 FORMAT "%8.4" ECU_ADDRESS 0x8FEF3C /end MEASUREMENT
/begin MEASUREMENT PCR_rOutDLP_mp "DTWin1-Regler Ausgang" SWORD Prc 1 100 -400.0000 399.9878 FORMAT "%8.4" ECU_ADDRESS 0x8FEF60 /end MEASUREMENT
/begin MEASUREMENT PCR_rOutDT1_mp "DT1-Anteil des PIDT1 Reglers" SWORD Prc 1 100 -400.0000 399.9878 FORMAT "%8.4" ECU_ADDRESS 0x8FEF3E /end MEASUREMENT
/begin MEASUREMENT PCR_rOutILimLP_mp "Limit of I- governor with MAP in LP Governor" SWORD Prc 1 100 -400.0000 399.9878 FORMAT "%8.4" ECU_ADDRESS 0x8FEF62 /end MEASUREMENT
/begin MEASUREMENT PCR_rOutILim_mp "limited value of output" SWORD Prc 1 100 -400.0000 399.9878 FORMAT "%8.4" ECU_ADDRESS 0x8FEF40 /end MEASUREMENT
/begin MEASUREMENT PCR_rOutILP_mp "I-Regler Ausgang" SWORD Prc 1 100 -400.0000 399.9878 FORMAT "%8.4" ECU_ADDRESS 0x8FEF64 /end MEASUREMENT
/begin MEASUREMENT PCR_rOutIMaxLP_mp "Map Output value to limit I- Governor in LPGovernor" SWORD Prc 1 100 -400.0000 399.9878 FORMAT "%8.4" ECU_ADDRESS 0x8FEF66 /end MEASUREMENT
/begin MEASUREMENT PCR_rOutIMax_mp "Ausgangsgröße des Kennfeldes PCR_rOutIMax_MAP" SWORD Prc 1 100 -400.0000 399.9878 FORMAT "%8.4" ECU_ADDRESS 0x8FEF42 /end MEASUREMENT
/begin MEASUREMENT PCR_rOutIMin_mp "Minimal Begrenzung des I-Regler" SWORD Prc 1 100 -400.0000 399.9878 FORMAT "%8.4" ECU_ADDRESS 0x8FEF44 /end MEASUREMENT
/begin MEASUREMENT PCR_rOutI_mp "I-Anteil des PIDT1 Reglers" SWORD Prc 1 100 -400.0000 399.9878 FORMAT "%8.4" ECU_ADDRESS 0x8FEF46 /end MEASUREMENT
/begin MEASUREMENT PCR_rOutLimLP_mp "Beschraenkter PID + Vorsteuertastverhaeltnis Ausgang" SWORD Prc 1 100 -400.0000 399.9878 FORMAT "%8.4" ECU_ADDRESS 0x8FEF68 /end MEASUREMENT
/begin MEASUREMENT PCR_rOutLP_mp "PID + Vorsteuertastverhaeltnis Ausgang" SWORD Prc 1 100 -400.0000 399.9878 FORMAT "%8.4" ECU_ADDRESS 0x8FEF6A /end MEASUREMENT
/begin MEASUREMENT PCR_rOutPIDLP_mp "PID Ausgang" SWORD Prc 1 100 -400.0000 399.9878 FORMAT "%8.4" ECU_ADDRESS 0x8FEF6C /end MEASUREMENT
/begin MEASUREMENT PCR_rOutPLP_mp "P-Regler Ausgang" SWORD Prc 1 100 -400.0000 399.9878 FORMAT "%8.4" ECU_ADDRESS 0x8FEF6E /end MEASUREMENT
/begin MEASUREMENT PCR_rOutP_mp "P-Anteil des PIDT1 Reglers" SWORD Prc 1 100 -400.0000 399.9878 FORMAT "%8.4" ECU_ADDRESS 0x8FEF48 /end MEASUREMENT
/begin MEASUREMENT PCR_rPICtlRmp_mp "Ausgang des PCR-Reglers durch Rampe" SWORD Prc 1 100 -400.0000 399.9878 FORMAT "%8.4" ECU_ADDRESS 0x8FEF4A /end MEASUREMENT
/begin MEASUREMENT PCR_rPICtl_mp "P+I+Steueranteil der Stellgröße (vor ARW)" SWORD Prc 1 100 -400.0000 399.9878 FORMAT "%8.4" ECU_ADDRESS 0x8FEF4C /end MEASUREMENT
/begin MEASUREMENT PCR_rPIDCtl_mp "Regel- und Steueranteil der Stellgrösse des Ladedruckreglers" SWORD Prc 1 100 -400.0000 399.9878 FORMAT "%8.4" ECU_ADDRESS 0x8FEF56 /end MEASUREMENT
/begin MEASUREMENT PCR_rstI_mp "Integratorzustand in Basisvariante" SWORD Prc 1 100 -400.0000 399.9878 FORMAT "%8.4" ECU_ADDRESS 0x8FEF58 /end MEASUREMENT
/begin MEASUREMENT PCR_rSurgeGvnrHysOff_mp "Anti-Ruckel-Regler untere Schwelle für die Hysterese" SWORD Prc 1 100 -400.0000 399.9878 FORMAT "%8.4" ECU_ADDRESS 0x6F8290 /end MEASUREMENT
/begin MEASUREMENT PCR_rSurgeGvnrOff_mp "untere Schwelle für die Hysterese" SWORD Prc 1 100 -400.0000 399.9878 FORMAT "%8.4" ECU_ADDRESS 0x6F8292 /end MEASUREMENT
/begin MEASUREMENT PCR_rSurgeGvnrOn_mp "obere Schwelle für die Hysterese" SWORD Prc 1 100 -400.0000 399.9878 FORMAT "%8.4" ECU_ADDRESS 0x6F8294 /end MEASUREMENT
/begin MEASUREMENT PCR_rSurgeHysHigh_mp "Higher ATL pressure ratio limit for hysteresis of Anti-Surge LIGov" SWORD Prc 1 100 -400.0000 399.9878 FORMAT "%8.4" ECU_ADDRESS 0x8FEEAA /end MEASUREMENT
/begin MEASUREMENT PCR_rSurgeHysLow_mp "Lower ATL pressure ratio limit for hysteresis of Anti-Surge LIGov" SWORD Prc 1 100 -400.0000 399.9878 FORMAT "%8.4" ECU_ADDRESS 0x8FEEAC /end MEASUREMENT
/begin MEASUREMENT PCR_rSurgeLIGov_mp "ALT Pressure ratio for Anti-Surge LIGov" SWORD Prc 1 100 -400.0000 399.9878 FORMAT "%8.4" ECU_ADDRESS 0x8FEEAE /end MEASUREMENT
/begin MEASUREMENT PCR_stAdPCVLogic_mp "Status zur Freigabe verschiedener Funktionsmodi des Lernalgorithmus (aktiv, nicht aktiv, ruecksetzen, ignorieren)" UBYTE OneToOne 1 100 0.00 255.0 FORMAT "%5.1" ECU_ADDRESS 0x8FEF4E /end MEASUREMENT
/begin MEASUREMENT PCR_stAdPCVRelCond_mp "Status der Bedingungen zur Freigabe des Lernprozesses" UBYTE OneToOne 1 100 0.00 255.0 FORMAT "%5.1" ECU_ADDRESS 0x8FEF4F /end MEASUREMENT
/begin MEASUREMENT PCR_stAdPCV_mp "Bedingungen fuer verschiedene Funktionsmodi des Lernalgorithmus (aktiv, nicht aktiv ruecksetzen, ignorieren)" UWORD OneToOne 1 100 0.00 65535.00 FORMAT "%8.2" ECU_ADDRESS 0x8FEF50 /end MEASUREMENT
/begin MEASUREMENT PCR_stBDesLogic_mp "Status bits based on which raw or ramped unlimited desired boost pressure selection is made." UBYTE OneToOne 1 100 0.00 255.0 FORMAT "%5.1" ECU_ADDRESS 0x8FEEF0 /end MEASUREMENT
/begin MEASUREMENT PCR_stClutch_mp "Bedingungsstatus der betätigten Kupplung" UBYTE OneToOne 1 100 0.00 255.0 FORMAT "%5.1" ECU_ADDRESS 0x8FEF84 /end MEASUREMENT
/begin MEASUREMENT PCR_stCmpEnd_mp "Calculation of the correction factor based on atmospheric factor" UBYTE OneToOne 1 100 0.00 255.0 FORMAT "%5.1" ECU_ADDRESS 0x8FEEF1 /end MEASUREMENT
/begin MEASUREMENT PCR_stCpBVlv_mp "Status des Vorgabewertes bei offener Verdichterbypassklappe" UBYTE OneToOne 1 100 0.00 255.0 FORMAT "%5.1" ECU_ADDRESS 0x8FEF85 /end MEASUREMENT
/begin MEASUREMENT PCR_stEepAdPCV_mp "Status von eeprom schreibt" UBYTE OneToOne 1 100 0.00 255.0 FORMAT "%5.1" ECU_ADDRESS 0x8FEF52 /end MEASUREMENT
/begin MEASUREMENT PCR_stEepBlock_mp "Status des Eeprom-Blockes" SWORD OneToOne 1 100 -32768.00 32767.00 FORMAT "%8.2" ECU_ADDRESS 0x8FEF54 /end MEASUREMENT
/begin MEASUREMENT PCR_stLPClutch_mp "Geschwindigkeitsschwelle für Kupplungssignal überwachung" UBYTE OneToOne 1 100 0.00 255.0 FORMAT "%5.1" ECU_ADDRESS 0x8FEF78 /end MEASUREMENT
/begin MEASUREMENT PCR_stLPMonitor "Schalter: Regler Niederdruckstufe (PCR_LP) ein/aus" UBYTE OneToOne 1 100 0.00 255.0 FORMAT "%5.1" ECU_ADDRESS 0x7F89C0 /end MEASUREMENT
/begin MEASUREMENT PCR_stLPPCR "Status der Ladedruckregelung Niederdruckstufe" UWORD OneToOne 1 100 0.00 65535.00 FORMAT "%8.2" ECU_ADDRESS 0x7F9146 /end MEASUREMENT
/begin MEASUREMENT PCR_stLPRgn_mp "Statuswert für die Bestimmung der Quantität am Regler Ein-Aus" UBYTE OneToOne 1 100 0.00 255.0 FORMAT "%5.1" ECU_ADDRESS 0x8FEF79 /end MEASUREMENT
/begin MEASUREMENT PCR_stLPWorkSph "aktueller Arbeitsbereich" UBYTE OneToOne 1 100 0.00 255.0 FORMAT "%5.1" ECU_ADDRESS 0x7F89C1 /end MEASUREMENT
/begin MEASUREMENT PCR_stMonitor "Statusangabe bei Abschaltung der Regelung" UBYTE OneToOne 1 100 0.00 255.0 FORMAT "%5.1" ECU_ADDRESS 0x7F89C2 /end MEASUREMENT
/begin MEASUREMENT PCR_stPCR "Status der Ladedruckregelung" UWORD OneToOne 1 100 0.00 65535.00 FORMAT "%8.2" ECU_ADDRESS 0x7F9148 /end MEASUREMENT
/begin MEASUREMENT PCR_stPCR_mp "Status der Ladedruckregelung" UWORD OneToOne 1 100 0.00 65535.00 FORMAT "%8.2" ECU_ADDRESS 0x8FEF86 /end MEASUREMENT
/begin MEASUREMENT PCR_stPreSurge "Status der Erkennung für Laderpumpen Zustand 1 (oszillierende Frischluftmasse mit kleiner Amplitude)" UBYTE OneToOne 1 100 0.00 255.0 FORMAT "%5.1" ECU_ADDRESS 0x7F89C3 /end MEASUREMENT
/begin MEASUREMENT PCR_stSurge "Status der Erkennung für Laderpumpen Zustand 2 (oszillierende Frischluftmasse mit großer Amplitude)" UBYTE OneToOne 1 100 0.00 255.0 FORMAT "%5.1" ECU_ADDRESS 0x7F89C4 /end MEASUREMENT
/begin MEASUREMENT PCR_stSurge1_mp "Anti-Surge LIGov status1 without engine speed monitoring" UBYTE OneToOne 1 100 0.00 255.0 FORMAT "%5.1" ECU_ADDRESS 0x8FEEB0 /end MEASUREMENT
/begin MEASUREMENT PCR_stSurgePre1_mp "Pre1 status of  Anti-Surge LIGov" UBYTE OneToOne 1 100 0.00 255.0 FORMAT "%5.1" ECU_ADDRESS 0x8FEEB1 /end MEASUREMENT
/begin MEASUREMENT PCR_stSurgePre2_mp "Pre2 status of  Anti-Surge LIGov" UBYTE OneToOne 1 100 0.00 255.0 FORMAT "%5.1" ECU_ADDRESS 0x8FEEB2 /end MEASUREMENT
/begin MEASUREMENT PCR_stSwtBPGovMaxDyn_mp "Ramp switch position, for dynamic adjustment of maximum allowable PCR governor output" UBYTE OneToOne 1 100 0.00 255.0 FORMAT "%5.1" ECU_ADDRESS 0x6F8280 /end MEASUREMENT
/begin MEASUREMENT PCR_stWorkSph "present working sphere" UBYTE OneToOne 1 100 0.00 255.0 FORMAT "%5.1" ECU_ADDRESS 0x7F89C7 /end MEASUREMENT
/begin MEASUREMENT PCR_swtGvnr "Schalter: Regler ein/aus" UBYTE OneToOne 1 100 0.00 255.0 FORMAT "%5.1" ECU_ADDRESS 0x7F89C9 /end MEASUREMENT
/begin MEASUREMENT PCR_swtLimSel "Schalter zur Auswahl der Größen, aus denen der zulässige Stellgrößenbereich bestimmt wird" UBYTE OneToOne 1 100 0.00 255.0 FORMAT "%5.1" ECU_ADDRESS 0x7F89CB /end MEASUREMENT
/begin MEASUREMENT PCR_swtLPGvnr "Schalter: Regler Niederdruckstufe (PCR_LP) ein/aus" UBYTE OneToOne 1 100 0.00 255.0 FORMAT "%5.1" ECU_ADDRESS 0x7F89CA /end MEASUREMENT
/begin MEASUREMENT PCR_swtLPGvnrV1_mp "Schalterwert für die Hystereseregelung" UBYTE OneToOne 1 100 0.00 255.0 FORMAT "%5.1" ECU_ADDRESS 0x8FEF7A /end MEASUREMENT
/begin MEASUREMENT PCR_swtQntDes "Schalter für Mengeneingangswunsch bei der Sollwertberechnung" UBYTE OneToOne 1 100 0.00 255.0 FORMAT "%5.1" ECU_ADDRESS 0x7F89CE /end MEASUREMENT
/begin MEASUREMENT PCR_swtRelAbs "Schalter zur Auswahl zwischen Absolut- und Relativdruckregelung" UBYTE OneToOne 1 100 0.00 255.0 FORMAT "%5.1" ECU_ADDRESS 0x7F89CF /end MEASUREMENT
/begin MEASUREMENT PCR_swtSurgeGvnr "Zustand einzelnen Statis für AntiSurge-Regler" UBYTE OneToOne 1 100 0.00 255.0 FORMAT "%5.1" ECU_ADDRESS 0x7F89D0 /end MEASUREMENT
/begin MEASUREMENT PCR_swtSurgeGvnrRel_mp "Status von der Freigabebedingungen des Ruckel-Reglers" UBYTE OneToOne 1 100 0.00 255.0 FORMAT "%5.1" ECU_ADDRESS 0x8FEFA8 /end MEASUREMENT
/begin MEASUREMENT PCR_swtSurgeGvnrSel_mp "Zustand einzelnen Statis für AntiSurge-Regler" UBYTE OneToOne 1 100 0.00 255.0 FORMAT "%5.1" ECU_ADDRESS 0x8FEFA9 /end MEASUREMENT
/begin MEASUREMENT PCR_tiGvnrDelOff_mp "Verspätung für Schalter weg des PCR-Reglers" UWORD Time_s 1 100 0.00 655.3500 FORMAT "%8.4" ECU_ADDRESS 0x8FEF88 /end MEASUREMENT
/begin MEASUREMENT PCR_tiStrtDelay_mp "Zeit, in der die Regelung nach Startabwurf abgeschaltet bleibt" UWORD Time_ms 1 100 0.00 655350.0 FORMAT "%8.1" ECU_ADDRESS 0x8FEF8A /end MEASUREMENT
/begin MEASUREMENT PCVCD_dcycDT1_mp "Sollwert Tastverhältnis mit DT1-Anteil" SWORD DtyCyc 1 100 -327.6800 327.6700 FORMAT "%8.4" ECU_ADDRESS 0x8FEFEC /end MEASUREMENT
/begin MEASUREMENT PCVCD_dcycOut_mp "Ausgangstastverhältnis" SWORD DtyCyc 1 100 -327.6800 327.6700 FORMAT "%8.4" ECU_ADDRESS 0x6F8296 /end MEASUREMENT
/begin MEASUREMENT PCVCD_dcycSetVal_mp "Sollwert Tastverhältnis für Druckregelventil" SWORD DtyCyc 1 100 -327.6800 327.6700 FORMAT "%8.4" ECU_ADDRESS 0x8FEFEE /end MEASUREMENT
/begin MEASUREMENT PCVCD_facIGov_mp "Stromregler I-Anteil" SWORD Fact 1 100 -4.000000 3.999878 FORMAT "%8.6" ECU_ADDRESS 0x8FEFF0 /end MEASUREMENT
/begin MEASUREMENT PCVCD_iActFlt_mp "PT1 gefilterter Strom Istwert" SWORD Curr 1 100 -32768.00 32767.00 FORMAT "%8.2" ECU_ADDRESS 0x8FEFF2 /end MEASUREMENT
/begin MEASUREMENT PCVCD_iActVal "Analogeingang Strom-Istwert" SWORD Curr 1 100 -32768.00 32767.00 FORMAT "%8.2" ECU_ADDRESS 0x7F914A /end MEASUREMENT
/begin MEASUREMENT PCVCD_iDvt "Stromregler Regelabweichung" SWORD Curr 1 100 -32768.00 32767.00 FORMAT "%8.2" ECU_ADDRESS 0x7F914C /end MEASUREMENT
/begin MEASUREMENT PCVCD_iGovActVal_mp "Isttrom nach Eingriff des Raildruckreglers" SWORD Curr 1 100 -32768.00 32767.00 FORMAT "%8.2" ECU_ADDRESS 0x8FEFF4 /end MEASUREMENT
/begin MEASUREMENT PCVCD_iSetFlt_mp "PT1 gefilterter Stromistwert" SWORD Curr 1 100 -32768.00 32767.00 FORMAT "%8.2" ECU_ADDRESS 0x8FEFF6 /end MEASUREMENT
/begin MEASUREMENT PCVCD_swtCtlState "geschlossener Regelkreis für Stromregler konstant oder in Abhängigkeit vom Raildruckregler" UBYTE OneToOne 1 100 0.00 255.0 FORMAT "%5.1" ECU_ADDRESS 0x7F89D1 /end MEASUREMENT
/begin MEASUREMENT PCVCD_uRawVal_mp "Analogeingang Spannungsrohwert" SWORD Volt 1 100 -160156.4 160151.5 FORMAT "%8.1" ECU_ADDRESS 0x8FEFF8 /end MEASUREMENT
/begin MEASUREMENT PCV_ctAdapt1_mp "Zähler für die Anzahl der Funktionsaufrufe der PCV-Adaption im Zustand PCV_ADAPT_STABLE" UWORD OneToOne 1 100 0.00 65535.00 FORMAT "%8.2" ECU_ADDRESS 0x8FEFCA /end MEASUREMENT
/begin MEASUREMENT PCV_ctAdapt2_mp "Zähler für die Anzahl der Funktionsaufrufe der PCV-Adaption im Zustand PCV_ADAPT_SUM_UP" UWORD OneToOne 1 100 0.00 65535.00 FORMAT "%8.2" ECU_ADDRESS 0x8FEFCC /end MEASUREMENT
/begin MEASUREMENT PCV_ctAdapt3_mp "Zähler für die erfolgreiche Berechnung der Adaption" ULONG OneToOne 1 100 0.00 4294967295.00 FORMAT "%13.2" ECU_ADDRESS 0x8FEFD0 /end MEASUREMENT
/begin MEASUREMENT PCV_dvolFlow_mp "Eingangswert für das Kennfeld PCV_facAdaptFlow_MAP" SWORD Qp_mm3_sec 1 100 -327680.0 327670.0 FORMAT "%8.1" ECU_ADDRESS 0x8FEFD4 /end MEASUREMENT
/begin MEASUREMENT PCV_dvolLeak_mp "Leckage des Druckregelventils" SWORD Qp_mm3_sec 1 100 -327680.0 327670.0 FORMAT "%8.1" ECU_ADDRESS 0x8FEFE4 /end MEASUREMENT
/begin MEASUREMENT PCV_facAdapt "Adaptionsfaktor für die PCV-Kennlinie" SWORD Fact 1 100 -4.000000 3.999878 FORMAT "%8.6" ECU_ADDRESS 0x7F914E /end MEASUREMENT
/begin MEASUREMENT PCV_facAdaptFlow "Faktor zur Abschätzung des Durchflusses durch das PCV" SWORD Fact 1 100 -4.000000 3.999878 FORMAT "%8.6" ECU_ADDRESS 0x7F9150 /end MEASUREMENT
/begin MEASUREMENT PCV_iSet "Sollstrom fuer das Druckregelventil" SWORD Curr 1 100 -32768.00 32767.00 FORMAT "%8.2" ECU_ADDRESS 0x7F9152 /end MEASUREMENT
/begin MEASUREMENT PCV_iSetClose_mp "Strom zum Schließen des Druckregelventils ohne dieses zu entprellen" SWORD Curr 1 100 -32768.00 32767.00 FORMAT "%8.2" ECU_ADDRESS 0x8FEFE6 /end MEASUREMENT
/begin MEASUREMENT PCV_pAdaptThres_mp "Raildruckschwelle für die Berechnung des Adaptionsfaktors" SWORD Pres_Rail 1 100 -3276.800 3276.700 FORMAT "%5.3" ECU_ADDRESS 0x8FEFD6 /end MEASUREMENT
/begin MEASUREMENT PCV_pPCVSetSum_mp "Aufsummierter Steuerdruck für das PCV für Mittelwertbildung" SLONG Pres_Rail 1 100 -214748364.800 214748364.700 FORMAT "%10.3" ECU_ADDRESS 0x8FEFD8 /end MEASUREMENT
/begin MEASUREMENT PCV_pPeakSum_mp "Aufsummierter Raildruck für Mittelwertbildung" SLONG Pres_Rail 1 100 -214748364.800 214748364.700 FORMAT "%10.3" ECU_ADDRESS 0x8FEFDC /end MEASUREMENT
/begin MEASUREMENT PCV_stActrCtl "Zustand der Stellwertsteuerung fuer das Druckregelventil" UBYTE OneToOne 1 100 0.00 255.0 FORMAT "%5.1" ECU_ADDRESS 0x7F89D2 /end MEASUREMENT
/begin MEASUREMENT PCV_stAdapt "Status des Statusautomaten der Adaptionsfunktion" UBYTE OneToOne 1 100 0.00 255.0 FORMAT "%5.1" ECU_ADDRESS 0x7F89D3 /end MEASUREMENT
/begin MEASUREMENT PCV_stAdaptMeUn "Freigabe-Botschaft für die Zumesseinheit" UBYTE OneToOne 1 100 0.00 255.0 FORMAT "%5.1" ECU_ADDRESS 0x7F89D4 /end MEASUREMENT
/begin MEASUREMENT PCV_stEngStrtMov_mp "Motorbewegung bei der Berechnung des elektrischen Sollstroms für das Druckregelventil" UBYTE OneToOne 1 100 0.00 255.0 FORMAT "%5.1" ECU_ADDRESS 0x8FEFE8 /end MEASUREMENT
/begin MEASUREMENT PCV_stSetClose_mp "Zustandsanforderung zum Schließen des Druckregelventils" UBYTE OneToOne 1 100 0.00 255.0 FORMAT "%5.1" ECU_ADDRESS 0x8FEFE9 /end MEASUREMENT
/begin MEASUREMENT PCV_tiAdaptLst_mp "Zeitpunkt, bei dem die letzte Adaptierung stattgefunden hat" ULONG TimeEngOn 1 100 0.00 4294967295.00 FORMAT "%13.2" ECU_ADDRESS 0x8FEFE0 /end MEASUREMENT
/begin MEASUREMENT PCV_tiSetCloseMax_mp "Verweilzeit im Zustand PCV_stActrCtl == PCV_CLOSE_MODE (0x20)" UWORD Time_ms 1 100 0.00 655350.0 FORMAT "%8.1" ECU_ADDRESS 0x8FEFEA /end MEASUREMENT
/begin MEASUREMENT PFltCD_pLinPreB1 "linearisierter Analogwert, Absolutdrucksensor vor dem Partikelfilter für Bank1" SWORD Pres_hPa 1 100 -32768.00 32767.00 FORMAT "%8.2" ECU_ADDRESS 0x7F9158 /end MEASUREMENT
/begin MEASUREMENT PFltCD_pLinPreB2 "linearisierter Analogwert, Absolutdrucksensor vor dem Partikelfilter für Bank2" SWORD Pres_hPa 1 100 -32768.00 32767.00 FORMAT "%8.2" ECU_ADDRESS 0x7F915A /end MEASUREMENT
/begin MEASUREMENT PFltCD_pPreB1 "Abgasdruck vor Partikelfilter Bank1" SWORD Pres_hPa 1 100 -32768.00 32767.00 FORMAT "%8.2" ECU_ADDRESS 0x7F915C /end MEASUREMENT
/begin MEASUREMENT PFltCD_pPreB1_mp "ungefilterter Pre PFlt-Druck für Bank1" SWORD Pres_hPa 1 100 -32768.00 32767.00 FORMAT "%8.2" ECU_ADDRESS 0x8FF326 /end MEASUREMENT
/begin MEASUREMENT PFltCD_pPreB2 "Abgasdruck vor Partikelfilter Bank2" SWORD Pres_hPa 1 100 -32768.00 32767.00 FORMAT "%8.2" ECU_ADDRESS 0x7F915E /end MEASUREMENT
/begin MEASUREMENT PFltCD_pPreB2_mp "ungefilterter Pre PFlt-Druck für Bank2" SWORD Pres_hPa 1 100 -32768.00 32767.00 FORMAT "%8.2" ECU_ADDRESS 0x8FF328 /end MEASUREMENT
/begin MEASUREMENT PFltCD_pPreDiff "Druckdifferenz zwischen Bank1 und Bank2, der Werte PFltCD_pPreB1/B2" SWORD Pres_hPa 1 100 -32768.00 32767.00 FORMAT "%8.2" ECU_ADDRESS 0x7F9160 /end MEASUREMENT
/begin MEASUREMENT PFltCD_swtSigPPre "Schalterwert ob ADC oder CAN" UBYTE OneToOne 1 100 0.00 255.0 FORMAT "%5.1" ECU_ADDRESS 0x7F89D5 /end MEASUREMENT
/begin MEASUREMENT PFltCD_tLinPreB1 "linearisierter Wert der Temperatur vor dem Partikelfilter erster Sensor" SWORD Temp_Cels 1 100 -50.140 899.860 FORMAT "%8.3" ECU_ADDRESS 0x7F9162 /end MEASUREMENT
/begin MEASUREMENT PFltCD_tLinPreB2 "linearisierter Wert der Temperatur vor dem Partikelfilter zweiter Sensor" SWORD Temp_Cels 1 100 -50.140 899.860 FORMAT "%8.3" ECU_ADDRESS 0x7F9164 /end MEASUREMENT
/begin MEASUREMENT PFltCD_tPreB1 "Abgastemp. vor Partikelfilter erster Sensor für Bank1" SWORD Temp_Cels 1 100 -50.140 899.860 FORMAT "%8.3" ECU_ADDRESS 0x7F9166 /end MEASUREMENT
/begin MEASUREMENT PFltCD_tPreB2 "Abgastemp. vor Partikelfilter erster Sensor für Bank2" SWORD Temp_Cels 1 100 -50.140 899.860 FORMAT "%8.3" ECU_ADDRESS 0x7F9168 /end MEASUREMENT
/begin MEASUREMENT PFltCD_uRawPresPreB1 "Rohwert des Abgasdruckes vor dem Partikelfilter für Bank1" SWORD Volt 1 100 -160156.4 160151.5 FORMAT "%8.1" ECU_ADDRESS 0x7F9170 /end MEASUREMENT
/begin MEASUREMENT PFltCD_uRawPresPreB2 "Rohwert des Abgasdruckes vor dem Partikelfilter für Bank2" SWORD Volt 1 100 -160156.4 160151.5 FORMAT "%8.1" ECU_ADDRESS 0x7F9172 /end MEASUREMENT
/begin MEASUREMENT PFltCD_uRawPresPreBnk_mp "Meßpunkt zur Anpassung des Eingangs zur Linearisierungskennlinie" SWORD Volt 1 100 -160156.4 160151.5 FORMAT "%8.1" ECU_ADDRESS 0x8FF32A /end MEASUREMENT
/begin MEASUREMENT PFltCD_uRawTempPreB1 "Spannungsrohwert der Abgastemperatur vor dem Partikelfilter für Bank1" SWORD Volt 1 100 0.00 5000.000 FORMAT "%8.3" ECU_ADDRESS 0x7F9174 /end MEASUREMENT
/begin MEASUREMENT PFltCD_uRawTempPreB2 "Spannungsrohwert der Abgastemperatur vor dem Partikelfilter für Bank2" SWORD Volt 1 100 0.00 5000.000 FORMAT "%8.3" ECU_ADDRESS 0x7F9176 /end MEASUREMENT
/begin MEASUREMENT PFltCD_uRawTempPreBnk_mp "Meßpunkt zur Anpassung des Eingangs zur Linearisierungskennlinie" SWORD Volt 1 100 -160156.4 160151.5 FORMAT "%8.1" ECU_ADDRESS 0x8FF32C /end MEASUREMENT
/begin FUNCTION pcr_ctlvalcalc_var_uic ""
 /begin OUT_MEASUREMENT PCR_dnAvrgNeg_mp PCR_dnSurgeHigh_mp PCR_dnSurgeLow_mp PCR_qSurgeHigh_mp PCR_qSurgeLow_mp PCR_rSurgeHysHigh_mp PCR_rSurgeHysLow_mp PCR_rSurgeLIGov_mp PCR_stSurge1_mp PCR_stSurgePre1_mp PCR_stSurgePre2_mp /end OUT_MEASUREMENT
/end FUNCTION
/begin FUNCTION pcr_desvalcalc "Ladedruck Sollwertbildung"
 /begin DEF_CHARACTERISTIC PCR_tiDT1DesCld_C PCR_DKdDesCld_C PCR_DKdPosDesCld_C PCR_DKdNegDesCld_C PCR_dpDWinPosDesCld_C PCR_dpDWinNegDesCld_C PCR_dpBDes_C PCR_dpSlpLimDwn_C PCR_dpSlpLimUp_C PCR_dqDes_C PCR_drAPP1UnFlt_C PCR_tiBDesRaw_C PCR_dpBDesRaw_C PCR_tiDT1qDes_C PCR_DKdqDes_C PCR_tiDT1rAPP1_C PCR_DKdrAPP1_C PCR_facATRgn_CUR PCR_facCtQ_MAP PCR_facIAT_CUR PCR_facN_CUR PCR_nLimMax_C PCR_nLimMin_C PCR_pAPQCmpnRgn_MAP PCR_pAPQCmpn_MAP PCR_pBDesBasFDC_MAP PCR_pBDesBasRgn1_MAP PCR_pBDesBasRgn2_MAP PCR_pDesBas_MAP PCR_pDesMaxAP_MAP PCR_pDesMax_C PCR_pDesMin_C PCR_pNQCtCmpn_MAP PCR_stRgnMsk1_C PCR_stRgnMsk2_C PCR_swtActSlpLim_C PCR_swtQntDesVal_C PCR_swtQntDesType_C PCR_swtSlpLimInputType_C PCR_tClntThres_C PCR_tiBDesSlpLim_C PCR_tiRmpMswt_C PCR_tiDT1DesWrm_C PCR_DKdDesWrm_C PCR_DKdPosDesWrm_C PCR_DKdNegDesWrm_C PCR_dpDWinPosDesWrm_C PCR_dpDWinNegDesWrm_C /end DEF_CHARACTERISTIC
 /begin IN_MEASUREMENT APSCD_pVal CTSCD_tClnt Eng_nAvrg IATSCD_tAir PCR_qDes /end IN_MEASUREMENT
/end FUNCTION
/begin FUNCTION pcr_desvalcalc_msg "" /begin OUT_MEASUREMENT PCR_pDesVal PCR_qDes PCR_swtQntDes /end OUT_MEASUREMENT /end FUNCTION
/begin FUNCTION pcr_desvalcalc_uic ""
 /begin DEF_CHARACTERISTIC PCR_pDesAdd_Vector PCR_pDesAdd_Channel PCR_pDes_Vector PCR_pDes_Channel /end DEF_CHARACTERISTIC
 /begin OUT_MEASUREMENT PCR_bpMap_mp PCR_dpBDesRaw_mp PCR_dqDes_mp PCR_drAPP1UnFlt_mp PCR_facATRgn_mp PCR_facAT_mp PCR_facCtQ_mp PCR_facN_mp PCR_pAPQCmpnRgn_mp PCR_pAPQCmpn_mp PCR_pBasMAP_mp PCR_pBDesAPCorrRgn1_mp PCR_pBDesAPCorrRgn2_mp PCR_pBDesAPCorr_mp PCR_pBDesATCorrRgn1_mp PCR_pBDesATCorrRgn2_mp PCR_pBDesATCorr_mp PCR_pBDesCtCorr_mp PCR_pBDesDyn_mp PCR_pBDesMaxAP_mp PCR_pBDesNCorr_mp PCR_pBDesRaw2_mp PCR_pBDesRaw3_mp PCR_pBDesRaw_mp PCR_pBDesStat_mp PCR_pBDes_mp PCR_pDesByp_mp PCR_pNQCtCmpn_mp PCR_pRgnMAP1_mp PCR_pRgnMAP2_mp PCR_qDesFrmMngTrqInr_mp PCR_stBDesLogic_mp PCR_stCmpEnd_mp /end OUT_MEASUREMENT
/end FUNCTION
/begin FUNCTION pcr_governor "Adaptiver Ladedruckregler"
 /begin DEF_CHARACTERISTIC PCR_I1AdPCVKi_C PCR_I1AdPCVKiPos_C PCR_I1AdPCVKiNeg_C PCR_rI1AdPCVWinPos_C PCR_rI1AdPCVWinNeg_C PCR_I2AdPCVKi_C PCR_I2AdPCVKiPos_C PCR_I2AdPCVKiNeg_C PCR_rI2AdPCVWinPos_C PCR_rI2AdPCVWinNeg_C PCR_I3AdPCVKi_C PCR_I3AdPCVKiPos_C PCR_I3AdPCVKiNeg_C PCR_rI3AdPCVWinPos_C PCR_rI3AdPCVWinNeg_C PCR_I4AdPCVKi_C PCR_I4AdPCVKiPos_C PCR_I4AdPCVKiNeg_C PCR_rI4AdPCVWinPos_C PCR_rI4AdPCVWinNeg_C PCR_dlyPT1_C PCR_dnAvrgAdPCVLim_C PCR_tiDnCorrDT1_C PCR_DnCorrDKd_C PCR_tiDpCorrDT1_C PCR_dpCorrDKd_C PCR_dqCtlAdPCVLim_C PCR_tiAdPCVqCtlDT1_C PCR_DKdAdPCVqCtlDT1_C PCR_drAdPCVCtlRmpUp_C PCR_drAdPCVCtlRmpDwn_C PCR_drBPGovMaxDynUp_C PCR_drBPGovMaxDynDn_C PCR_drPIRmpUp_C PCR_drPIRmpDwn_C PCR_DT1_C PCR_DKd_C PCR_DKdPos_C PCR_DKdNeg_C PCR_pDWinPos_C PCR_pDWinNeg_C PCR_facBPGovMaxCorr_CUR PCR_facDnCorr_CUR PCR_facDpCorr_CUR PCR_facD_MAP PCR_facI_MAP PCR_facP_MAP PCR_facresFlowRawCorr_MAP PCR_IKi_C PCR_IKiPos_C PCR_IKiNeg_C PCR_pIWinPos_C PCR_pIWinNeg_C PCR_mskNoAdPCVVal_C PCR_mskResetVal_C PCR_mskStopLearning_C PCR_nAvrgAdPCV1_C PCR_nAvrgAdPCV2_C PCR_nPCVMax_C PCR_nPCVMin_C PCR_pBGDevAdPCVLim_C PCR_pFltValLim_C PCR_pValAdPCVMax_C PCR_pValAdPCVMin_C PCR_PKp_C PCR_PKpPos_C PCR_PKpNeg_C PCR_pPWinPos_C PCR_pPWinNeg_C PCR_qCtlAdPCV1_C PCR_qCtlAdPCV2_C PCR_qPCVMax_C PCR_qPCVMin_C PCR_rAdPCVCtlValMax_C PCR_rAdPCVCtlValMin_C PCR_rBPGovMaxCorr_MAP PCR_rBPGovMaxDynCorr_MAP PCR_rBPGovMaxDynEnd_C PCR_rBPGovMaxDynStrt_C PCR_rBPGovMaxDyn_MAP PCR_rDistAdPCV1_C PCR_rDistAdPCV2_C PCR_rDistAdPCV3_C PCR_rDistAdPCV4_C PCR_rGvnrMax_CUR PCR_rGvnrMax_MAP PCR_rGvnrMin_CUR PCR_rGvnrMin_MAP PCR_rOutIMax_MAP PCR_rOutIMin_MAP PCR_stAdPCVReset_C PCR_swtAdPCVrLim_C PCR_swtIDevType_C PCR_swtLimMpCrVal_C PCR_swtLimMpCrType_C PCR_swtLimSelVal_C PCR_swtLimSelType_C PCR_swtRawCur_C PCR_swtRelAbsVal_C PCR_swtRelAbsType_C PCR_tAirAdPCVMax_C PCR_tAirAdPCVMin_C PCR_tClntAdPCVLim_C PCR_tiHiLoAdPCVRelCond0_C PCR_tiLoHiAdPCVRelCond0_C PCR_tiHiLoAdPCVRelCond3_C PCR_tiLoHiAdPCVRelCond3_C /end DEF_CHARACTERISTIC
 /begin IN_MEASUREMENT APSCD_pVal BPSCD_dFltValDT1 CoEng_dvolFlConsum Eng_nAvrg InjCtl_qCurr PCR_dn_mp PCR_dpBGDev_mp PCR_qReal PFlt_resFlowRaw /end IN_MEASUREMENT
/end FUNCTION
/begin FUNCTION pcr_governor_msg ""
 /begin OUT_MEASUREMENT PCR_dqCtlA PCR_pBGDev PCR_qReal PCR_rAdPCVCtlValLim PCR_rBPGovMax PCR_rBPGovMin PCR_rBPLim PCR_rGvnr PCR_rGvnr2 PCR_swtLimSel PCR_swtRelAbs /end OUT_MEASUREMENT
/end FUNCTION
/begin FUNCTION pcr_governor_uic ""
 /begin OUT_MEASUREMENT PCR_DKd_mp PCR_dn_mp PCR_dpBGDev_mp PCR_facAdPCVc1_mp PCR_facAdPCVc2_mp PCR_facAdPCVc3_mp PCR_facAdPCVc4_mp PCR_facAdPCVrx_mp PCR_facAdPCVry_mp PCR_facD1_mp PCR_facDnCorr_mp PCR_facDpCorr_mp PCR_facD_mp PCR_facI_mp PCR_facP_mp PCR_facresFlowRawCorr_mp PCR_pBDesFlt_mp PCR_pBGDev2_mp PCR_pBGDevI_mp PCR_rAdPCVCtlVal_mp PCR_rAdPCVI1_mp PCR_rAdPCVI2_mp PCR_rAdPCVI3_mp PCR_rAdPCVI4_mp PCR_rBPGovMaxDynRamp_mp PCR_rBPGovMaxDyn_mp PCR_rBPGovMaxVal1_mp PCR_rBPGovMaxVal2_mp PCR_rBPGovMax_mp PCR_rBPGovMin_mp PCR_rBPGvnrUnLim1_mp PCR_rBPGvnrUnLim2_mp PCR_rBPLim_mp PCR_rGovMaxCorr_mp PCR_rInitI1AdPCV_mp PCR_rInitI2AdPCV_mp PCR_rInitI3AdPCV_mp PCR_rInitI4AdPCV_mp PCR_rOutAdPCVI1_mp PCR_rOutAdPCVI2_mp PCR_rOutAdPCVI3_mp PCR_rOutAdPCVI4_mp PCR_rOutDT1_mp PCR_rOutILim_mp PCR_rOutIMax_mp PCR_rOutIMin_mp PCR_rOutI_mp PCR_rOutP_mp PCR_rPICtlRmp_mp PCR_rPICtl_mp PCR_stAdPCVLogic_mp PCR_stAdPCVRelCond_mp PCR_stAdPCV_mp PCR_stEepAdPCV_mp PCR_stEepBlock_mp PCR_stSwtBPGovMaxDyn_mp /end OUT_MEASUREMENT
/end FUNCTION
/begin FUNCTION pcr_governor_var "" /begin DEF_CHARACTERISTIC PCR_rARWIMin_C PCR_swtARWMode_C /end DEF_CHARACTERISTIC /end FUNCTION
/begin FUNCTION pcr_governor_var_msg "" /end FUNCTION
/begin FUNCTION pcr_governor_var_uic "" /begin OUT_MEASUREMENT PCR_rPIDCtl_mp PCR_rstI_mp /end OUT_MEASUREMENT /end FUNCTION
/begin FUNCTION pcr_lpgovernor ""
 /begin DEF_CHARACTERISTIC PCR_drBPALPRmpUp_C PCR_drBPALPRmpDwn_C PCR_tiDT1LP_C PCR_DKdLP_C PCR_DKdPosLP_C PCR_DKdNegLP_C PCR_pDWinPosLP_C PCR_pDWinNegLP_C PCR_IKiLP_C PCR_IKiPosLP_C PCR_IKiNegLP_C PCR_pIWinPosLP_C PCR_pIWinNegLP_C PCR_pBDesLPRgn1_MAP PCR_pBDesLPRgn2_MAP PCR_pBDesLP_MAP PCR_pBDesMaxAPLP_MAP PCR_PKpLP_C PCR_PKpPosLP_C PCR_PKpNegLP_C PCR_pPWinPosLP_C PCR_pPWinNegLP_C PCR_rBPBasLPRgn1_MAP PCR_rBPBasLPRgn2_MAP PCR_rBPBasLP_MAP PCR_rBPRglBasLPRgn1_MAP PCR_rBPRglBasLPRgn2_MAP PCR_rBPRglBasLP_MAP PCR_rDt1InitLP_C PCR_rGovMaxLP_C PCR_rGovMinLP_C PCR_rIInitLP_C PCR_rMaxLP_C PCR_rMinLP_C PCR_rOutIMaxLP_MAP PCR_stRgnMskLP1_C PCR_stRgnMskLP2_C PCR_tiRmpSlp_C /end DEF_CHARACTERISTIC
 /begin IN_MEASUREMENT APSCD_pVal BPSCD_dFltValDT1 Eng_nAvrg PCR_qDes /end IN_MEASUREMENT
/end FUNCTION
/begin FUNCTION pcr_lpgovernor_msg "" /begin OUT_MEASUREMENT PCR_pBGDvtLP PCR_rGvnrLP /end OUT_MEASUREMENT /end FUNCTION
/begin FUNCTION pcr_lpgovernor_uic ""
 /begin OUT_MEASUREMENT PCR_pBDesLPUnLim_mp PCR_pBDesLP_mp PCR_rBPBasLP_mp PCR_rBPRglBasLP_mp PCR_rOutDLP_mp PCR_rOutILimLP_mp PCR_rOutILP_mp PCR_rOutIMaxLP_mp PCR_rOutLimLP_mp PCR_rOutLP_mp PCR_rOutPIDLP_mp PCR_rOutPLP_mp /end OUT_MEASUREMENT
/end FUNCTION
/begin FUNCTION pcr_lpmonitor "PCR Monitoring  at Low Pressure"
 /begin DEF_CHARACTERISTIC PCR_DebLPDvtNegDef_C PCR_DebLPDvtNegOk_C PCR_DebLPDvtPosDef_C PCR_DebLPDvtPosOk_C PCR_nLPWrkSph2_C PCR_nLPWrkSph3_C PCR_pLPDvtMaxOffset_C PCR_pLPDvtMax_MAP PCR_pLPDvtMinOffset_C PCR_pLPDvtMin_MAP PCR_qLPClutchThres_CUR PCR_qLPGvnrOffRgn_CUR PCR_qLPGvnrOff_CUR PCR_qLPGvnrOnRgn_CUR PCR_qLPGvnrOn_CUR PCR_qLPWrkSph2_C PCR_qLPWrkSph3_C PCR_rLPDflVal09_C PCR_rLPDflVal12_C PCR_rLPDflVal18_C PCR_stLPMonCur_C PCR_swtLPV8_C PCR_tiLPClutchDebHighLow_C PCR_tiLPClutchDebLowHigh_C PCR_vLPClutch_C /end DEF_CHARACTERISTIC
 /begin IN_MEASUREMENT Eng_nAvrg InjCtl_qCurr /end IN_MEASUREMENT
/end FUNCTION
/begin FUNCTION pcr_lpmonitor_msg ""
 /begin OUT_MEASUREMENT PCR_rBPALP PCR_rBPALP2 PCR_stLPMonitor PCR_stLPPCR PCR_stLPWorkSph PCR_swtLPGvnr /end OUT_MEASUREMENT
/end FUNCTION
/begin FUNCTION pcr_lpmonitor_uic ""
 /begin OUT_MEASUREMENT PCR_pLPDvtMaxRaw_mp PCR_pLPDvtMax_mp PCR_pLPDvtMinRaw_mp PCR_pLPDvtMin_mp PCR_qLPGvnrOff_mp PCR_qLPGvnrOn_mp PCR_stLPClutch_mp PCR_stLPRgn_mp PCR_swtLPGvnrV1_mp /end OUT_MEASUREMENT
/end FUNCTION
/begin FUNCTION pcr_monitor "Ladedruckregelung - Überwachung und Abschaltung"
 /begin DEF_CHARACTERISTIC PCR_DebSRCHighDef_C PCR_DebSRCHighOk_C PCR_DebSRCLowDef_C PCR_DebSRCLowOk_C PCR_nCoStart_C PCR_nCoStrtHigh_C PCR_nWrkSph1_C PCR_nWrkSph2_C PCR_nWrkSph3_C PCR_pBGDevMaxOffset_C PCR_pBGDevMax_MAP PCR_pBGDevMinOffset_C PCR_pBGDevMin_MAP PCR_qClutchThres_C PCR_qClutchThres_CUR PCR_qRgtOffRgn_CUR PCR_qRgtOff_CUR PCR_qRgtOnRgn_CUR PCR_qRgtOn_CUR PCR_qWrkSph2_C PCR_qWrkSph3_C PCR_rCBOpn_C PCR_rDflVal04_C PCR_rDflVal05_C PCR_rDflVal06_C PCR_rDflVal12_C PCR_rDflVal15_MAP PCR_rDflVal18Rgn_MAP PCR_rDflVal18_C PCR_rDflVal24_C PCR_stClutchRgnMsk_C PCR_stCmpntActv_C PCR_stInhGvnrDvt_C PCR_stMonCur_C PCR_swtV8_C PCR_tiClutchDebHighLow_C PCR_tiClutchDebLowHigh_C PCR_tiCoStrt_CUR PCR_tiGvnrDelOff_CUR PCR_tiStrtDelayInit_C PCR_vClutch_C /end DEF_CHARACTERISTIC
 /begin IN_MEASUREMENT CTSCD_tClnt Eng_nAvrg InjCtl_qCurr PCR_qReal /end IN_MEASUREMENT
/end FUNCTION
/begin FUNCTION pcr_monitor_msg ""
 /begin OUT_MEASUREMENT PCR_rBPA PCR_rBPA2 PCR_stMonitor PCR_stPCR PCR_stWorkSph PCR_swtGvnr /end OUT_MEASUREMENT
/end FUNCTION
/begin FUNCTION pcr_monitor_uic ""
 /begin DEF_CHARACTERISTIC PCR_rBPACDAdd_Vector PCR_rBPACDAdd_Channel PCR_rBPACD_Vector PCR_rBPACD_Channel /end DEF_CHARACTERISTIC
 /begin OUT_MEASUREMENT PCR_pBGDevMaxRaw_mp PCR_pBGDevMax_mp PCR_pBGDevMinRaw_mp PCR_pBGDevMin_mp PCR_rBPACDByp_mp PCR_rDflVal18_mp PCR_stClutch_mp PCR_stCpBVlv_mp PCR_stPCR_mp PCR_tiGvnrDelOff_mp PCR_tiStrtDelay_mp /end OUT_MEASUREMENT
/end FUNCTION
/begin FUNCTION pcr_monitor_var "" /end FUNCTION
/begin FUNCTION pcr_monitor_var_msg "" /end FUNCTION
/begin FUNCTION pcr_monitor_var_uic "" /end FUNCTION
/begin FUNCTION pcr_surgectl "LDR-AntiSurge Regler"
 /begin DEF_CHARACTERISTIC PCR_dnSurgeCtlRel_C PCR_dpSurgeCtlRmpUp_C PCR_dpSurgeCtlRmpDwn_C PCR_dqSurgeCtlRel_C PCR_drSurgeCtlRmpUp_C PCR_drSurgeCtlRmpDwn_C PCR_facSurgeDes_MAP PCR_facSurgeI_MAP PCR_facSurgeP_MAP PCR_tiSurgeCtlQDT1_C PCR_DKdSurgeCtlQDT1_C PCR_ISurgeKi_C PCR_ISurgeKiPos_C PCR_ISurgeKiNeg_C PCR_facSurgeIWinPos_C PCR_facSurgeIWinNeg_C PCR_pBSurgeCtlVal_MAP PCR_pBSurgeDesMax_MAP PCR_pBSurgeDesMin_MAP PCR_pBSurgeDes_CUR PCR_pDvtSurgeCtlRel_C PCR_pSurgeARWIMin_C PCR_PSurgeKp_C PCR_PSurgeKpPos_C PCR_PSurgeKpNeg_C PCR_facSurgePWinPos_C PCR_facSurgePWinNeg_C PCR_rSurgeGvnrOff_CUR PCR_rSurgeGvnrOn_MAP PCR_rSurgeGvnr_MAP PCR_tiSurgeGvnrPT1_C PCR_swtSurgeARWMode_C PCR_swtSurgeGvnrSel_C PCR_tiSurgeCtlHiLoRel3_C PCR_tiSurgeCtlLoHiRel3_C PCR_tiSurgeCtlHiLoRelAll_C PCR_tiSurgeCtlLoHiRelAll_C /end DEF_CHARACTERISTIC
 /begin IN_MEASUREMENT APSCD_pLinVal Eng_nAvrg PCR_pBSurgePICtlLim_mp /end IN_MEASUREMENT
/end FUNCTION
/begin FUNCTION pcr_surgectl_msg "" /begin OUT_MEASUREMENT PCR_pBSurgeDes PCR_rGvnrSurge PCR_swtSurgeGvnr /end OUT_MEASUREMENT /end FUNCTION
/begin FUNCTION pcr_surgectl_uic ""
 /begin OUT_MEASUREMENT PCR_dqInjCtlQRaw_mp PCR_facSGDevI_mp PCR_facSurgeDes_mp PCR_facSurgeGvnrDev_mp PCR_facSurgeI_mp PCR_facSurgeP_mp PCR_pBSurgeCtlVal_mp PCR_pBSurgeDesMax_mp PCR_pBSurgeDesMin_mp PCR_pBSurgeDesRaw_mp PCR_pBSurgePICtlLim_mp PCR_pBSurgePICtl_mp PCR_pSOutI_mp PCR_pSOutP_mp PCR_pSurgestI_mp PCR_rGvnrSurgeRaw_mp PCR_rSurgeGvnrHysOff_mp PCR_rSurgeGvnrOff_mp PCR_rSurgeGvnrOn_mp PCR_swtSurgeGvnrRel_mp PCR_swtSurgeGvnrSel_mp /end OUT_MEASUREMENT
/end FUNCTION
/begin FUNCTION pcr_surgedet "Turboladerpumpgrenzerkennung"
 /begin DEF_CHARACTERISTIC PCR_ctAirPerTimeFrq_C PCR_facAirPerTimeAmplMax_C PCR_facAirPerTimeAmplMin_C PCR_facCnv_CUR PCR_facSin_CUR PCR_facSqr_CUR PCR_tiDebPreSurgeDetLoHi_C PCR_tiDebPreSurgeDetHiLo_C PCR_tiDebSurge1_C PCR_tiDebSurge2_C PCR_tiSurgeDetMDT12_C PCR_DKdSurgeDetMDT12_C PCR_tiSurgeDetMDT1_C PCR_DKdSurgeDetMDT1_C PCR_swtAirPerTimeDet_C PCR_swtFacCnv_C PCR_tiAirPerTimeAmplFlt_C PCR_tiAirPTCtlFlt1_C PCR_tiAirPTCtlFlt2_C PCR_tiAirPTCtlFlt3_C /end DEF_CHARACTERISTIC
 /begin IN_MEASUREMENT PCR_facAirPerTimeAmplFlt_mp PCR_facSinIn_mp PCR_facSqrIn_mp /end IN_MEASUREMENT
/end FUNCTION
/begin FUNCTION pcr_surgedet_msg "" /begin OUT_MEASUREMENT PCR_facAirPerTimeAmplFlt PCR_stPreSurge PCR_stSurge /end OUT_MEASUREMENT /end FUNCTION
/begin FUNCTION pcr_surgedet_uic ""
 /begin OUT_MEASUREMENT PCR_facAirAmplFlt_mp PCR_facAirDTAbsAmpl2_mp PCR_facAirDTAmpl12_mp PCR_facAirPerTimeAmplFlt_mp PCR_facAirPerTimeAmpl_mp PCR_facAirPTAmpl12_mp PCR_facAirPTAmpl1_mp PCR_facAirPTAmpl2Flt_mp PCR_facAirPTAmpl2_mp PCR_facCosCoeffDFT_mp PCR_facSinCoeffDFT_mp PCR_facSinIn_mp PCR_facSinOut_mp PCR_facSqrIn_mp /end OUT_MEASUREMENT
/end FUNCTION
/begin FUNCTION pcvcd_co "Druckregelventil Komponententreiber"
 /begin DEF_CHARACTERISTIC PCVCD_uSRCMin_C PCVCD_uSRCMax_C PCVCD_iLin_CUR PCVCD_ctPwrStgOnMax_C PCVCD_dcycMax_C PCVCD_dcycMin_C PCVCD_dcycSetValLin_CUR PCVCD_DebExcTempDef_C PCVCD_DebExcTempOk_C PCVCD_DebNoLoadDef_C PCVCD_DebNoLoadOk_C PCVCD_DebShortCircBatDef_C PCVCD_DebShortCircBatOk_C PCVCD_DebShortCircGndDef_C PCVCD_DebShortCircGndOk_C PCVCD_DebSRCHighDef_C PCVCD_DebSRCHighOk_C PCVCD_DebSRCLowDef_C PCVCD_DebSRCLowOk_C PCVCD_facIGovInit_CUR PCVCD_facIGovMax_C PCVCD_facIGovMin_C PCVCD_tiFlt1PT1_C PCVCD_tiFlt2PT1_C PCVCD_tiIGovDT1_C PCVCD_IGovDKd_C PCVCD_IGovIKi_C PCVCD_IGovIKiPos_C PCVCD_IGovIKiNeg_C PCVCD_iIGovIWinPos_C PCVCD_iIGovIWinNeg_C PCVCD_tiFltPT1Init_C PCVCD_numAdc_C PCVCD_numDia1_C PCVCD_numDia2_C PCVCD_numPwmOut_C PCVCD_stInvOut_C PCVCD_tiPer_C PCVCD_resCoil_C PCVCD_stPwrStgDia_C PCVCD_stSPICtl_C PCVCD_swtCtlStateVal_C PCVCD_swtCtlStateType_C PCVCD_swt_C PCVCD_tiBtwTst_C PCVCD_tiIGovInit_C PCVCD_tiPwrStgOn_C PCVCD_tiDebSigDefSigTst_C PCVCD_tiDebSigOkSigTst_C /end DEF_CHARACTERISTIC
 /begin IN_MEASUREMENT FlSys_t PCVCD_dcycSetVal_mp PCVCD_uRawVal_mp /end IN_MEASUREMENT
/end FUNCTION
/begin FUNCTION pcvcd_co_msg "" /begin OUT_MEASUREMENT PCVCD_iActVal PCVCD_iDvt PCVCD_swtCtlState /end OUT_MEASUREMENT /end FUNCTION
/begin FUNCTION pcvcd_co_uic ""
 /begin OUT_MEASUREMENT PCVCD_dcycDT1_mp PCVCD_dcycOut_mp PCVCD_dcycSetVal_mp PCVCD_facIGov_mp PCVCD_iActFlt_mp PCVCD_iGovActVal_mp PCVCD_iSetFlt_mp PCVCD_uRawVal_mp /end OUT_MEASUREMENT
/end FUNCTION
/begin FUNCTION pcv_adapt "Berechnung des adaptiven Faktors für das Druckregelventil"
 /begin DEF_CHARACTERISTIC PCV_dvolUpLim_CUR PCV_facAdaptDiffI_C PCV_facAdaptDiff_C PCV_facAdaptFlowMin_C PCV_facAdaptFlow_MAP PCV_facAdaptMax_C PCV_facAdaptMin_C PCV_facAdaptWgh_C PCV_numAdaptSum_C PCV_numAdaptThres_C PCV_numAdapt_C PCV_pAdaptThresDec_C PCV_pAdaptThresMax_C PCV_pAdaptThresMin_C PCV_pAdaptThres_C PCV_swtAdaptCPC_C PCV_swtAdaptFlow_C PCV_swtAdaptRst_C PCV_swtAdapt_C PCV_tFuelAdaptMax_C PCV_tFuelAdaptMin_C PCV_tiAdaptMax_C PCV_tSwtMeUn_C /end DEF_CHARACTERISTIC
 /begin IN_MEASUREMENT Eng_nAvrg PCV_dvolFlow_mp RailCD_pPeak /end IN_MEASUREMENT
/end FUNCTION
/begin FUNCTION pcv_adapt_msg "" /begin OUT_MEASUREMENT PCV_facAdapt PCV_facAdaptFlow PCV_stAdapt PCV_stAdaptMeUn /end OUT_MEASUREMENT /end FUNCTION
/begin FUNCTION pcv_adapt_uic ""
 /begin OUT_MEASUREMENT PCV_ctAdapt1_mp PCV_ctAdapt2_mp PCV_ctAdapt3_mp PCV_dvolFlow_mp PCV_pAdaptThres_mp PCV_pPCVSetSum_mp PCV_pPeakSum_mp PCV_tiAdaptLst_mp /end OUT_MEASUREMENT
/end FUNCTION
/begin FUNCTION pcv_leak "Leckage des Druckregelventils" /begin DEF_CHARACTERISTIC PCV_dvolLeak_CUR /end DEF_CHARACTERISTIC /begin IN_MEASUREMENT Rail_pSetPoint /end IN_MEASUREMENT /end FUNCTION
/begin FUNCTION pcv_leak_uic "" /begin OUT_MEASUREMENT PCV_dvolLeak_mp /end OUT_MEASUREMENT /end FUNCTION
/begin FUNCTION pcv_msg "" /end FUNCTION
/begin FUNCTION pcv_setcurr "Berechnung elektrischer Sollstrom für das Druckregelventil"
 /begin DEF_CHARACTERISTIC PCV_iCnvPress_CUR PCV_iSetClose_CUR PCV_iSetMaxBattHi_C PCV_iSetMax_C PCV_iSetMin_C PCV_nSetClose_C PCV_swtClose_C PCV_tiDurClose_C PCV_tiSetCloseMax_C PCV_tiWaitClose_C PCV_uBattHi_C PCV_uBattLo_C /end DEF_CHARACTERISTIC
 /begin IN_MEASUREMENT CTSCD_tClnt Rail_pPCVSet /end IN_MEASUREMENT
/end FUNCTION
/begin FUNCTION pcv_setcurr_msg "" /begin OUT_MEASUREMENT PCV_iSet PCV_stActrCtl /end OUT_MEASUREMENT /end FUNCTION
/begin FUNCTION pcv_setcurr_uic "" /begin DEF_CHARACTERISTIC PCV_iSet_Vector PCV_iSet_Channel /end DEF_CHARACTERISTIC
 /begin OUT_MEASUREMENT PCV_iSetClose_mp PCV_stEngStrtMov_mp PCV_stSetClose_mp PCV_tiSetCloseMax_mp /end OUT_MEASUREMENT
/end FUNCTION
/begin FUNCTION pfltcd_getppre "Absolutdruck vor dem Partikelfilter"
 /begin DEF_CHARACTERISTIC PFltCD_uSRCMinPPreB1_C PFltCD_uSRCMaxPPreB1_C PFltCD_pLinPreB1_CUR PFltCD_uSRCMinPPreB2_C PFltCD_uSRCMaxPPreB2_C PFltCD_pLinPreB2_CUR PFltCD_DebSigPPreDef_C PFltCD_DebSigPPreOk_C PFltCD_DebSRCHighPPreDef_C PFltCD_DebSRCHighPPreOk_C PFltCD_DebSRCLowPPreDef_C PFltCD_DebSRCLowPPreOk_C PFltCD_dtRmpSlpUpPPre_C PFltCD_dtRmpSlpDwnPPre_C PFLTCD_numAdc2B1_C PFLTCD_numAdc2B2_C PFltCD_pPreCor_CUR PFltCD_tiPPrePT1B1_C PFltCD_tiPPrePT1B2_C PFltCD_swtSigPPre_C PFltCD_stSensIDWordPPre_C PFltCD_pDflPre_C /end DEF_CHARACTERISTIC
 /begin IN_MEASUREMENT PFltCD_uRawPresPreBnk_mp PFlt_dvol /end IN_MEASUREMENT
/end FUNCTION
/begin FUNCTION pfltcd_getppre_msg ""
 /begin OUT_MEASUREMENT PFltCD_pLinPreB1 PFltCD_pLinPreB2 PFltCD_pPreB1 PFltCD_pPreB2 PFltCD_pPreDiff PFltCD_swtSigPPre PFltCD_uRawPresPreB1 PFltCD_uRawPresPreB2 /end OUT_MEASUREMENT
/end FUNCTION
/begin FUNCTION pfltcd_getppre_uic "" /begin OUT_MEASUREMENT PFltCD_pPreB1_mp PFltCD_pPreB2_mp PFltCD_uRawPresPreBnk_mp /end OUT_MEASUREMENT /end FUNCTION
/begin FUNCTION pfltcd_gettpre "Abgastemperatur vor dem Partikelfilter"
 /begin DEF_CHARACTERISTIC PFltCD_uSRCMinTPreB1_C PFltCD_uSRCMaxTPreB1_C PFltCD_tLinPreB1_CUR PFltCD_uSRCMinTPreB2_C PFltCD_uSRCMaxTPreB2_C PFltCD_tLinPreB2_CUR PFltCD_DebSRCHighDefTPre_C PFltCD_DebSRCHighOkTPre_C PFltCD_DebSRCLowDefTPre_C PFltCD_DebSRCLowOkTPre_C PFltCD_dtRmpSlpUpPre_C PFltCD_dtRmpSlpDwnPre_C PFltCD_facPreCor_CUR PFltCD_numTempPreADCB1_C PFltCD_numTempPreADCB2_C PFltCD_swtActvTPre_C PFltCD_stSensIDWordTPre_C PFltCD_tDflPre_C /end DEF_CHARACTERISTIC
 /begin IN_MEASUREMENT PFltCD_uRawTempPreBnk_mp PFlt_dvol /end IN_MEASUREMENT
/end FUNCTION
/begin FUNCTION pfltcd_gettpre_msg ""
 /begin OUT_MEASUREMENT PFltCD_tLinPreB1 PFltCD_tLinPreB2 PFltCD_tPreB1 PFltCD_tPreB2 PFltCD_uRawTempPreB1 PFltCD_uRawTempPreB2 /end OUT_MEASUREMENT
/end FUNCTION
/begin FUNCTION pfltcd_gettpre_uic "" /begin OUT_MEASUREMENT PFltCD_uRawTempPreBnk_mp /end OUT_MEASUREMENT /end FUNCTION
/begin COMPU_METHOD CubMtrPerHr "Volumsstrom in m^3/h" RAT_FUNC "%6.3" "m^3/h" COEFFS 0 10 0 0 0 1 /end COMPU_METHOD
/begin COMPU_METHOD Curr "Strom" RAT_FUNC "%6.2" "mA" COEFFS 0 1 0 0 0 1 /end COMPU_METHOD
/begin COMPU_METHOD dn_dZ20 "Motorbeschleunigung pro Zeit (dn/dt) (im 20 ms Raster)" RAT_FUNC "%6.1" "rpm/s" COEFFS 0 0.1 0 0 0 1 /end COMPU_METHOD
/begin COMPU_METHOD dp_dZ10 "boost pressure per time (dp/dt) every 10ms" RAT_FUNC "%6.1" "hPa/s" COEFFS 0 0.1 0 0 0 1 /end COMPU_METHOD
/begin COMPU_METHOD dp_dZ20 " boost pressure per time (dp/dt) every 20ms" RAT_FUNC "%6.1" "hPa/s" COEFFS 0 0.1 0 0 0 1 /end COMPU_METHOD
/begin COMPU_METHOD DtyCyc "Tastverhaeltnis" RAT_FUNC "%6.4" "%" COEFFS 0 100 0 0 0 1 /end COMPU_METHOD
/begin COMPU_METHOD EGTRmp "Zeitrampe verwendet von EGT Lib Funktionen" RAT_FUNC "%6.3" "s" COEFFS 0 0 1 0 0.0152587890625 0 /end COMPU_METHOD
/begin COMPU_METHOD EngN "Motordrehzahl" RAT_FUNC "%6.2" "rpm" COEFFS 0 1 0 0 0 1 /end COMPU_METHOD
/begin COMPU_METHOD Fact "Faktor mit Auflösung 1 / 8192, hauptsächlich für einen Faktorenbereich 0...1 verwendet" RAT_FUNC "%6.5" "-" COEFFS 0 8192 0 0 0 1 /end COMPU_METHOD
/begin COMPU_METHOD Fact1 "Faktor mit Auflösung 0,01 (100 mal höherer Bereich als Fact)" RAT_FUNC "%6.4" "-" COEFFS 0 128 0 0 0 1 /end COMPU_METHOD
/begin COMPU_METHOD Fact2 "Faktor mit Auflösung 0.001, für einen Faktorenbereich 0...5,46117 verwendet" RAT_FUNC "%6.4" "-" COEFFS 0 16 0 0 0 1 /end COMPU_METHOD
/begin COMPU_METHOD FactM "Low resolution factor for airmass" RAT_FUNC "%6.4" "-" COEFFS 0 16 0 0 0 1 /end COMPU_METHOD
/begin COMPU_METHOD FlConsum_l_h "Kraftstoffverbrauch" RAT_FUNC "%6.4" "l/h" COEFFS 0 100 0 0 0 1 /end COMPU_METHOD
/begin COMPU_METHOD InjMass "Einspritzmenge" RAT_FUNC "%6.4" "mg/hub" COEFFS 0 100 0 0 0 1 /end COMPU_METHOD
/begin COMPU_METHOD InjMassCyc "Einspritzmenge pro Zyklus (mg/Zyklus)" RAT_FUNC "%6.4" "mg/cyc" COEFFS 0 100 0 0 0 1 /end COMPU_METHOD
/begin COMPU_METHOD InjMassPerSec_20ms "Einspritzmengenänderung pro Sekunde für 20ms-Tasks" RAT_FUNC "%6.3" "mg/hub/s" COEFFS 0 2 0 0 0 1 /end COMPU_METHOD
/begin COMPU_METHOD Kd "Differentialverstärkung Kd (gleiche Einheit/Umrechnungsformel an Ein- und Ausgang)" RAT_FUNC "%7.6" "1/1" COEFFS 0 65536 0 0 0 1 /end COMPU_METHOD
/begin COMPU_METHOD Kd_InjMass2Prc "Differentialverstärkung (Einspritzmasse zu Prozent)" RAT_FUNC "%7.6" "%/(mg/Hub)" COEFFS 0 53687.0912 0 0 0 1 /end COMPU_METHOD
/begin COMPU_METHOD Kd_Pres2dpdt "differential gain(boost pressure to rate of change of boost pressure)" RAT_FUNC "%8.7" "hPa/sec/hPa" COEFFS 0 131072 0 0 0 1 /end COMPU_METHOD
/begin COMPU_METHOD Kd_Pres2Prc "Differentialverstärkung Kd (Druck Pres zu Prozent Prc)" RAT_FUNC "%9.8" "%/hPa" COEFFS 0 5368709.120000 0 0 0 1 /end COMPU_METHOD
/begin COMPU_METHOD Kd_Pres_hPa2Prc "Differentialverstärkung Kd (Druck Pres_hPa zu Prozent Prc)" RAT_FUNC "%9.8" "%/hPa" COEFFS 0 5368709.12 0 0 0 1 /end COMPU_METHOD
/begin COMPU_METHOD Kd_rpm2dndt "differential gain(engine speed to rate of change of engine speed)" RAT_FUNC "%8.7" "rmp/sec/rpm" COEFFS 0 131072 0 0 0 1 /end COMPU_METHOD
/begin COMPU_METHOD Ki "Integrale Verstärkung Ki (gleiche Einheit/Umrechnungsregel an Ein- und Ausgang)" RAT_FUNC "%6.5" "1/s" COEFFS 0 4294.967296 0 0 0 1 /end COMPU_METHOD
/begin COMPU_METHOD Ki_curr2fact "Integralverstärkung (Strom Curr zu Faktor Fact)" RAT_FUNC "%10.9" "1/mA*s" COEFFS 0 35184372.088832 0 0 0 1 /end COMPU_METHOD
/begin COMPU_METHOD Ki_Pres_fac2hPa "Gain Conversion from Factor to Hpa" RAT_FUNC "%6.4" "hPa/s" COEFFS 0 268.435456 0 0 0 1 /end COMPU_METHOD
/begin COMPU_METHOD Ki_Pres_hPa2Prc "Integralverstärkung (Druck Pres_hPa zu Prozent Prc)" RAT_FUNC "%8.7" "%/(hPa*s)" COEFFS 0 351843.72088832 0 0 0 1 /end COMPU_METHOD
/begin COMPU_METHOD Kp_Pres_fac2hPa "Gain Conversion from Factor to Hpa" RAT_FUNC "%6.5" "hPa" COEFFS 0 4096 0 0 0 1 /end COMPU_METHOD
/begin COMPU_METHOD Kp_Pres_hPa2Prc "Proportionale Verstärkung (Druck Pres_hPa zu Prozent Prc)" RAT_FUNC "%9.8" "%/hPa" COEFFS 0 5368709.12 0 0 0 1 /end COMPU_METHOD
/begin COMPU_METHOD NumPinAdc "verbale Umrechnung für ADC Signale" TAB_VERB "%6.3" "-" COMPU_TAB_REF NumPinAdc /end COMPU_METHOD
/begin COMPU_VTAB NumPinAdc "verbale Umrechnung für ADC Signale" TAB_VERB 61 0 "ADC_REF" 1 "Voltage_Lambda1_Ua" 2 "Voltage_Lambda1_Ri" 3 "Temperature_ECU_PCB" 4 "Voltage_Bank_1" 5 "Voltage_Bank_2" 6 "ADC_DUMMYA" 7 "1st_APP_Sensor_252" 8 "ADC_Reserve-S1" 9 "2nd_APP_Sensor_239" 10 "ADC_Reserve-S2" 11 "Water_Temperature_Sensor_182" 12 "TKS" 13 "Charge_Air_Temperature_Sensor_183_2" 14 "Exhaust_Temperature_Sensor_1_MASTER_158" 15 "Exhaust_Temperature_Sensor_1_SLAVE_158" 16 "Atmospheric_Pressure_Sensor" 17 "Charge_Air_Temperature_Sensor_183" 18 "ADC_DUMMYB_NOT_USED" 19 "Rail_Pressure_Peak_Value_156" 20 "Rail_Pressure_Peak_Value-DummySlave" 21 "Boost_Pressure_Sensor_154" 22 "Boost_Pressure_Sensor_2" 23 "Booster_Voltage_Sensor" 24 "Rail_Pressure_Sensor_156" 25 "Pressure_Upstream_Particle_Filter_MASTER_159" 26 "Pressure_Upstream_Particle_Filter_SLAVE_159" 27 "Temperature_Upstream_Particle_Filter_MASTER_134" 28 "Temperature_Upstream_Particle_Filter_SLAVE_134" 29 "Current_MeUn_Sensor" 30 "Current_PCV_Sensor" 31 "Engine_Oil_Pressure_110" 32 "Battery_Voltage_Sensor" 33 "ADC_DUMMY_SLAVE_NOT_USED" 34 "ADC_DUMMY_NOT_USED" 35 "Charge_Actuator_Event_0" 36 "Voltage_Piezo_Actuator_Bank_2_Event_0" 37 "Voltage_Piezo_Actuator_Bank_1_Event_0" 38 "Charge_Actuator_Event_1" 39 "Voltage_Piezo_Actuator_Bank_2_Event_1" 40 "Voltage_Piezo_Actuator_Bank_1_Event_1" 41 "Charge_Actuator_Event_2" 42 "Voltage_Piezo_Actuator_Bank_2_Event_2" 43 "Voltage_Piezo_Actuator_Bank_1_Event_2" 44 "Charge_Actuator_Event_3" 45 "Voltage_Piezo_Actuator_Bank_2_Event_3" 46 "Voltage_Piezo_Actuator_Bank_1_Event_3" 47 "Charge_Actuator_Event_4" 48 "Voltage_Piezo_Actuator_Bank_2_Event_4" 49 "Voltage_Piezo_Actuator_Bank_1_Event_4" 50 "Charge_Actuator_Event_5" 51 "Voltage_Piezo_Actuator_Bank_2_Event_5" 52 "Voltage_Piezo_Actuator_Bank_1_Event_5" 53 "Charge_Actuator_Event_6" 54 "Voltage_Piezo_Actuator_Bank_2_Event_6" 55 "Voltage_Piezo_Actuator_Bank_1_Event_6" 56 "Charge_Actuator_Event_7" 57 "Voltage_Piezo_Actuator_Bank_2_Event_7" 58 "Voltage_Piezo_Actuator_Bank_1_Event_7" 59 "Booster_Voltage_Piezo" 60 "Piezo_Voltage" /end COMPU_VTAB
/begin COMPU_METHOD NumPinDia "Verbale Umrechnung für Diagnose Signale" TAB_VERB "%6.3" "-" COMPU_TAB_REF NumPinDia /end COMPU_METHOD
/begin COMPU_VTAB NumPinDia "Verbale Umrechnung für Diagnose Signale" TAB_VERB 34 0 "CJ945_Diagnostic_Signal" 1 "AC_Compressor_DiaSig" 2 "Fuel_Pump_DiaSig" 3 "Starter_234" 4 "Radiator_Blind_Control_Diagnostic_Signal" 5 "Engine_Bay_Air_Flaps/Compressor_Bypass_123" 6 "Glow_Relay_Diagnostic_Signal1" 7 "EngM_Bearing_Actuator_Diagnostic_Signal_124" 8 "reserved Glow_Relay_Diagnostic_Signal2" 9 "Ebox_Fan_Actuator_Diagnostic_Signal_219" 10 "Shutter_Actuator_SW_DiaSig" 11 "Twostage_TurboLoading_SW_DiaSig" 12 "DIO_OUT_DIAGNOSTIC_DUMMY_NOT_USED" 13 "1st_Pressure_Control_Valve_Diagnostic_Signal_172" 14 "2nd_Pressure_Control_Valve_Diagnostic_Signal_172" 15 "1st_Metering_Unit_Diagnostic_Signal_171" 16 "2nd_Metering_Unit_Diagnostic_Signal_171" 17 "Boost_Pressure_Actuator_Diagnostic_Signal_193" 18 "Boost_Pressure_Actuator_Diagnostic_Signal_193_2" 19 "EGR_Actuator_Diagnostic_Signal_194" 20 "EGR_Actuator_Diagnostic_Signal2" 21 "Variable_Swirl_Actuator_Diagnostic_Signal_195" 22 "Throttle_Valve_Diagnostic_Signal_196" 23 "Throttle_Valve2_Diagnostic_Signal_196" 24 "FAN_240" 25 "Add_On_Heater_244" 26 "Low pressure stage BPA_Diagnostic_Signal_117" 27 "PWM_DIAGNOSTIC_DUMMY_NOT_USED" 28 "1st_Sensor_Supply_Voltage_DiaSig" 29 "2nd_Sensor_Supply_Voltage_DiaSig" 30 "3rd_Sensor_Supply_Voltage_DiaSig" 31 "4th_Sensor_Supply_Voltage_DiaSig" 32 "5th_Sensor_Supply_Voltage_DiaSig" 33 "6th_Sensor_Supply_Voltage_DiaSig" /end COMPU_VTAB
/begin COMPU_METHOD NumPinPwmOut "Verbale Umrechnung für PWM-Ausgang Signale" TAB_VERB "%6.3" "-" COMPU_TAB_REF NumPinPwmOut /end COMPU_METHOD
/begin COMPU_VTAB NumPinPwmOut "Verbale Umrechnung für PWM-Ausgang Signale" TAB_VERB 14 0 "PCV_Actuator_172" 1 "MeUn_Actuator_171" 2 "Boost_Pressure_Actuator_193" 3 "Boost_Pressure_Actuator_193_2" 4 "EGR_Actuator_194" 5 "EGR_Actuator_2" 6 "Variable_Swirl_Actuator_195" 7 "Throttle_Valve_196" 8 "Throttle_Valve2_196" 9 "Fan_Actuator_240" 10 "Add_On_Heater_244" 11 "LSU_Heater_PWMOutput" 12 "Low pressure stage BPA_117" 13 "PWM_DUMMY_NOT_USED" /end COMPU_VTAB
/begin COMPU_METHOD OneToOne "eins zu eins (physikalischer Wert ist gleich dem internen Wert)" RAT_FUNC "%6.2" "-" COEFFS 0 1 0 0 0 1 /end COMPU_METHOD
/begin COMPU_METHOD Period "Periodendauer" RAT_FUNC "%6.3" "ms" COEFFS 0 10 0 0 0 1 /end COMPU_METHOD
/begin COMPU_METHOD Prc "Prozent, gleiche interne Auflösung wie Fact, aber Darstellung in Prozent (0...100%)" RAT_FUNC "%6.4" "%" COEFFS 0 81.92 0 0 0 1 /end COMPU_METHOD
/begin COMPU_METHOD PrcPerSec "Prozentänderung pro Sekunde für 20ms-Tasks" RAT_FUNC "%6.3" "%/s" COEFFS 0 1.6384 0 0 0 1 /end COMPU_METHOD
/begin COMPU_METHOD Pres "Druck (angezeigt in [kPa])" RAT_FUNC "%7.2" "hPa" COEFFS 0 1.000000 0 0 0 1 /end COMPU_METHOD
/begin COMPU_METHOD Pres_hPa "Druck (angezeigt in [hPa])" RAT_FUNC "%6.2" "hPa" COEFFS 0 1 0 0 0 1 /end COMPU_METHOD
/begin COMPU_METHOD Pres_Rail "Raildruck in hPa" RAT_FUNC "%4.3" "bar" COEFFS 0 10.000000 0 0 0 1 /end COMPU_METHOD
/begin COMPU_METHOD Qp_mm3_sec "Umrechnung für Volumenstrom" RAT_FUNC "%6.1" "mm3/s" COEFFS 0 0.1 0 0 0 1 /end COMPU_METHOD
/begin COMPU_METHOD Resist_1 "1. Widerstandsvariante" RAT_FUNC "%6.2" "mOhm" COEFFS 0 1 0 0 0 1 /end COMPU_METHOD
/begin COMPU_METHOD Res_hPaHrPerCM "Strömungswiderstand [hPa h/m3]" RAT_FUNC "%6.5" "hPa/(m^3/h)" COEFFS 0 1000 0 0 0 1 /end COMPU_METHOD
/begin COMPU_METHOD RmpPrc "Prozent Rampengradient" RAT_FUNC "%6.5" "%/s" COEFFS 0 5368.70912 0 0 0 1 /end COMPU_METHOD
/begin COMPU_METHOD RmpPres_hPa "Rampengradient für Druck angezeigt in [hPa/s]" RAT_FUNC "%6.4" "hPa/s" COEFFS 0 65.536 0 0 0 1 /end COMPU_METHOD
/begin COMPU_METHOD RmpTemp "Rampengradient für Temperatur" RAT_FUNC "%6.4" "deg C/s" COEFFS 0 655.36 0 0 0 1 /end COMPU_METHOD
/begin COMPU_METHOD TempDiff_Kelv "Offsettemperatur dargestellt in [K]" RAT_FUNC "%6.3" "deg C" COEFFS 0 10 0 0 0 1 /end COMPU_METHOD
/begin COMPU_METHOD Temp_Cels "Temperatur dargestellt in °C (gleiche interne Darstellung wie Temp_Kelv)" RAT_FUNC "%6.1" "deg C" COEFFS 0 10 2731.4 0 0 1 /end COMPU_METHOD
/begin COMPU_METHOD TimeDeb "Entprellzeit in Millisekunden für Libraryfunktion Debounce" RAT_FUNC "%6.1" "ms" COEFFS 0 0.1 0 0 0 1 /end COMPU_METHOD
/begin COMPU_METHOD TimeDelay_ms "Zeitkonstante T1 fuer die Bibliotheksfunktionen PT1, DT1, etc.,  in ms angegeben" RAT_FUNC "%9.0" "ms" COEFFS 0 0 1 0 2.3283064365387e-07 0 /end COMPU_METHOD
/begin COMPU_METHOD TimeDelay_s "Zeitkonstante T1 (in s) für PT1, DT1, etc." RAT_FUNC "%9.3" "s" COEFFS 0 0 1 0 0.00023283064365387 0 /end COMPU_METHOD
/begin COMPU_METHOD TimeEngOn "Motorbetriebszeit in Sekunden" RAT_FUNC "%6.2" "s" COEFFS 0 1 0 0 0 1 /end COMPU_METHOD
/begin COMPU_METHOD Time_ms "Zeit in ms für Fehlerentprellung (DSM) und SW-Timer" RAT_FUNC "%6.1" "ms" COEFFS 0 0.1 0 0 0 1 /end COMPU_METHOD
/begin COMPU_METHOD Time_s "Zeit in s für Fehlerentprellung (DSM) und SW-Timer" RAT_FUNC "%6.4" "s" COEFFS 0 100 0 0 0 1 /end COMPU_METHOD
/begin COMPU_METHOD Vel "Fahrzeuggeschwindigkeit, gleiche interne Auflösung wie Vel_SI" RAT_FUNC "%6.4" "km/h" COEFFS 0 100 0 0 0 1 /end COMPU_METHOD
/begin COMPU_METHOD Volt "Spannung in V (von ADC)" RAT_FUNC "%6.2" "mV" COEFFS 0 0.2046 0 0 0 1 /end COMPU_METHOD
/begin COMPU_METHOD Volt_Batt "Batteriespannung" RAT_FUNC "%6.1" "mV" COEFFS 0 0.05115 0 0 0 1 /end COMPU_METHOD
/begin RECORD_LAYOUT Kf_Xs16_Ys16_Ws16 NO_AXIS_PTS_X 1 SWORD NO_AXIS_PTS_Y 2 SWORD AXIS_PTS_X 3 SWORD INDEX_INCR DIRECT AXIS_PTS_Y 4 SWORD INDEX_INCR DIRECT FNC_VALUES 5 SWORD COLUMN_DIR DIRECT /end RECORD_LAYOUT
/begin RECORD_LAYOUT Kl_Xs16_Ws16 NO_AXIS_PTS_X 1 SWORD AXIS_PTS_X 2 SWORD INDEX_INCR DIRECT FNC_VALUES 3 SWORD COLUMN_DIR DIRECT /end RECORD_LAYOUT
/begin RECORD_LAYOUT Kwb_Wu32 FNC_VALUES 1 ULONG COLUMN_DIR DIRECT /end RECORD_LAYOUT
/begin RECORD_LAYOUT Kw_Ws16 FNC_VALUES 1 SWORD COLUMN_DIR DIRECT /end RECORD_LAYOUT
/begin RECORD_LAYOUT Kw_Ws32 FNC_VALUES 1 SLONG COLUMN_DIR DIRECT /end RECORD_LAYOUT
/begin RECORD_LAYOUT Kw_Wu16 FNC_VALUES 1 UWORD COLUMN_DIR DIRECT /end RECORD_LAYOUT
/begin RECORD_LAYOUT Kw_Wu32 FNC_VALUES 1 ULONG COLUMN_DIR DIRECT /end RECORD_LAYOUT
/begin RECORD_LAYOUT Kw_Wu8 FNC_VALUES 1 UBYTE COLUMN_DIR DIRECT /end RECORD_LAYOUT
/end MODULE
/end PROJECT
