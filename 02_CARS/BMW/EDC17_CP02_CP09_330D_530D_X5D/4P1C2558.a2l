ASAP2_VERSION 1 4
/begin PROJECT P_558 "EDC17_CP02"
/begin HEADER "" VERSION "V1C1" PROJECT_NO P_558 /end HEADER
/begin MODULE DIM ""
/begin MOD_COMMON "" BYTE_ORDER MSB_LAST ALIGNMENT_BYTE 1 ALIGNMENT_WORD 2 ALIGNMENT_LONG 4 ALIGNMENT_FLOAT32_IEEE 4 /end MOD_COMMON
/begin CHARACTERISTIC Com_ctStateARSSelfRec_C "" VALUE 0x80063B2C Val_Wu8 255.0 OneToOne 0.00 255.0 FORMAT "%5.1" /end CHARACTERISTIC
/begin CHARACTERISTIC Com_ctTrqDemandAFSSelfRec_C "" VALUE 0x80063B2D Val_Wu8 255.0 OneToOne 0.00 255.0 FORMAT "%5.1" /end CHARACTERISTIC
/begin CHARACTERISTIC Com_nRqStgEFan_CUR "" CURVE 0x80063B40 Cur_Xs16Ws16 3000.000 FanSpd 0.00 3000.000 FORMAT "%8.3" EXTENDED_LIMITS -3000.092 3000.000
 /begin AXIS_DESCR STD_AXIS Com_numRqStgEFan_mp OneToOne 4 0.00 15.00 FORMAT "%5.2" EXTENDED_LIMITS 0.00 255.0 DEPOSIT ABSOLUTE /end AXIS_DESCR
/end CHARACTERISTIC
/begin CHARACTERISTIC Com_swtAnfrage_C "" VALUE 0x80063B2E Val_Wu8 1.000 OneToOne 0.00 1.000 FORMAT "%5.3" EXTENDED_LIMITS 0.00 255.0 /end CHARACTERISTIC
/begin CHARACTERISTIC Com_swtButtonMSA_C "" VALUE 0x80063B2F Val_Wu8 1.000 OneToOne 0.00 1.000 FORMAT "%5.3" EXTENDED_LIMITS 0.00 255.0 /end CHARACTERISTIC
/begin CHARACTERISTIC Com_swtDienste_C "" VALUE 0x80063B30 Val_Wu8 1.000 OneToOne 0.00 1.000 FORMAT "%5.3" EXTENDED_LIMITS 0.00 255.0 /end CHARACTERISTIC
/begin CHARACTERISTIC Com_swtPsp_C "" VALUE 0x80063B31 Val_Wu8 1.000 OneToOne 0.00 1.000 FORMAT "%5.3" EXTENDED_LIMITS 0.00 255.0 /end CHARACTERISTIC
/begin CHARACTERISTIC Com_swtReqEFan_C "" VALUE 0x80063B32 Val_Wu8 1.000 OneToOne 0.00 1.000 FORMAT "%5.3" EXTENDED_LIMITS 0.00 255.0 /end CHARACTERISTIC
/begin CHARACTERISTIC Com_swtReqMSA_C "" VALUE 0x80063B33 Val_Wu8 1.000 OneToOne 0.00 1.000 FORMAT "%5.3" EXTENDED_LIMITS 0.00 255.0 /end CHARACTERISTIC
/begin CHARACTERISTIC Com_swtShutOffPSP_C "" VALUE 0x80063B34 Val_Wu8 1.000 OneToOne 0.00 1.000 FORMAT "%5.3" EXTENDED_LIMITS 0.00 255.0 /end CHARACTERISTIC
/begin CHARACTERISTIC Com_swtStartdrehzahl_C "" VALUE 0x80063B35 Val_Wu8 1.000 OneToOne 0.00 1.000 FORMAT "%5.3" EXTENDED_LIMITS 0.00 255.0 /end CHARACTERISTIC
/begin CHARACTERISTIC Com_swtStateARS_C "" VALUE 0x80063B36 Val_Wu8 1.000 OneToOne 0.00 1.000 FORMAT "%5.3" EXTENDED_LIMITS 0.00 255.0 /end CHARACTERISTIC
/begin CHARACTERISTIC Com_swtStateSeat_C "" VALUE 0x80063B37 Val_Wu8 1.000 OneToOne 0.00 1.000 FORMAT "%5.3" EXTENDED_LIMITS 0.00 255.0 /end CHARACTERISTIC
/begin CHARACTERISTIC Com_swtTerminal_C "" VALUE 0x80063B38 Val_Wu8 1.000 OneToOne 0.00 1.000 FORMAT "%5.3" EXTENDED_LIMITS 0.00 255.0 /end CHARACTERISTIC
/begin CHARACTERISTIC Com_swtTrailer_C "" VALUE 0x80063B39 Val_Wu8 1.000 OneToOne 0.00 1.000 FORMAT "%5.3" EXTENDED_LIMITS 0.00 255.0 /end CHARACTERISTIC
/begin CHARACTERISTIC Com_swtTrqDemandAFS_C "" VALUE 0x80063B3A Val_Wu8 1.000 OneToOne 0.00 1.000 FORMAT "%5.3" EXTENDED_LIMITS 0.00 255.0 /end CHARACTERISTIC
/begin CHARACTERISTIC Com_swtZvKlappen_C "" VALUE 0x80063B3B Val_Wu8 1.000 OneToOne 0.00 1.000 FORMAT "%5.3" EXTENDED_LIMITS 0.00 255.0 /end CHARACTERISTIC
/begin CHARACTERISTIC Com_tiStateARSSelfRec_C "" VALUE 0x80063B3C Val_Ws16 327670.0 Time_ms 0.00 327670.0 FORMAT "%8.1" EXTENDED_LIMITS -327680.0 327670.0 /end CHARACTERISTIC
/begin CHARACTERISTIC Com_tiTrqDemandAFSSelfRec_C "" VALUE 0x80063B3E Val_Ws16 327670.0 Time_ms 0.00 327670.0 FORMAT "%8.1" EXTENDED_LIMITS -327680.0 327670.0 /end CHARACTERISTIC
/begin CHARACTERISTIC LSU_AirPerTimeI.Ki_C "/" VALUE 0x800637D0 Val_Ws32 4.99980524182 Ki 0.00 4.99980524182 FORMAT "%13.11" EXTENDED_LIMITS -1000000.00000 999999.999534 /end CHARACTERISTIC
/begin CHARACTERISTIC LSU_AirPerTimeI.KiPos_C "/" VALUE 0x800637D4 Val_Ws32 4.99980524182 Ki 0.00 4.99980524182 FORMAT "%13.11" EXTENDED_LIMITS -1000000.00000 999999.999534 /end CHARACTERISTIC
/begin CHARACTERISTIC LSU_AirPerTimeI.KiNeg_C "/" VALUE 0x800637D8 Val_Ws32 4.99980524182 Ki 0.00 4.99980524182 FORMAT "%13.11" EXTENDED_LIMITS -1000000.00000 999999.999534 /end CHARACTERISTIC
/begin CHARACTERISTIC LSU_AirPerTimeI.WinPos_C "/" VALUE 0x800637DC Val_Ws32 250.000000000 AirMassPerTime 223.000000000 473.000000000 FORMAT "%13.9" EXTENDED_LIMITS -214748364.800 214748364.700 /end CHARACTERISTIC
/begin CHARACTERISTIC LSU_AirPerTimeI.WinNeg_C "/" VALUE 0x800637E0 Val_Ws32 250.000000000 AirMassPerTime 223.000000000 473.000000000 FORMAT "%13.9" EXTENDED_LIMITS -214748364.800 214748364.700 /end CHARACTERISTIC
/begin CHARACTERISTIC LSU_BattHiDeb.tiHiLo_C "/" VALUE 0x800637A4 Kw_Ws16 655350.0 TimeDeb -327680.0 327670.0 FORMAT "%8.1" /end CHARACTERISTIC
/begin CHARACTERISTIC LSU_BattHiDeb.tiLoHi_C "/" VALUE 0x800637A6 Kw_Ws16 655350.0 TimeDeb -327680.0 327670.0 FORMAT "%8.1" /end CHARACTERISTIC
/begin CHARACTERISTIC LSU_d2rIni_C "" VALUE 0x800637E4 Val_Ws16 0.6553500 O2 -0.3276800 0.3276700 FORMAT "%9.7" /end CHARACTERISTIC
/begin CHARACTERISTIC LSU_dcycHtMin_C "" VALUE 0x80063914 Val_Ws16 100.0000 DtyCyc 0.00 100.0000 FORMAT "%8.4" EXTENDED_LIMITS -327.6800 327.6700 /end CHARACTERISTIC
/begin CHARACTERISTIC LSU_DcycRmp.Pos_C "/" VALUE 0x80063918 Val_Ws32 327679.999847 RmpDtyCyc 0.00 327679.999847 FORMAT "%13.6" EXTENDED_LIMITS -327680.000000 327679.999847 /end CHARACTERISTIC
/begin CHARACTERISTIC LSU_DcycRmp.Neg_C "/" VALUE 0x8006391C Val_Ws32 327679.999847 RmpDtyCyc 0.00 327679.999847 FORMAT "%13.6" EXTENDED_LIMITS -327680.000000 327679.999847 /end CHARACTERISTIC
/begin CHARACTERISTIC LSU_dcycStrt_CUR "" CURVE 0x80063920 Cur_Xs16Ws16 100.0000 DtyCyc 0.00 100.0000 FORMAT "%8.4" EXTENDED_LIMITS -327.6800 327.6700
 /begin AXIS_DESCR STD_AXIS LSU_tAirStrt_mp Temp_Cels 5 -73.14000 126.8600 FORMAT "%8.4" EXTENDED_LIMITS -3549.940 3003.560 DEPOSIT ABSOLUTE /end AXIS_DESCR
/end CHARACTERISTIC
/begin CHARACTERISTIC LSU_EvalMaxVal_C "" VALUE 0x800637E6 Val_Ws16 0.6553500 O2 -0.3276800 0.3276700 FORMAT "%9.7" /end CHARACTERISTIC
/begin CHARACTERISTIC LSU_EvalMinVal_C "" VALUE 0x800637E8 Val_Ws16 0.6553500 O2 -0.3276800 0.3276700 FORMAT "%9.7" /end CHARACTERISTIC
/begin CHARACTERISTIC LSU_facPresCompLean_MAP "" MAP 0x800637EA Map_Xs16Ys16Ws16 7.999878 Fact -4.000000 3.999878 FORMAT "%8.6"
 /begin AXIS_DESCR STD_AXIS LSU_pExhGasLstVal_mp Pres_hPa 8 -32768.00 3500.00 FORMAT "%8.2" EXTENDED_LIMITS -32768.00 32767.00 DEPOSIT ABSOLUTE /end AXIS_DESCR
 /begin AXIS_DESCR STD_AXIS LSU_tDvtPresComp_mp TempDiff_Kelv 5 -3276.800 3276.700 FORMAT "%8.3" DEPOSIT ABSOLUTE /end AXIS_DESCR
/end CHARACTERISTIC
/begin CHARACTERISTIC LSU_facPresCompRich_MAP "" MAP 0x80063858 Map_Xs16Ys16Ws16 7.999878 Fact -4.000000 3.999878 FORMAT "%8.6"
 /begin AXIS_DESCR STD_AXIS LSU_pExhGasLstVal_mp Pres_hPa 8 -32768.00 3500.00 FORMAT "%8.2" EXTENDED_LIMITS -32768.00 32767.00 DEPOSIT ABSOLUTE /end AXIS_DESCR
 /begin AXIS_DESCR STD_AXIS LSU_tDvtPresComp_mp TempDiff_Kelv 5 -3276.800 3276.700 FORMAT "%8.3" DEPOSIT ABSOLUTE /end AXIS_DESCR
/end CHARACTERISTIC
/begin CHARACTERISTIC LSU_mAirAdapActv_C "" VAL_BLK 0x800638C6 ValA_Ws16 6553.500 AirMass_2 -3276.800 3276.700 FORMAT "%8.3" NUMBER 1 /end CHARACTERISTIC
/begin CHARACTERISTIC LSU_mAirMaxCmpChk_C "" VALUE 0x8007A600 Val_Ws16 6553.500 AirMassPerCyl -3276.800 3276.700 FORMAT "%8.3" /end CHARACTERISTIC
/begin CHARACTERISTIC LSU_mAirMax_C "" VAL_BLK 0x8007A602 ValA_Ws16 6553.500 AirMassPerCyl -3276.800 3276.700 FORMAT "%8.3" NUMBER 3 /end CHARACTERISTIC
/begin CHARACTERISTIC LSU_mAirMinCmpChk_C "" VALUE 0x8007A608 Val_Ws16 6553.500 AirMassPerCyl -3276.800 3276.700 FORMAT "%8.3" /end CHARACTERISTIC
/begin CHARACTERISTIC LSU_mAirMin_C "" VAL_BLK 0x8007A60A ValA_Ws16 6553.500 AirMassPerCyl -3276.800 3276.700 FORMAT "%8.3" NUMBER 3 /end CHARACTERISTIC
/begin CHARACTERISTIC LSU_nHtCtlEna_C "" VALUE 0x80063936 Val_Ws16 16383.50 EngN 0.00 16383.50 FORMAT "%8.2" EXTENDED_LIMITS -16384.00 16383.50 /end CHARACTERISTIC
/begin CHARACTERISTIC LSU_nMaxCmpChk_C "" VALUE 0x8007A610 Val_Ws16 32767.50 EngN -16384.00 16383.50 FORMAT "%8.2" /end CHARACTERISTIC
/begin CHARACTERISTIC LSU_nMax_C "" VAL_BLK 0x8007A612 ValA_Ws16 32767.50 EngN -16384.00 16383.50 FORMAT "%8.2" NUMBER 3 /end CHARACTERISTIC
/begin CHARACTERISTIC LSU_nMinChkDyn_C "" VALUE 0x8007A618 Val_Ws16 32767.50 EngN -16384.00 16383.50 FORMAT "%8.2" /end CHARACTERISTIC
/begin CHARACTERISTIC LSU_nMinCmpChk_C "" VALUE 0x8007A61A Val_Ws16 32767.50 EngN -16384.00 16383.50 FORMAT "%8.2" /end CHARACTERISTIC
/begin CHARACTERISTIC LSU_nMin_C "" VAL_BLK 0x8007A61C ValA_Ws16 32767.50 EngN -16384.00 16383.50 FORMAT "%8.2" NUMBER 3 /end CHARACTERISTIC
/begin CHARACTERISTIC LSU_numEGFld_CA "" VAL_BLK 0x800638C8 ValA_Wu8 255.0 OneToOne 0.00 255.0 FORMAT "%5.1" NUMBER 1 /end CHARACTERISTIC
/begin CHARACTERISTIC LSU_numSelDiffChk_C "" VALUE 0x8007A622 Val_Wu8 32.00 OneToOne 0.00 32.00 FORMAT "%5.2" EXTENDED_LIMITS 0.00 255.0 /end CHARACTERISTIC
/begin CHARACTERISTIC LSU_numSensCmpChk_CA "" VAL_BLK 0x8007A623 ValA_Wu8 255.0 OneToOne 0.00 255.0 FORMAT "%5.1" READ_ONLY NUMBER 12 /end CHARACTERISTIC
/begin CHARACTERISTIC LSU_OvrRunDeb.tiHiLo_C "/" VALUE 0x800637A8 Kw_Ws16 655350.0 TimeDeb -327680.0 327670.0 FORMAT "%8.1" /end CHARACTERISTIC
/begin CHARACTERISTIC LSU_OvrRunDeb.tiLoHi_C "/" VALUE 0x800637AA Kw_Ws16 655350.0 TimeDeb -327680.0 327670.0 FORMAT "%8.1" /end CHARACTERISTIC
/begin CHARACTERISTIC LSU_qDiffMax_C "" VALUE 0x8007A630 Val_Ws16 655.3500 InjMass -327.6800 327.6700 FORMAT "%8.4" /end CHARACTERISTIC
/begin CHARACTERISTIC LSU_qMaxCmpChk_C "" VALUE 0x8007A632 Val_Ws16 655.3500 InjMass -327.6800 327.6700 FORMAT "%8.4" /end CHARACTERISTIC
/begin CHARACTERISTIC LSU_qMax_C "" VAL_BLK 0x8007A634 ValA_Ws16 655.3500 InjMass -327.6800 327.6700 FORMAT "%8.4" NUMBER 3 /end CHARACTERISTIC
/begin CHARACTERISTIC LSU_qMinCmpChk_C "" VALUE 0x8007A63A Val_Ws16 655.3500 InjMass -327.6800 327.6700 FORMAT "%8.4" /end CHARACTERISTIC
/begin CHARACTERISTIC LSU_qMin_C "" VAL_BLK 0x8007A63C ValA_Ws16 655.3500 InjMass -327.6800 327.6700 FORMAT "%8.4" NUMBER 3 /end CHARACTERISTIC
/begin CHARACTERISTIC LSU_qThresChkDyn_C "" VALUE 0x8007A642 Val_Ws16 655.3500 InjMass -327.6800 327.6700 FORMAT "%8.4" /end CHARACTERISTIC
/begin CHARACTERISTIC LSU_qThresOvrRun_C "" VALUE 0x8007A644 Val_Ws16 655.3500 InjMass -327.6800 327.6700 FORMAT "%8.4" /end CHARACTERISTIC
/begin CHARACTERISTIC LSU_rEGRMaxCmpChk_C "" VALUE 0x8007A646 Val_Ws16 300.0000 Prc -100.0000 200.0000 FORMAT "%8.4" EXTENDED_LIMITS -400.0000 399.9878 /end CHARACTERISTIC
/begin CHARACTERISTIC LSU_rEGRMinCmpChk_C "" VALUE 0x8007A648 Val_Ws16 300.0000 Prc -100.0000 200.0000 FORMAT "%8.4" EXTENDED_LIMITS -400.0000 399.9878 /end CHARACTERISTIC
/begin CHARACTERISTIC LSU_rLamRec_CUR "" CURVE 0x800638CA Cur_Xs16Ws16 65.53500 lambdaRecVal -32.76800 32.76700 FORMAT "%8.5"
 /begin AXIS_DESCR STD_AXIS LSU_rO2AdptLastLSU_mp O2 12 -0.3276800 0.3276700 FORMAT "%9.7" DEPOSIT ABSOLUTE /end AXIS_DESCR
/end CHARACTERISTIC
/begin CHARACTERISTIC LSU_rMaxDiff_CA "" VAL_BLK 0x8007A64A ValA_Ws16 0.6553500 O2 -0.3276800 0.3276700 FORMAT "%9.7" READ_ONLY NUMBER 6 /end CHARACTERISTIC
/begin CHARACTERISTIC LSU_rO2Lmbd1Thres_C "" VALUE 0x800637AC Val_Ws16 0.6553500 O2 -0.3276800 0.3276700 FORMAT "%9.7" /end CHARACTERISTIC
/begin CHARACTERISTIC LSU_rO2MaxVar_C "" VALUE 0x8007A656 Val_Ws16 0.6553500 O2 -0.3276800 0.3276700 FORMAT "%9.7" /end CHARACTERISTIC
/begin CHARACTERISTIC LSU_rO2Min_C "" VALUE 0x800637AE Val_Ws16 0.6553500 O2 -0.3276800 0.3276700 FORMAT "%9.7" /end CHARACTERISTIC
/begin CHARACTERISTIC LSU_rO2NegDvt_C "" VAL_BLK 0x8007A658 ValA_Ws16 0.6553500 O2 -0.3276800 0.3276700 FORMAT "%9.7" NUMBER 3 /end CHARACTERISTIC
/begin CHARACTERISTIC LSU_rO2PosDvt_C "" VAL_BLK 0x8007A65E ValA_Ws16 0.6553500 O2 -0.3276800 0.3276700 FORMAT "%9.7" NUMBER 3 /end CHARACTERISTIC
/begin CHARACTERISTIC LSU_rO2SwtPresComp_C "" VALUE 0x800638FC Val_Ws16 0.6553500 O2 -0.3276800 0.3276700 FORMAT "%9.7" /end CHARACTERISTIC
/begin CHARACTERISTIC LSU_Sens1DT1.T1_C "/" VALUE 0x80063938 Val_Ws32 4294.9672940 TimeDelay_s 0.000002000000001 4294.9672960 FORMAT "%12.7" /end CHARACTERISTIC
/begin CHARACTERISTIC LSU_Sens1DT1.Kd_C "/" VALUE 0x8006393C Val_Ws32 6553.59999847 Kd_Temp_Kelv2Dcyc -3276.80000000 3276.79999847 FORMAT "%13.8" /end CHARACTERISTIC
/begin CHARACTERISTIC LSU_Sens1I.Ki_C "/" VALUE 0x80063940 Val_Ws32 199999.999953 Ki_Temp_Kelv2Dcyc -100000.000000 99999.9999534 FORMAT "%13.6" /end CHARACTERISTIC
/begin CHARACTERISTIC LSU_Sens1I.KiPos_C "/" VALUE 0x80063944 Val_Ws32 199999.999953 Ki_Temp_Kelv2Dcyc -100000.000000 99999.9999534 FORMAT "%13.6" /end CHARACTERISTIC
/begin CHARACTERISTIC LSU_Sens1I.KiNeg_C "/" VALUE 0x80063948 Val_Ws32 199999.999953 Ki_Temp_Kelv2Dcyc -100000.000000 99999.9999534 FORMAT "%13.6" /end CHARACTERISTIC
/begin CHARACTERISTIC LSU_Sens1I.WinPos_C "/" VALUE 0x8006394C Val_Ws32 429496729.500 TempDiff_Kelv -214748364.800 214748364.700 FORMAT "%13.3" /end CHARACTERISTIC
/begin CHARACTERISTIC LSU_Sens1I.WinNeg_C "/" VALUE 0x80063950 Val_Ws32 429496729.500 TempDiff_Kelv -214748364.800 214748364.700 FORMAT "%13.3" /end CHARACTERISTIC
/begin CHARACTERISTIC LSU_Sens1P.Kp_C "/" VALUE 0x80063954 Val_Ws32 13107.1999969 Kp_Temp_Kelv2Dcyc -6553.60000000 6553.59999695 FORMAT "%13.8" /end CHARACTERISTIC
/begin CHARACTERISTIC LSU_Sens1P.KpPos_C "/" VALUE 0x80063958 Val_Ws32 13107.1999969 Kp_Temp_Kelv2Dcyc -6553.60000000 6553.59999695 FORMAT "%13.8" /end CHARACTERISTIC
/begin CHARACTERISTIC LSU_Sens1P.KpNeg_C "/" VALUE 0x8006395C Val_Ws32 13107.1999969 Kp_Temp_Kelv2Dcyc -6553.60000000 6553.59999695 FORMAT "%13.8" /end CHARACTERISTIC
/begin CHARACTERISTIC LSU_Sens1P.WinPos_C "/" VALUE 0x80063960 Val_Ws32 429496729.500 TempDiff_Kelv -214748364.800 214748364.700 FORMAT "%13.3" /end CHARACTERISTIC
/begin CHARACTERISTIC LSU_Sens1P.WinNeg_C "/" VALUE 0x80063964 Val_Ws32 429496729.500 TempDiff_Kelv -214748364.800 214748364.700 FORMAT "%13.3" /end CHARACTERISTIC
/begin CHARACTERISTIC LSU_Sens2DT1.T1_C "/" VALUE 0x80063968 Val_Ws32 4294.9672940 TimeDelay_s 0.000002000000001 4294.9672960 FORMAT "%12.7" /end CHARACTERISTIC
/begin CHARACTERISTIC LSU_Sens2DT1.Kd_C "/" VALUE 0x8006396C Val_Ws32 6553.59999847 Kd_Temp_Kelv2Dcyc -3276.80000000 3276.79999847 FORMAT "%13.8" /end CHARACTERISTIC
/begin CHARACTERISTIC LSU_Sens2I.Ki_C "/" VALUE 0x80063970 Val_Ws32 199999.999953 Ki_Temp_Kelv2Dcyc -100000.000000 99999.9999534 FORMAT "%13.6" /end CHARACTERISTIC
/begin CHARACTERISTIC LSU_Sens2I.KiPos_C "/" VALUE 0x80063974 Val_Ws32 199999.999953 Ki_Temp_Kelv2Dcyc -100000.000000 99999.9999534 FORMAT "%13.6" /end CHARACTERISTIC
/begin CHARACTERISTIC LSU_Sens2I.KiNeg_C "/" VALUE 0x80063978 Val_Ws32 199999.999953 Ki_Temp_Kelv2Dcyc -100000.000000 99999.9999534 FORMAT "%13.6" /end CHARACTERISTIC
/begin CHARACTERISTIC LSU_Sens2I.WinPos_C "/" VALUE 0x8006397C Val_Ws32 429496729.500 TempDiff_Kelv -214748364.800 214748364.700 FORMAT "%13.3" /end CHARACTERISTIC
/begin CHARACTERISTIC LSU_Sens2I.WinNeg_C "/" VALUE 0x80063980 Val_Ws32 429496729.500 TempDiff_Kelv -214748364.800 214748364.700 FORMAT "%13.3" /end CHARACTERISTIC
/begin CHARACTERISTIC LSU_Sens2P.Kp_C "/" VALUE 0x80063984 Val_Ws32 13107.1999969 Kp_Temp_Kelv2Dcyc -6553.60000000 6553.59999695 FORMAT "%13.8" /end CHARACTERISTIC
/begin CHARACTERISTIC LSU_Sens2P.KpPos_C "/" VALUE 0x80063988 Val_Ws32 13107.1999969 Kp_Temp_Kelv2Dcyc -6553.60000000 6553.59999695 FORMAT "%13.8" /end CHARACTERISTIC
/begin CHARACTERISTIC LSU_Sens2P.KpNeg_C "/" VALUE 0x8006398C Val_Ws32 13107.1999969 Kp_Temp_Kelv2Dcyc -6553.60000000 6553.59999695 FORMAT "%13.8" /end CHARACTERISTIC
/begin CHARACTERISTIC LSU_Sens2P.WinPos_C "/" VALUE 0x80063990 Val_Ws32 429496729.500 TempDiff_Kelv -214748364.800 214748364.700 FORMAT "%13.3" /end CHARACTERISTIC
/begin CHARACTERISTIC LSU_Sens2P.WinNeg_C "/" VALUE 0x80063994 Val_Ws32 429496729.500 TempDiff_Kelv -214748364.800 214748364.700 FORMAT "%13.3" /end CHARACTERISTIC
/begin CHARACTERISTIC LSU_stMonActv_C "" VALUE 0x8007A664 Val_Wu16 65535.00 OneToOne 0.00 65535.00 FORMAT "%8.2" /end CHARACTERISTIC
/begin CHARACTERISTIC LSU_stMonCmpReqd_C "" VALUE 0x8007A666 Val_Wu8 32.00 OneToOne 0.00 32.00 FORMAT "%5.2" EXTENDED_LIMITS 0.00 255.0 /end CHARACTERISTIC
/begin CHARACTERISTIC LSU_stMonMsk_C "" VALUE 0x8007A668 Val_Wu32 4294967295.00 OneToOne 0.00 4294967295.00 FORMAT "%13.2" /end CHARACTERISTIC
/begin CHARACTERISTIC LSU_stMskCmpChkO2_C "" VALUE 0x8007A66C Val_Wu32 4294967295.00 OneToOne 0.00 4294967295.00 FORMAT "%13.2" /end CHARACTERISTIC
/begin CHARACTERISTIC LSU_stPmpCtlDisbl_C "" VALUE 0x800639D0 Val_Wu8 255.0 OneToOne 0.00 255.0 FORMAT "%5.1" /end CHARACTERISTIC
/begin CHARACTERISTIC LSU_stSelPlausChkSig_C "" VALUE 0x8007A670 Val_Wu16 65535.00 OneToOne 0.00 65535.00 FORMAT "%8.2" /end CHARACTERISTIC
/begin CHARACTERISTIC LSU_stSrvTstDem_C "" VALUE 0x800637CC Val_Wu8 255.0 OneToOne 0.00 255.0 FORMAT "%5.1" /end CHARACTERISTIC
/begin CHARACTERISTIC LSU_stWireDiaPwrStgDiaEna_C "" VALUE 0x800637B0 Val_Wu8 1.000 OneToOne 0.00 1.000 FORMAT "%5.3" EXTENDED_LIMITS 0.00 255.0 /end CHARACTERISTIC
/begin CHARACTERISTIC LSU_swtAdap_C "" VALUE 0x800638FE Val_Wu8 1.000 OneToOne 0.00 1.000 FORMAT "%5.3" EXTENDED_LIMITS 0.00 255.0 /end CHARACTERISTIC
/begin CHARACTERISTIC LSU_tAirAdapActv_C "" VALUE 0x80063900 Val_Ws16 6553.500 Temp_Cels -3549.940 3003.560 FORMAT "%8.3" /end CHARACTERISTIC
/begin CHARACTERISTIC LSU_tExcMax_C "" VALUE 0x80063998 Val_Ws16 1200.000 Temp_Cels 99.96000 1299.960 FORMAT "%8.3" EXTENDED_LIMITS -3549.940 3003.560 /end CHARACTERISTIC
/begin CHARACTERISTIC LSU_tExcMin_C "" VALUE 0x8006399A Val_Ws16 1200.000 Temp_Cels 99.96000 1299.960 FORMAT "%8.3" EXTENDED_LIMITS -3549.940 3003.560 /end CHARACTERISTIC
/begin CHARACTERISTIC LSU_tHtCtlEna_C "" VALUE 0x8006399C Val_Ws16 1200.000 Temp_Cels 99.96000 1299.960 FORMAT "%8.3" EXTENDED_LIMITS -3549.940 3003.560 /end CHARACTERISTIC
/begin CHARACTERISTIC LSU_tiAdapFltIni_C "" VALUE 0x80063904 Val_Ws32 4294.9672940 TimeDelay_s 0.000002000000001 4294.9672960 FORMAT "%12.7" /end CHARACTERISTIC
/begin CHARACTERISTIC LSU_tiAdapFlt_C "" VALUE 0x80063908 Val_Ws32 4294.9672940 TimeDelay_s 0.000002000000001 4294.9672960 FORMAT "%12.7" /end CHARACTERISTIC
/begin CHARACTERISTIC LSU_tiDelIniVal_C "" VALUE 0x8006399E Val_Wu16 655350.0 Time_ms 0.00 655350.0 FORMAT "%8.1" /end CHARACTERISTIC
/begin CHARACTERISTIC LSU_tiDlyCmpChkO2_C "" VALUE 0x8007A672 Val_Wu16 655.3500 Time_s 0.00 655.3500 FORMAT "%8.4" /end CHARACTERISTIC
/begin CHARACTERISTIC LSU_tiDvtFlt_C "" VALUE 0x800637B4 Val_Ws32 4294.9672940 TimeDelay_s 0.000002000000001 4294.9672960 FORMAT "%12.7" /end CHARACTERISTIC
/begin CHARACTERISTIC LSU_tiEvalFltIni_C "" VALUE 0x8006390C Val_Ws32 4294.9672940 TimeDelay_s 0.000002000000001 4294.9672960 FORMAT "%12.7" /end CHARACTERISTIC
/begin CHARACTERISTIC LSU_tiEvalFlt_C "" VALUE 0x80063910 Val_Ws32 4294.9672940 TimeDelay_s 0.000002000000001 4294.9672960 FORMAT "%12.7" /end CHARACTERISTIC
/begin CHARACTERISTIC LSU_tiMaxDebVirtNernst_C "" VALUE 0x800637B8 Val_Ws16 655350.0 Time_ms -327680.0 327670.0 FORMAT "%8.1" /end CHARACTERISTIC
/begin CHARACTERISTIC LSU_tiO2CalcFlt_C "" VALUE 0x8007A674 Val_Ws32 4294.9672940 TimeDelay_s 0.000002000000001 4294.9672960 FORMAT "%12.7" /end CHARACTERISTIC
/begin CHARACTERISTIC LSU_tiO2Eval_C "" VALUE 0x8007A678 Val_Wu16 655.3500 Time_s 0.00 655.3500 FORMAT "%8.4" /end CHARACTERISTIC
/begin CHARACTERISTIC LSU_tiOpnLdTstActv_C "" VALUE 0x800637BA Val_Wu16 655.3500 Time_s 0.00 655.3500 FORMAT "%8.4" /end CHARACTERISTIC
/begin CHARACTERISTIC LSU_tiRiMeasDisa_C "" VALUE 0x800637BC Val_Wu16 655.3500 Time_s 0.00 655.3500 FORMAT "%8.4" /end CHARACTERISTIC
/begin CHARACTERISTIC LSU_tiSwt_CA "" VAL_BLK 0x8007A67A ValA_Wu16 655.3500 Time_s 0.00 655.3500 FORMAT "%8.4" NUMBER 1 /end CHARACTERISTIC
/begin CHARACTERISTIC LSU_tiWait1_CA "" VAL_BLK 0x8007A67C ValA_Wu16 655.3500 Time_s 0.00 655.3500 FORMAT "%8.4" NUMBER 1 /end CHARACTERISTIC
/begin CHARACTERISTIC LSU_tiWait2_CA "" VAL_BLK 0x8007A67E ValA_Wu16 655.3500 Time_s 0.00 655.3500 FORMAT "%8.4" NUMBER 1 /end CHARACTERISTIC
/begin CHARACTERISTIC LSU_tiWait3_CA "" VAL_BLK 0x8007A680 ValA_Wu16 655.3500 Time_s 0.00 655.3500 FORMAT "%8.4" NUMBER 1 /end CHARACTERISTIC
/begin CHARACTERISTIC LSU_tLowLim_CUR "" CURVE 0x800639A0 Cur_Xs16Ws16 300.0000 Temp_Cels 499.9600 799.9600 FORMAT "%8.4" EXTENDED_LIMITS -3549.940 3003.560
 /begin AXIS_DESCR STD_AXIS BattU_u Volt_Batt 5 0.00 15000.00 FORMAT "%8.2" EXTENDED_LIMITS -655360.0 655340.0 DEPOSIT ABSOLUTE /end AXIS_DESCR
/end CHARACTERISTIC
/begin CHARACTERISTIC LSU_tRiMinDiag_C "" VALUE 0x800637BE Val_Ws16 6553.500 Temp_Cels -3549.940 3003.560 FORMAT "%8.3" /end CHARACTERISTIC
/begin CHARACTERISTIC LSU_tRiSetP_C "" VALUE 0x800639B6 Val_Ws16 1200.000 Temp_Cels 99.96000 1299.960 FORMAT "%8.3" EXTENDED_LIMITS -3549.940 3003.560 /end CHARACTERISTIC
/begin CHARACTERISTIC LSU_tUpLim_CUR "" CURVE 0x800639B8 Cur_Xs16Ws16 300.0000 Temp_Cels 499.9600 799.9600 FORMAT "%8.4" EXTENDED_LIMITS -3549.940 3003.560
 /begin AXIS_DESCR STD_AXIS BattU_u Volt_Batt 5 0.00 15000.00 FORMAT "%8.2" EXTENDED_LIMITS -655360.0 655340.0 DEPOSIT ABSOLUTE /end AXIS_DESCR
/end CHARACTERISTIC
/begin CHARACTERISTIC LSU_uBattMin_C "" VALUE 0x800637C0 Val_Ws16 12500.00 Volt_Batt -500.0000 12000.00 FORMAT "%8.2" EXTENDED_LIMITS -655360.0 655340.0 /end CHARACTERISTIC
/begin CHARACTERISTIC LSU_uO2OpnLdNernstMax_C "" VALUE 0x800637C2 Val_Ws16 5000.000 Volt 0.00 5000.000 FORMAT "%8.3" EXTENDED_LIMITS -6553.600 6553.400 /end CHARACTERISTIC
/begin CHARACTERISTIC LSU_uO2OpnLdNernstMin_C "" VALUE 0x800637C4 Val_Ws16 7000.000 Volt -2000.000 5000.000 FORMAT "%8.3" EXTENDED_LIMITS -6553.600 6553.400 /end CHARACTERISTIC
/begin CHARACTERISTIC LSU_uO2OpnLdVirtGndMax_C "" VALUE 0x800637C6 Val_Ws16 5100.000 Volt -100.0000 5000.000 FORMAT "%8.3" EXTENDED_LIMITS -6553.600 6553.400 /end CHARACTERISTIC
/begin CHARACTERISTIC LSU_uO2OpnLdVirtGndMin_C "" VALUE 0x800637C8 Val_Ws16 5500.000 Volt -500.0000 5000.000 FORMAT "%8.3" EXTENDED_LIMITS -6553.600 6553.400 /end CHARACTERISTIC
/begin CHARACTERISTIC LSU_uRiOpnLdTstMax_C "" VALUE 0x800637CA Val_Ws16 5200.000 Volt 0.00 5200.000 FORMAT "%8.3" EXTENDED_LIMITS -6553.600 6553.400 /end CHARACTERISTIC
/begin CHARACTERISTIC LSU_volMinFl_C "" VALUE 0x8007A682 Val_Ws16 300.0000 Fl_Half_L 0.00 300.0000 FORMAT "%8.4" EXTENDED_LIMITS -16384.00 16383.50 /end CHARACTERISTIC
/begin CHARACTERISTIC MeUn_CrntCtlDT1.T1_C "Klasse für DT1-Stromreglerparameter/" VALUE 0x800639E0 Val_Ws32 4294.9672940 TimeDelay_s 0.000002000000001 4294.9672960 FORMAT "%12.7" /end CHARACTERISTIC
/begin CHARACTERISTIC MeUn_CrntCtlDT1.Kd_C "Klasse für DT1-Stromreglerparameter/" VALUE 0x800639E4 Val_Ws32 65535.9999847 Kd -32768.0000000 32767.9999847 FORMAT "%13.7" /end CHARACTERISTIC
/begin CHARACTERISTIC MeUn_CrntCtlI.Ki_C "Klasse für Parameter I-Glied/" VALUE 0x80063ABC Val_Ws32 244.140624943 Ki_curr2fact -122.070312500 122.070312443 FORMAT "%13.9" /end CHARACTERISTIC
/begin CHARACTERISTIC MeUn_CrntCtlI.KiPos_C "Klasse für Parameter I-Glied/" VALUE 0x80063AC0 Val_Ws32 244.140624943 Ki_curr2fact -122.070312500 122.070312443 FORMAT "%13.9" /end CHARACTERISTIC
/begin CHARACTERISTIC MeUn_CrntCtlI.KiNeg_C "Klasse für Parameter I-Glied/" VALUE 0x80063AC4 Val_Ws32 244.140624943 Ki_curr2fact -122.070312500 122.070312443 FORMAT "%13.9" /end CHARACTERISTIC
/begin CHARACTERISTIC MeUn_CrntCtlI.WinPos_C "Klasse für Parameter I-Glied/" VALUE 0x80063AC8 Val_Ws32 4294967295.00 Curr -2147483648.00 2147483647.00 FORMAT "%13.2" /end CHARACTERISTIC
/begin CHARACTERISTIC MeUn_CrntCtlI.WinNeg_C "Klasse für Parameter I-Glied/" VALUE 0x80063ACC Val_Ws32 4294967295.00 Curr -2147483648.00 2147483647.00 FORMAT "%13.2" /end CHARACTERISTIC
/begin CHARACTERISTIC MeUn_ctRot_C "maximale Anzahl Funktionsaufrufe der Rotation" VALUE 0x80063AA4 Val_Wu8 10.00 OneToOne 0.00 10.00 FORMAT "%5.2" EXTENDED_LIMITS 0.00 255.0 /end CHARACTERISTIC
/begin CHARACTERISTIC MeUn_facCrntCtlInit_CUR "Initialisierungsfaktor für I-Anteil des Stromreglers als Funktion der Systemtemperatur" CURVE 0x80063AD0 Cur_Xs16Ws16 2.000000 Fact 0.00 2.000000 FORMAT "%8.6" EXTENDED_LIMITS -4.000000 3.999878
 /begin AXIS_DESCR STD_AXIS FuelT_tFlSys Temp_Cels 6 -50.14000 149.8600 FORMAT "%8.4" EXTENDED_LIMITS -3549.940 3003.560 DEPOSIT ABSOLUTE /end AXIS_DESCR
/end CHARACTERISTIC
/begin CHARACTERISTIC MeUn_facCrntCtlMax_C "maximaler I-Anteil" VALUE 0x80063AEA Val_Ws16 1.000000 Fact 1.000000 2.000000 FORMAT "%8.6" EXTENDED_LIMITS -4.000000 3.999878 /end CHARACTERISTIC
/begin CHARACTERISTIC MeUn_facCrntCtlMin_C "minimaler I-Anteil" VALUE 0x80063AEC Val_Ws16 0.5000000 Fact 0.5000000 1.000000 FORMAT "%8.6" EXTENDED_LIMITS -4.000000 3.999878 /end CHARACTERISTIC
/begin CHARACTERISTIC MeUn_iCnvFlowRate_CUR "Kennlinie zur Umrechnung von Volumenstrom nach Strom" CURVE 0x80063AEE Cur_Xs16Ws16 5000.000 Curr 0.00 5000.000 FORMAT "%8.3" EXTENDED_LIMITS -32768.00 32767.00
 /begin AXIS_DESCR STD_AXIS MeUn_dvolSet Qp_mm3_sec 10 -10000.00 50000.00 FORMAT "%8.2" EXTENDED_LIMITS -327680.0 327670.0 DEPOSIT ABSOLUTE /end AXIS_DESCR
/end CHARACTERISTIC
/begin CHARACTERISTIC MeUn_iLin_CUR "Analogeingang, Linearisierungskennlinie" CURVE 0x800639E8 Cur_Xs16Ws16 5000.000 Curr 0.00 5000.000 FORMAT "%8.3" EXTENDED_LIMITS -32768.00 32767.00
 /begin AXIS_DESCR STD_AXIS MeUn_uRaw_mp Volt 2 0.00 5200.000 FORMAT "%8.3" EXTENDED_LIMITS -6553.600 6553.400 DEPOSIT ABSOLUTE /end AXIS_DESCR
/end CHARACTERISTIC
/begin CHARACTERISTIC MeUn_iSetMin_C "Sollstrom bei elektrischer Abschaltung der Zumesseinheit" VALUE 0x80063B18 Val_Ws16 65535.00 Curr -32768.00 32767.00 FORMAT "%8.2" /end CHARACTERISTIC
/begin CHARACTERISTIC MeUn_nDiffMax_C "maximale Differenz zwischen gefilterter Drehzahl für Kennlinie und aktueller Drehzahl um neuen Drehzahlwert zu übernehmen" VALUE 0x800639F2 Val_Ws16 6000.000 EngN 0.00 6000.000 FORMAT "%8.3" EXTENDED_LIMITS -16384.00 16383.50 /end CHARACTERISTIC
/begin CHARACTERISTIC MeUn_pActrPrt_C "Raildruckschwelle für die Freigabe der Stellerschutzfunktion" VALUE 0x80063B1A Val_Ws16 5276.800 Pres_Rail -3276.800 2000.000 FORMAT "%5.3" EXTENDED_LIMITS -3276.800 3276.700 /end CHARACTERISTIC
/begin CHARACTERISTIC MeUn_pFlowOfFl_C "Raildruckschwelle zum Rückschalten auf Stellwertvorgabe der Hochdruckregelung" VALUE 0x80063B1C Val_Ws16 5276.800 Pres_Rail -3276.800 2000.000 FORMAT "%5.3" EXTENDED_LIMITS -3276.800 3276.700 /end CHARACTERISTIC
/begin CHARACTERISTIC MeUn_PwmOut.rMin_C "Klasse für Parameter Ausgangstastverhältnis/" VALUE 0x800639F4 Kw_Ws16 100.0000 DtyCyc 0.00 100.0000 FORMAT "%8.4" EXTENDED_LIMITS -327.6800 327.6700 /end CHARACTERISTIC
/begin CHARACTERISTIC MeUn_PwmOut.rMax_C "Klasse für Parameter Ausgangstastverhältnis/" VALUE 0x800639F6 Kw_Ws16 100.0000 DtyCyc 0.00 100.0000 FORMAT "%8.4" EXTENDED_LIMITS -327.6800 327.6700 /end CHARACTERISTIC
/begin CHARACTERISTIC MeUn_PwmOut.tiBtwTstSCB_C "Klasse für Parameter Ausgangstastverhältnis/" VALUE 0x800639F8 Kw_Ws16 1000.000 Time_ms 0.00 1000.000 FORMAT "%8.3" EXTENDED_LIMITS -327680.0 327670.0 /end CHARACTERISTIC
/begin CHARACTERISTIC MeUn_PwmOut.tiBtwTstOT_C "Klasse für Parameter Ausgangstastverhältnis/" VALUE 0x800639FA Kw_Ws16 327.6700 Time_s 0.00 327.6700 FORMAT "%8.4" EXTENDED_LIMITS -327.6800 327.6700 /end CHARACTERISTIC
/begin CHARACTERISTIC MeUn_PwmOut.numTstMax_C "Klasse für Parameter Ausgangstastverhältnis/" VALUE 0x800639FC Kw_Wu16 65535.00 OneToOne 0.00 65535.00 FORMAT "%8.2" /end CHARACTERISTIC
/begin CHARACTERISTIC MeUn_PwmOut.swtBattCor_C "Klasse für Parameter Ausgangstastverhältnis/" VALUE 0x800639FE Kw_Wu8 1.000 OneToOne 0.00 1.000 FORMAT "%5.3" EXTENDED_LIMITS 0.00 255.0 /end CHARACTERISTIC
/begin CHARACTERISTIC MeUn_PwmOut.swtPsInv_C "Klasse für Parameter Ausgangstastverhältnis/" VALUE 0x800639FF Kw_Wu8 255.0 OneToOne 0.00 255.0 FORMAT "%5.1" /end CHARACTERISTIC
/begin CHARACTERISTIC MeUn_resCoil_C "Widerstandswert der Spule für die Zumesseinheit" VALUE 0x80063A00 Val_Ws16 5000.000 Resist_1 0.00 5000.000 FORMAT "%8.3" EXTENDED_LIMITS -32768.00 32767.00 /end CHARACTERISTIC
/begin CHARACTERISTIC MeUn_rLim_CUR "PWM Signalbegrenzung in Abhängigkeit der Temperatur" CURVE 0x80063AA6 Cur_Xs16Ws16 655.3500 DtyCyc -327.6800 327.6700 FORMAT "%8.4"
 /begin AXIS_DESCR STD_AXIS FuelT_tFlSys Temp_Cels 2 -3549.940 3003.560 FORMAT "%8.3" DEPOSIT ABSOLUTE /end AXIS_DESCR
/end CHARACTERISTIC
/begin CHARACTERISTIC MeUn_rMaxDty_C "Max-Wert, Ausgangstastverhältnis" VALUE 0x80063A02 Val_Ws16 100.0000 DtyCyc 0.00 100.0000 FORMAT "%8.4" EXTENDED_LIMITS -327.6800 327.6700 /end CHARACTERISTIC
/begin CHARACTERISTIC MeUn_rPerUn_C "Statuswort zur Spezifikation des Abschaltverhaltens der Endstufenfehlerdiagnose Zumesseinheit" VALUE 0x80063A04 Val_Ws16 32767.00 OneToOne 0.00 32767.00 FORMAT "%8.2" EXTENDED_LIMITS -32768.00 32767.00 /end CHARACTERISTIC
/begin CHARACTERISTIC MeUn_rRotEnd_C "Endwert des Tastverhältnisses während der Rotation" VALUE 0x80063AB0 Val_Ws16 427.6800 DtyCyc -327.6800 100.0000 FORMAT "%8.4" EXTENDED_LIMITS -327.6800 327.6700 /end CHARACTERISTIC
/begin CHARACTERISTIC MeUn_rRotStrt_C "Startwert des Tastverhältnisses während der Rotation" VALUE 0x80063AB2 Val_Ws16 427.6800 DtyCyc -327.6800 100.0000 FORMAT "%8.4" EXTENDED_LIMITS -327.6800 327.6700 /end CHARACTERISTIC
/begin CHARACTERISTIC MeUn_rSetLin_CUR "Linearisierungskurve des Tastverhältnisses der Zumesseinheit" CURVE 0x80063A06 Cur_Xs16Ws16 100.0000 DtyCyc 0.00 100.0000 FORMAT "%8.4" EXTENDED_LIMITS -327.6800 327.6700
 /begin AXIS_DESCR STD_AXIS MeUn_rSet_mp DtyCyc 4 -327.6800 327.6700 FORMAT "%8.4" DEPOSIT ABSOLUTE /end AXIS_DESCR
/end CHARACTERISTIC
/begin CHARACTERISTIC MeUn_SRC.uMin_C "Klasse für Vorgabewerte Analogeingang Signal Range Check/" VALUE 0x80063A18 Kw_Ws16 5200.000 Volt 0.00 5200.000 FORMAT "%8.3" EXTENDED_LIMITS -6553.600 6553.400 /end CHARACTERISTIC
/begin CHARACTERISTIC MeUn_SRC.uMax_C "Klasse für Vorgabewerte Analogeingang Signal Range Check/" VALUE 0x80063A1A Kw_Ws16 5200.000 Volt 0.00 5200.000 FORMAT "%8.3" EXTENDED_LIMITS -6553.600 6553.400 /end CHARACTERISTIC
/begin CHARACTERISTIC MeUn_stLvl_C "Invertierungsparameter der PWM Endstufe für die Zumesseinheit" VALUE 0x80063A1C Val_Wu8 1.000 OneToOne 0.00 1.000 FORMAT "%5.3" EXTENDED_LIMITS 0.00 255.0 /end CHARACTERISTIC
/begin CHARACTERISTIC MeUn_stPwrStgActv_C "Invertierungsparameter der PWM Endstufe" VALUE 0x80063A1D Val_Wu8 255.0 OneToOne 0.00 255.0 FORMAT "%5.1" /end CHARACTERISTIC
/begin CHARACTERISTIC MeUn_stPwrStgDia_C "Statuswort zur Spezifikation des Abschaltverhaltens der Endstufenfehlerdiagnose Zumesseinheit" VALUE 0x80063A1E Val_Wu8 255.0 OneToOne 0.00 255.0 FORMAT "%5.1" /end CHARACTERISTIC
/begin CHARACTERISTIC MeUn_stRotActv_C "Aktivierungsschalter der Rotation" VALUE 0x80063AB4 Val_Wu8 1.000 OneToOne 0.00 1.000 FORMAT "%5.3" EXTENDED_LIMITS 0.00 255.0 /end CHARACTERISTIC
/begin CHARACTERISTIC MeUn_tiCrntCtlInit_C "maximale Zeitdauer der Initialisierungsphase" VALUE 0x80063B1E Val_Ws16 327670.0 Time_ms 0.00 327670.0 FORMAT "%8.1" EXTENDED_LIMITS -327680.0 327670.0 /end CHARACTERISTIC
/begin CHARACTERISTIC MeUn_tiFlt1PT1_C "PT1 Filter Zeitkonstante für Strom-Istwert" VALUE 0x80063B20 Val_Ws32 4294.9672940 TimeDelay_s 0.000002000000001 4294.9672960 FORMAT "%12.7" /end CHARACTERISTIC
/begin CHARACTERISTIC MeUn_tiFlt2PT1_C "PT1 Filter Zeitkonstante für Strom-Sollwert" VALUE 0x80063B24 Val_Ws32 4294.9672940 TimeDelay_s 0.000002000000001 4294.9672960 FORMAT "%12.7" /end CHARACTERISTIC
/begin CHARACTERISTIC MeUn_tiFltPT1Init_C "PT1 Filter Zeitkonstante während Initialisierungsphase des Stromreglers" VALUE 0x80063B28 Val_Ws32 4294.9672940 TimeDelay_s 0.000002000000001 4294.9672960 FORMAT "%12.7" /end CHARACTERISTIC
/begin CHARACTERISTIC MeUn_tiPerUBattHi_C "Periodendauer der MeUn-PWM-Endstufe bei erhöhter Batteriespannung" VALUE 0x80063A20 Val_Ws16 2.000000 Period 1.000000 3.000000 FORMAT "%8.6" EXTENDED_LIMITS -3276.800 3276.700 /end CHARACTERISTIC
/begin CHARACTERISTIC MeUn_tiPer_CUR "Kennlinie für Periodendauer der PWM-Endstufe" CURVE 0x80063A22 Cur_Xs16Ws16 6.400000 Period 0.1000000 6.500000 FORMAT "%8.6" EXTENDED_LIMITS -3276.800 3276.700
 /begin AXIS_DESCR STD_AXIS MeUn_nDiffRef_mp EngN 30 -16384.00 16383.50 FORMAT "%8.2" DEPOSIT ABSOLUTE /end AXIS_DESCR
/end CHARACTERISTIC
/begin CHARACTERISTIC MeUn_tiPh_C "Kennlinie für Periodendauer der PWM-Endstufe" VALUE 0x80063A9C Val_Ws16 3276.700 Period 0.00 3276.700 FORMAT "%8.3" EXTENDED_LIMITS -3276.800 3276.700 /end CHARACTERISTIC
/begin CHARACTERISTIC MeUn_tiRotDel_C "Bestromungszeit während der Rotation" VALUE 0x80063AB6 Val_Wu16 65540.00 Time_ms 0.00 65540.00 FORMAT "%8.2" EXTENDED_LIMITS 0.00 655350.0 /end CHARACTERISTIC
/begin CHARACTERISTIC MeUn_tiRotWait_C "Pausenzeit während der Rotation" VALUE 0x80063AB8 Val_Wu16 65540.00 Time_ms 0.00 65540.00 FORMAT "%8.2" EXTENDED_LIMITS 0.00 655350.0 /end CHARACTERISTIC
/begin CHARACTERISTIC MeUn_uBattHi_C "Oberer Spannungspegel, ab dem die Frequenz der MeUn auf einen anderen Wert umgeschaltet wird" VALUE 0x80063A9E Val_Ws16 1015360. Volt_Batt -655360.0 360000.0 FORMAT "%8.1" EXTENDED_LIMITS -655360.0 655340.0 /end CHARACTERISTIC
/begin CHARACTERISTIC MeUn_uBattLo_C "Unterer Spannungspegel, ab dem die Frequenz der MeUn auf den normalen Wert umgeschaltet wird" VALUE 0x80063AA0 Val_Ws16 1310700. Volt_Batt -655360.0 655340.0 FORMAT "%8.1" /end CHARACTERISTIC
/begin CHARACTERISTIC MoCADC_ctDebCmp_C "Fehlerzählerendwert für Vergleich mit unabhängigem AD Wandler" VALUE 0x80044D38 Val_Wu8 255.0 OneToOne 0.00 255.0 FORMAT "%5.1" /end CHARACTERISTIC
/begin CHARACTERISTIC MoCADC_ctDebTst_C "Fehlerzählerendwert der Testspanunngs - Prüfung" VALUE 0x80044D39 Val_Wu8 255.0 OneToOne 0.00 255.0 FORMAT "%5.1" /end CHARACTERISTIC
/begin CHARACTERISTIC MoCADC_ctDebVltgRatio_C "Fehlerzählerendwert der Ratiometriekorrekturfakor Plausibilisierung" VALUE 0x80044D3A Val_Wu8 255.0 OneToOne 0.00 255.0 FORMAT "%5.1" /end CHARACTERISTIC
/begin CHARACTERISTIC MoCADC_ctDiagCmp_C "" VALUE 0x80044D3B Val_Wu8 255.0 OneToOne 0.00 255.0 FORMAT "%5.1" /end CHARACTERISTIC
/begin CHARACTERISTIC MoCADC_ctRstCmp_C "Anzahl zulässiger Resets bei Fehler im Vergleich mit unabhängigem AD Wandler" VALUE 0x80044D3C Val_Wu8 255.0 OneToOne 0.00 255.0 FORMAT "%5.1" /end CHARACTERISTIC
/begin CHARACTERISTIC MoCADC_ctRstTst_C "Anzahl zulässiger Resets bei Fehler in Testspanunngs - Prüfung" VALUE 0x80044D3D Val_Wu8 255.0 OneToOne 0.00 255.0 FORMAT "%5.1" /end CHARACTERISTIC
/begin CHARACTERISTIC MoCADC_ctRstVltgRatio_C "Anzahl zulässiger Resets bei Fehler in Ratiometriekorrekturfakor Plausibilisierung" VALUE 0x80044D3E Val_Wu8 255.0 OneToOne 0.00 255.0 FORMAT "%5.1" /end CHARACTERISTIC
/begin CHARACTERISTIC MoCADC_ctStyADC_C "Zählerendwert für Stationärerkennung für Vergleich mit unabhängigem AD Wandler" VALUE 0x80044D3F Val_Wu8 255.0 OneToOne 0.00 255.0 FORMAT "%5.1" /end CHARACTERISTIC
/begin CHARACTERISTIC MoCADC_facVltgRatioMax_C "Maximal zulässiger Wert für den Ratiometriekorrekturfaktor" VALUE 0x80044D40 Val_Wu16 63.99902 Mo_fac_q0p00098 0.00 63.99902 FORMAT "%8.5" /end CHARACTERISTIC
/begin CHARACTERISTIC MoCADC_facVltgRatioMin_C "Minimal zulässiger Wert für den Ratiometriekorrekturfaktor" VALUE 0x80044D42 Val_Wu16 63.99902 Mo_fac_q0p00098 0.00 63.99902 FORMAT "%8.5" /end CHARACTERISTIC
/begin CHARACTERISTIC MoCADC_uMaxDiff_C "Maximal zulässige Differenz zwischen den Ergebnissen der beiden ADCs" VALUE 0x80044D44 Val_Wu8 4980. Mo_u_mV_q19p53 0.00 4980. FORMAT "%5.0" /end CHARACTERISTIC
/begin CHARACTERISTIC MoCADC_uSty_C "" VALUE 0x80044D45 Val_Wu8 4980. Mo_u_mV_q19p53 0.00 4980. FORMAT "%5.0" /end CHARACTERISTIC
/begin CHARACTERISTIC MoCADC_uTstMax_C "Maximale Testspannung im ADC-Test" VALUE 0x80044D46 Val_Ws16 319995.1 Mo_u_mV_q4p88 -160000.0 159995.1 FORMAT "%8.1" /end CHARACTERISTIC
/begin CHARACTERISTIC MoCADC_uTstMin_C "Minimale Testspannung im ADC-Test" VALUE 0x80044D48 Val_Ws16 319995.1 Mo_u_mV_q4p88 -160000.0 159995.1 FORMAT "%8.1" /end CHARACTERISTIC
/begin CHARACTERISTIC MoCGPTA_numErr_C "" VALUE 0x80044D4A Val_Wu8 255.0 OneToOne 0.00 255.0 FORMAT "%5.1" /end CHARACTERISTIC
/begin CHARACTERISTIC MoCGPTA_tiDvtMax_C "" VALUE 0x80044D4C Val_Wu16 65535.00 OneToOne 0.00 65535.00 FORMAT "%8.2" /end CHARACTERISTIC
/begin CHARACTERISTIC MoCMem_ctDebErrChkRAM_C "Fehlertoleranzschwelle für Doppelablage und zyklischen RAM-Test" VALUE 0x80044D4E Val_Wu8 255.0 OneToOne 0.00 255.0 FORMAT "%5.1" /end CHARACTERISTIC
/begin CHARACTERISTIC MoCMem_ctDebErrChkROM_C "Fehlertoleranzschwelle für zyklischen ROM-Test" VALUE 0x80044D4F Val_Wu8 255.0 OneToOne 0.00 255.0 FORMAT "%5.1" /end CHARACTERISTIC
/begin CHARACTERISTIC MoCMem_ctDebHealChkRAM_C "Toleranzschwelle für Heilungszähler bei Doppelablage und zyklischem RAM-Test" VALUE 0x80044D50 Val_Wu8 255.0 OneToOne 0.00 255.0 FORMAT "%5.1" /end CHARACTERISTIC
/begin CHARACTERISTIC MoCMem_ctDebHealChkROM_C "Toleranzschwelle für Heilungszähler bei zyklischem ROM-Test" VALUE 0x80044D51 Val_Wu8 255.0 OneToOne 0.00 255.0 FORMAT "%5.1" /end CHARACTERISTIC
/begin CHARACTERISTIC MoCPCP_numErr_C "Fehlertoleranzschwelle für CRC-Prüfsummenfehler im PCP-Code" VALUE 0x80044D52 Val_Wu8 255.0 OneToOne 0.00 255.0 FORMAT "%5.1" /end CHARACTERISTIC
/begin CHARACTERISTIC MoCPCP_stEnaMFTst_CW "Aktivierung des Überwachungsfunktionstest für die PCP-Überwachung (PCP-Befehlstest)" VALUE 0x80044D53 Val_Wu8 255.0 OneToOne 0.00 255.0 FORMAT "%5.1" /end CHARACTERISTIC
/begin CHARACTERISTIC MoCPCP_tiHeal_C "Toleranzschwelle für Heilungszähler bei CRC-Prüfsummenfehler im PCP-Code" VALUE 0x80044D54 Val_Wu8 255.0 OneToOne 0.00 255.0 FORMAT "%5.1" /end CHARACTERISTIC
/begin CHARACTERISTIC MoCSOP_ctDebPSDia_C "Maximale Anzahl der Endstufentests" VALUE 0x80044D56 Val_Wu8 255.0 OneToOne 0.00 255.0 FORMAT "%5.1" /end CHARACTERISTIC
/begin CHARACTERISTIC MoCSOP_ctDebSOPTst_C "Maximale Anzahl der Wiederholungen des Abschaltpfadtests (Zeitüberwachung des Abschaltpfadtests)" VALUE 0x80044D57 Val_Wu8 255.0 OneToOne 0.00 255.0 FORMAT "%5.1" /end CHARACTERISTIC
/begin CHARACTERISTIC MoCSOP_stMMErrReac_CW "" VALUE 0x80044D58 Val_Wu8 255.0 OneToOne 0.00 255.0 FORMAT "%5.1" /end CHARACTERISTIC
/begin CHARACTERISTIC MoCSOP_stSOPTstActv_CW "Status-Bits für Auswahl eines bestimmten Abschaltpfadtests" VALUE 0x80044D59 Val_Wu8 255.0 OneToOne 0.00 255.0 FORMAT "%5.1" /end CHARACTERISTIC
/begin CHARACTERISTIC MoCSOP_stSWResetDem_CW "Status-Bit für Software-Reset Anforderung bei Abschaltpfadtest-Fehler" VALUE 0x80044D5A Val_Wu8 255.0 OneToOne 0.00 255.0 FORMAT "%5.1" /end CHARACTERISTIC
/begin CHARACTERISTIC MoFAcs_facAltTComp_CUR "" CURVE 0x80044D68 Cur_Xu8Wu8 99.61 Mo_r_prc_q0p39 0.00 99.61 FORMAT "%5.2"
 /begin AXIS_DESCR STD_AXIS MoFTEng_tEng Mo_t_DegC_q0p8o48 4 -48.00 156.0 FORMAT "%5.1" DEPOSIT ABSOLUTE /end AXIS_DESCR
/end CHARACTERISTIC
/begin CHARACTERISTIC MoFAcs_rTrqAC_CUR "" CURVE 0x80044D71 Cur_Xu8Wu8 99.61 Mo_r_prc_q0p39 0.00 99.61 FORMAT "%5.2"
 /begin AXIS_DESCR STD_AXIS MoFESpd_nEng Mo_n_rpm_q40p0 4 0.00 10200. FORMAT "%5.0" DEPOSIT ABSOLUTE /end AXIS_DESCR
/end CHARACTERISTIC
/begin CHARACTERISTIC MoFAcs_rTrqAlt_CUR "" CURVE 0x80044D7A Cur_Xu8Wu8 99.61 Mo_r_prc_q0p39 0.00 99.61 FORMAT "%5.2"
 /begin AXIS_DESCR STD_AXIS MoFESpd_nEng Mo_n_rpm_q40p0 4 0.00 10200. FORMAT "%5.0" DEPOSIT ABSOLUTE /end AXIS_DESCR
/end CHARACTERISTIC
/begin CHARACTERISTIC MoFAcs_rTrqStaPmp_C "" VALUE 0x80044D83 Val_Wu8 99.61 Mo_r_prc_q0p39 0.00 99.61 FORMAT "%5.2" /end CHARACTERISTIC
/begin CHARACTERISTIC MoFAcs_swtTraType_C "" VALUE 0x80044D84 Val_Wu8 255.0 OneToOne 0.00 255.0 FORMAT "%5.1" /end CHARACTERISTIC
/begin CHARACTERISTIC MoFAcs_trqARSMax_C "" VALUE 0x80044D86 Val_Ws16 6553.500 Mo_trq_nm_q0p1 -3276.800 3276.700 FORMAT "%8.3" /end CHARACTERISTIC
/begin CHARACTERISTIC MoFAcs_trqARSMax_CUR "" CURVE 0x80044D88 Cur_Xs16Ws16 6553.500 Mo_trq_nm_q0p1 -3276.800 3276.700 FORMAT "%8.3"
 /begin AXIS_DESCR STD_AXIS VehV_v Vel 4 -327.6800 327.6700 FORMAT "%8.4" DEPOSIT ABSOLUTE /end AXIS_DESCR
/end CHARACTERISTIC
/begin CHARACTERISTIC MoFAcs_trqLosTra_C "" VALUE 0x80044D9A Val_Ws16 6553.500 Mo_trq_nm_q0p1 -3276.800 3276.700 FORMAT "%8.3" /end CHARACTERISTIC
/begin CHARACTERISTIC MoFAPP_ctDeb_C "Fehlerzeit bei zueinander unplausiblen Fahrpedalsignalen in der Überwachung" VALUE 0x80044D5C Val_Wu8 10200. Mo_ti40ms_ms_q40p0 0.00 10200. FORMAT "%5.0" /end CHARACTERISTIC
/begin CHARACTERISTIC MoFAPP_ctRst_C "" VALUE 0x80044D5D Val_Wu8 255.0 OneToOne 0.00 255.0 FORMAT "%5.1" /end CHARACTERISTIC
/begin CHARACTERISTIC MoFAPP_uFL_C "Vollgas- Sollwert- Schwelle" VALUE 0x80044D5E Val_Wu8 4980. Mo_u_mV_q19p53 0.00 4980. FORMAT "%5.0" /end CHARACTERISTIC
/begin CHARACTERISTIC MoFAPP_uLoLim_C "" VALUE 0x80044D5F Val_Wu8 4980. Mo_u_mV_q19p53 0.00 4980. FORMAT "%5.0" /end CHARACTERISTIC
/begin CHARACTERISTIC MoFAPP_uMaxDiffFL_C "Maximal zulässige Differenz zwischen den Fahrpedalsignalen oberhalb Volllastschwelle" VALUE 0x80044D60 Val_Wu8 4980. Mo_u_mV_q19p53 0.00 4980. FORMAT "%5.0" /end CHARACTERISTIC
/begin CHARACTERISTIC MoFAPP_uMaxDiffPL_C "Maximal zulässige Differenz zwischen den Fahrpedalsignalen unterhalb Volllastschwelle" VALUE 0x80044D61 Val_Wu8 4980. Mo_u_mV_q19p53 0.00 4980. FORMAT "%5.0" /end CHARACTERISTIC
/begin CHARACTERISTIC MoFASD_tiT1_C "PT1 Filterzeitkonstante in der Ruckeldämpferüberwachung" VALUE 0x80044D62 Val_Wu16 5080.0000000 Mo_tiRec40ms_ms_b10240 40.000000000 5120.0000000 FORMAT "%12.7" EXTENDED_LIMITS 0.15625238422 10240.000000 /end CHARACTERISTIC
/begin CHARACTERISTIC MoFASD_trqFltMax_C "Maximaler Stellbereich der gefilterten Ruckeldämpferstellgröße in der Überwachung" VALUE 0x80044D64 Val_Ws16 120.0000 Mo_trq_nm_q0p1 0.00 120.0000 FORMAT "%8.4" EXTENDED_LIMITS -3276.800 3276.700 /end CHARACTERISTIC
/begin CHARACTERISTIC MoFASD_trqMax_C "Maximaler Stellbereich der Ruckeldämpferstellgröße in der Überwachung" VALUE 0x80044D66 Val_Ws16 120.0000 Mo_trq_nm_q0p1 0.00 120.0000 FORMAT "%8.4" EXTENDED_LIMITS -3276.800 3276.700 /end CHARACTERISTIC
/begin CHARACTERISTIC MoFClth_ctDeb_C "Entprellzählerschwelle zum Kupplungszustand" VALUE 0x80044D9C Val_Wu8 255.0 OneToOne 0.00 255.0 FORMAT "%5.1" /end CHARACTERISTIC
/begin CHARACTERISTIC MoFCoEng_tiT1_C "PT1 Zeitkonstante für negative Momentensprünge des zulässigen Moments" VALUE 0x80044D9D Val_Wu8 5080.00 Mo_tiRec40ms_ms_b10240 40.0000 5120.00 FORMAT "%7.2" EXTENDED_LIMITS 40.1569 10240.0 /end CHARACTERISTIC
/begin CHARACTERISTIC MoFCoOfs_rTrqPtdOfs_MAP "Kennfeld Ebene 2 Offset" MAP 0x80044D9E Map_Xu8Yu8Wu8 99.61 Mo_r_prc_q0p39 0.00 99.61 FORMAT "%5.2"
 /begin AXIS_DESCR STD_AXIS MoFCoOfs_rTrqPtd_mp Mo_r_prc_q0p39 8 0.00 99.61 FORMAT "%5.2" DEPOSIT ABSOLUTE /end AXIS_DESCR
 /begin AXIS_DESCR STD_AXIS MoFESpd_nEng Mo_n_rpm_q40p0 8 0.00 10200. FORMAT "%5.0" DEPOSIT ABSOLUTE /end AXIS_DESCR
/end CHARACTERISTIC
/begin CHARACTERISTIC MoFCoOfs_tiDel_C "Totzeit der Offsetberechnung in der Überwachung" VALUE 0x80044DF0 Val_Wu8 280.0 Mo_ti40ms_ms_q40p0 40.00 320.0 FORMAT "%5.1" EXTENDED_LIMITS 0.00 10200. /end CHARACTERISTIC
/begin CHARACTERISTIC MoFCoOfs_tiT1_C "Zeitkonstante PT1 Filter" VALUE 0x80044DF2 Val_Wu16 2008.0000000 Mo_tiRec40ms_ms_b10240 40.000000000 2048.0000000 FORMAT "%12.7" EXTENDED_LIMITS 0.15625238422 10240.000000 /end CHARACTERISTIC
/begin CHARACTERISTIC MoFCoVeh_facTrqComp_MAP "drehzahl- und fahrerwunschabhängiger Faktor für Verlustmomentkompensation" MAP 0x80044DF4 Map_Xs16Ys16Ws16 25599.61 Mo_r_prc_q0p39 -12800.00 12799.61 FORMAT "%8.2"
 /begin AXIS_DESCR STD_AXIS MoFESpd_nEng Mo_n_rpm_q40p0 6 0.00 10200. FORMAT "%5.0" DEPOSIT ABSOLUTE /end AXIS_DESCR
 /begin AXIS_DESCR STD_AXIS MoFCoVeh_trqVMD_mp Mo_trq_nm_q1p6 6 -52428.80 52427.20 FORMAT "%8.2" DEPOSIT ABSOLUTE /end AXIS_DESCR
/end CHARACTERISTIC
/begin CHARACTERISTIC MoFDrAs_ctDebACC_C "Zählwert für TurnOnDelay ACC" VALUE 0x80044E58 Val_Wu8 255.0 OneToOne 0.00 255.0 FORMAT "%5.1" /end CHARACTERISTIC
/begin CHARACTERISTIC MoFDrAs_ctDebCCtl_C "Entprellzeit für betätigte Bremse in der Funktionsüberwachung" VALUE 0x80044E59 Val_Wu8 255.0 OneToOne 0.00 255.0 FORMAT "%5.1" /end CHARACTERISTIC
/begin CHARACTERISTIC MoFDrAs_vACCMin_C "Vergleichswert Mindestgeschwindigkeit ACC" VALUE 0x80044E5A Val_Wu16 655.3500 Mo_v_kmh_q0p01 0.00 655.3500 FORMAT "%8.4" /end CHARACTERISTIC
/begin CHARACTERISTIC MoFDrAs_vCCtlMin_C "Vergleichswert Mindestgeschwindigkeit FGR" VALUE 0x80044E5C Val_Wu16 655.3500 Mo_v_kmh_q0p01 0.00 655.3500 FORMAT "%8.4" /end CHARACTERISTIC
/begin CHARACTERISTIC MoFDrDem_rThreshPrpMin_C "Rampenbeginn bei Verlustmomentberechnung" VALUE 0x80044E5E Val_Wu8 99.61 Mo_r_prc_q0p39 0.00 99.61 FORMAT "%5.2" /end CHARACTERISTIC
/begin CHARACTERISTIC MoFDrDem_rThreshPrp_C "Rampenende bei Verlustmomentberechnung" VALUE 0x80044E5F Val_Wu8 99.61 Mo_r_prc_q0p39 0.00 99.61 FORMAT "%5.2" /end CHARACTERISTIC
/begin CHARACTERISTIC MoFDrDem_rTrqEng_MAP "Fahrpedalkennfeld der Überwachungsfunktionen" MAP 0x80044E60 Map_Xu8Yu8Wu8 99.61 Mo_r_prc_q0p39 0.00 99.61 FORMAT "%5.2"
 /begin AXIS_DESCR STD_AXIS MoFESpd_nEng Mo_n_rpm_q40p0 8 0.00 10200. FORMAT "%5.0" DEPOSIT ABSOLUTE /end AXIS_DESCR
 /begin AXIS_DESCR STD_AXIS MoFDrDem_rAPP Mo_r_prc_q0p39 8 0.00 99.61 FORMAT "%5.2" DEPOSIT ABSOLUTE /end AXIS_DESCR
/end CHARACTERISTIC
/begin CHARACTERISTIC MoFDrDem_rTrqPTMax_C "" VALUE 0x80044EB2 Val_Wu16 655.3500 Mo_fac_q0p01 0.00 655.3500 FORMAT "%8.4" /end CHARACTERISTIC
/begin CHARACTERISTIC MoFDrDem_rTrqPTMin_C "" VALUE 0x80044EB4 Val_Wu16 655.3500 Mo_fac_q0p01 0.00 655.3500 FORMAT "%8.4" /end CHARACTERISTIC
/begin CHARACTERISTIC MoFDrDem_uAPPMax_C "" VALUE 0x80044EB6 Val_Wu8 4980. Mo_u_mV_q19p53 0.00 4980. FORMAT "%5.0" /end CHARACTERISTIC
/begin CHARACTERISTIC MoFDrDem_uAPPMin_C "" VALUE 0x80044EB7 Val_Wu8 4980. Mo_u_mV_q19p53 0.00 4980. FORMAT "%5.0" /end CHARACTERISTIC
/begin CHARACTERISTIC MoFESpd_ctDeb_C "Fehlerzählerendwert für Motordrehzahlvergleich in der Funktionsüberwachung" VALUE 0x80044EB8 Val_Wu8 255.0 OneToOne 0.00 255.0 FORMAT "%5.1" /end CHARACTERISTIC
/begin CHARACTERISTIC MoFESpd_ctRst_C "Anzahl zulässiger Resets bei Fehler im Motordrehzahlvergleich" VALUE 0x80044EB9 Val_Wu8 255.0 OneToOne 0.00 255.0 FORMAT "%5.1" /end CHARACTERISTIC
/begin CHARACTERISTIC MoFESpd_nDiffMax_C "Erlaubte Differenz zwischen berechneten Drehzahlen in Ebene 1 und Ebene 2" VALUE 0x80044EBA Val_Wu8 10200. Mo_n_rpm_q40p0 0.00 10200. FORMAT "%5.0" /end CHARACTERISTIC
/begin CHARACTERISTIC MoFESpd_nMin_C "Minimale Drehzahl in der Motordrehzahl-Überwachung" VALUE 0x80044EBB Val_Wu8 10200. Mo_n_rpm_q40p0 0.00 10200. FORMAT "%5.0" /end CHARACTERISTIC
/begin CHARACTERISTIC MoFESpd_phiMaxIni_C "Maximal zulässiger Winkeluhr-Stand während SyncIni Task zur Synchronisationsabbrucherkennung" VALUE 0x80044EBC Val_Wu16 65535.00 OneToOne 0.00 65535.00 FORMAT "%8.2" /end CHARACTERISTIC
/begin CHARACTERISTIC MoFExtInt_ctDebDCSMax_C "" VALUE 0x80044EBE Val_Wu8 255.0 OneToOne 0.00 255.0 FORMAT "%5.1" /end CHARACTERISTIC
/begin CHARACTERISTIC MoFExtInt_ctDebTSCMax_C "Maxwert des Entprellzählers für Verlängerung des Getriebeeingriffs, bis der Eingriff in der Ebene 1 ausgerampt worden ist" VALUE 0x80044EBF Val_Wu8 255.0 OneToOne 0.00 255.0 FORMAT "%5.1" /end CHARACTERISTIC
/begin CHARACTERISTIC MoFExtInt_st_C "Auswahl der Momentenebene der Eingangsmomente (indiziert/Kupplung)" VALUE 0x80044EC0 Val_Wu8 255.0 OneToOne 0.00 255.0 FORMAT "%5.1" /end CHARACTERISTIC
/begin CHARACTERISTIC MoFICO_ctDeb_C "Endwert für Entprellzähler der Fehlerreaktionsüberwachung" VALUE 0x80044EC2 Val_Wu8 255.0 OneToOne 0.00 255.0 FORMAT "%5.1" /end CHARACTERISTIC
/begin CHARACTERISTIC MoFICO_nCtOff_C "Maximal zulässige Motordrehzahl für Einspritzungen bei Einspritzmengenausblendung" VALUE 0x80044EC3 Val_Wu8 10200. Mo_n_rpm_q40p0 0.00 10200. FORMAT "%5.0" /end CHARACTERISTIC
/begin CHARACTERISTIC MoFInjDat_ctDebPhiErr_C "Fehlerzählerendwert Ansteuerbeginnwinkel der Ebene 1 unplausibel in der Funktionsüberwachung" VALUE 0x80044EC4 Val_Wu8 255.0 OneToOne 0.00 255.0 FORMAT "%5.1" /end CHARACTERISTIC
/begin CHARACTERISTIC MoFInjDat_ctDebQntErr_C "Fehlerzählerendwert Menge der Ebene 1 unplausibel in der Funktionsüberwachung" VALUE 0x80044EC5 Val_Wu8 255.0 OneToOne 0.00 255.0 FORMAT "%5.1" /end CHARACTERISTIC
/begin CHARACTERISTIC MoFInjDat_ctDiagPhi_C "Zählerendwert für MoFInjDat_ctDiagPhi in der Diagnose" VALUE 0x80063B52 Val_Wu8 255.0 OneToOne 0.00 255.0 FORMAT "%5.1" /end CHARACTERISTIC
/begin CHARACTERISTIC MoFInjDat_ctDiagQnt_C "Zählerendwert für MoFInjDat_ctDiagQnt in der Diagnose" VALUE 0x80063B53 Val_Wu8 255.0 OneToOne 0.00 255.0 FORMAT "%5.1" /end CHARACTERISTIC
/begin CHARACTERISTIC MoFInjDat_ctRst_C "Anzahl der Resets vor Anforderung der Einspritzmengenbegrenzung (EMB)" VALUE 0x80044EC6 Val_Wu8 255.0 OneToOne 0.00 255.0 FORMAT "%5.1" /end CHARACTERISTIC
/begin CHARACTERISTIC MoFInjDat_facInjEff_MAP "Momentenwirksamkeits-Faktor-Kennfeld der Schubüberwachung" MAP 0x80063B54 Map_Xs16Ys16Ws16 7.999878 Mo_fac_q0p000122 -4.000000 3.999878 FORMAT "%8.6"
 /begin AXIS_DESCR STD_AXIS Epm_nEng EngN 6 -16384.00 16383.50 FORMAT "%8.2" DEPOSIT ABSOLUTE /end AXIS_DESCR
 /begin AXIS_DESCR STD_AXIS MoFInjDat_phiInjAct_mp Mo_phi_degCrS_q0p02197 4 -720.0439 720.0220 FORMAT "%8.4" DEPOSIT ABSOLUTE /end AXIS_DESCR
/end CHARACTERISTIC
/begin CHARACTERISTIC MoFInjDat_nNumRevCs1Max_C "Maximaldrehzahl zur Mittelung über 1 Nockenwellenumdrehung" VALUE 0x80044EC7 Val_Wu8 10200. Mo_n_rpm_q40p0 0.00 10200. FORMAT "%5.0" /end CHARACTERISTIC
/begin CHARACTERISTIC MoFInjDat_nNumRevCs2Max_C "Maximaldrehzahl zur Mittelung über 2 Nockenwellenumdrehungen" VALUE 0x80044EC8 Val_Wu8 10200. Mo_n_rpm_q40p0 0.00 10200. FORMAT "%5.0" /end CHARACTERISTIC
/begin CHARACTERISTIC MoFInjDat_nNumRevCs2Min_C "Minimaldrehzahl zur Mittelung über 2 Nockenwellenumdrehungen" VALUE 0x80044EC9 Val_Wu8 10200. Mo_n_rpm_q40p0 0.00 10200. FORMAT "%5.0" /end CHARACTERISTIC
/begin CHARACTERISTIC MoFInjDat_nNumRevCs3Min_C "Minimaldrehzahl zur Mittelung über 3 Nockenwellenumdrehungen" VALUE 0x80044ECA Val_Wu8 10200. Mo_n_rpm_q40p0 0.00 10200. FORMAT "%5.0" /end CHARACTERISTIC
/begin CHARACTERISTIC MoFInjDat_numCyl_C "Zylinderanzahl in der Funktionsüberwachung" VALUE 0x80044ECB Val_Wu8 255.0 OneToOne 0.00 255.0 FORMAT "%5.1" /end CHARACTERISTIC
/begin CHARACTERISTIC MoFInjDat_phiMI1Max_C "Maximal plausibler Ansteuerbeginnwinkel MI1" VALUE 0x80044ECC Val_Ws16 1440.066 Mo_phi_degCrS_q0p02197 -720.0439 720.0220 FORMAT "%8.4" /end CHARACTERISTIC
/begin CHARACTERISTIC MoFInjDat_phiMI1Min_C "Minimal plausibler Ansteuerbeginnwinkel MI1" VALUE 0x80044ECE Val_Ws16 1440.066 Mo_phi_degCrS_q0p02197 -720.0439 720.0220 FORMAT "%8.4" /end CHARACTERISTIC
/begin CHARACTERISTIC MoFInjDat_phiPiIMax_C "Maximal plausibler Ansteuerbeginnwinkel PiI" VALUE 0x80044ED0 Val_Ws16 1440.066 Mo_phi_degCrS_q0p02197 -720.0439 720.0220 FORMAT "%8.4" /end CHARACTERISTIC
/begin CHARACTERISTIC MoFInjDat_phiPiIMin_C "Minimal plausibler Ansteuerbeginnwinkel PiI" VALUE 0x80044ED2 Val_Ws16 1440.066 Mo_phi_degCrS_q0p02197 -720.0439 720.0220 FORMAT "%8.4" /end CHARACTERISTIC
/begin CHARACTERISTIC MoFInjDat_phiPoI1Max_C "Maximal plausibler Ansteuerbeginnwinkel PoI1" VALUE 0x80044ED4 Val_Ws16 1440.066 Mo_phi_degCrS_q0p02197 -720.0439 720.0220 FORMAT "%8.4" /end CHARACTERISTIC
/begin CHARACTERISTIC MoFInjDat_phiPoI1Min_C "Minimal plausibler Ansteuerbeginnwinkel PoI1" VALUE 0x80044ED6 Val_Ws16 1440.066 Mo_phi_degCrS_q0p02197 -720.0439 720.0220 FORMAT "%8.4" /end CHARACTERISTIC
/begin CHARACTERISTIC MoFInjDat_phiPoI2Max_C "Maximal plausibler Ansteuerbeginnwinkel PoI2" VALUE 0x80044ED8 Val_Ws16 1440.066 Mo_phi_degCrS_q0p02197 -720.0439 720.0220 FORMAT "%8.4" /end CHARACTERISTIC
/begin CHARACTERISTIC MoFInjDat_phiPoI2Min_C "Minimal plausibler Ansteuerbeginnwinkel PoI2" VALUE 0x80044EDA Val_Ws16 1440.066 Mo_phi_degCrS_q0p02197 -720.0439 720.0220 FORMAT "%8.4" /end CHARACTERISTIC
/begin CHARACTERISTIC MoFInjDat_qThreshQntErr_C "Mengen-Schwelle zur Plausibilisierung der Ebene 1- Menge in der Funktionsüberwachung" VALUE 0x80044EDC Val_Ws16 655.3500 Mo_q_mg_q0p01 -327.6800 327.6700 FORMAT "%8.4" /end CHARACTERISTIC
/begin CHARACTERISTIC MoFInjQnt_ctDebErr_C "Fehlerzählerschwellwert in MoFInjQnt in der Funktionsüberwachung" VALUE 0x80044EDE Val_Wu8 255.0 OneToOne 0.00 255.0 FORMAT "%5.1" /end CHARACTERISTIC
/begin CHARACTERISTIC MoFInjQnt_ctRst_C "Anzahl der Resets vor Anforderung der Einspritzmengenbegrenzung (EMB)" VALUE 0x80044EDF Val_Wu8 255.0 OneToOne 0.00 255.0 FORMAT "%5.1" /end CHARACTERISTIC
/begin CHARACTERISTIC MoFInjQnt_rhoFl_C "Kraftstoffdichte in der Funktionsüberwachung" VALUE 0x80044EE0 Val_Wu8 25.50 Mo_rho_mgpmm3_q0p1 0.00 25.50 FORMAT "%5.2" /end CHARACTERISTIC
/begin CHARACTERISTIC MoFInjQnt_stQntAdj_MAP "Statuskennfeld Injektormengenabgleich in der Funktionsüberwachung" MAP 0x80044EE2 Map_Xs16Ys16Ws16 65535.00 OneToOne -32768.00 32767.00 FORMAT "%8.2"
 /begin AXIS_DESCR STD_AXIS MoFRailP_p Mo_p_bar_q8p0000 16 0.00 2000.000 EXTENDED_LIMITS 0.00 2040.000 DEPOSIT ABSOLUTE /end AXIS_DESCR
 /begin AXIS_DESCR STD_AXIS MoFInjQnt_volMI1UnCor_mp Mo_vol_mm3_q0p01 16 -327.6800 327.6700 FORMAT "%8.4" DEPOSIT ABSOLUTE /end AXIS_DESCR
/end CHARACTERISTIC
/begin CHARACTERISTIC MoFInjQnt_tiZFCETMax_CUR "Maximal zulässige Nullmengenkalibrierung Korrekturansteuerdauer in der Funktionsüberwachung" CURVE 0x80045126 Cur_Xs16Ws16 26214.00 Mo_ti_us_q0p4 -13107.20 13106.80 FORMAT "%8.2"
 /begin AXIS_DESCR STD_AXIS MoFRailP_p Mo_p_bar_q8p0000 6 0.00 2000.000 EXTENDED_LIMITS 0.00 2040.000 DEPOSIT ABSOLUTE /end AXIS_DESCR
/end CHARACTERISTIC
/begin CHARACTERISTIC MoFInjQnt_tiZFCETMin_CUR "Minimal zulässige Nullmengenkalibrierung Korrekturansteuerdauer in der Funktionsüberwachung" CURVE 0x80045140 Cur_Xs16Ws16 26214.00 Mo_ti_us_q0p4 -13107.20 13106.80 FORMAT "%8.2"
 /begin AXIS_DESCR STD_AXIS MoFRailP_p Mo_p_bar_q8p0000 6 0.00 2000.000 EXTENDED_LIMITS 0.00 2040.000 DEPOSIT ABSOLUTE /end AXIS_DESCR
/end CHARACTERISTIC
/begin CHARACTERISTIC MoFInjQnt_volQntAdjLim_C "Symetrische Begrenzung der Abgleichmengen" VALUE 0x8004515A Val_Ws16 655.3500 Mo_vol_mm3_q0p01 -327.6800 327.6700 FORMAT "%8.4" /end CHARACTERISTIC
/begin CHARACTERISTIC MoFInjQnt_vol_MAP "Einspritzvolumenkennfeld in der Funktionsüberwachung" MAP 0x8004515C Map_Xs16Ys16Ws16 655.3500 Mo_vol_mm3_q0p01 -327.6800 327.6700 FORMAT "%8.4"
 /begin AXIS_DESCR STD_AXIS MoFRailP_p Mo_p_bar_q8p0000 16 0.00 2000.000 EXTENDED_LIMITS 0.00 2040.000 DEPOSIT ABSOLUTE /end AXIS_DESCR
 /begin AXIS_DESCR STD_AXIS MoFInjDat_tiMI1 Mo_ti_us_q0p4 40 -13107.20 13106.80 FORMAT "%8.2" DEPOSIT ABSOLUTE /end AXIS_DESCR
/end CHARACTERISTIC
/begin CHARACTERISTIC MoFLos_rTrqEngLos_MAP "Kennfeld für das Motorverlustmoment der Überwachung" MAP 0x800456D0 Map_Xu8Yu8Wu8 99.61 Mo_r_prc_q0p39 0.00 99.61 FORMAT "%5.2"
 /begin AXIS_DESCR STD_AXIS MoFESpd_nEng Mo_n_rpm_q40p0 8 0.00 10200. FORMAT "%5.0" DEPOSIT ABSOLUTE /end AXIS_DESCR
 /begin AXIS_DESCR STD_AXIS MoFTEng_tEng Mo_t_DegC_q0p8o48 8 -48.00 156.0 FORMAT "%5.1" DEPOSIT ABSOLUTE /end AXIS_DESCR
/end CHARACTERISTIC
/begin CHARACTERISTIC MoFMode_fac1PoI2Eff_MAP "Momentenwirkungsgradfaktor 1 der PoI2 in der Funktionsüberwachung" MAP 0x80045722 Map_Xs16Ys16Ws16 257.0000 Mo_fac_q0p00392 -128.5020 128.4980 FORMAT "%8.4"
 /begin AXIS_DESCR STD_AXIS MoFESpd_nEng Mo_n_rpm_q40p0 5 0.00 10200. FORMAT "%5.0" DEPOSIT ABSOLUTE /end AXIS_DESCR
 /begin AXIS_DESCR STD_AXIS MoFInjDat_phiPoI2 Mo_phi_degCrS_q0p02197 5 -720.0439 720.0220 FORMAT "%8.4" DEPOSIT ABSOLUTE /end AXIS_DESCR
/end CHARACTERISTIC
/begin CHARACTERISTIC MoFMode_fac2PoI2Eff_CUR "Momentenwirkungsgradfaktor 2 der PoI2 in der Funktionsüberwachung" CURVE 0x8004576C Cur_Xs16Ws16 257.0000 Mo_fac_q0p00392 -128.5020 128.4980 FORMAT "%8.4"
 /begin AXIS_DESCR STD_AXIS MoFQntCor_qPoI2 Mo_q_mg_q0p01 3 -327.6800 327.6700 FORMAT "%8.4" DEPOSIT ABSOLUTE /end AXIS_DESCR
/end CHARACTERISTIC
/begin CHARACTERISTIC MoFMode_fac3PoI2Eff_MAP "Momentenwirkungsgradfaktor 3 der PoI2 in der Funktionsüberwachung" MAP 0x8004577A Map_Xs16Ys16Ws16 257.0000 Mo_fac_q0p00392 -128.5020 128.4980 FORMAT "%8.4"
 /begin AXIS_DESCR STD_AXIS MoFQntCor_qMI1 Mo_q_mg_q0p01 5 -327.6800 327.6700 FORMAT "%8.4" DEPOSIT ABSOLUTE /end AXIS_DESCR
 /begin AXIS_DESCR STD_AXIS MoFInjDat_tiMI1PoI2 Mo_ti_us_q0p4 5 -13107.20 13106.80 FORMAT "%8.2" DEPOSIT ABSOLUTE /end AXIS_DESCR
/end CHARACTERISTIC
/begin CHARACTERISTIC MoFOvR_ctDebASDdc_C "" VALUE 0x800457C4 Val_Wu16 65535.00 OneToOne 0.00 65535.00 FORMAT "%8.2" /end CHARACTERISTIC
/begin CHARACTERISTIC MoFOvR_ctDebETDef_C "Defektentprellzählerstand der Einspritzzeitenplausibilisierung" VALUE 0x800457C6 Val_Wu16 65535.00 OneToOne 0.00 65535.00 FORMAT "%8.2" /end CHARACTERISTIC
/begin CHARACTERISTIC MoFOvR_ctRst_C "Anzahl der Resets vor Anforderung der Einspritzmengenbegrenzung (EMB)" VALUE 0x800457C8 Val_Wu8 255.0 OneToOne 0.00 255.0 FORMAT "%5.1" /end CHARACTERISTIC
/begin CHARACTERISTIC MoFOvR_nEngOff_C "Kurbelwellendrehzahlgrenze zur Erkennung auf Motorzustand ""aus"" unterhalb der die Schubüberwachung inaktive ist" VALUE 0x800457C9 Val_Wu8 6000. Mo_n_rpm_q40p0 0.00 6000. FORMAT "%5.0" EXTENDED_LIMITS 0.00 10200. /end CHARACTERISTIC
/begin CHARACTERISTIC MoFOvR_nSpdGovLim_C "Kurbelwellendrehzahlgrenze oberhalb der die Schubüberwachung aufgrund Leerlaufreglerfreigabe aktive ist" VALUE 0x800457CA Val_Wu8 6000. Mo_n_rpm_q40p0 0.00 6000. FORMAT "%5.0" EXTENDED_LIMITS 0.00 10200. /end CHARACTERISTIC
/begin CHARACTERISTIC MoFOvR_nStrtEnd_C "Kurbelwellendrehzahlgrenze zur Erkennung auf Motorzustand ""an"" oberhalb der die Schubüberwachung aktive ist" VALUE 0x800457CB Val_Wu8 6000. Mo_n_rpm_q40p0 0.00 6000. FORMAT "%5.0" EXTENDED_LIMITS 0.00 10200. /end CHARACTERISTIC
/begin CHARACTERISTIC MoFOvR_tiAPPFlt_C "Verzögerungszeit des Fahrerwunsches aufgrund von Fahrpedalfilter und Führungsformer in der Schubüberwachung" VALUE 0x800457CC Val_Wu16 655350.0 Mo_ti10ms_ms_q10p0 0.00 655350.0 FORMAT "%8.1" /end CHARACTERISTIC
/begin CHARACTERISTIC MoFOvR_tiCrCtlBrkRmp_C "Bremssignalverzögerungszeit zur Berücksichtigung der FGR-Abschaltrampe in der Schubüberwachung" VALUE 0x800457CE Val_Wu16 655350.0 Mo_ti10ms_ms_q10p0 0.00 655350.0 FORMAT "%8.1" /end CHARACTERISTIC
/begin CHARACTERISTIC MoFOvR_tiEngSpdRlsBrkRmp_C "Bremssignalentprellzeit zur Freigabe der Schubüberwachung" VALUE 0x800457D0 Val_Wu16 655350.0 Mo_ti10ms_ms_q10p0 0.00 655350.0 FORMAT "%8.1" /end CHARACTERISTIC
/begin CHARACTERISTIC MoFOvR_tiLimET_CUR "Zulässige Ansteuerdauern zur Plausibilisierung mit tatsächlicher Ansteuerdauer" CURVE 0x800457D2 Cur_Xs16Ws16 6000.000 Mo_ti_us_q0p4 0.00 6000.000 FORMAT "%8.3" EXTENDED_LIMITS -13107.20 13106.80
 /begin AXIS_DESCR STD_AXIS MoFESpd_nEng Mo_n_rpm_q40p0 4 0.00 10200. FORMAT "%5.0" DEPOSIT ABSOLUTE /end AXIS_DESCR
/end CHARACTERISTIC
/begin CHARACTERISTIC MoFQntCor_ctDebErr_C "Fehlerentprellzählerendstand in MoFQntCor in der Funktionsüberwachung" VALUE 0x800457E4 Val_Wu8 255.0 OneToOne 0.00 255.0 FORMAT "%5.1" /end CHARACTERISTIC
/begin CHARACTERISTIC MoFQntCor_ctRst_C "Anzahl der Resets vor der Anforderung der Einspritzmengenbegrenzung (EMB)" VALUE 0x800457E5 Val_Wu8 255.0 OneToOne 0.00 255.0 FORMAT "%5.1" /end CHARACTERISTIC
/begin CHARACTERISTIC MoFQntCor_facFTSWCor_MAP "Kraftstofftemperatureinfluß Wellenkorrektur in der Funktionsüberwachung" MAP 0x800457E6 Map_Xs16Ys16Ws16 511.9922 Mo_fac_q0p0078125 -256.0000 255.9922 FORMAT "%8.4"
 /begin AXIS_DESCR STD_AXIS MoFRailP_p Mo_p_bar_q8p0000 19 0.00 2000.000 EXTENDED_LIMITS 0.00 2040.000 DEPOSIT ABSOLUTE /end AXIS_DESCR
 /begin AXIS_DESCR STD_AXIS MoFInjDat_tCor Mo_t_DegC_q0p8o48 8 -26262.40 26165.60 FORMAT "%8.2" DEPOSIT ABSOLUTE /end AXIS_DESCR
/end CHARACTERISTIC
/begin CHARACTERISTIC MoFQntCor_facPiI2WvCor_C "Faktor Einfluß PiI2 Wellenkorrektur in der Funktionsüberwachung" VALUE 0x80045950 Val_Wu8 1.992 Mo_fac_q0p0078125 0.00 1.992 FORMAT "%5.3" /end CHARACTERISTIC
/begin CHARACTERISTIC MoFQntCor_facWvCor1_MAP "Faktor 1 Einfluß Wellenkorrektur in der Funktionsüberwachung" MAP 0x80045952 Map_Xs16Ys16Ws16 511.9922 Mo_fac_q0p0078125 -256.0000 255.9922 FORMAT "%8.4"
 /begin AXIS_DESCR STD_AXIS MoFQntCor_qMI1 Mo_q_mg_q0p01 20 -327.6800 327.6700 FORMAT "%8.4" DEPOSIT ABSOLUTE /end AXIS_DESCR
 /begin AXIS_DESCR STD_AXIS MoFRailP_p Mo_p_bar_q8p0000 20 0.00 2000.000 EXTENDED_LIMITS 0.00 2040.000 DEPOSIT ABSOLUTE /end AXIS_DESCR
/end CHARACTERISTIC
/begin CHARACTERISTIC MoFQntCor_facWvCor2_MAP "Faktor 2 Einfluß Wellenkorrektur in der Funktionsüberwachung" MAP 0x80045CC6 Map_Xs16Ys16Ws16 511.9922 Mo_fac_q0p0078125 -256.0000 255.9922 FORMAT "%8.4"
 /begin AXIS_DESCR STD_AXIS MoFQntCor_qPoI2 Mo_q_mg_q0p01 20 -327.6800 327.6700 FORMAT "%8.4" DEPOSIT ABSOLUTE /end AXIS_DESCR
 /begin AXIS_DESCR STD_AXIS MoFRailP_p Mo_p_bar_q8p0000 20 0.00 2000.000 EXTENDED_LIMITS 0.00 2040.000 DEPOSIT ABSOLUTE /end AXIS_DESCR
/end CHARACTERISTIC
/begin CHARACTERISTIC MoFQntCor_qMI1DeltaMax_C "Maximal zulässige Abweichung Wellenkorrekturmenge MI1 in der Funktionsüberwachung" VALUE 0x8004603A Val_Ws16 655.3500 Mo_q_mg_q0p01 -327.6800 327.6700 FORMAT "%8.4" /end CHARACTERISTIC
/begin CHARACTERISTIC MoFQntCor_qPiI1DeltaMax_C "Maximal zulässige Abweichung Wellenkorrekturmenge PiI1 in der Funktionsüberwachung" VALUE 0x8004603C Val_Ws16 655.3500 Mo_q_mg_q0p01 -327.6800 327.6700 FORMAT "%8.4" /end CHARACTERISTIC
/begin CHARACTERISTIC MoFQntCor_qPoI2DeltaMax_C "Maximal zulässige Abweichung Wellenkorrekturmenge PoI2 in der Funktionsüberwachung" VALUE 0x8004603E Val_Ws16 655.3500 Mo_q_mg_q0p01 -327.6800 327.6700 FORMAT "%8.4" /end CHARACTERISTIC
/begin CHARACTERISTIC MoFQntCor_qWvCor1_MAP "Wellenkorrekturmenge 1 in der Funktionsüberwachung" MAP 0x80046040 Map_Xs16Ys16Ws16 655.3500 Mo_q_mg_q0p01 -327.6800 327.6700 FORMAT "%8.4"
 /begin AXIS_DESCR STD_AXIS MoFQntCor_tiPiI1MI1Cor_mp Mo_ti_us_q0p4 32 -13107.20 13106.80 FORMAT "%8.2" DEPOSIT ABSOLUTE /end AXIS_DESCR
 /begin AXIS_DESCR STD_AXIS MoFQntCor_qPiI1 Mo_q_mg_q0p01 4 -327.6800 327.6700 FORMAT "%8.4" DEPOSIT ABSOLUTE /end AXIS_DESCR
/end CHARACTERISTIC
/begin CHARACTERISTIC MoFQntCor_qWvCor2_MAP "Wellenkorrekturmenge 2 in der Funktionsüberwachung" MAP 0x8004618C Map_Xs16Ys16Ws16 655.3500 Mo_q_mg_q0p01 -327.6800 327.6700 FORMAT "%8.4"
 /begin AXIS_DESCR STD_AXIS MoFQntCor_tiMI1PoI2Cor_mp Mo_ti_us_q0p4 49 -13107.20 13106.80 FORMAT "%8.2" DEPOSIT ABSOLUTE /end AXIS_DESCR
 /begin AXIS_DESCR STD_AXIS MoFQntCor_rQMI1_mp Mo_fac_q0p04 6 0.00 10.20 FORMAT "%5.2" DEPOSIT ABSOLUTE /end AXIS_DESCR
/end CHARACTERISTIC
/begin CHARACTERISTIC MoFQntCor_qWvCorMax_C "Maximal zulässige Wellenkorrekturmenge in der Funktionsüberwachung" VALUE 0x8004644A Val_Ws16 655.3500 Mo_q_mg_q0p01 -327.6800 327.6700 FORMAT "%8.4" /end CHARACTERISTIC
/begin CHARACTERISTIC MoFQntCor_qWvCorMin_C "Minimal zulässige Wellenkorrekturmenge in der Funktionsüberwachung" VALUE 0x8004644C Val_Ws16 655.3500 Mo_q_mg_q0p01 -327.6800 327.6700 FORMAT "%8.4" /end CHARACTERISTIC
/begin CHARACTERISTIC MoFQntCor_qWvCorNorm_CUR "Normierungswellenkorrekturmenge in der Funktionsüberwachung" CURVE 0x8004644E Cur_Xs16Ws16 655.3500 Mo_q_mg_q0p01 -327.6800 327.6700 FORMAT "%8.4"
 /begin AXIS_DESCR STD_AXIS MoFRailP_p Mo_p_bar_q8p0000 20 0.00 2000.000 EXTENDED_LIMITS 0.00 2040.000 DEPOSIT ABSOLUTE /end AXIS_DESCR
/end CHARACTERISTIC
/begin CHARACTERISTIC MoFQntCor_tiDiffHyd_MAP "Hydraulische Zeitdifferenz in der Funktionsüberwachung" MAP 0x800464A0 Map_Xs16Ys16Ws16 26214.00 Mo_ti_us_q0p4 -13107.20 13106.80 FORMAT "%8.2"
 /begin AXIS_DESCR STD_AXIS MoFRailP_p Mo_p_bar_q8p0000 10 0.00 2000.000 EXTENDED_LIMITS 0.00 2040.000 DEPOSIT ABSOLUTE /end AXIS_DESCR
 /begin AXIS_DESCR STD_AXIS MoFQntCor_qPoI2 Mo_q_mg_q0p01 16 -327.6800 327.6700 FORMAT "%8.4" DEPOSIT ABSOLUTE /end AXIS_DESCR
/end CHARACTERISTIC
/begin CHARACTERISTIC MoFRailP_ctMaxDebDef_C "Schwelle SRC High defekt Raildruck der Funktionsüberwachung" VALUE 0x80046618 Val_Wu8 255.0 OneToOne 0.00 255.0 FORMAT "%5.1" /end CHARACTERISTIC
/begin CHARACTERISTIC MoFRailP_ctMaxDebOK_C "Schwelle SRC High OK Raildruck der Funktionsüberwachung" VALUE 0x80046619 Val_Wu8 255.0 OneToOne 0.00 255.0 FORMAT "%5.1" /end CHARACTERISTIC
/begin CHARACTERISTIC MoFRailP_ctMinDebDef_C "Schwelle SRC Low defekt Raildruck der Funktionsüberwachung" VALUE 0x8004661A Val_Wu8 255.0 OneToOne 0.00 255.0 FORMAT "%5.1" /end CHARACTERISTIC
/begin CHARACTERISTIC MoFRailP_ctMinDebOK_C "Schwelle SRC Low OK Raildruck der Funktionsüberwachung" VALUE 0x8004661B Val_Wu8 255.0 OneToOne 0.00 255.0 FORMAT "%5.1" /end CHARACTERISTIC
/begin CHARACTERISTIC MoFRailP_pLin_CUR "Linearisierungskennlinie Raildruck der Funktionsüberwachung" CURVE 0x8004661C Cur_Xu8Wu8 2000.000 Mo_p_bar_q8p0000 0.00 2000.000 EXTENDED_LIMITS 0.00 2040.000
 /begin AXIS_DESCR STD_AXIS MoFRailP_uRaw_mp Mo_u_mV_q19p53 4 0.00 4980. FORMAT "%5.0" DEPOSIT ABSOLUTE /end AXIS_DESCR
/end CHARACTERISTIC
/begin CHARACTERISTIC MoFRailP_pRailMax_C "Maximaler Raildruck der Funktionsüberwachung" VALUE 0x80046625 Val_Wu8 2000.000 Mo_p_bar_q8p0000 0.00 2000.000 EXTENDED_LIMITS 0.00 2040.000 /end CHARACTERISTIC
/begin CHARACTERISTIC MoFRailP_tiPT1_C "Zeitkonstante Raildruck-PT1 Filter der Funktionsüberwachung" VALUE 0x80046626 Val_Wu8 10.20 Mo_ti_s_q0p04 0.00 10.20 FORMAT "%5.2" /end CHARACTERISTIC
/begin CHARACTERISTIC MoFRailP_uSRCMax_C "SRC High Schwelle des Raildrucksensors der Funktionsüberwachung" VALUE 0x80046627 Val_Wu8 4980. Mo_u_mV_q19p53 0.00 4980. FORMAT "%5.0" /end CHARACTERISTIC
/begin CHARACTERISTIC MoFRailP_uSRCMin_C "SRC Low Schwelle des Raildrucksensors der Funktionsüberwachung" VALUE 0x80046628 Val_Wu8 4980. Mo_u_mV_q19p53 0.00 4980. FORMAT "%5.0" /end CHARACTERISTIC
/begin CHARACTERISTIC MoFSpdG_rTrqPtd_MAP "zulässiges Moment des Drehzahlreglers" MAP 0x8004662A Map_Xu8Yu8Wu8 99.61 Mo_r_prc_q0p39 0.00 99.61 FORMAT "%5.2"
 /begin AXIS_DESCR STD_AXIS MoFESpd_nEng Mo_n_rpm_q40p0 6 0.00 10200. FORMAT "%5.0" DEPOSIT ABSOLUTE /end AXIS_DESCR
 /begin AXIS_DESCR STD_AXIS MoFTEng_tEng Mo_t_DegC_q0p8o48 6 -48.00 156.0 FORMAT "%5.1" DEPOSIT ABSOLUTE /end AXIS_DESCR
/end CHARACTERISTIC
/begin CHARACTERISTIC MoFTEng_nEngOff_C "" VALUE 0x8004665C Val_Wu8 10200. Mo_n_rpm_q40p0 0.00 10200. FORMAT "%5.0" /end CHARACTERISTIC
/begin CHARACTERISTIC MoFTEng_nStrtEnd_C "" VALUE 0x8004665D Val_Wu8 10200. Mo_n_rpm_q40p0 0.00 10200. FORMAT "%5.0" /end CHARACTERISTIC
/begin CHARACTERISTIC MoFTEng_tiMinTempIni_CUR "" CURVE 0x8004665E Cur_Xu8Wu8 1306. Mo_ti40ms_s_q5p12 0.00 1306. FORMAT "%5.0"
 /begin AXIS_DESCR STD_AXIS MoFTEng_tEng Mo_t_DegC_q0p8o48 8 -48.00 156.0 FORMAT "%5.1" DEPOSIT ABSOLUTE /end AXIS_DESCR
/end CHARACTERISTIC
/begin CHARACTERISTIC MoFTEng_tiMinTempMax_C "" VALUE 0x8004666F Val_Wu8 1306. Mo_ti40ms_s_q5p12 0.00 1306. FORMAT "%5.0" /end CHARACTERISTIC
/begin CHARACTERISTIC MoFTEng_tiMinTempMin_C "Begrenzungswert beim hinunterzählen des Zeitzählers MoFTEng_tiMinTemp" VALUE 0x80046670 Val_Wu8 1306. Mo_ti40ms_s_q5p12 0.00 1306. FORMAT "%5.0" /end CHARACTERISTIC
/begin CHARACTERISTIC MoFTEng_tMin_CUR "" CURVE 0x80046671 Cur_Xu8Wu8 204.0 Mo_t_DegC_q0p8o48 -48.00 156.0 FORMAT "%5.1"
 /begin AXIS_DESCR STD_AXIS MoFTEng_tiMinTemp_mp Mo_ti40ms_s_q5p12 8 0.00 1306. FORMAT "%5.0" DEPOSIT ABSOLUTE /end AXIS_DESCR
/end CHARACTERISTIC
/begin CHARACTERISTIC MoFTrqCmp_ctDeb_C "Entprellwert für Fehlerzähler des Momentenvergleichs nachdem eine Einspritzmengenbegrenzung angefordert wird" VALUE 0x80046682 Val_Wu8 255.0 OneToOne 0.00 255.0 FORMAT "%5.1" /end CHARACTERISTIC
/begin CHARACTERISTIC MoFTrqCmp_ctRst_C "Anzahl Resets vor der Anforderung der Einspritzmengenbegrenzung (EMB)" VALUE 0x80046683 Val_Wu8 255.0 OneToOne 0.00 255.0 FORMAT "%5.1" /end CHARACTERISTIC
/begin CHARACTERISTIC MoFTrqIdc_q2trq_MAP "Kennfeld relatives Motormoment der Funktionsüberwachung" MAP 0x80046684 Map_Xs16Ys16Ws16 25599.61 Mo_r_prc_q0p39 -12800.00 12799.61 FORMAT "%8.2"
 /begin AXIS_DESCR STD_AXIS MoFESpd_nEng Mo_n_rpm_q40p0 16 0.00 10200. FORMAT "%5.0" DEPOSIT ABSOLUTE /end AXIS_DESCR
 /begin AXIS_DESCR STD_AXIS MoFMode_qSetUnBal Mo_q_mg_q0p01 16 -327.6800 327.6700 FORMAT "%8.4" DEPOSIT ABSOLUTE /end AXIS_DESCR
/end CHARACTERISTIC
/begin CHARACTERISTIC MoICoVeh_MoIDrDem_trqPtd_CA "" VAL_BLK 0x800468EC ValA_Ws16 65535.00 OneToOne -32768.00 32767.00 FORMAT "%8.2" NUMBER 8 /begin ANNOTATION /end ANNOTATION /end CHARACTERISTIC
/begin CHARACTERISTIC Mo_trqIdcMax_C "Maximale innere Motormoment der Steuergeräteüberwachung." VALUE 0x800468C8 Val_Ws16 6553.500 Mo_trq_nm_q0p1 -3276.800 3276.700 FORMAT "%8.3" /end CHARACTERISTIC
/begin CHARACTERISTIC MRly_ctErlyOpng_C "" VALUE 0x800639D2 Kw_Wu8 255.0 OneToOne 0.00 255.0 FORMAT "%5.1" /end CHARACTERISTIC
/begin CHARACTERISTIC MRly_tiBattVltgFlt_C "" VALUE 0x800639D4 Kw_Ws16 4294.8362200 TimeDelay_s 0.13107600012 4294.9672960 FORMAT "%12.7" /end CHARACTERISTIC
/begin CHARACTERISTIC MRly_tiStkRlyDiaDel_C "" VALUE 0x800639D6 Kw_Ws16 655350.0 Time_ms -327680.0 327670.0 FORMAT "%8.1" /end CHARACTERISTIC
/begin CHARACTERISTIC MRly_tiVltgStblDel_C "" VALUE 0x800639D8 Kw_Ws16 655350.0 Time_ms -327680.0 327670.0 FORMAT "%8.1" /end CHARACTERISTIC
/begin CHARACTERISTIC MRly_uStblThr_C "" VALUE 0x800639DA Kw_Ws16 30000.00 Volt_Batt 0.00 30000.00 FORMAT "%8.2" EXTENDED_LIMITS -655360.0 655340.0 /end CHARACTERISTIC
/begin CHARACTERISTIC MRly_uStkRlyBattThr_C "" VALUE 0x800639DC Kw_Ws16 30000.00 Volt_Batt 0.00 30000.00 FORMAT "%8.2" EXTENDED_LIMITS -655360.0 655340.0 /end CHARACTERISTIC
/begin CHARACTERISTIC OilPLmp_aMin_C "" VALUE 0x80063BA4 Val_Ws16 65.53500 Acc -32.76800 32.76700 FORMAT "%8.5" /end CHARACTERISTIC
/begin CHARACTERISTIC OilPLmp_DigOut.tiBtwTstSCB_C "/" VALUE 0x80063B9C Kw_Ws16 1000.000 Time_ms 0.00 1000.000 FORMAT "%8.3" EXTENDED_LIMITS -327680.0 327670.0 /end CHARACTERISTIC
/begin CHARACTERISTIC OilPLmp_DigOut.tiBtwTstOT_C "/" VALUE 0x80063B9E Kw_Ws16 1000.000 Time_s 0.00 1000.000 FORMAT "%8.3" EXTENDED_LIMITS -327.6800 327.6700 /end CHARACTERISTIC
/begin CHARACTERISTIC OilPLmp_DigOut.numTstMax_C "/" VALUE 0x80063BA0 Kw_Wu16 65535.00 OneToOne 0.00 65535.00 FORMAT "%8.2" /end CHARACTERISTIC
/begin CHARACTERISTIC OilPLmp_nStrt1_C "" VALUE 0x80063BA6 Val_Ws16 32767.50 EngN -16384.00 16383.50 FORMAT "%8.2" /end CHARACTERISTIC
/begin CHARACTERISTIC OilPLmp_nStrt2_C "" VALUE 0x80063BA8 Val_Ws16 32767.50 EngN -16384.00 16383.50 FORMAT "%8.2" /end CHARACTERISTIC
/begin CHARACTERISTIC OilPLmp_stPsDiaDisbl_C "" VALUE 0x80063BA2 Val_Wu8 255.0 OneToOne 0.00 255.0 FORMAT "%5.1" /end CHARACTERISTIC
/begin CHARACTERISTIC OilPLmp_stPsDisbl_C "" VALUE 0x80063BA3 Val_Wu8 255.0 OneToOne 0.00 255.0 FORMAT "%5.1" /end CHARACTERISTIC
/begin CHARACTERISTIC OilPLmp_swtStrt_C "" VALUE 0x80063BAA Val_Wu8 255.0 OneToOne 0.00 255.0 FORMAT "%5.1" /end CHARACTERISTIC
/begin CHARACTERISTIC OilPLmp_tiDebABSPos_C "" VALUE 0x80063BAC Val_Ws16 655350.0 Time_ms -327680.0 327670.0 FORMAT "%8.1" /end CHARACTERISTIC
/begin CHARACTERISTIC OilPLmp_tiInactv1_C "" VALUE 0x80063BAE Val_Ws16 655350.0 Time_ms -327680.0 327670.0 FORMAT "%8.1" /end CHARACTERISTIC
/begin CHARACTERISTIC OilPLmp_tiInactv2_C "" VALUE 0x80063BB0 Val_Ws16 655350.0 Time_ms -327680.0 327670.0 FORMAT "%8.1" /end CHARACTERISTIC
/begin CHARACTERISTIC OilPLmp_tiStrt_C "" VALUE 0x80063BB2 Val_Ws16 655350.0 Time_ms -327680.0 327670.0 FORMAT "%8.1" /end CHARACTERISTIC
/begin CHARACTERISTIC OilPLmp_vMin_C "" VALUE 0x80063BB4 Val_Ws16 655.3500 Vel -327.6800 327.6700 FORMAT "%8.4" /end CHARACTERISTIC
/begin CHARACTERISTIC Oil_DebP.tiHiLo_C "/" VALUE 0x80063BB6 Val_Ws16 655350.0 TimeDeb -327680.0 327670.0 FORMAT "%8.1" /end CHARACTERISTIC
/begin CHARACTERISTIC Oil_DebP.tiLoHi_C "/" VALUE 0x80063BB8 Val_Ws16 655350.0 TimeDeb -327680.0 327670.0 FORMAT "%8.1" /end CHARACTERISTIC
/begin MEASUREMENT ARS_trqDes "" SWORD Trq 1 100 -3276.800 3276.700 FORMAT "%8.3" ECU_ADDRESS 0xD000699E /end MEASUREMENT
/begin MEASUREMENT Com_bRecAFS "" UBYTE OneToOne 1 100 0.00 255.0 FORMAT "%5.1" ECU_ADDRESS 0xD0008F70 /end MEASUREMENT
/begin MEASUREMENT Com_bRecARS "" UBYTE OneToOne 1 100 0.00 255.0 FORMAT "%5.1" ECU_ADDRESS 0xD0008F71 /end MEASUREMENT
/begin MEASUREMENT Com_dstARSCTR "" UWORD OneToOne 1 100 0.00 65535.00 FORMAT "%8.2" ECU_ADDRESS 0xD0007644 /end MEASUREMENT
/begin MEASUREMENT Com_dTerminalCHK "" UBYTE OneToOne 1 100 0.00 255.0 FORMAT "%5.1" ECU_ADDRESS 0xD0008F76 /end MEASUREMENT
/begin MEASUREMENT Com_dTerminalCTR "" UWORD OneToOne 1 100 0.00 65535.00 FORMAT "%8.2" ECU_ADDRESS 0xD000762E /end MEASUREMENT
/begin MEASUREMENT Com_dTrqDemandAfsCHK "" UBYTE OneToOne 1 100 0.00 255.0 FORMAT "%5.1" ECU_ADDRESS 0xD0008F7A /end MEASUREMENT
/begin MEASUREMENT Com_dTrqDemandAfsCTR "" UWORD OneToOne 1 100 0.00 65535.00 FORMAT "%8.2" ECU_ADDRESS 0xD000763C /end MEASUREMENT
/begin MEASUREMENT Com_nPsp "" SWORD OneToOne_rpm 1 100 -32768.00 32767.00 FORMAT "%8.2" ECU_ADDRESS 0xD0006CEA /end MEASUREMENT
/begin MEASUREMENT Com_nRqStgEFan "" SWORD FanSpd 1 100 -3000.092 3000.000 FORMAT "%8.3" ECU_ADDRESS 0xD0006CEC /end MEASUREMENT
/begin MEASUREMENT Com_nStart "" SWORD EngN 1 100 -16384.00 16383.50 FORMAT "%8.2" ECU_ADDRESS 0xD0006CF0 /end MEASUREMENT
/begin MEASUREMENT Com_numRqStgEFan_mp "" UBYTE OneToOne 1 100 0.00 255.0 FORMAT "%5.1" ECU_ADDRESS 0xC0001275 /end MEASUREMENT
/begin MEASUREMENT Com_rPspSetPoint "" SWORD Prc 1 100 -400.0000 399.9878 FORMAT "%8.4" ECU_ADDRESS 0xD0006CFE /end MEASUREMENT
/begin MEASUREMENT Com_stARS "" UBYTE OneToOne 1 100 0.00 255.0 FORMAT "%5.1" ECU_ADDRESS 0xD0008F7F /end MEASUREMENT
/begin MEASUREMENT Com_stBonnet "" UBYTE OneToOne 1 100 0.00 255.0 FORMAT "%5.1" ECU_ADDRESS 0xD0008F80 /end MEASUREMENT
/begin MEASUREMENT Com_stButtonMSA "" UBYTE OneToOne 1 100 0.00 255.0 FORMAT "%5.1" ECU_ADDRESS 0xD0008F83 /end MEASUREMENT
/begin MEASUREMENT Com_stDoorDriver "" UBYTE OneToOne 1 100 0.00 255.0 FORMAT "%5.1" ECU_ADDRESS 0xD0008F89 /end MEASUREMENT
/begin MEASUREMENT Com_stDrWghSeat "" UBYTE OneToOne 1 100 0.00 255.0 FORMAT "%5.1" ECU_ADDRESS 0xD0008F8A /end MEASUREMENT
/begin MEASUREMENT Com_stErrAFS "" UBYTE OneToOne 1 100 0.00 255.0 FORMAT "%5.1" ECU_ADDRESS 0xD0008F8D /end MEASUREMENT
/begin MEASUREMENT Com_stKeyVld "" UBYTE OneToOne 1 100 0.00 255.0 FORMAT "%5.1" ECU_ADDRESS 0xD0008F93 /end MEASUREMENT
/begin MEASUREMENT Com_stPsp "" UBYTE OneToOne 1 100 0.00 255.0 FORMAT "%5.1" ECU_ADDRESS 0xD0008F99 /end MEASUREMENT
/begin MEASUREMENT Com_stReqMSA "" UBYTE OneToOne 1 100 0.00 255.0 FORMAT "%5.1" ECU_ADDRESS 0xD0008F9A /end MEASUREMENT
/begin MEASUREMENT Com_stShutOffPSP "" UBYTE OneToOne 1 100 0.00 255.0 FORMAT "%5.1" ECU_ADDRESS 0xD0008F9F /end MEASUREMENT
/begin MEASUREMENT Com_stT15 "" UBYTE OneToOne 1 100 0.00 255.0 FORMAT "%5.1" ECU_ADDRESS 0xD0008FA1 /end MEASUREMENT
/begin MEASUREMENT Com_stT50 "" UBYTE OneToOne 1 100 0.00 255.0 FORMAT "%5.1" ECU_ADDRESS 0xD0008FA2 /end MEASUREMENT
/begin MEASUREMENT Com_stTRadio "" UBYTE OneToOne 1 100 0.00 255.0 FORMAT "%5.1" ECU_ADDRESS 0xD0008FA3 /end MEASUREMENT
/begin MEASUREMENT Com_stTrailer "" UBYTE OneToOne 1 100 0.00 255.0 FORMAT "%5.1" ECU_ADDRESS 0xD0008FA5 /end MEASUREMENT
/begin MEASUREMENT Com_stTrqTarAFS "" UBYTE OneToOne 1 100 0.00 255.0 FORMAT "%5.1" ECU_ADDRESS 0xD0008FAB /end MEASUREMENT
/begin MEASUREMENT Com_swtDrBltb "" UBYTE OneToOne 1 100 0.00 255.0 FORMAT "%5.1" ECU_ADDRESS 0xD0008FAF /end MEASUREMENT
/begin MEASUREMENT Com_trqARSCur "" SWORD Trq 1 100 -3276.800 3276.700 FORMAT "%8.3" ECU_ADDRESS 0xD0006D14 /end MEASUREMENT
/begin MEASUREMENT Com_trqARSDes "" SWORD Trq 1 100 -3276.800 3276.700 FORMAT "%8.3" ECU_ADDRESS 0xD0006D16 /end MEASUREMENT
/begin MEASUREMENT Com_trqAvlAFS "" SWORD Trq 1 100 -3276.800 3276.700 FORMAT "%8.3" ECU_ADDRESS 0xD0006D18 /end MEASUREMENT
/begin MEASUREMENT Com_trqTarAFS "" SWORD Trq 1 100 -3276.800 3276.700 FORMAT "%8.3" ECU_ADDRESS 0xD0006D2E /end MEASUREMENT
/begin MEASUREMENT LSU_bpPlausSetPoint_mp "" SWORD OneToOne 1 100 -32768.00 32767.00 FORMAT "%8.2" ECU_ADDRESS 0xC0001238 /end MEASUREMENT
/begin MEASUREMENT LSU_d2rO2Eval_mp "" SWORD O2 1 100 -0.3276800 0.3276700 FORMAT "%9.7" ARRAY_SIZE 1 ECU_ADDRESS 0xC0001216 /end MEASUREMENT
/begin MEASUREMENT LSU_d2rO2_mp "" SWORD O2 1 100 -0.3276800 0.3276700 FORMAT "%9.7" ARRAY_SIZE 1 ECU_ADDRESS 0xC0001218 /end MEASUREMENT
/begin MEASUREMENT LSU_dcycDT1_mp "" SWORD DtyCyc 1 100 -327.6800 327.6700 FORMAT "%8.4" ARRAY_SIZE 1 ECU_ADDRESS 0xC000122C /end MEASUREMENT
/begin MEASUREMENT LSU_dcycHt "" SWORD DtyCyc 1 100 -327.6800 327.6700 FORMAT "%8.4" ARRAY_SIZE 1 ECU_ADDRESS 0xD000733C /end MEASUREMENT
/begin MEASUREMENT LSU_dcycHtIniRmp "" SWORD DtyCyc 1 100 -327.6800 327.6700 FORMAT "%8.4" ECU_ADDRESS 0xD0007338 /end MEASUREMENT
/begin MEASUREMENT LSU_dcycHtStrt "" SWORD DtyCyc 1 100 -327.6800 327.6700 FORMAT "%8.4" ARRAY_SIZE 1 ECU_ADDRESS 0xD000733A /end MEASUREMENT
/begin MEASUREMENT LSU_dcycI_mp "" SWORD DtyCyc 1 100 -327.6800 327.6700 FORMAT "%8.4" ARRAY_SIZE 1 ECU_ADDRESS 0xC000122E /end MEASUREMENT
/begin MEASUREMENT LSU_dcycP_mp "" SWORD DtyCyc 1 100 -327.6800 327.6700 FORMAT "%8.4" ARRAY_SIZE 1 ECU_ADDRESS 0xC0001230 /end MEASUREMENT
/begin MEASUREMENT LSU_drO2Adap "" SWORD O2 1 100 -0.3276800 0.3276700 FORMAT "%9.7" ARRAY_SIZE 1 ECU_ADDRESS 0xD0007340 /end MEASUREMENT
/begin MEASUREMENT LSU_drO2Flt_mp "" SWORD O2 1 100 -0.3276800 0.3276700 FORMAT "%9.7" ARRAY_SIZE 1 ECU_ADDRESS 0xC000121A /end MEASUREMENT
/begin MEASUREMENT LSU_facO2Corr_mp "" SWORD Fact 1 100 -4.000000 3.999878 FORMAT "%8.6" ARRAY_SIZE 1 ECU_ADDRESS 0xC000121C /end MEASUREMENT
/begin MEASUREMENT LSU_facPresComp_mp "" SWORD Fact 1 100 -4.000000 3.999878 FORMAT "%8.6" ARRAY_SIZE 1 ECU_ADDRESS 0xC000121E /end MEASUREMENT
/begin MEASUREMENT LSU_mAirAftOvrRun_mp "" SWORD AirMass_2 1 100 -3276.800 3276.700 FORMAT "%8.3" ECU_ADDRESS 0xC0001220 /end MEASUREMENT
/begin MEASUREMENT LSU_numMaxCmpChk_mp "" UBYTE OneToOne 1 100 0.00 255.0 FORMAT "%5.1" ECU_ADDRESS 0xC000123A /end MEASUREMENT
/begin MEASUREMENT LSU_pExhGasLstVal_mp "" SWORD Pres_hPa 1 100 -32768.00 3500.00 FORMAT "%8.2" ECU_ADDRESS 0xC0001222 /end MEASUREMENT
/begin MEASUREMENT LSU_qStrt_mp "" SWORD InjMass 1 100 -327.6800 327.6700 FORMAT "%8.4" ECU_ADDRESS 0xC000123C /end MEASUREMENT
/begin MEASUREMENT LSU_rLam "" SWORD lambda 1 100 -32.76800 32.76700 FORMAT "%8.5" ARRAY_SIZE 1 ECU_ADDRESS 0xD0007344 /end MEASUREMENT
/begin MEASUREMENT LSU_rLamRec "" SWORD lambdaRecVal 1 100 -32.76800 32.76700 FORMAT "%8.5" ARRAY_SIZE 1 ECU_ADDRESS 0xD0007342 /end MEASUREMENT
/begin MEASUREMENT LSU_rO2Adap "" SWORD O2 1 100 -0.3276800 0.3276700 FORMAT "%9.7" ARRAY_SIZE 1 ECU_ADDRESS 0xD0007348 /end MEASUREMENT
/begin MEASUREMENT LSU_rO2AdptLastLSU_mp "" SWORD O2 1 100 -0.3276800 0.3276700 FORMAT "%9.7" ECU_ADDRESS 0xC0001224 /end MEASUREMENT
/begin MEASUREMENT LSU_rO2Calc_mp "" SWORD O2 1 100 -0.3276800 0.3276700 FORMAT "%9.7" ECU_ADDRESS 0xC000123E /end MEASUREMENT
/begin MEASUREMENT LSU_rO2DiffCmpChk_mp "" SWORD O2 1 100 -0.3276800 0.3276700 FORMAT "%9.7" ARRAY_SIZE 1 ECU_ADDRESS 0xC0001240 /end MEASUREMENT
/begin MEASUREMENT LSU_rO2DvtNeg_mp "" SWORD O2 1 100 -0.3276800 0.3276700 FORMAT "%9.7" ECU_ADDRESS 0xC0001242 /end MEASUREMENT
/begin MEASUREMENT LSU_rO2DvtPos_mp "" SWORD O2 1 100 -0.3276800 0.3276700 FORMAT "%9.7" ECU_ADDRESS 0xC0001244 /end MEASUREMENT
/begin MEASUREMENT LSU_rO2FrstValCmpChk_mp "" SWORD O2 1 100 -0.3276800 0.3276700 FORMAT "%9.7" ARRAY_SIZE 1 ECU_ADDRESS 0xC0001246 /end MEASUREMENT
/begin MEASUREMENT LSU_rO2PresComp "" SWORD O2 1 100 -0.3276800 0.3276700 FORMAT "%9.7" ARRAY_SIZE 1 ECU_ADDRESS 0xD000734A /end MEASUREMENT
/begin MEASUREMENT LSU_rO2SecValCmpChk_mp "" SWORD O2 1 100 -0.3276800 0.3276700 FORMAT "%9.7" ARRAY_SIZE 1 ECU_ADDRESS 0xC0001248 /end MEASUREMENT
/begin MEASUREMENT LSU_rO2Stat "" SWORD O2 1 100 -0.3276800 0.3276700 FORMAT "%9.7" ECU_ADDRESS 0xD000734E /end MEASUREMENT
/begin MEASUREMENT LSU_rO2Thres1_mp "" SWORD O2 1 100 -0.3276800 0.3276700 FORMAT "%9.7" ARRAY_SIZE 1 ECU_ADDRESS 0xC000124A /end MEASUREMENT
/begin MEASUREMENT LSU_rO2Thres2_mp "" SWORD O2 1 100 -0.3276800 0.3276700 FORMAT "%9.7" ARRAY_SIZE 1 ECU_ADDRESS 0xC000124C /end MEASUREMENT
/begin MEASUREMENT LSU_stActv_mp "" UBYTE OneToOne 1 100 0.00 255.0 FORMAT "%5.1" ECU_ADDRESS 0xC0001214 /end MEASUREMENT
/begin MEASUREMENT LSU_stAdap "" UBYTE OneToOne 1 100 0.00 255.0 FORMAT "%5.1" ARRAY_SIZE 1 ECU_ADDRESS 0xD00090AB /end MEASUREMENT
/begin MEASUREMENT LSU_stAdapActv_mp "" UBYTE OneToOne 1 100 0.00 255.0 FORMAT "%5.1" ARRAY_SIZE 1 ECU_ADDRESS 0xC0001226 /end MEASUREMENT
/begin MEASUREMENT LSU_stChkDyn_mp "" UBYTE OneToOne 1 100 0.00 255.0 FORMAT "%5.1" ARRAY_SIZE 1 ECU_ADDRESS 0xC000124E /end MEASUREMENT
/begin MEASUREMENT LSU_stChng_mp "" UBYTE OneToOne 1 100 0.00 255.0 FORMAT "%5.1" ARRAY_SIZE 1 ECU_ADDRESS 0xC0001227 /end MEASUREMENT
/begin MEASUREMENT LSU_stCmpChkCon_mp "" UBYTE OneToOne 1 100 0.00 255.0 FORMAT "%5.1" ARRAY_SIZE 1 ECU_ADDRESS 0xC000124F /end MEASUREMENT
/begin MEASUREMENT LSU_stCmpChk_mp "" UBYTE OneToOne 1 100 0.00 255.0 FORMAT "%5.1" ARRAY_SIZE 1 ECU_ADDRESS 0xC0001250 /end MEASUREMENT
/begin MEASUREMENT LSU_stCmpErr_mp "" UBYTE OneToOne 1 100 0.00 255.0 FORMAT "%5.1" ARRAY_SIZE 1 ECU_ADDRESS 0xC0001251 /end MEASUREMENT
/begin MEASUREMENT LSU_stConstPOp "" UBYTE OneToOne 1 100 0.00 255.0 FORMAT "%5.1" ECU_ADDRESS 0xD00090AD /end MEASUREMENT
/begin MEASUREMENT LSU_stDebBattHi_mp "" UBYTE OneToOne 1 100 0.00 255.0 FORMAT "%5.1" ECU_ADDRESS 0xC0001204 /end MEASUREMENT
/begin MEASUREMENT LSU_stDebOvrRun_mp "" UBYTE OneToOne 1 100 0.00 255.0 FORMAT "%5.1" ECU_ADDRESS 0xC0001205 /end MEASUREMENT
/begin MEASUREMENT LSU_stDelHtCtl_mp "" UBYTE OneToOne 1 100 0.00 255.0 FORMAT "%5.1" ARRAY_SIZE 1 ECU_ADDRESS 0xC0001206 /end MEASUREMENT
/begin MEASUREMENT LSU_stDiagRegExpec_mp "" UWORD OneToOne 1 100 0.00 65535.00 FORMAT "%8.2" ARRAY_SIZE 1 ECU_ADDRESS 0xC0001208 /end MEASUREMENT
/begin MEASUREMENT LSU_stDiagReg_mp "" UWORD OneToOne 1 100 0.00 65535.00 FORMAT "%8.2" ARRAY_SIZE 1 ECU_ADDRESS 0xC000120A /end MEASUREMENT
/begin MEASUREMENT LSU_stErrBitMsk_mp "" UWORD OneToOne 1 100 0.00 65535.00 FORMAT "%8.2" ARRAY_SIZE 1 ECU_ADDRESS 0xC000120C /end MEASUREMENT
/begin MEASUREMENT LSU_stErr_mp "" UBYTE OneToOne 1 100 0.00 255.0 FORMAT "%5.1" ARRAY_SIZE 1 ECU_ADDRESS 0xC000120E /end MEASUREMENT
/begin MEASUREMENT LSU_stHold_mp "" UBYTE OneToOne 1 100 0.00 255.0 FORMAT "%5.1" ARRAY_SIZE 1 ECU_ADDRESS 0xC0001228 /end MEASUREMENT
/begin MEASUREMENT LSU_stHtCtl "" UBYTE OneToOne 1 100 0.00 255.0 FORMAT "%5.1" ARRAY_SIZE 1 ECU_ADDRESS 0xD00090B0 /end MEASUREMENT
/begin MEASUREMENT LSU_stInitReg_mp "" UWORD OneToOne 1 100 0.00 65535.00 FORMAT "%8.2" ARRAY_SIZE 1 ECU_ADDRESS 0xC0001210 /end MEASUREMENT
/begin MEASUREMENT LSU_stO2Chk "" UWORD OneToOne 1 100 0.00 65535.00 FORMAT "%8.2" ARRAY_SIZE 1 ECU_ADDRESS 0xD0007674 /end MEASUREMENT
/begin MEASUREMENT LSU_stO2Err "" UWORD OneToOne 1 100 0.00 65535.00 FORMAT "%8.2" ARRAY_SIZE 1 ECU_ADDRESS 0xD0007676 /end MEASUREMENT
/begin MEASUREMENT LSU_stOLTstVMUNEna_mp "" UBYTE OneToOne 1 100 0.00 255.0 FORMAT "%5.1" ARRAY_SIZE 1 ECU_ADDRESS 0xC0001212 /end MEASUREMENT
/begin MEASUREMENT LSU_stOpnErrIP "" UBYTE OneToOne 1 100 0.00 255.0 FORMAT "%5.1" ARRAY_SIZE 1 ECU_ADDRESS 0xD00090BD /end MEASUREMENT
/begin MEASUREMENT LSU_stOpnLdTstActv "" UBYTE OneToOne 1 100 0.00 255.0 FORMAT "%5.1" ARRAY_SIZE 1 ECU_ADDRESS 0xD00090BE /end MEASUREMENT
/begin MEASUREMENT LSU_stPlausChkCon "" UBYTE OneToOne 1 100 0.00 255.0 FORMAT "%5.1" ECU_ADDRESS 0xD00090BF /end MEASUREMENT
/begin MEASUREMENT LSU_stPlausChk_mp "" UBYTE OneToOne 1 100 0.00 255.0 FORMAT "%5.1" ARRAY_SIZE 1 ECU_ADDRESS 0xC0001252 /end MEASUREMENT
/begin MEASUREMENT LSU_stPmpCtl "" UBYTE OneToOne 1 100 0.00 255.0 FORMAT "%5.1" ARRAY_SIZE 1 ECU_ADDRESS 0xD00090C0 /end MEASUREMENT
/begin MEASUREMENT LSU_stPOpCmpChk_mp "" UBYTE OneToOne 1 100 0.00 255.0 FORMAT "%5.1" ECU_ADDRESS 0xC0001253 /end MEASUREMENT
/begin MEASUREMENT LSU_stRawOLTstEna_mp "" UBYTE OneToOne 1 100 0.00 255.0 FORMAT "%5.1" ARRAY_SIZE 1 ECU_ADDRESS 0xC0001213 /end MEASUREMENT
/begin MEASUREMENT LSU_stRmp_mp "" UBYTE OneToOne 1 100 0.00 255.0 FORMAT "%5.1" ARRAY_SIZE 1 ECU_ADDRESS 0xC0001232 /end MEASUREMENT
/begin MEASUREMENT LSU_stSCUNEna "" UBYTE OneToOne 1 100 0.00 255.0 FORMAT "%5.1" ARRAY_SIZE 1 ECU_ADDRESS 0xD00090C8 /end MEASUREMENT
/begin MEASUREMENT LSU_swtAdap "" UBYTE OneToOne 1 100 0.00 255.0 FORMAT "%5.1" ECU_ADDRESS 0xD00090CB /end MEASUREMENT
/begin MEASUREMENT LSU_tAirStrt_mp "" SWORD Temp_Cels 1 100 -3549.940 3003.560 FORMAT "%8.3" ECU_ADDRESS 0xC0001234 /end MEASUREMENT
/begin MEASUREMENT LSU_tDvtPresComp_mp "" SWORD TempDiff_Kelv 1 100 -3276.800 3276.700 FORMAT "%8.3" ECU_ADDRESS 0xC000122A /end MEASUREMENT
/begin MEASUREMENT LSU_tDvt_mp "" SWORD TempDiff_Kelv 1 100 -3276.800 3276.700 FORMAT "%8.3" ARRAY_SIZE 1 ECU_ADDRESS 0xC0001236 /end MEASUREMENT
/begin MEASUREMENT LSU_tiState1_mp "" UWORD Time_s 1 100 0.00 655.3500 FORMAT "%8.4" ARRAY_SIZE 1 ECU_ADDRESS 0xC0001254 /end MEASUREMENT
/begin MEASUREMENT LSU_tiState2_mp "" UWORD Time_s 1 100 0.00 655.3500 FORMAT "%8.4" ARRAY_SIZE 1 ECU_ADDRESS 0xC0001256 /end MEASUREMENT
/begin MEASUREMENT LSU_tiState3_mp "" UWORD Time_s 1 100 0.00 655.3500 FORMAT "%8.4" ARRAY_SIZE 1 ECU_ADDRESS 0xC0001258 /end MEASUREMENT
/begin MEASUREMENT MeUn_ctRot_mp "Anzahl Funktionsaufrufe der Rotation" UBYTE OneToOne 1 100 0.00 255.0 FORMAT "%5.1" ECU_ADDRESS 0xC000126A /end MEASUREMENT
/begin MEASUREMENT MeUn_dvolSet "Sollwert (Volumenstrom) von der Raildruckregelung" SWORD Qp_mm3_sec 1 100 -327680.0 327670.0 FORMAT "%8.1" ECU_ADDRESS 0xD0007378 /end MEASUREMENT
/begin MEASUREMENT MeUn_facCrntCtlLim_mp "Zumesseinheits-Stromregelung I-Anteil" SWORD Fact 1 100 -4.000000 3.999878 FORMAT "%8.6" ECU_ADDRESS 0xC000126C /end MEASUREMENT
/begin MEASUREMENT MeUn_iActFlt_mp "Zumesseinheits-Stromregelung gefilterter Strom-Istwert" SWORD Curr 1 100 -32768.00 32767.00 FORMAT "%8.2" ECU_ADDRESS 0xC000126E /end MEASUREMENT
/begin MEASUREMENT MeUn_iActVal "Analogeingang Strom-Istwert" SWORD Curr 1 100 -32768.00 32767.00 FORMAT "%8.2" ECU_ADDRESS 0xD000737A /end MEASUREMENT
/begin MEASUREMENT MeUn_iDvt_mp "Zumesseinheits-Stromregelung Regelabweichung" SWORD Curr 1 100 -32768.00 32767.00 FORMAT "%8.2" ECU_ADDRESS 0xC0001270 /end MEASUREMENT
/begin MEASUREMENT MeUn_iSetFlt "Zumesseinheits-Stromregelung gefilterter Strom-Sollwert" SWORD Curr 1 100 -32768.00 32767.00 FORMAT "%8.2" ECU_ADDRESS 0xD000737C /end MEASUREMENT
/begin MEASUREMENT MeUn_iSet_mp "Sollstrom für die Zumesseinheit" SWORD Curr 1 100 -32768.00 32767.00 FORMAT "%8.2" ECU_ADDRESS 0xC0001272 /end MEASUREMENT
/begin MEASUREMENT MeUn_nDiffRef_mp "gefilterte Drehzahl für Kennlinie" SWORD EngN 1 100 -16384.00 16383.50 FORMAT "%8.2" ECU_ADDRESS 0xC000125A /end MEASUREMENT
/begin MEASUREMENT MeUn_rPsPreRot_mp "Tastverhältnis des Stromreglers der MeUn vor Rotation" SWORD DtyCyc 1 100 -327.6800 327.6700 FORMAT "%8.4" ECU_ADDRESS 0xC000125C /end MEASUREMENT
/begin MEASUREMENT MeUn_rPs_mp "PWM-Signalausgang der Zumesseinheit" SWORD DtyCyc 1 100 -327.6800 327.6700 FORMAT "%8.4" ECU_ADDRESS 0xC000125E /end MEASUREMENT
/begin MEASUREMENT MeUn_rSetDT1_mp "Sollwert Tastverhältnis mit DT1-Anteil" SWORD DtyCyc 1 100 -327.6800 327.6700 FORMAT "%8.4" ECU_ADDRESS 0xC0001260 /end MEASUREMENT
/begin MEASUREMENT MeUn_rSetLin_mp "linearisierter Sollwert der Zumesseinheit" SWORD DtyCyc 1 100 -327.6800 327.6700 FORMAT "%8.4" ECU_ADDRESS 0xC0001262 /end MEASUREMENT
/begin MEASUREMENT MeUn_rSet_mp "Sollwert Tastverhältnis für Zumesseinheit" SWORD DtyCyc 1 100 -327.6800 327.6700 FORMAT "%8.4" ECU_ADDRESS 0xC0001264 /end MEASUREMENT
/begin MEASUREMENT MeUn_stActrCtl_mp "Zustand der Stellwertsteuerung für die Zumesseinheit" UBYTE OneToOne 1 100 0.00 255.0 FORMAT "%5.1" ECU_ADDRESS 0xC0001274 /end MEASUREMENT
/begin MEASUREMENT MeUn_stRot "Status der Funktion Ankerrotation der Zumesseinheit" UBYTE OneToOne 1 100 0.00 255.0 FORMAT "%5.1" ECU_ADDRESS 0xD000737E /end MEASUREMENT
/begin MEASUREMENT MeUn_tiPer_mp "Periodendauer der PWM-Endstufe" SWORD Period 1 100 -3276.800 3276.700 FORMAT "%8.3" ECU_ADDRESS 0xC0001266 /end MEASUREMENT
/begin MEASUREMENT MeUn_uRaw_mp "Analogeingang Spannungsrohwert" SWORD Volt 1 100 -6553.600 6553.400 FORMAT "%8.3" ECU_ADDRESS 0xC0001268 /end MEASUREMENT
/begin MEASUREMENT MoCADC_ctDebCmp "Fehlerzähler für Vergleich mit unabhängigem AD Wandler" UBYTE OneToOne 1 100 0.00 255.0 FORMAT "%5.1" ECU_ADDRESS 0xD000A00C /end MEASUREMENT
/begin MEASUREMENT MoCADC_ctDebTst "Fehlerzähler für Prüfung der Testspannung" UBYTE OneToOne 1 100 0.00 255.0 FORMAT "%5.1" ECU_ADDRESS 0xD000A00D /end MEASUREMENT
/begin MEASUREMENT MoCADC_ctDebVltgRatio "Fehlerzähler der Ratiometriekorrekturfaktor- Plausibilisierung" UBYTE OneToOne 1 100 0.00 255.0 FORMAT "%5.1" ECU_ADDRESS 0xD000A00E /end MEASUREMENT
/begin MEASUREMENT MoCADC_ctDiagCmp "" UBYTE OneToOne 1 100 0.00 255.0 FORMAT "%5.1" ECU_ADDRESS 0xD00090CE /end MEASUREMENT
/begin MEASUREMENT MoCADC_ctDiagTst "Zähler für Setzen des Testflags in der Diagnose bei der Prüfung der Testspannung in der ADC Überwachung" UBYTE OneToOne 1 100 0.00 255.0 FORMAT "%5.1" ECU_ADDRESS 0xD00090CF /end MEASUREMENT
/begin MEASUREMENT MoCADC_ctDiagVltgRatio "Zähler für Setzen des Testflags in der Diagnose bei der Prüfung des Ratiometriekorekturfaktors in der ADC Überwachung" UBYTE OneToOne 1 100 0.00 255.0 FORMAT "%5.1" ECU_ADDRESS 0xD00090D0 /end MEASUREMENT
/begin MEASUREMENT MoCADC_ctStyADC1 "Zähler für Stationärerkennung des internen AD Wandlers" UBYTE OneToOne 1 100 0.00 255.0 FORMAT "%5.1" ECU_ADDRESS 0xD000A00F /end MEASUREMENT
/begin MEASUREMENT MoCADC_ctStyADC2 "Zähler für Stationärerkennung des externen AD Wandlers" UBYTE OneToOne 1 100 0.00 255.0 FORMAT "%5.1" ECU_ADDRESS 0xD000A010 /end MEASUREMENT
/begin MEASUREMENT MoCADC_facVltgRatio "Ratiometriekorrekturfaktor in der Funktionsüberwachung" UWORD Mo_fac_q0p00098 1 100 0.00 63.99902 FORMAT "%8.5" ECU_ADDRESS 0xD000A014 /end MEASUREMENT
/begin MEASUREMENT MoCADC_st "Status Info der ADC Überwachung" UBYTE OneToOne 1 100 0.00 255.0 FORMAT "%5.1" ECU_ADDRESS 0xD000A016 /end MEASUREMENT
/begin MEASUREMENT MoCADC_stIrvErrCmp "Irreversibles Fehlerbit aus Vergleichsprüfung in der ADC Überwachung" UBYTE OneToOne 1 100 0.00 255.0 FORMAT "%5.1" ECU_ADDRESS 0xD000A262 /end MEASUREMENT
/begin MEASUREMENT MoCADC_stIrvErrTst "Irreversibles Fehlerbit aus Prüfung der Testspannung in der ADC Überwachung" UBYTE OneToOne 1 100 0.00 255.0 FORMAT "%5.1" ECU_ADDRESS 0xD000A263 /end MEASUREMENT
/begin MEASUREMENT MoCADC_stIrvErrVltgRatio "Irreversibles Fehlerbit aus Prüfung des Ratiometriekorekturfaktors in der ADC Überwachung" UBYTE OneToOne 1 100 0.00 255.0 FORMAT "%5.1" ECU_ADDRESS 0xD000A264 /end MEASUREMENT
/begin MEASUREMENT MoCADC_uADC1 "Spannung von Fahrpedalsignal 2 am internen ADC" UBYTE Mo_u_mV_q19p53 1 100 0.00 4980. FORMAT "%5.0" ECU_ADDRESS 0xD000A011 /end MEASUREMENT
/begin MEASUREMENT MoCADC_uADC2 "Spannung von Fahrpedalsignal 2 am externen ADC" UBYTE Mo_u_mV_q19p53 1 100 0.00 4980. FORMAT "%5.0" ECU_ADDRESS 0xD000A012 /end MEASUREMENT
/begin MEASUREMENT MoCADC_uTst_mp "Spannung am ADC Testspannungs-Eingang" SWORD Mo_u_mV_q4p88 1 100 -160000.0 159995.1 FORMAT "%8.1" ECU_ADDRESS 0xC0001276 /end MEASUREMENT
/begin MEASUREMENT MoCCom_bCPUNew "" UBYTE OneToOne 1 100 0.00 1.000 BIT_MASK 0x1 FORMAT "%5.3" ECU_ADDRESS 0xD000A0F0 /end MEASUREMENT
/begin MEASUREMENT MoCCom_bErrCntErr "" UBYTE OneToOne 1 100 0.00 1.000 BIT_MASK 0x8 FORMAT "%5.3" ECU_ADDRESS 0xD000A0E8 /end MEASUREMENT
/begin MEASUREMENT MoCCom_bErrCntNPl "" UBYTE OneToOne 1 100 0.00 1.000 BIT_MASK 0x1 FORMAT "%5.3" ECU_ADDRESS 0xD000A0E8 /end MEASUREMENT
/begin MEASUREMENT MoCCom_bPCPNew "" UBYTE OneToOne 1 100 0.00 1.000 BIT_MASK 0x4 FORMAT "%5.3" ECU_ADDRESS 0xD000A0F0 /end MEASUREMENT
/begin MEASUREMENT MoCCom_bPFCNew "" UBYTE OneToOne 1 100 0.00 1.000 BIT_MASK 0x2 FORMAT "%5.3" ECU_ADDRESS 0xD000A0F0 /end MEASUREMENT
/begin MEASUREMENT MoCCom_bSpiErr "" UBYTE OneToOne 1 100 0.00 1.000 BIT_MASK 0x80 FORMAT "%5.3" ECU_ADDRESS 0xD000A0E8 /end MEASUREMENT
/begin MEASUREMENT MoCCom_bSpiNPl "" UBYTE OneToOne 1 100 0.00 1.000 BIT_MASK 0x10 FORMAT "%5.3" ECU_ADDRESS 0xD000A0E8 /end MEASUREMENT
/begin MEASUREMENT MoCCom_ctErrFC "Fehlerzähler im Funktionsrechner für Fehler vom Überwachungsmodul" UBYTE OneToOne 1 100 0.00 255.0 FORMAT "%5.1" ECU_ADDRESS 0xD000A0DB /end MEASUREMENT
/begin MEASUREMENT MoCCom_ctErrMM "Fehlerzählerrückmeldung von Überwachungsmodul" UBYTE OneToOne 1 100 0.00 255.0 FORMAT "%5.1" ECU_ADDRESS 0xD000A0DD /end MEASUREMENT
/begin MEASUREMENT MoCCom_ctErrMMMsg "Info an Ebene 1: Fehlerzählerrückmeldung von Überwachungsmodul" UBYTE OneToOne 1 100 0.00 255.0 FORMAT "%5.1" ECU_ADDRESS 0xD00090D1 /end MEASUREMENT
/begin MEASUREMENT MoCCom_ctErrMMOld "Alte Fehlerzählerrückmeldung von Überwachungsmodul" UBYTE OneToOne 1 100 0.00 255.0 FORMAT "%5.1" ECU_ADDRESS 0xD000A0DE /end MEASUREMENT
/begin MEASUREMENT MoCCom_ctErrSPI "Fehlerzähler für SPI Übertragungen in Kommunikation mit Überwachungsmodul" UBYTE OneToOne 1 100 0.00 255.0 FORMAT "%5.1" ECU_ADDRESS 0xD000A0DF /end MEASUREMENT
/begin MEASUREMENT MoCCom_ctSOPTstActv "" UBYTE OneToOne 1 100 0.00 255.0 FORMAT "%5.1" ECU_ADDRESS 0xD000A0E0 /end MEASUREMENT
/begin MEASUREMENT MoCCom_Query "Erweiterte Frage von Überwachungsmodul" ULONG OneToOne 1 100 0.00 4294967295.00 FORMAT "%13.2" ECU_ADDRESS 0xD000A0EC /end MEASUREMENT
/begin MEASUREMENT MoCCom_Response "Antwort auf Frage vom Überwachungsmodul" ULONG OneToOne 1 100 0.00 4294967295.00 FORMAT "%13.2" ECU_ADDRESS 0xD000A0E4 /end MEASUREMENT
/begin MEASUREMENT MoCCom_st "Status Bitleiste für Kommunikation mit Überwachungsmodul" UBYTE OneToOne 1 100 0.00 255.0 FORMAT "%5.1" ECU_ADDRESS 0xD000A0E8 /end MEASUREMENT
/begin MEASUREMENT MoCCom_stQueryNew "Bitleiste für Info 'Neue Frage von Überwachungsmodul'" UBYTE OneToOne 1 100 0.00 255.0 FORMAT "%5.1" ECU_ADDRESS 0xD000A0F0 /end MEASUREMENT
/begin MEASUREMENT MoCCom_stWDAActvMsg "Info an Ebene 1: Watchdogabschaltung aktiv" UBYTE OneToOne 1 100 0.00 255.0 FORMAT "%5.1" ECU_ADDRESS 0xD00090D2 /end MEASUREMENT
/begin MEASUREMENT MoCCPU_ctSeq "Sequenzzähler für Befehlstest" UBYTE OneToOne 1 100 0.00 255.0 FORMAT "%5.1" ECU_ADDRESS 0xD000A0F1 /end MEASUREMENT
/begin MEASUREMENT MoCCPU_PartResp "Teilantwort aus Befehlstest an das Überwachungsmodul" ULONG OneToOne 1 100 0.00 4294967295.00 FORMAT "%13.2" ECU_ADDRESS 0xD000A0F8 /end MEASUREMENT
/begin MEASUREMENT MoCCPU_Query "" UBYTE OneToOne 1 100 0.00 255.0 FORMAT "%5.1" ECU_ADDRESS 0xD000A0FC /end MEASUREMENT
/begin MEASUREMENT MoCCPU_TempRes "Zwischenergebnis des Befehlstests" ULONG OneToOne 1 100 0.00 4294967295.00 FORMAT "%13.2" ECU_ADDRESS 0xD000A0F4 /end MEASUREMENT
/begin MEASUREMENT MoCMem_adCurrent "Aktueller Adresszeiger für den zyklischen ROM-check" ULONG OneToOne 1 100 0.00 4294967295.00 FORMAT "%13.2" ECU_ADDRESS 0xD000A018 /end MEASUREMENT
/begin MEASUREMENT MoCMem_adRamOffset "Aktueller Offset für den zyklischen RAM-check" ULONG OneToOne 1 100 0.00 4294967295.00 FORMAT "%13.2" ECU_ADDRESS 0xD000A01C /end MEASUREMENT
/begin MEASUREMENT MoCMem_ctDebErrChkRAM "Fehlerzähler für Doppelablagefehler und zykischen RAM-Test" UBYTE OneToOne 1 100 0.00 255.0 FORMAT "%5.1" ECU_ADDRESS 0xD000A020 /end MEASUREMENT
/begin MEASUREMENT MoCMem_ctDebErrChkROM "Fehlerzähler für zykischen ROM-Test" UBYTE OneToOne 1 100 0.00 255.0 FORMAT "%5.1" ECU_ADDRESS 0xD000A021 /end MEASUREMENT
/begin MEASUREMENT MoCMem_ctDebHealChkRAM "Heilungszähler für Doppelablagefehler und zykischen RAM-Test" UBYTE OneToOne 1 100 0.00 255.0 FORMAT "%5.1" ECU_ADDRESS 0xD000A022 /end MEASUREMENT
/begin MEASUREMENT MoCMem_ctDebHealChkROM "Heilungszähler für zyklischen ROM-Test" UBYTE OneToOne 1 100 0.00 255.0 FORMAT "%5.1" ECU_ADDRESS 0xD000A023 /end MEASUREMENT
/begin MEASUREMENT MoCMem_numCurrent "Aktuelle Prüfsumme für den zyklischen ROM-check" ULONG OneToOne 1 100 0.00 4294967295.00 FORMAT "%13.2" ECU_ADDRESS 0xD000A024 /end MEASUREMENT
/begin MEASUREMENT MoCMem_st "" UBYTE OneToOne 1 100 0.00 255.0 FORMAT "%5.1" ECU_ADDRESS 0xD000CF38 /end MEASUREMENT
/begin MEASUREMENT MoCMem_stFunctionSwitch "Variable schaltet zwischen überwachtem ROM-Code und ROM-Daten-Bereich um" UBYTE OneToOne 1 100 0.00 255.0 FORMAT "%5.1" ECU_ADDRESS 0xD000A028 /end MEASUREMENT
/begin MEASUREMENT MoCMem_stTotMemChk "Anforderung für komplette RAM/ROM-Speichertests in der Initialisierung" UBYTE OneToOne 1 100 0.00 255.0 FORMAT "%5.1" ECU_ADDRESS 0xD000CF3A /end MEASUREMENT
/begin MEASUREMENT MoCPCP_adCurrent "Aktueller Adresszeiger für die PCP-Code-Prüfung" ULONG OneToOne 1 100 0.00 4294967295.00 FORMAT "%13.2" ECU_ADDRESS 0xD000A02C /end MEASUREMENT
/begin MEASUREMENT MoCPCP_ctErr "Fehlerzähler für die CRC-Prüfsummenberechnung" UBYTE OneToOne 1 100 0.00 255.0 FORMAT "%5.1" ECU_ADDRESS 0xD000A030 /end MEASUREMENT
/begin MEASUREMENT MoCPCP_ctHeal "Heilungszähler für CRC-Prüfsummenfehler" UBYTE OneToOne 1 100 0.00 255.0 FORMAT "%5.1" ECU_ADDRESS 0xD000A031 /end MEASUREMENT
/begin MEASUREMENT MoCPCP_numCurrentCSum "Aktuelle Prüfsumme für die PCP-Code-Prüfung" ULONG OneToOne 1 100 0.00 4294967295.00 FORMAT "%13.2" ECU_ADDRESS 0xD000A034 /end MEASUREMENT
/begin MEASUREMENT MoCPFC_Checksum "Temporäres Ergebnis der Checksummenberechnung für die Programmablaufkontrolle in der Überwachung" ULONG OneToOne 1 100 0.00 4294967295.00 FORMAT "%13.2" ECU_ADDRESS 0xD000A11C /end MEASUREMENT
/begin MEASUREMENT MoCPFC_Checkword "Modulspezifisches Prüfwort für die Programmablaufkontrolle" ULONG OneToOne 1 100 0.00 4294967295.00 FORMAT "%13.2" ECU_ADDRESS 0xD000A120 /end MEASUREMENT
/begin MEASUREMENT MoCPFC_Counter "Modulaufrufzähler für die Programmablaufkontrolle in der Überwachung" UBYTE OneToOne 1 100 0.00 255.0 FORMAT "%5.1" ECU_ADDRESS 0xD000A124 /end MEASUREMENT
/begin MEASUREMENT MoCPFC_PartResp "Teilantwort von der Programmablaufkontrolle für das Überwachungsmodul" ULONG OneToOne 1 100 0.00 4294967295.00 FORMAT "%13.2" ECU_ADDRESS 0xD000A128 /end MEASUREMENT
/begin MEASUREMENT MoCSOP_ctDebPSDia "Anzahl Wiederholungen eines Endstufentests" UBYTE OneToOne 1 100 0.00 255.0 FORMAT "%5.1" ECU_ADDRESS 0xD000A12C /end MEASUREMENT
/begin MEASUREMENT MoCSOP_ctDebSOPTst "Anzahl der Wiederholungen des Abschaltpfadtests (Realisierung einer Zeitüberwachung)" UBYTE OneToOne 1 100 0.00 255.0 FORMAT "%5.1" ECU_ADDRESS 0xD000A12D /end MEASUREMENT
/begin MEASUREMENT MoCSOP_ctErrMM "Kopie des Fehlerzählers aus dem Überwachungsmodul im Funktionsrechner" UBYTE OneToOne 1 100 0.00 255.0 FORMAT "%5.1" ECU_ADDRESS 0xD000A130 /end MEASUREMENT
/begin MEASUREMENT MoCSOP_st "" UBYTE OneToOne 1 100 0.00 255.0 FORMAT "%5.1" ECU_ADDRESS 0xD000A12E /end MEASUREMENT
/begin MEASUREMENT MoCSOP_stActvMsg "Information für Ebene 1,2: Abschaltpfadtest ist aktiv" UBYTE OneToOne 1 100 0.00 255.0 FORMAT "%5.1" ECU_ADDRESS 0xD000922F /end MEASUREMENT
/begin MEASUREMENT MoCSOP_stRdy "Status-Variable zur Synchronisation von Abschaltpfadtest und Frage-/Antwort-Kommunikation" UBYTE OneToOne 1 100 0.00 255.0 FORMAT "%5.1" ECU_ADDRESS 0xD000A131 /end MEASUREMENT
/begin MEASUREMENT MoExe_ctCyc "" UBYTE OneToOne 1 100 0.00 255.0 FORMAT "%5.1" ECU_ADDRESS 0xD000A038 /end MEASUREMENT
/begin MEASUREMENT MoFACC_st "Statusinformationen für ACC-Betrieb" UBYTE OneToOne 1 100 0.00 255.0 FORMAT "%5.1" ECU_ADDRESS 0xD000A039 /end MEASUREMENT
/begin MEASUREMENT MoFAcs_rTrqAcs "" UBYTE Mo_r_prc_q0p39 1 100 0.00 99.61 FORMAT "%5.2" ECU_ADDRESS 0xD000A03A /end MEASUREMENT
/begin MEASUREMENT MoFAcs_rTrqARS_mp "" UBYTE Mo_r_prc_q0p39 1 100 0.00 99.61 FORMAT "%5.2" ECU_ADDRESS 0xD000A135 /end MEASUREMENT
/begin MEASUREMENT MoFAcs_rTrqLos "" UBYTE Mo_r_prc_q0p39 1 100 0.00 99.61 FORMAT "%5.2" ECU_ADDRESS 0xD000A03B /end MEASUREMENT
/begin MEASUREMENT MoFAcs_rTrqLosPT "" UBYTE Mo_r_prc_q0p39 1 100 0.00 99.61 FORMAT "%5.2" ECU_ADDRESS 0xD000A13A /end MEASUREMENT
/begin MEASUREMENT MoFAcs_trqAcs "" SWORD Mo_trq_nm_q0p1 1 100 -3276.800 3276.700 FORMAT "%8.3" ECU_ADDRESS 0xD000A03C /end MEASUREMENT
/begin MEASUREMENT MoFAcs_trqAcsMsg "" SWORD Mo_trq_nm_q0p1 1 100 -3276.800 3276.700 FORMAT "%8.3" ECU_ADDRESS 0xD0007380 /end MEASUREMENT
/begin MEASUREMENT MoFAcs_trqAC_mp "" SWORD Mo_trq_nm_q0p1 1 100 -3276.800 3276.700 FORMAT "%8.3" ECU_ADDRESS 0xC0001278 /end MEASUREMENT
/begin MEASUREMENT MoFAcs_trqAlt_mp "" SWORD Mo_trq_nm_q0p1 1 100 -3276.800 3276.700 FORMAT "%8.3" ECU_ADDRESS 0xC000127A /end MEASUREMENT
/begin MEASUREMENT MoFAcs_trqARSMax_mp "" SWORD Mo_trq_nm_q0p1 1 100 -3276.800 3276.700 FORMAT "%8.3" ECU_ADDRESS 0xC000127C /end MEASUREMENT
/begin MEASUREMENT MoFAcs_trqARS_mp "" SWORD Mo_trq_nm_q0p1 1 100 -3276.800 3276.700 FORMAT "%8.3" ECU_ADDRESS 0xC000127E /end MEASUREMENT
/begin MEASUREMENT MoFAcs_trqLosPT_mp "" SWORD Mo_trq_nm_q0p1 1 100 -3276.800 3276.700 FORMAT "%8.3" ECU_ADDRESS 0xC0001280 /end MEASUREMENT
/begin MEASUREMENT MoFAcs_trqLos_mp "" SWORD Mo_trq_nm_q0p1 1 100 -3276.800 3276.700 FORMAT "%8.3" ECU_ADDRESS 0xC0001282 /end MEASUREMENT
/begin MEASUREMENT MoFAPP_ctDeb "Fehlerzähler bei zueinander unplausiblen Fahrpedalsignalen in der Überwachung" UBYTE Mo_ti40ms_ms_q40p0 1 100 0.00 10200. FORMAT "%5.0" ECU_ADDRESS 0xD000A03E /end MEASUREMENT
/begin MEASUREMENT MoFAPP_ctDiag "Zähler für Setzen des Testflags in der Diagnose" UBYTE OneToOne 1 100 0.00 255.0 FORMAT "%5.1" ECU_ADDRESS 0xD00090D3 /end MEASUREMENT
/begin MEASUREMENT MoFAPP_stDiff_mp "Unplausibilität bei Vergleich der beiden Fahrpedalsignale" UBYTE OneToOne 1 100 0.00 255.0 FORMAT "%5.1" ECU_ADDRESS 0xC0001284 /end MEASUREMENT
/begin MEASUREMENT MoFAPP_stIrvErr "Irreversibles Fehlerbit bei der Fahrpedalüberwachung in der Funktionsüberwachung" UBYTE OneToOne 1 100 0.00 255.0 FORMAT "%5.1" ECU_ADDRESS 0xD000A265 /end MEASUREMENT
/begin MEASUREMENT MoFAPP_stLimpMsg "Info für Ebene 1: Fehlerreaktion aus Ebene 2 angefordert" UBYTE OneToOne 1 100 0.00 255.0 FORMAT "%5.1" ECU_ADDRESS 0xD00090D4 /end MEASUREMENT
/begin MEASUREMENT MoFAPP_stTst "Kennung für Freigabebedingung der Fehlerprüfung für die Diagnose" UBYTE OneToOne 1 100 0.00 255.0 FORMAT "%5.1" ECU_ADDRESS 0xD00090D5 /end MEASUREMENT
/begin MEASUREMENT MoFAPP_u "Position des Fahrpedals für die Funktionsüberwachung" UBYTE Mo_u_mV_q19p53 1 100 0.00 4980. FORMAT "%5.0" ECU_ADDRESS 0xD000A03F /end MEASUREMENT
/begin MEASUREMENT MoFAPP_uRaw1_mp "Aktueller Wert für Fahrpedalsignal 1" UBYTE Mo_u_mV_q19p53 1 100 0.00 4980. FORMAT "%5.0" ECU_ADDRESS 0xC0001285 /end MEASUREMENT
/begin MEASUREMENT MoFAPP_uRaw2_mp "Aktueller Wert für Fahrpedalsignal 2" UBYTE Mo_u_mV_q9p77 1 100 0.00 2490. FORMAT "%5.0" ECU_ADDRESS 0xC0001286 /end MEASUREMENT
/begin MEASUREMENT MoFASD_rTrq "Ruckeldämpferstellgröße in der Überwachung" UBYTE Mo_r_prc_q0p39 1 100 0.00 99.61 FORMAT "%5.2" ECU_ADDRESS 0xD000A044 /end MEASUREMENT
/begin MEASUREMENT MoFASD_trqASD_mp "" SWORD Mo_trq_nm_q0p1 1 100 -3276.800 3276.700 FORMAT "%8.3" ECU_ADDRESS 0xC0001288 /end MEASUREMENT
/begin MEASUREMENT MoFASD_trqFlt "PT1 Filtervariable in der Ruckeldämpferüberwachung" SLONG Mo_trq_nm_q0p00000152587890625 1 100 -3276.80000000 3276.79999847 FORMAT "%13.8" ECU_ADDRESS 0xD000A040 /end MEASUREMENT
/begin MEASUREMENT MoFBrk_st "Status des Bremslichtschalters" UBYTE OneToOne 1 100 0.00 255.0 FORMAT "%5.1" ECU_ADDRESS 0xD000A045 /end MEASUREMENT
/begin MEASUREMENT MoFCCtl_st "Statusinformationen für FGR-Betrieb" UBYTE OneToOne 1 100 0.00 255.0 FORMAT "%5.1" ECU_ADDRESS 0xD000A046 /end MEASUREMENT
/begin MEASUREMENT MoFClth_ctDeb "Entprellzähler zum Kupplungszustand" UBYTE OneToOne 1 100 0.00 255.0 FORMAT "%5.1" ECU_ADDRESS 0xD000A047 /end MEASUREMENT
/begin MEASUREMENT MoFClth_st "Kupplungszustand" UBYTE OneToOne 1 100 0.00 255.0 FORMAT "%5.1" ECU_ADDRESS 0xD000A048 /end MEASUREMENT
/begin MEASUREMENT MoFCoEng_rTrqFlt "PT1 Filtervariable" UWORD Mo_r_prc_q0p00152 1 100 0.00 99.99847 FORMAT "%8.5" ECU_ADDRESS 0xD000A04A /end MEASUREMENT
/begin MEASUREMENT MoFCoEng_rTrqInrSet "Relatives zulässige innere Motormoment nach dem Führungsformer" UBYTE Mo_r_prc_q0p39 1 100 0.00 99.61 FORMAT "%5.2" ECU_ADDRESS 0xD000A04C /end MEASUREMENT
/begin MEASUREMENT MoFCoEng_rTrqInr_mp "Relatives zulässiges innere Motormoment vor dem Führungsformer" UBYTE Mo_r_prc_q0p39 1 100 0.00 99.61 FORMAT "%5.2" ECU_ADDRESS 0xC000128A /end MEASUREMENT
/begin MEASUREMENT MoFCoEng_rTrqPtd "Relatives zulässige innere Motormoment" UBYTE Mo_r_prc_q0p39 1 100 0.00 99.61 FORMAT "%5.2" ECU_ADDRESS 0xD000A04D /end MEASUREMENT
/begin MEASUREMENT MoFCoEng_stTrqFlt "Status Aktivierung/Deaktivierung der Filterung des zulässigen Moments" UBYTE OneToOne 1 100 0.00 255.0 FORMAT "%5.1" ECU_ADDRESS 0xD000A04E /end MEASUREMENT
/begin MEASUREMENT MoFCoEng_trqInrSet_mp "Absolutes zulässige innere Motormoment nach Führungsformer vor Ruckeldämpfer" SWORD Mo_trq_nm_q0p1 1 100 -3276.800 3276.700 FORMAT "%8.3" ECU_ADDRESS 0xC000128C /end MEASUREMENT
/begin MEASUREMENT MoFCoEng_trqInr_mp "Absolutes zulässige innere Motormoment ungefiltert" SWORD Mo_trq_nm_q0p1 1 100 -3276.800 3276.700 FORMAT "%8.3" ECU_ADDRESS 0xC000128E /end MEASUREMENT
/begin MEASUREMENT MoFCoEng_trqLos_mp "Absolutes delta Motorverlustmoment" SWORD Mo_trq_nm_q0p1 1 100 -3276.800 3276.700 FORMAT "%8.3" ECU_ADDRESS 0xC0001290 /end MEASUREMENT
/begin MEASUREMENT MoFCoEng_trqPtd_mp "Absolutes zulässige innere Motormoment" SWORD Mo_trq_nm_q0p1 1 100 -3276.800 3276.700 FORMAT "%8.3" ECU_ADDRESS 0xC0001292 /end MEASUREMENT
/begin MEASUREMENT MoFCoOfs_ctIdxDel "Verzögerungszähler in der Überwachung" UBYTE OneToOne 1 100 0.00 255.0 FORMAT "%5.1" ECU_ADDRESS 0xD000A04F /end MEASUREMENT
/begin MEASUREMENT MoFCoOfs_rTrqPtdDel_mp "" UBYTE Mo_r_prc_q0p39 1 100 0.00 99.61 FORMAT "%5.2" ECU_ADDRESS 0xC0001294 /end MEASUREMENT
/begin MEASUREMENT MoFCoOfs_rTrqPtdFlt "Gefilteretes zulässiges inneres Motormoment" UWORD Mo_r_prc_q0p00152 1 100 0.00 99.99847 FORMAT "%8.5" ECU_ADDRESS 0xD000A050 /end MEASUREMENT
/begin MEASUREMENT MoFCoOfs_rTrqPtdMsg "Ebene 1 Schnittstelle zulässiges inneres Motormoment" UBYTE Mo_r_prc_q0p39 1 100 0.00 99.61 FORMAT "%5.2" ECU_ADDRESS 0xD00090D6 /end MEASUREMENT
/begin MEASUREMENT MoFCoOfs_rTrqPtdOfs "Relatives zulässiges inneres Motormoment mit Offset der Ebene 2" UBYTE Mo_r_prc_q0p39 1 100 0.00 99.61 FORMAT "%5.2" ECU_ADDRESS 0xD000A052 /end MEASUREMENT
/begin MEASUREMENT MoFCoOfs_rTrqPtd_mp "Offset behaftetes zulässiges inneres Motormoment" UBYTE Mo_r_prc_q0p39 1 100 0.00 99.61 FORMAT "%5.2" ECU_ADDRESS 0xC0001295 /end MEASUREMENT
/begin MEASUREMENT MoFCoOfs_trqPtdOfs_mp "" SWORD Mo_trq_nm_q0p1 1 100 -3276.800 3276.700 FORMAT "%8.3" ECU_ADDRESS 0xC0001296 /end MEASUREMENT
/begin MEASUREMENT MoFCoVeh_facTrqComp_mp "Faktor zur Verlustmomentkompensation" UBYTE Mo_r_prc_q0p39 1 100 0.00 99.61 FORMAT "%5.2" ECU_ADDRESS 0xC0001298 /end MEASUREMENT
/begin MEASUREMENT MoFCoVeh_rTrqComp "Moment der kompensierten Verluste (relativ)" UBYTE Mo_r_prc_q0p39 1 100 0.00 99.61 FORMAT "%5.2" ECU_ADDRESS 0xD000A053 /end MEASUREMENT
/begin MEASUREMENT MoFCoVeh_trqCompMsg "Moment der kompensierten Verluste zur Begrenzung in der Ebene 1" SWORD Mo_trq_nm_q0p1 1 100 -3276.800 3276.700 FORMAT "%8.3" ECU_ADDRESS 0xD0007382 /end MEASUREMENT
/begin MEASUREMENT MoFCoVeh_trqPrpClth_mp "koordiniertes Fahrerwunschmoment auf Basis Kupplungsmoment" SWORD Mo_trq_nm_q0p1 1 100 -3276.800 3276.700 FORMAT "%8.3" ECU_ADDRESS 0xC000129A /end MEASUREMENT
/begin MEASUREMENT MoFCoVeh_trqVehPtd "zulässiges Moment der Fahrzeugfunktionen" SWORD Mo_trq_nm_q0p1 1 100 -3276.800 3276.700 FORMAT "%8.3" ECU_ADDRESS 0xD000A054 /end MEASUREMENT
/begin MEASUREMENT MoFCoVeh_trqVehPtdMsg "zulässiges Moment der Fahrzeugfunktionen zur Begrenzung in der Ebene 1" SWORD Mo_trq_nm_q0p1 1 100 -3276.800 3276.700 FORMAT "%8.3" ECU_ADDRESS 0xD0007384 /end MEASUREMENT
/begin MEASUREMENT MoFCoVeh_trqVMD_mp "koordiniertes Fahrerwunschmoment auf Basis Radmoment" SWORD Mo_trq_nm_q1p6 1 100 -52428.80 52427.20 FORMAT "%8.2" ECU_ADDRESS 0xC000129C /end MEASUREMENT
/begin MEASUREMENT MoFDCS_stDem "Statusinfo der MSR-Eingriffüberwachung" UBYTE OneToOne 1 100 0.00 255.0 FORMAT "%5.1" ECU_ADDRESS 0xD000A056 /end MEASUREMENT
/begin MEASUREMENT MoFDCS_stIrvErr "Irreversibles Fehlerbit aus der MSR Eingriffsüberwachung" UBYTE OneToOne 1 100 0.00 1.000 BIT_MASK 0x1 FORMAT "%5.3" ECU_ADDRESS 0xD000A266 /end MEASUREMENT
/begin MEASUREMENT MoFDCS_trqDem "Angefordertes Motormoment von MSR-Steuerung" SWORD Mo_trq_nm_q0p1 1 100 -3276.800 3276.700 FORMAT "%8.3" ECU_ADDRESS 0xD000A058 /end MEASUREMENT
/begin MEASUREMENT MoFDrAs_ctDebACC "TurnOnDelay-Zähler ACC" UBYTE OneToOne 1 100 0.00 255.0 FORMAT "%5.1" ECU_ADDRESS 0xD000A05A /end MEASUREMENT
/begin MEASUREMENT MoFDrAs_ctDebCCtl "TurnOnDelay-Zähler FGR" UBYTE OneToOne 1 100 0.00 255.0 FORMAT "%5.1" ECU_ADDRESS 0xD000A05B /end MEASUREMENT
/begin MEASUREMENT MoFDrAs_stACCDel_mp "TurnOnDelay ACC aktiv" UBYTE OneToOne 1 100 0.00 255.0 FORMAT "%5.1" ECU_ADDRESS 0xC00012A4 /end MEASUREMENT
/begin MEASUREMENT MoFDrAs_stACCPtdMsg "Message zur Ebene 1 ACC-Eingriff zulässig" UBYTE OneToOne 1 100 0.00 255.0 FORMAT "%5.1" ECU_ADDRESS 0xD00090D7 /end MEASUREMENT
/begin MEASUREMENT MoFDrAs_stCCtlDel_mp "TurnOnDelay FGR aktiv" UBYTE OneToOne 1 100 0.00 255.0 FORMAT "%5.1" ECU_ADDRESS 0xC00012A5 /end MEASUREMENT
/begin MEASUREMENT MoFDrAs_stCCtlPtd "FlipFlop-Zustand FGR-Eingriff zulässig" UBYTE OneToOne 1 100 0.00 255.0 FORMAT "%5.1" ECU_ADDRESS 0xD000A05C /end MEASUREMENT
/begin MEASUREMENT MoFDrAs_stCCtlPtdMsg "Message zur Ebene 1 FGR-Eingriff zulässig" UBYTE OneToOne 1 100 0.00 255.0 FORMAT "%5.1" ECU_ADDRESS 0xD00090D8 /end MEASUREMENT
/begin MEASUREMENT MoFDrAs_stLogPtd_mp "Ergebnis XOR-Logik der ACC- und FGR-Zulässigkeiten" UBYTE OneToOne 1 100 0.00 255.0 FORMAT "%5.1" ECU_ADDRESS 0xC00012A6 /end MEASUREMENT
/begin MEASUREMENT MoFDrAs_stPtdMsg "Eingiff eines Fahrerassistenzsystemes zugelassen" UBYTE OneToOne 1 100 0.00 255.0 FORMAT "%5.1" ECU_ADDRESS 0xD00090D9 /end MEASUREMENT
/begin MEASUREMENT MoFDrAs_trqPtd "Zulässiges Radmoment der Fahrerassistenzsysteme" SWORD Mo_trq_nm_q1p6 1 100 -52428.80 52427.20 FORMAT "%8.2" ECU_ADDRESS 0xD000A05E /end MEASUREMENT
/begin MEASUREMENT MoFDrAs_vMin_mp "Ermittelte Vergleichsgeschwindigkeit zu MoFVSS_v" UWORD Mo_v_kmh_q0p01 1 100 0.00 655.3500 FORMAT "%8.4" ECU_ADDRESS 0xC00012A8 /end MEASUREMENT
/begin MEASUREMENT MoFDrDem_rAPP "Fahrpedalwert der Überwachungsfunktionen" UBYTE Mo_r_prc_q0p39 1 100 0.00 99.61 FORMAT "%5.2" ECU_ADDRESS 0xD000A060 /end MEASUREMENT
/begin MEASUREMENT MoFDrDem_rTrqMin_mp "relative Gesamt-Verlustmomente" UWORD Mo_r_prc_q0p39 1 100 0.00 25599.61 FORMAT "%8.2" ECU_ADDRESS 0xC00012AA /end MEASUREMENT
/begin MEASUREMENT MoFDrDem_rTrqPT "Übersetzungsverhältnis des Triebstranges" UWORD Mo_fac_q0p01 1 100 0.00 655.3500 FORMAT "%8.4" ECU_ADDRESS 0xD000A062 /end MEASUREMENT
/begin MEASUREMENT MoFDrDem_trqEng_mp "Fahrerwunschmoment auf Basis Kurbelwelle" SWORD Mo_trq_nm_q0p1 1 100 -3276.800 3276.700 FORMAT "%8.3" ECU_ADDRESS 0xC00012AC /end MEASUREMENT
/begin MEASUREMENT MoFDrDem_trqOvrRun_mp "berücksichtigte Verlustmomente" SWORD Mo_trq_nm_q0p1 1 100 -3276.800 3276.700 FORMAT "%8.3" ECU_ADDRESS 0xC00012AE /end MEASUREMENT
/begin MEASUREMENT MoFDrDem_trqPtd "zulässiges Fahrerwunschmoment auf Basis Radmoment" SWORD Mo_trq_nm_q1p6 1 100 -52428.80 52427.20 FORMAT "%8.2" ECU_ADDRESS 0xD000A064 /end MEASUREMENT
/begin MEASUREMENT MoFESpd_ctDeb "Fehlerzähler für Motordrehzahlvergleich in der Funktionsüberwachung" UBYTE OneToOne 1 100 0.00 255.0 FORMAT "%5.1" ECU_ADDRESS 0xD000A066 /end MEASUREMENT
/begin MEASUREMENT MoFESpd_ctDiag "Zähler für Setzen des Testflags in der Diagnose" UBYTE OneToOne 1 100 0.00 255.0 FORMAT "%5.1" ECU_ADDRESS 0xD00090DA /end MEASUREMENT
/begin MEASUREMENT MoFESpd_nEng "Motordrehzahl in der Funktionsüberwachung" UBYTE Mo_n_rpm_q40p0 1 100 0.00 10200. FORMAT "%5.0" ECU_ADDRESS 0xD000A070 /end MEASUREMENT
/begin MEASUREMENT MoFESpd_nEngL2_mp "In Funktionsüberwachung berechnete Motordrehzahl" UWORD Mo_n_rpm_q0p15625 1 100 0.00 10239.84 FORMAT "%8.2" ECU_ADDRESS 0xC00012B0 /end MEASUREMENT
/begin MEASUREMENT MoFESpd_phiGT1Last "Winkeluhr-Stand aus vorhergehendem Aufruf der Motordrehzahl-Überwachung" ULONG OneToOne 1 100 0.00 4294967295.00 FORMAT "%13.2" ECU_ADDRESS 0xD000A068 /end MEASUREMENT
/begin MEASUREMENT MoFESpd_stIrvErr "Irreversibles Fehlerbit beim Drehzahlvergleich in der Motordrehzahl-Überwachung" UBYTE OneToOne 1 100 0.00 255.0 FORMAT "%5.1" ECU_ADDRESS 0xD000A267 /end MEASUREMENT
/begin MEASUREMENT MoFESpd_stSyncAbrt1 "Kennung 1 für Synchronisations- Abbruch in der Funktionsüberwachung" UBYTE OneToOne 1 100 0.00 255.0 FORMAT "%5.1" ECU_ADDRESS 0xD000A16C /end MEASUREMENT
/begin MEASUREMENT MoFESpd_stSyncAbrt2 "Kennung 2 für Synchronisations- Abbruch in der Funktionsüberwachung" UBYTE OneToOne 1 100 0.00 255.0 FORMAT "%5.1" ECU_ADDRESS 0xD000A16D /end MEASUREMENT
/begin MEASUREMENT MoFESpd_stTst "Kennung für Freigabebedingung der Fehlerprüfung für die Diagnose" UBYTE OneToOne 1 100 0.00 255.0 FORMAT "%5.1" ECU_ADDRESS 0xD00090DB /end MEASUREMENT
/begin MEASUREMENT MoFESpd_tiLast "Systemzeit aus vorhergehendem Aufruf der Motordrehzahl-Überwachung" ULONG OneToOne 1 100 0.00 4294967295.00 FORMAT "%13.2" ECU_ADDRESS 0xD000A06C /end MEASUREMENT
/begin MEASUREMENT MoFExtInt_ctDebDCS "Entprellzähler für Verlängerung des MSR-Eingriffs, bis der Eingriff in der Ebene 1 ausgerampt worden ist." UBYTE OneToOne 1 100 0.00 255.0 FORMAT "%5.1" ECU_ADDRESS 0xD000A071 /end MEASUREMENT
/begin MEASUREMENT MoFExtInt_ctDebTSC "Entprellzähler für Verlängerung des Getriebeeingriffs, bis der Eingriff in der Ebene 1 ausgerampt worden ist." UBYTE OneToOne 1 100 0.00 255.0 FORMAT "%5.1" ECU_ADDRESS 0xD000A072 /end MEASUREMENT
/begin MEASUREMENT MoFExtInt_stDCSPtdMsg "Status der Zulässigkeit des MSR-Eingriffs aus der Ebene 2 an die Ebene 1" UBYTE OneToOne 1 100 0.00 255.0 FORMAT "%5.1" ECU_ADDRESS 0xD00090DC /end MEASUREMENT
/begin MEASUREMENT MoFExtInt_stTSCPtdMsg "" UBYTE OneToOne 1 100 0.00 255.0 FORMAT "%5.1" ECU_ADDRESS 0xD00090DD /end MEASUREMENT
/begin MEASUREMENT MoFExtInt_trqLos_mp "Messpunkt des Verlustmoments (Nebenaggregate- und Motorverluste)" SWORD Mo_trq_nm_q0p1 1 100 -3276.800 3276.700 FORMAT "%8.3" ECU_ADDRESS 0xC00012B2 /end MEASUREMENT
/begin MEASUREMENT MoFExtInt_trqPtd "zulässiges Moment der externen Eingriffe in der Funktionsüberwachung" SWORD Mo_trq_nm_q0p1 1 100 -3276.800 3276.700 FORMAT "%8.3" ECU_ADDRESS 0xD000A078 /end MEASUREMENT
/begin MEASUREMENT MoFExtInt_trqPtdDCS "Zulässiges Moment des externen Eingriffs in der Funktionsüberwachung" SWORD Mo_trq_nm_q0p1 1 100 -3276.800 3276.700 FORMAT "%8.3" ECU_ADDRESS 0xD000A074 /end MEASUREMENT
/begin MEASUREMENT MoFExtInt_trqPtdTSC "Zulässiges Moment des Getriebe-Eingriffs in der Funktionsüberwachung" SWORD Mo_trq_nm_q0p1 1 100 -3276.800 3276.700 FORMAT "%8.3" ECU_ADDRESS 0xD000A076 /end MEASUREMENT
/begin MEASUREMENT MoFICO_ctDeb "Entprellzähler der Fehlerreaktionsüberwachung" UBYTE OneToOne 1 100 0.00 255.0 FORMAT "%5.1" ECU_ADDRESS 0xD000A07A /end MEASUREMENT
/begin MEASUREMENT MoFInjDat_ctDebPhiErr "Fehlerzähler Ansteuerbeginnwinkel der Ebene 1 unplausibel in der Funktionsüberwachung" UBYTE OneToOne 1 100 0.00 255.0 FORMAT "%5.1" ECU_ADDRESS 0xD000A17D /end MEASUREMENT
/begin MEASUREMENT MoFInjDat_ctDebQntErr "Fehlerzähler Menge der Ebene 1 unplausibel in der Funktionsüberwachung" UBYTE OneToOne 1 100 0.00 255.0 FORMAT "%5.1" ECU_ADDRESS 0xD000A1D4 /end MEASUREMENT
/begin MEASUREMENT MoFInjDat_ctDiagPhi "Zähler für Setzen des Testflags bei der Prüfung der Ansteuerbeginnwinkeln in der Diagnose" UBYTE OneToOne 1 100 0.00 255.0 FORMAT "%5.1" ECU_ADDRESS 0xD00090DE /end MEASUREMENT
/begin MEASUREMENT MoFInjDat_ctDiagQnt "Zähler für Setzen des Testflags bei der Prüfung der Einspritzmengen in der Diagnose" UBYTE OneToOne 1 100 0.00 255.0 FORMAT "%5.1" ECU_ADDRESS 0xD00090DF /end MEASUREMENT
/begin MEASUREMENT MoFInjDat_ctProc "Modulaufrufzähler MoFInjDat_GetInj" UBYTE OneToOne 1 100 0.00 255.0 FORMAT "%5.1" ECU_ADDRESS 0xD000A17E /end MEASUREMENT
/begin MEASUREMENT MoFInjDat_numCylActr_mp "Zylindernummer einspritzplatzspezifisch" UBYTE OneToOne 1 100 0.00 255.0 FORMAT "%5.1" ARRAY_SIZE 10 ECU_ADDRESS 0xC00012B4 /end MEASUREMENT
/begin MEASUREMENT MoFInjDat_numInjType_mp "Einspritztyp einspritzplatzspezifisch" UBYTE OneToOne 1 100 0.00 255.0 FORMAT "%5.1" ARRAY_SIZE 10 ECU_ADDRESS 0xC00012BE /end MEASUREMENT
/begin MEASUREMENT MoFInjDat_numRevCsAct "Anzahl Nockenwellenumdrehungen zur Mittelwertberechnung in der Funktionsüberwachung" UBYTE OneToOne 1 100 0.00 255.0 FORMAT "%5.1" ECU_ADDRESS 0xD000A17F /end MEASUREMENT
/begin MEASUREMENT MoFInjDat_phiEOEMI1Sum "Summenwert EOE MI1 in der Funktionsüberwachung" SLONG Mo_phi_degCrS_q0p02197 1 100 -47188800.1758 47188800.1538 FORMAT "%13.4" ECU_ADDRESS 0xD000A180 /end MEASUREMENT
/begin MEASUREMENT MoFInjDat_phiEOEPiI1Sum "Summenwert EOE PiI1 in der Funktionsüberwachung" SLONG Mo_phi_degCrS_q0p02197 1 100 -47188800.1758 47188800.1538 FORMAT "%13.4" ECU_ADDRESS 0xD000A184 /end MEASUREMENT
/begin MEASUREMENT MoFInjDat_phiEOEPiI2Sum "Summenwert EOE PiI2 in der Funktionsüberwachung" SLONG Mo_phi_degCrS_q0p02197 1 100 -47188800.1758 47188800.1538 FORMAT "%13.4" ECU_ADDRESS 0xD000A188 /end MEASUREMENT
/begin MEASUREMENT MoFInjDat_phiInjAct_mp "Winkel der letzten zurückgelesenen Einspritzung" SWORD Mo_phi_degCrS_q0p02197 1 100 -720.0439 720.0220 FORMAT "%8.4" ECU_ADDRESS 0xC00012C8 /end MEASUREMENT
/begin MEASUREMENT MoFInjDat_phiInjBegActr_mp "Ansteuerwinkel einspritzplatzspezifisch" SWORD Mo_phi_degCrS_q0p02197 1 100 -720.0439 720.0220 FORMAT "%8.4" ARRAY_SIZE 10 ECU_ADDRESS 0xC00012CA /end MEASUREMENT
/begin MEASUREMENT MoFInjDat_phiMI1 "Gemittelter Ansteuerbeginn MI1 in der Funktionsüberwachung" SWORD Mo_phi_degCrS_q0p02197 1 100 -720.0439 720.0220 FORMAT "%8.4" ECU_ADDRESS 0xD000A1D6 /end MEASUREMENT
/begin MEASUREMENT MoFInjDat_phiMI1Sum "Summenwert MI1 in der Funktionsüberwachung" SLONG Mo_phi_degCrS_q0p02197 1 100 -47188800.1758 47188800.1538 FORMAT "%13.4" ECU_ADDRESS 0xD000A18C /end MEASUREMENT
/begin MEASUREMENT MoFInjDat_phiPiI1 "Gemittelter Ansteuerbeginn PiI1 in der Funktionsüberwachung" SWORD Mo_phi_degCrS_q0p02197 1 100 -720.0439 720.0220 FORMAT "%8.4" ECU_ADDRESS 0xD000A1D8 /end MEASUREMENT
/begin MEASUREMENT MoFInjDat_phiPiI1Sum "Summenwert PiI1 in der Funktionsüberwachung" SLONG Mo_phi_degCrS_q0p02197 1 100 -47188800.1758 47188800.1538 FORMAT "%13.4" ECU_ADDRESS 0xD000A190 /end MEASUREMENT
/begin MEASUREMENT MoFInjDat_phiPiI2 "Gemittelter Ansteuerbeginn PiI2 in der Funktionsüberwachung" SWORD Mo_phi_degCrS_q0p02197 1 100 -720.0439 720.0220 FORMAT "%8.4" ECU_ADDRESS 0xD000A1DA /end MEASUREMENT
/begin MEASUREMENT MoFInjDat_phiPiI2Sum "Summenwert PiI2 in der Funktionsüberwachung" SLONG Mo_phi_degCrS_q0p02197 1 100 -47188800.1758 47188800.1538 FORMAT "%13.4" ECU_ADDRESS 0xD000A194 /end MEASUREMENT
/begin MEASUREMENT MoFInjDat_phiPiI3 "Gemittelter Ansteuerbeginn PiI3 in der Funktionsüberwachung" SWORD Mo_phi_degCrS_q0p02197 1 100 -720.0439 720.0220 FORMAT "%8.4" ECU_ADDRESS 0xD000A1DC /end MEASUREMENT
/begin MEASUREMENT MoFInjDat_phiPiI3Sum "Summenwert PiI3 in der Funktionsüberwachung" SLONG Mo_phi_degCrS_q0p02197 1 100 -47188800.1758 47188800.1538 FORMAT "%13.4" ECU_ADDRESS 0xD000A198 /end MEASUREMENT
/begin MEASUREMENT MoFInjDat_phiPoI2 "Gemittelter Ansteuerbeginn PoI2 in der Funktionsüberwachung" SWORD Mo_phi_degCrS_q0p02197 1 100 -720.0439 720.0220 FORMAT "%8.4" ECU_ADDRESS 0xD000A1DE /end MEASUREMENT
/begin MEASUREMENT MoFInjDat_phiPoI2Sum "Summenwert PoI2 in der Funktionsüberwachung" SLONG Mo_phi_degCrS_q0p02197 1 100 -47188800.1758 47188800.1538 FORMAT "%13.4" ECU_ADDRESS 0xD000A19C /end MEASUREMENT
/begin MEASUREMENT MoFInjDat_qMI1WvCor "Gemittelte Wellenkorrekturmenge MI1 in der Funktionsüberwachung" SWORD Mo_q_mg_q0p01 1 100 -327.6800 327.6700 FORMAT "%8.4" ECU_ADDRESS 0xD000A1E0 /end MEASUREMENT
/begin MEASUREMENT MoFInjDat_qMI1WvCorSum "Summenwert Wellenkorrekturmenge MI1 der Ebene 1" SLONG Mo_q_mg_q0p01 1 100 -21474836.4800 21474836.4700 FORMAT "%13.4" ECU_ADDRESS 0xD000A1A0 /end MEASUREMENT
/begin MEASUREMENT MoFInjDat_qPiI1WvCor "Gemittelte Wellenkorrekturmenge PiI1 in der Funktionsüberwachung" SWORD Mo_q_mg_q0p01 1 100 -327.6800 327.6700 FORMAT "%8.4" ECU_ADDRESS 0xD000A1E2 /end MEASUREMENT
/begin MEASUREMENT MoFInjDat_qPiI1WvCorSum "Summenwert Wellenkorrekturmenge PiI1 der Ebene 1" SLONG Mo_q_mg_q0p01 1 100 -21474836.4800 21474836.4700 FORMAT "%13.4" ECU_ADDRESS 0xD000A1A4 /end MEASUREMENT
/begin MEASUREMENT MoFInjDat_qPoI2WvCor "Gemittelte Wellenkorrekturmenge PoI2 in der Funktionsüberwachung" SWORD Mo_q_mg_q0p01 1 100 -327.6800 327.6700 FORMAT "%8.4" ECU_ADDRESS 0xD000A1E4 /end MEASUREMENT
/begin MEASUREMENT MoFInjDat_qPoI2WvCorSum "Summenwert Wellenkorrekturmenge PoI2 der Ebene 1" SLONG Mo_q_mg_q0p01 1 100 -21474836.4800 21474836.4700 FORMAT "%13.4" ECU_ADDRESS 0xD000A1A8 /end MEASUREMENT
/begin MEASUREMENT MoFInjDat_stChkSum "Checksumme der Variablen in MoFInjDat_GetInj" ULONG OneToOne 1 100 0.00 4294967295.00 FORMAT "%13.2" ECU_ADDRESS 0xD000A1E8 /end MEASUREMENT
/begin MEASUREMENT MoFInjDat_stInjState "Statusinformation über laufende Einspritzungen" UBYTE OneToOne 1 100 0.00 255.0 FORMAT "%5.1" ECU_ADDRESS 0xD000A1EC /end MEASUREMENT
/begin MEASUREMENT MoFInjDat_stIrvErrPhi "Irreversibles Fehlerbit bei unplausiblen Ansteuerbeginnwinkeln für die Diagnose" UBYTE OneToOne 1 100 0.00 255.0 FORMAT "%5.1" ECU_ADDRESS 0xD000A268 /end MEASUREMENT
/begin MEASUREMENT MoFInjDat_stIrvErrQnt "Irreversibles Fehlerbit bei unplausiblen Einspritzmengen für die Diagnose" UBYTE OneToOne 1 100 0.00 255.0 FORMAT "%5.1" ECU_ADDRESS 0xD000A269 /end MEASUREMENT
/begin MEASUREMENT MoFInjDat_tCor "Kraftstofftemperatur der Druckwellenkorrektur in der Funktionsüberwachung" SWORD Mo_t_DegC_q0p8o48 1 100 -26262.40 26165.60 FORMAT "%8.2" ECU_ADDRESS 0xD000A1EE /end MEASUREMENT
/begin MEASUREMENT MoFInjDat_tiInjAct_mp "Ansteuerdauer der letzten zurückgelesenen Einspritzung" SWORD Mo_ti_us_q0p4 1 100 -13107.20 13106.80 FORMAT "%8.2" ECU_ADDRESS 0xC00012DE /end MEASUREMENT
/begin MEASUREMENT MoFInjDat_tiInjDurActr_mp "Ansteuerdauern einspritzplatzspezifisch" SWORD Mo_ti_us_q0p4 1 100 -13107.20 13106.80 FORMAT "%8.2" ARRAY_SIZE 10 ECU_ADDRESS 0xC00012E0 /end MEASUREMENT
/begin MEASUREMENT MoFInjDat_tiMI1 "Gemittelte Ansteuerdauer MI1 in der Funktionsüberwachung" SWORD Mo_ti_us_q0p4 1 100 -13107.20 13106.80 FORMAT "%8.2" ECU_ADDRESS 0xD000A1F0 /end MEASUREMENT
/begin MEASUREMENT MoFInjDat_tiMI1PoI2 "Zeitabstand zwischen EOE MI1 und SOE PoI2" SWORD Mo_ti_us_q0p4 1 100 -13107.20 13106.80 FORMAT "%8.2" ECU_ADDRESS 0xD000A1F2 /end MEASUREMENT
/begin MEASUREMENT MoFInjDat_tiMI1Sum "Summenwert Ansteuerdauer MI1 in der Funktionsüberwachung" SLONG Mo_ti_us_q0p4 1 100 -858993459.200 858993458.800 FORMAT "%13.3" ECU_ADDRESS 0xD000A1AC /end MEASUREMENT
/begin MEASUREMENT MoFInjDat_tiPiI1 "Gemittelte Ansteuerdauer PiI1 in der Funktionsüberwachung" SWORD Mo_ti_us_q0p4 1 100 -13107.20 13106.80 FORMAT "%8.2" ECU_ADDRESS 0xD000A1F4 /end MEASUREMENT
/begin MEASUREMENT MoFInjDat_tiPiI1MI1 "Zeitabstand zwischen EOE PiI1 und SOE MI1" SWORD Mo_ti_us_q0p4 1 100 -13107.20 13106.80 FORMAT "%8.2" ECU_ADDRESS 0xD000A1F6 /end MEASUREMENT
/begin MEASUREMENT MoFInjDat_tiPiI1Sum "Summenwert Ansteuerdauer PiI1 in der Funktionsüberwachung" SLONG Mo_ti_us_q0p4 1 100 -858993459.200 858993458.800 FORMAT "%13.3" ECU_ADDRESS 0xD000A1B0 /end MEASUREMENT
/begin MEASUREMENT MoFInjDat_tiPiI1ZFCETCor "Gemittelte Nullmengenkalibrieransteuerdauer Pi1 der Ebene 1" SWORD Mo_ti_us_q0p4 1 100 -13107.20 13106.80 FORMAT "%8.2" ECU_ADDRESS 0xD000A1F8 /end MEASUREMENT
/begin MEASUREMENT MoFInjDat_tiPiI1ZFCETCorSum "Summenwert Nullmengenkalibrieransteuerdauer Pi1 der Ebene 1" SLONG Mo_ti_us_q0p4 1 100 -858993459.200 858993458.800 FORMAT "%13.3" ECU_ADDRESS 0xD000A1B4 /end MEASUREMENT
/begin MEASUREMENT MoFInjDat_tiPiI2 "Gemittelte Ansteuerdauer PiI2 in der Funktionsüberwachung" SWORD Mo_ti_us_q0p4 1 100 -13107.20 13106.80 FORMAT "%8.2" ECU_ADDRESS 0xD000A1FA /end MEASUREMENT
/begin MEASUREMENT MoFInjDat_tiPiI2MI1 "Zeitabstand zwischen EOE PiI2 und SOE MI1" SWORD Mo_ti_us_q0p4 1 100 -13107.20 13106.80 FORMAT "%8.2" ECU_ADDRESS 0xD000A1FC /end MEASUREMENT
/begin MEASUREMENT MoFInjDat_tiPiI2PiI1 "Zeitabstand zwischen EOE PiI2 und SOE PiI1" SWORD Mo_ti_us_q0p4 1 100 -13107.20 13106.80 FORMAT "%8.2" ECU_ADDRESS 0xD000A1FE /end MEASUREMENT
/begin MEASUREMENT MoFInjDat_tiPiI2Sum "Summenwert Ansteuerdauer PiI2 in der Funktionsüberwachung" SLONG Mo_ti_us_q0p4 1 100 -858993459.200 858993458.800 FORMAT "%13.3" ECU_ADDRESS 0xD000A1B8 /end MEASUREMENT
/begin MEASUREMENT MoFInjDat_tiPiI2ZFCETCor "Gemittelte Nullmengenkalibrieransteuerdauer Pi2 der Ebene 1" SWORD Mo_ti_us_q0p4 1 100 -13107.20 13106.80 FORMAT "%8.2" ECU_ADDRESS 0xD000A200 /end MEASUREMENT
/begin MEASUREMENT MoFInjDat_tiPiI2ZFCETCorSum "Summenwert Nullmengenkalibrieransteuerdauer Pi2 der Ebene 1" SLONG Mo_ti_us_q0p4 1 100 -858993459.200 858993458.800 FORMAT "%13.3" ECU_ADDRESS 0xD000A1BC /end MEASUREMENT
/begin MEASUREMENT MoFInjDat_tiPiI3 "Gemittelte Ansteuerdauer PiI2 in der Funktionsüberwachung" SWORD Mo_ti_us_q0p4 1 100 -13107.20 13106.80 FORMAT "%8.2" ECU_ADDRESS 0xD000A202 /end MEASUREMENT
/begin MEASUREMENT MoFInjDat_tiPiI3Sum "Summenwert Ansteuerdauer PiI3 in der Funktionsüberwachung" SLONG Mo_ti_us_q0p4 1 100 -858993459.200 858993458.800 FORMAT "%13.3" ECU_ADDRESS 0xD000A1C0 /end MEASUREMENT
/begin MEASUREMENT MoFInjDat_tiPiI3ZFCETCor "Gemittelte Nullmengenkalibrieransteuerdauer Pi3 der Ebene 1" SWORD Mo_ti_us_q0p4 1 100 -13107.20 13106.80 FORMAT "%8.2" ECU_ADDRESS 0xD000A204 /end MEASUREMENT
/begin MEASUREMENT MoFInjDat_tiPiI3ZFCETCorSum "Summenwert Nullmengenkalibrieransteuerdauer Pi3 der Ebene 1" SLONG Mo_ti_us_q0p4 1 100 -858993459.200 858993458.800 FORMAT "%13.3" ECU_ADDRESS 0xD000A1C4 /end MEASUREMENT
/begin MEASUREMENT MoFInjDat_tiPoI2 "Gemittelte Ansteuerdauer PoI2 in der Funktionsüberwachung" SWORD Mo_ti_us_q0p4 1 100 -13107.20 13106.80 FORMAT "%8.2" ECU_ADDRESS 0xD000A206 /end MEASUREMENT
/begin MEASUREMENT MoFInjDat_tiPoI2Sum "Summenwert Ansteuerdauer PoI2 in der Funktionsüberwachung" SLONG Mo_ti_us_q0p4 1 100 -858993459.200 858993458.800 FORMAT "%13.3" ECU_ADDRESS 0xD000A1C8 /end MEASUREMENT
/begin MEASUREMENT MoFInjDat_tiTDCAvrg "Mittelwert der durchschnittlichen momentenwirksamen Ansteuerdauer pro Zylinder" SWORD Mo_ti_us_q0p4 1 100 -13107.20 13106.80 FORMAT "%8.2" ECU_ADDRESS 0xD000A208 /end MEASUREMENT
/begin MEASUREMENT MoFInjDat_tiTDCSumET_mp "Summe der momentenwirksamen Ansteuerdauer zylinderspezifisch" SWORD Mo_ti_us_q0p4 1 100 -13107.20 13106.80 FORMAT "%8.2" ARRAY_SIZE 6 ECU_ADDRESS 0xC00012F4 /end MEASUREMENT
/begin MEASUREMENT MoFInjDat_trqASD "Gemitteltes Ruckeldämpfereingriffsmoment in der Funktionsüberwachung" SWORD Mo_trq_nm_q0p1 1 100 -3276.800 3276.700 FORMAT "%8.3" ECU_ADDRESS 0xD000A20A /end MEASUREMENT
/begin MEASUREMENT MoFInjDat_trqASDSum "Summenwert Ruckeldämpfereingriffsmoment der Ebene 1" SLONG Mo_trq_nm_q0p1 1 100 -214748364.800 214748364.700 FORMAT "%13.3" ECU_ADDRESS 0xD000A1CC /end MEASUREMENT
/begin MEASUREMENT MoFInjDat_trqSpdG "Gemitteltes Leerlaufreglereingriffsmoment in der Funktionsüberwachung" SWORD Mo_trq_nm_q0p1 1 100 -3276.800 3276.700 FORMAT "%8.3" ECU_ADDRESS 0xD000A20C /end MEASUREMENT
/begin MEASUREMENT MoFInjDat_trqSpdGSum "Summenwert Leerlaufreglereingriffsmoment der Ebene 1" SLONG Mo_trq_nm_q0p1 1 100 -214748364.800 214748364.700 FORMAT "%13.3" ECU_ADDRESS 0xD000A1D0 /end MEASUREMENT
/begin MEASUREMENT MoFInjQnt_ctDebErr "Entprellzähler Fehlerreaktion aus MoFInjQnt in der Funktionsüberwachung" UBYTE OneToOne 1 100 0.00 255.0 FORMAT "%5.1" ECU_ADDRESS 0xD000A07B /end MEASUREMENT
/begin MEASUREMENT MoFInjQnt_ctDiag "Zähler für Setzen des Testflags in der Diagnose" UBYTE OneToOne 1 100 0.00 255.0 FORMAT "%5.1" ECU_ADDRESS 0xD00090E2 /end MEASUREMENT
/begin MEASUREMENT MoFInjQnt_qMI1Cor "Einspritzmenge MI1 vor Korrektur der Funktionsüberwachung" SWORD Mo_q_mg_q0p01 1 100 -327.6800 327.6700 FORMAT "%8.4" ECU_ADDRESS 0xD000A07C /end MEASUREMENT
/begin MEASUREMENT MoFInjQnt_qPiI1Cor "Einspritzmenge PiI1 vor Korrektur der Funktionsüberwachung" SWORD Mo_q_mg_q0p01 1 100 -327.6800 327.6700 FORMAT "%8.4" ECU_ADDRESS 0xD000A07E /end MEASUREMENT
/begin MEASUREMENT MoFInjQnt_qPiI2Cor "Einspritzmenge PiI2 vor Korrektur in der Funktionsüberwachung" SWORD Mo_q_mg_q0p01 1 100 -327.6800 327.6700 FORMAT "%8.4" ECU_ADDRESS 0xD000A080 /end MEASUREMENT
/begin MEASUREMENT MoFInjQnt_qPiI3Cor "Einspritzmenge PiI3 vor Korrektur in der Funktionsüberwachung" SWORD Mo_q_mg_q0p01 1 100 -327.6800 327.6700 FORMAT "%8.4" ECU_ADDRESS 0xD000A082 /end MEASUREMENT
/begin MEASUREMENT MoFInjQnt_qPoI2Cor "Einspritzmenge PoI2 vor Korrektur der Funktionsüberwachung" SWORD Mo_q_mg_q0p01 1 100 -327.6800 327.6700 FORMAT "%8.4" ECU_ADDRESS 0xD000A084 /end MEASUREMENT
/begin MEASUREMENT MoFInjQnt_stChk_mp "Status der Checksummenprüfung beim Auslesen der IMA-Werte aus EEPROM Spiegel" UBYTE OneToOne 1 100 0.00 255.0 FORMAT "%5.1" ARRAY_SIZE 6 ECU_ADDRESS 0xC0001300 /begin ANNOTATION /end ANNOTATION /end MEASUREMENT
/begin MEASUREMENT MoFInjQnt_stIrvErr "Irreversibles Fehlerbit bei unplausiblen NMK Ansteuerdauern für die Diagnose" UBYTE OneToOne 1 100 0.00 255.0 FORMAT "%5.1" ECU_ADDRESS 0xD000A26A /end MEASUREMENT
/begin MEASUREMENT MoFInjQnt_volCor "Abgleichwerte Injektormengenabgleich im Zylindermittel in der Funktionsüberwachung" SWORD Mo_vol_mm3_q0p01 1 100 -327.6800 327.6700 FORMAT "%8.4" ARRAY_SIZE 8 ECU_ADDRESS 0xC0001306 /end MEASUREMENT
/begin MEASUREMENT MoFInjQnt_volMI1QntAdj_mp "Injektormengenabgleich Korrekturvolumen der MI1 in der Funktionsüberwachung" SWORD Mo_vol_mm3_q0p01 1 100 -327.6800 327.6700 FORMAT "%8.4" ECU_ADDRESS 0xC0001326 /end MEASUREMENT
/begin MEASUREMENT MoFInjQnt_volMI1UnCor_mp "Einspritzvolumen MI1 vor Injektormengenabgleich Korrektur in der Funktionsüberwachung" SWORD Mo_vol_mm3_q0p01 1 100 -327.6800 327.6700 FORMAT "%8.4" ECU_ADDRESS 0xC0001328 /end MEASUREMENT
/begin MEASUREMENT MoFInjQnt_volPiI1QntAdj_mp "Injektormengenabgleich Korrekturvolumen der PiI1 in der Funktionsüberwachung" SWORD Mo_vol_mm3_q0p01 1 100 -327.6800 327.6700 FORMAT "%8.4" ECU_ADDRESS 0xC000132A /end MEASUREMENT
/begin MEASUREMENT MoFInjQnt_volPiI1UnCor_mp "Einspritzvolumen PiI1 vor Injektormengenabgleich Korrektur in der Funktionsüberwachung" SWORD Mo_vol_mm3_q0p01 1 100 -327.6800 327.6700 FORMAT "%8.4" ECU_ADDRESS 0xC000132C /end MEASUREMENT
/begin MEASUREMENT MoFInjQnt_volPiI2QntAdj_mp "Injektormengenabgleich Korrekturvolumen der PiI2 in der Funktionsüberwachung" SWORD Mo_vol_mm3_q0p01 1 100 -327.6800 327.6700 FORMAT "%8.4" ECU_ADDRESS 0xC000132E /end MEASUREMENT
/begin MEASUREMENT MoFInjQnt_volPiI2UnCor_mp "Einspritzvolumen PiI2 vor Injektormengenabgleich Korrektur in der Funktionsüberwachung" SWORD Mo_vol_mm3_q0p01 1 100 -327.6800 327.6700 FORMAT "%8.4" ECU_ADDRESS 0xC0001330 /end MEASUREMENT
/begin MEASUREMENT MoFInjQnt_volPiI3QntAdj_mp "Injektormengenabgleich Korrekturvolumen der PiI3 in der Funktionsüberwachung" SWORD Mo_vol_mm3_q0p01 1 100 -327.6800 327.6700 FORMAT "%8.4" ECU_ADDRESS 0xC0001332 /end MEASUREMENT
/begin MEASUREMENT MoFInjQnt_volPiI3UnCor_mp "Einspritzvolumen PiI3 vor Injektormengenabgleich Korrektur in der Funktionsüberwachung" SWORD Mo_vol_mm3_q0p01 1 100 -327.6800 327.6700 FORMAT "%8.4" ECU_ADDRESS 0xC0001334 /end MEASUREMENT
/begin MEASUREMENT MoFInjQnt_volPoI2QntAdj_mp "Injektormengenabgleich Korrekturvolumen der PoI2 in der Funktionsüberwachung" SWORD Mo_vol_mm3_q0p01 1 100 -327.6800 327.6700 FORMAT "%8.4" ECU_ADDRESS 0xC0001336 /end MEASUREMENT
/begin MEASUREMENT MoFInjQnt_volPoI2UnCor_mp "Einspritzvolumen PoI2 vor Injektormengenabgleich Korrektur in der Funktionsüberwachung" SWORD Mo_vol_mm3_q0p01 1 100 -327.6800 327.6700 FORMAT "%8.4" ECU_ADDRESS 0xC0001338 /end MEASUREMENT
/begin MEASUREMENT MoFIn_st "" UBYTE OneToOne 1 100 0.00 255.0 FORMAT "%5.1" ECU_ADDRESS 0xD000A086 /end MEASUREMENT
/begin MEASUREMENT MoFLos_rTrq "Relatives Motorverlustmoment der Überwachung" UBYTE Mo_r_prc_q0p39 1 100 0.00 99.61 FORMAT "%5.2" ECU_ADDRESS 0xD000A087 /end MEASUREMENT
/begin MEASUREMENT MoFMode_facPoI2Eff_mp "Gesamtmomentenwirkungsgradfaktor der PoI2 in der Funktionsüberwachung" UBYTE Mo_fac_q0p00392 1 100 0.00 1.000 FORMAT "%5.3" ECU_ADDRESS 0xC000133A /end MEASUREMENT
/begin MEASUREMENT MoFMode_qSetUnBal "Virtuelle Gesamteinspritzmenge der Funktionsüberwachung" SWORD Mo_q_mg_q0p01 1 100 -327.6800 327.6700 FORMAT "%8.4" ECU_ADDRESS 0xD000A088 /end MEASUREMENT
/begin MEASUREMENT MoFMode_qSumPiIMI_mp "Kraftstoffmengensumme aus PiIx und MI1 in der Funktionsüberwachung" SWORD Mo_q_mg_q0p01 1 100 -327.6800 327.6700 FORMAT "%8.4" ECU_ADDRESS 0xC000133C /end MEASUREMENT
/begin MEASUREMENT MoFMode_stOpModeMsg "Botschaft von Funktionsüberwachung an Betriebsartenkoordinator (CoEOM)" UWORD OneToOne 1 100 0.00 65535.00 FORMAT "%8.2" ECU_ADDRESS 0xD000767C /end MEASUREMENT
/begin MEASUREMENT MoFOvR_ctDebAPP "" UWORD OneToOne 1 100 0.00 65535.00 FORMAT "%8.2" ECU_ADDRESS 0xD000A08A /end MEASUREMENT
/begin MEASUREMENT MoFOvR_ctDebASDdc "" UWORD OneToOne 1 100 0.00 65535.00 FORMAT "%8.2" ECU_ADDRESS 0xD000A08C /end MEASUREMENT
/begin MEASUREMENT MoFOvR_ctDebASDdcL1 "" UWORD OneToOne 1 100 0.00 65535.00 FORMAT "%8.2" ECU_ADDRESS 0xD000A08E /end MEASUREMENT
/begin MEASUREMENT MoFOvR_ctDebBrk "" UWORD OneToOne 1 100 0.00 65535.00 FORMAT "%8.2" ECU_ADDRESS 0xD000A090 /end MEASUREMENT
/begin MEASUREMENT MoFOvR_ctDebET "Entprellzähler der Schubüberwachung" UWORD OneToOne 1 100 0.00 65535.00 FORMAT "%8.2" ECU_ADDRESS 0xD000A092 /end MEASUREMENT
/begin MEASUREMENT MoFOvR_ctDiag "Zähler für Setzen des Testflags in der Diagnose" UBYTE OneToOne 1 100 0.00 255.0 FORMAT "%5.1" ECU_ADDRESS 0xD00090E3 /end MEASUREMENT
/begin MEASUREMENT MoFOvR_ctEngSpd "" UWORD OneToOne 1 100 0.00 65535.00 FORMAT "%8.2" ECU_ADDRESS 0xD000A094 /end MEASUREMENT
/begin MEASUREMENT MoFOvR_stActvMsg "Status über aktive Schubüberwachung" UBYTE OneToOne 1 100 0.00 255.0 FORMAT "%5.1" ECU_ADDRESS 0xD0009230 /end MEASUREMENT
/begin MEASUREMENT MoFOvR_stIrvErr "Information ""EMB Anforderung"" für die Diagnose" UBYTE OneToOne 1 100 0.00 1.000 BIT_MASK 0x1 FORMAT "%5.3" ECU_ADDRESS 0xD000A26B /end MEASUREMENT
/begin MEASUREMENT MoFOvR_stRls "Status aller Freigabe Bits für die Schubüberwachung" UWORD OneToOne 1 100 0.00 65535.00 FORMAT "%8.2" ECU_ADDRESS 0xD000A098 /end MEASUREMENT
/begin MEASUREMENT MoFOvR_stTst "Kennung für Freigabebedingung der Fehlerprüfung für die Diagnose" UBYTE OneToOne 1 100 0.00 255.0 FORMAT "%5.1" ECU_ADDRESS 0xD00090E4 /end MEASUREMENT
/begin MEASUREMENT MoFOvR_tiLimET_mp "Zulässige Ansteuerdauer der Schubüberwachung" SWORD Mo_ti_us_q0p4 1 100 -13107.20 13106.80 FORMAT "%8.2" ECU_ADDRESS 0xC000133E /end MEASUREMENT
/begin MEASUREMENT MoFQntCor_ctDebErr "Fehlerentprellzähler in MoFQntCor in der Funktionsüberwachung" UBYTE OneToOne 1 100 0.00 255.0 FORMAT "%5.1" ECU_ADDRESS 0xD000A09A /end MEASUREMENT
/begin MEASUREMENT MoFQntCor_ctDiag "Zähler für Setzen des Testflags in der Diagnose" UBYTE OneToOne 1 100 0.00 255.0 FORMAT "%5.1" ECU_ADDRESS 0xD00090E5 /end MEASUREMENT
/begin MEASUREMENT MoFQntCor_qMI1 "Korrigierte MI1 Menge in der Funktionsüberwachung" SWORD Mo_q_mg_q0p01 1 100 -327.6800 327.6700 FORMAT "%8.4" ECU_ADDRESS 0xD000A09C /end MEASUREMENT
/begin MEASUREMENT MoFQntCor_qPiI1 "Korrigierte PiI1 Menge in der Funktionsüberwachung" SWORD Mo_q_mg_q0p01 1 100 -327.6800 327.6700 FORMAT "%8.4" ECU_ADDRESS 0xD000A09E /end MEASUREMENT
/begin MEASUREMENT MoFQntCor_qPiI1WvCor_mp "Wellenkorrekturmenge PiI1 in der Funktionsüberwachung" SWORD Mo_q_mg_q0p01 1 100 -327.6800 327.6700 FORMAT "%8.4" ECU_ADDRESS 0xC0001340 /end MEASUREMENT
/begin MEASUREMENT MoFQntCor_qPoI2 "Korrigierte PoI2 Menge in der Funktionsüberwachung" SWORD Mo_q_mg_q0p01 1 100 -327.6800 327.6700 FORMAT "%8.4" ECU_ADDRESS 0xD000A0A0 /end MEASUREMENT
/begin MEASUREMENT MoFQntCor_qPoI2WvCor_mp "Wellenkorrekturmenge PoI2 in der Funktionsüberwachung" SWORD Mo_q_mg_q0p01 1 100 -327.6800 327.6700 FORMAT "%8.4" ECU_ADDRESS 0xC0001342 /end MEASUREMENT
/begin MEASUREMENT MoFQntCor_qWvCor2_mp "Wellenkorrekturmenge 2 in der Funktionsüberwachung" SWORD Mo_q_mg_q0p01 1 100 -327.6800 327.6700 FORMAT "%8.4" ECU_ADDRESS 0xC0001344 /end MEASUREMENT
/begin MEASUREMENT MoFQntCor_qWvCorMI1PiI1_mp "Wellenkorrekturmenge MI1 aufgrund PiI1 in der Funktionsüberwachung" SWORD Mo_q_mg_q0p01 1 100 -327.6800 327.6700 FORMAT "%8.4" ECU_ADDRESS 0xC0001346 /end MEASUREMENT
/begin MEASUREMENT MoFQntCor_qWvCorMI1PiI2_mp "Wellenkorrekturmenge MI1 aufgrund PiI2 in der Funktionsüberwachung" SWORD Mo_q_mg_q0p01 1 100 -327.6800 327.6700 FORMAT "%8.4" ECU_ADDRESS 0xC0001348 /end MEASUREMENT
/begin MEASUREMENT MoFQntCor_qWvCorMI1_mp "Wellenkorrekturmenge MI1 in der Funktionsüberwachung" SWORD Mo_q_mg_q0p01 1 100 -327.6800 327.6700 FORMAT "%8.4" ECU_ADDRESS 0xC000134A /end MEASUREMENT
/begin MEASUREMENT MoFQntCor_qWvCorPiI1PiI2_mp "Wellenkorrekturmenge PiI1 aufgrund PiI2 in der Funktionsüberwachung" SWORD Mo_q_mg_q0p01 1 100 -327.6800 327.6700 FORMAT "%8.4" ECU_ADDRESS 0xC000134C /end MEASUREMENT
/begin MEASUREMENT MoFQntCor_rQMI1_mp "Mengenverhältnis MI1 in der Funktionsüberwachung" UBYTE Mo_fac_q0p04 1 100 0.00 10.20 FORMAT "%5.2" ECU_ADDRESS 0xC000134E /end MEASUREMENT
/begin MEASUREMENT MoFQntCor_stInj "Kennung für Freigabebedingung der Fehlerprüfung für die Diagnose" UBYTE OneToOne 1 100 0.00 255.0 FORMAT "%5.1" ECU_ADDRESS 0xD00090E6 /end MEASUREMENT
/begin MEASUREMENT MoFQntCor_stIrvErr "Irreversibles Fehlerbit bei unplausiblen Wellenkorrekturanteilen für die Diagnose" UBYTE OneToOne 1 100 0.00 255.0 FORMAT "%5.1" ECU_ADDRESS 0xD000A26C /end MEASUREMENT
/begin MEASUREMENT MoFQntCor_stMI1ErrAct_mp "Aktueller Fehler Mengenbilanz MI1 in der Funktionsüberwachung" UBYTE OneToOne 1 100 0.00 255.0 FORMAT "%5.1" ECU_ADDRESS 0xC000134F /end MEASUREMENT
/begin MEASUREMENT MoFQntCor_stPiI1ErrAct_mp "Aktueller Fehler Mengenbilanz PiI1 in der Funktionsüberwachung" UBYTE OneToOne 1 100 0.00 255.0 FORMAT "%5.1" ECU_ADDRESS 0xC0001350 /end MEASUREMENT
/begin MEASUREMENT MoFQntCor_stPoI2ErrAct_mp "Aktueller Fehler Mengenbilanz PoI2 in der Funktionsüberwachung" UBYTE OneToOne 1 100 0.00 255.0 FORMAT "%5.1" ECU_ADDRESS 0xC0001351 /end MEASUREMENT
/begin MEASUREMENT MoFQntCor_tiMI1PoI2Cor_mp "Korrigierter Zeitabstand MI1 zu PoI2 in der Funktionsüberwachung" SWORD Mo_ti_us_q0p4 1 100 -13107.20 13106.80 FORMAT "%8.2" ECU_ADDRESS 0xC0001352 /end MEASUREMENT
/begin MEASUREMENT MoFQntCor_tiPiI1MI1Cor_mp "Korrigierter Zeitabstand PiI1 zu MI1 in der Funktionsüberwachung" SWORD Mo_ti_us_q0p4 1 100 -13107.20 13106.80 FORMAT "%8.2" ECU_ADDRESS 0xC0001354 /end MEASUREMENT
/begin MEASUREMENT MoFQntCor_tiPiI2Hyd_mp "Hydraulische Korrekturzeit PiI2 in der Funktionsüberwachung" SWORD Mo_ti_us_q0p4 1 100 -13107.20 13106.80 FORMAT "%8.2" ECU_ADDRESS 0xC0001356 /end MEASUREMENT
/begin MEASUREMENT MoFRailP_ctMaxDebDef "Entprellzähler SRC High defekt Raildruck der Funktionsüberwachung" UBYTE OneToOne 1 100 0.00 255.0 FORMAT "%5.1" ECU_ADDRESS 0xD000A0A4 /end MEASUREMENT
/begin MEASUREMENT MoFRailP_ctMaxDebOK "Entprellzähler SRC High OK Raildruck der Funktionsüberwachung" UBYTE OneToOne 1 100 0.00 255.0 FORMAT "%5.1" ECU_ADDRESS 0xD000A0A5 /end MEASUREMENT
/begin MEASUREMENT MoFRailP_ctMinDebDef "Entprellzähler SRC Low defekt Raildruck der Funktionsüberwachung" UBYTE OneToOne 1 100 0.00 255.0 FORMAT "%5.1" ECU_ADDRESS 0xD000A0A6 /end MEASUREMENT
/begin MEASUREMENT MoFRailP_ctMinDebOK "Entprellzähler SRC Low OK Raildruck der Funktionsüberwachung" UBYTE OneToOne 1 100 0.00 255.0 FORMAT "%5.1" ECU_ADDRESS 0xD000A0A7 /end MEASUREMENT
/begin MEASUREMENT MoFRailP_p "Raildruck der Funktionsüberwachung" UBYTE Mo_p_bar_q8p0000 1 100 0.00 2000.000 ECU_ADDRESS 0xD000A0A8 /end MEASUREMENT
/begin MEASUREMENT MoFRailP_pFlt "Gefilterter Raildruck der Funktionsüberwachung" UWORD Mo_p_bar_q0p0311284 1 100 0.00 2000.000 FORMAT "%5.3" ECU_ADDRESS 0xD000A0A2 /end MEASUREMENT
/begin MEASUREMENT MoFRailP_stPlb_mp "Status Raildrucksensor plausibel in der Funktionsüberwachung" UBYTE OneToOne 1 100 0.00 255.0 FORMAT "%5.1" ECU_ADDRESS 0xC0001358 /end MEASUREMENT
/begin MEASUREMENT MoFRailP_stSRChighActDef_mp "Status Raildrucksensor SRC high aktuell defekt der Funktionsüberwachung" UBYTE OneToOne 1 100 0.00 255.0 FORMAT "%5.1" ECU_ADDRESS 0xC0001359 /end MEASUREMENT
/begin MEASUREMENT MoFRailP_stSRChighOK_mp "Status Raildrucksensor SRC high OK der Funktionsüberwachung" UBYTE OneToOne 1 100 0.00 255.0 FORMAT "%5.1" ECU_ADDRESS 0xC000135A /end MEASUREMENT
/begin MEASUREMENT MoFRailP_stSRClowActDef_mp "Status Raildrucksensor SRC low aktuell defekt der Funktionsüberwachung" UBYTE OneToOne 1 100 0.00 255.0 FORMAT "%5.1" ECU_ADDRESS 0xC000135B /end MEASUREMENT
/begin MEASUREMENT MoFRailP_stSRClowOK_mp "Status Raildrucksensor SRC low OK der Funktionsüberwachung" UBYTE OneToOne 1 100 0.00 255.0 FORMAT "%5.1" ECU_ADDRESS 0xC000135C /end MEASUREMENT
/begin MEASUREMENT MoFRailP_uRaw_mp "Raildrucksensorrohspannung der Funktionsüberwachung" UBYTE Mo_u_mV_q19p53 1 100 0.00 4980. FORMAT "%5.0" ECU_ADDRESS 0xC000135D /end MEASUREMENT
/begin MEASUREMENT MoFSpdG_rTrq "Moment des Drehzahlreglers in der Ebene 2" UBYTE Mo_r_prc_q0p39 1 100 0.00 99.61 FORMAT "%5.2" ECU_ADDRESS 0xD000A0A9 /end MEASUREMENT
/begin MEASUREMENT MoFSpdG_stDem "Status allgemeiner Drehzahlanforderungen" UBYTE OneToOne 1 100 0.00 255.0 FORMAT "%5.1" ECU_ADDRESS 0xD000A0AA /end MEASUREMENT
/begin MEASUREMENT MoFSpdG_trq_mp "Moment des Drehzahlreglers in der Ebene 2" SWORD Mo_trq_nm_q0p1 1 100 -3276.800 3276.700 FORMAT "%8.3" ECU_ADDRESS 0xC000135E /end MEASUREMENT
/begin MEASUREMENT MoFTEng_tEng "" UBYTE Mo_t_DegC_q0p8o48 1 100 -48.00 156.0 FORMAT "%5.1" ECU_ADDRESS 0xD000A0AE /end MEASUREMENT
/begin MEASUREMENT MoFTEng_tiAftStrt "" UWORD Mo_ti40ms_ms_q40p0 1 100 0.00 2621400. FORMAT "%8.0" ECU_ADDRESS 0xD000A0B0 /end MEASUREMENT
/begin MEASUREMENT MoFTEng_tiMinTemp "" UWORD Mo_ti20ms_s_q0p02 1 100 0.00 1310.700 FORMAT "%8.3" ECU_ADDRESS 0xD000A0AC /end MEASUREMENT
/begin MEASUREMENT MoFTEng_tiMinTemp_mp "" UBYTE Mo_ti40ms_s_q5p12 1 100 0.00 1306. FORMAT "%5.0" ECU_ADDRESS 0xC0001360 /end MEASUREMENT
/begin MEASUREMENT MoFTra_stDem "Statusinfo der MSR-Eingriffüberwachung" UBYTE OneToOne 1 100 0.00 255.0 FORMAT "%5.1" ECU_ADDRESS 0xD000A0B2 /end MEASUREMENT
/begin MEASUREMENT MoFTra_stIrvErr "Irreversibles Fehlerbit aus der MSR Eingriffsüberwachung" UBYTE OneToOne 1 100 0.00 1.000 BIT_MASK 0x1 FORMAT "%5.3" ECU_ADDRESS 0xD000A26D /end MEASUREMENT
/begin MEASUREMENT MoFTra_trqDem "Angefordertes Motormoment von MSR-Steuerung" SWORD Mo_trq_nm_q0p1 1 100 -3276.800 3276.700 FORMAT "%8.3" ECU_ADDRESS 0xD000A0B4 /end MEASUREMENT
/begin MEASUREMENT MoFTrqAct_st "Statusgröße Istmoment in der Funktionsüberwachung" UBYTE OneToOne 1 100 0.00 255.0 FORMAT "%5.1" ECU_ADDRESS 0xD000A0B7 /end MEASUREMENT
/begin MEASUREMENT MoFTrqCmp_ctDeb "Fehlerentprellzähler des Momentenvergleichs zur Auslösung der Einspritzmengenbegrenzung (EMB)" UBYTE OneToOne 1 100 0.00 255.0 FORMAT "%5.1" ECU_ADDRESS 0xD000A0B6 /end MEASUREMENT
/begin MEASUREMENT MoFTrqCmp_ctDiag "Zähler für Setzen des Testflags in der Diagnose" UBYTE OneToOne 1 100 0.00 255.0 FORMAT "%5.1" ECU_ADDRESS 0xD00090E7 /end MEASUREMENT
/begin MEASUREMENT MoFTrqCmp_stIrvErr "Information ""EMB Anforderung"" für die Diagnose" UBYTE OneToOne 1 100 0.00 255.0 FORMAT "%5.1" ECU_ADDRESS 0xD000A24B /end MEASUREMENT
/begin MEASUREMENT MoFTrqCmp_stTst "Kennung für Freigabebedingung der Fehlerprüfung für die Diagnose" UBYTE OneToOne 1 100 0.00 255.0 FORMAT "%5.1" ECU_ADDRESS 0xD00090E8 /end MEASUREMENT
/begin MEASUREMENT MoFTrqIdc_rTrq "aktuelles relatives indiziertes Motormoment der Funktionsüberwachung" UBYTE Mo_r_prc_q0p39 1 100 0.00 99.61 FORMAT "%5.2" ECU_ADDRESS 0xD000A0B8 /end MEASUREMENT
/begin MEASUREMENT MoFTrqIdc_trqIdc_mp "aktuelles absolutes indiziertes Motormoment der Funktionsüberwachung" SWORD Mo_trq_nm_q0p1 1 100 -3276.800 3276.700 FORMAT "%8.3" ECU_ADDRESS 0xC0001362 /end MEASUREMENT
/begin MEASUREMENT Mo_bCplChk "" UBYTE OneToOne 1 100 0.00 1.000 BIT_MASK 0x1 FORMAT "%5.3" ECU_ADDRESS 0xD000A0B9 /end MEASUREMENT
/begin MEASUREMENT Mo_bICOL1 "" UBYTE OneToOne 1 100 0.00 1.000 BIT_MASK 0x2 FORMAT "%5.3" ECU_ADDRESS 0xD000A0BA /end MEASUREMENT
/begin MEASUREMENT Mo_bICOL2 "" UBYTE OneToOne 1 100 0.00 1.000 BIT_MASK 0x1 FORMAT "%5.3" ECU_ADDRESS 0xD000A0BA /end MEASUREMENT
/begin MEASUREMENT Mo_bLimpHom "" UBYTE OneToOne 1 100 0.00 1.000 BIT_MASK 0x10 FORMAT "%5.3" ECU_ADDRESS 0xD000A0BA /end MEASUREMENT
/begin MEASUREMENT Mo_bLowVltg "" UBYTE OneToOne 1 100 0.00 1.000 BIT_MASK 0x4 FORMAT "%5.3" ECU_ADDRESS 0xD000A0BA /end MEASUREMENT
/begin MEASUREMENT Mo_bRamErr "" UBYTE OneToOne 1 100 0.00 1.000 BIT_MASK 0x2 FORMAT "%5.3" ECU_ADDRESS 0xD000A0B9 /end MEASUREMENT
/begin MEASUREMENT Mo_bRomErr "" UBYTE OneToOne 1 100 0.00 1.000 BIT_MASK 0x4 FORMAT "%5.3" ECU_ADDRESS 0xD000A0B9 /end MEASUREMENT
/begin MEASUREMENT Mo_ctRst "" UBYTE OneToOne 1 100 0.00 255.0 FORMAT "%5.1" ECU_ADDRESS 0xD000DA40 /end MEASUREMENT
/begin MEASUREMENT Mo_stCplChk_mp "" ULONG OneToOne 1 100 0.00 4294967295.00 FORMAT "%13.2" ECU_ADDRESS 0xC0001364 /end MEASUREMENT
/begin MEASUREMENT Mo_stICOMsg "" UBYTE OneToOne 1 100 0.00 255.0 FORMAT "%5.1" ECU_ADDRESS 0xD00090E9 /end MEASUREMENT
/begin MEASUREMENT Mo_stMoC "" UBYTE OneToOne 1 100 0.00 255.0 FORMAT "%5.1" ECU_ADDRESS 0xD000A0B9 /end MEASUREMENT
/begin MEASUREMENT Mo_stMoF "" UBYTE OneToOne 1 100 0.00 255.0 FORMAT "%5.1" ECU_ADDRESS 0xD000A0BA /end MEASUREMENT
/begin MEASUREMENT MRly_ctErlyOpng_mp "" UBYTE OneToOne 1 100 0.00 255.0 FORMAT "%5.1" ECU_ADDRESS 0xC0001368 /end MEASUREMENT
/begin MEASUREMENT MRly_st "" UBYTE OneToOne 1 100 0.00 255.0 FORMAT "%5.1" ECU_ADDRESS 0xD000922E /end MEASUREMENT
/begin MEASUREMENT MRly_stAct "" UBYTE OneToOne 1 100 0.00 255.0 FORMAT "%5.1" ECU_ADDRESS 0xD00090CD /end MEASUREMENT
/begin MEASUREMENT MRly_uBattFlt_mp "" SWORD Volt_Batt 1 100 -655360.0 655340.0 FORMAT "%8.1" ECU_ADDRESS 0xC000136A /end MEASUREMENT
/begin MEASUREMENT NSCDsRLam_rLam "" SWORD lambda 1 100 -32.76800 32.76700 FORMAT "%8.5" ECU_ADDRESS 0xD000738C /end MEASUREMENT
/begin MEASUREMENT NSCDsRLam_rLamRec "" SWORD lambdaRecVal 1 100 -32.76800 32.76700 FORMAT "%8.5" ECU_ADDRESS 0xD000738E /end MEASUREMENT
/begin MEASUREMENT NSCDsRLam_rO2PresComp "" SWORD O2 1 100 -0.3276800 0.3276700 FORMAT "%9.7" ECU_ADDRESS 0xD0007390 /end MEASUREMENT
/begin MEASUREMENT OilPLmp_st "" UBYTE OneToOne 1 100 0.00 255.0 FORMAT "%5.1" ECU_ADDRESS 0xD00090EC /end MEASUREMENT
/begin MEASUREMENT Oil_stPSwmp "" UBYTE OneToOne 1 100 0.00 255.0 FORMAT "%5.1" ECU_ADDRESS 0xD00090EF /end MEASUREMENT
/begin MEASUREMENT Oil_stRawPSwmp "" UBYTE OneToOne 1 100 0.00 255.0 FORMAT "%5.1" ECU_ADDRESS 0xD00090F0 /end MEASUREMENT
/begin MEASUREMENT TrbnDsRLam_rLam "" SWORD lambda 1 100 -32.76800 32.76700 FORMAT "%8.5" ECU_ADDRESS 0xD00075AE /end MEASUREMENT
/begin MEASUREMENT TrbnDsRLam_rLamRec "" SWORD lambdaRecVal 1 100 -32.76800 32.76700 FORMAT "%8.5" ECU_ADDRESS 0xD00075B0 /end MEASUREMENT
/begin MEASUREMENT TrbnDsRLam_rO2PresComp "" SWORD O2 1 100 -0.3276800 0.3276700 FORMAT "%9.7" ECU_ADDRESS 0xD00075B2 /end MEASUREMENT
/begin FUNCTION LSU_DDWireDia100ms ""
 /begin DEF_CHARACTERISTIC LSU_BattHiDeb.tiHiLo_C LSU_BattHiDeb.tiLoHi_C LSU_OvrRunDeb.tiHiLo_C LSU_OvrRunDeb.tiLoHi_C LSU_rO2Lmbd1Thres_C LSU_rO2Min_C LSU_stWireDiaPwrStgDiaEna_C LSU_tiDvtFlt_C LSU_tiMaxDebVirtNernst_C LSU_tiOpnLdTstActv_C LSU_tiRiMeasDisa_C LSU_tRiMinDiag_C LSU_uBattMin_C LSU_uO2OpnLdNernstMax_C LSU_uO2OpnLdNernstMin_C LSU_uO2OpnLdVirtGndMax_C LSU_uO2OpnLdVirtGndMin_C LSU_uRiOpnLdTstMax_C /end DEF_CHARACTERISTIC
 /begin OUT_MEASUREMENT LSU_stOpnErrIP LSU_stOpnLdTstActv /end OUT_MEASUREMENT
 /begin LOC_MEASUREMENT LSU_stDebBattHi_mp LSU_stDebOvrRun_mp LSU_stDelHtCtl_mp LSU_stDiagRegExpec_mp LSU_stDiagReg_mp LSU_stErrBitMsk_mp LSU_stErr_mp LSU_stInitReg_mp LSU_stOLTstVMUNEna_mp LSU_stRawOLTstEna_mp /end LOC_MEASUREMENT
/end FUNCTION
/begin FUNCTION LSU_IntFcDia "" /begin DEF_CHARACTERISTIC LSU_stSrvTstDem_C /end DEF_CHARACTERISTIC /end FUNCTION
/begin FUNCTION LSU_VDAdap ""
 /begin DEF_CHARACTERISTIC LSU_AirPerTimeI.Ki_C LSU_AirPerTimeI.KiPos_C LSU_AirPerTimeI.KiNeg_C LSU_AirPerTimeI.WinPos_C LSU_AirPerTimeI.WinNeg_C LSU_d2rIni_C LSU_EvalMaxVal_C LSU_EvalMinVal_C LSU_facPresCompLean_MAP LSU_facPresCompRich_MAP LSU_mAirAdapActv_C LSU_numEGFld_CA LSU_rLamRec_CUR LSU_rO2SwtPresComp_C LSU_swtAdap_C LSU_tAirAdapActv_C LSU_tiAdapFltIni_C LSU_tiAdapFlt_C LSU_tiEvalFltIni_C LSU_tiEvalFlt_C /end DEF_CHARACTERISTIC
 /begin IN_MEASUREMENT AFS_dm ASMod_pEGFld CoEng_st EnvT_t LSU_rO2Raw LSU_stO2IntValid LSU_swtEna LSU_tDvt_mp PthSet_stOvrRunCoord /end IN_MEASUREMENT
 /begin OUT_MEASUREMENT LSU_d2rO2Eval_mp LSU_d2rO2_mp LSU_drO2Adap LSU_drO2Flt_mp LSU_facO2Corr_mp LSU_facPresComp_mp LSU_mAirAftOvrRun_mp LSU_pExhGasLstVal_mp LSU_rLam LSU_rLamRec LSU_rO2Adap LSU_rO2AdptLastLSU_mp LSU_rO2PresComp LSU_stAdap LSU_stAdapActv_mp LSU_stChng_mp LSU_stHold_mp LSU_swtAdap LSU_tDvtPresComp_mp NSCDsRLam_rLam NSCDsRLam_rLamRec NSCDsRLam_rO2PresComp TrbnDsRLam_rLam TrbnDsRLam_rLamRec TrbnDsRLam_rO2PresComp /end OUT_MEASUREMENT
 /begin LOC_MEASUREMENT LSU_stActv_mp /end LOC_MEASUREMENT
/end FUNCTION
/begin FUNCTION LSU_VDHtrCtl ""
 /begin DEF_CHARACTERISTIC LSU_dcycHtMin_C LSU_DcycRmp.Pos_C LSU_DcycRmp.Neg_C LSU_dcycStrt_CUR LSU_nHtCtlEna_C LSU_Sens1DT1.T1_C LSU_Sens1DT1.Kd_C LSU_Sens1I.Ki_C LSU_Sens1I.KiPos_C LSU_Sens1I.KiNeg_C LSU_Sens1I.WinPos_C LSU_Sens1I.WinNeg_C LSU_Sens1P.Kp_C LSU_Sens1P.KpPos_C LSU_Sens1P.KpNeg_C LSU_Sens1P.WinPos_C LSU_Sens1P.WinNeg_C LSU_Sens2DT1.T1_C LSU_Sens2DT1.Kd_C LSU_Sens2I.Ki_C LSU_Sens2I.KiPos_C LSU_Sens2I.KiNeg_C LSU_Sens2I.WinPos_C LSU_Sens2I.WinNeg_C LSU_Sens2P.Kp_C LSU_Sens2P.KpPos_C LSU_Sens2P.KpNeg_C LSU_Sens2P.WinPos_C LSU_Sens2P.WinNeg_C LSU_tExcMax_C LSU_tExcMin_C LSU_tHtCtlEna_C LSU_tiDelIniVal_C LSU_tLowLim_CUR LSU_tRiSetP_C LSU_tUpLim_CUR /end DEF_CHARACTERISTIC
 /begin IN_MEASUREMENT BattU_u /end IN_MEASUREMENT
 /begin OUT_MEASUREMENT LSU_dcycDT1_mp LSU_dcycHt LSU_dcycHtIniRmp LSU_dcycHtStrt LSU_dcycI_mp LSU_dcycP_mp LSU_stHtCtl LSU_stRmp_mp LSU_stSCUNEna LSU_tAirStrt_mp LSU_tDvt_mp /end OUT_MEASUREMENT
/end FUNCTION
/begin FUNCTION lsu_vdmon ""
 /begin DEF_CHARACTERISTIC LSU_mAirMaxCmpChk_C LSU_mAirMax_C LSU_mAirMinCmpChk_C LSU_mAirMin_C LSU_nMaxCmpChk_C LSU_nMax_C LSU_nMinChkDyn_C LSU_nMinCmpChk_C LSU_nMin_C LSU_numSelDiffChk_C LSU_numSensCmpChk_CA LSU_qDiffMax_C LSU_qMaxCmpChk_C LSU_qMax_C LSU_qMinCmpChk_C LSU_qMin_C LSU_qThresChkDyn_C LSU_qThresOvrRun_C LSU_rEGRMaxCmpChk_C LSU_rEGRMinCmpChk_C LSU_rMaxDiff_CA LSU_rO2MaxVar_C LSU_rO2NegDvt_C LSU_rO2PosDvt_C LSU_stMonActv_C LSU_stMonCmpReqd_C LSU_stMonMsk_C LSU_stMskCmpChkO2_C LSU_stSelPlausChkSig_C LSU_tiDlyCmpChkO2_C LSU_tiO2CalcFlt_C LSU_tiO2Eval_C LSU_tiSwt_CA LSU_tiWait1_CA LSU_tiWait2_CA LSU_tiWait3_CA LSU_volMinFl_C /end DEF_CHARACTERISTIC
 /begin OUT_MEASUREMENT LSU_bpPlausSetPoint_mp LSU_numMaxCmpChk_mp LSU_qStrt_mp LSU_rO2Calc_mp LSU_rO2DiffCmpChk_mp LSU_rO2DvtNeg_mp LSU_rO2DvtPos_mp LSU_rO2FrstValCmpChk_mp LSU_rO2SecValCmpChk_mp LSU_rO2Stat LSU_rO2Thres1_mp LSU_rO2Thres2_mp LSU_stChkDyn_mp LSU_stCmpChkCon_mp LSU_stCmpChk_mp LSU_stCmpErr_mp LSU_stConstPOp LSU_stO2Chk LSU_stO2Err LSU_stPlausChkCon LSU_stPlausChk_mp LSU_stPOpCmpChk_mp LSU_tiState1_mp LSU_tiState2_mp LSU_tiState3_mp /end OUT_MEASUREMENT
/end FUNCTION
/begin FUNCTION LSU_VDPmpCtl "" /begin DEF_CHARACTERISTIC LSU_stPmpCtlDisbl_C /end DEF_CHARACTERISTIC /begin OUT_MEASUREMENT LSU_stPmpCtl /end OUT_MEASUREMENT /end FUNCTION
/begin FUNCTION medcadapt "" /begin OUT_MEASUREMENT ARS_trqDes /end OUT_MEASUREMENT /end FUNCTION
/begin FUNCTION medc_axispoints_core "" /end FUNCTION
/begin FUNCTION medc_axispoints_custom "" /end FUNCTION
/begin FUNCTION medc_axispoints_ds "" /end FUNCTION
/begin FUNCTION medc_axispoints_ds_gs "" /end FUNCTION
/begin FUNCTION medc_axispoints_prj "" /end FUNCTION
/begin FUNCTION medc_compu_core "" /end FUNCTION
/begin FUNCTION medc_compu_custom "" /end FUNCTION
/begin FUNCTION MEDC_Compu_DS "" /end FUNCTION
/begin FUNCTION MEDC_Compu_DS_GS "" /end FUNCTION
/begin FUNCTION medc_compu_prj "" /end FUNCTION
/begin FUNCTION medc_fixconst_core "" /end FUNCTION
/begin FUNCTION medc_fixconst_custom "" /end FUNCTION
/begin FUNCTION MEDC_FixConst_DS "" /end FUNCTION
/begin FUNCTION MEDC_FixConst_DS_GS "" /end FUNCTION
/begin FUNCTION medc_fixconst_prj "" /end FUNCTION
/begin FUNCTION medc_models_core "" /end FUNCTION
/begin FUNCTION medc_models_custom "" /end FUNCTION
/begin FUNCTION medc_models_ds "" /end FUNCTION
/begin FUNCTION MEDC_Models_DS_GS "" /end FUNCTION
/begin FUNCTION medc_models_prj "" /end FUNCTION
/begin FUNCTION medc_switches_core "" /end FUNCTION
/begin FUNCTION medc_switches_custom "" /end FUNCTION
/begin FUNCTION medc_switches_ds "" /end FUNCTION
/begin FUNCTION medc_switches_ds_gs "" /end FUNCTION
/begin FUNCTION medc_switches_prj "" /end FUNCTION
/begin FUNCTION medc_varconst_core "" /end FUNCTION
/begin FUNCTION medc_varconst_custom "" /end FUNCTION
/begin FUNCTION MEDC_VarConst_DS "" /end FUNCTION
/begin FUNCTION MEDC_VarConst_DS_GS "" /end FUNCTION
/begin FUNCTION medc_varconst_prj "" /end FUNCTION
/begin FUNCTION MemLay "" /end FUNCTION
/begin FUNCTION MeUn_DDCo ""
 /begin DEF_CHARACTERISTIC MeUn_CrntCtlDT1.T1_C MeUn_CrntCtlDT1.Kd_C MeUn_iLin_CUR MeUn_nDiffMax_C MeUn_PwmOut.rMin_C MeUn_PwmOut.rMax_C MeUn_PwmOut.tiBtwTstSCB_C MeUn_PwmOut.tiBtwTstOT_C MeUn_PwmOut.numTstMax_C MeUn_PwmOut.swtBattCor_C MeUn_PwmOut.swtPsInv_C MeUn_resCoil_C MeUn_rMaxDty_C MeUn_rPerUn_C MeUn_rSetLin_CUR MeUn_SRC.uMin_C MeUn_SRC.uMax_C MeUn_stLvl_C MeUn_stPwrStgActv_C MeUn_stPwrStgDia_C MeUn_tiPerUBattHi_C MeUn_tiPer_CUR MeUn_tiPh_C MeUn_uBattHi_C MeUn_uBattLo_C /end DEF_CHARACTERISTIC
 /begin IN_MEASUREMENT BattU_facCor BattU_u BattU_uRated DevLib_stPwrStgEnaCond Epm_nEng MeUn_stRot /end IN_MEASUREMENT
 /begin LOC_MEASUREMENT MeUn_iActVal MeUn_nDiffRef_mp MeUn_rPsPreRot_mp MeUn_rPs_mp MeUn_rSetDT1_mp MeUn_rSetLin_mp MeUn_rSet_mp MeUn_tiPer_mp MeUn_uRaw_mp /end LOC_MEASUREMENT
/end FUNCTION
/begin FUNCTION MeUn_Rot ""
 /begin DEF_CHARACTERISTIC MeUn_ctRot_C MeUn_rLim_CUR MeUn_rRotEnd_C MeUn_rRotStrt_C MeUn_stRotActv_C MeUn_tiRotDel_C MeUn_tiRotWait_C /end DEF_CHARACTERISTIC
 /begin IN_MEASUREMENT CoEng_st CoEng_stAftRun Epm_nEng FuelT_tFlSys SyC_stSub /end IN_MEASUREMENT
 /begin OUT_MEASUREMENT MeUn_stRot /end OUT_MEASUREMENT
 /begin LOC_MEASUREMENT MeUn_ctRot_mp /end LOC_MEASUREMENT
/end FUNCTION
/begin FUNCTION MeUn_VDCo ""
 /begin DEF_CHARACTERISTIC MeUn_CrntCtlI.Ki_C MeUn_CrntCtlI.KiPos_C MeUn_CrntCtlI.KiNeg_C MeUn_CrntCtlI.WinPos_C MeUn_CrntCtlI.WinNeg_C MeUn_facCrntCtlInit_CUR MeUn_facCrntCtlMax_C MeUn_facCrntCtlMin_C MeUn_iCnvFlowRate_CUR MeUn_iSetMin_C MeUn_pActrPrt_C MeUn_pFlowOfFl_C MeUn_tiCrntCtlInit_C MeUn_tiFlt1PT1_C MeUn_tiFlt2PT1_C MeUn_tiFltPT1Init_C /end DEF_CHARACTERISTIC
 /begin IN_MEASUREMENT DevLib_stMonActrPrt FuelT_tFlSys MeUn_stRot RailP_pFlt Rail_stCtlLoop /end IN_MEASUREMENT
 /begin OUT_MEASUREMENT MeUn_dvolSet /end OUT_MEASUREMENT
 /begin LOC_MEASUREMENT MeUn_facCrntCtlLim_mp MeUn_iActFlt_mp MeUn_iDvt_mp MeUn_iSetFlt MeUn_iSet_mp MeUn_stActrCtl_mp /end LOC_MEASUREMENT
/end FUNCTION
/begin FUNCTION Misc_Can ""
 /begin DEF_CHARACTERISTIC Com_ctStateARSSelfRec_C Com_ctTrqDemandAFSSelfRec_C Com_swtAnfrage_C Com_swtButtonMSA_C Com_swtDienste_C Com_swtPsp_C Com_swtReqEFan_C Com_swtReqMSA_C Com_swtShutOffPSP_C Com_swtStartdrehzahl_C Com_swtStateARS_C Com_swtStateSeat_C Com_swtTerminal_C Com_swtTrailer_C Com_swtTrqDemandAFS_C Com_swtZvKlappen_C Com_tiStateARSSelfRec_C Com_tiTrqDemandAFSSelfRec_C /end DEF_CHARACTERISTIC
 /begin LOC_MEASUREMENT Com_bRecAFS Com_bRecARS /end LOC_MEASUREMENT
/end FUNCTION
/begin FUNCTION Misc_co "" /begin DEF_CHARACTERISTIC Com_nRqStgEFan_CUR /end DEF_CHARACTERISTIC
 /begin OUT_MEASUREMENT Com_dTerminalCHK Com_dTerminalCTR Com_nPsp Com_rPspSetPoint Com_stKeyVld Com_stPsp Com_stT15 Com_stT50 Com_stTRadio /end OUT_MEASUREMENT
 /begin LOC_MEASUREMENT Com_dstARSCTR Com_dTrqDemandAfsCHK Com_dTrqDemandAfsCTR Com_nRqStgEFan Com_nStart Com_numRqStgEFan_mp Com_stARS Com_stBonnet Com_stButtonMSA Com_stDoorDriver Com_stDrWghSeat Com_stErrAFS Com_stReqMSA Com_stShutOffPSP Com_stTrailer Com_stTrqTarAFS Com_swtDrBltb Com_trqARSCur Com_trqARSDes Com_trqAvlAFS Com_trqTarAFS /end LOC_MEASUREMENT
/end FUNCTION
/begin FUNCTION Mli "" /end FUNCTION
/begin FUNCTION Mm "" /end FUNCTION
/begin FUNCTION MoCADC_Co ""
 /begin DEF_CHARACTERISTIC MoCADC_ctDebCmp_C MoCADC_ctDebTst_C MoCADC_ctDebVltgRatio_C MoCADC_ctDiagCmp_C MoCADC_ctRstCmp_C MoCADC_ctRstTst_C MoCADC_ctRstVltgRatio_C MoCADC_ctStyADC_C MoCADC_facVltgRatioMax_C MoCADC_facVltgRatioMin_C MoCADC_uMaxDiff_C MoCADC_uSty_C MoCADC_uTstMax_C MoCADC_uTstMin_C /end DEF_CHARACTERISTIC
 /begin IN_MEASUREMENT Mo_stICOMsg Mo_stMoC Mo_stMoF /end IN_MEASUREMENT
 /begin OUT_MEASUREMENT MoCADC_facVltgRatio MoCADC_st MoCADC_stIrvErrCmp MoCADC_stIrvErrTst MoCADC_stIrvErrVltgRatio /end OUT_MEASUREMENT
 /begin LOC_MEASUREMENT MoCADC_ctDebCmp MoCADC_ctDebTst MoCADC_ctDebVltgRatio MoCADC_ctDiagCmp MoCADC_ctDiagTst MoCADC_ctDiagVltgRatio MoCADC_ctStyADC1 MoCADC_ctStyADC2 MoCADC_uADC1 MoCADC_uADC2 MoCADC_uTst_mp /end LOC_MEASUREMENT
/end FUNCTION
/begin FUNCTION MoCCom_Co "" /begin REF_CHARACTERISTIC MoCSOP_ctDebSOPTst_C /end REF_CHARACTERISTIC
 /begin IN_MEASUREMENT MoCCPU_PartResp MoCMem_stTotMemChk MoCPFC_PartResp MoCSOP_stRdy /end IN_MEASUREMENT
 /begin OUT_MEASUREMENT MoCCom_ctErrMMMsg MoCCom_Query MoCCom_stQueryNew MoCCom_stWDAActvMsg /end OUT_MEASUREMENT
 /begin LOC_MEASUREMENT MoCCom_bCPUNew MoCCom_bErrCntErr MoCCom_bErrCntNPl MoCCom_bPCPNew MoCCom_bPFCNew MoCCom_bSpiErr MoCCom_bSpiNPl MoCCom_ctErrFC MoCCom_ctErrMM MoCCom_ctErrMMOld MoCCom_ctErrSPI MoCCom_ctSOPTstActv MoCCom_Response MoCCom_st /end LOC_MEASUREMENT
/end FUNCTION
/begin FUNCTION MoCCPU_Co "" /begin IN_MEASUREMENT MoCCom_Query MoCCom_stQueryNew /end IN_MEASUREMENT /begin OUT_MEASUREMENT MoCCPU_PartResp MoCCPU_Query /end OUT_MEASUREMENT /begin LOC_MEASUREMENT MoCCPU_ctSeq MoCCPU_TempRes /end LOC_MEASUREMENT /end FUNCTION
/begin FUNCTION MoCGPTA_Co "" /begin DEF_CHARACTERISTIC MoCGPTA_numErr_C MoCGPTA_tiDvtMax_C /end DEF_CHARACTERISTIC /end FUNCTION
/begin FUNCTION MoCMem_Co ""
 /begin DEF_CHARACTERISTIC MoCMem_ctDebErrChkRAM_C MoCMem_ctDebErrChkROM_C MoCMem_ctDebHealChkRAM_C MoCMem_ctDebHealChkROM_C /end DEF_CHARACTERISTIC
 /begin IN_MEASUREMENT Mo_stMoC /end IN_MEASUREMENT
 /begin OUT_MEASUREMENT MoCMem_st MoCMem_stTotMemChk /end OUT_MEASUREMENT
 /begin LOC_MEASUREMENT MoCMem_adCurrent MoCMem_adRamOffset MoCMem_ctDebErrChkRAM MoCMem_ctDebErrChkROM MoCMem_ctDebHealChkRAM MoCMem_ctDebHealChkROM MoCMem_numCurrent MoCMem_stFunctionSwitch /end LOC_MEASUREMENT
/end FUNCTION
/begin FUNCTION MoCPCP_Co "" /begin DEF_CHARACTERISTIC MoCPCP_numErr_C MoCPCP_stEnaMFTst_CW MoCPCP_tiHeal_C /end DEF_CHARACTERISTIC /begin IN_MEASUREMENT MoCCom_stQueryNew MoCMem_st Mo_stMoC /end IN_MEASUREMENT
 /begin LOC_MEASUREMENT MoCPCP_adCurrent MoCPCP_ctErr MoCPCP_ctHeal MoCPCP_numCurrentCSum /end LOC_MEASUREMENT
/end FUNCTION
/begin FUNCTION MoCPFC_Co "" /begin IN_MEASUREMENT MoCCom_Query /end IN_MEASUREMENT /begin OUT_MEASUREMENT MoCPFC_PartResp /end OUT_MEASUREMENT /begin LOC_MEASUREMENT MoCPFC_Checksum MoCPFC_Checkword MoCPFC_Counter /end LOC_MEASUREMENT /end FUNCTION
/begin FUNCTION MoCSOP_Co ""
 /begin DEF_CHARACTERISTIC MoCSOP_ctDebPSDia_C MoCSOP_ctDebSOPTst_C MoCSOP_stMMErrReac_CW MoCSOP_stSOPTstActv_CW MoCSOP_stSWResetDem_CW /end DEF_CHARACTERISTIC
 /begin IN_MEASUREMENT MoCMem_st MoCMem_stTotMemChk Mo_stMoF /end IN_MEASUREMENT
 /begin OUT_MEASUREMENT MoCSOP_ctErrMM MoCSOP_stActvMsg MoCSOP_stRdy /end OUT_MEASUREMENT
 /begin LOC_MEASUREMENT MoCSOP_ctDebPSDia MoCSOP_ctDebSOPTst MoCSOP_st /end LOC_MEASUREMENT
/end FUNCTION
/begin FUNCTION MoExe_Co "" /begin IN_MEASUREMENT SyC_stSub /end IN_MEASUREMENT /begin OUT_MEASUREMENT MoExe_ctCyc /end OUT_MEASUREMENT /end FUNCTION
/begin FUNCTION MoFACC_Co "" /begin IN_MEASUREMENT Mo_stMoC /end IN_MEASUREMENT /begin OUT_MEASUREMENT MoFACC_st /end OUT_MEASUREMENT /end FUNCTION
/begin FUNCTION MoFAcs_Co ""
 /begin DEF_CHARACTERISTIC MoFAcs_facAltTComp_CUR MoFAcs_rTrqAC_CUR MoFAcs_rTrqAlt_CUR MoFAcs_rTrqStaPmp_C MoFAcs_swtTraType_C MoFAcs_trqARSMax_C MoFAcs_trqARSMax_CUR MoFAcs_trqLosTra_C /end DEF_CHARACTERISTIC
 /begin REF_CHARACTERISTIC Mo_trqIdcMax_C /end REF_CHARACTERISTIC
 /begin IN_MEASUREMENT AC_trqDes Alt_trqDes ARS_trqDes Com_trqGbxFrc MoFESpd_nEng MoFTEng_tEng Mo_stMoC Strg_trqDes VehV_v /end IN_MEASUREMENT
 /begin OUT_MEASUREMENT MoFAcs_rTrqAcs MoFAcs_rTrqLos MoFAcs_rTrqLosPT MoFAcs_trqAcs MoFAcs_trqAcsMsg /end OUT_MEASUREMENT
 /begin LOC_MEASUREMENT MoFAcs_rTrqARS_mp MoFAcs_trqAC_mp MoFAcs_trqAlt_mp MoFAcs_trqARSMax_mp MoFAcs_trqARS_mp MoFAcs_trqLosPT_mp MoFAcs_trqLos_mp /end LOC_MEASUREMENT
/end FUNCTION
/begin FUNCTION MoFAPP_Co ""
 /begin DEF_CHARACTERISTIC MoFAPP_ctDeb_C MoFAPP_ctRst_C MoFAPP_uFL_C MoFAPP_uLoLim_C MoFAPP_uMaxDiffFL_C MoFAPP_uMaxDiffPL_C /end DEF_CHARACTERISTIC
 /begin IN_MEASUREMENT APP_stSigSrc MoCADC_st MoFIn_st Mo_stICOMsg Mo_stMoC Mo_stMoF /end IN_MEASUREMENT
 /begin OUT_MEASUREMENT MoFAPP_stIrvErr MoFAPP_stLimpMsg MoFAPP_u /end OUT_MEASUREMENT
 /begin LOC_MEASUREMENT MoFAPP_ctDeb MoFAPP_ctDiag MoFAPP_stDiff_mp MoFAPP_stTst MoFAPP_uRaw1_mp MoFAPP_uRaw2_mp /end LOC_MEASUREMENT
/end FUNCTION
/begin FUNCTION MoFASD_Co "" /begin DEF_CHARACTERISTIC MoFASD_tiT1_C MoFASD_trqFltMax_C MoFASD_trqMax_C /end DEF_CHARACTERISTIC /begin REF_CHARACTERISTIC Mo_trqIdcMax_C /end REF_CHARACTERISTIC /begin IN_MEASUREMENT MoFInjDat_trqASD Mo_stMoC /end IN_MEASUREMENT /begin OUT_MEASUREMENT MoFASD_rTrq /end OUT_MEASUREMENT /begin LOC_MEASUREMENT MoFASD_trqASD_mp MoFASD_trqFlt /end LOC_MEASUREMENT /end FUNCTION
/begin FUNCTION MoFBrk_Co "" /begin IN_MEASUREMENT Mo_stMoC /end IN_MEASUREMENT /begin OUT_MEASUREMENT MoFBrk_st /end OUT_MEASUREMENT /end FUNCTION
/begin FUNCTION MoFCCtl_Co "" /begin IN_MEASUREMENT Mo_stMoC /end IN_MEASUREMENT /begin OUT_MEASUREMENT MoFCCtl_st /end OUT_MEASUREMENT /end FUNCTION
/begin FUNCTION MoFClth_Co "" /begin DEF_CHARACTERISTIC MoFClth_ctDeb_C /end DEF_CHARACTERISTIC /begin IN_MEASUREMENT Mo_stMoC /end IN_MEASUREMENT /begin OUT_MEASUREMENT MoFClth_ctDeb MoFClth_st /end OUT_MEASUREMENT /end FUNCTION
/begin FUNCTION MoFCoEng_Co "" /begin DEF_CHARACTERISTIC MoFCoEng_tiT1_C /end DEF_CHARACTERISTIC /begin REF_CHARACTERISTIC Mo_trqIdcMax_C /end REF_CHARACTERISTIC
 /begin IN_MEASUREMENT MoFAcs_trqAcs MoFCoVeh_rTrqComp MoFCoVeh_trqVehPtd MoFLos_rTrq Mo_stMoC /end IN_MEASUREMENT
 /begin OUT_MEASUREMENT MoFCoEng_rTrqFlt MoFCoEng_rTrqInrSet MoFCoEng_rTrqPtd MoFCoEng_stTrqFlt /end OUT_MEASUREMENT
 /begin LOC_MEASUREMENT MoFCoEng_rTrqInr_mp MoFCoEng_trqInrSet_mp MoFCoEng_trqInr_mp MoFCoEng_trqLos_mp MoFCoEng_trqPtd_mp /end LOC_MEASUREMENT
/end FUNCTION
/begin FUNCTION MoFCoOfs_Co "" /begin DEF_CHARACTERISTIC MoFCoOfs_rTrqPtdOfs_MAP MoFCoOfs_tiDel_C MoFCoOfs_tiT1_C /end DEF_CHARACTERISTIC /begin REF_CHARACTERISTIC Mo_trqIdcMax_C /end REF_CHARACTERISTIC
 /begin IN_MEASUREMENT MoFASD_rTrq MoFCoEng_rTrqPtd MoFESpd_nEng MoFSpdG_rTrq Mo_stMoC /end IN_MEASUREMENT
 /begin OUT_MEASUREMENT MoFCoOfs_ctIdxDel MoFCoOfs_rTrqPtdFlt MoFCoOfs_rTrqPtdMsg MoFCoOfs_rTrqPtdOfs /end OUT_MEASUREMENT
 /begin LOC_MEASUREMENT MoFCoOfs_rTrqPtdDel_mp MoFCoOfs_rTrqPtd_mp MoFCoOfs_trqPtdOfs_mp /end LOC_MEASUREMENT
/end FUNCTION
/begin FUNCTION MoFCoVeh_Co "" /begin DEF_CHARACTERISTIC MoFCoVeh_facTrqComp_MAP MoICoVeh_MoIDrDem_trqPtd_CA /end DEF_CHARACTERISTIC /begin REF_CHARACTERISTIC Mo_trqIdcMax_C /end REF_CHARACTERISTIC
 /begin IN_MEASUREMENT CoVeh_trqDesComp MoCCPU_Query MoFAcs_rTrqLos MoFAcs_rTrqLosPT MoFDrAs_trqPtd MoFDrDem_rTrqPT MoFDrDem_trqPtd MoFESpd_nEng MoFExtInt_trqPtd Mo_stMoC /end IN_MEASUREMENT
 /begin OUT_MEASUREMENT MoFCoVeh_rTrqComp MoFCoVeh_trqCompMsg MoFCoVeh_trqVehPtd MoFCoVeh_trqVehPtdMsg /end OUT_MEASUREMENT
 /begin LOC_MEASUREMENT MoFCoVeh_facTrqComp_mp MoFCoVeh_trqPrpClth_mp MoFCoVeh_trqVMD_mp /end LOC_MEASUREMENT
/end FUNCTION
/begin FUNCTION MoFDCS_Co "" /begin IN_MEASUREMENT Com_stTrqDSCDes Com_trqDSCDes Mo_stMoC /end IN_MEASUREMENT /begin OUT_MEASUREMENT MoFDCS_stDem MoFDCS_stIrvErr MoFDCS_trqDem /end OUT_MEASUREMENT /end FUNCTION
/begin FUNCTION MoFDrAs_Co ""
 /begin DEF_CHARACTERISTIC MoFDrAs_ctDebACC_C MoFDrAs_ctDebCCtl_C MoFDrAs_vACCMin_C MoFDrAs_vCCtlMin_C /end DEF_CHARACTERISTIC
 /begin IN_MEASUREMENT ACCI_stInActv CoVMD_trqCrCtl CrCtl_stPtd MoFACC_st MoFBrk_st MoFCCtl_st Mo_stMoC VehMot_stPrpCrCtl VehV_v /end IN_MEASUREMENT
 /begin OUT_MEASUREMENT MoFDrAs_ctDebACC MoFDrAs_ctDebCCtl MoFDrAs_stACCPtdMsg MoFDrAs_stCCtlPtd MoFDrAs_stCCtlPtdMsg MoFDrAs_stPtdMsg MoFDrAs_trqPtd /end OUT_MEASUREMENT
 /begin LOC_MEASUREMENT MoFDrAs_stACCDel_mp MoFDrAs_stCCtlDel_mp MoFDrAs_stLogPtd_mp MoFDrAs_vMin_mp /end LOC_MEASUREMENT
/end FUNCTION
/begin FUNCTION MoFDrDem_Co ""
 /begin DEF_CHARACTERISTIC MoFDrDem_rThreshPrpMin_C MoFDrDem_rThreshPrp_C MoFDrDem_rTrqEng_MAP MoFDrDem_rTrqPTMax_C MoFDrDem_rTrqPTMin_C MoFDrDem_uAPPMax_C MoFDrDem_uAPPMin_C /end DEF_CHARACTERISTIC
 /begin REF_CHARACTERISTIC Mo_trqIdcMax_C /end REF_CHARACTERISTIC
 /begin IN_MEASUREMENT MoFAcs_rTrqLos MoFAPP_u MoFESpd_nEng MoFLos_rTrq Mo_stMoC PT_rTrq VehMot_rTrqDfftl /end IN_MEASUREMENT
 /begin OUT_MEASUREMENT MoFDrDem_rAPP MoFDrDem_rTrqPT MoFDrDem_trqPtd /end OUT_MEASUREMENT
 /begin LOC_MEASUREMENT MoFDrDem_rTrqMin_mp MoFDrDem_trqEng_mp MoFDrDem_trqOvrRun_mp /end LOC_MEASUREMENT
/end FUNCTION
/begin FUNCTION MoFESpd_Co ""
 /begin DEF_CHARACTERISTIC MoFESpd_ctDeb_C MoFESpd_ctRst_C MoFESpd_nDiffMax_C MoFESpd_nMin_C MoFESpd_phiMaxIni_C /end DEF_CHARACTERISTIC
 /begin IN_MEASUREMENT Mo_ctRst Mo_stICOMsg Mo_stMoC Mo_stMoF /end IN_MEASUREMENT
 /begin OUT_MEASUREMENT MoFESpd_nEng /end OUT_MEASUREMENT
 /begin LOC_MEASUREMENT MoFESpd_ctDeb MoFESpd_ctDiag MoFESpd_nEngL2_mp MoFESpd_phiGT1Last MoFESpd_stIrvErr MoFESpd_stSyncAbrt1 MoFESpd_stSyncAbrt2 MoFESpd_stTst MoFESpd_tiLast /end LOC_MEASUREMENT
/end FUNCTION
/begin FUNCTION MoFExtInt_Co ""
 /begin DEF_CHARACTERISTIC MoFExtInt_ctDebDCSMax_C MoFExtInt_ctDebTSCMax_C MoFExtInt_st_C /end DEF_CHARACTERISTIC
 /begin REF_CHARACTERISTIC Mo_trqIdcMax_C /end REF_CHARACTERISTIC
 /begin IN_MEASUREMENT MoFAcs_rTrqAcs MoFDCS_stDem MoFDCS_trqDem MoFLos_rTrq MoFTra_stDem MoFTra_trqDem Mo_stMoC Tra_stTSCPtd VMSI_stDCSPtd /end IN_MEASUREMENT
 /begin OUT_MEASUREMENT MoFExtInt_stDCSPtdMsg MoFExtInt_stTSCPtdMsg MoFExtInt_trqPtd /end OUT_MEASUREMENT
 /begin LOC_MEASUREMENT MoFExtInt_ctDebDCS MoFExtInt_ctDebTSC MoFExtInt_trqLos_mp MoFExtInt_trqPtdDCS MoFExtInt_trqPtdTSC /end LOC_MEASUREMENT
/end FUNCTION
/begin FUNCTION MoFICO_Co "" /begin DEF_CHARACTERISTIC MoFICO_ctDeb_C MoFICO_nCtOff_C /end DEF_CHARACTERISTIC
 /begin IN_MEASUREMENT MoFESpd_nEng MoFInjDat_stInjState Mo_ctRst Mo_stMoC Mo_stMoF /end IN_MEASUREMENT
 /begin LOC_MEASUREMENT MoFICO_ctDeb /end LOC_MEASUREMENT
/end FUNCTION
/begin FUNCTION MoFInjDat_GetInj ""
 /begin DEF_CHARACTERISTIC MoFInjDat_ctDebPhiErr_C MoFInjDat_ctDebQntErr_C MoFInjDat_ctDiagPhi_C MoFInjDat_ctDiagQnt_C MoFInjDat_ctRst_C MoFInjDat_facInjEff_MAP MoFInjDat_nNumRevCs1Max_C MoFInjDat_nNumRevCs2Max_C MoFInjDat_nNumRevCs2Min_C MoFInjDat_nNumRevCs3Min_C MoFInjDat_numCyl_C MoFInjDat_phiMI1Max_C MoFInjDat_phiMI1Min_C MoFInjDat_phiPiIMax_C MoFInjDat_phiPiIMin_C MoFInjDat_phiPoI1Max_C MoFInjDat_phiPoI1Min_C MoFInjDat_phiPoI2Max_C MoFInjDat_phiPoI2Min_C MoFInjDat_qThreshQntErr_C /end DEF_CHARACTERISTIC
 /begin IN_MEASUREMENT ASDdc_trq Epm_ctCyl Epm_nEng Epm_stOpMode InjCrv_stInjCharActVal InjCtl_qSetUnBal InjVlv_tiZFCPiI1ETCor Mo_ctRst Mo_stICOMsg Mo_stMoC Mo_stMoF SpdGov_trqSet /end IN_MEASUREMENT
 /begin OUT_MEASUREMENT MoFInjDat_ctDebQntErr MoFInjDat_phiMI1 MoFInjDat_phiPiI1 MoFInjDat_phiPiI2 MoFInjDat_phiPiI3 MoFInjDat_phiPoI2 MoFInjDat_qMI1WvCor MoFInjDat_qPiI1WvCor MoFInjDat_qPoI2WvCor MoFInjDat_stChkSum MoFInjDat_stInjState MoFInjDat_tCor MoFInjDat_tiMI1 MoFInjDat_tiMI1PoI2 MoFInjDat_tiPiI1 MoFInjDat_tiPiI1MI1 MoFInjDat_tiPiI1ZFCETCor MoFInjDat_tiPiI2 MoFInjDat_tiPiI2MI1 MoFInjDat_tiPiI2PiI1 MoFInjDat_tiPiI2ZFCETCor MoFInjDat_tiPiI3 MoFInjDat_tiPiI3ZFCETCor MoFInjDat_tiPoI2 MoFInjDat_tiTDCAvrg MoFInjDat_trqASD MoFInjDat_trqSpdG /end OUT_MEASUREMENT
 /begin LOC_MEASUREMENT MoFInjDat_ctDebPhiErr MoFInjDat_ctDiagPhi MoFInjDat_ctDiagQnt MoFInjDat_ctProc MoFInjDat_numCylActr_mp MoFInjDat_numInjType_mp MoFInjDat_numRevCsAct MoFInjDat_phiEOEMI1Sum MoFInjDat_phiEOEPiI1Sum MoFInjDat_phiEOEPiI2Sum MoFInjDat_phiInjAct_mp MoFInjDat_phiInjBegActr_mp MoFInjDat_phiMI1Sum MoFInjDat_phiPiI1Sum MoFInjDat_phiPiI2Sum MoFInjDat_phiPiI3Sum MoFInjDat_phiPoI2Sum MoFInjDat_qMI1WvCorSum MoFInjDat_qPiI1WvCorSum MoFInjDat_qPoI2WvCorSum MoFInjDat_stIrvErrPhi MoFInjDat_stIrvErrQnt MoFInjDat_tiInjAct_mp MoFInjDat_tiInjDurActr_mp MoFInjDat_tiMI1Sum MoFInjDat_tiPiI1Sum MoFInjDat_tiPiI1ZFCETCorSum MoFInjDat_tiPiI2Sum MoFInjDat_tiPiI2ZFCETCorSum MoFInjDat_tiPiI3Sum MoFInjDat_tiPiI3ZFCETCorSum MoFInjDat_tiPoI2Sum MoFInjDat_tiTDCSumET_mp MoFInjDat_trqASDSum MoFInjDat_trqSpdGSum /end LOC_MEASUREMENT
/end FUNCTION
/begin FUNCTION MoFInjQnt_Co ""
 /begin DEF_CHARACTERISTIC MoFInjQnt_ctDebErr_C MoFInjQnt_ctRst_C MoFInjQnt_rhoFl_C MoFInjQnt_stQntAdj_MAP MoFInjQnt_tiZFCETMax_CUR MoFInjQnt_tiZFCETMin_CUR MoFInjQnt_volQntAdjLim_C MoFInjQnt_vol_MAP /end DEF_CHARACTERISTIC
 /begin REF_CHARACTERISTIC MoFInjDat_numCyl_C /end REF_CHARACTERISTIC
 /begin IN_MEASUREMENT MoFInjDat_tiMI1 MoFInjDat_tiPiI1 MoFInjDat_tiPiI1ZFCETCor MoFInjDat_tiPiI2 MoFInjDat_tiPiI2ZFCETCor MoFInjDat_tiPiI3 MoFInjDat_tiPiI3ZFCETCor MoFInjDat_tiPoI2 MoFRailP_p Mo_ctRst Mo_stICOMsg Mo_stMoC Mo_stMoF /end IN_MEASUREMENT
 /begin OUT_MEASUREMENT MoFInjQnt_ctDebErr MoFInjQnt_qMI1Cor MoFInjQnt_qPiI1Cor MoFInjQnt_qPiI2Cor MoFInjQnt_qPiI3Cor MoFInjQnt_qPoI2Cor /end OUT_MEASUREMENT
 /begin LOC_MEASUREMENT MoFInjQnt_ctDiag MoFInjQnt_stChk_mp MoFInjQnt_stIrvErr MoFInjQnt_volCor MoFInjQnt_volMI1QntAdj_mp MoFInjQnt_volMI1UnCor_mp MoFInjQnt_volPiI1QntAdj_mp MoFInjQnt_volPiI1UnCor_mp MoFInjQnt_volPiI2QntAdj_mp MoFInjQnt_volPiI2UnCor_mp MoFInjQnt_volPiI3QntAdj_mp MoFInjQnt_volPiI3UnCor_mp MoFInjQnt_volPoI2QntAdj_mp MoFInjQnt_volPoI2UnCor_mp /end LOC_MEASUREMENT
/end FUNCTION
/begin FUNCTION MoFIn_Co "" /begin IN_MEASUREMENT Mo_stMoC /end IN_MEASUREMENT /begin OUT_MEASUREMENT MoFIn_st /end OUT_MEASUREMENT /end FUNCTION
/begin FUNCTION MoFLos_Co "" /begin DEF_CHARACTERISTIC MoFLos_rTrqEngLos_MAP /end DEF_CHARACTERISTIC /begin IN_MEASUREMENT MoFESpd_nEng MoFTEng_tEng Mo_stMoC /end IN_MEASUREMENT /begin OUT_MEASUREMENT MoFLos_rTrq /end OUT_MEASUREMENT /end FUNCTION
/begin FUNCTION MoFMode_Co ""
 /begin DEF_CHARACTERISTIC MoFMode_fac1PoI2Eff_MAP MoFMode_fac2PoI2Eff_CUR MoFMode_fac3PoI2Eff_MAP /end DEF_CHARACTERISTIC
 /begin IN_MEASUREMENT MoFESpd_nEng MoFInjDat_phiPoI2 MoFInjDat_tiMI1PoI2 MoFInjQnt_qPiI2Cor MoFInjQnt_qPiI3Cor MoFQntCor_qMI1 MoFQntCor_qPiI1 MoFQntCor_qPoI2 Mo_stMoC /end IN_MEASUREMENT
 /begin OUT_MEASUREMENT MoFMode_qSetUnBal MoFMode_stOpModeMsg /end OUT_MEASUREMENT
 /begin LOC_MEASUREMENT MoFMode_facPoI2Eff_mp MoFMode_qSumPiIMI_mp /end LOC_MEASUREMENT
/end FUNCTION
/begin FUNCTION MoFOvR_Co ""
 /begin DEF_CHARACTERISTIC MoFOvR_ctDebASDdc_C MoFOvR_ctDebETDef_C MoFOvR_ctRst_C MoFOvR_nEngOff_C MoFOvR_nSpdGovLim_C MoFOvR_nStrtEnd_C MoFOvR_tiAPPFlt_C MoFOvR_tiCrCtlBrkRmp_C MoFOvR_tiEngSpdRlsBrkRmp_C MoFOvR_tiLimET_CUR /end DEF_CHARACTERISTIC
 /begin IN_MEASUREMENT APP_r Brk_st CrCtl_stReq MoExe_ctCyc MoFBrk_st MoFClth_st MoFCoVeh_rTrqComp MoFDCS_stDem MoFDrDem_rAPP MoFESpd_nEng MoFInjDat_tiTDCAvrg MoFSpdG_stDem MoFTra_stDem Mo_ctRst Mo_stICOMsg Mo_stMoC Mo_stMoF PthSet_trqSetASDdc SpdGov_trqSet /end IN_MEASUREMENT
 /begin OUT_MEASUREMENT MoFOvR_stActvMsg /end OUT_MEASUREMENT
 /begin LOC_MEASUREMENT MoFOvR_ctDebAPP MoFOvR_ctDebASDdc MoFOvR_ctDebASDdcL1 MoFOvR_ctDebBrk MoFOvR_ctDebET MoFOvR_ctDiag MoFOvR_ctEngSpd MoFOvR_stIrvErr MoFOvR_stRls MoFOvR_stTst MoFOvR_tiLimET_mp /end LOC_MEASUREMENT
/end FUNCTION
/begin FUNCTION MoFQntCor_Co ""
 /begin DEF_CHARACTERISTIC MoFQntCor_ctDebErr_C MoFQntCor_ctRst_C MoFQntCor_facFTSWCor_MAP MoFQntCor_facPiI2WvCor_C MoFQntCor_facWvCor1_MAP MoFQntCor_facWvCor2_MAP MoFQntCor_qMI1DeltaMax_C MoFQntCor_qPiI1DeltaMax_C MoFQntCor_qPoI2DeltaMax_C MoFQntCor_qWvCor1_MAP MoFQntCor_qWvCor2_MAP MoFQntCor_qWvCorMax_C MoFQntCor_qWvCorMin_C MoFQntCor_qWvCorNorm_CUR MoFQntCor_tiDiffHyd_MAP /end DEF_CHARACTERISTIC
 /begin IN_MEASUREMENT MoFInjDat_qMI1WvCor MoFInjDat_qPiI1WvCor MoFInjDat_qPoI2WvCor MoFInjDat_tCor MoFInjDat_tiMI1PoI2 MoFInjDat_tiPiI1MI1 MoFInjDat_tiPiI2MI1 MoFInjDat_tiPiI2PiI1 MoFInjQnt_qMI1Cor MoFInjQnt_qPiI1Cor MoFInjQnt_qPiI2Cor MoFInjQnt_qPoI2Cor MoFRailP_p Mo_ctRst Mo_stICOMsg Mo_stMoC Mo_stMoF /end IN_MEASUREMENT
 /begin OUT_MEASUREMENT MoFQntCor_ctDebErr MoFQntCor_qMI1 MoFQntCor_qPiI1 MoFQntCor_qPoI2 /end OUT_MEASUREMENT
 /begin LOC_MEASUREMENT MoFQntCor_ctDiag MoFQntCor_qPiI1WvCor_mp MoFQntCor_qPoI2WvCor_mp MoFQntCor_qWvCor2_mp MoFQntCor_qWvCorMI1PiI1_mp MoFQntCor_qWvCorMI1PiI2_mp MoFQntCor_qWvCorMI1_mp MoFQntCor_qWvCorPiI1PiI2_mp MoFQntCor_rQMI1_mp MoFQntCor_stInj MoFQntCor_stIrvErr MoFQntCor_stMI1ErrAct_mp MoFQntCor_stPiI1ErrAct_mp MoFQntCor_stPoI2ErrAct_mp MoFQntCor_tiMI1PoI2Cor_mp MoFQntCor_tiPiI1MI1Cor_mp MoFQntCor_tiPiI2Hyd_mp /end LOC_MEASUREMENT
/end FUNCTION
/begin FUNCTION MoFRailP_Co ""
 /begin DEF_CHARACTERISTIC MoFRailP_ctMaxDebDef_C MoFRailP_ctMaxDebOK_C MoFRailP_ctMinDebDef_C MoFRailP_ctMinDebOK_C MoFRailP_pLin_CUR MoFRailP_pRailMax_C MoFRailP_tiPT1_C MoFRailP_uSRCMax_C MoFRailP_uSRCMin_C /end DEF_CHARACTERISTIC
 /begin IN_MEASUREMENT Mo_stMoC RailP_pFlt /end IN_MEASUREMENT
 /begin OUT_MEASUREMENT MoFRailP_ctMaxDebDef MoFRailP_ctMaxDebOK MoFRailP_ctMinDebDef MoFRailP_ctMinDebOK MoFRailP_p /end OUT_MEASUREMENT
 /begin LOC_MEASUREMENT MoFRailP_pFlt MoFRailP_stPlb_mp MoFRailP_stSRChighActDef_mp MoFRailP_stSRChighOK_mp MoFRailP_stSRClowActDef_mp MoFRailP_stSRClowOK_mp MoFRailP_uRaw_mp /end LOC_MEASUREMENT
/end FUNCTION
/begin FUNCTION MoFSpdG_Co "" /begin DEF_CHARACTERISTIC MoFSpdG_rTrqPtd_MAP /end DEF_CHARACTERISTIC /begin REF_CHARACTERISTIC Mo_trqIdcMax_C /end REF_CHARACTERISTIC /begin IN_MEASUREMENT MoFESpd_nEng MoFInjDat_trqSpdG MoFTEng_tEng Mo_stMoC /end IN_MEASUREMENT /begin OUT_MEASUREMENT MoFSpdG_rTrq MoFSpdG_stDem /end OUT_MEASUREMENT /begin LOC_MEASUREMENT MoFSpdG_trq_mp /end LOC_MEASUREMENT /end FUNCTION
/begin FUNCTION MoFSrv_Lib "" /end FUNCTION
/begin FUNCTION MoFTEng_Co ""
 /begin DEF_CHARACTERISTIC MoFTEng_nEngOff_C MoFTEng_nStrtEnd_C MoFTEng_tiMinTempIni_CUR MoFTEng_tiMinTempMax_C MoFTEng_tiMinTempMin_C MoFTEng_tMin_CUR /end DEF_CHARACTERISTIC
 /begin IN_MEASUREMENT EngDa_tEng MoFESpd_nEng MoFTrqAct_st Mo_stMoC /end IN_MEASUREMENT
 /begin OUT_MEASUREMENT MoFTEng_tEng MoFTEng_tiAftStrt /end OUT_MEASUREMENT
 /begin LOC_MEASUREMENT MoFTEng_tiMinTemp MoFTEng_tiMinTemp_mp /end LOC_MEASUREMENT
/end FUNCTION
/begin FUNCTION MoFTra_Co "" /begin IN_MEASUREMENT Com_stTrqGbxDes Gbx_trqTIIDes Mo_stMoC /end IN_MEASUREMENT /begin OUT_MEASUREMENT MoFTra_stDem MoFTra_stIrvErr MoFTra_trqDem /end OUT_MEASUREMENT /end FUNCTION
/begin FUNCTION MoFTrqCmp_Co "" /begin DEF_CHARACTERISTIC MoFTrqCmp_ctDeb_C MoFTrqCmp_ctRst_C /end DEF_CHARACTERISTIC
 /begin IN_MEASUREMENT MoFCoOfs_rTrqPtdOfs MoFTrqIdc_rTrq Mo_ctRst Mo_stICOMsg Mo_stMoC Mo_stMoF /end IN_MEASUREMENT
 /begin OUT_MEASUREMENT MoFTrqCmp_ctDeb MoFTrqCmp_stIrvErr /end OUT_MEASUREMENT
 /begin LOC_MEASUREMENT MoFTrqCmp_ctDiag MoFTrqCmp_stTst /end LOC_MEASUREMENT
/end FUNCTION
/begin FUNCTION MoFTrqIdc_Co "" /begin DEF_CHARACTERISTIC MoFTrqIdc_q2trq_MAP /end DEF_CHARACTERISTIC /begin REF_CHARACTERISTIC Mo_trqIdcMax_C /end REF_CHARACTERISTIC /begin IN_MEASUREMENT MoFESpd_nEng MoFMode_qSetUnBal Mo_stMoC /end IN_MEASUREMENT /begin OUT_MEASUREMENT MoFTrqAct_st MoFTrqIdc_rTrq /end OUT_MEASUREMENT /begin LOC_MEASUREMENT MoFTrqIdc_trqIdc_mp /end LOC_MEASUREMENT /end FUNCTION
/begin FUNCTION Mo_Glbl "" /begin DEF_CHARACTERISTIC Mo_trqIdcMax_C /end DEF_CHARACTERISTIC /begin OUT_MEASUREMENT Mo_ctRst Mo_stCplChk_mp Mo_stICOMsg Mo_stMoC Mo_stMoF /end OUT_MEASUREMENT
 /begin LOC_MEASUREMENT Mo_bCplChk Mo_bICOL1 Mo_bICOL2 Mo_bLimpHom Mo_bLowVltg Mo_bRamErr Mo_bRomErr /end LOC_MEASUREMENT
/end FUNCTION
/begin FUNCTION MRly_ShOff "" /end FUNCTION
/begin FUNCTION MRly_VD ""
 /begin DEF_CHARACTERISTIC MRly_ctErlyOpng_C MRly_tiBattVltgFlt_C MRly_tiStkRlyDiaDel_C MRly_tiVltgStblDel_C MRly_uStblThr_C MRly_uStkRlyBattThr_C /end DEF_CHARACTERISTIC
 /begin IN_MEASUREMENT BattU_u /end IN_MEASUREMENT
 /begin OUT_MEASUREMENT MRly_st MRly_stAct /end OUT_MEASUREMENT
 /begin LOC_MEASUREMENT MRly_ctErlyOpng_mp MRly_uBattFlt_mp /end LOC_MEASUREMENT
/end FUNCTION
/begin FUNCTION Msc "" /end FUNCTION
/begin FUNCTION OilPLmp_DD ""
 /begin DEF_CHARACTERISTIC OilPLmp_DigOut.tiBtwTstSCB_C OilPLmp_DigOut.tiBtwTstOT_C OilPLmp_DigOut.numTstMax_C OilPLmp_stPsDiaDisbl_C OilPLmp_stPsDisbl_C /end DEF_CHARACTERISTIC
 /begin IN_MEASUREMENT CoEng_stEng DevLib_stPwrStgEnaCond Epm_nEng Oil_stPSwmp VehV_a VehV_v /end IN_MEASUREMENT
 /begin OUT_MEASUREMENT OilPLmp_st /end OUT_MEASUREMENT
/end FUNCTION
/begin FUNCTION OilPLmp_VD ""
 /begin DEF_CHARACTERISTIC OilPLmp_aMin_C OilPLmp_nStrt1_C OilPLmp_nStrt2_C OilPLmp_swtStrt_C OilPLmp_tiDebABSPos_C OilPLmp_tiInactv1_C OilPLmp_tiInactv2_C OilPLmp_tiStrt_C OilPLmp_vMin_C /end DEF_CHARACTERISTIC
 /begin IN_MEASUREMENT CoEng_stEng Epm_nEng VehV_a VehV_v /end IN_MEASUREMENT
/end FUNCTION
/begin FUNCTION OilP_DD "" /begin DEF_CHARACTERISTIC Oil_DebP.tiHiLo_C Oil_DebP.tiLoHi_C /end DEF_CHARACTERISTIC /begin OUT_MEASUREMENT Oil_stRawPSwmp /end OUT_MEASUREMENT /end FUNCTION
/begin FUNCTION OilP_VD "" /begin IN_MEASUREMENT Epm_nEng Oil_stRawPSwmp /end IN_MEASUREMENT /begin OUT_MEASUREMENT Oil_stPSwmp /end OUT_MEASUREMENT /end FUNCTION
/begin COMPU_METHOD Acc "" RAT_FUNC "%6.5" "m/s^2" COEFFS 0 1000 0 0 0 1 /end COMPU_METHOD
/begin COMPU_METHOD AirMassPerCyl "" RAT_FUNC "%6.3" "mg/Hub" COEFFS 0 10 0 0 0 1 /end COMPU_METHOD
/begin COMPU_METHOD AirMassPerTime "" RAT_FUNC "%6.3" "Kg/h" COEFFS 0 10 0 0 0 1 /end COMPU_METHOD
/begin COMPU_METHOD AirMass_2 "" RAT_FUNC "%6.3" "g" COEFFS 0 10 0 0 0 1 /end COMPU_METHOD
/begin COMPU_METHOD Curr "" RAT_FUNC "%6.2" "mA" COEFFS 0 1 0 0 0 1 /end COMPU_METHOD
/begin COMPU_METHOD DtyCyc "" RAT_FUNC "%6.4" "%" COEFFS 0 100 0 0 0 1 /end COMPU_METHOD
/begin COMPU_METHOD EngN "" RAT_FUNC "%6.3" "rpm" COEFFS 0 2 0 0 0 1 /end COMPU_METHOD
/begin COMPU_METHOD Fact "" RAT_FUNC "%6.5" "-" COEFFS 0 8192 0 0 0 1 /end COMPU_METHOD
/begin COMPU_METHOD FanSpd "" RAT_FUNC "%6.3" "rpm" COEFFS 0 10.9223333333333 0 0 0 1 /end COMPU_METHOD
/begin COMPU_METHOD Fl_Half_L "" RAT_FUNC "%6.3" "l" COEFFS 0 2 0 0 0 1 /end COMPU_METHOD
/begin COMPU_METHOD InjMass "" RAT_FUNC "%6.4" "mg/hub" COEFFS 0 100 0 0 0 1 /end COMPU_METHOD
/begin COMPU_METHOD Kd "" RAT_FUNC "%7.6" "1/1" COEFFS 0 65536 0 0 0 1 /end COMPU_METHOD
/begin COMPU_METHOD Kd_Temp_Kelv2Dcyc "" RAT_FUNC "%8.7" "%/K" COEFFS 0 655360 0 0 0 1 /end COMPU_METHOD
/begin COMPU_METHOD Ki "" RAT_FUNC "%6.5" "1/s" COEFFS 0 2147.483648 0 0 0 1 /end COMPU_METHOD
/begin COMPU_METHOD Ki_curr2fact "" RAT_FUNC "%10.9" "1/mA*s" COEFFS 0 17592186.044416 0 0 0 1 /end COMPU_METHOD
/begin COMPU_METHOD Ki_Temp_Kelv2Dcyc "" RAT_FUNC "%7.6" "%/(K*s)" COEFFS 0 21474.83648 0 0 0 1 /end COMPU_METHOD
/begin COMPU_METHOD Kp_Temp_Kelv2Dcyc "" RAT_FUNC "%8.7" "%/K" COEFFS 0 327680 0 0 0 1 /end COMPU_METHOD
/begin COMPU_METHOD lambda "" RAT_FUNC "%6.5" "-" COEFFS 0 1000 0 0 0 1 /end COMPU_METHOD
/begin COMPU_METHOD lambdaRecVal "" RAT_FUNC "%6.5" "-" COEFFS 0 1000 0 0 0 1 /end COMPU_METHOD
/begin COMPU_METHOD Mo_fac_q0p000122 "" RAT_FUNC "%6.5" "1/1" COEFFS 0 8192 0 0 0 1 /end COMPU_METHOD
/begin COMPU_METHOD Mo_fac_q0p00098 "" RAT_FUNC "%6.5" "1/1" COEFFS 0 1024 0 0 0 1 /end COMPU_METHOD
/begin COMPU_METHOD Mo_fac_q0p00392 "" RAT_FUNC "%6.4" "1/1" COEFFS 0 255 0 0 0 1 /end COMPU_METHOD
/begin COMPU_METHOD Mo_fac_q0p0078125 "" RAT_FUNC "%6.4" "1/1" COEFFS 0 128 0 0 0 1 /end COMPU_METHOD
/begin COMPU_METHOD Mo_fac_q0p01 "" RAT_FUNC "%6.4" "1/1" COEFFS 0 100 0 0 0 1 /end COMPU_METHOD
/begin COMPU_METHOD Mo_fac_q0p04 "" RAT_FUNC "%6.4" "1/1" COEFFS 0 25 0 0 0 1 /end COMPU_METHOD
/begin COMPU_METHOD Mo_n_rpm_q0p15625 "" RAT_FUNC "%6.3" "rpm" COEFFS 0 256 0 0 0 40 /end COMPU_METHOD
/begin COMPU_METHOD Mo_n_rpm_q40p0 "" RAT_FUNC "%6.1" "rpm" COEFFS 0 1 0 0 0 40 /end COMPU_METHOD
/begin COMPU_METHOD Mo_phi_degCrS_q0p02197 "" RAT_FUNC "%6.4" "deg CrS" COEFFS 0 16383 0 0 0 360 /end COMPU_METHOD
/begin COMPU_METHOD Mo_p_bar_q0p0311284 "" RAT_FUNC "%5.4" "bar" COEFFS 0 10000000.000000 0 0 0 311284 /end COMPU_METHOD
/begin COMPU_METHOD Mo_p_bar_q8p0000 "" RAT_FUNC "%4.3" "bar" COEFFS 0 1000.000000 0 0 0 8000 /end COMPU_METHOD
/begin COMPU_METHOD Mo_q_mg_q0p01 "" RAT_FUNC "%6.4" "mg" COEFFS 0 100 0 0 0 1 /end COMPU_METHOD
/begin COMPU_METHOD Mo_rho_mgpmm3_q0p1 "" RAT_FUNC "%6.3" "mg/mm3" COEFFS 0 10 0 0 0 1 /end COMPU_METHOD
/begin COMPU_METHOD Mo_r_prc_q0p00152 "" RAT_FUNC "%6.4" "%" COEFFS 0 65536 0 0 0 100 /end COMPU_METHOD
/begin COMPU_METHOD Mo_r_prc_q0p39 "" RAT_FUNC "%6.3" "%" COEFFS 0 256 0 0 0 100 /end COMPU_METHOD
/begin COMPU_METHOD Mo_ti10ms_ms_q10p0 "" RAT_FUNC "%6.1" "ms" COEFFS 0 1 0 0 0 10 /end COMPU_METHOD
/begin COMPU_METHOD Mo_ti20ms_s_q0p02 "" RAT_FUNC "%6.4" "s" COEFFS 0 1 0 0 0 0.02 /end COMPU_METHOD
/begin COMPU_METHOD Mo_ti40ms_ms_q40p0 "" RAT_FUNC "%6.1" "ms" COEFFS 0 1 0 0 0 40 /end COMPU_METHOD
/begin COMPU_METHOD Mo_ti40ms_s_q5p12 "" RAT_FUNC "%6.2" "s" COEFFS 0 1000 0 0 0 5120 /end COMPU_METHOD
/begin COMPU_METHOD Mo_tiRec40ms_ms_b10240 "" RAT_FUNC "%6.1" "ms" COEFFS 0 0 10240 0 1 0 /end COMPU_METHOD
/begin COMPU_METHOD Mo_ti_s_q0p04 "" RAT_FUNC "%6.4" "s" COEFFS 0 25 0 0 0 1 /end COMPU_METHOD
/begin COMPU_METHOD Mo_ti_us_q0p4 "" RAT_FUNC "%6.3" "us" COEFFS 0 1000 0 0 0 400 /end COMPU_METHOD
/begin COMPU_METHOD Mo_trq_nm_q0p00000152587890625 "" RAT_FUNC "%8.7" "Nm" COEFFS 0 655360 0 0 0 1 /end COMPU_METHOD
/begin COMPU_METHOD Mo_trq_nm_q0p1 "" RAT_FUNC "%6.3" "Nm" COEFFS 0 10 0 0 0 1 /end COMPU_METHOD
/begin COMPU_METHOD Mo_trq_nm_q1p6 "" RAT_FUNC "%6.2" "Nm" COEFFS 0 10 0 0 0 16 /end COMPU_METHOD
/begin COMPU_METHOD Mo_t_DegC_q0p8o48 "" RAT_FUNC "%6.2" "deg C" COEFFS 0 5 240 0 0 4 /end COMPU_METHOD
/begin COMPU_METHOD Mo_u_mV_q19p53 "" RAT_FUNC "%6.1" "mV" COEFFS 0 256 0 0 0 5000 /end COMPU_METHOD
/begin COMPU_METHOD Mo_u_mV_q4p88 "" RAT_FUNC "%6.2" "mV" COEFFS 0 1024 0 0 0 5000 /end COMPU_METHOD
/begin COMPU_METHOD Mo_u_mV_q9p77 "" RAT_FUNC "%6.2" "mV" COEFFS 0 256 0 0 0 2500 /end COMPU_METHOD
/begin COMPU_METHOD Mo_vol_mm3_q0p01 "" RAT_FUNC "%6.4" "mm3" COEFFS 0 100 0 0 0 1 /end COMPU_METHOD
/begin COMPU_METHOD Mo_v_kmh_q0p01 "" RAT_FUNC "%6.4" "km/h" COEFFS 0 100 0 0 0 1 /end COMPU_METHOD
/begin COMPU_METHOD O2 "" RAT_FUNC "%8.7" "-" COEFFS 0 100000 0 0 0 1 /end COMPU_METHOD
/begin COMPU_METHOD OneToOne "" RAT_FUNC "%6.2" "-" COEFFS 0 1 0 0 0 1 /end COMPU_METHOD
/begin COMPU_METHOD OneToOne_rpm "" RAT_FUNC "%6.2" "rpm" COEFFS 0 1 0 0 0 1 /end COMPU_METHOD
/begin COMPU_METHOD Period "" RAT_FUNC "%6.3" "ms" COEFFS 0 10 0 0 0 1 /end COMPU_METHOD
/begin COMPU_METHOD PosMCKd_4 "" RAT_FUNC "%7.6" "%/AgCA" COEFFS 0 36001.0986663412 0 0 0 1 /end COMPU_METHOD
/begin COMPU_METHOD PosMCKi "" RAT_FUNC "%6.5" "%/(AgCA*s)" COEFFS 0 4718.73600439467 0 0 0 1 /end COMPU_METHOD
/begin COMPU_METHOD PosMCKi_2 "" RAT_FUNC "%6.5" "%/(AgCA*s)" COEFFS 0 2359.36800219733 0 0 0 1 /end COMPU_METHOD
/begin COMPU_METHOD PosMCKp "" RAT_FUNC "%7.6" "%/AgCA" COEFFS 0 72002.1973326823 0 0 0 1 /end COMPU_METHOD
/begin COMPU_METHOD PosMCKp_32 "" RAT_FUNC "%6.5" "%/AgCA" COEFFS 0 2250.06866664632 0 0 0 1 /end COMPU_METHOD
/begin COMPU_METHOD POSTDRV_SOFTRST_SY_Compu "" TAB_VERB "%6.3" "-" COMPU_TAB_REF POSTDRV_SOFTRST_SY_Compu /end COMPU_METHOD
/begin COMPU_VTAB POSTDRV_SOFTRST_SY_Compu "" TAB_VERB 2 0 "False" 0 "True" /end COMPU_VTAB
/begin COMPU_METHOD POSTDRV_T15RST_SY_Compu "" TAB_VERB "%6.3" "-" COMPU_TAB_REF POSTDRV_T15RST_SY_Compu /end COMPU_METHOD
/begin COMPU_VTAB POSTDRV_T15RST_SY_Compu "" TAB_VERB 2 0 "False" 1 "True" /end COMPU_VTAB
/begin COMPU_METHOD Prc "" RAT_FUNC "%6.4" "%" COEFFS 0 81.92 0 0 0 1 /end COMPU_METHOD
/begin COMPU_METHOD Pres_hPa "" RAT_FUNC "%6.2" "hPa" COEFFS 0 1 0 0 0 1 /end COMPU_METHOD
/begin COMPU_METHOD Pres_Rail "" RAT_FUNC "%4.3" "bar" COEFFS 0 10.000000 0 0 0 1 /end COMPU_METHOD
/begin COMPU_METHOD Qp_mm3_sec "" RAT_FUNC "%6.1" "mm3/s" COEFFS 0 0.1 0 0 0 1 /end COMPU_METHOD
/begin COMPU_METHOD Resist_1 "" RAT_FUNC "%6.2" "mOhm" COEFFS 0 1 0 0 0 1 /end COMPU_METHOD
/begin COMPU_METHOD RmpDtyCyc "" RAT_FUNC "%6.5" "%/s" COEFFS 0 6553.6 0 0 0 1 /end COMPU_METHOD
/begin COMPU_METHOD TempDiff_Kelv "" RAT_FUNC "%6.3" "K" COEFFS 0 10 0 0 0 1 /end COMPU_METHOD
/begin COMPU_METHOD Temp_Cels "" RAT_FUNC "%6.1" "deg C" COEFFS 0 10 2731.4 0 0 1 /end COMPU_METHOD
/begin COMPU_METHOD TimeDeb "" RAT_FUNC "%6.1" "ms" COEFFS 0 0.1 0 0 0 1 /end COMPU_METHOD
/begin COMPU_METHOD TimeDelay_s "" RAT_FUNC "%12.4" "s" COEFFS 0 0 1 0 0.00023283064365387 0 /end COMPU_METHOD
/begin COMPU_METHOD Time_ms "" RAT_FUNC "%6.1" "ms" COEFFS 0 0.1 0 0 0 1 /end COMPU_METHOD
/begin COMPU_METHOD Time_s "" RAT_FUNC "%6.4" "s" COEFFS 0 100 0 0 0 1 /end COMPU_METHOD
/begin COMPU_METHOD Trq "" RAT_FUNC "%6.3" "Nm" COEFFS 0 10 0 0 0 1 /end COMPU_METHOD
/begin COMPU_METHOD Vel "" RAT_FUNC "%6.4" "km/h" COEFFS 0 100 0 0 0 1 /end COMPU_METHOD
/begin COMPU_METHOD Volt "" RAT_FUNC "%6.3" "mV" COEFFS 0 5 0 0 0 1 /end COMPU_METHOD
/begin COMPU_METHOD Volt_Batt "" RAT_FUNC "%6.1" "mV" COEFFS 0 0.05 0 0 0 1 /end COMPU_METHOD
/begin RECORD_LAYOUT Cur_Xs16Ws16 NO_AXIS_PTS_X 1 SWORD AXIS_PTS_X 2 SWORD INDEX_INCR DIRECT FNC_VALUES 3 SWORD COLUMN_DIR DIRECT /end RECORD_LAYOUT
/begin RECORD_LAYOUT Cur_Xu8Wu8 NO_AXIS_PTS_X 1 UBYTE AXIS_PTS_X 2 UBYTE INDEX_INCR DIRECT FNC_VALUES 3 UBYTE COLUMN_DIR DIRECT /end RECORD_LAYOUT
/begin RECORD_LAYOUT Kw_Ws16 FNC_VALUES 1 SWORD COLUMN_DIR DIRECT /end RECORD_LAYOUT
/begin RECORD_LAYOUT Kw_Wu16 FNC_VALUES 1 UWORD COLUMN_DIR DIRECT /end RECORD_LAYOUT
/begin RECORD_LAYOUT Kw_Wu8 FNC_VALUES 1 UBYTE COLUMN_DIR DIRECT /end RECORD_LAYOUT
/begin RECORD_LAYOUT Map_Xs16Ys16Ws16 NO_AXIS_PTS_X 1 SWORD NO_AXIS_PTS_Y 2 SWORD AXIS_PTS_X 3 SWORD INDEX_INCR DIRECT AXIS_PTS_Y 4 SWORD INDEX_INCR DIRECT FNC_VALUES 5 SWORD COLUMN_DIR DIRECT /end RECORD_LAYOUT
/begin RECORD_LAYOUT Map_Xu8Yu8Wu8 NO_AXIS_PTS_X 1 UBYTE NO_AXIS_PTS_Y 2 UBYTE AXIS_PTS_X 3 UBYTE INDEX_INCR DIRECT AXIS_PTS_Y 4 UBYTE INDEX_INCR DIRECT FNC_VALUES 5 UBYTE COLUMN_DIR DIRECT /end RECORD_LAYOUT
/begin RECORD_LAYOUT ValA_Ws16 FNC_VALUES 1 SWORD COLUMN_DIR DIRECT /end RECORD_LAYOUT
/begin RECORD_LAYOUT ValA_Wu16 FNC_VALUES 1 UWORD COLUMN_DIR DIRECT /end RECORD_LAYOUT
/begin RECORD_LAYOUT ValA_Wu8 FNC_VALUES 1 UBYTE COLUMN_DIR DIRECT /end RECORD_LAYOUT
/begin RECORD_LAYOUT Val_Ws16 FNC_VALUES 1 SWORD COLUMN_DIR DIRECT /end RECORD_LAYOUT
/begin RECORD_LAYOUT Val_Ws32 FNC_VALUES 1 SLONG COLUMN_DIR DIRECT /end RECORD_LAYOUT
/begin RECORD_LAYOUT Val_Wu16 FNC_VALUES 1 UWORD COLUMN_DIR DIRECT /end RECORD_LAYOUT
/begin RECORD_LAYOUT Val_Wu32 FNC_VALUES 1 ULONG COLUMN_DIR DIRECT /end RECORD_LAYOUT
/begin RECORD_LAYOUT Val_Wu8 FNC_VALUES 1 UBYTE COLUMN_DIR DIRECT /end RECORD_LAYOUT
/end MODULE
/end PROJECT
