ASAP2_VERSION 1 41
/begin PROJECT MSD85 "Spray Guided DI-System with Piezo Injectors for 8-Cylinder"
/begin HEADER "_default_HeaderComment" PROJECT_NO _91 /end HEADER
/begin MODULE _default_ModuleName "_default_ModuleLongIdentifier"
/begin MOD_COMMON "_default_ModCommonComment" DEPOSIT ABSOLUTE BYTE_ORDER MSB_LAST ALIGNMENT_BYTE 1 ALIGNMENT_WORD 2 ALIGNMENT_LONG 2 ALIGNMENT_FLOAT32_IEEE 2 ALIGNMENT_FLOAT64_IEEE 4 /end MOD_COMMON
/begin MEASUREMENT lv_inh_wup_cyc "Warm-up cycles calculation inhibition" UBYTE _CNV_S_2_RANGE__0___1_CM 1 100. 0. 1. DISPLAY_IDENTIFIER LV_INH_WUP_CYC ECU_ADDRESS 0xd0008143 /end MEASUREMENT
/begin MEASUREMENT tco_st_dsl_cmn "Coolant temperature at start (only used in ERRM for GS-DS diversity)" UBYTE _CNV_A_R_LINEAR_____17_CM 1 100. -48. 142.5 DISPLAY_IDENTIFIER TCO_ST_DSL_CMN ECU_ADDRESS 0xd000813e FORMAT "%6.2" /end MEASUREMENT
/begin MEASUREMENT tco_dsl_cmn "Coolant temperature (only used in ERRM for GS-DS diversity)" UBYTE _CNV_A_R_LINEAR_____17_CM 1 100. -48. 142.5 DISPLAY_IDENTIFIER TCO_DSL_CMN ECU_ADDRESS 0xd000813d FORMAT "%6.2" /end MEASUREMENT
/begin AXIS_PTS ldpm_fmy_envd "" 0xa080294e errm_online_dummy _REC_AXS_20_u1 255. _CNV_A_R_LINEAR_____0_CM 4 0. 255. FORMAT "%3.0" /end AXIS_PTS
/begin MEASUREMENT t_act_mil "Minutes run by the engine while MIL activated" UWORD _CNV_A_R_LINEAR_____84_CM 1 100. 0. 65535. DISPLAY_IDENTIFIER T_ACT_MIL ECU_ADDRESS 0xd0009ffe FORMAT "%5.0" /end MEASUREMENT
/begin MEASUREMENT dist_act_mil "Global distance traveled while the MIL is illuminated" UWORD _CNV_A_R_LINEAR_____52_CM 1 100. 0. 65535. DISPLAY_IDENTIFIER DIST_ACT_MIL ECU_ADDRESS 0xd0009fe0 FORMAT "%5.0" /end MEASUREMENT
/begin MEASUREMENT dist_dtc_clr "Distance since DTC cleared up to 65535 Kms max" UWORD _CNV_A_R_LINEAR_____52_CM 1 100. 0. 65535. DISPLAY_IDENTIFIER DIST_DTC_CLR ECU_ADDRESS 0xd0009fe2 FORMAT "%5.0" /end MEASUREMENT
/begin MEASUREMENT dist_rel_dtc_clr "Distance at event DTC cleared up to 65535 Kms max" ULONG _CNV_A_R_LINEAR_____52_CM 1 100. 0. 4294967295. DISPLAY_IDENTIFIER DIST_REL_DTC_CLR ECU_ADDRESS 0xd0002790 FORMAT "%11.1" /end MEASUREMENT
/begin MEASUREMENT ctr_wup_dtc_clr "Number of WUP since DTC cleared" UBYTE _CNV_A_R_LINEAR_____0_CM 1 100. 0. 255. DISPLAY_IDENTIFIER CTR_WUP_DTC_CLR ECU_ADDRESS 0xd00080ce FORMAT "%3.0" /end MEASUREMENT
/begin MEASUREMENT state_ena_obd "Monitor enable status for the current DC" UWORD _CNV_A_R_LINEAR_____0_CM 1 100. 0. 65535. DISPLAY_IDENTIFIER STATE_ENA_OBD ECU_ADDRESS 0xd0009ffc FORMAT "%5.0" /end MEASUREMENT
/begin MEASUREMENT state_cmpl_obd "Monitor completion status for the current DC" UWORD _CNV_A_R_LINEAR_____0_CM 1 100. 0. 65535. DISPLAY_IDENTIFIER STATE_CMPL_OBD ECU_ADDRESS 0xd0009ffa FORMAT "%5.0" /end MEASUREMENT
/begin MEASUREMENT t_dtc_clr "Time since DTC cleared" UWORD _CNV_A_R_LINEAR_____84_CM 1 100. 0. 65535. DISPLAY_IDENTIFIER T_DTC_CLR ECU_ADDRESS 0xd000a000 FORMAT "%5.0" /end MEASUREMENT
/begin MEASUREMENT t_act_mil_60 "Seconds run by the engine while MIL activated" UBYTE _CNV_A_R_LINEAR_____36_CM 1 100. 0. 60. DISPLAY_IDENTIFIER T_ACT_MIL_60 ECU_ADDRESS 0xd0002797 FORMAT "%3.0" /end MEASUREMENT
/begin CHARACTERISTIC fmy_id_bn_msw.envd "Freeze frame FRF_CUS_SET_SPC: environmental data contents for failure XX" CURVE 0xa0802be0 _REC_CUR_20_u1_u1 254. _CNV_A_R_LINEAR_____0_CM 1. 255. DISPLAY_IDENTIFIER ID_ERR_ENVD_BN_MSW FORMAT "%3.0"
 /begin AXIS_DESCR COM_AXIS errm_online_dummy _CNV_A_R_LINEAR_____0_CM 4 0. 255. FORMAT "%3.0" AXIS_PTS_REF ldpm_fmy_envd /end AXIS_DESCR
/end CHARACTERISTIC
/begin CHARACTERISTIC fmy_id_bn_ang_pste.envd "Freeze frame FRF_CUS_SET_SPC: environmental data contents for failure XX" CURVE 0xa0802aa0 _REC_CUR_20_u1_u1 254. _CNV_A_R_LINEAR_____0_CM 1. 255. DISPLAY_IDENTIFIER ID_ERR_ENVD_BN_ANG_PSTE FORMAT "%3.0"
 /begin AXIS_DESCR COM_AXIS errm_online_dummy _CNV_A_R_LINEAR_____0_CM 4 0. 255. FORMAT "%3.0" AXIS_PTS_REF ldpm_fmy_envd /end AXIS_DESCR
/end CHARACTERISTIC
/begin CHARACTERISTIC fmy_id_bn_gear_rev.envd "Freeze frame FRF_CUS_SET_SPC: environmental data contents for failure XX" CURVE 0xa0802b68 _REC_CUR_20_u1_u1 254. _CNV_A_R_LINEAR_____0_CM 1. 255. DISPLAY_IDENTIFIER ID_ERR_ENVD_BN_GEAR_REV FORMAT "%3.0"
 /begin AXIS_DESCR COM_AXIS errm_online_dummy _CNV_A_R_LINEAR_____0_CM 4 0. 255. FORMAT "%3.0" AXIS_PTS_REF ldpm_fmy_envd /end AXIS_DESCR
/end CHARACTERISTIC
/begin CHARACTERISTIC fmy_id_bn_ltg_hdlp_l.envd "Freeze frame FRF_CUS_SET_SPC: environmental data contents for failure XX" CURVE 0xa0802bcc _REC_CUR_20_u1_u1 254. _CNV_A_R_LINEAR_____0_CM 1. 255. DISPLAY_IDENTIFIER ID_ERR_ENVD_BN_LTG_HDLP_L FORMAT "%3.0"
 /begin AXIS_DESCR COM_AXIS errm_online_dummy _CNV_A_R_LINEAR_____0_CM 4 0. 255. FORMAT "%3.0" AXIS_PTS_REF ldpm_fmy_envd /end AXIS_DESCR
/end CHARACTERISTIC
/begin CHARACTERISTIC fmy_id_bn_ldm.envd "Freeze frame FRF_CUS_SET_SPC: environmental data contents for failure XX" CURVE 0xa0802bb8 _REC_CUR_20_u1_u1 254. _CNV_A_R_LINEAR_____0_CM 1. 255. DISPLAY_IDENTIFIER ID_ERR_ENVD_BN_LDM FORMAT "%3.0"
 /begin AXIS_DESCR COM_AXIS errm_online_dummy _CNV_A_R_LINEAR_____0_CM 4 0. 255. FORMAT "%3.0" AXIS_PTS_REF ldpm_fmy_envd /end AXIS_DESCR
/end CHARACTERISTIC
/begin CHARACTERISTIC fmy_id_bn_trl.envd "Freeze frame FRF_CUS_SET_SPC: environmental data contents for failure XX" CURVE 0xa0802cf8 _REC_CUR_20_u1_u1 254. _CNV_A_R_LINEAR_____0_CM 1. 255. DISPLAY_IDENTIFIER ID_ERR_ENVD_BN_TRL FORMAT "%3.0"
 /begin AXIS_DESCR COM_AXIS errm_online_dummy _CNV_A_R_LINEAR_____0_CM 4 0. 255. FORMAT "%3.0" AXIS_PTS_REF ldpm_fmy_envd /end AXIS_DESCR
/end CHARACTERISTIC
/begin CHARACTERISTIC fmy_id_bn_hiv.envd "Freeze frame FRF_CUS_SET_SPC: environmental data contents for failure XX" CURVE 0xa0802b7c _REC_CUR_20_u1_u1 254. _CNV_A_R_LINEAR_____0_CM 1. 255. DISPLAY_IDENTIFIER ID_ERR_ENVD_BN_HIV FORMAT "%3.0"
 /begin AXIS_DESCR COM_AXIS errm_online_dummy _CNV_A_R_LINEAR_____0_CM 4 0. 255. FORMAT "%3.0" AXIS_PTS_REF ldpm_fmy_envd /end AXIS_DESCR
/end CHARACTERISTIC
/begin CHARACTERISTIC fmy_id_bn_t_clk.envd "Freeze frame FRF_CUS_SET_SPC: environmental data contents for failure XX" CURVE 0xa0802c44 _REC_CUR_20_u1_u1 254. _CNV_A_R_LINEAR_____0_CM 1. 255. DISPLAY_IDENTIFIER ID_ERR_ENVD_BN_T_CLK FORMAT "%3.0"
 /begin AXIS_DESCR COM_AXIS errm_online_dummy _CNV_A_R_LINEAR_____0_CM 4 0. 255. FORMAT "%3.0" AXIS_PTS_REF ldpm_fmy_envd /end AXIS_DESCR
/end CHARACTERISTIC
/begin CHARACTERISTIC fmy_id_bn_efp_crash.envd "Freeze frame FRF_CUS_SET_SPC: environmental data contents for failure XX" CURVE 0xa0802b04 _REC_CUR_20_u1_u1 254. _CNV_A_R_LINEAR_____0_CM 1. 255. DISPLAY_IDENTIFIER ID_ERR_ENVD_BN_EFP_CRASH FORMAT "%3.0"
 /begin AXIS_DESCR COM_AXIS errm_online_dummy _CNV_A_R_LINEAR_____0_CM 4 0. 255. FORMAT "%3.0" AXIS_PTS_REF ldpm_fmy_envd /end AXIS_DESCR
/end CHARACTERISTIC
/begin CHARACTERISTIC fmy_id_bn_cdn_door.envd "Freeze frame FRF_CUS_SET_SPC: environmental data contents for failure XX" CURVE 0xa0802adc _REC_CUR_20_u1_u1 254. _CNV_A_R_LINEAR_____0_CM 1. 255. DISPLAY_IDENTIFIER ID_ERR_ENVD_BN_CDN_DOOR FORMAT "%3.0"
 /begin AXIS_DESCR COM_AXIS errm_online_dummy _CNV_A_R_LINEAR_____0_CM 4 0. 255. FORMAT "%3.0" AXIS_PTS_REF ldpm_fmy_envd /end AXIS_DESCR
/end CHARACTERISTIC
/begin CHARACTERISTIC fmy_id_bn_req_pbr.envd "Freeze frame FRF_CUS_SET_SPC: environmental data contents for failure XX" CURVE 0xa0802c30 _REC_CUR_20_u1_u1 254. _CNV_A_R_LINEAR_____0_CM 1. 255. DISPLAY_IDENTIFIER ID_ERR_ENVD_BN_REQ_PBR FORMAT "%3.0"
 /begin AXIS_DESCR COM_AXIS errm_online_dummy _CNV_A_R_LINEAR_____0_CM 4 0. 255. FORMAT "%3.0" AXIS_PTS_REF ldpm_fmy_envd /end AXIS_DESCR
/end CHARACTERISTIC
/begin CHARACTERISTIC fmy_id_bn_pbr.envd "Freeze frame FRF_CUS_SET_SPC: environmental data contents for failure XX" CURVE 0xa0802bf4 _REC_CUR_20_u1_u1 254. _CNV_A_R_LINEAR_____0_CM 1. 255. DISPLAY_IDENTIFIER ID_ERR_ENVD_BN_PBR FORMAT "%3.0"
 /begin AXIS_DESCR COM_AXIS errm_online_dummy _CNV_A_R_LINEAR_____0_CM 4 0. 255. FORMAT "%3.0" AXIS_PTS_REF ldpm_fmy_envd /end AXIS_DESCR
/end CHARACTERISTIC
/begin CHARACTERISTIC fmy_id_bn_efp.envd "Freeze frame FRF_CUS_SET_SPC: environmental data contents for failure XX" CURVE 0xa0802af0 _REC_CUR_20_u1_u1 254. _CNV_A_R_LINEAR_____0_CM 1. 255. DISPLAY_IDENTIFIER ID_ERR_ENVD_BN_EFP FORMAT "%3.0"
 /begin AXIS_DESCR COM_AXIS errm_online_dummy _CNV_A_R_LINEAR_____0_CM 4 0. 255. FORMAT "%3.0" AXIS_PTS_REF ldpm_fmy_envd /end AXIS_DESCR
/end CHARACTERISTIC
/begin CHARACTERISTIC fmy_id_load_tps_plaus.envd "Freeze frame FRF_CUS_SET_SPC: environmental data contents for failure XX" CURVE 0xa0803d9c _REC_CUR_20_u1_u1 254. _CNV_A_R_LINEAR_____0_CM 1. 255. DISPLAY_IDENTIFIER ID_ERR_ENVD_LOAD_TPS_PLAUS FORMAT "%3.0"
 /begin AXIS_DESCR COM_AXIS errm_online_dummy _CNV_A_R_LINEAR_____0_CM 4 0. 255. FORMAT "%3.0" AXIS_PTS_REF ldpm_fmy_envd /end AXIS_DESCR
/end CHARACTERISTIC
/begin CHARACTERISTIC fmy_id_egy_min.envd "Freeze frame FRF_CUS_SET_SPC: environmental data contents for failure XX" CURVE 0xa080366c _REC_CUR_20_u1_u1 254. _CNV_A_R_LINEAR_____0_CM 1. 255. DISPLAY_IDENTIFIER ID_ERR_ENVD_EGY_MIN FORMAT "%3.0"
 /begin AXIS_DESCR COM_AXIS errm_online_dummy _CNV_A_R_LINEAR_____0_CM 4 0. 255. FORMAT "%3.0" AXIS_PTS_REF ldpm_fmy_envd /end AXIS_DESCR
/end CHARACTERISTIC
/begin CHARACTERISTIC fmy_id_locan_boff.envd "Freeze frame FRF_CUS_SET_SPC: environmental data contents for failure XX" CURVE 0xa0803db0 _REC_CUR_20_u1_u1 254. _CNV_A_R_LINEAR_____0_CM 1. 255. DISPLAY_IDENTIFIER ID_ERR_ENVD_LOCAN_BOFF FORMAT "%3.0"
 /begin AXIS_DESCR COM_AXIS errm_online_dummy _CNV_A_R_LINEAR_____0_CM 4 0. 255. FORMAT "%3.0" AXIS_PTS_REF ldpm_fmy_envd /end AXIS_DESCR
/end CHARACTERISTIC
/begin CHARACTERISTIC fmy_id_cwp_plaus.envd "Freeze frame FRF_CUS_SET_SPC: environmental data contents for failure XX" CURVE 0xa08032d4 _REC_CUR_20_u1_u1 254. _CNV_A_R_LINEAR_____0_CM 1. 255. DISPLAY_IDENTIFIER ID_ERR_ENVD_CWP_PLAUS FORMAT "%3.0"
 /begin AXIS_DESCR COM_AXIS errm_online_dummy _CNV_A_R_LINEAR_____0_CM 4 0. 255. FORMAT "%3.0" AXIS_PTS_REF ldpm_fmy_envd /end AXIS_DESCR
/end CHARACTERISTIC
/begin CHARACTERISTIC fmy_id_cwp_int_off.envd "Freeze frame FRF_CUS_SET_SPC: environmental data contents for failure XX" CURVE 0xa08032c0 _REC_CUR_20_u1_u1 254. _CNV_A_R_LINEAR_____0_CM 1. 255. DISPLAY_IDENTIFIER ID_ERR_ENVD_CWP_INT_OFF FORMAT "%3.0"
 /begin AXIS_DESCR COM_AXIS errm_online_dummy _CNV_A_R_LINEAR_____0_CM 4 0. 255. FORMAT "%3.0" AXIS_PTS_REF ldpm_fmy_envd /end AXIS_DESCR
/end CHARACTERISTIC
/begin CHARACTERISTIC fmy_id_cwp_pwr.envd "Freeze frame FRF_CUS_SET_SPC: environmental data contents for failure XX" CURVE 0xa08032e8 _REC_CUR_20_u1_u1 254. _CNV_A_R_LINEAR_____0_CM 1. 255. DISPLAY_IDENTIFIER ID_ERR_ENVD_CWP_PWR FORMAT "%3.0"
 /begin AXIS_DESCR COM_AXIS errm_online_dummy _CNV_A_R_LINEAR_____0_CM 4 0. 255. FORMAT "%3.0" AXIS_PTS_REF ldpm_fmy_envd /end AXIS_DESCR
/end CHARACTERISTIC
/begin CHARACTERISTIC fmy_id_cwp_com_plaus.envd "Freeze frame FRF_CUS_SET_SPC: environmental data contents for failure XX" CURVE 0xa08032ac _REC_CUR_20_u1_u1 254. _CNV_A_R_LINEAR_____0_CM 1. 255. DISPLAY_IDENTIFIER ID_ERR_ENVD_CWP_COM_PLAUS FORMAT "%3.0"
 /begin AXIS_DESCR COM_AXIS errm_online_dummy _CNV_A_R_LINEAR_____0_CM 4 0. 255. FORMAT "%3.0" AXIS_PTS_REF ldpm_fmy_envd /end AXIS_DESCR
/end CHARACTERISTIC
/begin CHARACTERISTIC fmy_id_qoil_sens.envd "Freeze frame FRF_CUS_SET_SPC: environmental data contents for failure XX" CURVE 0xa08044a4 _REC_CUR_20_u1_u1 254. _CNV_A_R_LINEAR_____0_CM 1. 255. DISPLAY_IDENTIFIER ID_ERR_ENVD_QOIL_SENS FORMAT "%3.0"
 /begin AXIS_DESCR COM_AXIS errm_online_dummy _CNV_A_R_LINEAR_____0_CM 4 0. 255. FORMAT "%3.0" AXIS_PTS_REF ldpm_fmy_envd /end AXIS_DESCR
/end CHARACTERISTIC
/begin CHARACTERISTIC fmy_id_bat_sens.envd "Freeze frame FRF_CUS_SET_SPC: environmental data contents for failure XX" CURVE 0xa0802a50 _REC_CUR_20_u1_u1 254. _CNV_A_R_LINEAR_____0_CM 1. 255. DISPLAY_IDENTIFIER ID_ERR_ENVD_BAT_SENS FORMAT "%3.0"
 /begin AXIS_DESCR COM_AXIS errm_online_dummy _CNV_A_R_LINEAR_____0_CM 4 0. 255. FORMAT "%3.0" AXIS_PTS_REF ldpm_fmy_envd /end AXIS_DESCR
/end CHARACTERISTIC
/begin CHARACTERISTIC fmy_id_bat_sens_it.envd "Freeze frame FRF_CUS_SET_SPC: environmental data contents for failure XX" CURVE 0xa0802a64 _REC_CUR_20_u1_u1 254. _CNV_A_R_LINEAR_____0_CM 1. 255. DISPLAY_IDENTIFIER ID_ERR_ENVD_BAT_SENS_IT FORMAT "%3.0"
 /begin AXIS_DESCR COM_AXIS errm_online_dummy _CNV_A_R_LINEAR_____0_CM 4 0. 255. FORMAT "%3.0" AXIS_PTS_REF ldpm_fmy_envd /end AXIS_DESCR
/end CHARACTERISTIC
/begin CHARACTERISTIC fmy_id_bat_sens_it_el.envd "Freeze frame FRF_CUS_SET_SPC: environmental data contents for failure XX" CURVE 0xa0802a78 _REC_CUR_20_u1_u1 254. _CNV_A_R_LINEAR_____0_CM 1. 255. DISPLAY_IDENTIFIER ID_ERR_ENVD_BAT_SENS_IT_EL FORMAT "%3.0"
 /begin AXIS_DESCR COM_AXIS errm_online_dummy _CNV_A_R_LINEAR_____0_CM 4 0. 255. FORMAT "%3.0" AXIS_PTS_REF ldpm_fmy_envd /end AXIS_DESCR
/end CHARACTERISTIC
/begin CHARACTERISTIC fmy_id_ecu_nvmy.envd "Freeze frame FRF_CUS_SET_SPC: environmental data contents for failure XX" CURVE 0xa080361c _REC_CUR_20_u1_u1 254. _CNV_A_R_LINEAR_____0_CM 1. 255. DISPLAY_IDENTIFIER ID_ERR_ENVD_ECU_NVMY FORMAT "%3.0"
 /begin AXIS_DESCR COM_AXIS errm_online_dummy _CNV_A_R_LINEAR_____0_CM 4 0. 255. FORMAT "%3.0" AXIS_PTS_REF ldpm_fmy_envd /end AXIS_DESCR
/end CHARACTERISTIC
/begin CHARACTERISTIC fmy_id_gs.envd "Freeze frame FRF_CUS_SET_SPC: environmental data contents for failure XX" CURVE 0xa080393c _REC_CUR_20_u1_u1 254. _CNV_A_R_LINEAR_____0_CM 1. 255. DISPLAY_IDENTIFIER ID_ERR_ENVD_GS FORMAT "%3.0"
 /begin AXIS_DESCR COM_AXIS errm_online_dummy _CNV_A_R_LINEAR_____0_CM 4 0. 255. FORMAT "%3.0" AXIS_PTS_REF ldpm_fmy_envd /end AXIS_DESCR
/end CHARACTERISTIC
/begin CHARACTERISTIC fmy_id_plaus_igk_bn.envd "Freeze frame FRF_CUS_SET_SPC: environmental data contents for failure XX" CURVE 0xa0804328 _REC_CUR_20_u1_u1 254. _CNV_A_R_LINEAR_____0_CM 1. 255. DISPLAY_IDENTIFIER ID_ERR_ENVD_PLAUS_IGK_BN FORMAT "%3.0"
 /begin AXIS_DESCR COM_AXIS errm_online_dummy _CNV_A_R_LINEAR_____0_CM 4 0. 255. FORMAT "%3.0" AXIS_PTS_REF ldpm_fmy_envd /end AXIS_DESCR
/end CHARACTERISTIC
/begin CHARACTERISTIC fmy_id_tq_req_can.envd "Freeze frame FRF_CUS_SET_SPC: environmental data contents for failure XX" CURVE 0xa0804c88 _REC_CUR_20_u1_u1 254. _CNV_A_R_LINEAR_____0_CM 1. 255. DISPLAY_IDENTIFIER ID_ERR_ENVD_TQ_REQ_CAN FORMAT "%3.0"
 /begin AXIS_DESCR COM_AXIS errm_online_dummy _CNV_A_R_LINEAR_____0_CM 4 0. 255. FORMAT "%3.0" AXIS_PTS_REF ldpm_fmy_envd /end AXIS_DESCR
/end CHARACTERISTIC
/begin CHARACTERISTIC fmy_id_map_sens_1.envd "Freeze frame FRF_CUS_SET_SPC: environmental data contents for failure XX" CURVE 0xa0803f18 _REC_CUR_20_u1_u1 254. _CNV_A_R_LINEAR_____0_CM 1. 255. DISPLAY_IDENTIFIER ID_ERR_ENVD_MAP_SENS_1 FORMAT "%3.0"
 /begin AXIS_DESCR COM_AXIS errm_online_dummy _CNV_A_R_LINEAR_____0_CM 4 0. 255. FORMAT "%3.0" AXIS_PTS_REF ldpm_fmy_envd /end AXIS_DESCR
/end CHARACTERISTIC
/begin CHARACTERISTIC fmy_id_map_sens_2.envd "Freeze frame FRF_CUS_SET_SPC: environmental data contents for failure XX" CURVE 0xa0803f2c _REC_CUR_20_u1_u1 254. _CNV_A_R_LINEAR_____0_CM 1. 255. DISPLAY_IDENTIFIER ID_ERR_ENVD_MAP_SENS_2 FORMAT "%3.0"
 /begin AXIS_DESCR COM_AXIS errm_online_dummy _CNV_A_R_LINEAR_____0_CM 4 0. 255. FORMAT "%3.0" AXIS_PTS_REF ldpm_fmy_envd /end AXIS_DESCR
/end CHARACTERISTIC
/begin CHARACTERISTIC fmy_id_dtc_trm.envd "Freeze frame FRF_CUS_SET_SPC: environmental data contents for failure XX" CURVE 0xa08034f0 _REC_CUR_20_u1_u1 254. _CNV_A_R_LINEAR_____0_CM 1. 255. DISPLAY_IDENTIFIER ID_ERR_ENVD_DTC_TRM FORMAT "%3.0"
 /begin AXIS_DESCR COM_AXIS errm_online_dummy _CNV_A_R_LINEAR_____0_CM 4 0. 255. FORMAT "%3.0" AXIS_PTS_REF ldpm_fmy_envd /end AXIS_DESCR
/end CHARACTERISTIC
/begin CHARACTERISTIC fmy_id_mec_ivvt_in_1.envd "Freeze frame FRF_CUS_SET_SPC: environmental data contents for failure XX" CURVE 0xa0803f7c _REC_CUR_20_u1_u1 254. _CNV_A_R_LINEAR_____0_CM 1. 255. DISPLAY_IDENTIFIER ID_ERR_ENVD_MEC_IVVT_IN_1 FORMAT "%3.0"
 /begin AXIS_DESCR COM_AXIS errm_online_dummy _CNV_A_R_LINEAR_____0_CM 4 0. 255. FORMAT "%3.0" AXIS_PTS_REF ldpm_fmy_envd /end AXIS_DESCR
/end CHARACTERISTIC
/begin CHARACTERISTIC fmy_id_mec_ivvt_in_2.envd "Freeze frame FRF_CUS_SET_SPC: environmental data contents for failure XX" CURVE 0xa0803f90 _REC_CUR_20_u1_u1 254. _CNV_A_R_LINEAR_____0_CM 1. 255. DISPLAY_IDENTIFIER ID_ERR_ENVD_MEC_IVVT_IN_2 FORMAT "%3.0"
 /begin AXIS_DESCR COM_AXIS errm_online_dummy _CNV_A_R_LINEAR_____0_CM 4 0. 255. FORMAT "%3.0" AXIS_PTS_REF ldpm_fmy_envd /end AXIS_DESCR
/end CHARACTERISTIC
/begin CHARACTERISTIC fmy_id_mec_ivvt_ex.envd "Freeze frame FRF_CUS_SET_SPC: environmental data contents for failure XX" CURVE 0xa0803f68 _REC_CUR_20_u1_u1 254. _CNV_A_R_LINEAR_____0_CM 1. 255. DISPLAY_IDENTIFIER ID_ERR_ENVD_MEC_IVVT_EX FORMAT "%3.0"
 /begin AXIS_DESCR COM_AXIS errm_online_dummy _CNV_A_R_LINEAR_____0_CM 4 0. 255. FORMAT "%3.0" AXIS_PTS_REF ldpm_fmy_envd /end AXIS_DESCR
/end CHARACTERISTIC
/begin CHARACTERISTIC fmy_id_tout_nox_sens_1.envd "Freeze frame FRF_CUS_SET_SPC: environmental data contents for failure XX" CURVE 0xa0804ae4 _REC_CUR_20_u1_u1 254. _CNV_A_R_LINEAR_____0_CM 1. 255. DISPLAY_IDENTIFIER ID_ERR_ENVD_TOUT_NOX_SENS_1 FORMAT "%3.0"
 /begin AXIS_DESCR COM_AXIS errm_online_dummy _CNV_A_R_LINEAR_____0_CM 4 0. 255. FORMAT "%3.0" AXIS_PTS_REF ldpm_fmy_envd /end AXIS_DESCR
/end CHARACTERISTIC
/begin CHARACTERISTIC fmy_id_tout_nox_sens_2.envd "Freeze frame FRF_CUS_SET_SPC: environmental data contents for failure XX" CURVE 0xa0804af8 _REC_CUR_20_u1_u1 254. _CNV_A_R_LINEAR_____0_CM 1. 255. DISPLAY_IDENTIFIER ID_ERR_ENVD_TOUT_NOX_SENS_2 FORMAT "%3.0"
 /begin AXIS_DESCR COM_AXIS errm_online_dummy _CNV_A_R_LINEAR_____0_CM 4 0. 255. FORMAT "%3.0" AXIS_PTS_REF ldpm_fmy_envd /end AXIS_DESCR
/end CHARACTERISTIC
/begin CHARACTERISTIC fmy_id_vvl_rot.envd "Freeze frame FRF_CUS_SET_SPC: environmental data contents for failure XX" CURVE 0xa0804ddc _REC_CUR_20_u1_u1 254. _CNV_A_R_LINEAR_____0_CM 1. 255. DISPLAY_IDENTIFIER ID_ERR_ENVD_VVL_ROT FORMAT "%3.0"
 /begin AXIS_DESCR COM_AXIS errm_online_dummy _CNV_A_R_LINEAR_____0_CM 4 0. 255. FORMAT "%3.0" AXIS_PTS_REF ldpm_fmy_envd /end AXIS_DESCR
/end CHARACTERISTIC
/begin CHARACTERISTIC fmy_id_rly_vvl.envd "Freeze frame FRF_CUS_SET_SPC: environmental data contents for failure XX" CURVE 0xa0804594 _REC_CUR_20_u1_u1 254. _CNV_A_R_LINEAR_____0_CM 1. 255. DISPLAY_IDENTIFIER ID_ERR_ENVD_RLY_VVL FORMAT "%3.0"
 /begin AXIS_DESCR COM_AXIS errm_online_dummy _CNV_A_R_LINEAR_____0_CM 4 0. 255. FORMAT "%3.0" AXIS_PTS_REF ldpm_fmy_envd /end AXIS_DESCR
/end CHARACTERISTIC
/begin CHARACTERISTIC fmy_id_nox_sens_1.envd "Freeze frame FRF_CUS_SET_SPC: environmental data contents for failure XX" CURVE 0xa080410c _REC_CUR_20_u1_u1 254. _CNV_A_R_LINEAR_____0_CM 1. 255. DISPLAY_IDENTIFIER ID_ERR_ENVD_NOX_SENS_1 FORMAT "%3.0"
 /begin AXIS_DESCR COM_AXIS errm_online_dummy _CNV_A_R_LINEAR_____0_CM 4 0. 255. FORMAT "%3.0" AXIS_PTS_REF ldpm_fmy_envd /end AXIS_DESCR
/end CHARACTERISTIC
/begin CHARACTERISTIC fmy_id_ns_obd_1_1.envd "Freeze frame FRF_CUS_SET_SPC: environmental data contents for failure XX" CURVE 0xa0804134 _REC_CUR_20_u1_u1 254. _CNV_A_R_LINEAR_____0_CM 1. 255. DISPLAY_IDENTIFIER ID_ERR_ENVD_NS_OBD_1_1 FORMAT "%3.0"
 /begin AXIS_DESCR COM_AXIS errm_online_dummy _CNV_A_R_LINEAR_____0_CM 4 0. 255. FORMAT "%3.0" AXIS_PTS_REF ldpm_fmy_envd /end AXIS_DESCR
/end CHARACTERISTIC
/begin CHARACTERISTIC fmy_id_ns_obd_1_2.envd "Freeze frame FRF_CUS_SET_SPC: environmental data contents for failure XX" CURVE 0xa0804148 _REC_CUR_20_u1_u1 254. _CNV_A_R_LINEAR_____0_CM 1. 255. DISPLAY_IDENTIFIER ID_ERR_ENVD_NS_OBD_1_2 FORMAT "%3.0"
 /begin AXIS_DESCR COM_AXIS errm_online_dummy _CNV_A_R_LINEAR_____0_CM 4 0. 255. FORMAT "%3.0" AXIS_PTS_REF ldpm_fmy_envd /end AXIS_DESCR
/end CHARACTERISTIC
/begin CHARACTERISTIC fmy_id_ovl_ecu_vvl.envd "Freeze frame FRF_CUS_SET_SPC: environmental data contents for failure XX" CURVE 0xa0804224 _REC_CUR_20_u1_u1 254. _CNV_A_R_LINEAR_____0_CM 1. 255. DISPLAY_IDENTIFIER ID_ERR_ENVD_OVL_ECU_VVL FORMAT "%3.0"
 /begin AXIS_DESCR COM_AXIS errm_online_dummy _CNV_A_R_LINEAR_____0_CM 4 0. 255. FORMAT "%3.0" AXIS_PTS_REF ldpm_fmy_envd /end AXIS_DESCR
/end CHARACTERISTIC
/begin CHARACTERISTIC fmy_id_dr_sc_vvl.envd "Freeze frame FRF_CUS_SET_SPC: environmental data contents for failure XX" CURVE 0xa08034dc _REC_CUR_20_u1_u1 254. _CNV_A_R_LINEAR_____0_CM 1. 255. DISPLAY_IDENTIFIER ID_ERR_ENVD_DR_SC_VVL FORMAT "%3.0"
 /begin AXIS_DESCR COM_AXIS errm_online_dummy _CNV_A_R_LINEAR_____0_CM 4 0. 255. FORMAT "%3.0" AXIS_PTS_REF ldpm_fmy_envd /end AXIS_DESCR
/end CHARACTERISTIC
/begin CHARACTERISTIC fmy_id_crit_ovl_ecu_vvl.envd "Freeze frame FRF_CUS_SET_SPC: environmental data contents for failure XX" CURVE 0xa08031d0 _REC_CUR_20_u1_u1 254. _CNV_A_R_LINEAR_____0_CM 1. 255. DISPLAY_IDENTIFIER ID_ERR_ENVD_CRIT_OVL_ECU_VVL FORMAT "%3.0"
 /begin AXIS_DESCR COM_AXIS errm_online_dummy _CNV_A_R_LINEAR_____0_CM 4 0. 255. FORMAT "%3.0" AXIS_PTS_REF ldpm_fmy_envd /end AXIS_DESCR
/end CHARACTERISTIC
/begin CHARACTERISTIC fmy_id_nox_sens_2.envd "Freeze frame FRF_CUS_SET_SPC: environmental data contents for failure XX" CURVE 0xa0804120 _REC_CUR_20_u1_u1 254. _CNV_A_R_LINEAR_____0_CM 1. 255. DISPLAY_IDENTIFIER ID_ERR_ENVD_NOX_SENS_2 FORMAT "%3.0"
 /begin AXIS_DESCR COM_AXIS errm_online_dummy _CNV_A_R_LINEAR_____0_CM 4 0. 255. FORMAT "%3.0" AXIS_PTS_REF ldpm_fmy_envd /end AXIS_DESCR
/end CHARACTERISTIC
/begin CHARACTERISTIC fmy_id_cur_h_vvl.envd "Freeze frame FRF_CUS_SET_SPC: environmental data contents for failure XX" CURVE 0xa0803284 _REC_CUR_20_u1_u1 254. _CNV_A_R_LINEAR_____0_CM 1. 255. DISPLAY_IDENTIFIER ID_ERR_ENVD_CUR_H_VVL FORMAT "%3.0"
 /begin AXIS_DESCR COM_AXIS errm_online_dummy _CNV_A_R_LINEAR_____0_CM 4 0. 255. FORMAT "%3.0" AXIS_PTS_REF ldpm_fmy_envd /end AXIS_DESCR
/end CHARACTERISTIC
/begin CHARACTERISTIC fmy_id_teg_pcat_down.envd "Freeze frame FRF_CUS_SET_SPC: environmental data contents for failure XX" CURVE 0xa08049b8 _REC_CUR_20_u1_u1 254. _CNV_A_R_LINEAR_____0_CM 1. 255. DISPLAY_IDENTIFIER ID_ERR_ENVD_TEG_PCAT_DOWN FORMAT "%3.0"
 /begin AXIS_DESCR COM_AXIS errm_online_dummy _CNV_A_R_LINEAR_____0_CM 4 0. 255. FORMAT "%3.0" AXIS_PTS_REF ldpm_fmy_envd /end AXIS_DESCR
/end CHARACTERISTIC
/begin CHARACTERISTIC fmy_id_t_seg_er.envd "Freeze frame FRF_CUS_SET_SPC: environmental data contents for failure XX" CURVE 0xa0804878 _REC_CUR_20_u1_u1 254. _CNV_A_R_LINEAR_____0_CM 1. 255. DISPLAY_IDENTIFIER ID_ERR_ENVD_T_SEG_ER FORMAT "%3.0"
 /begin AXIS_DESCR COM_AXIS errm_online_dummy _CNV_A_R_LINEAR_____0_CM 4 0. 255. FORMAT "%3.0" AXIS_PTS_REF ldpm_fmy_envd /end AXIS_DESCR
/end CHARACTERISTIC
/begin CHARACTERISTIC fmy_id_seg_ad_er.envd "Freeze frame FRF_CUS_SET_SPC: environmental data contents for failure XX" CURVE 0xa080460c _REC_CUR_20_u1_u1 254. _CNV_A_R_LINEAR_____0_CM 1. 255. DISPLAY_IDENTIFIER ID_ERR_ENVD_SEG_AD_ER FORMAT "%3.0"
 /begin AXIS_DESCR COM_AXIS errm_online_dummy _CNV_A_R_LINEAR_____0_CM 4 0. 255. FORMAT "%3.0" AXIS_PTS_REF ldpm_fmy_envd /end AXIS_DESCR
/end CHARACTERISTIC
/begin CHARACTERISTIC fmy_id_vs_plaus.envd "Freeze frame FRF_CUS_SET_SPC: environmental data contents for failure XX" CURVE 0xa0804dc8 _REC_CUR_20_u1_u1 254. _CNV_A_R_LINEAR_____0_CM 1. 255. DISPLAY_IDENTIFIER ID_ERR_ENVD_VS_PLAUS FORMAT "%3.0"
 /begin AXIS_DESCR COM_AXIS errm_online_dummy _CNV_A_R_LINEAR_____0_CM 4 0. 255. FORMAT "%3.0" AXIS_PTS_REF ldpm_fmy_envd /end AXIS_DESCR
/end CHARACTERISTIC
/begin CHARACTERISTIC fmy_id_ftl_obd.envd "Freeze frame FRF_CUS_SET_SPC: environmental data contents for failure XX" CURVE 0xa08037fc _REC_CUR_20_u1_u1 254. _CNV_A_R_LINEAR_____0_CM 1. 255. DISPLAY_IDENTIFIER ID_ERR_ENVD_FTL_OBD FORMAT "%3.0"
 /begin AXIS_DESCR COM_AXIS errm_online_dummy _CNV_A_R_LINEAR_____0_CM 4 0. 255. FORMAT "%3.0" AXIS_PTS_REF ldpm_fmy_envd /end AXIS_DESCR
/end CHARACTERISTIC
/begin CHARACTERISTIC fmy_id_ftl_le_can.envd "Freeze frame FRF_CUS_SET_SPC: environmental data contents for failure XX" CURVE 0xa08037d4 _REC_CUR_20_u1_u1 254. _CNV_A_R_LINEAR_____0_CM 1. 255. DISPLAY_IDENTIFIER ID_ERR_ENVD_FTL_LE_CAN FORMAT "%3.0"
 /begin AXIS_DESCR COM_AXIS errm_online_dummy _CNV_A_R_LINEAR_____0_CM 4 0. 255. FORMAT "%3.0" AXIS_PTS_REF ldpm_fmy_envd /end AXIS_DESCR
/end CHARACTERISTIC
/begin CHARACTERISTIC fmy_id_ftl_ri_can.envd "Freeze frame FRF_CUS_SET_SPC: environmental data contents for failure XX" CURVE 0xa0803810 _REC_CUR_20_u1_u1 254. _CNV_A_R_LINEAR_____0_CM 1. 255. DISPLAY_IDENTIFIER ID_ERR_ENVD_FTL_RI_CAN FORMAT "%3.0"
 /begin AXIS_DESCR COM_AXIS errm_online_dummy _CNV_A_R_LINEAR_____0_CM 4 0. 255. FORMAT "%3.0" AXIS_PTS_REF ldpm_fmy_envd /end AXIS_DESCR
/end CHARACTERISTIC
/begin CHARACTERISTIC fmy_id_tia_plaus.envd "Freeze frame FRF_CUS_SET_SPC: environmental data contents for failure XX" CURVE 0xa0804a30 _REC_CUR_20_u1_u1 254. _CNV_A_R_LINEAR_____0_CM 1. 255. DISPLAY_IDENTIFIER ID_ERR_ENVD_TIA_PLAUS FORMAT "%3.0"
 /begin AXIS_DESCR COM_AXIS errm_online_dummy _CNV_A_R_LINEAR_____0_CM 4 0. 255. FORMAT "%3.0" AXIS_PTS_REF ldpm_fmy_envd /end AXIS_DESCR
/end CHARACTERISTIC
/begin CHARACTERISTIC fmy_id_tam_can.envd "Freeze frame FRF_CUS_SET_SPC: environmental data contents for failure XX" CURVE 0xa080488c _REC_CUR_20_u1_u1 254. _CNV_A_R_LINEAR_____0_CM 1. 255. DISPLAY_IDENTIFIER ID_ERR_ENVD_TAM_CAN FORMAT "%3.0"
 /begin AXIS_DESCR COM_AXIS errm_online_dummy _CNV_A_R_LINEAR_____0_CM 4 0. 255. FORMAT "%3.0" AXIS_PTS_REF ldpm_fmy_envd /end AXIS_DESCR
/end CHARACTERISTIC
/begin CHARACTERISTIC fmy_id_tam_plaus.envd "Freeze frame FRF_CUS_SET_SPC: environmental data contents for failure XX" CURVE 0xa08048a0 _REC_CUR_20_u1_u1 254. _CNV_A_R_LINEAR_____0_CM 1. 255. DISPLAY_IDENTIFIER ID_ERR_ENVD_TAM_PLAUS FORMAT "%3.0"
 /begin AXIS_DESCR COM_AXIS errm_online_dummy _CNV_A_R_LINEAR_____0_CM 4 0. 255. FORMAT "%3.0" AXIS_PTS_REF ldpm_fmy_envd /end AXIS_DESCR
/end CHARACTERISTIC
/begin CHARACTERISTIC fmy_id_map_shift_1.envd "Freeze frame FRF_CUS_SET_SPC: environmental data contents for failure XX" CURVE 0xa0803f40 _REC_CUR_20_u1_u1 254. _CNV_A_R_LINEAR_____0_CM 1. 255. DISPLAY_IDENTIFIER ID_ERR_ENVD_MAP_SHIFT_1 FORMAT "%3.0"
 /begin AXIS_DESCR COM_AXIS errm_online_dummy _CNV_A_R_LINEAR_____0_CM 4 0. 255. FORMAT "%3.0" AXIS_PTS_REF ldpm_fmy_envd /end AXIS_DESCR
/end CHARACTERISTIC
/begin CHARACTERISTIC fmy_id_map_shift_2.envd "Freeze frame FRF_CUS_SET_SPC: environmental data contents for failure XX" CURVE 0xa0803f54 _REC_CUR_20_u1_u1 254. _CNV_A_R_LINEAR_____0_CM 1. 255. DISPLAY_IDENTIFIER ID_ERR_ENVD_MAP_SHIFT_2 FORMAT "%3.0"
 /begin AXIS_DESCR COM_AXIS errm_online_dummy _CNV_A_R_LINEAR_____0_CM 4 0. 255. FORMAT "%3.0" AXIS_PTS_REF ldpm_fmy_envd /end AXIS_DESCR
/end CHARACTERISTIC
/begin CHARACTERISTIC fmy_id_cat_diag_1.envd "Freeze frame FRF_CUS_SET_SPC: environmental data contents for failure XX" CURVE 0xa0802d5c _REC_CUR_20_u1_u1 254. _CNV_A_R_LINEAR_____0_CM 1. 255. DISPLAY_IDENTIFIER ID_ERR_ENVD_CAT_DIAG_1 FORMAT "%3.0"
 /begin AXIS_DESCR COM_AXIS errm_online_dummy _CNV_A_R_LINEAR_____0_CM 4 0. 255. FORMAT "%3.0" AXIS_PTS_REF ldpm_fmy_envd /end AXIS_DESCR
/end CHARACTERISTIC
/begin CHARACTERISTIC fmy_id_cat_diag_2.envd "Freeze frame FRF_CUS_SET_SPC: environmental data contents for failure XX" CURVE 0xa0802d70 _REC_CUR_20_u1_u1 254. _CNV_A_R_LINEAR_____0_CM 1. 255. DISPLAY_IDENTIFIER ID_ERR_ENVD_CAT_DIAG_2 FORMAT "%3.0"
 /begin AXIS_DESCR COM_AXIS errm_online_dummy _CNV_A_R_LINEAR_____0_CM 4 0. 255. FORMAT "%3.0" AXIS_PTS_REF ldpm_fmy_envd /end AXIS_DESCR
/end CHARACTERISTIC
/begin CHARACTERISTIC fmy_id_cat_diag_afl_1.envd "Freeze frame FRF_CUS_SET_SPC: environmental data contents for failure XX" CURVE 0xa0802d84 _REC_CUR_20_u1_u1 254. _CNV_A_R_LINEAR_____0_CM 1. 255. DISPLAY_IDENTIFIER ID_ERR_ENVD_CAT_DIAG_AFL_1 FORMAT "%3.0"
 /begin AXIS_DESCR COM_AXIS errm_online_dummy _CNV_A_R_LINEAR_____0_CM 4 0. 255. FORMAT "%3.0" AXIS_PTS_REF ldpm_fmy_envd /end AXIS_DESCR
/end CHARACTERISTIC
/begin CHARACTERISTIC fmy_id_cat_diag_afl_2.envd "Freeze frame FRF_CUS_SET_SPC: environmental data contents for failure XX" CURVE 0xa0802d98 _REC_CUR_20_u1_u1 254. _CNV_A_R_LINEAR_____0_CM 1. 255. DISPLAY_IDENTIFIER ID_ERR_ENVD_CAT_DIAG_AFL_2 FORMAT "%3.0"
 /begin AXIS_DESCR COM_AXIS errm_online_dummy _CNV_A_R_LINEAR_____0_CM 4 0. 255. FORMAT "%3.0" AXIS_PTS_REF ldpm_fmy_envd /end AXIS_DESCR
/end CHARACTERISTIC
/begin CHARACTERISTIC fmy_id_scg_ls_down_1.envd "Freeze frame FRF_CUS_SET_SPC: environmental data contents for failure XX" CURVE 0xa08045bc _REC_CUR_20_u1_u1 254. _CNV_A_R_LINEAR_____0_CM 1. 255. DISPLAY_IDENTIFIER ID_ERR_ENVD_SCG_LS_DOWN_1 FORMAT "%3.0"
 /begin AXIS_DESCR COM_AXIS errm_online_dummy _CNV_A_R_LINEAR_____0_CM 4 0. 255. FORMAT "%3.0" AXIS_PTS_REF ldpm_fmy_envd /end AXIS_DESCR
/end CHARACTERISTIC
/begin CHARACTERISTIC fmy_id_scp_ls_down_1.envd "Freeze frame FRF_CUS_SET_SPC: environmental data contents for failure XX" CURVE 0xa08045e4 _REC_CUR_20_u1_u1 254. _CNV_A_R_LINEAR_____0_CM 1. 255. DISPLAY_IDENTIFIER ID_ERR_ENVD_SCP_LS_DOWN_1 FORMAT "%3.0"
 /begin AXIS_DESCR COM_AXIS errm_online_dummy _CNV_A_R_LINEAR_____0_CM 4 0. 255. FORMAT "%3.0" AXIS_PTS_REF ldpm_fmy_envd /end AXIS_DESCR
/end CHARACTERISTIC
/begin CHARACTERISTIC fmy_id_oc_ls_down_1.envd "Freeze frame FRF_CUS_SET_SPC: environmental data contents for failure XX" CURVE 0xa08041ac _REC_CUR_20_u1_u1 254. _CNV_A_R_LINEAR_____0_CM 1. 255. DISPLAY_IDENTIFIER ID_ERR_ENVD_OC_LS_DOWN_1 FORMAT "%3.0"
 /begin AXIS_DESCR COM_AXIS errm_online_dummy _CNV_A_R_LINEAR_____0_CM 4 0. 255. FORMAT "%3.0" AXIS_PTS_REF ldpm_fmy_envd /end AXIS_DESCR
/end CHARACTERISTIC
/begin CHARACTERISTIC fmy_id_puc_ls_down_1.envd "Freeze frame FRF_CUS_SET_SPC: environmental data contents for failure XX" CURVE 0xa0804364 _REC_CUR_20_u1_u1 254. _CNV_A_R_LINEAR_____0_CM 1. 255. DISPLAY_IDENTIFIER ID_ERR_ENVD_PUC_LS_DOWN_1 FORMAT "%3.0"
 /begin AXIS_DESCR COM_AXIS errm_online_dummy _CNV_A_R_LINEAR_____0_CM 4 0. 255. FORMAT "%3.0" AXIS_PTS_REF ldpm_fmy_envd /end AXIS_DESCR
/end CHARACTERISTIC
/begin CHARACTERISTIC fmy_id_fl_ls_down_1.envd "Freeze frame FRF_CUS_SET_SPC: environmental data contents for failure XX" CURVE 0xa0803734 _REC_CUR_20_u1_u1 254. _CNV_A_R_LINEAR_____0_CM 1. 255. DISPLAY_IDENTIFIER ID_ERR_ENVD_FL_LS_DOWN_1 FORMAT "%3.0"
 /begin AXIS_DESCR COM_AXIS errm_online_dummy _CNV_A_R_LINEAR_____0_CM 4 0. 255. FORMAT "%3.0" AXIS_PTS_REF ldpm_fmy_envd /end AXIS_DESCR
/end CHARACTERISTIC
/begin CHARACTERISTIC fmy_id_lsl_up_if_1.envd "Freeze frame FRF_CUS_SET_SPC: environmental data contents for failure XX" CURVE 0xa0803e3c _REC_CUR_20_u1_u1 254. _CNV_A_R_LINEAR_____0_CM 1. 255. DISPLAY_IDENTIFIER ID_ERR_ENVD_LSL_UP_IF_1 FORMAT "%3.0"
 /begin AXIS_DESCR COM_AXIS errm_online_dummy _CNV_A_R_LINEAR_____0_CM 4 0. 255. FORMAT "%3.0" AXIS_PTS_REF ldpm_fmy_envd /end AXIS_DESCR
/end CHARACTERISTIC
/begin CHARACTERISTIC fmy_id_el_lsl_up_1.envd "Freeze frame FRF_CUS_SET_SPC: environmental data contents for failure XX" CURVE 0xa0803694 _REC_CUR_20_u1_u1 254. _CNV_A_R_LINEAR_____0_CM 1. 255. DISPLAY_IDENTIFIER ID_ERR_ENVD_EL_LSL_UP_1 FORMAT "%3.0"
 /begin AXIS_DESCR COM_AXIS errm_online_dummy _CNV_A_R_LINEAR_____0_CM 4 0. 255. FORMAT "%3.0" AXIS_PTS_REF ldpm_fmy_envd /end AXIS_DESCR
/end CHARACTERISTIC
/begin CHARACTERISTIC fmy_id_lsh_up_1.envd "Freeze frame FRF_CUS_SET_SPC: environmental data contents for failure XX" CURVE 0xa0803e14 _REC_CUR_20_u1_u1 254. _CNV_A_R_LINEAR_____0_CM 1. 255. DISPLAY_IDENTIFIER ID_ERR_ENVD_LSH_UP_1 FORMAT "%3.0"
 /begin AXIS_DESCR COM_AXIS errm_online_dummy _CNV_A_R_LINEAR_____0_CM 4 0. 255. FORMAT "%3.0" AXIS_PTS_REF ldpm_fmy_envd /end AXIS_DESCR
/end CHARACTERISTIC
/begin CHARACTERISTIC fmy_id_lsh_down_1.envd "Freeze frame FRF_CUS_SET_SPC: environmental data contents for failure XX" CURVE 0xa0803dc4 _REC_CUR_20_u1_u1 254. _CNV_A_R_LINEAR_____0_CM 1. 255. DISPLAY_IDENTIFIER ID_ERR_ENVD_LSH_DOWN_1 FORMAT "%3.0"
 /begin AXIS_DESCR COM_AXIS errm_online_dummy _CNV_A_R_LINEAR_____0_CM 4 0. 255. FORMAT "%3.0" AXIS_PTS_REF ldpm_fmy_envd /end AXIS_DESCR
/end CHARACTERISTIC
/begin CHARACTERISTIC fmy_id_vls_down_dif_1.envd "Freeze frame FRF_CUS_SET_SPC: environmental data contents for failure XX" CURVE 0xa0804d8c _REC_CUR_20_u1_u1 254. _CNV_A_R_LINEAR_____0_CM 1. 255. DISPLAY_IDENTIFIER ID_ERR_ENVD_VLS_DOWN_DIF_1 FORMAT "%3.0"
 /begin AXIS_DESCR COM_AXIS errm_online_dummy _CNV_A_R_LINEAR_____0_CM 4 0. 255. FORMAT "%3.0" AXIS_PTS_REF ldpm_fmy_envd /end AXIS_DESCR
/end CHARACTERISTIC
/begin CHARACTERISTIC fmy_id_lsh_lsl_up_1.envd "Freeze frame FRF_CUS_SET_SPC: environmental data contents for failure XX" CURVE 0xa0803dec _REC_CUR_20_u1_u1 254. _CNV_A_R_LINEAR_____0_CM 1. 255. DISPLAY_IDENTIFIER ID_ERR_ENVD_LSH_LSL_UP_1 FORMAT "%3.0"
 /begin AXIS_DESCR COM_AXIS errm_online_dummy _CNV_A_R_LINEAR_____0_CM 4 0. 255. FORMAT "%3.0" AXIS_PTS_REF ldpm_fmy_envd /end AXIS_DESCR
/end CHARACTERISTIC
/begin CHARACTERISTIC fmy_id_air_lsl_up_1.envd "Freeze frame FRF_CUS_SET_SPC: environmental data contents for failure XX" CURVE 0xa080299c _REC_CUR_20_u1_u1 254. _CNV_A_R_LINEAR_____0_CM 1. 255. DISPLAY_IDENTIFIER ID_ERR_ENVD_AIR_LSL_UP_1 FORMAT "%3.0"
 /begin AXIS_DESCR COM_AXIS errm_online_dummy _CNV_A_R_LINEAR_____0_CM 4 0. 255. FORMAT "%3.0" AXIS_PTS_REF ldpm_fmy_envd /end AXIS_DESCR
/end CHARACTERISTIC
/begin CHARACTERISTIC fmy_id_pue_ls_down_1.envd "Freeze frame FRF_CUS_SET_SPC: environmental data contents for failure XX" CURVE 0xa08043b4 _REC_CUR_20_u1_u1 254. _CNV_A_R_LINEAR_____0_CM 1. 255. DISPLAY_IDENTIFIER ID_ERR_ENVD_PUE_LS_DOWN_1 FORMAT "%3.0"
 /begin AXIS_DESCR COM_AXIS errm_online_dummy _CNV_A_R_LINEAR_____0_CM 4 0. 255. FORMAT "%3.0" AXIS_PTS_REF ldpm_fmy_envd /end AXIS_DESCR
/end CHARACTERISTIC
/begin CHARACTERISTIC fmy_id_swt_ls_down_1.envd "Freeze frame FRF_CUS_SET_SPC: environmental data contents for failure XX" CURVE 0xa080479c _REC_CUR_20_u1_u1 254. _CNV_A_R_LINEAR_____0_CM 1. 255. DISPLAY_IDENTIFIER ID_ERR_ENVD_SWT_LS_DOWN_1 FORMAT "%3.0"
 /begin AXIS_DESCR COM_AXIS errm_online_dummy _CNV_A_R_LINEAR_____0_CM 4 0. 255. FORMAT "%3.0" AXIS_PTS_REF ldpm_fmy_envd /end AXIS_DESCR
/end CHARACTERISTIC
/begin CHARACTERISTIC fmy_id_obd_lsh_down_1.envd "Freeze frame FRF_CUS_SET_SPC: environmental data contents for failure XX" CURVE 0xa080415c _REC_CUR_20_u1_u1 254. _CNV_A_R_LINEAR_____0_CM 1. 255. DISPLAY_IDENTIFIER ID_ERR_ENVD_OBD_LSH_DOWN_1 FORMAT "%3.0"
 /begin AXIS_DESCR COM_AXIS errm_online_dummy _CNV_A_R_LINEAR_____0_CM 4 0. 255. FORMAT "%3.0" AXIS_PTS_REF ldpm_fmy_envd /end AXIS_DESCR
/end CHARACTERISTIC
/begin CHARACTERISTIC fmy_id_dyn_vld_ls_up_1.envd "Freeze frame FRF_CUS_SET_SPC: environmental data contents for failure XX" CURVE 0xa0803518 _REC_CUR_20_u1_u1 254. _CNV_A_R_LINEAR_____0_CM 1. 255. DISPLAY_IDENTIFIER ID_ERR_ENVD_DYN_VLD_LS_UP_1 FORMAT "%3.0"
 /begin AXIS_DESCR COM_AXIS errm_online_dummy _CNV_A_R_LINEAR_____0_CM 4 0. 255. FORMAT "%3.0" AXIS_PTS_REF ldpm_fmy_envd /end AXIS_DESCR
/end CHARACTERISTIC
/begin CHARACTERISTIC fmy_id_puc_vld_ls_up_1.envd "Freeze frame FRF_CUS_SET_SPC: environmental data contents for failure XX" CURVE 0xa080438c _REC_CUR_20_u1_u1 254. _CNV_A_R_LINEAR_____0_CM 1. 255. DISPLAY_IDENTIFIER ID_ERR_ENVD_PUC_VLD_LS_UP_1 FORMAT "%3.0"
 /begin AXIS_DESCR COM_AXIS errm_online_dummy _CNV_A_R_LINEAR_____0_CM 4 0. 255. FORMAT "%3.0" AXIS_PTS_REF ldpm_fmy_envd /end AXIS_DESCR
/end CHARACTERISTIC
/begin CHARACTERISTIC fmy_id_obd_vld_lsh_up_1.envd "Freeze frame FRF_CUS_SET_SPC: environmental data contents for failure XX" CURVE 0xa0804184 _REC_CUR_20_u1_u1 254. _CNV_A_R_LINEAR_____0_CM 1. 255. DISPLAY_IDENTIFIER ID_ERR_ENVD_OBD_VLD_LSH_UP_1 FORMAT "%3.0"
 /begin AXIS_DESCR COM_AXIS errm_online_dummy _CNV_A_R_LINEAR_____0_CM 4 0. 255. FORMAT "%3.0" AXIS_PTS_REF ldpm_fmy_envd /end AXIS_DESCR
/end CHARACTERISTIC
/begin CHARACTERISTIC fmy_id_chk_ls_down_1.envd "Freeze frame FRF_CUS_SET_SPC: environmental data contents for failure XX" CURVE 0xa0802de8 _REC_CUR_20_u1_u1 254. _CNV_A_R_LINEAR_____0_CM 1. 255. DISPLAY_IDENTIFIER ID_ERR_ENVD_CHK_LS_DOWN_1 FORMAT "%3.0"
 /begin AXIS_DESCR COM_AXIS errm_online_dummy _CNV_A_R_LINEAR_____0_CM 4 0. 255. FORMAT "%3.0" AXIS_PTS_REF ldpm_fmy_envd /end AXIS_DESCR
/end CHARACTERISTIC
/begin CHARACTERISTIC fmy_id_shift_afl_lsl_up_1.envd "Freeze frame FRF_CUS_SET_SPC: environmental data contents for failure XX" CURVE 0xa080465c _REC_CUR_20_u1_u1 254. _CNV_A_R_LINEAR_____0_CM 1. 255. DISPLAY_IDENTIFIER ID_ERR_ENVD_SHIFT_AFL_LSL_UP_1 FORMAT "%3.0"
 /begin AXIS_DESCR COM_AXIS errm_online_dummy _CNV_A_R_LINEAR_____0_CM 4 0. 255. FORMAT "%3.0" AXIS_PTS_REF ldpm_fmy_envd /end AXIS_DESCR
/end CHARACTERISTIC
/begin CHARACTERISTIC fmy_id_shift_afr_lsl_up_1.envd "Freeze frame FRF_CUS_SET_SPC: environmental data contents for failure XX" CURVE 0xa0804684 _REC_CUR_20_u1_u1 254. _CNV_A_R_LINEAR_____0_CM 1. 255. DISPLAY_IDENTIFIER ID_ERR_ENVD_SHIFT_AFR_LSL_UP_1 FORMAT "%3.0"
 /begin AXIS_DESCR COM_AXIS errm_online_dummy _CNV_A_R_LINEAR_____0_CM 4 0. 255. FORMAT "%3.0" AXIS_PTS_REF ldpm_fmy_envd /end AXIS_DESCR
/end CHARACTERISTIC
/begin CHARACTERISTIC fmy_id_oc_lsl_up_1.envd "Freeze frame FRF_CUS_SET_SPC: environmental data contents for failure XX" CURVE 0xa08041d4 _REC_CUR_20_u1_u1 254. _CNV_A_R_LINEAR_____0_CM 1. 255. DISPLAY_IDENTIFIER ID_ERR_ENVD_OC_LSL_UP_1 FORMAT "%3.0"
 /begin AXIS_DESCR COM_AXIS errm_online_dummy _CNV_A_R_LINEAR_____0_CM 4 0. 255. FORMAT "%3.0" AXIS_PTS_REF ldpm_fmy_envd /end AXIS_DESCR
/end CHARACTERISTIC
/begin CHARACTERISTIC fmy_id_delta_i_lam_1.envd "Freeze frame FRF_CUS_SET_SPC: environmental data contents for failure XX" CURVE 0xa0803450 _REC_CUR_20_u1_u1 254. _CNV_A_R_LINEAR_____0_CM 1. 255. DISPLAY_IDENTIFIER ID_ERR_ENVD_DELTA_I_LAM_1 FORMAT "%3.0"
 /begin AXIS_DESCR COM_AXIS errm_online_dummy _CNV_A_R_LINEAR_____0_CM 4 0. 255. FORMAT "%3.0" AXIS_PTS_REF ldpm_fmy_envd /end AXIS_DESCR
/end CHARACTERISTIC
/begin CHARACTERISTIC fmy_id_ofs_lsl_up_1.envd "Freeze frame FRF_CUS_SET_SPC: environmental data contents for failure XX" CURVE 0xa08041fc _REC_CUR_20_u1_u1 254. _CNV_A_R_LINEAR_____0_CM 1. 255. DISPLAY_IDENTIFIER ID_ERR_ENVD_OFS_LSL_UP_1 FORMAT "%3.0"
 /begin AXIS_DESCR COM_AXIS errm_online_dummy _CNV_A_R_LINEAR_____0_CM 4 0. 255. FORMAT "%3.0" AXIS_PTS_REF ldpm_fmy_envd /end AXIS_DESCR
/end CHARACTERISTIC
/begin CHARACTERISTIC fmy_id_ttip_mes_lsh_up_1.envd "Freeze frame FRF_CUS_SET_SPC: environmental data contents for failure XX" CURVE 0xa0804cec _REC_CUR_20_u1_u1 254. _CNV_A_R_LINEAR_____0_CM 1. 255. DISPLAY_IDENTIFIER ID_ERR_ENVD_TTIP_MES_LSH_UP_1 FORMAT "%3.0"
 /begin AXIS_DESCR COM_AXIS errm_online_dummy _CNV_A_R_LINEAR_____0_CM 4 0. 255. FORMAT "%3.0" AXIS_PTS_REF ldpm_fmy_envd /end AXIS_DESCR
/end CHARACTERISTIC
/begin CHARACTERISTIC fmy_id_ctl_lsl_up_1.envd "Freeze frame FRF_CUS_SET_SPC: environmental data contents for failure XX" CURVE 0xa080325c _REC_CUR_20_u1_u1 254. _CNV_A_R_LINEAR_____0_CM 1. 255. DISPLAY_IDENTIFIER ID_ERR_ENVD_CTL_LSL_UP_1 FORMAT "%3.0"
 /begin AXIS_DESCR COM_AXIS errm_online_dummy _CNV_A_R_LINEAR_____0_CM 4 0. 255. FORMAT "%3.0" AXIS_PTS_REF ldpm_fmy_envd /end AXIS_DESCR
/end CHARACTERISTIC
/begin CHARACTERISTIC fmy_id_chg_ls_down.envd "Freeze frame FRF_CUS_SET_SPC: environmental data contents for failure XX" CURVE 0xa0802dac _REC_CUR_20_u1_u1 254. _CNV_A_R_LINEAR_____0_CM 1. 255. DISPLAY_IDENTIFIER ID_ERR_ENVD_CHG_LS_DOWN FORMAT "%3.0"
 /begin AXIS_DESCR COM_AXIS errm_online_dummy _CNV_A_R_LINEAR_____0_CM 4 0. 255. FORMAT "%3.0" AXIS_PTS_REF ldpm_fmy_envd /end AXIS_DESCR
/end CHARACTERISTIC
/begin CHARACTERISTIC fmy_id_scg_ls_down_2.envd "Freeze frame FRF_CUS_SET_SPC: environmental data contents for failure XX" CURVE 0xa08045d0 _REC_CUR_20_u1_u1 254. _CNV_A_R_LINEAR_____0_CM 1. 255. DISPLAY_IDENTIFIER ID_ERR_ENVD_SCG_LS_DOWN_2 FORMAT "%3.0"
 /begin AXIS_DESCR COM_AXIS errm_online_dummy _CNV_A_R_LINEAR_____0_CM 4 0. 255. FORMAT "%3.0" AXIS_PTS_REF ldpm_fmy_envd /end AXIS_DESCR
/end CHARACTERISTIC
/begin CHARACTERISTIC fmy_id_scp_ls_down_2.envd "Freeze frame FRF_CUS_SET_SPC: environmental data contents for failure XX" CURVE 0xa08045f8 _REC_CUR_20_u1_u1 254. _CNV_A_R_LINEAR_____0_CM 1. 255. DISPLAY_IDENTIFIER ID_ERR_ENVD_SCP_LS_DOWN_2 FORMAT "%3.0"
 /begin AXIS_DESCR COM_AXIS errm_online_dummy _CNV_A_R_LINEAR_____0_CM 4 0. 255. FORMAT "%3.0" AXIS_PTS_REF ldpm_fmy_envd /end AXIS_DESCR
/end CHARACTERISTIC
/begin CHARACTERISTIC fmy_id_oc_ls_down_2.envd "Freeze frame FRF_CUS_SET_SPC: environmental data contents for failure XX" CURVE 0xa08041c0 _REC_CUR_20_u1_u1 254. _CNV_A_R_LINEAR_____0_CM 1. 255. DISPLAY_IDENTIFIER ID_ERR_ENVD_OC_LS_DOWN_2 FORMAT "%3.0"
 /begin AXIS_DESCR COM_AXIS errm_online_dummy _CNV_A_R_LINEAR_____0_CM 4 0. 255. FORMAT "%3.0" AXIS_PTS_REF ldpm_fmy_envd /end AXIS_DESCR
/end CHARACTERISTIC
/begin CHARACTERISTIC fmy_id_puc_ls_down_2.envd "Freeze frame FRF_CUS_SET_SPC: environmental data contents for failure XX" CURVE 0xa0804378 _REC_CUR_20_u1_u1 254. _CNV_A_R_LINEAR_____0_CM 1. 255. DISPLAY_IDENTIFIER ID_ERR_ENVD_PUC_LS_DOWN_2 FORMAT "%3.0"
 /begin AXIS_DESCR COM_AXIS errm_online_dummy _CNV_A_R_LINEAR_____0_CM 4 0. 255. FORMAT "%3.0" AXIS_PTS_REF ldpm_fmy_envd /end AXIS_DESCR
/end CHARACTERISTIC
/begin CHARACTERISTIC fmy_id_fl_ls_down_2.envd "Freeze frame FRF_CUS_SET_SPC: environmental data contents for failure XX" CURVE 0xa0803748 _REC_CUR_20_u1_u1 254. _CNV_A_R_LINEAR_____0_CM 1. 255. DISPLAY_IDENTIFIER ID_ERR_ENVD_FL_LS_DOWN_2 FORMAT "%3.0"
 /begin AXIS_DESCR COM_AXIS errm_online_dummy _CNV_A_R_LINEAR_____0_CM 4 0. 255. FORMAT "%3.0" AXIS_PTS_REF ldpm_fmy_envd /end AXIS_DESCR
/end CHARACTERISTIC
/begin CHARACTERISTIC fmy_id_lsl_up_if_2.envd "Freeze frame FRF_CUS_SET_SPC: environmental data contents for failure XX" CURVE 0xa0803e50 _REC_CUR_20_u1_u1 254. _CNV_A_R_LINEAR_____0_CM 1. 255. DISPLAY_IDENTIFIER ID_ERR_ENVD_LSL_UP_IF_2 FORMAT "%3.0"
 /begin AXIS_DESCR COM_AXIS errm_online_dummy _CNV_A_R_LINEAR_____0_CM 4 0. 255. FORMAT "%3.0" AXIS_PTS_REF ldpm_fmy_envd /end AXIS_DESCR
/end CHARACTERISTIC
/begin CHARACTERISTIC fmy_id_el_lsl_up_2.envd "Freeze frame FRF_CUS_SET_SPC: environmental data contents for failure XX" CURVE 0xa08036a8 _REC_CUR_20_u1_u1 254. _CNV_A_R_LINEAR_____0_CM 1. 255. DISPLAY_IDENTIFIER ID_ERR_ENVD_EL_LSL_UP_2 FORMAT "%3.0"
 /begin AXIS_DESCR COM_AXIS errm_online_dummy _CNV_A_R_LINEAR_____0_CM 4 0. 255. FORMAT "%3.0" AXIS_PTS_REF ldpm_fmy_envd /end AXIS_DESCR
/end CHARACTERISTIC
/begin CHARACTERISTIC fmy_id_lsh_up_2.envd "Freeze frame FRF_CUS_SET_SPC: environmental data contents for failure XX" CURVE 0xa0803e28 _REC_CUR_20_u1_u1 254. _CNV_A_R_LINEAR_____0_CM 1. 255. DISPLAY_IDENTIFIER ID_ERR_ENVD_LSH_UP_2 FORMAT "%3.0"
 /begin AXIS_DESCR COM_AXIS errm_online_dummy _CNV_A_R_LINEAR_____0_CM 4 0. 255. FORMAT "%3.0" AXIS_PTS_REF ldpm_fmy_envd /end AXIS_DESCR
/end CHARACTERISTIC
/begin CHARACTERISTIC fmy_id_lsh_down_2.envd "Freeze frame FRF_CUS_SET_SPC: environmental data contents for failure XX" CURVE 0xa0803dd8 _REC_CUR_20_u1_u1 254. _CNV_A_R_LINEAR_____0_CM 1. 255. DISPLAY_IDENTIFIER ID_ERR_ENVD_LSH_DOWN_2 FORMAT "%3.0"
 /begin AXIS_DESCR COM_AXIS errm_online_dummy _CNV_A_R_LINEAR_____0_CM 4 0. 255. FORMAT "%3.0" AXIS_PTS_REF ldpm_fmy_envd /end AXIS_DESCR
/end CHARACTERISTIC
/begin CHARACTERISTIC fmy_id_vls_down_dif_2.envd "Freeze frame FRF_CUS_SET_SPC: environmental data contents for failure XX" CURVE 0xa0804da0 _REC_CUR_20_u1_u1 254. _CNV_A_R_LINEAR_____0_CM 1. 255. DISPLAY_IDENTIFIER ID_ERR_ENVD_VLS_DOWN_DIF_2 FORMAT "%3.0"
 /begin AXIS_DESCR COM_AXIS errm_online_dummy _CNV_A_R_LINEAR_____0_CM 4 0. 255. FORMAT "%3.0" AXIS_PTS_REF ldpm_fmy_envd /end AXIS_DESCR
/end CHARACTERISTIC
/begin CHARACTERISTIC fmy_id_lsh_lsl_up_2.envd "Freeze frame FRF_CUS_SET_SPC: environmental data contents for failure XX" CURVE 0xa0803e00 _REC_CUR_20_u1_u1 254. _CNV_A_R_LINEAR_____0_CM 1. 255. DISPLAY_IDENTIFIER ID_ERR_ENVD_LSH_LSL_UP_2 FORMAT "%3.0"
 /begin AXIS_DESCR COM_AXIS errm_online_dummy _CNV_A_R_LINEAR_____0_CM 4 0. 255. FORMAT "%3.0" AXIS_PTS_REF ldpm_fmy_envd /end AXIS_DESCR
/end CHARACTERISTIC
/begin CHARACTERISTIC fmy_id_air_lsl_up_2.envd "Freeze frame FRF_CUS_SET_SPC: environmental data contents for failure XX" CURVE 0xa08029b0 _REC_CUR_20_u1_u1 254. _CNV_A_R_LINEAR_____0_CM 1. 255. DISPLAY_IDENTIFIER ID_ERR_ENVD_AIR_LSL_UP_2 FORMAT "%3.0"
 /begin AXIS_DESCR COM_AXIS errm_online_dummy _CNV_A_R_LINEAR_____0_CM 4 0. 255. FORMAT "%3.0" AXIS_PTS_REF ldpm_fmy_envd /end AXIS_DESCR
/end CHARACTERISTIC
/begin CHARACTERISTIC fmy_id_pue_ls_down_2.envd "Freeze frame FRF_CUS_SET_SPC: environmental data contents for failure XX" CURVE 0xa08043c8 _REC_CUR_20_u1_u1 254. _CNV_A_R_LINEAR_____0_CM 1. 255. DISPLAY_IDENTIFIER ID_ERR_ENVD_PUE_LS_DOWN_2 FORMAT "%3.0"
 /begin AXIS_DESCR COM_AXIS errm_online_dummy _CNV_A_R_LINEAR_____0_CM 4 0. 255. FORMAT "%3.0" AXIS_PTS_REF ldpm_fmy_envd /end AXIS_DESCR
/end CHARACTERISTIC
/begin CHARACTERISTIC fmy_id_swt_ls_down_2.envd "Freeze frame FRF_CUS_SET_SPC: environmental data contents for failure XX" CURVE 0xa08047b0 _REC_CUR_20_u1_u1 254. _CNV_A_R_LINEAR_____0_CM 1. 255. DISPLAY_IDENTIFIER ID_ERR_ENVD_SWT_LS_DOWN_2 FORMAT "%3.0"
 /begin AXIS_DESCR COM_AXIS errm_online_dummy _CNV_A_R_LINEAR_____0_CM 4 0. 255. FORMAT "%3.0" AXIS_PTS_REF ldpm_fmy_envd /end AXIS_DESCR
/end CHARACTERISTIC
/begin CHARACTERISTIC fmy_id_obd_lsh_down_2.envd "Freeze frame FRF_CUS_SET_SPC: environmental data contents for failure XX" CURVE 0xa0804170 _REC_CUR_20_u1_u1 254. _CNV_A_R_LINEAR_____0_CM 1. 255. DISPLAY_IDENTIFIER ID_ERR_ENVD_OBD_LSH_DOWN_2 FORMAT "%3.0"
 /begin AXIS_DESCR COM_AXIS errm_online_dummy _CNV_A_R_LINEAR_____0_CM 4 0. 255. FORMAT "%3.0" AXIS_PTS_REF ldpm_fmy_envd /end AXIS_DESCR
/end CHARACTERISTIC
/begin CHARACTERISTIC fmy_id_dyn_vld_ls_up_2.envd "Freeze frame FRF_CUS_SET_SPC: environmental data contents for failure XX" CURVE 0xa080352c _REC_CUR_20_u1_u1 254. _CNV_A_R_LINEAR_____0_CM 1. 255. DISPLAY_IDENTIFIER ID_ERR_ENVD_DYN_VLD_LS_UP_2 FORMAT "%3.0"
 /begin AXIS_DESCR COM_AXIS errm_online_dummy _CNV_A_R_LINEAR_____0_CM 4 0. 255. FORMAT "%3.0" AXIS_PTS_REF ldpm_fmy_envd /end AXIS_DESCR
/end CHARACTERISTIC
/begin CHARACTERISTIC fmy_id_puc_vld_ls_up_2.envd "Freeze frame FRF_CUS_SET_SPC: environmental data contents for failure XX" CURVE 0xa08043a0 _REC_CUR_20_u1_u1 254. _CNV_A_R_LINEAR_____0_CM 1. 255. DISPLAY_IDENTIFIER ID_ERR_ENVD_PUC_VLD_LS_UP_2 FORMAT "%3.0"
 /begin AXIS_DESCR COM_AXIS errm_online_dummy _CNV_A_R_LINEAR_____0_CM 4 0. 255. FORMAT "%3.0" AXIS_PTS_REF ldpm_fmy_envd /end AXIS_DESCR
/end CHARACTERISTIC
/begin CHARACTERISTIC fmy_id_obd_vld_lsh_up_2.envd "Freeze frame FRF_CUS_SET_SPC: environmental data contents for failure XX" CURVE 0xa0804198 _REC_CUR_20_u1_u1 254. _CNV_A_R_LINEAR_____0_CM 1. 255. DISPLAY_IDENTIFIER ID_ERR_ENVD_OBD_VLD_LSH_UP_2 FORMAT "%3.0"
 /begin AXIS_DESCR COM_AXIS errm_online_dummy _CNV_A_R_LINEAR_____0_CM 4 0. 255. FORMAT "%3.0" AXIS_PTS_REF ldpm_fmy_envd /end AXIS_DESCR
/end CHARACTERISTIC
/begin CHARACTERISTIC fmy_id_chk_ls_down_2.envd "Freeze frame FRF_CUS_SET_SPC: environmental data contents for failure XX" CURVE 0xa0802dfc _REC_CUR_20_u1_u1 254. _CNV_A_R_LINEAR_____0_CM 1. 255. DISPLAY_IDENTIFIER ID_ERR_ENVD_CHK_LS_DOWN_2 FORMAT "%3.0"
 /begin AXIS_DESCR COM_AXIS errm_online_dummy _CNV_A_R_LINEAR_____0_CM 4 0. 255. FORMAT "%3.0" AXIS_PTS_REF ldpm_fmy_envd /end AXIS_DESCR
/end CHARACTERISTIC
/begin CHARACTERISTIC fmy_id_shift_afl_lsl_up_2.envd "Freeze frame FRF_CUS_SET_SPC: environmental data contents for failure XX" CURVE 0xa0804670 _REC_CUR_20_u1_u1 254. _CNV_A_R_LINEAR_____0_CM 1. 255. DISPLAY_IDENTIFIER ID_ERR_ENVD_SHIFT_AFL_LSL_UP_2 FORMAT "%3.0"
 /begin AXIS_DESCR COM_AXIS errm_online_dummy _CNV_A_R_LINEAR_____0_CM 4 0. 255. FORMAT "%3.0" AXIS_PTS_REF ldpm_fmy_envd /end AXIS_DESCR
/end CHARACTERISTIC
/begin CHARACTERISTIC fmy_id_shift_afr_lsl_up_2.envd "Freeze frame FRF_CUS_SET_SPC: environmental data contents for failure XX" CURVE 0xa0804698 _REC_CUR_20_u1_u1 254. _CNV_A_R_LINEAR_____0_CM 1. 255. DISPLAY_IDENTIFIER ID_ERR_ENVD_SHIFT_AFR_LSL_UP_2 FORMAT "%3.0"
 /begin AXIS_DESCR COM_AXIS errm_online_dummy _CNV_A_R_LINEAR_____0_CM 4 0. 255. FORMAT "%3.0" AXIS_PTS_REF ldpm_fmy_envd /end AXIS_DESCR
/end CHARACTERISTIC
/begin CHARACTERISTIC fmy_id_oc_lsl_up_2.envd "Freeze frame FRF_CUS_SET_SPC: environmental data contents for failure XX" CURVE 0xa08041e8 _REC_CUR_20_u1_u1 254. _CNV_A_R_LINEAR_____0_CM 1. 255. DISPLAY_IDENTIFIER ID_ERR_ENVD_OC_LSL_UP_2 FORMAT "%3.0"
 /begin AXIS_DESCR COM_AXIS errm_online_dummy _CNV_A_R_LINEAR_____0_CM 4 0. 255. FORMAT "%3.0" AXIS_PTS_REF ldpm_fmy_envd /end AXIS_DESCR
/end CHARACTERISTIC
/begin CHARACTERISTIC fmy_id_delta_i_lam_2.envd "Freeze frame FRF_CUS_SET_SPC: environmental data contents for failure XX" CURVE 0xa0803464 _REC_CUR_20_u1_u1 254. _CNV_A_R_LINEAR_____0_CM 1. 255. DISPLAY_IDENTIFIER ID_ERR_ENVD_DELTA_I_LAM_2 FORMAT "%3.0"
 /begin AXIS_DESCR COM_AXIS errm_online_dummy _CNV_A_R_LINEAR_____0_CM 4 0. 255. FORMAT "%3.0" AXIS_PTS_REF ldpm_fmy_envd /end AXIS_DESCR
/end CHARACTERISTIC
/begin CHARACTERISTIC fmy_id_ofs_lsl_up_2.envd "Freeze frame FRF_CUS_SET_SPC: environmental data contents for failure XX" CURVE 0xa0804210 _REC_CUR_20_u1_u1 254. _CNV_A_R_LINEAR_____0_CM 1. 255. DISPLAY_IDENTIFIER ID_ERR_ENVD_OFS_LSL_UP_2 FORMAT "%3.0"
 /begin AXIS_DESCR COM_AXIS errm_online_dummy _CNV_A_R_LINEAR_____0_CM 4 0. 255. FORMAT "%3.0" AXIS_PTS_REF ldpm_fmy_envd /end AXIS_DESCR
/end CHARACTERISTIC
/begin CHARACTERISTIC fmy_id_ttip_mes_lsh_up_2.envd "Freeze frame FRF_CUS_SET_SPC: environmental data contents for failure XX" CURVE 0xa0804d00 _REC_CUR_20_u1_u1 254. _CNV_A_R_LINEAR_____0_CM 1. 255. DISPLAY_IDENTIFIER ID_ERR_ENVD_TTIP_MES_LSH_UP_2 FORMAT "%3.0"
 /begin AXIS_DESCR COM_AXIS errm_online_dummy _CNV_A_R_LINEAR_____0_CM 4 0. 255. FORMAT "%3.0" AXIS_PTS_REF ldpm_fmy_envd /end AXIS_DESCR
/end CHARACTERISTIC
/begin CHARACTERISTIC fmy_id_ctl_lsl_up_2.envd "Freeze frame FRF_CUS_SET_SPC: environmental data contents for failure XX" CURVE 0xa0803270 _REC_CUR_20_u1_u1 254. _CNV_A_R_LINEAR_____0_CM 1. 255. DISPLAY_IDENTIFIER ID_ERR_ENVD_CTL_LSL_UP_2 FORMAT "%3.0"
 /begin AXIS_DESCR COM_AXIS errm_online_dummy _CNV_A_R_LINEAR_____0_CM 4 0. 255. FORMAT "%3.0" AXIS_PTS_REF ldpm_fmy_envd /end AXIS_DESCR
/end CHARACTERISTIC
/begin CHARACTERISTIC fmy_id_chg_ls_up.envd "Freeze frame FRF_CUS_SET_SPC: environmental data contents for failure XX" CURVE 0xa0802dc0 _REC_CUR_20_u1_u1 254. _CNV_A_R_LINEAR_____0_CM 1. 255. DISPLAY_IDENTIFIER ID_ERR_ENVD_CHG_LS_UP FORMAT "%3.0"
 /begin AXIS_DESCR COM_AXIS errm_online_dummy _CNV_A_R_LINEAR_____0_CM 4 0. 255. FORMAT "%3.0" AXIS_PTS_REF ldpm_fmy_envd /end AXIS_DESCR
/end CHARACTERISTIC
/begin CHARACTERISTIC fmy_id_alter_com.envd "Freeze frame FRF_CUS_SET_SPC: environmental data contents for failure XX" CURVE 0xa0802a00 _REC_CUR_20_u1_u1 254. _CNV_A_R_LINEAR_____0_CM 1. 255. DISPLAY_IDENTIFIER ID_ERR_ENVD_ALTER_COM FORMAT "%3.0"
 /begin AXIS_DESCR COM_AXIS errm_online_dummy _CNV_A_R_LINEAR_____0_CM 4 0. 255. FORMAT "%3.0" AXIS_PTS_REF ldpm_fmy_envd /end AXIS_DESCR
/end CHARACTERISTIC
/begin CHARACTERISTIC fmy_id_cwp_com.envd "Freeze frame FRF_CUS_SET_SPC: environmental data contents for failure XX" CURVE 0xa0803298 _REC_CUR_20_u1_u1 254. _CNV_A_R_LINEAR_____0_CM 1. 255. DISPLAY_IDENTIFIER ID_ERR_ENVD_CWP_COM FORMAT "%3.0"
 /begin AXIS_DESCR COM_AXIS errm_online_dummy _CNV_A_R_LINEAR_____0_CM 4 0. 255. FORMAT "%3.0" AXIS_PTS_REF ldpm_fmy_envd /end AXIS_DESCR
/end CHARACTERISTIC
/begin CHARACTERISTIC fmy_id_qoil_com.envd "Freeze frame FRF_CUS_SET_SPC: environmental data contents for failure XX" CURVE 0xa0804490 _REC_CUR_20_u1_u1 254. _CNV_A_R_LINEAR_____0_CM 1. 255. DISPLAY_IDENTIFIER ID_ERR_ENVD_QOIL_COM FORMAT "%3.0"
 /begin AXIS_DESCR COM_AXIS errm_online_dummy _CNV_A_R_LINEAR_____0_CM 4 0. 255. FORMAT "%3.0" AXIS_PTS_REF ldpm_fmy_envd /end AXIS_DESCR
/end CHARACTERISTIC
/begin CHARACTERISTIC fmy_id_sens_bat_smt_com.envd "Freeze frame FRF_CUS_SET_SPC: environmental data contents for failure XX" CURVE 0xa0804634 _REC_CUR_20_u1_u1 254. _CNV_A_R_LINEAR_____0_CM 1. 255. DISPLAY_IDENTIFIER ID_ERR_ENVD_SENS_BAT_SMT_COM FORMAT "%3.0"
 /begin AXIS_DESCR COM_AXIS errm_online_dummy _CNV_A_R_LINEAR_____0_CM 4 0. 255. FORMAT "%3.0" AXIS_PTS_REF ldpm_fmy_envd /end AXIS_DESCR
/end CHARACTERISTIC
/begin CHARACTERISTIC fmy_id_ecraspwm_fb.envd "Freeze frame FRF_CUS_SET_SPC: environmental data contents for failure XX" CURVE 0xa08035e0 _REC_CUR_20_u1_u1 254. _CNV_A_R_LINEAR_____0_CM 1. 255. DISPLAY_IDENTIFIER ID_ERR_ENVD_ECRASPWM_FB FORMAT "%3.0"
 /begin AXIS_DESCR COM_AXIS errm_online_dummy _CNV_A_R_LINEAR_____0_CM 4 0. 255. FORMAT "%3.0" AXIS_PTS_REF ldpm_fmy_envd /end AXIS_DESCR
/end CHARACTERISTIC
/begin CHARACTERISTIC fmy_id_ecras_el.envd "Freeze frame FRF_CUS_SET_SPC: environmental data contents for failure XX" CURVE 0xa08035b8 _REC_CUR_20_u1_u1 254. _CNV_A_R_LINEAR_____0_CM 1. 255. DISPLAY_IDENTIFIER ID_ERR_ENVD_ECRAS_EL FORMAT "%3.0"
 /begin AXIS_DESCR COM_AXIS errm_online_dummy _CNV_A_R_LINEAR_____0_CM 4 0. 255. FORMAT "%3.0" AXIS_PTS_REF ldpm_fmy_envd /end AXIS_DESCR
/end CHARACTERISTIC
/begin CHARACTERISTIC fmy_id_ecras_up_fb.envd "Freeze frame FRF_CUS_SET_SPC: environmental data contents for failure XX" CURVE 0xa08035cc _REC_CUR_20_u1_u1 254. _CNV_A_R_LINEAR_____0_CM 1. 255. DISPLAY_IDENTIFIER ID_ERR_ENVD_ECRAS_UP_FB FORMAT "%3.0"
 /begin AXIS_DESCR COM_AXIS errm_online_dummy _CNV_A_R_LINEAR_____0_CM 4 0. 255. FORMAT "%3.0" AXIS_PTS_REF ldpm_fmy_envd /end AXIS_DESCR
/end CHARACTERISTIC
/begin CHARACTERISTIC fmy_id_ecras_down_fb.envd "Freeze frame FRF_CUS_SET_SPC: environmental data contents for failure XX" CURVE 0xa08035a4 _REC_CUR_20_u1_u1 254. _CNV_A_R_LINEAR_____0_CM 1. 255. DISPLAY_IDENTIFIER ID_ERR_ENVD_ECRAS_DOWN_FB FORMAT "%3.0"
 /begin AXIS_DESCR COM_AXIS errm_online_dummy _CNV_A_R_LINEAR_____0_CM 4 0. 255. FORMAT "%3.0" AXIS_PTS_REF ldpm_fmy_envd /end AXIS_DESCR
/end CHARACTERISTIC
/begin CHARACTERISTIC fmy_id_warm_rst.envd "Freeze frame FRF_CUS_SET_SPC: environmental data contents for failure XX" CURVE 0xa0804df0 _REC_CUR_20_u1_u1 254. _CNV_A_R_LINEAR_____0_CM 1. 255. DISPLAY_IDENTIFIER ID_ERR_ENVD_WARM_RST FORMAT "%3.0"
 /begin AXIS_DESCR COM_AXIS errm_online_dummy _CNV_A_R_LINEAR_____0_CM 4 0. 255. FORMAT "%3.0" AXIS_PTS_REF ldpm_fmy_envd /end AXIS_DESCR
/end CHARACTERISTIC
/begin CHARACTERISTIC fmy_id_acr_ad.envd "Freeze frame FRF_CUS_SET_SPC: environmental data contents for failure XX" CURVE 0xa0802960 _REC_CUR_20_u1_u1 254. _CNV_A_R_LINEAR_____0_CM 1. 255. DISPLAY_IDENTIFIER ID_ERR_ENVD_ACR_AD FORMAT "%3.0"
 /begin AXIS_DESCR COM_AXIS errm_online_dummy _CNV_A_R_LINEAR_____0_CM 4 0. 255. FORMAT "%3.0" AXIS_PTS_REF ldpm_fmy_envd /end AXIS_DESCR
/end CHARACTERISTIC
/begin CHARACTERISTIC fmy_id_sens_acr.envd "Freeze frame FRF_CUS_SET_SPC: environmental data contents for failure XX" CURVE 0xa0804620 _REC_CUR_20_u1_u1 254. _CNV_A_R_LINEAR_____0_CM 1. 255. DISPLAY_IDENTIFIER ID_ERR_ENVD_SENS_ACR FORMAT "%3.0"
 /begin AXIS_DESCR COM_AXIS errm_online_dummy _CNV_A_R_LINEAR_____0_CM 4 0. 255. FORMAT "%3.0" AXIS_PTS_REF ldpm_fmy_envd /end AXIS_DESCR
/end CHARACTERISTIC
/begin CHARACTERISTIC fmy_id_acr_ctl.envd "Freeze frame FRF_CUS_SET_SPC: environmental data contents for failure XX" CURVE 0xa0802974 _REC_CUR_20_u1_u1 254. _CNV_A_R_LINEAR_____0_CM 1. 255. DISPLAY_IDENTIFIER ID_ERR_ENVD_ACR_CTL FORMAT "%3.0"
 /begin AXIS_DESCR COM_AXIS errm_online_dummy _CNV_A_R_LINEAR_____0_CM 4 0. 255. FORMAT "%3.0" AXIS_PTS_REF ldpm_fmy_envd /end AXIS_DESCR
/end CHARACTERISTIC
/begin CHARACTERISTIC fmy_id_acr_dr.envd "Freeze frame FRF_CUS_SET_SPC: environmental data contents for failure XX" CURVE 0xa0802988 _REC_CUR_20_u1_u1 254. _CNV_A_R_LINEAR_____0_CM 1. 255. DISPLAY_IDENTIFIER ID_ERR_ENVD_ACR_DR FORMAT "%3.0"
 /begin AXIS_DESCR COM_AXIS errm_online_dummy _CNV_A_R_LINEAR_____0_CM 4 0. 255. FORMAT "%3.0" AXIS_PTS_REF ldpm_fmy_envd /end AXIS_DESCR
/end CHARACTERISTIC
/begin CHARACTERISTIC fmy_id_var_cod.envd "Freeze frame FRF_CUS_SET_SPC: environmental data contents for failure XX" CURVE 0xa0804d3c _REC_CUR_20_u1_u1 254. _CNV_A_R_LINEAR_____0_CM 1. 255. DISPLAY_IDENTIFIER ID_ERR_ENVD_VAR_COD FORMAT "%3.0"
 /begin AXIS_DESCR COM_AXIS errm_online_dummy _CNV_A_R_LINEAR_____0_CM 4 0. 255. FORMAT "%3.0" AXIS_PTS_REF ldpm_fmy_envd /end AXIS_DESCR
/end CHARACTERISTIC
/begin CHARACTERISTIC fmy_id_veh_pow_var.envd "Freeze frame FRF_CUS_SET_SPC: environmental data contents for failure XX" CURVE 0xa0804d78 _REC_CUR_20_u1_u1 254. _CNV_A_R_LINEAR_____0_CM 1. 255. DISPLAY_IDENTIFIER ID_ERR_ENVD_VEH_POW_VAR FORMAT "%3.0"
 /begin AXIS_DESCR COM_AXIS errm_online_dummy _CNV_A_R_LINEAR_____0_CM 4 0. 255. FORMAT "%3.0" AXIS_PTS_REF ldpm_fmy_envd /end AXIS_DESCR
/end CHARACTERISTIC
/begin CHARACTERISTIC fmy_id_fup_mfp_plaus.envd "Freeze frame FRF_CUS_SET_SPC: environmental data contents for failure XX" CURVE 0xa0803860 _REC_CUR_20_u1_u1 254. _CNV_A_R_LINEAR_____0_CM 1. 255. DISPLAY_IDENTIFIER ID_ERR_ENVD_FUP_MFP_PLAUS FORMAT "%3.0"
 /begin AXIS_DESCR COM_AXIS errm_online_dummy _CNV_A_R_LINEAR_____0_CM 4 0. 255. FORMAT "%3.0" AXIS_PTS_REF ldpm_fmy_envd /end AXIS_DESCR
/end CHARACTERISTIC
/begin CHARACTERISTIC fmy_id_h_prs_sys.envd "Freeze frame FRF_CUS_SET_SPC: environmental data contents for failure XX" CURVE 0xa0803950 _REC_CUR_20_u1_u1 254. _CNV_A_R_LINEAR_____0_CM 1. 255. DISPLAY_IDENTIFIER ID_ERR_ENVD_H_PRS_SYS FORMAT "%3.0"
 /begin AXIS_DESCR COM_AXIS errm_online_dummy _CNV_A_R_LINEAR_____0_CM 4 0. 255. FORMAT "%3.0" AXIS_PTS_REF ldpm_fmy_envd /end AXIS_DESCR
/end CHARACTERISTIC
/begin CHARACTERISTIC fmy_id_fup_0.envd "Freeze frame FRF_CUS_SET_SPC: environmental data contents for failure XX" CURVE 0xa0803824 _REC_CUR_20_u1_u1 254. _CNV_A_R_LINEAR_____0_CM 1. 255. DISPLAY_IDENTIFIER ID_ERR_ENVD_FUP_0 FORMAT "%3.0"
 /begin AXIS_DESCR COM_AXIS errm_online_dummy _CNV_A_R_LINEAR_____0_CM 4 0. 255. FORMAT "%3.0" AXIS_PTS_REF ldpm_fmy_envd /end AXIS_DESCR
/end CHARACTERISTIC
/begin CHARACTERISTIC fmy_id_fup_1.envd "Freeze frame FRF_CUS_SET_SPC: environmental data contents for failure XX" CURVE 0xa0803838 _REC_CUR_20_u1_u1 254. _CNV_A_R_LINEAR_____0_CM 1. 255. DISPLAY_IDENTIFIER ID_ERR_ENVD_FUP_1 FORMAT "%3.0"
 /begin AXIS_DESCR COM_AXIS errm_online_dummy _CNV_A_R_LINEAR_____0_CM 4 0. 255. FORMAT "%3.0" AXIS_PTS_REF ldpm_fmy_envd /end AXIS_DESCR
/end CHARACTERISTIC
/begin CHARACTERISTIC fmy_id_vcv_fpc_0.envd "Freeze frame FRF_CUS_SET_SPC: environmental data contents for failure XX" CURVE 0xa0804d50 _REC_CUR_20_u1_u1 254. _CNV_A_R_LINEAR_____0_CM 1. 255. DISPLAY_IDENTIFIER ID_ERR_ENVD_VCV_FPC_0 FORMAT "%3.0"
 /begin AXIS_DESCR COM_AXIS errm_online_dummy _CNV_A_R_LINEAR_____0_CM 4 0. 255. FORMAT "%3.0" AXIS_PTS_REF ldpm_fmy_envd /end AXIS_DESCR
/end CHARACTERISTIC
/begin CHARACTERISTIC fmy_id_fup_efp.envd "Freeze frame FRF_CUS_SET_SPC: environmental data contents for failure XX" CURVE 0xa080384c _REC_CUR_20_u1_u1 254. _CNV_A_R_LINEAR_____0_CM 1. 255. DISPLAY_IDENTIFIER ID_ERR_ENVD_FUP_EFP FORMAT "%3.0"
 /begin AXIS_DESCR COM_AXIS errm_online_dummy _CNV_A_R_LINEAR_____0_CM 4 0. 255. FORMAT "%3.0" AXIS_PTS_REF ldpm_fmy_envd /end AXIS_DESCR
/end CHARACTERISTIC
/begin CHARACTERISTIC fmy_id_efppwm_plaus.envd "Freeze frame FRF_CUS_SET_SPC: environmental data contents for failure XX" CURVE 0xa0803658 _REC_CUR_20_u1_u1 254. _CNV_A_R_LINEAR_____0_CM 1. 255. DISPLAY_IDENTIFIER ID_ERR_ENVD_EFPPWM_PLAUS FORMAT "%3.0"
 /begin AXIS_DESCR COM_AXIS errm_online_dummy _CNV_A_R_LINEAR_____0_CM 4 0. 255. FORMAT "%3.0" AXIS_PTS_REF ldpm_fmy_envd /end AXIS_DESCR
/end CHARACTERISTIC
/begin CHARACTERISTIC fmy_id_l_prs_sys.envd "Freeze frame FRF_CUS_SET_SPC: environmental data contents for failure XX" CURVE 0xa0803d74 _REC_CUR_20_u1_u1 254. _CNV_A_R_LINEAR_____0_CM 1. 255. DISPLAY_IDENTIFIER ID_ERR_ENVD_L_PRS_SYS FORMAT "%3.0"
 /begin AXIS_DESCR COM_AXIS errm_online_dummy _CNV_A_R_LINEAR_____0_CM 4 0. 255. FORMAT "%3.0" AXIS_PTS_REF ldpm_fmy_envd /end AXIS_DESCR
/end CHARACTERISTIC
/begin CHARACTERISTIC fmy_id_vcv_fpc_1.envd "Freeze frame FRF_CUS_SET_SPC: environmental data contents for failure XX" CURVE 0xa0804d64 _REC_CUR_20_u1_u1 254. _CNV_A_R_LINEAR_____0_CM 1. 255. DISPLAY_IDENTIFIER ID_ERR_ENVD_VCV_FPC_1 FORMAT "%3.0"
 /begin AXIS_DESCR COM_AXIS errm_online_dummy _CNV_A_R_LINEAR_____0_CM 4 0. 255. FORMAT "%3.0" AXIS_PTS_REF ldpm_fmy_envd /end AXIS_DESCR
/end CHARACTERISTIC
/begin CHARACTERISTIC fmy_id_fsd_1.envd "Freeze frame FRF_CUS_SET_SPC: environmental data contents for failure XX" CURVE 0xa080375c _REC_CUR_20_u1_u1 254. _CNV_A_R_LINEAR_____0_CM 1. 255. DISPLAY_IDENTIFIER ID_ERR_ENVD_FSD_1 FORMAT "%3.0"
 /begin AXIS_DESCR COM_AXIS errm_online_dummy _CNV_A_R_LINEAR_____0_CM 4 0. 255. FORMAT "%3.0" AXIS_PTS_REF ldpm_fmy_envd /end AXIS_DESCR
/end CHARACTERISTIC
/begin CHARACTERISTIC fmy_id_fsd_2.envd "Freeze frame FRF_CUS_SET_SPC: environmental data contents for failure XX" CURVE 0xa0803770 _REC_CUR_20_u1_u1 254. _CNV_A_R_LINEAR_____0_CM 1. 255. DISPLAY_IDENTIFIER ID_ERR_ENVD_FSD_2 FORMAT "%3.0"
 /begin AXIS_DESCR COM_AXIS errm_online_dummy _CNV_A_R_LINEAR_____0_CM 4 0. 255. FORMAT "%3.0" AXIS_PTS_REF ldpm_fmy_envd /end AXIS_DESCR
/end CHARACTERISTIC
/begin CHARACTERISTIC fmy_id_fsd_lam_lim_1.envd "Freeze frame FRF_CUS_SET_SPC: environmental data contents for failure XX" CURVE 0xa08037ac _REC_CUR_20_u1_u1 254. _CNV_A_R_LINEAR_____0_CM 1. 255. DISPLAY_IDENTIFIER ID_ERR_ENVD_FSD_LAM_LIM_1 FORMAT "%3.0"
 /begin AXIS_DESCR COM_AXIS errm_online_dummy _CNV_A_R_LINEAR_____0_CM 4 0. 255. FORMAT "%3.0" AXIS_PTS_REF ldpm_fmy_envd /end AXIS_DESCR
/end CHARACTERISTIC
/begin CHARACTERISTIC fmy_id_fsd_lam_lim_2.envd "Freeze frame FRF_CUS_SET_SPC: environmental data contents for failure XX" CURVE 0xa08037c0 _REC_CUR_20_u1_u1 254. _CNV_A_R_LINEAR_____0_CM 1. 255. DISPLAY_IDENTIFIER ID_ERR_ENVD_FSD_LAM_LIM_2 FORMAT "%3.0"
 /begin AXIS_DESCR COM_AXIS errm_online_dummy _CNV_A_R_LINEAR_____0_CM 4 0. 255. FORMAT "%3.0" AXIS_PTS_REF ldpm_fmy_envd /end AXIS_DESCR
/end CHARACTERISTIC
/begin CHARACTERISTIC fmy_id_fsd_h_rng_1.envd "Freeze frame FRF_CUS_SET_SPC: environmental data contents for failure XX" CURVE 0xa0803784 _REC_CUR_20_u1_u1 254. _CNV_A_R_LINEAR_____0_CM 1. 255. DISPLAY_IDENTIFIER ID_ERR_ENVD_FSD_H_RNG_1 FORMAT "%3.0"
 /begin AXIS_DESCR COM_AXIS errm_online_dummy _CNV_A_R_LINEAR_____0_CM 4 0. 255. FORMAT "%3.0" AXIS_PTS_REF ldpm_fmy_envd /end AXIS_DESCR
/end CHARACTERISTIC
/begin CHARACTERISTIC fmy_id_fsd_h_rng_2.envd "Freeze frame FRF_CUS_SET_SPC: environmental data contents for failure XX" CURVE 0xa0803798 _REC_CUR_20_u1_u1 254. _CNV_A_R_LINEAR_____0_CM 1. 255. DISPLAY_IDENTIFIER ID_ERR_ENVD_FSD_H_RNG_2 FORMAT "%3.0"
 /begin AXIS_DESCR COM_AXIS errm_online_dummy _CNV_A_R_LINEAR_____0_CM 4 0. 255. FORMAT "%3.0" AXIS_PTS_REF ldpm_fmy_envd /end AXIS_DESCR
/end CHARACTERISTIC
/begin CHARACTERISTIC fmy_id_cyl_bal_lam_0.envd "Freeze frame FRF_CUS_SET_SPC: environmental data contents for failure XX" CURVE 0xa080339c _REC_CUR_20_u1_u1 254. _CNV_A_R_LINEAR_____0_CM 1. 255. DISPLAY_IDENTIFIER ID_ERR_ENVD_CYL_BAL_LAM_0 FORMAT "%3.0"
 /begin AXIS_DESCR COM_AXIS errm_online_dummy _CNV_A_R_LINEAR_____0_CM 4 0. 255. FORMAT "%3.0" AXIS_PTS_REF ldpm_fmy_envd /end AXIS_DESCR
/end CHARACTERISTIC
/begin CHARACTERISTIC fmy_id_cyl_bal_lam_1.envd "Freeze frame FRF_CUS_SET_SPC: environmental data contents for failure XX" CURVE 0xa08033b0 _REC_CUR_20_u1_u1 254. _CNV_A_R_LINEAR_____0_CM 1. 255. DISPLAY_IDENTIFIER ID_ERR_ENVD_CYL_BAL_LAM_1 FORMAT "%3.0"
 /begin AXIS_DESCR COM_AXIS errm_online_dummy _CNV_A_R_LINEAR_____0_CM 4 0. 255. FORMAT "%3.0" AXIS_PTS_REF ldpm_fmy_envd /end AXIS_DESCR
/end CHARACTERISTIC
/begin CHARACTERISTIC fmy_id_cyl_bal_lam_2.envd "Freeze frame FRF_CUS_SET_SPC: environmental data contents for failure XX" CURVE 0xa08033c4 _REC_CUR_20_u1_u1 254. _CNV_A_R_LINEAR_____0_CM 1. 255. DISPLAY_IDENTIFIER ID_ERR_ENVD_CYL_BAL_LAM_2 FORMAT "%3.0"
 /begin AXIS_DESCR COM_AXIS errm_online_dummy _CNV_A_R_LINEAR_____0_CM 4 0. 255. FORMAT "%3.0" AXIS_PTS_REF ldpm_fmy_envd /end AXIS_DESCR
/end CHARACTERISTIC
/begin CHARACTERISTIC fmy_id_cyl_bal_lam_3.envd "Freeze frame FRF_CUS_SET_SPC: environmental data contents for failure XX" CURVE 0xa08033d8 _REC_CUR_20_u1_u1 254. _CNV_A_R_LINEAR_____0_CM 1. 255. DISPLAY_IDENTIFIER ID_ERR_ENVD_CYL_BAL_LAM_3 FORMAT "%3.0"
 /begin AXIS_DESCR COM_AXIS errm_online_dummy _CNV_A_R_LINEAR_____0_CM 4 0. 255. FORMAT "%3.0" AXIS_PTS_REF ldpm_fmy_envd /end AXIS_DESCR
/end CHARACTERISTIC
/begin CHARACTERISTIC fmy_id_cyl_bal_lam_4.envd "Freeze frame FRF_CUS_SET_SPC: environmental data contents for failure XX" CURVE 0xa08033ec _REC_CUR_20_u1_u1 254. _CNV_A_R_LINEAR_____0_CM 1. 255. DISPLAY_IDENTIFIER ID_ERR_ENVD_CYL_BAL_LAM_4 FORMAT "%3.0"
 /begin AXIS_DESCR COM_AXIS errm_online_dummy _CNV_A_R_LINEAR_____0_CM 4 0. 255. FORMAT "%3.0" AXIS_PTS_REF ldpm_fmy_envd /end AXIS_DESCR
/end CHARACTERISTIC
/begin CHARACTERISTIC fmy_id_cyl_bal_lam_5.envd "Freeze frame FRF_CUS_SET_SPC: environmental data contents for failure XX" CURVE 0xa0803400 _REC_CUR_20_u1_u1 254. _CNV_A_R_LINEAR_____0_CM 1. 255. DISPLAY_IDENTIFIER ID_ERR_ENVD_CYL_BAL_LAM_5 FORMAT "%3.0"
 /begin AXIS_DESCR COM_AXIS errm_online_dummy _CNV_A_R_LINEAR_____0_CM 4 0. 255. FORMAT "%3.0" AXIS_PTS_REF ldpm_fmy_envd /end AXIS_DESCR
/end CHARACTERISTIC
/begin CHARACTERISTIC fmy_id_cyl_bal_lam_6.envd "Freeze frame FRF_CUS_SET_SPC: environmental data contents for failure XX" CURVE 0xa0803414 _REC_CUR_20_u1_u1 254. _CNV_A_R_LINEAR_____0_CM 1. 255. DISPLAY_IDENTIFIER ID_ERR_ENVD_CYL_BAL_LAM_6 FORMAT "%3.0"
 /begin AXIS_DESCR COM_AXIS errm_online_dummy _CNV_A_R_LINEAR_____0_CM 4 0. 255. FORMAT "%3.0" AXIS_PTS_REF ldpm_fmy_envd /end AXIS_DESCR
/end CHARACTERISTIC
/begin CHARACTERISTIC fmy_id_cyl_bal_lam_7.envd "Freeze frame FRF_CUS_SET_SPC: environmental data contents for failure XX" CURVE 0xa0803428 _REC_CUR_20_u1_u1 254. _CNV_A_R_LINEAR_____0_CM 1. 255. DISPLAY_IDENTIFIER ID_ERR_ENVD_CYL_BAL_LAM_7 FORMAT "%3.0"
 /begin AXIS_DESCR COM_AXIS errm_online_dummy _CNV_A_R_LINEAR_____0_CM 4 0. 255. FORMAT "%3.0" AXIS_PTS_REF ldpm_fmy_envd /end AXIS_DESCR
/end CHARACTERISTIC
/begin CHARACTERISTIC fmy_id_cyl_bal_er_0.envd "Freeze frame FRF_CUS_SET_SPC: environmental data contents for failure XX" CURVE 0xa08032fc _REC_CUR_20_u1_u1 254. _CNV_A_R_LINEAR_____0_CM 1. 255. DISPLAY_IDENTIFIER ID_ERR_ENVD_CYL_BAL_ER_0 FORMAT "%3.0"
 /begin AXIS_DESCR COM_AXIS errm_online_dummy _CNV_A_R_LINEAR_____0_CM 4 0. 255. FORMAT "%3.0" AXIS_PTS_REF ldpm_fmy_envd /end AXIS_DESCR
/end CHARACTERISTIC
/begin CHARACTERISTIC fmy_id_cyl_bal_er_1.envd "Freeze frame FRF_CUS_SET_SPC: environmental data contents for failure XX" CURVE 0xa0803310 _REC_CUR_20_u1_u1 254. _CNV_A_R_LINEAR_____0_CM 1. 255. DISPLAY_IDENTIFIER ID_ERR_ENVD_CYL_BAL_ER_1 FORMAT "%3.0"
 /begin AXIS_DESCR COM_AXIS errm_online_dummy _CNV_A_R_LINEAR_____0_CM 4 0. 255. FORMAT "%3.0" AXIS_PTS_REF ldpm_fmy_envd /end AXIS_DESCR
/end CHARACTERISTIC
/begin CHARACTERISTIC fmy_id_cyl_bal_er_2.envd "Freeze frame FRF_CUS_SET_SPC: environmental data contents for failure XX" CURVE 0xa0803324 _REC_CUR_20_u1_u1 254. _CNV_A_R_LINEAR_____0_CM 1. 255. DISPLAY_IDENTIFIER ID_ERR_ENVD_CYL_BAL_ER_2 FORMAT "%3.0"
 /begin AXIS_DESCR COM_AXIS errm_online_dummy _CNV_A_R_LINEAR_____0_CM 4 0. 255. FORMAT "%3.0" AXIS_PTS_REF ldpm_fmy_envd /end AXIS_DESCR
/end CHARACTERISTIC
/begin CHARACTERISTIC fmy_id_cyl_bal_er_3.envd "Freeze frame FRF_CUS_SET_SPC: environmental data contents for failure XX" CURVE 0xa0803338 _REC_CUR_20_u1_u1 254. _CNV_A_R_LINEAR_____0_CM 1. 255. DISPLAY_IDENTIFIER ID_ERR_ENVD_CYL_BAL_ER_3 FORMAT "%3.0"
 /begin AXIS_DESCR COM_AXIS errm_online_dummy _CNV_A_R_LINEAR_____0_CM 4 0. 255. FORMAT "%3.0" AXIS_PTS_REF ldpm_fmy_envd /end AXIS_DESCR
/end CHARACTERISTIC
/begin CHARACTERISTIC fmy_id_cyl_bal_er_4.envd "Freeze frame FRF_CUS_SET_SPC: environmental data contents for failure XX" CURVE 0xa080334c _REC_CUR_20_u1_u1 254. _CNV_A_R_LINEAR_____0_CM 1. 255. DISPLAY_IDENTIFIER ID_ERR_ENVD_CYL_BAL_ER_4 FORMAT "%3.0"
 /begin AXIS_DESCR COM_AXIS errm_online_dummy _CNV_A_R_LINEAR_____0_CM 4 0. 255. FORMAT "%3.0" AXIS_PTS_REF ldpm_fmy_envd /end AXIS_DESCR
/end CHARACTERISTIC
/begin CHARACTERISTIC fmy_id_cyl_bal_er_5.envd "Freeze frame FRF_CUS_SET_SPC: environmental data contents for failure XX" CURVE 0xa0803360 _REC_CUR_20_u1_u1 254. _CNV_A_R_LINEAR_____0_CM 1. 255. DISPLAY_IDENTIFIER ID_ERR_ENVD_CYL_BAL_ER_5 FORMAT "%3.0"
 /begin AXIS_DESCR COM_AXIS errm_online_dummy _CNV_A_R_LINEAR_____0_CM 4 0. 255. FORMAT "%3.0" AXIS_PTS_REF ldpm_fmy_envd /end AXIS_DESCR
/end CHARACTERISTIC
/begin CHARACTERISTIC fmy_id_cyl_bal_er_6.envd "Freeze frame FRF_CUS_SET_SPC: environmental data contents for failure XX" CURVE 0xa0803374 _REC_CUR_20_u1_u1 254. _CNV_A_R_LINEAR_____0_CM 1. 255. DISPLAY_IDENTIFIER ID_ERR_ENVD_CYL_BAL_ER_6 FORMAT "%3.0"
 /begin AXIS_DESCR COM_AXIS errm_online_dummy _CNV_A_R_LINEAR_____0_CM 4 0. 255. FORMAT "%3.0" AXIS_PTS_REF ldpm_fmy_envd /end AXIS_DESCR
/end CHARACTERISTIC
/begin CHARACTERISTIC fmy_id_cyl_bal_er_7.envd "Freeze frame FRF_CUS_SET_SPC: environmental data contents for failure XX" CURVE 0xa0803388 _REC_CUR_20_u1_u1 254. _CNV_A_R_LINEAR_____0_CM 1. 255. DISPLAY_IDENTIFIER ID_ERR_ENVD_CYL_BAL_ER_7 FORMAT "%3.0"
 /begin AXIS_DESCR COM_AXIS errm_online_dummy _CNV_A_R_LINEAR_____0_CM 4 0. 255. FORMAT "%3.0" AXIS_PTS_REF ldpm_fmy_envd /end AXIS_DESCR
/end CHARACTERISTIC
/begin CHARACTERISTIC fmy_id_mon_3.envd "Freeze frame FRF_CUS_SET_SPC: environmental data contents for failure XX" CURVE 0xa0804080 _REC_CUR_20_u1_u1 254. _CNV_A_R_LINEAR_____0_CM 1. 255. DISPLAY_IDENTIFIER ID_ERR_ENVD_MON_3 FORMAT "%3.0"
 /begin AXIS_DESCR COM_AXIS errm_online_dummy _CNV_A_R_LINEAR_____0_CM 4 0. 255. FORMAT "%3.0" AXIS_PTS_REF ldpm_fmy_envd /end AXIS_DESCR
/end CHARACTERISTIC
/begin CHARACTERISTIC fmy_id_maf_frq_rng_0.envd "Freeze frame FRF_CUS_SET_SPC: environmental data contents for failure XX" CURVE 0xa0803ec8 _REC_CUR_20_u1_u1 254. _CNV_A_R_LINEAR_____0_CM 1. 255. DISPLAY_IDENTIFIER ID_ERR_ENVD_MAF_FRQ_RNG_0 FORMAT "%3.0"
 /begin AXIS_DESCR COM_AXIS errm_online_dummy _CNV_A_R_LINEAR_____0_CM 4 0. 255. FORMAT "%3.0" AXIS_PTS_REF ldpm_fmy_envd /end AXIS_DESCR
/end CHARACTERISTIC
/begin CHARACTERISTIC fmy_id_maf_frq_grd_0.envd "Freeze frame FRF_CUS_SET_SPC: environmental data contents for failure XX" CURVE 0xa0803ea0 _REC_CUR_20_u1_u1 254. _CNV_A_R_LINEAR_____0_CM 1. 255. DISPLAY_IDENTIFIER ID_ERR_ENVD_MAF_FRQ_GRD_0 FORMAT "%3.0"
 /begin AXIS_DESCR COM_AXIS errm_online_dummy _CNV_A_R_LINEAR_____0_CM 4 0. 255. FORMAT "%3.0" AXIS_PTS_REF ldpm_fmy_envd /end AXIS_DESCR
/end CHARACTERISTIC
/begin CHARACTERISTIC fmy_id_maf_frq_el_0.envd "Freeze frame FRF_CUS_SET_SPC: environmental data contents for failure XX" CURVE 0xa0803e78 _REC_CUR_20_u1_u1 254. _CNV_A_R_LINEAR_____0_CM 1. 255. DISPLAY_IDENTIFIER ID_ERR_ENVD_MAF_FRQ_EL_0 FORMAT "%3.0"
 /begin AXIS_DESCR COM_AXIS errm_online_dummy _CNV_A_R_LINEAR_____0_CM 4 0. 255. FORMAT "%3.0" AXIS_PTS_REF ldpm_fmy_envd /end AXIS_DESCR
/end CHARACTERISTIC
/begin CHARACTERISTIC fmy_id_maf_frq_rng_1.envd "Freeze frame FRF_CUS_SET_SPC: environmental data contents for failure XX" CURVE 0xa0803edc _REC_CUR_20_u1_u1 254. _CNV_A_R_LINEAR_____0_CM 1. 255. DISPLAY_IDENTIFIER ID_ERR_ENVD_MAF_FRQ_RNG_1 FORMAT "%3.0"
 /begin AXIS_DESCR COM_AXIS errm_online_dummy _CNV_A_R_LINEAR_____0_CM 4 0. 255. FORMAT "%3.0" AXIS_PTS_REF ldpm_fmy_envd /end AXIS_DESCR
/end CHARACTERISTIC
/begin CHARACTERISTIC fmy_id_maf_frq_grd_1.envd "Freeze frame FRF_CUS_SET_SPC: environmental data contents for failure XX" CURVE 0xa0803eb4 _REC_CUR_20_u1_u1 254. _CNV_A_R_LINEAR_____0_CM 1. 255. DISPLAY_IDENTIFIER ID_ERR_ENVD_MAF_FRQ_GRD_1 FORMAT "%3.0"
 /begin AXIS_DESCR COM_AXIS errm_online_dummy _CNV_A_R_LINEAR_____0_CM 4 0. 255. FORMAT "%3.0" AXIS_PTS_REF ldpm_fmy_envd /end AXIS_DESCR
/end CHARACTERISTIC
/begin CHARACTERISTIC fmy_id_maf_frq_el_1.envd "Freeze frame FRF_CUS_SET_SPC: environmental data contents for failure XX" CURVE 0xa0803e8c _REC_CUR_20_u1_u1 254. _CNV_A_R_LINEAR_____0_CM 1. 255. DISPLAY_IDENTIFIER ID_ERR_ENVD_MAF_FRQ_EL_1 FORMAT "%3.0"
 /begin AXIS_DESCR COM_AXIS errm_online_dummy _CNV_A_R_LINEAR_____0_CM 4 0. 255. FORMAT "%3.0" AXIS_PTS_REF ldpm_fmy_envd /end AXIS_DESCR
/end CHARACTERISTIC
/begin CHARACTERISTIC fmy_id_tps_1_1.envd "Freeze frame FRF_CUS_SET_SPC: environmental data contents for failure XX" CURVE 0xa0804b0c _REC_CUR_20_u1_u1 254. _CNV_A_R_LINEAR_____0_CM 1. 255. DISPLAY_IDENTIFIER ID_ERR_ENVD_TPS_1_1 FORMAT "%3.0"
 /begin AXIS_DESCR COM_AXIS errm_online_dummy _CNV_A_R_LINEAR_____0_CM 4 0. 255. FORMAT "%3.0" AXIS_PTS_REF ldpm_fmy_envd /end AXIS_DESCR
/end CHARACTERISTIC
/begin CHARACTERISTIC fmy_id_tps_1_2.envd "Freeze frame FRF_CUS_SET_SPC: environmental data contents for failure XX" CURVE 0xa0804b20 _REC_CUR_20_u1_u1 254. _CNV_A_R_LINEAR_____0_CM 1. 255. DISPLAY_IDENTIFIER ID_ERR_ENVD_TPS_1_2 FORMAT "%3.0"
 /begin AXIS_DESCR COM_AXIS errm_online_dummy _CNV_A_R_LINEAR_____0_CM 4 0. 255. FORMAT "%3.0" AXIS_PTS_REF ldpm_fmy_envd /end AXIS_DESCR
/end CHARACTERISTIC
/begin CHARACTERISTIC fmy_id_tps_2_1.envd "Freeze frame FRF_CUS_SET_SPC: environmental data contents for failure XX" CURVE 0xa0804b34 _REC_CUR_20_u1_u1 254. _CNV_A_R_LINEAR_____0_CM 1. 255. DISPLAY_IDENTIFIER ID_ERR_ENVD_TPS_2_1 FORMAT "%3.0"
 /begin AXIS_DESCR COM_AXIS errm_online_dummy _CNV_A_R_LINEAR_____0_CM 4 0. 255. FORMAT "%3.0" AXIS_PTS_REF ldpm_fmy_envd /end AXIS_DESCR
/end CHARACTERISTIC
/begin CHARACTERISTIC fmy_id_tps_2_2.envd "Freeze frame FRF_CUS_SET_SPC: environmental data contents for failure XX" CURVE 0xa0804b48 _REC_CUR_20_u1_u1 254. _CNV_A_R_LINEAR_____0_CM 1. 255. DISPLAY_IDENTIFIER ID_ERR_ENVD_TPS_2_2 FORMAT "%3.0"
 /begin AXIS_DESCR COM_AXIS errm_online_dummy _CNV_A_R_LINEAR_____0_CM 4 0. 255. FORMAT "%3.0" AXIS_PTS_REF ldpm_fmy_envd /end AXIS_DESCR
/end CHARACTERISTIC
/begin CHARACTERISTIC fmy_id_tps_maf_1_1.envd "Freeze frame FRF_CUS_SET_SPC: environmental data contents for failure XX" CURVE 0xa0804bac _REC_CUR_20_u1_u1 254. _CNV_A_R_LINEAR_____0_CM 1. 255. DISPLAY_IDENTIFIER ID_ERR_ENVD_TPS_MAF_1_1 FORMAT "%3.0"
 /begin AXIS_DESCR COM_AXIS errm_online_dummy _CNV_A_R_LINEAR_____0_CM 4 0. 255. FORMAT "%3.0" AXIS_PTS_REF ldpm_fmy_envd /end AXIS_DESCR
/end CHARACTERISTIC
/begin CHARACTERISTIC fmy_id_tps_maf_1_2.envd "Freeze frame FRF_CUS_SET_SPC: environmental data contents for failure XX" CURVE 0xa0804bc0 _REC_CUR_20_u1_u1 254. _CNV_A_R_LINEAR_____0_CM 1. 255. DISPLAY_IDENTIFIER ID_ERR_ENVD_TPS_MAF_1_2 FORMAT "%3.0"
 /begin AXIS_DESCR COM_AXIS errm_online_dummy _CNV_A_R_LINEAR_____0_CM 4 0. 255. FORMAT "%3.0" AXIS_PTS_REF ldpm_fmy_envd /end AXIS_DESCR
/end CHARACTERISTIC
/begin CHARACTERISTIC fmy_id_tps_maf_2_1.envd "Freeze frame FRF_CUS_SET_SPC: environmental data contents for failure XX" CURVE 0xa0804bd4 _REC_CUR_20_u1_u1 254. _CNV_A_R_LINEAR_____0_CM 1. 255. DISPLAY_IDENTIFIER ID_ERR_ENVD_TPS_MAF_2_1 FORMAT "%3.0"
 /begin AXIS_DESCR COM_AXIS errm_online_dummy _CNV_A_R_LINEAR_____0_CM 4 0. 255. FORMAT "%3.0" AXIS_PTS_REF ldpm_fmy_envd /end AXIS_DESCR
/end CHARACTERISTIC
/begin CHARACTERISTIC fmy_id_tps_maf_2_2.envd "Freeze frame FRF_CUS_SET_SPC: environmental data contents for failure XX" CURVE 0xa0804be8 _REC_CUR_20_u1_u1 254. _CNV_A_R_LINEAR_____0_CM 1. 255. DISPLAY_IDENTIFIER ID_ERR_ENVD_TPS_MAF_2_2 FORMAT "%3.0"
 /begin AXIS_DESCR COM_AXIS errm_online_dummy _CNV_A_R_LINEAR_____0_CM 4 0. 255. FORMAT "%3.0" AXIS_PTS_REF ldpm_fmy_envd /end AXIS_DESCR
/end CHARACTERISTIC
/begin CHARACTERISTIC fmy_id_tps_ratio_1.envd "Freeze frame FRF_CUS_SET_SPC: environmental data contents for failure XX" CURVE 0xa0804bfc _REC_CUR_20_u1_u1 254. _CNV_A_R_LINEAR_____0_CM 1. 255. DISPLAY_IDENTIFIER ID_ERR_ENVD_TPS_RATIO_1 FORMAT "%3.0"
 /begin AXIS_DESCR COM_AXIS errm_online_dummy _CNV_A_R_LINEAR_____0_CM 4 0. 255. FORMAT "%3.0" AXIS_PTS_REF ldpm_fmy_envd /end AXIS_DESCR
/end CHARACTERISTIC
/begin CHARACTERISTIC fmy_id_tps_ratio_2.envd "Freeze frame FRF_CUS_SET_SPC: environmental data contents for failure XX" CURVE 0xa0804c10 _REC_CUR_20_u1_u1 254. _CNV_A_R_LINEAR_____0_CM 1. 255. DISPLAY_IDENTIFIER ID_ERR_ENVD_TPS_RATIO_2 FORMAT "%3.0"
 /begin AXIS_DESCR COM_AXIS errm_online_dummy _CNV_A_R_LINEAR_____0_CM 4 0. 255. FORMAT "%3.0" AXIS_PTS_REF ldpm_fmy_envd /end AXIS_DESCR
/end CHARACTERISTIC
/begin CHARACTERISTIC fmy_id_tps_ad_1.envd "Freeze frame FRF_CUS_SET_SPC: environmental data contents for failure XX" CURVE 0xa0804b5c _REC_CUR_20_u1_u1 254. _CNV_A_R_LINEAR_____0_CM 1. 255. DISPLAY_IDENTIFIER ID_ERR_ENVD_TPS_AD_1 FORMAT "%3.0"
 /begin AXIS_DESCR COM_AXIS errm_online_dummy _CNV_A_R_LINEAR_____0_CM 4 0. 255. FORMAT "%3.0" AXIS_PTS_REF ldpm_fmy_envd /end AXIS_DESCR
/end CHARACTERISTIC
/begin CHARACTERISTIC fmy_id_tps_ad_2.envd "Freeze frame FRF_CUS_SET_SPC: environmental data contents for failure XX" CURVE 0xa0804b70 _REC_CUR_20_u1_u1 254. _CNV_A_R_LINEAR_____0_CM 1. 255. DISPLAY_IDENTIFIER ID_ERR_ENVD_TPS_AD_2 FORMAT "%3.0"
 /begin AXIS_DESCR COM_AXIS errm_online_dummy _CNV_A_R_LINEAR_____0_CM 4 0. 255. FORMAT "%3.0" AXIS_PTS_REF ldpm_fmy_envd /end AXIS_DESCR
/end CHARACTERISTIC
/begin CHARACTERISTIC fmy_id_etc_pwm_1.envd "Freeze frame FRF_CUS_SET_SPC: environmental data contents for failure XX" CURVE 0xa080370c _REC_CUR_20_u1_u1 254. _CNV_A_R_LINEAR_____0_CM 1. 255. DISPLAY_IDENTIFIER ID_ERR_ENVD_ETC_PWM_1 FORMAT "%3.0"
 /begin AXIS_DESCR COM_AXIS errm_online_dummy _CNV_A_R_LINEAR_____0_CM 4 0. 255. FORMAT "%3.0" AXIS_PTS_REF ldpm_fmy_envd /end AXIS_DESCR
/end CHARACTERISTIC
/begin CHARACTERISTIC fmy_id_etc_pwm_2.envd "Freeze frame FRF_CUS_SET_SPC: environmental data contents for failure XX" CURVE 0xa0803720 _REC_CUR_20_u1_u1 254. _CNV_A_R_LINEAR_____0_CM 1. 255. DISPLAY_IDENTIFIER ID_ERR_ENVD_ETC_PWM_2 FORMAT "%3.0"
 /begin AXIS_DESCR COM_AXIS errm_online_dummy _CNV_A_R_LINEAR_____0_CM 4 0. 255. FORMAT "%3.0" AXIS_PTS_REF ldpm_fmy_envd /end AXIS_DESCR
/end CHARACTERISTIC
/begin CHARACTERISTIC fmy_id_etc_ctl_1.envd "Freeze frame FRF_CUS_SET_SPC: environmental data contents for failure XX" CURVE 0xa08036bc _REC_CUR_20_u1_u1 254. _CNV_A_R_LINEAR_____0_CM 1. 255. DISPLAY_IDENTIFIER ID_ERR_ENVD_ETC_CTL_1 FORMAT "%3.0"
 /begin AXIS_DESCR COM_AXIS errm_online_dummy _CNV_A_R_LINEAR_____0_CM 4 0. 255. FORMAT "%3.0" AXIS_PTS_REF ldpm_fmy_envd /end AXIS_DESCR
/end CHARACTERISTIC
/begin CHARACTERISTIC fmy_id_etc_ctl_2.envd "Freeze frame FRF_CUS_SET_SPC: environmental data contents for failure XX" CURVE 0xa08036d0 _REC_CUR_20_u1_u1 254. _CNV_A_R_LINEAR_____0_CM 1. 255. DISPLAY_IDENTIFIER ID_ERR_ENVD_ETC_CTL_2 FORMAT "%3.0"
 /begin AXIS_DESCR COM_AXIS errm_online_dummy _CNV_A_R_LINEAR_____0_CM 4 0. 255. FORMAT "%3.0" AXIS_PTS_REF ldpm_fmy_envd /end AXIS_DESCR
/end CHARACTERISTIC
/begin CHARACTERISTIC fmy_id_tps_ad_spr_1.envd "Freeze frame FRF_CUS_SET_SPC: environmental data contents for failure XX" CURVE 0xa0804b84 _REC_CUR_20_u1_u1 254. _CNV_A_R_LINEAR_____0_CM 1. 255. DISPLAY_IDENTIFIER ID_ERR_ENVD_TPS_AD_SPR_1 FORMAT "%3.0"
 /begin AXIS_DESCR COM_AXIS errm_online_dummy _CNV_A_R_LINEAR_____0_CM 4 0. 255. FORMAT "%3.0" AXIS_PTS_REF ldpm_fmy_envd /end AXIS_DESCR
/end CHARACTERISTIC
/begin CHARACTERISTIC fmy_id_tps_ad_spr_2.envd "Freeze frame FRF_CUS_SET_SPC: environmental data contents for failure XX" CURVE 0xa0804b98 _REC_CUR_20_u1_u1 254. _CNV_A_R_LINEAR_____0_CM 1. 255. DISPLAY_IDENTIFIER ID_ERR_ENVD_TPS_AD_SPR_2 FORMAT "%3.0"
 /begin AXIS_DESCR COM_AXIS errm_online_dummy _CNV_A_R_LINEAR_____0_CM 4 0. 255. FORMAT "%3.0" AXIS_PTS_REF ldpm_fmy_envd /end AXIS_DESCR
/end CHARACTERISTIC
/begin CHARACTERISTIC fmy_id_etc_dr_1.envd "Freeze frame FRF_CUS_SET_SPC: environmental data contents for failure XX" CURVE 0xa08036e4 _REC_CUR_20_u1_u1 254. _CNV_A_R_LINEAR_____0_CM 1. 255. DISPLAY_IDENTIFIER ID_ERR_ENVD_ETC_DR_1 FORMAT "%3.0"
 /begin AXIS_DESCR COM_AXIS errm_online_dummy _CNV_A_R_LINEAR_____0_CM 4 0. 255. FORMAT "%3.0" AXIS_PTS_REF ldpm_fmy_envd /end AXIS_DESCR
/end CHARACTERISTIC
/begin CHARACTERISTIC fmy_id_etc_dr_2.envd "Freeze frame FRF_CUS_SET_SPC: environmental data contents for failure XX" CURVE 0xa08036f8 _REC_CUR_20_u1_u1 254. _CNV_A_R_LINEAR_____0_CM 1. 255. DISPLAY_IDENTIFIER ID_ERR_ENVD_ETC_DR_2 FORMAT "%3.0"
 /begin AXIS_DESCR COM_AXIS errm_online_dummy _CNV_A_R_LINEAR_____0_CM 4 0. 255. FORMAT "%3.0" AXIS_PTS_REF ldpm_fmy_envd /end AXIS_DESCR
/end CHARACTERISTIC
/begin CHARACTERISTIC fmy_id_tps_st_chk_1.envd "Freeze frame FRF_CUS_SET_SPC: environmental data contents for failure XX" CURVE 0xa0804c24 _REC_CUR_20_u1_u1 254. _CNV_A_R_LINEAR_____0_CM 1. 255. DISPLAY_IDENTIFIER ID_ERR_ENVD_TPS_ST_CHK_1 FORMAT "%3.0"
 /begin AXIS_DESCR COM_AXIS errm_online_dummy _CNV_A_R_LINEAR_____0_CM 4 0. 255. FORMAT "%3.0" AXIS_PTS_REF ldpm_fmy_envd /end AXIS_DESCR
/end CHARACTERISTIC
/begin CHARACTERISTIC fmy_id_tps_st_chk_2.envd "Freeze frame FRF_CUS_SET_SPC: environmental data contents for failure XX" CURVE 0xa0804c38 _REC_CUR_20_u1_u1 254. _CNV_A_R_LINEAR_____0_CM 1. 255. DISPLAY_IDENTIFIER ID_ERR_ENVD_TPS_ST_CHK_2 FORMAT "%3.0"
 /begin AXIS_DESCR COM_AXIS errm_online_dummy _CNV_A_R_LINEAR_____0_CM 4 0. 255. FORMAT "%3.0" AXIS_PTS_REF ldpm_fmy_envd /end AXIS_DESCR
/end CHARACTERISTIC
/begin CHARACTERISTIC fmy_id_com_1_tq_loss_cord.envd "Freeze frame FRF_CUS_SET_SPC: environmental data contents for failure XX" CURVE 0xa0802eec _REC_CUR_20_u1_u1 254. _CNV_A_R_LINEAR_____0_CM 1. 255. DISPLAY_IDENTIFIER ID_ERR_ENVD_COM_1_TQ_LOSS_CORD FORMAT "%3.0"
 /begin AXIS_DESCR COM_AXIS errm_online_dummy _CNV_A_R_LINEAR_____0_CM 4 0. 255. FORMAT "%3.0" AXIS_PTS_REF ldpm_fmy_envd /end AXIS_DESCR
/end CHARACTERISTIC
/begin CHARACTERISTIC fmy_id_com_1_swi_gear.envd "Freeze frame FRF_CUS_SET_SPC: environmental data contents for failure XX" CURVE 0xa0802e9c _REC_CUR_20_u1_u1 254. _CNV_A_R_LINEAR_____0_CM 1. 255. DISPLAY_IDENTIFIER ID_ERR_ENVD_COM_1_SWI_GEAR FORMAT "%3.0"
 /begin AXIS_DESCR COM_AXIS errm_online_dummy _CNV_A_R_LINEAR_____0_CM 4 0. 255. FORMAT "%3.0" AXIS_PTS_REF ldpm_fmy_envd /end AXIS_DESCR
/end CHARACTERISTIC
/begin CHARACTERISTIC fmy_id_com_1_veh_mod.envd "Freeze frame FRF_CUS_SET_SPC: environmental data contents for failure XX" CURVE 0xa0802f3c _REC_CUR_20_u1_u1 254. _CNV_A_R_LINEAR_____0_CM 1. 255. DISPLAY_IDENTIFIER ID_ERR_ENVD_COM_1_VEH_MOD FORMAT "%3.0"
 /begin AXIS_DESCR COM_AXIS errm_online_dummy _CNV_A_R_LINEAR_____0_CM 4 0. 255. FORMAT "%3.0" AXIS_PTS_REF ldpm_fmy_envd /end AXIS_DESCR
/end CHARACTERISTIC
/begin CHARACTERISTIC fmy_id_com_1_brake_tcs.envd "Freeze frame FRF_CUS_SET_SPC: environmental data contents for failure XX" CURVE 0xa0802e74 _REC_CUR_20_u1_u1 254. _CNV_A_R_LINEAR_____0_CM 1. 255. DISPLAY_IDENTIFIER ID_ERR_ENVD_COM_1_BRAKE_TCS FORMAT "%3.0"
 /begin AXIS_DESCR COM_AXIS errm_online_dummy _CNV_A_R_LINEAR_____0_CM 4 0. 255. FORMAT "%3.0" AXIS_PTS_REF ldpm_fmy_envd /end AXIS_DESCR
/end CHARACTERISTIC
/begin CHARACTERISTIC fmy_id_com_1_tq_driv_asi.envd "Freeze frame FRF_CUS_SET_SPC: environmental data contents for failure XX" CURVE 0xa0802ed8 _REC_CUR_20_u1_u1 254. _CNV_A_R_LINEAR_____0_CM 1. 255. DISPLAY_IDENTIFIER ID_ERR_ENVD_COM_1_TQ_DRIV_ASI FORMAT "%3.0"
 /begin AXIS_DESCR COM_AXIS errm_online_dummy _CNV_A_R_LINEAR_____0_CM 4 0. 255. FORMAT "%3.0" AXIS_PTS_REF ldpm_fmy_envd /end AXIS_DESCR
/end CHARACTERISTIC
/begin CHARACTERISTIC fmy_id_com_1_tq_tcs.envd "Freeze frame FRF_CUS_SET_SPC: environmental data contents for failure XX" CURVE 0xa0802f14 _REC_CUR_20_u1_u1 254. _CNV_A_R_LINEAR_____0_CM 1. 255. DISPLAY_IDENTIFIER ID_ERR_ENVD_COM_1_TQ_TCS FORMAT "%3.0"
 /begin AXIS_DESCR COM_AXIS errm_online_dummy _CNV_A_R_LINEAR_____0_CM 4 0. 255. FORMAT "%3.0" AXIS_PTS_REF ldpm_fmy_envd /end AXIS_DESCR
/end CHARACTERISTIC
/begin CHARACTERISTIC fmy_id_com_1_tqb_tcs.envd "Freeze frame FRF_CUS_SET_SPC: environmental data contents for failure XX" CURVE 0xa0802f28 _REC_CUR_20_u1_u1 254. _CNV_A_R_LINEAR_____0_CM 1. 255. DISPLAY_IDENTIFIER ID_ERR_ENVD_COM_1_TQB_TCS FORMAT "%3.0"
 /begin AXIS_DESCR COM_AXIS errm_online_dummy _CNV_A_R_LINEAR_____0_CM 4 0. 255. FORMAT "%3.0" AXIS_PTS_REF ldpm_fmy_envd /end AXIS_DESCR
/end CHARACTERISTIC
/begin CHARACTERISTIC fmy_id_com_1_wheel_tcs.envd "Freeze frame FRF_CUS_SET_SPC: environmental data contents for failure XX" CURVE 0xa0802f64 _REC_CUR_20_u1_u1 254. _CNV_A_R_LINEAR_____0_CM 1. 255. DISPLAY_IDENTIFIER ID_ERR_ENVD_COM_1_WHEEL_TCS FORMAT "%3.0"
 /begin AXIS_DESCR COM_AXIS errm_online_dummy _CNV_A_R_LINEAR_____0_CM 4 0. 255. FORMAT "%3.0" AXIS_PTS_REF ldpm_fmy_envd /end AXIS_DESCR
/end CHARACTERISTIC
/begin CHARACTERISTIC fmy_id_com_1_req_tqdw.envd "Freeze frame FRF_CUS_SET_SPC: environmental data contents for failure XX" CURVE 0xa0802e88 _REC_CUR_20_u1_u1 254. _CNV_A_R_LINEAR_____0_CM 1. 255. DISPLAY_IDENTIFIER ID_ERR_ENVD_COM_1_REQ_TQDW FORMAT "%3.0"
 /begin AXIS_DESCR COM_AXIS errm_online_dummy _CNV_A_R_LINEAR_____0_CM 4 0. 255. FORMAT "%3.0" AXIS_PTS_REF ldpm_fmy_envd /end AXIS_DESCR
/end CHARACTERISTIC
/begin CHARACTERISTIC fmy_id_com_1_tq_pste.envd "Freeze frame FRF_CUS_SET_SPC: environmental data contents for failure XX" CURVE 0xa0802f00 _REC_CUR_20_u1_u1 254. _CNV_A_R_LINEAR_____0_CM 1. 255. DISPLAY_IDENTIFIER ID_ERR_ENVD_COM_1_TQ_PSTE FORMAT "%3.0"
 /begin AXIS_DESCR COM_AXIS errm_online_dummy _CNV_A_R_LINEAR_____0_CM 4 0. 255. FORMAT "%3.0" AXIS_PTS_REF ldpm_fmy_envd /end AXIS_DESCR
/end CHARACTERISTIC
/begin CHARACTERISTIC fmy_id_com_1_ang_pste.envd "Freeze frame FRF_CUS_SET_SPC: environmental data contents for failure XX" CURVE 0xa0802e38 _REC_CUR_20_u1_u1 254. _CNV_A_R_LINEAR_____0_CM 1. 255. DISPLAY_IDENTIFIER ID_ERR_ENVD_COM_1_ANG_PSTE FORMAT "%3.0"
 /begin AXIS_DESCR COM_AXIS errm_online_dummy _CNV_A_R_LINEAR_____0_CM 4 0. 255. FORMAT "%3.0" AXIS_PTS_REF ldpm_fmy_envd /end AXIS_DESCR
/end CHARACTERISTIC
/begin CHARACTERISTIC fmy_id_com_1_ac_trv.envd "Freeze frame FRF_CUS_SET_SPC: environmental data contents for failure XX" CURVE 0xa0802e24 _REC_CUR_20_u1_u1 254. _CNV_A_R_LINEAR_____0_CM 1. 255. DISPLAY_IDENTIFIER ID_ERR_ENVD_COM_1_AC_TRV FORMAT "%3.0"
 /begin AXIS_DESCR COM_AXIS errm_online_dummy _CNV_A_R_LINEAR_____0_CM 4 0. 255. FORMAT "%3.0" AXIS_PTS_REF ldpm_fmy_envd /end AXIS_DESCR
/end CHARACTERISTIC
/begin CHARACTERISTIC fmy_id_com_1_ac_lgt.envd "Freeze frame FRF_CUS_SET_SPC: environmental data contents for failure XX" CURVE 0xa0802e10 _REC_CUR_20_u1_u1 254. _CNV_A_R_LINEAR_____0_CM 1. 255. DISPLAY_IDENTIFIER ID_ERR_ENVD_COM_1_AC_LGT FORMAT "%3.0"
 /begin AXIS_DESCR COM_AXIS errm_online_dummy _CNV_A_R_LINEAR_____0_CM 4 0. 255. FORMAT "%3.0" AXIS_PTS_REF ldpm_fmy_envd /end AXIS_DESCR
/end CHARACTERISTIC
/begin CHARACTERISTIC fmy_id_com_1_tq_ars.envd "Freeze frame FRF_CUS_SET_SPC: environmental data contents for failure XX" CURVE 0xa0802ec4 _REC_CUR_20_u1_u1 254. _CNV_A_R_LINEAR_____0_CM 1. 255. DISPLAY_IDENTIFIER ID_ERR_ENVD_COM_1_TQ_ARS FORMAT "%3.0"
 /begin AXIS_DESCR COM_AXIS errm_online_dummy _CNV_A_R_LINEAR_____0_CM 4 0. 255. FORMAT "%3.0" AXIS_PTS_REF ldpm_fmy_envd /end AXIS_DESCR
/end CHARACTERISTIC
/begin CHARACTERISTIC fmy_id_com_1_ars.envd "Freeze frame FRF_CUS_SET_SPC: environmental data contents for failure XX" CURVE 0xa0802e4c _REC_CUR_20_u1_u1 254. _CNV_A_R_LINEAR_____0_CM 1. 255. DISPLAY_IDENTIFIER ID_ERR_ENVD_COM_1_ARS FORMAT "%3.0"
 /begin AXIS_DESCR COM_AXIS errm_online_dummy _CNV_A_R_LINEAR_____0_CM 4 0. 255. FORMAT "%3.0" AXIS_PTS_REF ldpm_fmy_envd /end AXIS_DESCR
/end CHARACTERISTIC
/begin CHARACTERISTIC fmy_id_com_1_vs.envd "Freeze frame FRF_CUS_SET_SPC: environmental data contents for failure XX" CURVE 0xa0802f50 _REC_CUR_20_u1_u1 254. _CNV_A_R_LINEAR_____0_CM 1. 255. DISPLAY_IDENTIFIER ID_ERR_ENVD_COM_1_VS FORMAT "%3.0"
 /begin AXIS_DESCR COM_AXIS errm_online_dummy _CNV_A_R_LINEAR_____0_CM 4 0. 255. FORMAT "%3.0" AXIS_PTS_REF ldpm_fmy_envd /end AXIS_DESCR
/end CHARACTERISTIC
/begin CHARACTERISTIC fmy_id_com_1_tcs.envd "Freeze frame FRF_CUS_SET_SPC: environmental data contents for failure XX" CURVE 0xa0802eb0 _REC_CUR_20_u1_u1 254. _CNV_A_R_LINEAR_____0_CM 1. 255. DISPLAY_IDENTIFIER ID_ERR_ENVD_COM_1_TCS FORMAT "%3.0"
 /begin AXIS_DESCR COM_AXIS errm_online_dummy _CNV_A_R_LINEAR_____0_CM 4 0. 255. FORMAT "%3.0" AXIS_PTS_REF ldpm_fmy_envd /end AXIS_DESCR
/end CHARACTERISTIC
/begin CHARACTERISTIC fmy_id_com_1_boff.envd "Freeze frame FRF_CUS_SET_SPC: environmental data contents for failure XX" CURVE 0xa0802e60 _REC_CUR_20_u1_u1 254. _CNV_A_R_LINEAR_____0_CM 1. 255. DISPLAY_IDENTIFIER ID_ERR_ENVD_COM_1_BOFF FORMAT "%3.0"
 /begin AXIS_DESCR COM_AXIS errm_online_dummy _CNV_A_R_LINEAR_____0_CM 4 0. 255. FORMAT "%3.0" AXIS_PTS_REF ldpm_fmy_envd /end AXIS_DESCR
/end CHARACTERISTIC
/begin CHARACTERISTIC fmy_id_com_2_efp_crash.envd "Freeze frame FRF_CUS_SET_SPC: environmental data contents for failure XX" CURVE 0xa0802ff0 _REC_CUR_20_u1_u1 254. _CNV_A_R_LINEAR_____0_CM 1. 255. DISPLAY_IDENTIFIER ID_ERR_ENVD_COM_2_EFP_CRASH FORMAT "%3.0"
 /begin AXIS_DESCR COM_AXIS errm_online_dummy _CNV_A_R_LINEAR_____0_CM 4 0. 255. FORMAT "%3.0" AXIS_PTS_REF ldpm_fmy_envd /end AXIS_DESCR
/end CHARACTERISTIC
/begin CHARACTERISTIC fmy_id_com_2_gb.envd "Freeze frame FRF_CUS_SET_SPC: environmental data contents for failure XX" CURVE 0xa080302c _REC_CUR_20_u1_u1 254. _CNV_A_R_LINEAR_____0_CM 1. 255. DISPLAY_IDENTIFIER ID_ERR_ENVD_COM_2_GB FORMAT "%3.0"
 /begin AXIS_DESCR COM_AXIS errm_online_dummy _CNV_A_R_LINEAR_____0_CM 4 0. 255. FORMAT "%3.0" AXIS_PTS_REF ldpm_fmy_envd /end AXIS_DESCR
/end CHARACTERISTIC
/begin CHARACTERISTIC fmy_id_com_2_etcu.envd "Freeze frame FRF_CUS_SET_SPC: environmental data contents for failure XX" CURVE 0xa0803004 _REC_CUR_20_u1_u1 254. _CNV_A_R_LINEAR_____0_CM 1. 255. DISPLAY_IDENTIFIER ID_ERR_ENVD_COM_2_ETCU FORMAT "%3.0"
 /begin AXIS_DESCR COM_AXIS errm_online_dummy _CNV_A_R_LINEAR_____0_CM 4 0. 255. FORMAT "%3.0" AXIS_PTS_REF ldpm_fmy_envd /end AXIS_DESCR
/end CHARACTERISTIC
/begin CHARACTERISTIC fmy_id_com_2_tq_etcu.envd "Freeze frame FRF_CUS_SET_SPC: environmental data contents for failure XX" CURVE 0xa0803108 _REC_CUR_20_u1_u1 254. _CNV_A_R_LINEAR_____0_CM 1. 255. DISPLAY_IDENTIFIER ID_ERR_ENVD_COM_2_TQ_ETCU FORMAT "%3.0"
 /begin AXIS_DESCR COM_AXIS errm_online_dummy _CNV_A_R_LINEAR_____0_CM 4 0. 255. FORMAT "%3.0" AXIS_PTS_REF ldpm_fmy_envd /end AXIS_DESCR
/end CHARACTERISTIC
/begin CHARACTERISTIC fmy_id_com_2_state_veh.envd "Freeze frame FRF_CUS_SET_SPC: environmental data contents for failure XX" CURVE 0xa08030a4 _REC_CUR_20_u1_u1 254. _CNV_A_R_LINEAR_____0_CM 1. 255. DISPLAY_IDENTIFIER ID_ERR_ENVD_COM_2_STATE_VEH FORMAT "%3.0"
 /begin AXIS_DESCR COM_AXIS errm_online_dummy _CNV_A_R_LINEAR_____0_CM 4 0. 255. FORMAT "%3.0" AXIS_PTS_REF ldpm_fmy_envd /end AXIS_DESCR
/end CHARACTERISTIC
/begin CHARACTERISTIC fmy_id_com_2_cas_2.envd "Freeze frame FRF_CUS_SET_SPC: environmental data contents for failure XX" CURVE 0xa0802fc8 _REC_CUR_20_u1_u1 254. _CNV_A_R_LINEAR_____0_CM 1. 255. DISPLAY_IDENTIFIER ID_ERR_ENVD_COM_2_CAS_2 FORMAT "%3.0"
 /begin AXIS_DESCR COM_AXIS errm_online_dummy _CNV_A_R_LINEAR_____0_CM 4 0. 255. FORMAT "%3.0" AXIS_PTS_REF ldpm_fmy_envd /end AXIS_DESCR
/end CHARACTERISTIC
/begin CHARACTERISTIC fmy_id_com_2_acc.envd "Freeze frame FRF_CUS_SET_SPC: environmental data contents for failure XX" CURVE 0xa0802f8c _REC_CUR_20_u1_u1 254. _CNV_A_R_LINEAR_____0_CM 1. 255. DISPLAY_IDENTIFIER ID_ERR_ENVD_COM_2_ACC FORMAT "%3.0"
 /begin AXIS_DESCR COM_AXIS errm_online_dummy _CNV_A_R_LINEAR_____0_CM 4 0. 255. FORMAT "%3.0" AXIS_PTS_REF ldpm_fmy_envd /end AXIS_DESCR
/end CHARACTERISTIC
/begin CHARACTERISTIC fmy_id_com_2_km_icl.envd "Freeze frame FRF_CUS_SET_SPC: environmental data contents for failure XX" CURVE 0xa080307c _REC_CUR_20_u1_u1 254. _CNV_A_R_LINEAR_____0_CM 1. 255. DISPLAY_IDENTIFIER ID_ERR_ENVD_COM_2_KM_ICL FORMAT "%3.0"
 /begin AXIS_DESCR COM_AXIS errm_online_dummy _CNV_A_R_LINEAR_____0_CM 4 0. 255. FORMAT "%3.0" AXIS_PTS_REF ldpm_fmy_envd /end AXIS_DESCR
/end CHARACTERISTIC
/begin CHARACTERISTIC fmy_id_com_2_t_icl.envd "Freeze frame FRF_CUS_SET_SPC: environmental data contents for failure XX" CURVE 0xa08030e0 _REC_CUR_20_u1_u1 254. _CNV_A_R_LINEAR_____0_CM 1. 255. DISPLAY_IDENTIFIER ID_ERR_ENVD_COM_2_T_ICL FORMAT "%3.0"
 /begin AXIS_DESCR COM_AXIS errm_online_dummy _CNV_A_R_LINEAR_____0_CM 4 0. 255. FORMAT "%3.0" AXIS_PTS_REF ldpm_fmy_envd /end AXIS_DESCR
/end CHARACTERISTIC
/begin CHARACTERISTIC fmy_id_com_2_tam_icl.envd "Freeze frame FRF_CUS_SET_SPC: environmental data contents for failure XX" CURVE 0xa08030f4 _REC_CUR_20_u1_u1 254. _CNV_A_R_LINEAR_____0_CM 1. 255. DISPLAY_IDENTIFIER ID_ERR_ENVD_COM_2_TAM_ICL FORMAT "%3.0"
 /begin AXIS_DESCR COM_AXIS errm_online_dummy _CNV_A_R_LINEAR_____0_CM 4 0. 255. FORMAT "%3.0" AXIS_PTS_REF ldpm_fmy_envd /end AXIS_DESCR
/end CHARACTERISTIC
/begin CHARACTERISTIC fmy_id_com_2_t_clk.envd "Freeze frame FRF_CUS_SET_SPC: environmental data contents for failure XX" CURVE 0xa08030cc _REC_CUR_20_u1_u1 254. _CNV_A_R_LINEAR_____0_CM 1. 255. DISPLAY_IDENTIFIER ID_ERR_ENVD_COM_2_T_CLK FORMAT "%3.0"
 /begin AXIS_DESCR COM_AXIS errm_online_dummy _CNV_A_R_LINEAR_____0_CM 4 0. 255. FORMAT "%3.0" AXIS_PTS_REF ldpm_fmy_envd /end AXIS_DESCR
/end CHARACTERISTIC
/begin CHARACTERISTIC fmy_id_com_2_boff.envd "Freeze frame FRF_CUS_SET_SPC: environmental data contents for failure XX" CURVE 0xa0802fa0 _REC_CUR_20_u1_u1 254. _CNV_A_R_LINEAR_____0_CM 1. 255. DISPLAY_IDENTIFIER ID_ERR_ENVD_COM_2_BOFF FORMAT "%3.0"
 /begin AXIS_DESCR COM_AXIS errm_online_dummy _CNV_A_R_LINEAR_____0_CM 4 0. 255. FORMAT "%3.0" AXIS_PTS_REF ldpm_fmy_envd /end AXIS_DESCR
/end CHARACTERISTIC
/begin CHARACTERISTIC fmy_id_com_2_t_absl_icl.envd "Freeze frame FRF_CUS_SET_SPC: environmental data contents for failure XX" CURVE 0xa08030b8 _REC_CUR_20_u1_u1 254. _CNV_A_R_LINEAR_____0_CM 1. 255. DISPLAY_IDENTIFIER ID_ERR_ENVD_COM_2_T_ABSL_ICL FORMAT "%3.0"
 /begin AXIS_DESCR COM_AXIS errm_online_dummy _CNV_A_R_LINEAR_____0_CM 4 0. 255. FORMAT "%3.0" AXIS_PTS_REF ldpm_fmy_envd /end AXIS_DESCR
/end CHARACTERISTIC
/begin CHARACTERISTIC fmy_id_com_2_cas.envd "Freeze frame FRF_CUS_SET_SPC: environmental data contents for failure XX" CURVE 0xa0802fb4 _REC_CUR_20_u1_u1 254. _CNV_A_R_LINEAR_____0_CM 1. 255. DISPLAY_IDENTIFIER ID_ERR_ENVD_COM_2_CAS FORMAT "%3.0"
 /begin AXIS_DESCR COM_AXIS errm_online_dummy _CNV_A_R_LINEAR_____0_CM 4 0. 255. FORMAT "%3.0" AXIS_PTS_REF ldpm_fmy_envd /end AXIS_DESCR
/end CHARACTERISTIC
/begin CHARACTERISTIC fmy_id_com_2_etcu_disp.envd "Freeze frame FRF_CUS_SET_SPC: environmental data contents for failure XX" CURVE 0xa0803018 _REC_CUR_20_u1_u1 254. _CNV_A_R_LINEAR_____0_CM 1. 255. DISPLAY_IDENTIFIER ID_ERR_ENVD_COM_2_ETCU_DISP FORMAT "%3.0"
 /begin AXIS_DESCR COM_AXIS errm_online_dummy _CNV_A_R_LINEAR_____0_CM 4 0. 255. FORMAT "%3.0" AXIS_PTS_REF ldpm_fmy_envd /end AXIS_DESCR
/end CHARACTERISTIC
/begin CHARACTERISTIC fmy_id_com_2_pow_off.envd "Freeze frame FRF_CUS_SET_SPC: environmental data contents for failure XX" CURVE 0xa0803090 _REC_CUR_20_u1_u1 254. _CNV_A_R_LINEAR_____0_CM 1. 255. DISPLAY_IDENTIFIER ID_ERR_ENVD_COM_2_POW_OFF FORMAT "%3.0"
 /begin AXIS_DESCR COM_AXIS errm_online_dummy _CNV_A_R_LINEAR_____0_CM 4 0. 255. FORMAT "%3.0" AXIS_PTS_REF ldpm_fmy_envd /end AXIS_DESCR
/end CHARACTERISTIC
/begin CHARACTERISTIC fmy_id_com_2_abs_icl.envd "Freeze frame FRF_CUS_SET_SPC: environmental data contents for failure XX" CURVE 0xa0802f78 _REC_CUR_20_u1_u1 254. _CNV_A_R_LINEAR_____0_CM 1. 255. DISPLAY_IDENTIFIER ID_ERR_ENVD_COM_2_ABS_ICL FORMAT "%3.0"
 /begin AXIS_DESCR COM_AXIS errm_online_dummy _CNV_A_R_LINEAR_____0_CM 4 0. 255. FORMAT "%3.0" AXIS_PTS_REF ldpm_fmy_envd /end AXIS_DESCR
/end CHARACTERISTIC
/begin CHARACTERISTIC fmy_id_com_2_trl.envd "Freeze frame FRF_CUS_SET_SPC: environmental data contents for failure XX" CURVE 0xa080311c _REC_CUR_20_u1_u1 254. _CNV_A_R_LINEAR_____0_CM 1. 255. DISPLAY_IDENTIFIER ID_ERR_ENVD_COM_2_TRL FORMAT "%3.0"
 /begin AXIS_DESCR COM_AXIS errm_online_dummy _CNV_A_R_LINEAR_____0_CM 4 0. 255. FORMAT "%3.0" AXIS_PTS_REF ldpm_fmy_envd /end AXIS_DESCR
/end CHARACTERISTIC
/begin CHARACTERISTIC fmy_id_com_2_hiv.envd "Freeze frame FRF_CUS_SET_SPC: environmental data contents for failure XX" CURVE 0xa0803054 _REC_CUR_20_u1_u1 254. _CNV_A_R_LINEAR_____0_CM 1. 255. DISPLAY_IDENTIFIER ID_ERR_ENVD_COM_2_HIV FORMAT "%3.0"
 /begin AXIS_DESCR COM_AXIS errm_online_dummy _CNV_A_R_LINEAR_____0_CM 4 0. 255. FORMAT "%3.0" AXIS_PTS_REF ldpm_fmy_envd /end AXIS_DESCR
/end CHARACTERISTIC
/begin CHARACTERISTIC fmy_id_com_2_icl.envd "Freeze frame FRF_CUS_SET_SPC: environmental data contents for failure XX" CURVE 0xa0803068 _REC_CUR_20_u1_u1 254. _CNV_A_R_LINEAR_____0_CM 1. 255. DISPLAY_IDENTIFIER ID_ERR_ENVD_COM_2_ICL FORMAT "%3.0"
 /begin AXIS_DESCR COM_AXIS errm_online_dummy _CNV_A_R_LINEAR_____0_CM 4 0. 255. FORMAT "%3.0" AXIS_PTS_REF ldpm_fmy_envd /end AXIS_DESCR
/end CHARACTERISTIC
/begin CHARACTERISTIC fmy_id_com_2_gear_rev.envd "Freeze frame FRF_CUS_SET_SPC: environmental data contents for failure XX" CURVE 0xa0803040 _REC_CUR_20_u1_u1 254. _CNV_A_R_LINEAR_____0_CM 1. 255. DISPLAY_IDENTIFIER ID_ERR_ENVD_COM_2_GEAR_REV FORMAT "%3.0"
 /begin AXIS_DESCR COM_AXIS errm_online_dummy _CNV_A_R_LINEAR_____0_CM 4 0. 255. FORMAT "%3.0" AXIS_PTS_REF ldpm_fmy_envd /end AXIS_DESCR
/end CHARACTERISTIC
/begin CHARACTERISTIC fmy_id_com_2_cdn_door.envd "Freeze frame FRF_CUS_SET_SPC: environmental data contents for failure XX" CURVE 0xa0802fdc _REC_CUR_20_u1_u1 254. _CNV_A_R_LINEAR_____0_CM 1. 255. DISPLAY_IDENTIFIER ID_ERR_ENVD_COM_2_CDN_DOOR FORMAT "%3.0"
 /begin AXIS_DESCR COM_AXIS errm_online_dummy _CNV_A_R_LINEAR_____0_CM 4 0. 255. FORMAT "%3.0" AXIS_PTS_REF ldpm_fmy_envd /end AXIS_DESCR
/end CHARACTERISTIC
/begin CHARACTERISTIC fmy_id_com_3_boff.envd "Freeze frame FRF_CUS_SET_SPC: environmental data contents for failure XX" CURVE 0xa0803130 _REC_CUR_20_u1_u1 254. _CNV_A_R_LINEAR_____0_CM 1. 255. DISPLAY_IDENTIFIER ID_ERR_ENVD_COM_3_BOFF FORMAT "%3.0"
 /begin AXIS_DESCR COM_AXIS errm_online_dummy _CNV_A_R_LINEAR_____0_CM 4 0. 255. FORMAT "%3.0" AXIS_PTS_REF ldpm_fmy_envd /end AXIS_DESCR
/end CHARACTERISTIC
/begin CHARACTERISTIC fmy_id_com_3_efp.envd "Freeze frame FRF_CUS_SET_SPC: environmental data contents for failure XX" CURVE 0xa0803144 _REC_CUR_20_u1_u1 254. _CNV_A_R_LINEAR_____0_CM 1. 255. DISPLAY_IDENTIFIER ID_ERR_ENVD_COM_3_EFP FORMAT "%3.0"
 /begin AXIS_DESCR COM_AXIS errm_online_dummy _CNV_A_R_LINEAR_____0_CM 4 0. 255. FORMAT "%3.0" AXIS_PTS_REF ldpm_fmy_envd /end AXIS_DESCR
/end CHARACTERISTIC
/begin CHARACTERISTIC fmy_id_com_3_tq_etcu.envd "Freeze frame FRF_CUS_SET_SPC: environmental data contents for failure XX" CURVE 0xa08031a8 _REC_CUR_20_u1_u1 254. _CNV_A_R_LINEAR_____0_CM 1. 255. DISPLAY_IDENTIFIER ID_ERR_ENVD_COM_3_TQ_ETCU FORMAT "%3.0"
 /begin AXIS_DESCR COM_AXIS errm_online_dummy _CNV_A_R_LINEAR_____0_CM 4 0. 255. FORMAT "%3.0" AXIS_PTS_REF ldpm_fmy_envd /end AXIS_DESCR
/end CHARACTERISTIC
/begin CHARACTERISTIC fmy_id_com_3_etcu.envd "Freeze frame FRF_CUS_SET_SPC: environmental data contents for failure XX" CURVE 0xa0803158 _REC_CUR_20_u1_u1 254. _CNV_A_R_LINEAR_____0_CM 1. 255. DISPLAY_IDENTIFIER ID_ERR_ENVD_COM_3_ETCU FORMAT "%3.0"
 /begin AXIS_DESCR COM_AXIS errm_online_dummy _CNV_A_R_LINEAR_____0_CM 4 0. 255. FORMAT "%3.0" AXIS_PTS_REF ldpm_fmy_envd /end AXIS_DESCR
/end CHARACTERISTIC
/begin CHARACTERISTIC fmy_id_com_3_etcu_disp.envd "Freeze frame FRF_CUS_SET_SPC: environmental data contents for failure XX" CURVE 0xa080316c _REC_CUR_20_u1_u1 254. _CNV_A_R_LINEAR_____0_CM 1. 255. DISPLAY_IDENTIFIER ID_ERR_ENVD_COM_3_ETCU_DISP FORMAT "%3.0"
 /begin AXIS_DESCR COM_AXIS errm_online_dummy _CNV_A_R_LINEAR_____0_CM 4 0. 255. FORMAT "%3.0" AXIS_PTS_REF ldpm_fmy_envd /end AXIS_DESCR
/end CHARACTERISTIC
/begin CHARACTERISTIC fmy_id_com_3_etcu_obd.envd "Freeze frame FRF_CUS_SET_SPC: environmental data contents for failure XX" CURVE 0xa0803180 _REC_CUR_20_u1_u1 254. _CNV_A_R_LINEAR_____0_CM 1. 255. DISPLAY_IDENTIFIER ID_ERR_ENVD_COM_3_ETCU_OBD FORMAT "%3.0"
 /begin AXIS_DESCR COM_AXIS errm_online_dummy _CNV_A_R_LINEAR_____0_CM 4 0. 255. FORMAT "%3.0" AXIS_PTS_REF ldpm_fmy_envd /end AXIS_DESCR
/end CHARACTERISTIC
/begin CHARACTERISTIC fmy_id_com_3_gb.envd "Freeze frame FRF_CUS_SET_SPC: environmental data contents for failure XX" CURVE 0xa0803194 _REC_CUR_20_u1_u1 254. _CNV_A_R_LINEAR_____0_CM 1. 255. DISPLAY_IDENTIFIER ID_ERR_ENVD_COM_3_GB FORMAT "%3.0"
 /begin AXIS_DESCR COM_AXIS errm_online_dummy _CNV_A_R_LINEAR_____0_CM 4 0. 255. FORMAT "%3.0" AXIS_PTS_REF ldpm_fmy_envd /end AXIS_DESCR
/end CHARACTERISTIC
/begin CHARACTERISTIC fmy_id_teg_sens_1.envd "Freeze frame FRF_CUS_SET_SPC: environmental data contents for failure XX" CURVE 0xa08049cc _REC_CUR_20_u1_u1 254. _CNV_A_R_LINEAR_____0_CM 1. 255. DISPLAY_IDENTIFIER ID_ERR_ENVD_TEG_SENS_1 FORMAT "%3.0"
 /begin AXIS_DESCR COM_AXIS errm_online_dummy _CNV_A_R_LINEAR_____0_CM 4 0. 255. FORMAT "%3.0" AXIS_PTS_REF ldpm_fmy_envd /end AXIS_DESCR
/end CHARACTERISTIC
/begin CHARACTERISTIC fmy_id_teg_sens_2.envd "Freeze frame FRF_CUS_SET_SPC: environmental data contents for failure XX" CURVE 0xa08049e0 _REC_CUR_20_u1_u1 254. _CNV_A_R_LINEAR_____0_CM 1. 255. DISPLAY_IDENTIFIER ID_ERR_ENVD_TEG_SENS_2 FORMAT "%3.0"
 /begin AXIS_DESCR COM_AXIS errm_online_dummy _CNV_A_R_LINEAR_____0_CM 4 0. 255. FORMAT "%3.0" AXIS_PTS_REF ldpm_fmy_envd /end AXIS_DESCR
/end CHARACTERISTIC
/begin CHARACTERISTIC fmy_id_amp_plaus_cus.envd "Freeze frame FRF_CUS_SET_SPC: environmental data contents for failure XX" CURVE 0xa0802a3c _REC_CUR_20_u1_u1 254. _CNV_A_R_LINEAR_____0_CM 1. 255. DISPLAY_IDENTIFIER ID_ERR_ENVD_AMP_PLAUS_CUS FORMAT "%3.0"
 /begin AXIS_DESCR COM_AXIS errm_online_dummy _CNV_A_R_LINEAR_____0_CM 4 0. 255. FORMAT "%3.0" AXIS_PTS_REF ldpm_fmy_envd /end AXIS_DESCR
/end CHARACTERISTIC
/begin CHARACTERISTIC fmy_id_tcha_prs_low.envd "Freeze frame FRF_CUS_SET_SPC: environmental data contents for failure XX" CURVE 0xa08048f0 _REC_CUR_20_u1_u1 254. _CNV_A_R_LINEAR_____0_CM 1. 255. DISPLAY_IDENTIFIER ID_ERR_ENVD_TCHA_PRS_LOW FORMAT "%3.0"
 /begin AXIS_DESCR COM_AXIS errm_online_dummy _CNV_A_R_LINEAR_____0_CM 4 0. 255. FORMAT "%3.0" AXIS_PTS_REF ldpm_fmy_envd /end AXIS_DESCR
/end CHARACTERISTIC
/begin CHARACTERISTIC fmy_id_tcha_leak.envd "Freeze frame FRF_CUS_SET_SPC: environmental data contents for failure XX" CURVE 0xa08048b4 _REC_CUR_20_u1_u1 254. _CNV_A_R_LINEAR_____0_CM 1. 255. DISPLAY_IDENTIFIER ID_ERR_ENVD_TCHA_LEAK FORMAT "%3.0"
 /begin AXIS_DESCR COM_AXIS errm_online_dummy _CNV_A_R_LINEAR_____0_CM 4 0. 255. FORMAT "%3.0" AXIS_PTS_REF ldpm_fmy_envd /end AXIS_DESCR
/end CHARACTERISTIC
/begin CHARACTERISTIC fmy_id_tcha_prs_dif.envd "Freeze frame FRF_CUS_SET_SPC: environmental data contents for failure XX" CURVE 0xa08048c8 _REC_CUR_20_u1_u1 254. _CNV_A_R_LINEAR_____0_CM 1. 255. DISPLAY_IDENTIFIER ID_ERR_ENVD_TCHA_PRS_DIF FORMAT "%3.0"
 /begin AXIS_DESCR COM_AXIS errm_online_dummy _CNV_A_R_LINEAR_____0_CM 4 0. 255. FORMAT "%3.0" AXIS_PTS_REF ldpm_fmy_envd /end AXIS_DESCR
/end CHARACTERISTIC
/begin CHARACTERISTIC fmy_id_tcha_prs_high.envd "Freeze frame FRF_CUS_SET_SPC: environmental data contents for failure XX" CURVE 0xa08048dc _REC_CUR_20_u1_u1 254. _CNV_A_R_LINEAR_____0_CM 1. 255. DISPLAY_IDENTIFIER ID_ERR_ENVD_TCHA_PRS_HIGH FORMAT "%3.0"
 /begin AXIS_DESCR COM_AXIS errm_online_dummy _CNV_A_R_LINEAR_____0_CM 4 0. 255. FORMAT "%3.0" AXIS_PTS_REF ldpm_fmy_envd /end AXIS_DESCR
/end CHARACTERISTIC
/begin CHARACTERISTIC fmy_id_put_plaus.envd "Freeze frame FRF_CUS_SET_SPC: environmental data contents for failure XX" CURVE 0xa0804404 _REC_CUR_20_u1_u1 254. _CNV_A_R_LINEAR_____0_CM 1. 255. DISPLAY_IDENTIFIER ID_ERR_ENVD_PUT_PLAUS FORMAT "%3.0"
 /begin AXIS_DESCR COM_AXIS errm_online_dummy _CNV_A_R_LINEAR_____0_CM 4 0. 255. FORMAT "%3.0" AXIS_PTS_REF ldpm_fmy_envd /end AXIS_DESCR
/end CHARACTERISTIC
/begin CHARACTERISTIC fmy_id_map_plaus.envd "Freeze frame FRF_CUS_SET_SPC: environmental data contents for failure XX" CURVE 0xa0803f04 _REC_CUR_20_u1_u1 254. _CNV_A_R_LINEAR_____0_CM 1. 255. DISPLAY_IDENTIFIER ID_ERR_ENVD_MAP_PLAUS FORMAT "%3.0"
 /begin AXIS_DESCR COM_AXIS errm_online_dummy _CNV_A_R_LINEAR_____0_CM 4 0. 255. FORMAT "%3.0" AXIS_PTS_REF ldpm_fmy_envd /end AXIS_DESCR
/end CHARACTERISTIC
/begin CHARACTERISTIC fmy_id_tq_cst.envd "Freeze frame FRF_CUS_SET_SPC: environmental data contents for failure XX" CURVE 0xa0804c4c _REC_CUR_20_u1_u1 254. _CNV_A_R_LINEAR_____0_CM 1. 255. DISPLAY_IDENTIFIER ID_ERR_ENVD_TQ_CST FORMAT "%3.0"
 /begin AXIS_DESCR COM_AXIS errm_online_dummy _CNV_A_R_LINEAR_____0_CM 4 0. 255. FORMAT "%3.0" AXIS_PTS_REF ldpm_fmy_envd /end AXIS_DESCR
/end CHARACTERISTIC
/begin CHARACTERISTIC fmy_id_gen_el.envd "Freeze frame FRF_CUS_SET_SPC: environmental data contents for failure XX" CURVE 0xa08038c4 _REC_CUR_20_u1_u1 254. _CNV_A_R_LINEAR_____0_CM 1. 255. DISPLAY_IDENTIFIER ID_ERR_ENVD_GEN_EL FORMAT "%3.0"
 /begin AXIS_DESCR COM_AXIS errm_online_dummy _CNV_A_R_LINEAR_____0_CM 4 0. 255. FORMAT "%3.0" AXIS_PTS_REF ldpm_fmy_envd /end AXIS_DESCR
/end CHARACTERISTIC
/begin CHARACTERISTIC fmy_id_gen_mec.envd "Freeze frame FRF_CUS_SET_SPC: environmental data contents for failure XX" CURVE 0xa0803900 _REC_CUR_20_u1_u1 254. _CNV_A_R_LINEAR_____0_CM 1. 255. DISPLAY_IDENTIFIER ID_ERR_ENVD_GEN_MEC FORMAT "%3.0"
 /begin AXIS_DESCR COM_AXIS errm_online_dummy _CNV_A_R_LINEAR_____0_CM 4 0. 255. FORMAT "%3.0" AXIS_PTS_REF ldpm_fmy_envd /end AXIS_DESCR
/end CHARACTERISTIC
/begin CHARACTERISTIC fmy_id_gen_h_temp.envd "Freeze frame FRF_CUS_SET_SPC: environmental data contents for failure XX" CURVE 0xa08038d8 _REC_CUR_20_u1_u1 254. _CNV_A_R_LINEAR_____0_CM 1. 255. DISPLAY_IDENTIFIER ID_ERR_ENVD_GEN_H_TEMP FORMAT "%3.0"
 /begin AXIS_DESCR COM_AXIS errm_online_dummy _CNV_A_R_LINEAR_____0_CM 4 0. 255. FORMAT "%3.0" AXIS_PTS_REF ldpm_fmy_envd /end AXIS_DESCR
/end CHARACTERISTIC
/begin CHARACTERISTIC fmy_id_gen_typ_not_plaus.envd "Freeze frame FRF_CUS_SET_SPC: environmental data contents for failure XX" CURVE 0xa0803928 _REC_CUR_20_u1_u1 254. _CNV_A_R_LINEAR_____0_CM 1. 255. DISPLAY_IDENTIFIER ID_ERR_ENVD_GEN_TYP_NOT_PLAUS FORMAT "%3.0"
 /begin AXIS_DESCR COM_AXIS errm_online_dummy _CNV_A_R_LINEAR_____0_CM 4 0. 255. FORMAT "%3.0" AXIS_PTS_REF ldpm_fmy_envd /end AXIS_DESCR
/end CHARACTERISTIC
/begin CHARACTERISTIC fmy_id_gen_msg_lost.envd "Freeze frame FRF_CUS_SET_SPC: environmental data contents for failure XX" CURVE 0xa0803914 _REC_CUR_20_u1_u1 254. _CNV_A_R_LINEAR_____0_CM 1. 255. DISPLAY_IDENTIFIER ID_ERR_ENVD_GEN_MSG_LOST FORMAT "%3.0"
 /begin AXIS_DESCR COM_AXIS errm_online_dummy _CNV_A_R_LINEAR_____0_CM 4 0. 255. FORMAT "%3.0" AXIS_PTS_REF ldpm_fmy_envd /end AXIS_DESCR
/end CHARACTERISTIC
/begin CHARACTERISTIC fmy_id_gen_clc_v_not_plaus.envd "Freeze frame FRF_CUS_SET_SPC: environmental data contents for failure XX" CURVE 0xa0803888 _REC_CUR_20_u1_u1 254. _CNV_A_R_LINEAR_____0_CM 1. 255. DISPLAY_IDENTIFIER ID_ERR_ENVD_GEN_CLC_V_NOT_PLAUS FORMAT "%3.0"
 /begin AXIS_DESCR COM_AXIS errm_online_dummy _CNV_A_R_LINEAR_____0_CM 4 0. 255. FORMAT "%3.0" AXIS_PTS_REF ldpm_fmy_envd /end AXIS_DESCR
/end CHARACTERISTIC
/begin CHARACTERISTIC fmy_id_gen_h_temp_clc.envd "Freeze frame FRF_CUS_SET_SPC: environmental data contents for failure XX" CURVE 0xa08038ec _REC_CUR_20_u1_u1 254. _CNV_A_R_LINEAR_____0_CM 1. 255. DISPLAY_IDENTIFIER ID_ERR_ENVD_GEN_H_TEMP_CLC FORMAT "%3.0"
 /begin AXIS_DESCR COM_AXIS errm_online_dummy _CNV_A_R_LINEAR_____0_CM 4 0. 255. FORMAT "%3.0" AXIS_PTS_REF ldpm_fmy_envd /end AXIS_DESCR
/end CHARACTERISTIC
/begin CHARACTERISTIC fmy_id_gen_ctl_not_plaus.envd "Freeze frame FRF_CUS_SET_SPC: environmental data contents for failure XX" CURVE 0xa080389c _REC_CUR_20_u1_u1 254. _CNV_A_R_LINEAR_____0_CM 1. 255. DISPLAY_IDENTIFIER ID_ERR_ENVD_GEN_CTL_NOT_PLAUS FORMAT "%3.0"
 /begin AXIS_DESCR COM_AXIS errm_online_dummy _CNV_A_R_LINEAR_____0_CM 4 0. 255. FORMAT "%3.0" AXIS_PTS_REF ldpm_fmy_envd /end AXIS_DESCR
/end CHARACTERISTIC
/begin CHARACTERISTIC fmy_id_slv_ivvt_in.envd "Freeze frame FRF_CUS_SET_SPC: environmental data contents for failure XX" CURVE 0xa08046e8 _REC_CUR_20_u1_u1 254. _CNV_A_R_LINEAR_____0_CM 1. 255. DISPLAY_IDENTIFIER ID_ERR_ENVD_SLV_IVVT_IN FORMAT "%3.0"
 /begin AXIS_DESCR COM_AXIS errm_online_dummy _CNV_A_R_LINEAR_____0_CM 4 0. 255. FORMAT "%3.0" AXIS_PTS_REF ldpm_fmy_envd /end AXIS_DESCR
/end CHARACTERISTIC
/begin CHARACTERISTIC fmy_id_slv_ivvt_ex.envd "Freeze frame FRF_CUS_SET_SPC: environmental data contents for failure XX" CURVE 0xa08046ac _REC_CUR_20_u1_u1 254. _CNV_A_R_LINEAR_____0_CM 1. 255. DISPLAY_IDENTIFIER ID_ERR_ENVD_SLV_IVVT_EX FORMAT "%3.0"
 /begin AXIS_DESCR COM_AXIS errm_online_dummy _CNV_A_R_LINEAR_____0_CM 4 0. 255. FORMAT "%3.0" AXIS_PTS_REF ldpm_fmy_envd /end AXIS_DESCR
/end CHARACTERISTIC
/begin CHARACTERISTIC fmy_id_conv_mon_1.envd "Freeze frame FRF_CUS_SET_SPC: environmental data contents for failure XX" CURVE 0xa08031bc _REC_CUR_20_u1_u1 254. _CNV_A_R_LINEAR_____0_CM 1. 255. DISPLAY_IDENTIFIER ID_ERR_ENVD_CONV_MON_1 FORMAT "%3.0"
 /begin AXIS_DESCR COM_AXIS errm_online_dummy _CNV_A_R_LINEAR_____0_CM 4 0. 255. FORMAT "%3.0" AXIS_PTS_REF ldpm_fmy_envd /end AXIS_DESCR
/end CHARACTERISTIC
/begin CHARACTERISTIC fmy_id_n_32_mon_1.envd "Freeze frame FRF_CUS_SET_SPC: environmental data contents for failure XX" CURVE 0xa08040e4 _REC_CUR_20_u1_u1 254. _CNV_A_R_LINEAR_____0_CM 1. 255. DISPLAY_IDENTIFIER ID_ERR_ENVD_N_32_MON_1 FORMAT "%3.0"
 /begin AXIS_DESCR COM_AXIS errm_online_dummy _CNV_A_R_LINEAR_____0_CM 4 0. 255. FORMAT "%3.0" AXIS_PTS_REF ldpm_fmy_envd /end AXIS_DESCR
/end CHARACTERISTIC
/begin CHARACTERISTIC fmy_id_pvs_mon_1.envd "Freeze frame FRF_CUS_SET_SPC: environmental data contents for failure XX" CURVE 0xa0804468 _REC_CUR_20_u1_u1 254. _CNV_A_R_LINEAR_____0_CM 1. 255. DISPLAY_IDENTIFIER ID_ERR_ENVD_PVS_MON_1 FORMAT "%3.0"
 /begin AXIS_DESCR COM_AXIS errm_online_dummy _CNV_A_R_LINEAR_____0_CM 4 0. 255. FORMAT "%3.0" AXIS_PTS_REF ldpm_fmy_envd /end AXIS_DESCR
/end CHARACTERISTIC
/begin CHARACTERISTIC fmy_id_tq_dif_isc_mon_1.envd "Freeze frame FRF_CUS_SET_SPC: environmental data contents for failure XX" CURVE 0xa0804c60 _REC_CUR_20_u1_u1 254. _CNV_A_R_LINEAR_____0_CM 1. 255. DISPLAY_IDENTIFIER ID_ERR_ENVD_TQ_DIF_ISC_MON_1 FORMAT "%3.0"
 /begin AXIS_DESCR COM_AXIS errm_online_dummy _CNV_A_R_LINEAR_____0_CM 4 0. 255. FORMAT "%3.0" AXIS_PTS_REF ldpm_fmy_envd /end AXIS_DESCR
/end CHARACTERISTIC
/begin CHARACTERISTIC fmy_id_tq_req_mon_1.envd "Freeze frame FRF_CUS_SET_SPC: environmental data contents for failure XX" CURVE 0xa0804c9c _REC_CUR_20_u1_u1 254. _CNV_A_R_LINEAR_____0_CM 1. 255. DISPLAY_IDENTIFIER ID_ERR_ENVD_TQ_REQ_MON_1 FORMAT "%3.0"
 /begin AXIS_DESCR COM_AXIS errm_online_dummy _CNV_A_R_LINEAR_____0_CM 4 0. 255. FORMAT "%3.0" AXIS_PTS_REF ldpm_fmy_envd /end AXIS_DESCR
/end CHARACTERISTIC
/begin CHARACTERISTIC fmy_id_tq_ext_mon_1.envd "Freeze frame FRF_CUS_SET_SPC: environmental data contents for failure XX" CURVE 0xa0804c74 _REC_CUR_20_u1_u1 254. _CNV_A_R_LINEAR_____0_CM 1. 255. DISPLAY_IDENTIFIER ID_ERR_ENVD_TQ_EXT_MON_1 FORMAT "%3.0"
 /begin AXIS_DESCR COM_AXIS errm_online_dummy _CNV_A_R_LINEAR_____0_CM 4 0. 255. FORMAT "%3.0" AXIS_PTS_REF ldpm_fmy_envd /end AXIS_DESCR
/end CHARACTERISTIC
/begin CHARACTERISTIC fmy_id_tqi_av_mon_1.envd "Freeze frame FRF_CUS_SET_SPC: environmental data contents for failure XX" CURVE 0xa0804cb0 _REC_CUR_20_u1_u1 254. _CNV_A_R_LINEAR_____0_CM 1. 255. DISPLAY_IDENTIFIER ID_ERR_ENVD_TQI_AV_MON_1 FORMAT "%3.0"
 /begin AXIS_DESCR COM_AXIS errm_online_dummy _CNV_A_R_LINEAR_____0_CM 4 0. 255. FORMAT "%3.0" AXIS_PTS_REF ldpm_fmy_envd /end AXIS_DESCR
/end CHARACTERISTIC
/begin CHARACTERISTIC fmy_id_tqi_n_max_mon_1.envd "Freeze frame FRF_CUS_SET_SPC: environmental data contents for failure XX" CURVE 0xa0804cd8 _REC_CUR_20_u1_u1 254. _CNV_A_R_LINEAR_____0_CM 1. 255. DISPLAY_IDENTIFIER ID_ERR_ENVD_TQI_N_MAX_MON_1 FORMAT "%3.0"
 /begin AXIS_DESCR COM_AXIS errm_online_dummy _CNV_A_R_LINEAR_____0_CM 4 0. 255. FORMAT "%3.0" AXIS_PTS_REF ldpm_fmy_envd /end AXIS_DESCR
/end CHARACTERISTIC
/begin CHARACTERISTIC fmy_id_mff_mon_1.envd "Freeze frame FRF_CUS_SET_SPC: environmental data contents for failure XX" CURVE 0xa0803fa4 _REC_CUR_20_u1_u1 254. _CNV_A_R_LINEAR_____0_CM 1. 255. DISPLAY_IDENTIFIER ID_ERR_ENVD_MFF_MON_1 FORMAT "%3.0"
 /begin AXIS_DESCR COM_AXIS errm_online_dummy _CNV_A_R_LINEAR_____0_CM 4 0. 255. FORMAT "%3.0" AXIS_PTS_REF ldpm_fmy_envd /end AXIS_DESCR
/end CHARACTERISTIC
/begin CHARACTERISTIC fmy_id_cru_inh_mon_1.envd "Freeze frame FRF_CUS_SET_SPC: environmental data contents for failure XX" CURVE 0xa0803234 _REC_CUR_20_u1_u1 254. _CNV_A_R_LINEAR_____0_CM 1. 255. DISPLAY_IDENTIFIER ID_ERR_ENVD_CRU_INH_MON_1 FORMAT "%3.0"
 /begin AXIS_DESCR COM_AXIS errm_online_dummy _CNV_A_R_LINEAR_____0_CM 4 0. 255. FORMAT "%3.0" AXIS_PTS_REF ldpm_fmy_envd /end AXIS_DESCR
/end CHARACTERISTIC
/begin CHARACTERISTIC fmy_id_swi_afs_mon.envd "Freeze frame FRF_CUS_SET_SPC: environmental data contents for failure XX" CURVE 0xa0804788 _REC_CUR_20_u1_u1 254. _CNV_A_R_LINEAR_____0_CM 1. 255. DISPLAY_IDENTIFIER ID_ERR_ENVD_SWI_AFS_MON FORMAT "%3.0"
 /begin AXIS_DESCR COM_AXIS errm_online_dummy _CNV_A_R_LINEAR_____0_CM 4 0. 255. FORMAT "%3.0" AXIS_PTS_REF ldpm_fmy_envd /end AXIS_DESCR
/end CHARACTERISTIC
/begin CHARACTERISTIC fmy_id_iv_0.envd "Freeze frame FRF_CUS_SET_SPC: environmental data contents for failure XX" CURVE 0xa0803be4 _REC_CUR_20_u1_u1 254. _CNV_A_R_LINEAR_____0_CM 1. 255. DISPLAY_IDENTIFIER ID_ERR_ENVD_IV_0 FORMAT "%3.0"
 /begin AXIS_DESCR COM_AXIS errm_online_dummy _CNV_A_R_LINEAR_____0_CM 4 0. 255. FORMAT "%3.0" AXIS_PTS_REF ldpm_fmy_envd /end AXIS_DESCR
/end CHARACTERISTIC
/begin CHARACTERISTIC fmy_id_iv_1.envd "Freeze frame FRF_CUS_SET_SPC: environmental data contents for failure XX" CURVE 0xa0803bf8 _REC_CUR_20_u1_u1 254. _CNV_A_R_LINEAR_____0_CM 1. 255. DISPLAY_IDENTIFIER ID_ERR_ENVD_IV_1 FORMAT "%3.0"
 /begin AXIS_DESCR COM_AXIS errm_online_dummy _CNV_A_R_LINEAR_____0_CM 4 0. 255. FORMAT "%3.0" AXIS_PTS_REF ldpm_fmy_envd /end AXIS_DESCR
/end CHARACTERISTIC
/begin CHARACTERISTIC fmy_id_iv_2.envd "Freeze frame FRF_CUS_SET_SPC: environmental data contents for failure XX" CURVE 0xa0803c0c _REC_CUR_20_u1_u1 254. _CNV_A_R_LINEAR_____0_CM 1. 255. DISPLAY_IDENTIFIER ID_ERR_ENVD_IV_2 FORMAT "%3.0"
 /begin AXIS_DESCR COM_AXIS errm_online_dummy _CNV_A_R_LINEAR_____0_CM 4 0. 255. FORMAT "%3.0" AXIS_PTS_REF ldpm_fmy_envd /end AXIS_DESCR
/end CHARACTERISTIC
/begin CHARACTERISTIC fmy_id_iv_3.envd "Freeze frame FRF_CUS_SET_SPC: environmental data contents for failure XX" CURVE 0xa0803c20 _REC_CUR_20_u1_u1 254. _CNV_A_R_LINEAR_____0_CM 1. 255. DISPLAY_IDENTIFIER ID_ERR_ENVD_IV_3 FORMAT "%3.0"
 /begin AXIS_DESCR COM_AXIS errm_online_dummy _CNV_A_R_LINEAR_____0_CM 4 0. 255. FORMAT "%3.0" AXIS_PTS_REF ldpm_fmy_envd /end AXIS_DESCR
/end CHARACTERISTIC
/begin CHARACTERISTIC fmy_id_iv_4.envd "Freeze frame FRF_CUS_SET_SPC: environmental data contents for failure XX" CURVE 0xa0803c34 _REC_CUR_20_u1_u1 254. _CNV_A_R_LINEAR_____0_CM 1. 255. DISPLAY_IDENTIFIER ID_ERR_ENVD_IV_4 FORMAT "%3.0"
 /begin AXIS_DESCR COM_AXIS errm_online_dummy _CNV_A_R_LINEAR_____0_CM 4 0. 255. FORMAT "%3.0" AXIS_PTS_REF ldpm_fmy_envd /end AXIS_DESCR
/end CHARACTERISTIC
/begin CHARACTERISTIC fmy_id_iv_5.envd "Freeze frame FRF_CUS_SET_SPC: environmental data contents for failure XX" CURVE 0xa0803c48 _REC_CUR_20_u1_u1 254. _CNV_A_R_LINEAR_____0_CM 1. 255. DISPLAY_IDENTIFIER ID_ERR_ENVD_IV_5 FORMAT "%3.0"
 /begin AXIS_DESCR COM_AXIS errm_online_dummy _CNV_A_R_LINEAR_____0_CM 4 0. 255. FORMAT "%3.0" AXIS_PTS_REF ldpm_fmy_envd /end AXIS_DESCR
/end CHARACTERISTIC
/begin CHARACTERISTIC fmy_id_iv_6.envd "Freeze frame FRF_CUS_SET_SPC: environmental data contents for failure XX" CURVE 0xa0803c5c _REC_CUR_20_u1_u1 254. _CNV_A_R_LINEAR_____0_CM 1. 255. DISPLAY_IDENTIFIER ID_ERR_ENVD_IV_6 FORMAT "%3.0"
 /begin AXIS_DESCR COM_AXIS errm_online_dummy _CNV_A_R_LINEAR_____0_CM 4 0. 255. FORMAT "%3.0" AXIS_PTS_REF ldpm_fmy_envd /end AXIS_DESCR
/end CHARACTERISTIC
/begin CHARACTERISTIC fmy_id_iv_7.envd "Freeze frame FRF_CUS_SET_SPC: environmental data contents for failure XX" CURVE 0xa0803c70 _REC_CUR_20_u1_u1 254. _CNV_A_R_LINEAR_____0_CM 1. 255. DISPLAY_IDENTIFIER ID_ERR_ENVD_IV_7 FORMAT "%3.0"
 /begin AXIS_DESCR COM_AXIS errm_online_dummy _CNV_A_R_LINEAR_____0_CM 4 0. 255. FORMAT "%3.0" AXIS_PTS_REF ldpm_fmy_envd /end AXIS_DESCR
/end CHARACTERISTIC
/begin CHARACTERISTIC fmy_id_iv_sc_0.envd "Freeze frame FRF_CUS_SET_SPC: environmental data contents for failure XX" CURVE 0xa0803c84 _REC_CUR_20_u1_u1 254. _CNV_A_R_LINEAR_____0_CM 1. 255. DISPLAY_IDENTIFIER ID_ERR_ENVD_IV_SC_0 FORMAT "%3.0"
 /begin AXIS_DESCR COM_AXIS errm_online_dummy _CNV_A_R_LINEAR_____0_CM 4 0. 255. FORMAT "%3.0" AXIS_PTS_REF ldpm_fmy_envd /end AXIS_DESCR
/end CHARACTERISTIC
/begin CHARACTERISTIC fmy_id_iv_sc_1.envd "Freeze frame FRF_CUS_SET_SPC: environmental data contents for failure XX" CURVE 0xa0803c98 _REC_CUR_20_u1_u1 254. _CNV_A_R_LINEAR_____0_CM 1. 255. DISPLAY_IDENTIFIER ID_ERR_ENVD_IV_SC_1 FORMAT "%3.0"
 /begin AXIS_DESCR COM_AXIS errm_online_dummy _CNV_A_R_LINEAR_____0_CM 4 0. 255. FORMAT "%3.0" AXIS_PTS_REF ldpm_fmy_envd /end AXIS_DESCR
/end CHARACTERISTIC
/begin CHARACTERISTIC fmy_id_iv_sc_2.envd "Freeze frame FRF_CUS_SET_SPC: environmental data contents for failure XX" CURVE 0xa0803cac _REC_CUR_20_u1_u1 254. _CNV_A_R_LINEAR_____0_CM 1. 255. DISPLAY_IDENTIFIER ID_ERR_ENVD_IV_SC_2 FORMAT "%3.0"
 /begin AXIS_DESCR COM_AXIS errm_online_dummy _CNV_A_R_LINEAR_____0_CM 4 0. 255. FORMAT "%3.0" AXIS_PTS_REF ldpm_fmy_envd /end AXIS_DESCR
/end CHARACTERISTIC
/begin CHARACTERISTIC fmy_id_iv_sc_3.envd "Freeze frame FRF_CUS_SET_SPC: environmental data contents for failure XX" CURVE 0xa0803cc0 _REC_CUR_20_u1_u1 254. _CNV_A_R_LINEAR_____0_CM 1. 255. DISPLAY_IDENTIFIER ID_ERR_ENVD_IV_SC_3 FORMAT "%3.0"
 /begin AXIS_DESCR COM_AXIS errm_online_dummy _CNV_A_R_LINEAR_____0_CM 4 0. 255. FORMAT "%3.0" AXIS_PTS_REF ldpm_fmy_envd /end AXIS_DESCR
/end CHARACTERISTIC
/begin CHARACTERISTIC fmy_id_iv_sc_4.envd "Freeze frame FRF_CUS_SET_SPC: environmental data contents for failure XX" CURVE 0xa0803cd4 _REC_CUR_20_u1_u1 254. _CNV_A_R_LINEAR_____0_CM 1. 255. DISPLAY_IDENTIFIER ID_ERR_ENVD_IV_SC_4 FORMAT "%3.0"
 /begin AXIS_DESCR COM_AXIS errm_online_dummy _CNV_A_R_LINEAR_____0_CM 4 0. 255. FORMAT "%3.0" AXIS_PTS_REF ldpm_fmy_envd /end AXIS_DESCR
/end CHARACTERISTIC
/begin CHARACTERISTIC fmy_id_iv_sc_5.envd "Freeze frame FRF_CUS_SET_SPC: environmental data contents for failure XX" CURVE 0xa0803ce8 _REC_CUR_20_u1_u1 254. _CNV_A_R_LINEAR_____0_CM 1. 255. DISPLAY_IDENTIFIER ID_ERR_ENVD_IV_SC_5 FORMAT "%3.0"
 /begin AXIS_DESCR COM_AXIS errm_online_dummy _CNV_A_R_LINEAR_____0_CM 4 0. 255. FORMAT "%3.0" AXIS_PTS_REF ldpm_fmy_envd /end AXIS_DESCR
/end CHARACTERISTIC
/begin CHARACTERISTIC fmy_id_iv_sc_6.envd "Freeze frame FRF_CUS_SET_SPC: environmental data contents for failure XX" CURVE 0xa0803cfc _REC_CUR_20_u1_u1 254. _CNV_A_R_LINEAR_____0_CM 1. 255. DISPLAY_IDENTIFIER ID_ERR_ENVD_IV_SC_6 FORMAT "%3.0"
 /begin AXIS_DESCR COM_AXIS errm_online_dummy _CNV_A_R_LINEAR_____0_CM 4 0. 255. FORMAT "%3.0" AXIS_PTS_REF ldpm_fmy_envd /end AXIS_DESCR
/end CHARACTERISTIC
/begin CHARACTERISTIC fmy_id_iv_sc_7.envd "Freeze frame FRF_CUS_SET_SPC: environmental data contents for failure XX" CURVE 0xa0803d10 _REC_CUR_20_u1_u1 254. _CNV_A_R_LINEAR_____0_CM 1. 255. DISPLAY_IDENTIFIER ID_ERR_ENVD_IV_SC_7 FORMAT "%3.0"
 /begin AXIS_DESCR COM_AXIS errm_online_dummy _CNV_A_R_LINEAR_____0_CM 4 0. 255. FORMAT "%3.0" AXIS_PTS_REF ldpm_fmy_envd /end AXIS_DESCR
/end CHARACTERISTIC
/begin CHARACTERISTIC fmy_id_pbk_iv_1.envd "Freeze frame FRF_CUS_SET_SPC: environmental data contents for failure XX" CURVE 0xa0804238 _REC_CUR_20_u1_u1 254. _CNV_A_R_LINEAR_____0_CM 1. 255. DISPLAY_IDENTIFIER ID_ERR_ENVD_PBK_IV_1 FORMAT "%3.0"
 /begin AXIS_DESCR COM_AXIS errm_online_dummy _CNV_A_R_LINEAR_____0_CM 4 0. 255. FORMAT "%3.0" AXIS_PTS_REF ldpm_fmy_envd /end AXIS_DESCR
/end CHARACTERISTIC
/begin CHARACTERISTIC fmy_id_pbk_iv_2.envd "Freeze frame FRF_CUS_SET_SPC: environmental data contents for failure XX" CURVE 0xa080424c _REC_CUR_20_u1_u1 254. _CNV_A_R_LINEAR_____0_CM 1. 255. DISPLAY_IDENTIFIER ID_ERR_ENVD_PBK_IV_2 FORMAT "%3.0"
 /begin AXIS_DESCR COM_AXIS errm_online_dummy _CNV_A_R_LINEAR_____0_CM 4 0. 255. FORMAT "%3.0" AXIS_PTS_REF ldpm_fmy_envd /end AXIS_DESCR
/end CHARACTERISTIC
/begin CHARACTERISTIC fmy_id_pbk_iv_3.envd "Freeze frame FRF_CUS_SET_SPC: environmental data contents for failure XX" CURVE 0xa0804260 _REC_CUR_20_u1_u1 254. _CNV_A_R_LINEAR_____0_CM 1. 255. DISPLAY_IDENTIFIER ID_ERR_ENVD_PBK_IV_3 FORMAT "%3.0"
 /begin AXIS_DESCR COM_AXIS errm_online_dummy _CNV_A_R_LINEAR_____0_CM 4 0. 255. FORMAT "%3.0" AXIS_PTS_REF ldpm_fmy_envd /end AXIS_DESCR
/end CHARACTERISTIC
/begin CHARACTERISTIC fmy_id_pbk_iv_4.envd "Freeze frame FRF_CUS_SET_SPC: environmental data contents for failure XX" CURVE 0xa0804274 _REC_CUR_20_u1_u1 254. _CNV_A_R_LINEAR_____0_CM 1. 255. DISPLAY_IDENTIFIER ID_ERR_ENVD_PBK_IV_4 FORMAT "%3.0"
 /begin AXIS_DESCR COM_AXIS errm_online_dummy _CNV_A_R_LINEAR_____0_CM 4 0. 255. FORMAT "%3.0" AXIS_PTS_REF ldpm_fmy_envd /end AXIS_DESCR
/end CHARACTERISTIC
/begin MEASUREMENT fmy_ram_dyn[0].err_info_dyn.lv_cdn_diag_dc "Flag to detect that diag conditions have been met during DC" UWORD _CNV_S_2_RANGE__0___1_CM 1 100. 0. 1. DISPLAY_IDENTIFIER LV_CDN_DIAG_DC[0] ECU_ADDRESS 0xd000931c BIT_MASK 0x10 /end MEASUREMENT
/begin MEASUREMENT fmy_ram_dyn[0].ctr_dc_err_det "Number of driving cycles since DTC detection" UBYTE _CNV_A_R_LINEAR_____0_CM 1 100. 0. 255. DISPLAY_IDENTIFIER CTR_DC_ERR_DET[0] ECU_ADDRESS 0xd0009322 FORMAT "%3.0" /end MEASUREMENT
/begin MEASUREMENT fmy_ram_dyn[0].ctr_dc_err_det_diag_cdn "Number of DC since DTC detection with diag started" UBYTE _CNV_A_R_LINEAR_____0_CM 1 100. 0. 255. DISPLAY_IDENTIFIER CTR_DC_ERR_DET_DIAG_CDN[0] ECU_ADDRESS 0xd0009323 FORMAT "%3.0" /end MEASUREMENT
/begin MEASUREMENT fmy_ram_dyn[0].ctr_dc_err_det_diag_cmpl "Number of DC since DTC detection with diag completed" UBYTE _CNV_A_R_LINEAR_____0_CM 1 100. 0. 255. DISPLAY_IDENTIFIER CTR_DC_ERR_DET_DIAG_CMPL[0] ECU_ADDRESS 0xd0009324 FORMAT "%3.0" /end MEASUREMENT
/begin MEASUREMENT fmy_ram_dyn[1].err_info_dyn.lv_cdn_diag_dc "Flag to detect that diag conditions have been met during DC" UWORD _CNV_S_2_RANGE__0___1_CM 1 100. 0. 1. DISPLAY_IDENTIFIER LV_CDN_DIAG_DC[1] ECU_ADDRESS 0xd000932c BIT_MASK 0x10 /end MEASUREMENT
/begin MEASUREMENT fmy_ram_dyn[1].ctr_dc_err_det "Number of driving cycles since DTC detection" UBYTE _CNV_A_R_LINEAR_____0_CM 1 100. 0. 255. DISPLAY_IDENTIFIER CTR_DC_ERR_DET[1] ECU_ADDRESS 0xd0009332 FORMAT "%3.0" /end MEASUREMENT
/begin MEASUREMENT fmy_ram_dyn[1].ctr_dc_err_det_diag_cdn "Number of DC since DTC detection with diag started" UBYTE _CNV_A_R_LINEAR_____0_CM 1 100. 0. 255. DISPLAY_IDENTIFIER CTR_DC_ERR_DET_DIAG_CDN[1] ECU_ADDRESS 0xd0009333 FORMAT "%3.0" /end MEASUREMENT
/begin MEASUREMENT fmy_ram_dyn[1].ctr_dc_err_det_diag_cmpl "Number of DC since DTC detection with diag completed" UBYTE _CNV_A_R_LINEAR_____0_CM 1 100. 0. 255. DISPLAY_IDENTIFIER CTR_DC_ERR_DET_DIAG_CMPL[1] ECU_ADDRESS 0xd0009334 FORMAT "%3.0" /end MEASUREMENT
/begin MEASUREMENT fmy_ram_dyn[2].err_info_dyn.lv_cdn_diag_dc "Flag to detect that diag conditions have been met during DC" UWORD _CNV_S_2_RANGE__0___1_CM 1 100. 0. 1. DISPLAY_IDENTIFIER LV_CDN_DIAG_DC[2] ECU_ADDRESS 0xd000933c BIT_MASK 0x10 /end MEASUREMENT
/begin MEASUREMENT fmy_ram_dyn[2].ctr_dc_err_det "Number of driving cycles since DTC detection" UBYTE _CNV_A_R_LINEAR_____0_CM 1 100. 0. 255. DISPLAY_IDENTIFIER CTR_DC_ERR_DET[2] ECU_ADDRESS 0xd0009342 FORMAT "%3.0" /end MEASUREMENT
/begin MEASUREMENT fmy_ram_dyn[2].ctr_dc_err_det_diag_cdn "Number of DC since DTC detection with diag started" UBYTE _CNV_A_R_LINEAR_____0_CM 1 100. 0. 255. DISPLAY_IDENTIFIER CTR_DC_ERR_DET_DIAG_CDN[2] ECU_ADDRESS 0xd0009343 FORMAT "%3.0" /end MEASUREMENT
/begin MEASUREMENT fmy_ram_dyn[2].ctr_dc_err_det_diag_cmpl "Number of DC since DTC detection with diag completed" UBYTE _CNV_A_R_LINEAR_____0_CM 1 100. 0. 255. DISPLAY_IDENTIFIER CTR_DC_ERR_DET_DIAG_CMPL[2] ECU_ADDRESS 0xd0009344 FORMAT "%3.0" /end MEASUREMENT
/begin MEASUREMENT fmy_ram_dyn[3].err_info_dyn.lv_cdn_diag_dc "Flag to detect that diag conditions have been met during DC" UWORD _CNV_S_2_RANGE__0___1_CM 1 100. 0. 1. DISPLAY_IDENTIFIER LV_CDN_DIAG_DC[3] ECU_ADDRESS 0xd000934c BIT_MASK 0x10 /end MEASUREMENT
/begin MEASUREMENT fmy_ram_dyn[3].ctr_dc_err_det "Number of driving cycles since DTC detection" UBYTE _CNV_A_R_LINEAR_____0_CM 1 100. 0. 255. DISPLAY_IDENTIFIER CTR_DC_ERR_DET[3] ECU_ADDRESS 0xd0009352 FORMAT "%3.0" /end MEASUREMENT
/begin MEASUREMENT fmy_ram_dyn[3].ctr_dc_err_det_diag_cdn "Number of DC since DTC detection with diag started" UBYTE _CNV_A_R_LINEAR_____0_CM 1 100. 0. 255. DISPLAY_IDENTIFIER CTR_DC_ERR_DET_DIAG_CDN[3] ECU_ADDRESS 0xd0009353 FORMAT "%3.0" /end MEASUREMENT
/begin MEASUREMENT fmy_ram_dyn[3].ctr_dc_err_det_diag_cmpl "Number of DC since DTC detection with diag completed" UBYTE _CNV_A_R_LINEAR_____0_CM 1 100. 0. 255. DISPLAY_IDENTIFIER CTR_DC_ERR_DET_DIAG_CMPL[3] ECU_ADDRESS 0xd0009354 FORMAT "%3.0" /end MEASUREMENT
/begin MEASUREMENT fmy_ram_dyn[4].err_info_dyn.lv_cdn_diag_dc "Flag to detect that diag conditions have been met during DC" UWORD _CNV_S_2_RANGE__0___1_CM 1 100. 0. 1. DISPLAY_IDENTIFIER LV_CDN_DIAG_DC[4] ECU_ADDRESS 0xd000935c BIT_MASK 0x10 /end MEASUREMENT
/begin MEASUREMENT fmy_ram_dyn[4].ctr_dc_err_det "Number of driving cycles since DTC detection" UBYTE _CNV_A_R_LINEAR_____0_CM 1 100. 0. 255. DISPLAY_IDENTIFIER CTR_DC_ERR_DET[4] ECU_ADDRESS 0xd0009362 FORMAT "%3.0" /end MEASUREMENT
/begin MEASUREMENT fmy_ram_dyn[4].ctr_dc_err_det_diag_cdn "Number of DC since DTC detection with diag started" UBYTE _CNV_A_R_LINEAR_____0_CM 1 100. 0. 255. DISPLAY_IDENTIFIER CTR_DC_ERR_DET_DIAG_CDN[4] ECU_ADDRESS 0xd0009363 FORMAT "%3.0" /end MEASUREMENT
/begin MEASUREMENT fmy_ram_dyn[4].ctr_dc_err_det_diag_cmpl "Number of DC since DTC detection with diag completed" UBYTE _CNV_A_R_LINEAR_____0_CM 1 100. 0. 255. DISPLAY_IDENTIFIER CTR_DC_ERR_DET_DIAG_CMPL[4] ECU_ADDRESS 0xd0009364 FORMAT "%3.0" /end MEASUREMENT
/begin MEASUREMENT fmy_ram_dyn[5].err_info_dyn.lv_cdn_diag_dc "Flag to detect that diag conditions have been met during DC" UWORD _CNV_S_2_RANGE__0___1_CM 1 100. 0. 1. DISPLAY_IDENTIFIER LV_CDN_DIAG_DC[5] ECU_ADDRESS 0xd000936c BIT_MASK 0x10 /end MEASUREMENT
/begin MEASUREMENT fmy_ram_dyn[5].ctr_dc_err_det "Number of driving cycles since DTC detection" UBYTE _CNV_A_R_LINEAR_____0_CM 1 100. 0. 255. DISPLAY_IDENTIFIER CTR_DC_ERR_DET[5] ECU_ADDRESS 0xd0009372 FORMAT "%3.0" /end MEASUREMENT
/begin MEASUREMENT fmy_ram_dyn[5].ctr_dc_err_det_diag_cdn "Number of DC since DTC detection with diag started" UBYTE _CNV_A_R_LINEAR_____0_CM 1 100. 0. 255. DISPLAY_IDENTIFIER CTR_DC_ERR_DET_DIAG_CDN[5] ECU_ADDRESS 0xd0009373 FORMAT "%3.0" /end MEASUREMENT
/begin MEASUREMENT fmy_ram_dyn[5].ctr_dc_err_det_diag_cmpl "Number of DC since DTC detection with diag completed" UBYTE _CNV_A_R_LINEAR_____0_CM 1 100. 0. 255. DISPLAY_IDENTIFIER CTR_DC_ERR_DET_DIAG_CMPL[5] ECU_ADDRESS 0xd0009374 FORMAT "%3.0" /end MEASUREMENT
/begin MEASUREMENT fmy_ram_dyn[6].err_info_dyn.lv_cdn_diag_dc "Flag to detect that diag conditions have been met during DC" UWORD _CNV_S_2_RANGE__0___1_CM 1 100. 0. 1. DISPLAY_IDENTIFIER LV_CDN_DIAG_DC[6] ECU_ADDRESS 0xd000937c BIT_MASK 0x10 /end MEASUREMENT
/begin MEASUREMENT fmy_ram_dyn[6].ctr_dc_err_det "Number of driving cycles since DTC detection" UBYTE _CNV_A_R_LINEAR_____0_CM 1 100. 0. 255. DISPLAY_IDENTIFIER CTR_DC_ERR_DET[6] ECU_ADDRESS 0xd0009382 FORMAT "%3.0" /end MEASUREMENT
/begin MEASUREMENT fmy_ram_dyn[6].ctr_dc_err_det_diag_cdn "Number of DC since DTC detection with diag started" UBYTE _CNV_A_R_LINEAR_____0_CM 1 100. 0. 255. DISPLAY_IDENTIFIER CTR_DC_ERR_DET_DIAG_CDN[6] ECU_ADDRESS 0xd0009383 FORMAT "%3.0" /end MEASUREMENT
/begin MEASUREMENT fmy_ram_dyn[6].ctr_dc_err_det_diag_cmpl "Number of DC since DTC detection with diag completed" UBYTE _CNV_A_R_LINEAR_____0_CM 1 100. 0. 255. DISPLAY_IDENTIFIER CTR_DC_ERR_DET_DIAG_CMPL[6] ECU_ADDRESS 0xd0009384 FORMAT "%3.0" /end MEASUREMENT
/begin MEASUREMENT fmy_ram_dyn[7].err_info_dyn.lv_cdn_diag_dc "Flag to detect that diag conditions have been met during DC" UWORD _CNV_S_2_RANGE__0___1_CM 1 100. 0. 1. DISPLAY_IDENTIFIER LV_CDN_DIAG_DC[7] ECU_ADDRESS 0xd000938c BIT_MASK 0x10 /end MEASUREMENT
/begin MEASUREMENT fmy_ram_dyn[7].ctr_dc_err_det "Number of driving cycles since DTC detection" UBYTE _CNV_A_R_LINEAR_____0_CM 1 100. 0. 255. DISPLAY_IDENTIFIER CTR_DC_ERR_DET[7] ECU_ADDRESS 0xd0009392 FORMAT "%3.0" /end MEASUREMENT
/begin MEASUREMENT fmy_ram_dyn[7].ctr_dc_err_det_diag_cdn "Number of DC since DTC detection with diag started" UBYTE _CNV_A_R_LINEAR_____0_CM 1 100. 0. 255. DISPLAY_IDENTIFIER CTR_DC_ERR_DET_DIAG_CDN[7] ECU_ADDRESS 0xd0009393 FORMAT "%3.0" /end MEASUREMENT
/begin MEASUREMENT fmy_ram_dyn[7].ctr_dc_err_det_diag_cmpl "Number of DC since DTC detection with diag completed" UBYTE _CNV_A_R_LINEAR_____0_CM 1 100. 0. 255. DISPLAY_IDENTIFIER CTR_DC_ERR_DET_DIAG_CMPL[7] ECU_ADDRESS 0xd0009394 FORMAT "%3.0" /end MEASUREMENT
/begin MEASUREMENT fmy_ram_dyn[8].err_info_dyn.lv_cdn_diag_dc "Flag to detect that diag conditions have been met during DC" UWORD _CNV_S_2_RANGE__0___1_CM 1 100. 0. 1. DISPLAY_IDENTIFIER LV_CDN_DIAG_DC[8] ECU_ADDRESS 0xd000939c BIT_MASK 0x10 /end MEASUREMENT
/begin MEASUREMENT fmy_ram_dyn[8].ctr_dc_err_det "Number of driving cycles since DTC detection" UBYTE _CNV_A_R_LINEAR_____0_CM 1 100. 0. 255. DISPLAY_IDENTIFIER CTR_DC_ERR_DET[8] ECU_ADDRESS 0xd00093a2 FORMAT "%3.0" /end MEASUREMENT
/begin MEASUREMENT fmy_ram_dyn[8].ctr_dc_err_det_diag_cdn "Number of DC since DTC detection with diag started" UBYTE _CNV_A_R_LINEAR_____0_CM 1 100. 0. 255. DISPLAY_IDENTIFIER CTR_DC_ERR_DET_DIAG_CDN[8] ECU_ADDRESS 0xd00093a3 FORMAT "%3.0" /end MEASUREMENT
/begin MEASUREMENT fmy_ram_dyn[8].ctr_dc_err_det_diag_cmpl "Number of DC since DTC detection with diag completed" UBYTE _CNV_A_R_LINEAR_____0_CM 1 100. 0. 255. DISPLAY_IDENTIFIER CTR_DC_ERR_DET_DIAG_CMPL[8] ECU_ADDRESS 0xd00093a4 FORMAT "%3.0" /end MEASUREMENT
/begin MEASUREMENT fmy_ram_dyn[9].err_info_dyn.lv_cdn_diag_dc "Flag to detect that diag conditions have been met during DC" UWORD _CNV_S_2_RANGE__0___1_CM 1 100. 0. 1. DISPLAY_IDENTIFIER LV_CDN_DIAG_DC[9] ECU_ADDRESS 0xd00093ac BIT_MASK 0x10 /end MEASUREMENT
/begin MEASUREMENT fmy_ram_dyn[9].ctr_dc_err_det "Number of driving cycles since DTC detection" UBYTE _CNV_A_R_LINEAR_____0_CM 1 100. 0. 255. DISPLAY_IDENTIFIER CTR_DC_ERR_DET[9] ECU_ADDRESS 0xd00093b2 FORMAT "%3.0" /end MEASUREMENT
/begin MEASUREMENT fmy_ram_dyn[9].ctr_dc_err_det_diag_cdn "Number of DC since DTC detection with diag started" UBYTE _CNV_A_R_LINEAR_____0_CM 1 100. 0. 255. DISPLAY_IDENTIFIER CTR_DC_ERR_DET_DIAG_CDN[9] ECU_ADDRESS 0xd00093b3 FORMAT "%3.0" /end MEASUREMENT
/begin MEASUREMENT fmy_ram_dyn[9].ctr_dc_err_det_diag_cmpl "Number of DC since DTC detection with diag completed" UBYTE _CNV_A_R_LINEAR_____0_CM 1 100. 0. 255. DISPLAY_IDENTIFIER CTR_DC_ERR_DET_DIAG_CMPL[9] ECU_ADDRESS 0xd00093b4 FORMAT "%3.0" /end MEASUREMENT
/begin CHARACTERISTIC c_t_ast_rbm "" VALUE 0xa0804eca _REC_VAL_20_u2 6553.5 _CNV_A_R_LINEAR_____4_CM 0. 6553.5 DISPLAY_IDENTIFIER C_T_AST_RBM FORMAT "%6.1" /end CHARACTERISTIC
/begin CHARACTERISTIC c_vs_thd_rbm "" VALUE 0xa0804edb _REC_VAL_20_u1 255. _CNV_A_R_LINEAR_____6_CM 0. 255. DISPLAY_IDENTIFIER C_VS_THD_RBM FORMAT "%3.0" /end CHARACTERISTIC
/begin CHARACTERISTIC c_t_vs_rbm "" VALUE 0xa0804ed0 _REC_VAL_20_u2 6553.5 _CNV_A_R_LINEAR_____4_CM 0. 6553.5 DISPLAY_IDENTIFIER C_T_VS_RBM FORMAT "%6.1" /end CHARACTERISTIC
/begin CHARACTERISTIC c_tam_min_rbm "" VALUE 0xa0804ed4 _REC_VAL_20_u1 190.5 _CNV_A_R_LINEAR_____17_CM -48. 142.5 DISPLAY_IDENTIFIER C_TAM_MIN_RBM FORMAT "%6.2" /end CHARACTERISTIC
/begin CHARACTERISTIC c_amp_min_rbm "" VALUE 0xa0804eb6 _REC_VAL_20_u2 5434. _CNV_A_R_LINEAR_____27_CM 0. 5434. DISPLAY_IDENTIFIER C_AMP_MIN_RBM FORMAT "%7.2" /end CHARACTERISTIC
/begin CHARACTERISTIC c_dly_ast_rbm "" VALUE 0xa0804ebc _REC_VAL_20_u2 6553.5 _CNV_A_R_LINEAR_____4_CM 0. 6553.5 DISPLAY_IDENTIFIER C_DLY_AST_RBM FORMAT "%6.1" /end CHARACTERISTIC
/begin MEASUREMENT ctr_igk_cyc_rbm "" UWORD _CNV_A_R_LINEAR_____0_CM 1 100. 0. 65535. DISPLAY_IDENTIFIER CTR_IGK_CYC_RBM ECU_ADDRESS 0xd0009fde FORMAT "%5.0" /end MEASUREMENT
/begin MEASUREMENT ctr_cdn_obd_rbm "" UWORD _CNV_A_R_LINEAR_____0_CM 1 100. 0. 65535. DISPLAY_IDENTIFIER CTR_CDN_OBD_RBM ECU_ADDRESS 0xd0009fdc FORMAT "%5.0" /end MEASUREMENT
/begin MEASUREMENT lv_igk_cyc_rbm "" UBYTE _CNV_S_2_RANGE__0___1_CM 1 100. 0. 1. DISPLAY_IDENTIFIER LV_IGK_CYC_RBM ECU_ADDRESS 0xd000279c BIT_MASK 0x1 /end MEASUREMENT
/begin MEASUREMENT lv_dc_rbm "" UBYTE _CNV_S_2_RANGE__0___1_CM 1 100. 0. 1. DISPLAY_IDENTIFIER LV_DC_RBM ECU_ADDRESS 0xd0008142 BIT_MASK 0x1 /end MEASUREMENT
/begin MEASUREMENT t_ast_rbm "" UWORD _CNV_A_R_LINEAR_____4_CM 1 100. 0. 6553.5 DISPLAY_IDENTIFIER T_AST_RBM ECU_ADDRESS 0xd0002786 FORMAT "%6.1" /end MEASUREMENT
/begin MEASUREMENT t_vs_rbm "" UWORD _CNV_A_R_LINEAR_____4_CM 1 100. 0. 6553.5 DISPLAY_IDENTIFIER T_VS_RBM ECU_ADDRESS 0xd000278a FORMAT "%6.1" /end MEASUREMENT
/begin MEASUREMENT t_is_rbm "" UWORD _CNV_A_R_LINEAR_____4_CM 1 100. 0. 6553.5 DISPLAY_IDENTIFIER T_IS_RBM ECU_ADDRESS 0xd0002788 FORMAT "%6.1" /end MEASUREMENT
/begin CHARACTERISTIC c_t_is_rbm "" VALUE 0xa0804ecc _REC_VAL_20_u2 6553.5 _CNV_A_R_LINEAR_____4_CM 0. 6553.5 DISPLAY_IDENTIFIER C_T_IS_RBM FORMAT "%6.1" /end CHARACTERISTIC
/begin MEASUREMENT state_dc_rbm "" UBYTE _CNV_A_R_LINEAR_____0_CM 1 100. 0. 255. DISPLAY_IDENTIFIER STATE_DC_RBM ECU_ADDRESS 0xd0002796 FORMAT "%3.0" /end MEASUREMENT
/begin CHARACTERISTIC c_vs_thd_is_cdn_rbm "" VALUE 0xa0804eda _REC_VAL_20_u1 25.5 _CNV_A_R_LINEAR_____45_CM 0. 25.5 DISPLAY_IDENTIFIER C_VS_THD_IS_CDN_RBM FORMAT "%4.1" /end CHARACTERISTIC
/begin CHARACTERISTIC c_pv_is_rbm "" VALUE 0xa0804ec2 _REC_VAL_20_u2 99.90234375 _CNV_A_R_CPULOAD__0_448_CM 0. 99.90234375 DISPLAY_IDENTIFIER C_PV_IS_RBM FORMAT "%5.2" /end CHARACTERISTIC
/begin MEASUREMENT state_rbm[0] "" UBYTE _CNV_A_R_LINEAR_____0_CM 1 100. 0. 15. DISPLAY_IDENTIFIER STATE_RBM[0] ECU_ADDRESS 0xd0008154 FORMAT "%3.0" /end MEASUREMENT
/begin MEASUREMENT state_rbm[1] "" UBYTE _CNV_A_R_LINEAR_____0_CM 1 100. 0. 15. DISPLAY_IDENTIFIER STATE_RBM[1] ECU_ADDRESS 0xd0008155 FORMAT "%3.0" /end MEASUREMENT
/begin MEASUREMENT state_rbm[2] "" UBYTE _CNV_A_R_LINEAR_____0_CM 1 100. 0. 15. DISPLAY_IDENTIFIER STATE_RBM[2] ECU_ADDRESS 0xd0008156 FORMAT "%3.0" /end MEASUREMENT
/begin MEASUREMENT state_rbm[3] "" UBYTE _CNV_A_R_LINEAR_____0_CM 1 100. 0. 15. DISPLAY_IDENTIFIER STATE_RBM[3] ECU_ADDRESS 0xd0008157 FORMAT "%3.0" /end MEASUREMENT
/begin MEASUREMENT state_rbm[4] "" UBYTE _CNV_A_R_LINEAR_____0_CM 1 100. 0. 15. DISPLAY_IDENTIFIER STATE_RBM[4] ECU_ADDRESS 0xd0008158 FORMAT "%3.0" /end MEASUREMENT
/begin MEASUREMENT state_rbm[5] "" UBYTE _CNV_A_R_LINEAR_____0_CM 1 100. 0. 15. DISPLAY_IDENTIFIER STATE_RBM[5] ECU_ADDRESS 0xd0008159 FORMAT "%3.0" /end MEASUREMENT
/begin MEASUREMENT state_rbm[6] "" UBYTE _CNV_A_R_LINEAR_____0_CM 1 100. 0. 15. DISPLAY_IDENTIFIER STATE_RBM[6] ECU_ADDRESS 0xd000815a FORMAT "%3.0" /end MEASUREMENT
/begin MEASUREMENT state_rbm[7] "" UBYTE _CNV_A_R_LINEAR_____0_CM 1 100. 0. 15. DISPLAY_IDENTIFIER STATE_RBM[7] ECU_ADDRESS 0xd000815b FORMAT "%3.0" /end MEASUREMENT
/begin MEASUREMENT state_rbm[8] "" UBYTE _CNV_A_R_LINEAR_____0_CM 1 100. 0. 15. DISPLAY_IDENTIFIER STATE_RBM[8] ECU_ADDRESS 0xd000815c FORMAT "%3.0" /end MEASUREMENT
/begin MEASUREMENT state_rbm[9] "" UBYTE _CNV_A_R_LINEAR_____0_CM 1 100. 0. 15. DISPLAY_IDENTIFIER STATE_RBM[9] ECU_ADDRESS 0xd000815d FORMAT "%3.0" /end MEASUREMENT
/begin MEASUREMENT state_rbm[10] "" UBYTE _CNV_A_R_LINEAR_____0_CM 1 100. 0. 15. DISPLAY_IDENTIFIER STATE_RBM[10] ECU_ADDRESS 0xd000815e FORMAT "%3.0" /end MEASUREMENT
/begin MEASUREMENT state_rbm[11] "" UBYTE _CNV_A_R_LINEAR_____0_CM 1 100. 0. 15. DISPLAY_IDENTIFIER STATE_RBM[11] ECU_ADDRESS 0xd000815f FORMAT "%3.0" /end MEASUREMENT
/begin MEASUREMENT state_rbm[12] "" UBYTE _CNV_A_R_LINEAR_____0_CM 1 100. 0. 15. DISPLAY_IDENTIFIER STATE_RBM[12] ECU_ADDRESS 0xd0008160 FORMAT "%3.0" /end MEASUREMENT
/begin MEASUREMENT state_rbm[13] "" UBYTE _CNV_A_R_LINEAR_____0_CM 1 100. 0. 15. DISPLAY_IDENTIFIER STATE_RBM[13] ECU_ADDRESS 0xd0008161 FORMAT "%3.0" /end MEASUREMENT
/begin MEASUREMENT state_rbm[14] "" UBYTE _CNV_A_R_LINEAR_____0_CM 1 100. 0. 15. DISPLAY_IDENTIFIER STATE_RBM[14] ECU_ADDRESS 0xd0008162 FORMAT "%3.0" /end MEASUREMENT
/begin MEASUREMENT state_rbm[15] "" UBYTE _CNV_A_R_LINEAR_____0_CM 1 100. 0. 15. DISPLAY_IDENTIFIER STATE_RBM[15] ECU_ADDRESS 0xd0008163 FORMAT "%3.0" /end MEASUREMENT
/begin MEASUREMENT state_rbm[16] "" UBYTE _CNV_A_R_LINEAR_____0_CM 1 100. 0. 15. DISPLAY_IDENTIFIER STATE_RBM[16] ECU_ADDRESS 0xd0008164 FORMAT "%3.0" /end MEASUREMENT
/begin MEASUREMENT state_rbm[17] "" UBYTE _CNV_A_R_LINEAR_____0_CM 1 100. 0. 15. DISPLAY_IDENTIFIER STATE_RBM[17] ECU_ADDRESS 0xd0008165 FORMAT "%3.0" /end MEASUREMENT
/begin MEASUREMENT state_rbm[18] "" UBYTE _CNV_A_R_LINEAR_____0_CM 1 100. 0. 15. DISPLAY_IDENTIFIER STATE_RBM[18] ECU_ADDRESS 0xd0008166 FORMAT "%3.0" /end MEASUREMENT
/begin MEASUREMENT state_rbm[19] "" UBYTE _CNV_A_R_LINEAR_____0_CM 1 100. 0. 15. DISPLAY_IDENTIFIER STATE_RBM[19] ECU_ADDRESS 0xd0008167 FORMAT "%3.0" /end MEASUREMENT
/begin MEASUREMENT state_rbm[20] "" UBYTE _CNV_A_R_LINEAR_____0_CM 1 100. 0. 15. DISPLAY_IDENTIFIER STATE_RBM[20] ECU_ADDRESS 0xd0008168 FORMAT "%3.0" /end MEASUREMENT
/begin MEASUREMENT state_rbm[21] "" UBYTE _CNV_A_R_LINEAR_____0_CM 1 100. 0. 15. DISPLAY_IDENTIFIER STATE_RBM[21] ECU_ADDRESS 0xd0008169 FORMAT "%3.0" /end MEASUREMENT
/begin MEASUREMENT state_rbm[22] "" UBYTE _CNV_A_R_LINEAR_____0_CM 1 100. 0. 15. DISPLAY_IDENTIFIER STATE_RBM[22] ECU_ADDRESS 0xd000816a FORMAT "%3.0" /end MEASUREMENT
/begin MEASUREMENT state_rbm[23] "" UBYTE _CNV_A_R_LINEAR_____0_CM 1 100. 0. 15. DISPLAY_IDENTIFIER STATE_RBM[23] ECU_ADDRESS 0xd000816b FORMAT "%3.0" /end MEASUREMENT
/begin MEASUREMENT state_rbm[24] "" UBYTE _CNV_A_R_LINEAR_____0_CM 1 100. 0. 15. DISPLAY_IDENTIFIER STATE_RBM[24] ECU_ADDRESS 0xd000816c FORMAT "%3.0" /end MEASUREMENT
/begin MEASUREMENT state_rbm[25] "" UBYTE _CNV_A_R_LINEAR_____0_CM 1 100. 0. 15. DISPLAY_IDENTIFIER STATE_RBM[25] ECU_ADDRESS 0xd000816d FORMAT "%3.0" /end MEASUREMENT
/begin MEASUREMENT state_rbm[26] "" UBYTE _CNV_A_R_LINEAR_____0_CM 1 100. 0. 15. DISPLAY_IDENTIFIER STATE_RBM[26] ECU_ADDRESS 0xd000816e FORMAT "%3.0" /end MEASUREMENT
/begin MEASUREMENT state_rbm[27] "" UBYTE _CNV_A_R_LINEAR_____0_CM 1 100. 0. 15. DISPLAY_IDENTIFIER STATE_RBM[27] ECU_ADDRESS 0xd000816f FORMAT "%3.0" /end MEASUREMENT
/begin MEASUREMENT state_rbm[28] "" UBYTE _CNV_A_R_LINEAR_____0_CM 1 100. 0. 15. DISPLAY_IDENTIFIER STATE_RBM[28] ECU_ADDRESS 0xd0008170 FORMAT "%3.0" /end MEASUREMENT
/begin MEASUREMENT state_rbm[29] "" UBYTE _CNV_A_R_LINEAR_____0_CM 1 100. 0. 15. DISPLAY_IDENTIFIER STATE_RBM[29] ECU_ADDRESS 0xd0008171 FORMAT "%3.0" /end MEASUREMENT
/begin MEASUREMENT state_rbm[30] "" UBYTE _CNV_A_R_LINEAR_____0_CM 1 100. 0. 15. DISPLAY_IDENTIFIER STATE_RBM[30] ECU_ADDRESS 0xd0008172 FORMAT "%3.0" /end MEASUREMENT
/begin MEASUREMENT state_rbm[31] "" UBYTE _CNV_A_R_LINEAR_____0_CM 1 100. 0. 15. DISPLAY_IDENTIFIER STATE_RBM[31] ECU_ADDRESS 0xd0008173 FORMAT "%3.0" /end MEASUREMENT
/begin MEASUREMENT state_rbm[32] "" UBYTE _CNV_A_R_LINEAR_____0_CM 1 100. 0. 15. DISPLAY_IDENTIFIER STATE_RBM[32] ECU_ADDRESS 0xd0008174 FORMAT "%3.0" /end MEASUREMENT
/begin MEASUREMENT state_rbm[33] "" UBYTE _CNV_A_R_LINEAR_____0_CM 1 100. 0. 15. DISPLAY_IDENTIFIER STATE_RBM[33] ECU_ADDRESS 0xd0008175 FORMAT "%3.0" /end MEASUREMENT
/begin MEASUREMENT state_rbm[34] "" UBYTE _CNV_A_R_LINEAR_____0_CM 1 100. 0. 15. DISPLAY_IDENTIFIER STATE_RBM[34] ECU_ADDRESS 0xd0008176 FORMAT "%3.0" /end MEASUREMENT
/begin MEASUREMENT state_rbm[35] "" UBYTE _CNV_A_R_LINEAR_____0_CM 1 100. 0. 15. DISPLAY_IDENTIFIER STATE_RBM[35] ECU_ADDRESS 0xd0008177 FORMAT "%3.0" /end MEASUREMENT
/begin MEASUREMENT state_rbm[36] "" UBYTE _CNV_A_R_LINEAR_____0_CM 1 100. 0. 15. DISPLAY_IDENTIFIER STATE_RBM[36] ECU_ADDRESS 0xd0008178 FORMAT "%3.0" /end MEASUREMENT
/begin MEASUREMENT state_rbm[37] "" UBYTE _CNV_A_R_LINEAR_____0_CM 1 100. 0. 15. DISPLAY_IDENTIFIER STATE_RBM[37] ECU_ADDRESS 0xd0008179 FORMAT "%3.0" /end MEASUREMENT
/begin MEASUREMENT state_rbm[38] "" UBYTE _CNV_A_R_LINEAR_____0_CM 1 100. 0. 15. DISPLAY_IDENTIFIER STATE_RBM[38] ECU_ADDRESS 0xd000817a FORMAT "%3.0" /end MEASUREMENT
/begin MEASUREMENT state_rbm[39] "" UBYTE _CNV_A_R_LINEAR_____0_CM 1 100. 0. 15. DISPLAY_IDENTIFIER STATE_RBM[39] ECU_ADDRESS 0xd000817b FORMAT "%3.0" /end MEASUREMENT
/begin MEASUREMENT state_rbm[40] "" UBYTE _CNV_A_R_LINEAR_____0_CM 1 100. 0. 15. DISPLAY_IDENTIFIER STATE_RBM[40] ECU_ADDRESS 0xd000817c FORMAT "%3.0" /end MEASUREMENT
/begin MEASUREMENT state_rbm[41] "" UBYTE _CNV_A_R_LINEAR_____0_CM 1 100. 0. 15. DISPLAY_IDENTIFIER STATE_RBM[41] ECU_ADDRESS 0xd000817d FORMAT "%3.0" /end MEASUREMENT
/begin MEASUREMENT state_rbm[42] "" UBYTE _CNV_A_R_LINEAR_____0_CM 1 100. 0. 15. DISPLAY_IDENTIFIER STATE_RBM[42] ECU_ADDRESS 0xd000817e FORMAT "%3.0" /end MEASUREMENT
/begin MEASUREMENT state_rbm[43] "" UBYTE _CNV_A_R_LINEAR_____0_CM 1 100. 0. 15. DISPLAY_IDENTIFIER STATE_RBM[43] ECU_ADDRESS 0xd000817f FORMAT "%3.0" /end MEASUREMENT
/begin MEASUREMENT state_rbm[44] "" UBYTE _CNV_A_R_LINEAR_____0_CM 1 100. 0. 15. DISPLAY_IDENTIFIER STATE_RBM[44] ECU_ADDRESS 0xd0008180 FORMAT "%3.0" /end MEASUREMENT
/begin MEASUREMENT state_rbm[45] "" UBYTE _CNV_A_R_LINEAR_____0_CM 1 100. 0. 15. DISPLAY_IDENTIFIER STATE_RBM[45] ECU_ADDRESS 0xd0008181 FORMAT "%3.0" /end MEASUREMENT
/begin MEASUREMENT state_rbm[46] "" UBYTE _CNV_A_R_LINEAR_____0_CM 1 100. 0. 15. DISPLAY_IDENTIFIER STATE_RBM[46] ECU_ADDRESS 0xd0008182 FORMAT "%3.0" /end MEASUREMENT
/begin MEASUREMENT state_rbm[47] "" UBYTE _CNV_A_R_LINEAR_____0_CM 1 100. 0. 15. DISPLAY_IDENTIFIER STATE_RBM[47] ECU_ADDRESS 0xd0008183 FORMAT "%3.0" /end MEASUREMENT
/begin MEASUREMENT state_rbm[48] "" UBYTE _CNV_A_R_LINEAR_____0_CM 1 100. 0. 15. DISPLAY_IDENTIFIER STATE_RBM[48] ECU_ADDRESS 0xd0008184 FORMAT "%3.0" /end MEASUREMENT
/begin MEASUREMENT rbm_stat_CAT_DIAG_1.ctr_comp_rbm "" UWORD _CNV_A_R_LINEAR_____0_CM 1 100. 0. 65535. DISPLAY_IDENTIFIER CTR_COMP_RBM_CAT_DIAG_1 ECU_ADDRESS 0xd0009b32 FORMAT "%5.0" /end MEASUREMENT
/begin MEASUREMENT rbm_stat_CAT_DIAG_1.ctr_cdn_rbm "" UWORD _CNV_A_R_LINEAR_____0_CM 1 100. 0. 65535. DISPLAY_IDENTIFIER CTR_CDN_RBM_CAT_DIAG_1 ECU_ADDRESS 0xd0009b34 FORMAT "%5.0" /end MEASUREMENT
/begin MEASUREMENT rbm_stat_CAT_DIAG_1.state_ctr_rbm "" UBYTE _CNV_A_R_LINEAR_____0_CM 1 100. 0. 3. DISPLAY_IDENTIFIER STATE_CTR_RBM_CAT_DIAG_1 ECU_ADDRESS 0xd0009b36 FORMAT "%3.0" /end MEASUREMENT
/begin MEASUREMENT rbm_stat_CAT_DIAG_2.ctr_comp_rbm "" UWORD _CNV_A_R_LINEAR_____0_CM 1 100. 0. 65535. DISPLAY_IDENTIFIER CTR_COMP_RBM_CAT_DIAG_2 ECU_ADDRESS 0xd0009b38 FORMAT "%5.0" /end MEASUREMENT
/begin MEASUREMENT rbm_stat_CAT_DIAG_2.ctr_cdn_rbm "" UWORD _CNV_A_R_LINEAR_____0_CM 1 100. 0. 65535. DISPLAY_IDENTIFIER CTR_CDN_RBM_CAT_DIAG_2 ECU_ADDRESS 0xd0009b3a FORMAT "%5.0" /end MEASUREMENT
/begin MEASUREMENT rbm_stat_CAT_DIAG_2.state_ctr_rbm "" UBYTE _CNV_A_R_LINEAR_____0_CM 1 100. 0. 3. DISPLAY_IDENTIFIER STATE_CTR_RBM_CAT_DIAG_2 ECU_ADDRESS 0xd0009b3c FORMAT "%3.0" /end MEASUREMENT
/begin MEASUREMENT rbm_stat_DYN_VLD_LS_UP_1.ctr_comp_rbm "" UWORD _CNV_A_R_LINEAR_____0_CM 1 100. 0. 65535. DISPLAY_IDENTIFIER CTR_COMP_RBM_DYN_VLD_LS_UP_1 ECU_ADDRESS 0xd0009b5c FORMAT "%5.0" /end MEASUREMENT
/begin MEASUREMENT rbm_stat_DYN_VLD_LS_UP_1.ctr_cdn_rbm "" UWORD _CNV_A_R_LINEAR_____0_CM 1 100. 0. 65535. DISPLAY_IDENTIFIER CTR_CDN_RBM_DYN_VLD_LS_UP_1 ECU_ADDRESS 0xd0009b5e FORMAT "%5.0" /end MEASUREMENT
/begin MEASUREMENT rbm_stat_DYN_VLD_LS_UP_1.state_ctr_rbm "" UBYTE _CNV_A_R_LINEAR_____0_CM 1 100. 0. 3. DISPLAY_IDENTIFIER STATE_CTR_RBM_DYN_VLD_LS_UP_1 ECU_ADDRESS 0xd0009b60 FORMAT "%3.0" /end MEASUREMENT
/begin MEASUREMENT rbm_stat_DYN_VLD_LS_UP_2.ctr_comp_rbm "" UWORD _CNV_A_R_LINEAR_____0_CM 1 100. 0. 65535. DISPLAY_IDENTIFIER CTR_COMP_RBM_DYN_VLD_LS_UP_2 ECU_ADDRESS 0xd0009b62 FORMAT "%5.0" /end MEASUREMENT
/begin MEASUREMENT rbm_stat_DYN_VLD_LS_UP_2.ctr_cdn_rbm "" UWORD _CNV_A_R_LINEAR_____0_CM 1 100. 0. 65535. DISPLAY_IDENTIFIER CTR_CDN_RBM_DYN_VLD_LS_UP_2 ECU_ADDRESS 0xd0009b64 FORMAT "%5.0" /end MEASUREMENT
/begin MEASUREMENT rbm_stat_DYN_VLD_LS_UP_2.state_ctr_rbm "" UBYTE _CNV_A_R_LINEAR_____0_CM 1 100. 0. 3. DISPLAY_IDENTIFIER STATE_CTR_RBM_DYN_VLD_LS_UP_2 ECU_ADDRESS 0xd0009b66 FORMAT "%3.0" /end MEASUREMENT
/begin MEASUREMENT rbm_stat_MEC_IVVT_IN.ctr_comp_rbm "" UWORD _CNV_A_R_LINEAR_____0_CM 1 100. 0. 65535. DISPLAY_IDENTIFIER CTR_COMP_RBM_MEC_IVVT_IN ECU_ADDRESS 0xd0009b92 FORMAT "%5.0" /end MEASUREMENT
/begin MEASUREMENT rbm_stat_MEC_IVVT_IN.ctr_cdn_rbm "" UWORD _CNV_A_R_LINEAR_____0_CM 1 100. 0. 65535. DISPLAY_IDENTIFIER CTR_CDN_RBM_MEC_IVVT_IN ECU_ADDRESS 0xd0009b94 FORMAT "%5.0" /end MEASUREMENT
/begin MEASUREMENT rbm_stat_MEC_IVVT_IN.state_ctr_rbm "" UBYTE _CNV_A_R_LINEAR_____0_CM 1 100. 0. 3. DISPLAY_IDENTIFIER STATE_CTR_RBM_MEC_IVVT_IN ECU_ADDRESS 0xd0009b96 FORMAT "%3.0" /end MEASUREMENT
/begin MEASUREMENT rbm_stat_SA_SYS.ctr_comp_rbm "" UWORD _CNV_A_R_LINEAR_____0_CM 1 100. 0. 65535. DISPLAY_IDENTIFIER CTR_COMP_RBM_SA_SYS ECU_ADDRESS 0xd0009be0 FORMAT "%5.0" /end MEASUREMENT
/begin MEASUREMENT rbm_stat_SA_SYS.ctr_cdn_rbm "" UWORD _CNV_A_R_LINEAR_____0_CM 1 100. 0. 65535. DISPLAY_IDENTIFIER CTR_CDN_RBM_SA_SYS ECU_ADDRESS 0xd0009be2 FORMAT "%5.0" /end MEASUREMENT
/begin MEASUREMENT rbm_stat_SA_SYS.state_ctr_rbm "" UBYTE _CNV_A_R_LINEAR_____0_CM 1 100. 0. 3. DISPLAY_IDENTIFIER STATE_CTR_RBM_SA_SYS ECU_ADDRESS 0xd0009be4 FORMAT "%3.0" /end MEASUREMENT
/begin MEASUREMENT rbm_stat_AIR_LSL_UP_1.ctr_comp_rbm "" UWORD _CNV_A_R_LINEAR_____0_CM 1 100. 0. 65535. DISPLAY_IDENTIFIER CTR_COMP_RBM_AIR_LSL_UP_1 ECU_ADDRESS 0xd0009b14 FORMAT "%5.0" /end MEASUREMENT
/begin MEASUREMENT rbm_stat_AIR_LSL_UP_1.ctr_cdn_rbm "" UWORD _CNV_A_R_LINEAR_____0_CM 1 100. 0. 65535. DISPLAY_IDENTIFIER CTR_CDN_RBM_AIR_LSL_UP_1 ECU_ADDRESS 0xd0009b16 FORMAT "%5.0" /end MEASUREMENT
/begin MEASUREMENT rbm_stat_AIR_LSL_UP_1.state_ctr_rbm "" UBYTE _CNV_A_R_LINEAR_____0_CM 1 100. 0. 3. DISPLAY_IDENTIFIER STATE_CTR_RBM_AIR_LSL_UP_1 ECU_ADDRESS 0xd0009b18 FORMAT "%3.0" /end MEASUREMENT
/begin MEASUREMENT rbm_stat_AIR_LSL_UP_2.ctr_comp_rbm "" UWORD _CNV_A_R_LINEAR_____0_CM 1 100. 0. 65535. DISPLAY_IDENTIFIER CTR_COMP_RBM_AIR_LSL_UP_2 ECU_ADDRESS 0xd0009b1a FORMAT "%5.0" /end MEASUREMENT
/begin MEASUREMENT rbm_stat_AIR_LSL_UP_2.ctr_cdn_rbm "" UWORD _CNV_A_R_LINEAR_____0_CM 1 100. 0. 65535. DISPLAY_IDENTIFIER CTR_CDN_RBM_AIR_LSL_UP_2 ECU_ADDRESS 0xd0009b1c FORMAT "%5.0" /end MEASUREMENT
/begin MEASUREMENT rbm_stat_AIR_LSL_UP_2.state_ctr_rbm "" UBYTE _CNV_A_R_LINEAR_____0_CM 1 100. 0. 3. DISPLAY_IDENTIFIER STATE_CTR_RBM_AIR_LSL_UP_2 ECU_ADDRESS 0xd0009b1e FORMAT "%3.0" /end MEASUREMENT
/begin MEASUREMENT rbm_stat_DMTLM.ctr_comp_rbm "" UWORD _CNV_A_R_LINEAR_____0_CM 1 100. 0. 65535. DISPLAY_IDENTIFIER CTR_COMP_RBM_DMTLM ECU_ADDRESS 0xd0009b56 FORMAT "%5.0" /end MEASUREMENT
/begin MEASUREMENT rbm_stat_DMTLM.ctr_cdn_rbm "" UWORD _CNV_A_R_LINEAR_____0_CM 1 100. 0. 65535. DISPLAY_IDENTIFIER CTR_CDN_RBM_DMTLM ECU_ADDRESS 0xd0009b58 FORMAT "%5.0" /end MEASUREMENT
/begin MEASUREMENT rbm_stat_DMTLM.state_ctr_rbm "" UBYTE _CNV_A_R_LINEAR_____0_CM 1 100. 0. 3. DISPLAY_IDENTIFIER STATE_CTR_RBM_DMTLM ECU_ADDRESS 0xd0009b5a FORMAT "%3.0" /end MEASUREMENT
/begin MEASUREMENT rbm_stat_MEC_IVVT_EX.ctr_comp_rbm "" UWORD _CNV_A_R_LINEAR_____0_CM 1 100. 0. 65535. DISPLAY_IDENTIFIER CTR_COMP_RBM_MEC_IVVT_EX ECU_ADDRESS 0xd0009b8c FORMAT "%5.0" /end MEASUREMENT
/begin MEASUREMENT rbm_stat_MEC_IVVT_EX.ctr_cdn_rbm "" UWORD _CNV_A_R_LINEAR_____0_CM 1 100. 0. 65535. DISPLAY_IDENTIFIER CTR_CDN_RBM_MEC_IVVT_EX ECU_ADDRESS 0xd0009b8e FORMAT "%5.0" /end MEASUREMENT
/begin MEASUREMENT rbm_stat_MEC_IVVT_EX.state_ctr_rbm "" UBYTE _CNV_A_R_LINEAR_____0_CM 1 100. 0. 3. DISPLAY_IDENTIFIER STATE_CTR_RBM_MEC_IVVT_EX ECU_ADDRESS 0xd0009b90 FORMAT "%3.0" /end MEASUREMENT
/begin MEASUREMENT rbm_stat_SA_SAFM.ctr_comp_rbm "" UWORD _CNV_A_R_LINEAR_____0_CM 1 100. 0. 65535. DISPLAY_IDENTIFIER CTR_COMP_RBM_SA_SAFM ECU_ADDRESS 0xd0009bc8 FORMAT "%5.0" /end MEASUREMENT
/begin MEASUREMENT rbm_stat_SA_SAFM.ctr_cdn_rbm "" UWORD _CNV_A_R_LINEAR_____0_CM 1 100. 0. 65535. DISPLAY_IDENTIFIER CTR_CDN_RBM_SA_SAFM ECU_ADDRESS 0xd0009bca FORMAT "%5.0" /end MEASUREMENT
/begin MEASUREMENT rbm_stat_SA_SAFM.state_ctr_rbm "" UBYTE _CNV_A_R_LINEAR_____0_CM 1 100. 0. 3. DISPLAY_IDENTIFIER STATE_CTR_RBM_SA_SAFM ECU_ADDRESS 0xd0009bcc FORMAT "%3.0" /end MEASUREMENT
/begin MEASUREMENT rbm_stat_SA_SAP.ctr_comp_rbm "" UWORD _CNV_A_R_LINEAR_____0_CM 1 100. 0. 65535. DISPLAY_IDENTIFIER CTR_COMP_RBM_SA_SAP ECU_ADDRESS 0xd0009bce FORMAT "%5.0" /end MEASUREMENT
/begin MEASUREMENT rbm_stat_SA_SAP.ctr_cdn_rbm "" UWORD _CNV_A_R_LINEAR_____0_CM 1 100. 0. 65535. DISPLAY_IDENTIFIER CTR_CDN_RBM_SA_SAP ECU_ADDRESS 0xd0009bd0 FORMAT "%5.0" /end MEASUREMENT
/begin MEASUREMENT rbm_stat_SA_SAP.state_ctr_rbm "" UBYTE _CNV_A_R_LINEAR_____0_CM 1 100. 0. 3. DISPLAY_IDENTIFIER STATE_CTR_RBM_SA_SAP ECU_ADDRESS 0xd0009bd2 FORMAT "%3.0" /end MEASUREMENT
/begin MEASUREMENT rbm_stat_SA_SAV.ctr_comp_rbm "" UWORD _CNV_A_R_LINEAR_____0_CM 1 100. 0. 65535. DISPLAY_IDENTIFIER CTR_COMP_RBM_SA_SAV ECU_ADDRESS 0xd0009bd4 FORMAT "%5.0" /end MEASUREMENT
/begin MEASUREMENT rbm_stat_SA_SAV.ctr_cdn_rbm "" UWORD _CNV_A_R_LINEAR_____0_CM 1 100. 0. 65535. DISPLAY_IDENTIFIER CTR_CDN_RBM_SA_SAV ECU_ADDRESS 0xd0009bd6 FORMAT "%5.0" /end MEASUREMENT
/begin MEASUREMENT rbm_stat_SA_SAV.state_ctr_rbm "" UBYTE _CNV_A_R_LINEAR_____0_CM 1 100. 0. 3. DISPLAY_IDENTIFIER STATE_CTR_RBM_SA_SAV ECU_ADDRESS 0xd0009bd8 FORMAT "%3.0" /end MEASUREMENT
/begin MEASUREMENT rbm_stat_SA_SAV_LSL.ctr_comp_rbm "" UWORD _CNV_A_R_LINEAR_____0_CM 1 100. 0. 65535. DISPLAY_IDENTIFIER CTR_COMP_RBM_SA_SAV_LSL ECU_ADDRESS 0xd0009bda FORMAT "%5.0" /end MEASUREMENT
/begin MEASUREMENT rbm_stat_SA_SAV_LSL.ctr_cdn_rbm "" UWORD _CNV_A_R_LINEAR_____0_CM 1 100. 0. 65535. DISPLAY_IDENTIFIER CTR_CDN_RBM_SA_SAV_LSL ECU_ADDRESS 0xd0009bdc FORMAT "%5.0" /end MEASUREMENT
/begin MEASUREMENT rbm_stat_SA_SAV_LSL.state_ctr_rbm "" UBYTE _CNV_A_R_LINEAR_____0_CM 1 100. 0. 3. DISPLAY_IDENTIFIER STATE_CTR_RBM_SA_SAV_LSL ECU_ADDRESS 0xd0009bde FORMAT "%3.0" /end MEASUREMENT
/begin MEASUREMENT rbm_stat_SHIFT_AFL_LSL_UP_1.ctr_comp_rbm "" UWORD _CNV_A_R_LINEAR_____0_CM 1 100. 0. 65535. DISPLAY_IDENTIFIER CTR_COMP_RBM_SHIFT_AFL_LSL_UP_1 ECU_ADDRESS 0xd0009be6 FORMAT "%5.0" /end MEASUREMENT
/begin MEASUREMENT rbm_stat_SHIFT_AFL_LSL_UP_1.ctr_cdn_rbm "" UWORD _CNV_A_R_LINEAR_____0_CM 1 100. 0. 65535. DISPLAY_IDENTIFIER CTR_CDN_RBM_SHIFT_AFL_LSL_UP_1 ECU_ADDRESS 0xd0009be8 FORMAT "%5.0" /end MEASUREMENT
/begin MEASUREMENT rbm_stat_SHIFT_AFL_LSL_UP_1.state_ctr_rbm "" UBYTE _CNV_A_R_LINEAR_____0_CM 1 100. 0. 3. DISPLAY_IDENTIFIER STATE_CTR_RBM_SHIFT_AFL_LSL_UP_1 ECU_ADDRESS 0xd0009bea FORMAT "%3.0" /end MEASUREMENT
/begin MEASUREMENT rbm_stat_SHIFT_AFL_LSL_UP_2.ctr_comp_rbm "" UWORD _CNV_A_R_LINEAR_____0_CM 1 100. 0. 65535. DISPLAY_IDENTIFIER CTR_COMP_RBM_SHIFT_AFL_LSL_UP_2 ECU_ADDRESS 0xd0009bec FORMAT "%5.0" /end MEASUREMENT
/begin MEASUREMENT rbm_stat_SHIFT_AFL_LSL_UP_2.ctr_cdn_rbm "" UWORD _CNV_A_R_LINEAR_____0_CM 1 100. 0. 65535. DISPLAY_IDENTIFIER CTR_CDN_RBM_SHIFT_AFL_LSL_UP_2 ECU_ADDRESS 0xd0009bee FORMAT "%5.0" /end MEASUREMENT
/begin MEASUREMENT rbm_stat_SHIFT_AFL_LSL_UP_2.state_ctr_rbm "" UBYTE _CNV_A_R_LINEAR_____0_CM 1 100. 0. 3. DISPLAY_IDENTIFIER STATE_CTR_RBM_SHIFT_AFL_LSL_UP_2 ECU_ADDRESS 0xd0009bf0 FORMAT "%3.0" /end MEASUREMENT
/begin MEASUREMENT rbm_stat_SHIFT_AFR_LSL_UP_1.ctr_comp_rbm "" UWORD _CNV_A_R_LINEAR_____0_CM 1 100. 0. 65535. DISPLAY_IDENTIFIER CTR_COMP_RBM_SHIFT_AFR_LSL_UP_1 ECU_ADDRESS 0xd0009bf2 FORMAT "%5.0" /end MEASUREMENT
/begin MEASUREMENT rbm_stat_SHIFT_AFR_LSL_UP_1.ctr_cdn_rbm "" UWORD _CNV_A_R_LINEAR_____0_CM 1 100. 0. 65535. DISPLAY_IDENTIFIER CTR_CDN_RBM_SHIFT_AFR_LSL_UP_1 ECU_ADDRESS 0xd0009bf4 FORMAT "%5.0" /end MEASUREMENT
/begin MEASUREMENT rbm_stat_SHIFT_AFR_LSL_UP_1.state_ctr_rbm "" UBYTE _CNV_A_R_LINEAR_____0_CM 1 100. 0. 3. DISPLAY_IDENTIFIER STATE_CTR_RBM_SHIFT_AFR_LSL_UP_1 ECU_ADDRESS 0xd0009bf6 FORMAT "%3.0" /end MEASUREMENT
/begin MEASUREMENT rbm_stat_SHIFT_AFR_LSL_UP_2.ctr_comp_rbm "" UWORD _CNV_A_R_LINEAR_____0_CM 1 100. 0. 65535. DISPLAY_IDENTIFIER CTR_COMP_RBM_SHIFT_AFR_LSL_UP_2 ECU_ADDRESS 0xd0009bf8 FORMAT "%5.0" /end MEASUREMENT
/begin MEASUREMENT rbm_stat_SHIFT_AFR_LSL_UP_2.ctr_cdn_rbm "" UWORD _CNV_A_R_LINEAR_____0_CM 1 100. 0. 65535. DISPLAY_IDENTIFIER CTR_CDN_RBM_SHIFT_AFR_LSL_UP_2 ECU_ADDRESS 0xd0009bfa FORMAT "%5.0" /end MEASUREMENT
/begin MEASUREMENT rbm_stat_SHIFT_AFR_LSL_UP_2.state_ctr_rbm "" UBYTE _CNV_A_R_LINEAR_____0_CM 1 100. 0. 3. DISPLAY_IDENTIFIER STATE_CTR_RBM_SHIFT_AFR_LSL_UP_2 ECU_ADDRESS 0xd0009bfc FORMAT "%3.0" /end MEASUREMENT
/begin MEASUREMENT rbm_stat_TAM_PLAUS.ctr_comp_rbm "" UWORD _CNV_A_R_LINEAR_____0_CM 1 100. 0. 65535. DISPLAY_IDENTIFIER CTR_COMP_RBM_TAM_PLAUS ECU_ADDRESS 0xd0009c10 FORMAT "%5.0" /end MEASUREMENT
/begin MEASUREMENT rbm_stat_TAM_PLAUS.ctr_cdn_rbm "" UWORD _CNV_A_R_LINEAR_____0_CM 1 100. 0. 65535. DISPLAY_IDENTIFIER CTR_CDN_RBM_TAM_PLAUS ECU_ADDRESS 0xd0009c12 FORMAT "%5.0" /end MEASUREMENT
/begin MEASUREMENT rbm_stat_TAM_PLAUS.state_ctr_rbm "" UBYTE _CNV_A_R_LINEAR_____0_CM 1 100. 0. 3. DISPLAY_IDENTIFIER STATE_CTR_RBM_TAM_PLAUS ECU_ADDRESS 0xd0009c14 FORMAT "%3.0" /end MEASUREMENT
/begin MEASUREMENT rbm_stat_TCO_2_PLAUS.ctr_comp_rbm "" UWORD _CNV_A_R_LINEAR_____0_CM 1 100. 0. 65535. DISPLAY_IDENTIFIER CTR_COMP_RBM_TCO_2_PLAUS ECU_ADDRESS 0xd0009c16 FORMAT "%5.0" /end MEASUREMENT
/begin MEASUREMENT rbm_stat_TCO_2_PLAUS.ctr_cdn_rbm "" UWORD _CNV_A_R_LINEAR_____0_CM 1 100. 0. 65535. DISPLAY_IDENTIFIER CTR_CDN_RBM_TCO_2_PLAUS ECU_ADDRESS 0xd0009c18 FORMAT "%5.0" /end MEASUREMENT
/begin MEASUREMENT rbm_stat_TCO_2_PLAUS.state_ctr_rbm "" UBYTE _CNV_A_R_LINEAR_____0_CM 1 100. 0. 3. DISPLAY_IDENTIFIER STATE_CTR_RBM_TCO_2_PLAUS ECU_ADDRESS 0xd0009c1a FORMAT "%3.0" /end MEASUREMENT
/begin MEASUREMENT rbm_stat_TCO_PLAUS.ctr_comp_rbm "" UWORD _CNV_A_R_LINEAR_____0_CM 1 100. 0. 65535. DISPLAY_IDENTIFIER CTR_COMP_RBM_TCO_PLAUS ECU_ADDRESS 0xd0009c1c FORMAT "%5.0" /end MEASUREMENT
/begin MEASUREMENT rbm_stat_TCO_PLAUS.ctr_cdn_rbm "" UWORD _CNV_A_R_LINEAR_____0_CM 1 100. 0. 65535. DISPLAY_IDENTIFIER CTR_CDN_RBM_TCO_PLAUS ECU_ADDRESS 0xd0009c1e FORMAT "%5.0" /end MEASUREMENT
/begin MEASUREMENT rbm_stat_TCO_PLAUS.state_ctr_rbm "" UBYTE _CNV_A_R_LINEAR_____0_CM 1 100. 0. 3. DISPLAY_IDENTIFIER STATE_CTR_RBM_TCO_PLAUS ECU_ADDRESS 0xd0009c20 FORMAT "%3.0" /end MEASUREMENT
/begin MEASUREMENT rbm_stat_TCO_STUCK.ctr_comp_rbm "" UWORD _CNV_A_R_LINEAR_____0_CM 1 100. 0. 65535. DISPLAY_IDENTIFIER CTR_COMP_RBM_TCO_STUCK ECU_ADDRESS 0xd0009c22 FORMAT "%5.0" /end MEASUREMENT
/begin MEASUREMENT rbm_stat_TCO_STUCK.ctr_cdn_rbm "" UWORD _CNV_A_R_LINEAR_____0_CM 1 100. 0. 65535. DISPLAY_IDENTIFIER CTR_CDN_RBM_TCO_STUCK ECU_ADDRESS 0xd0009c24 FORMAT "%5.0" /end MEASUREMENT
/begin MEASUREMENT rbm_stat_TCO_STUCK.state_ctr_rbm "" UBYTE _CNV_A_R_LINEAR_____0_CM 1 100. 0. 3. DISPLAY_IDENTIFIER STATE_CTR_RBM_TCO_STUCK ECU_ADDRESS 0xd0009c26 FORMAT "%3.0" /end MEASUREMENT
/begin MEASUREMENT rbm_stat_VS_PLAUS.ctr_comp_rbm "" UWORD _CNV_A_R_LINEAR_____0_CM 1 100. 0. 65535. DISPLAY_IDENTIFIER CTR_COMP_RBM_VS_PLAUS ECU_ADDRESS 0xd0009c64 FORMAT "%5.0" /end MEASUREMENT
/begin MEASUREMENT rbm_stat_VS_PLAUS.ctr_cdn_rbm "" UWORD _CNV_A_R_LINEAR_____0_CM 1 100. 0. 65535. DISPLAY_IDENTIFIER CTR_CDN_RBM_VS_PLAUS ECU_ADDRESS 0xd0009c66 FORMAT "%5.0" /end MEASUREMENT
/begin MEASUREMENT rbm_stat_VS_PLAUS.state_ctr_rbm "" UBYTE _CNV_A_R_LINEAR_____0_CM 1 100. 0. 3. DISPLAY_IDENTIFIER STATE_CTR_RBM_VS_PLAUS ECU_ADDRESS 0xd0009c68 FORMAT "%3.0" /end MEASUREMENT
/begin MEASUREMENT rbm_stat_FTL_OBD.ctr_comp_rbm "" UWORD _CNV_A_R_LINEAR_____0_CM 1 100. 0. 65535. DISPLAY_IDENTIFIER CTR_COMP_RBM_FTL_OBD ECU_ADDRESS 0xd0009b68 FORMAT "%5.0" /end MEASUREMENT
/begin MEASUREMENT rbm_stat_FTL_OBD.ctr_cdn_rbm "" UWORD _CNV_A_R_LINEAR_____0_CM 1 100. 0. 65535. DISPLAY_IDENTIFIER CTR_CDN_RBM_FTL_OBD ECU_ADDRESS 0xd0009b6a FORMAT "%5.0" /end MEASUREMENT
/begin MEASUREMENT rbm_stat_FTL_OBD.state_ctr_rbm "" UBYTE _CNV_A_R_LINEAR_____0_CM 1 100. 0. 3. DISPLAY_IDENTIFIER STATE_CTR_RBM_FTL_OBD ECU_ADDRESS 0xd0009b6c FORMAT "%3.0" /end MEASUREMENT
/begin MEASUREMENT rbm_stat_OBD_LSH_DOWN_1.ctr_comp_rbm "" UWORD _CNV_A_R_LINEAR_____0_CM 1 100. 0. 65535. DISPLAY_IDENTIFIER CTR_COMP_RBM_OBD_LSH_DOWN_1 ECU_ADDRESS 0xd0009b98 FORMAT "%5.0" /end MEASUREMENT
/begin MEASUREMENT rbm_stat_OBD_LSH_DOWN_1.ctr_cdn_rbm "" UWORD _CNV_A_R_LINEAR_____0_CM 1 100. 0. 65535. DISPLAY_IDENTIFIER CTR_CDN_RBM_OBD_LSH_DOWN_1 ECU_ADDRESS 0xd0009b9a FORMAT "%5.0" /end MEASUREMENT
/begin MEASUREMENT rbm_stat_OBD_LSH_DOWN_1.state_ctr_rbm "" UBYTE _CNV_A_R_LINEAR_____0_CM 1 100. 0. 3. DISPLAY_IDENTIFIER STATE_CTR_RBM_OBD_LSH_DOWN_1 ECU_ADDRESS 0xd0009b9c FORMAT "%3.0" /end MEASUREMENT
/begin MEASUREMENT rbm_stat_OBD_LSH_DOWN_2.ctr_comp_rbm "" UWORD _CNV_A_R_LINEAR_____0_CM 1 100. 0. 65535. DISPLAY_IDENTIFIER CTR_COMP_RBM_OBD_LSH_DOWN_2 ECU_ADDRESS 0xd0009b9e FORMAT "%5.0" /end MEASUREMENT
/begin MEASUREMENT rbm_stat_OBD_LSH_DOWN_2.ctr_cdn_rbm "" UWORD _CNV_A_R_LINEAR_____0_CM 1 100. 0. 65535. DISPLAY_IDENTIFIER CTR_CDN_RBM_OBD_LSH_DOWN_2 ECU_ADDRESS 0xd0009ba0 FORMAT "%5.0" /end MEASUREMENT
/begin MEASUREMENT rbm_stat_OBD_LSH_DOWN_2.state_ctr_rbm "" UBYTE _CNV_A_R_LINEAR_____0_CM 1 100. 0. 3. DISPLAY_IDENTIFIER STATE_CTR_RBM_OBD_LSH_DOWN_2 ECU_ADDRESS 0xd0009ba2 FORMAT "%3.0" /end MEASUREMENT
/begin MEASUREMENT rbm_stat_AMP_PLAUS.ctr_comp_rbm "" UWORD _CNV_A_R_LINEAR_____0_CM 1 100. 0. 65535. DISPLAY_IDENTIFIER CTR_COMP_RBM_AMP_PLAUS ECU_ADDRESS 0xd0009b20 FORMAT "%5.0" /end MEASUREMENT
/begin MEASUREMENT rbm_stat_AMP_PLAUS.ctr_cdn_rbm "" UWORD _CNV_A_R_LINEAR_____0_CM 1 100. 0. 65535. DISPLAY_IDENTIFIER CTR_CDN_RBM_AMP_PLAUS ECU_ADDRESS 0xd0009b22 FORMAT "%5.0" /end MEASUREMENT
/begin MEASUREMENT rbm_stat_AMP_PLAUS.state_ctr_rbm "" UBYTE _CNV_A_R_LINEAR_____0_CM 1 100. 0. 3. DISPLAY_IDENTIFIER STATE_CTR_RBM_AMP_PLAUS ECU_ADDRESS 0xd0009b24 FORMAT "%3.0" /end MEASUREMENT
/begin MEASUREMENT rbm_stat_TIA_PLAUS.ctr_comp_rbm "" UWORD _CNV_A_R_LINEAR_____0_CM 1 100. 0. 65535. DISPLAY_IDENTIFIER CTR_COMP_RBM_TIA_PLAUS ECU_ADDRESS 0xd0009c34 FORMAT "%5.0" /end MEASUREMENT
/begin MEASUREMENT rbm_stat_TIA_PLAUS.ctr_cdn_rbm "" UWORD _CNV_A_R_LINEAR_____0_CM 1 100. 0. 65535. DISPLAY_IDENTIFIER CTR_CDN_RBM_TIA_PLAUS ECU_ADDRESS 0xd0009c36 FORMAT "%5.0" /end MEASUREMENT
/begin MEASUREMENT rbm_stat_TIA_PLAUS.state_ctr_rbm "" UBYTE _CNV_A_R_LINEAR_____0_CM 1 100. 0. 3. DISPLAY_IDENTIFIER STATE_CTR_RBM_TIA_PLAUS ECU_ADDRESS 0xd0009c38 FORMAT "%3.0" /end MEASUREMENT
/begin MEASUREMENT rbm_stat_MAF.ctr_comp_rbm "" UWORD _CNV_A_R_LINEAR_____0_CM 1 100. 0. 65535. DISPLAY_IDENTIFIER CTR_COMP_RBM_MAF ECU_ADDRESS 0xd0009b80 FORMAT "%5.0" /end MEASUREMENT
/begin MEASUREMENT rbm_stat_MAF.ctr_cdn_rbm "" UWORD _CNV_A_R_LINEAR_____0_CM 1 100. 0. 65535. DISPLAY_IDENTIFIER CTR_CDN_RBM_MAF ECU_ADDRESS 0xd0009b82 FORMAT "%5.0" /end MEASUREMENT
/begin MEASUREMENT rbm_stat_MAF.state_ctr_rbm "" UBYTE _CNV_A_R_LINEAR_____0_CM 1 100. 0. 3. DISPLAY_IDENTIFIER STATE_CTR_RBM_MAF ECU_ADDRESS 0xd0009b84 FORMAT "%3.0" /end MEASUREMENT
/begin MEASUREMENT rbm_stat_ISC.ctr_comp_rbm "" UWORD _CNV_A_R_LINEAR_____0_CM 1 100. 0. 65535. DISPLAY_IDENTIFIER CTR_COMP_RBM_ISC ECU_ADDRESS 0xd0009b6e FORMAT "%5.0" /end MEASUREMENT
/begin MEASUREMENT rbm_stat_ISC.ctr_cdn_rbm "" UWORD _CNV_A_R_LINEAR_____0_CM 1 100. 0. 65535. DISPLAY_IDENTIFIER CTR_CDN_RBM_ISC ECU_ADDRESS 0xd0009b70 FORMAT "%5.0" /end MEASUREMENT
/begin MEASUREMENT rbm_stat_ISC.state_ctr_rbm "" UBYTE _CNV_A_R_LINEAR_____0_CM 1 100. 0. 3. DISPLAY_IDENTIFIER STATE_CTR_RBM_ISC ECU_ADDRESS 0xd0009b72 FORMAT "%3.0" /end MEASUREMENT
/begin MEASUREMENT rbm_stat_CS.ctr_comp_rbm "" UWORD _CNV_A_R_LINEAR_____0_CM 1 100. 0. 65535. DISPLAY_IDENTIFIER CTR_COMP_RBM_CS ECU_ADDRESS 0xd0009b4a FORMAT "%5.0" /end MEASUREMENT
/begin MEASUREMENT rbm_stat_CS.ctr_cdn_rbm "" UWORD _CNV_A_R_LINEAR_____0_CM 1 100. 0. 65535. DISPLAY_IDENTIFIER CTR_CDN_RBM_CS ECU_ADDRESS 0xd0009b4c FORMAT "%5.0" /end MEASUREMENT
/begin MEASUREMENT rbm_stat_CS.state_ctr_rbm "" UBYTE _CNV_A_R_LINEAR_____0_CM 1 100. 0. 3. DISPLAY_IDENTIFIER STATE_CTR_RBM_CS ECU_ADDRESS 0xd0009b4e FORMAT "%3.0" /end MEASUREMENT
/begin CHARACTERISTIC lc_rbm_clr "Reinit the rate base monitoring statistics LC_RBM_CLR 0->1" VALUE 0xa0804ee0 _REC_VAL_20_u1 1. _CNV_A_R_LINEAR_____0_CM 0. 1. DISPLAY_IDENTIFIER LC_RBM_CLR FORMAT "%1.0" /end CHARACTERISTIC
/begin MEASUREMENT rbm_stat_SMALL_LEAK.ctr_comp_rbm "" UWORD _CNV_A_R_LINEAR_____0_CM 1 100. 0. 65535. DISPLAY_IDENTIFIER CTR_COMP_RBM_SMALL_LEAK ECU_ADDRESS 0xd0009bfe FORMAT "%5.0" /end MEASUREMENT
/begin MEASUREMENT rbm_stat_SMALL_LEAK.ctr_cdn_rbm "" UWORD _CNV_A_R_LINEAR_____0_CM 1 100. 0. 65535. DISPLAY_IDENTIFIER CTR_CDN_RBM_SMALL_LEAK ECU_ADDRESS 0xd0009c00 FORMAT "%5.0" /end MEASUREMENT
/begin MEASUREMENT rbm_stat_SMALL_LEAK.state_ctr_rbm "" UBYTE _CNV_A_R_LINEAR_____0_CM 1 100. 0. 3. DISPLAY_IDENTIFIER STATE_CTR_RBM_SMALL_LEAK ECU_ADDRESS 0xd0009c02 FORMAT "%3.0" /end MEASUREMENT
/begin MEASUREMENT rbm_stat_ROUGH_LEAK.ctr_comp_rbm "" UWORD _CNV_A_R_LINEAR_____0_CM 1 100. 0. 65535. DISPLAY_IDENTIFIER CTR_COMP_RBM_ROUGH_LEAK ECU_ADDRESS 0xd0009bbc FORMAT "%5.0" /end MEASUREMENT
/begin MEASUREMENT rbm_stat_ROUGH_LEAK.ctr_cdn_rbm "" UWORD _CNV_A_R_LINEAR_____0_CM 1 100. 0. 65535. DISPLAY_IDENTIFIER CTR_CDN_RBM_ROUGH_LEAK ECU_ADDRESS 0xd0009bbe FORMAT "%5.0" /end MEASUREMENT
/begin MEASUREMENT rbm_stat_ROUGH_LEAK.state_ctr_rbm "" UBYTE _CNV_A_R_LINEAR_____0_CM 1 100. 0. 3. DISPLAY_IDENTIFIER STATE_CTR_RBM_ROUGH_LEAK ECU_ADDRESS 0xd0009bc0 FORMAT "%3.0" /end MEASUREMENT
/begin MEASUREMENT rbm_stat_OBD_VLD_LSH_UP_1.ctr_comp_rbm "" UWORD _CNV_A_R_LINEAR_____0_CM 1 100. 0. 65535. DISPLAY_IDENTIFIER CTR_COMP_RBM_OBD_VLD_LSH_UP_1 ECU_ADDRESS 0xd0009ba4 FORMAT "%5.0" /end MEASUREMENT
/begin MEASUREMENT rbm_stat_OBD_VLD_LSH_UP_1.ctr_cdn_rbm "" UWORD _CNV_A_R_LINEAR_____0_CM 1 100. 0. 65535. DISPLAY_IDENTIFIER CTR_CDN_RBM_OBD_VLD_LSH_UP_1 ECU_ADDRESS 0xd0009ba6 FORMAT "%5.0" /end MEASUREMENT
/begin MEASUREMENT rbm_stat_OBD_VLD_LSH_UP_1.state_ctr_rbm "" UBYTE _CNV_A_R_LINEAR_____0_CM 1 100. 0. 3. DISPLAY_IDENTIFIER STATE_CTR_RBM_OBD_VLD_LSH_UP_1 ECU_ADDRESS 0xd0009ba8 FORMAT "%3.0" /end MEASUREMENT
/begin MEASUREMENT rbm_stat_OBD_VLD_LSH_UP_2.ctr_comp_rbm "" UWORD _CNV_A_R_LINEAR_____0_CM 1 100. 0. 65535. DISPLAY_IDENTIFIER CTR_COMP_RBM_OBD_VLD_LSH_UP_2 ECU_ADDRESS 0xd0009baa FORMAT "%5.0" /end MEASUREMENT
/begin MEASUREMENT rbm_stat_OBD_VLD_LSH_UP_2.ctr_cdn_rbm "" UWORD _CNV_A_R_LINEAR_____0_CM 1 100. 0. 65535. DISPLAY_IDENTIFIER CTR_CDN_RBM_OBD_VLD_LSH_UP_2 ECU_ADDRESS 0xd0009bac FORMAT "%5.0" /end MEASUREMENT
/begin MEASUREMENT rbm_stat_OBD_VLD_LSH_UP_2.state_ctr_rbm "" UBYTE _CNV_A_R_LINEAR_____0_CM 1 100. 0. 3. DISPLAY_IDENTIFIER STATE_CTR_RBM_OBD_VLD_LSH_UP_2 ECU_ADDRESS 0xd0009bae FORMAT "%3.0" /end MEASUREMENT
/begin MEASUREMENT rbm_stat_TH.ctr_comp_rbm "" UWORD _CNV_A_R_LINEAR_____0_CM 1 100. 0. 65535. DISPLAY_IDENTIFIER CTR_COMP_RBM_TH ECU_ADDRESS 0xd0009c2e FORMAT "%5.0" /end MEASUREMENT
/begin MEASUREMENT rbm_stat_TH.ctr_cdn_rbm "" UWORD _CNV_A_R_LINEAR_____0_CM 1 100. 0. 65535. DISPLAY_IDENTIFIER CTR_CDN_RBM_TH ECU_ADDRESS 0xd0009c30 FORMAT "%5.0" /end MEASUREMENT
/begin MEASUREMENT rbm_stat_TH.state_ctr_rbm "" UBYTE _CNV_A_R_LINEAR_____0_CM 1 100. 0. 3. DISPLAY_IDENTIFIER STATE_CTR_RBM_TH ECU_ADDRESS 0xd0009c32 FORMAT "%3.0" /end MEASUREMENT
/begin MEASUREMENT rbm_stat_LOAD_TPS_PLAUS.ctr_comp_rbm "" UWORD _CNV_A_R_LINEAR_____0_CM 1 100. 0. 65535. DISPLAY_IDENTIFIER CTR_COMP_RBM_LOAD_TPS_PLAUS ECU_ADDRESS 0xd0009b7a FORMAT "%5.0" /end MEASUREMENT
/begin MEASUREMENT rbm_stat_LOAD_TPS_PLAUS.ctr_cdn_rbm "" UWORD _CNV_A_R_LINEAR_____0_CM 1 100. 0. 65535. DISPLAY_IDENTIFIER CTR_CDN_RBM_LOAD_TPS_PLAUS ECU_ADDRESS 0xd0009b7c FORMAT "%5.0" /end MEASUREMENT
/begin MEASUREMENT rbm_stat_LOAD_TPS_PLAUS.state_ctr_rbm "" UBYTE _CNV_A_R_LINEAR_____0_CM 1 100. 0. 3. DISPLAY_IDENTIFIER STATE_CTR_RBM_LOAD_TPS_PLAUS ECU_ADDRESS 0xd0009b7e FORMAT "%3.0" /end MEASUREMENT
/begin MEASUREMENT rbm_stat_MAP_DIP_PLAUS.ctr_comp_rbm "" UWORD _CNV_A_R_LINEAR_____0_CM 1 100. 0. 65535. DISPLAY_IDENTIFIER CTR_COMP_RBM_MAP_DIP_PLAUS ECU_ADDRESS 0xd0009b86 FORMAT "%5.0" /end MEASUREMENT
/begin MEASUREMENT rbm_stat_MAP_DIP_PLAUS.ctr_cdn_rbm "" UWORD _CNV_A_R_LINEAR_____0_CM 1 100. 0. 65535. DISPLAY_IDENTIFIER CTR_CDN_RBM_MAP_DIP_PLAUS ECU_ADDRESS 0xd0009b88 FORMAT "%5.0" /end MEASUREMENT
/begin MEASUREMENT rbm_stat_MAP_DIP_PLAUS.state_ctr_rbm "" UBYTE _CNV_A_R_LINEAR_____0_CM 1 100. 0. 3. DISPLAY_IDENTIFIER STATE_CTR_RBM_MAP_DIP_PLAUS ECU_ADDRESS 0xd0009b8a FORMAT "%3.0" /end MEASUREMENT
/begin MEASUREMENT rbm_stat_VLS_DOWN_DIF_2.ctr_comp_rbm "" UWORD _CNV_A_R_LINEAR_____0_CM 1 100. 0. 65535. DISPLAY_IDENTIFIER CTR_COMP_RBM_VLS_DOWN_DIF_2 ECU_ADDRESS 0xd0009c5e FORMAT "%5.0" /end MEASUREMENT
/begin MEASUREMENT rbm_stat_VLS_DOWN_DIF_2.ctr_cdn_rbm "" UWORD _CNV_A_R_LINEAR_____0_CM 1 100. 0. 65535. DISPLAY_IDENTIFIER CTR_CDN_RBM_VLS_DOWN_DIF_2 ECU_ADDRESS 0xd0009c60 FORMAT "%5.0" /end MEASUREMENT
/begin MEASUREMENT rbm_stat_VLS_DOWN_DIF_2.state_ctr_rbm "" UBYTE _CNV_A_R_LINEAR_____0_CM 1 100. 0. 3. DISPLAY_IDENTIFIER STATE_CTR_RBM_VLS_DOWN_DIF_2 ECU_ADDRESS 0xd0009c62 FORMAT "%3.0" /end MEASUREMENT
/begin MEASUREMENT rbm_stat_VLS_DOWN_DIF_1.ctr_comp_rbm "" UWORD _CNV_A_R_LINEAR_____0_CM 1 100. 0. 65535. DISPLAY_IDENTIFIER CTR_COMP_RBM_VLS_DOWN_DIF_1 ECU_ADDRESS 0xd0009c58 FORMAT "%5.0" /end MEASUREMENT
/begin MEASUREMENT rbm_stat_VLS_DOWN_DIF_1.ctr_cdn_rbm "" UWORD _CNV_A_R_LINEAR_____0_CM 1 100. 0. 65535. DISPLAY_IDENTIFIER CTR_CDN_RBM_VLS_DOWN_DIF_1 ECU_ADDRESS 0xd0009c5a FORMAT "%5.0" /end MEASUREMENT
/begin MEASUREMENT rbm_stat_VLS_DOWN_DIF_1.state_ctr_rbm "" UBYTE _CNV_A_R_LINEAR_____0_CM 1 100. 0. 3. DISPLAY_IDENTIFIER STATE_CTR_RBM_VLS_DOWN_DIF_1 ECU_ADDRESS 0xd0009c5c FORMAT "%3.0" /end MEASUREMENT
/begin MEASUREMENT rbm_stat_CHK_LS_DOWN_1.ctr_comp_rbm "" UWORD _CNV_A_R_LINEAR_____0_CM 1 100. 0. 65535. DISPLAY_IDENTIFIER CTR_COMP_RBM_CHK_LS_DOWN_1 ECU_ADDRESS 0xd0009b3e FORMAT "%5.0" /end MEASUREMENT
/begin MEASUREMENT rbm_stat_CHK_LS_DOWN_1.ctr_cdn_rbm "" UWORD _CNV_A_R_LINEAR_____0_CM 1 100. 0. 65535. DISPLAY_IDENTIFIER CTR_CDN_RBM_CHK_LS_DOWN_1 ECU_ADDRESS 0xd0009b40 FORMAT "%5.0" /end MEASUREMENT
/begin MEASUREMENT rbm_stat_CHK_LS_DOWN_1.state_ctr_rbm "" UBYTE _CNV_A_R_LINEAR_____0_CM 1 100. 0. 3. DISPLAY_IDENTIFIER STATE_CTR_RBM_CHK_LS_DOWN_1 ECU_ADDRESS 0xd0009b42 FORMAT "%3.0" /end MEASUREMENT
/begin MEASUREMENT rbm_stat_CHK_LS_DOWN_2.ctr_comp_rbm "" UWORD _CNV_A_R_LINEAR_____0_CM 1 100. 0. 65535. DISPLAY_IDENTIFIER CTR_COMP_RBM_CHK_LS_DOWN_2 ECU_ADDRESS 0xd0009b44 FORMAT "%5.0" /end MEASUREMENT
/begin MEASUREMENT rbm_stat_CHK_LS_DOWN_2.ctr_cdn_rbm "" UWORD _CNV_A_R_LINEAR_____0_CM 1 100. 0. 65535. DISPLAY_IDENTIFIER CTR_CDN_RBM_CHK_LS_DOWN_2 ECU_ADDRESS 0xd0009b46 FORMAT "%5.0" /end MEASUREMENT
/begin MEASUREMENT rbm_stat_CHK_LS_DOWN_2.state_ctr_rbm "" UBYTE _CNV_A_R_LINEAR_____0_CM 1 100. 0. 3. DISPLAY_IDENTIFIER STATE_CTR_RBM_CHK_LS_DOWN_2 ECU_ADDRESS 0xd0009b48 FORMAT "%3.0" /end MEASUREMENT
/begin MEASUREMENT rbm_stat_REF_CRK_CAM_IN_1.ctr_comp_rbm "" UWORD _CNV_A_R_LINEAR_____0_CM 1 100. 0. 65535. DISPLAY_IDENTIFIER CTR_COMP_RBM_REF_CRK_CAM_IN_1 ECU_ADDRESS 0xd0009bb6 FORMAT "%5.0" /end MEASUREMENT
/begin MEASUREMENT rbm_stat_REF_CRK_CAM_IN_1.ctr_cdn_rbm "" UWORD _CNV_A_R_LINEAR_____0_CM 1 100. 0. 65535. DISPLAY_IDENTIFIER CTR_CDN_RBM_REF_CRK_CAM_IN_1 ECU_ADDRESS 0xd0009bb8 FORMAT "%5.0" /end MEASUREMENT
/begin MEASUREMENT rbm_stat_REF_CRK_CAM_IN_1.state_ctr_rbm "" UBYTE _CNV_A_R_LINEAR_____0_CM 1 100. 0. 3. DISPLAY_IDENTIFIER STATE_CTR_RBM_REF_CRK_CAM_IN_1 ECU_ADDRESS 0xd0009bba FORMAT "%3.0" /end MEASUREMENT
/begin MEASUREMENT rbm_stat_REF_CRK_CAM_EX_1.ctr_comp_rbm "" UWORD _CNV_A_R_LINEAR_____0_CM 1 100. 0. 65535. DISPLAY_IDENTIFIER CTR_COMP_RBM_REF_CRK_CAM_EX_1 ECU_ADDRESS 0xd0009bb0 FORMAT "%5.0" /end MEASUREMENT
/begin MEASUREMENT rbm_stat_REF_CRK_CAM_EX_1.ctr_cdn_rbm "" UWORD _CNV_A_R_LINEAR_____0_CM 1 100. 0. 65535. DISPLAY_IDENTIFIER CTR_CDN_RBM_REF_CRK_CAM_EX_1 ECU_ADDRESS 0xd0009bb2 FORMAT "%5.0" /end MEASUREMENT
/begin MEASUREMENT rbm_stat_REF_CRK_CAM_EX_1.state_ctr_rbm "" UBYTE _CNV_A_R_LINEAR_____0_CM 1 100. 0. 3. DISPLAY_IDENTIFIER STATE_CTR_RBM_REF_CRK_CAM_EX_1 ECU_ADDRESS 0xd0009bb4 FORMAT "%3.0" /end MEASUREMENT
/begin MEASUREMENT rbm_stat_SWT_LS_DOWN_1.ctr_comp_rbm "" UWORD _CNV_A_R_LINEAR_____0_CM 1 100. 0. 65535. DISPLAY_IDENTIFIER CTR_COMP_RBM_SWT_LS_DOWN_1 ECU_ADDRESS 0xd0009c04 FORMAT "%5.0" /end MEASUREMENT
/begin MEASUREMENT rbm_stat_SWT_LS_DOWN_1.ctr_cdn_rbm "" UWORD _CNV_A_R_LINEAR_____0_CM 1 100. 0. 65535. DISPLAY_IDENTIFIER CTR_CDN_RBM_SWT_LS_DOWN_1 ECU_ADDRESS 0xd0009c06 FORMAT "%5.0" /end MEASUREMENT
/begin MEASUREMENT rbm_stat_SWT_LS_DOWN_1.state_ctr_rbm "" UBYTE _CNV_A_R_LINEAR_____0_CM 1 100. 0. 3. DISPLAY_IDENTIFIER STATE_CTR_RBM_SWT_LS_DOWN_1 ECU_ADDRESS 0xd0009c08 FORMAT "%3.0" /end MEASUREMENT
/begin MEASUREMENT rbm_stat_SWT_LS_DOWN_2.ctr_comp_rbm "" UWORD _CNV_A_R_LINEAR_____0_CM 1 100. 0. 65535. DISPLAY_IDENTIFIER CTR_COMP_RBM_SWT_LS_DOWN_2 ECU_ADDRESS 0xd0009c0a FORMAT "%5.0" /end MEASUREMENT
/begin MEASUREMENT rbm_stat_SWT_LS_DOWN_2.ctr_cdn_rbm "" UWORD _CNV_A_R_LINEAR_____0_CM 1 100. 0. 65535. DISPLAY_IDENTIFIER CTR_CDN_RBM_SWT_LS_DOWN_2 ECU_ADDRESS 0xd0009c0c FORMAT "%5.0" /end MEASUREMENT
/begin MEASUREMENT rbm_stat_SWT_LS_DOWN_2.state_ctr_rbm "" UBYTE _CNV_A_R_LINEAR_____0_CM 1 100. 0. 3. DISPLAY_IDENTIFIER STATE_CTR_RBM_SWT_LS_DOWN_2 ECU_ADDRESS 0xd0009c0e FORMAT "%3.0" /end MEASUREMENT
/begin MEASUREMENT rbm_stat_T_ES.ctr_comp_rbm "" UWORD _CNV_A_R_LINEAR_____0_CM 1 100. 0. 65535. DISPLAY_IDENTIFIER CTR_COMP_RBM_T_ES ECU_ADDRESS 0xd0009c52 FORMAT "%5.0" /end MEASUREMENT
/begin MEASUREMENT rbm_stat_T_ES.ctr_cdn_rbm "" UWORD _CNV_A_R_LINEAR_____0_CM 1 100. 0. 65535. DISPLAY_IDENTIFIER CTR_CDN_RBM_T_ES ECU_ADDRESS 0xd0009c54 FORMAT "%5.0" /end MEASUREMENT
/begin MEASUREMENT rbm_stat_T_ES.state_ctr_rbm "" UBYTE _CNV_A_R_LINEAR_____0_CM 1 100. 0. 3. DISPLAY_IDENTIFIER STATE_CTR_RBM_T_ES ECU_ADDRESS 0xd0009c56 FORMAT "%3.0" /end MEASUREMENT
/begin MEASUREMENT rbm_stat_TPS.ctr_comp_rbm "" UWORD _CNV_A_R_LINEAR_____0_CM 1 100. 0. 65535. DISPLAY_IDENTIFIER CTR_COMP_RBM_TPS ECU_ADDRESS 0xd0009c46 FORMAT "%5.0" /end MEASUREMENT
/begin MEASUREMENT rbm_stat_TPS.ctr_cdn_rbm "" UWORD _CNV_A_R_LINEAR_____0_CM 1 100. 0. 65535. DISPLAY_IDENTIFIER CTR_CDN_RBM_TPS ECU_ADDRESS 0xd0009c48 FORMAT "%5.0" /end MEASUREMENT
/begin MEASUREMENT rbm_stat_TPS.state_ctr_rbm "" UBYTE _CNV_A_R_LINEAR_____0_CM 1 100. 0. 3. DISPLAY_IDENTIFIER STATE_CTR_RBM_TPS ECU_ADDRESS 0xd0009c4a FORMAT "%3.0" /end MEASUREMENT
/begin MEASUREMENT rbm_stat_ANG_INST_AD_VVL.ctr_comp_rbm "" UWORD _CNV_A_R_LINEAR_____0_CM 1 100. 0. 65535. DISPLAY_IDENTIFIER CTR_COMP_RBM_ANG_INST_AD_VVL ECU_ADDRESS 0xd0009b2c FORMAT "%5.0" /end MEASUREMENT
/begin MEASUREMENT rbm_stat_ANG_INST_AD_VVL.ctr_cdn_rbm "" UWORD _CNV_A_R_LINEAR_____0_CM 1 100. 0. 65535. DISPLAY_IDENTIFIER CTR_CDN_RBM_ANG_INST_AD_VVL ECU_ADDRESS 0xd0009b2e FORMAT "%5.0" /end MEASUREMENT
/begin MEASUREMENT rbm_stat_ANG_INST_AD_VVL.state_ctr_rbm "" UBYTE _CNV_A_R_LINEAR_____0_CM 1 100. 0. 3. DISPLAY_IDENTIFIER STATE_CTR_RBM_ANG_INST_AD_VVL ECU_ADDRESS 0xd0009b30 FORMAT "%3.0" /end MEASUREMENT
/begin MEASUREMENT rbm_stat_ANG_CHK_MAX_VVL.ctr_comp_rbm "" UWORD _CNV_A_R_LINEAR_____0_CM 1 100. 0. 65535. DISPLAY_IDENTIFIER CTR_COMP_RBM_ANG_CHK_MAX_VVL ECU_ADDRESS 0xd0009b26 FORMAT "%5.0" /end MEASUREMENT
/begin MEASUREMENT rbm_stat_ANG_CHK_MAX_VVL.ctr_cdn_rbm "" UWORD _CNV_A_R_LINEAR_____0_CM 1 100. 0. 65535. DISPLAY_IDENTIFIER CTR_CDN_RBM_ANG_CHK_MAX_VVL ECU_ADDRESS 0xd0009b28 FORMAT "%5.0" /end MEASUREMENT
/begin MEASUREMENT rbm_stat_ANG_CHK_MAX_VVL.state_ctr_rbm "" UBYTE _CNV_A_R_LINEAR_____0_CM 1 100. 0. 3. DISPLAY_IDENTIFIER STATE_CTR_RBM_ANG_CHK_MAX_VVL ECU_ADDRESS 0xd0009b2a FORMAT "%3.0" /end MEASUREMENT
/begin MEASUREMENT rbm_stat_TOOTH_OFF_IN_1.ctr_comp_rbm "" UWORD _CNV_A_R_LINEAR_____0_CM 1 100. 0. 65535. DISPLAY_IDENTIFIER CTR_COMP_RBM_TOOTH_OFF_IN_1 ECU_ADDRESS 0xd0009c40 FORMAT "%5.0" /end MEASUREMENT
/begin MEASUREMENT rbm_stat_TOOTH_OFF_IN_1.ctr_cdn_rbm "" UWORD _CNV_A_R_LINEAR_____0_CM 1 100. 0. 65535. DISPLAY_IDENTIFIER CTR_CDN_RBM_TOOTH_OFF_IN_1 ECU_ADDRESS 0xd0009c42 FORMAT "%5.0" /end MEASUREMENT
/begin MEASUREMENT rbm_stat_TOOTH_OFF_IN_1.state_ctr_rbm "" UBYTE _CNV_A_R_LINEAR_____0_CM 1 100. 0. 3. DISPLAY_IDENTIFIER STATE_CTR_RBM_TOOTH_OFF_IN_1 ECU_ADDRESS 0xd0009c44 FORMAT "%3.0" /end MEASUREMENT
/begin MEASUREMENT rbm_stat_TOOTH_OFF_EX_1.ctr_comp_rbm "" UWORD _CNV_A_R_LINEAR_____0_CM 1 100. 0. 65535. DISPLAY_IDENTIFIER CTR_COMP_RBM_TOOTH_OFF_EX_1 ECU_ADDRESS 0xd0009c3a FORMAT "%5.0" /end MEASUREMENT
/begin MEASUREMENT rbm_stat_TOOTH_OFF_EX_1.ctr_cdn_rbm "" UWORD _CNV_A_R_LINEAR_____0_CM 1 100. 0. 65535. DISPLAY_IDENTIFIER CTR_CDN_RBM_TOOTH_OFF_EX_1 ECU_ADDRESS 0xd0009c3c FORMAT "%5.0" /end MEASUREMENT
/begin MEASUREMENT rbm_stat_TOOTH_OFF_EX_1.state_ctr_rbm "" UBYTE _CNV_A_R_LINEAR_____0_CM 1 100. 0. 3. DISPLAY_IDENTIFIER STATE_CTR_RBM_TOOTH_OFF_EX_1 ECU_ADDRESS 0xd0009c3e FORMAT "%3.0" /end MEASUREMENT
/begin MEASUREMENT rbm_stat_ISC_CST.ctr_comp_rbm "" UWORD _CNV_A_R_LINEAR_____0_CM 1 100. 0. 65535. DISPLAY_IDENTIFIER CTR_COMP_RBM_ISC_CST ECU_ADDRESS 0xd0009b74 FORMAT "%5.0" /end MEASUREMENT
/begin MEASUREMENT rbm_stat_ISC_CST.ctr_cdn_rbm "" UWORD _CNV_A_R_LINEAR_____0_CM 1 100. 0. 65535. DISPLAY_IDENTIFIER CTR_CDN_RBM_ISC_CST ECU_ADDRESS 0xd0009b76 FORMAT "%5.0" /end MEASUREMENT
/begin MEASUREMENT rbm_stat_ISC_CST.state_ctr_rbm "" UBYTE _CNV_A_R_LINEAR_____0_CM 1 100. 0. 3. DISPLAY_IDENTIFIER STATE_CTR_RBM_ISC_CST ECU_ADDRESS 0xd0009b78 FORMAT "%3.0" /end MEASUREMENT
/begin MEASUREMENT rbm_stat_TQ_CST.ctr_comp_rbm "" UWORD _CNV_A_R_LINEAR_____0_CM 1 100. 0. 65535. DISPLAY_IDENTIFIER CTR_COMP_RBM_TQ_CST ECU_ADDRESS 0xd0009c4c FORMAT "%5.0" /end MEASUREMENT
/begin MEASUREMENT rbm_stat_TQ_CST.ctr_cdn_rbm "" UWORD _CNV_A_R_LINEAR_____0_CM 1 100. 0. 65535. DISPLAY_IDENTIFIER CTR_CDN_RBM_TQ_CST ECU_ADDRESS 0xd0009c4e FORMAT "%5.0" /end MEASUREMENT
/begin MEASUREMENT rbm_stat_TQ_CST.state_ctr_rbm "" UBYTE _CNV_A_R_LINEAR_____0_CM 1 100. 0. 3. DISPLAY_IDENTIFIER STATE_CTR_RBM_TQ_CST ECU_ADDRESS 0xd0009c50 FORMAT "%3.0" /end MEASUREMENT
/begin MEASUREMENT rbm_stat_DIAGCPS.ctr_comp_rbm "" UWORD _CNV_A_R_LINEAR_____0_CM 1 100. 0. 65535. DISPLAY_IDENTIFIER CTR_COMP_RBM_DIAGCPS ECU_ADDRESS 0xd0009b50 FORMAT "%5.0" /end MEASUREMENT
/begin MEASUREMENT rbm_stat_DIAGCPS.ctr_cdn_rbm "" UWORD _CNV_A_R_LINEAR_____0_CM 1 100. 0. 65535. DISPLAY_IDENTIFIER CTR_CDN_RBM_DIAGCPS ECU_ADDRESS 0xd0009b52 FORMAT "%5.0" /end MEASUREMENT
/begin MEASUREMENT rbm_stat_DIAGCPS.state_ctr_rbm "" UBYTE _CNV_A_R_LINEAR_____0_CM 1 100. 0. 3. DISPLAY_IDENTIFIER STATE_CTR_RBM_DIAGCPS ECU_ADDRESS 0xd0009b54 FORMAT "%3.0" /end MEASUREMENT
/begin MEASUREMENT rbm_stat_SA.ctr_comp_rbm "" UWORD _CNV_A_R_LINEAR_____0_CM 1 100. 0. 65535. DISPLAY_IDENTIFIER CTR_COMP_RBM_SA ECU_ADDRESS 0xd0009bc2 FORMAT "%5.0" /end MEASUREMENT
/begin MEASUREMENT rbm_stat_SA.ctr_cdn_rbm "" UWORD _CNV_A_R_LINEAR_____0_CM 1 100. 0. 65535. DISPLAY_IDENTIFIER CTR_CDN_RBM_SA ECU_ADDRESS 0xd0009bc4 FORMAT "%5.0" /end MEASUREMENT
/begin MEASUREMENT rbm_stat_SA.state_ctr_rbm "" UBYTE _CNV_A_R_LINEAR_____0_CM 1 100. 0. 3. DISPLAY_IDENTIFIER STATE_CTR_RBM_SA ECU_ADDRESS 0xd0009bc6 FORMAT "%3.0" /end MEASUREMENT
/begin MEASUREMENT t_ast_cst_rbm "Comulative time (depending on ambient temperature) since engine start" UWORD _CNV_A_R_LINEAR_____36_CM 1 100. 0. 65535. DISPLAY_IDENTIFIER T_AST_CST_RBM ECU_ADDRESS 0xd0002784 FORMAT "%5.0" /end MEASUREMENT
/begin CHARACTERISTIC c_tam_min_cst_rbm "Minimum ambient temperature threshold for RBM cold start condition" VALUE 0xa0804ed3 _REC_VAL_20_u1 190.5 _CNV_A_R_LINEAR_____17_CM -48. 142.5 DISPLAY_IDENTIFIER C_TAM_MIN_CST_RBM FORMAT "%5.1" /end CHARACTERISTIC
/begin CHARACTERISTIC c_tam_max_cst_rbm "Maximum ambient temperature threshold for for RBM cold start condition" VALUE 0xa0804ed2 _REC_VAL_20_u1 190.5 _CNV_A_R_LINEAR_____17_CM -48. 142.5 DISPLAY_IDENTIFIER C_TAM_MAX_CST_RBM FORMAT "%5.1" /end CHARACTERISTIC
/begin CHARACTERISTIC c_t_ast_cst_rbm "Minimum comulative time since engine start for RBM cold start condition" VALUE 0xa0804ec8 _REC_VAL_20_u2 65535. _CNV_A_R_LINEAR_____36_CM 0. 65535. DISPLAY_IDENTIFIER C_T_AST_CST_RBM FORMAT "%5.0" /end CHARACTERISTIC
/begin CHARACTERISTIC c_tco_st_min_cst_rbm "Minimum engine start temperature threshold for RBM cold start condition" VALUE 0xa0804ed7 _REC_VAL_20_u1 190.5 _CNV_A_R_LINEAR_____17_CM -48. 142.5 DISPLAY_IDENTIFIER C_TCO_ST_MIN_CST_RBM FORMAT "%5.1" /end CHARACTERISTIC
/begin CHARACTERISTIC c_tco_st_max_cst_rbm "Maximum engine start temperature threshold for RBM cold start condition" VALUE 0xa0804ed6 _REC_VAL_20_u1 190.5 _CNV_A_R_LINEAR_____17_CM -48. 142.5 DISPLAY_IDENTIFIER C_TCO_ST_MAX_CST_RBM FORMAT "%5.1" /end CHARACTERISTIC
/begin CHARACTERISTIC c_tam_st_hys_cst_rbm "Ambient temperature hysteresis for RBM cold start condition" VALUE 0xa0804ed5 _REC_VAL_20_u1 190.5 _CNV_A_R_LINEAR_____25_CM 0. 190.5 DISPLAY_IDENTIFIER C_TAM_ST_HYS_CST_RBM FORMAT "%5.1" /end CHARACTERISTIC
/begin MEASUREMENT rbm_stat_TCO_STUCK_RNG.ctr_comp_rbm "" UWORD _CNV_A_R_LINEAR_____0_CM 1 100. 0. 65535. DISPLAY_IDENTIFIER CTR_COMP_RBM_TCO_STUCK_RNG ECU_ADDRESS 0xd0009c28 FORMAT "%5.0" /end MEASUREMENT
/begin MEASUREMENT rbm_stat_TCO_STUCK_RNG.ctr_cdn_rbm "" UWORD _CNV_A_R_LINEAR_____0_CM 1 100. 0. 65535. DISPLAY_IDENTIFIER CTR_CDN_RBM_TCO_STUCK_RNG ECU_ADDRESS 0xd0009c2a FORMAT "%5.0" /end MEASUREMENT
/begin MEASUREMENT rbm_stat_TCO_STUCK_RNG.state_ctr_rbm "" UBYTE _CNV_A_R_LINEAR_____0_CM 1 100. 0. 3. DISPLAY_IDENTIFIER STATE_CTR_RBM_TCO_STUCK_RNG ECU_ADDRESS 0xd0009c2c FORMAT "%3.0" /end MEASUREMENT
/begin COMPU_METHOD _CNV_A_R_LINEAR_____0_CM "" RAT_FUNC "%6.3" "-" COEFFS 0 1. 0. 0 0 1 /end COMPU_METHOD
/begin COMPU_METHOD _CNV_S_2_RANGE__0___1_CM "" TAB_VERB "%6.3" "-" COMPU_TAB_REF _CNV_S_2_RANGE__0___1 /end COMPU_METHOD
/begin COMPU_VTAB _CNV_S_2_RANGE__0___1 "" TAB_VERB 2 0 "0" 1 "1" /end COMPU_VTAB
/begin COMPU_METHOD _CNV_A_R_LINEAR_____4_CM "" RAT_FUNC "%6.3" "s" COEFFS 0 10. 0. 0 0 1 /end COMPU_METHOD
/begin COMPU_METHOD _CNV_A_R_LINEAR_____6_CM "" RAT_FUNC "%6.3" "km/h" COEFFS 0 1. 0. 0 0 1 /end COMPU_METHOD
/begin COMPU_METHOD _CNV_A_R_LINEAR_____17_CM "" RAT_FUNC "%6.3" "°C" COEFFS 0 1.333333333333333 64. 0 0 1 /end COMPU_METHOD
/begin COMPU_METHOD _CNV_A_R_LINEAR_____25_CM "" RAT_FUNC "%6.3" "°C" COEFFS 0 1.333333333333333 0. 0 0 1 /end COMPU_METHOD
/begin COMPU_METHOD _CNV_A_R_LINEAR_____27_CM "" RAT_FUNC "%6.3" "hPa" COEFFS 0 12.06017666543982 0. 0 0 1 /end COMPU_METHOD
/begin COMPU_METHOD _CNV_A_R_LINEAR_____36_CM "" RAT_FUNC "%6.3" "s" COEFFS 0 1. 0. 0 0 1 /end COMPU_METHOD
/begin COMPU_METHOD _CNV_A_R_LINEAR_____45_CM "" RAT_FUNC "%6.3" "km/h" COEFFS 0 10. 0. 0 0 1 /end COMPU_METHOD
/begin COMPU_METHOD _CNV_A_R_LINEAR_____52_CM "" RAT_FUNC "%6.3" "km" COEFFS 0 1. 0. 0 0 1 /end COMPU_METHOD
/begin COMPU_METHOD _CNV_A_R_LINEAR_____84_CM "" RAT_FUNC "%6.3" "min" COEFFS 0 1. 0. 0 0 1 /end COMPU_METHOD
/begin COMPU_METHOD _CNV_A_R_CPULOAD__0_448_CM "" RAT_FUNC "%6.3" "%" COEFFS 0 10.24 0. 0 0 1 /end COMPU_METHOD
/begin RECORD_LAYOUT _REC_VAL_20_u1 FNC_VALUES 1 UBYTE COLUMN_DIR DIRECT /end RECORD_LAYOUT
/begin RECORD_LAYOUT _REC_VAL_20_u2 FNC_VALUES 1 UWORD COLUMN_DIR DIRECT /end RECORD_LAYOUT
/begin RECORD_LAYOUT _REC_AXS_20_u1 NO_AXIS_PTS_X 1 UBYTE AXIS_PTS_X 2 UBYTE INDEX_INCR DIRECT /end RECORD_LAYOUT
/begin RECORD_LAYOUT _REC_CUR_20_u1_u1 FNC_VALUES 1 UBYTE COLUMN_DIR DIRECT /end RECORD_LAYOUT
/begin FUNCTION ERRM_Environmental_data "Environmental_Data"
 /begin DEF_CHARACTERISTIC fmy_id_bn_msw.envd fmy_id_bn_ang_pste.envd fmy_id_bn_gear_rev.envd fmy_id_bn_ltg_hdlp_l.envd fmy_id_bn_ldm.envd fmy_id_bn_trl.envd fmy_id_bn_hiv.envd fmy_id_bn_t_clk.envd fmy_id_bn_efp_crash.envd fmy_id_bn_cdn_door.envd fmy_id_bn_req_pbr.envd fmy_id_bn_pbr.envd fmy_id_bn_efp.envd fmy_id_load_tps_plaus.envd fmy_id_egy_min.envd fmy_id_locan_boff.envd fmy_id_cwp_plaus.envd fmy_id_cwp_int_off.envd fmy_id_cwp_pwr.envd fmy_id_cwp_com_plaus.envd fmy_id_qoil_sens.envd fmy_id_bat_sens.envd fmy_id_bat_sens_it.envd fmy_id_bat_sens_it_el.envd fmy_id_ecu_nvmy.envd fmy_id_gs.envd fmy_id_plaus_igk_bn.envd fmy_id_tq_req_can.envd fmy_id_map_sens_1.envd fmy_id_map_sens_2.envd fmy_id_dtc_trm.envd fmy_id_mec_ivvt_in_1.envd fmy_id_mec_ivvt_in_2.envd fmy_id_mec_ivvt_ex.envd fmy_id_tout_nox_sens_1.envd fmy_id_tout_nox_sens_2.envd fmy_id_vvl_rot.envd fmy_id_rly_vvl.envd fmy_id_nox_sens_1.envd fmy_id_ns_obd_1_1.envd fmy_id_ns_obd_1_2.envd fmy_id_ovl_ecu_vvl.envd fmy_id_dr_sc_vvl.envd fmy_id_crit_ovl_ecu_vvl.envd fmy_id_nox_sens_2.envd fmy_id_cur_h_vvl.envd fmy_id_teg_pcat_down.envd fmy_id_t_seg_er.envd fmy_id_seg_ad_er.envd fmy_id_vs_plaus.envd fmy_id_ftl_obd.envd fmy_id_ftl_le_can.envd fmy_id_ftl_ri_can.envd fmy_id_tia_plaus.envd fmy_id_tam_can.envd fmy_id_tam_plaus.envd fmy_id_map_shift_1.envd fmy_id_map_shift_2.envd fmy_id_cat_diag_1.envd fmy_id_cat_diag_2.envd fmy_id_cat_diag_afl_1.envd fmy_id_cat_diag_afl_2.envd fmy_id_scg_ls_down_1.envd fmy_id_scp_ls_down_1.envd fmy_id_oc_ls_down_1.envd fmy_id_puc_ls_down_1.envd fmy_id_fl_ls_down_1.envd fmy_id_lsl_up_if_1.envd fmy_id_el_lsl_up_1.envd fmy_id_lsh_up_1.envd fmy_id_lsh_down_1.envd fmy_id_vls_down_dif_1.envd fmy_id_lsh_lsl_up_1.envd fmy_id_air_lsl_up_1.envd fmy_id_pue_ls_down_1.envd fmy_id_swt_ls_down_1.envd fmy_id_obd_lsh_down_1.envd fmy_id_dyn_vld_ls_up_1.envd fmy_id_puc_vld_ls_up_1.envd fmy_id_obd_vld_lsh_up_1.envd fmy_id_chk_ls_down_1.envd fmy_id_shift_afl_lsl_up_1.envd fmy_id_shift_afr_lsl_up_1.envd fmy_id_oc_lsl_up_1.envd fmy_id_delta_i_lam_1.envd fmy_id_ofs_lsl_up_1.envd fmy_id_ttip_mes_lsh_up_1.envd fmy_id_ctl_lsl_up_1.envd fmy_id_chg_ls_down.envd fmy_id_scg_ls_down_2.envd fmy_id_scp_ls_down_2.envd fmy_id_oc_ls_down_2.envd fmy_id_puc_ls_down_2.envd fmy_id_fl_ls_down_2.envd fmy_id_lsl_up_if_2.envd fmy_id_el_lsl_up_2.envd fmy_id_lsh_up_2.envd fmy_id_lsh_down_2.envd fmy_id_vls_down_dif_2.envd fmy_id_lsh_lsl_up_2.envd fmy_id_air_lsl_up_2.envd fmy_id_pue_ls_down_2.envd fmy_id_swt_ls_down_2.envd fmy_id_obd_lsh_down_2.envd fmy_id_dyn_vld_ls_up_2.envd fmy_id_puc_vld_ls_up_2.envd fmy_id_obd_vld_lsh_up_2.envd fmy_id_chk_ls_down_2.envd fmy_id_shift_afl_lsl_up_2.envd fmy_id_shift_afr_lsl_up_2.envd fmy_id_oc_lsl_up_2.envd fmy_id_delta_i_lam_2.envd fmy_id_ofs_lsl_up_2.envd fmy_id_ttip_mes_lsh_up_2.envd fmy_id_ctl_lsl_up_2.envd fmy_id_chg_ls_up.envd fmy_id_alter_com.envd fmy_id_cwp_com.envd fmy_id_qoil_com.envd fmy_id_sens_bat_smt_com.envd fmy_id_ecraspwm_fb.envd fmy_id_ecras_el.envd fmy_id_ecras_up_fb.envd fmy_id_ecras_down_fb.envd fmy_id_warm_rst.envd fmy_id_acr_ad.envd fmy_id_sens_acr.envd fmy_id_acr_ctl.envd fmy_id_acr_dr.envd fmy_id_var_cod.envd fmy_id_veh_pow_var.envd fmy_id_fup_mfp_plaus.envd fmy_id_h_prs_sys.envd fmy_id_fup_0.envd fmy_id_fup_1.envd fmy_id_vcv_fpc_0.envd fmy_id_fup_efp.envd fmy_id_efppwm_plaus.envd fmy_id_l_prs_sys.envd fmy_id_vcv_fpc_1.envd fmy_id_fsd_1.envd fmy_id_fsd_2.envd fmy_id_fsd_lam_lim_1.envd fmy_id_fsd_lam_lim_2.envd fmy_id_fsd_h_rng_1.envd fmy_id_fsd_h_rng_2.envd fmy_id_cyl_bal_lam_0.envd fmy_id_cyl_bal_lam_1.envd fmy_id_cyl_bal_lam_2.envd fmy_id_cyl_bal_lam_3.envd fmy_id_cyl_bal_lam_4.envd fmy_id_cyl_bal_lam_5.envd fmy_id_cyl_bal_lam_6.envd fmy_id_cyl_bal_lam_7.envd fmy_id_cyl_bal_er_0.envd fmy_id_cyl_bal_er_1.envd fmy_id_cyl_bal_er_2.envd fmy_id_cyl_bal_er_3.envd fmy_id_cyl_bal_er_4.envd fmy_id_cyl_bal_er_5.envd fmy_id_cyl_bal_er_6.envd fmy_id_cyl_bal_er_7.envd fmy_id_mon_3.envd fmy_id_maf_frq_rng_0.envd fmy_id_maf_frq_grd_0.envd fmy_id_maf_frq_el_0.envd fmy_id_maf_frq_rng_1.envd fmy_id_maf_frq_grd_1.envd fmy_id_maf_frq_el_1.envd fmy_id_tps_1_1.envd fmy_id_tps_1_2.envd fmy_id_tps_2_1.envd fmy_id_tps_2_2.envd fmy_id_tps_maf_1_1.envd fmy_id_tps_maf_1_2.envd fmy_id_tps_maf_2_1.envd fmy_id_tps_maf_2_2.envd fmy_id_tps_ratio_1.envd fmy_id_tps_ratio_2.envd fmy_id_tps_ad_1.envd fmy_id_tps_ad_2.envd fmy_id_etc_pwm_1.envd fmy_id_etc_pwm_2.envd fmy_id_etc_ctl_1.envd fmy_id_etc_ctl_2.envd fmy_id_tps_ad_spr_1.envd fmy_id_tps_ad_spr_2.envd fmy_id_etc_dr_1.envd fmy_id_etc_dr_2.envd fmy_id_tps_st_chk_1.envd fmy_id_tps_st_chk_2.envd fmy_id_com_1_tq_loss_cord.envd fmy_id_com_1_swi_gear.envd fmy_id_com_1_veh_mod.envd fmy_id_com_1_brake_tcs.envd fmy_id_com_1_tq_driv_asi.envd fmy_id_com_1_tq_tcs.envd fmy_id_com_1_tqb_tcs.envd fmy_id_com_1_wheel_tcs.envd fmy_id_com_1_req_tqdw.envd fmy_id_com_1_tq_pste.envd fmy_id_com_1_ang_pste.envd fmy_id_com_1_ac_trv.envd fmy_id_com_1_ac_lgt.envd fmy_id_com_1_tq_ars.envd fmy_id_com_1_ars.envd fmy_id_com_1_vs.envd fmy_id_com_1_tcs.envd fmy_id_com_1_boff.envd fmy_id_com_2_efp_crash.envd fmy_id_com_2_gb.envd fmy_id_com_2_etcu.envd fmy_id_com_2_tq_etcu.envd fmy_id_com_2_state_veh.envd fmy_id_com_2_cas_2.envd fmy_id_com_2_acc.envd fmy_id_com_2_km_icl.envd fmy_id_com_2_t_icl.envd fmy_id_com_2_tam_icl.envd fmy_id_com_2_t_clk.envd fmy_id_com_2_boff.envd fmy_id_com_2_t_absl_icl.envd fmy_id_com_2_cas.envd fmy_id_com_2_etcu_disp.envd fmy_id_com_2_pow_off.envd fmy_id_com_2_abs_icl.envd fmy_id_com_2_trl.envd fmy_id_com_2_hiv.envd fmy_id_com_2_icl.envd fmy_id_com_2_gear_rev.envd fmy_id_com_2_cdn_door.envd fmy_id_com_3_boff.envd fmy_id_com_3_efp.envd fmy_id_com_3_tq_etcu.envd fmy_id_com_3_etcu.envd fmy_id_com_3_etcu_disp.envd fmy_id_com_3_etcu_obd.envd fmy_id_com_3_gb.envd fmy_id_teg_sens_1.envd fmy_id_teg_sens_2.envd fmy_id_amp_plaus_cus.envd fmy_id_tcha_prs_low.envd fmy_id_tcha_leak.envd fmy_id_tcha_prs_dif.envd fmy_id_tcha_prs_high.envd fmy_id_put_plaus.envd fmy_id_map_plaus.envd fmy_id_tq_cst.envd fmy_id_gen_el.envd fmy_id_gen_mec.envd fmy_id_gen_h_temp.envd fmy_id_gen_typ_not_plaus.envd fmy_id_gen_msg_lost.envd fmy_id_gen_clc_v_not_plaus.envd fmy_id_gen_h_temp_clc.envd fmy_id_gen_ctl_not_plaus.envd fmy_id_slv_ivvt_in.envd fmy_id_slv_ivvt_ex.envd fmy_id_conv_mon_1.envd fmy_id_n_32_mon_1.envd fmy_id_pvs_mon_1.envd fmy_id_tq_dif_isc_mon_1.envd fmy_id_tq_req_mon_1.envd fmy_id_tq_ext_mon_1.envd fmy_id_tqi_av_mon_1.envd fmy_id_tqi_n_max_mon_1.envd fmy_id_mff_mon_1.envd fmy_id_cru_inh_mon_1.envd fmy_id_swi_afs_mon.envd fmy_id_iv_0.envd fmy_id_iv_1.envd fmy_id_iv_2.envd fmy_id_iv_3.envd fmy_id_iv_4.envd fmy_id_iv_5.envd fmy_id_iv_6.envd fmy_id_iv_7.envd fmy_id_iv_sc_0.envd fmy_id_iv_sc_1.envd fmy_id_iv_sc_2.envd fmy_id_iv_sc_3.envd fmy_id_iv_sc_4.envd fmy_id_iv_sc_5.envd fmy_id_iv_sc_6.envd fmy_id_iv_sc_7.envd fmy_id_pbk_iv_1.envd fmy_id_pbk_iv_2.envd fmy_id_pbk_iv_3.envd fmy_id_pbk_iv_4.envd /end DEF_CHARACTERISTIC
/end FUNCTION
/begin FUNCTION ERRM_Statistical_Data "Statistical_data"
 /begin OUT_MEASUREMENT t_act_mil dist_act_mil dist_dtc_clr dist_rel_dtc_clr ctr_wup_dtc_clr state_ena_obd state_cmpl_obd t_dtc_clr t_act_mil_60 /end OUT_MEASUREMENT
/end FUNCTION
/begin FUNCTION ERRM_Rate_Base_Monitoring "Rate_base_monitoring"
 /begin DEF_CHARACTERISTIC c_t_ast_rbm c_vs_thd_rbm c_t_vs_rbm c_tam_min_rbm c_amp_min_rbm c_dly_ast_rbm c_t_is_rbm c_vs_thd_is_cdn_rbm c_pv_is_rbm lc_rbm_clr c_tam_min_cst_rbm c_tam_max_cst_rbm c_t_ast_cst_rbm c_tco_st_min_cst_rbm c_tco_st_max_cst_rbm c_tam_st_hys_cst_rbm /end DEF_CHARACTERISTIC
 /begin OUT_MEASUREMENT ctr_igk_cyc_rbm ctr_cdn_obd_rbm lv_igk_cyc_rbm lv_dc_rbm t_ast_rbm t_vs_rbm t_is_rbm state_dc_rbm state_rbm[0] state_rbm[1] state_rbm[2] state_rbm[3] state_rbm[4] state_rbm[5] state_rbm[6] state_rbm[7] state_rbm[8] state_rbm[9] state_rbm[10] state_rbm[11] state_rbm[12] state_rbm[13] state_rbm[14] state_rbm[15] state_rbm[16] state_rbm[17] state_rbm[18] state_rbm[19] state_rbm[20] state_rbm[21] state_rbm[22] state_rbm[23] state_rbm[24] state_rbm[25] state_rbm[26] state_rbm[27] state_rbm[28] state_rbm[29] state_rbm[30] state_rbm[31] state_rbm[32] state_rbm[33] state_rbm[34] state_rbm[35] state_rbm[36] state_rbm[37] state_rbm[38] state_rbm[39] state_rbm[40] state_rbm[41] state_rbm[42] state_rbm[43] state_rbm[44] state_rbm[45] state_rbm[46] state_rbm[47] state_rbm[48] rbm_stat_CAT_DIAG_1.ctr_comp_rbm rbm_stat_CAT_DIAG_1.ctr_cdn_rbm rbm_stat_CAT_DIAG_1.state_ctr_rbm rbm_stat_CAT_DIAG_2.ctr_comp_rbm rbm_stat_CAT_DIAG_2.ctr_cdn_rbm rbm_stat_CAT_DIAG_2.state_ctr_rbm rbm_stat_DYN_VLD_LS_UP_1.ctr_comp_rbm rbm_stat_DYN_VLD_LS_UP_1.ctr_cdn_rbm rbm_stat_DYN_VLD_LS_UP_1.state_ctr_rbm rbm_stat_DYN_VLD_LS_UP_2.ctr_comp_rbm rbm_stat_DYN_VLD_LS_UP_2.ctr_cdn_rbm rbm_stat_DYN_VLD_LS_UP_2.state_ctr_rbm rbm_stat_MEC_IVVT_IN.ctr_comp_rbm rbm_stat_MEC_IVVT_IN.ctr_cdn_rbm rbm_stat_MEC_IVVT_IN.state_ctr_rbm rbm_stat_SA_SYS.ctr_comp_rbm rbm_stat_SA_SYS.ctr_cdn_rbm rbm_stat_SA_SYS.state_ctr_rbm rbm_stat_AIR_LSL_UP_1.ctr_comp_rbm rbm_stat_AIR_LSL_UP_1.ctr_cdn_rbm rbm_stat_AIR_LSL_UP_1.state_ctr_rbm rbm_stat_AIR_LSL_UP_2.ctr_comp_rbm rbm_stat_AIR_LSL_UP_2.ctr_cdn_rbm rbm_stat_AIR_LSL_UP_2.state_ctr_rbm rbm_stat_DMTLM.ctr_comp_rbm rbm_stat_DMTLM.ctr_cdn_rbm rbm_stat_DMTLM.state_ctr_rbm rbm_stat_MEC_IVVT_EX.ctr_comp_rbm rbm_stat_MEC_IVVT_EX.ctr_cdn_rbm rbm_stat_MEC_IVVT_EX.state_ctr_rbm rbm_stat_SA_SAFM.ctr_comp_rbm rbm_stat_SA_SAFM.ctr_cdn_rbm rbm_stat_SA_SAFM.state_ctr_rbm rbm_stat_SA_SAP.ctr_comp_rbm rbm_stat_SA_SAP.ctr_cdn_rbm rbm_stat_SA_SAP.state_ctr_rbm rbm_stat_SA_SAV.ctr_comp_rbm rbm_stat_SA_SAV.ctr_cdn_rbm rbm_stat_SA_SAV.state_ctr_rbm rbm_stat_SA_SAV_LSL.ctr_comp_rbm rbm_stat_SA_SAV_LSL.ctr_cdn_rbm rbm_stat_SA_SAV_LSL.state_ctr_rbm rbm_stat_SHIFT_AFL_LSL_UP_1.ctr_comp_rbm rbm_stat_SHIFT_AFL_LSL_UP_1.ctr_cdn_rbm rbm_stat_SHIFT_AFL_LSL_UP_1.state_ctr_rbm rbm_stat_SHIFT_AFL_LSL_UP_2.ctr_comp_rbm rbm_stat_SHIFT_AFL_LSL_UP_2.ctr_cdn_rbm rbm_stat_SHIFT_AFL_LSL_UP_2.state_ctr_rbm rbm_stat_SHIFT_AFR_LSL_UP_1.ctr_comp_rbm rbm_stat_SHIFT_AFR_LSL_UP_1.ctr_cdn_rbm rbm_stat_SHIFT_AFR_LSL_UP_1.state_ctr_rbm rbm_stat_SHIFT_AFR_LSL_UP_2.ctr_comp_rbm rbm_stat_SHIFT_AFR_LSL_UP_2.ctr_cdn_rbm rbm_stat_SHIFT_AFR_LSL_UP_2.state_ctr_rbm rbm_stat_TAM_PLAUS.ctr_comp_rbm rbm_stat_TAM_PLAUS.ctr_cdn_rbm rbm_stat_TAM_PLAUS.state_ctr_rbm rbm_stat_TCO_2_PLAUS.ctr_comp_rbm rbm_stat_TCO_2_PLAUS.ctr_cdn_rbm rbm_stat_TCO_2_PLAUS.state_ctr_rbm rbm_stat_TCO_PLAUS.ctr_comp_rbm rbm_stat_TCO_PLAUS.ctr_cdn_rbm rbm_stat_TCO_PLAUS.state_ctr_rbm rbm_stat_TCO_STUCK.ctr_comp_rbm rbm_stat_TCO_STUCK.ctr_cdn_rbm rbm_stat_TCO_STUCK.state_ctr_rbm rbm_stat_VS_PLAUS.ctr_comp_rbm rbm_stat_VS_PLAUS.ctr_cdn_rbm rbm_stat_VS_PLAUS.state_ctr_rbm rbm_stat_FTL_OBD.ctr_comp_rbm rbm_stat_FTL_OBD.ctr_cdn_rbm rbm_stat_FTL_OBD.state_ctr_rbm rbm_stat_OBD_LSH_DOWN_1.ctr_comp_rbm rbm_stat_OBD_LSH_DOWN_1.ctr_cdn_rbm rbm_stat_OBD_LSH_DOWN_1.state_ctr_rbm rbm_stat_OBD_LSH_DOWN_2.ctr_comp_rbm rbm_stat_OBD_LSH_DOWN_2.ctr_cdn_rbm rbm_stat_OBD_LSH_DOWN_2.state_ctr_rbm rbm_stat_AMP_PLAUS.ctr_comp_rbm rbm_stat_AMP_PLAUS.ctr_cdn_rbm rbm_stat_AMP_PLAUS.state_ctr_rbm rbm_stat_TIA_PLAUS.ctr_comp_rbm rbm_stat_TIA_PLAUS.ctr_cdn_rbm rbm_stat_TIA_PLAUS.state_ctr_rbm rbm_stat_MAF.ctr_comp_rbm rbm_stat_MAF.ctr_cdn_rbm rbm_stat_MAF.state_ctr_rbm rbm_stat_ISC.ctr_comp_rbm rbm_stat_ISC.ctr_cdn_rbm rbm_stat_ISC.state_ctr_rbm rbm_stat_CS.ctr_comp_rbm rbm_stat_CS.ctr_cdn_rbm rbm_stat_CS.state_ctr_rbm rbm_stat_SMALL_LEAK.ctr_comp_rbm rbm_stat_SMALL_LEAK.ctr_cdn_rbm rbm_stat_SMALL_LEAK.state_ctr_rbm rbm_stat_ROUGH_LEAK.ctr_comp_rbm rbm_stat_ROUGH_LEAK.ctr_cdn_rbm rbm_stat_ROUGH_LEAK.state_ctr_rbm rbm_stat_OBD_VLD_LSH_UP_1.ctr_comp_rbm rbm_stat_OBD_VLD_LSH_UP_1.ctr_cdn_rbm rbm_stat_OBD_VLD_LSH_UP_1.state_ctr_rbm rbm_stat_OBD_VLD_LSH_UP_2.ctr_comp_rbm rbm_stat_OBD_VLD_LSH_UP_2.ctr_cdn_rbm rbm_stat_OBD_VLD_LSH_UP_2.state_ctr_rbm rbm_stat_TH.ctr_comp_rbm rbm_stat_TH.ctr_cdn_rbm rbm_stat_TH.state_ctr_rbm rbm_stat_LOAD_TPS_PLAUS.ctr_comp_rbm rbm_stat_LOAD_TPS_PLAUS.ctr_cdn_rbm rbm_stat_LOAD_TPS_PLAUS.state_ctr_rbm rbm_stat_MAP_DIP_PLAUS.ctr_comp_rbm rbm_stat_MAP_DIP_PLAUS.ctr_cdn_rbm rbm_stat_MAP_DIP_PLAUS.state_ctr_rbm rbm_stat_VLS_DOWN_DIF_2.ctr_comp_rbm rbm_stat_VLS_DOWN_DIF_2.ctr_cdn_rbm rbm_stat_VLS_DOWN_DIF_2.state_ctr_rbm rbm_stat_VLS_DOWN_DIF_1.ctr_comp_rbm rbm_stat_VLS_DOWN_DIF_1.ctr_cdn_rbm rbm_stat_VLS_DOWN_DIF_1.state_ctr_rbm rbm_stat_CHK_LS_DOWN_1.ctr_comp_rbm rbm_stat_CHK_LS_DOWN_1.ctr_cdn_rbm rbm_stat_CHK_LS_DOWN_1.state_ctr_rbm rbm_stat_CHK_LS_DOWN_2.ctr_comp_rbm rbm_stat_CHK_LS_DOWN_2.ctr_cdn_rbm rbm_stat_CHK_LS_DOWN_2.state_ctr_rbm rbm_stat_REF_CRK_CAM_IN_1.ctr_comp_rbm rbm_stat_REF_CRK_CAM_IN_1.ctr_cdn_rbm rbm_stat_REF_CRK_CAM_IN_1.state_ctr_rbm rbm_stat_REF_CRK_CAM_EX_1.ctr_comp_rbm rbm_stat_REF_CRK_CAM_EX_1.ctr_cdn_rbm rbm_stat_REF_CRK_CAM_EX_1.state_ctr_rbm rbm_stat_SWT_LS_DOWN_1.ctr_comp_rbm rbm_stat_SWT_LS_DOWN_1.ctr_cdn_rbm rbm_stat_SWT_LS_DOWN_1.state_ctr_rbm rbm_stat_SWT_LS_DOWN_2.ctr_comp_rbm rbm_stat_SWT_LS_DOWN_2.ctr_cdn_rbm rbm_stat_SWT_LS_DOWN_2.state_ctr_rbm rbm_stat_T_ES.ctr_comp_rbm rbm_stat_T_ES.ctr_cdn_rbm rbm_stat_T_ES.state_ctr_rbm rbm_stat_TPS.ctr_comp_rbm rbm_stat_TPS.ctr_cdn_rbm rbm_stat_TPS.state_ctr_rbm rbm_stat_ANG_INST_AD_VVL.ctr_comp_rbm rbm_stat_ANG_INST_AD_VVL.ctr_cdn_rbm rbm_stat_ANG_INST_AD_VVL.state_ctr_rbm rbm_stat_ANG_CHK_MAX_VVL.ctr_comp_rbm rbm_stat_ANG_CHK_MAX_VVL.ctr_cdn_rbm rbm_stat_ANG_CHK_MAX_VVL.state_ctr_rbm rbm_stat_TOOTH_OFF_IN_1.ctr_comp_rbm rbm_stat_TOOTH_OFF_IN_1.ctr_cdn_rbm rbm_stat_TOOTH_OFF_IN_1.state_ctr_rbm rbm_stat_TOOTH_OFF_EX_1.ctr_comp_rbm rbm_stat_TOOTH_OFF_EX_1.ctr_cdn_rbm rbm_stat_TOOTH_OFF_EX_1.state_ctr_rbm rbm_stat_ISC_CST.ctr_comp_rbm rbm_stat_ISC_CST.ctr_cdn_rbm rbm_stat_ISC_CST.state_ctr_rbm rbm_stat_TQ_CST.ctr_comp_rbm rbm_stat_TQ_CST.ctr_cdn_rbm rbm_stat_TQ_CST.state_ctr_rbm rbm_stat_DIAGCPS.ctr_comp_rbm rbm_stat_DIAGCPS.ctr_cdn_rbm rbm_stat_DIAGCPS.state_ctr_rbm rbm_stat_SA.ctr_comp_rbm rbm_stat_SA.ctr_cdn_rbm rbm_stat_SA.state_ctr_rbm t_ast_cst_rbm rbm_stat_TCO_STUCK_RNG.ctr_comp_rbm rbm_stat_TCO_STUCK_RNG.ctr_cdn_rbm rbm_stat_TCO_STUCK_RNG.state_ctr_rbm /end OUT_MEASUREMENT
/end FUNCTION
/begin FUNCTION ERRM_Dyn_Error_Managmt_Appl_Inc "Dyn_Error_Management_Core_Appl_Inc" /begin OUT_MEASUREMENT lv_inh_wup_cyc tco_st_dsl_cmn tco_dsl_cmn /end OUT_MEASUREMENT /end FUNCTION
/begin FUNCTION ERRM_Statistical_Data_Appl_Inc "Statistical_data_Appl_Inc"
 /begin OUT_MEASUREMENT fmy_ram_dyn[0].err_info_dyn.lv_cdn_diag_dc fmy_ram_dyn[0].ctr_dc_err_det fmy_ram_dyn[0].ctr_dc_err_det_diag_cdn fmy_ram_dyn[0].ctr_dc_err_det_diag_cmpl fmy_ram_dyn[1].err_info_dyn.lv_cdn_diag_dc fmy_ram_dyn[1].ctr_dc_err_det fmy_ram_dyn[1].ctr_dc_err_det_diag_cdn fmy_ram_dyn[1].ctr_dc_err_det_diag_cmpl fmy_ram_dyn[2].err_info_dyn.lv_cdn_diag_dc fmy_ram_dyn[2].ctr_dc_err_det fmy_ram_dyn[2].ctr_dc_err_det_diag_cdn fmy_ram_dyn[2].ctr_dc_err_det_diag_cmpl fmy_ram_dyn[3].err_info_dyn.lv_cdn_diag_dc fmy_ram_dyn[3].ctr_dc_err_det fmy_ram_dyn[3].ctr_dc_err_det_diag_cdn fmy_ram_dyn[3].ctr_dc_err_det_diag_cmpl fmy_ram_dyn[4].err_info_dyn.lv_cdn_diag_dc fmy_ram_dyn[4].ctr_dc_err_det fmy_ram_dyn[4].ctr_dc_err_det_diag_cdn fmy_ram_dyn[4].ctr_dc_err_det_diag_cmpl fmy_ram_dyn[5].err_info_dyn.lv_cdn_diag_dc fmy_ram_dyn[5].ctr_dc_err_det fmy_ram_dyn[5].ctr_dc_err_det_diag_cdn fmy_ram_dyn[5].ctr_dc_err_det_diag_cmpl fmy_ram_dyn[6].err_info_dyn.lv_cdn_diag_dc fmy_ram_dyn[6].ctr_dc_err_det fmy_ram_dyn[6].ctr_dc_err_det_diag_cdn fmy_ram_dyn[6].ctr_dc_err_det_diag_cmpl fmy_ram_dyn[7].err_info_dyn.lv_cdn_diag_dc fmy_ram_dyn[7].ctr_dc_err_det fmy_ram_dyn[7].ctr_dc_err_det_diag_cdn fmy_ram_dyn[7].ctr_dc_err_det_diag_cmpl fmy_ram_dyn[8].err_info_dyn.lv_cdn_diag_dc fmy_ram_dyn[8].ctr_dc_err_det fmy_ram_dyn[8].ctr_dc_err_det_diag_cdn fmy_ram_dyn[8].ctr_dc_err_det_diag_cmpl fmy_ram_dyn[9].err_info_dyn.lv_cdn_diag_dc fmy_ram_dyn[9].ctr_dc_err_det fmy_ram_dyn[9].ctr_dc_err_det_diag_cdn fmy_ram_dyn[9].ctr_dc_err_det_diag_cmpl /end OUT_MEASUREMENT
/end FUNCTION
/begin FUNCTION ERRM_Rate_Base_Monitoring_Appl_I "Rate_base_monitoring_Appl_Inc" /end FUNCTION
/end MODULE
/end PROJECT
