ASAP2_VERSION 1 41
/begin PROJECT MSD70 "Spray Guided DI-System with Piezo Injectors for 6-Cylinder"
/begin HEADER "_default_HeaderComment" PROJECT_NO _0B /end HEADER
/begin MODULE _default_ModuleName "_default_ModuleLongIdentifier"
/begin MOD_COMMON "_default_ModCommonComment" DEPOSIT ABSOLUTE BYTE_ORDER MSB_LAST ALIGNMENT_BYTE 1 ALIGNMENT_WORD 2 ALIGNMENT_LONG 2 ALIGNMENT_FLOAT32_IEEE 2 ALIGNMENT_FLOAT64_IEEE 4 /end MOD_COMMON
/begin MEASUREMENT Dzw_hz "Zündwinkeloffset für Heizleistungseingriff" SBYTE _CNV_R_R_Def_zw_sb__623_CM 1 100. -64. 63.5 DISPLAY_IDENTIFIER DZW_HZ ECU_ADDRESS 0xd0006bf3 FORMAT "%4.1" /end MEASUREMENT
/begin MEASUREMENT Dzw_kr_gd "Differenzzündwinkel für Klopfen gedrosselter Betrieb" SBYTE _CNV_R_R_Def_zw_sb__623_CM 1 100. -64. 63.5 DISPLAY_IDENTIFIER DZW_KR_GD ECU_ADDRESS 0xd0006bd9 FORMAT "%4.1" /end MEASUREMENT
/begin MEASUREMENT Dzw_kr_vt "Differenzzündwinkel für Klopfen VVT Betrieb" SBYTE _CNV_R_R_Def_zw_sb__623_CM 1 100. -64. 63.5 DISPLAY_IDENTIFIER DZW_KR_VT ECU_ADDRESS 0xd0006bda FORMAT "%4.1" /end MEASUREMENT
/begin MEASUREMENT Dzw_lam_kor "Lambdakorrektur Grundzündwinkel" SBYTE _CNV_R_R_Def_zw_sb__623_CM 1 100. -64. 63.5 DISPLAY_IDENTIFIER DZW_LAM_KOR ECU_ADDRESS 0xd0006bd6 FORMAT "%4.1" /end MEASUREMENT
/begin MEASUREMENT Dzw_lam_kor1 "Lambdakorrektur1 Grundzündwinkel GDI " SBYTE _CNV_R_R_Def_zw_sb__623_CM 1 100. -64. 63.5 DISPLAY_IDENTIFIER DZW_LAM_KOR1 ECU_ADDRESS 0xd0006bd7 FORMAT "%4.1" /end MEASUREMENT
/begin MEASUREMENT Dzw_lam_kor2 "Lambdakorrektur2 Grundzündwinkel GDI" SBYTE _CNV_R_R_Def_zw_sb__623_CM 1 100. -64. 63.5 DISPLAY_IDENTIFIER DZW_LAM_KOR2 ECU_ADDRESS 0xd0006bd8 FORMAT "%4.1" /end MEASUREMENT
/begin MEASUREMENT Dzw_t1 "Temperaturkorrektur 1 Grundzündwinkel" SBYTE _CNV_R_R_Def_zw_sb__623_CM 1 100. -64. 63.5 DISPLAY_IDENTIFIER DZW_T1 ECU_ADDRESS 0xd0006bd4 FORMAT "%4.1" /end MEASUREMENT
/begin MEASUREMENT Dzw_td98 "Grundzündwinkelkorrektur teilgedrosselt ROZ 98" SBYTE _CNV_R_R_Def_zw_sb__623_CM 1 100. -64. 63.5 DISPLAY_IDENTIFIER DZW_TD98 ECU_ADDRESS 0xd0006bca FORMAT "%4.1" /end MEASUREMENT
/begin MEASUREMENT Dzw_vns_vt "Differenzzündwinkel bei Warmlauf VVT Betrieb" SBYTE _CNV_R_R_Def_zw_sb__623_CM 1 100. -64. 63.5 DISPLAY_IDENTIFIER DZW_VNS_VT ECU_ADDRESS 0xd0006bb5 FORMAT "%4.1" /end MEASUREMENT
/begin MEASUREMENT Dzw_wl_gd "Differenzzündwinkel bei Warmlauf gedrosselter Betrieb" SBYTE _CNV_R_R_Def_zw_sb__623_CM 1 100. -64. 63.5 DISPLAY_IDENTIFIER DZW_WL_GD ECU_ADDRESS 0xd0006bb6 FORMAT "%4.1" /end MEASUREMENT
/begin MEASUREMENT Dzw_wl_vt "Differenzzündwinkel bei Warmlauf VVT Betrieb" SBYTE _CNV_R_R_Def_zw_sb__623_CM 1 100. -64. 63.5 DISPLAY_IDENTIFIER DZW_WL_VT ECU_ADDRESS 0xd0006bb4 FORMAT "%4.1" /end MEASUREMENT
/begin MEASUREMENT Dzwdyn "Differenzzündwinkel Dynamikkorrektur" SBYTE _CNV_R_R_Def_zw_sb__623_CM 1 100. -64. 63.5 DISPLAY_IDENTIFIER DZWDYN ECU_ADDRESS 0xd0006be7 FORMAT "%4.1" /end MEASUREMENT
/begin MEASUREMENT Dzwdyn_dek "Differenzzündwinkel Dynamikkorrektur Abregelungsdekrement" SBYTE _CNV_R_R_Def_zw_sb__623_CM 1 100. -64. 63.5 DISPLAY_IDENTIFIER DZWDYN_DEK ECU_ADDRESS 0xd0006be9 FORMAT "%4.1" /end MEASUREMENT
/begin MEASUREMENT Dzwdyn_hold "Differenzzündwinkel Dynamikkorrektur Haltewert" SBYTE _CNV_R_R_Def_zw_sb__623_CM 1 100. -64. 63.5 DISPLAY_IDENTIFIER DZWDYN_HOLD ECU_ADDRESS 0xd0006be8 FORMAT "%4.1" /end MEASUREMENT
/begin MEASUREMENT Dzwdynn "Differenzzündwinkel Dynamikkorrektur negative Richtung" SBYTE _CNV_R_R_Def_zw_sb__623_CM 1 100. -64. 63.5 DISPLAY_IDENTIFIER DZWDYNN ECU_ADDRESS 0xd0006bf0 FORMAT "%4.1" /end MEASUREMENT
/begin MEASUREMENT Dzwdynn_dek "Differenzzündwinkel Dynamikkorrektur Abregelungsdekrement " SBYTE _CNV_R_R_Def_zw_sb__623_CM 1 100. -64. 63.5 DISPLAY_IDENTIFIER DZWDYNN_DEK ECU_ADDRESS 0xd0006bf2 FORMAT "%4.1" /end MEASUREMENT
/begin MEASUREMENT Dzwdynn_hold "Differenzzündwinkel Dynamikkorrektur Haltewert negative Richtung" SBYTE _CNV_R_R_Def_zw_sb__623_CM 1 100. -64. 63.5 DISPLAY_IDENTIFIER DZWDYNN_HOLD ECU_ADDRESS 0xd0006bf1 FORMAT "%4.1" /end MEASUREMENT
/begin MEASUREMENT Dzwo_lam_kor "Grundreferenzzündwinkel Lambdakorrektur" SBYTE _CNV_R_R_Def_zw_sb__623_CM 1 100. -64. 63.5 DISPLAY_IDENTIFIER DZWO_LAM_KOR ECU_ADDRESS 0xd0006b9b FORMAT "%4.1" /end MEASUREMENT
/begin MEASUREMENT Dzwo_lam_kor1 "Grundreferenzzündwinkel Lambdakorrektur Bank 1" SBYTE _CNV_R_R_Def_zw_sb__623_CM 1 100. -64. 63.5 DISPLAY_IDENTIFIER DZWO_LAM_KOR1 ECU_ADDRESS 0xd0006b9c FORMAT "%4.1" /end MEASUREMENT
/begin MEASUREMENT Dzwo_lam_kor2 "Grundreferenzzündwinkel Lambdakorrektur Bank 2" SBYTE _CNV_R_R_Def_zw_sb__623_CM 1 100. -64. 63.5 DISPLAY_IDENTIFIER DZWO_LAM_KOR2 ECU_ADDRESS 0xd0006b9d FORMAT "%4.1" /end MEASUREMENT
/begin MEASUREMENT Dzwokh_lam_kor "Grundreferenzzündwinkel Lambdakorrektur bei Katheizen" SBYTE _CNV_R_R_Def_zw_sb__623_CM 1 100. -64. 63.5 DISPLAY_IDENTIFIER DZWOKH_LAM_KOR ECU_ADDRESS 0xd0006bb1 FORMAT "%4.1" /end MEASUREMENT
/begin MEASUREMENT Dzwot "Grundreferenzzündwinkel Temperaturkorrektur" SBYTE _CNV_R_R_Def_zw_sb__623_CM 1 100. -64. 63.5 DISPLAY_IDENTIFIER DZWOT ECU_ADDRESS 0xd0006b9a FORMAT "%4.1" /end MEASUREMENT
/begin MEASUREMENT Dzwt "Temperaturkorrektur Grundzündwinkel" SWORD _CNV_R_R_Def_zw_sw__599_CM 1 100. -50. 60. DISPLAY_IDENTIFIER DZWT ECU_ADDRESS 0xd0006bc6 FORMAT "%6.1" /end MEASUREMENT
/begin MEASUREMENT Dzwt_gd "Differenzzündwinkel gedrosselter Betrieb" SBYTE _CNV_R_R_Def_zw_sb__623_CM 1 100. -64. 63.5 DISPLAY_IDENTIFIER DZWT_GD ECU_ADDRESS 0xd0006bdc FORMAT "%4.1" /end MEASUREMENT
/begin MEASUREMENT Dzwt_vt "Differenzzündwinkel VVT Betrieb" SBYTE _CNV_R_R_Def_zw_sb__623_CM 1 100. -64. 63.5 DISPLAY_IDENTIFIER DZWT_VT ECU_ADDRESS 0xd0006bdb FORMAT "%4.1" /end MEASUREMENT
/begin MEASUREMENT F_dynakt "Faktor Haltezeit Dynamikkorrektur" UBYTE _CNV_R_R_Def_f_ub_b_573_CM 1 100. 0. 0.996 DISPLAY_IDENTIFIER F_DYNAKT ECU_ADDRESS 0xd0006be6 /end MEASUREMENT
/begin MEASUREMENT F_dynnakt "Faktor Haltezeit Dynamikkorrektur negative Richtung" UBYTE _CNV_R_R_Def_f_ub_b_573_CM 1 100. 0. 0.996 DISPLAY_IDENTIFIER F_DYNNAKT ECU_ADDRESS 0xd0006bef /end MEASUREMENT
/begin MEASUREMENT F_dynnvz "Faktor Verzögerungszeit Dynamikkorrektur negative Richtung" UBYTE _CNV_R_R_Def_f_ub_b_573_CM 1 100. 0. 0.996 DISPLAY_IDENTIFIER F_DYNNVZ ECU_ADDRESS 0xd0006bee /end MEASUREMENT
/begin MEASUREMENT F_dynvz "Faktor Verzögerungszeit Dynamikkorrektur" UBYTE _CNV_R_R_Def_f_ub_b_573_CM 1 100. 0. 0.996 DISPLAY_IDENTIFIER F_DYNVZ ECU_ADDRESS 0xd0006be5 /end MEASUREMENT
/begin MEASUREMENT F_dzw_vns_vt "Faktor Wichtung KF_DZW_VNS_VT zu KF_DZW_WL_VT" UBYTE _CNV_R_R_Def_f_ub_b_573_CM 1 100. 0. 0.996 DISPLAY_IDENTIFIER F_DZW_VNS_VT ECU_ADDRESS 0xd0006bdd /end MEASUREMENT
/begin MEASUREMENT F_rfzwv "Faktor Uberblendung Verzögerung Rf" UBYTE _CNV_R_R_Def_f_ub_b_573_CM 1 100. 0. 0.996 DISPLAY_IDENTIFIER F_RFZWV ECU_ADDRESS 0xd0006bde /end MEASUREMENT
/begin MEASUREMENT F_zw_kr_gd "Faktor KR Spätverstellung" UWORD _CNV_R_R_Def_f_uw_b_579_CM 1 100. 0. 1.9999 DISPLAY_IDENTIFIER F_ZW_KR_GD ECU_ADDRESS 0xd0006c08 FORMAT "%14.5" /end MEASUREMENT
/begin MEASUREMENT F_zw_kr_vt "Faktor KR Spätverstellung" UWORD _CNV_R_R_Def_f_uw_b_579_CM 1 100. 0. 1.9999 DISPLAY_IDENTIFIER F_ZW_KR_VT ECU_ADDRESS 0xd0006c06 FORMAT "%14.5" /end MEASUREMENT
/begin MEASUREMENT F_zwhz "Einblendungsfaktor Zündwinkeleingriff für Heizleistungssteigerung" UBYTE _CNV_R_R_Def_f_ub_b_573_CM 1 100. 0. 0.996 DISPLAY_IDENTIFIER F_ZWHZ ECU_ADDRESS 0xd0006bf4 /end MEASUREMENT
/begin MEASUREMENT Minhubsw "Minhub als signed Word" SWORD _CNV_R_R_Def_hub_uw_605_CM 1 100. -32.768 32.767 DISPLAY_IDENTIFIER MINHUBSW ECU_ADDRESS 0xd0006c0a FORMAT "%8.3" /end MEASUREMENT
/begin MEASUREMENT Rf_sol_old "alte rel. Sollfüllung" SWORD _CNV_R_R_Def_rf_sw__616_CM 1 100. -327.68 327.67 DISPLAY_IDENTIFIER RF_SOL_OLD ECU_ADDRESS 0xd0006bfc FORMAT "%9.4" /end MEASUREMENT
/begin MEASUREMENT Rf_solkrv "verz. rel. Sollfüllung für KR" SWORD _CNV_R_R_Def_rf_sw__616_CM 1 100. -327.68 327.67 DISPLAY_IDENTIFIER RF_SOLKRV ECU_ADDRESS 0xd0006bf6 FORMAT "%9.4" /end MEASUREMENT
/begin MEASUREMENT Rf_solkrv_hold "gehaltener Wert  rel. Sollfüllung für KR" SWORD _CNV_R_R_Def_rf_sw__616_CM 1 100. -327.68 327.67 DISPLAY_IDENTIFIER RF_SOLKRV_HOLD ECU_ADDRESS 0xd0006c02 FORMAT "%9.4" /end MEASUREMENT
/begin MEASUREMENT Rf_solkrv_old "alte verz. rel. Sollfüllung für KR" SWORD _CNV_R_R_Def_rf_sw__616_CM 1 100. -327.68 327.67 DISPLAY_IDENTIFIER RF_SOLKRV_OLD ECU_ADDRESS 0xd0006bfe FORMAT "%9.4" /end MEASUREMENT
/begin MEASUREMENT Rf_solkrvf "gef. verz. rel. Sollfüllung für KR" SWORD _CNV_R_R_Def_rf_sw__616_CM 1 100. -327.68 327.67 DISPLAY_IDENTIFIER RF_SOLKRVF ECU_ADDRESS 0xd0006bbc FORMAT "%9.4" /end MEASUREMENT
/begin MEASUREMENT Rf_solkrvf_old "gef. verz. rel. Sollfüllung für KR" SWORD _CNV_R_R_Def_rf_sw__616_CM 1 100. -327.68 327.67 DISPLAY_IDENTIFIER RF_SOLKRVF_OLD ECU_ADDRESS 0xd0006c00 FORMAT "%9.4" /end MEASUREMENT
/begin MEASUREMENT Rf_solkrvfgd "gef. verz. rel. Sollfüllung gedrosselt für KR" SWORD _CNV_R_R_Def_rf_sw__616_CM 1 100. -327.68 327.67 DISPLAY_IDENTIFIER RF_SOLKRVFGD ECU_ADDRESS 0xd0006bbe FORMAT "%9.4" /end MEASUREMENT
/begin MEASUREMENT Rf_solkrvgd "verz. rel. Sollfüllung gedrosselt für KR" SWORD _CNV_R_R_Def_rf_sw__616_CM 1 100. -327.68 327.67 DISPLAY_IDENTIFIER RF_SOLKRVGD ECU_ADDRESS 0xd0006bf8 FORMAT "%9.4" /end MEASUREMENT
/begin MEASUREMENT Rf_solkrvof "verz. rel. Sollfüllung für KR ungefiltert" SWORD _CNV_R_R_Def_rf_sw__616_CM 1 100. -327.68 327.67 DISPLAY_IDENTIFIER RF_SOLKRVOF ECU_ADDRESS 0xd0006bfa FORMAT "%9.4" /end MEASUREMENT
/begin MEASUREMENT Rf_zwv "rel. Füllung verzögert für ZW" SWORD _CNV_R_R_Def_rf_sw__616_CM 1 100. -327.68 327.67 DISPLAY_IDENTIFIER RF_ZWV ECU_ADDRESS 0xd0006bb8 FORMAT "%9.4" /end MEASUREMENT
/begin MEASUREMENT Rfkr "rel. Füllung für KR" SWORD _CNV_R_R_Def_rf_sw__616_CM 1 100. -327.68 327.67 DISPLAY_IDENTIFIER RFKR ECU_ADDRESS 0xd0006bba FORMAT "%9.4" /end MEASUREMENT
/begin MEASUREMENT St_zwgrund "Statuswort ZWGRUND" UBYTE _CNV_R_R_Def_dez_sl_575_CM 1 100. 0. 255. DISPLAY_IDENTIFIER ST_ZWGRUND ECU_ADDRESS 0xd0006bb7 FORMAT "%3.0" /end MEASUREMENT
/begin MEASUREMENT St_zwgrund.B_zwdyn "Bedingung Grundzündwinkeldynamik" UBYTE _CNV_S_1_Def_bit_ub_700_CM 1 100. 0. 0. DISPLAY_IDENTIFIER B_ZWDYN ECU_ADDRESS 0xd0006bb7 BIT_MASK 0x1 /end MEASUREMENT
/begin MEASUREMENT St_zwgrund.B_zwdynn "Bedingung Grundzündwinkeldynamik negative Richtung" UBYTE _CNV_S_1_Def_bit_ub_700_CM 1 100. 0. 0. DISPLAY_IDENTIFIER B_ZWDYNN ECU_ADDRESS 0xd0006bb7 BIT_MASK 0x2 /end MEASUREMENT
/begin MEASUREMENT St_zwgrund1 "Statuswort ZWGRUND 1" UBYTE _CNV_R_R_Def_dez_sl_575_CM 1 100. 0. 255. DISPLAY_IDENTIFIER ST_ZWGRUND1 ECU_ADDRESS 0xd0006bc8 FORMAT "%3.0" /end MEASUREMENT
/begin MEASUREMENT St_zwgrund1.B_rfsola "Bedingung alt. Zeitkonstante für Rf_soll-Filter" UBYTE _CNV_S_1_Def_bit_ub_700_CM 1 100. 0. 0. DISPLAY_IDENTIFIER B_RFSOLA ECU_ADDRESS 0xd0006bc8 BIT_MASK 0x4 /end MEASUREMENT
/begin MEASUREMENT St_zwgrund1.B_trigin "Bedingung Triggereingang Grundzündwinkeldynamik" UBYTE _CNV_S_1_Def_bit_ub_700_CM 1 100. 0. 0. DISPLAY_IDENTIFIER B_TRIGIN ECU_ADDRESS 0xd0006bc8 BIT_MASK 0x8 /end MEASUREMENT
/begin MEASUREMENT St_zwgrund1.B_trigout "Bedingung Triggerausgang Grundzündwinkeldynamik" UBYTE _CNV_S_1_Def_bit_ub_700_CM 1 100. 0. 0. DISPLAY_IDENTIFIER B_TRIGOUT ECU_ADDRESS 0xd0006bc8 BIT_MASK 0x10 /end MEASUREMENT
/begin MEASUREMENT St_zwgrund1.B_zwdynakt "Bedingung Haltezeit Dynamikkorrektur" UBYTE _CNV_S_1_Def_bit_ub_700_CM 1 100. 0. 0. DISPLAY_IDENTIFIER B_ZWDYNAKT ECU_ADDRESS 0xd0006bc8 BIT_MASK 0x40 /end MEASUREMENT
/begin MEASUREMENT St_zwgrund1.B_zwdynvz "Bedingung Verzögerung Dynamikkorrektur" UBYTE _CNV_S_1_Def_bit_ub_700_CM 1 100. 0. 0. DISPLAY_IDENTIFIER B_ZWDYNVZ ECU_ADDRESS 0xd0006bc8 BIT_MASK 0x20 /end MEASUREMENT
/begin MEASUREMENT St_zwgrund1.B_zwfall "Bedingung Grundzündwinkel fällt" UBYTE _CNV_S_1_Def_bit_ub_700_CM 1 100. 0. 0. DISPLAY_IDENTIFIER B_ZWFALL ECU_ADDRESS 0xd0006bc8 BIT_MASK 0x2 /end MEASUREMENT
/begin MEASUREMENT St_zwgrund1.B_zwsteig "Bedingung Grundzündwinkel steigt" UBYTE _CNV_S_1_Def_bit_ub_700_CM 1 100. 0. 0. DISPLAY_IDENTIFIER B_ZWSTEIG ECU_ADDRESS 0xd0006bc8 BIT_MASK 0x1 /end MEASUREMENT
/begin MEASUREMENT St_zwgrund2 "Statuswort ZWGRUND 2" UBYTE _CNV_R_R_Def_dez_sl_575_CM 1 100. 0. 255. DISPLAY_IDENTIFIER ST_ZWGRUND2 ECU_ADDRESS 0xd0006bc9 FORMAT "%3.0" /end MEASUREMENT
/begin MEASUREMENT St_zwgrund2.B_triginn "Bedingung Triggereingang Grundzündwinkeldynamik negative Richtung" UBYTE _CNV_S_1_Def_bit_ub_700_CM 1 100. 0. 0. DISPLAY_IDENTIFIER B_TRIGINN ECU_ADDRESS 0xd0006bc9 BIT_MASK 0x4 /end MEASUREMENT
/begin MEASUREMENT St_zwgrund2.B_trigoutn "Bedingung Triggerausgang Grundzündwinkeldynamik negative Richtung" UBYTE _CNV_S_1_Def_bit_ub_700_CM 1 100. 0. 0. DISPLAY_IDENTIFIER B_TRIGOUTN ECU_ADDRESS 0xd0006bc9 BIT_MASK 0x8 /end MEASUREMENT
/begin MEASUREMENT St_zwgrund2.B_zwdynnakt "Bedingung Haltezeit Dynamikkorrektur negative Richtung" UBYTE _CNV_S_1_Def_bit_ub_700_CM 1 100. 0. 0. DISPLAY_IDENTIFIER B_ZWDYNNAKT ECU_ADDRESS 0xd0006bc9 BIT_MASK 0x2 /end MEASUREMENT
/begin MEASUREMENT St_zwgrund2.B_zwdynnvz "Bedingung Verzögerung Dynamikkorrektur negative Richtung" UBYTE _CNV_S_1_Def_bit_ub_700_CM 1 100. 0. 0. DISPLAY_IDENTIFIER B_ZWDYNNVZ ECU_ADDRESS 0xd0006bc9 BIT_MASK 0x1 /end MEASUREMENT
/begin MEASUREMENT St_zwgrundhs "Statuswort St_zwgrundhs" UBYTE _CNV_R_R_Def_dez_sl_575_CM 1 100. 0. 255. DISPLAY_IDENTIFIER ST_ZWGRUNDHS ECU_ADDRESS 0xd0006bf5 FORMAT "%3.0" /end MEASUREMENT
/begin MEASUREMENT St_zwgrundhs.B_zwhz "Heizleistungssteigerung über Zündwinkel aktiv" UBYTE _CNV_S_1_Def_bit_ub_700_CM 1 100. 0. 0. DISPLAY_IDENTIFIER B_ZWHZ ECU_ADDRESS 0xd0006bf5 BIT_MASK 0x1 /end MEASUREMENT
/begin MEASUREMENT Td_dynakt "Haltezeit Dynamikkorrektur" UBYTE _CNV_R_R_Def_td_uw__679_CM 1 100. 0. 2.55 DISPLAY_IDENTIFIER TD_DYNAKT ECU_ADDRESS 0xd0006be2 FORMAT "%5.2" /end MEASUREMENT
/begin MEASUREMENT Td_dyndek "Abregelungszeit Dynamikkorrektur" UBYTE _CNV_R_R_Def_td_uw__679_CM 1 100. 0. 2.55 DISPLAY_IDENTIFIER TD_DYNDEK ECU_ADDRESS 0xd0006be3 FORMAT "%5.2" /end MEASUREMENT
/begin MEASUREMENT Td_dynnakt "Haltezeit Dynamikkorrektur negative Richtung" UBYTE _CNV_R_R_Def_td_uw__679_CM 1 100. 0. 2.55 DISPLAY_IDENTIFIER TD_DYNNAKT ECU_ADDRESS 0xd0006beb FORMAT "%5.2" /end MEASUREMENT
/begin MEASUREMENT Td_dynndek "Abregelungszeit Dynamikkorrektur negative Richtung" UBYTE _CNV_R_R_Def_td_uw__679_CM 1 100. 0. 2.55 DISPLAY_IDENTIFIER TD_DYNNDEK ECU_ADDRESS 0xd0006bec FORMAT "%5.2" /end MEASUREMENT
/begin MEASUREMENT Td_dynnvz "Verzögerungszeit Dynamikkorrektur negative Richtung" UBYTE _CNV_R_R_Def_td_uw__679_CM 1 100. 0. 2.55 DISPLAY_IDENTIFIER TD_DYNNVZ ECU_ADDRESS 0xd0006bea FORMAT "%5.2" /end MEASUREMENT
/begin MEASUREMENT Td_dynvz "Verzögerungszeit Dynamikkorrektur" UBYTE _CNV_R_R_Def_td_uw__679_CM 1 100. 0. 2.55 DISPLAY_IDENTIFIER TD_DYNVZ ECU_ADDRESS 0xd0006be1 FORMAT "%5.2" /end MEASUREMENT
/begin MEASUREMENT Tddrfsol "Haltezeit B_zwdyn" UBYTE _CNV_R_R_Def_td_uw__679_CM 1 100. 0. 2.55 DISPLAY_IDENTIFIER TDDRFSOL ECU_ADDRESS 0xd0006bdf FORMAT "%5.2" /end MEASUREMENT
/begin MEASUREMENT Tddrfsol_dyn "Gesamtzeitzeit Dynamikkorrektur" UBYTE _CNV_R_R_Def_td_uw__679_CM 1 100. 0. 2.55 DISPLAY_IDENTIFIER TDDRFSOL_DYN ECU_ADDRESS 0xd0006be4 FORMAT "%5.2" /end MEASUREMENT
/begin MEASUREMENT Tddrfsoln "Haltezeit B_zwdynn" UBYTE _CNV_R_R_Def_td_uw__679_CM 1 100. 0. 2.55 DISPLAY_IDENTIFIER TDDRFSOLN ECU_ADDRESS 0xd0006be0 FORMAT "%5.2" /end MEASUREMENT
/begin MEASUREMENT Tddrfsoln_dyn "Gesamtzeitzeit Dynamikkorrektur negative Richtung" UBYTE _CNV_R_R_Def_td_uw__679_CM 1 100. 0. 2.55 DISPLAY_IDENTIFIER TDDRFSOLN_DYN ECU_ADDRESS 0xd0006bed FORMAT "%5.2" /end MEASUREMENT
/begin MEASUREMENT Zw_grund "Grundzündwinkel" SWORD _CNV_R_R_Def_zw_sw__599_CM 1 100. -50. 60. DISPLAY_IDENTIFIER ZW_GRUND ECU_ADDRESS 0xd0006bc0 FORMAT "%6.1" /end MEASUREMENT
/begin MEASUREMENT Zw_grund1 "Grundzündwinkel1 GDI" SWORD _CNV_R_R_Def_zw_sw__599_CM 1 100. -50. 60. DISPLAY_IDENTIFIER ZW_GRUND1 ECU_ADDRESS 0xd0006bc2 FORMAT "%6.1" /end MEASUREMENT
/begin MEASUREMENT Zw_grund2 "Grundzündwinkel2 GDI" SWORD _CNV_R_R_Def_zw_sw__599_CM 1 100. -50. 60. DISPLAY_IDENTIFIER ZW_GRUND2 ECU_ADDRESS 0xd0006bc4 FORMAT "%6.1" /end MEASUREMENT
/begin MEASUREMENT Zw_grund_vk "Grundzündwinkel vor Korrektur" SBYTE _CNV_R_R_Def_zw_sb__623_CM 1 100. -64. 63.5 DISPLAY_IDENTIFIER ZW_GRUND_VK ECU_ADDRESS 0xd0006bd5 FORMAT "%4.1" /end MEASUREMENT
/begin MEASUREMENT Zw_opt "Referenzzündwinkel" SWORD _CNV_R_R_Def_zw_sw__599_CM 1 100. -50. 60. DISPLAY_IDENTIFIER ZW_OPT ECU_ADDRESS 0xd0006b98 FORMAT "%6.1" /end MEASUREMENT
/begin MEASUREMENT Zw_opt1 "Referenzzündwinkel Bank 1" SWORD _CNV_R_R_Def_zw_sw__599_CM 1 100. -50. 60. DISPLAY_IDENTIFIER ZW_OPT1 ECU_ADDRESS 0xd0006b9e FORMAT "%6.1" /end MEASUREMENT
/begin MEASUREMENT Zw_opt2 "Referenzzündwinkel Bank 2" SWORD _CNV_R_R_Def_zw_sw__599_CM 1 100. -50. 60. DISPLAY_IDENTIFIER ZW_OPT2 ECU_ADDRESS 0xd0006ba0 FORMAT "%6.1" /end MEASUREMENT
/begin MEASUREMENT Zw_opt_kh "Grundreferenzzündwinkel Katheizen" SBYTE _CNV_R_R_Def_zw_sb__623_CM 1 100. -64. 63.5 DISPLAY_IDENTIFIER ZW_OPT_KH ECU_ADDRESS 0xd0006ba5 FORMAT "%4.1" /end MEASUREMENT
/begin MEASUREMENT Zw_opt_khgd "Grundreferenzzündwinkel Katheizen gedrosselter Betrieb" SBYTE _CNV_R_R_Def_zw_sb__623_CM 1 100. -64. 63.5 DISPLAY_IDENTIFIER ZW_OPT_KHGD ECU_ADDRESS 0xd0006ba7 FORMAT "%4.1" /end MEASUREMENT
/begin MEASUREMENT Zw_opt_khkgd "Grundreferenzzündwinkel bei Katheizen kalte Teillast gedrosselter Betrieb" SBYTE _CNV_R_R_Def_zw_sb__623_CM 1 100. -64. 63.5 DISPLAY_IDENTIFIER ZW_OPT_KHKGD ECU_ADDRESS 0xd0006baf FORMAT "%4.1" /end MEASUREMENT
/begin MEASUREMENT Zw_opt_khkllgd "Grundreferenzzündwinkel bei Katheizen kalter Leerlauf gedrosselter Betrieb" SBYTE _CNV_R_R_Def_zw_sb__623_CM 1 100. -64. 63.5 DISPLAY_IDENTIFIER ZW_OPT_KHKLLGD ECU_ADDRESS 0xd0006bad FORMAT "%4.1" /end MEASUREMENT
/begin MEASUREMENT Zw_opt_khkllvt "Grundreferenzzündwinkel bei Katheizen kalter Leerlauf VVT Betrieb" SBYTE _CNV_R_R_Def_zw_sb__623_CM 1 100. -64. 63.5 DISPLAY_IDENTIFIER ZW_OPT_KHKLLVT ECU_ADDRESS 0xd0006ba9 FORMAT "%4.1" /end MEASUREMENT
/begin MEASUREMENT Zw_opt_khkvt "Grundreferenzzündwinkel bei Katheizen kalte Teillast VVT Betrieb" SBYTE _CNV_R_R_Def_zw_sb__623_CM 1 100. -64. 63.5 DISPLAY_IDENTIFIER ZW_OPT_KHKVT ECU_ADDRESS 0xd0006bab FORMAT "%4.1" /end MEASUREMENT
/begin MEASUREMENT Zw_opt_khvt "Grundreferenzzündwinkel Katheizen VVT Betrieb" SBYTE _CNV_R_R_Def_zw_sb__623_CM 1 100. -64. 63.5 DISPLAY_IDENTIFIER ZW_OPT_KHVT ECU_ADDRESS 0xd0006ba6 FORMAT "%4.1" /end MEASUREMENT
/begin MEASUREMENT Zw_opt_khwgd "Grundreferenzzündwinkel bei Katheizen warme Teillast gedrosselter  Betrieb" SBYTE _CNV_R_R_Def_zw_sb__623_CM 1 100. -64. 63.5 DISPLAY_IDENTIFIER ZW_OPT_KHWGD ECU_ADDRESS 0xd0006bb0 FORMAT "%4.1" /end MEASUREMENT
/begin MEASUREMENT Zw_opt_khwllgd "Grundreferenzzündwinkel bei Katheizen warmer Leerlauf gedrosselter Betrieb" SBYTE _CNV_R_R_Def_zw_sb__623_CM 1 100. -64. 63.5 DISPLAY_IDENTIFIER ZW_OPT_KHWLLGD ECU_ADDRESS 0xd0006bae FORMAT "%4.1" /end MEASUREMENT
/begin MEASUREMENT Zw_opt_khwllvt "Grundreferenzzündwinkel bei Katheizen warmer Leerlauf VVT Betrieb" SBYTE _CNV_R_R_Def_zw_sb__623_CM 1 100. -64. 63.5 DISPLAY_IDENTIFIER ZW_OPT_KHWLLVT ECU_ADDRESS 0xd0006baa FORMAT "%4.1" /end MEASUREMENT
/begin MEASUREMENT Zw_opt_khwvt "Grundreferenzzündwinkel bei Katheizen warme Teillast VVT Betrieb" SBYTE _CNV_R_R_Def_zw_sb__623_CM 1 100. -64. 63.5 DISPLAY_IDENTIFIER ZW_OPT_KHWVT ECU_ADDRESS 0xd0006bac FORMAT "%4.1" /end MEASUREMENT
/begin MEASUREMENT Zw_opt_n "Grundreferenzzündwinkel nach Korrektur" SBYTE _CNV_R_R_Def_zw_sb__623_CM 1 100. -64. 63.5 DISPLAY_IDENTIFIER ZW_OPT_N ECU_ADDRESS 0xd0006ba8 FORMAT "%4.1" /end MEASUREMENT
/begin MEASUREMENT Zw_opt_nvk "Grundreferenzzündwinkel vor Korrektur" SBYTE _CNV_R_R_Def_zw_sb__623_CM 1 100. -64. 63.5 DISPLAY_IDENTIFIER ZW_OPT_NVK ECU_ADDRESS 0xd0006ba2 FORMAT "%4.1" /end MEASUREMENT
/begin MEASUREMENT Zw_opt_nvkgd "Grundreferenzzündwinkel vor Korrektur GD" SBYTE _CNV_R_R_Def_zw_sb__623_CM 1 100. -64. 63.5 DISPLAY_IDENTIFIER ZW_OPT_NVKGD ECU_ADDRESS 0xd0006ba4 FORMAT "%4.1" /end MEASUREMENT
/begin MEASUREMENT Zw_opt_nvkvt "Grundreferenzzündwinkel vor Korrektur VVT" SBYTE _CNV_R_R_Def_zw_sb__623_CM 1 100. -64. 63.5 DISPLAY_IDENTIFIER ZW_OPT_NVKVT ECU_ADDRESS 0xd0006ba3 FORMAT "%4.1" /end MEASUREMENT
/begin MEASUREMENT Zw_timer "Timer für Rf_sol-Modelliewrung (Grundzündwinkel)" UWORD _CNV_R_R_Def_dez_sl_575_CM 1 100. 0. 65535. DISPLAY_IDENTIFIER ZW_TIMER ECU_ADDRESS 0xd0006c04 FORMAT "%5.0" /end MEASUREMENT
/begin MEASUREMENT Zw_vt98 "Grundzündwinkel VVT ROZ 98" SBYTE _CNV_R_R_Def_zw_sb__623_CM 1 100. -64. 63.5 DISPLAY_IDENTIFIER ZW_VT98 ECU_ADDRESS 0xd0006bcf FORMAT "%4.1" /end MEASUREMENT
/begin MEASUREMENT Zwdyn "dyn. Grundzündwinkel" SBYTE _CNV_R_R_Def_zw_sb__623_CM 1 100. -64. 63.5 DISPLAY_IDENTIFIER ZWDYN ECU_ADDRESS 0xd0006bce FORMAT "%4.1" /end MEASUREMENT
/begin MEASUREMENT Zwdyn_gd "dyn. Grundzündwinkel gedrosselt" SBYTE _CNV_R_R_Def_zw_sb__623_CM 1 100. -64. 63.5 DISPLAY_IDENTIFIER ZWDYN_GD ECU_ADDRESS 0xd0006bcc FORMAT "%4.1" /end MEASUREMENT
/begin MEASUREMENT Zwdyn_nl "dyn. Grundzündwinkel Notlauf" SBYTE _CNV_R_R_Def_zw_sb__623_CM 1 100. -64. 63.5 DISPLAY_IDENTIFIER ZWDYN_NL ECU_ADDRESS 0xd0006bcd FORMAT "%4.1" /end MEASUREMENT
/begin MEASUREMENT Zwdyn_vt "dyn. Grundzündwinkel VVT-Betrieb" SBYTE _CNV_R_R_Def_zw_sb__623_CM 1 100. -64. 63.5 DISPLAY_IDENTIFIER ZWDYN_VT ECU_ADDRESS 0xd0006bcb FORMAT "%4.1" /end MEASUREMENT
/begin MEASUREMENT Zwstat "stat. Grundzündwinkel" SBYTE _CNV_R_R_Def_zw_sb__623_CM 1 100. -64. 63.5 DISPLAY_IDENTIFIER ZWSTAT ECU_ADDRESS 0xd0006bd3 FORMAT "%4.1" /end MEASUREMENT
/begin MEASUREMENT Zwstat_gd "stat. Grundzündwinkel gedrosselt" SBYTE _CNV_R_R_Def_zw_sb__623_CM 1 100. -64. 63.5 DISPLAY_IDENTIFIER ZWSTAT_GD ECU_ADDRESS 0xd0006bd1 FORMAT "%4.1" /end MEASUREMENT
/begin MEASUREMENT Zwstat_nl "stat. Grundzündwinkel Notlauf" SBYTE _CNV_R_R_Def_zw_sb__623_CM 1 100. -64. 63.5 DISPLAY_IDENTIFIER ZWSTAT_NL ECU_ADDRESS 0xd0006bd2 FORMAT "%4.1" /end MEASUREMENT
/begin MEASUREMENT Zwstat_vt "stat. Grundzündwinkel VVT-Betrieb" SBYTE _CNV_R_R_Def_zw_sb__623_CM 1 100. -64. 63.5 DISPLAY_IDENTIFIER ZWSTAT_VT ECU_ADDRESS 0xd0006bd0 FORMAT "%4.1" /end MEASUREMENT
/begin CHARACTERISTIC CW_ZWDYN "Codewort für Grundzündwinkeldynamik" VALUE 0xa100f6c4 _REC_VAL_20_u1 99.45 _CNV_R_R_Def_dez_sl_575_CM 0. 255. FORMAT "%3.0" /end CHARACTERISTIC
/begin CHARACTERISTIC KF_DZW_DYN "Grundkennfeld Dynamikkorrektur" MAP 0xa1010510 _REC_MAP_52_UBYTE_s1_s2_s2 99.45 _CNV_R_R_Def_zw_sb__623_CM -64. 63.5 FORMAT "%4.1"
 /begin AXIS_DESCR STD_AXIS Nkw _CNV_R_R_Def_n_sw_q_612_CM 4 -32768. 32767. FORMAT "%5.0" /end AXIS_DESCR
 /begin AXIS_DESCR STD_AXIS Rf_zwv _CNV_R_R_Def_rf_sw__616_CM 4 -327.68 327.67 FORMAT "%7.4" /end AXIS_DESCR
/end CHARACTERISTIC
/begin CHARACTERISTIC KF_DZW_DYNN "Grundkennfeld Dynamikkorrektur" MAP 0xa1010598 _REC_MAP_52_UBYTE_s1_s2_s2 99.45 _CNV_R_R_Def_zw_sb__623_CM -64. 63.5 FORMAT "%4.1"
 /begin AXIS_DESCR STD_AXIS Nkw _CNV_R_R_Def_n_sw_q_612_CM 4 -32768. 32767. FORMAT "%5.0" /end AXIS_DESCR
 /begin AXIS_DESCR STD_AXIS Rf_zwv _CNV_R_R_Def_rf_sw__616_CM 4 -327.68 327.67 FORMAT "%7.4" /end AXIS_DESCR
/end CHARACTERISTIC
/begin CHARACTERISTIC KF_DZW_HZ "Deltazündwinkel für Heizleistungssteigerung" MAP 0xa100f844 _REC_MAP_52_UBYTE_s1_s2_s2 99.45 _CNV_R_R_Def_zw_sb__623_CM -64. 63.5 FORMAT "%4.1"
 /begin AXIS_DESCR STD_AXIS Nkw _CNV_R_R_Def_n_sw_q_612_CM 5 -32768. 32767. FORMAT "%5.0" /end AXIS_DESCR
 /begin AXIS_DESCR STD_AXIS Rfkr _CNV_R_R_Def_rf_sw__616_CM 5 -327.68 327.67 FORMAT "%7.4" /end AXIS_DESCR
/end CHARACTERISTIC
/begin CHARACTERISTIC KF_DZW_KR_GD "Kennfeld Deltazündwinkel für KR Betrieb gedrosselter Betrieb" MAP 0xa101038c _REC_MAP_52_UBYTE_s1_s2_s2 99.45 _CNV_R_R_Def_zw_sb__623_CM -64. 63.5 FORMAT "%4.1"
 /begin AXIS_DESCR STD_AXIS Nkw _CNV_R_R_Def_n_sw_q_612_CM 8 -32768. 32767. FORMAT "%5.0" /end AXIS_DESCR
 /begin AXIS_DESCR STD_AXIS Rfkr _CNV_R_R_Def_rf_sw__616_CM 6 -327.68 327.67 FORMAT "%7.4" /end AXIS_DESCR
/end CHARACTERISTIC
/begin CHARACTERISTIC KF_DZW_KR_VT "Kennfeld Deltazündwinkel für KR Betrieb VVT Betrieb" MAP 0xa10103dc _REC_MAP_52_UBYTE_s1_s2_s2 99.45 _CNV_R_R_Def_zw_sb__623_CM -64. 63.5 FORMAT "%4.1"
 /begin AXIS_DESCR STD_AXIS Nkw _CNV_R_R_Def_n_sw_q_612_CM 8 -32768. 32767. FORMAT "%5.0" /end AXIS_DESCR
 /begin AXIS_DESCR STD_AXIS Rfkr _CNV_R_R_Def_rf_sw__616_CM 6 -327.68 327.67 FORMAT "%7.4" /end AXIS_DESCR
/end CHARACTERISTIC
/begin CHARACTERISTIC KF_DZW_TD98 "Kennfeld Grundzündwinkelkorrektur teilgedrosselt ROZ 98" MAP 0xa100fd1c _REC_MAP_52_UBYTE_s1_s2_s2 99.45 _CNV_R_R_Def_zw_sb__623_CM -64. 63.5 FORMAT "%4.1"
 /begin AXIS_DESCR STD_AXIS Minhubsw _CNV_R_R_Def_hub_uw_605_CM 8 -32.768 32.767 /end AXIS_DESCR
 /begin AXIS_DESCR STD_AXIS Dpssolfilt _CNV_R_R_Def_p_sw_q_578_CM 8 -1280. 1279.9609 FORMAT "%5.2" /end AXIS_DESCR
/end CHARACTERISTIC
/begin CHARACTERISTIC KF_DZW_VNS_VT "Kennfeld Deltazündwinkel bei Vanoskorr. im VVT Betrieb" MAP 0xa10102ec _REC_MAP_52_UBYTE_s1_s2_s2 99.45 _CNV_R_R_Def_zw_sb__623_CM -64. 63.5 FORMAT "%4.1"
 /begin AXIS_DESCR STD_AXIS Nkw _CNV_R_R_Def_n_sw_q_612_CM 8 -32768. 32767. FORMAT "%5.0" /end AXIS_DESCR
 /begin AXIS_DESCR STD_AXIS Rfkr _CNV_R_R_Def_rf_sw__616_CM 6 -327.68 327.67 FORMAT "%7.4" /end AXIS_DESCR
/end CHARACTERISTIC
/begin CHARACTERISTIC KF_DZW_WL_GD "Kennfeld Deltazündwinkel bei Warmlauf gedrosselter Betrieb" MAP 0xa101033c _REC_MAP_52_UBYTE_s1_s2_s2 99.45 _CNV_R_R_Def_zw_sb__623_CM -64. 63.5 FORMAT "%4.1"
 /begin AXIS_DESCR STD_AXIS Nkw _CNV_R_R_Def_n_sw_q_612_CM 8 -32768. 32767. FORMAT "%5.0" /end AXIS_DESCR
 /begin AXIS_DESCR STD_AXIS Rfkr _CNV_R_R_Def_rf_sw__616_CM 6 -327.68 327.67 FORMAT "%7.4" /end AXIS_DESCR
/end CHARACTERISTIC
/begin CHARACTERISTIC KF_DZW_WL_VT "Kennfeld Deltazündwinkel bei Warmlauf VVT Betrieb" MAP 0xa101029c _REC_MAP_52_UBYTE_s1_s2_s2 99.45 _CNV_R_R_Def_zw_sb__623_CM -64. 63.5 FORMAT "%4.1"
 /begin AXIS_DESCR STD_AXIS Nkw _CNV_R_R_Def_n_sw_q_612_CM 8 -32768. 32767. FORMAT "%5.0" /end AXIS_DESCR
 /begin AXIS_DESCR STD_AXIS Rfkr _CNV_R_R_Def_rf_sw__616_CM 6 -327.68 327.67 FORMAT "%7.4" /end AXIS_DESCR
/end CHARACTERISTIC
/begin CHARACTERISTIC KF_FDZW_DYN1 "Korrekturkennfeld für Dynamikkorrektur" MAP 0xa1010534 _REC_MAP_52_u1_s2_s2 0.996 _CNV_R_R_Def_f_ub_b_573_CM 0. 0.996
 /begin AXIS_DESCR STD_AXIS Tans _CNV_R_R_Def_t_sw_q_618_CM 4 -3276.8 3276.7 FORMAT "%4.1" /end AXIS_DESCR
 /begin AXIS_DESCR STD_AXIS Dzw_annm _CNV_R_R_Def_zw_sw__599_CM 4 -50. 60. FORMAT "%4.1" /end AXIS_DESCR
/end CHARACTERISTIC
/begin CHARACTERISTIC KF_FDZW_DYN2 "Korrekturkennfeld für Dynamikkorrektur" MAP 0xa1010558 _REC_MAP_52_u1_u2_u2 0.996 _CNV_R_R_Def_f_ub_b_573_CM 0. 0.996
 /begin AXIS_DESCR STD_AXIS V _CNV_R_R_Def_v_uw_q_723_CM 6 0. 360. FORMAT "%5.0" /end AXIS_DESCR
 /begin AXIS_DESCR STD_AXIS NO_INPUT_QUANTITY _CNV_R_R_Def_dez_sl_575_CM 6 0. 65535. FORMAT "%5.0" /end AXIS_DESCR
/end CHARACTERISTIC
/begin CHARACTERISTIC KF_FDZW_DYNN1 "Korrekturkennfeld für Dynamikkorrektur" MAP 0xa10105bc _REC_MAP_52_u1_s2_s2 0.996 _CNV_R_R_Def_f_ub_b_573_CM 0. 0.996
 /begin AXIS_DESCR STD_AXIS Tans _CNV_R_R_Def_t_sw_q_618_CM 4 -3276.8 3276.7 FORMAT "%4.1" /end AXIS_DESCR
 /begin AXIS_DESCR STD_AXIS Dzw_annm _CNV_R_R_Def_zw_sw__599_CM 4 -50. 60. FORMAT "%4.1" /end AXIS_DESCR
/end CHARACTERISTIC
/begin CHARACTERISTIC KF_FDZW_DYNN2 "Korrekturkennfeld für Dynamikkorrektur" MAP 0xa10105e0 _REC_MAP_52_u1_u2_u2 0.996 _CNV_R_R_Def_f_ub_b_573_CM 0. 0.996
 /begin AXIS_DESCR STD_AXIS V _CNV_R_R_Def_v_uw_q_723_CM 6 0. 360. FORMAT "%5.0" /end AXIS_DESCR
 /begin AXIS_DESCR STD_AXIS NO_INPUT_QUANTITY _CNV_R_R_Def_dez_sl_575_CM 6 0. 65535. FORMAT "%5.0" /end AXIS_DESCR
/end CHARACTERISTIC
/begin CHARACTERISTIC KF_FDZW_T "Kennfeld Faktor Ansaugluftkorrektur 1 Grundzündwinkel" MAP 0xa10104f4 _REC_MAP_52_u1_s2_s2 1.9921 _CNV_R_R_Def_f_ub_b_625_CM 0. 1.9921
 /begin AXIS_DESCR STD_AXIS Nkw _CNV_R_R_Def_n_sw_q_612_CM 4 -32768. 32767. FORMAT "%5.0" /end AXIS_DESCR
 /begin AXIS_DESCR STD_AXIS Tans _CNV_R_R_Def_t_sw_q_618_CM 3 -3276.8 3276.7 FORMAT "%4.1" /end AXIS_DESCR
/end CHARACTERISTIC
/begin CHARACTERISTIC KF_FDZW_VNS_VT "Kennfeld zur Variablen Verzögerung von Rk_1 und Rk_2" MAP 0xa100f874 _REC_MAP_52_u1_s2_s2 0.996 _CNV_R_R_Def_f_ub_b_573_CM 0. 0.996
 /begin AXIS_DESCR STD_AXIS Dvsa_ramp _CNV_R_R_Def_spr_sw_583_CM 8 -3276.8 3276.7 FORMAT "%5.2" /end AXIS_DESCR
 /begin AXIS_DESCR STD_AXIS Dvse_ramp _CNV_R_R_Def_spr_sw_583_CM 8 -3276.8 3276.7 FORMAT "%5.2" /end AXIS_DESCR
/end CHARACTERISTIC
/begin CHARACTERISTIC KF_FZWOKH_LAMKOR "Korrekturfaktor Lambdakorrektur Referenzzündwinkel bei Katheizen" MAP 0xa100f210 _REC_MAP_52_UBYTE_s2_s2_s2 3.9999 _CNV_R_R_Def_f_sw_b_608_CM -2. 1.9999 FORMAT "%14.5"
 /begin AXIS_DESCR STD_AXIS Nkw _CNV_R_R_Def_n_sw_q_612_CM 4 -32768. 32767. FORMAT "%5.0" /end AXIS_DESCR
 /begin AXIS_DESCR STD_AXIS Rf_zwv _CNV_R_R_Def_rf_sw__616_CM 4 -327.68 327.67 FORMAT "%7.4" /end AXIS_DESCR
/end CHARACTERISTIC
/begin CHARACTERISTIC KF_FZWO_LAMKOR "Korrekturfaktor Lambdakorrektur Referenzzündwinkel" MAP 0xa100f1dc _REC_MAP_52_UBYTE_s2_s2_s2 3.9999 _CNV_R_R_Def_f_sw_b_608_CM -2. 1.9999 FORMAT "%14.5"
 /begin AXIS_DESCR STD_AXIS Nkw _CNV_R_R_Def_n_sw_q_612_CM 4 -32768. 32767. FORMAT "%5.0" /end AXIS_DESCR
 /begin AXIS_DESCR STD_AXIS Rf_zwv _CNV_R_R_Def_rf_sw__616_CM 4 -327.68 327.67 FORMAT "%7.4" /end AXIS_DESCR
/end CHARACTERISTIC
/begin CHARACTERISTIC KF_FZW_KR_GD "Kennfeld Temperaturkorrektur Grundzündwinkel" MAP 0xa1010204 _REC_MAP_52_UBYTE_u2_s2_s2 1.9999 _CNV_R_R_Def_f_uw_b_579_CM 0. 1.9999 FORMAT "%14.5"
 /begin AXIS_DESCR STD_AXIS Tmot _CNV_R_R_Def_t_sw_q_620_CM 6 -327.68 327.67 FORMAT "%5.2" /end AXIS_DESCR
 /begin AXIS_DESCR STD_AXIS Tans _CNV_R_R_Def_t_sw_q_618_CM 6 -3276.8 3276.7 FORMAT "%4.1" /end AXIS_DESCR
/end CHARACTERISTIC
/begin CHARACTERISTIC KF_FZW_KR_VT "Kennfeld Temperaturkorrektur Grundzündwinkel" MAP 0xa10101a0 _REC_MAP_52_UBYTE_u2_s2_s2 1.9999 _CNV_R_R_Def_f_uw_b_579_CM 0. 1.9999 FORMAT "%14.5"
 /begin AXIS_DESCR STD_AXIS Tmot _CNV_R_R_Def_t_sw_q_620_CM 6 -327.68 327.67 FORMAT "%5.2" /end AXIS_DESCR
 /begin AXIS_DESCR STD_AXIS Tans _CNV_R_R_Def_t_sw_q_618_CM 6 -3276.8 3276.7 FORMAT "%4.1" /end AXIS_DESCR
/end CHARACTERISTIC
/begin CHARACTERISTIC KF_FZW_LAMKOR "Kennfeld Temperaturkorrektur Grundzündwinkel" MAP 0xa1010268 _REC_MAP_52_UBYTE_s2_s2_s2 3.9999 _CNV_R_R_Def_f_sw_b_608_CM -2. 1.9999 FORMAT "%14.5"
 /begin AXIS_DESCR STD_AXIS Nkw _CNV_R_R_Def_n_sw_q_612_CM 4 -32768. 32767. FORMAT "%5.0" /end AXIS_DESCR
 /begin AXIS_DESCR STD_AXIS Rf_zwv _CNV_R_R_Def_rf_sw__616_CM 4 -327.68 327.67 FORMAT "%7.4" /end AXIS_DESCR
/end CHARACTERISTIC
/begin CHARACTERISTIC KF_FZW_WL_GD "Kennfeld Grundzündwinkelkorrektur nach Start" MAP 0xa1010490 _REC_MAP_52_UBYTE_s2_u2_s2 3.9999 _CNV_R_R_Def_f_sw_b_608_CM -2. 1.9999 FORMAT "%14.5"
 /begin AXIS_DESCR STD_AXIS Zr_seg_nstart _CNV_R_R_Def_dez_sl_575_CM 6 0. 65535. FORMAT "%5.0" /end AXIS_DESCR
 /begin AXIS_DESCR STD_AXIS Tmot _CNV_R_R_Def_t_sw_q_620_CM 6 -327.68 327.67 FORMAT "%5.2" /end AXIS_DESCR
/end CHARACTERISTIC
/begin CHARACTERISTIC KF_FZW_WL_VT "Kennfeld Grundzündwinkelkorrektur nach Start" MAP 0xa101042c _REC_MAP_52_UBYTE_s2_u2_s2 3.9999 _CNV_R_R_Def_f_sw_b_608_CM -2. 1.9999 FORMAT "%14.5"
 /begin AXIS_DESCR STD_AXIS Zr_seg_nstart _CNV_R_R_Def_dez_sl_575_CM 6 0. 65535. FORMAT "%5.0" /end AXIS_DESCR
 /begin AXIS_DESCR STD_AXIS Tmot _CNV_R_R_Def_t_sw_q_620_CM 6 -327.68 327.67 FORMAT "%5.2" /end AXIS_DESCR
/end CHARACTERISTIC
/begin CHARACTERISTIC KF_TDRFSOLKR "Kennfeld Verzögerung Rf_soll" MAP 0xa100f9c4 _REC_MAP_52_u1_u2_s2 15. _CNV_R_R_Def_dez_sl_575_CM 0. 15. FORMAT "%3.0" /begin AXIS_DESCR STD_AXIS Minhub _CNV_R_R_Def_hub_uw_605_CM 6 0. 65.535 /end AXIS_DESCR
 /begin AXIS_DESCR STD_AXIS Dpssolfilt _CNV_R_R_Def_p_sw_q_578_CM 6 -1280. 1279.9609 FORMAT "%5.2" /end AXIS_DESCR
/end CHARACTERISTIC
/begin CHARACTERISTIC KF_TDRFZW "Kennfeld Verzögerung Rf_soll" MAP 0xa100f9a0 _REC_MAP_52_u1_s2_s2 8. _CNV_R_R_Def_dez_sl_575_CM 0. 8. FORMAT "%3.0"
 /begin AXIS_DESCR STD_AXIS Nkw _CNV_R_R_Def_n_sw_q_612_CM 4 -32768. 32767. FORMAT "%5.0" /end AXIS_DESCR
 /begin AXIS_DESCR STD_AXIS Rf _CNV_R_R_Def_rf_sw__616_CM 4 -327.68 327.67 FORMAT "%7.4" /end AXIS_DESCR
/end CHARACTERISTIC
/begin CHARACTERISTIC KF_ZKRFSOLF "Kennfeld Zeitkonstante Rf_soll-Filter fallen" MAP 0xa100f8d8 _REC_MAP_52_UBYTE_u2_u2_s2 655.35 _CNV_R_R_Def_zk10ms_709_CM 1.e-002 655.36 FORMAT "%7.4" /begin AXIS_DESCR STD_AXIS Minhub _CNV_R_R_Def_hub_uw_605_CM 6 0. 65.535 /end AXIS_DESCR
 /begin AXIS_DESCR STD_AXIS Dpssolfilt _CNV_R_R_Def_p_sw_q_578_CM 6 -1280. 1279.9609 FORMAT "%5.2" /end AXIS_DESCR
/end CHARACTERISTIC
/begin CHARACTERISTIC KF_ZKRFSOLS "Kennfeld Zeitkonstante Rf_soll-Filter 2 steigen" MAP 0xa100f93c _REC_MAP_52_UBYTE_u2_u2_s2 655.35 _CNV_R_R_Def_zk10ms_709_CM 1.e-002 655.36 FORMAT "%7.4" /begin AXIS_DESCR STD_AXIS Minhub _CNV_R_R_Def_hub_uw_605_CM 6 0. 65.535 /end AXIS_DESCR
 /begin AXIS_DESCR STD_AXIS Dpssolfilt _CNV_R_R_Def_p_sw_q_578_CM 6 -1280. 1279.9609 FORMAT "%5.2" /end AXIS_DESCR
/end CHARACTERISTIC
/begin CHARACTERISTIC KF_ZWOPT_GD "Kennfeld Grundrefererenzzündwinkel GD" MAP 0xa100f050 _REC_MAP_52_UBYTE_s1_s2_s2 99.45 _CNV_R_R_Def_zw_sb__623_CM -64. 63.5 FORMAT "%4.1"
 /begin AXIS_DESCR STD_AXIS Nkw _CNV_R_R_Def_n_sw_q_612_CM 20 -32768. 32767. FORMAT "%5.0" /end AXIS_DESCR
 /begin AXIS_DESCR STD_AXIS Rf_zwv _CNV_R_R_Def_rf_sw__616_CM 16 -327.68 327.67 FORMAT "%7.4" /end AXIS_DESCR
/end CHARACTERISTIC
/begin CHARACTERISTIC KF_ZWOPT_VT "Kennfeld Grundrefererenzzündwinkel VVT" MAP 0xa100ed38 _REC_MAP_52_UBYTE_s1_s2_s2 99.45 _CNV_R_R_Def_zw_sb__623_CM -64. 63.5 FORMAT "%4.1"
 /begin AXIS_DESCR STD_AXIS Nkw _CNV_R_R_Def_n_sw_q_612_CM 20 -32768. 32767. FORMAT "%5.0" /end AXIS_DESCR
 /begin AXIS_DESCR STD_AXIS Rf_zwv _CNV_R_R_Def_rf_sw__616_CM 16 -327.68 327.67 FORMAT "%7.4" /end AXIS_DESCR
/end CHARACTERISTIC
/begin CHARACTERISTIC KF_ZWOPT_VTS "Kennfeld Grundreferenzzündwinkel VVT sicher" MAP 0xa100eec4 _REC_MAP_52_UBYTE_s1_s2_s2 99.45 _CNV_R_R_Def_zw_sb__623_CM -64. 63.5 FORMAT "%4.1"
 /begin AXIS_DESCR STD_AXIS Nkw _CNV_R_R_Def_n_sw_q_612_CM 20 -32768. 32767. FORMAT "%5.0" /end AXIS_DESCR
 /begin AXIS_DESCR STD_AXIS Rf_zwv _CNV_R_R_Def_rf_sw__616_CM 16 -327.68 327.67 FORMAT "%7.4" /end AXIS_DESCR
/end CHARACTERISTIC
/begin CHARACTERISTIC KF_ZWO_KHKGD "Kennfeld Grundrefererenzzündwinkel bei Katheizen gedrosselter Betrieb" MAP 0xa100f484 _REC_MAP_52_UBYTE_s1_s2_s2 99.45 _CNV_R_R_Def_zw_sb__623_CM -64. 63.5 FORMAT "%4.1"
 /begin AXIS_DESCR STD_AXIS Nkw _CNV_R_R_Def_n_sw_q_612_CM 12 -32768. 32767. FORMAT "%5.0" /end AXIS_DESCR
 /begin AXIS_DESCR STD_AXIS Rf_zwv _CNV_R_R_Def_rf_sw__616_CM 10 -327.68 327.67 FORMAT "%7.4" /end AXIS_DESCR
/end CHARACTERISTIC
/begin CHARACTERISTIC KF_ZWO_KHKLLGD "Kennfeld Grundrefererenzzündwinkel bei Katheizen Leerlauf gedrosselter Betrieb" MAP 0xa100f5d4 _REC_MAP_52_UBYTE_s1_s2_s2 99.45 _CNV_R_R_Def_zw_sb__623_CM -64. 63.5 FORMAT "%4.1"
 /begin AXIS_DESCR STD_AXIS Nkw _CNV_R_R_Def_n_sw_q_612_CM 8 -32768. 32767. FORMAT "%5.0" /end AXIS_DESCR
 /begin AXIS_DESCR STD_AXIS Rf_zwv _CNV_R_R_Def_rf_sw__616_CM 10 -327.68 327.67 FORMAT "%7.4" /end AXIS_DESCR
/end CHARACTERISTIC
/begin CHARACTERISTIC KF_ZWO_KHKLLVT "Kennfeld Grundrefererenzzündwinkel bei Katheizen Leerlauf VVT Betrieb" MAP 0xa100f394 _REC_MAP_52_UBYTE_s1_s2_s2 99.45 _CNV_R_R_Def_zw_sb__623_CM -64. 63.5 FORMAT "%4.1"
 /begin AXIS_DESCR STD_AXIS Nkw _CNV_R_R_Def_n_sw_q_612_CM 8 -32768. 32767. FORMAT "%5.0" /end AXIS_DESCR
 /begin AXIS_DESCR STD_AXIS Rf_zwv _CNV_R_R_Def_rf_sw__616_CM 10 -327.68 327.67 FORMAT "%7.4" /end AXIS_DESCR
/end CHARACTERISTIC
/begin CHARACTERISTIC KF_ZWO_KHKVT "Kennfeld Grundrefererenzzündwinkel bei Katheizen VVT Betrieb" MAP 0xa100f244 _REC_MAP_52_UBYTE_s1_s2_s2 99.45 _CNV_R_R_Def_zw_sb__623_CM -64. 63.5 FORMAT "%4.1"
 /begin AXIS_DESCR STD_AXIS Nkw _CNV_R_R_Def_n_sw_q_612_CM 12 -32768. 32767. FORMAT "%5.0" /end AXIS_DESCR
 /begin AXIS_DESCR STD_AXIS Rf_zwv _CNV_R_R_Def_rf_sw__616_CM 10 -327.68 327.67 FORMAT "%7.4" /end AXIS_DESCR
/end CHARACTERISTIC
/begin CHARACTERISTIC KF_ZWO_KHWGD "Kennfeld Grundrefererenzzündwinkel bei Katheizen Warmlauf gedrosselter Betrieb" MAP 0xa100f52c _REC_MAP_52_UBYTE_s1_s2_s2 99.45 _CNV_R_R_Def_zw_sb__623_CM -64. 63.5 FORMAT "%4.1"
 /begin AXIS_DESCR STD_AXIS Nkw _CNV_R_R_Def_n_sw_q_612_CM 12 -32768. 32767. FORMAT "%5.0" /end AXIS_DESCR
 /begin AXIS_DESCR STD_AXIS Rf_zwv _CNV_R_R_Def_rf_sw__616_CM 10 -327.68 327.67 FORMAT "%7.4" /end AXIS_DESCR
/end CHARACTERISTIC
/begin CHARACTERISTIC KF_ZWO_KHWLLGD "Kennfeld Grundrefererenzzündwinkel bei Katheizen Warmlauf gedrosselter Betrieb Leerlauf" MAP 0xa100f64c _REC_MAP_52_UBYTE_s1_s2_s2 99.45 _CNV_R_R_Def_zw_sb__623_CM -64. 63.5 FORMAT "%4.1"
 /begin AXIS_DESCR STD_AXIS Nkw _CNV_R_R_Def_n_sw_q_612_CM 8 -32768. 32767. FORMAT "%5.0" /end AXIS_DESCR
 /begin AXIS_DESCR STD_AXIS Rf_zwv _CNV_R_R_Def_rf_sw__616_CM 10 -327.68 327.67 FORMAT "%7.4" /end AXIS_DESCR
/end CHARACTERISTIC
/begin CHARACTERISTIC KF_ZWO_KHWLLVT "Kennfeld Grundrefererenzzündwinkel bei Katheizen Warmlauf Leerlauf VVT Betrieb" MAP 0xa100f40c _REC_MAP_52_UBYTE_s1_s2_s2 99.45 _CNV_R_R_Def_zw_sb__623_CM -64. 63.5 FORMAT "%4.1"
 /begin AXIS_DESCR STD_AXIS Nkw _CNV_R_R_Def_n_sw_q_612_CM 8 -32768. 32767. FORMAT "%5.0" /end AXIS_DESCR
 /begin AXIS_DESCR STD_AXIS Rf_zwv _CNV_R_R_Def_rf_sw__616_CM 10 -327.68 327.67 FORMAT "%7.4" /end AXIS_DESCR
/end CHARACTERISTIC
/begin CHARACTERISTIC KF_ZWO_KHWVT "Kennfeld Grundrefererenzzündwinkel bei Katheizen Warmlauf VVT Betrieb" MAP 0xa100f2ec _REC_MAP_52_UBYTE_s1_s2_s2 99.45 _CNV_R_R_Def_zw_sb__623_CM -64. 63.5 FORMAT "%4.1"
 /begin AXIS_DESCR STD_AXIS Nkw _CNV_R_R_Def_n_sw_q_612_CM 12 -32768. 32767. FORMAT "%5.0" /end AXIS_DESCR
 /begin AXIS_DESCR STD_AXIS Rf_zwv _CNV_R_R_Def_rf_sw__616_CM 10 -327.68 327.67 FORMAT "%7.4" /end AXIS_DESCR
/end CHARACTERISTIC
/begin CHARACTERISTIC KF_ZW_GD "Kennfeld Grundzündwinkel gedrosselt" MAP 0xa100fd80 _REC_MAP_52_UBYTE_s1_s2_s2 99.45 _CNV_R_R_Def_zw_sb__623_CM -64. 63.5 FORMAT "%4.1"
 /begin AXIS_DESCR STD_AXIS Nkw _CNV_R_R_Def_n_sw_q_612_CM 20 -32768. 32767. FORMAT "%5.0" /end AXIS_DESCR
 /begin AXIS_DESCR STD_AXIS Rf_zwv _CNV_R_R_Def_rf_sw__616_CM 16 -327.68 327.67 FORMAT "%7.4" /end AXIS_DESCR
/end CHARACTERISTIC
/begin CHARACTERISTIC KF_ZW_GD_VL "Kennfeld Grundzündwinkel gedrosselt Volllast" MAP 0xa101011c _REC_MAP_52_UBYTE_s1_s2_s2 99.45 _CNV_R_R_Def_zw_sb__623_CM -64. 63.5 FORMAT "%4.1"
 /begin AXIS_DESCR STD_AXIS Nkw _CNV_R_R_Def_n_sw_q_612_CM 20 -32768. 32767. FORMAT "%5.0" /end AXIS_DESCR
 /begin AXIS_DESCR STD_AXIS Rf_zwv _CNV_R_R_Def_rf_sw__616_CM 4 -327.68 327.67 FORMAT "%7.4" /end AXIS_DESCR
/end CHARACTERISTIC
/begin CHARACTERISTIC KF_ZW_NL "Kennfeld Grundzündwinkel Notlauf" MAP 0xa100ff0c _REC_MAP_52_UBYTE_s1_s2_s2 99.45 _CNV_R_R_Def_zw_sb__623_CM -64. 63.5 FORMAT "%4.1"
 /begin AXIS_DESCR STD_AXIS Nkw _CNV_R_R_Def_n_sw_q_612_CM 20 -32768. 32767. FORMAT "%5.0" /end AXIS_DESCR
 /begin AXIS_DESCR STD_AXIS Rf_zwv _CNV_R_R_Def_rf_sw__616_CM 16 -327.68 327.67 FORMAT "%7.4" /end AXIS_DESCR
/end CHARACTERISTIC
/begin CHARACTERISTIC KF_ZW_VT98 "Kennfeld Grundzündwinkel VVT ROZ 98" MAP 0xa100fa04 _REC_MAP_52_UBYTE_s1_s2_s2 99.45 _CNV_R_R_Def_zw_sb__623_CM -64. 63.5 FORMAT "%4.1"
 /begin AXIS_DESCR STD_AXIS Nkw _CNV_R_R_Def_n_sw_q_612_CM 20 -32768. 32767. FORMAT "%5.0" /end AXIS_DESCR
 /begin AXIS_DESCR STD_AXIS Rf_zwv _CNV_R_R_Def_rf_sw__616_CM 16 -327.68 327.67 FORMAT "%7.4" /end AXIS_DESCR
/end CHARACTERISTIC
/begin CHARACTERISTIC KF_ZW_VT98S "Kennfeld Grundzündwinkel VVT ROZ 98 sicher" MAP 0xa100fb90 _REC_MAP_52_UBYTE_s1_s2_s2 99.45 _CNV_R_R_Def_zw_sb__623_CM -64. 63.5 FORMAT "%4.1"
 /begin AXIS_DESCR STD_AXIS Nkw _CNV_R_R_Def_n_sw_q_612_CM 20 -32768. 32767. FORMAT "%5.0" /end AXIS_DESCR
 /begin AXIS_DESCR STD_AXIS Rf_zwv _CNV_R_R_Def_rf_sw__616_CM 16 -327.68 327.67 FORMAT "%7.4" /end AXIS_DESCR
/end CHARACTERISTIC
/begin CHARACTERISTIC KF_ZW_VT_VL98 "Kennfeld Grundzündwinkel VVT Volllast ROZ 98" MAP 0xa1010098 _REC_MAP_52_UBYTE_s1_s2_s2 99.45 _CNV_R_R_Def_zw_sb__623_CM -64. 63.5 FORMAT "%4.1"
 /begin AXIS_DESCR STD_AXIS Nkw _CNV_R_R_Def_n_sw_q_612_CM 20 -32768. 32767. FORMAT "%5.0" /end AXIS_DESCR
 /begin AXIS_DESCR STD_AXIS Rf_zwv _CNV_R_R_Def_rf_sw__616_CM 4 -327.68 327.67 FORMAT "%7.4" /end AXIS_DESCR
/end CHARACTERISTIC
/begin CHARACTERISTIC KL_DRFSOL "KL Drfsol-Schwellwert für Triggerung B_zwdyn" CURVE 0xa100f7a8 _REC_CUR_TKL_UW_VV__s2_s2 98.30250000000001 _CNV_R_R_Def_rf_sw__616_CM -327.68 327.67 FORMAT "%7.4"
 /begin AXIS_DESCR STD_AXIS Nkw _CNV_R_R_Def_n_sw_q_612_CM 8 -32768. 32767. FORMAT "%5.0" /end AXIS_DESCR
/end CHARACTERISTIC
/begin CHARACTERISTIC KL_DRFSOLN "KL Drfsol-Schwellwert für Triggerung B_zwdynn" CURVE 0xa100f7cc _REC_CUR_TKL_UW_VV__s2_s2 98.30250000000001 _CNV_R_R_Def_rf_sw__616_CM -327.68 327.67 FORMAT "%7.4"
 /begin AXIS_DESCR STD_AXIS Nkw _CNV_R_R_Def_n_sw_q_612_CM 8 -32768. 32767. FORMAT "%5.0" /end AXIS_DESCR
/end CHARACTERISTIC
/begin CHARACTERISTIC KL_DZWOKH_LAMKOR "Kennlinie Lambdakorrektur Grundreferenzzündwinkel Katheizen" CURVE 0xa100ed1c _REC_CUR_TKL_UW_VV__s1_u2 99.45 _CNV_R_R_Def_zw_sb__623_CM -64. 63.5 FORMAT "%4.1"
 /begin AXIS_DESCR STD_AXIS La_soll _CNV_R_R_Def_f_uw_b_594_CM 8 0. 15.9997 FORMAT "%7.4" /end AXIS_DESCR
/end CHARACTERISTIC
/begin CHARACTERISTIC KL_DZWO_LAMKOR "Kennlinie Lambdakorrektur Grundreferenzzündwinkel" CURVE 0xa100ed00 _REC_CUR_TKL_UW_VV__s1_u2 99.45 _CNV_R_R_Def_zw_sb__623_CM -64. 63.5 FORMAT "%4.1"
 /begin AXIS_DESCR STD_AXIS La_soll _CNV_R_R_Def_f_uw_b_594_CM 8 0. 15.9997 FORMAT "%7.4" /end AXIS_DESCR
/end CHARACTERISTIC
/begin CHARACTERISTIC KL_DZW_LAMKOR "Kennlinie Lambdakorrektur Grundzündwinkel" CURVE 0xa100f828 _REC_CUR_TKL_UW_VV__s1_u2 99.45 _CNV_R_R_Def_zw_sb__623_CM -64. 63.5 FORMAT "%4.1"
 /begin AXIS_DESCR STD_AXIS La_soll _CNV_R_R_Def_f_uw_b_594_CM 8 0. 15.9997 FORMAT "%7.4" /end AXIS_DESCR
/end CHARACTERISTIC
/begin CHARACTERISTIC KL_FRFSOL "Kennlinie für Faktor Rf_solkrv" CURVE 0xa100f778 _REC_CUR_TKL_UW_VV__u1_s2 1.9921 _CNV_R_R_Def_f_ub_b_625_CM 0. 1.9921
 /begin AXIS_DESCR STD_AXIS Nkw _CNV_R_R_Def_n_sw_q_612_CM 6 -32768. 32767. FORMAT "%5.0" /end AXIS_DESCR
/end CHARACTERISTIC
/begin CHARACTERISTIC KL_FZKRFSOLF "Kennlinie für Faktor Zeitkonstante Rf_soll-Filter fallen" CURVE 0xa100f6ec _REC_CUR_TKL_UW_VV__u1_s2 7.9687 _CNV_R_R_Def_f_ub_b_739_CM 0. 7.9687 FORMAT "%5.2"
 /begin AXIS_DESCR STD_AXIS Nkw _CNV_R_R_Def_n_sw_q_612_CM 6 -32768. 32767. FORMAT "%5.0" /end AXIS_DESCR
/end CHARACTERISTIC
/begin CHARACTERISTIC KL_FZKRFSOLS "Kennlinie für Faktor Zeitkonstante Rf_soll-Filter steigen" CURVE 0xa100f750 _REC_CUR_TKL_UW_VV__u1_s2 7.9687 _CNV_R_R_Def_f_ub_b_739_CM 0. 7.9687 FORMAT "%5.2"
 /begin AXIS_DESCR STD_AXIS Nkw _CNV_R_R_Def_n_sw_q_612_CM 6 -32768. 32767. FORMAT "%5.0" /end AXIS_DESCR
/end CHARACTERISTIC
/begin CHARACTERISTIC KL_F_DYNAKT "Kennlinie Anteil Haltezeit" CURVE 0xa100f730 _REC_CUR_TKL_UW_VV__u1_s2 0.996 _CNV_R_R_Def_f_ub_b_573_CM 0. 0.996
 /begin AXIS_DESCR STD_AXIS Nkw _CNV_R_R_Def_n_sw_q_612_CM 4 -32768. 32767. FORMAT "%5.0" /end AXIS_DESCR
/end CHARACTERISTIC
/begin CHARACTERISTIC KL_F_DYNNAKT "Kennlinie Anteil Haltezeit negative Richtung" CURVE 0xa100f740 _REC_CUR_TKL_UW_VV__u1_s2 0.996 _CNV_R_R_Def_f_ub_b_573_CM 0. 0.996
 /begin AXIS_DESCR STD_AXIS Nkw _CNV_R_R_Def_n_sw_q_612_CM 4 -32768. 32767. FORMAT "%5.0" /end AXIS_DESCR
/end CHARACTERISTIC
/begin CHARACTERISTIC KL_F_DYNNVZ "Kennlinie Anteil Verzögerungszeit negative Richtung" CURVE 0xa100f710 _REC_CUR_TKL_UW_VV__u1_s2 0.996 _CNV_R_R_Def_f_ub_b_573_CM 0. 0.996
 /begin AXIS_DESCR STD_AXIS Nkw _CNV_R_R_Def_n_sw_q_612_CM 4 -32768. 32767. FORMAT "%5.0" /end AXIS_DESCR
/end CHARACTERISTIC
/begin CHARACTERISTIC KL_F_DYNVZ "Kennlinie Anteil Verzögerungszeit" CURVE 0xa100f700 _REC_CUR_TKL_UW_VV__u1_s2 0.996 _CNV_R_R_Def_f_ub_b_573_CM 0. 0.996
 /begin AXIS_DESCR STD_AXIS Nkw _CNV_R_R_Def_n_sw_q_612_CM 4 -32768. 32767. FORMAT "%5.0" /end AXIS_DESCR
/end CHARACTERISTIC
/begin CHARACTERISTIC KL_F_RFZWV "Kennlinie Überblender Verzögerung Rf für Zündwinkelberechnung" CURVE 0xa100f720 _REC_CUR_TKL_UW_VV__u1_s2 0.996 _CNV_R_R_Def_f_ub_b_573_CM 0. 0.996
 /begin AXIS_DESCR STD_AXIS Nkw _CNV_R_R_Def_n_sw_q_612_CM 4 -32768. 32767. FORMAT "%5.0" /end AXIS_DESCR
/end CHARACTERISTIC
/begin CHARACTERISTIC KL_TD "KL Anzahl Halteschritte für Rf_solkrv_hold" CURVE 0xa100f78c _REC_CUR_TKL_UW_VV__u2_s2 0. _CNV_R_R_Def_dez_sl_575_CM 0. 65535. FORMAT "%5.0"
 /begin AXIS_DESCR STD_AXIS Nkw _CNV_R_R_Def_n_sw_q_612_CM 6 -32768. 32767. FORMAT "%5.0" /end AXIS_DESCR
/end CHARACTERISTIC
/begin CHARACTERISTIC KL_TDDRFSOL "Kennlinie Timer Grundzündwinkeldynamik" CURVE 0xa100f7f0 _REC_CUR_TKL_UW_VV__u1_s2 2.55 _CNV_R_R_Def_td_uw__679_CM 0. 2.55 FORMAT "%5.2"
 /begin AXIS_DESCR STD_AXIS Nkw _CNV_R_R_Def_n_sw_q_612_CM 8 -32768. 32767. FORMAT "%5.0" /end AXIS_DESCR
/end CHARACTERISTIC
/begin CHARACTERISTIC KL_TDDRFSOLN "Kennlinie Timer Grundzündwinkeldynamik negative Richtung" CURVE 0xa100f80c _REC_CUR_TKL_UW_VV__u1_s2 2.55 _CNV_R_R_Def_td_uw__679_CM 0. 2.55 FORMAT "%5.2"
 /begin AXIS_DESCR STD_AXIS Nkw _CNV_R_R_Def_n_sw_q_612_CM 8 -32768. 32767. FORMAT "%5.0" /end AXIS_DESCR
/end CHARACTERISTIC
/begin CHARACTERISTIC KL_TDRFSOLO "Kennlinie Verzögerung Rf_soll" CURVE 0xa100f764 _REC_CUR_TKL_UW_VV__u1_s2 15. _CNV_R_R_Def_dez_sl_575_CM 0. 15. FORMAT "%3.0"
 /begin AXIS_DESCR STD_AXIS Nkw _CNV_R_R_Def_n_sw_q_612_CM 6 -32768. 32767. FORMAT "%5.0" /end AXIS_DESCR
/end CHARACTERISTIC
/begin CHARACTERISTIC K_DRFSOL "Delta Rf_sol" VALUE 0xa100f6e6 _REC_VAL_20_s2 98.30250000000001 _CNV_R_R_Def_rf_sw__616_CM -327.68 327.67 FORMAT "%7.4" /end CHARACTERISTIC
/begin CHARACTERISTIC K_DRFSOLKRV "Delta Rf_solkrv" VALUE 0xa100f6ea _REC_VAL_20_s2 98.30250000000001 _CNV_R_R_Def_rf_sw__616_CM -327.68 327.67 FORMAT "%7.4" /end CHARACTERISTIC
/begin CHARACTERISTIC K_DRFSOLKRVF "Delta Rf_solkrvf" VALUE 0xa100f6e8 _REC_VAL_20_s2 98.30250000000001 _CNV_R_R_Def_rf_sw__616_CM -327.68 327.67 FORMAT "%7.4" /end CHARACTERISTIC
/begin CHARACTERISTIC K_DZW_HSPLIT "" VALUE 0xa100ecfc _REC_VAL_20_s1 99.45 _CNV_R_R_Def_zw_sb__623_CM -64. 63.5 FORMAT "%4.1" /end CHARACTERISTIC
/begin CHARACTERISTIC K_MAT_BAZW "Zuordnung Eingang Ba-Umschaltung zu Betriebsart" VAL_BLK 0xa100ecf4 _REC_VAL_2_u1 1. _CNV_R_R_Def_dez_sl_575_CM 1. 2. FORMAT "%3.0" NUMBER 8 /end CHARACTERISTIC
/begin CHARACTERISTIC K_MAT_RFKR "Zuordnung Eingang Ba-Umschaltung zu Betriebsart" VAL_BLK 0xa100f6cc _REC_VAL_2_u1 2. _CNV_R_R_Def_dez_sl_575_CM 1. 3. FORMAT "%3.0" NUMBER 8 /end CHARACTERISTIC
/begin CHARACTERISTIC K_MAT_ZWDYN "Zuordnung Eingang Ba-Umschaltung zu Betriebsart" VAL_BLK 0xa100f6d4 _REC_VAL_2_u1 2. _CNV_R_R_Def_dez_sl_575_CM 1. 3. FORMAT "%3.0" NUMBER 8 /end CHARACTERISTIC
/begin CHARACTERISTIC K_MAT_ZWSTAT "Zuordnung Eingang Ba-Umschaltung zu Betriebsart" VAL_BLK 0xa100f6dc _REC_VAL_2_u1 2. _CNV_R_R_Def_dez_sl_575_CM 1. 3. FORMAT "%3.0" NUMBER 8 /end CHARACTERISTIC
/begin CHARACTERISTIC K_TDRFSOLGD "Verzögerungschritte Rf_soll gedrosselt" VALUE 0xa100f6c8 _REC_VAL_20_u1 15. _CNV_R_R_Def_dez_sl_575_CM 0. 15. FORMAT "%3.0" /end CHARACTERISTIC
/begin CHARACTERISTIC K_ZKRFSOLGD "Zeitkonstante für Rf_soll-filter (gedrosselt)" VALUE 0xa100f6e4 _REC_VAL_20_u2 655.35 _CNV_R_R_Def_zk10ms_709_CM 1.e-002 655.36 FORMAT "%7.4" /end CHARACTERISTIC
/begin CHARACTERISTIC K_ZWHZINI "Rampenstartwert für Einblendfaktor ZW-Eingriff Heizleistungssteigerung" VALUE 0xa100f6c7 _REC_VAL_20_u1 0.996 _CNV_R_R_Def_f_ub_b_573_CM 0. 0.996 /end CHARACTERISTIC
/begin CHARACTERISTIC K_ZWHZRAMP "Rampensteigung für ZW-Eingriff Heizleistung" VALUE 0xa100f6c6 _REC_VAL_20_u1 0.996 _CNV_R_R_Def_f_ub_b_573_CM 0. 0.996 /end CHARACTERISTIC
/begin CHARACTERISTIC S_ZWDYNRETRIG "Schalter zum Einschalter Retriggern " VALUE 0xa100f6c5 _REC_VAL_20_u1 1. _CNV_R_R_Def_dez_sl_575_CM 0. 1. FORMAT "%3.0" /end CHARACTERISTIC
/begin MEASUREMENT tia_im "Air temperatrure in the intake manifold" UBYTE _CNV_A_R_LINEAR_____16_CM 1 100. -48. 142.5 DISPLAY_IDENTIFIER TIA_IM ECU_ADDRESS 0xd00037aa FORMAT "%6.2" /end MEASUREMENT
/begin MEASUREMENT tia_thr "air temperature at the throttle body " UBYTE _CNV_A_R_LINEAR_____16_CM 1 100. -48. 142.5 DISPLAY_IDENTIFIER TIA_THR ECU_ADDRESS 0xd00037ab FORMAT "%6.2" /end MEASUREMENT
/begin MEASUREMENT tia_thr_st "air temperature at the throttle body at start" UBYTE _CNV_A_R_LINEAR_____16_CM 1 100. -48. 142.5 DISPLAY_IDENTIFIER TIA_THR_ST ECU_ADDRESS 0xd00037ac FORMAT "%6.2" /end MEASUREMENT
/begin MEASUREMENT lv_err_tia_im "Boolean for error currently present which might affect temperature TIA_IM (after debounce)" UBYTE _CNV_S_2_RANGE__0___1_CM 1 100. 0. 1. DISPLAY_IDENTIFIER LV_ERR_TIA_IM ECU_ADDRESS 0xd00037a9 BIT_MASK 0x1 /end MEASUREMENT
/begin MEASUREMENT lv_err_tia_thr "Boolean for error currently present which might affect temperature TIA_THR (after debounce)" UBYTE _CNV_S_2_RANGE__0___1_CM 1 100. 0. 1. DISPLAY_IDENTIFIER LV_ERR_TIA_THR ECU_ADDRESS 0xd00037a8 BIT_MASK 0x1 /end MEASUREMENT
/begin AXIS_PTS ldpm_temp_cat_dif_ch_l_1_extc "" 0xa10066d4 temp_cat_dif_ch_l _REC_AXS_20_u2 2047.96875 _CNV_A_R_EXTC_LINEA_778_CM 8 -1056. 991.96875 FORMAT "%11.5" /end AXIS_PTS
/begin AXIS_PTS ldpm_tnt_dif_ch_l_1_extc "" 0xa10066e8 tnt_dif_ch_l _REC_AXS_20_u2 2047.96875 _CNV_A_R_LINEAR_____779_CM 8 -1024. 1023.96875 FORMAT "%11.5" /end AXIS_PTS
/begin MEASUREMENT state_ch_mod_ast "Catlyst heating strategy" UBYTE _CNV_S_4_EXTC_RANGE_780_CM 1 100. 0. 3. DISPLAY_IDENTIFIER STATE_CH_MOD_AST ECU_ADDRESS 0xd0002ebc /end MEASUREMENT
/begin CHARACTERISTIC lc_ch_mod_man_act "Activation of manual setting of catalyst heating strategy" VALUE 0xa1008104 _REC_VAL_20_u1 1. _CNV_S_2_RANGE__0___1_CM 0. 1. DISPLAY_IDENTIFIER LC_CH_MOD_MAN_ACT /end CHARACTERISTIC
/begin CHARACTERISTIC c_ch_mod_man "Manual setting of catalyst heating strategy" VALUE 0xa1008088 _REC_VAL_20_u1 3. _CNV_A_R_LINEAR_____0_CM 0. 3. DISPLAY_IDENTIFIER C_CH_MOD_MAN FORMAT "%1.0" /end CHARACTERISTIC
/begin CHARACTERISTIC c_n_max_mplh_ch_ast "Maximum engine speed for catalyst heating in homogeneous mode with dual injection" VALUE 0xa10080b0 _REC_VAL_20_u1 8160. _CNV_A_R_LINEAR_____9_CM 0. 8160. DISPLAY_IDENTIFIER C_N_MAX_MPLH_CH_AST FORMAT "%4.0" /end CHARACTERISTIC
/begin CHARACTERISTIC c_tqi_min_mplh_ch_ast "Minimum indicated torque request for catalyst heating in homogeneous mode with dual injection" VALUE 0xa10080f8 _REC_VAL_20_s2 2047.96875 _CNV_A_R_LINEAR_____30_CM -1024. 1023.96875 DISPLAY_IDENTIFIER C_TQI_MIN_MPLH_CH_AST FORMAT "%11.5" /end CHARACTERISTIC
/begin CHARACTERISTIC c_tqi_max_mplh_ch_ast "Maximum indicated torque request for catalyst heating in homogeneous mode with dual injection" VALUE 0xa10080f4 _REC_VAL_20_s2 2047.96875 _CNV_A_R_LINEAR_____30_CM -1024. 1023.96875 DISPLAY_IDENTIFIER C_TQI_MAX_MPLH_CH_AST FORMAT "%11.5" /end CHARACTERISTIC
/begin CHARACTERISTIC c_n_min_mplh_ch_ast "Minimum engine speed for catalyst heating in homogeneous mode with dual injection" VALUE 0xa10080b2 _REC_VAL_20_u1 8160. _CNV_A_R_LINEAR_____9_CM 0. 8160. DISPLAY_IDENTIFIER C_N_MIN_MPLH_CH_AST FORMAT "%4.0" /end CHARACTERISTIC
/begin CHARACTERISTIC c_tqi_min_mplp_ch_ast "Minimum of indicated torque request for catalyst heating with post injection" VALUE 0xa10080fa _REC_VAL_20_s2 2047.96875 _CNV_A_R_LINEAR_____30_CM -1024. 1023.96875 DISPLAY_IDENTIFIER C_TQI_MIN_MPLP_CH_AST FORMAT "%11.5" /end CHARACTERISTIC
/begin CHARACTERISTIC c_n_min_mplp_ch_ast "Minimum engine speed for catalyst heating in stratified mode with post injection" VALUE 0xa10080b3 _REC_VAL_20_u1 8160. _CNV_A_R_LINEAR_____9_CM 0. 8160. DISPLAY_IDENTIFIER C_N_MIN_MPLP_CH_AST FORMAT "%4.0" /end CHARACTERISTIC
/begin CHARACTERISTIC c_n_max_mplp_ch_ast "Maximum engine speed for catalyst heating in stratified mode with post injection" VALUE 0xa10080b1 _REC_VAL_20_u1 8160. _CNV_A_R_LINEAR_____9_CM 0. 8160. DISPLAY_IDENTIFIER C_N_MAX_MPLP_CH_AST FORMAT "%4.0" /end CHARACTERISTIC
/begin CHARACTERISTIC c_tqi_max_mplp_ch_ast "Maximum of indicated torque request for catalyst heating with post injection" VALUE 0xa10080f6 _REC_VAL_20_s2 2047.96875 _CNV_A_R_LINEAR_____30_CM -1024. 1023.96875 DISPLAY_IDENTIFIER C_TQI_MAX_MPLP_CH_AST FORMAT "%11.5" /end CHARACTERISTIC
/begin AXIS_PTS ldp_t_ast_id_ch_mod_bas "" 0xa10063b4 t_ast _REC_AXS_20_u2 6553.5 _CNV_A_R_LINEAR_____4_CM 8 0. 6553.5 FORMAT "%6.1" /end AXIS_PTS
/begin AXIS_PTS ldp_tco_st_id_ch_mod_bas "" 0xa1006468 tco_st _REC_AXS_20_u1 190.5 _CNV_A_R_LINEAR_____16_CM 8 -48. 142.5 FORMAT "%6.2" /end AXIS_PTS
/begin CHARACTERISTIC id_ch_mod_bas "Basic catalyst heating strategy" MAP 0xa1006748 _REC_MAP_20_u1_u2_u1 3. _CNV_A_R_LINEAR_____0_CM 0. 3. DISPLAY_IDENTIFIER ID_CH_MOD_BAS FORMAT "%1.0"
 /begin AXIS_DESCR COM_AXIS t_ast _CNV_A_R_LINEAR_____4_CM 8 0. 6553.5 FORMAT "%6.1" AXIS_PTS_REF ldp_t_ast_id_ch_mod_bas /end AXIS_DESCR
 /begin AXIS_DESCR COM_AXIS tco_st _CNV_A_R_LINEAR_____16_CM 8 -48. 142.5 FORMAT "%6.2" AXIS_PTS_REF ldp_tco_st_id_ch_mod_bas /end AXIS_DESCR
/end CHARACTERISTIC
/begin MEASUREMENT state_ch_mod_req_ast "State of requested after start catalyst heating strategy, 1st priority" UBYTE _CNV_S_4_EXTC_RANGE_780_CM 1 100. 0. 3. DISPLAY_IDENTIFIER STATE_CH_MOD_REQ_AST ECU_ADDRESS 0xd0002ebf /end MEASUREMENT
/begin CHARACTERISTIC c_vs_max_mplp_ch_ast "Threshold of vehicle speed for catalyst heating with post injection" VALUE 0xa1008102 _REC_VAL_20_u1 255. _CNV_A_R_LINEAR_____6_CM 0. 255. DISPLAY_IDENTIFIER C_VS_MAX_MPLP_CH_AST FORMAT "%3.0" /end CHARACTERISTIC
/begin MEASUREMENT lv_ch_ast_mplp_cdn "Indicates if conditions for after start catalyst heating with post injection in stratified are fulfilled" UBYTE _CNV_S_2_RANGE__0___1_CM 1 100. 0. 1. DISPLAY_IDENTIFIER LV_CH_AST_MPLP_CDN ECU_ADDRESS 0xd0002eb4 /end MEASUREMENT
/begin MEASUREMENT lv_ch_ast_mplh_cdn "Indicates if conditions for after start catalyst heating with multiple injection in homogenous are fulfilled" UBYTE _CNV_S_2_RANGE__0___1_CM 1 100. 0. 1. DISPLAY_IDENTIFIER LV_CH_AST_MPLH_CDN ECU_ADDRESS 0xd0002eb3 /end MEASUREMENT
/begin MEASUREMENT lv_ch_ast_cdn "Indicator for conditions of catalyst heating after start" UBYTE _CNV_S_2_RANGE__0___1_CM 1 100. 0. 1. DISPLAY_IDENTIFIER LV_CH_AST_CDN ECU_ADDRESS 0xd0002eb2 /end MEASUREMENT
/begin MEASUREMENT lv_ch_ast_swi_on_ramp "Switch from catalyst heating off to catalyst heating after start" UBYTE _CNV_S_2_RANGE__0___1_CM 1 100. 0. 1. DISPLAY_IDENTIFIER LV_CH_AST_SWI_ON_RAMP ECU_ADDRESS 0xd0002eb5 /end MEASUREMENT
/begin AXIS_PTS ldp_tco_st_ip_t_es_thd_ch_ast "" 0xa10064a4 tco_st _REC_AXS_20_u1 190.5 _CNV_A_R_LINEAR_____16_CM 8 -48. 142.5 FORMAT "%6.2" /end AXIS_PTS
/begin AXIS_PTS ldp_tco_st_ip_t_ast_thd_ch_ast "" 0xa1006498 tco_st _REC_AXS_20_u1 190.5 _CNV_A_R_LINEAR_____16_CM 8 -48. 142.5 FORMAT "%6.2" /end AXIS_PTS
/begin CHARACTERISTIC ip_t_es_thd_ch_ast "Threshold of engine off duration time which stops catalyst heating after start" CURVE 0xa1007d30 _REC_CUR_20_u2_u1 65535. _CNV_A_R_LINEAR_____77_CM 0. 65535. DISPLAY_IDENTIFIER IP_T_ES_THD_CH_AST FORMAT "%5.0"
 /begin AXIS_DESCR COM_AXIS tco_st _CNV_A_R_LINEAR_____16_CM 8 -48. 142.5 FORMAT "%6.2" AXIS_PTS_REF ldp_tco_st_ip_t_es_thd_ch_ast /end AXIS_DESCR
/end CHARACTERISTIC
/begin CHARACTERISTIC ip_t_ast_thd_ch_ast "Threshold of time after start which stops the catalyst heating after start" CURVE 0xa1007d20 _REC_CUR_20_u2_u1 6553.5 _CNV_A_R_LINEAR_____4_CM 0. 6553.5 DISPLAY_IDENTIFIER IP_T_AST_THD_CH_AST FORMAT "%6.1"
 /begin AXIS_DESCR COM_AXIS tco_st _CNV_A_R_LINEAR_____16_CM 8 -48. 142.5 FORMAT "%6.2" AXIS_PTS_REF ldp_tco_st_ip_t_ast_thd_ch_ast /end AXIS_DESCR
/end CHARACTERISTIC
/begin MEASUREMENT state_ch "state of catalyst heating" UBYTE _CNV_S_4_STATE_CH_781_CM 1 100. 0. 3. DISPLAY_IDENTIFIER STATE_CH ECU_ADDRESS 0xd0002eba /end MEASUREMENT
/begin MEASUREMENT tnt_dif_ch_l "difference between maximum and actual value of TNT" SWORD _CNV_A_R_LINEAR_____538_CM 1 100. -1024. 1023.96875 DISPLAY_IDENTIFIER TNT_DIF_CH_L ECU_ADDRESS 0xd000273c FORMAT "%11.5" /end MEASUREMENT
/begin MEASUREMENT temp_cat_dif_ch_l "Difference between target and actual value of cat. temperature" SWORD _CNV_A_R_EXTC_LINEA_782_CM 1 100. -1056. 991.96875 DISPLAY_IDENTIFIER TEMP_CAT_DIF_CH_L ECU_ADDRESS 0xd000272c FORMAT "%11.5" /end MEASUREMENT
/begin CHARACTERISTIC c_thd_temp_cat_ch_ast "Threshold of catalyst temperature for catalyst heating after start" VALUE 0xa10080cc _REC_VAL_20_u2 1023.984375 _CNV_A_R_LINEAR_____776_CM -33. 990.984375 DISPLAY_IDENTIFIER C_THD_TEMP_CAT_CH_AST FORMAT "%10.6" /end CHARACTERISTIC
/begin CHARACTERISTIC c_n_32_thd_ch_l_off "Threshold of engine speed that disables CH_L" VALUE 0xa10080ae _REC_VAL_20_u1 8160. _CNV_A_R_LINEAR_____9_CM 0. 8160. DISPLAY_IDENTIFIER C_N_32_THD_CH_L_OFF FORMAT "%4.0" /end CHARACTERISTIC
/begin CHARACTERISTIC c_n_32_thd_ch_l_on "Threshold of engine speed that disables CH_L" VALUE 0xa10080af _REC_VAL_20_u1 8160. _CNV_A_R_LINEAR_____9_CM 0. 8160. DISPLAY_IDENTIFIER C_N_32_THD_CH_L_ON FORMAT "%4.0" /end CHARACTERISTIC
/begin CHARACTERISTIC c_state_ch_man "Manual setting of state of cat. heating" VALUE 0xa10080be _REC_VAL_20_u1 3. _CNV_A_R_LINEAR_____0_CM 0. 3. DISPLAY_IDENTIFIER C_STATE_CH_MAN FORMAT "%3.0" /end CHARACTERISTIC
/begin CHARACTERISTIC c_temp_cat_thd_ch_l_off "Threshold of catalyst temperature for CH_L (switching off)" VALUE 0xa10080c4 _REC_VAL_20_u2 1023.984375 _CNV_A_R_LINEAR_____776_CM -33. 990.984375 DISPLAY_IDENTIFIER C_TEMP_CAT_THD_CH_L_OFF FORMAT "%10.6" /end CHARACTERISTIC
/begin CHARACTERISTIC c_temp_cat_thd_ch_l_hom_on "Threshold of catalyst temperature for homogeneous CH_L" VALUE 0xa10080c2 _REC_VAL_20_u2 1023.984375 _CNV_A_R_LINEAR_____776_CM -33. 990.984375 DISPLAY_IDENTIFIER C_TEMP_CAT_THD_CH_L_HOM_ON FORMAT "%10.6" /end CHARACTERISTIC
/begin CHARACTERISTIC c_temp_cat_thd_ch_l_s_on "Threshold of catalyst temperature for stratified CH_L" VALUE 0xa10080c6 _REC_VAL_20_u2 1023.984375 _CNV_A_R_LINEAR_____776_CM -33. 990.984375 DISPLAY_IDENTIFIER C_TEMP_CAT_THD_CH_L_S_ON FORMAT "%10.6" /end CHARACTERISTIC
/begin CHARACTERISTIC c_thd_tnt_ch_ast "Threshold of nox trap temperature for catalyst heating after start" VALUE 0xa10080ce _REC_VAL_20_u2 1023.984375 _CNV_A_R_LINEAR_____197_CM 0. 1023.984375 DISPLAY_IDENTIFIER C_THD_TNT_CH_AST FORMAT "%11.6" /end CHARACTERISTIC
/begin CHARACTERISTIC c_tnt_thd_ch_l_off "Threshold NOx trap temperature that deactivates CH in stratified and homogeneous" VALUE 0xa10080da _REC_VAL_20_u2 1023.984375 _CNV_A_R_LINEAR_____197_CM 0. 1023.984375 DISPLAY_IDENTIFIER C_TNT_THD_CH_L_OFF FORMAT "%11.6" /end CHARACTERISTIC
/begin CHARACTERISTIC c_tnt_thd_ch_l_hom_on "Threshold NOx trap temperature that activates CH in homogeneous" VALUE 0xa10080d8 _REC_VAL_20_u2 1023.984375 _CNV_A_R_LINEAR_____197_CM 0. 1023.984375 DISPLAY_IDENTIFIER C_TNT_THD_CH_L_HOM_ON FORMAT "%11.6" /end CHARACTERISTIC
/begin CHARACTERISTIC c_tnt_thd_ch_l_s_on "Threshold NOx trap temperature that activates CH in stratified" VALUE 0xa10080dc _REC_VAL_20_u2 1023.984375 _CNV_A_R_LINEAR_____197_CM 0. 1023.984375 DISPLAY_IDENTIFIER C_TNT_THD_CH_L_S_ON FORMAT "%11.6" /end CHARACTERISTIC
/begin CHARACTERISTIC c_tqi_req_fast_thd_ch_l_off "Threshold of TQI_REQ_FAST that disables CH_L" VALUE 0xa10080fc _REC_VAL_20_s2 2047.96875 _CNV_A_R_LINEAR_____30_CM -1024. 1023.96875 DISPLAY_IDENTIFIER C_TQI_REQ_FAST_THD_CH_L_OFF FORMAT "%11.5" /end CHARACTERISTIC
/begin CHARACTERISTIC c_tqi_req_fast_thd_ch_l_on "Threshold of TQI_REQ_FAST that enables CH_L" VALUE 0xa10080fe _REC_VAL_20_s2 2047.96875 _CNV_A_R_LINEAR_____30_CM -1024. 1023.96875 DISPLAY_IDENTIFIER C_TQI_REQ_FAST_THD_CH_L_ON FORMAT "%11.5" /end CHARACTERISTIC
/begin CHARACTERISTIC lc_state_ch_man_act "Activation of manual setting of state of cat. heating" VALUE 0xa1008112 _REC_VAL_20_u1 1. _CNV_A_R_LINEAR_____0_CM 0. 1. DISPLAY_IDENTIFIER LC_STATE_CH_MAN_ACT FORMAT "%1.0" /end CHARACTERISTIC
/begin MEASUREMENT tqi_req_fast_fil_ch_so2p "Filtered torque request (fast path) for desulfation catalyst heating activation" SWORD _CNV_A_R_LINEAR_____30_CM 1 100. -1024. 1023.96875 DISPLAY_IDENTIFIER TQI_REQ_FAST_FIL_CH_SO2P ECU_ADDRESS 0xd000274a FORMAT "%8.2" /end MEASUREMENT
/begin MEASUREMENT vs_fil_ch_so2p "Filtered vehicle speed" UBYTE _CNV_A_R_LINEAR_____6_CM 1 100. 0. 255. DISPLAY_IDENTIFIER VS_FIL_CH_SO2P ECU_ADDRESS 0xd0002ec3 FORMAT "%3.0" /end MEASUREMENT
/begin MEASUREMENT lv_ch_so2p_cdn "Indicator for conditions of desulfation catalyst heating" UBYTE _CNV_S_2_RANGE__0___1_CM 1 100. 0. 1. DISPLAY_IDENTIFIER LV_CH_SO2P_CDN ECU_ADDRESS 0xd0002eb7 /end MEASUREMENT
/begin MEASUREMENT lv_ch_l_cdn "Indicator for conditions of low load catalyst heating" UBYTE _CNV_S_2_RANGE__0___1_CM 1 100. 0. 1. DISPLAY_IDENTIFIER LV_CH_L_CDN ECU_ADDRESS 0xd0002eb6 /end MEASUREMENT
/begin CHARACTERISTIC c_fac_tqi_fil_ch_so2p "Correlation factor to filter the requested torque" VALUE 0xa1008094 _REC_VAL_20_u2 1. _CNV_A_R_LINEAR_____232_CM 0. 1. DISPLAY_IDENTIFIER C_FAC_TQI_FIL_CH_SO2P FORMAT "%6.4" /end CHARACTERISTIC
/begin CHARACTERISTIC c_fac_vs_fil_ch_so2p "Correlation factor to filter the vehicle speed" VALUE 0xa1008096 _REC_VAL_20_u2 1. _CNV_A_R_LINEAR_____232_CM 0. 1. DISPLAY_IDENTIFIER C_FAC_VS_FIL_CH_SO2P FORMAT "%6.4" /end CHARACTERISTIC
/begin CHARACTERISTIC c_temp_cat_thd_ch_so2p "Threshold of catalyst temperature for desulfation catalyst heating" VALUE 0xa10080c8 _REC_VAL_20_u2 1023.984375 _CNV_A_R_LINEAR_____776_CM -33. 990.984375 DISPLAY_IDENTIFIER C_TEMP_CAT_THD_CH_SO2P FORMAT "%10.6" /end CHARACTERISTIC
/begin CHARACTERISTIC c_tnt_max_ch_so2p "Maximum temperature of TNT for desulfation catalyst heating" VALUE 0xa10080d0 _REC_VAL_20_u2 1023.984375 _CNV_A_R_LINEAR_____197_CM 0. 1023.984375 DISPLAY_IDENTIFIER C_TNT_MAX_CH_SO2P FORMAT "%11.6" /end CHARACTERISTIC
/begin CHARACTERISTIC c_tnt_min_ch_so2p "Minimum temperature of TNT for desulfation catalyst heating" VALUE 0xa10080d4 _REC_VAL_20_u2 1023.984375 _CNV_A_R_LINEAR_____197_CM 0. 1023.984375 DISPLAY_IDENTIFIER C_TNT_MIN_CH_SO2P FORMAT "%11.6" /end CHARACTERISTIC
/begin CHARACTERISTIC c_tqi_thd_ch_so2p "Threshold of requested torque to activate desulfation catalyst heating" VALUE 0xa1008100 _REC_VAL_20_s2 2047.96875 _CNV_A_R_LINEAR_____30_CM -1024. 1023.96875 DISPLAY_IDENTIFIER C_TQI_THD_CH_SO2P FORMAT "%8.2" /end CHARACTERISTIC
/begin CHARACTERISTIC c_vs_thd_ch_so2p "threshold of vehicle speed to activate desulfation catalyst heating" VALUE 0xa1008103 _REC_VAL_20_u1 255. _CNV_A_R_LINEAR_____6_CM 0. 255. DISPLAY_IDENTIFIER C_VS_THD_CH_SO2P FORMAT "%3.0" /end CHARACTERISTIC
/begin MEASUREMENT fac_cam_sp_ch "Interpolation factor for CAM_SP catalyst heating" UBYTE _CNV_A_R_LINEAR_____27_CM 1 100. 0. 0.99609375 DISPLAY_IDENTIFIER FAC_CAM_SP_CH ECU_ADDRESS 0xd0002eb0 FORMAT "%5.3" /end MEASUREMENT
/begin MEASUREMENT cam_sp_ch_in "Intake camshaft target spread for catalyst heating" SWORD _CNV_A_R_LINEAR_____482_CM 1 100. -768. 767.9765625 DISPLAY_IDENTIFIER CAM_SP_CH_IN ECU_ADDRESS 0xd00026de FORMAT "%7.2" /end MEASUREMENT
/begin MEASUREMENT cam_sp_ch_ex "Outtake camshaft target spread for catalyst heating" SWORD _CNV_A_R_LINEAR_____482_CM 1 100. -768. 767.9765625 DISPLAY_IDENTIFIER CAM_SP_CH_EX ECU_ADDRESS 0xd00026dc FORMAT "%7.2" /end MEASUREMENT
/begin CHARACTERISTIC c_t_dri_ch_cam "duration of ramp after LV_DRI change" VALUE 0xa10080c0 _REC_VAL_20_u2 655.35 _CNV_A_R_LINEAR_____3_CM 0. 655.35 DISPLAY_IDENTIFIER C_T_DRI_CH_CAM FORMAT "%6.2" /end CHARACTERISTIC
/begin AXIS_PTS ldp_ctr_km_can_ip_fac_cam_sp_ch "" 0xa10061c4 ctr_km_can _REC_AXS_20_u2 655350. _CNV_A_R_LINEAR_____70_CM 4 0. 655350. FORMAT "%7.0" /end AXIS_PTS
/begin AXIS_PTS ldpm_tco_st_3_extc "" 0xa10066bc tco_st _REC_AXS_20_u1 190.5 _CNV_A_R_LINEAR_____16_CM 8 -48. 142.5 FORMAT "%6.2" /end AXIS_PTS
/begin AXIS_PTS ldpm_tco_st_1_extc "" 0xa10066a4 tco_st _REC_AXS_20_u1 190.5 _CNV_A_R_LINEAR_____16_CM 8 -48. 142.5 FORMAT "%6.2" /end AXIS_PTS
/begin AXIS_PTS ldpm_tco_st_2_extc "" 0xa10066b0 tco_st _REC_AXS_20_u1 190.5 _CNV_A_R_LINEAR_____16_CM 8 -48. 142.5 FORMAT "%6.2" /end AXIS_PTS
/begin AXIS_PTS ldpm_tco_st_4_extc "" 0xa10066c8 tco_st _REC_AXS_20_u1 190.5 _CNV_A_R_LINEAR_____16_CM 8 -48. 142.5 FORMAT "%6.2" /end AXIS_PTS
/begin AXIS_PTS ldpm_t_ast_2_extc "" 0xa1006648 t_ast _REC_AXS_20_u2 6553.5 _CNV_A_R_LINEAR_____4_CM 8 0. 6553.5 FORMAT "%6.1" /end AXIS_PTS
/begin AXIS_PTS ldpm_t_ast_3_extc "" 0xa100665c t_ast _REC_AXS_20_u2 6553.5 _CNV_A_R_LINEAR_____4_CM 8 0. 6553.5 FORMAT "%6.1" /end AXIS_PTS
/begin AXIS_PTS ldpm_t_ast_4_extc "" 0xa1006670 t_ast _REC_AXS_20_u2 6553.5 _CNV_A_R_LINEAR_____4_CM 8 0. 6553.5 FORMAT "%6.1" /end AXIS_PTS
/begin AXIS_PTS ldpm_t_ast_1_extc "" 0xa1006634 t_ast _REC_AXS_20_u2 6553.5 _CNV_A_R_LINEAR_____4_CM 8 0. 6553.5 FORMAT "%6.1" /end AXIS_PTS
/begin AXIS_PTS ldp_n_32_ip_fac_cam_sp_ch_opp "" 0xa10062fa n_32 _REC_AXS_20_u1 8160. _CNV_A_R_LINEAR_____9_CM 4 0. 8160. FORMAT "%4.0" /end AXIS_PTS
/begin AXIS_PTS ldp_dip_ip_fac_cam_sp_ch_opp "" 0xa10061e4 online_dummy _REC_AXS_20_u2 5434. _CNV_A_R_LINEAR_____26_CM 4 0. 5434. FORMAT "%7.2" /end AXIS_PTS
/begin CHARACTERISTIC ip_fac_cam_sp_ch_opp "Factor operating point" MAP 0xa1006dec _REC_MAP_20_u1_u1_u2 0.99609375 _CNV_A_R_LINEAR_____27_CM 0. 0.99609375 DISPLAY_IDENTIFIER IP_FAC_CAM_SP_CH_OPP FORMAT "%5.3"
 /begin AXIS_DESCR COM_AXIS n_32 _CNV_A_R_LINEAR_____9_CM 4 0. 8160. FORMAT "%4.0" AXIS_PTS_REF ldp_n_32_ip_fac_cam_sp_ch_opp /end AXIS_DESCR
 /begin AXIS_DESCR COM_AXIS online_dummy _CNV_A_R_LINEAR_____26_CM 4 0. 5434. FORMAT "%7.2" AXIS_PTS_REF ldp_dip_ip_fac_cam_sp_ch_opp /end AXIS_DESCR
/end CHARACTERISTIC
/begin CHARACTERISTIC ip_fac_cam_sp_ch_km "Factor vehicle mileage" CURVE 0xa1006de8 _REC_CUR_20_u1_u2 0.99609375 _CNV_A_R_LINEAR_____27_CM 0. 0.99609375 DISPLAY_IDENTIFIER IP_FAC_CAM_SP_CH_KM FORMAT "%5.3"
 /begin AXIS_DESCR COM_AXIS ctr_km_can _CNV_A_R_LINEAR_____70_CM 4 0. 655350. FORMAT "%7.0" AXIS_PTS_REF ldp_ctr_km_can_ip_fac_cam_sp_ch /end AXIS_DESCR
/end CHARACTERISTIC
/begin CHARACTERISTIC c_fac_cam_ch_l_dif_max "Interpolation factor of CH-Cam-setpoints" VALUE 0xa1008090 _REC_VAL_20_u1 1. _CNV_A_R_LINEAR_____783_CM 0. 1. DISPLAY_IDENTIFIER C_FAC_CAM_CH_L_DIF_MAX FORMAT "%7.5" /end CHARACTERISTIC
/begin CHARACTERISTIC ip_cam_ch_ast_hom_dri_ex "Target spread during CAT heating, LV_DRI = 1, exhaust camshaft" MAP 0xa10067ac _REC_MAP_20_u1_u1_u2 -95.625 _CNV_A_R_LINEAR_____567_CM -40. -135.625 DISPLAY_IDENTIFIER IP_CAM_CH_AST_HOM_DRI_EX FORMAT "%8.3"
 /begin AXIS_DESCR COM_AXIS tco_st _CNV_A_R_LINEAR_____16_CM 8 -48. 142.5 FORMAT "%6.2" AXIS_PTS_REF ldpm_tco_st_4_extc /end AXIS_DESCR
 /begin AXIS_DESCR COM_AXIS t_ast _CNV_A_R_LINEAR_____4_CM 8 0. 6553.5 FORMAT "%6.1" AXIS_PTS_REF ldpm_t_ast_4_extc /end AXIS_DESCR
/end CHARACTERISTIC
/begin CHARACTERISTIC ip_cam_ch_ast_hom_dri_in "Target spread during CAT heating in HOM, LV_DRI = 1, intake camshaft" MAP 0xa10067ec _REC_MAP_20_u1_u1_u2 95.625 _CNV_A_R_LINEAR_____568_CM 60. 155.625 DISPLAY_IDENTIFIER IP_CAM_CH_AST_HOM_DRI_IN FORMAT "%7.3"
 /begin AXIS_DESCR COM_AXIS tco_st _CNV_A_R_LINEAR_____16_CM 8 -48. 142.5 FORMAT "%6.2" AXIS_PTS_REF ldpm_tco_st_3_extc /end AXIS_DESCR
 /begin AXIS_DESCR COM_AXIS t_ast _CNV_A_R_LINEAR_____4_CM 8 0. 6553.5 FORMAT "%6.1" AXIS_PTS_REF ldpm_t_ast_3_extc /end AXIS_DESCR
/end CHARACTERISTIC
/begin CHARACTERISTIC ip_cam_ch_ast_hom_ex "Target spread during CAT heating in HOM, LV_DRI = 0, exhaust camshaft" MAP 0xa100682c _REC_MAP_20_u1_u1_u2 -95.625 _CNV_A_R_LINEAR_____567_CM -40. -135.625 DISPLAY_IDENTIFIER IP_CAM_CH_AST_HOM_EX FORMAT "%8.3"
 /begin AXIS_DESCR COM_AXIS tco_st _CNV_A_R_LINEAR_____16_CM 8 -48. 142.5 FORMAT "%6.2" AXIS_PTS_REF ldpm_tco_st_2_extc /end AXIS_DESCR
 /begin AXIS_DESCR COM_AXIS t_ast _CNV_A_R_LINEAR_____4_CM 8 0. 6553.5 FORMAT "%6.1" AXIS_PTS_REF ldpm_t_ast_2_extc /end AXIS_DESCR
/end CHARACTERISTIC
/begin CHARACTERISTIC ip_cam_ch_ast_hom_in "Target spread during CAT heating in HOM, LV_DRI = 0, intake camshaft" MAP 0xa100686c _REC_MAP_20_u1_u1_u2 95.625 _CNV_A_R_LINEAR_____568_CM 60. 155.625 DISPLAY_IDENTIFIER IP_CAM_CH_AST_HOM_IN FORMAT "%7.3"
 /begin AXIS_DESCR COM_AXIS tco_st _CNV_A_R_LINEAR_____16_CM 8 -48. 142.5 FORMAT "%6.2" AXIS_PTS_REF ldpm_tco_st_1_extc /end AXIS_DESCR
 /begin AXIS_DESCR COM_AXIS t_ast _CNV_A_R_LINEAR_____4_CM 8 0. 6553.5 FORMAT "%6.1" AXIS_PTS_REF ldpm_t_ast_1_extc /end AXIS_DESCR
/end CHARACTERISTIC
/begin CHARACTERISTIC ip_cam_ch_ast_mplh_dri_ex "Target spread during CAT heating in HOM_DUI, LV_DRI = 1, exhaust camshaft" MAP 0xa10068ac _REC_MAP_20_u1_u1_u2 -95.625 _CNV_A_R_LINEAR_____567_CM -40. -135.625 DISPLAY_IDENTIFIER IP_CAM_CH_AST_MPLH_DRI_EX FORMAT "%8.3"
 /begin AXIS_DESCR COM_AXIS tco_st _CNV_A_R_LINEAR_____16_CM 8 -48. 142.5 FORMAT "%6.2" AXIS_PTS_REF ldpm_tco_st_4_extc /end AXIS_DESCR
 /begin AXIS_DESCR COM_AXIS t_ast _CNV_A_R_LINEAR_____4_CM 8 0. 6553.5 FORMAT "%6.1" AXIS_PTS_REF ldpm_t_ast_4_extc /end AXIS_DESCR
/end CHARACTERISTIC
/begin CHARACTERISTIC ip_cam_ch_ast_mplh_dri_in "Target spread during CAT heating in HOM_DUI, LV_DRI = 1, intake camshaft" MAP 0xa10068ec _REC_MAP_20_u1_u1_u2 95.625 _CNV_A_R_LINEAR_____568_CM 60. 155.625 DISPLAY_IDENTIFIER IP_CAM_CH_AST_MPLH_DRI_IN FORMAT "%7.3"
 /begin AXIS_DESCR COM_AXIS tco_st _CNV_A_R_LINEAR_____16_CM 8 -48. 142.5 FORMAT "%6.2" AXIS_PTS_REF ldpm_tco_st_3_extc /end AXIS_DESCR
 /begin AXIS_DESCR COM_AXIS t_ast _CNV_A_R_LINEAR_____4_CM 8 0. 6553.5 FORMAT "%6.1" AXIS_PTS_REF ldpm_t_ast_3_extc /end AXIS_DESCR
/end CHARACTERISTIC
/begin CHARACTERISTIC ip_cam_ch_ast_mplh_in "Target spread during CAT heating in HOM_DUI, LV_DRI = 0, intake camshaft" MAP 0xa100696c _REC_MAP_20_u1_u1_u2 95.625 _CNV_A_R_LINEAR_____568_CM 60. 155.625 DISPLAY_IDENTIFIER IP_CAM_CH_AST_MPLH_IN FORMAT "%7.3"
 /begin AXIS_DESCR COM_AXIS tco_st _CNV_A_R_LINEAR_____16_CM 8 -48. 142.5 FORMAT "%6.2" AXIS_PTS_REF ldpm_tco_st_1_extc /end AXIS_DESCR
 /begin AXIS_DESCR COM_AXIS t_ast _CNV_A_R_LINEAR_____4_CM 8 0. 6553.5 FORMAT "%6.1" AXIS_PTS_REF ldpm_t_ast_1_extc /end AXIS_DESCR
/end CHARACTERISTIC
/begin CHARACTERISTIC ip_cam_ch_ast_mplh_ex "Target spread during CAT heating in HOM_DUI, LV_DRI = 0, exhaust camshaft" MAP 0xa100692c _REC_MAP_20_u1_u1_u2 -95.625 _CNV_A_R_LINEAR_____567_CM -40. -135.625 DISPLAY_IDENTIFIER IP_CAM_CH_AST_MPLH_EX FORMAT "%8.3"
 /begin AXIS_DESCR COM_AXIS tco_st _CNV_A_R_LINEAR_____16_CM 8 -48. 142.5 FORMAT "%6.2" AXIS_PTS_REF ldpm_tco_st_2_extc /end AXIS_DESCR
 /begin AXIS_DESCR COM_AXIS t_ast _CNV_A_R_LINEAR_____4_CM 8 0. 6553.5 FORMAT "%6.1" AXIS_PTS_REF ldpm_t_ast_2_extc /end AXIS_DESCR
/end CHARACTERISTIC
/begin CHARACTERISTIC ip_cam_ch_ast_mplp_dri_ex "Target spread during CAT heating in S_POST, LV_DRI = 1, exhaust camshaft" MAP 0xa10069ac _REC_MAP_20_u1_u1_u2 -95.625 _CNV_A_R_LINEAR_____567_CM -40. -135.625 DISPLAY_IDENTIFIER IP_CAM_CH_AST_MPLP_DRI_EX FORMAT "%8.3"
 /begin AXIS_DESCR COM_AXIS tco_st _CNV_A_R_LINEAR_____16_CM 8 -48. 142.5 FORMAT "%6.2" AXIS_PTS_REF ldpm_tco_st_4_extc /end AXIS_DESCR
 /begin AXIS_DESCR COM_AXIS t_ast _CNV_A_R_LINEAR_____4_CM 8 0. 6553.5 FORMAT "%6.1" AXIS_PTS_REF ldpm_t_ast_4_extc /end AXIS_DESCR
/end CHARACTERISTIC
/begin CHARACTERISTIC ip_cam_ch_ast_mplp_dri_in "Target spread during CAT heating in S_POST, LV_DRI = 1, intake camshaft" MAP 0xa10069ec _REC_MAP_20_u1_u1_u2 95.625 _CNV_A_R_LINEAR_____568_CM 60. 155.625 DISPLAY_IDENTIFIER IP_CAM_CH_AST_MPLP_DRI_IN FORMAT "%7.3"
 /begin AXIS_DESCR COM_AXIS tco_st _CNV_A_R_LINEAR_____16_CM 8 -48. 142.5 FORMAT "%6.2" AXIS_PTS_REF ldpm_tco_st_3_extc /end AXIS_DESCR
 /begin AXIS_DESCR COM_AXIS t_ast _CNV_A_R_LINEAR_____4_CM 8 0. 6553.5 FORMAT "%6.1" AXIS_PTS_REF ldpm_t_ast_3_extc /end AXIS_DESCR
/end CHARACTERISTIC
/begin CHARACTERISTIC ip_cam_ch_ast_mplp_ex "Target spread during CAT heating in S_POST, LV_DRI = 0, exhaust camshaft" MAP 0xa1006a2c _REC_MAP_20_u1_u1_u2 -95.625 _CNV_A_R_LINEAR_____567_CM -40. -135.625 DISPLAY_IDENTIFIER IP_CAM_CH_AST_MPLP_EX FORMAT "%8.3"
 /begin AXIS_DESCR COM_AXIS tco_st _CNV_A_R_LINEAR_____16_CM 8 -48. 142.5 FORMAT "%6.2" AXIS_PTS_REF ldpm_tco_st_2_extc /end AXIS_DESCR
 /begin AXIS_DESCR COM_AXIS t_ast _CNV_A_R_LINEAR_____4_CM 8 0. 6553.5 FORMAT "%6.1" AXIS_PTS_REF ldpm_t_ast_2_extc /end AXIS_DESCR
/end CHARACTERISTIC
/begin CHARACTERISTIC ip_cam_ch_ast_mplp_in "Target spread during CAT heating in S_POST, LV_DRI = 0, intake camshaft" MAP 0xa1006a6c _REC_MAP_20_u1_u1_u2 95.625 _CNV_A_R_LINEAR_____568_CM 60. 155.625 DISPLAY_IDENTIFIER IP_CAM_CH_AST_MPLP_IN FORMAT "%7.3"
 /begin AXIS_DESCR COM_AXIS tco_st _CNV_A_R_LINEAR_____16_CM 8 -48. 142.5 FORMAT "%6.2" AXIS_PTS_REF ldpm_tco_st_1_extc /end AXIS_DESCR
 /begin AXIS_DESCR COM_AXIS t_ast _CNV_A_R_LINEAR_____4_CM 8 0. 6553.5 FORMAT "%6.1" AXIS_PTS_REF ldpm_t_ast_1_extc /end AXIS_DESCR
/end CHARACTERISTIC
/begin AXIS_PTS ldpm_n_32_5_extc "" 0xa1006620 n_32 _REC_AXS_20_u1 8160. _CNV_A_R_LINEAR_____9_CM 8 0. 8160. FORMAT "%4.0" /end AXIS_PTS
/begin AXIS_PTS ldpm_n_32_3_extc "" 0xa1006608 n_32 _REC_AXS_20_u1 8160. _CNV_A_R_LINEAR_____9_CM 8 0. 8160. FORMAT "%4.0" /end AXIS_PTS
/begin AXIS_PTS ldpm_tqi_req_slow_2_extc "" 0xa1006720 tqi_req_slow _REC_AXS_20_u2 1023.96875 _CNV_A_R_LINEAR_____30_CM 8 0. 1023.96875 FORMAT "%7.2" /end AXIS_PTS
/begin AXIS_PTS ldpm_tqi_req_slow_3_extc "" 0xa1006734 tqi_req_slow _REC_AXS_20_u2 1023.96875 _CNV_A_R_LINEAR_____30_CM 8 0. 1023.96875 FORMAT "%7.2" /end AXIS_PTS
/begin CHARACTERISTIC ip_cam_ch_l_hom_ex "Outlet camshaft phasing during homogeneous low load CH" MAP 0xa1006aac _REC_MAP_20_u1_u1_u2 -95.625 _CNV_A_R_LINEAR_____567_CM -40. -135.625 DISPLAY_IDENTIFIER IP_CAM_CH_L_HOM_EX FORMAT "%8.3"
 /begin AXIS_DESCR COM_AXIS n_32 _CNV_A_R_LINEAR_____9_CM 8 0. 8160. FORMAT "%4.0" AXIS_PTS_REF ldpm_n_32_5_extc /end AXIS_DESCR
 /begin AXIS_DESCR COM_AXIS tqi_req_slow _CNV_A_R_LINEAR_____30_CM 8 0. 1023.96875 FORMAT "%7.2" AXIS_PTS_REF ldpm_tqi_req_slow_2_extc /end AXIS_DESCR
/end CHARACTERISTIC
/begin CHARACTERISTIC ip_cam_ch_l_hom_in "Inlet camshaft phasing during homogenous low load CH" MAP 0xa1006aec _REC_MAP_20_u1_u1_u2 95.625 _CNV_A_R_LINEAR_____568_CM 60. 155.625 DISPLAY_IDENTIFIER IP_CAM_CH_L_HOM_IN FORMAT "%8.3"
 /begin AXIS_DESCR COM_AXIS n_32 _CNV_A_R_LINEAR_____9_CM 8 0. 8160. FORMAT "%4.0" AXIS_PTS_REF ldpm_n_32_5_extc /end AXIS_DESCR
 /begin AXIS_DESCR COM_AXIS tqi_req_slow _CNV_A_R_LINEAR_____30_CM 8 0. 1023.96875 FORMAT "%7.2" AXIS_PTS_REF ldpm_tqi_req_slow_2_extc /end AXIS_DESCR
/end CHARACTERISTIC
/begin CHARACTERISTIC ip_cam_ch_l_mplp_ex "Outlet camshaft phasing during stratified low load CH" MAP 0xa1006b2c _REC_MAP_20_u1_u1_u2 -95.625 _CNV_A_R_LINEAR_____567_CM -40. -135.625 DISPLAY_IDENTIFIER IP_CAM_CH_L_MPLP_EX FORMAT "%8.3"
 /begin AXIS_DESCR COM_AXIS n_32 _CNV_A_R_LINEAR_____9_CM 8 0. 8160. FORMAT "%4.0" AXIS_PTS_REF ldpm_n_32_5_extc /end AXIS_DESCR
 /begin AXIS_DESCR COM_AXIS tqi_req_slow _CNV_A_R_LINEAR_____30_CM 8 0. 1023.96875 FORMAT "%7.2" AXIS_PTS_REF ldpm_tqi_req_slow_2_extc /end AXIS_DESCR
/end CHARACTERISTIC
/begin CHARACTERISTIC ip_cam_ch_l_mplp_in "Inlet camshaft phasing during stratified low load CH" MAP 0xa1006b6c _REC_MAP_20_u1_u1_u2 95.625 _CNV_A_R_LINEAR_____568_CM 60. 155.625 DISPLAY_IDENTIFIER IP_CAM_CH_L_MPLP_IN FORMAT "%8.3"
 /begin AXIS_DESCR COM_AXIS n_32 _CNV_A_R_LINEAR_____9_CM 8 0. 8160. FORMAT "%4.0" AXIS_PTS_REF ldpm_n_32_5_extc /end AXIS_DESCR
 /begin AXIS_DESCR COM_AXIS tqi_req_slow _CNV_A_R_LINEAR_____30_CM 8 0. 1023.96875 FORMAT "%7.2" AXIS_PTS_REF ldpm_tqi_req_slow_2_extc /end AXIS_DESCR
/end CHARACTERISTIC
/begin CHARACTERISTIC ip_cam_ch_so2p_hom_ex "Outlet camshaft phasing during homogenous desulfation CH" MAP 0xa1006bac _REC_MAP_20_u1_u1_u2 -95.625 _CNV_A_R_LINEAR_____567_CM -40. -135.625 DISPLAY_IDENTIFIER IP_CAM_CH_SO2P_HOM_EX FORMAT "%8.3"
 /begin AXIS_DESCR COM_AXIS n_32 _CNV_A_R_LINEAR_____9_CM 8 0. 8160. FORMAT "%4.0" AXIS_PTS_REF ldpm_n_32_3_extc /end AXIS_DESCR
 /begin AXIS_DESCR COM_AXIS tqi_req_slow _CNV_A_R_LINEAR_____30_CM 8 0. 1023.96875 FORMAT "%7.2" AXIS_PTS_REF ldpm_tqi_req_slow_3_extc /end AXIS_DESCR
/end CHARACTERISTIC
/begin CHARACTERISTIC ip_cam_ch_so2p_hom_in "Inlet camshaft phasing during homogeneous desulfation CH" MAP 0xa1006bec _REC_MAP_20_u1_u1_u2 95.625 _CNV_A_R_LINEAR_____568_CM 60. 155.625 DISPLAY_IDENTIFIER IP_CAM_CH_SO2P_HOM_IN FORMAT "%8.3"
 /begin AXIS_DESCR COM_AXIS n_32 _CNV_A_R_LINEAR_____9_CM 8 0. 8160. FORMAT "%4.0" AXIS_PTS_REF ldpm_n_32_3_extc /end AXIS_DESCR
 /begin AXIS_DESCR COM_AXIS tqi_req_slow _CNV_A_R_LINEAR_____30_CM 8 0. 1023.96875 FORMAT "%7.2" AXIS_PTS_REF ldpm_tqi_req_slow_3_extc /end AXIS_DESCR
/end CHARACTERISTIC
/begin CHARACTERISTIC ip_cam_ch_so2p_mplh_ex "Outlet camshaft phasing during homogeneous split desulfation CH" MAP 0xa1006c2c _REC_MAP_20_u1_u1_u2 -95.625 _CNV_A_R_LINEAR_____567_CM -40. -135.625 DISPLAY_IDENTIFIER IP_CAM_CH_SO2P_MPLH_EX FORMAT "%8.3"
 /begin AXIS_DESCR COM_AXIS n_32 _CNV_A_R_LINEAR_____9_CM 8 0. 8160. FORMAT "%4.0" AXIS_PTS_REF ldpm_n_32_3_extc /end AXIS_DESCR
 /begin AXIS_DESCR COM_AXIS tqi_req_slow _CNV_A_R_LINEAR_____30_CM 8 0. 1023.96875 FORMAT "%7.2" AXIS_PTS_REF ldpm_tqi_req_slow_3_extc /end AXIS_DESCR
/end CHARACTERISTIC
/begin CHARACTERISTIC ip_cam_ch_so2p_mplh_in "Inlet camshaft phsing during homogeneous split desulfation CH" MAP 0xa1006c6c _REC_MAP_20_u1_u1_u2 95.625 _CNV_A_R_LINEAR_____568_CM 60. 155.625 DISPLAY_IDENTIFIER IP_CAM_CH_SO2P_MPLH_IN FORMAT "%8.3"
 /begin AXIS_DESCR COM_AXIS n_32 _CNV_A_R_LINEAR_____9_CM 8 0. 8160. FORMAT "%4.0" AXIS_PTS_REF ldpm_n_32_3_extc /end AXIS_DESCR
 /begin AXIS_DESCR COM_AXIS tqi_req_slow _CNV_A_R_LINEAR_____30_CM 8 0. 1023.96875 FORMAT "%7.2" AXIS_PTS_REF ldpm_tqi_req_slow_3_extc /end AXIS_DESCR
/end CHARACTERISTIC
/begin CHARACTERISTIC ip_fac_cam_sp_ch_ast "Factor depending " MAP 0xa1006dc4 _REC_MAP_20_u1_u1_u2 0.99609375 _CNV_A_R_LINEAR_____71_CM 0. 0.99609375 DISPLAY_IDENTIFIER IP_FAC_CAM_SP_CH_AST FORMAT "%5.3"
 /begin AXIS_DESCR COM_AXIS tco_st _CNV_A_R_LINEAR_____16_CM 6 -48. 142.5 FORMAT "%6.2" AXIS_PTS_REF ldp_tco_st_ip_fac_cam_sp_ch_ast /end AXIS_DESCR
 /begin AXIS_DESCR COM_AXIS t_ast _CNV_A_R_LINEAR_____4_CM 6 0. 6553.5 FORMAT "%6.1" AXIS_PTS_REF ldp_t_ast_ip_fac_cam_sp_ch_ast /end AXIS_DESCR
/end CHARACTERISTIC
/begin AXIS_PTS ldp_tco_st_ip_fac_cam_sp_ch_ast "" 0xa1006472 tco_st _REC_AXS_20_u1 190.5 _CNV_A_R_LINEAR_____16_CM 6 -48. 142.5 FORMAT "%6.2" /end AXIS_PTS
/begin AXIS_PTS ldp_t_ast_ip_fac_cam_sp_ch_ast "" 0xa10063c8 t_ast _REC_AXS_20_u2 6553.5 _CNV_A_R_LINEAR_____4_CM 6 0. 6553.5 FORMAT "%6.1" /end AXIS_PTS
/begin AXIS_PTS ldp_mff_post_inj_ip_fac_cam_ch "" 0xa1006288 mff_post_inj[0] _REC_AXS_20_u2 1389. _CNV_A_R_LINEAR_____108_CM 6 0. 1389. FORMAT "%7.2" /end AXIS_PTS
/begin AXIS_PTS ldp_tq_add_ch_ip_fac_cam_ch "" 0xa10064b0 tq_add_so2p _REC_AXS_20_u2 1023.96875 _CNV_A_R_LINEAR_____30_CM 6 0. 1023.96875 FORMAT "%7.2" /end AXIS_PTS
/begin CHARACTERISTIC ip_fac_cam_ch_mff_post "Interpolation factor of CH-Cam-setpoint" CURVE 0xa1006db8 _REC_CUR_20_u1_u2 0.99609375 _CNV_A_R_LINEAR_____71_CM 0. 0.99609375 DISPLAY_IDENTIFIER IP_FAC_CAM_CH_MFF_POST FORMAT "%5.3"
 /begin AXIS_DESCR COM_AXIS mff_post_inj[0] _CNV_A_R_LINEAR_____108_CM 6 0. 1389. FORMAT "%7.2" AXIS_PTS_REF ldp_mff_post_inj_ip_fac_cam_ch /end AXIS_DESCR
/end CHARACTERISTIC
/begin CHARACTERISTIC ip_fac_cam_ch_tq_add "Interpolation factor of CH-Cam-setpoints" CURVE 0xa1006dbe _REC_CUR_20_u1_u2 0.99609375 _CNV_A_R_LINEAR_____71_CM 0. 0.99609375 DISPLAY_IDENTIFIER IP_FAC_CAM_CH_TQ_ADD FORMAT "%5.3"
 /begin AXIS_DESCR COM_AXIS tq_add_so2p _CNV_A_R_LINEAR_____30_CM 6 0. 1023.96875 FORMAT "%7.2" AXIS_PTS_REF ldp_tq_add_ch_ip_fac_cam_ch /end AXIS_DESCR
/end CHARACTERISTIC
/begin MEASUREMENT iga_dif_s_ch "Ignition angle difference for stratified catalyst heating with post injection" UBYTE _CNV_A_R_LINEAR_____167_CM 1 100. -35.625 60. DISPLAY_IDENTIFIER IGA_DIF_S_CH ECU_ADDRESS 0xd0002eb1 FORMAT "%7.3" /end MEASUREMENT
/begin CHARACTERISTIC lc_iga_dif_s_ch_man_act "Activation of manual setting of ignition angle difference for stratified catalyst heating with post injection" VALUE 0xa1008107 _REC_VAL_20_u1 1. _CNV_A_R_LINEAR_____0_CM 0. 1. DISPLAY_IDENTIFIER LC_IGA_DIF_S_CH_MAN_ACT FORMAT "%1.0" /end CHARACTERISTIC
/begin CHARACTERISTIC c_iga_dif_s_ch_man "Manual setting of ignition angle difference for stratified catalyst heating with post injection" VALUE 0xa100809c _REC_VAL_20_u1 95.625 _CNV_A_R_LINEAR_____167_CM -35.625 60. DISPLAY_IDENTIFIER C_IGA_DIF_S_CH_MAN FORMAT "%7.3" /end CHARACTERISTIC
/begin AXIS_PTS ldp_mff_post_ip_iga_dif_ch_l "" 0xa1006298 online_dummy _REC_AXS_20_u2 1389. _CNV_A_R_LINEAR_____108_CM 8 0. 1389. FORMAT "%7.2" /end AXIS_PTS
/begin CHARACTERISTIC ip_iga_dif_add_mff_post_ch_l "Mass of post injection depending correction for ignition anlge difference for low load catalyst heating" CURVE 0xa1007080 _REC_CUR_20_u1_u2 95.625 _CNV_A_R_LINEAR_____167_CM -35.625 60. DISPLAY_IDENTIFIER IP_IGA_DIF_ADD_MFF_POST_CH_L FORMAT "%7.3"
 /begin AXIS_DESCR COM_AXIS online_dummy _CNV_A_R_LINEAR_____108_CM 8 0. 1389. FORMAT "%7.2" AXIS_PTS_REF ldp_mff_post_ip_iga_dif_ch_l /end AXIS_DESCR
/end CHARACTERISTIC
/begin CHARACTERISTIC ip_iga_dif_s_ch_l_bas "Ignition angle difference for stratified low load catalyst heating with post injection" MAP 0xa10070e8 _REC_MAP_20_u2_u1_u2 1440. _CNV_A_R_LINEAR_____784_CM -720. 720. DISPLAY_IDENTIFIER IP_IGA_DIF_S_CH_L_BAS FORMAT "%6.1"
 /begin AXIS_DESCR COM_AXIS n_32 _CNV_A_R_LINEAR_____9_CM 6 0. 8160. FORMAT "%4.0" AXIS_PTS_REF ldpm_n_32_6_extc /end AXIS_DESCR
 /begin AXIS_DESCR COM_AXIS mff_sp_mv _CNV_A_R_LINEAR_____108_CM 6 0. 1389. FORMAT "%7.2" AXIS_PTS_REF ldpm_mff_sp_mv_2_extc /end AXIS_DESCR
/end CHARACTERISTIC
/begin CHARACTERISTIC ip_iga_dif_s_ch_ast_bas "Ignition angle difference for stratified catalyst heating with post injection" MAP 0xa1007088 _REC_MAP_20_u2_u1_u2 1440. _CNV_A_R_LINEAR_____784_CM -720. 720. DISPLAY_IDENTIFIER IP_IGA_DIF_S_CH_AST_BAS FORMAT "%6.1"
 /begin AXIS_DESCR COM_AXIS n_32 _CNV_A_R_LINEAR_____9_CM 8 0. 8160. FORMAT "%4.0" AXIS_PTS_REF ldpm_n_32_2_extc /end AXIS_DESCR
 /begin AXIS_DESCR COM_AXIS mff_sp_mv _CNV_A_R_LINEAR_____108_CM 6 0. 1389. FORMAT "%7.2" AXIS_PTS_REF ldpm_mff_sp_mv_1_extc /end AXIS_DESCR
/end CHARACTERISTIC
/begin AXIS_PTS ldpm_mff_sp_mv_1_extc "" 0xa10065d0 mff_sp_mv _REC_AXS_20_u2 1389. _CNV_A_R_LINEAR_____108_CM 6 0. 1389. FORMAT "%7.2" /end AXIS_PTS
/begin AXIS_PTS ldpm_n_32_6_extc "" 0xa100662a n_32 _REC_AXS_20_u1 8160. _CNV_A_R_LINEAR_____9_CM 6 0. 8160. FORMAT "%4.0" /end AXIS_PTS
/begin AXIS_PTS ldpm_mff_sp_mv_2_extc "" 0xa10065e0 mff_sp_mv _REC_AXS_20_u2 1389. _CNV_A_R_LINEAR_____108_CM 6 0. 1389. FORMAT "%7.2" /end AXIS_PTS
/begin AXIS_PTS ldpm_tco_1_extc "" 0xa1006698 tco _REC_AXS_20_u1 190.5 _CNV_A_R_LINEAR_____16_CM 8 -48. 142.5 FORMAT "%6.2" /end AXIS_PTS
/begin AXIS_PTS ldpm_t_ast_5_extc "" 0xa1006684 t_ast _REC_AXS_20_u2 6553.5 _CNV_A_R_LINEAR_____4_CM 8 0. 6553.5 FORMAT "%6.1" /end AXIS_PTS
/begin CHARACTERISTIC ip_n_sp_is_ch_ast_mplh "Idle speed setpoint for homogeneous catalyst heating with dual injection" MAP 0xa1007858 _REC_MAP_20_u2_u1_u2 8160. _CNV_A_R_LINEAR_____13_CM 0. 8160. DISPLAY_IDENTIFIER IP_N_SP_IS_CH_AST_MPLH FORMAT "%4.0"
 /begin AXIS_DESCR COM_AXIS tco _CNV_A_R_LINEAR_____16_CM 8 -48. 142.5 FORMAT "%6.2" AXIS_PTS_REF ldpm_tco_1_extc /end AXIS_DESCR
 /begin AXIS_DESCR COM_AXIS t_ast _CNV_A_R_LINEAR_____4_CM 8 0. 6553.5 FORMAT "%6.1" AXIS_PTS_REF ldpm_t_ast_5_extc /end AXIS_DESCR
/end CHARACTERISTIC
/begin CHARACTERISTIC ip_n_sp_is_ch_ast_mplp "Idle speed setpoint for stratified catalyst heating with post injection" MAP 0xa1007958 _REC_MAP_20_u2_u1_u2 8160. _CNV_A_R_LINEAR_____13_CM 0. 8160. DISPLAY_IDENTIFIER IP_N_SP_IS_CH_AST_MPLP FORMAT "%4.0"
 /begin AXIS_DESCR COM_AXIS tco _CNV_A_R_LINEAR_____16_CM 8 -48. 142.5 FORMAT "%6.2" AXIS_PTS_REF ldpm_tco_1_extc /end AXIS_DESCR
 /begin AXIS_DESCR COM_AXIS t_ast _CNV_A_R_LINEAR_____4_CM 8 0. 6553.5 FORMAT "%6.1" AXIS_PTS_REF ldpm_t_ast_5_extc /end AXIS_DESCR
/end CHARACTERISTIC
/begin MEASUREMENT n_sp_is_ch "Idle speed setpoint for catalyst heating" UWORD _CNV_A_R_LINEAR_____13_CM 1 100. 0. 8160. DISPLAY_IDENTIFIER N_SP_IS_CH ECU_ADDRESS 0xd000270e FORMAT "%4.0" /end MEASUREMENT
/begin CHARACTERISTIC ip_n_sp_is_ch_ast_hom "Idle speed setpoint for homogeneous catalyst heating" MAP 0xa1007758 _REC_MAP_20_u2_u1_u2 8160. _CNV_A_R_LINEAR_____13_CM 0. 8160. DISPLAY_IDENTIFIER IP_N_SP_IS_CH_AST_HOM FORMAT "%4.0"
 /begin AXIS_DESCR COM_AXIS tco _CNV_A_R_LINEAR_____16_CM 8 -48. 142.5 FORMAT "%6.2" AXIS_PTS_REF ldpm_tco_1_extc /end AXIS_DESCR
 /begin AXIS_DESCR COM_AXIS t_ast _CNV_A_R_LINEAR_____4_CM 8 0. 6553.5 FORMAT "%6.1" AXIS_PTS_REF ldpm_t_ast_5_extc /end AXIS_DESCR
/end CHARACTERISTIC
/begin CHARACTERISTIC ip_n_sp_is_ch_l_hom "Idle speed setpoint for homogeneous low load CH" MAP 0xa1007a58 _REC_MAP_20_u2_u2_u2 8160. _CNV_A_R_LINEAR_____13_CM 0. 8160. DISPLAY_IDENTIFIER IP_N_SP_IS_CH_L_HOM FORMAT "%4.0"
 /begin AXIS_DESCR COM_AXIS temp_cat_dif_ch_l _CNV_A_R_EXTC_LINEA_778_CM 8 -1056. 991.96875 FORMAT "%11.5" AXIS_PTS_REF ldpm_temp_cat_dif_ch_l_1_extc /end AXIS_DESCR
 /begin AXIS_DESCR COM_AXIS tnt_dif_ch_l _CNV_A_R_LINEAR_____779_CM 8 -1024. 1023.96875 FORMAT "%11.5" AXIS_PTS_REF ldpm_tnt_dif_ch_l_1_extc /end AXIS_DESCR
/end CHARACTERISTIC
/begin CHARACTERISTIC ip_n_sp_is_ch_l_s "Idle speed setpoint for stratified low load CH" MAP 0xa1007ad8 _REC_MAP_20_u2_u2_u2 8160. _CNV_A_R_LINEAR_____13_CM 0. 8160. DISPLAY_IDENTIFIER IP_N_SP_IS_CH_L_S FORMAT "%4.0"
 /begin AXIS_DESCR COM_AXIS temp_cat_dif_ch_l _CNV_A_R_EXTC_LINEA_778_CM 8 -1056. 991.96875 FORMAT "%11.5" AXIS_PTS_REF ldpm_temp_cat_dif_ch_l_1_extc /end AXIS_DESCR
 /begin AXIS_DESCR COM_AXIS tnt_dif_ch_l _CNV_A_R_LINEAR_____779_CM 8 -1024. 1023.96875 FORMAT "%11.5" AXIS_PTS_REF ldpm_tnt_dif_ch_l_1_extc /end AXIS_DESCR
/end CHARACTERISTIC
/begin CHARACTERISTIC ip_n_sp_is_ch_ast_hom_dri "Idle speed setpoint for homogeneous catalyst heating, engaged gear" MAP 0xa10077d8 _REC_MAP_20_u2_u1_u2 8160. _CNV_A_R_LINEAR_____13_CM 0. 8160. DISPLAY_IDENTIFIER IP_N_SP_IS_CH_AST_HOM_DRI FORMAT "%4.0"
 /begin AXIS_DESCR COM_AXIS tco _CNV_A_R_LINEAR_____16_CM 8 -48. 142.5 FORMAT "%6.2" AXIS_PTS_REF ldpm_tco_1_extc /end AXIS_DESCR
 /begin AXIS_DESCR COM_AXIS t_ast _CNV_A_R_LINEAR_____4_CM 8 0. 6553.5 FORMAT "%6.1" AXIS_PTS_REF ldpm_t_ast_5_extc /end AXIS_DESCR
/end CHARACTERISTIC
/begin CHARACTERISTIC ip_n_sp_is_ch_ast_mplh_dri "Idle speed setpoint for homogeneous catalyst heating with multiple injection, engaged gear" MAP 0xa10078d8 _REC_MAP_20_u2_u1_u2 8160. _CNV_A_R_LINEAR_____13_CM 0. 8160. DISPLAY_IDENTIFIER IP_N_SP_IS_CH_AST_MPLH_DRI FORMAT "%4.0"
 /begin AXIS_DESCR COM_AXIS tco _CNV_A_R_LINEAR_____16_CM 8 -48. 142.5 FORMAT "%6.2" AXIS_PTS_REF ldpm_tco_1_extc /end AXIS_DESCR
 /begin AXIS_DESCR COM_AXIS t_ast _CNV_A_R_LINEAR_____4_CM 8 0. 6553.5 FORMAT "%6.1" AXIS_PTS_REF ldpm_t_ast_5_extc /end AXIS_DESCR
/end CHARACTERISTIC
/begin CHARACTERISTIC ip_n_sp_is_ch_ast_mplp_dri "Idle speed setpoint for stratified catalyst heating with post injection, engaged gear" MAP 0xa10079d8 _REC_MAP_20_u2_u1_u2 8160. _CNV_A_R_LINEAR_____13_CM 0. 8160. DISPLAY_IDENTIFIER IP_N_SP_IS_CH_AST_MPLP_DRI FORMAT "%4.0"
 /begin AXIS_DESCR COM_AXIS tco _CNV_A_R_LINEAR_____16_CM 8 -48. 142.5 FORMAT "%6.2" AXIS_PTS_REF ldpm_tco_1_extc /end AXIS_DESCR
 /begin AXIS_DESCR COM_AXIS t_ast _CNV_A_R_LINEAR_____4_CM 8 0. 6553.5 FORMAT "%6.1" AXIS_PTS_REF ldpm_t_ast_5_extc /end AXIS_DESCR
/end CHARACTERISTIC
/begin CHARACTERISTIC lc_dri_act_mt "Usage of gear dependency of N_SP_IS_CH maps for manual transmision" VALUE 0xa1008105 _REC_VAL_20_u1 1. _CNV_S_2_RANGE__0___1_CM 0. 1. DISPLAY_IDENTIFIER LC_DRI_ACT_MT /end CHARACTERISTIC
/begin AXIS_PTS ldp_tqi_req_slow_ip_lamb_hom_is "" 0xa100654c tqi_req_slow _REC_AXS_20_u2 2047.96875 _CNV_A_R_LINEAR_____65_CM 8 -1024. 1023.96875 FORMAT "%11.5" /end AXIS_PTS
/begin AXIS_PTS ldp_n_32_ip_lamb_ch_hom_dui_is "" 0xa1006328 n_32 _REC_AXS_20_u1 8160. _CNV_A_R_LINEAR_____9_CM 8 0. 8160. FORMAT "%4.0" /end AXIS_PTS
/begin AXIS_PTS ldp_tqi_req_slow_ip_lamb_hom "" 0xa1006538 tqi_req_slow _REC_AXS_20_u2 2047.96875 _CNV_A_R_LINEAR_____65_CM 8 -1024. 1023.96875 FORMAT "%11.5" /end AXIS_PTS
/begin MEASUREMENT lamb_sp_ch[0] "Lambda setpoint for catalyst heating - bankselective" UWORD _CNV_A_R_LINEAR_____122_CM 1 100. 0. 31.9990234375 DISPLAY_IDENTIFIER LAMB_SP_CH[0] ECU_ADDRESS 0xd00026f4 FORMAT "%7.4" /end MEASUREMENT
/begin MEASUREMENT lamb_sp_ch[1] "Lambda setpoint for catalyst heating - bankselective" UWORD _CNV_A_R_LINEAR_____122_CM 1 100. 0. 31.9990234375 DISPLAY_IDENTIFIER LAMB_SP_CH[1] ECU_ADDRESS 0xd00026f6 FORMAT "%7.4" /end MEASUREMENT
/begin CHARACTERISTIC ip_lamb_ch_ast_hom "Lambda setpoint for homogeneous catalyst heating" MAP 0xa1007230 _REC_MAP_20_u2_u1_u2 31.9990234375 _CNV_A_R_LINEAR_____122_CM 0. 31.9990234375 DISPLAY_IDENTIFIER IP_LAMB_CH_AST_HOM FORMAT "%7.4"
 /begin AXIS_DESCR COM_AXIS n_32 _CNV_A_R_LINEAR_____9_CM 8 0. 8160. FORMAT "%4.0" AXIS_PTS_REF ldp_n_32_ip_lamb_ch_ast_hom /end AXIS_DESCR
 /begin AXIS_DESCR COM_AXIS tqi_req_slow _CNV_A_R_LINEAR_____65_CM 8 -1024. 1023.96875 FORMAT "%11.5" AXIS_PTS_REF ldp_tqi_req_slow_ip_lamb_hom /end AXIS_DESCR
/end CHARACTERISTIC
/begin AXIS_PTS ldp_n_32_ip_lamb_ch_ast_hom "" 0xa1006310 n_32 _REC_AXS_20_u1 8160. _CNV_A_R_LINEAR_____9_CM 8 0. 8160. FORMAT "%4.0" /end AXIS_PTS
/begin CHARACTERISTIC ip_lamb_ch_ast_hom_is "Lambda setpoint for homogeneous catalyst heating in idle speed" MAP 0xa10072b0 _REC_MAP_20_u2_u1_u2 31.9990234375 _CNV_A_R_LINEAR_____122_CM 0. 31.9990234375 DISPLAY_IDENTIFIER IP_LAMB_CH_AST_HOM_IS FORMAT "%7.4"
 /begin AXIS_DESCR COM_AXIS n_32 _CNV_A_R_LINEAR_____9_CM 8 0. 8160. FORMAT "%4.0" AXIS_PTS_REF ldp_n_32_ip_lamb_ch_ast_mplh_is /end AXIS_DESCR
 /begin AXIS_DESCR COM_AXIS tqi_req_slow _CNV_A_R_LINEAR_____65_CM 8 -1024. 1023.96875 FORMAT "%11.5" AXIS_PTS_REF ldp_tqi_req_slow_ip_lamb_hom_is /end AXIS_DESCR
/end CHARACTERISTIC
/begin CHARACTERISTIC ip_lamb_add_ch_ast_hom "T_AST and TCO depending additional correction for lambda setpoint for catalyst heating" MAP 0xa1007130 _REC_MAP_20_u2_u2_u1 31.9990234375 _CNV_A_R_LINEAR_____122_CM 0. 31.9990234375 DISPLAY_IDENTIFIER IP_LAMB_ADD_CH_AST_HOM FORMAT "%7.4"
 /begin AXIS_DESCR COM_AXIS t_ast _CNV_A_R_LINEAR_____4_CM 8 0. 6553.5 FORMAT "%6.1" AXIS_PTS_REF ldp_t_ast_ip_lamb_add_hom /end AXIS_DESCR
 /begin AXIS_DESCR COM_AXIS tco _CNV_A_R_LINEAR_____16_CM 8 -48. 142.5 FORMAT "%6.2" AXIS_PTS_REF ldp_tco_ip_lamb_add_hom /end AXIS_DESCR
/end CHARACTERISTIC
/begin AXIS_PTS ldp_t_ast_ip_lamb_add_hom "" 0xa1006410 t_ast _REC_AXS_20_u2 6553.5 _CNV_A_R_LINEAR_____4_CM 8 0. 6553.5 FORMAT "%6.1" /end AXIS_PTS
/begin AXIS_PTS ldp_tco_ip_lamb_add_hom "" 0xa1006444 tco _REC_AXS_20_u1 190.5 _CNV_A_R_LINEAR_____16_CM 8 -48. 142.5 FORMAT "%6.2" /end AXIS_PTS
/begin CHARACTERISTIC ip_lamb_add_ch_ast_mplh "T_AST and TCO depending additional correction for lambda setpoint for catalyst heating with dual injection" MAP 0xa10071b0 _REC_MAP_20_u2_u2_u1 31.9990234375 _CNV_A_R_LINEAR_____122_CM 0. 31.9990234375 DISPLAY_IDENTIFIER IP_LAMB_ADD_CH_AST_MPLH FORMAT "%7.4"
 /begin AXIS_DESCR COM_AXIS t_ast _CNV_A_R_LINEAR_____4_CM 8 0. 6553.5 FORMAT "%6.1" AXIS_PTS_REF ldp_t_ast_ip_lamb_add_mplh /end AXIS_DESCR
 /begin AXIS_DESCR COM_AXIS tco _CNV_A_R_LINEAR_____16_CM 8 -48. 142.5 FORMAT "%6.2" AXIS_PTS_REF ldp_tco_ip_lamb_add_mplh /end AXIS_DESCR
/end CHARACTERISTIC
/begin AXIS_PTS ldp_t_ast_ip_lamb_add_mplh "" 0xa1006424 t_ast _REC_AXS_20_u2 6553.5 _CNV_A_R_LINEAR_____4_CM 8 0. 6553.5 FORMAT "%6.1" /end AXIS_PTS
/begin AXIS_PTS ldp_tco_ip_lamb_add_mplh "" 0xa1006450 tco _REC_AXS_20_u1 190.5 _CNV_A_R_LINEAR_____16_CM 8 -48. 142.5 FORMAT "%6.2" /end AXIS_PTS
/begin AXIS_PTS ldp_n_32_ip_lamb_ch_mplh "" 0xa1006334 n_32 _REC_AXS_20_u1 8160. _CNV_A_R_LINEAR_____9_CM 8 0. 8160. FORMAT "%4.0" /end AXIS_PTS
/begin AXIS_PTS ldp_tqi_req_slow_ip_lamb_mplh "" 0xa1006560 tqi_req_slow _REC_AXS_20_u2 2047.96875 _CNV_A_R_LINEAR_____65_CM 8 -1024. 1023.96875 FORMAT "%11.5" /end AXIS_PTS
/begin CHARACTERISTIC ip_lamb_ch_ast_mplh_is "Lambda setpoint for homogeneous catalyst heating with dual injection in idle speed" MAP 0xa10073b0 _REC_MAP_20_u2_u1_u2 31.9990234375 _CNV_A_R_LINEAR_____122_CM 0. 31.9990234375 DISPLAY_IDENTIFIER IP_LAMB_CH_AST_MPLH_IS FORMAT "%7.4"
 /begin AXIS_DESCR COM_AXIS n_32 _CNV_A_R_LINEAR_____9_CM 8 0. 8160. FORMAT "%4.0" AXIS_PTS_REF ldp_n_32_ip_lamb_ch_hom_dui_is /end AXIS_DESCR
 /begin AXIS_DESCR COM_AXIS tqi_req_slow _CNV_A_R_LINEAR_____65_CM 8 -1024. 1023.96875 FORMAT "%11.5" AXIS_PTS_REF ldp_tqi_slow_ip_lamb_mplh_is /end AXIS_DESCR
/end CHARACTERISTIC
/begin AXIS_PTS ldp_n_32_ip_lamb_ch_ast_mplh_is "" 0xa100631c n_32 _REC_AXS_20_u1 8160. _CNV_A_R_LINEAR_____9_CM 8 0. 8160. FORMAT "%4.0" /end AXIS_PTS
/begin AXIS_PTS ldp_tqi_slow_ip_lamb_mplh_is "" 0xa1006594 tqi_req_slow _REC_AXS_20_u2 2047.96875 _CNV_A_R_LINEAR_____65_CM 8 -1024. 1023.96875 FORMAT "%11.5" /end AXIS_PTS
/begin AXIS_PTS ldpm_tnt_dif_ch_so2p_1_extc "" 0xa10066fc tnt_dif_ch_so2p _REC_AXS_20_u2 2047.96875 _CNV_A_R_LINEAR_____779_CM 6 -1024. 1023.96875 FORMAT "%11.5" /end AXIS_PTS
/begin CHARACTERISTIC ip_fac_lamb_ch_so2p_tnt_dif "Lambda setpoint for homogeneous split desulfation catalyst heating" CURVE 0xa1006e20 _REC_CUR_20_u2_u2 1. _CNV_A_R_LINEAR_____122_CM 0. 1. DISPLAY_IDENTIFIER IP_FAC_LAMB_CH_SO2P_TNT_DIF FORMAT "%6.4"
 /begin AXIS_DESCR COM_AXIS tnt_dif_ch_so2p _CNV_A_R_LINEAR_____779_CM 6 -1024. 1023.96875 FORMAT "%11.5" AXIS_PTS_REF ldpm_tnt_dif_ch_so2p_1_extc /end AXIS_DESCR
/end CHARACTERISTIC
/begin AXIS_PTS ldpm_tqi_req_slow_1_extc "" 0xa100670c tqi_req_slow _REC_AXS_20_u2 1023.96875 _CNV_A_R_LINEAR_____30_CM 8 0. 1023.96875 FORMAT "%7.2" /end AXIS_PTS
/begin CHARACTERISTIC ip_lamb_ch_so2p_hom "Lambda setpoint for homogeneous desulfation catalyst heating" MAP 0xa1007430 _REC_MAP_20_u2_u1_u2 31.9990234 _CNV_A_R_LINEAR_____785_CM 0. 31.9990234 DISPLAY_IDENTIFIER IP_LAMB_CH_SO2P_HOM FORMAT "%10.7"
 /begin AXIS_DESCR COM_AXIS n_32 _CNV_A_R_LINEAR_____9_CM 8 0. 8160. FORMAT "%4.0" AXIS_PTS_REF ldpm_n_32_4_extc /end AXIS_DESCR
 /begin AXIS_DESCR COM_AXIS tqi_req_slow _CNV_A_R_LINEAR_____30_CM 8 0. 1023.96875 FORMAT "%7.2" AXIS_PTS_REF ldpm_tqi_req_slow_1_extc /end AXIS_DESCR
/end CHARACTERISTIC
/begin CHARACTERISTIC ip_lamb_ch_so2p_mplh "Lambda setpoint for homogeneous split desulfation catalyst heating" MAP 0xa10074b0 _REC_MAP_20_u2_u1_u2 31.9990234 _CNV_A_R_LINEAR_____785_CM 0. 31.9990234 DISPLAY_IDENTIFIER IP_LAMB_CH_SO2P_MPLH FORMAT "%10.7"
 /begin AXIS_DESCR COM_AXIS n_32 _CNV_A_R_LINEAR_____9_CM 8 0. 8160. FORMAT "%4.0" AXIS_PTS_REF ldpm_n_32_4_extc /end AXIS_DESCR
 /begin AXIS_DESCR COM_AXIS tqi_req_slow _CNV_A_R_LINEAR_____30_CM 8 0. 1023.96875 FORMAT "%7.2" AXIS_PTS_REF ldpm_tqi_req_slow_1_extc /end AXIS_DESCR
/end CHARACTERISTIC
/begin CHARACTERISTIC ip_lamb_ch_ast_mplh "Lambda setpoint for homogeneous catalyst heating with dual injection" MAP 0xa1007330 _REC_MAP_20_u2_u1_u2 31.9990234375 _CNV_A_R_LINEAR_____122_CM 0. 31.9990234375 DISPLAY_IDENTIFIER IP_LAMB_CH_AST_MPLH FORMAT "%7.4"
 /begin AXIS_DESCR COM_AXIS n_32 _CNV_A_R_LINEAR_____9_CM 8 0. 8160. FORMAT "%4.0" AXIS_PTS_REF ldp_n_32_ip_lamb_ch_mplh /end AXIS_DESCR
 /begin AXIS_DESCR COM_AXIS tqi_req_slow _CNV_A_R_LINEAR_____65_CM 8 -1024. 1023.96875 FORMAT "%11.5" AXIS_PTS_REF ldp_tqi_req_slow_ip_lamb_mplh /end AXIS_DESCR
/end CHARACTERISTIC
/begin MEASUREMENT lamb_sp_ch_so2p[0] "Lambda setpoint for catalyst heating   bankselective, during desulfation" UWORD _CNV_A_R_LINEAR_____122_CM 1 100. 0. 31.9990234375 DISPLAY_IDENTIFIER LAMB_SP_CH_SO2P[0] ECU_ADDRESS 0xd00026f8 FORMAT "%7.4" /end MEASUREMENT
/begin MEASUREMENT lamb_sp_ch_so2p[1] "Lambda setpoint for catalyst heating   bankselective, during desulfation" UWORD _CNV_A_R_LINEAR_____122_CM 1 100. 0. 31.9990234375 DISPLAY_IDENTIFIER LAMB_SP_CH_SO2P[1] ECU_ADDRESS 0xd00026fa FORMAT "%7.4" /end MEASUREMENT
/begin CHARACTERISTIC c_lamb_sp_ch_man[0] "manual setting of lambda setpoint for catalyst heating   bankselective" VALUE 0xa100809e _REC_VAL_20_u2 31.9990234375 _CNV_A_R_LINEAR_____122_CM 0. 31.9990234375 DISPLAY_IDENTIFIER C_LAMB_SP_CH_MAN[0] FORMAT "%7.4" /end CHARACTERISTIC
/begin CHARACTERISTIC c_lamb_sp_ch_man[1] "manual setting of lambda setpoint for catalyst heating   bankselective" VALUE 0xa10080a0 _REC_VAL_20_u2 31.9990234375 _CNV_A_R_LINEAR_____122_CM 0. 31.9990234375 DISPLAY_IDENTIFIER C_LAMB_SP_CH_MAN[1] FORMAT "%7.4" /end CHARACTERISTIC
/begin CHARACTERISTIC lc_lamb_sp_ch_man_act "Activation of manual setting of LAMB_SP_CH" VALUE 0xa100810a _REC_VAL_20_u1 1. _CNV_S_2_RANGE__0___1_CM 0. 1. DISPLAY_IDENTIFIER LC_LAMB_SP_CH_MAN_ACT /end CHARACTERISTIC
/begin CHARACTERISTIC lc_lamb_sp_ch_so2p_man_act "Activation of manual setting of LAMB_SP_CH_SO2P" VALUE 0xa100810b _REC_VAL_20_u1 1. _CNV_S_2_RANGE__0___1_CM 0. 1. DISPLAY_IDENTIFIER LC_LAMB_SP_CH_SO2P_MAN_ACT /end CHARACTERISTIC
/begin CHARACTERISTIC lc_lamb_so2p_fast_ena "Enables using of LAMB_SO2P in case of LV_SO2P_FAST_REQ (fast desulfation without wobble)" VALUE 0xa1008109 _REC_VAL_20_u1 1. _CNV_S_2_RANGE__0___1_CM 0. 1. DISPLAY_IDENTIFIER LC_LAMB_SO2P_FAST_ENA /end CHARACTERISTIC
/begin CHARACTERISTIC ip_mff_sp_2_add_iga_ch "Ignition angle depending correction of fuel mass for second injection pulse" CURVE 0xa1007648 _REC_CUR_20_u2_u2 1389. _CNV_A_R_LINEAR_____108_CM 0. 1389. DISPLAY_IDENTIFIER IP_MFF_SP_2_ADD_IGA_CH FORMAT "%7.2"
 /begin AXIS_DESCR COM_AXIS iga_av_mv_h_rng _CNV_A_R_LINEAR_____170_CM 8 -90. 90. FORMAT "%8.4" AXIS_PTS_REF ldp_iga_h_rng_ip_mff_2_mplh_ch /end AXIS_DESCR
/end CHARACTERISTIC
/begin AXIS_PTS ldpm_n_32_1_extc "" 0xa10065f0 n_32 _REC_AXS_20_u1 8160. _CNV_A_R_LINEAR_____9_CM 8 0. 8160. FORMAT "%4.0" /end AXIS_PTS
/begin AXIS_PTS ldpm_maf_1_extc "" 0xa10065a8 maf _REC_AXS_20_u2 1389. _CNV_A_R_LINEAR_____108_CM 8 0. 1389. FORMAT "%7.2" /end AXIS_PTS
/begin MEASUREMENT mff_sp_2_mplh_ch "Fuel mass for second injection pulse" UWORD _CNV_A_R_LINEAR_____108_CM 1 100. 0. 1389. DISPLAY_IDENTIFIER MFF_SP_2_MPLH_CH ECU_ADDRESS 0xd000270c FORMAT "%7.2" /end MEASUREMENT
/begin CHARACTERISTIC c_mff_sp_2_mplh_ch_man "Manual setting of fuel mass for second injection pulse" VALUE 0xa10080ac _REC_VAL_20_u2 1389. _CNV_A_R_LINEAR_____108_CM 0. 1389. DISPLAY_IDENTIFIER C_MFF_SP_2_MPLH_CH_MAN FORMAT "%7.2" /end CHARACTERISTIC
/begin CHARACTERISTIC lc_mff_sp_2_mplh_ch_man_act "Activation of manual setting of fuel mass for second injection pulse" VALUE 0xa100810e _REC_VAL_20_u1 1. _CNV_S_2_RANGE__0___1_CM 0. 1. DISPLAY_IDENTIFIER LC_MFF_SP_2_MPLH_CH_MAN_ACT /end CHARACTERISTIC
/begin CHARACTERISTIC ip_mff_sp_2_mplh_ch_ast "Basic fuel mass for second injection pulse" MAP 0xa1007658 _REC_MAP_20_u2_u1_u2 1389. _CNV_A_R_LINEAR_____108_CM 0. 1389. DISPLAY_IDENTIFIER IP_MFF_SP_2_MPLH_CH_AST FORMAT "%7.2"
 /begin AXIS_DESCR COM_AXIS n_32 _CNV_A_R_LINEAR_____9_CM 8 0. 8160. FORMAT "%4.0" AXIS_PTS_REF ldpm_n_32_1_extc /end AXIS_DESCR
 /begin AXIS_DESCR COM_AXIS maf _CNV_A_R_LINEAR_____108_CM 8 0. 1389. FORMAT "%7.2" AXIS_PTS_REF ldpm_maf_1_extc /end AXIS_DESCR
/end CHARACTERISTIC
/begin CHARACTERISTIC ip_mff_sp_2_mplh_ch_so2p "Fuel mass for second injection pulse in desulfation catalyst heating" MAP 0xa10076d8 _REC_MAP_20_u2_u1_u2 1389. _CNV_A_R_LINEAR_____108_CM 0. 1389. DISPLAY_IDENTIFIER IP_MFF_SP_2_MPLH_CH_SO2P FORMAT "%7.2"
 /begin AXIS_DESCR COM_AXIS n_32 _CNV_A_R_LINEAR_____9_CM 8 0. 8160. FORMAT "%4.0" AXIS_PTS_REF ldpm_n_32_4_extc /end AXIS_DESCR
 /begin AXIS_DESCR COM_AXIS maf _CNV_A_R_LINEAR_____108_CM 8 0. 1389. FORMAT "%7.2" AXIS_PTS_REF ldpm_maf_2_extc /end AXIS_DESCR
/end CHARACTERISTIC
/begin AXIS_PTS ldp_iga_h_rng_ip_mff_2_mplh_ch "Ignition angle depending correction of fuel mass for second injection pulse" 0xa10061f0 iga_av_mv_h_rng _REC_AXS_20_u2 180. _CNV_A_R_LINEAR_____170_CM 8 -90. 90. FORMAT "%8.4" /end AXIS_PTS
/begin MEASUREMENT mff_mplp_ch "Fuel mass for post injection" UWORD _CNV_A_R_LINEAR_____108_CM 1 100. 0. 1389. DISPLAY_IDENTIFIER MFF_MPLP_CH ECU_ADDRESS 0xd00026fe FORMAT "%7.2" /end MEASUREMENT
/begin MEASUREMENT lamb_cmb_s "" UWORD _CNV_A_R_LINEAR_____243_CM 1 100. 0. 31.99951171875 DISPLAY_IDENTIFIER LAMB_CMB_S ECU_ADDRESS 0xd00026f2 FORMAT "%9.6" /end MEASUREMENT
/begin MEASUREMENT ti_post_inj[0] "Injection time of the post injection" UWORD _CNV_A_R_LINEAR_____233_CM 1 100. 0. 65.535 DISPLAY_IDENTIFIER TI_POST_INJ[0] ECU_ADDRESS 0xd0002730 /end MEASUREMENT
/begin MEASUREMENT ti_post_inj[1] "Injection time of the post injection" UWORD _CNV_A_R_LINEAR_____233_CM 1 100. 0. 65.535 DISPLAY_IDENTIFIER TI_POST_INJ[1] ECU_ADDRESS 0xd0002732 /end MEASUREMENT
/begin MEASUREMENT ti_post_inj[2] "Injection time of the post injection" UWORD _CNV_A_R_LINEAR_____233_CM 1 100. 0. 65.535 DISPLAY_IDENTIFIER TI_POST_INJ[2] ECU_ADDRESS 0xd0002734 /end MEASUREMENT
/begin MEASUREMENT ti_post_inj[3] "Injection time of the post injection" UWORD _CNV_A_R_LINEAR_____233_CM 1 100. 0. 65.535 DISPLAY_IDENTIFIER TI_POST_INJ[3] ECU_ADDRESS 0xd0002736 /end MEASUREMENT
/begin MEASUREMENT ti_post_inj[4] "Injection time of the post injection" UWORD _CNV_A_R_LINEAR_____233_CM 1 100. 0. 65.535 DISPLAY_IDENTIFIER TI_POST_INJ[4] ECU_ADDRESS 0xd0002738 /end MEASUREMENT
/begin MEASUREMENT ti_post_inj[5] "Injection time of the post injection" UWORD _CNV_A_R_LINEAR_____233_CM 1 100. 0. 65.535 DISPLAY_IDENTIFIER TI_POST_INJ[5] ECU_ADDRESS 0xd000273a /end MEASUREMENT
/begin MEASUREMENT mff_post_inj[0] "Mass fuel flow of the post injection" UWORD _CNV_A_R_LINEAR_____108_CM 1 100. 0. 1389. DISPLAY_IDENTIFIER MFF_POST_INJ[0] ECU_ADDRESS 0xd0002700 FORMAT "%7.2" /end MEASUREMENT
/begin MEASUREMENT mff_post_inj[1] "Mass fuel flow of the post injection" UWORD _CNV_A_R_LINEAR_____108_CM 1 100. 0. 1389. DISPLAY_IDENTIFIER MFF_POST_INJ[1] ECU_ADDRESS 0xd0002702 FORMAT "%7.2" /end MEASUREMENT
/begin MEASUREMENT mff_post_inj[2] "Mass fuel flow of the post injection" UWORD _CNV_A_R_LINEAR_____108_CM 1 100. 0. 1389. DISPLAY_IDENTIFIER MFF_POST_INJ[2] ECU_ADDRESS 0xd0002704 FORMAT "%7.2" /end MEASUREMENT
/begin MEASUREMENT mff_post_inj[3] "Mass fuel flow of the post injection" UWORD _CNV_A_R_LINEAR_____108_CM 1 100. 0. 1389. DISPLAY_IDENTIFIER MFF_POST_INJ[3] ECU_ADDRESS 0xd0002706 FORMAT "%7.2" /end MEASUREMENT
/begin MEASUREMENT mff_post_inj[4] "Mass fuel flow of the post injection" UWORD _CNV_A_R_LINEAR_____108_CM 1 100. 0. 1389. DISPLAY_IDENTIFIER MFF_POST_INJ[4] ECU_ADDRESS 0xd0002708 FORMAT "%7.2" /end MEASUREMENT
/begin MEASUREMENT mff_post_inj[5] "Mass fuel flow of the post injection" UWORD _CNV_A_R_LINEAR_____108_CM 1 100. 0. 1389. DISPLAY_IDENTIFIER MFF_POST_INJ[5] ECU_ADDRESS 0xd000270a FORMAT "%7.2" /end MEASUREMENT
/begin MEASUREMENT lv_post_inj_act "Boolean variable indicating the post injection is active" UBYTE _CNV_S_2_RANGE__0___1_CM 1 100. 0. 1. DISPLAY_IDENTIFIER LV_POST_INJ_ACT ECU_ADDRESS 0xd0002eb9 BIT_MASK 0x1 /end MEASUREMENT
/begin MEASUREMENT lv_iv_post_egy_rng "Boolean variable indicating used energy range" UBYTE _CNV_S_2_RANGE__0___1_CM 1 100. 0. 1. DISPLAY_IDENTIFIER LV_IV_POST_EGY_RNG ECU_ADDRESS 0xd0002eb8 BIT_MASK 0x1 /end MEASUREMENT
/begin CHARACTERISTIC c_fup_cor_post_inj "Manula additive correction factor for injector pressure difference at post injection" VALUE 0xa1008098 _REC_VAL_20_u2 347776. _CNV_A_R_LINEAR_____152_CM 0. 347776. DISPLAY_IDENTIFIER C_FUP_COR_POST_INJ FORMAT "%8.1" /end CHARACTERISTIC
/begin AXIS_PTS ldp_n_32_ip_fac_mff_mplp_ch_ast "" 0xa1006300 n_32 _REC_AXS_20_u1 8160. _CNV_A_R_LINEAR_____9_CM 6 0. 8160. FORMAT "%4.0" /end AXIS_PTS
/begin CHARACTERISTIC ip_fac_mff_mplp_ch_ast "Correction factor for TCO and CYC_CAST for the mass fuel flow of the post injection" MAP 0xa1006e2c _REC_MAP_20_u2_u1_u2 1.99996948242188 _CNV_A_R_LINEAR_____8_CM 0. 1.99996948242188 DISPLAY_IDENTIFIER IP_FAC_MFF_MPLP_CH_AST FORMAT "%7.5"
 /begin AXIS_DESCR COM_AXIS tco _CNV_A_R_LINEAR_____16_CM 8 -48. 142.5 FORMAT "%5.1" AXIS_PTS_REF ldp_tco_ip_fac_mff_mplp_ch_ast /end AXIS_DESCR
 /begin AXIS_DESCR COM_AXIS cyc_cast _CNV_A_R_LINEAR_____0_CM 8 0. 65535. FORMAT "%5.0" AXIS_PTS_REF ldp_cyc_cast_ip_fac_mff_mplp_ch /end AXIS_DESCR
/end CHARACTERISTIC
/begin AXIS_PTS ldp_tco_ip_fac_mff_mplp_ch_ast "" 0xa1006438 tco _REC_AXS_20_u1 190.5 _CNV_A_R_LINEAR_____16_CM 8 -48. 142.5 FORMAT "%5.1" /end AXIS_PTS
/begin AXIS_PTS ldp_cyc_cast_ip_fac_mff_mplp_ch "" 0xa10061d0 cyc_cast _REC_AXS_20_u2 65535. _CNV_A_R_LINEAR_____0_CM 8 0. 65535. FORMAT "%5.0" /end AXIS_PTS
/begin CHARACTERISTIC c_maf_fac_post_inj "Constant for stoichiometric air/ fuel ratio (=14.7)" VALUE 0xa10080a4 _REC_VAL_20_u2 31.99951171875 _CNV_A_R_LINEAR_____243_CM 0. 31.99951171875 DISPLAY_IDENTIFIER C_MAF_FAC_POST_INJ FORMAT "%9.6" /end CHARACTERISTIC
/begin CHARACTERISTIC c_mff_mplp_ch_lgrd_off "limitation gradient for MFF_MPLP_CH at ending of catalyst heating after start" VALUE 0xa10080a6 _REC_VAL_20_u2 1389. _CNV_A_R_LINEAR_____108_CM 0. 1389. DISPLAY_IDENTIFIER C_MFF_MPLP_CH_LGRD_OFF FORMAT "%7.2" /end CHARACTERISTIC
/begin CHARACTERISTIC c_mff_mplp_ch_lgrd_on "limitation gradient for MFF_MPLP_CH at beginning of catalyst heating after start" VALUE 0xa10080a8 _REC_VAL_20_u2 1389. _CNV_A_R_LINEAR_____108_CM 0. 1389. DISPLAY_IDENTIFIER C_MFF_MPLP_CH_LGRD_ON FORMAT "%7.2" /end CHARACTERISTIC
/begin CHARACTERISTIC lc_iv_post_egy_rng "Switch to select energy range" VALUE 0xa1008108 _REC_VAL_20_u1 1. _CNV_A_R_LINEAR_____0_CM 0. 1. DISPLAY_IDENTIFIER LC_IV_POST_EGY_RNG FORMAT "%2.0" /end CHARACTERISTIC
/begin CHARACTERISTIC ip_fac_cor_post_inj "Engine speed correction factor for the mass fuel flow of the post injection" CURVE 0xa1006dfc _REC_CUR_20_u2_u1 1.99996948242188 _CNV_A_R_LINEAR_____8_CM 0. 1.99996948242188 DISPLAY_IDENTIFIER IP_FAC_COR_POST_INJ FORMAT "%7.5"
 /begin AXIS_DESCR COM_AXIS n_32 _CNV_A_R_LINEAR_____9_CM 6 0. 8160. FORMAT "%4.0" AXIS_PTS_REF ldp_n_32_ip_fac_mff_mplp_ch_ast /end AXIS_DESCR
/end CHARACTERISTIC
/begin CHARACTERISTIC ip_fac_mff_mplp_ch_ast_n_32 "Engine speed correction factor for the mass fuel flow of the post injection" CURVE 0xa1006eac _REC_CUR_20_u2_u1 1.99996948242188 _CNV_A_R_LINEAR_____8_CM 0. 1.99996948242188 DISPLAY_IDENTIFIER IP_FAC_MFF_MPLP_CH_AST_N_32 FORMAT "%7.5"
 /begin AXIS_DESCR COM_AXIS n_32 _CNV_A_R_LINEAR_____9_CM 6 0. 8160. FORMAT "%4.0" AXIS_PTS_REF ldp_n_32_ip_fac_mff_mplp_ch_ast /end AXIS_DESCR
/end CHARACTERISTIC
/begin CHARACTERISTIC ip_fac_mff_mplp_ch_l "Difference between cat. temperatures and target temp. depending correction for TQ_ADD_CH_L" MAP 0xa1006eb8 _REC_MAP_20_u2_u2_u2 1.99996948242188 _CNV_A_R_LINEAR_____8_CM 0. 1.99996948242188 DISPLAY_IDENTIFIER IP_FAC_MFF_MPLP_CH_L FORMAT "%7.5"
 /begin AXIS_DESCR COM_AXIS temp_cat_dif_ch_l _CNV_A_R_EXTC_LINEA_778_CM 8 -1056. 991.96875 FORMAT "%11.5" AXIS_PTS_REF ldpm_temp_cat_dif_ch_l_1_extc /end AXIS_DESCR
 /begin AXIS_DESCR COM_AXIS tnt_dif_ch_l _CNV_A_R_LINEAR_____779_CM 8 -1024. 1023.96875 FORMAT "%11.5" AXIS_PTS_REF ldpm_tnt_dif_ch_l_1_extc /end AXIS_DESCR
/end CHARACTERISTIC
/begin AXIS_PTS ldp_lamb_cmb_s_ip_mplp_ch_ast "" 0xa1006218 lamb_cmb_s _REC_AXS_20_u2 31.99951171875 _CNV_A_R_LINEAR_____243_CM 8 0. 31.99951171875 FORMAT "%9.6" /end AXIS_PTS
/begin AXIS_PTS ldp_lamb_cmb_s_ip_mff_mplp_ch_l "" 0xa1006204 lamb_cmb_s _REC_AXS_20_u2 31.99951171875 _CNV_A_R_LINEAR_____243_CM 8 0. 31.99951171875 FORMAT "%9.6" /end AXIS_PTS
/begin CHARACTERISTIC ip_mff_mplp_ch_ast "Basis map for the mass fuel flow of the post injection" MAP 0xa1007588 _REC_MAP_20_u2_u2_u2 1389. _CNV_A_R_LINEAR_____108_CM 0. 1389. DISPLAY_IDENTIFIER IP_MFF_MPLP_CH_AST FORMAT "%7.2"
 /begin AXIS_DESCR COM_AXIS mff_sp_mv _CNV_A_R_LINEAR_____108_CM 6 0. 1389. FORMAT "%7.2" AXIS_PTS_REF ldpm_mff_sp_mv_1_extc /end AXIS_DESCR
 /begin AXIS_DESCR COM_AXIS lamb_cmb_s _CNV_A_R_LINEAR_____243_CM 8 0. 31.99951171875 FORMAT "%9.6" AXIS_PTS_REF ldp_lamb_cmb_s_ip_mplp_ch_ast /end AXIS_DESCR
/end CHARACTERISTIC
/begin CHARACTERISTIC ip_mff_mplp_ch_l "Basic map for the mass fuel flow of the post injection for low load CH" MAP 0xa10075e8 _REC_MAP_20_u2_u2_u2 1389. _CNV_A_R_LINEAR_____108_CM 0. 1389. DISPLAY_IDENTIFIER IP_MFF_MPLP_CH_L FORMAT "%7.2"
 /begin AXIS_DESCR COM_AXIS mff_sp_mv _CNV_A_R_LINEAR_____108_CM 6 0. 1389. FORMAT "%7.2" AXIS_PTS_REF ldpm_mff_sp_mv_2_extc /end AXIS_DESCR
 /begin AXIS_DESCR COM_AXIS lamb_cmb_s _CNV_A_R_LINEAR_____243_CM 8 0. 31.99951171875 FORMAT "%9.6" AXIS_PTS_REF ldp_lamb_cmb_s_ip_mff_mplp_ch_l /end AXIS_DESCR
/end CHARACTERISTIC
/begin CHARACTERISTIC lc_mff_mplp_ch_man_act "Switch for manual mass fuel flow for the post injection for catalyst heating" VALUE 0xa100810d _REC_VAL_20_u1 1. _CNV_S_2_RANGE__0___1_CM 0. 1. DISPLAY_IDENTIFIER LC_MFF_MPLP_CH_MAN_ACT /end CHARACTERISTIC
/begin CHARACTERISTIC c_mff_mplp_ch_man "Manual mass fuel flow for the post injection for catalyst heating" VALUE 0xa10080aa _REC_VAL_20_u2 1389. _CNV_A_R_LINEAR_____108_CM 0. 1389. DISPLAY_IDENTIFIER C_MFF_MPLP_CH_MAN FORMAT "%7.2" /end CHARACTERISTIC
/begin CHARACTERISTIC ip_soi_1_ch_add_tco "Additive value for end of 1st injection related to ignition angle depending on coolant temperature" CURVE 0xa1007b58 _REC_CUR_20_u2_u1 1440. _CNV_A_R_LINEAR_____784_CM -720. 720. DISPLAY_IDENTIFIER IP_SOI_1_CH_ADD_TCO FORMAT "%6.1"
 /begin AXIS_DESCR COM_AXIS tco _CNV_A_R_LINEAR_____16_CM 8 -48. 142.5 FORMAT "%6.2" AXIS_PTS_REF ldp_tco_ip_soi_1_ch_add_tco /end AXIS_DESCR
/end CHARACTERISTIC
/begin AXIS_PTS ldp_tco_ip_soi_1_ch_add_tco "" 0xa100645c tco _REC_AXS_20_u1 190.5 _CNV_A_R_LINEAR_____16_CM 8 -48. 142.5 FORMAT "%6.2" /end AXIS_PTS
/begin CHARACTERISTIC c_soi_1_mplh_ch_as "Additional calibration of start of injection for catalyst heating" VALUE 0xa10080b4 _REC_VAL_20_u2 1440. _CNV_A_R_LINEAR_____784_CM -720. 720. DISPLAY_IDENTIFIER C_SOI_1_MPLH_CH_AS FORMAT "%6.1" /end CHARACTERISTIC
/begin CHARACTERISTIC c_soi_1_mplh_ch_man "Manual setting of start of injection for catalyst heating" VALUE 0xa10080b6 _REC_VAL_20_u2 720. _CNV_A_R_LINEAR_____168_CM 0. 720. DISPLAY_IDENTIFIER C_SOI_1_MPLH_CH_MAN FORMAT "%7.3" /end CHARACTERISTIC
/begin CHARACTERISTIC lc_soi_1_mplh_ch_man_act "Activation of manual setting of start of injection for catalyst heating" VALUE 0xa100810f _REC_VAL_20_u1 1. _CNV_A_R_LINEAR_____0_CM 0. 1. DISPLAY_IDENTIFIER LC_SOI_1_MPLH_CH_MAN_ACT FORMAT "%1.0" /end CHARACTERISTIC
/begin AXIS_PTS ldp_maf_ip_soi_1_mplh_ch_ast "" 0xa1006250 maf _REC_AXS_20_u2 1389. _CNV_A_R_LINEAR_____108_CM 8 0. 1389. FORMAT "%7.2" /end AXIS_PTS
/begin AXIS_PTS ldp_n_32_ip_soi_1_mplh_ch_ast "" 0xa100634c n_32 _REC_AXS_20_u1 8160. _CNV_A_R_LINEAR_____9_CM 8 0. 8160. FORMAT "%4.0" /end AXIS_PTS
/begin CHARACTERISTIC ip_soi_1_mplh_ch_ast "Basic start of injection for CH" MAP 0xa1007b68 _REC_MAP_20_u2_u1_u2 720. _CNV_A_R_LINEAR_____168_CM 0. 720. DISPLAY_IDENTIFIER IP_SOI_1_MPLH_CH_AST FORMAT "%7.3"
 /begin AXIS_DESCR COM_AXIS n_32 _CNV_A_R_LINEAR_____9_CM 8 0. 8160. FORMAT "%4.0" AXIS_PTS_REF ldp_n_32_ip_soi_1_mplh_ch_ast /end AXIS_DESCR
 /begin AXIS_DESCR COM_AXIS maf _CNV_A_R_LINEAR_____108_CM 8 0. 1389. FORMAT "%7.2" AXIS_PTS_REF ldp_maf_ip_soi_1_mplh_ch_ast /end AXIS_DESCR
/end CHARACTERISTIC
/begin MEASUREMENT soi_1_mplh_ch[0] "start of injection for catalyst heating" UWORD _CNV_A_R_LINEAR_____168_CM 1 100. 0. 720. DISPLAY_IDENTIFIER SOI_1_MPLH_CH[0] ECU_ADDRESS 0xd0002710 FORMAT "%7.3" /end MEASUREMENT
/begin MEASUREMENT soi_1_mplh_ch[1] "start of injection for catalyst heating" UWORD _CNV_A_R_LINEAR_____168_CM 1 100. 0. 720. DISPLAY_IDENTIFIER SOI_1_MPLH_CH[1] ECU_ADDRESS 0xd0002712 FORMAT "%7.3" /end MEASUREMENT
/begin MEASUREMENT soi_1_mplh_ch[2] "start of injection for catalyst heating" UWORD _CNV_A_R_LINEAR_____168_CM 1 100. 0. 720. DISPLAY_IDENTIFIER SOI_1_MPLH_CH[2] ECU_ADDRESS 0xd0002714 FORMAT "%7.3" /end MEASUREMENT
/begin MEASUREMENT soi_1_mplh_ch[3] "start of injection for catalyst heating" UWORD _CNV_A_R_LINEAR_____168_CM 1 100. 0. 720. DISPLAY_IDENTIFIER SOI_1_MPLH_CH[3] ECU_ADDRESS 0xd0002716 FORMAT "%7.3" /end MEASUREMENT
/begin MEASUREMENT soi_1_mplh_ch[4] "start of injection for catalyst heating" UWORD _CNV_A_R_LINEAR_____168_CM 1 100. 0. 720. DISPLAY_IDENTIFIER SOI_1_MPLH_CH[4] ECU_ADDRESS 0xd0002718 FORMAT "%7.3" /end MEASUREMENT
/begin MEASUREMENT soi_1_mplh_ch[5] "start of injection for catalyst heating" UWORD _CNV_A_R_LINEAR_____168_CM 1 100. 0. 720. DISPLAY_IDENTIFIER SOI_1_MPLH_CH[5] ECU_ADDRESS 0xd000271a FORMAT "%7.3" /end MEASUREMENT
/begin AXIS_PTS ldp_n_32_ip_soi_1_mplh_ch_so2p "" 0xa1006358 n_32 _REC_AXS_20_u1 8160. _CNV_A_R_LINEAR_____9_CM 8 0. 8160. FORMAT "%4.0" /end AXIS_PTS
/begin AXIS_PTS ldp_maf_ip_soi_1_mplh_ch_so2p "" 0xa1006264 maf _REC_AXS_20_u2 1389. _CNV_A_R_LINEAR_____108_CM 8 0. 1389. FORMAT "%7.2" /end AXIS_PTS
/begin CHARACTERISTIC ip_soi_1_mplh_ch_so2p "Basic start of injection for MPLH during catalyst heating for desulfation" MAP 0xa1007be8 _REC_MAP_20_u2_u1_u2 720. _CNV_A_R_LINEAR_____168_CM 0. 720. DISPLAY_IDENTIFIER IP_SOI_1_MPLH_CH_SO2P FORMAT "%7.3"
 /begin AXIS_DESCR COM_AXIS n_32 _CNV_A_R_LINEAR_____9_CM 8 0. 8160. FORMAT "%4.0" AXIS_PTS_REF ldp_n_32_ip_soi_1_mplh_ch_so2p /end AXIS_DESCR
 /begin AXIS_DESCR COM_AXIS maf _CNV_A_R_LINEAR_____108_CM 8 0. 1389. FORMAT "%7.2" AXIS_PTS_REF ldp_maf_ip_soi_1_mplh_ch_so2p /end AXIS_DESCR
/end CHARACTERISTIC
/begin CHARACTERISTIC c_eoi_2_delta_mplh_ch_as "Correction of application system" VALUE 0xa100808a _REC_VAL_20_u2 1440. _CNV_A_R_LINEAR_____784_CM -720. 720. DISPLAY_IDENTIFIER C_EOI_2_DELTA_MPLH_CH_AS FORMAT "%6.1" /end CHARACTERISTIC
/begin CHARACTERISTIC c_eoi_2_delta_mplh_ch_man "Manual setting of end of injection of the second injection for catalyst heating" VALUE 0xa100808c _REC_VAL_20_u2 720. _CNV_A_R_LINEAR_____168_CM 0. 720. DISPLAY_IDENTIFIER C_EOI_2_DELTA_MPLH_CH_MAN FORMAT "%7.3" /end CHARACTERISTIC
/begin CHARACTERISTIC lc_eoi_2_delta_mplh_ch_man_act "Activation of manual setting of end of injection of the second injection for catalyst heating" VALUE 0xa1008106 _REC_VAL_20_u1 1. _CNV_A_R_LINEAR_____0_CM 0. 1. DISPLAY_IDENTIFIER LC_EOI_2_DELTA_MPLH_CH_MAN_ACT FORMAT "%1.0" /end CHARACTERISTIC
/begin AXIS_PTS ldp_n_32_ip_eoi_2_delta_ch "" 0xa10062f0 n_32 _REC_AXS_20_u1 8160. _CNV_A_R_LINEAR_____9_CM 8 0. 8160. FORMAT "%4.0" /end AXIS_PTS
/begin AXIS_PTS ldp_maf_ip_eoi_2_delta_ch "" 0xa100623c maf _REC_AXS_20_u2 1389. _CNV_A_R_LINEAR_____108_CM 8 0. 1389. FORMAT "%7.2" /end AXIS_PTS
/begin AXIS_PTS ldp_mff_2_ip_eoi_2_mplh_ch_add "" 0xa1006278 mff_sp_2_mplh_ch _REC_AXS_20_u2 1389. _CNV_A_R_LINEAR_____108_CM 6 0. 1389. FORMAT "%7.2" /end AXIS_PTS
/begin CHARACTERISTIC ip_eoi_2_delta_mplh_ch_ast "End of 2nd injection -HOM_DUI-mode- related to ignition angle" MAP 0xa1006cac _REC_MAP_20_u2_u1_u2 720. _CNV_A_R_LINEAR_____168_CM 0. 720. DISPLAY_IDENTIFIER IP_EOI_2_DELTA_MPLH_CH_AST FORMAT "%7.3"
 /begin AXIS_DESCR COM_AXIS n_32 _CNV_A_R_LINEAR_____9_CM 8 0. 8160. FORMAT "%4.0" AXIS_PTS_REF ldp_n_32_ip_eoi_2_delta_ch /end AXIS_DESCR
 /begin AXIS_DESCR COM_AXIS maf _CNV_A_R_LINEAR_____108_CM 8 0. 1389. FORMAT "%7.2" AXIS_PTS_REF ldp_maf_ip_eoi_2_delta_ch /end AXIS_DESCR
/end CHARACTERISTIC
/begin CHARACTERISTIC ip_eoi_2_mplh_ch_add_mff_2 "Additive value for end of 2nd injection related to ignition angle depending on coolant temperature" CURVE 0xa1006dac _REC_CUR_20_u2_u2 1440. _CNV_A_R_LINEAR_____784_CM -720. 720. DISPLAY_IDENTIFIER IP_EOI_2_MPLH_CH_ADD_MFF_2 FORMAT "%6.1"
 /begin AXIS_DESCR COM_AXIS mff_sp_2_mplh_ch _CNV_A_R_LINEAR_____108_CM 6 0. 1389. FORMAT "%7.2" AXIS_PTS_REF ldp_mff_2_ip_eoi_2_mplh_ch_add /end AXIS_DESCR
/end CHARACTERISTIC
/begin MEASUREMENT eoi_2_delta_mplh_ch "End of injection of the second injection for catalyst heating" UWORD _CNV_A_R_LINEAR_____168_CM 1 100. 0. 720. DISPLAY_IDENTIFIER EOI_2_DELTA_MPLH_CH ECU_ADDRESS 0xd00026e0 FORMAT "%7.3" /end MEASUREMENT
/begin AXIS_PTS ldpm_n_32_4_extc "" 0xa1006614 n_32 _REC_AXS_20_u1 8160. _CNV_A_R_LINEAR_____9_CM 8 0. 8160. FORMAT "%4.0" /end AXIS_PTS
/begin AXIS_PTS ldpm_maf_2_extc "" 0xa10065bc maf _REC_AXS_20_u2 1389. _CNV_A_R_LINEAR_____108_CM 8 0. 1389. FORMAT "%7.2" /end AXIS_PTS
/begin CHARACTERISTIC ip_eoi_2_delta_mplh_ch_so2p "End of 2nd injection in desulfation catalyst heating in homogeneous with split injection- related to ignition angle" MAP 0xa1006d2c _REC_MAP_20_u2_u1_u2 720. _CNV_A_R_LINEAR_____168_CM 0. 720. DISPLAY_IDENTIFIER IP_EOI_2_DELTA_MPLH_CH_SO2P FORMAT "%7.3"
 /begin AXIS_DESCR COM_AXIS n_32 _CNV_A_R_LINEAR_____9_CM 8 0. 8160. FORMAT "%4.0" AXIS_PTS_REF ldpm_n_32_4_extc /end AXIS_DESCR
 /begin AXIS_DESCR COM_AXIS maf _CNV_A_R_LINEAR_____108_CM 8 0. 1389. FORMAT "%7.2" AXIS_PTS_REF ldpm_maf_2_extc /end AXIS_DESCR
/end CHARACTERISTIC
/begin CHARACTERISTIC lc_soi_post_inj_man_act "Switch for manual start of injection for the post injection" VALUE 0xa1008111 _REC_VAL_20_u1 1. _CNV_S_2_RANGE__0___1_CM 0. 1. DISPLAY_IDENTIFIER LC_SOI_POST_INJ_MAN_ACT /end CHARACTERISTIC
/begin MEASUREMENT eoi_lim_post "latest possible EOI" UWORD _CNV_A_R_LINEAR_____168_CM 1 100. 0. 720. DISPLAY_IDENTIFIER EOI_LIM_POST ECU_ADDRESS 0xd00026e2 FORMAT "%6.2" /end MEASUREMENT
/begin MEASUREMENT soi_lim_post "earliest possible SOI" UWORD _CNV_A_R_LINEAR_____168_CM 1 100. 0. 720. DISPLAY_IDENTIFIER SOI_LIM_POST ECU_ADDRESS 0xd000271c FORMAT "%6.2" /end MEASUREMENT
/begin MEASUREMENT soi_post_inj[0] "Start of the post injection" UWORD _CNV_A_R_LINEAR_____168_CM 1 100. 0. 720. DISPLAY_IDENTIFIER SOI_POST_INJ[0] ECU_ADDRESS 0xd0002720 FORMAT "%6.2" /end MEASUREMENT
/begin MEASUREMENT soi_post_inj[1] "Start of the post injection" UWORD _CNV_A_R_LINEAR_____168_CM 1 100. 0. 720. DISPLAY_IDENTIFIER SOI_POST_INJ[1] ECU_ADDRESS 0xd0002722 FORMAT "%6.2" /end MEASUREMENT
/begin MEASUREMENT soi_post_inj[2] "Start of the post injection" UWORD _CNV_A_R_LINEAR_____168_CM 1 100. 0. 720. DISPLAY_IDENTIFIER SOI_POST_INJ[2] ECU_ADDRESS 0xd0002724 FORMAT "%6.2" /end MEASUREMENT
/begin MEASUREMENT soi_post_inj[3] "Start of the post injection" UWORD _CNV_A_R_LINEAR_____168_CM 1 100. 0. 720. DISPLAY_IDENTIFIER SOI_POST_INJ[3] ECU_ADDRESS 0xd0002726 FORMAT "%6.2" /end MEASUREMENT
/begin MEASUREMENT soi_post_inj[4] "Start of the post injection" UWORD _CNV_A_R_LINEAR_____168_CM 1 100. 0. 720. DISPLAY_IDENTIFIER SOI_POST_INJ[4] ECU_ADDRESS 0xd0002728 FORMAT "%6.2" /end MEASUREMENT
/begin MEASUREMENT soi_post_inj[5] "Start of the post injection" UWORD _CNV_A_R_LINEAR_____168_CM 1 100. 0. 720. DISPLAY_IDENTIFIER SOI_POST_INJ[5] ECU_ADDRESS 0xd000272a FORMAT "%6.2" /end MEASUREMENT
/begin MEASUREMENT eoi_post_inj[0] "End of the post injection" UWORD _CNV_A_R_LINEAR_____168_CM 1 100. 0. 720. DISPLAY_IDENTIFIER EOI_POST_INJ[0] ECU_ADDRESS 0xd00026e4 FORMAT "%6.2" /end MEASUREMENT
/begin MEASUREMENT eoi_post_inj[1] "End of the post injection" UWORD _CNV_A_R_LINEAR_____168_CM 1 100. 0. 720. DISPLAY_IDENTIFIER EOI_POST_INJ[1] ECU_ADDRESS 0xd00026e6 FORMAT "%6.2" /end MEASUREMENT
/begin MEASUREMENT eoi_post_inj[2] "End of the post injection" UWORD _CNV_A_R_LINEAR_____168_CM 1 100. 0. 720. DISPLAY_IDENTIFIER EOI_POST_INJ[2] ECU_ADDRESS 0xd00026e8 FORMAT "%6.2" /end MEASUREMENT
/begin MEASUREMENT eoi_post_inj[3] "End of the post injection" UWORD _CNV_A_R_LINEAR_____168_CM 1 100. 0. 720. DISPLAY_IDENTIFIER EOI_POST_INJ[3] ECU_ADDRESS 0xd00026ea FORMAT "%6.2" /end MEASUREMENT
/begin MEASUREMENT eoi_post_inj[4] "End of the post injection" UWORD _CNV_A_R_LINEAR_____168_CM 1 100. 0. 720. DISPLAY_IDENTIFIER EOI_POST_INJ[4] ECU_ADDRESS 0xd00026ec FORMAT "%6.2" /end MEASUREMENT
/begin MEASUREMENT eoi_post_inj[5] "End of the post injection" UWORD _CNV_A_R_LINEAR_____168_CM 1 100. 0. 720. DISPLAY_IDENTIFIER EOI_POST_INJ[5] ECU_ADDRESS 0xd00026ee FORMAT "%6.2" /end MEASUREMENT
/begin CHARACTERISTIC c_eoi_lim_post "Latest possible EOI" VALUE 0xa100808e _REC_VAL_20_u2 720. _CNV_A_R_LINEAR_____168_CM 0. 720. DISPLAY_IDENTIFIER C_EOI_LIM_POST FORMAT "%6.2" /end CHARACTERISTIC
/begin CHARACTERISTIC c_soi_lim_post "Earliest possible SOI" VALUE 0xa10080b8 _REC_VAL_20_u2 720. _CNV_A_R_LINEAR_____168_CM 0. 720. DISPLAY_IDENTIFIER C_SOI_LIM_POST FORMAT "%6.2" /end CHARACTERISTIC
/begin AXIS_PTS ldpm_n_32_2_extc "" 0xa10065fc n_32 _REC_AXS_20_u1 8160. _CNV_A_R_LINEAR_____9_CM 8 0. 8160. FORMAT "%4.0" /end AXIS_PTS
/begin MEASUREMENT soi_mplp_dif_ch "Start of injection of the second injection for catalyst heating" UWORD _CNV_A_R_LINEAR_____168_CM 1 100. 0. 720. DISPLAY_IDENTIFIER SOI_MPLP_DIF_CH ECU_ADDRESS 0xd000271e FORMAT "%6.2" /end MEASUREMENT
/begin CHARACTERISTIC c_soi_post_inj_man "Manual start of injection for the post injection" VALUE 0xa10080bc _REC_VAL_20_u2 720. _CNV_A_R_LINEAR_____168_CM 0. 720. DISPLAY_IDENTIFIER C_SOI_POST_INJ_MAN FORMAT "%6.2" /end CHARACTERISTIC
/begin CHARACTERISTIC c_soi_mplp_man "Manual start of injection for the post injection" VALUE 0xa10080ba _REC_VAL_20_u2 720. _CNV_A_R_LINEAR_____168_CM 0. 720. DISPLAY_IDENTIFIER C_SOI_MPLP_MAN FORMAT "%6.2" /end CHARACTERISTIC
/begin CHARACTERISTIC lc_soi_mplp_man_act "Switch for manual start of injection for the post injection" VALUE 0xa1008110 _REC_VAL_20_u1 1. _CNV_S_2_RANGE__0___1_CM 0. 1. DISPLAY_IDENTIFIER LC_SOI_MPLP_MAN_ACT /end CHARACTERISTIC
/begin AXIS_PTS ldp_mff_post_ip_soi_mplp_ch_l "" 0xa10062c0 online_dummy _REC_AXS_20_u2 1389. _CNV_A_R_LINEAR_____108_CM 8 0. 1389. FORMAT "%7.2" /end AXIS_PTS
/begin CHARACTERISTIC ip_soi_mplp_add_mff_post_ch_l "Mass of post injection depending correction of start of injection of post injection for low load strat. CH" CURVE 0xa1007c68 _REC_CUR_20_u2_u2 720. _CNV_A_R_LINEAR_____168_CM 0. 720. DISPLAY_IDENTIFIER IP_SOI_MPLP_ADD_MFF_POST_CH_L FORMAT "%7.3"
 /begin AXIS_DESCR COM_AXIS online_dummy _CNV_A_R_LINEAR_____108_CM 8 0. 1389. FORMAT "%7.2" AXIS_PTS_REF ldp_mff_post_ip_soi_mplp_ch_l /end AXIS_DESCR
/end CHARACTERISTIC
/begin CHARACTERISTIC ip_soi_mplp_dif_ch_ast "start of injection of the second injection for catalyst heating" MAP 0xa1007c78 _REC_MAP_20_u2_u1_u2 720. _CNV_A_R_LINEAR_____168_CM 0. 720. DISPLAY_IDENTIFIER IP_SOI_MPLP_DIF_CH_AST FORMAT "%7.3"
 /begin AXIS_DESCR COM_AXIS n_32 _CNV_A_R_LINEAR_____9_CM 8 0. 8160. FORMAT "%4.0" AXIS_PTS_REF ldpm_n_32_2_extc /end AXIS_DESCR
 /begin AXIS_DESCR COM_AXIS mff_sp_mv _CNV_A_R_LINEAR_____108_CM 6 0. 1389. FORMAT "%7.2" AXIS_PTS_REF ldpm_mff_sp_mv_1_extc /end AXIS_DESCR
/end CHARACTERISTIC
/begin CHARACTERISTIC ip_soi_mplp_dif_ch_l "Start of injection of post injection for low load stratified catalyst heating" MAP 0xa1007cd8 _REC_MAP_20_u2_u1_u2 720. _CNV_A_R_LINEAR_____168_CM 0. 720. DISPLAY_IDENTIFIER IP_SOI_MPLP_DIF_CH_L FORMAT "%7.3"
 /begin AXIS_DESCR COM_AXIS n_32 _CNV_A_R_LINEAR_____9_CM 6 0. 8160. FORMAT "%4.0" AXIS_PTS_REF ldpm_n_32_6_extc /end AXIS_DESCR
 /begin AXIS_DESCR COM_AXIS mff_sp_mv _CNV_A_R_LINEAR_____108_CM 6 0. 1389. FORMAT "%7.2" AXIS_PTS_REF ldpm_mff_sp_mv_2_extc /end AXIS_DESCR
/end CHARACTERISTIC
/begin MEASUREMENT tq_add_ch "Torque reserve for catalyst heating" SWORD _CNV_A_R_LINEAR_____30_CM 1 100. -1024. 1023.96875 DISPLAY_IDENTIFIER TQ_ADD_CH ECU_ADDRESS 0xd0002740 FORMAT "%11.5" /end MEASUREMENT
/begin CHARACTERISTIC c_tq_add_ch_hom_man "Manual setting of torque reserve for catalyst heating in homogeneous mode" VALUE 0xa10080de _REC_VAL_20_u2 1023.96875 _CNV_A_R_LINEAR_____30_CM 0. 1023.96875 DISPLAY_IDENTIFIER C_TQ_ADD_CH_HOM_MAN FORMAT "%7.2" /end CHARACTERISTIC
/begin CHARACTERISTIC lc_tq_add_ch_hom_man_act "Activation of manual setting of torque reserve for catalyst heating in homogeneous mode" VALUE 0xa1008113 _REC_VAL_20_u1 1. _CNV_A_R_LINEAR_____0_CM 0. 1. DISPLAY_IDENTIFIER LC_TQ_ADD_CH_HOM_MAN_ACT FORMAT "%1.0" /end CHARACTERISTIC
/begin CHARACTERISTIC lc_tq_add_ch_mplh_man_act "Activation of manual setting of torque reserve for catalyst heating in homogeneous mode, dual injection" VALUE 0xa1008114 _REC_VAL_20_u1 1. _CNV_A_R_LINEAR_____0_CM 0. 1. DISPLAY_IDENTIFIER LC_TQ_ADD_CH_MPLH_MAN_ACT FORMAT "%1.0" /end CHARACTERISTIC
/begin CHARACTERISTIC c_tq_add_ch_lgrd_on "Gradient for TQ_ADD_CH entry ramps" VALUE 0xa10080e4 _REC_VAL_20_u2 1023.96875 _CNV_A_R_LINEAR_____30_CM 0. 1023.96875 DISPLAY_IDENTIFIER C_TQ_ADD_CH_LGRD_ON FORMAT "%7.2" /end CHARACTERISTIC
/begin CHARACTERISTIC c_tq_add_ch_lgrd_off "Gradient for TQ_ADD_CH exit ramp" VALUE 0xa10080e2 _REC_VAL_20_u2 1023.96875 _CNV_A_R_LINEAR_____30_CM 0. 1023.96875 DISPLAY_IDENTIFIER C_TQ_ADD_CH_LGRD_OFF FORMAT "%7.2" /end CHARACTERISTIC
/begin AXIS_PTS ldp_n_32_ip_tq_add_ch_hom_is "" 0xa1006370 n_32 _REC_AXS_20_u1 8160. _CNV_A_R_LINEAR_____9_CM 8 0. 8160. FORMAT "%4.0" /end AXIS_PTS
/begin AXIS_PTS ldp_n_32_ip_tq_add_mplh_is "" 0xa10063a0 n_32 _REC_AXS_20_u1 8160. _CNV_A_R_LINEAR_____9_CM 8 0. 8160. FORMAT "%4.0" /end AXIS_PTS
/begin AXIS_PTS ldp_n_32_ip_tq_add_ch_mplh "" 0xa1006394 n_32 _REC_AXS_20_u1 8160. _CNV_A_R_LINEAR_____9_CM 8 0. 8160. FORMAT "%4.0" /end AXIS_PTS
/begin AXIS_PTS ldp_tqi_req_ip_tq_add_ch_hom_is "" 0xa10064d4 tqi_req_tra _REC_AXS_20_u2 1023.96875 _CNV_A_R_LINEAR_____30_CM 8 0. 1023.96875 FORMAT "%7.2" /end AXIS_PTS
/begin AXIS_PTS ldp_tqi_req_ip_tq_ch_mplh_is "" 0xa1006524 tqi_req_tra _REC_AXS_20_u2 1023.96875 _CNV_A_R_LINEAR_____30_CM 8 0. 1023.96875 FORMAT "%7.2" /end AXIS_PTS
/begin AXIS_PTS ldp_tqi_req_ip_tq_ch_mplh "" 0xa1006510 tqi_req_tra _REC_AXS_20_u2 1023.96875 _CNV_A_R_LINEAR_____30_CM 8 0. 1023.96875 FORMAT "%7.2" /end AXIS_PTS
/begin AXIS_PTS ldp_t_ast_ip_fac_tq_ch_mplh "" 0xa10063fc t_ast _REC_AXS_20_u2 6553.5 _CNV_A_R_LINEAR_____4_CM 8 0. 6553.5 FORMAT "%6.1" /end AXIS_PTS
/begin AXIS_PTS ldp_t_ast_ip_fac_tq_add_ch_hom "" 0xa10063e8 t_ast _REC_AXS_20_u2 6553.5 _CNV_A_R_LINEAR_____4_CM 8 0. 6553.5 FORMAT "%6.1" /end AXIS_PTS
/begin AXIS_PTS ldp_tco_st_ip_fac_tq_add_ch_hom "" 0xa1006480 tco_st _REC_AXS_20_u1 190.5 _CNV_A_R_LINEAR_____16_CM 8 -48. 142.5 FORMAT "%6.2" /end AXIS_PTS
/begin AXIS_PTS ldp_tco_st_ip_fac_tq_mplh "" 0xa100648c tco_st _REC_AXS_20_u1 190.5 _CNV_A_R_LINEAR_____16_CM 8 -48. 142.5 FORMAT "%6.2" /end AXIS_PTS
/begin CHARACTERISTIC ip_tq_add_ch_hom_is "Coolant temperature and time after start depending correction TQ_ADD_CH" MAP 0xa1007dc0 _REC_MAP_20_u2_u1_u2 2047.96875 _CNV_A_R_LINEAR_____65_CM -1024. 1023.96875 DISPLAY_IDENTIFIER IP_TQ_ADD_CH_HOM_IS FORMAT "%11.5"
 /begin AXIS_DESCR COM_AXIS n_32 _CNV_A_R_LINEAR_____9_CM 8 0. 8160. FORMAT "%4.0" AXIS_PTS_REF ldp_n_32_ip_tq_add_ch_hom_is /end AXIS_DESCR
 /begin AXIS_DESCR COM_AXIS tqi_req_tra _CNV_A_R_LINEAR_____30_CM 8 0. 1023.96875 FORMAT "%7.2" AXIS_PTS_REF ldp_tqi_req_ip_tq_add_ch_hom_is /end AXIS_DESCR
/end CHARACTERISTIC
/begin CHARACTERISTIC ip_tq_add_ch_mplh_is "Basic torque increase for catalyst heating for homogeneous split" MAP 0xa1007fc0 _REC_MAP_20_u2_u1_u2 2047.96875 _CNV_A_R_LINEAR_____65_CM -1024. 1023.96875 DISPLAY_IDENTIFIER IP_TQ_ADD_CH_MPLH_IS FORMAT "%11.5"
 /begin AXIS_DESCR COM_AXIS n_32 _CNV_A_R_LINEAR_____9_CM 8 0. 8160. FORMAT "%4.0" AXIS_PTS_REF ldp_n_32_ip_tq_add_mplh_is /end AXIS_DESCR
 /begin AXIS_DESCR COM_AXIS tqi_req_tra _CNV_A_R_LINEAR_____30_CM 8 0. 1023.96875 FORMAT "%7.2" AXIS_PTS_REF ldp_tqi_req_ip_tq_ch_mplh_is /end AXIS_DESCR
/end CHARACTERISTIC
/begin CHARACTERISTIC ip_tq_add_ch_mplh "Basic torque increase for catalyst heating at homogeneous split injection" MAP 0xa1007f40 _REC_MAP_20_u2_u1_u2 2047.96875 _CNV_A_R_LINEAR_____65_CM -1024. 1023.96875 DISPLAY_IDENTIFIER IP_TQ_ADD_CH_MPLH FORMAT "%11.5"
 /begin AXIS_DESCR COM_AXIS n_32 _CNV_A_R_LINEAR_____9_CM 8 0. 8160. FORMAT "%4.0" AXIS_PTS_REF ldp_n_32_ip_tq_add_ch_mplh /end AXIS_DESCR
 /begin AXIS_DESCR COM_AXIS tqi_req_tra _CNV_A_R_LINEAR_____30_CM 8 0. 1023.96875 FORMAT "%7.2" AXIS_PTS_REF ldp_tqi_req_ip_tq_ch_mplh /end AXIS_DESCR
/end CHARACTERISTIC
/begin CHARACTERISTIC ip_fac_tq_add_ch_mplh "Coolant temperature and time after start depending correction TQ_ADD_CH_HSP" MAP 0xa1006ff8 _REC_MAP_20_u1_u2_u1 0.99609375 _CNV_A_R_LINEAR_____27_CM 0. 0.99609375 DISPLAY_IDENTIFIER IP_FAC_TQ_ADD_CH_MPLH FORMAT "%5.3"
 /begin AXIS_DESCR COM_AXIS t_ast _CNV_A_R_LINEAR_____4_CM 8 0. 6553.5 FORMAT "%6.1" AXIS_PTS_REF ldp_t_ast_ip_fac_tq_ch_mplh /end AXIS_DESCR
 /begin AXIS_DESCR COM_AXIS tco_st _CNV_A_R_LINEAR_____16_CM 8 -48. 142.5 FORMAT "%6.2" AXIS_PTS_REF ldp_tco_st_ip_fac_tq_mplh /end AXIS_DESCR
/end CHARACTERISTIC
/begin CHARACTERISTIC c_tq_add_ch_mplh_man "Manual setting of torque reserve for catalyst heating in homogeneous mode with dual injection" VALUE 0xa10080e6 _REC_VAL_20_u2 1023.96875 _CNV_A_R_LINEAR_____30_CM 0. 1023.96875 DISPLAY_IDENTIFIER C_TQ_ADD_CH_MPLH_MAN FORMAT "%7.2" /end CHARACTERISTIC
/begin CHARACTERISTIC c_tq_add_ch_l_lgrd "Limitation gradient for torque reserve in low load cat. heating" VALUE 0xa10080e0 _REC_VAL_20_u2 1023.96875 _CNV_A_R_LINEAR_____30_CM 0. 1023.96875 DISPLAY_IDENTIFIER C_TQ_ADD_CH_L_LGRD FORMAT "%7.2" /end CHARACTERISTIC
/begin CHARACTERISTIC ip_fac_tq_add_ch_hom "Coolant temperature and time after start depending correction TQ_ADD_CH" MAP 0xa1006f38 _REC_MAP_20_u1_u2_u1 0.99609375 _CNV_A_R_LINEAR_____27_CM 0. 0.99609375 DISPLAY_IDENTIFIER IP_FAC_TQ_ADD_CH_HOM FORMAT "%5.3"
 /begin AXIS_DESCR COM_AXIS t_ast _CNV_A_R_LINEAR_____4_CM 8 0. 6553.5 FORMAT "%6.1" AXIS_PTS_REF ldp_t_ast_ip_fac_tq_add_ch_hom /end AXIS_DESCR
 /begin AXIS_DESCR COM_AXIS tco_st _CNV_A_R_LINEAR_____16_CM 8 -48. 142.5 FORMAT "%6.2" AXIS_PTS_REF ldp_tco_st_ip_fac_tq_add_ch_hom /end AXIS_DESCR
/end CHARACTERISTIC
/begin CHARACTERISTIC ip_fac_tq_add_ch_l "Difference between cat. temperatures and target temp. depending correction for TQ_ADD_CH_L" MAP 0xa1006f78 _REC_MAP_20_u2_u2_u2 1.99996948242188 _CNV_A_R_LINEAR_____8_CM 0. 1.99996948242188 DISPLAY_IDENTIFIER IP_FAC_TQ_ADD_CH_L FORMAT "%7.5"
 /begin AXIS_DESCR COM_AXIS temp_cat_dif_ch_l _CNV_A_R_EXTC_LINEA_778_CM 8 -1056. 991.96875 FORMAT "%11.5" AXIS_PTS_REF ldpm_temp_cat_dif_ch_l_1_extc /end AXIS_DESCR
 /begin AXIS_DESCR COM_AXIS tnt_dif_ch_l _CNV_A_R_LINEAR_____779_CM 8 -1024. 1023.96875 FORMAT "%11.5" AXIS_PTS_REF ldpm_tnt_dif_ch_l_1_extc /end AXIS_DESCR
/end CHARACTERISTIC
/begin AXIS_PTS ldp_n_32_ip_tq_add_ch_hom "" 0xa1006364 n_32 _REC_AXS_20_u1 8160. _CNV_A_R_LINEAR_____9_CM 8 0. 8160. FORMAT "%4.0" /end AXIS_PTS
/begin AXIS_PTS ldp_tqi_req_ip_tq_add_ch_hom "" 0xa10064c0 tqi_req_tra _REC_AXS_20_u2 1023.96875 _CNV_A_R_LINEAR_____30_CM 8 0. 1023.96875 FORMAT "%7.2" /end AXIS_PTS
/begin AXIS_PTS ldp_n_32_ip_tq_add_ch_l "" 0xa100637c n_32 _REC_AXS_20_u1 8160. _CNV_A_R_LINEAR_____9_CM 8 0. 8160. FORMAT "%4.0" /end AXIS_PTS
/begin AXIS_PTS ldp_n_32_ip_tq_add_ch_l_is "" 0xa1006388 n_32 _REC_AXS_20_u1 8160. _CNV_A_R_LINEAR_____9_CM 8 0. 8160. FORMAT "%4.0" /end AXIS_PTS
/begin AXIS_PTS ldp_tqi_req_ip_tq_add_ch_l "" 0xa10064e8 tqi_req_tra _REC_AXS_20_u2 1023.96875 _CNV_A_R_LINEAR_____30_CM 8 0. 1023.96875 FORMAT "%7.2" /end AXIS_PTS
/begin AXIS_PTS ldp_tqi_req_ip_tq_add_ch_l_is "" 0xa10064fc tqi_req_tra _REC_AXS_20_u2 1023.96875 _CNV_A_R_LINEAR_____30_CM 8 0. 1023.96875 FORMAT "%7.2" /end AXIS_PTS
/begin CHARACTERISTIC ip_tq_add_ch_hom "Basic torque increase for homogeneous catalyst heating" MAP 0xa1007d40 _REC_MAP_20_u2_u1_u2 2047.96875 _CNV_A_R_LINEAR_____65_CM -1024. 1023.96875 DISPLAY_IDENTIFIER IP_TQ_ADD_CH_HOM FORMAT "%11.5"
 /begin AXIS_DESCR COM_AXIS n_32 _CNV_A_R_LINEAR_____9_CM 8 0. 8160. FORMAT "%4.0" AXIS_PTS_REF ldp_n_32_ip_tq_add_ch_hom /end AXIS_DESCR
 /begin AXIS_DESCR COM_AXIS tqi_req_tra _CNV_A_R_LINEAR_____30_CM 8 0. 1023.96875 FORMAT "%7.2" AXIS_PTS_REF ldp_tqi_req_ip_tq_add_ch_hom /end AXIS_DESCR
/end CHARACTERISTIC
/begin CHARACTERISTIC ip_tq_add_ch_l_hom "Basic torque increase for homogeneous low load catalyst heating" MAP 0xa1007e40 _REC_MAP_20_u2_u1_u2 2047.96875 _CNV_A_R_LINEAR_____65_CM -1024. 1023.96875 DISPLAY_IDENTIFIER IP_TQ_ADD_CH_L_HOM FORMAT "%11.5"
 /begin AXIS_DESCR COM_AXIS n_32 _CNV_A_R_LINEAR_____9_CM 8 0. 8160. FORMAT "%4.0" AXIS_PTS_REF ldp_n_32_ip_tq_add_ch_l /end AXIS_DESCR
 /begin AXIS_DESCR COM_AXIS tqi_req_tra _CNV_A_R_LINEAR_____30_CM 8 0. 1023.96875 FORMAT "%7.2" AXIS_PTS_REF ldp_tqi_req_ip_tq_add_ch_l /end AXIS_DESCR
/end CHARACTERISTIC
/begin CHARACTERISTIC ip_tq_add_ch_l_hom_is "Torque reserve for low load catalyst heating in idle speed" MAP 0xa1007ec0 _REC_MAP_20_u2_u1_u2 2047.96875 _CNV_A_R_LINEAR_____65_CM -1024. 1023.96875 DISPLAY_IDENTIFIER IP_TQ_ADD_CH_L_HOM_IS FORMAT "%11.5"
 /begin AXIS_DESCR COM_AXIS n_32 _CNV_A_R_LINEAR_____9_CM 8 0. 8160. FORMAT "%4.0" AXIS_PTS_REF ldp_n_32_ip_tq_add_ch_l_is /end AXIS_DESCR
 /begin AXIS_DESCR COM_AXIS tqi_req_tra _CNV_A_R_LINEAR_____30_CM 8 0. 1023.96875 FORMAT "%7.2" AXIS_PTS_REF ldp_tqi_req_ip_tq_add_ch_l_is /end AXIS_DESCR
/end CHARACTERISTIC
/begin MEASUREMENT state_ch_mod "Catalyst heading strategy" UBYTE _CNV_S_4_EXTC_RANGE_780_CM 1 100. 0. 3. DISPLAY_IDENTIFIER STATE_CH_MOD ECU_ADDRESS 0xd0002ebb /end MEASUREMENT
/begin MEASUREMENT state_ch_mod_req "State of requested catalyst heating strategy, 1st priority" UBYTE _CNV_S_4_EXTC_RANGE_780_CM 1 100. 0. 3. DISPLAY_IDENTIFIER STATE_CH_MOD_REQ ECU_ADDRESS 0xd0002ebe /end MEASUREMENT
/begin MEASUREMENT state_ch_mod_l "Catlyst heating strategy for low load heating" UBYTE _CNV_S_4_EXTC_RANGE_780_CM 1 100. 0. 3. DISPLAY_IDENTIFIER STATE_CH_MOD_L ECU_ADDRESS 0xd0002ebd /end MEASUREMENT
/begin CHARACTERISTIC c_temp_cat_thd_swi_hom_ch_l "Threshold of catalyst temperature for switching from stratified to homogeneous in low load CH" VALUE 0xa10080ca _REC_VAL_20_u2 1023.984375 _CNV_A_R_LINEAR_____776_CM -33. 990.984375 DISPLAY_IDENTIFIER C_TEMP_CAT_THD_SWI_HOM_CH_L FORMAT "%10.6" /end CHARACTERISTIC
/begin CHARACTERISTIC c_tnt_mdl_h_thd_swi_hom_ch_l "Threshold of NOx trap temperature for switching from stratified to homogeneous in low load CH" VALUE 0xa10080d2 _REC_VAL_20_u2 1023.984375 _CNV_A_R_LINEAR_____197_CM 0. 1023.984375 DISPLAY_IDENTIFIER C_TNT_MDL_H_THD_SWI_HOM_CH_L FORMAT "%11.6" /end CHARACTERISTIC
/begin MEASUREMENT state_ch_mod_req_l "State of requested low load catalyst heating strategy, 1st priority" UBYTE _CNV_S_4_EXTC_RANGE_780_CM 1 100. 0. 3. DISPLAY_IDENTIFIER STATE_CH_MOD_REQ_L ECU_ADDRESS 0xd0002ec0 /end MEASUREMENT
/begin AXIS_PTS ldp_mff_post_ip_maf_dif_ch_l "" 0xa10062ac online_dummy _REC_AXS_20_u2 1389. _CNV_A_R_LINEAR_____108_CM 8 0. 1389. FORMAT "%7.2" /end AXIS_PTS
/begin AXIS_PTS ldp_mff_sp_ip_maf_dif_ch_l_bas "" 0xa10062d4 online_dummy _REC_AXS_20_u2 1389. _CNV_A_R_LINEAR_____108_CM 8 0. 1389. FORMAT "%7.2" /end AXIS_PTS
/begin AXIS_PTS ldp_n_32_ip_maf_dif_ch_l_bas "" 0xa1006340 n_32 _REC_AXS_20_u1 8160. _CNV_A_R_LINEAR_____9_CM 8 0. 8160. FORMAT "%4.0" /end AXIS_PTS
/begin CHARACTERISTIC ip_maf_dif_add_mff_post_ch_l "Mass of post injection depending correction for MAF_DIF" CURVE 0xa1007530 _REC_CUR_20_u2_u2 1389. _CNV_A_R_LINEAR_____108_CM 0. 1389. DISPLAY_IDENTIFIER IP_MAF_DIF_ADD_MFF_POST_CH_L FORMAT "%7.2"
 /begin AXIS_DESCR COM_AXIS online_dummy _CNV_A_R_LINEAR_____108_CM 8 0. 1389. FORMAT "%7.2" AXIS_PTS_REF ldp_mff_post_ip_maf_dif_ch_l /end AXIS_DESCR
/end CHARACTERISTIC
/begin CHARACTERISTIC ip_maf_dif_s_ch_l_bas "basic difference of mass of air flow for low load stratified catalyst heating" MAP 0xa1007540 _REC_MAP_20_u2_u1_u2 1389. _CNV_A_R_LINEAR_____108_CM 0. 1389. DISPLAY_IDENTIFIER IP_MAF_DIF_S_CH_L_BAS FORMAT "%7.2"
 /begin AXIS_DESCR COM_AXIS n_32 _CNV_A_R_LINEAR_____9_CM 6 0. 8160. FORMAT "%4.0" AXIS_PTS_REF ldpm_n_32_6_extc /end AXIS_DESCR
 /begin AXIS_DESCR COM_AXIS mff_sp_mv _CNV_A_R_LINEAR_____108_CM 6 0. 1389. FORMAT "%7.2" AXIS_PTS_REF ldpm_mff_sp_mv_2_extc /end AXIS_DESCR
/end CHARACTERISTIC
/begin CHARACTERISTIC c_maf_dif_s_ch_man "Manual setting of MAF difference for stratified catalyst heating" VALUE 0xa10080a2 _REC_VAL_20_u2 1389. _CNV_A_R_LINEAR_____108_CM 0. 1389. DISPLAY_IDENTIFIER C_MAF_DIF_S_CH_MAN FORMAT "%7.2" /end CHARACTERISTIC
/begin CHARACTERISTIC lc_maf_dif_s_ch_man_act "Activation of manual setting of MAF difference for stratified catalyst heating" VALUE 0xa100810c _REC_VAL_20_u1 1. _CNV_A_R_LINEAR_____0_CM 0. 1. DISPLAY_IDENTIFIER LC_MAF_DIF_S_CH_MAN_ACT FORMAT "%1.0" /end CHARACTERISTIC
/begin MEASUREMENT maf_dif_s_ch "Mass air flow difference for cat. heating in stratified mode (possibly with post injection)" UWORD _CNV_A_R_LINEAR_____108_CM 1 100. 0. 1389. DISPLAY_IDENTIFIER MAF_DIF_S_CH ECU_ADDRESS 0xd00026fc FORMAT "%7.2" /end MEASUREMENT
/begin MEASUREMENT tnt_dif_ch_so2p "Difference between desulfation setpoint and actual value of TNT" SWORD _CNV_A_R_LINEAR_____538_CM 1 100. -1024. 1023.96875 DISPLAY_IDENTIFIER TNT_DIF_CH_SO2P ECU_ADDRESS 0xd000273e FORMAT "%11.5" /end MEASUREMENT
/begin MEASUREMENT state_ch_mod_so2p "Catalyst heating strategy for desulfation catalyst heating" UBYTE _CNV_S_4_EXTC_RANGE_791_CM 1 100. 0. 3. DISPLAY_IDENTIFIER STATE_CH_MOD_SO2P ECU_ADDRESS 0xd0002ec2 /end MEASUREMENT
/begin MEASUREMENT state_ch_mod_req_so2p "Requested CH strategy (combustion mode) for desulfation catalyst heating" UBYTE _CNV_S_4_EXTC_RANGE_791_CM 1 100. 0. 3. DISPLAY_IDENTIFIER STATE_CH_MOD_REQ_SO2P ECU_ADDRESS 0xd0002ec1 /end MEASUREMENT
/begin CHARACTERISTIC c_tnt_sp_ch_so2p "Setpoint of TNT for desulfation catalyst heating" VALUE 0xa10080d6 _REC_VAL_20_u2 1023.984375 _CNV_A_R_LINEAR_____197_CM 0. 1023.984375 DISPLAY_IDENTIFIER C_TNT_SP_CH_SO2P FORMAT "%11.6" /end CHARACTERISTIC
/begin AXIS_PTS ldp_n_32_id_ch_mod_req_so2p "" 0xa10062e6 n_32 _REC_AXS_20_u1 8160. _CNV_A_R_LINEAR_____9_CM 6 0. 8160. FORMAT "%4.0" /end AXIS_PTS
/begin AXIS_PTS ldp_maf_id_ch_mod_req_so2p "" 0xa100622c maf _REC_AXS_20_u2 1389. _CNV_A_R_LINEAR_____108_CM 6 0. 1389. FORMAT "%7.2" /end AXIS_PTS
/begin CHARACTERISTIC id_state_ch_mod_req_so2p "Requested CH (combustion mode) for desulfation catalyst heating" MAP 0xa1006788 _REC_MAP_20_u1_u1_u2 3. _CNV_A_R_LINEAR_____0_CM 0. 3. DISPLAY_IDENTIFIER ID_STATE_CH_MOD_REQ_SO2P FORMAT "%1.0"
 /begin AXIS_DESCR COM_AXIS n_32 _CNV_A_R_LINEAR_____9_CM 6 0. 8160. FORMAT "%4.0" AXIS_PTS_REF ldp_n_32_id_ch_mod_req_so2p /end AXIS_DESCR
 /begin AXIS_DESCR COM_AXIS maf _CNV_A_R_LINEAR_____108_CM 6 0. 1389. FORMAT "%7.2" AXIS_PTS_REF ldp_maf_id_ch_mod_req_so2p /end AXIS_DESCR
/end CHARACTERISTIC
/begin MEASUREMENT fup_sp_ch "Fuel pressure setpoint for catalyst heading - used for MPLH-mode" UWORD _CNV_A_R_LINEAR_____152_CM 1 100. 0. 347776. DISPLAY_IDENTIFIER FUP_SP_CH ECU_ADDRESS 0xd00026f0 FORMAT "%6.0" /end MEASUREMENT
/begin CHARACTERISTIC c_fup_sp_ch_pas "Passive value for fuel pressure setpoint for catalyst heating" VALUE 0xa100809a _REC_VAL_20_u2 347776. _CNV_A_R_LINEAR_____152_CM 0. 347776. DISPLAY_IDENTIFIER C_FUP_SP_CH_PAS FORMAT "%6.0" /end CHARACTERISTIC
/begin AXIS_PTS ldp_tco_st_ip_fac_fup_sp_ch "Factor for fuel pressure setpoint during (MPLH)   catalyst heating" 0xa100647a tco_st _REC_AXS_20_u1 190.5 _CNV_A_R_LINEAR_____16_CM 4 -48. 142.5 FORMAT "%5.1" /end AXIS_PTS
/begin AXIS_PTS ldp_t_ast_ip_fac_fup_sp_ch "Factor for fuel pressure setpoint during (MPLH)   catalyst heating" 0xa10063d8 t_ast _REC_AXS_20_u2 6553.5 _CNV_A_R_LINEAR_____4_CM 6 0. 6553.5 FORMAT "%6.1" /end AXIS_PTS
/begin AXIS_PTS ldp_n_32_ip_fup_sp_ch "Fuel pressure setpoint for catalyst heating   used for MPLH mode" 0xa1006308 n_32 _REC_AXS_20_u1 8160. _CNV_A_R_LINEAR_____9_CM 6 0. 8160. FORMAT "%4.0" /end AXIS_PTS
/begin AXIS_PTS ldp_tqi_req_tra_ip_fup_sp_ch "Fuel pressure setpoint for catalyst heating   used for MPLH mode" 0xa1006574 tqi_req_tra _REC_AXS_20_u2 1023.96875 _CNV_A_R_LINEAR_____30_CM 6 0. 1023.96875 FORMAT "%7.2" /end AXIS_PTS
/begin MEASUREMENT pwm_acr "Finally duty cycle of idgital actuator control" SWORD _CNV_A_R_LINEAR_____201_CM 1 100. -100. 99.9969482421875 DISPLAY_IDENTIFIER PWM_ACR ECU_ADDRESS 0xd00024b0 FORMAT "%8.3" /end MEASUREMENT
/begin MEASUREMENT opg_dif_acr "Control deviation of the digital actuator conrol" SWORD _CNV_A_R_ACRC_LINEA_799_CM 1 100. -100. 99.9755859375 DISPLAY_IDENTIFIER OPG_DIF_ACR ECU_ADDRESS 0xd00024a0 FORMAT "%7.2" /end MEASUREMENT
/begin MEASUREMENT fac_vb_pwm_acr "Factor for battery voltage correction" UWORD _CNV_A_R_LINEAR_____122_CM 1 100. 0. 2. DISPLAY_IDENTIFIER FAC_VB_PWM_ACR ECU_ADDRESS 0xd000249c FORMAT "%4.3" /end MEASUREMENT
/begin MEASUREMENT opg_sp_ctl_acr "setpoint for digital actuator control" UWORD _CNV_A_R_ACRC_LINEA_799_CM 1 100. 0. 99.9755859375 DISPLAY_IDENTIFIER OPG_SP_CTL_ACR ECU_ADDRESS 0xd00024a6 FORMAT "%5.2" /end MEASUREMENT
/begin CHARACTERISTIC c_fac_c_1_acr_ctl "Filter parameter c1 of the ACR position controller" VALUE 0xa10010f4 _REC_VAL_20_s2 7.999878 _CNV_A_R_ACRC_LINEA_800_CM -4. 3.999878 DISPLAY_IDENTIFIER C_FAC_C_1_ACR_CTL FORMAT "%10.9" /end CHARACTERISTIC
/begin CHARACTERISTIC c_fac_c_2_acr_ctl "Filter parameter c2 of the ACR position controller" VALUE 0xa10010f6 _REC_VAL_20_s2 7.999878 _CNV_A_R_ACRC_LINEA_800_CM -4. 3.999878 DISPLAY_IDENTIFIER C_FAC_C_2_ACR_CTL FORMAT "%10.9" /end CHARACTERISTIC
/begin CHARACTERISTIC c_fac_c_3_acr_ctl "Filter parameter c3 of the ACR position controller" VALUE 0xa10010f8 _REC_VAL_20_s2 7.999878 _CNV_A_R_ACRC_LINEA_800_CM -4. 3.999878 DISPLAY_IDENTIFIER C_FAC_C_3_ACR_CTL FORMAT "%10.9" /end CHARACTERISTIC
/begin CHARACTERISTIC c_fac_f_1_acr_ctl "Filter parameter f1of the ACR position controller" VALUE 0xa10010fa _REC_VAL_20_s2 7.999878 _CNV_A_R_ACRC_LINEA_800_CM -4. 3.999878 DISPLAY_IDENTIFIER C_FAC_F_1_ACR_CTL FORMAT "%10.9" /end CHARACTERISTIC
/begin CHARACTERISTIC c_fac_f_2_acr_ctl "Filter parameter f2 of the ACR position controller" VALUE 0xa10010fc _REC_VAL_20_s2 7.999878 _CNV_A_R_ACRC_LINEA_800_CM -4. 3.999878 DISPLAY_IDENTIFIER C_FAC_F_2_ACR_CTL FORMAT "%10.9" /end CHARACTERISTIC
/begin CHARACTERISTIC c_fac_f_3_acr_ctl "Filter parameter f3 of the ACR position controller" VALUE 0xa10010fe _REC_VAL_20_s2 7.999878 _CNV_A_R_ACRC_LINEA_800_CM -4. 3.999878 DISPLAY_IDENTIFIER C_FAC_F_3_ACR_CTL FORMAT "%10.9" /end CHARACTERISTIC
/begin CHARACTERISTIC c_frq_pwm_acr "Frequency of the PWM signal used for closed-loop actuaor control" VALUE 0xa1001104 _REC_VAL_20_u2 6553.5 _CNV_A_R_ACRC_LINEA_801_CM 0. 6553.5 DISPLAY_IDENTIFIER C_FRQ_PWM_ACR FORMAT "%4.1" /end CHARACTERISTIC
/begin CHARACTERISTIC c_kp_acr_ctl "Amplification factor of the ACR position controller" VALUE 0xa1001106 _REC_VAL_20_u2 64. _CNV_A_R_EVAC_LINEA_314_CM 0. 64. DISPLAY_IDENTIFIER C_KP_ACR_CTL FORMAT "%4.3" /end CHARACTERISTIC
/begin CHARACTERISTIC c_pwm_acr_close "Static PWM duty cycle for the closing of the actuator" VALUE 0xa1001118 _REC_VAL_20_s2 199.9969482421875 _CNV_A_R_LINEAR_____201_CM -100. 99.9969482421875 DISPLAY_IDENTIFIER C_PWM_ACR_CLOSE FORMAT "%8.3" /end CHARACTERISTIC
/begin CHARACTERISTIC c_pwm_max_acr_ctl "Upper limitation threshold of the ACR position controller" VALUE 0xa100111c _REC_VAL_20_s2 199.9969482421875 _CNV_A_R_LINEAR_____201_CM -100. 99.9969482421875 DISPLAY_IDENTIFIER C_PWM_MAX_ACR_CTL FORMAT "%8.3" /end CHARACTERISTIC
/begin CHARACTERISTIC c_pwm_min_acr_ctl "Lower limitation threshold of the ACR position controller" VALUE 0xa100111e _REC_VAL_20_s2 199.9969482421875 _CNV_A_R_LINEAR_____201_CM -100. 99.9969482421875 DISPLAY_IDENTIFIER C_PWM_MIN_ACR_CTL FORMAT "%8.3" /end CHARACTERISTIC
/begin CHARACTERISTIC c_rate_opg_sp_acr "Setpoint rate limitation threshold of the ACR position controller" VALUE 0xa1001120 _REC_VAL_20_u2 99.9755859375 _CNV_A_R_ACRC_LINEA_799_CM 0. 99.9755859375 DISPLAY_IDENTIFIER C_RATE_OPG_SP_ACR FORMAT "%5.2" /end CHARACTERISTIC
/begin AXIS_PTS ldp_vb_mmv_ip_fac_vb_pwm_acr "" 0xa10010c2 vb_mmv _REC_AXS_20_u1 25.8984 _CNV_A_R_LINEAR_____21_CM 4 0. 25.8984 FORMAT "%3.1" /end AXIS_PTS
/begin CHARACTERISTIC ip_fac_vb_pwm_acr "Factor for battery voltage correction" CURVE 0xa10010c8 _REC_CUR_20_u2_u1 2. _CNV_A_R_LINEAR_____122_CM 0. 2. DISPLAY_IDENTIFIER IP_FAC_VB_PWM_ACR FORMAT "%4.3"
 /begin AXIS_DESCR COM_AXIS vb_mmv _CNV_A_R_LINEAR_____21_CM 4 0. 25.8984 FORMAT "%3.1" AXIS_PTS_REF ldp_vb_mmv_ip_fac_vb_pwm_acr /end AXIS_DESCR
/end CHARACTERISTIC
/begin AXIS_PTS ldp_opg_sp_acr_ip_pwm_acr_stat "" 0xa10010b8 opg_sp_acr _REC_AXS_20_u2 99.9755859375 _CNV_A_R_ACRC_LINEA_799_CM 4 0. 99.9755859375 FORMAT "%5.2" /end AXIS_PTS
/begin CHARACTERISTIC ip_pwm_acr_stat "Feedforward control of the ACR position controller" CURVE 0xa10010d8 _REC_CUR_20_u2_u2 199.99694824 _CNV_A_R_LINEAR_____225_CM -100. 99.99694824 DISPLAY_IDENTIFIER IP_PWM_ACR_STAT FORMAT "%8.3"
 /begin AXIS_DESCR COM_AXIS opg_sp_acr _CNV_A_R_ACRC_LINEA_799_CM 4 0. 99.9755859375 FORMAT "%5.2" AXIS_PTS_REF ldp_opg_sp_acr_ip_pwm_acr_stat /end AXIS_DESCR
/end CHARACTERISTIC
/begin MEASUREMENT state_acr_ctl "The state variable indicates the state of the ACR position contotrol" UBYTE _CNV_S_3_ACRC_RANGE_802_CM 1 100. 0. 2. DISPLAY_IDENTIFIER STATE_ACR_CTL ECU_ADDRESS 0xd0002ce7 /end MEASUREMENT
/begin MEASUREMENT lv_err_acr_ctl "Present failure for the actuator diagnosis after the error debounce" UBYTE _CNV_S_2_RANGE__0___1_CM 1 100. 0. 1. DISPLAY_IDENTIFIER LV_ERR_ACR_CTL ECU_ADDRESS 0xd00034cd BIT_MASK 0x1 /end MEASUREMENT
/begin MEASUREMENT ctr_diag_acr_ctl "Anti bounce counter for the actuator diagnosis" UBYTE _CNV_A_R_LINEAR_____0_CM 1 100. 0. 255. DISPLAY_IDENTIFIER CTR_DIAG_ACR_CTL ECU_ADDRESS 0xd0002cd9 FORMAT "%3.0" /end MEASUREMENT
/begin MEASUREMENT pwm_acr_mmv "Moving mean value of the actuator position controller output" UWORD _CNV_A_R_LINEAR_____201_CM 1 100. 0. 99.9969482421875 DISPLAY_IDENTIFIER PWM_ACR_MMV ECU_ADDRESS 0xc0000226 FORMAT "%7.3" /end MEASUREMENT
/begin MEASUREMENT opg_sp_acr_fil "Actuator valve position setpoint after filtering by low pass first order" UWORD _CNV_A_R_ACRC_LINEA_799_CM 1 100. 0. 99.9755859375 DISPLAY_IDENTIFIER OPG_SP_ACR_FIL ECU_ADDRESS 0xc0000222 FORMAT "%5.2" /end MEASUREMENT
/begin MEASUREMENT opg_dif_acr_err_max "Maximum admissible control deviation of the closed loop position control system" UWORD _CNV_A_R_ACRC_LINEA_799_CM 1 100. 0. 99.9755859375 DISPLAY_IDENTIFIER OPG_DIF_ACR_ERR_MAX ECU_ADDRESS 0xc0000220 FORMAT "%5.2" /end MEASUREMENT
/begin MEASUREMENT opg_sp_acr_grd "Gradient of the actuator valve position setpoint determined by low pass first order" SWORD _CNV_A_R_ACRC_LINEA_799_CM 1 100. -100. 99.9755859375 DISPLAY_IDENTIFIER OPG_SP_ACR_GRD ECU_ADDRESS 0xc0000224 FORMAT "%7.2" /end MEASUREMENT
/begin CHARACTERISTIC c_abc_dec_acr_ctl "Anti bounce counter decrement for the actuator diagnosis" VALUE 0xa10010e0 _REC_VAL_20_u1 255. _CNV_A_R_LINEAR_____0_CM 0. 255. DISPLAY_IDENTIFIER C_ABC_DEC_ACR_CTL FORMAT "%3.0" /end CHARACTERISTIC
/begin CHARACTERISTIC c_abc_inc_acr_ctl "Anti bounce counter increment for the actuator diagnosis" VALUE 0xa10010e1 _REC_VAL_20_u1 255. _CNV_A_R_LINEAR_____0_CM 0. 255. DISPLAY_IDENTIFIER C_ABC_INC_ACR_CTL FORMAT "%3.0" /end CHARACTERISTIC
/begin CHARACTERISTIC c_abc_max_acr_ctl "Maximum value for anti bounce counter for the actuator diagnosis" VALUE 0xa10010e4 _REC_VAL_20_u1 254. _CNV_A_R_LINEAR_____0_CM 1. 255. DISPLAY_IDENTIFIER C_ABC_MAX_ACR_CTL FORMAT "%3.0" /end CHARACTERISTIC
/begin CHARACTERISTIC c_crlc_opg_sp_acr "Correlation constant for filtering of OPG_SP_ACR" VALUE 0xa10010e8 _REC_VAL_20_u2 0.9999847412109381 _CNV_A_R_LINEAR_____68_CM 0. 0.9999847412109381 DISPLAY_IDENTIFIER C_CRLC_OPG_SP_ACR FORMAT "%7.5" /end CHARACTERISTIC
/begin CHARACTERISTIC c_crlc_pwm_acr "Correlation constant for filtering of PWM_ACR" VALUE 0xa10010ea _REC_VAL_20_u2 0.9999847412109381 _CNV_A_R_LINEAR_____68_CM 0. 0.9999847412109381 DISPLAY_IDENTIFIER C_CRLC_PWM_ACR FORMAT "%7.5" /end CHARACTERISTIC
/begin CHARACTERISTIC c_pwm_acr_max_diag "Maximum permitted PWM output of the ACR position controller" VALUE 0xa100111a _REC_VAL_20_u2 99.9969482421875 _CNV_A_R_LINEAR_____201_CM 0. 99.9969482421875 DISPLAY_IDENTIFIER C_PWM_ACR_MAX_DIAG FORMAT "%7.3" /end CHARACTERISTIC
/begin CHARACTERISTIC c_vb_min_pwm_acr_diag "Threshold depend on battery voltage for the activation of the PWM_ACR monitoring" VALUE 0xa1001135 _REC_VAL_20_u1 25.8984375 _CNV_A_R_LINEAR_____289_CM 0. 25.8984375 DISPLAY_IDENTIFIER C_VB_MIN_PWM_ACR_DIAG FORMAT "%9.6" /end CHARACTERISTIC
/begin CHARACTERISTIC ip_opg_dif_acr_err_max "Maximum admissible control deviation dependent on the actuator valve setpoint gradient" CURVE 0xa10010d0 _REC_CUR_20_u2_u2 99.9755859375 _CNV_A_R_ACRC_LINEA_799_CM 0. 99.9755859375 DISPLAY_IDENTIFIER IP_OPG_DIF_ACR_ERR_MAX FORMAT "%5.2"
 /begin AXIS_DESCR COM_AXIS opg_sp_acr_grd _CNV_A_R_ACRC_LINEA_799_CM 4 0. 99.9755859375 FORMAT "%5.2" AXIS_PTS_REF ldp_opg_sp_acr_grd_absv_ip_opg /end AXIS_DESCR
/end CHARACTERISTIC
/begin AXIS_PTS ldp_opg_sp_acr_grd_absv_ip_opg "" 0xa10010ac opg_sp_acr_grd _REC_AXS_20_u2 99.9755859375 _CNV_A_R_ACRC_LINEA_799_CM 4 0. 99.9755859375 FORMAT "%5.2" /end AXIS_PTS
/begin MEASUREMENT lv_inh_diag_acr_ctl "Inhibition condition for the actuator diagnosis" UBYTE _CNV_S_2_RANGE__0___1_CM 1 100. 0. 1. DISPLAY_IDENTIFIER LV_INH_DIAG_ACR_CTL ECU_ADDRESS 0xd0002cf0 BIT_MASK 0x1 /end MEASUREMENT
/begin MEASUREMENT lv_pwm_acr_off_req "ACR position control deactivation requested from monitoring level 1" UBYTE _CNV_S_2_RANGE__0___1_CM 1 100. 0. 1. DISPLAY_IDENTIFIER LV_PWM_ACR_OFF_REQ ECU_ADDRESS 0xd0002cf4 BIT_MASK 0x1 /end MEASUREMENT
/begin MEASUREMENT lv_err_sens_acr "Present failure for sensor signal range check after error debounce" UBYTE _CNV_S_2_RANGE__0___1_CM 1 100. 0. 1. DISPLAY_IDENTIFIER LV_ERR_SENS_ACR ECU_ADDRESS 0xd00034cc BIT_MASK 0x1 /end MEASUREMENT
/begin CHARACTERISTIC c_abc_inc_sens_acr "Anti bounce counter increment for signal range check" VALUE 0xa10010e3 _REC_VAL_20_u1 255. _CNV_A_R_LINEAR_____0_CM 0. 255. DISPLAY_IDENTIFIER C_ABC_INC_SENS_ACR FORMAT "%3.0" /end CHARACTERISTIC
/begin CHARACTERISTIC c_abc_max_sens_acr "Maximum value for anti bounce counter for signal range check" VALUE 0xa10010e6 _REC_VAL_20_u1 254. _CNV_A_R_LINEAR_____0_CM 1. 255. DISPLAY_IDENTIFIER C_ABC_MAX_SENS_ACR FORMAT "%3.0" /end CHARACTERISTIC
/begin CHARACTERISTIC c_v_max_sens_acr "Upper diagnostic threshold for the signal range check" VALUE 0xa1001130 _REC_VAL_20_u2 4.9951171875 _CNV_A_R_LINEAR_____2_CM 0. 4.9951171875 DISPLAY_IDENTIFIER C_V_MAX_SENS_ACR FORMAT "%5.3" /end CHARACTERISTIC
/begin CHARACTERISTIC c_v_min_sens_acr "Lower diagnostic threshold for the signal range check" VALUE 0xa1001132 _REC_VAL_20_u2 4.9951171875 _CNV_A_R_LINEAR_____2_CM 0. 4.9951171875 DISPLAY_IDENTIFIER C_V_MIN_SENS_ACR FORMAT "%5.3" /end CHARACTERISTIC
/begin MEASUREMENT lv_inh_diag_sens_acr "Inhibition condition for the position sensor range check" UBYTE _CNV_S_2_RANGE__0___1_CM 1 100. 0. 1. DISPLAY_IDENTIFIER LV_INH_DIAG_SENS_ACR ECU_ADDRESS 0xd0002cf2 BIT_MASK 0x1 /end MEASUREMENT
/begin MEASUREMENT lv_err_vcc_acr "Actuator sensor supply voltage error, variable is not supported by ERRM" UBYTE _CNV_S_2_RANGE__0___1_CM 1 100. 0. 1. DISPLAY_IDENTIFIER LV_ERR_VCC_ACR ECU_ADDRESS 0xd0002cee BIT_MASK 0x1 /end MEASUREMENT
/begin MEASUREMENT lv_err_acr_dr "Present failure for power stage diagnosis after error debounce " UBYTE _CNV_S_2_RANGE__0___1_CM 1 100. 0. 1. DISPLAY_IDENTIFIER LV_ERR_ACR_DR ECU_ADDRESS 0xd00034ce BIT_MASK 0x1 /end MEASUREMENT
/begin CHARACTERISTIC c_abc_inc_acr_dr "Anti bounce counter increment for the power stage diagnosis" VALUE 0xa10010e2 _REC_VAL_20_u1 255. _CNV_A_R_LINEAR_____0_CM 0. 255. DISPLAY_IDENTIFIER C_ABC_INC_ACR_DR FORMAT "%3.0" /end CHARACTERISTIC
/begin CHARACTERISTIC c_abc_max_acr_dr "Maximum value for anti bounce counter for the power stage diagnosis" VALUE 0xa10010e5 _REC_VAL_20_u1 254. _CNV_A_R_LINEAR_____0_CM 1. 255. DISPLAY_IDENTIFIER C_ABC_MAX_ACR_DR FORMAT "%3.0" /end CHARACTERISTIC
/begin MEASUREMENT lv_inh_diag_acr_dr "Inhibition condition for the power stage diagnosis" UBYTE _CNV_S_2_RANGE__0___1_CM 1 100. 0. 1. DISPLAY_IDENTIFIER LV_INH_DIAG_ACR_DR ECU_ADDRESS 0xd0002cf1 BIT_MASK 0x1 /end MEASUREMENT
/begin CHARACTERISTIC c_vb_min_acr_dr_diag "Minimum threshold for the activation/deactivation of the power stage diagnosis" VALUE 0xa1001134 _REC_VAL_20_u1 25.8984375 _CNV_A_R_LINEAR_____289_CM 0. 25.8984375 DISPLAY_IDENTIFIER C_VB_MIN_ACR_DR_DIAG FORMAT "%9.6" /end CHARACTERISTIC
/begin MEASUREMENT opg_acr "Measured opening of the actuator valve" UWORD _CNV_A_R_ACRC_LINEA_799_CM 1 100. 0. 99.9755859375 DISPLAY_IDENTIFIER OPG_ACR ECU_ADDRESS 0xd000249e FORMAT "%5.2" /end MEASUREMENT
/begin MEASUREMENT v_acr "Voltage value for actuator position control delivered from the measuring system" UWORD _CNV_A_R_LINEAR_____218_CM 1 100. 0. 4.995 DISPLAY_IDENTIFIER V_ACR ECU_ADDRESS 0xd00024b2 FORMAT "%5.3" /end MEASUREMENT
/begin MEASUREMENT v_acr_mv "Voltage value for actuator position control delivered from the measuring system with higher resolution" UWORD _CNV_A_R_ACRC_LINEA_803_CM 1 100. 0. 4.9951 DISPLAY_IDENTIFIER V_ACR_MV ECU_ADDRESS 0xd00024ba FORMAT "%3.2" /end MEASUREMENT
/begin MEASUREMENT v_acr_bas "Raw value of the measuring system for sctuator position control" UWORD _CNV_A_R_LINEAR_____218_CM 1 100. 0. 4.995 DISPLAY_IDENTIFIER V_ACR_BAS ECU_ADDRESS 0xd00024b8 FORMAT "%5.3" /end MEASUREMENT
/begin MEASUREMENT opg_sp_acr "Setpoint request after limitation for actuator position control" UWORD _CNV_A_R_ACRC_LINEA_799_CM 1 100. 0. 99.9755859375 DISPLAY_IDENTIFIER OPG_SP_ACR ECU_ADDRESS 0xd00024a2 FORMAT "%5.2" /end MEASUREMENT
/begin CHARACTERISTIC c_opg_sp_max_acr "Upper limitation theshold of the actuator position setpoint" VALUE 0xa100110e _REC_VAL_20_u2 99.9755859375 _CNV_A_R_ACRC_LINEA_799_CM 0. 99.9755859375 DISPLAY_IDENTIFIER C_OPG_SP_MAX_ACR FORMAT "%5.2" /end CHARACTERISTIC
/begin CHARACTERISTIC c_opg_sp_min_acr "Lower limitation threshold of the actuator position setpoint" VALUE 0xa1001112 _REC_VAL_20_u2 99.9755859375 _CNV_A_R_ACRC_LINEA_799_CM 0. 99.9755859375 DISPLAY_IDENTIFIER C_OPG_SP_MIN_ACR FORMAT "%5.2" /end CHARACTERISTIC
/begin MEASUREMENT opg_sp_sel_acr "Setpoint request after setpoint selection for actuator position control" UWORD _CNV_A_R_ACRC_LINEA_799_CM 1 100. 0. 99.9755859375 DISPLAY_IDENTIFIER OPG_SP_SEL_ACR ECU_ADDRESS 0xd00024ae FORMAT "%5.2" /end MEASUREMENT
/begin MEASUREMENT lv_opg_sp_lih_acr "Logical variable indicates a LIH setpoint request for actuator position control" UBYTE _CNV_S_2_RANGE__0___1_CM 1 100. 0. 1. DISPLAY_IDENTIFIER LV_OPG_SP_LIH_ACR ECU_ADDRESS 0xd0002ce2 BIT_MASK 0x1 /end MEASUREMENT
/begin MEASUREMENT opg_sp_lih_acr "Limp-home position setpoint for actuator position control" UWORD _CNV_A_R_ACRC_LINEA_799_CM 1 100. 0. 99.9755859375 DISPLAY_IDENTIFIER OPG_SP_LIH_ACR ECU_ADDRESS 0xd00024aa FORMAT "%5.2" /end MEASUREMENT
/begin MEASUREMENT lv_opg_sp_ext_acr "Logical variable indicates a external setpoint request for actuator position control" UBYTE _CNV_S_2_RANGE__0___1_CM 1 100. 0. 1. DISPLAY_IDENTIFIER LV_OPG_SP_EXT_ACR ECU_ADDRESS 0xd0002ce1 BIT_MASK 0x1 /end MEASUREMENT
/begin MEASUREMENT opg_sp_ext_acr "External position setpoint for actuator position control" UWORD _CNV_A_R_ACRC_LINEA_799_CM 1 100. 0. 99.9755859375 DISPLAY_IDENTIFIER OPG_SP_EXT_ACR ECU_ADDRESS 0xd00024a8 FORMAT "%5.2" /end MEASUREMENT
/begin MEASUREMENT lv_opg_sp_pop_acr "Lagical variable indicates a setpoint request during the post operating phase for actuator position control" UBYTE _CNV_S_2_RANGE__0___1_CM 1 100. 0. 1. DISPLAY_IDENTIFIER LV_OPG_SP_POP_ACR ECU_ADDRESS 0xd0002ce3 BIT_MASK 0x1 /end MEASUREMENT
/begin MEASUREMENT opg_sp_pop_acr "Position setpoint during post operating phase for actuator position control" UWORD _CNV_A_R_ACRC_LINEA_799_CM 1 100. 0. 99.9755859375 DISPLAY_IDENTIFIER OPG_SP_POP_ACR ECU_ADDRESS 0xd00024ac FORMAT "%5.2" /end MEASUREMENT
/begin MEASUREMENT state_acr_ctl_req "The state variable indicates the request for digital actuator control" UBYTE _CNV_S_3_ACRC_RANGE_804_CM 1 100. 0. 2. DISPLAY_IDENTIFIER STATE_ACR_CTL_REQ ECU_ADDRESS 0xd0002ce8 /end MEASUREMENT
/begin CHARACTERISTIC c_ctr_dly_acr_ctl "Time delay for the deactivation of the actuator position control" VALUE 0xa10010ef _REC_VAL_20_u1 255. _CNV_A_R_LINEAR_____0_CM 0. 255. DISPLAY_IDENTIFIER C_CTR_DLY_ACR_CTL FORMAT "%3.0" /end CHARACTERISTIC
/begin CHARACTERISTIC c_ctr_opg_sp_pop_acr "Delay counter for the deactivation of the position controller in the post-operating phase" VALUE 0xa10010f1 _REC_VAL_20_u1 255. _CNV_A_R_LINEAR_____0_CM 0. 255. DISPLAY_IDENTIFIER C_CTR_OPG_SP_POP_ACR FORMAT "%3.0" /end CHARACTERISTIC
/begin CHARACTERISTIC c_opg_sp_ext_acr "External position setpoint requested from the calibration system" VALUE 0xa100110a _REC_VAL_20_u2 99.9755859375 _CNV_A_R_ACRC_LINEA_799_CM 0. 99.9755859375 DISPLAY_IDENTIFIER C_OPG_SP_EXT_ACR FORMAT "%5.2" /end CHARACTERISTIC
/begin CHARACTERISTIC c_opg_sp_lih_acr "Position setpoint requestedduring limp-home mode has been activated" VALUE 0xa100110c _REC_VAL_20_u2 99.9755859375 _CNV_A_R_ACRC_LINEA_799_CM 0. 99.9755859375 DISPLAY_IDENTIFIER C_OPG_SP_LIH_ACR FORMAT "%5.2" /end CHARACTERISTIC
/begin CHARACTERISTIC c_opg_sp_min_acr_ctl "Deactivation threshold for actuator position control in normal operation" VALUE 0xa1001114 _REC_VAL_20_u2 99.9755859375 _CNV_A_R_ACRC_LINEA_799_CM 0. 99.9755859375 DISPLAY_IDENTIFIER C_OPG_SP_MIN_ACR_CTL FORMAT "%5.2" /end CHARACTERISTIC
/begin CHARACTERISTIC c_opg_sp_pop_acr "Position setpoint request in the post-operating phase" VALUE 0xa1001116 _REC_VAL_20_u2 99.9755859375 _CNV_A_R_ACRC_LINEA_799_CM 0. 99.9755859375 DISPLAY_IDENTIFIER C_OPG_SP_POP_ACR FORMAT "%5.2" /end CHARACTERISTIC
/begin CHARACTERISTIC lc_opg_sp_ext_acr "Activation of hte external setpoint adjustment made with the calibration system" VALUE 0xa1001138 _REC_VAL_20_u1 1. _CNV_S_2_RANGE__0___1_CM 0. 1. DISPLAY_IDENTIFIER LC_OPG_SP_EXT_ACR /end CHARACTERISTIC
/begin CHARACTERISTIC lc_pwm_acr_off_ena "Logical canstant distinguishs between power stage deactivation and static PWM duty-cycle for actuator closing" VALUE 0xa1001139 _REC_VAL_20_u1 1. _CNV_S_2_RANGE__0___1_CM 0. 1. DISPLAY_IDENTIFIER LC_PWM_ACR_OFF_ENA /end CHARACTERISTIC
/begin MEASUREMENT lv_inh_acr_ctl_ad "Logical variable to inhibit actuator position control" UBYTE _CNV_S_2_RANGE__0___1_CM 1 100. 0. 1. DISPLAY_IDENTIFIER LV_INH_ACR_CTL_AD ECU_ADDRESS 0xd0002ce0 BIT_MASK 0x1 /end MEASUREMENT
/begin MEASUREMENT fac_acr_slop "Signal slop of the actuator measuring system" UWORD _CNV_A_R_ACRC_LINEA_805_CM 1 100. 0. 99.99850000000001 DISPLAY_IDENTIFIER FAC_ACR_SLOP ECU_ADDRESS 0xd000249a FORMAT "%3.2" /end MEASUREMENT
/begin MEASUREMENT v_acr_ad_bol "Adaption value for the lower mechanical stop of the actuator valve" UWORD _CNV_A_R_LINEAR_____2_CM 1 100. 0. 4.9951171875 DISPLAY_IDENTIFIER V_ACR_AD_BOL ECU_ADDRESS 0xd00024b4 FORMAT "%5.3" /end MEASUREMENT
/begin MEASUREMENT ctr_dly_acr_ad "Delay counter for the activation of the actuator adaption" UBYTE _CNV_A_R_LINEAR_____0_CM 1 100. 0. 255. DISPLAY_IDENTIFIER CTR_DLY_ACR_AD ECU_ADDRESS 0xd0002cda FORMAT "%3.0" /end MEASUREMENT
/begin MEASUREMENT ctr_inh_acr_ad "Counter variable to inhibit actuator position control for valid adaption value" UBYTE _CNV_A_R_LINEAR_____0_CM 1 100. 0. 255. DISPLAY_IDENTIFIER CTR_INH_ACR_AD ECU_ADDRESS 0xd0002cdb FORMAT "%3.0" /end MEASUREMENT
/begin CHARACTERISTIC c_crlc_acr_ad "Correlation constant for the determination of the actuator adaption value" VALUE 0xa10010e7 _REC_VAL_20_u1 0.99609375 _CNV_A_R_LINEAR_____27_CM 0. 0.99609375 DISPLAY_IDENTIFIER C_CRLC_ACR_AD FORMAT "%5.3" /end CHARACTERISTIC
/begin CHARACTERISTIC c_ctr_dly_acr_ad_max "Delay counter for the activation of the actuator adaption" VALUE 0xa10010ee _REC_VAL_20_u1 255. _CNV_A_R_LINEAR_____0_CM 0. 255. DISPLAY_IDENTIFIER C_CTR_DLY_ACR_AD_MAX FORMAT "%3.0" /end CHARACTERISTIC
/begin CHARACTERISTIC c_ctr_inh_acr_ad_max "Maximum counter to inhibit actuator position control for valid adaption value" VALUE 0xa10010f0 _REC_VAL_20_u1 255. _CNV_A_R_LINEAR_____0_CM 0. 255. DISPLAY_IDENTIFIER C_CTR_INH_ACR_AD_MAX FORMAT "%3.0" /end CHARACTERISTIC
/begin CHARACTERISTIC c_fac_acr_slop "Signal slop of the actuator measuring system" VALUE 0xa10010f2 _REC_VAL_20_u2 99.99850000000001 _CNV_A_R_ACRC_LINEA_805_CM 0. 99.99850000000001 DISPLAY_IDENTIFIER C_FAC_ACR_SLOP FORMAT "%3.2" /end CHARACTERISTIC
/begin CHARACTERISTIC c_v_acr_ad_bol_ini "Initialisation value for the adapption value of the lower mechanical stop" VALUE 0xa1001122 _REC_VAL_20_u2 4.9951171875 _CNV_A_R_LINEAR_____2_CM 0. 4.9951171875 DISPLAY_IDENTIFIER C_V_ACR_AD_BOL_INI FORMAT "%5.3" /end CHARACTERISTIC
/begin CHARACTERISTIC c_v_acr_ad_bol_max "Upper limit for the plausibility check of the adaption value for the lower mechanical stop" VALUE 0xa1001124 _REC_VAL_20_u2 4.9951171875 _CNV_A_R_LINEAR_____2_CM 0. 4.9951171875 DISPLAY_IDENTIFIER C_V_ACR_AD_BOL_MAX FORMAT "%5.3" /end CHARACTERISTIC
/begin CHARACTERISTIC c_v_acr_ad_bol_min "Lower limit for the plausibility check of the adaption value for the lower mechanical stop" VALUE 0xa1001126 _REC_VAL_20_u2 4.9951171875 _CNV_A_R_LINEAR_____2_CM 0. 4.9951171875 DISPLAY_IDENTIFIER C_V_ACR_AD_BOL_MIN FORMAT "%5.3" /end CHARACTERISTIC
/begin MEASUREMENT lv_err_acr_ad "Logical variable is set, if an adaption error occurs" UBYTE _CNV_S_2_RANGE__0___1_CM 1 100. 0. 1. DISPLAY_IDENTIFIER LV_ERR_ACR_AD ECU_ADDRESS 0xd00034cb BIT_MASK 0x1 /end MEASUREMENT
/begin MEASUREMENT state_acr_ad "Variable indicate the state of the key on actuator adaption" UBYTE _CNV_S_5_ACRC_RANGE_806_CM 1 100. 0. 4. DISPLAY_IDENTIFIER STATE_ACR_AD ECU_ADDRESS 0xd0002ce6 /end MEASUREMENT
/begin MEASUREMENT lv_opg_sp_ad_acr "Lagical variable indicates a setpoint request for the actuator adaption" UBYTE _CNV_S_2_RANGE__0___1_CM 1 100. 0. 1. DISPLAY_IDENTIFIER LV_OPG_SP_AD_ACR ECU_ADDRESS 0xd0002cf3 BIT_MASK 0x1 /end MEASUREMENT
/begin MEASUREMENT opg_sp_ad_acr "Actuator adaption setpoint request for actuator position control" UWORD _CNV_A_R_ACRC_LINEA_799_CM 1 100. 0. 99.9755859375 DISPLAY_IDENTIFIER OPG_SP_AD_ACR ECU_ADDRESS 0xd00024a4 FORMAT "%5.2" /end MEASUREMENT
/begin CHARACTERISTIC c_ctr_acr_ad "Maximum time for the adaption of the lower and upper mechanical stop" VALUE 0xa10010ec _REC_VAL_20_u1 255. _CNV_A_R_LINEAR_____0_CM 0. 255. DISPLAY_IDENTIFIER C_CTR_ACR_AD FORMAT "%3.0" /end CHARACTERISTIC
/begin CHARACTERISTIC c_ctr_dly_acr_ad "Delay time befor adaption of the lower and upper mechanical stop will be started" VALUE 0xa10010ed _REC_VAL_20_u1 255. _CNV_A_R_LINEAR_____0_CM 0. 255. DISPLAY_IDENTIFIER C_CTR_DLY_ACR_AD FORMAT "%3.0" /end CHARACTERISTIC
/begin CHARACTERISTIC c_opg_sp_ad_lgrd "Change limitation for the adaption of the upper mechanical stop" VALUE 0xa1001108 _REC_VAL_20_u2 99.9755859375 _CNV_A_R_ACRC_LINEA_799_CM 0. 99.9755859375 DISPLAY_IDENTIFIER C_OPG_SP_AD_LGRD FORMAT "%5.2" /end CHARACTERISTIC
/begin CHARACTERISTIC c_opg_sp_max_ad_acr "Start setpoint for the adaption of the upper mechanical stop" VALUE 0xa1001110 _REC_VAL_20_u2 99.9755859375 _CNV_A_R_ACRC_LINEA_799_CM 0. 99.9755859375 DISPLAY_IDENTIFIER C_OPG_SP_MAX_AD_ACR FORMAT "%5.2" /end CHARACTERISTIC
/begin CHARACTERISTIC c_v_acr_ad_chk_ctl "Threshold for the actuator function check during the upper mechanical stop adaption" VALUE 0xa1001128 _REC_VAL_20_u2 4.9951171875 _CNV_A_R_LINEAR_____2_CM 0. 4.9951171875 DISPLAY_IDENTIFIER C_V_ACR_AD_CHK_CTL FORMAT "%5.3" /end CHARACTERISTIC
/begin CHARACTERISTIC c_v_acr_ad_tol_ini "Initialisation value of the upper mechanical stop" VALUE 0xa100112a _REC_VAL_20_u2 4.995 _CNV_A_R_LINEAR_____218_CM 0. 4.995 DISPLAY_IDENTIFIER C_V_ACR_AD_TOL_INI FORMAT "%5.3" /end CHARACTERISTIC
/begin CHARACTERISTIC c_v_acr_ad_tol_max "Upper limit for the plausibility check of the adaption value for the upper mechanical stop" VALUE 0xa100112c _REC_VAL_20_u2 4.995 _CNV_A_R_LINEAR_____218_CM 0. 4.995 DISPLAY_IDENTIFIER C_V_ACR_AD_TOL_MAX FORMAT "%5.3" /end CHARACTERISTIC
/begin CHARACTERISTIC lc_fac_acr_slop_ad_ena "Logical constant to enable the adaption of the upper mechanical stop" VALUE 0xa1001137 _REC_VAL_20_u1 1. _CNV_S_2_RANGE__0___1_CM 0. 1. DISPLAY_IDENTIFIER LC_FAC_ACR_SLOP_AD_ENA /end CHARACTERISTIC
/begin CHARACTERISTIC c_v_acr_ad_tol_min "Lower limit for the plausibility check of the adaption value for the upper mechanical stop" VALUE 0xa100112e _REC_VAL_20_u2 4.995 _CNV_A_R_LINEAR_____218_CM 0. 4.995 DISPLAY_IDENTIFIER C_V_ACR_AD_TOL_MIN FORMAT "%5.3" /end CHARACTERISTIC
/begin MEASUREMENT v_acr_ad_tol "Adaption value for the upper mechanical stop" UWORD _CNV_A_R_LINEAR_____2_CM 1 100. 0. 4.9951171875 DISPLAY_IDENTIFIER V_ACR_AD_TOL ECU_ADDRESS 0xd00024b6 FORMAT "%5.3" /end MEASUREMENT
/begin MEASUREMENT lv_inh_acr_ad "Inhibition condition for the actuator adapion and diagnosis" UBYTE _CNV_S_2_RANGE__0___1_CM 1 100. 0. 1. DISPLAY_IDENTIFIER LV_INH_ACR_AD ECU_ADDRESS 0xd0002cdf BIT_MASK 0x1 /end MEASUREMENT
/begin MEASUREMENT lv_acr_ad_act "Logical variable to indicate an active actuator adaption" UBYTE _CNV_S_2_RANGE__0___1_CM 1 100. 0. 1. DISPLAY_IDENTIFIER LV_ACR_AD_ACT ECU_ADDRESS 0xd0002cec BIT_MASK 0x1 /end MEASUREMENT
/begin MEASUREMENT lv_acr_ad_req "Logical variable to indicate an actuator adaption request" UBYTE _CNV_S_2_RANGE__0___1_CM 1 100. 0. 1. DISPLAY_IDENTIFIER LV_ACR_AD_REQ ECU_ADDRESS 0xd0002ced BIT_MASK 0x1 /end MEASUREMENT
/begin MEASUREMENT lv_inh_acr_ad_bol "Inhibition condition for the continuous actuator adaption and diagnosis" UBYTE _CNV_S_2_RANGE__0___1_CM 1 100. 0. 1. DISPLAY_IDENTIFIER LV_INH_ACR_AD_BOL ECU_ADDRESS 0xd0002cef BIT_MASK 0x1 /end MEASUREMENT
/begin CHARACTERISTIC lc_acr_ad_req "Logigal variable to set a new adaption request" VALUE 0xa1001136 _REC_VAL_20_u1 1. _CNV_S_2_RANGE__0___1_CM 0. 1. DISPLAY_IDENTIFIER LC_ACR_AD_REQ /end CHARACTERISTIC
/begin COMPU_METHOD _CNV_A_R_LINEAR_____0_CM "" RAT_FUNC "%6.3" "-" COEFFS 0 1. 0. 0 0 1 /end COMPU_METHOD
/begin COMPU_METHOD _CNV_S_2_RANGE__0___1_CM "" TAB_VERB "%6.3" "-" COMPU_TAB_REF _CNV_S_2_RANGE__0___1 /end COMPU_METHOD
/begin COMPU_VTAB _CNV_S_2_RANGE__0___1 "" TAB_VERB 2 0 "0" 1 "1" /end COMPU_VTAB
/begin COMPU_METHOD _CNV_A_R_LINEAR_____2_CM "" RAT_FUNC "%6.3" "V" COEFFS 0 204.8 0. 0 0 1 /end COMPU_METHOD
/begin COMPU_METHOD _CNV_A_R_LINEAR_____3_CM "" RAT_FUNC "%6.3" "s" COEFFS 0 100. 0. 0 0 1 /end COMPU_METHOD
/begin COMPU_METHOD _CNV_A_R_LINEAR_____4_CM "" RAT_FUNC "%6.3" "s" COEFFS 0 10. 0. 0 0 1 /end COMPU_METHOD
/begin COMPU_METHOD _CNV_A_R_LINEAR_____6_CM "" RAT_FUNC "%6.3" "km/h" COEFFS 0 1. 0. 0 0 1 /end COMPU_METHOD
/begin COMPU_METHOD _CNV_A_R_LINEAR_____8_CM "" RAT_FUNC "%6.3" "-" COEFFS 0 32767.99999999992 0. 0 0 1 /end COMPU_METHOD
/begin COMPU_METHOD _CNV_A_R_LINEAR_____9_CM "" RAT_FUNC "%6.3" "rpm" COEFFS 0 3.125e-002 0. 0 0 1 /end COMPU_METHOD
/begin COMPU_METHOD _CNV_A_R_LINEAR_____13_CM "" RAT_FUNC "%6.3" "rpm" COEFFS 0 1. 0. 0 0 1 /end COMPU_METHOD
/begin COMPU_METHOD _CNV_A_R_LINEAR_____16_CM "" RAT_FUNC "%6.3" "°C" COEFFS 0 1.333333333333333 64. 0 0 1 /end COMPU_METHOD
/begin COMPU_METHOD _CNV_A_R_LINEAR_____21_CM "" RAT_FUNC "%6.3" "V" COEFFS 0 9.846168103048838 0. 0 0 1 /end COMPU_METHOD
/begin COMPU_METHOD _CNV_A_R_LINEAR_____26_CM "" RAT_FUNC "%6.3" "hPa" COEFFS 0 12.06017666543982 0. 0 0 1 /end COMPU_METHOD
/begin COMPU_METHOD _CNV_A_R_LINEAR_____27_CM "" RAT_FUNC "%6.3" "-" COEFFS 0 256. 0. 0 0 1 /end COMPU_METHOD
/begin COMPU_METHOD _CNV_A_R_LINEAR_____30_CM "" RAT_FUNC "%6.3" "Nm" COEFFS 0 32. 0. 0 0 1 /end COMPU_METHOD
/begin COMPU_METHOD _CNV_A_R_LINEAR_____65_CM "" RAT_FUNC "%6.3" "Nm" COEFFS 0 32. 32768. 0 0 1 /end COMPU_METHOD
/begin COMPU_METHOD _CNV_A_R_LINEAR_____68_CM "" RAT_FUNC "%6.3" "-" COEFFS 0 65535.99999999996 0. 0 0 1 /end COMPU_METHOD
/begin COMPU_METHOD _CNV_A_R_LINEAR_____70_CM "" RAT_FUNC "%6.3" "km" COEFFS 0 0.1 0. 0 0 1 /end COMPU_METHOD
/begin COMPU_METHOD _CNV_A_R_LINEAR_____71_CM "" RAT_FUNC "%6.3" "" COEFFS 0 256. 0. 0 0 1 /end COMPU_METHOD
/begin COMPU_METHOD _CNV_A_R_LINEAR_____77_CM "" RAT_FUNC "%6.3" "min" COEFFS 0 1. 0. 0 0 1 /end COMPU_METHOD
/begin COMPU_METHOD _CNV_A_R_LINEAR_____108_CM "" RAT_FUNC "%6.3" "mg/stk" COEFFS 0 47.18142548596112 0. 0 0 1 /end COMPU_METHOD
/begin COMPU_METHOD _CNV_A_R_LINEAR_____122_CM "" RAT_FUNC "%6.3" "-" COEFFS 0 1024. 0. 0 0 1 /end COMPU_METHOD
/begin COMPU_METHOD _CNV_A_R_LINEAR_____152_CM "" RAT_FUNC "%6.3" "hPa" COEFFS 0 0.1884402603974972 0. 0 0 1 /end COMPU_METHOD
/begin COMPU_METHOD _CNV_A_R_LINEAR_____167_CM "" RAT_FUNC "%6.3" "°CRK" COEFFS 0 2.666666666666667 95. 0 0 1 /end COMPU_METHOD
/begin COMPU_METHOD _CNV_A_R_LINEAR_____168_CM "" RAT_FUNC "%6.3" "°CRK" COEFFS 0 2.666666666666667 0. 0 0 1 /end COMPU_METHOD
/begin COMPU_METHOD _CNV_A_R_LINEAR_____170_CM "" RAT_FUNC "%6.3" "°CRK" COEFFS 0 16. 1440. 0 0 1 /end COMPU_METHOD
/begin COMPU_METHOD _CNV_A_R_LINEAR_____197_CM "" RAT_FUNC "%6.3" "°C" COEFFS 0 64. 0. 0 0 1 /end COMPU_METHOD
/begin COMPU_METHOD _CNV_A_R_LINEAR_____201_CM "" RAT_FUNC "%6.3" "%" COEFFS 0 327.68 0. 0 0 1 /end COMPU_METHOD
/begin COMPU_METHOD _CNV_A_R_LINEAR_____218_CM "" RAT_FUNC "%6.3" "V" COEFFS 0 204.8048048048048 0. 0 0 1 /end COMPU_METHOD
/begin COMPU_METHOD _CNV_A_R_LINEAR_____225_CM "" RAT_FUNC "%6.3" "%" COEFFS 0 327.680000003584 32768.00000035841 0 0 1 /end COMPU_METHOD
/begin COMPU_METHOD _CNV_A_R_LINEAR_____232_CM "" RAT_FUNC "%6.3" "" COEFFS 0 65535. 0. 0 0 1 /end COMPU_METHOD
/begin COMPU_METHOD _CNV_A_R_LINEAR_____233_CM "" RAT_FUNC "%6.3" "ms" COEFFS 0 1000. 0. 0 0 1 /end COMPU_METHOD
/begin COMPU_METHOD _CNV_A_R_LINEAR_____243_CM "" RAT_FUNC "%6.3" "-" COEFFS 0 2048. 0. 0 0 1 /end COMPU_METHOD
/begin COMPU_METHOD _CNV_A_R_LINEAR_____289_CM "Battery voltage" RAT_FUNC "%6.3" "V" COEFFS 0 9.846153846153847 0. 0 0 1 /end COMPU_METHOD
/begin COMPU_METHOD _CNV_A_R_EVAC_LINEA_314_CM "" RAT_FUNC "%6.3" "-" COEFFS 0 16. 0. 0 0 1 /end COMPU_METHOD
/begin COMPU_METHOD _CNV_A_R_LINEAR_____482_CM "" RAT_FUNC "%6.3" "°CRK" COEFFS 0 42.66666666666666 0. 0 0 1 /end COMPU_METHOD
/begin COMPU_METHOD _CNV_A_R_LINEAR_____538_CM "" RAT_FUNC "%6.3" "K" COEFFS 0 32. 0. 0 0 1 /end COMPU_METHOD
/begin COMPU_METHOD _CNV_A_R_LINEAR_____567_CM "" RAT_FUNC "%6.3" "°CRK" COEFFS 0 -2.666666666666667 -106.6666666666667 0 0 1 /end COMPU_METHOD
/begin COMPU_METHOD _CNV_A_R_LINEAR_____568_CM "" RAT_FUNC "%6.3" "°CRK" COEFFS 0 2.666666666666667 -160. 0 0 1 /end COMPU_METHOD
/begin COMPU_METHOD _CNV_R_R_Def_f_ub_b_573_CM "Def_f_ub_b1" RAT_FUNC "%6.3" "-" COEFFS 0. 256. 0. 0. 0. 1. /end COMPU_METHOD
/begin COMPU_METHOD _CNV_R_R_Def_dez_sl_575_CM "Def_dez_sl_q1" RAT_FUNC "%6.3" "-" COEFFS 0. 1. 0. 0. 0. 1. /end COMPU_METHOD
/begin COMPU_METHOD _CNV_R_R_Def_p_sw_q_578_CM "Def_p_sw_q0p039" RAT_FUNC "%6.3" "hPa" COEFFS 0. 256. 0. 0. 0. 10. /end COMPU_METHOD
/begin COMPU_METHOD _CNV_R_R_Def_f_uw_b_579_CM "Def_f_uw_b2" RAT_FUNC "%6.3" "-" COEFFS 0. 65536. 0. 0. 0. 2. /end COMPU_METHOD
/begin COMPU_METHOD _CNV_R_R_Def_spr_sw_583_CM "Def_spr_sw_q0p1" RAT_FUNC "%6.3" "° KW" COEFFS 0. 10. 0. 0. 0. 1. /end COMPU_METHOD
/begin COMPU_METHOD _CNV_R_R_Def_f_uw_b_594_CM "Def_f_uw_b16" RAT_FUNC "%6.3" "-" COEFFS 0. 65536. 0. 0. 0. 16. /end COMPU_METHOD
/begin COMPU_METHOD _CNV_R_R_Def_zw_sw__599_CM "Def_zw_sw_q0p1" RAT_FUNC "%6.3" "°" COEFFS 0. 10. 0. 0. 0. 1. /end COMPU_METHOD
/begin COMPU_METHOD _CNV_R_R_Def_hub_uw_605_CM "Def_hub_uw_q0p001" RAT_FUNC "%6.3" "mm" COEFFS 0. 1000. 0. 0. 0. 1. /end COMPU_METHOD
/begin COMPU_METHOD _CNV_R_R_Def_f_sw_b_608_CM "Def_f_sw_b2" RAT_FUNC "%6.3" "-" COEFFS 0. 65536. 0. 0. 0. 4. /end COMPU_METHOD
/begin COMPU_METHOD _CNV_R_R_Def_n_sw_q_612_CM "Def_n_sw_q1p0" RAT_FUNC "%6.3" "Upm" COEFFS 0. 1. 0. 0. 0. 1. /end COMPU_METHOD
/begin COMPU_METHOD _CNV_R_R_Def_rf_sw__616_CM "Def_rf_sw_q0p01" RAT_FUNC "%6.3" "%" COEFFS 0. 100. 0. 0. 0. 1. /end COMPU_METHOD
/begin COMPU_METHOD _CNV_R_R_Def_t_sw_q_618_CM "Def_t_sw_q0p1" RAT_FUNC "%6.3" "°C" COEFFS 0. 10. 0. 0. 0. 1. /end COMPU_METHOD
/begin COMPU_METHOD _CNV_R_R_Def_t_sw_q_620_CM "Def_t_sw_q0p01" RAT_FUNC "%6.3" "°C" COEFFS 0. 100. 0. 0. 0. 1. /end COMPU_METHOD
/begin COMPU_METHOD _CNV_R_R_Def_zw_sb__623_CM "Def_zw_sb_q0p5" RAT_FUNC "%6.3" "°" COEFFS 0. 2. 0. 0. 0. 1. /end COMPU_METHOD
/begin COMPU_METHOD _CNV_R_R_Def_f_ub_b_625_CM "Def_f_ub_b2" RAT_FUNC "%6.3" "-" COEFFS 0. 256. 0. 0. 0. 2. /end COMPU_METHOD
/begin COMPU_METHOD _CNV_R_R_Def_td_uw__679_CM "Def_td_uw_q0p01" RAT_FUNC "%6.3" "s" COEFFS 0. 100. 0. 0. 0. 1. /end COMPU_METHOD
/begin COMPU_METHOD _CNV_S_1_Def_bit_ub_700_CM "Def_bit_ub_0" TAB_VERB "%6.3" "-" COMPU_TAB_REF _CNV_S_1_Def_bit_ub_700 /end COMPU_METHOD
/begin COMPU_VTAB _CNV_S_1_Def_bit_ub_700 "Def_bit_ub_0" TAB_VERB 1 0 "FALSE" /end COMPU_VTAB
/begin COMPU_METHOD _CNV_R_R_Def_zk10ms_709_CM "Def_zk10ms_uw_b655p36" RAT_FUNC "%6.3" "s" COEFFS 0. 0. 655.36 0. 1. 0. /end COMPU_METHOD
/begin COMPU_METHOD _CNV_R_R_Def_v_uw_q_723_CM "Def_v_uw_q1p0" RAT_FUNC "%6.3" "km/h" COEFFS 0. 1. 0. 0. 0. 1. /end COMPU_METHOD
/begin COMPU_METHOD _CNV_R_R_Def_f_ub_b_739_CM "Def_f_ub_b8" RAT_FUNC "%6.3" "-" COEFFS 0. 256. 0. 0. 0. 8. /end COMPU_METHOD
/begin COMPU_METHOD _CNV_A_R_LINEAR_____776_CM "" RAT_FUNC "%6.3" "°C" COEFFS 0 64. 2112. 0 0 1 /end COMPU_METHOD
/begin COMPU_METHOD _CNV_A_R_EXTC_LINEA_778_CM "" RAT_FUNC "%6.3" "K" COEFFS 0 32. 33792. 0 0 1 /end COMPU_METHOD
/begin COMPU_METHOD _CNV_A_R_LINEAR_____779_CM "" RAT_FUNC "%6.3" "K" COEFFS 0 32. 32768. 0 0 1 /end COMPU_METHOD
/begin COMPU_METHOD _CNV_S_4_EXTC_RANGE_780_CM "" TAB_VERB "%6.3" "-" COMPU_TAB_REF _CNV_S_4_EXTC_RANGE_780 /end COMPU_METHOD
/begin COMPU_VTAB _CNV_S_4_EXTC_RANGE_780 "" TAB_VERB 4 0 "CH_MOD_OFF" 1 "CH_MOD_HOM" 2 "CH_MOD_MPLH" 3 "CH_MOD_MPLP" /end COMPU_VTAB
/begin COMPU_METHOD _CNV_S_4_STATE_CH_781_CM "" TAB_VERB "%6.3" "" COMPU_TAB_REF _CNV_S_4_STATE_CH_781 /end COMPU_METHOD
/begin COMPU_VTAB _CNV_S_4_STATE_CH_781 "" TAB_VERB 4 0 "CH_OFF" 1 "CH_AST" 2 "CH_LOW_LOAD" 3 "CH_SO2P" /end COMPU_VTAB
/begin COMPU_METHOD _CNV_A_R_EXTC_LINEA_782_CM "" RAT_FUNC "%6.3" "K" COEFFS 0 32. 1024. 0 0 1 /end COMPU_METHOD
/begin COMPU_METHOD _CNV_A_R_LINEAR_____783_CM "" RAT_FUNC "%6.3" "" COEFFS 0 255. 0. 0 0 1 /end COMPU_METHOD
/begin COMPU_METHOD _CNV_A_R_LINEAR_____784_CM "" RAT_FUNC "%6.3" "°CRK" COEFFS 0 2.666666666666667 1920. 0 0 1 /end COMPU_METHOD
/begin COMPU_METHOD _CNV_A_R_LINEAR_____785_CM "" RAT_FUNC "%6.3" "-" COEFFS 0 1024.000001200037 0. 0 0 1 /end COMPU_METHOD
/begin COMPU_METHOD _CNV_S_4_EXTC_RANGE_791_CM "" TAB_VERB "%6.3" "" COMPU_TAB_REF _CNV_S_4_EXTC_RANGE_791 /end COMPU_METHOD
/begin COMPU_VTAB _CNV_S_4_EXTC_RANGE_791 "" TAB_VERB 4 0 "CH_MOD_OFF" 1 "CH_MOD_HOM" 2 "CH_MOD_MPLH" 3 "CH_MOD_MPLP" /end COMPU_VTAB
/begin COMPU_METHOD _CNV_A_R_ACRC_LINEA_799_CM "" RAT_FUNC "%6.3" "%" COEFFS 0 40.96 0. 0 0 1 /end COMPU_METHOD
/begin COMPU_METHOD _CNV_A_R_ACRC_LINEA_800_CM "" RAT_FUNC "%6.3" "-" COEFFS 0 8191.999927998902 -2.880043903132901e-004 0 0 1 /end COMPU_METHOD
/begin COMPU_METHOD _CNV_A_R_ACRC_LINEA_801_CM "" RAT_FUNC "%6.3" "Hz" COEFFS 0 10. 0. 0 0 1 /end COMPU_METHOD
/begin COMPU_METHOD _CNV_S_3_ACRC_RANGE_802_CM "" TAB_VERB "%6.3" "" COMPU_TAB_REF _CNV_S_3_ACRC_RANGE_802 /end COMPU_METHOD
/begin COMPU_VTAB _CNV_S_3_ACRC_RANGE_802 "" TAB_VERB 3 0 "PWM_OFF" 1 "PWM_STAT" 2 "PWM_CTL" /end COMPU_VTAB
/begin COMPU_METHOD _CNV_A_R_ACRC_LINEA_803_CM "" RAT_FUNC "%6.3" "V" COEFFS 0 409.801605573462 0. 0 0 1 /end COMPU_METHOD
/begin COMPU_METHOD _CNV_S_3_ACRC_RANGE_804_CM "" TAB_VERB "%6.3" "-" COMPU_TAB_REF _CNV_S_3_ACRC_RANGE_804 /end COMPU_METHOD
/begin COMPU_VTAB _CNV_S_3_ACRC_RANGE_804 "" TAB_VERB 3 0 "PWM_OFF" 1 "PWM_STAT" 2 "PWM_CTL" /end COMPU_VTAB
/begin COMPU_METHOD _CNV_A_R_ACRC_LINEA_805_CM "" RAT_FUNC "%6.3" "%/V" COEFFS 0 655.3598303974559 0. 0 0 1 /end COMPU_METHOD
/begin COMPU_METHOD _CNV_S_5_ACRC_RANGE_806_CM "" TAB_VERB "%6.3" "" COMPU_TAB_REF _CNV_S_5_ACRC_RANGE_806 /end COMPU_METHOD
/begin COMPU_VTAB _CNV_S_5_ACRC_RANGE_806 "" TAB_VERB 5 0 "ACR_AD_INIT" 1 "ACR_AD_BOL" 2 "ACR_GO_TOL" 3 "ACR_AD_TOL" 4 "ACR_AD_END" /end COMPU_VTAB
/begin RECORD_LAYOUT _REC_VAL_20_u1 FNC_VALUES 1 UBYTE COLUMN_DIR DIRECT /end RECORD_LAYOUT
/begin RECORD_LAYOUT _REC_VAL_20_u2 FNC_VALUES 1 UWORD COLUMN_DIR DIRECT /end RECORD_LAYOUT
/begin RECORD_LAYOUT _REC_AXS_20_u1 NO_AXIS_PTS_X 1 UBYTE AXIS_PTS_X 2 UBYTE INDEX_INCR DIRECT /end RECORD_LAYOUT
/begin RECORD_LAYOUT _REC_VAL_20_s2 FNC_VALUES 1 SWORD COLUMN_DIR DIRECT /end RECORD_LAYOUT
/begin RECORD_LAYOUT _REC_MAP_20_u2_u2_u1 FNC_VALUES 1 UWORD COLUMN_DIR DIRECT /end RECORD_LAYOUT
/begin RECORD_LAYOUT _REC_AXS_20_u2 NO_AXIS_PTS_X 1 UWORD AXIS_PTS_X 2 UWORD INDEX_INCR DIRECT /end RECORD_LAYOUT
/begin RECORD_LAYOUT _REC_CUR_20_u2_u1 FNC_VALUES 1 UWORD COLUMN_DIR DIRECT /end RECORD_LAYOUT
/begin RECORD_LAYOUT _REC_CUR_20_u2_u2 FNC_VALUES 1 UWORD COLUMN_DIR DIRECT /end RECORD_LAYOUT
/begin RECORD_LAYOUT _REC_VAL_20_s1 FNC_VALUES 1 SBYTE COLUMN_DIR DIRECT /end RECORD_LAYOUT
/begin RECORD_LAYOUT _REC_MAP_20_u2_u1_u2 FNC_VALUES 1 UWORD COLUMN_DIR DIRECT /end RECORD_LAYOUT
/begin RECORD_LAYOUT _REC_CUR_20_u1_u2 FNC_VALUES 1 UBYTE COLUMN_DIR DIRECT /end RECORD_LAYOUT
/begin RECORD_LAYOUT _REC_MAP_20_u2_u2_u2 FNC_VALUES 1 UWORD COLUMN_DIR DIRECT /end RECORD_LAYOUT
/begin RECORD_LAYOUT _REC_MAP_20_u1_u2_u1 FNC_VALUES 1 UBYTE COLUMN_DIR DIRECT /end RECORD_LAYOUT
/begin RECORD_LAYOUT _REC_MAP_20_u1_u1_u2 FNC_VALUES 1 UBYTE COLUMN_DIR DIRECT /end RECORD_LAYOUT
/begin RECORD_LAYOUT _REC_MAP_52_UBYTE_u2_s2_s2 NO_AXIS_PTS_X 1 UBYTE NO_AXIS_PTS_Y 2 UBYTE AXIS_PTS_X 3 SWORD INDEX_INCR DIRECT AXIS_PTS_Y 4 SWORD INDEX_INCR DIRECT FNC_VALUES 5 UWORD COLUMN_DIR DIRECT /end RECORD_LAYOUT
/begin RECORD_LAYOUT _REC_MAP_52_u1_s2_s2 NO_AXIS_PTS_X 1 UBYTE NO_AXIS_PTS_Y 2 UBYTE AXIS_PTS_X 3 SWORD INDEX_INCR DIRECT AXIS_PTS_Y 4 SWORD INDEX_INCR DIRECT FNC_VALUES 5 UBYTE COLUMN_DIR DIRECT /end RECORD_LAYOUT
/begin RECORD_LAYOUT _REC_MAP_52_UBYTE_s2_s2_s2 NO_AXIS_PTS_X 1 UBYTE NO_AXIS_PTS_Y 2 UBYTE AXIS_PTS_X 3 SWORD INDEX_INCR DIRECT AXIS_PTS_Y 4 SWORD INDEX_INCR DIRECT FNC_VALUES 5 SWORD COLUMN_DIR DIRECT /end RECORD_LAYOUT
/begin RECORD_LAYOUT _REC_MAP_52_UBYTE_u2_u2_s2 NO_AXIS_PTS_X 1 UBYTE NO_AXIS_PTS_Y 2 UBYTE AXIS_PTS_X 3 UWORD INDEX_INCR DIRECT AXIS_PTS_Y 4 SWORD INDEX_INCR DIRECT FNC_VALUES 5 UWORD COLUMN_DIR DIRECT /end RECORD_LAYOUT
/begin RECORD_LAYOUT _REC_MAP_52_u1_u2_s2 NO_AXIS_PTS_X 1 UBYTE NO_AXIS_PTS_Y 2 UBYTE AXIS_PTS_X 3 UWORD INDEX_INCR DIRECT AXIS_PTS_Y 4 SWORD INDEX_INCR DIRECT FNC_VALUES 5 UBYTE COLUMN_DIR DIRECT /end RECORD_LAYOUT
/begin RECORD_LAYOUT _REC_MAP_52_UBYTE_s2_u2_s2 NO_AXIS_PTS_X 1 UBYTE NO_AXIS_PTS_Y 2 UBYTE AXIS_PTS_X 3 UWORD INDEX_INCR DIRECT AXIS_PTS_Y 4 SWORD INDEX_INCR DIRECT FNC_VALUES 5 SWORD COLUMN_DIR DIRECT /end RECORD_LAYOUT
/begin RECORD_LAYOUT _REC_MAP_52_UBYTE_s1_s2_s2 NO_AXIS_PTS_X 1 UBYTE NO_AXIS_PTS_Y 2 UBYTE AXIS_PTS_X 3 SWORD INDEX_INCR DIRECT AXIS_PTS_Y 4 SWORD INDEX_INCR DIRECT FNC_VALUES 5 SBYTE COLUMN_DIR DIRECT /end RECORD_LAYOUT
/begin RECORD_LAYOUT _REC_MAP_52_u1_u2_u2 NO_AXIS_PTS_X 1 UBYTE NO_AXIS_PTS_Y 2 UBYTE AXIS_PTS_X 3 UWORD INDEX_INCR DIRECT AXIS_PTS_Y 4 UWORD INDEX_INCR DIRECT FNC_VALUES 5 UBYTE COLUMN_DIR DIRECT /end RECORD_LAYOUT
/begin RECORD_LAYOUT _REC_CUR_TKL_UW_VV__u2_s2 NO_AXIS_PTS_X 1 UBYTE RESERVED 2 BYTE AXIS_PTS_X 3 SWORD INDEX_INCR DIRECT FNC_VALUES 4 UWORD COLUMN_DIR DIRECT /end RECORD_LAYOUT
/begin RECORD_LAYOUT _REC_CUR_TKL_UW_VV__u1_s2 NO_AXIS_PTS_X 1 UBYTE RESERVED 2 BYTE AXIS_PTS_X 3 SWORD INDEX_INCR DIRECT FNC_VALUES 4 UBYTE COLUMN_DIR DIRECT /end RECORD_LAYOUT
/begin RECORD_LAYOUT _REC_CUR_TKL_UW_VV__s2_s2 NO_AXIS_PTS_X 1 UBYTE RESERVED 2 BYTE AXIS_PTS_X 3 SWORD INDEX_INCR DIRECT FNC_VALUES 4 SWORD COLUMN_DIR DIRECT /end RECORD_LAYOUT
/begin RECORD_LAYOUT _REC_CUR_TKL_UW_VV__s1_u2 NO_AXIS_PTS_X 1 UBYTE RESERVED 2 BYTE AXIS_PTS_X 3 UWORD INDEX_INCR DIRECT FNC_VALUES 4 SBYTE COLUMN_DIR DIRECT /end RECORD_LAYOUT
/begin RECORD_LAYOUT _REC_VAL_2_u1 FNC_VALUES 1 UBYTE COLUMN_DIR DIRECT /end RECORD_LAYOUT
/begin FUNCTION ZWGRUND ""
 /begin DEF_CHARACTERISTIC CW_ZWDYN KF_DZW_DYN KF_DZW_DYNN KF_DZW_HZ KF_DZW_KR_GD KF_DZW_KR_VT KF_DZW_TD98 KF_DZW_VNS_VT KF_DZW_WL_GD KF_DZW_WL_VT KF_FDZW_DYN1 KF_FDZW_DYN2 KF_FDZW_DYNN1 KF_FDZW_DYNN2 KF_FDZW_T KF_FDZW_VNS_VT KF_FZW_KR_GD KF_FZW_KR_VT KF_FZW_LAMKOR KF_FZW_WL_GD KF_FZW_WL_VT KF_TDRFSOLKR KF_TDRFZW KF_ZKRFSOLF KF_ZKRFSOLS KF_ZW_GD KF_ZW_GD_VL KF_ZW_NL KF_ZW_VT98 KF_ZW_VT98S KF_ZW_VT_VL98 KL_DRFSOL KL_DRFSOLN KL_DZW_LAMKOR KL_FRFSOL KL_FZKRFSOLF KL_FZKRFSOLS KL_F_DYNAKT KL_F_DYNNAKT KL_F_DYNNVZ KL_F_DYNVZ KL_F_RFZWV KL_TD KL_TDDRFSOL KL_TDDRFSOLN KL_TDRFSOLO K_DRFSOL K_DRFSOLKRV K_DRFSOLKRVF K_MAT_RFKR K_MAT_ZWDYN K_MAT_ZWSTAT K_TDRFSOLGD K_ZKRFSOLGD K_ZWHZINI K_ZWHZRAMP S_ZWDYNRETRIG /end DEF_CHARACTERISTIC
 /begin OUT_MEASUREMENT Dzw_hz Dzw_kr_gd Dzw_kr_vt Dzw_lam_kor Dzw_lam_kor1 Dzw_lam_kor2 Dzw_t1 Dzw_td98 Dzw_vns_vt Dzw_wl_gd Dzw_wl_vt Dzwdyn Dzwdyn_dek Dzwdyn_hold Dzwdynn Dzwdynn_dek Dzwdynn_hold Dzwt Dzwt_gd Dzwt_vt F_dynakt F_dynnakt F_dynnvz F_dynvz F_dzw_vns_vt F_rfzwv F_zw_kr_gd F_zw_kr_vt F_zwhz Minhubsw Rf_sol_old Rf_solkrv Rf_solkrv_hold Rf_solkrv_old Rf_solkrvf Rf_solkrvf_old Rf_solkrvfgd Rf_solkrvgd Rf_solkrvof Rf_zwv Rfkr St_zwgrund St_zwgrund.B_zwdyn St_zwgrund.B_zwdynn St_zwgrund1 St_zwgrund1.B_rfsola St_zwgrund1.B_trigin St_zwgrund1.B_trigout St_zwgrund1.B_zwdynakt St_zwgrund1.B_zwdynvz St_zwgrund1.B_zwfall St_zwgrund1.B_zwsteig St_zwgrund2 St_zwgrund2.B_triginn St_zwgrund2.B_trigoutn St_zwgrund2.B_zwdynnakt St_zwgrund2.B_zwdynnvz St_zwgrundhs St_zwgrundhs.B_zwhz Td_dynakt Td_dyndek Td_dynnakt Td_dynndek Td_dynnvz Td_dynvz Tddrfsol Tddrfsol_dyn Tddrfsoln Tddrfsoln_dyn Zw_grund Zw_grund1 Zw_grund2 Zw_grund_vk Zw_timer Zw_vt98 Zwdyn Zwdyn_gd Zwdyn_nl Zwdyn_vt Zwstat Zwstat_gd Zwstat_nl Zwstat_vt /end OUT_MEASUREMENT
/end FUNCTION
/begin FUNCTION ZWOPT ""
 /begin DEF_CHARACTERISTIC KF_FZWOKH_LAMKOR KF_FZWO_LAMKOR KF_ZWOPT_GD KF_ZWOPT_VT KF_ZWOPT_VTS KF_ZWO_KHKGD KF_ZWO_KHKLLGD KF_ZWO_KHKLLVT KF_ZWO_KHKVT KF_ZWO_KHWGD KF_ZWO_KHWLLGD KF_ZWO_KHWLLVT KF_ZWO_KHWVT KL_DZWOKH_LAMKOR KL_DZWO_LAMKOR K_DZW_HSPLIT K_MAT_BAZW /end DEF_CHARACTERISTIC
 /begin OUT_MEASUREMENT Dzwo_lam_kor Dzwo_lam_kor1 Dzwo_lam_kor2 Dzwokh_lam_kor Dzwot Zw_opt Zw_opt1 Zw_opt2 Zw_opt_kh Zw_opt_khgd Zw_opt_khkgd Zw_opt_khkllgd Zw_opt_khkllvt Zw_opt_khkvt Zw_opt_khvt Zw_opt_khwgd Zw_opt_khwllgd Zw_opt_khwllvt Zw_opt_khwvt Zw_opt_n Zw_opt_nvk Zw_opt_nvkgd Zw_opt_nvkvt /end OUT_MEASUREMENT
/end FUNCTION
/begin FUNCTION AGGR_AIRT_adaptation "" /begin OUT_MEASUREMENT tia_im tia_thr tia_thr_st lv_err_tia_im lv_err_tia_thr /end OUT_MEASUREMENT /end FUNCTION
/begin FUNCTION C_6_EXTC "C_6_EXTC" /begin SUB_FUNCTION EXTC_Ign_Ang_Diff_Cat_Heat_PI /end SUB_FUNCTION /end FUNCTION
/begin FUNCTION EXTC_Ign_Ang_Diff_Cat_Heat_PI "_Ign_Ang_Diff_Cat_Heat_PI"
 /begin DEF_CHARACTERISTIC lc_iga_dif_s_ch_man_act c_iga_dif_s_ch_man ldp_mff_post_ip_iga_dif_ch_l ip_iga_dif_add_mff_post_ch_l ip_iga_dif_s_ch_l_bas ip_iga_dif_s_ch_ast_bas ldpm_mff_sp_mv_1_extc ldpm_n_32_6_extc ldpm_mff_sp_mv_2_extc /end DEF_CHARACTERISTIC
 /begin OUT_MEASUREMENT iga_dif_s_ch /end OUT_MEASUREMENT
/end FUNCTION
/begin FUNCTION C_D_EXTC "C_D_EXTC" /begin SUB_FUNCTION EXTC_Torque_Based_Cat_Heat /end SUB_FUNCTION /end FUNCTION
/begin FUNCTION EXTC_Torque_Based_Cat_Heat "_Torque_Based_Cat_Heat"
 /begin DEF_CHARACTERISTIC c_tq_add_ch_hom_man lc_tq_add_ch_hom_man_act lc_tq_add_ch_mplh_man_act c_tq_add_ch_lgrd_on c_tq_add_ch_lgrd_off ldp_n_32_ip_tq_add_ch_hom_is ldp_n_32_ip_tq_add_mplh_is ldp_n_32_ip_tq_add_ch_mplh ldp_tqi_req_ip_tq_add_ch_hom_is ldp_tqi_req_ip_tq_ch_mplh_is ldp_tqi_req_ip_tq_ch_mplh ldp_t_ast_ip_fac_tq_ch_mplh ldp_t_ast_ip_fac_tq_add_ch_hom ldp_tco_st_ip_fac_tq_add_ch_hom ldp_tco_st_ip_fac_tq_mplh ip_tq_add_ch_hom_is ip_tq_add_ch_mplh_is ip_tq_add_ch_mplh ip_fac_tq_add_ch_mplh c_tq_add_ch_mplh_man c_tq_add_ch_l_lgrd ip_fac_tq_add_ch_hom ip_fac_tq_add_ch_l ldp_n_32_ip_tq_add_ch_hom ldp_tqi_req_ip_tq_add_ch_hom ldp_n_32_ip_tq_add_ch_l ldp_n_32_ip_tq_add_ch_l_is ldp_tqi_req_ip_tq_add_ch_l ldp_tqi_req_ip_tq_add_ch_l_is ip_tq_add_ch_hom ip_tq_add_ch_l_hom ip_tq_add_ch_l_hom_is /end DEF_CHARACTERISTIC
 /begin OUT_MEASUREMENT tq_add_ch /end OUT_MEASUREMENT
/end FUNCTION
/begin FUNCTION C_7_EXTC "C_7_EXTC"
 /begin SUB_FUNCTION EXTC_Inj_Phase_Homo_2_Pulse EXTC_Inj_Phase_Homo_1_Pulse EXTC_Lambda_SP_Cat_Heat EXTC_mff_sp_second_inj_hom_cat_heading EXTC_mff_sp_post_inj_hom_cat_heading EXTC_inj_phase_post_inj_cat_heading /end SUB_FUNCTION
/end FUNCTION
/begin FUNCTION EXTC_Inj_Phase_Homo_2_Pulse "_Inj_Phase_Homo_2_Pulse"
 /begin DEF_CHARACTERISTIC c_eoi_2_delta_mplh_ch_as c_eoi_2_delta_mplh_ch_man lc_eoi_2_delta_mplh_ch_man_act ldp_n_32_ip_eoi_2_delta_ch ldp_maf_ip_eoi_2_delta_ch ldp_mff_2_ip_eoi_2_mplh_ch_add ip_eoi_2_delta_mplh_ch_ast ip_eoi_2_mplh_ch_add_mff_2 ldpm_n_32_4_extc ldpm_maf_2_extc ip_eoi_2_delta_mplh_ch_so2p /end DEF_CHARACTERISTIC
 /begin OUT_MEASUREMENT eoi_2_delta_mplh_ch /end OUT_MEASUREMENT
/end FUNCTION
/begin FUNCTION EXTC_Inj_Phase_Homo_1_Pulse "_Inj_Phase_Homo_1_Pulse"
 /begin DEF_CHARACTERISTIC ip_soi_1_ch_add_tco ldp_tco_ip_soi_1_ch_add_tco c_soi_1_mplh_ch_as c_soi_1_mplh_ch_man lc_soi_1_mplh_ch_man_act ldp_maf_ip_soi_1_mplh_ch_ast ldp_n_32_ip_soi_1_mplh_ch_ast ip_soi_1_mplh_ch_ast ldp_maf_ip_soi_1_mplh_ch_so2p ip_soi_1_mplh_ch_so2p /end DEF_CHARACTERISTIC
 /begin OUT_MEASUREMENT soi_1_mplh_ch[0] soi_1_mplh_ch[1] soi_1_mplh_ch[2] soi_1_mplh_ch[3] soi_1_mplh_ch[4] soi_1_mplh_ch[5] /end OUT_MEASUREMENT
/end FUNCTION
/begin FUNCTION EXTC_Lambda_SP_Cat_Heat "_Lambda_SP_Cat_Heat"
 /begin DEF_CHARACTERISTIC ldp_tqi_req_slow_ip_lamb_hom_is ldp_n_32_ip_lamb_ch_hom_dui_is ldp_tqi_req_slow_ip_lamb_hom ip_lamb_ch_ast_hom ldp_n_32_ip_lamb_ch_ast_hom ip_lamb_ch_ast_hom_is ip_lamb_add_ch_ast_hom ldp_t_ast_ip_lamb_add_hom ldp_tco_ip_lamb_add_hom ip_lamb_add_ch_ast_mplh ldp_t_ast_ip_lamb_add_mplh ldp_tco_ip_lamb_add_mplh ldp_n_32_ip_lamb_ch_mplh ldp_tqi_req_slow_ip_lamb_mplh ip_lamb_ch_ast_mplh_is ldp_n_32_ip_lamb_ch_ast_mplh_is ldp_tqi_slow_ip_lamb_mplh_is ldpm_tnt_dif_ch_so2p_1_extc ip_fac_lamb_ch_so2p_tnt_dif ldpm_tqi_req_slow_1_extc ip_lamb_ch_so2p_hom ip_lamb_ch_so2p_mplh ip_lamb_ch_ast_mplh c_lamb_sp_ch_man[0] c_lamb_sp_ch_man[1] lc_lamb_sp_ch_man_act lc_lamb_sp_ch_so2p_man_act lc_lamb_so2p_fast_ena /end DEF_CHARACTERISTIC
 /begin OUT_MEASUREMENT lamb_sp_ch[0] lamb_sp_ch[1] lamb_sp_ch_so2p[0] lamb_sp_ch_so2p[1] /end OUT_MEASUREMENT
/end FUNCTION
/begin FUNCTION EXTC_mff_sp_second_inj_hom_cat_heading ""
 /begin DEF_CHARACTERISTIC ip_mff_sp_2_add_iga_ch ldpm_n_32_1_extc ldpm_maf_1_extc c_mff_sp_2_mplh_ch_man lc_mff_sp_2_mplh_ch_man_act ip_mff_sp_2_mplh_ch_ast ip_mff_sp_2_mplh_ch_so2p ldp_iga_h_rng_ip_mff_2_mplh_ch /end DEF_CHARACTERISTIC
 /begin OUT_MEASUREMENT mff_sp_2_mplh_ch /end OUT_MEASUREMENT
/end FUNCTION
/begin FUNCTION EXTC_mff_sp_post_inj_hom_cat_heading ""
 /begin DEF_CHARACTERISTIC c_fup_cor_post_inj ldp_n_32_ip_fac_mff_mplp_ch_ast ip_fac_mff_mplp_ch_ast ldp_tco_ip_fac_mff_mplp_ch_ast ldp_cyc_cast_ip_fac_mff_mplp_ch c_maf_fac_post_inj c_mff_mplp_ch_lgrd_off c_mff_mplp_ch_lgrd_on lc_iv_post_egy_rng ip_fac_cor_post_inj ip_fac_mff_mplp_ch_ast_n_32 ip_fac_mff_mplp_ch_l ldp_lamb_cmb_s_ip_mplp_ch_ast ldp_lamb_cmb_s_ip_mff_mplp_ch_l ip_mff_mplp_ch_ast ip_mff_mplp_ch_l lc_mff_mplp_ch_man_act c_mff_mplp_ch_man /end DEF_CHARACTERISTIC
 /begin OUT_MEASUREMENT mff_mplp_ch lamb_cmb_s ti_post_inj[0] ti_post_inj[1] ti_post_inj[2] ti_post_inj[3] ti_post_inj[4] ti_post_inj[5] mff_post_inj[0] mff_post_inj[1] mff_post_inj[2] mff_post_inj[3] mff_post_inj[4] mff_post_inj[5] lv_post_inj_act lv_iv_post_egy_rng /end OUT_MEASUREMENT
/end FUNCTION
/begin FUNCTION EXTC_inj_phase_post_inj_cat_heading ""
 /begin DEF_CHARACTERISTIC lc_soi_post_inj_man_act c_eoi_lim_post c_soi_lim_post ldpm_n_32_2_extc c_soi_post_inj_man c_soi_mplp_man lc_soi_mplp_man_act ldp_mff_post_ip_soi_mplp_ch_l ip_soi_mplp_add_mff_post_ch_l ip_soi_mplp_dif_ch_ast ip_soi_mplp_dif_ch_l /end DEF_CHARACTERISTIC
 /begin OUT_MEASUREMENT eoi_lim_post soi_lim_post soi_post_inj[0] soi_post_inj[1] soi_post_inj[2] soi_post_inj[3] soi_post_inj[4] soi_post_inj[5] eoi_post_inj[0] eoi_post_inj[1] eoi_post_inj[2] eoi_post_inj[3] eoi_post_inj[4] eoi_post_inj[5] soi_mplp_dif_ch /end OUT_MEASUREMENT
/end FUNCTION
/begin FUNCTION C_8_EXTC "C_8_EXTC" /begin SUB_FUNCTION EXTC_Idle_Speed_SP_Cat_Heat /end SUB_FUNCTION /end FUNCTION
/begin FUNCTION EXTC_Idle_Speed_SP_Cat_Heat "_Idle_Speed_SP_Cat_Heat"
 /begin DEF_CHARACTERISTIC ldpm_tco_1_extc ldpm_t_ast_5_extc ip_n_sp_is_ch_ast_mplh ip_n_sp_is_ch_ast_mplp ip_n_sp_is_ch_ast_hom ip_n_sp_is_ch_l_hom ip_n_sp_is_ch_l_s ip_n_sp_is_ch_ast_hom_dri ip_n_sp_is_ch_ast_mplh_dri ip_n_sp_is_ch_ast_mplp_dri lc_dri_act_mt /end DEF_CHARACTERISTIC
 /begin OUT_MEASUREMENT n_sp_is_ch /end OUT_MEASUREMENT
/end FUNCTION
/begin FUNCTION C_9_EXTC "C_9_EXTC"
 /begin SUB_FUNCTION EXTC_Camshaft_SP_Cat_Heat EXTC_Fuel_pressure_for_catalyst_heading /end SUB_FUNCTION
/end FUNCTION
/begin FUNCTION EXTC_Camshaft_SP_Cat_Heat "_Camshaft_SP_Cat_Heat"
 /begin DEF_CHARACTERISTIC c_t_dri_ch_cam ldp_ctr_km_can_ip_fac_cam_sp_ch ldpm_tco_st_3_extc ldpm_tco_st_1_extc ldpm_tco_st_2_extc ldpm_tco_st_4_extc ldpm_t_ast_2_extc ldpm_t_ast_3_extc ldpm_t_ast_4_extc ldpm_t_ast_1_extc ldp_n_32_ip_fac_cam_sp_ch_opp ldp_dip_ip_fac_cam_sp_ch_opp ip_fac_cam_sp_ch_opp ip_fac_cam_sp_ch_km c_fac_cam_ch_l_dif_max ip_cam_ch_ast_hom_dri_ex ip_cam_ch_ast_hom_dri_in ip_cam_ch_ast_hom_ex ip_cam_ch_ast_hom_in ip_cam_ch_ast_mplh_dri_ex ip_cam_ch_ast_mplh_dri_in ip_cam_ch_ast_mplh_in ip_cam_ch_ast_mplh_ex ip_cam_ch_ast_mplp_dri_ex ip_cam_ch_ast_mplp_dri_in ip_cam_ch_ast_mplp_ex ip_cam_ch_ast_mplp_in ldpm_n_32_5_extc ldpm_n_32_3_extc ldpm_tqi_req_slow_2_extc ldpm_tqi_req_slow_3_extc ip_cam_ch_l_hom_ex ip_cam_ch_l_hom_in ip_cam_ch_l_mplp_ex ip_cam_ch_l_mplp_in ip_cam_ch_so2p_hom_ex ip_cam_ch_so2p_hom_in ip_cam_ch_so2p_mplh_ex ip_cam_ch_so2p_mplh_in ip_fac_cam_sp_ch_ast ldp_tco_st_ip_fac_cam_sp_ch_ast ldp_t_ast_ip_fac_cam_sp_ch_ast ldp_mff_post_inj_ip_fac_cam_ch ldp_tq_add_ch_ip_fac_cam_ch ip_fac_cam_ch_mff_post ip_fac_cam_ch_tq_add /end DEF_CHARACTERISTIC
 /begin OUT_MEASUREMENT fac_cam_sp_ch cam_sp_ch_in cam_sp_ch_ex /end OUT_MEASUREMENT
/end FUNCTION
/begin FUNCTION EXTC_Fuel_pressure_for_catalyst_heading ""
 /begin DEF_CHARACTERISTIC c_fup_sp_ch_pas ldp_tco_st_ip_fac_fup_sp_ch ldp_t_ast_ip_fac_fup_sp_ch ldp_n_32_ip_fup_sp_ch ldp_tqi_req_tra_ip_fup_sp_ch /end DEF_CHARACTERISTIC
 /begin OUT_MEASUREMENT fup_sp_ch /end OUT_MEASUREMENT
/end FUNCTION
/begin FUNCTION C_5_EXTC ""
 /begin SUB_FUNCTION EXTC_Catalyst_heading_coordination EXTC_Catalyst_heating_after_start_strategy EXTC_Catalyst_heating_strategy EXTC_Cat_heating_low_load_stgy EXTC_Catalyst_heading_desulfation_strategy /end SUB_FUNCTION
/end FUNCTION
/begin FUNCTION EXTC_Catalyst_heading_coordination ""
 /begin DEF_CHARACTERISTIC ldp_tco_st_ip_t_es_thd_ch_ast ldp_tco_st_ip_t_ast_thd_ch_ast ip_t_es_thd_ch_ast ip_t_ast_thd_ch_ast c_thd_temp_cat_ch_ast c_n_32_thd_ch_l_off c_n_32_thd_ch_l_on c_state_ch_man c_temp_cat_thd_ch_l_off c_temp_cat_thd_ch_l_hom_on c_temp_cat_thd_ch_l_s_on c_thd_tnt_ch_ast c_tnt_thd_ch_l_off c_tnt_thd_ch_l_hom_on c_tnt_thd_ch_l_s_on c_tqi_req_fast_thd_ch_l_off c_tqi_req_fast_thd_ch_l_on lc_state_ch_man_act c_fac_tqi_fil_ch_so2p c_fac_vs_fil_ch_so2p c_temp_cat_thd_ch_so2p c_tnt_max_ch_so2p c_tnt_min_ch_so2p c_tqi_thd_ch_so2p c_vs_thd_ch_so2p /end DEF_CHARACTERISTIC
 /begin OUT_MEASUREMENT lv_ch_ast_cdn lv_ch_ast_swi_on_ramp state_ch tnt_dif_ch_l temp_cat_dif_ch_l tqi_req_fast_fil_ch_so2p vs_fil_ch_so2p lv_ch_so2p_cdn lv_ch_l_cdn /end OUT_MEASUREMENT
/end FUNCTION
/begin FUNCTION EXTC_Catalyst_heating_after_start_strategy ""
 /begin DEF_CHARACTERISTIC lc_ch_mod_man_act c_ch_mod_man c_n_max_mplh_ch_ast c_tqi_min_mplh_ch_ast c_tqi_max_mplh_ch_ast c_n_min_mplh_ch_ast c_tqi_min_mplp_ch_ast c_n_min_mplp_ch_ast c_n_max_mplp_ch_ast c_tqi_max_mplp_ch_ast ldp_t_ast_id_ch_mod_bas ldp_tco_st_id_ch_mod_bas id_ch_mod_bas c_vs_max_mplp_ch_ast /end DEF_CHARACTERISTIC
 /begin OUT_MEASUREMENT state_ch_mod_ast state_ch_mod_req_ast lv_ch_ast_mplp_cdn lv_ch_ast_mplh_cdn /end OUT_MEASUREMENT
/end FUNCTION
/begin FUNCTION EXTC_Catalyst_heating_strategy "" /begin OUT_MEASUREMENT state_ch_mod state_ch_mod_req /end OUT_MEASUREMENT /end FUNCTION
/begin FUNCTION EXTC_Cat_heating_low_load_stgy "Cat_heating_low_load_stgy" /begin DEF_CHARACTERISTIC c_temp_cat_thd_swi_hom_ch_l c_tnt_mdl_h_thd_swi_hom_ch_l /end DEF_CHARACTERISTIC /begin OUT_MEASUREMENT state_ch_mod_l state_ch_mod_req_l /end OUT_MEASUREMENT /end FUNCTION
/begin FUNCTION EXTC_Catalyst_heading_desulfation_strategy ""
 /begin DEF_CHARACTERISTIC c_tnt_sp_ch_so2p ldp_n_32_id_ch_mod_req_so2p ldp_maf_id_ch_mod_req_so2p id_state_ch_mod_req_so2p /end DEF_CHARACTERISTIC
 /begin OUT_MEASUREMENT tnt_dif_ch_so2p state_ch_mod_so2p state_ch_mod_req_so2p /end OUT_MEASUREMENT
/end FUNCTION
/begin FUNCTION C_C_EXTC "" /begin SUB_FUNCTION EXTC_Maf_cor_cat_ht_strat_mode /end SUB_FUNCTION /end FUNCTION
/begin FUNCTION EXTC_Maf_cor_cat_ht_strat_mode "Maf_cor_cat_ht_strat_mode"
 /begin DEF_CHARACTERISTIC ldp_mff_post_ip_maf_dif_ch_l ldp_mff_sp_ip_maf_dif_ch_l_bas ldp_n_32_ip_maf_dif_ch_l_bas ip_maf_dif_add_mff_post_ch_l ip_maf_dif_s_ch_l_bas c_maf_dif_s_ch_man lc_maf_dif_s_ch_man_act /end DEF_CHARACTERISTIC
 /begin OUT_MEASUREMENT maf_dif_s_ch /end OUT_MEASUREMENT
/end FUNCTION
/begin FUNCTION C_9_ACRC ""
 /begin SUB_FUNCTION ACRC_setpoint_selction ACRC_setpoint_selection_appl_inc ACRC_pos_controller ACRC_pos_controller_appl_inc /end SUB_FUNCTION
/end FUNCTION
/begin FUNCTION ACRC_setpoint_selction "" /end FUNCTION
/begin FUNCTION ACRC_setpoint_selection_appl_inc ""
 /begin DEF_CHARACTERISTIC c_opg_sp_max_acr c_opg_sp_min_acr c_ctr_dly_acr_ctl c_ctr_opg_sp_pop_acr c_opg_sp_ext_acr c_opg_sp_lih_acr c_opg_sp_min_acr_ctl c_opg_sp_pop_acr lc_opg_sp_ext_acr lc_pwm_acr_off_ena /end DEF_CHARACTERISTIC
 /begin OUT_MEASUREMENT opg_sp_acr opg_sp_sel_acr lv_opg_sp_lih_acr opg_sp_lih_acr lv_opg_sp_ext_acr opg_sp_ext_acr lv_opg_sp_pop_acr opg_sp_pop_acr state_acr_ctl_req /end OUT_MEASUREMENT
/end FUNCTION
/begin FUNCTION ACRC_pos_controller ""
 /begin DEF_CHARACTERISTIC c_fac_c_1_acr_ctl c_fac_c_2_acr_ctl c_fac_c_3_acr_ctl c_fac_f_1_acr_ctl c_fac_f_2_acr_ctl c_fac_f_3_acr_ctl c_frq_pwm_acr c_kp_acr_ctl c_pwm_acr_close c_pwm_max_acr_ctl c_pwm_min_acr_ctl c_rate_opg_sp_acr ldp_vb_mmv_ip_fac_vb_pwm_acr ip_fac_vb_pwm_acr ldp_opg_sp_acr_ip_pwm_acr_stat ip_pwm_acr_stat /end DEF_CHARACTERISTIC
 /begin OUT_MEASUREMENT pwm_acr opg_dif_acr fac_vb_pwm_acr opg_sp_ctl_acr /end OUT_MEASUREMENT
/end FUNCTION
/begin FUNCTION ACRC_pos_controller_appl_inc "" /begin OUT_MEASUREMENT state_acr_ctl /end OUT_MEASUREMENT /end FUNCTION
/begin FUNCTION C_4_ACRC "" /begin SUB_FUNCTION ACRC_position_determination /end SUB_FUNCTION /end FUNCTION
/begin FUNCTION ACRC_position_determination "" /begin OUT_MEASUREMENT opg_acr v_acr v_acr_mv v_acr_bas /end OUT_MEASUREMENT /end FUNCTION
/begin FUNCTION C_A_ACRC ""
 /begin SUB_FUNCTION ACRC_adaption_and_diagnosis ACRC_adaption_and_diagnosis_appl_inc ACRC_actuator_diagnosis ACRC_actuator_diagnosis_AI ACRC_limp_home_management ACRC_position_sensor_diagnosis ACRC_position_sensor_diagnosis_AI ACRC_power_stage_diagnosis ACRC_power_stage_diagnosis_AI /end SUB_FUNCTION
/end FUNCTION
/begin FUNCTION ACRC_adaption_and_diagnosis ""
 /begin DEF_CHARACTERISTIC c_crlc_acr_ad c_ctr_dly_acr_ad_max c_ctr_inh_acr_ad_max c_fac_acr_slop c_v_acr_ad_bol_ini c_v_acr_ad_bol_max c_v_acr_ad_bol_min c_ctr_acr_ad c_ctr_dly_acr_ad c_opg_sp_ad_lgrd c_opg_sp_max_ad_acr c_v_acr_ad_chk_ctl c_v_acr_ad_tol_ini c_v_acr_ad_tol_max lc_fac_acr_slop_ad_ena c_v_acr_ad_tol_min /end DEF_CHARACTERISTIC
 /begin OUT_MEASUREMENT lv_inh_acr_ctl_ad fac_acr_slop v_acr_ad_bol ctr_dly_acr_ad ctr_inh_acr_ad lv_err_acr_ad state_acr_ad lv_opg_sp_ad_acr opg_sp_ad_acr v_acr_ad_tol /end OUT_MEASUREMENT
/end FUNCTION
/begin FUNCTION ACRC_adaption_and_diagnosis_appl_inc "" /begin DEF_CHARACTERISTIC lc_acr_ad_req /end DEF_CHARACTERISTIC
 /begin OUT_MEASUREMENT lv_inh_acr_ad lv_acr_ad_act lv_acr_ad_req lv_inh_acr_ad_bol /end OUT_MEASUREMENT
/end FUNCTION
/begin FUNCTION ACRC_actuator_diagnosis ""
 /begin DEF_CHARACTERISTIC c_abc_dec_acr_ctl c_abc_inc_acr_ctl c_abc_max_acr_ctl c_crlc_opg_sp_acr c_crlc_pwm_acr c_pwm_acr_max_diag c_vb_min_pwm_acr_diag ip_opg_dif_acr_err_max ldp_opg_sp_acr_grd_absv_ip_opg /end DEF_CHARACTERISTIC
 /begin OUT_MEASUREMENT lv_err_acr_ctl ctr_diag_acr_ctl pwm_acr_mmv opg_sp_acr_fil opg_dif_acr_err_max opg_sp_acr_grd /end OUT_MEASUREMENT
/end FUNCTION
/begin FUNCTION ACRC_actuator_diagnosis_AI "" /begin OUT_MEASUREMENT lv_inh_diag_acr_ctl /end OUT_MEASUREMENT /end FUNCTION
/begin FUNCTION ACRC_limp_home_management "" /begin OUT_MEASUREMENT lv_pwm_acr_off_req /end OUT_MEASUREMENT /end FUNCTION
/begin FUNCTION ACRC_position_sensor_diagnosis ""
 /begin DEF_CHARACTERISTIC c_abc_inc_sens_acr c_abc_max_sens_acr c_v_max_sens_acr c_v_min_sens_acr /end DEF_CHARACTERISTIC
 /begin OUT_MEASUREMENT lv_err_sens_acr /end OUT_MEASUREMENT
/end FUNCTION
/begin FUNCTION ACRC_position_sensor_diagnosis_AI "" /begin OUT_MEASUREMENT lv_inh_diag_sens_acr lv_err_vcc_acr /end OUT_MEASUREMENT /end FUNCTION
/begin FUNCTION ACRC_power_stage_diagnosis "" /begin DEF_CHARACTERISTIC c_abc_inc_acr_dr c_abc_max_acr_dr /end DEF_CHARACTERISTIC /begin OUT_MEASUREMENT lv_err_acr_dr /end OUT_MEASUREMENT /end FUNCTION
/begin FUNCTION ACRC_power_stage_diagnosis_AI "" /begin DEF_CHARACTERISTIC c_vb_min_acr_dr_diag /end DEF_CHARACTERISTIC /begin OUT_MEASUREMENT lv_inh_diag_acr_dr /end OUT_MEASUREMENT /end FUNCTION
/end MODULE
/end PROJECT
