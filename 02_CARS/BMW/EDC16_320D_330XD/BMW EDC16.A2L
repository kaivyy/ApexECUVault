ASAP2_VERSION 1 3
/begin PROJECT P383 "BMW DDE6.3 8-Zylinder V9E.3 11.10.2004 CAN12H"
/begin HEADER "" VERSION "V9E.3_8Z_CAN12H" PROJECT_NO P383 /end HEADER
/begin MODULE DIM ""
/begin MOD_COMMON "" BYTE_ORDER MSB_FIRST ALIGNMENT_BYTE 1 ALIGNMENT_WORD 2 ALIGNMENT_LONG 4 ALIGNMENT_FLOAT32_IEEE 4 /end MOD_COMMON
/begin CHARACTERISTIC PFlt_cpExhGs_C "Spezifische Wärmekapazität des Abgases" VALUE 0xF5A10 Kw_Wu16 2000.000 Thr_Cpty_ExhGs 0.00 2000.000 FORMAT "%8.3" EXTENDED_LIMITS 0.00 655350.0 /end CHARACTERISTIC
/begin CHARACTERISTIC PFlt_CPFlt_C "Wärmekapazität des Partikelfilters" VALUE 0xF5A12 Kw_Wu16 32900.00 Thr_Cpty 100.0000 33000.00 FORMAT "%8.2" EXTENDED_LIMITS 0.00 65535.00 /end CHARACTERISTIC
/begin CHARACTERISTIC PFlt_ctEngPrtRgn_C "Schwelle für Maschinenschutz-Regenerationszählimpuls" VALUE 0xF5300 Kw_Wu16 65535.00 OneToOne 0.00 65535.00 FORMAT "%8.2" /end CHARACTERISTIC
/begin CHARACTERISTIC PFlt_ddvolHsLnPlausNeg_C "Negativer Schwellwert Volumenstromänderung zur Dynamikplausibilisierung" VALUE 0xF5264 Kw_Ws16 1500.000 CubMtrPerHrPerSec -1500.000 0.00 FORMAT "%8.3" EXTENDED_LIMITS -3276.800 3276.700 /end CHARACTERISTIC
/begin CHARACTERISTIC PFlt_ddvolHsLnPlausPos_C "Positiver Schwellwert Volumenstromänderung zur Dynamikplausibilisierung" VALUE 0xF5266 Kw_Ws16 1500.000 CubMtrPerHrPerSec 0.00 1500.000 FORMAT "%8.3" EXTENDED_LIMITS -3276.800 3276.700 /end CHARACTERISTIC
/begin CHARACTERISTIC PFlt_ddvolHsLnSot_C "Schwellwert Volumenstromänderung zur Schlauchleitungsüberwachung" VALUE 0xF5268 Kw_Ws16 3000.000 CubMtrPerHrPerSec -1500.000 1500.000 FORMAT "%8.3" EXTENDED_LIMITS -3276.800 3276.700 /end CHARACTERISTIC
/begin CHARACTERISTIC PFlt_DebAPSPlausDefHigh_C "Defektentprellzeit der APS-Plaus positiven Abweichung (MAX) bei projektspezifischen Druck-Plausibilitätsprüfungen" VALUE 0xF5302 Kw_Wu16 1000.000 Time_ms 0.00 1000.000 FORMAT "%8.3" EXTENDED_LIMITS 0.00 655350.0 /end CHARACTERISTIC
/begin CHARACTERISTIC PFlt_DebAPSPlausDefLow_C "Defektentprellzeit der APS-Plaus negativen Abweichung (MIN) bei projektspezifischen Druck-Plausibilitätsprüfungen" VALUE 0xF5304 Kw_Wu16 1000.000 Time_ms 0.00 1000.000 FORMAT "%8.3" EXTENDED_LIMITS 0.00 655350.0 /end CHARACTERISTIC
/begin CHARACTERISTIC PFlt_DebBPSPlausDefHigh_C "Defektentprellzeit der BPS-Plaus positiven Abweichung (MAX) bei projektspezifischen Druck-Plausibilitätsprüfungen" VALUE 0xF5306 Kw_Wu16 1000.000 Time_ms 0.00 1000.000 FORMAT "%8.3" EXTENDED_LIMITS 0.00 655350.0 /end CHARACTERISTIC
/begin CHARACTERISTIC PFlt_DebBPSPlausDefLow_C "Defektentprellzeit der BPS-Plaus negativen Abweichung (MIN) bei projektspezifischen Druck-Plausibilitätsprüfungen" VALUE 0xF5308 Kw_Wu16 1000.000 Time_ms 0.00 1000.000 FORMAT "%8.3" EXTENDED_LIMITS 0.00 655350.0 /end CHARACTERISTIC
/begin CHARACTERISTIC PFlt_DebPFltOvldInhRgnDef_C "Defekt debounce Zeit für Dfp_PFltOvldInhRgn" VALUE 0xF530A Kw_Wu16 20000.00 Time_ms 0.00 20000.00 FORMAT "%8.2" EXTENDED_LIMITS 0.00 655350.0 /end CHARACTERISTIC
/begin CHARACTERISTIC PFlt_DebPFltOvldInhRgnOk_C "Heilende Zeit für Dfp_PFltOvldInhRgn" VALUE 0xF530C Kw_Wu16 20000.00 Time_ms 0.00 20000.00 FORMAT "%8.2" EXTENDED_LIMITS 0.00 655350.0 /end CHARACTERISTIC
/begin CHARACTERISTIC PFlt_DebPFltOvldTrqLimDef_C "Defekt debounce Zeit fuer Dfp_PFltOvldTrqLim" VALUE 0xF530E Kw_Wu16 20000.00 Time_ms 0.00 20000.00 FORMAT "%8.2" EXTENDED_LIMITS 0.00 655350.0 /end CHARACTERISTIC
/begin CHARACTERISTIC PFlt_DebPFltOvldTrqLimOk_C "Heilende entprell Zeit für Dfp_PFltOvldTrqLim" VALUE 0xF5310 Kw_Wu16 20000.00 Time_ms 0.00 20000.00 FORMAT "%8.2" EXTENDED_LIMITS 0.00 655350.0 /end CHARACTERISTIC
/begin CHARACTERISTIC PFlt_DebPresPlausDefHigh_C "Defektentprellzeit der Pre-PFlt-Pres-Plaus positiven Abweichung (MAX) bei projektspezifischen Druck-Plausibilitätsprüfungen" VALUE 0xF5312 Kw_Wu16 1000.000 Time_ms 0.00 1000.000 FORMAT "%8.3" EXTENDED_LIMITS 0.00 655350.0 /end CHARACTERISTIC
/begin CHARACTERISTIC PFlt_DebPresPlausDefLow_C "Defektentprellzeit der Pre-PFlt-Pres-Plaus negativen Abweichung (MIN) bei projektspezifischen Druck-Plausibilitätsprüfungen" VALUE 0xF5314 Kw_Wu16 1000.000 Time_ms 0.00 1000.000 FORMAT "%8.3" EXTENDED_LIMITS 0.00 655350.0 /end CHARACTERISTIC
/begin CHARACTERISTIC PFlt_DebRstDfpEngPrtRgnMon_C "Entprellzeit zum Zurücksetzen von DfpEngPrtRgnMon_C" VALUE 0xF5316 Kw_Wu16 655.3500 Time_s 0.00 655.3500 FORMAT "%8.4" /end CHARACTERISTIC
/begin CHARACTERISTIC PFlt_dvolCharMonMin_C "Mindestvolumenstrom für Überwachung des Strömungswiderstandes" VALUE 0xF526A Kw_Ws16 100.0000 CubMtrPerHr 0.00 100.0000 FORMAT "%8.4" EXTENDED_LIMITS -3276.800 3276.700 /end CHARACTERISTIC
/begin CHARACTERISTIC PFlt_dvolRstDfpEngPrtMon_C "Luftstromschwelle zum Zurücksetzen von dpf_pfltmsotdiffmax" VALUE 0xF5318 Kw_Ws16 3000.000 CubMtrPerHr 0.00 3000.000 FORMAT "%8.3" EXTENDED_LIMITS -3276.800 3276.700 /end CHARACTERISTIC
/begin CHARACTERISTIC PFlt_facBlwBy_C "Thermischer Austauschfaktor für Abgas im Filter" VALUE 0xF5A14 Kw_Ws16 1.000000 Fact 0.00 1.000000 FORMAT "%8.6" EXTENDED_LIMITS -4.000000 3.999878 /end CHARACTERISTIC
/begin CHARACTERISTIC PFlt_facDpn_MAP "Kennfeld für Bestimmung der Wärmeverlustfaktor nach Abgastemperatursensor" MAP 0xF5A16 Kf_Xs16_Ys16_Ws16 1.000000 Fact 0.00 1.000000 FORMAT "%8.6" EXTENDED_LIMITS -4.000000 3.999878
 /begin AXIS_DESCR STD_AXIS IATSCD_tAir Temp_Cels 8 -50.14000 199.8600 FORMAT "%8.4" EXTENDED_LIMITS -3549.940 3003.560 DEPOSIT ABSOLUTE /end AXIS_DESCR
 /begin AXIS_DESCR STD_AXIS VSSCD_v Vel 8 0.00 300.0000 FORMAT "%8.4" EXTENDED_LIMITS -327.6800 327.6700 DEPOSIT ABSOLUTE /end AXIS_DESCR
/end CHARACTERISTIC
/begin CHARACTERISTIC PFlt_facHtTransNoLin_CUR "Nichtlinearitätsfaktor in der Wärmeübertragung im Filter" CURVE 0xF5ABA Kl_Xs16_Ws16 1.000000 Fact 0.00 1.000000 FORMAT "%8.6" EXTENDED_LIMITS -4.000000 3.999878
 /begin AXIS_DESCR STD_AXIS PFlt_tDiffCorr_mp TempDiff_Cels 4 500.0000 1000.000 FORMAT "%8.3" EXTENDED_LIMITS -3276.800 3276.700 DEPOSIT ABSOLUTE /end AXIS_DESCR
/end CHARACTERISTIC
/begin CHARACTERISTIC PFlt_facNO2RgnInhRgn_CUR "" CURVE 0xF531A Kl_Xs16_Ws16 7.999878 Fact -4.000000 3.999878 FORMAT "%8.6"
 /begin AXIS_DESCR STD_AXIS PFlt_facNO2RgnMapIn_mp Fact 10 0.00 1.000000 FORMAT "%8.6" EXTENDED_LIMITS -4.000000 3.999878 DEPOSIT ABSOLUTE /end AXIS_DESCR
/end CHARACTERISTIC
/begin CHARACTERISTIC PFlt_facNO2RgnTrqLim_CUR "" CURVE 0xF5344 Kl_Xs16_Ws16 7.999878 Fact -4.000000 3.999878 FORMAT "%8.6"
 /begin AXIS_DESCR STD_AXIS PFlt_facNO2RgnMapIn_mp Fact 10 0.00 1.000000 FORMAT "%8.6" EXTENDED_LIMITS -4.000000 3.999878 DEPOSIT ABSOLUTE /end AXIS_DESCR
/end CHARACTERISTIC
/begin CHARACTERISTIC PFlt_KdDT1TempCor_C "Sprunghöhe des DT1-Filters der Wärmeübergangssim. im Filter" VALUE 0xF5ACC Kw_Ws32 100.000000000 Kd -50.0000000000 50.0000000000 FORMAT "%13.10" EXTENDED_LIMITS -32768.0000000 32767.9999847 /end CHARACTERISTIC
/begin CHARACTERISTIC PFlt_kiITempMod_C "Verstärkungsfaktor Integrator Temperaturmodell" VALUE 0xF5AD0 Kw_Ws32 999999.999767 Ki -500000.000000 499999.999767 FORMAT "%13.6" /end CHARACTERISTIC
/begin CHARACTERISTIC PFlt_lRstDfpEngPrtMon_C "Strecke seit der letzten erfolgreichen Regeneration zum Zurücksetzen von dpf_pfltmsotdiffmax" VALUE 0xF5370 Kw_Wu32 4294967295.00 Length 0.00 4294967295.00 FORMAT "%13.2" /end CHARACTERISTIC
/begin CHARACTERISTIC PFlt_lSumDiffMax_C "Maximum erlaubte Unterschied für gefahrene Länge in Kilometer" VALUE 0xF5374 Kw_Wu32 4294967295.00 LengthKm 0.00 4294967295.00 FORMAT "%13.2" /end CHARACTERISTIC
/begin CHARACTERISTIC PFlt_mLoIdlSotSimMax_C "maximaler Wert des simulierten Rußes, über den Druck-Plausibilitätsprüfungen im niedrigen Leerlaufzustand verhindert werden" VALUE 0xF5378 Kw_Ws16 300.0000 mSoot_g 0.00 300.0000 FORMAT "%8.4" EXTENDED_LIMITS -327.6800 327.6700 /end CHARACTERISTIC
/begin CHARACTERISTIC PFlt_mSotDiff_C "Threshold value for difference between simulated and measured value of soot mass" VALUE 0xF537A Kw_Ws16 300.0000 mSoot_g 0.00 300.0000 FORMAT "%8.4" EXTENDED_LIMITS -327.6800 327.6700 /end CHARACTERISTIC
/begin CHARACTERISTIC PFlt_nLoIdlMax_C "obere Grenze des Drehzahlfensters, um Druck-Plausibilitätsprüfungen im niedrigen Leerlaufzustand zu ermöglichen" VALUE 0xF537C Kw_Ws16 5000.000 EngN 0.00 5000.000 FORMAT "%8.3" EXTENDED_LIMITS -32768.00 32767.00 /end CHARACTERISTIC
/begin CHARACTERISTIC PFlt_nLoIdlMin_C "untere Grenze des Drehzahlfensters, um Druck-Plausibilitätsprüfungen im niedrigen Leerlaufzustand zu ermöglichen" VALUE 0xF537E Kw_Ws16 5000.000 EngN 0.00 5000.000 FORMAT "%8.3" EXTENDED_LIMITS -32768.00 32767.00 /end CHARACTERISTIC
/begin CHARACTERISTIC PFlt_nMin_C "minimale Drehzahl, um Druck-Plausibilitätsprüfungen bei Kl15-EIN und nach dem Aufwachungszustand zu deaktivieren" VALUE 0xF5380 Kw_Ws16 5000.000 EngN 0.00 5000.000 FORMAT "%8.3" EXTENDED_LIMITS -32768.00 32767.00 /end CHARACTERISTIC
/begin CHARACTERISTIC PFlt_nPFltOvldHeal_C "Minimale Motordrehzahlschwelle für das Heilend von PFlt Überlastung dfps" VALUE 0xF5382 Kw_Ws16 5000.000 EngN 0.00 5000.000 FORMAT "%8.3" EXTENDED_LIMITS -32768.00 32767.00 /end CHARACTERISTIC
/begin CHARACTERISTIC PFlt_nStrtMax_C "obere Grenze des Drehzahlfensters, um Druck-Plausibilitätsprüfungen im Startzustand zu ermöglichen" VALUE 0xF5384 Kw_Ws16 5000.000 EngN 0.00 5000.000 FORMAT "%8.3" EXTENDED_LIMITS -32768.00 32767.00 /end CHARACTERISTIC
/begin CHARACTERISTIC PFlt_nStrtMin_C "untere Grenze des Drehzahlfensters, um Druck-Plausibilitätsprüfungen im Startzustand zu ermöglichen" VALUE 0xF5386 Kw_Ws16 5000.000 EngN 0.00 5000.000 FORMAT "%8.3" EXTENDED_LIMITS -32768.00 32767.00 /end CHARACTERISTIC
/begin CHARACTERISTIC PFlt_nTempChkTrg_C "Drehzahlschwelle zur Triggerung Zeitfenster Temperaturplausibilisierung" VALUE 0xF526C Kw_Ws16 1500.000 EngN 500.0000 2000.000 FORMAT "%8.3" EXTENDED_LIMITS -32768.00 32767.00 /end CHARACTERISTIC
/begin CHARACTERISTIC PFlt_numCntBck_C "Backstep value of the counter for IATSCD minimum search" VALUE 0xF526E Kw_Wu16 65535.00 OneToOne 0.00 65535.00 FORMAT "%8.2" /end CHARACTERISTIC
/begin CHARACTERISTIC PFlt_numCntMax_C "Maximum counter value for IATSCD minimum search" VALUE 0xF5270 Kw_Wu16 65535.00 OneToOne 0.00 65535.00 FORMAT "%8.2" /end CHARACTERISTIC
/begin CHARACTERISTIC PFlt_numCylRefB1_C "Nummer des Referenzzylinders auf Bank 1" VALUE 0xF5AD4 Kw_Wu8 7.000 OneToOne 0.00 7.000 FORMAT "%5.3" EXTENDED_LIMITS 0.00 255.0 /end CHARACTERISTIC
/begin CHARACTERISTIC PFlt_numCylRefB2_C "Nummer des Referenzzylinders auf Bank 2" VALUE 0xF5AD5 Kw_Wu8 7.000 OneToOne 0.00 7.000 FORMAT "%5.3" EXTENDED_LIMITS 0.00 255.0 /end CHARACTERISTIC
/begin CHARACTERISTIC PFlt_numEngPrtActvMsk_C "Aktivierungsmaske des Motorschutzes abhängig von der Regeneration" VALUE 0xF5388 Kw_Wu8 255.0 OneToOne 0.00 255.0 FORMAT "%5.1" /end CHARACTERISTIC
/begin CHARACTERISTIC PFlt_numPFltMon_C "Zeiger für Motortemperaturfeld" VALUE 0xF5272 Kw_Wu8 2.00000000000 EngTempFldSel 0.00 2.00000000000 FORMAT "%13.11" /end CHARACTERISTIC
/begin CHARACTERISTIC PFlt_numRgnStep1_C "Partikelfilterregeneration im 1. Schritt" VALUE 0xF5389 Kw_Wu8 255.0 OneToOne 0.00 255.0 FORMAT "%5.1" /end CHARACTERISTIC
/begin CHARACTERISTIC PFlt_numRgnStep2_C "Partikelfilterregeneration im 2 . Schritt" VALUE 0xF538A Kw_Wu8 255.0 OneToOne 0.00 255.0 FORMAT "%5.1" /end CHARACTERISTIC
/begin CHARACTERISTIC PFlt_numRgnStep3_C "Partikelfilterregeneration im 3. Schritt" VALUE 0xF538B Kw_Wu8 255.0 OneToOne 0.00 255.0 FORMAT "%5.1" /end CHARACTERISTIC
/begin CHARACTERISTIC PFlt_numRgnStep4_C "Partikelfilterregeneration im 4. Schritt" VALUE 0xF538C Kw_Wu8 255.0 OneToOne 0.00 255.0 FORMAT "%5.1" /end CHARACTERISTIC
/begin CHARACTERISTIC PFlt_numRgnStep5_C "Partikelfilterregeneration im 5. Schritt" VALUE 0xF538D Kw_Wu8 255.0 OneToOne 0.00 255.0 FORMAT "%5.1" /end CHARACTERISTIC
/begin CHARACTERISTIC PFlt_numRgnStep6_C "Partikelfilterregeneration im 6. Schritt" VALUE 0xF538E Kw_Wu8 255.0 OneToOne 0.00 255.0 FORMAT "%5.1" /end CHARACTERISTIC
/begin CHARACTERISTIC PFlt_numRgnStep7_C "Partikelfilterregeneration im 7. Schritt" VALUE 0xF538F Kw_Wu8 255.0 OneToOne 0.00 255.0 FORMAT "%5.1" /end CHARACTERISTIC
/begin CHARACTERISTIC PFlt_numRgnStep8_C "Partikelfilterregeneration im 8. Schritt" VALUE 0xF5390 Kw_Wu8 255.0 OneToOne 0.00 255.0 FORMAT "%5.1" /end CHARACTERISTIC
/begin CHARACTERISTIC PFlt_numTimeStpPlausSens_C "Anzahl Zeitschritte für numerische Differentiation der Sensorsignale" VALUE 0xF5273 Kw_Wu8 9.000 OneToOne 1.000 10.00 FORMAT "%5.2" EXTENDED_LIMITS 0.00 255.0 /end CHARACTERISTIC
/begin CHARACTERISTIC PFlt_pAPSNegDvt_C "Begrenzung der APS unter welchem der MIN-Fehler bei Druck-Plausibilitätsprüfungen auf APS-Plaus gesetzt wird" VALUE 0xF5392 Kw_Ws16 5000.000 Pres_hPa 0.00 5000.000 FORMAT "%8.3" EXTENDED_LIMITS -32768.00 32767.00 /end CHARACTERISTIC
/begin CHARACTERISTIC PFlt_pAPSPosDvt_C "Begrenzung der APS über welchem der MAX-Fehler bei Druck-Plausibilitätsprüfungen auf APS-Plaus gesetzt wird" VALUE 0xF5394 Kw_Ws16 5000.000 Pres_hPa 0.00 5000.000 FORMAT "%8.3" EXTENDED_LIMITS -32768.00 32767.00 /end CHARACTERISTIC
/begin CHARACTERISTIC PFlt_pBPAndAPTolcMax_C "Toleranzband für Ladedrucksensor und Atmosphärendrucksensor" VALUE 0xF5274 Kw_Wu16 65535.00 Pres_hPa 0.00 65535.00 FORMAT "%8.2" /end CHARACTERISTIC
/begin CHARACTERISTIC PFlt_pBPSNegDvt_C "Begrenzung der BPS unter welchem der MIN-Fehler bei Druck-Plausibilitätsprüfungen auf APS Plaus gesetzt wird" VALUE 0xF5396 Kw_Ws16 5000.000 Pres_hPa 0.00 5000.000 FORMAT "%8.3" EXTENDED_LIMITS -32768.00 32767.00 /end CHARACTERISTIC
/begin CHARACTERISTIC PFlt_pBPSPosDvt_C "Begrenzung der BPS über den maximalen Fehler auf BPS-Plaus bei Druck-Plausibilitätsprüfungen gestellt" VALUE 0xF5398 Kw_Ws16 5000.000 Pres_hPa 0.00 5000.000 FORMAT "%8.3" EXTENDED_LIMITS -32768.00 32767.00 /end CHARACTERISTIC
/begin CHARACTERISTIC PFlt_pDfl_C "Vorgabewert Absolutdruck vor Partikelfilter" VALUE 0xF59F4 Kw_Ws16 65535.00 Pres_hPa -32768.00 32767.00 FORMAT "%8.2" /end CHARACTERISTIC
/begin CHARACTERISTIC PFlt_pDiffCharMonMin_C "Mindestdifferenzdruck für Überwachung des Strömungswiderstandes" VALUE 0xF5276 Kw_Ws16 4500.000 Pres_hPa -1000.000 3500.000 FORMAT "%8.3" EXTENDED_LIMITS -32768.00 32767.00 /end CHARACTERISTIC
/begin CHARACTERISTIC PFlt_pDiffHsLnNeg_C "Untere Schwelle Differenzdruck zur Schlauchleitungsüberwachung" VALUE 0xF5278 Kw_Ws16 3277.0000 Pres_hPa 223.0000 3500.0000 FORMAT "%8.4" EXTENDED_LIMITS -32768.00 32767.00 /end CHARACTERISTIC
/begin CHARACTERISTIC PFlt_pDiffMax1_C "maximale Schwelle für die Regenerationsüberwachung des Motorschutzes" VALUE 0xF539A Kw_Ws16 3277.0000 Pres_hPa 223.0000 3500.0000 FORMAT "%8.4" EXTENDED_LIMITS -32768.00 32767.00 /end CHARACTERISTIC
/begin CHARACTERISTIC PFlt_pDiffMax_C "Obere Schwelle SRC Differenzdruck" VALUE 0xF527A Kw_Ws16 3277.0000 Pres_hPa 223.0000 3500.0000 FORMAT "%8.4" EXTENDED_LIMITS -32768.00 32767.00 /end CHARACTERISTIC
/begin CHARACTERISTIC PFlt_pDiffMin_C "Untere Schwelle SRC Differenzdruck" VALUE 0xF527C Kw_Ws16 3277.0000 Pres_hPa 223.0000 3500.0000 FORMAT "%8.4" EXTENDED_LIMITS -32768.00 32767.00 /end CHARACTERISTIC
/begin CHARACTERISTIC PFlt_pDiffTolcMax_C "Toleranzband Differenzdrucksensor" VALUE 0xF527E Kw_Ws16 3277.0000 Pres_hPa 223.0000 3500.0000 FORMAT "%8.4" EXTENDED_LIMITS -32768.00 32767.00 /end CHARACTERISTIC
/begin CHARACTERISTIC PFlt_pMinNrmCldStrt_C "Mindestumgebungsdruck für normalen Kaltstart" VALUE 0xF5280 Kw_Ws16 2700.000 Pres_hPa 800.0000 3500.000 FORMAT "%8.3" EXTENDED_LIMITS -32768.00 32767.00 /end CHARACTERISTIC
/begin CHARACTERISTIC PFlt_pPFltOvldInhRgn_MAP "Kennfeld für PFlt Überlastung Regenerationshemmung" MAP 0xF539C Kf_Xs16_Ys16_Ws16 3500.000 Pres_hPa 0.00 3500.000 FORMAT "%8.3" EXTENDED_LIMITS -32768.00 32767.00
 /begin AXIS_DESCR STD_AXIS Eng_nAvrg EngN 8 40.00000 6000.000 FORMAT "%8.3" EXTENDED_LIMITS -32768.00 32767.00 DEPOSIT ABSOLUTE /end AXIS_DESCR
 /begin AXIS_DESCR STD_AXIS InjCtl_qSetUnBal InjMassCyc 8 0.00 327.6700 FORMAT "%8.4" EXTENDED_LIMITS -327.6800 327.6700 DEPOSIT ABSOLUTE /end AXIS_DESCR
/end CHARACTERISTIC
/begin CHARACTERISTIC PFlt_pPFltOvldInit_C "Initwert des PT1Filter fuer PFlt_pPFltOvldLckRgn_mp" VALUE 0xF5440 Kw_Ws16 32767.00 Pres_hPa 0.00 32767.00 FORMAT "%8.2" EXTENDED_LIMITS -32768.00 32767.00 /end CHARACTERISTIC
/begin CHARACTERISTIC PFlt_pPFltOvldOfsHeal_C "Schwelle für die Heilung" VALUE 0xF5442 Kw_Ws16 32767.00 Pres_hPa 0.00 32767.00 FORMAT "%8.2" EXTENDED_LIMITS -32768.00 32767.00 /end CHARACTERISTIC
/begin CHARACTERISTIC PFlt_pPFltOvldTrqLim_MAP "Kennfeld fuer PFlt Uberladung Drehkraft-Beschränkung Berechnung" MAP 0xF5444 Kf_Xs16_Ys16_Ws16 3500.000 Pres_hPa 0.00 3500.000 FORMAT "%8.3" EXTENDED_LIMITS -32768.00 32767.00
 /begin AXIS_DESCR STD_AXIS Eng_nAvrg EngN 8 40.00000 6000.000 FORMAT "%8.3" EXTENDED_LIMITS -32768.00 32767.00 DEPOSIT ABSOLUTE /end AXIS_DESCR
 /begin AXIS_DESCR STD_AXIS InjCtl_qSetUnBal InjMassCyc 8 0.00 327.6700 FORMAT "%8.4" EXTENDED_LIMITS -327.6800 327.6700 DEPOSIT ABSOLUTE /end AXIS_DESCR
/end CHARACTERISTIC
/begin CHARACTERISTIC PFlt_pPreAndBPTolcMax_C "Toleranzband für Ladedrucksensor und absolut Drucksensor" VALUE 0xF5282 Kw_Ws16 65535.00 Pres_hPa -32768.00 32767.00 FORMAT "%8.2" /end CHARACTERISTIC
/begin CHARACTERISTIC PFlt_pPreAshOilCorr_MAP "von Auf PFlt_dvol und PFlt_mAshOil abhängiges Kennfeld zur Korrekturwertberechnung von PFlt_pPre" MAP 0xF54E8 Kf_Xs16_Ys16_Ws16 5000.000 Pres_hPa 0.00 5000.000 FORMAT "%8.3" EXTENDED_LIMITS -32768.00 32767.00
 /begin AXIS_DESCR STD_AXIS PFlt_dVolMapIn_mp CubMtrPerHr 5 0.00 3000.000 FORMAT "%8.3" EXTENDED_LIMITS -3276.800 3276.700 DEPOSIT ABSOLUTE /end AXIS_DESCR
 /begin AXIS_DESCR STD_AXIS PFlt_mAshOilMapIn_mp mSoot_g 5 0.00 300.0000 FORMAT "%8.4" EXTENDED_LIMITS -327.6800 327.6700 DEPOSIT ABSOLUTE /end AXIS_DESCR
/end CHARACTERISTIC
/begin CHARACTERISTIC PFlt_pPreCorrMax_C "maximaler Korrekturwert, welcher für PFlt_pPre zum Plausibilitätstest appliziert werden kann" VALUE 0xF5532 Kw_Ws16 5000.000 Pres_hPa 0.00 5000.000 FORMAT "%8.3" EXTENDED_LIMITS -32768.00 32767.00 /end CHARACTERISTIC
/begin CHARACTERISTIC PFlt_pPreDfl_C "Ersatzwert bei Druck vor Partikelfilter unplausibel" VALUE 0xF59F6 Kw_Ws16 65535.00 Pres_hPa -32768.00 32767.00 FORMAT "%8.2" /end CHARACTERISTIC
/begin CHARACTERISTIC PFlt_pPresNegDvt_C "Begrenzung der pPreCorr  unter welchem der MIN-Fehler bei  Druck-Plausibilitätsprüfungen auf pPre Plaus gesetzt wird" VALUE 0xF5534 Kw_Ws16 5000.000 Pres_hPa 0.00 5000.000 FORMAT "%8.3" EXTENDED_LIMITS -32768.00 32767.00 /end CHARACTERISTIC
/begin CHARACTERISTIC PFlt_pPreSotSimCorr_MAP "von PFlt_dvol und PFlt_mSotSim abhängiges Kennfeld zur Korrekturwertberechnung von PFlt_pPre" MAP 0xF5536 Kf_Xs16_Ys16_Ws16 5000.000 Pres_hPa 0.00 5000.000 FORMAT "%8.3" EXTENDED_LIMITS -32768.00 32767.00
 /begin AXIS_DESCR STD_AXIS PFlt_dVolMapIn_mp CubMtrPerHr 5 0.00 3000.000 FORMAT "%8.3" EXTENDED_LIMITS -3276.800 3276.700 DEPOSIT ABSOLUTE /end AXIS_DESCR
 /begin AXIS_DESCR STD_AXIS PFlt_mSotSimMapIn_mp mSoot_g 5 0.00 300.0000 FORMAT "%8.4" EXTENDED_LIMITS -327.6800 327.6700 DEPOSIT ABSOLUTE /end AXIS_DESCR
/end CHARACTERISTIC
/begin CHARACTERISTIC PFlt_pPresPlausMaxDvt_C "Begrenzung für Druckunterschied  über den NPL-Fehler auf Doppeldefekt Plaus bei den Druck-Plausibilitätsprüfungen gestellt" VALUE 0xF5580 Kw_Ws16 5000.000 Pres_hPa 0.00 5000.000 FORMAT "%8.3" EXTENDED_LIMITS -32768.00 32767.00 /end CHARACTERISTIC
/begin CHARACTERISTIC PFlt_pPresPlausMinDvt_C "Begrenzung der Druckdifferenz unter welchem alle Fehler bei  Druck-Plausibilitätsprüfungen gelöscht werden" VALUE 0xF5582 Kw_Ws16 5000.000 Pres_hPa 0.00 5000.000 FORMAT "%8.3" EXTENDED_LIMITS -32768.00 32767.00 /end CHARACTERISTIC
/begin CHARACTERISTIC PFlt_pPresPosDvt_C "Begrenzung der pPreCorr über den  maximalen Fehler auf pPre Plaus für Druck-Plausibilitätsprüfungen" VALUE 0xF5584 Kw_Ws16 5000.000 Pres_hPa 0.00 5000.000 FORMAT "%8.3" EXTENDED_LIMITS -32768.00 32767.00 /end CHARACTERISTIC
/begin CHARACTERISTIC PFlt_pPreTolcMax_C "Toleranzband Absolutdrucksensor" VALUE 0xF5284 Kw_Ws16 3277.0000 Pres_hPa 223.0000 3500.0000 FORMAT "%8.4" EXTENDED_LIMITS -32768.00 32767.00 /end CHARACTERISTIC
/begin CHARACTERISTIC PFlt_pPreVolCorr_CUR "von PFlt_dvol abhängige Kennlinie zur Korrekturwertberechnung von PFlt_pPre" CURVE 0xF5586 Kl_Xs16_Ws16 5000.000 Pres_hPa 0.00 5000.000 FORMAT "%8.3" EXTENDED_LIMITS -32768.00 32767.00
 /begin AXIS_DESCR STD_AXIS PFlt_dVolMapIn_mp CubMtrPerHr 5 0.00 3000.000 FORMAT "%8.3" EXTENDED_LIMITS -3276.800 3276.700 DEPOSIT ABSOLUTE /end AXIS_DESCR
/end CHARACTERISTIC
/begin CHARACTERISTIC PFlt_qLoIdlMax_C "obere Grenze der Einspritzmenge für den Leerlaufdruckplausibilitätstest" VALUE 0xF559C Kw_Ws16 327.6700 InjMassCyc 0.00 327.6700 FORMAT "%8.4" EXTENDED_LIMITS -327.6800 327.6700 /end CHARACTERISTIC
/begin CHARACTERISTIC PFlt_qLoIdlMin_C "untere Grenze der Einspritzmenge für den Leerlaufdruckplausibilitätstest" VALUE 0xF559E Kw_Ws16 327.6700 InjMassCyc 0.00 327.6700 FORMAT "%8.4" EXTENDED_LIMITS -327.6800 327.6700 /end CHARACTERISTIC
/begin CHARACTERISTIC PFlt_qPFltOvldHeal_C "Schwelle für die Einspritzmenge" VALUE 0xF55A0 Kw_Ws16 327.6700 InjMassInj 0.00 327.6700 FORMAT "%8.4" EXTENDED_LIMITS -327.6800 327.6700 /end CHARACTERISTIC
/begin CHARACTERISTIC PFlt_rEngPrtRgnMax_C "Schwellwert für das Verhältnis der Aufgabezeit und letzter Regenerationszeit" VALUE 0xF55A2 Kw_Ws16 799.9878 Prc -400.0000 399.9878 FORMAT "%8.4" /end CHARACTERISTIC
/begin CHARACTERISTIC PFlt_resFlowMax_C "Obere Schwelle SRC Strömungswiderstand" VALUE 0xF5286 Kw_Ws16 25.00000 Res_hPaHrPerCM 0.00 25.00000 FORMAT "%8.5" EXTENDED_LIMITS -32.76800 32.76700 /end CHARACTERISTIC
/begin CHARACTERISTIC PFlt_resFlowMin_C "Untere Schwelle SRC Strömungswiderstand" VALUE 0xF5288 Kw_Ws16 25.00000 Res_hPaHrPerCM 0.00 25.00000 FORMAT "%8.5" EXTENDED_LIMITS -32.76800 32.76700 /end CHARACTERISTIC
/begin CHARACTERISTIC PFlt_resFlowOvldInhRgn_MAP "" MAP 0xF55A4 Kf_Xs16_Ys16_Ws16 25.00000 Res_hPaHrPerCM 0.00 25.00000 FORMAT "%8.5" EXTENDED_LIMITS -32.76800 32.76700
 /begin AXIS_DESCR STD_AXIS Eng_nAvrg EngN 8 40.00000 6000.000 FORMAT "%8.3" EXTENDED_LIMITS -32768.00 32767.00 DEPOSIT ABSOLUTE /end AXIS_DESCR
 /begin AXIS_DESCR STD_AXIS InjCtl_qSetUnBal InjMassCyc 8 0.00 327.6700 FORMAT "%8.4" EXTENDED_LIMITS -327.6800 327.6700 DEPOSIT ABSOLUTE /end AXIS_DESCR
/end CHARACTERISTIC
/begin CHARACTERISTIC PFlt_resFlowOvldInit_C "" VALUE 0xF5648 Kw_Ws16 25.00000 Res_hPaHrPerCM 0.00 25.00000 FORMAT "%8.5" EXTENDED_LIMITS -32.76800 32.76700 /end CHARACTERISTIC
/begin CHARACTERISTIC PFlt_resFlowOvldOfsHeal_C "" VALUE 0xF564A Kw_Ws16 25.00000 Res_hPaHrPerCM 0.00 25.00000 FORMAT "%8.5" EXTENDED_LIMITS -32.76800 32.76700 /end CHARACTERISTIC
/begin CHARACTERISTIC PFlt_resFlowOvldTrqLim_MAP "" MAP 0xF564C Kf_Xs16_Ys16_Ws16 25.00000 Res_hPaHrPerCM 0.00 25.00000 FORMAT "%8.5" EXTENDED_LIMITS -32.76800 32.76700
 /begin AXIS_DESCR STD_AXIS Eng_nAvrg EngN 8 40.00000 6000.000 FORMAT "%8.3" EXTENDED_LIMITS -32768.00 32767.00 DEPOSIT ABSOLUTE /end AXIS_DESCR
 /begin AXIS_DESCR STD_AXIS InjCtl_qSetUnBal InjMassCyc 8 0.00 327.6700 FORMAT "%8.4" EXTENDED_LIMITS -327.6800 327.6700 DEPOSIT ABSOLUTE /end AXIS_DESCR
/end CHARACTERISTIC
/begin CHARACTERISTIC PFlt_resFlowTolcDynPlaus_C "Faktor für Festlegung Toleranzschwelle dynamische Drucküberwachung" VALUE 0xF528A Kw_Ws16 25.00000 Res_hPaHrPerCM 0.00 25.00000 FORMAT "%8.5" EXTENDED_LIMITS -32.76800 32.76700 /end CHARACTERISTIC
/begin CHARACTERISTIC PFlt_rLoIdlTVAMax_C "maximaler Wert des TVACD-Tastverhältnisses, über welchem die Plausibilitätsprüfungen im niedrigen Leerlauf deaktiviert werden" VALUE 0xF56F0 Kw_Ws16 100.0000 DtyCyc 0.00 100.0000 FORMAT "%8.4" EXTENDED_LIMITS -327.6800 327.6700 /end CHARACTERISTIC
/begin CHARACTERISTIC PFlt_stCfgTempSens_C "Bitleiste zur Auswahl der Abgastemperatursensoren" VALUE 0xF528C Kw_Wu8 255.0 OneToOne 0.00 255.0 FORMAT "%5.1" /end CHARACTERISTIC
/begin CHARACTERISTIC PFlt_stLoIdlEGTMsk_C "Abgasnachbehandlungsmaske für Druck-Plausibilitätsprüfungen im niedrigen Leerlaufzustand" VALUE 0xF56F4 Kw_Wu32 2147483647.00 OneToOne 0.00 2147483647.00 FORMAT "%13.2" EXTENDED_LIMITS 0.00 4294967295.00 /end CHARACTERISTIC
/begin CHARACTERISTIC PFlt_stMaxEGTMsk_C "Mask zur Regenerationserkennung" VALUE 0xF56F8 Kw_Wu32 2147483647.00 OneToOne 0.00 2147483647.00 FORMAT "%13.2" EXTENDED_LIMITS 0.00 4294967295.00 /end CHARACTERISTIC
/begin CHARACTERISTIC PFlt_stRgnMsk1_C "Abdecken für EGT_CmpSt Funktion" VALUE 0xF5AD8 Kw_Wu32 2147483647.00 OneToOne 0.00 2147483647.00 FORMAT "%13.2" EXTENDED_LIMITS 0.00 4294967295.00 /end CHARACTERISTIC
/begin CHARACTERISTIC PFlt_stRgnMsk2_C "Abdecken für EGT_CmpSt Funktion" VALUE 0xF5ADC Kw_Wu32 2147483647.00 OneToOne 0.00 2147483647.00 FORMAT "%13.2" EXTENDED_LIMITS 0.00 4294967295.00 /end CHARACTERISTIC
/begin CHARACTERISTIC PFlt_swtDiagRlsmSotCtl_C "Schalter zur Meldung von stDiagRlsmSotCtl an dfp" VALUE 0xF56FC Kw_Wu8 1.000 OneToOne 0.00 1.000 FORMAT "%5.3" EXTENDED_LIMITS 0.00 255.0 /end CHARACTERISTIC
/begin CHARACTERISTIC PFlt_swtEngPrtWrEEPROM_C "Schalter, um Schreiben der regeneration protection counter ins EEPROM freizugeben. (1: freigegeben, 0: gesperrt)" VALUE 0xF56FD Kw_Wu8 1.000 OneToOne 0.00 1.000 FORMAT "%5.3" EXTENDED_LIMITS 0.00 255.0 /end CHARACTERISTIC
/begin CHARACTERISTIC PFlt_swtEnvTempSens_C "Schalter Umgebungstemperatursensorfühler appliziert (1: appliziert, 0: nicht appliziert)" VALUE 0xF528D Kw_Wu8 1.000 OneToOne 0.00 1.000 FORMAT "%5.3" EXTENDED_LIMITS 0.00 255.0 /end CHARACTERISTIC
/begin CHARACTERISTIC PFlt_swtFacDpn_C "Schalter zur überlegeung der Verlustleistung (1: motornaher Kat. - Filter 0: kombinierter Kat. - Filter)" VALUE 0xF5AE0 Kw_Wu8 1.000 OneToOne 0.00 1.000 FORMAT "%5.3" EXTENDED_LIMITS 0.00 255.0 /end CHARACTERISTIC
/begin CHARACTERISTIC PFlt_swtMonCharMin_C "Schalter Auswahl Überwachung Strömungswiderstand (1: Überwachung Filterdurchbruch, 0: Grenzwert für Volumenstrom)" VALUE 0xF528E Kw_Wu8 1.000 OneToOne 0.00 1.000 FORMAT "%5.3" EXTENDED_LIMITS 0.00 255.0 /end CHARACTERISTIC
/begin CHARACTERISTIC PFlt_swtNeutrPDiff_C "Schalter zur Konfiguration der Berechnung der neutralen Message PFlt_pDiff" VALUE 0xF59F8 Kw_Wu8 3.000 OneToOne 0.00 3.000 FORMAT "%5.3" EXTENDED_LIMITS 0.00 255.0 /end CHARACTERISTIC
/begin CHARACTERISTIC PFlt_swtNeutrPPreFlt_C "Schalter zur Konfiguration der Berechnung der neutralen Message PFlt_pPreFlt" VALUE 0xF59F9 Kw_Wu8 3.000 OneToOne 0.00 3.000 FORMAT "%5.3" EXTENDED_LIMITS 0.00 255.0 /end CHARACTERISTIC
/begin CHARACTERISTIC PFlt_swtNeutrPPre_C "Schalter zur Konfiguration der Berechnung der neutralen Message PFlt_pPre" VALUE 0xF59FA Kw_Wu8 3.000 OneToOne 0.00 3.000 FORMAT "%5.3" EXTENDED_LIMITS 0.00 255.0 /end CHARACTERISTIC
/begin CHARACTERISTIC PFlt_swtNeutrTOxiPre_C "Schalter zur Konfiguration der Berechnung der neutralen Message PFlt_tOxiPre" VALUE 0xF59FB Kw_Wu8 3.000 OneToOne 0.00 3.000 FORMAT "%5.3" EXTENDED_LIMITS 0.00 255.0 /end CHARACTERISTIC
/begin CHARACTERISTIC PFlt_swtNeutrTPre_C "Schalter zur Konfiguration der Berechnung der neutralen Message PFlt_tPre" VALUE 0xF59FC Kw_Wu8 3.000 OneToOne 0.00 3.000 FORMAT "%5.3" EXTENDED_LIMITS 0.00 255.0 /end CHARACTERISTIC
/begin CHARACTERISTIC PFlt_swtPDiffOfsOn_C "Schalter zur Berücksichtigung des Differenzdruckoffsets (1: Berücksichtigt, 0: nicht Berücksichtigt)" VALUE 0xF59FD Kw_Wu8 1.000 OneToOne 0.00 1.000 FORMAT "%5.3" EXTENDED_LIMITS 0.00 255.0 /end CHARACTERISTIC
/begin CHARACTERISTIC PFlt_swtPFltOvldInhRgnCor_C "Schalter für schreiben er EEPROM Größen" VALUE 0xF56FE Kw_Wu8 1.000 OneToOne 0.00 1.000 FORMAT "%5.3" EXTENDED_LIMITS 0.00 255.0 /end CHARACTERISTIC
/begin CHARACTERISTIC PFlt_swtPFltOvldTrqLimCor_C "Schalter für schreiben er EEPROM Größen" VALUE 0xF56FF Kw_Wu8 1.000 OneToOne 0.00 1.000 FORMAT "%5.3" EXTENDED_LIMITS 0.00 255.0 /end CHARACTERISTIC
/begin CHARACTERISTIC PFlt_swtPresSensCfg_C "Auswahlwert für Sensorkonfiguration (0...nur Differenzdrucksensor verwendet, 1...nur Absolutdrucksensor verwendet)" VALUE 0xF59FE Kw_Wu8 2.000 OneToOne 0.00 2.000 FORMAT "%5.3" EXTENDED_LIMITS 0.00 255.0 /end CHARACTERISTIC
/begin CHARACTERISTIC PFlt_swtSvcSensChng_C "Schalter für Rücksetzen der EEPROM-Werte bei Differenzdrucksensoraustausch (1: Rücksetzen, 0: kein Rücksetzen)" VALUE 0xF528F Kw_Wu8 255.0 OneToOne 0.00 255.0 FORMAT "%5.1" /end CHARACTERISTIC
/begin CHARACTERISTIC PFlt_swtSvcTmrRst_C "Schalter für Rücksetzen der EEPROM-Timer-Werte bei Steuergerätetausch (1: Rücksetzen, 0: kein Rücksetzen)" VALUE 0xF5290 Kw_Wu8 255.0 OneToOne 0.00 255.0 FORMAT "%5.1" /end CHARACTERISTIC
/begin CHARACTERISTIC PFlt_swtTempModOff_C "Schalter zur Abschaltung des Partikelfiltertemperaturmodells (1: aus, 0: ein)" VALUE 0xF5AE1 Kw_Wu8 1.000 OneToOne 0.00 1.000 FORMAT "%5.3" EXTENDED_LIMITS 0.00 255.0 /end CHARACTERISTIC
/begin CHARACTERISTIC PFlt_swtTempOxiPreCfg_C "Schalter für Temperatursensorkonfiguration vor Oxidationskatalysator" VALUE 0xF59FF Kw_Wu8 1.000 OneToOne 0.00 1.000 FORMAT "%5.3" EXTENDED_LIMITS 0.00 255.0 /end CHARACTERISTIC
/begin CHARACTERISTIC PFlt_swtTempOxiPstCfg_C "Schalter für Temperatursensorkonfiguration nach Oxidationskatalysator" VALUE 0xF5A00 Kw_Wu8 1.000 OneToOne 0.00 1.000 FORMAT "%5.3" EXTENDED_LIMITS 0.00 255.0 /end CHARACTERISTIC
/begin CHARACTERISTIC PFlt_swttPreFltOn_C "Schalter zur Auswahl des PT1-gefilterten PFlt_tOxiPre oder PFltCD_tPre zur Ausgabe als PFlt_tPre (0:PFltCD_tPre)" VALUE 0xF5A01 Kw_Wu8 1.000 OneToOne 0.00 1.000 FORMAT "%5.3" EXTENDED_LIMITS 0.00 255.0 /end CHARACTERISTIC
/begin CHARACTERISTIC PFlt_tCldStrtDfl_C "Obere Temperaturschwelle für Kaltstarterkennung" VALUE 0xF5292 Kw_Ws16 950.0000 Temp_Cels -50.14000 899.8600 FORMAT "%8.4" EXTENDED_LIMITS -3549.940 3003.560 /end CHARACTERISTIC
/begin CHARACTERISTIC PFlt_tClntPFltOvldHeal_C "Schwelle für Fehlerheilung" VALUE 0xF5700 Kw_Ws16 950.0000 Temp_Cels -50.1400 899.8600 FORMAT "%8.4" EXTENDED_LIMITS -3549.940 3003.560 /end CHARACTERISTIC
/begin CHARACTERISTIC PFlt_tDevOxiPreMax_C "Grenzwert für den Schleppzeiger, um Fehlerpfad zu setzen" VALUE 0xF5702 Kw_Ws16 600.0000 TempDiff_Cels -100.0000 500.0000 FORMAT "%8.4" EXTENDED_LIMITS -3276.800 3276.700 /end CHARACTERISTIC
/begin CHARACTERISTIC PFlt_tDevOxiPreRgnMax_C "Grenzwert für den Schleppzeiger um bei Regeneration einen Fehlerpfad zu setzen" VALUE 0xF5704 Kw_Ws16 600.0000 TempDiff_Cels -100.0000 500.0000 FORMAT "%8.4" EXTENDED_LIMITS -3276.800 3276.700 /end CHARACTERISTIC
/begin CHARACTERISTIC PFlt_tDevPreMax_C "Grenzwert für den Schleppzeiger um Fehlerpfad zu setzen" VALUE 0xF5706 Kw_Ws16 600.0000 TempDiff_Cels -100.0000 500.0000 FORMAT "%8.4" EXTENDED_LIMITS -3276.800 3276.700 /end CHARACTERISTIC
/begin CHARACTERISTIC PFlt_tDevPreRgnMax_C "Grenzwert für den Schleppzeiger um im Regenerationsfall einen Fehlerpfad zu setzen" VALUE 0xF5708 Kw_Ws16 600.0000 TempDiff_Cels -100.0000 500.0000 FORMAT "%8.4" EXTENDED_LIMITS -3276.800 3276.700 /end CHARACTERISTIC
/begin CHARACTERISTIC PFlt_tDiffCldMax_C "Maximal erlaubte Abweichung Temperatursensoren bei Kaltstart" VALUE 0xF5294 Kw_Ws16 250.2000 TempDiff_Cels -50.10000 200.1000 FORMAT "%8.4" EXTENDED_LIMITS -3276.800 3276.700 /end CHARACTERISTIC
/begin CHARACTERISTIC PFlt_tDiffTolcMax_C "Maximal erlaubte Toleranzabweichung Temperaturplausibilisierung" VALUE 0xF5296 Kw_Ws16 250.2000 TempDiff_Cels -50.10000 200.1000 FORMAT "%8.4" EXTENDED_LIMITS -3276.800 3276.700 /end CHARACTERISTIC
/begin CHARACTERISTIC PFlt_tDpnAftOxiC_C "Temperaturverlust im Abgasrohr zwischen Oxidations-Katalysator und Partikelfilter" VALUE 0xF5A02 Kw_Ws16 6553.500 TempDiff_Cels -3276.800 3276.700 FORMAT "%8.3" /end CHARACTERISTIC
/begin CHARACTERISTIC PFlt_tDwnStrmTolcMax_C "Maximal zulässige Toleranz bei Plausibilisierung des zweiten Abgastemperatursensors" VALUE 0xF5298 Kw_Ws16 250.2000 TempDiff_Cels -50.10000 200.1000 FORMAT "%8.4" EXTENDED_LIMITS -3276.800 3276.700 /end CHARACTERISTIC
/begin CHARACTERISTIC PFlt_tEGMax_C "Obere Schwelle SRC Temperatursensoren" VALUE 0xF529A Kw_Ws16 950.0000 Temp_Cels -50.14000 899.8600 FORMAT "%8.4" EXTENDED_LIMITS -3549.940 3003.560 /end CHARACTERISTIC
/begin CHARACTERISTIC PFlt_tEGMin_C "Untere Schwelle SRC Temperatursensoren" VALUE 0xF529C Kw_Ws16 950.0000 Temp_Cels -50.14000 899.8600 FORMAT "%8.4" EXTENDED_LIMITS -3549.940 3003.560 /end CHARACTERISTIC
/begin CHARACTERISTIC PFlt_tExhGsStyRgn1_MAP "Temperatur der statischen Rußemission für Regeneration 1" MAP 0xF5AE2 Kf_Xs16_Ys16_Ws16 700.0000 TempDiff_Cels 100.0000 800.0000 FORMAT "%8.4" EXTENDED_LIMITS -3276.800 3276.700
 /begin AXIS_DESCR STD_AXIS Eng_nAvrg EngN 12 40.00000 6000.000 FORMAT "%8.3" EXTENDED_LIMITS -32768.00 32767.00 DEPOSIT ABSOLUTE /end AXIS_DESCR
 /begin AXIS_DESCR STD_AXIS InjCtl_qSetUnBal InjMassCyc 12 0.00 327.6700 FORMAT "%8.4" EXTENDED_LIMITS -327.6800 327.6700 DEPOSIT ABSOLUTE /end AXIS_DESCR
/end CHARACTERISTIC
/begin CHARACTERISTIC PFlt_tExhGsStyRgn2_MAP "static soot emission" MAP 0xF5C36 Kf_Xs16_Ys16_Ws16 700.0000 TempDiff_Cels 100.0000 800.0000 FORMAT "%8.4" EXTENDED_LIMITS -3276.800 3276.700
 /begin AXIS_DESCR STD_AXIS Eng_nAvrg EngN 12 40.00000 6000.000 FORMAT "%8.3" EXTENDED_LIMITS -32768.00 32767.00 DEPOSIT ABSOLUTE /end AXIS_DESCR
 /begin AXIS_DESCR STD_AXIS InjCtl_qSetUnBal InjMassCyc 12 0.00 327.6700 FORMAT "%8.4" EXTENDED_LIMITS -327.6800 327.6700 DEPOSIT ABSOLUTE /end AXIS_DESCR
/end CHARACTERISTIC
/begin CHARACTERISTIC PFlt_tExhGsSty_MAP "Kennfeld für Stationärtemperaturen" MAP 0xF5D8A Kf_Xs16_Ys16_Ws16 950.0000 Temp_Cels -50.1400 899.8600 FORMAT "%8.4" EXTENDED_LIMITS -3549.940 3003.560
 /begin AXIS_DESCR STD_AXIS Eng_nAvrg EngN 12 40.00000 6000.000 FORMAT "%8.3" EXTENDED_LIMITS -32768.00 32767.00 DEPOSIT ABSOLUTE /end AXIS_DESCR
 /begin AXIS_DESCR STD_AXIS InjCtl_qSetUnBal InjMassCyc 12 0.00 327.6700 FORMAT "%8.4" EXTENDED_LIMITS -327.6800 327.6700 DEPOSIT ABSOLUTE /end AXIS_DESCR
/end CHARACTERISTIC
/begin CHARACTERISTIC PFlt_tFrzMin_C "Minimale Temperatur, unter der vor einem Einfrieren des Drucksensors gewarnt wird" VALUE 0xF529E Kw_Ws16 950.0000 Temp_Cels -50.14000 899.8600 FORMAT "%8.4" EXTENDED_LIMITS -3549.940 3003.560 /end CHARACTERISTIC
/begin CHARACTERISTIC PFlt_tiChkTempPlausMax_CUR "Kennlinie zur Bestimmung des maximalen Zeitfensters zur Durchführung der Temp.-Plausibilisierung" CURVE 0xF52A0 Kl_Xs16_Ws16 5.000000 Time_s 0.00 5.000000 FORMAT "%8.6" EXTENDED_LIMITS -327.6800 327.6700
 /begin AXIS_DESCR STD_AXIS BattCD_u Volt_Batt 8 0.00 5004.888 FORMAT "%8.3" EXTENDED_LIMITS -640625.6 640606.1 DEPOSIT ABSOLUTE /end AXIS_DESCR
/end CHARACTERISTIC
/begin CHARACTERISTIC PFlt_tiDebAftRunTst_C "Entprellzeit der Nachlaufbedingung zur Freigabe der Druck-Plausibilitätsprüfungen" VALUE 0xF570A Kw_Wu16 1000.000 Time_ms 0.00 1000.000 FORMAT "%8.3" EXTENDED_LIMITS 0.00 655350.0 /end CHARACTERISTIC
/begin CHARACTERISTIC PFlt_DebCharMaxDef_C "Entprellzeit setzen Strömungswiderstand SRC high" VALUE 0xF52C2 Kw_Wu16 1000.000 Time_ms 0.00 1000.000 FORMAT "%8.3" EXTENDED_LIMITS 0.00 655350.0 /end CHARACTERISTIC
/begin CHARACTERISTIC PFlt_DebCharMaxOk_C "Entprellzeit heilen Strömungswiderstand SRC high" VALUE 0xF52C4 Kw_Wu16 1000.000 Time_ms 0.00 1000.000 FORMAT "%8.3" EXTENDED_LIMITS 0.00 655350.0 /end CHARACTERISTIC
/begin CHARACTERISTIC PFlt_DebCharMinDef_C "Entprellzeit setzen Strömungswiderstand SRC low" VALUE 0xF52C6 Kw_Wu16 1000.000 Time_ms 0.00 1000.000 FORMAT "%8.3" EXTENDED_LIMITS 0.00 655350.0 /end CHARACTERISTIC
/begin CHARACTERISTIC PFlt_DebCharMinOk_C "Entprellzeit heilen Strömungswiderstand SRC low" VALUE 0xF52C8 Kw_Wu16 1000.000 Time_ms 0.00 1000.000 FORMAT "%8.3" EXTENDED_LIMITS 0.00 655350.0 /end CHARACTERISTIC
/begin CHARACTERISTIC PFlt_DebEngPrtMaxDef_C "Entprellzeit setzen Motorschutz-Fehler" VALUE 0xF52CA Kw_Wu16 1000.000 Time_ms 0.00 1000.000 FORMAT "%8.3" EXTENDED_LIMITS 0.00 655350.0 /end CHARACTERISTIC
/begin CHARACTERISTIC PFlt_DebEngPrtMaxOk_C "Entprellzeit heilen Motorschutz-Fehler" VALUE 0xF52CC Kw_Wu16 1000.000 Time_ms 0.00 1000.000 FORMAT "%8.3" EXTENDED_LIMITS 0.00 655350.0 /end CHARACTERISTIC
/begin CHARACTERISTIC PFlt_tiDebLoIdl_C "Entprellzeit der Leerlaufbedingung zur Freigabe der Druck-Plausibilitätsprüfungen" VALUE 0xF570C Kw_Wu16 1000.000 Time_ms 0.00 1000.000 FORMAT "%8.3" EXTENDED_LIMITS 0.00 655350.0 /end CHARACTERISTIC
/begin CHARACTERISTIC PFlt_DebmSotMaxDef_C "Debouncing time for defect recognition of unsuccessful regeneration" VALUE 0xF570E Kw_Wu16 20000.00 Time_ms 0.00 20000.00 FORMAT "%8.2" EXTENDED_LIMITS 0.00 655350.0 /end CHARACTERISTIC
/begin CHARACTERISTIC PFlt_DebmSotMaxOk_C "Debouncing time for error healing of unsuccessful regeneration" VALUE 0xF5710 Kw_Wu16 20000.00 Time_ms 0.00 20000.00 FORMAT "%8.2" EXTENDED_LIMITS 0.00 655350.0 /end CHARACTERISTIC
/begin CHARACTERISTIC PFlt_DebOxiPreMaxDef_C "Defekterkennungszeit für den tOxiPre MAX Fehler" VALUE 0xF5712 Kw_Wu16 20000.00 Time_ms 0.00 20000.00 FORMAT "%8.2" EXTENDED_LIMITS 0.00 655350.0 /end CHARACTERISTIC
/begin CHARACTERISTIC PFlt_DebOxiPreMaxOk_C "Heilungszeit für den tOxiPre MAX Fehler" VALUE 0xF5714 Kw_Wu16 20000.00 Time_ms 0.00 20000.00 FORMAT "%8.2" EXTENDED_LIMITS 0.00 655350.0 /end CHARACTERISTIC
/begin CHARACTERISTIC PFlt_DebOxiPreNplDef_C "Defekterkennungszeit für den tOxiPre NPL Fehler" VALUE 0xF5716 Kw_Wu16 20000.00 Time_ms 0.00 20000.00 FORMAT "%8.2" EXTENDED_LIMITS 0.00 655350.0 /end CHARACTERISTIC
/begin CHARACTERISTIC PFlt_DebOxiPreNplOk_C "Heilungszeit für den tOxiPre NPL Fehler" VALUE 0xF5718 Kw_Wu16 20000.00 Time_ms 0.00 20000.00 FORMAT "%8.2" EXTENDED_LIMITS 0.00 655350.0 /end CHARACTERISTIC
/begin CHARACTERISTIC PFlt_DebOxiPreRgnMaxDef_C "Defekterkennungszeit für den tOxiPre MAX Fehler während der Regeneration" VALUE 0xF571A Kw_Wu16 20000.00 Time_ms 0.00 20000.00 FORMAT "%8.2" EXTENDED_LIMITS 0.00 655350.0 /end CHARACTERISTIC
/begin CHARACTERISTIC PFlt_DebOxiPreRgnMaxOk_C "Heilungszeit für den tOxiPre MAX Fehler während der Regeneration" VALUE 0xF571C Kw_Wu16 20000.00 Time_ms 0.00 20000.00 FORMAT "%8.2" EXTENDED_LIMITS 0.00 655350.0 /end CHARACTERISTIC
/begin CHARACTERISTIC PFlt_DebPreMaxDef_C "Defekterkennungszeit für den tPre MAX Fehler" VALUE 0xF571E Kw_Wu16 20000.00 Time_ms 0.00 20000.00 FORMAT "%8.2" EXTENDED_LIMITS 0.00 655350.0 /end CHARACTERISTIC
/begin CHARACTERISTIC PFlt_DebPreMaxOk_C "Heilungszeit für den tPre MAX Fehler" VALUE 0xF5720 Kw_Wu16 20000.00 Time_ms 0.00 20000.00 FORMAT "%8.2" EXTENDED_LIMITS 0.00 655350.0 /end CHARACTERISTIC
/begin CHARACTERISTIC PFlt_DebPreNplDef_C "Defekterkennungszeit für den tPre NPL Fehler" VALUE 0xF5722 Kw_Wu16 20000.00 Time_ms 0.00 20000.00 FORMAT "%8.2" EXTENDED_LIMITS 0.00 655350.0 /end CHARACTERISTIC
/begin CHARACTERISTIC PFlt_DebPreNplOk_C "Heilungszeit für den tPre NPL Fehler" VALUE 0xF5724 Kw_Wu16 20000.00 Time_ms 0.00 20000.00 FORMAT "%8.2" EXTENDED_LIMITS 0.00 655350.0 /end CHARACTERISTIC
/begin CHARACTERISTIC PFlt_DebPreRgnMaxDef_C "Entprellzeit für die Erkennung einen unvollständigen regeneration" VALUE 0xF5726 Kw_Wu16 20000.00 Time_ms 0.00 20000.00 FORMAT "%8.2" EXTENDED_LIMITS 0.00 655350.0 /end CHARACTERISTIC
/begin CHARACTERISTIC PFlt_DebPreRgnMaxOk_C "Entprellzeit für die Fehlerheilung" VALUE 0xF5728 Kw_Wu16 20000.00 Time_ms 0.00 20000.00 FORMAT "%8.2" EXTENDED_LIMITS 0.00 655350.0 /end CHARACTERISTIC
/begin CHARACTERISTIC PFlt_tiDebPresDblDef_C "Entprellzeit für APS BPS pPre Druck Plausibilitätsdoppeldefekt" VALUE 0xF572A Kw_Wu16 1000.000 Time_ms 0.00 1000.000 FORMAT "%8.3" EXTENDED_LIMITS 0.00 655350.0 /end CHARACTERISTIC
/begin CHARACTERISTIC PFlt_DebPDiffDynPlausDef_C "Entprellzeit setzen dynamischer Fehler Differenzdruck" VALUE 0xF52CE Kw_Wu16 1000.000 Time_ms 0.00 1000.000 FORMAT "%8.3" EXTENDED_LIMITS 0.00 655350.0 /end CHARACTERISTIC
/begin CHARACTERISTIC PFlt_DebPDiffDynPlausOk_C "Entprellzeit heilen dynamischer Fehler Differenzdruck" VALUE 0xF52D0 Kw_Wu16 1000.000 Time_ms 0.00 1000.000 FORMAT "%8.3" EXTENDED_LIMITS 0.00 655350.0 /end CHARACTERISTIC
/begin CHARACTERISTIC PFlt_tiDebPresPlausOk_C "Entprellzeit für APS BPS pPre Druck Plausibilitätsprüfungen" VALUE 0xF572C Kw_Wu16 1000.000 Time_ms 0.00 1000.000 FORMAT "%8.3" EXTENDED_LIMITS 0.00 655350.0 /end CHARACTERISTIC
/begin CHARACTERISTIC PFlt_DebHsLnPlausDef_C "Entprellzeit setzen Plausibilisierungsfehler Schlauchleitung" VALUE 0xF52D2 Kw_Wu16 1000.000 Time_ms 0.00 1000.000 FORMAT "%8.3" EXTENDED_LIMITS 0.00 655350.0 /end CHARACTERISTIC
/begin CHARACTERISTIC PFlt_DebHsLnPlausOk_C "Entprellzeit heilen Plausibilisierungsfehler Schlauchleitung" VALUE 0xF52D4 Kw_Wu16 1000.000 Time_ms 0.00 1000.000 FORMAT "%8.3" EXTENDED_LIMITS 0.00 655350.0 /end CHARACTERISTIC
/begin CHARACTERISTIC PFlt_DebPDiffMaxDef_C "Entprellzeit setzen Drucksensoren SRC high" VALUE 0xF52D6 Kw_Wu16 1000.000 Time_ms 0.00 1000.000 FORMAT "%8.3" EXTENDED_LIMITS 0.00 655350.0 /end CHARACTERISTIC
/begin CHARACTERISTIC PFlt_DebPDiffMaxOk_C "Entprellzeit heilen Drucksensoren SRC high" VALUE 0xF52D8 Kw_Wu16 1000.000 Time_ms 0.00 1000.000 FORMAT "%8.3" EXTENDED_LIMITS 0.00 655350.0 /end CHARACTERISTIC
/begin CHARACTERISTIC PFlt_DebPDiffMinDef_C "Entprellzeit setzen Drucksensoren SRC low" VALUE 0xF52DA Kw_Wu16 1000.000 Time_ms 0.00 1000.000 FORMAT "%8.3" EXTENDED_LIMITS 0.00 655350.0 /end CHARACTERISTIC
/begin CHARACTERISTIC PFlt_DebPDiffMinOk_C "Entprellzeit heilen Drucksensoren SRC low" VALUE 0xF52DC Kw_Wu16 1000.000 Time_ms 0.00 1000.000 FORMAT "%8.3" EXTENDED_LIMITS 0.00 655350.0 /end CHARACTERISTIC
/begin CHARACTERISTIC PFlt_DebSotPlausDef_C "Entprellzeit setzen Plausibilisierungsfehler Versottung" VALUE 0xF52DE Kw_Wu16 1000.000 Time_ms 0.00 1000.000 FORMAT "%8.3" EXTENDED_LIMITS 0.00 655350.0 /end CHARACTERISTIC
/begin CHARACTERISTIC PFlt_DebSotPlausOk_C "Entprellzeit heilen Plausibilisierungsfehler Versottung" VALUE 0xF52E0 Kw_Wu16 1000.000 Time_ms 0.00 1000.000 FORMAT "%8.3" EXTENDED_LIMITS 0.00 655350.0 /end CHARACTERISTIC
/begin CHARACTERISTIC PFlt_DebRgnPermMaxDef_C "Entprellzeit setzen permanente Regeneration" VALUE 0xF52E2 Kw_Wu16 1000.000 Time_ms 0.00 1000.000 FORMAT "%8.3" EXTENDED_LIMITS 0.00 655350.0 /end CHARACTERISTIC
/begin CHARACTERISTIC PFlt_DebRgnPermMaxOk_C "Entprellzeit heilen permanente Regeneration" VALUE 0xF52E4 Kw_Wu16 1000.000 Time_ms 0.00 1000.000 FORMAT "%8.3" EXTENDED_LIMITS 0.00 655350.0 /end CHARACTERISTIC
/begin CHARACTERISTIC PFlt_tiDebT15On_C "Entprellzeit der T15 EIN Bedingung zur Freigabe der Plausibilitätsprüfungen" VALUE 0xF572E Kw_Wu16 1000.000 Time_ms 0.00 1000.000 FORMAT "%8.3" EXTENDED_LIMITS 0.00 655350.0 /end CHARACTERISTIC
/begin CHARACTERISTIC PFlt_DebTEGMaxDef_C "Entprellzeit setzen Temperatursensoren SRC high" VALUE 0xF52E6 Kw_Wu16 1000.000 Time_ms 0.00 1000.000 FORMAT "%8.3" EXTENDED_LIMITS 0.00 655350.0 /end CHARACTERISTIC
/begin CHARACTERISTIC PFlt_DebTEGMaxOk_C "Entprellzeit heilen Temperatursensoren SRC high" VALUE 0xF52E8 Kw_Wu16 1000.000 Time_ms 0.00 1000.000 FORMAT "%8.3" EXTENDED_LIMITS 0.00 655350.0 /end CHARACTERISTIC
/begin CHARACTERISTIC PFlt_DebTEGMinDef_C "Entprellzeit setzen Temperatursensoren SRC low" VALUE 0xF52EA Kw_Wu16 1000.000 Time_ms 0.00 1000.000 FORMAT "%8.3" EXTENDED_LIMITS 0.00 655350.0 /end CHARACTERISTIC
/begin CHARACTERISTIC PFlt_DebTEGMinOk_C "Entprellzeit heilen Temperatursensoren SRC low" VALUE 0xF52EC Kw_Wu16 1000.000 Time_ms 0.00 1000.000 FORMAT "%8.3" EXTENDED_LIMITS 0.00 655350.0 /end CHARACTERISTIC
/begin CHARACTERISTIC PFlt_tiDelOfsCalc_C "Verzögerungszeit zur Berechnung des Differenzdrucksensoroffsets im Motornachlauf" VALUE 0xF52EE Kw_Wu16 99.30000 Time_s 0.7000000 100.0000 FORMAT "%8.4" EXTENDED_LIMITS 0.00 655.3500 /end CHARACTERISTIC
/begin CHARACTERISTIC PFlt_tiExhGsDel_CUR "Abgasstromverzögerung" CURVE 0xF5EDE Kl_Xs16_Ws16 10.01007 TimeDelay_s_Lin_16_2 0.00 10.01007 FORMAT "%8.5" EXTENDED_LIMITS -2000.061 2000.000
 /begin AXIS_DESCR STD_AXIS PFlt_dmEG_mp AirMassPerTime 8 -1000.000 1000.000 FORMAT "%8.3" EXTENDED_LIMITS -3276.800 3276.700 DEPOSIT ABSOLUTE /end AXIS_DESCR
/end CHARACTERISTIC
/begin CHARACTERISTIC PFlt_tiFstEngPrtRgnMax_C "Schwelle zum Zurücksetzen des Zählers für Regeneration wegen Motorschutz" VALUE 0xF5730 Kw_Wu32 4294967295.00 TimeEngOn 0.00 4294967295.00 FORMAT "%13.2" /end CHARACTERISTIC
/begin CHARACTERISTIC PFlt_tiHtTransDT1_CUR "Wärmeübertragungszeit" CURVE 0xF5F00 Kl_Xs16_Ws16 2000.000 TimeDelay_s_Lin_16_2 0.00 2000.000 FORMAT "%8.3" EXTENDED_LIMITS -2000.061 2000.000
 /begin AXIS_DESCR STD_AXIS PFlt_dmEG_mp AirMassPerTime 8 -1000.000 1000.000 FORMAT "%8.3" EXTENDED_LIMITS -3276.800 3276.700 DEPOSIT ABSOLUTE /end AXIS_DESCR
/end CHARACTERISTIC
/begin CHARACTERISTIC PFlt_tiLckChkTempPlaus_C "Verriegelungszeit Temperatursensorplausibilisierung nach kurzem Motorlauf" VALUE 0xF52F0 Kw_Wu16 50.00000 Time_s 50.00000 100.0000 FORMAT "%8.4" EXTENDED_LIMITS 0.00 655.3500 /end CHARACTERISTIC
/begin CHARACTERISTIC PFlt_tiLoIdlSnceRgnMax_C "Zeit seit letzter erfolgreicher Regeneration, nach der Plausibilitätsprüfungen freigegeben werden" VALUE 0xF5734 Kw_Wu32 4294967295.00 TimeEngOn 0.00 4294967295.00 FORMAT "%13.2" /end CHARACTERISTIC
/begin CHARACTERISTIC PFlt_tIncrDwnStrm_C "Korrekturwert Erwärmung zweite Abgastemperatur zur Überwachung" VALUE 0xF52F2 Kw_Ws16 300.0000 TempDiff_Cels 0.00 300.0000 FORMAT "%8.4" EXTENDED_LIMITS -3276.800 3276.700 /end CHARACTERISTIC
/begin CHARACTERISTIC PFlt_tIncrUpStrm_C "Korrekturwert Erwärmung erste Abgastemperatur zur Überwachung" VALUE 0xF52F4 Kw_Ws16 300.0000 TempDiff_Cels 0.00 300.0000 FORMAT "%8.4" EXTENDED_LIMITS -3276.800 3276.700 /end CHARACTERISTIC
/begin CHARACTERISTIC PFlt_tiPFltOvld1PT1_C "Zeitkonstante für Überladungserkennung" VALUE 0xF5738 Kw_Wu32 4294.9673 TimeDelay_s 0.0000010000000 4294.9673 FORMAT "%9.4" /end CHARACTERISTIC
/begin CHARACTERISTIC PFlt_tiPFltOvld2PT1_C "time constant for overloaddet." VALUE 0xF573C Kw_Wu32 4294.9673 TimeDelay_s 0.0000010000000 4294.9673 FORMAT "%9.4" /end CHARACTERISTIC
/begin CHARACTERISTIC PFlt_tiPPrePT1_C "Filterzeitkonstante für gefilterten Absolutdruck vor Partikelfilter" VALUE 0xF5A04 Kw_Wu32 99.582970 TimeDelay_s 0.29999073 99.882960 FORMAT "%9.5" EXTENDED_LIMITS 0.0000010000000 4294.9673 /end CHARACTERISTIC
/begin CHARACTERISTIC PFlt_tiFltHsLnPT1_C "Filterzeitkonstante Signalfilterung für Schlauchleitungsüberwachung" VALUE 0xF52F8 Kw_Wu32 4294.9673 TimeDelay_s 0.0000010000000 4294.9673 FORMAT "%9.4" /end CHARACTERISTIC
/begin CHARACTERISTIC PFlt_titPrePhysPT1_C "Zeitkonstante des PT1-Filters zur Filterung von PFlt_tOxiPre." VALUE 0xF5A08 Kw_Wu32 330.28210 TimeDelay_s 0.099999239 330.38210 FORMAT "%9.5" EXTENDED_LIMITS 0.0000010000000 4294.9673 /end CHARACTERISTIC
/begin CHARACTERISTIC PFlt_tOxiPreDiffMax_MAP "Schwelle für Maximale Differenztemperatur  den tOxiPre" MAP 0xF5740 Kf_Xs16_Ys16_Ws16 950.0000 Temp_Cels -50.1400 899.8600 FORMAT "%8.4" EXTENDED_LIMITS -3549.940 3003.560
 /begin AXIS_DESCR STD_AXIS Eng_nAvrg EngN 12 40.00000 6000.000 FORMAT "%8.3" EXTENDED_LIMITS -32768.00 32767.00 DEPOSIT ABSOLUTE /end AXIS_DESCR
 /begin AXIS_DESCR STD_AXIS InjCtl_qSetUnBal InjMassCyc 12 0.00 327.6700 FORMAT "%8.4" EXTENDED_LIMITS -327.6800 327.6700 DEPOSIT ABSOLUTE /end AXIS_DESCR
/end CHARACTERISTIC
/begin CHARACTERISTIC PFlt_tiOxiPreStyPT1_C " Zeitkonstant des PT1-Gliedes für stationäre Abgastemperatur vor dem Oxi-Kat" VALUE 0xF5F24 Kw_Wu32 4294.9673 TimeDelay_s 0.0000010000000 4294.9673 FORMAT "%9.4" /end CHARACTERISTIC
/begin CHARACTERISTIC PFlt_tPreDfl_C "Ersatzwert bei Temperatur vor Partikelfilter unplausibel" VALUE 0xF5A0C Kw_Ws16 950.000 Temp_Cels -50.140 899.860 FORMAT "%8.3" EXTENDED_LIMITS -3549.940 3003.560 /end CHARACTERISTIC
/begin CHARACTERISTIC PFlt_tPreDiffMax_MAP "Schwelle für Maximale Differenztemperatur" MAP 0xF5894 Kf_Xs16_Ys16_Ws16 950.0000 Temp_Cels -50.1400 899.8600 FORMAT "%8.4" EXTENDED_LIMITS -3549.940 3003.560
 /begin AXIS_DESCR STD_AXIS Eng_nAvrg EngN 12 40.00000 6000.000 FORMAT "%8.3" EXTENDED_LIMITS -32768.00 32767.00 DEPOSIT ABSOLUTE /end AXIS_DESCR
 /begin AXIS_DESCR STD_AXIS InjCtl_qSetUnBal InjMassCyc 12 0.00 327.6700 FORMAT "%8.4" EXTENDED_LIMITS -327.6800 327.6700 DEPOSIT ABSOLUTE /end AXIS_DESCR
/end CHARACTERISTIC
/begin CHARACTERISTIC PFlt_tiFltTempPT1_C "Filterzeitkonstante für Oberflächentemperatursimulation" VALUE 0xF5F28 Kw_Wu32 4294.9673 TimeDelay_s 0.0000010000000 4294.9673 FORMAT "%9.4" /end CHARACTERISTIC
/begin CHARACTERISTIC PFlt_tiPreStyPT1_C "Zeitkonstant des PT1-Gliedes für stationäre Abgastemperatur vor dem Partikelfilter" VALUE 0xF5F2C Kw_Wu32 4294.9673 TimeDelay_s 0.0000010000000 4294.9673 FORMAT "%9.4" /end CHARACTERISTIC
/begin CHARACTERISTIC PFlt_tRefSty_C "Referenztemperatur für das Festlegen des Abgastemperaturenkennfeldes" VALUE 0xF5F30 Kw_Ws16 250.0000 Temp_Cels -50.1400 199.8600 FORMAT "%8.4" EXTENDED_LIMITS -3549.940 3003.560 /end CHARACTERISTIC
/begin CHARACTERISTIC PFlt_tThresOxiPreMax_C "Grenzwert für die Fehlerpfadaktivierung" VALUE 0xF59E8 Kw_Ws16 950.0000 Temp_Cels -50.1400 899.8600 FORMAT "%8.4" EXTENDED_LIMITS -3549.940 3003.560 /end CHARACTERISTIC
/begin CHARACTERISTIC PFlt_tThresOxiPreRgnMax_C "Grenzwert zum Setzen eines Fehlerpfades im regenerationsfall" VALUE 0xF59EA Kw_Ws16 950.0000 Temp_Cels -50.1400 899.8600 FORMAT "%8.4" EXTENDED_LIMITS -3549.940 3003.560 /end CHARACTERISTIC
/begin CHARACTERISTIC PFlt_tThresPreMax_C "Grenzwert von PFlt_tPre zum setzen eines Fehlerpfades" VALUE 0xF59EC Kw_Ws16 950.0000 Temp_Cels -50.1400 899.8600 FORMAT "%8.4" EXTENDED_LIMITS -3549.940 3003.560 /end CHARACTERISTIC
/begin CHARACTERISTIC PFlt_tThresPreRgnMax_C "Grenzwert von PFlt_tPre zum Setzen eines Fehlerpfades im Regenerationsfall" VALUE 0xF59EE Kw_Ws16 950.0000 Temp_Cels -50.1400 899.8600 FORMAT "%8.4" EXTENDED_LIMITS -3549.940 3003.560 /end CHARACTERISTIC
/begin CHARACTERISTIC PFlt_tUpStrmTolcMax_C "Maximal zulässige Toleranz bei Plausibilisierung des ersten Abgastemperatursensors" VALUE 0xF52FC Kw_Ws16 250.2000 TempDiff_Cels -50.10000 200.1000 FORMAT "%8.4" EXTENDED_LIMITS -3276.800 3276.700 /end CHARACTERISTIC
/begin CHARACTERISTIC PFlt_vLoIdlSpeedMax_C "VSSCD_v Grenze für Plausibilitätstests im Leerlaufzustand" VALUE 0xF59F0 Kw_Ws16 655.3500 Vel -327.6800 327.6700 FORMAT "%8.4" /end CHARACTERISTIC
/begin CHARACTERISTIC PFlt_vPFltOvldHeal_C "VSSCD_v Schwelle für Fehlerheilung" VALUE 0xF59F2 Kw_Ws16 655.3500 Vel -327.6800 327.6700 FORMAT "%8.4" /end CHARACTERISTIC
/begin CHARACTERISTIC PrpCtl_facSpdCorr_C "Faktor zur Fahrzeuggeschwindigkeitskorrektur" VALUE 0xF638C Kw_Ws16 1.000000 FactLow 0.5000000 1.500000 FORMAT "%8.6" EXTENDED_LIMITS -32.00000 31.99902 /end CHARACTERISTIC
/begin CHARACTERISTIC PrpCtl_SpdLim4IKi_C "Regler I-Anteil 4. Gang" VALUE 0xF6390 Kw_Wu32 19999999.9953 Ki_Vel2TrqPrp 0.00 19999999.9953 FORMAT "%13.4" /end CHARACTERISTIC
/begin CHARACTERISTIC PrpCtl_SpdLim4IKiPos_C "Regler I-Anteil für positive Großsignale 4. Gang" VALUE 0xF6394 Kw_Wu32 19999999.9953 Ki_Vel2TrqPrp 0.00 19999999.9953 FORMAT "%13.4" /end CHARACTERISTIC
/begin CHARACTERISTIC PrpCtl_SpdLim4IKiNeg_C "Regler I-Anteil für negative Großsignale 4. Gang" VALUE 0xF6398 Kw_Wu32 19999999.9953 Ki_Vel2TrqPrp 0.00 19999999.9953 FORMAT "%13.4" /end CHARACTERISTIC
/begin CHARACTERISTIC PrpCtl_vSpdLim4IWinPos_C "obere Fenstergrenze für I-Anteil Kleinsignale 4.Gang" VALUE 0xF639C Kw_Ws16 300.0000 Vel 0.00 300.0000 FORMAT "%8.4" EXTENDED_LIMITS -327.6800 327.6700 /end CHARACTERISTIC
/begin CHARACTERISTIC PrpCtl_vSpdLim4IWinNeg_C "untere Fenstergrenze für I-Anteil Kleinsignale 4.Gang" VALUE 0xF639E Kw_Ws16 300.0000 Vel -300.0000 0.00 FORMAT "%8.4" EXTENDED_LIMITS -327.6800 327.6700 /end CHARACTERISTIC
/begin CHARACTERISTIC PrpCtl_SpdLim4PKp_C "Regler P-Anteil 4. Gang" VALUE 0xF63A0 Kw_Wu32 1310719.99969 Kp_Vel2TrqPrp 0.00 1310719.99969 FORMAT "%13.5" /end CHARACTERISTIC
/begin CHARACTERISTIC PrpCtl_SpdLim4PKpPos_C "Regler P-Anteil für positive Großsignale 4. Gang" VALUE 0xF63A4 Kw_Wu32 1310719.99969 Kp_Vel2TrqPrp 0.00 1310719.99969 FORMAT "%13.5" /end CHARACTERISTIC
/begin CHARACTERISTIC PrpCtl_SpdLim4PKpNeg_C "Regler P-Anteil für negative Großsignale 4. Gang" VALUE 0xF63A8 Kw_Wu32 1310719.99969 Kp_Vel2TrqPrp 0.00 1310719.99969 FORMAT "%13.5" /end CHARACTERISTIC
/begin CHARACTERISTIC PrpCtl_vSpdLim4PWinPos_C "obere Fenstergrenze für P-Anteil Kleinsignale 4.Gang" VALUE 0xF63AC Kw_Ws16 300.0000 Vel 0.00 300.0000 FORMAT "%8.4" EXTENDED_LIMITS -327.6800 327.6700 /end CHARACTERISTIC
/begin CHARACTERISTIC PrpCtl_vSpdLim4PWinNeg_C "untere Fenstergrenze für P-Anteil Kleinsignale 4.Gang" VALUE 0xF63AE Kw_Ws16 300.0000 Vel -300.0000 0.00 FORMAT "%8.4" EXTENDED_LIMITS -327.6800 327.6700 /end CHARACTERISTIC
/begin CHARACTERISTIC PrpCtl_SpdLim5IKi_C "Regler I-Anteil 5. Gang" VALUE 0xF63B0 Kw_Wu32 19999999.9953 Ki_Vel2TrqPrp 0.00 19999999.9953 FORMAT "%13.4" /end CHARACTERISTIC
/begin CHARACTERISTIC PrpCtl_SpdLim5IKiPos_C "Regler I-Anteil für positive Großsignale 5. Gang" VALUE 0xF63B4 Kw_Wu32 19999999.9953 Ki_Vel2TrqPrp 0.00 19999999.9953 FORMAT "%13.4" /end CHARACTERISTIC
/begin CHARACTERISTIC PrpCtl_SpdLim5IKiNeg_C "Regler I-Anteil für negative Großsignale 5. Gang" VALUE 0xF63B8 Kw_Wu32 19999999.9953 Ki_Vel2TrqPrp 0.00 19999999.9953 FORMAT "%13.4" /end CHARACTERISTIC
/begin CHARACTERISTIC PrpCtl_vSpdLim5IWinPos_C "obere Fenstergrenze für I-Anteil Kleinsignale 5.Gang" VALUE 0xF63BC Kw_Ws16 300.0000 Vel 0.00 300.0000 FORMAT "%8.4" EXTENDED_LIMITS -327.6800 327.6700 /end CHARACTERISTIC
/begin CHARACTERISTIC PrpCtl_vSpdLim5IWinNeg_C "untere Fenstergrenze für I-Anteil Kleinsignale 5.Gang" VALUE 0xF63BE Kw_Ws16 300.0000 Vel -300.0000 0.00 FORMAT "%8.4" EXTENDED_LIMITS -327.6800 327.6700 /end CHARACTERISTIC
/begin CHARACTERISTIC PrpCtl_SpdLim5PKp_C "Regler P-Anteil 5. Gang" VALUE 0xF63C0 Kw_Wu32 1310719.99969 Kp_Vel2TrqPrp 0.00 1310719.99969 FORMAT "%13.5" /end CHARACTERISTIC
/begin CHARACTERISTIC PrpCtl_SpdLim5PKpPos_C "Regler P-Anteil für positive Großsignale 5. Gang" VALUE 0xF63C4 Kw_Wu32 1310719.99969 Kp_Vel2TrqPrp 0.00 1310719.99969 FORMAT "%13.5" /end CHARACTERISTIC
/begin CHARACTERISTIC PrpCtl_SpdLim5PKpNeg_C "Regler P-Anteil für negative Großsignale 5. Gang" VALUE 0xF63C8 Kw_Wu32 1310719.99969 Kp_Vel2TrqPrp 0.00 1310719.99969 FORMAT "%13.5" /end CHARACTERISTIC
/begin CHARACTERISTIC PrpCtl_vSpdLim5PWinPos_C "obere Fenstergrenze für P-Anteil Kleinsignale 5.Gang" VALUE 0xF63CC Kw_Ws16 300.0000 Vel 0.00 300.0000 FORMAT "%8.4" EXTENDED_LIMITS -327.6800 327.6700 /end CHARACTERISTIC
/begin CHARACTERISTIC PrpCtl_vSpdLim5PWinNeg_C "untere Fenstergrenze für P-Anteil Kleinsignale 5.Gang" VALUE 0xF63CE Kw_Ws16 300.0000 Vel -300.0000 0.00 FORMAT "%8.4" EXTENDED_LIMITS -327.6800 327.6700 /end CHARACTERISTIC
/begin CHARACTERISTIC PrpCtl_tiSpdLimPT1_C "Zeitkonstante PT1-Glied" VALUE 0xF63D0 Kw_Wu32 4294.9673 TimeDelay_s 0.0000010000000 4294.9673 FORMAT "%9.4" /end CHARACTERISTIC
/begin CHARACTERISTIC PrpCtl_swtSpdLimVal_C "Datensatzwert für PrpCtl_swtSpdLim für Activierung (1) oder Deaktivierung (0) der Geschwindigkeitsbegrenzung" VALUE 0xF63D4 Kw_Wu8 1.000 OneToOne 0.00 1.000 FORMAT "%5.3" EXTENDED_LIMITS 0.00 255.0 /end CHARACTERISTIC
/begin CHARACTERISTIC PrpCtl_swtSpdLimType_C "Auswahlschalter für PrpCtl_swtSpdLim bei Ini: E2PROM(1) oder PrpCtl_swtSpdLimVal_C(2)" VALUE 0xF63D5 Kw_Wu8 1.000 OneToOne 1.000 2.000 FORMAT "%5.3" EXTENDED_LIMITS 0.00 255.0 /end CHARACTERISTIC
/begin CHARACTERISTIC PrpCtl_vSpdLimMax_C "Fahrzeughöchstgeschwindigkeit" VALUE 0xF63D6 Kw_Ws16 300.0000 Vel 0.00 300.0000 FORMAT "%8.4" EXTENDED_LIMITS -327.6800 327.6700 /end CHARACTERISTIC
/begin CHARACTERISTIC PrpCtl_vSpdLimThreshFree_C "Schwellwert Sollwertnachführung frei laufend" VALUE 0xF63D8 Kw_Ws16 300.0000 Vel 0.00 300.0000 FORMAT "%8.4" EXTENDED_LIMITS -327.6800 327.6700 /end CHARACTERISTIC
/begin CHARACTERISTIC PrpCtl_vSpdLimThreshOff_C "Schwellwert Sollwertnachführung ausgeschalten" VALUE 0xF63DA Kw_Ws16 300.0000 Vel 0.00 300.0000 FORMAT "%8.4" EXTENDED_LIMITS -327.6800 327.6700 /end CHARACTERISTIC
/begin CHARACTERISTIC PrpCtl_vSpdLimThreshOn_C "Schwellwert Sollwertnachführung eingeschalten" VALUE 0xF63DC Kw_Ws16 300.0000 Vel 0.00 300.0000 FORMAT "%8.4" EXTENDED_LIMITS -327.6800 327.6700 /end CHARACTERISTIC
/begin CHARACTERISTIC Prp_rEng_MAP "inverses Fahrverhaltenkennfeld für konventionelle Triebstrangsteuerung" MAP 0xF60D0 Kf_Xs16_Ys16_Ws16 799.9878 Prc -400.0000 399.9878 FORMAT "%8.4"
 /begin AXIS_DESCR STD_AXIS Eng_nAvrg EngN 16 -32768.00 32767.00 FORMAT "%8.2" DEPOSIT ABSOLUTE /end AXIS_DESCR
 /begin AXIS_DESCR STD_AXIS Prp_trqEng Trq 16 -3276.800 3276.700 FORMAT "%8.3" DEPOSIT ABSOLUTE /end AXIS_DESCR
/end CHARACTERISTIC
/begin CHARACTERISTIC Prp_rPrp_MAP "inverses Fahrverhaltenkennfeld für Mastershift" MAP 0xF6314 Kf_Xs16_Ys16_Ws16 799.9878 Prc -400.0000 399.9878 FORMAT "%8.4"
 /begin AXIS_DESCR STD_AXIS VSSCD_v Vel 1 -327.6800 327.6700 FORMAT "%8.4" DEPOSIT ABSOLUTE /end AXIS_DESCR
 /begin AXIS_DESCR STD_AXIS Prp_trqPrp TrqPrp 1 -6553.600 6553.400 FORMAT "%8.3" DEPOSIT ABSOLUTE /end AXIS_DESCR
/end CHARACTERISTIC
/begin CHARACTERISTIC Prp_swtVirtAPPSel_C "Schalter zur Auswahl der Logik zur Bestimmung des virtuellen AccPed-Wertes" VALUE 0xF631E Kw_Ws8 1.000 OneToOne 0.00 1.000 FORMAT "%5.3" EXTENDED_LIMITS -128.0 127.0 /end CHARACTERISTIC
/begin CHARACTERISTIC Prp_trqThresEng_CUR "Schwellwert-Kennlinie zur Unterscheidung zwischen Zug- und Schubbetrieb" CURVE 0xF6320 Kl_Xs16_Ws16 300.0000 TrqPrp 0.00 300.0000 FORMAT "%8.4" EXTENDED_LIMITS -6553.600 6553.400
 /begin AXIS_DESCR STD_AXIS Eng_nAvrg EngN 25 0.00 6000.000 FORMAT "%8.3" EXTENDED_LIMITS -32768.00 32767.00 DEPOSIT ABSOLUTE /end AXIS_DESCR
/end CHARACTERISTIC
/begin CHARACTERISTIC Prp_trqThresPrp_CUR "Schwellwert-Kennlinie zur Unterscheidung zwischen Zug- und Schubbetrieb" CURVE 0xF6386 Kl_Xs16_Ws16 300.0000 TrqPrp 0.00 300.0000 FORMAT "%8.4" EXTENDED_LIMITS -6553.600 6553.400
 /begin AXIS_DESCR STD_AXIS VSSCD_v Vel 1 0.00 300.0000 FORMAT "%8.4" EXTENDED_LIMITS -327.6800 327.6700 DEPOSIT ABSOLUTE /end AXIS_DESCR
/end CHARACTERISTIC
/begin CHARACTERISTIC PSPCD_dvolBase_CUR "Curve to calculate the fuel quantity consumption based on the Engine Speed" CURVE 0xF63E0 Kl_Xs16_Ws16 100.0000 FlConsum_l_h 0.00 100.0000 FORMAT "%8.4" EXTENDED_LIMITS -327.6800 327.6700
 /begin AXIS_DESCR STD_AXIS Eng_nAvrg EngN 16 0.00 6000.000 FORMAT "%8.3" EXTENDED_LIMITS -32768.00 32767.00 DEPOSIT ABSOLUTE /end AXIS_DESCR
/end CHARACTERISTIC
/begin CHARACTERISTIC PSPCD_dvolMax_C "Maximum limit of fuel consumption quantity" VALUE 0xF6422 Kw_Ws16 100.0000 FlConsum_l_h 0.00 100.0000 FORMAT "%8.4" EXTENDED_LIMITS -327.6800 327.6700 /end CHARACTERISTIC
/begin CHARACTERISTIC PSPCD_dvolMin_C "Minimum limit of the  fuel consumption quantity" VALUE 0xF6424 Kw_Ws16 100.0000 FlConsum_l_h 0.00 100.0000 FORMAT "%8.4" EXTENDED_LIMITS -327.6800 327.6700 /end CHARACTERISTIC
/begin CHARACTERISTIC PSPCD_dvolOut1_C "output fuel quantity incase of T15 changes from FALSE to TRUE" VALUE 0xF6426 Kw_Ws16 100.0000 FlConsum_l_h 0.00 100.0000 FORMAT "%8.4" EXTENDED_LIMITS -327.6800 327.6700 /end CHARACTERISTIC
/begin CHARACTERISTIC PSPCD_dvolTempLim_MAP "Map for limiting value of fuel depending on engine speed and fuel temperature" MAP 0xF6428 Kf_Xs16_Ys16_Ws16 100.0000 FlConsum_l_h 0.00 100.0000 FORMAT "%8.4" EXTENDED_LIMITS -327.6800 327.6700
 /begin AXIS_DESCR STD_AXIS Eng_nAvrg EngN 6 40.00000 6000.000 FORMAT "%8.3" EXTENDED_LIMITS -32768.00 32767.00 DEPOSIT ABSOLUTE /end AXIS_DESCR
 /begin AXIS_DESCR STD_AXIS FTSCD_tFuel Temp_Cels 6 -50.14000 199.8600 FORMAT "%8.4" EXTENDED_LIMITS -3549.940 3003.560 DEPOSIT ABSOLUTE /end AXIS_DESCR
/end CHARACTERISTIC
/begin CHARACTERISTIC PSPCD_facFTSCor_CUR "Curve to calculate the factor based on the Fuel temperature" CURVE 0xF648C Kl_Xs16_Ws16 50.00000 Fact1 0.00 50.00000 FORMAT "%8.5" EXTENDED_LIMITS -256.0000 255.9922
 /begin AXIS_DESCR STD_AXIS FTSCD_tFuel Temp_Cels 16 -50.14000 199.8600 FORMAT "%8.4" EXTENDED_LIMITS -3549.940 3003.560 DEPOSIT ABSOLUTE /end AXIS_DESCR
/end CHARACTERISTIC
/begin CHARACTERISTIC PSPCD_nLim_C "Threshold value for engine speed" VALUE 0xF64CE Kw_Ws16 5960.000 EngN 40.00000 6000.000 FORMAT "%8.3" EXTENDED_LIMITS -32768.00 32767.00 /end CHARACTERISTIC
/begin CHARACTERISTIC PSPCD_tiT15Delay_CUR "curve for calculation of time till which timer should run from the coolant temperature" CURVE 0xF64D0 Kl_Xs16_Ws16 10000.00 Time_ms 0.00 10000.00 FORMAT "%8.2" EXTENDED_LIMITS -327680.0 327670.0
 /begin AXIS_DESCR STD_AXIS CTSCD_tClnt Temp_Cels 16 -50.14000 199.8600 FORMAT "%8.4" EXTENDED_LIMITS -3549.940 3003.560 DEPOSIT ABSOLUTE /end AXIS_DESCR
/end CHARACTERISTIC
/begin CHARACTERISTIC QLTCD_cntComOk_C "Anzahl der positiven Prüfungen zur QLT-Erkennung" VALUE 0xF6512 Kw_Wu8 255.0 OneToOne 0.00 255.0 FORMAT "%5.1" /end CHARACTERISTIC
/begin CHARACTERISTIC QLTCD_tiDebDefect_C "Defektentprellzeit für BSD-Kommunikationsfehler" VALUE 0xF6514 Kw_Wu16 655350.0 Time_ms 0.00 655350.0 FORMAT "%8.1" /end CHARACTERISTIC
/begin CHARACTERISTIC QLTCD_tiDebOk_C "Heilungsentprellzeit für BSD-Kommunikationsfehler" VALUE 0xF6516 Kw_Wu16 655350.0 Time_ms 0.00 655350.0 FORMAT "%8.1" /end CHARACTERISTIC
/begin CHARACTERISTIC QLTCD_tiOutput_C "Botschaftsausgabe-Intervallzeit [ms" VALUE 0xF6518 Kw_Wu16 1980.000 Time_ms 20.00000 2000.000 FORMAT "%8.3" EXTENDED_LIMITS 0.00 655350.0 /end CHARACTERISTIC
/begin CHARACTERISTIC QLTCD_tiReset_C "Regenerationszeit nach Schnittstellenreset [ms" VALUE 0xF651A Kw_Wu16 1980.000 Time_ms 20.00000 2000.000 FORMAT "%8.3" EXTENDED_LIMITS 0.00 655350.0 /end CHARACTERISTIC
/begin CHARACTERISTIC QLTCD_tiTryDetection_C "Zeit für Erkennung selbst" VALUE 0xF651C Kw_Wu16 655350.0 Time_ms 0.00 655350.0 FORMAT "%8.1" /end CHARACTERISTIC
/begin CHARACTERISTIC QLTCD_tiWaitDetection_C "Zeit bis zum Start der Erkennung" VALUE 0xF651E Kw_Wu16 655350.0 Time_ms 0.00 655350.0 FORMAT "%8.1" /end CHARACTERISTIC
/begin CHARACTERISTIC RailCD_uSRCMin_C "SRC-Minimum Vorgabewert" VALUE 0xF86A4 Kw_Ws16 5200.391 Volt 0.00 5200.391 FORMAT "%8.3" EXTENDED_LIMITS -160156.4 160151.5 /end CHARACTERISTIC
/begin CHARACTERISTIC RailCD_uSRCMax_C "SRC-Maximum Vorgabewert" VALUE 0xF86A6 Kw_Ws16 5200.391 Volt 0.00 5200.391 FORMAT "%8.3" EXTENDED_LIMITS -160156.4 160151.5 /end CHARACTERISTIC
/begin CHARACTERISTIC RailCD_pLin_CUR "Linearisierungskennlinie für Kraftstoffdrucksensor" CURVE 0xF86A8 Kl_Xs16_Ws16 2000.000 Pres_Rail 0.00 2000.000 FORMAT "%5.3" EXTENDED_LIMITS -3276.800 3276.700
 /begin AXIS_DESCR STD_AXIS RailCD_uPeakRaw Volt 4 0.00 5200.391 FORMAT "%8.3" EXTENDED_LIMITS -160156.4 160151.5 DEPOSIT ABSOLUTE /end AXIS_DESCR
/end CHARACTERISTIC
/begin CHARACTERISTIC RailCD_DebSRCHighDef_C "Kraftstoffdruck Fehlerentprellzeit SRC-High" VALUE 0xF86BA Kw_Wu16 655350.0 Time_ms 0.00 655350.0 FORMAT "%8.1" /end CHARACTERISTIC
/begin CHARACTERISTIC RailCD_DebSRCHighOk_C "Kraftstoffdruck Heilungsentprellzeit SRC-High" VALUE 0xF86BC Kw_Wu16 655350.0 Time_ms 0.00 655350.0 FORMAT "%8.1" /end CHARACTERISTIC
/begin CHARACTERISTIC RailCD_DebSRCLowDef_C "Kraftstoffdruck Fehlerentprellzeit SRC-Low" VALUE 0xF86BE Kw_Wu16 655350.0 Time_ms 0.00 655350.0 FORMAT "%8.1" /end CHARACTERISTIC
/begin CHARACTERISTIC RailCD_DebSRCLowOk_C "Kraftstoffdruck Heilungsentprellzeit SRC-Low" VALUE 0xF86C0 Kw_Wu16 655350.0 Time_ms 0.00 655350.0 FORMAT "%8.1" /end CHARACTERISTIC
/begin CHARACTERISTIC RailCD_nStrtLim_C "start phase speed  threshold" VALUE 0xF8730 Kw_Ws16 6000.000 EngN 0.00 6000.000 FORMAT "%8.3" EXTENDED_LIMITS -32768.00 32767.00 /end CHARACTERISTIC
/begin CHARACTERISTIC RAILCD_numAdc2_C "application parameter for Exhaust Temperature Sensor 1" VALUE 0xF86C2 Kw_Wu8 60.0000000000 NumPinAdc 0.00 60.0000000000 FORMAT "%13.10" /end CHARACTERISTIC
/begin CHARACTERISTIC RAILCD_numAdc_C "application parameter for Rail pressure Sensor" VALUE 0xF86C3 Kw_Wu8 60.0000000000 NumPinAdc 0.00 60.0000000000 FORMAT "%13.10" /end CHARACTERISTIC
/begin CHARACTERISTIC RailCD_pFltWinNeg_CUR "Raildruckabfall, ab welchem auf Großsignalparameter umgeschaltet wird" CURVE 0xF86C4 Kl_Xs16_Ws16 6553.500 Pres_Rail -3276.800 3276.700 FORMAT "%5.3"
 /begin AXIS_DESCR STD_AXIS InjCtl_qSetUnBal InjMassCyc 10 -327.6800 327.6700 FORMAT "%8.4" DEPOSIT ABSOLUTE /end AXIS_DESCR
/end CHARACTERISTIC
/begin CHARACTERISTIC RailCD_pStrtLim_C "start phase Pressure threshold" VALUE 0xF8732 Kw_Ws16 2000.000 Pres_Rail 0.00 2000.000 FORMAT "%5.3" EXTENDED_LIMITS -3276.800 3276.700 /end CHARACTERISTIC
/begin CHARACTERISTIC RailCD_stRPSFlt_C "Funktionsweise der Raildruck-Spitzenwertermittlung im 10ms Raster" VALUE 0xF86EE Kw_Wu8 1.000 OneToOne 0.00 1.000 FORMAT "%5.3" EXTENDED_LIMITS 0.00 255.0 /end CHARACTERISTIC
/begin CHARACTERISTIC RailCD_swtOfsTst_C "Schalter für Freigabe des Offset-Tests für den Raildrucksensor im Start oder Nachlauf (0: Start, 1: Nachlauf)" VALUE 0xF86FC Kw_Wu8 3.000 OneToOne 0.00 3.000 FORMAT "%5.3" EXTENDED_LIMITS 0.00 255.0 /end CHARACTERISTIC
/begin CHARACTERISTIC RailCD_tiEvalDel_C "Verzögerungszeit zur Auswertung des Überwachungsergebnisses beim Offset-Tests für den Raildrucksensor" VALUE 0xF86FE Kw_Wu16 655350.0 Time_ms 0.00 655350.0 FORMAT "%8.1" /end CHARACTERISTIC
/begin CHARACTERISTIC RailCD_tiFlt1PT1_C "PT1 Filterparameter für steigenden Raildruck" VALUE 0xF86F0 Kw_Wu32 4294.9673 TimeDelay_s 0.0000010000000 4294.9673 FORMAT "%9.4" /end CHARACTERISTIC
/begin CHARACTERISTIC RailCD_tiFlt2PT1_C "PT1 Filterparameter für fallenden Raildruck (Kleinsignalverhalten)" VALUE 0xF86F4 Kw_Wu32 4294.9673 TimeDelay_s 0.0000010000000 4294.9673 FORMAT "%9.4" /end CHARACTERISTIC
/begin CHARACTERISTIC RailCD_tiFlt3PT1_C "PT1 Filterparameter für stark fallenden Raildruck (Großsignalverhalten)" VALUE 0xF86F8 Kw_Wu32 4294.9673 TimeDelay_s 0.0000010000000 4294.9673 FORMAT "%9.4" /end CHARACTERISTIC
/begin CHARACTERISTIC RailCD_tiOfsTstAftRun_C "Überwachungszeitraum des Offset-Tests für den Raildrucksensor im Nachlauf" VALUE 0xF8700 Kw_Wu16 655350.0 Time_ms 0.00 655350.0 FORMAT "%8.1" /end CHARACTERISTIC
/begin CHARACTERISTIC RailCD_tiOfsTstDel_CUR "Verzögerungszeit für Offset-Ueberwachung des Raildrucksensors" CURVE 0xF8702 Kl_Xs16_Ws16 5242.720 TimeRed 0.00 5242.720 FORMAT "%8.3" EXTENDED_LIMITS -5242.880 5242.720
 /begin AXIS_DESCR STD_AXIS RailCD_pPeak Pres_Rail 6 0.00 2000.000 FORMAT "%5.3" EXTENDED_LIMITS -3276.800 3276.700 DEPOSIT ABSOLUTE /end AXIS_DESCR
/end CHARACTERISTIC
/begin CHARACTERISTIC RailCD_tiOfsTstStrt_C "Überwachungszeitraum des Offset-Tests für den Raildrucksensor im Start" VALUE 0xF871C Kw_Wu16 655350.0 Time_ms 0.00 655350.0 FORMAT "%8.1" /end CHARACTERISTIC
/begin CHARACTERISTIC RailCD_tiPMonStrtLim_C "time duration  for error monitoring" VALUE 0xF8734 Kw_Wu32 10000.0000000 Time_ms 0.00 10000.0000000 FORMAT "%13.7" EXTENDED_LIMITS 0.00 42949672950.0 /end CHARACTERISTIC
/begin CHARACTERISTIC RailCD_tiStrErrDel_C "Timeout zur Speicherung des Überwachungsergebnisses beim Offset-Tests für den Raildrucksensor" VALUE 0xF871E Kw_Wu16 655350.0 Time_ms 0.00 655350.0 FORMAT "%8.1" /end CHARACTERISTIC
/begin CHARACTERISTIC RailCD_tOfsTstAftRun_C "Systemtemperaturschwelle zur Freigabe der Offset-Überwachung des Raildrucksensors im Nachlauf" VALUE 0xF8720 Kw_Ws16 250.0000 Temp_Cels -50.14000 199.8600 FORMAT "%8.4" EXTENDED_LIMITS -3549.940 3003.560 /end CHARACTERISTIC
/begin CHARACTERISTIC RailCD_tOfsTstDec_C "Wassertemperaturdifferenz 'Abkühlung' zur Freigabe der Offset-Überwachung des Raildrucksensors im Start" VALUE 0xF8722 Kw_Ws16 100.0000 TempDiff_Cels 0.00 100.0000 FORMAT "%8.4" EXTENDED_LIMITS -3276.800 3276.700 /end CHARACTERISTIC
/begin CHARACTERISTIC RailCD_tOfsTstInc_C "Wassertemperaturdifferenz 'Erwärmung' zur Freigabe der Offset-Überwachung des Raildrucksensors im Start" VALUE 0xF8724 Kw_Ws16 100.0000 TempDiff_Cels -100.0000 0.00 FORMAT "%8.4" EXTENDED_LIMITS -3276.800 3276.700 /end CHARACTERISTIC
/begin CHARACTERISTIC RailCD_tOfsTstStrt_C "Systemtemperaturschwelle zur Freigabe der Offset-Überwachung des Raildrucksensors im Start" VALUE 0xF8726 Kw_Ws16 250.0000 Temp_Cels -50.14000 199.8600 FORMAT "%8.4" EXTENDED_LIMITS -3549.940 3003.560 /end CHARACTERISTIC
/begin CHARACTERISTIC RailCD_uOfsAftRunMax_C "obere Offsetschwelle der Offset-Überwachung des Raildrucksensors im Nachlauf" VALUE 0xF8728 Kw_Ws16 5200.391 Volt 0.00 5200.391 FORMAT "%8.3" EXTENDED_LIMITS -160156.4 160151.5 /end CHARACTERISTIC
/begin CHARACTERISTIC RailCD_uOfsAftRunMin_C "untere Offsetschwelle der Offset-Überwachung des Raildrucksensors im Nachlauf" VALUE 0xF872A Kw_Ws16 5200.391 Volt 0.00 5200.391 FORMAT "%8.3" EXTENDED_LIMITS -160156.4 160151.5 /end CHARACTERISTIC
/begin CHARACTERISTIC RailCD_uOfsStrtMax_C "obere Offsetschwelle der Offset-Überwachung des Raildrucksensors im Start" VALUE 0xF872C Kw_Ws16 5200.391 Volt 0.00 5200.391 FORMAT "%8.3" EXTENDED_LIMITS -160156.4 160151.5 /end CHARACTERISTIC
/begin CHARACTERISTIC RailCD_uOfsStrtMin_C "untere Offsetschwelle der Offset-Überwachung des Raildrucksensors im Start" VALUE 0xF872E Kw_Ws16 5200.391 Volt 0.00 5200.391 FORMAT "%8.3" EXTENDED_LIMITS -160156.4 160151.5 /end CHARACTERISTIC
/begin CHARACTERISTIC Rail_DebCPC1MaxDef_C "Fehlerentprellzeit für Stellergröße PCV während CPC-Regelung im Eingriff ist" VALUE 0xF6B8C Kw_Wu16 655350.0 Time_ms 0.00 655350.0 FORMAT "%8.1" /end CHARACTERISTIC
/begin CHARACTERISTIC Rail_DebCPC1MaxOk_C "Heilungsentprellzeit für Stellgröße PCV während CPC-Regelung im Eingriff ist" VALUE 0xF6B8E Kw_Wu16 655350.0 Time_ms 0.00 655350.0 FORMAT "%8.1" /end CHARACTERISTIC
/begin CHARACTERISTIC Rail_DebCPC3MaxDef_C "Fehlerentprellzeit für minimalen Raildruck während CPC-Regelung im Eingriff ist" VALUE 0xF6B90 Kw_Wu16 655350.0 Time_ms 0.00 655350.0 FORMAT "%8.1" /end CHARACTERISTIC
/begin CHARACTERISTIC Rail_DebCPC3MaxOk_C "Heilungsentprellzeit für minimalen Raildruck während CPC-Regelung im Eingriff ist" VALUE 0xF6B92 Kw_Wu16 655350.0 Time_ms 0.00 655350.0 FORMAT "%8.1" /end CHARACTERISTIC
/begin CHARACTERISTIC Rail_DebCPC4MaxDef_C "Fehlerentprellzeit für maximalen Raildruck während CPC-Regelung im Eingriff" VALUE 0xF6B94 Kw_Wu16 655350.0 Time_ms 0.00 655350.0 FORMAT "%8.1" /end CHARACTERISTIC
/begin CHARACTERISTIC Rail_DebCPC4MaxOk_C "Heilungsentprellzeit für maximalen Raildruck während CPC-Regelung im Eingriff ist" VALUE 0xF6B96 Kw_Wu16 655350.0 Time_ms 0.00 655350.0 FORMAT "%8.1" /end CHARACTERISTIC
/begin CHARACTERISTIC Rail_DebCPCtlOn_C "Entprellzeit für die Freigabe der negativen Regelabweichung der CPC" VALUE 0xF6B2C Kw_Wu16 65540.00 TimeDeb 0.00 65540.00 FORMAT "%8.2" EXTENDED_LIMITS 0.00 655350.0 /end CHARACTERISTIC
/begin CHARACTERISTIC Rail_DebCPCtlOff_C "Entprellzeit für die Verriegelung der negativen Regelabweichung der CPC" VALUE 0xF6B2E Kw_Wu16 65540.00 TimeDeb 0.00 65540.00 FORMAT "%8.2" EXTENDED_LIMITS 0.00 655350.0 /end CHARACTERISTIC
/begin CHARACTERISTIC Rail_DebMeUn0MaxDef_C "Fehlerentprellzeit für Überwachung auf positive Regelabweichung" VALUE 0xF6BDC Kw_Wu16 655350.0 Time_ms 0.00 655350.0 FORMAT "%8.1" /end CHARACTERISTIC
/begin CHARACTERISTIC Rail_DebMeUn0MaxOk_C "Heilungsentprellzeit für Überwachung auf positive Regelabweichung" VALUE 0xF6BDE Kw_Wu16 655350.0 Time_ms 0.00 655350.0 FORMAT "%8.1" /end CHARACTERISTIC
/begin CHARACTERISTIC Rail_DebMeUn1MaxDef_C "Fehlerentprellzeit für Überwachung auf positive Regelabweichung und Sollwert des Volumenstroms durch die Zumesseinheit" VALUE 0xF6BE0 Kw_Wu16 655350.0 Time_ms 0.00 655350.0 FORMAT "%8.1" /end CHARACTERISTIC
/begin CHARACTERISTIC Rail_DebMeUn1MaxOk_C "Heilungsentprellzeit für Überwachung auf positive Regelabweichung und Sollwert des Volumenstroms durch die Zumesseinheit" VALUE 0xF6BE2 Kw_Wu16 655350.0 Time_ms 0.00 655350.0 FORMAT "%8.1" /end CHARACTERISTIC
/begin CHARACTERISTIC Rail_DebMeUn2MaxDef_C "Fehlerentprellzeit für negative Regelabweichung bei Nullförderung" VALUE 0xF6BE4 Kw_Wu16 655350.0 Time_ms 0.00 655350.0 FORMAT "%8.1" /end CHARACTERISTIC
/begin CHARACTERISTIC Rail_DebMeUn2MaxOk_C "Heilungsentprellzeit für negative Regelabweichung bei Nullförderung" VALUE 0xF6BE6 Kw_Wu16 655350.0 Time_ms 0.00 655350.0 FORMAT "%8.1" /end CHARACTERISTIC
/begin CHARACTERISTIC Rail_DebMeUn3MaxDef_C "Fehlerentprellzeit für minimalen Raildruck" VALUE 0xF6BE8 Kw_Wu16 655350.0 Time_ms 0.00 655350.0 FORMAT "%8.1" /end CHARACTERISTIC
/begin CHARACTERISTIC Rail_DebMeUn3MaxOk_C "Heilungsentprellzeit für minimalen Raildruck" VALUE 0xF6BEA Kw_Wu16 655350.0 Time_ms 0.00 655350.0 FORMAT "%8.1" /end CHARACTERISTIC
/begin CHARACTERISTIC Rail_DebMeUn4MaxDef_C "Fehlerentprellzeit für maximalen Raildruck" VALUE 0xF6BEC Kw_Wu16 655350.0 Time_ms 0.00 655350.0 FORMAT "%8.1" /end CHARACTERISTIC
/begin CHARACTERISTIC Rail_DebMeUn4MaxOk_C "Heilungsentprellzeit für maximalen Raildruck" VALUE 0xF6BEE Kw_Wu16 655350.0 Time_ms 0.00 655350.0 FORMAT "%8.1" /end CHARACTERISTIC
/begin CHARACTERISTIC Rail_dpPCVSetShOffDec_C "Abbaugradient des PCV Stellwertes beim Abstellen des Systemes" VALUE 0xF66A6 Kw_Ws16 26214.000 PresRail_sec -13107.200 13106.800 FORMAT "%5.3" /end CHARACTERISTIC
/begin CHARACTERISTIC Rail_dvolDvtLim_C "Volumenstromabweichung für die Umschaltung aus dem Zustand Rail_stCPC == CPC_MEUN_CLOSE" VALUE 0xF6520 Kw_Ws16 655350.0 Qp_mm3_sec -327680.0 327670.0 FORMAT "%8.1" /end CHARACTERISTIC
/begin CHARACTERISTIC Rail_dvolMeUnClose_CUR "Regelabweichung zum Schließen der ZME" CURVE 0xF6522 Kl_Xs16_Ws16 60000.00 Qp_mm3_sec -50000.00 10000.00 FORMAT "%8.2" EXTENDED_LIMITS -327680.0 327670.0
 /begin AXIS_DESCR STD_AXIS Eng_nAvrg EngN 12 0.00 6000.000 FORMAT "%8.3" EXTENDED_LIMITS -32768.00 32767.00 DEPOSIT ABSOLUTE /end AXIS_DESCR
/end CHARACTERISTIC
/begin CHARACTERISTIC Rail_dvolMeUnCtlInitI_CUR "Kennlinie zur Initialisierung des I-Anteils als Funktion der Systemtemperatur" CURVE 0xF6A2A Kl_Xs16_Ws16 150000.0 Qp_mm3_sec 0.00 150000.0 FORMAT "%8.1" EXTENDED_LIMITS -327680.0 327670.0
 /begin AXIS_DESCR STD_AXIS FlSys_t Temp_Cels 3 -50.14000 199.8600 FORMAT "%8.4" EXTENDED_LIMITS -3549.940 3003.560 DEPOSIT ABSOLUTE /end AXIS_DESCR
/end CHARACTERISTIC
/begin CHARACTERISTIC Rail_dvolMeUnCtlLoLim_C "untere Stellwertbegrenzung" VALUE 0xF66E6 Kw_Ws16 655350.0 Qp_mm3_sec -327680.0 327670.0 FORMAT "%8.1" /end CHARACTERISTIC
/begin CHARACTERISTIC Rail_dvolMeUnCtlUpLim_CUR "obere Stellwertbegrenzung" CURVE 0xF66E8 Kl_Xs16_Ws16 655350.0 Qp_mm3_sec -327680.0 327670.0 FORMAT "%8.1"
 /begin AXIS_DESCR STD_AXIS Eng_nAvrg EngN 11 0.00 6000.000 FORMAT "%8.3" EXTENDED_LIMITS -32768.00 32767.00 DEPOSIT ABSOLUTE /end AXIS_DESCR
/end CHARACTERISTIC
/begin CHARACTERISTIC Rail_dvolMeUnDvtNeg_C "Schwelle negative Regelabweichung des Volumenstroms zur Umschaltung auf MeUn Regelung" VALUE 0xF6B30 Kw_Ws16 10000.00 Qp_mm3_sec -10000.00 0.00 FORMAT "%8.2" EXTENDED_LIMITS -327680.0 327670.0 /end CHARACTERISTIC
/begin CHARACTERISTIC Rail_dvolMeUnDvtPos_C "Schwelle für Regelabweichung des Volumenstroms zur Aktivierung der CPC-Regelung" VALUE 0xF6B32 Kw_Ws16 10000.00 Qp_mm3_sec -10000.00 0.00 FORMAT "%8.2" EXTENDED_LIMITS -327680.0 327670.0 /end CHARACTERISTIC
/begin CHARACTERISTIC Rail_dvolMeUnOpn_CUR "Regelabweichung zum Öffnen der ZME" CURVE 0xF6554 Kl_Xs16_Ws16 60000.00 Qp_mm3_sec -10000.00 50000.00 FORMAT "%8.2" EXTENDED_LIMITS -327680.0 327670.0
 /begin AXIS_DESCR STD_AXIS Eng_nAvrg EngN 12 0.00 6000.000 FORMAT "%8.3" EXTENDED_LIMITS -32768.00 32767.00 DEPOSIT ABSOLUTE /end AXIS_DESCR
/end CHARACTERISTIC
/begin CHARACTERISTIC Rail_dvolMeUnSet_Vector "Bypass-Label für Rail_dvolMeUnSet (Nicht verstellen!)" VALUE 0xC39B2 Kw_Wu8 255.0 OneToOne 0.00 255.0 FORMAT "%5.1" /end CHARACTERISTIC
/begin CHARACTERISTIC Rail_dvolMeUnSet_Channel "Bypass-Label für Rail_dvolMeUnSet, nicht editieren!" VALUE 0xC39B3 Kw_Wu8 255.0 OneToOne 0.00 255.0 FORMAT "%5.1" /end CHARACTERISTIC
/begin CHARACTERISTIC Rail_dvolOff_C "Volumenstrom beim Abstellen des Systems (Nullförderung)" VALUE 0xF66A8 Kw_Ws16 655350.0 Qp_mm3_sec -327680.0 327670.0 FORMAT "%8.1" /end CHARACTERISTIC
/begin CHARACTERISTIC Rail_dvolPCVClose_CUR "Regelabweichung zum Schließen der DRV" CURVE 0xF6586 Kl_Xs16_Ws16 50000.00 Qp_mm3_sec -50000.00 0.00 FORMAT "%8.2" EXTENDED_LIMITS -327680.0 327670.0
 /begin AXIS_DESCR STD_AXIS Eng_nAvrg EngN 12 0.00 6000.000 FORMAT "%8.3" EXTENDED_LIMITS -32768.00 32767.00 DEPOSIT ABSOLUTE /end AXIS_DESCR
/end CHARACTERISTIC
/begin CHARACTERISTIC Rail_dvolPCVOpn_CUR "Regelabweichung zum Öffnen des DRV" CURVE 0xF65B8 Kl_Xs16_Ws16 50000.00 Qp_mm3_sec 0.00 50000.00 FORMAT "%8.2" EXTENDED_LIMITS -327680.0 327670.0
 /begin AXIS_DESCR STD_AXIS Eng_nAvrg EngN 12 0.00 6000.000 FORMAT "%8.3" EXTENDED_LIMITS -32768.00 32767.00 DEPOSIT ABSOLUTE /end AXIS_DESCR
/end CHARACTERISTIC
/begin CHARACTERISTIC Rail_dvolPreCtlCor_Vector "Bypass Label, nicht ändern!" VALUE 0xC39B4 Kw_Wu8 255.0 OneToOne 0.00 255.0 FORMAT "%5.1" /end CHARACTERISTIC
/begin CHARACTERISTIC Rail_dvolPreCtlCor_Channel "Bypass Label, nicht ändern!" VALUE 0xC39B5 Kw_Wu8 255.0 OneToOne 0.00 255.0 FORMAT "%5.1" /end CHARACTERISTIC
/begin CHARACTERISTIC Rail_dvolStrt_C "Volumenstrom während der Startphase (2-Stellerkonzept)" VALUE 0xF66AA Kw_Ws16 655350.0 Qp_mm3_sec -327680.0 327670.0 FORMAT "%8.1" /end CHARACTERISTIC
/begin CHARACTERISTIC Rail_facMeUnDvt_CUR "Gewichtungsfaktor für die Regelabweichung der ZME" CURVE 0xF65EA Kl_Xs16_Ws16 100.0000 Fact100 0.00 100.0000 FORMAT "%8.4" EXTENDED_LIMITS -327.6800 327.6700
 /begin AXIS_DESCR STD_AXIS Eng_nAvrg EngN 12 0.00 6000.000 FORMAT "%8.3" EXTENDED_LIMITS -32768.00 32767.00 DEPOSIT ABSOLUTE /end AXIS_DESCR
/end CHARACTERISTIC
/begin CHARACTERISTIC Rail_facMeUnSetPoint_CUR "Faktor für die Mindestfördermenge der Hochdruckpumpe" CURVE 0xF661C Kl_Xs16_Ws16 1.000000 Fact 0.00 1.000000 FORMAT "%8.6" EXTENDED_LIMITS -4.000000 3.999878
 /begin AXIS_DESCR STD_AXIS Eng_nAvrg EngN 12 0.00 6000.000 FORMAT "%8.3" EXTENDED_LIMITS -32768.00 32767.00 DEPOSIT ABSOLUTE /end AXIS_DESCR
/end CHARACTERISTIC
/begin CHARACTERISTIC Rail_facOvrMeUnNegIncr_C "Multiplikativer Faktor zur Erhöhung der I-Verstärkung für negative Großsignale bei Überdruck (Druckregelung über MeUn)" VALUE 0xF671C Kw_Ws16 255.9922 Fact1 0.00 255.9922 FORMAT "%8.4" EXTENDED_LIMITS -256.0000 255.9922 /end CHARACTERISTIC
/begin CHARACTERISTIC Rail_facOvrPCVNegIncr_C "Multiplikativer Faktor zur Erhöhung der I-Verstärkung für negative Großsignale bei Überdruck (Druckregelung über PCV)" VALUE 0xF68B4 Kw_Ws16 255.9922 Fact1 0.00 255.9922 FORMAT "%8.4" EXTENDED_LIMITS -256.0000 255.9922 /end CHARACTERISTIC
/begin CHARACTERISTIC Rail_facPCVDvt_CUR "Gewichtungsfaktor für die Regelabweichung des DRV" CURVE 0xF664E Kl_Xs16_Ws16 100.0000 Fact100 -100.0000 0.00 FORMAT "%8.4" EXTENDED_LIMITS -327.6800 327.6700
 /begin AXIS_DESCR STD_AXIS Eng_nAvrg EngN 12 0.00 6000.000 FORMAT "%8.3" EXTENDED_LIMITS -32768.00 32767.00 DEPOSIT ABSOLUTE /end AXIS_DESCR
/end CHARACTERISTIC
/begin CHARACTERISTIC Rail_facPCVFast_C "Faktor zum Beschleunigen des Stellverhaltens des DRV über die Regelabweichung" VALUE 0xF6680 Kw_Ws16 655.3500 Fact100 -327.6800 327.6700 FORMAT "%8.4" /end CHARACTERISTIC
/begin CHARACTERISTIC Rail_MeUnCtlDKd_CUR "D-Verstärkung der Druckregelung über Zumesseinheit" CURVE 0xF671E Kl_Xs16_Ws16 500.0000 Kd_pRail2Q_1 0.00 500.0000 FORMAT "%12.4" EXTENDED_LIMITS -800.0000 799.9756
 /begin AXIS_DESCR STD_AXIS Eng_nAvrg EngN 3 0.00 6000.000 FORMAT "%8.3" EXTENDED_LIMITS -32768.00 32767.00 DEPOSIT ABSOLUTE /end AXIS_DESCR
/end CHARACTERISTIC
/begin CHARACTERISTIC Rail_MeUnCtlIKiNeg_CUR "I-Verstärkung für negative Großsignale für die Druckregelung über Zumesseinheit" CURVE 0xF672C Kl_Xs16_Ws16 2000.015 Ki_pRail2Q_1 0.00 2000.015 FORMAT "%11.3" EXTENDED_LIMITS -3051.758 3051.665
 /begin AXIS_DESCR STD_AXIS Eng_nAvrg EngN 13 0.00 6000.000 FORMAT "%8.3" EXTENDED_LIMITS -32768.00 32767.00 DEPOSIT ABSOLUTE /end AXIS_DESCR
/end CHARACTERISTIC
/begin CHARACTERISTIC Rail_MeUnCtlIKiPos_CUR "I-Verstärkung für positive Großsignale für die Druckregelung über Zumesseinheit" CURVE 0xF6762 Kl_Xs16_Ws16 2000.015 Ki_pRail2Q_1 0.00 2000.015 FORMAT "%11.3" EXTENDED_LIMITS -3051.758 3051.665
 /begin AXIS_DESCR STD_AXIS Eng_nAvrg EngN 13 0.00 6000.000 FORMAT "%8.3" EXTENDED_LIMITS -32768.00 32767.00 DEPOSIT ABSOLUTE /end AXIS_DESCR
/end CHARACTERISTIC
/begin CHARACTERISTIC Rail_MeUnCtlIKi_CUR "I-Verstärkung für Kleinsignale für die Druckregelung über Zumesseinheit" CURVE 0xF6798 Kl_Xs16_Ws16 2000.015 Ki_pRail2Q_1 0.00 2000.015 FORMAT "%11.3" EXTENDED_LIMITS -3051.758 3051.665
 /begin AXIS_DESCR STD_AXIS Eng_nAvrg EngN 13 0.00 6000.000 FORMAT "%8.3" EXTENDED_LIMITS -32768.00 32767.00 DEPOSIT ABSOLUTE /end AXIS_DESCR
/end CHARACTERISTIC
/begin CHARACTERISTIC Rail_MeUnCtlPKpNeg_CUR "P-Verstärkung für negative Großsignale für die Druckregelung über Zumesseinheit" CURVE 0xF67CE Kl_Xs16_Ws16 200.0000 Kp_pRail2Q_1 0.00 200.0000 FORMAT "%12.4" EXTENDED_LIMITS -400.0000 399.9878
 /begin AXIS_DESCR STD_AXIS Eng_nAvrg EngN 13 0.00 6000.000 FORMAT "%8.3" EXTENDED_LIMITS -32768.00 32767.00 DEPOSIT ABSOLUTE /end AXIS_DESCR
/end CHARACTERISTIC
/begin CHARACTERISTIC Rail_MeUnCtlPKpPos_CUR "P-Verstärkung für positive Großsignale für die Druckregelung über Zumesseinheit" CURVE 0xF6804 Kl_Xs16_Ws16 200.0000 Kp_pRail2Q_1 0.00 200.0000 FORMAT "%12.4" EXTENDED_LIMITS -400.0000 399.9878
 /begin AXIS_DESCR STD_AXIS Eng_nAvrg EngN 13 0.00 6000.000 FORMAT "%8.3" EXTENDED_LIMITS -32768.00 32767.00 DEPOSIT ABSOLUTE /end AXIS_DESCR
/end CHARACTERISTIC
/begin CHARACTERISTIC Rail_MeUnCtlPKp_CUR "P-Verstärkung für Kleinsignale für die Druckregelung über Zumesseinheit" CURVE 0xF683A Kl_Xs16_Ws16 200.0000 Kp_pRail2Q_1 0.00 200.0000 FORMAT "%12.4" EXTENDED_LIMITS -400.0000 399.9878
 /begin AXIS_DESCR STD_AXIS Eng_nAvrg EngN 13 0.00 6000.000 FORMAT "%8.3" EXTENDED_LIMITS -32768.00 32767.00 DEPOSIT ABSOLUTE /end AXIS_DESCR
/end CHARACTERISTIC
/begin CHARACTERISTIC Rail_dvolMeUnSetMin_C "minimal zulässiger Volumenstrom durch Zumesseinheit für Raildrucküberwachung" VALUE 0xF6BF0 Kw_Ws16 50000.00 Qp_mm3_sec 0.00 50000.00 FORMAT "%8.2" EXTENDED_LIMITS -327680.0 327670.0 /end CHARACTERISTIC
/begin CHARACTERISTIC Rail_pMeUnPeakMax_C "Maximal zulässiger Raildruck" VALUE 0xF6BF2 Kw_Ws16 2000.000 Pres_Rail 0.00 2000.000 FORMAT "%5.3" EXTENDED_LIMITS -3276.800 3276.700 /end CHARACTERISTIC
/begin CHARACTERISTIC Rail_pMeUnDvtMax_C "Maximal zulässige Regelabweichung für Raildrucküberwachung" VALUE 0xF6BF4 Kw_Ws16 2000.000 Pres_Rail 0.00 2000.000 FORMAT "%5.3" EXTENDED_LIMITS -3276.800 3276.700 /end CHARACTERISTIC
/begin CHARACTERISTIC Rail_qMeUnLoIdle_C "Mengenschwelle zur Erkennung der Schubbedingung bei der Raildrucküberwachung" VALUE 0xF6BF6 Kw_Ws16 327.6700 InjMassCyc 0.00 327.6700 FORMAT "%8.4" EXTENDED_LIMITS -327.6800 327.6700 /end CHARACTERISTIC
/begin CHARACTERISTIC Rail_stMonMeUnRls_C "Generelle Freigabemaske für Überwachungen der Druckregelung über Zumesseinheit" VALUE 0xF6BF8 Kw_Wu16 65535.00 OneToOne 0.00 65535.00 FORMAT "%8.2" /end CHARACTERISTIC
/begin CHARACTERISTIC Rail_tMeUnLoIdle_C "Systemtemperaturschwelle für die Raildrucküberwachung" VALUE 0xF6BFA Kw_Ws16 250.0000 Temp_Cels -50.14000 199.8600 FORMAT "%8.4" EXTENDED_LIMITS -3549.940 3003.560 /end CHARACTERISTIC
/begin CHARACTERISTIC Rail_nCloseCtl_C "Drehzahlschwelle für Wechsel zwischen gesteuertem und geregeltem Betrieb" VALUE 0xF6690 Kw_Ws16 65535.00 EngN -32768.00 32767.00 FORMAT "%8.2" /end CHARACTERISTIC
/begin CHARACTERISTIC Rail_nMeUnFrzI_C "Drehzahlschwelle zum Einfrieren des I-Anteils für den Druckregler über Zumesseinheit" VALUE 0xF6A38 Kw_Ws16 65535.00 EngN -32768.00 32767.00 FORMAT "%8.2" /end CHARACTERISTIC
/begin CHARACTERISTIC Rail_nThresStrt_C "Drehzahlschwelle zum Verlassen des Startzustandes der Zustandssteuerung" VALUE 0xF6692 Kw_Ws16 65535.00 EngN -32768.00 32767.00 FORMAT "%8.2" /end CHARACTERISTIC
/begin CHARACTERISTIC Rail_numRevDel_C "Anzahl der Motorumdrehungen um von Steuern auf Regeln umzuschalten" VALUE 0xF66AC Kw_Wu16 65535.00 OneToOne 0.00 65535.00 FORMAT "%8.2" /end CHARACTERISTIC
/begin CHARACTERISTIC Rail_numRevPlaus_C "Anzahl der Motorumdrehungen um von Vorregelung auf Regelung umzuschalten" VALUE 0xF6694 Kw_Wu16 65535.00 OneToOne 0.00 65535.00 FORMAT "%8.2" /end CHARACTERISTIC
/begin CHARACTERISTIC Rail_pCloseCtl_C "Absolutdruckschwelle zum Umschaltung in den Regelbetrieb" VALUE 0xF6696 Kw_Ws16 6553.500 Pres_Rail -3276.800 3276.700 FORMAT "%5.3" /end CHARACTERISTIC
/begin CHARACTERISTIC Rail_pCPCPeakMax_C "maximal zulässiger Raildruck for the CPC monitoring" VALUE 0xF6B98 Kw_Ws16 2000.000 Pres_Rail 0.00 2000.000 FORMAT "%5.3" EXTENDED_LIMITS -3276.800 3276.700 /end CHARACTERISTIC
/begin CHARACTERISTIC Rail_pCPCPeakMin_CUR "minimal zulässiger Raildruck als Funktion der Motordrehzahl während CPC-Regelung im Eingriff ist" CURVE 0xF6B9A Kl_Xs16_Ws16 2000.000 Pres_Rail 0.00 2000.000 FORMAT "%5.3" EXTENDED_LIMITS -3276.800 3276.700
 /begin AXIS_DESCR STD_AXIS Eng_nAvrg EngN 16 0.00 6000.000 FORMAT "%8.3" EXTENDED_LIMITS -32768.00 32767.00 DEPOSIT ABSOLUTE /end AXIS_DESCR
/end CHARACTERISTIC
/begin CHARACTERISTIC Rail_PCVCtlDKd_CUR "D-Verstärkung der Druckregelung über Druckregelventil" CURVE 0xF68B6 Kl_Xs16_Ws16 50.00000 Kd_1 0.00 50.00000 FORMAT "%8.5" EXTENDED_LIMITS -64.00000 63.99805
 /begin AXIS_DESCR STD_AXIS Eng_nAvrg EngN 3 0.00 6000.000 FORMAT "%8.3" EXTENDED_LIMITS -32768.00 32767.00 DEPOSIT ABSOLUTE /end AXIS_DESCR
/end CHARACTERISTIC
/begin CHARACTERISTIC Rail_PCVCtlIKiNeg_CUR "I-Verstärkung für negative Großsignale für die Druckregelung über Druckregelventil" CURVE 0xF68C4 Kl_Xs16_Ws16 249.9968 Ki_1 0.00 249.9968 FORMAT "%8.4" EXTENDED_LIMITS -488.2812 488.2663
 /begin AXIS_DESCR STD_AXIS Eng_nAvrg EngN 13 0.00 6000.000 FORMAT "%8.3" EXTENDED_LIMITS -32768.00 32767.00 DEPOSIT ABSOLUTE /end AXIS_DESCR
/end CHARACTERISTIC
/begin CHARACTERISTIC Rail_PCVCtlIKiPos_CUR "I-Verstärkung für positive Großsignale für die Druckregelung über Druckregelventil" CURVE 0xF68FA Kl_Xs16_Ws16 249.9968 Ki_1 0.00 249.9968 FORMAT "%8.4" EXTENDED_LIMITS -488.2812 488.2663
 /begin AXIS_DESCR STD_AXIS Eng_nAvrg EngN 13 0.00 6000.000 FORMAT "%8.3" EXTENDED_LIMITS -32768.00 32767.00 DEPOSIT ABSOLUTE /end AXIS_DESCR
/end CHARACTERISTIC
/begin CHARACTERISTIC Rail_PCVCtlIKi_CUR "I-Verstärkung für Kleinsignale für die Druckregelung über Druckregelventil" CURVE 0xF6930 Kl_Xs16_Ws16 249.9968 Ki_1 0.00 249.9968 FORMAT "%8.4" EXTENDED_LIMITS -488.2812 488.2663
 /begin AXIS_DESCR STD_AXIS Eng_nAvrg EngN 13 0.00 6000.000 FORMAT "%8.3" EXTENDED_LIMITS -32768.00 32767.00 DEPOSIT ABSOLUTE /end AXIS_DESCR
/end CHARACTERISTIC
/begin CHARACTERISTIC Rail_PCVCtlPKpNeg_CUR "P-Verstärkung für negative Großsignale für die Druckregelung über Druckregelventil" CURVE 0xF6966 Kl_Xs16_Ws16 300.0000 Kp_1 0.00 300.0000 FORMAT "%8.4" EXTENDED_LIMITS -512.0000 511.9844
 /begin AXIS_DESCR STD_AXIS Eng_nAvrg EngN 13 0.00 6000.000 FORMAT "%8.3" EXTENDED_LIMITS -32768.00 32767.00 DEPOSIT ABSOLUTE /end AXIS_DESCR
/end CHARACTERISTIC
/begin CHARACTERISTIC Rail_PCVCtlPKpPos_CUR "P-Verstärkung für positive Großsignale für die Druckregelung über Druckregelventil" CURVE 0xF699C Kl_Xs16_Ws16 300.0000 Kp_1 0.00 300.0000 FORMAT "%8.4" EXTENDED_LIMITS -512.0000 511.9844
 /begin AXIS_DESCR STD_AXIS Eng_nAvrg EngN 13 0.00 6000.000 FORMAT "%8.3" EXTENDED_LIMITS -32768.00 32767.00 DEPOSIT ABSOLUTE /end AXIS_DESCR
/end CHARACTERISTIC
/begin CHARACTERISTIC Rail_PCVCtlPKp_CUR "P-Verstärkung für Kleinsignale für die Druckregelung über Druckregelventil" CURVE 0xF69D2 Kl_Xs16_Ws16 300.0000 Kp_1 0.00 300.0000 FORMAT "%8.4" EXTENDED_LIMITS -512.0000 511.9844
 /begin AXIS_DESCR STD_AXIS Eng_nAvrg EngN 13 0.00 6000.000 FORMAT "%8.3" EXTENDED_LIMITS -32768.00 32767.00 DEPOSIT ABSOLUTE /end AXIS_DESCR
/end CHARACTERISTIC
/begin CHARACTERISTIC Rail_pDiffCloseCtl_C "Differenzdruckschwelle zum Umschalten in den Regelbetrieb" VALUE 0xF6698 Kw_Ws16 6553.500 Pres_Rail -3276.800 3276.700 FORMAT "%5.3" /end CHARACTERISTIC
/begin CHARACTERISTIC Rail_pDvtFltMin_C "minimale absolute Regelabweichung als eingangssignal des DT1-Gliedes" VALUE 0xF6A3A Kw_Ws16 6553.500 Pres_Rail -3276.800 3276.700 FORMAT "%5.3" /end CHARACTERISTIC
/begin CHARACTERISTIC Rail_pMeUnCtlIWinNeg_C "untere Kleinsignalgrenze für den I-Anteil des Druckreglers über Zumesseinheit" VALUE 0xF6870 Kw_Ws16 6553.500 Pres_Rail -3276.800 3276.700 FORMAT "%5.3" /end CHARACTERISTIC
/begin CHARACTERISTIC Rail_pMeUnCtlIWinPos_C "obere Kleinsignalgrenze für den I-Anteil des Druckreglers über Zumesseinheit" VALUE 0xF6872 Kw_Ws16 6553.500 Pres_Rail -3276.800 3276.700 FORMAT "%5.3" /end CHARACTERISTIC
/begin CHARACTERISTIC Rail_pMeUnCtlPWinNeg_C "untere Kleinsignalgrenze für den P-Anteil des Druckreglers über Zumesseinheit" VALUE 0xF6874 Kw_Ws16 6553.500 Pres_Rail -3276.800 3276.700 FORMAT "%5.3" /end CHARACTERISTIC
/begin CHARACTERISTIC Rail_pMeUnCtlPWinPos_C "obere Kleinsignalgrenze für den P-Anteil des Druckreglers über Zumesseinheit" VALUE 0xF6876 Kw_Ws16 6553.500 Pres_Rail -3276.800 3276.700 FORMAT "%5.3" /end CHARACTERISTIC
/begin CHARACTERISTIC Rail_pMeUnCtlTypeHi_C "obere Solldruckhystereseschwelle für die Verriegelung der PCV-Regelung" VALUE 0xF6B34 Kw_Ws16 2000.000 Pres_Rail 0.00 2000.000 FORMAT "%5.3" EXTENDED_LIMITS -3276.800 3276.700 /end CHARACTERISTIC
/begin CHARACTERISTIC Rail_pMeUnCtlTypeLo_C "untere Solldruckhystereseschwelle für die Verriegelung der PCV Regelung" VALUE 0xF6B36 Kw_Ws16 2000.000 Pres_Rail 0.00 2000.000 FORMAT "%5.3" EXTENDED_LIMITS -3276.800 3276.700 /end CHARACTERISTIC
/begin CHARACTERISTIC Rail_pMeUnDvtMax_CUR "Maximal zulässige Regelabweichung für Raildrucküberwachung als Funktion der Drehzahl" CURVE 0xF6BFC Kl_Xs16_Ws16 3800.000 Pres_Rail -1800.000 2000.000 FORMAT "%5.3" EXTENDED_LIMITS -3276.800 3276.700
 /begin AXIS_DESCR STD_AXIS Eng_nAvrg EngN 4 0.00 6000.000 FORMAT "%8.3" EXTENDED_LIMITS -32768.00 32767.00 DEPOSIT ABSOLUTE /end AXIS_DESCR
/end CHARACTERISTIC
/begin CHARACTERISTIC Rail_pMeUnDvtMin_CUR "Minimal zulässige Regelabweichung für Raildrucküberwachung als Funktion der Drehzahl" CURVE 0xF6C0E Kl_Xs16_Ws16 3800.000 Pres_Rail -1800.000 2000.000 FORMAT "%5.3" EXTENDED_LIMITS -3276.800 3276.700
 /begin AXIS_DESCR STD_AXIS Eng_nAvrg EngN 4 0.00 6000.000 FORMAT "%8.3" EXTENDED_LIMITS -32768.00 32767.00 DEPOSIT ABSOLUTE /end AXIS_DESCR
/end CHARACTERISTIC
/begin CHARACTERISTIC Rail_pMeUnPeakMin_CUR "Minimal zulässiger Raildruck als Funktion der Motordrehzahl" CURVE 0xF6C20 Kl_Xs16_Ws16 2000.000 Pres_Rail 0.00 2000.000 FORMAT "%5.3" EXTENDED_LIMITS -3276.800 3276.700
 /begin AXIS_DESCR STD_AXIS Eng_nAvrg EngN 5 0.00 6000.000 FORMAT "%8.3" EXTENDED_LIMITS -32768.00 32767.00 DEPOSIT ABSOLUTE /end AXIS_DESCR
/end CHARACTERISTIC
/begin CHARACTERISTIC Rail_pMeUnPreCtlOff_C "Druckschwelle für die Umschaltung aus dem Zustand Rail_stCPC == CPC_MEUN_CLOSE" VALUE 0xF6682 Kw_Ws16 6553.500 Pres_Rail -3276.800 3276.700 FORMAT "%5.3" /end CHARACTERISTIC
/begin CHARACTERISTIC Rail_pMeUnPreCtlOn_C "Druckschwelle für die Umschaltung aus dem Zustand Rail_stCPC == CPC_MEUN_CLOSE" VALUE 0xF6684 Kw_Ws16 6553.500 Pres_Rail -3276.800 3276.700 FORMAT "%5.3" /end CHARACTERISTIC
/begin CHARACTERISTIC Rail_pOpnCtl_C "Absolutdruckschwelle zum Umschaltung in den Steuerbetrieb" VALUE 0xF669A Kw_Ws16 6553.500 Pres_Rail -3276.800 3276.700 FORMAT "%5.3" /end CHARACTERISTIC
/begin CHARACTERISTIC Rail_pOvrMeUnThresHigh_C "Obere Hystereseschwelle für Überdruckerkennung MeUn" VALUE 0xF6878 Kw_Ws16 2000.000 Pres_Rail 0.00 2000.000 FORMAT "%5.3" EXTENDED_LIMITS -3276.800 3276.700 /end CHARACTERISTIC
/begin CHARACTERISTIC Rail_pOvrMeUnThresLow_C "Untere Hystereseschwelle für Überdruckerkennung MeUn" VALUE 0xF687A Kw_Ws16 2000.000 Pres_Rail 0.00 2000.000 FORMAT "%5.3" EXTENDED_LIMITS -3276.800 3276.700 /end CHARACTERISTIC
/begin CHARACTERISTIC Rail_pOvrPCVThresHigh_C "Obere Hystereseschwelle für Überdruckerkennung PCV" VALUE 0xF6A08 Kw_Ws16 2000.000 Pres_Rail 0.00 2000.000 FORMAT "%5.3" EXTENDED_LIMITS -3276.800 3276.700 /end CHARACTERISTIC
/begin CHARACTERISTIC Rail_pOvrPCVThresLow_C "Untere Hystereseschwelle für Überdruckerkennung PCV" VALUE 0xF6A0A Kw_Ws16 2000.000 Pres_Rail 0.00 2000.000 FORMAT "%5.3" EXTENDED_LIMITS -3276.800 3276.700 /end CHARACTERISTIC
/begin CHARACTERISTIC Rail_pPCVCtlIWinNeg_C "untere Kleinsignalgrenze für den I-Anteil des Druckreglers über Druckregelventil" VALUE 0xF6A0C Kw_Ws16 6553.500 Pres_Rail -3276.800 3276.700 FORMAT "%5.3" /end CHARACTERISTIC
/begin CHARACTERISTIC Rail_pPCVCtlIWinPos_C "obere Kleinsignalgrenze für den I-Anteil des Druckreglers über Druckregelventil" VALUE 0xF6A0E Kw_Ws16 6553.500 Pres_Rail -3276.800 3276.700 FORMAT "%5.3" /end CHARACTERISTIC
/begin CHARACTERISTIC Rail_pPCVCtlLoLimStrt_C "untere Stellwertbegrenzung des Raildruckreglers über Druckregelventil während der Startphase" VALUE 0xF6716 Kw_Ws16 6553.500 Pres_Rail -3276.800 3276.700 FORMAT "%5.3" /end CHARACTERISTIC
/begin CHARACTERISTIC Rail_pPCVCtlLoLim_C "untere Stellwertbegrenzung des Raildruckreglers über Druckregelventil" VALUE 0xF6718 Kw_Ws16 6553.500 Pres_Rail -3276.800 3276.700 FORMAT "%5.3" /end CHARACTERISTIC
/begin CHARACTERISTIC Rail_pPCVCtlPWinNeg_C "untere Kleinsignalgrenze für den P-Anteil des Druckreglers über Druckregelventil" VALUE 0xF6A10 Kw_Ws16 6553.500 Pres_Rail -3276.800 3276.700 FORMAT "%5.3" /end CHARACTERISTIC
/begin CHARACTERISTIC Rail_pPCVCtlPWinPos_C "obere Kleinsignalgrenze für den P-Anteil des Druckreglers über Druckregelventil" VALUE 0xF6A12 Kw_Ws16 6553.500 Pres_Rail -3276.800 3276.700 FORMAT "%5.3" /end CHARACTERISTIC
/begin CHARACTERISTIC Rail_pPCVCtlUpLimStrt_C "obere Stellwertbegrenzung des Raildruckreglers über Druckregelventil während der Startphase" VALUE 0xF671A Kw_Ws16 6553.500 Pres_Rail -3276.800 3276.700 FORMAT "%5.3" /end CHARACTERISTIC
/begin CHARACTERISTIC Rail_pPCVInitI_MAP "Kennfeld für Initialisierungswert I-Anteil des PCV-Druckreglers, beim Umschalten von Zumesseinheit auf Druckregelventil" MAP 0xF6A3E Kf_Xs16_Ys16_Ws16 2000.000 Pres_Rail 0.00 2000.000 FORMAT "%5.3" EXTENDED_LIMITS -3276.800 3276.700
 /begin AXIS_DESCR STD_AXIS Eng_nAvrg EngN 8 0.00 6000.000 FORMAT "%8.3" EXTENDED_LIMITS -32768.00 32767.00 DEPOSIT ABSOLUTE /end AXIS_DESCR
 /begin AXIS_DESCR STD_AXIS Rail_pSetPoint Pres_Rail 12 0.00 2000.000 FORMAT "%5.3" EXTENDED_LIMITS -3276.800 3276.700 DEPOSIT ABSOLUTE /end AXIS_DESCR
/end CHARACTERISTIC
/begin CHARACTERISTIC Rail_pPCVRedOfs_C "Druckschwelle für die Umschaltung nach Rail_stCPC == CPC_RED_OFS oder nach CPC_PCV_RMP" VALUE 0xF6686 Kw_Ws16 6553.500 Pres_Rail -3276.800 3276.700 FORMAT "%5.3" /end CHARACTERISTIC
/begin CHARACTERISTIC Rail_pPCVSet_Vector "Bypass-Label für Rail_pPCVSet (Nicht verstellen!)" VALUE 0xC39B6 Kw_Wu8 255.0 OneToOne 0.00 255.0 FORMAT "%5.1" /end CHARACTERISTIC
/begin CHARACTERISTIC Rail_pPCVSet_Channel "Bypass-Label, nicht editieren !" VALUE 0xC39B7 Kw_Wu8 255.0 OneToOne 0.00 255.0 FORMAT "%5.1" /end CHARACTERISTIC
/begin CHARACTERISTIC Rail_pPreCtlCor_Vector "Bypass Label, nicht ändern!" VALUE 0xC39B8 Kw_Wu8 255.0 OneToOne 0.00 255.0 FORMAT "%5.1" /end CHARACTERISTIC
/begin CHARACTERISTIC Rail_pPreCtlCor_Channel "Bypass Label, nicht ändern!" VALUE 0xC39B9 Kw_Wu8 255.0 OneToOne 0.00 255.0 FORMAT "%5.1" /end CHARACTERISTIC
/begin CHARACTERISTIC Rail_pSetMin_CUR "Kennlinie für den minimalen Raildruck als PCV Stellwertvorgabe während Systemabstellung" CURVE 0xF66AE Kl_Xs16_Ws16 6553.500 Pres_Rail -3276.800 3276.700 FORMAT "%5.3"
 /begin AXIS_DESCR STD_AXIS Eng_nAvrg EngN 4 0.00 6000.000 FORMAT "%8.3" EXTENDED_LIMITS -32768.00 32767.00 DEPOSIT ABSOLUTE /end AXIS_DESCR
/end CHARACTERISTIC
/begin CHARACTERISTIC Rail_qCPCtlTypeHys_C "Hysterese für die Umschaltung auf CPC-Regelung" VALUE 0xF6B38 Kw_Ws16 327.6700 InjMassCyc 0.00 327.6700 FORMAT "%8.4" EXTENDED_LIMITS -327.6800 327.6700 /end CHARACTERISTIC
/begin CHARACTERISTIC Rail_qCPCtlType_CUR "Mengengrenze für die Umschaltung auf CPC-Regelung" CURVE 0xF6B3A Kl_Xs16_Ws16 327.6700 InjMassCyc 0.00 327.6700 FORMAT "%8.4" EXTENDED_LIMITS -327.6800 327.6700
 /begin AXIS_DESCR STD_AXIS Eng_nAvrg EngN 8 0.00 6000.000 FORMAT "%8.3" EXTENDED_LIMITS -32768.00 32767.00 DEPOSIT ABSOLUTE /end AXIS_DESCR
/end CHARACTERISTIC
/begin CHARACTERISTIC Rail_qMeUnCtlTypeHys_C "Hysterese für die Umschaltung auf MeUn-Regelung" VALUE 0xF6B5C Kw_Ws16 327.6700 InjMassCyc 0.00 327.6700 FORMAT "%8.4" EXTENDED_LIMITS -327.6800 327.6700 /end CHARACTERISTIC
/begin CHARACTERISTIC Rail_qMeUnCtlType_CUR "Kennlinie zur mengenabhängigen Umschaltung auf Druckregelung über Zumesseinheit (Rail_swtConInv_C beachten!)" CURVE 0xF6B5E Kl_Xs16_Ws16 327.6700 InjMassCyc 0.00 327.6700 FORMAT "%8.4" EXTENDED_LIMITS -327.6800 327.6700
 /begin AXIS_DESCR STD_AXIS Eng_nAvrg EngN 8 0.00 6000.000 FORMAT "%8.3" EXTENDED_LIMITS -32768.00 32767.00 DEPOSIT ABSOLUTE /end AXIS_DESCR
/end CHARACTERISTIC
/begin CHARACTERISTIC Rail_stCtlLoopSel_C "Schalterauswahl fuer die Raildruckregelung" VALUE 0xF66C0 Kw_Wu8 255.0 OneToOne 0.00 255.0 FORMAT "%5.1" /end CHARACTERISTIC
/begin CHARACTERISTIC Rail_swtCtlModeAdjVal_C "Abgleichersatzwert für Hochdruckregelungs-Modus MeUn/PCV (0x00: no error, 0x01: MeUn, 0x02: PCV)" VALUE 0xF669C Kw_Wu8 2.000 OneToOne 0.00 2.000 FORMAT "%5.3" EXTENDED_LIMITS 0.00 255.0 /end CHARACTERISTIC
/begin CHARACTERISTIC Rail_swtCtlType_C "Schalter für die manuelle Vorgabe des Regelmodus" VALUE 0xF6B80 Kw_Wu8 255.0 OneToOne 0.00 255.0 FORMAT "%5.1" /end CHARACTERISTIC
/begin CHARACTERISTIC Rail_swtPCVInitI_C "Auswahl, PCV-Reglerinitialisierung mit Vorsteuerwert oder mit Sollwert (Bit0: 1: Sollwert, 0: Vorsteuerwert)" VALUE 0xF6B2A Kw_Wu8 255.0 OneToOne 0.00 255.0 FORMAT "%5.1" /end CHARACTERISTIC
/begin CHARACTERISTIC Rail_tiDebDefMeUnDiag_C "Fehlerentprellzeit fuer Fehlerpfad Dfp_RailCtlModeMeUnDiag" VALUE 0xF669E Kw_Wu16 655350.0 Time_ms 0.00 655350.0 FORMAT "%8.1" /end CHARACTERISTIC
/begin CHARACTERISTIC Rail_tiDebOkMeUnDiag_C "Heilungsentprellzeit fuer Fehlerpfad Dfp_RailCtlModeMeUnDiag" VALUE 0xF66A0 Kw_Wu16 655350.0 Time_ms 0.00 655350.0 FORMAT "%8.1" /end CHARACTERISTIC
/begin CHARACTERISTIC Rail_tiDebDefPCVDiag_C "Fehlerentprellzeit fuer Fehlerpfad Dfp_RailCtlModePCVDiag" VALUE 0xF66A2 Kw_Wu16 655350.0 Time_ms 0.00 655350.0 FORMAT "%8.1" /end CHARACTERISTIC
/begin CHARACTERISTIC Rail_tiDebOkPCVDiag_C "Heilungsentprellzeit fuer Fehlerpfad Dfp_RailCtlModePCVDiag" VALUE 0xF66A4 Kw_Wu16 655350.0 Time_ms 0.00 655350.0 FORMAT "%8.1" /end CHARACTERISTIC
/begin CHARACTERISTIC Rail_tiDeflate_C "Maximale Zeit für die Entlüftung des Niederdruckkreises" VALUE 0xF66C2 Kw_Wu16 655350.0 Time_ms 0.00 655350.0 FORMAT "%8.1" /end CHARACTERISTIC
/begin CHARACTERISTIC Rail_tiFrzIDel_C "Verzögerungszeit zum Einfrieren des I-Anteils für den Druckregler über Zumesseinheit" VALUE 0xF6A3C Kw_Wu16 1000.000 Time_ms 0.00 1000.000 FORMAT "%8.3" EXTENDED_LIMITS 0.00 655350.0 /end CHARACTERISTIC
/begin CHARACTERISTIC Rail_tiMeUnCtlDT1_CUR "Zeitkonstante des DT1-Gliedes (Druckregelung über Zumesseinheit)" CURVE 0xF687C Kl_Xs16_Ws16 16.776216 TimeDelay_s_2 0.0010000129 16.777216 FORMAT "%9.6" EXTENDED_LIMITS 0.00051201563 16.777216
 /begin AXIS_DESCR STD_AXIS Eng_nAvrg EngN 5 0.00 6000.000 FORMAT "%8.3" EXTENDED_LIMITS -32768.00 32767.00 DEPOSIT ABSOLUTE /end AXIS_DESCR
/end CHARACTERISTIC
/begin CHARACTERISTIC Rail_tiMeUnCtlPT1_CUR "Zeitkonstante des PT1-Filters (Druckregelung über Zumesseinheit)" CURVE 0xF6892 Kl_Xs16_Ws16 16.776216 TimeDelay_s_2 0.0010000129 16.777216 FORMAT "%9.6" EXTENDED_LIMITS 0.00051201563 16.777216
 /begin AXIS_DESCR STD_AXIS Eng_nAvrg EngN 8 0.00 6000.000 FORMAT "%8.3" EXTENDED_LIMITS -32768.00 32767.00 DEPOSIT ABSOLUTE /end AXIS_DESCR
/end CHARACTERISTIC
/begin CHARACTERISTIC Rail_tiMeUnRmpDur_CUR "Laufzeit der Rampe um das Fördervolumen der Zumesseinheit vom aktuellen Sollwert auf die Maximalförderung zu rampen" CURVE 0xF66C4 Kl_Xs16_Ws16 655350.0 Time_ms -327680.0 327670.0 FORMAT "%8.1"
 /begin AXIS_DESCR STD_AXIS Eng_nAvrg EngN 8 0.00 6000.000 FORMAT "%8.3" EXTENDED_LIMITS -32768.00 32767.00 DEPOSIT ABSOLUTE /end AXIS_DESCR
/end CHARACTERISTIC
/begin CHARACTERISTIC Rail_tiPCVCtlDT1_CUR "Zeitkonstante des DT1-Gliedes für die Druckregelung über Druckregelventil" CURVE 0xF6A14 Kl_Xs16_Ws16 16.776216 TimeDelay_s_2 0.0010000129 16.777216 FORMAT "%9.6" EXTENDED_LIMITS 0.00051201563 16.777216
 /begin AXIS_DESCR STD_AXIS Eng_nAvrg EngN 5 0.00 6000.000 FORMAT "%8.3" EXTENDED_LIMITS -32768.00 32767.00 DEPOSIT ABSOLUTE /end AXIS_DESCR
/end CHARACTERISTIC
/begin CHARACTERISTIC Rail_tiPT1CPCDvt_C "Verzögerungszeitkonstante für die Regelabweichung des Volumenstroms" VALUE 0xF6688 Kw_Wu32 1073.7408 TimeDelay_s 0.0010000001 1073.7418 FORMAT "%9.4" EXTENDED_LIMITS 0.0000010000000 4294.9673 /end CHARACTERISTIC
/begin CHARACTERISTIC Rail_tiSwtCPCMax_C "maximale Verweildauer eines Zustandes für die CPC-Regelung" VALUE 0xF668C Kw_Wu16 655350.0 Time_ms 0.00 655350.0 FORMAT "%8.1" /end CHARACTERISTIC
/begin CHARACTERISTIC Rail_tiSwtCtlTypeDel_C "Verzögerungszeit bis zur Freigabe der Umschaltung des Regelprinzips" VALUE 0xF6B82 Kw_Wu16 655350.0 Time_ms 0.00 655350.0 FORMAT "%8.1" /end CHARACTERISTIC
/begin CHARACTERISTIC Rail_tMeUnCtlTypeHi_C "obere Temperaturhystereseschwelle zur Verriegelung der PCV-Regelung" VALUE 0xF6B84 Kw_Ws16 250.0000 Temp_Cels -50.14000 199.8600 FORMAT "%8.4" EXTENDED_LIMITS -3549.940 3003.560 /end CHARACTERISTIC
/begin CHARACTERISTIC Rail_tMeUnCtlTypeLo_C "untere Temperaturhystereseschwelle für die Verriegelung der PCV-Regelung" VALUE 0xF6B86 Kw_Ws16 250.0000 Temp_Cels -50.14000 199.8600 FORMAT "%8.4" EXTENDED_LIMITS -3549.940 3003.560 /end CHARACTERISTIC
/begin CHARACTERISTIC Rail_tSwtCPCHi_C "obere Temperaturhystereseschwelle zur Verriegelung der PCV-Regelung" VALUE 0xF6B88 Kw_Ws16 250.0000 Temp_Cels -50.14000 199.8600 FORMAT "%8.4" EXTENDED_LIMITS -3549.940 3003.560 /end CHARACTERISTIC
/begin CHARACTERISTIC Rail_tSwtCPCLo_C "untere Temperaturhystereseschwelle zur Verriegelung der PCV-Regelung" VALUE 0xF6B8A Kw_Ws16 250.0000 Temp_Cels -50.14000 199.8600 FORMAT "%8.4" EXTENDED_LIMITS -3549.940 3003.560 /end CHARACTERISTIC
/begin MEASUREMENT PFlt_ctEngPrtRgnB1_mp "Maschinenschutz-Regenerationskostenzähler für Bank1" UWORD OneToOne 1 100 0.00 65535.00 FORMAT "%8.2" ECU_ADDRESS 0x8FF234 /end MEASUREMENT
/begin MEASUREMENT PFlt_ctEngPrtRgnB2_mp "Maschinenschutz-Regenerationskostenzähler für Bank2" UWORD OneToOne 1 100 0.00 65535.00 FORMAT "%8.2" ECU_ADDRESS 0x8FF236 /end MEASUREMENT
/begin MEASUREMENT PFlt_ctRgnStep1_mp "Regenerationsschritt 1" UBYTE OneToOne 1 100 0.00 255.0 FORMAT "%5.1" ECU_ADDRESS 0x6F82E6 /end MEASUREMENT
/begin MEASUREMENT PFlt_ctRgnStep2_mp "Regenerationsschritt 2" UBYTE OneToOne 1 100 0.00 255.0 FORMAT "%5.1" ECU_ADDRESS 0x6F82E7 /end MEASUREMENT
/begin MEASUREMENT PFlt_ctRgnStep3_mp "Regenerationsschritt 3" UBYTE OneToOne 1 100 0.00 255.0 FORMAT "%5.1" ECU_ADDRESS 0x6F82E8 /end MEASUREMENT
/begin MEASUREMENT PFlt_ctRgnStep4_mp "Regenerationsschritt 4" UBYTE OneToOne 1 100 0.00 255.0 FORMAT "%5.1" ECU_ADDRESS 0x6F82E9 /end MEASUREMENT
/begin MEASUREMENT PFlt_ctRgnStep5_mp "Regenerationsschritt 5" UBYTE OneToOne 1 100 0.00 255.0 FORMAT "%5.1" ECU_ADDRESS 0x6F82EA /end MEASUREMENT
/begin MEASUREMENT PFlt_ctRgnStep6_mp "Regenerationsschritt 6" UBYTE OneToOne 1 100 0.00 255.0 FORMAT "%5.1" ECU_ADDRESS 0x6F82EB /end MEASUREMENT
/begin MEASUREMENT PFlt_ctRgnStep7_mp "Regenerationsschritt 1" UBYTE OneToOne 1 100 0.00 255.0 FORMAT "%5.1" ECU_ADDRESS 0x6F82EC /end MEASUREMENT
/begin MEASUREMENT PFlt_ctRgnStep8_mp "Regenerationsschritt 8" UBYTE OneToOne 1 100 0.00 255.0 FORMAT "%5.1" ECU_ADDRESS 0x6F82ED /end MEASUREMENT
/begin MEASUREMENT PFlt_ctRgnSum_mp "Summe Regenerationschritte 1 bis 8" UWORD OneToOne 1 100 0.00 65535.00 FORMAT "%8.2" ECU_ADDRESS 0x8FF238 /end MEASUREMENT
/begin MEASUREMENT PFlt_ddvolFltB1_mp "Änderung Abgasvolumenstrom für Bank1" SWORD CubMtrPerHrPerSec 1 100 -3276.800 3276.700 FORMAT "%8.3" ECU_ADDRESS 0x8FF2B8 /end MEASUREMENT
/begin MEASUREMENT PFlt_ddvolFltB2_mp "Änderung Abgasvolumenstrom für Bank2" SWORD CubMtrPerHrPerSec 1 100 -3276.800 3276.700 FORMAT "%8.3" ECU_ADDRESS 0x8FF2BA /end MEASUREMENT
/begin MEASUREMENT PFlt_dmEG_mp "Abgasmassenstrom" SWORD AirMassPerTime 1 100 -3276.800 3276.700 FORMAT "%8.3" ECU_ADDRESS 0x8FF2F8 /end MEASUREMENT
/begin MEASUREMENT PFlt_dpDiffFltB1_mp "Änderung Druckdifferenz für Bank1" SWORD hPaPerSec 1 100 -3276.800 3276.700 FORMAT "%8.3" ECU_ADDRESS 0x8FF2BC /end MEASUREMENT
/begin MEASUREMENT PFlt_dpDiffFltB2_mp "Änderung Druckdifferenz für Bank2" SWORD hPaPerSec 1 100 -3276.800 3276.700 FORMAT "%8.3" ECU_ADDRESS 0x8FF2BE /end MEASUREMENT
/begin MEASUREMENT PFlt_dpDiffNegDef_mp "Untere Schwelle Änderung Differenzdrucksignal" SWORD hPaPerSec 1 100 -3276.800 3276.700 FORMAT "%8.3" ECU_ADDRESS 0x8FF2C0 /end MEASUREMENT
/begin MEASUREMENT PFlt_dpDiffPosDef_mp "Obere Schwelle Änderung Differenzdrucksignal" SWORD hPaPerSec 1 100 -3276.800 3276.700 FORMAT "%8.3" ECU_ADDRESS 0x8FF2C2 /end MEASUREMENT
/begin MEASUREMENT PFlt_dvolFltB1_mp "gefilterter Abgasvolumenstrom für Bank1" SWORD CubMtrPerHr 1 100 -3276.800 3276.700 FORMAT "%8.3" ECU_ADDRESS 0x8FF2C4 /end MEASUREMENT
/begin MEASUREMENT PFlt_dvolFltB2_mp "gefilterter Abgasvolumenstrom für Bank2" SWORD CubMtrPerHr 1 100 -3276.800 3276.700 FORMAT "%8.3" ECU_ADDRESS 0x8FF2C6 /end MEASUREMENT
/begin MEASUREMENT PFlt_dVolMapIn_mp "Copy der Message PFlt_dvol% für Ansicht des korrekten Prozesspunktes während des Testens" SWORD CubMtrPerHr 1 100 -3276.800 3276.700 FORMAT "%8.3" ECU_ADDRESS 0x8FF23A /end MEASUREMENT
/begin MEASUREMENT PFlt_facDpn_mp "Wärmeverlustfaktor nach Temperatursensor" SWORD Fact 1 100 -4.000000 3.999878 FORMAT "%8.6" ECU_ADDRESS 0x8FF2FA /end MEASUREMENT
/begin MEASUREMENT PFlt_facNO2RgnMapIn_mp "" SWORD Fact 1 100 -4.000000 3.999878 FORMAT "%8.6" ECU_ADDRESS 0x8FF23C /end MEASUREMENT
/begin MEASUREMENT PFlt_lAvrgRgn "Mittlere Strecke der Regeneration in Kilometer" UWORD LengthKm 1 100 0.00 65535.00 FORMAT "%8.2" ECU_ADDRESS 0x7F9192 /end MEASUREMENT
/begin MEASUREMENT PFlt_mAshOilMapIn_mp "Copy der Message PFlt_mAshOil% für Ansicht des korrekten Prozesspunktes während des Testens" SWORD mSoot_g 1 100 -327.6800 327.6700 FORMAT "%8.4" ECU_ADDRESS 0x8FF23E /end MEASUREMENT
/begin MEASUREMENT PFlt_mSotSimMapIn_mp "Copy der Message PFlt_mSotSim% für Ansicht des korrekten Prozesspunktes während des Testens" SWORD mSoot_g 1 100 -327.6800 327.6700 FORMAT "%8.4" ECU_ADDRESS 0x8FF240 /end MEASUREMENT
/begin MEASUREMENT PFlt_pAPSBPSDiff_mp "absoluter Wertunterschied zwischen APSCD_pVal und BPSCD_pLin" SWORD Pres_hPa 1 100 -32768.00 32767.00 FORMAT "%8.2" ECU_ADDRESS 0x8FF242 /end MEASUREMENT
/begin MEASUREMENT PFlt_pAPSDvt_mp "Abweichung von APSCD_pVal bezüglich Mittelwert von BPSCD_pLin und korrigiertem PFlt_pPre" SWORD Pres_hPa 1 100 -32768.00 32767.00 FORMAT "%8.2" ECU_ADDRESS 0x8FF244 /end MEASUREMENT
/begin MEASUREMENT PFlt_pAPSPFltPresDiff_mp "absoluter Wertunterschied zwischen APSCD_pVal und korrigiertem PFlt_pPre" SWORD Pres_hPa 1 100 -32768.00 32767.00 FORMAT "%8.2" ECU_ADDRESS 0x8FF246 /end MEASUREMENT
/begin MEASUREMENT PFlt_pBPSDvt_mp "Abweichung von BPSCD_pLin bezüglich Mittelwert von APSCD_pVal und korrigiertem PFlt_pPre" SWORD Pres_hPa 1 100 -32768.00 32767.00 FORMAT "%8.2" ECU_ADDRESS 0x8FF248 /end MEASUREMENT
/begin MEASUREMENT PFlt_pBPSPFltPresDiff_mp "absoluter Wertunterschied zwischen BPSCD_pLin und korrigiertem PFlt_pPre" SWORD Pres_hPa 1 100 -32768.00 32767.00 FORMAT "%8.2" ECU_ADDRESS 0x8FF24A /end MEASUREMENT
/begin MEASUREMENT PFlt_pDiff "Differenzdruck über Partikelfilter" SWORD Pres_hPa 1 100 -32768.00 32767.00 FORMAT "%8.2" ECU_ADDRESS 0x7F91C0 /end MEASUREMENT
/begin MEASUREMENT PFlt_pDiffB1 "Differenzdruck über Partikelfilter für Bank1" SWORD Pres_hPa 1 100 -32768.00 32767.00 FORMAT "%8.2" ECU_ADDRESS 0x7F91C2 /end MEASUREMENT
/begin MEASUREMENT PFlt_pDiffB2 "Differenzdruck über Partikelfilter für Bank2" SWORD Pres_hPa 1 100 -32768.00 32767.00 FORMAT "%8.2" ECU_ADDRESS 0x7F91C4 /end MEASUREMENT
/begin MEASUREMENT PFlt_pDiffFltB1_mp "gefilterte Druckdifferenz über Partikelfilter für Bank1" SWORD Pres_hPa 1 100 -32768.00 32767.00 FORMAT "%8.2" ECU_ADDRESS 0x8FF2C8 /end MEASUREMENT
/begin MEASUREMENT PFlt_pDiffFltB2_mp "gefilterte Druckdifferenz über Partikelfilter für Bank2" SWORD Pres_hPa 1 100 -32768.00 32767.00 FORMAT "%8.2" ECU_ADDRESS 0x8FF2CA /end MEASUREMENT
/begin MEASUREMENT PFlt_pDiffOfsValActB1_mp "Aktueller Offset des Differenzdrucks über Partikelfilter für Bank1" SWORD Pres_hPa 1 100 -32768.00 32767.00 FORMAT "%8.2" ECU_ADDRESS 0x8FF2CC /end MEASUREMENT
/begin MEASUREMENT PFlt_pDiffOfsValActB2_mp "Aktueller Offset des Differenzdrucks über Partikelfilter für Bank2" SWORD Pres_hPa 1 100 -32768.00 32767.00 FORMAT "%8.2" ECU_ADDRESS 0x8FF2CE /end MEASUREMENT
/begin MEASUREMENT PFlt_pDiffOfsValActMidB1_mp "Im Nachlauf gemittelter offset des Differenzdrucks[hpa] für Bank1" SWORD Pres_hPa 1 100 -32768.00 32767.00 FORMAT "%8.2" ECU_ADDRESS 0x8FF2D0 /end MEASUREMENT
/begin MEASUREMENT PFlt_pDiffOfsValActMidB2_mp "Im Nachlauf gemittelter offset des Differenzdrucks[hpa] für Bank2" SWORD Pres_hPa 1 100 -32768.00 32767.00 FORMAT "%8.2" ECU_ADDRESS 0x8FF2D2 /end MEASUREMENT
/begin MEASUREMENT PFlt_pDiffOfsValActSensB1_mp "Offset des Differenzdrucks über Partikelfilter für Bank1 aus EEPROM" SWORD Pres_hPa 1 100 -32768.00 32767.00 FORMAT "%8.2" ECU_ADDRESS 0x8FF2F0 /end MEASUREMENT
/begin MEASUREMENT PFlt_pDiffOfsValActSensB2_mp "Offset des Differenzdrucks über Partikelfilter für Bank2 aus EEPROM" SWORD Pres_hPa 1 100 -32768.00 32767.00 FORMAT "%8.2" ECU_ADDRESS 0x8FF2F2 /end MEASUREMENT
/begin MEASUREMENT PFlt_pDiffOfsValOldB1_mp "Bisheriger Offset des Differenzdrucks über Partikelfilter für Bank1" SWORD Pres_hPa 1 100 -32768.00 32767.00 FORMAT "%8.2" ECU_ADDRESS 0x8FF2D4 /end MEASUREMENT
/begin MEASUREMENT PFlt_pDiffOfsValOldB2_mp "Bisheriger Offset des Differenzdrucks über Partikelfilter für Bank2" SWORD Pres_hPa 1 100 -32768.00 32767.00 FORMAT "%8.2" ECU_ADDRESS 0x8FF2D6 /end MEASUREMENT
/begin MEASUREMENT PFlt_pDiffRawB1 "Unkorrigierter Differenzdruck über Partikelfilter für Bank1" SWORD Pres_hPa 1 100 -32768.00 32767.00 FORMAT "%8.2" ECU_ADDRESS 0x7F91C6 /end MEASUREMENT
/begin MEASUREMENT PFlt_pDiffRawB2 "Unkorrigierter Differenzdruck über Partikelfilter für Bank2" SWORD Pres_hPa 1 100 -32768.00 32767.00 FORMAT "%8.2" ECU_ADDRESS 0x7F91C8 /end MEASUREMENT
/begin MEASUREMENT PFlt_pMidB1 "Absolutdruck im Partikelfilter Bank1" SWORD Pres_hPa 1 100 -32768.00 32767.00 FORMAT "%8.2" ECU_ADDRESS 0x7F91CE /end MEASUREMENT
/begin MEASUREMENT PFlt_pMidB2 "Absolutdruck im Partikelfilter Bank2" SWORD Pres_hPa 1 100 -32768.00 32767.00 FORMAT "%8.2" ECU_ADDRESS 0x7F91D0 /end MEASUREMENT
/begin MEASUREMENT PFlt_pPFltB1B2Diff_mp "absoluter Wertunterschied zwischen PFlt_pPreCorrB1_mp und PFlt_pPreCorrB2_mp" SWORD Pres_hPa 1 100 -32768.00 32767.00 FORMAT "%8.2" ECU_ADDRESS 0x8FF24C /end MEASUREMENT
/begin MEASUREMENT PFlt_pPFltOvldLckRgnB1_mp "Druckschwelle Überladungserkennung für Bank1" SWORD Pres_hPa 1 100 -32768.00 32767.00 FORMAT "%8.2" ECU_ADDRESS 0x8FF24E /end MEASUREMENT
/begin MEASUREMENT PFlt_pPFltOvldLckRgnB2_mp "Druckschwelle Überladungserkennung für Bank2" SWORD Pres_hPa 1 100 -32768.00 32767.00 FORMAT "%8.2" ECU_ADDRESS 0x8FF250 /end MEASUREMENT
/begin MEASUREMENT PFlt_pPFltOvldTrqLimB1_mp "Druckschwelle Überladungserkennung für Bank1" SWORD Pres_hPa 1 100 -32768.00 32767.00 FORMAT "%8.2" ECU_ADDRESS 0x8FF252 /end MEASUREMENT
/begin MEASUREMENT PFlt_pPFltOvldTrqLimB2_mp "Druckschwelle Überladungserkennung für Bank2" SWORD Pres_hPa 1 100 -32768.00 32767.00 FORMAT "%8.2" ECU_ADDRESS 0x8FF254 /end MEASUREMENT
/begin MEASUREMENT PFlt_pPFltPresDvtB1_mp "Abweichung des korrigierten PFlt_pPre bezüglich Mittelwert von APSCD_pVal und BPSCD_pLin für Bank1" SWORD Pres_hPa 1 100 -32768.00 32767.00 FORMAT "%8.2" ECU_ADDRESS 0x8FF256 /end MEASUREMENT
/begin MEASUREMENT PFlt_pPFltPresDvtB2_mp "Abweichung des korrigierten PFlt_pPre bezüglich Mittelwert von APSCD_pVal und BPSCD_pLin für Bank2" SWORD Pres_hPa 1 100 -32768.00 32767.00 FORMAT "%8.2" ECU_ADDRESS 0x8FF258 /end MEASUREMENT
/begin MEASUREMENT PFlt_pPre "Druck vor Partikelfilter" SWORD Pres_hPa 1 100 -32768.00 32767.00 FORMAT "%8.2" ECU_ADDRESS 0x7F91D2 /end MEASUREMENT
/begin MEASUREMENT PFlt_pPreAshOilCorrB1_mp "Ausgang des PFlt_pPre-Korrekturkennfelds mit den Eingängen PFlt_dvol und PFlt_mAshOil für Bank1" SWORD Pres_hPa 1 100 -32768.00 32767.00 FORMAT "%8.2" ECU_ADDRESS 0x8FF25A /end MEASUREMENT
/begin MEASUREMENT PFlt_pPreAshOilCorrB2_mp "Ausgang des PFlt_pPre-Korrekturkennfelds mit den Eingängen PFlt_dvol und PFlt_mAshOil für Bank2" SWORD Pres_hPa 1 100 -32768.00 32767.00 FORMAT "%8.2" ECU_ADDRESS 0x8FF25C /end MEASUREMENT
/begin MEASUREMENT PFlt_pPreB1 "Druck vor Partikelfilter für Bank1" SWORD Pres_hPa 1 100 -32768.00 32767.00 FORMAT "%8.2" ECU_ADDRESS 0x7F91D4 /end MEASUREMENT
/begin MEASUREMENT PFlt_pPreB2 "Druck vor Partikelfilter für Bank2" SWORD Pres_hPa 1 100 -32768.00 32767.00 FORMAT "%8.2" ECU_ADDRESS 0x7F91D6 /end MEASUREMENT
/begin MEASUREMENT PFlt_pPreCorrB1_mp "korrigierter Wert von PFlt_pPre zur Nutzung durch projektspezifische Druck-Plausibilitätsprüfungen für Bank1" SWORD Pres_hPa 1 100 -32768.00 32767.00 FORMAT "%8.2" ECU_ADDRESS 0x6F82EE /end MEASUREMENT
/begin MEASUREMENT PFlt_pPreCorrB2_mp "korrigierter Wert von PFlt_pPre zur Nutzung durch projektspezifische Druck-Plausibilitätsprüfungen für Bank2" SWORD Pres_hPa 1 100 -32768.00 32767.00 FORMAT "%8.2" ECU_ADDRESS 0x6F82F0 /end MEASUREMENT
/begin MEASUREMENT PFlt_pPreFlt "gefilterter Absolutdruck vor Partikelfilter" SWORD Pres_hPa 1 100 -32768.00 32767.00 FORMAT "%8.2" ECU_ADDRESS 0x7F91D8 /end MEASUREMENT
/begin MEASUREMENT PFlt_pPreFltB1 "gefilterter Absolutdruck vor Partikelfilter Bank1" SWORD Pres_hPa 1 100 -32768.00 32767.00 FORMAT "%8.2" ECU_ADDRESS 0x7F91DA /end MEASUREMENT
/begin MEASUREMENT PFlt_pPreFltB2 "gefilterter Absolutdruck vor Partikelfilter Bank2" SWORD Pres_hPa 1 100 -32768.00 32767.00 FORMAT "%8.2" ECU_ADDRESS 0x7F91DC /end MEASUREMENT
/begin MEASUREMENT PFlt_pPreIntB1 "Modulinterner Druck vor Partikelfilter Bank1 nach Plausibilitätstest" SWORD Pres_hPa 1 100 -32768.00 32767.00 FORMAT "%8.2" ECU_ADDRESS 0x7F91DE /end MEASUREMENT
/begin MEASUREMENT PFlt_pPreIntB2 "Modulinterner Druck vor Partikelfilter Bank2 nach Plausibilitätstest" SWORD Pres_hPa 1 100 -32768.00 32767.00 FORMAT "%8.2" ECU_ADDRESS 0x7F91E0 /end MEASUREMENT
/begin MEASUREMENT PFlt_pPreSotAshCorrSumB1_mp "Summe aus PFlt_pPreSotSimCorrB1_mp und  PFlt_pPreAshOilCorrB1_mp" SWORD Pres_hPa 1 100 -32768.00 32767.00 FORMAT "%8.2" ECU_ADDRESS 0x8FF25E /end MEASUREMENT
/begin MEASUREMENT PFlt_pPreSotAshCorrSumB2_mp "Summe aus PFlt_pPreSotSimCorrB2_mp und  PFlt_pPreAshOilCorrB2_mp" SWORD Pres_hPa 1 100 -32768.00 32767.00 FORMAT "%8.2" ECU_ADDRESS 0x8FF260 /end MEASUREMENT
/begin MEASUREMENT PFlt_pPreSotSimCorrB1_mp "Ausgang des PFlt_pPre Korrekturkennfelds mit den Eingängen PFlt_dvol und PFlt_mSotSim für Bank1" SWORD Pres_hPa 1 100 -32768.00 32767.00 FORMAT "%8.2" ECU_ADDRESS 0x8FF262 /end MEASUREMENT
/begin MEASUREMENT PFlt_pPreSotSimCorrB2_mp "Ausgang des PFlt_pPre Korrekturkennfelds mit den Eingängen PFlt_dvol und PFlt_mSotSim für Bank2" SWORD Pres_hPa 1 100 -32768.00 32767.00 FORMAT "%8.2" ECU_ADDRESS 0x8FF264 /end MEASUREMENT
/begin MEASUREMENT PFlt_pPreVolCorrB1_mp "Ausgang der PFlt_pPre Korrekturkennlinie mit den Eingängen PFlt_dvol und PFlt_dvol für Bank1" SWORD Pres_hPa 1 100 -32768.00 32767.00 FORMAT "%8.2" ECU_ADDRESS 0x8FF266 /end MEASUREMENT
/begin MEASUREMENT PFlt_pPreVolCorrB2_mp "Ausgang der PFlt_pPre Korrekturkennlinie mit den Eingängen PFlt_dvol und PFlt_dvol für Bank2" SWORD Pres_hPa 1 100 -32768.00 32767.00 FORMAT "%8.2" ECU_ADDRESS 0x8FF268 /end MEASUREMENT
/begin MEASUREMENT PFlt_qPoI2NonEff_mp "nicht wirksame Einspritzmenge der PoI2 mg/zycl" SWORD InjMassCyc 1 100 -327.6800 327.6700 FORMAT "%8.4" ECU_ADDRESS 0x8FF2FC /end MEASUREMENT
/begin MEASUREMENT PFlt_rEngPrtRgnB1_mp "Motorschutz-Regenerationsverhältnis der Aufgabe Zeit und des letzten Regenerationsmales fuer Bank1" SWORD Prc 1 100 -400.0000 399.9878 FORMAT "%8.4" ECU_ADDRESS 0x8FF26A /end MEASUREMENT
/begin MEASUREMENT PFlt_rEngPrtRgnB2_mp "Motorschutz-Regenerationsverhältnis der Aufgabe Zeit und des letzten Regenerationsmales für Bank2" SWORD Prc 1 100 -400.0000 399.9878 FORMAT "%8.4" ECU_ADDRESS 0x8FF26C /end MEASUREMENT
/begin MEASUREMENT PFlt_resFlowOvldLckRgnB1_mp "" SWORD Res_hPaHrPerCM 1 100 -32.76800 32.76700 FORMAT "%8.5" ECU_ADDRESS 0x8FF26E /end MEASUREMENT
/begin MEASUREMENT PFlt_resFlowOvldLckRgnB2_mp "" SWORD Res_hPaHrPerCM 1 100 -32.76800 32.76700 FORMAT "%8.5" ECU_ADDRESS 0x8FF270 /end MEASUREMENT
/begin MEASUREMENT PFlt_resFlowOvldTrqLimB1_mp "" SWORD Res_hPaHrPerCM 1 100 -32.76800 32.76700 FORMAT "%8.5" ECU_ADDRESS 0x8FF272 /end MEASUREMENT
/begin MEASUREMENT PFlt_resFlowOvldTrqLimB2_mp "" SWORD Res_hPaHrPerCM 1 100 -32.76800 32.76700 FORMAT "%8.5" ECU_ADDRESS 0x8FF274 /end MEASUREMENT
/begin MEASUREMENT PFlt_stAftRunDelDem "Nachlaufverzögerung für Partikelfiltermonitor" UBYTE OneToOne 1 100 0.00 255.0 FORMAT "%5.1" ECU_ADDRESS 0x7F89DE /end MEASUREMENT
/begin MEASUREMENT PFlt_stAftRunDelDemB1 "Nachlaufverzögerung für Partikelfiltermonitor für Bank1" UBYTE OneToOne 1 100 0.00 255.0 FORMAT "%5.1" ECU_ADDRESS 0x7F89DF /end MEASUREMENT
/begin MEASUREMENT PFlt_stAftRunDelDemB2 "Nachlaufverzögerung für Partikelfiltermonitor für Bank2" UBYTE OneToOne 1 100 0.00 255.0 FORMAT "%5.1" ECU_ADDRESS 0x7F89E0 /end MEASUREMENT
/begin MEASUREMENT PFlt_stAPSPlausDefHigh_mp "APSCD_pVal Abweichung ist positiv und fehlerhaft" UBYTE OneToOne 1 100 0.00 255.0 FORMAT "%5.1" ECU_ADDRESS 0x8FF276 /end MEASUREMENT
/begin MEASUREMENT PFlt_stAPSPlausDefLow_mp "APSCD_pVal Abweichung ist negativ und fehlerhaft" UBYTE OneToOne 1 100 0.00 255.0 FORMAT "%5.1" ECU_ADDRESS 0x8FF277 /end MEASUREMENT
/begin MEASUREMENT PFlt_stBPSPlausDefHigh_mp "BPSCD_pLin Abweichung ist positiv und fehlerhaft" UBYTE OneToOne 1 100 0.00 255.0 FORMAT "%5.1" ECU_ADDRESS 0x8FF278 /end MEASUREMENT
/begin MEASUREMENT PFlt_stBPSPlausDefLow_mp "BPSCD_pLin Abweichung ist negativ und fehlerhaft" UBYTE OneToOne 1 100 0.00 255.0 FORMAT "%5.1" ECU_ADDRESS 0x8FF279 /end MEASUREMENT
/begin MEASUREMENT PFlt_stEngPrtRgnB1_mp "Status der Motorschutzregeneration für Bank1" UWORD OneToOne 1 100 0.00 65535.00 FORMAT "%8.2" ECU_ADDRESS 0x8FF27A /end MEASUREMENT
/begin MEASUREMENT PFlt_stEngPrtRgnB2_mp "Status der Motorschutzregeneration für Bank2" UWORD OneToOne 1 100 0.00 65535.00 FORMAT "%8.2" ECU_ADDRESS 0x8FF27C /end MEASUREMENT
/begin MEASUREMENT PFlt_stLckTempPlaus_mp "Verriegelungsstatus Plausibilisierung Temperatursensoren" UBYTE OneToOne 1 100 0.00 255.0 FORMAT "%5.1" ECU_ADDRESS 0x8FF2D8 /end MEASUREMENT
/begin MEASUREMENT PFlt_stLckTmr_mp "Verriegelung Timer Temperaturplausibilisierung" UBYTE OneToOne 1 100 0.00 255.0 FORMAT "%5.1" ECU_ADDRESS 0x8FF2D9 /end MEASUREMENT
/begin MEASUREMENT PFlt_stPresDiffPlausB1_mp "Zustand Plausibilisierung Differenzdrucksignal für Bank1" UBYTE OneToOne 1 100 0.00 255.0 FORMAT "%5.1" ECU_ADDRESS 0x8FF2DA /end MEASUREMENT
/begin MEASUREMENT PFlt_stPresDiffPlausB2_mp "Zustand Plausibilisierung Differenzdrucksignal für Bank2" UBYTE OneToOne 1 100 0.00 255.0 FORMAT "%5.1" ECU_ADDRESS 0x8FF2DB /end MEASUREMENT
/begin MEASUREMENT PFlt_stPresPlausDefHighB1_mp "PFlt_pPreCorr_mp ist positiv und fehlerhaft für Bank1" UBYTE OneToOne 1 100 0.00 255.0 FORMAT "%5.1" ECU_ADDRESS 0x8FF27E /end MEASUREMENT
/begin MEASUREMENT PFlt_stPresPlausDefHighB2_mp "PFlt_pPreCorr_mp ist positiv und fehlerhaft für Bank2" UBYTE OneToOne 1 100 0.00 255.0 FORMAT "%5.1" ECU_ADDRESS 0x8FF27F /end MEASUREMENT
/begin MEASUREMENT PFlt_stPresPlausDefLowB1_mp "PFlt_pPreCorr_mp ist negativ und fehlerhaft für Bank1" UBYTE OneToOne 1 100 0.00 255.0 FORMAT "%5.1" ECU_ADDRESS 0x8FF280 /end MEASUREMENT
/begin MEASUREMENT PFlt_stPresPlausDefLowB2_mp "PFlt_pPreCorr_mp ist negativ und fehlerhaft für Bank2" UBYTE OneToOne 1 100 0.00 255.0 FORMAT "%5.1" ECU_ADDRESS 0x8FF281 /end MEASUREMENT
/begin MEASUREMENT PFlt_stPresPlausLoIdl_mp "Bit-kodierte Informationen, um projektspezifische Druck-Plausibilitätsprüfungen im niedrigen Leerlaufzustand zu ermöglichen" UBYTE OneToOne 1 100 0.00 255.0 FORMAT "%5.1" ECU_ADDRESS 0x8FF282 /end MEASUREMENT
/begin MEASUREMENT PFlt_stPresPlausOk_mp "Zur Anzeige, ob projektspezifische Druck-Plausibilitätsprüfungen in Ordnung sind" UBYTE OneToOne 1 100 0.00 255.0 FORMAT "%5.1" ECU_ADDRESS 0x8FF283 /end MEASUREMENT
/begin MEASUREMENT PFlt_stPresPlausTst_mp "Zustandsgröße zur Anzeige, ob projektspezifische Druck-Plausibilitätsprüfungen aktiv sind oder nicht" UBYTE OneToOne 1 100 0.00 255.0 FORMAT "%5.1" ECU_ADDRESS 0x8FF284 /end MEASUREMENT
/begin MEASUREMENT PFlt_stPresPlaus_mp "Bit-kodierte Informationen, um projektspezifische Druck-Plausibilitätsprüfungen zu ermöglichen" UBYTE OneToOne 1 100 0.00 255.0 FORMAT "%5.1" ECU_ADDRESS 0x6F82F2 /end MEASUREMENT
/begin MEASUREMENT PFlt_stResFlowHiB1_mp "Obere Schwelle Resflow-SRC überschritten für Bank1" UBYTE OneToOne 1 100 0.00 255.0 FORMAT "%5.1" ECU_ADDRESS 0x8FF2DC /end MEASUREMENT
/begin MEASUREMENT PFlt_stResFlowHiB2_mp "Obere Schwelle Resflow-SRC überschritten für Bank2" UBYTE OneToOne 1 100 0.00 255.0 FORMAT "%5.1" ECU_ADDRESS 0x8FF2DD /end MEASUREMENT
/begin MEASUREMENT PFlt_stResFlowLoB1_mp "Untere Schwelle ResFlow-SRC unterschritten für Bank1" UBYTE OneToOne 1 100 0.00 255.0 FORMAT "%5.1" ECU_ADDRESS 0x8FF2DE /end MEASUREMENT
/begin MEASUREMENT PFlt_stResFlowLoB2_mp "Untere Schwelle ResFlow-SRC unterschritten für Bank2" UBYTE OneToOne 1 100 0.00 255.0 FORMAT "%5.1" ECU_ADDRESS 0x8FF2DF /end MEASUREMENT
/begin MEASUREMENT PFlt_stRgnRlsOffB1_mp "Filter is no longer regeneratable for Bank1" UBYTE OneToOne 1 100 0.00 255.0 FORMAT "%5.1" ECU_ADDRESS 0x8FF285 /end MEASUREMENT
/begin MEASUREMENT PFlt_stRgnRlsOffB2_mp "Filter is no longer regeneratable for Bank2" UBYTE OneToOne 1 100 0.00 255.0 FORMAT "%5.1" ECU_ADDRESS 0x8FF286 /end MEASUREMENT
/begin MEASUREMENT PFlt_stRlsmSotCtlB1_mp "Status der Motorschutzregeneration für Freigabe der Rußsteuerung für Bank1" UBYTE OneToOne 1 100 0.00 255.0 FORMAT "%5.1" ECU_ADDRESS 0x8FF287 /end MEASUREMENT
/begin MEASUREMENT PFlt_stRlsmSotCtlB2_mp "Status der Motorschutzregeneration für Freigabe der Rußsteuerung für Bank2" UBYTE OneToOne 1 100 0.00 255.0 FORMAT "%5.1" ECU_ADDRESS 0x8FF288 /end MEASUREMENT
/begin MEASUREMENT PFlt_stTempPlausDoneB1_mp "Statusbit Plausibilisierung Temperatursensoren durchgeführt für Bank1" UBYTE OneToOne 1 100 0.00 255.0 FORMAT "%5.1" ECU_ADDRESS 0x8FF2E0 /end MEASUREMENT
/begin MEASUREMENT PFlt_stTempPlausDoneB2_mp "Statusbit Plausibilisierung Temperatursensoren durchgeführt für Bank2" UBYTE OneToOne 1 100 0.00 255.0 FORMAT "%5.1" ECU_ADDRESS 0x8FF2E1 /end MEASUREMENT
/begin MEASUREMENT PFlt_tDiffCorrB1_mp "Temperaturabweichung durch instationären Betrieb für Bank1" SWORD TempDiff_Cels 1 100 -3276.800 3276.700 FORMAT "%8.3" ECU_ADDRESS 0x8FF2FE /end MEASUREMENT
/begin MEASUREMENT PFlt_tDiffCorrB2_mp "Temperaturabweichung durch instationären Betrieb für Bank2" SWORD TempDiff_Cels 1 100 -3276.800 3276.700 FORMAT "%8.3" ECU_ADDRESS 0x8FF300 /end MEASUREMENT
/begin MEASUREMENT PFlt_tDiffCorr_mp "Temperaturabweichung durch instationären Betrieb" SWORD TempDiff_Cels 1 100 -3276.800 3276.700 FORMAT "%8.3" ECU_ADDRESS 0x8FF302 /end MEASUREMENT
/begin MEASUREMENT PFlt_tDwnStrmB1_mp "Zweite Abgastemperatur zur Überwachung für Bank1" SWORD Temp_Cels 1 100 -50.140 899.860 FORMAT "%8.3" ECU_ADDRESS 0x8FF2E2 /end MEASUREMENT
/begin MEASUREMENT PFlt_tDwnStrmB2_mp "Zweite Abgastemperatur zur Überwachung für Bank2" SWORD Temp_Cels 1 100 -50.140 899.860 FORMAT "%8.3" ECU_ADDRESS 0x8FF2E4 /end MEASUREMENT
/begin MEASUREMENT PFlt_tExhGsStyRgn1_mp "Temperatur der statischen Rußemission für Regeneration 1" SWORD TempDiff_Cels 1 100 -3276.800 3276.700 FORMAT "%8.3" ECU_ADDRESS 0x8FF304 /end MEASUREMENT
/begin MEASUREMENT PFlt_tExhGsStyRgn2_mp "Static soot emission" SWORD TempDiff_Cels 1 100 -3276.800 3276.700 FORMAT "%8.3" ECU_ADDRESS 0x8FF306 /end MEASUREMENT
/begin MEASUREMENT PFlt_tHtTransCorB1_mp "Temperaturkorrekturwert Wärmeübergang für Bank1" SWORD TempDiff_Cels 1 100 -3276.800 3276.700 FORMAT "%8.3" ECU_ADDRESS 0x8FF308 /end MEASUREMENT
/begin MEASUREMENT PFlt_tHtTransCorB2_mp "Temperaturkorrekturwert Wärmeübergang für Bank2" SWORD TempDiff_Cels 1 100 -3276.800 3276.700 FORMAT "%8.3" ECU_ADDRESS 0x8FF30A /end MEASUREMENT
/begin MEASUREMENT PFlt_tIATLoLvl_mp "niedrigster Wert der Ansauglufttemperatur" SWORD Temp_Cels 1 100 -50.140 899.860 FORMAT "%8.3" ECU_ADDRESS 0x8FF2E6 /end MEASUREMENT
/begin MEASUREMENT PFlt_tiChkTmpPlaus_mp "Abgelaufene Zeit nach Motorstopp, wenn die EEPROM-Zähler noch nicht abgelaufen ist." UWORD Time_s 1 100 0.00 655.3500 FORMAT "%8.4" ECU_ADDRESS 0x8FF2E8 /end MEASUREMENT
/begin MEASUREMENT PFlt_tiExhGsDelB1_mp "Verzögerungszeit Abgas Bank1" SWORD TimeDelay_s_Lin_16_2 1 100 -2000.061 2000.000 FORMAT "%8.3" ECU_ADDRESS 0x8FF30C /end MEASUREMENT
/begin MEASUREMENT PFlt_tiExhGsDelB2_mp "Verzögerungszeit Abgas Bank2" SWORD TimeDelay_s_Lin_16_2 1 100 -2000.061 2000.000 FORMAT "%8.3" ECU_ADDRESS 0x8FF30E /end MEASUREMENT
/begin MEASUREMENT PFlt_tiHtTransDT1B1_mp "Wärmeübergangszeit für Bank1" SWORD TimeDelay_s_Lin_16_2 1 100 -2000.061 2000.000 FORMAT "%8.3" ECU_ADDRESS 0x8FF310 /end MEASUREMENT
/begin MEASUREMENT PFlt_tiHtTransDT1B2_mp "Wärmeübergangszeit für Bank2" SWORD TimeDelay_s_Lin_16_2 1 100 -2000.061 2000.000 FORMAT "%8.3" ECU_ADDRESS 0x8FF312 /end MEASUREMENT
/begin MEASUREMENT PFlt_tiOpOldB1_mp "Aus EEPROM gelesene Dauer des Motorschutzes bei der Initialisierung für Bank1" ULONG TimeEngOn 1 100 0.00 4294967295.00 FORMAT "%13.2" ECU_ADDRESS 0x8FF28C /end MEASUREMENT
/begin MEASUREMENT PFlt_tiOpOldB2_mp "Aus EEPROM gelesene Dauer des Motorschutzes bei der Initialisierung für Bank2" ULONG TimeEngOn 1 100 0.00 4294967295.00 FORMAT "%13.2" ECU_ADDRESS 0x8FF290 /end MEASUREMENT
/begin MEASUREMENT PFlt_tiSnceFstEngPrtRgnB1_mp "Zeit seit der ersten Motorschutz-Regeneration für Bank1" ULONG TimeEngOn 1 100 0.00 4294967295.00 FORMAT "%13.2" ECU_ADDRESS 0x8FF294 /end MEASUREMENT
/begin MEASUREMENT PFlt_tiSnceFstEngPrtRgnB2_mp "Zeit seit der ersten Motorschutz-Regeneration für Bank2" ULONG TimeEngOn 1 100 0.00 4294967295.00 FORMAT "%13.2" ECU_ADDRESS 0x8FF298 /end MEASUREMENT
/begin MEASUREMENT PFlt_tOxiPre "Temperatur vor Oxidationskatalysator" SWORD Temp_Cels 1 100 -50.140 899.860 FORMAT "%8.3" ECU_ADDRESS 0x7F9214 /end MEASUREMENT
/begin MEASUREMENT PFlt_tOxiPreB1 "Abgastemperatur vor Oxidationskatalysator auf Flut 1" SWORD Temp_Cels 1 100 -50.140 899.860 FORMAT "%8.3" ECU_ADDRESS 0x7F9216 /end MEASUREMENT
/begin MEASUREMENT PFlt_tOxiPreB2 "Abgastemperatur vor Oxidationskatalysator auf Flut 2" SWORD Temp_Cels 1 100 -50.140 899.860 FORMAT "%8.3" ECU_ADDRESS 0x7F9218 /end MEASUREMENT
/begin MEASUREMENT PFlt_tOxiPreDiffB1_mp "Differenztemperatur vor Oxicat für Bank 1" SWORD Temp_Cels 1 100 -50.140 899.860 FORMAT "%8.3" ECU_ADDRESS 0x8FF29C /end MEASUREMENT
/begin MEASUREMENT PFlt_tOxiPreDiffB2_mp "Differenztemperatur vor Oxicat für Bank 2" SWORD Temp_Cels 1 100 -50.140 899.860 FORMAT "%8.3" ECU_ADDRESS 0x8FF29E /end MEASUREMENT
/begin MEASUREMENT PFlt_tOxiPreDiffMax_mp "Maximaler Schwellwert für die Differenz zwischen Temperatur vor Partikelfilter und stationärer Temperatur für den Oxicat" SWORD Temp_Cels 1 100 -50.140 899.860 FORMAT "%8.3" ECU_ADDRESS 0x8FF2A0 /end MEASUREMENT
/begin MEASUREMENT PFlt_tOxiPreMaxB1_mp "Maximale Temperatur vor Partikelfilter für den Oxicat für Bank 1" SWORD Temp_Cels 1 100 -50.140 899.860 FORMAT "%8.3" ECU_ADDRESS 0x8FF2A2 /end MEASUREMENT
/begin MEASUREMENT PFlt_tOxiPreMaxB2_mp "Maximale Temperatur vor Partikelfilter für den Oxicat für Bank 2" SWORD Temp_Cels 1 100 -50.140 899.860 FORMAT "%8.3" ECU_ADDRESS 0x8FF2A4 /end MEASUREMENT
/begin MEASUREMENT PFlt_tOxiPreRaw_mp "Kennfeldberechnete Temperatur vor dem Oxi-Kat" SWORD Temp_Cels 1 100 -50.140 899.860 FORMAT "%8.3" ECU_ADDRESS 0x8FF314 /end MEASUREMENT
/begin MEASUREMENT PFlt_tOxiPreRgnMaxB1_mp "Maximaler Abgasgegendruck vor Oxicat im Regenerationsfall für Bank 1" SWORD Temp_Cels 1 100 -50.140 899.860 FORMAT "%8.3" ECU_ADDRESS 0x8FF2A6 /end MEASUREMENT
/begin MEASUREMENT PFlt_tOxiPreRgnMaxB2_mp "Maximaler Abgasgegendruck vor Oxicat im Regenerationsfall für Bank 2" SWORD Temp_Cels 1 100 -50.140 899.860 FORMAT "%8.3" ECU_ADDRESS 0x8FF2A8 /end MEASUREMENT
/begin MEASUREMENT PFlt_tOxiPreSty "Stationäre Temperatur vor Oxidationskatalysator" SWORD Temp_Cels 1 100 -50.140 899.860 FORMAT "%8.3" ECU_ADDRESS 0x7F921A /end MEASUREMENT
/begin MEASUREMENT PFlt_tOxiPstB1 "Temperatur nach dem Oxidations Katalysator Bank1" SWORD Temp_Cels 1 100 -50.140 899.860 FORMAT "%8.3" ECU_ADDRESS 0x7F921C /end MEASUREMENT
/begin MEASUREMENT PFlt_tOxiPstB2 "Temperatur nach dem Oxidations Katalysator Bank2" SWORD Temp_Cels 1 100 -50.140 899.860 FORMAT "%8.3" ECU_ADDRESS 0x7F921E /end MEASUREMENT
/begin MEASUREMENT PFlt_tPFltMon_mp "Motortemperatur aus Kennfeld" SWORD Temp_Cels 1 100 -50.140 899.860 FORMAT "%8.3" ECU_ADDRESS 0x8FF2EA /end MEASUREMENT
/begin MEASUREMENT PFlt_tPre "Abgastemp. vor Partikelfilter" SWORD Temp_Cels 1 100 -50.140 899.860 FORMAT "%8.3" ECU_ADDRESS 0x7F9220 /end MEASUREMENT
/begin MEASUREMENT PFlt_tPreB1 "Abgastemperatur vor Diesel Partikelfilter auf Flut 1" SWORD Temp_Cels 1 100 -50.140 899.860 FORMAT "%8.3" ECU_ADDRESS 0x7F9222 /end MEASUREMENT
/begin MEASUREMENT PFlt_tPreB2 "Abgastemperatur vor Diesel Partikelfilter auf Flut 2" SWORD Temp_Cels 1 100 -50.140 899.860 FORMAT "%8.3" ECU_ADDRESS 0x7F9224 /end MEASUREMENT
/begin MEASUREMENT PFlt_tPreCorrB1_mp "Korrigiertes Temperatursignal vor Partikelfilter Bank1" SWORD Temp_Cels 1 100 -50.140 899.860 FORMAT "%8.3" ECU_ADDRESS 0x8FF316 /end MEASUREMENT
/begin MEASUREMENT PFlt_tPreCorrB2_mp "Korrigiertes Temperatursignal vor Partikelfilter Bank2" SWORD Temp_Cels 1 100 -50.140 899.860 FORMAT "%8.3" ECU_ADDRESS 0x8FF318 /end MEASUREMENT
/begin MEASUREMENT PFlt_tPreDiffB1_mp "Differenztemperatur vor Partikelfilter für Bank 1" SWORD Temp_Cels 1 100 -50.140 899.860 FORMAT "%8.3" ECU_ADDRESS 0x8FF2AA /end MEASUREMENT
/begin MEASUREMENT PFlt_tPreDiffB2_mp "Differenztemperatur vor Partikelfilter für Bank 2" SWORD Temp_Cels 1 100 -50.140 899.860 FORMAT "%8.3" ECU_ADDRESS 0x8FF2AC /end MEASUREMENT
/begin MEASUREMENT PFlt_tPreDiffMax_mp "Maximaler Schwellwert für die Differenz zwischen Temperatur vor Partikelfilter und Stationärer Temperatur für Oxicat" SWORD Temp_Cels 1 100 -50.140 899.860 FORMAT "%8.3" ECU_ADDRESS 0x8FF2AE /end MEASUREMENT
/begin MEASUREMENT PFlt_tPreIntB1 "Modulinterner Druck vor Partikelfilter nach Plausibilitätstest Bank1" SWORD Temp_Cels 1 100 -50.140 899.860 FORMAT "%8.3" ECU_ADDRESS 0x7F9226 /end MEASUREMENT
/begin MEASUREMENT PFlt_tPreIntB2 "Modulinterner Druck vor Partikelfilter nach Plausibilitätstest Bank2" SWORD Temp_Cels 1 100 -50.140 899.860 FORMAT "%8.3" ECU_ADDRESS 0x7F9228 /end MEASUREMENT
/begin MEASUREMENT PFlt_tPreMaxB1_mp "Maximale Temperatur vor Partikelfilter für Bank 1" SWORD Temp_Cels 1 100 -50.140 899.860 FORMAT "%8.3" ECU_ADDRESS 0x8FF2B0 /end MEASUREMENT
/begin MEASUREMENT PFlt_tPreMaxB2_mp "Maximale Temperatur vor Partikelfilter für Bank 2""" SWORD Temp_Cels 1 100 -50.140 899.860 FORMAT "%8.3" ECU_ADDRESS 0x8FF2B2 /end MEASUREMENT
/begin MEASUREMENT PFlt_tPrePhysFltB1_mp "PT1-gefilterter Wert von PFlt_tOxiPre für Bank1" SWORD Temp_Cels 1 100 -50.140 899.860 FORMAT "%8.3" ECU_ADDRESS 0x8FF2F4 /end MEASUREMENT
/begin MEASUREMENT PFlt_tPrePhysFltB2_mp "PT1-gefilterter Wert von PFlt_tOxiPre für Bank2" SWORD Temp_Cels 1 100 -50.140 899.860 FORMAT "%8.3" ECU_ADDRESS 0x8FF2F6 /end MEASUREMENT
/begin MEASUREMENT PFlt_tPreRawB1_mp "Kennfeldberechnete Temperatur vor dem Partikelfilter Bank1" SWORD Temp_Cels 1 100 -50.140 899.860 FORMAT "%8.3" ECU_ADDRESS 0x8FF31A /end MEASUREMENT
/begin MEASUREMENT PFlt_tPreRawB2_mp "Kennfeldberechnete Temperatur vor dem Partikelfilter Bank2" SWORD Temp_Cels 1 100 -50.140 899.860 FORMAT "%8.3" ECU_ADDRESS 0x8FF31C /end MEASUREMENT
/begin MEASUREMENT PFlt_tPreRgnMaxB1_mp "Maximaler Abgasdruck im Regenerationsfall für Bank 1" SWORD Temp_Cels 1 100 -50.140 899.860 FORMAT "%8.3" ECU_ADDRESS 0x8FF2B4 /end MEASUREMENT
/begin MEASUREMENT PFlt_tPreRgnMaxB2_mp "Maximaler Abgasdruck im Regenerationsfall für Bank 2" SWORD Temp_Cels 1 100 -50.140 899.860 FORMAT "%8.3" ECU_ADDRESS 0x8FF2B6 /end MEASUREMENT
/begin MEASUREMENT PFlt_tPreStyB1 "Stationärtemperatur vor Partikelfilter für Bank 1" SWORD Temp_Cels 1 100 -50.140 899.860 FORMAT "%8.3" ECU_ADDRESS 0x7F922A /end MEASUREMENT
/begin MEASUREMENT PFlt_tPreStyB2 "Stationärtemperatur vor Partikelfilter für Bank 2" SWORD Temp_Cels 1 100 -50.140 899.860 FORMAT "%8.3" ECU_ADDRESS 0x7F922C /end MEASUREMENT
/begin MEASUREMENT PFlt_tPstSimB1 "Simulierte Temperatur nach Partikelfilter Bank1" SWORD Temp_Cels 1 100 -50.140 899.860 FORMAT "%8.3" ECU_ADDRESS 0x7F922E /end MEASUREMENT
/begin MEASUREMENT PFlt_tPstSimB2 "Simulierte Temperatur nach Partikelfilter Bank2" SWORD Temp_Cels 1 100 -50.140 899.860 FORMAT "%8.3" ECU_ADDRESS 0x7F9230 /end MEASUREMENT
/begin MEASUREMENT PFlt_tSurfB1 "Oberflächen Temperatur vom Partikel Filter Bank1" SWORD Temp_Cels 1 100 -50.140 899.860 FORMAT "%8.3" ECU_ADDRESS 0x7F9232 /end MEASUREMENT
/begin MEASUREMENT PFlt_tSurfB2 "Oberflächen Temperatur vom Partikel Filter Bank2" SWORD Temp_Cels 1 100 -50.140 899.860 FORMAT "%8.3" ECU_ADDRESS 0x7F9234 /end MEASUREMENT
/begin MEASUREMENT PFlt_tSurfSimB1_mp "modellierte Partikelfilteroberflächentemperatur für Bank1" SWORD Temp_Cels 1 100 -50.140 899.860 FORMAT "%8.3" ECU_ADDRESS 0x8FF31E /end MEASUREMENT
/begin MEASUREMENT PFlt_tSurfSimB2_mp "modellierte Partikelfilteroberflächentemperatur für Bank2" SWORD Temp_Cels 1 100 -50.140 899.860 FORMAT "%8.3" ECU_ADDRESS 0x8FF320 /end MEASUREMENT
/begin MEASUREMENT PFlt_tTotCorB1_mp "Additiver Temperaturkorrekturwert für Bank1" SWORD TempDiff_Cels 1 100 -3276.800 3276.700 FORMAT "%8.3" ECU_ADDRESS 0x8FF322 /end MEASUREMENT
/begin MEASUREMENT PFlt_tTotCorB2_mp "Additiver Temperaturkorrekturwert für Bank2" SWORD TempDiff_Cels 1 100 -3276.800 3276.700 FORMAT "%8.3" ECU_ADDRESS 0x8FF324 /end MEASUREMENT
/begin MEASUREMENT PFlt_tTurbPreB1 "Temperatur vor dem Turbolader Bank1" SWORD Temp_Cels 1 100 -50.140 899.860 FORMAT "%8.3" ECU_ADDRESS 0x7F9236 /end MEASUREMENT
/begin MEASUREMENT PFlt_tTurbPreB2 "Temperatur vor dem Turbolader Bank2" SWORD Temp_Cels 1 100 -50.140 899.860 FORMAT "%8.3" ECU_ADDRESS 0x7F9238 /end MEASUREMENT
/begin MEASUREMENT PFlt_tUpStrmB1_mp "Erste Abgastemperatur zur Überwachung für Bank1" SWORD Temp_Cels 1 100 -50.140 899.860 FORMAT "%8.3" ECU_ADDRESS 0x8FF2EC /end MEASUREMENT
/begin MEASUREMENT PFlt_tUpStrmB2_mp "Erste Abgastemperatur zur Überwachung für Bank2" SWORD Temp_Cels 1 100 -50.140 899.860 FORMAT "%8.3" ECU_ADDRESS 0x8FF2EE /end MEASUREMENT
/begin MEASUREMENT PrpBrk_trqDes "Vortriebsmomentwunsch der Längsbewegung" SWORD TrqPrp 1 100 -6553.600 6553.400 FORMAT "%8.3" ECU_ADDRESS 0x7F9240 /end MEASUREMENT
/begin MEASUREMENT PrpBrk_trqLead "Vorhaltmoment der Längsbewegung" SWORD TrqPrp 1 100 -6553.600 6553.400 FORMAT "%8.3" ECU_ADDRESS 0x7F9242 /end MEASUREMENT
/begin MEASUREMENT PrpCtl_stSPTrack_mp "Messpunkt Status Sollwertnachführung" UBYTE OneToOne 1 100 0.00 255.0 FORMAT "%5.1" ECU_ADDRESS 0x8FF336 /end MEASUREMENT
/begin MEASUREMENT PrpCtl_swtSpdLim "SW-Schalter Aktivierung Geschwindigkeitsbegrenzung (0: deaktiviert, 1 aktiviert)" UBYTE OneToOne 1 100 0.00 255.0 FORMAT "%5.1" ECU_ADDRESS 0x7F89F5 /end MEASUREMENT
/begin MEASUREMENT PrpCtl_trqI_mp "Status I-Anteil" SLONG TrqPrp 1 100 -429496729.600 429496729.400 FORMAT "%13.3" ECU_ADDRESS 0x8FF338 /end MEASUREMENT
/begin MEASUREMENT PrpCtl_trqP_mp "Status PI-Anteil" SWORD TrqPrp 1 100 -6553.600 6553.400 FORMAT "%8.3" ECU_ADDRESS 0x8FF33C /end MEASUREMENT
/begin MEASUREMENT PrpCtl_trqSpdLim "begrenztes Moment für Höchstgeschwindigkeitsbegrenzung" SWORD TrqPrp 1 100 -6553.600 6553.400 FORMAT "%8.3" ECU_ADDRESS 0x7F9244 /end MEASUREMENT
/begin MEASUREMENT PrpCtl_vCurrTrack_mp "Messpunkt des nachgeführten Geschwindigkeitssollwertes" SWORD Vel 1 100 -327.6800 327.6700 FORMAT "%8.4" ECU_ADDRESS 0x8FF33E /end MEASUREMENT
/begin MEASUREMENT PrpCtl_vSpdCorr_mp "Fahrzeuggeschwindigkeit nach Multiplikation mit Korrekturfaktor" SWORD Vel 1 100 -327.6800 327.6700 FORMAT "%8.4" ECU_ADDRESS 0x8FF340 /end MEASUREMENT
/begin MEASUREMENT Prp_rAPP "verknüpfte Fahrpedalstellung PWG und virtuelles PWG" SWORD Prc 1 100 -400.0000 399.9878 FORMAT "%8.4" ECU_ADDRESS 0x7F9246 /end MEASUREMENT
/begin MEASUREMENT Prp_rVirtAPP "virtuelle Fahrpedalstellung bei FGR oder HGB" SWORD Prc 1 100 -400.0000 399.9878 FORMAT "%8.4" ECU_ADDRESS 0x7F9248 /end MEASUREMENT
/begin MEASUREMENT Prp_rVirtEngPrp_mp "Virtuelle Fahrpedalstellung aus inversem Fahrverhaltenkennfeld" SWORD Prc 1 100 -400.0000 399.9878 FORMAT "%8.4" ECU_ADDRESS 0x8FF32E /end MEASUREMENT
/begin MEASUREMENT Prp_rVirtOvrRun_mp "Virtuelle Fahrpedalstellung aus der inversen Schubkennlinie" SWORD Prc 1 100 -400.0000 399.9878 FORMAT "%8.4" ECU_ADDRESS 0x8FF330 /end MEASUREMENT
/begin MEASUREMENT Prp_stPrpSel "ACC or FGR present" UBYTE OneToOne 1 100 0.00 255.0 FORMAT "%5.1" ECU_ADDRESS 0x7F89F6 /end MEASUREMENT
/begin MEASUREMENT Prp_stTrqTypePrp "Indikator ob Verlustmomentenkompensation applikativ deaktiviert ist" UBYTE OneToOne 1 100 0.00 255.0 FORMAT "%5.1" ECU_ADDRESS 0x7F89F7 /end MEASUREMENT
/begin MEASUREMENT Prp_stVirtApp "virtuellle PWG-Stellung überschreibt die gemessene" UBYTE OneToOne 1 100 0.00 255.0 FORMAT "%5.1" ECU_ADDRESS 0x7F89F8 /end MEASUREMENT
/begin MEASUREMENT Prp_trqDesCC "Momentenanforderung FGR oder ACC" SWORD TrqPrp 1 100 -6553.600 6553.400 FORMAT "%8.3" ECU_ADDRESS 0x7F924A /end MEASUREMENT
/begin MEASUREMENT Prp_trqEng "Vortriebsmoment in innerem Moment" SWORD Trq 1 100 -3276.800 3276.700 FORMAT "%8.3" ECU_ADDRESS 0x7F924C /end MEASUREMENT
/begin MEASUREMENT Prp_trqEngPrp_mp "Meßpunkt der Auswahl zwischen Prp_trqEng oder Prp_trqPrp" SWORD TrqPrp 1 100 -6553.600 6553.400 FORMAT "%8.3" ECU_ADDRESS 0x8FF332 /end MEASUREMENT
/begin MEASUREMENT Prp_trqLead "Vorhaltmoment des Vortriebs" SWORD TrqPrp 1 100 -6553.600 6553.400 FORMAT "%8.3" ECU_ADDRESS 0x7F924E /end MEASUREMENT
/begin MEASUREMENT Prp_trqPrp "Vortriebsmoment" SWORD TrqPrp 1 100 -6553.600 6553.400 FORMAT "%8.3" ECU_ADDRESS 0x7F9250 /end MEASUREMENT
/begin MEASUREMENT Prp_trqRaw "Vortriebsmomentwunsch vor Führungsformer" SWORD TrqPrp 1 100 -6553.600 6553.400 FORMAT "%8.3" ECU_ADDRESS 0x7F9252 /end MEASUREMENT
/begin MEASUREMENT Prp_trqRawLim "Grenzwert des Vortriebsmomentenrohwertes" SWORD TrqPrp 1 100 -6553.600 6553.400 FORMAT "%8.3" ECU_ADDRESS 0x7F9254 /end MEASUREMENT
/begin MEASUREMENT Prp_trqThresPrp_mp "Drehmomentenschwelle zur Unterscheidung zwischen Zug- und Schubbetrieb" SWORD TrqPrp 1 100 -6553.600 6553.400 FORMAT "%8.3" ECU_ADDRESS 0x8FF334 /end MEASUREMENT
/begin MEASUREMENT PSPCD_dvol1_mp "limiting value of fuel depending on engine speed  and fuel temperature" SWORD FlConsum_l_h 1 100 -327.6800 327.6700 FORMAT "%8.4" ECU_ADDRESS 0x8FF342 /end MEASUREMENT
/begin MEASUREMENT PSPCD_dvol2_mp "Output value after correction based on fuel temperature" SWORD FlConsum_l_h 1 100 -327.6800 327.6700 FORMAT "%8.4" ECU_ADDRESS 0x8FF344 /end MEASUREMENT
/begin MEASUREMENT PSPCD_dvolOut "Output fuel consumption quantity from PSPCD" SWORD FlConsum_l_h 1 100 -327.6800 327.6700 FORMAT "%8.4" ECU_ADDRESS 0x7F923E /end MEASUREMENT
/begin MEASUREMENT PSPCD_dvolOut0_mp "limiting output fuel volume" SWORD FlConsum_l_h 1 100 -327.6800 327.6700 FORMAT "%8.4" ECU_ADDRESS 0x8FF346 /end MEASUREMENT
/begin MEASUREMENT PSPCD_dvolOut1_mp "Fuel quantity value depending on timer" SWORD FlConsum_l_h 1 100 -327.6800 327.6700 FORMAT "%8.4" ECU_ADDRESS 0x8FF348 /end MEASUREMENT
/begin MEASUREMENT PSPCD_dvolOut2_mp "Output fuel quantity depending on the Engine speed" SWORD FlConsum_l_h 1 100 -327.6800 327.6700 FORMAT "%8.4" ECU_ADDRESS 0x8FF34A /end MEASUREMENT
/begin MEASUREMENT PSPCD_dvolOut3_mp "Pre Supply Pump output value" SWORD FlConsum_l_h 1 100 -327.6800 327.6700 FORMAT "%8.4" ECU_ADDRESS 0x8FF34C /end MEASUREMENT
/begin MEASUREMENT PSPCD_stLogic_mp "Status of Engine,T15" UBYTE OneToOne 1 100 0.00 255.0 FORMAT "%5.1" ECU_ADDRESS 0x8FF34E /end MEASUREMENT
/begin MEASUREMENT PSPCD_tiT15Delay_mp "Time till which timer should run" SWORD Time_ms 1 100 -327680.0 327670.0 FORMAT "%8.1" ECU_ADDRESS 0x8FF350 /end MEASUREMENT
/begin MEASUREMENT QLTCD_B_ozfbsd_mp "oz-Kommunikationsfehler" UBYTE B_TRUE 1 100 0.00 1.00000000000 FORMAT "%13.11" ECU_ADDRESS 0x8FF352 /end MEASUREMENT
/begin MEASUREMENT QLTCD_B_qltdetec_mp "" UBYTE B_TRUE 1 100 0.00 1.00000000000 FORMAT "%13.11" ECU_ADDRESS 0x8FF353 /end MEASUREMENT
/begin MEASUREMENT QLTCD_cntComOk_mp "" UBYTE OneToOne 1 100 0.00 255.0 FORMAT "%5.1" ECU_ADDRESS 0x8FF354 /end MEASUREMENT
/begin MEASUREMENT QLTCD_CommErr_mp "bss-Kommunikationsfehler" UBYTE OneToOne 1 100 0.00 255.0 FORMAT "%5.1" ECU_ADDRESS 0x8FF355 /end MEASUREMENT
/begin MEASUREMENT QLTCD_oznivr "Ölstand von der BSD-Schnittstelle" UBYTE DEZ 1 100 0.00 255.0 FORMAT "%5.1" ECU_ADDRESS 0x7F8A0F /end MEASUREMENT
/begin MEASUREMENT QLTCD_ozpermr_w "Ölpermittivität von der BSD-Schnittstelle" UWORD DEZ 1 100 0.00 65535.00 FORMAT "%8.2" ECU_ADDRESS 0x7F926E /end MEASUREMENT
/begin MEASUREMENT QLTCD_ozstatus "Zustand der BSD-Schnittstelle" UBYTE DEZ 1 100 0.00 255.0 FORMAT "%5.1" ECU_ADDRESS 0x7F8A10 /end MEASUREMENT
/begin MEASUREMENT QLTCD_oztempr "Öltemperatur von der BSD-Schnittstelle" UBYTE DEZ 1 100 0.00 255.0 FORMAT "%5.1" ECU_ADDRESS 0x7F8A11 /end MEASUREMENT
/begin MEASUREMENT QLTCD_oz_permh_r_mp "High-Byte der Ölpermittivität" UBYTE OneToOne 1 100 0.00 255.0 FORMAT "%5.1" ECU_ADDRESS 0x8FF356 /end MEASUREMENT
/begin MEASUREMENT QLTCD_oz_perml_r_mp "Low-Byte der Ölpermittivität" UBYTE OneToOne 1 100 0.00 255.0 FORMAT "%5.1" ECU_ADDRESS 0x8FF357 /end MEASUREMENT
/begin MEASUREMENT QLTCD_State_Handler_mp "Zustand nach Meldung oder Fehlerbehandler" UWORD OneToOne 1 100 0.00 65535.00 FORMAT "%8.2" ECU_ADDRESS 0x8FF358 /end MEASUREMENT
/begin MEASUREMENT QLTCD_State_mp "Zustand des ibs-Komponententreibers" UWORD OneToOne 1 100 0.00 65535.00 FORMAT "%8.2" ECU_ADDRESS 0x8FF35A /end MEASUREMENT
/begin MEASUREMENT QLTCD_stComQLTActiv "Zustand der BSD-Schnittstelle" UBYTE DEZ 1 100 0.00 255.0 FORMAT "%5.1" ECU_ADDRESS 0x7F8A12 /end MEASUREMENT
/begin MEASUREMENT QLTCD_stDetection_mp "" UBYTE QltDet 1 100 0.00 2.00000000000 FORMAT "%13.11" ECU_ADDRESS 0x8FF35C /end MEASUREMENT
/begin MEASUREMENT QLTCD_stTBss_Active_mp "Zustand der BSD-Schnittstelle" UBYTE B_TRUE 1 100 0.00 1.00000000000 FORMAT "%13.11" ECU_ADDRESS 0x8FF35D /end MEASUREMENT
/begin MEASUREMENT QLTCD_SwitchState_mp "Zustand des Lesen-/Schreiben-Registerteils" UWORD OneToOne 1 100 0.00 65535.00 FORMAT "%8.2" ECU_ADDRESS 0x8FF35E /end MEASUREMENT
/begin MEASUREMENT RailCD_ctPMonStrt_mp "counter for error monitoring" ULONG Time_ms 1 100 0.00 42949672950.0 FORMAT "%13.1" ECU_ADDRESS 0x8FF450 /end MEASUREMENT
/begin MEASUREMENT RailCD_pAct_mp "aktueller Kraftstoffdruck" SWORD Pres_Rail 1 100 -3276.800 3276.700 FORMAT "%5.3" ECU_ADDRESS 0x6F8326 /end MEASUREMENT
/begin MEASUREMENT RailCD_pFltWinNeg_mp "Raildruckabfall, ab welchem auf Großsignalparameter umgeschaltet wird" SWORD Pres_Rail 1 100 -3276.800 3276.700 FORMAT "%5.3" ECU_ADDRESS 0x8FF43E /end MEASUREMENT
/begin MEASUREMENT RailCD_pLin_mp "linearisierter Wert des Kraftstoffdrucksensors" SWORD Pres_Rail 1 100 -3276.800 3276.700 FORMAT "%5.3" ECU_ADDRESS 0x8FF440 /end MEASUREMENT
/begin MEASUREMENT RailCD_pPeak "maximaler Raildruck der letzten 10ms" SWORD Pres_Rail 1 100 -3276.800 3276.700 FORMAT "%5.3" ECU_ADDRESS 0x7F9270 /end MEASUREMENT
/begin MEASUREMENT RailCD_stEngStrtMov_mp "Motorbewegung bei Offset-Überwachung des Raildrucksensors festgestellt" UBYTE OneToOne 1 100 0.00 255.0 FORMAT "%5.1" ECU_ADDRESS 0x8FF448 /end MEASUREMENT
/begin MEASUREMENT RailCD_stMon_mp "Überwachungsstatus des Spannungsoffsets des Raildrucksensors" UBYTE OneToOne 1 100 0.00 255.0 FORMAT "%5.1" ECU_ADDRESS 0x8FF449 /end MEASUREMENT
/begin MEASUREMENT RailCD_stOfsTstMon "aktueller Zustand der Offset-Überwachung für den Raildrucksensor" UBYTE OneToOne 1 100 0.00 255.0 FORMAT "%5.1" ECU_ADDRESS 0x7F8A13 /end MEASUREMENT
/begin MEASUREMENT RailCD_tClntLstCyc_mp "Wassertemperatur vom letzten Fahrzyklus für die Offset-Überwachung des Raildrucksensors" SWORD Temp_Cels 1 100 -50.140 899.860 FORMAT "%8.3" ECU_ADDRESS 0x8FF44A /end MEASUREMENT
/begin MEASUREMENT RailCD_tiFltPT1_mp "momentane Filterzeit für PT1 Filter" ULONG TimeDelay_s 1 100 0.0000010000000 4294.9673 FORMAT "%9.4" ECU_ADDRESS 0x8FF444 /end MEASUREMENT
/begin MEASUREMENT RailCD_tiOfsTstDel_mp "Verzögerungszeit = f(RailCD_pPeak) für Offset-Test des Raildrucksensors im Nachlauf" SWORD TimeRed 1 100 -5242.880 5242.720 FORMAT "%8.3" ECU_ADDRESS 0x8FF44C /end MEASUREMENT
/begin MEASUREMENT RailCD_uOfsAftRun "Spannungswert des Raildrucksensors während aktiver Überwachung im Nachlauf" SWORD Volt 1 100 -160156.4 160151.5 FORMAT "%8.1" ECU_ADDRESS 0x7F9272 /end MEASUREMENT
/begin MEASUREMENT RailCD_uOfsStrt "Spannungswert des Raildrucksensors während aktiver Überwachung in der Startphase" SWORD Volt 1 100 -160156.4 160151.5 FORMAT "%8.1" ECU_ADDRESS 0x7F9278 /end MEASUREMENT
/begin MEASUREMENT RailCD_uPeakRaw "Rohwert des Raildrucks" SWORD Volt 1 100 -160156.4 160151.5 FORMAT "%8.1" ECU_ADDRESS 0x7F927E /end MEASUREMENT
/begin MEASUREMENT Rail_dvolCPCDvtFlt_mp "gefilterte Volumenstromabweichung" SWORD Qp_mm3_sec 1 100 -327680.0 327670.0 FORMAT "%8.1" ECU_ADDRESS 0x8FF360 /end MEASUREMENT
/begin MEASUREMENT Rail_dvolCPCDvt_mp "selektierte Volumenstromabweichung" SWORD Qp_mm3_sec 1 100 -327680.0 327670.0 FORMAT "%8.1" ECU_ADDRESS 0x8FF362 /end MEASUREMENT
/begin MEASUREMENT Rail_dvolEstAged "geschätzer Volumenstrom eines gealterten Systems" SWORD Qp_mm3_sec 1 100 -327680.0 327670.0 FORMAT "%8.1" ECU_ADDRESS 0x7F9282 /end MEASUREMENT
/begin MEASUREMENT Rail_dvolMeUnCtlDT1_mp "DT1-Anteil des Druckreglers über Zumesseinheit" SWORD Qp_mm3_sec 1 100 -327680.0 327670.0 FORMAT "%8.1" ECU_ADDRESS 0x8FF3BC /end MEASUREMENT
/begin MEASUREMENT Rail_dvolMeUnCtlI "I-Anteil des Druckreglers der Zumesseinheit" SWORD Qp_mm3_sec 1 100 -327680.0 327670.0 FORMAT "%8.1" ECU_ADDRESS 0x7F9284 /end MEASUREMENT
/begin MEASUREMENT Rail_dvolMeUnCtlP_mp "P-Anteil des Druckreglers über Zumesseinheit" SWORD Qp_mm3_sec 1 100 -327680.0 327670.0 FORMAT "%8.1" ECU_ADDRESS 0x8FF3BE /end MEASUREMENT
/begin MEASUREMENT Rail_dvolMeUnCtlUpLim "obere Stellwertbegrenzung für Druckregelung über Zumesseinheit" SWORD Qp_mm3_sec 1 100 -327680.0 327670.0 FORMAT "%8.1" ECU_ADDRESS 0x7F9286 /end MEASUREMENT
/begin MEASUREMENT Rail_dvolMeUnDvt "Regelabweichung des Volumenstroms" SWORD Qp_mm3_sec 1 100 -327680.0 327670.0 FORMAT "%8.1" ECU_ADDRESS 0x7F9288 /end MEASUREMENT
/begin MEASUREMENT Rail_dvolMeUnSet "Sollwert (Volumenstrom) von der Raildruckregelung" SWORD Qp_mm3_sec 1 100 -327680.0 327670.0 FORMAT "%8.1" ECU_ADDRESS 0x7F928A /end MEASUREMENT
/begin MEASUREMENT Rail_dvolPreCtl "Vorsteuerwert für die Druckregelung über Zumesseinheit" SWORD Qp_mm3_sec 1 100 -327680.0 327670.0 FORMAT "%8.1" ECU_ADDRESS 0x7F928C /end MEASUREMENT
/begin MEASUREMENT Rail_dvolPreCtlCor "Botschaft für Bypasseingriff" SWORD Qp_mm3_sec 1 100 -327680.0 327670.0 FORMAT "%8.1" ECU_ADDRESS 0x7F928E /end MEASUREMENT
/begin MEASUREMENT Rail_dvolSetPoint_mp "Raildrucksollwert abhängig vom Volumenstrom" SWORD Qp_mm3_sec 1 100 -327680.0 327670.0 FORMAT "%8.1" ECU_ADDRESS 0x8FF364 /end MEASUREMENT
/begin MEASUREMENT Rail_facMeUnTiRmpVal_mp "aktueller Rampenwert der Rampe bei Umschaltung von Regelung über Zumesseinheit auf Regelung über Druckregelventil" SWORD Fact 1 100 -4.000000 3.999878 FORMAT "%8.6" ECU_ADDRESS 0x8FF36E /end MEASUREMENT
/begin MEASUREMENT Rail_MeUnCtlDKd_mp "D-Verstärkung der Druckregelung über Zumesseinheit" SLONG Kd_pRail2Q 1 100 -3276800.00000 3276799.99847 FORMAT "%16.5" ECU_ADDRESS 0x8FF378 /end MEASUREMENT
/begin MEASUREMENT Rail_MeUnCtlIKiNeg_mp "I-Verstärkung für negative Großsignale für die Druckregelung über Zumesseinheit" ULONG Ki_pRail2Q 1 100 0.00 99999999.9767 FORMAT "%16.4" ECU_ADDRESS 0x8FF37C /end MEASUREMENT
/begin MEASUREMENT Rail_MeUnCtlIKiPos_mp "I-Verstärkung für positive Großsignale für die Druckregelung über Zumesseinheit" ULONG Ki_pRail2Q 1 100 0.00 99999999.9767 FORMAT "%16.4" ECU_ADDRESS 0x8FF380 /end MEASUREMENT
/begin MEASUREMENT Rail_MeUnCtlIKi_mp "I-Verstärkung für Kleinsignale für die Druckregelung über Zumesseinheit" ULONG Ki_pRail2Q 1 100 0.00 99999999.9767 FORMAT "%16.4" ECU_ADDRESS 0x8FF384 /end MEASUREMENT
/begin MEASUREMENT Rail_MeUnCtlPKpNeg_mp "P-Verstärkung für negative Großsignale für die Druckregelung über Zumesseinheit" SLONG Kp_pRail2Q 1 100 -3276800.00000 3276799.99847 FORMAT "%16.5" ECU_ADDRESS 0x8FF388 /end MEASUREMENT
/begin MEASUREMENT Rail_MeUnCtlPKpPos_mp "P-Verstärkung für positive Großsignale für die Druckregelung über Zumesseinheit" SLONG Kp_pRail2Q 1 100 -3276800.00000 3276799.99847 FORMAT "%16.5" ECU_ADDRESS 0x8FF38C /end MEASUREMENT
/begin MEASUREMENT Rail_MeUnCtlPKp_mp "P-Verstärkung für Kleinsignale für die Druckregelung über Zumesseinheit" SLONG Kp_pRail2Q 1 100 -3276800.00000 3276799.99847 FORMAT "%16.5" ECU_ADDRESS 0x8FF390 /end MEASUREMENT
/begin MEASUREMENT Rail_pCPCPeakMin_mp "Ausgang der Kennlinie Rail_pCPCPeakMin_CUR" SWORD Pres_Rail 1 100 -3276.800 3276.700 FORMAT "%5.3" ECU_ADDRESS 0x8FF3DA /end MEASUREMENT
/begin MEASUREMENT Rail_PCVCtlDKd_mp "D-Verstärkung der Druckregelung über Druckregelventil" SLONG Kd 1 100 -32768.0000000 32767.9999847 FORMAT "%13.7" ECU_ADDRESS 0x8FF39C /end MEASUREMENT
/begin MEASUREMENT Rail_PCVCtlIKiNeg_mp "I-Verstärkung für negative Großsignale für die Druckregelung über Druckregelventil" ULONG Ki 1 100 0.00 999999.999767 FORMAT "%13.6" ECU_ADDRESS 0x8FF3A0 /end MEASUREMENT
/begin MEASUREMENT Rail_PCVCtlIKiPos_mp "I-Verstärkung für positive Großsignale für die Druckregelung über Druckregelventil" ULONG Ki 1 100 0.00 999999.999767 FORMAT "%13.6" ECU_ADDRESS 0x8FF3A4 /end MEASUREMENT
/begin MEASUREMENT Rail_PCVCtlIKi_mp "I-Verstärkung für Kleinsignale für die Druckregelung über Druckregelventil" ULONG Ki 1 100 0.00 999999.999767 FORMAT "%13.6" ECU_ADDRESS 0x8FF3A8 /end MEASUREMENT
/begin MEASUREMENT Rail_PCVCtlPKpNeg_mp "P-Verstärkung für negative Großsignale für die Druckregelung über Druckregelventil" SLONG Kp 1 100 -32768.0000000 32767.9999847 FORMAT "%13.7" ECU_ADDRESS 0x8FF3AC /end MEASUREMENT
/begin MEASUREMENT Rail_PCVCtlPKpPos_mp "P-Verstärkung für positive Großsignale für die Druckregelung über Druckregelventil" SLONG Kp 1 100 -32768.0000000 32767.9999847 FORMAT "%13.7" ECU_ADDRESS 0x8FF3B0 /end MEASUREMENT
/begin MEASUREMENT Rail_PCVCtlPKp_mp "P-Verstärkung für Kleinsignale für die Druckregelung über Druckregelventil" SLONG Kp 1 100 -32768.0000000 32767.9999847 FORMAT "%13.7" ECU_ADDRESS 0x8FF3B4 /end MEASUREMENT
/begin MEASUREMENT Rail_pDvt "Raildruckregler-Regelabweichung" SWORD Pres_Rail 1 100 -3276.800 3276.700 FORMAT "%5.3" ECU_ADDRESS 0x7F929E /end MEASUREMENT
/begin MEASUREMENT Rail_pDvtFltLim_mp "gefilterte Regelabweichung des Raildrucks" SWORD Pres_Rail 1 100 -3276.800 3276.700 FORMAT "%5.3" ECU_ADDRESS 0x8FF3C0 /end MEASUREMENT
/begin MEASUREMENT Rail_pMeUnDvt "Regelabweichung für den ZME-Regler" SWORD Pres_Rail 1 100 -3276.800 3276.700 FORMAT "%5.3" ECU_ADDRESS 0x7F92A0 /end MEASUREMENT
/begin MEASUREMENT Rail_pMeUnDvtMax_mp "Ausgang der Kennlinie Rail_pMeUnDvtMax_CUR" SWORD Pres_Rail 1 100 -3276.800 3276.700 FORMAT "%5.3" ECU_ADDRESS 0x8FF3E0 /end MEASUREMENT
/begin MEASUREMENT Rail_pMeUnDvtMin_mp "Ausgang der Kennlinie Rail_pMeUnDvtMin_CUR" SWORD Pres_Rail 1 100 -3276.800 3276.700 FORMAT "%5.3" ECU_ADDRESS 0x8FF3E2 /end MEASUREMENT
/begin MEASUREMENT Rail_pMeUnDvtPre_mp "aus CPC-Regelung ermittelte Regelabweichung für die Zumesseinheit" SWORD Pres_Rail 1 100 -3276.800 3276.700 FORMAT "%5.3" ECU_ADDRESS 0x8FF366 /end MEASUREMENT
/begin MEASUREMENT Rail_pMeUnPeakMin_mp "Ausgang der Kennlinie Rail_pMeUnPeakMin_CUR" SWORD Pres_Rail 1 100 -3276.800 3276.700 FORMAT "%5.3" ECU_ADDRESS 0x8FF3E4 /end MEASUREMENT
/begin MEASUREMENT Rail_pPCVCPCOfs_mp "rückgerechneter Offsetwert der CPC für die Steuergröße zum geschlossen Halten des DRV" SWORD Pres_Rail 1 100 -3276.800 3276.700 FORMAT "%5.3" ECU_ADDRESS 0x8FF368 /end MEASUREMENT
/begin MEASUREMENT Rail_pPCVCtlDT1_mp "DT1-Anteil des Druckreglers über Druckregelventil" SWORD Pres_Rail 1 100 -3276.800 3276.700 FORMAT "%5.3" ECU_ADDRESS 0x8FF3C6 /end MEASUREMENT
/begin MEASUREMENT Rail_pPCVCtlI_mp "I-Anteil des Druckreglers über Druckregelventil" SWORD Pres_Rail 1 100 -3276.800 3276.700 FORMAT "%5.3" ECU_ADDRESS 0x8FF3C8 /end MEASUREMENT
/begin MEASUREMENT Rail_pPCVCtlLoLim_mp "untere Stellwertbegrenzung des Raildruckreglers über Druckregelventil" SWORD Pres_Rail 1 100 -3276.800 3276.700 FORMAT "%5.3" ECU_ADDRESS 0x8FF374 /end MEASUREMENT
/begin MEASUREMENT Rail_pPCVCtlPILim_mp "DT1-Anteil des Druckreglers über Druckregelventil (begrenzt)" SWORD Pres_Rail 1 100 -3276.800 3276.700 FORMAT "%5.3" ECU_ADDRESS 0x8FF3CA /end MEASUREMENT
/begin MEASUREMENT Rail_pPCVCtlP_mp "P-Anteil des Druckreglers über Druckregelventil" SWORD Pres_Rail 1 100 -3276.800 3276.700 FORMAT "%5.3" ECU_ADDRESS 0x8FF3CC /end MEASUREMENT
/begin MEASUREMENT Rail_pPCVCtlUpLim_mp "obere Stellwertbegrenzung des Raildruckreglers über Druckregelventil" SWORD Pres_Rail 1 100 -3276.800 3276.700 FORMAT "%5.3" ECU_ADDRESS 0x8FF376 /end MEASUREMENT
/begin MEASUREMENT Rail_pPCVDvt "Regelabweichung für den DRV Regler" SWORD Pres_Rail 1 100 -3276.800 3276.700 FORMAT "%5.3" ECU_ADDRESS 0x7F92A2 /end MEASUREMENT
/begin MEASUREMENT Rail_pPCVDvtPre_mp "aus CPC-Regelung ermittelte Regelabweichung für das Druckregelventil" SWORD Pres_Rail 1 100 -3276.800 3276.700 FORMAT "%5.3" ECU_ADDRESS 0x8FF36A /end MEASUREMENT
/begin MEASUREMENT Rail_pPCVInitI_mp "Initialisierung I-Anteil des Druckreglers über Druckregelventil, beim Umschalten von Zumesseinheit auf Druckregelventil" SWORD Pres_Rail 1 100 -3276.800 3276.700 FORMAT "%5.3" ECU_ADDRESS 0x8FF3CE /end MEASUREMENT
/begin MEASUREMENT Rail_pPCVSet "Stellwertvorgabe für das Druckregelventil" SWORD Pres_Rail 1 100 -3276.800 3276.700 FORMAT "%5.3" ECU_ADDRESS 0x7F92A4 /end MEASUREMENT
/begin MEASUREMENT Rail_pPeakFlt_mp "PT1-gefilterter Raildruck für die Druckregelung über Zumesseinheit" SWORD Pres_Rail 1 100 -3276.800 3276.700 FORMAT "%5.3" ECU_ADDRESS 0x8FF3C2 /end MEASUREMENT
/begin MEASUREMENT Rail_pPreCtlCor "Botschaft für Bypasseingriff" SWORD Pres_Rail 1 100 -3276.800 3276.700 FORMAT "%5.3" ECU_ADDRESS 0x7F92A6 /end MEASUREMENT
/begin MEASUREMENT Rail_pSetMin_mp "minimaler Raildruck als PCV Stellwert während Systemabstellung" SWORD Pres_Rail 1 100 -3276.800 3276.700 FORMAT "%5.3" ECU_ADDRESS 0x8FF370 /end MEASUREMENT
/begin MEASUREMENT Rail_pWindUp_mp "rückgerechneter I-Anteil wenn Stellerbegrenzung erreicht ist" SWORD Pres_Rail 1 100 -3276.800 3276.700 FORMAT "%5.3" ECU_ADDRESS 0x8FF3D0 /end MEASUREMENT
/begin MEASUREMENT Rail_qCPCtlType_mp "Mengengrenze für die Umschaltung auf CPC-Regelung" SWORD InjMassCyc 1 100 -327.6800 327.6700 FORMAT "%8.4" ECU_ADDRESS 0x8FF3D2 /end MEASUREMENT
/begin MEASUREMENT Rail_qMeUnCtlType_mp "mengenabhängige Hystereseschwelle zur Umschaltung auf Druckregelung über Zumesseinheit" SWORD InjMassCyc 1 100 -327.6800 327.6700 FORMAT "%8.4" ECU_ADDRESS 0x8FF3D4 /end MEASUREMENT
/begin MEASUREMENT Rail_stCPC "Status des Zustandsautomaten für die Umschaltung der Raildruckregelung" UBYTE OneToOne 1 100 0.00 255.0 FORMAT "%5.1" ECU_ADDRESS 0x7F8A14 /end MEASUREMENT
/begin MEASUREMENT Rail_stCPCMon1_mp "Zustandsbits für die Überwachung der Stellgröße des DRV" UBYTE OneToOne 1 100 0.00 255.0 FORMAT "%5.1" ECU_ADDRESS 0x8FF3DC /end MEASUREMENT
/begin MEASUREMENT Rail_stCPCMon3_mp "Zustandsbits für Überwachung auf minimalen Raildruck während der Umschaltung nach CPC" UBYTE OneToOne 1 100 0.00 255.0 FORMAT "%5.1" ECU_ADDRESS 0x8FF3DD /end MEASUREMENT
/begin MEASUREMENT Rail_stCPCMon4_mp "Fehlerpfad für Überwachung auf maximalen Raildruck während Umschaltung nach CPC" UBYTE OneToOne 1 100 0.00 255.0 FORMAT "%5.1" ECU_ADDRESS 0x8FF3DE /end MEASUREMENT
/begin MEASUREMENT Rail_stCtlLoop "Zustand der Steuerung Raildruckregler" UBYTE OneToOne 1 100 0.00 255.0 FORMAT "%5.1" ECU_ADDRESS 0x7F8A15 /end MEASUREMENT
/begin MEASUREMENT Rail_stMeUnFrzI_mp "Status des rückgerechneten I-Anteils für die Stellwertbegrenzung für die Regelung der Zumesseinheit" UBYTE OneToOne 1 100 0.00 255.0 FORMAT "%5.1" ECU_ADDRESS 0x8FF3C4 /end MEASUREMENT
/begin MEASUREMENT Rail_stMeUnMon0_mp "Zustandsbits für Überwachung auf positive Regelabweichung" UBYTE OneToOne 1 100 0.00 255.0 FORMAT "%5.1" ECU_ADDRESS 0x8FF3E6 /end MEASUREMENT
/begin MEASUREMENT Rail_stMeUnMon1_mp "Zustandsbits für Überwachung auf positive Regelabweichung und Sollwert des Volumenstroms durch die Zumesseinheit" UBYTE OneToOne 1 100 0.00 255.0 FORMAT "%5.1" ECU_ADDRESS 0x8FF3E7 /end MEASUREMENT
/begin MEASUREMENT Rail_stMeUnMon2_mp "Zustandsbits für Überwachung auf negative Regelabweichung bei Nullförderung" UBYTE OneToOne 1 100 0.00 255.0 FORMAT "%5.1" ECU_ADDRESS 0x8FF3E8 /end MEASUREMENT
/begin MEASUREMENT Rail_stMeUnMon3_mp "Zustandsbits für Überwachung auf minimalen Raildruck" UBYTE OneToOne 1 100 0.00 255.0 FORMAT "%5.1" ECU_ADDRESS 0x8FF3E9 /end MEASUREMENT
/begin MEASUREMENT Rail_stMeUnMon4_mp "Zustandsbits für Überwachung auf maximalen Raildruck" UBYTE OneToOne 1 100 0.00 255.0 FORMAT "%5.1" ECU_ADDRESS 0x8FF3EA /end MEASUREMENT
/begin MEASUREMENT Rail_stPCVWindUp "Status des rückgerechneten I-Anteils für die Stellwertbegren zung für die Regelung des Druckregelventils" UBYTE OneToOne 1 100 0.00 255.0 FORMAT "%5.1" ECU_ADDRESS 0x7F8A17 /end MEASUREMENT
/begin MEASUREMENT Rail_stShOffTstAck "Quittierung für Nachlauftestanforderung" UBYTE OneToOne 1 100 0.00 255.0 FORMAT "%5.1" ECU_ADDRESS 0x7F8A18 /end MEASUREMENT
/begin MEASUREMENT Rail_stSwtCon_mp "Status der Umschaltbedingungen für das Regelprinzip" UBYTE OneToOne 1 100 0.00 255.0 FORMAT "%5.1" ECU_ADDRESS 0x8FF3D6 /end MEASUREMENT
/begin MEASUREMENT Rail_stSwtCPCCon_mp "Status für Umschaltbedingung für den CPC-Zustandsautomaten" UWORD OneToOne 1 100 0.00 65535.00 FORMAT "%8.2" ECU_ADDRESS 0x8FF3D8 /end MEASUREMENT
/begin MEASUREMENT Rail_tiMeUn0Deb_mp "MeUn0: Messpunkt fuer laufende Entprellzaehler" UWORD Time_ms 1 100 0.00 655350.0 FORMAT "%8.1" ECU_ADDRESS 0x6F82F4 /end MEASUREMENT
/begin MEASUREMENT Rail_tiMeUn1Deb_mp "MeUn1: Messpunkt fuer laufende Entprellzaehler" UWORD Time_ms 1 100 0.00 655350.0 FORMAT "%8.1" ECU_ADDRESS 0x6F82F6 /end MEASUREMENT
/begin MEASUREMENT Rail_tiMeUn2Deb_mp "MeUn2: Messpunkt fuer laufende Entprellzaehler" UWORD Time_ms 1 100 0.00 655350.0 FORMAT "%8.1" ECU_ADDRESS 0x6F82F8 /end MEASUREMENT
/begin MEASUREMENT Rail_tiMeUn3Deb_mp "MeUn3: Messpunkt fuer laufende Entprellzaehler" UWORD Time_ms 1 100 0.00 655350.0 FORMAT "%8.1" ECU_ADDRESS 0x6F82FA /end MEASUREMENT
/begin MEASUREMENT Rail_tiMeUn4Deb_mp "MeUn4: Messpunkt fuer laufende Entprellzaehler" UWORD Time_ms 1 100 0.00 655350.0 FORMAT "%8.1" ECU_ADDRESS 0x6F82FC /end MEASUREMENT
/begin MEASUREMENT Rail_tiMeUnCtlDT1_mp "Zeitkonstante des DT1-Gliedes für die Druckregelung über Zumesseinheit" ULONG TimeDelay_s 1 100 0.0000010000000 4294.9673 FORMAT "%9.4" ECU_ADDRESS 0x8FF394 /end MEASUREMENT
/begin MEASUREMENT Rail_tiMeUnCtlPT1_mp "Zeitkonstante des PT1-Filters für die Druckregelung über Zumesseinheit" ULONG TimeDelay_s 1 100 0.0000010000000 4294.9673 FORMAT "%9.4" ECU_ADDRESS 0x8FF398 /end MEASUREMENT
/begin MEASUREMENT Rail_tiMeUnRmpDur_mp "Laufzeit der Rampe um das Fördervolumen der Zumesseinheit vom aktuellen Sollwert auf die Maximalförderung zu rampen" SWORD InjTime_us 1 100 -32768.00 32767.00 FORMAT "%8.2" ECU_ADDRESS 0x8FF372 /end MEASUREMENT
/begin MEASUREMENT Rail_tiPCVCtlDT1_mp "Zeitkonstante des DT1-Gliedes für die Druckregelung über Druckregelventil" ULONG TimeDelay_s 1 100 0.0000010000000 4294.9673 FORMAT "%9.4" ECU_ADDRESS 0x8FF3B8 /end MEASUREMENT
/begin MEASUREMENT Rail_tiSwtCPC_mp "aktuelle Verweildauer in einem Übergangszustand des CPC-Zustandsautomaten" UWORD Time_ms 1 100 0.00 655350.0 FORMAT "%8.1" ECU_ADDRESS 0x8FF36C /end MEASUREMENT
/begin FUNCTION pflt_monitor "Überwachung des Partikelfilters"
 /begin DEF_CHARACTERISTIC PFlt_ddvolHsLnPlausNeg_C PFlt_ddvolHsLnPlausPos_C PFlt_ddvolHsLnSot_C PFlt_dvolCharMonMin_C PFlt_nTempChkTrg_C PFlt_numCntBck_C PFlt_numCntMax_C PFlt_numPFltMon_C PFlt_numTimeStpPlausSens_C PFlt_pBPAndAPTolcMax_C PFlt_pDiffCharMonMin_C PFlt_pDiffHsLnNeg_C PFlt_pDiffMax_C PFlt_pDiffMin_C PFlt_pDiffTolcMax_C PFlt_pMinNrmCldStrt_C PFlt_pPreAndBPTolcMax_C PFlt_pPreTolcMax_C PFlt_resFlowMax_C PFlt_resFlowMin_C PFlt_resFlowTolcDynPlaus_C PFlt_stCfgTempSens_C PFlt_swtEnvTempSens_C PFlt_swtMonCharMin_C PFlt_swtSvcSensChng_C PFlt_swtSvcTmrRst_C PFlt_tCldStrtDfl_C PFlt_tDiffCldMax_C PFlt_tDiffTolcMax_C PFlt_tDwnStrmTolcMax_C PFlt_tEGMax_C PFlt_tEGMin_C PFlt_tFrzMin_C PFlt_tiChkTempPlausMax_CUR PFlt_DebCharMaxDef_C PFlt_DebCharMaxOk_C PFlt_DebCharMinDef_C PFlt_DebCharMinOk_C PFlt_DebEngPrtMaxDef_C PFlt_DebEngPrtMaxOk_C PFlt_DebPDiffDynPlausDef_C PFlt_DebPDiffDynPlausOk_C PFlt_DebHsLnPlausDef_C PFlt_DebHsLnPlausOk_C PFlt_DebPDiffMaxDef_C PFlt_DebPDiffMaxOk_C PFlt_DebPDiffMinDef_C PFlt_DebPDiffMinOk_C PFlt_DebSotPlausDef_C PFlt_DebSotPlausOk_C PFlt_DebRgnPermMaxDef_C PFlt_DebRgnPermMaxOk_C PFlt_DebTEGMaxDef_C PFlt_DebTEGMaxOk_C PFlt_DebTEGMinDef_C PFlt_DebTEGMinOk_C PFlt_tiDelOfsCalc_C PFlt_tiLckChkTempPlaus_C PFlt_tIncrDwnStrm_C PFlt_tIncrUpStrm_C PFlt_tiFltHsLnPT1_C PFlt_tUpStrmTolcMax_C /end DEF_CHARACTERISTIC
 /begin IN_MEASUREMENT BattCD_u /end IN_MEASUREMENT
/end FUNCTION
/begin FUNCTION pflt_monitor_msg ""
 /begin OUT_MEASUREMENT PFlt_stAftRunDelDem PFlt_stAftRunDelDemB1 PFlt_stAftRunDelDemB2 /end OUT_MEASUREMENT
/end FUNCTION
/begin FUNCTION pflt_monitor_proj "Customer specific particulate filter monitoring functions."
 /begin DEF_CHARACTERISTIC PFlt_ctEngPrtRgn_C PFlt_DebAPSPlausDefHigh_C PFlt_DebAPSPlausDefLow_C PFlt_DebBPSPlausDefHigh_C PFlt_DebBPSPlausDefLow_C PFlt_DebPFltOvldInhRgnDef_C PFlt_DebPFltOvldInhRgnOk_C PFlt_DebPFltOvldTrqLimDef_C PFlt_DebPFltOvldTrqLimOk_C PFlt_DebPresPlausDefHigh_C PFlt_DebPresPlausDefLow_C PFlt_DebRstDfpEngPrtRgnMon_C PFlt_dvolRstDfpEngPrtMon_C PFlt_facNO2RgnInhRgn_CUR PFlt_facNO2RgnTrqLim_CUR PFlt_lRstDfpEngPrtMon_C PFlt_lSumDiffMax_C PFlt_mLoIdlSotSimMax_C PFlt_mSotDiff_C PFlt_nLoIdlMax_C PFlt_nLoIdlMin_C PFlt_nMin_C PFlt_nPFltOvldHeal_C PFlt_nStrtMax_C PFlt_nStrtMin_C PFlt_numEngPrtActvMsk_C PFlt_numRgnStep1_C PFlt_numRgnStep2_C PFlt_numRgnStep3_C PFlt_numRgnStep4_C PFlt_numRgnStep5_C PFlt_numRgnStep6_C PFlt_numRgnStep7_C PFlt_numRgnStep8_C PFlt_pAPSNegDvt_C PFlt_pAPSPosDvt_C PFlt_pBPSNegDvt_C PFlt_pBPSPosDvt_C PFlt_pDiffMax1_C PFlt_pPFltOvldInhRgn_MAP PFlt_pPFltOvldInit_C PFlt_pPFltOvldOfsHeal_C PFlt_pPFltOvldTrqLim_MAP PFlt_pPreAshOilCorr_MAP PFlt_pPreCorrMax_C PFlt_pPresNegDvt_C PFlt_pPreSotSimCorr_MAP PFlt_pPresPlausMaxDvt_C PFlt_pPresPlausMinDvt_C PFlt_pPresPosDvt_C PFlt_pPreVolCorr_CUR PFlt_qLoIdlMax_C PFlt_qLoIdlMin_C PFlt_qPFltOvldHeal_C PFlt_rEngPrtRgnMax_C PFlt_resFlowOvldInhRgn_MAP PFlt_resFlowOvldInit_C PFlt_resFlowOvldOfsHeal_C PFlt_resFlowOvldTrqLim_MAP PFlt_rLoIdlTVAMax_C PFlt_stLoIdlEGTMsk_C PFlt_stMaxEGTMsk_C PFlt_swtDiagRlsmSotCtl_C PFlt_swtEngPrtWrEEPROM_C PFlt_swtPFltOvldInhRgnCor_C PFlt_swtPFltOvldTrqLimCor_C PFlt_tClntPFltOvldHeal_C PFlt_tDevOxiPreMax_C PFlt_tDevOxiPreRgnMax_C PFlt_tDevPreMax_C PFlt_tDevPreRgnMax_C PFlt_tiDebAftRunTst_C PFlt_tiDebLoIdl_C PFlt_DebmSotMaxDef_C PFlt_DebmSotMaxOk_C PFlt_DebOxiPreMaxDef_C PFlt_DebOxiPreMaxOk_C PFlt_DebOxiPreNplDef_C PFlt_DebOxiPreNplOk_C PFlt_DebOxiPreRgnMaxDef_C PFlt_DebOxiPreRgnMaxOk_C PFlt_DebPreMaxDef_C PFlt_DebPreMaxOk_C PFlt_DebPreNplDef_C PFlt_DebPreNplOk_C PFlt_DebPreRgnMaxDef_C PFlt_DebPreRgnMaxOk_C PFlt_tiDebPresDblDef_C PFlt_tiDebPresPlausOk_C PFlt_tiDebT15On_C PFlt_tiFstEngPrtRgnMax_C PFlt_tiLoIdlSnceRgnMax_C PFlt_tiPFltOvld1PT1_C PFlt_tiPFltOvld2PT1_C PFlt_tOxiPreDiffMax_MAP PFlt_tPreDiffMax_MAP PFlt_tThresOxiPreMax_C PFlt_tThresOxiPreRgnMax_C PFlt_tThresPreMax_C PFlt_tThresPreRgnMax_C PFlt_vLoIdlSpeedMax_C PFlt_vPFltOvldHeal_C /end DEF_CHARACTERISTIC
 /begin IN_MEASUREMENT Eng_nAvrg InjCtl_qSetUnBal PFlt_dVolMapIn_mp PFlt_facNO2RgnMapIn_mp PFlt_mAshOilMapIn_mp PFlt_mSotSimMapIn_mp /end IN_MEASUREMENT
/end FUNCTION
/begin FUNCTION pflt_monitor_proj_msg "" /begin OUT_MEASUREMENT PFlt_lAvrgRgn /end OUT_MEASUREMENT /end FUNCTION
/begin FUNCTION pflt_monitor_proj_uic ""
 /begin OUT_MEASUREMENT PFlt_ctEngPrtRgnB1_mp PFlt_ctEngPrtRgnB2_mp PFlt_ctRgnStep1_mp PFlt_ctRgnStep2_mp PFlt_ctRgnStep3_mp PFlt_ctRgnStep4_mp PFlt_ctRgnStep5_mp PFlt_ctRgnStep6_mp PFlt_ctRgnStep7_mp PFlt_ctRgnStep8_mp PFlt_ctRgnSum_mp PFlt_dVolMapIn_mp PFlt_facNO2RgnMapIn_mp PFlt_mAshOilMapIn_mp PFlt_mSotSimMapIn_mp PFlt_pAPSBPSDiff_mp PFlt_pAPSDvt_mp PFlt_pAPSPFltPresDiff_mp PFlt_pBPSDvt_mp PFlt_pBPSPFltPresDiff_mp PFlt_pPFltB1B2Diff_mp PFlt_pPFltOvldLckRgnB1_mp PFlt_pPFltOvldLckRgnB2_mp PFlt_pPFltOvldTrqLimB1_mp PFlt_pPFltOvldTrqLimB2_mp PFlt_pPFltPresDvtB1_mp PFlt_pPFltPresDvtB2_mp PFlt_pPreAshOilCorrB1_mp PFlt_pPreAshOilCorrB2_mp PFlt_pPreCorrB1_mp PFlt_pPreCorrB2_mp PFlt_pPreSotAshCorrSumB1_mp PFlt_pPreSotAshCorrSumB2_mp PFlt_pPreSotSimCorrB1_mp PFlt_pPreSotSimCorrB2_mp PFlt_pPreVolCorrB1_mp PFlt_pPreVolCorrB2_mp PFlt_rEngPrtRgnB1_mp PFlt_rEngPrtRgnB2_mp PFlt_resFlowOvldLckRgnB1_mp PFlt_resFlowOvldLckRgnB2_mp PFlt_resFlowOvldTrqLimB1_mp PFlt_resFlowOvldTrqLimB2_mp PFlt_stAPSPlausDefHigh_mp PFlt_stAPSPlausDefLow_mp PFlt_stBPSPlausDefHigh_mp PFlt_stBPSPlausDefLow_mp PFlt_stEngPrtRgnB1_mp PFlt_stEngPrtRgnB2_mp PFlt_stPresPlausDefHighB1_mp PFlt_stPresPlausDefHighB2_mp PFlt_stPresPlausDefLowB1_mp PFlt_stPresPlausDefLowB2_mp PFlt_stPresPlausLoIdl_mp PFlt_stPresPlausOk_mp PFlt_stPresPlausTst_mp PFlt_stPresPlaus_mp PFlt_stRgnRlsOffB1_mp PFlt_stRgnRlsOffB2_mp PFlt_stRlsmSotCtlB1_mp PFlt_stRlsmSotCtlB2_mp PFlt_tiOpOldB1_mp PFlt_tiOpOldB2_mp PFlt_tiSnceFstEngPrtRgnB1_mp PFlt_tiSnceFstEngPrtRgnB2_mp PFlt_tOxiPreDiffB1_mp PFlt_tOxiPreDiffB2_mp PFlt_tOxiPreDiffMax_mp PFlt_tOxiPreMaxB1_mp PFlt_tOxiPreMaxB2_mp PFlt_tOxiPreRgnMaxB1_mp PFlt_tOxiPreRgnMaxB2_mp PFlt_tPreDiffB1_mp PFlt_tPreDiffB2_mp PFlt_tPreDiffMax_mp PFlt_tPreMaxB1_mp PFlt_tPreMaxB2_mp PFlt_tPreRgnMaxB1_mp PFlt_tPreRgnMaxB2_mp /end OUT_MEASUREMENT
/end FUNCTION
/begin FUNCTION pflt_monitor_uic ""
 /begin OUT_MEASUREMENT PFlt_ddvolFltB1_mp PFlt_ddvolFltB2_mp PFlt_dpDiffFltB1_mp PFlt_dpDiffFltB2_mp PFlt_dpDiffNegDef_mp PFlt_dpDiffPosDef_mp PFlt_dvolFltB1_mp PFlt_dvolFltB2_mp PFlt_pDiffFltB1_mp PFlt_pDiffFltB2_mp PFlt_pDiffOfsValActB1_mp PFlt_pDiffOfsValActB2_mp PFlt_pDiffOfsValActMidB1_mp PFlt_pDiffOfsValActMidB2_mp PFlt_pDiffOfsValOldB1_mp PFlt_pDiffOfsValOldB2_mp PFlt_stLckTempPlaus_mp PFlt_stLckTmr_mp PFlt_stPresDiffPlausB1_mp PFlt_stPresDiffPlausB2_mp PFlt_stResFlowHiB1_mp PFlt_stResFlowHiB2_mp PFlt_stResFlowLoB1_mp PFlt_stResFlowLoB2_mp PFlt_stTempPlausDoneB1_mp PFlt_stTempPlausDoneB2_mp PFlt_tDwnStrmB1_mp PFlt_tDwnStrmB2_mp PFlt_tIATLoLvl_mp PFlt_tiChkTmpPlaus_mp PFlt_tPFltMon_mp PFlt_tUpStrmB1_mp PFlt_tUpStrmB2_mp /end OUT_MEASUREMENT
/end FUNCTION
/begin FUNCTION pflt_sensadapt "Sensor Adaption"
 /begin DEF_CHARACTERISTIC PFlt_pDfl_C PFlt_pPreDfl_C PFlt_swtNeutrPDiff_C PFlt_swtNeutrPPreFlt_C PFlt_swtNeutrPPre_C PFlt_swtNeutrTOxiPre_C PFlt_swtNeutrTPre_C PFlt_swtPDiffOfsOn_C PFlt_swtPresSensCfg_C PFlt_swtTempOxiPreCfg_C PFlt_swtTempOxiPstCfg_C PFlt_swttPreFltOn_C PFlt_tDpnAftOxiC_C PFlt_tiPPrePT1_C PFlt_titPrePhysPT1_C PFlt_tPreDfl_C /end DEF_CHARACTERISTIC
/end FUNCTION
/begin FUNCTION pflt_sensadapt_msg ""
 /begin OUT_MEASUREMENT PFlt_pDiff PFlt_pDiffB1 PFlt_pDiffB2 PFlt_pDiffRawB1 PFlt_pDiffRawB2 PFlt_pMidB1 PFlt_pMidB2 PFlt_pPre PFlt_pPreB1 PFlt_pPreB2 PFlt_pPreFlt PFlt_pPreFltB1 PFlt_pPreFltB2 PFlt_pPreIntB1 PFlt_pPreIntB2 PFlt_tOxiPre PFlt_tOxiPreB1 PFlt_tOxiPreB2 PFlt_tOxiPstB1 PFlt_tOxiPstB2 PFlt_tPre PFlt_tPreB1 PFlt_tPreB2 PFlt_tPreIntB1 PFlt_tPreIntB2 PFlt_tTurbPreB1 PFlt_tTurbPreB2 /end OUT_MEASUREMENT
/end FUNCTION
/begin FUNCTION pflt_sensadapt_uic ""
 /begin OUT_MEASUREMENT PFlt_pDiffOfsValActSensB1_mp PFlt_pDiffOfsValActSensB2_mp PFlt_tPrePhysFltB1_mp PFlt_tPrePhysFltB2_mp /end OUT_MEASUREMENT
/end FUNCTION
/begin FUNCTION pflt_tempmod "Partikelfiltertemperaturmodell"
 /begin DEF_CHARACTERISTIC PFlt_cpExhGs_C PFlt_CPFlt_C PFlt_facBlwBy_C PFlt_facDpn_MAP PFlt_facHtTransNoLin_CUR PFlt_KdDT1TempCor_C PFlt_kiITempMod_C PFlt_numCylRefB1_C PFlt_numCylRefB2_C PFlt_stRgnMsk1_C PFlt_stRgnMsk2_C PFlt_swtFacDpn_C PFlt_swtTempModOff_C PFlt_tExhGsStyRgn1_MAP PFlt_tExhGsStyRgn2_MAP PFlt_tExhGsSty_MAP PFlt_tiExhGsDel_CUR PFlt_tiHtTransDT1_CUR PFlt_tiOxiPreStyPT1_C PFlt_tiFltTempPT1_C PFlt_tiPreStyPT1_C PFlt_tRefSty_C /end DEF_CHARACTERISTIC
 /begin IN_MEASUREMENT Eng_nAvrg IATSCD_tAir InjCtl_qSetUnBal PFlt_dmEG_mp PFlt_tDiffCorr_mp VSSCD_v /end IN_MEASUREMENT
/end FUNCTION
/begin FUNCTION pflt_tempmod_msg ""
 /begin OUT_MEASUREMENT PFlt_tOxiPreSty PFlt_tPreStyB1 PFlt_tPreStyB2 PFlt_tPstSimB1 PFlt_tPstSimB2 PFlt_tSurfB1 PFlt_tSurfB2 /end OUT_MEASUREMENT
/end FUNCTION
/begin FUNCTION pflt_tempmod_uic ""
 /begin OUT_MEASUREMENT PFlt_dmEG_mp PFlt_facDpn_mp PFlt_qPoI2NonEff_mp PFlt_tDiffCorrB1_mp PFlt_tDiffCorrB2_mp PFlt_tDiffCorr_mp PFlt_tExhGsStyRgn1_mp PFlt_tExhGsStyRgn2_mp PFlt_tHtTransCorB1_mp PFlt_tHtTransCorB2_mp PFlt_tiExhGsDelB1_mp PFlt_tiExhGsDelB2_mp PFlt_tiHtTransDT1B1_mp PFlt_tiHtTransDT1B2_mp PFlt_tOxiPreRaw_mp PFlt_tPreCorrB1_mp PFlt_tPreCorrB2_mp PFlt_tPreRawB1_mp PFlt_tPreRawB2_mp PFlt_tSurfSimB1_mp PFlt_tSurfSimB2_mp PFlt_tTotCorB1_mp PFlt_tTotCorB2_mp /end OUT_MEASUREMENT
/end FUNCTION
/begin FUNCTION prpbrk_msg "" /begin OUT_MEASUREMENT PrpBrk_trqDes PrpBrk_trqLead /end OUT_MEASUREMENT /end FUNCTION
/begin FUNCTION prpctl "Vortriebsregelung"
 /begin DEF_CHARACTERISTIC PrpCtl_facSpdCorr_C PrpCtl_SpdLim4IKi_C PrpCtl_SpdLim4IKiPos_C PrpCtl_SpdLim4IKiNeg_C PrpCtl_vSpdLim4IWinPos_C PrpCtl_vSpdLim4IWinNeg_C PrpCtl_SpdLim4PKp_C PrpCtl_SpdLim4PKpPos_C PrpCtl_SpdLim4PKpNeg_C PrpCtl_vSpdLim4PWinPos_C PrpCtl_vSpdLim4PWinNeg_C PrpCtl_SpdLim5IKi_C PrpCtl_SpdLim5IKiPos_C PrpCtl_SpdLim5IKiNeg_C PrpCtl_vSpdLim5IWinPos_C PrpCtl_vSpdLim5IWinNeg_C PrpCtl_SpdLim5PKp_C PrpCtl_SpdLim5PKpPos_C PrpCtl_SpdLim5PKpNeg_C PrpCtl_vSpdLim5PWinPos_C PrpCtl_vSpdLim5PWinNeg_C PrpCtl_tiSpdLimPT1_C PrpCtl_swtSpdLimVal_C PrpCtl_swtSpdLimType_C PrpCtl_vSpdLimMax_C PrpCtl_vSpdLimThreshFree_C PrpCtl_vSpdLimThreshOff_C PrpCtl_vSpdLimThreshOn_C /end DEF_CHARACTERISTIC
/end FUNCTION
/begin FUNCTION prpctl_msg "" /begin OUT_MEASUREMENT PrpCtl_swtSpdLim PrpCtl_trqSpdLim /end OUT_MEASUREMENT /end FUNCTION
/begin FUNCTION prpctl_uic ""
 /begin OUT_MEASUREMENT PrpCtl_stSPTrack_mp PrpCtl_trqI_mp PrpCtl_trqP_mp PrpCtl_vCurrTrack_mp PrpCtl_vSpdCorr_mp /end OUT_MEASUREMENT
/end FUNCTION
/begin FUNCTION prp_cocrctlprpctl "" /end FUNCTION
/begin FUNCTION prp_cocrctlprpctl_msg "" /end FUNCTION
/begin FUNCTION prp_cocrctlprpctl_uic "" /end FUNCTION
/begin FUNCTION prp_demsel "Anforderungs-Auswahl" /end FUNCTION
/begin FUNCTION prp_demsel_msg "" /begin OUT_MEASUREMENT Prp_stPrpSel Prp_trqDesCC Prp_trqLead Prp_trqRaw /end OUT_MEASUREMENT /end FUNCTION
/begin FUNCTION prp_demsel_uic "" /end FUNCTION
/begin FUNCTION prp_virtapp "virtuelle Fahrpedalstellung"
 /begin DEF_CHARACTERISTIC Prp_rEng_MAP Prp_rPrp_MAP Prp_swtVirtAPPSel_C Prp_trqThresEng_CUR Prp_trqThresPrp_CUR /end DEF_CHARACTERISTIC
 /begin IN_MEASUREMENT Eng_nAvrg Prp_trqEng Prp_trqPrp VSSCD_v /end IN_MEASUREMENT
/end FUNCTION
/begin FUNCTION prp_virtapp_msg ""
 /begin OUT_MEASUREMENT Prp_rAPP Prp_rVirtAPP Prp_stTrqTypePrp Prp_stVirtApp Prp_trqEng Prp_trqPrp Prp_trqRawLim /end OUT_MEASUREMENT
/end FUNCTION
/begin FUNCTION prp_virtapp_uic ""
 /begin OUT_MEASUREMENT Prp_rVirtEngPrp_mp Prp_rVirtOvrRun_mp Prp_trqEngPrp_mp Prp_trqThresPrp_mp /end OUT_MEASUREMENT
/end FUNCTION
/begin FUNCTION pspcd "Komponententreiber Vorförderpumpe"
 /begin DEF_CHARACTERISTIC PSPCD_dvolBase_CUR PSPCD_dvolMax_C PSPCD_dvolMin_C PSPCD_dvolOut1_C PSPCD_dvolTempLim_MAP PSPCD_facFTSCor_CUR PSPCD_nLim_C PSPCD_tiT15Delay_CUR /end DEF_CHARACTERISTIC
 /begin IN_MEASUREMENT CTSCD_tClnt Eng_nAvrg FTSCD_tFuel /end IN_MEASUREMENT
/end FUNCTION
/begin FUNCTION pspcd_msg "" /begin OUT_MEASUREMENT PSPCD_dvolOut /end OUT_MEASUREMENT /end FUNCTION
/begin FUNCTION pspcd_uic ""
 /begin OUT_MEASUREMENT PSPCD_dvol1_mp PSPCD_dvol2_mp PSPCD_dvolOut0_mp PSPCD_dvolOut1_mp PSPCD_dvolOut2_mp PSPCD_dvolOut3_mp PSPCD_stLogic_mp PSPCD_tiT15Delay_mp /end OUT_MEASUREMENT
/end FUNCTION
/begin FUNCTION qltcd "QLT mit BSD-Schnittstelle - Componententreiber"
 /begin DEF_CHARACTERISTIC QLTCD_cntComOk_C QLTCD_tiDebDefect_C QLTCD_tiDebOk_C QLTCD_tiOutput_C QLTCD_tiReset_C QLTCD_tiTryDetection_C QLTCD_tiWaitDetection_C /end DEF_CHARACTERISTIC
/end FUNCTION
/begin FUNCTION qltcd_msg ""
 /begin OUT_MEASUREMENT QLTCD_oznivr QLTCD_ozpermr_w QLTCD_ozstatus QLTCD_oztempr QLTCD_stComQLTActiv /end OUT_MEASUREMENT
/end FUNCTION
/begin FUNCTION qltcd_uic ""
 /begin OUT_MEASUREMENT QLTCD_B_ozfbsd_mp QLTCD_B_qltdetec_mp QLTCD_cntComOk_mp QLTCD_CommErr_mp QLTCD_oz_permh_r_mp QLTCD_oz_perml_r_mp QLTCD_State_Handler_mp QLTCD_State_mp QLTCD_stDetection_mp QLTCD_stTBss_Active_mp QLTCD_SwitchState_mp /end OUT_MEASUREMENT
/end FUNCTION
/begin FUNCTION railcd_clreeprom_uic "" /end FUNCTION
/begin FUNCTION railcd_co "Komponententreiber Rail"
 /begin DEF_CHARACTERISTIC RailCD_uSRCMin_C RailCD_uSRCMax_C RailCD_pLin_CUR RailCD_DebSRCHighDef_C RailCD_DebSRCHighOk_C RailCD_DebSRCLowDef_C RailCD_DebSRCLowOk_C RAILCD_numAdc2_C RAILCD_numAdc_C RailCD_pFltWinNeg_CUR RailCD_stRPSFlt_C RailCD_tiFlt1PT1_C RailCD_tiFlt2PT1_C RailCD_tiFlt3PT1_C /end DEF_CHARACTERISTIC
 /begin IN_MEASUREMENT InjCtl_qSetUnBal RailCD_uPeakRaw /end IN_MEASUREMENT
/end FUNCTION
/begin FUNCTION railcd_co_msg "" /begin OUT_MEASUREMENT RailCD_pPeak RailCD_uPeakRaw /end OUT_MEASUREMENT /end FUNCTION
/begin FUNCTION railcd_co_uic ""
 /begin OUT_MEASUREMENT RailCD_pAct_mp RailCD_pFltWinNeg_mp RailCD_pLin_mp RailCD_tiFltPT1_mp /end OUT_MEASUREMENT
/end FUNCTION
/begin FUNCTION railcd_offstst "RPS Offset Überwachung"
 /begin DEF_CHARACTERISTIC RailCD_swtOfsTst_C RailCD_tiEvalDel_C RailCD_tiOfsTstAftRun_C RailCD_tiOfsTstDel_CUR RailCD_tiOfsTstStrt_C RailCD_tiStrErrDel_C RailCD_tOfsTstAftRun_C RailCD_tOfsTstDec_C RailCD_tOfsTstInc_C RailCD_tOfsTstStrt_C RailCD_uOfsAftRunMax_C RailCD_uOfsAftRunMin_C RailCD_uOfsStrtMax_C RailCD_uOfsStrtMin_C /end DEF_CHARACTERISTIC
 /begin IN_MEASUREMENT RailCD_pPeak /end IN_MEASUREMENT
/end FUNCTION
/begin FUNCTION railcd_offstst_msg "" /begin OUT_MEASUREMENT RailCD_stOfsTstMon RailCD_uOfsAftRun RailCD_uOfsStrt /end OUT_MEASUREMENT /end FUNCTION
/begin FUNCTION railcd_offstst_uic ""
 /begin OUT_MEASUREMENT RailCD_stEngStrtMov_mp RailCD_stMon_mp RailCD_tClntLstCyc_mp RailCD_tiOfsTstDel_mp /end OUT_MEASUREMENT
/end FUNCTION
/begin FUNCTION railcd_pmonstrt "Start phase rail pressure monitoring" /begin DEF_CHARACTERISTIC RailCD_nStrtLim_C RailCD_pStrtLim_C RailCD_tiPMonStrtLim_C /end DEF_CHARACTERISTIC /end FUNCTION
/begin FUNCTION railcd_pmonstrt_uic "" /begin OUT_MEASUREMENT RailCD_ctPMonStrt_mp /end OUT_MEASUREMENT /end FUNCTION
/begin FUNCTION rail_adcget_uic "" /end FUNCTION
/begin FUNCTION rail_cpctlloop ""
 /begin DEF_CHARACTERISTIC Rail_dvolDvtLim_C Rail_dvolMeUnClose_CUR Rail_dvolMeUnOpn_CUR Rail_dvolPCVClose_CUR Rail_dvolPCVOpn_CUR Rail_facMeUnDvt_CUR Rail_facMeUnSetPoint_CUR Rail_facPCVDvt_CUR Rail_facPCVFast_C Rail_pMeUnPreCtlOff_C Rail_pMeUnPreCtlOn_C Rail_pPCVRedOfs_C Rail_tiPT1CPCDvt_C Rail_tiSwtCPCMax_C /end DEF_CHARACTERISTIC
 /begin IN_MEASUREMENT Eng_nAvrg /end IN_MEASUREMENT
/end FUNCTION
/begin FUNCTION rail_cpctlloop_msg "" /begin OUT_MEASUREMENT Rail_dvolMeUnDvt Rail_stCPC /end OUT_MEASUREMENT /end FUNCTION
/begin FUNCTION rail_cpctlloop_uic ""
 /begin OUT_MEASUREMENT Rail_dvolCPCDvtFlt_mp Rail_dvolCPCDvt_mp Rail_dvolSetPoint_mp Rail_pMeUnDvtPre_mp Rail_pPCVCPCOfs_mp Rail_pPCVDvtPre_mp Rail_tiSwtCPC_mp /end OUT_MEASUREMENT
/end FUNCTION
/begin FUNCTION rail_ctlloop "Raildruckregler Regelkreis"
 /begin DEF_CHARACTERISTIC Rail_nCloseCtl_C Rail_nThresStrt_C Rail_numRevPlaus_C Rail_pCloseCtl_C Rail_pDiffCloseCtl_C Rail_pOpnCtl_C Rail_swtCtlModeAdjVal_C Rail_tiDebDefMeUnDiag_C Rail_tiDebOkMeUnDiag_C Rail_tiDebDefPCVDiag_C Rail_tiDebOkPCVDiag_C /end DEF_CHARACTERISTIC
/end FUNCTION
/begin FUNCTION rail_ctllooplib ""
 /begin DEF_CHARACTERISTIC Rail_dpPCVSetShOffDec_C Rail_dvolOff_C Rail_dvolStrt_C Rail_numRevDel_C Rail_pSetMin_CUR Rail_stCtlLoopSel_C Rail_tiDeflate_C Rail_tiMeUnRmpDur_CUR /end DEF_CHARACTERISTIC
 /begin IN_MEASUREMENT Eng_nAvrg /end IN_MEASUREMENT
/end FUNCTION
/begin FUNCTION rail_ctllooplib_uic ""
 /begin OUT_MEASUREMENT Rail_facMeUnTiRmpVal_mp Rail_pSetMin_mp Rail_tiMeUnRmpDur_mp /end OUT_MEASUREMENT
/end FUNCTION
/begin FUNCTION rail_ctllooplimmeun "Begrenzungen für die Druckregelung ueber Zumesseinheit" /begin DEF_CHARACTERISTIC Rail_dvolMeUnCtlLoLim_C Rail_dvolMeUnCtlUpLim_CUR /end DEF_CHARACTERISTIC /begin IN_MEASUREMENT Eng_nAvrg /end IN_MEASUREMENT /end FUNCTION
/begin FUNCTION rail_ctllooplimmeun_uic "" /end FUNCTION
/begin FUNCTION rail_ctllooplimpcv "Begrenzungen für die Druckregelung ueber Druckregelventil"
 /begin DEF_CHARACTERISTIC Rail_pPCVCtlLoLimStrt_C Rail_pPCVCtlLoLim_C Rail_pPCVCtlUpLimStrt_C /end DEF_CHARACTERISTIC
/end FUNCTION
/begin FUNCTION rail_ctllooplimpcv_uic "" /begin OUT_MEASUREMENT Rail_pPCVCtlLoLim_mp Rail_pPCVCtlUpLim_mp /end OUT_MEASUREMENT /end FUNCTION
/begin FUNCTION rail_ctlloopmeun_msg "" /begin OUT_MEASUREMENT Rail_dvolMeUnCtlI Rail_dvolMeUnSet Rail_pMeUnDvt /end OUT_MEASUREMENT /end FUNCTION
/begin FUNCTION rail_ctlloopparameun "Parameter für die Druckregelung ueber Zumesseinheit"
 /begin DEF_CHARACTERISTIC Rail_facOvrMeUnNegIncr_C Rail_MeUnCtlDKd_CUR Rail_MeUnCtlIKiNeg_CUR Rail_MeUnCtlIKiPos_CUR Rail_MeUnCtlIKi_CUR Rail_MeUnCtlPKpNeg_CUR Rail_MeUnCtlPKpPos_CUR Rail_MeUnCtlPKp_CUR Rail_pMeUnCtlIWinNeg_C Rail_pMeUnCtlIWinPos_C Rail_pMeUnCtlPWinNeg_C Rail_pMeUnCtlPWinPos_C Rail_pOvrMeUnThresHigh_C Rail_pOvrMeUnThresLow_C Rail_tiMeUnCtlDT1_CUR Rail_tiMeUnCtlPT1_CUR /end DEF_CHARACTERISTIC
 /begin IN_MEASUREMENT Eng_nAvrg /end IN_MEASUREMENT
/end FUNCTION
/begin FUNCTION rail_ctlloopparameun_uic ""
 /begin OUT_MEASUREMENT Rail_MeUnCtlDKd_mp Rail_MeUnCtlIKiNeg_mp Rail_MeUnCtlIKiPos_mp Rail_MeUnCtlIKi_mp Rail_MeUnCtlPKpNeg_mp Rail_MeUnCtlPKpPos_mp Rail_MeUnCtlPKp_mp Rail_tiMeUnCtlDT1_mp Rail_tiMeUnCtlPT1_mp /end OUT_MEASUREMENT
/end FUNCTION
/begin FUNCTION rail_ctlloopparapcv "Parameter für die Druckregelung ueber Druckregelventil"
 /begin DEF_CHARACTERISTIC Rail_facOvrPCVNegIncr_C Rail_PCVCtlDKd_CUR Rail_PCVCtlIKiNeg_CUR Rail_PCVCtlIKiPos_CUR Rail_PCVCtlIKi_CUR Rail_PCVCtlPKpNeg_CUR Rail_PCVCtlPKpPos_CUR Rail_PCVCtlPKp_CUR Rail_pOvrPCVThresHigh_C Rail_pOvrPCVThresLow_C Rail_pPCVCtlIWinNeg_C Rail_pPCVCtlIWinPos_C Rail_pPCVCtlPWinNeg_C Rail_pPCVCtlPWinPos_C Rail_tiPCVCtlDT1_CUR /end DEF_CHARACTERISTIC
 /begin IN_MEASUREMENT Eng_nAvrg /end IN_MEASUREMENT
/end FUNCTION
/begin FUNCTION rail_ctlloopparapcv_uic ""
 /begin OUT_MEASUREMENT Rail_PCVCtlDKd_mp Rail_PCVCtlIKiNeg_mp Rail_PCVCtlIKiPos_mp Rail_PCVCtlIKi_mp Rail_PCVCtlPKpNeg_mp Rail_PCVCtlPKpPos_mp Rail_PCVCtlPKp_mp Rail_tiPCVCtlDT1_mp /end OUT_MEASUREMENT
/end FUNCTION
/begin FUNCTION rail_ctllooppcv_msg "" /begin OUT_MEASUREMENT Rail_pPCVDvt Rail_pPCVSet Rail_stPCVWindUp /end OUT_MEASUREMENT /end FUNCTION
/begin FUNCTION rail_ctlloop_msg ""
 /begin OUT_MEASUREMENT Rail_dvolEstAged Rail_dvolMeUnCtlUpLim Rail_dvolPreCtl Rail_dvolPreCtlCor Rail_pDvt Rail_pPreCtlCor Rail_stCtlLoop Rail_stShOffTstAck /end OUT_MEASUREMENT
/end FUNCTION
/begin FUNCTION rail_ctlloop_uic ""
 /begin DEF_CHARACTERISTIC Rail_dvolMeUnSet_Vector Rail_dvolMeUnSet_Channel Rail_dvolPreCtlCor_Vector Rail_dvolPreCtlCor_Channel Rail_pPCVSet_Vector Rail_pPCVSet_Channel Rail_pPreCtlCor_Vector Rail_pPreCtlCor_Channel /end DEF_CHARACTERISTIC
/end FUNCTION
/begin FUNCTION rail_ctlmeun ""
 /begin DEF_CHARACTERISTIC Rail_dvolMeUnCtlInitI_CUR Rail_nMeUnFrzI_C Rail_pDvtFltMin_C Rail_tiFrzIDel_C /end DEF_CHARACTERISTIC
 /begin IN_MEASUREMENT FlSys_t /end IN_MEASUREMENT
/end FUNCTION
/begin FUNCTION rail_ctlmeun_uic ""
 /begin OUT_MEASUREMENT Rail_dvolMeUnCtlDT1_mp Rail_dvolMeUnCtlP_mp Rail_pDvtFltLim_mp Rail_pPeakFlt_mp Rail_stMeUnFrzI_mp /end OUT_MEASUREMENT
/end FUNCTION
/begin FUNCTION rail_ctlpcv "" /begin DEF_CHARACTERISTIC Rail_pPCVInitI_MAP Rail_swtPCVInitI_C /end DEF_CHARACTERISTIC /begin IN_MEASUREMENT Eng_nAvrg Rail_pSetPoint /end IN_MEASUREMENT /end FUNCTION
/begin FUNCTION rail_ctlpcv_uic ""
 /begin OUT_MEASUREMENT Rail_pPCVCtlDT1_mp Rail_pPCVCtlI_mp Rail_pPCVCtlPILim_mp Rail_pPCVCtlP_mp Rail_pPCVInitI_mp Rail_pWindUp_mp /end OUT_MEASUREMENT
/end FUNCTION
/begin FUNCTION rail_ctltypeswt "Umschaltbedingungen für das 2-Reglerkonzept"
 /begin DEF_CHARACTERISTIC Rail_DebCPCtlOn_C Rail_DebCPCtlOff_C Rail_dvolMeUnDvtNeg_C Rail_dvolMeUnDvtPos_C Rail_pMeUnCtlTypeHi_C Rail_pMeUnCtlTypeLo_C Rail_qCPCtlTypeHys_C Rail_qCPCtlType_CUR Rail_qMeUnCtlTypeHys_C Rail_qMeUnCtlType_CUR Rail_swtCtlType_C Rail_tiSwtCtlTypeDel_C Rail_tMeUnCtlTypeHi_C Rail_tMeUnCtlTypeLo_C Rail_tSwtCPCHi_C Rail_tSwtCPCLo_C /end DEF_CHARACTERISTIC
 /begin IN_MEASUREMENT Eng_nAvrg /end IN_MEASUREMENT
/end FUNCTION
/begin FUNCTION rail_ctltypeswt_uic ""
 /begin OUT_MEASUREMENT Rail_qCPCtlType_mp Rail_qMeUnCtlType_mp Rail_stSwtCon_mp Rail_stSwtCPCCon_mp /end OUT_MEASUREMENT
/end FUNCTION
/begin FUNCTION rail_igovcalc "" /end FUNCTION
/begin FUNCTION rail_igovcalc_uic "" /end FUNCTION
/begin FUNCTION rail_moncpc "Raildruckueberwachung für die gekoppelte Drucküberwachung (CPC)"
 /begin DEF_CHARACTERISTIC Rail_DebCPC1MaxDef_C Rail_DebCPC1MaxOk_C Rail_DebCPC3MaxDef_C Rail_DebCPC3MaxOk_C Rail_DebCPC4MaxDef_C Rail_DebCPC4MaxOk_C Rail_pCPCPeakMax_C Rail_pCPCPeakMin_CUR /end DEF_CHARACTERISTIC
 /begin IN_MEASUREMENT Eng_nAvrg /end IN_MEASUREMENT
/end FUNCTION
/begin FUNCTION rail_moncpc_msg "" /end FUNCTION
/begin FUNCTION rail_moncpc_uic ""
 /begin OUT_MEASUREMENT Rail_pCPCPeakMin_mp Rail_stCPCMon1_mp Rail_stCPCMon3_mp Rail_stCPCMon4_mp /end OUT_MEASUREMENT
/end FUNCTION
/begin FUNCTION rail_monmeun "Raildruckueberwachung für die Druckregelung ueber Zumesseinheit"
 /begin DEF_CHARACTERISTIC Rail_DebMeUn0MaxDef_C Rail_DebMeUn0MaxOk_C Rail_DebMeUn1MaxDef_C Rail_DebMeUn1MaxOk_C Rail_DebMeUn2MaxDef_C Rail_DebMeUn2MaxOk_C Rail_DebMeUn3MaxDef_C Rail_DebMeUn3MaxOk_C Rail_DebMeUn4MaxDef_C Rail_DebMeUn4MaxOk_C Rail_dvolMeUnSetMin_C Rail_pMeUnPeakMax_C Rail_pMeUnDvtMax_C Rail_qMeUnLoIdle_C Rail_stMonMeUnRls_C Rail_tMeUnLoIdle_C Rail_pMeUnDvtMax_CUR Rail_pMeUnDvtMin_CUR Rail_pMeUnPeakMin_CUR /end DEF_CHARACTERISTIC
 /begin IN_MEASUREMENT Eng_nAvrg /end IN_MEASUREMENT
/end FUNCTION
/begin FUNCTION rail_monmeun_msg "" /end FUNCTION
/begin FUNCTION rail_monmeun_uic ""
 /begin OUT_MEASUREMENT Rail_pMeUnDvtMax_mp Rail_pMeUnDvtMin_mp Rail_pMeUnPeakMin_mp Rail_stMeUnMon0_mp Rail_stMeUnMon1_mp Rail_stMeUnMon2_mp Rail_stMeUnMon3_mp Rail_stMeUnMon4_mp Rail_tiMeUn0Deb_mp Rail_tiMeUn1Deb_mp Rail_tiMeUn2Deb_mp Rail_tiMeUn3Deb_mp Rail_tiMeUn4Deb_mp /end OUT_MEASUREMENT
/end FUNCTION
/begin COMPU_METHOD AirMassPerTime "Luftmasse pro Zeit" RAT_FUNC "%6.3" "Kg/h" COEFFS 0 10 0 0 0 1 /end COMPU_METHOD
/begin COMPU_METHOD B_TRUE "Umrechnung   ----> FALSE;    TRUE = TRUE" TAB_VERB "%6.3" "-" COMPU_TAB_REF B_TRUE /end COMPU_METHOD
/begin COMPU_VTAB B_TRUE "Umrechnung   ----> FALSE;    TRUE = TRUE" TAB_VERB 2 0 "----" 1 "TRUE" /end COMPU_VTAB
/begin COMPU_METHOD CubMtrPerHr "Volumsstrom in m^3/h" RAT_FUNC "%6.3" "m^3/h" COEFFS 0 10 0 0 0 1 /end COMPU_METHOD
/begin COMPU_METHOD CubMtrPerHrPerSec "Volumenstromdifferenz pro Sekunde" RAT_FUNC "%6.3" "m^3/h/s" COEFFS 0 10 0 0 0 1 /end COMPU_METHOD
/begin COMPU_METHOD DEZ "K3 Umwandlungen" RAT_FUNC "%6.2" "-" COEFFS 0 1 0 0 0 1 /end COMPU_METHOD
/begin COMPU_METHOD DtyCyc "Tastverhaeltnis" RAT_FUNC "%6.4" "%" COEFFS 0 100 0 0 0 1 /end COMPU_METHOD
/begin COMPU_METHOD EngN "Motordrehzahl" RAT_FUNC "%6.2" "rpm" COEFFS 0 1 0 0 0 1 /end COMPU_METHOD
/begin COMPU_METHOD EngTempFldSel "Verbale Umrechnung für Auswahl aus dem Motortemperatur-Feld Eng_tFld" TAB_VERB "%6.3" "-" COMPU_TAB_REF EngTempFldSel /end COMPU_METHOD
/begin COMPU_VTAB EngTempFldSel "Verbale Umrechnung für Auswahl aus dem Motortemperatur-Feld Eng_tFld" TAB_VERB 3 0 "Coolant_Temperature" 1 "Oil_Temperature" 2 "Eng_tEng" /end COMPU_VTAB
/begin COMPU_METHOD Fact "Faktor mit Auflösung 1 / 8192, hauptsächlich für einen Faktorenbereich 0...1 verwendet" RAT_FUNC "%6.5" "-" COEFFS 0 8192 0 0 0 1 /end COMPU_METHOD
/begin COMPU_METHOD Fact1 "Faktor mit Auflösung 0,01 (100 mal höherer Bereich als Fact)" RAT_FUNC "%6.4" "-" COEFFS 0 128 0 0 0 1 /end COMPU_METHOD
/begin COMPU_METHOD Fact100 "Faktor mit einer Auflösung von 0,01" RAT_FUNC "%6.4" "-" COEFFS 0 100 0 0 0 1 /end COMPU_METHOD
/begin COMPU_METHOD FactLow "Faktor mit Auflösung 1/1024, hauptsächlich für einen Faktorenbereich 1...50 verwendet" RAT_FUNC "%6.5" "-" COEFFS 0 1024 0 0 0 1 /end COMPU_METHOD
/begin COMPU_METHOD FlConsum_l_h "Kraftstoffverbrauch" RAT_FUNC "%6.4" "l/h" COEFFS 0 100 0 0 0 1 /end COMPU_METHOD
/begin COMPU_METHOD hPaPerSec "Differenzdruck pro Sekunde" RAT_FUNC "%6.3" "hPa/s" COEFFS 0 10 0 0 0 1 /end COMPU_METHOD
/begin COMPU_METHOD InjMassCyc "Einspritzmenge pro Zyklus (mg/Zyklus)" RAT_FUNC "%6.4" "mg/cyc" COEFFS 0 100 0 0 0 1 /end COMPU_METHOD
/begin COMPU_METHOD InjMassInj "Einspritzmenge pro Einspritzung (mg/Einspritzung)" RAT_FUNC "%6.4" "mg/inj" COEFFS 0 100 0 0 0 1 /end COMPU_METHOD
/begin COMPU_METHOD InjTime_us "Zeit in Microsekunden für das Einspritztiming" RAT_FUNC "%6.2" "us" COEFFS 0 1 0 0 0 1 /end COMPU_METHOD
/begin COMPU_METHOD Kd "Differentialverstärkung Kd (gleiche Einheit/Umrechnungsformel an Ein- und Ausgang)" RAT_FUNC "%7.6" "1/1" COEFFS 0 65536 0 0 0 1 /end COMPU_METHOD
/begin COMPU_METHOD Kd_1 "Differentialverstärkung Kd (gleiche Einheit/Umrechnungsregel an Ein- und Ausgang; Umrechnung für sint16-Werte)" RAT_FUNC "%6.4" "1/1" COEFFS 0 512 0 0 0 1 /end COMPU_METHOD
/begin COMPU_METHOD Kd_pRail2Q "Differentialverstärkung (Raildruck zu Menge)" RAT_FUNC "%11.4" "mm^3/s/bar" COEFFS 0 655.360000 0 0 0 1 /end COMPU_METHOD
/begin COMPU_METHOD Kd_pRail2Q_1 "Differentialverstärkung mit Normexponent (Raildruck zu Menge)" RAT_FUNC "%10.3" "mm^3/s/bar" COEFFS 0 40.960000 0 0 0 1 /end COMPU_METHOD
/begin COMPU_METHOD Ki "Integrale Verstärkung Ki (gleiche Einheit/Umrechnungsregel an Ein- und Ausgang)" RAT_FUNC "%6.5" "1/s" COEFFS 0 4294.967296 0 0 0 1 /end COMPU_METHOD
/begin COMPU_METHOD Ki_1 "Integrale Verstärkung Ki (gleiche Einheit/Umrechnungsregel an Ein- und Ausgang; Umrechnung für sint16-Werte)" RAT_FUNC "%6.4" "1/s" COEFFS 0 67.108864 0 0 0 1 /end COMPU_METHOD
/begin COMPU_METHOD Ki_pRail2Q "Integralverstärkung (Raildruck zu Menge)" RAT_FUNC "%10.3" "mm^3/s^2/bar" COEFFS 0 42.949673 0 0 0 1 /end COMPU_METHOD
/begin COMPU_METHOD Ki_pRail2Q_1 "Intgralverstärkung mit Normexponent (Raildruck zu Menge)" RAT_FUNC "%10.3" "mm^3/s^2/bar" COEFFS 0 10.737418 0 0 0 1 /end COMPU_METHOD
/begin COMPU_METHOD Ki_Vel2TrqPrp "Integralverstärkung (Fahrgeschwindigkeit zu Vortriebsmoment)" RAT_FUNC "%6.4" "Nm/(km/h)/s" COEFFS 0 214.7483648 0 0 0 1 /end COMPU_METHOD
/begin COMPU_METHOD Kp "proportionale Verstärkung Kp (gleiche Einheit/Umrechnungsregel an Ein- und Ausgang)" RAT_FUNC "%7.6" "1/1" COEFFS 0 65536 0 0 0 1 /end COMPU_METHOD
/begin COMPU_METHOD Kp_1 "proportionale Verstärkung Kp (gleiche Einheit/Umrechnungsregel an Ein- und Ausgang; Umrechnung für sint16-Werte)" RAT_FUNC "%6.4" "1/1" COEFFS 0 64 0 0 0 1 /end COMPU_METHOD
/begin COMPU_METHOD Kp_pRail2Q "Proportionale Verstärkung Kp (Raildruck zu Menge)" RAT_FUNC "%11.4" "mm^3/s/bar" COEFFS 0 655.360000 0 0 0 1 /end COMPU_METHOD
/begin COMPU_METHOD Kp_pRail2Q_1 "Proportionale Verstärkung mit Normexponent (Raildruck zu Menge)" RAT_FUNC "%10.3" "mm^3/s/bar" COEFFS 0 81.920000 0 0 0 1 /end COMPU_METHOD
/begin COMPU_METHOD Kp_Vel2TrqPrp "Proportionalverstärkung (Fahrgeschwindigkeit zu Vortriebsmoment)" RAT_FUNC "%6.5" "Nm/(km/h)" COEFFS 0 3276.8 0 0 0 1 /end COMPU_METHOD
/begin COMPU_METHOD Length "Länge in Meter" RAT_FUNC "%6.2" "m" COEFFS 0 1 0 0 0 1 /end COMPU_METHOD
/begin COMPU_METHOD LengthKm "Länge in Kilometer" RAT_FUNC "%6.2" "km" COEFFS 0 1 0 0 0 1 /end COMPU_METHOD
/begin COMPU_METHOD mSoot_g "Rußmasse [g]" RAT_FUNC "%6.4" "g" COEFFS 0 100 0 0 0 1 /end COMPU_METHOD
/begin COMPU_METHOD NumPinAdc "verbale Umrechnung für ADC Signale" TAB_VERB "%6.3" "-" COMPU_TAB_REF NumPinAdc /end COMPU_METHOD
/begin COMPU_VTAB NumPinAdc "verbale Umrechnung für ADC Signale" TAB_VERB 61 0 "ADC_REF" 1 "Voltage_Lambda1_Ua" 2 "Voltage_Lambda1_Ri" 3 "Temperature_ECU_PCB" 4 "Voltage_Bank_1" 5 "Voltage_Bank_2" 6 "ADC_DUMMYA" 7 "1st_APP_Sensor_252" 8 "ADC_Reserve-S1" 9 "2nd_APP_Sensor_239" 10 "ADC_Reserve-S2" 11 "Water_Temperature_Sensor_182" 12 "TKS" 13 "Charge_Air_Temperature_Sensor_183_2" 14 "Exhaust_Temperature_Sensor_1_MASTER_158" 15 "Exhaust_Temperature_Sensor_1_SLAVE_158" 16 "Atmospheric_Pressure_Sensor" 17 "Charge_Air_Temperature_Sensor_183" 18 "ADC_DUMMYB_NOT_USED" 19 "Rail_Pressure_Peak_Value_156" 20 "Rail_Pressure_Peak_Value-DummySlave" 21 "Boost_Pressure_Sensor_154" 22 "Boost_Pressure_Sensor_2" 23 "Booster_Voltage_Sensor" 24 "Rail_Pressure_Sensor_156" 25 "Pressure_Upstream_Particle_Filter_MASTER_159" 26 "Pressure_Upstream_Particle_Filter_SLAVE_159" 27 "Temperature_Upstream_Particle_Filter_MASTER_134" 28 "Temperature_Upstream_Particle_Filter_SLAVE_134" 29 "Current_MeUn_Sensor" 30 "Current_PCV_Sensor" 31 "Engine_Oil_Pressure_110" 32 "Battery_Voltage_Sensor" 33 "ADC_DUMMY_SLAVE_NOT_USED" 34 "ADC_DUMMY_NOT_USED" 35 "Charge_Actuator_Event_0" 36 "Voltage_Piezo_Actuator_Bank_2_Event_0" 37 "Voltage_Piezo_Actuator_Bank_1_Event_0" 38 "Charge_Actuator_Event_1" 39 "Voltage_Piezo_Actuator_Bank_2_Event_1" 40 "Voltage_Piezo_Actuator_Bank_1_Event_1" 41 "Charge_Actuator_Event_2" 42 "Voltage_Piezo_Actuator_Bank_2_Event_2" 43 "Voltage_Piezo_Actuator_Bank_1_Event_2" 44 "Charge_Actuator_Event_3" 45 "Voltage_Piezo_Actuator_Bank_2_Event_3" 46 "Voltage_Piezo_Actuator_Bank_1_Event_3" 47 "Charge_Actuator_Event_4" 48 "Voltage_Piezo_Actuator_Bank_2_Event_4" 49 "Voltage_Piezo_Actuator_Bank_1_Event_4" 50 "Charge_Actuator_Event_5" 51 "Voltage_Piezo_Actuator_Bank_2_Event_5" 52 "Voltage_Piezo_Actuator_Bank_1_Event_5" 53 "Charge_Actuator_Event_6" 54 "Voltage_Piezo_Actuator_Bank_2_Event_6" 55 "Voltage_Piezo_Actuator_Bank_1_Event_6" 56 "Charge_Actuator_Event_7" 57 "Voltage_Piezo_Actuator_Bank_2_Event_7" 58 "Voltage_Piezo_Actuator_Bank_1_Event_7" 59 "Booster_Voltage_Piezo" 60 "Piezo_Voltage" /end COMPU_VTAB
/begin COMPU_METHOD OneToOne "eins zu eins (physikalischer Wert ist gleich dem internen Wert)" RAT_FUNC "%6.2" "-" COEFFS 0 1 0 0 0 1 /end COMPU_METHOD
/begin COMPU_METHOD Prc "Prozent, gleiche interne Auflösung wie Fact, aber Darstellung in Prozent (0...100%)" RAT_FUNC "%6.4" "%" COEFFS 0 81.92 0 0 0 1 /end COMPU_METHOD
/begin COMPU_METHOD PresRail_sec "Raildruckerhöhung/absenkung in hPa/s" RAT_FUNC "%4.3" "bar/s" COEFFS 0 2.500000 0 0 0 1 /end COMPU_METHOD
/begin COMPU_METHOD Pres_hPa "Druck (angezeigt in [hPa])" RAT_FUNC "%6.2" "hPa" COEFFS 0 1 0 0 0 1 /end COMPU_METHOD
/begin COMPU_METHOD Pres_Rail "Raildruck in hPa" RAT_FUNC "%4.3" "bar" COEFFS 0 10.000000 0 0 0 1 /end COMPU_METHOD
/begin COMPU_METHOD QltDet "" TAB_VERB "%6.3" "-" COMPU_TAB_REF QltDet /end COMPU_METHOD
/begin COMPU_VTAB QltDet "" TAB_VERB 3 0 "Detection_Ready" 1 "Detection Init" 2 "Detection Diagnose" /end COMPU_VTAB
/begin COMPU_METHOD Qp_mm3_sec "Umrechnung für Volumenstrom" RAT_FUNC "%6.1" "mm3/s" COEFFS 0 0.1 0 0 0 1 /end COMPU_METHOD
/begin COMPU_METHOD Res_hPaHrPerCM "Strömungswiderstand [hPa h/m3]" RAT_FUNC "%6.5" "hPa/(m^3/h)" COEFFS 0 1000 0 0 0 1 /end COMPU_METHOD
/begin COMPU_METHOD TempDiff_Cels "difference/offset temperature displayed in degree celcius" RAT_FUNC "%6.3" "deg C" COEFFS 0 10 0 0 0 1 /end COMPU_METHOD
/begin COMPU_METHOD Temp_Cels "Temperatur dargestellt in °C (gleiche interne Darstellung wie Temp_Kelv)" RAT_FUNC "%6.1" "deg C" COEFFS 0 10 2731.4 0 0 1 /end COMPU_METHOD
/begin COMPU_METHOD Temp_Kelv "Temperatur dargestellt in Kelvin" RAT_FUNC "%6.3" "deg C" COEFFS 0 10 0 0 0 1 /end COMPU_METHOD
/begin COMPU_METHOD Thr_Cpty "Wärmekapazität" RAT_FUNC "%6.2" "J/K" COEFFS 0 1 0 0 0 1 /end COMPU_METHOD
/begin COMPU_METHOD Thr_Cpty_ExhGs "Wärmekapazität des Abgases" RAT_FUNC "%6.2" "J/kgK" COEFFS 0 0.1 0 0 0 1 /end COMPU_METHOD
/begin COMPU_METHOD TimeADCFilt "Zeit, spezielle Aufloesung für ADCFilt" RAT_FUNC "%6.4" "ms" COEFFS 0 256.016385048643 0 0 0 1 /end COMPU_METHOD
/begin COMPU_METHOD TimeDeb "Entprellzeit in Millisekunden für Libraryfunktion Debounce" RAT_FUNC "%6.1" "ms" COEFFS 0 0.1 0 0 0 1 /end COMPU_METHOD
/begin COMPU_METHOD TimeDelay_s "Zeitkonstante T1 (in s) für PT1, DT1, etc." RAT_FUNC "%9.3" "s" COEFFS 0 0 1 0 0.00023283064365387 0 /end COMPU_METHOD
/begin COMPU_METHOD TimeDelay_s_2 "Zeitkonstante T1 (in s) für PT1, DT1, etc. normiert auf 16 bit" RAT_FUNC "%9.4" "s" COEFFS 0 0 1 0 0.0596046447753906 0 /end COMPU_METHOD
/begin COMPU_METHOD TimeDelay_s_Lin_16_2 "Umrechung für Verzögerungszeitapplikation" RAT_FUNC "%6.4" "s" COEFFS 0 16.3835 0 0 0 1 /end COMPU_METHOD
/begin COMPU_METHOD TimeEngOn "Motorbetriebszeit in Sekunden" RAT_FUNC "%6.2" "s" COEFFS 0 1 0 0 0 1 /end COMPU_METHOD
/begin COMPU_METHOD TimeRed "Zeit in Sekunden mit reduzierter Auflösung für Ein/Ausgänge von KL/KF (sint16)" RAT_FUNC "%6.3" "s" COEFFS 0 6.25 0 0 0 1 /end COMPU_METHOD
/begin COMPU_METHOD Time_ms "Zeit in ms für Fehlerentprellung (DSM) und SW-Timer" RAT_FUNC "%6.1" "ms" COEFFS 0 0.1 0 0 0 1 /end COMPU_METHOD
/begin COMPU_METHOD Time_s "Zeit in s für Fehlerentprellung (DSM) und SW-Timer" RAT_FUNC "%6.4" "s" COEFFS 0 100 0 0 0 1 /end COMPU_METHOD
/begin COMPU_METHOD Trq "Motormoment" RAT_FUNC "%6.3" "Nm" COEFFS 0 10 0 0 0 1 /end COMPU_METHOD
/begin COMPU_METHOD TrqPrp "Vortriebsmoment" RAT_FUNC "%6.3" "Nm" COEFFS 0 5 0 0 0 1 /end COMPU_METHOD
/begin COMPU_METHOD Vel "Fahrzeuggeschwindigkeit, gleiche interne Auflösung wie Vel_SI" RAT_FUNC "%6.4" "km/h" COEFFS 0 100 0 0 0 1 /end COMPU_METHOD
/begin COMPU_METHOD Volt "Spannung in V (von ADC)" RAT_FUNC "%6.2" "mV" COEFFS 0 0.2046 0 0 0 1 /end COMPU_METHOD
/begin COMPU_METHOD Volt_Batt "Batteriespannung" RAT_FUNC "%6.1" "mV" COEFFS 0 0.05115 0 0 0 1 /end COMPU_METHOD
/begin RECORD_LAYOUT Kf_Xs16_Ys16_Ws16 NO_AXIS_PTS_X 1 SWORD NO_AXIS_PTS_Y 2 SWORD AXIS_PTS_X 3 SWORD INDEX_INCR DIRECT AXIS_PTS_Y 4 SWORD INDEX_INCR DIRECT FNC_VALUES 5 SWORD COLUMN_DIR DIRECT /end RECORD_LAYOUT
/begin RECORD_LAYOUT Kl_Xs16_Ws16 NO_AXIS_PTS_X 1 SWORD AXIS_PTS_X 2 SWORD INDEX_INCR DIRECT FNC_VALUES 3 SWORD COLUMN_DIR DIRECT /end RECORD_LAYOUT
/begin RECORD_LAYOUT Kw_Ws16 FNC_VALUES 1 SWORD COLUMN_DIR DIRECT /end RECORD_LAYOUT
/begin RECORD_LAYOUT Kw_Ws32 FNC_VALUES 1 SLONG COLUMN_DIR DIRECT /end RECORD_LAYOUT
/begin RECORD_LAYOUT Kw_Ws8 FNC_VALUES 1 SBYTE COLUMN_DIR DIRECT /end RECORD_LAYOUT
/begin RECORD_LAYOUT Kw_Wu16 FNC_VALUES 1 UWORD COLUMN_DIR DIRECT /end RECORD_LAYOUT
/begin RECORD_LAYOUT Kw_Wu32 FNC_VALUES 1 ULONG COLUMN_DIR DIRECT /end RECORD_LAYOUT
/begin RECORD_LAYOUT Kw_Wu8 FNC_VALUES 1 UBYTE COLUMN_DIR DIRECT /end RECORD_LAYOUT
/end MODULE
/end PROJECT
