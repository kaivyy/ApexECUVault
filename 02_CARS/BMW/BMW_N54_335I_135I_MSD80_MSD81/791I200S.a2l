ASAP2_VERSION 1 41
/begin PROJECT MSD85 "Spray Guided DI-System with Piezo Injectors for 8-Cylinder"
/begin HEADER "_default_HeaderComment" PROJECT_NO _91 /end HEADER
/begin MODULE _default_ModuleName "_default_ModuleLongIdentifier"
/begin MOD_COMMON "_default_ModCommonComment" DEPOSIT ABSOLUTE BYTE_ORDER MSB_LAST ALIGNMENT_BYTE 1 ALIGNMENT_WORD 2 ALIGNMENT_LONG 2 ALIGNMENT_FLOAT32_IEEE 2 ALIGNMENT_FLOAT64_IEEE 4 /end MOD_COMMON
/begin MEASUREMENT lam_bank_1.lam_dlyl.bf.lv_ldc_dly "status limited dynamic" ULONG _CNV_S_2_RANGE______76_CM 1 100. 0. 1. DISPLAY_IDENTIFIER LV_LDC_DLY_1 ECU_ADDRESS 0xd000b880 BIT_MASK 0x1 /end MEASUREMENT
/begin MEASUREMENT lam_bank_1.lam_dlyl.bf.lv_lam_mv_ldc_dly "status limited dynamic FAC_LAM_MV[NC_CBK_EX_NR]" ULONG _CNV_S_2_RANGE______76_CM 1 100. 0. 1. DISPLAY_IDENTIFIER LV_LAM_MV_LDC_DLY_1 ECU_ADDRESS 0xd000b880 BIT_MASK 0x2 /end MEASUREMENT
/begin MEASUREMENT lam_bank_1.lam_dlyl.fac_lam_mv_mmv_dly "floating mean value for limited lambda deviation" SWORD _CNV_A_R_LINEAR_____113_CM 1 100. -50. 49.9984741210938 DISPLAY_IDENTIFIER FAC_LAM_MV_MMV_DLY ECU_ADDRESS 0xd000b882 FORMAT "%7.3" /end MEASUREMENT
/begin MEASUREMENT lam_bank_1.lam_dlyl.maf_int_ldc_dly "integral of mass air flow since limited dynamic conditions are fulfilled" UWORD _CNV_A_R_LINEAR_____210_CM 1 100. 0. 1820.398 DISPLAY_IDENTIFIER MAF_INT_LDC_DLY_1 ECU_ADDRESS 0xd000b884 FORMAT "%7.2" /end MEASUREMENT
/begin MEASUREMENT lam_bank_2.lam_dlyl.bf.lv_ldc_dly "status limited dynamic" ULONG _CNV_S_2_RANGE______76_CM 1 100. 0. 1. DISPLAY_IDENTIFIER LV_LDC_DLY_2 ECU_ADDRESS 0xd000b8fc BIT_MASK 0x1 /end MEASUREMENT
/begin MEASUREMENT lam_bank_2.lam_dlyl.bf.lv_lam_mv_ldc_dly "status limited dynamic FAC_LAM_MV[NC_CBK_EX_NR]" ULONG _CNV_S_2_RANGE______76_CM 1 100. 0. 1. DISPLAY_IDENTIFIER LV_LAM_MV_LDC_DLY_2 ECU_ADDRESS 0xd000b8fc BIT_MASK 0x2 /end MEASUREMENT
/begin MEASUREMENT lam_bank_2.lam_dlyl.fac_lam_mv_mmv_dly "floating mean value for limited lambda deviation" SWORD _CNV_A_R_LINEAR_____113_CM 1 100. -50. 49.9984741210938 DISPLAY_IDENTIFIER FAC_LAM_MV_MMV_DLY ECU_ADDRESS 0xd000b8fe FORMAT "%7.3" /end MEASUREMENT
/begin MEASUREMENT lam_bank_2.lam_dlyl.maf_int_ldc_dly "integral of mass air flow since limited dynamic conditions are fulfilled" UWORD _CNV_A_R_LINEAR_____210_CM 1 100. 0. 1820.398 DISPLAY_IDENTIFIER MAF_INT_LDC_DLY_2 ECU_ADDRESS 0xd000b900 FORMAT "%7.2" /end MEASUREMENT
/begin CHARACTERISTIC lc_rpu_lamb_rgn_1 "Switch to use RPU value of LAMB_RGN_i" VALUE 0xa080c5e1 _REC_VAL_20_u1 1. _CNV_A_R_LINEAR_____0_CM 0. 1. DISPLAY_IDENTIFIER LC_RPU_LAMB_RGN_1 FORMAT "%1.0" /end CHARACTERISTIC
/begin MEASUREMENT t_rgn "Time counter for active regeneration" UWORD _CNV_A_R_LINEAR_____3_CM 1 100. 0. 655.35 DISPLAY_IDENTIFIER T_RGN ECU_ADDRESS 0xd000a4bc FORMAT "%6.2" /end MEASUREMENT
/begin MEASUREMENT t_rgn_2 "Time counter for second regeneration" UWORD _CNV_A_R_LINEAR_____3_CM 1 100. 0. 655.35 DISPLAY_IDENTIFIER T_RGN_2 ECU_ADDRESS 0xd000a4be FORMAT "%6.2" /end MEASUREMENT
/begin MEASUREMENT lv_lamb_park_afl_deac "Deactivation flag for regeneration depending on T_RGN_2" UBYTE _CNV_S_2_RANGE__0___1_CM 1 100. 0. 1. DISPLAY_IDENTIFIER LV_LAMB_PARK_AFL_DEAC ECU_ADDRESS 0xd0001323 BIT_MASK 0x1 /end MEASUREMENT
/begin MEASUREMENT lv_lamb_sp_swi "Flag of alternate" UBYTE _CNV_S_2_RANGE__0___1_CM 1 100. 0. 1. DISPLAY_IDENTIFIER LV_LAMB_SP_SWI ECU_ADDRESS 0xd00088f3 BIT_MASK 0x1 /end MEASUREMENT
/begin MEASUREMENT maf_kgh_hom "Calculated MAF_KGH for homogeneous operation" UWORD _CNV_A_R_LINEAR_____215_CM 1 100. 0. 2047.96875 DISPLAY_IDENTIFIER MAF_KGH_HOM ECU_ADDRESS 0xd000a4c4 FORMAT "%10.5" /end MEASUREMENT
/begin CHARACTERISTIC c_lamb_purge_l_ampl "Lambda purge for low amplitude regeneration" VALUE 0xa080bde8 _REC_VAL_20_u2 31.9990234375 _CNV_A_R_LINEAR_____129_CM 0. 31.9990234375 DISPLAY_IDENTIFIER C_LAMB_PURGE_L_AMPL FORMAT "%7.4" /end CHARACTERISTIC
/begin CHARACTERISTIC c_lamb_pas_bas "Basis lambda setpoint for passive state" VALUE 0xa080bde4 _REC_VAL_20_u2 31.9990234375 _CNV_A_R_LINEAR_____129_CM 0. 31.9990234375 DISPLAY_IDENTIFIER C_LAMB_PAS_BAS FORMAT "%7.4" /end CHARACTERISTIC
/begin CHARACTERISTIC c_maf_kgh_thr_max "Definition of max MAF_KGH for calculation of lambda setpoint depending on MAF_KGH" VALUE 0xa080be36 _REC_VAL_20_u2 2047.96875 _CNV_A_R_LINEAR_____215_CM 0. 2047.96875 DISPLAY_IDENTIFIER C_MAF_KGH_THR_MAX FORMAT "%10.5" /end CHARACTERISTIC
/begin CHARACTERISTIC c_maf_kgh_thr_min "Definition of min MAF_KGH for calculation of lambda setpoint depending on MAF_KGH" VALUE 0xa080be38 _REC_VAL_20_u2 2047.96875 _CNV_A_R_LINEAR_____215_CM 0. 2047.96875 DISPLAY_IDENTIFIER C_MAF_KGH_THR_MIN FORMAT "%10.5" /end CHARACTERISTIC
/begin CHARACTERISTIC c_state_lamb_rgn_2_h_ampl "Lambda setpoint correction strategy for second high amplitude regeneration" VALUE 0xa080c0e3 _REC_VAL_20_u1 3. _CNV_S_4_RANGE_C_ST_216_CM 0. 3. DISPLAY_IDENTIFIER C_STATE_LAMB_RGN_2_H_AMPL /end CHARACTERISTIC
/begin CHARACTERISTIC c_state_lamb_rgn_l_ampl "Strategy for low amplitude regeneration" VALUE 0xa080c0e4 _REC_VAL_20_u1 3. _CNV_S_4_RANGE_C_ST_217_CM 0. 3. DISPLAY_IDENTIFIER C_STATE_LAMB_RGN_L_AMPL /end CHARACTERISTIC
/begin CHARACTERISTIC c_state_lamb_rgn_l_ampl_bas "Basis low amplitude lambda regeneration state" VALUE 0xa080c0e5 _REC_VAL_20_u1 2. _CNV_S_3_RANGE_C_ST_218_CM 0. 2. DISPLAY_IDENTIFIER C_STATE_LAMB_RGN_L_AMPL_BAS /end CHARACTERISTIC
/begin CHARACTERISTIC c_state_lamb_rgn_1_h_ampl "Lambda setpoint correction strategy for first high amplitude regeneration" VALUE 0xa080c0e2 _REC_VAL_20_u1 3. _CNV_S_4_RANGE_C_ST_216_CM 0. 3. DISPLAY_IDENTIFIER C_STATE_LAMB_RGN_1_H_AMPL /end CHARACTERISTIC
/begin CHARACTERISTIC c_t_purge_h_ampl "Purge time for high amplitude regeneration" VALUE 0xa080c25c _REC_VAL_20_u2 655.35 _CNV_A_R_LINEAR_____3_CM 0. 655.35 DISPLAY_IDENTIFIER C_T_PURGE_H_AMPL FORMAT "%6.2" /end CHARACTERISTIC
/begin CHARACTERISTIC c_t_purge_l_ampl "Purge time for low amplitude regeneration" VALUE 0xa080c25e _REC_VAL_20_u2 655.35 _CNV_A_R_LINEAR_____3_CM 0. 655.35 DISPLAY_IDENTIFIER C_T_PURGE_L_AMPL FORMAT "%6.2" /end CHARACTERISTIC
/begin CHARACTERISTIC c_vls_park_t_rgn_2_deac "Threshold value for switch from lean to stoichiometric park at second regeneration" VALUE 0xa080c472 _REC_VAL_20_u2 1400. _CNV_A_R_LINEAR_____219_CM -200. 1200. DISPLAY_IDENTIFIER C_VLS_PARK_T_RGN_2_DEAC FORMAT "%4.0" /end CHARACTERISTIC
/begin AXIS_PTS ldp_vls_h_ampl_2_ip_lamb_fac "" 0xa08091b8 vls_nox_sens[0] _REC_AXS_20_u2 1400. _CNV_A_R_LINEAR_____219_CM 8 -200. 1200. FORMAT "%4.0" /end AXIS_PTS
/begin AXIS_PTS ldp_t_rgn_2_l_ampl_ip_lamb_fac "" 0xa0808d8c t_rgn_2 _REC_AXS_20_u2 655.35 _CNV_A_R_LINEAR_____3_CM 8 0. 655.35 FORMAT "%6.2" /end AXIS_PTS
/begin AXIS_PTS ldp_vls_h_ampl_1_ip_lamb_fac "" 0xa08091a4 vls_nox_sens[0] _REC_AXS_20_u2 1400. _CNV_A_R_LINEAR_____219_CM 8 -200. 1200. FORMAT "%4.0" /end AXIS_PTS
/begin AXIS_PTS ldp_vls_park_1_ip_lamb_fac "" 0xa08091f4 vls_nox_sens[0] _REC_AXS_20_u2 1400. _CNV_A_R_LINEAR_____219_CM 8 -200. 1200. FORMAT "%4.0" /end AXIS_PTS
/begin AXIS_PTS ldp_t_rgn_1_park_ip_lamb_fac "" 0xa0808d78 t_rgn _REC_AXS_20_u2 655.35 _CNV_A_R_LINEAR_____3_CM 8 0. 655.35 FORMAT "%6.2" /end AXIS_PTS
/begin AXIS_PTS ldp_t_rgn_2_park_ip_lamb_fac "" 0xa0808da0 t_rgn_2 _REC_AXS_20_u2 655.35 _CNV_A_R_LINEAR_____3_CM 8 0. 655.35 FORMAT "%6.2" /end AXIS_PTS
/begin CHARACTERISTIC ip_lamb_fac_park_2_t_rgn_2 "Lambda setpoint correction factor for park depending on T_RGN_2" CURVE 0xa080ae28 _REC_CUR_20_u1_u2 1.9921875 _CNV_A_R_LINEAR_____103_CM 0. 1.9921875 DISPLAY_IDENTIFIER IP_LAMB_FAC_PARK_2_T_RGN_2 FORMAT "%8.6"
 /begin AXIS_DESCR COM_AXIS t_rgn_2 _CNV_A_R_LINEAR_____3_CM 8 0. 655.35 FORMAT "%6.2" AXIS_PTS_REF ldp_t_rgn_2_park_ip_lamb_fac /end AXIS_DESCR
/end CHARACTERISTIC
/begin AXIS_PTS ldp_vls_l_ampl_2_ip_lamb_fac "" 0xa08091e0 vls_nox_sens[0] _REC_AXS_20_u2 1400. _CNV_A_R_LINEAR_____219_CM 8 -200. 1200. FORMAT "%4.0" /end AXIS_PTS
/begin AXIS_PTS ldp_vls_l_ampl_1_ip_lamb_fac "" 0xa08091cc vls_nox_sens[0] _REC_AXS_20_u2 1400. _CNV_A_R_LINEAR_____219_CM 8 -200. 1200. FORMAT "%4.0" /end AXIS_PTS
/begin AXIS_PTS ldp_t_rgn_1_l_ampl_ip_lamb_fac "" 0xa0808d64 t_rgn _REC_AXS_20_u2 655.35 _CNV_A_R_LINEAR_____3_CM 8 0. 655.35 FORMAT "%6.2" /end AXIS_PTS
/begin AXIS_PTS ldp_maf_kgh_l_ampl_ip_lamb_fac "" 0xa08088a4 maf_kgh_hom _REC_AXS_20_u2 2047.96875 _CNV_A_R_LINEAR_____215_CM 4 0. 2047.96875 FORMAT "%10.5" /end AXIS_PTS
/begin AXIS_PTS ldp_maf_kgh_hom_ip_lamb_bas "" 0xa0808880 maf_kgh_hom _REC_AXS_20_u2 2047.96875 _CNV_A_R_LINEAR_____215_CM 8 0. 2047.96875 FORMAT "%10.5" /end AXIS_PTS
/begin MEASUREMENT state_rgn[0] "NOx regeneration state" UBYTE _CNV_S_4_STATE_RGN__220_CM 1 100. 0. 3. DISPLAY_IDENTIFIER STATE_RGN_1 ECU_ADDRESS 0xd00088f0 /end MEASUREMENT
/begin MEASUREMENT state_rgn[1] "NOx regeneration state" UBYTE _CNV_S_4_STATE_RGN__220_CM 1 100. 0. 3. DISPLAY_IDENTIFIER STATE_RGN_2 ECU_ADDRESS 0xd00088f1 /end MEASUREMENT
/begin MEASUREMENT lamb_rgn[0] "Lambda setpoint for catalyst regeneration" UWORD _CNV_A_R_LINEAR_____129_CM 1 100. 0. 31.9990234375 DISPLAY_IDENTIFIER LAMB_RGN_1 ECU_ADDRESS 0xd000a4c0 FORMAT "%7.4" /end MEASUREMENT
/begin MEASUREMENT lamb_rgn[1] "Lambda setpoint for catalyst regeneration" UWORD _CNV_A_R_LINEAR_____129_CM 1 100. 0. 31.9990234375 DISPLAY_IDENTIFIER LAMB_RGN_2 ECU_ADDRESS 0xd000a4c2 FORMAT "%7.4" /end MEASUREMENT
/begin MEASUREMENT lamb_rgn_fac[0] "factor for the correction of the regeneration lambda" UBYTE _CNV_A_R_LINEAR_____103_CM 1 100. 0. 1.9921875 DISPLAY_IDENTIFIER LAMB_RGN_FAC_1 ECU_ADDRESS 0xd0001320 FORMAT "%8.6" /end MEASUREMENT
/begin MEASUREMENT lamb_rgn_fac[1] "factor for the correction of the regeneration lambda" UBYTE _CNV_A_R_LINEAR_____103_CM 1 100. 0. 1.9921875 DISPLAY_IDENTIFIER LAMB_RGN_FAC_2 ECU_ADDRESS 0xd0001321 FORMAT "%8.6" /end MEASUREMENT
/begin CHARACTERISTIC c_lamb_purge_h_ampl "Lambda purge for high amplitude regeneration" VALUE 0xa080bde6 _REC_VAL_20_u2 31.9990234375 _CNV_A_R_LINEAR_____129_CM 0. 31.9990234375 DISPLAY_IDENTIFIER C_LAMB_PURGE_H_AMPL FORMAT "%7.4" /end CHARACTERISTIC
/begin CHARACTERISTIC c_lamb_rgn_h_ampl_bas "Basis lambda setpoint for high amplitude regeneration" VALUE 0xa080bdec _REC_VAL_20_u2 31.9990234375 _CNV_A_R_LINEAR_____129_CM 0. 31.9990234375 DISPLAY_IDENTIFIER C_LAMB_RGN_H_AMPL_BAS FORMAT "%7.4" /end CHARACTERISTIC
/begin CHARACTERISTIC c_lamb_rgn_l_ampl_bas "Basis lambda setpoint for low amplitude regeneration" VALUE 0xa080bdee _REC_VAL_20_u2 31.9990234375 _CNV_A_R_LINEAR_____129_CM 0. 31.9990234375 DISPLAY_IDENTIFIER C_LAMB_RGN_L_AMPL_BAS FORMAT "%7.4" /end CHARACTERISTIC
/begin CHARACTERISTIC c_lamb_rgn_l_ampl_bas_max "Basis max lambda setpoint for low amplitude regeneration" VALUE 0xa080bdf0 _REC_VAL_20_u2 31.9990234375 _CNV_A_R_LINEAR_____129_CM 0. 31.9990234375 DISPLAY_IDENTIFIER C_LAMB_RGN_L_AMPL_BAS_MAX FORMAT "%7.4" /end CHARACTERISTIC
/begin CHARACTERISTIC c_state_rgn_1_park "Park strategy for first regeneration" VALUE 0xa080c0ea _REC_VAL_20_u1 3. _CNV_S_4_RANGE_C_ST_216_CM 0. 3. DISPLAY_IDENTIFIER C_STATE_RGN_1_PARK /end CHARACTERISTIC
/begin CHARACTERISTIC c_state_rgn_2_park "Park strategy for second regeneration" VALUE 0xa080c0eb _REC_VAL_20_u1 3. _CNV_S_4_RANGE_C_ST_216_CM 0. 3. DISPLAY_IDENTIFIER C_STATE_RGN_2_PARK /end CHARACTERISTIC
/begin CHARACTERISTIC c_state_rgn_ini_1 "Initialisation state for first bank" VALUE 0xa080c0ed _REC_VAL_20_u1 3. _CNV_S_4_STATE_RGN__220_CM 0. 3. DISPLAY_IDENTIFIER C_STATE_RGN_INI_1 /end CHARACTERISTIC
/begin CHARACTERISTIC c_state_rgn_ini_2 "Initialisation state for second bank" VALUE 0xa080c0ee _REC_VAL_20_u1 3. _CNV_S_4_STATE_RGN__220_CM 0. 3. DISPLAY_IDENTIFIER C_STATE_RGN_INI_2 /end CHARACTERISTIC
/begin CHARACTERISTIC ip_lamb_fac_h_ampl_2_vls "Lambda setpoint correction factor for second high amplitude regeneration depending on VLS_NOX_SENS_1" CURVE 0xa080add8 _REC_CUR_20_u1_u2 1.9921875 _CNV_A_R_LINEAR_____103_CM 0. 1.9921875 DISPLAY_IDENTIFIER IP_LAMB_FAC_H_AMPL_2_VLS FORMAT "%8.6"
 /begin AXIS_DESCR COM_AXIS vls_nox_sens[0] _CNV_A_R_LINEAR_____219_CM 8 -200. 1200. FORMAT "%4.0" AXIS_PTS_REF ldp_vls_h_ampl_2_ip_lamb_fac /end AXIS_DESCR
/end CHARACTERISTIC
/begin CHARACTERISTIC ip_lamb_fac_l_ampl_2_vls "Lambda setpoint correction factor for second low amplitude regeneration depending on VLS_NOX_SENS_1" CURVE 0xa080ade0 _REC_CUR_20_u1_u2 1.9921875 _CNV_A_R_LINEAR_____103_CM 0. 1.9921875 DISPLAY_IDENTIFIER IP_LAMB_FAC_L_AMPL_2_VLS FORMAT "%8.6"
 /begin AXIS_DESCR COM_AXIS vls_nox_sens[0] _CNV_A_R_LINEAR_____219_CM 8 -200. 1200. FORMAT "%4.0" AXIS_PTS_REF ldp_vls_l_ampl_2_ip_lamb_fac /end AXIS_DESCR
/end CHARACTERISTIC
/begin CHARACTERISTIC ip_lamb_fac_l_ampl_t_rgn_2 "Lambda setpoint correction factor for low amplitude regeneration depending on T_RGN_2" CURVE 0xa080adf0 _REC_CUR_20_u1_u2 1.9921875 _CNV_A_R_LINEAR_____103_CM 0. 1.9921875 DISPLAY_IDENTIFIER IP_LAMB_FAC_L_AMPL_T_RGN_2 FORMAT "%8.6"
 /begin AXIS_DESCR COM_AXIS t_rgn_2 _CNV_A_R_LINEAR_____3_CM 8 0. 655.35 FORMAT "%6.2" AXIS_PTS_REF ldp_t_rgn_2_l_ampl_ip_lamb_fac /end AXIS_DESCR
/end CHARACTERISTIC
/begin CHARACTERISTIC ip_lamb_fac_l_ampl_t_rgn_1 "Lambda setpoint correction factor for low amplitude regeneration depending on T_RGN" CURVE 0xa080ade8 _REC_CUR_20_u1_u2 1.9921875 _CNV_A_R_LINEAR_____103_CM 0. 1.9921875 DISPLAY_IDENTIFIER IP_LAMB_FAC_L_AMPL_T_RGN_1 FORMAT "%8.6"
 /begin AXIS_DESCR COM_AXIS t_rgn _CNV_A_R_LINEAR_____3_CM 8 0. 655.35 FORMAT "%6.2" AXIS_PTS_REF ldp_t_rgn_1_l_ampl_ip_lamb_fac /end AXIS_DESCR
/end CHARACTERISTIC
/begin CHARACTERISTIC ip_lamb_fac_h_ampl_1_vls "Lambda setpoint correction factor for first high amplitude regeneration depending on VLS_NOX_SENS_1" CURVE 0xa080add0 _REC_CUR_20_u1_u2 1.9921875 _CNV_A_R_LINEAR_____103_CM 0. 1.9921875 DISPLAY_IDENTIFIER IP_LAMB_FAC_H_AMPL_1_VLS FORMAT "%8.6"
 /begin AXIS_DESCR COM_AXIS vls_nox_sens[0] _CNV_A_R_LINEAR_____219_CM 8 -200. 1200. FORMAT "%4.0" AXIS_PTS_REF ldp_vls_h_ampl_1_ip_lamb_fac /end AXIS_DESCR
/end CHARACTERISTIC
/begin CHARACTERISTIC ip_lamb_fac_park_1_vls "Lambda setpoint correction factor for park depending on VLS_NOX_SENS_1" CURVE 0xa080ae20 _REC_CUR_20_u1_u2 1.9921875 _CNV_A_R_LINEAR_____103_CM 0. 1.9921875 DISPLAY_IDENTIFIER IP_LAMB_FAC_PARK_1_VLS FORMAT "%8.6"
 /begin AXIS_DESCR COM_AXIS vls_nox_sens[0] _CNV_A_R_LINEAR_____219_CM 8 -200. 1200. FORMAT "%4.0" AXIS_PTS_REF ldp_vls_park_1_ip_lamb_fac /end AXIS_DESCR
/end CHARACTERISTIC
/begin CHARACTERISTIC ip_lamb_fac_park_1_t_rgn "Lambda setpoint correction factor for park for first regeneration depending on T_RGN" CURVE 0xa080ae18 _REC_CUR_20_u1_u2 1.9921875 _CNV_A_R_LINEAR_____103_CM 0. 1.9921875 DISPLAY_IDENTIFIER IP_LAMB_FAC_PARK_1_T_RGN FORMAT "%8.6"
 /begin AXIS_DESCR COM_AXIS t_rgn _CNV_A_R_LINEAR_____3_CM 8 0. 655.35 FORMAT "%6.2" AXIS_PTS_REF ldp_t_rgn_1_park_ip_lamb_fac /end AXIS_DESCR
/end CHARACTERISTIC
/begin CHARACTERISTIC ip_lamb_fac_l_ampl_vls_maf_kgh "Lambda setpoint correction factor for first low amplitude regeneration depending on MAF and VLS_NOX_SENS_1" MAP 0xa080adf8 _REC_MAP_20_u1_u2_u2 1.9921875 _CNV_A_R_LINEAR_____103_CM 0. 1.9921875 DISPLAY_IDENTIFIER IP_LAMB_FAC_L_AMPL_VLS_MAF_KGH FORMAT "%8.6"
 /begin AXIS_DESCR COM_AXIS maf_kgh_hom _CNV_A_R_LINEAR_____215_CM 4 0. 2047.96875 FORMAT "%10.5" AXIS_PTS_REF ldp_maf_kgh_l_ampl_ip_lamb_fac /end AXIS_DESCR
 /begin AXIS_DESCR COM_AXIS vls_nox_sens[0] _CNV_A_R_LINEAR_____219_CM 8 -200. 1200. FORMAT "%4.0" AXIS_PTS_REF ldp_vls_l_ampl_1_ip_lamb_fac /end AXIS_DESCR
/end CHARACTERISTIC
/begin CHARACTERISTIC ip_lamb_rgn_l_ampl_bas "Lambda low regeneration setpoint depending on MAF_KGH" CURVE 0xa080ae30 _REC_CUR_20_u2_u2 31.9990234375 _CNV_A_R_LINEAR_____129_CM 0. 31.9990234375 DISPLAY_IDENTIFIER IP_LAMB_RGN_L_AMPL_BAS FORMAT "%7.4"
 /begin AXIS_DESCR COM_AXIS maf_kgh_hom _CNV_A_R_LINEAR_____215_CM 8 0. 2047.96875 FORMAT "%10.5" AXIS_PTS_REF ldp_maf_kgh_hom_ip_lamb_bas /end AXIS_DESCR
/end CHARACTERISTIC
/begin MEASUREMENT lamb_rgn_l_ampl_bas "Calculated basis low regeneration lambda setpoint" UWORD _CNV_A_R_LINEAR_____129_CM 1 100. 0. 31.9990234375 DISPLAY_IDENTIFIER LAMB_RGN_L_AMPL_BAS ECU_ADDRESS 0xd000131c FORMAT "%7.4" /end MEASUREMENT
/begin MEASUREMENT ctr_rgn_cyc_lamb_rgn "Regenerations counter for calculation of alternate flag" UBYTE _CNV_A_R_LINEAR_____0_CM 1 100. 0. 255. DISPLAY_IDENTIFIER CTR_RGN_CYC_LAMB_RGN ECU_ADDRESS 0xd00088f2 FORMAT "%3.0" /end MEASUREMENT
/begin CHARACTERISTIC c_lamb_park_bas "Basis lambda setpoint for park" VALUE 0xa080bde2 _REC_VAL_20_u2 31.9990234375 _CNV_A_R_LINEAR_____129_CM 0. 31.9990234375 DISPLAY_IDENTIFIER C_LAMB_PARK_BAS FORMAT "%7.4" /end CHARACTERISTIC
/begin CHARACTERISTIC c_ctr_rgn_swi_act "Number of regenerations with initialization of STATE_RGN when the alternate flag is 1" VALUE 0xa080bbc0 _REC_VAL_20_u1 254. _CNV_A_R_LINEAR_____0_CM 1. 255. DISPLAY_IDENTIFIER C_CTR_RGN_SWI_ACT FORMAT "%3.0" /end CHARACTERISTIC
/begin CHARACTERISTIC c_ctr_rgn_swi_deac "Number of regenerations with initialization of STATE_RGN when the alternate flag is 0" VALUE 0xa080bbc1 _REC_VAL_20_u1 254. _CNV_A_R_LINEAR_____0_CM 1. 255. DISPLAY_IDENTIFIER C_CTR_RGN_SWI_DEAC FORMAT "%3.0" /end CHARACTERISTIC
/begin MEASUREMENT maf_mmv_dly "floating mean value for limited MAF" UWORD _CNV_A_R_LINEAR_____111_CM 1 100. 0. 1389. DISPLAY_IDENTIFIER MAF_MMV_DLY ECU_ADDRESS 0xd000a53a FORMAT "%7.2" /end MEASUREMENT
/begin CHARACTERISTIC c_maf_crlc_dly "floating mean value calculation MAF" VALUE 0xa080be1c _REC_VAL_20_u2 0.9999847412109381 _CNV_A_R_LINEAR_____89_CM 0. 0.9999847412109381 DISPLAY_IDENTIFIER C_MAF_CRLC_DLY FORMAT "%7.5" /end CHARACTERISTIC
/begin CHARACTERISTIC c_lam_mv_crlc_dly "floating mean value calculation lambda " VALUE 0xa080bdc0 _REC_VAL_20_u2 0.9999847412109381 _CNV_A_R_LINEAR_____89_CM 0. 0.9999847412109381 DISPLAY_IDENTIFIER C_LAM_MV_CRLC_DLY FORMAT "%7.5" /end CHARACTERISTIC
/begin CHARACTERISTIC c_n_dyw_dly "threshold limited dynamic engine speed" VALUE 0xa080bf2a _REC_VAL_20_u2 8159. _CNV_A_R_LINEAR_____14_CM 1. 8160. DISPLAY_IDENTIFIER C_N_DYW_DLY FORMAT "%4.0" /end CHARACTERISTIC
/begin CHARACTERISTIC c_maf_dyw_dly "threshold limited dynamic engine MAF " VALUE 0xa080be24 _REC_VAL_20_u2 1389. _CNV_A_R_LINEAR_____111_CM 0. 1389. DISPLAY_IDENTIFIER C_MAF_DYW_DLY FORMAT "%7.2" /end CHARACTERISTIC
/begin CHARACTERISTIC c_lam_mv_dyw_dly "threshold limited dynamic lambda " VALUE 0xa080bdc2 _REC_VAL_20_u2 99.99847412109381 _CNV_A_R_LINEAR_____8_CM 0. 99.99847412109381 DISPLAY_IDENTIFIER C_LAM_MV_DYW_DLY /end CHARACTERISTIC
/begin MEASUREMENT n_mmv_dly "floating mean value for limited engine speed" UWORD _CNV_A_R_LINEAR_____14_CM 1 100. 0. 8160. DISPLAY_IDENTIFIER N_MMV_DLY ECU_ADDRESS 0xd000a538 FORMAT "%4.0" /end MEASUREMENT
/begin MEASUREMENT lv_n_ldc_dly "status limited dynamic N" UBYTE _CNV_S_2_RANGE__0___1_CM 1 100. 0. 1. DISPLAY_IDENTIFIER LV_N_LDC_DLY ECU_ADDRESS 0xd0001334 BIT_MASK 0x1 /end MEASUREMENT
/begin MEASUREMENT lv_maf_ldc_dly "status limited dynamic MAF" UBYTE _CNV_S_2_RANGE__0___1_CM 1 100. 0. 1. DISPLAY_IDENTIFIER LV_MAF_LDC_DLY ECU_ADDRESS 0xd0001335 BIT_MASK 0x1 /end MEASUREMENT
/begin MEASUREMENT lv_fac_tq_req_ldc_dly "Status limited dynamic of the requested torque factor" UBYTE _CNV_S_2_RANGE__0___1_CM 1 100. 0. 1. DISPLAY_IDENTIFIER LV_FAC_TQ_REQ_LDC_DLY ECU_ADDRESS 0xd0001336 BIT_MASK 0x1 /end MEASUREMENT
/begin CHARACTERISTIC c_n_crlc_dly "floating mean value calculation engine speed" VALUE 0xa080bf16 _REC_VAL_20_u2 0.9999847412109381 _CNV_A_R_LINEAR_____89_CM 0. 0.9999847412109381 DISPLAY_IDENTIFIER C_N_CRLC_DLY FORMAT "%7.5" /end CHARACTERISTIC
/begin CHARACTERISTIC c_maf_int_min_ldc_dly "threshold for MAF integral while restart of LAM after inactive " VALUE 0xa080be2e _REC_VAL_20_u2 1820.398 _CNV_A_R_LINEAR_____210_CM 0. 1820.398 DISPLAY_IDENTIFIER C_MAF_INT_MIN_LDC_DLY FORMAT "%7.2" /end CHARACTERISTIC
/begin MEASUREMENT fac_tq_req_grd "Gradient of the requested factor torque" SWORD _CNV_A_R_LINEAR_____211_CM 1 100. -1. 0.99996948 DISPLAY_IDENTIFIER FAC_TQ_REQ_GRD ECU_ADDRESS 0xd0001328 FORMAT "%8.5" /end MEASUREMENT
/begin MEASUREMENT fac_tq_req_grd_sum_dly "Summation of FAC_TQ_REQ_GRD to determine if a dynamic condition is present" UWORD _CNV_A_R_LINEAR_____9_CM 1 100. 0. 1.99996948242188 DISPLAY_IDENTIFIER FAC_TQ_REQ_GRD_SUM_DLY ECU_ADDRESS 0xd000132a FORMAT "%9.8" /end MEASUREMENT
/begin MEASUREMENT t_fac_tq_req_grd_sum_dly "Timer to decrement FAC_TQ_REQ_GRD_SUM_DLY" UBYTE _CNV_A_R_LINEAR_____110_CM 1 100. 0. 5.1 DISPLAY_IDENTIFIER T_FAC_TQ_REQ_GRD_SUM_DLY ECU_ADDRESS 0xd0001337 FORMAT "%4.2" /end MEASUREMENT
/begin CHARACTERISTIC c_fac_tq_req_grd_dec_dly "decrement for calculation PV_AV gradient" VALUE 0xa080bd1a _REC_VAL_20_u2 1.99996948242188 _CNV_A_R_LINEAR_____9_CM 0. 1.99996948242188 DISPLAY_IDENTIFIER C_FAC_TQ_REQ_GRD_DEC_DLY FORMAT "%9.8" /end CHARACTERISTIC
/begin CHARACTERISTIC c_fac_tq_req_grd_min_ldc_dly "minimum value of FAC_TQ_REW_GRD to increment FAC_TQ_REQ_GRD_SUM_DLY" VALUE 0xa080bd1c _REC_VAL_20_u2 1.99996948242188 _CNV_A_R_LINEAR_____9_CM 0. 1.99996948242188 DISPLAY_IDENTIFIER C_FAC_TQ_REQ_GRD_MIN_LDC_DLY FORMAT "%9.8" /end CHARACTERISTIC
/begin CHARACTERISTIC c_fac_tq_req_grd_sum_max_dly "threshold to reset the limited dynamic flag LV_LDC_DLY[i] due to present high FAC_TQ_REQ_GRD condition" VALUE 0xa080bd1e _REC_VAL_20_u2 1.99996948242188 _CNV_A_R_LINEAR_____9_CM 0. 1.99996948242188 DISPLAY_IDENTIFIER C_FAC_TQ_REQ_GRD_SUM_MAX_DLY FORMAT "%9.8" /end CHARACTERISTIC
/begin CHARACTERISTIC c_fac_tq_req_grd_sum_min_dly "threshold to set the limited dynamic flag LV_LDC_DLY[i] when no high FAC_TQ_REQ condition is set" VALUE 0xa080bd20 _REC_VAL_20_u2 1.99996948242188 _CNV_A_R_LINEAR_____9_CM 0. 1.99996948242188 DISPLAY_IDENTIFIER C_FAC_TQ_REQ_GRD_SUM_MIN_DLY FORMAT "%9.8" /end CHARACTERISTIC
/begin CHARACTERISTIC c_t_fac_tq_req_grd_sum_dly "time periods for calculation limited dynamic FAC_TQ_REQ_GRD" VALUE 0xa080c1c7 _REC_VAL_20_u1 5.1 _CNV_A_R_LINEAR_____110_CM 0. 5.1 DISPLAY_IDENTIFIER C_T_FAC_TQ_REQ_GRD_SUM_DLY FORMAT "%4.2" /end CHARACTERISTIC
/begin CHARACTERISTIC ip_rest "Considering the shut-off time for re-start calculation" CURVE 0xa080b3b4 _REC_CUR_20_u1_u2 0.199220002 _CNV_A_R_LINEAR_____18_CM 0. 0.99610001 DISPLAY_IDENTIFIER IP_REST FORMAT "%5.3"
 /begin AXIS_DESCR COM_AXIS t_es _CNV_A_R_LINEAR_____84_CM 8 0. 65535. FORMAT "%5.0" AXIS_PTS_REF ldp_t_es__rest /end AXIS_DESCR
/end CHARACTERISTIC
/begin CHARACTERISTIC ip_fac_rest "Considering coolant stop temperature and after start time for re-start calculation" MAP 0xa080a454 _REC_MAP_20_u1_u2_u1 0.199220002 _CNV_A_R_LINEAR_____18_CM 0. 0.99610001 DISPLAY_IDENTIFIER IP_FAC_REST FORMAT "%5.3"
 /begin AXIS_DESCR COM_AXIS t_ast_rest _CNV_A_R_LINEAR_____4_CM 8 0. 6553.5 FORMAT "%6.1" AXIS_PTS_REF ldp_t_ast_rest /end AXIS_DESCR
 /begin AXIS_DESCR COM_AXIS tco_stop _CNV_A_R_LINEAR_____17_CM 8 -48. 142.5 FORMAT "%5.1" AXIS_PTS_REF ldp_tco_stop__fac_rest /end AXIS_DESCR
/end CHARACTERISTIC
/begin CHARACTERISTIC ip_fac_stall "Special cold start reduction factor in case of re-start after engine stall out" CURVE 0xa080a4f4 _REC_CUR_20_u1_u1 0.199220002 _CNV_A_R_LINEAR_____18_CM 0. 0.99610001 DISPLAY_IDENTIFIER IP_FAC_STALL FORMAT "%5.3"
 /begin AXIS_DESCR COM_AXIS tco _CNV_A_R_LINEAR_____17_CM 8 -48. 142.5 FORMAT "%5.1" AXIS_PTS_REF ldpm_tco__fac_stall /end AXIS_DESCR
/end CHARACTERISTIC
/begin AXIS_PTS ldpm_tco__ti_st_rest "" 0xa08097c4 tco _REC_AXS_20_u1 28.575 _CNV_A_R_LINEAR_____17_CM 8 -48. 142.5 FORMAT "%5.1" /end AXIS_PTS
/begin AXIS_PTS ldp_tco_stop__fac_rest "" 0xa0808e1c tco_stop _REC_AXS_20_u1 28.575 _CNV_A_R_LINEAR_____17_CM 8 -48. 142.5 FORMAT "%5.1" /end AXIS_PTS
/begin AXIS_PTS ldpm_tco__fac_stall "" 0xa0809794 tco _REC_AXS_20_u1 28.575 _CNV_A_R_LINEAR_____17_CM 8 -48. 142.5 FORMAT "%5.1" /end AXIS_PTS
/begin AXIS_PTS ldp_t_es__rest "" 0xa0808d2c t_es _REC_AXS_20_u2 9830.25 _CNV_A_R_LINEAR_____84_CM 8 0. 65535. FORMAT "%5.0" /end AXIS_PTS
/begin AXIS_PTS ldp_t_ast_rest "" 0xa0808d18 t_ast_rest _REC_AXS_20_u2 983.025 _CNV_A_R_LINEAR_____4_CM 8 0. 6553.5 FORMAT "%6.1" /end AXIS_PTS
/begin CHARACTERISTIC ip_fac_stnd_rest "Cold start reduction factor in case of re-start with no engine stop time T_ES available" CURVE 0xa080a4fc _REC_CUR_20_u1_u1 0.199220002 _CNV_A_R_LINEAR_____18_CM 0. 0.99610001 DISPLAY_IDENTIFIER IP_FAC_STND_REST FORMAT "%5.3"
 /begin AXIS_DESCR COM_AXIS tco _CNV_A_R_LINEAR_____17_CM 8 -48. 142.5 FORMAT "%5.1" AXIS_PTS_REF ldpm_tco__ti_st_rest /end AXIS_DESCR
/end CHARACTERISTIC
/begin MEASUREMENT fac_st_rest "Cold start reduction factor in case of re-start detected" UBYTE _CNV_A_R_LINEAR_____100_CM 1 100. 0. 1.99220002 DISPLAY_IDENTIFIER FAC_ST_REST ECU_ADDRESS 0xd0008c8c FORMAT "%5.3" /end MEASUREMENT
/begin MEASUREMENT nr_cyl_scc_teg[0] "Number of shut off cyl for TEG calculation" UBYTE _CNV_A_R_LINEAR_____452_CM 1 100. 0. 13. DISPLAY_IDENTIFIER NR_CYL_SCC_TEG[0] ECU_ADDRESS 0xd0008a0c FORMAT "%4.1" /end MEASUREMENT
/begin MEASUREMENT nr_cyl_scc_teg[1] "Number of shut off cyl for TEG calculation" UBYTE _CNV_A_R_LINEAR_____452_CM 1 100. 0. 13. DISPLAY_IDENTIFIER NR_CYL_SCC_TEG[1] ECU_ADDRESS 0xd0008a0d FORMAT "%4.1" /end MEASUREMENT
/begin MEASUREMENT lv_teg_min_thd[0] "dew point has been reached bank selective" UBYTE _CNV_A_R_LINEAR_____0_CM 1 100. 0. 1. DISPLAY_IDENTIFIER LV_TEG_MIN_THD[0] ECU_ADDRESS 0xd0008a0e FORMAT "%1.0" BIT_MASK 0x1 /end MEASUREMENT
/begin MEASUREMENT lv_teg_min_thd[1] "dew point has been reached bank selective" UBYTE _CNV_A_R_LINEAR_____0_CM 1 100. 0. 1. DISPLAY_IDENTIFIER LV_TEG_MIN_THD[1] ECU_ADDRESS 0xd0008a0f FORMAT "%1.0" BIT_MASK 0x1 /end MEASUREMENT
/begin MEASUREMENT lv_teg_cat_down_min_thd[0] "dew point has been reached bank selective" UBYTE _CNV_A_R_LINEAR_____0_CM 1 100. 0. 1. DISPLAY_IDENTIFIER LV_TEG_CAT_DOWN_MIN_THD[0] ECU_ADDRESS 0xd0008a10 FORMAT "%1.0" BIT_MASK 0x1 /end MEASUREMENT
/begin MEASUREMENT lv_teg_cat_down_min_thd[1] "dew point has been reached bank selective" UBYTE _CNV_A_R_LINEAR_____0_CM 1 100. 0. 1. DISPLAY_IDENTIFIER LV_TEG_CAT_DOWN_MIN_THD[1] ECU_ADDRESS 0xd0008a11 FORMAT "%1.0" BIT_MASK 0x1 /end MEASUREMENT
/begin MEASUREMENT lv_puc_inh_temp_cat "Flag to inhibit PUC operation due to too high TEMP_CAT" UBYTE _CNV_A_R_LINEAR_____0_CM 1 100. 0. 1. DISPLAY_IDENTIFIER LV_PUC_INH_TEMP_CAT ECU_ADDRESS 0xd00075fc FORMAT "%1.0" BIT_MASK 0x1 /end MEASUREMENT
/begin MEASUREMENT lv_sel_cyl "boolean for cylinder specific transition PU-PUC, PUC-IS or PUC-PL ongoing" UBYTE _CNV_S_2_RANGE__0___1_CM 1 100. 0. 1. DISPLAY_IDENTIFIER LV_SEL_CYL ECU_ADDRESS 0xd0008c85 BIT_MASK 0x1 /end MEASUREMENT
/begin MEASUREMENT nr_pat_sel_cyl "selected index of fuel cut-off pattern for transition PU-PUC, PUC-IS, PUC-PL" UBYTE _CNV_A_R_LINEAR_____0_CM 1 100. 0. 255. DISPLAY_IDENTIFIER NR_PAT_SEL_CYL ECU_ADDRESS 0xd0008c84 FORMAT "%3.0" /end MEASUREMENT
/begin MEASUREMENT t_fcut_aj "timer value during jerk minimal sequential fuel cut-off" UBYTE _CNV_A_R_LINEAR_____3_CM 1 100. 0. 2.55 DISPLAY_IDENTIFIER T_FCUT_AJ ECU_ADDRESS 0xd000105c FORMAT "%4.2" /end MEASUREMENT
/begin MEASUREMENT t_osc_dt "period of time of the oscillation of the drive train" UBYTE _CNV_A_R_LINEAR_____3_CM 1 100. 0. 2.55 DISPLAY_IDENTIFIER T_OSC_DT ECU_ADDRESS 0xd000105d FORMAT "%4.2" /end MEASUREMENT
/begin MEASUREMENT nr_sel_cyl "index number of the selected cylinder pattern" UBYTE _CNV_A_R_LINEAR_____0_CM 1 100. 0. 255. DISPLAY_IDENTIFIER NR_SEL_CYL ECU_ADDRESS 0xd000105e FORMAT "%3.0" /end MEASUREMENT
/begin MEASUREMENT case_sel_cyl "case selector" UBYTE _CNV_A_R_LINEAR_____0_CM 1 100. 0. 3. DISPLAY_IDENTIFIER CASE_SEL_CYL ECU_ADDRESS 0xd000105f FORMAT "%1.0" /end MEASUREMENT
/begin AXIS_PTS ldp_case_sel_cyl__pat_sel_cyl "" 0xa0808510 case_sel_cyl _REC_AXS_20_u1 2. _CNV_A_R_LINEAR_____0_CM 3 1. 3. FORMAT "%3.0" /end AXIS_PTS
/begin AXIS_PTS ldp_nr_sel_cyl__pat_sel_cyl "" 0xa0808bfc nr_sel_cyl _REC_AXS_20_u1 7. _CNV_A_R_LINEAR_____0_CM 8 1. 8. FORMAT "%3.0" /end AXIS_PTS
/begin AXIS_PTS ldp_gr_mt__t_osc_dt "" 0xa0808788 gr_mt _REC_AXS_20_u1 255. _CNV_A_R_LINEAR_____0_CM 8 0. 255. FORMAT "%3.0" /end AXIS_PTS
/begin CHARACTERISTIC id_pat_sel_cyl "table for cylinder specific restart and trailing throttle fuel cut-off" MAP 0xa0809db4 _REC_MAP_20_u1_u1_u1 255. _CNV_A_R_LINEAR_____0_CM 0. 255. DISPLAY_IDENTIFIER ID_PAT_SEL_CYL FORMAT "%3.0"
 /begin AXIS_DESCR COM_AXIS case_sel_cyl _CNV_A_R_LINEAR_____0_CM 3 1. 3. FORMAT "%3.0" AXIS_PTS_REF ldp_case_sel_cyl__pat_sel_cyl /end AXIS_DESCR
 /begin AXIS_DESCR COM_AXIS nr_sel_cyl _CNV_A_R_LINEAR_____0_CM 8 1. 8. FORMAT "%3.0" AXIS_PTS_REF ldp_nr_sel_cyl__pat_sel_cyl /end AXIS_DESCR
/end CHARACTERISTIC
/begin CHARACTERISTIC id_t_osc_dt "characteristic period of time of the eigenfrequency of the powertrain" CURVE 0xa0809ec0 _REC_CUR_20_u1_u1 2.55 _CNV_A_R_LINEAR_____3_CM 0. 2.55 DISPLAY_IDENTIFIER ID_T_OSC_DT FORMAT "%4.2"
 /begin AXIS_DESCR COM_AXIS gr_mt _CNV_A_R_LINEAR_____0_CM 8 0. 255. FORMAT "%3.0" AXIS_PTS_REF ldp_gr_mt__t_osc_dt /end AXIS_DESCR
/end CHARACTERISTIC
/begin CHARACTERISTIC c_tps_grd_max_sel_rpl "TPS_GRD threshold for cancelling cylinder individual restart PL" VALUE 0xa080c351 _REC_VAL_20_u1 2987.5 _CNV_A_R_LINEAR_____386_CM 0. 2987.5 DISPLAY_IDENTIFIER C_TPS_GRD_MAX_SEL_RPL FORMAT "%4.0" /end CHARACTERISTIC
/begin CHARACTERISTIC c_n_grd_min_sel_ris "N_GRD threshold for cancelling cylinder individual restart IS" VALUE 0xa080bf34 _REC_VAL_20_s1 8160. _CNV_A_R_LINEAR_____30_CM -4096. 4064. DISPLAY_IDENTIFIER C_N_GRD_MIN_SEL_RIS FORMAT "%5.0" /end CHARACTERISTIC
/begin CHARACTERISTIC c_maf_max_sel_rpl "MAF threshold for cancelling cylinder individual restart PL" VALUE 0xa080be3c _REC_VAL_20_u2 1389. _CNV_A_R_LINEAR_____111_CM 0. 1389. DISPLAY_IDENTIFIER C_MAF_MAX_SEL_RPL FORMAT "%7.2" /end CHARACTERISTIC
/begin CHARACTERISTIC c_n_dif_max_sel_ris "N_DIF_COR threshold for cancelling cylinder individual restart idle" VALUE 0xa080bf26 _REC_VAL_20_u2 65535. _CNV_A_R_LINEAR_____193_CM -32768. 32767. DISPLAY_IDENTIFIER C_N_DIF_MAX_SEL_RIS FORMAT "%6.0" /end CHARACTERISTIC
/begin CHARACTERISTIC c_nr_sel_cyl_1 "start pattern for transition from PU to PUC (case 1)" VALUE 0xa080c032 _REC_VAL_20_u1 7. _CNV_A_R_LINEAR_____0_CM 1. 8. DISPLAY_IDENTIFIER C_NR_SEL_CYL_1 FORMAT "%3.0" /end CHARACTERISTIC
/begin CHARACTERISTIC c_nr_sel_cyl_2 "start pattern for transition from PUC to IS, PU (case 2)" VALUE 0xa080c033 _REC_VAL_20_u1 7. _CNV_A_R_LINEAR_____0_CM 1. 8. DISPLAY_IDENTIFIER C_NR_SEL_CYL_2 FORMAT "%3.0" /end CHARACTERISTIC
/begin CHARACTERISTIC c_nr_sel_cyl_3 "start pattern for transition from PUC to IS, PL (case 3)" VALUE 0xa080c034 _REC_VAL_20_u1 7. _CNV_A_R_LINEAR_____0_CM 1. 8. DISPLAY_IDENTIFIER C_NR_SEL_CYL_3 FORMAT "%3.0" /end CHARACTERISTIC
/begin CHARACTERISTIC lc_ena_fcut_aj "logical variable to enable jerk minimal sequential fuel cut-off" VALUE 0xa080c55d _REC_VAL_20_u1 1. _CNV_A_R_LINEAR_____0_CM 0. 1. DISPLAY_IDENTIFIER LC_ENA_FCUT_AJ FORMAT "%1.0" /end CHARACTERISTIC
/begin CHARACTERISTIC c_tqi_sp_slow_dif_max "TQI_SP_SLOW_DIF threshold for cancelling cylinder individual cut-off for restart in PL" VALUE 0xa080c3b0 _REC_VAL_20_s2 2047.96875 _CNV_A_R_LINEAR_____31_CM -1024. 1023.96875 DISPLAY_IDENTIFIER C_TQI_SP_SLOW_DIF_MAX FORMAT "%8.2" /end CHARACTERISTIC
/begin MEASUREMENT tqi_sp_slow_dif "Difference in requested torque for slow path from actual to last segment" SWORD _CNV_A_R_LINEAR_____31_CM 1 100. -1024. 1023.96875 DISPLAY_IDENTIFIER TQI_SP_SLOW_DIF ECU_ADDRESS 0xd0001058 FORMAT "%6.2" /end MEASUREMENT
/begin CHARACTERISTIC c_tnt_mdl_thd_rgn_not "NOx catalyst monolith temperature max. threshold for inhibit a regeneration" VALUE 0xa080c346 _REC_VAL_20_u1 1020. _CNV_A_R_LINEAR_____481_CM 0. 1020. DISPLAY_IDENTIFIER C_TNT_MDL_THD_RGN_NOT FORMAT "%4.0" /end CHARACTERISTIC
/begin CHARACTERISTIC c_tnt_mdl_thd_rgn_not_hys "NOx catalyst monolith temperature hysteresis for inhibit a regeneration" VALUE 0xa080c347 _REC_VAL_20_u1 1020. _CNV_A_R_LINEAR_____481_CM 0. 1020. DISPLAY_IDENTIFIER C_TNT_MDL_THD_RGN_NOT_HYS FORMAT "%4.0" /end CHARACTERISTIC
/begin CHARACTERISTIC lc_inh_nt_act_off "Codeword for the manual setting of the inhibiting bit" VALUE 0xa080c58d _REC_VAL_20_u1 1. _CNV_A_R_LINEAR_____0_CM 0. 1. DISPLAY_IDENTIFIER LC_INH_NT_ACT_OFF FORMAT "%2.0" /end CHARACTERISTIC
/begin CHARACTERISTIC lc_inh_rgn_req_ntld "Codeword for general inhibition of regeneration request due to loading degree" VALUE 0xa080c59a _REC_VAL_20_u1 1. _CNV_A_R_LINEAR_____0_CM 0. 1. DISPLAY_IDENTIFIER LC_INH_RGN_REQ_NTLD FORMAT "%2.0" /end CHARACTERISTIC
/begin CHARACTERISTIC lc_inh_nt_afl_off "Manual setting of inhibiting Lambda = 1 request" VALUE 0xa080c58f _REC_VAL_20_u1 1. _CNV_A_R_LINEAR_____0_CM 0. 1. DISPLAY_IDENTIFIER LC_INH_NT_AFL_OFF FORMAT "%2.0" /end CHARACTERISTIC
/begin CHARACTERISTIC lc_inh_nt_prj_act "calibration constant inhibiting the NOx catalyst auxiliary functionalities (complete)" VALUE 0xa080c591 _REC_VAL_20_u1 1. _CNV_A_R_LINEAR_____0_CM 0. 1. DISPLAY_IDENTIFIER LC_INH_NT_PRJ_ACT FORMAT "%2.0" /end CHARACTERISTIC
/begin CHARACTERISTIC c_tnt_mdl_nt_stc_max_min "Temperature threshold for enabling / disabling an full saturation" VALUE 0xa080c342 _REC_VAL_20_u1 1020. _CNV_A_R_LINEAR_____481_CM 0. 1020. DISPLAY_IDENTIFIER C_TNT_MDL_NT_STC_MAX_MIN FORMAT "%4.0" /end CHARACTERISTIC
/begin CHARACTERISTIC c_tnt_mdl_nt_stc_max_max "Temperature threshold for enabling / disabling full saturation" VALUE 0xa080c341 _REC_VAL_20_u1 1020. _CNV_A_R_LINEAR_____481_CM 0. 1020. DISPLAY_IDENTIFIER C_TNT_MDL_NT_STC_MAX_MAX FORMAT "%4.0" /end CHARACTERISTIC
/begin CHARACTERISTIC c_tnt_mdl_nt_stc_max_delta "max. deviation between higher and lower NT temp. for enabling a full saturation" VALUE 0xa080c340 _REC_VAL_20_u1 1020. _CNV_A_R_LINEAR_____481_CM 0. 1020. DISPLAY_IDENTIFIER C_TNT_MDL_NT_STC_MAX_DELTA FORMAT "%4.0" /end CHARACTERISTIC
/begin CHARACTERISTIC c_tnt_mdl_o2_stc_min "minimum speed for OSC-adaptation" VALUE 0xa080c345 _REC_VAL_20_u1 1020. _CNV_A_R_LINEAR_____481_CM 0. 1020. DISPLAY_IDENTIFIER C_TNT_MDL_O2_STC_MIN FORMAT "%4.0" /end CHARACTERISTIC
/begin CHARACTERISTIC c_tnt_mdl_o2_stc_max "Temperature threshold for enabling / disabling an O2-STC adaptation" VALUE 0xa080c344 _REC_VAL_20_u1 1020. _CNV_A_R_LINEAR_____481_CM 0. 1020. DISPLAY_IDENTIFIER C_TNT_MDL_O2_STC_MAX FORMAT "%4.0" /end CHARACTERISTIC
/begin CHARACTERISTIC c_tnt_mdl_o2_stc_delta "max. deviation between higher and lower NT temp. for enabling an O2-STC adaptation" VALUE 0xa080c343 _REC_VAL_20_u1 1020. _CNV_A_R_LINEAR_____481_CM 0. 1020. DISPLAY_IDENTIFIER C_TNT_MDL_O2_STC_DELTA FORMAT "%4.0" /end CHARACTERISTIC
/begin CHARACTERISTIC lc_inh_nt_stc_max "calibration constant  inhibiting the full saturation" VALUE 0xa080c592 _REC_VAL_20_u1 1. _CNV_A_R_LINEAR_____0_CM 0. 1. DISPLAY_IDENTIFIER LC_INH_NT_STC_MAX FORMAT "%2.0" /end CHARACTERISTIC
/begin CHARACTERISTIC c_vs_o2_stc_min "minimum speed for OSC-adaptation" VALUE 0xa080c4f0 _REC_VAL_20_u1 255. _CNV_A_R_LINEAR_____6_CM 0. 255. DISPLAY_IDENTIFIER C_VS_O2_STC_MIN FORMAT "%3.0" /end CHARACTERISTIC
/begin CHARACTERISTIC lc_inh_nt_o2_stc "calibration constant  inhibiting oxygen storage capacity adaptation" VALUE 0xa080c590 _REC_VAL_20_u1 1. _CNV_A_R_LINEAR_____0_CM 0. 1. DISPLAY_IDENTIFIER LC_INH_NT_O2_STC FORMAT "%2.0" /end CHARACTERISTIC
/begin CHARACTERISTIC lc_inh_nt_afl "Codeword for forcing to Lambda=1 operation" VALUE 0xa080c58e _REC_VAL_20_u1 1. _CNV_A_R_LINEAR_____0_CM 0. 1. DISPLAY_IDENTIFIER LC_INH_NT_AFL FORMAT "%2.0" /end CHARACTERISTIC
/begin CHARACTERISTIC lc_inh_req_nox_sens_off "Manual setting of inhibiting exlusively regeneration out of NOx-Sensor" VALUE 0xa080c597 _REC_VAL_20_u1 1. _CNV_A_R_LINEAR_____0_CM 0. 1. DISPLAY_IDENTIFIER LC_INH_REQ_NOX_SENS_OFF FORMAT "%2.0" /end CHARACTERISTIC
/begin MEASUREMENT lv_inh_nox_sens_rgn "Inhibition flag for NOx catalyst regeneration-stop request by NOx sensor readiness" UBYTE _CNV_S_2_RANGE__0___1_CM 1 100. 0. 1. DISPLAY_IDENTIFIER LV_INH_NOX_SENS_RGN ECU_ADDRESS 0xd000894e BIT_MASK 0x1 /end MEASUREMENT
/begin CHARACTERISTIC c_t_nox_sens_vld_state_rgn_req "Minimum time with NOx sensor not valid to switch to model" VALUE 0xa080c23c _REC_VAL_20_u2 655.35 _CNV_A_R_LINEAR_____3_CM 0. 655.35 DISPLAY_IDENTIFIER C_T_NOX_SENS_VLD_STATE_RGN_REQ FORMAT "%6.2" /end CHARACTERISTIC
/begin CHARACTERISTIC c_ntld_state_rgn_req "Minimum NOx catalyst loading degree to switch model (< NTLD_MAX)" VALUE 0xa080c05c _REC_VAL_20_u2 1. _CNV_A_R_LINEAR_____229_CM 0. 1. DISPLAY_IDENTIFIER C_NTLD_STATE_RGN_REQ FORMAT "%6.4" /end CHARACTERISTIC
/begin CHARACTERISTIC lc_tnt_mdl_max_ofs "" VALUE 0xa080c603 _REC_VAL_20_u1 1. _CNV_A_R_LINEAR_____0_CM 0. 1. DISPLAY_IDENTIFIER LC_TNT_MDL_MAX_OFS FORMAT "%2.0" /end CHARACTERISTIC
/begin CHARACTERISTIC c_vs_tnt_mdl_min "Vehicle speed threshold to enable CAT cooling at standing car" VALUE 0xa080c504 _REC_VAL_20_u1 255. _CNV_A_R_LINEAR_____6_CM 0. 255. DISPLAY_IDENTIFIER C_VS_TNT_MDL_MIN FORMAT "%3.0" /end CHARACTERISTIC
/begin CHARACTERISTIC c_t_vs_is_nt "Duration cat cooling at standing car is allowed" VALUE 0xa080c29d _REC_VAL_20_u1 25.5 _CNV_A_R_LINEAR_____4_CM 0. 25.5 DISPLAY_IDENTIFIER C_T_VS_IS_NT FORMAT "%3.1" /end CHARACTERISTIC
/begin CHARACTERISTIC c_tnt_mdl_max_ofs "Nox catalyst temperature offset to enable cat cooling at standing car" VALUE 0xa080c33c _REC_VAL_20_s1 1020. _CNV_A_R_LINEAR_____481_CM -512. 508. DISPLAY_IDENTIFIER C_TNT_MDL_MAX_OFS FORMAT "%4.2" /end CHARACTERISTIC
/begin CHARACTERISTIC c_tnt_mdl_h_max_ofs "Min Nox catalyst temperature to enable cat cooling at standing car" VALUE 0xa080c333 _REC_VAL_20_u1 1020. _CNV_A_R_LINEAR_____481_CM 0. 1020. DISPLAY_IDENTIFIER C_TNT_MDL_H_MAX_OFS FORMAT "%4.0" /end CHARACTERISTIC
/begin CHARACTERISTIC c_nt_sul_min_ofs "MIn NOx catalyst sulphur load to enable cat cooling at standing car" VALUE 0xa080c040 _REC_VAL_20_u2 10485.6 _CNV_A_R_LINEAR_____244_CM 0. 10485.6 DISPLAY_IDENTIFIER C_NT_SUL_MIN_OFS FORMAT "%8.2" /end CHARACTERISTIC
/begin CHARACTERISTIC lc_inh_ntld_req_nox_sens_auth "Inhibition of NOx regeneration requests due to NTLD after the NOx sensor has reached its readiness" VALUE 0xa080c593 _REC_VAL_20_u1 1. _CNV_A_R_LINEAR_____0_CM 0. 1. DISPLAY_IDENTIFIER LC_INH_NTLD_REQ_NOX_SENS_AUTH FORMAT "%2.0" /end CHARACTERISTIC
/begin CHARACTERISTIC lc_inh_ntld_req_nox_sens_vld "Inhibition of NOx regeneration requests due to NTLD, if the NOx signal is valid" VALUE 0xa080c594 _REC_VAL_20_u1 1. _CNV_A_R_LINEAR_____0_CM 0. 1. DISPLAY_IDENTIFIER LC_INH_NTLD_REQ_NOX_SENS_VLD FORMAT "%2.0" /end CHARACTERISTIC
/begin CHARACTERISTIC lc_inh_rgn_is "Inhibition of NOx regeneration requests at idle speed" VALUE 0xa080c598 _REC_VAL_20_u1 1. _CNV_A_R_LINEAR_____0_CM 0. 1. DISPLAY_IDENTIFIER LC_INH_RGN_IS FORMAT "%2.0" /end CHARACTERISTIC
/begin CHARACTERISTIC c_vs_min_rgn "Minimum vehicle speed for requesting a NOx regeneration" VALUE 0xa080c4e7 _REC_VAL_20_u1 255. _CNV_A_R_LINEAR_____6_CM 0. 255. DISPLAY_IDENTIFIER C_VS_MIN_RGN FORMAT "%3.0" /end CHARACTERISTIC
/begin MEASUREMENT nox_ad_fac "NOx emission adaptation factor" UBYTE _CNV_A_R_LINEAR_____103_CM 1 100. 0. 1.9921875 DISPLAY_IDENTIFIER NOX_AD_FAC ECU_ADDRESS 0xd00088f4 FORMAT "%5.3" /end MEASUREMENT
/begin MEASUREMENT lv_nox_ad_cmpl "logical value for active NOx emission adaptation" UBYTE _CNV_S_2_RANGE__0___1_CM 1 100. 0. 1. DISPLAY_IDENTIFIER LV_NOX_AD_CMPL ECU_ADDRESS 0xd00088f7 BIT_MASK 0x1 /end MEASUREMENT
/begin MEASUREMENT ntl_rgn_st_nox_mes_1 "measured NOx reducing agent mass" UWORD _CNV_A_R_LINEAR_____244_CM 1 100. 0. 10485.6 DISPLAY_IDENTIFIER NTL_RGN_ST_NOX_MES_1 ECU_ADDRESS 0xd00014dc FORMAT "%7.1" /end MEASUREMENT
/begin MEASUREMENT ntl_rgn_st_nox_mes_2 "measured NOx reducing agent mass" UWORD _CNV_A_R_LINEAR_____244_CM 1 100. 0. 10485.6 DISPLAY_IDENTIFIER NTL_RGN_ST_NOX_MES_2 ECU_ADDRESS 0xd00014e2 FORMAT "%7.1" /end MEASUREMENT
/begin MEASUREMENT nox_ad_fac_1 "NOx emission adaptation factor" UBYTE _CNV_A_R_LINEAR_____103_CM 1 100. 0. 1.9921875 DISPLAY_IDENTIFIER NOX_AD_FAC_1 ECU_ADDRESS 0xd00088f5 FORMAT "%5.3" /end MEASUREMENT
/begin MEASUREMENT nox_ad_fac_2 "NOx emission adaptation factor" UBYTE _CNV_A_R_LINEAR_____103_CM 1 100. 0. 1.9921875 DISPLAY_IDENTIFIER NOX_AD_FAC_2 ECU_ADDRESS 0xd00088f6 FORMAT "%5.3" /end MEASUREMENT
/begin MEASUREMENT lv_dyw_nox_ad "logical value for active limited dynamics" UBYTE _CNV_S_2_RANGE__0___1_CM 1 100. 0. 1. DISPLAY_IDENTIFIER LV_DYW_NOX_AD ECU_ADDRESS 0xd00088f8 BIT_MASK 0x1 /end MEASUREMENT
/begin MEASUREMENT nox_cor_s_mmv "moving mean value of NOx emission" UWORD _CNV_A_R_LINEAR_____489_CM 1 100. 0. 1023.984375 DISPLAY_IDENTIFIER NOX_COR_S_MMV ECU_ADDRESS 0xd00014de FORMAT "%7.2" /end MEASUREMENT
/begin MEASUREMENT maf_fg_cyl_mmv "moving mean value of mass air flow" UWORD _CNV_A_R_LINEAR_____215_CM 1 100. 0. 2047.96875 DISPLAY_IDENTIFIER MAF_FG_CYL_MMV ECU_ADDRESS 0xd00014e0 FORMAT "%7.2" /end MEASUREMENT
/begin MEASUREMENT nox_ad_fac_raw_2 "raw value of NOx emission adaptation factor" UBYTE _CNV_A_R_LINEAR_____103_CM 1 100. 0. 1.9921875 DISPLAY_IDENTIFIER NOX_AD_FAC_RAW_2 ECU_ADDRESS 0xd00014ea FORMAT "%5.3" /end MEASUREMENT
/begin MEASUREMENT nox_ad_fac_raw_1 "raw value of NOx emission adaptation factor" UBYTE _CNV_A_R_LINEAR_____103_CM 1 100. 0. 1.9921875 DISPLAY_IDENTIFIER NOX_AD_FAC_RAW_1 ECU_ADDRESS 0xd00014e4 FORMAT "%5.3" /end MEASUREMENT
/begin MEASUREMENT ctr_nox_ad_fac "adaptations counter" UBYTE _CNV_A_R_LINEAR_____0_CM 1 100. 0. 255. DISPLAY_IDENTIFIER CTR_NOX_AD_FAC ECU_ADDRESS 0xd00014e5 FORMAT "%3.0" /end MEASUREMENT
/begin CHARACTERISTIC c_crlc_nox_ad_fac "correlation constant of NOx emission factor" VALUE 0xa080bb04 _REC_VAL_20_u1 0.99609375 _CNV_A_R_LINEAR_____28_CM 0. 0.99609375 DISPLAY_IDENTIFIER C_CRLC_NOX_AD_FAC FORMAT "%5.3" /end CHARACTERISTIC
/begin CHARACTERISTIC lc_nox_ad_act "switch to activate NOx emission adaptation" VALUE 0xa080c5be _REC_VAL_20_u1 1. _CNV_A_R_LINEAR_____0_CM 0. 1. DISPLAY_IDENTIFIER LC_NOX_AD_ACT FORMAT "%1.0" /end CHARACTERISTIC
/begin CHARACTERISTIC c_crlc_nox_ad "correlation constant of NOx emission" VALUE 0xa080bb02 _REC_VAL_20_u2 0.9999847412109381 _CNV_A_R_LINEAR_____89_CM 0. 0.9999847412109381 DISPLAY_IDENTIFIER C_CRLC_NOX_AD FORMAT "%7.5" /end CHARACTERISTIC
/begin CHARACTERISTIC c_nox_ad_dyw "NOx emission limit for limited dynamics" VALUE 0xa080bfea _REC_VAL_20_u2 1023.984375 _CNV_A_R_LINEAR_____489_CM 0. 1023.984375 DISPLAY_IDENTIFIER C_NOX_AD_DYW FORMAT "%7.2" /end CHARACTERISTIC
/begin CHARACTERISTIC c_crlc_maf_fg_cyl "correlation constant of air mass flow" VALUE 0xa080baf4 _REC_VAL_20_u2 0.9999847412109381 _CNV_A_R_LINEAR_____89_CM 0. 0.9999847412109381 DISPLAY_IDENTIFIER C_CRLC_MAF_FG_CYL FORMAT "%7.5" /end CHARACTERISTIC
/begin CHARACTERISTIC c_maf_fg_cyl_dyw "air mass flow limit for limited dynamics" VALUE 0xa080be28 _REC_VAL_20_u2 2047.96875 _CNV_A_R_LINEAR_____215_CM 0. 2047.96875 DISPLAY_IDENTIFIER C_MAF_FG_CYL_DYW FORMAT "%7.2" /end CHARACTERISTIC
/begin CHARACTERISTIC lc_nox_ad_on "switch to enable permanent NOx emission adaptation" VALUE 0xa080c5c0 _REC_VAL_20_u1 1. _CNV_A_R_LINEAR_____0_CM 0. 1. DISPLAY_IDENTIFIER LC_NOX_AD_ON FORMAT "%1.0" /end CHARACTERISTIC
/begin CHARACTERISTIC c_ntld_min_nox_ad "min. NOx trap loading degree for starting adaptation" VALUE 0xa080c056 _REC_VAL_20_u2 0.9999847412109381 _CNV_A_R_LINEAR_____89_CM 0. 0.9999847412109381 DISPLAY_IDENTIFIER C_NTLD_MIN_NOX_AD FORMAT "%7.5" /end CHARACTERISTIC
/begin CHARACTERISTIC c_nox_ad_fac_dif "max. difference of NOx emission adaptation factor for finishing adaptation" VALUE 0xa080bfec _REC_VAL_20_u1 1.9921875 _CNV_A_R_LINEAR_____103_CM 0. 1.9921875 DISPLAY_IDENTIFIER C_NOX_AD_FAC_DIF FORMAT "%5.3" /end CHARACTERISTIC
/begin CHARACTERISTIC c_ctr_nox_ad_fac_min "min. value of adaptations counter to finish adaptation" VALUE 0xa080bbbb _REC_VAL_20_u1 255. _CNV_A_R_LINEAR_____0_CM 0. 255. DISPLAY_IDENTIFIER C_CTR_NOX_AD_FAC_MIN FORMAT "%3.0" /end CHARACTERISTIC
/begin CHARACTERISTIC c_tnt_mdl_nox_ad_min "temperature threshold for enabling / disabling emission adaptation" VALUE 0xa080c33f _REC_VAL_20_u1 1020. _CNV_A_R_LINEAR_____481_CM 0. 1020. DISPLAY_IDENTIFIER C_TNT_MDL_NOX_AD_MIN FORMAT "%4.0" /end CHARACTERISTIC
/begin CHARACTERISTIC c_tnt_mdl_nox_ad_max "temperature threshold for enabling / disabling emission adaptation" VALUE 0xa080c33e _REC_VAL_20_u1 1020. _CNV_A_R_LINEAR_____481_CM 0. 1020. DISPLAY_IDENTIFIER C_TNT_MDL_NOX_AD_MAX FORMAT "%4.0" /end CHARACTERISTIC
/begin CHARACTERISTIC c_ntld_max_nox_ad "max. NOx trap loading degree for starting adaptation" VALUE 0xa080c050 _REC_VAL_20_u2 0.9999847412109381 _CNV_A_R_LINEAR_____89_CM 0. 0.9999847412109381 DISPLAY_IDENTIFIER C_NTLD_MAX_NOX_AD FORMAT "%7.5" /end CHARACTERISTIC
/begin CHARACTERISTIC lc_nox_ad_fac_ini "switch for manual initialisation of NOx emission adaptation factor" VALUE 0xa080c5bf _REC_VAL_20_u1 1. _CNV_A_R_LINEAR_____0_CM 0. 1. DISPLAY_IDENTIFIER LC_NOX_AD_FAC_INI FORMAT "%1.0" /end CHARACTERISTIC
/begin CHARACTERISTIC c_nox_ad_fac_ini "NOx emission adaptation factor initialisation value" VALUE 0xa080bfed _REC_VAL_20_u1 1.9921875 _CNV_A_R_LINEAR_____103_CM 0. 1.9921875 DISPLAY_IDENTIFIER C_NOX_AD_FAC_INI FORMAT "%5.3" /end CHARACTERISTIC
/begin CHARACTERISTIC c_lamb_nox_ad_dyw "lambda threshold for limited dynamics" VALUE 0xa080bdd2 _REC_VAL_20_u2 31.9990234375 _CNV_A_R_LINEAR_____129_CM 0. 31.9990234375 DISPLAY_IDENTIFIER C_LAMB_NOX_AD_DYW FORMAT "%7.4" /end CHARACTERISTIC
/begin CHARACTERISTIC c_n_32_min_rgn_nox_ad "minimum engine speed for used adaptation value" VALUE 0xa080bf0e _REC_VAL_20_u1 8160. _CNV_A_R_LINEAR_____10_CM 0. 8160. DISPLAY_IDENTIFIER C_N_32_MIN_RGN_NOX_AD FORMAT "%4.0" /end CHARACTERISTIC
/begin CHARACTERISTIC c_vs_min_rgn_nox_ad "minimum vehicle speed for used adaptation value" VALUE 0xa080c4e9 _REC_VAL_20_u1 255. _CNV_A_R_LINEAR_____6_CM 0. 255. DISPLAY_IDENTIFIER C_VS_MIN_RGN_NOX_AD FORMAT "%3.0" /end CHARACTERISTIC
/begin CHARACTERISTIC c_maf_min_rgn_nox_ad "minimum mass air flow for used adaptation value" VALUE 0xa080be44 _REC_VAL_20_u2 2047.96875 _CNV_A_R_LINEAR_____215_CM 0. 2047.96875 DISPLAY_IDENTIFIER C_MAF_MIN_RGN_NOX_AD FORMAT "%7.2" /end CHARACTERISTIC
/begin AXIS_PTS ldpm_nt_agi_thermo "" 0xa0807bf0 nt_agi_thermo _REC_AXS_20_u2 0.9999847412109381 _CNV_A_R_LINEAR_____89_CM 6 0. 0.9999847412109381 FORMAT "%7.5" /end AXIS_PTS
/begin MEASUREMENT state_nox_prj "state of auxiliary functionalities manager" UBYTE _CNV_S_4_STATE_NOX__508_CM 1 100. 0. 4. DISPLAY_IDENTIFIER STATE_NOX_PRJ ECU_ADDRESS 0xd00088fc /end MEASUREMENT
/begin MEASUREMENT lv_nt_ad_cmpl "flag for communication with NOx catalyst aging module indicating a succesful adaptaion cycle" UBYTE _CNV_S_2_RANGE__0___1_CM 1 100. 0. 1. DISPLAY_IDENTIFIER LV_NT_AD_CMPL ECU_ADDRESS 0xd0008902 BIT_MASK 0x1 /end MEASUREMENT
/begin MEASUREMENT lv_nt_ad_vld "flag indicating that the evaluation of the adaptation values is allowed" UBYTE _CNV_S_2_RANGE__0___1_CM 1 100. 0. 1. DISPLAY_IDENTIFIER LV_NT_AD_VLD ECU_ADDRESS 0xd0008901 BIT_MASK 0x1 /end MEASUREMENT
/begin MEASUREMENT lv_nt_stc_max_act "flag for active full saturation" UBYTE _CNV_S_2_RANGE__0___1_CM 1 100. 0. 1. DISPLAY_IDENTIFIER LV_NT_STC_MAX_ACT ECU_ADDRESS 0xd0008903 BIT_MASK 0x1 /end MEASUREMENT
/begin MEASUREMENT lv_nt_stc_max_afl_act "flag for active lean phase of full saturation" UBYTE _CNV_S_2_RANGE__0___1_CM 1 100. 0. 1. DISPLAY_IDENTIFIER LV_NT_STC_MAX_AFL_ACT ECU_ADDRESS 0xd0008904 BIT_MASK 0x1 /end MEASUREMENT
/begin MEASUREMENT lv_nt_o2_stc_act "flag for active O2_STC management" UBYTE _CNV_S_2_RANGE__0___1_CM 1 100. 0. 1. DISPLAY_IDENTIFIER LV_NT_O2_STC_ACT ECU_ADDRESS 0xd0008900 BIT_MASK 0x1 /end MEASUREMENT
/begin MEASUREMENT lv_nt_prj_act "flag indicating an activated aux. func. module" UBYTE _CNV_S_2_RANGE__0___1_CM 1 100. 0. 1. DISPLAY_IDENTIFIER LV_NT_PRJ_ACT ECU_ADDRESS 0xd00088fd BIT_MASK 0x1 /end MEASUREMENT
/begin MEASUREMENT lv_rgn_req_ad "request for a full regeneration for adaptation or elongated stratisfied mode" UBYTE _CNV_S_2_RANGE__0___1_CM 1 100. 0. 1. DISPLAY_IDENTIFIER LV_RGN_REQ_AD ECU_ADDRESS 0xd00088ff BIT_MASK 0x1 /end MEASUREMENT
/begin MEASUREMENT lv_rgn_req_ad_vld "flag to set a valid request for a full regeneration" UBYTE _CNV_S_2_RANGE__0___1_CM 1 100. 0. 1. DISPLAY_IDENTIFIER LV_RGN_REQ_AD_VLD ECU_ADDRESS 0xd00014f5 BIT_MASK 0x1 /end MEASUREMENT
/begin MEASUREMENT lv_rgn_cdn_ad "flag for validity of sensor signal during regeneration" UBYTE _CNV_S_2_RANGE__0___1_CM 1 100. 0. 1. DISPLAY_IDENTIFIER LV_RGN_CDN_AD ECU_ADDRESS 0xd00014f6 BIT_MASK 0x1 /end MEASUREMENT
/begin MEASUREMENT lv_inh_rgn_ad "flag inhibiting a regeneration request by NOx sensor or loading degree model" UBYTE _CNV_S_2_RANGE__0___1_CM 1 100. 0. 1. DISPLAY_IDENTIFIER LV_INH_RGN_AD ECU_ADDRESS 0xd00088fe BIT_MASK 0x1 /end MEASUREMENT
/begin MEASUREMENT lv_sens_afr_ad_secu_1 "security threshold for sensor switch detection exceeded" UBYTE _CNV_S_2_RANGE__0___1_CM 1 100. 0. 1. DISPLAY_IDENTIFIER LV_SENS_AFR_AD_SECU_1 ECU_ADDRESS 0xd00014f7 BIT_MASK 0x1 /end MEASUREMENT
/begin MEASUREMENT lv_sens_afr_ad_secu_2 "security threshold for sensor switch detection exceeded" UBYTE _CNV_S_2_RANGE__0___1_CM 1 100. 0. 1. DISPLAY_IDENTIFIER LV_SENS_AFR_AD_SECU_2 ECU_ADDRESS 0xd00014f8 BIT_MASK 0x1 /end MEASUREMENT
/begin MEASUREMENT lv_sens_afr_o2_1 "thrshold for detecting rich mixture downstrem exceeded" UBYTE _CNV_S_2_RANGE__0___1_CM 1 100. 0. 1. DISPLAY_IDENTIFIER LV_SENS_AFR_O2_1 ECU_ADDRESS 0xd0008905 BIT_MASK 0x1 /end MEASUREMENT
/begin MEASUREMENT lv_sens_afr_o2_2 "thrshold for detecting rich mixture downstrem exceeded" UBYTE _CNV_S_2_RANGE__0___1_CM 1 100. 0. 1. DISPLAY_IDENTIFIER LV_SENS_AFR_O2_2 ECU_ADDRESS 0xd0008906 BIT_MASK 0x1 /end MEASUREMENT
/begin MEASUREMENT maf_int_puc_o2_stc "integral of mass air flow while PUC active, modified value for O2_STC measurement" UWORD _CNV_A_R_LINEAR_____210_CM 1 100. 0. 1820.398 DISPLAY_IDENTIFIER MAF_INT_PUC_O2_STC ECU_ADDRESS 0xd00014ec FORMAT "%7.2" /end MEASUREMENT
/begin MEASUREMENT t_vls_down_afl_1 "switch time counter" UWORD _CNV_A_R_LINEAR_____3_CM 1 100. 0. 655.35 DISPLAY_IDENTIFIER T_VLS_DOWN_AFL_1 ECU_ADDRESS 0xd000a4c8 FORMAT "%6.2" /end MEASUREMENT
/begin MEASUREMENT t_vls_down_afl_2 "switch time counter" UWORD _CNV_A_R_LINEAR_____3_CM 1 100. 0. 655.35 DISPLAY_IDENTIFIER T_VLS_DOWN_AFL_2 ECU_ADDRESS 0xd000a4cc FORMAT "%6.2" /end MEASUREMENT
/begin MEASUREMENT t_vls_down_secu_1 "time during witch sensor signal must pass from 1. vls-thd to 2. vls-thd (safety procedure)" UWORD _CNV_A_R_LINEAR_____3_CM 1 100. 0. 655.35 DISPLAY_IDENTIFIER T_VLS_DOWN_SECU_1 ECU_ADDRESS 0xd00014ee FORMAT "%6.2" /end MEASUREMENT
/begin MEASUREMENT t_vls_down_secu_2 "time during witch sensor signal must pass from 1. vls-thd to 2. vls-thd (safety procedure)" UWORD _CNV_A_R_LINEAR_____3_CM 1 100. 0. 655.35 DISPLAY_IDENTIFIER T_VLS_DOWN_SECU_2 ECU_ADDRESS 0xd00014f2 FORMAT "%6.2" /end MEASUREMENT
/begin MEASUREMENT t_nt_ad_com "time counter for duration of communication state" UBYTE _CNV_A_R_LINEAR_____4_CM 1 100. 0. 25.5 DISPLAY_IDENTIFIER T_NT_AD_COM ECU_ADDRESS 0xd00014f4 FORMAT "%4.1" /end MEASUREMENT
/begin MEASUREMENT ntl_dec_int_ad_1 "integral of reducing agent until sensor switch" UWORD _CNV_A_R_LINEAR_____244_CM 1 100. 0. 10485.6 DISPLAY_IDENTIFIER NTL_DEC_INT_AD_1 ECU_ADDRESS 0xd000a4ca FORMAT "%7.1" /end MEASUREMENT
/begin MEASUREMENT ntl_dec_int_ad_2 "integral of reducing agent until sensor switch" UWORD _CNV_A_R_LINEAR_____244_CM 1 100. 0. 10485.6 DISPLAY_IDENTIFIER NTL_DEC_INT_AD_2 ECU_ADDRESS 0xd000a4ce FORMAT "%7.1" /end MEASUREMENT
/begin MEASUREMENT ntl_dec_int_thd "integral of reducing agent to be achieved to stop full regeneration" UWORD _CNV_A_R_LINEAR_____244_CM 1 100. 0. 10485.6 DISPLAY_IDENTIFIER NTL_DEC_INT_THD ECU_ADDRESS 0xd00014f0 FORMAT "%7.1" /end MEASUREMENT
/begin CHARACTERISTIC lc_nt_prj_act "logical constant for auxiliary functionalities module activation" VALUE 0xa080c5ce _REC_VAL_20_u1 1. _CNV_A_R_LINEAR_____0_CM 0. 1. DISPLAY_IDENTIFIER LC_NT_PRJ_ACT FORMAT "%1.0" /end CHARACTERISTIC
/begin CHARACTERISTIC lc_rgn_req_ad_vld_act "logical constant for activation of extended regeneration phase after elongated stratified mode" VALUE 0xa080c5da _REC_VAL_20_u1 1. _CNV_A_R_LINEAR_____0_CM 0. 1. DISPLAY_IDENTIFIER LC_RGN_REQ_AD_VLD_ACT FORMAT "%1.0" /end CHARACTERISTIC
/begin CHARACTERISTIC c_maf_int_puc_o2_stc "required integral of air mass in PUC before starting an O2_STC measurement" VALUE 0xa080be32 _REC_VAL_20_u2 1820.398 _CNV_A_R_LINEAR_____210_CM 0. 1820.398 DISPLAY_IDENTIFIER C_MAF_INT_PUC_O2_STC FORMAT "%7.2" /end CHARACTERISTIC
/begin CHARACTERISTIC c_ntl_max_o2_stc "maximum permissible NOx load for O2_STC measurement" VALUE 0xa080c044 _REC_VAL_20_u2 10485.6 _CNV_A_R_LINEAR_____244_CM 0. 10485.6 DISPLAY_IDENTIFIER C_NTL_MAX_O2_STC FORMAT "%7.1" /end CHARACTERISTIC
/begin CHARACTERISTIC c_t_vls_down_secu "time within sensor signal must pass from 1. thd to 2. thd" VALUE 0xa080c296 _REC_VAL_20_u2 655.35 _CNV_A_R_LINEAR_____3_CM 0. 655.35 DISPLAY_IDENTIFIER C_T_VLS_DOWN_SECU FORMAT "%6.2" /end CHARACTERISTIC
/begin CHARACTERISTIC c_t_nt_ad_com "time threshold for duration of communication state" VALUE 0xa080c23e _REC_VAL_20_u1 25.5 _CNV_A_R_LINEAR_____4_CM 0. 25.5 DISPLAY_IDENTIFIER C_T_NT_AD_COM FORMAT "%4.1" /end CHARACTERISTIC
/begin CHARACTERISTIC c_vs_min_rgn_ad "maximum vehicle speed for use of adaptation value" VALUE 0xa080c4e8 _REC_VAL_20_u1 255. _CNV_A_R_LINEAR_____6_CM 0. 255. DISPLAY_IDENTIFIER C_VS_MIN_RGN_AD FORMAT "%3.0" /end CHARACTERISTIC
/begin CHARACTERISTIC c_n_32_min_rgn_ad "minimum engine speed for use of adaptation value" VALUE 0xa080bf0d _REC_VAL_20_u1 8160. _CNV_A_R_LINEAR_____10_CM 0. 8160. DISPLAY_IDENTIFIER C_N_32_MIN_RGN_AD FORMAT "%4.0" /end CHARACTERISTIC
/begin CHARACTERISTIC c_maf_min_rgn_ad "minimum mass air flow for use of adaptation value" VALUE 0xa080be42 _REC_VAL_20_u2 16383.75 _CNV_A_R_LINEAR_____509_CM 0. 16383.75 DISPLAY_IDENTIFIER C_MAF_MIN_RGN_AD FORMAT "%7.1" /end CHARACTERISTIC
/begin CHARACTERISTIC c_state_sens_afr_ad_1 "mode to determine rich exhaust gas downstream NOx trap" VALUE 0xa080c0f4 _REC_VAL_20_u1 3. _CNV_S_4_STATE_SENS_510_CM 0. 3. DISPLAY_IDENTIFIER C_STATE_SENS_AFR_AD_1 /end CHARACTERISTIC
/begin CHARACTERISTIC c_state_sens_afr_ad_2 "mode to determine rich exhaust gas downstream NOx trap" VALUE 0xa080c0f5 _REC_VAL_20_u1 3. _CNV_S_4_STATE_SENS_510_CM 0. 3. DISPLAY_IDENTIFIER C_STATE_SENS_AFR_AD_2 /end CHARACTERISTIC
/begin CHARACTERISTIC c_vls_down_afr_o2 "downstream binary lambda sensor signal threshold for determining rich exhaust gas (osc adaptation)" VALUE 0xa080c45a _REC_VAL_20_u2 4.9951171875 _CNV_A_R_LINEAR_____2_CM 0. 4.9951171875 DISPLAY_IDENTIFIER C_VLS_DOWN_AFR_O2 FORMAT "%5.3" /end CHARACTERISTIC
/begin CHARACTERISTIC c_vls_down_afr_ad_secu "1. sensor thd. after which 2. thd. must be reached within fixed time " VALUE 0xa080c458 _REC_VAL_20_u2 4.9951171875 _CNV_A_R_LINEAR_____2_CM 0. 4.9951171875 DISPLAY_IDENTIFIER C_VLS_DOWN_AFR_AD_SECU FORMAT "%5.3" /end CHARACTERISTIC
/begin CHARACTERISTIC c_vls_nox_sens_afr_o2 "binary NOx sensor signal threshold for determining rich exhaust gas (osc adaptation)" VALUE 0xa080c46c _REC_VAL_20_u2 1400. _CNV_A_R_LINEAR_____219_CM -200. 1200. DISPLAY_IDENTIFIER C_VLS_NOX_SENS_AFR_O2 FORMAT "%4.0" /end CHARACTERISTIC
/begin CHARACTERISTIC c_vls_nox_sens_afr_ad_secu "1. sensor thd. after which 2. thd. must be reached within fixed time " VALUE 0xa080c46a _REC_VAL_20_u2 1400. _CNV_A_R_LINEAR_____219_CM -200. 1200. DISPLAY_IDENTIFIER C_VLS_NOX_SENS_AFR_AD_SECU FORMAT "%4.0" /end CHARACTERISTIC
/begin CHARACTERISTIC c_lamb_nox_sens_afr_o2 "linear NOx sensor signal threshold for determining rich exhaust gas (osc adaptation)" VALUE 0xa080bdda _REC_VAL_20_u2 31.9990234375 _CNV_A_R_LINEAR_____129_CM 0. 31.9990234375 DISPLAY_IDENTIFIER C_LAMB_NOX_SENS_AFR_O2 FORMAT "%7.4" /end CHARACTERISTIC
/begin CHARACTERISTIC c_lamb_nox_sens_afr_ad_secu "1. sensor thd. after which 2. thd. must be reached within fixed time " VALUE 0xa080bdd8 _REC_VAL_20_u2 31.9990234375 _CNV_A_R_LINEAR_____129_CM 0. 31.9990234375 DISPLAY_IDENTIFIER C_LAMB_NOX_SENS_AFR_AD_SECU FORMAT "%7.4" /end CHARACTERISTIC
/begin AXIS_PTS ldp_t_afl_ntl_dec_int_ofs "" 0xa0808ccc t_afl _REC_AXS_20_u2 1310.7 _CNV_A_R_LINEAR_____110_CM 8 0. 1310.7 FORMAT "%7.2" /end AXIS_PTS
/begin CHARACTERISTIC ip_ntl_dec_int_ofs_t_afl "additional reducing agent mass required after elongated stratified mode" CURVE 0xa080b274 _REC_CUR_20_u2_u2 10485.6 _CNV_A_R_LINEAR_____244_CM 0. 10485.6 DISPLAY_IDENTIFIER IP_NTL_DEC_INT_OFS_T_AFL FORMAT "%7.1"
 /begin AXIS_DESCR COM_AXIS t_afl _CNV_A_R_LINEAR_____110_CM 8 0. 1310.7 FORMAT "%7.2" AXIS_PTS_REF ldp_t_afl_ntl_dec_int_ofs /end AXIS_DESCR
/end CHARACTERISTIC
/begin MEASUREMENT nox_out_mdl_sens "modelled NOx emission flow downstream the NOx catalyst" UWORD _CNV_A_R_LINEAR_____489_CM 1 100. 0. 1023.984375 DISPLAY_IDENTIFIER NOX_OUT_MDL_SENS ECU_ADDRESS 0xd00014fc FORMAT "%7.2" /end MEASUREMENT
/begin MEASUREMENT nox_out_mdl_dif_2 "deviation between measured and calculated NOx flow after NOx catalyst (bench selective)" SWORD _CNV_A_R_LINEAR_____489_CM 1 100. -512. 511.984375 DISPLAY_IDENTIFIER NOX_OUT_MDL_DIF_2 ECU_ADDRESS 0xd000151a FORMAT "%7.2" /end MEASUREMENT
/begin MEASUREMENT ntld_mdl_dif "correction of the closed loop control NOx catalyst model" SWORD _CNV_A_R_LINEAR_____511_CM 1 100. -0.5 0.499984741210938 DISPLAY_IDENTIFIER NTLD_MDL_DIF ECU_ADDRESS 0xd000a4d0 FORMAT "%8.5" /end MEASUREMENT
/begin MEASUREMENT nox_out_mdl_dif_1 "deviation between measured and calculated NOx flow after NOx catalyst (bench selective)" SWORD _CNV_A_R_LINEAR_____489_CM 1 100. -512. 511.984375 DISPLAY_IDENTIFIER NOX_OUT_MDL_DIF_1 ECU_ADDRESS 0xd0001506 FORMAT "%7.2" /end MEASUREMENT
/begin MEASUREMENT nox_out_mes_mmv_2 "moving mean value of measured NOx flow after NOx catalyst (bench selective)" UWORD _CNV_A_R_LINEAR_____489_CM 1 100. 0. 1023.984375 DISPLAY_IDENTIFIER NOX_OUT_MES_MMV_2 ECU_ADDRESS 0xd0001510 FORMAT "%7.2" /end MEASUREMENT
/begin MEASUREMENT nox_out_mes_mmv_1 "moving mean value of measured NOx flow after NOx catalyst (bench selective)" UWORD _CNV_A_R_LINEAR_____489_CM 1 100. 0. 1023.984375 DISPLAY_IDENTIFIER NOX_OUT_MES_MMV_1 ECU_ADDRESS 0xd00014fe FORMAT "%7.2" /end MEASUREMENT
/begin MEASUREMENT t_nox_mdl_ctrl_act_2 "time controller is active (bench selective)" UWORD _CNV_A_R_LINEAR_____110_CM 1 100. 0. 1310.7 DISPLAY_IDENTIFIER T_NOX_MDL_CTRL_ACT_2 ECU_ADDRESS 0xd0001512 FORMAT "%7.2" /end MEASUREMENT
/begin MEASUREMENT t_nox_mdl_ctrl_act_1 "time controller is active (bench selective)" UWORD _CNV_A_R_LINEAR_____110_CM 1 100. 0. 1310.7 DISPLAY_IDENTIFIER T_NOX_MDL_CTRL_ACT_1 ECU_ADDRESS 0xd0001500 FORMAT "%7.2" /end MEASUREMENT
/begin MEASUREMENT t_nox_mdl_ctrl_ena_1 "time controller is enabled (bench selective)" UWORD _CNV_A_R_LINEAR_____110_CM 1 100. 0. 1310.7 DISPLAY_IDENTIFIER T_NOX_MDL_CTRL_ENA_1 ECU_ADDRESS 0xd0001502 FORMAT "%7.2" /end MEASUREMENT
/begin MEASUREMENT t_nox_mdl_ctrl_ena_2 "time controller is enabled (bench selective)" UWORD _CNV_A_R_LINEAR_____110_CM 1 100. 0. 1310.7 DISPLAY_IDENTIFIER T_NOX_MDL_CTRL_ENA_2 ECU_ADDRESS 0xd0001514 FORMAT "%7.2" /end MEASUREMENT
/begin MEASUREMENT ntld_mdl_dif_i "I-value of the closed loop control NOx catalyst model" SWORD _CNV_A_R_LINEAR_____511_CM 1 100. -0.5 0.499984741210938 DISPLAY_IDENTIFIER NTLD_MDL_DIF_I ECU_ADDRESS 0xd0001508 FORMAT "%8.5" /end MEASUREMENT
/begin MEASUREMENT ntld_mdl_dif_i_1 "I-value of the closed loop control NOx catalyst model (bench selective)" SWORD _CNV_A_R_LINEAR_____511_CM 1 100. -0.5 0.499984741210938 DISPLAY_IDENTIFIER NTLD_MDL_DIF_I_1 ECU_ADDRESS 0xd000150c FORMAT "%8.5" /end MEASUREMENT
/begin MEASUREMENT ntld_mdl_dif_i_2 "I-value of the closed loop control NOx catalyst model (bench selective)" SWORD _CNV_A_R_LINEAR_____511_CM 1 100. -0.5 0.499984741210938 DISPLAY_IDENTIFIER NTLD_MDL_DIF_I_2 ECU_ADDRESS 0xd0001518 FORMAT "%8.5" /end MEASUREMENT
/begin MEASUREMENT ntld_mdl_dif_p "P-value of the closed loop control NOx catalyst model" SWORD _CNV_A_R_LINEAR_____511_CM 1 100. -0.5 0.499984741210938 DISPLAY_IDENTIFIER NTLD_MDL_DIF_P ECU_ADDRESS 0xd000150a FORMAT "%8.5" /end MEASUREMENT
/begin MEASUREMENT ntld_mdl_dif_p_1 "P-value of the closed loop control NOx catalyst model (bench selective)" SWORD _CNV_A_R_LINEAR_____511_CM 1 100. -0.5 0.499984741210938 DISPLAY_IDENTIFIER NTLD_MDL_DIF_P_1 ECU_ADDRESS 0xd000150e FORMAT "%8.5" /end MEASUREMENT
/begin MEASUREMENT ntld_mdl_dif_p_2 "P-value of the closed loop control NOx catalyst model (bench selective)" SWORD _CNV_A_R_LINEAR_____511_CM 1 100. -0.5 0.499984741210938 DISPLAY_IDENTIFIER NTLD_MDL_DIF_P_2 ECU_ADDRESS 0xd000151c FORMAT "%8.5" /end MEASUREMENT
/begin MEASUREMENT lv_nox_rgn_cmpl "boolean whether regenerations are \"complete\" or not" UBYTE _CNV_S_2_RANGE__0___1_CM 1 100. 0. 1. DISPLAY_IDENTIFIER LV_NOX_RGN_CMPL ECU_ADDRESS 0xd0008908 BIT_MASK 0x1 /end MEASUREMENT
/begin MEASUREMENT lv_inh_nox_mdl_ctrl_rgn "prohibition of regeneration by controller controlled NOx signal" UBYTE _CNV_S_2_RANGE__0___1_CM 1 100. 0. 1. DISPLAY_IDENTIFIER LV_INH_NOX_MDL_CTRL_RGN ECU_ADDRESS 0xd0008909 BIT_MASK 0x1 /end MEASUREMENT
/begin MEASUREMENT lv_inh_nox_mdl_ctrl_rgn_1 "prohibition of regeneration by controller controlled NOx signal (bench selective)" UBYTE _CNV_S_2_RANGE__0___1_CM 1 100. 0. 1. DISPLAY_IDENTIFIER LV_INH_NOX_MDL_CTRL_RGN_1 ECU_ADDRESS 0xd0001520 BIT_MASK 0x1 /end MEASUREMENT
/begin MEASUREMENT lv_inh_nox_mdl_ctrl_rgn_2 "prohibition of regeneration by controller controlled NOx signal (bench selective)" UBYTE _CNV_S_2_RANGE__0___1_CM 1 100. 0. 1. DISPLAY_IDENTIFIER LV_INH_NOX_MDL_CTRL_RGN_2 ECU_ADDRESS 0xd0001522 BIT_MASK 0x1 /end MEASUREMENT
/begin CHARACTERISTIC c_ntld_mdl_dif_i_min "minimum value of the I-part of the closed loop control NOx catalyst model" VALUE 0xa080c054 _REC_VAL_20_s2 0.9999847412109379 _CNV_A_R_LINEAR_____511_CM -0.5 0.499984741210938 DISPLAY_IDENTIFIER C_NTLD_MDL_DIF_I_MIN FORMAT "%8.5" /end CHARACTERISTIC
/begin CHARACTERISTIC c_ntld_mdl_dif_i_max "maximum value of the I-part of the closed loop control NOx catalyst model" VALUE 0xa080c052 _REC_VAL_20_s2 0.9999847412109379 _CNV_A_R_LINEAR_____511_CM -0.5 0.499984741210938 DISPLAY_IDENTIFIER C_NTLD_MDL_DIF_I_MAX FORMAT "%8.5" /end CHARACTERISTIC
/begin CHARACTERISTIC c_ntld_dec_stop "ramp gradient for a gradual deactivation of I-share during STATE_NOX = STOP" VALUE 0xa080c04c _REC_VAL_20_u2 0.9999847412109381 _CNV_A_R_LINEAR_____89_CM 0. 0.9999847412109381 DISPLAY_IDENTIFIER C_NTLD_DEC_STOP FORMAT "%7.5" /end CHARACTERISTIC
/begin CHARACTERISTIC c_ntld_dec_rgn "ramp gradient for a gradual deactivation of I-share during STATE_NOX = REGENERATION" VALUE 0xa080c04a _REC_VAL_20_u2 0.9999847412109381 _CNV_A_R_LINEAR_____89_CM 0. 0.9999847412109381 DISPLAY_IDENTIFIER C_NTLD_DEC_RGN FORMAT "%7.5" /end CHARACTERISTIC
/begin CHARACTERISTIC c_nox_out_mes_grd_max "maximum gradient of measured NOx flow downstream NOx cat" VALUE 0xa080bffa _REC_VAL_20_u2 1023.984375 _CNV_A_R_LINEAR_____489_CM 0. 1023.984375 DISPLAY_IDENTIFIER C_NOX_OUT_MES_GRD_MAX FORMAT "%7.2" /end CHARACTERISTIC
/begin CHARACTERISTIC lc_nox_rgn_cmpl "switch whether regenerations are \"complete\" or not" VALUE 0xa080c5c3 _REC_VAL_20_u1 1. _CNV_A_R_LINEAR_____0_CM 0. 1. DISPLAY_IDENTIFIER LC_NOX_RGN_CMPL FORMAT "%1.0" /end CHARACTERISTIC
/begin CHARACTERISTIC c_nox_ppm_ctrl_min "minimum threshold for measured NOx flow downstream NOx cat" VALUE 0xa080c000 _REC_VAL_20_u2 1500. _CNV_A_R_NOXD_LINEA_486_CM 0. 1500. DISPLAY_IDENTIFIER C_NOX_PPM_CTRL_MIN FORMAT "%4.0" /end CHARACTERISTIC
/begin CHARACTERISTIC c_ntld_ctrl_min "min NOx trap loading degree to start NOx catalyst model controller" VALUE 0xa080c048 _REC_VAL_20_u2 0.9999847412109381 _CNV_A_R_LINEAR_____89_CM 0. 0.9999847412109381 DISPLAY_IDENTIFIER C_NTLD_CTRL_MIN FORMAT "%7.5" /end CHARACTERISTIC
/begin CHARACTERISTIC c_crlc_nox_out_mes_mmv "correlation constant for moving mean value of measured NOx flow after NOx catalyst" VALUE 0xa080bb0c _REC_VAL_20_u2 0.9999847412109381 _CNV_A_R_LINEAR_____89_CM 0. 0.9999847412109381 DISPLAY_IDENTIFIER C_CRLC_NOX_OUT_MES_MMV FORMAT "%7.5" /end CHARACTERISTIC
/begin CHARACTERISTIC lc_nox_mdl_ctrl_act "switch to activate closed loop control for the NOx catalyst model" VALUE 0xa080c5c1 _REC_VAL_20_u1 1. _CNV_A_R_LINEAR_____0_CM 0. 1. DISPLAY_IDENTIFIER LC_NOX_MDL_CTRL_ACT FORMAT "%1.0" /end CHARACTERISTIC
/begin CHARACTERISTIC c_nox_out_mes_mmv_max "maximum value for \"limited dynamic\" for measured NOx flow downstream NOx cat" VALUE 0xa080bffe _REC_VAL_20_u2 1023.984375 _CNV_A_R_LINEAR_____489_CM 0. 1023.984375 DISPLAY_IDENTIFIER C_NOX_OUT_MES_MMV_MAX FORMAT "%7.2" /end CHARACTERISTIC
/begin CHARACTERISTIC c_nox_dif_mon "max deviation between model and NOx sensor" VALUE 0xa080bff2 _REC_VAL_20_u2 1023.984375 _CNV_A_R_LINEAR_____489_CM 0. 1023.984375 DISPLAY_IDENTIFIER C_NOX_DIF_MON FORMAT "%7.2" /end CHARACTERISTIC
/begin CHARACTERISTIC c_nox_dif_mon_min "threshold for monitoring deviation between model and NOx sensor" VALUE 0xa080bff4 _REC_VAL_20_u2 1500. _CNV_A_R_NOXD_LINEA_486_CM 0. 1500. DISPLAY_IDENTIFIER C_NOX_DIF_MON_MIN FORMAT "%4.0" /end CHARACTERISTIC
/begin CHARACTERISTIC c_t_nox_mdl_inh_ctrl_min "threshold for time controller must be active to allow regeneration request" VALUE 0xa080c23a _REC_VAL_20_u1 0.99609375 _CNV_A_R_LINEAR_____28_CM 0. 0.99609375 DISPLAY_IDENTIFIER C_T_NOX_MDL_INH_CTRL_MIN FORMAT "%5.3" /end CHARACTERISTIC
/begin CHARACTERISTIC c_t_nox_mdl_ctrl_ena_min "time controller is enabled" VALUE 0xa080c238 _REC_VAL_20_u2 1310.7 _CNV_A_R_LINEAR_____110_CM 0. 1310.7 DISPLAY_IDENTIFIER C_T_NOX_MDL_CTRL_ENA_MIN FORMAT "%7.2" /end CHARACTERISTIC
/begin CHARACTERISTIC lc_inh_p_hld "switch to inhibit holding of P-share" VALUE 0xa080c595 _REC_VAL_20_u1 1. _CNV_A_R_LINEAR_____0_CM 0. 1. DISPLAY_IDENTIFIER LC_INH_P_HLD FORMAT "%1.0" /end CHARACTERISTIC
/begin CHARACTERISTIC lc_inh_nox_mdl_ctrl_ini "initialisation value for LV_INH_NOX_MDL_CTRL_RGN_i" VALUE 0xa080c58c _REC_VAL_20_u1 1. _CNV_A_R_LINEAR_____0_CM 0. 1. DISPLAY_IDENTIFIER LC_INH_NOX_MDL_CTRL_INI FORMAT "%1.0" /end CHARACTERISTIC
/begin AXIS_PTS ldpm_nox_cor_red_mmv "" 0xa0809720 nox_cor_red_mmv _REC_AXS_20_u2 1023.984375 _CNV_A_R_LINEAR_____489_CM 6 0. 1023.984375 FORMAT "%7.2" /end AXIS_PTS
/begin AXIS_PTS ldp_maf_kgh_ip_crlc_nox_sens "" 0xa0808894 maf_kgh _REC_AXS_20_u2 2047.96875 _CNV_A_R_LINEAR_____215_CM 4 0. 2047.96875 FORMAT "%7.2" /end AXIS_PTS
/begin CHARACTERISTIC ip_ntld_mdl_dif_i "correlation constant for the I-share of the NTLD controller" MAP 0xa0815bac _REC_MAP_20_u2_u2_u2 0.499992370605469 _CNV_A_R_LINEAR_____512_CM 0. 0.499992370605469 DISPLAY_IDENTIFIER IP_NTLD_MDL_DIF_I FORMAT "%8.6"
 /begin AXIS_DESCR COM_AXIS nox_cor_red_mmv _CNV_A_R_LINEAR_____489_CM 6 0. 1023.984375 FORMAT "%7.2" AXIS_PTS_REF ldpm_nox_cor_red_mmv /end AXIS_DESCR
 /begin AXIS_DESCR COM_AXIS tnt_mdl_mv _CNV_A_R_LINEAR_____209_CM 6 0. 1023.984375 FORMAT "%7.2" AXIS_PTS_REF ldpm_tnt_mdl_mv /end AXIS_DESCR
/end CHARACTERISTIC
/begin CHARACTERISTIC ip_ntld_mdl_dif_p "correlation constant for the P-share of the NTLD controller" MAP 0xa0815bf4 _REC_MAP_20_u2_u2_u2 0.499992370605469 _CNV_A_R_LINEAR_____512_CM 0. 0.499992370605469 DISPLAY_IDENTIFIER IP_NTLD_MDL_DIF_P FORMAT "%8.6"
 /begin AXIS_DESCR COM_AXIS nox_cor_red_mmv _CNV_A_R_LINEAR_____489_CM 6 0. 1023.984375 FORMAT "%7.2" AXIS_PTS_REF ldpm_nox_cor_red_mmv /end AXIS_DESCR
 /begin AXIS_DESCR COM_AXIS tnt_mdl_mv _CNV_A_R_LINEAR_____209_CM 6 0. 1023.984375 FORMAT "%7.2" AXIS_PTS_REF ldpm_tnt_mdl_mv /end AXIS_DESCR
/end CHARACTERISTIC
/begin CHARACTERISTIC ip_crlc_nox_sens "correlation constant for the first order time delay of the calculated NOx flow after NOx catalyst" CURVE 0xa080a0ac _REC_CUR_20_u2_u2 0.9999847412109381 _CNV_A_R_LINEAR_____89_CM 0. 0.9999847412109381 DISPLAY_IDENTIFIER IP_CRLC_NOX_SENS FORMAT "%7.5"
 /begin AXIS_DESCR COM_AXIS maf_kgh _CNV_A_R_LINEAR_____215_CM 4 0. 2047.96875 FORMAT "%7.2" AXIS_PTS_REF ldp_maf_kgh_ip_crlc_nox_sens /end AXIS_DESCR
/end CHARACTERISTIC
/begin AXIS_PTS ldpm_tnt_mdl_mv "" 0xa0809858 tnt_mdl_mv _REC_AXS_20_u2 1023.984375 _CNV_A_R_LINEAR_____209_CM 6 0. 1023.984375 FORMAT "%7.2" /end AXIS_PTS
/begin CHARACTERISTIC c_su_conc_fuel "fuel sulphur concentration" VALUE 0xa0807f3c _REC_VAL_20_u1 510. _CNV_A_R_NOXM_LINEA_513_CM 0. 510. DISPLAY_IDENTIFIER C_SU_CONC_FUEL FORMAT "%3.0" /end CHARACTERISTIC
/begin CHARACTERISTIC c_su_conc_fuel_h "fuel sulphur concentration for high sulphured fuel" VALUE 0xa0807f3d _REC_VAL_20_u1 510. _CNV_A_R_NOXM_LINEA_513_CM 0. 510. DISPLAY_IDENTIFIER C_SU_CONC_FUEL_H FORMAT "%3.0" /end CHARACTERISTIC
/begin CHARACTERISTIC c_crlc_su_nox "correlation constant" VALUE 0xa0807eea _REC_VAL_20_u2 2.812146e-008 _CNV_A_R_NOXM_LINEA_514_CM 0. 2.812146e-008 DISPLAY_IDENTIFIER C_CRLC_SU_NOX FORMAT "%15.13" /end CHARACTERISTIC
/begin CHARACTERISTIC c_nt_sul_ini "manual initialisation value for NOx trap sulphur model" VALUE 0xa0807f2a _REC_VAL_20_u2 10485.6 _CNV_A_R_LINEAR_____244_CM 0. 10485.6 DISPLAY_IDENTIFIER C_NT_SUL_INI FORMAT "%7.1" /end CHARACTERISTIC
/begin CHARACTERISTIC c_lamb_sp_min_sul "lambda threshold for sulphur poisonning in homogeneous lambda 1" VALUE 0xa0807f02 _REC_VAL_20_u2 31.9990234375 _CNV_A_R_LINEAR_____129_CM 0. 31.9990234375 DISPLAY_IDENTIFIER C_LAMB_SP_MIN_SUL FORMAT "%7.4" /end CHARACTERISTIC
/begin CHARACTERISTIC lc_nt_sul_ini_man "logical constant for manual initialisation of NOx trap sulphur model" VALUE 0xa0807f77 _REC_VAL_20_u1 1. _CNV_A_R_LINEAR_____0_CM 0. 1. DISPLAY_IDENTIFIER LC_NT_SUL_INI_MAN FORMAT "%1.0" /end CHARACTERISTIC
/begin CHARACTERISTIC lc_nt_sul_lim_not "logical constant for continue incrementation above NT_SUL_MAX" VALUE 0xa0807f78 _REC_VAL_20_u1 1. _CNV_A_R_LINEAR_____0_CM 0. 1. DISPLAY_IDENTIFIER LC_NT_SUL_LIM_NOT FORMAT "%1.0" /end CHARACTERISTIC
/begin CHARACTERISTIC ip_nt_sul_max "maximum sulphur loading respecting NT_AGI_THERMO" CURVE 0xa0807e64 _REC_CUR_20_u2_u2 10485.6 _CNV_A_R_LINEAR_____244_CM 0. 10485.6 DISPLAY_IDENTIFIER IP_NT_SUL_MAX FORMAT "%7.1"
 /begin AXIS_DESCR COM_AXIS nt_agi_thermo _CNV_A_R_LINEAR_____89_CM 6 0. 0.9999847412109381 FORMAT "%7.5" AXIS_PTS_REF ldpm_nt_agi_thermo /end AXIS_DESCR
/end CHARACTERISTIC
/begin CHARACTERISTIC ip_t_so2p_dly "delay time before sulphur release" CURVE 0xa0807ea0 _REC_CUR_20_u2_u2 6553.5 _CNV_A_R_LINEAR_____4_CM 0. 6553.5 DISPLAY_IDENTIFIER IP_T_SO2P_DLY FORMAT "%6.1"
 /begin AXIS_DESCR COM_AXIS lamb_mv _CNV_A_R_LINEAR_____129_CM 4 0. 31.9990234375 FORMAT "%7.4" AXIS_PTS_REF ldpm_lamb_mv_ip_t_so2p_dly /end AXIS_DESCR
/end CHARACTERISTIC
/begin CHARACTERISTIC ip_nt_sul_dec_bas "basic sulphur loading decrement per time step" MAP 0xa0807e2c _REC_MAP_20_u2_u2_u2 5242.8 _CNV_A_R_NOXM_LINEA_515_CM 0. 5242.8 DISPLAY_IDENTIFIER IP_NT_SUL_DEC_BAS FORMAT "%7.2"
 /begin AXIS_DESCR COM_AXIS lamb_mv _CNV_A_R_LINEAR_____129_CM 4 0. 31.9990234375 FORMAT "%7.4" AXIS_PTS_REF ldpm_lamb_mv_ip_nt_sul_dec_bas /end AXIS_DESCR
 /begin AXIS_DESCR COM_AXIS tnt_mdl_mv _CNV_A_R_LINEAR_____209_CM 4 0. 1023.984375 FORMAT "%7.2" AXIS_PTS_REF ldp_tnt_mdl_mv_ip_nt_sul_dec /end AXIS_DESCR
/end CHARACTERISTIC
/begin CHARACTERISTIC ip_nt_sul_dec_fac_1 "correction factor for sulphur release" MAP 0xa08132ec _REC_MAP_20_u2_u2_u2 0.9999847412109381 _CNV_A_R_LINEAR_____89_CM 0. 0.9999847412109381 DISPLAY_IDENTIFIER IP_NT_SUL_DEC_FAC_1 FORMAT "%7.5"
 /begin AXIS_DESCR COM_AXIS nt_sul _CNV_A_R_LINEAR_____244_CM 6 0. 10485.6 FORMAT "%7.1" AXIS_PTS_REF ldpm_nt_sul_ip_nt_sul_dec_fac_1 /end AXIS_DESCR
 /begin AXIS_DESCR COM_AXIS nt_sul_so2p_beg[0] _CNV_A_R_LINEAR_____244_CM 6 0. 10485.6 FORMAT "%7.1" AXIS_PTS_REF ldp_nt_sul_so2p_beg_ip_nt_sul_1 /end AXIS_DESCR
/end CHARACTERISTIC
/begin AXIS_PTS ldp_tnt_mdl_mv_ip_nt_sul_dec "" 0xa0807b20 tnt_mdl_mv _REC_AXS_20_u2 1023.984375 _CNV_A_R_LINEAR_____209_CM 4 0. 1023.984375 FORMAT "%7.2" /end AXIS_PTS
/begin CHARACTERISTIC ip_nt_sul_h_dec_fac_1 "correction factor for sulphur release for high sulphured fuel" MAP 0xa0813334 _REC_MAP_20_u2_u2_u2 0.9999847412109381 _CNV_A_R_LINEAR_____89_CM 0. 0.9999847412109381 DISPLAY_IDENTIFIER IP_NT_SUL_H_DEC_FAC_1 FORMAT "%7.5"
 /begin AXIS_DESCR COM_AXIS nt_sul _CNV_A_R_LINEAR_____244_CM 6 0. 10485.6 FORMAT "%7.1" AXIS_PTS_REF ldpm_nt_sul_ip_nt_sul_dec_fac_1 /end AXIS_DESCR
 /begin AXIS_DESCR COM_AXIS nt_sul_so2p_beg[0] _CNV_A_R_LINEAR_____244_CM 6 0. 10485.6 FORMAT "%7.1" AXIS_PTS_REF ldp_nt_sul_so2p_beg_ip_nt_sul_1 /end AXIS_DESCR
/end CHARACTERISTIC
/begin AXIS_PTS ldp_nt_agi_thermo_ip_nt_sul_2 "" 0xa0807ad0 nt_agi_thermo _REC_AXS_20_u2 0.9999847412109381 _CNV_A_R_LINEAR_____89_CM 6 0. 0.9999847412109381 FORMAT "%7.5" /end AXIS_PTS
/begin CHARACTERISTIC ip_nt_sul_dec_fac_2 "correction factor for sulphur release on thermal aging factor" CURVE 0xa0807e4c _REC_CUR_20_u2_u2 0.9999847412109381 _CNV_A_R_LINEAR_____89_CM 0. 0.9999847412109381 DISPLAY_IDENTIFIER IP_NT_SUL_DEC_FAC_2 FORMAT "%7.5"
 /begin AXIS_DESCR COM_AXIS nt_agi_thermo _CNV_A_R_LINEAR_____89_CM 6 0. 0.9999847412109381 FORMAT "%7.5" AXIS_PTS_REF ldp_nt_agi_thermo_ip_nt_sul_2 /end AXIS_DESCR
/end CHARACTERISTIC
/begin AXIS_PTS ldpm_lamb_mv_ip_t_so2p_dly "" 0xa0807b5c lamb_mv _REC_AXS_20_u2 31.9990234375 _CNV_A_R_LINEAR_____129_CM 4 0. 31.9990234375 FORMAT "%7.4" /end AXIS_PTS
/begin AXIS_PTS ldpm_lamb_mv_ip_nt_sul_dec_bas "" 0xa0807b50 lamb_mv _REC_AXS_20_u2 31.9990234375 _CNV_A_R_LINEAR_____129_CM 4 0. 31.9990234375 FORMAT "%7.4" /end AXIS_PTS
/begin AXIS_PTS ldp_nt_sul_so2p_beg_ip_nt_sul_1 "" 0xa0807af0 nt_sul_so2p_beg[0] _REC_AXS_20_u2 10485.6 _CNV_A_R_LINEAR_____244_CM 6 0. 10485.6 FORMAT "%7.1" /end AXIS_PTS
/begin AXIS_PTS ldpm_nt_sul_ip_nt_sul_h_dec_1 "" 0xa0807c10 nt_sul _REC_AXS_20_u2 10485.6 _CNV_A_R_LINEAR_____244_CM 6 0. 10485.6 FORMAT "%7.1" /end AXIS_PTS
/begin AXIS_PTS ldp_tnt_mdl_mv_ip_crlc_sul_afs "" 0xa0807b00 tnt_mdl_mv _REC_AXS_20_u2 1023.984375 _CNV_A_R_LINEAR_____209_CM 4 0. 1023.984375 FORMAT "%7.2" /end AXIS_PTS
/begin CHARACTERISTIC ip_crlc_sul_afs "conversion factor for sulphur poisonning in homogenous lambda 1 according to tnt_mdl_mv" CURVE 0xa0807c68 _REC_CUR_20_u2_u2 0.9999847412109381 _CNV_A_R_LINEAR_____89_CM 0. 0.9999847412109381 DISPLAY_IDENTIFIER IP_CRLC_SUL_AFS FORMAT "%7.5"
 /begin AXIS_DESCR COM_AXIS tnt_mdl_mv _CNV_A_R_LINEAR_____209_CM 4 0. 1023.984375 FORMAT "%7.2" AXIS_PTS_REF ldp_tnt_mdl_mv_ip_crlc_sul_afs /end AXIS_DESCR
/end CHARACTERISTIC
/begin AXIS_PTS ldpm_nt_sul_ip_nt_sul_dec_fac_1 "" 0xa0807c00 nt_sul _REC_AXS_20_u2 10485.6 _CNV_A_R_LINEAR_____244_CM 6 0. 10485.6 FORMAT "%7.1" /end AXIS_PTS
/begin MEASUREMENT nt_sul_h "NOx trap sulphur loading for high sulphured fuel" UWORD _CNV_A_R_LINEAR_____244_CM 1 100. 0. 10485.6 DISPLAY_IDENTIFIER NT_SUL_H ECU_ADDRESS 0xd0007202 FORMAT "%7.1" /end MEASUREMENT
/begin MEASUREMENT nt_sul "NOx trap sulphur loading" UWORD _CNV_A_R_LINEAR_____244_CM 1 100. 0. 10485.6 DISPLAY_IDENTIFIER NT_SUL ECU_ADDRESS 0xd00071fa FORMAT "%7.1" /end MEASUREMENT
/begin CHARACTERISTIC c_state_egr_cbk "Configuration of asymmetrical EGR branch for sulfur model ( 0: no unsymmetry, 1 or 2: EGR branch on this bank )" VALUE 0xa0807f34 _REC_VAL_20_u1 2. _CNV_A_R_LINEAR_____0_CM 0. 2. DISPLAY_IDENTIFIER C_STATE_EGR_CBK FORMAT "%2.0" /end CHARACTERISTIC
/begin MEASUREMENT nt_sul_32[0] "NOx trap sulphur loading with high resolution" ULONG _CNV_A_R_NOXM_LINEA_516_CM 1 100. 0. 10485.6 DISPLAY_IDENTIFIER NT_SUL_32[1] ECU_ADDRESS 0xd000639c FORMAT "%12.6" /end MEASUREMENT
/begin MEASUREMENT nt_sul_32[1] "NOx trap sulphur loading with high resolution" ULONG _CNV_A_R_NOXM_LINEA_516_CM 1 100. 0. 10485.6 DISPLAY_IDENTIFIER NT_SUL_32[2] ECU_ADDRESS 0xd00063a0 FORMAT "%12.6" /end MEASUREMENT
/begin MEASUREMENT nt_sul_h_32[0] "NOx trap sulphur loading for high sulphured fuel with high resolution" ULONG _CNV_A_R_NOXM_LINEA_516_CM 1 100. 0. 10485.6 DISPLAY_IDENTIFIER NT_SUL_H_32[1] ECU_ADDRESS 0xd00063a4 FORMAT "%12.6" /end MEASUREMENT
/begin MEASUREMENT nt_sul_h_32[1] "NOx trap sulphur loading for high sulphured fuel with high resolution" ULONG _CNV_A_R_NOXM_LINEA_516_CM 1 100. 0. 10485.6 DISPLAY_IDENTIFIER NT_SUL_H_32[2] ECU_ADDRESS 0xd00063a8 FORMAT "%12.6" /end MEASUREMENT
/begin MEASUREMENT nt_sul_max[0] "maximum NOx trap sulphur loading" UWORD _CNV_A_R_LINEAR_____244_CM 1 100. 0. 10485.6 DISPLAY_IDENTIFIER NT_SUL_MAX[1] ECU_ADDRESS 0xd0007204 FORMAT "%7.1" /end MEASUREMENT
/begin MEASUREMENT nt_sul_max[1] "maximum NOx trap sulphur loading" UWORD _CNV_A_R_LINEAR_____244_CM 1 100. 0. 10485.6 DISPLAY_IDENTIFIER NT_SUL_MAX[2] ECU_ADDRESS 0xd0007206 FORMAT "%7.1" /end MEASUREMENT
/begin MEASUREMENT nt_agi_inc_so2p[0] "NOx trap aging factor increment per time step" ULONG _CNV_A_R_NOXM_LINEA_507_CM 1 100. 0. 1. DISPLAY_IDENTIFIER NT_AGI_INC_SO2P[1] ECU_ADDRESS 0xd0006388 FORMAT "%12.10" /end MEASUREMENT
/begin MEASUREMENT nt_agi_inc_so2p[1] "NOx trap aging factor increment per time step" ULONG _CNV_A_R_NOXM_LINEA_507_CM 1 100. 0. 1. DISPLAY_IDENTIFIER NT_AGI_INC_SO2P[2] ECU_ADDRESS 0xd000638c FORMAT "%12.10" /end MEASUREMENT
/begin MEASUREMENT nt_sul_h_delta[0] "NT_SUL_H delta due to desulfation or loading" SLONG _CNV_A_R_NOXM_LINEA_517_CM 1 100. -5242.88 5242.87999755859 DISPLAY_IDENTIFIER NT_SUL_H_DELTA[1] ECU_ADDRESS 0xd00036dc FORMAT "%11.6" /end MEASUREMENT
/begin MEASUREMENT nt_sul_h_delta[1] "NT_SUL_H delta due to desulfation or loading" SLONG _CNV_A_R_NOXM_LINEA_517_CM 1 100. -5242.88 5242.87999755859 DISPLAY_IDENTIFIER NT_SUL_H_DELTA[2] ECU_ADDRESS 0xd00036e0 FORMAT "%11.6" /end MEASUREMENT
/begin MEASUREMENT nt_sul_h_so2p_beg[0] "NOx trap sulphur loading for high sulphured fuel at desulfation begin" UWORD _CNV_A_R_LINEAR_____244_CM 1 100. 0. 10485.6 DISPLAY_IDENTIFIER NT_SUL_H_SO2P_BEG[1] ECU_ADDRESS 0xd00036a0 FORMAT "%7.1" /end MEASUREMENT
/begin MEASUREMENT nt_sul_h_so2p_beg[1] "NOx trap sulphur loading for high sulphured fuel at desulfation begin" UWORD _CNV_A_R_LINEAR_____244_CM 1 100. 0. 10485.6 DISPLAY_IDENTIFIER NT_SUL_H_SO2P_BEG[2] ECU_ADDRESS 0xd00036a2 FORMAT "%7.1" /end MEASUREMENT
/begin MEASUREMENT nt_sul_agi_delta[0] "NT_SUL_AGI delta due to desulfation" SLONG _CNV_A_R_NOXM_LINEA_517_CM 1 100. -5242.88 5242.87999755859 DISPLAY_IDENTIFIER NT_SUL_AGI_DELTA[1] ECU_ADDRESS 0xd00036cc FORMAT "%11.6" /end MEASUREMENT
/begin MEASUREMENT nt_sul_agi_delta[1] "NT_SUL_AGI delta due to desulfation" SLONG _CNV_A_R_NOXM_LINEA_517_CM 1 100. -5242.88 5242.87999755859 DISPLAY_IDENTIFIER NT_SUL_AGI_DELTA[2] ECU_ADDRESS 0xd00036d0 FORMAT "%11.6" /end MEASUREMENT
/begin MEASUREMENT nt_sul_delta[0] "NT_SUL delta due to desulfation or loading" SLONG _CNV_A_R_NOXM_LINEA_517_CM 1 100. -5242.88 5242.87999755859 DISPLAY_IDENTIFIER NT_SUL_DELTA[1] ECU_ADDRESS 0xd00036d4 FORMAT "%11.6" /end MEASUREMENT
/begin MEASUREMENT nt_sul_delta[1] "NT_SUL delta due to desulfation or loading" SLONG _CNV_A_R_NOXM_LINEA_517_CM 1 100. -5242.88 5242.87999755859 DISPLAY_IDENTIFIER NT_SUL_DELTA[2] ECU_ADDRESS 0xd00036d8 FORMAT "%11.6" /end MEASUREMENT
/begin MEASUREMENT nt_sul_so2p_beg[0] "NOx trap sulphur loading at desulfation begin" UWORD _CNV_A_R_LINEAR_____244_CM 1 100. 0. 10485.6 DISPLAY_IDENTIFIER NT_SUL_SO2P_BEG[1] ECU_ADDRESS 0xd00036a4 FORMAT "%7.1" /end MEASUREMENT
/begin MEASUREMENT nt_sul_so2p_beg[1] "NOx trap sulphur loading at desulfation begin" UWORD _CNV_A_R_LINEAR_____244_CM 1 100. 0. 10485.6 DISPLAY_IDENTIFIER NT_SUL_SO2P_BEG[2] ECU_ADDRESS 0xd00036a6 FORMAT "%7.1" /end MEASUREMENT
/begin MEASUREMENT nox_out_mes_int_1 "absolute tailpipe NOx emission during stratified operation mode" UWORD _CNV_A_R_LINEAR_____244_CM 1 100. 0. 10485.6 DISPLAY_IDENTIFIER NOX_OUT_MES_INT_1 ECU_ADDRESS 0xd000a4d4 FORMAT "%7.1" /end MEASUREMENT
/begin MEASUREMENT nox_out_mes_int_2 "absolute tailpipe NOx emission during stratified operation mode" UWORD _CNV_A_R_LINEAR_____244_CM 1 100. 0. 10485.6 DISPLAY_IDENTIFIER NOX_OUT_MES_INT_2 ECU_ADDRESS 0xd000a4d8 FORMAT "%7.1" /end MEASUREMENT
/begin MEASUREMENT nox_out_mes_1 "tailpipe NOx emission" UWORD _CNV_A_R_LINEAR_____489_CM 1 100. 0. 1023.984375 DISPLAY_IDENTIFIER NOX_OUT_MES_1 ECU_ADDRESS 0xd000a4d6 FORMAT "%7.2" /end MEASUREMENT
/begin MEASUREMENT nox_out_mes_2 "tailpipe NOx emission" UWORD _CNV_A_R_LINEAR_____489_CM 1 100. 0. 1023.984375 DISPLAY_IDENTIFIER NOX_OUT_MES_2 ECU_ADDRESS 0xd000a4da FORMAT "%7.2" /end MEASUREMENT
/begin CHARACTERISTIC lc_nox_out_mes_int_act "switch to enable calculation of NOx tailpipe emission" VALUE 0xa080c5c2 _REC_VAL_20_u1 1. _CNV_A_R_LINEAR_____0_CM 0. 1. DISPLAY_IDENTIFIER LC_NOX_OUT_MES_INT_ACT FORMAT "%1.0" /end CHARACTERISTIC
/begin MEASUREMENT teg_pcat_down_add "temperature offset to correct the influence of the exhaust flap and temp. sensor position" SWORD _CNV_A_R_LINEAR_____209_CM 1 100. -512. 511.984375 DISPLAY_IDENTIFIER TEG_PCAT_DOWN_ADD ECU_ADDRESS 0xd000a528 FORMAT "%6.2" /end MEASUREMENT
/begin MEASUREMENT fac_tnt_min_cor_1 "factor to reduce dew-point time of NOx cat. monolith temp. model" UBYTE _CNV_A_R_LINEAR_____103_CM 1 100. 0. 1.9921875 DISPLAY_IDENTIFIER FAC_TNT_MIN_COR_1 ECU_ADDRESS 0xd0008940 FORMAT "%5.3" /end MEASUREMENT
/begin MEASUREMENT fac_tnt_min_cor_2 "factor to reduce dew-point time of NOx cat. monolith temp. model" UBYTE _CNV_A_R_LINEAR_____103_CM 1 100. 0. 1.9921875 DISPLAY_IDENTIFIER FAC_TNT_MIN_COR_2 ECU_ADDRESS 0xd0008941 FORMAT "%5.3" /end MEASUREMENT
/begin MEASUREMENT int_tnt_maf "sum of weighted air mass flow values used for dew point recognition" UWORD _CNV_A_R_LINEAR_____518_CM 1 100. 0. 14506.44 DISPLAY_IDENTIFIER INT_TNT_MAF ECU_ADDRESS 0xd000166c FORMAT "%7.1" /end MEASUREMENT
/begin MEASUREMENT lv_tnt_min_thd_1 "dew point recognition" UBYTE _CNV_S_2_RANGE__0___1_CM 1 100. 0. 1. DISPLAY_IDENTIFIER LV_TNT_MIN_THD_1 ECU_ADDRESS 0xd000895d BIT_MASK 0x1 /end MEASUREMENT
/begin MEASUREMENT lv_tnt_min_thd_2 "dew point recognition" UBYTE _CNV_S_2_RANGE__0___1_CM 1 100. 0. 1. DISPLAY_IDENTIFIER LV_TNT_MIN_THD_2 ECU_ADDRESS 0xd000895e BIT_MASK 0x1 /end MEASUREMENT
/begin MEASUREMENT fac_int_tnt_maf_sa "Correction factor for INT_TNT_MAF calculation for active secondary air" UBYTE _CNV_A_R_LINEAR_____243_CM 1 100. 0. 3.984375 DISPLAY_IDENTIFIER FAC_INT_TNT_MAF_SA ECU_ADDRESS 0xd0001670 FORMAT "%4.2" /end MEASUREMENT
/begin MEASUREMENT ctr_cold_st_nt "number of cold starts for NOx catalyst" UBYTE _CNV_A_R_LINEAR_____0_CM 1 100. 0. 255. DISPLAY_IDENTIFIER CTR_COLD_ST_NT ECU_ADDRESS 0xd000895c FORMAT "%3.0" /end MEASUREMENT
/begin CHARACTERISTIC c_fac_int_tnt_maf_sa "Correction factor for INT_TNT_MAF calculation for active secondary air" VALUE 0xa080bcce _REC_VAL_20_u1 3.984375 _CNV_A_R_LINEAR_____243_CM 0. 3.984375 DISPLAY_IDENTIFIER C_FAC_INT_TNT_MAF_SA FORMAT "%4.2" /end CHARACTERISTIC
/begin AXIS_PTS ldpm_tco_st__int_tnt_thd "" 0xa080981a tco_st _REC_AXS_20_u1 28.575 _CNV_A_R_LINEAR_____17_CM 6 -48. 142.5 FORMAT "%5.1" /end AXIS_PTS
/begin AXIS_PTS ldpm_teg__int_tnt_thd "" 0xa080982c online_dummy _REC_AXS_20_u2 153.59765625 _CNV_A_R_LINEAR_____209_CM 6 0. 1023.984375 FORMAT "%7.2" /end AXIS_PTS
/begin CHARACTERISTIC ip_int_tnt_thd_1__tco_st__teg "threshold for air mass flow integral for the detection of dew-point" MAP 0xa081510c _REC_MAP_20_u2_u1_u2 14506.44 _CNV_A_R_LINEAR_____518_CM 0. 14506.44 DISPLAY_IDENTIFIER IP_INT_TNT_THD_1__TCO_ST__TEG FORMAT "%7.1"
 /begin AXIS_DESCR COM_AXIS tco_st _CNV_A_R_LINEAR_____17_CM 6 -48. 142.5 FORMAT "%5.1" AXIS_PTS_REF ldpm_tco_st__int_tnt_thd /end AXIS_DESCR
 /begin AXIS_DESCR COM_AXIS online_dummy _CNV_A_R_LINEAR_____209_CM 6 0. 1023.984375 FORMAT "%7.2" AXIS_PTS_REF ldpm_teg__int_tnt_thd /end AXIS_DESCR
/end CHARACTERISTIC
/begin CHARACTERISTIC ip_int_tnt_thd_2__tco_st__teg "threshold for air mass flow integral for the detection of dew-point" MAP 0xa0815154 _REC_MAP_20_u2_u1_u2 14506.44 _CNV_A_R_LINEAR_____518_CM 0. 14506.44 DISPLAY_IDENTIFIER IP_INT_TNT_THD_2__TCO_ST__TEG FORMAT "%7.1"
 /begin AXIS_DESCR COM_AXIS tco_st _CNV_A_R_LINEAR_____17_CM 6 -48. 142.5 FORMAT "%5.1" AXIS_PTS_REF ldpm_tco_st__int_tnt_thd /end AXIS_DESCR
 /begin AXIS_DESCR COM_AXIS online_dummy _CNV_A_R_LINEAR_____209_CM 6 0. 1023.984375 FORMAT "%7.2" AXIS_PTS_REF ldpm_teg__int_tnt_thd /end AXIS_DESCR
/end CHARACTERISTIC
/begin AXIS_PTS ldp_ctr_cold_st_nt__tnt_cold_st "" 0xa080851c ctr_cold_st_nt _REC_AXS_20_u1 255. _CNV_A_R_LINEAR_____0_CM 6 0. 255. FORMAT "%3.0" /end AXIS_PTS
/begin CHARACTERISTIC id_tnt_cold_st__ctr_cold_st_nt "weighting factor for the consideration of the number of cold start tests" CURVE 0xa0809ec8 _REC_CUR_20_u1_u1 3.984375 _CNV_A_R_LINEAR_____243_CM 0. 3.984375 DISPLAY_IDENTIFIER ID_TNT_COLD_ST__CTR_COLD_ST_NT FORMAT "%4.2"
 /begin AXIS_DESCR COM_AXIS ctr_cold_st_nt _CNV_A_R_LINEAR_____0_CM 6 0. 255. FORMAT "%3.0" AXIS_PTS_REF ldp_ctr_cold_st_nt__tnt_cold_st /end AXIS_DESCR
/end CHARACTERISTIC
/begin AXIS_PTS ldp_eff_iga_av__int_tnt "" 0xa080859c eff_iga_av _REC_AXS_20_u2 1.99996948242188 _CNV_A_R_LINEAR_____9_CM 6 0. 1.99996948242188 FORMAT "%7.5" /end AXIS_PTS
/begin AXIS_PTS ldp_maf_kgh__int_tnt "" 0xa0808870 maf_kgh _REC_AXS_20_u2 2047.96875 _CNV_A_R_LINEAR_____215_CM 6 0. 2047.96875 FORMAT "%7.2" /end AXIS_PTS
/begin CHARACTERISTIC ip_int_tnt__eff_iga_av__maf_kgh "weighting factor for ignition angle influence on dew point calculation" MAP 0xa080ad7c _REC_MAP_20_u1_u2_u2 15.9375 _CNV_A_R_EVAC_LINEA_298_CM 0. 15.9375 DISPLAY_IDENTIFIER IP_INT_TNT__EFF_IGA_AV__MAF_KGH FORMAT "%5.2"
 /begin AXIS_DESCR COM_AXIS eff_iga_av _CNV_A_R_LINEAR_____9_CM 6 0. 1.99996948242188 FORMAT "%7.5" AXIS_PTS_REF ldp_eff_iga_av__int_tnt /end AXIS_DESCR
 /begin AXIS_DESCR COM_AXIS maf_kgh _CNV_A_R_LINEAR_____215_CM 6 0. 2047.96875 FORMAT "%7.2" AXIS_PTS_REF ldp_maf_kgh__int_tnt /end AXIS_DESCR
/end CHARACTERISTIC
/begin MEASUREMENT teg_pcat_down_cor[0] "Sensor input NOx catalyst monolith temperature" UWORD _CNV_A_R_LINEAR_____209_CM 1 100. 0. 1023.984375 DISPLAY_IDENTIFIER TEG_PCAT_DOWN_COR[0] ECU_ADDRESS 0xd000a530 FORMAT "%7.2" /end MEASUREMENT
/begin MEASUREMENT teg_pcat_down_cor[1] "Sensor input NOx catalyst monolith temperature" UWORD _CNV_A_R_LINEAR_____209_CM 1 100. 0. 1023.984375 DISPLAY_IDENTIFIER TEG_PCAT_DOWN_COR[1] ECU_ADDRESS 0xd000a532 FORMAT "%7.2" /end MEASUREMENT
/begin MEASUREMENT ctr_cold_st "number of cold starts" UBYTE _CNV_A_R_LINEAR_____0_CM 1 100. 0. 255. DISPLAY_IDENTIFIER CTR_COLD_ST ECU_ADDRESS 0xd0008a08 FORMAT "%3.0" /end MEASUREMENT
/begin MEASUREMENT int_teg_maf "sum of the weighted air mass flow values used for the dew point recognition" UWORD _CNV_A_R_LINEAR_____519_CM 1 100. 0. 9102.08 DISPLAY_IDENTIFIER INT_TEG_MAF ECU_ADDRESS 0xd0001674 FORMAT "%6.1" /end MEASUREMENT
/begin MEASUREMENT lv_teg_cat_down_min_thd_1 "dew-point recognition downstream of catalyst" UBYTE _CNV_A_R_LINEAR_____0_CM 1 100. 0. 1. DISPLAY_IDENTIFIER LV_TEG_CAT_DOWN_MIN_THD ECU_ADDRESS 0xd0008a0a FORMAT "%1.0" BIT_MASK 0x1 /end MEASUREMENT
/begin MEASUREMENT lv_teg_min_thd_1 "dew-point recognition" UBYTE _CNV_A_R_LINEAR_____0_CM 1 100. 0. 1. DISPLAY_IDENTIFIER LV_TEG_MIN_THD ECU_ADDRESS 0xd0008a09 FORMAT "%1.0" BIT_MASK 0x1 /end MEASUREMENT
/begin CHARACTERISTIC id_ctr_cold_st "weighting factor for the consideration of the number of cold-start tests" CURVE 0xa080993c _REC_CUR_20_u1_u1 3.984375 _CNV_A_R_LINEAR_____243_CM 0. 3.984375 DISPLAY_IDENTIFIER ID_CTR_COLD_ST FORMAT "%4.2"
 /begin AXIS_DESCR COM_AXIS ctr_cold_st _CNV_A_R_LINEAR_____0_CM 6 0. 255. FORMAT "%3.0" AXIS_PTS_REF ldp_ctr_cold_st__ctr_cold_st /end AXIS_DESCR
/end CHARACTERISTIC
/begin AXIS_PTS ldp_ctr_cold_st__ctr_cold_st "" 0xa0808514 ctr_cold_st _REC_AXS_20_u1 255. _CNV_A_R_LINEAR_____0_CM 6 0. 255. FORMAT "%3.0" /end AXIS_PTS
/begin CHARACTERISTIC ip_int_teg_thd "threshold air mass flow integral for detection of dew point upstream of catalyst" MAP 0xa08150ac _REC_MAP_20_u2_u1_u1 9102.08 _CNV_A_R_LINEAR_____519_CM 0. 9102.08 DISPLAY_IDENTIFIER IP_INT_TEG_THD FORMAT "%6.1"
 /begin AXIS_DESCR COM_AXIS tco_st _CNV_A_R_LINEAR_____17_CM 8 -48. 142.5 FORMAT "%6.2" AXIS_PTS_REF ldpm_tco_st_1_extd /end AXIS_DESCR
 /begin AXIS_DESCR COM_AXIS tia _CNV_A_R_LINEAR_____17_CM 6 -48. 142.5 FORMAT "%6.2" AXIS_PTS_REF ldpm_tia_1_extd /end AXIS_DESCR
/end CHARACTERISTIC
/begin CHARACTERISTIC ip_int_teg_cat_down_thd "threshold air mass flow integral for detection of dew point downstream of catalyst" MAP 0xa081504c _REC_MAP_20_u2_u1_u1 9102.08 _CNV_A_R_LINEAR_____519_CM 0. 9102.08 DISPLAY_IDENTIFIER IP_INT_TEG_CAT_DOWN_THD FORMAT "%6.1"
 /begin AXIS_DESCR COM_AXIS tco_st _CNV_A_R_LINEAR_____17_CM 8 -48. 142.5 FORMAT "%6.2" AXIS_PTS_REF ldpm_tco_st_1_extd /end AXIS_DESCR
 /begin AXIS_DESCR COM_AXIS tia _CNV_A_R_LINEAR_____17_CM 6 -48. 142.5 FORMAT "%6.2" AXIS_PTS_REF ldpm_tia_1_extd /end AXIS_DESCR
/end CHARACTERISTIC
/begin AXIS_PTS ldpm_tco_st_1_extd "" 0xa0809808 tco_st _REC_AXS_20_u1 190.5 _CNV_A_R_LINEAR_____17_CM 8 -48. 142.5 FORMAT "%6.2" /end AXIS_PTS
/begin AXIS_PTS ldpm_tia_1_extd "" 0xa0809842 tia _REC_AXS_20_u1 190.5 _CNV_A_R_LINEAR_____17_CM 6 -48. 142.5 FORMAT "%6.2" /end AXIS_PTS
/begin CHARACTERISTIC ip_int_teg "weighting factor for the consideration of the ignition angle and MAF_KGH influence for dew point determination" MAP 0xa080ad58 _REC_MAP_20_u1_u2_u2 15.9375 _CNV_A_R_EVAC_LINEA_298_CM 0. 15.9375 DISPLAY_IDENTIFIER IP_INT_TEG FORMAT "%5.2"
 /begin AXIS_DESCR COM_AXIS eff_iga_av _CNV_A_R_LINEAR_____9_CM 6 0. 1.99996948242188 FORMAT "%7.5" AXIS_PTS_REF ldp_eff_iga_av__int_teg /end AXIS_DESCR
 /begin AXIS_DESCR COM_AXIS maf_kgh _CNV_A_R_LINEAR_____215_CM 6 0. 2047.96875 FORMAT "%7.2" AXIS_PTS_REF ldp_maf_kgh__int_teg /end AXIS_DESCR
/end CHARACTERISTIC
/begin AXIS_PTS ldp_eff_iga_av__int_teg "" 0xa080858c eff_iga_av _REC_AXS_20_u2 1.99996948242188 _CNV_A_R_LINEAR_____9_CM 6 0. 1.99996948242188 FORMAT "%7.5" /end AXIS_PTS
/begin AXIS_PTS ldp_maf_kgh__int_teg "" 0xa0808860 maf_kgh _REC_AXS_20_u2 2047.96875 _CNV_A_R_LINEAR_____215_CM 6 0. 2047.96875 FORMAT "%7.2" /end AXIS_PTS
/begin MEASUREMENT temp_cat_dyn_mdl[0] "modeled catalyst monolith temperature (bank selective)" UWORD _CNV_A_R_LINEAR_____214_CM 1 100. -273.15 1774.7875 DISPLAY_IDENTIFIER TEMP_CAT_DYN_MDL[1] ECU_ADDRESS 0xd000a2a6 FORMAT "%9.4" /end MEASUREMENT
/begin MEASUREMENT temp_cat_dyn_mdl[1] "modeled catalyst monolith temperature (bank selective)" UWORD _CNV_A_R_LINEAR_____214_CM 1 100. -273.15 1774.7875 DISPLAY_IDENTIFIER TEMP_CAT_DYN_MDL[2] ECU_ADDRESS 0xd000a2a8 FORMAT "%9.4" /end MEASUREMENT
/begin MEASUREMENT tnt_mdl_mv "Mean value of the two modelled NOx catalyst monolith temperatures" UWORD _CNV_A_R_LINEAR_____209_CM 1 100. 0. 1023.984375 DISPLAY_IDENTIFIER TNT_MDL_MV ECU_ADDRESS 0xd000a2b4 FORMAT "%7.2" /end MEASUREMENT
/begin MEASUREMENT tnt_mdl_h "Maximum of modelled NOx catalyst monolith temperatures" UWORD _CNV_A_R_LINEAR_____209_CM 1 100. 0. 1023.984375 DISPLAY_IDENTIFIER TNT_MDL_H ECU_ADDRESS 0xd000a2b6 FORMAT "%7.2" /end MEASUREMENT
/begin MEASUREMENT tnt_mdl_h_1 "Maximum of modelled NOx catalyst monolith temperatures (bank selective)" UWORD _CNV_A_R_LINEAR_____209_CM 1 100. 0. 1023.984375 DISPLAY_IDENTIFIER TNT_MDL_H_1 ECU_ADDRESS 0xd000a2b8 FORMAT "%7.2" /end MEASUREMENT
/begin MEASUREMENT tnt_mdl_h_2 "Maximum of modelled NOx catalyst monolith temperatures (bank selective)" UWORD _CNV_A_R_LINEAR_____209_CM 1 100. 0. 1023.984375 DISPLAY_IDENTIFIER TNT_MDL_H_2 ECU_ADDRESS 0xd000a2c6 FORMAT "%7.2" /end MEASUREMENT
/begin MEASUREMENT tnt_mdl_l "Minimum of modelled NOx catalyst monolith temperatures" UWORD _CNV_A_R_LINEAR_____209_CM 1 100. 0. 1023.984375 DISPLAY_IDENTIFIER TNT_MDL_L ECU_ADDRESS 0xd000a2ba FORMAT "%7.2" /end MEASUREMENT
/begin MEASUREMENT tnt_mdl_max_avl "Maximum attainable monolith temp. for active Nox cat. desulfation" UWORD _CNV_A_R_LINEAR_____209_CM 1 100. 0. 1023.984375 DISPLAY_IDENTIFIER TNT_MDL_MAX_AVL ECU_ADDRESS 0xd000a2aa FORMAT "%7.2" /end MEASUREMENT
/begin MEASUREMENT temp_cat_stat_mdl[0] "Modelled catalyst temperature under static conditions" UWORD _CNV_A_R_LINEAR_____214_CM 1 100. -273.15 1774.7875 DISPLAY_IDENTIFIER TEMP_CAT_STAT_MDL[1] ECU_ADDRESS 0xd000a2c0 FORMAT "%9.4" /end MEASUREMENT
/begin MEASUREMENT temp_cat_stat_mdl[1] "Modelled catalyst temperature under static conditions" UWORD _CNV_A_R_LINEAR_____214_CM 1 100. -273.15 1774.7875 DISPLAY_IDENTIFIER TEMP_CAT_STAT_MDL[2] ECU_ADDRESS 0xd000a2c2 FORMAT "%9.4" /end MEASUREMENT
/begin MEASUREMENT tnt_mdl_mv_sng[0] "MMean value of the two modelled NOx catalyst monolith temperatures for exhaust branch 1" UWORD _CNV_A_R_LINEAR_____209_CM 1 100. 0. 1023.984375 DISPLAY_IDENTIFIER TNT_MDL_MV_SNG[0] ECU_ADDRESS 0xd000a2bc FORMAT "%7.2" /end MEASUREMENT
/begin MEASUREMENT tnt_mdl_mv_sng[1] "MMean value of the two modelled NOx catalyst monolith temperatures for exhaust branch 1" UWORD _CNV_A_R_LINEAR_____209_CM 1 100. 0. 1023.984375 DISPLAY_IDENTIFIER TNT_MDL_MV_SNG[1] ECU_ADDRESS 0xd000a2be FORMAT "%7.2" /end MEASUREMENT
/begin MEASUREMENT tnt_mdl_1[0] "Modelled NOx catalyst temperature of the first monolith" UWORD _CNV_A_R_LINEAR_____209_CM 1 100. 0. 1023.984375 DISPLAY_IDENTIFIER TNT_MDL_1[0] ECU_ADDRESS 0xd000a2ac FORMAT "%7.2" /end MEASUREMENT
/begin MEASUREMENT tnt_mdl_1[1] "Modelled NOx catalyst temperature of the first monolith" UWORD _CNV_A_R_LINEAR_____209_CM 1 100. 0. 1023.984375 DISPLAY_IDENTIFIER TNT_MDL_1[1] ECU_ADDRESS 0xd000a2ae FORMAT "%7.2" /end MEASUREMENT
/begin MEASUREMENT tnt_mdl_2[0] "Modelled NOx catalyst temperature of the second monolith" UWORD _CNV_A_R_LINEAR_____209_CM 1 100. 0. 1023.984375 DISPLAY_IDENTIFIER TNT_MDL_2[0] ECU_ADDRESS 0xd000a2b0 FORMAT "%7.2" /end MEASUREMENT
/begin MEASUREMENT tnt_mdl_2[1] "Modelled NOx catalyst temperature of the second monolith" UWORD _CNV_A_R_LINEAR_____209_CM 1 100. 0. 1023.984375 DISPLAY_IDENTIFIER TNT_MDL_2[1] ECU_ADDRESS 0xd000a2b2 FORMAT "%7.2" /end MEASUREMENT
/begin MEASUREMENT t_mff_ad_min "Time indicating the minimum time for next requested lambda adaptation" UWORD _CNV_A_R_LINEAR_____4_CM 1 100. 0. 6553.5 DISPLAY_IDENTIFIER T_MFF_AD_MIN ECU_ADDRESS 0xd000a250 FORMAT "%6.1" /end MEASUREMENT
/begin CHARACTERISTIC c_delta_lamb_afr_so2p "delta lambda value for rich phase of desufation" VALUE 0xa0807ef6 _REC_VAL_20_s2 0.249996185302734 _CNV_A_R_LACO_LINEA_374_CM -0.125 0.124996185302734 DISPLAY_IDENTIFIER C_DELTA_LAMB_AFR_SO2P FORMAT "%9.6" /end CHARACTERISTIC
/begin CHARACTERISTIC c_delta_lamb_afl_so2p "delta lambda value for lean phase of desufation" VALUE 0xa0807ef4 _REC_VAL_20_s2 0.249996185302734 _CNV_A_R_LACO_LINEA_374_CM -0.125 0.124996185302734 DISPLAY_IDENTIFIER C_DELTA_LAMB_AFL_SO2P FORMAT "%9.6" /end CHARACTERISTIC
/begin CHARACTERISTIC c_delta_lamb_sp_so2p "permissible deviation of the lambda controller setpoint for desulfation with lambda alternation" VALUE 0xa0807ef8 _REC_VAL_20_u2 2. _CNV_A_R_LINEAR_____129_CM 0. 2. DISPLAY_IDENTIFIER C_DELTA_LAMB_SP_SO2P FORMAT "%6.4" /end CHARACTERISTIC
/begin AXIS_PTS ldpm_n_32_1_lamb_puls_so2p "" 0xa0807bc4 n_32 _REC_AXS_20_u1 8160. _CNV_A_R_LINEAR_____10_CM 8 0. 8160. FORMAT "%4.0" /end AXIS_PTS
/begin AXIS_PTS ldpm_maf_1_lamb_puls_so2p "" 0xa0807b68 maf _REC_AXS_20_u2 1389. _CNV_A_R_LINEAR_____111_CM 8 0. 1389. FORMAT "%7.2" /end AXIS_PTS
/begin CHARACTERISTIC ip_lam_so2p_pos_i "basic value of LAMB_PULS_SO2P integral component when lambda > 1" MAP 0xa0807cc0 _REC_MAP_20_u1_u1_u2 0.12402344 _CNV_A_R_NOXM_LINEA_928_CM 0. 0.12402344 DISPLAY_IDENTIFIER IP_LAM_SO2P_POS_I FORMAT "%6.4"
 /begin AXIS_DESCR COM_AXIS n_32 _CNV_A_R_LINEAR_____10_CM 8 0. 8160. FORMAT "%4.0" AXIS_PTS_REF ldpm_n_32_1_lamb_puls_so2p /end AXIS_DESCR
 /begin AXIS_DESCR COM_AXIS maf _CNV_A_R_LINEAR_____111_CM 8 0. 1389. FORMAT "%7.2" AXIS_PTS_REF ldpm_maf_1_lamb_puls_so2p /end AXIS_DESCR
/end CHARACTERISTIC
/begin CHARACTERISTIC ip_lam_so2p_neg_i "basic value of LAMB_PULS_SO2P integral component when lambda < 1" MAP 0xa0807c80 _REC_MAP_20_u1_u1_u2 0.12402344 _CNV_A_R_NOXM_LINEA_928_CM 0. 0.12402344 DISPLAY_IDENTIFIER IP_LAM_SO2P_NEG_I FORMAT "%6.4"
 /begin AXIS_DESCR COM_AXIS n_32 _CNV_A_R_LINEAR_____10_CM 8 0. 8160. FORMAT "%4.0" AXIS_PTS_REF ldpm_n_32_1_lamb_puls_so2p /end AXIS_DESCR
 /begin AXIS_DESCR COM_AXIS maf _CNV_A_R_LINEAR_____111_CM 8 0. 1389. FORMAT "%7.2" AXIS_PTS_REF ldpm_maf_1_lamb_puls_so2p /end AXIS_DESCR
/end CHARACTERISTIC
/begin CHARACTERISTIC c_vls_down_afl "threshold for detection of lean mixture at LS downstream position" VALUE 0xa0807f5a _REC_VAL_20_u2 4.9951171875 _CNV_A_R_LINEAR_____2_CM 0. 4.9951171875 DISPLAY_IDENTIFIER C_VLS_DOWN_AFL FORMAT "%5.3" /end CHARACTERISTIC
/begin CHARACTERISTIC c_t_vls_down_cyc_afl_max "maximum lean mixture cycle time at LS downstream position" VALUE 0xa0807f44 _REC_VAL_20_u2 1310.7 _CNV_A_R_LINEAR_____110_CM 0. 1310.7 DISPLAY_IDENTIFIER C_T_VLS_DOWN_CYC_AFL_MAX FORMAT "%7.2" /end CHARACTERISTIC
/begin CHARACTERISTIC c_t_vls_down_cyc_afr_max "maximum rich mixture cycle time at LS downstream position" VALUE 0xa0807f46 _REC_VAL_20_u2 1310.7 _CNV_A_R_LINEAR_____110_CM 0. 1310.7 DISPLAY_IDENTIFIER C_T_VLS_DOWN_CYC_AFR_MAX FORMAT "%7.2" /end CHARACTERISTIC
/begin AXIS_PTS ldpm_n_32_1_lamb_puls_ref "" 0xa0807bb8 n_32 _REC_AXS_20_u1 8160. _CNV_A_R_LINEAR_____10_CM 8 0. 8160. FORMAT "%4.0" /end AXIS_PTS
/begin AXIS_PTS ldpm_maf_2_lamb_puls_ref "" 0xa0807b7c maf _REC_AXS_20_u2 1389. _CNV_A_R_LINEAR_____111_CM 8 0. 1389. FORMAT "%7.2" /end AXIS_PTS
/begin CHARACTERISTIC ip_t_afl_down_lock_afl "LV_AFL transition lock-out time after transition of AF mixture to lean at LS downstream position" MAP 0xa081347c _REC_MAP_20_u2_u1_u2 1310.7 _CNV_A_R_LINEAR_____110_CM 0. 1310.7 DISPLAY_IDENTIFIER IP_T_AFL_DOWN_LOCK_AFL FORMAT "%7.2"
 /begin AXIS_DESCR COM_AXIS n_32 _CNV_A_R_LINEAR_____10_CM 8 0. 8160. FORMAT "%4.0" AXIS_PTS_REF ldpm_n_32_1_lamb_puls_ref /end AXIS_DESCR
 /begin AXIS_DESCR COM_AXIS maf _CNV_A_R_LINEAR_____111_CM 8 0. 1389. FORMAT "%7.2" AXIS_PTS_REF ldpm_maf_2_lamb_puls_ref /end AXIS_DESCR
/end CHARACTERISTIC
/begin CHARACTERISTIC ip_t_afl_down_lock_afr "LV_AFL transition lock-out time after transition of AF mixture to rich at LS downstream position" MAP 0xa08134fc _REC_MAP_20_u2_u1_u2 1310.7 _CNV_A_R_LINEAR_____110_CM 0. 1310.7 DISPLAY_IDENTIFIER IP_T_AFL_DOWN_LOCK_AFR FORMAT "%7.2"
 /begin AXIS_DESCR COM_AXIS n_32 _CNV_A_R_LINEAR_____10_CM 8 0. 8160. FORMAT "%4.0" AXIS_PTS_REF ldpm_n_32_1_lamb_puls_ref /end AXIS_DESCR
 /begin AXIS_DESCR COM_AXIS maf _CNV_A_R_LINEAR_____111_CM 8 0. 1389. FORMAT "%7.2" AXIS_PTS_REF ldpm_maf_2_lamb_puls_ref /end AXIS_DESCR
/end CHARACTERISTIC
/begin MEASUREMENT ctr_vls_down_afl_cyc[0] "denotes number of AF cycles since lambda contoller last activated at LS downstream position" UWORD _CNV_A_R_LINEAR_____0_CM 1 100. 0. 65535. DISPLAY_IDENTIFIER CTR_VLS_DOWN_AFL_CYC[1] ECU_ADDRESS 0xd0003682 FORMAT "%5.0" /end MEASUREMENT
/begin MEASUREMENT ctr_vls_down_afl_cyc[1] "denotes number of AF cycles since lambda contoller last activated at LS downstream position" UWORD _CNV_A_R_LINEAR_____0_CM 1 100. 0. 65535. DISPLAY_IDENTIFIER CTR_VLS_DOWN_AFL_CYC[2] ECU_ADDRESS 0xd0003684 FORMAT "%5.0" /end MEASUREMENT
/begin MEASUREMENT t_lam_dly_so2p[0] "total LAM P-jump delay time for transition due to desufation lambda alternation" UWORD _CNV_A_R_LINEAR_____110_CM 1 100. 0. 1310.7 DISPLAY_IDENTIFIER T_LAM_DLY_SO2P[1] ECU_ADDRESS 0xd00036b4 FORMAT "%7.2" /end MEASUREMENT
/begin MEASUREMENT t_lam_dly_so2p[1] "total LAM P-jump delay time for transition due to desufation lambda alternation" UWORD _CNV_A_R_LINEAR_____110_CM 1 100. 0. 1310.7 DISPLAY_IDENTIFIER T_LAM_DLY_SO2P[2] ECU_ADDRESS 0xd00036b6 FORMAT "%7.2" /end MEASUREMENT
/begin MEASUREMENT t_vls_down_cyc_afl[0] "lean mixture cycle time at LS downstream position" UWORD _CNV_A_R_LINEAR_____110_CM 1 100. 0. 1310.7 DISPLAY_IDENTIFIER T_VLS_DOWN_CYC_AFL[1] ECU_ADDRESS 0xd00036b8 FORMAT "%7.2" /end MEASUREMENT
/begin MEASUREMENT t_vls_down_cyc_afl[1] "lean mixture cycle time at LS downstream position" UWORD _CNV_A_R_LINEAR_____110_CM 1 100. 0. 1310.7 DISPLAY_IDENTIFIER T_VLS_DOWN_CYC_AFL[2] ECU_ADDRESS 0xd00036ba FORMAT "%7.2" /end MEASUREMENT
/begin MEASUREMENT vls_down_ref[0] "voltage signal observed for downstream AF cycle evaluation" UWORD _CNV_A_R_LINEAR_____2_CM 1 100. 0. 4.9951171875 DISPLAY_IDENTIFIER VLS_DOWN_REF[1] ECU_ADDRESS 0xd00036c4 FORMAT "%5.3" /end MEASUREMENT
/begin MEASUREMENT vls_down_ref[1] "voltage signal observed for downstream AF cycle evaluation" UWORD _CNV_A_R_LINEAR_____2_CM 1 100. 0. 4.9951171875 DISPLAY_IDENTIFIER VLS_DOWN_REF[2] ECU_ADDRESS 0xd00036c6 FORMAT "%5.3" /end MEASUREMENT
/begin MEASUREMENT lamb_puls_so2p_h_res[0] "delta lambda with high resolution" SWORD _CNV_A_R_LACO_LINEA_374_CM 1 100. -0.125 0.124996185302734 DISPLAY_IDENTIFIER LAMB_PULS_SO2P_H_RES[1] ECU_ADDRESS 0xd0003688 FORMAT "%9.6" /end MEASUREMENT
/begin MEASUREMENT lamb_puls_so2p_h_res[1] "delta lambda with high resolution" SWORD _CNV_A_R_LACO_LINEA_374_CM 1 100. -0.125 0.124996185302734 DISPLAY_IDENTIFIER LAMB_PULS_SO2P_H_RES[2] ECU_ADDRESS 0xd000368a FORMAT "%9.6" /end MEASUREMENT
/begin MEASUREMENT lv_vls_down_afl[0] "Monitoring sensor has detected \"lean\"" UBYTE _CNV_S_2_RANGE__0___1_CM 1 100. 0. 1. DISPLAY_IDENTIFIER LV_VLS_DOWN_AFL[1] ECU_ADDRESS 0xd00036f0 BIT_MASK 0x1 /end MEASUREMENT
/begin MEASUREMENT lv_vls_down_afl[1] "Monitoring sensor has detected \"lean\"" UBYTE _CNV_S_2_RANGE__0___1_CM 1 100. 0. 1. DISPLAY_IDENTIFIER LV_VLS_DOWN_AFL[2] ECU_ADDRESS 0xd00036f1 BIT_MASK 0x1 /end MEASUREMENT
/begin MEASUREMENT lv_vls_down_tra[0] "Transition of Air-Fuel mixture by downstream sensor" UBYTE _CNV_S_2_RANGE__0___1_CM 1 100. 0. 1. DISPLAY_IDENTIFIER LV_VLS_DOWN_TRA[1] ECU_ADDRESS 0xd00036f2 BIT_MASK 0x1 /end MEASUREMENT
/begin MEASUREMENT lv_vls_down_tra[1] "Transition of Air-Fuel mixture by downstream sensor" UBYTE _CNV_S_2_RANGE__0___1_CM 1 100. 0. 1. DISPLAY_IDENTIFIER LV_VLS_DOWN_TRA[2] ECU_ADDRESS 0xd00036f3 BIT_MASK 0x1 /end MEASUREMENT
/begin MEASUREMENT lv_so2p_afr[0] "rich phase of alternation" UBYTE _CNV_S_2_RANGE__0___1_CM 1 100. 0. 1. DISPLAY_IDENTIFIER LV_SO2P_AFR[1] ECU_ADDRESS 0xd000774e BIT_MASK 0x1 /end MEASUREMENT
/begin MEASUREMENT lv_so2p_afr[1] "rich phase of alternation" UBYTE _CNV_S_2_RANGE__0___1_CM 1 100. 0. 1. DISPLAY_IDENTIFIER LV_SO2P_AFR[2] ECU_ADDRESS 0xd000774f BIT_MASK 0x1 /end MEASUREMENT
/begin CHARACTERISTIC c_lamb_sp_so2p "Basis lambda setpoint for calculation of activation condition for desulfation" VALUE 0xa0807f04 _REC_VAL_20_u2 31.9990234375 _CNV_A_R_LINEAR_____129_CM 0. 31.9990234375 DISPLAY_IDENTIFIER C_LAMB_SP_SO2P FORMAT "%7.4" /end CHARACTERISTIC
/begin CHARACTERISTIC lc_t_afl_down_ctl "consider time thresholds for switching lean to rich or rich to lean" VALUE 0xa0807f7c _REC_VAL_20_u1 1. _CNV_A_R_LINEAR_____0_CM 0. 1. DISPLAY_IDENTIFIER LC_T_AFL_DOWN_CTL FORMAT "%1.0" /end CHARACTERISTIC
/begin CHARACTERISTIC c_lam_so2p_neg_p "Basis value of LAMB_PULS_SO2P proportional component during transition from lambda > 1 to lambda < 1" VALUE 0xa0807efb _REC_VAL_20_u1 1. _CNV_A_R_NOXM_LINEA_928_CM 0. 1. DISPLAY_IDENTIFIER C_LAM_SO2P_NEG_P FORMAT "%6.4" /end CHARACTERISTIC
/begin CHARACTERISTIC c_lam_so2p_pos_p "Basis value of LAMB_PULS_SO2P proportional component during transition from lambda < 1 to lambda > 1" VALUE 0xa0807efc _REC_VAL_20_u1 1. _CNV_A_R_NOXM_LINEA_928_CM 0. 1. DISPLAY_IDENTIFIER C_LAM_SO2P_POS_P FORMAT "%6.4" /end CHARACTERISTIC
/begin CHARACTERISTIC c_vls_down_afr "threshold for detection of rich mixture at LS downstream position" VALUE 0xa0807f5c _REC_VAL_20_u2 4.9951171875 _CNV_A_R_LINEAR_____2_CM 0. 4.9951171875 DISPLAY_IDENTIFIER C_VLS_DOWN_AFR FORMAT "%5.3" /end CHARACTERISTIC
/begin CHARACTERISTIC ip_vls_ref_lamb_ls_up "Reference map for upstream lambda to binary labda value" CURVE 0xa0807ea8 _REC_CUR_20_u2_u2 4.9951171875 _CNV_A_R_LINEAR_____2_CM 0. 4.9951171875 DISPLAY_IDENTIFIER IP_VLS_REF_LAMB_LS_UP FORMAT "%5.3"
 /begin AXIS_DESCR COM_AXIS egcp[0].egcp_struct_adcprlsl1.lamb_ls_up _CNV_A_R_LINEAR_____129_CM 8 0. 31.9990234375 FORMAT "%7.4" AXIS_PTS_REF ldp_lamb_ls_up_ip_vls_ref /end AXIS_DESCR
/end CHARACTERISTIC
/begin CHARACTERISTIC ip_vls_ref_lamb_ns "Scaling map for sensor on the first position from NOx Sensor lambda signal to VLS signal" CURVE 0xa0807eb8 _REC_CUR_20_u2_u2 4.9951171875 _CNV_A_R_LINEAR_____2_CM 0. 4.9951171875 DISPLAY_IDENTIFIER IP_VLS_REF_LAMB_NS FORMAT "%5.3"
 /begin AXIS_DESCR COM_AXIS NO_INPUT_QUANTITY _CNV_A_R_LINEAR_____129_CM 8 0. 31.9990234375 FORMAT "%7.4" AXIS_PTS_REF ldp_lamb_ns_ip_vls_ref_lamb_ns /end AXIS_DESCR
/end CHARACTERISTIC
/begin AXIS_PTS ldp_lamb_ls_up_ip_vls_ref "" 0xa0807a88 egcp[0].egcp_struct_adcprlsl1.lamb_ls_up _REC_AXS_20_u2 31.9990234375 _CNV_A_R_LINEAR_____129_CM 8 0. 31.9990234375 FORMAT "%7.4" /end AXIS_PTS
/begin AXIS_PTS ldp_lamb_ns_ip_vls_ref_lamb_ns "" 0xa0807a9c NO_INPUT_QUANTITY _REC_AXS_20_u2 31.9990234375 _CNV_A_R_LINEAR_____129_CM 8 0. 31.9990234375 FORMAT "%7.4" /end AXIS_PTS
/begin CHARACTERISTIC c_vls_ref_so2p_lamb_sp "Reference signal manual value" VALUE 0xa0807f60 _REC_VAL_20_u2 4.9951171875 _CNV_A_R_LINEAR_____2_CM 0. 4.9951171875 DISPLAY_IDENTIFIER C_VLS_REF_SO2P_LAMB_SP FORMAT "%5.3" /end CHARACTERISTIC
/begin CHARACTERISTIC ip_t_lam_dly_so2p_neg "Basic Lam-P-jump delay time from rich to lean transition" MAP 0xa081357c _REC_MAP_20_u2_u1_u2 1310.7 _CNV_A_R_LINEAR_____110_CM 0. 1310.7 DISPLAY_IDENTIFIER IP_T_LAM_DLY_SO2P_NEG FORMAT "%7.2"
 /begin AXIS_DESCR COM_AXIS n_32 _CNV_A_R_LINEAR_____10_CM 8 0. 8160. FORMAT "%4.0" AXIS_PTS_REF ldpm_n_32_1_lamb_puls_so2p /end AXIS_DESCR
 /begin AXIS_DESCR COM_AXIS maf _CNV_A_R_LINEAR_____111_CM 8 0. 1389. FORMAT "%7.2" AXIS_PTS_REF ldpm_maf_1_lamb_puls_so2p /end AXIS_DESCR
/end CHARACTERISTIC
/begin CHARACTERISTIC ip_t_lam_dly_so2p_pos "Basic Lam-P-jump delay time from lean to rich transition" MAP 0xa08135fc _REC_MAP_20_u2_u1_u2 1310.7 _CNV_A_R_LINEAR_____110_CM 0. 1310.7 DISPLAY_IDENTIFIER IP_T_LAM_DLY_SO2P_POS FORMAT "%7.2"
 /begin AXIS_DESCR COM_AXIS n_32 _CNV_A_R_LINEAR_____10_CM 8 0. 8160. FORMAT "%4.0" AXIS_PTS_REF ldpm_n_32_1_lamb_puls_so2p /end AXIS_DESCR
 /begin AXIS_DESCR COM_AXIS maf _CNV_A_R_LINEAR_____111_CM 8 0. 1389. FORMAT "%7.2" AXIS_PTS_REF ldpm_maf_1_lamb_puls_so2p /end AXIS_DESCR
/end CHARACTERISTIC
/begin CHARACTERISTIC ip_vls_ref_vls_ns "scaling map sensor from NOx sensor binary signal to VLS" CURVE 0xa0807ec8 _REC_CUR_20_u2_u2 4.9951171875 _CNV_A_R_LINEAR_____2_CM 0. 4.9951171875 DISPLAY_IDENTIFIER IP_VLS_REF_VLS_NS FORMAT "%5.3"
 /begin AXIS_DESCR COM_AXIS NO_INPUT_QUANTITY _CNV_A_R_LINEAR_____219_CM 8 -200. 1200. FORMAT "%4.0" AXIS_PTS_REF ldp_vls_ns_ip_vls_ref_vls_ns /end AXIS_DESCR
/end CHARACTERISTIC
/begin AXIS_PTS ldp_vls_ns_ip_vls_ref_vls_ns "" 0xa0807b30 NO_INPUT_QUANTITY _REC_AXS_20_u2 1400. _CNV_A_R_LINEAR_____219_CM 8 -200. 1200. FORMAT "%4.0" /end AXIS_PTS
/begin MEASUREMENT lamb_puls_so2p[0] "Delta lambda to pass to the lambda stimulation coordination routine" SBYTE _CNV_A_R_LINEAR_____129_CM 1 100. -0.125 0.1240234375 DISPLAY_IDENTIFIER LAMB_PULS_SO2P[1] ECU_ADDRESS 0xd0007732 FORMAT "%7.4" /end MEASUREMENT
/begin MEASUREMENT lamb_puls_so2p[1] "Delta lambda to pass to the lambda stimulation coordination routine" SBYTE _CNV_A_R_LINEAR_____129_CM 1 100. -0.125 0.1240234375 DISPLAY_IDENTIFIER LAMB_PULS_SO2P[2] ECU_ADDRESS 0xd0007733 FORMAT "%7.4" /end MEASUREMENT
/begin CHARACTERISTIC c_state_vls_sens_ref[0] "mode to determine the sensor signal in the frist sensor position" VALUE 0xa0807f3a _REC_VAL_20_u1 5. _CNV_S_6_NOXM_STATE_929_CM 0. 5. DISPLAY_IDENTIFIER C_STATE_SENS_VLS_DOWN_REF[1] /end CHARACTERISTIC
/begin CHARACTERISTIC c_state_vls_sens_ref[1] "mode to determine the sensor signal in the frist sensor position" VALUE 0xa0807f3b _REC_VAL_20_u1 5. _CNV_S_6_NOXM_STATE_929_CM 0. 5. DISPLAY_IDENTIFIER C_STATE_SENS_VLS_DOWN_REF[2] /end CHARACTERISTIC
/begin COMPU_METHOD _CNV_A_R_LINEAR_____0_CM "" RAT_FUNC "%6.3" "-" COEFFS 0 1. 0. 0 0 1 /end COMPU_METHOD
/begin COMPU_METHOD _CNV_S_2_RANGE__0___1_CM "" TAB_VERB "%6.3" "-" COMPU_TAB_REF _CNV_S_2_RANGE__0___1 /end COMPU_METHOD
/begin COMPU_VTAB _CNV_S_2_RANGE__0___1 "" TAB_VERB 2 0 "0" 1 "1" /end COMPU_VTAB
/begin COMPU_METHOD _CNV_A_R_LINEAR_____2_CM "" RAT_FUNC "%6.3" "V" COEFFS 0 204.8 0. 0 0 1 /end COMPU_METHOD
/begin COMPU_METHOD _CNV_A_R_LINEAR_____3_CM "" RAT_FUNC "%6.3" "s" COEFFS 0 100. 0. 0 0 1 /end COMPU_METHOD
/begin COMPU_METHOD _CNV_A_R_LINEAR_____4_CM "" RAT_FUNC "%6.3" "s" COEFFS 0 10. 0. 0 0 1 /end COMPU_METHOD
/begin COMPU_METHOD _CNV_A_R_LINEAR_____6_CM "" RAT_FUNC "%6.3" "km/h" COEFFS 0 1. 0. 0 0 1 /end COMPU_METHOD
/begin COMPU_METHOD _CNV_A_R_LINEAR_____8_CM "" RAT_FUNC "%6.3" "%" COEFFS 0 655.3599999999997 0. 0 0 1 /end COMPU_METHOD
/begin COMPU_METHOD _CNV_A_R_LINEAR_____9_CM "" RAT_FUNC "%6.3" "-" COEFFS 0 32767.99999999992 0. 0 0 1 /end COMPU_METHOD
/begin COMPU_METHOD _CNV_A_R_LINEAR_____10_CM "" RAT_FUNC "%6.3" "rpm" COEFFS 0 3.125e-002 0. 0 0 1 /end COMPU_METHOD
/begin COMPU_METHOD _CNV_A_R_LINEAR_____14_CM "" RAT_FUNC "%6.3" "rpm" COEFFS 0 1. 0. 0 0 1 /end COMPU_METHOD
/begin COMPU_METHOD _CNV_A_R_LINEAR_____17_CM "" RAT_FUNC "%6.3" "°C" COEFFS 0 1.333333333333333 64. 0 0 1 /end COMPU_METHOD
/begin COMPU_METHOD _CNV_A_R_LINEAR_____18_CM "" RAT_FUNC "%6.3" "-" COEFFS 0 255.9983911655618 0. 0 0 1 /end COMPU_METHOD
/begin COMPU_METHOD _CNV_A_R_LINEAR_____28_CM "" RAT_FUNC "%6.3" "-" COEFFS 0 256. 0. 0 0 1 /end COMPU_METHOD
/begin COMPU_METHOD _CNV_A_R_LINEAR_____30_CM "" RAT_FUNC "%6.3" "rpm/s" COEFFS 0 3.125e-002 0. 0 0 1 /end COMPU_METHOD
/begin COMPU_METHOD _CNV_A_R_LINEAR_____31_CM "" RAT_FUNC "%6.3" "Nm" COEFFS 0 32. 0. 0 0 1 /end COMPU_METHOD
/begin COMPU_METHOD _CNV_S_2_RANGE______76_CM "" TAB_VERB "%6.3" "" COMPU_TAB_REF _CNV_S_2_RANGE______76 /end COMPU_METHOD
/begin COMPU_VTAB _CNV_S_2_RANGE______76 "" TAB_VERB 2 0 "0" 1 "1" /end COMPU_VTAB
/begin COMPU_METHOD _CNV_A_R_LINEAR_____84_CM "" RAT_FUNC "%6.3" "min" COEFFS 0 1. 0. 0 0 1 /end COMPU_METHOD
/begin COMPU_METHOD _CNV_A_R_LINEAR_____89_CM "" RAT_FUNC "%6.3" "-" COEFFS 0 65535.99999999996 0. 0 0 1 /end COMPU_METHOD
/begin COMPU_METHOD _CNV_A_R_LINEAR_____100_CM "" RAT_FUNC "%6.3" "-" COEFFS 0 127.9991955827809 0. 0 0 1 /end COMPU_METHOD
/begin COMPU_METHOD _CNV_A_R_LINEAR_____103_CM "" RAT_FUNC "%6.3" "-" COEFFS 0 128. 0. 0 0 1 /end COMPU_METHOD
/begin COMPU_METHOD _CNV_A_R_LINEAR_____110_CM "" RAT_FUNC "%6.3" "s" COEFFS 0 50. 0. 0 0 1 /end COMPU_METHOD
/begin COMPU_METHOD _CNV_A_R_LINEAR_____111_CM "" RAT_FUNC "%6.3" "mg/stk" COEFFS 0 47.18142548596112 0. 0 0 1 /end COMPU_METHOD
/begin COMPU_METHOD _CNV_A_R_LINEAR_____113_CM "" RAT_FUNC "%6.3" "%" COEFFS 0 655.3599999999997 -1.455191522836685e-011 0 0 1 /end COMPU_METHOD
/begin COMPU_METHOD _CNV_A_R_LINEAR_____129_CM "" RAT_FUNC "%6.3" "-" COEFFS 0 1024. 0. 0 0 1 /end COMPU_METHOD
/begin COMPU_METHOD _CNV_A_R_LINEAR_____193_CM "" RAT_FUNC "%6.3" "rpm" COEFFS 0 1. 32768. 0 0 1 /end COMPU_METHOD
/begin COMPU_METHOD _CNV_A_R_LINEAR_____209_CM "" RAT_FUNC "%6.3" "°C" COEFFS 0 64. 0. 0 0 1 /end COMPU_METHOD
/begin COMPU_METHOD _CNV_A_R_LINEAR_____210_CM "" RAT_FUNC "%6.3" "g" COEFFS 0 36.00036915004301 0. 0 0 1 /end COMPU_METHOD
/begin COMPU_METHOD _CNV_A_R_LINEAR_____211_CM "" RAT_FUNC "%6.3" "-" COEFFS 0 32768.00003968061 3.96806062781252e-005 0 0 1 /end COMPU_METHOD
/begin COMPU_METHOD _CNV_A_R_LINEAR_____214_CM "" RAT_FUNC "%6.3" "°C" COEFFS 0 16. 4370.4 0 0 1 /end COMPU_METHOD
/begin COMPU_METHOD _CNV_A_R_LINEAR_____215_CM "" RAT_FUNC "%6.3" "kg/h" COEFFS 0 32. 0. 0 0 1 /end COMPU_METHOD
/begin COMPU_METHOD _CNV_S_4_RANGE_C_ST_216_CM "" TAB_VERB "%6.3" "-" COMPU_TAB_REF _CNV_S_4_RANGE_C_ST_216 /end COMPU_METHOD
/begin COMPU_VTAB _CNV_S_4_RANGE_C_ST_216 "" TAB_VERB 4 0 "NONE" 1 "VLS" 2 "T_RGN" 3 "T_RGN_2" /end COMPU_VTAB
/begin COMPU_METHOD _CNV_S_4_RANGE_C_ST_217_CM "" TAB_VERB "%6.3" "-" COMPU_TAB_REF _CNV_S_4_RANGE_C_ST_217 /end COMPU_METHOD
/begin COMPU_VTAB _CNV_S_4_RANGE_C_ST_217 "" TAB_VERB 4 0 "NONE" 1 "VLS_MAF" 2 "T_RGN" 3 "T_RGN_2" /end COMPU_VTAB
/begin COMPU_METHOD _CNV_S_3_RANGE_C_ST_218_CM "" TAB_VERB "%6.3" "-" COMPU_TAB_REF _CNV_S_3_RANGE_C_ST_218 /end COMPU_METHOD
/begin COMPU_VTAB _CNV_S_3_RANGE_C_ST_218 "" TAB_VERB 3 0 "NONE" 1 "IP" 2 "CLC" /end COMPU_VTAB
/begin COMPU_METHOD _CNV_A_R_LINEAR_____219_CM "" RAT_FUNC "%6.3" "mV" COEFFS 0 1. 200. 0 0 1 /end COMPU_METHOD
/begin COMPU_METHOD _CNV_S_4_STATE_RGN__220_CM "" TAB_VERB "%6.3" "-" COMPU_TAB_REF _CNV_S_4_STATE_RGN__220 /end COMPU_METHOD
/begin COMPU_VTAB _CNV_S_4_STATE_RGN__220 "" TAB_VERB 4 0 "H_AMPL" 1 "PARK" 2 "L_AMPL" 3 "PASSIVE" /end COMPU_VTAB
/begin COMPU_METHOD _CNV_A_R_LINEAR_____229_CM "" RAT_FUNC "%6.3" "" COEFFS 0 65535. 0. 0 0 1 /end COMPU_METHOD
/begin COMPU_METHOD _CNV_A_R_LINEAR_____243_CM "" RAT_FUNC "%6.3" "" COEFFS 0 64. 0. 0 0 1 /end COMPU_METHOD
/begin COMPU_METHOD _CNV_A_R_LINEAR_____244_CM "" RAT_FUNC "%6.3" "mg" COEFFS 0 6.25 0. 0 0 1 /end COMPU_METHOD
/begin COMPU_METHOD _CNV_A_R_EVAC_LINEA_298_CM "" RAT_FUNC "%6.3" "-" COEFFS 0 16. 0. 0 0 1 /end COMPU_METHOD
/begin COMPU_METHOD _CNV_A_R_LACO_LINEA_374_CM "" RAT_FUNC "%6.3" "-" COEFFS 0 262144.0000000004 5.093170329928398e-011 0 0 1 /end COMPU_METHOD
/begin COMPU_METHOD _CNV_A_R_LINEAR_____386_CM "" RAT_FUNC "%6.3" "°TPS/s" COEFFS 0 8.535564853556485e-002 0. 0 0 1 /end COMPU_METHOD
/begin COMPU_METHOD _CNV_A_R_LINEAR_____452_CM "" RAT_FUNC "%6.3" "-" COEFFS 0 2. 0. 0 0 1 /end COMPU_METHOD
/begin COMPU_METHOD _CNV_A_R_LINEAR_____481_CM "" RAT_FUNC "%6.3" "°C" COEFFS 0 0.25 0. 0 0 1 /end COMPU_METHOD
/begin COMPU_METHOD _CNV_A_R_NOXD_LINEA_486_CM "" RAT_FUNC "%6.3" "ppm" COEFFS 0 1. 0. 0 0 1 /end COMPU_METHOD
/begin COMPU_METHOD _CNV_A_R_LINEAR_____489_CM "" RAT_FUNC "%6.3" "mg/s" COEFFS 0 64. 0. 0 0 1 /end COMPU_METHOD
/begin COMPU_METHOD _CNV_A_R_NOXM_LINEA_507_CM "" RAT_FUNC "%6.3" "-" COEFFS 0 4294967295. 0. 0 0 1 /end COMPU_METHOD
/begin COMPU_METHOD _CNV_S_4_STATE_NOX__508_CM "" TAB_VERB "%6.3" "-" COMPU_TAB_REF _CNV_S_4_STATE_NOX__508 /end COMPU_METHOD
/begin COMPU_VTAB _CNV_S_4_STATE_NOX__508 "" TAB_VERB 4 0 "Passive" 2 "Full_Rgn" 3 "Communication" 4 "O2_STC" /end COMPU_VTAB
/begin COMPU_METHOD _CNV_A_R_LINEAR_____509_CM "" RAT_FUNC "%6.3" "kg/h" COEFFS 0 4. 0. 0 0 1 /end COMPU_METHOD
/begin COMPU_METHOD _CNV_S_4_STATE_SENS_510_CM "" TAB_VERB "%6.3" "-" COMPU_TAB_REF _CNV_S_4_STATE_SENS_510 /end COMPU_METHOD
/begin COMPU_VTAB _CNV_S_4_STATE_SENS_510 "" TAB_VERB 4 0 "VLS_DOWN" 1 "VLS_NOX_SENS" 2 "LAMB_NOX_SENS" 3 "VLS_NT_DOWN" /end COMPU_VTAB
/begin COMPU_METHOD _CNV_A_R_LINEAR_____511_CM "" RAT_FUNC "%6.3" "" COEFFS 0 65535.99999999997 -1.455191522836685e-011 0 0 1 /end COMPU_METHOD
/begin COMPU_METHOD _CNV_A_R_LINEAR_____512_CM "" RAT_FUNC "%6.3" "s/mg" COEFFS 0 131071.9999999999 0. 0 0 1 /end COMPU_METHOD
/begin COMPU_METHOD _CNV_A_R_NOXM_LINEA_513_CM "" RAT_FUNC "%6.3" "ppm" COEFFS 0 0.5 0. 0 0 1 /end COMPU_METHOD
/begin COMPU_METHOD _CNV_A_R_NOXM_LINEA_514_CM "" RAT_FUNC "%6.3" "-" COEFFS 0 2330426656368.482 0. 0 0 1 /end COMPU_METHOD
/begin COMPU_METHOD _CNV_A_R_NOXM_LINEA_515_CM "" RAT_FUNC "%6.3" "mg" COEFFS 0 6.249904631113146 0. 0 0 1 /end COMPU_METHOD
/begin COMPU_METHOD _CNV_A_R_NOXM_LINEA_516_CM "" RAT_FUNC "%6.3" "mg" COEFFS 0 409606.25 0. 0 0 1 /end COMPU_METHOD
/begin COMPU_METHOD _CNV_A_R_NOXM_LINEA_517_CM "" RAT_FUNC "%6.3" "mg" COEFFS 0 409600.0000000001 4.76837158203125e-007 0 0 1 /end COMPU_METHOD
/begin COMPU_METHOD _CNV_A_R_LINEAR_____518_CM "" RAT_FUNC "%6.3" "g" COEFFS 0 4.517648713261145 0. 0 0 1 /end COMPU_METHOD
/begin COMPU_METHOD _CNV_A_R_LINEAR_____519_CM "" RAT_FUNC "%6.3" "g" COEFFS 0 7.200002636759949 0. 0 0 1 /end COMPU_METHOD
/begin COMPU_METHOD _CNV_A_R_NOXM_LINEA_928_CM "" RAT_FUNC "%6.3" "-" COEFFS 0 1023.999979358741 0. 0 0 1 /end COMPU_METHOD
/begin COMPU_METHOD _CNV_S_6_NOXM_STATE_929_CM "" TAB_VERB "%6.3" "-" COMPU_TAB_REF _CNV_S_6_NOXM_STATE_929 /end COMPU_METHOD
/begin COMPU_VTAB _CNV_S_6_NOXM_STATE_929 "" TAB_VERB 6 0 "LAMB_LS_UP" 1 "VLS_DOWN" 2 "VLS_NS" 3 "LAMB_NS" 4 "VLS_NT_DOWN" 5 "MANUAL" /end COMPU_VTAB
/begin RECORD_LAYOUT _REC_VAL_20_u1 FNC_VALUES 1 UBYTE COLUMN_DIR DIRECT /end RECORD_LAYOUT
/begin RECORD_LAYOUT _REC_VAL_20_u2 FNC_VALUES 1 UWORD COLUMN_DIR DIRECT /end RECORD_LAYOUT
/begin RECORD_LAYOUT _REC_AXS_20_u1 NO_AXIS_PTS_X 1 UBYTE AXIS_PTS_X 2 UBYTE INDEX_INCR DIRECT /end RECORD_LAYOUT
/begin RECORD_LAYOUT _REC_MAP_20_u2_u1_u1 FNC_VALUES 1 UWORD COLUMN_DIR DIRECT /end RECORD_LAYOUT
/begin RECORD_LAYOUT _REC_CUR_20_u1_u1 FNC_VALUES 1 UBYTE COLUMN_DIR DIRECT /end RECORD_LAYOUT
/begin RECORD_LAYOUT _REC_VAL_20_s2 FNC_VALUES 1 SWORD COLUMN_DIR DIRECT /end RECORD_LAYOUT
/begin RECORD_LAYOUT _REC_AXS_20_u2 NO_AXIS_PTS_X 1 UWORD AXIS_PTS_X 2 UWORD INDEX_INCR DIRECT /end RECORD_LAYOUT
/begin RECORD_LAYOUT _REC_CUR_20_u2_u2 FNC_VALUES 1 UWORD COLUMN_DIR DIRECT /end RECORD_LAYOUT
/begin RECORD_LAYOUT _REC_VAL_20_s1 FNC_VALUES 1 SBYTE COLUMN_DIR DIRECT /end RECORD_LAYOUT
/begin RECORD_LAYOUT _REC_CUR_20_u1_u2 FNC_VALUES 1 UBYTE COLUMN_DIR DIRECT /end RECORD_LAYOUT
/begin RECORD_LAYOUT _REC_MAP_20_u2_u2_u2 FNC_VALUES 1 UWORD COLUMN_DIR DIRECT /end RECORD_LAYOUT
/begin RECORD_LAYOUT _REC_MAP_20_u2_u1_u2 FNC_VALUES 1 UWORD COLUMN_DIR DIRECT /end RECORD_LAYOUT
/begin RECORD_LAYOUT _REC_MAP_20_u1_u2_u2 FNC_VALUES 1 UBYTE COLUMN_DIR DIRECT /end RECORD_LAYOUT
/begin RECORD_LAYOUT _REC_MAP_20_u1_u1_u1 FNC_VALUES 1 UBYTE COLUMN_DIR DIRECT /end RECORD_LAYOUT
/begin RECORD_LAYOUT _REC_MAP_20_u1_u2_u1 FNC_VALUES 1 UBYTE COLUMN_DIR DIRECT /end RECORD_LAYOUT
/begin RECORD_LAYOUT _REC_MAP_20_u1_u1_u2 FNC_VALUES 1 UBYTE COLUMN_DIR DIRECT /end RECORD_LAYOUT
/begin FUNCTION INJ_Lambda_setpoint_for_catalyst_regeneration "_Lambda setpoint for catalyst regeneration"
 /begin DEF_CHARACTERISTIC lc_rpu_lamb_rgn_1 c_lamb_purge_l_ampl c_lamb_pas_bas c_maf_kgh_thr_max c_maf_kgh_thr_min c_state_lamb_rgn_2_h_ampl c_state_lamb_rgn_l_ampl c_state_lamb_rgn_l_ampl_bas c_state_lamb_rgn_1_h_ampl c_t_purge_h_ampl c_t_purge_l_ampl c_vls_park_t_rgn_2_deac ldp_vls_h_ampl_2_ip_lamb_fac ldp_t_rgn_2_l_ampl_ip_lamb_fac ldp_vls_h_ampl_1_ip_lamb_fac ldp_vls_park_1_ip_lamb_fac ldp_t_rgn_1_park_ip_lamb_fac ldp_t_rgn_2_park_ip_lamb_fac ip_lamb_fac_park_2_t_rgn_2 ldp_vls_l_ampl_2_ip_lamb_fac ldp_vls_l_ampl_1_ip_lamb_fac ldp_t_rgn_1_l_ampl_ip_lamb_fac ldp_maf_kgh_l_ampl_ip_lamb_fac ldp_maf_kgh_hom_ip_lamb_bas c_lamb_purge_h_ampl c_lamb_rgn_h_ampl_bas c_lamb_rgn_l_ampl_bas c_lamb_rgn_l_ampl_bas_max c_state_rgn_1_park c_state_rgn_2_park c_state_rgn_ini_1 c_state_rgn_ini_2 ip_lamb_fac_h_ampl_2_vls ip_lamb_fac_l_ampl_2_vls ip_lamb_fac_l_ampl_t_rgn_2 ip_lamb_fac_l_ampl_t_rgn_1 ip_lamb_fac_h_ampl_1_vls ip_lamb_fac_park_1_vls ip_lamb_fac_park_1_t_rgn ip_lamb_fac_l_ampl_vls_maf_kgh ip_lamb_rgn_l_ampl_bas c_lamb_park_bas c_ctr_rgn_swi_act c_ctr_rgn_swi_deac /end DEF_CHARACTERISTIC
 /begin OUT_MEASUREMENT t_rgn t_rgn_2 lv_lamb_park_afl_deac lv_lamb_sp_swi maf_kgh_hom state_rgn[0] state_rgn[1] lamb_rgn[0] lamb_rgn[1] lamb_rgn_fac[0] lamb_rgn_fac[1] lamb_rgn_l_ampl_bas ctr_rgn_cyc_lamb_rgn /end OUT_MEASUREMENT
/end FUNCTION
/begin FUNCTION INJ_Injection_Time_Correction_by_the_Application_System "_Injection Time Correction by the Application System" /begin OUT_MEASUREMENT t_mff_ad_min /end OUT_MEASUREMENT /end FUNCTION
/begin FUNCTION INJ_Exhaust_Gas_temperature_model "_Exhaust Gas temperature model"
 /begin DEF_CHARACTERISTIC id_ctr_cold_st ldp_ctr_cold_st__ctr_cold_st ip_int_teg_thd ip_int_teg_cat_down_thd ldpm_tco_st_1_extd ldpm_tia_1_extd ip_int_teg ldp_eff_iga_av__int_teg ldp_maf_kgh__int_teg /end DEF_CHARACTERISTIC
 /begin OUT_MEASUREMENT lv_puc_inh_temp_cat ctr_cold_st int_teg_maf lv_teg_cat_down_min_thd_1 lv_teg_min_thd_1 temp_cat_dyn_mdl[0] temp_cat_dyn_mdl[1] temp_cat_stat_mdl[0] temp_cat_stat_mdl[1] /end OUT_MEASUREMENT
/end FUNCTION
/begin FUNCTION INJ_Catalyst_enrichment_function "_Catalyst enrichment function" /end FUNCTION
/begin FUNCTION INJ_Application_incidences_for_catalyst_enrichment_function "_Application incidences for catalyst enrichment function" /end FUNCTION
/begin FUNCTION INJ_Lambda_stimulation_for_a_lambda_controller_with_an_UEGO_sensor "_Lambda stimulation for a lambda-controller with an UEGO-sensor" /end FUNCTION
/begin FUNCTION INJ_Forced_stimulation_for_a_lambda_controller_with_an_UEGO_sensor "_Forced stimulation for a lambda-controller with an UEGO-sensor" /end FUNCTION
/begin FUNCTION INJ_Restart_function "_Restart function" /begin DEF_CHARACTERISTIC ip_rest ip_fac_rest ip_fac_stall ip_fac_stnd_rest /end DEF_CHARACTERISTIC /begin OUT_MEASUREMENT fac_st_rest /end OUT_MEASUREMENT /end FUNCTION
/begin FUNCTION INJ_Detection_of_limited_dynamic_condition_for_dynamic_fuel_trim "_Detection of limited dynamic condition for dynamic fuel trim"
 /begin DEF_CHARACTERISTIC c_maf_crlc_dly c_lam_mv_crlc_dly c_n_dyw_dly c_maf_dyw_dly c_lam_mv_dyw_dly c_n_crlc_dly c_maf_int_min_ldc_dly c_fac_tq_req_grd_dec_dly c_fac_tq_req_grd_min_ldc_dly c_fac_tq_req_grd_sum_max_dly c_fac_tq_req_grd_sum_min_dly c_t_fac_tq_req_grd_sum_dly /end DEF_CHARACTERISTIC
 /begin OUT_MEASUREMENT lam_bank_1.lam_dlyl.bf.lv_ldc_dly lam_bank_1.lam_dlyl.bf.lv_lam_mv_ldc_dly lam_bank_1.lam_dlyl.fac_lam_mv_mmv_dly lam_bank_1.lam_dlyl.maf_int_ldc_dly lam_bank_2.lam_dlyl.bf.lv_ldc_dly lam_bank_2.lam_dlyl.bf.lv_lam_mv_ldc_dly lam_bank_2.lam_dlyl.fac_lam_mv_mmv_dly lam_bank_2.lam_dlyl.maf_int_ldc_dly maf_mmv_dly n_mmv_dly lv_n_ldc_dly lv_maf_ldc_dly lv_fac_tq_req_ldc_dly fac_tq_req_grd fac_tq_req_grd_sum_dly t_fac_tq_req_grd_sum_dly /end OUT_MEASUREMENT
/end FUNCTION
/begin FUNCTION INJ_Application_incidence_exhaust_gas_temperature_model "_Application incidence exhaust gas temperature model"
 /begin OUT_MEASUREMENT nr_cyl_scc_teg[0] nr_cyl_scc_teg[1] lv_teg_min_thd[0] lv_teg_min_thd[1] lv_teg_cat_down_min_thd[0] lv_teg_cat_down_min_thd[1] /end OUT_MEASUREMENT
/end FUNCTION
/begin FUNCTION INJ_Conditioning_of_catalyst_O2_loading "_Conditioning of catalyst O2 loading" /end FUNCTION
/begin FUNCTION INJ_Application_Incidences_for_conditioning_of_catalyst_O2_loading "_Application Incidences for conditioning of catalyst O2 loading" /end FUNCTION
/begin FUNCTION INJ_Downstream_oxygen_sensor_internal_resistance_determination "_Downstream oxygen sensor internal resistance determination" /end FUNCTION
/begin FUNCTION INJ_Inhibition_Conditions_for_OBDII_oxygen_downstream_heater_diagnosis "Inhibition Conditions for OBDII oxygen downstream heater diagnosis" /end FUNCTION
/begin FUNCTION INJ_Seq_FCUT_And_Restart_Fuel_Feed ""
 /begin DEF_CHARACTERISTIC ldp_case_sel_cyl__pat_sel_cyl ldp_nr_sel_cyl__pat_sel_cyl ldp_gr_mt__t_osc_dt id_pat_sel_cyl id_t_osc_dt c_tps_grd_max_sel_rpl c_n_grd_min_sel_ris c_maf_max_sel_rpl c_n_dif_max_sel_ris c_nr_sel_cyl_1 c_nr_sel_cyl_2 c_nr_sel_cyl_3 lc_ena_fcut_aj c_tqi_sp_slow_dif_max /end DEF_CHARACTERISTIC
 /begin OUT_MEASUREMENT lv_sel_cyl nr_pat_sel_cyl t_fcut_aj t_osc_dt nr_sel_cyl case_sel_cyl tqi_sp_slow_dif /end OUT_MEASUREMENT
/end FUNCTION
/begin FUNCTION INJ_Application_incidence_NOx_catalyst_management "_Application incidence NOx catalyst management"
 /begin DEF_CHARACTERISTIC c_tnt_mdl_thd_rgn_not c_tnt_mdl_thd_rgn_not_hys lc_inh_nt_act_off lc_inh_rgn_req_ntld lc_inh_nt_afl_off c_tnt_mdl_nt_stc_max_min c_tnt_mdl_nt_stc_max_max c_tnt_mdl_nt_stc_max_delta c_tnt_mdl_o2_stc_min c_tnt_mdl_o2_stc_max c_tnt_mdl_o2_stc_delta c_vs_o2_stc_min lc_inh_nt_afl lc_inh_req_nox_sens_off c_t_nox_sens_vld_state_rgn_req c_ntld_state_rgn_req lc_tnt_mdl_max_ofs c_vs_tnt_mdl_min c_t_vs_is_nt c_tnt_mdl_max_ofs c_tnt_mdl_h_max_ofs c_nt_sul_min_ofs lc_inh_ntld_req_nox_sens_auth lc_inh_ntld_req_nox_sens_vld lc_inh_rgn_is c_vs_min_rgn /end DEF_CHARACTERISTIC
 /begin OUT_MEASUREMENT lv_inh_nox_sens_rgn /end OUT_MEASUREMENT
/end FUNCTION
/begin FUNCTION INJ_NOx_catalyst_management___auxiliary_functionalities "_NOx catalyst management - auxiliary functionalities"
 /begin DEF_CHARACTERISTIC lc_inh_nt_prj_act lc_inh_nt_stc_max lc_inh_nt_o2_stc lc_nt_prj_act lc_rgn_req_ad_vld_act c_maf_int_puc_o2_stc c_ntl_max_o2_stc c_t_vls_down_secu c_t_nt_ad_com c_vs_min_rgn_ad c_n_32_min_rgn_ad c_maf_min_rgn_ad c_state_sens_afr_ad_1 c_state_sens_afr_ad_2 c_vls_down_afr_o2 c_vls_down_afr_ad_secu c_vls_nox_sens_afr_o2 c_vls_nox_sens_afr_ad_secu c_lamb_nox_sens_afr_o2 c_lamb_nox_sens_afr_ad_secu ldp_t_afl_ntl_dec_int_ofs ip_ntl_dec_int_ofs_t_afl /end DEF_CHARACTERISTIC
 /begin OUT_MEASUREMENT state_nox_prj lv_nt_ad_cmpl lv_nt_ad_vld lv_nt_stc_max_act lv_nt_stc_max_afl_act lv_nt_o2_stc_act lv_nt_prj_act lv_rgn_req_ad lv_rgn_req_ad_vld lv_rgn_cdn_ad lv_inh_rgn_ad lv_sens_afr_ad_secu_1 lv_sens_afr_ad_secu_2 lv_sens_afr_o2_1 lv_sens_afr_o2_2 maf_int_puc_o2_stc t_vls_down_afl_1 t_vls_down_afl_2 t_vls_down_secu_1 t_vls_down_secu_2 t_nt_ad_com ntl_dec_int_ad_1 ntl_dec_int_ad_2 ntl_dec_int_thd /end OUT_MEASUREMENT
/end FUNCTION
/begin FUNCTION INJ_NOx_Catalyst_Monolith_Temperature_Model "_NOx Catalyst Monolith Temperature Model"
 /begin DEF_CHARACTERISTIC c_fac_int_tnt_maf_sa ldpm_tco_st__int_tnt_thd ldpm_teg__int_tnt_thd ip_int_tnt_thd_1__tco_st__teg ip_int_tnt_thd_2__tco_st__teg ldp_ctr_cold_st_nt__tnt_cold_st id_tnt_cold_st__ctr_cold_st_nt ldp_eff_iga_av__int_tnt ldp_maf_kgh__int_tnt ip_int_tnt__eff_iga_av__maf_kgh /end DEF_CHARACTERISTIC
 /begin OUT_MEASUREMENT int_tnt_maf lv_tnt_min_thd_1 lv_tnt_min_thd_2 fac_int_tnt_maf_sa ctr_cold_st_nt teg_pcat_down_cor[0] teg_pcat_down_cor[1] tnt_mdl_mv tnt_mdl_h tnt_mdl_h_1 tnt_mdl_h_2 tnt_mdl_l tnt_mdl_max_avl tnt_mdl_mv_sng[0] tnt_mdl_mv_sng[1] tnt_mdl_1[0] tnt_mdl_1[1] tnt_mdl_2[0] tnt_mdl_2[1] /end OUT_MEASUREMENT
/end FUNCTION
/begin FUNCTION INJ_NOx_Cat_Monolith_Temp_Model__AI "_NOx Cat Monolith Temp Model  AI" /begin OUT_MEASUREMENT teg_pcat_down_add fac_tnt_min_cor_1 fac_tnt_min_cor_2 /end OUT_MEASUREMENT /end FUNCTION
/begin FUNCTION INJ_NOx_tailpipe_emission "_NOx tailpipe emission" /begin DEF_CHARACTERISTIC lc_nox_out_mes_int_act /end DEF_CHARACTERISTIC
 /begin OUT_MEASUREMENT nox_out_mes_int_1 nox_out_mes_int_2 nox_out_mes_1 nox_out_mes_2 /end OUT_MEASUREMENT
/end FUNCTION
/begin FUNCTION INJ_NOx_Cat_Sulphur_Model "_NOx Cat Sulphur Model"
 /begin DEF_CHARACTERISTIC c_su_conc_fuel c_su_conc_fuel_h c_crlc_su_nox c_nt_sul_ini c_lamb_sp_min_sul lc_nt_sul_ini_man lc_nt_sul_lim_not ip_nt_sul_max ip_t_so2p_dly ip_nt_sul_dec_bas ip_nt_sul_dec_fac_1 ldp_tnt_mdl_mv_ip_nt_sul_dec ip_nt_sul_h_dec_fac_1 ldp_nt_agi_thermo_ip_nt_sul_2 ip_nt_sul_dec_fac_2 ldpm_lamb_mv_ip_t_so2p_dly ldpm_lamb_mv_ip_nt_sul_dec_bas ldp_nt_sul_so2p_beg_ip_nt_sul_1 ldpm_nt_sul_ip_nt_sul_h_dec_1 ldp_tnt_mdl_mv_ip_crlc_sul_afs ip_crlc_sul_afs ldpm_nt_sul_ip_nt_sul_dec_fac_1 c_state_egr_cbk /end DEF_CHARACTERISTIC
 /begin OUT_MEASUREMENT nt_sul_h nt_sul nt_sul_32[0] nt_sul_32[1] nt_sul_h_32[0] nt_sul_h_32[1] nt_sul_max[0] nt_sul_max[1] nt_agi_inc_so2p[0] nt_agi_inc_so2p[1] nt_sul_h_delta[0] nt_sul_h_delta[1] nt_sul_h_so2p_beg[0] nt_sul_h_so2p_beg[1] nt_sul_agi_delta[0] nt_sul_agi_delta[1] nt_sul_delta[0] nt_sul_delta[1] nt_sul_so2p_beg[0] nt_sul_so2p_beg[1] /end OUT_MEASUREMENT
/end FUNCTION
/begin FUNCTION INJ_NOx_Cat_Model_Control "_NOx Cat Model Control"
 /begin DEF_CHARACTERISTIC c_ntld_mdl_dif_i_min c_ntld_mdl_dif_i_max c_ntld_dec_stop c_ntld_dec_rgn c_nox_out_mes_grd_max lc_nox_rgn_cmpl c_nox_ppm_ctrl_min c_ntld_ctrl_min c_crlc_nox_out_mes_mmv lc_nox_mdl_ctrl_act c_nox_out_mes_mmv_max c_nox_dif_mon c_nox_dif_mon_min c_t_nox_mdl_inh_ctrl_min c_t_nox_mdl_ctrl_ena_min lc_inh_p_hld lc_inh_nox_mdl_ctrl_ini ldpm_nox_cor_red_mmv ldp_maf_kgh_ip_crlc_nox_sens ip_ntld_mdl_dif_i ip_ntld_mdl_dif_p ip_crlc_nox_sens ldpm_tnt_mdl_mv /end DEF_CHARACTERISTIC
 /begin OUT_MEASUREMENT nox_out_mdl_sens nox_out_mdl_dif_2 ntld_mdl_dif nox_out_mdl_dif_1 nox_out_mes_mmv_2 nox_out_mes_mmv_1 t_nox_mdl_ctrl_act_2 t_nox_mdl_ctrl_act_1 t_nox_mdl_ctrl_ena_1 t_nox_mdl_ctrl_ena_2 ntld_mdl_dif_i ntld_mdl_dif_i_1 ntld_mdl_dif_i_2 ntld_mdl_dif_p ntld_mdl_dif_p_1 ntld_mdl_dif_p_2 lv_nox_rgn_cmpl lv_inh_nox_mdl_ctrl_rgn lv_inh_nox_mdl_ctrl_rgn_1 lv_inh_nox_mdl_ctrl_rgn_2 /end OUT_MEASUREMENT
/end FUNCTION
/begin FUNCTION INJ_NOx_Cat_Desulfation_Lambda_Stimulation "_NOx Cat Desulfation Lambda Stimulation"
 /begin DEF_CHARACTERISTIC c_delta_lamb_afr_so2p c_delta_lamb_afl_so2p c_delta_lamb_sp_so2p ldpm_n_32_1_lamb_puls_so2p ldpm_maf_1_lamb_puls_so2p ip_lam_so2p_pos_i ip_lam_so2p_neg_i c_vls_down_afl c_t_vls_down_cyc_afl_max c_t_vls_down_cyc_afr_max ldpm_n_32_1_lamb_puls_ref ldpm_maf_2_lamb_puls_ref ip_t_afl_down_lock_afl ip_t_afl_down_lock_afr c_lamb_sp_so2p lc_t_afl_down_ctl c_lam_so2p_neg_p c_lam_so2p_pos_p c_vls_down_afr ip_vls_ref_lamb_ls_up ip_vls_ref_lamb_ns ldp_lamb_ls_up_ip_vls_ref ldp_lamb_ns_ip_vls_ref_lamb_ns c_vls_ref_so2p_lamb_sp ip_t_lam_dly_so2p_neg ip_t_lam_dly_so2p_pos ip_vls_ref_vls_ns ldp_vls_ns_ip_vls_ref_vls_ns c_state_vls_sens_ref[0] c_state_vls_sens_ref[1] /end DEF_CHARACTERISTIC
 /begin OUT_MEASUREMENT ctr_vls_down_afl_cyc[0] ctr_vls_down_afl_cyc[1] t_lam_dly_so2p[0] t_lam_dly_so2p[1] t_vls_down_cyc_afl[0] t_vls_down_cyc_afl[1] vls_down_ref[0] vls_down_ref[1] lamb_puls_so2p_h_res[0] lamb_puls_so2p_h_res[1] lv_vls_down_afl[0] lv_vls_down_afl[1] lv_vls_down_tra[0] lv_vls_down_tra[1] lv_so2p_afr[0] lv_so2p_afr[1] lamb_puls_so2p[0] lamb_puls_so2p[1] /end OUT_MEASUREMENT
/end FUNCTION
/begin FUNCTION INJ_NOx_Engine_out_Emission_Adaptation "_NOx Engine out Emission Adaptation"
 /begin DEF_CHARACTERISTIC c_crlc_nox_ad_fac lc_nox_ad_act c_crlc_nox_ad c_nox_ad_dyw c_crlc_maf_fg_cyl c_maf_fg_cyl_dyw lc_nox_ad_on c_ntld_min_nox_ad c_nox_ad_fac_dif c_ctr_nox_ad_fac_min c_tnt_mdl_nox_ad_min c_tnt_mdl_nox_ad_max c_ntld_max_nox_ad lc_nox_ad_fac_ini c_nox_ad_fac_ini c_lamb_nox_ad_dyw c_n_32_min_rgn_nox_ad c_vs_min_rgn_nox_ad c_maf_min_rgn_nox_ad /end DEF_CHARACTERISTIC
 /begin OUT_MEASUREMENT nox_ad_fac lv_nox_ad_cmpl ntl_rgn_st_nox_mes_1 ntl_rgn_st_nox_mes_2 nox_ad_fac_1 nox_ad_fac_2 lv_dyw_nox_ad nox_cor_s_mmv maf_fg_cyl_mmv nox_ad_fac_raw_2 nox_ad_fac_raw_1 ctr_nox_ad_fac /end OUT_MEASUREMENT
/end FUNCTION
/end MODULE
/end PROJECT
