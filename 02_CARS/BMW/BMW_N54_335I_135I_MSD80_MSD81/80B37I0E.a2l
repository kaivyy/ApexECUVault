ASAP2_VERSION 1 41
/begin PROJECT MSD70 "Spray Guided DI-System with Piezo Injectors for 6-Cylinder"
/begin HEADER "_default_HeaderComment" PROJECT_NO _0B /end HEADER
/begin MODULE _default_ModuleName "_default_ModuleLongIdentifier"
/begin MOD_COMMON "_default_ModCommonComment" DEPOSIT ABSOLUTE BYTE_ORDER MSB_LAST ALIGNMENT_BYTE 1 ALIGNMENT_WORD 2 ALIGNMENT_LONG 2 ALIGNMENT_FLOAT32_IEEE 2 ALIGNMENT_FLOAT64_IEEE 4 /end MOD_COMMON
/begin CHARACTERISTIC c_t_ast_rbm "" VALUE 0xa10051c8 _REC_VAL_20_u2 65535. _CNV_A_R_LINEAR_____35_CM 0. 65535. DISPLAY_IDENTIFIER C_T_AST_RBM FORMAT "%5.0" /end CHARACTERISTIC
/begin CHARACTERISTIC c_vs_thd_rbm "" VALUE 0xa10051d2 _REC_VAL_20_u1 255. _CNV_A_R_LINEAR_____6_CM 0. 255. DISPLAY_IDENTIFIER C_VS_THD_RBM FORMAT "%3.0" /end CHARACTERISTIC
/begin CHARACTERISTIC c_t_vs_rbm "" VALUE 0xa10051cc _REC_VAL_20_u2 65535. _CNV_A_R_LINEAR_____35_CM 0. 65535. DISPLAY_IDENTIFIER C_T_VS_RBM FORMAT "%5.0" /end CHARACTERISTIC
/begin CHARACTERISTIC c_tam_min_rbm "" VALUE 0xa10051ce _REC_VAL_20_u1 190.5 _CNV_A_R_LINEAR_____16_CM -48. 142.5 DISPLAY_IDENTIFIER C_TAM_MIN_RBM FORMAT "%6.2" /end CHARACTERISTIC
/begin CHARACTERISTIC c_amp_min_rbm "" VALUE 0xa10051ba _REC_VAL_20_u2 5434. _CNV_A_R_LINEAR_____26_CM 0. 5434. DISPLAY_IDENTIFIER C_AMP_MIN_RBM FORMAT "%7.2" /end CHARACTERISTIC
/begin CHARACTERISTIC c_dly_ast_rbm "" VALUE 0xa10051c0 _REC_VAL_20_u2 6553.5 _CNV_A_R_LINEAR_____4_CM 0. 6553.5 DISPLAY_IDENTIFIER C_DLY_AST_RBM FORMAT "%6.1" /end CHARACTERISTIC
/begin MEASUREMENT ctr_igk_cyc_rbm "" UWORD _CNV_A_R_LINEAR_____0_CM 1 100. 0. 65535. DISPLAY_IDENTIFIER CTR_IGK_CYC_RBM ECU_ADDRESS 0xd0004a1e FORMAT "%5.0" /end MEASUREMENT
/begin MEASUREMENT ctr_cdn_obd_rbm "" UWORD _CNV_A_R_LINEAR_____0_CM 1 100. 0. 65535. DISPLAY_IDENTIFIER CTR_CDN_OBD_RBM ECU_ADDRESS 0xd0004a1c FORMAT "%5.0" /end MEASUREMENT
/begin MEASUREMENT lv_igk_cyc_rbm "" UBYTE _CNV_S_2_RANGE__0___1_CM 1 100. 0. 1. DISPLAY_IDENTIFIER LV_IGK_CYC_RBM ECU_ADDRESS 0xc0001e00 BIT_MASK 0x1 /end MEASUREMENT
/begin MEASUREMENT lv_dc_rbm "" UBYTE _CNV_S_2_RANGE__0___1_CM 1 100. 0. 1. DISPLAY_IDENTIFIER LV_DC_RBM ECU_ADDRESS 0xd000354d BIT_MASK 0x1 /end MEASUREMENT
/begin MEASUREMENT t_ast_rbm "" UWORD _CNV_A_R_LINEAR_____35_CM 1 100. 0. 65535. DISPLAY_IDENTIFIER T_AST_RBM ECU_ADDRESS 0xc0001de4 FORMAT "%5.0" /end MEASUREMENT
/begin MEASUREMENT t_vs_rbm "" UWORD _CNV_A_R_LINEAR_____35_CM 1 100. 0. 65535. DISPLAY_IDENTIFIER T_VS_RBM ECU_ADDRESS 0xc0001de6 FORMAT "%5.0" /end MEASUREMENT
/begin MEASUREMENT t_is_rbm "" UBYTE _CNV_A_R_LINEAR_____35_CM 1 100. 0. 255. DISPLAY_IDENTIFIER T_IS_RBM ECU_ADDRESS 0xc0001dfe FORMAT "%3.0" /end MEASUREMENT
/begin CHARACTERISTIC c_t_is_rbm "" VALUE 0xa10051ca _REC_VAL_20_u1 255. _CNV_A_R_LINEAR_____35_CM 0. 255. DISPLAY_IDENTIFIER C_T_IS_RBM FORMAT "%3.0" /end CHARACTERISTIC
/begin MEASUREMENT state_dc_rbm "" UBYTE _CNV_A_R_LINEAR_____0_CM 1 100. 0. 255. DISPLAY_IDENTIFIER STATE_DC_RBM ECU_ADDRESS 0xc0001dfc FORMAT "%3.0" /end MEASUREMENT
/begin CHARACTERISTIC c_vs_thd_is_cdn_rbm "" VALUE 0xa10051d1 _REC_VAL_20_u1 25.5 _CNV_A_R_LINEAR_____44_CM 0. 25.5 DISPLAY_IDENTIFIER C_VS_THD_IS_CDN_RBM FORMAT "%4.1" /end CHARACTERISTIC
/begin MEASUREMENT state_rbm[0] "" UBYTE _CNV_A_R_LINEAR_____0_CM 1 100. 0. 15. DISPLAY_IDENTIFIER STATE_RBM[0] ECU_ADDRESS 0xd0003564 FORMAT "%3.0" /end MEASUREMENT
/begin MEASUREMENT state_rbm[1] "" UBYTE _CNV_A_R_LINEAR_____0_CM 1 100. 0. 15. DISPLAY_IDENTIFIER STATE_RBM[1] ECU_ADDRESS 0xd0003565 FORMAT "%3.0" /end MEASUREMENT
/begin MEASUREMENT state_rbm[2] "" UBYTE _CNV_A_R_LINEAR_____0_CM 1 100. 0. 15. DISPLAY_IDENTIFIER STATE_RBM[2] ECU_ADDRESS 0xd0003566 FORMAT "%3.0" /end MEASUREMENT
/begin MEASUREMENT state_rbm[3] "" UBYTE _CNV_A_R_LINEAR_____0_CM 1 100. 0. 15. DISPLAY_IDENTIFIER STATE_RBM[3] ECU_ADDRESS 0xd0003567 FORMAT "%3.0" /end MEASUREMENT
/begin MEASUREMENT state_rbm[4] "" UBYTE _CNV_A_R_LINEAR_____0_CM 1 100. 0. 15. DISPLAY_IDENTIFIER STATE_RBM[4] ECU_ADDRESS 0xd0003568 FORMAT "%3.0" /end MEASUREMENT
/begin MEASUREMENT state_rbm[5] "" UBYTE _CNV_A_R_LINEAR_____0_CM 1 100. 0. 15. DISPLAY_IDENTIFIER STATE_RBM[5] ECU_ADDRESS 0xd0003569 FORMAT "%3.0" /end MEASUREMENT
/begin MEASUREMENT state_rbm[6] "" UBYTE _CNV_A_R_LINEAR_____0_CM 1 100. 0. 15. DISPLAY_IDENTIFIER STATE_RBM[6] ECU_ADDRESS 0xd000356a FORMAT "%3.0" /end MEASUREMENT
/begin MEASUREMENT state_rbm[7] "" UBYTE _CNV_A_R_LINEAR_____0_CM 1 100. 0. 15. DISPLAY_IDENTIFIER STATE_RBM[7] ECU_ADDRESS 0xd000356b FORMAT "%3.0" /end MEASUREMENT
/begin MEASUREMENT state_rbm[8] "" UBYTE _CNV_A_R_LINEAR_____0_CM 1 100. 0. 15. DISPLAY_IDENTIFIER STATE_RBM[8] ECU_ADDRESS 0xd000356c FORMAT "%3.0" /end MEASUREMENT
/begin MEASUREMENT state_rbm[9] "" UBYTE _CNV_A_R_LINEAR_____0_CM 1 100. 0. 15. DISPLAY_IDENTIFIER STATE_RBM[9] ECU_ADDRESS 0xd000356d FORMAT "%3.0" /end MEASUREMENT
/begin MEASUREMENT state_rbm[10] "" UBYTE _CNV_A_R_LINEAR_____0_CM 1 100. 0. 15. DISPLAY_IDENTIFIER STATE_RBM[10] ECU_ADDRESS 0xd000356e FORMAT "%3.0" /end MEASUREMENT
/begin MEASUREMENT state_rbm[11] "" UBYTE _CNV_A_R_LINEAR_____0_CM 1 100. 0. 15. DISPLAY_IDENTIFIER STATE_RBM[11] ECU_ADDRESS 0xd000356f FORMAT "%3.0" /end MEASUREMENT
/begin MEASUREMENT state_rbm[12] "" UBYTE _CNV_A_R_LINEAR_____0_CM 1 100. 0. 15. DISPLAY_IDENTIFIER STATE_RBM[12] ECU_ADDRESS 0xd0003570 FORMAT "%3.0" /end MEASUREMENT
/begin MEASUREMENT state_rbm[13] "" UBYTE _CNV_A_R_LINEAR_____0_CM 1 100. 0. 15. DISPLAY_IDENTIFIER STATE_RBM[13] ECU_ADDRESS 0xd0003571 FORMAT "%3.0" /end MEASUREMENT
/begin MEASUREMENT state_rbm[14] "" UBYTE _CNV_A_R_LINEAR_____0_CM 1 100. 0. 15. DISPLAY_IDENTIFIER STATE_RBM[14] ECU_ADDRESS 0xd0003572 FORMAT "%3.0" /end MEASUREMENT
/begin MEASUREMENT state_rbm[15] "" UBYTE _CNV_A_R_LINEAR_____0_CM 1 100. 0. 15. DISPLAY_IDENTIFIER STATE_RBM[15] ECU_ADDRESS 0xd0003573 FORMAT "%3.0" /end MEASUREMENT
/begin MEASUREMENT state_rbm[16] "" UBYTE _CNV_A_R_LINEAR_____0_CM 1 100. 0. 15. DISPLAY_IDENTIFIER STATE_RBM[16] ECU_ADDRESS 0xd0003574 FORMAT "%3.0" /end MEASUREMENT
/begin MEASUREMENT state_rbm[17] "" UBYTE _CNV_A_R_LINEAR_____0_CM 1 100. 0. 15. DISPLAY_IDENTIFIER STATE_RBM[17] ECU_ADDRESS 0xd0003575 FORMAT "%3.0" /end MEASUREMENT
/begin MEASUREMENT state_rbm[18] "" UBYTE _CNV_A_R_LINEAR_____0_CM 1 100. 0. 15. DISPLAY_IDENTIFIER STATE_RBM[18] ECU_ADDRESS 0xd0003576 FORMAT "%3.0" /end MEASUREMENT
/begin MEASUREMENT state_rbm[19] "" UBYTE _CNV_A_R_LINEAR_____0_CM 1 100. 0. 15. DISPLAY_IDENTIFIER STATE_RBM[19] ECU_ADDRESS 0xd0003577 FORMAT "%3.0" /end MEASUREMENT
/begin MEASUREMENT state_rbm[20] "" UBYTE _CNV_A_R_LINEAR_____0_CM 1 100. 0. 15. DISPLAY_IDENTIFIER STATE_RBM[20] ECU_ADDRESS 0xd0003578 FORMAT "%3.0" /end MEASUREMENT
/begin MEASUREMENT state_rbm[21] "" UBYTE _CNV_A_R_LINEAR_____0_CM 1 100. 0. 15. DISPLAY_IDENTIFIER STATE_RBM[21] ECU_ADDRESS 0xd0003579 FORMAT "%3.0" /end MEASUREMENT
/begin MEASUREMENT state_rbm[22] "" UBYTE _CNV_A_R_LINEAR_____0_CM 1 100. 0. 15. DISPLAY_IDENTIFIER STATE_RBM[22] ECU_ADDRESS 0xd000357a FORMAT "%3.0" /end MEASUREMENT
/begin MEASUREMENT state_rbm[23] "" UBYTE _CNV_A_R_LINEAR_____0_CM 1 100. 0. 15. DISPLAY_IDENTIFIER STATE_RBM[23] ECU_ADDRESS 0xd000357b FORMAT "%3.0" /end MEASUREMENT
/begin MEASUREMENT state_rbm[24] "" UBYTE _CNV_A_R_LINEAR_____0_CM 1 100. 0. 15. DISPLAY_IDENTIFIER STATE_RBM[24] ECU_ADDRESS 0xd000357c FORMAT "%3.0" /end MEASUREMENT
/begin MEASUREMENT state_rbm[25] "" UBYTE _CNV_A_R_LINEAR_____0_CM 1 100. 0. 15. DISPLAY_IDENTIFIER STATE_RBM[25] ECU_ADDRESS 0xd000357d FORMAT "%3.0" /end MEASUREMENT
/begin MEASUREMENT state_rbm[26] "" UBYTE _CNV_A_R_LINEAR_____0_CM 1 100. 0. 15. DISPLAY_IDENTIFIER STATE_RBM[26] ECU_ADDRESS 0xd000357e FORMAT "%3.0" /end MEASUREMENT
/begin MEASUREMENT state_rbm[27] "" UBYTE _CNV_A_R_LINEAR_____0_CM 1 100. 0. 15. DISPLAY_IDENTIFIER STATE_RBM[27] ECU_ADDRESS 0xd000357f FORMAT "%3.0" /end MEASUREMENT
/begin MEASUREMENT state_rbm[28] "" UBYTE _CNV_A_R_LINEAR_____0_CM 1 100. 0. 15. DISPLAY_IDENTIFIER STATE_RBM[28] ECU_ADDRESS 0xd0003580 FORMAT "%3.0" /end MEASUREMENT
/begin MEASUREMENT state_rbm[29] "" UBYTE _CNV_A_R_LINEAR_____0_CM 1 100. 0. 15. DISPLAY_IDENTIFIER STATE_RBM[29] ECU_ADDRESS 0xd0003581 FORMAT "%3.0" /end MEASUREMENT
/begin MEASUREMENT state_rbm[30] "" UBYTE _CNV_A_R_LINEAR_____0_CM 1 100. 0. 15. DISPLAY_IDENTIFIER STATE_RBM[30] ECU_ADDRESS 0xd0003582 FORMAT "%3.0" /end MEASUREMENT
/begin MEASUREMENT state_rbm[31] "" UBYTE _CNV_A_R_LINEAR_____0_CM 1 100. 0. 15. DISPLAY_IDENTIFIER STATE_RBM[31] ECU_ADDRESS 0xd0003583 FORMAT "%3.0" /end MEASUREMENT
/begin MEASUREMENT state_rbm[32] "" UBYTE _CNV_A_R_LINEAR_____0_CM 1 100. 0. 15. DISPLAY_IDENTIFIER STATE_RBM[32] ECU_ADDRESS 0xd0003584 FORMAT "%3.0" /end MEASUREMENT
/begin MEASUREMENT state_rbm[33] "" UBYTE _CNV_A_R_LINEAR_____0_CM 1 100. 0. 15. DISPLAY_IDENTIFIER STATE_RBM[33] ECU_ADDRESS 0xd0003585 FORMAT "%3.0" /end MEASUREMENT
/begin MEASUREMENT state_rbm[34] "" UBYTE _CNV_A_R_LINEAR_____0_CM 1 100. 0. 15. DISPLAY_IDENTIFIER STATE_RBM[34] ECU_ADDRESS 0xd0003586 FORMAT "%3.0" /end MEASUREMENT
/begin MEASUREMENT state_rbm[35] "" UBYTE _CNV_A_R_LINEAR_____0_CM 1 100. 0. 15. DISPLAY_IDENTIFIER STATE_RBM[35] ECU_ADDRESS 0xd0003587 FORMAT "%3.0" /end MEASUREMENT
/begin MEASUREMENT state_rbm[36] "" UBYTE _CNV_A_R_LINEAR_____0_CM 1 100. 0. 15. DISPLAY_IDENTIFIER STATE_RBM[36] ECU_ADDRESS 0xd0003588 FORMAT "%3.0" /end MEASUREMENT
/begin MEASUREMENT state_rbm[37] "" UBYTE _CNV_A_R_LINEAR_____0_CM 1 100. 0. 15. DISPLAY_IDENTIFIER STATE_RBM[37] ECU_ADDRESS 0xd0003589 FORMAT "%3.0" /end MEASUREMENT
/begin MEASUREMENT state_rbm[38] "" UBYTE _CNV_A_R_LINEAR_____0_CM 1 100. 0. 15. DISPLAY_IDENTIFIER STATE_RBM[38] ECU_ADDRESS 0xd000358a FORMAT "%3.0" /end MEASUREMENT
/begin MEASUREMENT state_rbm[39] "" UBYTE _CNV_A_R_LINEAR_____0_CM 1 100. 0. 15. DISPLAY_IDENTIFIER STATE_RBM[39] ECU_ADDRESS 0xd000358b FORMAT "%3.0" /end MEASUREMENT
/begin MEASUREMENT state_rbm[40] "" UBYTE _CNV_A_R_LINEAR_____0_CM 1 100. 0. 15. DISPLAY_IDENTIFIER STATE_RBM[40] ECU_ADDRESS 0xd000358c FORMAT "%3.0" /end MEASUREMENT
/begin MEASUREMENT state_rbm[41] "" UBYTE _CNV_A_R_LINEAR_____0_CM 1 100. 0. 15. DISPLAY_IDENTIFIER STATE_RBM[41] ECU_ADDRESS 0xd000358d FORMAT "%3.0" /end MEASUREMENT
/begin MEASUREMENT state_rbm[42] "" UBYTE _CNV_A_R_LINEAR_____0_CM 1 100. 0. 15. DISPLAY_IDENTIFIER STATE_RBM[42] ECU_ADDRESS 0xd000358e FORMAT "%3.0" /end MEASUREMENT
/begin MEASUREMENT state_rbm[43] "" UBYTE _CNV_A_R_LINEAR_____0_CM 1 100. 0. 15. DISPLAY_IDENTIFIER STATE_RBM[43] ECU_ADDRESS 0xd000358f FORMAT "%3.0" /end MEASUREMENT
/begin MEASUREMENT state_rbm[44] "" UBYTE _CNV_A_R_LINEAR_____0_CM 1 100. 0. 15. DISPLAY_IDENTIFIER STATE_RBM[44] ECU_ADDRESS 0xd0003590 FORMAT "%3.0" /end MEASUREMENT
/begin MEASUREMENT state_rbm[45] "" UBYTE _CNV_A_R_LINEAR_____0_CM 1 100. 0. 15. DISPLAY_IDENTIFIER STATE_RBM[45] ECU_ADDRESS 0xd0003591 FORMAT "%3.0" /end MEASUREMENT
/begin MEASUREMENT state_rbm[46] "" UBYTE _CNV_A_R_LINEAR_____0_CM 1 100. 0. 15. DISPLAY_IDENTIFIER STATE_RBM[46] ECU_ADDRESS 0xd0003592 FORMAT "%3.0" /end MEASUREMENT
/begin MEASUREMENT state_rbm[47] "" UBYTE _CNV_A_R_LINEAR_____0_CM 1 100. 0. 15. DISPLAY_IDENTIFIER STATE_RBM[47] ECU_ADDRESS 0xd0003593 FORMAT "%3.0" /end MEASUREMENT
/begin MEASUREMENT state_rbm[48] "" UBYTE _CNV_A_R_LINEAR_____0_CM 1 100. 0. 15. DISPLAY_IDENTIFIER STATE_RBM[48] ECU_ADDRESS 0xd0003594 FORMAT "%3.0" /end MEASUREMENT
/begin MEASUREMENT state_rbm[49] "" UBYTE _CNV_A_R_LINEAR_____0_CM 1 100. 0. 15. DISPLAY_IDENTIFIER STATE_RBM[49] ECU_ADDRESS 0xd0003595 FORMAT "%3.0" /end MEASUREMENT
/begin MEASUREMENT state_rbm[50] "" UBYTE _CNV_A_R_LINEAR_____0_CM 1 100. 0. 15. DISPLAY_IDENTIFIER STATE_RBM[50] ECU_ADDRESS 0xd0003596 FORMAT "%3.0" /end MEASUREMENT
/begin MEASUREMENT rbm_stat_CAT_DIAG_1.ctr_comp_rbm "" UWORD _CNV_A_R_LINEAR_____0_CM 1 100. 0. 65535. DISPLAY_IDENTIFIER CTR_COMP_RBM_CAT_DIAG_1 ECU_ADDRESS 0xd0004686 FORMAT "%5.0" /end MEASUREMENT
/begin MEASUREMENT rbm_stat_CAT_DIAG_1.ctr_cdn_rbm "" UWORD _CNV_A_R_LINEAR_____0_CM 1 100. 0. 65535. DISPLAY_IDENTIFIER CTR_CDN_RBM_CAT_DIAG_1 ECU_ADDRESS 0xd0004688 FORMAT "%5.0" /end MEASUREMENT
/begin MEASUREMENT rbm_stat_CAT_DIAG_1.state_ctr_rbm "" UBYTE _CNV_A_R_LINEAR_____0_CM 1 100. 0. 3. DISPLAY_IDENTIFIER STATE_CTR_RBM_CAT_DIAG_1 ECU_ADDRESS 0xd000468a FORMAT "%3.0" /end MEASUREMENT
/begin MEASUREMENT rbm_stat_CAT_DIAG_2.ctr_comp_rbm "" UWORD _CNV_A_R_LINEAR_____0_CM 1 100. 0. 65535. DISPLAY_IDENTIFIER CTR_COMP_RBM_CAT_DIAG_2 ECU_ADDRESS 0xd000468c FORMAT "%5.0" /end MEASUREMENT
/begin MEASUREMENT rbm_stat_CAT_DIAG_2.ctr_cdn_rbm "" UWORD _CNV_A_R_LINEAR_____0_CM 1 100. 0. 65535. DISPLAY_IDENTIFIER CTR_CDN_RBM_CAT_DIAG_2 ECU_ADDRESS 0xd000468e FORMAT "%5.0" /end MEASUREMENT
/begin MEASUREMENT rbm_stat_CAT_DIAG_2.state_ctr_rbm "" UBYTE _CNV_A_R_LINEAR_____0_CM 1 100. 0. 3. DISPLAY_IDENTIFIER STATE_CTR_RBM_CAT_DIAG_2 ECU_ADDRESS 0xd0004690 FORMAT "%3.0" /end MEASUREMENT
/begin MEASUREMENT rbm_stat_DIAGCPS.ctr_comp_rbm "" UWORD _CNV_A_R_LINEAR_____0_CM 1 100. 0. 65535. DISPLAY_IDENTIFIER CTR_COMP_RBM_DIAGCPS ECU_ADDRESS 0xd00046a4 FORMAT "%5.0" /end MEASUREMENT
/begin MEASUREMENT rbm_stat_DIAGCPS.ctr_cdn_rbm "" UWORD _CNV_A_R_LINEAR_____0_CM 1 100. 0. 65535. DISPLAY_IDENTIFIER CTR_CDN_RBM_DIAGCPS ECU_ADDRESS 0xd00046a6 FORMAT "%5.0" /end MEASUREMENT
/begin MEASUREMENT rbm_stat_DIAGCPS.state_ctr_rbm "" UBYTE _CNV_A_R_LINEAR_____0_CM 1 100. 0. 3. DISPLAY_IDENTIFIER STATE_CTR_RBM_DIAGCPS ECU_ADDRESS 0xd00046a8 FORMAT "%3.0" /end MEASUREMENT
/begin MEASUREMENT rbm_stat_DYN_VLD_LS_UP_1.ctr_comp_rbm "" UWORD _CNV_A_R_LINEAR_____0_CM 1 100. 0. 65535. DISPLAY_IDENTIFIER CTR_COMP_RBM_DYN_VLD_LS_UP_1 ECU_ADDRESS 0xd00046b0 FORMAT "%5.0" /end MEASUREMENT
/begin MEASUREMENT rbm_stat_DYN_VLD_LS_UP_1.ctr_cdn_rbm "" UWORD _CNV_A_R_LINEAR_____0_CM 1 100. 0. 65535. DISPLAY_IDENTIFIER CTR_CDN_RBM_DYN_VLD_LS_UP_1 ECU_ADDRESS 0xd00046b2 FORMAT "%5.0" /end MEASUREMENT
/begin MEASUREMENT rbm_stat_DYN_VLD_LS_UP_1.state_ctr_rbm "" UBYTE _CNV_A_R_LINEAR_____0_CM 1 100. 0. 3. DISPLAY_IDENTIFIER STATE_CTR_RBM_DYN_VLD_LS_UP_1 ECU_ADDRESS 0xd00046b4 FORMAT "%3.0" /end MEASUREMENT
/begin MEASUREMENT rbm_stat_DYN_VLD_LS_UP_2.ctr_comp_rbm "" UWORD _CNV_A_R_LINEAR_____0_CM 1 100. 0. 65535. DISPLAY_IDENTIFIER CTR_COMP_RBM_DYN_VLD_LS_UP_2 ECU_ADDRESS 0xd00046b6 FORMAT "%5.0" /end MEASUREMENT
/begin MEASUREMENT rbm_stat_DYN_VLD_LS_UP_2.ctr_cdn_rbm "" UWORD _CNV_A_R_LINEAR_____0_CM 1 100. 0. 65535. DISPLAY_IDENTIFIER CTR_CDN_RBM_DYN_VLD_LS_UP_2 ECU_ADDRESS 0xd00046b8 FORMAT "%5.0" /end MEASUREMENT
/begin MEASUREMENT rbm_stat_DYN_VLD_LS_UP_2.state_ctr_rbm "" UBYTE _CNV_A_R_LINEAR_____0_CM 1 100. 0. 3. DISPLAY_IDENTIFIER STATE_CTR_RBM_DYN_VLD_LS_UP_2 ECU_ADDRESS 0xd00046ba FORMAT "%3.0" /end MEASUREMENT
/begin MEASUREMENT rbm_stat_MEC_IVVT_IN.ctr_comp_rbm "" UWORD _CNV_A_R_LINEAR_____0_CM 1 100. 0. 65535. DISPLAY_IDENTIFIER CTR_COMP_RBM_MEC_IVVT_IN ECU_ADDRESS 0xd00046e0 FORMAT "%5.0" /end MEASUREMENT
/begin MEASUREMENT rbm_stat_MEC_IVVT_IN.ctr_cdn_rbm "" UWORD _CNV_A_R_LINEAR_____0_CM 1 100. 0. 65535. DISPLAY_IDENTIFIER CTR_CDN_RBM_MEC_IVVT_IN ECU_ADDRESS 0xd00046e2 FORMAT "%5.0" /end MEASUREMENT
/begin MEASUREMENT rbm_stat_MEC_IVVT_IN.state_ctr_rbm "" UBYTE _CNV_A_R_LINEAR_____0_CM 1 100. 0. 3. DISPLAY_IDENTIFIER STATE_CTR_RBM_MEC_IVVT_IN ECU_ADDRESS 0xd00046e4 FORMAT "%3.0" /end MEASUREMENT
/begin MEASUREMENT rbm_stat_SA_SYS.ctr_comp_rbm "" UWORD _CNV_A_R_LINEAR_____0_CM 1 100. 0. 65535. DISPLAY_IDENTIFIER CTR_COMP_RBM_SA_SYS ECU_ADDRESS 0xd0004728 FORMAT "%5.0" /end MEASUREMENT
/begin MEASUREMENT rbm_stat_SA_SYS.ctr_cdn_rbm "" UWORD _CNV_A_R_LINEAR_____0_CM 1 100. 0. 65535. DISPLAY_IDENTIFIER CTR_CDN_RBM_SA_SYS ECU_ADDRESS 0xd000472a FORMAT "%5.0" /end MEASUREMENT
/begin MEASUREMENT rbm_stat_SA_SYS.state_ctr_rbm "" UBYTE _CNV_A_R_LINEAR_____0_CM 1 100. 0. 3. DISPLAY_IDENTIFIER STATE_CTR_RBM_SA_SYS ECU_ADDRESS 0xd000472c FORMAT "%3.0" /end MEASUREMENT
/begin MEASUREMENT rbm_stat_AIR_LSL_UP_1.ctr_comp_rbm "" UWORD _CNV_A_R_LINEAR_____0_CM 1 100. 0. 65535. DISPLAY_IDENTIFIER CTR_COMP_RBM_AIR_LSL_UP_1 ECU_ADDRESS 0xd0004668 FORMAT "%5.0" /end MEASUREMENT
/begin MEASUREMENT rbm_stat_AIR_LSL_UP_1.ctr_cdn_rbm "" UWORD _CNV_A_R_LINEAR_____0_CM 1 100. 0. 65535. DISPLAY_IDENTIFIER CTR_CDN_RBM_AIR_LSL_UP_1 ECU_ADDRESS 0xd000466a FORMAT "%5.0" /end MEASUREMENT
/begin MEASUREMENT rbm_stat_AIR_LSL_UP_1.state_ctr_rbm "" UBYTE _CNV_A_R_LINEAR_____0_CM 1 100. 0. 3. DISPLAY_IDENTIFIER STATE_CTR_RBM_AIR_LSL_UP_1 ECU_ADDRESS 0xd000466c FORMAT "%3.0" /end MEASUREMENT
/begin MEASUREMENT rbm_stat_AIR_LSL_UP_2.ctr_comp_rbm "" UWORD _CNV_A_R_LINEAR_____0_CM 1 100. 0. 65535. DISPLAY_IDENTIFIER CTR_COMP_RBM_AIR_LSL_UP_2 ECU_ADDRESS 0xd000466e FORMAT "%5.0" /end MEASUREMENT
/begin MEASUREMENT rbm_stat_AIR_LSL_UP_2.ctr_cdn_rbm "" UWORD _CNV_A_R_LINEAR_____0_CM 1 100. 0. 65535. DISPLAY_IDENTIFIER CTR_CDN_RBM_AIR_LSL_UP_2 ECU_ADDRESS 0xd0004670 FORMAT "%5.0" /end MEASUREMENT
/begin MEASUREMENT rbm_stat_AIR_LSL_UP_2.state_ctr_rbm "" UBYTE _CNV_A_R_LINEAR_____0_CM 1 100. 0. 3. DISPLAY_IDENTIFIER STATE_CTR_RBM_AIR_LSL_UP_2 ECU_ADDRESS 0xd0004672 FORMAT "%3.0" /end MEASUREMENT
/begin MEASUREMENT rbm_stat_DMTLM.ctr_comp_rbm "" UWORD _CNV_A_R_LINEAR_____0_CM 1 100. 0. 65535. DISPLAY_IDENTIFIER CTR_COMP_RBM_DMTLM ECU_ADDRESS 0xd00046aa FORMAT "%5.0" /end MEASUREMENT
/begin MEASUREMENT rbm_stat_DMTLM.ctr_cdn_rbm "" UWORD _CNV_A_R_LINEAR_____0_CM 1 100. 0. 65535. DISPLAY_IDENTIFIER CTR_CDN_RBM_DMTLM ECU_ADDRESS 0xd00046ac FORMAT "%5.0" /end MEASUREMENT
/begin MEASUREMENT rbm_stat_DMTLM.state_ctr_rbm "" UBYTE _CNV_A_R_LINEAR_____0_CM 1 100. 0. 3. DISPLAY_IDENTIFIER STATE_CTR_RBM_DMTLM ECU_ADDRESS 0xd00046ae FORMAT "%3.0" /end MEASUREMENT
/begin MEASUREMENT rbm_stat_MEC_IVVT_EX.ctr_comp_rbm "" UWORD _CNV_A_R_LINEAR_____0_CM 1 100. 0. 65535. DISPLAY_IDENTIFIER CTR_COMP_RBM_MEC_IVVT_EX ECU_ADDRESS 0xd00046da FORMAT "%5.0" /end MEASUREMENT
/begin MEASUREMENT rbm_stat_MEC_IVVT_EX.ctr_cdn_rbm "" UWORD _CNV_A_R_LINEAR_____0_CM 1 100. 0. 65535. DISPLAY_IDENTIFIER CTR_CDN_RBM_MEC_IVVT_EX ECU_ADDRESS 0xd00046dc FORMAT "%5.0" /end MEASUREMENT
/begin MEASUREMENT rbm_stat_MEC_IVVT_EX.state_ctr_rbm "" UBYTE _CNV_A_R_LINEAR_____0_CM 1 100. 0. 3. DISPLAY_IDENTIFIER STATE_CTR_RBM_MEC_IVVT_EX ECU_ADDRESS 0xd00046de FORMAT "%3.0" /end MEASUREMENT
/begin MEASUREMENT rbm_stat_SA_SAFM.ctr_comp_rbm "" UWORD _CNV_A_R_LINEAR_____0_CM 1 100. 0. 65535. DISPLAY_IDENTIFIER CTR_COMP_RBM_SA_SAFM ECU_ADDRESS 0xd0004710 FORMAT "%5.0" /end MEASUREMENT
/begin MEASUREMENT rbm_stat_SA_SAFM.ctr_cdn_rbm "" UWORD _CNV_A_R_LINEAR_____0_CM 1 100. 0. 65535. DISPLAY_IDENTIFIER CTR_CDN_RBM_SA_SAFM ECU_ADDRESS 0xd0004712 FORMAT "%5.0" /end MEASUREMENT
/begin MEASUREMENT rbm_stat_SA_SAFM.state_ctr_rbm "" UBYTE _CNV_A_R_LINEAR_____0_CM 1 100. 0. 3. DISPLAY_IDENTIFIER STATE_CTR_RBM_SA_SAFM ECU_ADDRESS 0xd0004714 FORMAT "%3.0" /end MEASUREMENT
/begin MEASUREMENT rbm_stat_SA_SAP.ctr_comp_rbm "" UWORD _CNV_A_R_LINEAR_____0_CM 1 100. 0. 65535. DISPLAY_IDENTIFIER CTR_COMP_RBM_SA_SAP ECU_ADDRESS 0xd0004716 FORMAT "%5.0" /end MEASUREMENT
/begin MEASUREMENT rbm_stat_SA_SAP.ctr_cdn_rbm "" UWORD _CNV_A_R_LINEAR_____0_CM 1 100. 0. 65535. DISPLAY_IDENTIFIER CTR_CDN_RBM_SA_SAP ECU_ADDRESS 0xd0004718 FORMAT "%5.0" /end MEASUREMENT
/begin MEASUREMENT rbm_stat_SA_SAP.state_ctr_rbm "" UBYTE _CNV_A_R_LINEAR_____0_CM 1 100. 0. 3. DISPLAY_IDENTIFIER STATE_CTR_RBM_SA_SAP ECU_ADDRESS 0xd000471a FORMAT "%3.0" /end MEASUREMENT
/begin MEASUREMENT rbm_stat_SA_SAV.ctr_comp_rbm "" UWORD _CNV_A_R_LINEAR_____0_CM 1 100. 0. 65535. DISPLAY_IDENTIFIER CTR_COMP_RBM_SA_SAV ECU_ADDRESS 0xd000471c FORMAT "%5.0" /end MEASUREMENT
/begin MEASUREMENT rbm_stat_SA_SAV.ctr_cdn_rbm "" UWORD _CNV_A_R_LINEAR_____0_CM 1 100. 0. 65535. DISPLAY_IDENTIFIER CTR_CDN_RBM_SA_SAV ECU_ADDRESS 0xd000471e FORMAT "%5.0" /end MEASUREMENT
/begin MEASUREMENT rbm_stat_SA_SAV.state_ctr_rbm "" UBYTE _CNV_A_R_LINEAR_____0_CM 1 100. 0. 3. DISPLAY_IDENTIFIER STATE_CTR_RBM_SA_SAV ECU_ADDRESS 0xd0004720 FORMAT "%3.0" /end MEASUREMENT
/begin MEASUREMENT rbm_stat_SA_SAV_LSL.ctr_comp_rbm "" UWORD _CNV_A_R_LINEAR_____0_CM 1 100. 0. 65535. DISPLAY_IDENTIFIER CTR_COMP_RBM_SA_SAV_LSL ECU_ADDRESS 0xd0004722 FORMAT "%5.0" /end MEASUREMENT
/begin MEASUREMENT rbm_stat_SA_SAV_LSL.ctr_cdn_rbm "" UWORD _CNV_A_R_LINEAR_____0_CM 1 100. 0. 65535. DISPLAY_IDENTIFIER CTR_CDN_RBM_SA_SAV_LSL ECU_ADDRESS 0xd0004724 FORMAT "%5.0" /end MEASUREMENT
/begin MEASUREMENT rbm_stat_SA_SAV_LSL.state_ctr_rbm "" UBYTE _CNV_A_R_LINEAR_____0_CM 1 100. 0. 3. DISPLAY_IDENTIFIER STATE_CTR_RBM_SA_SAV_LSL ECU_ADDRESS 0xd0004726 FORMAT "%3.0" /end MEASUREMENT
/begin MEASUREMENT rbm_stat_SHIFT_AFL_LSL_UP_1.ctr_comp_rbm "" UWORD _CNV_A_R_LINEAR_____0_CM 1 100. 0. 65535. DISPLAY_IDENTIFIER CTR_COMP_RBM_SHIFT_AFL_LSL_UP_1 ECU_ADDRESS 0xd000472e FORMAT "%5.0" /end MEASUREMENT
/begin MEASUREMENT rbm_stat_SHIFT_AFL_LSL_UP_1.ctr_cdn_rbm "" UWORD _CNV_A_R_LINEAR_____0_CM 1 100. 0. 65535. DISPLAY_IDENTIFIER CTR_CDN_RBM_SHIFT_AFL_LSL_UP_1 ECU_ADDRESS 0xd0004730 FORMAT "%5.0" /end MEASUREMENT
/begin MEASUREMENT rbm_stat_SHIFT_AFL_LSL_UP_1.state_ctr_rbm "" UBYTE _CNV_A_R_LINEAR_____0_CM 1 100. 0. 3. DISPLAY_IDENTIFIER STATE_CTR_RBM_SHIFT_AFL_LSL_UP_1 ECU_ADDRESS 0xd0004732 FORMAT "%3.0" /end MEASUREMENT
/begin MEASUREMENT rbm_stat_SHIFT_AFL_LSL_UP_2.ctr_comp_rbm "" UWORD _CNV_A_R_LINEAR_____0_CM 1 100. 0. 65535. DISPLAY_IDENTIFIER CTR_COMP_RBM_SHIFT_AFL_LSL_UP_2 ECU_ADDRESS 0xd0004734 FORMAT "%5.0" /end MEASUREMENT
/begin MEASUREMENT rbm_stat_SHIFT_AFL_LSL_UP_2.ctr_cdn_rbm "" UWORD _CNV_A_R_LINEAR_____0_CM 1 100. 0. 65535. DISPLAY_IDENTIFIER CTR_CDN_RBM_SHIFT_AFL_LSL_UP_2 ECU_ADDRESS 0xd0004736 FORMAT "%5.0" /end MEASUREMENT
/begin MEASUREMENT rbm_stat_SHIFT_AFL_LSL_UP_2.state_ctr_rbm "" UBYTE _CNV_A_R_LINEAR_____0_CM 1 100. 0. 3. DISPLAY_IDENTIFIER STATE_CTR_RBM_SHIFT_AFL_LSL_UP_2 ECU_ADDRESS 0xd0004738 FORMAT "%3.0" /end MEASUREMENT
/begin MEASUREMENT rbm_stat_SHIFT_AFR_LSL_UP_1.ctr_comp_rbm "" UWORD _CNV_A_R_LINEAR_____0_CM 1 100. 0. 65535. DISPLAY_IDENTIFIER CTR_COMP_RBM_SHIFT_AFR_LSL_UP_1 ECU_ADDRESS 0xd000473a FORMAT "%5.0" /end MEASUREMENT
/begin MEASUREMENT rbm_stat_SHIFT_AFR_LSL_UP_1.ctr_cdn_rbm "" UWORD _CNV_A_R_LINEAR_____0_CM 1 100. 0. 65535. DISPLAY_IDENTIFIER CTR_CDN_RBM_SHIFT_AFR_LSL_UP_1 ECU_ADDRESS 0xd000473c FORMAT "%5.0" /end MEASUREMENT
/begin MEASUREMENT rbm_stat_SHIFT_AFR_LSL_UP_1.state_ctr_rbm "" UBYTE _CNV_A_R_LINEAR_____0_CM 1 100. 0. 3. DISPLAY_IDENTIFIER STATE_CTR_RBM_SHIFT_AFR_LSL_UP_1 ECU_ADDRESS 0xd000473e FORMAT "%3.0" /end MEASUREMENT
/begin MEASUREMENT rbm_stat_SHIFT_AFR_LSL_UP_2.ctr_comp_rbm "" UWORD _CNV_A_R_LINEAR_____0_CM 1 100. 0. 65535. DISPLAY_IDENTIFIER CTR_COMP_RBM_SHIFT_AFR_LSL_UP_2 ECU_ADDRESS 0xd0004740 FORMAT "%5.0" /end MEASUREMENT
/begin MEASUREMENT rbm_stat_SHIFT_AFR_LSL_UP_2.ctr_cdn_rbm "" UWORD _CNV_A_R_LINEAR_____0_CM 1 100. 0. 65535. DISPLAY_IDENTIFIER CTR_CDN_RBM_SHIFT_AFR_LSL_UP_2 ECU_ADDRESS 0xd0004742 FORMAT "%5.0" /end MEASUREMENT
/begin MEASUREMENT rbm_stat_SHIFT_AFR_LSL_UP_2.state_ctr_rbm "" UBYTE _CNV_A_R_LINEAR_____0_CM 1 100. 0. 3. DISPLAY_IDENTIFIER STATE_CTR_RBM_SHIFT_AFR_LSL_UP_2 ECU_ADDRESS 0xd0004744 FORMAT "%3.0" /end MEASUREMENT
/begin MEASUREMENT rbm_stat_TAM_PLAUS.ctr_comp_rbm "" UWORD _CNV_A_R_LINEAR_____0_CM 1 100. 0. 65535. DISPLAY_IDENTIFIER CTR_COMP_RBM_TAM_PLAUS ECU_ADDRESS 0xd0004758 FORMAT "%5.0" /end MEASUREMENT
/begin MEASUREMENT rbm_stat_TAM_PLAUS.ctr_cdn_rbm "" UWORD _CNV_A_R_LINEAR_____0_CM 1 100. 0. 65535. DISPLAY_IDENTIFIER CTR_CDN_RBM_TAM_PLAUS ECU_ADDRESS 0xd000475a FORMAT "%5.0" /end MEASUREMENT
/begin MEASUREMENT rbm_stat_TAM_PLAUS.state_ctr_rbm "" UBYTE _CNV_A_R_LINEAR_____0_CM 1 100. 0. 3. DISPLAY_IDENTIFIER STATE_CTR_RBM_TAM_PLAUS ECU_ADDRESS 0xd000475c FORMAT "%3.0" /end MEASUREMENT
/begin MEASUREMENT rbm_stat_TCO_2_PLAUS.ctr_comp_rbm "" UWORD _CNV_A_R_LINEAR_____0_CM 1 100. 0. 65535. DISPLAY_IDENTIFIER CTR_COMP_RBM_TCO_2_PLAUS ECU_ADDRESS 0xd000475e FORMAT "%5.0" /end MEASUREMENT
/begin MEASUREMENT rbm_stat_TCO_2_PLAUS.ctr_cdn_rbm "" UWORD _CNV_A_R_LINEAR_____0_CM 1 100. 0. 65535. DISPLAY_IDENTIFIER CTR_CDN_RBM_TCO_2_PLAUS ECU_ADDRESS 0xd0004760 FORMAT "%5.0" /end MEASUREMENT
/begin MEASUREMENT rbm_stat_TCO_2_PLAUS.state_ctr_rbm "" UBYTE _CNV_A_R_LINEAR_____0_CM 1 100. 0. 3. DISPLAY_IDENTIFIER STATE_CTR_RBM_TCO_2_PLAUS ECU_ADDRESS 0xd0004762 FORMAT "%3.0" /end MEASUREMENT
/begin MEASUREMENT rbm_stat_TCO_PLAUS.ctr_comp_rbm "" UWORD _CNV_A_R_LINEAR_____0_CM 1 100. 0. 65535. DISPLAY_IDENTIFIER CTR_COMP_RBM_TCO_PLAUS ECU_ADDRESS 0xd0004764 FORMAT "%5.0" /end MEASUREMENT
/begin MEASUREMENT rbm_stat_TCO_PLAUS.ctr_cdn_rbm "" UWORD _CNV_A_R_LINEAR_____0_CM 1 100. 0. 65535. DISPLAY_IDENTIFIER CTR_CDN_RBM_TCO_PLAUS ECU_ADDRESS 0xd0004766 FORMAT "%5.0" /end MEASUREMENT
/begin MEASUREMENT rbm_stat_TCO_PLAUS.state_ctr_rbm "" UBYTE _CNV_A_R_LINEAR_____0_CM 1 100. 0. 3. DISPLAY_IDENTIFIER STATE_CTR_RBM_TCO_PLAUS ECU_ADDRESS 0xd0004768 FORMAT "%3.0" /end MEASUREMENT
/begin MEASUREMENT rbm_stat_TCO_STUCK.ctr_comp_rbm "" UWORD _CNV_A_R_LINEAR_____0_CM 1 100. 0. 65535. DISPLAY_IDENTIFIER CTR_COMP_RBM_TCO_STUCK ECU_ADDRESS 0xd000476a FORMAT "%5.0" /end MEASUREMENT
/begin MEASUREMENT rbm_stat_TCO_STUCK.ctr_cdn_rbm "" UWORD _CNV_A_R_LINEAR_____0_CM 1 100. 0. 65535. DISPLAY_IDENTIFIER CTR_CDN_RBM_TCO_STUCK ECU_ADDRESS 0xd000476c FORMAT "%5.0" /end MEASUREMENT
/begin MEASUREMENT rbm_stat_TCO_STUCK.state_ctr_rbm "" UBYTE _CNV_A_R_LINEAR_____0_CM 1 100. 0. 3. DISPLAY_IDENTIFIER STATE_CTR_RBM_TCO_STUCK ECU_ADDRESS 0xd000476e FORMAT "%3.0" /end MEASUREMENT
/begin MEASUREMENT rbm_stat_VS_PLAUS.ctr_comp_rbm "" UWORD _CNV_A_R_LINEAR_____0_CM 1 100. 0. 65535. DISPLAY_IDENTIFIER CTR_COMP_RBM_VS_PLAUS ECU_ADDRESS 0xd0004794 FORMAT "%5.0" /end MEASUREMENT
/begin MEASUREMENT rbm_stat_VS_PLAUS.ctr_cdn_rbm "" UWORD _CNV_A_R_LINEAR_____0_CM 1 100. 0. 65535. DISPLAY_IDENTIFIER CTR_CDN_RBM_VS_PLAUS ECU_ADDRESS 0xd0004796 FORMAT "%5.0" /end MEASUREMENT
/begin MEASUREMENT rbm_stat_VS_PLAUS.state_ctr_rbm "" UBYTE _CNV_A_R_LINEAR_____0_CM 1 100. 0. 3. DISPLAY_IDENTIFIER STATE_CTR_RBM_VS_PLAUS ECU_ADDRESS 0xd0004798 FORMAT "%3.0" /end MEASUREMENT
/begin MEASUREMENT rbm_stat_FTL_OBD.ctr_comp_rbm "" UWORD _CNV_A_R_LINEAR_____0_CM 1 100. 0. 65535. DISPLAY_IDENTIFIER CTR_COMP_RBM_FTL_OBD ECU_ADDRESS 0xd00046bc FORMAT "%5.0" /end MEASUREMENT
/begin MEASUREMENT rbm_stat_FTL_OBD.ctr_cdn_rbm "" UWORD _CNV_A_R_LINEAR_____0_CM 1 100. 0. 65535. DISPLAY_IDENTIFIER CTR_CDN_RBM_FTL_OBD ECU_ADDRESS 0xd00046be FORMAT "%5.0" /end MEASUREMENT
/begin MEASUREMENT rbm_stat_FTL_OBD.state_ctr_rbm "" UBYTE _CNV_A_R_LINEAR_____0_CM 1 100. 0. 3. DISPLAY_IDENTIFIER STATE_CTR_RBM_FTL_OBD ECU_ADDRESS 0xd00046c0 FORMAT "%3.0" /end MEASUREMENT
/begin MEASUREMENT rbm_stat_OBD_LSH_DOWN_1.ctr_comp_rbm "" UWORD _CNV_A_R_LINEAR_____0_CM 1 100. 0. 65535. DISPLAY_IDENTIFIER CTR_COMP_RBM_OBD_LSH_DOWN_1 ECU_ADDRESS 0xd00046e6 FORMAT "%5.0" /end MEASUREMENT
/begin MEASUREMENT rbm_stat_OBD_LSH_DOWN_1.ctr_cdn_rbm "" UWORD _CNV_A_R_LINEAR_____0_CM 1 100. 0. 65535. DISPLAY_IDENTIFIER CTR_CDN_RBM_OBD_LSH_DOWN_1 ECU_ADDRESS 0xd00046e8 FORMAT "%5.0" /end MEASUREMENT
/begin MEASUREMENT rbm_stat_OBD_LSH_DOWN_1.state_ctr_rbm "" UBYTE _CNV_A_R_LINEAR_____0_CM 1 100. 0. 3. DISPLAY_IDENTIFIER STATE_CTR_RBM_OBD_LSH_DOWN_1 ECU_ADDRESS 0xd00046ea FORMAT "%3.0" /end MEASUREMENT
/begin MEASUREMENT rbm_stat_OBD_LSH_DOWN_2.ctr_comp_rbm "" UWORD _CNV_A_R_LINEAR_____0_CM 1 100. 0. 65535. DISPLAY_IDENTIFIER CTR_COMP_RBM_OBD_LSH_DOWN_2 ECU_ADDRESS 0xd00046ec FORMAT "%5.0" /end MEASUREMENT
/begin MEASUREMENT rbm_stat_OBD_LSH_DOWN_2.ctr_cdn_rbm "" UWORD _CNV_A_R_LINEAR_____0_CM 1 100. 0. 65535. DISPLAY_IDENTIFIER CTR_CDN_RBM_OBD_LSH_DOWN_2 ECU_ADDRESS 0xd00046ee FORMAT "%5.0" /end MEASUREMENT
/begin MEASUREMENT rbm_stat_OBD_LSH_DOWN_2.state_ctr_rbm "" UBYTE _CNV_A_R_LINEAR_____0_CM 1 100. 0. 3. DISPLAY_IDENTIFIER STATE_CTR_RBM_OBD_LSH_DOWN_2 ECU_ADDRESS 0xd00046f0 FORMAT "%3.0" /end MEASUREMENT
/begin MEASUREMENT rbm_stat_AMP_PLAUS.ctr_comp_rbm "" UWORD _CNV_A_R_LINEAR_____0_CM 1 100. 0. 65535. DISPLAY_IDENTIFIER CTR_COMP_RBM_AMP_PLAUS ECU_ADDRESS 0xd0004674 FORMAT "%5.0" /end MEASUREMENT
/begin MEASUREMENT rbm_stat_AMP_PLAUS.ctr_cdn_rbm "" UWORD _CNV_A_R_LINEAR_____0_CM 1 100. 0. 65535. DISPLAY_IDENTIFIER CTR_CDN_RBM_AMP_PLAUS ECU_ADDRESS 0xd0004676 FORMAT "%5.0" /end MEASUREMENT
/begin MEASUREMENT rbm_stat_AMP_PLAUS.state_ctr_rbm "" UBYTE _CNV_A_R_LINEAR_____0_CM 1 100. 0. 3. DISPLAY_IDENTIFIER STATE_CTR_RBM_AMP_PLAUS ECU_ADDRESS 0xd0004678 FORMAT "%3.0" /end MEASUREMENT
/begin MEASUREMENT rbm_stat_TIA_PLAUS.ctr_comp_rbm "" UWORD _CNV_A_R_LINEAR_____0_CM 1 100. 0. 65535. DISPLAY_IDENTIFIER CTR_COMP_RBM_TIA_PLAUS ECU_ADDRESS 0xd0004776 FORMAT "%5.0" /end MEASUREMENT
/begin MEASUREMENT rbm_stat_TIA_PLAUS.ctr_cdn_rbm "" UWORD _CNV_A_R_LINEAR_____0_CM 1 100. 0. 65535. DISPLAY_IDENTIFIER CTR_CDN_RBM_TIA_PLAUS ECU_ADDRESS 0xd0004778 FORMAT "%5.0" /end MEASUREMENT
/begin MEASUREMENT rbm_stat_TIA_PLAUS.state_ctr_rbm "" UBYTE _CNV_A_R_LINEAR_____0_CM 1 100. 0. 3. DISPLAY_IDENTIFIER STATE_CTR_RBM_TIA_PLAUS ECU_ADDRESS 0xd000477a FORMAT "%3.0" /end MEASUREMENT
/begin MEASUREMENT rbm_stat_MAF.ctr_comp_rbm "" UWORD _CNV_A_R_LINEAR_____0_CM 1 100. 0. 65535. DISPLAY_IDENTIFIER CTR_COMP_RBM_MAF ECU_ADDRESS 0xd00046ce FORMAT "%5.0" /end MEASUREMENT
/begin MEASUREMENT rbm_stat_MAF.ctr_cdn_rbm "" UWORD _CNV_A_R_LINEAR_____0_CM 1 100. 0. 65535. DISPLAY_IDENTIFIER CTR_CDN_RBM_MAF ECU_ADDRESS 0xd00046d0 FORMAT "%5.0" /end MEASUREMENT
/begin MEASUREMENT rbm_stat_MAF.state_ctr_rbm "" UBYTE _CNV_A_R_LINEAR_____0_CM 1 100. 0. 3. DISPLAY_IDENTIFIER STATE_CTR_RBM_MAF ECU_ADDRESS 0xd00046d2 FORMAT "%3.0" /end MEASUREMENT
/begin MEASUREMENT rbm_stat_ISC.ctr_comp_rbm "" UWORD _CNV_A_R_LINEAR_____0_CM 1 100. 0. 65535. DISPLAY_IDENTIFIER CTR_COMP_RBM_ISC ECU_ADDRESS 0xd00046c2 FORMAT "%5.0" /end MEASUREMENT
/begin MEASUREMENT rbm_stat_ISC.ctr_cdn_rbm "" UWORD _CNV_A_R_LINEAR_____0_CM 1 100. 0. 65535. DISPLAY_IDENTIFIER CTR_CDN_RBM_ISC ECU_ADDRESS 0xd00046c4 FORMAT "%5.0" /end MEASUREMENT
/begin MEASUREMENT rbm_stat_ISC.state_ctr_rbm "" UBYTE _CNV_A_R_LINEAR_____0_CM 1 100. 0. 3. DISPLAY_IDENTIFIER STATE_CTR_RBM_ISC ECU_ADDRESS 0xd00046c6 FORMAT "%3.0" /end MEASUREMENT
/begin MEASUREMENT rbm_stat_CS.ctr_comp_rbm "" UWORD _CNV_A_R_LINEAR_____0_CM 1 100. 0. 65535. DISPLAY_IDENTIFIER CTR_COMP_RBM_CS ECU_ADDRESS 0xd000469e FORMAT "%5.0" /end MEASUREMENT
/begin MEASUREMENT rbm_stat_CS.ctr_cdn_rbm "" UWORD _CNV_A_R_LINEAR_____0_CM 1 100. 0. 65535. DISPLAY_IDENTIFIER CTR_CDN_RBM_CS ECU_ADDRESS 0xd00046a0 FORMAT "%5.0" /end MEASUREMENT
/begin MEASUREMENT rbm_stat_CS.state_ctr_rbm "" UBYTE _CNV_A_R_LINEAR_____0_CM 1 100. 0. 3. DISPLAY_IDENTIFIER STATE_CTR_RBM_CS ECU_ADDRESS 0xd00046a2 FORMAT "%3.0" /end MEASUREMENT
/begin CHARACTERISTIC lc_rbm_clr "Reinit the rate base monitoring statistics LC_RBM_CLR 0->1" VALUE 0xa10051da _REC_VAL_20_u1 1. _CNV_A_R_LINEAR_____0_CM 0. 1. DISPLAY_IDENTIFIER LC_RBM_CLR FORMAT "%1.0" /end CHARACTERISTIC
/begin MEASUREMENT rbm_stat_SMALL_LEAK.ctr_comp_rbm "" UWORD _CNV_A_R_LINEAR_____0_CM 1 100. 0. 65535. DISPLAY_IDENTIFIER CTR_COMP_RBM_SMALL_LEAK ECU_ADDRESS 0xd0004746 FORMAT "%5.0" /end MEASUREMENT
/begin MEASUREMENT rbm_stat_SMALL_LEAK.ctr_cdn_rbm "" UWORD _CNV_A_R_LINEAR_____0_CM 1 100. 0. 65535. DISPLAY_IDENTIFIER CTR_CDN_RBM_SMALL_LEAK ECU_ADDRESS 0xd0004748 FORMAT "%5.0" /end MEASUREMENT
/begin MEASUREMENT rbm_stat_SMALL_LEAK.state_ctr_rbm "" UBYTE _CNV_A_R_LINEAR_____0_CM 1 100. 0. 3. DISPLAY_IDENTIFIER STATE_CTR_RBM_SMALL_LEAK ECU_ADDRESS 0xd000474a FORMAT "%3.0" /end MEASUREMENT
/begin MEASUREMENT rbm_stat_ROUGH_LEAK.ctr_comp_rbm "" UWORD _CNV_A_R_LINEAR_____0_CM 1 100. 0. 65535. DISPLAY_IDENTIFIER CTR_COMP_RBM_ROUGH_LEAK ECU_ADDRESS 0xd000470a FORMAT "%5.0" /end MEASUREMENT
/begin MEASUREMENT rbm_stat_ROUGH_LEAK.ctr_cdn_rbm "" UWORD _CNV_A_R_LINEAR_____0_CM 1 100. 0. 65535. DISPLAY_IDENTIFIER CTR_CDN_RBM_ROUGH_LEAK ECU_ADDRESS 0xd000470c FORMAT "%5.0" /end MEASUREMENT
/begin MEASUREMENT rbm_stat_ROUGH_LEAK.state_ctr_rbm "" UBYTE _CNV_A_R_LINEAR_____0_CM 1 100. 0. 3. DISPLAY_IDENTIFIER STATE_CTR_RBM_ROUGH_LEAK ECU_ADDRESS 0xd000470e FORMAT "%3.0" /end MEASUREMENT
/begin MEASUREMENT rbm_stat_OBD_VLD_LSH_UP_1.ctr_comp_rbm "" UWORD _CNV_A_R_LINEAR_____0_CM 1 100. 0. 65535. DISPLAY_IDENTIFIER CTR_COMP_RBM_OBD_VLD_LSH_UP_1 ECU_ADDRESS 0xd00046f2 FORMAT "%5.0" /end MEASUREMENT
/begin MEASUREMENT rbm_stat_OBD_VLD_LSH_UP_1.ctr_cdn_rbm "" UWORD _CNV_A_R_LINEAR_____0_CM 1 100. 0. 65535. DISPLAY_IDENTIFIER CTR_CDN_RBM_OBD_VLD_LSH_UP_1 ECU_ADDRESS 0xd00046f4 FORMAT "%5.0" /end MEASUREMENT
/begin MEASUREMENT rbm_stat_OBD_VLD_LSH_UP_1.state_ctr_rbm "" UBYTE _CNV_A_R_LINEAR_____0_CM 1 100. 0. 3. DISPLAY_IDENTIFIER STATE_CTR_RBM_OBD_VLD_LSH_UP_1 ECU_ADDRESS 0xd00046f6 FORMAT "%3.0" /end MEASUREMENT
/begin MEASUREMENT rbm_stat_OBD_VLD_LSH_UP_2.ctr_comp_rbm "" UWORD _CNV_A_R_LINEAR_____0_CM 1 100. 0. 65535. DISPLAY_IDENTIFIER CTR_COMP_RBM_OBD_VLD_LSH_UP_2 ECU_ADDRESS 0xd00046f8 FORMAT "%5.0" /end MEASUREMENT
/begin MEASUREMENT rbm_stat_OBD_VLD_LSH_UP_2.ctr_cdn_rbm "" UWORD _CNV_A_R_LINEAR_____0_CM 1 100. 0. 65535. DISPLAY_IDENTIFIER CTR_CDN_RBM_OBD_VLD_LSH_UP_2 ECU_ADDRESS 0xd00046fa FORMAT "%5.0" /end MEASUREMENT
/begin MEASUREMENT rbm_stat_OBD_VLD_LSH_UP_2.state_ctr_rbm "" UBYTE _CNV_A_R_LINEAR_____0_CM 1 100. 0. 3. DISPLAY_IDENTIFIER STATE_CTR_RBM_OBD_VLD_LSH_UP_2 ECU_ADDRESS 0xd00046fc FORMAT "%3.0" /end MEASUREMENT
/begin MEASUREMENT rbm_stat_TH.ctr_comp_rbm "" UWORD _CNV_A_R_LINEAR_____0_CM 1 100. 0. 65535. DISPLAY_IDENTIFIER CTR_COMP_RBM_TH ECU_ADDRESS 0xd0004770 FORMAT "%5.0" /end MEASUREMENT
/begin MEASUREMENT rbm_stat_TH.ctr_cdn_rbm "" UWORD _CNV_A_R_LINEAR_____0_CM 1 100. 0. 65535. DISPLAY_IDENTIFIER CTR_CDN_RBM_TH ECU_ADDRESS 0xd0004772 FORMAT "%5.0" /end MEASUREMENT
/begin MEASUREMENT rbm_stat_TH.state_ctr_rbm "" UBYTE _CNV_A_R_LINEAR_____0_CM 1 100. 0. 3. DISPLAY_IDENTIFIER STATE_CTR_RBM_TH ECU_ADDRESS 0xd0004774 FORMAT "%3.0" /end MEASUREMENT
/begin MEASUREMENT rbm_stat_LOAD_TPS_PLAUS.ctr_comp_rbm "" UWORD _CNV_A_R_LINEAR_____0_CM 1 100. 0. 65535. DISPLAY_IDENTIFIER CTR_COMP_RBM_LOAD_TPS_PLAUS ECU_ADDRESS 0xd00046c8 FORMAT "%5.0" /end MEASUREMENT
/begin MEASUREMENT rbm_stat_LOAD_TPS_PLAUS.ctr_cdn_rbm "" UWORD _CNV_A_R_LINEAR_____0_CM 1 100. 0. 65535. DISPLAY_IDENTIFIER CTR_CDN_RBM_LOAD_TPS_PLAUS ECU_ADDRESS 0xd00046ca FORMAT "%5.0" /end MEASUREMENT
/begin MEASUREMENT rbm_stat_LOAD_TPS_PLAUS.state_ctr_rbm "" UBYTE _CNV_A_R_LINEAR_____0_CM 1 100. 0. 3. DISPLAY_IDENTIFIER STATE_CTR_RBM_LOAD_TPS_PLAUS ECU_ADDRESS 0xd00046cc FORMAT "%3.0" /end MEASUREMENT
/begin MEASUREMENT rbm_stat_MAP_DIP_PLAUS.ctr_comp_rbm "" UWORD _CNV_A_R_LINEAR_____0_CM 1 100. 0. 65535. DISPLAY_IDENTIFIER CTR_COMP_RBM_MAP_DIP_PLAUS ECU_ADDRESS 0xd00046d4 FORMAT "%5.0" /end MEASUREMENT
/begin MEASUREMENT rbm_stat_MAP_DIP_PLAUS.ctr_cdn_rbm "" UWORD _CNV_A_R_LINEAR_____0_CM 1 100. 0. 65535. DISPLAY_IDENTIFIER CTR_CDN_RBM_MAP_DIP_PLAUS ECU_ADDRESS 0xd00046d6 FORMAT "%5.0" /end MEASUREMENT
/begin MEASUREMENT rbm_stat_MAP_DIP_PLAUS.state_ctr_rbm "" UBYTE _CNV_A_R_LINEAR_____0_CM 1 100. 0. 3. DISPLAY_IDENTIFIER STATE_CTR_RBM_MAP_DIP_PLAUS ECU_ADDRESS 0xd00046d8 FORMAT "%3.0" /end MEASUREMENT
/begin MEASUREMENT rbm_stat_VLS_DOWN_DIF_2.ctr_comp_rbm "" UWORD _CNV_A_R_LINEAR_____0_CM 1 100. 0. 65535. DISPLAY_IDENTIFIER CTR_COMP_RBM_VLS_DOWN_DIF_2 ECU_ADDRESS 0xd000478e FORMAT "%5.0" /end MEASUREMENT
/begin MEASUREMENT rbm_stat_VLS_DOWN_DIF_2.ctr_cdn_rbm "" UWORD _CNV_A_R_LINEAR_____0_CM 1 100. 0. 65535. DISPLAY_IDENTIFIER CTR_CDN_RBM_VLS_DOWN_DIF_2 ECU_ADDRESS 0xd0004790 FORMAT "%5.0" /end MEASUREMENT
/begin MEASUREMENT rbm_stat_VLS_DOWN_DIF_2.state_ctr_rbm "" UBYTE _CNV_A_R_LINEAR_____0_CM 1 100. 0. 3. DISPLAY_IDENTIFIER STATE_CTR_RBM_VLS_DOWN_DIF_2 ECU_ADDRESS 0xd0004792 FORMAT "%3.0" /end MEASUREMENT
/begin MEASUREMENT rbm_stat_VLS_DOWN_DIF_1.ctr_comp_rbm "" UWORD _CNV_A_R_LINEAR_____0_CM 1 100. 0. 65535. DISPLAY_IDENTIFIER CTR_COMP_RBM_VLS_DOWN_DIF_1 ECU_ADDRESS 0xd0004788 FORMAT "%5.0" /end MEASUREMENT
/begin MEASUREMENT rbm_stat_VLS_DOWN_DIF_1.ctr_cdn_rbm "" UWORD _CNV_A_R_LINEAR_____0_CM 1 100. 0. 65535. DISPLAY_IDENTIFIER CTR_CDN_RBM_VLS_DOWN_DIF_1 ECU_ADDRESS 0xd000478a FORMAT "%5.0" /end MEASUREMENT
/begin MEASUREMENT rbm_stat_VLS_DOWN_DIF_1.state_ctr_rbm "" UBYTE _CNV_A_R_LINEAR_____0_CM 1 100. 0. 3. DISPLAY_IDENTIFIER STATE_CTR_RBM_VLS_DOWN_DIF_1 ECU_ADDRESS 0xd000478c FORMAT "%3.0" /end MEASUREMENT
/begin MEASUREMENT rbm_stat_CHK_LS_DOWN_1.ctr_comp_rbm "" UWORD _CNV_A_R_LINEAR_____0_CM 1 100. 0. 65535. DISPLAY_IDENTIFIER CTR_COMP_RBM_CHK_LS_DOWN_1 ECU_ADDRESS 0xd0004692 FORMAT "%5.0" /end MEASUREMENT
/begin MEASUREMENT rbm_stat_CHK_LS_DOWN_1.ctr_cdn_rbm "" UWORD _CNV_A_R_LINEAR_____0_CM 1 100. 0. 65535. DISPLAY_IDENTIFIER CTR_CDN_RBM_CHK_LS_DOWN_1 ECU_ADDRESS 0xd0004694 FORMAT "%5.0" /end MEASUREMENT
/begin MEASUREMENT rbm_stat_CHK_LS_DOWN_1.state_ctr_rbm "" UBYTE _CNV_A_R_LINEAR_____0_CM 1 100. 0. 3. DISPLAY_IDENTIFIER STATE_CTR_RBM_CHK_LS_DOWN_1 ECU_ADDRESS 0xd0004696 FORMAT "%3.0" /end MEASUREMENT
/begin MEASUREMENT rbm_stat_CHK_LS_DOWN_2.ctr_comp_rbm "" UWORD _CNV_A_R_LINEAR_____0_CM 1 100. 0. 65535. DISPLAY_IDENTIFIER CTR_COMP_RBM_CHK_LS_DOWN_2 ECU_ADDRESS 0xd0004698 FORMAT "%5.0" /end MEASUREMENT
/begin MEASUREMENT rbm_stat_CHK_LS_DOWN_2.ctr_cdn_rbm "" UWORD _CNV_A_R_LINEAR_____0_CM 1 100. 0. 65535. DISPLAY_IDENTIFIER CTR_CDN_RBM_CHK_LS_DOWN_2 ECU_ADDRESS 0xd000469a FORMAT "%5.0" /end MEASUREMENT
/begin MEASUREMENT rbm_stat_CHK_LS_DOWN_2.state_ctr_rbm "" UBYTE _CNV_A_R_LINEAR_____0_CM 1 100. 0. 3. DISPLAY_IDENTIFIER STATE_CTR_RBM_CHK_LS_DOWN_2 ECU_ADDRESS 0xd000469c FORMAT "%3.0" /end MEASUREMENT
/begin MEASUREMENT rbm_stat_REF_CRK_CAM_IN_1.ctr_comp_rbm "" UWORD _CNV_A_R_LINEAR_____0_CM 1 100. 0. 65535. DISPLAY_IDENTIFIER CTR_COMP_RBM_CAT_DIAG_1 ECU_ADDRESS 0xd0004704 FORMAT "%5.0" /end MEASUREMENT
/begin MEASUREMENT rbm_stat_REF_CRK_CAM_IN_1.ctr_cdn_rbm "" UWORD _CNV_A_R_LINEAR_____0_CM 1 100. 0. 65535. DISPLAY_IDENTIFIER CTR_CDN_RBM_CAT_DIAG_1 ECU_ADDRESS 0xd0004706 FORMAT "%5.0" /end MEASUREMENT
/begin MEASUREMENT rbm_stat_REF_CRK_CAM_IN_1.state_ctr_rbm "" UBYTE _CNV_A_R_LINEAR_____0_CM 1 100. 0. 3. DISPLAY_IDENTIFIER STATE_CTR_RBM_CAT_DIAG_1 ECU_ADDRESS 0xd0004708 FORMAT "%3.0" /end MEASUREMENT
/begin MEASUREMENT rbm_stat_REF_CRK_CAM_EX_1.ctr_comp_rbm "" UWORD _CNV_A_R_LINEAR_____0_CM 1 100. 0. 65535. DISPLAY_IDENTIFIER CTR_COMP_RBM_CAT_DIAG_1 ECU_ADDRESS 0xd00046fe FORMAT "%5.0" /end MEASUREMENT
/begin MEASUREMENT rbm_stat_REF_CRK_CAM_EX_1.ctr_cdn_rbm "" UWORD _CNV_A_R_LINEAR_____0_CM 1 100. 0. 65535. DISPLAY_IDENTIFIER CTR_CDN_RBM_CAT_DIAG_1 ECU_ADDRESS 0xd0004700 FORMAT "%5.0" /end MEASUREMENT
/begin MEASUREMENT rbm_stat_REF_CRK_CAM_EX_1.state_ctr_rbm "" UBYTE _CNV_A_R_LINEAR_____0_CM 1 100. 0. 3. DISPLAY_IDENTIFIER STATE_CTR_RBM_CAT_DIAG_1 ECU_ADDRESS 0xd0004702 FORMAT "%3.0" /end MEASUREMENT
/begin MEASUREMENT rbm_stat_SWT_LS_DOWN_1.ctr_comp_rbm "" UWORD _CNV_A_R_LINEAR_____0_CM 1 100. 0. 65535. DISPLAY_IDENTIFIER CTR_COMP_RBM_CAT_DIAG_1 ECU_ADDRESS 0xd000474c FORMAT "%5.0" /end MEASUREMENT
/begin MEASUREMENT rbm_stat_SWT_LS_DOWN_1.ctr_cdn_rbm "" UWORD _CNV_A_R_LINEAR_____0_CM 1 100. 0. 65535. DISPLAY_IDENTIFIER CTR_CDN_RBM_CAT_DIAG_1 ECU_ADDRESS 0xd000474e FORMAT "%5.0" /end MEASUREMENT
/begin MEASUREMENT rbm_stat_SWT_LS_DOWN_1.state_ctr_rbm "" UBYTE _CNV_A_R_LINEAR_____0_CM 1 100. 0. 3. DISPLAY_IDENTIFIER STATE_CTR_RBM_CAT_DIAG_1 ECU_ADDRESS 0xd0004750 FORMAT "%3.0" /end MEASUREMENT
/begin MEASUREMENT rbm_stat_SWT_LS_DOWN_2.ctr_comp_rbm "" UWORD _CNV_A_R_LINEAR_____0_CM 1 100. 0. 65535. DISPLAY_IDENTIFIER CTR_COMP_RBM_CAT_DIAG_1 ECU_ADDRESS 0xd0004752 FORMAT "%5.0" /end MEASUREMENT
/begin MEASUREMENT rbm_stat_SWT_LS_DOWN_2.ctr_cdn_rbm "" UWORD _CNV_A_R_LINEAR_____0_CM 1 100. 0. 65535. DISPLAY_IDENTIFIER CTR_CDN_RBM_CAT_DIAG_1 ECU_ADDRESS 0xd0004754 FORMAT "%5.0" /end MEASUREMENT
/begin MEASUREMENT rbm_stat_SWT_LS_DOWN_2.state_ctr_rbm "" UBYTE _CNV_A_R_LINEAR_____0_CM 1 100. 0. 3. DISPLAY_IDENTIFIER STATE_CTR_RBM_CAT_DIAG_1 ECU_ADDRESS 0xd0004756 FORMAT "%3.0" /end MEASUREMENT
/begin MEASUREMENT rbm_stat_T_ES.ctr_comp_rbm "" UWORD _CNV_A_R_LINEAR_____0_CM 1 100. 0. 65535. DISPLAY_IDENTIFIER CTR_COMP_RBM_CAT_DIAG_1 ECU_ADDRESS 0xd0004782 FORMAT "%5.0" /end MEASUREMENT
/begin MEASUREMENT rbm_stat_T_ES.ctr_cdn_rbm "" UWORD _CNV_A_R_LINEAR_____0_CM 1 100. 0. 65535. DISPLAY_IDENTIFIER CTR_CDN_RBM_CAT_DIAG_1 ECU_ADDRESS 0xd0004784 FORMAT "%5.0" /end MEASUREMENT
/begin MEASUREMENT rbm_stat_T_ES.state_ctr_rbm "" UBYTE _CNV_A_R_LINEAR_____0_CM 1 100. 0. 3. DISPLAY_IDENTIFIER STATE_CTR_RBM_CAT_DIAG_1 ECU_ADDRESS 0xd0004786 FORMAT "%3.0" /end MEASUREMENT
/begin MEASUREMENT rbm_stat_TPS.ctr_comp_rbm "" UWORD _CNV_A_R_LINEAR_____0_CM 1 100. 0. 65535. DISPLAY_IDENTIFIER CTR_COMP_RBM_CAT_DIAG_1 ECU_ADDRESS 0xd000477c FORMAT "%5.0" /end MEASUREMENT
/begin MEASUREMENT rbm_stat_TPS.ctr_cdn_rbm "" UWORD _CNV_A_R_LINEAR_____0_CM 1 100. 0. 65535. DISPLAY_IDENTIFIER CTR_CDN_RBM_CAT_DIAG_1 ECU_ADDRESS 0xd000477e FORMAT "%5.0" /end MEASUREMENT
/begin MEASUREMENT rbm_stat_TPS.state_ctr_rbm "" UBYTE _CNV_A_R_LINEAR_____0_CM 1 100. 0. 3. DISPLAY_IDENTIFIER STATE_CTR_RBM_CAT_DIAG_1 ECU_ADDRESS 0xd0004780 FORMAT "%3.0" /end MEASUREMENT
/begin MEASUREMENT rbm_stat_ANG_INST_AD_VVL.ctr_comp_rbm "" UWORD _CNV_A_R_LINEAR_____0_CM 1 100. 0. 65535. DISPLAY_IDENTIFIER CTR_COMP_RBM_CAT_DIAG_1 ECU_ADDRESS 0xd0004680 FORMAT "%5.0" /end MEASUREMENT
/begin MEASUREMENT rbm_stat_ANG_INST_AD_VVL.ctr_cdn_rbm "" UWORD _CNV_A_R_LINEAR_____0_CM 1 100. 0. 65535. DISPLAY_IDENTIFIER CTR_CDN_RBM_CAT_DIAG_1 ECU_ADDRESS 0xd0004682 FORMAT "%5.0" /end MEASUREMENT
/begin MEASUREMENT rbm_stat_ANG_INST_AD_VVL.state_ctr_rbm "" UBYTE _CNV_A_R_LINEAR_____0_CM 1 100. 0. 3. DISPLAY_IDENTIFIER STATE_CTR_RBM_CAT_DIAG_1 ECU_ADDRESS 0xd0004684 FORMAT "%3.0" /end MEASUREMENT
/begin MEASUREMENT rbm_stat_ANG_CHK_MAX_VVL.ctr_comp_rbm "" UWORD _CNV_A_R_LINEAR_____0_CM 1 100. 0. 65535. DISPLAY_IDENTIFIER CTR_COMP_RBM_CAT_DIAG_1 ECU_ADDRESS 0xd000467a FORMAT "%5.0" /end MEASUREMENT
/begin MEASUREMENT rbm_stat_ANG_CHK_MAX_VVL.ctr_cdn_rbm "" UWORD _CNV_A_R_LINEAR_____0_CM 1 100. 0. 65535. DISPLAY_IDENTIFIER CTR_CDN_RBM_CAT_DIAG_1 ECU_ADDRESS 0xd000467c FORMAT "%5.0" /end MEASUREMENT
/begin MEASUREMENT rbm_stat_ANG_CHK_MAX_VVL.state_ctr_rbm "" UBYTE _CNV_A_R_LINEAR_____0_CM 1 100. 0. 3. DISPLAY_IDENTIFIER STATE_CTR_RBM_CAT_DIAG_1 ECU_ADDRESS 0xd000467e FORMAT "%3.0" /end MEASUREMENT
/begin MEASUREMENT Agr_hom "AGR Anforderung für Homogen" UWORD _CNV_R_R_Def_f_uw_b_576_CM 1 100. 0. 99.9984 DISPLAY_IDENTIFIER AGR_HOM ECU_ADDRESS 0xd0006b8e FORMAT "%8.3" /end MEASUREMENT
/begin MEASUREMENT Agr_sch "AGR Anforderung für Schicht" UWORD _CNV_R_R_Def_f_uw_b_576_CM 1 100. 0. 99.9984 DISPLAY_IDENTIFIER AGR_SCH ECU_ADDRESS 0xd0006b90 FORMAT "%8.3" /end MEASUREMENT
/begin MEASUREMENT Agr_soll "Gesamt AGR Anforderung" UWORD _CNV_R_R_Def_f_uw_b_576_CM 1 100. 0. 99.9984 DISPLAY_IDENTIFIER AGR_SOLL ECU_ADDRESS 0xd0006b8a FORMAT "%8.3" /end MEASUREMENT
/begin MEASUREMENT Agr_tra "Betriebsartabhängige AGr Anforderung" UWORD _CNV_R_R_Def_f_uw_b_576_CM 1 100. 0. 99.9984 DISPLAY_IDENTIFIER AGR_TRA ECU_ADDRESS 0xd0006b92 FORMAT "%8.3" /end MEASUREMENT
/begin MEASUREMENT Agr_w "Korrigierte AGR Anforderung" UWORD _CNV_R_R_Def_f_uw_b_576_CM 1 100. 0. 99.9984 DISPLAY_IDENTIFIER AGR_W ECU_ADDRESS 0xd0006b8c FORMAT "%8.3" /end MEASUREMENT
/begin MEASUREMENT Dlam_bs1 "Lambda-Sollwertänderung aus Bauteilschutz, Bank 1" SWORD _CNV_R_R_Def_f_sw_b_607_CM 1 100. -8. 7.9997 DISPLAY_IDENTIFIER DLAM_BS1 ECU_ADDRESS 0xc0004ce0 FORMAT "%9.4" /end MEASUREMENT
/begin MEASUREMENT Dlam_bs2 "Lambda-Sollwertänderung aus Bauteilschutz, Bank 2" SWORD _CNV_R_R_Def_f_sw_b_607_CM 1 100. -8. 7.9997 DISPLAY_IDENTIFIER DLAM_BS2 ECU_ADDRESS 0xc0004ce2 FORMAT "%9.4" /end MEASUREMENT
/begin MEASUREMENT Dlam_bs_n54 "Bauteilschutz-Vorsteuerwert für N54" UBYTE _CNV_R_R_Def_f_ub_b_609_CM 1 100. 0. 0.498 DISPLAY_IDENTIFIER DLAM_BS_N54 ECU_ADDRESS 0xc0004cc2 /end MEASUREMENT
/begin MEASUREMENT Dlam_bs_nok1 "Lambda-Sollwertänderung aus Bauteilschutz für NOx-Kat, Bank 1" SWORD _CNV_R_R_Def_f_sw_b_607_CM 1 100. -8. 7.9997 DISPLAY_IDENTIFIER DLAM_BS_NOK1 ECU_ADDRESS 0xc0004ce8 FORMAT "%9.4" /end MEASUREMENT
/begin MEASUREMENT Dlam_bs_nok2 "Lambda-Sollwertänderung aus Bauteilschutzfür NOx-Kat, Bank 2" SWORD _CNV_R_R_Def_f_sw_b_607_CM 1 100. -8. 7.9997 DISPLAY_IDENTIFIER DLAM_BS_NOK2 ECU_ADDRESS 0xc0004cee FORMAT "%9.4" /end MEASUREMENT
/begin MEASUREMENT Drfmx_ob "Delta Rfmax-Offset bei Overboost" SWORD _CNV_R_R_Def_rf_sw__616_CM 1 100. -327.68 327.67 DISPLAY_IDENTIFIER DRFMX_OB ECU_ADDRESS 0xc0000c96 FORMAT "%9.4" /end MEASUREMENT
/begin MEASUREMENT Drfmxw_ob "Delta Rfmax-Offset bei Overboost" SWORD _CNV_R_R_Def_rf_sw__616_CM 1 100. -327.68 327.67 DISPLAY_IDENTIFIER DRFMXW_OB ECU_ADDRESS 0xc0000c98 FORMAT "%9.4" /end MEASUREMENT
/begin MEASUREMENT Dt_bsnn1 "Deltatemperatur für Solltemperaturberechnung über NN-Befragung Bank 1" SWORD _CNV_R_R_Def_t_sw_q_618_CM 1 100. -3276.8 3276.7 DISPLAY_IDENTIFIER DT_BSNN1 ECU_ADDRESS 0xc0004d8a FORMAT "%6.1" /end MEASUREMENT
/begin MEASUREMENT Dt_bsnn2 "Deltatemperatur für Solltemperaturberechnung über NN-Befragung Bank 2" SWORD _CNV_R_R_Def_t_sw_q_618_CM 1 100. -3276.8 3276.7 DISPLAY_IDENTIFIER DT_BSNN2 ECU_ADDRESS 0xc0004d8c FORMAT "%6.1" /end MEASUREMENT
/begin MEASUREMENT Dta_bs1 "Abweichung Abgastemperatur vor Kat Bank 1 von Sollwert" SWORD _CNV_R_R_Def_t_sw_q_618_CM 1 100. -3276.8 3276.7 DISPLAY_IDENTIFIER DTA_BS1 ECU_ADDRESS 0xc0004ce4 FORMAT "%6.1" /end MEASUREMENT
/begin MEASUREMENT Dta_bs2 "Abweichung Abgastemperatur vor Kat Bank 2 von Sollwert" SWORD _CNV_R_R_Def_t_sw_q_618_CM 1 100. -3276.8 3276.7 DISPLAY_IDENTIFIER DTA_BS2 ECU_ADDRESS 0xc0004ce6 FORMAT "%6.1" /end MEASUREMENT
/begin MEASUREMENT Dta_bs_nok1 "Abweichung Abgastemperatur vor NOx-Kat Bank 1 von Sollwert" SWORD _CNV_R_R_Def_t_sw_q_618_CM 1 100. -3276.8 3276.7 DISPLAY_IDENTIFIER DTA_BS_NOK1 ECU_ADDRESS 0xc0004cea FORMAT "%6.1" /end MEASUREMENT
/begin MEASUREMENT Dta_bs_nok2 "Abweichung Abgastemperatur vor NOx-Kat Bank 2 von Sollwert" SWORD _CNV_R_R_Def_t_sw_q_618_CM 1 100. -3276.8 3276.7 DISPLAY_IDENTIFIER DTA_BS_NOK2 ECU_ADDRESS 0xc0004cec FORMAT "%6.1" /end MEASUREMENT
/begin MEASUREMENT Dtwr1 "Ungefilterte Rohrwandtemperatur Rohr 1" SWORD _CNV_R_R_Def_t_sw_q_620_CM 1 100. -327.68 327.67 DISPLAY_IDENTIFIER DTWR1 ECU_ADDRESS 0xc0004ee0 FORMAT "%7.2" /end MEASUREMENT
/begin MEASUREMENT Dtwr10 "Ungefilterte Rohrwandtemperatur Rohr 10" SWORD _CNV_R_R_Def_t_sw_q_620_CM 1 100. -327.68 327.67 DISPLAY_IDENTIFIER DTWR10 ECU_ADDRESS 0xc0004eee FORMAT "%7.2" /end MEASUREMENT
/begin MEASUREMENT Dtwr11 "Ungefilterte Rohrwandtemperatur Rohr 11" SWORD _CNV_R_R_Def_t_sw_q_620_CM 1 100. -327.68 327.67 DISPLAY_IDENTIFIER DTWR11 ECU_ADDRESS 0xc0004f46 FORMAT "%7.2" /end MEASUREMENT
/begin MEASUREMENT Dtwr11a "Ungefilterte Rohrwandtemperatur Rohr 11a (AGR)" SWORD _CNV_R_R_Def_t_sw_q_620_CM 1 100. -327.68 327.67 DISPLAY_IDENTIFIER DTWR11A ECU_ADDRESS 0xc0004f48 FORMAT "%7.2" /end MEASUREMENT
/begin MEASUREMENT Dtwr12 "Ungefilterte Rohrwandtemperatur Rohr 12" SWORD _CNV_R_R_Def_t_sw_q_620_CM 1 100. -327.68 327.67 DISPLAY_IDENTIFIER DTWR12 ECU_ADDRESS 0xc0004f4a FORMAT "%7.2" /end MEASUREMENT
/begin MEASUREMENT Dtwr12a "Ungefilterte Rohrwandtemperatur Rohr 12a" SWORD _CNV_R_R_Def_t_sw_q_620_CM 1 100. -327.68 327.67 DISPLAY_IDENTIFIER DTWR12A ECU_ADDRESS 0xc0004f4c FORMAT "%7.2" /end MEASUREMENT
/begin MEASUREMENT Dtwr13 "Ungefilterte Rohrwandtemperatur Rohr 13" SWORD _CNV_R_R_Def_t_sw_q_620_CM 1 100. -327.68 327.67 DISPLAY_IDENTIFIER DTWR13 ECU_ADDRESS 0xc0004f4e FORMAT "%7.2" /end MEASUREMENT
/begin MEASUREMENT Dtwr14 "Ungefilterte Rohrwandtemperatur Rohr 14" SWORD _CNV_R_R_Def_t_sw_q_620_CM 1 100. -327.68 327.67 DISPLAY_IDENTIFIER DTWR14 ECU_ADDRESS 0xc0004f50 FORMAT "%7.2" /end MEASUREMENT
/begin MEASUREMENT Dtwr14a "Ungefilterte Rohrwandtemperatur Rohr 14a" SWORD _CNV_R_R_Def_t_sw_q_620_CM 1 100. -327.68 327.67 DISPLAY_IDENTIFIER DTWR14A ECU_ADDRESS 0xc0004f52 FORMAT "%7.2" /end MEASUREMENT
/begin MEASUREMENT Dtwr15 "Ungefilterte Rohrwandtemperatur Rohr 15" SWORD _CNV_R_R_Def_t_sw_q_620_CM 1 100. -327.68 327.67 DISPLAY_IDENTIFIER DTWR15 ECU_ADDRESS 0xc0004f54 FORMAT "%7.2" /end MEASUREMENT
/begin MEASUREMENT Dtwr16 "Ungefilterte Rohrwandtemperatur Rohr 16" SWORD _CNV_R_R_Def_t_sw_q_620_CM 1 100. -327.68 327.67 DISPLAY_IDENTIFIER DTWR16 ECU_ADDRESS 0xc0004f56 FORMAT "%7.2" /end MEASUREMENT
/begin MEASUREMENT Dtwr2 "Ungefilterte Rohrwandtemperatur Rohr 2" SWORD _CNV_R_R_Def_t_sw_q_620_CM 1 100. -327.68 327.67 DISPLAY_IDENTIFIER DTWR2 ECU_ADDRESS 0xc0004ee2 FORMAT "%7.2" /end MEASUREMENT
/begin MEASUREMENT Dtwr3 "Ungefilterte Rohrwandtemperatur Rohr 3" SWORD _CNV_R_R_Def_t_sw_q_620_CM 1 100. -327.68 327.67 DISPLAY_IDENTIFIER DTWR3 ECU_ADDRESS 0xc0004ee4 FORMAT "%7.2" /end MEASUREMENT
/begin MEASUREMENT Dtwr4 "Ungefilterte Rohrwandtemperatur Rohr 4" SWORD _CNV_R_R_Def_t_sw_q_620_CM 1 100. -327.68 327.67 DISPLAY_IDENTIFIER DTWR4 ECU_ADDRESS 0xc0004ee6 FORMAT "%7.2" /end MEASUREMENT
/begin MEASUREMENT Dtwr5 "Ungefilterte Rohrwandtemperatur Rohr 5" SWORD _CNV_R_R_Def_t_sw_q_620_CM 1 100. -327.68 327.67 DISPLAY_IDENTIFIER DTWR5 ECU_ADDRESS 0xc0004efc FORMAT "%7.2" /end MEASUREMENT
/begin MEASUREMENT Dtwr6 "Ungefilterte Rohrwandtemperatur Rohr 6" SWORD _CNV_R_R_Def_t_sw_q_620_CM 1 100. -327.68 327.67 DISPLAY_IDENTIFIER DTWR6 ECU_ADDRESS 0xc0004efe FORMAT "%7.2" /end MEASUREMENT
/begin MEASUREMENT Dtwr7 "Ungefilterte Rohrwandtemperatur Rohr 7" SWORD _CNV_R_R_Def_t_sw_q_620_CM 1 100. -327.68 327.67 DISPLAY_IDENTIFIER DTWR7 ECU_ADDRESS 0xc0004ee8 FORMAT "%7.2" /end MEASUREMENT
/begin MEASUREMENT Dtwr8 "Ungefilterte Rohrwandtemperatur Rohr 8" SWORD _CNV_R_R_Def_t_sw_q_620_CM 1 100. -327.68 327.67 DISPLAY_IDENTIFIER DTWR8 ECU_ADDRESS 0xc0004eea FORMAT "%7.2" /end MEASUREMENT
/begin MEASUREMENT Dtwr9 "Ungefilterte Rohrwandtemperatur Rohr 9" SWORD _CNV_R_R_Def_t_sw_q_620_CM 1 100. -327.68 327.67 DISPLAY_IDENTIFIER DTWR9 ECU_ADDRESS 0xc0004eec FORMAT "%7.2" /end MEASUREMENT
/begin MEASUREMENT Dtwr_wg1 "Delta-Wandtemperatur Bank 1 über Wastegate N54" SWORD _CNV_R_R_Def_t_sw_q_618_CM 1 100. -3276.8 3276.7 DISPLAY_IDENTIFIER DTWR_WG1 ECU_ADDRESS 0xc0004ed8 FORMAT "%6.1" /end MEASUREMENT
/begin MEASUREMENT Dtwr_wg2 "Delta-Wandtemperatur Bank 2 über Wastegate N54" SWORD _CNV_R_R_Def_t_sw_q_618_CM 1 100. -3276.8 3276.7 DISPLAY_IDENTIFIER DTWR_WG2 ECU_ADDRESS 0xc0004eda FORMAT "%6.1" /end MEASUREMENT
/begin MEASUREMENT Exonok1 "Beitrag aus Exothermie NoX-Kat 1 zur Abgastemperatur" SWORD _CNV_R_R_Def_t_sw_q_618_CM 1 100. -3276.8 3276.7 DISPLAY_IDENTIFIER EXONOK1 ECU_ADDRESS 0xc0004f14 FORMAT "%6.1" /end MEASUREMENT
/begin MEASUREMENT Exonok2 "Beitrag aus Exothermie NoX-Kat 2 zur Abgastemperatur" SWORD _CNV_R_R_Def_t_sw_q_618_CM 1 100. -3276.8 3276.7 DISPLAY_IDENTIFIER EXONOK2 ECU_ADDRESS 0xc0004f16 FORMAT "%6.1" /end MEASUREMENT
/begin MEASUREMENT F_atlad "Atl-Regler Adaptionsfaktor" UWORD _CNV_R_R_Def_f_uw_b_579_CM 1 100. 0. 1.9999 DISPLAY_IDENTIFIER F_ATLAD ECU_ADDRESS 0xc000402c FORMAT "%14.5" /end MEASUREMENT
/begin MEASUREMENT F_atlrivst "Faktor f. Verhältnis I-Anteil d. Regelung zur Vorsteuerung - Indikator f. ATL-Zustand" SWORD _CNV_R_R_Def_f_sw_b_608_CM 1 100. -2. 1.9999 DISPLAY_IDENTIFIER F_ATLRIVST ECU_ADDRESS 0xc0000c8e FORMAT "%14.5" /end MEASUREMENT
/begin MEASUREMENT F_bs_i_nok "I-Anteil für Regler NOx-Kat" UWORD _CNV_R_R_Def_f_uw_b_579_CM 1 100. 0. 1.9999 DISPLAY_IDENTIFIER F_BS_I_NOK ECU_ADDRESS 0xc0004d0a FORMAT "%14.5" /end MEASUREMENT
/begin MEASUREMENT F_bs_p_nok "P-Anteil für Regler NOx-Kat" UWORD _CNV_R_R_Def_f_uw_b_580_CM 1 100. 0. 63.999 DISPLAY_IDENTIFIER F_BS_P_NOK ECU_ADDRESS 0xc0004d08 FORMAT "%9.4" /end MEASUREMENT
/begin MEASUREMENT F_msvld_diff "Massenstrom verteilung vor Verdichter Lader 2 zu 1" UWORD _CNV_R_R_Def_f_sw_b_608_CM 1 100. 0. 3.9999 DISPLAY_IDENTIFIER F_MSVLD_DIFF ECU_ADDRESS 0xd0006aaa FORMAT "%14.5" /end MEASUREMENT
/begin MEASUREMENT F_wg1diag "Korrekturfaktor für Plausibilitätscheck" UWORD _CNV_R_R_Def_f_uw_b_579_CM 1 100. 0. 1.9999 DISPLAY_IDENTIFIER F_WG1DIAG ECU_ADDRESS 0xd0006aac FORMAT "%14.5" /end MEASUREMENT
/begin MEASUREMENT F_wg1k_ad "adaptierter Faktor f. Wastegate 1" UWORD _CNV_R_R_Def_f_uw_b_579_CM 1 100. 0. 1.9999 DISPLAY_IDENTIFIER F_WG1K_AD ECU_ADDRESS 0xc0004030 FORMAT "%14.5" /end MEASUREMENT
/begin MEASUREMENT F_wg1k_fast "Korrekturfaktor Wastegate 1 schnell" UWORD _CNV_R_R_Def_f_uw_b_579_CM 1 100. 0. 1.9999 DISPLAY_IDENTIFIER F_WG1K_FAST ECU_ADDRESS 0xd0006aae FORMAT "%14.5" /end MEASUREMENT
/begin MEASUREMENT F_wg1kor "Korrekturfaktor Wasgate 1" UWORD _CNV_R_R_Def_f_uw_b_579_CM 1 100. 0. 1.9999 DISPLAY_IDENTIFIER F_WG1KOR ECU_ADDRESS 0xd0006aa6 FORMAT "%14.5" /end MEASUREMENT
/begin MEASUREMENT F_wg2kor "Korrekturfaktor Wasgate 2" UWORD _CNV_R_R_Def_f_uw_b_579_CM 1 100. 0. 1.9999 DISPLAY_IDENTIFIER F_WG2KOR ECU_ADDRESS 0xd0006aa8 FORMAT "%14.5" /end MEASUREMENT
/begin MEASUREMENT Fatmtmot "Temperatureinfluß vor Hauptkatalysator durch kalten Motor" SWORD _CNV_R_R_Def_cxm_sw_637_CM 1 100. -128. 127.996 DISPLAY_IDENTIFIER FATMTMOT ECU_ADDRESS 0xc0004e90 FORMAT "%8.3" /end MEASUREMENT
/begin MEASUREMENT La_bs1 "Lambda-Sollwert aus Bauteilschutz, Bank 1" UWORD _CNV_R_R_Def_f_uw_b_594_CM 1 100. 0. 15.9997 DISPLAY_IDENTIFIER LA_BS1 ECU_ADDRESS 0xc0004cc4 FORMAT "%9.4" /end MEASUREMENT
/begin MEASUREMENT La_bs2 "Lambda-Sollwert aus Bauteilschutz, Bank 2" UWORD _CNV_R_R_Def_f_uw_b_594_CM 1 100. 0. 15.9997 DISPLAY_IDENTIFIER LA_BS2 ECU_ADDRESS 0xc0004cc6 FORMAT "%9.4" /end MEASUREMENT
/begin MEASUREMENT La_bs_nn1 "Vorsteuer-Lambda aus inversem KNN, Bank 1" UWORD _CNV_R_R_Def_f_uw_b_594_CM 1 100. 0. 15.9997 DISPLAY_IDENTIFIER LA_BS_NN1 ECU_ADDRESS 0xc0004d6c FORMAT "%9.4" /end MEASUREMENT
/begin MEASUREMENT La_bs_nn1_ini "Gefilterter und begrenzter Vorsteuerwert Bank 1" UWORD _CNV_R_R_Def_f_uw_b_594_CM 1 100. 0. 15.9997 DISPLAY_IDENTIFIER LA_BS_NN1_INI ECU_ADDRESS 0xc0004cd4 FORMAT "%9.4" /end MEASUREMENT
/begin MEASUREMENT La_bs_nn2 "Vorsteuer-Lambda aus inversem KNN, Bank 2" UWORD _CNV_R_R_Def_f_uw_b_594_CM 1 100. 0. 15.9997 DISPLAY_IDENTIFIER LA_BS_NN2 ECU_ADDRESS 0xc0004d6e FORMAT "%9.4" /end MEASUREMENT
/begin MEASUREMENT La_bs_nn2_ini "Gefilterter und begrenzter Vorsteuerwert Bank 2" UWORD _CNV_R_R_Def_f_uw_b_594_CM 1 100. 0. 15.9997 DISPLAY_IDENTIFIER LA_BS_NN2_INI ECU_ADDRESS 0xc0004cd6 FORMAT "%9.4" /end MEASUREMENT
/begin MEASUREMENT La_bs_soll1 "Lambda-Sollwert aus Bauteilschutz, Bank 1" UWORD _CNV_R_R_Def_f_uw_b_594_CM 1 100. 0. 15.9997 DISPLAY_IDENTIFIER LA_BS_SOLL1 ECU_ADDRESS 0xc0004cd0 FORMAT "%9.4" /end MEASUREMENT
/begin MEASUREMENT La_bs_soll2 "Lambda-Sollwert aus Bauteilschutz, Bank 2" UWORD _CNV_R_R_Def_f_uw_b_594_CM 1 100. 0. 15.9997 DISPLAY_IDENTIFIER LA_BS_SOLL2 ECU_ADDRESS 0xc0004cd2 FORMAT "%9.4" /end MEASUREMENT
/begin MEASUREMENT La_bs_soll3 "Lambda-Sollwert aus Bauteilschutz für NOx-Kat, Bank 1" UWORD _CNV_R_R_Def_f_uw_b_594_CM 1 100. 0. 15.9997 DISPLAY_IDENTIFIER LA_BS_SOLL3 ECU_ADDRESS 0xc0004cd8 FORMAT "%9.4" /end MEASUREMENT
/begin MEASUREMENT La_bs_soll4 "Lambda-Sollwert aus Bauteilschutz für NOx-Kat, Bank 2" UWORD _CNV_R_R_Def_f_uw_b_594_CM 1 100. 0. 15.9997 DISPLAY_IDENTIFIER LA_BS_SOLL4 ECU_ADDRESS 0xc0004cda FORMAT "%9.4" /end MEASUREMENT
/begin MEASUREMENT La_vst1 "Gefilterter Lambda-Vorsteuerwert aus KNN, Bank 1" UWORD _CNV_R_R_Def_f_uw_b_594_CM 1 100. 0. 15.9997 DISPLAY_IDENTIFIER LA_VST1 ECU_ADDRESS 0xc0004cdc FORMAT "%9.4" /end MEASUREMENT
/begin MEASUREMENT La_vst2 "Gefilterter Lambda-Vorsteuerwert aus KNN, Bank 2" UWORD _CNV_R_R_Def_f_uw_b_594_CM 1 100. 0. 15.9997 DISPLAY_IDENTIFIER LA_VST2 ECU_ADDRESS 0xc0004cde FORMAT "%9.4" /end MEASUREMENT
/begin MEASUREMENT Mszyl_atm "Massenstrom Zylinder über 200ms gemittelt" UWORD _CNV_R_R_Def_ms_uw__611_CM 1 100. 0. 2047.9687 DISPLAY_IDENTIFIER MSZYL_ATM ECU_ADDRESS 0xc0004e4a FORMAT "%8.3" /end MEASUREMENT
/begin MEASUREMENT Mszyl_bank "Massenstrom in einer Zylinderbank" UWORD _CNV_R_R_Def_ms_uw__611_CM 1 100. 0. 2047.9687 DISPLAY_IDENTIFIER MSZYL_BANK ECU_ADDRESS 0xc0004ede FORMAT "%8.3" /end MEASUREMENT
/begin MEASUREMENT Mszyl_ges_atm "Massenstrom gesamt ATM" UWORD _CNV_R_R_Def_ms_uw__611_CM 1 100. 0. 2047.9687 DISPLAY_IDENTIFIER MSZYL_GES_ATM ECU_ADDRESS 0xc0004f0a FORMAT "%8.3" /end MEASUREMENT
/begin MEASUREMENT Mszyl_int "Mszyl aufintegriert während SA" UWORD _CNV_R_R_Def_m_uw_q_666_CM 1 100. 0. 20.0229 DISPLAY_IDENTIFIER MSZYL_INT ECU_ADDRESS 0xc0004d88 FORMAT "%9.4" /end MEASUREMENT
/begin MEASUREMENT Mszyl_nagr "Massenstrom in Bank 1 abzüglich AGR-Massenstrom" UWORD _CNV_R_R_Def_ms_uw__611_CM 1 100. 0. 2047.9687 DISPLAY_IDENTIFIER MSZYL_NAGR ECU_ADDRESS 0xc0004f08 FORMAT "%8.3" /end MEASUREMENT
/begin MEASUREMENT Mszyl_rohr "Massenstrom in einem Abgaskrümmer" UWORD _CNV_R_R_Def_ms_uw__611_CM 1 100. 0. 2047.9687 DISPLAY_IDENTIFIER MSZYL_ROHR ECU_ADDRESS 0xc0004edc FORMAT "%8.3" /end MEASUREMENT
/begin MEASUREMENT Nkw_atm "Motordrehzahl an der Kurbelwelle gemittelt über 200ms für ATM" SWORD _CNV_R_R_Def_n_sw_q_612_CM 1 100. -32768. 32767. DISPLAY_IDENTIFIER NKW_ATM ECU_ADDRESS 0xc0004d94 FORMAT "%5.0" /end MEASUREMENT
/begin MEASUREMENT Nok_ta_1 "Zeitkonstante Filter für Innentemperatur NoX-Kat 1" UWORD _CNV_R_R_Def_td_uw__592_CM 1 100. 0. 65.535 DISPLAY_IDENTIFIER NOK_TA_1 ECU_ADDRESS 0xc0004f0c FORMAT "%8.3" /end MEASUREMENT
/begin MEASUREMENT Nok_ta_2 "Zeitkonstante Filter für Innentemperatur NoX-Kat 2" UWORD _CNV_R_R_Def_td_uw__592_CM 1 100. 0. 65.535 DISPLAY_IDENTIFIER NOK_TA_2 ECU_ADDRESS 0xc0004f0e FORMAT "%8.3" /end MEASUREMENT
/begin MEASUREMENT Nok_tb_1 "Zeitkonstante Filter für Temperatur nach NoX-Kat 1" UWORD _CNV_R_R_Def_td_uw__592_CM 1 100. 0. 65.535 DISPLAY_IDENTIFIER NOK_TB_1 ECU_ADDRESS 0xc0004f10 FORMAT "%8.3" /end MEASUREMENT
/begin MEASUREMENT Nok_tb_2 "Zeitkonstante Filter für Temperatur nach NoX-Kat 2" UWORD _CNV_R_R_Def_td_uw__592_CM 1 100. 0. 65.535 DISPLAY_IDENTIFIER NOK_TB_2 ECU_ADDRESS 0xc0004f12 FORMAT "%8.3" /end MEASUREMENT
/begin MEASUREMENT Rf_atm "Relative Luftfuellung gemittelt über 200ms für ATM" SWORD _CNV_R_R_Def_rf_sw__616_CM 1 100. -327.68 327.67 DISPLAY_IDENTIFIER RF_ATM ECU_ADDRESS 0xc0004d92 FORMAT "%9.4" /end MEASUREMENT
/begin MEASUREMENT St_agrko "Statuswort" UBYTE _CNV_R_R_Def_dez_sl_575_CM 1 100. 0. 255. DISPLAY_IDENTIFIER ST_AGRKO ECU_ADDRESS 0xd0006b88 FORMAT "%3.0" /end MEASUREMENT
/begin MEASUREMENT St_agrko.B_agr_aus "Bedingung AGR ist ausgeschaltet" UBYTE _CNV_S_1_Def_bit_ub_700_CM 1 100. 0. 0. DISPLAY_IDENTIFIER B_AGR_AUS ECU_ADDRESS 0xd0006b88 BIT_MASK 0x1 /end MEASUREMENT
/begin MEASUREMENT St_agrko.B_agr_hom "Quittung Homogenbetrieb vom AGR ist möglich" UBYTE _CNV_S_1_Def_bit_ub_700_CM 1 100. 0. 0. DISPLAY_IDENTIFIER B_AGR_HOM ECU_ADDRESS 0xd0006b88 BIT_MASK 0x2 /end MEASUREMENT
/begin MEASUREMENT St_agrko.B_agr_hs "Quittung Homogenschichtbetrieb vom AGR ist möglich" UBYTE _CNV_S_1_Def_bit_ub_700_CM 1 100. 0. 0. DISPLAY_IDENTIFIER B_AGR_HS ECU_ADDRESS 0xd0006b88 BIT_MASK 0x4 /end MEASUREMENT
/begin MEASUREMENT St_agrko.B_agr_sch "Quittung Schichtbetrieb vom AGR ist möglich" UBYTE _CNV_S_1_Def_bit_ub_700_CM 1 100. 0. 0. DISPLAY_IDENTIFIER B_AGR_SCH ECU_ADDRESS 0xd0006b88 BIT_MASK 0x8 /end MEASUREMENT
/begin MEASUREMENT St_atlad "Statuswort" UBYTE _CNV_R_R_Def_dez_sl_575_CM 1 100. 0. 255. DISPLAY_IDENTIFIER ST_ATLAD ECU_ADDRESS 0xc0000c8c FORMAT "%3.0" /end MEASUREMENT
/begin MEASUREMENT St_atlad.B_atlad "ATL-Regler Adaption aktiv" UBYTE _CNV_S_1_Def_bit_ub_700_CM 1 100. 0. 0. DISPLAY_IDENTIFIER B_ATLAD ECU_ADDRESS 0xc0000c8c BIT_MASK 0x1 /end MEASUREMENT
/begin MEASUREMENT St_atldiag_10ms "Statuswort" UBYTE _CNV_R_R_Def_dez_sl_575_CM 1 100. 0. 255. DISPLAY_IDENTIFIER ST_ATLDIAG_10MS ECU_ADDRESS 0xd0006a8c FORMAT "%3.0" /end MEASUREMENT
/begin MEASUREMENT St_atldiag_10ms.B_atllekfast "ATL Leckage schnell - erkannt" UBYTE _CNV_S_1_Def_bit_ub_700_CM 1 100. 0. 0. DISPLAY_IDENTIFIER B_ATLLEKFAST ECU_ADDRESS 0xd0006a8c BIT_MASK 0x2 /end MEASUREMENT
/begin MEASUREMENT St_atldiag_10ms.B_atlr_errmn "Reglerfehler - negative Richtung" UBYTE _CNV_S_1_Def_bit_ub_700_CM 1 100. 0. 0. DISPLAY_IDENTIFIER B_ATLR_ERRMN ECU_ADDRESS 0xd0006a8c BIT_MASK 0x4 /end MEASUREMENT
/begin MEASUREMENT St_atldiag_10ms.B_atlr_errmx "Reglerfehler - positive Richtung" UBYTE _CNV_S_1_Def_bit_ub_700_CM 1 100. 0. 0. DISPLAY_IDENTIFIER B_ATLR_ERRMX ECU_ADDRESS 0xd0006a8c BIT_MASK 0x8 /end MEASUREMENT
/begin MEASUREMENT St_atldiag_10ms.B_beratllek "ATL Leckageerkennung aktiv" UBYTE _CNV_S_1_Def_bit_ub_700_CM 1 100. 0. 0. DISPLAY_IDENTIFIER B_BERATLLEK ECU_ADDRESS 0xd0006a8c BIT_MASK 0x1 /end MEASUREMENT
/begin MEASUREMENT St_atldiag_10ms.B_pld_errmn "negative Regelabweichung unterschritten" UBYTE _CNV_S_1_Def_bit_ub_700_CM 1 100. 0. 0. DISPLAY_IDENTIFIER B_PLD_ERRMN ECU_ADDRESS 0xd0006a8c BIT_MASK 0x10 /end MEASUREMENT
/begin MEASUREMENT St_atldiag_10ms.B_pld_errmx "positive Regelabweichung überschritten" UBYTE _CNV_S_1_Def_bit_ub_700_CM 1 100. 0. 0. DISPLAY_IDENTIFIER B_PLD_ERRMX ECU_ADDRESS 0xd0006a8c BIT_MASK 0x20 /end MEASUREMENT
/begin MEASUREMENT St_atldiag_tmp "Statuswort" UBYTE _CNV_R_R_Def_dez_sl_575_CM 1 100. 0. 255. DISPLAY_IDENTIFIER ST_ATLDIAG_TMP ECU_ADDRESS 0xd0006a8d FORMAT "%3.0" /end MEASUREMENT
/begin MEASUREMENT St_atldiag_tmp.B_fi_atllekfast "Fehler Leckage" UBYTE _CNV_S_1_Def_bit_ub_700_CM 1 100. 0. 0. DISPLAY_IDENTIFIER B_FI_ATLLEKFAST ECU_ADDRESS 0xd0006a8d BIT_MASK 0x1 /end MEASUREMENT
/begin MEASUREMENT St_atldiag_tmp.B_fi_atlrmn "Fehler Systemdiagnose" UBYTE _CNV_S_1_Def_bit_ub_700_CM 1 100. 0. 0. DISPLAY_IDENTIFIER B_FI_ATLRMN ECU_ADDRESS 0xd0006a8d BIT_MASK 0x2 /end MEASUREMENT
/begin MEASUREMENT St_atldiag_tmp.B_fi_atlrmx "Fehler Systemdiagnose" UBYTE _CNV_S_1_Def_bit_ub_700_CM 1 100. 0. 0. DISPLAY_IDENTIFIER B_FI_ATLRMX ECU_ADDRESS 0xd0006a8d BIT_MASK 0x4 /end MEASUREMENT
/begin MEASUREMENT St_atlgls "Statuswort" UBYTE _CNV_R_R_Def_dez_sl_575_CM 1 100. 0. 255. DISPLAY_IDENTIFIER ST_ATLGLS ECU_ADDRESS 0xd0006aa4 FORMAT "%3.0" /end MEASUREMENT
/begin MEASUREMENT St_atlgls.B_atlgls_pl "Gleichlaufstellung - Plausibilitätscheck aktiv" UBYTE _CNV_S_1_Def_bit_ub_700_CM 1 100. 0. 0. DISPLAY_IDENTIFIER B_ATLGLS_PL ECU_ADDRESS 0xd0006aa4 BIT_MASK 0x1 /end MEASUREMENT
/begin MEASUREMENT St_atlgls.B_fi_atlgls "Fehler Gleichlaufsteuerung" UBYTE _CNV_S_1_Def_bit_ub_700_CM 1 100. 0. 0. DISPLAY_IDENTIFIER B_FI_ATLGLS ECU_ADDRESS 0xd0006aa4 BIT_MASK 0x20 /end MEASUREMENT
/begin MEASUREMENT St_atlgls.B_wg1plmn "Wastegate 1 Min -plausibel" UBYTE _CNV_S_1_Def_bit_ub_700_CM 1 100. 0. 0. DISPLAY_IDENTIFIER B_WG1PLMN ECU_ADDRESS 0xd0006aa4 BIT_MASK 0x2 /end MEASUREMENT
/begin MEASUREMENT St_atlgls.B_wg1plmn2 "Wastegate 1 Min -plausibel" UBYTE _CNV_S_1_Def_bit_ub_700_CM 1 100. 0. 0. DISPLAY_IDENTIFIER B_WG1PLMN2 ECU_ADDRESS 0xd0006aa4 BIT_MASK 0x8 /end MEASUREMENT
/begin MEASUREMENT St_atlgls.B_wg1plmx "Wastegate 1 Max -plausibel" UBYTE _CNV_S_1_Def_bit_ub_700_CM 1 100. 0. 0. DISPLAY_IDENTIFIER B_WG1PLMX ECU_ADDRESS 0xd0006aa4 BIT_MASK 0x4 /end MEASUREMENT
/begin MEASUREMENT St_atlgls.B_wg1plmx2 "Wastegate 1 Max -plausibel" UBYTE _CNV_S_1_Def_bit_ub_700_CM 1 100. 0. 0. DISPLAY_IDENTIFIER B_WG1PLMX2 ECU_ADDRESS 0xd0006aa4 BIT_MASK 0x10 /end MEASUREMENT
/begin MEASUREMENT St_atlob "Statuswort" UBYTE _CNV_R_R_Def_dez_sl_575_CM 1 100. 0. 255. DISPLAY_IDENTIFIER ST_ATLOB ECU_ADDRESS 0xd00069d0 FORMAT "%3.0" /end MEASUREMENT
/begin MEASUREMENT St_atlob.B_atlob "Statuswort" UBYTE _CNV_S_1_Def_bit_ub_700_CM 1 100. 0. 0. DISPLAY_IDENTIFIER B_ATLOB ECU_ADDRESS 0xd00069d0 BIT_MASK 0x2 /end MEASUREMENT
/begin MEASUREMENT St_atlob.B_atlob_sp "Statuswort" UBYTE _CNV_S_1_Def_bit_ub_700_CM 1 100. 0. 0. DISPLAY_IDENTIFIER B_ATLOB_SP ECU_ADDRESS 0xd00069d0 BIT_MASK 0x4 /end MEASUREMENT
/begin MEASUREMENT St_atlob.B_atlreg "Statuswort" UBYTE _CNV_S_1_Def_bit_ub_700_CM 1 100. 0. 0. DISPLAY_IDENTIFIER B_ATLREG ECU_ADDRESS 0xd00069d0 BIT_MASK 0x1 /end MEASUREMENT
/begin MEASUREMENT St_atlob.B_ldo_err "Statuswort" UBYTE _CNV_S_1_Def_bit_ub_700_CM 1 100. 0. 0. DISPLAY_IDENTIFIER B_LDO_ERR ECU_ADDRESS 0xd00069d0 BIT_MASK 0x8 /end MEASUREMENT
/begin MEASUREMENT St_atlob_intern "Statuswort" UBYTE _CNV_R_R_Def_dez_sl_575_CM 1 100. 0. 255. DISPLAY_IDENTIFIER ST_ATLOB_INTERN ECU_ADDRESS 0xc0000c94 FORMAT "%3.0" /end MEASUREMENT
/begin MEASUREMENT St_atlob_intern.B_atlob_akt "Statuswort" UBYTE _CNV_S_1_Def_bit_ub_700_CM 1 100. 0. 0. DISPLAY_IDENTIFIER B_ATLOB_AKT ECU_ADDRESS 0xc0000c94 BIT_MASK 0x4 /end MEASUREMENT
/begin MEASUREMENT St_atlob_intern.B_atlob_end "Statuswort" UBYTE _CNV_S_1_Def_bit_ub_700_CM 1 100. 0. 0. DISPLAY_IDENTIFIER B_ATLOB_END ECU_ADDRESS 0xc0000c94 BIT_MASK 0x8 /end MEASUREMENT
/begin MEASUREMENT St_atlob_intern.B_atlstdby "Änderung Soll-Ladedruck" UBYTE _CNV_S_1_Def_bit_ub_700_CM 1 100. 0. 0. DISPLAY_IDENTIFIER B_ATLSTDBY ECU_ADDRESS 0xc0000c94 BIT_MASK 0x1 /end MEASUREMENT
/begin MEASUREMENT St_atlob_intern.B_atlstrg "Soll-Ladedruck nicht begrenzt" UBYTE _CNV_S_1_Def_bit_ub_700_CM 1 100. 0. 0. DISPLAY_IDENTIFIER B_ATLSTRG ECU_ADDRESS 0xc0000c94 BIT_MASK 0x2 /end MEASUREMENT
/begin MEASUREMENT St_atlout "Statuswort" UBYTE _CNV_R_R_Def_dez_sl_575_CM 1 100. 0. 255. DISPLAY_IDENTIFIER ST_ATLOUT ECU_ADDRESS 0xd00069d4 FORMAT "%3.0" /end MEASUREMENT
/begin MEASUREMENT St_atlout.B_wg1_auf "Wastegate 1 geöffnet" UBYTE _CNV_S_1_Def_bit_ub_700_CM 1 100. 0. 0. DISPLAY_IDENTIFIER B_WG1_AUF ECU_ADDRESS 0xd00069d4 BIT_MASK 0x1 /end MEASUREMENT
/begin MEASUREMENT St_atlout.B_wg2_auf "Wastegate 2 geöffnet" UBYTE _CNV_S_1_Def_bit_ub_700_CM 1 100. 0. 0. DISPLAY_IDENTIFIER B_WG2_AUF ECU_ADDRESS 0xd00069d4 BIT_MASK 0x2 /end MEASUREMENT
/begin MEASUREMENT St_atlpump "Statuswort" UBYTE _CNV_R_R_Def_dez_sl_575_CM 1 100. 0. 255. DISPLAY_IDENTIFIER ST_ATLPUMP ECU_ADDRESS 0xd0006ac4 FORMAT "%3.0" /end MEASUREMENT
/begin MEASUREMENT St_atlpump.B_atlpump1 "Lader1 pumpt" UBYTE _CNV_S_1_Def_bit_ub_700_CM 1 100. 0. 0. DISPLAY_IDENTIFIER B_ATLPUMP1 ECU_ADDRESS 0xd0006ac4 BIT_MASK 0x2 /end MEASUREMENT
/begin MEASUREMENT St_atlpump.B_atlpump2 "Lader 2 pumpt" UBYTE _CNV_S_1_Def_bit_ub_700_CM 1 100. 0. 0. DISPLAY_IDENTIFIER B_ATLPUMP2 ECU_ADDRESS 0xd0006ac4 BIT_MASK 0x4 /end MEASUREMENT
/begin MEASUREMENT St_atlpump.B_beratlpump "Berstimmung ATL-Pumpen aktiv" UBYTE _CNV_S_1_Def_bit_ub_700_CM 1 100. 0. 0. DISPLAY_IDENTIFIER B_BERATLPUMP ECU_ADDRESS 0xd0006ac4 BIT_MASK 0x1 /end MEASUREMENT
/begin MEASUREMENT St_atmnn "Statuswort ATMNN" UBYTE _CNV_R_R_Def_dez_sl_575_CM 1 100. 0. 255. DISPLAY_IDENTIFIER ST_ATMNN ECU_ADDRESS 0xc0004d50 FORMAT "%3.0" /end MEASUREMENT
/begin MEASUREMENT St_atmnn.B_sa_akt "Bedingung Schubabschaltung aktiv" UBYTE _CNV_S_1_Def_bit_ub_700_CM 1 100. 0. 0. DISPLAY_IDENTIFIER B_SA_AKT ECU_ADDRESS 0xc0004d50 BIT_MASK 0x1 /end MEASUREMENT
/begin MEASUREMENT St_atmphintern "Status ATMPH (intern)" UBYTE _CNV_R_R_Def_dez_sl_575_CM 1 100. 0. 255. DISPLAY_IDENTIFIER ST_ATMPHINTERN ECU_ADDRESS 0xc0004e1c FORMAT "%3.0" /end MEASUREMENT
/begin MEASUREMENT St_atmphintern.B_atmphreset "Reset ATMPH" UBYTE _CNV_S_1_Def_bit_ub_700_CM 1 100. 0. 0. DISPLAY_IDENTIFIER B_ATMPHRESET ECU_ADDRESS 0xc0004e1c BIT_MASK 0x1 /end MEASUREMENT
/begin MEASUREMENT St_atmphintern.B_er_lklps "verzögerte modifizierte Bedingung Lüfterklappensteuerung" UBYTE _CNV_S_1_Def_bit_ub_700_CM 1 100. 0. 0. DISPLAY_IDENTIFIER B_ER_LKLPS ECU_ADDRESS 0xc0004e1c BIT_MASK 0x8 /end MEASUREMENT
/begin MEASUREMENT St_atmphintern.B_lklps_atm "modifizierte Bedingung Lüfterklappensteuerung" UBYTE _CNV_S_1_Def_bit_ub_700_CM 1 100. 0. 0. DISPLAY_IDENTIFIER B_LKLPS_ATM ECU_ADDRESS 0xc0004e1c BIT_MASK 0x4 /end MEASUREMENT
/begin MEASUREMENT St_atmphintern.B_motoraus "Fallende Flanke B_startende" UBYTE _CNV_S_1_Def_bit_ub_700_CM 1 100. 0. 0. DISPLAY_IDENTIFIER B_MOTORAUS ECU_ADDRESS 0xc0004e1c BIT_MASK 0x2 /end MEASUREMENT
/begin MEASUREMENT St_edge_rising "Status ATMPH (intern: steigende Flanken)" UBYTE _CNV_R_R_Def_dez_sl_575_CM 1 100. 0. 255. DISPLAY_IDENTIFIER ST_EDGE_RISING ECU_ADDRESS 0xc0004e1d FORMAT "%3.0" /end MEASUREMENT
/begin MEASUREMENT St_edge_rising.B_ef_sa "Fallende Flanke B_sa liegt vor" UBYTE _CNV_S_1_Def_bit_ub_700_CM 1 100. 0. 0. DISPLAY_IDENTIFIER B_EF_SA ECU_ADDRESS 0xc0004e1d BIT_MASK 0x8 /end MEASUREMENT
/begin MEASUREMENT St_edge_rising.B_er_atm_reset "Steigende Flanke B_atmphreset liegt vor" UBYTE _CNV_S_1_Def_bit_ub_700_CM 1 100. 0. 0. DISPLAY_IDENTIFIER B_ER_ATM_RESET ECU_ADDRESS 0xc0004e1d BIT_MASK 0x2 /end MEASUREMENT
/begin MEASUREMENT St_edge_rising.B_er_sa "Steigende Flanke B_sa liegt vor" UBYTE _CNV_S_1_Def_bit_ub_700_CM 1 100. 0. 0. DISPLAY_IDENTIFIER B_ER_SA ECU_ADDRESS 0xc0004e1d BIT_MASK 0x4 /end MEASUREMENT
/begin MEASUREMENT St_edge_rising.B_er_startende "Steigende Flanke B_startende liegt vor" UBYTE _CNV_S_1_Def_bit_ub_700_CM 1 100. 0. 0. DISPLAY_IDENTIFIER B_ER_STARTENDE ECU_ADDRESS 0xc0004e1d BIT_MASK 0x1 /end MEASUREMENT
/begin MEASUREMENT St_edge_rising.B_sa_atmph "Verzögertes Signal B_sa (nur Ausschaltverzögerung)" UBYTE _CNV_S_1_Def_bit_ub_700_CM 1 100. 0. 0. DISPLAY_IDENTIFIER B_SA_ATMPH ECU_ADDRESS 0xc0004e1d BIT_MASK 0x10 /end MEASUREMENT
/begin MEASUREMENT St_reg_bs1 "Statuswert Bauteilschutzregler Bank 1" UBYTE _CNV_R_R_Def_dez_sl_575_CM 1 100. 0. 255. DISPLAY_IDENTIFIER ST_REG_BS1 ECU_ADDRESS 0xc0004ccb FORMAT "%3.0" /end MEASUREMENT
/begin MEASUREMENT St_reg_bs2 "Statuswert Bauteilschutzregler Bank 2" UBYTE _CNV_R_R_Def_dez_sl_575_CM 1 100. 0. 255. DISPLAY_IDENTIFIER ST_REG_BS2 ECU_ADDRESS 0xc0004ccc FORMAT "%3.0" /end MEASUREMENT
/begin MEASUREMENT St_reg_bs3 "Statuswert Bauteilschutzregler für NOx-Kat Bank 1" UBYTE _CNV_R_R_Def_dez_sl_575_CM 1 100. 0. 255. DISPLAY_IDENTIFIER ST_REG_BS3 ECU_ADDRESS 0xc0004ccd FORMAT "%3.0" /end MEASUREMENT
/begin MEASUREMENT St_reg_bs4 "Statuswert Bauteilschutzregler für NOx-Kat Bank 2" UBYTE _CNV_R_R_Def_dez_sl_575_CM 1 100. 0. 255. DISPLAY_IDENTIFIER ST_REG_BS4 ECU_ADDRESS 0xc0004cce FORMAT "%3.0" /end MEASUREMENT
/begin MEASUREMENT St_sa_atmph "Statusbyte Ausgang Schubabschaltung von ATMPH" UBYTE _CNV_R_R_Def_dez_sl_575_CM 1 100. 0. 255. DISPLAY_IDENTIFIER ST_SA_ATMPH ECU_ADDRESS 0xc0004e1e FORMAT "%3.0" /end MEASUREMENT
/begin MEASUREMENT St_sa_atmph.B_vb_sa "Schubabschalten verboten wg. niedriger KatTemp." UBYTE _CNV_S_1_Def_bit_ub_700_CM 1 100. 0. 0. DISPLAY_IDENTIFIER B_VB_SA ECU_ADDRESS 0xc0004e1e BIT_MASK 0x40 /end MEASUREMENT
/begin MEASUREMENT St_sa_atmph.B_vb_sa_nk "Schubabschalten verboten wg. niedriger NoX-KatTemp." UBYTE _CNV_S_1_Def_bit_ub_700_CM 1 100. 0. 0. DISPLAY_IDENTIFIER B_VB_SA_NK ECU_ADDRESS 0xc0004e1e BIT_MASK 0x80 /end MEASUREMENT
/begin MEASUREMENT St_testbs "Statusbyte Bauteilschutz Fehlerbits" UBYTE _CNV_R_R_Def_dez_sl_575_CM 1 100. 0. 255. DISPLAY_IDENTIFIER ST_TESTBS ECU_ADDRESS 0xc0004cc1 FORMAT "%3.0" /end MEASUREMENT
/begin MEASUREMENT St_testbs.B_FI_HFM "Bedingung FI_HFM aktiv" UBYTE _CNV_S_1_Def_bit_ub_700_CM 1 100. 0. 0. DISPLAY_IDENTIFIER B_FI_HFM ECU_ADDRESS 0xc0004cc1 BIT_MASK 0x2 /end MEASUREMENT
/begin MEASUREMENT St_testbs.B_FI_HFMPL "Bedingung FI_HFMPL aktiv" UBYTE _CNV_S_1_Def_bit_ub_700_CM 1 100. 0. 0. DISPLAY_IDENTIFIER B_FI_HFMPL ECU_ADDRESS 0xc0004cc1 BIT_MASK 0x1 /end MEASUREMENT
/begin MEASUREMENT St_testbs.B_FI_PUS "Bedingung FI_PUS aktiv" UBYTE _CNV_S_1_Def_bit_ub_700_CM 1 100. 0. 0. DISPLAY_IDENTIFIER B_FI_PUS ECU_ADDRESS 0xc0004cc1 BIT_MASK 0x40 /end MEASUREMENT
/begin MEASUREMENT St_testbs.B_FI_TANS "Bedingung FI_TANS aktiv" UBYTE _CNV_S_1_Def_bit_ub_700_CM 1 100. 0. 0. DISPLAY_IDENTIFIER B_FI_TANS ECU_ADDRESS 0xc0004cc1 BIT_MASK 0x8 /end MEASUREMENT
/begin MEASUREMENT St_testbs.B_FI_TKA "Bedingung FI_TKA aktiv" UBYTE _CNV_S_1_Def_bit_ub_700_CM 1 100. 0. 0. DISPLAY_IDENTIFIER B_FI_TKA ECU_ADDRESS 0xc0004cc1 BIT_MASK 0x10 /end MEASUREMENT
/begin MEASUREMENT St_testbs.B_FI_TMOT "Bedingung FI_TMOT aktiv" UBYTE _CNV_S_1_Def_bit_ub_700_CM 1 100. 0. 0. DISPLAY_IDENTIFIER B_FI_TMOT ECU_ADDRESS 0xc0004cc1 BIT_MASK 0x20 /end MEASUREMENT
/begin MEASUREMENT St_testbs.B_FI_VFZ "Bedingung FI_VFZ aktiv" UBYTE _CNV_S_1_Def_bit_ub_700_CM 1 100. 0. 0. DISPLAY_IDENTIFIER B_FI_VFZ ECU_ADDRESS 0xc0004cc1 BIT_MASK 0x4 /end MEASUREMENT
/begin MEASUREMENT St_zwbts1 "Statusbyte Bauteilschutzfunktion" UBYTE _CNV_R_R_Def_dez_sl_575_CM 1 100. 0. 255. DISPLAY_IDENTIFIER ST_ZWBTS1 ECU_ADDRESS 0xc0004cc0 FORMAT "%3.0" /end MEASUREMENT
/begin MEASUREMENT St_zwbts1.B_bs1 "Bedingung Bauteilschutz Bank 1 aktiv" UBYTE _CNV_S_1_Def_bit_ub_700_CM 1 100. 0. 0. DISPLAY_IDENTIFIER B_BS1 ECU_ADDRESS 0xc0004cc0 BIT_MASK 0x1 /end MEASUREMENT
/begin MEASUREMENT St_zwbts1.B_bs2 "Bedingung Bauteilschutz Bank 2 aktiv" UBYTE _CNV_S_1_Def_bit_ub_700_CM 1 100. 0. 0. DISPLAY_IDENTIFIER B_BS2 ECU_ADDRESS 0xc0004cc0 BIT_MASK 0x2 /end MEASUREMENT
/begin MEASUREMENT St_zwbts1.B_bsmager "Magerer Bauteilschutzmodus aktiv" UBYTE _CNV_S_1_Def_bit_ub_700_CM 1 100. 0. 0. DISPLAY_IDENTIFIER B_BSMAGER ECU_ADDRESS 0xc0004cc0 BIT_MASK 0x4 /end MEASUREMENT
/begin MEASUREMENT St_zwbtsakt "Statusbyte Bauteilschutzfunktion" UBYTE _CNV_R_R_Def_dez_sl_575_CM 1 100. 0. 255. DISPLAY_IDENTIFIER ST_ZWBTSAKT ECU_ADDRESS 0xc0004cca FORMAT "%3.0" /end MEASUREMENT
/begin MEASUREMENT St_zwbtsakt.B_bsakt1 "Bedingung Bauteilschutz Bank 1 aktiv" UBYTE _CNV_S_1_Def_bit_ub_700_CM 1 100. 0. 0. DISPLAY_IDENTIFIER B_BSAKT1 ECU_ADDRESS 0xc0004cca BIT_MASK 0x1 /end MEASUREMENT
/begin MEASUREMENT St_zwbtsakt.B_bsakt2 "Bedingung Bauteilschutz Bank 2 aktiv" UBYTE _CNV_S_1_Def_bit_ub_700_CM 1 100. 0. 0. DISPLAY_IDENTIFIER B_BSAKT2 ECU_ADDRESS 0xc0004cca BIT_MASK 0x2 /end MEASUREMENT
/begin MEASUREMENT St_zwbtsakt.B_bsakt3 "Bedingung Bauteilschutz Bank 2 aktiv" UBYTE _CNV_S_1_Def_bit_ub_700_CM 1 100. 0. 0. DISPLAY_IDENTIFIER B_BSAKT3 ECU_ADDRESS 0xc0004cca BIT_MASK 0x4 /end MEASUREMENT
/begin MEASUREMENT St_zwbtsakt.B_bsakt4 "Bedingung Bauteilschutz Bank 2 aktiv" UBYTE _CNV_S_1_Def_bit_ub_700_CM 1 100. 0. 0. DISPLAY_IDENTIFIER B_BSAKT4 ECU_ADDRESS 0xc0004cca BIT_MASK 0x8 /end MEASUREMENT
/begin MEASUREMENT T_ikat1 "Temperatur im Kat Bank 1 dynamisch" SWORD _CNV_R_R_Def_t_sw_q_618_CM 1 100. -3276.8 3276.7 DISPLAY_IDENTIFIER T_IKAT1 ECU_ADDRESS 0xc0004e2c FORMAT "%6.1" /end MEASUREMENT
/begin MEASUREMENT T_ikat1_stat "Temperatur im Kat Bank 1 stationär" SWORD _CNV_R_R_Def_t_sw_q_618_CM 1 100. -3276.8 3276.7 DISPLAY_IDENTIFIER T_IKAT1_STAT ECU_ADDRESS 0xc0004e30 FORMAT "%6.1" /end MEASUREMENT
/begin MEASUREMENT T_ikat2 "Temperatur im Kat Bank 2 dynamisch" SWORD _CNV_R_R_Def_t_sw_q_618_CM 1 100. -3276.8 3276.7 DISPLAY_IDENTIFIER T_IKAT2 ECU_ADDRESS 0xc0004e2e FORMAT "%6.1" /end MEASUREMENT
/begin MEASUREMENT T_ikat2_stat "Temperatur im Kat Bank 2 stationär" SWORD _CNV_R_R_Def_t_sw_q_618_CM 1 100. -3276.8 3276.7 DISPLAY_IDENTIFIER T_IKAT2_STAT ECU_ADDRESS 0xc0004e32 FORMAT "%6.1" /end MEASUREMENT
/begin MEASUREMENT Tabg_agr "Abgastemperatur nach Rohr 11a (AGR-Ventil)" SWORD _CNV_R_R_Def_t_sw_q_618_CM 1 100. -3276.8 3276.7 DISPLAY_IDENTIFIER TABG_AGR ECU_ADDRESS 0xc0004ec2 FORMAT "%6.1" /end MEASUREMENT
/begin MEASUREMENT Tabg_anok1 "Abgastemperatur vor NoX-Kat Bank 1" SWORD _CNV_R_R_Def_t_sw_q_618_CM 1 100. -3276.8 3276.7 DISPLAY_IDENTIFIER TABG_ANOK1 ECU_ADDRESS 0xc0004f22 FORMAT "%6.1" /end MEASUREMENT
/begin MEASUREMENT Tabg_anok2 "Abgastemperatur vor NoX-Kat Bank 2" SWORD _CNV_R_R_Def_t_sw_q_618_CM 1 100. -3276.8 3276.7 DISPLAY_IDENTIFIER TABG_ANOK2 ECU_ADDRESS 0xc0004f24 FORMAT "%6.1" /end MEASUREMENT
/begin MEASUREMENT Tabg_bank1 "Abgastemperatur Bank 1 aus KNN für N54" SWORD _CNV_R_R_Def_t_sw_q_618_CM 1 100. -3276.8 3276.7 DISPLAY_IDENTIFIER TABG_BANK1 ECU_ADDRESS 0xc0004ea2 FORMAT "%6.1" /end MEASUREMENT
/begin MEASUREMENT Tabg_bank2 "Abgastemperatur Bank 2 aus KNN für N54" SWORD _CNV_R_R_Def_t_sw_q_618_CM 1 100. -3276.8 3276.7 DISPLAY_IDENTIFIER TABG_BANK2 ECU_ADDRESS 0xc0004ea4 FORMAT "%6.1" /end MEASUREMENT
/begin MEASUREMENT Tabg_demax1 "Maximale Temperatur für Desulfatisierung Bank 1" SWORD _CNV_R_R_Def_t_sw_q_618_CM 1 100. -3276.8 3276.7 DISPLAY_IDENTIFIER TABG_DEMAX1 ECU_ADDRESS 0xc0004e44 FORMAT "%6.1" /end MEASUREMENT
/begin MEASUREMENT Tabg_demax2 "Maximale Temperatur für Desulfatisierung Bank 2" SWORD _CNV_R_R_Def_t_sw_q_618_CM 1 100. -3276.8 3276.7 DISPLAY_IDENTIFIER TABG_DEMAX2 ECU_ADDRESS 0xc0004e46 FORMAT "%6.1" /end MEASUREMENT
/begin MEASUREMENT Tabg_demaxav "Mittlere Maximale Temperatur für Desulfatisierung" SWORD _CNV_R_R_Def_t_sw_q_618_CM 1 100. -3276.8 3276.7 DISPLAY_IDENTIFIER TABG_DEMAXAV ECU_ADDRESS 0xc0004e48 FORMAT "%6.1" /end MEASUREMENT
/begin MEASUREMENT Tabg_desul "" SWORD _CNV_R_R_Def_t_sw_q_618_CM 1 100. -3276.8 3276.7 DISPLAY_IDENTIFIER TABG_DESUL ECU_ADDRESS 0xc0004ea6 FORMAT "%6.1" /end MEASUREMENT
/begin MEASUREMENT Tabg_desul1 "" SWORD _CNV_R_R_Def_t_sw_q_618_CM 1 100. -3276.8 3276.7 DISPLAY_IDENTIFIER TABG_DESUL1 ECU_ADDRESS 0xc0004ea8 FORMAT "%6.1" /end MEASUREMENT
/begin MEASUREMENT Tabg_desul2 "" SWORD _CNV_R_R_Def_t_sw_q_618_CM 1 100. -3276.8 3276.7 DISPLAY_IDENTIFIER TABG_DESUL2 ECU_ADDRESS 0xc0004eaa FORMAT "%6.1" /end MEASUREMENT
/begin MEASUREMENT Tabg_filt "Gefilterte zylinderindividuelle Abgastemperatur aus Neuronalem Netz" SWORD _CNV_R_R_Def_t_sw_q_618_CM 1 100. -3276.8 3276.7 DISPLAY_IDENTIFIER TABG_FILT ECU_ADDRESS 0xc0004d60 FORMAT "%6.1" ARRAY_SIZE 6 MATRIX_DIM 6 1 1 /end MEASUREMENT
/begin MEASUREMENT Tabg_fth "Abgastemperaturen am Krümmereintritt" SWORD _CNV_R_R_Def_t_sw_q_618_CM 1 100. -3276.8 3276.7 DISPLAY_IDENTIFIER TABG_FTH ECU_ADDRESS 0xc0004e64 FORMAT "%6.1" ARRAY_SIZE 6 MATRIX_DIM 6 1 1 /end MEASUREMENT
/begin MEASUREMENT Tabg_ikat_av "Mittlere Temperatur im Kat" SWORD _CNV_R_R_Def_t_sw_q_618_CM 1 100. -3276.8 3276.7 DISPLAY_IDENTIFIER TABG_IKAT_AV ECU_ADDRESS 0xc0004e34 FORMAT "%6.1" /end MEASUREMENT
/begin MEASUREMENT Tabg_inok1 "Abgastemperatur im NoX-Kat Bank 1" SWORD _CNV_R_R_Def_t_sw_q_618_CM 1 100. -3276.8 3276.7 DISPLAY_IDENTIFIER TABG_INOK1 ECU_ADDRESS 0xc0004e96 FORMAT "%6.1" /end MEASUREMENT
/begin MEASUREMENT Tabg_inok2 "Abgastemperatur im NoX-Kat Bank 2" SWORD _CNV_R_R_Def_t_sw_q_618_CM 1 100. -3276.8 3276.7 DISPLAY_IDENTIFIER TABG_INOK2 ECU_ADDRESS 0xc0004e98 FORMAT "%6.1" /end MEASUREMENT
/begin MEASUREMENT Tabg_izus "Abgastemperatur nach Zusammenführung NoX-Kat" SWORD _CNV_R_R_Def_t_sw_q_618_CM 1 100. -3276.8 3276.7 DISPLAY_IDENTIFIER TABG_IZUS ECU_ADDRESS 0xc0004f18 FORMAT "%6.1" /end MEASUREMENT
/begin MEASUREMENT Tabg_m1 "Mischabgastemperatur Bank 1" SWORD _CNV_R_R_Def_t_sw_q_618_CM 1 100. -3276.8 3276.7 DISPLAY_IDENTIFIER TABG_M1 ECU_ADDRESS 0xc0004e9e FORMAT "%6.1" /end MEASUREMENT
/begin MEASUREMENT Tabg_m2 "Mischabgastemperatur Bank 2" SWORD _CNV_R_R_Def_t_sw_q_618_CM 1 100. -3276.8 3276.7 DISPLAY_IDENTIFIER TABG_M2 ECU_ADDRESS 0xc0004ea0 FORMAT "%6.1" /end MEASUREMENT
/begin MEASUREMENT Tabg_natl1 "Abgastemperatur Bank 1 Nach Turbolader N54" SWORD _CNV_R_R_Def_t_sw_q_618_CM 1 100. -3276.8 3276.7 DISPLAY_IDENTIFIER TABG_NATL1 ECU_ADDRESS 0xc0004ec8 FORMAT "%6.1" /end MEASUREMENT
/begin MEASUREMENT Tabg_natl2 "Abgastemperatur Bank 2 Nach Turbolader N54" SWORD _CNV_R_R_Def_t_sw_q_618_CM 1 100. -3276.8 3276.7 DISPLAY_IDENTIFIER TABG_NATL2 ECU_ADDRESS 0xc0004eca FORMAT "%6.1" /end MEASUREMENT
/begin MEASUREMENT Tabg_nk1 "Abgastemperatur nach Kat Bank 1" SWORD _CNV_R_R_Def_t_sw_q_618_CM 1 100. -3276.8 3276.7 DISPLAY_IDENTIFIER TABG_NK1 ECU_ADDRESS 0xc0004e3e FORMAT "%6.1" /end MEASUREMENT
/begin MEASUREMENT Tabg_nk2 "Abgastemperatur nach Kat Bank 2" SWORD _CNV_R_R_Def_t_sw_q_618_CM 1 100. -3276.8 3276.7 DISPLAY_IDENTIFIER TABG_NK2 ECU_ADDRESS 0xc0004e40 FORMAT "%6.1" /end MEASUREMENT
/begin MEASUREMENT Tabg_nk3 "Abgastemperatur nach Hauptkat" SWORD _CNV_R_R_Def_t_sw_q_618_CM 1 100. -3276.8 3276.7 DISPLAY_IDENTIFIER TABG_NK3 ECU_ADDRESS 0xc0004e8c FORMAT "%6.1" /end MEASUREMENT
/begin MEASUREMENT Tabg_nk3st "Abgastemperatur nach Kat 3 im Start" SWORD _CNV_R_R_Def_t_sw_q_618_CM 1 100. -3276.8 3276.7 DISPLAY_IDENTIFIER TABG_NK3ST ECU_ADDRESS 0xc0004e8a FORMAT "%6.1" /end MEASUREMENT
/begin MEASUREMENT Tabg_nk_av "Mittlere Abgastemperatur nach Kat" SWORD _CNV_R_R_Def_t_sw_q_618_CM 1 100. -3276.8 3276.7 DISPLAY_IDENTIFIER TABG_NK_AV ECU_ADDRESS 0xc0004e42 FORMAT "%6.1" /end MEASUREMENT
/begin MEASUREMENT Tabg_nkab "Abgastemperatur nach Kat, NV" SWORD _CNV_R_R_Def_t_sw_q_618_CM 1 100. -3276.8 3276.7 DISPLAY_IDENTIFIER TABG_NKAB ECU_ADDRESS 0xc000403c FORMAT "%6.1" /end MEASUREMENT
/begin MEASUREMENT Tabg_nkst "Abgastemperatur nach Kat im Start" SWORD _CNV_R_R_Def_t_sw_q_618_CM 1 100. -3276.8 3276.7 DISPLAY_IDENTIFIER TABG_NKST ECU_ADDRESS 0xc0004e54 FORMAT "%6.1" /end MEASUREMENT
/begin MEASUREMENT Tabg_nnarr "Zylinderindividuelle Abgastemperatur aus Neuronalem Netz" SWORD _CNV_R_R_Def_t_sw_q_618_CM 1 100. -3276.8 3276.7 DISPLAY_IDENTIFIER TABG_NNARR ECU_ADDRESS 0xc0004d54 FORMAT "%6.1" ARRAY_SIZE 6 MATRIX_DIM 6 1 1 /end MEASUREMENT
/begin MEASUREMENT Tabg_nnarrh "Abgastemperaturen mit Enthalpiekorrektur" SWORD _CNV_R_R_Def_t_sw_q_618_CM 1 100. -3276.8 3276.7 DISPLAY_IDENTIFIER TABG_NNARRH ECU_ADDRESS 0xc0004e58 FORMAT "%6.1" ARRAY_SIZE 6 MATRIX_DIM 6 1 1 /end MEASUREMENT
/begin MEASUREMENT Tabg_nnok1 "Abgastemperatur nach NoX-Kat Bank 1" SWORD _CNV_R_R_Def_t_sw_q_618_CM 1 100. -3276.8 3276.7 DISPLAY_IDENTIFIER TABG_NNOK1 ECU_ADDRESS 0xc0004eac FORMAT "%6.1" /end MEASUREMENT
/begin MEASUREMENT Tabg_nnok2 "Abgastemperatur nach NoX-Kat Bank 2" SWORD _CNV_R_R_Def_t_sw_q_618_CM 1 100. -3276.8 3276.7 DISPLAY_IDENTIFIER TABG_NNOK2 ECU_ADDRESS 0xc0004eae FORMAT "%6.1" /end MEASUREMENT
/begin MEASUREMENT Tabg_nok_av "Durchschnittliche Abgastemperatur NoX-Kat" SWORD _CNV_R_R_Def_t_sw_q_618_CM 1 100. -3276.8 3276.7 DISPLAY_IDENTIFIER TABG_NOK_AV ECU_ADDRESS 0xc0004eb0 FORMAT "%6.1" /end MEASUREMENT
/begin MEASUREMENT Tabg_nok_av1 "Durchschnittliche Abgastemperatur NoX-Kat, Bank 1" SWORD _CNV_R_R_Def_t_sw_q_618_CM 1 100. -3276.8 3276.7 DISPLAY_IDENTIFIER TABG_NOK_AV1 ECU_ADDRESS 0xc0004eb2 FORMAT "%6.1" /end MEASUREMENT
/begin MEASUREMENT Tabg_nok_av2 "Durchschnittliche Abgastemperatur NoX-Kat, Bank 2" SWORD _CNV_R_R_Def_t_sw_q_618_CM 1 100. -3276.8 3276.7 DISPLAY_IDENTIFIER TABG_NOK_AV2 ECU_ADDRESS 0xc0004eb4 FORMAT "%6.1" /end MEASUREMENT
/begin MEASUREMENT Tabg_nokab1 "Abgastemperatur NoxKat Bank 1" SWORD _CNV_R_R_Def_t_sw_q_618_CM 1 100. -3276.8 3276.7 DISPLAY_IDENTIFIER TABG_NOKAB1 ECU_ADDRESS 0xc000404c FORMAT "%6.1" /end MEASUREMENT
/begin MEASUREMENT Tabg_nokab2 "Abgastemperatur NoxKat Bank 2" SWORD _CNV_R_R_Def_t_sw_q_618_CM 1 100. -3276.8 3276.7 DISPLAY_IDENTIFIER TABG_NOKAB2 ECU_ADDRESS 0xc000404e FORMAT "%6.1" /end MEASUREMENT
/begin MEASUREMENT Tabg_nokmax "Maximale Abgastemperatur NoX-Kat" SWORD _CNV_R_R_Def_t_sw_q_618_CM 1 100. -3276.8 3276.7 DISPLAY_IDENTIFIER TABG_NOKMAX ECU_ADDRESS 0xc0004ebc FORMAT "%6.1" /end MEASUREMENT
/begin MEASUREMENT Tabg_nokmax1 "Maximale Abgastemperatur NoX-Kat, Bank 1" SWORD _CNV_R_R_Def_t_sw_q_618_CM 1 100. -3276.8 3276.7 DISPLAY_IDENTIFIER TABG_NOKMAX1 ECU_ADDRESS 0xc0004ebe FORMAT "%6.1" /end MEASUREMENT
/begin MEASUREMENT Tabg_nokmax2 "Maximale Abgastemperatur NoX-Kat, Bank 2" SWORD _CNV_R_R_Def_t_sw_q_618_CM 1 100. -3276.8 3276.7 DISPLAY_IDENTIFIER TABG_NOKMAX2 ECU_ADDRESS 0xc0004ec0 FORMAT "%6.1" /end MEASUREMENT
/begin MEASUREMENT Tabg_nokmin "Minimale Abgastemperatur NoX-Kat" SWORD _CNV_R_R_Def_t_sw_q_618_CM 1 100. -3276.8 3276.7 DISPLAY_IDENTIFIER TABG_NOKMIN ECU_ADDRESS 0xc0004eb6 FORMAT "%6.1" /end MEASUREMENT
/begin MEASUREMENT Tabg_nokmin1 "Minimale Abgastemperatur NoX-Kat Bank 1" SWORD _CNV_R_R_Def_t_sw_q_618_CM 1 100. -3276.8 3276.7 DISPLAY_IDENTIFIER TABG_NOKMIN1 ECU_ADDRESS 0xc0004eb8 FORMAT "%6.1" /end MEASUREMENT
/begin MEASUREMENT Tabg_nokmin2 "Minimale Abgastemperatur NoX-Kat Bank 2" SWORD _CNV_R_R_Def_t_sw_q_618_CM 1 100. -3276.8 3276.7 DISPLAY_IDENTIFIER TABG_NOKMIN2 ECU_ADDRESS 0xc0004eba FORMAT "%6.1" /end MEASUREMENT
/begin MEASUREMENT Tabg_nokst1 "Start-Abgastemperatur nach NoX-Kat Bank 1" SWORD _CNV_R_R_Def_t_sw_q_618_CM 1 100. -3276.8 3276.7 DISPLAY_IDENTIFIER TABG_NOKST1 ECU_ADDRESS 0xc0004e92 FORMAT "%6.1" /end MEASUREMENT
/begin MEASUREMENT Tabg_nokst2 "Start-Abgastemperatur nach NoX-Kat Bank 2" SWORD _CNV_R_R_Def_t_sw_q_618_CM 1 100. -3276.8 3276.7 DISPLAY_IDENTIFIER TABG_NOKST2 ECU_ADDRESS 0xc0004e94 FORMAT "%6.1" /end MEASUREMENT
/begin MEASUREMENT Tabg_nzus "Abgastemperatur nach Zusammenführung" SWORD _CNV_R_R_Def_t_sw_q_618_CM 1 100. -3276.8 3276.7 DISPLAY_IDENTIFIER TABG_NZUS ECU_ADDRESS 0xc0004f32 FORMAT "%6.1" /end MEASUREMENT
/begin MEASUREMENT Tabg_r1 "Abgastemperatur nach Rohr 1" SWORD _CNV_R_R_Def_t_sw_q_618_CM 1 100. -3276.8 3276.7 DISPLAY_IDENTIFIER TABG_R1 ECU_ADDRESS 0xc0004ef0 FORMAT "%6.1" /end MEASUREMENT
/begin MEASUREMENT Tabg_r10 "Abgastemperatur nach Rohr 10" SWORD _CNV_R_R_Def_t_sw_q_618_CM 1 100. -3276.8 3276.7 DISPLAY_IDENTIFIER TABG_R10 ECU_ADDRESS 0xc0004e22 FORMAT "%6.1" /end MEASUREMENT
/begin MEASUREMENT Tabg_r11 "Abgastemperatur nach Rohr 11" SWORD _CNV_R_R_Def_t_sw_q_618_CM 1 100. -3276.8 3276.7 DISPLAY_IDENTIFIER TABG_R11 ECU_ADDRESS 0xc0004f26 FORMAT "%6.1" /end MEASUREMENT
/begin MEASUREMENT Tabg_r12 "Abgastemperatur nach Rohr 12" SWORD _CNV_R_R_Def_t_sw_q_618_CM 1 100. -3276.8 3276.7 DISPLAY_IDENTIFIER TABG_R12 ECU_ADDRESS 0xc0004f28 FORMAT "%6.1" /end MEASUREMENT
/begin MEASUREMENT Tabg_r12a "Abgastemperatur nach Rohr 12a" SWORD _CNV_R_R_Def_t_sw_q_618_CM 1 100. -3276.8 3276.7 DISPLAY_IDENTIFIER TABG_R12A ECU_ADDRESS 0xc0004ec4 FORMAT "%6.1" /end MEASUREMENT
/begin MEASUREMENT Tabg_r13 "Abgastemperatur nach Rohr 13" SWORD _CNV_R_R_Def_t_sw_q_618_CM 1 100. -3276.8 3276.7 DISPLAY_IDENTIFIER TABG_R13 ECU_ADDRESS 0xc0004f2a FORMAT "%6.1" /end MEASUREMENT
/begin MEASUREMENT Tabg_r14 "Abgastemperatur nach Rohr 14" SWORD _CNV_R_R_Def_t_sw_q_618_CM 1 100. -3276.8 3276.7 DISPLAY_IDENTIFIER TABG_R14 ECU_ADDRESS 0xc0004f2c FORMAT "%6.1" /end MEASUREMENT
/begin MEASUREMENT Tabg_r14a "Abgastemperatur nach Rohr 14a" SWORD _CNV_R_R_Def_t_sw_q_618_CM 1 100. -3276.8 3276.7 DISPLAY_IDENTIFIER TABG_R14A ECU_ADDRESS 0xc0004ec6 FORMAT "%6.1" /end MEASUREMENT
/begin MEASUREMENT Tabg_r15 "Abgastemperatur nach Rohr 15" SWORD _CNV_R_R_Def_t_sw_q_618_CM 1 100. -3276.8 3276.7 DISPLAY_IDENTIFIER TABG_R15 ECU_ADDRESS 0xc0004f2e FORMAT "%6.1" /end MEASUREMENT
/begin MEASUREMENT Tabg_r16 "Abgastemperatur nach Rohr 16" SWORD _CNV_R_R_Def_t_sw_q_618_CM 1 100. -3276.8 3276.7 DISPLAY_IDENTIFIER TABG_R16 ECU_ADDRESS 0xc0004f30 FORMAT "%6.1" /end MEASUREMENT
/begin MEASUREMENT Tabg_r2 "Abgastemperatur nach Rohr 2" SWORD _CNV_R_R_Def_t_sw_q_618_CM 1 100. -3276.8 3276.7 DISPLAY_IDENTIFIER TABG_R2 ECU_ADDRESS 0xc0004ef2 FORMAT "%6.1" /end MEASUREMENT
/begin MEASUREMENT Tabg_r3 "Abgastemperatur nach Rohr 3" SWORD _CNV_R_R_Def_t_sw_q_618_CM 1 100. -3276.8 3276.7 DISPLAY_IDENTIFIER TABG_R3 ECU_ADDRESS 0xc0004ef4 FORMAT "%6.1" /end MEASUREMENT
/begin MEASUREMENT Tabg_r4 "Abgastemperatur nach Rohr 4" SWORD _CNV_R_R_Def_t_sw_q_618_CM 1 100. -3276.8 3276.7 DISPLAY_IDENTIFIER TABG_R4 ECU_ADDRESS 0xc0004ef6 FORMAT "%6.1" /end MEASUREMENT
/begin MEASUREMENT Tabg_r5 "Abgastemperatur nach Rohr 5" SWORD _CNV_R_R_Def_t_sw_q_618_CM 1 100. -3276.8 3276.7 DISPLAY_IDENTIFIER TABG_R5 ECU_ADDRESS 0xc0004f00 FORMAT "%6.1" /end MEASUREMENT
/begin MEASUREMENT Tabg_r6 "Abgastemperatur nach Rohr 6" SWORD _CNV_R_R_Def_t_sw_q_618_CM 1 100. -3276.8 3276.7 DISPLAY_IDENTIFIER TABG_R6 ECU_ADDRESS 0xc0004f02 FORMAT "%6.1" /end MEASUREMENT
/begin MEASUREMENT Tabg_r7 "Abgastemperatur nach Rohr 7" SWORD _CNV_R_R_Def_t_sw_q_618_CM 1 100. -3276.8 3276.7 DISPLAY_IDENTIFIER TABG_R7 ECU_ADDRESS 0xc0004e4c FORMAT "%6.1" /end MEASUREMENT
/begin MEASUREMENT Tabg_r8 "Abgastemperatur nach Rohr 8" SWORD _CNV_R_R_Def_t_sw_q_618_CM 1 100. -3276.8 3276.7 DISPLAY_IDENTIFIER TABG_R8 ECU_ADDRESS 0xc0004e4e FORMAT "%6.1" /end MEASUREMENT
/begin MEASUREMENT Tabg_r9 "Abgastemperatur nach Rohr 9" SWORD _CNV_R_R_Def_t_sw_q_618_CM 1 100. -3276.8 3276.7 DISPLAY_IDENTIFIER TABG_R9 ECU_ADDRESS 0xc0004e24 FORMAT "%6.1" /end MEASUREMENT
/begin MEASUREMENT Tabg_sens_mdl1 "Abgastemperatur aus Sensormodell für Bank 1" SWORD _CNV_R_R_Def_t_sw_q_618_CM 1 100. -3276.8 3276.7 DISPLAY_IDENTIFIER TABG_SENS_MDL1 ECU_ADDRESS 0xc0004f1e FORMAT "%6.1" /end MEASUREMENT
/begin MEASUREMENT Tabg_sens_mdl2 "Abgastemperatur aus Sensormodell für Bank 2" SWORD _CNV_R_R_Def_t_sw_q_618_CM 1 100. -3276.8 3276.7 DISPLAY_IDENTIFIER TABG_SENS_MDL2 ECU_ADDRESS 0xc0004f20 FORMAT "%6.1" /end MEASUREMENT
/begin MEASUREMENT Tabg_turb1 "Abgastemperatur Bank 1 Nach Turbine N54" SWORD _CNV_R_R_Def_t_sw_q_618_CM 1 100. -3276.8 3276.7 DISPLAY_IDENTIFIER TABG_TURB1 ECU_ADDRESS 0xc0004ecc FORMAT "%6.1" /end MEASUREMENT
/begin MEASUREMENT Tabg_turb2 "Abgastemperatur Bank 2 Nach Turbine N54" SWORD _CNV_R_R_Def_t_sw_q_618_CM 1 100. -3276.8 3276.7 DISPLAY_IDENTIFIER TABG_TURB2 ECU_ADDRESS 0xc0004ece FORMAT "%6.1" /end MEASUREMENT
/begin MEASUREMENT Tabg_vk1 "Abgastemperatur vor Kat Bank 1" SWORD _CNV_R_R_Def_t_sw_q_618_CM 1 100. -3276.8 3276.7 DISPLAY_IDENTIFIER TABG_VK1 ECU_ADDRESS 0xc0004e26 FORMAT "%6.1" /end MEASUREMENT
/begin MEASUREMENT Tabg_vk1ab "Abgastemperatur vor Kat, Bank 1, NV" SWORD _CNV_R_R_Def_t_sw_q_618_CM 1 100. -3276.8 3276.7 DISPLAY_IDENTIFIER TABG_VK1AB ECU_ADDRESS 0xc000404a FORMAT "%6.1" /end MEASUREMENT
/begin MEASUREMENT Tabg_vk1st "Abgastemperatur bei Start vor Kat, Bank 1" SWORD _CNV_R_R_Def_t_sw_q_618_CM 1 100. -3276.8 3276.7 DISPLAY_IDENTIFIER TABG_VK1ST ECU_ADDRESS 0xc0004e84 FORMAT "%6.1" /end MEASUREMENT
/begin MEASUREMENT Tabg_vk2 "Abgastemperatur vor Kat Bank 2" SWORD _CNV_R_R_Def_t_sw_q_618_CM 1 100. -3276.8 3276.7 DISPLAY_IDENTIFIER TABG_VK2 ECU_ADDRESS 0xc0004e28 FORMAT "%6.1" /end MEASUREMENT
/begin MEASUREMENT Tabg_vk_av "Mittlere Abgastemperatur vor Kat" SWORD _CNV_R_R_Def_t_sw_q_618_CM 1 100. -3276.8 3276.7 DISPLAY_IDENTIFIER TABG_VK_AV ECU_ADDRESS 0xc0004e2a FORMAT "%6.1" /end MEASUREMENT
/begin MEASUREMENT Tabg_vnok1 "Abgastemperatur vor NoX-Kat nach Sensormodell Bank 1" SWORD _CNV_R_R_Def_t_sw_q_618_CM 1 100. -3276.8 3276.7 DISPLAY_IDENTIFIER TABG_VNOK1 ECU_ADDRESS 0xc0004f1a FORMAT "%6.1" /end MEASUREMENT
/begin MEASUREMENT Tabg_vnok2 "Abgastemperatur vor NoX-Kat nach Sensormodell Bank 2" SWORD _CNV_R_R_Def_t_sw_q_618_CM 1 100. -3276.8 3276.7 DISPLAY_IDENTIFIER TABG_VNOK2 ECU_ADDRESS 0xc0004f1c FORMAT "%6.1" /end MEASUREMENT
/begin MEASUREMENT Tabg_wg1 "Abgastemperatur Bank 1 nach Wastegate N54" SWORD _CNV_R_R_Def_t_sw_q_618_CM 1 100. -3276.8 3276.7 DISPLAY_IDENTIFIER TABG_WG1 ECU_ADDRESS 0xc0004ed0 FORMAT "%6.1" /end MEASUREMENT
/begin MEASUREMENT Tabg_wg2 "Abgastemperatur Bank 2 nach Wastegate N54" SWORD _CNV_R_R_Def_t_sw_q_618_CM 1 100. -3276.8 3276.7 DISPLAY_IDENTIFIER TABG_WG2 ECU_ADDRESS 0xc0004ed2 FORMAT "%6.1" /end MEASUREMENT
/begin MEASUREMENT Tans_ini "Temp. Ansaugluft während Initialisierung" SWORD _CNV_R_R_Def_t_sw_q_618_CM 1 100. -3276.8 3276.7 DISPLAY_IDENTIFIER TANS_INI ECU_ADDRESS 0xc0004e9a FORMAT "%6.1" /end MEASUREMENT
/begin MEASUREMENT Tbsaus1 "Ausschaltbedingung Regler Bank 1" SWORD _CNV_R_R_Def_t_sw_q_618_CM 1 100. -3276.8 3276.7 DISPLAY_IDENTIFIER TBSAUS1 ECU_ADDRESS 0xc0004cf4 FORMAT "%6.1" /end MEASUREMENT
/begin MEASUREMENT Tbsaus2 "Ausschaltbedingung Regler Bank 2" SWORD _CNV_R_R_Def_t_sw_q_618_CM 1 100. -3276.8 3276.7 DISPLAY_IDENTIFIER TBSAUS2 ECU_ADDRESS 0xc0004cfa FORMAT "%6.1" /end MEASUREMENT
/begin MEASUREMENT Tbsaus3 "Ausschaltbedingung Regler Bank 1 NOx-Kat" SWORD _CNV_R_R_Def_t_sw_q_618_CM 1 100. -3276.8 3276.7 DISPLAY_IDENTIFIER TBSAUS3 ECU_ADDRESS 0xc0004d00 FORMAT "%6.1" /end MEASUREMENT
/begin MEASUREMENT Tbsaus4 "Ausschaltbedingung Regler Bank 2 NOx-Kat" SWORD _CNV_R_R_Def_t_sw_q_618_CM 1 100. -3276.8 3276.7 DISPLAY_IDENTIFIER TBSAUS4 ECU_ADDRESS 0xc0004d06 FORMAT "%6.1" /end MEASUREMENT
/begin MEASUREMENT Tbsein1 "Einschaltbedingung Regler Bank 1" SWORD _CNV_R_R_Def_t_sw_q_618_CM 1 100. -3276.8 3276.7 DISPLAY_IDENTIFIER TBSEIN1 ECU_ADDRESS 0xc0004cf2 FORMAT "%6.1" /end MEASUREMENT
/begin MEASUREMENT Tbsein2 "Einschaltbedingung Regler Bank 2" SWORD _CNV_R_R_Def_t_sw_q_618_CM 1 100. -3276.8 3276.7 DISPLAY_IDENTIFIER TBSEIN2 ECU_ADDRESS 0xc0004cf8 FORMAT "%6.1" /end MEASUREMENT
/begin MEASUREMENT Tbsein3 "Einschaltbedingung Regler Bank 1 NOx-Kat" SWORD _CNV_R_R_Def_t_sw_q_618_CM 1 100. -3276.8 3276.7 DISPLAY_IDENTIFIER TBSEIN3 ECU_ADDRESS 0xc0004cfe FORMAT "%6.1" /end MEASUREMENT
/begin MEASUREMENT Tbsein4 "Einschaltbedingung Regler Bank 2 NOx-Kat" SWORD _CNV_R_R_Def_t_sw_q_618_CM 1 100. -3276.8 3276.7 DISPLAY_IDENTIFIER TBSEIN4 ECU_ADDRESS 0xc0004d04 FORMAT "%6.1" /end MEASUREMENT
/begin MEASUREMENT Tmr_r1 "Motorraumtemperatur für Rohr 1,2,3" SWORD _CNV_R_R_Def_t_sw_q_618_CM 1 100. -3276.8 3276.7 DISPLAY_IDENTIFIER TMR_R1 ECU_ADDRESS 0xc0004e70 FORMAT "%6.1" /end MEASUREMENT
/begin MEASUREMENT Tmr_r10 "Motorraumtemperatur für Rohr 10" SWORD _CNV_R_R_Def_t_sw_q_618_CM 1 100. -3276.8 3276.7 DISPLAY_IDENTIFIER TMR_R10 ECU_ADDRESS 0xc0004e7a FORMAT "%6.1" /end MEASUREMENT
/begin MEASUREMENT Tmr_r11 "Motorraumtemperatur für Rohr 11" SWORD _CNV_R_R_Def_t_sw_q_618_CM 1 100. -3276.8 3276.7 DISPLAY_IDENTIFIER TMR_R11 ECU_ADDRESS 0xc0004e8e FORMAT "%6.1" /end MEASUREMENT
/begin MEASUREMENT Tmr_r4 "Motorraumtemperatur für Rohr 4,5,6" SWORD _CNV_R_R_Def_t_sw_q_618_CM 1 100. -3276.8 3276.7 DISPLAY_IDENTIFIER TMR_R4 ECU_ADDRESS 0xc0004e72 FORMAT "%6.1" /end MEASUREMENT
/begin MEASUREMENT Tmr_r7 "Motorraumtemperatur für Rohr 7" SWORD _CNV_R_R_Def_t_sw_q_618_CM 1 100. -3276.8 3276.7 DISPLAY_IDENTIFIER TMR_R7 ECU_ADDRESS 0xc0004e74 FORMAT "%6.1" /end MEASUREMENT
/begin MEASUREMENT Tmr_r8 "Motorraumtemperatur für Rohr 8" SWORD _CNV_R_R_Def_t_sw_q_618_CM 1 100. -3276.8 3276.7 DISPLAY_IDENTIFIER TMR_R8 ECU_ADDRESS 0xc0004e76 FORMAT "%6.1" /end MEASUREMENT
/begin MEASUREMENT Tmr_r9 "Motorraumtemperatur für Rohr 9" SWORD _CNV_R_R_Def_t_sw_q_618_CM 1 100. -3276.8 3276.7 DISPLAY_IDENTIFIER TMR_R9 ECU_ADDRESS 0xc0004e78 FORMAT "%6.1" /end MEASUREMENT
/begin MEASUREMENT Tnnsoll1 "Sollwert Abgastemperatur für Abfrage KNN, Bank 1" SWORD _CNV_R_R_Def_t_sw_q_618_CM 1 100. -3276.8 3276.7 DISPLAY_IDENTIFIER TNNSOLL1 ECU_ADDRESS 0xc0004d8e FORMAT "%6.1" /end MEASUREMENT
/begin MEASUREMENT Tnnsoll2 "Sollwert Abgastemperatur für Abfrage KNN, Bank 2" SWORD _CNV_R_R_Def_t_sw_q_618_CM 1 100. -3276.8 3276.7 DISPLAY_IDENTIFIER TNNSOLL2 ECU_ADDRESS 0xc0004d90 FORMAT "%6.1" /end MEASUREMENT
/begin MEASUREMENT Tnnvksoll "Sollwert Abgastemperatur für Abfrage KNN unkorrigiert" SWORD _CNV_R_R_Def_t_sw_q_618_CM 1 100. -3276.8 3276.7 DISPLAY_IDENTIFIER TNNVKSOLL ECU_ADDRESS 0xc0004cc8 FORMAT "%6.1" /end MEASUREMENT
/begin MEASUREMENT Tnoksoll1 "Sollwert Abgastemperatur Bank 1 NOx-Kat" SWORD _CNV_R_R_Def_t_sw_q_618_CM 1 100. -3276.8 3276.7 DISPLAY_IDENTIFIER TNOKSOLL1 ECU_ADDRESS 0xc0004cfc FORMAT "%6.1" /end MEASUREMENT
/begin MEASUREMENT Tnoksoll2 "Sollwert Abgastemperatur Bank 2 NOx-Kat" SWORD _CNV_R_R_Def_t_sw_q_618_CM 1 100. -3276.8 3276.7 DISPLAY_IDENTIFIER TNOKSOLL2 ECU_ADDRESS 0xc0004d02 FORMAT "%6.1" /end MEASUREMENT
/begin MEASUREMENT Tvksoll1 "Sollwert Abgastemperatur Bank 1" SWORD _CNV_R_R_Def_t_sw_q_618_CM 1 100. -3276.8 3276.7 DISPLAY_IDENTIFIER TVKSOLL1 ECU_ADDRESS 0xc0004cf0 FORMAT "%6.1" /end MEASUREMENT
/begin MEASUREMENT Tvksoll2 "Sollwert Abgastemperatur Bank 2" SWORD _CNV_R_R_Def_t_sw_q_618_CM 1 100. -3276.8 3276.7 DISPLAY_IDENTIFIER TVKSOLL2 ECU_ADDRESS 0xc0004cf6 FORMAT "%6.1" /end MEASUREMENT
/begin MEASUREMENT Tvwg "Tastverhaeltnis - Wastegateansteuerung" UWORD _CNV_R_R_Def_f_uw_b_576_CM 1 100. 0. 99.9984 DISPLAY_IDENTIFIER TVWG ECU_ADDRESS 0xd00069d6 FORMAT "%8.3" /end MEASUREMENT
/begin MEASUREMENT Tvwg1_korho "Tastverhältnis höhenkorrigiert wegen Unterdruckdose" UWORD _CNV_R_R_Def_f_uw_b_576_CM 1 100. 0. 99.9984 DISPLAY_IDENTIFIER TVWG1_KORHO ECU_ADDRESS 0xd00069da FORMAT "%8.3" /end MEASUREMENT
/begin MEASUREMENT Tvwg2 "Tastverhaeltnis - Wastegateansteuerung 2" UWORD _CNV_R_R_Def_f_uw_b_576_CM 1 100. 0. 99.9984 DISPLAY_IDENTIFIER TVWG2 ECU_ADDRESS 0xd00069d8 FORMAT "%8.3" /end MEASUREMENT
/begin MEASUREMENT Tvwg2_korho "Tastverhältnis höhenkorrigiert wegen Unterdruckdose" UWORD _CNV_R_R_Def_f_uw_b_576_CM 1 100. 0. 99.9984 DISPLAY_IDENTIFIER TVWG2_KORHO ECU_ADDRESS 0xd00069dc FORMAT "%8.3" /end MEASUREMENT
/begin MEASUREMENT Tw_m1 "Mischtemperatur Rohrwand Bank 1" SWORD _CNV_R_R_Def_t_sw_q_618_CM 1 100. -3276.8 3276.7 DISPLAY_IDENTIFIER TW_M1 ECU_ADDRESS 0xc0004e36 FORMAT "%6.1" /end MEASUREMENT
/begin MEASUREMENT Tw_m1ab "Mischtemperatur Rohrwand Bank 1, NV" SWORD _CNV_R_R_Def_t_sw_q_618_CM 1 100. -3276.8 3276.7 DISPLAY_IDENTIFIER TW_M1AB ECU_ADDRESS 0xc000403e FORMAT "%6.1" /end MEASUREMENT
/begin MEASUREMENT Tw_m1st "Rohrwandtemperatur bei Start Bank1" SWORD _CNV_R_R_Def_t_sw_q_618_CM 1 100. -3276.8 3276.7 DISPLAY_IDENTIFIER TW_M1ST ECU_ADDRESS 0xc0004e7c FORMAT "%6.1" /end MEASUREMENT
/begin MEASUREMENT Tw_m2 "Mischtemperatur Rohrwand Bank 2" SWORD _CNV_R_R_Def_t_sw_q_618_CM 1 100. -3276.8 3276.7 DISPLAY_IDENTIFIER TW_M2 ECU_ADDRESS 0xc0004e38 FORMAT "%6.1" /end MEASUREMENT
/begin MEASUREMENT Tw_m2ab "Mischtemperatur Rohrwand Bank 2, NV" SWORD _CNV_R_R_Def_t_sw_q_618_CM 1 100. -3276.8 3276.7 DISPLAY_IDENTIFIER TW_M2AB ECU_ADDRESS 0xc0004040 FORMAT "%6.1" /end MEASUREMENT
/begin MEASUREMENT Tw_m2st "Rohrwandtemperatur bei Start Bank2" SWORD _CNV_R_R_Def_t_sw_q_618_CM 1 100. -3276.8 3276.7 DISPLAY_IDENTIFIER TW_M2ST ECU_ADDRESS 0xc0004e7e FORMAT "%6.1" /end MEASUREMENT
/begin MEASUREMENT Tw_nk1 "Rohrwandtemperatur nach Kat 1" SWORD _CNV_R_R_Def_t_sw_q_618_CM 1 100. -3276.8 3276.7 DISPLAY_IDENTIFIER TW_NK1 ECU_ADDRESS 0xc0004e3a FORMAT "%6.1" /end MEASUREMENT
/begin MEASUREMENT Tw_nk1ab "Wandtemperatur Bank 1, NV" SWORD _CNV_R_R_Def_t_sw_q_618_CM 1 100. -3276.8 3276.7 DISPLAY_IDENTIFIER TW_NK1AB ECU_ADDRESS 0xc0004042 FORMAT "%6.1" /end MEASUREMENT
/begin MEASUREMENT Tw_nk1st "Rohrwandtemperatur nach Kat bei Start Bank1" SWORD _CNV_R_R_Def_t_sw_q_618_CM 1 100. -3276.8 3276.7 DISPLAY_IDENTIFIER TW_NK1ST ECU_ADDRESS 0xc0004e86 FORMAT "%6.1" /end MEASUREMENT
/begin MEASUREMENT Tw_nk2 "Rohrwandtemperatur nach Kat 2" SWORD _CNV_R_R_Def_t_sw_q_618_CM 1 100. -3276.8 3276.7 DISPLAY_IDENTIFIER TW_NK2 ECU_ADDRESS 0xc0004e3c FORMAT "%6.1" /end MEASUREMENT
/begin MEASUREMENT Tw_nk2ab "Wandtemperatur Bank 2, NV" SWORD _CNV_R_R_Def_t_sw_q_618_CM 1 100. -3276.8 3276.7 DISPLAY_IDENTIFIER TW_NK2AB ECU_ADDRESS 0xc0004044 FORMAT "%6.1" /end MEASUREMENT
/begin MEASUREMENT Tw_nk2st "Rohrwandtemperatur nach Kat bei Start Bank2" SWORD _CNV_R_R_Def_t_sw_q_618_CM 1 100. -3276.8 3276.7 DISPLAY_IDENTIFIER TW_NK2ST ECU_ADDRESS 0xc0004e88 FORMAT "%6.1" /end MEASUREMENT
/begin MEASUREMENT Tw_r1 "Rohrwandtemperatur 1" SWORD _CNV_R_R_Def_t_sw_q_618_CM 1 100. -3276.8 3276.7 DISPLAY_IDENTIFIER TW_R1 ECU_ADDRESS 0xc0004e20 FORMAT "%6.1" /end MEASUREMENT
/begin MEASUREMENT Tw_r11 "Rohrwandtemperatur 11" SWORD _CNV_R_R_Def_t_sw_q_618_CM 1 100. -3276.8 3276.7 DISPLAY_IDENTIFIER TW_R11 ECU_ADDRESS 0xc0004f34 FORMAT "%6.1" /end MEASUREMENT
/begin MEASUREMENT Tw_r11a "Rohrwandtemperatur 11a (AGR)" SWORD _CNV_R_R_Def_t_sw_q_618_CM 1 100. -3276.8 3276.7 DISPLAY_IDENTIFIER TW_R11A ECU_ADDRESS 0xc0004f36 FORMAT "%6.1" /end MEASUREMENT
/begin MEASUREMENT Tw_r12 "Rohrwandtemperatur 12" SWORD _CNV_R_R_Def_t_sw_q_618_CM 1 100. -3276.8 3276.7 DISPLAY_IDENTIFIER TW_R12 ECU_ADDRESS 0xc0004f38 FORMAT "%6.1" /end MEASUREMENT
/begin MEASUREMENT Tw_r12a "Rohrwandtemperatur 12a" SWORD _CNV_R_R_Def_t_sw_q_618_CM 1 100. -3276.8 3276.7 DISPLAY_IDENTIFIER TW_R12A ECU_ADDRESS 0xc0004f3a FORMAT "%6.1" /end MEASUREMENT
/begin MEASUREMENT Tw_r13 "Rohrwandtemperatur 13" SWORD _CNV_R_R_Def_t_sw_q_618_CM 1 100. -3276.8 3276.7 DISPLAY_IDENTIFIER TW_R13 ECU_ADDRESS 0xc0004f3c FORMAT "%6.1" /end MEASUREMENT
/begin MEASUREMENT Tw_r14 "Rohrwandtemperatur 14" SWORD _CNV_R_R_Def_t_sw_q_618_CM 1 100. -3276.8 3276.7 DISPLAY_IDENTIFIER TW_R14 ECU_ADDRESS 0xc0004f3e FORMAT "%6.1" /end MEASUREMENT
/begin MEASUREMENT Tw_r14a "Rohrwandtemperatur 14a" SWORD _CNV_R_R_Def_t_sw_q_618_CM 1 100. -3276.8 3276.7 DISPLAY_IDENTIFIER TW_R14A ECU_ADDRESS 0xc0004f40 FORMAT "%6.1" /end MEASUREMENT
/begin MEASUREMENT Tw_r15 "Rohrwandtemperatur 15" SWORD _CNV_R_R_Def_t_sw_q_618_CM 1 100. -3276.8 3276.7 DISPLAY_IDENTIFIER TW_R15 ECU_ADDRESS 0xc0004f42 FORMAT "%6.1" /end MEASUREMENT
/begin MEASUREMENT Tw_r16 "Rohrwandtemperatur 16" SWORD _CNV_R_R_Def_t_sw_q_618_CM 1 100. -3276.8 3276.7 DISPLAY_IDENTIFIER TW_R16 ECU_ADDRESS 0xc0004f44 FORMAT "%6.1" /end MEASUREMENT
/begin MEASUREMENT Tw_r1ab "Wandtemperatur Krümmer 1, NV" SWORD _CNV_R_R_Def_t_sw_q_618_CM 1 100. -3276.8 3276.7 DISPLAY_IDENTIFIER TW_R1AB ECU_ADDRESS 0xc0004046 FORMAT "%6.1" /end MEASUREMENT
/begin MEASUREMENT Tw_r1st "Rohrwandtemperatur bei Start Krümmer 1" SWORD _CNV_R_R_Def_t_sw_q_618_CM 1 100. -3276.8 3276.7 DISPLAY_IDENTIFIER TW_R1ST ECU_ADDRESS 0xc0004e80 FORMAT "%6.1" /end MEASUREMENT
/begin MEASUREMENT Tw_r2 "Rohrwandtemperatur 2" SWORD _CNV_R_R_Def_t_sw_q_618_CM 1 100. -3276.8 3276.7 DISPLAY_IDENTIFIER TW_R2 ECU_ADDRESS 0xc0004ef8 FORMAT "%6.1" /end MEASUREMENT
/begin MEASUREMENT Tw_r3 "Rohrwandtemperatur 3" SWORD _CNV_R_R_Def_t_sw_q_618_CM 1 100. -3276.8 3276.7 DISPLAY_IDENTIFIER TW_R3 ECU_ADDRESS 0xc0004efa FORMAT "%6.1" /end MEASUREMENT
/begin MEASUREMENT Tw_r4 "Rohrwandtemperatur 4" SWORD _CNV_R_R_Def_t_sw_q_618_CM 1 100. -3276.8 3276.7 DISPLAY_IDENTIFIER TW_R4 ECU_ADDRESS 0xc0004e9c FORMAT "%6.1" /end MEASUREMENT
/begin MEASUREMENT Tw_r4ab "Wandtemperatur Krümmer 4, NV" SWORD _CNV_R_R_Def_t_sw_q_618_CM 1 100. -3276.8 3276.7 DISPLAY_IDENTIFIER TW_R4AB ECU_ADDRESS 0xc0004048 FORMAT "%6.1" /end MEASUREMENT
/begin MEASUREMENT Tw_r4st "Rohrwandtemperatur bei Start Krümmer 4" SWORD _CNV_R_R_Def_t_sw_q_618_CM 1 100. -3276.8 3276.7 DISPLAY_IDENTIFIER TW_R4ST ECU_ADDRESS 0xc0004e82 FORMAT "%6.1" /end MEASUREMENT
/begin MEASUREMENT Tw_r5 "Rohrwandtemperatur 5" SWORD _CNV_R_R_Def_t_sw_q_618_CM 1 100. -3276.8 3276.7 DISPLAY_IDENTIFIER TW_R5 ECU_ADDRESS 0xc0004f04 FORMAT "%6.1" /end MEASUREMENT
/begin MEASUREMENT Tw_r6 "Rohrwandtemperatur 6" SWORD _CNV_R_R_Def_t_sw_q_618_CM 1 100. -3276.8 3276.7 DISPLAY_IDENTIFIER TW_R6 ECU_ADDRESS 0xc0004f06 FORMAT "%6.1" /end MEASUREMENT
/begin MEASUREMENT Tw_wg1 "Wandtemperatur Bank 1 nach Wastegate N54" SWORD _CNV_R_R_Def_t_sw_q_618_CM 1 100. -3276.8 3276.7 DISPLAY_IDENTIFIER TW_WG1 ECU_ADDRESS 0xc0004ed4 FORMAT "%6.1" /end MEASUREMENT
/begin MEASUREMENT Tw_wg2 "Wandtemperatur Bank 2 nach Wastegate N54" SWORD _CNV_R_R_Def_t_sw_q_618_CM 1 100. -3276.8 3276.7 DISPLAY_IDENTIFIER TW_WG2 ECU_ADDRESS 0xc0004ed6 FORMAT "%6.1" /end MEASUREMENT
/begin MEASUREMENT V_atm_b1 "Fahrzeuggeschwindigkeit korrigiert über E-Lüfter-PWM, Bank 1" UWORD _CNV_R_R_Def_v_uw_q_723_CM 1 100. 0. 360. DISPLAY_IDENTIFIER V_ATM_B1 ECU_ADDRESS 0xc0004e50 FORMAT "%5.0" /end MEASUREMENT
/begin MEASUREMENT V_atm_b2 "Fahrzeuggeschwindigkeit korrigiert über E-Lüfter-PWM, Bank 2" UWORD _CNV_R_R_Def_v_uw_q_723_CM 1 100. 0. 360. DISPLAY_IDENTIFIER V_ATM_B2 ECU_ADDRESS 0xc0004e52 FORMAT "%5.0" /end MEASUREMENT
/begin MEASUREMENT Zw_mean "Über 200ms gemittelter Zündwinkel zylinderindividuell" FLOAT32_IEEE _CNV_R_R_Def_dez_sl_575_CM 1 100. -1000000000000. 10000000000000. DISPLAY_IDENTIFIER ZW_MEAN ECU_ADDRESS 0xc0004d70 FORMAT "%14.7" ARRAY_SIZE 6 MATRIX_DIM 6 1 1 /end MEASUREMENT
/begin AXIS_PTS GAX_ATMNN "Neuronen des ATMNN-MLP" 0xa100cef0 Modelle _REC_AXS_20_u1 255. _CNV_R_R_Def_dez_sl_575_CM 15 0. 255. FORMAT "%3.0" /end AXIS_PTS
/begin CHARACTERISTIC CW_ATMOD "Codewort Auswahl Bauteilschutz-Lambda" VALUE 0xa100ccfa _REC_VAL_20_u1 99.45 _CNV_R_R_Def_dez_sl_575_CM 0. 255. FORMAT "%3.0" /end CHARACTERISTIC
/begin CHARACTERISTIC KF_AGRHOM "Korrekturkennfeld AGR im Homogenbetrieb" MAP 0xa100ec2c _REC_MAP_52_UBYTE_u2_s2_s2 1.9999 _CNV_R_R_Def_f_uw_b_579_CM 0. 1.9999 FORMAT "%14.5"
 /begin AXIS_DESCR STD_AXIS Nkw _CNV_R_R_Def_n_sw_q_612_CM 6 -32768. 32767. FORMAT "%5.0" /end AXIS_DESCR
 /begin AXIS_DESCR STD_AXIS Rf _CNV_R_R_Def_rf_sw__616_CM 6 -327.68 327.67 FORMAT "%7.4" /end AXIS_DESCR
/end CHARACTERISTIC
/begin CHARACTERISTIC KF_AGRHOMMAX "Schwellwert für Quittung für Homogenbetrieb" MAP 0xa100ebc8 _REC_MAP_52_UBYTE_u2_s2_u2 100. _CNV_R_R_Def_tvpwm__736_CM 0. 100.
 /begin AXIS_DESCR STD_AXIS Nkw _CNV_R_R_Def_n_sw_q_612_CM 6 -32768. 32767. FORMAT "%5.0" /end AXIS_DESCR
 /begin AXIS_DESCR STD_AXIS La_ber _CNV_R_R_Def_f_uw_b_594_CM 6 0. 15.9997 FORMAT "%7.4" /end AXIS_DESCR
/end CHARACTERISTIC
/begin CHARACTERISTIC KF_AGRHOS "Grundkennfeld für AGR im Homogenschichtbetrieb" MAP 0xa100ea38 _REC_MAP_52_UBYTE_u2_s2_s2 99.9984 _CNV_R_R_Def_f_uw_b_576_CM 0. 99.9984
 /begin AXIS_DESCR STD_AXIS Nkw _CNV_R_R_Def_n_sw_q_612_CM 6 -32768. 32767. FORMAT "%5.0" /end AXIS_DESCR
 /begin AXIS_DESCR STD_AXIS Rk_soll_hs _CNV_R_R_Def_rk_sw__697_CM 6 -1600. 1599.9511 /end AXIS_DESCR
/end CHARACTERISTIC
/begin CHARACTERISTIC KF_AGRHOSMAX "Schwellwert für Quittung HOMOGEN Schichtbetrieb" MAP 0xa100ec90 _REC_MAP_52_UBYTE_u2_s2_u2 100. _CNV_R_R_Def_tvpwm__736_CM 0. 100.
 /begin AXIS_DESCR STD_AXIS Nkw _CNV_R_R_Def_n_sw_q_612_CM 6 -32768. 32767. FORMAT "%5.0" /end AXIS_DESCR
 /begin AXIS_DESCR STD_AXIS La_ber _CNV_R_R_Def_f_uw_b_594_CM 6 0. 15.9997 FORMAT "%7.4" /end AXIS_DESCR
/end CHARACTERISTIC
/begin CHARACTERISTIC KF_AGRSCH "Grundkennfeld für Schichtbetrieb" MAP 0xa100ea9c _REC_MAP_52_UBYTE_u2_s2_s2 99.9984 _CNV_R_R_Def_f_uw_b_576_CM 0. 99.9984
 /begin AXIS_DESCR STD_AXIS Nkw _CNV_R_R_Def_n_sw_q_612_CM 8 -32768. 32767. FORMAT "%5.0" /end AXIS_DESCR
 /begin AXIS_DESCR STD_AXIS Rk_soll_s _CNV_R_R_Def_rk_sw__697_CM 10 -1600. 1599.9511 /end AXIS_DESCR
/end CHARACTERISTIC
/begin CHARACTERISTIC KF_AGRSCHMAX "Schwellwert für Quittung Schichtbetrieb" MAP 0xa100eb64 _REC_MAP_52_UBYTE_u2_s2_u2 100. _CNV_R_R_Def_tvpwm__736_CM 0. 100.
 /begin AXIS_DESCR STD_AXIS Nkw _CNV_R_R_Def_n_sw_q_612_CM 6 -32768. 32767. FORMAT "%5.0" /end AXIS_DESCR
 /begin AXIS_DESCR STD_AXIS La_ber _CNV_R_R_Def_f_uw_b_594_CM 6 0. 15.9997 FORMAT "%7.4" /end AXIS_DESCR
/end CHARACTERISTIC
/begin CHARACTERISTIC KF_ATM54_ETA "" MAP 0xa100d878 _REC_MAP_52_u1_s2_s2 0.996 _CNV_R_R_Def_f_ub_b_573_CM 0. 0.996
 /begin AXIS_DESCR STD_AXIS Nkw _CNV_R_R_Def_n_sw_q_612_CM 8 -32768. 32767. FORMAT "%5.0" /end AXIS_DESCR
 /begin AXIS_DESCR STD_AXIS Rf _CNV_R_R_Def_rf_sw__616_CM 8 -327.68 327.67 FORMAT "%7.4" /end AXIS_DESCR
/end CHARACTERISTIC
/begin CHARACTERISTIC KF_ATM_FAKTH "Faktor Temperaturkorrektur durch Enthalpiemittelung" MAP 0xa100d290 _REC_MAP_52_UBYTE_u2_s2_s2 1.9999 _CNV_R_R_Def_f_uw_b_579_CM 0. 1.9999 FORMAT "%14.5"
 /begin AXIS_DESCR STD_AXIS Nkw _CNV_R_R_Def_n_sw_q_612_CM 8 -32768. 32767. FORMAT "%5.0" /end AXIS_DESCR
 /begin AXIS_DESCR STD_AXIS Rf _CNV_R_R_Def_rf_sw__616_CM 8 -327.68 327.67 FORMAT "%7.4" /end AXIS_DESCR
/end CHARACTERISTIC
/begin CHARACTERISTIC KF_ATM_FAKTS "Faktor Temperaturkorrektur durch Enthalpiemittelung im Schichtbetrieb" MAP 0xa100d334 _REC_MAP_52_UBYTE_u2_s2_s2 1.9999 _CNV_R_R_Def_f_uw_b_579_CM 0. 1.9999 FORMAT "%14.5"
 /begin AXIS_DESCR STD_AXIS Nkw _CNV_R_R_Def_n_sw_q_612_CM 8 -32768. 32767. FORMAT "%5.0" /end AXIS_DESCR
 /begin AXIS_DESCR STD_AXIS Rk_soll _CNV_R_R_Def_rk_sw__697_CM 8 -1600. 1599.9511 /end AXIS_DESCR
/end CHARACTERISTIC
/begin CHARACTERISTIC KF_ATM_FTH1 "Faktor Temperaturkorrektur durch Enthalpiemittelung Bank 1" MAP 0xa100d520 _REC_MAP_52_UBYTE_u2_s2_s2 1.9999 _CNV_R_R_Def_f_uw_b_579_CM 0. 1.9999 FORMAT "%14.5"
 /begin AXIS_DESCR STD_AXIS Nkw _CNV_R_R_Def_n_sw_q_612_CM 8 -32768. 32767. FORMAT "%5.0" /end AXIS_DESCR
 /begin AXIS_DESCR STD_AXIS Rf _CNV_R_R_Def_rf_sw__616_CM 8 -327.68 327.67 FORMAT "%7.4" /end AXIS_DESCR
/end CHARACTERISTIC
/begin CHARACTERISTIC KF_ATM_FTH2 "Faktor Temperaturkorrektur durch Enthalpiemittelung Bank 2" MAP 0xa100d5c4 _REC_MAP_52_UBYTE_u2_s2_s2 1.9999 _CNV_R_R_Def_f_uw_b_579_CM 0. 1.9999 FORMAT "%14.5"
 /begin AXIS_DESCR STD_AXIS Nkw _CNV_R_R_Def_n_sw_q_612_CM 8 -32768. 32767. FORMAT "%5.0" /end AXIS_DESCR
 /begin AXIS_DESCR STD_AXIS Rf _CNV_R_R_Def_rf_sw__616_CM 8 -327.68 327.67 FORMAT "%7.4" /end AXIS_DESCR
/end CHARACTERISTIC
/begin CHARACTERISTIC KF_ATM_FTS1 "Faktor Temperaturkorrektur durch Enthalpiemittelung Bank 1 für Schichtbetrieb" MAP 0xa100d3d8 _REC_MAP_52_UBYTE_u2_s2_s2 1.9999 _CNV_R_R_Def_f_uw_b_579_CM 0. 1.9999 FORMAT "%14.5"
 /begin AXIS_DESCR STD_AXIS Nkw _CNV_R_R_Def_n_sw_q_612_CM 8 -32768. 32767. FORMAT "%5.0" /end AXIS_DESCR
 /begin AXIS_DESCR STD_AXIS Rk_soll _CNV_R_R_Def_rk_sw__697_CM 8 -1600. 1599.9511 /end AXIS_DESCR
/end CHARACTERISTIC
/begin CHARACTERISTIC KF_ATM_FTS2 "Faktor Temperaturkorrektur durch Enthalpiemittelung Bank 2 für Schichtbetrieb" MAP 0xa100d47c _REC_MAP_52_UBYTE_u2_s2_s2 1.9999 _CNV_R_R_Def_f_uw_b_579_CM 0. 1.9999 FORMAT "%14.5"
 /begin AXIS_DESCR STD_AXIS Nkw _CNV_R_R_Def_n_sw_q_612_CM 8 -32768. 32767. FORMAT "%5.0" /end AXIS_DESCR
 /begin AXIS_DESCR STD_AXIS Rk_soll _CNV_R_R_Def_rk_sw__697_CM 8 -1600. 1599.9511 /end AXIS_DESCR
/end CHARACTERISTIC
/begin CHARACTERISTIC KF_BS_MX "Maximalwert für Begrenzung Vorsteuerlambda aus ATMNN" MAP 0xa100cda0 _REC_MAP_52_u1_s2_s2 0.498 _CNV_R_R_Def_f_ub_q_737_CM 1. 1.498 FORMAT "%5.2"
 /begin AXIS_DESCR STD_AXIS Nkw _CNV_R_R_Def_n_sw_q_612_CM 4 -32768. 32767. FORMAT "%5.0" /end AXIS_DESCR
 /begin AXIS_DESCR STD_AXIS Rf _CNV_R_R_Def_rf_sw__616_CM 4 -327.68 327.67 FORMAT "%7.4" /end AXIS_DESCR
/end CHARACTERISTIC
/begin CHARACTERISTIC KF_BS_VST "Vorsteuerwert für Lambda GDI-Motor" MAP 0xa100ce80 _REC_MAP_52_UBYTE_u2_s2_s2 15.9997 _CNV_R_R_Def_f_uw_b_594_CM 0. 15.9997 FORMAT "%7.4"
 /begin AXIS_DESCR STD_AXIS Nkw _CNV_R_R_Def_n_sw_q_612_CM 8 -32768. 32767. FORMAT "%5.0" /end AXIS_DESCR
 /begin AXIS_DESCR STD_AXIS Rf _CNV_R_R_Def_rf_sw__616_CM 4 -327.68 327.67 FORMAT "%7.4" /end AXIS_DESCR
/end CHARACTERISTIC
/begin CHARACTERISTIC KF_BS_VST_N54 "Bauteilschutz-Vorsteuerwert für N54" MAP 0xa100cdc4 _REC_MAP_52_u1_s2_s2 0.498 _CNV_R_R_Def_f_ub_b_609_CM 0. 0.498
 /begin AXIS_DESCR STD_AXIS Nkw _CNV_R_R_Def_n_sw_q_612_CM 8 -32768. 32767. FORMAT "%5.0" /end AXIS_DESCR
 /begin AXIS_DESCR STD_AXIS Dzw_mm _CNV_R_R_Def_rf_sw__616_CM 4 -327.68 327.67 FORMAT "%7.4" /end AXIS_DESCR
/end CHARACTERISTIC
/begin CHARACTERISTIC KF_DPLDULS "Deltadruck für Überladeschutzdiagnose" MAP 0xa100b2ac _REC_MAP_52_UBYTE_s2_s2_u2 102.398436 _CNV_R_R_Def_p_sw_q_614_CM -2560. 2559.9218 FORMAT "%5.2"
 /begin AXIS_DESCR STD_AXIS Nkw _CNV_R_R_Def_n_sw_q_612_CM 6 -32768. 32767. FORMAT "%5.0" /end AXIS_DESCR
 /begin AXIS_DESCR STD_AXIS Pld_soll _CNV_R_R_Def_p_sw_q_578_CM 6 0. 2559.9609 FORMAT "%5.2" /end AXIS_DESCR
/end CHARACTERISTIC
/begin CHARACTERISTIC KF_DRFMXW_OB "Delta Rfmax-Offset bei Overboost" MAP 0xa100b248 _REC_MAP_52_UBYTE_s2_s2_s2 98.30250000000001 _CNV_R_R_Def_rf_sw__616_CM -327.68 327.67 FORMAT "%7.4"
 /begin AXIS_DESCR STD_AXIS Nkw _CNV_R_R_Def_n_sw_q_612_CM 6 -32768. 32767. FORMAT "%5.0" /end AXIS_DESCR
 /begin AXIS_DESCR STD_AXIS Tans _CNV_R_R_Def_t_sw_q_618_CM 6 -3276.8 3276.7 FORMAT "%4.1" /end AXIS_DESCR
/end CHARACTERISTIC
/begin CHARACTERISTIC KF_FWGZUEKOR "Wastegate Korrekturfaktor auf Zündwinkeleingriffe" MAP 0xa100b384 _REC_MAP_52_UBYTE_u2_u2_s2 1.9999 _CNV_R_R_Def_f_uw_b_579_CM 0. 1.9999 FORMAT "%14.5" /begin AXIS_DESCR STD_AXIS Mszyl _CNV_R_R_Def_ms_uw__611_CM 12 0. 2047.9687 /end AXIS_DESCR
 /begin AXIS_DESCR STD_AXIS NO_INPUT_QUANTITY _CNV_R_R_Def_zw_sw__599_CM 12 -50. 60. FORMAT "%4.1" /end AXIS_DESCR
/end CHARACTERISTIC
/begin CHARACTERISTIC KF_TA_NOKSOLL "Solltemperatur für Abgastemperatur NOxKat" MAP 0xa100ce00 _REC_MAP_52_UBYTE_s2_s2_s2 131.07 _CNV_R_R_Def_t_sw_q_618_CM -3276.8 3276.7 FORMAT "%4.1"
 /begin AXIS_DESCR STD_AXIS Nkw _CNV_R_R_Def_n_sw_q_612_CM 8 -32768. 32767. FORMAT "%5.0" /end AXIS_DESCR
 /begin AXIS_DESCR STD_AXIS Rf _CNV_R_R_Def_rf_sw__616_CM 6 -327.68 327.67 FORMAT "%7.4" /end AXIS_DESCR
/end CHARACTERISTIC
/begin CHARACTERISTIC KF_TA_VKSOLL "Solltemperatur für Abgastemperatur Mischstrecke" MAP 0xa100cd6c _REC_MAP_52_UBYTE_s2_s2_s2 131.07 _CNV_R_R_Def_t_sw_q_618_CM -3276.8 3276.7 FORMAT "%4.1"
 /begin AXIS_DESCR STD_AXIS Nkw _CNV_R_R_Def_n_sw_q_612_CM 4 -32768. 32767. FORMAT "%5.0" /end AXIS_DESCR
 /begin AXIS_DESCR STD_AXIS Rf _CNV_R_R_Def_rf_sw__616_CM 4 -327.68 327.67 FORMAT "%7.4" /end AXIS_DESCR
/end CHARACTERISTIC
/begin CHARACTERISTIC KF_WG1KOR "Wastegate 1 Korrekturfaktor" MAP 0xa100c4d8 _REC_MAP_52_UBYTE_u2_u2_u2 1.9999 _CNV_R_R_Def_f_uw_b_579_CM 0. 1.9999 FORMAT "%14.5"
 /begin AXIS_DESCR STD_AXIS F_msvld_diff _CNV_R_R_Def_f_sw_b_608_CM 8 0. 3.9999 FORMAT "%14.5" /end AXIS_DESCR
 /begin AXIS_DESCR STD_AXIS Msvld _CNV_R_R_Def_ms_uw__611_CM 8 0. 2047.9687 /end AXIS_DESCR
/end CHARACTERISTIC
/begin CHARACTERISTIC KF_WG1_ZU2 "Grund - Gleichlaufkorrektur WG1 zu WG2 wegen Bauteilposition" MAP 0xa100c57c _REC_MAP_52_UBYTE_u2_u2_u2 1.9999 _CNV_R_R_Def_f_uw_b_579_CM 0. 1.9999 FORMAT "%14.5"
 /begin AXIS_DESCR STD_AXIS F_pldsvld_f _CNV_R_R_Def_f_sw_b_608_CM 8 0. 3.9999 FORMAT "%14.5" /end AXIS_DESCR
 /begin AXIS_DESCR STD_AXIS Vsvld_f _CNV_R_R_Def_vs_uw__731_CM 8 0. 1279.9804 FORMAT "%5.2" /end AXIS_DESCR
/end CHARACTERISTIC
/begin CHARACTERISTIC KL_AGRMSZYL "Kennfeld für maximales Ansteigen AGR Anforderung" CURVE 0xa100e9e4 _REC_CUR_TKL_UW_VV__u2_u2 99.9984 _CNV_R_R_Def_f_uw_b_576_CM 0. 99.9984 /begin AXIS_DESCR STD_AXIS Mszyl _CNV_R_R_Def_ms_uw__611_CM 6 0. 2047.9687 /end AXIS_DESCR /end CHARACTERISTIC
/begin CHARACTERISTIC KL_AGRTMOT "Tmot Korrektur für AGR" CURVE 0xa100ea00 _REC_CUR_TKL_UW_VV__u2_s2 1.9999 _CNV_R_R_Def_f_uw_b_579_CM 0. 1.9999 FORMAT "%14.5"
 /begin AXIS_DESCR STD_AXIS Tmot _CNV_R_R_Def_t_sw_q_620_CM 6 -327.68 327.67 FORMAT "%5.2" /end AXIS_DESCR
/end CHARACTERISTIC
/begin CHARACTERISTIC KL_ATM54_ABG "Faktor Wärmeverlust an Wand Wastegate Bank 1" CURVE 0xa100d91c _REC_CUR_TKL_UW_VV__u2_u2 0.9999 _CNV_R_R_Def_f_uw_b_591_CM 0. 0.9999 FORMAT "%14.5"
 /begin AXIS_DESCR STD_AXIS NO_INPUT_QUANTITY _CNV_R_R_Def_ms_uw__611_CM 8 0. 2047.9687 /end AXIS_DESCR
/end CHARACTERISTIC
/begin CHARACTERISTIC KL_ATM54_KAP "" CURVE 0xa100d854 _REC_CUR_TKL_UW_VV__u2_u2 1.9999 _CNV_R_R_Def_f_uw_b_579_CM 0. 1.9999 FORMAT "%14.5"
 /begin AXIS_DESCR STD_AXIS NO_INPUT_QUANTITY _CNV_R_R_Def_f_sw_b_608_CM 8 0. 3.9999 FORMAT "%14.5" /end AXIS_DESCR
/end CHARACTERISTIC
/begin CHARACTERISTIC KL_ATM_ABGR1 "Faktor Wärmeverlust an Wand vor Hauptkat Rohr 1" CURVE 0xa100d940 _REC_CUR_TKL_UW_VV__u2_u2 0.9999 _CNV_R_R_Def_f_uw_b_591_CM 0. 0.9999 FORMAT "%14.5"
 /begin AXIS_DESCR STD_AXIS NO_INPUT_QUANTITY _CNV_R_R_Def_ms_uw__611_CM 8 0. 2047.9687 /end AXIS_DESCR
/end CHARACTERISTIC
/begin CHARACTERISTIC KL_ATM_ABGR10 "Faktor Wärmeverlust an Wand nach Kat Rohr 10" CURVE 0xa100d9f4 _REC_CUR_TKL_UW_VV__u2_u2 0.9999 _CNV_R_R_Def_f_uw_b_591_CM 0. 0.9999 FORMAT "%14.5"
 /begin AXIS_DESCR STD_AXIS NO_INPUT_QUANTITY _CNV_R_R_Def_ms_uw__611_CM 8 0. 2047.9687 /end AXIS_DESCR
/end CHARACTERISTIC
/begin CHARACTERISTIC KL_ATM_ABGR11 "Faktor Wärmeverlust an Wand vor Hauptkat Rohr 11" CURVE 0xa100dbb0 _REC_CUR_TKL_UW_VV__u2_u2 0.9999 _CNV_R_R_Def_f_uw_b_591_CM 0. 0.9999 FORMAT "%14.5"
 /begin AXIS_DESCR STD_AXIS NO_INPUT_QUANTITY _CNV_R_R_Def_ms_uw__611_CM 8 0. 2047.9687 /end AXIS_DESCR
/end CHARACTERISTIC
/begin CHARACTERISTIC KL_ATM_ABGR11A "Faktor Wärmeverlust an Wand vor Hauptkat Rohr 11a (AGR)" CURVE 0xa100dbd4 _REC_CUR_TKL_UW_VV__u2_u2 0.9999 _CNV_R_R_Def_f_uw_b_591_CM 0. 0.9999 FORMAT "%14.5"
 /begin AXIS_DESCR STD_AXIS NO_INPUT_QUANTITY _CNV_R_R_Def_ms_uw__611_CM 8 0. 2047.9687 /end AXIS_DESCR
/end CHARACTERISTIC
/begin CHARACTERISTIC KL_ATM_ABGR12 "Faktor Wärmeverlust an Wand vor Hauptkat Rohr 12" CURVE 0xa100dbf8 _REC_CUR_TKL_UW_VV__u2_u2 0.9999 _CNV_R_R_Def_f_uw_b_591_CM 0. 0.9999 FORMAT "%14.5"
 /begin AXIS_DESCR STD_AXIS NO_INPUT_QUANTITY _CNV_R_R_Def_ms_uw__611_CM 8 0. 2047.9687 /end AXIS_DESCR
/end CHARACTERISTIC
/begin CHARACTERISTIC KL_ATM_ABGR12A "Faktor Wärmeverlust an Wand vor Hauptkat Rohr 12a" CURVE 0xa100dc1c _REC_CUR_TKL_UW_VV__u2_u2 0.9999 _CNV_R_R_Def_f_uw_b_591_CM 0. 0.9999 FORMAT "%14.5"
 /begin AXIS_DESCR STD_AXIS NO_INPUT_QUANTITY _CNV_R_R_Def_ms_uw__611_CM 8 0. 2047.9687 /end AXIS_DESCR
/end CHARACTERISTIC
/begin CHARACTERISTIC KL_ATM_ABGR13 "Faktor Wärmeverlust an Wand vor Hauptkat Rohr 13" CURVE 0xa100dc40 _REC_CUR_TKL_UW_VV__u2_u2 0.9999 _CNV_R_R_Def_f_uw_b_591_CM 0. 0.9999 FORMAT "%14.5"
 /begin AXIS_DESCR STD_AXIS NO_INPUT_QUANTITY _CNV_R_R_Def_ms_uw__611_CM 8 0. 2047.9687 /end AXIS_DESCR
/end CHARACTERISTIC
/begin CHARACTERISTIC KL_ATM_ABGR14 "Faktor Wärmeverlust an Wand vor Hauptkat Rohr 14" CURVE 0xa100dc64 _REC_CUR_TKL_UW_VV__u2_u2 0.9999 _CNV_R_R_Def_f_uw_b_591_CM 0. 0.9999 FORMAT "%14.5"
 /begin AXIS_DESCR STD_AXIS NO_INPUT_QUANTITY _CNV_R_R_Def_ms_uw__611_CM 8 0. 2047.9687 /end AXIS_DESCR
/end CHARACTERISTIC
/begin CHARACTERISTIC KL_ATM_ABGR14A "Faktor Wärmeverlust an Wand vor Hauptkat Rohr 14a" CURVE 0xa100dc88 _REC_CUR_TKL_UW_VV__u2_u2 0.9999 _CNV_R_R_Def_f_uw_b_591_CM 0. 0.9999 FORMAT "%14.5"
 /begin AXIS_DESCR STD_AXIS NO_INPUT_QUANTITY _CNV_R_R_Def_ms_uw__611_CM 8 0. 2047.9687 /end AXIS_DESCR
/end CHARACTERISTIC
/begin CHARACTERISTIC KL_ATM_ABGR15 "Faktor Wärmeverlust an Wand vor Hauptkat Rohr 15" CURVE 0xa100dcac _REC_CUR_TKL_UW_VV__u2_u2 0.9999 _CNV_R_R_Def_f_uw_b_591_CM 0. 0.9999 FORMAT "%14.5"
 /begin AXIS_DESCR STD_AXIS NO_INPUT_QUANTITY _CNV_R_R_Def_ms_uw__611_CM 8 0. 2047.9687 /end AXIS_DESCR
/end CHARACTERISTIC
/begin CHARACTERISTIC KL_ATM_ABGR16 "Faktor Wärmeverlust an Wand vor Hauptkat Rohr 16" CURVE 0xa100dcd0 _REC_CUR_TKL_UW_VV__u2_u2 0.9999 _CNV_R_R_Def_f_uw_b_591_CM 0. 0.9999 FORMAT "%14.5"
 /begin AXIS_DESCR STD_AXIS NO_INPUT_QUANTITY _CNV_R_R_Def_ms_uw__611_CM 8 0. 2047.9687 /end AXIS_DESCR
/end CHARACTERISTIC
/begin CHARACTERISTIC KL_ATM_ABGR4 "Faktor Wärmeverlust an Wand vor Hauptkat Rohr 4" CURVE 0xa100d964 _REC_CUR_TKL_UW_VV__u2_u2 0.9999 _CNV_R_R_Def_f_uw_b_591_CM 0. 0.9999 FORMAT "%14.5"
 /begin AXIS_DESCR STD_AXIS NO_INPUT_QUANTITY _CNV_R_R_Def_ms_uw__611_CM 8 0. 2047.9687 /end AXIS_DESCR
/end CHARACTERISTIC
/begin CHARACTERISTIC KL_ATM_ABGR7 "Faktor Wärmeverlust an Wand vor Hauptkat Rohr 7" CURVE 0xa100d988 _REC_CUR_TKL_UW_VV__u2_u2 0.9999 _CNV_R_R_Def_f_uw_b_591_CM 0. 0.9999 FORMAT "%14.5"
 /begin AXIS_DESCR STD_AXIS NO_INPUT_QUANTITY _CNV_R_R_Def_ms_uw__611_CM 8 0. 2047.9687 /end AXIS_DESCR
/end CHARACTERISTIC
/begin CHARACTERISTIC KL_ATM_ABGR8 "Faktor Wärmeverlust an Wand vor Hauptkat Rohr 8" CURVE 0xa100d9ac _REC_CUR_TKL_UW_VV__u2_u2 0.9999 _CNV_R_R_Def_f_uw_b_591_CM 0. 0.9999 FORMAT "%14.5"
 /begin AXIS_DESCR STD_AXIS NO_INPUT_QUANTITY _CNV_R_R_Def_ms_uw__611_CM 8 0. 2047.9687 /end AXIS_DESCR
/end CHARACTERISTIC
/begin CHARACTERISTIC KL_ATM_ABGR9 "Faktor Wärmeverlust an Wand nach Kat Rohr 9" CURVE 0xa100d9d0 _REC_CUR_TKL_UW_VV__u2_u2 0.9999 _CNV_R_R_Def_f_uw_b_591_CM 0. 0.9999 FORMAT "%14.5"
 /begin AXIS_DESCR STD_AXIS NO_INPUT_QUANTITY _CNV_R_R_Def_ms_uw__611_CM 8 0. 2047.9687 /end AXIS_DESCR
/end CHARACTERISTIC
/begin CHARACTERISTIC KL_ATM_ABST "Faktor Einfluß Abstellzeit auf Abkühlung Abgasanlage" CURVE 0xa100d244 _REC_CUR_TKL_UW_VV__u1_u2 0.996 _CNV_R_R_Def_f_ub_b_573_CM 0. 0.996
 /begin AXIS_DESCR STD_AXIS Tn_abstell _CNV_R_R_Def_dez_sl_575_CM 6 0. 65535. FORMAT "%5.0" /end AXIS_DESCR
/end CHARACTERISTIC
/begin CHARACTERISTIC KL_ATM_ABSTNK "Faktor Einfluß Abstellzeit auf Abkühlung Abgasanlage nach Kat" CURVE 0xa100d258 _REC_CUR_TKL_UW_VV__u1_u2 0.996 _CNV_R_R_Def_f_ub_b_573_CM 0. 0.996
 /begin AXIS_DESCR STD_AXIS Tn_abstell _CNV_R_R_Def_dez_sl_575_CM 6 0. 65535. FORMAT "%5.0" /end AXIS_DESCR
/end CHARACTERISTIC
/begin CHARACTERISTIC KL_ATM_DTSL "Temperaturänderung durch Sekundärluft" CURVE 0xa100d140 _REC_CUR_TKL_UW_VV__s2_u2 131.07 _CNV_R_R_Def_t_sw_q_618_CM -3276.8 3276.7 FORMAT "%4.1" /begin AXIS_DESCR STD_AXIS Ms_sl _CNV_R_R_Def_ms_uw__611_CM 4 0. 2047.9687 /end AXIS_DESCR /end CHARACTERISTIC
/begin CHARACTERISTIC KL_ATM_DTTMOT "Temperaturänderung durch Motortemperatur" CURVE 0xa100d164 _REC_CUR_TKL_UW_VV__s2_s2 131.07 _CNV_R_R_Def_t_sw_q_618_CM -3276.8 3276.7 FORMAT "%4.1"
 /begin AXIS_DESCR STD_AXIS Tmot _CNV_R_R_Def_t_sw_q_620_CM 4 -327.68 327.67 FORMAT "%5.2" /end AXIS_DESCR
/end CHARACTERISTIC
/begin CHARACTERISTIC KL_ATM_DV "Geschwindigkeitskorrektur über Lüfter-PWM" CURVE 0xa100d1e0 _REC_CUR_TKL_UW_VV__u1_u1 99.45 _CNV_R_R_Def_v_ub_q_742_CM 0. 153. FORMAT "%5.2"
 /begin AXIS_DESCR STD_AXIS L_pwmout _CNV_R_R_Def_f_ub_b_602_CM 5 0. 99.60930000000001 FORMAT "%5.2" /end AXIS_DESCR
/end CHARACTERISTIC
/begin CHARACTERISTIC KL_ATM_FLA "Korrektur Lambdaeinfluß für mageren Bauteilschutz" CURVE 0xa100d178 _REC_CUR_TKL_UW_VV__u1_u2 1.9921 _CNV_R_R_Def_f_ub_b_625_CM 0. 1.9921
 /begin AXIS_DESCR STD_AXIS NO_INPUT_QUANTITY _CNV_R_R_Def_f_uw_b_594_CM 6 0. 15.9997 FORMAT "%7.4" /end AXIS_DESCR
/end CHARACTERISTIC
/begin CHARACTERISTIC KL_ATM_FLAM "Faktor Einfluß Lambda auf Enthalpiekorrektur" CURVE 0xa100d1a8 _REC_CUR_TKL_UW_VV__u2_u2 1.9999 _CNV_R_R_Def_f_uw_b_579_CM 0. 1.9999 FORMAT "%14.5"
 /begin AXIS_DESCR STD_AXIS La_ist1 _CNV_R_R_Def_f_uw_b_594_CM 6 0. 15.9997 FORMAT "%7.4" /end AXIS_DESCR
/end CHARACTERISTIC
/begin CHARACTERISTIC KL_ATM_FSA "Filterfaktor fuer Abgastemperatur bei Schubabschaltung" CURVE 0xa100d100 _REC_CUR_TKL_UW_VV__u2_u2 65.535 _CNV_R_R_Def_td_uw__592_CM 0. 65.535
 /begin AXIS_DESCR STD_AXIS Mszyl_int _CNV_R_R_Def_m_uw_q_666_CM 8 0. 20.0229 FORMAT "%7.4" /end AXIS_DESCR
/end CHARACTERISTIC
/begin CHARACTERISTIC KL_ATM_FSL "Gewichtung Temperaturänderung durch Sekundärluft" CURVE 0xa100d154 _REC_CUR_TKL_UW_VV__u1_u2 1. _CNV_R_R_Def_f_ub_b_743_CM 0. 1. /begin AXIS_DESCR STD_AXIS Mszyl _CNV_R_R_Def_ms_uw__611_CM 4 0. 2047.9687 /end AXIS_DESCR /end CHARACTERISTIC
/begin CHARACTERISTIC KL_ATM_FVBANK "Korrekturfaktor für Geschwindigkeitskorrektur Bank 2" CURVE 0xa100d208 _REC_CUR_TKL_UW_VV__u1_u2 1.9921 _CNV_R_R_Def_f_ub_b_625_CM 0. 1.9921
 /begin AXIS_DESCR STD_AXIS V _CNV_R_R_Def_v_uw_q_723_CM 5 0. 360. FORMAT "%5.0" /end AXIS_DESCR
/end CHARACTERISTIC
/begin CHARACTERISTIC KL_ATM_FVLK0 "Faktor zur Geschwindigkeitskorrektur über Lüfter-PWM bei Lüfterklappenstellung 0" CURVE 0xa100d21c _REC_CUR_TKL_UW_VV__u1_u2 1.9921 _CNV_R_R_Def_f_ub_b_625_CM 0. 1.9921
 /begin AXIS_DESCR STD_AXIS V _CNV_R_R_Def_v_uw_q_723_CM 5 0. 360. FORMAT "%5.0" /end AXIS_DESCR
/end CHARACTERISTIC
/begin CHARACTERISTIC KL_ATM_FVLK1 "Faktor zur Geschwindigkeitskorrektur über Lüfter-PWM bei Lüfterklappenstellung 1" CURVE 0xa100d230 _REC_CUR_TKL_UW_VV__u1_u2 1.9921 _CNV_R_R_Def_f_ub_b_625_CM 0. 1.9921
 /begin AXIS_DESCR STD_AXIS V _CNV_R_R_Def_v_uw_q_723_CM 5 0. 360. FORMAT "%5.0" /end AXIS_DESCR
/end CHARACTERISTIC
/begin CHARACTERISTIC KL_ATM_LK_DV "Geschwindigkeitskorrektur über Lüfterklappenstellung" CURVE 0xa100d1f0 _REC_CUR_TKL_UW_VV__s2_u2 100.8 _CNV_R_R_Def_v_uw_q_723_CM -180. 180. FORMAT "%5.0"
 /begin AXIS_DESCR STD_AXIS V _CNV_R_R_Def_v_uw_q_723_CM 5 0. 360. FORMAT "%5.0" /end AXIS_DESCR
/end CHARACTERISTIC
/begin CHARACTERISTIC KL_ATM_LK_V "Korrektur der Fahrzeuggeschwindigkeit durch Kühlkanal" CURVE 0xa100d26c _REC_CUR_TKL_UW_VV__u2_u2 100.8 _CNV_R_R_Def_v_uw_q_723_CM 0. 360. FORMAT "%5.0"
 /begin AXIS_DESCR STD_AXIS V_atm_b1 _CNV_R_R_Def_v_uw_q_723_CM 8 0. 360. FORMAT "%5.0" /end AXIS_DESCR
/end CHARACTERISTIC
/begin CHARACTERISTIC KL_ATM_RUMG1 "Wärmeverlust von Rohr vor Hauptkat an Umgebung durch Fahrtwind Rohr 1" CURVE 0xa100da60 _REC_CUR_TKL_UW_VV__s2_u2 99.83843999999999 _CNV_R_R_Def_cxm_sw_637_CM -128. 127.996
 /begin AXIS_DESCR STD_AXIS V_atm_b1 _CNV_R_R_Def_v_uw_q_723_CM 8 0. 360. FORMAT "%5.0" /end AXIS_DESCR
/end CHARACTERISTIC
/begin CHARACTERISTIC KL_ATM_RUMG10 "Wärmeverlust von Rohr nach Kat an Umgebung durch Fahrtwind Rohr 10" CURVE 0xa100db14 _REC_CUR_TKL_UW_VV__s2_u2 99.83843999999999 _CNV_R_R_Def_cxm_sw_637_CM -128. 127.996
 /begin AXIS_DESCR STD_AXIS V_atm_b2 _CNV_R_R_Def_v_uw_q_723_CM 8 0. 360. FORMAT "%5.0" /end AXIS_DESCR
/end CHARACTERISTIC
/begin CHARACTERISTIC KL_ATM_RUMG11 "Wärmeverlust von Rohr vor Hauptkat an Umgebung durch Fahrtwind Rohr 11" CURVE 0xa100dcf4 _REC_CUR_TKL_UW_VV__s2_u2 99.83843999999999 _CNV_R_R_Def_cxm_sw_637_CM -128. 127.996
 /begin AXIS_DESCR STD_AXIS V _CNV_R_R_Def_v_uw_q_723_CM 8 0. 360. FORMAT "%5.0" /end AXIS_DESCR
/end CHARACTERISTIC
/begin CHARACTERISTIC KL_ATM_RUMG11A "Wärmeverlust von Rohr vor Hauptkat an Umgebung durch Fahrtwind Rohr 11a (AGR)" CURVE 0xa100dd18 _REC_CUR_TKL_UW_VV__s2_u2 99.83843999999999 _CNV_R_R_Def_cxm_sw_637_CM -128. 127.996
 /begin AXIS_DESCR STD_AXIS V _CNV_R_R_Def_v_uw_q_723_CM 8 0. 360. FORMAT "%5.0" /end AXIS_DESCR
/end CHARACTERISTIC
/begin CHARACTERISTIC KL_ATM_RUMG12 "Wärmeverlust von Rohr vor Hauptkat an Umgebung durch Fahrtwind Rohr 12" CURVE 0xa100dd3c _REC_CUR_TKL_UW_VV__s2_u2 99.83843999999999 _CNV_R_R_Def_cxm_sw_637_CM -128. 127.996
 /begin AXIS_DESCR STD_AXIS V _CNV_R_R_Def_v_uw_q_723_CM 8 0. 360. FORMAT "%5.0" /end AXIS_DESCR
/end CHARACTERISTIC
/begin CHARACTERISTIC KL_ATM_RUMG12A "Wärmeverlust von Rohr vor Hauptkat an Umgebung durch Fahrtwind Rohr 12a" CURVE 0xa100dd60 _REC_CUR_TKL_UW_VV__s2_u2 99.83843999999999 _CNV_R_R_Def_cxm_sw_637_CM -128. 127.996
 /begin AXIS_DESCR STD_AXIS V _CNV_R_R_Def_v_uw_q_723_CM 8 0. 360. FORMAT "%5.0" /end AXIS_DESCR
/end CHARACTERISTIC
/begin CHARACTERISTIC KL_ATM_RUMG13 "Wärmeverlust von Rohr vor Hauptkat an Umgebung durch Fahrtwind Rohr 13" CURVE 0xa100dd84 _REC_CUR_TKL_UW_VV__s2_u2 99.83843999999999 _CNV_R_R_Def_cxm_sw_637_CM -128. 127.996
 /begin AXIS_DESCR STD_AXIS V _CNV_R_R_Def_v_uw_q_723_CM 8 0. 360. FORMAT "%5.0" /end AXIS_DESCR
/end CHARACTERISTIC
/begin CHARACTERISTIC KL_ATM_RUMG14 "Wärmeverlust von Rohr vor Hauptkat an Umgebung durch Fahrtwind Rohr 14" CURVE 0xa100dda8 _REC_CUR_TKL_UW_VV__s2_u2 99.83843999999999 _CNV_R_R_Def_cxm_sw_637_CM -128. 127.996
 /begin AXIS_DESCR STD_AXIS V _CNV_R_R_Def_v_uw_q_723_CM 8 0. 360. FORMAT "%5.0" /end AXIS_DESCR
/end CHARACTERISTIC
/begin CHARACTERISTIC KL_ATM_RUMG14A "Wärmeverlust von Rohr vor Hauptkat an Umgebung durch Fahrtwind Rohr 14a" CURVE 0xa100ddcc _REC_CUR_TKL_UW_VV__s2_u2 99.83843999999999 _CNV_R_R_Def_cxm_sw_637_CM -128. 127.996
 /begin AXIS_DESCR STD_AXIS V _CNV_R_R_Def_v_uw_q_723_CM 8 0. 360. FORMAT "%5.0" /end AXIS_DESCR
/end CHARACTERISTIC
/begin CHARACTERISTIC KL_ATM_RUMG15 "Wärmeverlust von Rohr vor Hauptkat an Umgebung durch Fahrtwind Rohr 15" CURVE 0xa100ddf0 _REC_CUR_TKL_UW_VV__s2_u2 99.83843999999999 _CNV_R_R_Def_cxm_sw_637_CM -128. 127.996
 /begin AXIS_DESCR STD_AXIS V _CNV_R_R_Def_v_uw_q_723_CM 8 0. 360. FORMAT "%5.0" /end AXIS_DESCR
/end CHARACTERISTIC
/begin CHARACTERISTIC KL_ATM_RUMG16 "Wärmeverlust von Rohr vor Hauptkat an Umgebung durch Fahrtwind Rohr 16" CURVE 0xa100de14 _REC_CUR_TKL_UW_VV__s2_u2 99.83843999999999 _CNV_R_R_Def_cxm_sw_637_CM -128. 127.996
 /begin AXIS_DESCR STD_AXIS V _CNV_R_R_Def_v_uw_q_723_CM 8 0. 360. FORMAT "%5.0" /end AXIS_DESCR
/end CHARACTERISTIC
/begin CHARACTERISTIC KL_ATM_RUMG4 "Wärmeverlust von Rohr vor Hauptkat an Umgebung durch Fahrtwind Rohr 4" CURVE 0xa100da84 _REC_CUR_TKL_UW_VV__s2_u2 99.83843999999999 _CNV_R_R_Def_cxm_sw_637_CM -128. 127.996
 /begin AXIS_DESCR STD_AXIS V_atm_b2 _CNV_R_R_Def_v_uw_q_723_CM 8 0. 360. FORMAT "%5.0" /end AXIS_DESCR
/end CHARACTERISTIC
/begin CHARACTERISTIC KL_ATM_RUMG7 "Wärmeverlust von Rohr vor Hauptkat an Umgebung durch Fahrtwind Rohr 7" CURVE 0xa100daa8 _REC_CUR_TKL_UW_VV__s2_u2 99.83843999999999 _CNV_R_R_Def_cxm_sw_637_CM -128. 127.996
 /begin AXIS_DESCR STD_AXIS V_atm_b1 _CNV_R_R_Def_v_uw_q_723_CM 8 0. 360. FORMAT "%5.0" /end AXIS_DESCR
/end CHARACTERISTIC
/begin CHARACTERISTIC KL_ATM_RUMG8 "Wärmeverlust von Rohr vor Hauptkat an Umgebung durch Fahrtwind Rohr 8" CURVE 0xa100dacc _REC_CUR_TKL_UW_VV__s2_u2 99.83843999999999 _CNV_R_R_Def_cxm_sw_637_CM -128. 127.996
 /begin AXIS_DESCR STD_AXIS V_atm_b2 _CNV_R_R_Def_v_uw_q_723_CM 8 0. 360. FORMAT "%5.0" /end AXIS_DESCR
/end CHARACTERISTIC
/begin CHARACTERISTIC KL_ATM_RUMG9 "Wärmeverlust von Rohr nach Kat an Umgebung durch Fahrtwind Rohr 9" CURVE 0xa100daf0 _REC_CUR_TKL_UW_VV__s2_u2 99.83843999999999 _CNV_R_R_Def_cxm_sw_637_CM -128. 127.996
 /begin AXIS_DESCR STD_AXIS V_atm_b1 _CNV_R_R_Def_v_uw_q_723_CM 8 0. 360. FORMAT "%5.0" /end AXIS_DESCR
/end CHARACTERISTIC
/begin CHARACTERISTIC KL_ATM_RUMGT1 "Wärmeverlust von Wastegate an Umgebung durch Fahrtwind Bank 1" CURVE 0xa100da18 _REC_CUR_TKL_UW_VV__s2_u2 99.83843999999999 _CNV_R_R_Def_cxm_sw_637_CM -128. 127.996
 /begin AXIS_DESCR STD_AXIS V_atm_b1 _CNV_R_R_Def_v_uw_q_723_CM 8 0. 360. FORMAT "%5.0" /end AXIS_DESCR
/end CHARACTERISTIC
/begin CHARACTERISTIC KL_ATM_RUMGT2 "Wärmeverlust von Wastegate an Umgebung durch Fahrtwind Bank 2" CURVE 0xa100da3c _REC_CUR_TKL_UW_VV__s2_u2 99.83843999999999 _CNV_R_R_Def_cxm_sw_637_CM -128. 127.996
 /begin AXIS_DESCR STD_AXIS V_atm_b1 _CNV_R_R_Def_v_uw_q_723_CM 8 0. 360. FORMAT "%5.0" /end AXIS_DESCR
/end CHARACTERISTIC
/begin CHARACTERISTIC KL_ATM_TKA_FV "Geschwindigkeitsabhängigkeit Motorraumtemperatur" CURVE 0xa100d1c4 _REC_CUR_TKL_UW_VV__u1_u2 1.9921 _CNV_R_R_Def_f_ub_b_625_CM 0. 1.9921
 /begin AXIS_DESCR STD_AXIS V_atm_b1 _CNV_R_R_Def_v_uw_q_723_CM 8 0. 360. FORMAT "%5.0" /end AXIS_DESCR
/end CHARACTERISTIC
/begin CHARACTERISTIC KL_ATM_TMOTSA "Offset auf Abgasendtemperatur bei Schubabschaltung" CURVE 0xa100d124 _REC_CUR_TKL_UW_VV__s2_u2 98.30250000000001 _CNV_R_R_Def_t_sw_q_620_CM -327.68 327.67 FORMAT "%5.2" /begin AXIS_DESCR STD_AXIS Mszyl _CNV_R_R_Def_ms_uw__611_CM 6 0. 2047.9687 /end AXIS_DESCR /end CHARACTERISTIC
/begin CHARACTERISTIC KL_BS_I_NOK "I-Anteil PID-Regler Bauteilschutz NOx-Kat" CURVE 0xa100cd58 _REC_CUR_TKL_UW_VV__u2_u2 1.9999 _CNV_R_R_Def_f_uw_b_579_CM 0. 1.9999 FORMAT "%14.5" /begin AXIS_DESCR STD_AXIS Mszyl _CNV_R_R_Def_ms_uw__611_CM 4 0. 2047.9687 /end AXIS_DESCR /end CHARACTERISTIC
/begin CHARACTERISTIC KL_BS_P_NOK "P-Anteil PID-Regler Bauteilschutz NOx-Kat" CURVE 0xa100cd44 _REC_CUR_TKL_UW_VV__u2_u2 63.99900000000001 _CNV_R_R_Def_f_uw_b_580_CM 0. 63.999 FORMAT "%7.4" /begin AXIS_DESCR STD_AXIS Mszyl _CNV_R_R_Def_ms_uw__611_CM 4 0. 2047.9687 /end AXIS_DESCR /end CHARACTERISTIC
/begin CHARACTERISTIC KL_BS_ZKNN "Filterkonstante für Filterung KNN-Vorsteuerwert" CURVE 0xa100cd28 _REC_CUR_TKL_UW_VV__u2_u2 65.535 _CNV_R_R_Def_td_uw__592_CM 0. 65.535 /begin AXIS_DESCR STD_AXIS Mszyl _CNV_R_R_Def_ms_uw__611_CM 6 0. 2047.9687 /end AXIS_DESCR /end CHARACTERISTIC
/begin CHARACTERISTIC KL_FKWG1KOR "Filterkonstante für WG1KOR LowPass" CURVE 0xa100c490 _REC_CUR_TKL_UW_VV__u2_s2 0.9999847412109381 _CNV_R_R_Def_f_uw_b_591_CM 0. 0.9999847412109381 FORMAT "%14.5"
 /begin AXIS_DESCR STD_AXIS Pldrsoll_dyn _CNV_R_R_Def_p_sw_q_578_CM 8 -1280. 1279.9609 FORMAT "%5.2" /end AXIS_DESCR
/end CHARACTERISTIC
/begin CHARACTERISTIC KL_IKWG1K "Integrierbeiwert f. Adaption" CURVE 0xa100c4b4 _REC_CUR_TKL_UW_VV__u2_u2 0.9999847412109381 _CNV_R_R_Def_f_uw_b_591_CM 0. 0.9999847412109381 FORMAT "%14.5"
 /begin AXIS_DESCR STD_AXIS Vsvld_f _CNV_R_R_Def_vs_uw__731_CM 8 0. 1279.9804 FORMAT "%5.2" /end AXIS_DESCR
/end CHARACTERISTIC
/begin CHARACTERISTIC KL_K_EXH_LA "Einfluß Lambda auf Exothermie im Kat bei Homogenbetrieb" CURVE 0xa100d674 _REC_CUR_TKL_UW_VV__u1_u2 2.55 _CNV_R_R_Def_lf_ub__675_CM 0. 2.55
 /begin AXIS_DESCR STD_AXIS NO_INPUT_QUANTITY _CNV_R_R_Def_f_uw_b_594_CM 10 0. 15.9997 FORMAT "%7.4" /end AXIS_DESCR
/end CHARACTERISTIC
/begin CHARACTERISTIC KL_K_EXH_MS "Einfluß Mszyl auf Exothermie im Kat bei Homogenbetrieb" CURVE 0xa100db90 _REC_CUR_TKL_UW_VV__u1_u2 99.609375 _CNV_R_R_Def_t_ub_b_745_CM 0. 398.4375 /begin AXIS_DESCR STD_AXIS Mszyl _CNV_R_R_Def_ms_uw__611_CM 10 0. 2047.9687 /end AXIS_DESCR /end CHARACTERISTIC
/begin CHARACTERISTIC KL_K_EXS_LA "Einfluß Lambda auf Exothermie im Kat bei Schichtbetrieb" CURVE 0xa100d694 _REC_CUR_TKL_UW_VV__u1_u2 2.55 _CNV_R_R_Def_lf_ub__675_CM 0. 2.55
 /begin AXIS_DESCR STD_AXIS NO_INPUT_QUANTITY _CNV_R_R_Def_f_uw_b_594_CM 10 0. 15.9997 FORMAT "%7.4" /end AXIS_DESCR
/end CHARACTERISTIC
/begin CHARACTERISTIC KL_K_EXS_MS "Einfluß Mszyl auf Exothermie im Kat bei Schichtbetrieb" CURVE 0xa100db70 _REC_CUR_TKL_UW_VV__u1_u2 99.609375 _CNV_R_R_Def_t_ub_b_745_CM 0. 398.4375 /begin AXIS_DESCR STD_AXIS Mszyl _CNV_R_R_Def_ms_uw__611_CM 10 0. 2047.9687 /end AXIS_DESCR /end CHARACTERISTIC
/begin CHARACTERISTIC KL_K_T_DEC1 "Zeitkonstante für Integrator T_ikat bei fallender Temperatur" CURVE 0xa100d70c _REC_CUR_TKL_UW_VV__u2_u2 65.535 _CNV_R_R_Def_td_uw__592_CM 0. 65.535 /begin AXIS_DESCR STD_AXIS Mszyl _CNV_R_R_Def_ms_uw__611_CM 10 0. 2047.9687 /end AXIS_DESCR /end CHARACTERISTIC
/begin CHARACTERISTIC KL_K_T_DEC2 "Zeitkonstante für Integrator Tabg_nk bei fallender Temperatur" CURVE 0xa100d738 _REC_CUR_TKL_UW_VV__u2_u2 65.535 _CNV_R_R_Def_td_uw__592_CM 0. 65.535 /begin AXIS_DESCR STD_AXIS Mszyl _CNV_R_R_Def_ms_uw__611_CM 10 0. 2047.9687 /end AXIS_DESCR /end CHARACTERISTIC
/begin CHARACTERISTIC KL_K_T_INC1 "Zeitkonstante für Integrator T_ikat bei steigender Temperatur" CURVE 0xa100d6b4 _REC_CUR_TKL_UW_VV__u2_u2 65.535 _CNV_R_R_Def_td_uw__592_CM 0. 65.535 /begin AXIS_DESCR STD_AXIS Mszyl _CNV_R_R_Def_ms_uw__611_CM 10 0. 2047.9687 /end AXIS_DESCR /end CHARACTERISTIC
/begin CHARACTERISTIC KL_K_T_INC2 "Zeitkonstante für Integrator Tabg_nk bei steigender Temperatur" CURVE 0xa100d6e0 _REC_CUR_TKL_UW_VV__u2_u2 65.535 _CNV_R_R_Def_td_uw__592_CM 0. 65.535 /begin AXIS_DESCR STD_AXIS Mszyl _CNV_R_R_Def_ms_uw__611_CM 10 0. 2047.9687 /end AXIS_DESCR /end CHARACTERISTIC
/begin CHARACTERISTIC KL_LAMBAGR "Grundkennfeld für Homogenbetrieb AGR" CURVE 0xa100ea1c _REC_CUR_TKL_UW_VV__u2_u2 99.9984 _CNV_R_R_Def_f_uw_b_576_CM 0. 99.9984
 /begin AXIS_DESCR STD_AXIS La_soll _CNV_R_R_Def_f_uw_b_594_CM 6 0. 15.9997 FORMAT "%7.4" /end AXIS_DESCR
/end CHARACTERISTIC
/begin CHARACTERISTIC KL_N_EX_LA "Einfluß Lambda auf Exothermie im NoX-Kat" CURVE 0xa100d814 _REC_CUR_TKL_UW_VV__u1_u2 2.55 _CNV_R_R_Def_lf_ub__675_CM 0. 2.55
 /begin AXIS_DESCR STD_AXIS NO_INPUT_QUANTITY _CNV_R_R_Def_f_uw_b_594_CM 10 0. 15.9997 FORMAT "%7.4" /end AXIS_DESCR
/end CHARACTERISTIC
/begin CHARACTERISTIC KL_N_EX_MS "Einfluß Mszyl auf Exothermie im NoX-Kat" CURVE 0xa100d834 _REC_CUR_TKL_UW_VV__u1_u2 99.609375 _CNV_R_R_Def_t_ub_b_745_CM 0. 398.4375 /begin AXIS_DESCR STD_AXIS Mszyl _CNV_R_R_Def_ms_uw__611_CM 10 0. 2047.9687 /end AXIS_DESCR /end CHARACTERISTIC
/begin CHARACTERISTIC KL_N_T_DECA "Zeitkonstante für Integrator Tabg_inok bei fallender Temperatur" CURVE 0xa100d790 _REC_CUR_TKL_UW_VV__u2_u2 65.535 _CNV_R_R_Def_td_uw__592_CM 0. 65.535 /begin AXIS_DESCR STD_AXIS Mszyl _CNV_R_R_Def_ms_uw__611_CM 10 0. 2047.9687 /end AXIS_DESCR /end CHARACTERISTIC
/begin CHARACTERISTIC KL_N_T_DECB "Zeitkonstante für Integrator Tabg_nnok bei fallender Temperatur" CURVE 0xa100d7e8 _REC_CUR_TKL_UW_VV__u2_u2 65.535 _CNV_R_R_Def_td_uw__592_CM 0. 65.535 /begin AXIS_DESCR STD_AXIS Mszyl _CNV_R_R_Def_ms_uw__611_CM 10 0. 2047.9687 /end AXIS_DESCR /end CHARACTERISTIC
/begin CHARACTERISTIC KL_N_T_INCA "Zeitkonstante für Integrator Tabg_inok bei steigender Temperatur" CURVE 0xa100d764 _REC_CUR_TKL_UW_VV__u2_u2 65.535 _CNV_R_R_Def_td_uw__592_CM 0. 65.535 /begin AXIS_DESCR STD_AXIS Mszyl _CNV_R_R_Def_ms_uw__611_CM 10 0. 2047.9687 /end AXIS_DESCR /end CHARACTERISTIC
/begin CHARACTERISTIC KL_N_T_INCB "Zeitkonstante für Integrator Tabg_nnok bei steigender Temperatur" CURVE 0xa100d7bc _REC_CUR_TKL_UW_VV__u2_u2 65.535 _CNV_R_R_Def_td_uw__592_CM 0. 65.535 /begin AXIS_DESCR STD_AXIS Mszyl _CNV_R_R_Def_ms_uw__611_CM 10 0. 2047.9687 /end AXIS_DESCR /end CHARACTERISTIC
/begin CHARACTERISTIC KL_PLDLEK_MN "Unterer Grenzwert für Leckage-Bestimmung" CURVE 0xa100c458 _REC_CUR_TKL_UW_VV__u2_s2 3.9999 _CNV_R_R_Def_f_sw_b_608_CM 0. 3.9999 FORMAT "%14.5"
 /begin AXIS_DESCR STD_AXIS Nkw _CNV_R_R_Def_n_sw_q_612_CM 6 -32768. 32767. FORMAT "%5.0" /end AXIS_DESCR
/end CHARACTERISTIC
/begin CHARACTERISTIC KL_PLDLEK_MX "Oberer Grenzwert für Leckage-Bestimmung" CURVE 0xa100c43c _REC_CUR_TKL_UW_VV__u2_s2 3.9999 _CNV_R_R_Def_f_sw_b_608_CM 0. 3.9999 FORMAT "%14.5"
 /begin AXIS_DESCR STD_AXIS Nkw _CNV_R_R_Def_n_sw_q_612_CM 6 -32768. 32767. FORMAT "%5.0" /end AXIS_DESCR
/end CHARACTERISTIC
/begin CHARACTERISTIC KL_PLDPUMPMN "Rel. Ladedruck f. Pumpbestimmung" CURVE 0xa100c62c _REC_CUR_TKL_UW_VV__u2_s2 3.9999 _CNV_R_R_Def_f_sw_b_608_CM 0. 3.9999 FORMAT "%14.5"
 /begin AXIS_DESCR STD_AXIS Nkw _CNV_R_R_Def_n_sw_q_612_CM 8 -32768. 32767. FORMAT "%5.0" /end AXIS_DESCR
/end CHARACTERISTIC
/begin CHARACTERISTIC KL_TABGFIL "Zeitkonstante Filterbank Abgastemperatur" CURVE 0xa100d0e4 _REC_CUR_TKL_UW_VV__u2_u2 65.535 _CNV_R_R_Def_td_uw__592_CM 0. 65.535 /begin AXIS_DESCR STD_AXIS Mszyl _CNV_R_R_Def_ms_uw__611_CM 6 0. 2047.9687 /end AXIS_DESCR /end CHARACTERISTIC
/begin CHARACTERISTIC KL_TDOBAKTIV "Aktiv-Zeit Overboost Motordrehzahlabhängig" CURVE 0xa100b234 _REC_CUR_TKL_UW_VV__u1_s2 12.75 _CNV_R_R_Def_td_ub__749_CM 0. 12.75 FORMAT "%5.2"
 /begin AXIS_DESCR STD_AXIS Nkw _CNV_R_R_Def_n_sw_q_612_CM 6 -32768. 32767. FORMAT "%5.0" /end AXIS_DESCR
/end CHARACTERISTIC
/begin CHARACTERISTIC KL_TDOBSPERR "Zeit für Sperre Overboost nach Auslösung" CURVE 0xa100b220 _REC_CUR_TKL_UW_VV__u1_s2 12.75 _CNV_R_R_Def_td_ub__749_CM 0. 12.75 FORMAT "%5.2"
 /begin AXIS_DESCR STD_AXIS Nkw _CNV_R_R_Def_n_sw_q_612_CM 6 -32768. 32767. FORMAT "%5.0" /end AXIS_DESCR
/end CHARACTERISTIC
/begin CHARACTERISTIC KL_TDRFMXOB "" CURVE 0xa100b20c _REC_CUR_TKL_UW_VV__u1_s2 12.7 _CNV_R_R_Def_td_ub__749_CM 5.e-002 12.75 FORMAT "%5.2"
 /begin AXIS_DESCR STD_AXIS Nkw _CNV_R_R_Def_n_sw_q_612_CM 6 -32768. 32767. FORMAT "%5.0" /end AXIS_DESCR
/end CHARACTERISTIC
/begin CHARACTERISTIC KL_TVWGKORHO "Höhenkorrektur TV f. Wastegateansteuerung - bauteilbedingt  d. Unterdruckdose" CURVE 0xa100b348 _REC_CUR_TKL_UW_VV__u2_u2 1.9999 _CNV_R_R_Def_f_uw_b_579_CM 0. 1.9999 FORMAT "%14.5"
 /begin AXIS_DESCR STD_AXIS Pu _CNV_R_R_Def_p_sw_q_578_CM 5 0. 2559.9609 FORMAT "%5.2" /end AXIS_DESCR
/end CHARACTERISTIC
/begin CHARACTERISTIC KL_TVWG_DN "Stellwert -> Tastverhältnis f. schliessende Richtung" CURVE 0xa100b324 _REC_CUR_TKL_UW_VV__u2_u2 99.9984 _CNV_R_R_Def_f_uw_b_576_CM 0. 99.9984
 /begin AXIS_DESCR STD_AXIS NO_INPUT_QUANTITY _CNV_R_R_Def_f_uw_b_576_CM 8 0. 99.9984 /end AXIS_DESCR
/end CHARACTERISTIC
/begin CHARACTERISTIC KL_TVWG_UP "Stellwert -> Tastverhältnis f. öffnende Richtung" CURVE 0xa100b360 _REC_CUR_TKL_UW_VV__u2_u2 99.9984 _CNV_R_R_Def_f_uw_b_576_CM 0. 99.9984
 /begin AXIS_DESCR STD_AXIS NO_INPUT_QUANTITY _CNV_R_R_Def_f_uw_b_576_CM 8 0. 99.9984 /end AXIS_DESCR
/end CHARACTERISTIC
/begin CHARACTERISTIC KL_WBIAS "Gewichte der Neuronen (verst. Schicht) für Biasterm, ATMNN" CURVE 0xa100d06c _REC_CUR_20_S4_u1 11000000000000. _CNV_R_R_Def_dez_sl_575_CM -1000000000000. 10000000000000. FORMAT "%14.7"
 /begin AXIS_DESCR COM_AXIS Modelle _CNV_R_R_Def_dez_sl_575_CM 15 0. 255. FORMAT "%3.0" AXIS_PTS_REF GAX_ATMNN /end AXIS_DESCR
/end CHARACTERISTIC
/begin CHARACTERISTIC KL_WLA "Gewichte der Neuronen (verst. Schicht) für Eingang Lambda, ATMNN" CURVE 0xa100cf40 _REC_CUR_20_S4_u1 11000000000000. _CNV_R_R_Def_dez_sl_575_CM -1000000000000. 10000000000000. FORMAT "%14.7"
 /begin AXIS_DESCR COM_AXIS Modelle _CNV_R_R_Def_dez_sl_575_CM 15 0. 255. FORMAT "%3.0" AXIS_PTS_REF GAX_ATMNN /end AXIS_DESCR
/end CHARACTERISTIC
/begin CHARACTERISTIC KL_WNKW "Gewichte der Neuronen (verst. Schicht) für Eingang Drehzahl, ATMNN" CURVE 0xa100cf7c _REC_CUR_20_S4_u1 11000000000000. _CNV_R_R_Def_dez_sl_575_CM -1000000000000. 10000000000000. FORMAT "%14.7"
 /begin AXIS_DESCR COM_AXIS Modelle _CNV_R_R_Def_dez_sl_575_CM 15 0. 255. FORMAT "%3.0" AXIS_PTS_REF GAX_ATMNN /end AXIS_DESCR
/end CHARACTERISTIC
/begin CHARACTERISTIC KL_WOUT "Gewichte der Neuronen der Ausgangschicht, ATMNN" CURVE 0xa100d0a8 _REC_CUR_20_S4_u1 11000000000000. _CNV_R_R_Def_dez_sl_575_CM -1000000000000. 10000000000000. FORMAT "%14.7"
 /begin AXIS_DESCR COM_AXIS Modelle _CNV_R_R_Def_dez_sl_575_CM 15 0. 255. FORMAT "%3.0" AXIS_PTS_REF GAX_ATMNN /end AXIS_DESCR
/end CHARACTERISTIC
/begin CHARACTERISTIC KL_WRF "Gewichte der Neuronen (verst. Schicht) für Eingang Relative Füllung, ATMNN" CURVE 0xa100cfb8 _REC_CUR_20_S4_u1 11000000000000. _CNV_R_R_Def_dez_sl_575_CM -1000000000000. 10000000000000. FORMAT "%14.7"
 /begin AXIS_DESCR COM_AXIS Modelle _CNV_R_R_Def_dez_sl_575_CM 15 0. 255. FORMAT "%3.0" AXIS_PTS_REF GAX_ATMNN /end AXIS_DESCR
/end CHARACTERISTIC
/begin CHARACTERISTIC KL_WVSA "Gewichte der Neuronen (verst. Schicht) für Eingang Auslaßspreizung, ATMNN" CURVE 0xa100d030 _REC_CUR_20_S4_u1 11000000000000. _CNV_R_R_Def_dez_sl_575_CM -1000000000000. 10000000000000. FORMAT "%14.7"
 /begin AXIS_DESCR COM_AXIS Modelle _CNV_R_R_Def_dez_sl_575_CM 15 0. 255. FORMAT "%3.0" AXIS_PTS_REF GAX_ATMNN /end AXIS_DESCR
/end CHARACTERISTIC
/begin CHARACTERISTIC KL_WVSE "Gewichte der Neuronen (verst. Schicht) für Eingang Einlaßspreizung, ATMNN" CURVE 0xa100cff4 _REC_CUR_20_S4_u1 11000000000000. _CNV_R_R_Def_dez_sl_575_CM -1000000000000. 10000000000000. FORMAT "%14.7"
 /begin AXIS_DESCR COM_AXIS Modelle _CNV_R_R_Def_dez_sl_575_CM 15 0. 255. FORMAT "%3.0" AXIS_PTS_REF GAX_ATMNN /end AXIS_DESCR
/end CHARACTERISTIC
/begin CHARACTERISTIC KL_WZW "Gewichte der Neuronen (verst. Schicht) für Eingang Zündwinkel, ATMNN" CURVE 0xa100cf04 _REC_CUR_20_S4_u1 11000000000000. _CNV_R_R_Def_dez_sl_575_CM -1000000000000. 10000000000000. FORMAT "%14.7"
 /begin AXIS_DESCR COM_AXIS Modelle _CNV_R_R_Def_dez_sl_575_CM 15 0. 255. FORMAT "%3.0" AXIS_PTS_REF GAX_ATMNN /end AXIS_DESCR
/end CHARACTERISTIC
/begin CHARACTERISTIC KL_ZK_VK1 "Zeitkonstante Filter Abgastemp. vor Kat 1" CURVE 0xa100db38 _REC_CUR_TKL_UW_VV__u2_u2 65.535 _CNV_R_R_Def_td_uw__592_CM 0. 65.535 /begin AXIS_DESCR STD_AXIS Mszyl _CNV_R_R_Def_ms_uw__611_CM 6 0. 2047.9687 /end AXIS_DESCR /end CHARACTERISTIC
/begin CHARACTERISTIC KL_ZK_VK2 "Zeitkonstante Filter Abgastemp. vor Kat 1" CURVE 0xa100db54 _REC_CUR_TKL_UW_VV__u2_u2 65.535 _CNV_R_R_Def_td_uw__592_CM 0. 65.535 /begin AXIS_DESCR STD_AXIS Mszyl _CNV_R_R_Def_ms_uw__611_CM 6 0. 2047.9687 /end AXIS_DESCR /end CHARACTERISTIC
/begin CHARACTERISTIC K_AGRAUS "AGR Ratenanforderung für geschlossenes AGR" VALUE 0xa100e9dc _REC_VAL_20_u2 99.9984 _CNV_R_R_Def_f_uw_b_576_CM 0. 99.9984 /end CHARACTERISTIC
/begin CHARACTERISTIC K_AGRKLEIN "Schweelwert für geschlossenes AGR Ventil" VALUE 0xa100e9de _REC_VAL_20_u2 100. _CNV_R_R_Def_tvpwm__736_CM 0. 100. /end CHARACTERISTIC
/begin CHARACTERISTIC K_AGRSOLLAPP "Applikationswert für manuelle Agrsoll Position" VALUE 0xa100e9e0 _REC_VAL_20_u2 99.9984 _CNV_R_R_Def_f_uw_b_576_CM 0. 99.9984 /end CHARACTERISTIC
/begin CHARACTERISTIC K_ATLAD_MN "Atl-Regler Adaptionsfaktor - unterer Grenzwert" VALUE 0xa100c40c _REC_VAL_20_s2 1.9999 _CNV_R_R_Def_f_sw_b_608_CM 0. 1.9999 FORMAT "%14.5" /end CHARACTERISTIC
/begin CHARACTERISTIC K_ATLAD_MX "Atl-Regler Adaptionsfaktor - oberer Grenzwert" VALUE 0xa100c40e _REC_VAL_20_s2 1.9999 _CNV_R_R_Def_f_sw_b_608_CM 0. 1.9999 FORMAT "%14.5" /end CHARACTERISTIC
/begin CHARACTERISTIC K_ATLRPID_MN "Regelgrösse untere Schwelle" VALUE 0xa100c424 _REC_VAL_20_s2 99.99844999999999 _CNV_R_R_Def_rel_sw_584_CM -100. 99.9969 /end CHARACTERISTIC
/begin CHARACTERISTIC K_ATLRPID_MX "Regelgrösse obere Schwelle" VALUE 0xa100c426 _REC_VAL_20_s2 99.99844999999999 _CNV_R_R_Def_rel_sw_584_CM -100. 99.9969 /end CHARACTERISTIC
/begin CHARACTERISTIC K_ATM54_CPR "Absolute Wärmekapazität Wastegate = cp_Rohr * Masse Rohr Hauptkat" VALUE 0xa100d8da _REC_VAL_20_u2 163.835 _CNV_R_R_Def_cxm_uw_752_CM 0.25 16383.75 FORMAT "%5.2" /end CHARACTERISTIC
/begin CHARACTERISTIC K_ATMNN_ANZ "Anzahl Neuronen für ATMNN" VALUE 0xa100cedd _REC_VAL_20_u1 15. _CNV_R_R_Def_dez_sl_575_CM 0. 15. FORMAT "%3.0" /end CHARACTERISTIC
/begin CHARACTERISTIC K_ATMNN_EIN "Anzahl Eingänge für ATMNN" VALUE 0xa100cede _REC_VAL_20_u1 6. _CNV_R_R_Def_dez_sl_575_CM 0. 6. FORMAT "%3.0" /end CHARACTERISTIC
/begin CHARACTERISTIC K_ATMNOK_RES "Applikationseingriff Rücksetzen Rohrwandtemperatur" VALUE 0xa100d1a6 _REC_VAL_20_u1 1. _CNV_R_R_Def_dez_sl_575_CM 0. 1. FORMAT "%3.0" /end CHARACTERISTIC
/begin CHARACTERISTIC K_ATM_CPR1 "Absolute Wärmekapazität Rohr vor Hauptkat = cp_Rohr * Masse Rohr Hauptkat" VALUE 0xa100d8dc _REC_VAL_20_u2 163.835 _CNV_R_R_Def_cxm_uw_752_CM 0.25 16383.75 FORMAT "%5.2" /end CHARACTERISTIC
/begin CHARACTERISTIC K_ATM_CPR10 "Absolute Wärmekapazität Rohr nach Kat = cp_Rohr * Masse Rohr Kat" VALUE 0xa100d8ee _REC_VAL_20_u2 163.835 _CNV_R_R_Def_cxm_uw_752_CM 0.25 16383.75 FORMAT "%5.2" /end CHARACTERISTIC
/begin CHARACTERISTIC K_ATM_CPR11 "Absolute Wärmekapazität Rohr nach Kat = cp_Rohr * Masse Rohr Kat" VALUE 0xa100d902 _REC_VAL_20_u2 163.835 _CNV_R_R_Def_cxm_uw_752_CM 0.25 16383.75 FORMAT "%5.2" /end CHARACTERISTIC
/begin CHARACTERISTIC K_ATM_CPR11A "Absolute Wärmekapazität Rohr nach Kat = cp_Rohr * Masse Rohr Kat" VALUE 0xa100d904 _REC_VAL_20_u2 163.835 _CNV_R_R_Def_cxm_uw_752_CM 0.25 16383.75 FORMAT "%5.2" /end CHARACTERISTIC
/begin CHARACTERISTIC K_ATM_CPR12 "Absolute Wärmekapazität Rohr 12" VALUE 0xa100d906 _REC_VAL_20_u2 163.835 _CNV_R_R_Def_cxm_uw_752_CM 0.25 16383.75 FORMAT "%5.2" /end CHARACTERISTIC
/begin CHARACTERISTIC K_ATM_CPR12A "Absolute Wärmekapazität Rohr 12a" VALUE 0xa100d908 _REC_VAL_20_u2 163.835 _CNV_R_R_Def_cxm_uw_752_CM 0.25 16383.75 FORMAT "%5.2" /end CHARACTERISTIC
/begin CHARACTERISTIC K_ATM_CPR13 "Absolute Wärmekapazität Rohr 13" VALUE 0xa100d90a _REC_VAL_20_u2 163.835 _CNV_R_R_Def_cxm_uw_752_CM 0.25 16383.75 FORMAT "%5.2" /end CHARACTERISTIC
/begin CHARACTERISTIC K_ATM_CPR14 "Absolute Wärmekapazität Rohr 14" VALUE 0xa100d90c _REC_VAL_20_u2 163.835 _CNV_R_R_Def_cxm_uw_752_CM 0.25 16383.75 FORMAT "%5.2" /end CHARACTERISTIC
/begin CHARACTERISTIC K_ATM_CPR14A "Absolute Wärmekapazität Rohr 14a" VALUE 0xa100d90e _REC_VAL_20_u2 163.835 _CNV_R_R_Def_cxm_uw_752_CM 0.25 16383.75 FORMAT "%5.2" /end CHARACTERISTIC
/begin CHARACTERISTIC K_ATM_CPR15 "Absolute Wärmekapazität Rohr 15" VALUE 0xa100d910 _REC_VAL_20_u2 163.835 _CNV_R_R_Def_cxm_uw_752_CM 0.25 16383.75 FORMAT "%5.2" /end CHARACTERISTIC
/begin CHARACTERISTIC K_ATM_CPR16 "Absolute Wärmekapazität Rohr 16" VALUE 0xa100d912 _REC_VAL_20_u2 163.835 _CNV_R_R_Def_cxm_uw_752_CM 0.25 16383.75 FORMAT "%5.2" /end CHARACTERISTIC
/begin CHARACTERISTIC K_ATM_CPR2 "Absolute Wärmekapazität Rohr vor Hauptkat = cp_Rohr * Masse Rohr Hauptkat" VALUE 0xa100d8de _REC_VAL_20_u2 163.835 _CNV_R_R_Def_cxm_uw_752_CM 0.25 16383.75 FORMAT "%5.2" /end CHARACTERISTIC
/begin CHARACTERISTIC K_ATM_CPR3 "Absolute Wärmekapazität Rohr vor Hauptkat = cp_Rohr * Masse Rohr Hauptkat" VALUE 0xa100d8e0 _REC_VAL_20_u2 163.835 _CNV_R_R_Def_cxm_uw_752_CM 0.25 16383.75 FORMAT "%5.2" /end CHARACTERISTIC
/begin CHARACTERISTIC K_ATM_CPR4 "Absolute Wärmekapazität Rohr vor Hauptkat = cp_Rohr * Masse Rohr Hauptkat" VALUE 0xa100d8e2 _REC_VAL_20_u2 163.835 _CNV_R_R_Def_cxm_uw_752_CM 0.25 16383.75 FORMAT "%5.2" /end CHARACTERISTIC
/begin CHARACTERISTIC K_ATM_CPR5 "Absolute Wärmekapazität Rohr vor Hauptkat = cp_Rohr * Masse Rohr Hauptkat" VALUE 0xa100d8e4 _REC_VAL_20_u2 163.835 _CNV_R_R_Def_cxm_uw_752_CM 0.25 16383.75 FORMAT "%5.2" /end CHARACTERISTIC
/begin CHARACTERISTIC K_ATM_CPR6 "Absolute Wärmekapazität Rohr vor Hauptkat = cp_Rohr * Masse Rohr Hauptkat" VALUE 0xa100d8e6 _REC_VAL_20_u2 163.835 _CNV_R_R_Def_cxm_uw_752_CM 0.25 16383.75 FORMAT "%5.2" /end CHARACTERISTIC
/begin CHARACTERISTIC K_ATM_CPR7 "Absolute Wärmekapazität Rohr vor Hauptkat = cp_Rohr * Masse Rohr Hauptkat" VALUE 0xa100d8e8 _REC_VAL_20_u2 163.835 _CNV_R_R_Def_cxm_uw_752_CM 0.25 16383.75 FORMAT "%5.2" /end CHARACTERISTIC
/begin CHARACTERISTIC K_ATM_CPR8 "Absolute Wärmekapazität Rohr vor Hauptkat = cp_Rohr * Masse Rohr Hauptkat" VALUE 0xa100d8ea _REC_VAL_20_u2 163.835 _CNV_R_R_Def_cxm_uw_752_CM 0.25 16383.75 FORMAT "%5.2" /end CHARACTERISTIC
/begin CHARACTERISTIC K_ATM_CPR9 "Absolute Wärmekapazität Rohr nach Kat = cp_Rohr * Masse Rohr Kat" VALUE 0xa100d8ec _REC_VAL_20_u2 163.835 _CNV_R_R_Def_cxm_uw_752_CM 0.25 16383.75 FORMAT "%5.2" /end CHARACTERISTIC
/begin CHARACTERISTIC K_ATM_DESUAPP "Applikationswert Temperaturerhöhung für Entschwefelung" VALUE 0xa100d900 _REC_VAL_20_s2 131.07 _CNV_R_R_Def_t_sw_q_618_CM -3276.8 3276.7 FORMAT "%4.1" /end CHARACTERISTIC
/begin CHARACTERISTIC K_ATM_FTANS "Gewichtung Referenztemperatur" VALUE 0xa100cee4 _REC_VAL_20_u1 1. _CNV_R_R_Def_f_ub_b_743_CM 0. 1. /end CHARACTERISTIC
/begin CHARACTERISTIC K_ATM_FTANS_R1 "Gewichtungsfaktor zwischen Tans und Tumg für Motorraumtemperatur Bank1" VALUE 0xa100d196 _REC_VAL_20_u1 1.9921 _CNV_R_R_Def_f_ub_b_625_CM 0. 1.9921 /end CHARACTERISTIC
/begin CHARACTERISTIC K_ATM_FTANS_R10 "Gewichtungsfaktor zwischen Tans und Tumg für Motorraumtemperatur nach Kat Bank2" VALUE 0xa100d19b _REC_VAL_20_u1 1.9921 _CNV_R_R_Def_f_ub_b_625_CM 0. 1.9921 /end CHARACTERISTIC
/begin CHARACTERISTIC K_ATM_FTANS_R4 "Gewichtungsfaktor zwischen Tans und Tumg für Motorraumtemperatur Bank2" VALUE 0xa100d197 _REC_VAL_20_u1 1.9921 _CNV_R_R_Def_f_ub_b_625_CM 0. 1.9921 /end CHARACTERISTIC
/begin CHARACTERISTIC K_ATM_FTANS_R7 "Gewichtungsfaktor zwischen Tans und Tumg für Motorraumtemperatur Mischstrecke Bank1" VALUE 0xa100d198 _REC_VAL_20_u1 1.9921 _CNV_R_R_Def_f_ub_b_625_CM 0. 1.9921 /end CHARACTERISTIC
/begin CHARACTERISTIC K_ATM_FTANS_R8 "Gewichtungsfaktor zwischen Tans und Tumg für Motorraumtemperatur Mischstrecke Bank2" VALUE 0xa100d199 _REC_VAL_20_u1 1.9921 _CNV_R_R_Def_f_ub_b_625_CM 0. 1.9921 /end CHARACTERISTIC
/begin CHARACTERISTIC K_ATM_FTANS_R9 "Gewichtungsfaktor zwischen Tans und Tumg für Motorraumtemperatur nach Kat Bank1" VALUE 0xa100d19a _REC_VAL_20_u1 1.9921 _CNV_R_R_Def_f_ub_b_625_CM 0. 1.9921 /end CHARACTERISTIC
/begin CHARACTERISTIC K_ATM_FTANS_TMR "Gewichtungsfaktor für Tans zur Berechnung der Motorraumtemperaturen" VALUE 0xa100d195 _REC_VAL_20_u1 1.9921 _CNV_R_R_Def_f_ub_b_625_CM 0. 1.9921 /end CHARACTERISTIC
/begin CHARACTERISTIC K_ATM_FTMOT "Faktor des Motortemperatureinflußes auf Wärmeverluste Hauptkat" VALUE 0xa100d19c _REC_VAL_20_u1 2.55 _CNV_R_R_Def_cxm_ub_753_CM 0. 2.55 FORMAT "%5.2" /end CHARACTERISTIC
/begin CHARACTERISTIC K_ATM_FTMR_R1 "Geschwindigkeitsabhängiger Offsetfaktor Motorraumtemperatur Bank1" VALUE 0xa100d19d _REC_VAL_20_u1 1.9921 _CNV_R_R_Def_f_ub_b_625_CM 0. 1.9921 /end CHARACTERISTIC
/begin CHARACTERISTIC K_ATM_FTMR_R10 "Geschwindigkeitsabhängiger Offsetfaktor Motorraumtemperatur Rohr nach Kat Bank2" VALUE 0xa100d1a2 _REC_VAL_20_u1 1.9921 _CNV_R_R_Def_f_ub_b_625_CM 0. 1.9921 /end CHARACTERISTIC
/begin CHARACTERISTIC K_ATM_FTMR_R4 "Geschwindigkeitsabhängiger Offsetfaktor Motorraumtemperatur Bank2" VALUE 0xa100d19e _REC_VAL_20_u1 1.9921 _CNV_R_R_Def_f_ub_b_625_CM 0. 1.9921 /end CHARACTERISTIC
/begin CHARACTERISTIC K_ATM_FTMR_R7 "Geschwindigkeitsabhängiger Offsetfaktor Motorraumtemperatur Mischstrecke Bank1" VALUE 0xa100d19f _REC_VAL_20_u1 1.9921 _CNV_R_R_Def_f_ub_b_625_CM 0. 1.9921 /end CHARACTERISTIC
/begin CHARACTERISTIC K_ATM_FTMR_R8 "Geschwindigkeitsabhängiger Offsetfaktor Motorraumtemperatur Mischstrecke Bank2" VALUE 0xa100d1a0 _REC_VAL_20_u1 1.9921 _CNV_R_R_Def_f_ub_b_625_CM 0. 1.9921 /end CHARACTERISTIC
/begin CHARACTERISTIC K_ATM_FTMR_R9 "Geschwindigkeitsabhängiger Offsetfaktor Motorraumtemperatur Rohr nach Kat Bank1" VALUE 0xa100d1a1 _REC_VAL_20_u1 1.9921 _CNV_R_R_Def_f_ub_b_625_CM 0. 1.9921 /end CHARACTERISTIC
/begin CHARACTERISTIC K_ATM_LKLPS "Geschwindigkeits-Obergrenze für Lüfterklappensteuerung" VALUE 0xa100d18c _REC_VAL_20_u2 100.8 _CNV_R_R_Def_v_uw_q_723_CM 0. 360. FORMAT "%5.0" /end CHARACTERISTIC
/begin CHARACTERISTIC K_ATM_RESET "Applikationseingriff Rücksetzen Rohrwandtemperatur" VALUE 0xa100d1a3 _REC_VAL_20_u1 1. _CNV_R_R_Def_dez_sl_575_CM 0. 1. FORMAT "%3.0" /end CHARACTERISTIC
/begin CHARACTERISTIC K_ATM_TABGMX "Obergrenze für Abgastemperatur aus ATMNN" VALUE 0xa100d18e _REC_VAL_20_s2 131.07 _CNV_R_R_Def_t_sw_q_618_CM -3276.8 3276.7 FORMAT "%4.1" /end CHARACTERISTIC
/begin CHARACTERISTIC K_ATM_TANSREF "Referenztemperatur bei der das KNN trainiert wurde" VALUE 0xa100cee8 _REC_VAL_20_s2 131.07 _CNV_R_R_Def_t_sw_q_618_CM -3276.8 3276.7 FORMAT "%4.1" /end CHARACTERISTIC
/begin CHARACTERISTIC K_ATM_TMOT "" VALUE 0xa100d190 _REC_VAL_20_s2 98.30250000000001 _CNV_R_R_Def_t_sw_q_620_CM -327.68 327.67 FORMAT "%5.2" /end CHARACTERISTIC
/begin CHARACTERISTIC K_ATM_UEB_CON "Koeffizient Sensormodell, konstanter Anteil" VALUE 0xa100d8fa _REC_VAL_20_s2 131.07 _CNV_R_R_Def_t_sw_q_618_CM -3276.8 3276.7 FORMAT "%4.1" /end CHARACTERISTIC
/begin CHARACTERISTIC K_ATM_UEB_LA "Koeffizient Sensormodell für Eingang La_ist1" VALUE 0xa100d8f4 _REC_VAL_20_s2 63.999 _CNV_R_R_Def_f_sw_b_577_CM -32. 31.999 FORMAT "%7.4" /end CHARACTERISTIC
/begin CHARACTERISTIC K_ATM_UEB_MA "Koeffizient Sensormodell für Eingang Msagr" VALUE 0xa100d8f6 _REC_VAL_20_s2 63.999 _CNV_R_R_Def_f_sw_b_577_CM -32. 31.999 FORMAT "%7.4" /end CHARACTERISTIC
/begin CHARACTERISTIC K_ATM_UEB_MS "Koeffizient Sensormodell für Eingang Msyzl" VALUE 0xa100d8f0 _REC_VAL_20_s2 63.999 _CNV_R_R_Def_f_sw_b_577_CM -32. 31.999 FORMAT "%7.4" /end CHARACTERISTIC
/begin CHARACTERISTIC K_ATM_UEB_T "Koeffizient Sensormodell für Eingang Sensortemperatur" VALUE 0xa100d8f8 _REC_VAL_20_s2 63.999 _CNV_R_R_Def_f_sw_b_577_CM -32. 31.999 FORMAT "%7.4" /end CHARACTERISTIC
/begin CHARACTERISTIC K_ATM_UEB_V "Koeffizient Sensormodell für Eingang V" VALUE 0xa100d8f2 _REC_VAL_20_s2 63.999 _CNV_R_R_Def_f_sw_b_577_CM -32. 31.999 FORMAT "%7.4" /end CHARACTERISTIC
/begin CHARACTERISTIC K_BSDELT1 "Delta Solltemperatur Abgas für Einschaltbedingung Regler" VALUE 0xa100cd00 _REC_VAL_20_s2 131.07 _CNV_R_R_Def_t_sw_q_618_CM -3276.8 3276.7 FORMAT "%4.1" /end CHARACTERISTIC
/begin CHARACTERISTIC K_BSDELT2 "Delta Solltemperatur Abgas für Ausschaltbedingung Regler" VALUE 0xa100cd02 _REC_VAL_20_s2 131.07 _CNV_R_R_Def_t_sw_q_618_CM -3276.8 3276.7 FORMAT "%4.1" /end CHARACTERISTIC
/begin CHARACTERISTIC K_BSDELT3 "Delta Solltemperatur Abgas für Regler Bank 2" VALUE 0xa100ccf8 _REC_VAL_20_s2 131.07 _CNV_R_R_Def_t_sw_q_618_CM -3276.8 3276.7 FORMAT "%4.1" /end CHARACTERISTIC
/begin CHARACTERISTIC K_BSDELT4 "Delta Solltemperatur Abgas für Regler Bank 2 NOx-Kat" VALUE 0xa100cd04 _REC_VAL_20_s2 131.07 _CNV_R_R_Def_t_sw_q_618_CM -3276.8 3276.7 FORMAT "%4.1" /end CHARACTERISTIC
/begin CHARACTERISTIC K_BSDELT5 "Delta Solltemperatur Abgas für Einschaltbedingung Regler Bank 1 NOx-Kat" VALUE 0xa100cd06 _REC_VAL_20_s2 131.07 _CNV_R_R_Def_t_sw_q_618_CM -3276.8 3276.7 FORMAT "%4.1" /end CHARACTERISTIC
/begin CHARACTERISTIC K_BSDELT6 "Delta Solltemperatur Abgas für Ausschaltbedingung Regler Bank 1 NOx-Kat" VALUE 0xa100cd08 _REC_VAL_20_s2 131.07 _CNV_R_R_Def_t_sw_q_618_CM -3276.8 3276.7 FORMAT "%4.1" /end CHARACTERISTIC
/begin CHARACTERISTIC K_BSDELT7 "Delta Solltemperatur Abgas für Einschaltbedingung Regler Bank 2 NOx-Kat" VALUE 0xa100cd0a _REC_VAL_20_s2 131.07 _CNV_R_R_Def_t_sw_q_618_CM -3276.8 3276.7 FORMAT "%4.1" /end CHARACTERISTIC
/begin CHARACTERISTIC K_BSDELT8 "Delta Solltemperatur Abgas für Ausschaltbedingung Regler Bank 2 NOx-Kat" VALUE 0xa100cd0c _REC_VAL_20_s2 131.07 _CNV_R_R_Def_t_sw_q_618_CM -3276.8 3276.7 FORMAT "%4.1" /end CHARACTERISTIC
/begin CHARACTERISTIC K_BSLAMX "Lambda-Grenzwert" VALUE 0xa100ceea _REC_VAL_20_u2 15.9997 _CNV_R_R_Def_f_uw_b_594_CM 0. 15.9997 FORMAT "%7.4" /end CHARACTERISTIC
/begin CHARACTERISTIC K_BS_D "D-Anteil PID-Regler Bauteilschutz" VALUE 0xa100cd1c _REC_VAL_20_u2 63.99900000000001 _CNV_R_R_Def_f_uw_b_580_CM 0. 63.999 FORMAT "%7.4" /end CHARACTERISTIC
/begin CHARACTERISTIC K_BS_D_NOK "D-Anteil PID-Regler Bauteilschutz NOx-Kat" VALUE 0xa100cd1e _REC_VAL_20_u2 63.99900000000001 _CNV_R_R_Def_f_uw_b_580_CM 0. 63.999 FORMAT "%7.4" /end CHARACTERISTIC
/begin CHARACTERISTIC K_BS_I "I-Anteil PID-Regler Bauteilschutz" VALUE 0xa100cd1a _REC_VAL_20_u2 1.9999 _CNV_R_R_Def_f_uw_b_579_CM 0. 1.9999 FORMAT "%14.5" /end CHARACTERISTIC
/begin CHARACTERISTIC K_BS_IMN "Minimalbegrenzung I-Anteil Regler Bauteilschutz" VALUE 0xa100cd24 _REC_VAL_20_s2 15.9997 _CNV_R_R_Def_f_sw_b_607_CM -8. 7.9997 FORMAT "%7.4" /end CHARACTERISTIC
/begin CHARACTERISTIC K_BS_IMX "Maximalbegrenzung I-Anteil Regler Bauteilschutz" VALUE 0xa100cd26 _REC_VAL_20_s2 15.9997 _CNV_R_R_Def_f_sw_b_607_CM -8. 7.9997 FORMAT "%7.4" /end CHARACTERISTIC
/begin CHARACTERISTIC K_BS_MN "Lambda-Minimalwert für Bauteilschutz" VALUE 0xa100cd16 _REC_VAL_20_u2 15.9997 _CNV_R_R_Def_f_uw_b_594_CM 0. 15.9997 FORMAT "%7.4" /end CHARACTERISTIC
/begin CHARACTERISTIC K_BS_P "P-Anteil PID-Regler Bauteilschutz" VALUE 0xa100cd18 _REC_VAL_20_u2 63.99900000000001 _CNV_R_R_Def_f_uw_b_580_CM 0. 63.999 FORMAT "%7.4" /end CHARACTERISTIC
/begin CHARACTERISTIC K_BS_REGMN "Minimalbegrenzung Reglerausgang Bauteilschutz" VALUE 0xa100cd20 _REC_VAL_20_s2 15.9997 _CNV_R_R_Def_f_sw_b_607_CM -8. 7.9997 FORMAT "%7.4" /end CHARACTERISTIC
/begin CHARACTERISTIC K_BS_REGMX "Maximalbegrenzung Reglerausgang Bauteilschutz" VALUE 0xa100cd22 _REC_VAL_20_s2 15.9997 _CNV_R_R_Def_f_sw_b_607_CM -8. 7.9997 FORMAT "%7.4" /end CHARACTERISTIC
/begin CHARACTERISTIC K_BS_ZKININN "Filterparameter für Initialisierungswert Vorsteuerfilter" VALUE 0xa100cd14 _REC_VAL_20_u2 65.535 _CNV_R_R_Def_td_uw__592_CM 0. 65.535 /end CHARACTERISTIC
/begin CHARACTERISTIC K_DELAY_SA "Zeit für Verzögerung B_sa (fallende Flanke)" VALUE 0xa100d914 _REC_VAL_20_u1 51. _CNV_R_R_Def_td_uw__712_CM 0. 51. FORMAT "%4.1" /end CHARACTERISTIC
/begin CHARACTERISTIC K_DELAY_SAV "" VALUE 0xa100d915 _REC_VAL_20_u1 51. _CNV_R_R_Def_td_uw__712_CM 0. 51. FORMAT "%4.1" /end CHARACTERISTIC
/begin CHARACTERISTIC K_DTNN "Delta Solltemperatur Abgas für Befragung KNN" VALUE 0xa100cee6 _REC_VAL_20_s2 131.07 _CNV_R_R_Def_t_sw_q_618_CM -3276.8 3276.7 FORMAT "%4.1" /end CHARACTERISTIC
/begin CHARACTERISTIC K_FEXODESU "Ersatzfaktor Berechnung Exothermie im NoX-Kat bei Desulfatisierung" VALUE 0xa100d668 _REC_VAL_20_u1 2.55 _CNV_R_R_Def_lf_ub__675_CM 0. 2.55 /end CHARACTERISTIC
/begin CHARACTERISTIC K_FKWG1DIAG "Filterkonstante Wastegate Plausibilität" VALUE 0xa100c478 _REC_VAL_20_u2 0.9999847412109381 _CNV_R_R_Def_f_uw_b_591_CM 0. 0.9999847412109381 FORMAT "%14.5" /end CHARACTERISTIC
/begin CHARACTERISTIC K_IKATLAD "Intergrierbeiwert" VALUE 0xa100c41e _REC_VAL_20_u2 0.9999847412109381 _CNV_R_R_Def_f_uw_b_591_CM 0. 0.9999847412109381 FORMAT "%14.5" /end CHARACTERISTIC
/begin CHARACTERISTIC K_K_ANSPRING "Anspringtemperatur Kat-Modell GDI" VALUE 0xa100d66a _REC_VAL_20_s2 131.07 _CNV_R_R_Def_t_sw_q_618_CM -3276.8 3276.7 FORMAT "%4.1" /end CHARACTERISTIC
/begin CHARACTERISTIC K_K_NOEXO "Temperaturbeitrag Kat ohne Exothermie" VALUE 0xa100d66c _REC_VAL_20_s2 131.07 _CNV_R_R_Def_t_sw_q_618_CM -3276.8 3276.7 FORMAT "%4.1" /end CHARACTERISTIC
/begin CHARACTERISTIC K_LABSOFF "Lambda-Offset für Vergleic von La_vst mit La_bas" VALUE 0xa100cd0e _REC_VAL_20_s2 15.9997 _CNV_R_R_Def_f_sw_b_607_CM -8. 7.9997 FORMAT "%7.4" /end CHARACTERISTIC
/begin CHARACTERISTIC K_LA_BSPASS_FETT "Lambda-Sollwert bei deaktivierten fetten Bauteilschutz, Bank 1" VALUE 0xa100cd10 _REC_VAL_20_u2 15.9997 _CNV_R_R_Def_f_uw_b_594_CM 0. 15.9997 FORMAT "%7.4" /end CHARACTERISTIC
/begin CHARACTERISTIC K_LA_BSPASS_MAGER "Lambda-Sollwert bei deaktivierten mageren Bauteilschutz, Bank 1" VALUE 0xa100cd12 _REC_VAL_20_u2 15.9997 _CNV_R_R_Def_f_uw_b_594_CM 0. 15.9997 FORMAT "%7.4" /end CHARACTERISTIC
/begin CHARACTERISTIC K_MSVLDLEKF "Min. Änderung Massenstrom vor Verdichter bei Leckage" VALUE 0xa100c428 _REC_VAL_20_s2 102.398435 _CNV_R_R_Def_ms_uw__611_CM -1024. 1023.9687 /end CHARACTERISTIC
/begin CHARACTERISTIC K_MSVLDPMPMN "Min. Änderung Massenstrom vor Verdichter bei pumpen" VALUE 0xa100c620 _REC_VAL_20_s2 102.398435 _CNV_R_R_Def_ms_uw__611_CM -1024. 1023.9687 /end CHARACTERISTIC
/begin CHARACTERISTIC K_MSVLDPMPMX "Max. Änderung Massenstrom vor Verdichter bei pumpen" VALUE 0xa100c622 _REC_VAL_20_s2 102.398435 _CNV_R_R_Def_ms_uw__611_CM -1024. 1023.9687 /end CHARACTERISTIC
/begin CHARACTERISTIC K_NKWAD_MN "Untere Drehzahlschwelle f. Adaption" VALUE 0xa100c410 _REC_VAL_20_s2 0. _CNV_R_R_Def_n_sw_q_612_CM -32768. 32767. FORMAT "%5.0" /end CHARACTERISTIC
/begin CHARACTERISTIC K_NKWAD_MX "Obere Drehzahlschwelle f. Adaption" VALUE 0xa100c412 _REC_VAL_20_s2 0. _CNV_R_R_Def_n_sw_q_612_CM -32768. 32767. FORMAT "%5.0" /end CHARACTERISTIC
/begin CHARACTERISTIC K_NKWLEK_MN "Untere Drehzahlschwelle f. Leckageerkennung" VALUE 0xa100c42a _REC_VAL_20_s2 0. _CNV_R_R_Def_n_sw_q_612_CM -32768. 32767. FORMAT "%5.0" /end CHARACTERISTIC
/begin CHARACTERISTIC K_NKWLEK_MX "Obere Drehzahlschwelle f. Leckageerkennung" VALUE 0xa100c42c _REC_VAL_20_s2 0. _CNV_R_R_Def_n_sw_q_612_CM -32768. 32767. FORMAT "%5.0" /end CHARACTERISTIC
/begin CHARACTERISTIC K_NKWPUMP_MN "Untere Drehzahlschwelle f. Pumpbestimmung" VALUE 0xa100c624 _REC_VAL_20_s2 0. _CNV_R_R_Def_n_sw_q_612_CM -32768. 32767. FORMAT "%5.0" /end CHARACTERISTIC
/begin CHARACTERISTIC K_NKWPUMP_MX "Obere Drehzahlschwelle f. Pumpbestimmung" VALUE 0xa100c626 _REC_VAL_20_s2 0. _CNV_R_R_Def_n_sw_q_612_CM -32768. 32767. FORMAT "%5.0" /end CHARACTERISTIC
/begin CHARACTERISTIC K_NOK_AN "Anspringtemperatur NoXKat-Modell" VALUE 0xa100d66e _REC_VAL_20_s2 131.07 _CNV_R_R_Def_t_sw_q_618_CM -3276.8 3276.7 FORMAT "%4.1" /end CHARACTERISTIC
/begin CHARACTERISTIC K_N_NOEXO "Temperaturbeitrag NoX-Kat ohne Exothermie" VALUE 0xa100d670 _REC_VAL_20_s2 131.07 _CNV_R_R_Def_t_sw_q_618_CM -3276.8 3276.7 FORMAT "%4.1" /end CHARACTERISTIC
/begin CHARACTERISTIC K_PLDDIFFAD "Max. Regeldifferenz f. aktive Adaption " VALUE 0xa100c414 _REC_VAL_20_s2 102.398436 _CNV_R_R_Def_p_sw_q_614_CM -2560. 2559.9218 FORMAT "%5.2" /end CHARACTERISTIC
/begin CHARACTERISTIC K_PLDDPUMP "Änderung Ladedruck-Istwert bei Pumperkennung" VALUE 0xa100c628 _REC_VAL_20_s2 102.398436 _CNV_R_R_Def_p_sw_q_578_CM -1280. 1279.9609 FORMAT "%5.2" /end CHARACTERISTIC
/begin CHARACTERISTIC K_PLDD_MN "Regelabweichung untere Schwelle f. Reglerfehler" VALUE 0xa100c42e _REC_VAL_20_s2 102.398436 _CNV_R_R_Def_p_sw_q_614_CM -2560. 2559.9218 FORMAT "%5.2" /end CHARACTERISTIC
/begin CHARACTERISTIC K_PLDD_MX "Regelabweichung oberer Schwelle f. Reglerfehler" VALUE 0xa100c430 _REC_VAL_20_s2 102.398436 _CNV_R_R_Def_p_sw_q_614_CM -2560. 2559.9218 FORMAT "%5.2" /end CHARACTERISTIC
/begin CHARACTERISTIC K_PLDLEKF "Max. Änderung Laderdruck-Istwert - schnelle Diagnose" VALUE 0xa100c432 _REC_VAL_20_s2 102.398436 _CNV_R_R_Def_p_sw_q_578_CM -1280. 1279.9609 FORMAT "%5.2" /end CHARACTERISTIC
/begin CHARACTERISTIC K_PLDLEKOFS "Max. pos. Regeldifferenz - schnelle Diagnose" VALUE 0xa100c436 _REC_VAL_20_u2 102.398436 _CNV_R_R_Def_p_sw_q_578_CM 0. 2559.9609 FORMAT "%5.2" /end CHARACTERISTIC
/begin CHARACTERISTIC K_PLDSAD_MN "Min. Ladedruck-Sollwert f. Adaption" VALUE 0xa100c420 _REC_VAL_20_u2 102.398436 _CNV_R_R_Def_p_sw_q_578_CM 0. 2559.9609 FORMAT "%5.2" /end CHARACTERISTIC
/begin CHARACTERISTIC K_PLDSAD_MX "Max. Ladedruck-Sollwert f. Adaption" VALUE 0xa100c422 _REC_VAL_20_u2 102.398436 _CNV_R_R_Def_p_sw_q_578_CM 0. 2559.9609 FORMAT "%5.2" /end CHARACTERISTIC
/begin CHARACTERISTIC K_PLDSDAD_MN "Min. Änderung Ladedruck-Sollwert f. Adaption" VALUE 0xa100c416 _REC_VAL_20_s2 102.398436 _CNV_R_R_Def_p_sw_q_578_CM -1280. 1279.9609 FORMAT "%5.2" /end CHARACTERISTIC
/begin CHARACTERISTIC K_PLDSDAD_MX "Max. Änderung Ladedruck-Sollwert f. Adaption" VALUE 0xa100c418 _REC_VAL_20_s2 102.398436 _CNV_R_R_Def_p_sw_q_578_CM -1280. 1279.9609 FORMAT "%5.2" /end CHARACTERISTIC
/begin CHARACTERISTIC K_PLDSDPMPMN "Änderung Ladedruck-Sollwert bei Pumperkennung" VALUE 0xa100c62a _REC_VAL_20_s2 102.398436 _CNV_R_R_Def_p_sw_q_578_CM -1280. 1279.9609 FORMAT "%5.2" /end CHARACTERISTIC
/begin CHARACTERISTIC K_PLDSLEKF "Min. Änderung Laderdruck Sollwert - schnelle Diagnose" VALUE 0xa100c434 _REC_VAL_20_s2 102.398436 _CNV_R_R_Def_p_sw_q_578_CM -1280. 1279.9609 FORMAT "%5.2" /end CHARACTERISTIC
/begin CHARACTERISTIC K_PLD_AUS "" VALUE 0xa100b200 _REC_VAL_20_s2 102.398436 _CNV_R_R_Def_p_sw_q_614_CM -2560. 2559.9218 FORMAT "%5.2" /end CHARACTERISTIC
/begin CHARACTERISTIC K_PWGGRDOB "Fahrpedalgradient zur Auslösung Overboost" VALUE 0xa100b202 _REC_VAL_20_s2 95.99852999999999 _CNV_R_R_Def_wdk_sw_691_CM -800. 799.9755 FORMAT "%5.2" /end CHARACTERISTIC
/begin CHARACTERISTIC K_SATLIM "" VALUE 0xa100d8fc _REC_VAL_20_s2 131.07 _CNV_R_R_Def_t_sw_q_618_CM -3276.8 3276.7 FORMAT "%4.1" /end CHARACTERISTIC
/begin CHARACTERISTIC K_SATLIM_NK "" VALUE 0xa100d8fe _REC_VAL_20_s2 131.07 _CNV_R_R_Def_t_sw_q_618_CM -3276.8 3276.7 FORMAT "%4.1" /end CHARACTERISTIC
/begin CHARACTERISTIC K_TANSATLAD "Max. Ansauglufttemperatur für Regler-Adaption" VALUE 0xa100c41a _REC_VAL_20_s2 131.07 _CNV_R_R_Def_t_sw_q_618_CM -3276.8 3276.7 FORMAT "%4.1" /end CHARACTERISTIC
/begin CHARACTERISTIC K_TA_VKSOLL_DELT "Delta Solltemperatur Abgas bei Fehler" VALUE 0xa100ccfc _REC_VAL_20_s2 131.07 _CNV_R_R_Def_t_sw_q_618_CM -3276.8 3276.7 FORMAT "%4.1" /end CHARACTERISTIC
/begin CHARACTERISTIC K_TA_VKSOLL_DELT2 "Zusätzliches zeitabhängiges Delta Solltemperatur Abgas bei Fehler" VALUE 0xa100ccfe _REC_VAL_20_s2 131.07 _CNV_R_R_Def_t_sw_q_618_CM -3276.8 3276.7 FORMAT "%4.1" /end CHARACTERISTIC
/begin CHARACTERISTIC K_TBS2 "Zeitverzögerung nach Aktivierung BS für Sollwertdelta" VALUE 0xa100ccfb _REC_VAL_20_u1 99.45 _CNV_R_R_Def_td_uw__682_CM 0. 255. FORMAT "%5.2" /end CHARACTERISTIC
/begin CHARACTERISTIC K_TDATLLEKF "Verzögerung f. schnelle Leckage-Erkennung" VALUE 0xa100c438 _REC_VAL_20_u2 98.30250000000001 _CNV_R_R_Def_td_uw__679_CM 0. 655.35 FORMAT "%5.2" /end CHARACTERISTIC
/begin CHARACTERISTIC K_TDATL_ERR "Verzögerung f. Reglerfehler" VALUE 0xa100c43a _REC_VAL_20_u2 98.30250000000001 _CNV_R_R_Def_td_uw__679_CM 0. 655.35 FORMAT "%5.2" /end CHARACTERISTIC
/begin CHARACTERISTIC K_TDULSF "Verzögerung Überlastschutz" VALUE 0xa100b206 _REC_VAL_20_u1 12.75 _CNV_R_R_Def_td_ub__749_CM 0. 12.75 FORMAT "%5.2" /end CHARACTERISTIC
/begin CHARACTERISTIC K_TDULSFRST "Verzögerung Überlastschutz-Reset" VALUE 0xa100b207 _REC_VAL_20_u1 12.75 _CNV_R_R_Def_td_ub__749_CM 0. 12.75 FORMAT "%5.2" /end CHARACTERISTIC
/begin CHARACTERISTIC K_TDWG1PLMN "Verzögerungszeit min. WG-Check" VALUE 0xa100c47a _REC_VAL_20_u2 98.30250000000001 _CNV_R_R_Def_td_uw__679_CM 0. 655.35 FORMAT "%5.2" /end CHARACTERISTIC
/begin CHARACTERISTIC K_TDWG1PLMX "Verzögerungszeit max. WG-Check" VALUE 0xa100c47c _REC_VAL_20_u2 98.30250000000001 _CNV_R_R_Def_td_uw__679_CM 0. 655.35 FORMAT "%5.2" /end CHARACTERISTIC
/begin CHARACTERISTIC K_TMOTATLAD "Min. Motortemperatur für Regler-Adaption" VALUE 0xa100c41c _REC_VAL_20_s2 98.30250000000001 _CNV_R_R_Def_t_sw_q_620_CM -327.68 327.67 FORMAT "%5.2" /end CHARACTERISTIC
/begin CHARACTERISTIC K_TRNOK_ST "Starttemperatur Rohrwand" VALUE 0xa100d1a4 _REC_VAL_20_s2 131.07 _CNV_R_R_Def_t_sw_q_618_CM -3276.8 3276.7 FORMAT "%4.1" /end CHARACTERISTIC
/begin CHARACTERISTIC K_TR_ST "Starttemperatur Rohrwand" VALUE 0xa100d192 _REC_VAL_20_s2 131.07 _CNV_R_R_Def_t_sw_q_618_CM -3276.8 3276.7 FORMAT "%4.1" /end CHARACTERISTIC
/begin CHARACTERISTIC K_TVWG "Tastverhaeltnis WG1 - manuell" VALUE 0xa100b310 _REC_VAL_20_u2 99.9984 _CNV_R_R_Def_f_uw_b_576_CM 0. 99.9984 /end CHARACTERISTIC
/begin CHARACTERISTIC K_TVWG2 "Tastverhaeltnis WG2 - manuell" VALUE 0xa100b312 _REC_VAL_20_u2 99.9984 _CNV_R_R_Def_f_uw_b_576_CM 0. 99.9984 /end CHARACTERISTIC
/begin CHARACTERISTIC K_TVWGMIN "Mindest Tastverhältnis f. Ansteuerung - bauteilbedingtes Verhalten d. Unterdruckdose" VALUE 0xa100b314 _REC_VAL_20_u2 99.9984 _CNV_R_R_Def_f_uw_b_576_CM 0. 99.9984 /end CHARACTERISTIC
/begin CHARACTERISTIC K_TVWG_GLAKT "Ansteuerung Wastegate bei Gleichstellung" VALUE 0xa100b316 _REC_VAL_20_u2 99.9984 _CNV_R_R_Def_f_uw_b_576_CM 0. 99.9984 /end CHARACTERISTIC
/begin CHARACTERISTIC K_TVWG_MN "Tastverhaeltnis Minimum" VALUE 0xa100b318 _REC_VAL_20_u2 99.9984 _CNV_R_R_Def_f_uw_b_576_CM 0. 99.9984 /end CHARACTERISTIC
/begin CHARACTERISTIC K_TVWG_MX "Tastverhaeltnis Maximum" VALUE 0xa100b31a _REC_VAL_20_u2 99.9984 _CNV_R_R_Def_f_uw_b_576_CM 0. 99.9984 /end CHARACTERISTIC
/begin CHARACTERISTIC K_ULSHYS "Hysterese für Überladeschutz-Reset" VALUE 0xa100b204 _REC_VAL_20_u2 102.398436 _CNV_R_R_Def_p_sw_q_578_CM 0. 2559.9609 FORMAT "%5.2" /end CHARACTERISTIC
/begin CHARACTERISTIC K_WG1DIAGMN "Min. Korrekturfaktor f. Wastegate 1" VALUE 0xa100c47e _REC_VAL_20_u2 1.9999 _CNV_R_R_Def_f_uw_b_579_CM 0. 1.9999 FORMAT "%14.5" /end CHARACTERISTIC
/begin CHARACTERISTIC K_WG1DIAGMN2 "Min. Korrekturfaktor f. Wastegate 1" VALUE 0xa100c480 _REC_VAL_20_u2 1.9999 _CNV_R_R_Def_f_uw_b_579_CM 0. 1.9999 FORMAT "%14.5" /end CHARACTERISTIC
/begin CHARACTERISTIC K_WG1DIAGMX "Max. Korrekturfaktor f. Wastegate 1" VALUE 0xa100c482 _REC_VAL_20_u2 1.9999 _CNV_R_R_Def_f_uw_b_579_CM 0. 1.9999 FORMAT "%14.5" /end CHARACTERISTIC
/begin CHARACTERISTIC K_WG1DIAGMX2 "Max. Korrekturfaktor f. Wastegate 1" VALUE 0xa100c484 _REC_VAL_20_u2 1.9999 _CNV_R_R_Def_f_uw_b_579_CM 0. 1.9999 FORMAT "%14.5" /end CHARACTERISTIC
/begin CHARACTERISTIC K_WG1KMN "Unter Adaption-Grenzwert f. WG-Korrektur" VALUE 0xa100c474 _REC_VAL_20_s2 1.9999 _CNV_R_R_Def_f_sw_b_608_CM 0. 1.9999 FORMAT "%14.5" /end CHARACTERISTIC
/begin CHARACTERISTIC K_WG1KMX "Oberer Adaption-Grenzwert f. WG-Korrektur" VALUE 0xa100c476 _REC_VAL_20_s2 1.9999 _CNV_R_R_Def_f_sw_b_608_CM 0. 1.9999 FORMAT "%14.5" /end CHARACTERISTIC
/begin CHARACTERISTIC K_WG1KOR "Gleichlaufkorrektur WG1 - manuell" VALUE 0xa100c486 _REC_VAL_20_u2 1.9999 _CNV_R_R_Def_f_uw_b_579_CM 0. 1.9999 FORMAT "%14.5" /end CHARACTERISTIC
/begin CHARACTERISTIC K_WG2KOR "Gleichlaufkorrektur WG2 - manuell" VALUE 0xa100c488 _REC_VAL_20_u2 1.9999 _CNV_R_R_Def_f_uw_b_579_CM 0. 1.9999 FORMAT "%14.5" /end CHARACTERISTIC
/begin CHARACTERISTIC K_WOUT_BIAS "Gewichte des Biasterms der Ausgangschicht, ATMNN" VALUE 0xa100ceec _REC_VAL_20_S4 0. _CNV_R_R_Def_dez_sl_575_CM -1000000000000. 10000000000000. FORMAT "%14.7" /end CHARACTERISTIC
/begin CHARACTERISTIC S_AGRAUS_MAN "Schalter zum Manuellen Abschalten AGR" VALUE 0xa100e9e2 _REC_VAL_20_u1 1. _CNV_R_R_Def_dez_sl_575_CM 0. 1. FORMAT "%3.0" /end CHARACTERISTIC
/begin CHARACTERISTIC S_AGRSOLLAPP "Schalter für Manuelle AGR Sollposition" VALUE 0xa100e9e3 _REC_VAL_20_u1 1. _CNV_R_R_Def_dez_sl_575_CM 0. 1. FORMAT "%3.0" /end CHARACTERISTIC
/begin CHARACTERISTIC S_ATLGLS_PI "Umschaltung auf PI-Regler" VALUE 0xa100c48a _REC_VAL_20_u1 1. _CNV_R_R_Def_dez_sl_575_CM 0. 1. FORMAT "%3.0" /end CHARACTERISTIC
/begin CHARACTERISTIC S_ATMNN_N53 "Umschalter Lambdaeingang auf Rk für N53" VALUE 0xa100cee0 _REC_VAL_20_u1 1. _CNV_R_R_Def_dez_sl_575_CM 0. 1. FORMAT "%3.0" /end CHARACTERISTIC
/begin CHARACTERISTIC S_ATMPH_SENS "Umschalter auf Abgastemperatursensor für N53" VALUE 0xa100d916 _REC_VAL_20_u1 1. _CNV_R_R_Def_dez_sl_575_CM 0. 1. FORMAT "%3.0" /end CHARACTERISTIC
/begin CHARACTERISTIC S_ATMPH_SENS1 "Abgastemperatursensor auf Bank 1" VALUE 0xa100d918 _REC_VAL_20_u1 1. _CNV_R_R_Def_dez_sl_575_CM 0. 1. FORMAT "%3.0" /end CHARACTERISTIC
/begin CHARACTERISTIC S_ATMPH_SENS2 "Abgastemperatursensor auf Bank 2" VALUE 0xa100d919 _REC_VAL_20_u1 1. _CNV_R_R_Def_dez_sl_575_CM 0. 1. FORMAT "%3.0" /end CHARACTERISTIC
/begin CHARACTERISTIC S_ATM_N54 "Umschalter für N54-Funktionalität" VALUE 0xa100cedc _REC_VAL_20_u1 1. _CNV_R_R_Def_dez_sl_575_CM 0. 1. FORMAT "%3.0" /end CHARACTERISTIC
/begin CHARACTERISTIC S_FUMU_BSNN "Umschalter Funktionsmuster Deltatemperatur BS-Sollwert" VALUE 0xa100cee1 _REC_VAL_20_u1 1. _CNV_R_R_Def_dez_sl_575_CM 0. 1. FORMAT "%3.0" /end CHARACTERISTIC
/begin CHARACTERISTIC S_GLS2_MAN "Gleichlaufsteuerung WG2 - manuell" VALUE 0xa100c48b _REC_VAL_20_u1 1. _CNV_R_R_Def_dez_sl_575_CM 0. 1. FORMAT "%3.0" /end CHARACTERISTIC
/begin CHARACTERISTIC S_GLS_MAN "Gleichlaufsteuerung WG1 - manuell" VALUE 0xa100c48c _REC_VAL_20_u1 1. _CNV_R_R_Def_dez_sl_575_CM 0. 1. FORMAT "%3.0" /end CHARACTERISTIC
/begin CHARACTERISTIC S_MSZYL_MW "Umschalter Mittelwertfilter für Mszyl" VALUE 0xa100d194 _REC_VAL_20_u1 1. _CNV_R_R_Def_dez_sl_575_CM 0. 1. FORMAT "%3.0" /end CHARACTERISTIC
/begin CHARACTERISTIC S_NKW_MW "Umschalter Mittelwertfilter für Nkw" VALUE 0xa100cee2 _REC_VAL_20_u1 1. _CNV_R_R_Def_dez_sl_575_CM 0. 1. FORMAT "%3.0" /end CHARACTERISTIC
/begin CHARACTERISTIC S_PLDAUS "Schalter Ladedruckregelung aus" VALUE 0xa100b208 _REC_VAL_20_u1 1. _CNV_R_R_Def_dez_sl_575_CM 0. 1. FORMAT "%3.0" /end CHARACTERISTIC
/begin CHARACTERISTIC S_RF_MW "Umschalter Mittelwertfilter für Rf" VALUE 0xa100cee3 _REC_VAL_20_u1 1. _CNV_R_R_Def_dez_sl_575_CM 0. 1. FORMAT "%3.0" /end CHARACTERISTIC
/begin CHARACTERISTIC S_TABGFIL "Einschalter Filterbank für Abgastemperaturen" VALUE 0xa100cedf _REC_VAL_20_u1 1. _CNV_R_R_Def_dez_sl_575_CM 0. 1. FORMAT "%3.0" /end CHARACTERISTIC
/begin CHARACTERISTIC S_TSENSTURB "Umschalter auf Abgastemperatursensor für N54" VALUE 0xa100d917 _REC_VAL_20_u1 1. _CNV_R_R_Def_dez_sl_575_CM 0. 1. FORMAT "%3.0" /end CHARACTERISTIC
/begin CHARACTERISTIC S_TVWG2_INV "Tastverhältnis WG2 invertieren" VALUE 0xa100b31c _REC_VAL_20_u1 1. _CNV_R_R_Def_dez_sl_575_CM 0. 1. FORMAT "%3.0" /end CHARACTERISTIC
/begin CHARACTERISTIC S_TVWG2_MAN "Tastverhältnis WG2 - manuell" VALUE 0xa100b31d _REC_VAL_20_u1 1. _CNV_R_R_Def_dez_sl_575_CM 0. 1. FORMAT "%3.0" /end CHARACTERISTIC
/begin CHARACTERISTIC S_TVWGKORHOKL "Schalter höhenkorrigiertes Tastverhältnis aus Kennlinie" VALUE 0xa100b31e _REC_VAL_20_u1 1. _CNV_R_R_Def_dez_sl_575_CM 0. 1. FORMAT "%3.0" /end CHARACTERISTIC
/begin CHARACTERISTIC S_TVWG_INV "Tastverhältnis WG1 invertieren" VALUE 0xa100b31f _REC_VAL_20_u1 1. _CNV_R_R_Def_dez_sl_575_CM 0. 1. FORMAT "%3.0" /end CHARACTERISTIC
/begin CHARACTERISTIC S_TVWG_MAN "Tastverhältnis WG1 - manuell" VALUE 0xa100b320 _REC_VAL_20_u1 1. _CNV_R_R_Def_dez_sl_575_CM 0. 1. FORMAT "%3.0" /end CHARACTERISTIC
/begin COMPU_METHOD _CNV_A_R_LINEAR_____0_CM "" RAT_FUNC "%6.3" "-" COEFFS 0 1. 0. 0 0 1 /end COMPU_METHOD
/begin COMPU_METHOD _CNV_S_2_RANGE__0___1_CM "" TAB_VERB "%6.3" "-" COMPU_TAB_REF _CNV_S_2_RANGE__0___1 /end COMPU_METHOD
/begin COMPU_VTAB _CNV_S_2_RANGE__0___1 "" TAB_VERB 2 0 "0" 1 "1" /end COMPU_VTAB
/begin COMPU_METHOD _CNV_A_R_LINEAR_____4_CM "" RAT_FUNC "%6.3" "s" COEFFS 0 10. 0. 0 0 1 /end COMPU_METHOD
/begin COMPU_METHOD _CNV_A_R_LINEAR_____6_CM "" RAT_FUNC "%6.3" "km/h" COEFFS 0 1. 0. 0 0 1 /end COMPU_METHOD
/begin COMPU_METHOD _CNV_A_R_LINEAR_____16_CM "" RAT_FUNC "%6.3" "°C" COEFFS 0 1.333333333333333 64. 0 0 1 /end COMPU_METHOD
/begin COMPU_METHOD _CNV_A_R_LINEAR_____26_CM "" RAT_FUNC "%6.3" "hPa" COEFFS 0 12.06017666543982 0. 0 0 1 /end COMPU_METHOD
/begin COMPU_METHOD _CNV_A_R_LINEAR_____35_CM "" RAT_FUNC "%6.3" "s" COEFFS 0 1. 0. 0 0 1 /end COMPU_METHOD
/begin COMPU_METHOD _CNV_A_R_LINEAR_____44_CM "" RAT_FUNC "%6.3" "km/h" COEFFS 0 10. 0. 0 0 1 /end COMPU_METHOD
/begin COMPU_METHOD _CNV_R_R_Def_f_ub_b_573_CM "Def_f_ub_b1" RAT_FUNC "%6.3" "-" COEFFS 0. 256. 0. 0. 0. 1. /end COMPU_METHOD
/begin COMPU_METHOD _CNV_R_R_Def_dez_sl_575_CM "Def_dez_sl_q1" RAT_FUNC "%6.3" "-" COEFFS 0. 1. 0. 0. 0. 1. /end COMPU_METHOD
/begin COMPU_METHOD _CNV_R_R_Def_f_uw_b_576_CM "Def_f_uw_b100" RAT_FUNC "%6.3" "%" COEFFS 0. 65536. 0. 0. 0. 100. /end COMPU_METHOD
/begin COMPU_METHOD _CNV_R_R_Def_f_sw_b_577_CM "Def_f_sw_b32" RAT_FUNC "%6.3" "-" COEFFS 0. 32768. 0. 0. 0. 32. /end COMPU_METHOD
/begin COMPU_METHOD _CNV_R_R_Def_p_sw_q_578_CM "Def_p_sw_q0p039" RAT_FUNC "%6.3" "hPa" COEFFS 0. 256. 0. 0. 0. 10. /end COMPU_METHOD
/begin COMPU_METHOD _CNV_R_R_Def_f_uw_b_579_CM "Def_f_uw_b2" RAT_FUNC "%6.3" "-" COEFFS 0. 65536. 0. 0. 0. 2. /end COMPU_METHOD
/begin COMPU_METHOD _CNV_R_R_Def_f_uw_b_580_CM "Def_f_uw_b64" RAT_FUNC "%6.3" "-" COEFFS 0. 65536. 0. 0. 0. 64. /end COMPU_METHOD
/begin COMPU_METHOD _CNV_R_R_Def_rel_sw_584_CM "Def_rel_sw_b100" RAT_FUNC "%6.3" "%" COEFFS 0. 32768. 0. 0. 0. 100. /end COMPU_METHOD
/begin COMPU_METHOD _CNV_R_R_Def_f_uw_b_591_CM "Def_f_uw_b1" RAT_FUNC "%6.3" "-" COEFFS 0. 65536. 0. 0. 0. 1. /end COMPU_METHOD
/begin COMPU_METHOD _CNV_R_R_Def_td_uw__592_CM "Def_td_uw_q0p001" RAT_FUNC "%6.3" "ms" COEFFS 0. 1000. 0. 0. 0. 1. /end COMPU_METHOD
/begin COMPU_METHOD _CNV_R_R_Def_f_uw_b_594_CM "Def_f_uw_b16" RAT_FUNC "%6.3" "-" COEFFS 0. 65536. 0. 0. 0. 16. /end COMPU_METHOD
/begin COMPU_METHOD _CNV_R_R_Def_zw_sw__599_CM "Def_zw_sw_q0p1" RAT_FUNC "%6.3" "°" COEFFS 0. 10. 0. 0. 0. 1. /end COMPU_METHOD
/begin COMPU_METHOD _CNV_R_R_Def_f_ub_b_602_CM "Def_f_ub_b100" RAT_FUNC "%6.3" "%" COEFFS 0. 256. 0. 0. 0. 100. /end COMPU_METHOD
/begin COMPU_METHOD _CNV_R_R_Def_f_sw_b_607_CM "Def_f_sw_b8" RAT_FUNC "%6.3" "-" COEFFS 0. 32768. 0. 0. 0. 8. /end COMPU_METHOD
/begin COMPU_METHOD _CNV_R_R_Def_f_sw_b_608_CM "Def_f_sw_b2" RAT_FUNC "%6.3" "-" COEFFS 0. 65536. 0. 0. 0. 4. /end COMPU_METHOD
/begin COMPU_METHOD _CNV_R_R_Def_f_ub_b_609_CM "Def_f_ub_b0p5" RAT_FUNC "%6.3" "-" COEFFS 0. 256. 0. 0. 0. 0.5 /end COMPU_METHOD
/begin COMPU_METHOD _CNV_R_R_Def_ms_uw__611_CM "Def_ms_uw_q0p03125" RAT_FUNC "%6.3" "kg/h" COEFFS 0. 32. 0. 0. 0. 1. /end COMPU_METHOD
/begin COMPU_METHOD _CNV_R_R_Def_n_sw_q_612_CM "Def_n_sw_q1p0" RAT_FUNC "%6.3" "Upm" COEFFS 0. 1. 0. 0. 0. 1. /end COMPU_METHOD
/begin COMPU_METHOD _CNV_R_R_Def_p_sw_q_614_CM "Def_p_sw_q0p078" RAT_FUNC "%6.3" "hPa" COEFFS 0. 256. 0. 0. 0. 20. /end COMPU_METHOD
/begin COMPU_METHOD _CNV_R_R_Def_rf_sw__616_CM "Def_rf_sw_q0p01" RAT_FUNC "%6.3" "%" COEFFS 0. 100. 0. 0. 0. 1. /end COMPU_METHOD
/begin COMPU_METHOD _CNV_R_R_Def_t_sw_q_618_CM "Def_t_sw_q0p1" RAT_FUNC "%6.3" "°C" COEFFS 0. 10. 0. 0. 0. 1. /end COMPU_METHOD
/begin COMPU_METHOD _CNV_R_R_Def_t_sw_q_620_CM "Def_t_sw_q0p01" RAT_FUNC "%6.3" "°C" COEFFS 0. 100. 0. 0. 0. 1. /end COMPU_METHOD
/begin COMPU_METHOD _CNV_R_R_Def_f_ub_b_625_CM "Def_f_ub_b2" RAT_FUNC "%6.3" "-" COEFFS 0. 256. 0. 0. 0. 2. /end COMPU_METHOD
/begin COMPU_METHOD _CNV_R_R_Def_cxm_sw_637_CM "Def_cxm_sw_q0p0039" RAT_FUNC "%6.3" "J/kg*K^2" COEFFS 0. 32768. 0. 0. 0. 128. /end COMPU_METHOD
/begin COMPU_METHOD _CNV_R_R_Def_m_uw_q_666_CM "Def_m_uw_q0p000305" RAT_FUNC "%6.3" "kg" COEFFS 0. 3273. 0. 0. 0. 1. /end COMPU_METHOD
/begin COMPU_METHOD _CNV_R_R_Def_lf_ub__675_CM "Def_lf_ub_q0p01" RAT_FUNC "%6.3" "-" COEFFS 0. 100. 0. 0. 0. 1. /end COMPU_METHOD
/begin COMPU_METHOD _CNV_R_R_Def_td_uw__679_CM "Def_td_uw_q0p01" RAT_FUNC "%6.3" "s" COEFFS 0. 100. 0. 0. 0. 1. /end COMPU_METHOD
/begin COMPU_METHOD _CNV_R_R_Def_td_uw__682_CM "Def_td_uw_q1" RAT_FUNC "%6.3" "s" COEFFS 0. 1. 0. 0. 0. 1. /end COMPU_METHOD
/begin COMPU_METHOD _CNV_R_R_Def_wdk_sw_691_CM "Def_wdk_sw_q0p0244" RAT_FUNC "%6.3" "%" COEFFS 0. 4096. 0. 0. 0. 100. /end COMPU_METHOD
/begin COMPU_METHOD _CNV_R_R_Def_rk_sw__697_CM "Def_rk_sw_b1600" RAT_FUNC "%6.3" "%" COEFFS 0. 2048. 0. 0. 0. 100. /end COMPU_METHOD
/begin COMPU_METHOD _CNV_S_1_Def_bit_ub_700_CM "Def_bit_ub_0" TAB_VERB "%6.3" "-" COMPU_TAB_REF _CNV_S_1_Def_bit_ub_700 /end COMPU_METHOD
/begin COMPU_VTAB _CNV_S_1_Def_bit_ub_700 "Def_bit_ub_0" TAB_VERB 1 0 "FALSE" /end COMPU_VTAB
/begin COMPU_METHOD _CNV_R_R_Def_td_uw__712_CM "Def_td_uw_q0p2" RAT_FUNC "%6.3" "s" COEFFS 0. 5. 0. 0. 0. 1. /end COMPU_METHOD
/begin COMPU_METHOD _CNV_R_R_Def_v_uw_q_723_CM "Def_v_uw_q1p0" RAT_FUNC "%6.3" "km/h" COEFFS 0. 1. 0. 0. 0. 1. /end COMPU_METHOD
/begin COMPU_METHOD _CNV_R_R_Def_vs_uw__731_CM "Def_vs_uw_b1280" RAT_FUNC "%6.3" "m^3/h" COEFFS 0. 65536. 0. 0. 0. 1280. /end COMPU_METHOD
/begin COMPU_METHOD _CNV_R_R_Def_tvpwm__736_CM "Def_tvpwm_uw_q0p00153" RAT_FUNC "%6.3" "%" COEFFS 0. 65535. 0. 0. 0. 100. /end COMPU_METHOD
/begin COMPU_METHOD _CNV_R_R_Def_f_ub_q_737_CM "Def_f_ub_q0p5_o1p0" RAT_FUNC "%6.3" "-" COEFFS 0. -512. 512. 0. 0. -1. /end COMPU_METHOD
/begin COMPU_METHOD _CNV_R_R_Def_v_ub_q_742_CM "Def_v_ub_q0p6" RAT_FUNC "%6.3" "km/h" COEFFS 0. 10. 0. 0. 0. 6. /end COMPU_METHOD
/begin COMPU_METHOD _CNV_R_R_Def_f_ub_b_743_CM "Def_f_ub_b1p0" RAT_FUNC "%6.3" "-" COEFFS 0. 255. 0. 0. 0. 1. /end COMPU_METHOD
/begin COMPU_METHOD _CNV_R_R_Def_t_ub_b_745_CM "Def_t_ub_b400" RAT_FUNC "%6.3" "s" COEFFS 0. 256. 0. 0. 0. 400. /end COMPU_METHOD
/begin COMPU_METHOD _CNV_R_R_Def_td_ub__749_CM "Def_td_ub_q0p05" RAT_FUNC "%6.3" "s" COEFFS 0. 20. 0. 0. 0. 1. /end COMPU_METHOD
/begin COMPU_METHOD _CNV_R_R_Def_cxm_uw_752_CM "Def_cxm_uw_b16384" RAT_FUNC "%6.3" "J/K" COEFFS 0. 4. 0. 0. 0. 1. /end COMPU_METHOD
/begin COMPU_METHOD _CNV_R_R_Def_cxm_ub_753_CM "Def_cxm_ub_q0p01" RAT_FUNC "%6.3" "J/s*K^2" COEFFS 0. 256. 0. 0. 0. 2.56 /end COMPU_METHOD
/begin RECORD_LAYOUT _REC_VAL_20_u1 FNC_VALUES 1 UBYTE COLUMN_DIR DIRECT /end RECORD_LAYOUT
/begin RECORD_LAYOUT _REC_VAL_20_u2 FNC_VALUES 1 UWORD COLUMN_DIR DIRECT /end RECORD_LAYOUT
/begin RECORD_LAYOUT _REC_AXS_20_u1 NO_AXIS_PTS_X 1 UBYTE AXIS_PTS_X 2 UBYTE INDEX_INCR DIRECT /end RECORD_LAYOUT
/begin RECORD_LAYOUT _REC_VAL_20_s2 FNC_VALUES 1 SWORD COLUMN_DIR DIRECT /end RECORD_LAYOUT
/begin RECORD_LAYOUT _REC_MAP_52_UBYTE_s2_s2_u2 NO_AXIS_PTS_X 1 UBYTE NO_AXIS_PTS_Y 2 UBYTE AXIS_PTS_X 3 SWORD INDEX_INCR DIRECT AXIS_PTS_Y 4 UWORD INDEX_INCR DIRECT FNC_VALUES 5 SWORD COLUMN_DIR DIRECT /end RECORD_LAYOUT
/begin RECORD_LAYOUT _REC_MAP_52_UBYTE_u2_s2_s2 NO_AXIS_PTS_X 1 UBYTE NO_AXIS_PTS_Y 2 UBYTE AXIS_PTS_X 3 SWORD INDEX_INCR DIRECT AXIS_PTS_Y 4 SWORD INDEX_INCR DIRECT FNC_VALUES 5 UWORD COLUMN_DIR DIRECT /end RECORD_LAYOUT
/begin RECORD_LAYOUT _REC_MAP_52_UBYTE_u2_s2_u2 NO_AXIS_PTS_X 1 UBYTE NO_AXIS_PTS_Y 2 UBYTE AXIS_PTS_X 3 SWORD INDEX_INCR DIRECT AXIS_PTS_Y 4 UWORD INDEX_INCR DIRECT FNC_VALUES 5 UWORD COLUMN_DIR DIRECT /end RECORD_LAYOUT
/begin RECORD_LAYOUT _REC_MAP_52_UBYTE_u2_u2_u2 NO_AXIS_PTS_X 1 UBYTE NO_AXIS_PTS_Y 2 UBYTE AXIS_PTS_X 3 UWORD INDEX_INCR DIRECT AXIS_PTS_Y 4 UWORD INDEX_INCR DIRECT FNC_VALUES 5 UWORD COLUMN_DIR DIRECT /end RECORD_LAYOUT
/begin RECORD_LAYOUT _REC_MAP_52_u1_s2_s2 NO_AXIS_PTS_X 1 UBYTE NO_AXIS_PTS_Y 2 UBYTE AXIS_PTS_X 3 SWORD INDEX_INCR DIRECT AXIS_PTS_Y 4 SWORD INDEX_INCR DIRECT FNC_VALUES 5 UBYTE COLUMN_DIR DIRECT /end RECORD_LAYOUT
/begin RECORD_LAYOUT _REC_MAP_52_UBYTE_s2_s2_s2 NO_AXIS_PTS_X 1 UBYTE NO_AXIS_PTS_Y 2 UBYTE AXIS_PTS_X 3 SWORD INDEX_INCR DIRECT AXIS_PTS_Y 4 SWORD INDEX_INCR DIRECT FNC_VALUES 5 SWORD COLUMN_DIR DIRECT /end RECORD_LAYOUT
/begin RECORD_LAYOUT _REC_MAP_52_UBYTE_u2_u2_s2 NO_AXIS_PTS_X 1 UBYTE NO_AXIS_PTS_Y 2 UBYTE AXIS_PTS_X 3 UWORD INDEX_INCR DIRECT AXIS_PTS_Y 4 SWORD INDEX_INCR DIRECT FNC_VALUES 5 UWORD COLUMN_DIR DIRECT /end RECORD_LAYOUT
/begin RECORD_LAYOUT _REC_CUR_TKL_UW_VV__u2_u2 NO_AXIS_PTS_X 1 UBYTE RESERVED 2 BYTE AXIS_PTS_X 3 UWORD INDEX_INCR DIRECT FNC_VALUES 4 UWORD COLUMN_DIR DIRECT /end RECORD_LAYOUT
/begin RECORD_LAYOUT _REC_CUR_TKL_UW_VV__u2_s2 NO_AXIS_PTS_X 1 UBYTE RESERVED 2 BYTE AXIS_PTS_X 3 SWORD INDEX_INCR DIRECT FNC_VALUES 4 UWORD COLUMN_DIR DIRECT /end RECORD_LAYOUT
/begin RECORD_LAYOUT _REC_CUR_TKL_UW_VV__u1_s2 NO_AXIS_PTS_X 1 UBYTE RESERVED 2 BYTE AXIS_PTS_X 3 SWORD INDEX_INCR DIRECT FNC_VALUES 4 UBYTE COLUMN_DIR DIRECT /end RECORD_LAYOUT
/begin RECORD_LAYOUT _REC_CUR_TKL_UW_VV__u1_u2 NO_AXIS_PTS_X 1 UBYTE RESERVED 2 BYTE AXIS_PTS_X 3 UWORD INDEX_INCR DIRECT FNC_VALUES 4 UBYTE COLUMN_DIR DIRECT /end RECORD_LAYOUT
/begin RECORD_LAYOUT _REC_CUR_TKL_UW_VV__s2_u2 NO_AXIS_PTS_X 1 UBYTE RESERVED 2 BYTE AXIS_PTS_X 3 UWORD INDEX_INCR DIRECT FNC_VALUES 4 SWORD COLUMN_DIR DIRECT /end RECORD_LAYOUT
/begin RECORD_LAYOUT _REC_CUR_TKL_UW_VV__s2_s2 NO_AXIS_PTS_X 1 UBYTE RESERVED 2 BYTE AXIS_PTS_X 3 SWORD INDEX_INCR DIRECT FNC_VALUES 4 SWORD COLUMN_DIR DIRECT /end RECORD_LAYOUT
/begin RECORD_LAYOUT _REC_CUR_TKL_UW_VV__u1_u1 NO_AXIS_PTS_X 1 UBYTE RESERVED 2 BYTE AXIS_PTS_X 3 UBYTE INDEX_INCR DIRECT FNC_VALUES 4 UBYTE COLUMN_DIR DIRECT /end RECORD_LAYOUT
/begin RECORD_LAYOUT _REC_CUR_20_S4_u1 FNC_VALUES 1 FLOAT32_IEEE COLUMN_DIR DIRECT /end RECORD_LAYOUT
/begin RECORD_LAYOUT _REC_VAL_20_S4 FNC_VALUES 1 FLOAT32_IEEE COLUMN_DIR DIRECT /end RECORD_LAYOUT
/begin FUNCTION ERRM_Rate_Base_Monitoring "Rate base monitoring"
 /begin DEF_CHARACTERISTIC c_t_ast_rbm c_vs_thd_rbm c_t_vs_rbm c_tam_min_rbm c_amp_min_rbm c_dly_ast_rbm c_t_is_rbm c_vs_thd_is_cdn_rbm lc_rbm_clr /end DEF_CHARACTERISTIC
 /begin OUT_MEASUREMENT ctr_igk_cyc_rbm ctr_cdn_obd_rbm lv_igk_cyc_rbm lv_dc_rbm t_ast_rbm t_vs_rbm t_is_rbm state_dc_rbm state_rbm[0] state_rbm[1] state_rbm[2] state_rbm[3] state_rbm[4] state_rbm[5] state_rbm[6] state_rbm[7] state_rbm[8] state_rbm[9] state_rbm[10] state_rbm[11] state_rbm[12] state_rbm[13] state_rbm[14] state_rbm[15] state_rbm[16] state_rbm[17] state_rbm[18] state_rbm[19] state_rbm[20] state_rbm[21] state_rbm[22] state_rbm[23] state_rbm[24] state_rbm[25] state_rbm[26] state_rbm[27] state_rbm[28] state_rbm[29] state_rbm[30] state_rbm[31] state_rbm[32] state_rbm[33] state_rbm[34] state_rbm[35] state_rbm[36] state_rbm[37] state_rbm[38] state_rbm[39] state_rbm[40] state_rbm[41] state_rbm[42] state_rbm[43] state_rbm[44] state_rbm[45] state_rbm[46] state_rbm[47] state_rbm[48] state_rbm[49] state_rbm[50] rbm_stat_CAT_DIAG_1.ctr_comp_rbm rbm_stat_CAT_DIAG_1.ctr_cdn_rbm rbm_stat_CAT_DIAG_1.state_ctr_rbm rbm_stat_CAT_DIAG_2.ctr_comp_rbm rbm_stat_CAT_DIAG_2.ctr_cdn_rbm rbm_stat_CAT_DIAG_2.state_ctr_rbm rbm_stat_DIAGCPS.ctr_comp_rbm rbm_stat_DIAGCPS.ctr_cdn_rbm rbm_stat_DIAGCPS.state_ctr_rbm rbm_stat_DYN_VLD_LS_UP_1.ctr_comp_rbm rbm_stat_DYN_VLD_LS_UP_1.ctr_cdn_rbm rbm_stat_DYN_VLD_LS_UP_1.state_ctr_rbm rbm_stat_DYN_VLD_LS_UP_2.ctr_comp_rbm rbm_stat_DYN_VLD_LS_UP_2.ctr_cdn_rbm rbm_stat_DYN_VLD_LS_UP_2.state_ctr_rbm rbm_stat_MEC_IVVT_IN.ctr_comp_rbm rbm_stat_MEC_IVVT_IN.ctr_cdn_rbm rbm_stat_MEC_IVVT_IN.state_ctr_rbm rbm_stat_SA_SYS.ctr_comp_rbm rbm_stat_SA_SYS.ctr_cdn_rbm rbm_stat_SA_SYS.state_ctr_rbm rbm_stat_AIR_LSL_UP_1.ctr_comp_rbm rbm_stat_AIR_LSL_UP_1.ctr_cdn_rbm rbm_stat_AIR_LSL_UP_1.state_ctr_rbm rbm_stat_AIR_LSL_UP_2.ctr_comp_rbm rbm_stat_AIR_LSL_UP_2.ctr_cdn_rbm rbm_stat_AIR_LSL_UP_2.state_ctr_rbm rbm_stat_DMTLM.ctr_comp_rbm rbm_stat_DMTLM.ctr_cdn_rbm rbm_stat_DMTLM.state_ctr_rbm rbm_stat_MEC_IVVT_EX.ctr_comp_rbm rbm_stat_MEC_IVVT_EX.ctr_cdn_rbm rbm_stat_MEC_IVVT_EX.state_ctr_rbm rbm_stat_SA_SAFM.ctr_comp_rbm rbm_stat_SA_SAFM.ctr_cdn_rbm rbm_stat_SA_SAFM.state_ctr_rbm rbm_stat_SA_SAP.ctr_comp_rbm rbm_stat_SA_SAP.ctr_cdn_rbm rbm_stat_SA_SAP.state_ctr_rbm rbm_stat_SA_SAV.ctr_comp_rbm rbm_stat_SA_SAV.ctr_cdn_rbm rbm_stat_SA_SAV.state_ctr_rbm rbm_stat_SA_SAV_LSL.ctr_comp_rbm rbm_stat_SA_SAV_LSL.ctr_cdn_rbm rbm_stat_SA_SAV_LSL.state_ctr_rbm rbm_stat_SHIFT_AFL_LSL_UP_1.ctr_comp_rbm rbm_stat_SHIFT_AFL_LSL_UP_1.ctr_cdn_rbm rbm_stat_SHIFT_AFL_LSL_UP_1.state_ctr_rbm rbm_stat_SHIFT_AFL_LSL_UP_2.ctr_comp_rbm rbm_stat_SHIFT_AFL_LSL_UP_2.ctr_cdn_rbm rbm_stat_SHIFT_AFL_LSL_UP_2.state_ctr_rbm rbm_stat_SHIFT_AFR_LSL_UP_1.ctr_comp_rbm rbm_stat_SHIFT_AFR_LSL_UP_1.ctr_cdn_rbm rbm_stat_SHIFT_AFR_LSL_UP_1.state_ctr_rbm rbm_stat_SHIFT_AFR_LSL_UP_2.ctr_comp_rbm rbm_stat_SHIFT_AFR_LSL_UP_2.ctr_cdn_rbm rbm_stat_SHIFT_AFR_LSL_UP_2.state_ctr_rbm rbm_stat_TAM_PLAUS.ctr_comp_rbm rbm_stat_TAM_PLAUS.ctr_cdn_rbm rbm_stat_TAM_PLAUS.state_ctr_rbm rbm_stat_TCO_2_PLAUS.ctr_comp_rbm rbm_stat_TCO_2_PLAUS.ctr_cdn_rbm rbm_stat_TCO_2_PLAUS.state_ctr_rbm rbm_stat_TCO_PLAUS.ctr_comp_rbm rbm_stat_TCO_PLAUS.ctr_cdn_rbm rbm_stat_TCO_PLAUS.state_ctr_rbm rbm_stat_TCO_STUCK.ctr_comp_rbm rbm_stat_TCO_STUCK.ctr_cdn_rbm rbm_stat_TCO_STUCK.state_ctr_rbm rbm_stat_VS_PLAUS.ctr_comp_rbm rbm_stat_VS_PLAUS.ctr_cdn_rbm rbm_stat_VS_PLAUS.state_ctr_rbm rbm_stat_FTL_OBD.ctr_comp_rbm rbm_stat_FTL_OBD.ctr_cdn_rbm rbm_stat_FTL_OBD.state_ctr_rbm rbm_stat_OBD_LSH_DOWN_1.ctr_comp_rbm rbm_stat_OBD_LSH_DOWN_1.ctr_cdn_rbm rbm_stat_OBD_LSH_DOWN_1.state_ctr_rbm rbm_stat_OBD_LSH_DOWN_2.ctr_comp_rbm rbm_stat_OBD_LSH_DOWN_2.ctr_cdn_rbm rbm_stat_OBD_LSH_DOWN_2.state_ctr_rbm rbm_stat_AMP_PLAUS.ctr_comp_rbm rbm_stat_AMP_PLAUS.ctr_cdn_rbm rbm_stat_AMP_PLAUS.state_ctr_rbm rbm_stat_TIA_PLAUS.ctr_comp_rbm rbm_stat_TIA_PLAUS.ctr_cdn_rbm rbm_stat_TIA_PLAUS.state_ctr_rbm rbm_stat_MAF.ctr_comp_rbm rbm_stat_MAF.ctr_cdn_rbm rbm_stat_MAF.state_ctr_rbm rbm_stat_ISC.ctr_comp_rbm rbm_stat_ISC.ctr_cdn_rbm rbm_stat_ISC.state_ctr_rbm rbm_stat_CS.ctr_comp_rbm rbm_stat_CS.ctr_cdn_rbm rbm_stat_CS.state_ctr_rbm rbm_stat_SMALL_LEAK.ctr_comp_rbm rbm_stat_SMALL_LEAK.ctr_cdn_rbm rbm_stat_SMALL_LEAK.state_ctr_rbm rbm_stat_ROUGH_LEAK.ctr_comp_rbm rbm_stat_ROUGH_LEAK.ctr_cdn_rbm rbm_stat_ROUGH_LEAK.state_ctr_rbm rbm_stat_OBD_VLD_LSH_UP_1.ctr_comp_rbm rbm_stat_OBD_VLD_LSH_UP_1.ctr_cdn_rbm rbm_stat_OBD_VLD_LSH_UP_1.state_ctr_rbm rbm_stat_OBD_VLD_LSH_UP_2.ctr_comp_rbm rbm_stat_OBD_VLD_LSH_UP_2.ctr_cdn_rbm rbm_stat_OBD_VLD_LSH_UP_2.state_ctr_rbm rbm_stat_TH.ctr_comp_rbm rbm_stat_TH.ctr_cdn_rbm rbm_stat_TH.state_ctr_rbm rbm_stat_LOAD_TPS_PLAUS.ctr_comp_rbm rbm_stat_LOAD_TPS_PLAUS.ctr_cdn_rbm rbm_stat_LOAD_TPS_PLAUS.state_ctr_rbm rbm_stat_MAP_DIP_PLAUS.ctr_comp_rbm rbm_stat_MAP_DIP_PLAUS.ctr_cdn_rbm rbm_stat_MAP_DIP_PLAUS.state_ctr_rbm rbm_stat_VLS_DOWN_DIF_2.ctr_comp_rbm rbm_stat_VLS_DOWN_DIF_2.ctr_cdn_rbm rbm_stat_VLS_DOWN_DIF_2.state_ctr_rbm rbm_stat_VLS_DOWN_DIF_1.ctr_comp_rbm rbm_stat_VLS_DOWN_DIF_1.ctr_cdn_rbm rbm_stat_VLS_DOWN_DIF_1.state_ctr_rbm rbm_stat_CHK_LS_DOWN_1.ctr_comp_rbm rbm_stat_CHK_LS_DOWN_1.ctr_cdn_rbm rbm_stat_CHK_LS_DOWN_1.state_ctr_rbm rbm_stat_CHK_LS_DOWN_2.ctr_comp_rbm rbm_stat_CHK_LS_DOWN_2.ctr_cdn_rbm rbm_stat_CHK_LS_DOWN_2.state_ctr_rbm rbm_stat_REF_CRK_CAM_IN_1.ctr_comp_rbm rbm_stat_REF_CRK_CAM_IN_1.ctr_cdn_rbm rbm_stat_REF_CRK_CAM_IN_1.state_ctr_rbm rbm_stat_REF_CRK_CAM_EX_1.ctr_comp_rbm rbm_stat_REF_CRK_CAM_EX_1.ctr_cdn_rbm rbm_stat_REF_CRK_CAM_EX_1.state_ctr_rbm rbm_stat_SWT_LS_DOWN_1.ctr_comp_rbm rbm_stat_SWT_LS_DOWN_1.ctr_cdn_rbm rbm_stat_SWT_LS_DOWN_1.state_ctr_rbm rbm_stat_SWT_LS_DOWN_2.ctr_comp_rbm rbm_stat_SWT_LS_DOWN_2.ctr_cdn_rbm rbm_stat_SWT_LS_DOWN_2.state_ctr_rbm rbm_stat_T_ES.ctr_comp_rbm rbm_stat_T_ES.ctr_cdn_rbm rbm_stat_T_ES.state_ctr_rbm rbm_stat_TPS.ctr_comp_rbm rbm_stat_TPS.ctr_cdn_rbm rbm_stat_TPS.state_ctr_rbm rbm_stat_ANG_INST_AD_VVL.ctr_comp_rbm rbm_stat_ANG_INST_AD_VVL.ctr_cdn_rbm rbm_stat_ANG_INST_AD_VVL.state_ctr_rbm rbm_stat_ANG_CHK_MAX_VVL.ctr_comp_rbm rbm_stat_ANG_CHK_MAX_VVL.ctr_cdn_rbm rbm_stat_ANG_CHK_MAX_VVL.state_ctr_rbm /end OUT_MEASUREMENT
/end FUNCTION
/begin FUNCTION ERRM_Dyn_Error_Managmt_Appl_Inc "" /end FUNCTION
/begin FUNCTION Abgastemperaturmodell "Verantwortlich: W. Weuste, H. Gehrke; Umsetzer: F. Perschl" /begin SUB_FUNCTION ATMNN ATMPH BS /end SUB_FUNCTION /end FUNCTION
/begin FUNCTION ATMNN "ATM Neuronales Netz zur Modellierung der Motoraustrittstemperaturen"
 /begin DEF_CHARACTERISTIC GAX_ATMNN KL_ATM_DTSL KL_ATM_DTTMOT KL_ATM_FLA KL_ATM_FSA KL_ATM_FSL KL_ATM_TMOTSA KL_TABGFIL KL_WBIAS KL_WLA KL_WNKW KL_WOUT KL_WRF KL_WVSA KL_WVSE KL_WZW K_ATMNN_ANZ K_ATMNN_EIN K_ATM_FTANS K_ATM_TANSREF K_BSLAMX K_DTNN K_WOUT_BIAS S_ATMNN_N53 S_ATM_N54 S_FUMU_BSNN S_NKW_MW S_RF_MW S_TABGFIL /end DEF_CHARACTERISTIC
 /begin OUT_MEASUREMENT Dt_bsnn1 Dt_bsnn2 La_bs_nn1 La_bs_nn2 Mszyl_int Nkw_atm Rf_atm St_atmnn St_atmnn.B_sa_akt Tabg_filt Tabg_nnarr Tnnsoll1 Tnnsoll2 Zw_mean /end OUT_MEASUREMENT
/end FUNCTION
/begin FUNCTION ATMPH "ATM Physikalische Modellierung des Abgastrakts"
 /begin DEF_CHARACTERISTIC KF_ATM54_ETA KF_ATM_FAKTH KF_ATM_FAKTS KF_ATM_FTH1 KF_ATM_FTH2 KF_ATM_FTS1 KF_ATM_FTS2 KL_ATM54_ABG KL_ATM54_KAP KL_ATM_ABGR1 KL_ATM_ABGR10 KL_ATM_ABGR11 KL_ATM_ABGR11A KL_ATM_ABGR12 KL_ATM_ABGR12A KL_ATM_ABGR13 KL_ATM_ABGR14 KL_ATM_ABGR14A KL_ATM_ABGR15 KL_ATM_ABGR16 KL_ATM_ABGR4 KL_ATM_ABGR7 KL_ATM_ABGR8 KL_ATM_ABGR9 KL_ATM_ABST KL_ATM_ABSTNK KL_ATM_DV KL_ATM_FLAM KL_ATM_FVBANK KL_ATM_FVLK0 KL_ATM_FVLK1 KL_ATM_LK_DV KL_ATM_LK_V KL_ATM_RUMG1 KL_ATM_RUMG10 KL_ATM_RUMG11 KL_ATM_RUMG11A KL_ATM_RUMG12 KL_ATM_RUMG12A KL_ATM_RUMG13 KL_ATM_RUMG14 KL_ATM_RUMG14A KL_ATM_RUMG15 KL_ATM_RUMG16 KL_ATM_RUMG4 KL_ATM_RUMG7 KL_ATM_RUMG8 KL_ATM_RUMG9 KL_ATM_RUMGT1 KL_ATM_RUMGT2 KL_ATM_TKA_FV KL_K_EXH_LA KL_K_EXH_MS KL_K_EXS_LA KL_K_EXS_MS KL_K_T_DEC1 KL_K_T_DEC2 KL_K_T_INC1 KL_K_T_INC2 KL_N_EX_LA KL_N_EX_MS KL_N_T_DECA KL_N_T_DECB KL_N_T_INCA KL_N_T_INCB KL_ZK_VK1 KL_ZK_VK2 K_ATM54_CPR K_ATMNOK_RES K_ATM_CPR1 K_ATM_CPR10 K_ATM_CPR11 K_ATM_CPR11A K_ATM_CPR12 K_ATM_CPR12A K_ATM_CPR13 K_ATM_CPR14 K_ATM_CPR14A K_ATM_CPR15 K_ATM_CPR16 K_ATM_CPR2 K_ATM_CPR3 K_ATM_CPR4 K_ATM_CPR5 K_ATM_CPR6 K_ATM_CPR7 K_ATM_CPR8 K_ATM_CPR9 K_ATM_DESUAPP K_ATM_FTANS_R1 K_ATM_FTANS_R10 K_ATM_FTANS_R4 K_ATM_FTANS_R7 K_ATM_FTANS_R8 K_ATM_FTANS_R9 K_ATM_FTANS_TMR K_ATM_FTMOT K_ATM_FTMR_R1 K_ATM_FTMR_R10 K_ATM_FTMR_R4 K_ATM_FTMR_R7 K_ATM_FTMR_R8 K_ATM_FTMR_R9 K_ATM_LKLPS K_ATM_RESET K_ATM_TABGMX K_ATM_TMOT K_ATM_UEB_CON K_ATM_UEB_LA K_ATM_UEB_MA K_ATM_UEB_MS K_ATM_UEB_T K_ATM_UEB_V K_DELAY_SA K_DELAY_SAV K_FEXODESU K_K_ANSPRING K_K_NOEXO K_NOK_AN K_N_NOEXO K_SATLIM K_SATLIM_NK K_TRNOK_ST K_TR_ST S_ATMPH_SENS S_ATMPH_SENS1 S_ATMPH_SENS2 S_MSZYL_MW S_TSENSTURB /end DEF_CHARACTERISTIC
 /begin OUT_MEASUREMENT Dtwr1 Dtwr10 Dtwr11 Dtwr11a Dtwr12 Dtwr12a Dtwr13 Dtwr14 Dtwr14a Dtwr15 Dtwr16 Dtwr2 Dtwr3 Dtwr4 Dtwr5 Dtwr6 Dtwr7 Dtwr8 Dtwr9 Dtwr_wg1 Dtwr_wg2 Exonok1 Exonok2 Fatmtmot Mszyl_atm Mszyl_bank Mszyl_ges_atm Mszyl_nagr Mszyl_rohr Nok_ta_1 Nok_ta_2 Nok_tb_1 Nok_tb_2 St_atmphintern St_atmphintern.B_atmphreset St_atmphintern.B_er_lklps St_atmphintern.B_lklps_atm St_atmphintern.B_motoraus St_edge_rising St_edge_rising.B_ef_sa St_edge_rising.B_er_atm_reset St_edge_rising.B_er_sa St_edge_rising.B_er_startende St_edge_rising.B_sa_atmph St_sa_atmph St_sa_atmph.B_vb_sa St_sa_atmph.B_vb_sa_nk T_ikat1 T_ikat1_stat T_ikat2 T_ikat2_stat Tabg_agr Tabg_anok1 Tabg_anok2 Tabg_bank1 Tabg_bank2 Tabg_demax1 Tabg_demax2 Tabg_demaxav Tabg_desul Tabg_desul1 Tabg_desul2 Tabg_fth Tabg_ikat_av Tabg_inok1 Tabg_inok2 Tabg_izus Tabg_m1 Tabg_m2 Tabg_natl1 Tabg_natl2 Tabg_nk1 Tabg_nk2 Tabg_nk3 Tabg_nk3st Tabg_nk_av Tabg_nkab Tabg_nkst Tabg_nnarrh Tabg_nnok1 Tabg_nnok2 Tabg_nok_av Tabg_nok_av1 Tabg_nok_av2 Tabg_nokab1 Tabg_nokab2 Tabg_nokmax Tabg_nokmax1 Tabg_nokmax2 Tabg_nokmin Tabg_nokmin1 Tabg_nokmin2 Tabg_nokst1 Tabg_nokst2 Tabg_nzus Tabg_r1 Tabg_r10 Tabg_r11 Tabg_r12 Tabg_r12a Tabg_r13 Tabg_r14 Tabg_r14a Tabg_r15 Tabg_r16 Tabg_r2 Tabg_r3 Tabg_r4 Tabg_r5 Tabg_r6 Tabg_r7 Tabg_r8 Tabg_r9 Tabg_sens_mdl1 Tabg_sens_mdl2 Tabg_turb1 Tabg_turb2 Tabg_vk1 Tabg_vk1ab Tabg_vk1st Tabg_vk2 Tabg_vk_av Tabg_vnok1 Tabg_vnok2 Tabg_wg1 Tabg_wg2 Tans_ini Tmr_r1 Tmr_r10 Tmr_r11 Tmr_r4 Tmr_r7 Tmr_r8 Tmr_r9 Tw_m1 Tw_m1ab Tw_m1st Tw_m2 Tw_m2ab Tw_m2st Tw_nk1 Tw_nk1ab Tw_nk1st Tw_nk2 Tw_nk2ab Tw_nk2st Tw_r1 Tw_r11 Tw_r11a Tw_r12 Tw_r12a Tw_r13 Tw_r14 Tw_r14a Tw_r15 Tw_r16 Tw_r1ab Tw_r1st Tw_r2 Tw_r3 Tw_r4 Tw_r4ab Tw_r4st Tw_r5 Tw_r6 Tw_wg1 Tw_wg2 V_atm_b1 V_atm_b2 /end OUT_MEASUREMENT
/end FUNCTION
/begin FUNCTION BS "ATM Bauteilschutz"
 /begin DEF_CHARACTERISTIC CW_ATMOD KF_BS_MX KF_BS_VST KF_BS_VST_N54 KF_TA_NOKSOLL KF_TA_VKSOLL KL_BS_I_NOK KL_BS_P_NOK KL_BS_ZKNN K_BSDELT1 K_BSDELT2 K_BSDELT3 K_BSDELT4 K_BSDELT5 K_BSDELT6 K_BSDELT7 K_BSDELT8 K_BS_D K_BS_D_NOK K_BS_I K_BS_IMN K_BS_IMX K_BS_MN K_BS_P K_BS_REGMN K_BS_REGMX K_BS_ZKININN K_LABSOFF K_LA_BSPASS_FETT K_LA_BSPASS_MAGER K_TA_VKSOLL_DELT K_TA_VKSOLL_DELT2 K_TBS2 /end DEF_CHARACTERISTIC
 /begin OUT_MEASUREMENT Dlam_bs1 Dlam_bs2 Dlam_bs_n54 Dlam_bs_nok1 Dlam_bs_nok2 Dta_bs1 Dta_bs2 Dta_bs_nok1 Dta_bs_nok2 F_bs_i_nok F_bs_p_nok La_bs1 La_bs2 La_bs_nn1_ini La_bs_nn2_ini La_bs_soll1 La_bs_soll2 La_bs_soll3 La_bs_soll4 La_vst1 La_vst2 St_reg_bs1 St_reg_bs2 St_reg_bs3 St_reg_bs4 St_testbs St_testbs.B_FI_HFM St_testbs.B_FI_HFMPL St_testbs.B_FI_PUS St_testbs.B_FI_TANS St_testbs.B_FI_TKA St_testbs.B_FI_TMOT St_testbs.B_FI_VFZ St_zwbts1 St_zwbts1.B_bs1 St_zwbts1.B_bs2 St_zwbts1.B_bsmager St_zwbtsakt St_zwbtsakt.B_bsakt1 St_zwbtsakt.B_bsakt2 St_zwbtsakt.B_bsakt3 St_zwbtsakt.B_bsakt4 Tbsaus1 Tbsaus2 Tbsaus3 Tbsaus4 Tbsein1 Tbsein2 Tbsein3 Tbsein4 Tnnvksoll Tnoksoll1 Tnoksoll2 Tvksoll1 Tvksoll2 /end OUT_MEASUREMENT
/end FUNCTION
/begin FUNCTION AGRKO ""
 /begin DEF_CHARACTERISTIC KF_AGRHOM KF_AGRHOMMAX KF_AGRHOS KF_AGRHOSMAX KF_AGRSCH KF_AGRSCHMAX KL_AGRMSZYL KL_AGRTMOT KL_LAMBAGR K_AGRAUS K_AGRKLEIN K_AGRSOLLAPP S_AGRAUS_MAN S_AGRSOLLAPP /end DEF_CHARACTERISTIC
 /begin OUT_MEASUREMENT Agr_hom Agr_sch Agr_soll Agr_tra Agr_w St_agrko St_agrko.B_agr_aus St_agrko.B_agr_hom St_agrko.B_agr_hs St_agrko.B_agr_sch /end OUT_MEASUREMENT
/end FUNCTION
/begin FUNCTION ATLAD ""
 /begin DEF_CHARACTERISTIC K_ATLAD_MN K_ATLAD_MX K_IKATLAD K_NKWAD_MN K_NKWAD_MX K_PLDDIFFAD K_PLDSAD_MN K_PLDSAD_MX K_PLDSDAD_MN K_PLDSDAD_MX K_TANSATLAD K_TMOTATLAD /end DEF_CHARACTERISTIC
 /begin OUT_MEASUREMENT F_atlad F_atlrivst St_atlad St_atlad.B_atlad /end OUT_MEASUREMENT
/end FUNCTION
/begin FUNCTION ATLDIAG ""
 /begin DEF_CHARACTERISTIC KL_PLDLEK_MN KL_PLDLEK_MX K_ATLRPID_MN K_ATLRPID_MX K_MSVLDLEKF K_NKWLEK_MN K_NKWLEK_MX K_PLDD_MN K_PLDD_MX K_PLDLEKF K_PLDLEKOFS K_PLDSLEKF K_TDATLLEKF K_TDATL_ERR /end DEF_CHARACTERISTIC
 /begin OUT_MEASUREMENT St_atldiag_10ms St_atldiag_10ms.B_atllekfast St_atldiag_10ms.B_atlr_errmn St_atldiag_10ms.B_atlr_errmx St_atldiag_10ms.B_beratllek St_atldiag_10ms.B_pld_errmn St_atldiag_10ms.B_pld_errmx St_atldiag_tmp St_atldiag_tmp.B_fi_atllekfast St_atldiag_tmp.B_fi_atlrmn St_atldiag_tmp.B_fi_atlrmx /end OUT_MEASUREMENT
/end FUNCTION
/begin FUNCTION ATLGLS ""
 /begin DEF_CHARACTERISTIC KF_WG1KOR KF_WG1_ZU2 KL_FKWG1KOR KL_IKWG1K K_FKWG1DIAG K_TDWG1PLMN K_TDWG1PLMX K_WG1DIAGMN K_WG1DIAGMN2 K_WG1DIAGMX K_WG1DIAGMX2 K_WG1KMN K_WG1KMX K_WG1KOR K_WG2KOR S_ATLGLS_PI S_GLS2_MAN S_GLS_MAN /end DEF_CHARACTERISTIC
 /begin OUT_MEASUREMENT F_msvld_diff F_wg1diag F_wg1k_ad F_wg1k_fast F_wg1kor F_wg2kor St_atlgls St_atlgls.B_atlgls_pl St_atlgls.B_fi_atlgls St_atlgls.B_wg1plmn St_atlgls.B_wg1plmn2 St_atlgls.B_wg1plmx St_atlgls.B_wg1plmx2 /end OUT_MEASUREMENT
/end FUNCTION
/begin FUNCTION ATLOB ""
 /begin DEF_CHARACTERISTIC KF_DPLDULS KF_DRFMXW_OB KL_TDOBAKTIV KL_TDOBSPERR KL_TDRFMXOB K_PLD_AUS K_PWGGRDOB K_TDULSF K_TDULSFRST K_ULSHYS S_PLDAUS /end DEF_CHARACTERISTIC
 /begin OUT_MEASUREMENT Drfmx_ob Drfmxw_ob St_atlob St_atlob.B_atlob St_atlob.B_atlob_sp St_atlob.B_atlreg St_atlob.B_ldo_err St_atlob_intern St_atlob_intern.B_atlob_akt St_atlob_intern.B_atlob_end St_atlob_intern.B_atlstdby St_atlob_intern.B_atlstrg /end OUT_MEASUREMENT
/end FUNCTION
/begin FUNCTION ATLOUT ""
 /begin DEF_CHARACTERISTIC KF_FWGZUEKOR KL_TVWGKORHO KL_TVWG_DN KL_TVWG_UP K_TVWG K_TVWG2 K_TVWGMIN K_TVWG_GLAKT K_TVWG_MN K_TVWG_MX S_TVWG2_INV S_TVWG2_MAN S_TVWGKORHOKL S_TVWG_INV S_TVWG_MAN /end DEF_CHARACTERISTIC
 /begin OUT_MEASUREMENT St_atlout St_atlout.B_wg1_auf St_atlout.B_wg2_auf Tvwg Tvwg1_korho Tvwg2 Tvwg2_korho /end OUT_MEASUREMENT
/end FUNCTION
/begin FUNCTION ATLPUMP ""
 /begin DEF_CHARACTERISTIC KL_PLDPUMPMN K_MSVLDPMPMN K_MSVLDPMPMX K_NKWPUMP_MN K_NKWPUMP_MX K_PLDDPUMP K_PLDSDPMPMN /end DEF_CHARACTERISTIC
 /begin OUT_MEASUREMENT St_atlpump St_atlpump.B_atlpump1 St_atlpump.B_atlpump2 St_atlpump.B_beratlpump /end OUT_MEASUREMENT
/end FUNCTION
/end MODULE
/end PROJECT
