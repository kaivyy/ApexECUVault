ASAP2_VERSION 1 41
/begin PROJECT MSD70 "Spray Guided DI-System with Piezo Injectors for 6-Cylinder"
/begin HEADER "_default_HeaderComment" PROJECT_NO _0B /end HEADER
/begin MODULE _default_ModuleName "_default_ModuleLongIdentifier"
/begin MOD_COMMON "_default_ModCommonComment" DEPOSIT ABSOLUTE BYTE_ORDER MSB_LAST ALIGNMENT_BYTE 1 ALIGNMENT_WORD 2 ALIGNMENT_LONG 2 ALIGNMENT_FLOAT32_IEEE 2 ALIGNMENT_FLOAT64_IEEE 4 /end MOD_COMMON
/begin AXIS_PTS ldpm_prs_dec_inj_1_injr "" 0xa1008314 prs_dec_inj_1_hom _REC_AXS_20_u2 347776. _CNV_A_R_LINEAR_____152_CM 6 0. 347776. FORMAT "%8.1" /end AXIS_PTS
/begin MEASUREMENT inh_iv "Shut off pattern for static cylinder shut off (fixed cylinder allocation)" UBYTE _CNV_A_R_LINEAR_____0_CM 1 100. 0. 255. DISPLAY_IDENTIFIER INH_IV ECU_ADDRESS 0xd0002ee2 FORMAT "%3.0" /end MEASUREMENT
/begin MEASUREMENT inh_swi_iv "Shut off pattern for dynamic cylinder shut off" UWORD _CNV_A_R_LINEAR_____0_CM 1 100. 0. 65535. DISPLAY_IDENTIFIER INH_SWI_IV ECU_ADDRESS 0xd0002b12 FORMAT "%5.0" /end MEASUREMENT
/begin MEASUREMENT inh_iv_igk "Shut off pattern of IGK" UBYTE _CNV_A_R_LINEAR_____0_CM 1 100. 0. 255. DISPLAY_IDENTIFIER INH_IV_IGK ECU_ADDRESS 0xc00023fc FORMAT "%3.0" /end MEASUREMENT
/begin MEASUREMENT inh_iv_puc "Shut off pattern of pull fuel shut off " UBYTE _CNV_A_R_LINEAR_____0_CM 1 100. 0. 255. DISPLAY_IDENTIFIER INH_IV_PUC ECU_ADDRESS 0xc00023ff FORMAT "%3.0" /end MEASUREMENT
/begin MEASUREMENT inh_iv_mon "Shut off pattern of shut off request by monitoring concept " UBYTE _CNV_A_R_LINEAR_____0_CM 1 100. 0. 255. DISPLAY_IDENTIFIER INH_IV_MON ECU_ADDRESS 0xc00023fd FORMAT "%3.0" /end MEASUREMENT
/begin MEASUREMENT nr_pat "Index corresponding to the highest shut off level (fuel shut off with pattern)" UBYTE _CNV_A_R_LINEAR_____0_CM 1 100. 0. 255. DISPLAY_IDENTIFIER NR_PAT ECU_ADDRESS 0xd0002eec FORMAT "%3.0" /end MEASUREMENT
/begin MEASUREMENT sum_inh_iv "Sum of INH_IV" UBYTE _CNV_A_R_LINEAR_____0_CM 1 100. 0. 8. DISPLAY_IDENTIFIER SUM_INH_IV ECU_ADDRESS 0xd0002ef3 FORMAT "%3.0" /end MEASUREMENT
/begin CHARACTERISTIC id_inh_swi_iv "Cylinder shut-off pattern for dynamic cylinder shut off" CURVE 0xa1008324 _REC_CUR_20_u2_u1 65535. _CNV_A_R_LINEAR_____0_CM 0. 65535. DISPLAY_IDENTIFIER ID_INH_SWI_IV FORMAT "%5.0"
 /begin AXIS_DESCR COM_AXIS nr_pat _CNV_A_R_LINEAR_____0_CM 9 0. 255. READ_ONLY FORMAT "%3.0" AXIS_PTS_REF ldp_nr_pat_id_inh_swi_iv /end AXIS_DESCR
/end CHARACTERISTIC
/begin AXIS_PTS ldp_nr_pat_id_inh_swi_iv "" 0xa1008250 nr_pat _REC_AXS_20_u1 255. _CNV_A_R_LINEAR_____0_CM 9 0. 255. READ_ONLY FORMAT "%3.0" /end AXIS_PTS
/begin MEASUREMENT inh_inj "Sum pattern of cylinder shut off information (fixed cylinder allocation)" UBYTE _CNV_A_R_LINEAR_____0_CM 1 100. 0. 255. DISPLAY_IDENTIFIER INH_INJ ECU_ADDRESS 0xd0002ee1 FORMAT "%3.0" /end MEASUREMENT
/begin MEASUREMENT sum_inh_inj "Sum of INH_INJ" UBYTE _CNV_A_R_LINEAR_____0_CM 1 100. 0. 8. DISPLAY_IDENTIFIER SUM_INH_INJ ECU_ADDRESS 0xd0002ef2 FORMAT "%3.0" /end MEASUREMENT
/begin MEASUREMENT lv_inj_cut "All cylinders are shut off" UBYTE _CNV_S_2_RANGE__0___1_CM 1 100. 0. 1. DISPLAY_IDENTIFIER LV_INJ_CUT ECU_ADDRESS 0xd0002f0d BIT_MASK 0x1 /end MEASUREMENT
/begin MEASUREMENT lv_fcut_ind "At least one cylinder is shut off" UBYTE _CNV_S_2_RANGE__0___1_CM 1 100. 0. 1. DISPLAY_IDENTIFIER LV_FCUT_IND ECU_ADDRESS 0xd0002f0c BIT_MASK 0x1 /end MEASUREMENT
/begin MEASUREMENT sum_inh_iv_dyn "Sum of INH_IV_DYN" UBYTE _CNV_A_R_LINEAR_____0_CM 1 100. 0. 8. DISPLAY_IDENTIFIER SUM_INH_IV_DYN ECU_ADDRESS 0xd0002ef4 FORMAT "%3.0" /end MEASUREMENT
/begin MEASUREMENT inh_iv_n_max_req_fcut "Shut off pattern of LV_N_MAX_REQ_FCUT (engine speed limitation)" UBYTE _CNV_A_R_LINEAR_____0_CM 1 100. 0. 255. DISPLAY_IDENTIFIER INH_IV_N_MAX_REQ_FCUT ECU_ADDRESS 0xc00023fe FORMAT "%3.0" /end MEASUREMENT
/begin CHARACTERISTIC lc_swi_mod_inh_iv_dyn "Mode switch between different dynamic fuel shut off algorithm" VALUE 0xa1008a85 _REC_VAL_20_u1 1. _CNV_A_R_LINEAR_____0_CM 0. 1. DISPLAY_IDENTIFIER LC_SWI_MOD_INH_IV_DYN FORMAT "%1.0" /end CHARACTERISTIC
/begin MEASUREMENT state_inh_iv_dyn "State of the dynamic cylinder shut off request" ULONG _CNV_A_R_LINEAR_____0_CM 1 100. 0. 4294967295. DISPLAY_IDENTIFIER STATE_INH_IV_DYN ECU_ADDRESS 0xd00020dc FORMAT "%10.0" /end MEASUREMENT
/begin MEASUREMENT lv_ti_1_hom_min "Flag to indicate that minimum injection time is reached for homogeneous mode, first pulse" UBYTE _CNV_S_2_RANGE__0___1_CM 1 100. 0. 1. DISPLAY_IDENTIFIER LV_TI_1_HOM_MIN ECU_ADDRESS 0xd0002f15 BIT_MASK 0x1 /end MEASUREMENT
/begin MEASUREMENT lv_auth_ti_min_afl "Logical variable to authorize homogeneous lean mode if injection time is not to less" UBYTE _CNV_S_2_RANGE__0___1_CM 1 100. 0. 1. DISPLAY_IDENTIFIER LV_AUTH_TI_MIN_AFL ECU_ADDRESS 0xd0002f00 BIT_MASK 0x1 /end MEASUREMENT
/begin CHARACTERISTIC c_t_auth_ti_min_afl "Delay time after AFL mode was inhibited due to injection time limitation" VALUE 0xa1008a3e _REC_VAL_20_u2 655.34 _CNV_A_R_INJR_LINEA_472_CM 1.e-002 655.35 DISPLAY_IDENTIFIER C_T_AUTH_TI_MIN_AFL FORMAT "%6.2" /end CHARACTERISTIC
/begin MEASUREMENT lv_ti_2_hom_min "Flag to indicate that minimum injection time is reached for homogeneous mode, second pulse" UBYTE _CNV_S_2_RANGE__0___1_CM 1 100. 0. 1. DISPLAY_IDENTIFIER LV_TI_2_HOM_MIN ECU_ADDRESS 0xd0002f17 BIT_MASK 0x1 /end MEASUREMENT
/begin MEASUREMENT lv_auth_ti_min_s "Logical variable to authorize stratified mode if injection time is not to less" UBYTE _CNV_S_2_RANGE__0___1_CM 1 100. 0. 1. DISPLAY_IDENTIFIER LV_AUTH_TI_MIN_S ECU_ADDRESS 0xd0002f01 BIT_MASK 0x1 /end MEASUREMENT
/begin MEASUREMENT lv_ti_2_s_min "Flag to indicate that minimum injection time is reached for stratified mode, second pulse" UBYTE _CNV_S_2_RANGE__0___1_CM 1 100. 0. 1. DISPLAY_IDENTIFIER LV_TI_2_S_MIN ECU_ADDRESS 0xd0002f18 BIT_MASK 0x1 /end MEASUREMENT
/begin MEASUREMENT lv_ti_1_s_min "Flag to indicate that minimum injection time is reached for stratified mode, first pulse" UBYTE _CNV_S_2_RANGE__0___1_CM 1 100. 0. 1. DISPLAY_IDENTIFIER LV_TI_1_S_MIN ECU_ADDRESS 0xd0002f16 BIT_MASK 0x1 /end MEASUREMENT
/begin MEASUREMENT ti_2_hom_clc_min "Minimum injection time of second pulse, homogeneous mode" UWORD _CNV_A_R_LINEAR_____233_CM 1 100. 0. 65.535 DISPLAY_IDENTIFIER TI_2_HOM_CLC_MIN ECU_ADDRESS 0xc00023f2 /end MEASUREMENT
/begin MEASUREMENT ti_1_hom_clc_min "Minimum injection time of first pulse, homogeneous mode" UWORD _CNV_A_R_LINEAR_____233_CM 1 100. 0. 65.535 DISPLAY_IDENTIFIER TI_1_HOM_CLC_MIN ECU_ADDRESS 0xc00023ea /end MEASUREMENT
/begin MEASUREMENT ti_1_hom_clc_max "Maximum injection time of first pulse, homogeneous mode" UWORD _CNV_A_R_LINEAR_____233_CM 1 100. 0. 65.535 DISPLAY_IDENTIFIER TI_1_HOM_CLC_MAX ECU_ADDRESS 0xd0002b5a /end MEASUREMENT
/begin MEASUREMENT ti_2_hom_clc_max "Maximum injection time of second pulse, homogeneous mode" UWORD _CNV_A_R_LINEAR_____233_CM 1 100. 0. 65.535 DISPLAY_IDENTIFIER TI_2_HOM_CLC_MAX ECU_ADDRESS 0xc00023f0 /end MEASUREMENT
/begin MEASUREMENT ti_1_s_clc_min "Minimum injection time of first pulse, stratified mode" UWORD _CNV_A_R_LINEAR_____233_CM 1 100. 0. 65.535 DISPLAY_IDENTIFIER TI_1_S_CLC_MIN ECU_ADDRESS 0xc00023ee /end MEASUREMENT
/begin MEASUREMENT ti_2_s_clc_min "Minimum injection time of second pulse, stratified mode" UWORD _CNV_A_R_LINEAR_____233_CM 1 100. 0. 65.535 DISPLAY_IDENTIFIER TI_2_S_CLC_MIN ECU_ADDRESS 0xc00023f8 /end MEASUREMENT
/begin CHARACTERISTIC lc_ti_2_s_man_act "switch for manual setpoint for injection time in startified mode, 2. pulse" VALUE 0xa1008a8a _REC_VAL_20_u1 1. _CNV_A_R_LINEAR_____0_CM 0. 1. DISPLAY_IDENTIFIER LC_TI_2_S_MAN_ACT FORMAT "%1.0" /end CHARACTERISTIC
/begin CHARACTERISTIC lc_ti_1_s_man_act "switch for manual setpoint for injection time in startified mode, 1. pulse" VALUE 0xa1008a88 _REC_VAL_20_u1 1. _CNV_A_R_LINEAR_____0_CM 0. 1. DISPLAY_IDENTIFIER LC_TI_1_S_MAN_ACT FORMAT "%1.0" /end CHARACTERISTIC
/begin CHARACTERISTIC c_ti_2_s_man "manual setpoint for injection time in stratified mode,  2. pulse " VALUE 0xa1008a48 _REC_VAL_20_u2 65.535 _CNV_A_R_LINEAR_____233_CM 0. 65.535 DISPLAY_IDENTIFIER C_TI_2_S_MAN /end CHARACTERISTIC
/begin CHARACTERISTIC lc_ti_1_hom_man_act "Manual switch for manual setpoint for injection time in homogeneous mode, 1. pulse" VALUE 0xa1008a87 _REC_VAL_20_u1 1. _CNV_A_R_LINEAR_____0_CM 0. 1. DISPLAY_IDENTIFIER LC_TI_1_HOM_MAN_ACT FORMAT "%1.0" /end CHARACTERISTIC
/begin CHARACTERISTIC lc_ti_2_hom_man_act "Manual switch for manual setpoint for injection time in homogeneous mode, 2. pulse" VALUE 0xa1008a89 _REC_VAL_20_u1 1. _CNV_A_R_LINEAR_____0_CM 0. 1. DISPLAY_IDENTIFIER LC_TI_2_HOM_MAN_ACT FORMAT "%1.0" /end CHARACTERISTIC
/begin CHARACTERISTIC c_ti_1_hom_man "Manual setpoint for injection time in homogeneous mode, 1. pulse " VALUE 0xa1008a42 _REC_VAL_20_u2 65.535 _CNV_A_R_LINEAR_____233_CM 0. 65.535 DISPLAY_IDENTIFIER C_TI_1_HOM_MAN /end CHARACTERISTIC
/begin CHARACTERISTIC c_ti_2_hom_man "Manual setpoint for injection time in homogeneous mode, 2. pulse " VALUE 0xa1008a46 _REC_VAL_20_u2 65.535 _CNV_A_R_LINEAR_____233_CM 0. 65.535 DISPLAY_IDENTIFIER C_TI_2_HOM_MAN /end CHARACTERISTIC
/begin CHARACTERISTIC ip_ti_min_hom "Minimum injection time limitation for homogeneous mode" CURVE 0xa10089f0 _REC_CUR_20_u2_u2 65.535 _CNV_A_R_LINEAR_____233_CM 0. 65.535 DISPLAY_IDENTIFIER IP_TI_MIN_HOM
 /begin AXIS_DESCR COM_AXIS prs_dec_inj_1_hom _CNV_A_R_LINEAR_____152_CM 6 0. 347776. FORMAT "%8.1" AXIS_PTS_REF ldpm_prs_dec_inj_1_injr /end AXIS_DESCR
/end CHARACTERISTIC
/begin CHARACTERISTIC ip_ti_min_s "Minimum injection time limitation for stratified mode" CURVE 0xa10089fc _REC_CUR_20_u2_u2 65.535 _CNV_A_R_LINEAR_____233_CM 0. 65.535 DISPLAY_IDENTIFIER IP_TI_MIN_S
 /begin AXIS_DESCR COM_AXIS prs_dec_inj_1_hom _CNV_A_R_LINEAR_____152_CM 6 0. 347776. FORMAT "%8.1" AXIS_PTS_REF ldpm_prs_dec_inj_1_injr /end AXIS_DESCR
/end CHARACTERISTIC
/begin CHARACTERISTIC ip_mff_ti_stnd_egy_h "Injector characteristic at standard conditions, for high energy range" CURVE 0xa1008680 _REC_CUR_20_u2_u2 65.535 _CNV_A_R_LINEAR_____233_CM 0. 65.535 DISPLAY_IDENTIFIER IP_MFF_TI_STND_EGY_H
 /begin AXIS_DESCR COM_AXIS online_dummy _CNV_A_R_LINEAR_____108_CM 16 0. 1389. FORMAT "%7.2" AXIS_PTS_REF ldpm_mff_sp_1_injr /end AXIS_DESCR
/end CHARACTERISTIC
/begin CHARACTERISTIC ip_mff_ti_stnd_egy_l "Injector characteristic at standard conditions, for low energy range" CURVE 0xa10086a0 _REC_CUR_20_u2_u2 65.535 _CNV_A_R_LINEAR_____233_CM 0. 65.535 DISPLAY_IDENTIFIER IP_MFF_TI_STND_EGY_L
 /begin AXIS_DESCR COM_AXIS online_dummy _CNV_A_R_LINEAR_____108_CM 16 0. 1389. FORMAT "%7.2" AXIS_PTS_REF ldpm_mff_sp_1_injr /end AXIS_DESCR
/end CHARACTERISTIC
/begin MEASUREMENT ti_min_hom "Minimum injection time limitation for homogeneous mode" UWORD _CNV_A_R_LINEAR_____233_CM 1 100. 0. 65.535 DISPLAY_IDENTIFIER TI_MIN_HOM ECU_ADDRESS 0xd0002b64 /end MEASUREMENT
/begin MEASUREMENT ti_min_s "Minimum injection time limitation for stratified mode" UWORD _CNV_A_R_LINEAR_____233_CM 1 100. 0. 65.535 DISPLAY_IDENTIFIER TI_MIN_S ECU_ADDRESS 0xd0002b66 /end MEASUREMENT
/begin CHARACTERISTIC c_ti_1_s_man "manual setpoint for injection time in stratified mode,  1. pulse " VALUE 0xa1008a44 _REC_VAL_20_u2 65.535 _CNV_A_R_LINEAR_____233_CM 0. 65.535 DISPLAY_IDENTIFIER C_TI_1_S_MAN /end CHARACTERISTIC
/begin CHARACTERISTIC c_ti_min_ofs "Offset to TI_MIN, (injection time limitation at AFL mode and stratified mode)" VALUE 0xa1008a75 _REC_VAL_20_u1 1.02 _CNV_A_R_LINEAR_____111_CM 0. 1.02 DISPLAY_IDENTIFIER C_TI_MIN_OFS FORMAT "%5.3" /end CHARACTERISTIC
/begin CHARACTERISTIC c_ti_min_hys_s "Hysteresis to TI_MIN, (injection time limitation at stratified mode)" VALUE 0xa1008a74 _REC_VAL_20_u1 1.02 _CNV_A_R_LINEAR_____111_CM 0. 1.02 DISPLAY_IDENTIFIER C_TI_MIN_HYS_S FORMAT "%5.3" /end CHARACTERISTIC
/begin AXIS_PTS ldpm_mff_sp_1_injr "" 0xa10082f0 online_dummy _REC_AXS_20_u2 1389. _CNV_A_R_LINEAR_____108_CM 16 0. 1389. FORMAT "%7.2" /end AXIS_PTS
/begin AXIS_PTS ldp_mff_sp_ip_fac_ti_2_s "" 0xa10081fc mff_sp_1_s[0] _REC_AXS_20_u2 1389. _CNV_A_R_LINEAR_____108_CM 12 0. 1389. FORMAT "%7.2" /end AXIS_PTS
/begin MEASUREMENT fac_ti_2_s_dly_cor "Correction factor for mass flow difference at double injection" UWORD _CNV_A_R_LINEAR_____8_CM 1 100. 0. 1.99996948242188 DISPLAY_IDENTIFIER FAC_TI_2_S_DLY_COR ECU_ADDRESS 0xc00023c2 FORMAT "%7.5" /end MEASUREMENT
/begin MEASUREMENT fac_ti_2_s_cor "Correction factor for mass flow difference at double injection, caused by duration of the second pulse." UWORD _CNV_A_R_LINEAR_____8_CM 1 100. 0. 1.99996948242188 DISPLAY_IDENTIFIER FAC_TI_2_S_COR ECU_ADDRESS 0xc00023c0 FORMAT "%7.5" /end MEASUREMENT
/begin CHARACTERISTIC ip_fac_ti_2_s_dly_cor "correction of the mass flow difference between the mass flow sum of two pulses in comparison with the same requested mass for one pulse" MAP 0xa1008450 _REC_MAP_20_u2_u2_u2 1.99996948242188 _CNV_A_R_LINEAR_____8_CM 0. 1.99996948242188 DISPLAY_IDENTIFIER IP_FAC_TI_2_S_DLY_COR FORMAT "%7.5"
 /begin AXIS_DESCR COM_AXIS t_dly_1_2_s_ext[0] _CNV_A_R_LINEAR_____233_CM 16 0. 65.535 AXIS_PTS_REF ldp_t_dly_1_2_s_ip_fac_ti_2_s /end AXIS_DESCR
 /begin AXIS_DESCR COM_AXIS mff_sp_1_s[0] _CNV_A_R_LINEAR_____108_CM 12 0. 1389. FORMAT "%7.2" AXIS_PTS_REF ldp_mff_sp_ip_fac_ti_2_s /end AXIS_DESCR
/end CHARACTERISTIC
/begin CHARACTERISTIC ip_fac_ti_2_s_cor "This correction compensate different second injection duration." CURVE 0xa1008430 _REC_CUR_20_u2_u2 1.99996948242188 _CNV_A_R_LINEAR_____8_CM 0. 1.99996948242188 DISPLAY_IDENTIFIER IP_FAC_TI_2_S_COR FORMAT "%7.5"
 /begin AXIS_DESCR COM_AXIS injr.STR_INJR_ISPCLEGYIV0.ti_2_stnd_s[0] _CNV_A_R_LINEAR_____233_CM 16 0. 65.535 AXIS_PTS_REF ldp_ti_2_s_ip_fac_ti_2_s_cor /end AXIS_DESCR
/end CHARACTERISTIC
/begin AXIS_PTS ldp_t_dly_1_2_s_ip_fac_ti_2_s "correction of the mass flow difference between the mass flow sum of two pulses in comparison with the same requested mass for one pulse" 0xa1008278 t_dly_1_2_s_ext[0] _REC_AXS_20_u2 65.535 _CNV_A_R_LINEAR_____233_CM 16 0. 65.535 /end AXIS_PTS
/begin AXIS_PTS ldp_ti_2_s_ip_fac_ti_2_s_cor "This correction compensate different second injection duration." 0xa10082c0 injr.STR_INJR_ISPCLEGYIV0.ti_2_stnd_s[0] _REC_AXS_20_u2 65.535 _CNV_A_R_LINEAR_____233_CM 16 0. 65.535 /end AXIS_PTS
/begin MEASUREMENT prev_state_iv "Bit coded byte which indicates whether a cylinder was deactivated or not" UBYTE _CNV_A_R_LINEAR_____0_CM 1 100. 0. 255. DISPLAY_IDENTIFIER PREV_STATE_IV ECU_ADDRESS 0xd0002eed FORMAT "%3.0" /end MEASUREMENT
/begin MEASUREMENT inj_mod_global "" UBYTE _CNV_A_R_LINEAR_____0_CM 1 100. 0. 255. DISPLAY_IDENTIFIER INJ_MOD_GLOBAL ECU_ADDRESS 0xd0002ee6 FORMAT "%3.0" /end MEASUREMENT
/begin MEASUREMENT inh_iv_dyn "Shut off pattern for dynamic cylinder shut off (fixed cylinder allocation)" UBYTE _CNV_A_R_LINEAR_____0_CM 1 100. 0. 255. DISPLAY_IDENTIFIER INH_IV_DYN ECU_ADDRESS 0xd0002ee3 FORMAT "%3.0" /end MEASUREMENT
/begin MEASUREMENT crk_psn_eng_inj_upd "Engine position after injection data update" UWORD _CNV_A_R_LINEAR_____168_CM 1 100. 0. 720. DISPLAY_IDENTIFIER CRK_PSN_ENG_INJ_UPD ECU_ADDRESS 0xc0002372 FORMAT "%7.3" /end MEASUREMENT
/begin CHARACTERISTIC ip_fac_add_pulse "Weighting factor for additive pulses in case of injection time update at transient conditions" CURVE 0xa1008428 _REC_CUR_20_u1_u1 1.9921875 _CNV_A_R_LINEAR_____100_CM 0. 1.9921875 DISPLAY_IDENTIFIER IP_FAC_ADD_PULSE FORMAT "%8.6"
 /begin AXIS_DESCR COM_AXIS n_32 _CNV_A_R_LINEAR_____9_CM 6 0. 8160. FORMAT "%4.0" AXIS_PTS_REF ldp_n_32_ip_fac_add_pulse /end AXIS_DESCR
/end CHARACTERISTIC
/begin AXIS_PTS ldp_n_32_ip_fac_add_pulse "Weighting factor for additive pulses in case of injection time update at transient conditions" 0xa1008216 n_32 _REC_AXS_20_u1 8160. _CNV_A_R_LINEAR_____9_CM 6 0. 8160. FORMAT "%4.0" /end AXIS_PTS
/begin MEASUREMENT state_inj_typ_mem_iv "Bit coded status for active combustion mode over 720 °CRK " UBYTE _CNV_A_R_LINEAR_____0_CM 1 100. 0. 255. DISPLAY_IDENTIFIER STATE_INJ_TYP_MEM_IV ECU_ADDRESS 0xd0002ef1 FORMAT "%3.0" /end MEASUREMENT
/begin MEASUREMENT nr_cyl_ofs_inh_iv_dyn "Cylinder offset for destination of current cylinder number for dynamic fuel shut off" UBYTE _CNV_A_R_LINEAR_____0_CM 1 100. 0. 7. DISPLAY_IDENTIFIER NR_CYL_OFS_INH_IV_DYN ECU_ADDRESS 0xc0002402 FORMAT "%1.0" /end MEASUREMENT
/begin CHARACTERISTIC c_nr_cyl_ofs_inh_iv_dyn "Cylinder offset for destination of current cylinder number for dynamic fuel shut off" VALUE 0xa1008a30 _REC_VAL_20_u1 7. _CNV_A_R_LINEAR_____0_CM 0. 7. DISPLAY_IDENTIFIER C_NR_CYL_OFS_INH_IV_DYN FORMAT "%1.0" /end CHARACTERISTIC
/begin MEASUREMENT nr_cyl_inj_bas "Number of the current cylinder, which has reached its CRK_INJ_BAS[x]-Event" UBYTE _CNV_A_R_LINEAR_____0_CM 1 100. 0. 7. DISPLAY_IDENTIFIER NR_CYL_INJ_BAS ECU_ADDRESS 0xd0002ee7 FORMAT "%1.0" /end MEASUREMENT
/begin MEASUREMENT nr_cyl_inj_bas_prev "Number of the previous cylinder, which had reached its CRK_INJ_BAS[x]-Event" UBYTE _CNV_A_R_LINEAR_____0_CM 1 100. 0. 7. DISPLAY_IDENTIFIER NR_CYL_INJ_BAS_PREV ECU_ADDRESS 0xd0002ee8 FORMAT "%1.0" /end MEASUREMENT
/begin CHARACTERISTIC c_soi_ext_adj "Start of injection for external adjustment (service tool intervention)  " VALUE 0xa1008a3a _REC_VAL_20_u2 720. _CNV_A_R_LINEAR_____168_CM 0. 720. DISPLAY_IDENTIFIER C_SOI_EXT_ADJ FORMAT "%7.3" /end CHARACTERISTIC
/begin MEASUREMENT state_inj_mod_swi_act "State indicates a currently ongoing injection mode change, if not equal to zero" UBYTE _CNV_A_R_LINEAR_____0_CM 1 100. 0. 255. DISPLAY_IDENTIFIER STATE_INJ_MOD_SWI_ACT ECU_ADDRESS 0xd0002eef FORMAT "%3.0" /end MEASUREMENT
/begin MEASUREMENT inh_iv_mis_gen_ack "Shut off pattern for shut off caused by misfire generator" UBYTE _CNV_A_R_LINEAR_____0_CM 1 100. 0. 255. DISPLAY_IDENTIFIER INH_IV_MIS_GEN_ACK ECU_ADDRESS 0xd0002ee5 FORMAT "%3.0" /end MEASUREMENT
/begin MEASUREMENT lv_inj_crash_act_ack "Injection driver acknowledge of crash signal request" UBYTE _CNV_S_2_RANGE__0___1_CM 1 100. 0. 1. DISPLAY_IDENTIFIER LV_INJ_CRASH_ACT_ACK ECU_ADDRESS 0xc0002406 BIT_MASK 0x1 /end MEASUREMENT
/begin MEASUREMENT t_inj_crash_act "Injection valve opening time during vehicle crash" UWORD _CNV_A_R_LINEAR_____18_CM 1 100. 0. 655350. DISPLAY_IDENTIFIER T_INJ_CRASH_ACT ECU_ADDRESS 0xc00023e8 FORMAT "%6.0" /end MEASUREMENT
/begin MEASUREMENT lv_inj_crash_act_end "Injection driver reaction of vehicle crash signal finished" UBYTE _CNV_S_2_RANGE__0___1_CM 1 100. 0. 1. DISPLAY_IDENTIFIER LV_INJ_CRASH_ACT_END ECU_ADDRESS 0xc0002407 BIT_MASK 0x1 /end MEASUREMENT
/begin CHARACTERISTIC ip_ti_add_pulse_min "Minimum injection time for additive injection pulse, homogeneous mode" CURVE 0xa10089e4 _REC_CUR_20_u2_u2 65.535 _CNV_A_R_LINEAR_____233_CM 0. 65.535 DISPLAY_IDENTIFIER IP_TI_ADD_PULSE_MIN
 /begin AXIS_DESCR COM_AXIS prs_dec_inj_1_hom _CNV_A_R_LINEAR_____152_CM 6 0. 347776. FORMAT "%8.1" AXIS_PTS_REF ldpm_prs_dec_inj_1_injr /end AXIS_DESCR
/end CHARACTERISTIC
/begin MEASUREMENT state_inj_upd_mod_cyl_ack "Feedback from IO-software of successful data transfer" UBYTE _CNV_A_R_LINEAR_____0_CM 1 100. 0. 255. DISPLAY_IDENTIFIER STATE_INJ_UPD_MOD_CYL_ACK ECU_ADDRESS 0xc0002409 FORMAT "%3.0" /end MEASUREMENT
/begin MEASUREMENT soi_inj_upd_psn "Injection position for autonomous generated update pulse" UWORD _CNV_A_R_LINEAR_____168_CM 1 100. 0. 720. DISPLAY_IDENTIFIER SOI_INJ_UPD_PSN ECU_ADDRESS 0xc00023e4 FORMAT "%7.3" /end MEASUREMENT
/begin CHARACTERISTIC lc_inj_pls_upd_mod "Logical constant for selection of injection pulse update mode" VALUE 0xa1008a81 _REC_VAL_20_u1 1. _CNV_S_2_INJR_RANGE_475_CM 0. 1. DISPLAY_IDENTIFIER LC_INJ_PLS_UPD_MOD /end CHARACTERISTIC
/begin CHARACTERISTIC ip_soi_inj_upd_psn "Injection position for autonomous generated update pulse" CURVE 0xa10089c0 _REC_CUR_20_u2_u1 720. _CNV_A_R_LINEAR_____168_CM 0. 720. DISPLAY_IDENTIFIER IP_SOI_INJ_UPD_PSN FORMAT "%7.3"
 /begin AXIS_DESCR COM_AXIS n_32 _CNV_A_R_LINEAR_____9_CM 6 0. 8160. FORMAT "%4.0" AXIS_PTS_REF ldp_n_32_ip_soi_inj_upd_psn /end AXIS_DESCR
/end CHARACTERISTIC
/begin AXIS_PTS ldp_n_32_ip_soi_inj_upd_psn "Injection position for autonomous generated update pulse" 0xa100821e n_32 _REC_AXS_20_u1 8160. _CNV_A_R_LINEAR_____9_CM 6 0. 8160. FORMAT "%4.0" /end AXIS_PTS
/begin MEASUREMENT ti_as "Global Injection Time Correction by the Application System - multiplicative" UWORD _CNV_A_R_LINEAR_____115_CM 1 100. 0. 15.999755859375 DISPLAY_IDENTIFIER TI_AS ECU_ADDRESS 0xd0002b62 FORMAT "%7.4" /end MEASUREMENT
/begin CHARACTERISTIC c_ti_as_global "Global injection time correction" VALUE 0xa1008a70 _REC_VAL_20_u2 15.999755859375 _CNV_A_R_LINEAR_____115_CM 0. 15.999755859375 DISPLAY_IDENTIFIER C_TI_AS_GLOBAL FORMAT "%7.4" /end CHARACTERISTIC
/begin CHARACTERISTIC c_ti_add_as_global "Global Injection Time Correction - additive value" VALUE 0xa1008a5c _REC_VAL_20_s2 262.14 _CNV_A_R_LINEAR_____111_CM -131.072 131.068 DISPLAY_IDENTIFIER C_TI_ADD_AS_GLOBAL FORMAT "%8.3" /end CHARACTERISTIC
/begin CHARACTERISTIC c_ti_as[0] "Injection time factor (cylinder selective) to correct cylinder injection value" VALUE 0xa1008a60 _REC_VAL_20_u2 15.999755859375 _CNV_A_R_LINEAR_____115_CM 0. 15.999755859375 DISPLAY_IDENTIFIER C_TI_AS[0] FORMAT "%7.4" /end CHARACTERISTIC
/begin CHARACTERISTIC c_ti_as[1] "Injection time factor (cylinder selective) to correct cylinder injection value" VALUE 0xa1008a62 _REC_VAL_20_u2 15.999755859375 _CNV_A_R_LINEAR_____115_CM 0. 15.999755859375 DISPLAY_IDENTIFIER C_TI_AS[1] FORMAT "%7.4" /end CHARACTERISTIC
/begin CHARACTERISTIC c_ti_as[2] "Injection time factor (cylinder selective) to correct cylinder injection value" VALUE 0xa1008a64 _REC_VAL_20_u2 15.999755859375 _CNV_A_R_LINEAR_____115_CM 0. 15.999755859375 DISPLAY_IDENTIFIER C_TI_AS[2] FORMAT "%7.4" /end CHARACTERISTIC
/begin CHARACTERISTIC c_ti_as[3] "Injection time factor (cylinder selective) to correct cylinder injection value" VALUE 0xa1008a66 _REC_VAL_20_u2 15.999755859375 _CNV_A_R_LINEAR_____115_CM 0. 15.999755859375 DISPLAY_IDENTIFIER C_TI_AS[3] FORMAT "%7.4" /end CHARACTERISTIC
/begin CHARACTERISTIC c_ti_as[4] "Injection time factor (cylinder selective) to correct cylinder injection value" VALUE 0xa1008a68 _REC_VAL_20_u2 15.999755859375 _CNV_A_R_LINEAR_____115_CM 0. 15.999755859375 DISPLAY_IDENTIFIER C_TI_AS[4] FORMAT "%7.4" /end CHARACTERISTIC
/begin CHARACTERISTIC c_ti_as[5] "Injection time factor (cylinder selective) to correct cylinder injection value" VALUE 0xa1008a6a _REC_VAL_20_u2 15.999755859375 _CNV_A_R_LINEAR_____115_CM 0. 15.999755859375 DISPLAY_IDENTIFIER C_TI_AS[5] FORMAT "%7.4" /end CHARACTERISTIC
/begin CHARACTERISTIC c_ti_as_cbk_ex[0] "Injection time factor (exhaust bank selective) to correct cylinder injection value" VALUE 0xa1008a6c _REC_VAL_20_u2 15.999755859375 _CNV_A_R_LINEAR_____115_CM 0. 15.999755859375 DISPLAY_IDENTIFIER C_TI_AS_CBK_EX[0] FORMAT "%7.4" /end CHARACTERISTIC
/begin CHARACTERISTIC c_ti_as_cbk_ex[1] "Injection time factor (exhaust bank selective) to correct cylinder injection value" VALUE 0xa1008a6e _REC_VAL_20_u2 15.999755859375 _CNV_A_R_LINEAR_____115_CM 0. 15.999755859375 DISPLAY_IDENTIFIER C_TI_AS_CBK_EX[1] FORMAT "%7.4" /end CHARACTERISTIC
/begin CHARACTERISTIC c_ti_add_as[0] "Cylinder selective Injection Time Correction - additive value" VALUE 0xa1008a4c _REC_VAL_20_s2 262.14 _CNV_A_R_LINEAR_____111_CM -131.072 131.068 DISPLAY_IDENTIFIER C_TI_ADD_AS[0] FORMAT "%8.3" /end CHARACTERISTIC
/begin CHARACTERISTIC c_ti_add_as[1] "Cylinder selective Injection Time Correction - additive value" VALUE 0xa1008a4e _REC_VAL_20_s2 262.14 _CNV_A_R_LINEAR_____111_CM -131.072 131.068 DISPLAY_IDENTIFIER C_TI_ADD_AS[1] FORMAT "%8.3" /end CHARACTERISTIC
/begin CHARACTERISTIC c_ti_add_as[2] "Cylinder selective Injection Time Correction - additive value" VALUE 0xa1008a50 _REC_VAL_20_s2 262.14 _CNV_A_R_LINEAR_____111_CM -131.072 131.068 DISPLAY_IDENTIFIER C_TI_ADD_AS[2] FORMAT "%8.3" /end CHARACTERISTIC
/begin CHARACTERISTIC c_ti_add_as[3] "Cylinder selective Injection Time Correction - additive value" VALUE 0xa1008a52 _REC_VAL_20_s2 262.14 _CNV_A_R_LINEAR_____111_CM -131.072 131.068 DISPLAY_IDENTIFIER C_TI_ADD_AS[3] FORMAT "%8.3" /end CHARACTERISTIC
/begin CHARACTERISTIC c_ti_add_as[4] "Cylinder selective Injection Time Correction - additive value" VALUE 0xa1008a54 _REC_VAL_20_s2 262.14 _CNV_A_R_LINEAR_____111_CM -131.072 131.068 DISPLAY_IDENTIFIER C_TI_ADD_AS[4] FORMAT "%8.3" /end CHARACTERISTIC
/begin CHARACTERISTIC c_ti_add_as[5] "Cylinder selective Injection Time Correction - additive value" VALUE 0xa1008a56 _REC_VAL_20_s2 262.14 _CNV_A_R_LINEAR_____111_CM -131.072 131.068 DISPLAY_IDENTIFIER C_TI_ADD_AS[5] FORMAT "%8.3" /end CHARACTERISTIC
/begin CHARACTERISTIC c_ti_add_as_cbk_ex[0] "Exhaust bank selective Injection Time Correction - additive value" VALUE 0xa1008a58 _REC_VAL_20_s2 262.14 _CNV_A_R_LINEAR_____111_CM -131.072 131.068 DISPLAY_IDENTIFIER C_TI_ADD_AS_CBK_EX[0] FORMAT "%8.3" /end CHARACTERISTIC
/begin CHARACTERISTIC c_ti_add_as_cbk_ex[1] "Exhaust bank selective Injection Time Correction - additive value" VALUE 0xa1008a5a _REC_VAL_20_s2 262.14 _CNV_A_R_LINEAR_____111_CM -131.072 131.068 DISPLAY_IDENTIFIER C_TI_ADD_AS_CBK_EX[1] FORMAT "%8.3" /end CHARACTERISTIC
/begin CHARACTERISTIC lc_ti_as_cbk_upd_dis "Switch to disable TI_AS_CBK_EX and TI_ADD_AS_CBK_EX data update, for customer delivery it has to be 0" VALUE 0xa1008a8b _REC_VAL_20_u1 1. _CNV_A_R_LINEAR_____0_CM 0. 1. DISPLAY_IDENTIFIER LC_TI_AS_CBK_UPD_DIS FORMAT "%1.0" /end CHARACTERISTIC
/begin CHARACTERISTIC ip_fac_ti_temp_cor "factor for correction of fuel injection due to the fuel temperature" CURVE 0xa10085e8 _REC_CUR_20_u2_u1 1.999755859375 _CNV_A_R_LINEAR_____115_CM 0. 1.999755859375 DISPLAY_IDENTIFIER IP_FAC_TI_TEMP_COR FORMAT "%7.4"
 /begin AXIS_DESCR COM_AXIS tfu_inj _CNV_A_R_LINEAR_____16_CM 12 -48. 142.5 FORMAT "%6.2" AXIS_PTS_REF ldp_tfu_ip_fac_ti_temp_cor /end AXIS_DESCR
/end CHARACTERISTIC
/begin MEASUREMENT fac_ti_tfu "factor for correction of fuel injection time due to a change of fuel temperature variation" UWORD _CNV_A_R_LINEAR_____115_CM 1 100. 0. 1.999755859375 DISPLAY_IDENTIFIER FAC_TI_TFU ECU_ADDRESS 0xd0002b0e FORMAT "%7.4" /end MEASUREMENT
/begin AXIS_PTS ldp_tfu_ip_fac_ti_temp_cor "" 0xa10082b0 tfu_inj _REC_AXS_20_u1 190.5 _CNV_A_R_LINEAR_____16_CM 12 -48. 142.5 FORMAT "%6.2" /end AXIS_PTS
/begin MEASUREMENT injr.STR_INJR_ACCTLFINAL0.ti_1_hom[0] "Cylinder individual injection time, homogeneous mode, first pulse (intermediate value)" UWORD _CNV_A_R_LINEAR_____233_CM 1 100. 0. 65.535 DISPLAY_IDENTIFIER TI_1_HOM[0] ECU_ADDRESS 0xd00027a8 /end MEASUREMENT
/begin MEASUREMENT injr.STR_INJR_ACCTLFINAL0.ti_1_hom[1] "Cylinder individual injection time, homogeneous mode, first pulse (intermediate value)" UWORD _CNV_A_R_LINEAR_____233_CM 1 100. 0. 65.535 DISPLAY_IDENTIFIER TI_1_HOM[1] ECU_ADDRESS 0xd00027aa /end MEASUREMENT
/begin MEASUREMENT injr.STR_INJR_ACCTLFINAL0.ti_1_hom[2] "Cylinder individual injection time, homogeneous mode, first pulse (intermediate value)" UWORD _CNV_A_R_LINEAR_____233_CM 1 100. 0. 65.535 DISPLAY_IDENTIFIER TI_1_HOM[2] ECU_ADDRESS 0xd00027ac /end MEASUREMENT
/begin MEASUREMENT injr.STR_INJR_ACCTLFINAL0.ti_1_hom[3] "Cylinder individual injection time, homogeneous mode, first pulse (intermediate value)" UWORD _CNV_A_R_LINEAR_____233_CM 1 100. 0. 65.535 DISPLAY_IDENTIFIER TI_1_HOM[3] ECU_ADDRESS 0xd00027ae /end MEASUREMENT
/begin MEASUREMENT injr.STR_INJR_ACCTLFINAL0.ti_1_hom[4] "Cylinder individual injection time, homogeneous mode, first pulse (intermediate value)" UWORD _CNV_A_R_LINEAR_____233_CM 1 100. 0. 65.535 DISPLAY_IDENTIFIER TI_1_HOM[4] ECU_ADDRESS 0xd00027b0 /end MEASUREMENT
/begin MEASUREMENT injr.STR_INJR_ACCTLFINAL0.ti_1_hom[5] "Cylinder individual injection time, homogeneous mode, first pulse (intermediate value)" UWORD _CNV_A_R_LINEAR_____233_CM 1 100. 0. 65.535 DISPLAY_IDENTIFIER TI_1_HOM[5] ECU_ADDRESS 0xd00027b2 /end MEASUREMENT
/begin MEASUREMENT injr.STR_INJR_ACCTLFINAL0.ti_1_hom_clc[0] "Cylinder individual injection time, homogeneous mode, first pulse (intermediate value)" UWORD _CNV_A_R_LINEAR_____233_CM 1 100. 0. 65.535 DISPLAY_IDENTIFIER TI_1_HOM_CLC[0] ECU_ADDRESS 0xd00027b4 /end MEASUREMENT
/begin MEASUREMENT injr.STR_INJR_ACCTLFINAL0.ti_1_hom_clc[1] "Cylinder individual injection time, homogeneous mode, first pulse (intermediate value)" UWORD _CNV_A_R_LINEAR_____233_CM 1 100. 0. 65.535 DISPLAY_IDENTIFIER TI_1_HOM_CLC[1] ECU_ADDRESS 0xd00027b6 /end MEASUREMENT
/begin MEASUREMENT injr.STR_INJR_ACCTLFINAL0.ti_1_hom_clc[2] "Cylinder individual injection time, homogeneous mode, first pulse (intermediate value)" UWORD _CNV_A_R_LINEAR_____233_CM 1 100. 0. 65.535 DISPLAY_IDENTIFIER TI_1_HOM_CLC[2] ECU_ADDRESS 0xd00027b8 /end MEASUREMENT
/begin MEASUREMENT injr.STR_INJR_ACCTLFINAL0.ti_1_hom_clc[3] "Cylinder individual injection time, homogeneous mode, first pulse (intermediate value)" UWORD _CNV_A_R_LINEAR_____233_CM 1 100. 0. 65.535 DISPLAY_IDENTIFIER TI_1_HOM_CLC[3] ECU_ADDRESS 0xd00027ba /end MEASUREMENT
/begin MEASUREMENT injr.STR_INJR_ACCTLFINAL0.ti_1_hom_clc[4] "Cylinder individual injection time, homogeneous mode, first pulse (intermediate value)" UWORD _CNV_A_R_LINEAR_____233_CM 1 100. 0. 65.535 DISPLAY_IDENTIFIER TI_1_HOM_CLC[4] ECU_ADDRESS 0xd00027bc /end MEASUREMENT
/begin MEASUREMENT injr.STR_INJR_ACCTLFINAL0.ti_1_hom_clc[5] "Cylinder individual injection time, homogeneous mode, first pulse (intermediate value)" UWORD _CNV_A_R_LINEAR_____233_CM 1 100. 0. 65.535 DISPLAY_IDENTIFIER TI_1_HOM_CLC[5] ECU_ADDRESS 0xd00027be /end MEASUREMENT
/begin MEASUREMENT injr.STR_INJR_ACCTLFINAL0.ti_2_hom[0] "Cylinder individual injection time, homogeneous mode, second pulse (intermediate value)" UWORD _CNV_A_R_LINEAR_____233_CM 1 100. 0. 65.535 DISPLAY_IDENTIFIER TI_2_HOM[0] ECU_ADDRESS 0xd00027c0 /end MEASUREMENT
/begin MEASUREMENT injr.STR_INJR_ACCTLFINAL0.ti_2_hom[1] "Cylinder individual injection time, homogeneous mode, second pulse (intermediate value)" UWORD _CNV_A_R_LINEAR_____233_CM 1 100. 0. 65.535 DISPLAY_IDENTIFIER TI_2_HOM[1] ECU_ADDRESS 0xd00027c2 /end MEASUREMENT
/begin MEASUREMENT injr.STR_INJR_ACCTLFINAL0.ti_2_hom[2] "Cylinder individual injection time, homogeneous mode, second pulse (intermediate value)" UWORD _CNV_A_R_LINEAR_____233_CM 1 100. 0. 65.535 DISPLAY_IDENTIFIER TI_2_HOM[2] ECU_ADDRESS 0xd00027c4 /end MEASUREMENT
/begin MEASUREMENT injr.STR_INJR_ACCTLFINAL0.ti_2_hom[3] "Cylinder individual injection time, homogeneous mode, second pulse (intermediate value)" UWORD _CNV_A_R_LINEAR_____233_CM 1 100. 0. 65.535 DISPLAY_IDENTIFIER TI_2_HOM[3] ECU_ADDRESS 0xd00027c6 /end MEASUREMENT
/begin MEASUREMENT injr.STR_INJR_ACCTLFINAL0.ti_2_hom[4] "Cylinder individual injection time, homogeneous mode, second pulse (intermediate value)" UWORD _CNV_A_R_LINEAR_____233_CM 1 100. 0. 65.535 DISPLAY_IDENTIFIER TI_2_HOM[4] ECU_ADDRESS 0xd00027c8 /end MEASUREMENT
/begin MEASUREMENT injr.STR_INJR_ACCTLFINAL0.ti_2_hom[5] "Cylinder individual injection time, homogeneous mode, second pulse (intermediate value)" UWORD _CNV_A_R_LINEAR_____233_CM 1 100. 0. 65.535 DISPLAY_IDENTIFIER TI_2_HOM[5] ECU_ADDRESS 0xd00027ca /end MEASUREMENT
/begin MEASUREMENT injr.STR_INJR_ACCTLFINAL0.ti_2_hom_clc[0] "Cylinder individual injection time, homogeneous mode, second pulse (intermediate value)" UWORD _CNV_A_R_LINEAR_____233_CM 1 100. 0. 65.535 DISPLAY_IDENTIFIER TI_2_HOM_CLC[0] ECU_ADDRESS 0xd00027cc /end MEASUREMENT
/begin MEASUREMENT injr.STR_INJR_ACCTLFINAL0.ti_2_hom_clc[1] "Cylinder individual injection time, homogeneous mode, second pulse (intermediate value)" UWORD _CNV_A_R_LINEAR_____233_CM 1 100. 0. 65.535 DISPLAY_IDENTIFIER TI_2_HOM_CLC[1] ECU_ADDRESS 0xd00027ce /end MEASUREMENT
/begin MEASUREMENT injr.STR_INJR_ACCTLFINAL0.ti_2_hom_clc[2] "Cylinder individual injection time, homogeneous mode, second pulse (intermediate value)" UWORD _CNV_A_R_LINEAR_____233_CM 1 100. 0. 65.535 DISPLAY_IDENTIFIER TI_2_HOM_CLC[2] ECU_ADDRESS 0xd00027d0 /end MEASUREMENT
/begin MEASUREMENT injr.STR_INJR_ACCTLFINAL0.ti_2_hom_clc[3] "Cylinder individual injection time, homogeneous mode, second pulse (intermediate value)" UWORD _CNV_A_R_LINEAR_____233_CM 1 100. 0. 65.535 DISPLAY_IDENTIFIER TI_2_HOM_CLC[3] ECU_ADDRESS 0xd00027d2 /end MEASUREMENT
/begin MEASUREMENT injr.STR_INJR_ACCTLFINAL0.ti_2_hom_clc[4] "Cylinder individual injection time, homogeneous mode, second pulse (intermediate value)" UWORD _CNV_A_R_LINEAR_____233_CM 1 100. 0. 65.535 DISPLAY_IDENTIFIER TI_2_HOM_CLC[4] ECU_ADDRESS 0xd00027d4 /end MEASUREMENT
/begin MEASUREMENT injr.STR_INJR_ACCTLFINAL0.ti_2_hom_clc[5] "Cylinder individual injection time, homogeneous mode, second pulse (intermediate value)" UWORD _CNV_A_R_LINEAR_____233_CM 1 100. 0. 65.535 DISPLAY_IDENTIFIER TI_2_HOM_CLC[5] ECU_ADDRESS 0xd00027d6 /end MEASUREMENT
/begin MEASUREMENT injr.STR_INJR_ACCTLFINAL0.ti_1_s[0] "Cylinder individual injection time, stratified mode, fist pulse (intermediate value)" UWORD _CNV_A_R_LINEAR_____233_CM 1 100. 0. 65.535 DISPLAY_IDENTIFIER TI_1_S[0] ECU_ADDRESS 0xd00027d8 /end MEASUREMENT
/begin MEASUREMENT injr.STR_INJR_ACCTLFINAL0.ti_1_s[1] "Cylinder individual injection time, stratified mode, fist pulse (intermediate value)" UWORD _CNV_A_R_LINEAR_____233_CM 1 100. 0. 65.535 DISPLAY_IDENTIFIER TI_1_S[1] ECU_ADDRESS 0xd00027da /end MEASUREMENT
/begin MEASUREMENT injr.STR_INJR_ACCTLFINAL0.ti_1_s[2] "Cylinder individual injection time, stratified mode, fist pulse (intermediate value)" UWORD _CNV_A_R_LINEAR_____233_CM 1 100. 0. 65.535 DISPLAY_IDENTIFIER TI_1_S[2] ECU_ADDRESS 0xd00027dc /end MEASUREMENT
/begin MEASUREMENT injr.STR_INJR_ACCTLFINAL0.ti_1_s[3] "Cylinder individual injection time, stratified mode, fist pulse (intermediate value)" UWORD _CNV_A_R_LINEAR_____233_CM 1 100. 0. 65.535 DISPLAY_IDENTIFIER TI_1_S[3] ECU_ADDRESS 0xd00027de /end MEASUREMENT
/begin MEASUREMENT injr.STR_INJR_ACCTLFINAL0.ti_1_s[4] "Cylinder individual injection time, stratified mode, fist pulse (intermediate value)" UWORD _CNV_A_R_LINEAR_____233_CM 1 100. 0. 65.535 DISPLAY_IDENTIFIER TI_1_S[4] ECU_ADDRESS 0xd00027e0 /end MEASUREMENT
/begin MEASUREMENT injr.STR_INJR_ACCTLFINAL0.ti_1_s[5] "Cylinder individual injection time, stratified mode, fist pulse (intermediate value)" UWORD _CNV_A_R_LINEAR_____233_CM 1 100. 0. 65.535 DISPLAY_IDENTIFIER TI_1_S[5] ECU_ADDRESS 0xd00027e2 /end MEASUREMENT
/begin MEASUREMENT injr.STR_INJR_ACCTLFINAL0.ti_2_s[0] "Cylinder individual injection time, stratified mode, second pulse (intermediate value)" UWORD _CNV_A_R_LINEAR_____233_CM 1 100. 0. 65.535 DISPLAY_IDENTIFIER TI_2_S[0] ECU_ADDRESS 0xd00027e4 /end MEASUREMENT
/begin MEASUREMENT injr.STR_INJR_ACCTLFINAL0.ti_2_s[1] "Cylinder individual injection time, stratified mode, second pulse (intermediate value)" UWORD _CNV_A_R_LINEAR_____233_CM 1 100. 0. 65.535 DISPLAY_IDENTIFIER TI_2_S[1] ECU_ADDRESS 0xd00027e6 /end MEASUREMENT
/begin MEASUREMENT injr.STR_INJR_ACCTLFINAL0.ti_2_s[2] "Cylinder individual injection time, stratified mode, second pulse (intermediate value)" UWORD _CNV_A_R_LINEAR_____233_CM 1 100. 0. 65.535 DISPLAY_IDENTIFIER TI_2_S[2] ECU_ADDRESS 0xd00027e8 /end MEASUREMENT
/begin MEASUREMENT injr.STR_INJR_ACCTLFINAL0.ti_2_s[3] "Cylinder individual injection time, stratified mode, second pulse (intermediate value)" UWORD _CNV_A_R_LINEAR_____233_CM 1 100. 0. 65.535 DISPLAY_IDENTIFIER TI_2_S[3] ECU_ADDRESS 0xd00027ea /end MEASUREMENT
/begin MEASUREMENT injr.STR_INJR_ACCTLFINAL0.ti_2_s[4] "Cylinder individual injection time, stratified mode, second pulse (intermediate value)" UWORD _CNV_A_R_LINEAR_____233_CM 1 100. 0. 65.535 DISPLAY_IDENTIFIER TI_2_S[4] ECU_ADDRESS 0xd00027ec /end MEASUREMENT
/begin MEASUREMENT injr.STR_INJR_ACCTLFINAL0.ti_2_s[5] "Cylinder individual injection time, stratified mode, second pulse (intermediate value)" UWORD _CNV_A_R_LINEAR_____233_CM 1 100. 0. 65.535 DISPLAY_IDENTIFIER TI_2_S[5] ECU_ADDRESS 0xd00027ee /end MEASUREMENT
/begin MEASUREMENT injr.STR_INJR_ACCTLFINAL0.ti_1_s_clc[0] "Cylinder individual injection time, stratified mode, fist pulse (intermediate value)" UWORD _CNV_A_R_LINEAR_____233_CM 1 100. 0. 65.535 DISPLAY_IDENTIFIER TI_1_S_CLC[0] ECU_ADDRESS 0xd00027f0 /end MEASUREMENT
/begin MEASUREMENT injr.STR_INJR_ACCTLFINAL0.ti_1_s_clc[1] "Cylinder individual injection time, stratified mode, fist pulse (intermediate value)" UWORD _CNV_A_R_LINEAR_____233_CM 1 100. 0. 65.535 DISPLAY_IDENTIFIER TI_1_S_CLC[1] ECU_ADDRESS 0xd00027f2 /end MEASUREMENT
/begin MEASUREMENT injr.STR_INJR_ACCTLFINAL0.ti_1_s_clc[2] "Cylinder individual injection time, stratified mode, fist pulse (intermediate value)" UWORD _CNV_A_R_LINEAR_____233_CM 1 100. 0. 65.535 DISPLAY_IDENTIFIER TI_1_S_CLC[2] ECU_ADDRESS 0xd00027f4 /end MEASUREMENT
/begin MEASUREMENT injr.STR_INJR_ACCTLFINAL0.ti_1_s_clc[3] "Cylinder individual injection time, stratified mode, fist pulse (intermediate value)" UWORD _CNV_A_R_LINEAR_____233_CM 1 100. 0. 65.535 DISPLAY_IDENTIFIER TI_1_S_CLC[3] ECU_ADDRESS 0xd00027f6 /end MEASUREMENT
/begin MEASUREMENT injr.STR_INJR_ACCTLFINAL0.ti_1_s_clc[4] "Cylinder individual injection time, stratified mode, fist pulse (intermediate value)" UWORD _CNV_A_R_LINEAR_____233_CM 1 100. 0. 65.535 DISPLAY_IDENTIFIER TI_1_S_CLC[4] ECU_ADDRESS 0xd00027f8 /end MEASUREMENT
/begin MEASUREMENT injr.STR_INJR_ACCTLFINAL0.ti_1_s_clc[5] "Cylinder individual injection time, stratified mode, fist pulse (intermediate value)" UWORD _CNV_A_R_LINEAR_____233_CM 1 100. 0. 65.535 DISPLAY_IDENTIFIER TI_1_S_CLC[5] ECU_ADDRESS 0xd00027fa /end MEASUREMENT
/begin MEASUREMENT injr.STR_INJR_ACCTLFINAL0.ti_2_s_clc[0] "Cylinder individual injection time, stratified mode, second pulse (intermediate value)" UWORD _CNV_A_R_LINEAR_____233_CM 1 100. 0. 65.535 DISPLAY_IDENTIFIER TI_2_S_CLC[0] ECU_ADDRESS 0xd00027fc /end MEASUREMENT
/begin MEASUREMENT injr.STR_INJR_ACCTLFINAL0.ti_2_s_clc[1] "Cylinder individual injection time, stratified mode, second pulse (intermediate value)" UWORD _CNV_A_R_LINEAR_____233_CM 1 100. 0. 65.535 DISPLAY_IDENTIFIER TI_2_S_CLC[1] ECU_ADDRESS 0xd00027fe /end MEASUREMENT
/begin MEASUREMENT injr.STR_INJR_ACCTLFINAL0.ti_2_s_clc[2] "Cylinder individual injection time, stratified mode, second pulse (intermediate value)" UWORD _CNV_A_R_LINEAR_____233_CM 1 100. 0. 65.535 DISPLAY_IDENTIFIER TI_2_S_CLC[2] ECU_ADDRESS 0xd0002800 /end MEASUREMENT
/begin MEASUREMENT injr.STR_INJR_ACCTLFINAL0.ti_2_s_clc[3] "Cylinder individual injection time, stratified mode, second pulse (intermediate value)" UWORD _CNV_A_R_LINEAR_____233_CM 1 100. 0. 65.535 DISPLAY_IDENTIFIER TI_2_S_CLC[3] ECU_ADDRESS 0xd0002802 /end MEASUREMENT
/begin MEASUREMENT injr.STR_INJR_ACCTLFINAL0.ti_2_s_clc[4] "Cylinder individual injection time, stratified mode, second pulse (intermediate value)" UWORD _CNV_A_R_LINEAR_____233_CM 1 100. 0. 65.535 DISPLAY_IDENTIFIER TI_2_S_CLC[4] ECU_ADDRESS 0xd0002804 /end MEASUREMENT
/begin MEASUREMENT injr.STR_INJR_ACCTLFINAL0.ti_2_s_clc[5] "Cylinder individual injection time, stratified mode, second pulse (intermediate value)" UWORD _CNV_A_R_LINEAR_____233_CM 1 100. 0. 65.535 DISPLAY_IDENTIFIER TI_2_S_CLC[5] ECU_ADDRESS 0xd0002806 /end MEASUREMENT
/begin MEASUREMENT injr.STR_INJR_ACCTLFINAL0.ti_1_stnd_hom[0] "Mapped Injection time, homogeneous mode, 1. pulse" UWORD _CNV_A_R_LINEAR_____233_CM 1 100. 0. 65.535 DISPLAY_IDENTIFIER TI_1_STND_HOM[0] ECU_ADDRESS 0xd0002808 /end MEASUREMENT
/begin MEASUREMENT injr.STR_INJR_ACCTLFINAL0.ti_1_stnd_hom[1] "Mapped Injection time, homogeneous mode, 1. pulse" UWORD _CNV_A_R_LINEAR_____233_CM 1 100. 0. 65.535 DISPLAY_IDENTIFIER TI_1_STND_HOM[1] ECU_ADDRESS 0xd000280a /end MEASUREMENT
/begin MEASUREMENT injr.STR_INJR_ACCTLFINAL0.ti_1_stnd_hom[2] "Mapped Injection time, homogeneous mode, 1. pulse" UWORD _CNV_A_R_LINEAR_____233_CM 1 100. 0. 65.535 DISPLAY_IDENTIFIER TI_1_STND_HOM[2] ECU_ADDRESS 0xd000280c /end MEASUREMENT
/begin MEASUREMENT injr.STR_INJR_ACCTLFINAL0.ti_1_stnd_hom[3] "Mapped Injection time, homogeneous mode, 1. pulse" UWORD _CNV_A_R_LINEAR_____233_CM 1 100. 0. 65.535 DISPLAY_IDENTIFIER TI_1_STND_HOM[3] ECU_ADDRESS 0xd000280e /end MEASUREMENT
/begin MEASUREMENT injr.STR_INJR_ACCTLFINAL0.ti_1_stnd_hom[4] "Mapped Injection time, homogeneous mode, 1. pulse" UWORD _CNV_A_R_LINEAR_____233_CM 1 100. 0. 65.535 DISPLAY_IDENTIFIER TI_1_STND_HOM[4] ECU_ADDRESS 0xd0002810 /end MEASUREMENT
/begin MEASUREMENT injr.STR_INJR_ACCTLFINAL0.ti_1_stnd_hom[5] "Mapped Injection time, homogeneous mode, 1. pulse" UWORD _CNV_A_R_LINEAR_____233_CM 1 100. 0. 65.535 DISPLAY_IDENTIFIER TI_1_STND_HOM[5] ECU_ADDRESS 0xd0002812 /end MEASUREMENT
/begin MEASUREMENT injr.STR_INJR_ACCTLFINAL0.ti_2_stnd_hom[0] "Mapped Injection time, homogeneous mode, 2. pulse" UWORD _CNV_A_R_LINEAR_____233_CM 1 100. 0. 65.535 DISPLAY_IDENTIFIER TI_2_STND_HOM[0] ECU_ADDRESS 0xd0002814 /end MEASUREMENT
/begin MEASUREMENT injr.STR_INJR_ACCTLFINAL0.ti_2_stnd_hom[1] "Mapped Injection time, homogeneous mode, 2. pulse" UWORD _CNV_A_R_LINEAR_____233_CM 1 100. 0. 65.535 DISPLAY_IDENTIFIER TI_2_STND_HOM[1] ECU_ADDRESS 0xd0002816 /end MEASUREMENT
/begin MEASUREMENT injr.STR_INJR_ACCTLFINAL0.ti_2_stnd_hom[2] "Mapped Injection time, homogeneous mode, 2. pulse" UWORD _CNV_A_R_LINEAR_____233_CM 1 100. 0. 65.535 DISPLAY_IDENTIFIER TI_2_STND_HOM[2] ECU_ADDRESS 0xd0002818 /end MEASUREMENT
/begin MEASUREMENT injr.STR_INJR_ACCTLFINAL0.ti_2_stnd_hom[3] "Mapped Injection time, homogeneous mode, 2. pulse" UWORD _CNV_A_R_LINEAR_____233_CM 1 100. 0. 65.535 DISPLAY_IDENTIFIER TI_2_STND_HOM[3] ECU_ADDRESS 0xd000281a /end MEASUREMENT
/begin MEASUREMENT injr.STR_INJR_ACCTLFINAL0.ti_2_stnd_hom[4] "Mapped Injection time, homogeneous mode, 2. pulse" UWORD _CNV_A_R_LINEAR_____233_CM 1 100. 0. 65.535 DISPLAY_IDENTIFIER TI_2_STND_HOM[4] ECU_ADDRESS 0xd000281c /end MEASUREMENT
/begin MEASUREMENT injr.STR_INJR_ACCTLFINAL0.ti_2_stnd_hom[5] "Mapped Injection time, homogeneous mode, 2. pulse" UWORD _CNV_A_R_LINEAR_____233_CM 1 100. 0. 65.535 DISPLAY_IDENTIFIER TI_2_STND_HOM[5] ECU_ADDRESS 0xd000281e /end MEASUREMENT
/begin MEASUREMENT injr.STR_INJR_ACCTLFINAL0.mff_sp_1_hom_cor_inj[0] "Cylinder individual mass fuel flow set-point for homogeneous mode corrected by piezo energy carryover, first pulse" UWORD _CNV_A_R_LINEAR_____108_CM 1 100. 0. 1389. DISPLAY_IDENTIFIER MFF_SP_1_HOM_COR_INJ[0] ECU_ADDRESS 0xd0002820 FORMAT "%7.2" /end MEASUREMENT
/begin MEASUREMENT injr.STR_INJR_ACCTLFINAL0.mff_sp_1_hom_cor_inj[1] "Cylinder individual mass fuel flow set-point for homogeneous mode corrected by piezo energy carryover, first pulse" UWORD _CNV_A_R_LINEAR_____108_CM 1 100. 0. 1389. DISPLAY_IDENTIFIER MFF_SP_1_HOM_COR_INJ[1] ECU_ADDRESS 0xd0002822 FORMAT "%7.2" /end MEASUREMENT
/begin MEASUREMENT injr.STR_INJR_ACCTLFINAL0.mff_sp_1_hom_cor_inj[2] "Cylinder individual mass fuel flow set-point for homogeneous mode corrected by piezo energy carryover, first pulse" UWORD _CNV_A_R_LINEAR_____108_CM 1 100. 0. 1389. DISPLAY_IDENTIFIER MFF_SP_1_HOM_COR_INJ[2] ECU_ADDRESS 0xd0002824 FORMAT "%7.2" /end MEASUREMENT
/begin MEASUREMENT injr.STR_INJR_ACCTLFINAL0.mff_sp_1_hom_cor_inj[3] "Cylinder individual mass fuel flow set-point for homogeneous mode corrected by piezo energy carryover, first pulse" UWORD _CNV_A_R_LINEAR_____108_CM 1 100. 0. 1389. DISPLAY_IDENTIFIER MFF_SP_1_HOM_COR_INJ[3] ECU_ADDRESS 0xd0002826 FORMAT "%7.2" /end MEASUREMENT
/begin MEASUREMENT injr.STR_INJR_ACCTLFINAL0.mff_sp_1_hom_cor_inj[4] "Cylinder individual mass fuel flow set-point for homogeneous mode corrected by piezo energy carryover, first pulse" UWORD _CNV_A_R_LINEAR_____108_CM 1 100. 0. 1389. DISPLAY_IDENTIFIER MFF_SP_1_HOM_COR_INJ[4] ECU_ADDRESS 0xd0002828 FORMAT "%7.2" /end MEASUREMENT
/begin MEASUREMENT injr.STR_INJR_ACCTLFINAL0.mff_sp_1_hom_cor_inj[5] "Cylinder individual mass fuel flow set-point for homogeneous mode corrected by piezo energy carryover, first pulse" UWORD _CNV_A_R_LINEAR_____108_CM 1 100. 0. 1389. DISPLAY_IDENTIFIER MFF_SP_1_HOM_COR_INJ[5] ECU_ADDRESS 0xd000282a FORMAT "%7.2" /end MEASUREMENT
/begin MEASUREMENT injr.STR_INJR_ACCTLFINAL0.mff_sp_2_hom_cor_inj[0] "Cylinder individual mass fuel flow set-point for homogeneous mode corrected by piezo energy carryover, second pulse" UWORD _CNV_A_R_LINEAR_____108_CM 1 100. 0. 1389. DISPLAY_IDENTIFIER MFF_SP_2_HOM_COR_INJ[0] ECU_ADDRESS 0xd000282c FORMAT "%7.2" /end MEASUREMENT
/begin MEASUREMENT injr.STR_INJR_ACCTLFINAL0.mff_sp_2_hom_cor_inj[1] "Cylinder individual mass fuel flow set-point for homogeneous mode corrected by piezo energy carryover, second pulse" UWORD _CNV_A_R_LINEAR_____108_CM 1 100. 0. 1389. DISPLAY_IDENTIFIER MFF_SP_2_HOM_COR_INJ[1] ECU_ADDRESS 0xd000282e FORMAT "%7.2" /end MEASUREMENT
/begin MEASUREMENT injr.STR_INJR_ACCTLFINAL0.mff_sp_2_hom_cor_inj[2] "Cylinder individual mass fuel flow set-point for homogeneous mode corrected by piezo energy carryover, second pulse" UWORD _CNV_A_R_LINEAR_____108_CM 1 100. 0. 1389. DISPLAY_IDENTIFIER MFF_SP_2_HOM_COR_INJ[2] ECU_ADDRESS 0xd0002830 FORMAT "%7.2" /end MEASUREMENT
/begin MEASUREMENT injr.STR_INJR_ACCTLFINAL0.mff_sp_2_hom_cor_inj[3] "Cylinder individual mass fuel flow set-point for homogeneous mode corrected by piezo energy carryover, second pulse" UWORD _CNV_A_R_LINEAR_____108_CM 1 100. 0. 1389. DISPLAY_IDENTIFIER MFF_SP_2_HOM_COR_INJ[3] ECU_ADDRESS 0xd0002832 FORMAT "%7.2" /end MEASUREMENT
/begin MEASUREMENT injr.STR_INJR_ACCTLFINAL0.mff_sp_2_hom_cor_inj[4] "Cylinder individual mass fuel flow set-point for homogeneous mode corrected by piezo energy carryover, second pulse" UWORD _CNV_A_R_LINEAR_____108_CM 1 100. 0. 1389. DISPLAY_IDENTIFIER MFF_SP_2_HOM_COR_INJ[4] ECU_ADDRESS 0xd0002834 FORMAT "%7.2" /end MEASUREMENT
/begin MEASUREMENT injr.STR_INJR_ACCTLFINAL0.mff_sp_2_hom_cor_inj[5] "Cylinder individual mass fuel flow set-point for homogeneous mode corrected by piezo energy carryover, second pulse" UWORD _CNV_A_R_LINEAR_____108_CM 1 100. 0. 1389. DISPLAY_IDENTIFIER MFF_SP_2_HOM_COR_INJ[5] ECU_ADDRESS 0xd0002836 FORMAT "%7.2" /end MEASUREMENT
/begin MEASUREMENT injr.STR_INJR_REQGNS1P0.eoi_1_s[0] "End of the first injection for stratified mode" UWORD _CNV_A_R_LINEAR_____168_CM 1 100. 0. 720. DISPLAY_IDENTIFIER EOI_1_S[0] ECU_ADDRESS 0xd0002838 FORMAT "%7.3" /end MEASUREMENT
/begin MEASUREMENT injr.STR_INJR_REQGNS1P0.eoi_1_s[1] "End of the first injection for stratified mode" UWORD _CNV_A_R_LINEAR_____168_CM 1 100. 0. 720. DISPLAY_IDENTIFIER EOI_1_S[1] ECU_ADDRESS 0xd000283a FORMAT "%7.3" /end MEASUREMENT
/begin MEASUREMENT injr.STR_INJR_REQGNS1P0.eoi_1_s[2] "End of the first injection for stratified mode" UWORD _CNV_A_R_LINEAR_____168_CM 1 100. 0. 720. DISPLAY_IDENTIFIER EOI_1_S[2] ECU_ADDRESS 0xd000283c FORMAT "%7.3" /end MEASUREMENT
/begin MEASUREMENT injr.STR_INJR_REQGNS1P0.eoi_1_s[3] "End of the first injection for stratified mode" UWORD _CNV_A_R_LINEAR_____168_CM 1 100. 0. 720. DISPLAY_IDENTIFIER EOI_1_S[3] ECU_ADDRESS 0xd000283e FORMAT "%7.3" /end MEASUREMENT
/begin MEASUREMENT injr.STR_INJR_REQGNS1P0.eoi_1_s[4] "End of the first injection for stratified mode" UWORD _CNV_A_R_LINEAR_____168_CM 1 100. 0. 720. DISPLAY_IDENTIFIER EOI_1_S[4] ECU_ADDRESS 0xd0002840 FORMAT "%7.3" /end MEASUREMENT
/begin MEASUREMENT injr.STR_INJR_REQGNS1P0.eoi_1_s[5] "End of the first injection for stratified mode" UWORD _CNV_A_R_LINEAR_____168_CM 1 100. 0. 720. DISPLAY_IDENTIFIER EOI_1_S[5] ECU_ADDRESS 0xd0002842 FORMAT "%7.3" /end MEASUREMENT
/begin MEASUREMENT injr.STR_INJR_REQGNS1P0.soi_1_s[0] "Start of the first injection for stratified mode" UWORD _CNV_A_R_LINEAR_____168_CM 1 100. 0. 720. DISPLAY_IDENTIFIER SOI_1_S[0] ECU_ADDRESS 0xd0002844 FORMAT "%7.3" /end MEASUREMENT
/begin MEASUREMENT injr.STR_INJR_REQGNS1P0.soi_1_s[1] "Start of the first injection for stratified mode" UWORD _CNV_A_R_LINEAR_____168_CM 1 100. 0. 720. DISPLAY_IDENTIFIER SOI_1_S[1] ECU_ADDRESS 0xd0002846 FORMAT "%7.3" /end MEASUREMENT
/begin MEASUREMENT injr.STR_INJR_REQGNS1P0.soi_1_s[2] "Start of the first injection for stratified mode" UWORD _CNV_A_R_LINEAR_____168_CM 1 100. 0. 720. DISPLAY_IDENTIFIER SOI_1_S[2] ECU_ADDRESS 0xd0002848 FORMAT "%7.3" /end MEASUREMENT
/begin MEASUREMENT injr.STR_INJR_REQGNS1P0.soi_1_s[3] "Start of the first injection for stratified mode" UWORD _CNV_A_R_LINEAR_____168_CM 1 100. 0. 720. DISPLAY_IDENTIFIER SOI_1_S[3] ECU_ADDRESS 0xd000284a FORMAT "%7.3" /end MEASUREMENT
/begin MEASUREMENT injr.STR_INJR_REQGNS1P0.soi_1_s[4] "Start of the first injection for stratified mode" UWORD _CNV_A_R_LINEAR_____168_CM 1 100. 0. 720. DISPLAY_IDENTIFIER SOI_1_S[4] ECU_ADDRESS 0xd000284c FORMAT "%7.3" /end MEASUREMENT
/begin MEASUREMENT injr.STR_INJR_REQGNS1P0.soi_1_s[5] "Start of the first injection for stratified mode" UWORD _CNV_A_R_LINEAR_____168_CM 1 100. 0. 720. DISPLAY_IDENTIFIER SOI_1_S[5] ECU_ADDRESS 0xd000284e FORMAT "%7.3" /end MEASUREMENT
/begin MEASUREMENT injr.STR_INJR_REQGNS2P0.eoi_2_s[0] "End of the second injection for stratified mode" UWORD _CNV_A_R_LINEAR_____168_CM 1 100. 0. 720. DISPLAY_IDENTIFIER EOI_2_S[0] ECU_ADDRESS 0xd0002850 FORMAT "%7.3" /end MEASUREMENT
/begin MEASUREMENT injr.STR_INJR_REQGNS2P0.eoi_2_s[1] "End of the second injection for stratified mode" UWORD _CNV_A_R_LINEAR_____168_CM 1 100. 0. 720. DISPLAY_IDENTIFIER EOI_2_S[1] ECU_ADDRESS 0xd0002852 FORMAT "%7.3" /end MEASUREMENT
/begin MEASUREMENT injr.STR_INJR_REQGNS2P0.eoi_2_s[2] "End of the second injection for stratified mode" UWORD _CNV_A_R_LINEAR_____168_CM 1 100. 0. 720. DISPLAY_IDENTIFIER EOI_2_S[2] ECU_ADDRESS 0xd0002854 FORMAT "%7.3" /end MEASUREMENT
/begin MEASUREMENT injr.STR_INJR_REQGNS2P0.eoi_2_s[3] "End of the second injection for stratified mode" UWORD _CNV_A_R_LINEAR_____168_CM 1 100. 0. 720. DISPLAY_IDENTIFIER EOI_2_S[3] ECU_ADDRESS 0xd0002856 FORMAT "%7.3" /end MEASUREMENT
/begin MEASUREMENT injr.STR_INJR_REQGNS2P0.eoi_2_s[4] "End of the second injection for stratified mode" UWORD _CNV_A_R_LINEAR_____168_CM 1 100. 0. 720. DISPLAY_IDENTIFIER EOI_2_S[4] ECU_ADDRESS 0xd0002858 FORMAT "%7.3" /end MEASUREMENT
/begin MEASUREMENT injr.STR_INJR_REQGNS2P0.eoi_2_s[5] "End of the second injection for stratified mode" UWORD _CNV_A_R_LINEAR_____168_CM 1 100. 0. 720. DISPLAY_IDENTIFIER EOI_2_S[5] ECU_ADDRESS 0xd000285a FORMAT "%7.3" /end MEASUREMENT
/begin MEASUREMENT injr.STR_INJR_REQGNS2P0.soi_2_s[0] "Start of the second injection for stratified mode" UWORD _CNV_A_R_LINEAR_____168_CM 1 100. 0. 720. DISPLAY_IDENTIFIER SOI_2_S[0] ECU_ADDRESS 0xd000285c FORMAT "%7.3" /end MEASUREMENT
/begin MEASUREMENT injr.STR_INJR_REQGNS2P0.soi_2_s[1] "Start of the second injection for stratified mode" UWORD _CNV_A_R_LINEAR_____168_CM 1 100. 0. 720. DISPLAY_IDENTIFIER SOI_2_S[1] ECU_ADDRESS 0xd000285e FORMAT "%7.3" /end MEASUREMENT
/begin MEASUREMENT injr.STR_INJR_REQGNS2P0.soi_2_s[2] "Start of the second injection for stratified mode" UWORD _CNV_A_R_LINEAR_____168_CM 1 100. 0. 720. DISPLAY_IDENTIFIER SOI_2_S[2] ECU_ADDRESS 0xd0002860 FORMAT "%7.3" /end MEASUREMENT
/begin MEASUREMENT injr.STR_INJR_REQGNS2P0.soi_2_s[3] "Start of the second injection for stratified mode" UWORD _CNV_A_R_LINEAR_____168_CM 1 100. 0. 720. DISPLAY_IDENTIFIER SOI_2_S[3] ECU_ADDRESS 0xd0002862 FORMAT "%7.3" /end MEASUREMENT
/begin MEASUREMENT injr.STR_INJR_REQGNS2P0.soi_2_s[4] "Start of the second injection for stratified mode" UWORD _CNV_A_R_LINEAR_____168_CM 1 100. 0. 720. DISPLAY_IDENTIFIER SOI_2_S[4] ECU_ADDRESS 0xd0002864 FORMAT "%7.3" /end MEASUREMENT
/begin MEASUREMENT injr.STR_INJR_REQGNS2P0.soi_2_s[5] "Start of the second injection for stratified mode" UWORD _CNV_A_R_LINEAR_____168_CM 1 100. 0. 720. DISPLAY_IDENTIFIER SOI_2_S[5] ECU_ADDRESS 0xd0002866 FORMAT "%7.3" /end MEASUREMENT
/begin MEASUREMENT injr.STR_INJR_IFINFTRANS0.str_injr_transfer_to_iosw.fac_add_pulse "Weighting factor for injection time update at transient conditions (additive pulse)" UBYTE _CNV_A_R_LINEAR_____100_CM 1 100. 0. 1.9921875 DISPLAY_IDENTIFIER FAC_ADD_PULSE ECU_ADDRESS 0xd0002868 FORMAT "%8.6" /end MEASUREMENT
/begin MEASUREMENT injr.STR_INJR_IFINFTRANS0.str_injr_transfer_to_iosw.ti_add_pulse_min "Minimum injection time limitation for each injection pulse" UWORD _CNV_A_R_LINEAR_____233_CM 1 100. 0. 65.535 DISPLAY_IDENTIFIER TI_ADD_PULSE_MIN ECU_ADDRESS 0xd000286a /end MEASUREMENT
/begin MEASUREMENT injr.STR_INJR_IFINFTRANS0.str_injr_transfer_to_iosw.str_injr_transfer_to_iosw_cyl[0].lv_inh_inj "Flag that indicates  if cylinder shut off is active or not" UBYTE _CNV_S_2_RANGE__0___1_CM 1 100. 0. 1. DISPLAY_IDENTIFIER LV_INH_INJ[0] ECU_ADDRESS 0xd000286c BIT_MASK 0x1 /end MEASUREMENT
/begin MEASUREMENT injr.STR_INJR_IFINFTRANS0.str_injr_transfer_to_iosw.str_injr_transfer_to_iosw_cyl[0].lv_state_prev_iv "Cylinder individuel flag which indicates whether last injection was activated or deactivated" UBYTE _CNV_S_2_RANGE__0___1_CM 1 100. 0. 1. DISPLAY_IDENTIFIER LV_STATE_PREV_IV[0] ECU_ADDRESS 0xd000286d BIT_MASK 0x1 /end MEASUREMENT
/begin MEASUREMENT injr.STR_INJR_IFINFTRANS0.str_injr_transfer_to_iosw.str_injr_transfer_to_iosw_cyl[0].lv_add_pulse "Switch to enable additional injection pulse at homogeneous mode, single injection mode (injection update at transient operation)" UBYTE _CNV_S_2_RANGE__0___1_CM 1 100. 0. 1. DISPLAY_IDENTIFIER LV_ADD_PULSE[0] ECU_ADDRESS 0xd000286e BIT_MASK 0x1 /end MEASUREMENT
/begin MEASUREMENT injr.STR_INJR_IFINFTRANS0.str_injr_transfer_to_iosw.str_injr_transfer_to_iosw_cyl[0].inj_mod "Cylinder individual injection mode" UBYTE _CNV_A_R_LINEAR_____0_CM 1 100. 0. 255. DISPLAY_IDENTIFIER INJ_MOD[0] ECU_ADDRESS 0xd000286f FORMAT "%3.0" /end MEASUREMENT
/begin MEASUREMENT injr.STR_INJR_IFINFTRANS0.str_injr_transfer_to_iosw.str_injr_transfer_to_iosw_cyl[0].ctr_inh_iv_mis_gen "Counter of number of cycles where shut off caused by misfire generator was active" UBYTE _CNV_A_R_LINEAR_____0_CM 1 100. 0. 255. DISPLAY_IDENTIFIER CTR_INH_IV_MIS_GEN[0] ECU_ADDRESS 0xd0002870 FORMAT "%3.0" /end MEASUREMENT
/begin MEASUREMENT injr.STR_INJR_IFINFTRANS0.str_injr_transfer_to_iosw.str_injr_transfer_to_iosw_cyl[0].lv_inj_mplp_cyl "Logical variable for enabling post injection, cylinder individual" UBYTE _CNV_S_2_RANGE__0___1_CM 1 100. 0. 1. DISPLAY_IDENTIFIER LV_INJ_MPLP_CYL[0] ECU_ADDRESS 0xd0002871 /end MEASUREMENT
/begin MEASUREMENT injr.STR_INJR_IFINFTRANS0.str_injr_transfer_to_iosw.str_injr_transfer_to_iosw_cyl[0].ctr_test_mod_iv "Counter of number of injection valve actuator test cycles, cylinder individual" UBYTE _CNV_A_R_LINEAR_____0_CM 1 100. 0. 255. DISPLAY_IDENTIFIER CTR_TEST_MOD_IV[0] ECU_ADDRESS 0xd0002872 FORMAT "%3.0" /end MEASUREMENT
/begin MEASUREMENT injr.STR_INJR_IFINFTRANS0.str_injr_transfer_to_iosw.str_injr_transfer_to_iosw_cyl[0].inj_mod_sp "Injection mode set point, cylinder individual" UBYTE _CNV_A_R_LINEAR_____0_CM 1 100. 0. 255. DISPLAY_IDENTIFIER INJ_MOD_SP[0] ECU_ADDRESS 0xd0002873 FORMAT "%3.0" /end MEASUREMENT
/begin MEASUREMENT injr.STR_INJR_IFINFTRANS0.str_injr_transfer_to_iosw.str_injr_transfer_to_iosw_cyl[0].lv_inj_upd_ack "Cylinder individual flag, which indicates when a requested injection parameter update during mode switch was fulfilled. Flag switches from 0 to 1." UBYTE _CNV_S_2_RANGE__0___1_CM 1 100. 0. 1. DISPLAY_IDENTIFIER LV_INJ_UPD_ACK[0] ECU_ADDRESS 0xd0002874 BIT_MASK 0x1 /end MEASUREMENT
/begin MEASUREMENT injr.STR_INJR_IFINFTRANS0.str_injr_transfer_to_iosw.str_injr_transfer_to_iosw_cyl[0].str_injr_transfer_to_iosw_pls[0].soi_mes "Actual performed SOI of the first injection pulse, estimated" UWORD _CNV_A_R_LINEAR_____168_CM 1 100. 0. 720. DISPLAY_IDENTIFIER SOI_1_MES[0] ECU_ADDRESS 0xd0002878 FORMAT "%7.3" /end MEASUREMENT
/begin MEASUREMENT injr.STR_INJR_IFINFTRANS0.str_injr_transfer_to_iosw.str_injr_transfer_to_iosw_cyl[0].str_injr_transfer_to_iosw_pls[0].eoi_mes "Actual performed EOI of the first injection pulse, estimated" UWORD _CNV_A_R_LINEAR_____168_CM 1 100. 0. 720. DISPLAY_IDENTIFIER EOI_1_MES[0] ECU_ADDRESS 0xd000287a FORMAT "%7.3" /end MEASUREMENT
/begin MEASUREMENT injr.STR_INJR_IFINFTRANS0.str_injr_transfer_to_iosw.str_injr_transfer_to_iosw_cyl[0].str_injr_transfer_to_iosw_pls[0].cha_iv_mes "physical unit: uAs" UWORD _CNV_A_R_INJR_LINEA_477_CM 1 100. 0. 2272.6968 DISPLAY_IDENTIFIER CHA_IV_1_MES[0] ECU_ADDRESS 0xd000287c FORMAT "%4.0" /end MEASUREMENT
/begin MEASUREMENT injr.STR_INJR_IFINFTRANS0.str_injr_transfer_to_iosw.str_injr_transfer_to_iosw_cyl[0].str_injr_transfer_to_iosw_pls[0].v_iv_mes "Actual measured voltage of a carried out first pulse on the PIEZO injector, cylinder individual" UWORD _CNV_A_R_LINEAR_____195_CM 1 100. 0. 639.98046875 DISPLAY_IDENTIFIER V_IV_1_MES[0] ECU_ADDRESS 0xd000287e FORMAT "%6.2" /end MEASUREMENT
/begin MEASUREMENT injr.STR_INJR_IFINFTRANS0.str_injr_transfer_to_iosw.str_injr_transfer_to_iosw_cyl[0].str_injr_transfer_to_iosw_pls[0].ti_mes "Actual performed cylinder individual injection time, first pulse" UWORD _CNV_A_R_LINEAR_____233_CM 1 100. 0. 65.535 DISPLAY_IDENTIFIER TI_1_MES[0] ECU_ADDRESS 0xd0002880 /end MEASUREMENT
/begin MEASUREMENT injr.STR_INJR_IFINFTRANS0.str_injr_transfer_to_iosw.str_injr_transfer_to_iosw_cyl[0].str_injr_transfer_to_iosw_pls[0].egy_iv_clc "energy inside injector calculated from measurement data, first pulse" UWORD _CNV_A_R_INJR_LINEA_478_CM 1 100. 0. 255. DISPLAY_IDENTIFIER EGY_IV_1_CLC[0] ECU_ADDRESS 0xd0002882 FORMAT "%7.3" /end MEASUREMENT
/begin MEASUREMENT injr.STR_INJR_IFINFTRANS0.str_injr_transfer_to_iosw.str_injr_transfer_to_iosw_cyl[0].str_injr_transfer_to_iosw_pls[0].capa_iv_clc "Capacity of the piezo injector for the first pulse, calculated from measurement data" UWORD _CNV_A_R_INJR_LINEA_479_CM 1 100. 0. 27.96 DISPLAY_IDENTIFIER CAPA_IV_1_CLC[0] ECU_ADDRESS 0xd0002884 FORMAT "%5.4" /end MEASUREMENT
/begin MEASUREMENT injr.STR_INJR_IFINFTRANS0.str_injr_transfer_to_iosw.str_injr_transfer_to_iosw_cyl[0].str_injr_transfer_to_iosw_pls[1].soi_mes "Actual performed SOI of the second injection pulse, estimated" UWORD _CNV_A_R_LINEAR_____168_CM 1 100. 0. 720. DISPLAY_IDENTIFIER SOI_2_MES[0] ECU_ADDRESS 0xd0002886 FORMAT "%7.3" /end MEASUREMENT
/begin MEASUREMENT injr.STR_INJR_IFINFTRANS0.str_injr_transfer_to_iosw.str_injr_transfer_to_iosw_cyl[0].str_injr_transfer_to_iosw_pls[1].eoi_mes "Actual performed EOI of the second injection pulse, estimated" UWORD _CNV_A_R_LINEAR_____168_CM 1 100. 0. 720. DISPLAY_IDENTIFIER EOI_2_MES[0] ECU_ADDRESS 0xd0002888 FORMAT "%7.3" /end MEASUREMENT
/begin MEASUREMENT injr.STR_INJR_IFINFTRANS0.str_injr_transfer_to_iosw.str_injr_transfer_to_iosw_cyl[0].str_injr_transfer_to_iosw_pls[1].cha_iv_mes "Actual measured charge value of a carried out second pulse on the piezo injector, cylinder individual" UWORD _CNV_A_R_INJR_LINEA_477_CM 1 100. 0. 2272.6968 DISPLAY_IDENTIFIER CHA_IV_2_MES[0] ECU_ADDRESS 0xd000288a FORMAT "%4.0" /end MEASUREMENT
/begin MEASUREMENT injr.STR_INJR_IFINFTRANS0.str_injr_transfer_to_iosw.str_injr_transfer_to_iosw_cyl[0].str_injr_transfer_to_iosw_pls[1].v_iv_mes "Actual measured voltage of a carried out second pulse on the piezo injector, cylinder individual" UWORD _CNV_A_R_LINEAR_____195_CM 1 100. 0. 639.98046875 DISPLAY_IDENTIFIER V_IV_2_MES[0] ECU_ADDRESS 0xd000288c FORMAT "%6.2" /end MEASUREMENT
/begin MEASUREMENT injr.STR_INJR_IFINFTRANS0.str_injr_transfer_to_iosw.str_injr_transfer_to_iosw_cyl[0].str_injr_transfer_to_iosw_pls[1].ti_mes "Actual performed cylinder individual injection time, second pulse or additional pulse" UWORD _CNV_A_R_LINEAR_____233_CM 1 100. 0. 65.535 DISPLAY_IDENTIFIER TI_2_MES[0] ECU_ADDRESS 0xd000288e /end MEASUREMENT
/begin MEASUREMENT injr.STR_INJR_IFINFTRANS0.str_injr_transfer_to_iosw.str_injr_transfer_to_iosw_cyl[0].str_injr_transfer_to_iosw_pls[1].egy_iv_clc "Energy inside injector calculated from measurement data for the second pulse" UWORD _CNV_A_R_INJR_LINEA_478_CM 1 100. 0. 255. DISPLAY_IDENTIFIER EGY_IV_2_CLC[0] ECU_ADDRESS 0xd0002890 FORMAT "%7.3" /end MEASUREMENT
/begin MEASUREMENT injr.STR_INJR_IFINFTRANS0.str_injr_transfer_to_iosw.str_injr_transfer_to_iosw_cyl[0].str_injr_transfer_to_iosw_pls[1].capa_iv_clc "Capacity of the piezo injector for the second pulse, calculated from measurement data" UWORD _CNV_A_R_INJR_LINEA_479_CM 1 100. 0. 27.96 DISPLAY_IDENTIFIER CAPA_IV_2_CLC[0] ECU_ADDRESS 0xd0002892 FORMAT "%5.4" /end MEASUREMENT
/begin MEASUREMENT injr.STR_INJR_IFINFTRANS0.str_injr_transfer_to_iosw.str_injr_transfer_to_iosw_cyl[0].str_injr_transfer_to_iosw_pls[2].soi_mes "Actual performed SOI of the post injection pulse, estimated" UWORD _CNV_A_R_LINEAR_____168_CM 1 100. 0. 720. DISPLAY_IDENTIFIER SOI_POST_MES[0] ECU_ADDRESS 0xd0002894 FORMAT "%7.3" /end MEASUREMENT
/begin MEASUREMENT injr.STR_INJR_IFINFTRANS0.str_injr_transfer_to_iosw.str_injr_transfer_to_iosw_cyl[0].str_injr_transfer_to_iosw_pls[2].eoi_mes "Actual performed EOI of the post injection pulse, estimated" UWORD _CNV_A_R_LINEAR_____168_CM 1 100. 0. 720. DISPLAY_IDENTIFIER EOI_POST_MES[0] ECU_ADDRESS 0xd0002896 FORMAT "%7.3" /end MEASUREMENT
/begin MEASUREMENT injr.STR_INJR_IFINFTRANS0.str_injr_transfer_to_iosw.str_injr_transfer_to_iosw_cyl[0].str_injr_transfer_to_iosw_pls[2].cha_iv_mes "Actual measured charge value of a carried out post injection pulse on the piezo injector, cylinder individual" UWORD _CNV_A_R_INJR_LINEA_477_CM 1 100. 0. 2272.6968 DISPLAY_IDENTIFIER CHA_IV_POST_MES[0] ECU_ADDRESS 0xd0002898 FORMAT "%4.0" /end MEASUREMENT
/begin MEASUREMENT injr.STR_INJR_IFINFTRANS0.str_injr_transfer_to_iosw.str_injr_transfer_to_iosw_cyl[0].str_injr_transfer_to_iosw_pls[2].v_iv_mes "Actual measured voltage of a carried out post pulse on the piezo injector, cylinder individual" UWORD _CNV_A_R_LINEAR_____195_CM 1 100. 0. 639.98046875 DISPLAY_IDENTIFIER V_IV_POST_MES[0] ECU_ADDRESS 0xd000289a FORMAT "%6.2" /end MEASUREMENT
/begin MEASUREMENT injr.STR_INJR_IFINFTRANS0.str_injr_transfer_to_iosw.str_injr_transfer_to_iosw_cyl[0].str_injr_transfer_to_iosw_pls[2].ti_mes "Actual performed cylinder individual injection time, post injection pulse" UWORD _CNV_A_R_LINEAR_____233_CM 1 100. 0. 65.535 DISPLAY_IDENTIFIER TI_POST_MES[0] ECU_ADDRESS 0xd000289c /end MEASUREMENT
/begin MEASUREMENT injr.STR_INJR_IFINFTRANS0.str_injr_transfer_to_iosw.str_injr_transfer_to_iosw_cyl[0].str_injr_transfer_to_iosw_pls[2].egy_iv_clc "Energy inside injector calculated from measurement data for the post injection pulse" UWORD _CNV_A_R_INJR_LINEA_478_CM 1 100. 0. 255. DISPLAY_IDENTIFIER EGY_IV_POST_CLC[0] ECU_ADDRESS 0xd000289e FORMAT "%7.3" /end MEASUREMENT
/begin MEASUREMENT injr.STR_INJR_IFINFTRANS0.str_injr_transfer_to_iosw.str_injr_transfer_to_iosw_cyl[0].str_injr_transfer_to_iosw_pls[2].capa_iv_clc "Capacity of the piezo injector for the post injection pulse, calculated from measurement data" UWORD _CNV_A_R_INJR_LINEA_479_CM 1 100. 0. 27.96 DISPLAY_IDENTIFIER CAPA_IV_POST_CLC[0] ECU_ADDRESS 0xd00028a0 FORMAT "%5.4" /end MEASUREMENT
/begin MEASUREMENT injr.STR_INJR_IFINFTRANS0.str_injr_transfer_to_iosw.str_injr_transfer_to_iosw_cyl[1].lv_inh_inj "Flag that indicates  if cylinder shut off is active or not" UBYTE _CNV_S_2_RANGE__0___1_CM 1 100. 0. 1. DISPLAY_IDENTIFIER LV_INH_INJ[1] ECU_ADDRESS 0xd00028a4 BIT_MASK 0x1 /end MEASUREMENT
/begin MEASUREMENT injr.STR_INJR_IFINFTRANS0.str_injr_transfer_to_iosw.str_injr_transfer_to_iosw_cyl[1].lv_state_prev_iv "Cylinder individuel flag which indicates whether last injection was activated or deactivated" UBYTE _CNV_S_2_RANGE__0___1_CM 1 100. 0. 1. DISPLAY_IDENTIFIER LV_STATE_PREV_IV[1] ECU_ADDRESS 0xd00028a5 BIT_MASK 0x1 /end MEASUREMENT
/begin MEASUREMENT injr.STR_INJR_IFINFTRANS0.str_injr_transfer_to_iosw.str_injr_transfer_to_iosw_cyl[1].lv_add_pulse "Switch to enable additional injection pulse at homogeneous mode, single injection mode (injection update at transient operation)" UBYTE _CNV_S_2_RANGE__0___1_CM 1 100. 0. 1. DISPLAY_IDENTIFIER LV_ADD_PULSE[1] ECU_ADDRESS 0xd00028a6 BIT_MASK 0x1 /end MEASUREMENT
/begin MEASUREMENT injr.STR_INJR_IFINFTRANS0.str_injr_transfer_to_iosw.str_injr_transfer_to_iosw_cyl[1].inj_mod "Cylinder individual injection mode" UBYTE _CNV_A_R_LINEAR_____0_CM 1 100. 0. 255. DISPLAY_IDENTIFIER INJ_MOD[1] ECU_ADDRESS 0xd00028a7 FORMAT "%3.0" /end MEASUREMENT
/begin MEASUREMENT injr.STR_INJR_IFINFTRANS0.str_injr_transfer_to_iosw.str_injr_transfer_to_iosw_cyl[1].ctr_inh_iv_mis_gen "Counter of number of cycles where shut off caused by misfire generator was active" UBYTE _CNV_A_R_LINEAR_____0_CM 1 100. 0. 255. DISPLAY_IDENTIFIER CTR_INH_IV_MIS_GEN[1] ECU_ADDRESS 0xd00028a8 FORMAT "%3.0" /end MEASUREMENT
/begin MEASUREMENT injr.STR_INJR_IFINFTRANS0.str_injr_transfer_to_iosw.str_injr_transfer_to_iosw_cyl[1].lv_inj_mplp_cyl "Logical variable for enabling post injection, cylinder individual" UBYTE _CNV_S_2_RANGE__0___1_CM 1 100. 0. 1. DISPLAY_IDENTIFIER LV_INJ_MPLP_CYL[1] ECU_ADDRESS 0xd00028a9 /end MEASUREMENT
/begin MEASUREMENT injr.STR_INJR_IFINFTRANS0.str_injr_transfer_to_iosw.str_injr_transfer_to_iosw_cyl[1].ctr_test_mod_iv "Counter of number of injection valve actuator test cycles, cylinder individual" UBYTE _CNV_A_R_LINEAR_____0_CM 1 100. 0. 255. DISPLAY_IDENTIFIER CTR_TEST_MOD_IV[1] ECU_ADDRESS 0xd00028aa FORMAT "%3.0" /end MEASUREMENT
/begin MEASUREMENT injr.STR_INJR_IFINFTRANS0.str_injr_transfer_to_iosw.str_injr_transfer_to_iosw_cyl[1].inj_mod_sp "Injection mode set point, cylinder individual" UBYTE _CNV_A_R_LINEAR_____0_CM 1 100. 0. 255. DISPLAY_IDENTIFIER INJ_MOD_SP[1] ECU_ADDRESS 0xd00028ab FORMAT "%3.0" /end MEASUREMENT
/begin MEASUREMENT injr.STR_INJR_IFINFTRANS0.str_injr_transfer_to_iosw.str_injr_transfer_to_iosw_cyl[1].lv_inj_upd_ack "Cylinder individual flag, which indicates when a requested injection parameter update during mode switch was fulfilled. Flag switches from 0 to 1." UBYTE _CNV_S_2_RANGE__0___1_CM 1 100. 0. 1. DISPLAY_IDENTIFIER LV_INJ_UPD_ACK[1] ECU_ADDRESS 0xd00028ac BIT_MASK 0x1 /end MEASUREMENT
/begin MEASUREMENT injr.STR_INJR_IFINFTRANS0.str_injr_transfer_to_iosw.str_injr_transfer_to_iosw_cyl[1].str_injr_transfer_to_iosw_pls[0].soi_mes "Actual performed SOI of the first injection pulse, estimated" UWORD _CNV_A_R_LINEAR_____168_CM 1 100. 0. 720. DISPLAY_IDENTIFIER SOI_1_MES[1] ECU_ADDRESS 0xd00028b0 FORMAT "%7.3" /end MEASUREMENT
/begin MEASUREMENT injr.STR_INJR_IFINFTRANS0.str_injr_transfer_to_iosw.str_injr_transfer_to_iosw_cyl[1].str_injr_transfer_to_iosw_pls[0].eoi_mes "Actual performed EOI of the first injection pulse, estimated" UWORD _CNV_A_R_LINEAR_____168_CM 1 100. 0. 720. DISPLAY_IDENTIFIER EOI_1_MES[1] ECU_ADDRESS 0xd00028b2 FORMAT "%7.3" /end MEASUREMENT
/begin MEASUREMENT injr.STR_INJR_IFINFTRANS0.str_injr_transfer_to_iosw.str_injr_transfer_to_iosw_cyl[1].str_injr_transfer_to_iosw_pls[0].cha_iv_mes "physical unit: uAs" UWORD _CNV_A_R_INJR_LINEA_477_CM 1 100. 0. 2272.6968 DISPLAY_IDENTIFIER CHA_IV_1_MES[1] ECU_ADDRESS 0xd00028b4 FORMAT "%4.0" /end MEASUREMENT
/begin MEASUREMENT injr.STR_INJR_IFINFTRANS0.str_injr_transfer_to_iosw.str_injr_transfer_to_iosw_cyl[1].str_injr_transfer_to_iosw_pls[0].v_iv_mes "Actual measured voltage of a carried out first pulse on the PIEZO injector, cylinder individual" UWORD _CNV_A_R_LINEAR_____195_CM 1 100. 0. 639.98046875 DISPLAY_IDENTIFIER V_IV_1_MES[1] ECU_ADDRESS 0xd00028b6 FORMAT "%6.2" /end MEASUREMENT
/begin MEASUREMENT injr.STR_INJR_IFINFTRANS0.str_injr_transfer_to_iosw.str_injr_transfer_to_iosw_cyl[1].str_injr_transfer_to_iosw_pls[0].ti_mes "Actual performed cylinder individual injection time, first pulse" UWORD _CNV_A_R_LINEAR_____233_CM 1 100. 0. 65.535 DISPLAY_IDENTIFIER TI_1_MES[1] ECU_ADDRESS 0xd00028b8 /end MEASUREMENT
/begin MEASUREMENT injr.STR_INJR_IFINFTRANS0.str_injr_transfer_to_iosw.str_injr_transfer_to_iosw_cyl[1].str_injr_transfer_to_iosw_pls[0].egy_iv_clc "energy inside injector calculated from measurement data, first pulse" UWORD _CNV_A_R_INJR_LINEA_478_CM 1 100. 0. 255. DISPLAY_IDENTIFIER EGY_IV_1_CLC[1] ECU_ADDRESS 0xd00028ba FORMAT "%7.3" /end MEASUREMENT
/begin MEASUREMENT injr.STR_INJR_IFINFTRANS0.str_injr_transfer_to_iosw.str_injr_transfer_to_iosw_cyl[1].str_injr_transfer_to_iosw_pls[0].capa_iv_clc "Capacity of the piezo injector for the first pulse, calculated from measurement data" UWORD _CNV_A_R_INJR_LINEA_479_CM 1 100. 0. 27.96 DISPLAY_IDENTIFIER CAPA_IV_1_CLC[1] ECU_ADDRESS 0xd00028bc FORMAT "%5.4" /end MEASUREMENT
/begin MEASUREMENT injr.STR_INJR_IFINFTRANS0.str_injr_transfer_to_iosw.str_injr_transfer_to_iosw_cyl[1].str_injr_transfer_to_iosw_pls[1].soi_mes "Actual performed SOI of the second injection pulse, estimated" UWORD _CNV_A_R_LINEAR_____168_CM 1 100. 0. 720. DISPLAY_IDENTIFIER SOI_2_MES[1] ECU_ADDRESS 0xd00028be FORMAT "%7.3" /end MEASUREMENT
/begin MEASUREMENT injr.STR_INJR_IFINFTRANS0.str_injr_transfer_to_iosw.str_injr_transfer_to_iosw_cyl[1].str_injr_transfer_to_iosw_pls[1].eoi_mes "Actual performed EOI of the second injection pulse, estimated" UWORD _CNV_A_R_LINEAR_____168_CM 1 100. 0. 720. DISPLAY_IDENTIFIER EOI_2_MES[1] ECU_ADDRESS 0xd00028c0 FORMAT "%7.3" /end MEASUREMENT
/begin MEASUREMENT injr.STR_INJR_IFINFTRANS0.str_injr_transfer_to_iosw.str_injr_transfer_to_iosw_cyl[1].str_injr_transfer_to_iosw_pls[1].cha_iv_mes "Actual measured charge value of a carried out second pulse on the piezo injector, cylinder individual" UWORD _CNV_A_R_INJR_LINEA_477_CM 1 100. 0. 2272.6968 DISPLAY_IDENTIFIER CHA_IV_2_MES[1] ECU_ADDRESS 0xd00028c2 FORMAT "%4.0" /end MEASUREMENT
/begin MEASUREMENT injr.STR_INJR_IFINFTRANS0.str_injr_transfer_to_iosw.str_injr_transfer_to_iosw_cyl[1].str_injr_transfer_to_iosw_pls[1].v_iv_mes "Actual measured voltage of a carried out second pulse on the piezo injector, cylinder individual" UWORD _CNV_A_R_LINEAR_____195_CM 1 100. 0. 639.98046875 DISPLAY_IDENTIFIER V_IV_2_MES[1] ECU_ADDRESS 0xd00028c4 FORMAT "%6.2" /end MEASUREMENT
/begin MEASUREMENT injr.STR_INJR_IFINFTRANS0.str_injr_transfer_to_iosw.str_injr_transfer_to_iosw_cyl[1].str_injr_transfer_to_iosw_pls[1].ti_mes "Actual performed cylinder individual injection time, second pulse or additional pulse" UWORD _CNV_A_R_LINEAR_____233_CM 1 100. 0. 65.535 DISPLAY_IDENTIFIER TI_2_MES[1] ECU_ADDRESS 0xd00028c6 /end MEASUREMENT
/begin MEASUREMENT injr.STR_INJR_IFINFTRANS0.str_injr_transfer_to_iosw.str_injr_transfer_to_iosw_cyl[1].str_injr_transfer_to_iosw_pls[1].egy_iv_clc "Energy inside injector calculated from measurement data for the second pulse" UWORD _CNV_A_R_INJR_LINEA_478_CM 1 100. 0. 255. DISPLAY_IDENTIFIER EGY_IV_2_CLC[1] ECU_ADDRESS 0xd00028c8 FORMAT "%7.3" /end MEASUREMENT
/begin MEASUREMENT injr.STR_INJR_IFINFTRANS0.str_injr_transfer_to_iosw.str_injr_transfer_to_iosw_cyl[1].str_injr_transfer_to_iosw_pls[1].capa_iv_clc "Capacity of the piezo injector for the second pulse, calculated from measurement data" UWORD _CNV_A_R_INJR_LINEA_479_CM 1 100. 0. 27.96 DISPLAY_IDENTIFIER CAPA_IV_2_CLC[1] ECU_ADDRESS 0xd00028ca FORMAT "%5.4" /end MEASUREMENT
/begin MEASUREMENT injr.STR_INJR_IFINFTRANS0.str_injr_transfer_to_iosw.str_injr_transfer_to_iosw_cyl[1].str_injr_transfer_to_iosw_pls[2].soi_mes "Actual performed SOI of the post injection pulse, estimated" UWORD _CNV_A_R_LINEAR_____168_CM 1 100. 0. 720. DISPLAY_IDENTIFIER SOI_POST_MES[1] ECU_ADDRESS 0xd00028cc FORMAT "%7.3" /end MEASUREMENT
/begin MEASUREMENT injr.STR_INJR_IFINFTRANS0.str_injr_transfer_to_iosw.str_injr_transfer_to_iosw_cyl[1].str_injr_transfer_to_iosw_pls[2].eoi_mes "Actual performed EOI of the post injection pulse, estimated" UWORD _CNV_A_R_LINEAR_____168_CM 1 100. 0. 720. DISPLAY_IDENTIFIER EOI_POST_MES[1] ECU_ADDRESS 0xd00028ce FORMAT "%7.3" /end MEASUREMENT
/begin MEASUREMENT injr.STR_INJR_IFINFTRANS0.str_injr_transfer_to_iosw.str_injr_transfer_to_iosw_cyl[1].str_injr_transfer_to_iosw_pls[2].cha_iv_mes "Actual measured charge value of a carried out post injection pulse on the piezo injector, cylinder individual" UWORD _CNV_A_R_INJR_LINEA_477_CM 1 100. 0. 2272.6968 DISPLAY_IDENTIFIER CHA_IV_POST_MES[1] ECU_ADDRESS 0xd00028d0 FORMAT "%4.0" /end MEASUREMENT
/begin MEASUREMENT injr.STR_INJR_IFINFTRANS0.str_injr_transfer_to_iosw.str_injr_transfer_to_iosw_cyl[1].str_injr_transfer_to_iosw_pls[2].v_iv_mes "Actual measured voltage of a carried out post pulse on the piezo injector, cylinder individual" UWORD _CNV_A_R_LINEAR_____195_CM 1 100. 0. 639.98046875 DISPLAY_IDENTIFIER V_IV_POST_MES[1] ECU_ADDRESS 0xd00028d2 FORMAT "%6.2" /end MEASUREMENT
/begin MEASUREMENT injr.STR_INJR_IFINFTRANS0.str_injr_transfer_to_iosw.str_injr_transfer_to_iosw_cyl[1].str_injr_transfer_to_iosw_pls[2].ti_mes "Actual performed cylinder individual injection time, post injection pulse" UWORD _CNV_A_R_LINEAR_____233_CM 1 100. 0. 65.535 DISPLAY_IDENTIFIER TI_POST_MES[1] ECU_ADDRESS 0xd00028d4 /end MEASUREMENT
/begin MEASUREMENT injr.STR_INJR_IFINFTRANS0.str_injr_transfer_to_iosw.str_injr_transfer_to_iosw_cyl[1].str_injr_transfer_to_iosw_pls[2].egy_iv_clc "Energy inside injector calculated from measurement data for the post injection pulse" UWORD _CNV_A_R_INJR_LINEA_478_CM 1 100. 0. 255. DISPLAY_IDENTIFIER EGY_IV_POST_CLC[1] ECU_ADDRESS 0xd00028d6 FORMAT "%7.3" /end MEASUREMENT
/begin MEASUREMENT injr.STR_INJR_IFINFTRANS0.str_injr_transfer_to_iosw.str_injr_transfer_to_iosw_cyl[1].str_injr_transfer_to_iosw_pls[2].capa_iv_clc "Capacity of the piezo injector for the post injection pulse, calculated from measurement data" UWORD _CNV_A_R_INJR_LINEA_479_CM 1 100. 0. 27.96 DISPLAY_IDENTIFIER CAPA_IV_POST_CLC[1] ECU_ADDRESS 0xd00028d8 FORMAT "%5.4" /end MEASUREMENT
/begin MEASUREMENT injr.STR_INJR_IFINFTRANS0.str_injr_transfer_to_iosw.str_injr_transfer_to_iosw_cyl[2].lv_inh_inj "Flag that indicates  if cylinder shut off is active or not" UBYTE _CNV_S_2_RANGE__0___1_CM 1 100. 0. 1. DISPLAY_IDENTIFIER LV_INH_INJ[2] ECU_ADDRESS 0xd00028dc BIT_MASK 0x1 /end MEASUREMENT
/begin MEASUREMENT injr.STR_INJR_IFINFTRANS0.str_injr_transfer_to_iosw.str_injr_transfer_to_iosw_cyl[2].lv_state_prev_iv "Cylinder individuel flag which indicates whether last injection was activated or deactivated" UBYTE _CNV_S_2_RANGE__0___1_CM 1 100. 0. 1. DISPLAY_IDENTIFIER LV_STATE_PREV_IV[2] ECU_ADDRESS 0xd00028dd BIT_MASK 0x1 /end MEASUREMENT
/begin MEASUREMENT injr.STR_INJR_IFINFTRANS0.str_injr_transfer_to_iosw.str_injr_transfer_to_iosw_cyl[2].lv_add_pulse "Switch to enable additional injection pulse at homogeneous mode, single injection mode (injection update at transient operation)" UBYTE _CNV_S_2_RANGE__0___1_CM 1 100. 0. 1. DISPLAY_IDENTIFIER LV_ADD_PULSE[2] ECU_ADDRESS 0xd00028de BIT_MASK 0x1 /end MEASUREMENT
/begin MEASUREMENT injr.STR_INJR_IFINFTRANS0.str_injr_transfer_to_iosw.str_injr_transfer_to_iosw_cyl[2].inj_mod "Cylinder individual injection mode" UBYTE _CNV_A_R_LINEAR_____0_CM 1 100. 0. 255. DISPLAY_IDENTIFIER INJ_MOD[2] ECU_ADDRESS 0xd00028df FORMAT "%3.0" /end MEASUREMENT
/begin MEASUREMENT injr.STR_INJR_IFINFTRANS0.str_injr_transfer_to_iosw.str_injr_transfer_to_iosw_cyl[2].ctr_inh_iv_mis_gen "Counter of number of cycles where shut off caused by misfire generator was active" UBYTE _CNV_A_R_LINEAR_____0_CM 1 100. 0. 255. DISPLAY_IDENTIFIER CTR_INH_IV_MIS_GEN[2] ECU_ADDRESS 0xd00028e0 FORMAT "%3.0" /end MEASUREMENT
/begin MEASUREMENT injr.STR_INJR_IFINFTRANS0.str_injr_transfer_to_iosw.str_injr_transfer_to_iosw_cyl[2].lv_inj_mplp_cyl "Logical variable for enabling post injection, cylinder individual" UBYTE _CNV_S_2_RANGE__0___1_CM 1 100. 0. 1. DISPLAY_IDENTIFIER LV_INJ_MPLP_CYL[2] ECU_ADDRESS 0xd00028e1 /end MEASUREMENT
/begin MEASUREMENT injr.STR_INJR_IFINFTRANS0.str_injr_transfer_to_iosw.str_injr_transfer_to_iosw_cyl[2].ctr_test_mod_iv "Counter of number of injection valve actuator test cycles, cylinder individual" UBYTE _CNV_A_R_LINEAR_____0_CM 1 100. 0. 255. DISPLAY_IDENTIFIER CTR_TEST_MOD_IV[2] ECU_ADDRESS 0xd00028e2 FORMAT "%3.0" /end MEASUREMENT
/begin MEASUREMENT injr.STR_INJR_IFINFTRANS0.str_injr_transfer_to_iosw.str_injr_transfer_to_iosw_cyl[2].inj_mod_sp "Injection mode set point, cylinder individual" UBYTE _CNV_A_R_LINEAR_____0_CM 1 100. 0. 255. DISPLAY_IDENTIFIER INJ_MOD_SP[2] ECU_ADDRESS 0xd00028e3 FORMAT "%3.0" /end MEASUREMENT
/begin MEASUREMENT injr.STR_INJR_IFINFTRANS0.str_injr_transfer_to_iosw.str_injr_transfer_to_iosw_cyl[2].lv_inj_upd_ack "Cylinder individual flag, which indicates when a requested injection parameter update during mode switch was fulfilled. Flag switches from 0 to 1." UBYTE _CNV_S_2_RANGE__0___1_CM 1 100. 0. 1. DISPLAY_IDENTIFIER LV_INJ_UPD_ACK[2] ECU_ADDRESS 0xd00028e4 BIT_MASK 0x1 /end MEASUREMENT
/begin MEASUREMENT injr.STR_INJR_IFINFTRANS0.str_injr_transfer_to_iosw.str_injr_transfer_to_iosw_cyl[2].str_injr_transfer_to_iosw_pls[0].soi_mes "Actual performed SOI of the first injection pulse, estimated" UWORD _CNV_A_R_LINEAR_____168_CM 1 100. 0. 720. DISPLAY_IDENTIFIER SOI_1_MES[2] ECU_ADDRESS 0xd00028e8 FORMAT "%7.3" /end MEASUREMENT
/begin MEASUREMENT injr.STR_INJR_IFINFTRANS0.str_injr_transfer_to_iosw.str_injr_transfer_to_iosw_cyl[2].str_injr_transfer_to_iosw_pls[0].eoi_mes "Actual performed EOI of the first injection pulse, estimated" UWORD _CNV_A_R_LINEAR_____168_CM 1 100. 0. 720. DISPLAY_IDENTIFIER EOI_1_MES[2] ECU_ADDRESS 0xd00028ea FORMAT "%7.3" /end MEASUREMENT
/begin MEASUREMENT injr.STR_INJR_IFINFTRANS0.str_injr_transfer_to_iosw.str_injr_transfer_to_iosw_cyl[2].str_injr_transfer_to_iosw_pls[0].cha_iv_mes "physical unit: uAs" UWORD _CNV_A_R_INJR_LINEA_477_CM 1 100. 0. 2272.6968 DISPLAY_IDENTIFIER CHA_IV_1_MES[2] ECU_ADDRESS 0xd00028ec FORMAT "%4.0" /end MEASUREMENT
/begin MEASUREMENT injr.STR_INJR_IFINFTRANS0.str_injr_transfer_to_iosw.str_injr_transfer_to_iosw_cyl[2].str_injr_transfer_to_iosw_pls[0].v_iv_mes "Actual measured voltage of a carried out first pulse on the PIEZO injector, cylinder individual" UWORD _CNV_A_R_LINEAR_____195_CM 1 100. 0. 639.98046875 DISPLAY_IDENTIFIER V_IV_1_MES[2] ECU_ADDRESS 0xd00028ee FORMAT "%6.2" /end MEASUREMENT
/begin MEASUREMENT injr.STR_INJR_IFINFTRANS0.str_injr_transfer_to_iosw.str_injr_transfer_to_iosw_cyl[2].str_injr_transfer_to_iosw_pls[0].ti_mes "Actual performed cylinder individual injection time, first pulse" UWORD _CNV_A_R_LINEAR_____233_CM 1 100. 0. 65.535 DISPLAY_IDENTIFIER TI_1_MES[2] ECU_ADDRESS 0xd00028f0 /end MEASUREMENT
/begin MEASUREMENT injr.STR_INJR_IFINFTRANS0.str_injr_transfer_to_iosw.str_injr_transfer_to_iosw_cyl[2].str_injr_transfer_to_iosw_pls[0].egy_iv_clc "energy inside injector calculated from measurement data, first pulse" UWORD _CNV_A_R_INJR_LINEA_478_CM 1 100. 0. 255. DISPLAY_IDENTIFIER EGY_IV_1_CLC[2] ECU_ADDRESS 0xd00028f2 FORMAT "%7.3" /end MEASUREMENT
/begin MEASUREMENT injr.STR_INJR_IFINFTRANS0.str_injr_transfer_to_iosw.str_injr_transfer_to_iosw_cyl[2].str_injr_transfer_to_iosw_pls[0].capa_iv_clc "Capacity of the piezo injector for the first pulse, calculated from measurement data" UWORD _CNV_A_R_INJR_LINEA_479_CM 1 100. 0. 27.96 DISPLAY_IDENTIFIER CAPA_IV_1_CLC[2] ECU_ADDRESS 0xd00028f4 FORMAT "%5.4" /end MEASUREMENT
/begin MEASUREMENT injr.STR_INJR_IFINFTRANS0.str_injr_transfer_to_iosw.str_injr_transfer_to_iosw_cyl[2].str_injr_transfer_to_iosw_pls[1].soi_mes "Actual performed SOI of the second injection pulse, estimated" UWORD _CNV_A_R_LINEAR_____168_CM 1 100. 0. 720. DISPLAY_IDENTIFIER SOI_2_MES[2] ECU_ADDRESS 0xd00028f6 FORMAT "%7.3" /end MEASUREMENT
/begin MEASUREMENT injr.STR_INJR_IFINFTRANS0.str_injr_transfer_to_iosw.str_injr_transfer_to_iosw_cyl[2].str_injr_transfer_to_iosw_pls[1].eoi_mes "Actual performed EOI of the second injection pulse, estimated" UWORD _CNV_A_R_LINEAR_____168_CM 1 100. 0. 720. DISPLAY_IDENTIFIER EOI_2_MES[2] ECU_ADDRESS 0xd00028f8 FORMAT "%7.3" /end MEASUREMENT
/begin MEASUREMENT injr.STR_INJR_IFINFTRANS0.str_injr_transfer_to_iosw.str_injr_transfer_to_iosw_cyl[2].str_injr_transfer_to_iosw_pls[1].cha_iv_mes "Actual measured charge value of a carried out second pulse on the piezo injector, cylinder individual" UWORD _CNV_A_R_INJR_LINEA_477_CM 1 100. 0. 2272.6968 DISPLAY_IDENTIFIER CHA_IV_2_MES[2] ECU_ADDRESS 0xd00028fa FORMAT "%4.0" /end MEASUREMENT
/begin MEASUREMENT injr.STR_INJR_IFINFTRANS0.str_injr_transfer_to_iosw.str_injr_transfer_to_iosw_cyl[2].str_injr_transfer_to_iosw_pls[1].v_iv_mes "Actual measured voltage of a carried out second pulse on the piezo injector, cylinder individual" UWORD _CNV_A_R_LINEAR_____195_CM 1 100. 0. 639.98046875 DISPLAY_IDENTIFIER V_IV_2_MES[2] ECU_ADDRESS 0xd00028fc FORMAT "%6.2" /end MEASUREMENT
/begin MEASUREMENT injr.STR_INJR_IFINFTRANS0.str_injr_transfer_to_iosw.str_injr_transfer_to_iosw_cyl[2].str_injr_transfer_to_iosw_pls[1].ti_mes "Actual performed cylinder individual injection time, second pulse or additional pulse" UWORD _CNV_A_R_LINEAR_____233_CM 1 100. 0. 65.535 DISPLAY_IDENTIFIER TI_2_MES[2] ECU_ADDRESS 0xd00028fe /end MEASUREMENT
/begin MEASUREMENT injr.STR_INJR_IFINFTRANS0.str_injr_transfer_to_iosw.str_injr_transfer_to_iosw_cyl[2].str_injr_transfer_to_iosw_pls[1].egy_iv_clc "Energy inside injector calculated from measurement data for the second pulse" UWORD _CNV_A_R_INJR_LINEA_478_CM 1 100. 0. 255. DISPLAY_IDENTIFIER EGY_IV_2_CLC[2] ECU_ADDRESS 0xd0002900 FORMAT "%7.3" /end MEASUREMENT
/begin MEASUREMENT injr.STR_INJR_IFINFTRANS0.str_injr_transfer_to_iosw.str_injr_transfer_to_iosw_cyl[2].str_injr_transfer_to_iosw_pls[1].capa_iv_clc "Capacity of the piezo injector for the second pulse, calculated from measurement data" UWORD _CNV_A_R_INJR_LINEA_479_CM 1 100. 0. 27.96 DISPLAY_IDENTIFIER CAPA_IV_2_CLC[2] ECU_ADDRESS 0xd0002902 FORMAT "%5.4" /end MEASUREMENT
/begin MEASUREMENT injr.STR_INJR_IFINFTRANS0.str_injr_transfer_to_iosw.str_injr_transfer_to_iosw_cyl[2].str_injr_transfer_to_iosw_pls[2].soi_mes "Actual performed SOI of the post injection pulse, estimated" UWORD _CNV_A_R_LINEAR_____168_CM 1 100. 0. 720. DISPLAY_IDENTIFIER SOI_POST_MES[2] ECU_ADDRESS 0xd0002904 FORMAT "%7.3" /end MEASUREMENT
/begin MEASUREMENT injr.STR_INJR_IFINFTRANS0.str_injr_transfer_to_iosw.str_injr_transfer_to_iosw_cyl[2].str_injr_transfer_to_iosw_pls[2].eoi_mes "Actual performed EOI of the post injection pulse, estimated" UWORD _CNV_A_R_LINEAR_____168_CM 1 100. 0. 720. DISPLAY_IDENTIFIER EOI_POST_MES[2] ECU_ADDRESS 0xd0002906 FORMAT "%7.3" /end MEASUREMENT
/begin MEASUREMENT injr.STR_INJR_IFINFTRANS0.str_injr_transfer_to_iosw.str_injr_transfer_to_iosw_cyl[2].str_injr_transfer_to_iosw_pls[2].cha_iv_mes "Actual measured charge value of a carried out post injection pulse on the piezo injector, cylinder individual" UWORD _CNV_A_R_INJR_LINEA_477_CM 1 100. 0. 2272.6968 DISPLAY_IDENTIFIER CHA_IV_POST_MES[2] ECU_ADDRESS 0xd0002908 FORMAT "%4.0" /end MEASUREMENT
/begin MEASUREMENT injr.STR_INJR_IFINFTRANS0.str_injr_transfer_to_iosw.str_injr_transfer_to_iosw_cyl[2].str_injr_transfer_to_iosw_pls[2].v_iv_mes "Actual measured voltage of a carried out post pulse on the piezo injector, cylinder individual" UWORD _CNV_A_R_LINEAR_____195_CM 1 100. 0. 639.98046875 DISPLAY_IDENTIFIER V_IV_POST_MES[2] ECU_ADDRESS 0xd000290a FORMAT "%6.2" /end MEASUREMENT
/begin MEASUREMENT injr.STR_INJR_IFINFTRANS0.str_injr_transfer_to_iosw.str_injr_transfer_to_iosw_cyl[2].str_injr_transfer_to_iosw_pls[2].ti_mes "Actual performed cylinder individual injection time, post injection pulse" UWORD _CNV_A_R_LINEAR_____233_CM 1 100. 0. 65.535 DISPLAY_IDENTIFIER TI_POST_MES[2] ECU_ADDRESS 0xd000290c /end MEASUREMENT
/begin MEASUREMENT injr.STR_INJR_IFINFTRANS0.str_injr_transfer_to_iosw.str_injr_transfer_to_iosw_cyl[2].str_injr_transfer_to_iosw_pls[2].egy_iv_clc "Energy inside injector calculated from measurement data for the post injection pulse" UWORD _CNV_A_R_INJR_LINEA_478_CM 1 100. 0. 255. DISPLAY_IDENTIFIER EGY_IV_POST_CLC[2] ECU_ADDRESS 0xd000290e FORMAT "%7.3" /end MEASUREMENT
/begin MEASUREMENT injr.STR_INJR_IFINFTRANS0.str_injr_transfer_to_iosw.str_injr_transfer_to_iosw_cyl[2].str_injr_transfer_to_iosw_pls[2].capa_iv_clc "Capacity of the piezo injector for the post injection pulse, calculated from measurement data" UWORD _CNV_A_R_INJR_LINEA_479_CM 1 100. 0. 27.96 DISPLAY_IDENTIFIER CAPA_IV_POST_CLC[2] ECU_ADDRESS 0xd0002910 FORMAT "%5.4" /end MEASUREMENT
/begin MEASUREMENT injr.STR_INJR_IFINFTRANS0.str_injr_transfer_to_iosw.str_injr_transfer_to_iosw_cyl[3].lv_inh_inj "Flag that indicates  if cylinder shut off is active or not" UBYTE _CNV_S_2_RANGE__0___1_CM 1 100. 0. 1. DISPLAY_IDENTIFIER LV_INH_INJ[3] ECU_ADDRESS 0xd0002914 BIT_MASK 0x1 /end MEASUREMENT
/begin MEASUREMENT injr.STR_INJR_IFINFTRANS0.str_injr_transfer_to_iosw.str_injr_transfer_to_iosw_cyl[3].lv_state_prev_iv "Cylinder individuel flag which indicates whether last injection was activated or deactivated" UBYTE _CNV_S_2_RANGE__0___1_CM 1 100. 0. 1. DISPLAY_IDENTIFIER LV_STATE_PREV_IV[3] ECU_ADDRESS 0xd0002915 BIT_MASK 0x1 /end MEASUREMENT
/begin MEASUREMENT injr.STR_INJR_IFINFTRANS0.str_injr_transfer_to_iosw.str_injr_transfer_to_iosw_cyl[3].lv_add_pulse "Switch to enable additional injection pulse at homogeneous mode, single injection mode (injection update at transient operation)" UBYTE _CNV_S_2_RANGE__0___1_CM 1 100. 0. 1. DISPLAY_IDENTIFIER LV_ADD_PULSE[3] ECU_ADDRESS 0xd0002916 BIT_MASK 0x1 /end MEASUREMENT
/begin MEASUREMENT injr.STR_INJR_IFINFTRANS0.str_injr_transfer_to_iosw.str_injr_transfer_to_iosw_cyl[3].inj_mod "Cylinder individual injection mode" UBYTE _CNV_A_R_LINEAR_____0_CM 1 100. 0. 255. DISPLAY_IDENTIFIER INJ_MOD[3] ECU_ADDRESS 0xd0002917 FORMAT "%3.0" /end MEASUREMENT
/begin MEASUREMENT injr.STR_INJR_IFINFTRANS0.str_injr_transfer_to_iosw.str_injr_transfer_to_iosw_cyl[3].ctr_inh_iv_mis_gen "Counter of number of cycles where shut off caused by misfire generator was active" UBYTE _CNV_A_R_LINEAR_____0_CM 1 100. 0. 255. DISPLAY_IDENTIFIER CTR_INH_IV_MIS_GEN[3] ECU_ADDRESS 0xd0002918 FORMAT "%3.0" /end MEASUREMENT
/begin MEASUREMENT injr.STR_INJR_IFINFTRANS0.str_injr_transfer_to_iosw.str_injr_transfer_to_iosw_cyl[3].lv_inj_mplp_cyl "Logical variable for enabling post injection, cylinder individual" UBYTE _CNV_S_2_RANGE__0___1_CM 1 100. 0. 1. DISPLAY_IDENTIFIER LV_INJ_MPLP_CYL[3] ECU_ADDRESS 0xd0002919 /end MEASUREMENT
/begin MEASUREMENT injr.STR_INJR_IFINFTRANS0.str_injr_transfer_to_iosw.str_injr_transfer_to_iosw_cyl[3].ctr_test_mod_iv "Counter of number of injection valve actuator test cycles, cylinder individual" UBYTE _CNV_A_R_LINEAR_____0_CM 1 100. 0. 255. DISPLAY_IDENTIFIER CTR_TEST_MOD_IV[3] ECU_ADDRESS 0xd000291a FORMAT "%3.0" /end MEASUREMENT
/begin MEASUREMENT injr.STR_INJR_IFINFTRANS0.str_injr_transfer_to_iosw.str_injr_transfer_to_iosw_cyl[3].inj_mod_sp "Injection mode set point, cylinder individual" UBYTE _CNV_A_R_LINEAR_____0_CM 1 100. 0. 255. DISPLAY_IDENTIFIER INJ_MOD_SP[3] ECU_ADDRESS 0xd000291b FORMAT "%3.0" /end MEASUREMENT
/begin MEASUREMENT injr.STR_INJR_IFINFTRANS0.str_injr_transfer_to_iosw.str_injr_transfer_to_iosw_cyl[3].lv_inj_upd_ack "Cylinder individual flag, which indicates when a requested injection parameter update during mode switch was fulfilled. Flag switches from 0 to 1." UBYTE _CNV_S_2_RANGE__0___1_CM 1 100. 0. 1. DISPLAY_IDENTIFIER LV_INJ_UPD_ACK[3] ECU_ADDRESS 0xd000291c BIT_MASK 0x1 /end MEASUREMENT
/begin MEASUREMENT injr.STR_INJR_IFINFTRANS0.str_injr_transfer_to_iosw.str_injr_transfer_to_iosw_cyl[3].str_injr_transfer_to_iosw_pls[0].soi_mes "Actual performed SOI of the first injection pulse, estimated" UWORD _CNV_A_R_LINEAR_____168_CM 1 100. 0. 720. DISPLAY_IDENTIFIER SOI_1_MES[3] ECU_ADDRESS 0xd0002920 FORMAT "%7.3" /end MEASUREMENT
/begin MEASUREMENT injr.STR_INJR_IFINFTRANS0.str_injr_transfer_to_iosw.str_injr_transfer_to_iosw_cyl[3].str_injr_transfer_to_iosw_pls[0].eoi_mes "Actual performed EOI of the first injection pulse, estimated" UWORD _CNV_A_R_LINEAR_____168_CM 1 100. 0. 720. DISPLAY_IDENTIFIER EOI_1_MES[3] ECU_ADDRESS 0xd0002922 FORMAT "%7.3" /end MEASUREMENT
/begin MEASUREMENT injr.STR_INJR_IFINFTRANS0.str_injr_transfer_to_iosw.str_injr_transfer_to_iosw_cyl[3].str_injr_transfer_to_iosw_pls[0].cha_iv_mes "physical unit: uAs" UWORD _CNV_A_R_INJR_LINEA_477_CM 1 100. 0. 2272.6968 DISPLAY_IDENTIFIER CHA_IV_1_MES[3] ECU_ADDRESS 0xd0002924 FORMAT "%4.0" /end MEASUREMENT
/begin MEASUREMENT injr.STR_INJR_IFINFTRANS0.str_injr_transfer_to_iosw.str_injr_transfer_to_iosw_cyl[3].str_injr_transfer_to_iosw_pls[0].v_iv_mes "Actual measured voltage of a carried out first pulse on the PIEZO injector, cylinder individual" UWORD _CNV_A_R_LINEAR_____195_CM 1 100. 0. 639.98046875 DISPLAY_IDENTIFIER V_IV_1_MES[3] ECU_ADDRESS 0xd0002926 FORMAT "%6.2" /end MEASUREMENT
/begin MEASUREMENT injr.STR_INJR_IFINFTRANS0.str_injr_transfer_to_iosw.str_injr_transfer_to_iosw_cyl[3].str_injr_transfer_to_iosw_pls[0].ti_mes "Actual performed cylinder individual injection time, first pulse" UWORD _CNV_A_R_LINEAR_____233_CM 1 100. 0. 65.535 DISPLAY_IDENTIFIER TI_1_MES[3] ECU_ADDRESS 0xd0002928 /end MEASUREMENT
/begin MEASUREMENT injr.STR_INJR_IFINFTRANS0.str_injr_transfer_to_iosw.str_injr_transfer_to_iosw_cyl[3].str_injr_transfer_to_iosw_pls[0].egy_iv_clc "energy inside injector calculated from measurement data, first pulse" UWORD _CNV_A_R_INJR_LINEA_478_CM 1 100. 0. 255. DISPLAY_IDENTIFIER EGY_IV_1_CLC[3] ECU_ADDRESS 0xd000292a FORMAT "%7.3" /end MEASUREMENT
/begin MEASUREMENT injr.STR_INJR_IFINFTRANS0.str_injr_transfer_to_iosw.str_injr_transfer_to_iosw_cyl[3].str_injr_transfer_to_iosw_pls[0].capa_iv_clc "Capacity of the piezo injector for the first pulse, calculated from measurement data" UWORD _CNV_A_R_INJR_LINEA_479_CM 1 100. 0. 27.96 DISPLAY_IDENTIFIER CAPA_IV_1_CLC[3] ECU_ADDRESS 0xd000292c FORMAT "%5.4" /end MEASUREMENT
/begin MEASUREMENT injr.STR_INJR_IFINFTRANS0.str_injr_transfer_to_iosw.str_injr_transfer_to_iosw_cyl[3].str_injr_transfer_to_iosw_pls[1].soi_mes "Actual performed SOI of the second injection pulse, estimated" UWORD _CNV_A_R_LINEAR_____168_CM 1 100. 0. 720. DISPLAY_IDENTIFIER SOI_2_MES[3] ECU_ADDRESS 0xd000292e FORMAT "%7.3" /end MEASUREMENT
/begin MEASUREMENT injr.STR_INJR_IFINFTRANS0.str_injr_transfer_to_iosw.str_injr_transfer_to_iosw_cyl[3].str_injr_transfer_to_iosw_pls[1].eoi_mes "Actual performed EOI of the second injection pulse, estimated" UWORD _CNV_A_R_LINEAR_____168_CM 1 100. 0. 720. DISPLAY_IDENTIFIER EOI_2_MES[3] ECU_ADDRESS 0xd0002930 FORMAT "%7.3" /end MEASUREMENT
/begin MEASUREMENT injr.STR_INJR_IFINFTRANS0.str_injr_transfer_to_iosw.str_injr_transfer_to_iosw_cyl[3].str_injr_transfer_to_iosw_pls[1].cha_iv_mes "Actual measured charge value of a carried out second pulse on the piezo injector, cylinder individual" UWORD _CNV_A_R_INJR_LINEA_477_CM 1 100. 0. 2272.6968 DISPLAY_IDENTIFIER CHA_IV_2_MES[3] ECU_ADDRESS 0xd0002932 FORMAT "%4.0" /end MEASUREMENT
/begin MEASUREMENT injr.STR_INJR_IFINFTRANS0.str_injr_transfer_to_iosw.str_injr_transfer_to_iosw_cyl[3].str_injr_transfer_to_iosw_pls[1].v_iv_mes "Actual measured voltage of a carried out second pulse on the piezo injector, cylinder individual" UWORD _CNV_A_R_LINEAR_____195_CM 1 100. 0. 639.98046875 DISPLAY_IDENTIFIER V_IV_2_MES[3] ECU_ADDRESS 0xd0002934 FORMAT "%6.2" /end MEASUREMENT
/begin MEASUREMENT injr.STR_INJR_IFINFTRANS0.str_injr_transfer_to_iosw.str_injr_transfer_to_iosw_cyl[3].str_injr_transfer_to_iosw_pls[1].ti_mes "Actual performed cylinder individual injection time, second pulse or additional pulse" UWORD _CNV_A_R_LINEAR_____233_CM 1 100. 0. 65.535 DISPLAY_IDENTIFIER TI_2_MES[3] ECU_ADDRESS 0xd0002936 /end MEASUREMENT
/begin MEASUREMENT injr.STR_INJR_IFINFTRANS0.str_injr_transfer_to_iosw.str_injr_transfer_to_iosw_cyl[3].str_injr_transfer_to_iosw_pls[1].egy_iv_clc "Energy inside injector calculated from measurement data for the second pulse" UWORD _CNV_A_R_INJR_LINEA_478_CM 1 100. 0. 255. DISPLAY_IDENTIFIER EGY_IV_2_CLC[3] ECU_ADDRESS 0xd0002938 FORMAT "%7.3" /end MEASUREMENT
/begin MEASUREMENT injr.STR_INJR_IFINFTRANS0.str_injr_transfer_to_iosw.str_injr_transfer_to_iosw_cyl[3].str_injr_transfer_to_iosw_pls[1].capa_iv_clc "Capacity of the piezo injector for the second pulse, calculated from measurement data" UWORD _CNV_A_R_INJR_LINEA_479_CM 1 100. 0. 27.96 DISPLAY_IDENTIFIER CAPA_IV_2_CLC[3] ECU_ADDRESS 0xd000293a FORMAT "%5.4" /end MEASUREMENT
/begin MEASUREMENT injr.STR_INJR_IFINFTRANS0.str_injr_transfer_to_iosw.str_injr_transfer_to_iosw_cyl[3].str_injr_transfer_to_iosw_pls[2].soi_mes "Actual performed SOI of the post injection pulse, estimated" UWORD _CNV_A_R_LINEAR_____168_CM 1 100. 0. 720. DISPLAY_IDENTIFIER SOI_POST_MES[3] ECU_ADDRESS 0xd000293c FORMAT "%7.3" /end MEASUREMENT
/begin MEASUREMENT injr.STR_INJR_IFINFTRANS0.str_injr_transfer_to_iosw.str_injr_transfer_to_iosw_cyl[3].str_injr_transfer_to_iosw_pls[2].eoi_mes "Actual performed EOI of the post injection pulse, estimated" UWORD _CNV_A_R_LINEAR_____168_CM 1 100. 0. 720. DISPLAY_IDENTIFIER EOI_POST_MES[3] ECU_ADDRESS 0xd000293e FORMAT "%7.3" /end MEASUREMENT
/begin MEASUREMENT injr.STR_INJR_IFINFTRANS0.str_injr_transfer_to_iosw.str_injr_transfer_to_iosw_cyl[3].str_injr_transfer_to_iosw_pls[2].cha_iv_mes "Actual measured charge value of a carried out post injection pulse on the piezo injector, cylinder individual" UWORD _CNV_A_R_INJR_LINEA_477_CM 1 100. 0. 2272.6968 DISPLAY_IDENTIFIER CHA_IV_POST_MES[3] ECU_ADDRESS 0xd0002940 FORMAT "%4.0" /end MEASUREMENT
/begin MEASUREMENT injr.STR_INJR_IFINFTRANS0.str_injr_transfer_to_iosw.str_injr_transfer_to_iosw_cyl[3].str_injr_transfer_to_iosw_pls[2].v_iv_mes "Actual measured voltage of a carried out post pulse on the piezo injector, cylinder individual" UWORD _CNV_A_R_LINEAR_____195_CM 1 100. 0. 639.98046875 DISPLAY_IDENTIFIER V_IV_POST_MES[3] ECU_ADDRESS 0xd0002942 FORMAT "%6.2" /end MEASUREMENT
/begin MEASUREMENT injr.STR_INJR_IFINFTRANS0.str_injr_transfer_to_iosw.str_injr_transfer_to_iosw_cyl[3].str_injr_transfer_to_iosw_pls[2].ti_mes "Actual performed cylinder individual injection time, post injection pulse" UWORD _CNV_A_R_LINEAR_____233_CM 1 100. 0. 65.535 DISPLAY_IDENTIFIER TI_POST_MES[3] ECU_ADDRESS 0xd0002944 /end MEASUREMENT
/begin MEASUREMENT injr.STR_INJR_IFINFTRANS0.str_injr_transfer_to_iosw.str_injr_transfer_to_iosw_cyl[3].str_injr_transfer_to_iosw_pls[2].egy_iv_clc "Energy inside injector calculated from measurement data for the post injection pulse" UWORD _CNV_A_R_INJR_LINEA_478_CM 1 100. 0. 255. DISPLAY_IDENTIFIER EGY_IV_POST_CLC[3] ECU_ADDRESS 0xd0002946 FORMAT "%7.3" /end MEASUREMENT
/begin MEASUREMENT injr.STR_INJR_IFINFTRANS0.str_injr_transfer_to_iosw.str_injr_transfer_to_iosw_cyl[3].str_injr_transfer_to_iosw_pls[2].capa_iv_clc "Capacity of the piezo injector for the post injection pulse, calculated from measurement data" UWORD _CNV_A_R_INJR_LINEA_479_CM 1 100. 0. 27.96 DISPLAY_IDENTIFIER CAPA_IV_POST_CLC[3] ECU_ADDRESS 0xd0002948 FORMAT "%5.4" /end MEASUREMENT
/begin MEASUREMENT injr.STR_INJR_IFINFTRANS0.str_injr_transfer_to_iosw.str_injr_transfer_to_iosw_cyl[4].lv_inh_inj "Flag that indicates  if cylinder shut off is active or not" UBYTE _CNV_S_2_RANGE__0___1_CM 1 100. 0. 1. DISPLAY_IDENTIFIER LV_INH_INJ[4] ECU_ADDRESS 0xd000294c BIT_MASK 0x1 /end MEASUREMENT
/begin MEASUREMENT injr.STR_INJR_IFINFTRANS0.str_injr_transfer_to_iosw.str_injr_transfer_to_iosw_cyl[4].lv_state_prev_iv "Cylinder individuel flag which indicates whether last injection was activated or deactivated" UBYTE _CNV_S_2_RANGE__0___1_CM 1 100. 0. 1. DISPLAY_IDENTIFIER LV_STATE_PREV_IV[4] ECU_ADDRESS 0xd000294d BIT_MASK 0x1 /end MEASUREMENT
/begin MEASUREMENT injr.STR_INJR_IFINFTRANS0.str_injr_transfer_to_iosw.str_injr_transfer_to_iosw_cyl[4].lv_add_pulse "Switch to enable additional injection pulse at homogeneous mode, single injection mode (injection update at transient operation)" UBYTE _CNV_S_2_RANGE__0___1_CM 1 100. 0. 1. DISPLAY_IDENTIFIER LV_ADD_PULSE[4] ECU_ADDRESS 0xd000294e BIT_MASK 0x1 /end MEASUREMENT
/begin MEASUREMENT injr.STR_INJR_IFINFTRANS0.str_injr_transfer_to_iosw.str_injr_transfer_to_iosw_cyl[4].inj_mod "Cylinder individual injection mode" UBYTE _CNV_A_R_LINEAR_____0_CM 1 100. 0. 255. DISPLAY_IDENTIFIER INJ_MOD[4] ECU_ADDRESS 0xd000294f FORMAT "%3.0" /end MEASUREMENT
/begin MEASUREMENT injr.STR_INJR_IFINFTRANS0.str_injr_transfer_to_iosw.str_injr_transfer_to_iosw_cyl[4].ctr_inh_iv_mis_gen "Counter of number of cycles where shut off caused by misfire generator was active" UBYTE _CNV_A_R_LINEAR_____0_CM 1 100. 0. 255. DISPLAY_IDENTIFIER CTR_INH_IV_MIS_GEN[4] ECU_ADDRESS 0xd0002950 FORMAT "%3.0" /end MEASUREMENT
/begin MEASUREMENT injr.STR_INJR_IFINFTRANS0.str_injr_transfer_to_iosw.str_injr_transfer_to_iosw_cyl[4].lv_inj_mplp_cyl "Logical variable for enabling post injection, cylinder individual" UBYTE _CNV_S_2_RANGE__0___1_CM 1 100. 0. 1. DISPLAY_IDENTIFIER LV_INJ_MPLP_CYL[4] ECU_ADDRESS 0xd0002951 /end MEASUREMENT
/begin MEASUREMENT injr.STR_INJR_IFINFTRANS0.str_injr_transfer_to_iosw.str_injr_transfer_to_iosw_cyl[4].ctr_test_mod_iv "Counter of number of injection valve actuator test cycles, cylinder individual" UBYTE _CNV_A_R_LINEAR_____0_CM 1 100. 0. 255. DISPLAY_IDENTIFIER CTR_TEST_MOD_IV[4] ECU_ADDRESS 0xd0002952 FORMAT "%3.0" /end MEASUREMENT
/begin MEASUREMENT injr.STR_INJR_IFINFTRANS0.str_injr_transfer_to_iosw.str_injr_transfer_to_iosw_cyl[4].inj_mod_sp "Injection mode set point, cylinder individual" UBYTE _CNV_A_R_LINEAR_____0_CM 1 100. 0. 255. DISPLAY_IDENTIFIER INJ_MOD_SP[4] ECU_ADDRESS 0xd0002953 FORMAT "%3.0" /end MEASUREMENT
/begin MEASUREMENT injr.STR_INJR_IFINFTRANS0.str_injr_transfer_to_iosw.str_injr_transfer_to_iosw_cyl[4].lv_inj_upd_ack "Cylinder individual flag, which indicates when a requested injection parameter update during mode switch was fulfilled. Flag switches from 0 to 1." UBYTE _CNV_S_2_RANGE__0___1_CM 1 100. 0. 1. DISPLAY_IDENTIFIER LV_INJ_UPD_ACK[4] ECU_ADDRESS 0xd0002954 BIT_MASK 0x1 /end MEASUREMENT
/begin MEASUREMENT injr.STR_INJR_IFINFTRANS0.str_injr_transfer_to_iosw.str_injr_transfer_to_iosw_cyl[4].str_injr_transfer_to_iosw_pls[0].soi_mes "Actual performed SOI of the first injection pulse, estimated" UWORD _CNV_A_R_LINEAR_____168_CM 1 100. 0. 720. DISPLAY_IDENTIFIER SOI_1_MES[4] ECU_ADDRESS 0xd0002958 FORMAT "%7.3" /end MEASUREMENT
/begin MEASUREMENT injr.STR_INJR_IFINFTRANS0.str_injr_transfer_to_iosw.str_injr_transfer_to_iosw_cyl[4].str_injr_transfer_to_iosw_pls[0].eoi_mes "Actual performed EOI of the first injection pulse, estimated" UWORD _CNV_A_R_LINEAR_____168_CM 1 100. 0. 720. DISPLAY_IDENTIFIER EOI_1_MES[4] ECU_ADDRESS 0xd000295a FORMAT "%7.3" /end MEASUREMENT
/begin MEASUREMENT injr.STR_INJR_IFINFTRANS0.str_injr_transfer_to_iosw.str_injr_transfer_to_iosw_cyl[4].str_injr_transfer_to_iosw_pls[0].cha_iv_mes "physical unit: uAs" UWORD _CNV_A_R_INJR_LINEA_477_CM 1 100. 0. 2272.6968 DISPLAY_IDENTIFIER CHA_IV_1_MES[4] ECU_ADDRESS 0xd000295c FORMAT "%4.0" /end MEASUREMENT
/begin MEASUREMENT injr.STR_INJR_IFINFTRANS0.str_injr_transfer_to_iosw.str_injr_transfer_to_iosw_cyl[4].str_injr_transfer_to_iosw_pls[0].v_iv_mes "Actual measured voltage of a carried out first pulse on the PIEZO injector, cylinder individual" UWORD _CNV_A_R_LINEAR_____195_CM 1 100. 0. 639.98046875 DISPLAY_IDENTIFIER V_IV_1_MES[4] ECU_ADDRESS 0xd000295e FORMAT "%6.2" /end MEASUREMENT
/begin MEASUREMENT injr.STR_INJR_IFINFTRANS0.str_injr_transfer_to_iosw.str_injr_transfer_to_iosw_cyl[4].str_injr_transfer_to_iosw_pls[0].ti_mes "Actual performed cylinder individual injection time, first pulse" UWORD _CNV_A_R_LINEAR_____233_CM 1 100. 0. 65.535 DISPLAY_IDENTIFIER TI_1_MES[4] ECU_ADDRESS 0xd0002960 /end MEASUREMENT
/begin MEASUREMENT injr.STR_INJR_IFINFTRANS0.str_injr_transfer_to_iosw.str_injr_transfer_to_iosw_cyl[4].str_injr_transfer_to_iosw_pls[0].egy_iv_clc "energy inside injector calculated from measurement data, first pulse" UWORD _CNV_A_R_INJR_LINEA_478_CM 1 100. 0. 255. DISPLAY_IDENTIFIER EGY_IV_1_CLC[4] ECU_ADDRESS 0xd0002962 FORMAT "%7.3" /end MEASUREMENT
/begin MEASUREMENT injr.STR_INJR_IFINFTRANS0.str_injr_transfer_to_iosw.str_injr_transfer_to_iosw_cyl[4].str_injr_transfer_to_iosw_pls[0].capa_iv_clc "Capacity of the piezo injector for the first pulse, calculated from measurement data" UWORD _CNV_A_R_INJR_LINEA_479_CM 1 100. 0. 27.96 DISPLAY_IDENTIFIER CAPA_IV_1_CLC[4] ECU_ADDRESS 0xd0002964 FORMAT "%5.4" /end MEASUREMENT
/begin MEASUREMENT injr.STR_INJR_IFINFTRANS0.str_injr_transfer_to_iosw.str_injr_transfer_to_iosw_cyl[4].str_injr_transfer_to_iosw_pls[1].soi_mes "Actual performed SOI of the second injection pulse, estimated" UWORD _CNV_A_R_LINEAR_____168_CM 1 100. 0. 720. DISPLAY_IDENTIFIER SOI_2_MES[4] ECU_ADDRESS 0xd0002966 FORMAT "%7.3" /end MEASUREMENT
/begin MEASUREMENT injr.STR_INJR_IFINFTRANS0.str_injr_transfer_to_iosw.str_injr_transfer_to_iosw_cyl[4].str_injr_transfer_to_iosw_pls[1].eoi_mes "Actual performed EOI of the second injection pulse, estimated" UWORD _CNV_A_R_LINEAR_____168_CM 1 100. 0. 720. DISPLAY_IDENTIFIER EOI_2_MES[4] ECU_ADDRESS 0xd0002968 FORMAT "%7.3" /end MEASUREMENT
/begin MEASUREMENT injr.STR_INJR_IFINFTRANS0.str_injr_transfer_to_iosw.str_injr_transfer_to_iosw_cyl[4].str_injr_transfer_to_iosw_pls[1].cha_iv_mes "Actual measured charge value of a carried out second pulse on the piezo injector, cylinder individual" UWORD _CNV_A_R_INJR_LINEA_477_CM 1 100. 0. 2272.6968 DISPLAY_IDENTIFIER CHA_IV_2_MES[4] ECU_ADDRESS 0xd000296a FORMAT "%4.0" /end MEASUREMENT
/begin MEASUREMENT injr.STR_INJR_IFINFTRANS0.str_injr_transfer_to_iosw.str_injr_transfer_to_iosw_cyl[4].str_injr_transfer_to_iosw_pls[1].v_iv_mes "Actual measured voltage of a carried out second pulse on the piezo injector, cylinder individual" UWORD _CNV_A_R_LINEAR_____195_CM 1 100. 0. 639.98046875 DISPLAY_IDENTIFIER V_IV_2_MES[4] ECU_ADDRESS 0xd000296c FORMAT "%6.2" /end MEASUREMENT
/begin MEASUREMENT injr.STR_INJR_IFINFTRANS0.str_injr_transfer_to_iosw.str_injr_transfer_to_iosw_cyl[4].str_injr_transfer_to_iosw_pls[1].ti_mes "Actual performed cylinder individual injection time, second pulse or additional pulse" UWORD _CNV_A_R_LINEAR_____233_CM 1 100. 0. 65.535 DISPLAY_IDENTIFIER TI_2_MES[4] ECU_ADDRESS 0xd000296e /end MEASUREMENT
/begin MEASUREMENT injr.STR_INJR_IFINFTRANS0.str_injr_transfer_to_iosw.str_injr_transfer_to_iosw_cyl[4].str_injr_transfer_to_iosw_pls[1].egy_iv_clc "Energy inside injector calculated from measurement data for the second pulse" UWORD _CNV_A_R_INJR_LINEA_478_CM 1 100. 0. 255. DISPLAY_IDENTIFIER EGY_IV_2_CLC[4] ECU_ADDRESS 0xd0002970 FORMAT "%7.3" /end MEASUREMENT
/begin MEASUREMENT injr.STR_INJR_IFINFTRANS0.str_injr_transfer_to_iosw.str_injr_transfer_to_iosw_cyl[4].str_injr_transfer_to_iosw_pls[1].capa_iv_clc "Capacity of the piezo injector for the second pulse, calculated from measurement data" UWORD _CNV_A_R_INJR_LINEA_479_CM 1 100. 0. 27.96 DISPLAY_IDENTIFIER CAPA_IV_2_CLC[4] ECU_ADDRESS 0xd0002972 FORMAT "%5.4" /end MEASUREMENT
/begin MEASUREMENT injr.STR_INJR_IFINFTRANS0.str_injr_transfer_to_iosw.str_injr_transfer_to_iosw_cyl[4].str_injr_transfer_to_iosw_pls[2].soi_mes "Actual performed SOI of the post injection pulse, estimated" UWORD _CNV_A_R_LINEAR_____168_CM 1 100. 0. 720. DISPLAY_IDENTIFIER SOI_POST_MES[4] ECU_ADDRESS 0xd0002974 FORMAT "%7.3" /end MEASUREMENT
/begin MEASUREMENT injr.STR_INJR_IFINFTRANS0.str_injr_transfer_to_iosw.str_injr_transfer_to_iosw_cyl[4].str_injr_transfer_to_iosw_pls[2].eoi_mes "Actual performed EOI of the post injection pulse, estimated" UWORD _CNV_A_R_LINEAR_____168_CM 1 100. 0. 720. DISPLAY_IDENTIFIER EOI_POST_MES[4] ECU_ADDRESS 0xd0002976 FORMAT "%7.3" /end MEASUREMENT
/begin MEASUREMENT injr.STR_INJR_IFINFTRANS0.str_injr_transfer_to_iosw.str_injr_transfer_to_iosw_cyl[4].str_injr_transfer_to_iosw_pls[2].cha_iv_mes "Actual measured charge value of a carried out post injection pulse on the piezo injector, cylinder individual" UWORD _CNV_A_R_INJR_LINEA_477_CM 1 100. 0. 2272.6968 DISPLAY_IDENTIFIER CHA_IV_POST_MES[4] ECU_ADDRESS 0xd0002978 FORMAT "%4.0" /end MEASUREMENT
/begin MEASUREMENT injr.STR_INJR_IFINFTRANS0.str_injr_transfer_to_iosw.str_injr_transfer_to_iosw_cyl[4].str_injr_transfer_to_iosw_pls[2].v_iv_mes "Actual measured voltage of a carried out post pulse on the piezo injector, cylinder individual" UWORD _CNV_A_R_LINEAR_____195_CM 1 100. 0. 639.98046875 DISPLAY_IDENTIFIER V_IV_POST_MES[4] ECU_ADDRESS 0xd000297a FORMAT "%6.2" /end MEASUREMENT
/begin MEASUREMENT injr.STR_INJR_IFINFTRANS0.str_injr_transfer_to_iosw.str_injr_transfer_to_iosw_cyl[4].str_injr_transfer_to_iosw_pls[2].ti_mes "Actual performed cylinder individual injection time, post injection pulse" UWORD _CNV_A_R_LINEAR_____233_CM 1 100. 0. 65.535 DISPLAY_IDENTIFIER TI_POST_MES[4] ECU_ADDRESS 0xd000297c /end MEASUREMENT
/begin MEASUREMENT injr.STR_INJR_IFINFTRANS0.str_injr_transfer_to_iosw.str_injr_transfer_to_iosw_cyl[4].str_injr_transfer_to_iosw_pls[2].egy_iv_clc "Energy inside injector calculated from measurement data for the post injection pulse" UWORD _CNV_A_R_INJR_LINEA_478_CM 1 100. 0. 255. DISPLAY_IDENTIFIER EGY_IV_POST_CLC[4] ECU_ADDRESS 0xd000297e FORMAT "%7.3" /end MEASUREMENT
/begin MEASUREMENT injr.STR_INJR_IFINFTRANS0.str_injr_transfer_to_iosw.str_injr_transfer_to_iosw_cyl[4].str_injr_transfer_to_iosw_pls[2].capa_iv_clc "Capacity of the piezo injector for the post injection pulse, calculated from measurement data" UWORD _CNV_A_R_INJR_LINEA_479_CM 1 100. 0. 27.96 DISPLAY_IDENTIFIER CAPA_IV_POST_CLC[4] ECU_ADDRESS 0xd0002980 FORMAT "%5.4" /end MEASUREMENT
/begin MEASUREMENT injr.STR_INJR_IFINFTRANS0.str_injr_transfer_to_iosw.str_injr_transfer_to_iosw_cyl[5].lv_inh_inj "Flag that indicates  if cylinder shut off is active or not" UBYTE _CNV_S_2_RANGE__0___1_CM 1 100. 0. 1. DISPLAY_IDENTIFIER LV_INH_INJ[5] ECU_ADDRESS 0xd0002984 BIT_MASK 0x1 /end MEASUREMENT
/begin MEASUREMENT injr.STR_INJR_IFINFTRANS0.str_injr_transfer_to_iosw.str_injr_transfer_to_iosw_cyl[5].lv_state_prev_iv "Cylinder individuel flag which indicates whether last injection was activated or deactivated" UBYTE _CNV_S_2_RANGE__0___1_CM 1 100. 0. 1. DISPLAY_IDENTIFIER LV_STATE_PREV_IV[5] ECU_ADDRESS 0xd0002985 BIT_MASK 0x1 /end MEASUREMENT
/begin MEASUREMENT injr.STR_INJR_IFINFTRANS0.str_injr_transfer_to_iosw.str_injr_transfer_to_iosw_cyl[5].lv_add_pulse "Switch to enable additional injection pulse at homogeneous mode, single injection mode (injection update at transient operation)" UBYTE _CNV_S_2_RANGE__0___1_CM 1 100. 0. 1. DISPLAY_IDENTIFIER LV_ADD_PULSE[5] ECU_ADDRESS 0xd0002986 BIT_MASK 0x1 /end MEASUREMENT
/begin MEASUREMENT injr.STR_INJR_IFINFTRANS0.str_injr_transfer_to_iosw.str_injr_transfer_to_iosw_cyl[5].inj_mod "Cylinder individual injection mode" UBYTE _CNV_A_R_LINEAR_____0_CM 1 100. 0. 255. DISPLAY_IDENTIFIER INJ_MOD[5] ECU_ADDRESS 0xd0002987 FORMAT "%3.0" /end MEASUREMENT
/begin MEASUREMENT injr.STR_INJR_IFINFTRANS0.str_injr_transfer_to_iosw.str_injr_transfer_to_iosw_cyl[5].ctr_inh_iv_mis_gen "Counter of number of cycles where shut off caused by misfire generator was active" UBYTE _CNV_A_R_LINEAR_____0_CM 1 100. 0. 255. DISPLAY_IDENTIFIER CTR_INH_IV_MIS_GEN[5] ECU_ADDRESS 0xd0002988 FORMAT "%3.0" /end MEASUREMENT
/begin MEASUREMENT injr.STR_INJR_IFINFTRANS0.str_injr_transfer_to_iosw.str_injr_transfer_to_iosw_cyl[5].lv_inj_mplp_cyl "Logical variable for enabling post injection, cylinder individual" UBYTE _CNV_S_2_RANGE__0___1_CM 1 100. 0. 1. DISPLAY_IDENTIFIER LV_INJ_MPLP_CYL[5] ECU_ADDRESS 0xd0002989 /end MEASUREMENT
/begin MEASUREMENT injr.STR_INJR_IFINFTRANS0.str_injr_transfer_to_iosw.str_injr_transfer_to_iosw_cyl[5].ctr_test_mod_iv "Counter of number of injection valve actuator test cycles, cylinder individual" UBYTE _CNV_A_R_LINEAR_____0_CM 1 100. 0. 255. DISPLAY_IDENTIFIER CTR_TEST_MOD_IV[5] ECU_ADDRESS 0xd000298a FORMAT "%3.0" /end MEASUREMENT
/begin MEASUREMENT injr.STR_INJR_IFINFTRANS0.str_injr_transfer_to_iosw.str_injr_transfer_to_iosw_cyl[5].inj_mod_sp "Injection mode set point, cylinder individual" UBYTE _CNV_A_R_LINEAR_____0_CM 1 100. 0. 255. DISPLAY_IDENTIFIER INJ_MOD_SP[5] ECU_ADDRESS 0xd000298b FORMAT "%3.0" /end MEASUREMENT
/begin MEASUREMENT injr.STR_INJR_IFINFTRANS0.str_injr_transfer_to_iosw.str_injr_transfer_to_iosw_cyl[5].lv_inj_upd_ack "Cylinder individual flag, which indicates when a requested injection parameter update during mode switch was fulfilled. Flag switches from 0 to 1." UBYTE _CNV_S_2_RANGE__0___1_CM 1 100. 0. 1. DISPLAY_IDENTIFIER LV_INJ_UPD_ACK[5] ECU_ADDRESS 0xd000298c BIT_MASK 0x1 /end MEASUREMENT
/begin MEASUREMENT injr.STR_INJR_IFINFTRANS0.str_injr_transfer_to_iosw.str_injr_transfer_to_iosw_cyl[5].str_injr_transfer_to_iosw_pls[0].soi_mes "Actual performed SOI of the first injection pulse, estimated" UWORD _CNV_A_R_LINEAR_____168_CM 1 100. 0. 720. DISPLAY_IDENTIFIER SOI_1_MES[5] ECU_ADDRESS 0xd0002990 FORMAT "%7.3" /end MEASUREMENT
/begin MEASUREMENT injr.STR_INJR_IFINFTRANS0.str_injr_transfer_to_iosw.str_injr_transfer_to_iosw_cyl[5].str_injr_transfer_to_iosw_pls[0].eoi_mes "Actual performed EOI of the first injection pulse, estimated" UWORD _CNV_A_R_LINEAR_____168_CM 1 100. 0. 720. DISPLAY_IDENTIFIER EOI_1_MES[5] ECU_ADDRESS 0xd0002992 FORMAT "%7.3" /end MEASUREMENT
/begin MEASUREMENT injr.STR_INJR_IFINFTRANS0.str_injr_transfer_to_iosw.str_injr_transfer_to_iosw_cyl[5].str_injr_transfer_to_iosw_pls[0].cha_iv_mes "physical unit: uAs" UWORD _CNV_A_R_INJR_LINEA_477_CM 1 100. 0. 2272.6968 DISPLAY_IDENTIFIER CHA_IV_1_MES[5] ECU_ADDRESS 0xd0002994 FORMAT "%4.0" /end MEASUREMENT
/begin MEASUREMENT injr.STR_INJR_IFINFTRANS0.str_injr_transfer_to_iosw.str_injr_transfer_to_iosw_cyl[5].str_injr_transfer_to_iosw_pls[0].v_iv_mes "Actual measured voltage of a carried out first pulse on the PIEZO injector, cylinder individual" UWORD _CNV_A_R_LINEAR_____195_CM 1 100. 0. 639.98046875 DISPLAY_IDENTIFIER V_IV_1_MES[5] ECU_ADDRESS 0xd0002996 FORMAT "%6.2" /end MEASUREMENT
/begin MEASUREMENT injr.STR_INJR_IFINFTRANS0.str_injr_transfer_to_iosw.str_injr_transfer_to_iosw_cyl[5].str_injr_transfer_to_iosw_pls[0].ti_mes "Actual performed cylinder individual injection time, first pulse" UWORD _CNV_A_R_LINEAR_____233_CM 1 100. 0. 65.535 DISPLAY_IDENTIFIER TI_1_MES[5] ECU_ADDRESS 0xd0002998 /end MEASUREMENT
/begin MEASUREMENT injr.STR_INJR_IFINFTRANS0.str_injr_transfer_to_iosw.str_injr_transfer_to_iosw_cyl[5].str_injr_transfer_to_iosw_pls[0].egy_iv_clc "energy inside injector calculated from measurement data, first pulse" UWORD _CNV_A_R_INJR_LINEA_478_CM 1 100. 0. 255. DISPLAY_IDENTIFIER EGY_IV_1_CLC[5] ECU_ADDRESS 0xd000299a FORMAT "%7.3" /end MEASUREMENT
/begin MEASUREMENT injr.STR_INJR_IFINFTRANS0.str_injr_transfer_to_iosw.str_injr_transfer_to_iosw_cyl[5].str_injr_transfer_to_iosw_pls[0].capa_iv_clc "Capacity of the piezo injector for the first pulse, calculated from measurement data" UWORD _CNV_A_R_INJR_LINEA_479_CM 1 100. 0. 27.96 DISPLAY_IDENTIFIER CAPA_IV_1_CLC[5] ECU_ADDRESS 0xd000299c FORMAT "%5.4" /end MEASUREMENT
/begin MEASUREMENT injr.STR_INJR_IFINFTRANS0.str_injr_transfer_to_iosw.str_injr_transfer_to_iosw_cyl[5].str_injr_transfer_to_iosw_pls[1].soi_mes "Actual performed SOI of the second injection pulse, estimated" UWORD _CNV_A_R_LINEAR_____168_CM 1 100. 0. 720. DISPLAY_IDENTIFIER SOI_2_MES[5] ECU_ADDRESS 0xd000299e FORMAT "%7.3" /end MEASUREMENT
/begin MEASUREMENT injr.STR_INJR_IFINFTRANS0.str_injr_transfer_to_iosw.str_injr_transfer_to_iosw_cyl[5].str_injr_transfer_to_iosw_pls[1].eoi_mes "Actual performed EOI of the second injection pulse, estimated" UWORD _CNV_A_R_LINEAR_____168_CM 1 100. 0. 720. DISPLAY_IDENTIFIER EOI_2_MES[5] ECU_ADDRESS 0xd00029a0 FORMAT "%7.3" /end MEASUREMENT
/begin MEASUREMENT injr.STR_INJR_IFINFTRANS0.str_injr_transfer_to_iosw.str_injr_transfer_to_iosw_cyl[5].str_injr_transfer_to_iosw_pls[1].cha_iv_mes "Actual measured charge value of a carried out second pulse on the piezo injector, cylinder individual" UWORD _CNV_A_R_INJR_LINEA_477_CM 1 100. 0. 2272.6968 DISPLAY_IDENTIFIER CHA_IV_2_MES[5] ECU_ADDRESS 0xd00029a2 FORMAT "%4.0" /end MEASUREMENT
/begin MEASUREMENT injr.STR_INJR_IFINFTRANS0.str_injr_transfer_to_iosw.str_injr_transfer_to_iosw_cyl[5].str_injr_transfer_to_iosw_pls[1].v_iv_mes "Actual measured voltage of a carried out second pulse on the piezo injector, cylinder individual" UWORD _CNV_A_R_LINEAR_____195_CM 1 100. 0. 639.98046875 DISPLAY_IDENTIFIER V_IV_2_MES[5] ECU_ADDRESS 0xd00029a4 FORMAT "%6.2" /end MEASUREMENT
/begin MEASUREMENT injr.STR_INJR_IFINFTRANS0.str_injr_transfer_to_iosw.str_injr_transfer_to_iosw_cyl[5].str_injr_transfer_to_iosw_pls[1].ti_mes "Actual performed cylinder individual injection time, second pulse or additional pulse" UWORD _CNV_A_R_LINEAR_____233_CM 1 100. 0. 65.535 DISPLAY_IDENTIFIER TI_2_MES[5] ECU_ADDRESS 0xd00029a6 /end MEASUREMENT
/begin MEASUREMENT injr.STR_INJR_IFINFTRANS0.str_injr_transfer_to_iosw.str_injr_transfer_to_iosw_cyl[5].str_injr_transfer_to_iosw_pls[1].egy_iv_clc "Energy inside injector calculated from measurement data for the second pulse" UWORD _CNV_A_R_INJR_LINEA_478_CM 1 100. 0. 255. DISPLAY_IDENTIFIER EGY_IV_2_CLC[5] ECU_ADDRESS 0xd00029a8 FORMAT "%7.3" /end MEASUREMENT
/begin MEASUREMENT injr.STR_INJR_IFINFTRANS0.str_injr_transfer_to_iosw.str_injr_transfer_to_iosw_cyl[5].str_injr_transfer_to_iosw_pls[1].capa_iv_clc "Capacity of the piezo injector for the second pulse, calculated from measurement data" UWORD _CNV_A_R_INJR_LINEA_479_CM 1 100. 0. 27.96 DISPLAY_IDENTIFIER CAPA_IV_2_CLC[5] ECU_ADDRESS 0xd00029aa FORMAT "%5.4" /end MEASUREMENT
/begin MEASUREMENT injr.STR_INJR_IFINFTRANS0.str_injr_transfer_to_iosw.str_injr_transfer_to_iosw_cyl[5].str_injr_transfer_to_iosw_pls[2].soi_mes "Actual performed SOI of the post injection pulse, estimated" UWORD _CNV_A_R_LINEAR_____168_CM 1 100. 0. 720. DISPLAY_IDENTIFIER SOI_POST_MES[5] ECU_ADDRESS 0xd00029ac FORMAT "%7.3" /end MEASUREMENT
/begin MEASUREMENT injr.STR_INJR_IFINFTRANS0.str_injr_transfer_to_iosw.str_injr_transfer_to_iosw_cyl[5].str_injr_transfer_to_iosw_pls[2].eoi_mes "Actual performed EOI of the post injection pulse, estimated" UWORD _CNV_A_R_LINEAR_____168_CM 1 100. 0. 720. DISPLAY_IDENTIFIER EOI_POST_MES[5] ECU_ADDRESS 0xd00029ae FORMAT "%7.3" /end MEASUREMENT
/begin MEASUREMENT injr.STR_INJR_IFINFTRANS0.str_injr_transfer_to_iosw.str_injr_transfer_to_iosw_cyl[5].str_injr_transfer_to_iosw_pls[2].cha_iv_mes "Actual measured charge value of a carried out post injection pulse on the piezo injector, cylinder individual" UWORD _CNV_A_R_INJR_LINEA_477_CM 1 100. 0. 2272.6968 DISPLAY_IDENTIFIER CHA_IV_POST_MES[5] ECU_ADDRESS 0xd00029b0 FORMAT "%4.0" /end MEASUREMENT
/begin MEASUREMENT injr.STR_INJR_IFINFTRANS0.str_injr_transfer_to_iosw.str_injr_transfer_to_iosw_cyl[5].str_injr_transfer_to_iosw_pls[2].v_iv_mes "Actual measured voltage of a carried out post pulse on the piezo injector, cylinder individual" UWORD _CNV_A_R_LINEAR_____195_CM 1 100. 0. 639.98046875 DISPLAY_IDENTIFIER V_IV_POST_MES[5] ECU_ADDRESS 0xd00029b2 FORMAT "%6.2" /end MEASUREMENT
/begin MEASUREMENT injr.STR_INJR_IFINFTRANS0.str_injr_transfer_to_iosw.str_injr_transfer_to_iosw_cyl[5].str_injr_transfer_to_iosw_pls[2].ti_mes "Actual performed cylinder individual injection time, post injection pulse" UWORD _CNV_A_R_LINEAR_____233_CM 1 100. 0. 65.535 DISPLAY_IDENTIFIER TI_POST_MES[5] ECU_ADDRESS 0xd00029b4 /end MEASUREMENT
/begin MEASUREMENT injr.STR_INJR_IFINFTRANS0.str_injr_transfer_to_iosw.str_injr_transfer_to_iosw_cyl[5].str_injr_transfer_to_iosw_pls[2].egy_iv_clc "Energy inside injector calculated from measurement data for the post injection pulse" UWORD _CNV_A_R_INJR_LINEA_478_CM 1 100. 0. 255. DISPLAY_IDENTIFIER EGY_IV_POST_CLC[5] ECU_ADDRESS 0xd00029b6 FORMAT "%7.3" /end MEASUREMENT
/begin MEASUREMENT injr.STR_INJR_IFINFTRANS0.str_injr_transfer_to_iosw.str_injr_transfer_to_iosw_cyl[5].str_injr_transfer_to_iosw_pls[2].capa_iv_clc "Capacity of the piezo injector for the post injection pulse, calculated from measurement data" UWORD _CNV_A_R_INJR_LINEA_479_CM 1 100. 0. 27.96 DISPLAY_IDENTIFIER CAPA_IV_POST_CLC[5] ECU_ADDRESS 0xd00029b8 FORMAT "%5.4" /end MEASUREMENT
/begin MEASUREMENT injr.STR_INJR_IFINFTRANS0.str_injr_transfer_to_iosw.lv_iv_mes_vld "The flag indicates if the measurements for charge and voltage of the piezo injector is valid" UBYTE _CNV_S_2_RANGE__0___1_CM 1 100. 0. 1. DISPLAY_IDENTIFIER LV_IV_MES_VLD ECU_ADDRESS 0xd00029bc /end MEASUREMENT
/begin MEASUREMENT injr.STR_INJR_REQGNHOM1P0.soi_1_hom[0] "start of injection for homogeneous mode, 1.pulse" UWORD _CNV_A_R_LINEAR_____168_CM 1 100. 0. 720. DISPLAY_IDENTIFIER SOI_1_HOM[0] ECU_ADDRESS 0xd00029c0 FORMAT "%7.3" /end MEASUREMENT
/begin MEASUREMENT injr.STR_INJR_REQGNHOM1P0.soi_1_hom[1] "start of injection for homogeneous mode, 1.pulse" UWORD _CNV_A_R_LINEAR_____168_CM 1 100. 0. 720. DISPLAY_IDENTIFIER SOI_1_HOM[1] ECU_ADDRESS 0xd00029c2 FORMAT "%7.3" /end MEASUREMENT
/begin MEASUREMENT injr.STR_INJR_REQGNHOM1P0.soi_1_hom[2] "start of injection for homogeneous mode, 1.pulse" UWORD _CNV_A_R_LINEAR_____168_CM 1 100. 0. 720. DISPLAY_IDENTIFIER SOI_1_HOM[2] ECU_ADDRESS 0xd00029c4 FORMAT "%7.3" /end MEASUREMENT
/begin MEASUREMENT injr.STR_INJR_REQGNHOM1P0.soi_1_hom[3] "start of injection for homogeneous mode, 1.pulse" UWORD _CNV_A_R_LINEAR_____168_CM 1 100. 0. 720. DISPLAY_IDENTIFIER SOI_1_HOM[3] ECU_ADDRESS 0xd00029c6 FORMAT "%7.3" /end MEASUREMENT
/begin MEASUREMENT injr.STR_INJR_REQGNHOM1P0.soi_1_hom[4] "start of injection for homogeneous mode, 1.pulse" UWORD _CNV_A_R_LINEAR_____168_CM 1 100. 0. 720. DISPLAY_IDENTIFIER SOI_1_HOM[4] ECU_ADDRESS 0xd00029c8 FORMAT "%7.3" /end MEASUREMENT
/begin MEASUREMENT injr.STR_INJR_REQGNHOM1P0.soi_1_hom[5] "start of injection for homogeneous mode, 1.pulse" UWORD _CNV_A_R_LINEAR_____168_CM 1 100. 0. 720. DISPLAY_IDENTIFIER SOI_1_HOM[5] ECU_ADDRESS 0xd00029ca FORMAT "%7.3" /end MEASUREMENT
/begin MEASUREMENT injr.STR_INJR_REQGNHOM1P0.soi_1_hom_clc[0] "Calculated start of injection for homogeneous mode, 1.pulse out of start" UWORD _CNV_A_R_LINEAR_____168_CM 1 100. 0. 720. DISPLAY_IDENTIFIER SOI_1_HOM_CLC[0] ECU_ADDRESS 0xd00029d8 FORMAT "%7.3" /end MEASUREMENT
/begin MEASUREMENT injr.STR_INJR_REQGNHOM1P0.soi_1_hom_clc[1] "Calculated start of injection for homogeneous mode, 1.pulse out of start" UWORD _CNV_A_R_LINEAR_____168_CM 1 100. 0. 720. DISPLAY_IDENTIFIER SOI_1_HOM_CLC[1] ECU_ADDRESS 0xd00029da FORMAT "%7.3" /end MEASUREMENT
/begin MEASUREMENT injr.STR_INJR_REQGNHOM1P0.soi_1_hom_clc[2] "Calculated start of injection for homogeneous mode, 1.pulse out of start" UWORD _CNV_A_R_LINEAR_____168_CM 1 100. 0. 720. DISPLAY_IDENTIFIER SOI_1_HOM_CLC[2] ECU_ADDRESS 0xd00029dc FORMAT "%7.3" /end MEASUREMENT
/begin MEASUREMENT injr.STR_INJR_REQGNHOM1P0.soi_1_hom_clc[3] "Calculated start of injection for homogeneous mode, 1.pulse out of start" UWORD _CNV_A_R_LINEAR_____168_CM 1 100. 0. 720. DISPLAY_IDENTIFIER SOI_1_HOM_CLC[3] ECU_ADDRESS 0xd00029de FORMAT "%7.3" /end MEASUREMENT
/begin MEASUREMENT injr.STR_INJR_REQGNHOM1P0.soi_1_hom_clc[4] "Calculated start of injection for homogeneous mode, 1.pulse out of start" UWORD _CNV_A_R_LINEAR_____168_CM 1 100. 0. 720. DISPLAY_IDENTIFIER SOI_1_HOM_CLC[4] ECU_ADDRESS 0xd00029e0 FORMAT "%7.3" /end MEASUREMENT
/begin MEASUREMENT injr.STR_INJR_REQGNHOM1P0.soi_1_hom_clc[5] "Calculated start of injection for homogeneous mode, 1.pulse out of start" UWORD _CNV_A_R_LINEAR_____168_CM 1 100. 0. 720. DISPLAY_IDENTIFIER SOI_1_HOM_CLC[5] ECU_ADDRESS 0xd00029e2 FORMAT "%7.3" /end MEASUREMENT
/begin MEASUREMENT injr.STR_INJR_ISPCLAS0.ti_tun_iv[0] "Cylinder selective Injection Time Correction by the Application System - multiplicative value" UWORD _CNV_A_R_LINEAR_____115_CM 1 100. 0. 15.999755859375 DISPLAY_IDENTIFIER TI_TUN_IV[0] ECU_ADDRESS 0xd00029e4 FORMAT "%7.4" /end MEASUREMENT
/begin MEASUREMENT injr.STR_INJR_ISPCLAS0.ti_tun_iv[1] "Cylinder selective Injection Time Correction by the Application System - multiplicative value" UWORD _CNV_A_R_LINEAR_____115_CM 1 100. 0. 15.999755859375 DISPLAY_IDENTIFIER TI_TUN_IV[1] ECU_ADDRESS 0xd00029e6 FORMAT "%7.4" /end MEASUREMENT
/begin MEASUREMENT injr.STR_INJR_ISPCLAS0.ti_tun_iv[2] "Cylinder selective Injection Time Correction by the Application System - multiplicative value" UWORD _CNV_A_R_LINEAR_____115_CM 1 100. 0. 15.999755859375 DISPLAY_IDENTIFIER TI_TUN_IV[2] ECU_ADDRESS 0xd00029e8 FORMAT "%7.4" /end MEASUREMENT
/begin MEASUREMENT injr.STR_INJR_ISPCLAS0.ti_tun_iv[3] "Cylinder selective Injection Time Correction by the Application System - multiplicative value" UWORD _CNV_A_R_LINEAR_____115_CM 1 100. 0. 15.999755859375 DISPLAY_IDENTIFIER TI_TUN_IV[3] ECU_ADDRESS 0xd00029ea FORMAT "%7.4" /end MEASUREMENT
/begin MEASUREMENT injr.STR_INJR_ISPCLAS0.ti_tun_iv[4] "Cylinder selective Injection Time Correction by the Application System - multiplicative value" UWORD _CNV_A_R_LINEAR_____115_CM 1 100. 0. 15.999755859375 DISPLAY_IDENTIFIER TI_TUN_IV[4] ECU_ADDRESS 0xd00029ec FORMAT "%7.4" /end MEASUREMENT
/begin MEASUREMENT injr.STR_INJR_ISPCLAS0.ti_tun_iv[5] "Cylinder selective Injection Time Correction by the Application System - multiplicative value" UWORD _CNV_A_R_LINEAR_____115_CM 1 100. 0. 15.999755859375 DISPLAY_IDENTIFIER TI_TUN_IV[5] ECU_ADDRESS 0xd00029ee FORMAT "%7.4" /end MEASUREMENT
/begin MEASUREMENT injr.STR_INJR_ISPCLAS0.ti_tun_add_iv[0] "Cylinder selective Injection Time Correction by the Application System - additive value" SWORD _CNV_A_R_LINEAR_____111_CM 1 100. -131.072 131.068 DISPLAY_IDENTIFIER TI_TUN_ADD_IV[0] ECU_ADDRESS 0xd00029f0 FORMAT "%8.3" /end MEASUREMENT
/begin MEASUREMENT injr.STR_INJR_ISPCLAS0.ti_tun_add_iv[1] "Cylinder selective Injection Time Correction by the Application System - additive value" SWORD _CNV_A_R_LINEAR_____111_CM 1 100. -131.072 131.068 DISPLAY_IDENTIFIER TI_TUN_ADD_IV[1] ECU_ADDRESS 0xd00029f2 FORMAT "%8.3" /end MEASUREMENT
/begin MEASUREMENT injr.STR_INJR_ISPCLAS0.ti_tun_add_iv[2] "Cylinder selective Injection Time Correction by the Application System - additive value" SWORD _CNV_A_R_LINEAR_____111_CM 1 100. -131.072 131.068 DISPLAY_IDENTIFIER TI_TUN_ADD_IV[2] ECU_ADDRESS 0xd00029f4 FORMAT "%8.3" /end MEASUREMENT
/begin MEASUREMENT injr.STR_INJR_ISPCLAS0.ti_tun_add_iv[3] "Cylinder selective Injection Time Correction by the Application System - additive value" SWORD _CNV_A_R_LINEAR_____111_CM 1 100. -131.072 131.068 DISPLAY_IDENTIFIER TI_TUN_ADD_IV[3] ECU_ADDRESS 0xd00029f6 FORMAT "%8.3" /end MEASUREMENT
/begin MEASUREMENT injr.STR_INJR_ISPCLAS0.ti_tun_add_iv[4] "Cylinder selective Injection Time Correction by the Application System - additive value" SWORD _CNV_A_R_LINEAR_____111_CM 1 100. -131.072 131.068 DISPLAY_IDENTIFIER TI_TUN_ADD_IV[4] ECU_ADDRESS 0xd00029f8 FORMAT "%8.3" /end MEASUREMENT
/begin MEASUREMENT injr.STR_INJR_ISPCLAS0.ti_tun_add_iv[5] "Cylinder selective Injection Time Correction by the Application System - additive value" SWORD _CNV_A_R_LINEAR_____111_CM 1 100. -131.072 131.068 DISPLAY_IDENTIFIER TI_TUN_ADD_IV[5] ECU_ADDRESS 0xd00029fa FORMAT "%8.3" /end MEASUREMENT
/begin MEASUREMENT injr.STR_INJR_ACCTLCYL0.lv_scc[0] "Flag that indicates static single cylinder shut off, exhaust cylinder bank individual" UBYTE _CNV_S_2_RANGE__0___1_CM 1 100. 0. 1. DISPLAY_IDENTIFIER LV_SCC_1 ECU_ADDRESS 0xd00029fc BIT_MASK 0x1 /end MEASUREMENT
/begin MEASUREMENT injr.STR_INJR_ACCTLCYL0.lv_scc[1] "Flag that indicates static single cylinder shut off, exhaust cylinder bank individual" UBYTE _CNV_S_2_RANGE__0___1_CM 1 100. 0. 1. DISPLAY_IDENTIFIER LV_SCC_2 ECU_ADDRESS 0xd00029fd BIT_MASK 0x1 /end MEASUREMENT
/begin MEASUREMENT injr.STR_INJR_ACCTLCYL0.sum_inh_iv_cbk[0] "Sum of those bits within INH_IV which are allocated to exhaust cylinderbank k" UBYTE _CNV_A_R_LINEAR_____0_CM 1 100. 0. 8. DISPLAY_IDENTIFIER SUM_INH_IV_CBK_1 ECU_ADDRESS 0xd00029fe FORMAT "%3.0" /end MEASUREMENT
/begin MEASUREMENT injr.STR_INJR_ACCTLCYL0.sum_inh_iv_cbk[1] "Sum of those bits within INH_IV which are allocated to exhaust cylinderbank k" UBYTE _CNV_A_R_LINEAR_____0_CM 1 100. 0. 8. DISPLAY_IDENTIFIER SUM_INH_IV_CBK_2 ECU_ADDRESS 0xd00029ff FORMAT "%3.0" /end MEASUREMENT
/begin MEASUREMENT injr.STR_INJR_REQGNHOM2P0.eoi_2_hom[0] "end of injection of the second injection for hom. combustion mode (intermediate value)" UWORD _CNV_A_R_LINEAR_____168_CM 1 100. 0. 720. DISPLAY_IDENTIFIER EOI_2_HOM[0] ECU_ADDRESS 0xd0002a00 FORMAT "%7.3" /end MEASUREMENT
/begin MEASUREMENT injr.STR_INJR_REQGNHOM2P0.eoi_2_hom[1] "end of injection of the second injection for hom. combustion mode (intermediate value)" UWORD _CNV_A_R_LINEAR_____168_CM 1 100. 0. 720. DISPLAY_IDENTIFIER EOI_2_HOM[1] ECU_ADDRESS 0xd0002a02 FORMAT "%7.3" /end MEASUREMENT
/begin MEASUREMENT injr.STR_INJR_REQGNHOM2P0.eoi_2_hom[2] "end of injection of the second injection for hom. combustion mode (intermediate value)" UWORD _CNV_A_R_LINEAR_____168_CM 1 100. 0. 720. DISPLAY_IDENTIFIER EOI_2_HOM[2] ECU_ADDRESS 0xd0002a04 FORMAT "%7.3" /end MEASUREMENT
/begin MEASUREMENT injr.STR_INJR_REQGNHOM2P0.eoi_2_hom[3] "end of injection of the second injection for hom. combustion mode (intermediate value)" UWORD _CNV_A_R_LINEAR_____168_CM 1 100. 0. 720. DISPLAY_IDENTIFIER EOI_2_HOM[3] ECU_ADDRESS 0xd0002a06 FORMAT "%7.3" /end MEASUREMENT
/begin MEASUREMENT injr.STR_INJR_REQGNHOM2P0.eoi_2_hom[4] "end of injection of the second injection for hom. combustion mode (intermediate value)" UWORD _CNV_A_R_LINEAR_____168_CM 1 100. 0. 720. DISPLAY_IDENTIFIER EOI_2_HOM[4] ECU_ADDRESS 0xd0002a08 FORMAT "%7.3" /end MEASUREMENT
/begin MEASUREMENT injr.STR_INJR_REQGNHOM2P0.eoi_2_hom[5] "end of injection of the second injection for hom. combustion mode (intermediate value)" UWORD _CNV_A_R_LINEAR_____168_CM 1 100. 0. 720. DISPLAY_IDENTIFIER EOI_2_HOM[5] ECU_ADDRESS 0xd0002a0a FORMAT "%7.3" /end MEASUREMENT
/begin MEASUREMENT cam_shift_ex "Shift of the exhaust camshaft relative to passiv position" SWORD _CNV_A_R_LINEAR_____168_CM 1 100. -360. 360. DISPLAY_IDENTIFIER CAM_SHIFT_EX ECU_ADDRESS 0xd0002a68 FORMAT "%7.3" /end MEASUREMENT
/begin MEASUREMENT cam_shift_in "Shift of the inlet camshaft relative to passiv position" SWORD _CNV_A_R_LINEAR_____168_CM 1 100. -360. 360. DISPLAY_IDENTIFIER CAM_SHIFT_IN ECU_ADDRESS 0xd0002a6a FORMAT "%7.3" /end MEASUREMENT
/begin MEASUREMENT eoi_2_hom_ext[0] "End of injection for homogeneous mode, 2.pulse - base value from MSD70 layer" UWORD _CNV_A_R_LINEAR_____168_CM 1 100. 0. 720. DISPLAY_IDENTIFIER EOI_2_HOM_EXT[0] ECU_ADDRESS 0xd0002ad0 FORMAT "%7.3" /end MEASUREMENT
/begin MEASUREMENT eoi_2_hom_ext[1] "End of injection for homogeneous mode, 2.pulse - base value from MSD70 layer" UWORD _CNV_A_R_LINEAR_____168_CM 1 100. 0. 720. DISPLAY_IDENTIFIER EOI_2_HOM_EXT[1] ECU_ADDRESS 0xd0002ad2 FORMAT "%7.3" /end MEASUREMENT
/begin MEASUREMENT eoi_2_hom_ext[2] "End of injection for homogeneous mode, 2.pulse - base value from MSD70 layer" UWORD _CNV_A_R_LINEAR_____168_CM 1 100. 0. 720. DISPLAY_IDENTIFIER EOI_2_HOM_EXT[2] ECU_ADDRESS 0xd0002ad4 FORMAT "%7.3" /end MEASUREMENT
/begin MEASUREMENT eoi_2_hom_ext[3] "End of injection for homogeneous mode, 2.pulse - base value from MSD70 layer" UWORD _CNV_A_R_LINEAR_____168_CM 1 100. 0. 720. DISPLAY_IDENTIFIER EOI_2_HOM_EXT[3] ECU_ADDRESS 0xd0002ad6 FORMAT "%7.3" /end MEASUREMENT
/begin MEASUREMENT eoi_2_hom_ext[4] "End of injection for homogeneous mode, 2.pulse - base value from MSD70 layer" UWORD _CNV_A_R_LINEAR_____168_CM 1 100. 0. 720. DISPLAY_IDENTIFIER EOI_2_HOM_EXT[4] ECU_ADDRESS 0xd0002ad8 FORMAT "%7.3" /end MEASUREMENT
/begin MEASUREMENT eoi_2_hom_ext[5] "End of injection for homogeneous mode, 2.pulse - base value from MSD70 layer" UWORD _CNV_A_R_LINEAR_____168_CM 1 100. 0. 720. DISPLAY_IDENTIFIER EOI_2_HOM_EXT[5] ECU_ADDRESS 0xd0002ada FORMAT "%7.3" /end MEASUREMENT
/begin MEASUREMENT soi_1_hom_ext[0] "Start of injection for homogeneous mode, 1.pulse - base value from MSD70 layer" UWORD _CNV_A_R_LINEAR_____168_CM 1 100. 0. 720. DISPLAY_IDENTIFIER SOI_1_HOM_EXT[0] ECU_ADDRESS 0xd0002b30 FORMAT "%7.3" /end MEASUREMENT
/begin MEASUREMENT soi_1_hom_ext[1] "Start of injection for homogeneous mode, 1.pulse - base value from MSD70 layer" UWORD _CNV_A_R_LINEAR_____168_CM 1 100. 0. 720. DISPLAY_IDENTIFIER SOI_1_HOM_EXT[1] ECU_ADDRESS 0xd0002b32 FORMAT "%7.3" /end MEASUREMENT
/begin MEASUREMENT soi_1_hom_ext[2] "Start of injection for homogeneous mode, 1.pulse - base value from MSD70 layer" UWORD _CNV_A_R_LINEAR_____168_CM 1 100. 0. 720. DISPLAY_IDENTIFIER SOI_1_HOM_EXT[2] ECU_ADDRESS 0xd0002b34 FORMAT "%7.3" /end MEASUREMENT
/begin MEASUREMENT soi_1_hom_ext[3] "Start of injection for homogeneous mode, 1.pulse - base value from MSD70 layer" UWORD _CNV_A_R_LINEAR_____168_CM 1 100. 0. 720. DISPLAY_IDENTIFIER SOI_1_HOM_EXT[3] ECU_ADDRESS 0xd0002b36 FORMAT "%7.3" /end MEASUREMENT
/begin MEASUREMENT soi_1_hom_ext[4] "Start of injection for homogeneous mode, 1.pulse - base value from MSD70 layer" UWORD _CNV_A_R_LINEAR_____168_CM 1 100. 0. 720. DISPLAY_IDENTIFIER SOI_1_HOM_EXT[4] ECU_ADDRESS 0xd0002b38 FORMAT "%7.3" /end MEASUREMENT
/begin MEASUREMENT soi_1_hom_ext[5] "Start of injection for homogeneous mode, 1.pulse - base value from MSD70 layer" UWORD _CNV_A_R_LINEAR_____168_CM 1 100. 0. 720. DISPLAY_IDENTIFIER SOI_1_HOM_EXT[5] ECU_ADDRESS 0xd0002b3a FORMAT "%7.3" /end MEASUREMENT
/begin MEASUREMENT eoi_1_s_ext[0] "End of injection for stratified mode, 1.pulse - base value from MSD70 layer" UWORD _CNV_A_R_LINEAR_____168_CM 1 100. 0. 720. DISPLAY_IDENTIFIER EOI_1_S_EXT[0] ECU_ADDRESS 0xd0002ac4 FORMAT "%7.3" /end MEASUREMENT
/begin MEASUREMENT eoi_1_s_ext[1] "End of injection for stratified mode, 1.pulse - base value from MSD70 layer" UWORD _CNV_A_R_LINEAR_____168_CM 1 100. 0. 720. DISPLAY_IDENTIFIER EOI_1_S_EXT[1] ECU_ADDRESS 0xd0002ac6 FORMAT "%7.3" /end MEASUREMENT
/begin MEASUREMENT eoi_1_s_ext[2] "End of injection for stratified mode, 1.pulse - base value from MSD70 layer" UWORD _CNV_A_R_LINEAR_____168_CM 1 100. 0. 720. DISPLAY_IDENTIFIER EOI_1_S_EXT[2] ECU_ADDRESS 0xd0002ac8 FORMAT "%7.3" /end MEASUREMENT
/begin MEASUREMENT eoi_1_s_ext[3] "End of injection for stratified mode, 1.pulse - base value from MSD70 layer" UWORD _CNV_A_R_LINEAR_____168_CM 1 100. 0. 720. DISPLAY_IDENTIFIER EOI_1_S_EXT[3] ECU_ADDRESS 0xd0002aca FORMAT "%7.3" /end MEASUREMENT
/begin MEASUREMENT eoi_1_s_ext[4] "End of injection for stratified mode, 1.pulse - base value from MSD70 layer" UWORD _CNV_A_R_LINEAR_____168_CM 1 100. 0. 720. DISPLAY_IDENTIFIER EOI_1_S_EXT[4] ECU_ADDRESS 0xd0002acc FORMAT "%7.3" /end MEASUREMENT
/begin MEASUREMENT eoi_1_s_ext[5] "End of injection for stratified mode, 1.pulse - base value from MSD70 layer" UWORD _CNV_A_R_LINEAR_____168_CM 1 100. 0. 720. DISPLAY_IDENTIFIER EOI_1_S_EXT[5] ECU_ADDRESS 0xd0002ace FORMAT "%7.3" /end MEASUREMENT
/begin MEASUREMENT eoi_2_s_ext[0] "End of injection for stratified mode, 2.pulse - base value from MSD70 layer" UWORD _CNV_A_R_LINEAR_____168_CM 1 100. 0. 720. DISPLAY_IDENTIFIER EOI_2_S_EXT[0] ECU_ADDRESS 0xd0002ae8 FORMAT "%7.3" /end MEASUREMENT
/begin MEASUREMENT eoi_2_s_ext[1] "End of injection for stratified mode, 2.pulse - base value from MSD70 layer" UWORD _CNV_A_R_LINEAR_____168_CM 1 100. 0. 720. DISPLAY_IDENTIFIER EOI_2_S_EXT[1] ECU_ADDRESS 0xd0002aea FORMAT "%7.3" /end MEASUREMENT
/begin MEASUREMENT eoi_2_s_ext[2] "End of injection for stratified mode, 2.pulse - base value from MSD70 layer" UWORD _CNV_A_R_LINEAR_____168_CM 1 100. 0. 720. DISPLAY_IDENTIFIER EOI_2_S_EXT[2] ECU_ADDRESS 0xd0002aec FORMAT "%7.3" /end MEASUREMENT
/begin MEASUREMENT eoi_2_s_ext[3] "End of injection for stratified mode, 2.pulse - base value from MSD70 layer" UWORD _CNV_A_R_LINEAR_____168_CM 1 100. 0. 720. DISPLAY_IDENTIFIER EOI_2_S_EXT[3] ECU_ADDRESS 0xd0002aee FORMAT "%7.3" /end MEASUREMENT
/begin MEASUREMENT eoi_2_s_ext[4] "End of injection for stratified mode, 2.pulse - base value from MSD70 layer" UWORD _CNV_A_R_LINEAR_____168_CM 1 100. 0. 720. DISPLAY_IDENTIFIER EOI_2_S_EXT[4] ECU_ADDRESS 0xd0002af0 FORMAT "%7.3" /end MEASUREMENT
/begin MEASUREMENT eoi_2_s_ext[5] "End of injection for stratified mode, 2.pulse - base value from MSD70 layer" UWORD _CNV_A_R_LINEAR_____168_CM 1 100. 0. 720. DISPLAY_IDENTIFIER EOI_2_S_EXT[5] ECU_ADDRESS 0xd0002af2 FORMAT "%7.3" /end MEASUREMENT
/begin MEASUREMENT soi_1_homs_ext[0] "Start of injection for homogeneous mode, 1.pulse - base value from MSD70 layer" UWORD _CNV_A_R_LINEAR_____168_CM 1 100. 0. 720. DISPLAY_IDENTIFIER SOI_1_HOMS_EXT[0] ECU_ADDRESS 0xd0002b3c FORMAT "%7.3" /end MEASUREMENT
/begin MEASUREMENT soi_1_homs_ext[1] "Start of injection for homogeneous mode, 1.pulse - base value from MSD70 layer" UWORD _CNV_A_R_LINEAR_____168_CM 1 100. 0. 720. DISPLAY_IDENTIFIER SOI_1_HOMS_EXT[1] ECU_ADDRESS 0xd0002b3e FORMAT "%7.3" /end MEASUREMENT
/begin MEASUREMENT soi_1_homs_ext[2] "Start of injection for homogeneous mode, 1.pulse - base value from MSD70 layer" UWORD _CNV_A_R_LINEAR_____168_CM 1 100. 0. 720. DISPLAY_IDENTIFIER SOI_1_HOMS_EXT[2] ECU_ADDRESS 0xd0002b40 FORMAT "%7.3" /end MEASUREMENT
/begin MEASUREMENT soi_1_homs_ext[3] "Start of injection for homogeneous mode, 1.pulse - base value from MSD70 layer" UWORD _CNV_A_R_LINEAR_____168_CM 1 100. 0. 720. DISPLAY_IDENTIFIER SOI_1_HOMS_EXT[3] ECU_ADDRESS 0xd0002b42 FORMAT "%7.3" /end MEASUREMENT
/begin MEASUREMENT soi_1_homs_ext[4] "Start of injection for homogeneous mode, 1.pulse - base value from MSD70 layer" UWORD _CNV_A_R_LINEAR_____168_CM 1 100. 0. 720. DISPLAY_IDENTIFIER SOI_1_HOMS_EXT[4] ECU_ADDRESS 0xd0002b44 FORMAT "%7.3" /end MEASUREMENT
/begin MEASUREMENT soi_1_homs_ext[5] "Start of injection for homogeneous mode, 1.pulse - base value from MSD70 layer" UWORD _CNV_A_R_LINEAR_____168_CM 1 100. 0. 720. DISPLAY_IDENTIFIER SOI_1_HOMS_EXT[5] ECU_ADDRESS 0xd0002b46 FORMAT "%7.3" /end MEASUREMENT
/begin MEASUREMENT eoi_2_homs_ext[0] "End of injection for homogeneous mode, 2.pulse - base value from MSD70 layer" UWORD _CNV_A_R_LINEAR_____168_CM 1 100. 0. 720. DISPLAY_IDENTIFIER EOI_2_HOMS_EXT[0] ECU_ADDRESS 0xd0002adc FORMAT "%7.3" /end MEASUREMENT
/begin MEASUREMENT eoi_2_homs_ext[1] "End of injection for homogeneous mode, 2.pulse - base value from MSD70 layer" UWORD _CNV_A_R_LINEAR_____168_CM 1 100. 0. 720. DISPLAY_IDENTIFIER EOI_2_HOMS_EXT[1] ECU_ADDRESS 0xd0002ade FORMAT "%7.3" /end MEASUREMENT
/begin MEASUREMENT eoi_2_homs_ext[2] "End of injection for homogeneous mode, 2.pulse - base value from MSD70 layer" UWORD _CNV_A_R_LINEAR_____168_CM 1 100. 0. 720. DISPLAY_IDENTIFIER EOI_2_HOMS_EXT[2] ECU_ADDRESS 0xd0002ae0 FORMAT "%7.3" /end MEASUREMENT
/begin MEASUREMENT eoi_2_homs_ext[3] "End of injection for homogeneous mode, 2.pulse - base value from MSD70 layer" UWORD _CNV_A_R_LINEAR_____168_CM 1 100. 0. 720. DISPLAY_IDENTIFIER EOI_2_HOMS_EXT[3] ECU_ADDRESS 0xd0002ae2 FORMAT "%7.3" /end MEASUREMENT
/begin MEASUREMENT eoi_2_homs_ext[4] "End of injection for homogeneous mode, 2.pulse - base value from MSD70 layer" UWORD _CNV_A_R_LINEAR_____168_CM 1 100. 0. 720. DISPLAY_IDENTIFIER EOI_2_HOMS_EXT[4] ECU_ADDRESS 0xd0002ae4 FORMAT "%7.3" /end MEASUREMENT
/begin MEASUREMENT eoi_2_homs_ext[5] "End of injection for homogeneous mode, 2.pulse - base value from MSD70 layer" UWORD _CNV_A_R_LINEAR_____168_CM 1 100. 0. 720. DISPLAY_IDENTIFIER EOI_2_HOMS_EXT[5] ECU_ADDRESS 0xd0002ae6 FORMAT "%7.3" /end MEASUREMENT
/begin MEASUREMENT lv_crk_dif_soi_eoi_lim "Difference between SOI and EOI is beyond the maximum" UBYTE _CNV_S_2_RANGE__0___1_CM 1 100. 0. 1. DISPLAY_IDENTIFIER LV_CRK_DIF_SOI_EOI_LIM ECU_ADDRESS 0xd0002f02 BIT_MASK 0x1 /end MEASUREMENT
/begin MEASUREMENT lv_eoi_lim_hom "At least one injection was repositioned to eoi_min_hom" UBYTE _CNV_S_2_RANGE__0___1_CM 1 100. 0. 1. DISPLAY_IDENTIFIER LV_EOI_LIM_HOM ECU_ADDRESS 0xc0002404 BIT_MASK 0x1 /end MEASUREMENT
/begin MEASUREMENT soi_lim "Earliest possible SOI" UWORD _CNV_A_R_LINEAR_____168_CM 1 100. 0. 720. DISPLAY_IDENTIFIER SOI_LIM ECU_ADDRESS 0xd0002b48 FORMAT "%7.3" /end MEASUREMENT
/begin CHARACTERISTIC c_eoi_lim_hom "Latest possible EOI" VALUE 0xa1008a20 _REC_VAL_20_u2 720. _CNV_A_R_LINEAR_____168_CM 0. 720. DISPLAY_IDENTIFIER C_EOI_LIM_HOM FORMAT "%7.3" /end CHARACTERISTIC
/begin CHARACTERISTIC c_eoi_lim_hom_st "Latest possible EOI at start" VALUE 0xa1008a24 _REC_VAL_20_u2 720. _CNV_A_R_LINEAR_____168_CM 0. 720. DISPLAY_IDENTIFIER C_EOI_LIM_HOM_ST FORMAT "%7.3" /end CHARACTERISTIC
/begin CHARACTERISTIC c_soi_lim "Earlies possible SOI" VALUE 0xa1008a3c _REC_VAL_20_u2 720. _CNV_A_R_LINEAR_____168_CM 0. 720. DISPLAY_IDENTIFIER C_SOI_LIM FORMAT "%7.3" /end CHARACTERISTIC
/begin CHARACTERISTIC ip_eoi_lim_hom_fup_cor "FUP correction of EOI_LIM_HOM" CURVE 0xa1008420 _REC_CUR_20_u2_u2 720. _CNV_A_R_INJR_LINEA_481_CM -360. 360. DISPLAY_IDENTIFIER IP_EOI_LIM_HOM_FUP_COR FORMAT "%7.3"
 /begin AXIS_DESCR COM_AXIS online_dummy _CNV_A_R_LINEAR_____152_CM 4 0. 347776. FORMAT "%8.1" AXIS_PTS_REF ldpm_fup_h_1_injr /end AXIS_DESCR
/end CHARACTERISTIC
/begin MEASUREMENT eoi_lim_hom "Latest possible EOI at homogeneous mode" UWORD _CNV_A_R_LINEAR_____168_CM 1 100. 0. 720. DISPLAY_IDENTIFIER EOI_LIM_HOM ECU_ADDRESS 0xd0002af4 FORMAT "%7.3" /end MEASUREMENT
/begin MEASUREMENT eoi_1_hom "End of injection for homogeneous mode, 1pulse" UWORD _CNV_A_R_LINEAR_____168_CM 1 100. 0. 720. DISPLAY_IDENTIFIER EOI_1_HOM ECU_ADDRESS 0xd0002ac0 FORMAT "%7.3" /end MEASUREMENT
/begin AXIS_PTS ldpm_fup_h_1_injr "" 0xa10082e4 online_dummy _REC_AXS_20_u2 347776. _CNV_A_R_LINEAR_____152_CM 4 0. 347776. FORMAT "%8.1" /end AXIS_PTS
/begin CHARACTERISTIC c_eoi_lim_hom_multi_cor "Correction value for calculation of the latest possible EOI, if multi injection is active" VALUE 0xa1008a22 _REC_VAL_20_s2 720. _CNV_A_R_LINEAR_____168_CM -360. 360. DISPLAY_IDENTIFIER C_EOI_LIM_HOM_MULTI_COR FORMAT "%7.3" /end CHARACTERISTIC
/begin CHARACTERISTIC lc_soi_1_hom_man "Switch for the manual setpoit for EOI" VALUE 0xa1008a82 _REC_VAL_20_u1 1. _CNV_A_R_LINEAR_____0_CM 0. 1. DISPLAY_IDENTIFIER LC_SOI_1_HOM_MAN FORMAT "%1.0" /end CHARACTERISTIC
/begin CHARACTERISTIC lc_soi_1_hom_st_man "Switch to activate the manual setpoint for SOI during start" VALUE 0xa1008a83 _REC_VAL_20_u1 1. _CNV_A_R_LINEAR_____0_CM 0. 1. DISPLAY_IDENTIFIER LC_SOI_1_HOM_ST_MAN FORMAT "%1.0" /end CHARACTERISTIC
/begin CHARACTERISTIC c_soi_1_hom_man "Manual setpoit for EOI" VALUE 0xa1008a34 _REC_VAL_20_u2 720. _CNV_A_R_LINEAR_____168_CM 0. 720. DISPLAY_IDENTIFIER C_SOI_1_HOM_MAN FORMAT "%7.3" /end CHARACTERISTIC
/begin CHARACTERISTIC c_soi_1_hom_st_man "Manual setpoint for SOI during start" VALUE 0xa1008a36 _REC_VAL_20_u2 720. _CNV_A_R_LINEAR_____168_CM 0. 720. DISPLAY_IDENTIFIER C_SOI_1_HOM_ST_MAN FORMAT "%7.3" /end CHARACTERISTIC
/begin CHARACTERISTIC lc_eoi_2_s_man "Global application assistance switch passive/active for the second injection" VALUE 0xa1008a7f _REC_VAL_20_u1 1. _CNV_A_R_LINEAR_____0_CM 0. 1. DISPLAY_IDENTIFIER LC_EOI_2_S_MAN FORMAT "%1.0" /end CHARACTERISTIC
/begin CHARACTERISTIC c_eoi_2_s_man "Global application assistance for the second injection" VALUE 0xa1008a1e _REC_VAL_20_u2 720. _CNV_A_R_LINEAR_____168_CM 0. 720. DISPLAY_IDENTIFIER C_EOI_2_S_MAN FORMAT "%7.3" /end CHARACTERISTIC
/begin MEASUREMENT lv_iv_egy_rng_1 "Flag for the injector energy range of the first pulse (0 = low range, 1 = high range)" UBYTE _CNV_S_2_RANGE__0___1_CM 1 100. 0. 1. DISPLAY_IDENTIFIER LV_IV_EGY_RNG_1 ECU_ADDRESS 0xd0002f0e BIT_MASK 0x1 /end MEASUREMENT
/begin MEASUREMENT lv_iv_egy_rng_2 "Flag for the injector energy range of the second pulse (0 = low range, 1 = high range)" UBYTE _CNV_S_2_RANGE__0___1_CM 1 100. 0. 1. DISPLAY_IDENTIFIER LV_IV_EGY_RNG_2 ECU_ADDRESS 0xd0002f0f BIT_MASK 0x1 /end MEASUREMENT
/begin MEASUREMENT ti_1_min_stnd_egy_h_s "Minimum stratified injection time for high energy range, 1. pulse" UWORD _CNV_A_R_LINEAR_____233_CM 1 100. 0. 65.535 DISPLAY_IDENTIFIER TI_1_MIN_STND_EGY_H_S ECU_ADDRESS 0xc00023ec /end MEASUREMENT
/begin MEASUREMENT ti_2_min_stnd_egy_h_s "Minimum stratified injection time for high energy range, 2. pulse" UWORD _CNV_A_R_LINEAR_____233_CM 1 100. 0. 65.535 DISPLAY_IDENTIFIER TI_2_MIN_STND_EGY_H_S ECU_ADDRESS 0xc00023f6 /end MEASUREMENT
/begin CHARACTERISTIC c_ti_thd_iv_egy_rng "Injection time threshold for the selection of the injector energy range" VALUE 0xa1008a76 _REC_VAL_20_u2 65.535 _CNV_A_R_LINEAR_____233_CM 0. 65.535 DISPLAY_IDENTIFIER C_TI_THD_IV_EGY_RNG /end CHARACTERISTIC
/begin MEASUREMENT t_dcha_per_hom "Piezo IV discharge period for homogeneous mode" UBYTE _CNV_A_R_LINEAR_____509_CM 1 100. 0. 0.3 DISPLAY_IDENTIFIER T_DCHA_PER_HOM ECU_ADDRESS 0xd0002ef9 FORMAT "%4.2" /end MEASUREMENT
/begin MEASUREMENT t_cha_per_s_1 "Piezo IV charge period for stratified mode first pulse" UBYTE _CNV_A_R_LINEAR_____509_CM 1 100. 0. 0.3 DISPLAY_IDENTIFIER T_CHA_PER_S_1 ECU_ADDRESS 0xd0002ef7 FORMAT "%4.2" /end MEASUREMENT
/begin MEASUREMENT t_dcha_per_s_1 "Piezo IV discharge period for stratified mode first pulse" UBYTE _CNV_A_R_LINEAR_____509_CM 1 100. 0. 0.3 DISPLAY_IDENTIFIER T_DCHA_PER_S_1 ECU_ADDRESS 0xd0002efb FORMAT "%4.2" /end MEASUREMENT
/begin MEASUREMENT t_cha_per_s_2 "Piezo IV charge period for stratified mode second pulse" UBYTE _CNV_A_R_LINEAR_____509_CM 1 100. 0. 0.3 DISPLAY_IDENTIFIER T_CHA_PER_S_2 ECU_ADDRESS 0xd0002ef8 FORMAT "%4.2" /end MEASUREMENT
/begin MEASUREMENT t_dcha_per_s_2 "Piezo IV discharge period for stratified mode second pulse" UBYTE _CNV_A_R_LINEAR_____509_CM 1 100. 0. 0.3 DISPLAY_IDENTIFIER T_DCHA_PER_S_2 ECU_ADDRESS 0xd0002efc FORMAT "%4.2" /end MEASUREMENT
/begin MEASUREMENT t_cha_per_post "Piezo IV charge period for post injection pulse" UBYTE _CNV_A_R_LINEAR_____509_CM 1 100. 0. 0.3 DISPLAY_IDENTIFIER T_CHA_PER_POST ECU_ADDRESS 0xd0002ef6 FORMAT "%4.2" /end MEASUREMENT
/begin MEASUREMENT t_dcha_per_post "Piezo IV discharge period for post injection pulse" UBYTE _CNV_A_R_LINEAR_____509_CM 1 100. 0. 0.3 DISPLAY_IDENTIFIER T_DCHA_PER_POST ECU_ADDRESS 0xd0002efa FORMAT "%4.2" /end MEASUREMENT
/begin MEASUREMENT t_cha_per_hom "Piezo IV charge period for homogeneous mode" UBYTE _CNV_A_R_LINEAR_____509_CM 1 100. 0. 0.3 DISPLAY_IDENTIFIER T_CHA_PER_HOM ECU_ADDRESS 0xd0002ef5 FORMAT "%4.2" /end MEASUREMENT
/begin MEASUREMENT egy_step_inj_cha_grd_lim_not[0] "Unlimited piezo injector energy charge gradient for a single step" UWORD _CNV_A_R_INJR_LINEA_480_CM 1 100. 0. 100. DISPLAY_IDENTIFIER EGY_STEP_INJ_CHA_GRD_LIM_NOT[0] ECU_ADDRESS 0xc000238c FORMAT "%7.3" /end MEASUREMENT
/begin MEASUREMENT egy_step_inj_cha_grd_lim_not[1] "Unlimited piezo injector energy charge gradient for a single step" UWORD _CNV_A_R_INJR_LINEA_480_CM 1 100. 0. 100. DISPLAY_IDENTIFIER EGY_STEP_INJ_CHA_GRD_LIM_NOT[1] ECU_ADDRESS 0xc000238e FORMAT "%7.3" /end MEASUREMENT
/begin MEASUREMENT egy_step_inj_cha_grd_lim_not[2] "Unlimited piezo injector energy charge gradient for a single step" UWORD _CNV_A_R_INJR_LINEA_480_CM 1 100. 0. 100. DISPLAY_IDENTIFIER EGY_STEP_INJ_CHA_GRD_LIM_NOT[2] ECU_ADDRESS 0xc0002390 FORMAT "%7.3" /end MEASUREMENT
/begin MEASUREMENT egy_step_inj_cha_grd_lim_not[3] "Unlimited piezo injector energy charge gradient for a single step" UWORD _CNV_A_R_INJR_LINEA_480_CM 1 100. 0. 100. DISPLAY_IDENTIFIER EGY_STEP_INJ_CHA_GRD_LIM_NOT[3] ECU_ADDRESS 0xc0002392 FORMAT "%7.3" /end MEASUREMENT
/begin MEASUREMENT egy_step_inj_cha_grd_lim_not[4] "Unlimited piezo injector energy charge gradient for a single step" UWORD _CNV_A_R_INJR_LINEA_480_CM 1 100. 0. 100. DISPLAY_IDENTIFIER EGY_STEP_INJ_CHA_GRD_LIM_NOT[4] ECU_ADDRESS 0xc0002394 FORMAT "%7.3" /end MEASUREMENT
/begin MEASUREMENT egy_step_inj_cha_grd_lim_not[5] "Unlimited piezo injector energy charge gradient for a single step" UWORD _CNV_A_R_INJR_LINEA_480_CM 1 100. 0. 100. DISPLAY_IDENTIFIER EGY_STEP_INJ_CHA_GRD_LIM_NOT[5] ECU_ADDRESS 0xc0002396 FORMAT "%7.3" /end MEASUREMENT
/begin MEASUREMENT egy_step_inj_cha_grd_dif_hom[0] "Piezo injector energy charge gradient abundance for a single step - homogenous operation" SWORD _CNV_A_R_INJR_LINEA_480_CM 1 100. -50. 50. DISPLAY_IDENTIFIER EGY_STEP_INJ_CHA_GRD_DIF_HOM[0] ECU_ADDRESS 0xc0002374 FORMAT "%7.3" /end MEASUREMENT
/begin MEASUREMENT egy_step_inj_cha_grd_dif_hom[1] "Piezo injector energy charge gradient abundance for a single step - homogenous operation" SWORD _CNV_A_R_INJR_LINEA_480_CM 1 100. -50. 50. DISPLAY_IDENTIFIER EGY_STEP_INJ_CHA_GRD_DIF_HOM[1] ECU_ADDRESS 0xc0002376 FORMAT "%7.3" /end MEASUREMENT
/begin MEASUREMENT egy_step_inj_cha_grd_dif_hom[2] "Piezo injector energy charge gradient abundance for a single step - homogenous operation" SWORD _CNV_A_R_INJR_LINEA_480_CM 1 100. -50. 50. DISPLAY_IDENTIFIER EGY_STEP_INJ_CHA_GRD_DIF_HOM[2] ECU_ADDRESS 0xc0002378 FORMAT "%7.3" /end MEASUREMENT
/begin MEASUREMENT egy_step_inj_cha_grd_dif_hom[3] "Piezo injector energy charge gradient abundance for a single step - homogenous operation" SWORD _CNV_A_R_INJR_LINEA_480_CM 1 100. -50. 50. DISPLAY_IDENTIFIER EGY_STEP_INJ_CHA_GRD_DIF_HOM[3] ECU_ADDRESS 0xc000237a FORMAT "%7.3" /end MEASUREMENT
/begin MEASUREMENT egy_step_inj_cha_grd_dif_hom[4] "Piezo injector energy charge gradient abundance for a single step - homogenous operation" SWORD _CNV_A_R_INJR_LINEA_480_CM 1 100. -50. 50. DISPLAY_IDENTIFIER EGY_STEP_INJ_CHA_GRD_DIF_HOM[4] ECU_ADDRESS 0xc000237c FORMAT "%7.3" /end MEASUREMENT
/begin MEASUREMENT egy_step_inj_cha_grd_dif_hom[5] "Piezo injector energy charge gradient abundance for a single step - homogenous operation" SWORD _CNV_A_R_INJR_LINEA_480_CM 1 100. -50. 50. DISPLAY_IDENTIFIER EGY_STEP_INJ_CHA_GRD_DIF_HOM[5] ECU_ADDRESS 0xc000237e FORMAT "%7.3" /end MEASUREMENT
/begin MEASUREMENT fac_egy_dif_hom[0] "Energy-level-difference factor - homogenous operation" UWORD _CNV_A_R_INJR_LINEA_540_CM 1 100. -50. 50. DISPLAY_IDENTIFIER FAC_EGY_DIF_HOM[0] ECU_ADDRESS 0xc000239c FORMAT "%7.3" /end MEASUREMENT
/begin MEASUREMENT fac_egy_dif_hom[1] "Energy-level-difference factor - homogenous operation" UWORD _CNV_A_R_INJR_LINEA_540_CM 1 100. -50. 50. DISPLAY_IDENTIFIER FAC_EGY_DIF_HOM[1] ECU_ADDRESS 0xc000239e FORMAT "%7.3" /end MEASUREMENT
/begin MEASUREMENT fac_egy_dif_hom[2] "Energy-level-difference factor - homogenous operation" UWORD _CNV_A_R_INJR_LINEA_540_CM 1 100. -50. 50. DISPLAY_IDENTIFIER FAC_EGY_DIF_HOM[2] ECU_ADDRESS 0xc00023a0 FORMAT "%7.3" /end MEASUREMENT
/begin MEASUREMENT fac_egy_dif_hom[3] "Energy-level-difference factor - homogenous operation" UWORD _CNV_A_R_INJR_LINEA_540_CM 1 100. -50. 50. DISPLAY_IDENTIFIER FAC_EGY_DIF_HOM[3] ECU_ADDRESS 0xc00023a2 FORMAT "%7.3" /end MEASUREMENT
/begin MEASUREMENT fac_egy_dif_hom[4] "Energy-level-difference factor - homogenous operation" UWORD _CNV_A_R_INJR_LINEA_540_CM 1 100. -50. 50. DISPLAY_IDENTIFIER FAC_EGY_DIF_HOM[4] ECU_ADDRESS 0xc00023a4 FORMAT "%7.3" /end MEASUREMENT
/begin MEASUREMENT fac_egy_dif_hom[5] "Energy-level-difference factor - homogenous operation" UWORD _CNV_A_R_INJR_LINEA_540_CM 1 100. -50. 50. DISPLAY_IDENTIFIER FAC_EGY_DIF_HOM[5] ECU_ADDRESS 0xc00023a6 FORMAT "%7.3" /end MEASUREMENT
/begin MEASUREMENT egy_step_inj_cha_grd_dif_s[0] "Piezo injector energy charge gradient abundance for a single step - stratified operation" SWORD _CNV_A_R_INJR_LINEA_480_CM 1 100. -50. 50. DISPLAY_IDENTIFIER EGY_STEP_INJ_CHA_GRD_DIF_S[0] ECU_ADDRESS 0xc0002380 FORMAT "%7.3" /end MEASUREMENT
/begin MEASUREMENT egy_step_inj_cha_grd_dif_s[1] "Piezo injector energy charge gradient abundance for a single step - stratified operation" SWORD _CNV_A_R_INJR_LINEA_480_CM 1 100. -50. 50. DISPLAY_IDENTIFIER EGY_STEP_INJ_CHA_GRD_DIF_S[1] ECU_ADDRESS 0xc0002382 FORMAT "%7.3" /end MEASUREMENT
/begin MEASUREMENT egy_step_inj_cha_grd_dif_s[2] "Piezo injector energy charge gradient abundance for a single step - stratified operation" SWORD _CNV_A_R_INJR_LINEA_480_CM 1 100. -50. 50. DISPLAY_IDENTIFIER EGY_STEP_INJ_CHA_GRD_DIF_S[2] ECU_ADDRESS 0xc0002384 FORMAT "%7.3" /end MEASUREMENT
/begin MEASUREMENT egy_step_inj_cha_grd_dif_s[3] "Piezo injector energy charge gradient abundance for a single step - stratified operation" SWORD _CNV_A_R_INJR_LINEA_480_CM 1 100. -50. 50. DISPLAY_IDENTIFIER EGY_STEP_INJ_CHA_GRD_DIF_S[3] ECU_ADDRESS 0xc0002386 FORMAT "%7.3" /end MEASUREMENT
/begin MEASUREMENT egy_step_inj_cha_grd_dif_s[4] "Piezo injector energy charge gradient abundance for a single step - stratified operation" SWORD _CNV_A_R_INJR_LINEA_480_CM 1 100. -50. 50. DISPLAY_IDENTIFIER EGY_STEP_INJ_CHA_GRD_DIF_S[4] ECU_ADDRESS 0xc0002388 FORMAT "%7.3" /end MEASUREMENT
/begin MEASUREMENT egy_step_inj_cha_grd_dif_s[5] "Piezo injector energy charge gradient abundance for a single step - stratified operation" SWORD _CNV_A_R_INJR_LINEA_480_CM 1 100. -50. 50. DISPLAY_IDENTIFIER EGY_STEP_INJ_CHA_GRD_DIF_S[5] ECU_ADDRESS 0xc000238a FORMAT "%7.3" /end MEASUREMENT
/begin MEASUREMENT fac_egy_dif_s[0] "Energy-level-difference factor - stratified operation" UWORD _CNV_A_R_INJR_LINEA_540_CM 1 100. -50. 50. DISPLAY_IDENTIFIER FAC_EGY_DIF_S[0] ECU_ADDRESS 0xc00023a8 FORMAT "%7.3" /end MEASUREMENT
/begin MEASUREMENT fac_egy_dif_s[1] "Energy-level-difference factor - stratified operation" UWORD _CNV_A_R_INJR_LINEA_540_CM 1 100. -50. 50. DISPLAY_IDENTIFIER FAC_EGY_DIF_S[1] ECU_ADDRESS 0xc00023aa FORMAT "%7.3" /end MEASUREMENT
/begin MEASUREMENT fac_egy_dif_s[2] "Energy-level-difference factor - stratified operation" UWORD _CNV_A_R_INJR_LINEA_540_CM 1 100. -50. 50. DISPLAY_IDENTIFIER FAC_EGY_DIF_S[2] ECU_ADDRESS 0xc00023ac FORMAT "%7.3" /end MEASUREMENT
/begin MEASUREMENT fac_egy_dif_s[3] "Energy-level-difference factor - stratified operation" UWORD _CNV_A_R_INJR_LINEA_540_CM 1 100. -50. 50. DISPLAY_IDENTIFIER FAC_EGY_DIF_S[3] ECU_ADDRESS 0xc00023ae FORMAT "%7.3" /end MEASUREMENT
/begin MEASUREMENT fac_egy_dif_s[4] "Energy-level-difference factor - stratified operation" UWORD _CNV_A_R_INJR_LINEA_540_CM 1 100. -50. 50. DISPLAY_IDENTIFIER FAC_EGY_DIF_S[4] ECU_ADDRESS 0xc00023b0 FORMAT "%7.3" /end MEASUREMENT
/begin MEASUREMENT fac_egy_dif_s[5] "Energy-level-difference factor - stratified operation" UWORD _CNV_A_R_INJR_LINEA_540_CM 1 100. -50. 50. DISPLAY_IDENTIFIER FAC_EGY_DIF_S[5] ECU_ADDRESS 0xc00023b2 FORMAT "%7.3" /end MEASUREMENT
/begin MEASUREMENT fac_mff_dif_s[0] "MFF-difference factor - stratified operation" UWORD _CNV_A_R_LINEAR_____249_CM 1 100. -1. 0.99996948 DISPLAY_IDENTIFIER FAC_MFF_DIF_S[0] ECU_ADDRESS 0xc00023b4 FORMAT "%8.5" /end MEASUREMENT
/begin MEASUREMENT fac_mff_dif_s[1] "MFF-difference factor - stratified operation" UWORD _CNV_A_R_LINEAR_____249_CM 1 100. -1. 0.99996948 DISPLAY_IDENTIFIER FAC_MFF_DIF_S[1] ECU_ADDRESS 0xc00023b6 FORMAT "%8.5" /end MEASUREMENT
/begin MEASUREMENT fac_mff_dif_s[2] "MFF-difference factor - stratified operation" UWORD _CNV_A_R_LINEAR_____249_CM 1 100. -1. 0.99996948 DISPLAY_IDENTIFIER FAC_MFF_DIF_S[2] ECU_ADDRESS 0xc00023b8 FORMAT "%8.5" /end MEASUREMENT
/begin MEASUREMENT fac_mff_dif_s[3] "MFF-difference factor - stratified operation" UWORD _CNV_A_R_LINEAR_____249_CM 1 100. -1. 0.99996948 DISPLAY_IDENTIFIER FAC_MFF_DIF_S[3] ECU_ADDRESS 0xc00023ba FORMAT "%8.5" /end MEASUREMENT
/begin MEASUREMENT fac_mff_dif_s[4] "MFF-difference factor - stratified operation" UWORD _CNV_A_R_LINEAR_____249_CM 1 100. -1. 0.99996948 DISPLAY_IDENTIFIER FAC_MFF_DIF_S[4] ECU_ADDRESS 0xc00023bc FORMAT "%8.5" /end MEASUREMENT
/begin MEASUREMENT fac_mff_dif_s[5] "MFF-difference factor - stratified operation" UWORD _CNV_A_R_LINEAR_____249_CM 1 100. -1. 0.99996948 DISPLAY_IDENTIFIER FAC_MFF_DIF_S[5] ECU_ADDRESS 0xc00023be FORMAT "%8.5" /end MEASUREMENT
/begin CHARACTERISTIC c_ti_hys_iv_egy_rng "Injection time hysteresis for the selection of the injector energy range" VALUE 0xa1008a72 _REC_VAL_20_u2 65.535 _CNV_A_R_LINEAR_____233_CM 0. 65.535 DISPLAY_IDENTIFIER C_TI_HYS_IV_EGY_RNG /end CHARACTERISTIC
/begin CHARACTERISTIC c_egy_step_inj_cha_grd_max_hom "Upper threshold of energy charge gradient for a single step - homogenous operation" VALUE 0xa1008a0e _REC_VAL_20_u2 100. _CNV_A_R_INJR_LINEA_480_CM 0. 100. DISPLAY_IDENTIFIER C_EGY_STEP_INJ_CHA_GRD_MAX_HOM FORMAT "%7.3" /end CHARACTERISTIC
/begin CHARACTERISTIC c_egy_step_inj_cha_grd_min_hom "Lower threshold of energy charge gradient for a single step - homogenous operation" VALUE 0xa1008a12 _REC_VAL_20_u2 100. _CNV_A_R_INJR_LINEA_480_CM 0. 100. DISPLAY_IDENTIFIER C_EGY_STEP_INJ_CHA_GRD_MIN_HOM FORMAT "%7.3" /end CHARACTERISTIC
/begin CHARACTERISTIC c_egy_step_inj_cha_grd_max_s "Upper threshold of energy charge gradient for a single step - stratified operation" VALUE 0xa1008a10 _REC_VAL_20_u2 100. _CNV_A_R_INJR_LINEA_480_CM 0. 100. DISPLAY_IDENTIFIER C_EGY_STEP_INJ_CHA_GRD_MAX_S FORMAT "%7.3" /end CHARACTERISTIC
/begin CHARACTERISTIC c_egy_step_inj_cha_grd_min_s "Lower threshold of energy charge gradient for a single step - stratified operation" VALUE 0xa1008a14 _REC_VAL_20_u2 100. _CNV_A_R_INJR_LINEA_480_CM 0. 100. DISPLAY_IDENTIFIER C_EGY_STEP_INJ_CHA_GRD_MIN_S FORMAT "%7.3" /end CHARACTERISTIC
/begin MEASUREMENT mff_sp_2_tot_s[0] "Total MFF-setpoint corrected by MFF-difference factor - stratified operation (2. pulse)" UWORD _CNV_A_R_LINEAR_____108_CM 1 100. 0. 1389. DISPLAY_IDENTIFIER MFF_SP_2_TOT_S[0] ECU_ADDRESS 0xc00023d0 FORMAT "%7.2" /end MEASUREMENT
/begin MEASUREMENT mff_sp_2_tot_s[1] "Total MFF-setpoint corrected by MFF-difference factor - stratified operation (2. pulse)" UWORD _CNV_A_R_LINEAR_____108_CM 1 100. 0. 1389. DISPLAY_IDENTIFIER MFF_SP_2_TOT_S[1] ECU_ADDRESS 0xc00023d2 FORMAT "%7.2" /end MEASUREMENT
/begin MEASUREMENT mff_sp_2_tot_s[2] "Total MFF-setpoint corrected by MFF-difference factor - stratified operation (2. pulse)" UWORD _CNV_A_R_LINEAR_____108_CM 1 100. 0. 1389. DISPLAY_IDENTIFIER MFF_SP_2_TOT_S[2] ECU_ADDRESS 0xc00023d4 FORMAT "%7.2" /end MEASUREMENT
/begin MEASUREMENT mff_sp_2_tot_s[3] "Total MFF-setpoint corrected by MFF-difference factor - stratified operation (2. pulse)" UWORD _CNV_A_R_LINEAR_____108_CM 1 100. 0. 1389. DISPLAY_IDENTIFIER MFF_SP_2_TOT_S[3] ECU_ADDRESS 0xc00023d6 FORMAT "%7.2" /end MEASUREMENT
/begin MEASUREMENT mff_sp_2_tot_s[4] "Total MFF-setpoint corrected by MFF-difference factor - stratified operation (2. pulse)" UWORD _CNV_A_R_LINEAR_____108_CM 1 100. 0. 1389. DISPLAY_IDENTIFIER MFF_SP_2_TOT_S[4] ECU_ADDRESS 0xc00023d8 FORMAT "%7.2" /end MEASUREMENT
/begin MEASUREMENT mff_sp_2_tot_s[5] "Total MFF-setpoint corrected by MFF-difference factor - stratified operation (2. pulse)" UWORD _CNV_A_R_LINEAR_____108_CM 1 100. 0. 1389. DISPLAY_IDENTIFIER MFF_SP_2_TOT_S[5] ECU_ADDRESS 0xc00023da FORMAT "%7.2" /end MEASUREMENT
/begin MEASUREMENT mff_sp_1_tot_s[0] "Total MFF-setpoint corrected by MFF-difference factor - stratified operation (1. pulse)" UWORD _CNV_A_R_LINEAR_____108_CM 1 100. 0. 1389. DISPLAY_IDENTIFIER MFF_SP_1_TOT_S[0] ECU_ADDRESS 0xc00023c4 FORMAT "%7.2" /end MEASUREMENT
/begin MEASUREMENT mff_sp_1_tot_s[1] "Total MFF-setpoint corrected by MFF-difference factor - stratified operation (1. pulse)" UWORD _CNV_A_R_LINEAR_____108_CM 1 100. 0. 1389. DISPLAY_IDENTIFIER MFF_SP_1_TOT_S[1] ECU_ADDRESS 0xc00023c6 FORMAT "%7.2" /end MEASUREMENT
/begin MEASUREMENT mff_sp_1_tot_s[2] "Total MFF-setpoint corrected by MFF-difference factor - stratified operation (1. pulse)" UWORD _CNV_A_R_LINEAR_____108_CM 1 100. 0. 1389. DISPLAY_IDENTIFIER MFF_SP_1_TOT_S[2] ECU_ADDRESS 0xc00023c8 FORMAT "%7.2" /end MEASUREMENT
/begin MEASUREMENT mff_sp_1_tot_s[3] "Total MFF-setpoint corrected by MFF-difference factor - stratified operation (1. pulse)" UWORD _CNV_A_R_LINEAR_____108_CM 1 100. 0. 1389. DISPLAY_IDENTIFIER MFF_SP_1_TOT_S[3] ECU_ADDRESS 0xc00023ca FORMAT "%7.2" /end MEASUREMENT
/begin MEASUREMENT mff_sp_1_tot_s[4] "Total MFF-setpoint corrected by MFF-difference factor - stratified operation (1. pulse)" UWORD _CNV_A_R_LINEAR_____108_CM 1 100. 0. 1389. DISPLAY_IDENTIFIER MFF_SP_1_TOT_S[4] ECU_ADDRESS 0xc00023cc FORMAT "%7.2" /end MEASUREMENT
/begin MEASUREMENT mff_sp_1_tot_s[5] "Total MFF-setpoint corrected by MFF-difference factor - stratified operation (1. pulse)" UWORD _CNV_A_R_LINEAR_____108_CM 1 100. 0. 1389. DISPLAY_IDENTIFIER MFF_SP_1_TOT_S[5] ECU_ADDRESS 0xc00023ce FORMAT "%7.2" /end MEASUREMENT
/begin MEASUREMENT egy_add_temp "Additive piezo energy correction depending on the injector temperature" SWORD _CNV_A_R_INJR_LINEA_480_CM 1 100. -50. 50. DISPLAY_IDENTIFIER EGY_ADD_TEMP ECU_ADDRESS 0xd0002a74 FORMAT "%7.3" /end MEASUREMENT
/begin AXIS_PTS ldp_tfu_inj_ip_egy_add_temp "" 0xa100829c tfu_inj _REC_AXS_20_u1 190.5 _CNV_A_R_LINEAR_____16_CM 8 -48. 142.5 FORMAT "%6.2" /end AXIS_PTS
/begin CHARACTERISTIC ip_egy_add_temp "Additive piezo energy correction depending on the injector temperature" CURVE 0xa1008348 _REC_CUR_20_u2_u1 100. _CNV_A_R_INJR_LINEA_540_CM -50. 50. DISPLAY_IDENTIFIER IP_EGY_ADD_TEMP FORMAT "%7.3"
 /begin AXIS_DESCR COM_AXIS tfu_inj _CNV_A_R_LINEAR_____16_CM 8 -48. 142.5 FORMAT "%6.2" AXIS_PTS_REF ldp_tfu_inj_ip_egy_add_temp /end AXIS_DESCR
/end CHARACTERISTIC
/begin CHARACTERISTIC c_delta_t_min_dui "least time between two injections" VALUE 0xa1008a08 _REC_VAL_20_u2 65.535 _CNV_A_R_LINEAR_____233_CM 0. 65.535 DISPLAY_IDENTIFIER C_DELTA_T_MIN_DUI /end CHARACTERISTIC
/begin CHARACTERISTIC c_eoi_2_hom_man "Manual setpoit for EOI" VALUE 0xa1008a1a _REC_VAL_20_u2 720. _CNV_A_R_LINEAR_____168_CM 0. 720. DISPLAY_IDENTIFIER C_EOI_2_HOM_MAN FORMAT "%7.3" /end CHARACTERISTIC
/begin CHARACTERISTIC lc_eoi_2_hom_man "switch for using the manual setpoit for EOI" VALUE 0xa1008a7d _REC_VAL_20_u1 1. _CNV_A_R_LINEAR_____0_CM 0. 1. DISPLAY_IDENTIFIER LC_EOI_2_HOM_MAN FORMAT "%1.0" /end CHARACTERISTIC
/begin MEASUREMENT soi_2_hom "Start of injection of the second injection for homogeneous combustion, cylinder 0" UWORD _CNV_A_R_LINEAR_____168_CM 1 100. 0. 720. DISPLAY_IDENTIFIER SOI_2_HOM ECU_ADDRESS 0xc00023e2 FORMAT "%7.3" /end MEASUREMENT
/begin MEASUREMENT eoi_1_soi_2_gap_hom "Gap between the two latest calculated injections at cylinder 0" UWORD _CNV_A_R_LINEAR_____168_CM 1 100. 0. 720. DISPLAY_IDENTIFIER EOI_1_SOI_2_GAP_HOM ECU_ADDRESS 0xc0002398 FORMAT "%7.3" /end MEASUREMENT
/begin CHARACTERISTIC lc_eoi_1_s_man "Global application assistance switch passive/active for the first injection" VALUE 0xa1008a7c _REC_VAL_20_u1 1. _CNV_A_R_LINEAR_____0_CM 0. 1. DISPLAY_IDENTIFIER LC_EOI_1_S_MAN FORMAT "%1.0" /end CHARACTERISTIC
/begin CHARACTERISTIC c_eoi_1_s_man "Global application assistance for the first injection " VALUE 0xa1008a18 _REC_VAL_20_u2 720. _CNV_A_R_LINEAR_____168_CM 0. 720. DISPLAY_IDENTIFIER C_EOI_1_S_MAN FORMAT "%7.3" /end CHARACTERISTIC
/begin COMPU_METHOD _CNV_A_R_LINEAR_____0_CM "" RAT_FUNC "%6.3" "-" COEFFS 0 1. 0. 0 0 1 /end COMPU_METHOD
/begin COMPU_METHOD _CNV_S_2_RANGE__0___1_CM "" TAB_VERB "%6.3" "-" COMPU_TAB_REF _CNV_S_2_RANGE__0___1 /end COMPU_METHOD
/begin COMPU_VTAB _CNV_S_2_RANGE__0___1 "" TAB_VERB 2 0 "0" 1 "1" /end COMPU_VTAB
/begin COMPU_METHOD _CNV_A_R_LINEAR_____8_CM "" RAT_FUNC "%6.3" "-" COEFFS 0 32767.99999999992 0. 0 0 1 /end COMPU_METHOD
/begin COMPU_METHOD _CNV_A_R_LINEAR_____9_CM "" RAT_FUNC "%6.3" "rpm" COEFFS 0 3.125e-002 0. 0 0 1 /end COMPU_METHOD
/begin COMPU_METHOD _CNV_A_R_LINEAR_____16_CM "" RAT_FUNC "%6.3" "°C" COEFFS 0 1.333333333333333 64. 0 0 1 /end COMPU_METHOD
/begin COMPU_METHOD _CNV_A_R_LINEAR_____18_CM "" RAT_FUNC "%6.3" "ms" COEFFS 0 0.1 0. 0 0 1 /end COMPU_METHOD
/begin COMPU_METHOD _CNV_A_R_LINEAR_____100_CM "" RAT_FUNC "%6.3" "-" COEFFS 0 128. 0. 0 0 1 /end COMPU_METHOD
/begin COMPU_METHOD _CNV_A_R_LINEAR_____108_CM "" RAT_FUNC "%6.3" "mg/stk" COEFFS 0 47.18142548596112 0. 0 0 1 /end COMPU_METHOD
/begin COMPU_METHOD _CNV_A_R_LINEAR_____111_CM "" RAT_FUNC "%6.3" "ms" COEFFS 0 250. 0. 0 0 1 /end COMPU_METHOD
/begin COMPU_METHOD _CNV_A_R_LINEAR_____115_CM "" RAT_FUNC "%6.3" "-" COEFFS 0 4096. 0. 0 0 1 /end COMPU_METHOD
/begin COMPU_METHOD _CNV_A_R_LINEAR_____152_CM "" RAT_FUNC "%6.3" "hPa" COEFFS 0 0.1884402603974972 0. 0 0 1 /end COMPU_METHOD
/begin COMPU_METHOD _CNV_A_R_LINEAR_____168_CM "" RAT_FUNC "%6.3" "°CRK" COEFFS 0 2.666666666666667 0. 0 0 1 /end COMPU_METHOD
/begin COMPU_METHOD _CNV_A_R_LINEAR_____195_CM "" RAT_FUNC "%6.3" "V" COEFFS 0 51.2 0. 0 0 1 /end COMPU_METHOD
/begin COMPU_METHOD _CNV_A_R_LINEAR_____233_CM "" RAT_FUNC "%6.3" "ms" COEFFS 0 1000. 0. 0 0 1 /end COMPU_METHOD
/begin COMPU_METHOD _CNV_A_R_LINEAR_____249_CM "" RAT_FUNC "%6.3" "-" COEFFS 0 32768.00003968061 32768.00003968061 0 0 1 /end COMPU_METHOD
/begin COMPU_METHOD _CNV_A_R_INJR_LINEA_472_CM "" RAT_FUNC "%6.3" "s" COEFFS 0 100. -1. 0 0 1 /end COMPU_METHOD
/begin COMPU_METHOD _CNV_S_2_INJR_RANGE_475_CM "" TAB_VERB "%6.3" "-" COMPU_TAB_REF _CNV_S_2_INJR_RANGE_475 /end COMPU_METHOD
/begin COMPU_VTAB _CNV_S_2_INJR_RANGE_475 "" TAB_VERB 2 0 "IMMEDIATE" 1 "AUTONOMOUS" /end COMPU_VTAB
/begin COMPU_METHOD _CNV_A_R_INJR_LINEA_477_CM "" RAT_FUNC "%6.3" "uAs" COEFFS 0 0.4501260352898812 0. 0 0 1 /end COMPU_METHOD
/begin COMPU_METHOD _CNV_A_R_INJR_LINEA_478_CM "" RAT_FUNC "%6.3" "mJ" COEFFS 0 257. 0. 0 0 1 /end COMPU_METHOD
/begin COMPU_METHOD _CNV_A_R_INJR_LINEA_479_CM "" RAT_FUNC "%6.3" "uF" COEFFS 0 2343.884120171674 0. 0 0 1 /end COMPU_METHOD
/begin COMPU_METHOD _CNV_A_R_INJR_LINEA_480_CM "" RAT_FUNC "%6.3" "%" COEFFS 0 163.84 0. 0 0 1 /end COMPU_METHOD
/begin COMPU_METHOD _CNV_A_R_INJR_LINEA_481_CM "" RAT_FUNC "%6.3" "°CRK" COEFFS 0 2.666666666666667 960. 0 0 1 /end COMPU_METHOD
/begin COMPU_METHOD _CNV_A_R_LINEAR_____509_CM "" RAT_FUNC "%6.3" "ms" COEFFS 0 100. 0. 0 0 1 /end COMPU_METHOD
/begin COMPU_METHOD _CNV_A_R_INJR_LINEA_540_CM "" RAT_FUNC "%6.3" "%" COEFFS 0 163.84 8192. 0 0 1 /end COMPU_METHOD
/begin RECORD_LAYOUT _REC_VAL_20_u1 FNC_VALUES 1 UBYTE COLUMN_DIR DIRECT /end RECORD_LAYOUT
/begin RECORD_LAYOUT _REC_VAL_20_u2 FNC_VALUES 1 UWORD COLUMN_DIR DIRECT /end RECORD_LAYOUT
/begin RECORD_LAYOUT _REC_AXS_20_u1 NO_AXIS_PTS_X 1 UBYTE AXIS_PTS_X 2 UBYTE INDEX_INCR DIRECT /end RECORD_LAYOUT
/begin RECORD_LAYOUT _REC_CUR_20_u1_u1 FNC_VALUES 1 UBYTE COLUMN_DIR DIRECT /end RECORD_LAYOUT
/begin RECORD_LAYOUT _REC_VAL_20_s2 FNC_VALUES 1 SWORD COLUMN_DIR DIRECT /end RECORD_LAYOUT
/begin RECORD_LAYOUT _REC_AXS_20_u2 NO_AXIS_PTS_X 1 UWORD AXIS_PTS_X 2 UWORD INDEX_INCR DIRECT /end RECORD_LAYOUT
/begin RECORD_LAYOUT _REC_CUR_20_u2_u1 FNC_VALUES 1 UWORD COLUMN_DIR DIRECT /end RECORD_LAYOUT
/begin RECORD_LAYOUT _REC_CUR_20_u2_u2 FNC_VALUES 1 UWORD COLUMN_DIR DIRECT /end RECORD_LAYOUT
/begin RECORD_LAYOUT _REC_MAP_20_u2_u2_u2 FNC_VALUES 1 UWORD COLUMN_DIR DIRECT /end RECORD_LAYOUT
/begin FUNCTION INJR_Final_Injection_Timing ""
 /begin DEF_CHARACTERISTIC c_t_auth_ti_min_afl lc_ti_2_s_man_act lc_ti_1_s_man_act c_ti_2_s_man lc_ti_1_hom_man_act lc_ti_2_hom_man_act c_ti_1_hom_man c_ti_2_hom_man ip_ti_min_hom ip_ti_min_s ip_mff_ti_stnd_egy_h ip_mff_ti_stnd_egy_l c_ti_1_s_man c_ti_min_ofs c_ti_min_hys_s ip_fac_ti_2_s_dly_cor ip_fac_ti_2_s_cor ldp_t_dly_1_2_s_ip_fac_ti_2_s ldp_ti_2_s_ip_fac_ti_2_s_cor /end DEF_CHARACTERISTIC
 /begin OUT_MEASUREMENT lv_ti_1_hom_min lv_auth_ti_min_afl lv_ti_2_hom_min lv_auth_ti_min_s lv_ti_2_s_min lv_ti_1_s_min ti_2_hom_clc_min ti_1_hom_clc_min ti_1_hom_clc_max ti_2_hom_clc_max ti_1_s_clc_min ti_2_s_clc_min ti_min_hom ti_min_s fac_ti_2_s_dly_cor fac_ti_2_s_cor injr.STR_INJR_ACCTLFINAL0.ti_1_hom[0] injr.STR_INJR_ACCTLFINAL0.ti_1_hom[1] injr.STR_INJR_ACCTLFINAL0.ti_1_hom[2] injr.STR_INJR_ACCTLFINAL0.ti_1_hom[3] injr.STR_INJR_ACCTLFINAL0.ti_1_hom[4] injr.STR_INJR_ACCTLFINAL0.ti_1_hom[5] injr.STR_INJR_ACCTLFINAL0.ti_1_hom_clc[0] injr.STR_INJR_ACCTLFINAL0.ti_1_hom_clc[1] injr.STR_INJR_ACCTLFINAL0.ti_1_hom_clc[2] injr.STR_INJR_ACCTLFINAL0.ti_1_hom_clc[3] injr.STR_INJR_ACCTLFINAL0.ti_1_hom_clc[4] injr.STR_INJR_ACCTLFINAL0.ti_1_hom_clc[5] injr.STR_INJR_ACCTLFINAL0.ti_2_hom[0] injr.STR_INJR_ACCTLFINAL0.ti_2_hom[1] injr.STR_INJR_ACCTLFINAL0.ti_2_hom[2] injr.STR_INJR_ACCTLFINAL0.ti_2_hom[3] injr.STR_INJR_ACCTLFINAL0.ti_2_hom[4] injr.STR_INJR_ACCTLFINAL0.ti_2_hom[5] injr.STR_INJR_ACCTLFINAL0.ti_2_hom_clc[0] injr.STR_INJR_ACCTLFINAL0.ti_2_hom_clc[1] injr.STR_INJR_ACCTLFINAL0.ti_2_hom_clc[2] injr.STR_INJR_ACCTLFINAL0.ti_2_hom_clc[3] injr.STR_INJR_ACCTLFINAL0.ti_2_hom_clc[4] injr.STR_INJR_ACCTLFINAL0.ti_2_hom_clc[5] injr.STR_INJR_ACCTLFINAL0.ti_1_s[0] injr.STR_INJR_ACCTLFINAL0.ti_1_s[1] injr.STR_INJR_ACCTLFINAL0.ti_1_s[2] injr.STR_INJR_ACCTLFINAL0.ti_1_s[3] injr.STR_INJR_ACCTLFINAL0.ti_1_s[4] injr.STR_INJR_ACCTLFINAL0.ti_1_s[5] injr.STR_INJR_ACCTLFINAL0.ti_2_s[0] injr.STR_INJR_ACCTLFINAL0.ti_2_s[1] injr.STR_INJR_ACCTLFINAL0.ti_2_s[2] injr.STR_INJR_ACCTLFINAL0.ti_2_s[3] injr.STR_INJR_ACCTLFINAL0.ti_2_s[4] injr.STR_INJR_ACCTLFINAL0.ti_2_s[5] injr.STR_INJR_ACCTLFINAL0.ti_1_s_clc[0] injr.STR_INJR_ACCTLFINAL0.ti_1_s_clc[1] injr.STR_INJR_ACCTLFINAL0.ti_1_s_clc[2] injr.STR_INJR_ACCTLFINAL0.ti_1_s_clc[3] injr.STR_INJR_ACCTLFINAL0.ti_1_s_clc[4] injr.STR_INJR_ACCTLFINAL0.ti_1_s_clc[5] injr.STR_INJR_ACCTLFINAL0.ti_2_s_clc[0] injr.STR_INJR_ACCTLFINAL0.ti_2_s_clc[1] injr.STR_INJR_ACCTLFINAL0.ti_2_s_clc[2] injr.STR_INJR_ACCTLFINAL0.ti_2_s_clc[3] injr.STR_INJR_ACCTLFINAL0.ti_2_s_clc[4] injr.STR_INJR_ACCTLFINAL0.ti_2_s_clc[5] injr.STR_INJR_ACCTLFINAL0.ti_1_stnd_hom[0] injr.STR_INJR_ACCTLFINAL0.ti_1_stnd_hom[1] injr.STR_INJR_ACCTLFINAL0.ti_1_stnd_hom[2] injr.STR_INJR_ACCTLFINAL0.ti_1_stnd_hom[3] injr.STR_INJR_ACCTLFINAL0.ti_1_stnd_hom[4] injr.STR_INJR_ACCTLFINAL0.ti_1_stnd_hom[5] injr.STR_INJR_ACCTLFINAL0.ti_2_stnd_hom[0] injr.STR_INJR_ACCTLFINAL0.ti_2_stnd_hom[1] injr.STR_INJR_ACCTLFINAL0.ti_2_stnd_hom[2] injr.STR_INJR_ACCTLFINAL0.ti_2_stnd_hom[3] injr.STR_INJR_ACCTLFINAL0.ti_2_stnd_hom[4] injr.STR_INJR_ACCTLFINAL0.ti_2_stnd_hom[5] injr.STR_INJR_ACCTLFINAL0.mff_sp_1_hom_cor_inj[0] injr.STR_INJR_ACCTLFINAL0.mff_sp_1_hom_cor_inj[1] injr.STR_INJR_ACCTLFINAL0.mff_sp_1_hom_cor_inj[2] injr.STR_INJR_ACCTLFINAL0.mff_sp_1_hom_cor_inj[3] injr.STR_INJR_ACCTLFINAL0.mff_sp_1_hom_cor_inj[4] injr.STR_INJR_ACCTLFINAL0.mff_sp_1_hom_cor_inj[5] injr.STR_INJR_ACCTLFINAL0.mff_sp_2_hom_cor_inj[0] injr.STR_INJR_ACCTLFINAL0.mff_sp_2_hom_cor_inj[1] injr.STR_INJR_ACCTLFINAL0.mff_sp_2_hom_cor_inj[2] injr.STR_INJR_ACCTLFINAL0.mff_sp_2_hom_cor_inj[3] injr.STR_INJR_ACCTLFINAL0.mff_sp_2_hom_cor_inj[4] injr.STR_INJR_ACCTLFINAL0.mff_sp_2_hom_cor_inj[5] /end OUT_MEASUREMENT
/end FUNCTION
/begin FUNCTION INJR_Injection_phase_Appl_Inc ""
 /begin OUT_MEASUREMENT cam_shift_ex cam_shift_in eoi_2_hom_ext[0] eoi_2_hom_ext[1] eoi_2_hom_ext[2] eoi_2_hom_ext[3] eoi_2_hom_ext[4] eoi_2_hom_ext[5] soi_1_hom_ext[0] soi_1_hom_ext[1] soi_1_hom_ext[2] soi_1_hom_ext[3] soi_1_hom_ext[4] soi_1_hom_ext[5] eoi_1_s_ext[0] eoi_1_s_ext[1] eoi_1_s_ext[2] eoi_1_s_ext[3] eoi_1_s_ext[4] eoi_1_s_ext[5] eoi_2_s_ext[0] eoi_2_s_ext[1] eoi_2_s_ext[2] eoi_2_s_ext[3] eoi_2_s_ext[4] eoi_2_s_ext[5] soi_1_homs_ext[0] soi_1_homs_ext[1] soi_1_homs_ext[2] soi_1_homs_ext[3] soi_1_homs_ext[4] soi_1_homs_ext[5] eoi_2_homs_ext[0] eoi_2_homs_ext[1] eoi_2_homs_ext[2] eoi_2_homs_ext[3] eoi_2_homs_ext[4] eoi_2_homs_ext[5] /end OUT_MEASUREMENT
/end FUNCTION
/begin FUNCTION INJR_Injection_phase_strat_1st_pulse "" /begin DEF_CHARACTERISTIC lc_eoi_1_s_man c_eoi_1_s_man /end DEF_CHARACTERISTIC
 /begin OUT_MEASUREMENT injr.STR_INJR_REQGNS1P0.eoi_1_s[0] injr.STR_INJR_REQGNS1P0.eoi_1_s[1] injr.STR_INJR_REQGNS1P0.eoi_1_s[2] injr.STR_INJR_REQGNS1P0.eoi_1_s[3] injr.STR_INJR_REQGNS1P0.eoi_1_s[4] injr.STR_INJR_REQGNS1P0.eoi_1_s[5] injr.STR_INJR_REQGNS1P0.soi_1_s[0] injr.STR_INJR_REQGNS1P0.soi_1_s[1] injr.STR_INJR_REQGNS1P0.soi_1_s[2] injr.STR_INJR_REQGNS1P0.soi_1_s[3] injr.STR_INJR_REQGNS1P0.soi_1_s[4] injr.STR_INJR_REQGNS1P0.soi_1_s[5] /end OUT_MEASUREMENT
/end FUNCTION
/begin FUNCTION INJR_Injection_phase_strat_2nd_pulse "" /begin DEF_CHARACTERISTIC lc_eoi_2_s_man c_eoi_2_s_man /end DEF_CHARACTERISTIC
 /begin OUT_MEASUREMENT injr.STR_INJR_REQGNS2P0.eoi_2_s[0] injr.STR_INJR_REQGNS2P0.eoi_2_s[1] injr.STR_INJR_REQGNS2P0.eoi_2_s[2] injr.STR_INJR_REQGNS2P0.eoi_2_s[3] injr.STR_INJR_REQGNS2P0.eoi_2_s[4] injr.STR_INJR_REQGNS2P0.eoi_2_s[5] injr.STR_INJR_REQGNS2P0.soi_2_s[0] injr.STR_INJR_REQGNS2P0.soi_2_s[1] injr.STR_INJR_REQGNS2P0.soi_2_s[2] injr.STR_INJR_REQGNS2P0.soi_2_s[3] injr.STR_INJR_REQGNS2P0.soi_2_s[4] injr.STR_INJR_REQGNS2P0.soi_2_s[5] /end OUT_MEASUREMENT
/end FUNCTION
/begin FUNCTION INJR_Transfer_to_basic_sw ""
 /begin DEF_CHARACTERISTIC ip_fac_add_pulse ldp_n_32_ip_fac_add_pulse c_nr_cyl_ofs_inh_iv_dyn c_soi_ext_adj ip_ti_add_pulse_min lc_inj_pls_upd_mod ip_soi_inj_upd_psn ldp_n_32_ip_soi_inj_upd_psn /end DEF_CHARACTERISTIC
 /begin OUT_MEASUREMENT prev_state_iv inj_mod_global inh_iv_dyn crk_psn_eng_inj_upd state_inj_typ_mem_iv nr_cyl_ofs_inh_iv_dyn nr_cyl_inj_bas nr_cyl_inj_bas_prev state_inj_mod_swi_act inh_iv_mis_gen_ack lv_inj_crash_act_ack t_inj_crash_act lv_inj_crash_act_end state_inj_upd_mod_cyl_ack soi_inj_upd_psn injr.STR_INJR_IFINFTRANS0.str_injr_transfer_to_iosw.fac_add_pulse injr.STR_INJR_IFINFTRANS0.str_injr_transfer_to_iosw.ti_add_pulse_min injr.STR_INJR_IFINFTRANS0.str_injr_transfer_to_iosw.str_injr_transfer_to_iosw_cyl[0].lv_inh_inj injr.STR_INJR_IFINFTRANS0.str_injr_transfer_to_iosw.str_injr_transfer_to_iosw_cyl[0].lv_state_prev_iv injr.STR_INJR_IFINFTRANS0.str_injr_transfer_to_iosw.str_injr_transfer_to_iosw_cyl[0].lv_add_pulse injr.STR_INJR_IFINFTRANS0.str_injr_transfer_to_iosw.str_injr_transfer_to_iosw_cyl[0].inj_mod injr.STR_INJR_IFINFTRANS0.str_injr_transfer_to_iosw.str_injr_transfer_to_iosw_cyl[0].ctr_inh_iv_mis_gen injr.STR_INJR_IFINFTRANS0.str_injr_transfer_to_iosw.str_injr_transfer_to_iosw_cyl[0].lv_inj_mplp_cyl injr.STR_INJR_IFINFTRANS0.str_injr_transfer_to_iosw.str_injr_transfer_to_iosw_cyl[0].ctr_test_mod_iv injr.STR_INJR_IFINFTRANS0.str_injr_transfer_to_iosw.str_injr_transfer_to_iosw_cyl[0].inj_mod_sp injr.STR_INJR_IFINFTRANS0.str_injr_transfer_to_iosw.str_injr_transfer_to_iosw_cyl[0].lv_inj_upd_ack injr.STR_INJR_IFINFTRANS0.str_injr_transfer_to_iosw.str_injr_transfer_to_iosw_cyl[0].str_injr_transfer_to_iosw_pls[0].soi_mes injr.STR_INJR_IFINFTRANS0.str_injr_transfer_to_iosw.str_injr_transfer_to_iosw_cyl[0].str_injr_transfer_to_iosw_pls[0].eoi_mes injr.STR_INJR_IFINFTRANS0.str_injr_transfer_to_iosw.str_injr_transfer_to_iosw_cyl[0].str_injr_transfer_to_iosw_pls[0].cha_iv_mes injr.STR_INJR_IFINFTRANS0.str_injr_transfer_to_iosw.str_injr_transfer_to_iosw_cyl[0].str_injr_transfer_to_iosw_pls[0].v_iv_mes injr.STR_INJR_IFINFTRANS0.str_injr_transfer_to_iosw.str_injr_transfer_to_iosw_cyl[0].str_injr_transfer_to_iosw_pls[0].ti_mes injr.STR_INJR_IFINFTRANS0.str_injr_transfer_to_iosw.str_injr_transfer_to_iosw_cyl[0].str_injr_transfer_to_iosw_pls[0].egy_iv_clc injr.STR_INJR_IFINFTRANS0.str_injr_transfer_to_iosw.str_injr_transfer_to_iosw_cyl[0].str_injr_transfer_to_iosw_pls[0].capa_iv_clc injr.STR_INJR_IFINFTRANS0.str_injr_transfer_to_iosw.str_injr_transfer_to_iosw_cyl[0].str_injr_transfer_to_iosw_pls[1].soi_mes injr.STR_INJR_IFINFTRANS0.str_injr_transfer_to_iosw.str_injr_transfer_to_iosw_cyl[0].str_injr_transfer_to_iosw_pls[1].eoi_mes injr.STR_INJR_IFINFTRANS0.str_injr_transfer_to_iosw.str_injr_transfer_to_iosw_cyl[0].str_injr_transfer_to_iosw_pls[1].cha_iv_mes injr.STR_INJR_IFINFTRANS0.str_injr_transfer_to_iosw.str_injr_transfer_to_iosw_cyl[0].str_injr_transfer_to_iosw_pls[1].v_iv_mes injr.STR_INJR_IFINFTRANS0.str_injr_transfer_to_iosw.str_injr_transfer_to_iosw_cyl[0].str_injr_transfer_to_iosw_pls[1].ti_mes injr.STR_INJR_IFINFTRANS0.str_injr_transfer_to_iosw.str_injr_transfer_to_iosw_cyl[0].str_injr_transfer_to_iosw_pls[1].egy_iv_clc injr.STR_INJR_IFINFTRANS0.str_injr_transfer_to_iosw.str_injr_transfer_to_iosw_cyl[0].str_injr_transfer_to_iosw_pls[1].capa_iv_clc injr.STR_INJR_IFINFTRANS0.str_injr_transfer_to_iosw.str_injr_transfer_to_iosw_cyl[0].str_injr_transfer_to_iosw_pls[2].soi_mes injr.STR_INJR_IFINFTRANS0.str_injr_transfer_to_iosw.str_injr_transfer_to_iosw_cyl[0].str_injr_transfer_to_iosw_pls[2].eoi_mes injr.STR_INJR_IFINFTRANS0.str_injr_transfer_to_iosw.str_injr_transfer_to_iosw_cyl[0].str_injr_transfer_to_iosw_pls[2].cha_iv_mes injr.STR_INJR_IFINFTRANS0.str_injr_transfer_to_iosw.str_injr_transfer_to_iosw_cyl[0].str_injr_transfer_to_iosw_pls[2].v_iv_mes injr.STR_INJR_IFINFTRANS0.str_injr_transfer_to_iosw.str_injr_transfer_to_iosw_cyl[0].str_injr_transfer_to_iosw_pls[2].ti_mes injr.STR_INJR_IFINFTRANS0.str_injr_transfer_to_iosw.str_injr_transfer_to_iosw_cyl[0].str_injr_transfer_to_iosw_pls[2].egy_iv_clc injr.STR_INJR_IFINFTRANS0.str_injr_transfer_to_iosw.str_injr_transfer_to_iosw_cyl[0].str_injr_transfer_to_iosw_pls[2].capa_iv_clc injr.STR_INJR_IFINFTRANS0.str_injr_transfer_to_iosw.str_injr_transfer_to_iosw_cyl[1].lv_inh_inj injr.STR_INJR_IFINFTRANS0.str_injr_transfer_to_iosw.str_injr_transfer_to_iosw_cyl[1].lv_state_prev_iv injr.STR_INJR_IFINFTRANS0.str_injr_transfer_to_iosw.str_injr_transfer_to_iosw_cyl[1].lv_add_pulse injr.STR_INJR_IFINFTRANS0.str_injr_transfer_to_iosw.str_injr_transfer_to_iosw_cyl[1].inj_mod injr.STR_INJR_IFINFTRANS0.str_injr_transfer_to_iosw.str_injr_transfer_to_iosw_cyl[1].ctr_inh_iv_mis_gen injr.STR_INJR_IFINFTRANS0.str_injr_transfer_to_iosw.str_injr_transfer_to_iosw_cyl[1].lv_inj_mplp_cyl injr.STR_INJR_IFINFTRANS0.str_injr_transfer_to_iosw.str_injr_transfer_to_iosw_cyl[1].ctr_test_mod_iv injr.STR_INJR_IFINFTRANS0.str_injr_transfer_to_iosw.str_injr_transfer_to_iosw_cyl[1].inj_mod_sp injr.STR_INJR_IFINFTRANS0.str_injr_transfer_to_iosw.str_injr_transfer_to_iosw_cyl[1].lv_inj_upd_ack injr.STR_INJR_IFINFTRANS0.str_injr_transfer_to_iosw.str_injr_transfer_to_iosw_cyl[1].str_injr_transfer_to_iosw_pls[0].soi_mes injr.STR_INJR_IFINFTRANS0.str_injr_transfer_to_iosw.str_injr_transfer_to_iosw_cyl[1].str_injr_transfer_to_iosw_pls[0].eoi_mes injr.STR_INJR_IFINFTRANS0.str_injr_transfer_to_iosw.str_injr_transfer_to_iosw_cyl[1].str_injr_transfer_to_iosw_pls[0].cha_iv_mes injr.STR_INJR_IFINFTRANS0.str_injr_transfer_to_iosw.str_injr_transfer_to_iosw_cyl[1].str_injr_transfer_to_iosw_pls[0].v_iv_mes injr.STR_INJR_IFINFTRANS0.str_injr_transfer_to_iosw.str_injr_transfer_to_iosw_cyl[1].str_injr_transfer_to_iosw_pls[0].ti_mes injr.STR_INJR_IFINFTRANS0.str_injr_transfer_to_iosw.str_injr_transfer_to_iosw_cyl[1].str_injr_transfer_to_iosw_pls[0].egy_iv_clc injr.STR_INJR_IFINFTRANS0.str_injr_transfer_to_iosw.str_injr_transfer_to_iosw_cyl[1].str_injr_transfer_to_iosw_pls[0].capa_iv_clc injr.STR_INJR_IFINFTRANS0.str_injr_transfer_to_iosw.str_injr_transfer_to_iosw_cyl[1].str_injr_transfer_to_iosw_pls[1].soi_mes injr.STR_INJR_IFINFTRANS0.str_injr_transfer_to_iosw.str_injr_transfer_to_iosw_cyl[1].str_injr_transfer_to_iosw_pls[1].eoi_mes injr.STR_INJR_IFINFTRANS0.str_injr_transfer_to_iosw.str_injr_transfer_to_iosw_cyl[1].str_injr_transfer_to_iosw_pls[1].cha_iv_mes injr.STR_INJR_IFINFTRANS0.str_injr_transfer_to_iosw.str_injr_transfer_to_iosw_cyl[1].str_injr_transfer_to_iosw_pls[1].v_iv_mes injr.STR_INJR_IFINFTRANS0.str_injr_transfer_to_iosw.str_injr_transfer_to_iosw_cyl[1].str_injr_transfer_to_iosw_pls[1].ti_mes injr.STR_INJR_IFINFTRANS0.str_injr_transfer_to_iosw.str_injr_transfer_to_iosw_cyl[1].str_injr_transfer_to_iosw_pls[1].egy_iv_clc injr.STR_INJR_IFINFTRANS0.str_injr_transfer_to_iosw.str_injr_transfer_to_iosw_cyl[1].str_injr_transfer_to_iosw_pls[1].capa_iv_clc injr.STR_INJR_IFINFTRANS0.str_injr_transfer_to_iosw.str_injr_transfer_to_iosw_cyl[1].str_injr_transfer_to_iosw_pls[2].soi_mes injr.STR_INJR_IFINFTRANS0.str_injr_transfer_to_iosw.str_injr_transfer_to_iosw_cyl[1].str_injr_transfer_to_iosw_pls[2].eoi_mes injr.STR_INJR_IFINFTRANS0.str_injr_transfer_to_iosw.str_injr_transfer_to_iosw_cyl[1].str_injr_transfer_to_iosw_pls[2].cha_iv_mes injr.STR_INJR_IFINFTRANS0.str_injr_transfer_to_iosw.str_injr_transfer_to_iosw_cyl[1].str_injr_transfer_to_iosw_pls[2].v_iv_mes injr.STR_INJR_IFINFTRANS0.str_injr_transfer_to_iosw.str_injr_transfer_to_iosw_cyl[1].str_injr_transfer_to_iosw_pls[2].ti_mes injr.STR_INJR_IFINFTRANS0.str_injr_transfer_to_iosw.str_injr_transfer_to_iosw_cyl[1].str_injr_transfer_to_iosw_pls[2].egy_iv_clc injr.STR_INJR_IFINFTRANS0.str_injr_transfer_to_iosw.str_injr_transfer_to_iosw_cyl[1].str_injr_transfer_to_iosw_pls[2].capa_iv_clc injr.STR_INJR_IFINFTRANS0.str_injr_transfer_to_iosw.str_injr_transfer_to_iosw_cyl[2].lv_inh_inj injr.STR_INJR_IFINFTRANS0.str_injr_transfer_to_iosw.str_injr_transfer_to_iosw_cyl[2].lv_state_prev_iv injr.STR_INJR_IFINFTRANS0.str_injr_transfer_to_iosw.str_injr_transfer_to_iosw_cyl[2].lv_add_pulse injr.STR_INJR_IFINFTRANS0.str_injr_transfer_to_iosw.str_injr_transfer_to_iosw_cyl[2].inj_mod injr.STR_INJR_IFINFTRANS0.str_injr_transfer_to_iosw.str_injr_transfer_to_iosw_cyl[2].ctr_inh_iv_mis_gen injr.STR_INJR_IFINFTRANS0.str_injr_transfer_to_iosw.str_injr_transfer_to_iosw_cyl[2].lv_inj_mplp_cyl injr.STR_INJR_IFINFTRANS0.str_injr_transfer_to_iosw.str_injr_transfer_to_iosw_cyl[2].ctr_test_mod_iv injr.STR_INJR_IFINFTRANS0.str_injr_transfer_to_iosw.str_injr_transfer_to_iosw_cyl[2].inj_mod_sp injr.STR_INJR_IFINFTRANS0.str_injr_transfer_to_iosw.str_injr_transfer_to_iosw_cyl[2].lv_inj_upd_ack injr.STR_INJR_IFINFTRANS0.str_injr_transfer_to_iosw.str_injr_transfer_to_iosw_cyl[2].str_injr_transfer_to_iosw_pls[0].soi_mes injr.STR_INJR_IFINFTRANS0.str_injr_transfer_to_iosw.str_injr_transfer_to_iosw_cyl[2].str_injr_transfer_to_iosw_pls[0].eoi_mes injr.STR_INJR_IFINFTRANS0.str_injr_transfer_to_iosw.str_injr_transfer_to_iosw_cyl[2].str_injr_transfer_to_iosw_pls[0].cha_iv_mes injr.STR_INJR_IFINFTRANS0.str_injr_transfer_to_iosw.str_injr_transfer_to_iosw_cyl[2].str_injr_transfer_to_iosw_pls[0].v_iv_mes injr.STR_INJR_IFINFTRANS0.str_injr_transfer_to_iosw.str_injr_transfer_to_iosw_cyl[2].str_injr_transfer_to_iosw_pls[0].ti_mes injr.STR_INJR_IFINFTRANS0.str_injr_transfer_to_iosw.str_injr_transfer_to_iosw_cyl[2].str_injr_transfer_to_iosw_pls[0].egy_iv_clc injr.STR_INJR_IFINFTRANS0.str_injr_transfer_to_iosw.str_injr_transfer_to_iosw_cyl[2].str_injr_transfer_to_iosw_pls[0].capa_iv_clc injr.STR_INJR_IFINFTRANS0.str_injr_transfer_to_iosw.str_injr_transfer_to_iosw_cyl[2].str_injr_transfer_to_iosw_pls[1].soi_mes injr.STR_INJR_IFINFTRANS0.str_injr_transfer_to_iosw.str_injr_transfer_to_iosw_cyl[2].str_injr_transfer_to_iosw_pls[1].eoi_mes injr.STR_INJR_IFINFTRANS0.str_injr_transfer_to_iosw.str_injr_transfer_to_iosw_cyl[2].str_injr_transfer_to_iosw_pls[1].cha_iv_mes injr.STR_INJR_IFINFTRANS0.str_injr_transfer_to_iosw.str_injr_transfer_to_iosw_cyl[2].str_injr_transfer_to_iosw_pls[1].v_iv_mes injr.STR_INJR_IFINFTRANS0.str_injr_transfer_to_iosw.str_injr_transfer_to_iosw_cyl[2].str_injr_transfer_to_iosw_pls[1].ti_mes injr.STR_INJR_IFINFTRANS0.str_injr_transfer_to_iosw.str_injr_transfer_to_iosw_cyl[2].str_injr_transfer_to_iosw_pls[1].egy_iv_clc injr.STR_INJR_IFINFTRANS0.str_injr_transfer_to_iosw.str_injr_transfer_to_iosw_cyl[2].str_injr_transfer_to_iosw_pls[1].capa_iv_clc injr.STR_INJR_IFINFTRANS0.str_injr_transfer_to_iosw.str_injr_transfer_to_iosw_cyl[2].str_injr_transfer_to_iosw_pls[2].soi_mes injr.STR_INJR_IFINFTRANS0.str_injr_transfer_to_iosw.str_injr_transfer_to_iosw_cyl[2].str_injr_transfer_to_iosw_pls[2].eoi_mes injr.STR_INJR_IFINFTRANS0.str_injr_transfer_to_iosw.str_injr_transfer_to_iosw_cyl[2].str_injr_transfer_to_iosw_pls[2].cha_iv_mes injr.STR_INJR_IFINFTRANS0.str_injr_transfer_to_iosw.str_injr_transfer_to_iosw_cyl[2].str_injr_transfer_to_iosw_pls[2].v_iv_mes injr.STR_INJR_IFINFTRANS0.str_injr_transfer_to_iosw.str_injr_transfer_to_iosw_cyl[2].str_injr_transfer_to_iosw_pls[2].ti_mes injr.STR_INJR_IFINFTRANS0.str_injr_transfer_to_iosw.str_injr_transfer_to_iosw_cyl[2].str_injr_transfer_to_iosw_pls[2].egy_iv_clc injr.STR_INJR_IFINFTRANS0.str_injr_transfer_to_iosw.str_injr_transfer_to_iosw_cyl[2].str_injr_transfer_to_iosw_pls[2].capa_iv_clc injr.STR_INJR_IFINFTRANS0.str_injr_transfer_to_iosw.str_injr_transfer_to_iosw_cyl[3].lv_inh_inj injr.STR_INJR_IFINFTRANS0.str_injr_transfer_to_iosw.str_injr_transfer_to_iosw_cyl[3].lv_state_prev_iv injr.STR_INJR_IFINFTRANS0.str_injr_transfer_to_iosw.str_injr_transfer_to_iosw_cyl[3].lv_add_pulse injr.STR_INJR_IFINFTRANS0.str_injr_transfer_to_iosw.str_injr_transfer_to_iosw_cyl[3].inj_mod injr.STR_INJR_IFINFTRANS0.str_injr_transfer_to_iosw.str_injr_transfer_to_iosw_cyl[3].ctr_inh_iv_mis_gen injr.STR_INJR_IFINFTRANS0.str_injr_transfer_to_iosw.str_injr_transfer_to_iosw_cyl[3].lv_inj_mplp_cyl injr.STR_INJR_IFINFTRANS0.str_injr_transfer_to_iosw.str_injr_transfer_to_iosw_cyl[3].ctr_test_mod_iv injr.STR_INJR_IFINFTRANS0.str_injr_transfer_to_iosw.str_injr_transfer_to_iosw_cyl[3].inj_mod_sp injr.STR_INJR_IFINFTRANS0.str_injr_transfer_to_iosw.str_injr_transfer_to_iosw_cyl[3].lv_inj_upd_ack injr.STR_INJR_IFINFTRANS0.str_injr_transfer_to_iosw.str_injr_transfer_to_iosw_cyl[3].str_injr_transfer_to_iosw_pls[0].soi_mes injr.STR_INJR_IFINFTRANS0.str_injr_transfer_to_iosw.str_injr_transfer_to_iosw_cyl[3].str_injr_transfer_to_iosw_pls[0].eoi_mes injr.STR_INJR_IFINFTRANS0.str_injr_transfer_to_iosw.str_injr_transfer_to_iosw_cyl[3].str_injr_transfer_to_iosw_pls[0].cha_iv_mes injr.STR_INJR_IFINFTRANS0.str_injr_transfer_to_iosw.str_injr_transfer_to_iosw_cyl[3].str_injr_transfer_to_iosw_pls[0].v_iv_mes injr.STR_INJR_IFINFTRANS0.str_injr_transfer_to_iosw.str_injr_transfer_to_iosw_cyl[3].str_injr_transfer_to_iosw_pls[0].ti_mes injr.STR_INJR_IFINFTRANS0.str_injr_transfer_to_iosw.str_injr_transfer_to_iosw_cyl[3].str_injr_transfer_to_iosw_pls[0].egy_iv_clc injr.STR_INJR_IFINFTRANS0.str_injr_transfer_to_iosw.str_injr_transfer_to_iosw_cyl[3].str_injr_transfer_to_iosw_pls[0].capa_iv_clc injr.STR_INJR_IFINFTRANS0.str_injr_transfer_to_iosw.str_injr_transfer_to_iosw_cyl[3].str_injr_transfer_to_iosw_pls[1].soi_mes injr.STR_INJR_IFINFTRANS0.str_injr_transfer_to_iosw.str_injr_transfer_to_iosw_cyl[3].str_injr_transfer_to_iosw_pls[1].eoi_mes injr.STR_INJR_IFINFTRANS0.str_injr_transfer_to_iosw.str_injr_transfer_to_iosw_cyl[3].str_injr_transfer_to_iosw_pls[1].cha_iv_mes injr.STR_INJR_IFINFTRANS0.str_injr_transfer_to_iosw.str_injr_transfer_to_iosw_cyl[3].str_injr_transfer_to_iosw_pls[1].v_iv_mes injr.STR_INJR_IFINFTRANS0.str_injr_transfer_to_iosw.str_injr_transfer_to_iosw_cyl[3].str_injr_transfer_to_iosw_pls[1].ti_mes injr.STR_INJR_IFINFTRANS0.str_injr_transfer_to_iosw.str_injr_transfer_to_iosw_cyl[3].str_injr_transfer_to_iosw_pls[1].egy_iv_clc injr.STR_INJR_IFINFTRANS0.str_injr_transfer_to_iosw.str_injr_transfer_to_iosw_cyl[3].str_injr_transfer_to_iosw_pls[1].capa_iv_clc injr.STR_INJR_IFINFTRANS0.str_injr_transfer_to_iosw.str_injr_transfer_to_iosw_cyl[3].str_injr_transfer_to_iosw_pls[2].soi_mes injr.STR_INJR_IFINFTRANS0.str_injr_transfer_to_iosw.str_injr_transfer_to_iosw_cyl[3].str_injr_transfer_to_iosw_pls[2].eoi_mes injr.STR_INJR_IFINFTRANS0.str_injr_transfer_to_iosw.str_injr_transfer_to_iosw_cyl[3].str_injr_transfer_to_iosw_pls[2].cha_iv_mes injr.STR_INJR_IFINFTRANS0.str_injr_transfer_to_iosw.str_injr_transfer_to_iosw_cyl[3].str_injr_transfer_to_iosw_pls[2].v_iv_mes injr.STR_INJR_IFINFTRANS0.str_injr_transfer_to_iosw.str_injr_transfer_to_iosw_cyl[3].str_injr_transfer_to_iosw_pls[2].ti_mes injr.STR_INJR_IFINFTRANS0.str_injr_transfer_to_iosw.str_injr_transfer_to_iosw_cyl[3].str_injr_transfer_to_iosw_pls[2].egy_iv_clc injr.STR_INJR_IFINFTRANS0.str_injr_transfer_to_iosw.str_injr_transfer_to_iosw_cyl[3].str_injr_transfer_to_iosw_pls[2].capa_iv_clc injr.STR_INJR_IFINFTRANS0.str_injr_transfer_to_iosw.str_injr_transfer_to_iosw_cyl[4].lv_inh_inj injr.STR_INJR_IFINFTRANS0.str_injr_transfer_to_iosw.str_injr_transfer_to_iosw_cyl[4].lv_state_prev_iv injr.STR_INJR_IFINFTRANS0.str_injr_transfer_to_iosw.str_injr_transfer_to_iosw_cyl[4].lv_add_pulse injr.STR_INJR_IFINFTRANS0.str_injr_transfer_to_iosw.str_injr_transfer_to_iosw_cyl[4].inj_mod injr.STR_INJR_IFINFTRANS0.str_injr_transfer_to_iosw.str_injr_transfer_to_iosw_cyl[4].ctr_inh_iv_mis_gen injr.STR_INJR_IFINFTRANS0.str_injr_transfer_to_iosw.str_injr_transfer_to_iosw_cyl[4].lv_inj_mplp_cyl injr.STR_INJR_IFINFTRANS0.str_injr_transfer_to_iosw.str_injr_transfer_to_iosw_cyl[4].ctr_test_mod_iv injr.STR_INJR_IFINFTRANS0.str_injr_transfer_to_iosw.str_injr_transfer_to_iosw_cyl[4].inj_mod_sp injr.STR_INJR_IFINFTRANS0.str_injr_transfer_to_iosw.str_injr_transfer_to_iosw_cyl[4].lv_inj_upd_ack injr.STR_INJR_IFINFTRANS0.str_injr_transfer_to_iosw.str_injr_transfer_to_iosw_cyl[4].str_injr_transfer_to_iosw_pls[0].soi_mes injr.STR_INJR_IFINFTRANS0.str_injr_transfer_to_iosw.str_injr_transfer_to_iosw_cyl[4].str_injr_transfer_to_iosw_pls[0].eoi_mes injr.STR_INJR_IFINFTRANS0.str_injr_transfer_to_iosw.str_injr_transfer_to_iosw_cyl[4].str_injr_transfer_to_iosw_pls[0].cha_iv_mes injr.STR_INJR_IFINFTRANS0.str_injr_transfer_to_iosw.str_injr_transfer_to_iosw_cyl[4].str_injr_transfer_to_iosw_pls[0].v_iv_mes injr.STR_INJR_IFINFTRANS0.str_injr_transfer_to_iosw.str_injr_transfer_to_iosw_cyl[4].str_injr_transfer_to_iosw_pls[0].ti_mes injr.STR_INJR_IFINFTRANS0.str_injr_transfer_to_iosw.str_injr_transfer_to_iosw_cyl[4].str_injr_transfer_to_iosw_pls[0].egy_iv_clc injr.STR_INJR_IFINFTRANS0.str_injr_transfer_to_iosw.str_injr_transfer_to_iosw_cyl[4].str_injr_transfer_to_iosw_pls[0].capa_iv_clc injr.STR_INJR_IFINFTRANS0.str_injr_transfer_to_iosw.str_injr_transfer_to_iosw_cyl[4].str_injr_transfer_to_iosw_pls[1].soi_mes injr.STR_INJR_IFINFTRANS0.str_injr_transfer_to_iosw.str_injr_transfer_to_iosw_cyl[4].str_injr_transfer_to_iosw_pls[1].eoi_mes injr.STR_INJR_IFINFTRANS0.str_injr_transfer_to_iosw.str_injr_transfer_to_iosw_cyl[4].str_injr_transfer_to_iosw_pls[1].cha_iv_mes injr.STR_INJR_IFINFTRANS0.str_injr_transfer_to_iosw.str_injr_transfer_to_iosw_cyl[4].str_injr_transfer_to_iosw_pls[1].v_iv_mes injr.STR_INJR_IFINFTRANS0.str_injr_transfer_to_iosw.str_injr_transfer_to_iosw_cyl[4].str_injr_transfer_to_iosw_pls[1].ti_mes injr.STR_INJR_IFINFTRANS0.str_injr_transfer_to_iosw.str_injr_transfer_to_iosw_cyl[4].str_injr_transfer_to_iosw_pls[1].egy_iv_clc injr.STR_INJR_IFINFTRANS0.str_injr_transfer_to_iosw.str_injr_transfer_to_iosw_cyl[4].str_injr_transfer_to_iosw_pls[1].capa_iv_clc injr.STR_INJR_IFINFTRANS0.str_injr_transfer_to_iosw.str_injr_transfer_to_iosw_cyl[4].str_injr_transfer_to_iosw_pls[2].soi_mes injr.STR_INJR_IFINFTRANS0.str_injr_transfer_to_iosw.str_injr_transfer_to_iosw_cyl[4].str_injr_transfer_to_iosw_pls[2].eoi_mes injr.STR_INJR_IFINFTRANS0.str_injr_transfer_to_iosw.str_injr_transfer_to_iosw_cyl[4].str_injr_transfer_to_iosw_pls[2].cha_iv_mes injr.STR_INJR_IFINFTRANS0.str_injr_transfer_to_iosw.str_injr_transfer_to_iosw_cyl[4].str_injr_transfer_to_iosw_pls[2].v_iv_mes injr.STR_INJR_IFINFTRANS0.str_injr_transfer_to_iosw.str_injr_transfer_to_iosw_cyl[4].str_injr_transfer_to_iosw_pls[2].ti_mes injr.STR_INJR_IFINFTRANS0.str_injr_transfer_to_iosw.str_injr_transfer_to_iosw_cyl[4].str_injr_transfer_to_iosw_pls[2].egy_iv_clc injr.STR_INJR_IFINFTRANS0.str_injr_transfer_to_iosw.str_injr_transfer_to_iosw_cyl[4].str_injr_transfer_to_iosw_pls[2].capa_iv_clc injr.STR_INJR_IFINFTRANS0.str_injr_transfer_to_iosw.str_injr_transfer_to_iosw_cyl[5].lv_inh_inj injr.STR_INJR_IFINFTRANS0.str_injr_transfer_to_iosw.str_injr_transfer_to_iosw_cyl[5].lv_state_prev_iv injr.STR_INJR_IFINFTRANS0.str_injr_transfer_to_iosw.str_injr_transfer_to_iosw_cyl[5].lv_add_pulse injr.STR_INJR_IFINFTRANS0.str_injr_transfer_to_iosw.str_injr_transfer_to_iosw_cyl[5].inj_mod injr.STR_INJR_IFINFTRANS0.str_injr_transfer_to_iosw.str_injr_transfer_to_iosw_cyl[5].ctr_inh_iv_mis_gen injr.STR_INJR_IFINFTRANS0.str_injr_transfer_to_iosw.str_injr_transfer_to_iosw_cyl[5].lv_inj_mplp_cyl injr.STR_INJR_IFINFTRANS0.str_injr_transfer_to_iosw.str_injr_transfer_to_iosw_cyl[5].ctr_test_mod_iv injr.STR_INJR_IFINFTRANS0.str_injr_transfer_to_iosw.str_injr_transfer_to_iosw_cyl[5].inj_mod_sp injr.STR_INJR_IFINFTRANS0.str_injr_transfer_to_iosw.str_injr_transfer_to_iosw_cyl[5].lv_inj_upd_ack injr.STR_INJR_IFINFTRANS0.str_injr_transfer_to_iosw.str_injr_transfer_to_iosw_cyl[5].str_injr_transfer_to_iosw_pls[0].soi_mes injr.STR_INJR_IFINFTRANS0.str_injr_transfer_to_iosw.str_injr_transfer_to_iosw_cyl[5].str_injr_transfer_to_iosw_pls[0].eoi_mes injr.STR_INJR_IFINFTRANS0.str_injr_transfer_to_iosw.str_injr_transfer_to_iosw_cyl[5].str_injr_transfer_to_iosw_pls[0].cha_iv_mes injr.STR_INJR_IFINFTRANS0.str_injr_transfer_to_iosw.str_injr_transfer_to_iosw_cyl[5].str_injr_transfer_to_iosw_pls[0].v_iv_mes injr.STR_INJR_IFINFTRANS0.str_injr_transfer_to_iosw.str_injr_transfer_to_iosw_cyl[5].str_injr_transfer_to_iosw_pls[0].ti_mes injr.STR_INJR_IFINFTRANS0.str_injr_transfer_to_iosw.str_injr_transfer_to_iosw_cyl[5].str_injr_transfer_to_iosw_pls[0].egy_iv_clc injr.STR_INJR_IFINFTRANS0.str_injr_transfer_to_iosw.str_injr_transfer_to_iosw_cyl[5].str_injr_transfer_to_iosw_pls[0].capa_iv_clc injr.STR_INJR_IFINFTRANS0.str_injr_transfer_to_iosw.str_injr_transfer_to_iosw_cyl[5].str_injr_transfer_to_iosw_pls[1].soi_mes injr.STR_INJR_IFINFTRANS0.str_injr_transfer_to_iosw.str_injr_transfer_to_iosw_cyl[5].str_injr_transfer_to_iosw_pls[1].eoi_mes injr.STR_INJR_IFINFTRANS0.str_injr_transfer_to_iosw.str_injr_transfer_to_iosw_cyl[5].str_injr_transfer_to_iosw_pls[1].cha_iv_mes injr.STR_INJR_IFINFTRANS0.str_injr_transfer_to_iosw.str_injr_transfer_to_iosw_cyl[5].str_injr_transfer_to_iosw_pls[1].v_iv_mes injr.STR_INJR_IFINFTRANS0.str_injr_transfer_to_iosw.str_injr_transfer_to_iosw_cyl[5].str_injr_transfer_to_iosw_pls[1].ti_mes injr.STR_INJR_IFINFTRANS0.str_injr_transfer_to_iosw.str_injr_transfer_to_iosw_cyl[5].str_injr_transfer_to_iosw_pls[1].egy_iv_clc injr.STR_INJR_IFINFTRANS0.str_injr_transfer_to_iosw.str_injr_transfer_to_iosw_cyl[5].str_injr_transfer_to_iosw_pls[1].capa_iv_clc injr.STR_INJR_IFINFTRANS0.str_injr_transfer_to_iosw.str_injr_transfer_to_iosw_cyl[5].str_injr_transfer_to_iosw_pls[2].soi_mes injr.STR_INJR_IFINFTRANS0.str_injr_transfer_to_iosw.str_injr_transfer_to_iosw_cyl[5].str_injr_transfer_to_iosw_pls[2].eoi_mes injr.STR_INJR_IFINFTRANS0.str_injr_transfer_to_iosw.str_injr_transfer_to_iosw_cyl[5].str_injr_transfer_to_iosw_pls[2].cha_iv_mes injr.STR_INJR_IFINFTRANS0.str_injr_transfer_to_iosw.str_injr_transfer_to_iosw_cyl[5].str_injr_transfer_to_iosw_pls[2].v_iv_mes injr.STR_INJR_IFINFTRANS0.str_injr_transfer_to_iosw.str_injr_transfer_to_iosw_cyl[5].str_injr_transfer_to_iosw_pls[2].ti_mes injr.STR_INJR_IFINFTRANS0.str_injr_transfer_to_iosw.str_injr_transfer_to_iosw_cyl[5].str_injr_transfer_to_iosw_pls[2].egy_iv_clc injr.STR_INJR_IFINFTRANS0.str_injr_transfer_to_iosw.str_injr_transfer_to_iosw_cyl[5].str_injr_transfer_to_iosw_pls[2].capa_iv_clc injr.STR_INJR_IFINFTRANS0.str_injr_transfer_to_iosw.lv_iv_mes_vld /end OUT_MEASUREMENT
/end FUNCTION
/begin FUNCTION INJR_Injection_phase_1st_pulse ""
 /begin DEF_CHARACTERISTIC c_eoi_lim_hom c_eoi_lim_hom_st c_soi_lim ip_eoi_lim_hom_fup_cor ldpm_fup_h_1_injr c_eoi_lim_hom_multi_cor lc_soi_1_hom_man lc_soi_1_hom_st_man c_soi_1_hom_man c_soi_1_hom_st_man /end DEF_CHARACTERISTIC
 /begin OUT_MEASUREMENT injr.STR_INJR_REQGNHOM1P0.soi_1_hom[0] injr.STR_INJR_REQGNHOM1P0.soi_1_hom[1] injr.STR_INJR_REQGNHOM1P0.soi_1_hom[2] injr.STR_INJR_REQGNHOM1P0.soi_1_hom[3] injr.STR_INJR_REQGNHOM1P0.soi_1_hom[4] injr.STR_INJR_REQGNHOM1P0.soi_1_hom[5] injr.STR_INJR_REQGNHOM1P0.soi_1_hom_clc[0] injr.STR_INJR_REQGNHOM1P0.soi_1_hom_clc[1] injr.STR_INJR_REQGNHOM1P0.soi_1_hom_clc[2] injr.STR_INJR_REQGNHOM1P0.soi_1_hom_clc[3] injr.STR_INJR_REQGNHOM1P0.soi_1_hom_clc[4] injr.STR_INJR_REQGNHOM1P0.soi_1_hom_clc[5] lv_crk_dif_soi_eoi_lim lv_eoi_lim_hom soi_lim eoi_lim_hom eoi_1_hom /end OUT_MEASUREMENT
/end FUNCTION
/begin FUNCTION INJR_Fuel_temperature_correction "" /begin DEF_CHARACTERISTIC ip_fac_ti_temp_cor ldp_tfu_ip_fac_ti_temp_cor /end DEF_CHARACTERISTIC /begin OUT_MEASUREMENT fac_ti_tfu /end OUT_MEASUREMENT /end FUNCTION
/begin FUNCTION INJR_Correction_via_Appl_System ""
 /begin DEF_CHARACTERISTIC c_ti_as_global c_ti_add_as_global c_ti_as[0] c_ti_as[1] c_ti_as[2] c_ti_as[3] c_ti_as[4] c_ti_as[5] c_ti_as_cbk_ex[0] c_ti_as_cbk_ex[1] c_ti_add_as[0] c_ti_add_as[1] c_ti_add_as[2] c_ti_add_as[3] c_ti_add_as[4] c_ti_add_as[5] c_ti_add_as_cbk_ex[0] c_ti_add_as_cbk_ex[1] lc_ti_as_cbk_upd_dis /end DEF_CHARACTERISTIC
 /begin OUT_MEASUREMENT ti_as injr.STR_INJR_ISPCLAS0.ti_tun_iv[0] injr.STR_INJR_ISPCLAS0.ti_tun_iv[1] injr.STR_INJR_ISPCLAS0.ti_tun_iv[2] injr.STR_INJR_ISPCLAS0.ti_tun_iv[3] injr.STR_INJR_ISPCLAS0.ti_tun_iv[4] injr.STR_INJR_ISPCLAS0.ti_tun_iv[5] injr.STR_INJR_ISPCLAS0.ti_tun_add_iv[0] injr.STR_INJR_ISPCLAS0.ti_tun_add_iv[1] injr.STR_INJR_ISPCLAS0.ti_tun_add_iv[2] injr.STR_INJR_ISPCLAS0.ti_tun_add_iv[3] injr.STR_INJR_ISPCLAS0.ti_tun_add_iv[4] injr.STR_INJR_ISPCLAS0.ti_tun_add_iv[5] /end OUT_MEASUREMENT
/end FUNCTION
/begin FUNCTION INJR_Cylinder_Shut_Off ""
 /begin DEF_CHARACTERISTIC id_inh_swi_iv ldp_nr_pat_id_inh_swi_iv lc_swi_mod_inh_iv_dyn /end DEF_CHARACTERISTIC
 /begin OUT_MEASUREMENT inh_iv inh_swi_iv inh_iv_igk inh_iv_puc inh_iv_mon nr_pat sum_inh_iv inh_inj sum_inh_inj lv_inj_cut lv_fcut_ind sum_inh_iv_dyn inh_iv_n_max_req_fcut state_inh_iv_dyn injr.STR_INJR_ACCTLCYL0.lv_scc[0] injr.STR_INJR_ACCTLCYL0.lv_scc[1] injr.STR_INJR_ACCTLCYL0.sum_inh_iv_cbk[0] injr.STR_INJR_ACCTLCYL0.sum_inh_iv_cbk[1] /end OUT_MEASUREMENT
/end FUNCTION
/begin FUNCTION INJR_Injection_phase_2nd_pulse "" /begin DEF_CHARACTERISTIC c_delta_t_min_dui c_eoi_2_hom_man lc_eoi_2_hom_man /end DEF_CHARACTERISTIC
 /begin OUT_MEASUREMENT injr.STR_INJR_REQGNHOM2P0.eoi_2_hom[0] injr.STR_INJR_REQGNHOM2P0.eoi_2_hom[1] injr.STR_INJR_REQGNHOM2P0.eoi_2_hom[2] injr.STR_INJR_REQGNHOM2P0.eoi_2_hom[3] injr.STR_INJR_REQGNHOM2P0.eoi_2_hom[4] injr.STR_INJR_REQGNHOM2P0.eoi_2_hom[5] soi_2_hom eoi_1_soi_2_gap_hom /end OUT_MEASUREMENT
/end FUNCTION
/begin FUNCTION INJR_Comp_of_temp_influence "" /begin DEF_CHARACTERISTIC ldp_tfu_inj_ip_egy_add_temp ip_egy_add_temp /end DEF_CHARACTERISTIC /begin OUT_MEASUREMENT egy_add_temp /end OUT_MEASUREMENT /end FUNCTION
/begin FUNCTION INJR_Injector_needle_lift_adj ""
 /begin DEF_CHARACTERISTIC c_ti_thd_iv_egy_rng c_ti_hys_iv_egy_rng c_egy_step_inj_cha_grd_max_hom c_egy_step_inj_cha_grd_min_hom c_egy_step_inj_cha_grd_max_s c_egy_step_inj_cha_grd_min_s /end DEF_CHARACTERISTIC
 /begin OUT_MEASUREMENT lv_iv_egy_rng_1 lv_iv_egy_rng_2 ti_1_min_stnd_egy_h_s ti_2_min_stnd_egy_h_s t_dcha_per_hom t_cha_per_s_1 t_dcha_per_s_1 t_cha_per_s_2 t_dcha_per_s_2 t_cha_per_post t_dcha_per_post t_cha_per_hom egy_step_inj_cha_grd_lim_not[0] egy_step_inj_cha_grd_lim_not[1] egy_step_inj_cha_grd_lim_not[2] egy_step_inj_cha_grd_lim_not[3] egy_step_inj_cha_grd_lim_not[4] egy_step_inj_cha_grd_lim_not[5] egy_step_inj_cha_grd_dif_hom[0] egy_step_inj_cha_grd_dif_hom[1] egy_step_inj_cha_grd_dif_hom[2] egy_step_inj_cha_grd_dif_hom[3] egy_step_inj_cha_grd_dif_hom[4] egy_step_inj_cha_grd_dif_hom[5] fac_egy_dif_hom[0] fac_egy_dif_hom[1] fac_egy_dif_hom[2] fac_egy_dif_hom[3] fac_egy_dif_hom[4] fac_egy_dif_hom[5] egy_step_inj_cha_grd_dif_s[0] egy_step_inj_cha_grd_dif_s[1] egy_step_inj_cha_grd_dif_s[2] egy_step_inj_cha_grd_dif_s[3] egy_step_inj_cha_grd_dif_s[4] egy_step_inj_cha_grd_dif_s[5] fac_egy_dif_s[0] fac_egy_dif_s[1] fac_egy_dif_s[2] fac_egy_dif_s[3] fac_egy_dif_s[4] fac_egy_dif_s[5] fac_mff_dif_s[0] fac_mff_dif_s[1] fac_mff_dif_s[2] fac_mff_dif_s[3] fac_mff_dif_s[4] fac_mff_dif_s[5] mff_sp_2_tot_s[0] mff_sp_2_tot_s[1] mff_sp_2_tot_s[2] mff_sp_2_tot_s[3] mff_sp_2_tot_s[4] mff_sp_2_tot_s[5] mff_sp_1_tot_s[0] mff_sp_1_tot_s[1] mff_sp_1_tot_s[2] mff_sp_1_tot_s[3] mff_sp_1_tot_s[4] mff_sp_1_tot_s[5] /end OUT_MEASUREMENT
/end FUNCTION
/end MODULE
/end PROJECT
