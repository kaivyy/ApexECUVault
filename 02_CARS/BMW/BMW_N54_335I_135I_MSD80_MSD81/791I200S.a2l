ASAP2_VERSION 1 41
/begin PROJECT MSD85 "Spray Guided DI-System with Piezo Injectors for 8-Cylinder"
/begin HEADER "_default_HeaderComment" PROJECT_NO _91 /end HEADER
/begin MODULE _default_ModuleName "_default_ModuleLongIdentifier"
/begin MOD_COMMON "_default_ModCommonComment" DEPOSIT ABSOLUTE BYTE_ORDER MSB_LAST ALIGNMENT_BYTE 1 ALIGNMENT_WORD 2 ALIGNMENT_LONG 2 ALIGNMENT_FLOAT32_IEEE 2 ALIGNMENT_FLOAT64_IEEE 4 /end MOD_COMMON
/begin AXIS_PTS ldpm_fmy_envd "" 0xa080294e errm_online_dummy _REC_AXS_20_u1 255. _CNV_A_R_LINEAR_____0_CM 4 0. 255. FORMAT "%3.0" /end AXIS_PTS
/begin MEASUREMENT tbl_frf[5].envd_obd[8] "Freeze frame FRF_OBD: environmental data (fixed by law)" UBYTE _CNV_A_R_LINEAR_____0_CM 1 100. 0. 255. DISPLAY_IDENTIFIER ENVD_OBD_9_5 ECU_ADDRESS 0xd0009e30 FORMAT "%3.0" /end MEASUREMENT
/begin MEASUREMENT tbl_frf[5].envd_obd[9] "Freeze frame FRF_OBD: environmental data (fixed by law)" UBYTE _CNV_A_R_LINEAR_____0_CM 1 100. 0. 255. DISPLAY_IDENTIFIER ENVD_OBD_10_5 ECU_ADDRESS 0xd0009e31 FORMAT "%3.0" /end MEASUREMENT
/begin MEASUREMENT tbl_frf[5].envd_obd[10] "Freeze frame FRF_OBD: environmental data (fixed by law)" UBYTE _CNV_A_R_LINEAR_____0_CM 1 100. 0. 255. DISPLAY_IDENTIFIER ENVD_OBD_11_5 ECU_ADDRESS 0xd0009e32 FORMAT "%3.0" /end MEASUREMENT
/begin MEASUREMENT tbl_frf[5].envd_obd[11] "Freeze frame FRF_OBD: environmental data (fixed by law)" UBYTE _CNV_A_R_LINEAR_____0_CM 1 100. 0. 255. DISPLAY_IDENTIFIER ENVD_OBD_12_5 ECU_ADDRESS 0xd0009e33 FORMAT "%3.0" /end MEASUREMENT
/begin MEASUREMENT tbl_frf[5].envd_obd[12] "Freeze frame FRF_OBD: environmental data (fixed by law)" UBYTE _CNV_A_R_LINEAR_____0_CM 1 100. 0. 255. DISPLAY_IDENTIFIER ENVD_OBD_13_5 ECU_ADDRESS 0xd0009e34 FORMAT "%3.0" /end MEASUREMENT
/begin MEASUREMENT tbl_frf[5].envd_obd[13] "Freeze frame FRF_OBD: environmental data (fixed by law)" UBYTE _CNV_A_R_LINEAR_____0_CM 1 100. 0. 255. DISPLAY_IDENTIFIER ENVD_OBD_14_5 ECU_ADDRESS 0xd0009e35 FORMAT "%3.0" /end MEASUREMENT
/begin MEASUREMENT tbl_frf[5].envd_obd[14] "Freeze frame FRF_OBD: environmental data (fixed by law)" UBYTE _CNV_A_R_LINEAR_____0_CM 1 100. 0. 255. DISPLAY_IDENTIFIER ENVD_OBD_15_5 ECU_ADDRESS 0xd0009e36 FORMAT "%3.0" /end MEASUREMENT
/begin MEASUREMENT tbl_frf[5].envd_obd[15] "Freeze frame FRF_OBD: environmental data (fixed by law)" UBYTE _CNV_A_R_LINEAR_____0_CM 1 100. 0. 255. DISPLAY_IDENTIFIER ENVD_OBD_16_5 ECU_ADDRESS 0xd0009e37 FORMAT "%3.0" /end MEASUREMENT
/begin MEASUREMENT tbl_frf[5].envd_obd[16] "Freeze frame FRF_OBD: environmental data (fixed by law)" UBYTE _CNV_A_R_LINEAR_____0_CM 1 100. 0. 255. DISPLAY_IDENTIFIER ENVD_OBD_17_5 ECU_ADDRESS 0xd0009e38 FORMAT "%3.0" /end MEASUREMENT
/begin MEASUREMENT tbl_frf[5].envd_obd[17] "Freeze frame FRF_OBD: environmental data (fixed by law)" UBYTE _CNV_A_R_LINEAR_____0_CM 1 100. 0. 255. DISPLAY_IDENTIFIER ENVD_OBD_18_5 ECU_ADDRESS 0xd0009e39 FORMAT "%3.0" /end MEASUREMENT
/begin MEASUREMENT tbl_frf[5].envd_obd[18] "Freeze frame FRF_OBD: environmental data (fixed by law)" UBYTE _CNV_A_R_LINEAR_____0_CM 1 100. 0. 255. DISPLAY_IDENTIFIER ENVD_OBD_19_5 ECU_ADDRESS 0xd0009e3a FORMAT "%3.0" /end MEASUREMENT
/begin MEASUREMENT tbl_frf[5].envd_obd[19] "Freeze frame FRF_OBD: environmental data (fixed by law)" UBYTE _CNV_A_R_LINEAR_____0_CM 1 100. 0. 255. DISPLAY_IDENTIFIER ENVD_OBD_20_5 ECU_ADDRESS 0xd0009e3b FORMAT "%3.0" /end MEASUREMENT
/begin MEASUREMENT tbl_frf[5].envd_obd[20] "Freeze frame FRF_OBD: environmental data (fixed by law)" UBYTE _CNV_A_R_LINEAR_____0_CM 1 100. 0. 255. DISPLAY_IDENTIFIER ENVD_OBD_21_5 ECU_ADDRESS 0xd0009e3c FORMAT "%3.0" /end MEASUREMENT
/begin MEASUREMENT tbl_frf[5].envd_obd[21] "Freeze frame FRF_OBD: environmental data (fixed by law)" UBYTE _CNV_A_R_LINEAR_____0_CM 1 100. 0. 255. DISPLAY_IDENTIFIER ENVD_OBD_22_5 ECU_ADDRESS 0xd0009e3d FORMAT "%3.0" /end MEASUREMENT
/begin MEASUREMENT tbl_frf[5].envd_obd[22] "Freeze frame FRF_OBD: environmental data (fixed by law)" UBYTE _CNV_A_R_LINEAR_____0_CM 1 100. 0. 255. DISPLAY_IDENTIFIER ENVD_OBD_23_5 ECU_ADDRESS 0xd0009e3e FORMAT "%3.0" /end MEASUREMENT
/begin MEASUREMENT tbl_frf[5].envd_obd[23] "Freeze frame FRF_OBD: environmental data (fixed by law)" UBYTE _CNV_A_R_LINEAR_____0_CM 1 100. 0. 255. DISPLAY_IDENTIFIER ENVD_OBD_24_5 ECU_ADDRESS 0xd0009e3f FORMAT "%3.0" /end MEASUREMENT
/begin MEASUREMENT tbl_frf[5].envd_obd[24] "Freeze frame FRF_OBD: environmental data (fixed by law)" UBYTE _CNV_A_R_LINEAR_____0_CM 1 100. 0. 255. DISPLAY_IDENTIFIER ENVD_OBD_25_5 ECU_ADDRESS 0xd0009e40 FORMAT "%3.0" /end MEASUREMENT
/begin MEASUREMENT tbl_frf[5].envd_obd[25] "Freeze frame FRF_OBD: environmental data (fixed by law)" UBYTE _CNV_A_R_LINEAR_____0_CM 1 100. 0. 255. DISPLAY_IDENTIFIER ENVD_OBD_26_5 ECU_ADDRESS 0xd0009e41 FORMAT "%3.0" /end MEASUREMENT
/begin MEASUREMENT tbl_frf[5].envd_obd[26] "Freeze frame FRF_OBD: environmental data (fixed by law)" UBYTE _CNV_A_R_LINEAR_____0_CM 1 100. 0. 255. DISPLAY_IDENTIFIER ENVD_OBD_27_5 ECU_ADDRESS 0xd0009e42 FORMAT "%3.0" /end MEASUREMENT
/begin MEASUREMENT tbl_frf[5].envd_obd[27] "Freeze frame FRF_OBD: environmental data (fixed by law)" UBYTE _CNV_A_R_LINEAR_____0_CM 1 100. 0. 255. DISPLAY_IDENTIFIER ENVD_OBD_28_5 ECU_ADDRESS 0xd0009e43 FORMAT "%3.0" /end MEASUREMENT
/begin MEASUREMENT tbl_frf[5].envd_obd[28] "Freeze frame FRF_OBD: environmental data (fixed by law)" UBYTE _CNV_A_R_LINEAR_____0_CM 1 100. 0. 255. DISPLAY_IDENTIFIER ENVD_OBD_29_5 ECU_ADDRESS 0xd0009e44 FORMAT "%3.0" /end MEASUREMENT
/begin MEASUREMENT tbl_frf[5].envd_obd[29] "Freeze frame FRF_OBD: environmental data (fixed by law)" UBYTE _CNV_A_R_LINEAR_____0_CM 1 100. 0. 255. DISPLAY_IDENTIFIER ENVD_OBD_30_5 ECU_ADDRESS 0xd0009e45 FORMAT "%3.0" /end MEASUREMENT
/begin MEASUREMENT tbl_frf[5].envd_obd[30] "Freeze frame FRF_OBD: environmental data (fixed by law)" UBYTE _CNV_A_R_LINEAR_____0_CM 1 100. 0. 255. DISPLAY_IDENTIFIER ENVD_OBD_31_5 ECU_ADDRESS 0xd0009e46 FORMAT "%3.0" /end MEASUREMENT
/begin MEASUREMENT tbl_frf[5].envd_obd[31] "Freeze frame FRF_OBD: environmental data (fixed by law)" UBYTE _CNV_A_R_LINEAR_____0_CM 1 100. 0. 255. DISPLAY_IDENTIFIER ENVD_OBD_32_5 ECU_ADDRESS 0xd0009e47 FORMAT "%3.0" /end MEASUREMENT
/begin MEASUREMENT tbl_frf[5].envd_obd[32] "Freeze frame FRF_OBD: environmental data (fixed by law)" UBYTE _CNV_A_R_LINEAR_____0_CM 1 100. 0. 255. DISPLAY_IDENTIFIER ENVD_OBD_33_5 ECU_ADDRESS 0xd0009e48 FORMAT "%3.0" /end MEASUREMENT
/begin MEASUREMENT tbl_frf[5].envd_obd[33] "Freeze frame FRF_OBD: environmental data (fixed by law)" UBYTE _CNV_A_R_LINEAR_____0_CM 1 100. 0. 255. DISPLAY_IDENTIFIER ENVD_OBD_34_5 ECU_ADDRESS 0xd0009e49 FORMAT "%3.0" /end MEASUREMENT
/begin MEASUREMENT tbl_frf[5].envd_obd[34] "Freeze frame FRF_OBD: environmental data (fixed by law)" UBYTE _CNV_A_R_LINEAR_____0_CM 1 100. 0. 255. DISPLAY_IDENTIFIER ENVD_OBD[34] ECU_ADDRESS 0xd0009e4a FORMAT "%3.0" /end MEASUREMENT
/begin MEASUREMENT tbl_frf[5].envd_obd[35] "Freeze frame FRF_OBD: environmental data (fixed by law)" UBYTE _CNV_A_R_LINEAR_____0_CM 1 100. 0. 255. DISPLAY_IDENTIFIER ENVD_OBD[35] ECU_ADDRESS 0xd0009e4b FORMAT "%3.0" /end MEASUREMENT
/begin MEASUREMENT tbl_frf[5].envd_obd[36] "Freeze frame FRF_OBD: environmental data (fixed by law)" UBYTE _CNV_A_R_LINEAR_____0_CM 1 100. 0. 255. DISPLAY_IDENTIFIER ENVD_OBD[36] ECU_ADDRESS 0xd0009e4c FORMAT "%3.0" /end MEASUREMENT
/begin MEASUREMENT tbl_frf[5].envd_obd[37] "Freeze frame FRF_OBD: environmental data (fixed by law)" UBYTE _CNV_A_R_LINEAR_____0_CM 1 100. 0. 255. DISPLAY_IDENTIFIER ENVD_OBD[37] ECU_ADDRESS 0xd0009e4d FORMAT "%3.0" /end MEASUREMENT
/begin MEASUREMENT tbl_frf[5].envd_cus_cmn[0] "Freeze frame FRF_CUS_CMN: environmental data common to all failure (not fixed by law)" UBYTE _CNV_A_R_LINEAR_____0_CM 1 100. 0. 255. DISPLAY_IDENTIFIER ENVD_CUS_CMN_1_5 ECU_ADDRESS 0xd0009e4e FORMAT "%3.0" /end MEASUREMENT
/begin MEASUREMENT tbl_frf[5].envd_cus_set_cmn[0][0] "Freeze frame FRF_CUS_SET_CMN: environmental data common to all failure (not fixed by law) stored in set" UBYTE _CNV_A_R_LINEAR_____0_CM 1 100. 0. 255. DISPLAY_IDENTIFIER ENVD_CUS_SET_CMN_1_1_5 ECU_ADDRESS 0xd0009e50 FORMAT "%3.0" /end MEASUREMENT
/begin MEASUREMENT tbl_frf[5].envd_cus_set_cmn[0][1] "Freeze frame FRF_CUS_SET_CMN: environmental data common to all failure (not fixed by law) stored in set" UBYTE _CNV_A_R_LINEAR_____0_CM 1 100. 0. 255. DISPLAY_IDENTIFIER ENVD_CUS_SET_CMN_2_1_5 ECU_ADDRESS 0xd0009e51 FORMAT "%3.0" /end MEASUREMENT
/begin MEASUREMENT tbl_frf[5].envd_cus_set_cmn[0][2] "Freeze frame FRF_CUS_SET_CMN: environmental data common to all failure (not fixed by law) stored in set" UBYTE _CNV_A_R_LINEAR_____0_CM 1 100. 0. 255. DISPLAY_IDENTIFIER ENVD_CUS_SET_CMN_3_1_5 ECU_ADDRESS 0xd0009e52 FORMAT "%3.0" /end MEASUREMENT
/begin MEASUREMENT tbl_frf[5].envd_cus_set_cmn[0][3] "Freeze frame FRF_CUS_SET_CMN: environmental data common to all failure (not fixed by law) stored in set" UBYTE _CNV_A_R_LINEAR_____0_CM 1 100. 0. 255. DISPLAY_IDENTIFIER ENVD_CUS_SET_CMN_0_3_ ECU_ADDRESS 0xd0009e53 FORMAT "%3.0" /end MEASUREMENT
/begin MEASUREMENT tbl_frf[5].envd_cus_set_cmn[0][4] "Freeze frame FRF_CUS_SET_CMN: environmental data common to all failure (not fixed by law) stored in set" UBYTE _CNV_A_R_LINEAR_____0_CM 1 100. 0. 255. DISPLAY_IDENTIFIER ENVD_CUS_SET_CMN_0_4_ ECU_ADDRESS 0xd0009e54 FORMAT "%3.0" /end MEASUREMENT
/begin MEASUREMENT tbl_frf[5].envd_cus_set_cmn[0][5] "Freeze frame FRF_CUS_SET_CMN: environmental data common to all failure (not fixed by law) stored in set" UBYTE _CNV_A_R_LINEAR_____0_CM 1 100. 0. 255. DISPLAY_IDENTIFIER ENVD_CUS_SET_CMN_0_5_ ECU_ADDRESS 0xd0009e55 FORMAT "%3.0" /end MEASUREMENT
/begin MEASUREMENT tbl_frf[5].envd_cus_set_cmn[0][6] "Freeze frame FRF_CUS_SET_CMN: environmental data common to all failure (not fixed by law) stored in set" UBYTE _CNV_A_R_LINEAR_____0_CM 1 100. 0. 255. DISPLAY_IDENTIFIER ENVD_CUS_SET_CMN_0_6_ ECU_ADDRESS 0xd0009e56 FORMAT "%3.0" /end MEASUREMENT
/begin MEASUREMENT tbl_frf[5].envd_cus_set_cmn[0][7] "Freeze frame FRF_CUS_SET_CMN: environmental data common to all failure (not fixed by law) stored in set" UBYTE _CNV_A_R_LINEAR_____0_CM 1 100. 0. 255. DISPLAY_IDENTIFIER ENVD_CUS_SET_CMN_0_7_ ECU_ADDRESS 0xd0009e57 FORMAT "%3.0" /end MEASUREMENT
/begin MEASUREMENT tbl_frf[5].envd_cus_set_cmn[0][8] "Freeze frame FRF_CUS_SET_CMN: environmental data common to all failure (not fixed by law) stored in set" UBYTE _CNV_A_R_LINEAR_____0_CM 1 100. 0. 255. DISPLAY_IDENTIFIER ENVD_CUS_SET_CMN_0_8_ ECU_ADDRESS 0xd0009e58 FORMAT "%3.0" /end MEASUREMENT
/begin MEASUREMENT tbl_frf[5].envd_cus_set_cmn[0][9] "Freeze frame FRF_CUS_SET_CMN: environmental data common to all failure (not fixed by law) stored in set" UBYTE _CNV_A_R_LINEAR_____0_CM 1 100. 0. 255. DISPLAY_IDENTIFIER ENVD_CUS_SET_CMN_0_9_ ECU_ADDRESS 0xd0009e59 FORMAT "%3.0" /end MEASUREMENT
/begin MEASUREMENT tbl_frf[5].envd_cus_set_cmn[1][0] "Freeze frame FRF_CUS_SET_CMN: environmental data common to all failure (not fixed by law) stored in set" UBYTE _CNV_A_R_LINEAR_____0_CM 1 100. 0. 255. DISPLAY_IDENTIFIER ENVD_CUS_SET_CMN_1_2_5 ECU_ADDRESS 0xd0009e5a FORMAT "%3.0" /end MEASUREMENT
/begin MEASUREMENT tbl_frf[5].envd_cus_set_cmn[1][1] "Freeze frame FRF_CUS_SET_CMN: environmental data common to all failure (not fixed by law) stored in set" UBYTE _CNV_A_R_LINEAR_____0_CM 1 100. 0. 255. DISPLAY_IDENTIFIER ENVD_CUS_SET_CMN_2_2_5 ECU_ADDRESS 0xd0009e5b FORMAT "%3.0" /end MEASUREMENT
/begin MEASUREMENT tbl_frf[5].envd_cus_set_cmn[1][2] "Freeze frame FRF_CUS_SET_CMN: environmental data common to all failure (not fixed by law) stored in set" UBYTE _CNV_A_R_LINEAR_____0_CM 1 100. 0. 255. DISPLAY_IDENTIFIER ENVD_CUS_SET_CMN_3_2_5 ECU_ADDRESS 0xd0009e5c FORMAT "%3.0" /end MEASUREMENT
/begin MEASUREMENT tbl_frf[5].envd_cus_set_cmn[1][3] "Freeze frame FRF_CUS_SET_CMN: environmental data common to all failure (not fixed by law) stored in set" UBYTE _CNV_A_R_LINEAR_____0_CM 1 100. 0. 255. DISPLAY_IDENTIFIER ENVD_CUS_SET_CMN_1_3_ ECU_ADDRESS 0xd0009e5d FORMAT "%3.0" /end MEASUREMENT
/begin MEASUREMENT tbl_frf[5].envd_cus_set_cmn[1][4] "Freeze frame FRF_CUS_SET_CMN: environmental data common to all failure (not fixed by law) stored in set" UBYTE _CNV_A_R_LINEAR_____0_CM 1 100. 0. 255. DISPLAY_IDENTIFIER ENVD_CUS_SET_CMN_1_4_ ECU_ADDRESS 0xd0009e5e FORMAT "%3.0" /end MEASUREMENT
/begin MEASUREMENT tbl_frf[5].envd_cus_set_cmn[1][5] "Freeze frame FRF_CUS_SET_CMN: environmental data common to all failure (not fixed by law) stored in set" UBYTE _CNV_A_R_LINEAR_____0_CM 1 100. 0. 255. DISPLAY_IDENTIFIER ENVD_CUS_SET_CMN_1_5_ ECU_ADDRESS 0xd0009e5f FORMAT "%3.0" /end MEASUREMENT
/begin MEASUREMENT tbl_frf[5].envd_cus_set_cmn[1][6] "Freeze frame FRF_CUS_SET_CMN: environmental data common to all failure (not fixed by law) stored in set" UBYTE _CNV_A_R_LINEAR_____0_CM 1 100. 0. 255. DISPLAY_IDENTIFIER ENVD_CUS_SET_CMN_1_6_ ECU_ADDRESS 0xd0009e60 FORMAT "%3.0" /end MEASUREMENT
/begin MEASUREMENT tbl_frf[5].envd_cus_set_cmn[1][7] "Freeze frame FRF_CUS_SET_CMN: environmental data common to all failure (not fixed by law) stored in set" UBYTE _CNV_A_R_LINEAR_____0_CM 1 100. 0. 255. DISPLAY_IDENTIFIER ENVD_CUS_SET_CMN_1_7_ ECU_ADDRESS 0xd0009e61 FORMAT "%3.0" /end MEASUREMENT
/begin MEASUREMENT tbl_frf[5].envd_cus_set_cmn[1][8] "Freeze frame FRF_CUS_SET_CMN: environmental data common to all failure (not fixed by law) stored in set" UBYTE _CNV_A_R_LINEAR_____0_CM 1 100. 0. 255. DISPLAY_IDENTIFIER ENVD_CUS_SET_CMN_1_8_ ECU_ADDRESS 0xd0009e62 FORMAT "%3.0" /end MEASUREMENT
/begin MEASUREMENT tbl_frf[5].envd_cus_set_cmn[1][9] "Freeze frame FRF_CUS_SET_CMN: environmental data common to all failure (not fixed by law) stored in set" UBYTE _CNV_A_R_LINEAR_____0_CM 1 100. 0. 255. DISPLAY_IDENTIFIER ENVD_CUS_SET_CMN_1_9_ ECU_ADDRESS 0xd0009e63 FORMAT "%3.0" /end MEASUREMENT
/begin MEASUREMENT tbl_frf[5].envd_cus_set_cmn[2][0] "Freeze frame FRF_CUS_SET_CMN: environmental data common to all failure (not fixed by law) stored in set" UBYTE _CNV_A_R_LINEAR_____0_CM 1 100. 0. 255. DISPLAY_IDENTIFIER ENVD_CUS_SET_CMN_1_3_5 ECU_ADDRESS 0xd0009e64 FORMAT "%3.0" /end MEASUREMENT
/begin MEASUREMENT tbl_frf[5].envd_cus_set_cmn[2][1] "Freeze frame FRF_CUS_SET_CMN: environmental data common to all failure (not fixed by law) stored in set" UBYTE _CNV_A_R_LINEAR_____0_CM 1 100. 0. 255. DISPLAY_IDENTIFIER ENVD_CUS_SET_CMN_2_3_5 ECU_ADDRESS 0xd0009e65 FORMAT "%3.0" /end MEASUREMENT
/begin MEASUREMENT tbl_frf[5].envd_cus_set_cmn[2][2] "Freeze frame FRF_CUS_SET_CMN: environmental data common to all failure (not fixed by law) stored in set" UBYTE _CNV_A_R_LINEAR_____0_CM 1 100. 0. 255. DISPLAY_IDENTIFIER ENVD_CUS_SET_CMN_3_3_5 ECU_ADDRESS 0xd0009e66 FORMAT "%3.0" /end MEASUREMENT
/begin MEASUREMENT tbl_frf[5].envd_cus_set_cmn[2][3] "Freeze frame FRF_CUS_SET_CMN: environmental data common to all failure (not fixed by law) stored in set" UBYTE _CNV_A_R_LINEAR_____0_CM 1 100. 0. 255. DISPLAY_IDENTIFIER ENVD_CUS_SET_CMN_2_3_ ECU_ADDRESS 0xd0009e67 FORMAT "%3.0" /end MEASUREMENT
/begin MEASUREMENT tbl_frf[5].envd_cus_set_cmn[2][4] "Freeze frame FRF_CUS_SET_CMN: environmental data common to all failure (not fixed by law) stored in set" UBYTE _CNV_A_R_LINEAR_____0_CM 1 100. 0. 255. DISPLAY_IDENTIFIER ENVD_CUS_SET_CMN_2_4_ ECU_ADDRESS 0xd0009e68 FORMAT "%3.0" /end MEASUREMENT
/begin MEASUREMENT tbl_frf[5].envd_cus_set_cmn[2][5] "Freeze frame FRF_CUS_SET_CMN: environmental data common to all failure (not fixed by law) stored in set" UBYTE _CNV_A_R_LINEAR_____0_CM 1 100. 0. 255. DISPLAY_IDENTIFIER ENVD_CUS_SET_CMN_2_5_ ECU_ADDRESS 0xd0009e69 FORMAT "%3.0" /end MEASUREMENT
/begin MEASUREMENT tbl_frf[5].envd_cus_set_cmn[2][6] "Freeze frame FRF_CUS_SET_CMN: environmental data common to all failure (not fixed by law) stored in set" UBYTE _CNV_A_R_LINEAR_____0_CM 1 100. 0. 255. DISPLAY_IDENTIFIER ENVD_CUS_SET_CMN_2_6_ ECU_ADDRESS 0xd0009e6a FORMAT "%3.0" /end MEASUREMENT
/begin MEASUREMENT tbl_frf[5].envd_cus_set_cmn[2][7] "Freeze frame FRF_CUS_SET_CMN: environmental data common to all failure (not fixed by law) stored in set" UBYTE _CNV_A_R_LINEAR_____0_CM 1 100. 0. 255. DISPLAY_IDENTIFIER ENVD_CUS_SET_CMN_2_7_ ECU_ADDRESS 0xd0009e6b FORMAT "%3.0" /end MEASUREMENT
/begin MEASUREMENT tbl_frf[5].envd_cus_set_cmn[2][8] "Freeze frame FRF_CUS_SET_CMN: environmental data common to all failure (not fixed by law) stored in set" UBYTE _CNV_A_R_LINEAR_____0_CM 1 100. 0. 255. DISPLAY_IDENTIFIER ENVD_CUS_SET_CMN_2_8_ ECU_ADDRESS 0xd0009e6c FORMAT "%3.0" /end MEASUREMENT
/begin MEASUREMENT tbl_frf[5].envd_cus_set_cmn[2][9] "Freeze frame FRF_CUS_SET_CMN: environmental data common to all failure (not fixed by law) stored in set" UBYTE _CNV_A_R_LINEAR_____0_CM 1 100. 0. 255. DISPLAY_IDENTIFIER ENVD_CUS_SET_CMN_2_9_ ECU_ADDRESS 0xd0009e6d FORMAT "%3.0" /end MEASUREMENT
/begin MEASUREMENT tbl_frf[5].envd_cus_set_spc[0][0] "Freeze frame FRF_CUS_SET_SPC: environmental data specific to each failure (not fixed by law) stored in set" UBYTE _CNV_A_R_LINEAR_____0_CM 1 100. 0. 255. DISPLAY_IDENTIFIER ENVD_CUS_SET_SPC_1_1_5 ECU_ADDRESS 0xd0009e70 FORMAT "%3.0" /end MEASUREMENT
/begin MEASUREMENT tbl_frf[5].envd_cus_set_spc[0][1] "Freeze frame FRF_CUS_SET_SPC: environmental data specific to each failure (not fixed by law) stored in set" UBYTE _CNV_A_R_LINEAR_____0_CM 1 100. 0. 255. DISPLAY_IDENTIFIER ENVD_CUS_SET_SPC_2_1_5 ECU_ADDRESS 0xd0009e71 FORMAT "%3.0" /end MEASUREMENT
/begin MEASUREMENT tbl_frf[5].envd_cus_set_spc[0][2] "Freeze frame FRF_CUS_SET_SPC: environmental data specific to each failure (not fixed by law) stored in set" UBYTE _CNV_A_R_LINEAR_____0_CM 1 100. 0. 255. DISPLAY_IDENTIFIER ENVD_CUS_SET_SPC_3_1_5 ECU_ADDRESS 0xd0009e72 FORMAT "%3.0" /end MEASUREMENT
/begin MEASUREMENT tbl_frf[5].envd_cus_set_spc[0][3] "Freeze frame FRF_CUS_SET_SPC: environmental data specific to each failure (not fixed by law) stored in set" UBYTE _CNV_A_R_LINEAR_____0_CM 1 100. 0. 255. DISPLAY_IDENTIFIER ENVD_CUS_SET_SPC_4_1_5 ECU_ADDRESS 0xd0009e73 FORMAT "%3.0" /end MEASUREMENT
/begin MEASUREMENT tbl_frf[5].envd_cus_set_spc[1][0] "Freeze frame FRF_CUS_SET_SPC: environmental data specific to each failure (not fixed by law) stored in set" UBYTE _CNV_A_R_LINEAR_____0_CM 1 100. 0. 255. DISPLAY_IDENTIFIER ENVD_CUS_SET_SPC_1_2_5 ECU_ADDRESS 0xd0009e74 FORMAT "%3.0" /end MEASUREMENT
/begin MEASUREMENT tbl_frf[5].envd_cus_set_spc[1][1] "Freeze frame FRF_CUS_SET_SPC: environmental data specific to each failure (not fixed by law) stored in set" UBYTE _CNV_A_R_LINEAR_____0_CM 1 100. 0. 255. DISPLAY_IDENTIFIER ENVD_CUS_SET_SPC_2_2_5 ECU_ADDRESS 0xd0009e75 FORMAT "%3.0" /end MEASUREMENT
/begin MEASUREMENT tbl_frf[5].envd_cus_set_spc[1][2] "Freeze frame FRF_CUS_SET_SPC: environmental data specific to each failure (not fixed by law) stored in set" UBYTE _CNV_A_R_LINEAR_____0_CM 1 100. 0. 255. DISPLAY_IDENTIFIER ENVD_CUS_SET_SPC_3_2_5 ECU_ADDRESS 0xd0009e76 FORMAT "%3.0" /end MEASUREMENT
/begin MEASUREMENT tbl_frf[5].envd_cus_set_spc[1][3] "Freeze frame FRF_CUS_SET_SPC: environmental data specific to each failure (not fixed by law) stored in set" UBYTE _CNV_A_R_LINEAR_____0_CM 1 100. 0. 255. DISPLAY_IDENTIFIER ENVD_CUS_SET_SPC_4_2_5 ECU_ADDRESS 0xd0009e77 FORMAT "%3.0" /end MEASUREMENT
/begin MEASUREMENT tbl_frf[5].envd_cus_set_spc[2][0] "Freeze frame FRF_CUS_SET_SPC: environmental data specific to each failure (not fixed by law) stored in set" UBYTE _CNV_A_R_LINEAR_____0_CM 1 100. 0. 255. DISPLAY_IDENTIFIER ENVD_CUS_SET_SPC_1_3_5 ECU_ADDRESS 0xd0009e78 FORMAT "%3.0" /end MEASUREMENT
/begin MEASUREMENT tbl_frf[5].envd_cus_set_spc[2][1] "Freeze frame FRF_CUS_SET_SPC: environmental data specific to each failure (not fixed by law) stored in set" UBYTE _CNV_A_R_LINEAR_____0_CM 1 100. 0. 255. DISPLAY_IDENTIFIER ENVD_CUS_SET_SPC_2_3_5 ECU_ADDRESS 0xd0009e79 FORMAT "%3.0" /end MEASUREMENT
/begin MEASUREMENT tbl_frf[5].envd_cus_set_spc[2][2] "Freeze frame FRF_CUS_SET_SPC: environmental data specific to each failure (not fixed by law) stored in set" UBYTE _CNV_A_R_LINEAR_____0_CM 1 100. 0. 255. DISPLAY_IDENTIFIER ENVD_CUS_SET_SPC_3_3_5 ECU_ADDRESS 0xd0009e7a FORMAT "%3.0" /end MEASUREMENT
/begin MEASUREMENT tbl_frf[5].envd_cus_set_spc[2][3] "Freeze frame FRF_CUS_SET_SPC: environmental data specific to each failure (not fixed by law) stored in set" UBYTE _CNV_A_R_LINEAR_____0_CM 1 100. 0. 255. DISPLAY_IDENTIFIER ENVD_CUS_SET_SPC_4_3_5 ECU_ADDRESS 0xd0009e7b FORMAT "%3.0" /end MEASUREMENT
/begin MEASUREMENT tbl_frf[6].envd_obd[0] "Freeze frame FRF_OBD: environmental data (fixed by law)" UBYTE _CNV_A_R_LINEAR_____0_CM 1 100. 0. 255. DISPLAY_IDENTIFIER ENVD_OBD_1_6 ECU_ADDRESS 0xd0009e80 FORMAT "%3.0" /end MEASUREMENT
/begin MEASUREMENT tbl_frf[6].envd_obd[1] "Freeze frame FRF_OBD: environmental data (fixed by law)" UBYTE _CNV_A_R_LINEAR_____0_CM 1 100. 0. 255. DISPLAY_IDENTIFIER ENVD_OBD_2_6 ECU_ADDRESS 0xd0009e81 FORMAT "%3.0" /end MEASUREMENT
/begin MEASUREMENT tbl_frf[6].envd_obd[2] "Freeze frame FRF_OBD: environmental data (fixed by law)" UBYTE _CNV_A_R_LINEAR_____0_CM 1 100. 0. 255. DISPLAY_IDENTIFIER ENVD_OBD_3_6 ECU_ADDRESS 0xd0009e82 FORMAT "%3.0" /end MEASUREMENT
/begin MEASUREMENT tbl_frf[6].envd_obd[3] "Freeze frame FRF_OBD: environmental data (fixed by law)" UBYTE _CNV_A_R_LINEAR_____0_CM 1 100. 0. 255. DISPLAY_IDENTIFIER ENVD_OBD_4_6 ECU_ADDRESS 0xd0009e83 FORMAT "%3.0" /end MEASUREMENT
/begin MEASUREMENT tbl_frf[6].envd_obd[4] "Freeze frame FRF_OBD: environmental data (fixed by law)" UBYTE _CNV_A_R_LINEAR_____0_CM 1 100. 0. 255. DISPLAY_IDENTIFIER ENVD_OBD_5_6 ECU_ADDRESS 0xd0009e84 FORMAT "%3.0" /end MEASUREMENT
/begin MEASUREMENT tbl_frf[6].envd_obd[5] "Freeze frame FRF_OBD: environmental data (fixed by law)" UBYTE _CNV_A_R_LINEAR_____0_CM 1 100. 0. 255. DISPLAY_IDENTIFIER ENVD_OBD_6_6 ECU_ADDRESS 0xd0009e85 FORMAT "%3.0" /end MEASUREMENT
/begin MEASUREMENT tbl_frf[6].envd_obd[6] "Freeze frame FRF_OBD: environmental data (fixed by law)" UBYTE _CNV_A_R_LINEAR_____0_CM 1 100. 0. 255. DISPLAY_IDENTIFIER ENVD_OBD_7_6 ECU_ADDRESS 0xd0009e86 FORMAT "%3.0" /end MEASUREMENT
/begin MEASUREMENT tbl_frf[6].envd_obd[7] "Freeze frame FRF_OBD: environmental data (fixed by law)" UBYTE _CNV_A_R_LINEAR_____0_CM 1 100. 0. 255. DISPLAY_IDENTIFIER ENVD_OBD_8_6 ECU_ADDRESS 0xd0009e87 FORMAT "%3.0" /end MEASUREMENT
/begin MEASUREMENT tbl_frf[6].envd_obd[8] "Freeze frame FRF_OBD: environmental data (fixed by law)" UBYTE _CNV_A_R_LINEAR_____0_CM 1 100. 0. 255. DISPLAY_IDENTIFIER ENVD_OBD_9_6 ECU_ADDRESS 0xd0009e88 FORMAT "%3.0" /end MEASUREMENT
/begin MEASUREMENT tbl_frf[6].envd_obd[9] "Freeze frame FRF_OBD: environmental data (fixed by law)" UBYTE _CNV_A_R_LINEAR_____0_CM 1 100. 0. 255. DISPLAY_IDENTIFIER ENVD_OBD_10_6 ECU_ADDRESS 0xd0009e89 FORMAT "%3.0" /end MEASUREMENT
/begin MEASUREMENT tbl_frf[6].envd_obd[10] "Freeze frame FRF_OBD: environmental data (fixed by law)" UBYTE _CNV_A_R_LINEAR_____0_CM 1 100. 0. 255. DISPLAY_IDENTIFIER ENVD_OBD_11_6 ECU_ADDRESS 0xd0009e8a FORMAT "%3.0" /end MEASUREMENT
/begin MEASUREMENT tbl_frf[6].envd_obd[11] "Freeze frame FRF_OBD: environmental data (fixed by law)" UBYTE _CNV_A_R_LINEAR_____0_CM 1 100. 0. 255. DISPLAY_IDENTIFIER ENVD_OBD_12_6 ECU_ADDRESS 0xd0009e8b FORMAT "%3.0" /end MEASUREMENT
/begin MEASUREMENT tbl_frf[6].envd_obd[12] "Freeze frame FRF_OBD: environmental data (fixed by law)" UBYTE _CNV_A_R_LINEAR_____0_CM 1 100. 0. 255. DISPLAY_IDENTIFIER ENVD_OBD_13_6 ECU_ADDRESS 0xd0009e8c FORMAT "%3.0" /end MEASUREMENT
/begin MEASUREMENT tbl_frf[6].envd_obd[13] "Freeze frame FRF_OBD: environmental data (fixed by law)" UBYTE _CNV_A_R_LINEAR_____0_CM 1 100. 0. 255. DISPLAY_IDENTIFIER ENVD_OBD_14_6 ECU_ADDRESS 0xd0009e8d FORMAT "%3.0" /end MEASUREMENT
/begin MEASUREMENT tbl_frf[6].envd_obd[14] "Freeze frame FRF_OBD: environmental data (fixed by law)" UBYTE _CNV_A_R_LINEAR_____0_CM 1 100. 0. 255. DISPLAY_IDENTIFIER ENVD_OBD_15_6 ECU_ADDRESS 0xd0009e8e FORMAT "%3.0" /end MEASUREMENT
/begin MEASUREMENT tbl_frf[6].envd_obd[15] "Freeze frame FRF_OBD: environmental data (fixed by law)" UBYTE _CNV_A_R_LINEAR_____0_CM 1 100. 0. 255. DISPLAY_IDENTIFIER ENVD_OBD_16_6 ECU_ADDRESS 0xd0009e8f FORMAT "%3.0" /end MEASUREMENT
/begin MEASUREMENT tbl_frf[6].envd_obd[16] "Freeze frame FRF_OBD: environmental data (fixed by law)" UBYTE _CNV_A_R_LINEAR_____0_CM 1 100. 0. 255. DISPLAY_IDENTIFIER ENVD_OBD_17_6 ECU_ADDRESS 0xd0009e90 FORMAT "%3.0" /end MEASUREMENT
/begin MEASUREMENT tbl_frf[6].envd_obd[17] "Freeze frame FRF_OBD: environmental data (fixed by law)" UBYTE _CNV_A_R_LINEAR_____0_CM 1 100. 0. 255. DISPLAY_IDENTIFIER ENVD_OBD_18_6 ECU_ADDRESS 0xd0009e91 FORMAT "%3.0" /end MEASUREMENT
/begin MEASUREMENT tbl_frf[6].envd_obd[18] "Freeze frame FRF_OBD: environmental data (fixed by law)" UBYTE _CNV_A_R_LINEAR_____0_CM 1 100. 0. 255. DISPLAY_IDENTIFIER ENVD_OBD_19_6 ECU_ADDRESS 0xd0009e92 FORMAT "%3.0" /end MEASUREMENT
/begin MEASUREMENT tbl_frf[6].envd_obd[19] "Freeze frame FRF_OBD: environmental data (fixed by law)" UBYTE _CNV_A_R_LINEAR_____0_CM 1 100. 0. 255. DISPLAY_IDENTIFIER ENVD_OBD_20_6 ECU_ADDRESS 0xd0009e93 FORMAT "%3.0" /end MEASUREMENT
/begin MEASUREMENT tbl_frf[6].envd_obd[20] "Freeze frame FRF_OBD: environmental data (fixed by law)" UBYTE _CNV_A_R_LINEAR_____0_CM 1 100. 0. 255. DISPLAY_IDENTIFIER ENVD_OBD_21_6 ECU_ADDRESS 0xd0009e94 FORMAT "%3.0" /end MEASUREMENT
/begin MEASUREMENT tbl_frf[6].envd_obd[21] "Freeze frame FRF_OBD: environmental data (fixed by law)" UBYTE _CNV_A_R_LINEAR_____0_CM 1 100. 0. 255. DISPLAY_IDENTIFIER ENVD_OBD_22_6 ECU_ADDRESS 0xd0009e95 FORMAT "%3.0" /end MEASUREMENT
/begin MEASUREMENT tbl_frf[6].envd_obd[22] "Freeze frame FRF_OBD: environmental data (fixed by law)" UBYTE _CNV_A_R_LINEAR_____0_CM 1 100. 0. 255. DISPLAY_IDENTIFIER ENVD_OBD_23_6 ECU_ADDRESS 0xd0009e96 FORMAT "%3.0" /end MEASUREMENT
/begin MEASUREMENT tbl_frf[6].envd_obd[23] "Freeze frame FRF_OBD: environmental data (fixed by law)" UBYTE _CNV_A_R_LINEAR_____0_CM 1 100. 0. 255. DISPLAY_IDENTIFIER ENVD_OBD_24_6 ECU_ADDRESS 0xd0009e97 FORMAT "%3.0" /end MEASUREMENT
/begin MEASUREMENT tbl_frf[6].envd_obd[24] "Freeze frame FRF_OBD: environmental data (fixed by law)" UBYTE _CNV_A_R_LINEAR_____0_CM 1 100. 0. 255. DISPLAY_IDENTIFIER ENVD_OBD_25_6 ECU_ADDRESS 0xd0009e98 FORMAT "%3.0" /end MEASUREMENT
/begin MEASUREMENT tbl_frf[6].envd_obd[25] "Freeze frame FRF_OBD: environmental data (fixed by law)" UBYTE _CNV_A_R_LINEAR_____0_CM 1 100. 0. 255. DISPLAY_IDENTIFIER ENVD_OBD_26_6 ECU_ADDRESS 0xd0009e99 FORMAT "%3.0" /end MEASUREMENT
/begin MEASUREMENT tbl_frf[6].envd_obd[26] "Freeze frame FRF_OBD: environmental data (fixed by law)" UBYTE _CNV_A_R_LINEAR_____0_CM 1 100. 0. 255. DISPLAY_IDENTIFIER ENVD_OBD_27_6 ECU_ADDRESS 0xd0009e9a FORMAT "%3.0" /end MEASUREMENT
/begin MEASUREMENT tbl_frf[6].envd_obd[27] "Freeze frame FRF_OBD: environmental data (fixed by law)" UBYTE _CNV_A_R_LINEAR_____0_CM 1 100. 0. 255. DISPLAY_IDENTIFIER ENVD_OBD_28_6 ECU_ADDRESS 0xd0009e9b FORMAT "%3.0" /end MEASUREMENT
/begin MEASUREMENT tbl_frf[6].envd_obd[28] "Freeze frame FRF_OBD: environmental data (fixed by law)" UBYTE _CNV_A_R_LINEAR_____0_CM 1 100. 0. 255. DISPLAY_IDENTIFIER ENVD_OBD_29_6 ECU_ADDRESS 0xd0009e9c FORMAT "%3.0" /end MEASUREMENT
/begin MEASUREMENT tbl_frf[6].envd_obd[29] "Freeze frame FRF_OBD: environmental data (fixed by law)" UBYTE _CNV_A_R_LINEAR_____0_CM 1 100. 0. 255. DISPLAY_IDENTIFIER ENVD_OBD_30_6 ECU_ADDRESS 0xd0009e9d FORMAT "%3.0" /end MEASUREMENT
/begin MEASUREMENT tbl_frf[6].envd_obd[30] "Freeze frame FRF_OBD: environmental data (fixed by law)" UBYTE _CNV_A_R_LINEAR_____0_CM 1 100. 0. 255. DISPLAY_IDENTIFIER ENVD_OBD_31_6 ECU_ADDRESS 0xd0009e9e FORMAT "%3.0" /end MEASUREMENT
/begin MEASUREMENT tbl_frf[6].envd_obd[31] "Freeze frame FRF_OBD: environmental data (fixed by law)" UBYTE _CNV_A_R_LINEAR_____0_CM 1 100. 0. 255. DISPLAY_IDENTIFIER ENVD_OBD_32_6 ECU_ADDRESS 0xd0009e9f FORMAT "%3.0" /end MEASUREMENT
/begin MEASUREMENT tbl_frf[6].envd_obd[32] "Freeze frame FRF_OBD: environmental data (fixed by law)" UBYTE _CNV_A_R_LINEAR_____0_CM 1 100. 0. 255. DISPLAY_IDENTIFIER ENVD_OBD_33_6 ECU_ADDRESS 0xd0009ea0 FORMAT "%3.0" /end MEASUREMENT
/begin MEASUREMENT tbl_frf[6].envd_obd[33] "Freeze frame FRF_OBD: environmental data (fixed by law)" UBYTE _CNV_A_R_LINEAR_____0_CM 1 100. 0. 255. DISPLAY_IDENTIFIER ENVD_OBD_34_6 ECU_ADDRESS 0xd0009ea1 FORMAT "%3.0" /end MEASUREMENT
/begin MEASUREMENT tbl_frf[6].envd_obd[34] "Freeze frame FRF_OBD: environmental data (fixed by law)" UBYTE _CNV_A_R_LINEAR_____0_CM 1 100. 0. 255. DISPLAY_IDENTIFIER ENVD_OBD[34] ECU_ADDRESS 0xd0009ea2 FORMAT "%3.0" /end MEASUREMENT
/begin MEASUREMENT tbl_frf[6].envd_obd[35] "Freeze frame FRF_OBD: environmental data (fixed by law)" UBYTE _CNV_A_R_LINEAR_____0_CM 1 100. 0. 255. DISPLAY_IDENTIFIER ENVD_OBD[35] ECU_ADDRESS 0xd0009ea3 FORMAT "%3.0" /end MEASUREMENT
/begin MEASUREMENT tbl_frf[6].envd_obd[36] "Freeze frame FRF_OBD: environmental data (fixed by law)" UBYTE _CNV_A_R_LINEAR_____0_CM 1 100. 0. 255. DISPLAY_IDENTIFIER ENVD_OBD[36] ECU_ADDRESS 0xd0009ea4 FORMAT "%3.0" /end MEASUREMENT
/begin MEASUREMENT tbl_frf[6].envd_obd[37] "Freeze frame FRF_OBD: environmental data (fixed by law)" UBYTE _CNV_A_R_LINEAR_____0_CM 1 100. 0. 255. DISPLAY_IDENTIFIER ENVD_OBD[37] ECU_ADDRESS 0xd0009ea5 FORMAT "%3.0" /end MEASUREMENT
/begin MEASUREMENT tbl_frf[6].envd_cus_cmn[0] "Freeze frame FRF_CUS_CMN: environmental data common to all failure (not fixed by law)" UBYTE _CNV_A_R_LINEAR_____0_CM 1 100. 0. 255. DISPLAY_IDENTIFIER ENVD_CUS_CMN_1_6 ECU_ADDRESS 0xd0009ea6 FORMAT "%3.0" /end MEASUREMENT
/begin MEASUREMENT tbl_frf[6].envd_cus_set_cmn[0][0] "Freeze frame FRF_CUS_SET_CMN: environmental data common to all failure (not fixed by law) stored in set" UBYTE _CNV_A_R_LINEAR_____0_CM 1 100. 0. 255. DISPLAY_IDENTIFIER ENVD_CUS_SET_CMN_1_1_6 ECU_ADDRESS 0xd0009ea8 FORMAT "%3.0" /end MEASUREMENT
/begin MEASUREMENT tbl_frf[6].envd_cus_set_cmn[0][1] "Freeze frame FRF_CUS_SET_CMN: environmental data common to all failure (not fixed by law) stored in set" UBYTE _CNV_A_R_LINEAR_____0_CM 1 100. 0. 255. DISPLAY_IDENTIFIER ENVD_CUS_SET_CMN_2_1_6 ECU_ADDRESS 0xd0009ea9 FORMAT "%3.0" /end MEASUREMENT
/begin MEASUREMENT tbl_frf[6].envd_cus_set_cmn[0][2] "Freeze frame FRF_CUS_SET_CMN: environmental data common to all failure (not fixed by law) stored in set" UBYTE _CNV_A_R_LINEAR_____0_CM 1 100. 0. 255. DISPLAY_IDENTIFIER ENVD_CUS_SET_CMN_3_1_6 ECU_ADDRESS 0xd0009eaa FORMAT "%3.0" /end MEASUREMENT
/begin MEASUREMENT tbl_frf[6].envd_cus_set_cmn[0][3] "Freeze frame FRF_CUS_SET_CMN: environmental data common to all failure (not fixed by law) stored in set" UBYTE _CNV_A_R_LINEAR_____0_CM 1 100. 0. 255. DISPLAY_IDENTIFIER ENVD_CUS_SET_CMN_0_3_ ECU_ADDRESS 0xd0009eab FORMAT "%3.0" /end MEASUREMENT
/begin MEASUREMENT tbl_frf[6].envd_cus_set_cmn[0][4] "Freeze frame FRF_CUS_SET_CMN: environmental data common to all failure (not fixed by law) stored in set" UBYTE _CNV_A_R_LINEAR_____0_CM 1 100. 0. 255. DISPLAY_IDENTIFIER ENVD_CUS_SET_CMN_0_4_ ECU_ADDRESS 0xd0009eac FORMAT "%3.0" /end MEASUREMENT
/begin MEASUREMENT tbl_frf[6].envd_cus_set_cmn[0][5] "Freeze frame FRF_CUS_SET_CMN: environmental data common to all failure (not fixed by law) stored in set" UBYTE _CNV_A_R_LINEAR_____0_CM 1 100. 0. 255. DISPLAY_IDENTIFIER ENVD_CUS_SET_CMN_0_5_ ECU_ADDRESS 0xd0009ead FORMAT "%3.0" /end MEASUREMENT
/begin MEASUREMENT tbl_frf[6].envd_cus_set_cmn[0][6] "Freeze frame FRF_CUS_SET_CMN: environmental data common to all failure (not fixed by law) stored in set" UBYTE _CNV_A_R_LINEAR_____0_CM 1 100. 0. 255. DISPLAY_IDENTIFIER ENVD_CUS_SET_CMN_0_6_ ECU_ADDRESS 0xd0009eae FORMAT "%3.0" /end MEASUREMENT
/begin MEASUREMENT tbl_frf[6].envd_cus_set_cmn[0][7] "Freeze frame FRF_CUS_SET_CMN: environmental data common to all failure (not fixed by law) stored in set" UBYTE _CNV_A_R_LINEAR_____0_CM 1 100. 0. 255. DISPLAY_IDENTIFIER ENVD_CUS_SET_CMN_0_7_ ECU_ADDRESS 0xd0009eaf FORMAT "%3.0" /end MEASUREMENT
/begin MEASUREMENT tbl_frf[6].envd_cus_set_cmn[0][8] "Freeze frame FRF_CUS_SET_CMN: environmental data common to all failure (not fixed by law) stored in set" UBYTE _CNV_A_R_LINEAR_____0_CM 1 100. 0. 255. DISPLAY_IDENTIFIER ENVD_CUS_SET_CMN_0_8_ ECU_ADDRESS 0xd0009eb0 FORMAT "%3.0" /end MEASUREMENT
/begin MEASUREMENT tbl_frf[6].envd_cus_set_cmn[0][9] "Freeze frame FRF_CUS_SET_CMN: environmental data common to all failure (not fixed by law) stored in set" UBYTE _CNV_A_R_LINEAR_____0_CM 1 100. 0. 255. DISPLAY_IDENTIFIER ENVD_CUS_SET_CMN_0_9_ ECU_ADDRESS 0xd0009eb1 FORMAT "%3.0" /end MEASUREMENT
/begin MEASUREMENT tbl_frf[6].envd_cus_set_cmn[1][0] "Freeze frame FRF_CUS_SET_CMN: environmental data common to all failure (not fixed by law) stored in set" UBYTE _CNV_A_R_LINEAR_____0_CM 1 100. 0. 255. DISPLAY_IDENTIFIER ENVD_CUS_SET_CMN_1_2_6 ECU_ADDRESS 0xd0009eb2 FORMAT "%3.0" /end MEASUREMENT
/begin MEASUREMENT tbl_frf[6].envd_cus_set_cmn[1][1] "Freeze frame FRF_CUS_SET_CMN: environmental data common to all failure (not fixed by law) stored in set" UBYTE _CNV_A_R_LINEAR_____0_CM 1 100. 0. 255. DISPLAY_IDENTIFIER ENVD_CUS_SET_CMN_2_2_6 ECU_ADDRESS 0xd0009eb3 FORMAT "%3.0" /end MEASUREMENT
/begin MEASUREMENT tbl_frf[6].envd_cus_set_cmn[1][2] "Freeze frame FRF_CUS_SET_CMN: environmental data common to all failure (not fixed by law) stored in set" UBYTE _CNV_A_R_LINEAR_____0_CM 1 100. 0. 255. DISPLAY_IDENTIFIER ENVD_CUS_SET_CMN_3_2_6 ECU_ADDRESS 0xd0009eb4 FORMAT "%3.0" /end MEASUREMENT
/begin MEASUREMENT tbl_frf[6].envd_cus_set_cmn[1][3] "Freeze frame FRF_CUS_SET_CMN: environmental data common to all failure (not fixed by law) stored in set" UBYTE _CNV_A_R_LINEAR_____0_CM 1 100. 0. 255. DISPLAY_IDENTIFIER ENVD_CUS_SET_CMN_1_3_ ECU_ADDRESS 0xd0009eb5 FORMAT "%3.0" /end MEASUREMENT
/begin MEASUREMENT tbl_frf[6].envd_cus_set_cmn[1][4] "Freeze frame FRF_CUS_SET_CMN: environmental data common to all failure (not fixed by law) stored in set" UBYTE _CNV_A_R_LINEAR_____0_CM 1 100. 0. 255. DISPLAY_IDENTIFIER ENVD_CUS_SET_CMN_1_4_ ECU_ADDRESS 0xd0009eb6 FORMAT "%3.0" /end MEASUREMENT
/begin MEASUREMENT tbl_frf[6].envd_cus_set_cmn[1][5] "Freeze frame FRF_CUS_SET_CMN: environmental data common to all failure (not fixed by law) stored in set" UBYTE _CNV_A_R_LINEAR_____0_CM 1 100. 0. 255. DISPLAY_IDENTIFIER ENVD_CUS_SET_CMN_1_5_ ECU_ADDRESS 0xd0009eb7 FORMAT "%3.0" /end MEASUREMENT
/begin MEASUREMENT tbl_frf[6].envd_cus_set_cmn[1][6] "Freeze frame FRF_CUS_SET_CMN: environmental data common to all failure (not fixed by law) stored in set" UBYTE _CNV_A_R_LINEAR_____0_CM 1 100. 0. 255. DISPLAY_IDENTIFIER ENVD_CUS_SET_CMN_1_6_ ECU_ADDRESS 0xd0009eb8 FORMAT "%3.0" /end MEASUREMENT
/begin MEASUREMENT tbl_frf[6].envd_cus_set_cmn[1][7] "Freeze frame FRF_CUS_SET_CMN: environmental data common to all failure (not fixed by law) stored in set" UBYTE _CNV_A_R_LINEAR_____0_CM 1 100. 0. 255. DISPLAY_IDENTIFIER ENVD_CUS_SET_CMN_1_7_ ECU_ADDRESS 0xd0009eb9 FORMAT "%3.0" /end MEASUREMENT
/begin MEASUREMENT tbl_frf[6].envd_cus_set_cmn[1][8] "Freeze frame FRF_CUS_SET_CMN: environmental data common to all failure (not fixed by law) stored in set" UBYTE _CNV_A_R_LINEAR_____0_CM 1 100. 0. 255. DISPLAY_IDENTIFIER ENVD_CUS_SET_CMN_1_8_ ECU_ADDRESS 0xd0009eba FORMAT "%3.0" /end MEASUREMENT
/begin MEASUREMENT tbl_frf[6].envd_cus_set_cmn[1][9] "Freeze frame FRF_CUS_SET_CMN: environmental data common to all failure (not fixed by law) stored in set" UBYTE _CNV_A_R_LINEAR_____0_CM 1 100. 0. 255. DISPLAY_IDENTIFIER ENVD_CUS_SET_CMN_1_9_ ECU_ADDRESS 0xd0009ebb FORMAT "%3.0" /end MEASUREMENT
/begin MEASUREMENT tbl_frf[6].envd_cus_set_cmn[2][0] "Freeze frame FRF_CUS_SET_CMN: environmental data common to all failure (not fixed by law) stored in set" UBYTE _CNV_A_R_LINEAR_____0_CM 1 100. 0. 255. DISPLAY_IDENTIFIER ENVD_CUS_SET_CMN_1_3_6 ECU_ADDRESS 0xd0009ebc FORMAT "%3.0" /end MEASUREMENT
/begin MEASUREMENT tbl_frf[6].envd_cus_set_cmn[2][1] "Freeze frame FRF_CUS_SET_CMN: environmental data common to all failure (not fixed by law) stored in set" UBYTE _CNV_A_R_LINEAR_____0_CM 1 100. 0. 255. DISPLAY_IDENTIFIER ENVD_CUS_SET_CMN_2_3_6 ECU_ADDRESS 0xd0009ebd FORMAT "%3.0" /end MEASUREMENT
/begin MEASUREMENT tbl_frf[6].envd_cus_set_cmn[2][2] "Freeze frame FRF_CUS_SET_CMN: environmental data common to all failure (not fixed by law) stored in set" UBYTE _CNV_A_R_LINEAR_____0_CM 1 100. 0. 255. DISPLAY_IDENTIFIER ENVD_CUS_SET_CMN_3_3_6 ECU_ADDRESS 0xd0009ebe FORMAT "%3.0" /end MEASUREMENT
/begin MEASUREMENT tbl_frf[6].envd_cus_set_cmn[2][3] "Freeze frame FRF_CUS_SET_CMN: environmental data common to all failure (not fixed by law) stored in set" UBYTE _CNV_A_R_LINEAR_____0_CM 1 100. 0. 255. DISPLAY_IDENTIFIER ENVD_CUS_SET_CMN_2_3_ ECU_ADDRESS 0xd0009ebf FORMAT "%3.0" /end MEASUREMENT
/begin MEASUREMENT tbl_frf[6].envd_cus_set_cmn[2][4] "Freeze frame FRF_CUS_SET_CMN: environmental data common to all failure (not fixed by law) stored in set" UBYTE _CNV_A_R_LINEAR_____0_CM 1 100. 0. 255. DISPLAY_IDENTIFIER ENVD_CUS_SET_CMN_2_4_ ECU_ADDRESS 0xd0009ec0 FORMAT "%3.0" /end MEASUREMENT
/begin MEASUREMENT tbl_frf[6].envd_cus_set_cmn[2][5] "Freeze frame FRF_CUS_SET_CMN: environmental data common to all failure (not fixed by law) stored in set" UBYTE _CNV_A_R_LINEAR_____0_CM 1 100. 0. 255. DISPLAY_IDENTIFIER ENVD_CUS_SET_CMN_2_5_ ECU_ADDRESS 0xd0009ec1 FORMAT "%3.0" /end MEASUREMENT
/begin MEASUREMENT tbl_frf[6].envd_cus_set_cmn[2][6] "Freeze frame FRF_CUS_SET_CMN: environmental data common to all failure (not fixed by law) stored in set" UBYTE _CNV_A_R_LINEAR_____0_CM 1 100. 0. 255. DISPLAY_IDENTIFIER ENVD_CUS_SET_CMN_2_6_ ECU_ADDRESS 0xd0009ec2 FORMAT "%3.0" /end MEASUREMENT
/begin MEASUREMENT tbl_frf[6].envd_cus_set_cmn[2][7] "Freeze frame FRF_CUS_SET_CMN: environmental data common to all failure (not fixed by law) stored in set" UBYTE _CNV_A_R_LINEAR_____0_CM 1 100. 0. 255. DISPLAY_IDENTIFIER ENVD_CUS_SET_CMN_2_7_ ECU_ADDRESS 0xd0009ec3 FORMAT "%3.0" /end MEASUREMENT
/begin MEASUREMENT tbl_frf[6].envd_cus_set_cmn[2][8] "Freeze frame FRF_CUS_SET_CMN: environmental data common to all failure (not fixed by law) stored in set" UBYTE _CNV_A_R_LINEAR_____0_CM 1 100. 0. 255. DISPLAY_IDENTIFIER ENVD_CUS_SET_CMN_2_8_ ECU_ADDRESS 0xd0009ec4 FORMAT "%3.0" /end MEASUREMENT
/begin MEASUREMENT tbl_frf[6].envd_cus_set_cmn[2][9] "Freeze frame FRF_CUS_SET_CMN: environmental data common to all failure (not fixed by law) stored in set" UBYTE _CNV_A_R_LINEAR_____0_CM 1 100. 0. 255. DISPLAY_IDENTIFIER ENVD_CUS_SET_CMN_2_9_ ECU_ADDRESS 0xd0009ec5 FORMAT "%3.0" /end MEASUREMENT
/begin MEASUREMENT tbl_frf[6].envd_cus_set_spc[0][0] "Freeze frame FRF_CUS_SET_SPC: environmental data specific to each failure (not fixed by law) stored in set" UBYTE _CNV_A_R_LINEAR_____0_CM 1 100. 0. 255. DISPLAY_IDENTIFIER ENVD_CUS_SET_SPC_1_1_6 ECU_ADDRESS 0xd0009ec8 FORMAT "%3.0" /end MEASUREMENT
/begin MEASUREMENT tbl_frf[6].envd_cus_set_spc[0][1] "Freeze frame FRF_CUS_SET_SPC: environmental data specific to each failure (not fixed by law) stored in set" UBYTE _CNV_A_R_LINEAR_____0_CM 1 100. 0. 255. DISPLAY_IDENTIFIER ENVD_CUS_SET_SPC_2_1_6 ECU_ADDRESS 0xd0009ec9 FORMAT "%3.0" /end MEASUREMENT
/begin MEASUREMENT tbl_frf[6].envd_cus_set_spc[0][2] "Freeze frame FRF_CUS_SET_SPC: environmental data specific to each failure (not fixed by law) stored in set" UBYTE _CNV_A_R_LINEAR_____0_CM 1 100. 0. 255. DISPLAY_IDENTIFIER ENVD_CUS_SET_SPC_3_1_6 ECU_ADDRESS 0xd0009eca FORMAT "%3.0" /end MEASUREMENT
/begin MEASUREMENT tbl_frf[6].envd_cus_set_spc[0][3] "Freeze frame FRF_CUS_SET_SPC: environmental data specific to each failure (not fixed by law) stored in set" UBYTE _CNV_A_R_LINEAR_____0_CM 1 100. 0. 255. DISPLAY_IDENTIFIER ENVD_CUS_SET_SPC_4_1_6 ECU_ADDRESS 0xd0009ecb FORMAT "%3.0" /end MEASUREMENT
/begin MEASUREMENT tbl_frf[6].envd_cus_set_spc[1][0] "Freeze frame FRF_CUS_SET_SPC: environmental data specific to each failure (not fixed by law) stored in set" UBYTE _CNV_A_R_LINEAR_____0_CM 1 100. 0. 255. DISPLAY_IDENTIFIER ENVD_CUS_SET_SPC_1_2_6 ECU_ADDRESS 0xd0009ecc FORMAT "%3.0" /end MEASUREMENT
/begin MEASUREMENT tbl_frf[6].envd_cus_set_spc[1][1] "Freeze frame FRF_CUS_SET_SPC: environmental data specific to each failure (not fixed by law) stored in set" UBYTE _CNV_A_R_LINEAR_____0_CM 1 100. 0. 255. DISPLAY_IDENTIFIER ENVD_CUS_SET_SPC_2_2_6 ECU_ADDRESS 0xd0009ecd FORMAT "%3.0" /end MEASUREMENT
/begin MEASUREMENT tbl_frf[6].envd_cus_set_spc[1][2] "Freeze frame FRF_CUS_SET_SPC: environmental data specific to each failure (not fixed by law) stored in set" UBYTE _CNV_A_R_LINEAR_____0_CM 1 100. 0. 255. DISPLAY_IDENTIFIER ENVD_CUS_SET_SPC_3_2_6 ECU_ADDRESS 0xd0009ece FORMAT "%3.0" /end MEASUREMENT
/begin MEASUREMENT tbl_frf[6].envd_cus_set_spc[1][3] "Freeze frame FRF_CUS_SET_SPC: environmental data specific to each failure (not fixed by law) stored in set" UBYTE _CNV_A_R_LINEAR_____0_CM 1 100. 0. 255. DISPLAY_IDENTIFIER ENVD_CUS_SET_SPC_4_2_6 ECU_ADDRESS 0xd0009ecf FORMAT "%3.0" /end MEASUREMENT
/begin MEASUREMENT tbl_frf[6].envd_cus_set_spc[2][0] "Freeze frame FRF_CUS_SET_SPC: environmental data specific to each failure (not fixed by law) stored in set" UBYTE _CNV_A_R_LINEAR_____0_CM 1 100. 0. 255. DISPLAY_IDENTIFIER ENVD_CUS_SET_SPC_1_3_6 ECU_ADDRESS 0xd0009ed0 FORMAT "%3.0" /end MEASUREMENT
/begin MEASUREMENT tbl_frf[6].envd_cus_set_spc[2][1] "Freeze frame FRF_CUS_SET_SPC: environmental data specific to each failure (not fixed by law) stored in set" UBYTE _CNV_A_R_LINEAR_____0_CM 1 100. 0. 255. DISPLAY_IDENTIFIER ENVD_CUS_SET_SPC_2_3_6 ECU_ADDRESS 0xd0009ed1 FORMAT "%3.0" /end MEASUREMENT
/begin MEASUREMENT tbl_frf[6].envd_cus_set_spc[2][2] "Freeze frame FRF_CUS_SET_SPC: environmental data specific to each failure (not fixed by law) stored in set" UBYTE _CNV_A_R_LINEAR_____0_CM 1 100. 0. 255. DISPLAY_IDENTIFIER ENVD_CUS_SET_SPC_3_3_6 ECU_ADDRESS 0xd0009ed2 FORMAT "%3.0" /end MEASUREMENT
/begin MEASUREMENT tbl_frf[6].envd_cus_set_spc[2][3] "Freeze frame FRF_CUS_SET_SPC: environmental data specific to each failure (not fixed by law) stored in set" UBYTE _CNV_A_R_LINEAR_____0_CM 1 100. 0. 255. DISPLAY_IDENTIFIER ENVD_CUS_SET_SPC_4_3_6 ECU_ADDRESS 0xd0009ed3 FORMAT "%3.0" /end MEASUREMENT
/begin MEASUREMENT tbl_frf[7].envd_obd[0] "Freeze frame FRF_OBD: environmental data (fixed by law)" UBYTE _CNV_A_R_LINEAR_____0_CM 1 100. 0. 255. DISPLAY_IDENTIFIER ENVD_OBD_1_7 ECU_ADDRESS 0xd0009ed8 FORMAT "%3.0" /end MEASUREMENT
/begin MEASUREMENT tbl_frf[7].envd_obd[1] "Freeze frame FRF_OBD: environmental data (fixed by law)" UBYTE _CNV_A_R_LINEAR_____0_CM 1 100. 0. 255. DISPLAY_IDENTIFIER ENVD_OBD_2_7 ECU_ADDRESS 0xd0009ed9 FORMAT "%3.0" /end MEASUREMENT
/begin MEASUREMENT tbl_frf[7].envd_obd[2] "Freeze frame FRF_OBD: environmental data (fixed by law)" UBYTE _CNV_A_R_LINEAR_____0_CM 1 100. 0. 255. DISPLAY_IDENTIFIER ENVD_OBD_3_7 ECU_ADDRESS 0xd0009eda FORMAT "%3.0" /end MEASUREMENT
/begin MEASUREMENT tbl_frf[7].envd_obd[3] "Freeze frame FRF_OBD: environmental data (fixed by law)" UBYTE _CNV_A_R_LINEAR_____0_CM 1 100. 0. 255. DISPLAY_IDENTIFIER ENVD_OBD_4_7 ECU_ADDRESS 0xd0009edb FORMAT "%3.0" /end MEASUREMENT
/begin MEASUREMENT tbl_frf[7].envd_obd[4] "Freeze frame FRF_OBD: environmental data (fixed by law)" UBYTE _CNV_A_R_LINEAR_____0_CM 1 100. 0. 255. DISPLAY_IDENTIFIER ENVD_OBD_5_7 ECU_ADDRESS 0xd0009edc FORMAT "%3.0" /end MEASUREMENT
/begin MEASUREMENT tbl_frf[7].envd_obd[5] "Freeze frame FRF_OBD: environmental data (fixed by law)" UBYTE _CNV_A_R_LINEAR_____0_CM 1 100. 0. 255. DISPLAY_IDENTIFIER ENVD_OBD_6_7 ECU_ADDRESS 0xd0009edd FORMAT "%3.0" /end MEASUREMENT
/begin MEASUREMENT tbl_frf[7].envd_obd[6] "Freeze frame FRF_OBD: environmental data (fixed by law)" UBYTE _CNV_A_R_LINEAR_____0_CM 1 100. 0. 255. DISPLAY_IDENTIFIER ENVD_OBD_7_7 ECU_ADDRESS 0xd0009ede FORMAT "%3.0" /end MEASUREMENT
/begin MEASUREMENT tbl_frf[7].envd_obd[7] "Freeze frame FRF_OBD: environmental data (fixed by law)" UBYTE _CNV_A_R_LINEAR_____0_CM 1 100. 0. 255. DISPLAY_IDENTIFIER ENVD_OBD_8_7 ECU_ADDRESS 0xd0009edf FORMAT "%3.0" /end MEASUREMENT
/begin MEASUREMENT tbl_frf[7].envd_obd[8] "Freeze frame FRF_OBD: environmental data (fixed by law)" UBYTE _CNV_A_R_LINEAR_____0_CM 1 100. 0. 255. DISPLAY_IDENTIFIER ENVD_OBD_9_7 ECU_ADDRESS 0xd0009ee0 FORMAT "%3.0" /end MEASUREMENT
/begin MEASUREMENT tbl_frf[7].envd_obd[9] "Freeze frame FRF_OBD: environmental data (fixed by law)" UBYTE _CNV_A_R_LINEAR_____0_CM 1 100. 0. 255. DISPLAY_IDENTIFIER ENVD_OBD_10_7 ECU_ADDRESS 0xd0009ee1 FORMAT "%3.0" /end MEASUREMENT
/begin MEASUREMENT tbl_frf[7].envd_obd[10] "Freeze frame FRF_OBD: environmental data (fixed by law)" UBYTE _CNV_A_R_LINEAR_____0_CM 1 100. 0. 255. DISPLAY_IDENTIFIER ENVD_OBD_11_7 ECU_ADDRESS 0xd0009ee2 FORMAT "%3.0" /end MEASUREMENT
/begin MEASUREMENT tbl_frf[7].envd_obd[11] "Freeze frame FRF_OBD: environmental data (fixed by law)" UBYTE _CNV_A_R_LINEAR_____0_CM 1 100. 0. 255. DISPLAY_IDENTIFIER ENVD_OBD_12_7 ECU_ADDRESS 0xd0009ee3 FORMAT "%3.0" /end MEASUREMENT
/begin MEASUREMENT tbl_frf[7].envd_obd[12] "Freeze frame FRF_OBD: environmental data (fixed by law)" UBYTE _CNV_A_R_LINEAR_____0_CM 1 100. 0. 255. DISPLAY_IDENTIFIER ENVD_OBD_13_7 ECU_ADDRESS 0xd0009ee4 FORMAT "%3.0" /end MEASUREMENT
/begin MEASUREMENT tbl_frf[7].envd_obd[13] "Freeze frame FRF_OBD: environmental data (fixed by law)" UBYTE _CNV_A_R_LINEAR_____0_CM 1 100. 0. 255. DISPLAY_IDENTIFIER ENVD_OBD_14_7 ECU_ADDRESS 0xd0009ee5 FORMAT "%3.0" /end MEASUREMENT
/begin MEASUREMENT tbl_frf[7].envd_obd[14] "Freeze frame FRF_OBD: environmental data (fixed by law)" UBYTE _CNV_A_R_LINEAR_____0_CM 1 100. 0. 255. DISPLAY_IDENTIFIER ENVD_OBD_15_7 ECU_ADDRESS 0xd0009ee6 FORMAT "%3.0" /end MEASUREMENT
/begin MEASUREMENT tbl_frf[7].envd_obd[15] "Freeze frame FRF_OBD: environmental data (fixed by law)" UBYTE _CNV_A_R_LINEAR_____0_CM 1 100. 0. 255. DISPLAY_IDENTIFIER ENVD_OBD_16_7 ECU_ADDRESS 0xd0009ee7 FORMAT "%3.0" /end MEASUREMENT
/begin MEASUREMENT tbl_frf[7].envd_obd[16] "Freeze frame FRF_OBD: environmental data (fixed by law)" UBYTE _CNV_A_R_LINEAR_____0_CM 1 100. 0. 255. DISPLAY_IDENTIFIER ENVD_OBD_17_7 ECU_ADDRESS 0xd0009ee8 FORMAT "%3.0" /end MEASUREMENT
/begin MEASUREMENT tbl_frf[7].envd_obd[17] "Freeze frame FRF_OBD: environmental data (fixed by law)" UBYTE _CNV_A_R_LINEAR_____0_CM 1 100. 0. 255. DISPLAY_IDENTIFIER ENVD_OBD_18_7 ECU_ADDRESS 0xd0009ee9 FORMAT "%3.0" /end MEASUREMENT
/begin MEASUREMENT tbl_frf[7].envd_obd[18] "Freeze frame FRF_OBD: environmental data (fixed by law)" UBYTE _CNV_A_R_LINEAR_____0_CM 1 100. 0. 255. DISPLAY_IDENTIFIER ENVD_OBD_19_7 ECU_ADDRESS 0xd0009eea FORMAT "%3.0" /end MEASUREMENT
/begin MEASUREMENT tbl_frf[7].envd_obd[19] "Freeze frame FRF_OBD: environmental data (fixed by law)" UBYTE _CNV_A_R_LINEAR_____0_CM 1 100. 0. 255. DISPLAY_IDENTIFIER ENVD_OBD_20_7 ECU_ADDRESS 0xd0009eeb FORMAT "%3.0" /end MEASUREMENT
/begin MEASUREMENT tbl_frf[7].envd_obd[20] "Freeze frame FRF_OBD: environmental data (fixed by law)" UBYTE _CNV_A_R_LINEAR_____0_CM 1 100. 0. 255. DISPLAY_IDENTIFIER ENVD_OBD_21_7 ECU_ADDRESS 0xd0009eec FORMAT "%3.0" /end MEASUREMENT
/begin MEASUREMENT tbl_frf[7].envd_obd[21] "Freeze frame FRF_OBD: environmental data (fixed by law)" UBYTE _CNV_A_R_LINEAR_____0_CM 1 100. 0. 255. DISPLAY_IDENTIFIER ENVD_OBD_22_7 ECU_ADDRESS 0xd0009eed FORMAT "%3.0" /end MEASUREMENT
/begin MEASUREMENT tbl_frf[7].envd_obd[22] "Freeze frame FRF_OBD: environmental data (fixed by law)" UBYTE _CNV_A_R_LINEAR_____0_CM 1 100. 0. 255. DISPLAY_IDENTIFIER ENVD_OBD_23_7 ECU_ADDRESS 0xd0009eee FORMAT "%3.0" /end MEASUREMENT
/begin MEASUREMENT tbl_frf[7].envd_obd[23] "Freeze frame FRF_OBD: environmental data (fixed by law)" UBYTE _CNV_A_R_LINEAR_____0_CM 1 100. 0. 255. DISPLAY_IDENTIFIER ENVD_OBD_24_7 ECU_ADDRESS 0xd0009eef FORMAT "%3.0" /end MEASUREMENT
/begin MEASUREMENT tbl_frf[7].envd_obd[24] "Freeze frame FRF_OBD: environmental data (fixed by law)" UBYTE _CNV_A_R_LINEAR_____0_CM 1 100. 0. 255. DISPLAY_IDENTIFIER ENVD_OBD_25_7 ECU_ADDRESS 0xd0009ef0 FORMAT "%3.0" /end MEASUREMENT
/begin MEASUREMENT tbl_frf[7].envd_obd[25] "Freeze frame FRF_OBD: environmental data (fixed by law)" UBYTE _CNV_A_R_LINEAR_____0_CM 1 100. 0. 255. DISPLAY_IDENTIFIER ENVD_OBD_26_7 ECU_ADDRESS 0xd0009ef1 FORMAT "%3.0" /end MEASUREMENT
/begin MEASUREMENT tbl_frf[7].envd_obd[26] "Freeze frame FRF_OBD: environmental data (fixed by law)" UBYTE _CNV_A_R_LINEAR_____0_CM 1 100. 0. 255. DISPLAY_IDENTIFIER ENVD_OBD_27_7 ECU_ADDRESS 0xd0009ef2 FORMAT "%3.0" /end MEASUREMENT
/begin MEASUREMENT tbl_frf[7].envd_obd[27] "Freeze frame FRF_OBD: environmental data (fixed by law)" UBYTE _CNV_A_R_LINEAR_____0_CM 1 100. 0. 255. DISPLAY_IDENTIFIER ENVD_OBD_28_7 ECU_ADDRESS 0xd0009ef3 FORMAT "%3.0" /end MEASUREMENT
/begin MEASUREMENT tbl_frf[7].envd_obd[28] "Freeze frame FRF_OBD: environmental data (fixed by law)" UBYTE _CNV_A_R_LINEAR_____0_CM 1 100. 0. 255. DISPLAY_IDENTIFIER ENVD_OBD_29_7 ECU_ADDRESS 0xd0009ef4 FORMAT "%3.0" /end MEASUREMENT
/begin MEASUREMENT tbl_frf[7].envd_obd[29] "Freeze frame FRF_OBD: environmental data (fixed by law)" UBYTE _CNV_A_R_LINEAR_____0_CM 1 100. 0. 255. DISPLAY_IDENTIFIER ENVD_OBD_30_7 ECU_ADDRESS 0xd0009ef5 FORMAT "%3.0" /end MEASUREMENT
/begin MEASUREMENT tbl_frf[7].envd_obd[30] "Freeze frame FRF_OBD: environmental data (fixed by law)" UBYTE _CNV_A_R_LINEAR_____0_CM 1 100. 0. 255. DISPLAY_IDENTIFIER ENVD_OBD_31_7 ECU_ADDRESS 0xd0009ef6 FORMAT "%3.0" /end MEASUREMENT
/begin MEASUREMENT tbl_frf[7].envd_obd[31] "Freeze frame FRF_OBD: environmental data (fixed by law)" UBYTE _CNV_A_R_LINEAR_____0_CM 1 100. 0. 255. DISPLAY_IDENTIFIER ENVD_OBD_32_7 ECU_ADDRESS 0xd0009ef7 FORMAT "%3.0" /end MEASUREMENT
/begin MEASUREMENT tbl_frf[7].envd_obd[32] "Freeze frame FRF_OBD: environmental data (fixed by law)" UBYTE _CNV_A_R_LINEAR_____0_CM 1 100. 0. 255. DISPLAY_IDENTIFIER ENVD_OBD_33_7 ECU_ADDRESS 0xd0009ef8 FORMAT "%3.0" /end MEASUREMENT
/begin MEASUREMENT tbl_frf[7].envd_obd[33] "Freeze frame FRF_OBD: environmental data (fixed by law)" UBYTE _CNV_A_R_LINEAR_____0_CM 1 100. 0. 255. DISPLAY_IDENTIFIER ENVD_OBD_34_7 ECU_ADDRESS 0xd0009ef9 FORMAT "%3.0" /end MEASUREMENT
/begin MEASUREMENT tbl_frf[7].envd_obd[34] "Freeze frame FRF_OBD: environmental data (fixed by law)" UBYTE _CNV_A_R_LINEAR_____0_CM 1 100. 0. 255. DISPLAY_IDENTIFIER ENVD_OBD[34] ECU_ADDRESS 0xd0009efa FORMAT "%3.0" /end MEASUREMENT
/begin MEASUREMENT tbl_frf[7].envd_obd[35] "Freeze frame FRF_OBD: environmental data (fixed by law)" UBYTE _CNV_A_R_LINEAR_____0_CM 1 100. 0. 255. DISPLAY_IDENTIFIER ENVD_OBD[35] ECU_ADDRESS 0xd0009efb FORMAT "%3.0" /end MEASUREMENT
/begin MEASUREMENT tbl_frf[7].envd_obd[36] "Freeze frame FRF_OBD: environmental data (fixed by law)" UBYTE _CNV_A_R_LINEAR_____0_CM 1 100. 0. 255. DISPLAY_IDENTIFIER ENVD_OBD[36] ECU_ADDRESS 0xd0009efc FORMAT "%3.0" /end MEASUREMENT
/begin MEASUREMENT tbl_frf[7].envd_obd[37] "Freeze frame FRF_OBD: environmental data (fixed by law)" UBYTE _CNV_A_R_LINEAR_____0_CM 1 100. 0. 255. DISPLAY_IDENTIFIER ENVD_OBD[37] ECU_ADDRESS 0xd0009efd FORMAT "%3.0" /end MEASUREMENT
/begin MEASUREMENT tbl_frf[7].envd_cus_cmn[0] "Freeze frame FRF_CUS_CMN: environmental data common to all failure (not fixed by law)" UBYTE _CNV_A_R_LINEAR_____0_CM 1 100. 0. 255. DISPLAY_IDENTIFIER ENVD_CUS_CMN_1_7 ECU_ADDRESS 0xd0009efe FORMAT "%3.0" /end MEASUREMENT
/begin MEASUREMENT tbl_frf[7].envd_cus_set_cmn[0][0] "Freeze frame FRF_CUS_SET_CMN: environmental data common to all failure (not fixed by law) stored in set" UBYTE _CNV_A_R_LINEAR_____0_CM 1 100. 0. 255. DISPLAY_IDENTIFIER ENVD_CUS_SET_CMN_1_1_7 ECU_ADDRESS 0xd0009f00 FORMAT "%3.0" /end MEASUREMENT
/begin MEASUREMENT tbl_frf[7].envd_cus_set_cmn[0][1] "Freeze frame FRF_CUS_SET_CMN: environmental data common to all failure (not fixed by law) stored in set" UBYTE _CNV_A_R_LINEAR_____0_CM 1 100. 0. 255. DISPLAY_IDENTIFIER ENVD_CUS_SET_CMN_2_1_7 ECU_ADDRESS 0xd0009f01 FORMAT "%3.0" /end MEASUREMENT
/begin MEASUREMENT tbl_frf[7].envd_cus_set_cmn[0][2] "Freeze frame FRF_CUS_SET_CMN: environmental data common to all failure (not fixed by law) stored in set" UBYTE _CNV_A_R_LINEAR_____0_CM 1 100. 0. 255. DISPLAY_IDENTIFIER ENVD_CUS_SET_CMN_3_1_7 ECU_ADDRESS 0xd0009f02 FORMAT "%3.0" /end MEASUREMENT
/begin MEASUREMENT tbl_frf[7].envd_cus_set_cmn[0][3] "Freeze frame FRF_CUS_SET_CMN: environmental data common to all failure (not fixed by law) stored in set" UBYTE _CNV_A_R_LINEAR_____0_CM 1 100. 0. 255. DISPLAY_IDENTIFIER ENVD_CUS_SET_CMN_0_3_ ECU_ADDRESS 0xd0009f03 FORMAT "%3.0" /end MEASUREMENT
/begin MEASUREMENT tbl_frf[7].envd_cus_set_cmn[0][4] "Freeze frame FRF_CUS_SET_CMN: environmental data common to all failure (not fixed by law) stored in set" UBYTE _CNV_A_R_LINEAR_____0_CM 1 100. 0. 255. DISPLAY_IDENTIFIER ENVD_CUS_SET_CMN_0_4_ ECU_ADDRESS 0xd0009f04 FORMAT "%3.0" /end MEASUREMENT
/begin MEASUREMENT tbl_frf[7].envd_cus_set_cmn[0][5] "Freeze frame FRF_CUS_SET_CMN: environmental data common to all failure (not fixed by law) stored in set" UBYTE _CNV_A_R_LINEAR_____0_CM 1 100. 0. 255. DISPLAY_IDENTIFIER ENVD_CUS_SET_CMN_0_5_ ECU_ADDRESS 0xd0009f05 FORMAT "%3.0" /end MEASUREMENT
/begin MEASUREMENT tbl_frf[7].envd_cus_set_cmn[0][6] "Freeze frame FRF_CUS_SET_CMN: environmental data common to all failure (not fixed by law) stored in set" UBYTE _CNV_A_R_LINEAR_____0_CM 1 100. 0. 255. DISPLAY_IDENTIFIER ENVD_CUS_SET_CMN_0_6_ ECU_ADDRESS 0xd0009f06 FORMAT "%3.0" /end MEASUREMENT
/begin MEASUREMENT tbl_frf[7].envd_cus_set_cmn[0][7] "Freeze frame FRF_CUS_SET_CMN: environmental data common to all failure (not fixed by law) stored in set" UBYTE _CNV_A_R_LINEAR_____0_CM 1 100. 0. 255. DISPLAY_IDENTIFIER ENVD_CUS_SET_CMN_0_7_ ECU_ADDRESS 0xd0009f07 FORMAT "%3.0" /end MEASUREMENT
/begin MEASUREMENT tbl_frf[7].envd_cus_set_cmn[0][8] "Freeze frame FRF_CUS_SET_CMN: environmental data common to all failure (not fixed by law) stored in set" UBYTE _CNV_A_R_LINEAR_____0_CM 1 100. 0. 255. DISPLAY_IDENTIFIER ENVD_CUS_SET_CMN_0_8_ ECU_ADDRESS 0xd0009f08 FORMAT "%3.0" /end MEASUREMENT
/begin MEASUREMENT tbl_frf[7].envd_cus_set_cmn[0][9] "Freeze frame FRF_CUS_SET_CMN: environmental data common to all failure (not fixed by law) stored in set" UBYTE _CNV_A_R_LINEAR_____0_CM 1 100. 0. 255. DISPLAY_IDENTIFIER ENVD_CUS_SET_CMN_0_9_ ECU_ADDRESS 0xd0009f09 FORMAT "%3.0" /end MEASUREMENT
/begin MEASUREMENT tbl_frf[7].envd_cus_set_cmn[1][0] "Freeze frame FRF_CUS_SET_CMN: environmental data common to all failure (not fixed by law) stored in set" UBYTE _CNV_A_R_LINEAR_____0_CM 1 100. 0. 255. DISPLAY_IDENTIFIER ENVD_CUS_SET_CMN_1_2_7 ECU_ADDRESS 0xd0009f0a FORMAT "%3.0" /end MEASUREMENT
/begin MEASUREMENT tbl_frf[7].envd_cus_set_cmn[1][1] "Freeze frame FRF_CUS_SET_CMN: environmental data common to all failure (not fixed by law) stored in set" UBYTE _CNV_A_R_LINEAR_____0_CM 1 100. 0. 255. DISPLAY_IDENTIFIER ENVD_CUS_SET_CMN_2_2_7 ECU_ADDRESS 0xd0009f0b FORMAT "%3.0" /end MEASUREMENT
/begin MEASUREMENT tbl_frf[7].envd_cus_set_cmn[1][2] "Freeze frame FRF_CUS_SET_CMN: environmental data common to all failure (not fixed by law) stored in set" UBYTE _CNV_A_R_LINEAR_____0_CM 1 100. 0. 255. DISPLAY_IDENTIFIER ENVD_CUS_SET_CMN_3_2_7 ECU_ADDRESS 0xd0009f0c FORMAT "%3.0" /end MEASUREMENT
/begin MEASUREMENT tbl_frf[7].envd_cus_set_cmn[1][3] "Freeze frame FRF_CUS_SET_CMN: environmental data common to all failure (not fixed by law) stored in set" UBYTE _CNV_A_R_LINEAR_____0_CM 1 100. 0. 255. DISPLAY_IDENTIFIER ENVD_CUS_SET_CMN_1_3_ ECU_ADDRESS 0xd0009f0d FORMAT "%3.0" /end MEASUREMENT
/begin MEASUREMENT tbl_frf[7].envd_cus_set_cmn[1][4] "Freeze frame FRF_CUS_SET_CMN: environmental data common to all failure (not fixed by law) stored in set" UBYTE _CNV_A_R_LINEAR_____0_CM 1 100. 0. 255. DISPLAY_IDENTIFIER ENVD_CUS_SET_CMN_1_4_ ECU_ADDRESS 0xd0009f0e FORMAT "%3.0" /end MEASUREMENT
/begin MEASUREMENT tbl_frf[7].envd_cus_set_cmn[1][5] "Freeze frame FRF_CUS_SET_CMN: environmental data common to all failure (not fixed by law) stored in set" UBYTE _CNV_A_R_LINEAR_____0_CM 1 100. 0. 255. DISPLAY_IDENTIFIER ENVD_CUS_SET_CMN_1_5_ ECU_ADDRESS 0xd0009f0f FORMAT "%3.0" /end MEASUREMENT
/begin MEASUREMENT tbl_frf[7].envd_cus_set_cmn[1][6] "Freeze frame FRF_CUS_SET_CMN: environmental data common to all failure (not fixed by law) stored in set" UBYTE _CNV_A_R_LINEAR_____0_CM 1 100. 0. 255. DISPLAY_IDENTIFIER ENVD_CUS_SET_CMN_1_6_ ECU_ADDRESS 0xd0009f10 FORMAT "%3.0" /end MEASUREMENT
/begin MEASUREMENT tbl_frf[7].envd_cus_set_cmn[1][7] "Freeze frame FRF_CUS_SET_CMN: environmental data common to all failure (not fixed by law) stored in set" UBYTE _CNV_A_R_LINEAR_____0_CM 1 100. 0. 255. DISPLAY_IDENTIFIER ENVD_CUS_SET_CMN_1_7_ ECU_ADDRESS 0xd0009f11 FORMAT "%3.0" /end MEASUREMENT
/begin MEASUREMENT tbl_frf[7].envd_cus_set_cmn[1][8] "Freeze frame FRF_CUS_SET_CMN: environmental data common to all failure (not fixed by law) stored in set" UBYTE _CNV_A_R_LINEAR_____0_CM 1 100. 0. 255. DISPLAY_IDENTIFIER ENVD_CUS_SET_CMN_1_8_ ECU_ADDRESS 0xd0009f12 FORMAT "%3.0" /end MEASUREMENT
/begin MEASUREMENT tbl_frf[7].envd_cus_set_cmn[1][9] "Freeze frame FRF_CUS_SET_CMN: environmental data common to all failure (not fixed by law) stored in set" UBYTE _CNV_A_R_LINEAR_____0_CM 1 100. 0. 255. DISPLAY_IDENTIFIER ENVD_CUS_SET_CMN_1_9_ ECU_ADDRESS 0xd0009f13 FORMAT "%3.0" /end MEASUREMENT
/begin MEASUREMENT tbl_frf[7].envd_cus_set_cmn[2][0] "Freeze frame FRF_CUS_SET_CMN: environmental data common to all failure (not fixed by law) stored in set" UBYTE _CNV_A_R_LINEAR_____0_CM 1 100. 0. 255. DISPLAY_IDENTIFIER ENVD_CUS_SET_CMN_1_3_7 ECU_ADDRESS 0xd0009f14 FORMAT "%3.0" /end MEASUREMENT
/begin MEASUREMENT tbl_frf[7].envd_cus_set_cmn[2][1] "Freeze frame FRF_CUS_SET_CMN: environmental data common to all failure (not fixed by law) stored in set" UBYTE _CNV_A_R_LINEAR_____0_CM 1 100. 0. 255. DISPLAY_IDENTIFIER ENVD_CUS_SET_CMN_2_3_7 ECU_ADDRESS 0xd0009f15 FORMAT "%3.0" /end MEASUREMENT
/begin MEASUREMENT tbl_frf[7].envd_cus_set_cmn[2][2] "Freeze frame FRF_CUS_SET_CMN: environmental data common to all failure (not fixed by law) stored in set" UBYTE _CNV_A_R_LINEAR_____0_CM 1 100. 0. 255. DISPLAY_IDENTIFIER ENVD_CUS_SET_CMN_3_3_7 ECU_ADDRESS 0xd0009f16 FORMAT "%3.0" /end MEASUREMENT
/begin MEASUREMENT tbl_frf[7].envd_cus_set_cmn[2][3] "Freeze frame FRF_CUS_SET_CMN: environmental data common to all failure (not fixed by law) stored in set" UBYTE _CNV_A_R_LINEAR_____0_CM 1 100. 0. 255. DISPLAY_IDENTIFIER ENVD_CUS_SET_CMN_2_3_ ECU_ADDRESS 0xd0009f17 FORMAT "%3.0" /end MEASUREMENT
/begin MEASUREMENT tbl_frf[7].envd_cus_set_cmn[2][4] "Freeze frame FRF_CUS_SET_CMN: environmental data common to all failure (not fixed by law) stored in set" UBYTE _CNV_A_R_LINEAR_____0_CM 1 100. 0. 255. DISPLAY_IDENTIFIER ENVD_CUS_SET_CMN_2_4_ ECU_ADDRESS 0xd0009f18 FORMAT "%3.0" /end MEASUREMENT
/begin MEASUREMENT tbl_frf[7].envd_cus_set_cmn[2][5] "Freeze frame FRF_CUS_SET_CMN: environmental data common to all failure (not fixed by law) stored in set" UBYTE _CNV_A_R_LINEAR_____0_CM 1 100. 0. 255. DISPLAY_IDENTIFIER ENVD_CUS_SET_CMN_2_5_ ECU_ADDRESS 0xd0009f19 FORMAT "%3.0" /end MEASUREMENT
/begin MEASUREMENT tbl_frf[7].envd_cus_set_cmn[2][6] "Freeze frame FRF_CUS_SET_CMN: environmental data common to all failure (not fixed by law) stored in set" UBYTE _CNV_A_R_LINEAR_____0_CM 1 100. 0. 255. DISPLAY_IDENTIFIER ENVD_CUS_SET_CMN_2_6_ ECU_ADDRESS 0xd0009f1a FORMAT "%3.0" /end MEASUREMENT
/begin MEASUREMENT tbl_frf[7].envd_cus_set_cmn[2][7] "Freeze frame FRF_CUS_SET_CMN: environmental data common to all failure (not fixed by law) stored in set" UBYTE _CNV_A_R_LINEAR_____0_CM 1 100. 0. 255. DISPLAY_IDENTIFIER ENVD_CUS_SET_CMN_2_7_ ECU_ADDRESS 0xd0009f1b FORMAT "%3.0" /end MEASUREMENT
/begin MEASUREMENT tbl_frf[7].envd_cus_set_cmn[2][8] "Freeze frame FRF_CUS_SET_CMN: environmental data common to all failure (not fixed by law) stored in set" UBYTE _CNV_A_R_LINEAR_____0_CM 1 100. 0. 255. DISPLAY_IDENTIFIER ENVD_CUS_SET_CMN_2_8_ ECU_ADDRESS 0xd0009f1c FORMAT "%3.0" /end MEASUREMENT
/begin MEASUREMENT tbl_frf[7].envd_cus_set_cmn[2][9] "Freeze frame FRF_CUS_SET_CMN: environmental data common to all failure (not fixed by law) stored in set" UBYTE _CNV_A_R_LINEAR_____0_CM 1 100. 0. 255. DISPLAY_IDENTIFIER ENVD_CUS_SET_CMN_2_9_ ECU_ADDRESS 0xd0009f1d FORMAT "%3.0" /end MEASUREMENT
/begin MEASUREMENT tbl_frf[7].envd_cus_set_spc[0][0] "Freeze frame FRF_CUS_SET_SPC: environmental data specific to each failure (not fixed by law) stored in set" UBYTE _CNV_A_R_LINEAR_____0_CM 1 100. 0. 255. DISPLAY_IDENTIFIER ENVD_CUS_SET_SPC_1_1_7 ECU_ADDRESS 0xd0009f20 FORMAT "%3.0" /end MEASUREMENT
/begin MEASUREMENT tbl_frf[7].envd_cus_set_spc[0][1] "Freeze frame FRF_CUS_SET_SPC: environmental data specific to each failure (not fixed by law) stored in set" UBYTE _CNV_A_R_LINEAR_____0_CM 1 100. 0. 255. DISPLAY_IDENTIFIER ENVD_CUS_SET_SPC_2_1_7 ECU_ADDRESS 0xd0009f21 FORMAT "%3.0" /end MEASUREMENT
/begin MEASUREMENT tbl_frf[7].envd_cus_set_spc[0][2] "Freeze frame FRF_CUS_SET_SPC: environmental data specific to each failure (not fixed by law) stored in set" UBYTE _CNV_A_R_LINEAR_____0_CM 1 100. 0. 255. DISPLAY_IDENTIFIER ENVD_CUS_SET_SPC_3_1_7 ECU_ADDRESS 0xd0009f22 FORMAT "%3.0" /end MEASUREMENT
/begin MEASUREMENT tbl_frf[7].envd_cus_set_spc[0][3] "Freeze frame FRF_CUS_SET_SPC: environmental data specific to each failure (not fixed by law) stored in set" UBYTE _CNV_A_R_LINEAR_____0_CM 1 100. 0. 255. DISPLAY_IDENTIFIER ENVD_CUS_SET_SPC_4_1_7 ECU_ADDRESS 0xd0009f23 FORMAT "%3.0" /end MEASUREMENT
/begin MEASUREMENT tbl_frf[7].envd_cus_set_spc[1][0] "Freeze frame FRF_CUS_SET_SPC: environmental data specific to each failure (not fixed by law) stored in set" UBYTE _CNV_A_R_LINEAR_____0_CM 1 100. 0. 255. DISPLAY_IDENTIFIER ENVD_CUS_SET_SPC_1_2_7 ECU_ADDRESS 0xd0009f24 FORMAT "%3.0" /end MEASUREMENT
/begin MEASUREMENT tbl_frf[7].envd_cus_set_spc[1][1] "Freeze frame FRF_CUS_SET_SPC: environmental data specific to each failure (not fixed by law) stored in set" UBYTE _CNV_A_R_LINEAR_____0_CM 1 100. 0. 255. DISPLAY_IDENTIFIER ENVD_CUS_SET_SPC_2_2_7 ECU_ADDRESS 0xd0009f25 FORMAT "%3.0" /end MEASUREMENT
/begin MEASUREMENT tbl_frf[7].envd_cus_set_spc[1][2] "Freeze frame FRF_CUS_SET_SPC: environmental data specific to each failure (not fixed by law) stored in set" UBYTE _CNV_A_R_LINEAR_____0_CM 1 100. 0. 255. DISPLAY_IDENTIFIER ENVD_CUS_SET_SPC_3_2_7 ECU_ADDRESS 0xd0009f26 FORMAT "%3.0" /end MEASUREMENT
/begin MEASUREMENT tbl_frf[7].envd_cus_set_spc[1][3] "Freeze frame FRF_CUS_SET_SPC: environmental data specific to each failure (not fixed by law) stored in set" UBYTE _CNV_A_R_LINEAR_____0_CM 1 100. 0. 255. DISPLAY_IDENTIFIER ENVD_CUS_SET_SPC_4_2_7 ECU_ADDRESS 0xd0009f27 FORMAT "%3.0" /end MEASUREMENT
/begin MEASUREMENT tbl_frf[7].envd_cus_set_spc[2][0] "Freeze frame FRF_CUS_SET_SPC: environmental data specific to each failure (not fixed by law) stored in set" UBYTE _CNV_A_R_LINEAR_____0_CM 1 100. 0. 255. DISPLAY_IDENTIFIER ENVD_CUS_SET_SPC_1_3_7 ECU_ADDRESS 0xd0009f28 FORMAT "%3.0" /end MEASUREMENT
/begin MEASUREMENT tbl_frf[7].envd_cus_set_spc[2][1] "Freeze frame FRF_CUS_SET_SPC: environmental data specific to each failure (not fixed by law) stored in set" UBYTE _CNV_A_R_LINEAR_____0_CM 1 100. 0. 255. DISPLAY_IDENTIFIER ENVD_CUS_SET_SPC_2_3_7 ECU_ADDRESS 0xd0009f29 FORMAT "%3.0" /end MEASUREMENT
/begin MEASUREMENT tbl_frf[7].envd_cus_set_spc[2][2] "Freeze frame FRF_CUS_SET_SPC: environmental data specific to each failure (not fixed by law) stored in set" UBYTE _CNV_A_R_LINEAR_____0_CM 1 100. 0. 255. DISPLAY_IDENTIFIER ENVD_CUS_SET_SPC_3_3_7 ECU_ADDRESS 0xd0009f2a FORMAT "%3.0" /end MEASUREMENT
/begin MEASUREMENT tbl_frf[7].envd_cus_set_spc[2][3] "Freeze frame FRF_CUS_SET_SPC: environmental data specific to each failure (not fixed by law) stored in set" UBYTE _CNV_A_R_LINEAR_____0_CM 1 100. 0. 255. DISPLAY_IDENTIFIER ENVD_CUS_SET_SPC_4_3_7 ECU_ADDRESS 0xd0009f2b FORMAT "%3.0" /end MEASUREMENT
/begin MEASUREMENT tbl_frf[8].envd_obd[0] "Freeze frame FRF_OBD: environmental data (fixed by law)" UBYTE _CNV_A_R_LINEAR_____0_CM 1 100. 0. 255. DISPLAY_IDENTIFIER ENVD_OBD_1_8 ECU_ADDRESS 0xd0009f30 FORMAT "%3.0" /end MEASUREMENT
/begin MEASUREMENT tbl_frf[8].envd_obd[1] "Freeze frame FRF_OBD: environmental data (fixed by law)" UBYTE _CNV_A_R_LINEAR_____0_CM 1 100. 0. 255. DISPLAY_IDENTIFIER ENVD_OBD_2_8 ECU_ADDRESS 0xd0009f31 FORMAT "%3.0" /end MEASUREMENT
/begin MEASUREMENT tbl_frf[8].envd_obd[2] "Freeze frame FRF_OBD: environmental data (fixed by law)" UBYTE _CNV_A_R_LINEAR_____0_CM 1 100. 0. 255. DISPLAY_IDENTIFIER ENVD_OBD_3_8 ECU_ADDRESS 0xd0009f32 FORMAT "%3.0" /end MEASUREMENT
/begin MEASUREMENT tbl_frf[8].envd_obd[3] "Freeze frame FRF_OBD: environmental data (fixed by law)" UBYTE _CNV_A_R_LINEAR_____0_CM 1 100. 0. 255. DISPLAY_IDENTIFIER ENVD_OBD_4_8 ECU_ADDRESS 0xd0009f33 FORMAT "%3.0" /end MEASUREMENT
/begin MEASUREMENT tbl_frf[8].envd_obd[4] "Freeze frame FRF_OBD: environmental data (fixed by law)" UBYTE _CNV_A_R_LINEAR_____0_CM 1 100. 0. 255. DISPLAY_IDENTIFIER ENVD_OBD_5_8 ECU_ADDRESS 0xd0009f34 FORMAT "%3.0" /end MEASUREMENT
/begin MEASUREMENT tbl_frf[8].envd_obd[5] "Freeze frame FRF_OBD: environmental data (fixed by law)" UBYTE _CNV_A_R_LINEAR_____0_CM 1 100. 0. 255. DISPLAY_IDENTIFIER ENVD_OBD_6_8 ECU_ADDRESS 0xd0009f35 FORMAT "%3.0" /end MEASUREMENT
/begin MEASUREMENT tbl_frf[8].envd_obd[6] "Freeze frame FRF_OBD: environmental data (fixed by law)" UBYTE _CNV_A_R_LINEAR_____0_CM 1 100. 0. 255. DISPLAY_IDENTIFIER ENVD_OBD_7_8 ECU_ADDRESS 0xd0009f36 FORMAT "%3.0" /end MEASUREMENT
/begin MEASUREMENT tbl_frf[8].envd_obd[7] "Freeze frame FRF_OBD: environmental data (fixed by law)" UBYTE _CNV_A_R_LINEAR_____0_CM 1 100. 0. 255. DISPLAY_IDENTIFIER ENVD_OBD_8_8 ECU_ADDRESS 0xd0009f37 FORMAT "%3.0" /end MEASUREMENT
/begin MEASUREMENT tbl_frf[8].envd_obd[8] "Freeze frame FRF_OBD: environmental data (fixed by law)" UBYTE _CNV_A_R_LINEAR_____0_CM 1 100. 0. 255. DISPLAY_IDENTIFIER ENVD_OBD_9_8 ECU_ADDRESS 0xd0009f38 FORMAT "%3.0" /end MEASUREMENT
/begin MEASUREMENT tbl_frf[8].envd_obd[9] "Freeze frame FRF_OBD: environmental data (fixed by law)" UBYTE _CNV_A_R_LINEAR_____0_CM 1 100. 0. 255. DISPLAY_IDENTIFIER ENVD_OBD_10_8 ECU_ADDRESS 0xd0009f39 FORMAT "%3.0" /end MEASUREMENT
/begin MEASUREMENT tbl_frf[8].envd_obd[10] "Freeze frame FRF_OBD: environmental data (fixed by law)" UBYTE _CNV_A_R_LINEAR_____0_CM 1 100. 0. 255. DISPLAY_IDENTIFIER ENVD_OBD_11_8 ECU_ADDRESS 0xd0009f3a FORMAT "%3.0" /end MEASUREMENT
/begin MEASUREMENT tbl_frf[8].envd_obd[11] "Freeze frame FRF_OBD: environmental data (fixed by law)" UBYTE _CNV_A_R_LINEAR_____0_CM 1 100. 0. 255. DISPLAY_IDENTIFIER ENVD_OBD_12_8 ECU_ADDRESS 0xd0009f3b FORMAT "%3.0" /end MEASUREMENT
/begin MEASUREMENT tbl_frf[8].envd_obd[12] "Freeze frame FRF_OBD: environmental data (fixed by law)" UBYTE _CNV_A_R_LINEAR_____0_CM 1 100. 0. 255. DISPLAY_IDENTIFIER ENVD_OBD_13_8 ECU_ADDRESS 0xd0009f3c FORMAT "%3.0" /end MEASUREMENT
/begin MEASUREMENT tbl_frf[8].envd_obd[13] "Freeze frame FRF_OBD: environmental data (fixed by law)" UBYTE _CNV_A_R_LINEAR_____0_CM 1 100. 0. 255. DISPLAY_IDENTIFIER ENVD_OBD_14_8 ECU_ADDRESS 0xd0009f3d FORMAT "%3.0" /end MEASUREMENT
/begin MEASUREMENT tbl_frf[8].envd_obd[14] "Freeze frame FRF_OBD: environmental data (fixed by law)" UBYTE _CNV_A_R_LINEAR_____0_CM 1 100. 0. 255. DISPLAY_IDENTIFIER ENVD_OBD_15_8 ECU_ADDRESS 0xd0009f3e FORMAT "%3.0" /end MEASUREMENT
/begin MEASUREMENT tbl_frf[8].envd_obd[15] "Freeze frame FRF_OBD: environmental data (fixed by law)" UBYTE _CNV_A_R_LINEAR_____0_CM 1 100. 0. 255. DISPLAY_IDENTIFIER ENVD_OBD_16_8 ECU_ADDRESS 0xd0009f3f FORMAT "%3.0" /end MEASUREMENT
/begin MEASUREMENT tbl_frf[8].envd_obd[16] "Freeze frame FRF_OBD: environmental data (fixed by law)" UBYTE _CNV_A_R_LINEAR_____0_CM 1 100. 0. 255. DISPLAY_IDENTIFIER ENVD_OBD_17_8 ECU_ADDRESS 0xd0009f40 FORMAT "%3.0" /end MEASUREMENT
/begin MEASUREMENT tbl_frf[8].envd_obd[17] "Freeze frame FRF_OBD: environmental data (fixed by law)" UBYTE _CNV_A_R_LINEAR_____0_CM 1 100. 0. 255. DISPLAY_IDENTIFIER ENVD_OBD_18_8 ECU_ADDRESS 0xd0009f41 FORMAT "%3.0" /end MEASUREMENT
/begin MEASUREMENT tbl_frf[8].envd_obd[18] "Freeze frame FRF_OBD: environmental data (fixed by law)" UBYTE _CNV_A_R_LINEAR_____0_CM 1 100. 0. 255. DISPLAY_IDENTIFIER ENVD_OBD_19_8 ECU_ADDRESS 0xd0009f42 FORMAT "%3.0" /end MEASUREMENT
/begin MEASUREMENT tbl_frf[8].envd_obd[19] "Freeze frame FRF_OBD: environmental data (fixed by law)" UBYTE _CNV_A_R_LINEAR_____0_CM 1 100. 0. 255. DISPLAY_IDENTIFIER ENVD_OBD_20_8 ECU_ADDRESS 0xd0009f43 FORMAT "%3.0" /end MEASUREMENT
/begin MEASUREMENT tbl_frf[8].envd_obd[20] "Freeze frame FRF_OBD: environmental data (fixed by law)" UBYTE _CNV_A_R_LINEAR_____0_CM 1 100. 0. 255. DISPLAY_IDENTIFIER ENVD_OBD_21_8 ECU_ADDRESS 0xd0009f44 FORMAT "%3.0" /end MEASUREMENT
/begin MEASUREMENT tbl_frf[8].envd_obd[21] "Freeze frame FRF_OBD: environmental data (fixed by law)" UBYTE _CNV_A_R_LINEAR_____0_CM 1 100. 0. 255. DISPLAY_IDENTIFIER ENVD_OBD_22_8 ECU_ADDRESS 0xd0009f45 FORMAT "%3.0" /end MEASUREMENT
/begin MEASUREMENT tbl_frf[8].envd_obd[22] "Freeze frame FRF_OBD: environmental data (fixed by law)" UBYTE _CNV_A_R_LINEAR_____0_CM 1 100. 0. 255. DISPLAY_IDENTIFIER ENVD_OBD_23_8 ECU_ADDRESS 0xd0009f46 FORMAT "%3.0" /end MEASUREMENT
/begin MEASUREMENT tbl_frf[8].envd_obd[23] "Freeze frame FRF_OBD: environmental data (fixed by law)" UBYTE _CNV_A_R_LINEAR_____0_CM 1 100. 0. 255. DISPLAY_IDENTIFIER ENVD_OBD_24_8 ECU_ADDRESS 0xd0009f47 FORMAT "%3.0" /end MEASUREMENT
/begin MEASUREMENT tbl_frf[8].envd_obd[24] "Freeze frame FRF_OBD: environmental data (fixed by law)" UBYTE _CNV_A_R_LINEAR_____0_CM 1 100. 0. 255. DISPLAY_IDENTIFIER ENVD_OBD_25_8 ECU_ADDRESS 0xd0009f48 FORMAT "%3.0" /end MEASUREMENT
/begin MEASUREMENT tbl_frf[8].envd_obd[25] "Freeze frame FRF_OBD: environmental data (fixed by law)" UBYTE _CNV_A_R_LINEAR_____0_CM 1 100. 0. 255. DISPLAY_IDENTIFIER ENVD_OBD_26_8 ECU_ADDRESS 0xd0009f49 FORMAT "%3.0" /end MEASUREMENT
/begin MEASUREMENT tbl_frf[8].envd_obd[26] "Freeze frame FRF_OBD: environmental data (fixed by law)" UBYTE _CNV_A_R_LINEAR_____0_CM 1 100. 0. 255. DISPLAY_IDENTIFIER ENVD_OBD_27_8 ECU_ADDRESS 0xd0009f4a FORMAT "%3.0" /end MEASUREMENT
/begin MEASUREMENT tbl_frf[8].envd_obd[27] "Freeze frame FRF_OBD: environmental data (fixed by law)" UBYTE _CNV_A_R_LINEAR_____0_CM 1 100. 0. 255. DISPLAY_IDENTIFIER ENVD_OBD_28_8 ECU_ADDRESS 0xd0009f4b FORMAT "%3.0" /end MEASUREMENT
/begin MEASUREMENT tbl_frf[8].envd_obd[28] "Freeze frame FRF_OBD: environmental data (fixed by law)" UBYTE _CNV_A_R_LINEAR_____0_CM 1 100. 0. 255. DISPLAY_IDENTIFIER ENVD_OBD_29_8 ECU_ADDRESS 0xd0009f4c FORMAT "%3.0" /end MEASUREMENT
/begin MEASUREMENT tbl_frf[8].envd_obd[29] "Freeze frame FRF_OBD: environmental data (fixed by law)" UBYTE _CNV_A_R_LINEAR_____0_CM 1 100. 0. 255. DISPLAY_IDENTIFIER ENVD_OBD_30_8 ECU_ADDRESS 0xd0009f4d FORMAT "%3.0" /end MEASUREMENT
/begin MEASUREMENT tbl_frf[8].envd_obd[30] "Freeze frame FRF_OBD: environmental data (fixed by law)" UBYTE _CNV_A_R_LINEAR_____0_CM 1 100. 0. 255. DISPLAY_IDENTIFIER ENVD_OBD_31_8 ECU_ADDRESS 0xd0009f4e FORMAT "%3.0" /end MEASUREMENT
/begin MEASUREMENT tbl_frf[8].envd_obd[31] "Freeze frame FRF_OBD: environmental data (fixed by law)" UBYTE _CNV_A_R_LINEAR_____0_CM 1 100. 0. 255. DISPLAY_IDENTIFIER ENVD_OBD_32_8 ECU_ADDRESS 0xd0009f4f FORMAT "%3.0" /end MEASUREMENT
/begin MEASUREMENT tbl_frf[8].envd_obd[32] "Freeze frame FRF_OBD: environmental data (fixed by law)" UBYTE _CNV_A_R_LINEAR_____0_CM 1 100. 0. 255. DISPLAY_IDENTIFIER ENVD_OBD_33_8 ECU_ADDRESS 0xd0009f50 FORMAT "%3.0" /end MEASUREMENT
/begin MEASUREMENT tbl_frf[8].envd_obd[33] "Freeze frame FRF_OBD: environmental data (fixed by law)" UBYTE _CNV_A_R_LINEAR_____0_CM 1 100. 0. 255. DISPLAY_IDENTIFIER ENVD_OBD_34_8 ECU_ADDRESS 0xd0009f51 FORMAT "%3.0" /end MEASUREMENT
/begin MEASUREMENT tbl_frf[8].envd_obd[34] "Freeze frame FRF_OBD: environmental data (fixed by law)" UBYTE _CNV_A_R_LINEAR_____0_CM 1 100. 0. 255. DISPLAY_IDENTIFIER ENVD_OBD[34] ECU_ADDRESS 0xd0009f52 FORMAT "%3.0" /end MEASUREMENT
/begin MEASUREMENT tbl_frf[8].envd_obd[35] "Freeze frame FRF_OBD: environmental data (fixed by law)" UBYTE _CNV_A_R_LINEAR_____0_CM 1 100. 0. 255. DISPLAY_IDENTIFIER ENVD_OBD[35] ECU_ADDRESS 0xd0009f53 FORMAT "%3.0" /end MEASUREMENT
/begin MEASUREMENT tbl_frf[8].envd_obd[36] "Freeze frame FRF_OBD: environmental data (fixed by law)" UBYTE _CNV_A_R_LINEAR_____0_CM 1 100. 0. 255. DISPLAY_IDENTIFIER ENVD_OBD[36] ECU_ADDRESS 0xd0009f54 FORMAT "%3.0" /end MEASUREMENT
/begin MEASUREMENT tbl_frf[8].envd_obd[37] "Freeze frame FRF_OBD: environmental data (fixed by law)" UBYTE _CNV_A_R_LINEAR_____0_CM 1 100. 0. 255. DISPLAY_IDENTIFIER ENVD_OBD[37] ECU_ADDRESS 0xd0009f55 FORMAT "%3.0" /end MEASUREMENT
/begin MEASUREMENT tbl_frf[8].envd_cus_cmn[0] "Freeze frame FRF_CUS_CMN: environmental data common to all failure (not fixed by law)" UBYTE _CNV_A_R_LINEAR_____0_CM 1 100. 0. 255. DISPLAY_IDENTIFIER ENVD_CUS_CMN_1_8 ECU_ADDRESS 0xd0009f56 FORMAT "%3.0" /end MEASUREMENT
/begin MEASUREMENT tbl_frf[8].envd_cus_set_cmn[0][0] "Freeze frame FRF_CUS_SET_CMN: environmental data common to all failure (not fixed by law) stored in set" UBYTE _CNV_A_R_LINEAR_____0_CM 1 100. 0. 255. DISPLAY_IDENTIFIER ENVD_CUS_SET_CMN_1_1_8 ECU_ADDRESS 0xd0009f58 FORMAT "%3.0" /end MEASUREMENT
/begin MEASUREMENT tbl_frf[8].envd_cus_set_cmn[0][1] "Freeze frame FRF_CUS_SET_CMN: environmental data common to all failure (not fixed by law) stored in set" UBYTE _CNV_A_R_LINEAR_____0_CM 1 100. 0. 255. DISPLAY_IDENTIFIER ENVD_CUS_SET_CMN_2_1_8 ECU_ADDRESS 0xd0009f59 FORMAT "%3.0" /end MEASUREMENT
/begin MEASUREMENT tbl_frf[8].envd_cus_set_cmn[0][2] "Freeze frame FRF_CUS_SET_CMN: environmental data common to all failure (not fixed by law) stored in set" UBYTE _CNV_A_R_LINEAR_____0_CM 1 100. 0. 255. DISPLAY_IDENTIFIER ENVD_CUS_SET_CMN_3_1_8 ECU_ADDRESS 0xd0009f5a FORMAT "%3.0" /end MEASUREMENT
/begin MEASUREMENT tbl_frf[8].envd_cus_set_cmn[0][3] "Freeze frame FRF_CUS_SET_CMN: environmental data common to all failure (not fixed by law) stored in set" UBYTE _CNV_A_R_LINEAR_____0_CM 1 100. 0. 255. DISPLAY_IDENTIFIER ENVD_CUS_SET_CMN_0_3_ ECU_ADDRESS 0xd0009f5b FORMAT "%3.0" /end MEASUREMENT
/begin MEASUREMENT tbl_frf[8].envd_cus_set_cmn[0][4] "Freeze frame FRF_CUS_SET_CMN: environmental data common to all failure (not fixed by law) stored in set" UBYTE _CNV_A_R_LINEAR_____0_CM 1 100. 0. 255. DISPLAY_IDENTIFIER ENVD_CUS_SET_CMN_0_4_ ECU_ADDRESS 0xd0009f5c FORMAT "%3.0" /end MEASUREMENT
/begin MEASUREMENT tbl_frf[8].envd_cus_set_cmn[0][5] "Freeze frame FRF_CUS_SET_CMN: environmental data common to all failure (not fixed by law) stored in set" UBYTE _CNV_A_R_LINEAR_____0_CM 1 100. 0. 255. DISPLAY_IDENTIFIER ENVD_CUS_SET_CMN_0_5_ ECU_ADDRESS 0xd0009f5d FORMAT "%3.0" /end MEASUREMENT
/begin MEASUREMENT tbl_frf[8].envd_cus_set_cmn[0][6] "Freeze frame FRF_CUS_SET_CMN: environmental data common to all failure (not fixed by law) stored in set" UBYTE _CNV_A_R_LINEAR_____0_CM 1 100. 0. 255. DISPLAY_IDENTIFIER ENVD_CUS_SET_CMN_0_6_ ECU_ADDRESS 0xd0009f5e FORMAT "%3.0" /end MEASUREMENT
/begin MEASUREMENT tbl_frf[8].envd_cus_set_cmn[0][7] "Freeze frame FRF_CUS_SET_CMN: environmental data common to all failure (not fixed by law) stored in set" UBYTE _CNV_A_R_LINEAR_____0_CM 1 100. 0. 255. DISPLAY_IDENTIFIER ENVD_CUS_SET_CMN_0_7_ ECU_ADDRESS 0xd0009f5f FORMAT "%3.0" /end MEASUREMENT
/begin MEASUREMENT tbl_frf[8].envd_cus_set_cmn[0][8] "Freeze frame FRF_CUS_SET_CMN: environmental data common to all failure (not fixed by law) stored in set" UBYTE _CNV_A_R_LINEAR_____0_CM 1 100. 0. 255. DISPLAY_IDENTIFIER ENVD_CUS_SET_CMN_0_8_ ECU_ADDRESS 0xd0009f60 FORMAT "%3.0" /end MEASUREMENT
/begin MEASUREMENT tbl_frf[8].envd_cus_set_cmn[0][9] "Freeze frame FRF_CUS_SET_CMN: environmental data common to all failure (not fixed by law) stored in set" UBYTE _CNV_A_R_LINEAR_____0_CM 1 100. 0. 255. DISPLAY_IDENTIFIER ENVD_CUS_SET_CMN_0_9_ ECU_ADDRESS 0xd0009f61 FORMAT "%3.0" /end MEASUREMENT
/begin MEASUREMENT tbl_frf[8].envd_cus_set_cmn[1][0] "Freeze frame FRF_CUS_SET_CMN: environmental data common to all failure (not fixed by law) stored in set" UBYTE _CNV_A_R_LINEAR_____0_CM 1 100. 0. 255. DISPLAY_IDENTIFIER ENVD_CUS_SET_CMN_1_2_8 ECU_ADDRESS 0xd0009f62 FORMAT "%3.0" /end MEASUREMENT
/begin MEASUREMENT tbl_frf[8].envd_cus_set_cmn[1][1] "Freeze frame FRF_CUS_SET_CMN: environmental data common to all failure (not fixed by law) stored in set" UBYTE _CNV_A_R_LINEAR_____0_CM 1 100. 0. 255. DISPLAY_IDENTIFIER ENVD_CUS_SET_CMN_2_2_8 ECU_ADDRESS 0xd0009f63 FORMAT "%3.0" /end MEASUREMENT
/begin MEASUREMENT tbl_frf[8].envd_cus_set_cmn[1][2] "Freeze frame FRF_CUS_SET_CMN: environmental data common to all failure (not fixed by law) stored in set" UBYTE _CNV_A_R_LINEAR_____0_CM 1 100. 0. 255. DISPLAY_IDENTIFIER ENVD_CUS_SET_CMN_3_2_8 ECU_ADDRESS 0xd0009f64 FORMAT "%3.0" /end MEASUREMENT
/begin MEASUREMENT tbl_frf[8].envd_cus_set_cmn[1][3] "Freeze frame FRF_CUS_SET_CMN: environmental data common to all failure (not fixed by law) stored in set" UBYTE _CNV_A_R_LINEAR_____0_CM 1 100. 0. 255. DISPLAY_IDENTIFIER ENVD_CUS_SET_CMN_1_3_ ECU_ADDRESS 0xd0009f65 FORMAT "%3.0" /end MEASUREMENT
/begin MEASUREMENT tbl_frf[8].envd_cus_set_cmn[1][4] "Freeze frame FRF_CUS_SET_CMN: environmental data common to all failure (not fixed by law) stored in set" UBYTE _CNV_A_R_LINEAR_____0_CM 1 100. 0. 255. DISPLAY_IDENTIFIER ENVD_CUS_SET_CMN_1_4_ ECU_ADDRESS 0xd0009f66 FORMAT "%3.0" /end MEASUREMENT
/begin MEASUREMENT tbl_frf[8].envd_cus_set_cmn[1][5] "Freeze frame FRF_CUS_SET_CMN: environmental data common to all failure (not fixed by law) stored in set" UBYTE _CNV_A_R_LINEAR_____0_CM 1 100. 0. 255. DISPLAY_IDENTIFIER ENVD_CUS_SET_CMN_1_5_ ECU_ADDRESS 0xd0009f67 FORMAT "%3.0" /end MEASUREMENT
/begin MEASUREMENT tbl_frf[8].envd_cus_set_cmn[1][6] "Freeze frame FRF_CUS_SET_CMN: environmental data common to all failure (not fixed by law) stored in set" UBYTE _CNV_A_R_LINEAR_____0_CM 1 100. 0. 255. DISPLAY_IDENTIFIER ENVD_CUS_SET_CMN_1_6_ ECU_ADDRESS 0xd0009f68 FORMAT "%3.0" /end MEASUREMENT
/begin MEASUREMENT tbl_frf[8].envd_cus_set_cmn[1][7] "Freeze frame FRF_CUS_SET_CMN: environmental data common to all failure (not fixed by law) stored in set" UBYTE _CNV_A_R_LINEAR_____0_CM 1 100. 0. 255. DISPLAY_IDENTIFIER ENVD_CUS_SET_CMN_1_7_ ECU_ADDRESS 0xd0009f69 FORMAT "%3.0" /end MEASUREMENT
/begin MEASUREMENT tbl_frf[8].envd_cus_set_cmn[1][8] "Freeze frame FRF_CUS_SET_CMN: environmental data common to all failure (not fixed by law) stored in set" UBYTE _CNV_A_R_LINEAR_____0_CM 1 100. 0. 255. DISPLAY_IDENTIFIER ENVD_CUS_SET_CMN_1_8_ ECU_ADDRESS 0xd0009f6a FORMAT "%3.0" /end MEASUREMENT
/begin MEASUREMENT tbl_frf[8].envd_cus_set_cmn[1][9] "Freeze frame FRF_CUS_SET_CMN: environmental data common to all failure (not fixed by law) stored in set" UBYTE _CNV_A_R_LINEAR_____0_CM 1 100. 0. 255. DISPLAY_IDENTIFIER ENVD_CUS_SET_CMN_1_9_ ECU_ADDRESS 0xd0009f6b FORMAT "%3.0" /end MEASUREMENT
/begin MEASUREMENT tbl_frf[8].envd_cus_set_cmn[2][0] "Freeze frame FRF_CUS_SET_CMN: environmental data common to all failure (not fixed by law) stored in set" UBYTE _CNV_A_R_LINEAR_____0_CM 1 100. 0. 255. DISPLAY_IDENTIFIER ENVD_CUS_SET_CMN_1_3_8 ECU_ADDRESS 0xd0009f6c FORMAT "%3.0" /end MEASUREMENT
/begin MEASUREMENT tbl_frf[8].envd_cus_set_cmn[2][1] "Freeze frame FRF_CUS_SET_CMN: environmental data common to all failure (not fixed by law) stored in set" UBYTE _CNV_A_R_LINEAR_____0_CM 1 100. 0. 255. DISPLAY_IDENTIFIER ENVD_CUS_SET_CMN_2_3_8 ECU_ADDRESS 0xd0009f6d FORMAT "%3.0" /end MEASUREMENT
/begin MEASUREMENT tbl_frf[8].envd_cus_set_cmn[2][2] "Freeze frame FRF_CUS_SET_CMN: environmental data common to all failure (not fixed by law) stored in set" UBYTE _CNV_A_R_LINEAR_____0_CM 1 100. 0. 255. DISPLAY_IDENTIFIER ENVD_CUS_SET_CMN_3_3_8 ECU_ADDRESS 0xd0009f6e FORMAT "%3.0" /end MEASUREMENT
/begin MEASUREMENT tbl_frf[8].envd_cus_set_cmn[2][3] "Freeze frame FRF_CUS_SET_CMN: environmental data common to all failure (not fixed by law) stored in set" UBYTE _CNV_A_R_LINEAR_____0_CM 1 100. 0. 255. DISPLAY_IDENTIFIER ENVD_CUS_SET_CMN_2_3_ ECU_ADDRESS 0xd0009f6f FORMAT "%3.0" /end MEASUREMENT
/begin MEASUREMENT tbl_frf[8].envd_cus_set_cmn[2][4] "Freeze frame FRF_CUS_SET_CMN: environmental data common to all failure (not fixed by law) stored in set" UBYTE _CNV_A_R_LINEAR_____0_CM 1 100. 0. 255. DISPLAY_IDENTIFIER ENVD_CUS_SET_CMN_2_4_ ECU_ADDRESS 0xd0009f70 FORMAT "%3.0" /end MEASUREMENT
/begin MEASUREMENT tbl_frf[8].envd_cus_set_cmn[2][5] "Freeze frame FRF_CUS_SET_CMN: environmental data common to all failure (not fixed by law) stored in set" UBYTE _CNV_A_R_LINEAR_____0_CM 1 100. 0. 255. DISPLAY_IDENTIFIER ENVD_CUS_SET_CMN_2_5_ ECU_ADDRESS 0xd0009f71 FORMAT "%3.0" /end MEASUREMENT
/begin MEASUREMENT tbl_frf[8].envd_cus_set_cmn[2][6] "Freeze frame FRF_CUS_SET_CMN: environmental data common to all failure (not fixed by law) stored in set" UBYTE _CNV_A_R_LINEAR_____0_CM 1 100. 0. 255. DISPLAY_IDENTIFIER ENVD_CUS_SET_CMN_2_6_ ECU_ADDRESS 0xd0009f72 FORMAT "%3.0" /end MEASUREMENT
/begin MEASUREMENT tbl_frf[8].envd_cus_set_cmn[2][7] "Freeze frame FRF_CUS_SET_CMN: environmental data common to all failure (not fixed by law) stored in set" UBYTE _CNV_A_R_LINEAR_____0_CM 1 100. 0. 255. DISPLAY_IDENTIFIER ENVD_CUS_SET_CMN_2_7_ ECU_ADDRESS 0xd0009f73 FORMAT "%3.0" /end MEASUREMENT
/begin MEASUREMENT tbl_frf[8].envd_cus_set_cmn[2][8] "Freeze frame FRF_CUS_SET_CMN: environmental data common to all failure (not fixed by law) stored in set" UBYTE _CNV_A_R_LINEAR_____0_CM 1 100. 0. 255. DISPLAY_IDENTIFIER ENVD_CUS_SET_CMN_2_8_ ECU_ADDRESS 0xd0009f74 FORMAT "%3.0" /end MEASUREMENT
/begin MEASUREMENT tbl_frf[8].envd_cus_set_cmn[2][9] "Freeze frame FRF_CUS_SET_CMN: environmental data common to all failure (not fixed by law) stored in set" UBYTE _CNV_A_R_LINEAR_____0_CM 1 100. 0. 255. DISPLAY_IDENTIFIER ENVD_CUS_SET_CMN_2_9_ ECU_ADDRESS 0xd0009f75 FORMAT "%3.0" /end MEASUREMENT
/begin MEASUREMENT tbl_frf[8].envd_cus_set_spc[0][0] "Freeze frame FRF_CUS_SET_SPC: environmental data specific to each failure (not fixed by law) stored in set" UBYTE _CNV_A_R_LINEAR_____0_CM 1 100. 0. 255. DISPLAY_IDENTIFIER ENVD_CUS_SET_SPC_1_1_8 ECU_ADDRESS 0xd0009f78 FORMAT "%3.0" /end MEASUREMENT
/begin MEASUREMENT tbl_frf[8].envd_cus_set_spc[0][1] "Freeze frame FRF_CUS_SET_SPC: environmental data specific to each failure (not fixed by law) stored in set" UBYTE _CNV_A_R_LINEAR_____0_CM 1 100. 0. 255. DISPLAY_IDENTIFIER ENVD_CUS_SET_SPC_2_1_8 ECU_ADDRESS 0xd0009f79 FORMAT "%3.0" /end MEASUREMENT
/begin MEASUREMENT tbl_frf[8].envd_cus_set_spc[0][2] "Freeze frame FRF_CUS_SET_SPC: environmental data specific to each failure (not fixed by law) stored in set" UBYTE _CNV_A_R_LINEAR_____0_CM 1 100. 0. 255. DISPLAY_IDENTIFIER ENVD_CUS_SET_SPC_3_1_8 ECU_ADDRESS 0xd0009f7a FORMAT "%3.0" /end MEASUREMENT
/begin MEASUREMENT tbl_frf[8].envd_cus_set_spc[0][3] "Freeze frame FRF_CUS_SET_SPC: environmental data specific to each failure (not fixed by law) stored in set" UBYTE _CNV_A_R_LINEAR_____0_CM 1 100. 0. 255. DISPLAY_IDENTIFIER ENVD_CUS_SET_SPC_4_1_8 ECU_ADDRESS 0xd0009f7b FORMAT "%3.0" /end MEASUREMENT
/begin MEASUREMENT tbl_frf[8].envd_cus_set_spc[1][0] "Freeze frame FRF_CUS_SET_SPC: environmental data specific to each failure (not fixed by law) stored in set" UBYTE _CNV_A_R_LINEAR_____0_CM 1 100. 0. 255. DISPLAY_IDENTIFIER ENVD_CUS_SET_SPC_1_2_8 ECU_ADDRESS 0xd0009f7c FORMAT "%3.0" /end MEASUREMENT
/begin MEASUREMENT tbl_frf[8].envd_cus_set_spc[1][1] "Freeze frame FRF_CUS_SET_SPC: environmental data specific to each failure (not fixed by law) stored in set" UBYTE _CNV_A_R_LINEAR_____0_CM 1 100. 0. 255. DISPLAY_IDENTIFIER ENVD_CUS_SET_SPC_2_2_8 ECU_ADDRESS 0xd0009f7d FORMAT "%3.0" /end MEASUREMENT
/begin MEASUREMENT tbl_frf[8].envd_cus_set_spc[1][2] "Freeze frame FRF_CUS_SET_SPC: environmental data specific to each failure (not fixed by law) stored in set" UBYTE _CNV_A_R_LINEAR_____0_CM 1 100. 0. 255. DISPLAY_IDENTIFIER ENVD_CUS_SET_SPC_3_2_8 ECU_ADDRESS 0xd0009f7e FORMAT "%3.0" /end MEASUREMENT
/begin MEASUREMENT tbl_frf[8].envd_cus_set_spc[1][3] "Freeze frame FRF_CUS_SET_SPC: environmental data specific to each failure (not fixed by law) stored in set" UBYTE _CNV_A_R_LINEAR_____0_CM 1 100. 0. 255. DISPLAY_IDENTIFIER ENVD_CUS_SET_SPC_4_2_8 ECU_ADDRESS 0xd0009f7f FORMAT "%3.0" /end MEASUREMENT
/begin MEASUREMENT tbl_frf[8].envd_cus_set_spc[2][0] "Freeze frame FRF_CUS_SET_SPC: environmental data specific to each failure (not fixed by law) stored in set" UBYTE _CNV_A_R_LINEAR_____0_CM 1 100. 0. 255. DISPLAY_IDENTIFIER ENVD_CUS_SET_SPC_1_3_8 ECU_ADDRESS 0xd0009f80 FORMAT "%3.0" /end MEASUREMENT
/begin MEASUREMENT tbl_frf[8].envd_cus_set_spc[2][1] "Freeze frame FRF_CUS_SET_SPC: environmental data specific to each failure (not fixed by law) stored in set" UBYTE _CNV_A_R_LINEAR_____0_CM 1 100. 0. 255. DISPLAY_IDENTIFIER ENVD_CUS_SET_SPC_2_3_8 ECU_ADDRESS 0xd0009f81 FORMAT "%3.0" /end MEASUREMENT
/begin MEASUREMENT tbl_frf[8].envd_cus_set_spc[2][2] "Freeze frame FRF_CUS_SET_SPC: environmental data specific to each failure (not fixed by law) stored in set" UBYTE _CNV_A_R_LINEAR_____0_CM 1 100. 0. 255. DISPLAY_IDENTIFIER ENVD_CUS_SET_SPC_3_3_8 ECU_ADDRESS 0xd0009f82 FORMAT "%3.0" /end MEASUREMENT
/begin MEASUREMENT tbl_frf[8].envd_cus_set_spc[2][3] "Freeze frame FRF_CUS_SET_SPC: environmental data specific to each failure (not fixed by law) stored in set" UBYTE _CNV_A_R_LINEAR_____0_CM 1 100. 0. 255. DISPLAY_IDENTIFIER ENVD_CUS_SET_SPC_4_3_8 ECU_ADDRESS 0xd0009f83 FORMAT "%3.0" /end MEASUREMENT
/begin MEASUREMENT tbl_frf[9].envd_obd[0] "Freeze frame FRF_OBD: environmental data (fixed by law)" UBYTE _CNV_A_R_LINEAR_____0_CM 1 100. 0. 255. DISPLAY_IDENTIFIER ENVD_OBD_1_9 ECU_ADDRESS 0xd0009f88 FORMAT "%3.0" /end MEASUREMENT
/begin MEASUREMENT tbl_frf[9].envd_obd[1] "Freeze frame FRF_OBD: environmental data (fixed by law)" UBYTE _CNV_A_R_LINEAR_____0_CM 1 100. 0. 255. DISPLAY_IDENTIFIER ENVD_OBD_2_9 ECU_ADDRESS 0xd0009f89 FORMAT "%3.0" /end MEASUREMENT
/begin MEASUREMENT tbl_frf[9].envd_obd[2] "Freeze frame FRF_OBD: environmental data (fixed by law)" UBYTE _CNV_A_R_LINEAR_____0_CM 1 100. 0. 255. DISPLAY_IDENTIFIER ENVD_OBD_3_9 ECU_ADDRESS 0xd0009f8a FORMAT "%3.0" /end MEASUREMENT
/begin MEASUREMENT tbl_frf[9].envd_obd[3] "Freeze frame FRF_OBD: environmental data (fixed by law)" UBYTE _CNV_A_R_LINEAR_____0_CM 1 100. 0. 255. DISPLAY_IDENTIFIER ENVD_OBD_4_9 ECU_ADDRESS 0xd0009f8b FORMAT "%3.0" /end MEASUREMENT
/begin MEASUREMENT tbl_frf[9].envd_obd[4] "Freeze frame FRF_OBD: environmental data (fixed by law)" UBYTE _CNV_A_R_LINEAR_____0_CM 1 100. 0. 255. DISPLAY_IDENTIFIER ENVD_OBD_5_9 ECU_ADDRESS 0xd0009f8c FORMAT "%3.0" /end MEASUREMENT
/begin MEASUREMENT tbl_frf[9].envd_obd[5] "Freeze frame FRF_OBD: environmental data (fixed by law)" UBYTE _CNV_A_R_LINEAR_____0_CM 1 100. 0. 255. DISPLAY_IDENTIFIER ENVD_OBD_6_9 ECU_ADDRESS 0xd0009f8d FORMAT "%3.0" /end MEASUREMENT
/begin MEASUREMENT tbl_frf[9].envd_obd[6] "Freeze frame FRF_OBD: environmental data (fixed by law)" UBYTE _CNV_A_R_LINEAR_____0_CM 1 100. 0. 255. DISPLAY_IDENTIFIER ENVD_OBD_7_9 ECU_ADDRESS 0xd0009f8e FORMAT "%3.0" /end MEASUREMENT
/begin MEASUREMENT tbl_frf[9].envd_obd[7] "Freeze frame FRF_OBD: environmental data (fixed by law)" UBYTE _CNV_A_R_LINEAR_____0_CM 1 100. 0. 255. DISPLAY_IDENTIFIER ENVD_OBD_8_9 ECU_ADDRESS 0xd0009f8f FORMAT "%3.0" /end MEASUREMENT
/begin MEASUREMENT tbl_frf[9].envd_obd[8] "Freeze frame FRF_OBD: environmental data (fixed by law)" UBYTE _CNV_A_R_LINEAR_____0_CM 1 100. 0. 255. DISPLAY_IDENTIFIER ENVD_OBD_9_9 ECU_ADDRESS 0xd0009f90 FORMAT "%3.0" /end MEASUREMENT
/begin MEASUREMENT tbl_frf[9].envd_obd[9] "Freeze frame FRF_OBD: environmental data (fixed by law)" UBYTE _CNV_A_R_LINEAR_____0_CM 1 100. 0. 255. DISPLAY_IDENTIFIER ENVD_OBD_10_9 ECU_ADDRESS 0xd0009f91 FORMAT "%3.0" /end MEASUREMENT
/begin MEASUREMENT tbl_frf[9].envd_obd[10] "Freeze frame FRF_OBD: environmental data (fixed by law)" UBYTE _CNV_A_R_LINEAR_____0_CM 1 100. 0. 255. DISPLAY_IDENTIFIER ENVD_OBD_11_9 ECU_ADDRESS 0xd0009f92 FORMAT "%3.0" /end MEASUREMENT
/begin MEASUREMENT tbl_frf[9].envd_obd[11] "Freeze frame FRF_OBD: environmental data (fixed by law)" UBYTE _CNV_A_R_LINEAR_____0_CM 1 100. 0. 255. DISPLAY_IDENTIFIER ENVD_OBD_12_9 ECU_ADDRESS 0xd0009f93 FORMAT "%3.0" /end MEASUREMENT
/begin MEASUREMENT tbl_frf[9].envd_obd[12] "Freeze frame FRF_OBD: environmental data (fixed by law)" UBYTE _CNV_A_R_LINEAR_____0_CM 1 100. 0. 255. DISPLAY_IDENTIFIER ENVD_OBD_13_9 ECU_ADDRESS 0xd0009f94 FORMAT "%3.0" /end MEASUREMENT
/begin MEASUREMENT tbl_frf[9].envd_obd[13] "Freeze frame FRF_OBD: environmental data (fixed by law)" UBYTE _CNV_A_R_LINEAR_____0_CM 1 100. 0. 255. DISPLAY_IDENTIFIER ENVD_OBD_14_9 ECU_ADDRESS 0xd0009f95 FORMAT "%3.0" /end MEASUREMENT
/begin MEASUREMENT tbl_frf[9].envd_obd[14] "Freeze frame FRF_OBD: environmental data (fixed by law)" UBYTE _CNV_A_R_LINEAR_____0_CM 1 100. 0. 255. DISPLAY_IDENTIFIER ENVD_OBD_15_9 ECU_ADDRESS 0xd0009f96 FORMAT "%3.0" /end MEASUREMENT
/begin MEASUREMENT tbl_frf[9].envd_obd[15] "Freeze frame FRF_OBD: environmental data (fixed by law)" UBYTE _CNV_A_R_LINEAR_____0_CM 1 100. 0. 255. DISPLAY_IDENTIFIER ENVD_OBD_16_9 ECU_ADDRESS 0xd0009f97 FORMAT "%3.0" /end MEASUREMENT
/begin MEASUREMENT tbl_frf[9].envd_obd[16] "Freeze frame FRF_OBD: environmental data (fixed by law)" UBYTE _CNV_A_R_LINEAR_____0_CM 1 100. 0. 255. DISPLAY_IDENTIFIER ENVD_OBD_17_9 ECU_ADDRESS 0xd0009f98 FORMAT "%3.0" /end MEASUREMENT
/begin MEASUREMENT tbl_frf[9].envd_obd[17] "Freeze frame FRF_OBD: environmental data (fixed by law)" UBYTE _CNV_A_R_LINEAR_____0_CM 1 100. 0. 255. DISPLAY_IDENTIFIER ENVD_OBD_18_9 ECU_ADDRESS 0xd0009f99 FORMAT "%3.0" /end MEASUREMENT
/begin MEASUREMENT tbl_frf[9].envd_obd[18] "Freeze frame FRF_OBD: environmental data (fixed by law)" UBYTE _CNV_A_R_LINEAR_____0_CM 1 100. 0. 255. DISPLAY_IDENTIFIER ENVD_OBD_19_9 ECU_ADDRESS 0xd0009f9a FORMAT "%3.0" /end MEASUREMENT
/begin MEASUREMENT tbl_frf[9].envd_obd[19] "Freeze frame FRF_OBD: environmental data (fixed by law)" UBYTE _CNV_A_R_LINEAR_____0_CM 1 100. 0. 255. DISPLAY_IDENTIFIER ENVD_OBD_20_9 ECU_ADDRESS 0xd0009f9b FORMAT "%3.0" /end MEASUREMENT
/begin MEASUREMENT tbl_frf[9].envd_obd[20] "Freeze frame FRF_OBD: environmental data (fixed by law)" UBYTE _CNV_A_R_LINEAR_____0_CM 1 100. 0. 255. DISPLAY_IDENTIFIER ENVD_OBD_21_9 ECU_ADDRESS 0xd0009f9c FORMAT "%3.0" /end MEASUREMENT
/begin MEASUREMENT tbl_frf[9].envd_obd[21] "Freeze frame FRF_OBD: environmental data (fixed by law)" UBYTE _CNV_A_R_LINEAR_____0_CM 1 100. 0. 255. DISPLAY_IDENTIFIER ENVD_OBD_22_9 ECU_ADDRESS 0xd0009f9d FORMAT "%3.0" /end MEASUREMENT
/begin MEASUREMENT tbl_frf[9].envd_obd[22] "Freeze frame FRF_OBD: environmental data (fixed by law)" UBYTE _CNV_A_R_LINEAR_____0_CM 1 100. 0. 255. DISPLAY_IDENTIFIER ENVD_OBD_23_9 ECU_ADDRESS 0xd0009f9e FORMAT "%3.0" /end MEASUREMENT
/begin MEASUREMENT tbl_frf[9].envd_obd[23] "Freeze frame FRF_OBD: environmental data (fixed by law)" UBYTE _CNV_A_R_LINEAR_____0_CM 1 100. 0. 255. DISPLAY_IDENTIFIER ENVD_OBD_24_9 ECU_ADDRESS 0xd0009f9f FORMAT "%3.0" /end MEASUREMENT
/begin MEASUREMENT tbl_frf[9].envd_obd[24] "Freeze frame FRF_OBD: environmental data (fixed by law)" UBYTE _CNV_A_R_LINEAR_____0_CM 1 100. 0. 255. DISPLAY_IDENTIFIER ENVD_OBD_25_9 ECU_ADDRESS 0xd0009fa0 FORMAT "%3.0" /end MEASUREMENT
/begin MEASUREMENT tbl_frf[9].envd_obd[25] "Freeze frame FRF_OBD: environmental data (fixed by law)" UBYTE _CNV_A_R_LINEAR_____0_CM 1 100. 0. 255. DISPLAY_IDENTIFIER ENVD_OBD_26_9 ECU_ADDRESS 0xd0009fa1 FORMAT "%3.0" /end MEASUREMENT
/begin MEASUREMENT tbl_frf[9].envd_obd[26] "Freeze frame FRF_OBD: environmental data (fixed by law)" UBYTE _CNV_A_R_LINEAR_____0_CM 1 100. 0. 255. DISPLAY_IDENTIFIER ENVD_OBD_27_9 ECU_ADDRESS 0xd0009fa2 FORMAT "%3.0" /end MEASUREMENT
/begin MEASUREMENT tbl_frf[9].envd_obd[27] "Freeze frame FRF_OBD: environmental data (fixed by law)" UBYTE _CNV_A_R_LINEAR_____0_CM 1 100. 0. 255. DISPLAY_IDENTIFIER ENVD_OBD_28_9 ECU_ADDRESS 0xd0009fa3 FORMAT "%3.0" /end MEASUREMENT
/begin MEASUREMENT tbl_frf[9].envd_obd[28] "Freeze frame FRF_OBD: environmental data (fixed by law)" UBYTE _CNV_A_R_LINEAR_____0_CM 1 100. 0. 255. DISPLAY_IDENTIFIER ENVD_OBD_29_9 ECU_ADDRESS 0xd0009fa4 FORMAT "%3.0" /end MEASUREMENT
/begin MEASUREMENT tbl_frf[9].envd_obd[29] "Freeze frame FRF_OBD: environmental data (fixed by law)" UBYTE _CNV_A_R_LINEAR_____0_CM 1 100. 0. 255. DISPLAY_IDENTIFIER ENVD_OBD_30_9 ECU_ADDRESS 0xd0009fa5 FORMAT "%3.0" /end MEASUREMENT
/begin MEASUREMENT tbl_frf[9].envd_obd[30] "Freeze frame FRF_OBD: environmental data (fixed by law)" UBYTE _CNV_A_R_LINEAR_____0_CM 1 100. 0. 255. DISPLAY_IDENTIFIER ENVD_OBD_31_9 ECU_ADDRESS 0xd0009fa6 FORMAT "%3.0" /end MEASUREMENT
/begin MEASUREMENT tbl_frf[9].envd_obd[31] "Freeze frame FRF_OBD: environmental data (fixed by law)" UBYTE _CNV_A_R_LINEAR_____0_CM 1 100. 0. 255. DISPLAY_IDENTIFIER ENVD_OBD_32_9 ECU_ADDRESS 0xd0009fa7 FORMAT "%3.0" /end MEASUREMENT
/begin MEASUREMENT tbl_frf[9].envd_obd[32] "Freeze frame FRF_OBD: environmental data (fixed by law)" UBYTE _CNV_A_R_LINEAR_____0_CM 1 100. 0. 255. DISPLAY_IDENTIFIER ENVD_OBD_33_9 ECU_ADDRESS 0xd0009fa8 FORMAT "%3.0" /end MEASUREMENT
/begin MEASUREMENT tbl_frf[9].envd_obd[33] "Freeze frame FRF_OBD: environmental data (fixed by law)" UBYTE _CNV_A_R_LINEAR_____0_CM 1 100. 0. 255. DISPLAY_IDENTIFIER ENVD_OBD_34_9 ECU_ADDRESS 0xd0009fa9 FORMAT "%3.0" /end MEASUREMENT
/begin MEASUREMENT tbl_frf[9].envd_obd[34] "Freeze frame FRF_OBD: environmental data (fixed by law)" UBYTE _CNV_A_R_LINEAR_____0_CM 1 100. 0. 255. DISPLAY_IDENTIFIER ENVD_OBD[34] ECU_ADDRESS 0xd0009faa FORMAT "%3.0" /end MEASUREMENT
/begin MEASUREMENT tbl_frf[9].envd_obd[35] "Freeze frame FRF_OBD: environmental data (fixed by law)" UBYTE _CNV_A_R_LINEAR_____0_CM 1 100. 0. 255. DISPLAY_IDENTIFIER ENVD_OBD[35] ECU_ADDRESS 0xd0009fab FORMAT "%3.0" /end MEASUREMENT
/begin MEASUREMENT tbl_frf[9].envd_obd[36] "Freeze frame FRF_OBD: environmental data (fixed by law)" UBYTE _CNV_A_R_LINEAR_____0_CM 1 100. 0. 255. DISPLAY_IDENTIFIER ENVD_OBD[36] ECU_ADDRESS 0xd0009fac FORMAT "%3.0" /end MEASUREMENT
/begin MEASUREMENT tbl_frf[9].envd_obd[37] "Freeze frame FRF_OBD: environmental data (fixed by law)" UBYTE _CNV_A_R_LINEAR_____0_CM 1 100. 0. 255. DISPLAY_IDENTIFIER ENVD_OBD[37] ECU_ADDRESS 0xd0009fad FORMAT "%3.0" /end MEASUREMENT
/begin MEASUREMENT tbl_frf[9].envd_cus_cmn[0] "Freeze frame FRF_CUS_CMN: environmental data common to all failure (not fixed by law)" UBYTE _CNV_A_R_LINEAR_____0_CM 1 100. 0. 255. DISPLAY_IDENTIFIER ENVD_CUS_CMN_1_9 ECU_ADDRESS 0xd0009fae FORMAT "%3.0" /end MEASUREMENT
/begin MEASUREMENT tbl_frf[9].envd_cus_set_cmn[0][0] "Freeze frame FRF_CUS_SET_CMN: environmental data common to all failure (not fixed by law) stored in set" UBYTE _CNV_A_R_LINEAR_____0_CM 1 100. 0. 255. DISPLAY_IDENTIFIER ENVD_CUS_SET_CMN_1_1_9 ECU_ADDRESS 0xd0009fb0 FORMAT "%3.0" /end MEASUREMENT
/begin MEASUREMENT tbl_frf[9].envd_cus_set_cmn[0][1] "Freeze frame FRF_CUS_SET_CMN: environmental data common to all failure (not fixed by law) stored in set" UBYTE _CNV_A_R_LINEAR_____0_CM 1 100. 0. 255. DISPLAY_IDENTIFIER ENVD_CUS_SET_CMN_2_1_9 ECU_ADDRESS 0xd0009fb1 FORMAT "%3.0" /end MEASUREMENT
/begin MEASUREMENT tbl_frf[9].envd_cus_set_cmn[0][2] "Freeze frame FRF_CUS_SET_CMN: environmental data common to all failure (not fixed by law) stored in set" UBYTE _CNV_A_R_LINEAR_____0_CM 1 100. 0. 255. DISPLAY_IDENTIFIER ENVD_CUS_SET_CMN_3_1_9 ECU_ADDRESS 0xd0009fb2 FORMAT "%3.0" /end MEASUREMENT
/begin MEASUREMENT tbl_frf[9].envd_cus_set_cmn[0][3] "Freeze frame FRF_CUS_SET_CMN: environmental data common to all failure (not fixed by law) stored in set" UBYTE _CNV_A_R_LINEAR_____0_CM 1 100. 0. 255. DISPLAY_IDENTIFIER ENVD_CUS_SET_CMN_0_3_ ECU_ADDRESS 0xd0009fb3 FORMAT "%3.0" /end MEASUREMENT
/begin MEASUREMENT tbl_frf[9].envd_cus_set_cmn[0][4] "Freeze frame FRF_CUS_SET_CMN: environmental data common to all failure (not fixed by law) stored in set" UBYTE _CNV_A_R_LINEAR_____0_CM 1 100. 0. 255. DISPLAY_IDENTIFIER ENVD_CUS_SET_CMN_0_4_ ECU_ADDRESS 0xd0009fb4 FORMAT "%3.0" /end MEASUREMENT
/begin MEASUREMENT tbl_frf[9].envd_cus_set_cmn[0][5] "Freeze frame FRF_CUS_SET_CMN: environmental data common to all failure (not fixed by law) stored in set" UBYTE _CNV_A_R_LINEAR_____0_CM 1 100. 0. 255. DISPLAY_IDENTIFIER ENVD_CUS_SET_CMN_0_5_ ECU_ADDRESS 0xd0009fb5 FORMAT "%3.0" /end MEASUREMENT
/begin MEASUREMENT tbl_frf[9].envd_cus_set_cmn[0][6] "Freeze frame FRF_CUS_SET_CMN: environmental data common to all failure (not fixed by law) stored in set" UBYTE _CNV_A_R_LINEAR_____0_CM 1 100. 0. 255. DISPLAY_IDENTIFIER ENVD_CUS_SET_CMN_0_6_ ECU_ADDRESS 0xd0009fb6 FORMAT "%3.0" /end MEASUREMENT
/begin MEASUREMENT tbl_frf[9].envd_cus_set_cmn[0][7] "Freeze frame FRF_CUS_SET_CMN: environmental data common to all failure (not fixed by law) stored in set" UBYTE _CNV_A_R_LINEAR_____0_CM 1 100. 0. 255. DISPLAY_IDENTIFIER ENVD_CUS_SET_CMN_0_7_ ECU_ADDRESS 0xd0009fb7 FORMAT "%3.0" /end MEASUREMENT
/begin MEASUREMENT tbl_frf[9].envd_cus_set_cmn[0][8] "Freeze frame FRF_CUS_SET_CMN: environmental data common to all failure (not fixed by law) stored in set" UBYTE _CNV_A_R_LINEAR_____0_CM 1 100. 0. 255. DISPLAY_IDENTIFIER ENVD_CUS_SET_CMN_0_8_ ECU_ADDRESS 0xd0009fb8 FORMAT "%3.0" /end MEASUREMENT
/begin MEASUREMENT tbl_frf[9].envd_cus_set_cmn[0][9] "Freeze frame FRF_CUS_SET_CMN: environmental data common to all failure (not fixed by law) stored in set" UBYTE _CNV_A_R_LINEAR_____0_CM 1 100. 0. 255. DISPLAY_IDENTIFIER ENVD_CUS_SET_CMN_0_9_ ECU_ADDRESS 0xd0009fb9 FORMAT "%3.0" /end MEASUREMENT
/begin MEASUREMENT tbl_frf[9].envd_cus_set_cmn[1][0] "Freeze frame FRF_CUS_SET_CMN: environmental data common to all failure (not fixed by law) stored in set" UBYTE _CNV_A_R_LINEAR_____0_CM 1 100. 0. 255. DISPLAY_IDENTIFIER ENVD_CUS_SET_CMN_1_2_9 ECU_ADDRESS 0xd0009fba FORMAT "%3.0" /end MEASUREMENT
/begin MEASUREMENT tbl_frf[9].envd_cus_set_cmn[1][1] "Freeze frame FRF_CUS_SET_CMN: environmental data common to all failure (not fixed by law) stored in set" UBYTE _CNV_A_R_LINEAR_____0_CM 1 100. 0. 255. DISPLAY_IDENTIFIER ENVD_CUS_SET_CMN_2_2_9 ECU_ADDRESS 0xd0009fbb FORMAT "%3.0" /end MEASUREMENT
/begin MEASUREMENT tbl_frf[9].envd_cus_set_cmn[1][2] "Freeze frame FRF_CUS_SET_CMN: environmental data common to all failure (not fixed by law) stored in set" UBYTE _CNV_A_R_LINEAR_____0_CM 1 100. 0. 255. DISPLAY_IDENTIFIER ENVD_CUS_SET_CMN_3_2_9 ECU_ADDRESS 0xd0009fbc FORMAT "%3.0" /end MEASUREMENT
/begin MEASUREMENT tbl_frf[9].envd_cus_set_cmn[1][3] "Freeze frame FRF_CUS_SET_CMN: environmental data common to all failure (not fixed by law) stored in set" UBYTE _CNV_A_R_LINEAR_____0_CM 1 100. 0. 255. DISPLAY_IDENTIFIER ENVD_CUS_SET_CMN_1_3_ ECU_ADDRESS 0xd0009fbd FORMAT "%3.0" /end MEASUREMENT
/begin MEASUREMENT tbl_frf[9].envd_cus_set_cmn[1][4] "Freeze frame FRF_CUS_SET_CMN: environmental data common to all failure (not fixed by law) stored in set" UBYTE _CNV_A_R_LINEAR_____0_CM 1 100. 0. 255. DISPLAY_IDENTIFIER ENVD_CUS_SET_CMN_1_4_ ECU_ADDRESS 0xd0009fbe FORMAT "%3.0" /end MEASUREMENT
/begin MEASUREMENT tbl_frf[9].envd_cus_set_cmn[1][5] "Freeze frame FRF_CUS_SET_CMN: environmental data common to all failure (not fixed by law) stored in set" UBYTE _CNV_A_R_LINEAR_____0_CM 1 100. 0. 255. DISPLAY_IDENTIFIER ENVD_CUS_SET_CMN_1_5_ ECU_ADDRESS 0xd0009fbf FORMAT "%3.0" /end MEASUREMENT
/begin MEASUREMENT tbl_frf[9].envd_cus_set_cmn[1][6] "Freeze frame FRF_CUS_SET_CMN: environmental data common to all failure (not fixed by law) stored in set" UBYTE _CNV_A_R_LINEAR_____0_CM 1 100. 0. 255. DISPLAY_IDENTIFIER ENVD_CUS_SET_CMN_1_6_ ECU_ADDRESS 0xd0009fc0 FORMAT "%3.0" /end MEASUREMENT
/begin MEASUREMENT tbl_frf[9].envd_cus_set_cmn[1][7] "Freeze frame FRF_CUS_SET_CMN: environmental data common to all failure (not fixed by law) stored in set" UBYTE _CNV_A_R_LINEAR_____0_CM 1 100. 0. 255. DISPLAY_IDENTIFIER ENVD_CUS_SET_CMN_1_7_ ECU_ADDRESS 0xd0009fc1 FORMAT "%3.0" /end MEASUREMENT
/begin MEASUREMENT tbl_frf[9].envd_cus_set_cmn[1][8] "Freeze frame FRF_CUS_SET_CMN: environmental data common to all failure (not fixed by law) stored in set" UBYTE _CNV_A_R_LINEAR_____0_CM 1 100. 0. 255. DISPLAY_IDENTIFIER ENVD_CUS_SET_CMN_1_8_ ECU_ADDRESS 0xd0009fc2 FORMAT "%3.0" /end MEASUREMENT
/begin MEASUREMENT tbl_frf[9].envd_cus_set_cmn[1][9] "Freeze frame FRF_CUS_SET_CMN: environmental data common to all failure (not fixed by law) stored in set" UBYTE _CNV_A_R_LINEAR_____0_CM 1 100. 0. 255. DISPLAY_IDENTIFIER ENVD_CUS_SET_CMN_1_9_ ECU_ADDRESS 0xd0009fc3 FORMAT "%3.0" /end MEASUREMENT
/begin MEASUREMENT tbl_frf[9].envd_cus_set_cmn[2][0] "Freeze frame FRF_CUS_SET_CMN: environmental data common to all failure (not fixed by law) stored in set" UBYTE _CNV_A_R_LINEAR_____0_CM 1 100. 0. 255. DISPLAY_IDENTIFIER ENVD_CUS_SET_CMN_1_3_9 ECU_ADDRESS 0xd0009fc4 FORMAT "%3.0" /end MEASUREMENT
/begin MEASUREMENT tbl_frf[9].envd_cus_set_cmn[2][1] "Freeze frame FRF_CUS_SET_CMN: environmental data common to all failure (not fixed by law) stored in set" UBYTE _CNV_A_R_LINEAR_____0_CM 1 100. 0. 255. DISPLAY_IDENTIFIER ENVD_CUS_SET_CMN_2_3_9 ECU_ADDRESS 0xd0009fc5 FORMAT "%3.0" /end MEASUREMENT
/begin MEASUREMENT tbl_frf[9].envd_cus_set_cmn[2][2] "Freeze frame FRF_CUS_SET_CMN: environmental data common to all failure (not fixed by law) stored in set" UBYTE _CNV_A_R_LINEAR_____0_CM 1 100. 0. 255. DISPLAY_IDENTIFIER ENVD_CUS_SET_CMN_3_3_9 ECU_ADDRESS 0xd0009fc6 FORMAT "%3.0" /end MEASUREMENT
/begin MEASUREMENT tbl_frf[9].envd_cus_set_cmn[2][3] "Freeze frame FRF_CUS_SET_CMN: environmental data common to all failure (not fixed by law) stored in set" UBYTE _CNV_A_R_LINEAR_____0_CM 1 100. 0. 255. DISPLAY_IDENTIFIER ENVD_CUS_SET_CMN_2_3_ ECU_ADDRESS 0xd0009fc7 FORMAT "%3.0" /end MEASUREMENT
/begin MEASUREMENT tbl_frf[9].envd_cus_set_cmn[2][4] "Freeze frame FRF_CUS_SET_CMN: environmental data common to all failure (not fixed by law) stored in set" UBYTE _CNV_A_R_LINEAR_____0_CM 1 100. 0. 255. DISPLAY_IDENTIFIER ENVD_CUS_SET_CMN_2_4_ ECU_ADDRESS 0xd0009fc8 FORMAT "%3.0" /end MEASUREMENT
/begin MEASUREMENT tbl_frf[9].envd_cus_set_cmn[2][5] "Freeze frame FRF_CUS_SET_CMN: environmental data common to all failure (not fixed by law) stored in set" UBYTE _CNV_A_R_LINEAR_____0_CM 1 100. 0. 255. DISPLAY_IDENTIFIER ENVD_CUS_SET_CMN_2_5_ ECU_ADDRESS 0xd0009fc9 FORMAT "%3.0" /end MEASUREMENT
/begin MEASUREMENT tbl_frf[9].envd_cus_set_cmn[2][6] "Freeze frame FRF_CUS_SET_CMN: environmental data common to all failure (not fixed by law) stored in set" UBYTE _CNV_A_R_LINEAR_____0_CM 1 100. 0. 255. DISPLAY_IDENTIFIER ENVD_CUS_SET_CMN_2_6_ ECU_ADDRESS 0xd0009fca FORMAT "%3.0" /end MEASUREMENT
/begin MEASUREMENT tbl_frf[9].envd_cus_set_cmn[2][7] "Freeze frame FRF_CUS_SET_CMN: environmental data common to all failure (not fixed by law) stored in set" UBYTE _CNV_A_R_LINEAR_____0_CM 1 100. 0. 255. DISPLAY_IDENTIFIER ENVD_CUS_SET_CMN_2_7_ ECU_ADDRESS 0xd0009fcb FORMAT "%3.0" /end MEASUREMENT
/begin MEASUREMENT tbl_frf[9].envd_cus_set_cmn[2][8] "Freeze frame FRF_CUS_SET_CMN: environmental data common to all failure (not fixed by law) stored in set" UBYTE _CNV_A_R_LINEAR_____0_CM 1 100. 0. 255. DISPLAY_IDENTIFIER ENVD_CUS_SET_CMN_2_8_ ECU_ADDRESS 0xd0009fcc FORMAT "%3.0" /end MEASUREMENT
/begin MEASUREMENT tbl_frf[9].envd_cus_set_cmn[2][9] "Freeze frame FRF_CUS_SET_CMN: environmental data common to all failure (not fixed by law) stored in set" UBYTE _CNV_A_R_LINEAR_____0_CM 1 100. 0. 255. DISPLAY_IDENTIFIER ENVD_CUS_SET_CMN_2_9_ ECU_ADDRESS 0xd0009fcd FORMAT "%3.0" /end MEASUREMENT
/begin MEASUREMENT tbl_frf[9].envd_cus_set_spc[0][0] "Freeze frame FRF_CUS_SET_SPC: environmental data specific to each failure (not fixed by law) stored in set" UBYTE _CNV_A_R_LINEAR_____0_CM 1 100. 0. 255. DISPLAY_IDENTIFIER ENVD_CUS_SET_SPC_1_1_9 ECU_ADDRESS 0xd0009fd0 FORMAT "%3.0" /end MEASUREMENT
/begin MEASUREMENT tbl_frf[9].envd_cus_set_spc[0][1] "Freeze frame FRF_CUS_SET_SPC: environmental data specific to each failure (not fixed by law) stored in set" UBYTE _CNV_A_R_LINEAR_____0_CM 1 100. 0. 255. DISPLAY_IDENTIFIER ENVD_CUS_SET_SPC_2_1_9 ECU_ADDRESS 0xd0009fd1 FORMAT "%3.0" /end MEASUREMENT
/begin MEASUREMENT tbl_frf[9].envd_cus_set_spc[0][2] "Freeze frame FRF_CUS_SET_SPC: environmental data specific to each failure (not fixed by law) stored in set" UBYTE _CNV_A_R_LINEAR_____0_CM 1 100. 0. 255. DISPLAY_IDENTIFIER ENVD_CUS_SET_SPC_3_1_9 ECU_ADDRESS 0xd0009fd2 FORMAT "%3.0" /end MEASUREMENT
/begin MEASUREMENT tbl_frf[9].envd_cus_set_spc[0][3] "Freeze frame FRF_CUS_SET_SPC: environmental data specific to each failure (not fixed by law) stored in set" UBYTE _CNV_A_R_LINEAR_____0_CM 1 100. 0. 255. DISPLAY_IDENTIFIER ENVD_CUS_SET_SPC_4_1_9 ECU_ADDRESS 0xd0009fd3 FORMAT "%3.0" /end MEASUREMENT
/begin MEASUREMENT tbl_frf[9].envd_cus_set_spc[1][0] "Freeze frame FRF_CUS_SET_SPC: environmental data specific to each failure (not fixed by law) stored in set" UBYTE _CNV_A_R_LINEAR_____0_CM 1 100. 0. 255. DISPLAY_IDENTIFIER ENVD_CUS_SET_SPC_1_2_9 ECU_ADDRESS 0xd0009fd4 FORMAT "%3.0" /end MEASUREMENT
/begin MEASUREMENT tbl_frf[9].envd_cus_set_spc[1][1] "Freeze frame FRF_CUS_SET_SPC: environmental data specific to each failure (not fixed by law) stored in set" UBYTE _CNV_A_R_LINEAR_____0_CM 1 100. 0. 255. DISPLAY_IDENTIFIER ENVD_CUS_SET_SPC_2_2_9 ECU_ADDRESS 0xd0009fd5 FORMAT "%3.0" /end MEASUREMENT
/begin MEASUREMENT tbl_frf[9].envd_cus_set_spc[1][2] "Freeze frame FRF_CUS_SET_SPC: environmental data specific to each failure (not fixed by law) stored in set" UBYTE _CNV_A_R_LINEAR_____0_CM 1 100. 0. 255. DISPLAY_IDENTIFIER ENVD_CUS_SET_SPC_3_2_9 ECU_ADDRESS 0xd0009fd6 FORMAT "%3.0" /end MEASUREMENT
/begin MEASUREMENT tbl_frf[9].envd_cus_set_spc[1][3] "Freeze frame FRF_CUS_SET_SPC: environmental data specific to each failure (not fixed by law) stored in set" UBYTE _CNV_A_R_LINEAR_____0_CM 1 100. 0. 255. DISPLAY_IDENTIFIER ENVD_CUS_SET_SPC_4_2_9 ECU_ADDRESS 0xd0009fd7 FORMAT "%3.0" /end MEASUREMENT
/begin MEASUREMENT tbl_frf[9].envd_cus_set_spc[2][0] "Freeze frame FRF_CUS_SET_SPC: environmental data specific to each failure (not fixed by law) stored in set" UBYTE _CNV_A_R_LINEAR_____0_CM 1 100. 0. 255. DISPLAY_IDENTIFIER ENVD_CUS_SET_SPC_1_3_9 ECU_ADDRESS 0xd0009fd8 FORMAT "%3.0" /end MEASUREMENT
/begin MEASUREMENT tbl_frf[9].envd_cus_set_spc[2][1] "Freeze frame FRF_CUS_SET_SPC: environmental data specific to each failure (not fixed by law) stored in set" UBYTE _CNV_A_R_LINEAR_____0_CM 1 100. 0. 255. DISPLAY_IDENTIFIER ENVD_CUS_SET_SPC_2_3_9 ECU_ADDRESS 0xd0009fd9 FORMAT "%3.0" /end MEASUREMENT
/begin MEASUREMENT tbl_frf[9].envd_cus_set_spc[2][2] "Freeze frame FRF_CUS_SET_SPC: environmental data specific to each failure (not fixed by law) stored in set" UBYTE _CNV_A_R_LINEAR_____0_CM 1 100. 0. 255. DISPLAY_IDENTIFIER ENVD_CUS_SET_SPC_3_3_9 ECU_ADDRESS 0xd0009fda FORMAT "%3.0" /end MEASUREMENT
/begin MEASUREMENT tbl_frf[9].envd_cus_set_spc[2][3] "Freeze frame FRF_CUS_SET_SPC: environmental data specific to each failure (not fixed by law) stored in set" UBYTE _CNV_A_R_LINEAR_____0_CM 1 100. 0. 255. DISPLAY_IDENTIFIER ENVD_CUS_SET_SPC_4_3_9 ECU_ADDRESS 0xd0009fdb FORMAT "%3.0" /end MEASUREMENT
/begin CHARACTERISTIC fmy_id_imob_0.envd "Freeze frame FRF_CUS_SET_SPC: environmental data contents for failure XX" CURVE 0xa0803b6c _REC_CUR_20_u1_u1 254. _CNV_A_R_LINEAR_____0_CM 1. 255. DISPLAY_IDENTIFIER ID_ERR_ENVD_IMOB_0 FORMAT "%3.0"
 /begin AXIS_DESCR COM_AXIS errm_online_dummy _CNV_A_R_LINEAR_____0_CM 4 0. 255. FORMAT "%3.0" AXIS_PTS_REF ldpm_fmy_envd /end AXIS_DESCR
/end CHARACTERISTIC
/begin CHARACTERISTIC fmy_id_imob_1.envd "Freeze frame FRF_CUS_SET_SPC: environmental data contents for failure XX" CURVE 0xa0803b80 _REC_CUR_20_u1_u1 254. _CNV_A_R_LINEAR_____0_CM 1. 255. DISPLAY_IDENTIFIER ID_ERR_ENVD_IMOB_1 FORMAT "%3.0"
 /begin AXIS_DESCR COM_AXIS errm_online_dummy _CNV_A_R_LINEAR_____0_CM 4 0. 255. FORMAT "%3.0" AXIS_PTS_REF ldpm_fmy_envd /end AXIS_DESCR
/end CHARACTERISTIC
/begin CHARACTERISTIC fmy_id_imob_2.envd "Freeze frame FRF_CUS_SET_SPC: environmental data contents for failure XX" CURVE 0xa0803b94 _REC_CUR_20_u1_u1 254. _CNV_A_R_LINEAR_____0_CM 1. 255. DISPLAY_IDENTIFIER ID_ERR_ENVD_IMOB_2 FORMAT "%3.0"
 /begin AXIS_DESCR COM_AXIS errm_online_dummy _CNV_A_R_LINEAR_____0_CM 4 0. 255. FORMAT "%3.0" AXIS_PTS_REF ldpm_fmy_envd /end AXIS_DESCR
/end CHARACTERISTIC
/begin CHARACTERISTIC fmy_id_imob_3.envd "Freeze frame FRF_CUS_SET_SPC: environmental data contents for failure XX" CURVE 0xa0803ba8 _REC_CUR_20_u1_u1 254. _CNV_A_R_LINEAR_____0_CM 1. 255. DISPLAY_IDENTIFIER ID_ERR_ENVD_IMOB_3 FORMAT "%3.0"
 /begin AXIS_DESCR COM_AXIS errm_online_dummy _CNV_A_R_LINEAR_____0_CM 4 0. 255. FORMAT "%3.0" AXIS_PTS_REF ldpm_fmy_envd /end AXIS_DESCR
/end CHARACTERISTIC
/begin CHARACTERISTIC fmy_id_tco_el.envd "Freeze frame FRF_CUS_SET_SPC: environmental data contents for failure XX" CURVE 0xa0804940 _REC_CUR_20_u1_u1 254. _CNV_A_R_LINEAR_____0_CM 1. 255. DISPLAY_IDENTIFIER ID_ERR_ENVD_TCO_EL FORMAT "%3.0"
 /begin AXIS_DESCR COM_AXIS errm_online_dummy _CNV_A_R_LINEAR_____0_CM 4 0. 255. FORMAT "%3.0" AXIS_PTS_REF ldpm_fmy_envd /end AXIS_DESCR
/end CHARACTERISTIC
/begin CHARACTERISTIC fmy_id_tco_grd.envd "Freeze frame FRF_CUS_SET_SPC: environmental data contents for failure XX" CURVE 0xa0804954 _REC_CUR_20_u1_u1 254. _CNV_A_R_LINEAR_____0_CM 1. 255. DISPLAY_IDENTIFIER ID_ERR_ENVD_TCO_GRD FORMAT "%3.0"
 /begin AXIS_DESCR COM_AXIS errm_online_dummy _CNV_A_R_LINEAR_____0_CM 4 0. 255. FORMAT "%3.0" AXIS_PTS_REF ldpm_fmy_envd /end AXIS_DESCR
/end CHARACTERISTIC
/begin CHARACTERISTIC fmy_id_tco_stuck.envd "Freeze frame FRF_CUS_SET_SPC: environmental data contents for failure XX" CURVE 0xa080497c _REC_CUR_20_u1_u1 254. _CNV_A_R_LINEAR_____0_CM 1. 255. DISPLAY_IDENTIFIER ID_ERR_ENVD_TCO_STUCK FORMAT "%3.0"
 /begin AXIS_DESCR COM_AXIS errm_online_dummy _CNV_A_R_LINEAR_____0_CM 4 0. 255. FORMAT "%3.0" AXIS_PTS_REF ldpm_fmy_envd /end AXIS_DESCR
/end CHARACTERISTIC
/begin CHARACTERISTIC fmy_id_tco_stuck_rng.envd "Freeze frame FRF_CUS_SET_SPC: environmental data contents for failure XX" CURVE 0xa0804990 _REC_CUR_20_u1_u1 254. _CNV_A_R_LINEAR_____0_CM 1. 255. DISPLAY_IDENTIFIER ID_ERR_ENVD_TCO_STUCK_RNG FORMAT "%3.0"
 /begin AXIS_DESCR COM_AXIS errm_online_dummy _CNV_A_R_LINEAR_____0_CM 4 0. 255. FORMAT "%3.0" AXIS_PTS_REF ldpm_fmy_envd /end AXIS_DESCR
/end CHARACTERISTIC
/begin CHARACTERISTIC fmy_id_tco_plaus.envd "Freeze frame FRF_CUS_SET_SPC: environmental data contents for failure XX" CURVE 0xa0804968 _REC_CUR_20_u1_u1 254. _CNV_A_R_LINEAR_____0_CM 1. 255. DISPLAY_IDENTIFIER ID_ERR_ENVD_TCO_PLAUS FORMAT "%3.0"
 /begin AXIS_DESCR COM_AXIS errm_online_dummy _CNV_A_R_LINEAR_____0_CM 4 0. 255. FORMAT "%3.0" AXIS_PTS_REF ldpm_fmy_envd /end AXIS_DESCR
/end CHARACTERISTIC
/begin CHARACTERISTIC fmy_id_tco_2_el.envd "Freeze frame FRF_CUS_SET_SPC: environmental data contents for failure XX" CURVE 0xa0804904 _REC_CUR_20_u1_u1 254. _CNV_A_R_LINEAR_____0_CM 1. 255. DISPLAY_IDENTIFIER ID_ERR_ENVD_TCO_2_EL FORMAT "%3.0"
 /begin AXIS_DESCR COM_AXIS errm_online_dummy _CNV_A_R_LINEAR_____0_CM 4 0. 255. FORMAT "%3.0" AXIS_PTS_REF ldpm_fmy_envd /end AXIS_DESCR
/end CHARACTERISTIC
/begin CHARACTERISTIC fmy_id_tco_2_grd.envd "Freeze frame FRF_CUS_SET_SPC: environmental data contents for failure XX" CURVE 0xa0804918 _REC_CUR_20_u1_u1 254. _CNV_A_R_LINEAR_____0_CM 1. 255. DISPLAY_IDENTIFIER ID_ERR_ENVD_TCO_2_GRD FORMAT "%3.0"
 /begin AXIS_DESCR COM_AXIS errm_online_dummy _CNV_A_R_LINEAR_____0_CM 4 0. 255. FORMAT "%3.0" AXIS_PTS_REF ldpm_fmy_envd /end AXIS_DESCR
/end CHARACTERISTIC
/begin CHARACTERISTIC fmy_id_tco_2_plaus.envd "Freeze frame FRF_CUS_SET_SPC: environmental data contents for failure XX" CURVE 0xa080492c _REC_CUR_20_u1_u1 254. _CNV_A_R_LINEAR_____0_CM 1. 255. DISPLAY_IDENTIFIER ID_ERR_ENVD_TCO_2_PLAUS FORMAT "%3.0"
 /begin AXIS_DESCR COM_AXIS errm_online_dummy _CNV_A_R_LINEAR_____0_CM 4 0. 255. FORMAT "%3.0" AXIS_PTS_REF ldpm_fmy_envd /end AXIS_DESCR
/end CHARACTERISTIC
/begin CHARACTERISTIC fmy_id_ect_el.envd "Freeze frame FRF_CUS_SET_SPC: environmental data contents for failure XX" CURVE 0xa08035f4 _REC_CUR_20_u1_u1 254. _CNV_A_R_LINEAR_____0_CM 1. 255. DISPLAY_IDENTIFIER ID_ERR_ENVD_ECT_EL FORMAT "%3.0"
 /begin AXIS_DESCR COM_AXIS errm_online_dummy _CNV_A_R_LINEAR_____0_CM 4 0. 255. FORMAT "%3.0" AXIS_PTS_REF ldpm_fmy_envd /end AXIS_DESCR
/end CHARACTERISTIC
/begin CHARACTERISTIC fmy_id_ecf_el_1.envd "Freeze frame FRF_CUS_SET_SPC: environmental data contents for failure XX" CURVE 0xa0803554 _REC_CUR_20_u1_u1 254. _CNV_A_R_LINEAR_____0_CM 1. 255. DISPLAY_IDENTIFIER ID_ERR_ENVD_ECF_EL_1 FORMAT "%3.0"
 /begin AXIS_DESCR COM_AXIS errm_online_dummy _CNV_A_R_LINEAR_____0_CM 4 0. 255. FORMAT "%3.0" AXIS_PTS_REF ldpm_fmy_envd /end AXIS_DESCR
/end CHARACTERISTIC
/begin CHARACTERISTIC fmy_id_ecf_el_2.envd "Freeze frame FRF_CUS_SET_SPC: environmental data contents for failure XX" CURVE 0xa0803568 _REC_CUR_20_u1_u1 254. _CNV_A_R_LINEAR_____0_CM 1. 255. DISPLAY_IDENTIFIER ID_ERR_ENVD_ECF_EL_2 FORMAT "%3.0"
 /begin AXIS_DESCR COM_AXIS errm_online_dummy _CNV_A_R_LINEAR_____0_CM 4 0. 255. FORMAT "%3.0" AXIS_PTS_REF ldpm_fmy_envd /end AXIS_DESCR
/end CHARACTERISTIC
/begin CHARACTERISTIC fmy_id_ecfpwm_fb_1.envd "Freeze frame FRF_CUS_SET_SPC: environmental data contents for failure XX" CURVE 0xa080357c _REC_CUR_20_u1_u1 254. _CNV_A_R_LINEAR_____0_CM 1. 255. DISPLAY_IDENTIFIER ID_ERR_ENVD_ECFPWM_FB_1 FORMAT "%3.0"
 /begin AXIS_DESCR COM_AXIS errm_online_dummy _CNV_A_R_LINEAR_____0_CM 4 0. 255. FORMAT "%3.0" AXIS_PTS_REF ldpm_fmy_envd /end AXIS_DESCR
/end CHARACTERISTIC
/begin CHARACTERISTIC fmy_id_ecfpwm_fb_2.envd "Freeze frame FRF_CUS_SET_SPC: environmental data contents for failure XX" CURVE 0xa0803590 _REC_CUR_20_u1_u1 254. _CNV_A_R_LINEAR_____0_CM 1. 255. DISPLAY_IDENTIFIER ID_ERR_ENVD_ECFPWM_FB_2 FORMAT "%3.0"
 /begin AXIS_DESCR COM_AXIS errm_online_dummy _CNV_A_R_LINEAR_____0_CM 4 0. 255. FORMAT "%3.0" AXIS_PTS_REF ldpm_fmy_envd /end AXIS_DESCR
/end CHARACTERISTIC
/begin CHARACTERISTIC fmy_id_th.envd "Freeze frame FRF_CUS_SET_SPC: environmental data contents for failure XX" CURVE 0xa08049f4 _REC_CUR_20_u1_u1 254. _CNV_A_R_LINEAR_____0_CM 1. 255. DISPLAY_IDENTIFIER ID_ERR_ENVD_TH FORMAT "%3.0"
 /begin AXIS_DESCR COM_AXIS errm_online_dummy _CNV_A_R_LINEAR_____0_CM 4 0. 255. FORMAT "%3.0" AXIS_PTS_REF ldpm_fmy_envd /end AXIS_DESCR
/end CHARACTERISTIC
/begin CHARACTERISTIC fmy_id_ftl_min.envd "Freeze frame FRF_CUS_SET_SPC: environmental data contents for failure XX" CURVE 0xa08037e8 _REC_CUR_20_u1_u1 254. _CNV_A_R_LINEAR_____0_CM 1. 255. DISPLAY_IDENTIFIER ID_ERR_ENVD_FTL_MIN FORMAT "%3.0"
 /begin AXIS_DESCR COM_AXIS errm_online_dummy _CNV_A_R_LINEAR_____0_CM 4 0. 255. FORMAT "%3.0" AXIS_PTS_REF ldpm_fmy_envd /end AXIS_DESCR
/end CHARACTERISTIC
/begin CHARACTERISTIC fmy_id_tia_el_1.envd "Freeze frame FRF_CUS_SET_SPC: environmental data contents for failure XX" CURVE 0xa0804a08 _REC_CUR_20_u1_u1 254. _CNV_A_R_LINEAR_____0_CM 1. 255. DISPLAY_IDENTIFIER ID_ERR_ENVD_TIA_EL_1 FORMAT "%3.0"
 /begin AXIS_DESCR COM_AXIS errm_online_dummy _CNV_A_R_LINEAR_____0_CM 4 0. 255. FORMAT "%3.0" AXIS_PTS_REF ldpm_fmy_envd /end AXIS_DESCR
/end CHARACTERISTIC
/begin CHARACTERISTIC fmy_id_tia_el_2.envd "Freeze frame FRF_CUS_SET_SPC: environmental data contents for failure XX" CURVE 0xa0804a1c _REC_CUR_20_u1_u1 254. _CNV_A_R_LINEAR_____0_CM 1. 255. DISPLAY_IDENTIFIER ID_ERR_ENVD_TIA_EL_2 FORMAT "%3.0"
 /begin AXIS_DESCR COM_AXIS errm_online_dummy _CNV_A_R_LINEAR_____0_CM 4 0. 255. FORMAT "%3.0" AXIS_PTS_REF ldpm_fmy_envd /end AXIS_DESCR
/end CHARACTERISTIC
/begin CHARACTERISTIC fmy_id_tia_thr_el_1.envd "Freeze frame FRF_CUS_SET_SPC: environmental data contents for failure XX" CURVE 0xa0804a44 _REC_CUR_20_u1_u1 254. _CNV_A_R_LINEAR_____0_CM 1. 255. DISPLAY_IDENTIFIER ID_ERR_ENVD_TIA_THR_EL_1 FORMAT "%3.0"
 /begin AXIS_DESCR COM_AXIS errm_online_dummy _CNV_A_R_LINEAR_____0_CM 4 0. 255. FORMAT "%3.0" AXIS_PTS_REF ldpm_fmy_envd /end AXIS_DESCR
/end CHARACTERISTIC
/begin CHARACTERISTIC fmy_id_tia_thr_el_2.envd "Freeze frame FRF_CUS_SET_SPC: environmental data contents for failure XX" CURVE 0xa0804a58 _REC_CUR_20_u1_u1 254. _CNV_A_R_LINEAR_____0_CM 1. 255. DISPLAY_IDENTIFIER ID_ERR_ENVD_TIA_THR_EL_2 FORMAT "%3.0"
 /begin AXIS_DESCR COM_AXIS errm_online_dummy _CNV_A_R_LINEAR_____0_CM 4 0. 255. FORMAT "%3.0" AXIS_PTS_REF ldpm_fmy_envd /end AXIS_DESCR
/end CHARACTERISTIC
/begin CHARACTERISTIC fmy_id_amp.envd "Freeze frame FRF_CUS_SET_SPC: environmental data contents for failure XX" CURVE 0xa0802a14 _REC_CUR_20_u1_u1 254. _CNV_A_R_LINEAR_____0_CM 1. 255. DISPLAY_IDENTIFIER ID_ERR_ENVD_AMP FORMAT "%3.0"
 /begin AXIS_DESCR COM_AXIS errm_online_dummy _CNV_A_R_LINEAR_____0_CM 4 0. 255. FORMAT "%3.0" AXIS_PTS_REF ldpm_fmy_envd /end AXIS_DESCR
/end CHARACTERISTIC
/begin CHARACTERISTIC fmy_id_amp_plaus.envd "Freeze frame FRF_CUS_SET_SPC: environmental data contents for failure XX" CURVE 0xa0802a28 _REC_CUR_20_u1_u1 254. _CNV_A_R_LINEAR_____0_CM 1. 255. DISPLAY_IDENTIFIER ID_ERR_ENVD_AMP_PLAUS FORMAT "%3.0"
 /begin AXIS_DESCR COM_AXIS errm_online_dummy _CNV_A_R_LINEAR_____0_CM 4 0. 255. FORMAT "%3.0" AXIS_PTS_REF ldpm_fmy_envd /end AXIS_DESCR
/end CHARACTERISTIC
/begin CHARACTERISTIC fmy_id_maf.envd "Freeze frame FRF_CUS_SET_SPC: environmental data contents for failure XX" CURVE 0xa0803e64 _REC_CUR_20_u1_u1 254. _CNV_A_R_LINEAR_____0_CM 1. 255. DISPLAY_IDENTIFIER ID_ERR_ENVD_MAF FORMAT "%3.0"
 /begin AXIS_DESCR COM_AXIS errm_online_dummy _CNV_A_R_LINEAR_____0_CM 4 0. 255. FORMAT "%3.0" AXIS_PTS_REF ldpm_fmy_envd /end AXIS_DESCR
/end CHARACTERISTIC
/begin CHARACTERISTIC fmy_id_el_cps.envd "Freeze frame FRF_CUS_SET_SPC: environmental data contents for failure XX" CURVE 0xa0803680 _REC_CUR_20_u1_u1 254. _CNV_A_R_LINEAR_____0_CM 1. 255. DISPLAY_IDENTIFIER ID_ERR_ENVD_EL_CPS FORMAT "%3.0"
 /begin AXIS_DESCR COM_AXIS errm_online_dummy _CNV_A_R_LINEAR_____0_CM 4 0. 255. FORMAT "%3.0" AXIS_PTS_REF ldpm_fmy_envd /end AXIS_DESCR
/end CHARACTERISTIC
/begin CHARACTERISTIC fmy_id_slv_ivvt_in_1.envd "Freeze frame FRF_CUS_SET_SPC: environmental data contents for failure XX" CURVE 0xa08046fc _REC_CUR_20_u1_u1 254. _CNV_A_R_LINEAR_____0_CM 1. 255. DISPLAY_IDENTIFIER ID_ERR_ENVD_SLV_IVVT_IN_1 FORMAT "%3.0"
 /begin AXIS_DESCR COM_AXIS errm_online_dummy _CNV_A_R_LINEAR_____0_CM 4 0. 255. FORMAT "%3.0" AXIS_PTS_REF ldpm_fmy_envd /end AXIS_DESCR
/end CHARACTERISTIC
/begin CHARACTERISTIC fmy_id_slv_ivvt_in_2.envd "Freeze frame FRF_CUS_SET_SPC: environmental data contents for failure XX" CURVE 0xa0804710 _REC_CUR_20_u1_u1 254. _CNV_A_R_LINEAR_____0_CM 1. 255. DISPLAY_IDENTIFIER ID_ERR_ENVD_SLV_IVVT_IN_2 FORMAT "%3.0"
 /begin AXIS_DESCR COM_AXIS errm_online_dummy _CNV_A_R_LINEAR_____0_CM 4 0. 255. FORMAT "%3.0" AXIS_PTS_REF ldpm_fmy_envd /end AXIS_DESCR
/end CHARACTERISTIC
/begin CHARACTERISTIC fmy_id_slv_ivvt_ex_1.envd "Freeze frame FRF_CUS_SET_SPC: environmental data contents for failure XX" CURVE 0xa08046c0 _REC_CUR_20_u1_u1 254. _CNV_A_R_LINEAR_____0_CM 1. 255. DISPLAY_IDENTIFIER ID_ERR_ENVD_SLV_IVVT_EX_1 FORMAT "%3.0"
 /begin AXIS_DESCR COM_AXIS errm_online_dummy _CNV_A_R_LINEAR_____0_CM 4 0. 255. FORMAT "%3.0" AXIS_PTS_REF ldpm_fmy_envd /end AXIS_DESCR
/end CHARACTERISTIC
/begin CHARACTERISTIC fmy_id_slv_ivvt_ex_2.envd "Freeze frame FRF_CUS_SET_SPC: environmental data contents for failure XX" CURVE 0xa08046d4 _REC_CUR_20_u1_u1 254. _CNV_A_R_LINEAR_____0_CM 1. 255. DISPLAY_IDENTIFIER ID_ERR_ENVD_SLV_IVVT_EX_2 FORMAT "%3.0"
 /begin AXIS_DESCR COM_AXIS errm_online_dummy _CNV_A_R_LINEAR_____0_CM 4 0. 255. FORMAT "%3.0" AXIS_PTS_REF ldpm_fmy_envd /end AXIS_DESCR
/end CHARACTERISTIC
/begin CHARACTERISTIC fmy_id_ecu_cks.envd "Freeze frame FRF_CUS_SET_SPC: environmental data contents for failure XX" CURVE 0xa0803608 _REC_CUR_20_u1_u1 254. _CNV_A_R_LINEAR_____0_CM 1. 255. DISPLAY_IDENTIFIER ID_ERR_ENVD_ECU_CKS FORMAT "%3.0"
 /begin AXIS_DESCR COM_AXIS errm_online_dummy _CNV_A_R_LINEAR_____0_CM 4 0. 255. FORMAT "%3.0" AXIS_PTS_REF ldpm_fmy_envd /end AXIS_DESCR
/end CHARACTERISTIC
/begin CHARACTERISTIC fmy_id_vs.envd "Freeze frame FRF_CUS_SET_SPC: environmental data contents for failure XX" CURVE 0xa0804db4 _REC_CUR_20_u1_u1 254. _CNV_A_R_LINEAR_____0_CM 1. 255. DISPLAY_IDENTIFIER ID_ERR_ENVD_VS FORMAT "%3.0"
 /begin AXIS_DESCR COM_AXIS errm_online_dummy _CNV_A_R_LINEAR_____0_CM 4 0. 255. FORMAT "%3.0" AXIS_PTS_REF ldpm_fmy_envd /end AXIS_DESCR
/end CHARACTERISTIC
/begin CHARACTERISTIC fmy_id_knks_1.envd "Freeze frame FRF_CUS_SET_SPC: environmental data contents for failure XX" CURVE 0xa0803d24 _REC_CUR_20_u1_u1 254. _CNV_A_R_LINEAR_____0_CM 1. 255. DISPLAY_IDENTIFIER ID_ERR_ENVD_KNKS_1 FORMAT "%3.0"
 /begin AXIS_DESCR COM_AXIS errm_online_dummy _CNV_A_R_LINEAR_____0_CM 4 0. 255. FORMAT "%3.0" AXIS_PTS_REF ldpm_fmy_envd /end AXIS_DESCR
/end CHARACTERISTIC
/begin CHARACTERISTIC fmy_id_knks_2.envd "Freeze frame FRF_CUS_SET_SPC: environmental data contents for failure XX" CURVE 0xa0803d38 _REC_CUR_20_u1_u1 254. _CNV_A_R_LINEAR_____0_CM 1. 255. DISPLAY_IDENTIFIER ID_ERR_ENVD_KNKS_2 FORMAT "%3.0"
 /begin AXIS_DESCR COM_AXIS errm_online_dummy _CNV_A_R_LINEAR_____0_CM 4 0. 255. FORMAT "%3.0" AXIS_PTS_REF ldpm_fmy_envd /end AXIS_DESCR
/end CHARACTERISTIC
/begin CHARACTERISTIC fmy_id_knks_3.envd "Freeze frame FRF_CUS_SET_SPC: environmental data contents for failure XX" CURVE 0xa0803d4c _REC_CUR_20_u1_u1 254. _CNV_A_R_LINEAR_____0_CM 1. 255. DISPLAY_IDENTIFIER ID_ERR_ENVD_KNKS_3 FORMAT "%3.0"
 /begin AXIS_DESCR COM_AXIS errm_online_dummy _CNV_A_R_LINEAR_____0_CM 4 0. 255. FORMAT "%3.0" AXIS_PTS_REF ldpm_fmy_envd /end AXIS_DESCR
/end CHARACTERISTIC
/begin CHARACTERISTIC fmy_id_knks_4.envd "Freeze frame FRF_CUS_SET_SPC: environmental data contents for failure XX" CURVE 0xa0803d60 _REC_CUR_20_u1_u1 254. _CNV_A_R_LINEAR_____0_CM 1. 255. DISPLAY_IDENTIFIER ID_ERR_ENVD_KNKS_4 FORMAT "%3.0"
 /begin AXIS_DESCR COM_AXIS errm_online_dummy _CNV_A_R_LINEAR_____0_CM 4 0. 255. FORMAT "%3.0" AXIS_PTS_REF ldpm_fmy_envd /end AXIS_DESCR
/end CHARACTERISTIC
/begin CHARACTERISTIC fmy_id_rfp_dr_1.envd "Freeze frame FRF_CUS_SET_SPC: environmental data contents for failure XX" CURVE 0xa0804508 _REC_CUR_20_u1_u1 254. _CNV_A_R_LINEAR_____0_CM 1. 255. DISPLAY_IDENTIFIER ID_ERR_ENVD_RFP_DR_1 FORMAT "%3.0"
 /begin AXIS_DESCR COM_AXIS errm_online_dummy _CNV_A_R_LINEAR_____0_CM 4 0. 255. FORMAT "%3.0" AXIS_PTS_REF ldpm_fmy_envd /end AXIS_DESCR
/end CHARACTERISTIC
/begin CHARACTERISTIC fmy_id_rfp_dr_2.envd "Freeze frame FRF_CUS_SET_SPC: environmental data contents for failure XX" CURVE 0xa080451c _REC_CUR_20_u1_u1 254. _CNV_A_R_LINEAR_____0_CM 1. 255. DISPLAY_IDENTIFIER ID_ERR_ENVD_RFP_DR_2 FORMAT "%3.0"
 /begin AXIS_DESCR COM_AXIS errm_online_dummy _CNV_A_R_LINEAR_____0_CM 4 0. 255. FORMAT "%3.0" AXIS_PTS_REF ldpm_fmy_envd /end AXIS_DESCR
/end CHARACTERISTIC
/begin CHARACTERISTIC fmy_id_wg_1_dr.envd "Freeze frame FRF_CUS_SET_SPC: environmental data contents for failure XX" CURVE 0xa0804e04 _REC_CUR_20_u1_u1 254. _CNV_A_R_LINEAR_____0_CM 1. 255. DISPLAY_IDENTIFIER ID_ERR_ENVD_WG_1_DR FORMAT "%3.0"
 /begin AXIS_DESCR COM_AXIS errm_online_dummy _CNV_A_R_LINEAR_____0_CM 4 0. 255. FORMAT "%3.0" AXIS_PTS_REF ldpm_fmy_envd /end AXIS_DESCR
/end CHARACTERISTIC
/begin CHARACTERISTIC fmy_id_wg_2_dr.envd "Freeze frame FRF_CUS_SET_SPC: environmental data contents for failure XX" CURVE 0xa0804e18 _REC_CUR_20_u1_u1 254. _CNV_A_R_LINEAR_____0_CM 1. 255. DISPLAY_IDENTIFIER ID_ERR_ENVD_WG_2_DR FORMAT "%3.0"
 /begin AXIS_DESCR COM_AXIS errm_online_dummy _CNV_A_R_LINEAR_____0_CM 4 0. 255. FORMAT "%3.0" AXIS_PTS_REF ldpm_fmy_envd /end AXIS_DESCR
/end CHARACTERISTIC
/begin CHARACTERISTIC fmy_id_put_el_1.envd "Freeze frame FRF_CUS_SET_SPC: environmental data contents for failure XX" CURVE 0xa08043dc _REC_CUR_20_u1_u1 254. _CNV_A_R_LINEAR_____0_CM 1. 255. DISPLAY_IDENTIFIER ID_ERR_ENVD_PUT_EL_1 FORMAT "%3.0"
 /begin AXIS_DESCR COM_AXIS errm_online_dummy _CNV_A_R_LINEAR_____0_CM 4 0. 255. FORMAT "%3.0" AXIS_PTS_REF ldpm_fmy_envd /end AXIS_DESCR
/end CHARACTERISTIC
/begin CHARACTERISTIC fmy_id_put_el_2.envd "Freeze frame FRF_CUS_SET_SPC: environmental data contents for failure XX" CURVE 0xa08043f0 _REC_CUR_20_u1_u1 254. _CNV_A_R_LINEAR_____0_CM 1. 255. DISPLAY_IDENTIFIER ID_ERR_ENVD_PUT_EL_2 FORMAT "%3.0"
 /begin AXIS_DESCR COM_AXIS errm_online_dummy _CNV_A_R_LINEAR_____0_CM 4 0. 255. FORMAT "%3.0" AXIS_PTS_REF ldpm_fmy_envd /end AXIS_DESCR
/end CHARACTERISTIC
/begin CHARACTERISTIC fmy_id_igc_scp_0.envd "Freeze frame FRF_CUS_SET_SPC: environmental data contents for failure XX" CURVE 0xa0803aa4 _REC_CUR_20_u1_u1 254. _CNV_A_R_LINEAR_____0_CM 1. 255. DISPLAY_IDENTIFIER ID_ERR_ENVD_IGC_SCP_0 FORMAT "%3.0"
 /begin AXIS_DESCR COM_AXIS errm_online_dummy _CNV_A_R_LINEAR_____0_CM 4 0. 255. FORMAT "%3.0" AXIS_PTS_REF ldpm_fmy_envd /end AXIS_DESCR
/end CHARACTERISTIC
/begin CHARACTERISTIC fmy_id_igc_scp_1.envd "Freeze frame FRF_CUS_SET_SPC: environmental data contents for failure XX" CURVE 0xa0803ab8 _REC_CUR_20_u1_u1 254. _CNV_A_R_LINEAR_____0_CM 1. 255. DISPLAY_IDENTIFIER ID_ERR_ENVD_IGC_SCP_1 FORMAT "%3.0"
 /begin AXIS_DESCR COM_AXIS errm_online_dummy _CNV_A_R_LINEAR_____0_CM 4 0. 255. FORMAT "%3.0" AXIS_PTS_REF ldpm_fmy_envd /end AXIS_DESCR
/end CHARACTERISTIC
/begin CHARACTERISTIC fmy_id_igc_scp_2.envd "Freeze frame FRF_CUS_SET_SPC: environmental data contents for failure XX" CURVE 0xa0803acc _REC_CUR_20_u1_u1 254. _CNV_A_R_LINEAR_____0_CM 1. 255. DISPLAY_IDENTIFIER ID_ERR_ENVD_IGC_SCP_2 FORMAT "%3.0"
 /begin AXIS_DESCR COM_AXIS errm_online_dummy _CNV_A_R_LINEAR_____0_CM 4 0. 255. FORMAT "%3.0" AXIS_PTS_REF ldpm_fmy_envd /end AXIS_DESCR
/end CHARACTERISTIC
/begin CHARACTERISTIC fmy_id_igc_scp_3.envd "Freeze frame FRF_CUS_SET_SPC: environmental data contents for failure XX" CURVE 0xa0803ae0 _REC_CUR_20_u1_u1 254. _CNV_A_R_LINEAR_____0_CM 1. 255. DISPLAY_IDENTIFIER ID_ERR_ENVD_IGC_SCP_3 FORMAT "%3.0"
 /begin AXIS_DESCR COM_AXIS errm_online_dummy _CNV_A_R_LINEAR_____0_CM 4 0. 255. FORMAT "%3.0" AXIS_PTS_REF ldpm_fmy_envd /end AXIS_DESCR
/end CHARACTERISTIC
/begin CHARACTERISTIC fmy_id_igc_scp_4.envd "Freeze frame FRF_CUS_SET_SPC: environmental data contents for failure XX" CURVE 0xa0803af4 _REC_CUR_20_u1_u1 254. _CNV_A_R_LINEAR_____0_CM 1. 255. DISPLAY_IDENTIFIER ID_ERR_ENVD_IGC_SCP_4 FORMAT "%3.0"
 /begin AXIS_DESCR COM_AXIS errm_online_dummy _CNV_A_R_LINEAR_____0_CM 4 0. 255. FORMAT "%3.0" AXIS_PTS_REF ldpm_fmy_envd /end AXIS_DESCR
/end CHARACTERISTIC
/begin CHARACTERISTIC fmy_id_igc_scp_5.envd "Freeze frame FRF_CUS_SET_SPC: environmental data contents for failure XX" CURVE 0xa0803b08 _REC_CUR_20_u1_u1 254. _CNV_A_R_LINEAR_____0_CM 1. 255. DISPLAY_IDENTIFIER ID_ERR_ENVD_IGC_SCP_5 FORMAT "%3.0"
 /begin AXIS_DESCR COM_AXIS errm_online_dummy _CNV_A_R_LINEAR_____0_CM 4 0. 255. FORMAT "%3.0" AXIS_PTS_REF ldpm_fmy_envd /end AXIS_DESCR
/end CHARACTERISTIC
/begin CHARACTERISTIC fmy_id_igc_scp_6.envd "Freeze frame FRF_CUS_SET_SPC: environmental data contents for failure XX" CURVE 0xa0803b1c _REC_CUR_20_u1_u1 254. _CNV_A_R_LINEAR_____0_CM 1. 255. DISPLAY_IDENTIFIER ID_ERR_ENVD_IGC_SCP_6 FORMAT "%3.0"
 /begin AXIS_DESCR COM_AXIS errm_online_dummy _CNV_A_R_LINEAR_____0_CM 4 0. 255. FORMAT "%3.0" AXIS_PTS_REF ldpm_fmy_envd /end AXIS_DESCR
/end CHARACTERISTIC
/begin CHARACTERISTIC fmy_id_igc_scp_7.envd "Freeze frame FRF_CUS_SET_SPC: environmental data contents for failure XX" CURVE 0xa0803b30 _REC_CUR_20_u1_u1 254. _CNV_A_R_LINEAR_____0_CM 1. 255. DISPLAY_IDENTIFIER ID_ERR_ENVD_IGC_SCP_7 FORMAT "%3.0"
 /begin AXIS_DESCR COM_AXIS errm_online_dummy _CNV_A_R_LINEAR_____0_CM 4 0. 255. FORMAT "%3.0" AXIS_PTS_REF ldpm_fmy_envd /end AXIS_DESCR
/end CHARACTERISTIC
/begin CHARACTERISTIC fmy_id_igc_scg_0.envd "Freeze frame FRF_CUS_SET_SPC: environmental data contents for failure XX" CURVE 0xa0803a04 _REC_CUR_20_u1_u1 254. _CNV_A_R_LINEAR_____0_CM 1. 255. DISPLAY_IDENTIFIER ID_ERR_ENVD_IGC_SCG_0 FORMAT "%3.0"
 /begin AXIS_DESCR COM_AXIS errm_online_dummy _CNV_A_R_LINEAR_____0_CM 4 0. 255. FORMAT "%3.0" AXIS_PTS_REF ldpm_fmy_envd /end AXIS_DESCR
/end CHARACTERISTIC
/begin CHARACTERISTIC fmy_id_igc_scg_1.envd "Freeze frame FRF_CUS_SET_SPC: environmental data contents for failure XX" CURVE 0xa0803a18 _REC_CUR_20_u1_u1 254. _CNV_A_R_LINEAR_____0_CM 1. 255. DISPLAY_IDENTIFIER ID_ERR_ENVD_IGC_SCG_1 FORMAT "%3.0"
 /begin AXIS_DESCR COM_AXIS errm_online_dummy _CNV_A_R_LINEAR_____0_CM 4 0. 255. FORMAT "%3.0" AXIS_PTS_REF ldpm_fmy_envd /end AXIS_DESCR
/end CHARACTERISTIC
/begin CHARACTERISTIC fmy_id_igc_scg_2.envd "Freeze frame FRF_CUS_SET_SPC: environmental data contents for failure XX" CURVE 0xa0803a2c _REC_CUR_20_u1_u1 254. _CNV_A_R_LINEAR_____0_CM 1. 255. DISPLAY_IDENTIFIER ID_ERR_ENVD_IGC_SCG_2 FORMAT "%3.0"
 /begin AXIS_DESCR COM_AXIS errm_online_dummy _CNV_A_R_LINEAR_____0_CM 4 0. 255. FORMAT "%3.0" AXIS_PTS_REF ldpm_fmy_envd /end AXIS_DESCR
/end CHARACTERISTIC
/begin CHARACTERISTIC fmy_id_igc_scg_3.envd "Freeze frame FRF_CUS_SET_SPC: environmental data contents for failure XX" CURVE 0xa0803a40 _REC_CUR_20_u1_u1 254. _CNV_A_R_LINEAR_____0_CM 1. 255. DISPLAY_IDENTIFIER ID_ERR_ENVD_IGC_SCG_3 FORMAT "%3.0"
 /begin AXIS_DESCR COM_AXIS errm_online_dummy _CNV_A_R_LINEAR_____0_CM 4 0. 255. FORMAT "%3.0" AXIS_PTS_REF ldpm_fmy_envd /end AXIS_DESCR
/end CHARACTERISTIC
/begin CHARACTERISTIC fmy_id_igc_scg_4.envd "Freeze frame FRF_CUS_SET_SPC: environmental data contents for failure XX" CURVE 0xa0803a54 _REC_CUR_20_u1_u1 254. _CNV_A_R_LINEAR_____0_CM 1. 255. DISPLAY_IDENTIFIER ID_ERR_ENVD_IGC_SCG_4 FORMAT "%3.0"
 /begin AXIS_DESCR COM_AXIS errm_online_dummy _CNV_A_R_LINEAR_____0_CM 4 0. 255. FORMAT "%3.0" AXIS_PTS_REF ldpm_fmy_envd /end AXIS_DESCR
/end CHARACTERISTIC
/begin CHARACTERISTIC fmy_id_igc_scg_5.envd "Freeze frame FRF_CUS_SET_SPC: environmental data contents for failure XX" CURVE 0xa0803a68 _REC_CUR_20_u1_u1 254. _CNV_A_R_LINEAR_____0_CM 1. 255. DISPLAY_IDENTIFIER ID_ERR_ENVD_IGC_SCG_5 FORMAT "%3.0"
 /begin AXIS_DESCR COM_AXIS errm_online_dummy _CNV_A_R_LINEAR_____0_CM 4 0. 255. FORMAT "%3.0" AXIS_PTS_REF ldpm_fmy_envd /end AXIS_DESCR
/end CHARACTERISTIC
/begin CHARACTERISTIC fmy_id_igc_scg_6.envd "Freeze frame FRF_CUS_SET_SPC: environmental data contents for failure XX" CURVE 0xa0803a7c _REC_CUR_20_u1_u1 254. _CNV_A_R_LINEAR_____0_CM 1. 255. DISPLAY_IDENTIFIER ID_ERR_ENVD_IGC_SCG_6 FORMAT "%3.0"
 /begin AXIS_DESCR COM_AXIS errm_online_dummy _CNV_A_R_LINEAR_____0_CM 4 0. 255. FORMAT "%3.0" AXIS_PTS_REF ldpm_fmy_envd /end AXIS_DESCR
/end CHARACTERISTIC
/begin CHARACTERISTIC fmy_id_igc_scg_7.envd "Freeze frame FRF_CUS_SET_SPC: environmental data contents for failure XX" CURVE 0xa0803a90 _REC_CUR_20_u1_u1 254. _CNV_A_R_LINEAR_____0_CM 1. 255. DISPLAY_IDENTIFIER ID_ERR_ENVD_IGC_SCG_7 FORMAT "%3.0"
 /begin AXIS_DESCR COM_AXIS errm_online_dummy _CNV_A_R_LINEAR_____0_CM 4 0. 255. FORMAT "%3.0" AXIS_PTS_REF ldpm_fmy_envd /end AXIS_DESCR
/end CHARACTERISTIC
/begin CHARACTERISTIC fmy_id_igc_ol_0.envd "Freeze frame FRF_CUS_SET_SPC: environmental data contents for failure XX" CURVE 0xa0803964 _REC_CUR_20_u1_u1 254. _CNV_A_R_LINEAR_____0_CM 1. 255. DISPLAY_IDENTIFIER ID_ERR_ENVD_IGC_OL_0 FORMAT "%3.0"
 /begin AXIS_DESCR COM_AXIS errm_online_dummy _CNV_A_R_LINEAR_____0_CM 4 0. 255. FORMAT "%3.0" AXIS_PTS_REF ldpm_fmy_envd /end AXIS_DESCR
/end CHARACTERISTIC
/begin CHARACTERISTIC fmy_id_igc_ol_1.envd "Freeze frame FRF_CUS_SET_SPC: environmental data contents for failure XX" CURVE 0xa0803978 _REC_CUR_20_u1_u1 254. _CNV_A_R_LINEAR_____0_CM 1. 255. DISPLAY_IDENTIFIER ID_ERR_ENVD_IGC_OL_1 FORMAT "%3.0"
 /begin AXIS_DESCR COM_AXIS errm_online_dummy _CNV_A_R_LINEAR_____0_CM 4 0. 255. FORMAT "%3.0" AXIS_PTS_REF ldpm_fmy_envd /end AXIS_DESCR
/end CHARACTERISTIC
/begin CHARACTERISTIC fmy_id_igc_ol_2.envd "Freeze frame FRF_CUS_SET_SPC: environmental data contents for failure XX" CURVE 0xa080398c _REC_CUR_20_u1_u1 254. _CNV_A_R_LINEAR_____0_CM 1. 255. DISPLAY_IDENTIFIER ID_ERR_ENVD_IGC_OL_2 FORMAT "%3.0"
 /begin AXIS_DESCR COM_AXIS errm_online_dummy _CNV_A_R_LINEAR_____0_CM 4 0. 255. FORMAT "%3.0" AXIS_PTS_REF ldpm_fmy_envd /end AXIS_DESCR
/end CHARACTERISTIC
/begin CHARACTERISTIC fmy_id_igc_ol_3.envd "Freeze frame FRF_CUS_SET_SPC: environmental data contents for failure XX" CURVE 0xa08039a0 _REC_CUR_20_u1_u1 254. _CNV_A_R_LINEAR_____0_CM 1. 255. DISPLAY_IDENTIFIER ID_ERR_ENVD_IGC_OL_3 FORMAT "%3.0"
 /begin AXIS_DESCR COM_AXIS errm_online_dummy _CNV_A_R_LINEAR_____0_CM 4 0. 255. FORMAT "%3.0" AXIS_PTS_REF ldpm_fmy_envd /end AXIS_DESCR
/end CHARACTERISTIC
/begin CHARACTERISTIC fmy_id_igc_ol_4.envd "Freeze frame FRF_CUS_SET_SPC: environmental data contents for failure XX" CURVE 0xa08039b4 _REC_CUR_20_u1_u1 254. _CNV_A_R_LINEAR_____0_CM 1. 255. DISPLAY_IDENTIFIER ID_ERR_ENVD_IGC_OL_4 FORMAT "%3.0"
 /begin AXIS_DESCR COM_AXIS errm_online_dummy _CNV_A_R_LINEAR_____0_CM 4 0. 255. FORMAT "%3.0" AXIS_PTS_REF ldpm_fmy_envd /end AXIS_DESCR
/end CHARACTERISTIC
/begin CHARACTERISTIC fmy_id_igc_ol_5.envd "Freeze frame FRF_CUS_SET_SPC: environmental data contents for failure XX" CURVE 0xa08039c8 _REC_CUR_20_u1_u1 254. _CNV_A_R_LINEAR_____0_CM 1. 255. DISPLAY_IDENTIFIER ID_ERR_ENVD_IGC_OL_5 FORMAT "%3.0"
 /begin AXIS_DESCR COM_AXIS errm_online_dummy _CNV_A_R_LINEAR_____0_CM 4 0. 255. FORMAT "%3.0" AXIS_PTS_REF ldpm_fmy_envd /end AXIS_DESCR
/end CHARACTERISTIC
/begin CHARACTERISTIC fmy_id_igc_ol_6.envd "Freeze frame FRF_CUS_SET_SPC: environmental data contents for failure XX" CURVE 0xa08039dc _REC_CUR_20_u1_u1 254. _CNV_A_R_LINEAR_____0_CM 1. 255. DISPLAY_IDENTIFIER ID_ERR_ENVD_IGC_OL_6 FORMAT "%3.0"
 /begin AXIS_DESCR COM_AXIS errm_online_dummy _CNV_A_R_LINEAR_____0_CM 4 0. 255. FORMAT "%3.0" AXIS_PTS_REF ldpm_fmy_envd /end AXIS_DESCR
/end CHARACTERISTIC
/begin CHARACTERISTIC fmy_id_igc_ol_7.envd "Freeze frame FRF_CUS_SET_SPC: environmental data contents for failure XX" CURVE 0xa08039f0 _REC_CUR_20_u1_u1 254. _CNV_A_R_LINEAR_____0_CM 1. 255. DISPLAY_IDENTIFIER ID_ERR_ENVD_IGC_OL_7 FORMAT "%3.0"
 /begin AXIS_DESCR COM_AXIS errm_online_dummy _CNV_A_R_LINEAR_____0_CM 4 0. 255. FORMAT "%3.0" AXIS_PTS_REF ldpm_fmy_envd /end AXIS_DESCR
/end CHARACTERISTIC
/begin CHARACTERISTIC fmy_id_dur_igc_mpl.envd "Freeze frame FRF_CUS_SET_SPC: environmental data contents for failure XX" CURVE 0xa0803504 _REC_CUR_20_u1_u1 254. _CNV_A_R_LINEAR_____0_CM 1. 255. DISPLAY_IDENTIFIER ID_ERR_ENVD_DUR_IGC_MPL FORMAT "%3.0"
 /begin AXIS_DESCR COM_AXIS errm_online_dummy _CNV_A_R_LINEAR_____0_CM 4 0. 255. FORMAT "%3.0" AXIS_PTS_REF ldpm_fmy_envd /end AXIS_DESCR
/end CHARACTERISTIC
/begin CHARACTERISTIC fmy_id_v_ref_1.envd "Freeze frame FRF_CUS_SET_SPC: environmental data contents for failure XX" CURVE 0xa0804d14 _REC_CUR_20_u1_u1 254. _CNV_A_R_LINEAR_____0_CM 1. 255. DISPLAY_IDENTIFIER ID_ERR_ENVD_V_REF_1 FORMAT "%3.0"
 /begin AXIS_DESCR COM_AXIS errm_online_dummy _CNV_A_R_LINEAR_____0_CM 4 0. 255. FORMAT "%3.0" AXIS_PTS_REF ldpm_fmy_envd /end AXIS_DESCR
/end CHARACTERISTIC
/begin CHARACTERISTIC fmy_id_v_ref_2.envd "Freeze frame FRF_CUS_SET_SPC: environmental data contents for failure XX" CURVE 0xa0804d28 _REC_CUR_20_u1_u1 254. _CNV_A_R_LINEAR_____0_CM 1. 255. DISPLAY_IDENTIFIER ID_ERR_ENVD_V_REF_2 FORMAT "%3.0"
 /begin AXIS_DESCR COM_AXIS errm_online_dummy _CNV_A_R_LINEAR_____0_CM 4 0. 255. FORMAT "%3.0" AXIS_PTS_REF ldpm_fmy_envd /end AXIS_DESCR
/end CHARACTERISTIC
/begin CHARACTERISTIC fmy_id_pvs_1.envd "Freeze frame FRF_CUS_SET_SPC: environmental data contents for failure XX" CURVE 0xa0804418 _REC_CUR_20_u1_u1 254. _CNV_A_R_LINEAR_____0_CM 1. 255. DISPLAY_IDENTIFIER ID_ERR_ENVD_PVS_1 FORMAT "%3.0"
 /begin AXIS_DESCR COM_AXIS errm_online_dummy _CNV_A_R_LINEAR_____0_CM 4 0. 255. FORMAT "%3.0" AXIS_PTS_REF ldpm_fmy_envd /end AXIS_DESCR
/end CHARACTERISTIC
/begin CHARACTERISTIC fmy_id_pvs_2.envd "Freeze frame FRF_CUS_SET_SPC: environmental data contents for failure XX" CURVE 0xa080442c _REC_CUR_20_u1_u1 254. _CNV_A_R_LINEAR_____0_CM 1. 255. DISPLAY_IDENTIFIER ID_ERR_ENVD_PVS_2 FORMAT "%3.0"
 /begin AXIS_DESCR COM_AXIS errm_online_dummy _CNV_A_R_LINEAR_____0_CM 4 0. 255. FORMAT "%3.0" AXIS_PTS_REF ldpm_fmy_envd /end AXIS_DESCR
/end CHARACTERISTIC
/begin CHARACTERISTIC fmy_id_pvs_ratio.envd "Freeze frame FRF_CUS_SET_SPC: environmental data contents for failure XX" CURVE 0xa080447c _REC_CUR_20_u1_u1 254. _CNV_A_R_LINEAR_____0_CM 1. 255. DISPLAY_IDENTIFIER ID_ERR_ENVD_PVS_RATIO FORMAT "%3.0"
 /begin AXIS_DESCR COM_AXIS errm_online_dummy _CNV_A_R_LINEAR_____0_CM 4 0. 255. FORMAT "%3.0" AXIS_PTS_REF ldpm_fmy_envd /end AXIS_DESCR
/end CHARACTERISTIC
/begin CHARACTERISTIC fmy_id_pvs_double.envd "Freeze frame FRF_CUS_SET_SPC: environmental data contents for failure XX" CURVE 0xa0804454 _REC_CUR_20_u1_u1 254. _CNV_A_R_LINEAR_____0_CM 1. 255. DISPLAY_IDENTIFIER ID_ERR_ENVD_PVS_DOUBLE FORMAT "%3.0"
 /begin AXIS_DESCR COM_AXIS errm_online_dummy _CNV_A_R_LINEAR_____0_CM 4 0. 255. FORMAT "%3.0" AXIS_PTS_REF ldpm_fmy_envd /end AXIS_DESCR
/end CHARACTERISTIC
/begin CHARACTERISTIC fmy_id_pvs_bls_not_plaus.envd "Freeze frame FRF_CUS_SET_SPC: environmental data contents for failure XX" CURVE 0xa0804440 _REC_CUR_20_u1_u1 254. _CNV_A_R_LINEAR_____0_CM 1. 255. DISPLAY_IDENTIFIER ID_ERR_ENVD_PVS_BLS_NOT_PLAUS FORMAT "%3.0"
 /begin AXIS_DESCR COM_AXIS errm_online_dummy _CNV_A_R_LINEAR_____0_CM 4 0. 255. FORMAT "%3.0" AXIS_PTS_REF ldpm_fmy_envd /end AXIS_DESCR
/end CHARACTERISTIC
/begin CHARACTERISTIC fmy_id_mtc_ctl_1.envd "Freeze frame FRF_CUS_SET_SPC: environmental data contents for failure XX" CURVE 0xa08040d0 _REC_CUR_20_u1_u1 254. _CNV_A_R_LINEAR_____0_CM 1. 255. DISPLAY_IDENTIFIER ID_ERR_ENVD_MTC_CTL_1 FORMAT "%3.0"
 /begin AXIS_DESCR COM_AXIS errm_online_dummy _CNV_A_R_LINEAR_____0_CM 4 0. 255. FORMAT "%3.0" AXIS_PTS_REF ldpm_fmy_envd /end AXIS_DESCR
/end CHARACTERISTIC
/begin CHARACTERISTIC fmy_id_gen.envd "Freeze frame FRF_CUS_SET_SPC: environmental data contents for failure XX" CURVE 0xa0803874 _REC_CUR_20_u1_u1 254. _CNV_A_R_LINEAR_____0_CM 1. 255. DISPLAY_IDENTIFIER ID_ERR_ENVD_GEN FORMAT "%3.0"
 /begin AXIS_DESCR COM_AXIS errm_online_dummy _CNV_A_R_LINEAR_____0_CM 4 0. 255. FORMAT "%3.0" AXIS_PTS_REF ldpm_fmy_envd /end AXIS_DESCR
/end CHARACTERISTIC
/begin CHARACTERISTIC fmy_id_gen_diag.envd "Freeze frame FRF_CUS_SET_SPC: environmental data contents for failure XX" CURVE 0xa08038b0 _REC_CUR_20_u1_u1 254. _CNV_A_R_LINEAR_____0_CM 1. 255. DISPLAY_IDENTIFIER ID_ERR_ENVD_GEN_DIAG FORMAT "%3.0"
 /begin AXIS_DESCR COM_AXIS errm_online_dummy _CNV_A_R_LINEAR_____0_CM 4 0. 255. FORMAT "%3.0" AXIS_PTS_REF ldpm_fmy_envd /end AXIS_DESCR
/end CHARACTERISTIC
/begin CHARACTERISTIC fmy_id_alter_bn.envd "Freeze frame FRF_CUS_SET_SPC: environmental data contents for failure XX" CURVE 0xa08029c4 _REC_CUR_20_u1_u1 254. _CNV_A_R_LINEAR_____0_CM 1. 255. DISPLAY_IDENTIFIER ID_ERR_ENVD_ALTER_BN FORMAT "%3.0"
 /begin AXIS_DESCR COM_AXIS errm_online_dummy _CNV_A_R_LINEAR_____0_CM 4 0. 255. FORMAT "%3.0" AXIS_PTS_REF ldpm_fmy_envd /end AXIS_DESCR
/end CHARACTERISTIC
/begin CHARACTERISTIC fmy_id_alter_bn_bat.envd "Freeze frame FRF_CUS_SET_SPC: environmental data contents for failure XX" CURVE 0xa08029d8 _REC_CUR_20_u1_u1 254. _CNV_A_R_LINEAR_____0_CM 1. 255. DISPLAY_IDENTIFIER ID_ERR_ENVD_ALTER_BN_BAT FORMAT "%3.0"
 /begin AXIS_DESCR COM_AXIS errm_online_dummy _CNV_A_R_LINEAR_____0_CM 4 0. 255. FORMAT "%3.0" AXIS_PTS_REF ldpm_fmy_envd /end AXIS_DESCR
/end CHARACTERISTIC
/begin CHARACTERISTIC fmy_id_t_es.envd "Freeze frame FRF_CUS_SET_SPC: environmental data contents for failure XX" CURVE 0xa0804864 _REC_CUR_20_u1_u1 254. _CNV_A_R_LINEAR_____0_CM 1. 255. DISPLAY_IDENTIFIER ID_ERR_ENVD_T_ES FORMAT "%3.0"
 /begin AXIS_DESCR COM_AXIS errm_online_dummy _CNV_A_R_LINEAR_____0_CM 4 0. 255. FORMAT "%3.0" AXIS_PTS_REF ldpm_fmy_envd /end AXIS_DESCR
/end CHARACTERISTIC
/begin CHARACTERISTIC fmy_id_map_dip_plaus.envd "Freeze frame FRF_CUS_SET_SPC: environmental data contents for failure XX" CURVE 0xa0803ef0 _REC_CUR_20_u1_u1 254. _CNV_A_R_LINEAR_____0_CM 1. 255. DISPLAY_IDENTIFIER ID_ERR_ENVD_MAP_DIP_PLAUS FORMAT "%3.0"
 /begin AXIS_DESCR COM_AXIS errm_online_dummy _CNV_A_R_LINEAR_____0_CM 4 0. 255. FORMAT "%3.0" AXIS_PTS_REF ldpm_fmy_envd /end AXIS_DESCR
/end CHARACTERISTIC
/begin CHARACTERISTIC fmy_id_toil_level.envd "Freeze frame FRF_CUS_SET_SPC: environmental data contents for failure XX" CURVE 0xa0804a6c _REC_CUR_20_u1_u1 254. _CNV_A_R_LINEAR_____0_CM 1. 255. DISPLAY_IDENTIFIER ID_ERR_ENVD_TOIL_LEVEL FORMAT "%3.0"
 /begin AXIS_DESCR COM_AXIS errm_online_dummy _CNV_A_R_LINEAR_____0_CM 4 0. 255. FORMAT "%3.0" AXIS_PTS_REF ldpm_fmy_envd /end AXIS_DESCR
/end CHARACTERISTIC
/begin CHARACTERISTIC fmy_id_alter_bn_rgn.envd "Freeze frame FRF_CUS_SET_SPC: environmental data contents for failure XX" CURVE 0xa08029ec _REC_CUR_20_u1_u1 254. _CNV_A_R_LINEAR_____0_CM 1. 255. DISPLAY_IDENTIFIER ID_ERR_ENVD_ALTER_BN_RGN FORMAT "%3.0"
 /begin AXIS_DESCR COM_AXIS errm_online_dummy _CNV_A_R_LINEAR_____0_CM 4 0. 255. FORMAT "%3.0" AXIS_PTS_REF ldpm_fmy_envd /end AXIS_DESCR
/end CHARACTERISTIC
/begin CHARACTERISTIC fmy_id_per_cam_in_1.envd "Freeze frame FRF_CUS_SET_SPC: environmental data contents for failure XX" CURVE 0xa08042b0 _REC_CUR_20_u1_u1 254. _CNV_A_R_LINEAR_____0_CM 1. 255. DISPLAY_IDENTIFIER ID_ERR_ENVD_PER_CAM_IN_1 FORMAT "%3.0"
 /begin AXIS_DESCR COM_AXIS errm_online_dummy _CNV_A_R_LINEAR_____0_CM 4 0. 255. FORMAT "%3.0" AXIS_PTS_REF ldpm_fmy_envd /end AXIS_DESCR
/end CHARACTERISTIC
/begin CHARACTERISTIC fmy_id_per_cam_ex_1.envd "Freeze frame FRF_CUS_SET_SPC: environmental data contents for failure XX" CURVE 0xa0804288 _REC_CUR_20_u1_u1 254. _CNV_A_R_LINEAR_____0_CM 1. 255. DISPLAY_IDENTIFIER ID_ERR_ENVD_PER_CAM_EX_1 FORMAT "%3.0"
 /begin AXIS_DESCR COM_AXIS errm_online_dummy _CNV_A_R_LINEAR_____0_CM 4 0. 255. FORMAT "%3.0" AXIS_PTS_REF ldpm_fmy_envd /end AXIS_DESCR
/end CHARACTERISTIC
/begin CHARACTERISTIC fmy_id_syn_cam_in_1.envd "Freeze frame FRF_CUS_SET_SPC: environmental data contents for failure XX" CURVE 0xa08047ec _REC_CUR_20_u1_u1 254. _CNV_A_R_LINEAR_____0_CM 1. 255. DISPLAY_IDENTIFIER ID_ERR_ENVD_SYN_CAM_IN_1 FORMAT "%3.0"
 /begin AXIS_DESCR COM_AXIS errm_online_dummy _CNV_A_R_LINEAR_____0_CM 4 0. 255. FORMAT "%3.0" AXIS_PTS_REF ldpm_fmy_envd /end AXIS_DESCR
/end CHARACTERISTIC
/begin CHARACTERISTIC fmy_id_syn_cam_ex_1.envd "Freeze frame FRF_CUS_SET_SPC: environmental data contents for failure XX" CURVE 0xa08047c4 _REC_CUR_20_u1_u1 254. _CNV_A_R_LINEAR_____0_CM 1. 255. DISPLAY_IDENTIFIER ID_ERR_ENVD_SYN_CAM_EX_1 FORMAT "%3.0"
 /begin AXIS_DESCR COM_AXIS errm_online_dummy _CNV_A_R_LINEAR_____0_CM 4 0. 255. FORMAT "%3.0" AXIS_PTS_REF ldpm_fmy_envd /end AXIS_DESCR
/end CHARACTERISTIC
/begin CHARACTERISTIC fmy_id_ref_crk_cam_in_1.envd "Freeze frame FRF_CUS_SET_SPC: environmental data contents for failure XX" CURVE 0xa08044e0 _REC_CUR_20_u1_u1 254. _CNV_A_R_LINEAR_____0_CM 1. 255. DISPLAY_IDENTIFIER ID_ERR_ENVD_REF_CRK_CAM_IN_1 FORMAT "%3.0"
 /begin AXIS_DESCR COM_AXIS errm_online_dummy _CNV_A_R_LINEAR_____0_CM 4 0. 255. FORMAT "%3.0" AXIS_PTS_REF ldpm_fmy_envd /end AXIS_DESCR
/end CHARACTERISTIC
/begin CHARACTERISTIC fmy_id_ref_crk_cam_ex_1.envd "Freeze frame FRF_CUS_SET_SPC: environmental data contents for failure XX" CURVE 0xa08044b8 _REC_CUR_20_u1_u1 254. _CNV_A_R_LINEAR_____0_CM 1. 255. DISPLAY_IDENTIFIER ID_ERR_ENVD_REF_CRK_CAM_EX_1 FORMAT "%3.0"
 /begin AXIS_DESCR COM_AXIS errm_online_dummy _CNV_A_R_LINEAR_____0_CM 4 0. 255. FORMAT "%3.0" AXIS_PTS_REF ldpm_fmy_envd /end AXIS_DESCR
/end CHARACTERISTIC
/begin CHARACTERISTIC fmy_id_per_cam_in_2.envd "Freeze frame FRF_CUS_SET_SPC: environmental data contents for failure XX" CURVE 0xa08042c4 _REC_CUR_20_u1_u1 254. _CNV_A_R_LINEAR_____0_CM 1. 255. DISPLAY_IDENTIFIER ID_ERR_ENVD_PER_CAM_IN_2 FORMAT "%3.0"
 /begin AXIS_DESCR COM_AXIS errm_online_dummy _CNV_A_R_LINEAR_____0_CM 4 0. 255. FORMAT "%3.0" AXIS_PTS_REF ldpm_fmy_envd /end AXIS_DESCR
/end CHARACTERISTIC
/begin CHARACTERISTIC fmy_id_per_cam_ex_2.envd "Freeze frame FRF_CUS_SET_SPC: environmental data contents for failure XX" CURVE 0xa080429c _REC_CUR_20_u1_u1 254. _CNV_A_R_LINEAR_____0_CM 1. 255. DISPLAY_IDENTIFIER ID_ERR_ENVD_PER_CAM_EX_2 FORMAT "%3.0"
 /begin AXIS_DESCR COM_AXIS errm_online_dummy _CNV_A_R_LINEAR_____0_CM 4 0. 255. FORMAT "%3.0" AXIS_PTS_REF ldpm_fmy_envd /end AXIS_DESCR
/end CHARACTERISTIC
/begin CHARACTERISTIC fmy_id_syn_cam_in_2.envd "Freeze frame FRF_CUS_SET_SPC: environmental data contents for failure XX" CURVE 0xa0804800 _REC_CUR_20_u1_u1 254. _CNV_A_R_LINEAR_____0_CM 1. 255. DISPLAY_IDENTIFIER ID_ERR_ENVD_SYN_CAM_IN_2 FORMAT "%3.0"
 /begin AXIS_DESCR COM_AXIS errm_online_dummy _CNV_A_R_LINEAR_____0_CM 4 0. 255. FORMAT "%3.0" AXIS_PTS_REF ldpm_fmy_envd /end AXIS_DESCR
/end CHARACTERISTIC
/begin CHARACTERISTIC fmy_id_syn_cam_ex_2.envd "Freeze frame FRF_CUS_SET_SPC: environmental data contents for failure XX" CURVE 0xa08047d8 _REC_CUR_20_u1_u1 254. _CNV_A_R_LINEAR_____0_CM 1. 255. DISPLAY_IDENTIFIER ID_ERR_ENVD_SYN_CAM_EX_2 FORMAT "%3.0"
 /begin AXIS_DESCR COM_AXIS errm_online_dummy _CNV_A_R_LINEAR_____0_CM 4 0. 255. FORMAT "%3.0" AXIS_PTS_REF ldpm_fmy_envd /end AXIS_DESCR
/end CHARACTERISTIC
/begin CHARACTERISTIC fmy_id_ref_crk_cam_in_2.envd "Freeze frame FRF_CUS_SET_SPC: environmental data contents for failure XX" CURVE 0xa08044f4 _REC_CUR_20_u1_u1 254. _CNV_A_R_LINEAR_____0_CM 1. 255. DISPLAY_IDENTIFIER ID_ERR_ENVD_REF_CRK_CAM_IN_2 FORMAT "%3.0"
 /begin AXIS_DESCR COM_AXIS errm_online_dummy _CNV_A_R_LINEAR_____0_CM 4 0. 255. FORMAT "%3.0" AXIS_PTS_REF ldpm_fmy_envd /end AXIS_DESCR
/end CHARACTERISTIC
/begin CHARACTERISTIC fmy_id_ref_crk_cam_ex_2.envd "Freeze frame FRF_CUS_SET_SPC: environmental data contents for failure XX" CURVE 0xa08044cc _REC_CUR_20_u1_u1 254. _CNV_A_R_LINEAR_____0_CM 1. 255. DISPLAY_IDENTIFIER ID_ERR_ENVD_REF_CRK_CAM_EX_2 FORMAT "%3.0"
 /begin AXIS_DESCR COM_AXIS errm_online_dummy _CNV_A_R_LINEAR_____0_CM 4 0. 255. FORMAT "%3.0" AXIS_PTS_REF ldpm_fmy_envd /end AXIS_DESCR
/end CHARACTERISTIC
/begin CHARACTERISTIC fmy_id_crk_tooth.envd "Freeze frame FRF_CUS_SET_SPC: environmental data contents for failure XX" CURVE 0xa080320c _REC_CUR_20_u1_u1 254. _CNV_A_R_LINEAR_____0_CM 1. 255. DISPLAY_IDENTIFIER ID_ERR_ENVD_CRK_TOOTH FORMAT "%3.0"
 /begin AXIS_DESCR COM_AXIS errm_online_dummy _CNV_A_R_LINEAR_____0_CM 4 0. 255. FORMAT "%3.0" AXIS_PTS_REF ldpm_fmy_envd /end AXIS_DESCR
/end CHARACTERISTIC
/begin CHARACTERISTIC fmy_id_crk_tooth_per.envd "Freeze frame FRF_CUS_SET_SPC: environmental data contents for failure XX" CURVE 0xa0803220 _REC_CUR_20_u1_u1 254. _CNV_A_R_LINEAR_____0_CM 1. 255. DISPLAY_IDENTIFIER ID_ERR_ENVD_CRK_TOOTH_PER FORMAT "%3.0"
 /begin AXIS_DESCR COM_AXIS errm_online_dummy _CNV_A_R_LINEAR_____0_CM 4 0. 255. FORMAT "%3.0" AXIS_PTS_REF ldpm_fmy_envd /end AXIS_DESCR
/end CHARACTERISTIC
/begin CHARACTERISTIC fmy_id_crk_syn.envd "Freeze frame FRF_CUS_SET_SPC: environmental data contents for failure XX" CURVE 0xa08031f8 _REC_CUR_20_u1_u1 254. _CNV_A_R_LINEAR_____0_CM 1. 255. DISPLAY_IDENTIFIER ID_ERR_ENVD_CRK_SYN FORMAT "%3.0"
 /begin AXIS_DESCR COM_AXIS errm_online_dummy _CNV_A_R_LINEAR_____0_CM 4 0. 255. FORMAT "%3.0" AXIS_PTS_REF ldpm_fmy_envd /end AXIS_DESCR
/end CHARACTERISTIC
/begin CHARACTERISTIC fmy_id_crk_plaus.envd "Freeze frame FRF_CUS_SET_SPC: environmental data contents for failure XX" CURVE 0xa08031e4 _REC_CUR_20_u1_u1 254. _CNV_A_R_LINEAR_____0_CM 1. 255. DISPLAY_IDENTIFIER ID_ERR_ENVD_CRK_PLAUS FORMAT "%3.0"
 /begin AXIS_DESCR COM_AXIS errm_online_dummy _CNV_A_R_LINEAR_____0_CM 4 0. 255. FORMAT "%3.0" AXIS_PTS_REF ldpm_fmy_envd /end AXIS_DESCR
/end CHARACTERISTIC
/begin CHARACTERISTIC fmy_id_plaus_cam_in_1.envd "Freeze frame FRF_CUS_SET_SPC: environmental data contents for failure XX" CURVE 0xa0804300 _REC_CUR_20_u1_u1 254. _CNV_A_R_LINEAR_____0_CM 1. 255. DISPLAY_IDENTIFIER ID_ERR_ENVD_PLAUS_CAM_IN_1 FORMAT "%3.0"
 /begin AXIS_DESCR COM_AXIS errm_online_dummy _CNV_A_R_LINEAR_____0_CM 4 0. 255. FORMAT "%3.0" AXIS_PTS_REF ldpm_fmy_envd /end AXIS_DESCR
/end CHARACTERISTIC
/begin CHARACTERISTIC fmy_id_plaus_cam_ex_1.envd "Freeze frame FRF_CUS_SET_SPC: environmental data contents for failure XX" CURVE 0xa08042d8 _REC_CUR_20_u1_u1 254. _CNV_A_R_LINEAR_____0_CM 1. 255. DISPLAY_IDENTIFIER ID_ERR_ENVD_PLAUS_CAM_EX_1 FORMAT "%3.0"
 /begin AXIS_DESCR COM_AXIS errm_online_dummy _CNV_A_R_LINEAR_____0_CM 4 0. 255. FORMAT "%3.0" AXIS_PTS_REF ldpm_fmy_envd /end AXIS_DESCR
/end CHARACTERISTIC
/begin CHARACTERISTIC fmy_id_syn_crk_cam_in_1.envd "Freeze frame FRF_CUS_SET_SPC: environmental data contents for failure XX" CURVE 0xa080483c _REC_CUR_20_u1_u1 254. _CNV_A_R_LINEAR_____0_CM 1. 255. DISPLAY_IDENTIFIER ID_ERR_ENVD_SYN_CRK_CAM_IN_1 FORMAT "%3.0"
 /begin AXIS_DESCR COM_AXIS errm_online_dummy _CNV_A_R_LINEAR_____0_CM 4 0. 255. FORMAT "%3.0" AXIS_PTS_REF ldpm_fmy_envd /end AXIS_DESCR
/end CHARACTERISTIC
/begin CHARACTERISTIC fmy_id_syn_crk_cam_ex_1.envd "Freeze frame FRF_CUS_SET_SPC: environmental data contents for failure XX" CURVE 0xa0804814 _REC_CUR_20_u1_u1 254. _CNV_A_R_LINEAR_____0_CM 1. 255. DISPLAY_IDENTIFIER ID_ERR_ENVD_SYN_CRK_CAM_EX_1 FORMAT "%3.0"
 /begin AXIS_DESCR COM_AXIS errm_online_dummy _CNV_A_R_LINEAR_____0_CM 4 0. 255. FORMAT "%3.0" AXIS_PTS_REF ldpm_fmy_envd /end AXIS_DESCR
/end CHARACTERISTIC
/begin CHARACTERISTIC fmy_id_tooth_off_in_1.envd "Freeze frame FRF_CUS_SET_SPC: environmental data contents for failure XX" CURVE 0xa0804aa8 _REC_CUR_20_u1_u1 254. _CNV_A_R_LINEAR_____0_CM 1. 255. DISPLAY_IDENTIFIER ID_ERR_ENVD_TOOTH_OFF_IN_1 FORMAT "%3.0"
 /begin AXIS_DESCR COM_AXIS errm_online_dummy _CNV_A_R_LINEAR_____0_CM 4 0. 255. FORMAT "%3.0" AXIS_PTS_REF ldpm_fmy_envd /end AXIS_DESCR
/end CHARACTERISTIC
/begin CHARACTERISTIC fmy_id_tooth_off_ex_1.envd "Freeze frame FRF_CUS_SET_SPC: environmental data contents for failure XX" CURVE 0xa0804a80 _REC_CUR_20_u1_u1 254. _CNV_A_R_LINEAR_____0_CM 1. 255. DISPLAY_IDENTIFIER ID_ERR_ENVD_TOOTH_OFF_EX_1 FORMAT "%3.0"
 /begin AXIS_DESCR COM_AXIS errm_online_dummy _CNV_A_R_LINEAR_____0_CM 4 0. 255. FORMAT "%3.0" AXIS_PTS_REF ldpm_fmy_envd /end AXIS_DESCR
/end CHARACTERISTIC
/begin CHARACTERISTIC fmy_id_plaus_cam_in_2.envd "Freeze frame FRF_CUS_SET_SPC: environmental data contents for failure XX" CURVE 0xa0804314 _REC_CUR_20_u1_u1 254. _CNV_A_R_LINEAR_____0_CM 1. 255. DISPLAY_IDENTIFIER ID_ERR_ENVD_PLAUS_CAM_IN_2 FORMAT "%3.0"
 /begin AXIS_DESCR COM_AXIS errm_online_dummy _CNV_A_R_LINEAR_____0_CM 4 0. 255. FORMAT "%3.0" AXIS_PTS_REF ldpm_fmy_envd /end AXIS_DESCR
/end CHARACTERISTIC
/begin CHARACTERISTIC fmy_id_plaus_cam_ex_2.envd "Freeze frame FRF_CUS_SET_SPC: environmental data contents for failure XX" CURVE 0xa08042ec _REC_CUR_20_u1_u1 254. _CNV_A_R_LINEAR_____0_CM 1. 255. DISPLAY_IDENTIFIER ID_ERR_ENVD_PLAUS_CAM_EX_2 FORMAT "%3.0"
 /begin AXIS_DESCR COM_AXIS errm_online_dummy _CNV_A_R_LINEAR_____0_CM 4 0. 255. FORMAT "%3.0" AXIS_PTS_REF ldpm_fmy_envd /end AXIS_DESCR
/end CHARACTERISTIC
/begin CHARACTERISTIC fmy_id_syn_crk_cam_in_2.envd "Freeze frame FRF_CUS_SET_SPC: environmental data contents for failure XX" CURVE 0xa0804850 _REC_CUR_20_u1_u1 254. _CNV_A_R_LINEAR_____0_CM 1. 255. DISPLAY_IDENTIFIER ID_ERR_ENVD_SYN_CRK_CAM_IN_2 FORMAT "%3.0"
 /begin AXIS_DESCR COM_AXIS errm_online_dummy _CNV_A_R_LINEAR_____0_CM 4 0. 255. FORMAT "%3.0" AXIS_PTS_REF ldpm_fmy_envd /end AXIS_DESCR
/end CHARACTERISTIC
/begin CHARACTERISTIC fmy_id_syn_crk_cam_ex_2.envd "Freeze frame FRF_CUS_SET_SPC: environmental data contents for failure XX" CURVE 0xa0804828 _REC_CUR_20_u1_u1 254. _CNV_A_R_LINEAR_____0_CM 1. 255. DISPLAY_IDENTIFIER ID_ERR_ENVD_SYN_CRK_CAM_EX_2 FORMAT "%3.0"
 /begin AXIS_DESCR COM_AXIS errm_online_dummy _CNV_A_R_LINEAR_____0_CM 4 0. 255. FORMAT "%3.0" AXIS_PTS_REF ldpm_fmy_envd /end AXIS_DESCR
/end CHARACTERISTIC
/begin CHARACTERISTIC fmy_id_tooth_off_in_2.envd "Freeze frame FRF_CUS_SET_SPC: environmental data contents for failure XX" CURVE 0xa0804abc _REC_CUR_20_u1_u1 254. _CNV_A_R_LINEAR_____0_CM 1. 255. DISPLAY_IDENTIFIER ID_ERR_ENVD_TOOTH_OFF_IN_2 FORMAT "%3.0"
 /begin AXIS_DESCR COM_AXIS errm_online_dummy _CNV_A_R_LINEAR_____0_CM 4 0. 255. FORMAT "%3.0" AXIS_PTS_REF ldpm_fmy_envd /end AXIS_DESCR
/end CHARACTERISTIC
/begin CHARACTERISTIC fmy_id_tooth_off_ex_2.envd "Freeze frame FRF_CUS_SET_SPC: environmental data contents for failure XX" CURVE 0xa0804a94 _REC_CUR_20_u1_u1 254. _CNV_A_R_LINEAR_____0_CM 1. 255. DISPLAY_IDENTIFIER ID_ERR_ENVD_TOOTH_OFF_EX_2 FORMAT "%3.0"
 /begin AXIS_DESCR COM_AXIS errm_online_dummy _CNV_A_R_LINEAR_____0_CM 4 0. 255. FORMAT "%3.0" AXIS_PTS_REF ldpm_fmy_envd /end AXIS_DESCR
/end CHARACTERISTIC
/begin CHARACTERISTIC fmy_id_can_boff.envd "Freeze frame FRF_CUS_SET_SPC: environmental data contents for failure XX" CURVE 0xa0802d48 _REC_CUR_20_u1_u1 254. _CNV_A_R_LINEAR_____0_CM 1. 255. DISPLAY_IDENTIFIER ID_ERR_ENVD_CAN_BOFF FORMAT "%3.0"
 /begin AXIS_DESCR COM_AXIS errm_online_dummy _CNV_A_R_LINEAR_____0_CM 4 0. 255. FORMAT "%3.0" AXIS_PTS_REF ldpm_fmy_envd /end AXIS_DESCR
/end CHARACTERISTIC
/begin CHARACTERISTIC fmy_id_rly_main.envd "Freeze frame FRF_CUS_SET_SPC: environmental data contents for failure XX" CURVE 0xa0804558 _REC_CUR_20_u1_u1 254. _CNV_A_R_LINEAR_____0_CM 1. 255. DISPLAY_IDENTIFIER ID_ERR_ENVD_RLY_MAIN FORMAT "%3.0"
 /begin AXIS_DESCR COM_AXIS errm_online_dummy _CNV_A_R_LINEAR_____0_CM 4 0. 255. FORMAT "%3.0" AXIS_PTS_REF ldpm_fmy_envd /end AXIS_DESCR
/end CHARACTERISTIC
/begin CHARACTERISTIC fmy_id_rly_main_dly.envd "Freeze frame FRF_CUS_SET_SPC: environmental data contents for failure XX" CURVE 0xa080456c _REC_CUR_20_u1_u1 254. _CNV_A_R_LINEAR_____0_CM 1. 255. DISPLAY_IDENTIFIER ID_ERR_ENVD_RLY_MAIN_DLY FORMAT "%3.0"
 /begin AXIS_DESCR COM_AXIS errm_online_dummy _CNV_A_R_LINEAR_____0_CM 4 0. 255. FORMAT "%3.0" AXIS_PTS_REF ldpm_fmy_envd /end AXIS_DESCR
/end CHARACTERISTIC
/begin CHARACTERISTIC fmy_id_rly_accout.envd "Freeze frame FRF_CUS_SET_SPC: environmental data contents for failure XX" CURVE 0xa0804530 _REC_CUR_20_u1_u1 254. _CNV_A_R_LINEAR_____0_CM 1. 255. DISPLAY_IDENTIFIER ID_ERR_ENVD_RLY_ACCOUT FORMAT "%3.0"
 /begin AXIS_DESCR COM_AXIS errm_online_dummy _CNV_A_R_LINEAR_____0_CM 4 0. 255. FORMAT "%3.0" AXIS_PTS_REF ldpm_fmy_envd /end AXIS_DESCR
/end CHARACTERISTIC
/begin CHARACTERISTIC fmy_id_isc.envd "Freeze frame FRF_CUS_SET_SPC: environmental data contents for failure XX" CURVE 0xa0803bbc _REC_CUR_20_u1_u1 254. _CNV_A_R_LINEAR_____0_CM 1. 255. DISPLAY_IDENTIFIER ID_ERR_ENVD_ISC FORMAT "%3.0"
 /begin AXIS_DESCR COM_AXIS errm_online_dummy _CNV_A_R_LINEAR_____0_CM 4 0. 255. FORMAT "%3.0" AXIS_PTS_REF ldpm_fmy_envd /end AXIS_DESCR
/end CHARACTERISTIC
/begin CHARACTERISTIC fmy_id_isc_cst.envd "Freeze frame FRF_CUS_SET_SPC: environmental data contents for failure XX" CURVE 0xa0803bd0 _REC_CUR_20_u1_u1 254. _CNV_A_R_LINEAR_____0_CM 1. 255. DISPLAY_IDENTIFIER ID_ERR_ENVD_ISC_CST FORMAT "%3.0"
 /begin AXIS_DESCR COM_AXIS errm_online_dummy _CNV_A_R_LINEAR_____0_CM 4 0. 255. FORMAT "%3.0" AXIS_PTS_REF ldpm_fmy_envd /end AXIS_DESCR
/end CHARACTERISTIC
/begin CHARACTERISTIC fmy_id_im_bls_plaus.envd "Freeze frame FRF_CUS_SET_SPC: environmental data contents for failure XX" CURVE 0xa0803b44 _REC_CUR_20_u1_u1 254. _CNV_A_R_LINEAR_____0_CM 1. 255. DISPLAY_IDENTIFIER ID_ERR_ENVD_IM_BLS_PLAUS FORMAT "%3.0"
 /begin AXIS_DESCR COM_AXIS errm_online_dummy _CNV_A_R_LINEAR_____0_CM 4 0. 255. FORMAT "%3.0" AXIS_PTS_REF ldpm_fmy_envd /end AXIS_DESCR
/end CHARACTERISTIC
/begin CHARACTERISTIC fmy_id_im_bts_plaus.envd "Freeze frame FRF_CUS_SET_SPC: environmental data contents for failure XX" CURVE 0xa0803b58 _REC_CUR_20_u1_u1 254. _CNV_A_R_LINEAR_____0_CM 1. 255. DISPLAY_IDENTIFIER ID_ERR_ENVD_IM_BTS_PLAUS FORMAT "%3.0"
 /begin AXIS_DESCR COM_AXIS errm_online_dummy _CNV_A_R_LINEAR_____0_CM 4 0. 255. FORMAT "%3.0" AXIS_PTS_REF ldpm_fmy_envd /end AXIS_DESCR
/end CHARACTERISTIC
/begin CHARACTERISTIC fmy_id_msw_tog.envd "Freeze frame FRF_CUS_SET_SPC: environmental data contents for failure XX" CURVE 0xa08040bc _REC_CUR_20_u1_u1 254. _CNV_A_R_LINEAR_____0_CM 1. 255. DISPLAY_IDENTIFIER ID_ERR_ENVD_MSW_TOG FORMAT "%3.0"
 /begin AXIS_DESCR COM_AXIS errm_online_dummy _CNV_A_R_LINEAR_____0_CM 4 0. 255. FORMAT "%3.0" AXIS_PTS_REF ldpm_fmy_envd /end AXIS_DESCR
/end CHARACTERISTIC
/begin CHARACTERISTIC fmy_id_msw_2.envd "Freeze frame FRF_CUS_SET_SPC: environmental data contents for failure XX" CURVE 0xa0804094 _REC_CUR_20_u1_u1 254. _CNV_A_R_LINEAR_____0_CM 1. 255. DISPLAY_IDENTIFIER ID_ERR_ENVD_MSW_2 FORMAT "%3.0"
 /begin AXIS_DESCR COM_AXIS errm_online_dummy _CNV_A_R_LINEAR_____0_CM 4 0. 255. FORMAT "%3.0" AXIS_PTS_REF ldpm_fmy_envd /end AXIS_DESCR
/end CHARACTERISTIC
/begin CHARACTERISTIC fmy_id_msw_3.envd "Freeze frame FRF_CUS_SET_SPC: environmental data contents for failure XX" CURVE 0xa08040a8 _REC_CUR_20_u1_u1 254. _CNV_A_R_LINEAR_____0_CM 1. 255. DISPLAY_IDENTIFIER ID_ERR_ENVD_MSW_3 FORMAT "%3.0"
 /begin AXIS_DESCR COM_AXIS errm_online_dummy _CNV_A_R_LINEAR_____0_CM 4 0. 255. FORMAT "%3.0" AXIS_PTS_REF ldpm_fmy_envd /end AXIS_DESCR
/end CHARACTERISTIC
/begin CHARACTERISTIC fmy_id_mis_0.envd "Freeze frame FRF_CUS_SET_SPC: environmental data contents for failure XX" CURVE 0xa0803fb8 _REC_CUR_20_u1_u1 254. _CNV_A_R_LINEAR_____0_CM 1. 255. DISPLAY_IDENTIFIER ID_ERR_ENVD_MIS_0 FORMAT "%3.0"
 /begin AXIS_DESCR COM_AXIS errm_online_dummy _CNV_A_R_LINEAR_____0_CM 4 0. 255. FORMAT "%3.0" AXIS_PTS_REF ldpm_fmy_envd /end AXIS_DESCR
/end CHARACTERISTIC
/begin CHARACTERISTIC fmy_id_mis_1.envd "Freeze frame FRF_CUS_SET_SPC: environmental data contents for failure XX" CURVE 0xa0803fcc _REC_CUR_20_u1_u1 254. _CNV_A_R_LINEAR_____0_CM 1. 255. DISPLAY_IDENTIFIER ID_ERR_ENVD_MIS_1 FORMAT "%3.0"
 /begin AXIS_DESCR COM_AXIS errm_online_dummy _CNV_A_R_LINEAR_____0_CM 4 0. 255. FORMAT "%3.0" AXIS_PTS_REF ldpm_fmy_envd /end AXIS_DESCR
/end CHARACTERISTIC
/begin CHARACTERISTIC fmy_id_mis_2.envd "Freeze frame FRF_CUS_SET_SPC: environmental data contents for failure XX" CURVE 0xa0803fe0 _REC_CUR_20_u1_u1 254. _CNV_A_R_LINEAR_____0_CM 1. 255. DISPLAY_IDENTIFIER ID_ERR_ENVD_MIS_2 FORMAT "%3.0"
 /begin AXIS_DESCR COM_AXIS errm_online_dummy _CNV_A_R_LINEAR_____0_CM 4 0. 255. FORMAT "%3.0" AXIS_PTS_REF ldpm_fmy_envd /end AXIS_DESCR
/end CHARACTERISTIC
/begin CHARACTERISTIC fmy_id_mis_3.envd "Freeze frame FRF_CUS_SET_SPC: environmental data contents for failure XX" CURVE 0xa0803ff4 _REC_CUR_20_u1_u1 254. _CNV_A_R_LINEAR_____0_CM 1. 255. DISPLAY_IDENTIFIER ID_ERR_ENVD_MIS_3 FORMAT "%3.0"
 /begin AXIS_DESCR COM_AXIS errm_online_dummy _CNV_A_R_LINEAR_____0_CM 4 0. 255. FORMAT "%3.0" AXIS_PTS_REF ldpm_fmy_envd /end AXIS_DESCR
/end CHARACTERISTIC
/begin CHARACTERISTIC fmy_id_mis_4.envd "Freeze frame FRF_CUS_SET_SPC: environmental data contents for failure XX" CURVE 0xa0804008 _REC_CUR_20_u1_u1 254. _CNV_A_R_LINEAR_____0_CM 1. 255. DISPLAY_IDENTIFIER ID_ERR_ENVD_MIS_4 FORMAT "%3.0"
 /begin AXIS_DESCR COM_AXIS errm_online_dummy _CNV_A_R_LINEAR_____0_CM 4 0. 255. FORMAT "%3.0" AXIS_PTS_REF ldpm_fmy_envd /end AXIS_DESCR
/end CHARACTERISTIC
/begin CHARACTERISTIC fmy_id_mis_5.envd "Freeze frame FRF_CUS_SET_SPC: environmental data contents for failure XX" CURVE 0xa080401c _REC_CUR_20_u1_u1 254. _CNV_A_R_LINEAR_____0_CM 1. 255. DISPLAY_IDENTIFIER ID_ERR_ENVD_MIS_5 FORMAT "%3.0"
 /begin AXIS_DESCR COM_AXIS errm_online_dummy _CNV_A_R_LINEAR_____0_CM 4 0. 255. FORMAT "%3.0" AXIS_PTS_REF ldpm_fmy_envd /end AXIS_DESCR
/end CHARACTERISTIC
/begin CHARACTERISTIC fmy_id_mis_6.envd "Freeze frame FRF_CUS_SET_SPC: environmental data contents for failure XX" CURVE 0xa0804030 _REC_CUR_20_u1_u1 254. _CNV_A_R_LINEAR_____0_CM 1. 255. DISPLAY_IDENTIFIER ID_ERR_ENVD_MIS_6 FORMAT "%3.0"
 /begin AXIS_DESCR COM_AXIS errm_online_dummy _CNV_A_R_LINEAR_____0_CM 4 0. 255. FORMAT "%3.0" AXIS_PTS_REF ldpm_fmy_envd /end AXIS_DESCR
/end CHARACTERISTIC
/begin CHARACTERISTIC fmy_id_mis_7.envd "Freeze frame FRF_CUS_SET_SPC: environmental data contents for failure XX" CURVE 0xa0804044 _REC_CUR_20_u1_u1 254. _CNV_A_R_LINEAR_____0_CM 1. 255. DISPLAY_IDENTIFIER ID_ERR_ENVD_MIS_7 FORMAT "%3.0"
 /begin AXIS_DESCR COM_AXIS errm_online_dummy _CNV_A_R_LINEAR_____0_CM 4 0. 255. FORMAT "%3.0" AXIS_PTS_REF ldpm_fmy_envd /end AXIS_DESCR
/end CHARACTERISTIC
/begin CHARACTERISTIC fmy_id_mis_mpl.envd "Freeze frame FRF_CUS_SET_SPC: environmental data contents for failure XX" CURVE 0xa080406c _REC_CUR_20_u1_u1 254. _CNV_A_R_LINEAR_____0_CM 1. 255. DISPLAY_IDENTIFIER ID_ERR_ENVD_MIS_MPL FORMAT "%3.0"
 /begin AXIS_DESCR COM_AXIS errm_online_dummy _CNV_A_R_LINEAR_____0_CM 4 0. 255. FORMAT "%3.0" AXIS_PTS_REF ldpm_fmy_envd /end AXIS_DESCR
/end CHARACTERISTIC
/begin CHARACTERISTIC fmy_id_mis_ftl_l.envd "Freeze frame FRF_CUS_SET_SPC: environmental data contents for failure XX" CURVE 0xa0804058 _REC_CUR_20_u1_u1 254. _CNV_A_R_LINEAR_____0_CM 1. 255. DISPLAY_IDENTIFIER ID_ERR_ENVD_MIS_FTL_L FORMAT "%3.0"
 /begin AXIS_DESCR COM_AXIS errm_online_dummy _CNV_A_R_LINEAR_____0_CM 4 0. 255. FORMAT "%3.0" AXIS_PTS_REF ldpm_fmy_envd /end AXIS_DESCR
/end CHARACTERISTIC
/begin CHARACTERISTIC fmy_id_ef.envd "Freeze frame FRF_CUS_SET_SPC: environmental data contents for failure XX" CURVE 0xa0803644 _REC_CUR_20_u1_u1 254. _CNV_A_R_LINEAR_____0_CM 1. 255. DISPLAY_IDENTIFIER ID_ERR_ENVD_EF FORMAT "%3.0"
 /begin AXIS_DESCR COM_AXIS errm_online_dummy _CNV_A_R_LINEAR_____0_CM 4 0. 255. FORMAT "%3.0" AXIS_PTS_REF ldpm_fmy_envd /end AXIS_DESCR
/end CHARACTERISTIC
/begin CHARACTERISTIC fmy_id_tecu.envd "Freeze frame FRF_CUS_SET_SPC: environmental data contents for failure XX" CURVE 0xa08049a4 _REC_CUR_20_u1_u1 254. _CNV_A_R_LINEAR_____0_CM 1. 255. DISPLAY_IDENTIFIER ID_ERR_ENVD_TECU FORMAT "%3.0"
 /begin AXIS_DESCR COM_AXIS errm_online_dummy _CNV_A_R_LINEAR_____0_CM 4 0. 255. FORMAT "%3.0" AXIS_PTS_REF ldpm_fmy_envd /end AXIS_DESCR
/end CHARACTERISTIC
/begin CHARACTERISTIC fmy_id_ebox_cfa.envd "Freeze frame FRF_CUS_SET_SPC: environmental data contents for failure XX" CURVE 0xa0803540 _REC_CUR_20_u1_u1 254. _CNV_A_R_LINEAR_____0_CM 1. 255. DISPLAY_IDENTIFIER ID_ERR_ENVD_EBOX_CFA FORMAT "%3.0"
 /begin AXIS_DESCR COM_AXIS errm_online_dummy _CNV_A_R_LINEAR_____0_CM 4 0. 255. FORMAT "%3.0" AXIS_PTS_REF ldpm_fmy_envd /end AXIS_DESCR
/end CHARACTERISTIC
/begin CHARACTERISTIC fmy_id_ecu_ram.envd "Freeze frame FRF_CUS_SET_SPC: environmental data contents for failure XX" CURVE 0xa0803630 _REC_CUR_20_u1_u1 254. _CNV_A_R_LINEAR_____0_CM 1. 255. DISPLAY_IDENTIFIER ID_ERR_ENVD_ECU_RAM FORMAT "%3.0"
 /begin AXIS_DESCR COM_AXIS errm_online_dummy _CNV_A_R_LINEAR_____0_CM 4 0. 255. FORMAT "%3.0" AXIS_PTS_REF ldpm_fmy_envd /end AXIS_DESCR
/end CHARACTERISTIC
/begin CHARACTERISTIC fmy_id_tqi_lim.envd "Freeze frame FRF_CUS_SET_SPC: environmental data contents for failure XX" CURVE 0xa0804cc4 _REC_CUR_20_u1_u1 254. _CNV_A_R_LINEAR_____0_CM 1. 255. DISPLAY_IDENTIFIER ID_ERR_ENVD_TQI_LIM FORMAT "%3.0"
 /begin AXIS_DESCR COM_AXIS errm_online_dummy _CNV_A_R_LINEAR_____0_CM 4 0. 255. FORMAT "%3.0" AXIS_PTS_REF ldpm_fmy_envd /end AXIS_DESCR
/end CHARACTERISTIC
/begin CHARACTERISTIC fmy_id_dmtls.envd "Freeze frame FRF_CUS_SET_SPC: environmental data contents for failure XX" CURVE 0xa08034c8 _REC_CUR_20_u1_u1 254. _CNV_A_R_LINEAR_____0_CM 1. 255. DISPLAY_IDENTIFIER ID_ERR_ENVD_DMTLS FORMAT "%3.0"
 /begin AXIS_DESCR COM_AXIS errm_online_dummy _CNV_A_R_LINEAR_____0_CM 4 0. 255. FORMAT "%3.0" AXIS_PTS_REF ldpm_fmy_envd /end AXIS_DESCR
/end CHARACTERISTIC
/begin CHARACTERISTIC fmy_id_dmtl_pump.envd "Freeze frame FRF_CUS_SET_SPC: environmental data contents for failure XX" CURVE 0xa080348c _REC_CUR_20_u1_u1 254. _CNV_A_R_LINEAR_____0_CM 1. 255. DISPLAY_IDENTIFIER ID_ERR_ENVD_DMTL_PUMP FORMAT "%3.0"
 /begin AXIS_DESCR COM_AXIS errm_online_dummy _CNV_A_R_LINEAR_____0_CM 4 0. 255. FORMAT "%3.0" AXIS_PTS_REF ldpm_fmy_envd /end AXIS_DESCR
/end CHARACTERISTIC
/begin CHARACTERISTIC fmy_id_dmtlm.envd "Freeze frame FRF_CUS_SET_SPC: environmental data contents for failure XX" CURVE 0xa08034b4 _REC_CUR_20_u1_u1 254. _CNV_A_R_LINEAR_____0_CM 1. 255. DISPLAY_IDENTIFIER ID_ERR_ENVD_DMTLM FORMAT "%3.0"
 /begin AXIS_DESCR COM_AXIS errm_online_dummy _CNV_A_R_LINEAR_____0_CM 4 0. 255. FORMAT "%3.0" AXIS_PTS_REF ldpm_fmy_envd /end AXIS_DESCR
/end CHARACTERISTIC
/begin CHARACTERISTIC fmy_id_rough_leak.envd "Freeze frame FRF_CUS_SET_SPC: environmental data contents for failure XX" CURVE 0xa08045a8 _REC_CUR_20_u1_u1 254. _CNV_A_R_LINEAR_____0_CM 1. 255. DISPLAY_IDENTIFIER ID_ERR_ENVD_ROUGH_LEAK FORMAT "%3.0"
 /begin AXIS_DESCR COM_AXIS errm_online_dummy _CNV_A_R_LINEAR_____0_CM 4 0. 255. FORMAT "%3.0" AXIS_PTS_REF ldpm_fmy_envd /end AXIS_DESCR
/end CHARACTERISTIC
/begin CHARACTERISTIC fmy_id_small_leak.envd "Freeze frame FRF_CUS_SET_SPC: environmental data contents for failure XX" CURVE 0xa0804724 _REC_CUR_20_u1_u1 254. _CNV_A_R_LINEAR_____0_CM 1. 255. DISPLAY_IDENTIFIER ID_ERR_ENVD_SMALL_LEAK FORMAT "%3.0"
 /begin AXIS_DESCR COM_AXIS errm_online_dummy _CNV_A_R_LINEAR_____0_CM 4 0. 255. FORMAT "%3.0" AXIS_PTS_REF ldpm_fmy_envd /end AXIS_DESCR
/end CHARACTERISTIC
/begin CHARACTERISTIC fmy_id_chk_fuc.envd "Freeze frame FRF_CUS_SET_SPC: environmental data contents for failure XX" CURVE 0xa0802dd4 _REC_CUR_20_u1_u1 254. _CNV_A_R_LINEAR_____0_CM 1. 255. DISPLAY_IDENTIFIER ID_ERR_ENVD_CHK_FUC FORMAT "%3.0"
 /begin AXIS_DESCR COM_AXIS errm_online_dummy _CNV_A_R_LINEAR_____0_CM 4 0. 255. FORMAT "%3.0" AXIS_PTS_REF ldpm_fmy_envd /end AXIS_DESCR
/end CHARACTERISTIC
/begin CHARACTERISTIC fmy_id_sof.envd "Freeze frame FRF_CUS_SET_SPC: environmental data contents for failure XX" CURVE 0xa0804738 _REC_CUR_20_u1_u1 254. _CNV_A_R_LINEAR_____0_CM 1. 255. DISPLAY_IDENTIFIER ID_ERR_ENVD_SOF FORMAT "%3.0"
 /begin AXIS_DESCR COM_AXIS errm_online_dummy _CNV_A_R_LINEAR_____0_CM 4 0. 255. FORMAT "%3.0" AXIS_PTS_REF ldpm_fmy_envd /end AXIS_DESCR
/end CHARACTERISTIC
/begin CHARACTERISTIC fmy_id_sof_req.envd "Freeze frame FRF_CUS_SET_SPC: environmental data contents for failure XX" CURVE 0xa080474c _REC_CUR_20_u1_u1 254. _CNV_A_R_LINEAR_____0_CM 1. 255. DISPLAY_IDENTIFIER ID_ERR_ENVD_SOF_REQ FORMAT "%3.0"
 /begin AXIS_DESCR COM_AXIS errm_online_dummy _CNV_A_R_LINEAR_____0_CM 4 0. 255. FORMAT "%3.0" AXIS_PTS_REF ldpm_fmy_envd /end AXIS_DESCR
/end CHARACTERISTIC
/begin CHARACTERISTIC fmy_id_rly_crcv_heat.envd "Freeze frame FRF_CUS_SET_SPC: environmental data contents for failure XX" CURVE 0xa0804544 _REC_CUR_20_u1_u1 254. _CNV_A_R_LINEAR_____0_CM 1. 255. DISPLAY_IDENTIFIER ID_ERR_ENVD_RLY_CRCV_HEAT FORMAT "%3.0"
 /begin AXIS_DESCR COM_AXIS errm_online_dummy _CNV_A_R_LINEAR_____0_CM 4 0. 255. FORMAT "%3.0" AXIS_PTS_REF ldpm_fmy_envd /end AXIS_DESCR
/end CHARACTERISTIC
/begin CHARACTERISTIC fmy_id_rly_st.envd "Freeze frame FRF_CUS_SET_SPC: environmental data contents for failure XX" CURVE 0xa0804580 _REC_CUR_20_u1_u1 254. _CNV_A_R_LINEAR_____0_CM 1. 255. DISPLAY_IDENTIFIER ID_ERR_ENVD_RLY_ST FORMAT "%3.0"
 /begin AXIS_DESCR COM_AXIS errm_online_dummy _CNV_A_R_LINEAR_____0_CM 4 0. 255. FORMAT "%3.0" AXIS_PTS_REF ldpm_fmy_envd /end AXIS_DESCR
/end CHARACTERISTIC
/begin CHARACTERISTIC fmy_id_bsd.envd "Freeze frame FRF_CUS_SET_SPC: environmental data contents for failure XX" CURVE 0xa0802d34 _REC_CUR_20_u1_u1 254. _CNV_A_R_LINEAR_____0_CM 1. 255. DISPLAY_IDENTIFIER ID_ERR_ENVD_BSD FORMAT "%3.0"
 /begin AXIS_DESCR COM_AXIS errm_online_dummy _CNV_A_R_LINEAR_____0_CM 4 0. 255. FORMAT "%3.0" AXIS_PTS_REF ldpm_fmy_envd /end AXIS_DESCR
/end CHARACTERISTIC
/begin CHARACTERISTIC fmy_id_poil_swi.envd "Freeze frame FRF_CUS_SET_SPC: environmental data contents for failure XX" CURVE 0xa0804350 _REC_CUR_20_u1_u1 254. _CNV_A_R_LINEAR_____0_CM 1. 255. DISPLAY_IDENTIFIER ID_ERR_ENVD_POIL_SWI FORMAT "%3.0"
 /begin AXIS_DESCR COM_AXIS errm_online_dummy _CNV_A_R_LINEAR_____0_CM 4 0. 255. FORMAT "%3.0" AXIS_PTS_REF ldpm_fmy_envd /end AXIS_DESCR
/end CHARACTERISTIC
/begin CHARACTERISTIC fmy_id_tout_efp_can.envd "Freeze frame FRF_CUS_SET_SPC: environmental data contents for failure XX" CURVE 0xa0804ad0 _REC_CUR_20_u1_u1 254. _CNV_A_R_LINEAR_____0_CM 1. 255. DISPLAY_IDENTIFIER ID_ERR_ENVD_TOUT_EFP_CAN FORMAT "%3.0"
 /begin AXIS_DESCR COM_AXIS errm_online_dummy _CNV_A_R_LINEAR_____0_CM 4 0. 255. FORMAT "%3.0" AXIS_PTS_REF ldpm_fmy_envd /end AXIS_DESCR
/end CHARACTERISTIC
/begin CHARACTERISTIC fmy_id_diagcps.envd "Freeze frame FRF_CUS_SET_SPC: environmental data contents for failure XX" CURVE 0xa0803478 _REC_CUR_20_u1_u1 254. _CNV_A_R_LINEAR_____0_CM 1. 255. DISPLAY_IDENTIFIER ID_ERR_ENVD_DIAGCPS FORMAT "%3.0"
 /begin AXIS_DESCR COM_AXIS errm_online_dummy _CNV_A_R_LINEAR_____0_CM 4 0. 255. FORMAT "%3.0" AXIS_PTS_REF ldpm_fmy_envd /end AXIS_DESCR
/end CHARACTERISTIC
/begin CHARACTERISTIC fmy_id_dcc.envd "Freeze frame FRF_CUS_SET_SPC: environmental data contents for failure XX" CURVE 0xa080343c _REC_CUR_20_u1_u1 254. _CNV_A_R_LINEAR_____0_CM 1. 255. DISPLAY_IDENTIFIER ID_ERR_ENVD_DCC FORMAT "%3.0"
 /begin AXIS_DESCR COM_AXIS errm_online_dummy _CNV_A_R_LINEAR_____0_CM 4 0. 255. FORMAT "%3.0" AXIS_PTS_REF ldpm_fmy_envd /end AXIS_DESCR
/end CHARACTERISTIC
/begin CHARACTERISTIC fmy_id_ldm.envd "Freeze frame FRF_CUS_SET_SPC: environmental data contents for failure XX" CURVE 0xa0803d88 _REC_CUR_20_u1_u1 254. _CNV_A_R_LINEAR_____0_CM 1. 255. DISPLAY_IDENTIFIER ID_ERR_ENVD_LDM FORMAT "%3.0"
 /begin AXIS_DESCR COM_AXIS errm_online_dummy _CNV_A_R_LINEAR_____0_CM 4 0. 255. FORMAT "%3.0" AXIS_PTS_REF ldpm_fmy_envd /end AXIS_DESCR
/end CHARACTERISTIC
/begin CHARACTERISTIC fmy_id_dmtlh.envd "Freeze frame FRF_CUS_SET_SPC: environmental data contents for failure XX" CURVE 0xa08034a0 _REC_CUR_20_u1_u1 254. _CNV_A_R_LINEAR_____0_CM 1. 255. DISPLAY_IDENTIFIER ID_ERR_ENVD_DMTLH FORMAT "%3.0"
 /begin AXIS_DESCR COM_AXIS errm_online_dummy _CNV_A_R_LINEAR_____0_CM 4 0. 255. FORMAT "%3.0" AXIS_PTS_REF ldpm_fmy_envd /end AXIS_DESCR
/end CHARACTERISTIC
/begin CHARACTERISTIC fmy_id_cs.envd "Freeze frame FRF_CUS_SET_SPC: environmental data contents for failure XX" CURVE 0xa0803248 _REC_CUR_20_u1_u1 254. _CNV_A_R_LINEAR_____0_CM 1. 255. DISPLAY_IDENTIFIER ID_ERR_ENVD_CS FORMAT "%3.0"
 /begin AXIS_DESCR COM_AXIS errm_online_dummy _CNV_A_R_LINEAR_____0_CM 4 0. 255. FORMAT "%3.0" AXIS_PTS_REF ldpm_fmy_envd /end AXIS_DESCR
/end CHARACTERISTIC
/begin CHARACTERISTIC fmy_id_spi_mps.envd "Freeze frame FRF_CUS_SET_SPC: environmental data contents for failure XX" CURVE 0xa0804774 _REC_CUR_20_u1_u1 254. _CNV_A_R_LINEAR_____0_CM 1. 255. DISPLAY_IDENTIFIER ID_ERR_ENVD_SPI_MPS FORMAT "%3.0"
 /begin AXIS_DESCR COM_AXIS errm_online_dummy _CNV_A_R_LINEAR_____0_CM 4 0. 255. FORMAT "%3.0" AXIS_PTS_REF ldpm_fmy_envd /end AXIS_DESCR
/end CHARACTERISTIC
/begin CHARACTERISTIC fmy_id_spi_knk.envd "Freeze frame FRF_CUS_SET_SPC: environmental data contents for failure XX" CURVE 0xa0804760 _REC_CUR_20_u1_u1 254. _CNV_A_R_LINEAR_____0_CM 1. 255. DISPLAY_IDENTIFIER ID_ERR_ENVD_SPI_KNK FORMAT "%3.0"
 /begin AXIS_DESCR COM_AXIS errm_online_dummy _CNV_A_R_LINEAR_____0_CM 4 0. 255. FORMAT "%3.0" AXIS_PTS_REF ldpm_fmy_envd /end AXIS_DESCR
/end CHARACTERISTIC
/begin CHARACTERISTIC fmy_id_sens_poil.envd "Freeze frame FRF_CUS_SET_SPC: environmental data contents for failure XX" CURVE 0xa0804648 _REC_CUR_20_u1_u1 254. _CNV_A_R_LINEAR_____0_CM 1. 255. DISPLAY_IDENTIFIER ID_ERR_ENVD_SENS_POIL FORMAT "%3.0"
 /begin AXIS_DESCR COM_AXIS errm_online_dummy _CNV_A_R_LINEAR_____0_CM 4 0. 255. FORMAT "%3.0" AXIS_PTS_REF ldpm_fmy_envd /end AXIS_DESCR
/end CHARACTERISTIC
/begin CHARACTERISTIC fmy_id_poil_dr.envd "Freeze frame FRF_CUS_SET_SPC: environmental data contents for failure XX" CURVE 0xa080433c _REC_CUR_20_u1_u1 254. _CNV_A_R_LINEAR_____0_CM 1. 255. DISPLAY_IDENTIFIER ID_ERR_ENVD_POIL_DR FORMAT "%3.0"
 /begin AXIS_DESCR COM_AXIS errm_online_dummy _CNV_A_R_LINEAR_____0_CM 4 0. 255. FORMAT "%3.0" AXIS_PTS_REF ldpm_fmy_envd /end AXIS_DESCR
/end CHARACTERISTIC
/begin CHARACTERISTIC fmy_id_bn_tq_dcc.envd "Freeze frame FRF_CUS_SET_SPC: environmental data contents for failure XX" CURVE 0xa0802c94 _REC_CUR_20_u1_u1 254. _CNV_A_R_LINEAR_____0_CM 1. 255. DISPLAY_IDENTIFIER ID_ERR_ENVD_BN_TQ_DCC FORMAT "%3.0"
 /begin AXIS_DESCR COM_AXIS errm_online_dummy _CNV_A_R_LINEAR_____0_CM 4 0. 255. FORMAT "%3.0" AXIS_PTS_REF ldpm_fmy_envd /end AXIS_DESCR
/end CHARACTERISTIC
/begin CHARACTERISTIC fmy_id_bn_tq_pste_2.envd "Freeze frame FRF_CUS_SET_SPC: environmental data contents for failure XX" CURVE 0xa0802cbc _REC_CUR_20_u1_u1 254. _CNV_A_R_LINEAR_____0_CM 1. 255. DISPLAY_IDENTIFIER ID_ERR_ENVD_BN_TQ_PSTE_2 FORMAT "%3.0"
 /begin AXIS_DESCR COM_AXIS errm_online_dummy _CNV_A_R_LINEAR_____0_CM 4 0. 255. FORMAT "%3.0" AXIS_PTS_REF ldpm_fmy_envd /end AXIS_DESCR
/end CHARACTERISTIC
/begin CHARACTERISTIC fmy_id_bn_tq_pste_3.envd "Freeze frame FRF_CUS_SET_SPC: environmental data contents for failure XX" CURVE 0xa0802cd0 _REC_CUR_20_u1_u1 254. _CNV_A_R_LINEAR_____0_CM 1. 255. DISPLAY_IDENTIFIER ID_ERR_ENVD_BN_TQ_PSTE_3 FORMAT "%3.0"
 /begin AXIS_DESCR COM_AXIS errm_online_dummy _CNV_A_R_LINEAR_____0_CM 4 0. 255. FORMAT "%3.0" AXIS_PTS_REF ldpm_fmy_envd /end AXIS_DESCR
/end CHARACTERISTIC
/begin CHARACTERISTIC fmy_id_bn_ars.envd "Freeze frame FRF_CUS_SET_SPC: environmental data contents for failure XX" CURVE 0xa0802ab4 _REC_CUR_20_u1_u1 254. _CNV_A_R_LINEAR_____0_CM 1. 255. DISPLAY_IDENTIFIER ID_ERR_ENVD_BN_ARS FORMAT "%3.0"
 /begin AXIS_DESCR COM_AXIS errm_online_dummy _CNV_A_R_LINEAR_____0_CM 4 0. 255. FORMAT "%3.0" AXIS_PTS_REF ldpm_fmy_envd /end AXIS_DESCR
/end CHARACTERISTIC
/begin CHARACTERISTIC fmy_id_bn_cas.envd "Freeze frame FRF_CUS_SET_SPC: environmental data contents for failure XX" CURVE 0xa0802ac8 _REC_CUR_20_u1_u1 254. _CNV_A_R_LINEAR_____0_CM 1. 255. DISPLAY_IDENTIFIER ID_ERR_ENVD_BN_CAS FORMAT "%3.0"
 /begin AXIS_DESCR COM_AXIS errm_online_dummy _CNV_A_R_LINEAR_____0_CM 4 0. 255. FORMAT "%3.0" AXIS_PTS_REF ldpm_fmy_envd /end AXIS_DESCR
/end CHARACTERISTIC
/begin CHARACTERISTIC fmy_id_bn_tq_tcs.envd "Freeze frame FRF_CUS_SET_SPC: environmental data contents for failure XX" CURVE 0xa0802ce4 _REC_CUR_20_u1_u1 254. _CNV_A_R_LINEAR_____0_CM 1. 255. DISPLAY_IDENTIFIER ID_ERR_ENVD_BN_TQ_TCS FORMAT "%3.0"
 /begin AXIS_DESCR COM_AXIS errm_online_dummy _CNV_A_R_LINEAR_____0_CM 4 0. 255. FORMAT "%3.0" AXIS_PTS_REF ldpm_fmy_envd /end AXIS_DESCR
/end CHARACTERISTIC
/begin CHARACTERISTIC fmy_id_bn_vs_tcs.envd "Freeze frame FRF_CUS_SET_SPC: environmental data contents for failure XX" CURVE 0xa0802d20 _REC_CUR_20_u1_u1 254. _CNV_A_R_LINEAR_____0_CM 1. 255. DISPLAY_IDENTIFIER ID_ERR_ENVD_BN_VS_TCS FORMAT "%3.0"
 /begin AXIS_DESCR COM_AXIS errm_online_dummy _CNV_A_R_LINEAR_____0_CM 4 0. 255. FORMAT "%3.0" AXIS_PTS_REF ldpm_fmy_envd /end AXIS_DESCR
/end CHARACTERISTIC
/begin CHARACTERISTIC fmy_id_bn_tcs.envd "Freeze frame FRF_CUS_SET_SPC: environmental data contents for failure XX" CURVE 0xa0802c6c _REC_CUR_20_u1_u1 254. _CNV_A_R_LINEAR_____0_CM 1. 255. DISPLAY_IDENTIFIER ID_ERR_ENVD_BN_TCS FORMAT "%3.0"
 /begin AXIS_DESCR COM_AXIS errm_online_dummy _CNV_A_R_LINEAR_____0_CM 4 0. 255. FORMAT "%3.0" AXIS_PTS_REF ldpm_fmy_envd /end AXIS_DESCR
/end CHARACTERISTIC
/begin CHARACTERISTIC fmy_id_bn_tq_etcu.envd "Freeze frame FRF_CUS_SET_SPC: environmental data contents for failure XX" CURVE 0xa0802ca8 _REC_CUR_20_u1_u1 254. _CNV_A_R_LINEAR_____0_CM 1. 255. DISPLAY_IDENTIFIER ID_ERR_ENVD_BN_TQ_ETCU FORMAT "%3.0"
 /begin AXIS_DESCR COM_AXIS errm_online_dummy _CNV_A_R_LINEAR_____0_CM 4 0. 255. FORMAT "%3.0" AXIS_PTS_REF ldpm_fmy_envd /end AXIS_DESCR
/end CHARACTERISTIC
/begin CHARACTERISTIC fmy_id_bn_etcu.envd "Freeze frame FRF_CUS_SET_SPC: environmental data contents for failure XX" CURVE 0xa0802b18 _REC_CUR_20_u1_u1 254. _CNV_A_R_LINEAR_____0_CM 1. 255. DISPLAY_IDENTIFIER ID_ERR_ENVD_BN_ETCU FORMAT "%3.0"
 /begin AXIS_DESCR COM_AXIS errm_online_dummy _CNV_A_R_LINEAR_____0_CM 4 0. 255. FORMAT "%3.0" AXIS_PTS_REF ldpm_fmy_envd /end AXIS_DESCR
/end CHARACTERISTIC
/begin CHARACTERISTIC fmy_id_bn_etcu_2.envd "Freeze frame FRF_CUS_SET_SPC: environmental data contents for failure XX" CURVE 0xa0802b2c _REC_CUR_20_u1_u1 254. _CNV_A_R_LINEAR_____0_CM 1. 255. DISPLAY_IDENTIFIER ID_ERR_ENVD_BN_ETCU_2 FORMAT "%3.0"
 /begin AXIS_DESCR COM_AXIS errm_online_dummy _CNV_A_R_LINEAR_____0_CM 4 0. 255. FORMAT "%3.0" AXIS_PTS_REF ldpm_fmy_envd /end AXIS_DESCR
/end CHARACTERISTIC
/begin CHARACTERISTIC fmy_id_bn_etcu_3.envd "Freeze frame FRF_CUS_SET_SPC: environmental data contents for failure XX" CURVE 0xa0802b40 _REC_CUR_20_u1_u1 254. _CNV_A_R_LINEAR_____0_CM 1. 255. DISPLAY_IDENTIFIER ID_ERR_ENVD_BN_ETCU_3 FORMAT "%3.0"
 /begin AXIS_DESCR COM_AXIS errm_online_dummy _CNV_A_R_LINEAR_____0_CM 4 0. 255. FORMAT "%3.0" AXIS_PTS_REF ldpm_fmy_envd /end AXIS_DESCR
/end CHARACTERISTIC
/begin CHARACTERISTIC fmy_id_bn_etcu_disp.envd "Freeze frame FRF_CUS_SET_SPC: environmental data contents for failure XX" CURVE 0xa0802b54 _REC_CUR_20_u1_u1 254. _CNV_A_R_LINEAR_____0_CM 1. 255. DISPLAY_IDENTIFIER ID_ERR_ENVD_BN_ETCU_DISP FORMAT "%3.0"
 /begin AXIS_DESCR COM_AXIS errm_online_dummy _CNV_A_R_LINEAR_____0_CM 4 0. 255. FORMAT "%3.0" AXIS_PTS_REF ldpm_fmy_envd /end AXIS_DESCR
/end CHARACTERISTIC
/begin CHARACTERISTIC fmy_id_bn_tq_amt.envd "Freeze frame FRF_CUS_SET_SPC: environmental data contents for failure XX" CURVE 0xa0802c80 _REC_CUR_20_u1_u1 254. _CNV_A_R_LINEAR_____0_CM 1. 255. DISPLAY_IDENTIFIER ID_ERR_ENVD_BN_TQ_AMT FORMAT "%3.0"
 /begin AXIS_DESCR COM_AXIS errm_online_dummy _CNV_A_R_LINEAR_____0_CM 4 0. 255. FORMAT "%3.0" AXIS_PTS_REF ldpm_fmy_envd /end AXIS_DESCR
/end CHARACTERISTIC
/begin CHARACTERISTIC fmy_id_bn_acc.envd "Freeze frame FRF_CUS_SET_SPC: environmental data contents for failure XX" CURVE 0xa0802a8c _REC_CUR_20_u1_u1 254. _CNV_A_R_LINEAR_____0_CM 1. 255. DISPLAY_IDENTIFIER ID_ERR_ENVD_BN_ACC FORMAT "%3.0"
 /begin AXIS_DESCR COM_AXIS errm_online_dummy _CNV_A_R_LINEAR_____0_CM 4 0. 255. FORMAT "%3.0" AXIS_PTS_REF ldpm_fmy_envd /end AXIS_DESCR
/end CHARACTERISTIC
/begin CHARACTERISTIC fmy_id_bn_t_icl.envd "Freeze frame FRF_CUS_SET_SPC: environmental data contents for failure XX" CURVE 0xa0802c58 _REC_CUR_20_u1_u1 254. _CNV_A_R_LINEAR_____0_CM 1. 255. DISPLAY_IDENTIFIER ID_ERR_ENVD_BN_T_ICL FORMAT "%3.0"
 /begin AXIS_DESCR COM_AXIS errm_online_dummy _CNV_A_R_LINEAR_____0_CM 4 0. 255. FORMAT "%3.0" AXIS_PTS_REF ldpm_fmy_envd /end AXIS_DESCR
/end CHARACTERISTIC
/begin CHARACTERISTIC fmy_id_bn_veh_mod.envd "Freeze frame FRF_CUS_SET_SPC: environmental data contents for failure XX" CURVE 0xa0802d0c _REC_CUR_20_u1_u1 254. _CNV_A_R_LINEAR_____0_CM 1. 255. DISPLAY_IDENTIFIER ID_ERR_ENVD_BN_VEH_MOD FORMAT "%3.0"
 /begin AXIS_DESCR COM_AXIS errm_online_dummy _CNV_A_R_LINEAR_____0_CM 4 0. 255. FORMAT "%3.0" AXIS_PTS_REF ldpm_fmy_envd /end AXIS_DESCR
/end CHARACTERISTIC
/begin CHARACTERISTIC fmy_id_bn_km_icl.envd "Freeze frame FRF_CUS_SET_SPC: environmental data contents for failure XX" CURVE 0xa0802ba4 _REC_CUR_20_u1_u1 254. _CNV_A_R_LINEAR_____0_CM 1. 255. DISPLAY_IDENTIFIER ID_ERR_ENVD_BN_KM_ICL FORMAT "%3.0"
 /begin AXIS_DESCR COM_AXIS errm_online_dummy _CNV_A_R_LINEAR_____0_CM 4 0. 255. FORMAT "%3.0" AXIS_PTS_REF ldpm_fmy_envd /end AXIS_DESCR
/end CHARACTERISTIC
/begin CHARACTERISTIC fmy_id_bn_icl.envd "Freeze frame FRF_CUS_SET_SPC: environmental data contents for failure XX" CURVE 0xa0802b90 _REC_CUR_20_u1_u1 254. _CNV_A_R_LINEAR_____0_CM 1. 255. DISPLAY_IDENTIFIER ID_ERR_ENVD_BN_ICL FORMAT "%3.0"
 /begin AXIS_DESCR COM_AXIS errm_online_dummy _CNV_A_R_LINEAR_____0_CM 4 0. 255. FORMAT "%3.0" AXIS_PTS_REF ldpm_fmy_envd /end AXIS_DESCR
/end CHARACTERISTIC
/begin CHARACTERISTIC fmy_id_bn_pow_vb.envd "Freeze frame FRF_CUS_SET_SPC: environmental data contents for failure XX" CURVE 0xa0802c1c _REC_CUR_20_u1_u1 254. _CNV_A_R_LINEAR_____0_CM 1. 255. DISPLAY_IDENTIFIER ID_ERR_ENVD_BN_POW_VB FORMAT "%3.0"
 /begin AXIS_DESCR COM_AXIS errm_online_dummy _CNV_A_R_LINEAR_____0_CM 4 0. 255. FORMAT "%3.0" AXIS_PTS_REF ldpm_fmy_envd /end AXIS_DESCR
/end CHARACTERISTIC
/begin CHARACTERISTIC fmy_id_bn_pow_gen.envd "Freeze frame FRF_CUS_SET_SPC: environmental data contents for failure XX" CURVE 0xa0802c08 _REC_CUR_20_u1_u1 254. _CNV_A_R_LINEAR_____0_CM 1. 255. DISPLAY_IDENTIFIER ID_ERR_ENVD_BN_POW_GEN FORMAT "%3.0"
 /begin AXIS_DESCR COM_AXIS errm_online_dummy _CNV_A_R_LINEAR_____0_CM 4 0. 255. FORMAT "%3.0" AXIS_PTS_REF ldpm_fmy_envd /end AXIS_DESCR
/end CHARACTERISTIC
/begin COMPU_METHOD _CNV_A_R_LINEAR_____0_CM "" RAT_FUNC "%6.3" "-" COEFFS 0 1. 0. 0 0 1 /end COMPU_METHOD
/begin RECORD_LAYOUT _REC_AXS_20_u1 NO_AXIS_PTS_X 1 UBYTE AXIS_PTS_X 2 UBYTE INDEX_INCR DIRECT /end RECORD_LAYOUT
/begin RECORD_LAYOUT _REC_CUR_20_u1_u1 FNC_VALUES 1 UBYTE COLUMN_DIR DIRECT /end RECORD_LAYOUT
/begin FUNCTION ERRM_Environmental_data "Environmental_Data"
 /begin DEF_CHARACTERISTIC ldpm_fmy_envd fmy_id_imob_0.envd fmy_id_imob_1.envd fmy_id_imob_2.envd fmy_id_imob_3.envd fmy_id_tco_el.envd fmy_id_tco_grd.envd fmy_id_tco_stuck.envd fmy_id_tco_stuck_rng.envd fmy_id_tco_plaus.envd fmy_id_tco_2_el.envd fmy_id_tco_2_grd.envd fmy_id_tco_2_plaus.envd fmy_id_ect_el.envd fmy_id_ecf_el_1.envd fmy_id_ecf_el_2.envd fmy_id_ecfpwm_fb_1.envd fmy_id_ecfpwm_fb_2.envd fmy_id_th.envd fmy_id_ftl_min.envd fmy_id_tia_el_1.envd fmy_id_tia_el_2.envd fmy_id_tia_thr_el_1.envd fmy_id_tia_thr_el_2.envd fmy_id_amp.envd fmy_id_amp_plaus.envd fmy_id_maf.envd fmy_id_el_cps.envd fmy_id_slv_ivvt_in_1.envd fmy_id_slv_ivvt_in_2.envd fmy_id_slv_ivvt_ex_1.envd fmy_id_slv_ivvt_ex_2.envd fmy_id_ecu_cks.envd fmy_id_vs.envd fmy_id_knks_1.envd fmy_id_knks_2.envd fmy_id_knks_3.envd fmy_id_knks_4.envd fmy_id_rfp_dr_1.envd fmy_id_rfp_dr_2.envd fmy_id_wg_1_dr.envd fmy_id_wg_2_dr.envd fmy_id_put_el_1.envd fmy_id_put_el_2.envd fmy_id_igc_scp_0.envd fmy_id_igc_scp_1.envd fmy_id_igc_scp_2.envd fmy_id_igc_scp_3.envd fmy_id_igc_scp_4.envd fmy_id_igc_scp_5.envd fmy_id_igc_scp_6.envd fmy_id_igc_scp_7.envd fmy_id_igc_scg_0.envd fmy_id_igc_scg_1.envd fmy_id_igc_scg_2.envd fmy_id_igc_scg_3.envd fmy_id_igc_scg_4.envd fmy_id_igc_scg_5.envd fmy_id_igc_scg_6.envd fmy_id_igc_scg_7.envd fmy_id_igc_ol_0.envd fmy_id_igc_ol_1.envd fmy_id_igc_ol_2.envd fmy_id_igc_ol_3.envd fmy_id_igc_ol_4.envd fmy_id_igc_ol_5.envd fmy_id_igc_ol_6.envd fmy_id_igc_ol_7.envd fmy_id_dur_igc_mpl.envd fmy_id_v_ref_1.envd fmy_id_v_ref_2.envd fmy_id_pvs_1.envd fmy_id_pvs_2.envd fmy_id_pvs_ratio.envd fmy_id_pvs_double.envd fmy_id_pvs_bls_not_plaus.envd fmy_id_mtc_ctl_1.envd fmy_id_gen.envd fmy_id_gen_diag.envd fmy_id_alter_bn.envd fmy_id_alter_bn_bat.envd fmy_id_t_es.envd fmy_id_map_dip_plaus.envd fmy_id_toil_level.envd fmy_id_alter_bn_rgn.envd fmy_id_per_cam_in_1.envd fmy_id_per_cam_ex_1.envd fmy_id_syn_cam_in_1.envd fmy_id_syn_cam_ex_1.envd fmy_id_ref_crk_cam_in_1.envd fmy_id_ref_crk_cam_ex_1.envd fmy_id_per_cam_in_2.envd fmy_id_per_cam_ex_2.envd fmy_id_syn_cam_in_2.envd fmy_id_syn_cam_ex_2.envd fmy_id_ref_crk_cam_in_2.envd fmy_id_ref_crk_cam_ex_2.envd fmy_id_crk_tooth.envd fmy_id_crk_tooth_per.envd fmy_id_crk_syn.envd fmy_id_crk_plaus.envd fmy_id_plaus_cam_in_1.envd fmy_id_plaus_cam_ex_1.envd fmy_id_syn_crk_cam_in_1.envd fmy_id_syn_crk_cam_ex_1.envd fmy_id_tooth_off_in_1.envd fmy_id_tooth_off_ex_1.envd fmy_id_plaus_cam_in_2.envd fmy_id_plaus_cam_ex_2.envd fmy_id_syn_crk_cam_in_2.envd fmy_id_syn_crk_cam_ex_2.envd fmy_id_tooth_off_in_2.envd fmy_id_tooth_off_ex_2.envd fmy_id_can_boff.envd fmy_id_rly_main.envd fmy_id_rly_main_dly.envd fmy_id_rly_accout.envd fmy_id_isc.envd fmy_id_isc_cst.envd fmy_id_im_bls_plaus.envd fmy_id_im_bts_plaus.envd fmy_id_msw_tog.envd fmy_id_msw_2.envd fmy_id_msw_3.envd fmy_id_mis_0.envd fmy_id_mis_1.envd fmy_id_mis_2.envd fmy_id_mis_3.envd fmy_id_mis_4.envd fmy_id_mis_5.envd fmy_id_mis_6.envd fmy_id_mis_7.envd fmy_id_mis_mpl.envd fmy_id_mis_ftl_l.envd fmy_id_ef.envd fmy_id_tecu.envd fmy_id_ebox_cfa.envd fmy_id_ecu_ram.envd fmy_id_tqi_lim.envd fmy_id_dmtls.envd fmy_id_dmtl_pump.envd fmy_id_dmtlm.envd fmy_id_rough_leak.envd fmy_id_small_leak.envd fmy_id_chk_fuc.envd fmy_id_sof.envd fmy_id_sof_req.envd fmy_id_rly_crcv_heat.envd fmy_id_rly_st.envd fmy_id_bsd.envd fmy_id_poil_swi.envd fmy_id_tout_efp_can.envd fmy_id_diagcps.envd fmy_id_dcc.envd fmy_id_ldm.envd fmy_id_dmtlh.envd fmy_id_cs.envd fmy_id_spi_mps.envd fmy_id_spi_knk.envd fmy_id_sens_poil.envd fmy_id_poil_dr.envd fmy_id_bn_tq_dcc.envd fmy_id_bn_tq_pste_2.envd fmy_id_bn_tq_pste_3.envd fmy_id_bn_ars.envd fmy_id_bn_cas.envd fmy_id_bn_tq_tcs.envd fmy_id_bn_vs_tcs.envd fmy_id_bn_tcs.envd fmy_id_bn_tq_etcu.envd fmy_id_bn_etcu.envd fmy_id_bn_etcu_2.envd fmy_id_bn_etcu_3.envd fmy_id_bn_etcu_disp.envd fmy_id_bn_tq_amt.envd fmy_id_bn_acc.envd fmy_id_bn_t_icl.envd fmy_id_bn_veh_mod.envd fmy_id_bn_km_icl.envd fmy_id_bn_icl.envd fmy_id_bn_pow_vb.envd fmy_id_bn_pow_gen.envd /end DEF_CHARACTERISTIC
 /begin OUT_MEASUREMENT tbl_frf[5].envd_obd[8] tbl_frf[5].envd_obd[9] tbl_frf[5].envd_obd[10] tbl_frf[5].envd_obd[11] tbl_frf[5].envd_obd[12] tbl_frf[5].envd_obd[13] tbl_frf[5].envd_obd[14] tbl_frf[5].envd_obd[15] tbl_frf[5].envd_obd[16] tbl_frf[5].envd_obd[17] tbl_frf[5].envd_obd[18] tbl_frf[5].envd_obd[19] tbl_frf[5].envd_obd[20] tbl_frf[5].envd_obd[21] tbl_frf[5].envd_obd[22] tbl_frf[5].envd_obd[23] tbl_frf[5].envd_obd[24] tbl_frf[5].envd_obd[25] tbl_frf[5].envd_obd[26] tbl_frf[5].envd_obd[27] tbl_frf[5].envd_obd[28] tbl_frf[5].envd_obd[29] tbl_frf[5].envd_obd[30] tbl_frf[5].envd_obd[31] tbl_frf[5].envd_obd[32] tbl_frf[5].envd_obd[33] tbl_frf[5].envd_obd[34] tbl_frf[5].envd_obd[35] tbl_frf[5].envd_obd[36] tbl_frf[5].envd_obd[37] tbl_frf[5].envd_cus_cmn[0] tbl_frf[5].envd_cus_set_cmn[0][0] tbl_frf[5].envd_cus_set_cmn[0][1] tbl_frf[5].envd_cus_set_cmn[0][2] tbl_frf[5].envd_cus_set_cmn[0][3] tbl_frf[5].envd_cus_set_cmn[0][4] tbl_frf[5].envd_cus_set_cmn[0][5] tbl_frf[5].envd_cus_set_cmn[0][6] tbl_frf[5].envd_cus_set_cmn[0][7] tbl_frf[5].envd_cus_set_cmn[0][8] tbl_frf[5].envd_cus_set_cmn[0][9] tbl_frf[5].envd_cus_set_cmn[1][0] tbl_frf[5].envd_cus_set_cmn[1][1] tbl_frf[5].envd_cus_set_cmn[1][2] tbl_frf[5].envd_cus_set_cmn[1][3] tbl_frf[5].envd_cus_set_cmn[1][4] tbl_frf[5].envd_cus_set_cmn[1][5] tbl_frf[5].envd_cus_set_cmn[1][6] tbl_frf[5].envd_cus_set_cmn[1][7] tbl_frf[5].envd_cus_set_cmn[1][8] tbl_frf[5].envd_cus_set_cmn[1][9] tbl_frf[5].envd_cus_set_cmn[2][0] tbl_frf[5].envd_cus_set_cmn[2][1] tbl_frf[5].envd_cus_set_cmn[2][2] tbl_frf[5].envd_cus_set_cmn[2][3] tbl_frf[5].envd_cus_set_cmn[2][4] tbl_frf[5].envd_cus_set_cmn[2][5] tbl_frf[5].envd_cus_set_cmn[2][6] tbl_frf[5].envd_cus_set_cmn[2][7] tbl_frf[5].envd_cus_set_cmn[2][8] tbl_frf[5].envd_cus_set_cmn[2][9] tbl_frf[5].envd_cus_set_spc[0][0] tbl_frf[5].envd_cus_set_spc[0][1] tbl_frf[5].envd_cus_set_spc[0][2] tbl_frf[5].envd_cus_set_spc[0][3] tbl_frf[5].envd_cus_set_spc[1][0] tbl_frf[5].envd_cus_set_spc[1][1] tbl_frf[5].envd_cus_set_spc[1][2] tbl_frf[5].envd_cus_set_spc[1][3] tbl_frf[5].envd_cus_set_spc[2][0] tbl_frf[5].envd_cus_set_spc[2][1] tbl_frf[5].envd_cus_set_spc[2][2] tbl_frf[5].envd_cus_set_spc[2][3] tbl_frf[6].envd_obd[0] tbl_frf[6].envd_obd[1] tbl_frf[6].envd_obd[2] tbl_frf[6].envd_obd[3] tbl_frf[6].envd_obd[4] tbl_frf[6].envd_obd[5] tbl_frf[6].envd_obd[6] tbl_frf[6].envd_obd[7] tbl_frf[6].envd_obd[8] tbl_frf[6].envd_obd[9] tbl_frf[6].envd_obd[10] tbl_frf[6].envd_obd[11] tbl_frf[6].envd_obd[12] tbl_frf[6].envd_obd[13] tbl_frf[6].envd_obd[14] tbl_frf[6].envd_obd[15] tbl_frf[6].envd_obd[16] tbl_frf[6].envd_obd[17] tbl_frf[6].envd_obd[18] tbl_frf[6].envd_obd[19] tbl_frf[6].envd_obd[20] tbl_frf[6].envd_obd[21] tbl_frf[6].envd_obd[22] tbl_frf[6].envd_obd[23] tbl_frf[6].envd_obd[24] tbl_frf[6].envd_obd[25] tbl_frf[6].envd_obd[26] tbl_frf[6].envd_obd[27] tbl_frf[6].envd_obd[28] tbl_frf[6].envd_obd[29] tbl_frf[6].envd_obd[30] tbl_frf[6].envd_obd[31] tbl_frf[6].envd_obd[32] tbl_frf[6].envd_obd[33] tbl_frf[6].envd_obd[34] tbl_frf[6].envd_obd[35] tbl_frf[6].envd_obd[36] tbl_frf[6].envd_obd[37] tbl_frf[6].envd_cus_cmn[0] tbl_frf[6].envd_cus_set_cmn[0][0] tbl_frf[6].envd_cus_set_cmn[0][1] tbl_frf[6].envd_cus_set_cmn[0][2] tbl_frf[6].envd_cus_set_cmn[0][3] tbl_frf[6].envd_cus_set_cmn[0][4] tbl_frf[6].envd_cus_set_cmn[0][5] tbl_frf[6].envd_cus_set_cmn[0][6] tbl_frf[6].envd_cus_set_cmn[0][7] tbl_frf[6].envd_cus_set_cmn[0][8] tbl_frf[6].envd_cus_set_cmn[0][9] tbl_frf[6].envd_cus_set_cmn[1][0] tbl_frf[6].envd_cus_set_cmn[1][1] tbl_frf[6].envd_cus_set_cmn[1][2] tbl_frf[6].envd_cus_set_cmn[1][3] tbl_frf[6].envd_cus_set_cmn[1][4] tbl_frf[6].envd_cus_set_cmn[1][5] tbl_frf[6].envd_cus_set_cmn[1][6] tbl_frf[6].envd_cus_set_cmn[1][7] tbl_frf[6].envd_cus_set_cmn[1][8] tbl_frf[6].envd_cus_set_cmn[1][9] tbl_frf[6].envd_cus_set_cmn[2][0] tbl_frf[6].envd_cus_set_cmn[2][1] tbl_frf[6].envd_cus_set_cmn[2][2] tbl_frf[6].envd_cus_set_cmn[2][3] tbl_frf[6].envd_cus_set_cmn[2][4] tbl_frf[6].envd_cus_set_cmn[2][5] tbl_frf[6].envd_cus_set_cmn[2][6] tbl_frf[6].envd_cus_set_cmn[2][7] tbl_frf[6].envd_cus_set_cmn[2][8] tbl_frf[6].envd_cus_set_cmn[2][9] tbl_frf[6].envd_cus_set_spc[0][0] tbl_frf[6].envd_cus_set_spc[0][1] tbl_frf[6].envd_cus_set_spc[0][2] tbl_frf[6].envd_cus_set_spc[0][3] tbl_frf[6].envd_cus_set_spc[1][0] tbl_frf[6].envd_cus_set_spc[1][1] tbl_frf[6].envd_cus_set_spc[1][2] tbl_frf[6].envd_cus_set_spc[1][3] tbl_frf[6].envd_cus_set_spc[2][0] tbl_frf[6].envd_cus_set_spc[2][1] tbl_frf[6].envd_cus_set_spc[2][2] tbl_frf[6].envd_cus_set_spc[2][3] tbl_frf[7].envd_obd[0] tbl_frf[7].envd_obd[1] tbl_frf[7].envd_obd[2] tbl_frf[7].envd_obd[3] tbl_frf[7].envd_obd[4] tbl_frf[7].envd_obd[5] tbl_frf[7].envd_obd[6] tbl_frf[7].envd_obd[7] tbl_frf[7].envd_obd[8] tbl_frf[7].envd_obd[9] tbl_frf[7].envd_obd[10] tbl_frf[7].envd_obd[11] tbl_frf[7].envd_obd[12] tbl_frf[7].envd_obd[13] tbl_frf[7].envd_obd[14] tbl_frf[7].envd_obd[15] tbl_frf[7].envd_obd[16] tbl_frf[7].envd_obd[17] tbl_frf[7].envd_obd[18] tbl_frf[7].envd_obd[19] tbl_frf[7].envd_obd[20] tbl_frf[7].envd_obd[21] tbl_frf[7].envd_obd[22] tbl_frf[7].envd_obd[23] tbl_frf[7].envd_obd[24] tbl_frf[7].envd_obd[25] tbl_frf[7].envd_obd[26] tbl_frf[7].envd_obd[27] tbl_frf[7].envd_obd[28] tbl_frf[7].envd_obd[29] tbl_frf[7].envd_obd[30] tbl_frf[7].envd_obd[31] tbl_frf[7].envd_obd[32] tbl_frf[7].envd_obd[33] tbl_frf[7].envd_obd[34] tbl_frf[7].envd_obd[35] tbl_frf[7].envd_obd[36] tbl_frf[7].envd_obd[37] tbl_frf[7].envd_cus_cmn[0] tbl_frf[7].envd_cus_set_cmn[0][0] tbl_frf[7].envd_cus_set_cmn[0][1] tbl_frf[7].envd_cus_set_cmn[0][2] tbl_frf[7].envd_cus_set_cmn[0][3] tbl_frf[7].envd_cus_set_cmn[0][4] tbl_frf[7].envd_cus_set_cmn[0][5] tbl_frf[7].envd_cus_set_cmn[0][6] tbl_frf[7].envd_cus_set_cmn[0][7] tbl_frf[7].envd_cus_set_cmn[0][8] tbl_frf[7].envd_cus_set_cmn[0][9] tbl_frf[7].envd_cus_set_cmn[1][0] tbl_frf[7].envd_cus_set_cmn[1][1] tbl_frf[7].envd_cus_set_cmn[1][2] tbl_frf[7].envd_cus_set_cmn[1][3] tbl_frf[7].envd_cus_set_cmn[1][4] tbl_frf[7].envd_cus_set_cmn[1][5] tbl_frf[7].envd_cus_set_cmn[1][6] tbl_frf[7].envd_cus_set_cmn[1][7] tbl_frf[7].envd_cus_set_cmn[1][8] tbl_frf[7].envd_cus_set_cmn[1][9] tbl_frf[7].envd_cus_set_cmn[2][0] tbl_frf[7].envd_cus_set_cmn[2][1] tbl_frf[7].envd_cus_set_cmn[2][2] tbl_frf[7].envd_cus_set_cmn[2][3] tbl_frf[7].envd_cus_set_cmn[2][4] tbl_frf[7].envd_cus_set_cmn[2][5] tbl_frf[7].envd_cus_set_cmn[2][6] tbl_frf[7].envd_cus_set_cmn[2][7] tbl_frf[7].envd_cus_set_cmn[2][8] tbl_frf[7].envd_cus_set_cmn[2][9] tbl_frf[7].envd_cus_set_spc[0][0] tbl_frf[7].envd_cus_set_spc[0][1] tbl_frf[7].envd_cus_set_spc[0][2] tbl_frf[7].envd_cus_set_spc[0][3] tbl_frf[7].envd_cus_set_spc[1][0] tbl_frf[7].envd_cus_set_spc[1][1] tbl_frf[7].envd_cus_set_spc[1][2] tbl_frf[7].envd_cus_set_spc[1][3] tbl_frf[7].envd_cus_set_spc[2][0] tbl_frf[7].envd_cus_set_spc[2][1] tbl_frf[7].envd_cus_set_spc[2][2] tbl_frf[7].envd_cus_set_spc[2][3] tbl_frf[8].envd_obd[0] tbl_frf[8].envd_obd[1] tbl_frf[8].envd_obd[2] tbl_frf[8].envd_obd[3] tbl_frf[8].envd_obd[4] tbl_frf[8].envd_obd[5] tbl_frf[8].envd_obd[6] tbl_frf[8].envd_obd[7] tbl_frf[8].envd_obd[8] tbl_frf[8].envd_obd[9] tbl_frf[8].envd_obd[10] tbl_frf[8].envd_obd[11] tbl_frf[8].envd_obd[12] tbl_frf[8].envd_obd[13] tbl_frf[8].envd_obd[14] tbl_frf[8].envd_obd[15] tbl_frf[8].envd_obd[16] tbl_frf[8].envd_obd[17] tbl_frf[8].envd_obd[18] tbl_frf[8].envd_obd[19] tbl_frf[8].envd_obd[20] tbl_frf[8].envd_obd[21] tbl_frf[8].envd_obd[22] tbl_frf[8].envd_obd[23] tbl_frf[8].envd_obd[24] tbl_frf[8].envd_obd[25] tbl_frf[8].envd_obd[26] tbl_frf[8].envd_obd[27] tbl_frf[8].envd_obd[28] tbl_frf[8].envd_obd[29] tbl_frf[8].envd_obd[30] tbl_frf[8].envd_obd[31] tbl_frf[8].envd_obd[32] tbl_frf[8].envd_obd[33] tbl_frf[8].envd_obd[34] tbl_frf[8].envd_obd[35] tbl_frf[8].envd_obd[36] tbl_frf[8].envd_obd[37] tbl_frf[8].envd_cus_cmn[0] tbl_frf[8].envd_cus_set_cmn[0][0] tbl_frf[8].envd_cus_set_cmn[0][1] tbl_frf[8].envd_cus_set_cmn[0][2] tbl_frf[8].envd_cus_set_cmn[0][3] tbl_frf[8].envd_cus_set_cmn[0][4] tbl_frf[8].envd_cus_set_cmn[0][5] tbl_frf[8].envd_cus_set_cmn[0][6] tbl_frf[8].envd_cus_set_cmn[0][7] tbl_frf[8].envd_cus_set_cmn[0][8] tbl_frf[8].envd_cus_set_cmn[0][9] tbl_frf[8].envd_cus_set_cmn[1][0] tbl_frf[8].envd_cus_set_cmn[1][1] tbl_frf[8].envd_cus_set_cmn[1][2] tbl_frf[8].envd_cus_set_cmn[1][3] tbl_frf[8].envd_cus_set_cmn[1][4] tbl_frf[8].envd_cus_set_cmn[1][5] tbl_frf[8].envd_cus_set_cmn[1][6] tbl_frf[8].envd_cus_set_cmn[1][7] tbl_frf[8].envd_cus_set_cmn[1][8] tbl_frf[8].envd_cus_set_cmn[1][9] tbl_frf[8].envd_cus_set_cmn[2][0] tbl_frf[8].envd_cus_set_cmn[2][1] tbl_frf[8].envd_cus_set_cmn[2][2] tbl_frf[8].envd_cus_set_cmn[2][3] tbl_frf[8].envd_cus_set_cmn[2][4] tbl_frf[8].envd_cus_set_cmn[2][5] tbl_frf[8].envd_cus_set_cmn[2][6] tbl_frf[8].envd_cus_set_cmn[2][7] tbl_frf[8].envd_cus_set_cmn[2][8] tbl_frf[8].envd_cus_set_cmn[2][9] tbl_frf[8].envd_cus_set_spc[0][0] tbl_frf[8].envd_cus_set_spc[0][1] tbl_frf[8].envd_cus_set_spc[0][2] tbl_frf[8].envd_cus_set_spc[0][3] tbl_frf[8].envd_cus_set_spc[1][0] tbl_frf[8].envd_cus_set_spc[1][1] tbl_frf[8].envd_cus_set_spc[1][2] tbl_frf[8].envd_cus_set_spc[1][3] tbl_frf[8].envd_cus_set_spc[2][0] tbl_frf[8].envd_cus_set_spc[2][1] tbl_frf[8].envd_cus_set_spc[2][2] tbl_frf[8].envd_cus_set_spc[2][3] tbl_frf[9].envd_obd[0] tbl_frf[9].envd_obd[1] tbl_frf[9].envd_obd[2] tbl_frf[9].envd_obd[3] tbl_frf[9].envd_obd[4] tbl_frf[9].envd_obd[5] tbl_frf[9].envd_obd[6] tbl_frf[9].envd_obd[7] tbl_frf[9].envd_obd[8] tbl_frf[9].envd_obd[9] tbl_frf[9].envd_obd[10] tbl_frf[9].envd_obd[11] tbl_frf[9].envd_obd[12] tbl_frf[9].envd_obd[13] tbl_frf[9].envd_obd[14] tbl_frf[9].envd_obd[15] tbl_frf[9].envd_obd[16] tbl_frf[9].envd_obd[17] tbl_frf[9].envd_obd[18] tbl_frf[9].envd_obd[19] tbl_frf[9].envd_obd[20] tbl_frf[9].envd_obd[21] tbl_frf[9].envd_obd[22] tbl_frf[9].envd_obd[23] tbl_frf[9].envd_obd[24] tbl_frf[9].envd_obd[25] tbl_frf[9].envd_obd[26] tbl_frf[9].envd_obd[27] tbl_frf[9].envd_obd[28] tbl_frf[9].envd_obd[29] tbl_frf[9].envd_obd[30] tbl_frf[9].envd_obd[31] tbl_frf[9].envd_obd[32] tbl_frf[9].envd_obd[33] tbl_frf[9].envd_obd[34] tbl_frf[9].envd_obd[35] tbl_frf[9].envd_obd[36] tbl_frf[9].envd_obd[37] tbl_frf[9].envd_cus_cmn[0] tbl_frf[9].envd_cus_set_cmn[0][0] tbl_frf[9].envd_cus_set_cmn[0][1] tbl_frf[9].envd_cus_set_cmn[0][2] tbl_frf[9].envd_cus_set_cmn[0][3] tbl_frf[9].envd_cus_set_cmn[0][4] tbl_frf[9].envd_cus_set_cmn[0][5] tbl_frf[9].envd_cus_set_cmn[0][6] tbl_frf[9].envd_cus_set_cmn[0][7] tbl_frf[9].envd_cus_set_cmn[0][8] tbl_frf[9].envd_cus_set_cmn[0][9] tbl_frf[9].envd_cus_set_cmn[1][0] tbl_frf[9].envd_cus_set_cmn[1][1] tbl_frf[9].envd_cus_set_cmn[1][2] tbl_frf[9].envd_cus_set_cmn[1][3] tbl_frf[9].envd_cus_set_cmn[1][4] tbl_frf[9].envd_cus_set_cmn[1][5] tbl_frf[9].envd_cus_set_cmn[1][6] tbl_frf[9].envd_cus_set_cmn[1][7] tbl_frf[9].envd_cus_set_cmn[1][8] tbl_frf[9].envd_cus_set_cmn[1][9] tbl_frf[9].envd_cus_set_cmn[2][0] tbl_frf[9].envd_cus_set_cmn[2][1] tbl_frf[9].envd_cus_set_cmn[2][2] tbl_frf[9].envd_cus_set_cmn[2][3] tbl_frf[9].envd_cus_set_cmn[2][4] tbl_frf[9].envd_cus_set_cmn[2][5] tbl_frf[9].envd_cus_set_cmn[2][6] tbl_frf[9].envd_cus_set_cmn[2][7] tbl_frf[9].envd_cus_set_cmn[2][8] tbl_frf[9].envd_cus_set_cmn[2][9] tbl_frf[9].envd_cus_set_spc[0][0] tbl_frf[9].envd_cus_set_spc[0][1] tbl_frf[9].envd_cus_set_spc[0][2] tbl_frf[9].envd_cus_set_spc[0][3] tbl_frf[9].envd_cus_set_spc[1][0] tbl_frf[9].envd_cus_set_spc[1][1] tbl_frf[9].envd_cus_set_spc[1][2] tbl_frf[9].envd_cus_set_spc[1][3] tbl_frf[9].envd_cus_set_spc[2][0] tbl_frf[9].envd_cus_set_spc[2][1] tbl_frf[9].envd_cus_set_spc[2][2] tbl_frf[9].envd_cus_set_spc[2][3] /end OUT_MEASUREMENT
/end FUNCTION
/end MODULE
/end PROJECT
