ASAP2_VERSION 1 41
/begin PROJECT MSD85 "Spray Guided DI-System with Piezo Injectors for 8-Cylinder"
/begin HEADER "_default_HeaderComment" PROJECT_NO _91 /end HEADER
/begin MODULE _default_ModuleName "_default_ModuleLongIdentifier"
/begin MOD_COMMON "_default_ModCommonComment" DEPOSIT ABSOLUTE BYTE_ORDER MSB_LAST ALIGNMENT_BYTE 1 ALIGNMENT_WORD 2 ALIGNMENT_LONG 2 ALIGNMENT_FLOAT32_IEEE 2 ALIGNMENT_FLOAT64_IEEE 4 /end MOD_COMMON
/begin MEASUREMENT iga_dif_bas_crk_cyl_lam "Difference between basic ignition angle stored during calibration of IP_CRK_SYN and actual value" SWORD _CNV_A_R_LINEAR_____134_CM 1 100. -180. 179.9375 DISPLAY_IDENTIFIER IGA_DIF_BAS_CRK_CYL_LAM ECU_ADDRESS 0xd0000890 FORMAT "%7.3" /end MEASUREMENT
/begin MEASUREMENT cycnr_puc "" UWORD _CNV_A_R_LINEAR_____0_CM 1 100. 0. 65535. DISPLAY_IDENTIFIER CYCNR_PUC ECU_ADDRESS 0xd0000b4c FORMAT "%5.0" /end MEASUREMENT
/begin MEASUREMENT n_hys_puc "" UBYTE _CNV_A_R_LINEAR_____10_CM 1 100. 0. 8160. DISPLAY_IDENTIFIER N_HYS_PUC ECU_ADDRESS 0xd0000b54 FORMAT "%4.0" /end MEASUREMENT
/begin MEASUREMENT n_min_puc "" UBYTE _CNV_A_R_LINEAR_____10_CM 1 100. 0. 8160. DISPLAY_IDENTIFIER N_MIN_PUC ECU_ADDRESS 0xd0008c11 FORMAT "%4.0" /end MEASUREMENT
/begin MEASUREMENT n_hys_min_puc "Minimum engine speed hystersis for LV_PUC" UBYTE _CNV_A_R_LINEAR_____10_CM 1 100. 0. 8160. DISPLAY_IDENTIFIER N_HYS_MIN_PUC ECU_ADDRESS 0xd0000b55 FORMAT "%4.0" /end MEASUREMENT
/begin MEASUREMENT n_hys_act_puc "Actual effective engine speed hystersis for LV_PUC" UBYTE _CNV_A_R_LINEAR_____10_CM 1 100. 0. 8160. DISPLAY_IDENTIFIER N_HYS_ACT_PUC ECU_ADDRESS 0xd0000b56 FORMAT "%4.0" /end MEASUREMENT
/begin MEASUREMENT lv_diagcps_min_mod "Indication EVAC sent into MIN_PURGE by FC CPS" UBYTE _CNV_S_2_RANGE__0___1_CM 1 100. 0. 1. DISPLAY_IDENTIFIER LV_DIAGCPS_MIN_MOD ECU_ADDRESS 0xd0008611 /end MEASUREMENT
/begin MEASUREMENT lv_eol_cps_ini "LV indicating EOL-requested functional check CPS " UBYTE _CNV_S_2_RANGE__0___1_CM 1 100. 0. 1. DISPLAY_IDENTIFIER LV_EOL_CPS_INI ECU_ADDRESS 0xd0008612 /end MEASUREMENT
/begin MEASUREMENT lv_opm_av_cng_diagcps "LV indicating change of operation mode " UBYTE _CNV_S_2_RANGE__0___1_CM 1 100. 0. 1. DISPLAY_IDENTIFIER LV_OPM_AV_CNG_DIAGCPS ECU_ADDRESS 0xd0008613 /end MEASUREMENT
/begin MEASUREMENT t_diagcps_dly_1_rbm "Delay time step 2 (RBM) - functional check CPS" UBYTE _CNV_A_R_LINEAR_____4_CM 1 100. 0.1 25.5 DISPLAY_IDENTIFIER T_DIAGCPS_DLY_1_RBM ECU_ADDRESS 0xd0000c7a FORMAT "%4.1" /end MEASUREMENT
/begin MEASUREMENT t_diagcps_dly_2_rbm "Delay time step 3 (RBM) - functional check CPS" UBYTE _CNV_A_R_LINEAR_____4_CM 1 100. 0.1 25.5 DISPLAY_IDENTIFIER T_DIAGCPS_DLY_2_RBM ECU_ADDRESS 0xd0000c7b FORMAT "%4.1" /end MEASUREMENT
/begin MEASUREMENT t_diagcps_maf_rbm "Time for active FLOW_SP offset  step 3 (RBM) - functional check CPS" UBYTE _CNV_A_R_LINEAR_____4_CM 1 100. 0.1 25.5 DISPLAY_IDENTIFIER T_DIAGCPS_MAF_RBM ECU_ADDRESS 0xd0000c7c FORMAT "%4.1" /end MEASUREMENT
/begin MEASUREMENT lv_t_diagcps_rbm "Auxiliary bit timer for RBM - functional check CPS" UBYTE _CNV_S_2_RANGE__0___1_CM 1 100. 0. 1. DISPLAY_IDENTIFIER LV_T_DIAGCPS_RBM ECU_ADDRESS 0xd0000c87 /end MEASUREMENT
/begin MEASUREMENT t_diagcps_n_map_1_rbm "time interval for N-DIF-Diagnosis step 2 (RBM) - functional check CPS" UWORD _CNV_A_R_LINEAR_____4_CM 1 100. 0.1 6553.5 DISPLAY_IDENTIFIER T_DIAGCPS_N_MAP_1_RBM ECU_ADDRESS 0xd0000c68 FORMAT "%6.1" /end MEASUREMENT
/begin MEASUREMENT lv_n_can_err "Indicating LV_ERR_CRK for bus communication" UBYTE _CNV_S_2_RANGE__0___1_CM 1 100. 0. 1. DISPLAY_IDENTIFIER LV_N_CAN_ERR ECU_ADDRESS 0xd0008573 /end MEASUREMENT
/begin MEASUREMENT lv_fmy_exit_st "" UBYTE _CNV_S_2_RANGE__0___1_CM 1 100. 0. 1. DISPLAY_IDENTIFIER LV_FMY_EXIT_ST ECU_ADDRESS 0xd0008b7e BIT_MASK 0x1 /end MEASUREMENT
/begin MEASUREMENT nt_eff_cor_rpu "RPU value of NT_EFF_COR_RPU" UBYTE _CNV_A_R_LINEAR_____243_CM 1 100. 0. 3.984375 DISPLAY_IDENTIFIER NT_EFF_COR_RPU ECU_ADDRESS 0xd0008b80 FORMAT "%4.2" /end MEASUREMENT
/begin MEASUREMENT nt_stc_bas_rpu "RPU value of NT_STC_BAS" UWORD _CNV_A_R_LINEAR_____244_CM 1 100. 0. 10485.6 DISPLAY_IDENTIFIER NT_STC_BAS_RPU ECU_ADDRESS 0xd000a732 FORMAT "%7.1" /end MEASUREMENT
/begin MEASUREMENT ntl_rpu "RPU value of NTL_RPU" UWORD _CNV_A_R_LINEAR_____244_CM 1 100. 0. 10485.6 DISPLAY_IDENTIFIER NTL_RPU ECU_ADDRESS 0xd000a734 FORMAT "%7.1" /end MEASUREMENT
/begin MEASUREMENT lv_rgn_nt_req_rpu "RPU value of LV_RGN_NT_REQ" UBYTE _CNV_S_2_RANGE__0___1_CM 1 100. 0. 1. DISPLAY_IDENTIFIER LV_RGN_NT_REQ_RPU ECU_ADDRESS 0xd0008b82 BIT_MASK 0x1 /end MEASUREMENT
/begin MEASUREMENT lv_act_int_puc_afl_rpu_1 "RPU value of  LV_ACT_INT_PUC_AFL_1" UBYTE _CNV_S_2_RANGE__0___1_CM 1 100. 0. 1. DISPLAY_IDENTIFIER LV_ACT_INT_PUC_AFL_RPU_1 ECU_ADDRESS 0xd0008b84 BIT_MASK 0x1 /end MEASUREMENT
/begin MEASUREMENT lv_act_int_puc_afl_rpu_2 "RPU value of  LV_ACT_INT_PUC_AFL_2" UBYTE _CNV_S_2_RANGE__0___1_CM 1 100. 0. 1. DISPLAY_IDENTIFIER LV_ACT_INT_PUC_AFL_RPU_2 ECU_ADDRESS 0xd0008b87 BIT_MASK 0x1 /end MEASUREMENT
/begin MEASUREMENT lv_rgn_agi_rpu_1 "RPU value of  LV_RGN_AGI_1" UBYTE _CNV_S_2_RANGE__0___1_CM 1 100. 0. 1. DISPLAY_IDENTIFIER LV_RGN_AGI_RPU_1 ECU_ADDRESS 0xd0008b85 BIT_MASK 0x1 /end MEASUREMENT
/begin MEASUREMENT lv_rgn_agi_rpu_2 "RPU value of  LV_RGN_AGI_2" UBYTE _CNV_S_2_RANGE__0___1_CM 1 100. 0. 1. DISPLAY_IDENTIFIER LV_RGN_AGI_RPU_2 ECU_ADDRESS 0xd0008b88 BIT_MASK 0x1 /end MEASUREMENT
/begin MEASUREMENT lv_sens_afr_rpu_1 "RPU value of  LV_SENS_AFR_1" UBYTE _CNV_S_2_RANGE__0___1_CM 1 100. 0. 1. DISPLAY_IDENTIFIER LV_SENS_AFR_RPU_1 ECU_ADDRESS 0xd0008b86 BIT_MASK 0x1 /end MEASUREMENT
/begin MEASUREMENT lv_sens_afr_rpu_2 "RPU value of  LV_SENS_AFR_2" UBYTE _CNV_S_2_RANGE__0___1_CM 1 100. 0. 1. DISPLAY_IDENTIFIER LV_SENS_AFR_RPU_2 ECU_ADDRESS 0xd0008b89 BIT_MASK 0x1 /end MEASUREMENT
/begin MEASUREMENT lv_nt_afs_req_rpu "RPU value of LV_NT_AFS_REQ" UBYTE _CNV_S_2_RANGE__0___1_CM 1 100. 0. 1. DISPLAY_IDENTIFIER LV_NT_AFS_REQ_RPU ECU_ADDRESS 0xd0008b83 BIT_MASK 0x1 /end MEASUREMENT
/begin MEASUREMENT state_nox_rpu "RPU value of STATE_NOX" UBYTE _CNV_S_6_STATE_NOX__245_CM 1 100. 0. 5. DISPLAY_IDENTIFIER STATE_NOX_RPU ECU_ADDRESS 0xd0008b81 /end MEASUREMENT
/begin MEASUREMENT toil_max_warn "max. TOIL at last warning threshold 1" UBYTE _CNV_A_R_LINEAR_____26_CM 1 100. -40. 160. DISPLAY_IDENTIFIER TOIL_MAX_WARN ECU_ADDRESS 0xd000a692 FORMAT "%3.0" /end MEASUREMENT
/begin MEASUREMENT vs_toil_max "VS at last warning threshold 1" UBYTE _CNV_A_R_LINEAR_____6_CM 1 100. 0. 255. DISPLAY_IDENTIFIER VS_TOIL_MAX ECU_ADDRESS 0xd000a693 FORMAT "%3.0" /end MEASUREMENT
/begin MEASUREMENT n_toil_max "N at last warning threshold 1" UWORD _CNV_A_R_LINEAR_____14_CM 1 100. 0. 8160. DISPLAY_IDENTIFIER N_TOIL_MAX ECU_ADDRESS 0xd000a68c FORMAT "%4.0" /end MEASUREMENT
/begin MEASUREMENT gear_toil_max "GEAR at last warning threshold 1" UBYTE _CNV_A_R_LINEAR_____0_CM 1 100. 0. 255. DISPLAY_IDENTIFIER GEAR_TOIL_MAX ECU_ADDRESS 0xd000a694 FORMAT "%3.0" /end MEASUREMENT
/begin MEASUREMENT tqi_av_toil_max "indicated engine torque at last warning threshold 1" SWORD _CNV_A_R_LINEAR_____31_CM 1 100. -1024. 1023.96875 DISPLAY_IDENTIFIER TQI_AV_TOIL_MAX ECU_ADDRESS 0xd000a690 FORMAT "%8.2" /end MEASUREMENT
/begin MEASUREMENT tco_toil_max "Coolant temperature at last warning threshold 1" UBYTE _CNV_A_R_LINEAR_____17_CM 1 100. -48. 142.5 DISPLAY_IDENTIFIER TCO_TOIL_MAX ECU_ADDRESS 0xd000a696 FORMAT "%5.1" /end MEASUREMENT
/begin MEASUREMENT tam_toil_max "Ambient temperature at last warning threshold 1" UBYTE _CNV_A_R_LINEAR_____17_CM 1 100. -48. 142.5 DISPLAY_IDENTIFIER TAM_TOIL_MAX ECU_ADDRESS 0xd000a695 FORMAT "%5.1" /end MEASUREMENT
/begin MEASUREMENT ctr_toil_max "event frequency counter" UBYTE _CNV_A_R_LINEAR_____0_CM 1 100. 0. 255. DISPLAY_IDENTIFIER CTR_TOIL_MAX ECU_ADDRESS 0xd000a697 FORMAT "%3.0" /end MEASUREMENT
/begin MEASUREMENT pv_av_toil_max "PV_AV  at last warning threshold 1" UBYTE _CNV_A_R_LINEAR_____5_CM 1 100. 0. 99.609375 DISPLAY_IDENTIFIER PV_AV_TOIL_MAX ECU_ADDRESS 0xd000a698 FORMAT "%4.1" /end MEASUREMENT
/begin MEASUREMENT lv_cs_toil_max "clutch switch detection at last warning threshold 1" UBYTE _CNV_S_2_RANGE______76_CM 1 100. 0. 1. DISPLAY_IDENTIFIER LV_CS_TOIL_MAX ECU_ADDRESS 0xd0008a18 BIT_MASK 0x1 /end MEASUREMENT
/begin MEASUREMENT toil_thd_toil_max "warning threshold 1" UBYTE _CNV_A_R_LINEAR_____26_CM 1 100. -40. 160. DISPLAY_IDENTIFIER TOIL_THD_TOIL_MAX ECU_ADDRESS 0xd000a699 FORMAT "%3.0" /end MEASUREMENT
/begin MEASUREMENT dist_toil_max "mileage at last warning threshold 1" UWORD _CNV_A_R_LINEAR_____255_CM 1 100. 0. 524280. DISPLAY_IDENTIFIER DIST_TOIL_MAX ECU_ADDRESS 0xd000a68e FORMAT "%8.3" /end MEASUREMENT
/begin MEASUREMENT lv_toil_thd_warn_1 "TOIL > warning threshold 1" UBYTE _CNV_S_2_RANGE______76_CM 1 100. 0. 1. DISPLAY_IDENTIFIER LV_TOIL_THD_WARN_1 ECU_ADDRESS 0xd0008a19 BIT_MASK 0x1 /end MEASUREMENT
/begin MEASUREMENT lv_toil_thd_warn_2 "TOIL > warning threshold 2" UBYTE _CNV_S_2_RANGE______76_CM 1 100. 0. 1. DISPLAY_IDENTIFIER LV_TOIL_THD_WARN_2 ECU_ADDRESS 0xd0008a1a BIT_MASK 0x1 /end MEASUREMENT
/begin MEASUREMENT n_ratio_conv "" UBYTE _CNV_A_R_LINEAR_____28_CM 1 100. 0. 0.99609375 DISPLAY_IDENTIFIER N_RATIO_CONV ECU_ADDRESS 0xd0001767 FORMAT "%4.3" /end MEASUREMENT
/begin MEASUREMENT lv_inh_bal_cus "CILC and CYBL inhibt by external request" UBYTE _CNV_S_2_RANGE__0___1_CM 1 100. 0. 1. DISPLAY_IDENTIFIER LV_INH_BAL_CUS ECU_ADDRESS 0xd00086bc BIT_MASK 0x1 /end MEASUREMENT
/begin MEASUREMENT cdn_diag_el_cps "Diagnosis condition for failure el_cps" UBYTE _CNV_A_R_LINEAR_____0_CM 1 100. 0. 7. DISPLAY_IDENTIFIER CDN_DIAG_EL_CPS ECU_ADDRESS 0xd0002934 FORMAT "%3.0" /end MEASUREMENT
/begin MEASUREMENT lv_inh_diag_seg_ad_er "Specific conditions to inhibate Engine roughness segment adaptive values diagnosis" UBYTE _CNV_S_2_RANGE__0___1_CM 1 100. 0. 1. DISPLAY_IDENTIFIER LV_INH_DIAG_SEG_AD_ER ECU_ADDRESS 0xd0007485 BIT_MASK 0x1 /end MEASUREMENT
/begin MEASUREMENT lv_inh_diag_t_seg_er "Specific conditions to inhibate Engine roughness segment time acquisition diagnosis" UBYTE _CNV_S_2_RANGE__0___1_CM 1 100. 0. 1. DISPLAY_IDENTIFIER LV_INH_DIAG_T_SEG_ER ECU_ADDRESS 0xd0007486 BIT_MASK 0x1 /end MEASUREMENT
/begin MEASUREMENT vs_rr_edge_t_av_max "" ULONG _CNV_A_R_LINEAR_____273_CM 1 100. 0. 34359738.36 DISPLAY_IDENTIFIER VS_RR_EDGE_T_AV_MAX ECU_ADDRESS 0xd0003648 FORMAT "%12.3" /end MEASUREMENT
/begin MEASUREMENT poil_sp_ext_adj "adjustment value for Oilpressure setpoint" UBYTE _CNV_A_R_LINEAR_____424_CM 1 100. 0. 8160. DISPLAY_IDENTIFIER POIL_SP_EXT_ADJ ECU_ADDRESS 0xd0009009 FORMAT "%4.0" /end MEASUREMENT
/begin MEASUREMENT poil_pwm_ext_adj "adjustment value for Oilpressure solenoid setpoint" UBYTE _CNV_A_R_LINEAR_____5_CM 1 100. 0. 99.609375 DISPLAY_IDENTIFIER POIL_PWM_EXT_ADJ ECU_ADDRESS 0xd0009021 FORMAT "%4.1" /end MEASUREMENT
/begin MEASUREMENT tps_ext_adj "Throttle angle setpoint requested by service tool" UWORD _CNV_A_R_LINEAR_____227_CM 1 100. 0. 119.5 DISPLAY_IDENTIFIER TPS_EXT_ADJ ECU_ADDRESS 0xd000ac5e FORMAT "%7.3" /end MEASUREMENT
/begin MEASUREMENT state_egy_min_kwp "state of FeTraWe / 01= Fertigung 02 = Transport 03 = Werkstatt" UBYTE _CNV_S_4_RANGE_STAT_429_CM 1 100. 0. 3. DISPLAY_IDENTIFIER STATE_EGY_MIN_KWP ECU_ADDRESS 0xd0008ffb /end MEASUREMENT
/begin MEASUREMENT ctr_err_dyn_nr_obd "Number of failures stored in dynamic memory (2 nd layer) with error class >=10h" UBYTE _CNV_A_R_LINEAR_____0_CM 1 100. 0. 255. DISPLAY_IDENTIFIER CTR_ERR_DYN_NR_OBD ECU_ADDRESS 0xd0001c50 FORMAT "%3.0" /end MEASUREMENT
/begin MEASUREMENT inh_iv_kwp "Shut off  request for cylinder x ------1=enabled / 0=disabledBit0=cylinder 0 (log)  Bit1=cylinder 1 (log)Bit2=cylinder 2 (log)Bit3=cylinder 3 (log)Bit4=cylinder 4 (log)Bit5=cylinder 5 (log)" UBYTE _CNV_A_R_LINEAR_____0_CM 1 100. 0. 63. DISPLAY_IDENTIFIER INH_IV_KWP ECU_ADDRESS 0xd0009074 FORMAT "%2.0" /end MEASUREMENT
/begin MEASUREMENT state_iv_chg "Bit coded state indicating wether injection valve was changed - 1 on bit position x indicates injector change for logical cylinder x" UWORD _CNV_A_R_LINEAR_____0_CM 1 100. 0. 65535. DISPLAY_IDENTIFIER STATE_IV_CHG ECU_ADDRESS 0xd000ac8c FORMAT "%5.0" /end MEASUREMENT
/begin MEASUREMENT cyl_id_sam_trig "" UBYTE _CNV_A_R_LINEAR_____397_CM 1 100. 1. 4. DISPLAY_IDENTIFIER CYL_ID_SAM_TRIG ECU_ADDRESS 0xd0008faa FORMAT "%1.0" /end MEASUREMENT
/begin MEASUREMENT lv_err_load_tps_plaus "Error Flag for LOAD_TPS_PLAUS error" UBYTE _CNV_S_2_RANGE__0___1_CM 1 100. 0. 1. DISPLAY_IDENTIFIER LV_ERR_LOAD_TPS_PLAUS ECU_ADDRESS 0xd0007fb7 BIT_MASK 0x1 /end MEASUREMENT
/begin MEASUREMENT lv_err_map_dip_plaus "Error Flag for map_dip_plaus error" UBYTE _CNV_S_2_RANGE__0___1_CM 1 100. 0. 1. DISPLAY_IDENTIFIER LV_ERR_MAP_DIP_PLAUS ECU_ADDRESS 0xd0007f46 BIT_MASK 0x1 /end MEASUREMENT
/begin MEASUREMENT lv_err_alter_bn_rgn "Error Flag for alter_bn_rgn error" UBYTE _CNV_S_2_RANGE__0___1_CM 1 100. 0. 1. DISPLAY_IDENTIFIER LV_ERR_ALTER_BN_RGN ECU_ADDRESS 0xd0007f48 BIT_MASK 0x1 /end MEASUREMENT
/begin MEASUREMENT lv_inh_diag_rbm_mec_ivvt_ex "Flag set if IVVT diagnosis is inhibitied due to present OBD error" UBYTE _CNV_S_2_RANGE__0___1_CM 1 100. 0. 1. DISPLAY_IDENTIFIER LV_INH_DIAG_RBM_MEC_IVVT_EX ECU_ADDRESS 0xd00026e9 BIT_MASK 0x1 /end MEASUREMENT
/begin MEASUREMENT lv_eol_obd_dc "" UBYTE _CNV_S_2_RANGE__0___1_CM 1 100. 0. 1. DISPLAY_IDENTIFIER LV_EOL_OBD_DC ECU_ADDRESS 0xd000869f BIT_MASK 0x1 /end MEASUREMENT
/begin MEASUREMENT state_rbm_mec_ivvt_ex "Interface of MEC_IVVT_EX monitor with the Rate-Based Monitoring statistics" UBYTE _CNV_A_R_LINEAR_____0_CM 1 100. 0. 7. DISPLAY_IDENTIFIER STATE_RBM_MEC_IVVT_EX ECU_ADDRESS 0xd000869a FORMAT "%1.0" /end MEASUREMENT
/begin MEASUREMENT lv_inh_diag_rbm_mec_ivvt_in[0] "flag set if ivvt diagnosis is inhibitied due to present OBD error" UBYTE _CNV_S_2_RANGE__0___1_CM 1 100. 0. 1. DISPLAY_IDENTIFIER LV_INH_DIAG_RBM_MEC_IVVT_IN[0] ECU_ADDRESS 0xd00026e4 BIT_MASK 0x1 /end MEASUREMENT
/begin MEASUREMENT lv_inh_diag_rbm_mec_ivvt_in[1] "flag set if ivvt diagnosis is inhibitied due to present OBD error" UBYTE _CNV_S_2_RANGE__0___1_CM 1 100. 0. 1. DISPLAY_IDENTIFIER LV_INH_DIAG_RBM_MEC_IVVT_IN[1] ECU_ADDRESS 0xd00026e5 BIT_MASK 0x1 /end MEASUREMENT
/begin MEASUREMENT lv_inh_diag_rbm_map_dip_plaus "flag set if MAP_DIP_PLAUS diagnosis is inhibitied due to present OBD error" UBYTE _CNV_S_2_RANGE__0___1_CM 1 100. 0. 1. DISPLAY_IDENTIFIER LV_INH_DIAG_RBM_MAP_DIP_PLAUS ECU_ADDRESS 0xd00026ec BIT_MASK 0x1 /end MEASUREMENT
/begin MEASUREMENT lv_inh_diag_rbm_load_tps_plaus "flag set if LOAD_TPS_PLAUS diagnosis is inhibitied due to present OBD error" UBYTE _CNV_S_2_RANGE__0___1_CM 1 100. 0. 1. DISPLAY_IDENTIFIER LV_INH_DIAG_RBM_LOAD_TPS_PLAUS ECU_ADDRESS 0xd00026ef BIT_MASK 0x1 /end MEASUREMENT
/begin MEASUREMENT state_rbm_mec_ivvt_in[0] "Interface of MEC_IVVT_IN monitor with the Rate-Based Monitoring statistics" UBYTE _CNV_A_R_LINEAR_____0_CM 1 100. 0. 7. DISPLAY_IDENTIFIER STATE_RBM_MEC_IVVT_IN[0] ECU_ADDRESS 0xd0008698 FORMAT "%1.0" /end MEASUREMENT
/begin MEASUREMENT state_rbm_mec_ivvt_in[1] "Interface of MEC_IVVT_IN monitor with the Rate-Based Monitoring statistics" UBYTE _CNV_A_R_LINEAR_____0_CM 1 100. 0. 7. DISPLAY_IDENTIFIER STATE_RBM_MEC_IVVT_IN[1] ECU_ADDRESS 0xd0008699 FORMAT "%1.0" /end MEASUREMENT
/begin MEASUREMENT state_rbm_map_dip_plaus "Interface of MAP_DIP_PLAUS monitor with the Rate-Based Monitoring statistics" UBYTE _CNV_A_R_LINEAR_____0_CM 1 100. 0. 7. DISPLAY_IDENTIFIER STATE_RBM_MAP_DIP_PLAUS ECU_ADDRESS 0xd000869b FORMAT "%1.0" /end MEASUREMENT
/begin MEASUREMENT state_rbm_load_tps_plaus "Interface of LOAD_TPS_PLAUS monitor with the Rate-Based Monitoring statistics" UBYTE _CNV_A_R_LINEAR_____0_CM 1 100. 0. 7. DISPLAY_IDENTIFIER STATE_RBM_LOAD_TPS_PLAUS ECU_ADDRESS 0xd000869c FORMAT "%1.0" /end MEASUREMENT
/begin MEASUREMENT lv_end_rbm_mec_ivvt_ex "flag set if ivvt diagnosis cycle RBM is finished" UBYTE _CNV_S_2_RANGE__0___1_CM 1 100. 0. 1. DISPLAY_IDENTIFIER LV_END_RBM_MEC_IVVT_EX ECU_ADDRESS 0xd00026e8 BIT_MASK 0x1 /end MEASUREMENT
/begin MEASUREMENT lv_end_rbm_mec_ivvt_in[0] "flag set if ivvt diagnosis cycle RBM is finished" UBYTE _CNV_S_2_RANGE__0___1_CM 1 100. 0. 1. DISPLAY_IDENTIFIER LV_END_RBM_MEC_IVVT_IN[0] ECU_ADDRESS 0xd00026e2 BIT_MASK 0x1 /end MEASUREMENT
/begin MEASUREMENT lv_end_rbm_mec_ivvt_in[1] "flag set if ivvt diagnosis cycle RBM is finished" UBYTE _CNV_S_2_RANGE__0___1_CM 1 100. 0. 1. DISPLAY_IDENTIFIER LV_END_RBM_MEC_IVVT_IN[1] ECU_ADDRESS 0xd00026e3 BIT_MASK 0x1 /end MEASUREMENT
/begin MEASUREMENT lv_end_rbm_map_dip_plaus "flag set if map_dip_plaus diagnosis cycle RBM is finished" UBYTE _CNV_S_2_RANGE__0___1_CM 1 100. 0. 1. DISPLAY_IDENTIFIER LV_END_RBM_MAP_DIP_PLAUS ECU_ADDRESS 0xd00026eb BIT_MASK 0x1 /end MEASUREMENT
/begin MEASUREMENT lv_end_rbm_load_tps_plaus "flag set if load_tps_plaus diagnosis cycle RBM is finished" UBYTE _CNV_S_2_RANGE__0___1_CM 1 100. 0. 1. DISPLAY_IDENTIFIER LV_END_RBM_LOAD_TPS_PLAUS ECU_ADDRESS 0xd00026ee BIT_MASK 0x1 /end MEASUREMENT
/begin MEASUREMENT lv_cdn_rbm_mec_ivvt_ex "flag set if ivvt diagnosis condition RBM is fulfilled" UBYTE _CNV_S_2_RANGE__0___1_CM 1 100. 0. 1. DISPLAY_IDENTIFIER LV_CDN_RBM_MEC_IVVT_EX ECU_ADDRESS 0xd00026ea BIT_MASK 0x1 /end MEASUREMENT
/begin MEASUREMENT lv_cdn_rbm_mec_ivvt_in[0] "flag set if ivvt diagnosis condition RBM is fulfilled" UBYTE _CNV_S_2_RANGE__0___1_CM 1 100. 0. 1. DISPLAY_IDENTIFIER LV_CDN_RBM_MEC_IVVT_IN[0] ECU_ADDRESS 0xd00026e6 BIT_MASK 0x1 /end MEASUREMENT
/begin MEASUREMENT lv_cdn_rbm_mec_ivvt_in[1] "flag set if ivvt diagnosis condition RBM is fulfilled" UBYTE _CNV_S_2_RANGE__0___1_CM 1 100. 0. 1. DISPLAY_IDENTIFIER LV_CDN_RBM_MEC_IVVT_IN[1] ECU_ADDRESS 0xd00026e7 BIT_MASK 0x1 /end MEASUREMENT
/begin MEASUREMENT lv_cdn_rbm_map_dip_plaus "flag set if map_dip_plaus diagnosis condition RBM is fulfilled" UBYTE _CNV_S_2_RANGE__0___1_CM 1 100. 0. 1. DISPLAY_IDENTIFIER LV_CDN_RBM_MAP_DIP_PLAUS ECU_ADDRESS 0xd00026ed BIT_MASK 0x1 /end MEASUREMENT
/begin MEASUREMENT lv_cdn_rbm_load_tps_plaus "flag set if load_tps_plaus diagnosis condition RBM is fulfilled" UBYTE _CNV_S_2_RANGE__0___1_CM 1 100. 0. 1. DISPLAY_IDENTIFIER LV_CDN_RBM_LOAD_TPS_PLAUS ECU_ADDRESS 0xd00026f0 BIT_MASK 0x1 /end MEASUREMENT
/begin MEASUREMENT state_rbm_tq_cst "Interface of TQ_CST monitor with the Rate-Based Monitoring statistics" UBYTE _CNV_A_R_LINEAR_____0_CM 1 100. 0. 7. DISPLAY_IDENTIFIER STATE_RBM_TQ_CST ECU_ADDRESS 0xd000869d FORMAT "%1.0" /end MEASUREMENT
/begin MEASUREMENT lv_err_amp_plaus_cus "Boolean for error currently present on AMP plausibility diagnosis" UBYTE _CNV_S_2_RANGE__0___1_CM 1 100. 0. 1. DISPLAY_IDENTIFIER LV_ERR_AMP_PLAUS_CUS ECU_ADDRESS 0xd000809a BIT_MASK 0x1 /end MEASUREMENT
/begin MEASUREMENT lv_err_tcha_prs_low "Boolean for error currently present on charger pressure to low diagnosis" UBYTE _CNV_S_2_RANGE__0___1_CM 1 100. 0. 1. DISPLAY_IDENTIFIER LV_ERR_TCHA_PRS_LOW ECU_ADDRESS 0xd000809b BIT_MASK 0x1 /end MEASUREMENT
/begin MEASUREMENT lv_err_tcha_leak "Boolean for error currently present on charger leakage diagnosis" UBYTE _CNV_S_2_RANGE__0___1_CM 1 100. 0. 1. DISPLAY_IDENTIFIER LV_ERR_TCHA_LEAK ECU_ADDRESS 0xd000809c BIT_MASK 0x1 /end MEASUREMENT
/begin MEASUREMENT lv_err_tcha_prs_high "Boolean for error currently present on charger pressure to high diagnosis" UBYTE _CNV_S_2_RANGE__0___1_CM 1 100. 0. 1. DISPLAY_IDENTIFIER LV_ERR_TCHA_PRS_HIGH ECU_ADDRESS 0xd000809e BIT_MASK 0x1 /end MEASUREMENT
/begin MEASUREMENT lv_err_tcha_prs_dif "Boolean for error currently present on charger pressure difference diagnosis" UBYTE _CNV_S_2_RANGE__0___1_CM 1 100. 0. 1. DISPLAY_IDENTIFIER LV_ERR_TCHA_PRS_DIF ECU_ADDRESS 0xd000809d BIT_MASK 0x1 /end MEASUREMENT
/begin MEASUREMENT lv_err_put_plaus "Boolean for error currently present on PUT plausibility diagnosis" UBYTE _CNV_S_2_RANGE__0___1_CM 1 100. 0. 1. DISPLAY_IDENTIFIER LV_ERR_PUT_PLAUS ECU_ADDRESS 0xd000809f BIT_MASK 0x1 /end MEASUREMENT
/begin MEASUREMENT lv_err_map_plaus "Boolean for detected error of Manifold pressure plausibility diagnosis" UBYTE _CNV_S_2_RANGE__0___1_CM 1 100. 0. 1. DISPLAY_IDENTIFIER LV_ERR_MAP_PLAUS ECU_ADDRESS 0xd00080a0 BIT_MASK 0x1 /end MEASUREMENT
/begin MEASUREMENT lv_err_tq_cst "Error Flag for TQ_CST error" UBYTE _CNV_S_2_RANGE__0___1_CM 1 100. 0. 1. DISPLAY_IDENTIFIER LV_ERR_TQ_CST ECU_ADDRESS 0xd00080a1 BIT_MASK 0x1 /end MEASUREMENT
/begin MEASUREMENT lv_err_gen_el "Error Flag for TQ_CST error" UBYTE _CNV_S_2_RANGE__0___1_CM 1 100. 0. 1. DISPLAY_IDENTIFIER LV_ERR_GEN_EL ECU_ADDRESS 0xd00080a2 BIT_MASK 0x1 /end MEASUREMENT
/begin MEASUREMENT lv_err_gen_mec "Error Flag for TQ_CST error" UBYTE _CNV_S_2_RANGE__0___1_CM 1 100. 0. 1. DISPLAY_IDENTIFIER LV_ERR_GEN_MEC ECU_ADDRESS 0xd00080a3 BIT_MASK 0x1 /end MEASUREMENT
/begin MEASUREMENT lv_err_gen_h_temp "Error Flag for TQ_CST error" UBYTE _CNV_S_2_RANGE__0___1_CM 1 100. 0. 1. DISPLAY_IDENTIFIER LV_ERR_GEN_H_TEMP ECU_ADDRESS 0xd00080a4 BIT_MASK 0x1 /end MEASUREMENT
/begin MEASUREMENT lv_err_gen_typ_not_plaus "Error Flag for TQ_CST error" UBYTE _CNV_S_2_RANGE__0___1_CM 1 100. 0. 1. DISPLAY_IDENTIFIER LV_ERR_GEN_TYP_NOT_PLAUS ECU_ADDRESS 0xd00080a5 BIT_MASK 0x1 /end MEASUREMENT
/begin MEASUREMENT lv_err_gen_msg_lost "Error Flag for TQ_CST error" UBYTE _CNV_S_2_RANGE__0___1_CM 1 100. 0. 1. DISPLAY_IDENTIFIER LV_ERR_GEN_MSG_LOST ECU_ADDRESS 0xd00080a6 BIT_MASK 0x1 /end MEASUREMENT
/begin MEASUREMENT lv_err_gen_clc_v_not_plaus "Error Flag for TQ_CST error" UBYTE _CNV_S_2_RANGE__0___1_CM 1 100. 0. 1. DISPLAY_IDENTIFIER LV_ERR_GEN_CLC_V_NOT_PLAUS ECU_ADDRESS 0xd00080a7 BIT_MASK 0x1 /end MEASUREMENT
/begin MEASUREMENT lv_err_gen_h_temp_clc "Error Flag for TQ_CST error" UBYTE _CNV_S_2_RANGE__0___1_CM 1 100. 0. 1. DISPLAY_IDENTIFIER LV_ERR_GEN_H_TEMP_CLC ECU_ADDRESS 0xd00080a8 BIT_MASK 0x1 /end MEASUREMENT
/begin MEASUREMENT lv_err_gen_ctl_not_plaus "Error Flag for TQ_CST error" UBYTE _CNV_S_2_RANGE__0___1_CM 1 100. 0. 1. DISPLAY_IDENTIFIER LV_ERR_GEN_CTL_NOT_PLAUS ECU_ADDRESS 0xd00080a9 BIT_MASK 0x1 /end MEASUREMENT
/begin MEASUREMENT cdn_diag_ect_el "Diagnosis condition for failure ect_el" UBYTE _CNV_A_R_LINEAR_____0_CM 1 100. 0. 7. DISPLAY_IDENTIFIER CDN_DIAG_ECT_EL ECU_ADDRESS 0xd0002690 FORMAT "%3.0" /end MEASUREMENT
/begin MEASUREMENT lv_err_ect_el "Present failure : failure after filtering of diagnosis ECT" UBYTE _CNV_S_2_RANGE__0___1_CM 1 100. 0. 1. DISPLAY_IDENTIFIER LV_ERR_ECT_EL ECU_ADDRESS 0xd0007f01 BIT_MASK 0x1 /end MEASUREMENT
/begin MEASUREMENT lv_err_ecf[0] "Boolean for electronic controlled cooling fan error" UBYTE _CNV_S_2_RANGE__0___1_CM 1 100. 0. 1. DISPLAY_IDENTIFIER LV_ERR_ECF[0] ECU_ADDRESS 0xd0007574 /end MEASUREMENT
/begin MEASUREMENT lv_err_ecf[1] "Boolean for electronic controlled cooling fan error" UBYTE _CNV_S_2_RANGE__0___1_CM 1 100. 0. 1. DISPLAY_IDENTIFIER LV_ERR_ECF[1] ECU_ADDRESS 0xd0007575 /end MEASUREMENT
/begin MEASUREMENT pow_out_ecf "Cooling fan power output of all available fan(s) at the vehicle" UBYTE _CNV_A_R_LINEAR_____5_CM 1 100. 0. 99.609375 DISPLAY_IDENTIFIER POW_OUT_ECF ECU_ADDRESS 0xd0007556 /end MEASUREMENT
/begin MEASUREMENT t_dly_purge_diagcps "Delay time for activating DIAGCPS-diagnosis (step2) after LV CL MMV 0  --> 1" UWORD _CNV_A_R_LINEAR_____110_CM 1 100. 0. 1310.7 DISPLAY_IDENTIFIER T_DLY_PURGE_DIAGCPS ECU_ADDRESS 0xd00092d8 FORMAT "%7.2" /end MEASUREMENT
/begin MEASUREMENT maf_kgh_add_max "Maximum possible engine load for catalyst heating - kg/h" UWORD _CNV_A_R_LINEAR_____215_CM 1 100. 0. 2047.96875 DISPLAY_IDENTIFIER MAF_KGH_ADD_MAX ECU_ADDRESS 0xd00072a2 FORMAT "%7.2" /end MEASUREMENT
/begin MEASUREMENT tqi_sp_s "Torque setpoint for stratified combustion mode" SWORD _CNV_A_R_LINEAR_____31_CM 1 100. -1024. 1023.96875 DISPLAY_IDENTIFIER TQI_SP_S ECU_ADDRESS 0xd00072ac FORMAT "%8.2" /end MEASUREMENT
/begin MEASUREMENT lv_lamb_cop "Boolean for active catalyst overheating control" UBYTE _CNV_S_2_RANGE__0___1_CM 1 100. 0. 1. DISPLAY_IDENTIFIER LV_LAMB_COP ECU_ADDRESS 0xd00075fb BIT_MASK 0x1 /end MEASUREMENT
/begin MEASUREMENT lv_lamb_cop_[0] "Boolean for active catalyst overheating control bank 1" UBYTE _CNV_S_2_RANGE__0___1_CM 1 100. 0. 1. DISPLAY_IDENTIFIER LV_LAMB_COP[1] ECU_ADDRESS 0xd00075f8 BIT_MASK 0x1 /end MEASUREMENT
/begin MEASUREMENT lv_lamb_cop_[1] "Boolean for active catalyst overheating control bank 2" UBYTE _CNV_S_2_RANGE__0___1_CM 1 100. 0. 1. DISPLAY_IDENTIFIER LV_LAMB_COP[2] ECU_ADDRESS 0xd00075f9 BIT_MASK 0x1 /end MEASUREMENT
/begin MEASUREMENT lamb_cop[0] "Lambda for catalyst overheating prevention  bank 1" UWORD _CNV_A_R_LINEAR_____129_CM 1 100. 0. 31.9990234375 DISPLAY_IDENTIFIER LAMB_COP[1] ECU_ADDRESS 0xd00068e4 FORMAT "%7.4" /end MEASUREMENT
/begin MEASUREMENT lamb_cop[1] "Lambda for catalyst overheating prevention bank 2" UWORD _CNV_A_R_LINEAR_____129_CM 1 100. 0. 31.9990234375 DISPLAY_IDENTIFIER LAMB_COP[2] ECU_ADDRESS 0xd00068e6 FORMAT "%7.4" /end MEASUREMENT
/begin MEASUREMENT fac_maf_rel_egr_cor_1 "Relative filling, EGR-corrected, Bank 1" UWORD _CNV_A_R_LINEAR_____226_CM 1 100. 0. 300. DISPLAY_IDENTIFIER FAC_MAF_REL_EGR_COR_1 ECU_ADDRESS 0xd00068ea FORMAT "%5.1" /end MEASUREMENT
/begin MEASUREMENT fac_maf_rel_egr_cor_2 "Relative filling, EGR-corrected, Bank 2" UWORD _CNV_A_R_LINEAR_____226_CM 1 100. 0. 300. DISPLAY_IDENTIFIER FAC_MAF_REL_EGR_COR_2 ECU_ADDRESS 0xd00068ec FORMAT "%5.1" /end MEASUREMENT
/begin MEASUREMENT fac_maf_rel_egr_cor "Relative filling, EGR-corrected" UWORD _CNV_A_R_LINEAR_____226_CM 1 100. 0. 300. DISPLAY_IDENTIFIER FAC_MAF_REL_EGR_COR ECU_ADDRESS 0xd00068e8 FORMAT "%5.1" /end MEASUREMENT
/begin MEASUREMENT n_sp_is_brake "idle speed correction due to accumulator charge" UWORD _CNV_A_R_LINEAR_____14_CM 1 100. 0. 32767. DISPLAY_IDENTIFIER N_SP_IS_BRAKE ECU_ADDRESS 0xd000a152 FORMAT "%5.0" /end MEASUREMENT
/begin MEASUREMENT fac_tq_add_is_opm_sel "torque reserve for idle speed interpolation factor for operation switch manager" UBYTE _CNV_A_R_LINEAR_____185_CM 1 100. 0. 0.99609375 DISPLAY_IDENTIFIER FAC_TQ_ADD_IS_OPM_SEL ECU_ADDRESS 0xd0008694 FORMAT "%5.3" /end MEASUREMENT
/begin MEASUREMENT n_sp_is_poil_ctl "idle speed correction due to oil pressure regulator" UWORD _CNV_A_R_LINEAR_____14_CM 1 100. 0. 8160. DISPLAY_IDENTIFIER N_SP_IS_POIL_CTL ECU_ADDRESS 0xd000a154 FORMAT "%4.0" /end MEASUREMENT
/begin MEASUREMENT fac_tq_loss_opm_sel "torque loss interpolation factor for opeartion switch manager" UBYTE _CNV_A_R_LINEAR_____185_CM 1 100. 0. 0.99609375 DISPLAY_IDENTIFIER FAC_TQ_LOSS_OPM_SEL ECU_ADDRESS 0xd00086b0 FORMAT "%5.3" /end MEASUREMENT
/begin MEASUREMENT lamb_sp_[0] "lambda setpoint " UWORD _CNV_A_R_LINEAR_____129_CM 1 100. -32768. 32767. DISPLAY_IDENTIFIER LAMB_SP[1] ECU_ADDRESS 0xd000a230 FORMAT "%7.4" /end MEASUREMENT
/begin MEASUREMENT lamb_sp_[1] "lambda setpoint " UWORD _CNV_A_R_LINEAR_____129_CM 1 100. -32768. 32767. DISPLAY_IDENTIFIER LAMB_SP[2] ECU_ADDRESS 0xd000a232 FORMAT "%7.4" /end MEASUREMENT
/begin MEASUREMENT lamb_sp_hom[0] "lambda setpoint " UWORD _CNV_A_R_LINEAR_____24_CM 1 100. 0. 1.99993896484375 DISPLAY_IDENTIFIER LAMB_SP_HOM[1] ECU_ADDRESS 0xd000a234 FORMAT "%7.5" /end MEASUREMENT
/begin MEASUREMENT lamb_sp_hom[1] "lambda setpoint " UWORD _CNV_A_R_LINEAR_____24_CM 1 100. 0. 1.99993896484375 DISPLAY_IDENTIFIER LAMB_SP_HOM[2] ECU_ADDRESS 0xd000a236 FORMAT "%7.5" /end MEASUREMENT
/begin MEASUREMENT lv_cs "Clutch switch information from Siemens" UBYTE _CNV_S_2_RANGE__0___1_CM 1 100. 0. 1. DISPLAY_IDENTIFIER LV_CS ECU_ADDRESS 0xd00086b4 BIT_MASK 0x1 /end MEASUREMENT
/begin MEASUREMENT toil_mes "Oil temperature" UBYTE _CNV_A_R_LINEAR_____26_CM 1 100. -40. 160. DISPLAY_IDENTIFIER TOIL_MES ECU_ADDRESS 0xd0008708 FORMAT "%3.0" /end MEASUREMENT
/begin MEASUREMENT state_oil_req "Recommended refill volume engine-oil" UBYTE _CNV_A_R_LINEAR_____0_CM 1 100. 0. 255. DISPLAY_IDENTIFIER STATE_OIL_REQ ECU_ADDRESS 0xd000870d FORMAT "%3.0" /end MEASUREMENT
/begin MEASUREMENT state_loil "fluid-level engine-oil" UBYTE _CNV_A_R_LINEAR_____0_CM 1 100. 0. 255. DISPLAY_IDENTIFIER STATE_LOIL ECU_ADDRESS 0xd000870e FORMAT "%3.0" /end MEASUREMENT
/begin MEASUREMENT qoil_ds_can_2_1 "ID2 BOS message 2" UBYTE _CNV_A_R_LINEAR_____0_CM 1 100. 0. 255. DISPLAY_IDENTIFIER QOIL_DS_CAN_2_1 ECU_ADDRESS 0xd000870f FORMAT "%3.0" /end MEASUREMENT
/begin MEASUREMENT qoil_ds_can_2_2 "ID function BOS message 2" SWORD _CNV_A_R_LINEAR_____0_CM 1 100. -32768. 32767. DISPLAY_IDENTIFIER QOIL_DS_CAN_2_2 ECU_ADDRESS 0xd000a2cc FORMAT "%6.0" /end MEASUREMENT
/begin MEASUREMENT qoil_ds_can_2_3 "Forecast intermittent way BOS message 2" UBYTE _CNV_A_R_LINEAR_____0_CM 1 100. 0. 255. DISPLAY_IDENTIFIER QOIL_DS_CAN_2_3 ECU_ADDRESS 0xd0008710 FORMAT "%3.0" /end MEASUREMENT
/begin MEASUREMENT qoil_ds_can_2_4 "target-date year BOS message 2" UBYTE _CNV_A_R_LINEAR_____0_CM 1 100. 0. 255. DISPLAY_IDENTIFIER QOIL_DS_CAN_2_4 ECU_ADDRESS 0xd0008711 FORMAT "%3.0" /end MEASUREMENT
/begin MEASUREMENT qoil_ds_can_2_5 "target-date month BOS message 2" UBYTE _CNV_A_R_LINEAR_____0_CM 1 100. 0. 255. DISPLAY_IDENTIFIER QOIL_DS_CAN_2_5 ECU_ADDRESS 0xd0008712 FORMAT "%3.0" /end MEASUREMENT
/begin MEASUREMENT qoil_ds_can_2_6 "Forecast intermittent time BOS message 2" UBYTE _CNV_A_R_LINEAR_____0_CM 1 100. 0. 255. DISPLAY_IDENTIFIER QOIL_DS_CAN_2_6 ECU_ADDRESS 0xd0008713 FORMAT "%3.0" /end MEASUREMENT
/begin MEASUREMENT dist_resi_oil "Ausgabewert Restlaufstrecke Motoröl" SWORD _CNV_R_R_Def_km_sw__68_CM 1 100. -327680. 327670. DISPLAY_IDENTIFIER DIST_RESI_OIL ECU_ADDRESS 0xd000a2ce FORMAT "%6.1" /end MEASUREMENT
/begin MEASUREMENT dist_resi_oil_km "Einheit der BOS-Info (km)" UBYTE _CNV_A_R_LINEAR_____0_CM 1 100. 0. 255. DISPLAY_IDENTIFIER DIST_RESI_OIL_KM ECU_ADDRESS 0xd0008714 FORMAT "%3.0" /end MEASUREMENT
/begin MEASUREMENT state_oil_avl "Rest-Verfügbarkeit Motoröl in Prozent" UBYTE _CNV_A_R_LINEAR_____0_CM 1 100. 0. 255. DISPLAY_IDENTIFIER STATE_OIL_AVL ECU_ADDRESS 0xd0008715 FORMAT "%3.0" /end MEASUREMENT
/begin MEASUREMENT poil_sp "Oil pressure setpoint" UWORD _CNV_A_R_LINEAR_____247_CM 1 100. 0. 20. DISPLAY_IDENTIFIER POIL_SP ECU_ADDRESS 0xd000a2d0 /end MEASUREMENT
/begin MEASUREMENT poil_pwm "Tastverhältnis Öldruck-Regelventil" UWORD _CNV_A_R_LINEAR_____8_CM 1 100. 0. 99.99847412109381 DISPLAY_IDENTIFIER POIL_PWM ECU_ADDRESS 0xd000a2d2 /end MEASUREMENT
/begin MEASUREMENT lv_poil_swi_cus "Condition oil pressure display (from customer)" UBYTE _CNV_S_2_RANGE__0___1_CM 1 100. 0. 1. DISPLAY_IDENTIFIER LV_POIL_SWI_CUS ECU_ADDRESS 0xd0008716 BIT_MASK 0x1 /end MEASUREMENT
/begin MEASUREMENT lv_soil_vld_loil_cus "Oil temperature valid from customer" UBYTE _CNV_S_2_RANGE__0___1_CM 1 100. 0. 1. DISPLAY_IDENTIFIER LV_SOIL_VLD_LOIL_CUS ECU_ADDRESS 0xd0008717 BIT_MASK 0x1 /end MEASUREMENT
/begin MEASUREMENT lv_t_cool_vld_loil_cus "Cool off time valid from customer" UBYTE _CNV_S_2_RANGE__0___1_CM 1 100. 0. 1. DISPLAY_IDENTIFIER LV_T_COOL_VLD_LOIL_CUS ECU_ADDRESS 0xd0008718 BIT_MASK 0x1 /end MEASUREMENT
/begin MEASUREMENT fac_mff_cst_opm_sel "start fuel mass flow interpolation factor for operation switch manager" UBYTE _CNV_A_R_LINEAR_____185_CM 1 100. 0. 0.99609375 DISPLAY_IDENTIFIER FAC_MFF_CST_OPM_SEL ECU_ADDRESS 0xd0007606 FORMAT "%5.3" /end MEASUREMENT
/begin MEASUREMENT mff_sp_s "Fuel mass in stratified combustion." UWORD _CNV_A_R_LINEAR_____111_CM 1 100. 0. 1389. DISPLAY_IDENTIFIER MFF_SP_S ECU_ADDRESS 0xd00069da FORMAT "%7.2" /end MEASUREMENT
/begin MEASUREMENT fac_ti_wup_opm_sel "warm up injection time correction interpolation factor for operation switch manager" UBYTE _CNV_A_R_LINEAR_____185_CM 1 100. 0. 0.99609375 DISPLAY_IDENTIFIER FAC_TI_WUP_OPM_SEL ECU_ADDRESS 0xd000760b FORMAT "%5.3" /end MEASUREMENT
/begin MEASUREMENT fac_ti_cast_opm_sel "post start injection time correction interpolation factor for operation switch manager" UBYTE _CNV_A_R_LINEAR_____185_CM 1 100. 0. 0.99609375 DISPLAY_IDENTIFIER FAC_TI_CAST_OPM_SEL ECU_ADDRESS 0xd000760a FORMAT "%5.3" /end MEASUREMENT
/begin MEASUREMENT inj_mod_s_req "injection mode selection strat (single/multi)" UBYTE _CNV_A_R_LINEAR_____0_CM 1 100. 0. 255. DISPLAY_IDENTIFIER INJ_MOD_S_REQ ECU_ADDRESS 0xd000760d FORMAT "%3.0" /end MEASUREMENT
/begin MEASUREMENT mff_sp_1_s[0] "Fuel mass setpoint for the first pulse at stratified mode " UWORD _CNV_A_R_LINEAR_____111_CM 1 100. 0. 1389. DISPLAY_IDENTIFIER MFF_SP_1_S[0] ECU_ADDRESS 0xd0006974 FORMAT "%7.2" /end MEASUREMENT
/begin MEASUREMENT mff_sp_1_s[1] "Fuel mass setpoint for the first pulse at stratified mode " UWORD _CNV_A_R_LINEAR_____111_CM 1 100. 0. 1389. DISPLAY_IDENTIFIER MFF_SP_1_S[1] ECU_ADDRESS 0xd0006976 FORMAT "%7.2" /end MEASUREMENT
/begin MEASUREMENT mff_sp_1_s[2] "Fuel mass setpoint for the first pulse at stratified mode " UWORD _CNV_A_R_LINEAR_____111_CM 1 100. 0. 1389. DISPLAY_IDENTIFIER MFF_SP_1_S[2] ECU_ADDRESS 0xd0006978 FORMAT "%7.2" /end MEASUREMENT
/begin MEASUREMENT mff_sp_1_s[3] "Fuel mass setpoint for the first pulse at stratified mode " UWORD _CNV_A_R_LINEAR_____111_CM 1 100. 0. 1389. DISPLAY_IDENTIFIER MFF_SP_1_S[3] ECU_ADDRESS 0xd000697a FORMAT "%7.2" /end MEASUREMENT
/begin MEASUREMENT mff_sp_1_s[4] "Fuel mass setpoint for the first pulse at stratified mode " UWORD _CNV_A_R_LINEAR_____111_CM 1 100. 0. 1389. DISPLAY_IDENTIFIER MFF_SP_1_S[4] ECU_ADDRESS 0xd000697c FORMAT "%7.2" /end MEASUREMENT
/begin MEASUREMENT mff_sp_1_s[5] "Fuel mass setpoint for the first pulse at stratified mode " UWORD _CNV_A_R_LINEAR_____111_CM 1 100. 0. 1389. DISPLAY_IDENTIFIER MFF_SP_1_S[5] ECU_ADDRESS 0xd000697e FORMAT "%7.2" /end MEASUREMENT
/begin MEASUREMENT mff_sp_1_s[6] "Fuel mass setpoint for the first pulse at stratified mode " UWORD _CNV_A_R_LINEAR_____111_CM 1 100. 0. 1389. DISPLAY_IDENTIFIER MFF_SP_1_S[6] ECU_ADDRESS 0xd0006980 FORMAT "%7.2" /end MEASUREMENT
/begin MEASUREMENT mff_sp_1_s[7] "Fuel mass setpoint for the first pulse at stratified mode " UWORD _CNV_A_R_LINEAR_____111_CM 1 100. 0. 1389. DISPLAY_IDENTIFIER MFF_SP_1_S[7] ECU_ADDRESS 0xd0006982 FORMAT "%7.2" /end MEASUREMENT
/begin MEASUREMENT mff_sp_2_s[0] "Fuel mass setpoint for the  second  pulse at stratified mode " UWORD _CNV_A_R_LINEAR_____111_CM 1 100. 0. 1389. DISPLAY_IDENTIFIER MFF_SP_2_S[0] ECU_ADDRESS 0xd00069a4 FORMAT "%7.2" /end MEASUREMENT
/begin MEASUREMENT mff_sp_2_s[1] "Fuel mass setpoint for the  second  pulse at stratified mode " UWORD _CNV_A_R_LINEAR_____111_CM 1 100. 0. 1389. DISPLAY_IDENTIFIER MFF_SP_2_S[1] ECU_ADDRESS 0xd00069a6 FORMAT "%7.2" /end MEASUREMENT
/begin MEASUREMENT mff_sp_2_s[2] "Fuel mass setpoint for the  second  pulse at stratified mode " UWORD _CNV_A_R_LINEAR_____111_CM 1 100. 0. 1389. DISPLAY_IDENTIFIER MFF_SP_2_S[2] ECU_ADDRESS 0xd00069a8 FORMAT "%7.2" /end MEASUREMENT
/begin MEASUREMENT mff_sp_2_s[3] "Fuel mass setpoint for the  second  pulse at stratified mode " UWORD _CNV_A_R_LINEAR_____111_CM 1 100. 0. 1389. DISPLAY_IDENTIFIER MFF_SP_2_S[3] ECU_ADDRESS 0xd00069aa FORMAT "%7.2" /end MEASUREMENT
/begin MEASUREMENT mff_sp_2_s[4] "Fuel mass setpoint for the  second  pulse at stratified mode " UWORD _CNV_A_R_LINEAR_____111_CM 1 100. 0. 1389. DISPLAY_IDENTIFIER MFF_SP_2_S[4] ECU_ADDRESS 0xd00069ac FORMAT "%7.2" /end MEASUREMENT
/begin MEASUREMENT mff_sp_2_s[5] "Fuel mass setpoint for the  second  pulse at stratified mode " UWORD _CNV_A_R_LINEAR_____111_CM 1 100. 0. 1389. DISPLAY_IDENTIFIER MFF_SP_2_S[5] ECU_ADDRESS 0xd00069ae FORMAT "%7.2" /end MEASUREMENT
/begin MEASUREMENT mff_sp_2_s[6] "Fuel mass setpoint for the  second  pulse at stratified mode " UWORD _CNV_A_R_LINEAR_____111_CM 1 100. 0. 1389. DISPLAY_IDENTIFIER MFF_SP_2_S[6] ECU_ADDRESS 0xd00069b0 FORMAT "%7.2" /end MEASUREMENT
/begin MEASUREMENT mff_sp_2_s[7] "Fuel mass setpoint for the  second  pulse at stratified mode " UWORD _CNV_A_R_LINEAR_____111_CM 1 100. 0. 1389. DISPLAY_IDENTIFIER MFF_SP_2_S[7] ECU_ADDRESS 0xd00069b2 FORMAT "%7.2" /end MEASUREMENT
/begin MEASUREMENT mff_sp_3_s[0] "Fuel mass setpoint for the third  pulse at stratified mode " UWORD _CNV_A_R_LINEAR_____111_CM 1 100. 0. 1389. DISPLAY_IDENTIFIER MFF_SP_3_S[0] ECU_ADDRESS 0xd00069c4 FORMAT "%7.2" /end MEASUREMENT
/begin MEASUREMENT mff_sp_3_s[1] "Fuel mass setpoint for the third  pulse at stratified mode " UWORD _CNV_A_R_LINEAR_____111_CM 1 100. 0. 1389. DISPLAY_IDENTIFIER MFF_SP_3_S[1] ECU_ADDRESS 0xd00069c6 FORMAT "%7.2" /end MEASUREMENT
/begin MEASUREMENT mff_sp_3_s[2] "Fuel mass setpoint for the third  pulse at stratified mode " UWORD _CNV_A_R_LINEAR_____111_CM 1 100. 0. 1389. DISPLAY_IDENTIFIER MFF_SP_3_S[2] ECU_ADDRESS 0xd00069c8 FORMAT "%7.2" /end MEASUREMENT
/begin MEASUREMENT mff_sp_3_s[3] "Fuel mass setpoint for the third  pulse at stratified mode " UWORD _CNV_A_R_LINEAR_____111_CM 1 100. 0. 1389. DISPLAY_IDENTIFIER MFF_SP_3_S[3] ECU_ADDRESS 0xd00069ca FORMAT "%7.2" /end MEASUREMENT
/begin CHARACTERISTIC lc_com_1_nwl_info "logical constant for communication through a network layer" VALUE 0xa080c53d _REC_VAL_20_u1 1. _CNV_A_R_LINEAR_____0_CM 0. 1. DISPLAY_IDENTIFIER LC_COM_1_NWL_INFO FORMAT "%2.0" /end CHARACTERISTIC
/begin MEASUREMENT nmot_rb "Engine-speed" UBYTE _CNV_A_R_LINEAR_____905_CM 1 100. 0. 10200. DISPLAY_IDENTIFIER NMOT_RB ECU_ADDRESS 0xd00077f7 FORMAT "%6.0" /end MEASUREMENT
/begin MEASUREMENT nmot_w_rb "Engine-speed" UWORD _CNV_A_R_LINEAR_____170_CM 1 100. 0. 16383.75 DISPLAY_IDENTIFIER NMOT_W_RB ECU_ADDRESS 0xd0007318 FORMAT "%8.2" /end MEASUREMENT
/begin MEASUREMENT prsoll_w_rb[0] "Rail pressure control setpoint" UWORD _CNV_A_R_LINEAR_____801_CM 1 100. 0. 32.7675 DISPLAY_IDENTIFIER PRSOLL_W_RB[0] ECU_ADDRESS 0xd000731e FORMAT "%7.4" /end MEASUREMENT
/begin MEASUREMENT prsoll_w_rb[1] "Rail pressure control setpoint" UWORD _CNV_A_R_LINEAR_____801_CM 1 100. 0. 32.7675 DISPLAY_IDENTIFIER PRSOLL_W_RB[1] ECU_ADDRESS 0xd0007320 FORMAT "%7.4" /end MEASUREMENT
/begin MEASUREMENT prist_w_rb[0] "Rail pressure setpoint filtered" UWORD _CNV_A_R_LINEAR_____801_CM 1 100. 0. 32.7675 DISPLAY_IDENTIFIER PRIST_W_RB[0] ECU_ADDRESS 0xd000731a FORMAT "%7.4" /end MEASUREMENT
/begin MEASUREMENT prist_w_rb[1] "Rail pressure setpoint filtered" UWORD _CNV_A_R_LINEAR_____801_CM 1 100. 0. 32.7675 DISPLAY_IDENTIFIER PRIST_W_RB[1] ECU_ADDRESS 0xd000731c FORMAT "%7.4" /end MEASUREMENT
/begin MEASUREMENT B_hdr_rb[0] "Flag activation / deactivation rail pressure control" UBYTE _CNV_A_R_LINEAR_____0_CM 1 100. 0. 1. DISPLAY_IDENTIFIER B_HDR_RB[0] ECU_ADDRESS 0xd00077e6 FORMAT "%1.0" /end MEASUREMENT
/begin MEASUREMENT B_hdr_rb[1] "Flag activation / deactivation rail pressure control" UBYTE _CNV_A_R_LINEAR_____0_CM 1 100. 0. 1. DISPLAY_IDENTIFIER B_HDR_RB[1] ECU_ADDRESS 0xd00077e7 FORMAT "%1.0" /end MEASUREMENT
/begin MEASUREMENT rkmeeff_w_rb[0] "Bank-middle effective injected fuel mass (inclusive reducing-level)" UWORD _CNV_A_R_LINEAR_____906_CM 1 100. 0. 3071.953125 DISPLAY_IDENTIFIER RKMEEFF_W_RB[0] ECU_ADDRESS 0xd0007326 FORMAT "%9.4" /end MEASUREMENT
/begin MEASUREMENT rkmeeff_w_rb[1] "Bank-middle effective injected fuel mass (inclusive reducing-level)" UWORD _CNV_A_R_LINEAR_____906_CM 1 100. 0. 3071.953125 DISPLAY_IDENTIFIER RKMEEFF_W_RB[1] ECU_ADDRESS 0xd0007328 FORMAT "%9.4" /end MEASUREMENT
/begin MEASUREMENT B_bm_rb "Condition benchmark identified" UBYTE _CNV_A_R_LINEAR_____0_CM 1 100. 0. 1. DISPLAY_IDENTIFIER B_BM_RB ECU_ADDRESS 0xd00077e4 FORMAT "%1.0" /end MEASUREMENT
/begin MEASUREMENT B_stend_rb "Condition start-end reached" UBYTE _CNV_A_R_LINEAR_____0_CM 1 100. 0. 1. DISPLAY_IDENTIFIER B_STEND_RB ECU_ADDRESS 0xd00077f0 FORMAT "%1.0" /end MEASUREMENT
/begin MEASUREMENT ubsqf_rb "Vehicle voltage calculated into standard quantization and filtered" UBYTE _CNV_A_R_LINEAR_____425_CM 1 100. 0. 25.5 DISPLAY_IDENTIFIER UBSQF_RB ECU_ADDRESS 0xd00077fc FORMAT "%4.1" /end MEASUREMENT
/begin MEASUREMENT B_msvoff_rb[0] "Condition deactivation mass control valve" UBYTE _CNV_A_R_LINEAR_____0_CM 1 100. 0. 1. DISPLAY_IDENTIFIER B_MSVOFF_RB[0] ECU_ADDRESS 0xd00077ec FORMAT "%1.0" /end MEASUREMENT
/begin MEASUREMENT B_msvoff_rb[1] "Condition deactivation mass control valve" UBYTE _CNV_A_R_LINEAR_____0_CM 1 100. 0. 1. DISPLAY_IDENTIFIER B_MSVOFF_RB[1] ECU_ADDRESS 0xd00077ed FORMAT "%1.0" /end MEASUREMENT
/begin MEASUREMENT B_sthdp_rb "Condition start with active high pressure pump" UBYTE _CNV_A_R_LINEAR_____0_CM 1 100. 0. 1. DISPLAY_IDENTIFIER B_STHDP_RB ECU_ADDRESS 0xd00077f1 FORMAT "%1.0" /end MEASUREMENT
/begin MEASUREMENT ubsqf_w_rb "Vehicle voltage calculated into standard quantization and filtered" UWORD _CNV_A_R_LINEAR_____907_CM 1 100. 0. 25.59960938 DISPLAY_IDENTIFIER UBSQF_W_RB ECU_ADDRESS 0xd000732c FORMAT "%9.6" /end MEASUREMENT
/begin MEASUREMENT B_sa_rb "Condition fuel cut-off" UBYTE _CNV_A_R_LINEAR_____0_CM 1 100. 0. 1. DISPLAY_IDENTIFIER B_SA_RB ECU_ADDRESS 0xd00077ee FORMAT "%1.0" /end MEASUREMENT
/begin MEASUREMENT B_stprel_rb "Condition debounce of engine-speed-signal started" UBYTE _CNV_A_R_LINEAR_____0_CM 1 100. 0. 1. DISPLAY_IDENTIFIER B_STPREL_RB ECU_ADDRESS 0xd00077f2 FORMAT "%1.0" /end MEASUREMENT
/begin MEASUREMENT B_sabte_rb "Condition fuel cut-off for canister-purge" UBYTE _CNV_A_R_LINEAR_____0_CM 1 100. 0. 1. DISPLAY_IDENTIFIER B_SABTE_RB ECU_ADDRESS 0xd00077ef FORMAT "%1.0" /end MEASUREMENT
/begin MEASUREMENT wnwvfa_w_rb[0] "Improved camshaft angle (outet camshaft 1)" SWORD _CNV_A_R_LINEAR_____908_CM 1 100. -256. 255.9921875 DISPLAY_IDENTIFIER WNWVFA_W_RB[0] ECU_ADDRESS 0xd000732e FORMAT "%9.4" /end MEASUREMENT
/begin MEASUREMENT wnwvfa_w_rb[1] "Improved camshaft angle (outet camshaft 1)" SWORD _CNV_A_R_LINEAR_____908_CM 1 100. -256. 255.9921875 DISPLAY_IDENTIFIER WNWVFA_W_RB[1] ECU_ADDRESS 0xd0007330 FORMAT "%9.4" /end MEASUREMENT
/begin MEASUREMENT tmot_rb "Engine temperature" UBYTE _CNV_A_R_LINEAR_____17_CM 1 100. -48. 143.25 DISPLAY_IDENTIFIER TMOT_RB ECU_ADDRESS 0xd00077fb FORMAT "%5.1" /end MEASUREMENT
/begin MEASUREMENT tfuelsq_rb "Fuel temperature" UBYTE _CNV_A_R_LINEAR_____17_CM 1 100. -48. 143.25 DISPLAY_IDENTIFIER TFUELSQ_RB ECU_ADDRESS 0xd00077fa FORMAT "%5.1" /end MEASUREMENT
/begin MEASUREMENT tnse_w_rb "Elapsed time since end of start" UWORD _CNV_A_R_LINEAR_____4_CM 1 100. 0. 6553.5 DISPLAY_IDENTIFIER TNSE_W_RB ECU_ADDRESS 0xd000732a FORMAT "%6.1" /end MEASUREMENT
/begin MEASUREMENT E_tm_rb "Error flag of engine temperature" UBYTE _CNV_A_R_LINEAR_____0_CM 1 100. 0. 1. DISPLAY_IDENTIFIER E_TM_RB ECU_ADDRESS 0xd00077f6 FORMAT "%1.0" /end MEASUREMENT
/begin MEASUREMENT E_n_rb "Error flag of engine speed sensor" UBYTE _CNV_A_R_LINEAR_____0_CM 1 100. 0. 1. DISPLAY_IDENTIFIER E_N_RB ECU_ADDRESS 0xd00077f5 FORMAT "%1.0" /end MEASUREMENT
/begin MEASUREMENT B_tfuelg_rb "Fuel temperature invalid" UBYTE _CNV_A_R_LINEAR_____0_CM 1 100. 0. 1. DISPLAY_IDENTIFIER B_TFUELG_RB ECU_ADDRESS 0xd00077f3 FORMAT "%1.0" /end MEASUREMENT
/begin MEASUREMENT B_entist_rb "Injection at start enabled" UBYTE _CNV_A_R_LINEAR_____0_CM 1 100. 0. 1. DISPLAY_IDENTIFIER B_ENTIST_RB ECU_ADDRESS 0xd00077e5 FORMAT "%1.0" /end MEASUREMENT
/begin MEASUREMENT B_ll_rb "Idle running from driver point of view" UBYTE _CNV_A_R_LINEAR_____0_CM 1 100. 0. 1. DISPLAY_IDENTIFIER B_LL_RB ECU_ADDRESS 0xd00077e8 FORMAT "%1.0" /end MEASUREMENT
/begin MEASUREMENT B_tprel_rb "Time debouncing finished" UBYTE _CNV_A_R_LINEAR_____0_CM 1 100. 0. 1. DISPLAY_IDENTIFIER B_TPREL_RB ECU_ADDRESS 0xd00077f4 FORMAT "%1.0" /end MEASUREMENT
/begin MEASUREMENT prsollu_w_rb[0] "Unfiltered fuel rail setpoint" UWORD _CNV_A_R_LINEAR_____801_CM 1 100. 0. 32.7675 DISPLAY_IDENTIFIER PRSOLLU_W_RB[0] ECU_ADDRESS 0xd0007322 FORMAT "%7.4" /end MEASUREMENT
/begin MEASUREMENT prsollu_w_rb[1] "Unfiltered fuel rail setpoint" UWORD _CNV_A_R_LINEAR_____801_CM 1 100. 0. 32.7675 DISPLAY_IDENTIFIER PRSOLLU_W_RB[1] ECU_ADDRESS 0xd0007324 FORMAT "%7.4" /end MEASUREMENT
/begin MEASUREMENT B_lr_rb "Lambda control of bank 1 active" UBYTE _CNV_A_R_LINEAR_____0_CM 1 100. 0. 1. DISPLAY_IDENTIFIER B_LR_RB ECU_ADDRESS 0xd00077ea FORMAT "%1.0" /end MEASUREMENT
/begin MEASUREMENT B_lr2_rb "Lambda control of bank 2 active" UBYTE _CNV_A_R_LINEAR_____0_CM 1 100. 0. 1. DISPLAY_IDENTIFIER B_LR2_RB ECU_ADDRESS 0xd00077e9 FORMAT "%1.0" /end MEASUREMENT
/begin AXIS_PTS ldp_nmot_klphdrn_rb_0 "" 0xa08081f0 nmot_rb _REC_AXS_20_u1 10200. _CNV_A_R_LINEAR_____905_CM 8 0. 10200. FORMAT "%6.0" /end AXIS_PTS
/begin AXIS_PTS ldp_nmot_klphdrn_rb_1 "" 0xa08083c0 nmot_rb _REC_AXS_20_u1 10200. _CNV_A_R_LINEAR_____905_CM 8 0. 10200. FORMAT "%6.0" /end AXIS_PTS
/begin AXIS_PTS ldp_nmot_fwphdr_rb_0 "" 0xa08081d4 nmot_rb _REC_AXS_20_u1 10200. _CNV_A_R_LINEAR_____905_CM 8 0. 10200. FORMAT "%6.0" /end AXIS_PTS
/begin AXIS_PTS ldp_nmot_fwphdr_rb_1 "" 0xa08083a4 nmot_rb _REC_AXS_20_u1 10200. _CNV_A_R_LINEAR_____905_CM 8 0. 10200. FORMAT "%6.0" /end AXIS_PTS
/begin AXIS_PTS ldp_nmot_fwihdr_rb_1 "" 0xa0808398 nmot_rb _REC_AXS_20_u1 10200. _CNV_A_R_LINEAR_____905_CM 8 0. 10200. FORMAT "%6.0" /end AXIS_PTS
/begin AXIS_PTS spd06hdsw_rb_0 "" 0xa0808264 prdiff_w_rb[0] _REC_AXS_20_u2 32.7675 _CNV_A_R_LINEAR_____909_CM 8 -16.384 16.3835 FORMAT "%8.4" /end AXIS_PTS
/begin AXIS_PTS spd06hdsw_rb_1 "" 0xa0808428 prdiff_w_rb[1] _REC_AXS_20_u2 32.7675 _CNV_A_R_LINEAR_____909_CM 8 -16.384 16.3835 FORMAT "%8.4" /end AXIS_PTS
/begin AXIS_PTS snm08hduw_rb_0 "" 0xa0808250 nmot_w_rb _REC_AXS_20_u2 16383.75 _CNV_A_R_LINEAR_____170_CM 8 0. 16383.75 FORMAT "%8.2" /end AXIS_PTS
/begin AXIS_PTS snm08hduw_rb_1 "" 0xa0808414 nmot_w_rb _REC_AXS_20_u2 16383.75 _CNV_A_R_LINEAR_____170_CM 8 0. 16383.75 FORMAT "%8.2" /end AXIS_PTS
/begin AXIS_PTS spr06hduw_rb_0 "" 0xa0808278 prsoll_w_rb[0] _REC_AXS_20_u2 32.7675 _CNV_A_R_LINEAR_____801_CM 6 0. 32.7675 FORMAT "%7.4" /end AXIS_PTS
/begin AXIS_PTS spr06hduw_rb_1 "" 0xa080843c prsoll_w_rb[1] _REC_AXS_20_u2 32.7675 _CNV_A_R_LINEAR_____801_CM 6 0. 32.7675 FORMAT "%7.4" /end AXIS_PTS
/begin AXIS_PTS ldp_nmot_w_kftamsv_rb_0 "" 0xa08081fc nmot_w_rb _REC_AXS_20_u2 16383.75 _CNV_A_R_LINEAR_____170_CM 8 0. 16383.75 FORMAT "%8.2" /end AXIS_PTS
/begin AXIS_PTS ldp_nmot_w_kftamsv_rb_1 "" 0xa08083cc nmot_w_rb _REC_AXS_20_u2 16383.75 _CNV_A_R_LINEAR_____170_CM 8 0. 16383.75 FORMAT "%8.2" /end AXIS_PTS
/begin AXIS_PTS ldp_ubsqf_w_kftamsv_rb_0 "" 0xa0808240 ubsqf_w_rb _REC_AXS_20_u2 25.59960938 _CNV_A_R_LINEAR_____907_CM 6 0. 25.59960938 FORMAT "%9.6" /end AXIS_PTS
/begin AXIS_PTS ldp_ubsqf_w_kftamsv_rb_1 "" 0xa0808404 ubsqf_w_rb _REC_AXS_20_u2 25.59960938 _CNV_A_R_LINEAR_____907_CM 6 0. 25.59960938 FORMAT "%9.6" /end AXIS_PTS
/begin AXIS_PTS ldp_ubsqf_klvzmsv_rb_1 "" 0xa08083fa ubsqf_rb _REC_AXS_20_u1 25.5 _CNV_A_R_LINEAR_____425_CM 6 0. 25.5 FORMAT "%4.1" /end AXIS_PTS
/begin AXIS_PTS ldp_tmsvm_klvzmsvt_rb_1 "" 0xa08083e6 tmsvm_rb[1] _REC_AXS_20_u1 191.25 _CNV_A_R_LINEAR_____17_CM 3 -48. 143.25 FORMAT "%5.1" /end AXIS_PTS
/begin AXIS_PTS ldp_tmsvm_klvzmsvt_rb_0 "" 0xa0808216 tmsvm_rb[0] _REC_AXS_20_u1 191.25 _CNV_A_R_LINEAR_____17_CM 3 -48. 143.25 FORMAT "%5.1" /end AXIS_PTS
/begin AXIS_PTS ldp_nmot_fwihdr_rb_0 "" 0xa08081c8 nmot_rb _REC_AXS_20_u1 10200. _CNV_A_R_LINEAR_____905_CM 8 0. 10200. FORMAT "%6.0" /end AXIS_PTS
/begin AXIS_PTS ldp_dwmsvd_kfvzmsvdw_rb_0 "" 0xa08081bc dwmsvd_w_rb[0] _REC_AXS_20_u2 6553.5 _CNV_A_R_LINEAR_____910_CM 4 -3276.8 3276.7 FORMAT "%7.1" /end AXIS_PTS
/begin AXIS_PTS ldp_dwmsvd_kfvzmsvdw_rb_1 "" 0xa080838c dwmsvd_w_rb[1] _REC_AXS_20_u2 6553.5 _CNV_A_R_LINEAR_____910_CM 4 -3276.8 3276.7 FORMAT "%7.1" /end AXIS_PTS
/begin AXIS_PTS ldp_nmot_kfvzmsvdw_rb_0 "" 0xa08081de nmot_rb _REC_AXS_20_u1 10200. _CNV_A_R_LINEAR_____905_CM 4 0. 10200. FORMAT "%6.0" /end AXIS_PTS
/begin AXIS_PTS ldp_nmot_kfvzmsvdw_rb_1 "" 0xa08083ae nmot_rb _REC_AXS_20_u1 10200. _CNV_A_R_LINEAR_____905_CM 4 0. 10200. FORMAT "%6.0" /end AXIS_PTS
/begin AXIS_PTS ldp_ubsqf_klvzmsv_rb_0 "" 0xa0808236 ubsqf_rb _REC_AXS_20_u1 25.5 _CNV_A_R_LINEAR_____425_CM 6 0. 25.5 FORMAT "%4.1" /end AXIS_PTS
/begin AXIS_PTS ldp_ubsqf_kltamsvub_rb "" 0xa080822a ubsqf_rb _REC_AXS_20_u1 25.5 _CNV_A_R_LINEAR_____425_CM 6 0. 25.5 FORMAT "%4.1" /end AXIS_PTS
/begin AXIS_PTS ldp_tnse_w_klftmsv_rb_0 "" 0xa080821c tnse_w_rb _REC_AXS_20_u2 6553.5 _CNV_A_R_LINEAR_____4_CM 4 0. 6553.5 FORMAT "%6.1" /end AXIS_PTS
/begin AXIS_PTS ldp_tnse_w_klftmsv_rb_1 "" 0xa08083ec tnse_w_rb _REC_AXS_20_u2 6553.5 _CNV_A_R_LINEAR_____4_CM 4 0. 6553.5 FORMAT "%6.1" /end AXIS_PTS
/begin AXIS_PTS ldp_nmot_klnmtmsv_rb_0 "" 0xa08081ea nmot_rb _REC_AXS_20_u1 10200. _CNV_A_R_LINEAR_____905_CM 4 0. 10200. FORMAT "%6.0" /end AXIS_PTS
/begin AXIS_PTS ldp_nmot_klnmtmsv_rb_1 "" 0xa08083ba nmot_rb _REC_AXS_20_u1 10200. _CNV_A_R_LINEAR_____905_CM 4 0. 10200. FORMAT "%6.0" /end AXIS_PTS
/begin AXIS_PTS ldp_tfuelsq_klfvstgtf_rb_0 "" 0xa080820e tfuelsq_rb _REC_AXS_20_u1 191.25 _CNV_A_R_LINEAR_____17_CM 3 -48. 143.25 FORMAT "%5.1" /end AXIS_PTS
/begin AXIS_PTS ldp_tfuelsq_klfvstgtf_rb_1 "" 0xa08083de tfuelsq_rb _REC_AXS_20_u1 191.25 _CNV_A_R_LINEAR_____17_CM 3 -48. 143.25 FORMAT "%5.1" /end AXIS_PTS
/begin AXIS_PTS ldp_tfuelsq_klfvstotf_rb_0 "" 0xa0808212 tfuelsq_rb _REC_AXS_20_u1 191.25 _CNV_A_R_LINEAR_____17_CM 3 -48. 143.25 FORMAT "%5.1" /end AXIS_PTS
/begin AXIS_PTS ldp_tfuelsq_klfvstotf_rb_1 "" 0xa08083e2 tfuelsq_rb _REC_AXS_20_u1 191.25 _CNV_A_R_LINEAR_____17_CM 3 -48. 143.25 FORMAT "%5.1" /end AXIS_PTS
/begin AXIS_PTS ldp_nmot_kfwhzmsv_rb_0 "" 0xa08081e4 nmot_rb _REC_AXS_20_u1 10200. _CNV_A_R_LINEAR_____905_CM 5 0. 10200. FORMAT "%6.0" /end AXIS_PTS
/begin AXIS_PTS ldp_nmot_kfwhzmsv_rb_1 "" 0xa08083b4 nmot_rb _REC_AXS_20_u1 10200. _CNV_A_R_LINEAR_____905_CM 5 0. 10200. FORMAT "%6.0" /end AXIS_PTS
/begin AXIS_PTS ldp_ubsqf_kfwhzmsv_rb_0 "" 0xa0808226 ubsqf_rb _REC_AXS_20_u1 25.5 _CNV_A_R_LINEAR_____425_CM 3 0. 25.5 FORMAT "%4.1" /end AXIS_PTS
/begin AXIS_PTS ldp_ubsqf_kfwhzmsv_rb_1 "" 0xa08083f6 ubsqf_rb _REC_AXS_20_u1 25.5 _CNV_A_R_LINEAR_____425_CM 3 0. 25.5 FORMAT "%4.1" /end AXIS_PTS
/begin AXIS_PTS ldp_ubsqf_kltamsvubs_rb "" 0xa0808232 ubsqf_rb _REC_AXS_20_u1 25.5 _CNV_A_R_LINEAR_____425_CM 2 0. 25.5 FORMAT "%4.1" /end AXIS_PTS
/begin MEASUREMENT pria_w_rb[0] "High pressure controller I-share" SWORD _CNV_A_R_LINEAR_____801_CM 1 100. -16.384 16.3835 DISPLAY_IDENTIFIER PRIA_W_RB[0] ECU_ADDRESS 0xd0000d4c FORMAT "%8.4" /end MEASUREMENT
/begin MEASUREMENT pria_w_rb[1] "High pressure controller I-share" SWORD _CNV_A_R_LINEAR_____801_CM 1 100. -16.384 16.3835 DISPLAY_IDENTIFIER PRIA_W_RB[1] ECU_ADDRESS 0xd0000d4e FORMAT "%8.4" /end MEASUREMENT
/begin MEASUREMENT prdr_w_rb[0] "Output value of rail pressure controller" SWORD _CNV_A_R_LINEAR_____801_CM 1 100. -16.384 16.3835 DISPLAY_IDENTIFIER PRDR_W_RB[0] ECU_ADDRESS 0xd0000d48 FORMAT "%8.4" /end MEASUREMENT
/begin MEASUREMENT prdr_w_rb[1] "Output value of rail pressure controller" SWORD _CNV_A_R_LINEAR_____801_CM 1 100. -16.384 16.3835 DISPLAY_IDENTIFIER PRDR_W_RB[1] ECU_ADDRESS 0xd0000d4a FORMAT "%8.4" /end MEASUREMENT
/begin MEASUREMENT prdiff_w_rb[0] "Control offset of rail pressure control" SWORD _CNV_A_R_LINEAR_____801_CM 1 100. -16.384 16.3835 DISPLAY_IDENTIFIER PRDIFF_W_RB[0] ECU_ADDRESS 0xd0000d44 FORMAT "%8.4" /end MEASUREMENT
/begin MEASUREMENT prdiff_w_rb[1] "Control offset of rail pressure control" SWORD _CNV_A_R_LINEAR_____801_CM 1 100. -16.384 16.3835 DISPLAY_IDENTIFIER PRDIFF_W_RB[1] ECU_ADDRESS 0xd0000d46 FORMAT "%8.4" /end MEASUREMENT
/begin MEASUREMENT vstmsvoa_w_rb[0] "Auxiliary variable offset part in map-based pilot control of the VCV" SWORD _CNV_A_R_LINEAR_____546_CM 1 100. -3276.8 3276.7 DISPLAY_IDENTIFIER VSTMSVOA_W_RB[0] ECU_ADDRESS 0xd0000d64 FORMAT "%7.1" /end MEASUREMENT
/begin MEASUREMENT vstmsvoa_w_rb[1] "Auxiliary variable offset part in map-based pilot control of the VCV" SWORD _CNV_A_R_LINEAR_____546_CM 1 100. -3276.8 3276.7 DISPLAY_IDENTIFIER VSTMSVOA_W_RB[1] ECU_ADDRESS 0xd0000d66 FORMAT "%7.1" /end MEASUREMENT
/begin MEASUREMENT B_msvkma_rb[0] "Bit for low flow control of the VCV active" UBYTE _CNV_A_R_LINEAR_____0_CM 1 100. 0. 1. DISPLAY_IDENTIFIER B_MSVKMA_RB[0] ECU_ADDRESS 0xd0000d82 FORMAT "%1.0" /end MEASUREMENT
/begin MEASUREMENT B_msvkma_rb[1] "Bit for low flow control of the VCV active" UBYTE _CNV_A_R_LINEAR_____0_CM 1 100. 0. 1. DISPLAY_IDENTIFIER B_MSVKMA_RB[1] ECU_ADDRESS 0xd0000d83 FORMAT "%1.0" /end MEASUREMENT
/begin MEASUREMENT B_hdrres_rb[0] "Condition for reset of rail pressure controller" UBYTE _CNV_A_R_LINEAR_____0_CM 1 100. 0. 1. DISPLAY_IDENTIFIER B_HDRRES_RB[0] ECU_ADDRESS 0xd0000d7e FORMAT "%1.0" /end MEASUREMENT
/begin MEASUREMENT B_hdrres_rb[1] "Condition for reset of rail pressure controller" UBYTE _CNV_A_R_LINEAR_____0_CM 1 100. 0. 1. DISPLAY_IDENTIFIER B_HDRRES_RB[1] ECU_ADDRESS 0xd0000d7f FORMAT "%1.0" /end MEASUREMENT
/begin MEASUREMENT B_msvact_rb[0] "Bit control active" UBYTE _CNV_A_R_LINEAR_____0_CM 1 100. 0. 1. DISPLAY_IDENTIFIER B_MSVACT_RB[0] ECU_ADDRESS 0xd0000d80 FORMAT "%1.0" /end MEASUREMENT
/begin MEASUREMENT B_msvact_rb[1] "Bit control active" UBYTE _CNV_A_R_LINEAR_____0_CM 1 100. 0. 1. DISPLAY_IDENTIFIER B_MSVACT_RB[1] ECU_ADDRESS 0xd0000d81 FORMAT "%1.0" /end MEASUREMENT
/begin MEASUREMENT dwmsvvst_w_rb[0] "Pre-control value for flow control valve" SWORD _CNV_A_R_LINEAR_____546_CM 1 100. -3276.8 3276.7 DISPLAY_IDENTIFIER DWMSVVST_W_RB[0] ECU_ADDRESS 0xd0000d38 FORMAT "%7.1" /end MEASUREMENT
/begin MEASUREMENT dwmsvvst_w_rb[1] "Pre-control value for flow control valve" SWORD _CNV_A_R_LINEAR_____546_CM 1 100. -3276.8 3276.7 DISPLAY_IDENTIFIER DWMSVVST_W_RB[1] ECU_ADDRESS 0xd0000d3a FORMAT "%7.1" /end MEASUREMENT
/begin MEASUREMENT dwmsvd_w_rb[0] "Delivery time of the VCV" SWORD _CNV_A_R_LINEAR_____546_CM 1 100. -3276.8 3276.7 DISPLAY_IDENTIFIER DWMSVD_W_RB[0] ECU_ADDRESS 0xd0000d24 FORMAT "%7.1" /end MEASUREMENT
/begin MEASUREMENT dwmsvd_w_rb[1] "Delivery time of the VCV" SWORD _CNV_A_R_LINEAR_____546_CM 1 100. -3276.8 3276.7 DISPLAY_IDENTIFIER DWMSVD_W_RB[1] ECU_ADDRESS 0xd0000d26 FORMAT "%7.1" /end MEASUREMENT
/begin MEASUREMENT dwmsvo_w_rb[0] "Control angle of VCV (open)" SWORD _CNV_A_R_LINEAR_____546_CM 1 100. -3276.8 3276.7 DISPLAY_IDENTIFIER DWMSVO_W_RB[0] ECU_ADDRESS 0xd0000d2c FORMAT "%7.1" /end MEASUREMENT
/begin MEASUREMENT dwmsvo_w_rb[1] "Control angle of VCV (open)" SWORD _CNV_A_R_LINEAR_____546_CM 1 100. -3276.8 3276.7 DISPLAY_IDENTIFIER DWMSVO_W_RB[1] ECU_ADDRESS 0xd0000d2e FORMAT "%7.1" /end MEASUREMENT
/begin MEASUREMENT dwmsvovb_w_rb[0] "Delta-angle to open VCV before limitation" SWORD _CNV_A_R_LINEAR_____546_CM 1 100. -3276.8 3276.7 DISPLAY_IDENTIFIER DWMSVOVB_W_RB[0] ECU_ADDRESS 0xd0000d30 FORMAT "%7.1" /end MEASUREMENT
/begin MEASUREMENT dwmsvovb_w_rb[1] "Delta-angle to open VCV before limitation" SWORD _CNV_A_R_LINEAR_____546_CM 1 100. -3276.8 3276.7 DISPLAY_IDENTIFIER DWMSVOVB_W_RB[1] ECU_ADDRESS 0xd0000d32 FORMAT "%7.1" /end MEASUREMENT
/begin MEASUREMENT vstmsvga_w_rb[0] "Auxiliary variable gain part in map-based pilot control of the VCV" UWORD _CNV_A_R_LINEAR_____546_CM 1 100. 0. 6553.5 DISPLAY_IDENTIFIER VSTMSVGA_W_RB[0] ECU_ADDRESS 0xd0000d60 FORMAT "%7.1" /end MEASUREMENT
/begin MEASUREMENT vstmsvga_w_rb[1] "Auxiliary variable gain part in map-based pilot control of the VCV" UWORD _CNV_A_R_LINEAR_____546_CM 1 100. 0. 6553.5 DISPLAY_IDENTIFIER VSTMSVGA_W_RB[1] ECU_ADDRESS 0xd0000d62 FORMAT "%7.1" /end MEASUREMENT
/begin MEASUREMENT dwmsvs_w_rb[0] "Control angle to start VCV inclusive control delay (close)" UWORD _CNV_A_R_LINEAR_____546_CM 1 100. 0. 6553.5 DISPLAY_IDENTIFIER DWMSVS_W_RB[0] ECU_ADDRESS 0xd0000d34 FORMAT "%7.1" /end MEASUREMENT
/begin MEASUREMENT dwmsvs_w_rb[1] "Control angle to start VCV inclusive control delay (close)" UWORD _CNV_A_R_LINEAR_____546_CM 1 100. 0. 6553.5 DISPLAY_IDENTIFIER DWMSVS_W_RB[1] ECU_ADDRESS 0xd0000d36 FORMAT "%7.1" /end MEASUREMENT
/begin CHARACTERISTIC kihdr_rb[0] "I-share of rail pressure controller" VALUE 0xa0808346 _REC_VAL_20_u1 7.96875 _CNV_A_R_LINEAR_____834_CM 0. 7.96875 DISPLAY_IDENTIFIER KIHDR_RB[0] FORMAT "%5.3" /end CHARACTERISTIC
/begin CHARACTERISTIC kihdr_rb[1] "I-share of rail pressure controller" VALUE 0xa0808347 _REC_VAL_20_u1 7.96875 _CNV_A_R_LINEAR_____834_CM 0. 7.96875 DISPLAY_IDENTIFIER KIHDR_RB[1] FORMAT "%5.3" /end CHARACTERISTIC
/begin CHARACTERISTIC prrglmin_rb[0] "Limitation minimum value I-share of controller" VALUE 0xa080835c _REC_VAL_20_s2 32.7675 _CNV_A_R_LINEAR_____801_CM -16.384 16.3835 DISPLAY_IDENTIFIER PRRGLMIN_RB[0] FORMAT "%8.4" /end CHARACTERISTIC
/begin CHARACTERISTIC prrglmin_rb[1] "Limitation minimum value I-share of controller" VALUE 0xa080835e _REC_VAL_20_s2 32.7675 _CNV_A_R_LINEAR_____801_CM -16.384 16.3835 DISPLAY_IDENTIFIER PRRGLMIN_RB[1] FORMAT "%8.4" /end CHARACTERISTIC
/begin CHARACTERISTIC prrglmax_rb[0] "Limitation maximum value I-share of controller" VALUE 0xa0808358 _REC_VAL_20_s2 32.7675 _CNV_A_R_LINEAR_____801_CM -16.384 16.3835 DISPLAY_IDENTIFIER PRRGLMAX_RB[0] FORMAT "%8.4" /end CHARACTERISTIC
/begin CHARACTERISTIC prrglmax_rb[1] "Limitation maximum value I-share of controller" VALUE 0xa080835a _REC_VAL_20_s2 32.7675 _CNV_A_R_LINEAR_____801_CM -16.384 16.3835 DISPLAY_IDENTIFIER PRRGLMAX_RB[1] FORMAT "%8.4" /end CHARACTERISTIC
/begin CHARACTERISTIC dwmsvvstap_rb[0] "Application value map-based pilot control of the VCV" VALUE 0xa0808330 _REC_VAL_20_s2 6553.5 _CNV_A_R_LINEAR_____546_CM -3276.8 3276.7 DISPLAY_IDENTIFIER DWMSVVSTAP_RB[0] FORMAT "%7.1" /end CHARACTERISTIC
/begin CHARACTERISTIC dwmsvvstap_rb[1] "Application value map-based pilot control of the VCV" VALUE 0xa0808332 _REC_VAL_20_s2 6553.5 _CNV_A_R_LINEAR_____546_CM -3276.8 3276.7 DISPLAY_IDENTIFIER DWMSVVSTAP_RB[1] FORMAT "%7.1" /end CHARACTERISTIC
/begin CHARACTERISTIC cwdaf_rb[0] "Code word HD-System including pressure reducing function" VALUE 0xa080831a _REC_VAL_20_u1 255. _CNV_A_R_LINEAR_____0_CM 0. 255. DISPLAY_IDENTIFIER CWDAF_RB[0] FORMAT "%3.0" /end CHARACTERISTIC
/begin CHARACTERISTIC cwdaf_rb[1] "Code word HD-System including pressure reducing function" VALUE 0xa080831b _REC_VAL_20_u1 255. _CNV_A_R_LINEAR_____0_CM 0. 255. DISPLAY_IDENTIFIER CWDAF_RB[1] FORMAT "%3.0" /end CHARACTERISTIC
/begin CHARACTERISTIC dwmsvmn_rb[0] "Angle limitation for minimal delivery mass" VALUE 0xa0808320 _REC_VAL_20_s2 720. _CNV_A_R_LINEAR_____546_CM -360. 360. DISPLAY_IDENTIFIER DWMSVMN_RB[0] FORMAT "%6.1" /end CHARACTERISTIC
/begin CHARACTERISTIC dwmsvmn_rb[1] "Angle limitation for minimal delivery mass" VALUE 0xa0808322 _REC_VAL_20_s2 720. _CNV_A_R_LINEAR_____546_CM -360. 360. DISPLAY_IDENTIFIER DWMSVMN_RB[1] FORMAT "%6.1" /end CHARACTERISTIC
/begin CHARACTERISTIC dwmsvmx_rb[0] "Angle limitation for maximal delivery mass" VALUE 0xa0808324 _REC_VAL_20_s2 720. _CNV_A_R_LINEAR_____546_CM -360. 360. DISPLAY_IDENTIFIER DWMSVMX_RB[0] FORMAT "%6.1" /end CHARACTERISTIC
/begin CHARACTERISTIC dwmsvmx_rb[1] "Angle limitation for maximal delivery mass" VALUE 0xa0808326 _REC_VAL_20_s2 720. _CNV_A_R_LINEAR_____546_CM -360. 360. DISPLAY_IDENTIFIER DWMSVMX_RB[1] FORMAT "%6.1" /end CHARACTERISTIC
/begin CHARACTERISTIC dwmsvomx_rb[0] "Minimal angle of controlling the VCV (open)" VALUE 0xa0808328 _REC_VAL_20_s2 720. _CNV_A_R_LINEAR_____546_CM -360. 360. DISPLAY_IDENTIFIER DWMSVOMX_RB[0] FORMAT "%6.1" /end CHARACTERISTIC
/begin CHARACTERISTIC dwmsvomx_rb[1] "Minimal angle of controlling the VCV (open)" VALUE 0xa080832a _REC_VAL_20_s2 720. _CNV_A_R_LINEAR_____546_CM -360. 360. DISPLAY_IDENTIFIER DWMSVOMX_RB[1] FORMAT "%6.1" /end CHARACTERISTIC
/begin CHARACTERISTIC dwmsvost_rb[0] "Angle limitation for maximum control in high pressure start" VALUE 0xa080832c _REC_VAL_20_s2 720. _CNV_A_R_LINEAR_____546_CM -360. 360. DISPLAY_IDENTIFIER DWMSVOST_RB[0] FORMAT "%6.1" /end CHARACTERISTIC
/begin CHARACTERISTIC dwmsvost_rb[1] "Angle limitation for maximum control in high pressure start" VALUE 0xa080832e _REC_VAL_20_s2 720. _CNV_A_R_LINEAR_____546_CM -360. 360. DISPLAY_IDENTIFIER DWMSVOST_RB[1] FORMAT "%6.1" /end CHARACTERISTIC
/begin CHARACTERISTIC fdwmsvrdr_rb[0] "Coefficient adaption controller intervention" VALUE 0xa0808340 _REC_VAL_20_u2 199.99694824 _CNV_A_R_LINEAR_____911_CM 0. 199.99694824 DISPLAY_IDENTIFIER FDWMSVRDR_RB[0] FORMAT "%9.5" /end CHARACTERISTIC
/begin CHARACTERISTIC fdwmsvrdr_rb[1] "Coefficient adaption controller intervention" VALUE 0xa0808342 _REC_VAL_20_u2 199.99694824 _CNV_A_R_LINEAR_____911_CM 0. 199.99694824 DISPLAY_IDENTIFIER FDWMSVRDR_RB[1] FORMAT "%9.5" /end CHARACTERISTIC
/begin CHARACTERISTIC prmin_rb[0] "Minimal value limitation rail pressure setpoint" VALUE 0xa080834e _REC_VAL_20_u2 32.7675 _CNV_A_R_LINEAR_____801_CM 0. 32.7675 DISPLAY_IDENTIFIER PRMIN_RB[0] FORMAT "%7.4" /end CHARACTERISTIC
/begin CHARACTERISTIC prmin_rb[1] "Minimal value limitation rail pressure setpoint" VALUE 0xa0808350 _REC_VAL_20_u2 32.7675 _CNV_A_R_LINEAR_____801_CM 0. 32.7675 DISPLAY_IDENTIFIER PRMIN_RB[1] FORMAT "%7.4" /end CHARACTERISTIC
/begin CHARACTERISTIC prminmsv_rb[0] "Minimal rail pressure for self locking of the VCV" VALUE 0xa0808352 _REC_VAL_20_u1 32.64 _CNV_A_R_LINEAR_____912_CM 0. 32.64 DISPLAY_IDENTIFIER PRMINMSV_RB[0] FORMAT "%5.2" /end CHARACTERISTIC
/begin CHARACTERISTIC prminmsv_rb[1] "Minimal rail pressure for self locking of the VCV" VALUE 0xa0808353 _REC_VAL_20_u1 32.64 _CNV_A_R_LINEAR_____912_CM 0. 32.64 DISPLAY_IDENTIFIER PRMINMSV_RB[1] FORMAT "%5.2" /end CHARACTERISTIC
/begin CHARACTERISTIC klphdrn_rb_0 "P-share of rail pressure controller dependent on engine-speed" CURVE 0xa08082e8 _REC_CUR_20_u1_u1 1.9921875 _CNV_A_R_LINEAR_____103_CM 0. 1.9921875 DISPLAY_IDENTIFIER KLPHDRN_RB_0 FORMAT "%8.6"
 /begin AXIS_DESCR COM_AXIS nmot_rb _CNV_A_R_LINEAR_____905_CM 8 0. 10200. FORMAT "%6.0" AXIS_PTS_REF ldp_nmot_klphdrn_rb_0 /end AXIS_DESCR
/end CHARACTERISTIC
/begin CHARACTERISTIC klphdrn_rb_1 "P-share of rail pressure controller dependent on engine-speed" CURVE 0xa08084ac _REC_CUR_20_u1_u1 1.9921875 _CNV_A_R_LINEAR_____103_CM 0. 1.9921875 DISPLAY_IDENTIFIER KLPHDRN_RB_1 FORMAT "%8.6"
 /begin AXIS_DESCR COM_AXIS nmot_rb _CNV_A_R_LINEAR_____905_CM 8 0. 10200. FORMAT "%6.0" AXIS_PTS_REF ldp_nmot_klphdrn_rb_1 /end AXIS_DESCR
/end CHARACTERISTIC
/begin CHARACTERISTIC fwphdr_rb_0 "Weighting factor PI-controller-parameter HDR; P-share" CURVE 0xa0808290 _REC_CUR_20_u1_u1 1.9921875 _CNV_A_R_LINEAR_____103_CM 0. 1.9921875 DISPLAY_IDENTIFIER FWPHDR_RB_0 FORMAT "%8.6"
 /begin AXIS_DESCR COM_AXIS nmot_rb _CNV_A_R_LINEAR_____905_CM 8 0. 10200. FORMAT "%6.0" AXIS_PTS_REF ldp_nmot_fwphdr_rb_0 /end AXIS_DESCR
/end CHARACTERISTIC
/begin CHARACTERISTIC fwphdr_rb_1 "Weighting factor PI-controller-parameter HDR; P-share" CURVE 0xa0808454 _REC_CUR_20_u1_u1 1.9921875 _CNV_A_R_LINEAR_____103_CM 0. 1.9921875 DISPLAY_IDENTIFIER FWPHDR_RB_1 FORMAT "%8.6"
 /begin AXIS_DESCR COM_AXIS nmot_rb _CNV_A_R_LINEAR_____905_CM 8 0. 10200. FORMAT "%6.0" AXIS_PTS_REF ldp_nmot_fwphdr_rb_1 /end AXIS_DESCR
/end CHARACTERISTIC
/begin CHARACTERISTIC fwihdr_rb_0 "Weighting factor PI-controller-parameter HDR; I-share" CURVE 0xa0808288 _REC_CUR_20_u1_u1 1.9921875 _CNV_A_R_LINEAR_____103_CM 0. 1.9921875 DISPLAY_IDENTIFIER FWIHDR_RB_0 FORMAT "%8.6"
 /begin AXIS_DESCR COM_AXIS nmot_rb _CNV_A_R_LINEAR_____905_CM 8 0. 10200. FORMAT "%6.0" AXIS_PTS_REF ldp_nmot_fwihdr_rb_0 /end AXIS_DESCR
/end CHARACTERISTIC
/begin CHARACTERISTIC fwihdr_rb_1 "Weighting factor PI-controller-parameter HDR; I-share" CURVE 0xa080844c _REC_CUR_20_u1_u1 1.9921875 _CNV_A_R_LINEAR_____103_CM 0. 1.9921875 DISPLAY_IDENTIFIER FWIHDR_RB_1 FORMAT "%8.6"
 /begin AXIS_DESCR COM_AXIS nmot_rb _CNV_A_R_LINEAR_____905_CM 8 0. 10200. FORMAT "%6.0" AXIS_PTS_REF ldp_nmot_fwihdr_rb_1 /end AXIS_DESCR
/end CHARACTERISTIC
/begin CHARACTERISTIC klphdr_rb_0 "P-share of rail pressure controller" CURVE 0xa08082d8 _REC_CUR_20_u2_u2 7.9998779296875 _CNV_A_R_LINEAR_____115_CM 0. 7.9998779296875 DISPLAY_IDENTIFIER KLPHDR_RB_0 FORMAT "%6.4"
 /begin AXIS_DESCR COM_AXIS prdiff_w_rb[0] _CNV_A_R_LINEAR_____909_CM 8 -16.384 16.3835 FORMAT "%8.4" AXIS_PTS_REF spd06hdsw_rb_0 /end AXIS_DESCR
/end CHARACTERISTIC
/begin CHARACTERISTIC klphdr_rb_1 "P-share of rail pressure controller" CURVE 0xa080849c _REC_CUR_20_u2_u2 7.9998779296875 _CNV_A_R_LINEAR_____115_CM 0. 7.9998779296875 DISPLAY_IDENTIFIER KLPHDR_RB_1 FORMAT "%6.4"
 /begin AXIS_DESCR COM_AXIS prdiff_w_rb[1] _CNV_A_R_LINEAR_____909_CM 8 -16.384 16.3835 FORMAT "%8.4" AXIS_PTS_REF spd06hdsw_rb_1 /end AXIS_DESCR
/end CHARACTERISTIC
/begin CHARACTERISTIC klihdr_rb_0 "I-share of rail pressure controller" CURVE 0xa08082c4 _REC_CUR_20_u2_u2 7.9998779296875 _CNV_A_R_LINEAR_____115_CM 0. 7.9998779296875 DISPLAY_IDENTIFIER KLIHDR_RB_0 FORMAT "%6.4"
 /begin AXIS_DESCR COM_AXIS prdiff_w_rb[0] _CNV_A_R_LINEAR_____909_CM 8 -16.384 16.3835 FORMAT "%8.4" AXIS_PTS_REF spd06hdsw_rb_0 /end AXIS_DESCR
/end CHARACTERISTIC
/begin CHARACTERISTIC klihdr_rb_1 "I-share of rail pressure controller" CURVE 0xa0808488 _REC_CUR_20_u2_u2 7.9998779296875 _CNV_A_R_LINEAR_____115_CM 0. 7.9998779296875 DISPLAY_IDENTIFIER KLIHDR_RB_1 FORMAT "%6.4"
 /begin AXIS_DESCR COM_AXIS prdiff_w_rb[1] _CNV_A_R_LINEAR_____909_CM 8 -16.384 16.3835 FORMAT "%8.4" AXIS_PTS_REF spd06hdsw_rb_1 /end AXIS_DESCR
/end CHARACTERISTIC
/begin CHARACTERISTIC kfvstmsvo_rb_0 "Offset of map-based pilot control of the VCV" MAP 0xa08137a4 _REC_MAP_20_u2_u2_u2 6553.5 _CNV_A_R_LINEAR_____910_CM -3276.8 3276.7 DISPLAY_IDENTIFIER KFVSTMSVO_RB_0 FORMAT "%7.1"
 /begin AXIS_DESCR COM_AXIS nmot_w_rb _CNV_A_R_LINEAR_____170_CM 8 0. 16383.75 FORMAT "%8.2" AXIS_PTS_REF snm08hduw_rb_0 /end AXIS_DESCR
 /begin AXIS_DESCR COM_AXIS prsoll_w_rb[0] _CNV_A_R_LINEAR_____801_CM 6 0. 32.7675 FORMAT "%7.4" AXIS_PTS_REF spr06hduw_rb_0 /end AXIS_DESCR
/end CHARACTERISTIC
/begin CHARACTERISTIC kfvstmsvo_rb_1 "Offset of map-based pilot control of the VCV" MAP 0xa0813864 _REC_MAP_20_u2_u2_u2 6553.5 _CNV_A_R_LINEAR_____910_CM -3276.8 3276.7 DISPLAY_IDENTIFIER KFVSTMSVO_RB_1 FORMAT "%7.1"
 /begin AXIS_DESCR COM_AXIS nmot_w_rb _CNV_A_R_LINEAR_____170_CM 8 0. 16383.75 FORMAT "%8.2" AXIS_PTS_REF snm08hduw_rb_1 /end AXIS_DESCR
 /begin AXIS_DESCR COM_AXIS prsoll_w_rb[1] _CNV_A_R_LINEAR_____801_CM 6 0. 32.7675 FORMAT "%7.4" AXIS_PTS_REF spr06hduw_rb_1 /end AXIS_DESCR
/end CHARACTERISTIC
/begin CHARACTERISTIC klvstmsvg_rb_0 "Gain of map-based pilot control of the VCV" CURVE 0xa08082f8 _REC_CUR_20_u2_u2 3.99993896484375 _CNV_A_R_LINEAR_____24_CM 0. 3.99993896484375 DISPLAY_IDENTIFIER KLVSTMSVG_RB_0 FORMAT "%7.5"
 /begin AXIS_DESCR COM_AXIS nmot_w_rb _CNV_A_R_LINEAR_____170_CM 8 0. 16383.75 FORMAT "%8.2" AXIS_PTS_REF snm08hduw_rb_0 /end AXIS_DESCR
/end CHARACTERISTIC
/begin CHARACTERISTIC klvstmsvg_rb_1 "Gain of map-based pilot control of the VCV" CURVE 0xa08084b4 _REC_CUR_20_u2_u2 3.99993896484375 _CNV_A_R_LINEAR_____24_CM 0. 3.99993896484375 DISPLAY_IDENTIFIER KLVSTMSVG_RB_1 FORMAT "%7.5"
 /begin AXIS_DESCR COM_AXIS nmot_w_rb _CNV_A_R_LINEAR_____170_CM 8 0. 16383.75 FORMAT "%8.2" AXIS_PTS_REF snm08hduw_rb_1 /end AXIS_DESCR
/end CHARACTERISTIC
/begin CHARACTERISTIC kftamsv_rb_0 "VCV pulse width depending on battery voltage and engine speed" MAP 0xa0813744 _REC_MAP_20_u2_u2_u2 65.53 _CNV_A_R_INJR_LINEA_466_CM 0. 65.53 DISPLAY_IDENTIFIER KFTAMSV_RB_0 FORMAT "%5.2"
 /begin AXIS_DESCR COM_AXIS nmot_w_rb _CNV_A_R_LINEAR_____170_CM 8 0. 16383.75 FORMAT "%8.2" AXIS_PTS_REF ldp_nmot_w_kftamsv_rb_0 /end AXIS_DESCR
 /begin AXIS_DESCR COM_AXIS ubsqf_w_rb _CNV_A_R_LINEAR_____907_CM 6 0. 25.59960938 FORMAT "%9.6" AXIS_PTS_REF ldp_ubsqf_w_kftamsv_rb_0 /end AXIS_DESCR
/end CHARACTERISTIC
/begin CHARACTERISTIC kftamsv_rb_1 "VCV pulse width depending on battery voltage and engine speed" MAP 0xa0813804 _REC_MAP_20_u2_u2_u2 65.53 _CNV_A_R_INJR_LINEA_466_CM 0. 65.53 DISPLAY_IDENTIFIER KFTAMSV_RB_1 FORMAT "%5.2"
 /begin AXIS_DESCR COM_AXIS nmot_w_rb _CNV_A_R_LINEAR_____170_CM 8 0. 16383.75 FORMAT "%8.2" AXIS_PTS_REF ldp_nmot_w_kftamsv_rb_1 /end AXIS_DESCR
 /begin AXIS_DESCR COM_AXIS ubsqf_w_rb _CNV_A_R_LINEAR_____907_CM 6 0. 25.59960938 FORMAT "%9.6" AXIS_PTS_REF ldp_ubsqf_w_kftamsv_rb_1 /end AXIS_DESCR
/end CHARACTERISTIC
/begin CHARACTERISTIC klvzmsv_rb_1 "VCV time delay depending on battery voltage" CURVE 0xa08084c4 _REC_CUR_20_u1_u1 12.75 _CNV_A_R_LINEAR_____913_CM 0. 12.75 DISPLAY_IDENTIFIER KLVZMSV_RB_1 FORMAT "%5.2"
 /begin AXIS_DESCR COM_AXIS ubsqf_rb _CNV_A_R_LINEAR_____425_CM 6 0. 25.5 FORMAT "%4.1" AXIS_PTS_REF ldp_ubsqf_klvzmsv_rb_1 /end AXIS_DESCR
/end CHARACTERISTIC
/begin CHARACTERISTIC c_rho_fuel "Density of the fuel (needed for module 'Fuel supply general')" VALUE 0xa080c0ae _REC_VAL_20_u2 825.3605 _CNV_A_R_LINEAR_____914_CM 74.6395 900. DISPLAY_IDENTIFIER C_RHO_FUEL FORMAT "%7.2" /end CHARACTERISTIC
/begin MEASUREMENT prpa_w_rb[0] "High pressure controller P-share" SWORD _CNV_A_R_LINEAR_____801_CM 1 100. -16.384 16.3835 DISPLAY_IDENTIFIER PRPA_W_RB[0] ECU_ADDRESS 0xd0000d50 FORMAT "%8.4" /end MEASUREMENT
/begin MEASUREMENT prpa_w_rb[1] "High pressure controller P-share" SWORD _CNV_A_R_LINEAR_____801_CM 1 100. -16.384 16.3835 DISPLAY_IDENTIFIER PRPA_W_RB[1] ECU_ADDRESS 0xd0000d52 FORMAT "%8.4" /end MEASUREMENT
/begin MEASUREMENT B_hdrba_rb[0] "Flag to stop the integrator during control variable limitation" UBYTE _CNV_A_R_LINEAR_____0_CM 1 100. 0. 1. DISPLAY_IDENTIFIER B_HDRBA_RB[0] ECU_ADDRESS 0xd0000d7c FORMAT "%1.0" /end MEASUREMENT
/begin MEASUREMENT B_hdrba_rb[1] "Flag to stop the integrator during control variable limitation" UBYTE _CNV_A_R_LINEAR_____0_CM 1 100. 0. 1. DISPLAY_IDENTIFIER B_HDRBA_RB[1] ECU_ADDRESS 0xd0000d7d FORMAT "%1.0" /end MEASUREMENT
/begin MEASUREMENT wvzmsv_w_rb[0] "Time-delay of the VCV -control in [degree crank angle]" UWORD _CNV_A_R_LINEAR_____546_CM 1 100. 0. 6553.5 DISPLAY_IDENTIFIER WVZMSV_W_RB[0] ECU_ADDRESS 0xd0000d70 FORMAT "%7.1" /end MEASUREMENT
/begin MEASUREMENT wvzmsv_w_rb[1] "Time-delay of the VCV -control in [degree crank angle]" UWORD _CNV_A_R_LINEAR_____546_CM 1 100. 0. 6553.5 DISPLAY_IDENTIFIER WVZMSV_W_RB[1] ECU_ADDRESS 0xd0000d72 FORMAT "%7.1" /end MEASUREMENT
/begin MEASUREMENT t_vcv_ctl_st[0] "Timer for start procedure with continuous signal" UWORD _CNV_A_R_LINEAR_____3_CM 1 100. 0. 655.35 DISPLAY_IDENTIFIER T_VCV_CTL_ST[0] ECU_ADDRESS 0xd0000d54 FORMAT "%6.2" /end MEASUREMENT
/begin MEASUREMENT t_vcv_ctl_st[1] "Timer for start procedure with continuous signal" UWORD _CNV_A_R_LINEAR_____3_CM 1 100. 0. 655.35 DISPLAY_IDENTIFIER T_VCV_CTL_ST[1] ECU_ADDRESS 0xd0000d56 FORMAT "%6.2" /end MEASUREMENT
/begin CHARACTERISTIC dwotz1otp_rb[0] "Delta angle between upper dead point cylinder 1 and upper dead point high pressure pump\nDeltawinkel zwischen OT-Zylinder1 und OT-Pumpe" VALUE 0xa0808334 _REC_VAL_20_s2 65535. _CNV_A_R_LINEAR_____915_CM -32768. 32767. DISPLAY_IDENTIFIER DWOTZ1OTP_RB[0] FORMAT "%6.0" /end CHARACTERISTIC
/begin CHARACTERISTIC dwotz1otp_rb[1] "Delta angle between upper dead point cylinder 1 and upper dead point high pressure pump\nDeltawinkel zwischen OT-Zylinder1 und OT-Pumpe" VALUE 0xa0808336 _REC_VAL_20_s2 65535. _CNV_A_R_LINEAR_____915_CM -32768. 32767. DISPLAY_IDENTIFIER DWOTZ1OTP_RB[1] FORMAT "%6.0" /end CHARACTERISTIC
/begin CHARACTERISTIC wnwras_rb[0] "Angle for outlet valve closing in reference position based on charge cycle\nWinkel Auslassventil schlieát in Referenzposition bezogen auf Ladungswechsel (LWOT)" VALUE 0xa0808388 _REC_VAL_20_s2 511.9921875 _CNV_A_R_LINEAR_____908_CM -256. 255.9921875 DISPLAY_IDENTIFIER WNWRAS_RB[0] FORMAT "%9.4" /end CHARACTERISTIC
/begin CHARACTERISTIC wnwras_rb[1] "Angle for outlet valve closing in reference position based on charge cycle\nWinkel Auslassventil schlieát in Referenzposition bezogen auf Ladungswechsel (LWOT)" VALUE 0xa080838a _REC_VAL_20_s2 511.9921875 _CNV_A_R_LINEAR_____908_CM -256. 255.9921875 DISPLAY_IDENTIFIER WNWRAS_RB[1] FORMAT "%9.4" /end CHARACTERISTIC
/begin MEASUREMENT ang_ref_vcv[0] "Reference angle for VCV control" UWORD _CNV_A_R_LINEAR_____546_CM 1 100. 0. 6553.5 DISPLAY_IDENTIFIER ANG_REF_VCV[0] ECU_ADDRESS 0xd0007314 FORMAT "%7.1" /end MEASUREMENT
/begin MEASUREMENT ang_ref_vcv[1] "Reference angle for VCV control" UWORD _CNV_A_R_LINEAR_____546_CM 1 100. 0. 6553.5 DISPLAY_IDENTIFIER ANG_REF_VCV[1] ECU_ADDRESS 0xd0007316 FORMAT "%7.1" /end MEASUREMENT
/begin MEASUREMENT ang_close_vcv[0] "Angle to close the VCV (volume control valve)" UWORD _CNV_A_R_LINEAR_____546_CM 1 100. 0. 6553.5 DISPLAY_IDENTIFIER ANG_CLOSE_VCV[0] ECU_ADDRESS 0xd0007308 FORMAT "%7.1" /end MEASUREMENT
/begin MEASUREMENT ang_close_vcv[1] "Angle to close the VCV (volume control valve)" UWORD _CNV_A_R_LINEAR_____546_CM 1 100. 0. 6553.5 DISPLAY_IDENTIFIER ANG_CLOSE_VCV[1] ECU_ADDRESS 0xd000730a FORMAT "%7.1" /end MEASUREMENT
/begin MEASUREMENT ang_open_vcv[0] "Angle to open the VCV (volume control valve)" UWORD _CNV_A_R_LINEAR_____546_CM 1 100. 0. 6553.5 DISPLAY_IDENTIFIER ANG_OPEN_VCV[0] ECU_ADDRESS 0xd0007310 FORMAT "%7.1" /end MEASUREMENT
/begin MEASUREMENT ang_open_vcv[1] "Angle to open the VCV (volume control valve)" UWORD _CNV_A_R_LINEAR_____546_CM 1 100. 0. 6553.5 DISPLAY_IDENTIFIER ANG_OPEN_VCV[1] ECU_ADDRESS 0xd0007312 FORMAT "%7.1" /end MEASUREMENT
/begin MEASUREMENT kphdr_u16_rb[0] "P-part of the rail pressure controller" UWORD _CNV_A_R_LINEAR_____119_CM 1 100. 0. 15.999755859375 DISPLAY_IDENTIFIER KPHDR_U16_RB[0] ECU_ADDRESS 0xd0000d40 FORMAT "%7.4" /end MEASUREMENT
/begin MEASUREMENT kphdr_u16_rb[1] "P-part of the rail pressure controller" UWORD _CNV_A_R_LINEAR_____119_CM 1 100. 0. 15.999755859375 DISPLAY_IDENTIFIER KPHDR_U16_RB[1] ECU_ADDRESS 0xd0000d42 FORMAT "%7.4" /end MEASUREMENT
/begin MEASUREMENT kihdr_u16_rb[0] "I-part of the rail pressure controller" UWORD _CNV_A_R_LINEAR_____119_CM 1 100. 0. 15.999755859375 DISPLAY_IDENTIFIER KIHDR_U16_RB[0] ECU_ADDRESS 0xd0000d3c FORMAT "%7.4" /end MEASUREMENT
/begin MEASUREMENT kihdr_u16_rb[1] "I-part of the rail pressure controller" UWORD _CNV_A_R_LINEAR_____119_CM 1 100. 0. 15.999755859375 DISPLAY_IDENTIFIER KIHDR_U16_RB[1] ECU_ADDRESS 0xd0000d3e FORMAT "%7.4" /end MEASUREMENT
/begin MEASUREMENT vststa_w_rb[0] "Static part in map-based pilot control of the VCV" SWORD _CNV_A_R_LINEAR_____546_CM 1 100. -3276.8 3276.7 DISPLAY_IDENTIFIER VSTSTA_W_RB[0] ECU_ADDRESS 0xd0000d68 FORMAT "%7.1" /end MEASUREMENT
/begin MEASUREMENT vststa_w_rb[1] "Static part in map-based pilot control of the VCV" SWORD _CNV_A_R_LINEAR_____546_CM 1 100. -3276.8 3276.7 DISPLAY_IDENTIFIER VSTSTA_W_RB[1] ECU_ADDRESS 0xd0000d6a FORMAT "%7.1" /end MEASUREMENT
/begin MEASUREMENT tvzmsv_rb[0] "Time delay of the VCV" UBYTE _CNV_A_R_LINEAR_____913_CM 1 100. 0. 12.75 DISPLAY_IDENTIFIER TVZMSV_RB[0] ECU_ADDRESS 0xd0000d9e FORMAT "%5.2" /end MEASUREMENT
/begin MEASUREMENT tvzmsv_rb[1] "Time delay of the VCV" UBYTE _CNV_A_R_LINEAR_____913_CM 1 100. 0. 12.75 DISPLAY_IDENTIFIER TVZMSV_RB[1] ECU_ADDRESS 0xd0000d9f FORMAT "%5.2" /end MEASUREMENT
/begin MEASUREMENT tvzmsvr_rb[0] "Time delay of VCV without delivery angle dependent closing behaviour" UBYTE _CNV_A_R_LINEAR_____913_CM 1 100. 0. 12.75 DISPLAY_IDENTIFIER TVZMSVR_RB[0] ECU_ADDRESS 0xd0000da0 FORMAT "%5.2" /end MEASUREMENT
/begin MEASUREMENT tvzmsvr_rb[1] "Time delay of VCV without delivery angle dependent closing behaviour" UBYTE _CNV_A_R_LINEAR_____913_CM 1 100. 0. 12.75 DISPLAY_IDENTIFIER TVZMSVR_RB[1] ECU_ADDRESS 0xd0000da1 FORMAT "%5.2" /end MEASUREMENT
/begin MEASUREMENT tmp_u16_rb[0] "Converted engine speed in °CRK/ms" UWORD _CNV_A_R_LINEAR_____916_CM 1 100. 0. 98.3025 DISPLAY_IDENTIFIER TMP_U16_RB[0] ECU_ADDRESS 0xd0000d58 FORMAT "%7.4" /end MEASUREMENT
/begin MEASUREMENT tmp_u16_rb[1] "Converted engine speed in °CRK/ms" UWORD _CNV_A_R_LINEAR_____916_CM 1 100. 0. 98.3025 DISPLAY_IDENTIFIER TMP_U16_RB[1] ECU_ADDRESS 0xd0000d5a FORMAT "%7.4" /end MEASUREMENT
/begin MEASUREMENT B_enreq_1_rb[0] "Intermediate boolean of the VCV (volume control valve) control at fuel cut-off" UBYTE _CNV_A_R_LINEAR_____0_CM 1 100. 0. 1. DISPLAY_IDENTIFIER B_ENREQ_1_RB[0] ECU_ADDRESS 0xd0000d7a FORMAT "%1.0" /end MEASUREMENT
/begin MEASUREMENT B_enreq_1_rb[1] "Intermediate boolean of the VCV (volume control valve) control at fuel cut-off" UBYTE _CNV_A_R_LINEAR_____0_CM 1 100. 0. 1. DISPLAY_IDENTIFIER B_ENREQ_1_RB[1] ECU_ADDRESS 0xd0000d7b FORMAT "%1.0" /end MEASUREMENT
/begin MEASUREMENT B_enreq_0_rb[0] "Intermediate boolean of the VCV (volume control valve) control at engine start (= B_enreq in formula section)" UBYTE _CNV_A_R_LINEAR_____0_CM 1 100. 0. 1. DISPLAY_IDENTIFIER B_ENREQ_0_RB[0] ECU_ADDRESS 0xd0000d78 FORMAT "%1.0" /end MEASUREMENT
/begin MEASUREMENT B_enreq_0_rb[1] "Intermediate boolean of the VCV (volume control valve) control at engine start (= B_enreq in formula section)" UBYTE _CNV_A_R_LINEAR_____0_CM 1 100. 0. 1. DISPLAY_IDENTIFIER B_ENREQ_0_RB[1] ECU_ADDRESS 0xd0000d79 FORMAT "%1.0" /end MEASUREMENT
/begin CHARACTERISTIC klvzmsv_rb_0 "VCV time delay depending on battery voltage" CURVE 0xa0808308 _REC_CUR_20_u1_u1 12.75 _CNV_A_R_LINEAR_____913_CM 0. 12.75 DISPLAY_IDENTIFIER KLVZMSV_RB_0 FORMAT "%5.2"
 /begin AXIS_DESCR COM_AXIS ubsqf_rb _CNV_A_R_LINEAR_____425_CM 6 0. 25.5 FORMAT "%4.1" AXIS_PTS_REF ldp_ubsqf_klvzmsv_rb_0 /end AXIS_DESCR
/end CHARACTERISTIC
/begin CHARACTERISTIC klvzmsvt_rb_1 "Correction of the VCV temperature influence" CURVE 0xa08084ca _REC_CUR_20_u1_u1 2. _CNV_A_R_LINEAR_____917_CM 0. 2. DISPLAY_IDENTIFIER KLVZMSVT_RB_1 FORMAT "%6.4"
 /begin AXIS_DESCR COM_AXIS tmsvm_rb[1] _CNV_A_R_LINEAR_____17_CM 3 -48. 143.25 FORMAT "%5.1" AXIS_PTS_REF ldp_tmsvm_klvzmsvt_rb_1 /end AXIS_DESCR
/end CHARACTERISTIC
/begin CHARACTERISTIC sy_camnmsv_rb[0] "System constant (adjustable) for number of cams of the high pressure pump HDP5" VALUE 0xa0808368 _REC_VAL_20_u1 255. _CNV_A_R_LINEAR_____0_CM 0. 255. DISPLAY_IDENTIFIER SY_CAMNMSV_RB[0] FORMAT "%3.0" /end CHARACTERISTIC
/begin CHARACTERISTIC sy_camnmsv_rb[1] "System constant (adjustable) for number of cams of the high pressure pump HDP5" VALUE 0xa0808369 _REC_VAL_20_u1 255. _CNV_A_R_LINEAR_____0_CM 0. 255. DISPLAY_IDENTIFIER SY_CAMNMSV_RB[1] FORMAT "%3.0" /end CHARACTERISTIC
/begin CHARACTERISTIC sy_tmmsv_rb[0] "System constant (calibratable) for activation of the temperature correction (0: inactive; >0: active)" VALUE 0xa080836c _REC_VAL_20_u1 255. _CNV_A_R_LINEAR_____0_CM 0. 255. DISPLAY_IDENTIFIER SY_TMMSV_RB[0] FORMAT "%3.0" /end CHARACTERISTIC
/begin CHARACTERISTIC sy_tmmsv_rb[1] "System constant (calibratable) for activation of the temperature correction (0: inactive; >0: active)" VALUE 0xa080836d _REC_VAL_20_u1 255. _CNV_A_R_LINEAR_____0_CM 0. 255. DISPLAY_IDENTIFIER SY_TMMSV_RB[1] FORMAT "%3.0" /end CHARACTERISTIC
/begin CHARACTERISTIC klvzmsvt_rb_0 "Correction of the VCV temperature influence" CURVE 0xa080830e _REC_CUR_20_u1_u1 2. _CNV_A_R_LINEAR_____917_CM 0. 2. DISPLAY_IDENTIFIER KLVZMSVT_RB_0 FORMAT "%6.4"
 /begin AXIS_DESCR COM_AXIS tmsvm_rb[0] _CNV_A_R_LINEAR_____17_CM 3 -48. 143.25 FORMAT "%5.1" AXIS_PTS_REF ldp_tmsvm_klvzmsvt_rb_0 /end AXIS_DESCR
/end CHARACTERISTIC
/begin CHARACTERISTIC kfvzmsvdw_rb_0 "Correction of the delivery angle dependent closing behaviour (more precise pre-control)" MAP 0xa0808298 _REC_MAP_20_u1_u2_u1 2. _CNV_A_R_LINEAR_____917_CM 0. 2. DISPLAY_IDENTIFIER KFVZMSVDW_RB_0 FORMAT "%6.4"
 /begin AXIS_DESCR COM_AXIS dwmsvd_w_rb[0] _CNV_A_R_LINEAR_____910_CM 4 -3276.8 3276.7 FORMAT "%7.1" AXIS_PTS_REF ldp_dwmsvd_kfvzmsvdw_rb_0 /end AXIS_DESCR
 /begin AXIS_DESCR COM_AXIS nmot_rb _CNV_A_R_LINEAR_____905_CM 4 0. 10200. FORMAT "%6.0" AXIS_PTS_REF ldp_nmot_kfvzmsvdw_rb_0 /end AXIS_DESCR
/end CHARACTERISTIC
/begin CHARACTERISTIC kfvzmsvdw_rb_1 "Correction of the delivery angle dependent closing behaviour (more precise pre-control)" MAP 0xa080845c _REC_MAP_20_u1_u2_u1 2. _CNV_A_R_LINEAR_____917_CM 0. 2. DISPLAY_IDENTIFIER KFVZMSVDW_RB_1 FORMAT "%6.4"
 /begin AXIS_DESCR COM_AXIS dwmsvd_w_rb[1] _CNV_A_R_LINEAR_____910_CM 4 -3276.8 3276.7 FORMAT "%7.1" AXIS_PTS_REF ldp_dwmsvd_kfvzmsvdw_rb_1 /end AXIS_DESCR
 /begin AXIS_DESCR COM_AXIS nmot_rb _CNV_A_R_LINEAR_____905_CM 4 0. 10200. FORMAT "%6.0" AXIS_PTS_REF ldp_nmot_kfvzmsvdw_rb_1 /end AXIS_DESCR
/end CHARACTERISTIC
/begin CHARACTERISTIC cwvstmsv_rb[0] "Configuration map-based pilot control of the VCV" VALUE 0xa080831e _REC_VAL_20_u1 255. _CNV_A_R_LINEAR_____0_CM 0. 255. DISPLAY_IDENTIFIER CWVSTMSV_RB[0] FORMAT "%3.0" /end CHARACTERISTIC
/begin CHARACTERISTIC cwvstmsv_rb[1] "Configuration map-based pilot control of the VCV" VALUE 0xa080831f _REC_VAL_20_u1 255. _CNV_A_R_LINEAR_____0_CM 0. 255. DISPLAY_IDENTIFIER CWVSTMSV_RB[1] FORMAT "%3.0" /end CHARACTERISTIC
/begin CHARACTERISTIC c_t_pls_diag_vcv[0] "Pulse duration of the test pulse for the VCV diagnosis during overrun fuel cutoff" VALUE 0xa0808316 _REC_VAL_20_u1 2.55 _CNV_A_R_INJR_LINEA_466_CM 0. 2.55 DISPLAY_IDENTIFIER C_T_PLS_DIAG_VCV[0] FORMAT "%4.2" /end CHARACTERISTIC
/begin CHARACTERISTIC c_t_pls_diag_vcv[1] "Pulse duration of the test pulse for the VCV diagnosis during overrun fuel cutoff" VALUE 0xa0808317 _REC_VAL_20_u1 2.55 _CNV_A_R_INJR_LINEA_466_CM 0. 2.55 DISPLAY_IDENTIFIER C_T_PLS_DIAG_VCV[1] FORMAT "%4.2" /end CHARACTERISTIC
/begin MEASUREMENT ang_dur_vcv_ctl_1[0] "End of \"Pull-In\" Phase" UWORD _CNV_A_R_LINEAR_____546_CM 1 100. 0. 6553.5 DISPLAY_IDENTIFIER ANG_DUR_VCV_CTL_1[0] ECU_ADDRESS 0xd000730c FORMAT "%7.1" /end MEASUREMENT
/begin MEASUREMENT ang_dur_vcv_ctl_1[1] "End of \"Pull-In\" Phase" UWORD _CNV_A_R_LINEAR_____546_CM 1 100. 0. 6553.5 DISPLAY_IDENTIFIER ANG_DUR_VCV_CTL_1[1] ECU_ADDRESS 0xd000730e FORMAT "%7.1" /end MEASUREMENT
/begin MEASUREMENT pwm_vcv_ctl_1 "Pull-in Phase of VCV control at pulse mode (1st cycle after activation)" UBYTE _CNV_A_R_LINEAR_____5_CM 1 100. 0. 99.609375 DISPLAY_IDENTIFIER PWM_VCV_CTL_1 ECU_ADDRESS 0xd0000d8e FORMAT "%9.6" /end MEASUREMENT
/begin MEASUREMENT pwm_vcv_ctl_2 "Duty cycle of VCV control at pulse mode (2nd cycle)" UBYTE _CNV_A_R_LINEAR_____5_CM 1 100. 0. 99.609375 DISPLAY_IDENTIFIER PWM_VCV_CTL_2 ECU_ADDRESS 0xd00077f8 FORMAT "%9.6" /end MEASUREMENT
/begin MEASUREMENT tamsvac_rb "Duty cycle of VCV control at pulse mode (2nd cycle)" UBYTE _CNV_A_R_LINEAR_____5_CM 1 100. 0. 99.609375 DISPLAY_IDENTIFIER TAMSVAC_RB ECU_ADDRESS 0xd0000d8f FORMAT "%9.6" /end MEASUREMENT
/begin CHARACTERISTIC kltamsvub_rb "Characteristic map duty cycle % for 4KHz signal(Control duty cycle in PWM holding phase, Normal operating mode)" CURVE 0xa08082f0 _REC_CUR_20_u1_u1 99.609375 _CNV_A_R_LINEAR_____5_CM 0. 99.609375 DISPLAY_IDENTIFIER KLTAMSVUB_RB FORMAT "%9.6"
 /begin AXIS_DESCR COM_AXIS ubsqf_rb _CNV_A_R_LINEAR_____425_CM 6 0. 25.5 FORMAT "%4.1" AXIS_PTS_REF ldp_ubsqf_kltamsvub_rb /end AXIS_DESCR
/end CHARACTERISTIC
/begin MEASUREMENT B_tmsvmg_rb[0] "VCV temperature from model valid " UBYTE _CNV_A_R_LINEAR_____0_CM 1 100. 0. 1. DISPLAY_IDENTIFIER B_TMSVMG_RB[0] ECU_ADDRESS 0xd0000d8a FORMAT "%1.0" /end MEASUREMENT
/begin MEASUREMENT B_tmsvmg_rb[1] "VCV temperature from model valid " UBYTE _CNV_A_R_LINEAR_____0_CM 1 100. 0. 1. DISPLAY_IDENTIFIER B_TMSVMG_RB[1] ECU_ADDRESS 0xd0000d8b FORMAT "%1.0" /end MEASUREMENT
/begin MEASUREMENT tmsvtmtf_rb[0] "Filtered engine temperature for VCV temperature calculation" UBYTE _CNV_A_R_LINEAR_____17_CM 1 100. -48. 143.25 DISPLAY_IDENTIFIER TMSVTMTF_RB[0] ECU_ADDRESS 0xd0000d9a FORMAT "%5.1" /end MEASUREMENT
/begin MEASUREMENT tmsvtmtf_rb[1] "Filtered engine temperature for VCV temperature calculation" UBYTE _CNV_A_R_LINEAR_____17_CM 1 100. -48. 143.25 DISPLAY_IDENTIFIER TMSVTMTF_RB[1] ECU_ADDRESS 0xd0000d9b FORMAT "%5.1" /end MEASUREMENT
/begin MEASUREMENT tmsvtflf_rb[0] "Filtered fuel temperature for VCV temperature calculation" UBYTE _CNV_A_R_LINEAR_____17_CM 1 100. -48. 143.25 DISPLAY_IDENTIFIER TMSVTFLF_RB[0] ECU_ADDRESS 0xd0000d98 FORMAT "%5.1" /end MEASUREMENT
/begin MEASUREMENT tmsvtflf_rb[1] "Filtered fuel temperature for VCV temperature calculation" UBYTE _CNV_A_R_LINEAR_____17_CM 1 100. -48. 143.25 DISPLAY_IDENTIFIER TMSVTFLF_RB[1] ECU_ADDRESS 0xd0000d99 FORMAT "%5.1" /end MEASUREMENT
/begin MEASUREMENT tmsvtmtst_rb[0] "Weighting between engine temperature and fuel temperature" UBYTE _CNV_A_R_LINEAR_____17_CM 1 100. -48. 143.25 DISPLAY_IDENTIFIER TMSVTMTST_RB[0] ECU_ADDRESS 0xd0000d9c FORMAT "%5.1" /end MEASUREMENT
/begin MEASUREMENT tmsvtmtst_rb[1] "Weighting between engine temperature and fuel temperature" UBYTE _CNV_A_R_LINEAR_____17_CM 1 100. -48. 143.25 DISPLAY_IDENTIFIER TMSVTMTST_RB[1] ECU_ADDRESS 0xd0000d9d FORMAT "%5.1" /end MEASUREMENT
/begin MEASUREMENT tmsvm_rb[0] "Calculated VCV solenoid temperature" UBYTE _CNV_A_R_LINEAR_____17_CM 1 100. -48. 143.25 DISPLAY_IDENTIFIER TMSVM_RB[0] ECU_ADDRESS 0xd0000d96 FORMAT "%5.1" /end MEASUREMENT
/begin MEASUREMENT tmsvm_rb[1] "Calculated VCV solenoid temperature" UBYTE _CNV_A_R_LINEAR_____17_CM 1 100. -48. 143.25 DISPLAY_IDENTIFIER TMSVM_RB[1] ECU_ADDRESS 0xd0000d97 FORMAT "%5.1" /end MEASUREMENT
/begin MEASUREMENT tmsveig_rb[0] "Self-heating temperature of the VCV solenoid" UBYTE _CNV_A_R_LINEAR_____17_CM 1 100. -48. 143.25 DISPLAY_IDENTIFIER TMSVEIG_RB[0] ECU_ADDRESS 0xd0000d92 FORMAT "%5.1" /end MEASUREMENT
/begin MEASUREMENT tmsveig_rb[1] "Self-heating temperature of the VCV solenoid" UBYTE _CNV_A_R_LINEAR_____17_CM 1 100. -48. 143.25 DISPLAY_IDENTIFIER TMSVEIG_RB[1] ECU_ADDRESS 0xd0000d93 FORMAT "%5.1" /end MEASUREMENT
/begin MEASUREMENT tmsveigf_rb[0] "Filtered self-heating temperature of the VCV solenoid" UBYTE _CNV_A_R_LINEAR_____17_CM 1 100. -48. 143.25 DISPLAY_IDENTIFIER TMSVEIGF_RB[0] ECU_ADDRESS 0xd0000d94 FORMAT "%5.1" /end MEASUREMENT
/begin MEASUREMENT tmsveigf_rb[1] "Filtered self-heating temperature of the VCV solenoid" UBYTE _CNV_A_R_LINEAR_____17_CM 1 100. -48. 143.25 DISPLAY_IDENTIFIER TMSVEIGF_RB[1] ECU_ADDRESS 0xd0000d95 FORMAT "%5.1" /end MEASUREMENT
/begin CHARACTERISTIC cwtmsv_rb[0] "Configuration for activation of VCV temperature model" VALUE 0xa080831c _REC_VAL_20_u1 255. _CNV_A_R_LINEAR_____0_CM 0. 255. DISPLAY_IDENTIFIER CWTMSV_RB[0] FORMAT "%3.0" /end CHARACTERISTIC
/begin CHARACTERISTIC cwtmsv_rb[1] "Configuration for activation of VCV temperature model" VALUE 0xa080831d _REC_VAL_20_u1 255. _CNV_A_R_LINEAR_____0_CM 0. 255. DISPLAY_IDENTIFIER CWTMSV_RB[1] FORMAT "%3.0" /end CHARACTERISTIC
/begin CHARACTERISTIC tmsvapl_rb[0] "Application parameter of VCV temperature" VALUE 0xa0808376 _REC_VAL_20_u1 191.25 _CNV_A_R_LINEAR_____17_CM -48. 143.25 DISPLAY_IDENTIFIER TMSVAPL_RB[0] FORMAT "%5.1" /end CHARACTERISTIC
/begin CHARACTERISTIC tmsvapl_rb[1] "Application parameter of VCV temperature" VALUE 0xa0808377 _REC_VAL_20_u1 191.25 _CNV_A_R_LINEAR_____17_CM -48. 143.25 DISPLAY_IDENTIFIER TMSVAPL_RB[1] FORMAT "%5.1" /end CHARACTERISTIC
/begin CHARACTERISTIC ttmt_rb[0] "Time constant for engine temperature lowpass filter" VALUE 0xa0808384 _REC_VAL_20_u2 0.9999847412109381 _CNV_A_R_LINEAR_____89_CM 0. 0.9999847412109381 DISPLAY_IDENTIFIER TTMT_RB[0] FORMAT "%7.5" /end CHARACTERISTIC
/begin CHARACTERISTIC ttmt_rb[1] "Time constant for engine temperature lowpass filter" VALUE 0xa0808386 _REC_VAL_20_u2 0.9999847412109381 _CNV_A_R_LINEAR_____89_CM 0. 0.9999847412109381 DISPLAY_IDENTIFIER TTMT_RB[1] FORMAT "%7.5" /end CHARACTERISTIC
/begin CHARACTERISTIC ttfl_rb[0] "Time constant for fuel temperature lowpass filter" VALUE 0xa0808380 _REC_VAL_20_u2 0.9999847412109381 _CNV_A_R_LINEAR_____89_CM 0. 0.9999847412109381 DISPLAY_IDENTIFIER TTFL_RB[0] FORMAT "%7.5" /end CHARACTERISTIC
/begin CHARACTERISTIC ttfl_rb[1] "Time constant for fuel temperature lowpass filter" VALUE 0xa0808382 _REC_VAL_20_u2 0.9999847412109381 _CNV_A_R_LINEAR_____89_CM 0. 0.9999847412109381 DISPLAY_IDENTIFIER TTFL_RB[1] FORMAT "%7.5" /end CHARACTERISTIC
/begin CHARACTERISTIC teig_rb[0] "Time constant for self-heating temperature lowpass filter" VALUE 0xa080836e _REC_VAL_20_u2 0.9999847412109381 _CNV_A_R_LINEAR_____89_CM 0. 0.9999847412109381 DISPLAY_IDENTIFIER TEIG_RB[0] FORMAT "%7.5" /end CHARACTERISTIC
/begin CHARACTERISTIC teig_rb[1] "Time constant for self-heating temperature lowpass filter" VALUE 0xa0808370 _REC_VAL_20_u2 0.9999847412109381 _CNV_A_R_LINEAR_____89_CM 0. 0.9999847412109381 DISPLAY_IDENTIFIER TEIG_RB[1] FORMAT "%7.5" /end CHARACTERISTIC
/begin CHARACTERISTIC tmsvquali_rb[0] "Time constant for the steady state of tmsvm_rb" VALUE 0xa0808378 _REC_VAL_20_u2 13107. _CNV_A_R_LINEAR_____438_CM 0. 13107. DISPLAY_IDENTIFIER TMSVQUALI_RB[0] FORMAT "%7.1" /end CHARACTERISTIC
/begin CHARACTERISTIC tmsvquali_rb[1] "Time constant for the steady state of tmsvm_rb" VALUE 0xa080837a _REC_VAL_20_u2 13107. _CNV_A_R_LINEAR_____438_CM 0. 13107. DISPLAY_IDENTIFIER TMSVQUALI_RB[1] FORMAT "%7.1" /end CHARACTERISTIC
/begin CHARACTERISTIC fkttfuel_rb[0] "Scale factor for fuel temperature" VALUE 0xa0808344 _REC_VAL_20_u1 12.451172 _CNV_A_R_LINEAR_____918_CM 0. 12.451172 DISPLAY_IDENTIFIER FKTTFUEL_RB[0] /end CHARACTERISTIC
/begin CHARACTERISTIC fkttfuel_rb[1] "Scale factor for fuel temperature" VALUE 0xa0808345 _REC_VAL_20_u1 12.451172 _CNV_A_R_LINEAR_____918_CM 0. 12.451172 DISPLAY_IDENTIFIER FKTTFUEL_RB[1] /end CHARACTERISTIC
/begin CHARACTERISTIC klftmsv_rb_0 "Time influence of engine temperature on VCV temperature" CURVE 0xa08082b8 _REC_CUR_20_u1_u2 0.99609375 _CNV_A_R_LINEAR_____185_CM 0. 0.99609375 DISPLAY_IDENTIFIER KLFTMSV_RB_0 FORMAT "%5.3"
 /begin AXIS_DESCR COM_AXIS tnse_w_rb _CNV_A_R_LINEAR_____4_CM 4 0. 6553.5 FORMAT "%6.1" AXIS_PTS_REF ldp_tnse_w_klftmsv_rb_0 /end AXIS_DESCR
/end CHARACTERISTIC
/begin CHARACTERISTIC klftmsv_rb_1 "Time influence of engine temperature on VCV temperature" CURVE 0xa080847c _REC_CUR_20_u1_u2 0.99609375 _CNV_A_R_LINEAR_____185_CM 0. 0.99609375 DISPLAY_IDENTIFIER KLFTMSV_RB_1 FORMAT "%5.3"
 /begin AXIS_DESCR COM_AXIS tnse_w_rb _CNV_A_R_LINEAR_____4_CM 4 0. 6553.5 FORMAT "%6.1" AXIS_PTS_REF ldp_tnse_w_klftmsv_rb_1 /end AXIS_DESCR
/end CHARACTERISTIC
/begin CHARACTERISTIC klnmtmsv_rb_0 "Influence of effective power dissipation on VCV temperature" CURVE 0xa08082d4 _REC_CUR_20_u1_u1 191.25 _CNV_A_R_LINEAR_____17_CM -48. 143.25 DISPLAY_IDENTIFIER KLNMTMSV_RB_0 FORMAT "%5.1"
 /begin AXIS_DESCR COM_AXIS nmot_rb _CNV_A_R_LINEAR_____905_CM 4 0. 10200. FORMAT "%6.0" AXIS_PTS_REF ldp_nmot_klnmtmsv_rb_0 /end AXIS_DESCR
/end CHARACTERISTIC
/begin CHARACTERISTIC klnmtmsv_rb_1 "Influence of effective power dissipation on VCV temperature" CURVE 0xa0808498 _REC_CUR_20_u1_u1 191.25 _CNV_A_R_LINEAR_____17_CM -48. 143.25 DISPLAY_IDENTIFIER KLNMTMSV_RB_1 FORMAT "%5.1"
 /begin AXIS_DESCR COM_AXIS nmot_rb _CNV_A_R_LINEAR_____905_CM 4 0. 10200. FORMAT "%6.0" AXIS_PTS_REF ldp_nmot_klnmtmsv_rb_1 /end AXIS_DESCR
/end CHARACTERISTIC
/begin MEASUREMENT B_msvzpa_rb[0] "Two-point-control active" UBYTE _CNV_A_R_LINEAR_____0_CM 1 100. 0. 1. DISPLAY_IDENTIFIER B_MSVZPA_RB[0] ECU_ADDRESS 0xd0000d86 FORMAT "%1.0" /end MEASUREMENT
/begin MEASUREMENT B_msvzpa_rb[1] "Two-point-control active" UBYTE _CNV_A_R_LINEAR_____0_CM 1 100. 0. 1. DISPLAY_IDENTIFIER B_MSVZPA_RB[1] ECU_ADDRESS 0xd0000d87 FORMAT "%1.0" /end MEASUREMENT
/begin MEASUREMENT B_msvzpa0_rb[0] "Two-point-control active (inside two-point control block)" UBYTE _CNV_A_R_LINEAR_____0_CM 1 100. 0. 1. DISPLAY_IDENTIFIER B_MSVZPA0_RB[0] ECU_ADDRESS 0xd0000d84 FORMAT "%1.0" /end MEASUREMENT
/begin MEASUREMENT B_msvzpa0_rb[1] "Two-point-control active (inside two-point control block)" UBYTE _CNV_A_R_LINEAR_____0_CM 1 100. 0. 1. DISPLAY_IDENTIFIER B_MSVZPA0_RB[1] ECU_ADDRESS 0xd0000d85 FORMAT "%1.0" /end MEASUREMENT
/begin MEASUREMENT vstmsvfg_w_rb[0] "Slope factor of pilot control" UWORD _CNV_A_R_LINEAR_____24_CM 1 100. 0. 3.99993896484375 DISPLAY_IDENTIFIER VSTMSVFG_W_RB[0] ECU_ADDRESS 0xd0000d5c FORMAT "%7.5" /end MEASUREMENT
/begin MEASUREMENT vstmsvfg_w_rb[1] "Slope factor of pilot control" UWORD _CNV_A_R_LINEAR_____24_CM 1 100. 0. 3.99993896484375 DISPLAY_IDENTIFIER VSTMSVFG_W_RB[1] ECU_ADDRESS 0xd0000d5e FORMAT "%7.5" /end MEASUREMENT
/begin CHARACTERISTIC dwvstmsvst_rb[0] "Initial value of pilot control in case of high pressure start" VALUE 0xa080833c _REC_VAL_20_s2 6553.5 _CNV_A_R_LINEAR_____546_CM -3276.8 3276.7 DISPLAY_IDENTIFIER DWVSTMSVST_RB[0] FORMAT "%7.1" /end CHARACTERISTIC
/begin CHARACTERISTIC dwvstmsvst_rb[1] "Initial value of pilot control in case of high pressure start" VALUE 0xa080833e _REC_VAL_20_s2 6553.5 _CNV_A_R_LINEAR_____546_CM -3276.8 3276.7 DISPLAY_IDENTIFIER DWVSTMSVST_RB[1] FORMAT "%7.1" /end CHARACTERISTIC
/begin CHARACTERISTIC dwvstmsvap_rb[0] "Application value for pilot control" VALUE 0xa0808338 _REC_VAL_20_s2 6553.5 _CNV_A_R_LINEAR_____546_CM -3276.8 3276.7 DISPLAY_IDENTIFIER DWVSTMSVAP_RB[0] FORMAT "%7.1" /end CHARACTERISTIC
/begin CHARACTERISTIC dwvstmsvap_rb[1] "Application value for pilot control" VALUE 0xa080833a _REC_VAL_20_s2 6553.5 _CNV_A_R_LINEAR_____546_CM -3276.8 3276.7 DISPLAY_IDENTIFIER DWVSTMSVAP_RB[1] FORMAT "%7.1" /end CHARACTERISTIC
/begin CHARACTERISTIC nmsvzpah_rb[0] "Hysteresis of engine speed threshold for two-point-control of VCV" VALUE 0xa080834a _REC_VAL_20_u1 10200. _CNV_A_R_LINEAR_____905_CM 0. 10200. DISPLAY_IDENTIFIER NMSVZPAH_RB[0] FORMAT "%6.0" /end CHARACTERISTIC
/begin CHARACTERISTIC nmsvzpah_rb[1] "Hysteresis of engine speed threshold for two-point-control of VCV" VALUE 0xa080834b _REC_VAL_20_u1 10200. _CNV_A_R_LINEAR_____905_CM 0. 10200. DISPLAY_IDENTIFIER NMSVZPAH_RB[1] FORMAT "%6.0" /end CHARACTERISTIC
/begin CHARACTERISTIC nmsvzpas_rb[0] "Engine speed threshold for two-point-control of VCV" VALUE 0xa080834c _REC_VAL_20_u1 10200. _CNV_A_R_LINEAR_____905_CM 0. 10200. DISPLAY_IDENTIFIER NMSVZPAS_RB[0] FORMAT "%6.0" /end CHARACTERISTIC
/begin CHARACTERISTIC nmsvzpas_rb[1] "Engine speed threshold for two-point-control of VCV" VALUE 0xa080834d _REC_VAL_20_u1 10200. _CNV_A_R_LINEAR_____905_CM 0. 10200. DISPLAY_IDENTIFIER NMSVZPAS_RB[1] FORMAT "%6.0" /end CHARACTERISTIC
/begin CHARACTERISTIC rkmsvzpah_rb[0] "Hysteresis of load threshold for two-point-control of VCV" VALUE 0xa0808360 _REC_VAL_20_u2 3071.953125 _CNV_A_R_LINEAR_____919_CM 0. 3071.953125 DISPLAY_IDENTIFIER RKMSVZPAH_RB[0] FORMAT "%7.2" /end CHARACTERISTIC
/begin CHARACTERISTIC rkmsvzpah_rb[1] "Hysteresis of load threshold for two-point-control of VCV" VALUE 0xa0808362 _REC_VAL_20_u2 3071.953125 _CNV_A_R_LINEAR_____919_CM 0. 3071.953125 DISPLAY_IDENTIFIER RKMSVZPAH_RB[1] FORMAT "%7.2" /end CHARACTERISTIC
/begin CHARACTERISTIC rkmsvzpas_rb[0] "Load threshold for two-point-control of VCV" VALUE 0xa0808364 _REC_VAL_20_u2 3071.953125 _CNV_A_R_LINEAR_____919_CM 0. 3071.953125 DISPLAY_IDENTIFIER RKMSVZPAS_RB[0] FORMAT "%7.2" /end CHARACTERISTIC
/begin CHARACTERISTIC rkmsvzpas_rb[1] "Load threshold for two-point-control of VCV" VALUE 0xa0808366 _REC_VAL_20_u2 3071.953125 _CNV_A_R_LINEAR_____919_CM 0. 3071.953125 DISPLAY_IDENTIFIER RKMSVZPAS_RB[1] FORMAT "%7.2" /end CHARACTERISTIC
/begin CHARACTERISTIC tnstmsvzpa_rb[0] "Minimum time threshold after start for two-point-control of VCV" VALUE 0xa080837c _REC_VAL_20_u2 6553.5 _CNV_A_R_LINEAR_____4_CM 0. 6553.5 DISPLAY_IDENTIFIER TNSTMSVZPA_RB[0] FORMAT "%6.1" /end CHARACTERISTIC
/begin CHARACTERISTIC tnstmsvzpa_rb[1] "Minimum time threshold after start for two-point-control of VCV" VALUE 0xa080837e _REC_VAL_20_u2 6553.5 _CNV_A_R_LINEAR_____4_CM 0. 6553.5 DISPLAY_IDENTIFIER TNSTMSVZPA_RB[1] FORMAT "%6.1" /end CHARACTERISTIC
/begin CHARACTERISTIC tmmsvzpao_rb[0] "Upper engine temperature threshold for two-point-control of VCV" VALUE 0xa0808372 _REC_VAL_20_u1 191.25 _CNV_A_R_LINEAR_____17_CM -48. 143.25 DISPLAY_IDENTIFIER TMMSVZPAO_RB[0] FORMAT "%5.1" /end CHARACTERISTIC
/begin CHARACTERISTIC tmmsvzpao_rb[1] "Upper engine temperature threshold for two-point-control of VCV" VALUE 0xa0808373 _REC_VAL_20_u1 191.25 _CNV_A_R_LINEAR_____17_CM -48. 143.25 DISPLAY_IDENTIFIER TMMSVZPAO_RB[1] FORMAT "%5.1" /end CHARACTERISTIC
/begin CHARACTERISTIC tmmsvzpau_rb[0] "Lower engine temperature threshold for two-point-control of VCV" VALUE 0xa0808374 _REC_VAL_20_u1 191.25 _CNV_A_R_LINEAR_____17_CM -48. 143.25 DISPLAY_IDENTIFIER TMMSVZPAU_RB[0] FORMAT "%5.1" /end CHARACTERISTIC
/begin CHARACTERISTIC tmmsvzpau_rb[1] "Lower engine temperature threshold for two-point-control of VCV" VALUE 0xa0808375 _REC_VAL_20_u1 191.25 _CNV_A_R_LINEAR_____17_CM -48. 143.25 DISPLAY_IDENTIFIER TMMSVZPAU_RB[1] FORMAT "%5.1" /end CHARACTERISTIC
/begin CHARACTERISTIC klfvstgtf_rb_0 "Slope correction of pilot control dependent of fuel temperature" CURVE 0xa08082bc _REC_CUR_20_u1_u1 1.9921875 _CNV_A_R_LINEAR_____103_CM 0. 1.9921875 DISPLAY_IDENTIFIER KLFVSTGTF_RB_0 FORMAT "%5.3"
 /begin AXIS_DESCR COM_AXIS tfuelsq_rb _CNV_A_R_LINEAR_____17_CM 3 -48. 143.25 FORMAT "%5.1" AXIS_PTS_REF ldp_tfuelsq_klfvstgtf_rb_0 /end AXIS_DESCR
/end CHARACTERISTIC
/begin CHARACTERISTIC klfvstgtf_rb_1 "Slope correction of pilot control dependent of fuel temperature" CURVE 0xa0808480 _REC_CUR_20_u1_u1 1.9921875 _CNV_A_R_LINEAR_____103_CM 0. 1.9921875 DISPLAY_IDENTIFIER KLFVSTGTF_RB_1 FORMAT "%5.3"
 /begin AXIS_DESCR COM_AXIS tfuelsq_rb _CNV_A_R_LINEAR_____17_CM 3 -48. 143.25 FORMAT "%5.1" AXIS_PTS_REF ldp_tfuelsq_klfvstgtf_rb_1 /end AXIS_DESCR
/end CHARACTERISTIC
/begin CHARACTERISTIC klfvstotf_rb_0 "Offset correction of pilot control dependent of fuel temperature" CURVE 0xa08082c0 _REC_CUR_20_u1_u1 1.9921875 _CNV_A_R_LINEAR_____103_CM 0. 1.9921875 DISPLAY_IDENTIFIER KLFVSTOTF_RB_0 FORMAT "%5.3"
 /begin AXIS_DESCR COM_AXIS tfuelsq_rb _CNV_A_R_LINEAR_____17_CM 3 -48. 143.25 FORMAT "%5.1" AXIS_PTS_REF ldp_tfuelsq_klfvstotf_rb_0 /end AXIS_DESCR
/end CHARACTERISTIC
/begin CHARACTERISTIC klfvstotf_rb_1 "Offset correction of pilot control dependent of fuel temperature" CURVE 0xa0808484 _REC_CUR_20_u1_u1 1.9921875 _CNV_A_R_LINEAR_____103_CM 0. 1.9921875 DISPLAY_IDENTIFIER KLFVSTOTF_RB_1 FORMAT "%5.3"
 /begin AXIS_DESCR COM_AXIS tfuelsq_rb _CNV_A_R_LINEAR_____17_CM 3 -48. 143.25 FORMAT "%5.1" AXIS_PTS_REF ldp_tfuelsq_klfvstotf_rb_1 /end AXIS_DESCR
/end CHARACTERISTIC
/begin MEASUREMENT B_cononmsv_rb[0] "Condition for permanent current feed of the VCV for high pressure start" UBYTE _CNV_A_R_LINEAR_____0_CM 1 100. 0. 1. DISPLAY_IDENTIFIER B_CONONMSV_RB[0] ECU_ADDRESS 0xd0000d74 FORMAT "%1.0" /end MEASUREMENT
/begin MEASUREMENT B_cononmsv_rb[1] "Condition for permanent current feed of the VCV for high pressure start" UBYTE _CNV_A_R_LINEAR_____0_CM 1 100. 0. 1. DISPLAY_IDENTIFIER B_CONONMSV_RB[1] ECU_ADDRESS 0xd0000d75 FORMAT "%1.0" /end MEASUREMENT
/begin MEASUREMENT B_tmpst_rb "Boolean which indicates high pressure start request" UBYTE _CNV_A_R_LINEAR_____0_CM 1 100. 0. 1. DISPLAY_IDENTIFIER B_TMPST_RB ECU_ADDRESS 0xd0000d88 FORMAT "%1.0" /end MEASUREMENT
/begin MEASUREMENT whzmsv_w_rb[0] "Angle for dwell time of the VCV control" UWORD _CNV_A_R_LINEAR_____546_CM 1 100. 0. 6553.5 DISPLAY_IDENTIFIER WHZMSV_W_RB[0] ECU_ADDRESS 0xd0000d6c FORMAT "%7.1" /end MEASUREMENT
/begin MEASUREMENT whzmsv_w_rb[1] "Angle for dwell time of the VCV control" UWORD _CNV_A_R_LINEAR_____546_CM 1 100. 0. 6553.5 DISPLAY_IDENTIFIER WHZMSV_W_RB[1] ECU_ADDRESS 0xd0000d6e FORMAT "%7.1" /end MEASUREMENT
/begin MEASUREMENT B_dwmsvmn_rb[0] "Bit which indicates dwmsvovb_w less or equal dwmsvmn_w" UBYTE _CNV_A_R_LINEAR_____0_CM 1 100. 0. 1. DISPLAY_IDENTIFIER B_DWMSVMN_RB[0] ECU_ADDRESS 0xd0000d76 FORMAT "%1.0" /end MEASUREMENT
/begin MEASUREMENT B_dwmsvmn_rb[1] "Bit which indicates dwmsvovb_w less or equal dwmsvmn_w" UBYTE _CNV_A_R_LINEAR_____0_CM 1 100. 0. 1. DISPLAY_IDENTIFIER B_DWMSVMN_RB[1] ECU_ADDRESS 0xd0000d77 FORMAT "%1.0" /end MEASUREMENT
/begin MEASUREMENT dwmsvmn_w_rb[0] "Angle Limited angle for maximal delivery mass" SWORD _CNV_A_R_LINEAR_____546_CM 1 100. -360. 360. DISPLAY_IDENTIFIER DWMSVMN_W_RB[0] ECU_ADDRESS 0xd0000d28 FORMAT "%6.1" /end MEASUREMENT
/begin MEASUREMENT dwmsvmn_w_rb[1] "Angle Limited angle for maximal delivery mass" SWORD _CNV_A_R_LINEAR_____546_CM 1 100. -360. 360. DISPLAY_IDENTIFIER DWMSVMN_W_RB[1] ECU_ADDRESS 0xd0000d2a FORMAT "%6.1" /end MEASUREMENT
/begin CHARACTERISTIC cwamsv_rb[0] "Code word for drive of VCV" VALUE 0xa0808318 _REC_VAL_20_u1 255. _CNV_A_R_LINEAR_____0_CM 0. 255. DISPLAY_IDENTIFIER CWAMSV_RB[0] FORMAT "%3.0" /end CHARACTERISTIC
/begin CHARACTERISTIC cwamsv_rb[1] "Code word for drive of VCV" VALUE 0xa0808319 _REC_VAL_20_u1 255. _CNV_A_R_LINEAR_____0_CM 0. 255. DISPLAY_IDENTIFIER CWAMSV_RB[1] FORMAT "%3.0" /end CHARACTERISTIC
/begin CHARACTERISTIC prmsvhdst_rb[0] "Pressure threshold for maximum drive of the VCV during high pressure start" VALUE 0xa0808356 _REC_VAL_20_u1 32.64 _CNV_A_R_LINEAR_____912_CM 0. 32.64 DISPLAY_IDENTIFIER PRMSVHDST_RB[0] FORMAT "%5.2" /end CHARACTERISTIC
/begin CHARACTERISTIC prmsvhdst_rb[1] "Pressure threshold for maximum drive of the VCV during high pressure start" VALUE 0xa0808357 _REC_VAL_20_u1 32.64 _CNV_A_R_LINEAR_____912_CM 0. 32.64 DISPLAY_IDENTIFIER PRMSVHDST_RB[1] FORMAT "%5.2" /end CHARACTERISTIC
/begin CHARACTERISTIC prminsaof_rb[0] "Offset rail pressure during cylinder cut off for activation high pressure control" VALUE 0xa0808354 _REC_VAL_20_u1 32.64 _CNV_A_R_LINEAR_____912_CM 0. 32.64 DISPLAY_IDENTIFIER PRMINSAOF_RB[0] FORMAT "%5.2" /end CHARACTERISTIC
/begin CHARACTERISTIC prminsaof_rb[1] "Offset rail pressure during cylinder cut off for activation high pressure control" VALUE 0xa0808355 _REC_VAL_20_u1 32.64 _CNV_A_R_LINEAR_____912_CM 0. 32.64 DISPLAY_IDENTIFIER PRMINSAOF_RB[1] FORMAT "%5.2" /end CHARACTERISTIC
/begin CHARACTERISTIC kfwhzmsv_rb_0 "Angle for dwell time VCV control" MAP 0xa08082a8 _REC_MAP_20_u1_u1_u1 255. _CNV_A_R_LINEAR_____920_CM 0. 255. DISPLAY_IDENTIFIER KFWHZMSV_RB_0 FORMAT "%3.0"
 /begin AXIS_DESCR COM_AXIS nmot_rb _CNV_A_R_LINEAR_____905_CM 5 0. 10200. FORMAT "%6.0" AXIS_PTS_REF ldp_nmot_kfwhzmsv_rb_0 /end AXIS_DESCR
 /begin AXIS_DESCR COM_AXIS ubsqf_rb _CNV_A_R_LINEAR_____425_CM 3 0. 25.5 FORMAT "%4.1" AXIS_PTS_REF ldp_ubsqf_kfwhzmsv_rb_0 /end AXIS_DESCR
/end CHARACTERISTIC
/begin CHARACTERISTIC kfwhzmsv_rb_1 "Angle for dwell time VCV control" MAP 0xa080846c _REC_MAP_20_u1_u1_u1 255. _CNV_A_R_LINEAR_____920_CM 0. 255. DISPLAY_IDENTIFIER KFWHZMSV_RB_1 FORMAT "%3.0"
 /begin AXIS_DESCR COM_AXIS nmot_rb _CNV_A_R_LINEAR_____905_CM 5 0. 10200. FORMAT "%6.0" AXIS_PTS_REF ldp_nmot_kfwhzmsv_rb_1 /end AXIS_DESCR
 /begin AXIS_DESCR COM_AXIS ubsqf_rb _CNV_A_R_LINEAR_____425_CM 3 0. 25.5 FORMAT "%4.1" AXIS_PTS_REF ldp_ubsqf_kfwhzmsv_rb_1 /end AXIS_DESCR
/end CHARACTERISTIC
/begin CHARACTERISTIC sy_fsszpa_rb[0] "System constant (calibratable) for two point control of HPP" VALUE 0xa080836a _REC_VAL_20_u1 255. _CNV_A_R_LINEAR_____0_CM 0. 255. DISPLAY_IDENTIFIER SY_FSSZPA_RB[0] FORMAT "%3.0" /end CHARACTERISTIC
/begin CHARACTERISTIC sy_fsszpa_rb[1] "System constant (calibratable) for two point control of HPP" VALUE 0xa080836b _REC_VAL_20_u1 255. _CNV_A_R_LINEAR_____0_CM 0. 255. DISPLAY_IDENTIFIER SY_FSSZPA_RB[1] FORMAT "%3.0" /end CHARACTERISTIC
/begin CHARACTERISTIC c_t_max_vcv_ctl_st[0] "Time limitation for Start - Phase" VALUE 0xa0808312 _REC_VAL_20_u2 655.35 _CNV_A_R_LINEAR_____3_CM 0. 655.35 DISPLAY_IDENTIFIER C_T_MAX_VCV_CTL_ST[0] FORMAT "%6.2" /end CHARACTERISTIC
/begin CHARACTERISTIC c_t_max_vcv_ctl_st[1] "Time limitation for Start - Phase" VALUE 0xa0808314 _REC_VAL_20_u2 655.35 _CNV_A_R_LINEAR_____3_CM 0. 655.35 DISPLAY_IDENTIFIER C_T_MAX_VCV_CTL_ST[1] FORMAT "%6.2" /end CHARACTERISTIC
/begin CHARACTERISTIC nc_t_dur_max "Safety time limitation for MFLStart action ( NC_TDUR_MAX = 3,01E3  ms )" VALUE 0xa0808348 _REC_VAL_20_u2 16383. _CNV_A_R_LINEAR_____92_CM 0. 16383. DISPLAY_IDENTIFIER NC_T_DUR_MAX FORMAT "%5.0" /end CHARACTERISTIC
/begin MEASUREMENT frkkma_rb[0] "Auxiliary variable gain part in map-based pilot control of the VCV" UBYTE _CNV_A_R_LINEAR_____921_CM 1 100. 0. 7.96875 DISPLAY_IDENTIFIER FRKKMA_RB[0] ECU_ADDRESS 0xd0000d8c FORMAT "%4.2" /end MEASUREMENT
/begin MEASUREMENT frkkma_rb[1] "Auxiliary variable gain part in map-based pilot control of the VCV" UBYTE _CNV_A_R_LINEAR_____921_CM 1 100. 0. 7.96875 DISPLAY_IDENTIFIER FRKKMA_RB[1] ECU_ADDRESS 0xd0000d8d FORMAT "%4.2" /end MEASUREMENT
/begin MEASUREMENT tamsvst_rb "Duty cycle of VCV control at pulse mode at START phase" UBYTE _CNV_A_R_LINEAR_____5_CM 1 100. 0. 99.609375 DISPLAY_IDENTIFIER TAMSVST_RB ECU_ADDRESS 0xd0000d90 FORMAT "%9.6" /end MEASUREMENT
/begin MEASUREMENT pwm_vcv_ctl_st "Duty cycle of VCV control at pulse mode at START phase" UBYTE _CNV_A_R_LINEAR_____5_CM 1 100. 0. 99.609375 DISPLAY_IDENTIFIER PWM_VCV_CTL_ST ECU_ADDRESS 0xd00077f9 FORMAT "%9.6" /end MEASUREMENT
/begin CHARACTERISTIC kltamsvubs_rb "Characteristic map duty cycle % for 4KHz signal (permanent duty cycle at START phase)" CURVE 0xa08082f6 _REC_CUR_20_u1_u1 99.609375 _CNV_A_R_LINEAR_____5_CM 0. 99.609375 DISPLAY_IDENTIFIER KLTAMSVUBS_RB FORMAT "%9.6"
 /begin AXIS_DESCR COM_AXIS ubsqf_rb _CNV_A_R_LINEAR_____425_CM 2 0. 25.5 FORMAT "%4.1" AXIS_PTS_REF ldp_ubsqf_kltamsvubs_rb /end AXIS_DESCR
/end CHARACTERISTIC
/begin MEASUREMENT state_key "State of Kl. (Kl.R, Kl. 15, Kl.50 etc.)" UBYTE _CNV_A_R_LINEAR_____0_CM 1 100. 0. 15. DISPLAY_IDENTIFIER STATE_KEY ECU_ADDRESS 0xd000857e FORMAT "%2.0" /end MEASUREMENT
/begin MEASUREMENT state_veh_cdn "status vehicle condition" UBYTE _CNV_A_R_LINEAR_____0_CM 1 100. 0. 15. DISPLAY_IDENTIFIER STATE_VEH_CDN ECU_ADDRESS 0xd000857f FORMAT "%2.0" /end MEASUREMENT
/begin MEASUREMENT t_pow_off "remaining time before switch off the power supply" UWORD _CNV_A_R_LINEAR_____36_CM 1 100. 0. 65535. DISPLAY_IDENTIFIER T_POW_OFF ECU_ADDRESS 0xd000a0a0 FORMAT "%5.0" /end MEASUREMENT
/begin MEASUREMENT lv_t_pow_off "Bit indicationg countdown for switch off power supply" UBYTE _CNV_S_2_RANGE__0___1_CM 1 100. 0. 1. DISPLAY_IDENTIFIER LV_T_POW_OFF ECU_ADDRESS 0xd000858c /end MEASUREMENT
/begin MEASUREMENT tcc_com_2_cas "alive counter for communication" UBYTE _CNV_A_R_LINEAR_____0_CM 1 100. 0. 15. DISPLAY_IDENTIFIER TCC_COM_2_CAS ECU_ADDRESS 0xd0008586 FORMAT "%2.0" /end MEASUREMENT
/begin MEASUREMENT tcc_com_2_cas_2 "alive counter for communication" UBYTE _CNV_A_R_LINEAR_____0_CM 1 100. 0. 15. DISPLAY_IDENTIFIER TCC_COM_2_CAS_2 ECU_ADDRESS 0xd0008584 FORMAT "%2.0" /end MEASUREMENT
/begin MEASUREMENT crc_com_2_cas "CRC for communication" UBYTE _CNV_A_R_LINEAR_____0_CM 1 100. 0. 255. DISPLAY_IDENTIFIER CRC_COM_2_CAS ECU_ADDRESS 0xd0008587 FORMAT "%3.0" /end MEASUREMENT
/begin MEASUREMENT crc_com_2_cas_2 "CRC for communication" UBYTE _CNV_A_R_LINEAR_____0_CM 1 100. 0. 255. DISPLAY_IDENTIFIER CRC_COM_2_CAS_2 ECU_ADDRESS 0xd0008585 FORMAT "%3.0" /end MEASUREMENT
/begin MEASUREMENT crc_clc_com_2_cas_2 "CRC calculated for communication" UBYTE _CNV_A_R_LINEAR_____0_CM 1 100. 0. 255. DISPLAY_IDENTIFIER CRC_CLC_COM_2_CAS_2 ECU_ADDRESS 0xd0008589 FORMAT "%3.0" /end MEASUREMENT
/begin MEASUREMENT crc_clc_com_2_cas "CRC calculated for communication" UBYTE _CNV_A_R_LINEAR_____0_CM 1 100. 0. 255. DISPLAY_IDENTIFIER CRC_CLC_COM_2_CAS ECU_ADDRESS 0xd0008588 FORMAT "%3.0" /end MEASUREMENT
/begin MEASUREMENT lv_cas_msg_vld "Bit indicating error free CAS message received via CAN" UBYTE _CNV_S_2_RANGE__0___1_CM 1 100. 0. 1. DISPLAY_IDENTIFIER LV_CAS_MSG_VLD ECU_ADDRESS 0xd000858d /end MEASUREMENT
/begin MEASUREMENT tcc_vs "alive counter for communication" UBYTE _CNV_A_R_LINEAR_____0_CM 1 100. 0. 15. DISPLAY_IDENTIFIER TCC_VS ECU_ADDRESS 0xd00085a4 FORMAT "%2.0" /end MEASUREMENT
/begin MEASUREMENT crc_vs "CRC for communication" UBYTE _CNV_A_R_LINEAR_____0_CM 1 100. 0. 255. DISPLAY_IDENTIFIER CRC_VS ECU_ADDRESS 0xd00085a5 FORMAT "%3.0" /end MEASUREMENT
/begin MEASUREMENT crc_clc_vs "CRC calculated for communication" UBYTE _CNV_A_R_LINEAR_____0_CM 1 100. 0. 255. DISPLAY_IDENTIFIER CRC_CLC_VS ECU_ADDRESS 0xd00085a6 FORMAT "%3.0" /end MEASUREMENT
/begin MEASUREMENT crc_clc_com_1_vs "CRC calculated for communication" UBYTE _CNV_A_R_LINEAR_____0_CM 1 100. 0. 255. DISPLAY_IDENTIFIER CRC_CLC_COM_1_VS ECU_ADDRESS 0xd00085aa FORMAT "%3.0" /end MEASUREMENT
/begin MEASUREMENT crc_com_1_vs "CRC for communication" UBYTE _CNV_A_R_LINEAR_____0_CM 1 100. 0. 255. DISPLAY_IDENTIFIER CRC_COM_1_VS ECU_ADDRESS 0xd00085a9 FORMAT "%3.0" /end MEASUREMENT
/begin MEASUREMENT tcc_com_1_vs "alive counter for communication" UBYTE _CNV_A_R_LINEAR_____0_CM 1 100. 0. 15. DISPLAY_IDENTIFIER TCC_COM_1_VS ECU_ADDRESS 0xd00085a7 FORMAT "%2.0" /end MEASUREMENT
/begin MEASUREMENT crc_clc_com_1_tq_pste "CRC calculated for communication" UBYTE _CNV_A_R_LINEAR_____0_CM 1 100. 0. 255. DISPLAY_IDENTIFIER CRC_CLC_COM_1_TQ_PSTE ECU_ADDRESS 0xd00085ae FORMAT "%3.0" /end MEASUREMENT
/begin MEASUREMENT crc_com_1_tq_pste "CRC for communication" UBYTE _CNV_A_R_LINEAR_____0_CM 1 100. 0. 255. DISPLAY_IDENTIFIER CRC_COM_1_TQ_PSTE ECU_ADDRESS 0xd00085ad FORMAT "%3.0" /end MEASUREMENT
/begin MEASUREMENT tcc_com_1_tq_pste "alive counter for communication" UBYTE _CNV_A_R_LINEAR_____0_CM 1 100. 0. 15. DISPLAY_IDENTIFIER TCC_COM_1_TQ_PSTE ECU_ADDRESS 0xd00085ab FORMAT "%2.0" /end MEASUREMENT
/begin MEASUREMENT crc_clc_com_1_req_tqdw "CRC calculated for communication" UBYTE _CNV_A_R_LINEAR_____0_CM 1 100. 0. 255. DISPLAY_IDENTIFIER CRC_CLC_COM_1_REQ_TQDW ECU_ADDRESS 0xd00085b2 FORMAT "%3.0" /end MEASUREMENT
/begin MEASUREMENT crc_com_1_req_tqdw "CRC for communication" UBYTE _CNV_A_R_LINEAR_____0_CM 1 100. 0. 255. DISPLAY_IDENTIFIER CRC_COM_1_REQ_TQDW ECU_ADDRESS 0xd00085b1 FORMAT "%3.0" /end MEASUREMENT
/begin MEASUREMENT tcc_com_1_req_tqdw "alive counter for communication" UBYTE _CNV_A_R_LINEAR_____0_CM 1 100. 0. 15. DISPLAY_IDENTIFIER TCC_COM_1_REQ_TQDW ECU_ADDRESS 0xd00085af FORMAT "%2.0" /end MEASUREMENT
/begin MEASUREMENT crc_clc_com_1_ac_trv "CRC calculated for communication" UBYTE _CNV_A_R_LINEAR_____0_CM 1 100. 0. 255. DISPLAY_IDENTIFIER CRC_CLC_COM_1_AC_TRV ECU_ADDRESS 0xd00085ba FORMAT "%3.0" /end MEASUREMENT
/begin MEASUREMENT crc_clc_com_1_ac_lgt "CRC calculated for communication" UBYTE _CNV_A_R_LINEAR_____0_CM 1 100. 0. 255. DISPLAY_IDENTIFIER CRC_CLC_COM_1_AC_LGT ECU_ADDRESS 0xd00085b6 FORMAT "%3.0" /end MEASUREMENT
/begin MEASUREMENT crc_com_1_ac_trv "CRC for communication" UBYTE _CNV_A_R_LINEAR_____0_CM 1 100. 0. 255. DISPLAY_IDENTIFIER CRC_COM_1_AC_TRV ECU_ADDRESS 0xd00085b9 FORMAT "%3.0" /end MEASUREMENT
/begin MEASUREMENT crc_com_1_ac_lgt "CRC for communication" UBYTE _CNV_A_R_LINEAR_____0_CM 1 100. 0. 255. DISPLAY_IDENTIFIER CRC_COM_1_AC_LGT ECU_ADDRESS 0xd00085b5 FORMAT "%3.0" /end MEASUREMENT
/begin MEASUREMENT tcc_com_1_ac_trv "alive counter for communication" UBYTE _CNV_A_R_LINEAR_____0_CM 1 100. 0. 15. DISPLAY_IDENTIFIER TCC_COM_1_AC_TRV ECU_ADDRESS 0xd00085b7 FORMAT "%2.0" /end MEASUREMENT
/begin MEASUREMENT tcc_com_1_ac_lgt "alive counter for communication" UBYTE _CNV_A_R_LINEAR_____0_CM 1 100. 0. 15. DISPLAY_IDENTIFIER TCC_COM_1_AC_LGT ECU_ADDRESS 0xd00085b3 FORMAT "%2.0" /end MEASUREMENT
/begin MEASUREMENT tcc_com_1_tq_loss_cord "alive counter for communication on FelxRay" UBYTE _CNV_A_R_LINEAR_____0_CM 1 100. 0. 15. DISPLAY_IDENTIFIER TCC_COM_1_TQ_LOSS_CORD ECU_ADDRESS 0xd00085bb FORMAT "%2.0" /end MEASUREMENT
/begin MEASUREMENT crc_com_1_tq_loss_cord "CRC for communication on FleyRay" UBYTE _CNV_A_R_LINEAR_____0_CM 1 100. 0. 255. DISPLAY_IDENTIFIER CRC_COM_1_TQ_LOSS_CORD ECU_ADDRESS 0xd00085bc FORMAT "%3.0" /end MEASUREMENT
/begin MEASUREMENT crc_clc_com_1_tq_loss_cord "CRC calculated for communication on FlexRay" UBYTE _CNV_A_R_LINEAR_____0_CM 1 100. 0. 255. DISPLAY_IDENTIFIER CRC_CLC_COM_1_TQ_LOSS_CORD ECU_ADDRESS 0xd00085bd FORMAT "%3.0" /end MEASUREMENT
/begin MEASUREMENT state_ecu_tq_loss_cord "State of ICM ECU" UBYTE _CNV_A_R_LINEAR_____0_CM 1 100. 0. 15. DISPLAY_IDENTIFIER STATE_ECU_TQ_LOSS_CORD ECU_ADDRESS 0xd00085be FORMAT "%2.0" /end MEASUREMENT
/begin MEASUREMENT state_tq_loss_cord_sp "qualifier/state of signal TQ_LOSS_CORD_SP" UBYTE _CNV_A_R_LINEAR_____0_CM 1 100. 0. 255. DISPLAY_IDENTIFIER STATE_TQ_LOSS_CORD_SP ECU_ADDRESS 0xd00085bf FORMAT "%3.0" /end MEASUREMENT
/begin MEASUREMENT tcc_com_1_tq_driv_asi "alive counter for communication on FelxRay" UBYTE _CNV_A_R_LINEAR_____0_CM 1 100. 0. 15. DISPLAY_IDENTIFIER TCC_COM_1_TQ_DRIV_ASI ECU_ADDRESS 0xd00085c0 FORMAT "%2.0" /end MEASUREMENT
/begin MEASUREMENT crc_com_1_tq_driv_asi "CRC for communication on FleyRay" UBYTE _CNV_A_R_LINEAR_____0_CM 1 100. 0. 255. DISPLAY_IDENTIFIER CRC_COM_1_TQ_DRIV_ASI ECU_ADDRESS 0xd00085c1 FORMAT "%3.0" /end MEASUREMENT
/begin MEASUREMENT crc_clc_com_1_tq_driv_asi "CRC calculated for communication on FlexRay" UBYTE _CNV_A_R_LINEAR_____0_CM 1 100. 0. 255. DISPLAY_IDENTIFIER CRC_CLC_COM_1_TQ_DRIV_ASI ECU_ADDRESS 0xd00085c2 FORMAT "%3.0" /end MEASUREMENT
/begin MEASUREMENT state_ecu_tq_wheel_driv_asi "State of ICM ECU" UBYTE _CNV_A_R_LINEAR_____0_CM 1 100. 0. 15. DISPLAY_IDENTIFIER STATE_ECU_TQ_WHEEL_DRIV_ASI ECU_ADDRESS 0xd00085c3 FORMAT "%2.0" /end MEASUREMENT
/begin MEASUREMENT state_tq_wheel_driv_asi "qualifier/state of signal TQ_WHEEL_DRIV_ASI" UBYTE _CNV_A_R_LINEAR_____0_CM 1 100. 0. 255. DISPLAY_IDENTIFIER STATE_TQ_WHEEL_DRIV_ASI ECU_ADDRESS 0xd00085c4 FORMAT "%3.0" /end MEASUREMENT
/begin MEASUREMENT tcc_com_1_veh_mod "alive counter for communication on FelxRay" UBYTE _CNV_A_R_LINEAR_____0_CM 1 100. 0. 15. DISPLAY_IDENTIFIER TCC_COM_1_VEH_MOD ECU_ADDRESS 0xd00085c5 FORMAT "%2.0" /end MEASUREMENT
/begin MEASUREMENT crc_com_1_veh_mod "CRC for communication on FleyRay" UBYTE _CNV_A_R_LINEAR_____0_CM 1 100. 0. 255. DISPLAY_IDENTIFIER CRC_COM_1_VEH_MOD ECU_ADDRESS 0xd00085c6 FORMAT "%3.0" /end MEASUREMENT
/begin MEASUREMENT crc_clc_com_1_veh_mod "CRC calculated for communication on FlexRay" UBYTE _CNV_A_R_LINEAR_____0_CM 1 100. 0. 255. DISPLAY_IDENTIFIER CRC_CLC_COM_1_VEH_MOD ECU_ADDRESS 0xd00085c7 FORMAT "%3.0" /end MEASUREMENT
/begin MEASUREMENT tcc_com_1_tq_tcs "alive counter for communication" UBYTE _CNV_A_R_LINEAR_____0_CM 1 100. 0. 15. DISPLAY_IDENTIFIER TCC_COM_1_TQ_TCS ECU_ADDRESS 0xd0008594 FORMAT "%2.0" /end MEASUREMENT
/begin MEASUREMENT state_ecu_tq_wheel_tcs "state ECU request for wheel torque on powertrain" UBYTE _CNV_A_R_LINEAR_____0_CM 1 100. 0. 15. DISPLAY_IDENTIFIER STATE_ECU_TQ_WHEEL_TCS ECU_ADDRESS 0xd0008596 FORMAT "%2.0" /end MEASUREMENT
/begin MEASUREMENT state_com_1_tq_tcs_err "state ECU request for wheel torque on powertrain" UBYTE _CNV_A_R_LINEAR_____0_CM 1 100. 0. 15. DISPLAY_IDENTIFIER STATE_COM_1_TQ_TCS_ERR ECU_ADDRESS 0xd00084e3 FORMAT "%2.0" /end MEASUREMENT
/begin MEASUREMENT state_tqb_sum_tcs "Qualifier concept to actual-value for braking-torque" UBYTE _CNV_A_R_LINEAR_____0_CM 1 100. 0. 15. DISPLAY_IDENTIFIER STATE_TQB_SUM_TCS ECU_ADDRESS 0xd0008598 FORMAT "%2.0" /end MEASUREMENT
/begin MEASUREMENT state_n_wheel_re_le "Qualifier concept to actual-value for RPM wheel rear left" UBYTE _CNV_A_R_LINEAR_____0_CM 1 100. 0. 15. DISPLAY_IDENTIFIER STATE_N_WHEEL_RE_LE ECU_ADDRESS 0xd0008599 FORMAT "%2.0" /end MEASUREMENT
/begin MEASUREMENT state_n_wheel_re_ri "Qualifier concept to actual-value for RPM wheel rear right" UBYTE _CNV_A_R_LINEAR_____0_CM 1 100. 0. 15. DISPLAY_IDENTIFIER STATE_N_WHEEL_RE_RI ECU_ADDRESS 0xd000859a FORMAT "%2.0" /end MEASUREMENT
/begin MEASUREMENT state_n_wheel_fn_le "Qualifier concept to actual-value for RPM wheel front left" UBYTE _CNV_A_R_LINEAR_____0_CM 1 100. 0. 15. DISPLAY_IDENTIFIER STATE_N_WHEEL_FN_LE ECU_ADDRESS 0xd000859b FORMAT "%2.0" /end MEASUREMENT
/begin MEASUREMENT state_n_wheel_fn_ri "Qualifier concept to actual-value for RPM wheel front right" UBYTE _CNV_A_R_LINEAR_____0_CM 1 100. 0. 15. DISPLAY_IDENTIFIER STATE_N_WHEEL_FN_RI ECU_ADDRESS 0xd000859c FORMAT "%2.0" /end MEASUREMENT
/begin MEASUREMENT tcc_com_1_wheel_tcs "Alive counter for communication on FLX" UBYTE _CNV_A_R_LINEAR_____0_CM 1 100. 0. 15. DISPLAY_IDENTIFIER TCC_COM_1_WHEEL_TCS ECU_ADDRESS 0xd000859d FORMAT "%2.0" /end MEASUREMENT
/begin MEASUREMENT tcc_com_1_tq_tcs_prev "Alive counter for communication on FLX" UBYTE _CNV_A_R_LINEAR_____0_CM 1 100. 0. 15. DISPLAY_IDENTIFIER TCC_COM_1_TQ_TCS_PREV ECU_ADDRESS 0xd00085a1 FORMAT "%2.0" /end MEASUREMENT
/begin MEASUREMENT lv_req_isc_inh "Flag for inhibiting idle speed controller request" UBYTE _CNV_S_2_RANGE__0___1_CM 1 100. 0. 1. DISPLAY_IDENTIFIER LV_REQ_ISC_INH ECU_ADDRESS 0xd00074af BIT_MASK 0x1 /end MEASUREMENT
/begin MEASUREMENT lv_isc_req_inh_ast "Flag for inhibition of idle speed controller request in after start" UBYTE _CNV_S_2_RANGE__0___1_CM 1 100. 0. 1. DISPLAY_IDENTIFIER LV_ISC_REQ_INH_AST ECU_ADDRESS 0xd00074a8 BIT_MASK 0x1 /end MEASUREMENT
/begin MEASUREMENT t_dly_tq_p_d_inh_ast "Time counter for PD-part activation of idle speed controller in after start" UWORD _CNV_A_R_LINEAR_____3_CM 1 100. 0. 655.35 DISPLAY_IDENTIFIER T_DLY_TQ_P_D_INH_AST ECU_ADDRESS 0xd0002520 FORMAT "%6.2" /end MEASUREMENT
/begin MEASUREMENT t_dly_tq_i_inh_ast "Time counter for I-part activation of idle speed controller in after start" UWORD _CNV_A_R_LINEAR_____3_CM 1 100. 0. 655.35 DISPLAY_IDENTIFIER T_DLY_TQ_I_INH_AST ECU_ADDRESS 0xd000251e FORMAT "%6.2" /end MEASUREMENT
/begin MEASUREMENT t_dly_isc_act_ast "Time counter for idle speed request activation in after start" UWORD _CNV_A_R_LINEAR_____3_CM 1 100. 0. 655.35 DISPLAY_IDENTIFIER T_DLY_ISC_ACT_AST ECU_ADDRESS 0xd000251a FORMAT "%6.2" /end MEASUREMENT
/begin CHARACTERISTIC c_n_sp_is_ofs_i_inh_ast "Engine speed offset for activation of the I-part of idle speed controller in after start" VALUE 0xa08024ae _REC_VAL_20_u2 8160. _CNV_A_R_LINEAR_____14_CM 0. 8160. DISPLAY_IDENTIFIER C_N_SP_IS_OFS_I_INH_AST FORMAT "%4.0" /end CHARACTERISTIC
/begin MEASUREMENT lv_isc_inh "Flag for inhibiting idle speed controller (e. g. by service tester)" UBYTE _CNV_S_2_RANGE__0___1_CM 1 100. 0. 1. DISPLAY_IDENTIFIER LV_ISC_INH ECU_ADDRESS 0xd00074a7 BIT_MASK 0x1 /end MEASUREMENT
/begin MEASUREMENT lv_tq_i_isc_inh "Flag for inhibiting the I-part of idle speed controller" UBYTE _CNV_S_2_RANGE__0___1_CM 1 100. 0. 1. DISPLAY_IDENTIFIER LV_TQ_I_ISC_INH ECU_ADDRESS 0xd00074b0 BIT_MASK 0x1 /end MEASUREMENT
/begin MEASUREMENT lv_tq_p_d_isc_inh "Flag for inhibiting the PD-part of idle speed controller" UBYTE _CNV_S_2_RANGE__0___1_CM 1 100. 0. 1. DISPLAY_IDENTIFIER LV_TQ_P_D_ISC_INH ECU_ADDRESS 0xd00074b2 BIT_MASK 0x1 /end MEASUREMENT
/begin AXIS_PTS ldp_tco_ip_n_thd_isc_act_ast "" 0xa0802160 tco _REC_AXS_20_u1 190.5 _CNV_A_R_LINEAR_____17_CM 4 -48. 142.5 FORMAT "%6.2" /end AXIS_PTS
/begin AXIS_PTS ldpm_tco_3_ensc "" 0xa08022a2 tco _REC_AXS_20_u1 190.5 _CNV_A_R_LINEAR_____17_CM 4 -48. 142.5 FORMAT "%6.2" /end AXIS_PTS
/begin CHARACTERISTIC ip_n_thd_isc_act_ast "Engine speed threshold for activation of the idle speed controller in the after start phase" CURVE 0xa080240c _REC_CUR_20_u2_u1 8160. _CNV_A_R_LINEAR_____14_CM 0. 8160. DISPLAY_IDENTIFIER IP_N_THD_ISC_ACT_AST FORMAT "%4.0"
 /begin AXIS_DESCR COM_AXIS tco _CNV_A_R_LINEAR_____17_CM 4 -48. 142.5 FORMAT "%6.2" AXIS_PTS_REF ldp_tco_ip_n_thd_isc_act_ast /end AXIS_DESCR
/end CHARACTERISTIC
/begin CHARACTERISTIC ip_t_dly_isc_act_ast "Time limit for Idle speed activation in after start" CURVE 0xa080241c _REC_CUR_20_u2_u1 655.35 _CNV_A_R_LINEAR_____3_CM 0. 655.35 DISPLAY_IDENTIFIER IP_T_DLY_ISC_ACT_AST FORMAT "%6.2"
 /begin AXIS_DESCR COM_AXIS tco _CNV_A_R_LINEAR_____17_CM 4 -48. 142.5 FORMAT "%6.2" AXIS_PTS_REF ldpm_tco_3_ensc /end AXIS_DESCR
/end CHARACTERISTIC
/begin CHARACTERISTIC ip_t_dly_tq_i_inh_ast "Time limit for activation of the I-part of idle speed controller in after start" CURVE 0xa0802424 _REC_CUR_20_u2_u1 655.35 _CNV_A_R_LINEAR_____3_CM 0. 655.35 DISPLAY_IDENTIFIER IP_T_DLY_TQ_I_INH_AST FORMAT "%6.2"
 /begin AXIS_DESCR COM_AXIS tco _CNV_A_R_LINEAR_____17_CM 4 -48. 142.5 FORMAT "%6.2" AXIS_PTS_REF ldpm_tco_3_ensc /end AXIS_DESCR
/end CHARACTERISTIC
/begin CHARACTERISTIC ip_t_dly_tq_p_d_inh_ast "Time limit for activation of the PD-part of idle speed controller in after start" CURVE 0xa080242c _REC_CUR_20_u2_u1 655.35 _CNV_A_R_LINEAR_____3_CM 0. 655.35 DISPLAY_IDENTIFIER IP_T_DLY_TQ_P_D_INH_AST FORMAT "%6.2"
 /begin AXIS_DESCR COM_AXIS tco _CNV_A_R_LINEAR_____17_CM 4 -48. 142.5 FORMAT "%6.2" AXIS_PTS_REF ldpm_tco_3_ensc /end AXIS_DESCR
/end CHARACTERISTIC
/begin CHARACTERISTIC c_maf_max_diag_isc "Maximum mass air flow to perform idle speed Plausibility check" VALUE 0xa080249a _REC_VAL_20_u1 1389. _CNV_A_R_LINEAR_____15_CM 0. 1389. DISPLAY_IDENTIFIER C_MAF_MAX_DIAG_ISC FORMAT "%4.0" /end CHARACTERISTIC
/begin CHARACTERISTIC c_n_dif_max_diag_isc "Maximum deviation above nominal idle speed" VALUE 0xa08024a2 _REC_VAL_20_s2 65535. _CNV_A_R_LINEAR_____14_CM -32768. 32767. DISPLAY_IDENTIFIER C_N_DIF_MAX_DIAG_ISC FORMAT "%6.0" /end CHARACTERISTIC
/begin CHARACTERISTIC c_flow_cps_max_diag_isc "Maximum canister purge fuel flow from CPS to cylinder to perform idle speed plausibility check" VALUE 0xa0802498 _REC_VAL_20_u2 7.9998779296875 _CNV_A_R_LINEAR_____162_CM 0. 7.9998779296875 DISPLAY_IDENTIFIER C_FLOW_CPS_MAX_DIAG_ISC FORMAT "%6.4" /end CHARACTERISTIC
/begin CHARACTERISTIC c_t_dly_isc_diag "Time delay for diagnosis activation" VALUE 0xa08024be _REC_VAL_20_u2 6553.5 _CNV_A_R_LINEAR_____4_CM 0. 6553.5 DISPLAY_IDENTIFIER C_T_DLY_ISC_DIAG FORMAT "%6.1" /end CHARACTERISTIC
/begin CHARACTERISTIC c_t_dly_tq_dif_i_is_diag "Constant time delay for diagnosis activation depending on integral part" VALUE 0xa08024c0 _REC_VAL_20_u2 6553.5 _CNV_A_R_LINEAR_____4_CM 0. 6553.5 DISPLAY_IDENTIFIER C_T_DLY_TQ_DIF_I_IS_DIAG FORMAT "%6.1" /end CHARACTERISTIC
/begin MEASUREMENT t_isc_diag "Time delay for diagnosis activation" UWORD _CNV_A_R_LINEAR_____4_CM 1 100. 0. 6553.5 DISPLAY_IDENTIFIER T_ISC_DIAG ECU_ADDRESS 0xd0002522 FORMAT "%6.1" /end MEASUREMENT
/begin CHARACTERISTIC c_abc_inc_isc "Anti-bounce counter increment for idle speed Plausibility check" VALUE 0xa080248e _REC_VAL_20_u1 255. _CNV_A_R_LINEAR_____0_CM 0. 255. DISPLAY_IDENTIFIER C_ABC_INC_ISC FORMAT "%3.0" /end CHARACTERISTIC
/begin CHARACTERISTIC c_abc_dec_isc "Anti-bounce counter decrement for idle speed Plausibility check" VALUE 0xa080248c _REC_VAL_20_u1 255. _CNV_A_R_LINEAR_____0_CM 0. 255. DISPLAY_IDENTIFIER C_ABC_DEC_ISC FORMAT "%3.0" /end CHARACTERISTIC
/begin CHARACTERISTIC c_abc_inc_isc_cst "Anti-bounce counter increment for idle speed Plausibility check at coldstart" VALUE 0xa080248f _REC_VAL_20_u1 255. _CNV_A_R_LINEAR_____0_CM 0. 255. DISPLAY_IDENTIFIER C_ABC_INC_ISC_CST FORMAT "%3.0" /end CHARACTERISTIC
/begin CHARACTERISTIC c_abc_dec_isc_cst "Anti-bounce counter decrement for idle speed Plausibility check at coldstart" VALUE 0xa080248d _REC_VAL_20_u1 255. _CNV_A_R_LINEAR_____0_CM 0. 255. DISPLAY_IDENTIFIER C_ABC_DEC_ISC_CST FORMAT "%3.0" /end CHARACTERISTIC
/begin MEASUREMENT lv_err_isc "Boolean for fault memory Idle Control System: Unplausible Speed" UBYTE _CNV_S_2_RANGE__0___1_CM 1 100. 0. 1. DISPLAY_IDENTIFIER LV_ERR_ISC ECU_ADDRESS 0xd0007f69 BIT_MASK 0x1 /end MEASUREMENT
/begin MEASUREMENT lv_err_isc_cst "Boolean for fault memory Idle Control System: Unplausible Speed at coldstart" UBYTE _CNV_S_2_RANGE__0___1_CM 1 100. 0. 1. DISPLAY_IDENTIFIER LV_ERR_ISC_CST ECU_ADDRESS 0xd0007f6a BIT_MASK 0x1 /end MEASUREMENT
/begin MEASUREMENT t_dly_tq_dif_i_is_diag "Time delay for diagnosis activation depending on integral part" UWORD _CNV_A_R_LINEAR_____4_CM 1 100. 0. 6553.5 DISPLAY_IDENTIFIER T_DLY_TQ_DIF_I_IS_DIAG ECU_ADDRESS 0xd000251c FORMAT "%6.1" /end MEASUREMENT
/begin MEASUREMENT n_dif_min_diag_isc_cst "Lower engine speed deviation of idle speed control diagnosis at coldstart" UWORD _CNV_A_R_LINEAR_____14_CM 1 100. 0. 8160. DISPLAY_IDENTIFIER N_DIF_MIN_DIAG_ISC_CST ECU_ADDRESS 0xd000250e FORMAT "%4.0" /end MEASUREMENT
/begin MEASUREMENT n_dif_max_diag_isc_cst "Upper engine speed deviation of idle speed control diagnosis at coldstart" UWORD _CNV_A_R_LINEAR_____14_CM 1 100. 0. 8160. DISPLAY_IDENTIFIER N_DIF_MAX_DIAG_ISC_CST ECU_ADDRESS 0xd000250c FORMAT "%4.0" /end MEASUREMENT
/begin CHARACTERISTIC c_abc_max_isc_cst "Maximum value of the anti-bounce counter for idle speed Plausibility check at coldstart" VALUE 0xa0802491 _REC_VAL_20_u1 254. _CNV_A_R_LINEAR_____0_CM 1. 255. DISPLAY_IDENTIFIER C_ABC_MAX_ISC_CST FORMAT "%3.0" /end CHARACTERISTIC
/begin CHARACTERISTIC c_abc_max_isc "Maximum value of the anti-bounce counter for idle speed Plausibility check" VALUE 0xa0802490 _REC_VAL_20_u1 254. _CNV_A_R_LINEAR_____0_CM 1. 255. DISPLAY_IDENTIFIER C_ABC_MAX_ISC FORMAT "%3.0" /end CHARACTERISTIC
/begin CHARACTERISTIC c_tco_min_isc "Min TCO threshold for idle speed diagnosis " VALUE 0xa08024d1 _REC_VAL_20_u1 190.5 _CNV_A_R_LINEAR_____17_CM -48. 142.5 DISPLAY_IDENTIFIER C_TCO_MIN_ISC FORMAT "%6.2" /end CHARACTERISTIC
/begin CHARACTERISTIC c_tco_min_isc_cst "Min TCO threshold for idle speed diagnosis at coldstart " VALUE 0xa08024d2 _REC_VAL_20_u1 190.5 _CNV_A_R_LINEAR_____17_CM -48. 142.5 DISPLAY_IDENTIFIER C_TCO_MIN_ISC_CST FORMAT "%6.2" /end CHARACTERISTIC
/begin CHARACTERISTIC c_n_dif_min_diag_isc "Maximum deviation below nominal idle speed" VALUE 0xa08024a4 _REC_VAL_20_s2 65535. _CNV_A_R_LINEAR_____14_CM -32768. 32767. DISPLAY_IDENTIFIER C_N_DIF_MIN_DIAG_ISC FORMAT "%6.0" /end CHARACTERISTIC
/begin CHARACTERISTIC lc_t_isc_diag_ast_inh "Switch for inhibition of activation timer after start of ISC diagnosis" VALUE 0xa0802508 _REC_VAL_20_u1 1. _CNV_A_R_LINEAR_____0_CM 0. 1. DISPLAY_IDENTIFIER LC_T_ISC_DIAG_AST_INH FORMAT "%1.0" /end CHARACTERISTIC
/begin AXIS_PTS ldp_t_ast_ip_fac_diag_isc_cst "" 0xa0802118 t_ast _REC_AXS_20_u2 6553.5 _CNV_A_R_LINEAR_____4_CM 6 0. 6553.5 FORMAT "%6.1" /end AXIS_PTS
/begin AXIS_PTS ldp_tco_st_ip_t_inh_isc_diag "" 0xa0802174 tco _REC_AXS_20_u1 190.5 _CNV_A_R_LINEAR_____17_CM 6 -48. 142.5 FORMAT "%6.2" /end AXIS_PTS
/begin AXIS_PTS ldp_tco_ip_diag_isc_cst "" 0xa0802146 tco _REC_AXS_20_u1 190.5 _CNV_A_R_LINEAR_____17_CM 6 -48. 142.5 FORMAT "%6.2" /end AXIS_PTS
/begin AXIS_PTS ldp_tco_st_ip_diag_isc_cst "" 0xa080216c tco _REC_AXS_20_u1 190.5 _CNV_A_R_LINEAR_____17_CM 6 -48. 142.5 FORMAT "%6.2" /end AXIS_PTS
/begin CHARACTERISTIC ip_fac_dif_diag_isc_cst "Influence of time after start for limits of idle speed controller diagnosis at coldstart" CURVE 0xa08022cc _REC_CUR_20_u1_u2 1.9921875 _CNV_A_R_LINEAR_____103_CM 0. 1.9921875 DISPLAY_IDENTIFIER IP_FAC_DIF_DIAG_ISC_CST FORMAT "%8.6"
 /begin AXIS_DESCR COM_AXIS t_ast _CNV_A_R_LINEAR_____4_CM 6 0. 6553.5 FORMAT "%6.1" AXIS_PTS_REF ldp_t_ast_ip_fac_diag_isc_cst /end AXIS_DESCR
/end CHARACTERISTIC
/begin CHARACTERISTIC ip_t_isc_diag_ast_inh "Initialization for activation timer of idle speed diagnosis after start" CURVE 0xa0802434 _REC_CUR_20_u1_u1 25.5 _CNV_A_R_LINEAR_____4_CM 0. 25.5 DISPLAY_IDENTIFIER IP_T_ISC_DIAG_AST_INH FORMAT "%4.1"
 /begin AXIS_DESCR COM_AXIS tco _CNV_A_R_LINEAR_____17_CM 6 -48. 142.5 FORMAT "%6.2" AXIS_PTS_REF ldp_tco_st_ip_t_inh_isc_diag /end AXIS_DESCR
/end CHARACTERISTIC
/begin CHARACTERISTIC ip_n_dif_max_diag_isc_cst "Upper engine speed deviation for limits idle speed control diagnosis at coldstart" MAP 0xa080ead0 _REC_MAP_20_u2_u1_u1 8160. _CNV_A_R_LINEAR_____14_CM 0. 8160. DISPLAY_IDENTIFIER IP_N_DIF_MAX_DIAG_ISC_CST FORMAT "%4.0"
 /begin AXIS_DESCR COM_AXIS tco _CNV_A_R_LINEAR_____17_CM 6 -48. 142.5 FORMAT "%6.2" AXIS_PTS_REF ldp_tco_ip_diag_isc_cst /end AXIS_DESCR
 /begin AXIS_DESCR COM_AXIS tco _CNV_A_R_LINEAR_____17_CM 6 -48. 142.5 FORMAT "%6.2" AXIS_PTS_REF ldp_tco_st_ip_diag_isc_cst /end AXIS_DESCR
/end CHARACTERISTIC
/begin CHARACTERISTIC ip_n_dif_min_diag_isc_cst "Lower engine speed deviation for limits idle speed control diagnosis at coldstart" MAP 0xa080eb18 _REC_MAP_20_u2_u1_u1 8160. _CNV_A_R_LINEAR_____14_CM 0. 8160. DISPLAY_IDENTIFIER IP_N_DIF_MIN_DIAG_ISC_CST FORMAT "%4.0"
 /begin AXIS_DESCR COM_AXIS tco _CNV_A_R_LINEAR_____17_CM 6 -48. 142.5 FORMAT "%6.2" AXIS_PTS_REF ldp_tco_ip_diag_isc_cst /end AXIS_DESCR
 /begin AXIS_DESCR COM_AXIS tco _CNV_A_R_LINEAR_____17_CM 6 -48. 142.5 FORMAT "%6.2" AXIS_PTS_REF ldp_tco_st_ip_diag_isc_cst /end AXIS_DESCR
/end CHARACTERISTIC
/begin MEASUREMENT t_ctr_pu_isc_act "Time counter for ISC activation in PU" UWORD _CNV_A_R_LINEAR_____3_CM 1 100. 0. 655.35 DISPLAY_IDENTIFIER T_CTR_PU_ISC_ACT ECU_ADDRESS 0xd0006674 FORMAT "%6.2" /end MEASUREMENT
/begin MEASUREMENT t_ctr_is_isc_act "Time counter for ISC activation in AST/IS" UWORD _CNV_A_R_LINEAR_____3_CM 1 100. 0. 655.35 DISPLAY_IDENTIFIER T_CTR_IS_ISC_ACT ECU_ADDRESS 0xd0002518 FORMAT "%6.2" /end MEASUREMENT
/begin MEASUREMENT state_req_isc "Actual state for ISC request" UBYTE _CNV_S_5_ENSC_RANGE_931_CM 1 100. 0. 4. DISPLAY_IDENTIFIER STATE_REQ_ISC ECU_ADDRESS 0xd000253a /end MEASUREMENT
/begin CHARACTERISTIC lc_isc_act_ast_cdn_swi "Switch for using different after start ISC activation conditions" VALUE 0xa0802500 _REC_VAL_20_u1 1. _CNV_A_R_LINEAR_____0_CM 0. 1. DISPLAY_IDENTIFIER LC_ISC_ACT_AST_CDN_SWI FORMAT "%1.0" /end CHARACTERISTIC
/begin CHARACTERISTIC lc_isc_act_norm_cdn_swi "Switch for using different ISC activation conditions in 'normal' mode" VALUE 0xa0802502 _REC_VAL_20_u1 1. _CNV_A_R_LINEAR_____0_CM 0. 1. DISPLAY_IDENTIFIER LC_ISC_ACT_NORM_CDN_SWI FORMAT "%1.0" /end CHARACTERISTIC
/begin CHARACTERISTIC c_t_dly_isc_act_pu "Time limit for ISC activation in PU" VALUE 0xa08024bc _REC_VAL_20_u2 655.35 _CNV_A_R_LINEAR_____3_CM 0. 655.35 DISPLAY_IDENTIFIER C_T_DLY_ISC_ACT_PU FORMAT "%6.2" /end CHARACTERISTIC
/begin CHARACTERISTIC c_t_dly_isc_act_ast "Time limit for ISC activation in AST" VALUE 0xa08024b8 _REC_VAL_20_u2 5.1 _CNV_A_R_LINEAR_____3_CM 0. 5.1 DISPLAY_IDENTIFIER C_T_DLY_ISC_ACT_AST FORMAT "%6.2" /end CHARACTERISTIC
/begin CHARACTERISTIC c_t_dly_isc_act_norm "Time limit for ISC activation in IS" VALUE 0xa08024ba _REC_VAL_20_u1 1. _CNV_A_R_LINEAR_____3_CM 0. 1. DISPLAY_IDENTIFIER C_T_DLY_ISC_ACT_NORM FORMAT "%4.2" /end CHARACTERISTIC
/begin CHARACTERISTIC lc_isc_pu_act_sel "Flag for selection of condition for ISC PU activation (LV_DT or GEAR)" VALUE 0xa0802505 _REC_VAL_20_u1 1. _CNV_A_R_LINEAR_____0_CM 0. 1. DISPLAY_IDENTIFIER LC_ISC_PU_ACT_SEL FORMAT "%1.0" /end CHARACTERISTIC
/begin CHARACTERISTIC c_n_dif_isc_act_pl_down "Additive term to define the low limit for ISC activation in PL" VALUE 0xa080249e _REC_VAL_20_s2 65535. _CNV_A_R_LINEAR_____14_CM -32768. 32767. DISPLAY_IDENTIFIER C_N_DIF_ISC_ACT_PL_DOWN FORMAT "%6.0" /end CHARACTERISTIC
/begin CHARACTERISTIC c_n_dif_isc_act_pl_up "Additive term to define the upper limit for ISC deactivation in PL" VALUE 0xa08024a0 _REC_VAL_20_s2 65535. _CNV_A_R_LINEAR_____14_CM -32768. 32767. DISPLAY_IDENTIFIER C_N_DIF_ISC_ACT_PL_UP FORMAT "%6.0" /end CHARACTERISTIC
/begin CHARACTERISTIC c_n_sp_is_max_pl_act "Speed setpoint threshold for part load activation" VALUE 0xa08024ac _REC_VAL_20_u2 8160. _CNV_A_R_LINEAR_____14_CM 0. 8160. DISPLAY_IDENTIFIER C_N_SP_IS_MAX_PL_ACT FORMAT "%4.0" /end CHARACTERISTIC
/begin CHARACTERISTIC lc_isc_act_cdn_swi "Calibratable logical bit for switching between different activation conditions" VALUE 0xa0802501 _REC_VAL_20_u1 1. _CNV_A_R_LINEAR_____0_CM 0. 1. DISPLAY_IDENTIFIER LC_ISC_ACT_CDN_SWI FORMAT "%1.0" /end CHARACTERISTIC
/begin CHARACTERISTIC lc_isc_pl_act_inh "Calibratable bit to inhibit ISC activation in part load" VALUE 0xa0802504 _REC_VAL_20_u1 1. _CNV_A_R_LINEAR_____0_CM 0. 1. DISPLAY_IDENTIFIER LC_ISC_PL_ACT_INH FORMAT "%1.0" /end CHARACTERISTIC
/begin MEASUREMENT lv_n_grd_neg_fil "Memory bit for falling gradient after start" UBYTE _CNV_S_2_RANGE__0___1_CM 1 100. 0. 1. DISPLAY_IDENTIFIER LV_N_GRD_NEG_FIL ECU_ADDRESS 0xd0002538 BIT_MASK 0x1 /end MEASUREMENT
/begin MEASUREMENT lv_req_isc "Logical variable for idle speed controller activation request" UBYTE _CNV_S_2_RANGE__0___1_CM 1 100. 0. 1. DISPLAY_IDENTIFIER LV_REQ_ISC ECU_ADDRESS 0xd00074ae BIT_MASK 0x1 /end MEASUREMENT
/begin MEASUREMENT lv_n_fall_det "Flag to indicate detection of falling engine speed" UBYTE _CNV_S_2_RANGE__0___1_CM 1 100. 0. 1. DISPLAY_IDENTIFIER LV_N_FALL_DET ECU_ADDRESS 0xd00074aa BIT_MASK 0x1 /end MEASUREMENT
/begin MEASUREMENT n_trig_min "Engine speed in time grid C_T_TRIG_N_DIF_MIN" UWORD _CNV_A_R_LINEAR_____14_CM 1 100. 0. 8160. DISPLAY_IDENTIFIER N_TRIG_MIN ECU_ADDRESS 0xd0002516 FORMAT "%4.0" /end MEASUREMENT
/begin MEASUREMENT n_dif_min_ris "Engine speed difference by falling engine speed in time grid C_T_MIN_RIS" UWORD _CNV_A_R_LINEAR_____14_CM 1 100. 0. 8160. DISPLAY_IDENTIFIER N_DIF_MIN_RIS ECU_ADDRESS 0xd0002510 FORMAT "%4.0" /end MEASUREMENT
/begin MEASUREMENT n_trig_dif_min "Engine speed difference in time grid C_T_TRIG_N_DIF_MIN" SWORD _CNV_A_R_LINEAR_____14_CM 1 100. -8160. 8160. DISPLAY_IDENTIFIER N_TRIG_DIF_MIN ECU_ADDRESS 0xd0002514 FORMAT "%5.0" /end MEASUREMENT
/begin CHARACTERISTIC c_n_dif_isc_act_ast "Additive term to define the low limit for ISC activation after start" VALUE 0xa080249c _REC_VAL_20_s2 65535. _CNV_A_R_LINEAR_____14_CM -32768. 32767. DISPLAY_IDENTIFIER C_N_DIF_ISC_ACT_AST FORMAT "%6.0" /end CHARACTERISTIC
/begin CHARACTERISTIC c_n_dif_min_ris "Minimum engine speed decrease to switch on IS-controller after C_T_MIN_RIS" VALUE 0xa08024a6 _REC_VAL_20_u2 8160. _CNV_A_R_LINEAR_____14_CM 0. 8160. DISPLAY_IDENTIFIER C_N_DIF_MIN_RIS FORMAT "%4.0" /end CHARACTERISTIC
/begin CHARACTERISTIC c_t_min_ris "Engine speed variation check period if N_DIF_COR < 0" VALUE 0xa08024c4 _REC_VAL_20_u2 655.34 _CNV_A_R_LINEAR_____3_CM 1.e-002 655.35 DISPLAY_IDENTIFIER C_T_MIN_RIS FORMAT "%6.2" /end CHARACTERISTIC
/begin CHARACTERISTIC c_t_trig_n_dif_min "Time grid for sampling the engine speed" VALUE 0xa08024d0 _REC_VAL_20_u1 2540. _CNV_A_R_LINEAR_____20_CM 10. 2550. DISPLAY_IDENTIFIER C_T_TRIG_N_DIF_MIN FORMAT "%4.0" /end CHARACTERISTIC
/begin MEASUREMENT state_pas_ramp_act_p_d_is "Circular buffer for the logical value for PD-part passive ramp active" UBYTE _CNV_A_R_LINEAR_____0_CM 1 100. 0. 255. DISPLAY_IDENTIFIER STATE_PAS_RAMP_ACT_P_D_IS ECU_ADDRESS 0xd000749b /end MEASUREMENT
/begin MEASUREMENT state_pas_ramp_act_i_is "Circular buffer for the logical value for I-part passive ramp active" UBYTE _CNV_A_R_LINEAR_____0_CM 1 100. 0. 255. DISPLAY_IDENTIFIER STATE_PAS_RAMP_ACT_I_IS ECU_ADDRESS 0xd000749a /end MEASUREMENT
/begin MEASUREMENT state_i_isc "State of the integral part: I_PASSIVE, I_NORMAL, RAMP_TO_PAS, RAMP_TO_LIM" UBYTE _CNV_S_4_ENSC_RANGE_932_CM 1 100. 0. 3. DISPLAY_IDENTIFIER STATE_I_ISC ECU_ADDRESS 0xd0007498 /end MEASUREMENT
/begin MEASUREMENT state_p_d_isc "State of the PD-part: P_D_PASSIVE, P_D_NORMAL, RAMP_TO_ZERO" UBYTE _CNV_S_3_ENSC_RANGE_933_CM 1 100. 0. 2. DISPLAY_IDENTIFIER STATE_P_D_ISC ECU_ADDRESS 0xd0007499 /end MEASUREMENT
/begin MEASUREMENT tq_add_ramp_p_d_fast_is "Increment of the fast PD-part ramps; this value is added per update rate" SWORD _CNV_A_R_ENSC_LINEA_934_CM 1 100. -256. 255.9922 DISPLAY_IDENTIFIER TQ_ADD_RAMP_P_D_FAST_IS ECU_ADDRESS 0xd000252a FORMAT "%9.4" /end MEASUREMENT
/begin MEASUREMENT t_ramp_lim_p_d_is "Time constant for ramp limit of P-, D-controller output in case of idle speed controller passive" UWORD _CNV_A_R_LINEAR_____3_CM 1 100. 0. 655.35 DISPLAY_IDENTIFIER T_RAMP_LIM_P_D_IS ECU_ADDRESS 0xd0002524 FORMAT "%6.2" /end MEASUREMENT
/begin MEASUREMENT tq_add_ramp_p_d_slow_is "Increment of the slow PD-part ramps; this value is added per update rate" SWORD _CNV_A_R_ENSC_LINEA_934_CM 1 100. -256. 255.9922 DISPLAY_IDENTIFIER TQ_ADD_RAMP_P_D_SLOW_IS ECU_ADDRESS 0xd000252c FORMAT "%9.4" /end MEASUREMENT
/begin CHARACTERISTIC lc_tq_add_i_is_drof_inh "Flag to inhibit TQ_ADD_I_IS at active DROF, i. e. TQ_DIF_I_IS = const." VALUE 0xa080250a _REC_VAL_20_u1 1. _CNV_A_R_LINEAR_____0_CM 0. 1. DISPLAY_IDENTIFIER LC_TQ_ADD_I_IS_DROF_INH FORMAT "%1.0" /end CHARACTERISTIC
/begin CHARACTERISTIC lc_tq_dif_p_d_slow_inh "Calibration bit for inhibiting PD-slow-part" VALUE 0xa080250d _REC_VAL_20_u1 1. _CNV_A_R_LINEAR_____0_CM 0. 1. DISPLAY_IDENTIFIER LC_TQ_DIF_P_D_SLOW_INH FORMAT "%1.0" /end CHARACTERISTIC
/begin CHARACTERISTIC lc_tq_add_i_inh_as "Logical variable for ISC I-part map output deactivation - default value at initialisation = 0" VALUE 0xa0802509 _REC_VAL_20_u1 1. _CNV_A_R_LINEAR_____0_CM 0. 1. DISPLAY_IDENTIFIER LC_TQ_ADD_I_INH_AS FORMAT "%1.0" /end CHARACTERISTIC
/begin CHARACTERISTIC lc_tq_dif_p_d_inh_as "Bit for inhibiting the PD-part - default value = 0" VALUE 0xa080250c _REC_VAL_20_u1 1. _CNV_A_R_LINEAR_____0_CM 0. 1. DISPLAY_IDENTIFIER LC_TQ_DIF_P_D_INH_AS FORMAT "%1.0" /end CHARACTERISTIC
/begin CHARACTERISTIC lc_tq_dif_i_inh_as "Logical variable for ISC I-part deactivation (completely) - default value at initialisation = 0" VALUE 0xa080250b _REC_VAL_20_u1 1. _CNV_A_R_LINEAR_____0_CM 0. 1. DISPLAY_IDENTIFIER LC_TQ_DIF_I_INH_AS FORMAT "%1.0" /end CHARACTERISTIC
/begin CHARACTERISTIC lc_isc_inh "Bit for inhibiting the PD- and integral part - default value = 0" VALUE 0xa0802503 _REC_VAL_20_u1 1. _CNV_A_R_LINEAR_____0_CM 0. 1. DISPLAY_IDENTIFIER LC_ISC_INH FORMAT "%1.0" /end CHARACTERISTIC
/begin MEASUREMENT tq_dif_i_is "I-part" SWORD _CNV_A_R_LINEAR_____31_CM 1 100. -1024. 1023.96875 DISPLAY_IDENTIFIER TQ_DIF_I_IS ECU_ADDRESS 0xd000667e FORMAT "%11.5" /end MEASUREMENT
/begin MEASUREMENT tq_add_i_is "Increment of limited integrator" SWORD _CNV_A_R_ENSC_LINEA_935_CM 1 100. -4. 3.9998779296875 DISPLAY_IDENTIFIER TQ_ADD_I_IS ECU_ADDRESS 0xd0002528 FORMAT "%7.4" /end MEASUREMENT
/begin MEASUREMENT tq_dif_p_d_slow_is "PD-part for slow path of torque coordination" SWORD _CNV_A_R_LINEAR_____31_CM 1 100. -1024. 1023.96875 DISPLAY_IDENTIFIER TQ_DIF_P_D_SLOW_IS ECU_ADDRESS 0xd0006692 FORMAT "%11.5" /end MEASUREMENT
/begin MEASUREMENT tq_dif_p_d_slow_is_1 "PD-part intermediate value" SWORD _CNV_A_R_LINEAR_____31_CM 1 100. -1024. 1023.96875 DISPLAY_IDENTIFIER TQ_DIF_P_D_SLOW_IS_1 ECU_ADDRESS 0xd000252e FORMAT "%11.5" /end MEASUREMENT
/begin MEASUREMENT tq_dif_p_d_slow_is_2 "PD-part intermediate value" SWORD _CNV_A_R_LINEAR_____31_CM 1 100. -1024. 1023.96875 DISPLAY_IDENTIFIER TQ_DIF_P_D_SLOW_IS_2 ECU_ADDRESS 0xd0002530 FORMAT "%11.5" /end MEASUREMENT
/begin MEASUREMENT tq_dif_p_d_fast_is "PD-part for fast path of torque coordination" SWORD _CNV_A_R_LINEAR_____31_CM 1 100. -1024. 1023.96875 DISPLAY_IDENTIFIER TQ_DIF_P_D_FAST_IS ECU_ADDRESS 0xd0006688 FORMAT "%11.5" /end MEASUREMENT
/begin MEASUREMENT crlc_tq_dif_p_d_fast_is "Correlation constant for PD-part filtering in fast path" UWORD _CNV_A_R_LINEAR_____89_CM 1 100. 0. 0.9999847412109381 DISPLAY_IDENTIFIER CRLC_TQ_DIF_P_D_FAST_IS ECU_ADDRESS 0xd0006664 FORMAT "%7.5" /end MEASUREMENT
/begin MEASUREMENT crlc_tq_dif_p_d_slow_is "Correlation constant for PD-part filtering in slow path" UWORD _CNV_A_R_LINEAR_____89_CM 1 100. 0. 0.9999847412109381 DISPLAY_IDENTIFIER CRLC_TQ_DIF_P_D_SLOW_IS ECU_ADDRESS 0xd0006666 FORMAT "%7.5" /end MEASUREMENT
/begin MEASUREMENT n_grd_fil_i_is "Engine speed gradient filtering for I-part" SBYTE _CNV_A_R_LINEAR_____30_CM 1 100. -4096. 4064. DISPLAY_IDENTIFIER N_GRD_FIL_I_IS ECU_ADDRESS 0xd0007495 FORMAT "%5.0" /end MEASUREMENT
/begin MEASUREMENT n_grd_fil_p_d_is "Engine speed gradient filtering for PD-part" SBYTE _CNV_A_R_LINEAR_____30_CM 1 100. -4096. 4064. DISPLAY_IDENTIFIER N_GRD_FIL_P_D_IS ECU_ADDRESS 0xd0007496 FORMAT "%5.0" /end MEASUREMENT
/begin MEASUREMENT tq_dif_p_d_fast_is_ast_min "PD-part after start torque limitation for fast path" SWORD _CNV_A_R_LINEAR_____31_CM 1 100. -1024. 1023.96875 DISPLAY_IDENTIFIER TQ_DIF_P_D_FAST_IS_AST_MIN ECU_ADDRESS 0xd000668a FORMAT "%11.5" /end MEASUREMENT
/begin MEASUREMENT tq_dif_p_d_slow_is_ast_min "PD-part after start torque limitation for slow path" SWORD _CNV_A_R_LINEAR_____31_CM 1 100. -1024. 1023.96875 DISPLAY_IDENTIFIER TQ_DIF_P_D_SLOW_IS_AST_MIN ECU_ADDRESS 0xd0006694 FORMAT "%11.5" /end MEASUREMENT
/begin AXIS_PTS ldpm_t_ast_3_ensc "" 0xa0802280 t_ast _REC_AXS_20_u2 6553.5 _CNV_A_R_LINEAR_____4_CM 6 0. 6553.5 FORMAT "%6.1" /end AXIS_PTS
/begin AXIS_PTS ldpm_n_grd_fil_p_d_is_1_ensc "" 0xa0802236 n_grd_fil_p_d_is _REC_AXS_20_u1 8160. _CNV_A_R_LINEAR_____29_CM 6 -4096. 4064. FORMAT "%5.0" /end AXIS_PTS
/begin AXIS_PTS ldpm_n_dif_cor_1_ensc "" 0xa080217c n_dif_cor _REC_AXS_20_u2 65535. _CNV_A_R_LINEAR_____193_CM 12 -32768. 32767. FORMAT "%6.0" /end AXIS_PTS
/begin AXIS_PTS ldpm_n_grd_fil_p_d_is_2_ensc "" 0xa0802240 n_grd_fil_p_d_is _REC_AXS_20_u1 8160. _CNV_A_R_LINEAR_____29_CM 12 -4096. 4064. FORMAT "%5.0" /end AXIS_PTS
/begin CHARACTERISTIC c_crlc_n_grd_fil_p_d_is "Correlation constant engine speed gradient filtering PD-part" VALUE 0xa0802494 _REC_VAL_20_u2 0.9999847412109381 _CNV_A_R_LINEAR_____89_CM 0. 0.9999847412109381 DISPLAY_IDENTIFIER C_CRLC_N_GRD_FIL_P_D_IS FORMAT "%7.5" /end CHARACTERISTIC
/begin CHARACTERISTIC ip_fac_n_grd_is "Weighting factor for N_GRD input for IP_P_D_IS" MAP 0xa08022d4 _REC_MAP_20_u1_u1_u2 1.9921875 _CNV_A_R_LINEAR_____103_CM 0. 1.9921875 DISPLAY_IDENTIFIER IP_FAC_N_GRD_IS FORMAT "%8.6"
 /begin AXIS_DESCR COM_AXIS tco _CNV_A_R_LINEAR_____17_CM 8 -48. 142.5 FORMAT "%6.2" AXIS_PTS_REF ldp_tco_ip_fac_n_grd_is /end AXIS_DESCR
 /begin AXIS_DESCR COM_AXIS t_ast _CNV_A_R_LINEAR_____4_CM 8 0. 6553.5 FORMAT "%6.1" AXIS_PTS_REF ldp_t_ast_ip_fac_n_grd_is /end AXIS_DESCR
/end CHARACTERISTIC
/begin MEASUREMENT fac_tq_dif_p_d_dt_is_clc "Gear dependent weighting factor for PD-part at closed drivetrain" UWORD _CNV_A_R_LINEAR_____9_CM 1 100. 0. 1.99996948242188 DISPLAY_IDENTIFIER FAC_TQ_DIF_P_D_DT_IS_CLC ECU_ADDRESS 0xd000666c FORMAT "%7.5" /end MEASUREMENT
/begin MEASUREMENT fac_n_grd_is "Factor in dependance of TCO and TOIL for weighting the speed gradient influence on the PD-part (for LV_DT=0)" UBYTE _CNV_A_R_LINEAR_____103_CM 1 100. 0. 1.9921875 DISPLAY_IDENTIFIER FAC_N_GRD_IS ECU_ADDRESS 0xd0007494 FORMAT "%8.6" /end MEASUREMENT
/begin AXIS_PTS ldp_tco_ip_fac_n_grd_is "" 0xa0802150 tco _REC_AXS_20_u1 190.5 _CNV_A_R_LINEAR_____17_CM 8 -48. 142.5 FORMAT "%6.2" /end AXIS_PTS
/begin AXIS_PTS ldp_t_ast_ip_fac_n_grd_is "" 0xa0802128 t_ast _REC_AXS_20_u2 6553.5 _CNV_A_R_LINEAR_____4_CM 8 0. 6553.5 FORMAT "%6.1" /end AXIS_PTS
/begin CHARACTERISTIC c_crlc_n_grd_fil_i_is "Correlation constant engine speed gradient filtering I-part" VALUE 0xa0802492 _REC_VAL_20_u2 0.9999847412109381 _CNV_A_R_LINEAR_____89_CM 0. 0.9999847412109381 DISPLAY_IDENTIFIER C_CRLC_N_GRD_FIL_I_IS FORMAT "%7.5" /end CHARACTERISTIC
/begin CHARACTERISTIC c_nr_buf_n_grd_fil_p_d_is "Buffer size moving mean value engine speed gradient filtering PD-part ISC" VALUE 0xa08024b1 _REC_VAL_20_u1 14. _CNV_A_R_LINEAR_____0_CM 1. 15. DISPLAY_IDENTIFIER C_NR_BUF_N_GRD_FIL_P_D_IS FORMAT "%3.0" /end CHARACTERISTIC
/begin CHARACTERISTIC ip_crlc_tq_dif_p_d_slow_is "Correlation constant for PT1-filtering of PD-part slow path" MAP 0xa080e9b0 _REC_MAP_20_u2_u2_u1 0.9999847412109381 _CNV_A_R_LINEAR_____89_CM 0. 0.9999847412109381 DISPLAY_IDENTIFIER IP_CRLC_TQ_DIF_P_D_SLOW_IS FORMAT "%7.5"
 /begin AXIS_DESCR COM_AXIS n_dif_cor _CNV_A_R_LINEAR_____193_CM 12 -32768. 32767. FORMAT "%6.0" AXIS_PTS_REF ldpm_n_dif_cor_1_ensc /end AXIS_DESCR
 /begin AXIS_DESCR COM_AXIS n_grd_fil_p_d_is _CNV_A_R_LINEAR_____29_CM 12 -4096. 4064. FORMAT "%5.0" AXIS_PTS_REF ldpm_n_grd_fil_p_d_is_2_ensc /end AXIS_DESCR
/end CHARACTERISTIC
/begin CHARACTERISTIC ip_crlc_tq_dif_p_d_dt_slow_is "Correlation constant for PT1-filtering of PD-part slow path drivetrain engaged" MAP 0xa080e770 _REC_MAP_20_u2_u2_u1 0.9999847412109381 _CNV_A_R_LINEAR_____89_CM 0. 0.9999847412109381 DISPLAY_IDENTIFIER IP_CRLC_TQ_DIF_P_D_DT_SLOW_IS FORMAT "%7.5"
 /begin AXIS_DESCR COM_AXIS n_dif_cor _CNV_A_R_LINEAR_____193_CM 12 -32768. 32767. FORMAT "%6.0" AXIS_PTS_REF ldpm_n_dif_cor_1_ensc /end AXIS_DESCR
 /begin AXIS_DESCR COM_AXIS n_grd_fil_p_d_is _CNV_A_R_LINEAR_____29_CM 12 -4096. 4064. FORMAT "%5.0" AXIS_PTS_REF ldpm_n_grd_fil_p_d_is_2_ensc /end AXIS_DESCR
/end CHARACTERISTIC
/begin CHARACTERISTIC ip_crlc_tq_dif_p_d_fast_is "Correlation constant for PT1-filtering of PD-part fast path" MAP 0xa080e890 _REC_MAP_20_u2_u2_u1 0.9999847412109381 _CNV_A_R_LINEAR_____89_CM 0. 0.9999847412109381 DISPLAY_IDENTIFIER IP_CRLC_TQ_DIF_P_D_FAST_IS FORMAT "%7.5"
 /begin AXIS_DESCR COM_AXIS n_dif_cor _CNV_A_R_LINEAR_____193_CM 12 -32768. 32767. FORMAT "%6.0" AXIS_PTS_REF ldpm_n_dif_cor_1_ensc /end AXIS_DESCR
 /begin AXIS_DESCR COM_AXIS n_grd_fil_p_d_is _CNV_A_R_LINEAR_____29_CM 12 -4096. 4064. FORMAT "%5.0" AXIS_PTS_REF ldpm_n_grd_fil_p_d_is_2_ensc /end AXIS_DESCR
/end CHARACTERISTIC
/begin CHARACTERISTIC ip_crlc_tq_dif_p_d_dt_fast_is "Correlation constant for PT1-filtering of PD-part fast path drivetrain engaged" MAP 0xa080e650 _REC_MAP_20_u2_u2_u1 0.9999847412109381 _CNV_A_R_LINEAR_____89_CM 0. 0.9999847412109381 DISPLAY_IDENTIFIER IP_CRLC_TQ_DIF_P_D_DT_FAST_IS FORMAT "%7.5"
 /begin AXIS_DESCR COM_AXIS n_dif_cor _CNV_A_R_LINEAR_____193_CM 12 -32768. 32767. FORMAT "%6.0" AXIS_PTS_REF ldpm_n_dif_cor_1_ensc /end AXIS_DESCR
 /begin AXIS_DESCR COM_AXIS n_grd_fil_p_d_is _CNV_A_R_LINEAR_____29_CM 12 -4096. 4064. FORMAT "%5.0" AXIS_PTS_REF ldpm_n_grd_fil_p_d_is_2_ensc /end AXIS_DESCR
/end CHARACTERISTIC
/begin CHARACTERISTIC ip_tq_dif_p_d_fast_is_ast_min "After start limitation for PD-part for fast path" CURVE 0xa0802444 _REC_CUR_20_u2_u2 2047.96875 _CNV_A_R_LINEAR_____87_CM -1024. 1023.96875 DISPLAY_IDENTIFIER IP_TQ_DIF_P_D_FAST_IS_AST_MIN FORMAT "%11.5"
 /begin AXIS_DESCR COM_AXIS t_ast _CNV_A_R_LINEAR_____4_CM 6 0. 6553.5 FORMAT "%6.1" AXIS_PTS_REF ldpm_t_ast_3_ensc /end AXIS_DESCR
/end CHARACTERISTIC
/begin CHARACTERISTIC ip_tq_dif_p_d_slow_is_ast_min "After start limitation for PD-part for slow path" CURVE 0xa0802450 _REC_CUR_20_u2_u2 2047.96875 _CNV_A_R_LINEAR_____87_CM -1024. 1023.96875 DISPLAY_IDENTIFIER IP_TQ_DIF_P_D_SLOW_IS_AST_MIN FORMAT "%11.5"
 /begin AXIS_DESCR COM_AXIS t_ast _CNV_A_R_LINEAR_____4_CM 6 0. 6553.5 FORMAT "%6.1" AXIS_PTS_REF ldpm_t_ast_3_ensc /end AXIS_DESCR
/end CHARACTERISTIC
/begin CHARACTERISTIC c_tq_dif_i_is_ini "Initialisation value of TQ_DIF_I_IS in case of LV_DT = 0 -> 1" VALUE 0xa08024e0 _REC_VAL_20_s2 2047.96875 _CNV_A_R_LINEAR_____31_CM -1024. 1023.96875 DISPLAY_IDENTIFIER C_TQ_DIF_I_IS_INI FORMAT "%11.5" /end CHARACTERISTIC
/begin CHARACTERISTIC c_tq_dif_i_is_thd "Threshold of TQ_DIF_I_IS to enable the reset function" VALUE 0xa08024e2 _REC_VAL_20_s2 2047.96875 _CNV_A_R_LINEAR_____31_CM -1024. 1023.96875 DISPLAY_IDENTIFIER C_TQ_DIF_I_IS_THD FORMAT "%11.5" /end CHARACTERISTIC
/begin CHARACTERISTIC c_nr_buf_n_grd_fil_i_is "Buffer size moving mean value engine speed gradient filtering I-part ISC" VALUE 0xa08024b0 _REC_VAL_20_u1 14. _CNV_A_R_LINEAR_____0_CM 1. 15. DISPLAY_IDENTIFIER C_NR_BUF_N_GRD_FIL_I_IS FORMAT "%3.0" /end CHARACTERISTIC
/begin CHARACTERISTIC c_vs_min_tq_dif_i_is_ini "Minimum vehicle speed to enable the reset of TQ_DIF_I_IS" VALUE 0xa08024fc _REC_VAL_20_u1 255. _CNV_A_R_LINEAR_____6_CM 0. 255. DISPLAY_IDENTIFIER C_VS_MIN_TQ_DIF_I_IS_INI FORMAT "%3.0" /end CHARACTERISTIC
/begin CHARACTERISTIC id_fac_tq_dif_p_d_dt_is_clc "Weighting factor for ISC PD-part at closed drivetrain" CURVE 0xa08022bc _REC_CUR_20_u2_u1 1.99996948242188 _CNV_A_R_LINEAR_____9_CM 0. 1.99996948242188 DISPLAY_IDENTIFIER ID_FAC_TQ_DIF_P_D_DT_IS_CLC FORMAT "%7.5"
 /begin AXIS_DESCR COM_AXIS gear _CNV_A_R_LINEAR_____0_CM 8 0. 255. FORMAT "%3.0" AXIS_PTS_REF ldp_gear_id_fac_tq_dif_p_d_dt /end AXIS_DESCR
/end CHARACTERISTIC
/begin AXIS_PTS ldp_gear_id_fac_tq_dif_p_d_dt "" 0xa0802060 gear _REC_AXS_20_u1 255. _CNV_A_R_LINEAR_____0_CM 8 0. 255. FORMAT "%3.0" /end AXIS_PTS
/begin CHARACTERISTIC lc_n_grd_fil_i_swi "Logical variable for changing between N_GRD_FIL_1_IS and N_GRD_FIL_IS" VALUE 0xa0802506 _REC_VAL_20_u1 1. _CNV_A_R_LINEAR_____0_CM 0. 1. DISPLAY_IDENTIFIER LC_N_GRD_FIL_I_SWI FORMAT "%1.0" /end CHARACTERISTIC
/begin CHARACTERISTIC lc_n_grd_fil_p_d_swi "Logical variable for switching between N_GRD_FIL_1_IS and N_GRD_FIL_IS" VALUE 0xa0802507 _REC_VAL_20_u1 1. _CNV_A_R_LINEAR_____0_CM 0. 1. DISPLAY_IDENTIFIER LC_N_GRD_FIL_P_D_SWI FORMAT "%1.0" /end CHARACTERISTIC
/begin CHARACTERISTIC c_tq_bol_i_is "Bottom limit for I-controller output" VALUE 0xa08024de _REC_VAL_20_s2 2047.96875 _CNV_A_R_LINEAR_____31_CM -1024. 1023.96875 DISPLAY_IDENTIFIER C_TQ_BOL_I_IS FORMAT "%11.5" /end CHARACTERISTIC
/begin CHARACTERISTIC c_tq_bol_i_dt_is "Bottom limit for I-controller output and drive train closed" VALUE 0xa08024dc _REC_VAL_20_s2 2047.96875 _CNV_A_R_LINEAR_____31_CM -1024. 1023.96875 DISPLAY_IDENTIFIER C_TQ_BOL_I_DT_IS FORMAT "%11.5" /end CHARACTERISTIC
/begin CHARACTERISTIC c_tq_pas_i_is "Final passive value for I-controller output" VALUE 0xa08024ee _REC_VAL_20_s2 2047.96875 _CNV_A_R_LINEAR_____31_CM -1024. 1023.96875 DISPLAY_IDENTIFIER C_TQ_PAS_I_IS FORMAT "%11.5" /end CHARACTERISTIC
/begin CHARACTERISTIC c_tq_pas_i_acc_is "Final passive value for I-controller output and air conditioning compressor active" VALUE 0xa08024ec _REC_VAL_20_s2 2047.96875 _CNV_A_R_LINEAR_____31_CM -1024. 1023.96875 DISPLAY_IDENTIFIER C_TQ_PAS_I_ACC_IS FORMAT "%11.5" /end CHARACTERISTIC
/begin CHARACTERISTIC c_t_ramp_lim_p_d_dt_is "Time constant for ramp limit of P-, D-controller output in case of idle speed controller passive and LV_DT = 1" VALUE 0xa08024ca _REC_VAL_20_u2 655.35 _CNV_A_R_LINEAR_____3_CM 0. 655.35 DISPLAY_IDENTIFIER C_T_RAMP_LIM_P_D_DT_IS FORMAT "%6.2" /end CHARACTERISTIC
/begin CHARACTERISTIC ip_fac_p_d_fast_tco_is "TCO depending factor for fast path of torque coordination" CURVE 0xa0802314 _REC_CUR_20_u2_u1 1.99996948242188 _CNV_A_R_LINEAR_____9_CM 0. 1.99996948242188 DISPLAY_IDENTIFIER IP_FAC_P_D_FAST_TCO_IS FORMAT "%7.5"
 /begin AXIS_DESCR COM_AXIS tco _CNV_A_R_LINEAR_____17_CM 8 -48. 142.5 FORMAT "%6.2" AXIS_PTS_REF ldpm_tco_is_1 /end AXIS_DESCR
/end CHARACTERISTIC
/begin AXIS_PTS ldpm_tco_is_1 "" 0xa08022b0 tco _REC_AXS_20_u1 190.5 _CNV_A_R_LINEAR_____17_CM 8 -48. 142.5 FORMAT "%6.2" /end AXIS_PTS
/begin CHARACTERISTIC ip_fac_p_d_slow_tco_is "TCO depending factor for slow path of torque coordination" CURVE 0xa0802324 _REC_CUR_20_u2_u1 1.99996948242188 _CNV_A_R_LINEAR_____9_CM 0. 1.99996948242188 DISPLAY_IDENTIFIER IP_FAC_P_D_SLOW_TCO_IS FORMAT "%7.5"
 /begin AXIS_DESCR COM_AXIS tco _CNV_A_R_LINEAR_____17_CM 8 -48. 142.5 FORMAT "%6.2" AXIS_PTS_REF ldpm_tco_is_1 /end AXIS_DESCR
/end CHARACTERISTIC
/begin CHARACTERISTIC ip_n_thd_tq_dif_p_d_pctl "engine speed threshold for activation of the precontrol value of PD-part to avoid engine stalling" CURVE 0xa0802414 _REC_CUR_20_u2_u1 8160. _CNV_A_R_LINEAR_____14_CM 0. 8160. DISPLAY_IDENTIFIER IP_N_THD_TQ_DIF_P_D_PCTL FORMAT "%4.0"
 /begin AXIS_DESCR COM_AXIS tco _CNV_A_R_LINEAR_____17_CM 4 -48. 142.5 FORMAT "%6.2" AXIS_PTS_REF ldp_tco_ip_n_thd_tq_dif_p_d /end AXIS_DESCR
/end CHARACTERISTIC
/begin AXIS_PTS ldp_tco_ip_n_thd_tq_dif_p_d "" 0xa0802166 tco _REC_AXS_20_u1 190.5 _CNV_A_R_LINEAR_____17_CM 4 -48. 142.5 FORMAT "%6.2" /end AXIS_PTS
/begin CHARACTERISTIC ip_tq_bol_i_is_ast "Map for after start limitation of TQ_DIF_I_IS" CURVE 0xa080243c _REC_CUR_20_u2_u2 2047.96875 _CNV_A_R_LINEAR_____87_CM -1024. 1023.96875 DISPLAY_IDENTIFIER IP_TQ_BOL_I_IS_AST FORMAT "%11.5"
 /begin AXIS_DESCR COM_AXIS t_ast _CNV_A_R_LINEAR_____4_CM 4 0. 6553.5 FORMAT "%6.1" AXIS_PTS_REF ldp_t_ast_ip_tq_bol_i_is_ast /end AXIS_DESCR
/end CHARACTERISTIC
/begin AXIS_PTS ldp_t_ast_ip_tq_bol_i_is_ast "" 0xa080213c t_ast _REC_AXS_20_u2 6553.5 _CNV_A_R_LINEAR_____4_CM 4 0. 6553.5 FORMAT "%6.1" /end AXIS_PTS
/begin CHARACTERISTIC ip_fac_tq_dif_p_d_slow_is "Map for weighting the PD-part in the slow path" MAP 0xa08023b4 _REC_MAP_20_u2_u2_u1 1.99996948242188 _CNV_A_R_LINEAR_____9_CM 0. 1.99996948242188 DISPLAY_IDENTIFIER IP_FAC_TQ_DIF_P_D_SLOW_IS FORMAT "%7.5"
 /begin AXIS_DESCR COM_AXIS n_dif_cor _CNV_A_R_LINEAR_____193_CM 4 -32768. 32767. FORMAT "%6.0" AXIS_PTS_REF ldp_n_dif_cor_ip_fac_p_d_slow /end AXIS_DESCR
 /begin AXIS_DESCR COM_AXIS n_grd_fil_p_d_is _CNV_A_R_LINEAR_____29_CM 4 -4096. 4064. FORMAT "%5.0" AXIS_PTS_REF ldp_n_grd_p_d_is_ip_fac_p_d /end AXIS_DESCR
/end CHARACTERISTIC
/begin AXIS_PTS ldp_n_dif_cor_ip_fac_p_d_slow "" 0xa080206c n_dif_cor _REC_AXS_20_u2 65535. _CNV_A_R_LINEAR_____193_CM 4 -32768. 32767. FORMAT "%6.0" /end AXIS_PTS
/begin AXIS_PTS ldp_n_grd_p_d_is_ip_fac_p_d "" 0xa08020f6 n_grd_fil_p_d_is _REC_AXS_20_u1 8160. _CNV_A_R_LINEAR_____29_CM 4 -4096. 4064. FORMAT "%5.0" /end AXIS_PTS
/begin AXIS_PTS ldp_n_dif_ip_tq_p_d_fast_pctl "" 0xa08020a8 n_dif_pctl _REC_AXS_20_u2 65535. _CNV_A_R_LINEAR_____193_CM 6 -32768. 32767. FORMAT "%6.0" /end AXIS_PTS
/begin AXIS_PTS ldp_n_grd_ip_tq_p_d_fast_pctl "" 0xa08020c8 n_grd _REC_AXS_20_u1 8160. _CNV_A_R_LINEAR_____29_CM 8 -4096. 4064. FORMAT "%5.0" /end AXIS_PTS
/begin AXIS_PTS ldp_n_dif_ip_tq_p_d_slow_pctl "" 0xa08020b8 n_dif_pctl _REC_AXS_20_u2 65535. _CNV_A_R_LINEAR_____193_CM 6 -32768. 32767. FORMAT "%6.0" /end AXIS_PTS
/begin AXIS_PTS ldp_n_grd_ip_tq_p_d_slow_pctl "" 0xa08020d4 n_grd _REC_AXS_20_u1 8160. _CNV_A_R_LINEAR_____29_CM 8 -4096. 4064. FORMAT "%5.0" /end AXIS_PTS
/begin MEASUREMENT tq_bol_i_is "Bottom limit integral part ISC" SWORD _CNV_A_R_LINEAR_____31_CM 1 100. -1024. 1023.96875 DISPLAY_IDENTIFIER TQ_BOL_I_IS ECU_ADDRESS 0xd000667a FORMAT "%11.5" /end MEASUREMENT
/begin MEASUREMENT tq_dif_p_d_slow_pctl "PD precontrol value for slow path to assist driffing off without PV" SWORD _CNV_A_R_LINEAR_____31_CM 1 100. -1024. 1023.96875 DISPLAY_IDENTIFIER TQ_DIF_P_D_SLOW_PCTL ECU_ADDRESS 0xd0006698 FORMAT "%11.5" /end MEASUREMENT
/begin MEASUREMENT tq_dif_p_d_fast_is_clc "Map value of PD-part for fast path of torque coordination" SWORD _CNV_A_R_LINEAR_____31_CM 1 100. -1024. 1023.96875 DISPLAY_IDENTIFIER TQ_DIF_P_D_FAST_IS_CLC ECU_ADDRESS 0xd000668c FORMAT "%11.5" /end MEASUREMENT
/begin MEASUREMENT tq_dif_p_d_slow_is_clc "Map value of PD-part for slow path of torque coordination" SWORD _CNV_A_R_LINEAR_____31_CM 1 100. -1024. 1023.96875 DISPLAY_IDENTIFIER TQ_DIF_P_D_SLOW_IS_CLC ECU_ADDRESS 0xd0006696 FORMAT "%11.5" /end MEASUREMENT
/begin MEASUREMENT fac_tq_dif_p_d_slow_is "value for weighting the PD-part in the slow path" UWORD _CNV_A_R_LINEAR_____9_CM 1 100. 0. 1.99996948242188 DISPLAY_IDENTIFIER FAC_TQ_DIF_P_D_SLOW_IS ECU_ADDRESS 0xd000666e FORMAT "%7.5" /end MEASUREMENT
/begin MEASUREMENT fac_p_d_slow_tco_is "TCP depending factor for slow-path of torque coordination" UWORD _CNV_A_R_LINEAR_____9_CM 1 100. 0. 1.99996948242188 DISPLAY_IDENTIFIER FAC_P_D_SLOW_TCO_IS ECU_ADDRESS 0xd000666a FORMAT "%7.5" /end MEASUREMENT
/begin MEASUREMENT tq_dif_p_d_fast_pctl "PD precontrol value for fast path to assist driffing off without PV" SWORD _CNV_A_R_LINEAR_____31_CM 1 100. -1024. 1023.96875 DISPLAY_IDENTIFIER TQ_DIF_P_D_FAST_PCTL ECU_ADDRESS 0xd000668e FORMAT "%11.5" /end MEASUREMENT
/begin MEASUREMENT tq_dif_i_is_clc "I-part for idle speed controller" SWORD _CNV_A_R_ENSC_LINEA_935_CM 1 100. -4. 3.9998779296875 DISPLAY_IDENTIFIER TQ_DIF_I_IS_CLC ECU_ADDRESS 0xd0006680 FORMAT "%7.4" /end MEASUREMENT
/begin MEASUREMENT t_ramp_lim_p_d_dt_is "value of the time constant for ramp limit of PD-part in case of idle speed controller passive" UWORD _CNV_A_R_LINEAR_____3_CM 1 100. 0. 655.35 DISPLAY_IDENTIFIER T_RAMP_LIM_P_D_DT_IS ECU_ADDRESS 0xd0006678 FORMAT "%6.2" /end MEASUREMENT
/begin MEASUREMENT tq_tol_i_is "Top limit integral part ISC" SWORD _CNV_A_R_LINEAR_____31_CM 1 100. -1024. 1023.96875 DISPLAY_IDENTIFIER TQ_TOL_I_IS ECU_ADDRESS 0xd000669e FORMAT "%11.5" /end MEASUREMENT
/begin MEASUREMENT tq_pas_i_is "Final passive value for I-controller output" SWORD _CNV_A_R_LINEAR_____31_CM 1 100. -1024. 1023.96875 DISPLAY_IDENTIFIER TQ_PAS_I_IS ECU_ADDRESS 0xd000669a FORMAT "%11.5" /end MEASUREMENT
/begin MEASUREMENT n_dif_pctl "Engine speed deviation for driving off assistance without PV" SWORD _CNV_A_R_LINEAR_____14_CM 1 100. -32768. 32767. DISPLAY_IDENTIFIER N_DIF_PCTL ECU_ADDRESS 0xd0002512 FORMAT "%6.0" /end MEASUREMENT
/begin CHARACTERISTIC c_crlc_tq_p_d_pctl_dec "Filter correlation constant for decreasing the PD parts of driving off assistance without PV (PCTL)" VALUE 0xa0802496 _REC_VAL_20_u2 0.9999847412109381 _CNV_A_R_LINEAR_____89_CM 0. 0.9999847412109381 DISPLAY_IDENTIFIER C_CRLC_TQ_P_D_PCTL_DEC FORMAT "%7.5" /end CHARACTERISTIC
/begin CHARACTERISTIC ip_tq_dif_p_d_slow_pctl "Slow PD part to support the engine speed controller at driving off without PV" MAP 0xa080f0c0 _REC_MAP_20_u2_u2_u1 2047.96875 _CNV_A_R_LINEAR_____87_CM -1024. 1023.96875 DISPLAY_IDENTIFIER IP_TQ_DIF_P_D_SLOW_PCTL FORMAT "%11.5"
 /begin AXIS_DESCR COM_AXIS n_dif_pctl _CNV_A_R_LINEAR_____193_CM 6 -32768. 32767. FORMAT "%6.0" AXIS_PTS_REF ldp_n_dif_ip_tq_p_d_slow_pctl /end AXIS_DESCR
 /begin AXIS_DESCR COM_AXIS n_grd _CNV_A_R_LINEAR_____29_CM 8 -4096. 4064. FORMAT "%5.0" AXIS_PTS_REF ldp_n_grd_ip_tq_p_d_slow_pctl /end AXIS_DESCR
/end CHARACTERISTIC
/begin CHARACTERISTIC ip_tq_dif_p_d_fast_pctl "Fast PD part to support the engine speed controller at driving off without PV" MAP 0xa080ede0 _REC_MAP_20_u2_u2_u1 2047.96875 _CNV_A_R_LINEAR_____87_CM -1024. 1023.96875 DISPLAY_IDENTIFIER IP_TQ_DIF_P_D_FAST_PCTL FORMAT "%11.5"
 /begin AXIS_DESCR COM_AXIS n_dif_pctl _CNV_A_R_LINEAR_____193_CM 6 -32768. 32767. FORMAT "%6.0" AXIS_PTS_REF ldp_n_dif_ip_tq_p_d_fast_pctl /end AXIS_DESCR
 /begin AXIS_DESCR COM_AXIS n_grd _CNV_A_R_LINEAR_____29_CM 8 -4096. 4064. FORMAT "%5.0" AXIS_PTS_REF ldp_n_grd_ip_tq_p_d_fast_pctl /end AXIS_DESCR
/end CHARACTERISTIC
/begin MEASUREMENT fac_p_d_fast_tco_is "TCP depending factor for fast-path of torque coordination" UWORD _CNV_A_R_LINEAR_____9_CM 1 100. 0. 1.99996948242188 DISPLAY_IDENTIFIER FAC_P_D_FAST_TCO_IS ECU_ADDRESS 0xd0006668 FORMAT "%7.5" /end MEASUREMENT
/begin MEASUREMENT lv_tq_pctl_act "Activation condition for driving off assistance without driver request (PCTL function)" UBYTE _CNV_S_2_RANGE__0___1_CM 1 100. 0. 1. DISPLAY_IDENTIFIER LV_TQ_PCTL_ACT ECU_ADDRESS 0xd0002539 /end MEASUREMENT
/begin CHARACTERISTIC c_tq_tol_i_is "Top limit for I-controller output" VALUE 0xa08024f8 _REC_VAL_20_s2 2047.96875 _CNV_A_R_LINEAR_____31_CM -1024. 1023.96875 DISPLAY_IDENTIFIER C_TQ_TOL_I_IS FORMAT "%11.5" /end CHARACTERISTIC
/begin CHARACTERISTIC c_vs_pctl "Vehicle speed threshold for activation of the driving off assistance without driver request (PCTL)" VALUE 0xa08024fd _REC_VAL_20_u1 255. _CNV_A_R_LINEAR_____6_CM 0. 255. DISPLAY_IDENTIFIER C_VS_PCTL FORMAT "%3.0" /end CHARACTERISTIC
/begin CHARACTERISTIC c_vs_pctl_ofs "Vehicle speed hysteresis for the deactivation of the driving off assistance without driver request (PCTL)" VALUE 0xa08024fe _REC_VAL_20_u1 255. _CNV_A_R_LINEAR_____6_CM 0. 255. DISPLAY_IDENTIFIER C_VS_PCTL_OFS FORMAT "%3.0" /end CHARACTERISTIC
/begin CHARACTERISTIC lc_tq_pctl_inh_cdn "Flag inhibits activation conditions for driving off assistance without driver request (PCTL)" VALUE 0xa080250e _REC_VAL_20_u1 1. _CNV_A_R_LINEAR_____0_CM 0. 1. DISPLAY_IDENTIFIER LC_TQ_PCTL_INH_CDN FORMAT "%1.0" /end CHARACTERISTIC
/begin CHARACTERISTIC c_tq_pas_i_is_lgrd "constant for change limitation to ramp out TQ_DIF_I_IS to passive value at drivetrain not engaged" VALUE 0xa08024f0 _REC_VAL_20_u2 255.9921875 _CNV_A_R_ECM2_LINEA_842_CM 0. 255.9921875 DISPLAY_IDENTIFIER C_TQ_PAS_I_IS_LGRD FORMAT "%7.3" /end CHARACTERISTIC
/begin CHARACTERISTIC c_tq_pas_i_is_lgrd_dt "constant for change limitation to ramp out TQ_DIF_I_IS to passive value at drivetrain engaged" VALUE 0xa08024f2 _REC_VAL_20_u2 255.9921875 _CNV_A_R_ECM2_LINEA_842_CM 0. 255.9921875 DISPLAY_IDENTIFIER C_TQ_PAS_I_IS_LGRD_DT FORMAT "%7.3" /end CHARACTERISTIC
/begin MEASUREMENT tq_pas_i_is_lgrd "Change limitation to ramp out TQ_DIF_I_IS to passive value" UWORD _CNV_A_R_ECM2_LINEA_842_CM 1 100. 0. 255.9921875 DISPLAY_IDENTIFIER TQ_PAS_I_IS_LGRD ECU_ADDRESS 0xd000669c FORMAT "%7.3" /end MEASUREMENT
/begin MEASUREMENT state_tq_pctl_act "Circular buffer indicating the status of the pre-control function" UBYTE _CNV_A_R_LINEAR_____0_CM 1 100. 0. 255. DISPLAY_IDENTIFIER STATE_TQ_PCTL_ACT ECU_ADDRESS 0xd000749c FORMAT "%3.0" /end MEASUREMENT
/begin MEASUREMENT tq_dif_i_is_lim "Limited I part" SWORD _CNV_A_R_LINEAR_____31_CM 1 100. -1024. 1023.96875 DISPLAY_IDENTIFIER TQ_DIF_I_IS_LIM ECU_ADDRESS 0xd0006682 FORMAT "%11.5" /end MEASUREMENT
/begin MEASUREMENT tq_isc_i_min_tq_pste "I limitation min value at PSTE intervention" SWORD _CNV_A_R_LINEAR_____31_CM 1 100. -1024. 1023.96875 DISPLAY_IDENTIFIER TQ_ISC_I_MIN_TQ_PSTE ECU_ADDRESS 0xd0002534 FORMAT "%11.5" /end MEASUREMENT
/begin MEASUREMENT tq_isc_i_max_tq_pste "I limitation max value at PSTE intervention" SWORD _CNV_A_R_LINEAR_____31_CM 1 100. -1024. 1023.96875 DISPLAY_IDENTIFIER TQ_ISC_I_MAX_TQ_PSTE ECU_ADDRESS 0xd0002532 FORMAT "%11.5" /end MEASUREMENT
/begin MEASUREMENT t_tq_isc_i_tq_pste_lim "Delay time to reset the idle speed controller limitation due to PSTE" UWORD _CNV_A_R_LINEAR_____110_CM 1 100. 0. 1310.7 DISPLAY_IDENTIFIER T_TQ_ISC_I_TQ_PSTE_LIM ECU_ADDRESS 0xd0002526 FORMAT "%7.2" /end MEASUREMENT
/begin CHARACTERISTIC c_thd_tq_add_pste_i_isc "TQ_ADD_PSTE threshold for calc of I limitation threshold" VALUE 0xa08024d4 _REC_VAL_20_s2 2047.96875 _CNV_A_R_LINEAR_____31_CM -1024. 1023.96875 DISPLAY_IDENTIFIER C_THD_TQ_ADD_PSTE_I_ISC FORMAT "%11.5" /end CHARACTERISTIC
/begin CHARACTERISTIC c_thd_tq_add_pste_i_isc_hys "Hysteresis for TQ_ADD_PSTE threshold to leave I limitation" VALUE 0xa08024d6 _REC_VAL_20_s2 2047.96875 _CNV_A_R_LINEAR_____31_CM -1024. 1023.96875 DISPLAY_IDENTIFIER C_THD_TQ_ADD_PSTE_I_ISC_HYS FORMAT "%11.5" /end CHARACTERISTIC
/begin CHARACTERISTIC c_thd_tq_loss_pste_i_isc "TQ_LOSS_PSTE threshold for calc of I limitation threshold" VALUE 0xa08024d8 _REC_VAL_20_s2 2047.96875 _CNV_A_R_LINEAR_____31_CM -1024. 1023.96875 DISPLAY_IDENTIFIER C_THD_TQ_LOSS_PSTE_I_ISC FORMAT "%11.5" /end CHARACTERISTIC
/begin CHARACTERISTIC c_thd_tq_loss_pste_i_isc_hys "Hysteresis for TQ_LOSS_PSTE threshold to leave I limitation" VALUE 0xa08024da _REC_VAL_20_s2 2047.96875 _CNV_A_R_LINEAR_____31_CM -1024. 1023.96875 DISPLAY_IDENTIFIER C_THD_TQ_LOSS_PSTE_I_ISC_HYS FORMAT "%11.5" /end CHARACTERISTIC
/begin CHARACTERISTIC c_tq_isc_i_max_tq_drof "I limitation at drive off" VALUE 0xa08024e4 _REC_VAL_20_s2 2047.96875 _CNV_A_R_LINEAR_____31_CM -1024. 1023.96875 DISPLAY_IDENTIFIER C_TQ_ISC_I_MAX_TQ_DROF FORMAT "%11.5" /end CHARACTERISTIC
/begin CHARACTERISTIC c_tq_isc_i_max_tq_pste "I limitation max value at PSTE intervention" VALUE 0xa08024e6 _REC_VAL_20_s2 2047.96875 _CNV_A_R_LINEAR_____31_CM -1024. 1023.96875 DISPLAY_IDENTIFIER C_TQ_ISC_I_MAX_TQ_PSTE FORMAT "%11.5" /end CHARACTERISTIC
/begin CHARACTERISTIC c_tq_isc_i_min_tq_drof "I limitation at drive off" VALUE 0xa08024e8 _REC_VAL_20_s2 2047.96875 _CNV_A_R_LINEAR_____31_CM -1024. 1023.96875 DISPLAY_IDENTIFIER C_TQ_ISC_I_MIN_TQ_DROF FORMAT "%11.5" /end CHARACTERISTIC
/begin CHARACTERISTIC c_tq_isc_i_min_tq_pste "I limitation min value at PSTE intervention" VALUE 0xa08024ea _REC_VAL_20_s2 2047.96875 _CNV_A_R_LINEAR_____31_CM -1024. 1023.96875 DISPLAY_IDENTIFIER C_TQ_ISC_I_MIN_TQ_PSTE FORMAT "%11.5" /end CHARACTERISTIC
/begin CHARACTERISTIC c_tq_tol_i_dt_is_opm_1 "Top limit for I controller output and drive train closed in operation mode 1" VALUE 0xa08024f4 _REC_VAL_20_s2 2047.96875 _CNV_A_R_LINEAR_____31_CM -1024. 1023.96875 DISPLAY_IDENTIFIER C_TQ_TOL_I_DT_IS_OPM_1 FORMAT "%11.5" /end CHARACTERISTIC
/begin CHARACTERISTIC c_tq_tol_i_dt_is_opm_2 "Top limit for I controller output and drive train closed in operation mode 2" VALUE 0xa08024f6 _REC_VAL_20_s2 2047.96875 _CNV_A_R_LINEAR_____31_CM -1024. 1023.96875 DISPLAY_IDENTIFIER C_TQ_TOL_I_DT_IS_OPM_2 FORMAT "%11.5" /end CHARACTERISTIC
/begin CHARACTERISTIC c_t_ramp_lim_i_dt_is "Time constant for ramp limit of I controller output in case of idle speed controller passive and drive train engagedResolution is directly coupled with update rate" VALUE 0xa08024c6 _REC_VAL_20_u2 1310.7 _CNV_A_R_LINEAR_____110_CM 0. 1310.7 DISPLAY_IDENTIFIER C_T_RAMP_LIM_I_DT_IS FORMAT "%7.2" /end CHARACTERISTIC
/begin CHARACTERISTIC c_t_ramp_lim_i_is "Time constant for ramp limit of I controller output in case of idle speed controller passiveResolution is directly coupled with update rate" VALUE 0xa08024c8 _REC_VAL_20_u2 1310.7 _CNV_A_R_LINEAR_____110_CM 0. 1310.7 DISPLAY_IDENTIFIER C_T_RAMP_LIM_I_IS FORMAT "%7.2" /end CHARACTERISTIC
/begin CHARACTERISTIC c_t_ramp_lim_p_d_is "Time constant for ramp limit of P-, D-controller output in case of idle speed controller passive" VALUE 0xa08024cc _REC_VAL_20_u2 655.35 _CNV_A_R_LINEAR_____3_CM 0. 655.35 DISPLAY_IDENTIFIER C_T_RAMP_LIM_P_D_IS FORMAT "%6.2" /end CHARACTERISTIC
/begin CHARACTERISTIC c_t_tq_isc_i_tq_pste_lim "Delay time to reset the idle speed controller limitation due to PSTE" VALUE 0xa08024ce _REC_VAL_20_u2 1310.7 _CNV_A_R_LINEAR_____110_CM 0. 1310.7 DISPLAY_IDENTIFIER C_T_TQ_ISC_I_TQ_PSTE_LIM FORMAT "%7.2" /end CHARACTERISTIC
/begin AXIS_PTS ldp_n_dif_cor_ip_tq_p_d_fast_dt "" 0xa0802078 n_dif_cor _REC_AXS_20_u2 65535. _CNV_A_R_LINEAR_____193_CM 10 -32768. 32767. FORMAT "%6.0" /end AXIS_PTS
/begin AXIS_PTS ldpm_n_dif_cor_ip_tq_p_d_fast "" 0xa0802198 n_dif_cor _REC_AXS_20_u2 65535. _CNV_A_R_LINEAR_____193_CM 10 -32768. 32767. FORMAT "%6.0" /end AXIS_PTS
/begin AXIS_PTS ldp_n_grd_p_d_ip_tq_p_d_fast_dt "" 0xa08020e0 n_grd_fil_p_d_is _REC_AXS_20_u1 8160. _CNV_A_R_LINEAR_____29_CM 8 -4096. 4064. FORMAT "%5.0" /end AXIS_PTS
/begin AXIS_PTS ldpm_n_grd_p_d_ip_tq_p_d_fast "" 0xa0802250 n_grd_fil_p_d_is _REC_AXS_20_u1 8160. _CNV_A_R_LINEAR_____29_CM 8 -4096. 4064. FORMAT "%5.0" /end AXIS_PTS
/begin AXIS_PTS ldp_n_dif_cor_ip_tq_p_d_slow_dt "" 0xa0802090 n_dif_cor _REC_AXS_20_u2 65535. _CNV_A_R_LINEAR_____193_CM 10 -32768. 32767. FORMAT "%6.0" /end AXIS_PTS
/begin AXIS_PTS ldpm_n_dif_cor_ip_tq_p_d_slow "" 0xa08021b0 n_dif_cor _REC_AXS_20_u2 65535. _CNV_A_R_LINEAR_____193_CM 10 -32768. 32767. FORMAT "%6.0" /end AXIS_PTS
/begin AXIS_PTS ldpm_n_grd_p_d_ip_tq_p_d_slow "" 0xa080225c n_grd_fil_p_d_is _REC_AXS_20_u1 8160. _CNV_A_R_LINEAR_____29_CM 8 -4096. 4064. FORMAT "%5.0" /end AXIS_PTS
/begin AXIS_PTS ldp_n_grd_p_d_ip_tq_p_d_slow_dt "" 0xa08020ec n_grd_fil_p_d_is _REC_AXS_20_u1 8160. _CNV_A_R_LINEAR_____29_CM 8 -4096. 4064. FORMAT "%5.0" /end AXIS_PTS
/begin MEASUREMENT lv_drof "Bit indicating that the driving off assistance function is active" UBYTE _CNV_S_2_RANGE__0___1_CM 1 100. 0. 1. DISPLAY_IDENTIFIER LV_DROF ECU_ADDRESS 0xd00074a4 BIT_MASK 0x1 /end MEASUREMENT
/begin MEASUREMENT n_sp_is_drof "Idle speed setpoint of the driving off assistance function" UWORD _CNV_A_R_LINEAR_____14_CM 1 100. 0. 8160. DISPLAY_IDENTIFIER N_SP_IS_DROF ECU_ADDRESS 0xd0006672 FORMAT "%4.0" /end MEASUREMENT
/begin MEASUREMENT t_drof_gear "Time since a gear is detected during driving off situation" UBYTE _CNV_A_R_LINEAR_____3_CM 1 100. 0. 2.55 DISPLAY_IDENTIFIER T_DROF_GEAR ECU_ADDRESS 0xd000253b FORMAT "%4.2" /end MEASUREMENT
/begin CHARACTERISTIC c_vs_drof "Vehicle speed threshold for the activation of the driving off assistance" VALUE 0xa08024fa _REC_VAL_20_u1 255. _CNV_A_R_LINEAR_____6_CM 0. 255. DISPLAY_IDENTIFIER C_VS_DROF FORMAT "%3.0" /end CHARACTERISTIC
/begin CHARACTERISTIC c_n_max_hys_drof "Engine speed hysteresis for the activation of the driving off assistance" VALUE 0xa08024a9 _REC_VAL_20_u1 8160. _CNV_A_R_LINEAR_____10_CM 0. 8160. DISPLAY_IDENTIFIER C_N_MAX_HYS_DROF FORMAT "%4.0" /end CHARACTERISTIC
/begin CHARACTERISTIC c_t_drof_gear "Maximum time for the driving off assistance when a gear is detected" VALUE 0xa08024c2 _REC_VAL_20_u1 2.55 _CNV_A_R_LINEAR_____3_CM 0. 2.55 DISPLAY_IDENTIFIER C_T_DROF_GEAR FORMAT "%4.2" /end CHARACTERISTIC
/begin CHARACTERISTIC c_vs_hys_drof "Vehicle speed hysteresis for the activation of the driving off assistance" VALUE 0xa08024fb _REC_VAL_20_u1 255. _CNV_A_R_LINEAR_____6_CM 0. 255. DISPLAY_IDENTIFIER C_VS_HYS_DROF FORMAT "%3.0" /end CHARACTERISTIC
/begin CHARACTERISTIC ip_n_sp_is_drof "Engine speed setpoint for driving off assistance" MAP 0xa08023d4 _REC_MAP_20_u2_u2_u1 8160. _CNV_A_R_LINEAR_____14_CM 0. 8160. DISPLAY_IDENTIFIER IP_N_SP_IS_DROF FORMAT "%4.0"
 /begin AXIS_DESCR COM_AXIS pv _CNV_A_R_CPULOAD__0_448_CM 6 0. 99.90234375 FORMAT "%5.2" AXIS_PTS_REF ldp_pv_ip_n_sp_is_drof /end AXIS_DESCR
 /begin AXIS_DESCR COM_AXIS tco _CNV_A_R_LINEAR_____17_CM 4 -48. 142.5 FORMAT "%6.2" AXIS_PTS_REF ldp_tco_ip_n_sp_is_drof /end AXIS_DESCR
/end CHARACTERISTIC
/begin CHARACTERISTIC ip_n_sp_is_drof_lgrd "Gradient limitation of idle speed setpoint when driving off assistance is deactivated" CURVE 0xa0802404 _REC_CUR_20_u2_u2 8160. _CNV_A_R_LINEAR_____14_CM 0. 8160. DISPLAY_IDENTIFIER IP_N_SP_IS_DROF_LGRD FORMAT "%4.0"
 /begin AXIS_DESCR COM_AXIS pv _CNV_A_R_CPULOAD__0_448_CM 4 0. 99.90234375 FORMAT "%5.2" AXIS_PTS_REF ldp_pv_ip_n_sp_is_drof_lgrd /end AXIS_DESCR
/end CHARACTERISTIC
/begin CHARACTERISTIC c_pv_hys_drof "Pedal value hysteresis for the activation of driving off assistance" VALUE 0xa08024b6 _REC_VAL_20_u2 99.90234375 _CNV_A_R_CPULOAD__0_448_CM 0. 99.90234375 DISPLAY_IDENTIFIER C_PV_HYS_DROF FORMAT "%5.2" /end CHARACTERISTIC
/begin AXIS_PTS ldp_tco_ip_n_sp_is_drof "" 0xa080215a tco _REC_AXS_20_u1 190.5 _CNV_A_R_LINEAR_____17_CM 4 -48. 142.5 FORMAT "%6.2" /end AXIS_PTS
/begin CHARACTERISTIC c_pv_drof_max "Maximum pedal value threshold for the activation of driving off assistance" VALUE 0xa08024b2 _REC_VAL_20_u2 99.90234375 _CNV_A_R_CPULOAD__0_448_CM 0. 99.90234375 DISPLAY_IDENTIFIER C_PV_DROF_MAX FORMAT "%5.2" /end CHARACTERISTIC
/begin CHARACTERISTIC c_pv_drof_min "Minimum pedal value threshold for the activation of driving off assistance" VALUE 0xa08024b4 _REC_VAL_20_u2 99.90234375 _CNV_A_R_CPULOAD__0_448_CM 0. 99.90234375 DISPLAY_IDENTIFIER C_PV_DROF_MIN FORMAT "%5.2" /end CHARACTERISTIC
/begin CHARACTERISTIC c_n_max_drof "Engine speed threshold for the activation of the driving off assistance" VALUE 0xa08024a8 _REC_VAL_20_u1 8160. _CNV_A_R_LINEAR_____10_CM 0. 8160. DISPLAY_IDENTIFIER C_N_MAX_DROF FORMAT "%4.0" /end CHARACTERISTIC
/begin CHARACTERISTIC lc_clu_open_drof_ena "Flag enables DROF activation by using the clutch information" VALUE 0xa08024ff _REC_VAL_20_u1 1. _CNV_A_R_LINEAR_____0_CM 0. 1. DISPLAY_IDENTIFIER LC_CLU_OPEN_DROF_ENA FORMAT "%1.0" /end CHARACTERISTIC
/begin AXIS_PTS ldp_pv_ip_n_sp_is_drof "" 0xa08020fc pv _REC_AXS_20_u2 99.90234375 _CNV_A_R_CPULOAD__0_448_CM 6 0. 99.90234375 FORMAT "%5.2" /end AXIS_PTS
/begin AXIS_PTS ldp_pv_ip_n_sp_is_drof_lgrd "" 0xa080210c pv _REC_AXS_20_u2 99.90234375 _CNV_A_R_CPULOAD__0_448_CM 4 0. 99.90234375 FORMAT "%5.2" /end AXIS_PTS
/begin MEASUREMENT state_drof "Circular buffer indicating statuts of DROF" UBYTE _CNV_A_R_LINEAR_____0_CM 1 100. 0. 255. DISPLAY_IDENTIFIER STATE_DROF ECU_ADDRESS 0xd0007497 FORMAT "%3.0" /end MEASUREMENT
/begin COMPU_METHOD _CNV_A_R_LINEAR_____0_CM "" RAT_FUNC "%6.3" "-" COEFFS 0 1. 0. 0 0 1 /end COMPU_METHOD
/begin COMPU_METHOD _CNV_S_2_RANGE__0___1_CM "" TAB_VERB "%6.3" "-" COMPU_TAB_REF _CNV_S_2_RANGE__0___1 /end COMPU_METHOD
/begin COMPU_VTAB _CNV_S_2_RANGE__0___1 "" TAB_VERB 2 0 "0" 1 "1" /end COMPU_VTAB
/begin COMPU_METHOD _CNV_A_R_LINEAR_____3_CM "" RAT_FUNC "%6.3" "s" COEFFS 0 100. 0. 0 0 1 /end COMPU_METHOD
/begin COMPU_METHOD _CNV_A_R_LINEAR_____4_CM "" RAT_FUNC "%6.3" "s" COEFFS 0 10. 0. 0 0 1 /end COMPU_METHOD
/begin COMPU_METHOD _CNV_A_R_LINEAR_____5_CM "" RAT_FUNC "%6.3" "%" COEFFS 0 2.56 0. 0 0 1 /end COMPU_METHOD
/begin COMPU_METHOD _CNV_A_R_LINEAR_____6_CM "" RAT_FUNC "%6.3" "km/h" COEFFS 0 1. 0. 0 0 1 /end COMPU_METHOD
/begin COMPU_METHOD _CNV_A_R_LINEAR_____8_CM "" RAT_FUNC "%6.3" "%" COEFFS 0 655.3599999999997 0. 0 0 1 /end COMPU_METHOD
/begin COMPU_METHOD _CNV_A_R_LINEAR_____9_CM "" RAT_FUNC "%6.3" "-" COEFFS 0 32767.99999999992 0. 0 0 1 /end COMPU_METHOD
/begin COMPU_METHOD _CNV_A_R_LINEAR_____10_CM "" RAT_FUNC "%6.3" "rpm" COEFFS 0 3.125e-002 0. 0 0 1 /end COMPU_METHOD
/begin COMPU_METHOD _CNV_A_R_LINEAR_____14_CM "" RAT_FUNC "%6.3" "rpm" COEFFS 0 1. 0. 0 0 1 /end COMPU_METHOD
/begin COMPU_METHOD _CNV_A_R_LINEAR_____15_CM "" RAT_FUNC "%6.3" "mg/stk" COEFFS 0 0.183585313174946 0. 0 0 1 /end COMPU_METHOD
/begin COMPU_METHOD _CNV_A_R_LINEAR_____17_CM "" RAT_FUNC "%6.3" "°C" COEFFS 0 1.333333333333333 64. 0 0 1 /end COMPU_METHOD
/begin COMPU_METHOD _CNV_A_R_LINEAR_____20_CM "" RAT_FUNC "%6.3" "ms" COEFFS 0 0.1 0. 0 0 1 /end COMPU_METHOD
/begin COMPU_METHOD _CNV_A_R_LINEAR_____24_CM "" RAT_FUNC "%6.3" "-" COEFFS 0 16384. 0. 0 0 1 /end COMPU_METHOD
/begin COMPU_METHOD _CNV_A_R_LINEAR_____26_CM "" RAT_FUNC "%6.3" "°C" COEFFS 0 1. 40. 0 0 1 /end COMPU_METHOD
/begin COMPU_METHOD _CNV_A_R_LINEAR_____28_CM "" RAT_FUNC "%6.3" "-" COEFFS 0 256. 0. 0 0 1 /end COMPU_METHOD
/begin COMPU_METHOD _CNV_A_R_LINEAR_____29_CM "" RAT_FUNC "%6.3" "rpm/s" COEFFS 0 3.125e-002 128. 0 0 1 /end COMPU_METHOD
/begin COMPU_METHOD _CNV_A_R_LINEAR_____30_CM "" RAT_FUNC "%6.3" "rpm/s" COEFFS 0 3.125e-002 0. 0 0 1 /end COMPU_METHOD
/begin COMPU_METHOD _CNV_A_R_LINEAR_____31_CM "" RAT_FUNC "%6.3" "Nm" COEFFS 0 32. 0. 0 0 1 /end COMPU_METHOD
/begin COMPU_METHOD _CNV_A_R_LINEAR_____36_CM "" RAT_FUNC "%6.3" "s" COEFFS 0 1. 0. 0 0 1 /end COMPU_METHOD
/begin COMPU_METHOD _CNV_R_R_Def_km_sw__68_CM "Def_km_sw_q10" RAT_FUNC "%6.3" "km" COEFFS 0. 1. 0. 0. 0. 10. /end COMPU_METHOD
/begin COMPU_METHOD _CNV_S_2_RANGE______76_CM "" TAB_VERB "%6.3" "" COMPU_TAB_REF _CNV_S_2_RANGE______76 /end COMPU_METHOD
/begin COMPU_VTAB _CNV_S_2_RANGE______76 "" TAB_VERB 2 0 "0" 1 "1" /end COMPU_VTAB
/begin COMPU_METHOD _CNV_A_R_LINEAR_____87_CM "" RAT_FUNC "%6.3" "Nm" COEFFS 0 32. 32768. 0 0 1 /end COMPU_METHOD
/begin COMPU_METHOD _CNV_A_R_LINEAR_____89_CM "" RAT_FUNC "%6.3" "-" COEFFS 0 65535.99999999996 0. 0 0 1 /end COMPU_METHOD
/begin COMPU_METHOD _CNV_A_R_LINEAR_____92_CM "" RAT_FUNC "%6.3" "ms" COEFFS 0 1. 0. 0 0 1 /end COMPU_METHOD
/begin COMPU_METHOD _CNV_A_R_LINEAR_____103_CM "" RAT_FUNC "%6.3" "-" COEFFS 0 128. 0. 0 0 1 /end COMPU_METHOD
/begin COMPU_METHOD _CNV_A_R_LINEAR_____110_CM "" RAT_FUNC "%6.3" "s" COEFFS 0 50. 0. 0 0 1 /end COMPU_METHOD
/begin COMPU_METHOD _CNV_A_R_LINEAR_____111_CM "" RAT_FUNC "%6.3" "mg/stk" COEFFS 0 47.18142548596112 0. 0 0 1 /end COMPU_METHOD
/begin COMPU_METHOD _CNV_A_R_LINEAR_____115_CM "" RAT_FUNC "%6.3" "-" COEFFS 0 8192. 0. 0 0 1 /end COMPU_METHOD
/begin COMPU_METHOD _CNV_A_R_LINEAR_____119_CM "" RAT_FUNC "%6.3" "-" COEFFS 0 4096. 0. 0 0 1 /end COMPU_METHOD
/begin COMPU_METHOD _CNV_A_R_LINEAR_____129_CM "" RAT_FUNC "%6.3" "-" COEFFS 0 1024. 0. 0 0 1 /end COMPU_METHOD
/begin COMPU_METHOD _CNV_A_R_LINEAR_____134_CM "" RAT_FUNC "%6.3" "°CRK" COEFFS 0 16.0027782601146 0.5000868206284395 0 0 1 /end COMPU_METHOD
/begin COMPU_METHOD _CNV_A_R_LINEAR_____162_CM "" RAT_FUNC "%6.3" "kg/h" COEFFS 0 8192. 0. 0 0 1 /end COMPU_METHOD
/begin COMPU_METHOD _CNV_A_R_LINEAR_____170_CM "" RAT_FUNC "%6.3" "rpm" COEFFS 0 4. 0. 0 0 1 /end COMPU_METHOD
/begin COMPU_METHOD _CNV_A_R_LINEAR_____185_CM "" RAT_FUNC "%6.3" "" COEFFS 0 256. 0. 0 0 1 /end COMPU_METHOD
/begin COMPU_METHOD _CNV_A_R_LINEAR_____193_CM "" RAT_FUNC "%6.3" "rpm" COEFFS 0 1. 32768. 0 0 1 /end COMPU_METHOD
/begin COMPU_METHOD _CNV_A_R_LINEAR_____215_CM "" RAT_FUNC "%6.3" "kg/h" COEFFS 0 32. 0. 0 0 1 /end COMPU_METHOD
/begin COMPU_METHOD _CNV_A_R_LINEAR_____226_CM "" RAT_FUNC "%6.3" "%" COEFFS 0 10. 0. 0 0 1 /end COMPU_METHOD
/begin COMPU_METHOD _CNV_A_R_LINEAR_____227_CM "" RAT_FUNC "%6.3" "°TPS" COEFFS 0 137.0962343096234 0. 0 0 1 /end COMPU_METHOD
/begin COMPU_METHOD _CNV_A_R_LINEAR_____243_CM "" RAT_FUNC "%6.3" "" COEFFS 0 64. 0. 0 0 1 /end COMPU_METHOD
/begin COMPU_METHOD _CNV_A_R_LINEAR_____244_CM "" RAT_FUNC "%6.3" "mg" COEFFS 0 6.25 0. 0 0 1 /end COMPU_METHOD
/begin COMPU_METHOD _CNV_S_6_STATE_NOX__245_CM "" TAB_VERB "%6.3" "-" COMPU_TAB_REF _CNV_S_6_STATE_NOX__245 /end COMPU_METHOD
/begin COMPU_VTAB _CNV_S_6_STATE_NOX__245 "" TAB_VERB 6 0 "PASSIV" 1 "LOAD" 2 "REGENERATION" 3 "WAIT" 4 "STOP" 5 "WARMUP" /end COMPU_VTAB
/begin COMPU_METHOD _CNV_A_R_LINEAR_____247_CM "" RAT_FUNC "%6.3" "Bar" COEFFS 0 1000. 0. 0 0 1 /end COMPU_METHOD
/begin COMPU_METHOD _CNV_A_R_LINEAR_____255_CM "" RAT_FUNC "%6.3" "km" COEFFS 0 0.125 0. 0 0 1 /end COMPU_METHOD
/begin COMPU_METHOD _CNV_A_R_LINEAR_____273_CM "" RAT_FUNC "%6.3" "ms" COEFFS 0 125. 0. 0 0 1 /end COMPU_METHOD
/begin COMPU_METHOD _CNV_A_R_LINEAR_____397_CM "" RAT_FUNC "%6.3" "-" COEFFS 0 1. -1. 0 0 1 /end COMPU_METHOD
/begin COMPU_METHOD _CNV_A_R_LINEAR_____424_CM "" RAT_FUNC "%6.3" "hPa" COEFFS 0 3.125e-002 0. 0 0 1 /end COMPU_METHOD
/begin COMPU_METHOD _CNV_A_R_LINEAR_____425_CM "" RAT_FUNC "%6.3" "V" COEFFS 0 10. 0. 0 0 1 /end COMPU_METHOD
/begin COMPU_METHOD _CNV_S_4_RANGE_STAT_429_CM "" TAB_VERB "%6.3" "-" COMPU_TAB_REF _CNV_S_4_RANGE_STAT_429 /end COMPU_METHOD
/begin COMPU_VTAB _CNV_S_4_RANGE_STAT_429 "" TAB_VERB 4 0 "PASSIVE" 1 "EGY_1" 2 "EGY_2" 3 "EGY_3" /end COMPU_VTAB
/begin COMPU_METHOD _CNV_A_R_LINEAR_____438_CM "" RAT_FUNC "%6.3" "s" COEFFS 0 5. 0. 0 0 1 /end COMPU_METHOD
/begin COMPU_METHOD _CNV_A_R_CPULOAD__0_448_CM "" RAT_FUNC "%6.3" "%" COEFFS 0 10.24 0. 0 0 1 /end COMPU_METHOD
/begin COMPU_METHOD _CNV_A_R_INJR_LINEA_466_CM "" RAT_FUNC "%6.3" "ms" COEFFS 0 100. 0. 0 0 1 /end COMPU_METHOD
/begin COMPU_METHOD _CNV_A_R_LINEAR_____546_CM "" RAT_FUNC "%6.3" "°CRK" COEFFS 0 10. 0. 0 0 1 /end COMPU_METHOD
/begin COMPU_METHOD _CNV_A_R_LINEAR_____801_CM "" RAT_FUNC "%6.3" "MPa" COEFFS 0 2000. 0. 0 0 1 /end COMPU_METHOD
/begin COMPU_METHOD _CNV_A_R_LINEAR_____834_CM "" RAT_FUNC "%6.3" "" COEFFS 0 32. 0. 0 0 1 /end COMPU_METHOD
/begin COMPU_METHOD _CNV_A_R_ECM2_LINEA_842_CM "" RAT_FUNC "%6.3" "Nm" COEFFS 0 128. 0. 0 0 1 /end COMPU_METHOD
/begin COMPU_METHOD _CNV_A_R_LINEAR_____905_CM "" RAT_FUNC "%6.3" "rpm" COEFFS 0 2.5e-002 0. 0 0 1 /end COMPU_METHOD
/begin COMPU_METHOD _CNV_A_R_LINEAR_____906_CM "" RAT_FUNC "%6.3" "-" COEFFS 0 21.33333333333333 0. 0 0 1 /end COMPU_METHOD
/begin COMPU_METHOD _CNV_A_R_LINEAR_____907_CM "" RAT_FUNC "%6.3" "V" COEFFS 0 2559.999999499993 0. 0 0 1 /end COMPU_METHOD
/begin COMPU_METHOD _CNV_A_R_LINEAR_____908_CM "" RAT_FUNC "%6.3" "°CRK" COEFFS 0 128. 0. 0 0 1 /end COMPU_METHOD
/begin COMPU_METHOD _CNV_A_R_LINEAR_____909_CM "" RAT_FUNC "%6.3" "MPa" COEFFS 0 2000. 32768. 0 0 1 /end COMPU_METHOD
/begin COMPU_METHOD _CNV_A_R_LINEAR_____910_CM "" RAT_FUNC "%6.3" "°CRK" COEFFS 0 10. 32768. 0 0 1 /end COMPU_METHOD
/begin COMPU_METHOD _CNV_A_R_LINEAR_____911_CM "" RAT_FUNC "%6.3" "°CRK/MPa" COEFFS 0 327.680000003584 0. 0 0 1 /end COMPU_METHOD
/begin COMPU_METHOD _CNV_A_R_LINEAR_____912_CM "" RAT_FUNC "%6.3" "MPa" COEFFS 0 7.8125 0. 0 0 1 /end COMPU_METHOD
/begin COMPU_METHOD _CNV_A_R_LINEAR_____913_CM "" RAT_FUNC "%6.3" "ms" COEFFS 0 20. 0. 0 0 1 /end COMPU_METHOD
/begin COMPU_METHOD _CNV_A_R_LINEAR_____914_CM "" RAT_FUNC "%6.3" "mg/cm³" COEFFS 0 72.81666617193335 4.452599805517821e-004 0 0 1 /end COMPU_METHOD
/begin COMPU_METHOD _CNV_A_R_LINEAR_____915_CM "" RAT_FUNC "%6.3" "°CRK" COEFFS 0 1. 0. 0 0 1 /end COMPU_METHOD
/begin COMPU_METHOD _CNV_A_R_LINEAR_____916_CM "" RAT_FUNC "%6.3" "°CRK/ms" COEFFS 0 666.6666666666667 0. 0 0 1 /end COMPU_METHOD
/begin COMPU_METHOD _CNV_A_R_LINEAR_____917_CM "" RAT_FUNC "%6.3" "-" COEFFS 0 127.5 0. 0 0 1 /end COMPU_METHOD
/begin COMPU_METHOD _CNV_A_R_LINEAR_____918_CM "" RAT_FUNC "%6.3" "%" COEFFS 0 20.47999979439686 0. 0 0 1 /end COMPU_METHOD
/begin COMPU_METHOD _CNV_A_R_LINEAR_____919_CM "" RAT_FUNC "%6.3" "%" COEFFS 0 21.33333333333333 0. 0 0 1 /end COMPU_METHOD
/begin COMPU_METHOD _CNV_A_R_LINEAR_____920_CM "" RAT_FUNC "%6.3" "*360°CRK" COEFFS 0 1. 0. 0 0 1 /end COMPU_METHOD
/begin COMPU_METHOD _CNV_A_R_LINEAR_____921_CM "" RAT_FUNC "%6.3" "°CRK" COEFFS 0 32. 0. 0 0 1 /end COMPU_METHOD
/begin COMPU_METHOD _CNV_S_5_ENSC_RANGE_931_CM "" TAB_VERB "%6.3" "-" COMPU_TAB_REF _CNV_S_5_ENSC_RANGE_931 /end COMPU_METHOD
/begin COMPU_VTAB _CNV_S_5_ENSC_RANGE_931 "" TAB_VERB 5 0 "ISC_PASSIVE" 1 "AFTER_START" 2 "NORMAL" 3 "TRAILING_THR" 4 "PART_LOAD" /end COMPU_VTAB
/begin COMPU_METHOD _CNV_S_4_ENSC_RANGE_932_CM "" TAB_VERB "%6.3" "-" COMPU_TAB_REF _CNV_S_4_ENSC_RANGE_932 /end COMPU_METHOD
/begin COMPU_VTAB _CNV_S_4_ENSC_RANGE_932 "" TAB_VERB 4 0 "I_PASSIVE" 1 "I_NORMAL" 2 "RAMP_TO_PAS" 3 "RAMP_TO_LIM" /end COMPU_VTAB
/begin COMPU_METHOD _CNV_S_3_ENSC_RANGE_933_CM "" TAB_VERB "%6.3" "-" COMPU_TAB_REF _CNV_S_3_ENSC_RANGE_933 /end COMPU_METHOD
/begin COMPU_VTAB _CNV_S_3_ENSC_RANGE_933 "" TAB_VERB 3 0 "P_D_PASSIVE" 1 "P_D_NORMAL" 2 "RAMP_TO_ZERO" /end COMPU_VTAB
/begin COMPU_METHOD _CNV_A_R_ENSC_LINEA_934_CM "" RAT_FUNC "%6.3" "Nm" COEFFS 0 127.9999968749524 -8.000121888471767e-004 0 0 1 /end COMPU_METHOD
/begin COMPU_METHOD _CNV_A_R_ENSC_LINEA_935_CM "" RAT_FUNC "%6.3" "Nm" COEFFS 0 8192. 0. 0 0 1 /end COMPU_METHOD
/begin RECORD_LAYOUT _REC_VAL_20_u1 FNC_VALUES 1 UBYTE COLUMN_DIR DIRECT /end RECORD_LAYOUT
/begin RECORD_LAYOUT _REC_VAL_20_u2 FNC_VALUES 1 UWORD COLUMN_DIR DIRECT /end RECORD_LAYOUT
/begin RECORD_LAYOUT _REC_AXS_20_u1 NO_AXIS_PTS_X 1 UBYTE AXIS_PTS_X 2 UBYTE INDEX_INCR DIRECT /end RECORD_LAYOUT
/begin RECORD_LAYOUT _REC_MAP_20_u2_u1_u1 FNC_VALUES 1 UWORD COLUMN_DIR DIRECT /end RECORD_LAYOUT
/begin RECORD_LAYOUT _REC_CUR_20_u1_u1 FNC_VALUES 1 UBYTE COLUMN_DIR DIRECT /end RECORD_LAYOUT
/begin RECORD_LAYOUT _REC_VAL_20_s2 FNC_VALUES 1 SWORD COLUMN_DIR DIRECT /end RECORD_LAYOUT
/begin RECORD_LAYOUT _REC_MAP_20_u2_u2_u1 FNC_VALUES 1 UWORD COLUMN_DIR DIRECT /end RECORD_LAYOUT
/begin RECORD_LAYOUT _REC_AXS_20_u2 NO_AXIS_PTS_X 1 UWORD AXIS_PTS_X 2 UWORD INDEX_INCR DIRECT /end RECORD_LAYOUT
/begin RECORD_LAYOUT _REC_CUR_20_u2_u1 FNC_VALUES 1 UWORD COLUMN_DIR DIRECT /end RECORD_LAYOUT
/begin RECORD_LAYOUT _REC_CUR_20_u2_u2 FNC_VALUES 1 UWORD COLUMN_DIR DIRECT /end RECORD_LAYOUT
/begin RECORD_LAYOUT _REC_CUR_20_u1_u2 FNC_VALUES 1 UBYTE COLUMN_DIR DIRECT /end RECORD_LAYOUT
/begin RECORD_LAYOUT _REC_MAP_20_u2_u2_u2 FNC_VALUES 1 UWORD COLUMN_DIR DIRECT /end RECORD_LAYOUT
/begin RECORD_LAYOUT _REC_MAP_20_u1_u1_u1 FNC_VALUES 1 UBYTE COLUMN_DIR DIRECT /end RECORD_LAYOUT
/begin RECORD_LAYOUT _REC_MAP_20_u1_u2_u1 FNC_VALUES 1 UBYTE COLUMN_DIR DIRECT /end RECORD_LAYOUT
/begin RECORD_LAYOUT _REC_MAP_20_u1_u1_u2 FNC_VALUES 1 UBYTE COLUMN_DIR DIRECT /end RECORD_LAYOUT
/begin FUNCTION High_Pressure_Pump_Control ""
 /begin DEF_CHARACTERISTIC kihdr_rb[0] kihdr_rb[1] prrglmin_rb[0] prrglmin_rb[1] prrglmax_rb[0] prrglmax_rb[1] dwmsvvstap_rb[0] dwmsvvstap_rb[1] cwdaf_rb[0] cwdaf_rb[1] dwmsvmn_rb[0] dwmsvmn_rb[1] dwmsvmx_rb[0] dwmsvmx_rb[1] dwmsvomx_rb[0] dwmsvomx_rb[1] dwmsvost_rb[0] dwmsvost_rb[1] fdwmsvrdr_rb[0] fdwmsvrdr_rb[1] prmin_rb[0] prmin_rb[1] prminmsv_rb[0] prminmsv_rb[1] klphdrn_rb_0 klphdrn_rb_1 fwphdr_rb_0 fwphdr_rb_1 fwihdr_rb_0 fwihdr_rb_1 klphdr_rb_0 klphdr_rb_1 klihdr_rb_0 klihdr_rb_1 kfvstmsvo_rb_0 kfvstmsvo_rb_1 klvstmsvg_rb_0 klvstmsvg_rb_1 kftamsv_rb_0 kftamsv_rb_1 klvzmsv_rb_1 c_rho_fuel dwotz1otp_rb[0] dwotz1otp_rb[1] wnwras_rb[0] wnwras_rb[1] klvzmsv_rb_0 klvzmsvt_rb_1 sy_camnmsv_rb[0] sy_camnmsv_rb[1] sy_tmmsv_rb[0] sy_tmmsv_rb[1] klvzmsvt_rb_0 kfvzmsvdw_rb_0 kfvzmsvdw_rb_1 cwvstmsv_rb[0] cwvstmsv_rb[1] c_t_pls_diag_vcv[0] c_t_pls_diag_vcv[1] kltamsvub_rb cwtmsv_rb[0] cwtmsv_rb[1] tmsvapl_rb[0] tmsvapl_rb[1] ttmt_rb[0] ttmt_rb[1] ttfl_rb[0] ttfl_rb[1] teig_rb[0] teig_rb[1] tmsvquali_rb[0] tmsvquali_rb[1] fkttfuel_rb[0] fkttfuel_rb[1] klftmsv_rb_0 klftmsv_rb_1 klnmtmsv_rb_0 klnmtmsv_rb_1 dwvstmsvst_rb[0] dwvstmsvst_rb[1] dwvstmsvap_rb[0] dwvstmsvap_rb[1] nmsvzpah_rb[0] nmsvzpah_rb[1] nmsvzpas_rb[0] nmsvzpas_rb[1] rkmsvzpah_rb[0] rkmsvzpah_rb[1] rkmsvzpas_rb[0] rkmsvzpas_rb[1] tnstmsvzpa_rb[0] tnstmsvzpa_rb[1] tmmsvzpao_rb[0] tmmsvzpao_rb[1] tmmsvzpau_rb[0] tmmsvzpau_rb[1] klfvstgtf_rb_0 klfvstgtf_rb_1 klfvstotf_rb_0 klfvstotf_rb_1 cwamsv_rb[0] cwamsv_rb[1] prmsvhdst_rb[0] prmsvhdst_rb[1] prminsaof_rb[0] prminsaof_rb[1] kfwhzmsv_rb_0 kfwhzmsv_rb_1 sy_fsszpa_rb[0] sy_fsszpa_rb[1] c_t_max_vcv_ctl_st[0] c_t_max_vcv_ctl_st[1] nc_t_dur_max kltamsvubs_rb /end DEF_CHARACTERISTIC
 /begin OUT_MEASUREMENT nmot_rb nmot_w_rb prsoll_w_rb[0] prsoll_w_rb[1] prist_w_rb[0] prist_w_rb[1] B_hdr_rb[0] B_hdr_rb[1] rkmeeff_w_rb[0] rkmeeff_w_rb[1] B_bm_rb B_stend_rb ubsqf_rb B_msvoff_rb[0] B_msvoff_rb[1] B_sthdp_rb ubsqf_w_rb B_sa_rb B_stprel_rb B_sabte_rb wnwvfa_w_rb[0] wnwvfa_w_rb[1] tmot_rb tfuelsq_rb tnse_w_rb E_tm_rb E_n_rb B_tfuelg_rb B_entist_rb B_ll_rb B_tprel_rb prsollu_w_rb[0] prsollu_w_rb[1] B_lr_rb B_lr2_rb pria_w_rb[0] pria_w_rb[1] prdr_w_rb[0] prdr_w_rb[1] prdiff_w_rb[0] prdiff_w_rb[1] vstmsvoa_w_rb[0] vstmsvoa_w_rb[1] B_msvkma_rb[0] B_msvkma_rb[1] B_hdrres_rb[0] B_hdrres_rb[1] B_msvact_rb[0] B_msvact_rb[1] dwmsvvst_w_rb[0] dwmsvvst_w_rb[1] dwmsvd_w_rb[0] dwmsvd_w_rb[1] dwmsvo_w_rb[0] dwmsvo_w_rb[1] dwmsvovb_w_rb[0] dwmsvovb_w_rb[1] vstmsvga_w_rb[0] vstmsvga_w_rb[1] dwmsvs_w_rb[0] dwmsvs_w_rb[1] prpa_w_rb[0] prpa_w_rb[1] B_hdrba_rb[0] B_hdrba_rb[1] wvzmsv_w_rb[0] wvzmsv_w_rb[1] t_vcv_ctl_st[0] t_vcv_ctl_st[1] ang_ref_vcv[0] ang_ref_vcv[1] ang_close_vcv[0] ang_close_vcv[1] ang_open_vcv[0] ang_open_vcv[1] kphdr_u16_rb[0] kphdr_u16_rb[1] kihdr_u16_rb[0] kihdr_u16_rb[1] vststa_w_rb[0] vststa_w_rb[1] tvzmsv_rb[0] tvzmsv_rb[1] tvzmsvr_rb[0] tvzmsvr_rb[1] tmp_u16_rb[0] tmp_u16_rb[1] B_enreq_1_rb[0] B_enreq_1_rb[1] B_enreq_0_rb[0] B_enreq_0_rb[1] ang_dur_vcv_ctl_1[0] ang_dur_vcv_ctl_1[1] pwm_vcv_ctl_1 pwm_vcv_ctl_2 tamsvac_rb B_tmsvmg_rb[0] B_tmsvmg_rb[1] tmsvtmtf_rb[0] tmsvtmtf_rb[1] tmsvtflf_rb[0] tmsvtflf_rb[1] tmsvtmtst_rb[0] tmsvtmtst_rb[1] tmsvm_rb[0] tmsvm_rb[1] tmsveig_rb[0] tmsveig_rb[1] tmsveigf_rb[0] tmsveigf_rb[1] B_msvzpa_rb[0] B_msvzpa_rb[1] B_msvzpa0_rb[0] B_msvzpa0_rb[1] vstmsvfg_w_rb[0] vstmsvfg_w_rb[1] B_cononmsv_rb[0] B_cononmsv_rb[1] B_tmpst_rb whzmsv_w_rb[0] whzmsv_w_rb[1] B_dwmsvmn_rb[0] B_dwmsvmn_rb[1] dwmsvmn_w_rb[0] dwmsvmn_w_rb[1] frkkma_rb[0] frkkma_rb[1] tamsvst_rb pwm_vcv_ctl_st /end OUT_MEASUREMENT
/end FUNCTION
/begin FUNCTION C_4_INTC ""
 /begin SUB_FUNCTION INTC_FLX_Messages_EILU INTC_FLX_Messages_TRV_and_LGT_dynamic INTC_FLX_messages_ESP /end SUB_FUNCTION
/end FUNCTION
/begin FUNCTION INTC_FLX_Messages_EILU "" /begin DEF_CHARACTERISTIC lc_com_1_nwl_info /end DEF_CHARACTERISTIC
 /begin OUT_MEASUREMENT state_key state_veh_cdn t_pow_off lv_t_pow_off tcc_com_2_cas tcc_com_2_cas_2 crc_com_2_cas crc_com_2_cas_2 crc_clc_com_2_cas_2 crc_clc_com_2_cas lv_cas_msg_vld tcc_com_1_tq_tcs state_ecu_tq_wheel_tcs state_com_1_tq_tcs_err state_tqb_sum_tcs state_n_wheel_re_le state_n_wheel_re_ri state_n_wheel_fn_le state_n_wheel_fn_ri tcc_com_1_wheel_tcs tcc_com_1_tq_tcs_prev /end OUT_MEASUREMENT
/end FUNCTION
/begin FUNCTION INTC_FLX_Messages_TRV_and_LGT_dynamic ""
 /begin OUT_MEASUREMENT tcc_vs crc_vs crc_clc_vs crc_clc_com_1_vs crc_com_1_vs tcc_com_1_vs crc_clc_com_1_tq_pste crc_com_1_tq_pste tcc_com_1_tq_pste crc_clc_com_1_req_tqdw crc_com_1_req_tqdw tcc_com_1_req_tqdw crc_clc_com_1_ac_trv crc_clc_com_1_ac_lgt crc_com_1_ac_trv crc_com_1_ac_lgt tcc_com_1_ac_trv tcc_com_1_ac_lgt tcc_com_1_tq_loss_cord crc_com_1_tq_loss_cord crc_clc_com_1_tq_loss_cord state_ecu_tq_loss_cord state_tq_loss_cord_sp tcc_com_1_tq_driv_asi crc_com_1_tq_driv_asi crc_clc_com_1_tq_driv_asi state_ecu_tq_wheel_driv_asi state_tq_wheel_driv_asi tcc_com_1_veh_mod crc_com_1_veh_mod crc_clc_com_1_veh_mod /end OUT_MEASUREMENT
/end FUNCTION
/begin FUNCTION INTC_FLX_messages_ESP "" /end FUNCTION
/begin FUNCTION IO_SWTEST "" /end FUNCTION
/begin FUNCTION C_8_ENSC "C_8_ENSC"
 /begin SUB_FUNCTION ENSC_Act_conditions_for_isc ENSC_Act_conditions_for_isc__AI ENSC_Idle_speed_control ENSC_Idle_speed_control__AI ENSC_Idle_speed_parameters ENSC_Idle_speed_torque_reserve ENSC_Idle_speed_torque_res__AI /end SUB_FUNCTION
/end FUNCTION
/begin FUNCTION ENSC_Act_conditions_for_isc "_Act_conditions_for_isc"
 /begin DEF_CHARACTERISTIC lc_isc_act_ast_cdn_swi lc_isc_act_norm_cdn_swi c_t_dly_isc_act_pu c_t_dly_isc_act_ast c_t_dly_isc_act_norm lc_isc_pu_act_sel c_n_dif_isc_act_pl_down c_n_dif_isc_act_pl_up c_n_sp_is_max_pl_act lc_isc_act_cdn_swi lc_isc_pl_act_inh c_n_dif_isc_act_ast c_n_dif_min_ris c_t_min_ris c_t_trig_n_dif_min /end DEF_CHARACTERISTIC
 /begin OUT_MEASUREMENT t_ctr_pu_isc_act t_ctr_is_isc_act state_req_isc lv_n_grd_neg_fil lv_req_isc lv_n_fall_det n_trig_min n_dif_min_ris n_trig_dif_min /end OUT_MEASUREMENT
/end FUNCTION
/begin FUNCTION ENSC_Act_conditions_for_isc__AI "_Act_conditions_for_isc__AI"
 /begin DEF_CHARACTERISTIC c_n_sp_is_ofs_i_inh_ast ldpm_tco_3_ensc ip_n_thd_isc_act_ast ip_t_dly_isc_act_ast ip_t_dly_tq_i_inh_ast ip_t_dly_tq_p_d_inh_ast /end DEF_CHARACTERISTIC
 /begin OUT_MEASUREMENT lv_req_isc_inh lv_isc_req_inh_ast t_dly_tq_p_d_inh_ast t_dly_tq_i_inh_ast t_dly_isc_act_ast lv_isc_inh lv_tq_i_isc_inh lv_tq_p_d_isc_inh /end OUT_MEASUREMENT
/end FUNCTION
/begin FUNCTION ENSC_Idle_speed_control "_Idle_speed_control"
 /begin DEF_CHARACTERISTIC lc_tq_add_i_is_drof_inh lc_tq_dif_p_d_slow_inh lc_tq_add_i_inh_as lc_tq_dif_p_d_inh_as lc_tq_dif_i_inh_as lc_isc_inh /end DEF_CHARACTERISTIC
 /begin OUT_MEASUREMENT state_pas_ramp_act_p_d_is state_pas_ramp_act_i_is state_i_isc state_p_d_isc tq_add_ramp_p_d_fast_is t_ramp_lim_p_d_is tq_add_ramp_p_d_slow_is tq_dif_i_is tq_add_i_is tq_dif_p_d_slow_is tq_dif_p_d_slow_is_1 tq_dif_p_d_slow_is_2 tq_dif_p_d_fast_is /end OUT_MEASUREMENT
/end FUNCTION
/begin FUNCTION ENSC_Idle_speed_control__AI "_Idle_speed_control__AI"
 /begin DEF_CHARACTERISTIC ldpm_t_ast_3_ensc ldpm_n_grd_fil_p_d_is_1_ensc ldpm_n_dif_cor_1_ensc ldpm_n_grd_fil_p_d_is_2_ensc c_crlc_n_grd_fil_p_d_is ip_fac_n_grd_is ldp_tco_ip_fac_n_grd_is ldp_t_ast_ip_fac_n_grd_is c_crlc_n_grd_fil_i_is c_nr_buf_n_grd_fil_p_d_is ip_crlc_tq_dif_p_d_slow_is ip_crlc_tq_dif_p_d_dt_slow_is ip_crlc_tq_dif_p_d_fast_is ip_crlc_tq_dif_p_d_dt_fast_is ip_tq_dif_p_d_fast_is_ast_min ip_tq_dif_p_d_slow_is_ast_min c_tq_dif_i_is_ini c_tq_dif_i_is_thd c_nr_buf_n_grd_fil_i_is c_vs_min_tq_dif_i_is_ini id_fac_tq_dif_p_d_dt_is_clc ldp_gear_id_fac_tq_dif_p_d_dt lc_n_grd_fil_i_swi lc_n_grd_fil_p_d_swi /end DEF_CHARACTERISTIC
 /begin OUT_MEASUREMENT crlc_tq_dif_p_d_fast_is crlc_tq_dif_p_d_slow_is n_grd_fil_i_is n_grd_fil_p_d_is tq_dif_p_d_fast_is_ast_min tq_dif_p_d_slow_is_ast_min fac_tq_dif_p_d_dt_is_clc fac_n_grd_is /end OUT_MEASUREMENT
/end FUNCTION
/begin FUNCTION ENSC_Idle_speed_parameters "_Idle_speed_parameters"
 /begin DEF_CHARACTERISTIC c_tq_bol_i_is c_tq_bol_i_dt_is c_tq_pas_i_is c_tq_pas_i_acc_is c_t_ramp_lim_p_d_dt_is ip_fac_p_d_fast_tco_is ldpm_tco_is_1 ip_fac_p_d_slow_tco_is ip_n_thd_tq_dif_p_d_pctl ldp_tco_ip_n_thd_tq_dif_p_d ip_tq_bol_i_is_ast ldp_t_ast_ip_tq_bol_i_is_ast ip_fac_tq_dif_p_d_slow_is ldp_n_dif_cor_ip_fac_p_d_slow ldp_n_grd_p_d_is_ip_fac_p_d ldp_n_dif_ip_tq_p_d_fast_pctl ldp_n_grd_ip_tq_p_d_fast_pctl ldp_n_dif_ip_tq_p_d_slow_pctl ldp_n_grd_ip_tq_p_d_slow_pctl c_crlc_tq_p_d_pctl_dec ip_tq_dif_p_d_slow_pctl ip_tq_dif_p_d_fast_pctl c_tq_tol_i_is c_vs_pctl c_vs_pctl_ofs lc_tq_pctl_inh_cdn c_tq_pas_i_is_lgrd c_tq_pas_i_is_lgrd_dt c_thd_tq_add_pste_i_isc c_thd_tq_add_pste_i_isc_hys c_thd_tq_loss_pste_i_isc c_thd_tq_loss_pste_i_isc_hys c_tq_isc_i_max_tq_drof c_tq_isc_i_max_tq_pste c_tq_isc_i_min_tq_drof c_tq_isc_i_min_tq_pste c_tq_tol_i_dt_is_opm_1 c_tq_tol_i_dt_is_opm_2 c_t_ramp_lim_i_dt_is c_t_ramp_lim_i_is c_t_ramp_lim_p_d_is c_t_tq_isc_i_tq_pste_lim ldp_n_dif_cor_ip_tq_p_d_fast_dt ldpm_n_dif_cor_ip_tq_p_d_fast ldp_n_grd_p_d_ip_tq_p_d_fast_dt ldpm_n_grd_p_d_ip_tq_p_d_fast ldp_n_dif_cor_ip_tq_p_d_slow_dt ldpm_n_dif_cor_ip_tq_p_d_slow ldpm_n_grd_p_d_ip_tq_p_d_slow ldp_n_grd_p_d_ip_tq_p_d_slow_dt /end DEF_CHARACTERISTIC
 /begin OUT_MEASUREMENT tq_bol_i_is tq_dif_p_d_slow_pctl tq_dif_p_d_fast_is_clc tq_dif_p_d_slow_is_clc fac_tq_dif_p_d_slow_is fac_p_d_slow_tco_is tq_dif_p_d_fast_pctl tq_dif_i_is_clc t_ramp_lim_p_d_dt_is tq_tol_i_is tq_pas_i_is n_dif_pctl fac_p_d_fast_tco_is lv_tq_pctl_act tq_pas_i_is_lgrd state_tq_pctl_act tq_dif_i_is_lim tq_isc_i_min_tq_pste tq_isc_i_max_tq_pste t_tq_isc_i_tq_pste_lim /end OUT_MEASUREMENT
/end FUNCTION
/begin FUNCTION ENSC_Idle_speed_torque_reserve "_Idle_speed_torque_reserve" /end FUNCTION
/begin FUNCTION ENSC_Idle_speed_torque_res__AI "_Idle_speed_torque_res__AI" /end FUNCTION
/begin FUNCTION C_A_ENSC "C_A_ENSC"
 /begin SUB_FUNCTION ENSC_Idle_speed_control_diag ENSC_Idle_speed_control_diag_AI /end SUB_FUNCTION
/end FUNCTION
/begin FUNCTION ENSC_Idle_speed_control_diag "_Idle_speed_control_diag"
 /begin DEF_CHARACTERISTIC c_maf_max_diag_isc c_n_dif_max_diag_isc c_flow_cps_max_diag_isc c_t_dly_isc_diag c_t_dly_tq_dif_i_is_diag c_n_dif_min_diag_isc lc_t_isc_diag_ast_inh /end DEF_CHARACTERISTIC
 /begin OUT_MEASUREMENT t_isc_diag lv_err_isc lv_err_isc_cst t_dly_tq_dif_i_is_diag n_dif_min_diag_isc_cst n_dif_max_diag_isc_cst /end OUT_MEASUREMENT
/end FUNCTION
/begin FUNCTION ENSC_Idle_speed_control_diag_AI "_Idle_speed_control_diag_ai"
 /begin DEF_CHARACTERISTIC c_abc_inc_isc c_abc_dec_isc c_abc_inc_isc_cst c_abc_dec_isc_cst c_abc_max_isc_cst c_abc_max_isc c_tco_min_isc c_tco_min_isc_cst ldp_t_ast_ip_fac_diag_isc_cst ldp_tco_st_ip_t_inh_isc_diag ldp_tco_ip_diag_isc_cst ldp_tco_st_ip_diag_isc_cst ip_fac_dif_diag_isc_cst ip_t_isc_diag_ast_inh ip_n_dif_max_diag_isc_cst ip_n_dif_min_diag_isc_cst /end DEF_CHARACTERISTIC
/end FUNCTION
/begin FUNCTION C_4_ENSC "C_4_ENSC"
 /begin SUB_FUNCTION ENSC_Driving_off_assistance ENSC_Engine_speed_sp_calculation /end SUB_FUNCTION
/end FUNCTION
/begin FUNCTION ENSC_Driving_off_assistance "_Driving_off_assistance"
 /begin DEF_CHARACTERISTIC c_vs_drof c_n_max_hys_drof c_t_drof_gear c_vs_hys_drof ip_n_sp_is_drof ip_n_sp_is_drof_lgrd c_pv_hys_drof ldp_tco_ip_n_sp_is_drof c_pv_drof_max c_pv_drof_min c_n_max_drof lc_clu_open_drof_ena ldp_pv_ip_n_sp_is_drof ldp_pv_ip_n_sp_is_drof_lgrd /end DEF_CHARACTERISTIC
 /begin OUT_MEASUREMENT lv_drof n_sp_is_drof t_drof_gear state_drof /end OUT_MEASUREMENT
/end FUNCTION
/begin FUNCTION ENSC_Engine_speed_sp_calculation "_Engine_speed_sp_calculation" /end FUNCTION
/begin FUNCTION __DDS_EXPA2_DEFAULT_FUNC__ "__DDS_EXPA2_DEFAULT_FUNC__"
 /begin OUT_MEASUREMENT iga_dif_bas_crk_cyl_lam cycnr_puc n_hys_puc n_min_puc n_hys_min_puc n_hys_act_puc lv_diagcps_min_mod lv_eol_cps_ini lv_opm_av_cng_diagcps t_diagcps_dly_1_rbm t_diagcps_dly_2_rbm t_diagcps_maf_rbm lv_t_diagcps_rbm t_diagcps_n_map_1_rbm lv_n_can_err lv_fmy_exit_st nt_eff_cor_rpu nt_stc_bas_rpu ntl_rpu lv_rgn_nt_req_rpu lv_act_int_puc_afl_rpu_1 lv_act_int_puc_afl_rpu_2 lv_rgn_agi_rpu_1 lv_rgn_agi_rpu_2 lv_sens_afr_rpu_1 lv_sens_afr_rpu_2 lv_nt_afs_req_rpu state_nox_rpu toil_max_warn vs_toil_max n_toil_max gear_toil_max tqi_av_toil_max tco_toil_max tam_toil_max ctr_toil_max pv_av_toil_max lv_cs_toil_max toil_thd_toil_max dist_toil_max lv_toil_thd_warn_1 lv_toil_thd_warn_2 n_ratio_conv lv_inh_bal_cus cdn_diag_el_cps lv_inh_diag_seg_ad_er lv_inh_diag_t_seg_er vs_rr_edge_t_av_max poil_sp_ext_adj poil_pwm_ext_adj tps_ext_adj state_egy_min_kwp ctr_err_dyn_nr_obd inh_iv_kwp state_iv_chg cyl_id_sam_trig lv_err_load_tps_plaus lv_err_map_dip_plaus lv_err_alter_bn_rgn lv_inh_diag_rbm_mec_ivvt_ex lv_eol_obd_dc state_rbm_mec_ivvt_ex lv_inh_diag_rbm_mec_ivvt_in[0] lv_inh_diag_rbm_mec_ivvt_in[1] lv_inh_diag_rbm_map_dip_plaus lv_inh_diag_rbm_load_tps_plaus state_rbm_mec_ivvt_in[0] state_rbm_mec_ivvt_in[1] state_rbm_map_dip_plaus state_rbm_load_tps_plaus lv_end_rbm_mec_ivvt_ex lv_end_rbm_mec_ivvt_in[0] lv_end_rbm_mec_ivvt_in[1] lv_end_rbm_map_dip_plaus lv_end_rbm_load_tps_plaus lv_cdn_rbm_mec_ivvt_ex lv_cdn_rbm_mec_ivvt_in[0] lv_cdn_rbm_mec_ivvt_in[1] lv_cdn_rbm_map_dip_plaus lv_cdn_rbm_load_tps_plaus state_rbm_tq_cst lv_err_amp_plaus_cus lv_err_tcha_prs_low lv_err_tcha_leak lv_err_tcha_prs_high lv_err_tcha_prs_dif lv_err_put_plaus lv_err_map_plaus lv_err_tq_cst lv_err_gen_el lv_err_gen_mec lv_err_gen_h_temp lv_err_gen_typ_not_plaus lv_err_gen_msg_lost lv_err_gen_clc_v_not_plaus lv_err_gen_h_temp_clc lv_err_gen_ctl_not_plaus cdn_diag_ect_el lv_err_ect_el lv_err_ecf[0] lv_err_ecf[1] pow_out_ecf t_dly_purge_diagcps maf_kgh_add_max tqi_sp_s lv_lamb_cop lv_lamb_cop_[0] lv_lamb_cop_[1] lamb_cop[0] lamb_cop[1] fac_maf_rel_egr_cor_1 fac_maf_rel_egr_cor_2 fac_maf_rel_egr_cor n_sp_is_brake fac_tq_add_is_opm_sel n_sp_is_poil_ctl fac_tq_loss_opm_sel lamb_sp_[0] lamb_sp_[1] lamb_sp_hom[0] lamb_sp_hom[1] lv_cs toil_mes state_oil_req state_loil qoil_ds_can_2_1 qoil_ds_can_2_2 qoil_ds_can_2_3 qoil_ds_can_2_4 qoil_ds_can_2_5 qoil_ds_can_2_6 dist_resi_oil dist_resi_oil_km state_oil_avl poil_sp poil_pwm lv_poil_swi_cus lv_soil_vld_loil_cus lv_t_cool_vld_loil_cus fac_mff_cst_opm_sel mff_sp_s fac_ti_wup_opm_sel fac_ti_cast_opm_sel inj_mod_s_req mff_sp_1_s[0] mff_sp_1_s[1] mff_sp_1_s[2] mff_sp_1_s[3] mff_sp_1_s[4] mff_sp_1_s[5] mff_sp_1_s[6] mff_sp_1_s[7] mff_sp_2_s[0] mff_sp_2_s[1] mff_sp_2_s[2] mff_sp_2_s[3] mff_sp_2_s[4] mff_sp_2_s[5] mff_sp_2_s[6] mff_sp_2_s[7] mff_sp_3_s[0] mff_sp_3_s[1] mff_sp_3_s[2] mff_sp_3_s[3] /end OUT_MEASUREMENT
/end FUNCTION
/end MODULE
/end PROJECT
