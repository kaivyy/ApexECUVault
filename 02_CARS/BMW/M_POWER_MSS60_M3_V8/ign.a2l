ASAP2_VERSION 1 30
/begin PROJECT MSS65-ign "Generiert am 14.10.05 um 09:57:47"
/begin HEADER "" VERSION "R341" /end HEADER
/begin MODULE _MSS65-ign "Generiert am 14.10.05 um 09:57:47"
/begin MOD_PAR "" VERSION "ccp 2.1" ADDR_EPK 0x67CA8 EPK "V530" SUPPLIER "ZS-M-57" CUSTOMER "ZS-M-52" CUSTOMER_NO "xxx" USER "Q......." ECU "MSS65-IGN"
 /begin MEMORY_SEGMENT CODESEG1 "Program" CODE FLASH INTERN 0x10000 0x60000 -1 -1 -1 -1 -1 /end MEMORY_SEGMENT
 /begin MEMORY_SEGMENT CODESEG2 "Program" CODE FLASH EXTERN 0x450000 0x1B0000 -1 -1 -1 -1 -1 /end MEMORY_SEGMENT
 /begin MEMORY_SEGMENT DATASEG1 "Appl.-DATA" DATA FLASH INTERN 0x70000 0x10000 -1 -1 -1 -1 -1 /end MEMORY_SEGMENT
 /begin MEMORY_SEGMENT VARSEG "Variablen" VARIABLES RAM INTERN 0x3F8000 0x8000 -1 -1 -1 -1 -1 /end MEMORY_SEGMENT
 /begin CALIBRATION_METHOD DSERAP 1 /begin CALIBRATION_HANDLE 458752 65532 /end CALIBRATION_HANDLE /end CALIBRATION_METHOD
/end MOD_PAR
/begin MOD_COMMON "" BYTE_ORDER MSB_FIRST ALIGNMENT_BYTE 1 ALIGNMENT_WORD 2 ALIGNMENT_LONG 4 ALIGNMENT_FLOAT32_IEEE 4 ALIGNMENT_FLOAT64_IEEE 8 /end MOD_COMMON
/begin IF_DATA EDIC_ISO_DS2 "V1.0" 0x12 25 1 SUPP_SERVICE READMEM SUPP_SERVICE WRITEMEM SUPP_SERVICE ACK TELDATA 0x9E /end IF_DATA
/begin IF_DATA ASAP1B_CCP
 /begin SOURCE "5 ms" 3 5 QP_BLOB 0 LENGTH 20 CAN_ID_FIXED 0x410 RASTER 0 FIRST_PID 0 /end SOURCE
 /begin SOURCE "100 ms" 5 1 QP_BLOB 1 LENGTH 10 CAN_ID_FIXED 0x411 RASTER 1 FIRST_PID 20 /end SOURCE
 /begin SOURCE "segment-synchron" 103 1 QP_BLOB 2 LENGTH 10 CAN_ID_FIXED 0x412 RASTER 2 FIRST_PID 30 /end SOURCE
 /begin TP_BLOB 0x201 0x202 0x400 0x401 0x1234 MSB_FIRST /begin CAN_PARAM 0x1F4 0x41 0x25 /end CAN_PARAM
  /begin DEFINED_PAGES 1 Workingpage 0x0 0xC70000 0x10000 RAM RAM_INIT_BY_ECU FLASH_BACK DEFAULT /end DEFINED_PAGES
  /begin DEFINED_PAGES 2 Referenzpage 0x0 0x70000 0x10000 FLASH RAM_INIT_BY_ECU /end DEFINED_PAGES
  OPTIONAL_CMD 0xC OPTIONAL_CMD 0xD OPTIONAL_CMD 0xE OPTIONAL_CMD 0x9 OPTIONAL_CMD 0x10 OPTIONAL_CMD 0x11 OPTIONAL_CMD 0x12 OPTIONAL_CMD 0x13 OPTIONAL_CMD 0x18 OPTIONAL_CMD 0x19 OPTIONAL_CMD 0x22 OPTIONAL_CMD 0x23 BAUDRATE 500000 SAMPLE_POINT 66 SAMPLE_RATE 1 /begin CHECKSUM_PARAM 0x8009 65532 CHECKSUM_CALCULATION ACTIVE_PAGE /end CHECKSUM_PARAM RESUME_SUPPORTED STORE_SUPPORTED /end TP_BLOB
 /begin RASTER "5ms-Task" 5ms 0 3 5 /end RASTER
 /begin RASTER "100ms-Task" 100ms 1 5 1 /end RASTER
 /begin RASTER "sync-Task" sync 2 103 1 /end RASTER
/end IF_DATA
/begin IF_DATA ASAP1B_KWP2000
 /begin SOURCE "timeslot" 0 0 QP_BLOB 0 BLOCKMODE 0xf0 0 20 /end SOURCE
 /begin TP_BLOB 0x100 0x11 0xF1 WuP MSB_FIRST 1 0x0 TIME_DEF 20 2 25 28 250 0 SERAM 393472 393472 457471 457471 0 0 1 0 0 1 /begin CHECKSUM 0x10201 0x1 0x1 REQUESTROUTINERESULTS RNC_RESULT 35 /end CHECKSUM
  /begin FLASH_COPY TOOLFLASHBACK 0x3 REQUESTROUTINERESULTS RAM_INITBYECU 0x86 COPY_FRAME 1 RNC_RESULT 35 251 252 /end FLASH_COPY
  K_LINE WuP 0x11 0xF1 /end TP_BLOB
/end IF_DATA
/begin CHARACTERISTIC K_AR_CFG "Konfiguration" VALUE 0x70364 TKW_VV_VV_UB 100.0 FORMULA_0476 0.0 255.0 /end CHARACTERISTIC
/begin CHARACTERISTIC K_AR_FAK_KOMFORT "Wichtungsfaktor bei Komfort" VALUE 0x70396 TKW_VV_VV_UW 100.0 FORMULA_0073 0.0 4.0 FORMAT "%6.3" /end CHARACTERISTIC
/begin CHARACTERISTIC K_AR_FAK_SPORT "Wichtungsfaktor bei Sport" VALUE 0x70398 TKW_VV_VV_UW 100.0 FORMULA_0073 0.0 4.0 FORMAT "%6.3" /end CHARACTERISTIC
/begin CHARACTERISTIC K_AR_KORR_P_1 "P-Anteil zum Aufregeln auf n" VALUE 0x7037E TKW_VV_VV_UW 100.0 FORMULA_0477 0.0 8.0 FORMAT "%5.2" /end CHARACTERISTIC
/begin CHARACTERISTIC K_AR_KORR_P_2 "P-Anteil zum Aufregeln auf n" VALUE 0x70380 TKW_VV_VV_UW 100.0 FORMULA_0477 0.0 8.0 FORMAT "%5.2" /end CHARACTERISTIC
/begin CHARACTERISTIC K_AR_KORR_P_3 "P-Anteil zum Aufregeln auf n" VALUE 0x70382 TKW_VV_VV_UW 100.0 FORMULA_0477 0.0 8.0 FORMAT "%5.2" /end CHARACTERISTIC
/begin CHARACTERISTIC K_AR_KORR_P_4 "P-Anteil zum Aufregeln auf n" VALUE 0x70384 TKW_VV_VV_UW 100.0 FORMULA_0477 0.0 8.0 FORMAT "%5.2" /end CHARACTERISTIC
/begin CHARACTERISTIC K_AR_KORR_P_5 "P-Anteil zum Aufregeln auf n" VALUE 0x70386 TKW_VV_VV_UW 100.0 FORMULA_0477 0.0 8.0 FORMAT "%5.2" /end CHARACTERISTIC
/begin CHARACTERISTIC K_AR_KORR_P_6 "P-Anteil zum Aufregeln auf n" VALUE 0x70388 TKW_VV_VV_UW 100.0 FORMULA_0477 0.0 8.0 FORMAT "%5.2" /end CHARACTERISTIC
/begin CHARACTERISTIC K_AR_KORR_P_7 "P-Anteil zum Aufregeln auf n" VALUE 0x7038A TKW_VV_VV_UW 100.0 FORMULA_0477 0.0 8.0 FORMAT "%5.2" /end CHARACTERISTIC
/begin CHARACTERISTIC K_AR_KORR_P_N "P-Anteil zum Aufregeln auf n" VALUE 0x7037C TKW_VV_VV_UW 100.0 FORMULA_0477 0.0 8.0 FORMAT "%5.2" /end CHARACTERISTIC
/begin CHARACTERISTIC K_AR_KORR_P_R "P-Anteil zum Aufregeln auf n" VALUE 0x7037A TKW_VV_VV_UW 100.0 FORMULA_0477 0.0 8.0 FORMAT "%5.2" /end CHARACTERISTIC
/begin CHARACTERISTIC K_AR_MD_MAX "max. Momentenanforderung" VALUE 0x7039C TKW_VV_VV_SW 100.0 FORMULA_0009 -100.0 1000.0 FORMAT "%4.1" /end CHARACTERISTIC
/begin CHARACTERISTIC K_AR_MD_MIN "min. Momentenanforderung" VALUE 0x7039A TKW_VV_VV_SW 100.0 FORMULA_0009 -100.0 1000.0 FORMAT "%4.1" /end CHARACTERISTIC
/begin CHARACTERISTIC K_AR_N_DIF_BESCHL_1 "Schwelle fuer 1. BWelle" VALUE 0x7036E TKW_VV_VV_SW 100.0 FORMULA_0006 -10000.0 10000.0 /end CHARACTERISTIC
/begin CHARACTERISTIC K_AR_N_DIF_BESCHL_2 "Schwelle fuer 2. BWelle" VALUE 0x70370 TKW_VV_VV_SW 100.0 FORMULA_0006 -10000.0 10000.0 /end CHARACTERISTIC
/begin CHARACTERISTIC K_AR_N_DIF_REF_MAX "max. Differenz" VALUE 0x70378 TKW_VV_VV_SW 100.0 FORMULA_0006 -10000.0 10000.0 /end CHARACTERISTIC
/begin CHARACTERISTIC K_AR_N_DIF_REF_MIN "min. Differenz" VALUE 0x70376 TKW_VV_VV_SW 100.0 FORMULA_0006 -10000.0 10000.0 /end CHARACTERISTIC
/begin CHARACTERISTIC K_AR_N_DIF_VERZ_1 "Schwelle fuer 1. VWelle" VALUE 0x70372 TKW_VV_VV_SW 100.0 FORMULA_0006 -10000.0 10000.0 /end CHARACTERISTIC
/begin CHARACTERISTIC K_AR_N_DIF_VERZ_2 "Schwelle fuer 2. VWelle" VALUE 0x70374 TKW_VV_VV_SW 100.0 FORMULA_0006 -10000.0 10000.0 /end CHARACTERISTIC
/begin CHARACTERISTIC K_AR_N_FIL_0 "Filterkonstante" VALUE 0x7038C TKW_VV_VV_SW 100.0 FORMULA_0478 -2.999999932944775e-002 2.999999932944775e-002 FORMAT "%7.4" /end CHARACTERISTIC
/begin CHARACTERISTIC K_AR_N_FIL_1 "Filterkonstante" VALUE 0x7038E TKW_VV_VV_SW 100.0 FORMULA_0478 -2.999999932944775e-002 2.999999932944775e-002 FORMAT "%7.4" /end CHARACTERISTIC
/begin CHARACTERISTIC K_AR_N_FIL_2 "Filterkonstante" VALUE 0x70390 TKW_VV_VV_SW 100.0 FORMULA_0478 -2.999999932944775e-002 2.999999932944775e-002 FORMAT "%7.4" /end CHARACTERISTIC
/begin CHARACTERISTIC K_AR_N_FIL_3 "Filterkonstante" VALUE 0x70392 TKW_VV_VV_SW 100.0 FORMULA_0199 -2.0 1.990000009536743 FORMAT "%7.4" /end CHARACTERISTIC
/begin CHARACTERISTIC K_AR_N_FIL_4 "Filterkonstante" VALUE 0x70394 TKW_VV_VV_SW 100.0 FORMULA_0199 -2.0 1.990000009536743 FORMAT "%7.4" /end CHARACTERISTIC
/begin CHARACTERISTIC K_AR_N_MAX "max. Schwelle" VALUE 0x70368 TKW_VV_VV_SW 100.0 FORMULA_0006 0.0 10000.0 /end CHARACTERISTIC
/begin CHARACTERISTIC K_AR_N_MIN "min. Schwelle" VALUE 0x70366 TKW_VV_VV_SW 100.0 FORMULA_0006 0.0 10000.0 /end CHARACTERISTIC
/begin CHARACTERISTIC K_AR_T_MAX "max. AR-Eingriffszeit" VALUE 0x7036C TKW_VV_VV_UW 100.0 FORMULA_0109 0.0 325.0 FORMAT "%5.2" /end CHARACTERISTIC
/begin CHARACTERISTIC K_AR_T_PAS_DELAY "Delay nach Sperre" VALUE 0x7036A TKW_VV_VV_UW 100.0 FORMULA_0109 0.0 325.0 FORMAT "%5.2" /end CHARACTERISTIC
/begin CHARACTERISTIC K_AT_CFG "Schalter Konfiguration Anti-Trampel-Funktion" VALUE 0x70440 TKW_VV_VV_UB 100.0 FORMULA_0486 0.0 255.0 /end CHARACTERISTIC
/begin CHARACTERISTIC K_AT_FG_TP_N "Grenzfrequenz TP Motordrehzahl" VALUE 0x70448 TKW_VV_VV_UB 100.0 FORMULA_0487 0.0 255.0 /end CHARACTERISTIC
/begin CHARACTERISTIC K_AT_FG_TP_TRAMPIN "Grenzfrequenz TP Trampeln" VALUE 0x70449 TKW_VV_VV_UB 100.0 FORMULA_0487 0.0 255.0 /end CHARACTERISTIC
/begin CHARACTERISTIC K_AT_FG_TP_V "Grenzfrequenz TP Radgeschwindigkeit" VALUE 0x70447 TKW_VV_VV_UB 100.0 FORMULA_0487 0.0 255.0 /end CHARACTERISTIC
/begin CHARACTERISTIC K_AT_FG_TP_V_GRAD "Grenzfrequenz TP Radgeschwindigkeitsgradient" VALUE 0x7044A TKW_VV_VV_UB 100.0 FORMULA_0487 0.0 255.0 /end CHARACTERISTIC
/begin CHARACTERISTIC K_AT_MD_BEGR_A1 "Koeffizient a1, PID-Regler" VALUE 0x70458 TKW_VV_VV_SW 100.0 FORMULA_0488 -10.0 10.0 FORMAT "%5.2" /end CHARACTERISTIC
/begin CHARACTERISTIC K_AT_MD_GRAD_TAU_NEG "PT1 Filterkonstante für positive Gradienten" VALUE 0x7045B TKW_VV_VV_UB 100.0 FORMULA_0470 5.100000184029341e-003 1.279999971389771 /end CHARACTERISTIC
/begin CHARACTERISTIC K_AT_MD_GRAD_TAU_POS "PT1 Filterkonstante für positive Gradienten" VALUE 0x7045A TKW_VV_VV_UB 100.0 FORMULA_0470 5.100000184029341e-003 1.279999971389771 /end CHARACTERISTIC
/begin CHARACTERISTIC K_AT_N_MAX "Maximale Motordrehzahl fuer Anti-Trampeln Eingriff" VALUE 0x70444 TKW_VV_VV_SW 100.0 FORMULA_0006 0.0 10000.0 /end CHARACTERISTIC
/begin CHARACTERISTIC K_AT_N_MIN "Minimale Motordrehzahl fuer Anti-Trampeln Eingriff" VALUE 0x70442 TKW_VV_VV_SW 100.0 FORMULA_0006 0.0 10000.0 /end CHARACTERISTIC
/begin CHARACTERISTIC K_AT_SK_MAX "Maximales Notprogramm fuer Anti-Trampeln Eingriff" VALUE 0x70446 TKW_VV_VV_UB 100.0 FORMULA_0003 0.0 255.0 /end CHARACTERISTIC
/begin CHARACTERISTIC K_AT_TRAMPIN_SOLL_SCHUB "Schwelle Schubabschaltung AT Eingriff" VALUE 0x70456 TKW_VV_VV_SW 100.0 FORMULA_0483 -80.0 360.0 FORMAT "%4.1" /end CHARACTERISTIC
/begin CHARACTERISTIC K_AT_TRAMPIN_SOLL_START "Startschwelle AT Eingriff" VALUE 0x70452 TKW_VV_VV_SW 100.0 FORMULA_0483 -80.0 360.0 FORMAT "%4.1" /end CHARACTERISTIC
/begin CHARACTERISTIC K_AT_TRAMPIN_SOLL_STOP "Startschwelle AT Eingriff" VALUE 0x70454 TKW_VV_VV_SW 100.0 FORMULA_0483 -80.0 360.0 FORMAT "%4.1" /end CHARACTERISTIC
/begin CHARACTERISTIC K_AT_V_GRAD_DOWN_TAU "Zeitkonstante negativer Radgeschwindigkeitsgradient" VALUE 0x7044C TKW_VV_VV_UB 100.0 FORMULA_0470 5.100000184029341e-003 1.279999971389771 /end CHARACTERISTIC
/begin CHARACTERISTIC K_AT_V_GRAD_INT_TAU "Zeitkonstante negativer Radgeschwindigkeitsgradient" VALUE 0x70450 TKW_VV_VV_UB 100.0 FORMULA_0470 5.100000184029341e-003 1.279999971389771 /end CHARACTERISTIC
/begin CHARACTERISTIC K_AT_V_GRAD_INT_TGL "Gradientenumschaltung 80ms / 100ms Periode" VALUE 0x7044E TKW_VV_VV_SW 100.0 FORMULA_0076 -80.0 360.0 FORMAT "%4.1" /end CHARACTERISTIC
/begin CHARACTERISTIC K_AT_V_GRAD_UP_TAU "Zeitkonstante positiver Radgeschwindigkeitsgradient" VALUE 0x7044B TKW_VV_VV_UB 100.0 FORMULA_0470 5.100000184029341e-003 1.279999971389771 /end CHARACTERISTIC
/begin CHARACTERISTIC K_TABG_C "Mittlere spezifische Waermekapazitaet" VALUE 0x79EF2 TKW_VV_VV_UW 100.0 FORMULA_0971 1.0 65535.0 /end CHARACTERISTIC
/begin CHARACTERISTIC K_TABG_DIAG_MAX "Obere Grenze Abgastemperatur" VALUE 0x79EE4 TKW_VV_VV_SW 100.0 FORMULA_0342 -50.0 1250.0 FORMAT "%5.2" /end CHARACTERISTIC
/begin CHARACTERISTIC K_TABG_DIAG_MIN "Unter Grenze Abgastemperatur" VALUE 0x79EE2 TKW_VV_VV_SW 100.0 FORMULA_0342 -50.0 1250.0 FORMAT "%5.2" /end CHARACTERISTIC
/begin CHARACTERISTIC K_TABG_DIAG_PLAUSI_AKTIV_T_ML "Plausi-Diag-Sperrzeit nach Motorstart" VALUE 0x79EEA TKW_VV_VV_UW 100.0 FORMULA_0021 0.0 655.0 FORMAT "%5.2" /end CHARACTERISTIC
/begin CHARACTERISTIC K_TABG_DIAG_PLAUSI_DELTA_NEG "Maximale negative Abweichung" VALUE 0x79EE6 TKW_VV_VV_SW 100.0 FORMULA_0970 -1000.0 0.0 FORMAT "%5.2" /end CHARACTERISTIC
/begin CHARACTERISTIC K_TABG_DIAG_PLAUSI_DELTA_POS "Maximale positive Abweichung" VALUE 0x79EE8 TKW_VV_VV_SW 100.0 FORMULA_0970 0.0 1000.0 FORMAT "%5.2" /end CHARACTERISTIC
/begin CHARACTERISTIC K_TABG_DIAG_TIME "Sperrzeit fuer Plausifehler" VALUE 0x79EEC TKW_VV_VV_UW 100.0 FORMULA_0071 0.0 6553.5 FORMAT "%4.1" /end CHARACTERISTIC
/begin CHARACTERISTIC K_TABG_KAT_EXO_HYS "Hysterese fuer Enthalpie" VALUE 0x79F06 TKW_VV_VV_SW 100.0 FORMULA_0074 -1000.0 1000.0 FORMAT "%4.1" /end CHARACTERISTIC
/begin CHARACTERISTIC K_TABG_KAT_EXO_MS_SCHWELLE "Gespeicherte Sauerstoffmasse im KAT" VALUE 0x79F0A TKW_VV_VV_SW 100.0 FORMULA_0090 -3276.800048828125 3276.699951171875 FORMAT "%5.2" /end CHARACTERISTIC
/begin CHARACTERISTIC K_TABG_KAT_EXO_ON "Startwert fuer Enthalpie" VALUE 0x79F08 TKW_VV_VV_SW 100.0 FORMULA_0023 -50.0 1250.0 FORMAT "%4.1" /end CHARACTERISTIC
/begin CHARACTERISTIC K_TABG_KAT_MC "Waermekapazitaet des Katalysatoranfangs" VALUE 0x79EF8 TKW_VV_VV_UW 100.0 FORMULA_0972 1.0 65535.0 /end CHARACTERISTIC
/begin CHARACTERISTIC K_TABG_KAT_T_OFFS_AB "Abregelrampe Enthalpie" VALUE 0x79F04 TKW_VV_VV_SW 100.0 FORMULA_0974 0.0 3276.699951171875 FORMAT "%4.1" /end CHARACTERISTIC
/begin CHARACTERISTIC K_TABG_KAT_T_OFFS_AUF "Aufregelrampe Enthalpie" VALUE 0x79F02 TKW_VV_VV_SW 100.0 FORMULA_0974 0.0 3276.699951171875 FORMAT "%4.1" /end CHARACTERISTIC
/begin CHARACTERISTIC K_TABG_LW_AUSBLEND_OFFS "Temperaturoffset ausgeblendeter Zylinder" VALUE 0x79EFC TKW_VV_VV_SW 100.0 FORMULA_0074 -1000.0 1000.0 FORMAT "%4.1" /end CHARACTERISTIC
/begin CHARACTERISTIC K_TABG_NKAT_A "Katflaeche" VALUE 0x79F00 TKW_VV_VV_UW 100.0 FORMULA_0973 0.0 6.553500175476074 FORMAT "%7.4" /end CHARACTERISTIC
/begin CHARACTERISTIC K_TABG_NKAT_CFG "Schalter welche Nachkattemperatur" VALUE 0x79ED8 TKW_VV_VV_UB 100.0 FORMULA_0966 0.0 255.0 /end CHARACTERISTIC
/begin CHARACTERISTIC K_TABG_NKAT_K_TUMG "Waermeuebergangskoeffizient" VALUE 0x79EDC TKW_VV_VV_UW 100.0 FORMULA_0968 0.0 65.53500366210938 FORMAT "%7.4" /end CHARACTERISTIC
/begin CHARACTERISTIC K_TABG_NKAT_K_V "Geschwindikeitsabhaengiger Waermeuebergangskoeffizient" VALUE 0x79EE0 TKW_VV_VV_UW 100.0 FORMULA_0969 0.0 6.553500175476074 FORMAT "%7.4" /end CHARACTERISTIC
/begin CHARACTERISTIC K_TABG_NKAT_MAX_CFG "Schalter welche Nachkattemperatur abgespeichert wird" VALUE 0x79ED9 TKW_VV_VV_UB 100.0 FORMULA_0967 0.0 255.0 /end CHARACTERISTIC
/begin CHARACTERISTIC K_TABG_NKAT_MC "Waermekapazitaet des Katalysatorendes" VALUE 0x79EFA TKW_VV_VV_UW 100.0 FORMULA_0972 1.0 65535.0 /end CHARACTERISTIC
/begin CHARACTERISTIC K_TABG_PST_V "Ersatzgeschwindigkeit am Pruefstand" VALUE 0x79EDA TKW_VV_VV_SW 100.0 FORMULA_0076 -80.0 360.0 FORMAT "%4.1" /end CHARACTERISTIC
/begin CHARACTERISTIC K_TABG_STAND_MAX "Maximale Abstellabgastemperatur" VALUE 0x79EEE TKW_VV_VV_SW 100.0 FORMULA_0074 -1000.0 1250.0 FORMAT "%4.1" /end CHARACTERISTIC
/begin CHARACTERISTIC K_TABG_TAU "Filterkonstante fuer die Abgastemperaturerfassung" VALUE 0x79EF0 TKW_VV_VV_UB 100.0 FORMULA_0746 0.1004000008106232 25.60000038146973 /end CHARACTERISTIC
/begin CHARACTERISTIC K_TABG_VKAT_A "Kruemmerflaeche" VALUE 0x79EFE TKW_VV_VV_UW 100.0 FORMULA_0973 0.0 6.553500175476074 FORMAT "%7.4" /end CHARACTERISTIC
/begin CHARACTERISTIC K_TABG_VKAT_K_V "Geschwindikeitsabhaengiger Waermeuebergangskoeffizient" VALUE 0x79EDE TKW_VV_VV_UW 100.0 FORMULA_0969 0.0 6.553500175476074 FORMAT "%7.4" /end CHARACTERISTIC
/begin CHARACTERISTIC K_TABG_VKAT_MC "Waermekapazitaet vor Kat" VALUE 0x79EF4 TKW_VV_VV_UW 100.0 FORMULA_0972 1.0 65535.0 /end CHARACTERISTIC
/begin CHARACTERISTIC K_TABG_VKAT_REAK_SCHWELLE "Aktivierungsschwelle Kruemmerreaktion" VALUE 0x79EF6 TKW_VV_VV_SW 100.0 FORMULA_0023 -50.0 1250.0 FORMAT "%4.1" /end CHARACTERISTIC
/begin CHARACTERISTIC K_TAN_AEBEGR "Aenderungsbegrenzung fuer tan_filter" VALUE 0x7A124 TKW_VV_VV_UW 100.0 FORMULA_0981 0.0 25.0 FORMAT "%5.2" /end CHARACTERISTIC
/begin CHARACTERISTIC K_TAN_DIAG_MAX "Obere Grenze Ansauglufttemperatur" VALUE 0x7A120 TKW_VV_VV_SW 100.0 FORMULA_0975 -50.0 170.0 FORMAT "%6.3" /end CHARACTERISTIC
/begin CHARACTERISTIC K_TAN_DIAG_MIN "Unter Grenze Ansauglufttemperatur" VALUE 0x7A11E TKW_VV_VV_SW 100.0 FORMULA_0975 -50.0 170.0 FORMAT "%6.3" /end CHARACTERISTIC
/begin CHARACTERISTIC K_TAN_ERSATZ "Ersatzwert fuer die Ansauglufttemperatur" VALUE 0x7A122 TKW_VV_VV_SW 100.0 FORMULA_0975 -50.0 170.0 FORMAT "%6.3" /end CHARACTERISTIC
/begin CHARACTERISTIC K_TAN_MAX_E2 "max. Ansauglufttemperatur" VALUE 0x7B4EE TKW_VV_VV_SW 100.0 FORMULA_0023 -50.0 170.0 FORMAT "%4.1" /end CHARACTERISTIC
/begin CHARACTERISTIC K_TAN_MAX_NEG_GRAD_E2 "Gradientenschwelle Ebene 2" VALUE 0x7B4F0 TKW_VV_VV_SW 100.0 FORMULA_0985 -32768.0 0.0 /end CHARACTERISTIC
/begin CHARACTERISTIC K_TAN_MAX_POS_GRAD_E2 "Gradientenschwelle Ebene 2" VALUE 0x7B4F2 TKW_VV_VV_SW 100.0 FORMULA_0985 0.0 32767.0 /end CHARACTERISTIC
/begin CHARACTERISTIC K_TAN_MIN_E2 "min. Ansauglufttemperatur" VALUE 0x7B4EC TKW_VV_VV_SW 100.0 FORMULA_0023 -50.0 170.0 FORMAT "%4.1" /end CHARACTERISTIC
/begin CHARACTERISTIC K_TAN_MODELL_ALLOW_NO_TUMG "Fehler Umgebungstemperatur zulassen" VALUE 0x7A12F TKW_VV_VV_UB 100.0 FORMULA_0983 0.0 255.0 /end CHARACTERISTIC
/begin CHARACTERISTIC K_TAN_MODELL_MR_TAU "Filterkonstante fuer Motorraumtemperatur" VALUE 0x7A12C TKW_VV_VV_UW 100.0 FORMULA_0681 0.1000000014901161 6553.5 FORMAT "%5.2" /end CHARACTERISTIC
/begin CHARACTERISTIC K_TAN_MW_ABGR_NEG "neg. Aenderungsbegr. Ansauglufttemperatur pro 100ms" VALUE 0x7A126 TKW_VV_VV_UW 100.0 FORMULA_0023 0.0 100.0 FORMAT "%4.1" /end CHARACTERISTIC
/begin CHARACTERISTIC K_TAN_MW_ABGR_POS "pos. Aenderungsbegr. Ansauglufttemperatur pro 100ms" VALUE 0x7A128 TKW_VV_VV_UW 100.0 FORMULA_0023 0.0 100.0 FORMAT "%4.1" /end CHARACTERISTIC
/begin CHARACTERISTIC K_TAN_OBD_ALWAYS "Bedingungen ignorieren" VALUE 0x7A130 TKW_VV_VV_UB 100.0 FORMULA_0984 0.0 255.0 /end CHARACTERISTIC
/begin CHARACTERISTIC K_TAN_OBD_CFG "Plausibilisierung Ansauglufttemperatur" VALUE 0x7A12E TKW_VV_VV_UB 100.0 FORMULA_0982 0.0 255.0 /end CHARACTERISTIC
/begin CHARACTERISTIC K_TAN_OBD_DELTA_MAX "Maximale Temperaturdifferenz der beiden HFM" VALUE 0x7A132 TKW_VV_VV_SW 100.0 FORMULA_0074 -1000.0 1000.0 FORMAT "%4.1" /end CHARACTERISTIC
/begin CHARACTERISTIC K_TAN_OBD_DYN_DELAY "Zeitfenster für Delay nach Dynamik" VALUE 0x7A138 TKW_VV_VV_UW 100.0 FORMULA_0980 0.0 6553.5 FORMAT "%5.2" /end CHARACTERISTIC
/begin CHARACTERISTIC K_TAN_OBD_N_DYN_MAX "Maximale Drehzahldynamik" VALUE 0x7A140 TKW_VV_VV_SW 100.0 FORMULA_0105 -10000.0 10000.0 /end CHARACTERISTIC
/begin CHARACTERISTIC K_TAN_OBD_N_DYN_TAU "Filterkonstante für Drehzahldynamik" VALUE 0x7A12B TKW_VV_VV_UB 100.0 FORMULA_0746 0.1004000008106232 25.60000038146973 /end CHARACTERISTIC
/begin CHARACTERISTIC K_TAN_OBD_N_MAX "Mindestdrehzahl" VALUE 0x7A13E TKW_VV_VV_SW 100.0 FORMULA_0006 0.0 10000.0 /end CHARACTERISTIC
/begin CHARACTERISTIC K_TAN_OBD_N_MIN "Mindestdrehzahl" VALUE 0x7A13C TKW_VV_VV_SW 100.0 FORMULA_0006 0.0 10000.0 /end CHARACTERISTIC
/begin CHARACTERISTIC K_TAN_OBD_RF_DYN_MAX "Maximale Dynamik relative Füllung" VALUE 0x7A148 TKW_VV_VV_SW 100.0 FORMULA_0007 0.0 2.0 FORMAT "%6.3" /end CHARACTERISTIC
/begin CHARACTERISTIC K_TAN_OBD_RF_MAX "Obergrenze relative Füllung" VALUE 0x7A146 TKW_VV_VV_SW 100.0 FORMULA_0007 0.0 2.0 FORMAT "%6.3" /end CHARACTERISTIC
/begin CHARACTERISTIC K_TAN_OBD_RF_MIN "Untergrenze relative Füllung" VALUE 0x7A144 TKW_VV_VV_SW 100.0 FORMULA_0007 0.0 2.0 FORMAT "%6.3" /end CHARACTERISTIC
/begin CHARACTERISTIC K_TAN_OBD_T_DELTA "Zeitfenster für Temperaturabweichung" VALUE 0x7A134 TKW_VV_VV_UW 100.0 FORMULA_0980 0.0 6553.5 FORMAT "%5.2" /end CHARACTERISTIC
/begin CHARACTERISTIC K_TAN_OBD_TMOT_MIN "Untergrenze Motortemperatur" VALUE 0x7A142 TKW_VV_VV_SW 100.0 FORMULA_0023 -50.0 170.0 FORMAT "%4.1" /end CHARACTERISTIC
/begin CHARACTERISTIC K_TAN_OBD_V_MIN "Mindestgeschwindigkeit" VALUE 0x7A13A TKW_VV_VV_SW 100.0 FORMULA_0076 -80.0 360.0 FORMAT "%4.1" /end CHARACTERISTIC
/begin CHARACTERISTIC K_TAN_OBD_V_T_MIN "Zeitfenster für Mindestgeschwindigkeit" VALUE 0x7A136 TKW_VV_VV_UW 100.0 FORMULA_0980 0.0 6553.5 FORMAT "%5.2" /end CHARACTERISTIC
/begin CHARACTERISTIC K_TAN_TAU "Filterkonstante fuer die Ansauglufttemperaturerfassung" VALUE 0x7A12A TKW_VV_VV_UB 100.0 FORMULA_0746 0.1004000008106232 25.60000038146973 /end CHARACTERISTIC
/begin CHARACTERISTIC KF_AR_MD_FAKTOR "P-Regler" MAP 0x7039E TKF_SW_SW_SW 100.0 FORMULA_0477 -2.0 2.0 FORMAT "%5.2" /begin AXIS_DESCR STD_AXIS n FORMULA_0006 8 0.0 10000.0 MAX_GRAD 0.0 /end AXIS_DESCR /begin AXIS_DESCR STD_AXIS gang FORMULA_0479 8 -1.0 10.0 MAX_GRAD 0.0 /end AXIS_DESCR /end CHARACTERISTIC
/begin CHARACTERISTIC KF_AT_MD_BEGR_KR "Regelparameter KR" MAP 0x705F8 TKF_SW_SW_SW 100.0 FORMULA_0489 0.0 20.0 FORMAT "%5.2" /begin AXIS_DESCR STD_AXIS Gang FORMULA_0479 6 -1.0 10.0 MAX_GRAD 0.0 /end AXIS_DESCR
 /begin AXIS_DESCR STD_AXIS Wunschmoment FORMULA_0009 6 -100.0 1000.0 MAX_GRAD 0.0 FORMAT "%4.1" /end AXIS_DESCR
/end CHARACTERISTIC
/begin CHARACTERISTIC KF_AT_MD_BEGR_TN "Regelparameter TN" MAP 0x7065A TKF_SW_SW_SW 100.0 FORMULA_0490 3.000000026077032e-003 30.0 FORMAT "%6.3" /begin AXIS_DESCR STD_AXIS Gang FORMULA_0479 6 -1.0 10.0 MAX_GRAD 0.0 /end AXIS_DESCR
 /begin AXIS_DESCR STD_AXIS Wunschmoment FORMULA_0009 6 -100.0 1000.0 MAX_GRAD 0.0 FORMAT "%4.1" /end AXIS_DESCR
/end CHARACTERISTIC
/begin CHARACTERISTIC KF_AT_MD_BEGR_TV "Regelparameter TV" MAP 0x706BC TKF_SW_SW_SW 100.0 FORMULA_0490 0.0 20.0 FORMAT "%6.3" /begin AXIS_DESCR STD_AXIS Gang FORMULA_0479 6 -1.0 10.0 MAX_GRAD 0.0 /end AXIS_DESCR
 /begin AXIS_DESCR STD_AXIS Wunschmoment FORMULA_0009 6 -100.0 1000.0 MAX_GRAD 0.0 FORMAT "%4.1" /end AXIS_DESCR
/end CHARACTERISTIC
/begin CHARACTERISTIC KF_TABG_LW_STAT "Stationaere Abgastemperatur nach Ladungswechsel" MAP 0x7A07C TKF_SW_SW_SW 100.0 FORMULA_0023 -50.0 1250.0 FORMAT "%4.1" /begin AXIS_DESCR STD_AXIS n FORMULA_0006 8 0.0 10000.0 MAX_GRAD 0.0 /end AXIS_DESCR
 /begin AXIS_DESCR STD_AXIS rf FORMULA_0007 8 0.0 2.0 MAX_GRAD 0.0 FORMAT "%6.3" /end AXIS_DESCR
/end CHARACTERISTIC
/begin CHARACTERISTIC KL_AT_MD_BEGR_KR_FAK "Faktor auf KR" CURVE 0x705B6 TKL_SW_VV_UW 100.0 FORMULA_0073 0.0 20.0 FORMAT "%6.3"
 /begin AXIS_DESCR STD_AXIS Regelabweichung FORMULA_0483 5 -360.0 360.0 MAX_GRAD 0.0 FORMAT "%4.1" /end AXIS_DESCR
/end CHARACTERISTIC
/begin CHARACTERISTIC KL_AT_MD_BEGR_TN_FAK "Faktor auf TN" CURVE 0x705CC TKL_SW_VV_UW 100.0 FORMULA_0073 0.0 20.0 FORMAT "%6.3"
 /begin AXIS_DESCR STD_AXIS Regelabweichung FORMULA_0483 5 -360.0 360.0 MAX_GRAD 0.0 FORMAT "%4.1" /end AXIS_DESCR
/end CHARACTERISTIC
/begin CHARACTERISTIC KL_AT_MD_BEGR_TV_FAK "Faktor auf TV" CURVE 0x705E2 TKL_SW_VV_UW 100.0 FORMULA_0073 0.0 20.0 FORMAT "%6.3"
 /begin AXIS_DESCR STD_AXIS Regelabweichung FORMULA_0483 5 -360.0 360.0 MAX_GRAD 0.0 FORMAT "%4.1" /end AXIS_DESCR
/end CHARACTERISTIC
/begin CHARACTERISTIC KL_AT_MD_KUPP_MIN "minimales Moment durch AT Begrenzung" CURVE 0x70582 TKL_SW_VV_SW 100.0 FORMULA_0009 -100.0 1000.0 FORMAT "%4.1"
 /begin AXIS_DESCR STD_AXIS Fahrerwunsch FORMULA_0009 4 -100.0 1000.0 MAX_GRAD 0.0 FORMAT "%4.1" /end AXIS_DESCR
/end CHARACTERISTIC
/begin CHARACTERISTIC KL_AT_N_FAK "Drehzahlwichtung" CURVE 0x7051A TKL_SW_VV_SW 100.0 FORMULA_0073 -2.0 2.0 FORMAT "%6.3"
 /begin AXIS_DESCR STD_AXIS Trampeln_n FORMULA_0006 6 0.0 10000.0 MAX_GRAD 0.0 /end AXIS_DESCR
/end CHARACTERISTIC
/begin CHARACTERISTIC KL_AT_SCHLUPF_FAK "Schlupfwichtung" CURVE 0x70534 TKL_SW_VV_SW 100.0 FORMULA_0073 -2.0 2.0 FORMAT "%6.3"
 /begin AXIS_DESCR STD_AXIS Schlupf FORMULA_0484 6 -300.0 300.0 MAX_GRAD 0.0 FORMAT "%4.1" /end AXIS_DESCR
/end CHARACTERISTIC
/begin CHARACTERISTIC KL_AT_TRAMPIN_SCHUB "Momenteneingriff bei Schubtrampeln" CURVE 0x70594 TKL_SW_VV_SW 100.0 FORMULA_0009 -100.0 1000.0 FORMAT "%4.1"
 /begin AXIS_DESCR STD_AXIS Trampelintensitaet FORMULA_0483 8 -80.0 360.0 MAX_GRAD 0.0 FORMAT "%4.1" /end AXIS_DESCR
/end CHARACTERISTIC
/begin CHARACTERISTIC KL_AT_V_GRAD_FAK "Wichtung Radgeschwindigkeitsgradient" CURVE 0x7054E TKL_SW_VV_SW 100.0 FORMULA_0073 -2.0 2.0 FORMAT "%6.3"
 /begin AXIS_DESCR STD_AXIS Gradient FORMULA_0076 6 -80.0 360.0 MAX_GRAD 0.0 FORMAT "%4.1" /end AXIS_DESCR
/end CHARACTERISTIC
/begin CHARACTERISTIC KL_AT_V_GRAD_INT_FAK "Wichtung Gradientensumme HL und HR" CURVE 0x70568 TKL_SW_VV_SW 100.0 FORMULA_0073 -2.0 2.0 FORMAT "%6.3"
 /begin AXIS_DESCR STD_AXIS Gradient FORMULA_0076 6 -80.0 360.0 MAX_GRAD 0.0 FORMAT "%4.1" /end AXIS_DESCR
/end CHARACTERISTIC
/begin CHARACTERISTIC KL_AT_V_TP_A2 "Filterkoeffizient A2" CURVE 0x7045C TKL_UB_VV_SW 100.0 FORMULA_0482 -4.0 3.999799966812134 FORMAT "%7.4"
 /begin AXIS_DESCR STD_AXIS Grenzfrequenz FORMULA_0487 12 0.0 255.0 MAX_GRAD 0.0 /end AXIS_DESCR
/end CHARACTERISTIC
/begin CHARACTERISTIC KL_AT_V_TP_A3 "Filterkoeffizient A3" CURVE 0x70482 TKL_UB_VV_SW 100.0 FORMULA_0482 -4.0 3.999799966812134 FORMAT "%7.4"
 /begin AXIS_DESCR STD_AXIS Grenzfrequenz FORMULA_0487 12 0.0 255.0 MAX_GRAD 0.0 /end AXIS_DESCR
/end CHARACTERISTIC
/begin CHARACTERISTIC KL_AT_V_TP_B1 "Filterkoeffizient B1" CURVE 0x704A8 TKL_UB_VV_SW 100.0 FORMULA_0482 -4.0 3.999799966812134 FORMAT "%7.4"
 /begin AXIS_DESCR STD_AXIS Grenzfrequenz FORMULA_0487 12 0.0 255.0 MAX_GRAD 0.0 /end AXIS_DESCR
/end CHARACTERISTIC
/begin CHARACTERISTIC KL_AT_V_TP_B2 "Filterkoeffizient B2" CURVE 0x704CE TKL_UB_VV_SW 100.0 FORMULA_0482 -4.0 3.999799966812134 FORMAT "%7.4"
 /begin AXIS_DESCR STD_AXIS Grenzfrequenz FORMULA_0487 12 0.0 255.0 MAX_GRAD 0.0 /end AXIS_DESCR
/end CHARACTERISTIC
/begin CHARACTERISTIC KL_AT_V_TP_B3 "Filterkoeffizient B3" CURVE 0x704F4 TKL_UB_VV_SW 100.0 FORMULA_0482 -4.0 3.999799966812134 FORMAT "%7.4"
 /begin AXIS_DESCR STD_AXIS Grenzfrequenz FORMULA_0487 12 0.0 255.0 MAX_GRAD 0.0 /end AXIS_DESCR
/end CHARACTERISTIC
/begin CHARACTERISTIC KL_TABG_DIAG_PLAUSI_ML_FAK "Gewichtungsfaktor bei der Diagnose" CURVE 0x7A06A TKL_SW_VV_UW 100.0 FORMULA_0073 0.0 4.0 FORMAT "%6.3"
 /begin AXIS_DESCR STD_AXIS tabg_ml_ges FORMULA_0103 4 -100.0 1400.0 MAX_GRAD 0.0 FORMAT "%4.1" /end AXIS_DESCR
/end CHARACTERISTIC
/begin CHARACTERISTIC KL_TABG_KAT_EXO_MAX "Maximale Enthalpie" CURVE 0x7A058 TKL_UW_VV_SW 100.0 FORMULA_0961 0.0 327.6700134277344 FORMAT "%5.2"
 /begin AXIS_DESCR STD_AXIS lam_ist_mw FORMULA_0025 4 0.0 3.999000072479248 MAX_GRAD 0.0 FORMAT "%6.3" /end AXIS_DESCR
/end CHARACTERISTIC
/begin CHARACTERISTIC KL_TABG_KAT_STAND_F "Faktor Standzeit" CURVE 0x79FE0 TKL_UW_VV_UW 100.0 FORMULA_0073 0.0 4.0 FORMAT "%6.3"
 /begin AXIS_DESCR STD_AXIS time_ms FORMULA_0706 8 0.0 1092.25 MAX_GRAD 0.0 FORMAT "%5.2" /end AXIS_DESCR
/end CHARACTERISTIC
/begin CHARACTERISTIC KL_TABG_LW_F_ETA_ZW "Gewichtungsfaktor Zuendwinkel" CURVE 0x79F74 TKL_UW_VV_UW 100.0 FORMULA_0073 0.0 4.0 FORMAT "%6.3"
 /begin AXIS_DESCR STD_AXIS md_eta_zw_ne FORMULA_0437 6 0.0 150.0 MAX_GRAD 0.0 FORMAT "%4.1" /end AXIS_DESCR
/end CHARACTERISTIC
/begin CHARACTERISTIC KL_TABG_LW_F_LAM "Gewichtungsfaktor Lambda" CURVE 0x79F8E TKL_UW_VV_UW 100.0 FORMULA_0073 0.0 4.0 FORMAT "%6.3"
 /begin AXIS_DESCR STD_AXIS lam_ist_mw FORMULA_0025 4 0.0 3.999000072479248 MAX_GRAD 0.0 FORMAT "%6.3" /end AXIS_DESCR
/end CHARACTERISTIC
/begin CHARACTERISTIC KL_TABG_LW_F_RG "Gewichtungsfaktor Restgas" CURVE 0x79F56 TKL_SW_VV_UW 100.0 FORMULA_0073 0.0 4.0 FORMAT "%6.3"
 /begin AXIS_DESCR STD_AXIS rg_x_delta FORMULA_0100 7 -0.5 0.5 MAX_GRAD 0.0 FORMAT "%5.2" /end AXIS_DESCR
/end CHARACTERISTIC
/begin CHARACTERISTIC KL_TABG_LW_STAND_F "Faktor Standzeit" CURVE 0x7A002 TKL_UW_VV_UW 100.0 FORMULA_0073 0.0 4.0 FORMAT "%6.3"
 /begin AXIS_DESCR STD_AXIS time_ms FORMULA_0706 4 0.0 1092.25 MAX_GRAD 0.0 FORMAT "%5.2" /end AXIS_DESCR
/end CHARACTERISTIC
/begin CHARACTERISTIC KL_TABG_LW_TAU "Filterzeitkonstante" CURVE 0x7A014 TKL_SW_VV_UB 100.0 FORMULA_0746 0.1004000008106232 25.60000038146973
 /begin AXIS_DESCR STD_AXIS tabg_lw_ml_ges FORMULA_0103 4 -100.0 1400.0 MAX_GRAD 0.0 FORMAT "%4.1" /end AXIS_DESCR
/end CHARACTERISTIC
/begin CHARACTERISTIC KL_TABG_LW_VERH_WURZEL "Verhaeltnis der Ladungswechseltemperaturen" CURVE 0x79FA0 TKL_UW_VV_UW 100.0 FORMULA_0073 0.0 4.0 FORMAT "%6.3"
 /begin AXIS_DESCR STD_AXIS tabg_lw_verh FORMULA_0073 7 0.0 4.0 MAX_GRAD 0.0 FORMAT "%6.3" /end AXIS_DESCR
/end CHARACTERISTIC
/begin CHARACTERISTIC KL_TABG_PT200 "Kennlinie Abgastemperatur" CURVE 0x79F0C TKL_SW_VV_SW 100.0 FORMULA_0342 -50.0 1250.0 FORMAT "%5.2" /begin AXIS_DESCR STD_AXIS tabg_ad FORMULA_0114 18 0.0 1023.0 MAX_GRAD 0.0 /end AXIS_DESCR /end CHARACTERISTIC
/begin CHARACTERISTIC KL_TABG_VKAT_F_REAK "Reaktion im Kruemmer" CURVE 0x7A046 TKL_UW_VV_UW 100.0 FORMULA_0073 0.0 4.0 FORMAT "%6.3"
 /begin AXIS_DESCR STD_AXIS lam_ist_mw FORMULA_0025 4 0.0 3.999000072479248 MAX_GRAD 0.0 FORMAT "%6.3" /end AXIS_DESCR
/end CHARACTERISTIC
/begin CHARACTERISTIC KL_TABG_VKAT_K_TMOT "Waermeuebergangskoeffizient" CURVE 0x7A022 TKL_SW_VV_UW 100.0 FORMULA_0968 0.0 65.53500366210938 FORMAT "%7.4"
 /begin AXIS_DESCR STD_AXIS tabg_lw_ml_ges FORMULA_0103 4 -100.0 1400.0 MAX_GRAD 0.0 FORMAT "%4.1" /end AXIS_DESCR
/end CHARACTERISTIC
/begin CHARACTERISTIC KL_TABG_VKAT_MC_F_TMOT "Waermekapazitaet vor Kat beim Start" CURVE 0x7A034 TKL_SW_VV_UW 100.0 FORMULA_0073 0.0 63.99900054931641 FORMAT "%6.3"
 /begin AXIS_DESCR STD_AXIS tmot FORMULA_0023 4 -50.0 170.0 MAX_GRAD 0.0 FORMAT "%4.1" /end AXIS_DESCR
/end CHARACTERISTIC
/begin CHARACTERISTIC KL_TABG_VKAT_STAND_F "Faktor Standzeit" CURVE 0x79FBE TKL_UW_VV_UW 100.0 FORMULA_0073 0.0 4.0 FORMAT "%6.3"
 /begin AXIS_DESCR STD_AXIS time_ms FORMULA_0706 8 0.0 1092.25 MAX_GRAD 0.0 FORMAT "%5.2" /end AXIS_DESCR
/end CHARACTERISTIC
/begin CHARACTERISTIC KL_TAN_MODELL_ABREG "Kennlinie Temperaturabregung/Zeit" CURVE 0x7A1B0 TKL_UW_VV_UW 100.0 FORMULA_0199 0.0 2.0 FORMAT "%7.4"
 /begin AXIS_DESCR STD_AXIS time_ms FORMULA_0706 6 0.0 1092.25 MAX_GRAD 0.0 FORMAT "%5.2" /end AXIS_DESCR
/end CHARACTERISTIC
/begin CHARACTERISTIC KL_TAN_MODELL_ML_RATIO "Kennlinie Ansaugluftmasse zu tau" CURVE 0x7A196 TKL_SW_VV_UW 100.0 FORMULA_0199 0.0 2.0 FORMAT "%7.4"
 /begin AXIS_DESCR STD_AXIS ml_b1 FORMULA_0103 6 -100.0 1400.0 MAX_GRAD 0.0 FORMAT "%4.1" /end AXIS_DESCR
/end CHARACTERISTIC
/begin CHARACTERISTIC KL_TAN_MODELL_ML_TAU "Kennlinie Ansaugluftmasse zu tau" CURVE 0x7A17C TKL_SW_VV_UW 100.0 FORMULA_0681 0.1000000014901161 6553.5 FORMAT "%5.2"
 /begin AXIS_DESCR STD_AXIS ml_b1 FORMULA_0103 6 -100.0 1400.0 MAX_GRAD 0.0 FORMAT "%4.1" /end AXIS_DESCR
/end CHARACTERISTIC
/begin CHARACTERISTIC KL_TAN_MODELL_MR_ABREG "Kennlinie Temperaturabregung/Zeit" CURVE 0x7A1CA TKL_UW_VV_UW 100.0 FORMULA_0199 0.0 2.0 FORMAT "%7.4"
 /begin AXIS_DESCR STD_AXIS time_ms FORMULA_0706 6 0.0 1092.25 MAX_GRAD 0.0 FORMAT "%5.2" /end AXIS_DESCR
/end CHARACTERISTIC
/begin CHARACTERISTIC KL_TAN_MODELL_MR_TUMG_KAL "Kalibrierung Motorraumtemp mit TUMG" CURVE 0x7A1E4 TKL_SW_VV_SW 100.0 FORMULA_0074 -1000.0 1000.0 FORMAT "%4.1"
 /begin AXIS_DESCR STD_AXIS tumg FORMULA_0023 6 -50.0 170.0 MAX_GRAD 0.0 FORMAT "%4.1" /end AXIS_DESCR
/end CHARACTERISTIC
/begin CHARACTERISTIC KL_TAN_NTC "Kennlinie Ansauglufttemperatur" CURVE 0x7A14A TKL_SW_VV_SW 100.0 FORMULA_0975 -50.0 170.0 FORMAT "%6.3" /begin AXIS_DESCR STD_AXIS tan_ad FORMULA_0114 12 0.0 1023.0 MAX_GRAD 0.0 /end AXIS_DESCR /end CHARACTERISTIC
/begin MEASUREMENT afz_a0_nv "Nullpunktadaption für Laengsbeschleunigung Fahrzeug" SWORD FORMULA_0454 0 0.0 -50.0 50.0 READ_WRITE ECU_ADDRESS 0x3F9132 /end MEASUREMENT
/begin MEASUREMENT ar_dn "nDelta" SWORD FORMULA_0475 0 0.0 -10000.0 10000.0 READ_WRITE ECU_ADDRESS 0x3FB228 /end MEASUREMENT
/begin MEASUREMENT ar_md "Stellgroesse" SWORD FORMULA_0009 0 0.0 -100.0 1000.0 READ_WRITE ECU_ADDRESS 0x3FB232 /end MEASUREMENT
/begin MEASUREMENT ar_md_kupp_korr "Korrektur fuer nRef" SWORD FORMULA_0009 0 0.0 -100.0 1000.0 READ_WRITE ECU_ADDRESS 0x3FB226 /end MEASUREMENT
/begin MEASUREMENT ar_n_dif "Differenz" SWORD FORMULA_0006 0 0.0 -10000.0 10000.0 READ_WRITE ECU_ADDRESS 0x3FB222 /end MEASUREMENT
/begin MEASUREMENT ar_n_dif_last "letzte Differenz" SWORD FORMULA_0006 0 0.0 -10000.0 10000.0 READ_WRITE ECU_ADDRESS 0x3FB224 /end MEASUREMENT
/begin MEASUREMENT ar_n_dif_ref "Differenz zu nRef" SWORD FORMULA_0006 0 0.0 -10000.0 10000.0 READ_WRITE ECU_ADDRESS 0x3FB22E /end MEASUREMENT
/begin MEASUREMENT ar_n_dif_ref_filt "gefilt. Differenz zu nRef" SWORD FORMULA_0006 0 0.0 -10000.0 10000.0 READ_WRITE ECU_ADDRESS 0x3FB230 /end MEASUREMENT
/begin MEASUREMENT ar_n_dif_ref_temp "Differenz ohne Begr" SWORD FORMULA_0006 0 0.0 -10000.0 10000.0 READ_WRITE ECU_ADDRESS 0x3FB22C /end MEASUREMENT
/begin MEASUREMENT ar_n_ref "Referenzdrehzahl" SWORD FORMULA_0006 0 0.0 0.0 10000.0 READ_WRITE ECU_ADDRESS 0x3FB22A /end MEASUREMENT
/begin MEASUREMENT ar_st "Status AR" UBYTE FORMULA_0473 0 0.0 0.0 255.0 READ_WRITE ECU_ADDRESS 0x3FB21C /end MEASUREMENT
/begin MEASUREMENT ar_state "State AR" UBYTE FORMULA_0474 0 0.0 0.0 255.0 READ_WRITE ECU_ADDRESS 0x3FB21D /end MEASUREMENT
/begin MEASUREMENT ar_t_max "max. AR-Eingriffszeit" UWORD FORMULA_0109 0 0.0 0.0 325.0 READ_WRITE ECU_ADDRESS 0x3FB220 /end MEASUREMENT
/begin MEASUREMENT ar_t_pas_delay "Delay nach Sperre" UWORD FORMULA_0109 0 0.0 0.0 325.0 READ_WRITE ECU_ADDRESS 0x3FB21E /end MEASUREMENT
/begin MEASUREMENT at_koeff_tp_n_a2 "Koeffizientensatz TP Motordrehzahl" SWORD FORMULA_0482 0 0.0 -4.0 3.999799966812134 READ_WRITE ECU_ADDRESS 0x3FB240 /end MEASUREMENT
/begin MEASUREMENT at_koeff_tp_n_a3 "Koeffizientensatz TP Motordrehzahl" SWORD FORMULA_0482 0 0.0 -4.0 3.999799966812134 READ_WRITE ECU_ADDRESS 0x3FB242 /end MEASUREMENT
/begin MEASUREMENT at_koeff_tp_n_b1 "Koeffizientensatz TP Motordrehzahl" SWORD FORMULA_0482 0 0.0 -4.0 3.999799966812134 READ_WRITE ECU_ADDRESS 0x3FB244 /end MEASUREMENT
/begin MEASUREMENT at_koeff_tp_n_b2 "Koeffizientensatz TP Motordrehzahl" SWORD FORMULA_0482 0 0.0 -4.0 3.999799966812134 READ_WRITE ECU_ADDRESS 0x3FB246 /end MEASUREMENT
/begin MEASUREMENT at_koeff_tp_n_b3 "Koeffizientensatz TP Motordrehzahl" SWORD FORMULA_0482 0 0.0 -4.0 3.999799966812134 READ_WRITE ECU_ADDRESS 0x3FB248 /end MEASUREMENT
/begin MEASUREMENT at_koeff_tp_trampin_a2 "Koeffizientensatz TP Trampeln" SWORD FORMULA_0482 0 0.0 -4.0 3.999799966812134 READ_WRITE ECU_ADDRESS 0x3FB24A /end MEASUREMENT
/begin MEASUREMENT at_koeff_tp_trampin_a3 "Koeffizientensatz TP Trampeln" SWORD FORMULA_0482 0 0.0 -4.0 3.999799966812134 READ_WRITE ECU_ADDRESS 0x3FB24C /end MEASUREMENT
/begin MEASUREMENT at_koeff_tp_trampin_b1 "Koeffizientensatz TP Trampeln" SWORD FORMULA_0482 0 0.0 -4.0 3.999799966812134 READ_WRITE ECU_ADDRESS 0x3FB24E /end MEASUREMENT
/begin MEASUREMENT at_koeff_tp_trampin_b2 "Koeffizientensatz TP Trampeln" SWORD FORMULA_0482 0 0.0 -4.0 3.999799966812134 READ_WRITE ECU_ADDRESS 0x3FB250 /end MEASUREMENT
/begin MEASUREMENT at_koeff_tp_trampin_b3 "Koeffizientensatz TP Trampeln" SWORD FORMULA_0482 0 0.0 -4.0 3.999799966812134 READ_WRITE ECU_ADDRESS 0x3FB252 /end MEASUREMENT
/begin MEASUREMENT at_koeff_tp_v_a2 "Koeffizientensatz TP Radgeschwindigkeit" SWORD FORMULA_0482 0 0.0 -4.0 3.999799966812134 READ_WRITE ECU_ADDRESS 0x3FB236 /end MEASUREMENT
/begin MEASUREMENT at_koeff_tp_v_a3 "Koeffizientensatz TP Radgeschwindigkeit" SWORD FORMULA_0482 0 0.0 -4.0 3.999799966812134 READ_WRITE ECU_ADDRESS 0x3FB238 /end MEASUREMENT
/begin MEASUREMENT at_koeff_tp_v_b1 "Koeffizientensatz TP Radgeschwindigkeit" SWORD FORMULA_0482 0 0.0 -4.0 3.999799966812134 READ_WRITE ECU_ADDRESS 0x3FB23A /end MEASUREMENT
/begin MEASUREMENT at_koeff_tp_v_b2 "Koeffizientensatz TP Radgeschwindigkeit" SWORD FORMULA_0482 0 0.0 -4.0 3.999799966812134 READ_WRITE ECU_ADDRESS 0x3FB23C /end MEASUREMENT
/begin MEASUREMENT at_koeff_tp_v_b3 "Koeffizientensatz TP Radgeschwindigkeit" SWORD FORMULA_0482 0 0.0 -4.0 3.999799966812134 READ_WRITE ECU_ADDRESS 0x3FB23E /end MEASUREMENT
/begin MEASUREMENT at_koeff_tp_v_grad_a2 "Koeffizientensatz TP Radgeschwindigkeitsgradient" SWORD FORMULA_0482 0 0.0 -4.0 3.999799966812134 READ_WRITE ECU_ADDRESS 0x3FB254 /end MEASUREMENT
/begin MEASUREMENT at_koeff_tp_v_grad_a3 "Koeffizientensatz TP Radgeschwindigkeitsgradient" SWORD FORMULA_0482 0 0.0 -4.0 3.999799966812134 READ_WRITE ECU_ADDRESS 0x3FB256 /end MEASUREMENT
/begin MEASUREMENT at_koeff_tp_v_grad_b1 "Koeffizientensatz TP Radgeschwindigkeitsgradient" SWORD FORMULA_0482 0 0.0 -4.0 3.999799966812134 READ_WRITE ECU_ADDRESS 0x3FB258 /end MEASUREMENT
/begin MEASUREMENT at_koeff_tp_v_grad_b2 "Koeffizientensatz TP Radgeschwindigkeitsgradient" SWORD FORMULA_0482 0 0.0 -4.0 3.999799966812134 READ_WRITE ECU_ADDRESS 0x3FB25A /end MEASUREMENT
/begin MEASUREMENT at_koeff_tp_v_grad_b3 "Koeffizientensatz TP Radgeschwindigkeitsgradient" SWORD FORMULA_0482 0 0.0 -4.0 3.999799966812134 READ_WRITE ECU_ADDRESS 0x3FB25C /end MEASUREMENT
/begin MEASUREMENT at_md_begr "Moment durch Anti-Trampel Funktion begrenzt" SWORD FORMULA_0009 0 0.0 -100.0 1000.0 READ_WRITE ECU_ADDRESS 0x3FB36C /end MEASUREMENT
/begin MEASUREMENT at_md_begr_b0 "Koeffizient b0, PID-Regler" SLONG FORMULA_0485 0 0.0 -2147483.648 2147483.647 READ_WRITE ECU_ADDRESS 0x3FB360 /end MEASUREMENT
/begin MEASUREMENT at_md_begr_b1 "Koeffizient b1, PID-Regler" SLONG FORMULA_0485 0 0.0 -2147483.648 2147483.647 READ_WRITE ECU_ADDRESS 0x3FB364 /end MEASUREMENT
/begin MEASUREMENT at_md_begr_b2 "Koeffizient b2, PID-Regler" SLONG FORMULA_0485 0 0.0 -2147483.648 2147483.647 READ_WRITE ECU_ADDRESS 0x3FB368 /end MEASUREMENT
/begin MEASUREMENT at_md_kupp_min "minimales Moment durch Anti-Trampel Begrenzung" SWORD FORMULA_0009 0 0.0 -100.0 1000.0 READ_WRITE ECU_ADDRESS 0x3FB352 /end MEASUREMENT
/begin MEASUREMENT at_md_kupp_ml "Reduktionsmoment fuer den Luftpfad" SWORD FORMULA_0009 0 0.0 -100.0 1000.0 READ_WRITE ECU_ADDRESS 0x3FB354 /end MEASUREMENT
/begin MEASUREMENT at_md_kupp_tz "Reduktionsmoment fuer Zuendwinkelpfad" SWORD FORMULA_0009 0 0.0 -100.0 1000.0 READ_WRITE ECU_ADDRESS 0x3FB356 /end MEASUREMENT
/begin MEASUREMENT at_md_kupp_wunsch "Minimum Wunschmoment" SWORD FORMULA_0009 0 0.0 -100.0 1000.0 READ_WRITE ECU_ADDRESS 0x3FB350 /end MEASUREMENT
/begin MEASUREMENT at_n_fak "Drehzahlwichtung abh. von Trampelintensitaet" SWORD FORMULA_0073 0 0.0 -32.0 31.99900054931641 READ_WRITE ECU_ADDRESS 0x3FB2DE /end MEASUREMENT
/begin MEASUREMENT at_n_hp "Motordrehzahl, hochpassgefiltert" SWORD FORMULA_0006 0 0.0 0.0 10000.0 READ_WRITE ECU_ADDRESS 0x3FB2DA /end MEASUREMENT
/begin MEASUREMENT at_n_hp_abs_fil "Trampelintensitaet Motordrehzahl, tiefpassgefiltert" SWORD FORMULA_0006 0 0.0 0.0 10000.0 READ_WRITE ECU_ADDRESS 0x3FB2DC /end MEASUREMENT
/begin MEASUREMENT at_sample_cnt "Intervallzaehler fuer Gradientenintegration" UBYTE FORMULA_0003 0 0.0 0.0 255.0 READ_WRITE ECU_ADDRESS 0x3FB328 /end MEASUREMENT
/begin MEASUREMENT at_schlupf_fak "Schlupfwichtung" SWORD FORMULA_0073 0 0.0 -32.0 31.99900054931641 READ_WRITE ECU_ADDRESS 0x3FB31E /end MEASUREMENT
/begin MEASUREMENT at_schlupf_li "Schlupf links" SWORD FORMULA_0484 0 0.0 -300.0 300.0 READ_WRITE ECU_ADDRESS 0x3FB318 /end MEASUREMENT
/begin MEASUREMENT at_schlupf_min "minimaler Schlupf" SWORD FORMULA_0484 0 0.0 -300.0 300.0 READ_WRITE ECU_ADDRESS 0x3FB31C /end MEASUREMENT
/begin MEASUREMENT at_schlupf_re "Schlupf rechts" SWORD FORMULA_0484 0 0.0 -300.0 300.0 READ_WRITE ECU_ADDRESS 0x3FB31A /end MEASUREMENT
/begin MEASUREMENT at_st "Status Anti-Trampel-Funktion" UBYTE FORMULA_0037 0 0.0 0.0 255.0 READ_WRITE ECU_ADDRESS 0x3FB234 /end MEASUREMENT
/begin MEASUREMENT at_st_eingriff "Status Anti-Trampel-Funktion Eingriff" UBYTE FORMULA_0481 0 0 0.0 255.0 READ_WRITE BIT_MASK 0x2 ECU_ADDRESS 0x3FB234 /end MEASUREMENT
/begin MEASUREMENT at_st_enable "Status Anti-Trampel-Funktion Enable" UBYTE FORMULA_0480 0 0 0.0 255.0 READ_WRITE BIT_MASK 0x1 ECU_ADDRESS 0x3FB234 /end MEASUREMENT
/begin MEASUREMENT at_tp_verz_n1 "Tiefpass-Verzoegerungsglieder fuer Trampelerkennung" SLONG FORMULA_0000 0 0.0 -2147483648.0 2147483647.0 READ_WRITE ECU_ADDRESS 0x3FB298 /end MEASUREMENT
/begin MEASUREMENT at_tp_verz_n2 "Tiefpass-Verzoegerungsglieder fuer Trampelerkennung" SLONG FORMULA_0000 0 0.0 -2147483648.0 2147483647.0 READ_WRITE ECU_ADDRESS 0x3FB29C /end MEASUREMENT
/begin MEASUREMENT at_tp_verz_trampin_ha1 "Tiefpass-Verzoegerungsglieder fuer Trampelerkennung" SLONG FORMULA_0000 0 0.0 -2147483648.0 2147483647.0 READ_WRITE ECU_ADDRESS 0x3FB290 /end MEASUREMENT
/begin MEASUREMENT at_tp_verz_trampin_ha2 "Tiefpass-Verzoegerungsglieder fuer Trampelerkennung" SLONG FORMULA_0000 0 0.0 -2147483648.0 2147483647.0 READ_WRITE ECU_ADDRESS 0x3FB294 /end MEASUREMENT
/begin MEASUREMENT at_tp_verz_trampin_n1 "Tiefpass-Verzoegerungsglieder fuer Trampelerkennung" SLONG FORMULA_0000 0 0.0 -2147483648.0 2147483647.0 READ_WRITE ECU_ADDRESS 0x3FB2A0 /end MEASUREMENT
/begin MEASUREMENT at_tp_verz_trampin_n2 "Tiefpass-Verzoegerungsglieder fuer Trampelerkennung" SLONG FORMULA_0000 0 0.0 -2147483648.0 2147483647.0 READ_WRITE ECU_ADDRESS 0x3FB2A4 /end MEASUREMENT
/begin MEASUREMENT at_tp_verz_trampin_vl1 "Tiefpass-Verzoegerungsglieder fuer Trampelerkennung" SLONG FORMULA_0000 0 0.0 -2147483648.0 2147483647.0 READ_WRITE ECU_ADDRESS 0x3FB268 /end MEASUREMENT
/begin MEASUREMENT at_tp_verz_trampin_vl2 "Tiefpass-Verzoegerungsglieder fuer Trampelerkennung" SLONG FORMULA_0000 0 0.0 -2147483648.0 2147483647.0 READ_WRITE ECU_ADDRESS 0x3FB26C /end MEASUREMENT
/begin MEASUREMENT at_tp_verz_trampin_vr1 "Tiefpass-Verzoegerungsglieder fuer Trampelerkennung" SLONG FORMULA_0000 0 0.0 -2147483648.0 2147483647.0 READ_WRITE ECU_ADDRESS 0x3FB278 /end MEASUREMENT
/begin MEASUREMENT at_tp_verz_trampin_vr2 "Tiefpass-Verzoegerungsglieder fuer Trampelerkennung" SLONG FORMULA_0000 0 0.0 -2147483648.0 2147483647.0 READ_WRITE ECU_ADDRESS 0x3FB27C /end MEASUREMENT
/begin MEASUREMENT at_tp_verz_v_grad_hl1 "Tiefpass-Verzoegerungsglieder fuer Trampelerkennung" SLONG FORMULA_0000 0 0.0 -2147483648.0 2147483647.0 READ_WRITE ECU_ADDRESS 0x3FB2B8 /end MEASUREMENT
/begin MEASUREMENT at_tp_verz_v_grad_hl2 "Tiefpass-Verzoegerungsglieder fuer Trampelerkennung" SLONG FORMULA_0000 0 0.0 -2147483648.0 2147483647.0 READ_WRITE ECU_ADDRESS 0x3FB2BC /end MEASUREMENT
/begin MEASUREMENT at_tp_verz_v_grad_hr1 "Tiefpass-Verzoegerungsglieder fuer Trampelerkennung" SLONG FORMULA_0000 0 0.0 -2147483648.0 2147483647.0 READ_WRITE ECU_ADDRESS 0x3FB2C0 /end MEASUREMENT
/begin MEASUREMENT at_tp_verz_v_grad_hr2 "Tiefpass-Verzoegerungsglieder fuer Trampelerkennung" SLONG FORMULA_0000 0 0.0 -2147483648.0 2147483647.0 READ_WRITE ECU_ADDRESS 0x3FB2C4 /end MEASUREMENT
/begin MEASUREMENT at_tp_verz_v_grad_vl1 "Tiefpass-Verzoegerungsglieder fuer Trampelerkennung" SLONG FORMULA_0000 0 0.0 -2147483648.0 2147483647.0 READ_WRITE ECU_ADDRESS 0x3FB2A8 /end MEASUREMENT
/begin MEASUREMENT at_tp_verz_v_grad_vl2 "Tiefpass-Verzoegerungsglieder fuer Trampelerkennung" SLONG FORMULA_0000 0 0.0 -2147483648.0 2147483647.0 READ_WRITE ECU_ADDRESS 0x3FB2AC /end MEASUREMENT
/begin MEASUREMENT at_tp_verz_v_grad_vr1 "Tiefpass-Verzoegerungsglieder fuer Trampelerkennung" SLONG FORMULA_0000 0 0.0 -2147483648.0 2147483647.0 READ_WRITE ECU_ADDRESS 0x3FB2B0 /end MEASUREMENT
/begin MEASUREMENT at_tp_verz_v_grad_vr2 "Tiefpass-Verzoegerungsglieder fuer Trampelerkennung" SLONG FORMULA_0000 0 0.0 -2147483648.0 2147483647.0 READ_WRITE ECU_ADDRESS 0x3FB2B4 /end MEASUREMENT
/begin MEASUREMENT at_tp_verz_v_hl1 "Tiefpass-Verzoegerungsglieder fuer Trampelerkennung" SLONG FORMULA_0000 0 0.0 -2147483648.0 2147483647.0 READ_WRITE ECU_ADDRESS 0x3FB280 /end MEASUREMENT
/begin MEASUREMENT at_tp_verz_v_hl2 "Tiefpass-Verzoegerungsglieder fuer Trampelerkennung" SLONG FORMULA_0000 0 0.0 -2147483648.0 2147483647.0 READ_WRITE ECU_ADDRESS 0x3FB284 /end MEASUREMENT
/begin MEASUREMENT at_tp_verz_v_hr1 "Tiefpass-Verzoegerungsglieder fuer Trampelerkennung" SLONG FORMULA_0000 0 0.0 -2147483648.0 2147483647.0 READ_WRITE ECU_ADDRESS 0x3FB288 /end MEASUREMENT
/begin MEASUREMENT at_tp_verz_v_hr2 "Tiefpass-Verzoegerungsglieder fuer Trampelerkennung" SLONG FORMULA_0000 0 0.0 -2147483648.0 2147483647.0 READ_WRITE ECU_ADDRESS 0x3FB28C /end MEASUREMENT
/begin MEASUREMENT at_tp_verz_v_vl1 "Tiefpass-Verzoegerungsglieder fuer Trampelerkennung" SLONG FORMULA_0000 0 0.0 -2147483648.0 2147483647.0 READ_WRITE ECU_ADDRESS 0x3FB260 /end MEASUREMENT
/begin MEASUREMENT at_tp_verz_v_vl2 "Tiefpass-Verzoegerungsglieder fuer Trampelerkennung" SLONG FORMULA_0000 0 0.0 -2147483648.0 2147483647.0 READ_WRITE ECU_ADDRESS 0x3FB264 /end MEASUREMENT
/begin MEASUREMENT at_tp_verz_v_vr1 "Tiefpass-Verzoegerungsglieder fuer Trampelerkennung" SLONG FORMULA_0000 0 0.0 -2147483648.0 2147483647.0 READ_WRITE ECU_ADDRESS 0x3FB270 /end MEASUREMENT
/begin MEASUREMENT at_tp_verz_v_vr2 "Tiefpass-Verzoegerungsglieder fuer Trampelerkennung" SLONG FORMULA_0000 0 0.0 -2147483648.0 2147483647.0 READ_WRITE ECU_ADDRESS 0x3FB274 /end MEASUREMENT
/begin MEASUREMENT at_trampin "Trampelintensitaet HA - VA" SWORD FORMULA_0483 0 0.0 -80.0 360.0 READ_WRITE ECU_ADDRESS 0x3FB34C /end MEASUREMENT
/begin MEASUREMENT at_trampin_dif "gew. Trampelintensitaet HA ueber Trampelschwelle" SWORD FORMULA_0483 0 0.0 -80.0 360.0 READ_WRITE ECU_ADDRESS 0x3FB358 /end MEASUREMENT
/begin MEASUREMENT at_trampin_dif_verz1 "Trampelintensitaet, einmal verzoegert" SWORD FORMULA_0483 0 0.0 -80.0 360.0 READ_WRITE ECU_ADDRESS 0x3FB35A /end MEASUREMENT
/begin MEASUREMENT at_trampin_dif_verz2 "Trampelintensitaet, zweimal verzoegert" SWORD FORMULA_0483 0 0.0 -80.0 360.0 READ_WRITE ECU_ADDRESS 0x3FB35C /end MEASUREMENT
/begin MEASUREMENT at_trampin_ha "gewichtete Trampelintensitaet HA" SWORD FORMULA_0483 0 0.0 -80.0 360.0 READ_WRITE ECU_ADDRESS 0x3FB34A /end MEASUREMENT
/begin MEASUREMENT at_trampin_ha_roh "Summe Radgeschwindigkeiten HA, hochpassgefiltert" SWORD FORMULA_0076 0 0.0 -80.0 360.0 READ_WRITE ECU_ADDRESS 0x3FB2D6 /end MEASUREMENT
/begin MEASUREMENT at_trampin_ha_tp "Trampelintensitaet HA, tiefpassgefiltert" SWORD FORMULA_0483 0 0.0 -80.0 360.0 READ_WRITE ECU_ADDRESS 0x3FB2D8 /end MEASUREMENT
/begin MEASUREMENT at_trampin_schub "Trampelintensitaet Schubbetrieb" SWORD FORMULA_0483 0 0.0 -80.0 360.0 READ_WRITE ECU_ADDRESS 0x3FB34E /end MEASUREMENT
/begin MEASUREMENT at_trampin_va "mittlere Trampelintensität an der Vorderachse" SWORD FORMULA_0483 0 0.0 -80.0 360.0 READ_WRITE ECU_ADDRESS 0x3FB2D0 /end MEASUREMENT
/begin MEASUREMENT at_trampin_vl "Trampelintensitaet VL, tiefpassgefiltert" SWORD FORMULA_0483 0 0.0 -80.0 360.0 READ_WRITE ECU_ADDRESS 0x3FB2CA /end MEASUREMENT
/begin MEASUREMENT at_trampin_vr "Trampelintensitaet VR, tiefpassgefiltert" SWORD FORMULA_0483 0 0.0 -80.0 360.0 READ_WRITE ECU_ADDRESS 0x3FB2CE /end MEASUREMENT
/begin MEASUREMENT at_v_grad_fak "Wichtung, maximaler Gradient" SWORD FORMULA_0073 0 0.0 -32.0 31.99900054931641 READ_WRITE ECU_ADDRESS 0x3FB326 /end MEASUREMENT
/begin MEASUREMENT at_v_grad_int_100ms "Summe der Gradienten HL und HR, 100ms Periode" SWORD FORMULA_0076 0 0.0 -80.0 360.0 READ_WRITE ECU_ADDRESS 0x3FB340 /end MEASUREMENT
/begin MEASUREMENT at_v_grad_int_100ms_fil "gefilterte Summe der Gradienten HL und HR, 100ms Periode" SWORD FORMULA_0076 0 0.0 -80.0 360.0 READ_WRITE ECU_ADDRESS 0x3FB344 /end MEASUREMENT
/begin MEASUREMENT at_v_grad_int_80ms "Summe der Gradienten HL und HR, 80ms Periode" SWORD FORMULA_0076 0 0.0 -80.0 360.0 READ_WRITE ECU_ADDRESS 0x3FB33E /end MEASUREMENT
/begin MEASUREMENT at_v_grad_int_80ms_fil "gefilterte Summe der Gradienten HL und HR, 80ms Periode" SWORD FORMULA_0076 0 0.0 -80.0 360.0 READ_WRITE ECU_ADDRESS 0x3FB342 /end MEASUREMENT
/begin MEASUREMENT at_v_grad_int_fak "Wichtung, Summe der Gradienten HL und HR" SWORD FORMULA_0073 0 0.0 -32.0 31.99900054931641 READ_WRITE ECU_ADDRESS 0x3FB348 /end MEASUREMENT
/begin MEASUREMENT at_v_grad_int_fil "selektierte, gefilterte Summe der Gradienten HL und HR" SWORD FORMULA_0076 0 0.0 -80.0 360.0 READ_WRITE ECU_ADDRESS 0x3FB346 /end MEASUREMENT
/begin MEASUREMENT at_v_grad_li "Gradient links" SWORD FORMULA_0076 0 0.0 -80.0 360.0 READ_WRITE ECU_ADDRESS 0x3FB320 /end MEASUREMENT
/begin MEASUREMENT at_v_grad_max "maximaler Gradient" SWORD FORMULA_0076 0 0.0 -80.0 360.0 READ_WRITE ECU_ADDRESS 0x3FB324 /end MEASUREMENT
/begin MEASUREMENT at_v_grad_re "Gradient rechts" SWORD FORMULA_0076 0 0.0 -80.0 360.0 READ_WRITE ECU_ADDRESS 0x3FB322 /end MEASUREMENT
/begin MEASUREMENT at_v_rad_hl_grad "Radgeschwindigkeitsgradient HL, (delta v / 5ms)" SWORD FORMULA_0076 0 0.0 -80.0 360.0 READ_WRITE ECU_ADDRESS 0x3FB2FE /end MEASUREMENT
/begin MEASUREMENT at_v_rad_hl_grad_fil "gemittelter Radgeschwindigkeitsgradient HL, (delta v / 5ms)" SWORD FORMULA_0076 0 0.0 -80.0 360.0 READ_WRITE ECU_ADDRESS 0x3FB308 /end MEASUREMENT
/begin MEASUREMENT at_v_rad_hl_hp "Radgeschwindigkeit HL, hochpassgefiltert" SWORD FORMULA_0076 0 0.0 -80.0 360.0 READ_WRITE ECU_ADDRESS 0x3FB2D2 /end MEASUREMENT
/begin MEASUREMENT at_v_rad_hl_tp "Radgeschwindigkeit HL, tiefpassgefiltert" SWORD FORMULA_0076 0 0.0 -80.0 360.0 READ_WRITE ECU_ADDRESS 0x3FB2FC /end MEASUREMENT
/begin MEASUREMENT at_v_rad_hl_tp_verz "verzoegerte Radgeschwindigkeit HL, tiefpassgefiltert" SWORD FORMULA_0076 0 0.0 -80.0 360.0 READ_WRITE ARRAY_SIZE 4 ECU_ADDRESS 0x3FB300 MATRIX_DIM 4 1 1 /end MEASUREMENT
/begin MEASUREMENT at_v_rad_hl_verz "verzoegerte Radgeschwindigkeit HL" SWORD FORMULA_0076 0 0.0 -80.0 360.0 READ_WRITE ARRAY_SIZE 5 ECU_ADDRESS 0x3FB32A MATRIX_DIM 5 1 1 /end MEASUREMENT
/begin MEASUREMENT at_v_rad_hr_grad "Radgeschwindigkeitsgradient HR, (delta v / 5ms)" SWORD FORMULA_0076 0 0.0 -80.0 360.0 READ_WRITE ECU_ADDRESS 0x3FB30C /end MEASUREMENT
/begin MEASUREMENT at_v_rad_hr_grad_fil "gemittelter Radgeschwindigkeitsgradient HR, (delta v / 5ms)" SWORD FORMULA_0076 0 0.0 -80.0 360.0 READ_WRITE ECU_ADDRESS 0x3FB316 /end MEASUREMENT
/begin MEASUREMENT at_v_rad_hr_hp "Radgeschwindigkeit HR, hochpassgefiltert" SWORD FORMULA_0076 0 0.0 -80.0 360.0 READ_WRITE ECU_ADDRESS 0x3FB2D4 /end MEASUREMENT
/begin MEASUREMENT at_v_rad_hr_tp "Radgeschwindigkeit HR, tiefpassgefiltert" SWORD FORMULA_0076 0 0.0 -80.0 360.0 READ_WRITE ECU_ADDRESS 0x3FB30A /end MEASUREMENT
/begin MEASUREMENT at_v_rad_hr_tp_verz "verzoegerte Radgeschwindigkeit HR, tiefpassgefiltert" SWORD FORMULA_0076 0 0.0 -80.0 360.0 READ_WRITE ARRAY_SIZE 4 ECU_ADDRESS 0x3FB30E MATRIX_DIM 4 1 1 /end MEASUREMENT
/begin MEASUREMENT at_v_rad_hr_verz "verzoegerte Radgeschwindigkeit HR" SWORD FORMULA_0076 0 0.0 -80.0 360.0 READ_WRITE ARRAY_SIZE 5 ECU_ADDRESS 0x3FB334 MATRIX_DIM 5 1 1 /end MEASUREMENT
/begin MEASUREMENT at_v_rad_vl_grad "Radgeschwindigkeitsgradient VL, (delta v / 5ms)" SWORD FORMULA_0076 0 0.0 -80.0 360.0 READ_WRITE ECU_ADDRESS 0x3FB2E2 /end MEASUREMENT
/begin MEASUREMENT at_v_rad_vl_grad_fil "gemittelter Radgeschwindigkeitsgradient VL, (delta v / 5ms)" SWORD FORMULA_0076 0 0.0 -80.0 360.0 READ_WRITE ECU_ADDRESS 0x3FB2EC /end MEASUREMENT
/begin MEASUREMENT at_v_rad_vl_hp "Radgeschwindigkeit VL, hochpassgefiltert" SWORD FORMULA_0076 0 0.0 -80.0 360.0 READ_WRITE ECU_ADDRESS 0x3FB2C8 /end MEASUREMENT
/begin MEASUREMENT at_v_rad_vl_tp "Radgeschwindigkeit VL, tiefpassgefiltert" SWORD FORMULA_0076 0 0.0 -80.0 360.0 READ_WRITE ECU_ADDRESS 0x3FB2E0 /end MEASUREMENT
/begin MEASUREMENT at_v_rad_vl_tp_verz "verzoegerte Radgeschwindigkeit VL, tiefpassgefiltert" SWORD FORMULA_0076 0 0.0 -80.0 360.0 READ_WRITE ARRAY_SIZE 4 ECU_ADDRESS 0x3FB2E4 MATRIX_DIM 4 1 1 /end MEASUREMENT
/begin MEASUREMENT at_v_rad_vr_grad "Radgeschwindigkeitsgradient VR, (delta v / 5ms)" SWORD FORMULA_0076 0 0.0 -80.0 360.0 READ_WRITE ECU_ADDRESS 0x3FB2F0 /end MEASUREMENT
/begin MEASUREMENT at_v_rad_vr_grad_fil "gemittelter Radgeschwindigkeitsgradient VR, (delta v / 5ms)" SWORD FORMULA_0076 0 0.0 -80.0 360.0 READ_WRITE ECU_ADDRESS 0x3FB2FA /end MEASUREMENT
/begin MEASUREMENT at_v_rad_vr_hp "Radgeschwindigkeit VR, hochpassgefiltert" SWORD FORMULA_0076 0 0.0 -80.0 360.0 READ_WRITE ECU_ADDRESS 0x3FB2CC /end MEASUREMENT
/begin MEASUREMENT at_v_rad_vr_tp "Radgeschwindigkeit VR, tiefpassgefiltert" SWORD FORMULA_0076 0 0.0 -80.0 360.0 READ_WRITE ECU_ADDRESS 0x3FB2EE /end MEASUREMENT
/begin MEASUREMENT at_v_rad_vr_tp_verz "verzoegerte Radgeschwindigkeit VR, tiefpassgefiltert" SWORD FORMULA_0076 0 0.0 -80.0 360.0 READ_WRITE ARRAY_SIZE 4 ECU_ADDRESS 0x3FB2F2 MATRIX_DIM 4 1 1 /end MEASUREMENT
/begin MEASUREMENT auss_erk_ns_nv_zyl1 "Zaehler Nebenschlusserkennung." UWORD FORMULA_0010 0 0.0 0.0 65535.0 READ_WRITE ECU_ADDRESS 0x3F9D80 /end MEASUREMENT
/begin MEASUREMENT auss_erk_ns_nv_zyl10 "Zaehler Nebenschlusserkennung." UWORD FORMULA_0010 0 0.0 0.0 65535.0 READ_WRITE ECU_ADDRESS 0x3F9D92 /end MEASUREMENT
/begin MEASUREMENT auss_erk_ns_nv_zyl2 "Zaehler Nebenschlusserkennung." UWORD FORMULA_0010 0 0.0 0.0 65535.0 READ_WRITE ECU_ADDRESS 0x3F9D82 /end MEASUREMENT
/begin MEASUREMENT auss_erk_ns_nv_zyl3 "Zaehler Nebenschlusserkennung." UWORD FORMULA_0010 0 0.0 0.0 65535.0 READ_WRITE ECU_ADDRESS 0x3F9D84 /end MEASUREMENT
/begin MEASUREMENT auss_erk_ns_nv_zyl4 "Zaehler Nebenschlusserkennung." UWORD FORMULA_0010 0 0.0 0.0 65535.0 READ_WRITE ECU_ADDRESS 0x3F9D86 /end MEASUREMENT
/begin MEASUREMENT auss_erk_ns_nv_zyl5 "Zaehler Nebenschlusserkennung." UWORD FORMULA_0010 0 0.0 0.0 65535.0 READ_WRITE ECU_ADDRESS 0x3F9D88 /end MEASUREMENT
/begin MEASUREMENT auss_erk_ns_nv_zyl6 "Zaehler Nebenschlusserkennung." UWORD FORMULA_0010 0 0.0 0.0 65535.0 READ_WRITE ECU_ADDRESS 0x3F9D8A /end MEASUREMENT
/begin MEASUREMENT auss_erk_ns_nv_zyl7 "Zaehler Nebenschlusserkennung." UWORD FORMULA_0010 0 0.0 0.0 65535.0 READ_WRITE ECU_ADDRESS 0x3F9D8C /end MEASUREMENT
/begin MEASUREMENT auss_erk_ns_nv_zyl8 "Zaehler Nebenschlusserkennung." UWORD FORMULA_0010 0 0.0 0.0 65535.0 READ_WRITE ECU_ADDRESS 0x3F9D8E /end MEASUREMENT
/begin MEASUREMENT auss_erk_ns_nv_zyl9 "Zaehler Nebenschlusserkennung." UWORD FORMULA_0010 0 0.0 0.0 65535.0 READ_WRITE ECU_ADDRESS 0x3F9D90 /end MEASUREMENT
/begin MEASUREMENT auss_erk_nv_zyl1 "Zaehler Zuendaussetzer." UWORD FORMULA_0010 0 0.0 0.0 65535.0 READ_WRITE ECU_ADDRESS 0x3F9D58 /end MEASUREMENT
/begin MEASUREMENT auss_erk_nv_zyl10 "Zaehler Zuendaussetzer." UWORD FORMULA_0010 0 0.0 0.0 65535.0 READ_WRITE ECU_ADDRESS 0x3F9D6A /end MEASUREMENT
/begin MEASUREMENT auss_erk_nv_zyl2 "Zaehler Zuendaussetzer." UWORD FORMULA_0010 0 0.0 0.0 65535.0 READ_WRITE ECU_ADDRESS 0x3F9D5A /end MEASUREMENT
/begin MEASUREMENT auss_erk_nv_zyl3 "Zaehler Zuendaussetzer." UWORD FORMULA_0010 0 0.0 0.0 65535.0 READ_WRITE ECU_ADDRESS 0x3F9D5C /end MEASUREMENT
/begin MEASUREMENT auss_erk_nv_zyl4 "Zaehler Zuendaussetzer." UWORD FORMULA_0010 0 0.0 0.0 65535.0 READ_WRITE ECU_ADDRESS 0x3F9D5E /end MEASUREMENT
/begin MEASUREMENT auss_erk_nv_zyl5 "Zaehler Zuendaussetzer." UWORD FORMULA_0010 0 0.0 0.0 65535.0 READ_WRITE ECU_ADDRESS 0x3F9D60 /end MEASUREMENT
/begin MEASUREMENT auss_erk_nv_zyl6 "Zaehler Zuendaussetzer." UWORD FORMULA_0010 0 0.0 0.0 65535.0 READ_WRITE ECU_ADDRESS 0x3F9D62 /end MEASUREMENT
/begin MEASUREMENT auss_erk_nv_zyl7 "Zaehler Zuendaussetzer." UWORD FORMULA_0010 0 0.0 0.0 65535.0 READ_WRITE ECU_ADDRESS 0x3F9D64 /end MEASUREMENT
/begin MEASUREMENT auss_erk_nv_zyl8 "Zaehler Zuendaussetzer." UWORD FORMULA_0010 0 0.0 0.0 65535.0 READ_WRITE ECU_ADDRESS 0x3F9D66 /end MEASUREMENT
/begin MEASUREMENT auss_erk_nv_zyl9 "Zaehler Zuendaussetzer." UWORD FORMULA_0010 0 0.0 0.0 65535.0 READ_WRITE ECU_ADDRESS 0x3F9D68 /end MEASUREMENT
/begin MEASUREMENT auss_erk_ti_nv_zyl1 "Zaehler Verbrennungsaussetzererkennung." UWORD FORMULA_0010 0 0.0 0.0 65535.0 READ_WRITE ECU_ADDRESS 0x3F9D6C /end MEASUREMENT
/begin MEASUREMENT auss_erk_ti_nv_zyl10 "Zaehler Verbrennungsaussetzererkennung." UWORD FORMULA_0010 0 0.0 0.0 65535.0 READ_WRITE ECU_ADDRESS 0x3F9D7E /end MEASUREMENT
/begin MEASUREMENT auss_erk_ti_nv_zyl2 "Zaehler Verbrennungsaussetzererkennung." UWORD FORMULA_0010 0 0.0 0.0 65535.0 READ_WRITE ECU_ADDRESS 0x3F9D6E /end MEASUREMENT
/begin MEASUREMENT auss_erk_ti_nv_zyl3 "Zaehler Verbrennungsaussetzererkennung." UWORD FORMULA_0010 0 0.0 0.0 65535.0 READ_WRITE ECU_ADDRESS 0x3F9D70 /end MEASUREMENT
/begin MEASUREMENT auss_erk_ti_nv_zyl4 "Zaehler Verbrennungsaussetzererkennung." UWORD FORMULA_0010 0 0.0 0.0 65535.0 READ_WRITE ECU_ADDRESS 0x3F9D72 /end MEASUREMENT
/begin MEASUREMENT auss_erk_ti_nv_zyl5 "Zaehler Verbrennungsaussetzererkennung." UWORD FORMULA_0010 0 0.0 0.0 65535.0 READ_WRITE ECU_ADDRESS 0x3F9D74 /end MEASUREMENT
/begin MEASUREMENT auss_erk_ti_nv_zyl6 "Zaehler Verbrennungsaussetzererkennung." UWORD FORMULA_0010 0 0.0 0.0 65535.0 READ_WRITE ECU_ADDRESS 0x3F9D76 /end MEASUREMENT
/begin MEASUREMENT auss_erk_ti_nv_zyl7 "Zaehler Verbrennungsaussetzererkennung." UWORD FORMULA_0010 0 0.0 0.0 65535.0 READ_WRITE ECU_ADDRESS 0x3F9D78 /end MEASUREMENT
/begin MEASUREMENT auss_erk_ti_nv_zyl8 "Zaehler Verbrennungsaussetzererkennung." UWORD FORMULA_0010 0 0.0 0.0 65535.0 READ_WRITE ECU_ADDRESS 0x3F9D7A /end MEASUREMENT
/begin MEASUREMENT auss_erk_ti_nv_zyl9 "Zaehler Verbrennungsaussetzererkennung." UWORD FORMULA_0010 0 0.0 0.0 65535.0 READ_WRITE ECU_ADDRESS 0x3F9D7C /end MEASUREMENT
/begin MEASUREMENT auss_ff.auss_lp_int "TP-Integral-Leitwert im Aussetzerfenster" SWORD FORMULA_0227 0 0.0 0.0 4.0 READ_WRITE ECU_ADDRESS 0x3F9FE4 /end MEASUREMENT
/begin MEASUREMENT auss_ff.auss_lp_min "Offset Leitwert im Aussetzerfenster." SWORD FORMULA_0442 0 0.0 0.0 0.6000000238418579 READ_WRITE ECU_ADDRESS 0x3F9FEA /end MEASUREMENT
/begin MEASUREMENT auss_ff.auss_ns_time "Nebenschlusszeit im Aussetzerfenster." UWORD FORMULA_0446 0 0.0 0.0 24.57600021362305 READ_WRITE ECU_ADDRESS 0x3F9FE8 /end MEASUREMENT
/begin MEASUREMENT auss_ff.auss_spark_time "Funkenbrenndauer." SWORD FORMULA_0445 0 0.0 0.0 4.681000232696533 READ_WRITE ECU_ADDRESS 0x3F9FE6 /end MEASUREMENT
/begin MEASUREMENT auss_ff.egas_ist_lls "Istwert LLS (CAN)" SWORD FORMULA_0001 0 0.0 -10.0 120.0 READ_WRITE ECU_ADDRESS 0x3F9FE0 /end MEASUREMENT
/begin MEASUREMENT auss_ff.egas_wdk_abs "korr. U_WDK" SWORD FORMULA_0250 0 0.0 0.0 5.0 READ_WRITE ECU_ADDRESS 0x3F9FDE /end MEASUREMENT
/begin MEASUREMENT auss_ff.laa_f_ber_nv "Faktor-Lambdaadaption ohne TE" UWORD FORMULA_0024 0 0.0 0.0 1.998999953269959 READ_WRITE ECU_ADDRESS 0x3F9FD4 /end MEASUREMENT
/begin MEASUREMENT auss_ff.lam_ist_mw "Mittelwert IST-Lambda" UWORD FORMULA_0025 0 0.0 0.0 3.999000072479248 READ_WRITE ECU_ADDRESS 0x3F9FD2 /end MEASUREMENT
/begin MEASUREMENT auss_ff.n "Drehzahl" SWORD FORMULA_0006 0 0.0 0.0 10000.0 READ_WRITE ECU_ADDRESS 0x3F9FBE /end MEASUREMENT
/begin MEASUREMENT auss_ff.pks_rel "rel. Kraftstoffdruck" SWORD FORMULA_0110 0 0.0 0.0 10.0 READ_WRITE ECU_ADDRESS 0x3F9FC2 /end MEASUREMENT
/begin MEASUREMENT auss_ff.rf "Fuellung" SWORD FORMULA_0007 0 0.0 0.0 2.0 READ_WRITE ECU_ADDRESS 0x3F9FCC /end MEASUREMENT
/begin MEASUREMENT auss_ff.rf_aq "Fuellung vom AQ" SWORD FORMULA_0007 0 0.0 0.0 2.0 READ_WRITE ECU_ADDRESS 0x3F9FD0 /end MEASUREMENT
/begin MEASUREMENT auss_ff.rf_hfm "Fuellung vom HFM" SWORD FORMULA_0007 0 0.0 0.0 2.0 READ_WRITE ECU_ADDRESS 0x3F9FCE /end MEASUREMENT
/begin MEASUREMENT auss_ff.st "FF-Zustand" UWORD FORMULA_0444 0 0.0 0.0 65535.0 READ_WRITE ECU_ADDRESS 0x3F9FBC /end MEASUREMENT
/begin MEASUREMENT auss_ff.ti_tpu_st "Freigabe Einspritzung" UWORD FORMULA_0010 0 0.0 0.0 65535.0 READ_WRITE ECU_ADDRESS 0x3F9FC4 /end MEASUREMENT
/begin MEASUREMENT auss_ff.time_ml "Zeit seit Motor laeuft" ULONG FORMULA_0147 0 0.0 0.0 42949672.95 READ_WRITE ECU_ADDRESS 0x3F9FC8 /end MEASUREMENT
/begin MEASUREMENT auss_ff.tz "Zuendwinkel" SWORD FORMULA_0102 0 0.0 -50.0 60.0 READ_WRITE ECU_ADDRESS 0x3F9FE2 /end MEASUREMENT
/begin MEASUREMENT auss_ff.ub "Spannung" SWORD FORMULA_0008 0 0.0 0.0 28.0 READ_WRITE ECU_ADDRESS 0x3F9FC0 /end MEASUREMENT
/begin MEASUREMENT auss_ff.van_ist_a "Auslassvanos Istposition" SWORD FORMULA_0102 0 0.0 50.0 160.0 READ_WRITE ECU_ADDRESS 0x3F9FDA /end MEASUREMENT
/begin MEASUREMENT auss_ff.van_ist_e "Einlassvanos Istposition" SWORD FORMULA_0102 0 0.0 50.0 160.0 READ_WRITE ECU_ADDRESS 0x3F9FD6 /end MEASUREMENT
/begin MEASUREMENT auss_ff.van_soll_a "Auslassvanos Sollwert" SWORD FORMULA_0102 0 0.0 50.0 160.0 READ_WRITE ECU_ADDRESS 0x3F9FDC /end MEASUREMENT
/begin MEASUREMENT auss_ff.van_soll_e "Einlassvanos Sollwert" SWORD FORMULA_0102 0 0.0 50.0 160.0 READ_WRITE ECU_ADDRESS 0x3F9FD8 /end MEASUREMENT
/begin MEASUREMENT auss_ff.vr_mess "Istverstaerkung." SWORD FORMULA_0447 0 0.0 0.0 32.0 READ_WRITE ECU_ADDRESS 0x3F9FEC /end MEASUREMENT
/begin MEASUREMENT auss_ff.zustand_motor "Betriebszustand" UWORD FORMULA_0019 0 0.0 0.0 65535.0 READ_WRITE ECU_ADDRESS 0x3F9FC6 /end MEASUREMENT
/begin MEASUREMENT auss_lp_min_sa_max_nv_zyl1 "Maximaler Offset im Aussetzerfenster bei SA." SWORD FORMULA_0442 0 0.0 0.0 0.6000000238418579 READ_WRITE ECU_ADDRESS 0x3F9EC4 /end MEASUREMENT
/begin MEASUREMENT auss_lp_min_sa_max_nv_zyl10 "Maximaler Offset im Aussetzerfenster bei SA." SWORD FORMULA_0442 0 0.0 0.0 0.6000000238418579 READ_WRITE ECU_ADDRESS 0x3F9ED6 /end MEASUREMENT
/begin MEASUREMENT auss_lp_min_sa_max_nv_zyl2 "Maximaler Offset im Aussetzerfenster bei SA." SWORD FORMULA_0442 0 0.0 0.0 0.6000000238418579 READ_WRITE ECU_ADDRESS 0x3F9EC6 /end MEASUREMENT
/begin MEASUREMENT auss_lp_min_sa_max_nv_zyl3 "Maximaler Offset im Aussetzerfenster bei SA." SWORD FORMULA_0442 0 0.0 0.0 0.6000000238418579 READ_WRITE ECU_ADDRESS 0x3F9EC8 /end MEASUREMENT
/begin MEASUREMENT auss_lp_min_sa_max_nv_zyl4 "Maximaler Offset im Aussetzerfenster bei SA." SWORD FORMULA_0442 0 0.0 0.0 0.6000000238418579 READ_WRITE ECU_ADDRESS 0x3F9ECA /end MEASUREMENT
/begin MEASUREMENT auss_lp_min_sa_max_nv_zyl5 "Maximaler Offset im Aussetzerfenster bei SA." SWORD FORMULA_0442 0 0.0 0.0 0.6000000238418579 READ_WRITE ECU_ADDRESS 0x3F9ECC /end MEASUREMENT
/begin MEASUREMENT auss_lp_min_sa_max_nv_zyl6 "Maximaler Offset im Aussetzerfenster bei SA." SWORD FORMULA_0442 0 0.0 0.0 0.6000000238418579 READ_WRITE ECU_ADDRESS 0x3F9ECE /end MEASUREMENT
/begin MEASUREMENT auss_lp_min_sa_max_nv_zyl7 "Maximaler Offset im Aussetzerfenster bei SA." SWORD FORMULA_0442 0 0.0 0.0 0.6000000238418579 READ_WRITE ECU_ADDRESS 0x3F9ED0 /end MEASUREMENT
/begin MEASUREMENT auss_lp_min_sa_max_nv_zyl8 "Maximaler Offset im Aussetzerfenster bei SA." SWORD FORMULA_0442 0 0.0 0.0 0.6000000238418579 READ_WRITE ECU_ADDRESS 0x3F9ED2 /end MEASUREMENT
/begin MEASUREMENT auss_lp_min_sa_max_nv_zyl9 "Maximaler Offset im Aussetzerfenster bei SA." SWORD FORMULA_0442 0 0.0 0.0 0.6000000238418579 READ_WRITE ECU_ADDRESS 0x3F9ED4 /end MEASUREMENT
/begin MEASUREMENT c_cbs_oel_nv "Codierdaten OELWARTUNGSINTERVALL" UBYTE FORMULA_0034 0 0.0 0.0 255.0 READ_WRITE ECU_ADDRESS 0x3F8672 /end MEASUREMENT
/begin MEASUREMENT c_ksa_nv "Codierdaten KRAFTSTOFFAUSLEGUNG" UBYTE FORMULA_0035 0 0.0 0.0 255.0 READ_WRITE ECU_ADDRESS 0x3F8673 /end MEASUREMENT
/begin MEASUREMENT c_mil_nv "Codierdaten MILANSTEUERUNG" UBYTE FORMULA_0033 0 0.0 0.0 255.0 READ_WRITE ECU_ADDRESS 0x3F8671 /end MEASUREMENT
/begin MEASUREMENT c_mj_nv "Codierdaten MODELLJAHR" UBYTE FORMULA_0036 0 0.0 0.0 255.0 READ_WRITE ECU_ADDRESS 0x3F8674 /end MEASUREMENT
/begin MEASUREMENT can_fzgtyp_clas_pwr_nv "Variante v_max-Anhebung" UBYTE FORMULA_0030 0 0.0 0.0 255.0 READ_WRITE ECU_ADDRESS 0x3F866E /end MEASUREMENT
/begin MEASUREMENT can_fzgtyp_grb_nv "Getriebevariante" UBYTE FORMULA_0031 0 0.0 0.0 255.0 READ_WRITE ECU_ADDRESS 0x3F866F /end MEASUREMENT
/begin MEASUREMENT can_fzgtyp_land_nv "Laendervariante" UBYTE FORMULA_0028 0 0.0 0.0 255.0 READ_WRITE ECU_ADDRESS 0x3F866C /end MEASUREMENT
/begin MEASUREMENT can_fzgtyp_veh_nv "Fahrzeugvariante" UBYTE FORMULA_0029 0 0.0 0.0 255.0 READ_WRITE ECU_ADDRESS 0x3F866D /end MEASUREMENT
/begin MEASUREMENT can_km_stand_nv "Kilometerstand" ULONG FORMULA_0027 0 0.0 0.0 16777214.0 READ_WRITE ECU_ADDRESS 0x3F8668 /end MEASUREMENT
/begin MEASUREMENT ccp_retry_cnt_nv "Download Retryzaehler" UWORD FORMULA_0010 0 0.0 0.0 65535.0 READ_WRITE ECU_ADDRESS 0x3F9276 /end MEASUREMENT
/begin MEASUREMENT crc32_data_carb_nv "Daten-CRC fuer Mode 9" ULONG FORMULA_0000 0 0.0 0.0 4294967295.0 READ_WRITE ECU_ADDRESS 0x3F9228 /end MEASUREMENT
/begin MEASUREMENT crc32_prog_carb_nv "Programm-CRC fuer Mode 9" ULONG FORMULA_0000 0 0.0 0.0 4294967295.0 READ_WRITE ECU_ADDRESS 0x3F9224 /end MEASUREMENT
/begin MEASUREMENT ed_css_st_ign_nv "CSS-Status der Funktionen" UBYTE FORMULA_0037 0 0.0 0.0 255.0 READ_WRITE ECU_ADDRESS 0x3F834A /end MEASUREMENT
/begin MEASUREMENT ed_css_st_ign_nv_auss "Aussetzer" UBYTE FORMULA_0038 0 0 0.0 255.0 READ_WRITE BIT_MASK 0x1 ECU_ADDRESS 0x3F834A /end MEASUREMENT
/begin MEASUREMENT ed_css_st_ign_nv_lls "Leerlaufsteller" UBYTE FORMULA_0041 0 0 0.0 255.0 READ_WRITE BIT_MASK 0x8 ECU_ADDRESS 0x3F834A /end MEASUREMENT
/begin MEASUREMENT ed_css_st_ign_nv_pwg "Pedalwertgeber" UBYTE FORMULA_0039 0 0 0.0 255.0 READ_WRITE BIT_MASK 0x2 ECU_ADDRESS 0x3F834A /end MEASUREMENT
/begin MEASUREMENT ed_css_st_ign_nv_tmot "Motortemperatur" UBYTE FORMULA_0040 0 0 0.0 255.0 READ_WRITE BIT_MASK 0x4 ECU_ADDRESS 0x3F834A /end MEASUREMENT
/begin MEASUREMENT ed_fsp_inj_fehlerzaehler_nv "Zaehler zum Fehlersortieren" UWORD FORMULA_0010 0 0.0 0.0 65535.0 READ_WRITE ECU_ADDRESS 0x3F8666 /end MEASUREMENT
/begin MEASUREMENT eeprom_anzahl_schreiben_nv "Anzahl der Schreibvorgaenge ins Flash" ULONG FORMULA_0449 0 0.0 0.0 4294967295.0 READ_WRITE ECU_ADDRESS 0x3F90FC /end MEASUREMENT
/begin MEASUREMENT eeprom_crc_nv "Standstabile Adaptionsdaten" ULONG FORMULA_0000 0 0.0 0.0 4294967295.0 READ_WRITE ECU_ADDRESS 0x3F9104 /end MEASUREMENT
/begin MEASUREMENT eeprom_crc_wichtig_nv "Lebensdauer Adaptionsdaten" ULONG FORMULA_0000 0 0.0 0.0 4294967295.0 READ_WRITE ECU_ADDRESS 0x3F90F8 /end MEASUREMENT
/begin MEASUREMENT eeprom_date "Erstelldatum beim Abspeichern" UBYTE FORMULA_0419 0 0.0 0.0 255.0 READ_WRITE ARRAY_SIZE 9 ECU_ADDRESS 0x3F910A MATRIX_DIM 9 1 1 /end MEASUREMENT
/begin MEASUREMENT eeprom_datenlaenge_nv "Anzahl der Datenbytes" UWORD FORMULA_0450 0 0.0 0.0 262140.0 READ_WRITE ECU_ADDRESS 0x3F9108 /end MEASUREMENT
/begin MEASUREMENT eeprom_datenlaenge_wichtig_nv "Anzahl der Datenbytes" UWORD FORMULA_0450 0 0.0 0.0 262140.0 READ_WRITE ECU_ADDRESS 0x3F9100 /end MEASUREMENT
/begin MEASUREMENT eeprom_time "Erstellzeit beim Abspeichern" UBYTE FORMULA_0419 0 0.0 0.0 255.0 READ_WRITE ARRAY_SIZE 6 ECU_ADDRESS 0x3F9113 MATRIX_DIM 6 1 1 /end MEASUREMENT
/begin MEASUREMENT eeprom_version_prog_nv "Programmversion beim Abspeichern" UWORD FORMULA_0451 0 0.0 0.0 65535.0 READ_WRITE ECU_ADDRESS 0x3F9102 /end MEASUREMENT
/begin MEASUREMENT egas_dk_ff_b1.abs "korr. U_WDK" SWORD FORMULA_0250 0 0.0 0.0 5.0 READ_WRITE ECU_ADDRESS 0x3F9E5A /end MEASUREMENT
/begin MEASUREMENT egas_dk_ff_b1.can_st "CAN-Status" UBYTE FORMULA_0117 0 0.0 0.0 255.0 READ_WRITE ECU_ADDRESS 0x3F9E68 /end MEASUREMENT
/begin MEASUREMENT egas_dk_ff_b1.fail_st "Failsafe-Status" UWORD FORMULA_0431 0 0.0 0.0 65535.0 READ_WRITE ECU_ADDRESS 0x3F9E5C /end MEASUREMENT
/begin MEASUREMENT egas_dk_ff_b1.ist "Istwert" SWORD FORMULA_0001 0 0.0 -10.0 120.0 READ_WRITE ECU_ADDRESS 0x3F9E56 /end MEASUREMENT
/begin MEASUREMENT egas_dk_ff_b1.mode "Mode" UBYTE FORMULA_0435 0 0.0 0.0 255.0 READ_WRITE ECU_ADDRESS 0x3F9E66 /end MEASUREMENT
/begin MEASUREMENT egas_dk_ff_b1.n "Drehzahl" SWORD FORMULA_0006 0 0.0 0.0 10000.0 READ_WRITE ECU_ADDRESS 0x3F9E4C /end MEASUREMENT
/begin MEASUREMENT egas_dk_ff_b1.r_adapt_st "Adaptionsstatus" UBYTE FORMULA_0434 0 0.0 0.0 255.0 READ_WRITE ECU_ADDRESS 0x3F9E64 /end MEASUREMENT
/begin MEASUREMENT egas_dk_ff_b1.r_diag_st "Diagnosestatus" UWORD FORMULA_0433 0 0.0 0.0 65535.0 READ_WRITE ECU_ADDRESS 0x3F9E62 /end MEASUREMENT
/begin MEASUREMENT egas_dk_ff_b1.r_mode "Mode" UBYTE FORMULA_0435 0 0.0 0.0 255.0 READ_WRITE ECU_ADDRESS 0x3F9E65 /end MEASUREMENT
/begin MEASUREMENT egas_dk_ff_b1.r_sollw "R-Sollwert" SWORD FORMULA_0001 0 0.0 -10.0 120.0 READ_WRITE ECU_ADDRESS 0x3F9E60 /end MEASUREMENT
/begin MEASUREMENT egas_dk_ff_b1.rf_aq "Fuellung vom AQ" SWORD FORMULA_0007 0 0.0 0.0 2.0 READ_WRITE ECU_ADDRESS 0x3F9E4E /end MEASUREMENT
/begin MEASUREMENT egas_dk_ff_b1.rf_hfm "Fuellung vom HFM" SWORD FORMULA_0007 0 0.0 0.0 2.0 READ_WRITE ECU_ADDRESS 0x3F9E50 /end MEASUREMENT
/begin MEASUREMENT egas_dk_ff_b1.soll "Sollwert" SWORD FORMULA_0001 0 0.0 -10.0 120.0 READ_WRITE ECU_ADDRESS 0x3F9E54 /end MEASUREMENT
/begin MEASUREMENT egas_dk_ff_b1.state "State" UBYTE FORMULA_0436 0 0.0 0.0 255.0 READ_WRITE ECU_ADDRESS 0x3F9E67 /end MEASUREMENT
/begin MEASUREMENT egas_dk_ff_b1.ub "Spannung" SWORD FORMULA_0008 0 0.0 0.0 28.0 READ_WRITE ECU_ADDRESS 0x3F9E52 /end MEASUREMENT
/begin MEASUREMENT egas_dk_ff_b1.wdk "Istwert" SWORD FORMULA_0001 0 0.0 -10.0 120.0 READ_WRITE ECU_ADDRESS 0x3F9E58 /end MEASUREMENT
/begin MEASUREMENT egas_dk_ff_b1.zust_sk "SK-Zustand der DK" UWORD FORMULA_0432 0 0.0 0.0 65535.0 READ_WRITE ECU_ADDRESS 0x3F9E5E /end MEASUREMENT
/begin MEASUREMENT egas_dk_ff_b2.abs "korr. U_WDK" SWORD FORMULA_0250 0 0.0 0.0 5.0 READ_WRITE ECU_ADDRESS 0x3F9E78 /end MEASUREMENT
/begin MEASUREMENT egas_dk_ff_b2.can_st "CAN-Status" UBYTE FORMULA_0117 0 0.0 0.0 255.0 READ_WRITE ECU_ADDRESS 0x3F9E86 /end MEASUREMENT
/begin MEASUREMENT egas_dk_ff_b2.fail_st "Failsafe-Status" UWORD FORMULA_0431 0 0.0 0.0 65535.0 READ_WRITE ECU_ADDRESS 0x3F9E7A /end MEASUREMENT
/begin MEASUREMENT egas_dk_ff_b2.ist "Istwert" SWORD FORMULA_0001 0 0.0 -10.0 120.0 READ_WRITE ECU_ADDRESS 0x3F9E74 /end MEASUREMENT
/begin MEASUREMENT egas_dk_ff_b2.mode "Mode" UBYTE FORMULA_0435 0 0.0 0.0 255.0 READ_WRITE ECU_ADDRESS 0x3F9E84 /end MEASUREMENT
/begin MEASUREMENT egas_dk_ff_b2.n "Drehzahl" SWORD FORMULA_0006 0 0.0 0.0 10000.0 READ_WRITE ECU_ADDRESS 0x3F9E6A /end MEASUREMENT
/begin MEASUREMENT egas_dk_ff_b2.r_adapt_st "Adaptionsstatus" UBYTE FORMULA_0434 0 0.0 0.0 255.0 READ_WRITE ECU_ADDRESS 0x3F9E82 /end MEASUREMENT
/begin MEASUREMENT egas_dk_ff_b2.r_diag_st "Diagnosestatus" UWORD FORMULA_0433 0 0.0 0.0 65535.0 READ_WRITE ECU_ADDRESS 0x3F9E80 /end MEASUREMENT
/begin MEASUREMENT egas_dk_ff_b2.r_mode "Mode" UBYTE FORMULA_0435 0 0.0 0.0 255.0 READ_WRITE ECU_ADDRESS 0x3F9E83 /end MEASUREMENT
/begin MEASUREMENT egas_dk_ff_b2.r_sollw "R-Sollwert" SWORD FORMULA_0001 0 0.0 -10.0 120.0 READ_WRITE ECU_ADDRESS 0x3F9E7E /end MEASUREMENT
/begin MEASUREMENT egas_dk_ff_b2.rf_aq "Fuellung vom AQ" SWORD FORMULA_0007 0 0.0 0.0 2.0 READ_WRITE ECU_ADDRESS 0x3F9E6C /end MEASUREMENT
/begin MEASUREMENT egas_dk_ff_b2.rf_hfm "Fuellung vom HFM" SWORD FORMULA_0007 0 0.0 0.0 2.0 READ_WRITE ECU_ADDRESS 0x3F9E6E /end MEASUREMENT
/begin MEASUREMENT egas_dk_ff_b2.soll "Sollwert" SWORD FORMULA_0001 0 0.0 -10.0 120.0 READ_WRITE ECU_ADDRESS 0x3F9E72 /end MEASUREMENT
/begin MEASUREMENT egas_dk_ff_b2.state "State" UBYTE FORMULA_0436 0 0.0 0.0 255.0 READ_WRITE ECU_ADDRESS 0x3F9E85 /end MEASUREMENT
/begin MEASUREMENT egas_dk_ff_b2.ub "Spannung" SWORD FORMULA_0008 0 0.0 0.0 28.0 READ_WRITE ECU_ADDRESS 0x3F9E70 /end MEASUREMENT
/begin MEASUREMENT egas_dk_ff_b2.wdk "Istwert" SWORD FORMULA_0001 0 0.0 -10.0 120.0 READ_WRITE ECU_ADDRESS 0x3F9E76 /end MEASUREMENT
/begin MEASUREMENT egas_dk_ff_b2.zust_sk "SK-Zustand der DK" UWORD FORMULA_0432 0 0.0 0.0 65535.0 READ_WRITE ECU_ADDRESS 0x3F9E7C /end MEASUREMENT
/begin MEASUREMENT egas_lls_ff_b1.can_st "CAN-Status" UBYTE FORMULA_0117 0 0.0 0.0 255.0 READ_WRITE ECU_ADDRESS 0x3F9E32 /end MEASUREMENT
/begin MEASUREMENT egas_lls_ff_b1.fail_st "Failsafe-Status" UWORD FORMULA_0431 0 0.0 0.0 65535.0 READ_WRITE ECU_ADDRESS 0x3F9E26 /end MEASUREMENT
/begin MEASUREMENT egas_lls_ff_b1.ist "Istwert" SWORD FORMULA_0001 0 0.0 -10.0 120.0 READ_WRITE ECU_ADDRESS 0x3F9E24 /end MEASUREMENT
/begin MEASUREMENT egas_lls_ff_b1.mode "Mode" UBYTE FORMULA_0435 0 0.0 0.0 255.0 READ_WRITE ECU_ADDRESS 0x3F9E30 /end MEASUREMENT
/begin MEASUREMENT egas_lls_ff_b1.n "Drehzahl" SWORD FORMULA_0006 0 0.0 0.0 10000.0 READ_WRITE ECU_ADDRESS 0x3F9E1C /end MEASUREMENT
/begin MEASUREMENT egas_lls_ff_b1.r_adapt_st "Adaptionsstatus" UBYTE FORMULA_0434 0 0.0 0.0 255.0 READ_WRITE ECU_ADDRESS 0x3F9E2E /end MEASUREMENT
/begin MEASUREMENT egas_lls_ff_b1.r_diag_st "Diagnosestatus" UWORD FORMULA_0433 0 0.0 0.0 65535.0 READ_WRITE ECU_ADDRESS 0x3F9E2C /end MEASUREMENT
/begin MEASUREMENT egas_lls_ff_b1.r_mode "Mode" UBYTE FORMULA_0435 0 0.0 0.0 255.0 READ_WRITE ECU_ADDRESS 0x3F9E2F /end MEASUREMENT
/begin MEASUREMENT egas_lls_ff_b1.r_sollw "R-Sollwert" SWORD FORMULA_0001 0 0.0 -10.0 120.0 READ_WRITE ECU_ADDRESS 0x3F9E2A /end MEASUREMENT
/begin MEASUREMENT egas_lls_ff_b1.rf "Fuellung" SWORD FORMULA_0007 0 0.0 0.0 2.0 READ_WRITE ECU_ADDRESS 0x3F9E1E /end MEASUREMENT
/begin MEASUREMENT egas_lls_ff_b1.soll "Sollwert" SWORD FORMULA_0001 0 0.0 -10.0 120.0 READ_WRITE ECU_ADDRESS 0x3F9E22 /end MEASUREMENT
/begin MEASUREMENT egas_lls_ff_b1.state "State" UBYTE FORMULA_0436 0 0.0 0.0 255.0 READ_WRITE ECU_ADDRESS 0x3F9E31 /end MEASUREMENT
/begin MEASUREMENT egas_lls_ff_b1.ub "Spannung" SWORD FORMULA_0008 0 0.0 0.0 28.0 READ_WRITE ECU_ADDRESS 0x3F9E20 /end MEASUREMENT
/begin MEASUREMENT egas_lls_ff_b1.zust_sk "SK-Zustand der DK" UWORD FORMULA_0432 0 0.0 0.0 65535.0 READ_WRITE ECU_ADDRESS 0x3F9E28 /end MEASUREMENT
/begin MEASUREMENT egas_lls_ff_b2.can_st "CAN-Status" UBYTE FORMULA_0117 0 0.0 0.0 255.0 READ_WRITE ECU_ADDRESS 0x3F9E4A /end MEASUREMENT
/begin MEASUREMENT egas_lls_ff_b2.fail_st "Failsafe-Status" UWORD FORMULA_0431 0 0.0 0.0 65535.0 READ_WRITE ECU_ADDRESS 0x3F9E3E /end MEASUREMENT
/begin MEASUREMENT egas_lls_ff_b2.ist "Istwert" SWORD FORMULA_0001 0 0.0 -10.0 120.0 READ_WRITE ECU_ADDRESS 0x3F9E3C /end MEASUREMENT
/begin MEASUREMENT egas_lls_ff_b2.mode "Mode" UBYTE FORMULA_0435 0 0.0 0.0 255.0 READ_WRITE ECU_ADDRESS 0x3F9E48 /end MEASUREMENT
/begin MEASUREMENT egas_lls_ff_b2.n "Drehzahl" SWORD FORMULA_0006 0 0.0 0.0 10000.0 READ_WRITE ECU_ADDRESS 0x3F9E34 /end MEASUREMENT
/begin MEASUREMENT egas_lls_ff_b2.r_adapt_st "Adaptionsstatus" UBYTE FORMULA_0434 0 0.0 0.0 255.0 READ_WRITE ECU_ADDRESS 0x3F9E46 /end MEASUREMENT
/begin MEASUREMENT egas_lls_ff_b2.r_diag_st "Diagnosestatus" UWORD FORMULA_0433 0 0.0 0.0 65535.0 READ_WRITE ECU_ADDRESS 0x3F9E44 /end MEASUREMENT
/begin MEASUREMENT egas_lls_ff_b2.r_mode "Mode" UBYTE FORMULA_0435 0 0.0 0.0 255.0 READ_WRITE ECU_ADDRESS 0x3F9E47 /end MEASUREMENT
/begin MEASUREMENT egas_lls_ff_b2.r_sollw "R-Sollwert" SWORD FORMULA_0001 0 0.0 -10.0 120.0 READ_WRITE ECU_ADDRESS 0x3F9E42 /end MEASUREMENT
/begin MEASUREMENT egas_lls_ff_b2.rf "Fuellung" SWORD FORMULA_0007 0 0.0 0.0 2.0 READ_WRITE ECU_ADDRESS 0x3F9E36 /end MEASUREMENT
/begin MEASUREMENT egas_lls_ff_b2.soll "Sollwert" SWORD FORMULA_0001 0 0.0 -10.0 120.0 READ_WRITE ECU_ADDRESS 0x3F9E3A /end MEASUREMENT
/begin MEASUREMENT egas_lls_ff_b2.state "State" UBYTE FORMULA_0436 0 0.0 0.0 255.0 READ_WRITE ECU_ADDRESS 0x3F9E49 /end MEASUREMENT
/begin MEASUREMENT egas_lls_ff_b2.ub "Spannung" SWORD FORMULA_0008 0 0.0 0.0 28.0 READ_WRITE ECU_ADDRESS 0x3F9E38 /end MEASUREMENT
/begin MEASUREMENT egas_lls_ff_b2.zust_sk "SK-Zustand der DK" UWORD FORMULA_0432 0 0.0 0.0 65535.0 READ_WRITE ECU_ADDRESS 0x3F9E40 /end MEASUREMENT
/begin MEASUREMENT egas_wdk_a0_b1 "WDK-Nullpunkt" SWORD FORMULA_0250 0 0.0 0.0 5.0 READ_WRITE ECU_ADDRESS 0x3F9D38 /end MEASUREMENT
/begin MEASUREMENT egas_wdk_a0_b2 "WDK-Nullpunkt" SWORD FORMULA_0250 0 0.0 0.0 5.0 READ_WRITE ECU_ADDRESS 0x3F9D3A /end MEASUREMENT
/begin MEASUREMENT elu_nl_nv "PWM-Signal der letzten ELU-Nachlaufanforderung" UBYTE FORMULA_0032 0 0.0 0.0 255.0 READ_WRITE ECU_ADDRESS 0x3F8670 /end MEASUREMENT
/begin MEASUREMENT fpga_lade_errors_nv "Anzahl fehlgeschlagener FPGA loads" UBYTE FORMULA_0423 0 0.0 0.0 255.0 READ_WRITE ECU_ADDRESS 0x3F9D4C /end MEASUREMENT
/begin MEASUREMENT fr_adapt "Bereichsadaption" UWORD FORMULA_0073 0 0.0 0.0 4.0 READ_WRITE ARRAY_SIZE 16 ECU_ADDRESS 0x3F9DCA MATRIX_DIM 16 1 1 /end MEASUREMENT
/begin MEASUREMENT fra_aq_adapt_roh_b1 "Adaptionswert" SWORD FORMULA_0424 0 0.0 -50.0 50.0 READ_WRITE ECU_ADDRESS 0x3F9D4E /end MEASUREMENT
/begin MEASUREMENT fra_aq_adapt_roh_b2 "Adaptionswert" SWORD FORMULA_0424 0 0.0 -50.0 50.0 READ_WRITE ECU_ADDRESS 0x3F9D50 /end MEASUREMENT
/begin MEASUREMENT fra_loli_w_bias_b1_nv "Lernwerte Bias fuer NN-FRA" FLOAT32_IEEE FORMULA_0044 0 0.0 -3.402823466385289e+038 3.402823466385289e+038 READ_WRITE ARRAY_SIZE 15 ECU_ADDRESS 0x3FA00C MATRIX_DIM 15 1 1 /end MEASUREMENT
/begin MEASUREMENT fra_loli_w_bias_b2_nv "Lernwerte Bias fuer NN-FRA" FLOAT32_IEEE FORMULA_0044 0 0.0 -3.402823466385289e+038 3.402823466385289e+038 READ_WRITE ARRAY_SIZE 15 ECU_ADDRESS 0x3FA048 MATRIX_DIM 15 1 1 /end MEASUREMENT
/begin MEASUREMENT fra_loli_w_n_b1_nv "Lernwerte n fuer NN-FRA" FLOAT32_IEEE FORMULA_0044 0 0.0 -3.402823466385289e+038 3.402823466385289e+038 READ_WRITE ARRAY_SIZE 15 ECU_ADDRESS 0x3FA084 MATRIX_DIM 15 1 1 /end MEASUREMENT
/begin MEASUREMENT fra_loli_w_n_b2_nv "Lernwerte n fuer NN-FRA" FLOAT32_IEEE FORMULA_0044 0 0.0 -3.402823466385289e+038 3.402823466385289e+038 READ_WRITE ARRAY_SIZE 15 ECU_ADDRESS 0x3FA0C0 MATRIX_DIM 15 1 1 /end MEASUREMENT
/begin MEASUREMENT fra_loli_w_rf_b1_nv "Lernwerte rf fuer NN-FRA" FLOAT32_IEEE FORMULA_0044 0 0.0 -3.402823466385289e+038 3.402823466385289e+038 READ_WRITE ARRAY_SIZE 15 ECU_ADDRESS 0x3FA0FC MATRIX_DIM 15 1 1 /end MEASUREMENT
/begin MEASUREMENT fra_loli_w_rf_b2_nv "Lernwerte rf fuer NN-FRA" FLOAT32_IEEE FORMULA_0044 0 0.0 -3.402823466385289e+038 3.402823466385289e+038 READ_WRITE ARRAY_SIZE 15 ECU_ADDRESS 0x3FA138 MATRIX_DIM 15 1 1 /end MEASUREMENT
/begin MEASUREMENT hdw_1_nv "HDW" ULONG FORMULA_0000 0 0.0 0.0 4294967295.0 READ_WRITE ECU_ADDRESS 0x3F911C /end MEASUREMENT
/begin MEASUREMENT hdw_2_nv "HDW" ULONG FORMULA_0000 0 0.0 0.0 4294967295.0 READ_WRITE ECU_ADDRESS 0x3F9120 /end MEASUREMENT
/begin MEASUREMENT hdw_3_nv "HDW" ULONG FORMULA_0000 0 0.0 0.0 4294967295.0 READ_WRITE ECU_ADDRESS 0x3F9124 /end MEASUREMENT
/begin MEASUREMENT ipk_sync_error_st_nv "IPK Sync Error im Hochlauf" UBYTE FORMULA_0005 0 0.0 0.0 255.0 READ_WRITE ECU_ADDRESS 0x3F9236 /end MEASUREMENT
/begin MEASUREMENT ipk_sync_errorcount_nv "Fehlerzaehler fuer Sync-Timeout" UBYTE FORMULA_0003 0 0.0 0.0 255.0 READ_WRITE ECU_ADDRESS 0x3F9235 /end MEASUREMENT
/begin MEASUREMENT ka_dtz_diag_cnt_nv_b1 "Zaehler Bereichsueberwachung von ka_dtz pro Bank." UBYTE FORMULA_0003 0 0.0 0.0 255.0 READ_WRITE ECU_ADDRESS 0x3F9D98 /end MEASUREMENT
/begin MEASUREMENT ka_dtz_diag_cnt_nv_b2 "Zaehler Bereichsueberwachung von ka_dtz pro Bank." UBYTE FORMULA_0003 0 0.0 0.0 255.0 READ_WRITE ECU_ADDRESS 0x3F9D99 /end MEASUREMENT
/begin MEASUREMENT ka_tz_diag_cnt_nv_b1 "Zaehler Bereichsueberwachung von ka_tz_nv pro Bank." UBYTE FORMULA_0003 0 0.0 0.0 255.0 READ_WRITE ECU_ADDRESS 0x3F9D96 /end MEASUREMENT
/begin MEASUREMENT ka_tz_diag_cnt_nv_b2 "Zaehler Bereichsueberwachung von ka_tz_nv pro Bank." UBYTE FORMULA_0003 0 0.0 0.0 255.0 READ_WRITE ECU_ADDRESS 0x3F9D97 /end MEASUREMENT
/begin MEASUREMENT ka_tz_nv_zyl1 "Klopfadaptionrueckziehwinkel." SLONG FORMULA_0225 0 0.0 -50.0 60.0 READ_WRITE ECU_ADDRESS 0x3F9D9C /end MEASUREMENT
/begin MEASUREMENT ka_tz_nv_zyl10 "Klopfadaptionrueckziehwinkel." SLONG FORMULA_0225 0 0.0 -50.0 60.0 READ_WRITE ECU_ADDRESS 0x3F9DC0 /end MEASUREMENT
/begin MEASUREMENT ka_tz_nv_zyl2 "Klopfadaptionrueckziehwinkel." SLONG FORMULA_0225 0 0.0 -50.0 60.0 READ_WRITE ECU_ADDRESS 0x3F9DA0 /end MEASUREMENT
/begin MEASUREMENT ka_tz_nv_zyl3 "Klopfadaptionrueckziehwinkel." SLONG FORMULA_0225 0 0.0 -50.0 60.0 READ_WRITE ECU_ADDRESS 0x3F9DA4 /end MEASUREMENT
/begin MEASUREMENT ka_tz_nv_zyl4 "Klopfadaptionrueckziehwinkel." SLONG FORMULA_0225 0 0.0 -50.0 60.0 READ_WRITE ECU_ADDRESS 0x3F9DA8 /end MEASUREMENT
/begin MEASUREMENT ka_tz_nv_zyl5 "Klopfadaptionrueckziehwinkel." SLONG FORMULA_0225 0 0.0 -50.0 60.0 READ_WRITE ECU_ADDRESS 0x3F9DAC /end MEASUREMENT
/begin MEASUREMENT ka_tz_nv_zyl6 "Klopfadaptionrueckziehwinkel." SLONG FORMULA_0225 0 0.0 -50.0 60.0 READ_WRITE ECU_ADDRESS 0x3F9DB0 /end MEASUREMENT
/begin MEASUREMENT ka_tz_nv_zyl7 "Klopfadaptionrueckziehwinkel." SLONG FORMULA_0225 0 0.0 -50.0 60.0 READ_WRITE ECU_ADDRESS 0x3F9DB4 /end MEASUREMENT
/begin MEASUREMENT ka_tz_nv_zyl8 "Klopfadaptionrueckziehwinkel." SLONG FORMULA_0225 0 0.0 -50.0 60.0 READ_WRITE ECU_ADDRESS 0x3F9DB8 /end MEASUREMENT
/begin MEASUREMENT ka_tz_nv_zyl9 "Klopfadaptionrueckziehwinkel." SLONG FORMULA_0225 0 0.0 -50.0 60.0 READ_WRITE ECU_ADDRESS 0x3F9DBC /end MEASUREMENT
/begin MEASUREMENT kat_obd_wert_gesamt_nv "Gesamtsystemdiagnosewert" UWORD FORMULA_0025 0 0.0 0.0 3.999000072479248 READ_WRITE ECU_ADDRESS 0x3F8662 /end MEASUREMENT
/begin MEASUREMENT kat_obd_wert_nv_b1 "gem., gewichtete Abweichung z. MW" UWORD FORMULA_0025 0 0.0 0.0 3.999000072479248 READ_WRITE ECU_ADDRESS 0x3F865E /end MEASUREMENT
/begin MEASUREMENT kat_obd_wert_nv_b2 "gem., gewichtete Abweichung z. MW" UWORD FORMULA_0025 0 0.0 0.0 3.999000072479248 READ_WRITE ECU_ADDRESS 0x3F8660 /end MEASUREMENT
/begin MEASUREMENT kr_dtz_diag_cnt_nv_b1 "Zaehler Bereichsueberwachung von kr_dtz pro Bank." UBYTE FORMULA_0003 0 0.0 0.0 255.0 READ_WRITE ECU_ADDRESS 0x3F9D94 /end MEASUREMENT
/begin MEASUREMENT kr_dtz_diag_cnt_nv_b2 "Zaehler Bereichsueberwachung von kr_dtz pro Bank." UBYTE FORMULA_0003 0 0.0 0.0 255.0 READ_WRITE ECU_ADDRESS 0x3F9D95 /end MEASUREMENT
/begin MEASUREMENT kwp_fetrawe_st "" UBYTE FORMULA_0026 0 0.0 0.0 255.0 READ_WRITE ECU_ADDRESS 0x3F8664 /end MEASUREMENT
/begin MEASUREMENT laa_f_ber_nv_b1 "Faktor-Lambdaadaption ohne TE" UWORD FORMULA_0024 0 0.0 0.0 1.998999953269959 READ_WRITE ECU_ADDRESS 0x3F865A /end MEASUREMENT
/begin MEASUREMENT laa_f_ber_nv_b2 "Faktor-Lambdaadaption ohne TE" UWORD FORMULA_0024 0 0.0 0.0 1.998999953269959 READ_WRITE ECU_ADDRESS 0x3F865C /end MEASUREMENT
/begin MEASUREMENT llr_ad_md_ac "Adaptionswert mit Klima" SWORD FORMULA_0009 0 0.0 -50.0 50.0 READ_WRITE ECU_ADDRESS 0x3F9DC6 /end MEASUREMENT
/begin MEASUREMENT llr_ad_md_norm "Adaptionswert" SWORD FORMULA_0009 0 0.0 -50.0 50.0 READ_WRITE ECU_ADDRESS 0x3F9DC4 /end MEASUREMENT
/begin MEASUREMENT md_ff.aq_abs_m "Oeffnung" UWORD FORMULA_0143 0 0.0 0.0 6500.0 READ_WRITE ECU_ADDRESS 0x3F9EA2 /end MEASUREMENT
/begin MEASUREMENT md_ff.eta_min "min. Eta" UWORD FORMULA_0437 0 0.0 0.0 150.0 READ_WRITE ECU_ADDRESS 0x3F9E9A /end MEASUREMENT
/begin MEASUREMENT md_ff.eta_ne "Eta-Ne" UWORD FORMULA_0437 0 0.0 0.0 150.0 READ_WRITE ECU_ADDRESS 0x3F9E9C /end MEASUREMENT
/begin MEASUREMENT md_ff.ind_wunsch_ml "ML-Wunschmoment" SWORD FORMULA_0009 0 0.0 -100.0 1000.0 READ_WRITE ECU_ADDRESS 0x3F9E92 /end MEASUREMENT
/begin MEASUREMENT md_ff.ind_wunsch_tz "TZ-Wunschmoment" SWORD FORMULA_0009 0 0.0 -100.0 1000.0 READ_WRITE ECU_ADDRESS 0x3F9E90 /end MEASUREMENT
/begin MEASUREMENT md_ff.kupp_ist "Istmoment" SWORD FORMULA_0009 0 0.0 -100.0 1000.0 READ_WRITE ECU_ADDRESS 0x3F9E94 /end MEASUREMENT
/begin MEASUREMENT md_ff.kupp_min_filter "min. Moment" SWORD FORMULA_0009 0 0.0 -100.0 1000.0 READ_WRITE ECU_ADDRESS 0x3F9E98 /end MEASUREMENT
/begin MEASUREMENT md_ff.kupp_wunsch_ges "Wunschmoment" SWORD FORMULA_0009 0 0.0 -100.0 1000.0 READ_WRITE ECU_ADDRESS 0x3F9E8A /end MEASUREMENT
/begin MEASUREMENT md_ff.kupp_wunsch_ml "ML-Wunschmoment" SWORD FORMULA_0009 0 0.0 -100.0 1000.0 READ_WRITE ECU_ADDRESS 0x3F9E8E /end MEASUREMENT
/begin MEASUREMENT md_ff.kupp_wunsch_tz "TZ-Wunschmoment" SWORD FORMULA_0009 0 0.0 -100.0 1000.0 READ_WRITE ECU_ADDRESS 0x3F9E8C /end MEASUREMENT
/begin MEASUREMENT md_ff.ml_st "Status Sollmoment-ML" UBYTE FORMULA_0440 0 0.0 0.0 255.0 READ_WRITE ECU_ADDRESS 0x3F9EA7 /end MEASUREMENT
/begin MEASUREMENT md_ff.n "Drehzzahl" SWORD FORMULA_0006 0 0.0 0.0 10000.0 READ_WRITE ECU_ADDRESS 0x3F9E88 /end MEASUREMENT
/begin MEASUREMENT md_ff.pwg_soll "min. Moment" SWORD FORMULA_0001 0 0.0 -10.0 120.0 READ_WRITE ECU_ADDRESS 0x3F9E96 /end MEASUREMENT
/begin MEASUREMENT md_ff.rf_m "Sollfuellung" SWORD FORMULA_0007 0 0.0 0.0 2.0 READ_WRITE ECU_ADDRESS 0x3F9EA0 /end MEASUREMENT
/begin MEASUREMENT md_ff.rf_soll "Sollfuellung" SWORD FORMULA_0007 0 0.0 0.0 2.0 READ_WRITE ECU_ADDRESS 0x3F9E9E /end MEASUREMENT
/begin MEASUREMENT md_ff.s_bls "Bremse" UBYTE FORMULA_0439 0 0.0 0.0 255.0 READ_WRITE ECU_ADDRESS 0x3F9EA5 /end MEASUREMENT
/begin MEASUREMENT md_ff.sk_fehler "SK-Fehlerinfo" UBYTE FORMULA_0438 0 0.0 0.0 255.0 READ_WRITE ECU_ADDRESS 0x3F9EA4 /end MEASUREMENT
/begin MEASUREMENT md_ff.ti_tpu_st "Einspritzung" UWORD FORMULA_0010 0 0.0 0.0 65535.0 READ_WRITE ECU_ADDRESS 0x3F9EA8 /end MEASUREMENT
/begin MEASUREMENT md_ff.tz_st "Status Sollmoment-TZ" UBYTE FORMULA_0440 0 0.0 0.0 255.0 READ_WRITE ECU_ADDRESS 0x3F9EA6 /end MEASUREMENT
/begin MEASUREMENT md_ff_e2.eta_zw_ne "Eta aus Ebene 1" UWORD FORMULA_0437 0 0.0 0.0 150.0 READ_WRITE ECU_ADDRESS 0x3F9FAC /end MEASUREMENT
/begin MEASUREMENT md_ff_e2.eta_zw_ne_e2 "Eta aus Ebene 2" UWORD FORMULA_0437 0 0.0 0.0 150.0 READ_WRITE ECU_ADDRESS 0x3F9FAA /end MEASUREMENT
/begin MEASUREMENT md_ff_e2.fw_rel "Rel. Fahrerwunsch" SWORD FORMULA_0001 0 0.0 -10.0 120.0 READ_WRITE ECU_ADDRESS 0x3F9F90 /end MEASUREMENT
/begin MEASUREMENT md_ff_e2.fw_rel_diff "Rel. Fahrerwunsch - Differenz" SWORD FORMULA_0001 0 0.0 -10.0 120.0 READ_WRITE ECU_ADDRESS 0x3F9F92 /end MEASUREMENT
/begin MEASUREMENT md_ff_e2.ind_opt "ind. Optimal" SWORD FORMULA_0009 0 0.0 -100.0 1000.0 READ_WRITE ECU_ADDRESS 0x3F9FA6 /end MEASUREMENT
/begin MEASUREMENT md_ff_e2.ind_opt_diff "ind. Optimal - Differenz" SWORD FORMULA_0009 0 0.0 -100.0 1000.0 READ_WRITE ECU_ADDRESS 0x3F9FA8 /end MEASUREMENT
/begin MEASUREMENT md_ff_e2.kupp_ist "Istmoment" SWORD FORMULA_0009 0 0.0 -100.0 1000.0 READ_WRITE ECU_ADDRESS 0x3F9FA4 /end MEASUREMENT
/begin MEASUREMENT md_ff_e2.kupp_max "Maximalmoment" SWORD FORMULA_0009 0 0.0 -100.0 1000.0 READ_WRITE ECU_ADDRESS 0x3F9F94 /end MEASUREMENT
/begin MEASUREMENT md_ff_e2.kupp_max_diff "Maximalmoment - Differenz" SWORD FORMULA_0009 0 0.0 -100.0 1000.0 READ_WRITE ECU_ADDRESS 0x3F9F96 /end MEASUREMENT
/begin MEASUREMENT md_ff_e2.kupp_min "Minimalmoment" SWORD FORMULA_0009 0 0.0 -100.0 1000.0 READ_WRITE ECU_ADDRESS 0x3F9F98 /end MEASUREMENT
/begin MEASUREMENT md_ff_e2.kupp_min_diff "Minimalmoment - Differenz" SWORD FORMULA_0009 0 0.0 -100.0 1000.0 READ_WRITE ECU_ADDRESS 0x3F9F9A /end MEASUREMENT
/begin MEASUREMENT md_ff_e2.kupp_soll "Sollmoment" SWORD FORMULA_0009 0 0.0 -100.0 1000.0 READ_WRITE ECU_ADDRESS 0x3F9FA2 /end MEASUREMENT
/begin MEASUREMENT md_ff_e2.kupp_wunsch "Wunschmoment (Fahrer, FGR)" SWORD FORMULA_0009 0 0.0 -100.0 1000.0 READ_WRITE ECU_ADDRESS 0x3F9FA0 /end MEASUREMENT
/begin MEASUREMENT md_ff_e2.n "Drehzzahl" SWORD FORMULA_0006 0 0.0 0.0 10000.0 READ_WRITE ECU_ADDRESS 0x3F9F88 /end MEASUREMENT
/begin MEASUREMENT md_ff_e2.rf_m "Fuellung" SWORD FORMULA_0007 0 0.0 0.0 2.0 READ_WRITE ECU_ADDRESS 0x3F9F8A /end MEASUREMENT
/begin MEASUREMENT md_ff_e2.rf_pt_korr "Fuellungskorrektur" UWORD FORMULA_0073 0 0.0 0.0 4.0 READ_WRITE ECU_ADDRESS 0x3F9F8C /end MEASUREMENT
/begin MEASUREMENT md_ff_e2.schlepp "Schleppmoment" SWORD FORMULA_0009 0 0.0 -100.0 1000.0 READ_WRITE ECU_ADDRESS 0x3F9F9C /end MEASUREMENT
/begin MEASUREMENT md_ff_e2.schlepp_diff "Schleppmoment - Differenz" SWORD FORMULA_0009 0 0.0 -100.0 1000.0 READ_WRITE ECU_ADDRESS 0x3F9F9E /end MEASUREMENT
/begin MEASUREMENT md_ff_e2.ti_tpu_st "Ausblendstatus" UWORD FORMULA_0010 0 0.0 0.0 65535.0 READ_WRITE ECU_ADDRESS 0x3F9FAE /end MEASUREMENT
/begin MEASUREMENT md_ff_e2.toel "Oeltemperatur" SWORD FORMULA_0023 0 0.0 -50.0 170.0 READ_WRITE ECU_ADDRESS 0x3F9F8E /end MEASUREMENT
/begin MEASUREMENT md_off_1of3_.aq_abs_b1 "Oeffnung B1" UWORD FORMULA_0143 0 0.0 0.0 6500.0 READ_WRITE ECU_ADDRESS 0x3F9F02 /end MEASUREMENT
/begin MEASUREMENT md_off_1of3_.aq_abs_b2 "Oeffnung B2" UWORD FORMULA_0143 0 0.0 0.0 6500.0 READ_WRITE ECU_ADDRESS 0x3F9F04 /end MEASUREMENT
/begin MEASUREMENT md_off_1of3_.gang "Gang" SBYTE FORMULA_0135 0 0.0 -1.0 10.0 READ_WRITE ECU_ADDRESS 0x3F9F0F /end MEASUREMENT
/begin MEASUREMENT md_off_1of3_.ind_schlepp "Schleppmoment" SWORD FORMULA_0009 0 0.0 -100.0 1000.0 READ_WRITE ECU_ADDRESS 0x3F9EE2 /end MEASUREMENT
/begin MEASUREMENT md_off_1of3_.ind_wunsch_ml_komp "ML-Wunschmoment" SWORD FORMULA_0009 0 0.0 -100.0 1000.0 READ_WRITE ECU_ADDRESS 0x3F9EE4 /end MEASUREMENT
/begin MEASUREMENT md_off_1of3_.kupp_ist "Istmoment" SWORD FORMULA_0009 0 0.0 -100.0 1000.0 READ_WRITE ECU_ADDRESS 0x3F9EE6 /end MEASUREMENT
/begin MEASUREMENT md_off_1of3_.kupp_min_filter "min. Moment" SWORD FORMULA_0009 0 0.0 -100.0 1000.0 READ_WRITE ECU_ADDRESS 0x3F9EEA /end MEASUREMENT
/begin MEASUREMENT md_off_1of3_.kupp_wunsch "Wunschmoment" SWORD FORMULA_0009 0 0.0 -100.0 1000.0 READ_WRITE ECU_ADDRESS 0x3F9EDA /end MEASUREMENT
/begin MEASUREMENT md_off_1of3_.kupp_wunsch_ges "Wunschmoment" SWORD FORMULA_0009 0 0.0 -100.0 1000.0 READ_WRITE ECU_ADDRESS 0x3F9EDC /end MEASUREMENT
/begin MEASUREMENT md_off_1of3_.kupp_wunsch_ml "ML-Wunschmoment" SWORD FORMULA_0009 0 0.0 -100.0 1000.0 READ_WRITE ECU_ADDRESS 0x3F9EE0 /end MEASUREMENT
/begin MEASUREMENT md_off_1of3_.kupp_wunsch_tz "TZ-Wunschmoment" SWORD FORMULA_0009 0 0.0 -100.0 1000.0 READ_WRITE ECU_ADDRESS 0x3F9EDE /end MEASUREMENT
/begin MEASUREMENT md_off_1of3_.lam_ist_b1 "Lambdaist B1" UWORD FORMULA_0025 0 0.0 0.0 3.999000072479248 READ_WRITE ECU_ADDRESS 0x3F9F06 /end MEASUREMENT
/begin MEASUREMENT md_off_1of3_.lam_ist_b2 "Lambdaist B2" UWORD FORMULA_0025 0 0.0 0.0 3.999000072479248 READ_WRITE ECU_ADDRESS 0x3F9F08 /end MEASUREMENT
/begin MEASUREMENT md_off_1of3_.ml_st "Status Sollmoment-ML" UBYTE FORMULA_0440 0 0.0 0.0 255.0 READ_WRITE ECU_ADDRESS 0x3F9F0E /end MEASUREMENT
/begin MEASUREMENT md_off_1of3_.n "Drehzzahl" SWORD FORMULA_0006 0 0.0 0.0 10000.0 READ_WRITE ECU_ADDRESS 0x3F9ED8 /end MEASUREMENT
/begin MEASUREMENT md_off_1of3_.pks_rel "rel. Kraftstoffdruck" SWORD FORMULA_0110 0 0.0 0.0 10.0 READ_WRITE ECU_ADDRESS 0x3F9EF0 /end MEASUREMENT
/begin MEASUREMENT md_off_1of3_.pos_kupp_ist "Debug" UBYTE FORMULA_0443 0 0.0 0.0 1020.0 READ_WRITE ECU_ADDRESS 0x3F9F0A /end MEASUREMENT
/begin MEASUREMENT md_off_1of3_.pwg_soll "min. Moment" SWORD FORMULA_0001 0 0.0 -10.0 120.0 READ_WRITE ECU_ADDRESS 0x3F9EE8 /end MEASUREMENT
/begin MEASUREMENT md_off_1of3_.rf_m "Sollfuellung" SWORD FORMULA_0007 0 0.0 0.0 2.0 READ_WRITE ECU_ADDRESS 0x3F9EEE /end MEASUREMENT
/begin MEASUREMENT md_off_1of3_.rf_soll "Sollfuellung" SWORD FORMULA_0006 0 0.0 0.0 10000.0 READ_WRITE ECU_ADDRESS 0x3F9EEC /end MEASUREMENT
/begin MEASUREMENT md_off_1of3_.s_bls "Bremse/HBR/Kraftschluss" UBYTE FORMULA_0439 0 0.0 0.0 255.0 READ_WRITE ECU_ADDRESS 0x3F9F0C /end MEASUREMENT
/begin MEASUREMENT md_off_1of3_.smg_st "Debug" UBYTE FORMULA_0003 0 0.0 0.0 255.0 READ_WRITE ECU_ADDRESS 0x3F9F0B /end MEASUREMENT
/begin MEASUREMENT md_off_1of3_.te_tv "auszugebendes TE-Tastverhaeltnis" UWORD FORMULA_0107 0 0.0 0.0 100.0 READ_WRITE ECU_ADDRESS 0x3F9F00 /end MEASUREMENT
/begin MEASUREMENT md_off_1of3_.ti_mks_soll1 "Time" UWORD FORMULA_0111 0 0.0 0.0 1023.984313964844 READ_WRITE ECU_ADDRESS 0x3F9EF8 /end MEASUREMENT
/begin MEASUREMENT md_off_1of3_.ti_out1 "Ausgegebene Einspritzzeit im letzten Arbeitsspiel." ULONG FORMULA_0363 0 0.0 4194.303 0.0 READ_WRITE ECU_ADDRESS 0x3F9EFC /end MEASUREMENT
/begin MEASUREMENT md_off_1of3_.ti_tpu_st "Einspritzung" UWORD FORMULA_0010 0 0.0 0.0 65535.0 READ_WRITE ECU_ADDRESS 0x3F9EF2 /end MEASUREMENT
/begin MEASUREMENT md_off_1of3_.time_ml "Time" UWORD FORMULA_0021 0 0.0 0.0 655.0 READ_WRITE ECU_ADDRESS 0x3F9EF4 /end MEASUREMENT
/begin MEASUREMENT md_off_1of3_.tz_st "Status Sollmoment-TZ" UBYTE FORMULA_0440 0 0.0 0.0 255.0 READ_WRITE ECU_ADDRESS 0x3F9F0D /end MEASUREMENT
/begin MEASUREMENT md_off_1of3_.tz1 "Time" SWORD FORMULA_0102 0 0.0 -50.0 60.0 READ_WRITE ECU_ADDRESS 0x3F9EFA /end MEASUREMENT
/begin MEASUREMENT md_off_1of3_.zust_motor "Betriebszustand der Motorsteuerung" UWORD FORMULA_0019 0 0.0 0.0 65535.0 READ_WRITE ECU_ADDRESS 0x3F9EF6 /end MEASUREMENT
/begin MEASUREMENT md_off_2of3_.aq_abs_b1 "Oeffnung B1" UWORD FORMULA_0143 0 0.0 0.0 6500.0 READ_WRITE ECU_ADDRESS 0x3F9F3A /end MEASUREMENT
/begin MEASUREMENT md_off_2of3_.aq_abs_b2 "Oeffnung B2" UWORD FORMULA_0143 0 0.0 0.0 6500.0 READ_WRITE ECU_ADDRESS 0x3F9F3C /end MEASUREMENT
/begin MEASUREMENT md_off_2of3_.gang "Gang" SBYTE FORMULA_0135 0 0.0 -1.0 10.0 READ_WRITE ECU_ADDRESS 0x3F9F47 /end MEASUREMENT
/begin MEASUREMENT md_off_2of3_.ind_schlepp "Schleppmoment" SWORD FORMULA_0009 0 0.0 -100.0 1000.0 READ_WRITE ECU_ADDRESS 0x3F9F1A /end MEASUREMENT
/begin MEASUREMENT md_off_2of3_.ind_wunsch_ml_komp "ML-Wunschmoment" SWORD FORMULA_0009 0 0.0 -100.0 1000.0 READ_WRITE ECU_ADDRESS 0x3F9F1C /end MEASUREMENT
/begin MEASUREMENT md_off_2of3_.kupp_ist "Istmoment" SWORD FORMULA_0009 0 0.0 -100.0 1000.0 READ_WRITE ECU_ADDRESS 0x3F9F1E /end MEASUREMENT
/begin MEASUREMENT md_off_2of3_.kupp_min_filter "min. Moment" SWORD FORMULA_0009 0 0.0 -100.0 1000.0 READ_WRITE ECU_ADDRESS 0x3F9F22 /end MEASUREMENT
/begin MEASUREMENT md_off_2of3_.kupp_wunsch "Wunschmoment" SWORD FORMULA_0009 0 0.0 -100.0 1000.0 READ_WRITE ECU_ADDRESS 0x3F9F12 /end MEASUREMENT
/begin MEASUREMENT md_off_2of3_.kupp_wunsch_ges "Wunschmoment" SWORD FORMULA_0009 0 0.0 -100.0 1000.0 READ_WRITE ECU_ADDRESS 0x3F9F14 /end MEASUREMENT
/begin MEASUREMENT md_off_2of3_.kupp_wunsch_ml "ML-Wunschmoment" SWORD FORMULA_0009 0 0.0 -100.0 1000.0 READ_WRITE ECU_ADDRESS 0x3F9F18 /end MEASUREMENT
/begin MEASUREMENT md_off_2of3_.kupp_wunsch_tz "TZ-Wunschmoment" SWORD FORMULA_0009 0 0.0 -100.0 1000.0 READ_WRITE ECU_ADDRESS 0x3F9F16 /end MEASUREMENT
/begin MEASUREMENT md_off_2of3_.lam_ist_b1 "Lambdaist B1" UWORD FORMULA_0025 0 0.0 0.0 3.999000072479248 READ_WRITE ECU_ADDRESS 0x3F9F3E /end MEASUREMENT
/begin MEASUREMENT md_off_2of3_.lam_ist_b2 "Lambdaist B2" UWORD FORMULA_0025 0 0.0 0.0 3.999000072479248 READ_WRITE ECU_ADDRESS 0x3F9F40 /end MEASUREMENT
/begin MEASUREMENT md_off_2of3_.ml_st "Status Sollmoment-ML" UBYTE FORMULA_0440 0 0.0 0.0 255.0 READ_WRITE ECU_ADDRESS 0x3F9F46 /end MEASUREMENT
/begin MEASUREMENT md_off_2of3_.n "Drehzzahl" SWORD FORMULA_0006 0 0.0 0.0 10000.0 READ_WRITE ECU_ADDRESS 0x3F9F10 /end MEASUREMENT
/begin MEASUREMENT md_off_2of3_.pks_rel "rel. Kraftstoffdruck" SWORD FORMULA_0110 0 0.0 0.0 10.0 READ_WRITE ECU_ADDRESS 0x3F9F28 /end MEASUREMENT
/begin MEASUREMENT md_off_2of3_.pos_kupp_ist "Debug" UBYTE FORMULA_0443 0 0.0 0.0 1020.0 READ_WRITE ECU_ADDRESS 0x3F9F42 /end MEASUREMENT
/begin MEASUREMENT md_off_2of3_.pwg_soll "min. Moment" SWORD FORMULA_0001 0 0.0 -10.0 120.0 READ_WRITE ECU_ADDRESS 0x3F9F20 /end MEASUREMENT
/begin MEASUREMENT md_off_2of3_.rf_m "Sollfuellung" SWORD FORMULA_0007 0 0.0 0.0 2.0 READ_WRITE ECU_ADDRESS 0x3F9F26 /end MEASUREMENT
/begin MEASUREMENT md_off_2of3_.rf_soll "Sollfuellung" SWORD FORMULA_0006 0 0.0 0.0 10000.0 READ_WRITE ECU_ADDRESS 0x3F9F24 /end MEASUREMENT
/begin MEASUREMENT md_off_2of3_.s_bls "Bremse/HBR/Kraftschluss" UBYTE FORMULA_0439 0 0.0 0.0 255.0 READ_WRITE ECU_ADDRESS 0x3F9F44 /end MEASUREMENT
/begin MEASUREMENT md_off_2of3_.smg_st "Debug" UBYTE FORMULA_0003 0 0.0 0.0 255.0 READ_WRITE ECU_ADDRESS 0x3F9F43 /end MEASUREMENT
/begin MEASUREMENT md_off_2of3_.te_tv "auszugebendes TE-Tastverhaeltnis" UWORD FORMULA_0107 0 0.0 0.0 100.0 READ_WRITE ECU_ADDRESS 0x3F9F38 /end MEASUREMENT
/begin MEASUREMENT md_off_2of3_.ti_mks_soll1 "Time" UWORD FORMULA_0111 0 0.0 0.0 1023.984313964844 READ_WRITE ECU_ADDRESS 0x3F9F30 /end MEASUREMENT
/begin MEASUREMENT md_off_2of3_.ti_out1 "Ausgegebene Einspritzzeit im letzten Arbeitsspiel." ULONG FORMULA_0363 0 0.0 4194.303 0.0 READ_WRITE ECU_ADDRESS 0x3F9F34 /end MEASUREMENT
/begin MEASUREMENT md_off_2of3_.ti_tpu_st "Einspritzung" UWORD FORMULA_0010 0 0.0 0.0 65535.0 READ_WRITE ECU_ADDRESS 0x3F9F2A /end MEASUREMENT
/begin MEASUREMENT md_off_2of3_.time_ml "Time" UWORD FORMULA_0021 0 0.0 0.0 655.0 READ_WRITE ECU_ADDRESS 0x3F9F2C /end MEASUREMENT
/begin MEASUREMENT md_off_2of3_.tz_st "Status Sollmoment-TZ" UBYTE FORMULA_0440 0 0.0 0.0 255.0 READ_WRITE ECU_ADDRESS 0x3F9F45 /end MEASUREMENT
/begin MEASUREMENT md_off_2of3_.tz1 "Time" SWORD FORMULA_0102 0 0.0 -50.0 60.0 READ_WRITE ECU_ADDRESS 0x3F9F32 /end MEASUREMENT
/begin MEASUREMENT md_off_2of3_.zust_motor "Betriebszustand der Motorsteuerung" UWORD FORMULA_0019 0 0.0 0.0 65535.0 READ_WRITE ECU_ADDRESS 0x3F9F2E /end MEASUREMENT
/begin MEASUREMENT md_off_3of3_.aq_abs_b1 "Oeffnung B1" UWORD FORMULA_0143 0 0.0 0.0 6500.0 READ_WRITE ECU_ADDRESS 0x3F9F72 /end MEASUREMENT
/begin MEASUREMENT md_off_3of3_.aq_abs_b2 "Oeffnung B2" UWORD FORMULA_0143 0 0.0 0.0 6500.0 READ_WRITE ECU_ADDRESS 0x3F9F74 /end MEASUREMENT
/begin MEASUREMENT md_off_3of3_.gang "Gang" SBYTE FORMULA_0135 0 0.0 -1.0 10.0 READ_WRITE ECU_ADDRESS 0x3F9F7F /end MEASUREMENT
/begin MEASUREMENT md_off_3of3_.ind_schlepp "Schleppmoment" SWORD FORMULA_0009 0 0.0 -100.0 1000.0 READ_WRITE ECU_ADDRESS 0x3F9F52 /end MEASUREMENT
/begin MEASUREMENT md_off_3of3_.ind_wunsch_ml_komp "ML-Wunschmoment" SWORD FORMULA_0009 0 0.0 -100.0 1000.0 READ_WRITE ECU_ADDRESS 0x3F9F54 /end MEASUREMENT
/begin MEASUREMENT md_off_3of3_.kupp_ist "Istmoment" SWORD FORMULA_0009 0 0.0 -100.0 1000.0 READ_WRITE ECU_ADDRESS 0x3F9F56 /end MEASUREMENT
/begin MEASUREMENT md_off_3of3_.kupp_min_filter "min. Moment" SWORD FORMULA_0009 0 0.0 -100.0 1000.0 READ_WRITE ECU_ADDRESS 0x3F9F5A /end MEASUREMENT
/begin MEASUREMENT md_off_3of3_.kupp_wunsch "Wunschmoment" SWORD FORMULA_0009 0 0.0 -100.0 1000.0 READ_WRITE ECU_ADDRESS 0x3F9F4A /end MEASUREMENT
/begin MEASUREMENT md_off_3of3_.kupp_wunsch_ges "Wunschmoment" SWORD FORMULA_0009 0 0.0 -100.0 1000.0 READ_WRITE ECU_ADDRESS 0x3F9F4C /end MEASUREMENT
/begin MEASUREMENT md_off_3of3_.kupp_wunsch_ml "ML-Wunschmoment" SWORD FORMULA_0009 0 0.0 -100.0 1000.0 READ_WRITE ECU_ADDRESS 0x3F9F50 /end MEASUREMENT
/begin MEASUREMENT md_off_3of3_.kupp_wunsch_tz "TZ-Wunschmoment" SWORD FORMULA_0009 0 0.0 -100.0 1000.0 READ_WRITE ECU_ADDRESS 0x3F9F4E /end MEASUREMENT
/begin MEASUREMENT md_off_3of3_.lam_ist_b1 "Lambdaist B1" UWORD FORMULA_0025 0 0.0 0.0 3.999000072479248 READ_WRITE ECU_ADDRESS 0x3F9F76 /end MEASUREMENT
/begin MEASUREMENT md_off_3of3_.lam_ist_b2 "Lambdaist B2" UWORD FORMULA_0025 0 0.0 0.0 3.999000072479248 READ_WRITE ECU_ADDRESS 0x3F9F78 /end MEASUREMENT
/begin MEASUREMENT md_off_3of3_.ml_st "Status Sollmoment-ML" UBYTE FORMULA_0440 0 0.0 0.0 255.0 READ_WRITE ECU_ADDRESS 0x3F9F7E /end MEASUREMENT
/begin MEASUREMENT md_off_3of3_.n "Drehzzahl" SWORD FORMULA_0006 0 0.0 0.0 10000.0 READ_WRITE ECU_ADDRESS 0x3F9F48 /end MEASUREMENT
/begin MEASUREMENT md_off_3of3_.pks_rel "rel. Kraftstoffdruck" SWORD FORMULA_0110 0 0.0 0.0 10.0 READ_WRITE ECU_ADDRESS 0x3F9F60 /end MEASUREMENT
/begin MEASUREMENT md_off_3of3_.pos_kupp_ist "Debug" UBYTE FORMULA_0443 0 0.0 0.0 1020.0 READ_WRITE ECU_ADDRESS 0x3F9F7A /end MEASUREMENT
/begin MEASUREMENT md_off_3of3_.pwg_soll "min. Moment" SWORD FORMULA_0001 0 0.0 -10.0 120.0 READ_WRITE ECU_ADDRESS 0x3F9F58 /end MEASUREMENT
/begin MEASUREMENT md_off_3of3_.rf_m "Sollfuellung" SWORD FORMULA_0007 0 0.0 0.0 2.0 READ_WRITE ECU_ADDRESS 0x3F9F5E /end MEASUREMENT
/begin MEASUREMENT md_off_3of3_.rf_soll "Sollfuellung" SWORD FORMULA_0006 0 0.0 0.0 10000.0 READ_WRITE ECU_ADDRESS 0x3F9F5C /end MEASUREMENT
/begin MEASUREMENT md_off_3of3_.s_bls "Bremse/HBR/Kraftschluss" UBYTE FORMULA_0439 0 0.0 0.0 255.0 READ_WRITE ECU_ADDRESS 0x3F9F7C /end MEASUREMENT
/begin MEASUREMENT md_off_3of3_.smg_st "Debug" UBYTE FORMULA_0003 0 0.0 0.0 255.0 READ_WRITE ECU_ADDRESS 0x3F9F7B /end MEASUREMENT
/begin MEASUREMENT md_off_3of3_.te_tv "auszugebendes TE-Tastverhaeltnis" UWORD FORMULA_0107 0 0.0 0.0 100.0 READ_WRITE ECU_ADDRESS 0x3F9F70 /end MEASUREMENT
/begin MEASUREMENT md_off_3of3_.ti_mks_soll1 "Time" UWORD FORMULA_0111 0 0.0 0.0 1023.984313964844 READ_WRITE ECU_ADDRESS 0x3F9F68 /end MEASUREMENT
/begin MEASUREMENT md_off_3of3_.ti_out1 "Ausgegebene Einspritzzeit im letzten Arbeitsspiel." ULONG FORMULA_0363 0 0.0 4194.303 0.0 READ_WRITE ECU_ADDRESS 0x3F9F6C /end MEASUREMENT
/begin MEASUREMENT md_off_3of3_.ti_tpu_st "Einspritzung" UWORD FORMULA_0010 0 0.0 0.0 65535.0 READ_WRITE ECU_ADDRESS 0x3F9F62 /end MEASUREMENT
/begin MEASUREMENT md_off_3of3_.time_ml "Time" UWORD FORMULA_0021 0 0.0 0.0 655.0 READ_WRITE ECU_ADDRESS 0x3F9F64 /end MEASUREMENT
/begin MEASUREMENT md_off_3of3_.tz_st "Status Sollmoment-TZ" UBYTE FORMULA_0440 0 0.0 0.0 255.0 READ_WRITE ECU_ADDRESS 0x3F9F7D /end MEASUREMENT
/begin MEASUREMENT md_off_3of3_.tz1 "Time" SWORD FORMULA_0102 0 0.0 -50.0 60.0 READ_WRITE ECU_ADDRESS 0x3F9F6A /end MEASUREMENT
/begin MEASUREMENT md_off_3of3_.zust_motor "Betriebszustand der Motorsteuerung" UWORD FORMULA_0019 0 0.0 0.0 65535.0 READ_WRITE ECU_ADDRESS 0x3F9F66 /end MEASUREMENT
/begin MEASUREMENT md_off_st "Debug" UBYTE FORMULA_0003 0 0.0 0.0 255.0 READ_WRITE ECU_ADDRESS 0x3F9F80 /end MEASUREMENT
/begin MEASUREMENT md_sk_timer_0_nv "SK-Timer bei pwg=0 - NV" UWORD FORMULA_0021 0 0.0 0.0 655.0 READ_WRITE ECU_ADDRESS 0x3F9F82 /end MEASUREMENT
/begin MEASUREMENT md_sk_timer_1_nv "SK-Timer bei pwg>0 - NV" UWORD FORMULA_0021 0 0.0 0.0 655.0 READ_WRITE ECU_ADDRESS 0x3F9F84 /end MEASUREMENT
/begin MEASUREMENT md_sk_vergl_diff_nv "Soll-/Istabweichung - NV" SWORD FORMULA_0009 0 0.0 -100.0 1000.0 READ_WRITE ECU_ADDRESS 0x3F9F86 /end MEASUREMENT
/begin MEASUREMENT os_err_ff.addr_0 "Adresse wo letzte Exception her kam" ULONG FORMULA_0000 0 0.0 0.0 4294967295.0 READ_WRITE ECU_ADDRESS 0x3F92AC /end MEASUREMENT
/begin MEASUREMENT os_err_ff.addr_1 "Adresse wo letzte Exception her kam" ULONG FORMULA_0000 0 0.0 0.0 4294967295.0 READ_WRITE ECU_ADDRESS 0x3F92B0 /end MEASUREMENT
/begin MEASUREMENT os_err_ff.addr_2 "Adresse wo letzte Exception her kam" ULONG FORMULA_0000 0 0.0 0.0 4294967295.0 READ_WRITE ECU_ADDRESS 0x3F92B4 /end MEASUREMENT
/begin MEASUREMENT os_err_ff.addr_3 "Adresse wo letzte Exception her kam" ULONG FORMULA_0000 0 0.0 0.0 4294967295.0 READ_WRITE ECU_ADDRESS 0x3F92B8 /end MEASUREMENT
/begin MEASUREMENT os_err_ff.addr_4 "Adresse wo letzte Exception her kam" ULONG FORMULA_0000 0 0.0 0.0 4294967295.0 READ_WRITE ECU_ADDRESS 0x3F92BC /end MEASUREMENT
/begin MEASUREMENT os_err_ff.addr_5 "Adresse wo letzte Exception her kam" ULONG FORMULA_0000 0 0.0 0.0 4294967295.0 READ_WRITE ECU_ADDRESS 0x3F92C0 /end MEASUREMENT
/begin MEASUREMENT os_err_ff.addr_6 "Adresse wo letzte Exception her kam" ULONG FORMULA_0000 0 0.0 0.0 4294967295.0 READ_WRITE ECU_ADDRESS 0x3F92C4 /end MEASUREMENT
/begin MEASUREMENT os_err_ff.addr_7 "Adresse wo letzte Exception her kam" ULONG FORMULA_0000 0 0.0 0.0 4294967295.0 READ_WRITE ECU_ADDRESS 0x3F92C8 /end MEASUREMENT
/begin MEASUREMENT os_err_ff.ptr "Zeiger auf Ringspeicher" ULONG FORMULA_0000 0 0.0 0.0 4294967295.0 READ_WRITE ECU_ADDRESS 0x3F92A8 /end MEASUREMENT
/begin MEASUREMENT os_proz_ff.aq_soll_grad "Gradient AQ-Soll von Bank1" SWORD FORMULA_0020 0 0.0 -30000.0 30000.0 READ_WRITE ECU_ADDRESS 0x3F92D6 /end MEASUREMENT
/begin MEASUREMENT os_proz_ff.mtime "Maximale Prozess Zeit" UWORD FORMULA_0018 0 0.0 0.0 65535.0 READ_WRITE ECU_ADDRESS 0x3F92CC /end MEASUREMENT
/begin MEASUREMENT os_proz_ff.mtime_pid "PID des Prozesses mit max Zeit" UWORD FORMULA_0010 0 0.0 0.0 65535.0 READ_WRITE ECU_ADDRESS 0x3F92CE /end MEASUREMENT
/begin MEASUREMENT os_proz_ff.n "Motordrehzahl" SWORD FORMULA_0006 0 0.0 0.0 10000.0 READ_WRITE ECU_ADDRESS 0x3F92D0 /end MEASUREMENT
/begin MEASUREMENT os_proz_ff.rf "relative Fuellung Mittel zwischen Bank 1 und 2" SWORD FORMULA_0007 0 0.0 0.0 2.0 READ_WRITE ECU_ADDRESS 0x3F92D2 /end MEASUREMENT
/begin MEASUREMENT os_proz_ff.time_ml "Motor laeuft Zeit" UWORD FORMULA_0021 0 0.0 0.0 655.0 READ_WRITE ECU_ADDRESS 0x3F92D8 /end MEASUREMENT
/begin MEASUREMENT os_proz_ff.zustand_motor "Betriebszustand der Motorsteuerung" UWORD FORMULA_0019 0 0.0 0.0 65535.0 READ_WRITE ECU_ADDRESS 0x3F92D4 /end MEASUREMENT
/begin MEASUREMENT os_proz_irq_ff.aq_soll_grad "Gradient AQ-Soll von Bank1" SWORD FORMULA_0020 0 0.0 -30000.0 30000.0 READ_WRITE ECU_ADDRESS 0x3F92E4 /end MEASUREMENT
/begin MEASUREMENT os_proz_irq_ff.mtime "Maximale Prozess Zeit" UWORD FORMULA_0018 0 0.0 0.0 65535.0 READ_WRITE ECU_ADDRESS 0x3F92DA /end MEASUREMENT
/begin MEASUREMENT os_proz_irq_ff.mtime_pid "PID des Prozesses mit max Zeit" UWORD FORMULA_0010 0 0.0 0.0 65535.0 READ_WRITE ECU_ADDRESS 0x3F92DC /end MEASUREMENT
/begin MEASUREMENT os_proz_irq_ff.n "Motordrehzahl" SWORD FORMULA_0006 0 0.0 0.0 10000.0 READ_WRITE ECU_ADDRESS 0x3F92DE /end MEASUREMENT
/begin MEASUREMENT os_proz_irq_ff.rf "relative Fuellung Mittel zwischen Bank 1 und 2" SWORD FORMULA_0007 0 0.0 0.0 2.0 READ_WRITE ECU_ADDRESS 0x3F92E0 /end MEASUREMENT
/begin MEASUREMENT os_proz_irq_ff.time_ml "Motor laeuft Zeit" UWORD FORMULA_0021 0 0.0 0.0 655.0 READ_WRITE ECU_ADDRESS 0x3F92E6 /end MEASUREMENT
/begin MEASUREMENT os_proz_irq_ff.zustand_motor "Betriebszustand der Motorsteuerung" UWORD FORMULA_0019 0 0.0 0.0 65535.0 READ_WRITE ECU_ADDRESS 0x3F92E2 /end MEASUREMENT
/begin MEASUREMENT os_proz_irq_last_nv "CPU Last fuer diesen IRQ" UWORD FORMULA_0022 0 0.0 0.0 655.3499755859375 READ_WRITE ARRAY_SIZE 10 ECU_ADDRESS 0x3F92E8 MATRIX_DIM 10 1 1 /end MEASUREMENT
/begin MEASUREMENT pctrl_proz_err_nv "Fehler Prozessueberwachung" UWORD FORMULA_0010 0 0.0 0.0 65535.0 READ_WRITE ECU_ADDRESS 0x3F925C /end MEASUREMENT
/begin MEASUREMENT pctrl_task_err_nv "Fehler Taskueberwachung" UBYTE FORMULA_0003 0 0.0 0.0 255.0 READ_WRITE ECU_ADDRESS 0x3F925A /end MEASUREMENT
/begin MEASUREMENT pwg_bls_ff.anzahl_nv "Anzahl der Gas-Bremse-Betaetigungen" UWORD FORMULA_0010 0 0.0 0.0 65535.0 READ_WRITE ECU_ADDRESS 0x3F9FF4 /end MEASUREMENT
/begin MEASUREMENT pwg_bls_ff.can_ax "Laengsbeschleunigung (roh)" SWORD FORMULA_0123 0 0.0 -20.0 20.0 READ_WRITE ECU_ADDRESS 0x3FA002 /end MEASUREMENT
/begin MEASUREMENT pwg_bls_ff.can_ay "Querbeschleunigung (roh)" SWORD FORMULA_0123 0 0.0 -20.0 20.0 READ_WRITE ECU_ADDRESS 0x3FA004 /end MEASUREMENT
/begin MEASUREMENT pwg_bls_ff.can_brp_nv "Bremsdruck" UBYTE FORMULA_0129 0 0.0 0.0 200.0 READ_WRITE ECU_ADDRESS 0x3F9FF7 /end MEASUREMENT
/begin MEASUREMENT pwg_bls_ff.can_km_stand_nv "Kilometerstand" ULONG FORMULA_0027 0 0.0 0.0 16777214.0 READ_WRITE ECU_ADDRESS 0x3F9FF0 /end MEASUREMENT
/begin MEASUREMENT pwg_bls_ff.can_lrw "Lenkradwinkel" SWORD FORMULA_0132 0 0.0 -1440.153564453125 1440.109619140625 READ_WRITE ECU_ADDRESS 0x3FA006 /end MEASUREMENT
/begin MEASUREMENT pwg_bls_ff.md_fw_fgr "rel. Wunschmoment vom FGR" SWORD FORMULA_0001 0 0.0 0.0 100.0 READ_WRITE ECU_ADDRESS 0x3FA008 /end MEASUREMENT
/begin MEASUREMENT pwg_bls_ff.mvac_p_nv "gemessener Differenzdruck(Senor) Mastervac/Umgebung" SWORD FORMULA_0075 0 0.0 -1100.0 200.0 READ_WRITE ECU_ADDRESS 0x3F9FF8 /end MEASUREMENT
/begin MEASUREMENT pwg_bls_ff.n_nv "Drehzahl" SWORD FORMULA_0006 0 0.0 0.0 10000.0 READ_WRITE ECU_ADDRESS 0x3F9FFE /end MEASUREMENT
/begin MEASUREMENT pwg_bls_ff.pwg_filter_nv "Gefilterter Messwert der Pedalwerterfassung" UWORD FORMULA_0448 0 0.0 0.0 102.3983993530273 READ_WRITE ECU_ADDRESS 0x3F9FFA /end MEASUREMENT
/begin MEASUREMENT pwg_bls_ff.rf_m_nv "relative Fuellung Mittel zwischen Bank 1 und 2" SWORD FORMULA_0007 0 0.0 0.0 2.0 READ_WRITE ECU_ADDRESS 0x3F9FFC /end MEASUREMENT
/begin MEASUREMENT pwg_bls_ff.sk_md_begr_nv "SK-Begrenzungsstufe" UBYTE FORMULA_0167 0 0.0 0.0 255.0 READ_WRITE ECU_ADDRESS 0x3F9FF6 /end MEASUREMENT
/begin MEASUREMENT pwg_bls_ff.v_vorne_nv "v-Vorderachse" SWORD FORMULA_0076 0 0.0 -80.0 360.0 READ_WRITE ECU_ADDRESS 0x3FA000 /end MEASUREMENT
/begin MEASUREMENT pwg_max_diff_adapt_nv "Maximal aufgetretene Differenz der Pedalwertgeber" SWORD FORMULA_0001 0 0.0 0.0 120.0 READ_WRITE ECU_ADDRESS 0x3F9D32 /end MEASUREMENT
/begin MEASUREMENT pwg1_a0_nv "Absolute Potentiometerspannung 1 fuer LL" SWORD FORMULA_0250 0 0.0 0.0 5.0 READ_WRITE ECU_ADDRESS 0x3F9D34 /end MEASUREMENT
/begin MEASUREMENT pwg2_a0_nv "Absolute Potentiometerspannung 2 fuer LL" SWORD FORMULA_0251 0 0.0 0.0 5.0 READ_WRITE ECU_ADDRESS 0x3F9D36 /end MEASUREMENT
/begin MEASUREMENT ram_chk_err_adr_nv "Fehleradresse vom RamCheck" ULONG FORMULA_0000 0 0.0 0.0 4294967295.0 READ_WRITE ECU_ADDRESS 0x3F922C /end MEASUREMENT
/begin MEASUREMENT schalter_bls_counter_nv "Haeufigkeitszaehler Bremse" ULONG FORMULA_0000 0 0.0 0.0 4294967295.0 READ_WRITE ECU_ADDRESS 0x3F9EAC /end MEASUREMENT
/begin MEASUREMENT sk_ff.crc32_result "CRC-Fehler" UBYTE FORMULA_0013 0 0.0 0.0 255.0 READ_WRITE ECU_ADDRESS 0x3F924B /end MEASUREMENT
/begin MEASUREMENT sk_ff.egas_sk_mode "SK-Mode Egas" UBYTE FORMULA_0012 0 0.0 0.0 255.0 READ_WRITE ECU_ADDRESS 0x3F9248 /end MEASUREMENT
/begin MEASUREMENT sk_ff.fail_st_zyl "Ausblender" UWORD FORMULA_0010 0 0.0 0.0 65535.0 READ_WRITE ECU_ADDRESS 0x3F9244 /end MEASUREMENT
/begin MEASUREMENT sk_ff.kupp_ist "Istmoment" SWORD FORMULA_0009 0 0.0 -100.0 1000.0 READ_WRITE ECU_ADDRESS 0x3F9240 /end MEASUREMENT
/begin MEASUREMENT sk_ff.kupp_wunsch_ges "Wunschmoment" SWORD FORMULA_0009 0 0.0 -100.0 1000.0 READ_WRITE ECU_ADDRESS 0x3F923E /end MEASUREMENT
/begin MEASUREMENT sk_ff.md_sk_mode "SK-Mode Momentenmanager" UBYTE FORMULA_0012 0 0.0 0.0 255.0 READ_WRITE ECU_ADDRESS 0x3F9249 /end MEASUREMENT
/begin MEASUREMENT sk_ff.n "Drehzahl" SWORD FORMULA_0006 0 0.0 0.0 10000.0 READ_WRITE ECU_ADDRESS 0x3F9238 /end MEASUREMENT
/begin MEASUREMENT sk_ff.os_err_addr "OS-Err: Adresse" ULONG FORMULA_0000 0 0.0 0.0 4294967295.0 READ_WRITE ECU_ADDRESS 0x3F9250 /end MEASUREMENT
/begin MEASUREMENT sk_ff.os_err_cnt "OS-Err: Summe" UBYTE FORMULA_0003 0 0.0 0.0 255.0 READ_WRITE ECU_ADDRESS 0x3F924C /end MEASUREMENT
/begin MEASUREMENT sk_ff.os_err_type "Fehlertyp" UBYTE FORMULA_0014 0 0.0 0.0 255.0 READ_WRITE ECU_ADDRESS 0x3F924D /end MEASUREMENT
/begin MEASUREMENT sk_ff.proz_err "Prozess-Fehler" UWORD FORMULA_0010 0 0.0 0.0 65535.0 READ_WRITE ECU_ADDRESS 0x3F9254 /end MEASUREMENT
/begin MEASUREMENT sk_ff.pwg_soll "Pedalwert" SWORD FORMULA_0001 0 0.0 -10.0 120.0 READ_WRITE ECU_ADDRESS 0x3F9242 /end MEASUREMENT
/begin MEASUREMENT sk_ff.reset_cnt "Resetzaehler" UBYTE FORMULA_0003 0 0.0 0.0 255.0 READ_WRITE ECU_ADDRESS 0x3F924E /end MEASUREMENT
/begin MEASUREMENT sk_ff.rf_m "Fuellung" SWORD FORMULA_0007 0 0.0 0.0 2.0 READ_WRITE ECU_ADDRESS 0x3F923A /end MEASUREMENT
/begin MEASUREMENT sk_ff.smg_sk_mode "SK-Mode SMG" UBYTE FORMULA_0012 0 0.0 0.0 255.0 READ_WRITE ECU_ADDRESS 0x3F924A /end MEASUREMENT
/begin MEASUREMENT sk_ff.stufe "SK-Stufe" UBYTE FORMULA_0003 0 0.0 0.0 255.0 READ_WRITE ECU_ADDRESS 0x3F924F /end MEASUREMENT
/begin MEASUREMENT sk_ff.task_err "Task-Fehler" UWORD FORMULA_0010 0 0.0 0.0 65535.0 READ_WRITE ECU_ADDRESS 0x3F9256 /end MEASUREMENT
/begin MEASUREMENT sk_ff.ub "Spannung" SWORD FORMULA_0008 0 0.0 0.0 28.0 READ_WRITE ECU_ADDRESS 0x3F923C /end MEASUREMENT
/begin MEASUREMENT sk_ff.ursache "Ursache fuer SK-Eingriff" UWORD FORMULA_0011 0 0.0 0.0 65535.0 READ_WRITE ECU_ADDRESS 0x3F9246 /end MEASUREMENT
/begin MEASUREMENT smg_adapt_ihar_nv "Hinterachs- und Raduebersetzung" UWORD FORMULA_0073 0 0.0 0.0 63.99900054931641 READ_WRITE ECU_ADDRESS 0x3F9EAA /end MEASUREMENT
/begin MEASUREMENT smg_can_obd_st_nv "OBD-Status SMG" UBYTE FORMULA_0441 0 0.0 0.0 255.0 READ_WRITE ECU_ADDRESS 0x3F9EC2 /end MEASUREMENT
/begin MEASUREMENT smg_ff.abbruch_ges "Grund fuer Schaltabbruch - Summe" UBYTE FORMULA_0430 0 0.0 0.0 255.0 READ_WRITE ECU_ADDRESS 0x3F9E16 /end MEASUREMENT
/begin MEASUREMENT smg_ff.counter "Anzahl der Aufrufe" UBYTE FORMULA_0003 0 0.0 0.0 255.0 READ_WRITE ECU_ADDRESS 0x3F9DF0 /end MEASUREMENT
/begin MEASUREMENT smg_ff.dme_st "DME-Status" UBYTE FORMULA_0298 0 0.0 0.0 255.0 READ_WRITE ECU_ADDRESS 0x3F9E11 /end MEASUREMENT
/begin MEASUREMENT smg_ff.getr_st "Getriebestatus" UBYTE FORMULA_0427 0 0.0 0.0 255.0 READ_WRITE ECU_ADDRESS 0x3F9E13 /end MEASUREMENT
/begin MEASUREMENT smg_ff.istgang "Istgang" SBYTE FORMULA_0135 0 0.0 -1.0 10.0 READ_WRITE ECU_ADDRESS 0x3F9E10 /end MEASUREMENT
/begin MEASUREMENT smg_ff.km_stand "Kilometerstand" ULONG FORMULA_0027 0 0.0 0.0 16777214.0 READ_WRITE ECU_ADDRESS 0x3F9DEC /end MEASUREMENT
/begin MEASUREMENT smg_ff.kupp_st "Kupplungsstatus" UBYTE FORMULA_0426 0 0.0 0.0 255.0 READ_WRITE ECU_ADDRESS 0x3F9E12 /end MEASUREMENT
/begin MEASUREMENT smg_ff.md_fahrer "Fahrerwunschmoment" SWORD FORMULA_0009 0 0.0 -100.0 1000.0 READ_WRITE ECU_ADDRESS 0x3F9E04 /end MEASUREMENT
/begin MEASUREMENT smg_ff.md_ist "Moment an der Kupplung" SWORD FORMULA_0009 0 0.0 -100.0 1000.0 READ_WRITE ECU_ADDRESS 0x3F9E08 /end MEASUREMENT
/begin MEASUREMENT smg_ff.md_soll "TZ-Sollmoment" SWORD FORMULA_0009 0 0.0 -100.0 1000.0 READ_WRITE ECU_ADDRESS 0x3F9E06 /end MEASUREMENT
/begin MEASUREMENT smg_ff.mk_ist "absolutes Kupplungsmoment" SWORD FORMULA_0009 0 0.0 -100.0 1000.0 READ_WRITE ECU_ADDRESS 0x3F9E0C /end MEASUREMENT
/begin MEASUREMENT smg_ff.mk_soll "absolutes Kupplungssollmoment" SWORD FORMULA_0009 0 0.0 -100.0 1000.0 READ_WRITE ECU_ADDRESS 0x3F9E0A /end MEASUREMENT
/begin MEASUREMENT smg_ff.modul "Modulstatus" UBYTE FORMULA_0428 0 0.0 0.0 255.0 READ_WRITE ECU_ADDRESS 0x3F9E14 /end MEASUREMENT
/begin MEASUREMENT smg_ff.n "Motordrehzahl" SWORD FORMULA_0006 0 0.0 0.0 10000.0 READ_WRITE ECU_ADDRESS 0x3F9DF8 /end MEASUREMENT
/begin MEASUREMENT smg_ff.n_berech "berechnete Drehzahl" SWORD FORMULA_0006 0 0.0 0.0 10000.0 READ_WRITE ECU_ADDRESS 0x3F9E18 /end MEASUREMENT
/begin MEASUREMENT smg_ff.n_getr_ein "Getriebeeingangsdrehzahl" SWORD FORMULA_0006 0 0.0 0.0 10000.0 READ_WRITE ECU_ADDRESS 0x3F9DFA /end MEASUREMENT
/begin MEASUREMENT smg_ff.n_getr_ziel "Getriebezieldrehzahl" SWORD FORMULA_0006 0 0.0 0.0 10000.0 READ_WRITE ECU_ADDRESS 0x3F9DFC /end MEASUREMENT
/begin MEASUREMENT smg_ff.pos_kupp_ist "Kupplungsposition" UBYTE FORMULA_0425 0 0.0 0.0 1020.0 READ_WRITE ECU_ADDRESS 0x3F9E0E /end MEASUREMENT
/begin MEASUREMENT smg_ff.pwg_soll "Fahrerwunsch" SWORD FORMULA_0001 0 0.0 -10.0 120.0 READ_WRITE ECU_ADDRESS 0x3F9E02 /end MEASUREMENT
/begin MEASUREMENT smg_ff.s_krafts "Kraftschluss" UBYTE FORMULA_0429 0 0.0 0.0 255.0 READ_WRITE ECU_ADDRESS 0x3F9E15 /end MEASUREMENT
/begin MEASUREMENT smg_ff.sk_flags "SK-Flags" UWORD FORMULA_0010 0 0.0 0.0 65535.0 READ_WRITE ECU_ADDRESS 0x3F9DF2 /end MEASUREMENT
/begin MEASUREMENT smg_ff.sk_flags_nv "SK-Flags Historie" UWORD FORMULA_0010 0 0.0 0.0 65535.0 READ_WRITE ECU_ADDRESS 0x3F9DF4 /end MEASUREMENT
/begin MEASUREMENT smg_ff.sk_mode "SK-Mode" UBYTE FORMULA_0003 0 0.0 0.0 255.0 READ_WRITE ECU_ADDRESS 0x3F9DF1 /end MEASUREMENT
/begin MEASUREMENT smg_ff.toel "Toel" SWORD FORMULA_0023 0 0.0 -50.0 170.0 READ_WRITE ECU_ADDRESS 0x3F9DF6 /end MEASUREMENT
/begin MEASUREMENT smg_ff.v_hinten "vHinten" SWORD FORMULA_0076 0 0.0 -80.0 360.0 READ_WRITE ECU_ADDRESS 0x3F9E00 /end MEASUREMENT
/begin MEASUREMENT smg_ff.v_vorne "vVorne" SWORD FORMULA_0076 0 0.0 -80.0 360.0 READ_WRITE ECU_ADDRESS 0x3F9DFE /end MEASUREMENT
/begin MEASUREMENT smg_ff.zielgang "Zielgang" SBYTE FORMULA_0135 0 0.0 -1.0 10.0 READ_WRITE ECU_ADDRESS 0x3F9E0F /end MEASUREMENT
/begin MEASUREMENT spim_chain_error_nv "SPI Chains Fehler" UBYTE FORMULA_0004 0 0.0 0.0 255.0 READ_WRITE ECU_ADDRESS 0x3F9234 /end MEASUREMENT
/begin MEASUREMENT spim_error_reinit_ctr_nv "SPI-reinits durch Fehlverhalten" UBYTE FORMULA_0003 0 0.0 0.0 255.0 READ_WRITE ECU_ADDRESS 0x3F9233 /end MEASUREMENT
/begin MEASUREMENT spim_errorcode_reinit_nv "Errorcode weswegen ein SPI-Reinit ausgefuehrt wurde" UBYTE FORMULA_0002 0 0.0 0.0 255.0 READ_WRITE ECU_ADDRESS 0x3F9232 /end MEASUREMENT
/begin MEASUREMENT sys_exc_addr_nv "Exception-Adresse" ULONG FORMULA_0000 0 0.0 0.0 4294967295.0 READ_WRITE ECU_ADDRESS 0x3F9264 /end MEASUREMENT
/begin MEASUREMENT sys_exc_lr_nv "Exception-Linkregister" ULONG FORMULA_0000 0 0.0 0.0 4294967295.0 READ_WRITE ECU_ADDRESS 0x3F9260 /end MEASUREMENT
/begin MEASUREMENT sys_exc_vec_nv "Exception-Vector" UWORD FORMULA_0015 0 0.0 0.0 65535.0 READ_WRITE ECU_ADDRESS 0x3F925E /end MEASUREMENT
/begin MEASUREMENT sys_rsr_cnt_nv.csrs "ChkstopReset" UBYTE FORMULA_0003 0 0.0 0.0 255.0 READ_WRITE ECU_ADDRESS 0x3F926C /end MEASUREMENT
/begin MEASUREMENT sys_rsr_cnt_nv.dbhrs "DebugHardReset" UBYTE FORMULA_0003 0 0.0 0.0 255.0 READ_WRITE ECU_ADDRESS 0x3F926D /end MEASUREMENT
/begin MEASUREMENT sys_rsr_cnt_nv.dbsrs "DebugSoftReset" UBYTE FORMULA_0003 0 0.0 0.0 255.0 READ_WRITE ECU_ADDRESS 0x3F926E /end MEASUREMENT
/begin MEASUREMENT sys_rsr_cnt_nv.ehrs "ExtHardReset" UBYTE FORMULA_0003 0 0.0 0.0 255.0 READ_WRITE ECU_ADDRESS 0x3F9268 /end MEASUREMENT
/begin MEASUREMENT sys_rsr_cnt_nv.esrs "ExtSoftReset" UBYTE FORMULA_0003 0 0.0 0.0 255.0 READ_WRITE ECU_ADDRESS 0x3F9269 /end MEASUREMENT
/begin MEASUREMENT sys_rsr_cnt_nv.ghrst "GlitchHPinReset" UBYTE FORMULA_0003 0 0.0 0.0 255.0 READ_WRITE ECU_ADDRESS 0x3F9273 /end MEASUREMENT
/begin MEASUREMENT sys_rsr_cnt_nv.gpor "GlitchPowerOnReset" UBYTE FORMULA_0003 0 0.0 0.0 255.0 READ_WRITE ECU_ADDRESS 0x3F9272 /end MEASUREMENT
/begin MEASUREMENT sys_rsr_cnt_nv.gsrst "GlitchSPinReset" UBYTE FORMULA_0003 0 0.0 0.0 255.0 READ_WRITE ECU_ADDRESS 0x3F9274 /end MEASUREMENT
/begin MEASUREMENT sys_rsr_cnt_nv.ilbc "IllegalBitChangeReset" UBYTE FORMULA_0003 0 0.0 0.0 255.0 READ_WRITE ECU_ADDRESS 0x3F9271 /end MEASUREMENT
/begin MEASUREMENT sys_rsr_cnt_nv.jtrs "JTAGReset" UBYTE FORMULA_0003 0 0.0 0.0 255.0 READ_WRITE ECU_ADDRESS 0x3F926F /end MEASUREMENT
/begin MEASUREMENT sys_rsr_cnt_nv.llrs "LossOfClockReset" UBYTE FORMULA_0003 0 0.0 0.0 255.0 READ_WRITE ECU_ADDRESS 0x3F926A /end MEASUREMENT
/begin MEASUREMENT sys_rsr_cnt_nv.ocrs "OnChipReset" UBYTE FORMULA_0003 0 0.0 0.0 255.0 READ_WRITE ECU_ADDRESS 0x3F9270 /end MEASUREMENT
/begin MEASUREMENT sys_rsr_cnt_nv.swrs "WatchdogReset" UBYTE FORMULA_0003 0 0.0 0.0 255.0 READ_WRITE ECU_ADDRESS 0x3F926B /end MEASUREMENT
/begin MEASUREMENT sys_zust_cpu_last_max_nv "Maximale CPU Last" UWORD FORMULA_0001 0 0.0 0.0 100.0 READ_WRITE ECU_ADDRESS 0x3F9230 /end MEASUREMENT
/begin MEASUREMENT tabg_ad_b1 "Eingelesener Spannungswert fuer Abgastemperatur" SWORD FORMULA_0114 0 0.0 0.0 1023.0 READ_WRITE ECU_ADDRESS 0x3FC4C8 /end MEASUREMENT
/begin MEASUREMENT tabg_ad_b2 "Eingelesener Spannungswert fuer Abgastemperatur" SWORD FORMULA_0114 0 0.0 0.0 1023.0 READ_WRITE ECU_ADDRESS 0x3FC4CA /end MEASUREMENT
/begin MEASUREMENT tabg_diag_time_b1 "Sperrzeit fuer Plausifehler" UWORD FORMULA_0071 0 0.0 0.0 6553.5 READ_WRITE ECU_ADDRESS 0x3FC4FE /end MEASUREMENT
/begin MEASUREMENT tabg_diag_time_b2 "Sperrzeit fuer Plausifehler" UWORD FORMULA_0071 0 0.0 0.0 6553.5 READ_WRITE ECU_ADDRESS 0x3FC500 /end MEASUREMENT
/begin MEASUREMENT tabg_kat_exo_max_b1 "Maximale Enthalpie" SWORD FORMULA_0961 0 0.0 0.0 327.6700134277344 READ_WRITE ECU_ADDRESS 0x3FC4F6 /end MEASUREMENT
/begin MEASUREMENT tabg_kat_exo_max_b2 "Maximale Enthalpie" SWORD FORMULA_0961 0 0.0 0.0 327.6700134277344 READ_WRITE ECU_ADDRESS 0x3FC4F8 /end MEASUREMENT
/begin MEASUREMENT tabg_kat_exo_on_b1 "Einschaltschwelle fuer Enthalpie" SWORD FORMULA_0023 0 0.0 -50.0 1250.0 READ_WRITE ECU_ADDRESS 0x3FC4FA /end MEASUREMENT
/begin MEASUREMENT tabg_kat_exo_on_b2 "Einschaltschwelle fuer Enthalpie" SWORD FORMULA_0023 0 0.0 -50.0 1250.0 READ_WRITE ECU_ADDRESS 0x3FC4FC /end MEASUREMENT
/begin MEASUREMENT tabg_kat_t_offs_b1 "Enthalpietemperatur" SWORD FORMULA_0961 0 0.0 0.0 327.6700134277344 READ_WRITE ECU_ADDRESS 0x3FC4F2 /end MEASUREMENT
/begin MEASUREMENT tabg_kat_t_offs_b2 "Enthalpietemperatur" SWORD FORMULA_0961 0 0.0 0.0 327.6700134277344 READ_WRITE ECU_ADDRESS 0x3FC4F4 /end MEASUREMENT
/begin MEASUREMENT tabg_lw_f_eta_zw_ne_b1 "Zuendwinkeleinflussfaktor" UWORD FORMULA_0073 0 0.0 0.0 4.0 READ_WRITE ECU_ADDRESS 0x3FC4E0 /end MEASUREMENT
/begin MEASUREMENT tabg_lw_f_eta_zw_ne_b2 "Zuendwinkeleinflussfaktor" UWORD FORMULA_0073 0 0.0 0.0 4.0 READ_WRITE ECU_ADDRESS 0x3FC4E2 /end MEASUREMENT
/begin MEASUREMENT tabg_lw_f_lam_b1 "Lambdaeinflussfaktor" UWORD FORMULA_0073 0 0.0 0.0 4.0 READ_WRITE ECU_ADDRESS 0x3FC4E4 /end MEASUREMENT
/begin MEASUREMENT tabg_lw_f_lam_b2 "Lambdaeinflussfaktor" UWORD FORMULA_0073 0 0.0 0.0 4.0 READ_WRITE ECU_ADDRESS 0x3FC4E6 /end MEASUREMENT
/begin MEASUREMENT tabg_lw_f_rg_b1 "Resteinflussgasfaktor" UWORD FORMULA_0073 0 0.0 0.0 4.0 READ_WRITE ECU_ADDRESS 0x3FC4DC /end MEASUREMENT
/begin MEASUREMENT tabg_lw_f_rg_b2 "Resteinflussgasfaktor" UWORD FORMULA_0073 0 0.0 0.0 4.0 READ_WRITE ECU_ADDRESS 0x3FC4DE /end MEASUREMENT
/begin MEASUREMENT tabg_lw_filter_b1 "Gefilterte Ladungswechseltemperatur" SWORD FORMULA_0342 0 0.0 -50.0 1250.0 READ_WRITE ECU_ADDRESS 0x3FC4D8 /end MEASUREMENT
/begin MEASUREMENT tabg_lw_filter_b2 "Gefilterte Ladungswechseltemperatur" SWORD FORMULA_0342 0 0.0 -50.0 1250.0 READ_WRITE ECU_ADDRESS 0x3FC4DA /end MEASUREMENT
/begin MEASUREMENT tabg_lw_roh_b1 "Ungefilterte Ladungswechseltemperatur" SWORD FORMULA_0342 0 0.0 -50.0 1250.0 READ_WRITE ECU_ADDRESS 0x3FC4D4 /end MEASUREMENT
/begin MEASUREMENT tabg_lw_roh_b2 "Ungefilterte Ladungswechseltemperatur" SWORD FORMULA_0342 0 0.0 -50.0 1250.0 READ_WRITE ECU_ADDRESS 0x3FC4D6 /end MEASUREMENT
/begin MEASUREMENT tabg_lw_stand_nv_b1 "Offset zu TUMG beim Abstellen" SWORD FORMULA_0074 0 0.0 -1000.0 1250.0 READ_WRITE ECU_ADDRESS 0x3F9D3C /end MEASUREMENT
/begin MEASUREMENT tabg_lw_stand_nv_b2 "Offset zu TUMG beim Abstellen" SWORD FORMULA_0074 0 0.0 -1000.0 1250.0 READ_WRITE ECU_ADDRESS 0x3F9D3E /end MEASUREMENT
/begin MEASUREMENT tabg_lw_stat_b1 "Temperatur in Celsius" SWORD FORMULA_0023 0 0.0 -50.0 1250.0 READ_WRITE ECU_ADDRESS 0x3FC4D0 /end MEASUREMENT
/begin MEASUREMENT tabg_lw_stat_b2 "Temperatur in Celsius" SWORD FORMULA_0023 0 0.0 -50.0 1250.0 READ_WRITE ECU_ADDRESS 0x3FC4D2 /end MEASUREMENT
/begin MEASUREMENT tabg_lw_tau_b1 "Filterzeitkonstante fuer Ladungswechsel" UBYTE FORMULA_0746 0 0.0 0.1004000008106232 25.60000038146973 READ_WRITE ECU_ADDRESS 0x3FC4F0 /end MEASUREMENT
/begin MEASUREMENT tabg_lw_tau_b2 "Filterzeitkonstante fuer Ladungswechsel" UBYTE FORMULA_0746 0 0.0 0.1004000008106232 25.60000038146973 READ_WRITE ECU_ADDRESS 0x3FC4F1 /end MEASUREMENT
/begin MEASUREMENT tabg_ml_ges_b1 "Gesamte Luftmasse im Abgasstrang" SWORD FORMULA_0103 0 0.0 -100.0 1400.0 READ_WRITE ECU_ADDRESS 0x3FC4EC /end MEASUREMENT
/begin MEASUREMENT tabg_ml_ges_b2 "Gesamte Luftmasse im Abgasstrang" SWORD FORMULA_0103 0 0.0 -100.0 1400.0 READ_WRITE ECU_ADDRESS 0x3FC4EE /end MEASUREMENT
/begin MEASUREMENT tabg_nkat_max_nv_b1 "Maximale Nachkattemperatur" SWORD FORMULA_0023 0 0.0 -50.0 1250.0 READ_WRITE ECU_ADDRESS 0x3F9D48 /end MEASUREMENT
/begin MEASUREMENT tabg_nkat_max_nv_b2 "Maximale Nachkattemperatur" SWORD FORMULA_0023 0 0.0 -50.0 1250.0 READ_WRITE ECU_ADDRESS 0x3F9D4A /end MEASUREMENT
/begin MEASUREMENT tabg_nkat_stand_nv_b1 "Offset zu TUMG beim Abstellen" SWORD FORMULA_0074 0 0.0 -1000.0 1250.0 READ_WRITE ECU_ADDRESS 0x3F9D44 /end MEASUREMENT
/begin MEASUREMENT tabg_nkat_stand_nv_b2 "Offset zu TUMG beim Abstellen" SWORD FORMULA_0074 0 0.0 -1000.0 1250.0 READ_WRITE ECU_ADDRESS 0x3F9D46 /end MEASUREMENT
/begin MEASUREMENT tabg_roh_b1 "Ungefilterter Messwert der Abgastemperatur" SWORD FORMULA_0342 0 0.0 -50.0 1250.0 READ_WRITE ECU_ADDRESS 0x3FC4CC /end MEASUREMENT
/begin MEASUREMENT tabg_roh_b2 "Ungefilterter Messwert der Abgastemperatur" SWORD FORMULA_0342 0 0.0 -50.0 1250.0 READ_WRITE ECU_ADDRESS 0x3FC4CE /end MEASUREMENT
/begin MEASUREMENT tabg_st "TABG-Status" UBYTE FORMULA_0037 0 0.0 0.0 255.0 READ_WRITE ECU_ADDRESS 0x3FC502 /end MEASUREMENT
/begin MEASUREMENT tabg_st_aufregeln_b1 "Kat-Enthalpie Bank 1" UBYTE FORMULA_0962 0 0 0.0 255.0 READ_WRITE BIT_MASK 0x1 ECU_ADDRESS 0x3FC502 /end MEASUREMENT
/begin MEASUREMENT tabg_st_aufregeln_b2 "Kat-Enthalpie Bank 2" UBYTE FORMULA_0963 0 0 0.0 255.0 READ_WRITE BIT_MASK 0x2 ECU_ADDRESS 0x3FC502 /end MEASUREMENT
/begin MEASUREMENT tabg_st_init_b1 "CAN-Init Bank 1" UBYTE FORMULA_0964 0 0 0.0 255.0 READ_WRITE BIT_MASK 0x40 ECU_ADDRESS 0x3FC502 /end MEASUREMENT
/begin MEASUREMENT tabg_st_init_b2 "CAN-Init Bank 2" UBYTE FORMULA_0965 0 0 0.0 255.0 READ_WRITE BIT_MASK 0x80 ECU_ADDRESS 0x3FC502 /end MEASUREMENT
/begin MEASUREMENT tabg_vkat_f_reak_b1 "Faktor der Reaktion im Kruemmer" UWORD FORMULA_0073 0 0.0 0.0 4.0 READ_WRITE ECU_ADDRESS 0x3FC4E8 /end MEASUREMENT
/begin MEASUREMENT tabg_vkat_f_reak_b2 "Faktor der Reaktion im Kruemmer" UWORD FORMULA_0073 0 0.0 0.0 4.0 READ_WRITE ECU_ADDRESS 0x3FC4EA /end MEASUREMENT
/begin MEASUREMENT tabg_vkat_stand_nv_b1 "Offset zu TUMG beim Abstellen" SWORD FORMULA_0074 0 0.0 -1000.0 1250.0 READ_WRITE ECU_ADDRESS 0x3F9D40 /end MEASUREMENT
/begin MEASUREMENT tabg_vkat_stand_nv_b2 "Offset zu TUMG beim Abstellen" SWORD FORMULA_0074 0 0.0 -1000.0 1250.0 READ_WRITE ECU_ADDRESS 0x3F9D42 /end MEASUREMENT
/begin MEASUREMENT tan_ad_b1 "Eingelesener Spannungswert fuer Ansauglufttemperatur" SWORD FORMULA_0114 0 0.0 0.0 1023.0 READ_WRITE ECU_ADDRESS 0x3FC510 /end MEASUREMENT
/begin MEASUREMENT tan_ad_b2 "Eingelesener Spannungswert fuer Ansauglufttemperatur" SWORD FORMULA_0114 0 0.0 0.0 1023.0 READ_WRITE ECU_ADDRESS 0x3FC512 /end MEASUREMENT
/begin MEASUREMENT tan_filter_b1 "Gefilterter Messwert der Ansauglufttemperatur" SWORD FORMULA_0975 0 0.0 -50.0 170.0 READ_WRITE ECU_ADDRESS 0x3FC518 /end MEASUREMENT
/begin MEASUREMENT tan_filter_b2 "Gefilterter Messwert der Ansauglufttemperatur" SWORD FORMULA_0975 0 0.0 -50.0 170.0 READ_WRITE ECU_ADDRESS 0x3FC51A /end MEASUREMENT
/begin MEASUREMENT tan_modell_b1 "Ansauglufttemperatur Modell gefiltert" SWORD FORMULA_0023 0 0.0 -50.0 170.0 READ_WRITE ECU_ADDRESS 0x3FC524 /end MEASUREMENT
/begin MEASUREMENT tan_modell_b2 "Ansauglufttemperatur Modell gefiltert" SWORD FORMULA_0023 0 0.0 -50.0 170.0 READ_WRITE ECU_ADDRESS 0x3FC526 /end MEASUREMENT
/begin MEASUREMENT tan_modell_ml_ratio_b1 "Faktor Luftmasse für TAN-Modell" UWORD FORMULA_0199 0 0.0 0.0 2.0 READ_WRITE ECU_ADDRESS 0x3FC52C /end MEASUREMENT
/begin MEASUREMENT tan_modell_ml_ratio_b2 "Faktor Luftmasse für TAN-Modell" UWORD FORMULA_0199 0 0.0 0.0 2.0 READ_WRITE ECU_ADDRESS 0x3FC52E /end MEASUREMENT
/begin MEASUREMENT tan_modell_ml_tau_b1 "Temperatur tau TAN-Modell" UWORD FORMULA_0681 0 0.0 0.1000000014901161 6553.5 READ_WRITE ECU_ADDRESS 0x3FC528 /end MEASUREMENT
/begin MEASUREMENT tan_modell_ml_tau_b2 "Temperatur tau TAN-Modell" UWORD FORMULA_0681 0 0.0 0.1000000014901161 6553.5 READ_WRITE ECU_ADDRESS 0x3FC52A /end MEASUREMENT
/begin MEASUREMENT tan_modell_mr "Temperatur Motorraum TAN-Modell" SWORD FORMULA_0023 0 0.0 -50.0 170.0 READ_WRITE ECU_ADDRESS 0x3FC51C /end MEASUREMENT
/begin MEASUREMENT tan_modell_mr_kal "Motorraumtempabweichung durch TUMG" SWORD FORMULA_0074 0 0.0 -1000.0 1000.0 READ_WRITE ECU_ADDRESS 0x3FC546 /end MEASUREMENT
/begin MEASUREMENT tan_modell_mr_off "Temperaturdifferenz Motorraum zu TMOT" SWORD FORMULA_0074 0 0.0 -1000.0 1000.0 READ_WRITE ECU_ADDRESS 0x3F9D56 /end MEASUREMENT
/begin MEASUREMENT tan_modell_off_b1 "Temperaturdifferenz TAN Modell zu ungefiltert" SWORD FORMULA_0074 0 0.0 -1000.0 1000.0 READ_WRITE ECU_ADDRESS 0x3F9D52 /end MEASUREMENT
/begin MEASUREMENT tan_modell_off_b2 "Temperaturdifferenz TAN Modell zu ungefiltert" SWORD FORMULA_0074 0 0.0 -1000.0 1000.0 READ_WRITE ECU_ADDRESS 0x3F9D54 /end MEASUREMENT
/begin MEASUREMENT tan_modell_raw_b1 "Temperatur Ansaugluft Modell ungefiltert" SWORD FORMULA_0023 0 0.0 -50.0 170.0 READ_WRITE ECU_ADDRESS 0x3FC520 /end MEASUREMENT
/begin MEASUREMENT tan_modell_raw_b2 "Temperatur Ansaugluft Modell ungefiltert" SWORD FORMULA_0023 0 0.0 -50.0 170.0 READ_WRITE ECU_ADDRESS 0x3FC522 /end MEASUREMENT
/begin MEASUREMENT tan_modell_st "Status Modell Ansauglufttemperatur" UBYTE FORMULA_0976 0 0.0 0.0 2.0 READ_WRITE ECU_ADDRESS 0x3FC530 /end MEASUREMENT
/begin MEASUREMENT tan_modell_tmot "Motorraumtemperatur Zielwert" SWORD FORMULA_0023 0 0.0 -50.0 170.0 READ_WRITE ECU_ADDRESS 0x3FC548 /end MEASUREMENT
/begin MEASUREMENT tan_n_dyn "Drehzahl gefiltert im tan-Modul" SWORD FORMULA_0105 0 0.0 -10000.0 10000.0 READ_WRITE ECU_ADDRESS 0x3FC542 /end MEASUREMENT
/begin MEASUREMENT tan_n_dyn_delta "Drehzahl zwischen gefiltert und ungefiltert" SWORD FORMULA_0105 0 0.0 -10000.0 10000.0 READ_WRITE ECU_ADDRESS 0x3FC544 /end MEASUREMENT
/begin MEASUREMENT tan_obd_delta "Temperaturdifferenz der beiden HFM" SWORD FORMULA_0074 0 0.0 -1000.0 1000.0 READ_WRITE ECU_ADDRESS 0x3FC53A /end MEASUREMENT
/begin MEASUREMENT tan_obd_delta_modell_b1 "Temperaturdifferenz HFM zu Modell" SWORD FORMULA_0074 0 0.0 -1000.0 1000.0 READ_WRITE ECU_ADDRESS 0x3FC53C /end MEASUREMENT
/begin MEASUREMENT tan_obd_delta_modell_b2 "Temperaturdifferenz HFM zu Modell" SWORD FORMULA_0074 0 0.0 -1000.0 1000.0 READ_WRITE ECU_ADDRESS 0x3FC53E /end MEASUREMENT
/begin MEASUREMENT tan_obd_dyn_delay "Zeit seit Dynamiküberschreitung" UWORD FORMULA_0980 0 0.0 0.0 6553.5 READ_WRITE ECU_ADDRESS 0x3FC538 /end MEASUREMENT
/begin MEASUREMENT tan_obd_ersatz "Zuteilung Ersatzwert Ansauglufttemperatur" UBYTE FORMULA_0977 0 0.0 0.0 2.0 READ_WRITE ECU_ADDRESS 0x3FC531 /end MEASUREMENT
/begin MEASUREMENT tan_obd_st "Status Plausibilisierung Ansauglufttemperatur" UBYTE FORMULA_0003 0 0.0 0.0 2.0 READ_WRITE ECU_ADDRESS 0x3FC532 /end MEASUREMENT
/begin MEASUREMENT tan_obd_st_last "Status letzte Diagnose" UBYTE FORMULA_0979 0 0.0 0.0 255.0 READ_WRITE BIT_MASK 0x22 ECU_ADDRESS 0x3FC532 /end MEASUREMENT
/begin MEASUREMENT tan_obd_st_now "Status aktuelle Diagnose" UBYTE FORMULA_0978 0 0.0 0.0 255.0 READ_WRITE BIT_MASK 0x11 ECU_ADDRESS 0x3FC532 /end MEASUREMENT
/begin MEASUREMENT tan_obd_t_delta_no "Zeit seit keine Abweichung" UWORD FORMULA_0980 0 0.0 0.0 6553.5 READ_WRITE ECU_ADDRESS 0x3FC536 /end MEASUREMENT
/begin MEASUREMENT tan_obd_t_delta_yes "Zeit seit Abweichung" UWORD FORMULA_0980 0 0.0 0.0 6553.5 READ_WRITE ECU_ADDRESS 0x3FC534 /end MEASUREMENT
/begin MEASUREMENT tan_obd_v_t_min "Zeit über Minimalgeschwindigkeit" UWORD FORMULA_0980 0 0.0 0.0 6553.5 READ_WRITE ECU_ADDRESS 0x3FC540 /end MEASUREMENT
/begin MEASUREMENT tan_roh_b1 "Ungefilterter Messwert der Ansauglufttemperatur" SWORD FORMULA_0975 0 0.0 -50.0 170.0 READ_WRITE ECU_ADDRESS 0x3FC514 /end MEASUREMENT
/begin MEASUREMENT tan_roh_b2 "Ungefilterter Messwert der Ansauglufttemperatur" SWORD FORMULA_0975 0 0.0 -50.0 170.0 READ_WRITE ECU_ADDRESS 0x3FC516 /end MEASUREMENT
/begin MEASUREMENT tan_tmot_tumg_delta "Temperaturdifferenz Motorraum zu Umgebung" SWORD FORMULA_0074 0 0.0 -1000.0 1000.0 READ_WRITE ECU_ADDRESS 0x3FC51E /end MEASUREMENT
/begin MEASUREMENT tdme_max_nv "Maximale DME-Temperatur ueber alle Zyklen" SWORD FORMULA_0023 0 0.0 -50.0 170.0 READ_WRITE ECU_ADDRESS 0x3F9128 /end MEASUREMENT
/begin MEASUREMENT tdme_min_nv "Minimale DME-Temperatur ueber alle Zyklen" SWORD FORMULA_0023 0 0.0 -50.0 170.0 READ_WRITE ECU_ADDRESS 0x3F912A /end MEASUREMENT
/begin MEASUREMENT tdme_time_zaehler_nv "Zeit fuer Temperatur oberhalb Schwelle" ULONG FORMULA_0452 0 0.0 0.0 429496729.5 READ_WRITE ECU_ADDRESS 0x3F912C /end MEASUREMENT
/begin MEASUREMENT tdme_zyklen_nv "Fahrzyklen oberhalb der Temperatur Schwelle" UWORD FORMULA_0453 0 0.0 0.0 65535.0 READ_WRITE ECU_ADDRESS 0x3F9130 /end MEASUREMENT
/begin MEASUREMENT time_rel_diag_nl_2_nv "Relativzeit aus vorletztem Nachlauf" ULONG FORMULA_0145 0 0.0 0.0 71582788.25 READ_WRITE ECU_ADDRESS 0x3F9FB4 /end MEASUREMENT
/begin MEASUREMENT time_rel_diag_nl_nv "Relativzeit aus letztem Nachlauf" ULONG FORMULA_0145 0 0.0 0.0 71582788.25 READ_WRITE ECU_ADDRESS 0x3F9FB0 /end MEASUREMENT
/begin MEASUREMENT time_rel_zero_cnt_nv "time_rel-Reset-Zaehler" UBYTE FORMULA_0003 0 0.0 0.0 255.0 READ_WRITE ECU_ADDRESS 0x3F9FB8 /end MEASUREMENT
/begin MEASUREMENT tmot_abstell_nv "Abstelltemperatur des Motors" SWORD FORMULA_0023 0 0.0 -50.0 170.0 READ_WRITE ECU_ADDRESS 0x3F8348 /end MEASUREMENT
/begin MEASUREMENT toel_abstell_nv "Oel-Abstelltemperatur" SWORD FORMULA_0023 0 0.0 -50.0 170.0 READ_WRITE ECU_ADDRESS 0x3F9D30 /end MEASUREMENT
/begin MEASUREMENT toel_wanne "Oeltemperatur am QLT (Oelwanne)" SWORD FORMULA_0023 0 0.0 -50.0 170.0 READ_WRITE ECU_ADDRESS 0x3F8658 /end MEASUREMENT
/begin MEASUREMENT tpu_kw_err_ff_a.cnt "Abrisszaehler" UBYTE FORMULA_0003 0 0.0 0.0 255.0 READ_WRITE ECU_ADDRESS 0x3F927B /end MEASUREMENT
/begin MEASUREMENT tpu_kw_err_ff_a.event_time "letzte Ereigniszeit" ULONG FORMULA_0017 0 0.0 0.0 2396.745 READ_WRITE ECU_ADDRESS 0x3F9288 /end MEASUREMENT
/begin MEASUREMENT tpu_kw_err_ff_a.irq "Interruptarten" UBYTE FORMULA_0003 0 0.0 0.0 255.0 READ_WRITE ECU_ADDRESS 0x3F927A /end MEASUREMENT
/begin MEASUREMENT tpu_kw_err_ff_a.last_period "letzte Zahnperiode" ULONG FORMULA_0017 0 0.0 0.0 2396.745 READ_WRITE ECU_ADDRESS 0x3F9284 /end MEASUREMENT
/begin MEASUREMENT tpu_kw_err_ff_a.n "Abrissdrehzahl" SWORD FORMULA_0006 0 0.0 0.0 10000.0 READ_WRITE ECU_ADDRESS 0x3F927C /end MEASUREMENT
/begin MEASUREMENT tpu_kw_err_ff_a.n_zahn "Abrisszahndrehzahl" SWORD FORMULA_0006 0 0.0 0.0 10000.0 READ_WRITE ECU_ADDRESS 0x3F927E /end MEASUREMENT
/begin MEASUREMENT tpu_kw_err_ff_a.prev_period "vorletzte Zahnperiode" ULONG FORMULA_0017 0 0.0 0.0 2396.745 READ_WRITE ECU_ADDRESS 0x3F9280 /end MEASUREMENT
/begin MEASUREMENT tpu_kw_err_ff_a.state "Zustand der TPU" UBYTE FORMULA_0016 0 0.0 0.0 255.0 READ_WRITE ECU_ADDRESS 0x3F9278 /end MEASUREMENT
/begin MEASUREMENT tpu_kw_err_ff_a.tooth "Abrisszahn" UBYTE FORMULA_0003 0 0.0 0.0 255.0 READ_WRITE ECU_ADDRESS 0x3F9279 /end MEASUREMENT
/begin MEASUREMENT tpu_kw_err_ff_a.tooth_time "letzte Zahnzeit" ULONG FORMULA_0017 0 0.0 0.0 2396.745 READ_WRITE ECU_ADDRESS 0x3F928C /end MEASUREMENT
/begin MEASUREMENT tpu_kw_err_ff_b.cnt "Abrisszaehler" UBYTE FORMULA_0003 0 0.0 0.0 255.0 READ_WRITE ECU_ADDRESS 0x3F9293 /end MEASUREMENT
/begin MEASUREMENT tpu_kw_err_ff_b.event_time "letzte Ereigniszeit" ULONG FORMULA_0017 0 0.0 0.0 2396.745 READ_WRITE ECU_ADDRESS 0x3F92A0 /end MEASUREMENT
/begin MEASUREMENT tpu_kw_err_ff_b.irq "Interruptarten" UBYTE FORMULA_0003 0 0.0 0.0 255.0 READ_WRITE ECU_ADDRESS 0x3F9292 /end MEASUREMENT
/begin MEASUREMENT tpu_kw_err_ff_b.last_period "letzte Zahnperiode" ULONG FORMULA_0017 0 0.0 0.0 2396.745 READ_WRITE ECU_ADDRESS 0x3F929C /end MEASUREMENT
/begin MEASUREMENT tpu_kw_err_ff_b.n "Abrissdrehzahl" SWORD FORMULA_0006 0 0.0 0.0 10000.0 READ_WRITE ECU_ADDRESS 0x3F9294 /end MEASUREMENT
/begin MEASUREMENT tpu_kw_err_ff_b.n_zahn "Abrisszahndrehzahl" SWORD FORMULA_0006 0 0.0 0.0 10000.0 READ_WRITE ECU_ADDRESS 0x3F9296 /end MEASUREMENT
/begin MEASUREMENT tpu_kw_err_ff_b.prev_period "vorletzte Zahnperiode" ULONG FORMULA_0017 0 0.0 0.0 2396.745 READ_WRITE ECU_ADDRESS 0x3F9298 /end MEASUREMENT
/begin MEASUREMENT tpu_kw_err_ff_b.state "Zustand der TPU" UBYTE FORMULA_0016 0 0.0 0.0 255.0 READ_WRITE ECU_ADDRESS 0x3F9290 /end MEASUREMENT
/begin MEASUREMENT tpu_kw_err_ff_b.tooth "Abrisszahn" UBYTE FORMULA_0003 0 0.0 0.0 255.0 READ_WRITE ECU_ADDRESS 0x3F9291 /end MEASUREMENT
/begin MEASUREMENT tpu_kw_err_ff_b.tooth_time "letzte Zahnzeit" ULONG FORMULA_0017 0 0.0 0.0 2396.745 READ_WRITE ECU_ADDRESS 0x3F92A4 /end MEASUREMENT
/begin MEASUREMENT tpu_kw_irq_info_cnt_nv_a "Anzahl Infointerrupts (+/- ein Zahn)." UBYTE FORMULA_0003 0 0.0 0.0 255.0 READ_WRITE ECU_ADDRESS 0x3F9258 /end MEASUREMENT
/begin MEASUREMENT tpu_kw_irq_info_cnt_nv_b "Anzahl Infointerrupts (+/- ein Zahn)." UBYTE FORMULA_0003 0 0.0 0.0 255.0 READ_WRITE ECU_ADDRESS 0x3F9259 /end MEASUREMENT
/begin MEASUREMENT vr_sci_err_cnt_nv_zyl1 "TPU SCI-Nachricht konnte nicht gestartet werden." UBYTE FORMULA_0003 0 0.0 0.0 255.0 READ_WRITE ECU_ADDRESS 0x3FA176 /end MEASUREMENT
/begin MEASUREMENT vr_sci_err_cnt_nv_zyl10 "TPU SCI-Nachricht konnte nicht gestartet werden." UBYTE FORMULA_0003 0 0.0 0.0 255.0 READ_WRITE ECU_ADDRESS 0x3FA17F /end MEASUREMENT
/begin MEASUREMENT vr_sci_err_cnt_nv_zyl2 "TPU SCI-Nachricht konnte nicht gestartet werden." UBYTE FORMULA_0003 0 0.0 0.0 255.0 READ_WRITE ECU_ADDRESS 0x3FA177 /end MEASUREMENT
/begin MEASUREMENT vr_sci_err_cnt_nv_zyl3 "TPU SCI-Nachricht konnte nicht gestartet werden." UBYTE FORMULA_0003 0 0.0 0.0 255.0 READ_WRITE ECU_ADDRESS 0x3FA178 /end MEASUREMENT
/begin MEASUREMENT vr_sci_err_cnt_nv_zyl4 "TPU SCI-Nachricht konnte nicht gestartet werden." UBYTE FORMULA_0003 0 0.0 0.0 255.0 READ_WRITE ECU_ADDRESS 0x3FA179 /end MEASUREMENT
/begin MEASUREMENT vr_sci_err_cnt_nv_zyl5 "TPU SCI-Nachricht konnte nicht gestartet werden." UBYTE FORMULA_0003 0 0.0 0.0 255.0 READ_WRITE ECU_ADDRESS 0x3FA17A /end MEASUREMENT
/begin MEASUREMENT vr_sci_err_cnt_nv_zyl6 "TPU SCI-Nachricht konnte nicht gestartet werden." UBYTE FORMULA_0003 0 0.0 0.0 255.0 READ_WRITE ECU_ADDRESS 0x3FA17B /end MEASUREMENT
/begin MEASUREMENT vr_sci_err_cnt_nv_zyl7 "TPU SCI-Nachricht konnte nicht gestartet werden." UBYTE FORMULA_0003 0 0.0 0.0 255.0 READ_WRITE ECU_ADDRESS 0x3FA17C /end MEASUREMENT
/begin MEASUREMENT vr_sci_err_cnt_nv_zyl8 "TPU SCI-Nachricht konnte nicht gestartet werden." UBYTE FORMULA_0003 0 0.0 0.0 255.0 READ_WRITE ECU_ADDRESS 0x3FA17D /end MEASUREMENT
/begin MEASUREMENT vr_sci_err_cnt_nv_zyl9 "TPU SCI-Nachricht konnte nicht gestartet werden." UBYTE FORMULA_0003 0 0.0 0.0 255.0 READ_WRITE ECU_ADDRESS 0x3FA17E /end MEASUREMENT
/begin MEASUREMENT vr_sci_err_msg_nv "TPU SCI-Nachricht zu spaet ausgegeben." UWORD FORMULA_0010 0 0.0 0.0 65535.0 READ_WRITE ECU_ADDRESS 0x3FA174 /end MEASUREMENT
/begin MEASUREMENT vr_set_cnt_nv_0 "Statistik Verstaerkungseinstellung." UBYTE FORMULA_0003 0 0.0 0.0 255.0 READ_WRITE ECU_ADDRESS 0x3FA180 /end MEASUREMENT
/begin MEASUREMENT vr_set_cnt_nv_1 "Statistik Verstaerkungseinstellung." UBYTE FORMULA_0003 0 0.0 0.0 255.0 READ_WRITE ECU_ADDRESS 0x3FA181 /end MEASUREMENT
/begin MEASUREMENT vr_set_cnt_nv_2 "Statistik Verstaerkungseinstellung." UBYTE FORMULA_0003 0 0.0 0.0 255.0 READ_WRITE ECU_ADDRESS 0x3FA182 /end MEASUREMENT
/begin MEASUREMENT vr_set_cnt_nv_3 "Statistik Verstaerkungseinstellung." UBYTE FORMULA_0003 0 0.0 0.0 255.0 READ_WRITE ECU_ADDRESS 0x3FA183 /end MEASUREMENT
/begin MEASUREMENT vr_set_cnt_nv_4 "Statistik Verstaerkungseinstellung." UBYTE FORMULA_0003 0 0.0 0.0 255.0 READ_WRITE ECU_ADDRESS 0x3FA184 /end MEASUREMENT
/begin MEASUREMENT vr_set_cnt_nv_5 "Statistik Verstaerkungseinstellung." UBYTE FORMULA_0003 0 0.0 0.0 255.0 READ_WRITE ECU_ADDRESS 0x3FA185 /end MEASUREMENT
/begin MEASUREMENT vr_set_cnt_nv_6 "Statistik Verstaerkungseinstellung." UBYTE FORMULA_0003 0 0.0 0.0 255.0 READ_WRITE ECU_ADDRESS 0x3FA186 /end MEASUREMENT
/begin MEASUREMENT vr_set_cnt_nv_7 "Statistik Verstaerkungseinstellung." UBYTE FORMULA_0003 0 0.0 0.0 255.0 READ_WRITE ECU_ADDRESS 0x3FA187 /end MEASUREMENT
/begin MEASUREMENT vr_set_cnt_nv_8 "Statistik Verstaerkungseinstellung." UBYTE FORMULA_0003 0 0.0 0.0 255.0 READ_WRITE ECU_ADDRESS 0x3FA188 /end MEASUREMENT
/begin MEASUREMENT zoelp_ans_cnt_nv "Anzahl der Ansteuerungen" UWORD FORMULA_0010 0 0.0 0.0 65535.0 READ_WRITE ECU_ADDRESS 0x3F9DC8 /end MEASUREMENT
/begin COMPU_METHOD FORMULA_0000 "FORMULA_0000" RAT_FUNC "%7.0" "-" COEFFS 0 1 0 0 0 1 /end COMPU_METHOD
/begin COMPU_METHOD FORMULA_0001 "FORMULA_0001" RAT_FUNC "%6.1" "%" COEFFS 0 10.0 0.0 0 0.0 1.0 /end COMPU_METHOD
/begin COMPU_METHOD FORMULA_0002 "FORMULA_0002" TAB_VERB "%3.0" "-" COMPU_TAB_REF FORMULA_0002_VTAB /end COMPU_METHOD
/begin COMPU_METHOD FORMULA_0003 "FORMULA_0003" RAT_FUNC "%3.0" "-" COEFFS 0 1 0 0 0 1 /end COMPU_METHOD
/begin COMPU_METHOD FORMULA_0004 "FORMULA_0004" TAB_VERB "%5.2" "-" COMPU_TAB_REF FORMULA_0004_VTAB /end COMPU_METHOD
/begin COMPU_METHOD FORMULA_0005 "FORMULA_0005" TAB_VERB "%5.2" "-" COMPU_TAB_REF FORMULA_0005_VTAB /end COMPU_METHOD
/begin COMPU_METHOD FORMULA_0006 "FORMULA_0006" RAT_FUNC "%5.0" "Upm" COEFFS 0 1 0 0 0 1 /end COMPU_METHOD
/begin COMPU_METHOD FORMULA_0007 "FORMULA_0007" RAT_FUNC "%8.3" "-" COEFFS 0 10000.0 0.0 0 0.0 1.0 /end COMPU_METHOD
/begin COMPU_METHOD FORMULA_0008 "FORMULA_0008" RAT_FUNC "%6.1" "V" COEFFS 0 10.0 0.0 0 0.0 1.0 /end COMPU_METHOD
/begin COMPU_METHOD FORMULA_0009 "FORMULA_0009" RAT_FUNC "%6.1" "Nm" COEFFS 0 10.0 0.0 0 0.0 1.0 /end COMPU_METHOD
/begin COMPU_METHOD FORMULA_0010 "FORMULA_0010" RAT_FUNC "%5.0" "-" COEFFS 0 1 0 0 0 1 /end COMPU_METHOD
/begin COMPU_METHOD FORMULA_0011 "FORMULA_0011" TAB_VERB "%5.0" "-" COMPU_TAB_REF FORMULA_0011_VTAB /end COMPU_METHOD
/begin COMPU_METHOD FORMULA_0012 "FORMULA_0012" TAB_VERB "%3.0" "-" COMPU_TAB_REF FORMULA_0012_VTAB /end COMPU_METHOD
/begin COMPU_METHOD FORMULA_0013 "FORMULA_0013" TAB_VERB "%3.0" "-" COMPU_TAB_REF FORMULA_0013_VTAB /end COMPU_METHOD
/begin COMPU_METHOD FORMULA_0014 "FORMULA_0014" TAB_VERB "%3.0" "-" COMPU_TAB_REF FORMULA_0014_VTAB /end COMPU_METHOD
/begin COMPU_METHOD FORMULA_0015 "FORMULA_0015" TAB_VERB "%5.0" "-" COMPU_TAB_REF FORMULA_0015_VTAB /end COMPU_METHOD
/begin COMPU_METHOD FORMULA_0016 "FORMULA_0016" TAB_VERB "%3.0" "-" COMPU_TAB_REF FORMULA_0016_VTAB /end COMPU_METHOD
/begin COMPU_METHOD FORMULA_0017 "FORMULA_0017" RAT_FUNC "%9.2" "ms" COEFFS 0 7000.0 0.0 0 0.0 1.0 /end COMPU_METHOD
/begin COMPU_METHOD FORMULA_0018 "FORMULA_0018" RAT_FUNC "%5.0" "us" COEFFS 0 1 0 0 0 1 /end COMPU_METHOD
/begin COMPU_METHOD FORMULA_0019 "FORMULA_0019" TAB_VERB "%7.2" "-" COMPU_TAB_REF FORMULA_0019_VTAB /end COMPU_METHOD
/begin COMPU_METHOD FORMULA_0020 "FORMULA_0020" RAT_FUNC "%5.0" "qmm/s" COEFFS 0 5.e-002 0.0 0 0.0 1.0 /end COMPU_METHOD
/begin COMPU_METHOD FORMULA_0021 "FORMULA_0021" RAT_FUNC "%7.2" "s" COEFFS 0 100.0 0.0 0 0.0 1.0 /end COMPU_METHOD
/begin COMPU_METHOD FORMULA_0022 "FORMULA_0022" RAT_FUNC "%7.2" "%" COEFFS 0 100.0 0.0 0 0.0 1.0 /end COMPU_METHOD
/begin COMPU_METHOD FORMULA_0023 "FORMULA_0023" RAT_FUNC "%6.1" "°C" COEFFS 0 10.0 2732.0 0 0.0 1.0 /end COMPU_METHOD
/begin COMPU_METHOD FORMULA_0024 "FORMULA_0024" RAT_FUNC "%9.4" "-" COEFFS 0 32768.0 0.0 0 0.0 1.0 /end COMPU_METHOD
/begin COMPU_METHOD FORMULA_0025 "FORMULA_0025" RAT_FUNC "%8.3" "-" COEFFS 0 16384.0 0.0 0 0.0 1.0 /end COMPU_METHOD
/begin COMPU_METHOD FORMULA_0026 "FORMULA_0026" TAB_VERB "%3.0" "-" COMPU_TAB_REF FORMULA_0026_VTAB /end COMPU_METHOD
/begin COMPU_METHOD FORMULA_0027 "FORMULA_0027" RAT_FUNC "%7.0" "km" COEFFS 0 1 0 0 0 1 /end COMPU_METHOD
/begin COMPU_METHOD FORMULA_0028 "FORMULA_0028" TAB_VERB "%3.0" "-" COMPU_TAB_REF FORMULA_0028_VTAB /end COMPU_METHOD
/begin COMPU_METHOD FORMULA_0029 "FORMULA_0029" TAB_VERB "%3.0" "-" COMPU_TAB_REF FORMULA_0029_VTAB /end COMPU_METHOD
/begin COMPU_METHOD FORMULA_0030 "FORMULA_0030" TAB_VERB "%3.0" "-" COMPU_TAB_REF FORMULA_0030_VTAB /end COMPU_METHOD
/begin COMPU_METHOD FORMULA_0031 "FORMULA_0031" TAB_VERB "%3.0" "-" COMPU_TAB_REF FORMULA_0031_VTAB /end COMPU_METHOD
/begin COMPU_METHOD FORMULA_0032 "FORMULA_0032" RAT_FUNC "%3.0" "%" COEFFS 0 1 0 0 0 1 /end COMPU_METHOD
/begin COMPU_METHOD FORMULA_0033 "FORMULA_0033" TAB_VERB "%3.0" "-" COMPU_TAB_REF FORMULA_0033_VTAB /end COMPU_METHOD
/begin COMPU_METHOD FORMULA_0034 "FORMULA_0034" TAB_VERB "%3.0" "-" COMPU_TAB_REF FORMULA_0034_VTAB /end COMPU_METHOD
/begin COMPU_METHOD FORMULA_0035 "FORMULA_0035" TAB_VERB "%3.0" "-" COMPU_TAB_REF FORMULA_0035_VTAB /end COMPU_METHOD
/begin COMPU_METHOD FORMULA_0036 "FORMULA_0036" TAB_VERB "%3.0" "-" COMPU_TAB_REF FORMULA_0036_VTAB /end COMPU_METHOD
/begin COMPU_METHOD FORMULA_0037 "FORMULA_0037" RAT_FUNC "%5.2" "-" COEFFS 0 1 0 0 0 1 /end COMPU_METHOD
/begin COMPU_METHOD FORMULA_0038 "FORMULA_0038" TAB_VERB "%5.2" "-" COMPU_TAB_REF FORMULA_0038_VTAB /end COMPU_METHOD
/begin COMPU_METHOD FORMULA_0039 "FORMULA_0039" TAB_VERB "%5.2" "-" COMPU_TAB_REF FORMULA_0039_VTAB /end COMPU_METHOD
/begin COMPU_METHOD FORMULA_0040 "FORMULA_0040" TAB_VERB "%5.2" "-" COMPU_TAB_REF FORMULA_0040_VTAB /end COMPU_METHOD
/begin COMPU_METHOD FORMULA_0041 "FORMULA_0041" TAB_VERB "%5.2" "-" COMPU_TAB_REF FORMULA_0041_VTAB /end COMPU_METHOD
/begin COMPU_METHOD FORMULA_0044 "FORMULA_0044" RAT_FUNC "%9.2" "-" COEFFS 0 1 0 0 0 1 /end COMPU_METHOD
/begin COMPU_METHOD FORMULA_0071 "FORMULA_0071" RAT_FUNC "%6.1" "s" COEFFS 0 10.0 0.0 0 0.0 1.0 /end COMPU_METHOD
/begin COMPU_METHOD FORMULA_0073 "FORMULA_0073" RAT_FUNC "%8.3" "-" COEFFS 0 1024.0 0.0 0 0.0 1.0 /end COMPU_METHOD
/begin COMPU_METHOD FORMULA_0074 "FORMULA_0074" RAT_FUNC "%6.1" "Kelvin" COEFFS 0 10.0 0.0 0 0.0 1.0 /end COMPU_METHOD
/begin COMPU_METHOD FORMULA_0075 "FORMULA_0075" RAT_FUNC "%6.1" "mbar" COEFFS 0 16.0 0.0 0 0.0 1.0 /end COMPU_METHOD
/begin COMPU_METHOD FORMULA_0076 "FORMULA_0076" RAT_FUNC "%6.1" "km/h" COEFFS 0 16.0 0.0 0 0.0 1.0 /end COMPU_METHOD
/begin COMPU_METHOD FORMULA_0090 "FORMULA_0090" RAT_FUNC "%7.2" "mg" COEFFS 0 10.0 0.0 0 0.0 1.0 /end COMPU_METHOD
/begin COMPU_METHOD FORMULA_0100 "FORMULA_0100" RAT_FUNC "%7.2" "-" COEFFS 0 10000.0 0.0 0 0.0 1.0 /end COMPU_METHOD
/begin COMPU_METHOD FORMULA_0102 "FORMULA_0102" RAT_FUNC "%6.1" "°KW" COEFFS 0 10.0 0.0 0 0.0 1.0 /end COMPU_METHOD
/begin COMPU_METHOD FORMULA_0103 "FORMULA_0103" RAT_FUNC "%6.1" "kg/h" COEFFS 0 10.0 0.0 0 0.0 1.0 /end COMPU_METHOD
/begin COMPU_METHOD FORMULA_0105 "FORMULA_0105" RAT_FUNC "%5.0" "Upm/s" COEFFS 0 1 0 0 0 1 /end COMPU_METHOD
/begin COMPU_METHOD FORMULA_0107 "FORMULA_0107" RAT_FUNC "%6.1" "%" COEFFS 0 10.24 0.0 0 0.0 1.0 /end COMPU_METHOD
/begin COMPU_METHOD FORMULA_0109 "FORMULA_0109" RAT_FUNC "%7.2" "s" COEFFS 0 200.0 0.0 0 0.0 1.0 /end COMPU_METHOD
/begin COMPU_METHOD FORMULA_0110 "FORMULA_0110" RAT_FUNC "%8.3" "bar" COEFFS 0 1000.0 0.0 0 0.0 1.0 /end COMPU_METHOD
/begin COMPU_METHOD FORMULA_0111 "FORMULA_0111" RAT_FUNC "%7.2" "mg" COEFFS 0 64.0 0.0 0 0.0 1.0 /end COMPU_METHOD
/begin COMPU_METHOD FORMULA_0114 "FORMULA_0114" RAT_FUNC "%5.0" "digit" COEFFS 0 1 0 0 0 1 /end COMPU_METHOD
/begin COMPU_METHOD FORMULA_0117 "FORMULA_0117" TAB_VERB "%3.0" "-" COMPU_TAB_REF FORMULA_0117_VTAB /end COMPU_METHOD
/begin COMPU_METHOD FORMULA_0123 "FORMULA_0123" RAT_FUNC "%7.2" "m/(s*s)" COEFFS 0 40.0 0.0 0 0.0 1.0 /end COMPU_METHOD
/begin COMPU_METHOD FORMULA_0129 "FORMULA_0129" RAT_FUNC "%3.0" "bar" COEFFS 0 1 0 0 0 1 /end COMPU_METHOD
/begin COMPU_METHOD FORMULA_0132 "FORMULA_0132" RAT_FUNC "%7.2" "Grad" COEFFS 0 22.75312855517634 0.0 0 0.0 1.0 /end COMPU_METHOD
/begin COMPU_METHOD FORMULA_0135 "FORMULA_0135" RAT_FUNC "%3.0" ".Gang" COEFFS 0 1 0 0 0 1 /end COMPU_METHOD
/begin COMPU_METHOD FORMULA_0143 "FORMULA_0143" RAT_FUNC "%6.1" "qmm" COEFFS 0 10.0 0.0 0 0.0 1.0 /end COMPU_METHOD
/begin COMPU_METHOD FORMULA_0145 "FORMULA_0145" RAT_FUNC "%9.2" "min" COEFFS 0 60.0 0.0 0 0.0 1.0 /end COMPU_METHOD
/begin COMPU_METHOD FORMULA_0147 "FORMULA_0147" RAT_FUNC "%9.2" "s" COEFFS 0 100.0 0.0 0 0.0 1.0 /end COMPU_METHOD
/begin COMPU_METHOD FORMULA_0167 "FORMULA_0167" TAB_VERB "%3.0" "-" COMPU_TAB_REF FORMULA_0167_VTAB /end COMPU_METHOD
/begin COMPU_METHOD FORMULA_0199 "FORMULA_0199" RAT_FUNC "%9.4" "-" COEFFS 0 16384.0 0.0 0 0.0 1.0 /end COMPU_METHOD
/begin COMPU_METHOD FORMULA_0225 "FORMULA_0225" RAT_FUNC "%10.3" "°KW" COEFFS 0 81920.0 0.0 0 0.0 1.0 /end COMPU_METHOD
/begin COMPU_METHOD FORMULA_0227 "FORMULA_0227" RAT_FUNC "%7.2" "nSs" COEFFS 0 51.22410237444204 0.0 0 0.0 1.0 /end COMPU_METHOD
/begin COMPU_METHOD FORMULA_0250 "FORMULA_0250" RAT_FUNC "%8.3" "V" COEFFS 0 204.8 0.0 0 0.0 1.0 /end COMPU_METHOD
/begin COMPU_METHOD FORMULA_0251 "FORMULA_0251" RAT_FUNC "%8.3" "V" COEFFS 0 409.6 0.0 0 0.0 1.0 /end COMPU_METHOD
/begin COMPU_METHOD FORMULA_0298 "FORMULA_0298" TAB_VERB "%5.2" "-" COMPU_TAB_REF FORMULA_0298_VTAB /end COMPU_METHOD
/begin COMPU_METHOD FORMULA_0342 "FORMULA_0342" RAT_FUNC "%7.2" "°C" COEFFS 0 20.0 5463.0 0 0.0 1.0 /end COMPU_METHOD
/begin COMPU_METHOD FORMULA_0363 "FORMULA_0363" RAT_FUNC "%9.2" "ms" COEFFS 0 1000.0 0.0 0 0.0 1.0 /end COMPU_METHOD
/begin COMPU_METHOD FORMULA_0419 "FORMULA_0419" TAB_VERB "%3.0" "-" COMPU_TAB_REF FORMULA_0419_VTAB /end COMPU_METHOD
/begin COMPU_METHOD FORMULA_0423 "FORMULA_0423" RAT_FUNC "%3.0" "mal" COEFFS 0 1 0 0 0 1 /end COMPU_METHOD
/begin COMPU_METHOD FORMULA_0424 "FORMULA_0424" RAT_FUNC "%7.2" "qmm" COEFFS 0 100.0 0.0 0 0.0 1.0 /end COMPU_METHOD
/begin COMPU_METHOD FORMULA_0425 "FORMULA_0425" RAT_FUNC "%3.0" "Bit" COEFFS 0 0.25 0.0 0 0.0 1.0 /end COMPU_METHOD
/begin COMPU_METHOD FORMULA_0426 "FORMULA_0426" TAB_VERB "%5.2" "-" COMPU_TAB_REF FORMULA_0426_VTAB /end COMPU_METHOD
/begin COMPU_METHOD FORMULA_0427 "FORMULA_0427" TAB_VERB "%5.2" "-" COMPU_TAB_REF FORMULA_0427_VTAB /end COMPU_METHOD
/begin COMPU_METHOD FORMULA_0428 "FORMULA_0428" TAB_VERB "%3.0" "-" COMPU_TAB_REF FORMULA_0428_VTAB /end COMPU_METHOD
/begin COMPU_METHOD FORMULA_0429 "FORMULA_0429" TAB_VERB "%5.2" "-" COMPU_TAB_REF FORMULA_0429_VTAB /end COMPU_METHOD
/begin COMPU_METHOD FORMULA_0430 "FORMULA_0430" TAB_VERB "%5.2" "-" COMPU_TAB_REF FORMULA_0430_VTAB /end COMPU_METHOD
/begin COMPU_METHOD FORMULA_0431 "FORMULA_0431" TAB_VERB "%5.0" "-" COMPU_TAB_REF FORMULA_0431_VTAB /end COMPU_METHOD
/begin COMPU_METHOD FORMULA_0432 "FORMULA_0432" TAB_VERB "%7.2" "-" COMPU_TAB_REF FORMULA_0432_VTAB /end COMPU_METHOD
/begin COMPU_METHOD FORMULA_0433 "FORMULA_0433" TAB_VERB "%5.0" "-" COMPU_TAB_REF FORMULA_0433_VTAB /end COMPU_METHOD
/begin COMPU_METHOD FORMULA_0434 "FORMULA_0434" TAB_VERB "%3.0" "-" COMPU_TAB_REF FORMULA_0434_VTAB /end COMPU_METHOD
/begin COMPU_METHOD FORMULA_0435 "FORMULA_0435" TAB_VERB "%3.0" "-" COMPU_TAB_REF FORMULA_0435_VTAB /end COMPU_METHOD
/begin COMPU_METHOD FORMULA_0436 "FORMULA_0436" TAB_VERB "%5.2" "-" COMPU_TAB_REF FORMULA_0436_VTAB /end COMPU_METHOD
/begin COMPU_METHOD FORMULA_0437 "FORMULA_0437" RAT_FUNC "%6.1" "%" COEFFS 0 327.68 0.0 0 0.0 1.0 /end COMPU_METHOD
/begin COMPU_METHOD FORMULA_0438 "FORMULA_0438" TAB_VERB "%3.0" "-" COMPU_TAB_REF FORMULA_0438_VTAB /end COMPU_METHOD
/begin COMPU_METHOD FORMULA_0439 "FORMULA_0439" TAB_VERB "%3.0" "-" COMPU_TAB_REF FORMULA_0439_VTAB /end COMPU_METHOD
/begin COMPU_METHOD FORMULA_0440 "FORMULA_0440" TAB_VERB "%3.0" "-" COMPU_TAB_REF FORMULA_0440_VTAB /end COMPU_METHOD
/begin COMPU_METHOD FORMULA_0441 "FORMULA_0441" TAB_VERB "%3.0" "-" COMPU_TAB_REF FORMULA_0441_VTAB /end COMPU_METHOD
/begin COMPU_METHOD FORMULA_0442 "FORMULA_0442" RAT_FUNC "%7.2" "V" COEFFS 0 1241.21837996177 0.0 0 0.0 1.0 /end COMPU_METHOD
/begin COMPU_METHOD FORMULA_0443 "FORMULA_0443" RAT_FUNC "%3.0" "-" COEFFS 0 0.25 0.0 0 0.0 1.0 /end COMPU_METHOD
/begin COMPU_METHOD FORMULA_0444 "FORMULA_0444" TAB_VERB "%5.0" "-" COMPU_TAB_REF FORMULA_0444_VTAB /end COMPU_METHOD
/begin COMPU_METHOD FORMULA_0445 "FORMULA_0445" RAT_FUNC "%7.2" "ms" COEFFS 0 7000.0 0.0 0 0.0 1.0 /end COMPU_METHOD
/begin COMPU_METHOD FORMULA_0446 "FORMULA_0446" RAT_FUNC "%7.2" "ms" COEFFS 0 250.0 0.0 0 0.0 1.0 /end COMPU_METHOD
/begin COMPU_METHOD FORMULA_0447 "FORMULA_0447" RAT_FUNC "%8.3" "*" COEFFS 0 512.0 0.0 0 0.0 1.0 /end COMPU_METHOD
/begin COMPU_METHOD FORMULA_0448 "FORMULA_0448" RAT_FUNC "%8.3" "%" COEFFS 0 640.0 0.0 0 0.0 1.0 /end COMPU_METHOD
/begin COMPU_METHOD FORMULA_0449 "FORMULA_0449" RAT_FUNC "%7.0" "mal" COEFFS 0 1 0 0 0 1 /end COMPU_METHOD
/begin COMPU_METHOD FORMULA_0450 "FORMULA_0450" RAT_FUNC "%5.0" "bytes" COEFFS 0 0.25 0.0 0 0.0 1.0 /end COMPU_METHOD
/begin COMPU_METHOD FORMULA_0451 "FORMULA_0451" RAT_FUNC "%5.0" "VERS" COEFFS 0 1 0 0 0 1 /end COMPU_METHOD
/begin COMPU_METHOD FORMULA_0452 "FORMULA_0452" RAT_FUNC "%8.1" "s" COEFFS 0 10.0 0.0 0 0.0 1.0 /end COMPU_METHOD
/begin COMPU_METHOD FORMULA_0453 "FORMULA_0453" RAT_FUNC "%5.0" "zyklen" COEFFS 0 1 0 0 0 1 /end COMPU_METHOD
/begin COMPU_METHOD FORMULA_0454 "FORMULA_0454" RAT_FUNC "%7.2" "m/(s*s)" COEFFS 0 14.61887523581298 0.0 0 0.0 1.0 /end COMPU_METHOD
/begin COMPU_METHOD FORMULA_0470 "FORMULA_0470" RAT_FUNC "%6.3" "s" COEFFS 0 0 1.28 0 1 0 /end COMPU_METHOD
/begin COMPU_METHOD FORMULA_0473 "FORMULA_0473" TAB_VERB "%3.0" "-" COMPU_TAB_REF FORMULA_0473_VTAB /end COMPU_METHOD
/begin COMPU_METHOD FORMULA_0474 "FORMULA_0474" TAB_VERB "%3.0" "-" COMPU_TAB_REF FORMULA_0474_VTAB /end COMPU_METHOD
/begin COMPU_METHOD FORMULA_0475 "FORMULA_0475" RAT_FUNC "%5.0" "Upm/s" COEFFS 0 5.e-003 0.0 0 0.0 1.0 /end COMPU_METHOD
/begin COMPU_METHOD FORMULA_0476 "FORMULA_0476" TAB_VERB "%5.2" "-" COMPU_TAB_REF FORMULA_0476_VTAB /end COMPU_METHOD
/begin COMPU_METHOD FORMULA_0477 "FORMULA_0477" RAT_FUNC "%7.2" "Nm/Upm" COEFFS 0 5120.0 0.0 0 0.0 1.0 /end COMPU_METHOD
/begin COMPU_METHOD FORMULA_0478 "FORMULA_0478" RAT_FUNC "%9.4" "-" COEFFS 0 1048576.0 0.0 0 0.0 1.0 /end COMPU_METHOD
/begin COMPU_METHOD FORMULA_0479 "FORMULA_0479" RAT_FUNC "%5.0" ".Gang" COEFFS 0 1 0 0 0 1 /end COMPU_METHOD
/begin COMPU_METHOD FORMULA_0480 "FORMULA_0480" TAB_VERB "%5.2" "-" COMPU_TAB_REF FORMULA_0480_VTAB /end COMPU_METHOD
/begin COMPU_METHOD FORMULA_0481 "FORMULA_0481" TAB_VERB "%5.2" "-" COMPU_TAB_REF FORMULA_0481_VTAB /end COMPU_METHOD
/begin COMPU_METHOD FORMULA_0482 "FORMULA_0482" RAT_FUNC "%9.4" "-" COEFFS 0 8192.0 0.0 0 0.0 1.0 /end COMPU_METHOD
/begin COMPU_METHOD FORMULA_0483 "FORMULA_0483" RAT_FUNC "%6.1" "trmp" COEFFS 0 16.0 0.0 0 0.0 1.0 /end COMPU_METHOD
/begin COMPU_METHOD FORMULA_0484 "FORMULA_0484" RAT_FUNC "%6.1" "%" COEFFS 0 100.0 0.0 0 0.0 1.0 /end COMPU_METHOD
/begin COMPU_METHOD FORMULA_0485 "FORMULA_0485" RAT_FUNC "%10.3" "Nm/trmp" COEFFS 0 1000.0 0.0 0 0.0 1.0 /end COMPU_METHOD
/begin COMPU_METHOD FORMULA_0486 "FORMULA_0486" TAB_VERB "%3.0" "-" COMPU_TAB_REF FORMULA_0486_VTAB /end COMPU_METHOD
/begin COMPU_METHOD FORMULA_0487 "FORMULA_0487" RAT_FUNC "%3.0" "Hz" COEFFS 0 1 0 0 0 1 /end COMPU_METHOD
/begin COMPU_METHOD FORMULA_0488 "FORMULA_0488" RAT_FUNC "%7.2" "-" COEFFS 0 100.0 0.0 0 0.0 1.0 /end COMPU_METHOD
/begin COMPU_METHOD FORMULA_0489 "FORMULA_0489" RAT_FUNC "%7.2" "Nm/trmp" COEFFS 0 100.0 0.0 0 0.0 1.0 /end COMPU_METHOD
/begin COMPU_METHOD FORMULA_0490 "FORMULA_0490" RAT_FUNC "%8.3" "s" COEFFS 0 1000.0 0.0 0 0.0 1.0 /end COMPU_METHOD
/begin COMPU_METHOD FORMULA_0681 "FORMULA_0681" RAT_FUNC "%7.2" "s" COEFFS 0 0 6553.5 0 1 0 /end COMPU_METHOD
/begin COMPU_METHOD FORMULA_0706 "FORMULA_0706" RAT_FUNC "%7.2" "min" COEFFS 0 60.0 0.0 0 0.0 1.0 /end COMPU_METHOD
/begin COMPU_METHOD FORMULA_0746 "FORMULA_0746" RAT_FUNC "%5.2" "s" COEFFS 0 0 25.6 0 1 0 /end COMPU_METHOD
/begin COMPU_METHOD FORMULA_0961 "FORMULA_0961" RAT_FUNC "%7.2" "Kelvin" COEFFS 0 100.0 0.0 0 0.0 1.0 /end COMPU_METHOD
/begin COMPU_METHOD FORMULA_0962 "FORMULA_0962" TAB_VERB "%5.2" "-" COMPU_TAB_REF FORMULA_0962_VTAB /end COMPU_METHOD
/begin COMPU_METHOD FORMULA_0963 "FORMULA_0963" TAB_VERB "%5.2" "-" COMPU_TAB_REF FORMULA_0963_VTAB /end COMPU_METHOD
/begin COMPU_METHOD FORMULA_0964 "FORMULA_0964" TAB_VERB "%5.2" "-" COMPU_TAB_REF FORMULA_0964_VTAB /end COMPU_METHOD
/begin COMPU_METHOD FORMULA_0965 "FORMULA_0965" TAB_VERB "%5.2" "-" COMPU_TAB_REF FORMULA_0965_VTAB /end COMPU_METHOD
/begin COMPU_METHOD FORMULA_0966 "FORMULA_0966" TAB_VERB "%3.0" "-" COMPU_TAB_REF FORMULA_0966_VTAB /end COMPU_METHOD
/begin COMPU_METHOD FORMULA_0967 "FORMULA_0967" TAB_VERB "%3.0" "-" COMPU_TAB_REF FORMULA_0967_VTAB /end COMPU_METHOD
/begin COMPU_METHOD FORMULA_0968 "FORMULA_0968" RAT_FUNC "%9.4" "W/Km²" COEFFS 0 1000.0 0.0 0 0.0 1.0 /end COMPU_METHOD
/begin COMPU_METHOD FORMULA_0969 "FORMULA_0969" RAT_FUNC "%9.4" "Wh/Km²km" COEFFS 0 10000.0 0.0 0 0.0 1.0 /end COMPU_METHOD
/begin COMPU_METHOD FORMULA_0970 "FORMULA_0970" RAT_FUNC "%7.2" "Kelvin" COEFFS 0 20.0 0.0 0 0.0 1.0 /end COMPU_METHOD
/begin COMPU_METHOD FORMULA_0971 "FORMULA_0971" RAT_FUNC "%5.0" "J/(kg*K)" COEFFS 0 1 0 0 0 1 /end COMPU_METHOD
/begin COMPU_METHOD FORMULA_0972 "FORMULA_0972" RAT_FUNC "%5.0" "J/Kelvin" COEFFS 0 1 0 0 0 1 /end COMPU_METHOD
/begin COMPU_METHOD FORMULA_0973 "FORMULA_0973" RAT_FUNC "%9.4" "m²" COEFFS 0 10000.0 0.0 0 0.0 1.0 /end COMPU_METHOD
/begin COMPU_METHOD FORMULA_0974 "FORMULA_0974" RAT_FUNC "%6.1" "Kelvin/s" COEFFS 0 10.0 0.0 0 0.0 1.0 /end COMPU_METHOD
/begin COMPU_METHOD FORMULA_0975 "FORMULA_0975" RAT_FUNC "%8.3" "°C" COEFFS 0 40.0 10926.0 0 0.0 1.0 /end COMPU_METHOD
/begin COMPU_METHOD FORMULA_0976 "FORMULA_0976" TAB_VERB "%3.0" "-" COMPU_TAB_REF FORMULA_0976_VTAB /end COMPU_METHOD
/begin COMPU_METHOD FORMULA_0977 "FORMULA_0977" TAB_VERB "%3.0" "-" COMPU_TAB_REF FORMULA_0977_VTAB /end COMPU_METHOD
/begin COMPU_METHOD FORMULA_0978 "FORMULA_0978" TAB_VERB "%3.0" "-" COMPU_TAB_REF FORMULA_0978_VTAB /end COMPU_METHOD
/begin COMPU_METHOD FORMULA_0979 "FORMULA_0979" TAB_VERB "%3.0" "-" COMPU_TAB_REF FORMULA_0979_VTAB /end COMPU_METHOD
/begin COMPU_METHOD FORMULA_0980 "FORMULA_0980" RAT_FUNC "%7.2" "s" COEFFS 0 10.0 0.0 0 0.0 1.0 /end COMPU_METHOD
/begin COMPU_METHOD FORMULA_0981 "FORMULA_0981" RAT_FUNC "%7.2" "°C/s" COEFFS 0 4.0 1092.6 0 0.0 1.0 /end COMPU_METHOD
/begin COMPU_METHOD FORMULA_0982 "FORMULA_0982" TAB_VERB "%5.2" "-" COMPU_TAB_REF FORMULA_0982_VTAB /end COMPU_METHOD
/begin COMPU_METHOD FORMULA_0983 "FORMULA_0983" TAB_VERB "%5.2" "-" COMPU_TAB_REF FORMULA_0983_VTAB /end COMPU_METHOD
/begin COMPU_METHOD FORMULA_0984 "FORMULA_0984" TAB_VERB "%5.2" "-" COMPU_TAB_REF FORMULA_0984_VTAB /end COMPU_METHOD
/begin COMPU_METHOD FORMULA_0985 "FORMULA_0985" RAT_FUNC "%5.0" "Kelvin/s" COEFFS 0 1 0 0 0 1 /end COMPU_METHOD
/begin COMPU_VTAB FORMULA_0002_VTAB "FORMULA_0002_VTAB" TAB_VERB 4 0 "in Ordnung" 128 "queue full" 64 "queue fehler" 32 "IRQ illegal" DEFAULT_VALUE "undefiniert" /end COMPU_VTAB
/begin COMPU_VTAB FORMULA_0004_VTAB "FORMULA_0004_VTAB" TAB_VERB 9 0 "OK" 1 "NR CS0" 2 "NR CS1" 4 "NR CS2" 8 "NR CS3" 16 "CNT CS0" 17 "CNT CS1" 18 "CNT CS2" 20 "CNT CS3" /end COMPU_VTAB
/begin COMPU_VTAB FORMULA_0005_VTAB "FORMULA_0005_VTAB" TAB_VERB 7 0 "OK" 1 "Seg-Kanal" 2 "5ms-Kanal" 4 "10ms-Kanal" 8 "100ms-Kanal" 16 "bgnd-Kanal" 32 "kwp-Kanal" DEFAULT_VALUE "ungueltig" /end COMPU_VTAB
/begin COMPU_VTAB FORMULA_0011_VTAB "FORMULA_0011_VTAB" TAB_VERB 14 0 "kein Fehler" 1 "Egasueberwachung" 2 "Momentenueberwachung" 4 "Einspritzueberwachung" 8 "SMG-Ueberwachung" 16 "Systemfehler" 32 "Stackueberwachung" 64 "Resetanzahl" 128 "Gemischfehler" 512 "CRC-Check" 1024 "Taskueberwachung" 2048 "Prozessueberwachung" 4096 "Pedalwertgeber" 8192 "Mastervac" DEFAULT_VALUE "undef" /end COMPU_VTAB
/begin COMPU_VTAB FORMULA_0012_VTAB "FORMULA_0012_VTAB" TAB_VERB 1 0 "iO" DEFAULT_VALUE "Fehler" /end COMPU_VTAB
/begin COMPU_VTAB FORMULA_0013_VTAB "FORMULA_0013_VTAB" TAB_VERB 5 0 "CRC iO" 1 "D-Fehler" 2 "P-Fehler" 3 "PD-Fehler" 4 "B-Fehler" DEFAULT_VALUE "Mehrfachfehler" /end COMPU_VTAB
/begin COMPU_VTAB FORMULA_0014_VTAB "FORMULA_0014_VTAB" TAB_VERB 5 0 "OK" 3 "ID" 4 "Limit" 11 "Overrun" 14 "Stack" /end COMPU_VTAB
/begin COMPU_VTAB FORMULA_0015_VTAB "FORMULA_0015_VTAB" TAB_VERB 6 512 "MCI" 768 "DataAcc" 1024 "IntrAcc" 1536 "Align" 1792 "PrgExc" 8192 "NMI" /end COMPU_VTAB
/begin COMPU_VTAB FORMULA_0016_VTAB "FORMULA_0016_VTAB" TAB_VERB 13 0 "ini" 1 "1st edge" 2 "second edge" 3 "wait teeth" 4 "search gap" 5 "1st missing required" 6 "last tooth until gap" 7 "1st missing tooth" 8 "2nd missing tooth" 9 "1st tooth after gap" 10 "2nd tooth after gap" 11 "tooth 2..56, 62..116" 12 "gap required" DEFAULT_VALUE "undefined" /end COMPU_VTAB
/begin COMPU_VTAB FORMULA_0019_VTAB "FORMULA_0019_VTAB" TAB_VERB 13 1 "Motor steht" 2 "Motor presync" 4 "Start" 8 "LLOKS" 16 "LLMKS" 32 "TL" 64 "VL" 128 "SA" 256 "NL" 512 "Abgew." 1024 "Kl15 aus" 2048 "Wakeup" 4096 "Schub" DEFAULT_VALUE "undefiniert" /end COMPU_VTAB
/begin COMPU_VTAB FORMULA_0026_VTAB "FORMULA_0026_VTAB" TAB_VERB 4 0 "off" 1 "Fertigungsmode" 2 "Transportmode" 4 "Werkstattmode" DEFAULT_VALUE "off" /end COMPU_VTAB
/begin COMPU_VTAB FORMULA_0028_VTAB "FORMULA_0028_VTAB" TAB_VERB 7 0 "kein Land" 1 "ECE" 2 "US" 3 "D" 4 "GB" 5 "J" 255 "ungueltig" /end COMPU_VTAB
/begin COMPU_VTAB FORMULA_0029_VTAB "FORMULA_0029_VTAB" TAB_VERB 9 0 "keine Angabe" 4 "E60" 5 "E61" 6 "E63" 7 "E64" 8 "E90" 13 "E91" 14 "E92" 15 "E93" DEFAULT_VALUE "ungueltig" /end COMPU_VTAB
/begin COMPU_VTAB FORMULA_0030_VTAB "FORMULA_0030_VTAB" TAB_VERB 3 0 "v_max 250" 1 "reserviert" 2 "v_max angehoben" DEFAULT_VALUE "undef" /end COMPU_VTAB
/begin COMPU_VTAB FORMULA_0031_VTAB "FORMULA_0031_VTAB" TAB_VERB 6 0 "HS" 1 "Automat" 2 "Steptronic" 3 "SMG" 4 "DKG" 15 "ungueltig" /end COMPU_VTAB
/begin COMPU_VTAB FORMULA_0033_VTAB "FORMULA_0033_VTAB" TAB_VERB 2 255 "Lampe aktiviert" 254 "Lampe deaktiviert" DEFAULT_VALUE "undef" /end COMPU_VTAB
/begin COMPU_VTAB FORMULA_0034_VTAB "FORMULA_0034_VTAB" TAB_VERB 4 255 "25tkm" 254 "20tkm" 252 "12tkm" 248 "6tkm" DEFAULT_VALUE "undef" /end COMPU_VTAB
/begin COMPU_VTAB FORMULA_0035_VTAB "FORMULA_0035_VTAB" TAB_VERB 3 255 "Standard" 254 "minderwertig" 252 "bleihaltig" DEFAULT_VALUE "undef" /end COMPU_VTAB
/begin COMPU_VTAB FORMULA_0036_VTAB "FORMULA_0036_VTAB" TAB_VERB 10 255 "unknown" 254 "MJ2007" 253 "MJ2008" 252 "MJ2009" 251 "MJ2010" 250 "MJ2011" 249 "MJ2012" 248 "MJ2013" 247 "MJ2014" 246 "MJ2015" DEFAULT_VALUE "undef" /end COMPU_VTAB
/begin COMPU_VTAB FORMULA_0038_VTAB "FORMULA_0038_VTAB" TAB_VERB 1 0 "erfuellt" DEFAULT_VALUE "offen" /end COMPU_VTAB
/begin COMPU_VTAB FORMULA_0039_VTAB "FORMULA_0039_VTAB" TAB_VERB 1 0 "erfuellt" DEFAULT_VALUE "offen" /end COMPU_VTAB
/begin COMPU_VTAB FORMULA_0040_VTAB "FORMULA_0040_VTAB" TAB_VERB 1 0 "erfuellt" DEFAULT_VALUE "offen" /end COMPU_VTAB
/begin COMPU_VTAB FORMULA_0041_VTAB "FORMULA_0041_VTAB" TAB_VERB 1 0 "erfuellt" DEFAULT_VALUE "offen" /end COMPU_VTAB
/begin COMPU_VTAB FORMULA_0117_VTAB "FORMULA_0117_VTAB" TAB_VERB 8 0 "O.K." 1 "BusOff" 2 "DPR" 4 "Timeout" 5 "BusOff+Timeout" 8 "Overflow" 16 "Chksum" 32 "Alive" DEFAULT_VALUE "Mehrfachfehler" /end COMPU_VTAB
/begin COMPU_VTAB FORMULA_0167_VTAB "FORMULA_0167_VTAB" TAB_VERB 1 0 "kein Fehler" /end COMPU_VTAB
/begin COMPU_VTAB FORMULA_0298_VTAB "FORMULA_0298_VTAB" TAB_VERB 6 0 "Inaktiv" 1 "Abregeln" 2 "Schalten" 3 "Aufregeln" 4 "Ende" 15 "Error" /end COMPU_VTAB
/begin COMPU_VTAB FORMULA_0419_VTAB "FORMULA_0419_VTAB" TAB_VERB 63 45 "-" 48 "0" 49 "1" 50 "2" 51 "3" 52 "4" 53 "5" 54 "6" 55 "7" 56 "8" 57 "9" 65 "A" 66 "B" 67 "C" 68 "D" 69 "E" 70 "F" 71 "G" 72 "H" 73 "I" 74 "J" 75 "K" 76 "L" 77 "M" 78 "N" 79 "O" 80 "P" 81 "Q" 82 "R" 83 "S" 84 "T" 85 "U" 86 "V" 87 "W" 88 "X" 89 "Y" 90 "Z" 97 "a" 98 "b" 99 "c" 100 "d" 101 "e" 102 "f" 103 "g" 104 "h" 105 "i" 106 "j" 107 "k" 108 "l" 109 "m" 110 "n" 111 "o" 112 "p" 113 "q" 114 "r" 115 "s" 116 "t" 117 "u" 118 "v" 119 "w" 120 "x" 121 "y" 122 "z" DEFAULT_VALUE "DEZ" /end COMPU_VTAB
/begin COMPU_VTAB FORMULA_0426_VTAB "FORMULA_0426_VTAB" TAB_VERB 5 0 "offen" 1 "geschlossen" 2 "oeffnet" 3 "schliesst" 7 "Fehler" /end COMPU_VTAB
/begin COMPU_VTAB FORMULA_0427_VTAB "FORMULA_0427_VTAB" TAB_VERB 11 0 "Geschaltet" 1 "Aktiv" 2 "ZWK aktiv" 3 "synchronisiert" 4 "SW Neutral" 5 "vorspannen" 6 "Init" 7 "Synchron fertig" 8 "vor Synchron" 9 "vor Synchron aktiv" 15 "Fehler" /end COMPU_VTAB
/begin COMPU_VTAB FORMULA_0428_VTAB "FORMULA_0428_VTAB" TAB_VERB 11 0 "undef" 1 "Anfahren" 2 "Anfahren-KD" 3 "Wait-RS" 4 "Anfahren-RS" 5 "Schalten" 6 "Einkuppeln" 7 "Anhalten" 8 "Abwuergen" 9 "Radabriss" 15 "Fehler" /end COMPU_VTAB
/begin COMPU_VTAB FORMULA_0429_VTAB "FORMULA_0429_VTAB" TAB_VERB 2 0 "offen" 1 "geschlossen" DEFAULT_VALUE "undef" /end COMPU_VTAB
/begin COMPU_VTAB FORMULA_0430_VTAB "FORMULA_0430_VTAB" TAB_VERB 4 0 "kein Abbruch" 1 "Ablauf-Timeout" 2 "CAN-Timeout" 16 "Doppelschaltung" DEFAULT_VALUE "undef" /end COMPU_VTAB
/begin COMPU_VTAB FORMULA_0431_VTAB "FORMULA_0431_VTAB" TAB_VERB 8 0 "kein Fehler" 1 "R-Mode" 2 "Diagnose" 8 "CAN-Fehler" 16 "NP-Err" 32 "SK-Fehler" 12 "Alive" 64 "Startup" DEFAULT_VALUE "Mehrfachfehler" /end COMPU_VTAB
/begin COMPU_VTAB FORMULA_0432_VTAB "FORMULA_0432_VTAB" TAB_VERB 9 0 "kein Fehler" 1 "Soll-Vgl" 2 "Soll-Ist-Vgl" 4 "Mode-Vgl" 8 "CAN-Wert" 16 "Spalt offen" 32 "Klemmen offen" 64 "CAN-Istwert" 128 "WDK-CAN-Vgl" DEFAULT_VALUE "Mehrfachfehler" /end COMPU_VTAB
/begin COMPU_VTAB FORMULA_0433_VTAB "FORMULA_0433_VTAB" TAB_VERB 17 0 "kein Fehler" 1 "RAM-Fehler" 2 "ROM-Fehler" 4 "A/D Wandler-Fehler" 8 "Software Reset" 16 "CAN-Bus Fehler" 32 "CAN-Timeout" 64 "CAN-Fehler Chksum" 128 "CAN-Fehler Alive" 256 "Zylinderbankzuordnung" 512 "Bereichsueberwachung" 1024 "Gradientenueberwachung" 2048 "Lagereglerueberwachung" 4096 "therm. Ueberlast" 8192 "Motorschutz" 16384 "NP-Fehler" 32768 "NP-Abbruch" DEFAULT_VALUE "Mehrfachfehler" /end COMPU_VTAB
/begin COMPU_VTAB FORMULA_0434_VTAB "FORMULA_0434_VTAB" TAB_VERB 6 1 "oA aus" 2 "oA aktiv" 4 "oA erfolgreich" 9 "oA abgelehnt" 10 "oA abgebrochen" 12 "oA fehlerhaft" DEFAULT_VALUE "undef" /end COMPU_VTAB
/begin COMPU_VTAB FORMULA_0435_VTAB "FORMULA_0435_VTAB" TAB_VERB 7 0 "Init" 1 "Inaktiv" 2 "NP-Adapt" 4 "Aktiv" 8 "Zust bb" 10 "Federtest" 15 "Failsafe" /end COMPU_VTAB
/begin COMPU_VTAB FORMULA_0436_VTAB "FORMULA_0436_VTAB" TAB_VERB 5 0 "Wait" 1 "Inaktiv" 2 "Aktiv" 3 "Aktiv/Adapt" 255 "Failsafe" /end COMPU_VTAB
/begin COMPU_VTAB FORMULA_0438_VTAB "FORMULA_0438_VTAB" TAB_VERB 7 0 "kein Fehler" 1 "Md-Chk0" 2 "Md-Chk" 4 "MDmin-Chk" 8 "Rf-Chk" 16 "Eta-Chk" 32 "LLR-Chk" DEFAULT_VALUE "Mehrfach" /end COMPU_VTAB
/begin COMPU_VTAB FORMULA_0439_VTAB "FORMULA_0439_VTAB" TAB_VERB 1 0 "nein" DEFAULT_VALUE "ja" /end COMPU_VTAB
/begin COMPU_VTAB FORMULA_0440_VTAB "FORMULA_0440_VTAB" TAB_VERB 22 0 "Fahrer" 1 "SMG" 2 "ASC" 3 "MSR" 4 "Schub" 5 "MCS" 16 "Fahrer+LLR" 17 "SMG+LLR" 18 "ASC+LLR" 19 "MSR+LLR" 32 "Fahrer+AR" 33 "SMG+AR" 34 "ASC+AR" 35 "MSR+AR" 64 "Fahrer+Begr" 65 "SMG+Begr" 66 "ASC+Begr" 67 "MSR+Begr" 128 "Fahrer+SK" 129 "SMG+SK" 130 "ASC+SK" 131 "MSR+SK" DEFAULT_VALUE "Mehrfach" /end COMPU_VTAB
/begin COMPU_VTAB FORMULA_0441_VTAB "FORMULA_0441_VTAB" TAB_VERB 4 0 "aus" 2 "FF" 4 "MIL" 6 "FF+MIL" /end COMPU_VTAB
/begin COMPU_VTAB FORMULA_0444_VTAB "FORMULA_0444_VTAB" TAB_VERB 2 0 "leer" 1 "gespeichert" DEFAULT_VALUE "eingefroren" /end COMPU_VTAB
/begin COMPU_VTAB FORMULA_0473_VTAB "FORMULA_0473_VTAB" TAB_VERB 7 0 "Warten" 1 "Init" 2 "Gesperrt" 3 "Init+Gesperrt" 4 "Frei" 8 "Aktiv" 12 "Frei+Aktiv" /end COMPU_VTAB
/begin COMPU_VTAB FORMULA_0474_VTAB "FORMULA_0474_VTAB" TAB_VERB 4 0 "Erwarte_1" 1 "Aktiv" 2 "Erwarte_2B" 3 "Erwarte_2V" /end COMPU_VTAB
/begin COMPU_VTAB FORMULA_0476_VTAB "FORMULA_0476_VTAB" TAB_VERB 5 0 "AR aus" 1 "1B+1V" 3 "2B+1V" 5 "1B+2V" 7 "2B+2V" DEFAULT_VALUE "undef" /end COMPU_VTAB
/begin COMPU_VTAB FORMULA_0480_VTAB "FORMULA_0480_VTAB" TAB_VERB 2 0 "AT gesperrt" 1 "AT freigegeben" /end COMPU_VTAB
/begin COMPU_VTAB FORMULA_0481_VTAB "FORMULA_0481_VTAB" TAB_VERB 2 0 "AT kein Eingriff" 1 "AT Eingriff" /end COMPU_VTAB
/begin COMPU_VTAB FORMULA_0486_VTAB "FORMULA_0486_VTAB" TAB_VERB 3 0 "Aus" 1 "immer Aktiv" 2 "HS Aktiv" /end COMPU_VTAB
/begin COMPU_VTAB FORMULA_0962_VTAB "FORMULA_0962_VTAB" TAB_VERB 1 0 "Abregeln_B1" DEFAULT_VALUE "Aufregeln_B1" /end COMPU_VTAB
/begin COMPU_VTAB FORMULA_0963_VTAB "FORMULA_0963_VTAB" TAB_VERB 1 0 "Abregeln_B2" DEFAULT_VALUE "Aufregeln_B2" /end COMPU_VTAB
/begin COMPU_VTAB FORMULA_0964_VTAB "FORMULA_0964_VTAB" TAB_VERB 1 0 "No_Init_B1" DEFAULT_VALUE "Init_B1" /end COMPU_VTAB
/begin COMPU_VTAB FORMULA_0965_VTAB "FORMULA_0965_VTAB" TAB_VERB 1 0 "No_Init_B2" DEFAULT_VALUE "Init_B2" /end COMPU_VTAB
/begin COMPU_VTAB FORMULA_0966_VTAB "FORMULA_0966_VTAB" TAB_VERB 3 0 "Messwert" 1 "Modell" 2 "kein Sensor" /end COMPU_VTAB
/begin COMPU_VTAB FORMULA_0967_VTAB "FORMULA_0967_VTAB" TAB_VERB 2 0 "Messwert" 1 "Modell" /end COMPU_VTAB
/begin COMPU_VTAB FORMULA_0976_VTAB "FORMULA_0976_VTAB" TAB_VERB 5 0 "O.K." 1 "Fehler HFM" 2 "Fehler TMOT" 4 "Fehler TUMG" 8 "Fehler time_ms" DEFAULT_VALUE "undef" /end COMPU_VTAB
/begin COMPU_VTAB FORMULA_0977_VTAB "FORMULA_0977_VTAB" TAB_VERB 3 0 "kein Ersatzwert" 1 "HFM1 ist Ersatzwert" 2 "HFM2 ist Ersatzwert" DEFAULT_VALUE "undef" /end COMPU_VTAB
/begin COMPU_VTAB FORMULA_0978_VTAB "FORMULA_0978_VTAB" TAB_VERB 3 0 "Bedingungen" 1 "O.K." 16 "Fehler" DEFAULT_VALUE "undef" /end COMPU_VTAB
/begin COMPU_VTAB FORMULA_0979_VTAB "FORMULA_0979_VTAB" TAB_VERB 3 0 "Fehlt" 1 "O.K." 16 "Fehler" DEFAULT_VALUE "undef" /end COMPU_VTAB
/begin COMPU_VTAB FORMULA_0982_VTAB "FORMULA_0982_VTAB" TAB_VERB 2 0 "Disabled" 1 "Enabled" /end COMPU_VTAB
/begin COMPU_VTAB FORMULA_0983_VTAB "FORMULA_0983_VTAB" TAB_VERB 2 0 "Not Allowed" 1 "Allowed" /end COMPU_VTAB
/begin COMPU_VTAB FORMULA_0984_VTAB "FORMULA_0984_VTAB" TAB_VERB 2 0 "All Conditions" 1 "No Conditions" /end COMPU_VTAB
/begin FUNCTION Abgastemperatur ""
 /begin DEF_CHARACTERISTIC K_TABG_C K_TABG_DIAG_MAX K_TABG_DIAG_MIN K_TABG_DIAG_PLAUSI_AKTIV_T_ML K_TABG_DIAG_PLAUSI_DELTA_NEG K_TABG_DIAG_PLAUSI_DELTA_POS K_TABG_DIAG_TIME K_TABG_KAT_EXO_HYS K_TABG_KAT_EXO_MS_SCHWELLE K_TABG_KAT_EXO_ON K_TABG_KAT_MC K_TABG_KAT_T_OFFS_AB K_TABG_KAT_T_OFFS_AUF K_TABG_LW_AUSBLEND_OFFS K_TABG_NKAT_A K_TABG_NKAT_CFG K_TABG_NKAT_K_TUMG K_TABG_NKAT_K_V K_TABG_NKAT_MAX_CFG K_TABG_NKAT_MC K_TABG_PST_V K_TABG_STAND_MAX K_TABG_TAU K_TABG_VKAT_A K_TABG_VKAT_K_V K_TABG_VKAT_MC K_TABG_VKAT_REAK_SCHWELLE KF_TABG_LW_STAT KL_TABG_DIAG_PLAUSI_ML_FAK KL_TABG_KAT_EXO_MAX KL_TABG_KAT_STAND_F KL_TABG_LW_F_ETA_ZW KL_TABG_LW_F_LAM KL_TABG_LW_F_RG KL_TABG_LW_STAND_F KL_TABG_LW_TAU KL_TABG_LW_VERH_WURZEL KL_TABG_PT200 KL_TABG_VKAT_F_REAK KL_TABG_VKAT_K_TMOT KL_TABG_VKAT_MC_F_TMOT KL_TABG_VKAT_STAND_F /end DEF_CHARACTERISTIC
 /begin OUT_MEASUREMENT tabg_ad_b1 tabg_ad_b2 tabg_diag_time_b1 tabg_diag_time_b2 tabg_kat_exo_max_b1 tabg_kat_exo_max_b2 tabg_kat_exo_on_b1 tabg_kat_exo_on_b2 tabg_kat_t_offs_b1 tabg_kat_t_offs_b2 tabg_lw_f_eta_zw_ne_b1 tabg_lw_f_eta_zw_ne_b2 tabg_lw_f_lam_b1 tabg_lw_f_lam_b2 tabg_lw_f_rg_b1 tabg_lw_f_rg_b2 tabg_lw_filter_b1 tabg_lw_filter_b2 tabg_lw_roh_b1 tabg_lw_roh_b2 tabg_lw_stat_b1 tabg_lw_stat_b2 tabg_lw_tau_b1 tabg_lw_tau_b2 tabg_ml_ges_b1 tabg_ml_ges_b2 tabg_roh_b1 tabg_roh_b2 tabg_st tabg_st_aufregeln_b1 tabg_st_aufregeln_b2 tabg_st_init_b1 tabg_st_init_b2 tabg_vkat_f_reak_b1 tabg_vkat_f_reak_b2 /end OUT_MEASUREMENT
/end FUNCTION
/begin FUNCTION AdaptCommon ""
 /begin OUT_MEASUREMENT ccp_retry_cnt_nv crc32_data_carb_nv crc32_prog_carb_nv ipk_sync_error_st_nv ipk_sync_errorcount_nv os_err_ff.addr_0 os_err_ff.addr_1 os_err_ff.addr_2 os_err_ff.addr_3 os_err_ff.addr_4 os_err_ff.addr_5 os_err_ff.addr_6 os_err_ff.addr_7 os_err_ff.ptr os_proz_ff.aq_soll_grad os_proz_ff.mtime os_proz_ff.mtime_pid os_proz_ff.n os_proz_ff.rf os_proz_ff.time_ml os_proz_ff.zustand_motor os_proz_irq_ff.aq_soll_grad os_proz_irq_ff.mtime os_proz_irq_ff.mtime_pid os_proz_irq_ff.n os_proz_irq_ff.rf os_proz_irq_ff.time_ml os_proz_irq_ff.zustand_motor os_proz_irq_last_nv pctrl_proz_err_nv pctrl_task_err_nv ram_chk_err_adr_nv sk_ff.crc32_result sk_ff.egas_sk_mode sk_ff.fail_st_zyl sk_ff.kupp_ist sk_ff.kupp_wunsch_ges sk_ff.md_sk_mode sk_ff.n sk_ff.os_err_addr sk_ff.os_err_cnt sk_ff.os_err_type sk_ff.proz_err sk_ff.pwg_soll sk_ff.reset_cnt sk_ff.rf_m sk_ff.smg_sk_mode sk_ff.stufe sk_ff.task_err sk_ff.ub sk_ff.ursache spim_chain_error_nv spim_error_reinit_ctr_nv spim_errorcode_reinit_nv sys_exc_addr_nv sys_exc_lr_nv sys_exc_vec_nv sys_rsr_cnt_nv.csrs sys_rsr_cnt_nv.dbhrs sys_rsr_cnt_nv.dbsrs sys_rsr_cnt_nv.ehrs sys_rsr_cnt_nv.esrs sys_rsr_cnt_nv.ghrst sys_rsr_cnt_nv.gpor sys_rsr_cnt_nv.gsrst sys_rsr_cnt_nv.ilbc sys_rsr_cnt_nv.jtrs sys_rsr_cnt_nv.llrs sys_rsr_cnt_nv.ocrs sys_rsr_cnt_nv.swrs sys_zust_cpu_last_max_nv tpu_kw_err_ff_a.cnt tpu_kw_err_ff_a.event_time tpu_kw_err_ff_a.irq tpu_kw_err_ff_a.last_period tpu_kw_err_ff_a.n tpu_kw_err_ff_a.n_zahn tpu_kw_err_ff_a.prev_period tpu_kw_err_ff_a.state tpu_kw_err_ff_a.tooth tpu_kw_err_ff_a.tooth_time tpu_kw_err_ff_b.cnt tpu_kw_err_ff_b.event_time tpu_kw_err_ff_b.irq tpu_kw_err_ff_b.last_period tpu_kw_err_ff_b.n tpu_kw_err_ff_b.n_zahn tpu_kw_err_ff_b.prev_period tpu_kw_err_ff_b.state tpu_kw_err_ff_b.tooth tpu_kw_err_ff_b.tooth_time tpu_kw_irq_info_cnt_nv_a tpu_kw_irq_info_cnt_nv_b /end OUT_MEASUREMENT
/end FUNCTION
/begin FUNCTION Adaptiondaten_glob ""
 /begin OUT_MEASUREMENT c_cbs_oel_nv c_ksa_nv c_mil_nv c_mj_nv can_fzgtyp_clas_pwr_nv can_fzgtyp_grb_nv can_fzgtyp_land_nv can_fzgtyp_veh_nv can_km_stand_nv ed_css_st_ign_nv ed_css_st_ign_nv_auss ed_css_st_ign_nv_lls ed_css_st_ign_nv_pwg ed_css_st_ign_nv_tmot ed_fsp_inj_fehlerzaehler_nv elu_nl_nv kat_obd_wert_gesamt_nv kat_obd_wert_nv_b1 kat_obd_wert_nv_b2 kwp_fetrawe_st laa_f_ber_nv_b1 laa_f_ber_nv_b2 tmot_abstell_nv toel_wanne /end OUT_MEASUREMENT
/end FUNCTION
/begin FUNCTION Adaptionswerte ""
 /begin OUT_MEASUREMENT afz_a0_nv auss_erk_ns_nv_zyl1 auss_erk_ns_nv_zyl10 auss_erk_ns_nv_zyl2 auss_erk_ns_nv_zyl3 auss_erk_ns_nv_zyl4 auss_erk_ns_nv_zyl5 auss_erk_ns_nv_zyl6 auss_erk_ns_nv_zyl7 auss_erk_ns_nv_zyl8 auss_erk_ns_nv_zyl9 auss_erk_nv_zyl1 auss_erk_nv_zyl10 auss_erk_nv_zyl2 auss_erk_nv_zyl3 auss_erk_nv_zyl4 auss_erk_nv_zyl5 auss_erk_nv_zyl6 auss_erk_nv_zyl7 auss_erk_nv_zyl8 auss_erk_nv_zyl9 auss_erk_ti_nv_zyl1 auss_erk_ti_nv_zyl10 auss_erk_ti_nv_zyl2 auss_erk_ti_nv_zyl3 auss_erk_ti_nv_zyl4 auss_erk_ti_nv_zyl5 auss_erk_ti_nv_zyl6 auss_erk_ti_nv_zyl7 auss_erk_ti_nv_zyl8 auss_erk_ti_nv_zyl9 auss_ff.auss_lp_int auss_ff.auss_lp_min auss_ff.auss_ns_time auss_ff.auss_spark_time auss_ff.egas_ist_lls auss_ff.egas_wdk_abs auss_ff.laa_f_ber_nv auss_ff.lam_ist_mw auss_ff.n auss_ff.pks_rel auss_ff.rf auss_ff.rf_aq auss_ff.rf_hfm auss_ff.st auss_ff.ti_tpu_st auss_ff.time_ml auss_ff.tz auss_ff.ub auss_ff.van_ist_a auss_ff.van_ist_e auss_ff.van_soll_a auss_ff.van_soll_e auss_ff.vr_mess auss_ff.zustand_motor auss_lp_min_sa_max_nv_zyl1 auss_lp_min_sa_max_nv_zyl10 auss_lp_min_sa_max_nv_zyl2 auss_lp_min_sa_max_nv_zyl3 auss_lp_min_sa_max_nv_zyl4 auss_lp_min_sa_max_nv_zyl5 auss_lp_min_sa_max_nv_zyl6 auss_lp_min_sa_max_nv_zyl7 auss_lp_min_sa_max_nv_zyl8 auss_lp_min_sa_max_nv_zyl9 eeprom_anzahl_schreiben_nv eeprom_crc_nv eeprom_crc_wichtig_nv eeprom_date eeprom_datenlaenge_nv eeprom_datenlaenge_wichtig_nv eeprom_time eeprom_version_prog_nv egas_dk_ff_b1.abs egas_dk_ff_b1.can_st egas_dk_ff_b1.fail_st egas_dk_ff_b1.ist egas_dk_ff_b1.mode egas_dk_ff_b1.n egas_dk_ff_b1.r_adapt_st egas_dk_ff_b1.r_diag_st egas_dk_ff_b1.r_mode egas_dk_ff_b1.r_sollw egas_dk_ff_b1.rf_aq egas_dk_ff_b1.rf_hfm egas_dk_ff_b1.soll egas_dk_ff_b1.state egas_dk_ff_b1.ub egas_dk_ff_b1.wdk egas_dk_ff_b1.zust_sk egas_dk_ff_b2.abs egas_dk_ff_b2.can_st egas_dk_ff_b2.fail_st egas_dk_ff_b2.ist egas_dk_ff_b2.mode egas_dk_ff_b2.n egas_dk_ff_b2.r_adapt_st egas_dk_ff_b2.r_diag_st egas_dk_ff_b2.r_mode egas_dk_ff_b2.r_sollw egas_dk_ff_b2.rf_aq egas_dk_ff_b2.rf_hfm egas_dk_ff_b2.soll egas_dk_ff_b2.state egas_dk_ff_b2.ub egas_dk_ff_b2.wdk egas_dk_ff_b2.zust_sk egas_lls_ff_b1.can_st egas_lls_ff_b1.fail_st egas_lls_ff_b1.ist egas_lls_ff_b1.mode egas_lls_ff_b1.n egas_lls_ff_b1.r_adapt_st egas_lls_ff_b1.r_diag_st egas_lls_ff_b1.r_mode egas_lls_ff_b1.r_sollw egas_lls_ff_b1.rf egas_lls_ff_b1.soll egas_lls_ff_b1.state egas_lls_ff_b1.ub egas_lls_ff_b1.zust_sk egas_lls_ff_b2.can_st egas_lls_ff_b2.fail_st egas_lls_ff_b2.ist egas_lls_ff_b2.mode egas_lls_ff_b2.n egas_lls_ff_b2.r_adapt_st egas_lls_ff_b2.r_diag_st egas_lls_ff_b2.r_mode egas_lls_ff_b2.r_sollw egas_lls_ff_b2.rf egas_lls_ff_b2.soll egas_lls_ff_b2.state egas_lls_ff_b2.ub egas_lls_ff_b2.zust_sk egas_wdk_a0_b1 egas_wdk_a0_b2 fpga_lade_errors_nv fr_adapt fra_aq_adapt_roh_b1 fra_aq_adapt_roh_b2 fra_loli_w_bias_b1_nv fra_loli_w_bias_b2_nv fra_loli_w_n_b1_nv fra_loli_w_n_b2_nv fra_loli_w_rf_b1_nv fra_loli_w_rf_b2_nv hdw_1_nv hdw_2_nv hdw_3_nv ka_dtz_diag_cnt_nv_b1 ka_dtz_diag_cnt_nv_b2 ka_tz_diag_cnt_nv_b1 ka_tz_diag_cnt_nv_b2 ka_tz_nv_zyl1 ka_tz_nv_zyl10 ka_tz_nv_zyl2 ka_tz_nv_zyl3 ka_tz_nv_zyl4 ka_tz_nv_zyl5 ka_tz_nv_zyl6 ka_tz_nv_zyl7 ka_tz_nv_zyl8 ka_tz_nv_zyl9 kr_dtz_diag_cnt_nv_b1 kr_dtz_diag_cnt_nv_b2 llr_ad_md_ac llr_ad_md_norm md_ff.aq_abs_m md_ff.eta_min md_ff.eta_ne md_ff.ind_wunsch_ml md_ff.ind_wunsch_tz md_ff.kupp_ist md_ff.kupp_min_filter md_ff.kupp_wunsch_ges md_ff.kupp_wunsch_ml md_ff.kupp_wunsch_tz md_ff.ml_st md_ff.n md_ff.pwg_soll md_ff.rf_m md_ff.rf_soll md_ff.s_bls md_ff.sk_fehler md_ff.ti_tpu_st md_ff.tz_st md_ff_e2.eta_zw_ne md_ff_e2.eta_zw_ne_e2 md_ff_e2.fw_rel md_ff_e2.fw_rel_diff md_ff_e2.ind_opt md_ff_e2.ind_opt_diff md_ff_e2.kupp_ist md_ff_e2.kupp_max md_ff_e2.kupp_max_diff md_ff_e2.kupp_min md_ff_e2.kupp_min_diff md_ff_e2.kupp_soll md_ff_e2.kupp_wunsch md_ff_e2.n md_ff_e2.rf_m md_ff_e2.rf_pt_korr md_ff_e2.schlepp md_ff_e2.schlepp_diff md_ff_e2.ti_tpu_st md_ff_e2.toel md_off_1of3_.aq_abs_b1 md_off_1of3_.aq_abs_b2 md_off_1of3_.gang md_off_1of3_.ind_schlepp md_off_1of3_.ind_wunsch_ml_komp md_off_1of3_.kupp_ist md_off_1of3_.kupp_min_filter md_off_1of3_.kupp_wunsch md_off_1of3_.kupp_wunsch_ges md_off_1of3_.kupp_wunsch_ml md_off_1of3_.kupp_wunsch_tz md_off_1of3_.lam_ist_b1 md_off_1of3_.lam_ist_b2 md_off_1of3_.ml_st md_off_1of3_.n md_off_1of3_.pks_rel md_off_1of3_.pos_kupp_ist md_off_1of3_.pwg_soll md_off_1of3_.rf_m md_off_1of3_.rf_soll md_off_1of3_.s_bls md_off_1of3_.smg_st md_off_1of3_.te_tv md_off_1of3_.ti_mks_soll1 md_off_1of3_.ti_out1 md_off_1of3_.ti_tpu_st md_off_1of3_.time_ml md_off_1of3_.tz_st md_off_1of3_.tz1 md_off_1of3_.zust_motor md_off_2of3_.aq_abs_b1 md_off_2of3_.aq_abs_b2 md_off_2of3_.gang md_off_2of3_.ind_schlepp md_off_2of3_.ind_wunsch_ml_komp md_off_2of3_.kupp_ist md_off_2of3_.kupp_min_filter md_off_2of3_.kupp_wunsch md_off_2of3_.kupp_wunsch_ges md_off_2of3_.kupp_wunsch_ml md_off_2of3_.kupp_wunsch_tz md_off_2of3_.lam_ist_b1 md_off_2of3_.lam_ist_b2 md_off_2of3_.ml_st md_off_2of3_.n md_off_2of3_.pks_rel md_off_2of3_.pos_kupp_ist md_off_2of3_.pwg_soll md_off_2of3_.rf_m md_off_2of3_.rf_soll md_off_2of3_.s_bls md_off_2of3_.smg_st md_off_2of3_.te_tv md_off_2of3_.ti_mks_soll1 md_off_2of3_.ti_out1 md_off_2of3_.ti_tpu_st md_off_2of3_.time_ml md_off_2of3_.tz_st md_off_2of3_.tz1 md_off_2of3_.zust_motor md_off_3of3_.aq_abs_b1 md_off_3of3_.aq_abs_b2 md_off_3of3_.gang md_off_3of3_.ind_schlepp md_off_3of3_.ind_wunsch_ml_komp md_off_3of3_.kupp_ist md_off_3of3_.kupp_min_filter md_off_3of3_.kupp_wunsch md_off_3of3_.kupp_wunsch_ges md_off_3of3_.kupp_wunsch_ml md_off_3of3_.kupp_wunsch_tz md_off_3of3_.lam_ist_b1 md_off_3of3_.lam_ist_b2 md_off_3of3_.ml_st md_off_3of3_.n md_off_3of3_.pks_rel md_off_3of3_.pos_kupp_ist md_off_3of3_.pwg_soll md_off_3of3_.rf_m md_off_3of3_.rf_soll md_off_3of3_.s_bls md_off_3of3_.smg_st md_off_3of3_.te_tv md_off_3of3_.ti_mks_soll1 md_off_3of3_.ti_out1 md_off_3of3_.ti_tpu_st md_off_3of3_.time_ml md_off_3of3_.tz_st md_off_3of3_.tz1 md_off_3of3_.zust_motor md_off_st md_sk_timer_0_nv md_sk_timer_1_nv md_sk_vergl_diff_nv pwg_bls_ff.anzahl_nv pwg_bls_ff.can_ax pwg_bls_ff.can_ay pwg_bls_ff.can_brp_nv pwg_bls_ff.can_km_stand_nv pwg_bls_ff.can_lrw pwg_bls_ff.md_fw_fgr pwg_bls_ff.mvac_p_nv pwg_bls_ff.n_nv pwg_bls_ff.pwg_filter_nv pwg_bls_ff.rf_m_nv pwg_bls_ff.sk_md_begr_nv pwg_bls_ff.v_vorne_nv pwg_max_diff_adapt_nv pwg1_a0_nv pwg2_a0_nv schalter_bls_counter_nv smg_adapt_ihar_nv smg_can_obd_st_nv smg_ff.abbruch_ges smg_ff.counter smg_ff.dme_st smg_ff.getr_st smg_ff.istgang smg_ff.km_stand smg_ff.kupp_st smg_ff.md_fahrer smg_ff.md_ist smg_ff.md_soll smg_ff.mk_ist smg_ff.mk_soll smg_ff.modul smg_ff.n smg_ff.n_berech smg_ff.n_getr_ein smg_ff.n_getr_ziel smg_ff.pos_kupp_ist smg_ff.pwg_soll smg_ff.s_krafts smg_ff.sk_flags smg_ff.sk_flags_nv smg_ff.sk_mode smg_ff.toel smg_ff.v_hinten smg_ff.v_vorne smg_ff.zielgang tabg_lw_stand_nv_b1 tabg_lw_stand_nv_b2 tabg_nkat_max_nv_b1 tabg_nkat_max_nv_b2 tabg_nkat_stand_nv_b1 tabg_nkat_stand_nv_b2 tabg_vkat_stand_nv_b1 tabg_vkat_stand_nv_b2 tan_modell_mr_off tan_modell_off_b1 tan_modell_off_b2 tdme_max_nv tdme_min_nv tdme_time_zaehler_nv tdme_zyklen_nv time_rel_diag_nl_2_nv time_rel_diag_nl_nv time_rel_zero_cnt_nv toel_abstell_nv vr_sci_err_cnt_nv_zyl1 vr_sci_err_cnt_nv_zyl10 vr_sci_err_cnt_nv_zyl2 vr_sci_err_cnt_nv_zyl3 vr_sci_err_cnt_nv_zyl4 vr_sci_err_cnt_nv_zyl5 vr_sci_err_cnt_nv_zyl6 vr_sci_err_cnt_nv_zyl7 vr_sci_err_cnt_nv_zyl8 vr_sci_err_cnt_nv_zyl9 vr_sci_err_msg_nv vr_set_cnt_nv_0 vr_set_cnt_nv_1 vr_set_cnt_nv_2 vr_set_cnt_nv_3 vr_set_cnt_nv_4 vr_set_cnt_nv_5 vr_set_cnt_nv_6 vr_set_cnt_nv_7 vr_set_cnt_nv_8 zoelp_ans_cnt_nv /end OUT_MEASUREMENT
/end FUNCTION
/begin FUNCTION Ansauglufttemperatur ""
 /begin DEF_CHARACTERISTIC K_TAN_AEBEGR K_TAN_DIAG_MAX K_TAN_DIAG_MIN K_TAN_ERSATZ K_TAN_MAX_E2 K_TAN_MAX_NEG_GRAD_E2 K_TAN_MAX_POS_GRAD_E2 K_TAN_MIN_E2 K_TAN_MODELL_ALLOW_NO_TUMG K_TAN_MODELL_MR_TAU K_TAN_MW_ABGR_NEG K_TAN_MW_ABGR_POS K_TAN_OBD_ALWAYS K_TAN_OBD_CFG K_TAN_OBD_DELTA_MAX K_TAN_OBD_DYN_DELAY K_TAN_OBD_N_DYN_MAX K_TAN_OBD_N_DYN_TAU K_TAN_OBD_N_MAX K_TAN_OBD_N_MIN K_TAN_OBD_RF_DYN_MAX K_TAN_OBD_RF_MAX K_TAN_OBD_RF_MIN K_TAN_OBD_T_DELTA K_TAN_OBD_TMOT_MIN K_TAN_OBD_V_MIN K_TAN_OBD_V_T_MIN K_TAN_TAU KL_TAN_MODELL_ABREG KL_TAN_MODELL_ML_RATIO KL_TAN_MODELL_ML_TAU KL_TAN_MODELL_MR_ABREG KL_TAN_MODELL_MR_TUMG_KAL KL_TAN_NTC /end DEF_CHARACTERISTIC
 /begin OUT_MEASUREMENT tan_ad_b1 tan_ad_b2 tan_filter_b1 tan_filter_b2 tan_modell_b1 tan_modell_b2 tan_modell_ml_ratio_b1 tan_modell_ml_ratio_b2 tan_modell_ml_tau_b1 tan_modell_ml_tau_b2 tan_modell_mr tan_modell_mr_kal tan_modell_raw_b1 tan_modell_raw_b2 tan_modell_st tan_modell_tmot tan_n_dyn tan_n_dyn_delta tan_obd_delta tan_obd_delta_modell_b1 tan_obd_delta_modell_b2 tan_obd_dyn_delay tan_obd_ersatz tan_obd_st tan_obd_st_last tan_obd_st_now tan_obd_t_delta_no tan_obd_t_delta_yes tan_obd_v_t_min tan_roh_b1 tan_roh_b2 tan_tmot_tumg_delta /end OUT_MEASUREMENT
/end FUNCTION
/begin FUNCTION Anti-Trampeln ""
 /begin DEF_CHARACTERISTIC K_AT_CFG K_AT_FG_TP_N K_AT_FG_TP_TRAMPIN K_AT_FG_TP_V K_AT_FG_TP_V_GRAD K_AT_MD_BEGR_A1 K_AT_MD_GRAD_TAU_NEG K_AT_MD_GRAD_TAU_POS K_AT_N_MAX K_AT_N_MIN K_AT_SK_MAX K_AT_TRAMPIN_SOLL_SCHUB K_AT_TRAMPIN_SOLL_START K_AT_TRAMPIN_SOLL_STOP K_AT_V_GRAD_DOWN_TAU K_AT_V_GRAD_INT_TAU K_AT_V_GRAD_INT_TGL K_AT_V_GRAD_UP_TAU KF_AT_MD_BEGR_KR KF_AT_MD_BEGR_TN KF_AT_MD_BEGR_TV KL_AT_MD_BEGR_KR_FAK KL_AT_MD_BEGR_TN_FAK KL_AT_MD_BEGR_TV_FAK KL_AT_MD_KUPP_MIN KL_AT_N_FAK KL_AT_SCHLUPF_FAK KL_AT_TRAMPIN_SCHUB KL_AT_V_GRAD_FAK KL_AT_V_GRAD_INT_FAK KL_AT_V_TP_A2 KL_AT_V_TP_A3 KL_AT_V_TP_B1 KL_AT_V_TP_B2 KL_AT_V_TP_B3 /end DEF_CHARACTERISTIC
 /begin OUT_MEASUREMENT at_koeff_tp_n_a2 at_koeff_tp_n_a3 at_koeff_tp_n_b1 at_koeff_tp_n_b2 at_koeff_tp_n_b3 at_koeff_tp_trampin_a2 at_koeff_tp_trampin_a3 at_koeff_tp_trampin_b1 at_koeff_tp_trampin_b2 at_koeff_tp_trampin_b3 at_koeff_tp_v_a2 at_koeff_tp_v_a3 at_koeff_tp_v_b1 at_koeff_tp_v_b2 at_koeff_tp_v_b3 at_koeff_tp_v_grad_a2 at_koeff_tp_v_grad_a3 at_koeff_tp_v_grad_b1 at_koeff_tp_v_grad_b2 at_koeff_tp_v_grad_b3 at_md_begr at_md_begr_b0 at_md_begr_b1 at_md_begr_b2 at_md_kupp_min at_md_kupp_ml at_md_kupp_tz at_md_kupp_wunsch at_n_fak at_n_hp at_n_hp_abs_fil at_sample_cnt at_schlupf_fak at_schlupf_li at_schlupf_min at_schlupf_re at_st at_st_eingriff at_st_enable at_tp_verz_n1 at_tp_verz_n2 at_tp_verz_trampin_ha1 at_tp_verz_trampin_ha2 at_tp_verz_trampin_n1 at_tp_verz_trampin_n2 at_tp_verz_trampin_vl1 at_tp_verz_trampin_vl2 at_tp_verz_trampin_vr1 at_tp_verz_trampin_vr2 at_tp_verz_v_grad_hl1 at_tp_verz_v_grad_hl2 at_tp_verz_v_grad_hr1 at_tp_verz_v_grad_hr2 at_tp_verz_v_grad_vl1 at_tp_verz_v_grad_vl2 at_tp_verz_v_grad_vr1 at_tp_verz_v_grad_vr2 at_tp_verz_v_hl1 at_tp_verz_v_hl2 at_tp_verz_v_hr1 at_tp_verz_v_hr2 at_tp_verz_v_vl1 at_tp_verz_v_vl2 at_tp_verz_v_vr1 at_tp_verz_v_vr2 at_trampin at_trampin_dif at_trampin_dif_verz1 at_trampin_dif_verz2 at_trampin_ha at_trampin_ha_roh at_trampin_ha_tp at_trampin_schub at_trampin_va at_trampin_vl at_trampin_vr at_v_grad_fak at_v_grad_int_100ms at_v_grad_int_100ms_fil at_v_grad_int_80ms at_v_grad_int_80ms_fil at_v_grad_int_fak at_v_grad_int_fil at_v_grad_li at_v_grad_max at_v_grad_re at_v_rad_hl_grad at_v_rad_hl_grad_fil at_v_rad_hl_hp at_v_rad_hl_tp at_v_rad_hl_tp_verz at_v_rad_hl_verz at_v_rad_hr_grad at_v_rad_hr_grad_fil at_v_rad_hr_hp at_v_rad_hr_tp at_v_rad_hr_tp_verz at_v_rad_hr_verz at_v_rad_vl_grad at_v_rad_vl_grad_fil at_v_rad_vl_hp at_v_rad_vl_tp at_v_rad_vl_tp_verz at_v_rad_vr_grad at_v_rad_vr_grad_fil at_v_rad_vr_hp at_v_rad_vr_tp at_v_rad_vr_tp_verz /end OUT_MEASUREMENT
/end FUNCTION
/begin FUNCTION Antiruckelregelung ""
 /begin DEF_CHARACTERISTIC K_AR_CFG K_AR_FAK_KOMFORT K_AR_FAK_SPORT K_AR_KORR_P_1 K_AR_KORR_P_2 K_AR_KORR_P_3 K_AR_KORR_P_4 K_AR_KORR_P_5 K_AR_KORR_P_6 K_AR_KORR_P_7 K_AR_KORR_P_N K_AR_KORR_P_R K_AR_MD_MAX K_AR_MD_MIN K_AR_N_DIF_BESCHL_1 K_AR_N_DIF_BESCHL_2 K_AR_N_DIF_REF_MAX K_AR_N_DIF_REF_MIN K_AR_N_DIF_VERZ_1 K_AR_N_DIF_VERZ_2 K_AR_N_FIL_0 K_AR_N_FIL_1 K_AR_N_FIL_2 K_AR_N_FIL_3 K_AR_N_FIL_4 K_AR_N_MAX K_AR_N_MIN K_AR_T_MAX K_AR_T_PAS_DELAY KF_AR_MD_FAKTOR /end DEF_CHARACTERISTIC
 /begin OUT_MEASUREMENT ar_dn ar_md ar_md_kupp_korr ar_n_dif ar_n_dif_last ar_n_dif_ref ar_n_dif_ref_filt ar_n_dif_ref_temp ar_n_ref ar_st ar_state ar_t_max ar_t_pas_delay /end OUT_MEASUREMENT
/end FUNCTION
/begin RECORD_LAYOUT TKF_SW_SW_SW FNC_VALUES 5 SWORD COLUMN_DIR DIRECT AXIS_PTS_X 3 SWORD INDEX_INCR DIRECT AXIS_PTS_Y 4 SWORD INDEX_INCR DIRECT NO_AXIS_PTS_X 1 UBYTE NO_AXIS_PTS_Y 2 UBYTE /end RECORD_LAYOUT
/begin RECORD_LAYOUT TKL_SW_VV_SW FNC_VALUES 4 SWORD COLUMN_DIR DIRECT AXIS_PTS_X 3 SWORD INDEX_INCR DIRECT NO_AXIS_PTS_X 1 UBYTE RESERVED 2 BYTE /end RECORD_LAYOUT
/begin RECORD_LAYOUT TKL_SW_VV_UB FNC_VALUES 4 UBYTE COLUMN_DIR DIRECT AXIS_PTS_X 3 SWORD INDEX_INCR DIRECT NO_AXIS_PTS_X 1 UBYTE RESERVED 2 BYTE /end RECORD_LAYOUT
/begin RECORD_LAYOUT TKL_SW_VV_UW FNC_VALUES 4 UWORD COLUMN_DIR DIRECT AXIS_PTS_X 3 SWORD INDEX_INCR DIRECT NO_AXIS_PTS_X 1 UBYTE RESERVED 2 BYTE /end RECORD_LAYOUT
/begin RECORD_LAYOUT TKL_UB_VV_SW FNC_VALUES 4 SWORD COLUMN_DIR DIRECT AXIS_PTS_X 3 UBYTE INDEX_INCR DIRECT NO_AXIS_PTS_X 1 UBYTE RESERVED 2 BYTE /end RECORD_LAYOUT
/begin RECORD_LAYOUT TKL_UW_VV_SW FNC_VALUES 4 SWORD COLUMN_DIR DIRECT AXIS_PTS_X 3 UWORD INDEX_INCR DIRECT NO_AXIS_PTS_X 1 UBYTE RESERVED 2 BYTE /end RECORD_LAYOUT
/begin RECORD_LAYOUT TKL_UW_VV_UW FNC_VALUES 4 UWORD COLUMN_DIR DIRECT AXIS_PTS_X 3 UWORD INDEX_INCR DIRECT NO_AXIS_PTS_X 1 UBYTE RESERVED 2 BYTE /end RECORD_LAYOUT
/begin RECORD_LAYOUT TKW_VV_VV_SW FNC_VALUES 1 SWORD COLUMN_DIR DIRECT /end RECORD_LAYOUT
/begin RECORD_LAYOUT TKW_VV_VV_UB FNC_VALUES 1 UBYTE COLUMN_DIR DIRECT /end RECORD_LAYOUT
/begin RECORD_LAYOUT TKW_VV_VV_UW FNC_VALUES 1 UWORD COLUMN_DIR DIRECT /end RECORD_LAYOUT
/end MODULE
/end PROJECT
