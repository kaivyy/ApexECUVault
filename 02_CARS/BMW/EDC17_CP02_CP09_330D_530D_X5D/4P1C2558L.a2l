ASAP2_VERSION 1 4
/begin PROJECT P_558 "EDC17_CP02"
/begin HEADER "" VERSION "V1C1" PROJECT_NO P_558 /end HEADER
/begin MODULE DIM ""
/begin MOD_COMMON "" BYTE_ORDER MSB_LAST ALIGNMENT_BYTE 1 ALIGNMENT_WORD 2 ALIGNMENT_LONG 4 ALIGNMENT_FLOAT32_IEEE 4 /end MOD_COMMON
/begin CHARACTERISTIC AccPed_rNotPressed_C "" VALUE 0x8006D4FC Val_Ws16 19.99512 Prc 0.00 19.99512 FORMAT "%8.5" EXTENDED_LIMITS -400.0000 399.9878 /end CHARACTERISTIC
/begin CHARACTERISTIC DiffIO_rTrqDfftl_C "" VALUE 0x8006D4FE Val_Ws16 99.00000 TransR 0.00 99.00000 FORMAT "%8.5" EXTENDED_LIMITS -327.6800 327.6700 /end CHARACTERISTIC
/begin CHARACTERISTIC DiffIO_stCfg_C "" VALUE 0x8006D500 Val_Wu8 3.000 OneToOne 0.00 3.000 FORMAT "%5.3" EXTENDED_LIMITS 0.00 255.0 /end CHARACTERISTIC
/begin CHARACTERISTIC DiffIO_trqPrtDfftl_C "" VALUE 0x8006D502 Val_Ws16 50000.00 TrqPrp 0.00 50000.00 FORMAT "%8.2" EXTENDED_LIMITS -52428.80 52427.20 /end CHARACTERISTIC
/begin CHARACTERISTIC Eng_stOff_C "" VALUE 0x8006D504 Val_Wu8 1.000 OneToOne 0.00 1.000 FORMAT "%5.3" EXTENDED_LIMITS 0.00 255.0 /end CHARACTERISTIC
/begin CHARACTERISTIC Eng_stRun_C "" VALUE 0x8006D505 Val_Wu8 1.000 OneToOne 0.00 1.000 FORMAT "%5.3" EXTENDED_LIMITS 0.00 255.0 /end CHARACTERISTIC
/begin CHARACTERISTIC Exh_numFldTOxiCatUs_C "" VALUE 0x8006D120 Val_Ws16 65535.00 OneToOne -32768.00 32767.00 FORMAT "%8.2" /end CHARACTERISTIC
/begin CHARACTERISTIC Exh_numTOxiCatUs_C "" VALUE 0x8006D122 Val_Wu8 255.0 OneToOne 0.00 255.0 FORMAT "%5.1" /end CHARACTERISTIC
/begin CHARACTERISTIC Exh_numTPFltUs_C "" VALUE 0x8006D1D0 Val_Wu8 255.0 OneToOne 0.00 255.0 FORMAT "%5.1" /end CHARACTERISTIC
/begin CHARACTERISTIC Exh_RmpSlpTOxiCatUs.Pos_C "/" VALUE 0x8006D124 Kw_Ws32 3276799.99847 RmpTemp 0.00 3276799.99847 FORMAT "%13.5" EXTENDED_LIMITS -3276800.00000 3276799.99847 /end CHARACTERISTIC
/begin CHARACTERISTIC Exh_RmpSlpTOxiCatUs.Neg_C "/" VALUE 0x8006D128 Kw_Ws32 3276799.99847 RmpTemp 0.00 3276799.99847 FORMAT "%13.5" EXTENDED_LIMITS -3276800.00000 3276799.99847 /end CHARACTERISTIC
/begin CHARACTERISTIC Exh_RmpSlpTPFltUs.Pos_C "/" VALUE 0x8006D1D4 Kw_Ws32 3276799.99847 RmpTemp 0.00 3276799.99847 FORMAT "%13.5" EXTENDED_LIMITS -3276800.00000 3276799.99847 /end CHARACTERISTIC
/begin CHARACTERISTIC Exh_RmpSlpTPFltUs.Neg_C "/" VALUE 0x8006D1D8 Kw_Ws32 3276799.99847 RmpTemp 0.00 3276799.99847 FORMAT "%13.5" EXTENDED_LIMITS -3276800.00000 3276799.99847 /end CHARACTERISTIC
/begin CHARACTERISTIC Exh_SRCTPFltUs.uMin_C "/" VALUE 0x8006D1C0 Val_Ws16 250.0000 Volt 0.00 250.0000 FORMAT "%8.4" EXTENDED_LIMITS -6553.600 6553.400 /end CHARACTERISTIC
/begin CHARACTERISTIC Exh_SRCTPFltUs.uMax_C "/" VALUE 0x8006D1C2 Val_Ws16 1800.000 Volt 3000.000 4800.000 FORMAT "%8.3" EXTENDED_LIMITS -6553.600 6553.400 /end CHARACTERISTIC
/begin CHARACTERISTIC Exh_stMaskLckNplTPFltUs_C "" VALUE 0x8006D1DC Val_Wu32 4294967295.00 OneToOne 0.00 4294967295.00 FORMAT "%13.2" /end CHARACTERISTIC
/begin CHARACTERISTIC Exh_stMskLckNplTOxiCatUs_C "" VALUE 0x8006D12C Val_Wu32 4294967295.00 OneToOne 0.00 4294967295.00 FORMAT "%13.2" /end CHARACTERISTIC
/begin CHARACTERISTIC Exh_swtDflTPFltUs_C "" VALUE 0x8006D1E0 Val_Wu8 255.0 OneToOne 0.00 255.0 FORMAT "%5.1" /end CHARACTERISTIC
/begin CHARACTERISTIC Exh_tDiffNegTOxiCatUs_CUR "" CURVE 0x8006D130 Kl_Xs16_Ws16 6553.500 TempDiff_Kelv -3276.800 3276.700 FORMAT "%8.3"
 /begin AXIS_DESCR STD_AXIS Exh_tModTOxiCatUs_mp Temp_Cels 16 -3549.940 3003.560 FORMAT "%8.3" DEPOSIT ABSOLUTE /end AXIS_DESCR
/end CHARACTERISTIC
/begin CHARACTERISTIC Exh_tDiffNegTPFltUs_CUR "" CURVE 0x8006D1E2 Cur_Xs16Ws16 300.0000 TempDiff_Kelv -200.0000 100.0000 FORMAT "%8.4" EXTENDED_LIMITS -3276.800 3276.700
 /begin AXIS_DESCR STD_AXIS Exh_tEGFldTPFltUs_mp Temp_Cels 2 -45.04000 999.9600 FORMAT "%8.3" EXTENDED_LIMITS -3549.940 3003.560 DEPOSIT ABSOLUTE /end AXIS_DESCR
/end CHARACTERISTIC
/begin CHARACTERISTIC Exh_tDiffPosTOxiCatUs_CUR "" CURVE 0x8006D172 Kl_Xs16_Ws16 6553.500 TempDiff_Kelv -3276.800 3276.700 FORMAT "%8.3"
 /begin AXIS_DESCR STD_AXIS Exh_tModTOxiCatUs_mp Temp_Cels 16 -3549.940 3003.560 FORMAT "%8.3" DEPOSIT ABSOLUTE /end AXIS_DESCR
/end CHARACTERISTIC
/begin CHARACTERISTIC Exh_tDiffPosTPFltUs_CUR "" CURVE 0x8006D1EC Cur_Xs16Ws16 300.0000 TempDiff_Kelv 0.00 300.0000 FORMAT "%8.4" EXTENDED_LIMITS -3276.800 3276.700
 /begin AXIS_DESCR STD_AXIS Exh_tEGFldTPFltUs_mp Temp_Cels 2 -0.04000000 1099.960 FORMAT "%8.3" EXTENDED_LIMITS -3549.940 3003.560 DEPOSIT ABSOLUTE /end AXIS_DESCR
/end CHARACTERISTIC
/begin CHARACTERISTIC Exh_tiLckNplRgnTOxiCatUs_C "" VALUE 0x8006D1B4 Val_Ws16 655.3500 Time_s -327.6800 327.6700 FORMAT "%8.4" /end CHARACTERISTIC
/begin CHARACTERISTIC Exh_tiLckNplRgnTPFltUs_C "" VALUE 0x8006D1F6 Val_Ws16 655.3500 Time_s -327.6800 327.6700 FORMAT "%8.4" /end CHARACTERISTIC
/begin CHARACTERISTIC Exh_tiLckNplTOxiCatUs_C "" VALUE 0x8006D1B6 Val_Ws16 655.3500 Time_s -327.6800 327.6700 FORMAT "%8.4" /end CHARACTERISTIC
/begin CHARACTERISTIC Exh_tiLckNplTPFltUs_C "" VALUE 0x8006D1F8 Val_Ws16 655.3500 Time_s -327.6800 327.6700 FORMAT "%8.4" /end CHARACTERISTIC
/begin CHARACTERISTIC Exh_tiLPFltPT1TOxiCatUs_C "" VALUE 0x8006D1B8 Val_Ws32 4294.9672940 TimeDelay_s 0.000002000000001 4294.9672960 FORMAT "%12.7" /end CHARACTERISTIC
/begin CHARACTERISTIC Exh_TransStageParTPFltUs.Dfl_C "/" VALUE 0x8006D1FA Kw_Ws16 199.0000 Temp_Cels -0.04000000 198.9600 FORMAT "%8.4" EXTENDED_LIMITS -3549.940 3003.560 /end CHARACTERISTIC
/begin CHARACTERISTIC Exh_TransStageParTPFltUs.stSensId_C "/" VALUE 0x8006D1FC Kw_Wu8 255.0 OneToOne 0.00 255.0 FORMAT "%5.1" /end CHARACTERISTIC
/begin CHARACTERISTIC Exh_TransStgTOxiCatUs.Dfl_C "/" VALUE 0x8006D1BC Kw_Ws16 250.0000 Temp_Cels -50.04000 199.9600 FORMAT "%8.4" EXTENDED_LIMITS -3549.940 3003.560 /end CHARACTERISTIC
/begin CHARACTERISTIC Exh_TransStgTOxiCatUs.stSensId_C "/" VALUE 0x8006D1BE Kw_Wu8 255.0 OneToOne 0.00 255.0 FORMAT "%5.1" /end CHARACTERISTIC
/begin CHARACTERISTIC Exh_tTransfTPFltUs_CUR "" CURVE 0x8006D1C4 Cur_Xs16Ws16 225.0000 Temp_Cels -45.04000 179.9600 FORMAT "%8.4" EXTENDED_LIMITS -3549.940 3003.560
 /begin AXIS_DESCR STD_AXIS Exh_uRawTPFltUs Volt 2 0.00 4800.000 FORMAT "%8.3" EXTENDED_LIMITS -6553.600 6553.400 DEPOSIT ABSOLUTE /end AXIS_DESCR
/end CHARACTERISTIC
/begin CHARACTERISTIC LiGov_nSetpoint_C "" VALUE 0x8006D506 Val_Ws16 1200.000 EngN 0.00 1200.000 FORMAT "%8.3" EXTENDED_LIMITS -16384.00 16383.50 /end CHARACTERISTIC
/begin CHARACTERISTIC PhyMod_pwrClntEntry_C "" VALUE 0x8006D508 Kw_Ws16 1235306. Pwr2 -617662.2 617643.4 FORMAT "%8.1" /end CHARACTERISTIC
/begin CHARACTERISTIC PT_numTraGear1_C "" VALUE 0x8006D2E8 Val_Wu8 255.0 OneToOne 0.00 255.0 FORMAT "%5.1" /end CHARACTERISTIC
/begin CHARACTERISTIC PT_numTraGear2_C "" VALUE 0x8006D2E9 Val_Wu8 255.0 OneToOne 0.00 255.0 FORMAT "%5.1" /end CHARACTERISTIC
/begin CHARACTERISTIC PT_numTraGear3_C "" VALUE 0x8006D2EA Val_Wu8 255.0 OneToOne 0.00 255.0 FORMAT "%5.1" /end CHARACTERISTIC
/begin CHARACTERISTIC PT_numTraGear4_C "" VALUE 0x8006D2EB Val_Wu8 255.0 OneToOne 0.00 255.0 FORMAT "%5.1" /end CHARACTERISTIC
/begin CHARACTERISTIC PT_numTraGear5_C "" VALUE 0x8006D2EC Val_Wu8 255.0 OneToOne 0.00 255.0 FORMAT "%5.1" /end CHARACTERISTIC
/begin CHARACTERISTIC PT_numTraGear6_C "" VALUE 0x8006D2ED Val_Wu8 255.0 OneToOne 0.00 255.0 FORMAT "%5.1" /end CHARACTERISTIC
/begin CHARACTERISTIC PT_numTraGear7_C "" VALUE 0x8006D2EE Val_Wu8 255.0 OneToOne 0.00 255.0 FORMAT "%5.1" /end CHARACTERISTIC
/begin CHARACTERISTIC PT_numTraGearR_C "" VALUE 0x8006D2EF Val_Wu8 255.0 OneToOne 0.00 255.0 FORMAT "%5.1" /end CHARACTERISTIC
/begin CHARACTERISTIC PT_numTraNoGear_C "Applikationsparameter für Leergang" VALUE 0x8006D2F0 Val_Wu8 255.0 OneToOne 0.00 255.0 FORMAT "%5.1" /end CHARACTERISTIC
/begin CHARACTERISTIC PT_rTraGear1_C "" VALUE 0x8006D2F2 Val_Ws16 655.3500 TransR -327.6800 327.6700 FORMAT "%8.4" /end CHARACTERISTIC
/begin CHARACTERISTIC PT_rTraGear2_C "" VALUE 0x8006D2F4 Val_Ws16 655.3500 TransR -327.6800 327.6700 FORMAT "%8.4" /end CHARACTERISTIC
/begin CHARACTERISTIC PT_rTraGear3_C "" VALUE 0x8006D2F6 Val_Ws16 655.3500 TransR -327.6800 327.6700 FORMAT "%8.4" /end CHARACTERISTIC
/begin CHARACTERISTIC PT_rTraGear4_C "" VALUE 0x8006D2F8 Val_Ws16 655.3500 TransR -327.6800 327.6700 FORMAT "%8.4" /end CHARACTERISTIC
/begin CHARACTERISTIC PT_rTraGear5_C "" VALUE 0x8006D2FA Val_Ws16 655.3500 TransR -327.6800 327.6700 FORMAT "%8.4" /end CHARACTERISTIC
/begin CHARACTERISTIC PT_rTraGear6_C "" VALUE 0x8006D2FC Val_Ws16 655.3500 TransR -327.6800 327.6700 FORMAT "%8.4" /end CHARACTERISTIC
/begin CHARACTERISTIC PT_rTraGearR_C "" VALUE 0x8006D2FE Val_Ws16 655.3500 TransR -327.6800 327.6700 FORMAT "%8.4" /end CHARACTERISTIC
/begin CHARACTERISTIC PT_rTraLoRng_C "" VALUE 0x8006D300 Val_Ws16 655.3500 TransR -327.6800 327.6700 FORMAT "%8.4" /end CHARACTERISTIC
/begin CHARACTERISTIC PT_rTraMax_C "" VALUE 0x8006D302 Val_Ws16 655.3500 TransR -327.6800 327.6700 FORMAT "%8.4" /end CHARACTERISTIC
/begin CHARACTERISTIC SIIO_stDCSIntv_C "" VALUE 0x8006D50A Val_Wu8 255.0 OneToOne 0.00 255.0 FORMAT "%5.1" /end CHARACTERISTIC
/begin CHARACTERISTIC SIIO_stTCSIntv_C "" VALUE 0x8006D50B Val_Wu8 255.0 OneToOne 0.00 255.0 FORMAT "%5.1" /end CHARACTERISTIC
/begin CHARACTERISTIC SIIO_trqDesDCS_C "" VALUE 0x8006D50C Val_Ws16 104856.0 TrqPrp -52428.80 52427.20 FORMAT "%8.2" /end CHARACTERISTIC
/begin CHARACTERISTIC SIIO_trqDesTCS_C "" VALUE 0x8006D50E Val_Ws16 104856.0 TrqPrp -52428.80 52427.20 FORMAT "%8.2" /end CHARACTERISTIC
/begin CHARACTERISTIC SIIO_trqLeadTCS_C "" VALUE 0x8006D510 Val_Ws16 104856.0 TrqPrp -52428.80 52427.20 FORMAT "%8.2" /end CHARACTERISTIC
/begin CHARACTERISTIC StbIntv_bDCSIntv_C "" VALUE 0x8007E6C8 Val_Wu8 255.0 OneToOne 0.00 255.0 FORMAT "%5.1" /end CHARACTERISTIC
/begin CHARACTERISTIC StbIntv_bDCSNeutr_C "" VALUE 0x8007E6C9 Val_Wu8 255.0 OneToOne 0.00 255.0 FORMAT "%5.1" /end CHARACTERISTIC
/begin CHARACTERISTIC StbIntv_bTCSIntv_C "" VALUE 0x8007E6CA Val_Wu8 255.0 OneToOne 0.00 255.0 FORMAT "%5.1" /end CHARACTERISTIC
/begin CHARACTERISTIC StbIntv_bTCSNeutr_C "" VALUE 0x8007E6CB Val_Wu8 255.0 OneToOne 0.00 255.0 FORMAT "%5.1" /end CHARACTERISTIC
/begin CHARACTERISTIC StbIntv_trqDCSDes_C "" VALUE 0x8007E6CC Val_Ws16 104856.0 TrqPrp -52428.80 52427.20 FORMAT "%8.2" /end CHARACTERISTIC
/begin CHARACTERISTIC StbIntv_trqTCSDes_C "" VALUE 0x8007E6CE Val_Ws16 104856.0 TrqPrp -52428.80 52427.20 FORMAT "%8.2" /end CHARACTERISTIC
/begin CHARACTERISTIC StbIntv_trqTCSLead_C "" VALUE 0x8007E6D0 Val_Ws16 104856.0 TrqPrp -52428.80 52427.20 FORMAT "%8.2" /end CHARACTERISTIC
/begin CHARACTERISTIC StWhl_dphiAg_C "" VALUE 0x8006D512 Val_Ws16 360.0000 AngleDerivative 0.00 360.0000 FORMAT "%8.4" EXTENDED_LIMITS -2048.000 2047.938 /end CHARACTERISTIC
/begin CHARACTERISTIC StWhl_phiAg_C "" VALUE 0x8006D514 Val_Ws16 360.0000 Angle 0.00 360.0000 FORMAT "%8.4" EXTENDED_LIMITS -1024.000 1023.969 /end CHARACTERISTIC
/begin CHARACTERISTIC Tra_bAST_C "Status AST-Intervention aktiv" VALUE 0x8007E5DE Val_Wu8 255.0 OneToOne 0.00 255.0 FORMAT "%5.1" /end CHARACTERISTIC
/begin CHARACTERISTIC Tra_bCanAirCanPtd_C "Bedingung relative Kühlleistungsanforderung vom CAN" VALUE 0x8007E4D2 Val_Wu8 255.0 OneToOne 0.00 255.0 FORMAT "%5.1" /end CHARACTERISTIC
/begin CHARACTERISTIC Tra_bCANASTIntv_C "Status AST-Eingriff über CAN" VALUE 0x8007E5D4 Val_Wu8 255.0 OneToOne 0.00 255.0 FORMAT "%5.1" /end CHARACTERISTIC
/begin CHARACTERISTIC Tra_bCanClntCanPtd_C "" VALUE 0x8007E4D3 Val_Wu8 255.0 OneToOne 0.00 255.0 FORMAT "%5.1" /end CHARACTERISTIC
/begin CHARACTERISTIC Tra_bCANIdlSetP_C "Status Getriebeleerlaufdrehzahlanhebung über CAN" VALUE 0x8007E5D5 Val_Wu8 255.0 OneToOne 0.00 255.0 FORMAT "%5.1" /end CHARACTERISTIC
/begin CHARACTERISTIC Tra_bCanInfoCan_C "" VALUE 0x8006D304 Val_Wu8 255.0 OneToOne 0.00 255.0 FORMAT "%5.1" /end CHARACTERISTIC
/begin CHARACTERISTIC Tra_bCanLevPos_C "" VALUE 0x8006D305 Val_Wu8 255.0 OneToOne 0.00 255.0 FORMAT "%5.1" /end CHARACTERISTIC
/begin CHARACTERISTIC Tra_bCanLoRng_C "" VALUE 0x8006D306 Val_Wu8 255.0 OneToOne 0.00 255.0 FORMAT "%5.1" /end CHARACTERISTIC
/begin CHARACTERISTIC Tra_bCanPlausDecIntv_C "Bedingung fallender Getriebeeingriff plausibel" VALUE 0x8007E5E0 Val_Wu8 255.0 OneToOne 0.00 255.0 FORMAT "%5.1" /end CHARACTERISTIC
/begin CHARACTERISTIC Tra_bCanPlausIncIntv_C "Bedingung steigender Getriebeeingriff plausibel" VALUE 0x8007E5E1 Val_Wu8 255.0 OneToOne 0.00 255.0 FORMAT "%5.1" /end CHARACTERISTIC
/begin CHARACTERISTIC Tra_bCanRevGear_C "" VALUE 0x8006D307 Val_Wu8 255.0 OneToOne 0.00 255.0 FORMAT "%5.1" /end CHARACTERISTIC
/begin CHARACTERISTIC Tra_bCanRTra_C "" VALUE 0x8006D308 Val_Wu8 255.0 OneToOne 0.00 255.0 FORMAT "%5.1" /end CHARACTERISTIC
/begin CHARACTERISTIC Tra_bFltIdlSpdDes_C "Status Getriebeleerlaufdrehzahlanhebung ungefiltert bzw. gefiltert übernehmen" VALUE 0x8007E5DF Val_Wu8 255.0 OneToOne 0.00 255.0 FORMAT "%5.1" /end CHARACTERISTIC
/begin CHARACTERISTIC Tra_bGbxNPosEna_C "" VALUE 0x8006D309 Val_Wu8 255.0 OneToOne 0.00 255.0 FORMAT "%5.1" /end CHARACTERISTIC
/begin CHARACTERISTIC Tra_bStrtStopEnaDfl_C "" VALUE 0x8006D30A Val_Wu8 255.0 OneToOne 0.00 255.0 FORMAT "%5.1" /end CHARACTERISTIC
/begin CHARACTERISTIC Tra_dtrqLimUp_C "" VALUE 0x8006D350 Val_Ws32 6553599.99847 RmpTrq -3276800.00000 3276799.99847 FORMAT "%13.5" /end CHARACTERISTIC
/begin CHARACTERISTIC Tra_dtrqPrtRmp.Pos_C "/" VALUE 0x8006D354 Kw_Ws32 3276799.99847 RmpTrq 0.00 3276799.99847 FORMAT "%13.5" EXTENDED_LIMITS -3276800.00000 3276799.99847 /end CHARACTERISTIC
/begin CHARACTERISTIC Tra_dtrqPrtRmp.Neg_C "/" VALUE 0x8006D358 Kw_Ws32 3276799.99847 RmpTrq 0.00 3276799.99847 FORMAT "%13.5" EXTENDED_LIMITS -3276800.00000 3276799.99847 /end CHARACTERISTIC
/begin CHARACTERISTIC Tra_dtrqPrtRmpP.Pos_C "---/" VALUE 0x8007E4D8 Kw_Ws32 3276799.99847 RmpTrq 0.00 3276799.99847 FORMAT "%13.5" EXTENDED_LIMITS -3276800.00000 3276799.99847 /end CHARACTERISTIC
/begin CHARACTERISTIC Tra_dtrqPrtRmpP.Neg_C "---/" VALUE 0x8007E4DC Kw_Ws32 3276799.99847 RmpTrq 0.00 3276799.99847 FORMAT "%13.5" EXTENDED_LIMITS -3276800.00000 3276799.99847 /end CHARACTERISTIC
/begin CHARACTERISTIC Tra_dtrqRmpDecP.Pos_C "---/" VALUE 0x8007E5E4 Kw_Ws32 3276799.99847 RmpTrq 0.00 3276799.99847 FORMAT "%13.5" EXTENDED_LIMITS -3276800.00000 3276799.99847 /end CHARACTERISTIC
/begin CHARACTERISTIC Tra_dtrqRmpDecP.Neg_C "---/" VALUE 0x8007E5E8 Kw_Ws32 3276799.99847 RmpTrq 0.00 3276799.99847 FORMAT "%13.5" EXTENDED_LIMITS -3276800.00000 3276799.99847 /end CHARACTERISTIC
/begin CHARACTERISTIC Tra_dtrqRmpIncP.Pos_C "---/" VALUE 0x8007E5EC Kw_Ws32 3276799.99847 RmpTrq 0.00 3276799.99847 FORMAT "%13.5" EXTENDED_LIMITS -3276800.00000 3276799.99847 /end CHARACTERISTIC
/begin CHARACTERISTIC Tra_dtrqRmpIncP.Neg_C "---/" VALUE 0x8007E5F0 Kw_Ws32 3276799.99847 RmpTrq 0.00 3276799.99847 FORMAT "%13.5" EXTENDED_LIMITS -3276800.00000 3276799.99847 /end CHARACTERISTIC
/begin CHARACTERISTIC Tra_facLimUp_CUR "" CURVE 0x8006D35C Kl_Xs16_Ws16 7.999878 Fact -4.000000 3.999878 FORMAT "%8.6"
 /begin AXIS_DESCR STD_AXIS VehV_v Vel 8 0.00 300.0000 FORMAT "%8.4" EXTENDED_LIMITS -327.6800 327.6700 DEPOSIT ABSOLUTE /end AXIS_DESCR
/end CHARACTERISTIC
/begin CHARACTERISTIC Tra_nASTDes_C "Ersatzwert für Synchronisationsdrehzahl" VALUE 0x8007E5D6 Val_Ws16 32767.50 EngN -16384.00 16383.50 FORMAT "%8.2" /end CHARACTERISTIC
/begin CHARACTERISTIC Tra_nEngMin_C "" VALUE 0x8006D30C Val_Ws16 32767.50 EngN -16384.00 16383.50 FORMAT "%8.2" /end CHARACTERISTIC
/begin CHARACTERISTIC Tra_nMax_C "Ersatzwert für Maximale Solldrehzahl vom Getriebe" VALUE 0x8007E5D8 Val_Ws16 32767.50 EngN -16384.00 16383.50 FORMAT "%8.2" /end CHARACTERISTIC
/begin CHARACTERISTIC Tra_nMin_C "Ersatzwert für minimale Solldrehzahl vom Getriebe" VALUE 0x8007E5DA Val_Ws16 32767.50 EngN -16384.00 16383.50 FORMAT "%8.2" /end CHARACTERISTIC
/begin CHARACTERISTIC Tra_numLevPosCan_C "" VALUE 0x8006D30E Val_Wu8 255.0 OneToOne 0.00 255.0 FORMAT "%5.1" /end CHARACTERISTIC
/begin CHARACTERISTIC Tra_rClgDem_C "Parameter relative Lüfterkühlleistung" VALUE 0x8007E4D4 Val_Ws16 799.9878 Prc -400.0000 399.9878 FORMAT "%8.4" /end CHARACTERISTIC
/begin CHARACTERISTIC Tra_rV2NDfl_C "" VALUE 0x8006D310 Val_Ws16 0.6553500 VelToN -0.3276800 0.3276700 FORMAT "%9.7" /end CHARACTERISTIC
/begin CHARACTERISTIC Tra_rVn1H_C "" VALUE 0x8006D312 Val_Ws16 0.6553500 VelToN -0.3276800 0.3276700 FORMAT "%9.7" /end CHARACTERISTIC
/begin CHARACTERISTIC Tra_rVn1L_C "" VALUE 0x8006D314 Val_Ws16 0.6553500 VelToN -0.3276800 0.3276700 FORMAT "%9.7" /end CHARACTERISTIC
/begin CHARACTERISTIC Tra_rVn1To2Des_C "" VALUE 0x8006D316 Val_Ws16 0.6553500 VelToN -0.3276800 0.3276700 FORMAT "%9.7" /end CHARACTERISTIC
/begin CHARACTERISTIC Tra_rVn2H_C "" VALUE 0x8006D318 Val_Ws16 0.6553500 VelToN -0.3276800 0.3276700 FORMAT "%9.7" /end CHARACTERISTIC
/begin CHARACTERISTIC Tra_rVn2L_C "" VALUE 0x8006D31A Val_Ws16 0.6553500 VelToN -0.3276800 0.3276700 FORMAT "%9.7" /end CHARACTERISTIC
/begin CHARACTERISTIC Tra_rVn2To3Des_C "" VALUE 0x8006D31C Val_Ws16 0.6553500 VelToN -0.3276800 0.3276700 FORMAT "%9.7" /end CHARACTERISTIC
/begin CHARACTERISTIC Tra_rVn3H_C "" VALUE 0x8006D31E Val_Ws16 0.6553500 VelToN -0.3276800 0.3276700 FORMAT "%9.7" /end CHARACTERISTIC
/begin CHARACTERISTIC Tra_rVn3L_C "" VALUE 0x8006D320 Val_Ws16 0.6553500 VelToN -0.3276800 0.3276700 FORMAT "%9.7" /end CHARACTERISTIC
/begin CHARACTERISTIC Tra_rVn3To4Des_C "" VALUE 0x8006D322 Val_Ws16 0.6553500 VelToN -0.3276800 0.3276700 FORMAT "%9.7" /end CHARACTERISTIC
/begin CHARACTERISTIC Tra_rVn4H_C "" VALUE 0x8006D324 Val_Ws16 0.6553500 VelToN -0.3276800 0.3276700 FORMAT "%9.7" /end CHARACTERISTIC
/begin CHARACTERISTIC Tra_rVn4L_C "" VALUE 0x8006D326 Val_Ws16 0.6553500 VelToN -0.3276800 0.3276700 FORMAT "%9.7" /end CHARACTERISTIC
/begin CHARACTERISTIC Tra_rVn4To5Des_C "" VALUE 0x8006D328 Val_Ws16 0.6553500 VelToN -0.3276800 0.3276700 FORMAT "%9.7" /end CHARACTERISTIC
/begin CHARACTERISTIC Tra_rVn5H_C "" VALUE 0x8006D32A Val_Ws16 0.6553500 VelToN -0.3276800 0.3276700 FORMAT "%9.7" /end CHARACTERISTIC
/begin CHARACTERISTIC Tra_rVn5L_C "" VALUE 0x8006D32C Val_Ws16 0.6553500 VelToN -0.3276800 0.3276700 FORMAT "%9.7" /end CHARACTERISTIC
/begin CHARACTERISTIC Tra_rVn5To6Des_C "" VALUE 0x8006D32E Val_Ws16 0.6553500 VelToN -0.3276800 0.3276700 FORMAT "%9.7" /end CHARACTERISTIC
/begin CHARACTERISTIC Tra_rVn6H_C "" VALUE 0x8006D330 Val_Ws16 0.6553500 VelToN -0.3276800 0.3276700 FORMAT "%9.7" /end CHARACTERISTIC
/begin CHARACTERISTIC Tra_rVn6L_C "" VALUE 0x8006D332 Val_Ws16 0.6553500 VelToN -0.3276800 0.3276700 FORMAT "%9.7" /end CHARACTERISTIC
/begin CHARACTERISTIC Tra_rVnRH_C "" VALUE 0x8006D334 Val_Ws16 0.6553500 VelToN -0.3276800 0.3276700 FORMAT "%9.7" /end CHARACTERISTIC
/begin CHARACTERISTIC Tra_rVnRL_C "" VALUE 0x8006D336 Val_Ws16 0.6553500 VelToN -0.3276800 0.3276700 FORMAT "%9.7" /end CHARACTERISTIC
/begin CHARACTERISTIC Tra_stLevPosD_C "" VALUE 0x8006D338 Val_Wu8 255.0 OneToOne 0.00 255.0 FORMAT "%5.1" /end CHARACTERISTIC
/begin CHARACTERISTIC Tra_stPrtCfg_C "Konfiguration CAN" VALUE 0x8007E4E0 Val_Wu8 255.0 OneToOne 0.00 255.0 FORMAT "%5.1" /end CHARACTERISTIC
/begin CHARACTERISTIC Tra_stTraType_C "Parameter Getriebetyp" VALUE 0x8007E628 Kw_Wu8 255.0 OneToOne 0.00 255.0 FORMAT "%5.1" /end CHARACTERISTIC
/begin CHARACTERISTIC Tra_swtDrvAway_C "" VALUE 0x8006D37E Val_Wu8 1.000 OneToOne 0.00 1.000 FORMAT "%5.3" EXTENDED_LIMITS 0.00 255.0 /end CHARACTERISTIC
/begin CHARACTERISTIC Tra_swtLevPosSlct_CA "" VAL_BLK 0x8006D339 ValA_Wu8 255.0 OneToOne 0.00 255.0 FORMAT "%5.1" NUMBER 8 /end CHARACTERISTIC
/begin CHARACTERISTIC Tra_swtRmpPtd_C "Schalter für Rampenfunktionalität" VALUE 0x8007E5F4 Val_Wu8 255.0 OneToOne 0.00 255.0 FORMAT "%5.1" /end CHARACTERISTIC
/begin CHARACTERISTIC Tra_swtTypeSlct_CA "" VAL_BLK 0x8006D341 ValA_Wu8 255.0 OneToOne 0.00 255.0 FORMAT "%5.1" NUMBER 8 /end CHARACTERISTIC
/begin CHARACTERISTIC Tra_tClntDes_C "Parameter Kühlmitteltemperatur-Sollwert" VALUE 0x8007E4D6 Val_Ws16 6553.500 Temp_Cels -3549.940 3003.560 FORMAT "%8.3" /end CHARACTERISTIC
/begin CHARACTERISTIC Tra_tiASTDes_C "Ersatzwert für Synchronisationszeit" VALUE 0x8007E5DC Val_Ws16 655.3500 Time_s -327.6800 327.6700 FORMAT "%8.4" /end CHARACTERISTIC
/begin CHARACTERISTIC Tra_tOilDfl_C "applikativer Defaultwert für die Getriebeöltemperatur" VALUE 0x8006D34A Val_Ws16 6553.500 Temp_Cels -3549.940 3003.560 FORMAT "%8.3" /end CHARACTERISTIC
/begin CHARACTERISTIC Tra_trqDesMaxTrq_CUR "Wunschmoment abhängig von der Motordrehzahl" CURVE 0x8007E5F6 Kl_Xs16_Ws16 6553.500 Trq -3276.800 3276.700 FORMAT "%8.3"
 /begin AXIS_DESCR STD_AXIS Epm_nEng EngN 10 -16384.00 16383.50 FORMAT "%8.2" DEPOSIT ABSOLUTE /end AXIS_DESCR
/end CHARACTERISTIC
/begin CHARACTERISTIC Tra_trqDesMax_C "applizierbares maximales Wunschmoment" VALUE 0x8007E620 Val_Ws16 6553.500 Trq -3276.800 3276.700 FORMAT "%8.3" /end CHARACTERISTIC
/begin CHARACTERISTIC Tra_trqDesMin_C "applizierbares minimales Wunschmoment" VALUE 0x8007E622 Val_Ws16 6553.500 Trq -3276.800 3276.700 FORMAT "%8.3" /end CHARACTERISTIC
/begin CHARACTERISTIC Tra_trqInMax_C "Allgemeiner Momenten-Maximalwert" VALUE 0x8007E4E2 Val_Ws16 6553.500 Trq -3276.800 3276.700 FORMAT "%8.3" /end CHARACTERISTIC
/begin CHARACTERISTIC Tra_trqLos_C "Parameter Getriebeverlustmoment" VALUE 0x8006D34E Kw_Ws16 6553.500 Trq -3276.800 3276.700 FORMAT "%8.3" /end CHARACTERISTIC
/begin CHARACTERISTIC Tra_trqMaxErr_CUR "" CURVE 0x8006D380 Kl_Xs16_Ws16 1000.000 Trq 0.00 1000.000 FORMAT "%8.3" EXTENDED_LIMITS -3276.800 3276.700
 /begin AXIS_DESCR STD_AXIS Epm_nEng EngN 10 0.00 6000.000 FORMAT "%8.3" EXTENDED_LIMITS -16384.00 16383.50 DEPOSIT ABSOLUTE /end AXIS_DESCR
/end CHARACTERISTIC
/begin CHARACTERISTIC Tra_trqMaxGear1_CUR "Kennlinie (n/trq) Gang 1" CURVE 0x8007E4E4 Cur_Xs16Ws16 6553.500 Trq -3276.800 3276.700 FORMAT "%8.3"
 /begin AXIS_DESCR STD_AXIS Epm_nEng EngN 8 -16384.00 16383.50 FORMAT "%8.2" DEPOSIT ABSOLUTE /end AXIS_DESCR
/end CHARACTERISTIC
/begin CHARACTERISTIC Tra_trqMaxGear2_CUR "Kennlinie (n/trq) Gang 2" CURVE 0x8007E506 Cur_Xs16Ws16 6553.500 Trq -3276.800 3276.700 FORMAT "%8.3"
 /begin AXIS_DESCR STD_AXIS Epm_nEng EngN 8 -16384.00 16383.50 FORMAT "%8.2" DEPOSIT ABSOLUTE /end AXIS_DESCR
/end CHARACTERISTIC
/begin CHARACTERISTIC Tra_trqMaxGear3_CUR "Kennlinie (n/trq) Gang 3" CURVE 0x8007E528 Cur_Xs16Ws16 6553.500 Trq -3276.800 3276.700 FORMAT "%8.3"
 /begin AXIS_DESCR STD_AXIS Epm_nEng EngN 8 -16384.00 16383.50 FORMAT "%8.2" DEPOSIT ABSOLUTE /end AXIS_DESCR
/end CHARACTERISTIC
/begin CHARACTERISTIC Tra_trqMaxGear4_CUR "Kennlinie (n/trq) Gang 4" CURVE 0x8007E54A Cur_Xs16Ws16 6553.500 Trq -3276.800 3276.700 FORMAT "%8.3"
 /begin AXIS_DESCR STD_AXIS Epm_nEng EngN 8 -16384.00 16383.50 FORMAT "%8.2" DEPOSIT ABSOLUTE /end AXIS_DESCR
/end CHARACTERISTIC
/begin CHARACTERISTIC Tra_trqMaxGear5_CUR "Kennlinie (n/trq) Gang 5" CURVE 0x8007E56C Cur_Xs16Ws16 6553.500 Trq -3276.800 3276.700 FORMAT "%8.3"
 /begin AXIS_DESCR STD_AXIS Epm_nEng EngN 8 -16384.00 16383.50 FORMAT "%8.2" DEPOSIT ABSOLUTE /end AXIS_DESCR
/end CHARACTERISTIC
/begin CHARACTERISTIC Tra_trqMaxGear6_CUR "Kennlinie (n/trq) Gang 6" CURVE 0x8007E58E Cur_Xs16Ws16 6553.500 Trq -3276.800 3276.700 FORMAT "%8.3"
 /begin AXIS_DESCR STD_AXIS Epm_nEng EngN 8 -16384.00 16383.50 FORMAT "%8.2" DEPOSIT ABSOLUTE /end AXIS_DESCR
/end CHARACTERISTIC
/begin CHARACTERISTIC Tra_trqMaxGearR_CUR "Kennlinie (n/trq) Gang R" CURVE 0x8007E5B0 Cur_Xs16Ws16 6553.500 Trq -3276.800 3276.700 FORMAT "%8.3"
 /begin AXIS_DESCR STD_AXIS Epm_nEng EngN 8 -16384.00 16383.50 FORMAT "%8.2" DEPOSIT ABSOLUTE /end AXIS_DESCR
/end CHARACTERISTIC
/begin CHARACTERISTIC Tra_vMinTrqRed_C "applizierbare Motordrehzahl" VALUE 0x8007E624 Val_Ws16 655.3500 Vel -327.6800 327.6700 FORMAT "%8.4" /end CHARACTERISTIC
/begin CHARACTERISTIC Tra_vMin_C "" VALUE 0x8006D34C Val_Ws16 655.3500 Vel -327.6800 327.6700 FORMAT "%8.4" /end CHARACTERISTIC
/begin CHARACTERISTIC TrbChLP_Pwm.tiPer_C "/" VALUE 0x8007E62A Kw_Ws16 9.900000 Period 0.1000000 10.00000 FORMAT "%8.5" EXTENDED_LIMITS -3276.800 3276.700 /end CHARACTERISTIC
/begin CHARACTERISTIC TrbChLP_Pwm.stLvl_C "/" VALUE 0x8007E62C Kw_Wu8 1.000 OneToOne 0.00 1.000 FORMAT "%5.3" EXTENDED_LIMITS 0.00 255.0 /end CHARACTERISTIC
/begin CHARACTERISTIC TrbChLP_Pwm.rMaxDty_C "/" VALUE 0x8007E62E Kw_Ws16 100.0000 DtyCyc 0.00 100.0000 FORMAT "%8.4" EXTENDED_LIMITS -327.6800 327.6700 /end CHARACTERISTIC
/begin CHARACTERISTIC TrbChLP_Pwm.rPerUn_C "/" VALUE 0x8007E630 Kw_Ws16 3276.700 Period 0.00 3276.700 FORMAT "%8.3" EXTENDED_LIMITS -3276.800 3276.700 /end CHARACTERISTIC
/begin CHARACTERISTIC TrbChLP_Pwm.tiPh_C "/" VALUE 0x8007E632 Kw_Ws16 65535.00 OneToOne -32768.00 32767.00 FORMAT "%8.2" /end CHARACTERISTIC
/begin CHARACTERISTIC TrbChLP_PwmOut.rMin_C "/" VALUE 0x8007E634 Kw_Ws16 100.0000 DtyCyc 0.00 100.0000 FORMAT "%8.4" EXTENDED_LIMITS -327.6800 327.6700 /end CHARACTERISTIC
/begin CHARACTERISTIC TrbChLP_PwmOut.rMax_C "/" VALUE 0x8007E636 Kw_Ws16 100.0000 DtyCyc 0.00 100.0000 FORMAT "%8.4" EXTENDED_LIMITS -327.6800 327.6700 /end CHARACTERISTIC
/begin CHARACTERISTIC TrbChLP_PwmOut.tiBtwTstSCB_C "/" VALUE 0x8007E638 Kw_Ws16 1000.000 Time_ms 0.00 1000.000 FORMAT "%8.3" EXTENDED_LIMITS -327680.0 327670.0 /end CHARACTERISTIC
/begin CHARACTERISTIC TrbChLP_PwmOut.tiBtwTstOT_C "/" VALUE 0x8007E63A Kw_Ws16 1000.000 Time_s 0.00 1000.000 FORMAT "%8.3" EXTENDED_LIMITS -327.6800 327.6700 /end CHARACTERISTIC
/begin CHARACTERISTIC TrbChLP_PwmOut.numTstMax_C "/" VALUE 0x8007E63C Kw_Wu16 65535.00 OneToOne 0.00 65535.00 FORMAT "%8.2" /end CHARACTERISTIC
/begin CHARACTERISTIC TrbChLP_PwmOut.swtBattCor_C "/" VALUE 0x8007E63E Kw_Wu8 1.000 OneToOne 0.00 1.000 FORMAT "%5.3" EXTENDED_LIMITS 0.00 255.0 /end CHARACTERISTIC
/begin CHARACTERISTIC TrbChLP_PwmOut.swtPsInv_C "/" VALUE 0x8007E63F Kw_Wu8 255.0 OneToOne 0.00 255.0 FORMAT "%5.1" /end CHARACTERISTIC
/begin CHARACTERISTIC TrbChLP_rCnv_CUR "" CURVE 0x8007E640 Cur_Xs16Ws16 100.0000 DtyCyc 0.00 100.0000 FORMAT "%8.4" EXTENDED_LIMITS -327.6800 327.6700
 /begin AXIS_DESCR STD_AXIS TrbChLP_r Prc 25 -400.0000 399.9878 FORMAT "%8.4" DEPOSIT ABSOLUTE /end AXIS_DESCR
/end CHARACTERISTIC
/begin CHARACTERISTIC TrbChLP_stPsDiaDisbl_C "" VALUE 0x8007E6A6 Val_Wu8 255.0 OneToOne 0.00 255.0 FORMAT "%5.1" /end CHARACTERISTIC
/begin CHARACTERISTIC TrbChLP_stPsDisbl_C "" VALUE 0x8007E6A7 Val_Wu8 255.0 OneToOne 0.00 255.0 FORMAT "%5.1" /end CHARACTERISTIC
/begin CHARACTERISTIC TrbCh_4WinSigDur.tiErr1Min_C "/" VALUE 0x8006D412 Kw_Ws16 655350.0 Time_ms -327680.0 327670.0 FORMAT "%8.1" /end CHARACTERISTIC
/begin CHARACTERISTIC TrbCh_4WinSigDur.tiErr1Max_C "/" VALUE 0x8006D414 Kw_Ws16 655350.0 Time_ms -327680.0 327670.0 FORMAT "%8.1" /end CHARACTERISTIC
/begin CHARACTERISTIC TrbCh_4WinSigDur.tiErr2Min_C "/" VALUE 0x8006D416 Kw_Ws16 655350.0 Time_ms -327680.0 327670.0 FORMAT "%8.1" /end CHARACTERISTIC
/begin CHARACTERISTIC TrbCh_4WinSigDur.tiErr2Max_C "/" VALUE 0x8006D418 Kw_Ws16 655350.0 Time_ms -327680.0 327670.0 FORMAT "%8.1" /end CHARACTERISTIC
/begin CHARACTERISTIC TrbCh_4WinSigDur.tiErr3Min_C "/" VALUE 0x8006D41A Kw_Ws16 655350.0 Time_ms -327680.0 327670.0 FORMAT "%8.1" /end CHARACTERISTIC
/begin CHARACTERISTIC TrbCh_4WinSigDur.tiErr3Max_C "/" VALUE 0x8006D41C Kw_Ws16 655350.0 Time_ms -327680.0 327670.0 FORMAT "%8.1" /end CHARACTERISTIC
/begin CHARACTERISTIC TrbCh_4WinSigDur.tiErr4Min_C "/" VALUE 0x8006D41E Kw_Ws16 655350.0 Time_ms -327680.0 327670.0 FORMAT "%8.1" /end CHARACTERISTIC
/begin CHARACTERISTIC TrbCh_4WinSigDur.tiErr4Max_C "/" VALUE 0x8006D420 Kw_Ws16 655350.0 Time_ms -327680.0 327670.0 FORMAT "%8.1" /end CHARACTERISTIC
/begin CHARACTERISTIC TrbCh_Pwm.tiPer_C "/" VALUE 0x8006D422 Kw_Ws16 9.900000 Period 0.1000000 10.00000 FORMAT "%8.5" EXTENDED_LIMITS -3276.800 3276.700 /end CHARACTERISTIC
/begin CHARACTERISTIC TrbCh_Pwm.stLvl_C "/" VALUE 0x8006D424 Kw_Wu8 1.000 OneToOne 0.00 1.000 FORMAT "%5.3" EXTENDED_LIMITS 0.00 255.0 /end CHARACTERISTIC
/begin CHARACTERISTIC TrbCh_Pwm.rMaxDty_C "/" VALUE 0x8006D426 Kw_Ws16 100.0000 DtyCyc 0.00 100.0000 FORMAT "%8.4" EXTENDED_LIMITS -327.6800 327.6700 /end CHARACTERISTIC
/begin CHARACTERISTIC TrbCh_Pwm.rPerUn_C "/" VALUE 0x8006D428 Kw_Ws16 3276.700 Period 0.00 3276.700 FORMAT "%8.3" EXTENDED_LIMITS -3276.800 3276.700 /end CHARACTERISTIC
/begin CHARACTERISTIC TrbCh_Pwm.tiPh_C "/" VALUE 0x8006D42A Kw_Ws16 65535.00 OneToOne -32768.00 32767.00 FORMAT "%8.2" /end CHARACTERISTIC
/begin CHARACTERISTIC TrbCh_PwmOut.rMin_C "/" VALUE 0x8006D42C Kw_Ws16 100.0000 DtyCyc 0.00 100.0000 FORMAT "%8.4" EXTENDED_LIMITS -327.6800 327.6700 /end CHARACTERISTIC
/begin CHARACTERISTIC TrbCh_PwmOut.rMax_C "/" VALUE 0x8006D42E Kw_Ws16 100.0000 DtyCyc 0.00 100.0000 FORMAT "%8.4" EXTENDED_LIMITS -327.6800 327.6700 /end CHARACTERISTIC
/begin CHARACTERISTIC TrbCh_PwmOut.tiBtwTstSCB_C "/" VALUE 0x8006D430 Kw_Ws16 1000.000 Time_ms 0.00 1000.000 FORMAT "%8.3" EXTENDED_LIMITS -327680.0 327670.0 /end CHARACTERISTIC
/begin CHARACTERISTIC TrbCh_PwmOut.tiBtwTstOT_C "/" VALUE 0x8006D432 Kw_Ws16 1000.000 Time_s 0.00 1000.000 FORMAT "%8.3" EXTENDED_LIMITS -327.6800 327.6700 /end CHARACTERISTIC
/begin CHARACTERISTIC TrbCh_PwmOut.numTstMax_C "/" VALUE 0x8006D434 Kw_Wu16 65535.00 OneToOne 0.00 65535.00 FORMAT "%8.2" /end CHARACTERISTIC
/begin CHARACTERISTIC TrbCh_PwmOut.swtBattCor_C "/" VALUE 0x8006D436 Kw_Wu8 1.000 OneToOne 0.00 1.000 FORMAT "%5.3" EXTENDED_LIMITS 0.00 255.0 /end CHARACTERISTIC
/begin CHARACTERISTIC TrbCh_PwmOut.swtPsInv_C "/" VALUE 0x8006D437 Kw_Wu8 255.0 OneToOne 0.00 255.0 FORMAT "%5.1" /end CHARACTERISTIC
/begin CHARACTERISTIC TrbCh_rCnv_CUR "" CURVE 0x8006D438 Cur_Xs16Ws16 100.0000 DtyCyc 0.00 100.0000 FORMAT "%8.4" EXTENDED_LIMITS -327.6800 327.6700
 /begin AXIS_DESCR STD_AXIS TrbCh_r Prc 25 -400.0000 399.9878 FORMAT "%8.4" DEPOSIT ABSOLUTE /end AXIS_DESCR
/end CHARACTERISTIC
/begin CHARACTERISTIC TrbCh_rPsDisbl_C "" VALUE 0x8006D49E Val_Ws16 100.0000 DtyCyc 0.00 100.0000 FORMAT "%8.4" EXTENDED_LIMITS -327.6800 327.6700 /end CHARACTERISTIC
/begin CHARACTERISTIC TrbCh_rTransf_CUR "" CURVE 0x8006D3AC Cur_Xs16Ws16 100.0000 Prc 0.00 100.0000 FORMAT "%8.4" EXTENDED_LIMITS -400.0000 399.9878
 /begin AXIS_DESCR STD_AXIS TrbCh_rRaw DtyCyc 25 0.00 100.0000 FORMAT "%8.4" EXTENDED_LIMITS -327.6800 327.6700 DEPOSIT ABSOLUTE /end AXIS_DESCR
/end CHARACTERISTIC
/begin CHARACTERISTIC TrbCh_stPsDiaDisbl_C "" VALUE 0x8006D4A0 Val_Wu8 255.0 OneToOne 0.00 255.0 FORMAT "%5.1" /end CHARACTERISTIC
/begin CHARACTERISTIC TrbCh_stPsDisbl_C "" VALUE 0x8006D4A1 Val_Wu8 255.0 OneToOne 0.00 255.0 FORMAT "%5.1" /end CHARACTERISTIC
/begin CHARACTERISTIC TrbCh_typ4WinDia_C "" VALUE 0x8006D4A2 Val_Wu8 2.00000000000 Typ4WinDia 0.00 2.00000000000 FORMAT "%13.11" EXTENDED_LIMITS 0.00 3.00000000000 /end CHARACTERISTIC
/begin CHARACTERISTIC TSDa_tRadOutSubs_C "Ersatzwert für die Kühlmitteltemperatur am Kühleraustritt" VALUE 0x8006D200 Kw_Ws16 6553.500 Temp_Cels -3549.940 3003.560 FORMAT "%8.3" /end CHARACTERISTIC
/begin CHARACTERISTIC VehMot_mInrt_C "Fahrzeugmasse" VALUE 0x8007E6A8 Kw_Ws16 65535.00 Mass -32768.00 32767.00 FORMAT "%8.2" /end CHARACTERISTIC
/begin CHARACTERISTIC VehMot_tiFastLearn_C "Zeitkonstante für schnellen Lernmodus" VALUE 0x8007E6AA Kw_Ws16 65.53500 Time_s_1 -32.76800 32.76700 FORMAT "%8.5" /end CHARACTERISTIC
/begin CHARACTERISTIC VehMot_tiTrqDragMin_C "Minimale Zeitkonstante für Filterung geschätzter Fahrwiderstand" VALUE 0x8007E6AC Kw_Ws16 65.53500 Time_s_1 -32.76800 32.76700 FORMAT "%8.5" /end CHARACTERISTIC
/begin CHARACTERISTIC VehMot_tiTrqDragVx_CUR "Kennlinie für Zeitkonstante abhängig von Fahrzeuggeschwindigkeit" CURVE 0x8007E6AE Kl_Xs16_Ws16 65.53500 Time_s_1 -32.76800 32.76700 FORMAT "%8.5"
 /begin AXIS_DESCR STD_AXIS GlbDa_vX Vel 2 -327.6800 327.6700 FORMAT "%8.4" DEPOSIT ABSOLUTE /end AXIS_DESCR
/end CHARACTERISTIC
/begin CHARACTERISTIC VehMot_tiTrqPrpPT1_C "Zeitkonstante für Filterung Moment" VALUE 0x8007E6B8 Kw_Ws32 4294.9672940 TimeDelay_s 0.000002000000001 4294.9672960 FORMAT "%12.7" /end CHARACTERISTIC
/begin CHARACTERISTIC VehMot_trqDragMax_C "Maximaler Fahrwiderstand" VALUE 0x8007E6BC Kw_Ws32 429496729.500 TrqPrpHigh -214748364.800 214748364.700 FORMAT "%13.3" /end CHARACTERISTIC
/begin CHARACTERISTIC VehMot_trqThresComp_C "Schwelle für komplette Kompensation der Nebenaggregate" VALUE 0x8007E6C0 Kw_Ws32 429496729.500 TrqPrpHigh -214748364.800 214748364.700 FORMAT "%13.3" /end CHARACTERISTIC
/begin CHARACTERISTIC VehMot_vMinDragEst_C "Minimale Fahrzeuggeschwindigkeit für Berechnnung Fahrwiderstand" VALUE 0x8007E6C4 Kw_Ws16 6553.500 TrqPrpHigh -3276.800 3276.700 FORMAT "%8.3" /end CHARACTERISTIC
/begin CHARACTERISTIC VehV_ImpPerDist_C "" VALUE 0x8006D4D4 Val_Ws32 17.500000000000000 VSS_DistFac 2.500000000000000 20.000000000000000 FORMAT "%20.17" EXTENDED_LIMITS 3.352761270176974 7200000000.0000000 /end CHARACTERISTIC
/begin CHARACTERISTIC VehV_nThresPla_C "" VALUE 0x8006D4E0 Val_Ws16 16383.50 EngN 0.00 16383.50 FORMAT "%8.2" EXTENDED_LIMITS -16384.00 16383.50 /end CHARACTERISTIC
/begin CHARACTERISTIC VehV_swtSig_C "" VALUE 0x8006D4D8 Val_Wu8 255.0 OneToOne 0.00 255.0 FORMAT "%5.1" /end CHARACTERISTIC
/begin CHARACTERISTIC VehV_swtTrqSel_C "" VALUE 0x8006D4E2 Val_Wu8 255.0 OneToOne 0.00 255.0 FORMAT "%5.1" /end CHARACTERISTIC
/begin CHARACTERISTIC VehV_tiAPT1_C "" VALUE 0x8006D4E4 Val_Ws32 4294.9672940 TimeDelay_s 0.000002000000001 4294.9672960 FORMAT "%12.7" /end CHARACTERISTIC
/begin CHARACTERISTIC VehV_tiDebMonPla_C "" VALUE 0x8006D4E8 Val_Ws16 655350.0 Time_ms -327680.0 327670.0 FORMAT "%8.1" /end CHARACTERISTIC
/begin CHARACTERISTIC VehV_tiPerMax_C "" VALUE 0x8006D4DC Val_Ws32 214748364.750 Time_PwmHigh -107374182.400 107374182.350 FORMAT "%13.3" /end CHARACTERISTIC
/begin CHARACTERISTIC VehV_tiVPT1_C "" VALUE 0x8006D4EC Val_Ws32 4294.9672940 TimeDelay_s 0.000002000000001 4294.9672960 FORMAT "%12.7" /end CHARACTERISTIC
/begin CHARACTERISTIC VehV_trqThresPla_C "" VALUE 0x8006D4F0 Val_Ws16 3276.700 Trq 0.00 3276.700 FORMAT "%8.3" EXTENDED_LIMITS -3276.800 3276.700 /end CHARACTERISTIC
/begin CHARACTERISTIC VehV_vDfl_C "" VALUE 0x8006D4F2 Val_Ws16 327.6700 Vel 0.00 327.6700 FORMAT "%8.4" EXTENDED_LIMITS -327.6800 327.6700 /end CHARACTERISTIC
/begin CHARACTERISTIC VehV_vMax_C "" VALUE 0x8006D4F4 Val_Ws16 327.6700 Vel 0.00 327.6700 FORMAT "%8.4" EXTENDED_LIMITS -327.6800 327.6700 /end CHARACTERISTIC
/begin CHARACTERISTIC VehV_vMin_C "" VALUE 0x8006D4F6 Val_Ws16 20.00000 Vel 0.00 20.00000 FORMAT "%8.5" EXTENDED_LIMITS -327.6800 327.6700 /end CHARACTERISTIC
/begin CHARACTERISTIC VehV_vThresPla_C "" VALUE 0x8006D4F8 Val_Ws16 327.6700 Vel 0.00 327.6700 FORMAT "%8.4" EXTENDED_LIMITS -327.6800 327.6700 /end CHARACTERISTIC
/begin CHARACTERISTIC VMD_rEng_MAP "" MAP 0x8007E6D8 Map_Xs16Ys16Ws16 799.9878 Prc -400.0000 399.9878 FORMAT "%8.4"
 /begin AXIS_DESCR STD_AXIS Epm_nEng EngN 6 -16384.00 16383.50 FORMAT "%8.2" DEPOSIT ABSOLUTE /end AXIS_DESCR
 /begin AXIS_DESCR STD_AXIS VMD_trqEng Trq 16 -3276.800 3276.700 FORMAT "%8.3" DEPOSIT ABSOLUTE /end AXIS_DESCR
/end CHARACTERISTIC
/begin CHARACTERISTIC VMD_rPrp_MAP "" MAP 0x8007E7C8 Map_Xs16Ys16Ws16 799.9878 Prc -400.0000 399.9878 FORMAT "%8.4"
 /begin AXIS_DESCR STD_AXIS GlbDa_vX Vel 6 -327.6800 327.6700 FORMAT "%8.4" DEPOSIT ABSOLUTE /end AXIS_DESCR
 /begin AXIS_DESCR STD_AXIS VMD_trqPrpCorr TrqPrp 16 -52428.80 52427.20 FORMAT "%8.2" DEPOSIT ABSOLUTE /end AXIS_DESCR
/end CHARACTERISTIC
/begin CHARACTERISTIC VMD_tiFltVirtAPP_C "" VALUE 0x8007E6D4 Val_Ws32 4294.9672940 TimeDelay_s 0.000002000000001 4294.9672960 FORMAT "%12.7" /end CHARACTERISTIC
/begin CHARACTERISTIC VMD_trqThresEng_CUR "" CURVE 0x8007E8B8 Cur_Xs16Ws16 6553.500 Trq -3276.800 3276.700 FORMAT "%8.3"
 /begin AXIS_DESCR STD_AXIS Epm_nEng EngN 6 -16384.00 16383.50 FORMAT "%8.2" DEPOSIT ABSOLUTE /end AXIS_DESCR
/end CHARACTERISTIC
/begin CHARACTERISTIC VMD_trqThresPrp_CUR "" CURVE 0x8007E8D2 Cur_Xs16Ws16 104856.0 TrqPrp -52428.80 52427.20 FORMAT "%8.2"
 /begin AXIS_DESCR STD_AXIS GlbDa_vX Vel 6 -327.6800 327.6700 FORMAT "%8.4" DEPOSIT ABSOLUTE /end AXIS_DESCR
/end CHARACTERISTIC
/begin CHARACTERISTIC VMSI_dtrqRmpDCSP.Pos_C "/" VALUE 0x8007E8EC Kw_Ws32 3276799.99847 RmpTrqPrpHigh 0.00 3276799.99847 FORMAT "%13.5" EXTENDED_LIMITS -3276800.00000 3276799.99847 /end CHARACTERISTIC
/begin CHARACTERISTIC VMSI_dtrqRmpDCSP.Neg_C "/" VALUE 0x8007E8F0 Kw_Ws32 3276799.99847 RmpTrqPrpHigh 0.00 3276799.99847 FORMAT "%13.5" EXTENDED_LIMITS -3276800.00000 3276799.99847 /end CHARACTERISTIC
/begin CHARACTERISTIC VMSI_dtrqRmpTCSP.Pos_C "/" VALUE 0x8007E8F4 Kw_Ws32 3276799.99847 RmpTrqPrpHigh 0.00 3276799.99847 FORMAT "%13.5" EXTENDED_LIMITS -3276800.00000 3276799.99847 /end CHARACTERISTIC
/begin CHARACTERISTIC VMSI_dtrqRmpTCSP.Neg_C "/" VALUE 0x8007E8F8 Kw_Ws32 3276799.99847 RmpTrqPrpHigh 0.00 3276799.99847 FORMAT "%13.5" EXTENDED_LIMITS -3276800.00000 3276799.99847 /end CHARACTERISTIC
/begin CHARACTERISTIC VMSI_stCfg_C "Konfigurationsparameter für Stabilitätseingriffe" VALUE 0x8007E8FC Val_Wu8 255.0 OneToOne 0.00 255.0 FORMAT "%5.1" /end CHARACTERISTIC
/begin CHARACTERISTIC VMSI_swtSlipCtl_C "EEPROM-Schalter für verfügbare Stabilitätseingriffe" VALUE 0x8007E8FD Val_Wu8 255.0 OneToOne 0.00 255.0 FORMAT "%5.1" /end CHARACTERISTIC
/begin CHARACTERISTIC VSwCtl_facEngTempCtlCor_CUR "Kennlinie für den Korrekturfaktor für die Motortemperatur Korrektur" CURVE 0x8007E900 Kl_Xs16_Ws16 1.000000 Fact 0.00 1.000000 FORMAT "%8.6" EXTENDED_LIMITS -4.000000 3.999878
 /begin AXIS_DESCR STD_AXIS VSwCtl_tEngCtlVal_mp Temp_Cels 12 -50.14000 199.8600 FORMAT "%8.4" EXTENDED_LIMITS -3549.940 3003.560 DEPOSIT ABSOLUTE /end AXIS_DESCR
/end CHARACTERISTIC
/begin CHARACTERISTIC VSwCtl_facEnvPresCtlCorEOMQnt1_CUR "Kennlinie: Atmosphärendruck-Korrekturfaktor für die Drallniveau-Steuerung für die erste auf Einspritzmenge basierte Betriebsart" CURVE 0x8007EF3C Kl_Xs16_Ws16 8192.000 Fact 0.00 8192.000 FORMAT "%8.3" EXTENDED_LIMITS -4.000000 3.999878
 /begin AXIS_DESCR STD_AXIS EnvP_p Pres_hPa 25 0.00 3500.000 FORMAT "%8.3" EXTENDED_LIMITS -32768.00 32767.00 DEPOSIT ABSOLUTE /end AXIS_DESCR
/end CHARACTERISTIC
/begin CHARACTERISTIC VSwCtl_facEnvPresCtlCor_CUR "Kennlinie für Atmosphärendruck Korrektur" CURVE 0x8007E932 Kl_Xs16_Ws16 1.000000 Fact 0.00 1.000000 FORMAT "%8.6" EXTENDED_LIMITS -4.000000 3.999878
 /begin AXIS_DESCR STD_AXIS EnvP_p Pres_hPa 25 0.00 3500.000 FORMAT "%8.3" EXTENDED_LIMITS -32768.00 32767.00 DEPOSIT ABSOLUTE /end AXIS_DESCR
/end CHARACTERISTIC
/begin CHARACTERISTIC VSwCtl_facRmpValCtlCor_CUR "Korrekturkennlinie für den EGT-Rampenwert" CURVE 0x8007EEE8 Kl_Xs16_Ws16 3.999939 CoEOMSwt_S16 -2.000000 1.999939 FORMAT "%8.6"
 /begin AXIS_DESCR STD_AXIS VSwCtl_facRmpVal_mp CoEOMSwt_S16 13 -2.000000 1.999939 FORMAT "%8.6" DEPOSIT ABSOLUTE /end AXIS_DESCR
/end CHARACTERISTIC
/begin CHARACTERISTIC VSwCtl_numEngTempCtlVal_C "Index zur Auswahl einer Temperatur aus dem Motortemperaturfeld" VALUE 0x8007E998 Kw_Wu8 2.00000000000 EngTempFldSel 0.00 2.00000000000 FORMAT "%13.11" /end CHARACTERISTIC
/begin CHARACTERISTIC VSwCtl_rCtlBasEOMQnt1_MAP "Kennfeld: Basiswert für die Drallniveau-Steuerung für die erste auf Einspritzmenge basierte Betriebsart" MAP 0x8007EFA2 Kf_Xs16_Ys16_Ws16 8192.004 Prc 0.00 8192.004 FORMAT "%8.3" EXTENDED_LIMITS -400.0000 399.9878
 /begin AXIS_DESCR STD_AXIS Epm_nEng EngN 16 0.00 12000.00 FORMAT "%8.2" EXTENDED_LIMITS -16384.00 16383.50 DEPOSIT ABSOLUTE /end AXIS_DESCR
 /begin AXIS_DESCR STD_AXIS VSwCtl_qCurr_mp InjMass 16 0.00 327.6700 FORMAT "%8.4" EXTENDED_LIMITS -327.6800 327.6700 DEPOSIT ABSOLUTE /end AXIS_DESCR
/end CHARACTERISTIC
/begin CHARACTERISTIC VSwCtl_rCtlBasHiAltdEOMQnt1_MAP "Kennfeld: Höhenbasiswert für die Drallniveau-Steuerung für die erste auf Einspritzmenge basierte Betriebsart" MAP 0x8007F1E6 Kf_Xs16_Ys16_Ws16 8192.004 Prc 0.00 8192.004 FORMAT "%8.3" EXTENDED_LIMITS -400.0000 399.9878
 /begin AXIS_DESCR STD_AXIS Epm_nEng EngN 16 0.00 12000.00 FORMAT "%8.2" EXTENDED_LIMITS -16384.00 16383.50 DEPOSIT ABSOLUTE /end AXIS_DESCR
 /begin AXIS_DESCR STD_AXIS VSwCtl_qCurr_mp InjMass 16 0.00 327.6700 FORMAT "%8.4" EXTENDED_LIMITS -327.6800 327.6700 DEPOSIT ABSOLUTE /end AXIS_DESCR
/end CHARACTERISTIC
/begin CHARACTERISTIC VSwCtl_rCtlBasHiAltd_MAP "Kennfeld für den Basissteuerwert in der Höhe" MAP 0x8007E99A Kf_Xs16_Ys16_Ws16 100.0000 Prc 0.00 100.0000 FORMAT "%8.4" EXTENDED_LIMITS -400.0000 399.9878
 /begin AXIS_DESCR STD_AXIS Epm_nEng EngN 16 0.00 6000.000 FORMAT "%8.3" EXTENDED_LIMITS -16384.00 16383.50 DEPOSIT ABSOLUTE /end AXIS_DESCR
 /begin AXIS_DESCR STD_AXIS InjCtl_qCurr InjMass 16 0.00 1500.000 FORMAT "%8.3" EXTENDED_LIMITS -327.6800 327.6700 DEPOSIT ABSOLUTE /end AXIS_DESCR
/end CHARACTERISTIC
/begin CHARACTERISTIC VSwCtl_rCtlBas_MAP "Grundkennfeld für den Steuerwert" MAP 0x8007EBDE Kf_Xs16_Ys16_Ws16 100.0000 Prc 0.00 100.0000 FORMAT "%8.4" EXTENDED_LIMITS -400.0000 399.9878
 /begin AXIS_DESCR STD_AXIS Epm_nEng EngN 16 0.00 6000.000 FORMAT "%8.3" EXTENDED_LIMITS -16384.00 16383.50 DEPOSIT ABSOLUTE /end AXIS_DESCR
 /begin AXIS_DESCR STD_AXIS InjCtl_qCurr InjMass 16 0.00 1500.000 FORMAT "%8.3" EXTENDED_LIMITS -327.6800 327.6700 DEPOSIT ABSOLUTE /end AXIS_DESCR
/end CHARACTERISTIC
/begin CHARACTERISTIC VSwCtl_rDflVal_CA "Vorgabewerteliste" VAL_BLK 0x8007EE22 ValA_Ws16 799.9878 Prc -400.0000 399.9878 FORMAT "%8.4" NUMBER 6 /end CHARACTERISTIC
/begin CHARACTERISTIC VSwCtl_rEngTempCorBas_MAP "Basissteuerwert für die Motortemperatur Korrektur" MAP 0x8007EE2E Kf_Xs16_Ys16_Ws16 100.0000 Prc 0.00 100.0000 FORMAT "%8.4" EXTENDED_LIMITS -400.0000 399.9878
 /begin AXIS_DESCR STD_AXIS Epm_nEng EngN 8 0.00 6000.000 FORMAT "%8.3" EXTENDED_LIMITS -16384.00 16383.50 DEPOSIT ABSOLUTE /end AXIS_DESCR
 /begin AXIS_DESCR STD_AXIS InjCtl_qCurr InjMass 8 0.00 1500.000 FORMAT "%8.3" EXTENDED_LIMITS -327.6800 327.6700 DEPOSIT ABSOLUTE /end AXIS_DESCR
/end CHARACTERISTIC
/begin CHARACTERISTIC VSwCtl_rThresMax_C "Obere Grenze des zweistufigen Schwellwertschalters" VALUE 0x8007EED2 Kw_Ws16 100.0000 Prc 0.00 100.0000 FORMAT "%8.4" EXTENDED_LIMITS -400.0000 399.9878 /end CHARACTERISTIC
/begin CHARACTERISTIC VSwCtl_rThresMin_C "Untere Grenze des zweistufigen Schwellwertschalters" VALUE 0x8007EED4 Kw_Ws16 100.0000 Prc 0.00 100.0000 FORMAT "%8.4" EXTENDED_LIMITS -400.0000 399.9878 /end CHARACTERISTIC
/begin CHARACTERISTIC VSwCtl_rVSAAirTempCorr_CUR "" CURVE 0x8006D4A4 Kl_Xs16_Ws16 100.0000 Prc 0.00 100.0000 FORMAT "%8.4" EXTENDED_LIMITS -400.0000 399.9878
 /begin AXIS_DESCR STD_AXIS Air_tAFS Temp_Cels 6 -50.14000 199.8600 FORMAT "%8.4" EXTENDED_LIMITS -3549.940 3003.560 DEPOSIT ABSOLUTE /end AXIS_DESCR
/end CHARACTERISTIC
/begin CHARACTERISTIC VSwCtl_rVSAMax_C "Maximales Drallniveausteller Ansteuerverhältnis" VALUE 0x8007EED6 Kw_Ws16 100.0000 Prc 0.00 100.0000 FORMAT "%8.4" EXTENDED_LIMITS -400.0000 399.9878 /end CHARACTERISTIC
/begin CHARACTERISTIC VSwCtl_rVSAMin_C "Minimales Drallniveausteller Ansteuerverhältnis" VALUE 0x8007EED8 Kw_Ws16 100.0000 Prc 0.00 100.0000 FORMAT "%8.4" EXTENDED_LIMITS -400.0000 399.9878 /end CHARACTERISTIC
/begin CHARACTERISTIC VSwCtl_stBitMskEOM_CA "Bitmaske zur Auswahl der relevanten Abschaltfälle im Regenerationsbetrieb" VAL_BLK 0x8007EF24 ValA_Wu32 4294967295.00 OneToOne 0.00 4294967295.00 FORMAT "%13.2" NUMBER 2 /end CHARACTERISTIC
/begin CHARACTERISTIC VSwCtl_stCtlValEOMMsk_CA "Bitmaske für die Auswahl der Regenerationsstufe" VAL_BLK 0x8007EF20 ValA_Wu32 4294967295.00 OneToOne 0.00 4294967295.00 FORMAT "%13.2" NUMBER 1 /end CHARACTERISTIC
/begin CHARACTERISTIC VSwCtl_stMonEOMMsk_CA "Bitmaske für den Abschaltfall im Regenerationsbetrieb" VAL_BLK 0x8007EF2C ValA_Wu32 4294967295.00 OneToOne 0.00 4294967295.00 FORMAT "%13.2" NUMBER 2 /end CHARACTERISTIC
/begin CHARACTERISTIC VSwCtl_stPrioMon_CA "Prioritätenliste" VAL_BLK 0x8007EEDA ValA_Ws16 65535.00 OneToOne -32768.00 32767.00 FORMAT "%8.2" NUMBER 6 /end CHARACTERISTIC
/begin CHARACTERISTIC VSwCtl_stShOffEOMMsk_C "Bitmaske für für einen relevanten Betriebsartwechsel" VALUE 0x8007EF38 Kw_Wu32 4294967295.00 OneToOne 0.00 4294967295.00 FORMAT "%13.2" /end CHARACTERISTIC
/begin CHARACTERISTIC VSwCtl_swtHysOff_C "Schalter für die Umschaltung zwischen kontinuierlicher und zwei Punkt Drallniveausteuerung" VALUE 0x8007EEE6 Kw_Wu8 255.0 OneToOne 0.00 255.0 FORMAT "%5.1" /end CHARACTERISTIC
/begin CHARACTERISTIC VSwCtl_tiMonEOM_CA "Verzögerungszeit zum Vergleich der Bitmasken der relevanten Abschaltfälle" VAL_BLK 0x8007EF34 ValA_Ws16 655350.0 TimeDeb -327680.0 327670.0 FORMAT "%8.1" NUMBER 2 /end CHARACTERISTIC
/begin CHARACTERISTIC VSwCtl_tiStartDelay_CUR "" CURVE 0x8006D4BE Kl_Xs16_Ws16 20.00000 TimeDeb 0.00 20.00000 FORMAT "%8.5" EXTENDED_LIMITS -327680.0 327670.0
 /begin AXIS_DESCR STD_AXIS VSwCtl_tEngCtlVal_mp Temp_Cels 5 0.9600000 198.9600 FORMAT "%8.4" EXTENDED_LIMITS -3549.940 3003.560 DEPOSIT ABSOLUTE /end AXIS_DESCR
/end CHARACTERISTIC
/begin CHARACTERISTIC VSwVlv_DKdNgv_C "" VALUE 0x8007F4A4 Val_Ws32 10.0000000000 Kd 0.00 10.0000000000 FORMAT "%13.10" EXTENDED_LIMITS -32768.0000000 32767.9999847 /end CHARACTERISTIC
/begin CHARACTERISTIC VSwVlv_DKdPsv_C "" VALUE 0x8007F4A8 Val_Ws32 10.0000000000 Kd 0.00 10.0000000000 FORMAT "%13.10" EXTENDED_LIMITS -32768.0000000 32767.9999847 /end CHARACTERISTIC
/begin CHARACTERISTIC VSwVlv_drActNgv_C "" VALUE 0x8007F4AC Val_Ws16 7999.878 VlvVel -4000.000 3999.878 FORMAT "%8.3" /end CHARACTERISTIC
/begin CHARACTERISTIC VSwVlv_drActPsv_C "" VALUE 0x8007F4AE Val_Ws16 7999.878 VlvVel -4000.000 3999.878 FORMAT "%8.3" /end CHARACTERISTIC
/begin CHARACTERISTIC VSwVlv_drOfsLrnVlvSlpDwn_C "" VALUE 0x8007F5A4 Val_Ws32 399999.999814 RmpPrc 0.00 399999.999814 FORMAT "%13.6" EXTENDED_LIMITS -400000.000000 399999.999814 /end CHARACTERISTIC
/begin CHARACTERISTIC VSwVlv_drOfsLrnVlvSlpUp_C "" VALUE 0x8007F5A8 Val_Ws32 399999.999814 RmpPrc 0.00 399999.999814 FORMAT "%13.6" EXTENDED_LIMITS -400000.000000 399999.999814 /end CHARACTERISTIC
/begin CHARACTERISTIC VSwVlv_facLpGnStrt_C "" VALUE 0x8007F42C Val_Ws16 7.999878 Fact -4.000000 3.999878 FORMAT "%8.6" /end CHARACTERISTIC
/begin CHARACTERISTIC VSwVlv_IKiNgv_C "" VALUE 0x8007F4B0 Val_Ws32 99.9998301268 Ki 0.00 99.9998301268 FORMAT "%13.9" EXTENDED_LIMITS -1000000.00000 999999.999534 /end CHARACTERISTIC
/begin CHARACTERISTIC VSwVlv_IKiPsv_C "" VALUE 0x8007F4B4 Val_Ws32 99.9998301268 Ki 0.00 99.9998301268 FORMAT "%13.9" EXTENDED_LIMITS -1000000.00000 999999.999534 /end CHARACTERISTIC
/begin CHARACTERISTIC VSwVlv_numAdapClsMax_C "" VALUE 0x8007F5AC Val_Wu8 255.0 OneToOne 0.00 255.0 FORMAT "%5.1" /end CHARACTERISTIC
/begin CHARACTERISTIC VSwVlv_PKpNgv_C "" VALUE 0x8007F4B8 Val_Ws32 20.0000000000 Kp 0.00 20.0000000000 FORMAT "%13.10" EXTENDED_LIMITS -65536.0000000 65535.9999695 /end CHARACTERISTIC
/begin CHARACTERISTIC VSwVlv_PKpPsv_C "" VALUE 0x8007F4BC Val_Ws32 20.0000000000 Kp 0.00 20.0000000000 FORMAT "%13.10" EXTENDED_LIMITS -65536.0000000 65535.9999695 /end CHARACTERISTIC
/begin CHARACTERISTIC VSwVlv_Pwm.tiPer_C "/" VALUE 0x8007F42E Kw_Ws16 9.900000 Period 0.1000000 10.00000 FORMAT "%8.5" EXTENDED_LIMITS -3276.800 3276.700 /end CHARACTERISTIC
/begin CHARACTERISTIC VSwVlv_Pwm.stLvl_C "/" VALUE 0x8007F430 Kw_Wu8 1.000 OneToOne 0.00 1.000 FORMAT "%5.3" EXTENDED_LIMITS 0.00 255.0 /end CHARACTERISTIC
/begin CHARACTERISTIC VSwVlv_Pwm.rMaxDty_C "/" VALUE 0x8007F432 Kw_Ws16 100.0000 DtyCyc 0.00 100.0000 FORMAT "%8.4" EXTENDED_LIMITS -327.6800 327.6700 /end CHARACTERISTIC
/begin CHARACTERISTIC VSwVlv_Pwm.rPerUn_C "/" VALUE 0x8007F434 Kw_Ws16 3276.700 Period 0.00 3276.700 FORMAT "%8.3" EXTENDED_LIMITS -3276.800 3276.700 /end CHARACTERISTIC
/begin CHARACTERISTIC VSwVlv_Pwm.tiPh_C "/" VALUE 0x8007F436 Kw_Ws16 65535.00 OneToOne -32768.00 32767.00 FORMAT "%8.2" /end CHARACTERISTIC
/begin CHARACTERISTIC VSwVlv_PwmOut.rMin_C "/" VALUE 0x8007F438 Kw_Ws16 100.0000 DtyCyc 0.00 100.0000 FORMAT "%8.4" EXTENDED_LIMITS -327.6800 327.6700 /end CHARACTERISTIC
/begin CHARACTERISTIC VSwVlv_PwmOut.rMax_C "/" VALUE 0x8007F43A Kw_Ws16 100.0000 DtyCyc 0.00 100.0000 FORMAT "%8.4" EXTENDED_LIMITS -327.6800 327.6700 /end CHARACTERISTIC
/begin CHARACTERISTIC VSwVlv_PwmOut.tiBtwTstSCB_C "/" VALUE 0x8007F43C Kw_Ws16 1000.000 Time_ms 0.00 1000.000 FORMAT "%8.3" EXTENDED_LIMITS -327680.0 327670.0 /end CHARACTERISTIC
/begin CHARACTERISTIC VSwVlv_PwmOut.tiBtwTstOT_C "/" VALUE 0x8007F43E Kw_Ws16 327.6700 Time_s 0.00 327.6700 FORMAT "%8.4" EXTENDED_LIMITS -327.6800 327.6700 /end CHARACTERISTIC
/begin CHARACTERISTIC VSwVlv_PwmOut.numTstMax_C "/" VALUE 0x8007F440 Kw_Wu16 65535.00 OneToOne 0.00 65535.00 FORMAT "%8.2" /end CHARACTERISTIC
/begin CHARACTERISTIC VSwVlv_PwmOut.swtBattCor_C "/" VALUE 0x8007F442 Kw_Wu8 1.000 OneToOne 0.00 1.000 FORMAT "%5.3" EXTENDED_LIMITS 0.00 255.0 /end CHARACTERISTIC
/begin CHARACTERISTIC VSwVlv_PwmOut.swtPsInv_C "/" VALUE 0x8007F443 Kw_Wu8 255.0 OneToOne 0.00 255.0 FORMAT "%5.1" /end CHARACTERISTIC
/begin CHARACTERISTIC VSwVlv_rActMax_C "" VALUE 0x8007F5AE Val_Ws16 100.0000 Prc 0.00 100.0000 FORMAT "%8.4" EXTENDED_LIMITS -400.0000 399.9878 /end CHARACTERISTIC
/begin CHARACTERISTIC VSwVlv_rActMin_C "" VALUE 0x8007F5B0 Val_Ws16 100.0000 Prc 0.00 100.0000 FORMAT "%8.4" EXTENDED_LIMITS -400.0000 399.9878 /end CHARACTERISTIC
/begin CHARACTERISTIC VSwVlv_rActNgv_C "" VALUE 0x8007F4C0 Val_Ws16 799.9878 Prc -400.0000 399.9878 FORMAT "%8.4" /end CHARACTERISTIC
/begin CHARACTERISTIC VSwVlv_rActPosMin_C "" VALUE 0x8007F5B2 Val_Ws16 100.0000 Prc 0.00 100.0000 FORMAT "%8.4" EXTENDED_LIMITS -400.0000 399.9878 /end CHARACTERISTIC
/begin CHARACTERISTIC VSwVlv_rActPosOfs_C "" VALUE 0x8007F5B4 Val_Ws16 100.0000 Prc 0.00 100.0000 FORMAT "%8.4" EXTENDED_LIMITS -400.0000 399.9878 /end CHARACTERISTIC
/begin CHARACTERISTIC VSwVlv_rActPsv_C "" VALUE 0x8007F4C2 Val_Ws16 799.9878 Prc -400.0000 399.9878 FORMAT "%8.4" /end CHARACTERISTIC
/begin CHARACTERISTIC VSwVlv_rAdapAgClsMin_C "" VALUE 0x8007F5B6 Val_Ws16 100.0000 Prc 0.00 100.0000 FORMAT "%8.4" EXTENDED_LIMITS -400.0000 399.9878 /end CHARACTERISTIC
/begin CHARACTERISTIC VSwVlv_rAdapAgOpnMax_C "" VALUE 0x8007F5B8 Val_Ws16 100.0000 Prc 0.00 100.0000 FORMAT "%8.4" EXTENDED_LIMITS -400.0000 399.9878 /end CHARACTERISTIC
/begin CHARACTERISTIC VSwVlv_rAdapDiffPlausLgT_C "" VALUE 0x8007F5BA Val_Ws16 100.0000 Prc 0.00 100.0000 FORMAT "%8.4" EXTENDED_LIMITS -400.0000 399.9878 /end CHARACTERISTIC
/begin CHARACTERISTIC VSwVlv_rAdapDiffPlausMin_C "" VALUE 0x8007F5BC Val_Ws16 100.0000 Prc 0.00 100.0000 FORMAT "%8.4" EXTENDED_LIMITS -400.0000 399.9878 /end CHARACTERISTIC
/begin CHARACTERISTIC VSwVlv_rAdapDiffPlausShT_C "" VALUE 0x8007F5BE Val_Ws16 100.0000 Prc 0.00 100.0000 FORMAT "%8.4" EXTENDED_LIMITS -400.0000 399.9878 /end CHARACTERISTIC
/begin CHARACTERISTIC VSwVlv_rAdapDiffPlaus_C "" VALUE 0x8007F5C0 Val_Ws16 100.0000 Prc 0.00 100.0000 FORMAT "%8.4" EXTENDED_LIMITS -400.0000 399.9878 /end CHARACTERISTIC
/begin CHARACTERISTIC VSwVlv_rAdap_CUR "" CURVE 0x8007F4C4 Cur_Xs16Ws16 799.9878 Prc -400.0000 399.9878 FORMAT "%8.4"
 /begin AXIS_DESCR STD_AXIS VSwVlv_r Prc 16 -400.0000 399.9878 FORMAT "%8.4" DEPOSIT ABSOLUTE /end AXIS_DESCR
/end CHARACTERISTIC
/begin CHARACTERISTIC VSwVlv_rCmpNewCtlUn_C "" VALUE 0x8007F5C2 Val_Ws16 100.0000 Prc 0.00 100.0000 FORMAT "%8.4" EXTENDED_LIMITS -400.0000 399.9878 /end CHARACTERISTIC
/begin CHARACTERISTIC VSwVlv_rCnv_CUR "" CURVE 0x8007F444 Cur_Xs16Ws16 655.3500 DtyCyc -327.6800 327.6700 FORMAT "%8.4"
 /begin AXIS_DESCR STD_AXIS VSwVlv_rVSw Prc 16 -400.0000 399.9878 FORMAT "%8.4" DEPOSIT ABSOLUTE /end AXIS_DESCR
/end CHARACTERISTIC
/begin CHARACTERISTIC VSwVlv_rDMax_C "" VALUE 0x8007F506 Val_Ws16 100.0000 Prc 0.00 100.0000 FORMAT "%8.4" EXTENDED_LIMITS -400.0000 399.9878 /end CHARACTERISTIC
/begin CHARACTERISTIC VSwVlv_rDvtMax_C "" VALUE 0x8007F490 Val_Ws16 799.9878 Prc -400.0000 399.9878 FORMAT "%8.4" /end CHARACTERISTIC
/begin CHARACTERISTIC VSwVlv_rDvtMin_C "" VALUE 0x8007F492 Val_Ws16 799.9878 Prc -400.0000 399.9878 FORMAT "%8.4" /end CHARACTERISTIC
/begin CHARACTERISTIC VSwVlv_rGovDvtThres_C "" VALUE 0x8007F508 Val_Ws16 100.0000 Prc 0.00 100.0000 FORMAT "%8.4" EXTENDED_LIMITS -400.0000 399.9878 /end CHARACTERISTIC
/begin CHARACTERISTIC VSwVlv_rGovMax_C "" VALUE 0x8007F50A Val_Ws16 100.0000 Prc 0.00 100.0000 FORMAT "%8.4" EXTENDED_LIMITS -400.0000 399.9878 /end CHARACTERISTIC
/begin CHARACTERISTIC VSwVlv_rGovMin_C "" VALUE 0x8007F50C Val_Ws16 200.0000 Prc -100.0000 100.0000 FORMAT "%8.4" EXTENDED_LIMITS -400.0000 399.9878 /end CHARACTERISTIC
/begin CHARACTERISTIC VSwVlv_RlsIKi_C "" VALUE 0x8007F494 Val_Ws32 66076419.9231 Ki_ThrVlv -33038209.9692 33038209.9538 FORMAT "%13.4" /end CHARACTERISTIC
/begin CHARACTERISTIC VSwVlv_rMax_C "" VALUE 0x8007F50E Val_Ws16 100.0000 Prc 0.00 100.0000 FORMAT "%8.4" EXTENDED_LIMITS -400.0000 399.9878 /end CHARACTERISTIC
/begin CHARACTERISTIC VSwVlv_rMinLrnLstCor_C "" VALUE 0x8007F5C4 Val_Ws16 200.0000 Prc -100.0000 100.0000 FORMAT "%8.4" EXTENDED_LIMITS -400.0000 399.9878 /end CHARACTERISTIC
/begin CHARACTERISTIC VSwVlv_rMin_C "" VALUE 0x8007F510 Val_Ws16 150.0000 Prc -50.00000 100.0000 FORMAT "%8.4" EXTENDED_LIMITS -400.0000 399.9878 /end CHARACTERISTIC
/begin CHARACTERISTIC VSwVlv_RmpSlp.Pos_C "/" VALUE 0x8007F5C8 Kw_Ws32 5.00008463860 RmpPrc 0.00 5.00008463860 FORMAT "%13.11" EXTENDED_LIMITS -400000.000000 399999.999814 /end CHARACTERISTIC
/begin CHARACTERISTIC VSwVlv_RmpSlp.Neg_C "/" VALUE 0x8007F5CC Kw_Ws32 5.00008463860 RmpPrc 0.00 5.00008463860 FORMAT "%13.11" EXTENDED_LIMITS -400000.000000 399999.999814 /end CHARACTERISTIC
/begin CHARACTERISTIC VSwVlv_rOfsLrnLstCor_C "" VALUE 0x8007F5D0 Val_Ws16 200.0000 Prc -100.0000 100.0000 FORMAT "%8.4" EXTENDED_LIMITS -400.0000 399.9878 /end CHARACTERISTIC
/begin CHARACTERISTIC VSwVlv_rOfsLrnVlvMax_C "" VALUE 0x8007F5D2 Val_Ws16 100.0000 Prc 0.00 100.0000 FORMAT "%8.4" EXTENDED_LIMITS -400.0000 399.9878 /end CHARACTERISTIC
/begin CHARACTERISTIC VSwVlv_rOfsLrnVlvMin_C "" VALUE 0x8007F5D4 Val_Ws16 200.0000 Prc -100.0000 100.0000 FORMAT "%8.4" EXTENDED_LIMITS -400.0000 399.9878 /end CHARACTERISTIC
/begin CHARACTERISTIC VSwVlv_rOutDMax_C "" VALUE 0x8007F512 Val_Ws16 100.0000 Prc 0.00 100.0000 FORMAT "%8.4" EXTENDED_LIMITS -400.0000 399.9878 /end CHARACTERISTIC
/begin CHARACTERISTIC VSwVlv_rOutIMax_C "" VALUE 0x8007F514 Val_Ws16 100.0000 Prc 0.00 100.0000 FORMAT "%8.4" EXTENDED_LIMITS -400.0000 399.9878 /end CHARACTERISTIC
/begin CHARACTERISTIC VSwVlv_rPIDWinNgv_C "" VALUE 0x8007F516 Val_Ws16 200.0000 Prc -100.0000 100.0000 FORMAT "%8.4" EXTENDED_LIMITS -400.0000 399.9878 /end CHARACTERISTIC
/begin CHARACTERISTIC VSwVlv_rPIDWinPsv_C "" VALUE 0x8007F518 Val_Ws16 100.0000 Prc 0.00 100.0000 FORMAT "%8.4" EXTENDED_LIMITS -400.0000 399.9878 /end CHARACTERISTIC
/begin CHARACTERISTIC VSwVlv_rPlausLgTMin_C "" VALUE 0x8007F5D6 Val_Ws16 100.0000 Prc 0.00 100.0000 FORMAT "%8.4" EXTENDED_LIMITS -400.0000 399.9878 /end CHARACTERISTIC
/begin CHARACTERISTIC VSwVlv_rPlausShTMin_C "" VALUE 0x8007F5D8 Val_Ws16 100.0000 Prc 0.00 100.0000 FORMAT "%8.4" EXTENDED_LIMITS -400.0000 399.9878 /end CHARACTERISTIC
/begin CHARACTERISTIC VSwVlv_rRlsMax_C "" VALUE 0x8007F498 Val_Ws16 799.9878 Prc -400.0000 399.9878 FORMAT "%8.4" /end CHARACTERISTIC
/begin CHARACTERISTIC VSwVlv_rRlsMin_C "" VALUE 0x8007F49A Val_Ws16 799.9878 Prc -400.0000 399.9878 FORMAT "%8.4" /end CHARACTERISTIC
/begin CHARACTERISTIC VSwVlv_rTransf_CUR "" CURVE 0x8007F558 Kl_Xs16_Ws16 100.0000 Prc 0.00 100.0000 FORMAT "%8.4" EXTENDED_LIMITS -400.0000 399.9878
 /begin AXIS_DESCR STD_AXIS VSwVlv_uRaw Volt 16 0.00 5200.000 FORMAT "%8.3" EXTENDED_LIMITS -6553.600 6553.400 DEPOSIT ABSOLUTE /end AXIS_DESCR
/end CHARACTERISTIC
/begin CHARACTERISTIC VSwVlv_SlwClsDKd_C "" VALUE 0x8007F51C Val_Ws32 65535.9999847 Kd -32768.0000000 32767.9999847 FORMAT "%13.7" /end CHARACTERISTIC
/begin CHARACTERISTIC VSwVlv_SlwClsIKi_C "" VALUE 0x8007F520 Val_Ws32 1999999.99953 Ki -1000000.00000 999999.999534 FORMAT "%13.5" /end CHARACTERISTIC
/begin CHARACTERISTIC VSwVlv_SlwClsPKp_C "" VALUE 0x8007F524 Val_Ws32 131071.999969 Kp -65536.0000000 65535.9999695 FORMAT "%13.7" /end CHARACTERISTIC
/begin CHARACTERISTIC VSwVlv_SlwOpnDKd_C "" VALUE 0x8007F528 Val_Ws32 65535.9999847 Kd -32768.0000000 32767.9999847 FORMAT "%13.7" /end CHARACTERISTIC
/begin CHARACTERISTIC VSwVlv_SlwOpnIKi_C "" VALUE 0x8007F52C Val_Ws32 1999999.99953 Ki -1000000.00000 999999.999534 FORMAT "%13.5" /end CHARACTERISTIC
/begin CHARACTERISTIC VSwVlv_SlwOpnPKp_C "" VALUE 0x8007F530 Val_Ws32 131071.999969 Kp -65536.0000000 65535.9999695 FORMAT "%13.7" /end CHARACTERISTIC
/begin CHARACTERISTIC VSwVlv_SmlSigNgvDKd_C "" VALUE 0x8007F534 Val_Ws32 10.0000000000 Kd 0.00 10.0000000000 FORMAT "%13.10" EXTENDED_LIMITS -32768.0000000 32767.9999847 /end CHARACTERISTIC
/begin CHARACTERISTIC VSwVlv_SmlSigNgvIKi_C "" VALUE 0x8007F538 Val_Ws32 99.9998301268 Ki 0.00 99.9998301268 FORMAT "%13.9" EXTENDED_LIMITS -1000000.00000 999999.999534 /end CHARACTERISTIC
/begin CHARACTERISTIC VSwVlv_SmlSigNgvPKp_C "" VALUE 0x8007F53C Val_Ws32 20.0000000000 Kp 0.00 20.0000000000 FORMAT "%13.10" EXTENDED_LIMITS -65536.0000000 65535.9999695 /end CHARACTERISTIC
/begin CHARACTERISTIC VSwVlv_SmlSigPsvDKd_C "" VALUE 0x8007F540 Val_Ws32 10.0000000000 Kd 0.00 10.0000000000 FORMAT "%13.10" EXTENDED_LIMITS -32768.0000000 32767.9999847 /end CHARACTERISTIC
/begin CHARACTERISTIC VSwVlv_SmlSigPsvIKi_C "" VALUE 0x8007F544 Val_Ws32 99.9998301268 Ki 0.00 99.9998301268 FORMAT "%13.9" EXTENDED_LIMITS -1000000.00000 999999.999534 /end CHARACTERISTIC
/begin CHARACTERISTIC VSwVlv_SmlSigPsvPKp_C "" VALUE 0x8007F548 Val_Ws32 20.0000000000 Kp 0.00 20.0000000000 FORMAT "%13.10" EXTENDED_LIMITS -65536.0000000 65535.9999695 /end CHARACTERISTIC
/begin CHARACTERISTIC VSwVlv_SRC.uMin_C "/" VALUE 0x8007F59A Kw_Ws16 5200.000 Volt 0.00 5200.000 FORMAT "%8.3" EXTENDED_LIMITS -6553.600 6553.400 /end CHARACTERISTIC
/begin CHARACTERISTIC VSwVlv_SRC.uMax_C "/" VALUE 0x8007F59C Kw_Ws16 5200.000 Volt 0.00 5200.000 FORMAT "%8.3" EXTENDED_LIMITS -6553.600 6553.400 /end CHARACTERISTIC
/begin CHARACTERISTIC VSwVlv_stNewVlvTrg_C "" VALUE 0x8007F5DA Val_Wu8 1.000 OneToOne 0.00 1.000 FORMAT "%5.3" EXTENDED_LIMITS 0.00 255.0 /end CHARACTERISTIC
/begin CHARACTERISTIC VSwVlv_stOfsLrnTrg_C "" VALUE 0x8007F5DB Val_Wu8 1.000 OneToOne 0.00 1.000 FORMAT "%5.3" EXTENDED_LIMITS 0.00 255.0 /end CHARACTERISTIC
/begin CHARACTERISTIC VSwVlv_stPsDiaDisbl_C "" VALUE 0x8007F486 Val_Wu8 255.0 OneToOne 0.00 255.0 FORMAT "%5.1" /end CHARACTERISTIC
/begin CHARACTERISTIC VSwVlv_stPsDisbl_C "" VALUE 0x8007F487 Val_Wu8 255.0 OneToOne 0.00 255.0 FORMAT "%5.1" /end CHARACTERISTIC
/begin CHARACTERISTIC VSwVlv_swtActPosOfs_C "" VALUE 0x8007F5DC Val_Wu8 1.000 OneToOne 0.00 1.000 FORMAT "%5.3" EXTENDED_LIMITS 0.00 255.0 /end CHARACTERISTIC
/begin CHARACTERISTIC VSwVlv_swtGovByp_C "" VALUE 0x8007F54C Val_Wu8 1.000 OneToOne 0.00 1.000 FORMAT "%5.3" EXTENDED_LIMITS 0.00 255.0 /end CHARACTERISTIC
/begin CHARACTERISTIC VSwVlv_swtHwSel_C "" VALUE 0x8007F488 Val_Wu8 255.0 OneToOne 0.00 255.0 FORMAT "%5.1" /end CHARACTERISTIC
/begin CHARACTERISTIC VSwVlv_swtNrmSel_C "" VALUE 0x8007F59E Val_Wu8 255.0 OneToOne 0.00 255.0 FORMAT "%5.1" /end CHARACTERISTIC
/begin CHARACTERISTIC VSwVlv_swtOfsLrnActv_C "" VALUE 0x8007F5DD Val_Wu8 255.0 OneToOne 0.00 255.0 FORMAT "%5.1" /end CHARACTERISTIC
/begin CHARACTERISTIC VSwVlv_swtSensPrs_C "" VALUE 0x8007F59F Val_Wu8 255.0 OneToOne 0.00 255.0 FORMAT "%5.1" /end CHARACTERISTIC
/begin CHARACTERISTIC VSwVlv_tEngMax_C "" VALUE 0x8007F5DE Val_Ws16 250.0000 Temp_Cels -50.14000 199.8600 FORMAT "%8.4" EXTENDED_LIMITS -3549.940 3003.560 /end CHARACTERISTIC
/begin CHARACTERISTIC VSwVlv_tEngMin_C "" VALUE 0x8007F5E0 Val_Ws16 250.0000 Temp_Cels -50.14000 199.8600 FORMAT "%8.4" EXTENDED_LIMITS -3549.940 3003.560 /end CHARACTERISTIC
/begin CHARACTERISTIC VSwVlv_tiAdapJamVlv_C "" VALUE 0x8007F5E2 Val_Ws16 20000.00 Time_ms 0.00 20000.00 FORMAT "%8.2" EXTENDED_LIMITS -327680.0 327670.0 /end CHARACTERISTIC
/begin CHARACTERISTIC VSwVlv_tiAdapPullDwn_C "" VALUE 0x8007F5E4 Val_Ws16 20000.00 Time_ms 0.00 20000.00 FORMAT "%8.2" EXTENDED_LIMITS -327680.0 327670.0 /end CHARACTERISTIC
/begin CHARACTERISTIC VSwVlv_tiAdapPullUp_C "" VALUE 0x8007F5E6 Val_Ws16 20000.00 Time_ms 0.00 20000.00 FORMAT "%8.2" EXTENDED_LIMITS -327680.0 327670.0 /end CHARACTERISTIC
/begin CHARACTERISTIC VSwVlv_tiGovDT1_C "" VALUE 0x8007F550 Val_Ws32 4294.9672940 TimeDelay_s 0.000002000000001 4294.9672960 FORMAT "%12.7" /end CHARACTERISTIC
/begin CHARACTERISTIC VSwVlv_tiOpnJamVlv_C "" VALUE 0x8007F5E8 Val_Ws16 655350.0 Time_ms -327680.0 327670.0 FORMAT "%8.1" /end CHARACTERISTIC
/begin CHARACTERISTIC VSwVlv_tiPT1FacCor_C "" VALUE 0x8007F48C Val_Ws32 4294.9672940 TimeDelay_s 0.000002000000001 4294.9672960 FORMAT "%12.7" /end CHARACTERISTIC
/begin CHARACTERISTIC VSwVlv_tiRepRls_C "" VALUE 0x8007F49C Val_Ws32 36.0000000000 Time_s 0.00 36.0000000000 FORMAT "%13.10" EXTENDED_LIMITS -21474836.4800 21474836.4700 /end CHARACTERISTIC
/begin CHARACTERISTIC VSwVlv_tiRls_C "" VALUE 0x8007F4A0 Val_Ws16 5.000000 Time_s 0.00 5.000000 FORMAT "%8.6" EXTENDED_LIMITS -327.6800 327.6700 /end CHARACTERISTIC
/begin CHARACTERISTIC VSwVlv_tiSlwParDT1_C "" VALUE 0x8007F554 Val_Ws32 4294.9672940 TimeDelay_s 0.000002000000001 4294.9672960 FORMAT "%12.7" /end CHARACTERISTIC
/begin CHARACTERISTIC VSwVlv_TransStg.Dfl_C "/" VALUE 0x8007F5EA Kw_Ws16 100.0000 Prc 0.00 100.0000 FORMAT "%8.4" EXTENDED_LIMITS -400.0000 399.9878 /end CHARACTERISTIC
/begin CHARACTERISTIC VSwVlv_TransStg.stSensId_C "/" VALUE 0x8007F5EC Kw_Wu8 255.0 OneToOne 0.00 255.0 FORMAT "%5.1" /end CHARACTERISTIC
/begin CHARACTERISTIC VSwVlv_uBattMax_C "" VALUE 0x8007F5EE Val_Ws16 28600.00 Volt_Batt 0.00 28600.00 FORMAT "%8.2" EXTENDED_LIMITS -655360.0 655340.0 /end CHARACTERISTIC
/begin CHARACTERISTIC VSwVlv_uBattMin_C "" VALUE 0x8007F5F0 Val_Ws16 28600.00 Volt_Batt 0.00 28600.00 FORMAT "%8.2" EXTENDED_LIMITS -655360.0 655340.0 /end CHARACTERISTIC
/begin CHARACTERISTIC VSwVlv_uRefSens_C "" VALUE 0x8007F5A0 Val_Ws16 13107.00 Volt -6553.600 6553.400 FORMAT "%8.3" /end CHARACTERISTIC
/begin CHARACTERISTIC WaHt_nACEngXHigh_C "oberer Grenzwert für Epm_nEng" VALUE 0x8007F5F4 Kw_Ws16 6000.000 EngN 0.00 6000.000 FORMAT "%8.3" EXTENDED_LIMITS -16384.00 16383.50 /end CHARACTERISTIC
/begin CHARACTERISTIC WaHt_nACEngXLow_C "unterer Grenzwert für Epm_nEng" VALUE 0x8007F5F6 Kw_Ws16 6000.000 EngN 0.00 6000.000 FORMAT "%8.3" EXTENDED_LIMITS -16384.00 16383.50 /end CHARACTERISTIC
/begin CHARACTERISTIC WaHt_nDAEng_C "Motordrehzahlschwelle für Antrieb wegzustand" VALUE 0x8007F5F8 Kw_Ws16 6000.000 EngN 0.00 6000.000 FORMAT "%8.3" EXTENDED_LIMITS -16384.00 16383.50 /end CHARACTERISTIC
/begin CHARACTERISTIC WaHt_nMin_C "Leerlaufanhebung bei Zuheizung" VALUE 0x8007F5FA Kw_Ws16 500.0000 EngN 0.00 500.0000 FORMAT "%8.4" EXTENDED_LIMITS -16384.00 16383.50 /end CHARACTERISTIC
/begin CHARACTERISTIC WaHt_rHtgOutMax_C "Maximal-Tastverhältnis am PI-Regler Ausgang" VALUE 0x8007F5FC Kw_Ws16 100.0000 DtyCyc 0.00 100.0000 FORMAT "%8.4" EXTENDED_LIMITS -327.6800 327.6700 /end CHARACTERISTIC
/begin CHARACTERISTIC WaHt_rHtgOutMin_C "Minimal-Tastverhältnis am PI-Regler Ausgang" VALUE 0x8007F5FE Kw_Ws16 100.0000 DtyCyc 0.00 100.0000 FORMAT "%8.4" EXTENDED_LIMITS -327.6800 327.6700 /end CHARACTERISTIC
/begin CHARACTERISTIC WaHt_swtHtgUp_C "Schalter um den Aufheizstatus des Motors zu ändern (0: berechnen, 1: rücksetzen, 2: setzen des Aufheizstatus)" VALUE 0x8007F600 Kw_Wu8 2.000 OneToOne 0.00 2.000 FORMAT "%5.3" EXTENDED_LIMITS 0.00 255.0 /end CHARACTERISTIC
/begin CHARACTERISTIC WaHt_tEnvHysDelta_C "Delta-Wert für Kühlmitteltemperaturhysterese" VALUE 0x8007F602 Kw_Ws16 100.0000 TempDiff_Cels 0.00 100.0000 FORMAT "%8.4" EXTENDED_LIMITS -32768.00 32767.00 /end CHARACTERISTIC
/begin CHARACTERISTIC WaHt_tEnv_CUR "Umgebungstemperatur Umrechnungskennlinie" CURVE 0x8007F604 Kl_Xs16_Ws16 200.0000 Temp_Cels -50.04000 149.9600 FORMAT "%8.4" EXTENDED_LIMITS -3549.940 3003.560
 /begin AXIS_DESCR STD_AXIS GlbDa_tEnv Temp_Cels 2 -40.04000 134.9600 FORMAT "%8.4" EXTENDED_LIMITS -3549.940 3003.560 DEPOSIT ABSOLUTE /end AXIS_DESCR
/end CHARACTERISTIC
/begin CHARACTERISTIC WaHt_tiACMin_C "Timer für den Beschleunigungs-Fall" VALUE 0x8007F60E Kw_Wu16 60000.00 Time_ms 0.00 60000.00 FORMAT "%8.2" EXTENDED_LIMITS 0.00 655350.0 /end CHARACTERISTIC
/begin CHARACTERISTIC WaHt_tiDAMin_C "Timer im Wegfahr-Fall" VALUE 0x8007F610 Kw_Wu16 60000.00 Time_ms 0.00 60000.00 FORMAT "%8.2" EXTENDED_LIMITS 0.00 655350.0 /end CHARACTERISTIC
/begin CHARACTERISTIC WaHt_tiStrt_C "Startverzoegerung fuer die Heizleistungssteigerung" VALUE 0x8007F612 Kw_Wu16 2000.000 Time_ms 0.00 2000.000 FORMAT "%8.3" EXTENDED_LIMITS 0.00 655350.0 /end CHARACTERISTIC
/begin CHARACTERISTIC WaHt_trqInrLimDelta_C "Delta Torque" VALUE 0x8007F614 Kw_Ws16 1500.000 Trq -500.0000 1000.000 FORMAT "%8.3" EXTENDED_LIMITS -3276.800 3276.700 /end CHARACTERISTIC
/begin CHARACTERISTIC WaHt_vDAVeh_C "Trägergeschwindigkeit Schwelle für Antrieb wegzustand" VALUE 0x8007F616 Kw_Ws16 300.0000 Vel 0.00 300.0000 FORMAT "%8.4" EXTENDED_LIMITS -327.6800 327.6700 /end CHARACTERISTIC
/begin CHARACTERISTIC ZFC_ClbActv.xVal_C "Minimale Batteriespannung für die Nullmengenkalibrierung/" VALUE 0x8006D54A Kw_Wu8 1.000 OneToOne 0.00 1.000 FORMAT "%5.3" EXTENDED_LIMITS 0.00 255.0 /end CHARACTERISTIC
/begin CHARACTERISTIC ZFC_ClbActv.xTyp_C "Minimale Batteriespannung für die Nullmengenkalibrierung/" VALUE 0x8006D54B Kw_Wu8 2.000 OneToOne 0.00 2.000 FORMAT "%5.3" EXTENDED_LIMITS 0.00 255.0 /end CHARACTERISTIC
/begin CHARACTERISTIC ZFC_dBPFacFBCG3_GMAP "" MAP 0x8006D54C MapG_Ws16 60.00000 ZFC_BPfac 0.00 60.00000 FORMAT "%8.5" EXTENDED_LIMITS -60.00183 60.00000
 /begin AXIS_DESCR COM_AXIS Epm_nEng EngN 7 40.00000 6000.000 FORMAT "%8.3" EXTENDED_LIMITS -16384.00 16383.50 AXIS_PTS_REF ZFC_nFBCVal_AXIS /end AXIS_DESCR
 /begin AXIS_DESCR COM_AXIS ZFC_idxFBCElm_mp OneToOne 4 0.00 4.000 FORMAT "%5.3" EXTENDED_LIMITS 0.00 255.0 AXIS_PTS_REF ZFC_idxFBCVal_AXIS /end AXIS_DESCR
/end CHARACTERISTIC
/begin CHARACTERISTIC ZFC_dBPFacFBCG4_GMAP "" MAP 0x8006D584 MapG_Ws16 60.00000 ZFC_BPfac 0.00 60.00000 FORMAT "%8.5" EXTENDED_LIMITS -60.00183 60.00000
 /begin AXIS_DESCR COM_AXIS Epm_nEng EngN 7 40.00000 6000.000 FORMAT "%8.3" EXTENDED_LIMITS -16384.00 16383.50 AXIS_PTS_REF ZFC_nFBCVal_AXIS /end AXIS_DESCR
 /begin AXIS_DESCR COM_AXIS ZFC_idxFBCElm_mp OneToOne 4 0.00 4.000 FORMAT "%5.3" EXTENDED_LIMITS 0.00 255.0 AXIS_PTS_REF ZFC_idxFBCVal_AXIS /end AXIS_DESCR
/end CHARACTERISTIC
/begin CHARACTERISTIC ZFC_dBPFacFBCG5_GMAP "" MAP 0x8006D5BC MapG_Ws16 60.00000 ZFC_BPfac 0.00 60.00000 FORMAT "%8.5" EXTENDED_LIMITS -60.00183 60.00000
 /begin AXIS_DESCR COM_AXIS Epm_nEng EngN 7 40.00000 6000.000 FORMAT "%8.3" EXTENDED_LIMITS -16384.00 16383.50 AXIS_PTS_REF ZFC_nFBCVal_AXIS /end AXIS_DESCR
 /begin AXIS_DESCR COM_AXIS ZFC_idxFBCElm_mp OneToOne 4 0.00 4.000 FORMAT "%5.3" EXTENDED_LIMITS 0.00 255.0 AXIS_PTS_REF ZFC_idxFBCVal_AXIS /end AXIS_DESCR
/end CHARACTERISTIC
/begin CHARACTERISTIC ZFC_dBPFacFBCG6_GMAP "" MAP 0x8006D5F4 MapG_Ws16 60.00000 ZFC_BPfac 0.00 60.00000 FORMAT "%8.5" EXTENDED_LIMITS -60.00183 60.00000
 /begin AXIS_DESCR COM_AXIS Epm_nEng EngN 7 40.00000 6000.000 FORMAT "%8.3" EXTENDED_LIMITS -16384.00 16383.50 AXIS_PTS_REF ZFC_nFBCVal_AXIS /end AXIS_DESCR
 /begin AXIS_DESCR COM_AXIS ZFC_idxFBCElm_mp OneToOne 4 0.00 4.000 FORMAT "%5.3" EXTENDED_LIMITS 0.00 255.0 AXIS_PTS_REF ZFC_idxFBCVal_AXIS /end AXIS_DESCR
/end CHARACTERISTIC
/begin CHARACTERISTIC ZFC_dBPFacFBCG7_GMAP "" MAP 0x8006D62C MapG_Ws16 60.00000 ZFC_BPfac 0.00 60.00000 FORMAT "%8.5" EXTENDED_LIMITS -60.00183 60.00000
 /begin AXIS_DESCR COM_AXIS Epm_nEng EngN 7 40.00000 6000.000 FORMAT "%8.3" EXTENDED_LIMITS -16384.00 16383.50 AXIS_PTS_REF ZFC_nFBCVal_AXIS /end AXIS_DESCR
 /begin AXIS_DESCR COM_AXIS ZFC_idxFBCElm_mp OneToOne 4 0.00 4.000 FORMAT "%5.3" EXTENDED_LIMITS 0.00 255.0 AXIS_PTS_REF ZFC_idxFBCVal_AXIS /end AXIS_DESCR
/end CHARACTERISTIC
/begin CHARACTERISTIC ZFC_dSegFBCCaSG3_GMAP "" MAP 0x8006D664 MapG_Ws16 255.9922 ZFC_PerHalfRatio 0.00 255.9922 FORMAT "%8.4" EXTENDED_LIMITS -256.0000 255.9922
 /begin AXIS_DESCR COM_AXIS Epm_nEng EngN 7 40.00000 6000.000 FORMAT "%8.3" EXTENDED_LIMITS -16384.00 16383.50 AXIS_PTS_REF ZFC_nFBCVal_AXIS /end AXIS_DESCR
 /begin AXIS_DESCR COM_AXIS ZFC_idxFBCElm_mp OneToOne 4 0.00 4.000 FORMAT "%5.3" EXTENDED_LIMITS 0.00 255.0 AXIS_PTS_REF ZFC_idxFBCVal_AXIS /end AXIS_DESCR
/end CHARACTERISTIC
/begin CHARACTERISTIC ZFC_dSegFBCCaSG4_GMAP "" MAP 0x8006D69C MapG_Ws16 255.9922 ZFC_PerHalfRatio 0.00 255.9922 FORMAT "%8.4" EXTENDED_LIMITS -256.0000 255.9922
 /begin AXIS_DESCR COM_AXIS Epm_nEng EngN 7 40.00000 6000.000 FORMAT "%8.3" EXTENDED_LIMITS -16384.00 16383.50 AXIS_PTS_REF ZFC_nFBCVal_AXIS /end AXIS_DESCR
 /begin AXIS_DESCR COM_AXIS ZFC_idxFBCElm_mp OneToOne 4 0.00 4.000 FORMAT "%5.3" EXTENDED_LIMITS 0.00 255.0 AXIS_PTS_REF ZFC_idxFBCVal_AXIS /end AXIS_DESCR
/end CHARACTERISTIC
/begin CHARACTERISTIC ZFC_dSegFBCCaSG5_GMAP "" MAP 0x8006D6D4 MapG_Ws16 255.9922 ZFC_PerHalfRatio 0.00 255.9922 FORMAT "%8.4" EXTENDED_LIMITS -256.0000 255.9922
 /begin AXIS_DESCR COM_AXIS Epm_nEng EngN 7 40.00000 6000.000 FORMAT "%8.3" EXTENDED_LIMITS -16384.00 16383.50 AXIS_PTS_REF ZFC_nFBCVal_AXIS /end AXIS_DESCR
 /begin AXIS_DESCR COM_AXIS ZFC_idxFBCElm_mp OneToOne 4 0.00 4.000 FORMAT "%5.3" EXTENDED_LIMITS 0.00 255.0 AXIS_PTS_REF ZFC_idxFBCVal_AXIS /end AXIS_DESCR
/end CHARACTERISTIC
/begin CHARACTERISTIC ZFC_dSegFBCCaSG6_GMAP "" MAP 0x8006D70C MapG_Ws16 255.9922 ZFC_PerHalfRatio 0.00 255.9922 FORMAT "%8.4" EXTENDED_LIMITS -256.0000 255.9922
 /begin AXIS_DESCR COM_AXIS Epm_nEng EngN 7 40.00000 6000.000 FORMAT "%8.3" EXTENDED_LIMITS -16384.00 16383.50 AXIS_PTS_REF ZFC_nFBCVal_AXIS /end AXIS_DESCR
 /begin AXIS_DESCR COM_AXIS ZFC_idxFBCElm_mp OneToOne 4 0.00 4.000 FORMAT "%5.3" EXTENDED_LIMITS 0.00 255.0 AXIS_PTS_REF ZFC_idxFBCVal_AXIS /end AXIS_DESCR
/end CHARACTERISTIC
/begin CHARACTERISTIC ZFC_dSegFBCCaSG7_GMAP "" MAP 0x8006D744 MapG_Ws16 255.9922 ZFC_PerHalfRatio 0.00 255.9922 FORMAT "%8.4" EXTENDED_LIMITS -256.0000 255.9922
 /begin AXIS_DESCR COM_AXIS Epm_nEng EngN 7 40.00000 6000.000 FORMAT "%8.3" EXTENDED_LIMITS -16384.00 16383.50 AXIS_PTS_REF ZFC_nFBCVal_AXIS /end AXIS_DESCR
 /begin AXIS_DESCR COM_AXIS ZFC_idxFBCElm_mp OneToOne 4 0.00 4.000 FORMAT "%5.3" EXTENDED_LIMITS 0.00 255.0 AXIS_PTS_REF ZFC_idxFBCVal_AXIS /end AXIS_DESCR
/end CHARACTERISTIC
/begin CHARACTERISTIC ZFC_idxFBCElm_C "" VALUE 0x8006D77C Val_Wu8 4.000 OneToOne 0.00 4.000 FORMAT "%5.3" EXTENDED_LIMITS 0.00 255.0 /end CHARACTERISTIC
/begin AXIS_PTS ZFC_idxFBCVal_AXIS "" 0x8006D77D ZFC_idxFBCElm_mp Axis_Xu8 4.000 OneToOne 4 0.00 4.000 FORMAT "%5.3" EXTENDED_LIMITS 0.00 255.0 DEPOSIT ABSOLUTE /end AXIS_PTS
/begin CHARACTERISTIC ZFC_nAvrgMax_C "Maximale Drehzahl für die Nullmengenkalibrierung" VALUE 0x8006D782 Val_Ws16 5960.000 EngN 40.00000 6000.000 FORMAT "%8.3" EXTENDED_LIMITS -16384.00 16383.50 /end CHARACTERISTIC
/begin CHARACTERISTIC ZFC_nAvrgMin_C "Minimale Drehzahl für die Nullmengenkalibrierung" VALUE 0x8006D784 Val_Ws16 5960.000 EngN 40.00000 6000.000 FORMAT "%8.3" EXTENDED_LIMITS -16384.00 16383.50 /end CHARACTERISTIC
/begin CHARACTERISTIC ZFC_nChngPRailMax_C "Maximale Drehzahl für die eine Raildruckanforderung der Nullmengenkalibrierung erfolgt" VALUE 0x8006D786 Val_Ws16 5960.000 EngN 40.00000 6000.000 FORMAT "%8.3" EXTENDED_LIMITS -16384.00 16383.50 /end CHARACTERISTIC
/begin CHARACTERISTIC ZFC_nFBCThresMax_C "Minimale Batteriespannung für die Nullmengenkalibrierung" VALUE 0x8006D788 Val_Ws16 5960.000 EngN 40.00000 6000.000 FORMAT "%8.3" EXTENDED_LIMITS -16384.00 16383.50 /end CHARACTERISTIC
/begin AXIS_PTS ZFC_nFBCVal_AXIS "" 0x8006D78A Epm_nEng Axis_Xs16 5960.000 EngN 7 40.00000 6000.000 FORMAT "%8.3" EXTENDED_LIMITS -16384.00 16383.50 DEPOSIT ABSOLUTE /end AXIS_PTS
/begin CHARACTERISTIC ZFC_nHyst_C "Hysteresewert Drehzahl für die Nullmengenkalibrierung" VALUE 0x8006D79A Val_Ws16 5960.000 EngN 40.00000 6000.000 FORMAT "%8.3" EXTENDED_LIMITS -16384.00 16383.50 /end CHARACTERISTIC
/begin CHARACTERISTIC ZFC_pACMax_C "Minimale Batteriespannung für die Nullmengenkalibrierung" VALUE 0x8006D79C Val_Ws16 1000.000 PresAC_hPa 0.00 1000.000 FORMAT "%8.3" EXTENDED_LIMITS -65536.00 65534.00 /end CHARACTERISTIC
/begin CHARACTERISTIC ZFC_pBstMin_C "" VALUE 0x8006D79E Val_Ws16 3500.000 Pres_hPa 0.00 3500.000 FORMAT "%8.3" EXTENDED_LIMITS -32768.00 32767.00 /end CHARACTERISTIC
/begin CHARACTERISTIC ZFC_phiSet_CUR "Ansteuerbeginn für Einspritzung der Nullmengenkalibrierung" CURVE 0x8006D7BA Cur_Xs16Ws16 1440.000 AngleCrS -720.0000 720.0000 FORMAT "%8.4" EXTENDED_LIMITS -720.0220 720.0000
 /begin AXIS_DESCR STD_AXIS Epm_nEng EngN 16 40.00000 6000.000 FORMAT "%8.3" EXTENDED_LIMITS -16384.00 16383.50 DEPOSIT ABSOLUTE /end AXIS_DESCR
/end CHARACTERISTIC
/begin CHARACTERISTIC ZFC_rAccPedMax_C "" VALUE 0x8006D7A0 Val_Ws16 799.9878 Prc -400.0000 399.9878 FORMAT "%8.4" /end CHARACTERISTIC
/begin CHARACTERISTIC ZFC_stACSel_C "Minimale Batteriespannung für die Nullmengenkalibrierung" VALUE 0x8006D7A2 Val_Wu8 255.0 OneToOne 0.00 255.0 FORMAT "%5.1" /end CHARACTERISTIC
/begin CHARACTERISTIC ZFC_stClthSel_C "Bitmaske zur Freigabe des Kupplungssignals für die Kalibrierung" VALUE 0x8006D7A3 Val_Wu8 255.0 OneToOne 0.00 255.0 FORMAT "%5.1" /end CHARACTERISTIC
/begin CHARACTERISTIC ZFC_stGearRls_CA "Gangabhängige Freigabe der ZFC Kalibrierung" VAL_BLK 0x8006D7A4 ValA_Wu8 1.000 OneToOne 0.00 1.000 FORMAT "%5.3" EXTENDED_LIMITS 0.00 255.0 NUMBER 7 /end CHARACTERISTIC
/begin CHARACTERISTIC ZFC_tAirThres_C "Minimale Ansauglufttemperatur für die Nullmengenkalibrierung" VALUE 0x8006D7AC Val_Ws16 250.0000 Temp_Cels -50.14000 199.8600 FORMAT "%8.4" EXTENDED_LIMITS -3549.940 3003.560 /end CHARACTERISTIC
/begin CHARACTERISTIC ZFC_tEngThres_C "Minimale Motortemperatur für die Nullmengenkalibrierung" VALUE 0x8006D7AE Val_Ws16 250.0000 Temp_Cels -50.14000 199.8600 FORMAT "%8.4" EXTENDED_LIMITS -3549.940 3003.560 /end CHARACTERISTIC
/begin CHARACTERISTIC ZFC_tFuelThresMax_C "Maximale Kraftstofftemperatur für die Nullmengenkalibrierung" VALUE 0x8006D7B0 Val_Ws16 200.0000 Temp_Cels -50.14000 149.8600 FORMAT "%8.4" EXTENDED_LIMITS -3549.940 3003.560 /end CHARACTERISTIC
/begin CHARACTERISTIC ZFC_tFuelThresMin_C "Minimale Kraftstofftemperatur für die Nullmengenkalibrierung" VALUE 0x8006D7B2 Val_Ws16 200.0000 Temp_Cels -50.14000 149.8600 FORMAT "%8.4" EXTENDED_LIMITS -3549.940 3003.560 /end CHARACTERISTIC
/begin CHARACTERISTIC ZFC_tiCldCham_CUR "Zeit bis der Brennraum für die Nullmengenkalibrierung zu stark abgekühlt ist" CURVE 0x8006D516 Cur_Xs16Ws16 327670.0 Time_ms 0.00 327670.0 FORMAT "%8.1" EXTENDED_LIMITS -327680.0 327670.0
 /begin AXIS_DESCR STD_AXIS CACDsT_t Temp_Cels 12 -50.14000 199.8600 FORMAT "%8.4" EXTENDED_LIMITS -3549.940 3003.560 DEPOSIT ABSOLUTE /end AXIS_DESCR
/end CHARACTERISTIC
/begin CHARACTERISTIC ZFC_tiDelOvrRun_C "Verzögerung nach dem Einsetzen der Schubphase für die Nullmengenkalibrierung" VALUE 0x8006D7B4 Val_Ws16 327670.0 Time_ms 0.00 327670.0 FORMAT "%8.1" EXTENDED_LIMITS -327680.0 327670.0 /end CHARACTERISTIC
/begin CHARACTERISTIC ZFC_tiDelpRailLim_C "Verzögerung zum Einschwingen des Raildrucks für die Nullmengenkalibrierung" VALUE 0x8006D7B6 Val_Ws16 327670.0 Time_ms 0.00 327670.0 FORMAT "%8.1" EXTENDED_LIMITS -327680.0 327670.0 /end CHARACTERISTIC
/begin CHARACTERISTIC ZFC_tiHotCham_C "Zeit bis der Brennraum warm genug für die Nullmengenkalibrierung ist" VALUE 0x8006D548 Val_Ws16 327670.0 Time_ms 0.00 327670.0 FORMAT "%8.1" EXTENDED_LIMITS -327680.0 327670.0 /end CHARACTERISTIC
/begin CHARACTERISTIC ZFC_uBattMin_C "Minimale Batteriespannung für die Nullmengenkalibrierung" VALUE 0x8006D7B8 Val_Ws16 655340.0 Volt_Batt 0.00 655340.0 FORMAT "%8.1" EXTENDED_LIMITS -655360.0 655340.0 /end CHARACTERISTIC
/begin MEASUREMENT AltIO_trqDes "" SWORD default 1 100 -32768.00 32767.00 FORMAT "%8.2" ECU_ADDRESS 0xD0006BF0 /end MEASUREMENT
/begin MEASUREMENT CoPT_nMaxEng "" SWORD default 1 100 -32768.00 32767.00 FORMAT "%8.2" ECU_ADDRESS 0xD0006C86 /end MEASUREMENT
/begin MEASUREMENT CoPT_nMinEng "" SWORD default 1 100 -32768.00 32767.00 FORMAT "%8.2" ECU_ADDRESS 0xD0006C8E /end MEASUREMENT
/begin MEASUREMENT DiffIO_rTrqDfftl "" SWORD TransR 1 100 -327.6800 327.6700 FORMAT "%8.4" ECU_ADDRESS 0xD0006D86 /end MEASUREMENT
/begin MEASUREMENT DiffIO_stCfg "" UBYTE OneToOne 1 100 0.00 255.0 FORMAT "%5.1" ECU_ADDRESS 0xD0008FD0 /end MEASUREMENT
/begin MEASUREMENT DiffIO_trqPrtDfftl "" SLONG TrqPrpHigh 1 100 -214748364.800 214748364.700 FORMAT "%13.3" ECU_ADDRESS 0xD0004304 /end MEASUREMENT
/begin MEASUREMENT EngPrt_nMax "" SWORD EngN 1 100 -16384.00 16383.50 FORMAT "%8.2" ECU_ADDRESS 0xD0006E3A /end MEASUREMENT
/begin MEASUREMENT ETCtl_tiPoI2Cor "" SWORD InjTime_us 1 100 -13107.20 5000.00 FORMAT "%8.2" ECU_ADDRESS 0xD0006E1A /end MEASUREMENT
/begin MEASUREMENT Exh_stEgtTOxiCatUs_mp "" UBYTE OneToOne 1 100 0.00 255.0 FORMAT "%5.1" ECU_ADDRESS 0xC0001A7D /end MEASUREMENT
/begin MEASUREMENT Exh_stTmrPlausTOxiCatUs_mp "" UBYTE OneToOne 1 100 0.00 255.0 FORMAT "%5.1" ECU_ADDRESS 0xC0001A7E /end MEASUREMENT
/begin MEASUREMENT Exh_tAdapTOxiCatUs "" SWORD Temp_Cels 1 100 -3549.940 3003.560 FORMAT "%8.3" ECU_ADDRESS 0xD0006EC2 /end MEASUREMENT
/begin MEASUREMENT Exh_tAdapTPFltUs "" SWORD Temp_Cels 1 100 -3549.940 3003.560 FORMAT "%8.3" ECU_ADDRESS 0xD0006EC4 /end MEASUREMENT
/begin MEASUREMENT Exh_tDiffNegTOxiCatUs_mp "" SWORD TempDiff_Kelv 1 100 -3276.800 3276.700 FORMAT "%8.3" ECU_ADDRESS 0xC0001A80 /end MEASUREMENT
/begin MEASUREMENT Exh_tDiffNegTPFltUs_mp "" SWORD TempDiff_Kelv 1 100 -3276.800 3276.700 FORMAT "%8.3" ECU_ADDRESS 0xC0001A86 /end MEASUREMENT
/begin MEASUREMENT Exh_tDiffPosTOxiCatUs_mp "" SWORD TempDiff_Kelv 1 100 -3276.800 3276.700 FORMAT "%8.3" ECU_ADDRESS 0xC0001A82 /end MEASUREMENT
/begin MEASUREMENT Exh_tDiffPosTPFltUs_mp "" SWORD TempDiff_Kelv 1 100 -3276.800 3276.700 FORMAT "%8.3" ECU_ADDRESS 0xC0001A88 /end MEASUREMENT
/begin MEASUREMENT Exh_tDiffTPFltUs_mp "" SWORD TempDiff_Kelv 1 100 -3276.800 3276.700 FORMAT "%8.3" ECU_ADDRESS 0xC0001A8A /end MEASUREMENT
/begin MEASUREMENT Exh_tEGFldTPFltUs_mp "" SWORD Temp_Cels 1 100 -3549.940 3003.560 FORMAT "%8.3" ECU_ADDRESS 0xC0001A8C /end MEASUREMENT
/begin MEASUREMENT Exh_tModTOxiCatUs_mp "" SWORD Temp_Cels 1 100 -3549.940 3003.560 FORMAT "%8.3" ECU_ADDRESS 0xC0001A84 /end MEASUREMENT
/begin MEASUREMENT Exh_tOxiCatUs "" SWORD Temp_Cels 1 100 -3549.940 3003.560 FORMAT "%8.3" ECU_ADDRESS 0xD0006ED8 /end MEASUREMENT
/begin MEASUREMENT Exh_tPFltUs "" SWORD Temp_Cels 1 100 -3549.940 3003.560 FORMAT "%8.3" ECU_ADDRESS 0xD0006EDA /end MEASUREMENT
/begin MEASUREMENT Exh_tSensTPFltUs "" SWORD Temp_Cels 1 100 -3549.940 3003.560 FORMAT "%8.3" ECU_ADDRESS 0xD0006EE2 /end MEASUREMENT
/begin MEASUREMENT Exh_uRawTPFltUs "" SWORD Volt 1 100 -6553.600 6553.400 FORMAT "%8.3" ECU_ADDRESS 0xD0006EE8 /end MEASUREMENT
/begin MEASUREMENT LiGov_nStat "" SWORD EngN 1 100 -16384.00 16383.50 FORMAT "%8.2" ECU_ADDRESS 0xD0007376 /end MEASUREMENT
/begin MEASUREMENT PFltRgn_st "" ULONG OneToOne 1 100 0.00 4294967295.00 FORMAT "%13.2" ECU_ADDRESS 0xD00045C0 /end MEASUREMENT
/begin MEASUREMENT PT_numTraGear "" UBYTE OneToOne 1 100 0.00 255.0 FORMAT "%5.1" ECU_ADDRESS 0xD0009131 /end MEASUREMENT
/begin MEASUREMENT PT_numTraGearDes "" UBYTE OneToOne 1 100 0.00 255.0 FORMAT "%5.1" ECU_ADDRESS 0xD0009132 /end MEASUREMENT
/begin MEASUREMENT PT_numTraParGear "" UBYTE OneToOne 1 100 0.00 255.0 FORMAT "%5.1" ECU_ADDRESS 0xD0009133 /end MEASUREMENT
/begin MEASUREMENT PT_rTraGear "" SWORD TransR 1 100 -327.6800 327.6700 FORMAT "%8.4" ECU_ADDRESS 0xD0007460 /end MEASUREMENT
/begin MEASUREMENT PT_rTraGearDes "" SWORD TransR 1 100 -327.6800 327.6700 FORMAT "%8.4" ECU_ADDRESS 0xD0007462 /end MEASUREMENT
/begin MEASUREMENT PT_rTraV2N "" SWORD VelToN 1 100 -0.3276800 0.3276700 FORMAT "%9.7" ECU_ADDRESS 0xD0007464 /end MEASUREMENT
/begin MEASUREMENT PT_stTraGrip "Kraftschlusszustand Getriebe" UBYTE OneToOne 1 100 0.00 255.0 FORMAT "%5.1" ECU_ADDRESS 0xD0009139 /end MEASUREMENT
/begin MEASUREMENT PT_stTraLoRng "" UBYTE OneToOne 1 100 0.00 255.0 FORMAT "%5.1" ECU_ADDRESS 0xD000913B /end MEASUREMENT
/begin MEASUREMENT PT_stTraRevGear "" UBYTE OneToOne 1 100 0.00 255.0 FORMAT "%5.1" ECU_ADDRESS 0xD000913C /end MEASUREMENT
/begin MEASUREMENT PT_stTraShftOp "" UBYTE OneToOne 1 100 0.00 255.0 FORMAT "%5.1" ECU_ADDRESS 0xD000913D /end MEASUREMENT
/begin MEASUREMENT PT_stTraType "Aktueller Getriebetyp" UBYTE OneToOne 1 100 0.00 255.0 FORMAT "%5.1" ECU_ADDRESS 0xD000913E /end MEASUREMENT
/begin MEASUREMENT PT_trqTraPrt "Maximaler Momentenwert für Getriebeschutz" SWORD Trq 1 100 -3276.800 3276.700 FORMAT "%8.3" ECU_ADDRESS 0xD000746E /end MEASUREMENT
/begin MEASUREMENT SIIO_stDCSIntv "" SLONG OneToOne 1 100 -2147483648.00 2147483647.00 FORMAT "%13.2" ECU_ADDRESS 0xD00043A4 /end MEASUREMENT
/begin MEASUREMENT SIIO_stTCSIntv "" SLONG OneToOne 1 100 -2147483648.00 2147483647.00 FORMAT "%13.2" ECU_ADDRESS 0xD00043A8 /end MEASUREMENT
/begin MEASUREMENT SIIO_trqDesDCS "" SLONG TrqPrpHigh 1 100 -214748364.800 214748364.700 FORMAT "%13.3" ECU_ADDRESS 0xD00043AC /end MEASUREMENT
/begin MEASUREMENT SIIO_trqDesTCS "" SLONG TrqPrpHigh 1 100 -214748364.800 214748364.700 FORMAT "%13.3" ECU_ADDRESS 0xD00043B0 /end MEASUREMENT
/begin MEASUREMENT SIIO_trqLeadTCS "" SLONG TrqPrpHigh 1 100 -214748364.800 214748364.700 FORMAT "%13.3" ECU_ADDRESS 0xD00043B4 /end MEASUREMENT
/begin MEASUREMENT SSEUI_stStopStrtSwt "" UBYTE OneToOne 1 100 0.00 255.0 FORMAT "%5.1" ECU_ADDRESS 0xD0009155 /end MEASUREMENT
/begin MEASUREMENT StbIntv_bDCSIntv "Freigabe für Momentenanforderungen aus der Schleppmomentenregelung (MSR)" UBYTE OneToOne 1 100 0.00 255.0 FORMAT "%5.1" ECU_ADDRESS 0xD000916B /end MEASUREMENT
/begin MEASUREMENT StbIntv_bDCSNeutr "Neutralwert für Momentenanforderungen aus der Schleppmomentenregelung (MSR) empfangen" UBYTE OneToOne 1 100 0.00 255.0 FORMAT "%5.1" ECU_ADDRESS 0xD000916C /end MEASUREMENT
/begin MEASUREMENT StbIntv_bTCSIntv "Freigabe für Antischlupfregelungsmomente (ASR)" UBYTE OneToOne 1 100 0.00 255.0 FORMAT "%5.1" ECU_ADDRESS 0xD000916D /end MEASUREMENT
/begin MEASUREMENT StbIntv_bTCSNeutr "Neutralwert für Antischlupfregelungsmomente (ASR) empfangen" UBYTE OneToOne 1 100 0.00 255.0 FORMAT "%5.1" ECU_ADDRESS 0xD000916E /end MEASUREMENT
/begin MEASUREMENT StbIntv_trqDCSDes "MSR Eingriffsmoment (Radmoment)" SLONG TrqPrpHigh 1 100 -214748364.800 214748364.700 FORMAT "%13.3" ECU_ADDRESS 0xD00043B8 /end MEASUREMENT
/begin MEASUREMENT StbIntv_trqTCSDes "ASR Solleingriffsmoment (Radmoment)" SLONG TrqPrpHigh 1 100 -214748364.800 214748364.700 FORMAT "%13.3" ECU_ADDRESS 0xD00043BC /end MEASUREMENT
/begin MEASUREMENT StbIntv_trqTCSLead "ASR Vorhaltmomenteneingriff (Radmoment)" SLONG TrqPrpHigh 1 100 -214748364.800 214748364.700 FORMAT "%13.3" ECU_ADDRESS 0xD00043C0 /end MEASUREMENT
/begin MEASUREMENT Tra_dtrqLimUp_mp "" SLONG RmpTrq 1 100 -3276800.00000 3276799.99847 FORMAT "%13.5" ECU_ADDRESS 0xC0001A98 /end MEASUREMENT
/begin MEASUREMENT Tra_nASTDes "Synchronisationsdrehzahl" SWORD EngN 1 100 -16384.00 16383.50 FORMAT "%8.2" ECU_ADDRESS 0xD000757E /end MEASUREMENT
/begin MEASUREMENT Tra_nMax "Maximaldrehzahl für Getriebe" SWORD EngN 1 100 -16384.00 16383.50 FORMAT "%8.2" ECU_ADDRESS 0xD0007580 /end MEASUREMENT
/begin MEASUREMENT Tra_nMin "Minimaldrehzahl für Getriebe" SWORD EngN 1 100 -16384.00 16383.50 FORMAT "%8.2" ECU_ADDRESS 0xD0007582 /end MEASUREMENT
/begin MEASUREMENT Tra_numDflGear_mp "" UBYTE OneToOne 1 100 0.00 255.0 FORMAT "%5.1" ECU_ADDRESS 0xC0001A8E /end MEASUREMENT
/begin MEASUREMENT Tra_numOldGear "" UBYTE OneToOne 1 100 0.00 255.0 FORMAT "%5.1" ECU_ADDRESS 0xD0009185 /end MEASUREMENT
/begin MEASUREMENT Tra_numOldParGear "" UBYTE OneToOne 1 100 0.00 255.0 FORMAT "%5.1" ECU_ADDRESS 0xD0009186 /end MEASUREMENT
/begin MEASUREMENT Tra_rClgDem "Relative Lüfterkühlleistung" SWORD Prc 1 100 -400.0000 399.9878 FORMAT "%8.4" ECU_ADDRESS 0xD0007584 /end MEASUREMENT
/begin MEASUREMENT Tra_rV2NLoRng_mp "" SWORD VelToN 1 100 -0.3276800 0.3276700 FORMAT "%9.7" ECU_ADDRESS 0xC0001A90 /end MEASUREMENT
/begin MEASUREMENT Tra_stAST "Status Synchronisationsdrehzahleingriff" UBYTE OneToOne 1 100 0.00 255.0 FORMAT "%5.1" ECU_ADDRESS 0xD0009187 /end MEASUREMENT
/begin MEASUREMENT Tra_stDrvAway_mp "" UBYTE OneToOne 1 100 0.00 255.0 FORMAT "%5.1" ECU_ADDRESS 0xC0001A9C /end MEASUREMENT
/begin MEASUREMENT Tra_stNSetP "Zustand für aktuelle Solldrehzahl-Anforderung" UBYTE OneToOne 1 100 0.00 255.0 FORMAT "%5.1" ECU_ADDRESS 0xD0009188 /end MEASUREMENT
/begin MEASUREMENT Tra_stStopEna "" UBYTE OneToOne 1 100 0.00 255.0 FORMAT "%5.1" ECU_ADDRESS 0xD0009189 /end MEASUREMENT
/begin MEASUREMENT Tra_stStrtEna "" UBYTE OneToOne 1 100 0.00 255.0 FORMAT "%5.1" ECU_ADDRESS 0xD000918A /end MEASUREMENT
/begin MEASUREMENT Tra_stTSCPtd "Eingriff zugelassen (für Monitoring)" UBYTE OneToOne 1 100 0.00 255.0 FORMAT "%5.1" ECU_ADDRESS 0xD000918B /end MEASUREMENT
/begin MEASUREMENT Tra_swtSlctGearInfoCan_mp "" UBYTE OneToOne 1 100 0.00 255.0 FORMAT "%5.1" ECU_ADDRESS 0xC0001A92 /end MEASUREMENT
/begin MEASUREMENT Tra_tClntDes "Kühlmitteltemperatur-Sollwert" SWORD Temp_Cels 1 100 -3549.940 3003.560 FORMAT "%8.3" ECU_ADDRESS 0xD0007586 /end MEASUREMENT
/begin MEASUREMENT Tra_tiASTDes "Synchronisationszeit" SWORD Time_s 1 100 -327.6800 327.6700 FORMAT "%8.4" ECU_ADDRESS 0xD000758A /end MEASUREMENT
/begin MEASUREMENT Tra_tOil "Getriebeöltemperatur" SWORD Temp_Cels 1 100 -3549.940 3003.560 FORMAT "%8.3" ECU_ADDRESS 0xD0007588 /end MEASUREMENT
/begin MEASUREMENT Tra_trqDecDem_mp "Aktueller Momentenwert (Messpunkt)" SWORD Trq 1 100 -3276.800 3276.700 FORMAT "%8.3" ECU_ADDRESS 0xC0001AA4 /end MEASUREMENT
/begin MEASUREMENT Tra_trqDesMax "Maximaler geforderter Momentenwert(erniedrigender Eingriff)" SWORD Trq 1 100 -3276.800 3276.700 FORMAT "%8.3" ECU_ADDRESS 0xD000758C /end MEASUREMENT
/begin MEASUREMENT Tra_trqDesMin "Minimaler geforderter Momentenwert(erhöhender Eingriff)" SWORD Trq 1 100 -3276.800 3276.700 FORMAT "%8.3" ECU_ADDRESS 0xD000758E /end MEASUREMENT
/begin MEASUREMENT Tra_trqIncDem_mp "Aktueller Momentenwert (Messpunkt)" SWORD Trq 1 100 -3276.800 3276.700 FORMAT "%8.3" ECU_ADDRESS 0xC0001AA6 /end MEASUREMENT
/begin MEASUREMENT Tra_trqLeadMax "Maximaler geforderter Momentenwert(erniedrigender Eingriff)" SWORD Trq 1 100 -3276.800 3276.700 FORMAT "%8.3" ECU_ADDRESS 0xD0007590 /end MEASUREMENT
/begin MEASUREMENT Tra_trqLeadMin "Minimaler geforderter Momentenwert(erhöhender Eingriff)" SWORD Trq 1 100 -3276.800 3276.700 FORMAT "%8.3" ECU_ADDRESS 0xD0007592 /end MEASUREMENT
/begin MEASUREMENT Tra_trqLimDrvAway_mp "" SWORD Trq 1 100 -3276.800 3276.700 FORMAT "%8.3" ECU_ADDRESS 0xC0001A9E /end MEASUREMENT
/begin MEASUREMENT Tra_trqLimRampIn_mp "" SWORD Trq 1 100 -3276.800 3276.700 FORMAT "%8.3" ECU_ADDRESS 0xC0001AA0 /end MEASUREMENT
/begin MEASUREMENT Tra_trqLos "Getriebeverlustmoment" SWORD Trq 1 100 -3276.800 3276.700 FORMAT "%8.3" ECU_ADDRESS 0xD0007594 /end MEASUREMENT
/begin MEASUREMENT Tra_trqMaxCur_mp "" SWORD Trq 1 100 -3276.800 3276.700 FORMAT "%8.3" ECU_ADDRESS 0xC0001AA2 /end MEASUREMENT
/begin MEASUREMENT Tra_trqPrtGear_mp "Messpunkt Momentenwert Gang-Pfad" SWORD Trq 1 100 -3276.800 3276.700 FORMAT "%8.3" ECU_ADDRESS 0xC0001A94 /end MEASUREMENT
/begin MEASUREMENT Tra_trqPrtKnall_mp "Messpunkt Momentenwert Knallstart-Pfad" SWORD Trq 1 100 -3276.800 3276.700 FORMAT "%8.3" ECU_ADDRESS 0xC0001A96 /end MEASUREMENT
/begin MEASUREMENT TrbChLP_r "" SWORD Prc 1 100 -400.0000 399.9878 FORMAT "%8.4" ECU_ADDRESS 0xD0007596 /end MEASUREMENT
/begin MEASUREMENT TrbChLP_rPs "" SWORD DtyCyc 1 100 -327.6800 327.6700 FORMAT "%8.4" ECU_ADDRESS 0xD000759C /end MEASUREMENT
/begin MEASUREMENT TrbCh_r "" SWORD Prc 1 100 -400.0000 399.9878 FORMAT "%8.4" ECU_ADDRESS 0xD000759E /end MEASUREMENT
/begin MEASUREMENT TrbCh_rPs "" SWORD DtyCyc 1 100 -327.6800 327.6700 FORMAT "%8.4" ECU_ADDRESS 0xD00075A8 /end MEASUREMENT
/begin MEASUREMENT TrbCh_rRaw "" SWORD DtyCyc 1 100 -327.6800 327.6700 FORMAT "%8.4" ECU_ADDRESS 0xD00075AA /end MEASUREMENT
/begin MEASUREMENT TrbCh_rSens "" SWORD Prc 1 100 -400.0000 399.9878 FORMAT "%8.4" ECU_ADDRESS 0xD00075AC /end MEASUREMENT
/begin MEASUREMENT TrbCh_stActrErr "" UWORD OneToOne 1 100 0.00 65535.00 FORMAT "%8.2" ECU_ADDRESS 0xD0007698 /end MEASUREMENT
/begin MEASUREMENT TrbCh_stErrMsg_mp "" UBYTE OneToOne 1 100 0.00 255.0 FORMAT "%5.1" ECU_ADDRESS 0xC0001AA8 /end MEASUREMENT
/begin MEASUREMENT TSDa_tClntIniVal "erste gültige Wert der Kühlmitteltemperatur am Motoraustritt" SWORD Temp_Cels 1 100 -3549.940 3003.560 FORMAT "%8.3" ECU_ADDRESS 0xD0007558 /end MEASUREMENT
/begin MEASUREMENT TSDa_tClntRadOut "Kühlmitteltemperatur am Kühleraustritt" SWORD Temp_Cels 1 100 -3549.940 3003.560 FORMAT "%8.3" ECU_ADDRESS 0xD000755A /end MEASUREMENT
/begin MEASUREMENT TS_tClntEngIn "" SWORD Temp_Cels 1 100 -3549.940 3003.560 FORMAT "%8.3" ECU_ADDRESS 0xD0007562 /end MEASUREMENT
/begin MEASUREMENT TS_tClntEngOut "Kühlmitteltemperatur am Motoraustritt" SWORD Temp_Cels 1 100 -3549.940 3003.560 FORMAT "%8.3" ECU_ADDRESS 0xD0007564 /end MEASUREMENT
/begin MEASUREMENT TS_tClntIniVal "" SWORD default 1 100 -32768.00 32767.00 FORMAT "%8.2" ECU_ADDRESS 0xD0007566 /end MEASUREMENT
/begin MEASUREMENT VehMot_a2trq "Umrechnungsfaktor Beschleunigung in Vortriebsmoment" SWORD MassLength 1 100 -6553.600 6553.400 FORMAT "%8.3" ECU_ADDRESS 0xD00075E0 /end MEASUREMENT
/begin MEASUREMENT VehMot_aPrpCurr "Momentane, geschätzte Beschleunigung" SWORD Acc 1 100 -32.76800 32.76700 FORMAT "%8.5" ECU_ADDRESS 0xD00075E2 /end MEASUREMENT
/begin MEASUREMENT VehMot_aPrpMax "Maximal mögliche Beschleunigung im momentanen Gang" SWORD Acc 1 100 -32.76800 32.76700 FORMAT "%8.5" ECU_ADDRESS 0xD00075E4 /end MEASUREMENT
/begin MEASUREMENT VehMot_aPrpMin "Minimal mögliche Beschleunigung im momentanen Gang" SWORD Acc 1 100 -32.76800 32.76700 FORMAT "%8.5" ECU_ADDRESS 0xD00075E6 /end MEASUREMENT
/begin MEASUREMENT VehMot_tiTrqDragPT1 "Zeitkonstante für Filterung geschätzten Fahrwiderstand" SWORD Time_s_1 1 100 -32.76800 32.76700 FORMAT "%8.5" ECU_ADDRESS 0xD0007F6C /end MEASUREMENT
/begin MEASUREMENT VehMot_trqDrag "Gesamter Fahrwiderstand" SLONG TrqPrpHigh 1 100 -214748364.800 214748364.700 FORMAT "%13.3" ECU_ADDRESS 0xD00043EC /end MEASUREMENT
/begin MEASUREMENT VehMot_trqDragEst_mp "Geschätzter Fahrwiderstand" SLONG TrqPrpHigh 1 100 -214748364.800 214748364.700 FORMAT "%13.3" ECU_ADDRESS 0xC0001AAC /end MEASUREMENT
/begin MEASUREMENT VehMot_trqPrpFlt_mp "Aktuelles Vortriebsmoment, gefiltert" SLONG TrqPrpHigh 1 100 -214748364.800 214748364.700 FORMAT "%13.3" ECU_ADDRESS 0xC0001AB0 /end MEASUREMENT
/begin MEASUREMENT VehMot_trqThresComp "Schwelle für komplette Kompensation der Nebenaggregate" SWORD TrqPrpHigh 1 100 -3276.800 3276.700 FORMAT "%8.3" ECU_ADDRESS 0xD0004400 /end MEASUREMENT
/begin MEASUREMENT VehMot_trqWoComp_mp "Vortriebsmoment ohne Kompensationsanteil" SLONG TrqPrpHigh 1 100 -214748364.800 214748364.700 FORMAT "%13.3" ECU_ADDRESS 0xC0001AB4 /end MEASUREMENT
/begin MEASUREMENT VehV_a "" SWORD Acc 1 100 -32.76800 32.76700 FORMAT "%8.5" ECU_ADDRESS 0xD0007600 /end MEASUREMENT
/begin MEASUREMENT VehV_aRawUnFlt_mp "" SWORD Acc 1 100 -32.76800 32.76700 FORMAT "%8.5" ECU_ADDRESS 0xC0001ABE /end MEASUREMENT
/begin MEASUREMENT VehV_tiPerAvrg "" SLONG Time_PwmHigh 1 100 -107374182.400 107374182.350 FORMAT "%13.3" ECU_ADDRESS 0xD0004404 /end MEASUREMENT
/begin MEASUREMENT VehV_tiPerAvrgOld_mp "" SLONG Time_PwmHigh 1 100 -107374182.400 107374182.350 FORMAT "%13.3" ECU_ADDRESS 0xC0001AB8 /end MEASUREMENT
/begin MEASUREMENT VehV_v "" SWORD Vel 1 100 -327.6800 327.6700 FORMAT "%8.4" ECU_ADDRESS 0xD0007602 /end MEASUREMENT
/begin MEASUREMENT VehV_vRawOld_mp "" SWORD Vel 1 100 -327.6800 327.6700 FORMAT "%8.4" ECU_ADDRESS 0xC0001ABC /end MEASUREMENT
/begin MEASUREMENT VehV_vSens "" SWORD Vel 1 100 -327.6800 327.6700 FORMAT "%8.4" ECU_ADDRESS 0xD0007604 /end MEASUREMENT
/begin MEASUREMENT VehV_vUnFlt_mp "" SWORD Vel 1 100 -327.6800 327.6700 FORMAT "%8.4" ECU_ADDRESS 0xC0001AC0 /end MEASUREMENT
/begin MEASUREMENT VMD_rVirtAPP "" SWORD Prc 1 100 -400.0000 399.9878 FORMAT "%8.4" ECU_ADDRESS 0xD00075B8 /end MEASUREMENT
/begin MEASUREMENT VMD_trqEng "" SWORD Trq 1 100 -3276.800 3276.700 FORMAT "%8.3" ECU_ADDRESS 0xD0007F70 /end MEASUREMENT
/begin MEASUREMENT VMD_trqPrpCorr "" SWORD TrqPrp 1 100 -52428.80 52427.20 FORMAT "%8.2" ECU_ADDRESS 0xD0007F72 /end MEASUREMENT
/begin MEASUREMENT VMSI_stDCSPtd "Erhöhender Stabilitätseingriff von Ebene1 verboten." UBYTE OneToOne 1 100 0.00 255.0 FORMAT "%5.1" ECU_ADDRESS 0xD000918E /end MEASUREMENT
/begin MEASUREMENT VMSI_trqDCSRmpOut_mp "Messpunkt des Rampenausgangs der Abschaltrampe des erhöhenden Stabilitätseingriffs" SLONG TrqPrpHigh 1 100 -214748364.800 214748364.700 FORMAT "%13.3" ECU_ADDRESS 0xC0001AC4 /end MEASUREMENT
/begin MEASUREMENT VMSI_trqDesMax "Reduzierender Wunschmomenteneingriff vom ESP" SLONG TrqPrpHigh 1 100 -214748364.800 214748364.700 FORMAT "%13.3" ECU_ADDRESS 0xD00043D4 /end MEASUREMENT
/begin MEASUREMENT VMSI_trqLeadMax "Reduzierender Vorhaltmomenteneingriff vom ESP" SLONG TrqPrpHigh 1 100 -214748364.800 214748364.700 FORMAT "%13.3" ECU_ADDRESS 0xD00043D8 /end MEASUREMENT
/begin MEASUREMENT VMSI_trqMin "Erhöhender Wunschmomenteneingriff vom ESP" SLONG TrqPrpHigh 1 100 -214748364.800 214748364.700 FORMAT "%13.3" ECU_ADDRESS 0xD00043DC /end MEASUREMENT
/begin MEASUREMENT VMSI_trqTCSRmpOut_mp "Messpunkt des Rampenausgangs der Abschaltrampe des reduzierenden Stabilitätseingriffs" SLONG TrqPrpHigh 1 100 -214748364.800 214748364.700 FORMAT "%13.3" ECU_ADDRESS 0xC0001AC8 /end MEASUREMENT
/begin MEASUREMENT VSwCtl_facEngTempCtlCor_mp "Motortemperaturabhängiger Korrekturfaktor" SWORD Fact 1 100 -4.000000 3.999878 FORMAT "%8.6" ECU_ADDRESS 0xC0001ACC /end MEASUREMENT
/begin MEASUREMENT VSwCtl_facEnvPresCtlCorEOMQnt1_mp "Atmosphärendruckabhängiger Korrekturfaktor für die erste auf Einspritzmenge basierte Betriebsart" SWORD Fact 1 100 -4.000000 3.999878 FORMAT "%8.6" ECU_ADDRESS 0xC0001AFE /end MEASUREMENT
/begin MEASUREMENT VSwCtl_facEnvPresCtlCor_mp "Atmosphärendruckabhängiger Korrekturfaktor" SWORD Fact 1 100 -4.000000 3.999878 FORMAT "%8.6" ECU_ADDRESS 0xC0001ACE /end MEASUREMENT
/begin MEASUREMENT VSwCtl_facRmpValCtlCor_mp "Korrigierter EGT-Rampenwert" SWORD CoEOMSwt_S16 1 100 -2.000000 1.999939 FORMAT "%8.6" ECU_ADDRESS 0xC0001AE6 /end MEASUREMENT
/begin MEASUREMENT VSwCtl_facRmpVal_mp "EOM-Rampenwert" SWORD CoEOMSwt_S16 1 100 -2.000000 1.999939 FORMAT "%8.6" ECU_ADDRESS 0xC0001AE8 /end MEASUREMENT
/begin MEASUREMENT VSwCtl_numEOMMode_mp "Index der geforderten Betriebsart" UBYTE OneToOne 1 100 0.00 255.0 FORMAT "%5.1" ECU_ADDRESS 0xC0001AF0 /end MEASUREMENT
/begin MEASUREMENT VSwCtl_qCurr_mp "aktuelle Einspritzmenge" SWORD InjMass 1 100 -327.6800 327.6700 FORMAT "%8.4" ECU_ADDRESS 0xC0001B00 /end MEASUREMENT
/begin MEASUREMENT VSwCtl_rCtlBasEOMQnt1_mp "Basiswert für die erste auf Einspritzmenge basierte Betriebsart" SWORD Prc 1 100 -400.0000 399.9878 FORMAT "%8.4" ECU_ADDRESS 0xC0001B02 /end MEASUREMENT
/begin MEASUREMENT VSwCtl_rCtlBasEOMTrq4_mp "Basiswert für die vierte auf Drehmoment basierte Betriebsart" SWORD Prc 1 100 -400.0000 399.9878 FORMAT "%8.4" ECU_ADDRESS 0xC0001B04 /end MEASUREMENT
/begin MEASUREMENT VSwCtl_rCtlBasHiAltdEOMQnt1_mp "Höhenbasiswert für die erste auf Einspritzmenge basierten Betriebsart" SWORD Prc 1 100 -400.0000 399.9878 FORMAT "%8.4" ECU_ADDRESS 0xC0001B06 /end MEASUREMENT
/begin MEASUREMENT VSwCtl_rCtlBasHiAltd_mp "Steuerwert in der Höhe im Normalbetrieb" SWORD Prc 1 100 -400.0000 399.9878 FORMAT "%8.4" ECU_ADDRESS 0xC0001AD0 /end MEASUREMENT
/begin MEASUREMENT VSwCtl_rCtlBas_mp "Basissteuerwert für den Drallniveausteller" SWORD Prc 1 100 -400.0000 399.9878 FORMAT "%8.4" ECU_ADDRESS 0xC0001AD2 /end MEASUREMENT
/begin MEASUREMENT VSwCtl_rCtlCor_mp "Korrigierter Steuerwert" SWORD Prc 1 100 -400.0000 399.9878 FORMAT "%8.4" ECU_ADDRESS 0xC0001AD4 /end MEASUREMENT
/begin MEASUREMENT VSwCtl_rCtlVal1EOMQnt1_mp "Steuerwert nach Atmosphärendruck Korrektur für die erste auf Einspritzmenge basierte Betriebsart" SWORD Prc 1 100 -400.0000 399.9878 FORMAT "%8.4" ECU_ADDRESS 0xC0001B08 /end MEASUREMENT
/begin MEASUREMENT VSwCtl_rCtlVal1_mp "Steuerwert nach Atmosphärendruck Korrektur im Normalbetrieb" SWORD Prc 1 100 -400.0000 399.9878 FORMAT "%8.4" ECU_ADDRESS 0xC0001AD6 /end MEASUREMENT
/begin MEASUREMENT VSwCtl_rCtlVal2_mp "Steuerwert nach Motortemperatur Korrektur" SWORD Prc 1 100 -400.0000 399.9878 FORMAT "%8.4" ECU_ADDRESS 0xC0001AD8 /end MEASUREMENT
/begin MEASUREMENT VSwCtl_rCtlValNrm_mp "Steuerwert für den Drallniveausteller im Normalbetrieb" SWORD Prc 1 100 -400.0000 399.9878 FORMAT "%8.4" ECU_ADDRESS 0xC0001ADA /end MEASUREMENT
/begin MEASUREMENT VSwCtl_rEngTempCorBas_mp "Basissteuerwert für die Motortemperatur Korrektur" SWORD Prc 1 100 -400.0000 399.9878 FORMAT "%8.4" ECU_ADDRESS 0xC0001ADC /end MEASUREMENT
/begin MEASUREMENT VSwCtl_rEngTempCor_mp "Motortemperaturabhängiger Korrekturwert" SWORD Prc 1 100 -400.0000 399.9878 FORMAT "%8.4" ECU_ADDRESS 0xC0001ADE /end MEASUREMENT
/begin MEASUREMENT VSwCtl_stBitMskEOM_mp "Bitmaske zur Auswahl der relevanten Abschaltfälle für die gewählte Betriebsart" ULONG OneToOne 1 100 0.00 4294967295.00 FORMAT "%13.2" ECU_ADDRESS 0xC0001AF4 /end MEASUREMENT
/begin MEASUREMENT VSwCtl_stEOMCtlVal_mp "Status über den Wechsel in eine andere Betriebsart" ULONG OneToOne 1 100 0.00 4294967295.00 FORMAT "%13.2" ECU_ADDRESS 0xC0001AEC /end MEASUREMENT
/begin MEASUREMENT VSwCtl_stEOMMon "Status der Betriebsartenüberwachung" ULONG OneToOne 1 100 0.00 4294967295.00 FORMAT "%13.2" ECU_ADDRESS 0xD00045EC /end MEASUREMENT
/begin MEASUREMENT VSwCtl_stMon "Priorisierte Abschaltfälle der Drallniveausteuerung" UBYTE OneToOne 1 100 0.00 255.0 FORMAT "%5.1" ECU_ADDRESS 0xD000918F /end MEASUREMENT
/begin MEASUREMENT VSwCtl_stMonBits_mp "Selektierte Abschaltfälle" ULONG OneToOne 1 100 0.00 4294967295.00 FORMAT "%13.2" ECU_ADDRESS 0xC0001AE0 /end MEASUREMENT
/begin MEASUREMENT VSwCtl_stSelBitMskEOM_mp "selektierte Bitmaske für Abschaltfälle für die gewählte Betriebsart" ULONG OneToOne 1 100 0.00 4294967295.00 FORMAT "%13.2" ECU_ADDRESS 0xC0001AF8 /end MEASUREMENT
/begin MEASUREMENT VSwCtl_stVSwBits "Status der Abschaltfälle" ULONG OneToOne 1 100 0.00 4294967295.00 FORMAT "%13.2" ECU_ADDRESS 0xD00045F8 /end MEASUREMENT
/begin MEASUREMENT VSwCtl_tEngCtlVal_mp "Ausgewählte Temperatur aus dem Motortemperaturfeld" SWORD Temp_Cels 1 100 -3549.940 3003.560 FORMAT "%8.3" ECU_ADDRESS 0xC0001AE4 /end MEASUREMENT
/begin MEASUREMENT VSwCtl_tiMonEOM_mp "Zeitverzögerung bei Auswahl der Abschaltfallmaske" SWORD TimeDeb 1 100 -327680.0 327670.0 FORMAT "%8.1" ECU_ADDRESS 0xC0001AFC /end MEASUREMENT
/begin MEASUREMENT VSwCtl_tiStartDelay_mp "" SWORD Time_ms 1 100 -327680.0 327670.0 FORMAT "%8.1" ECU_ADDRESS 0xC0001B0C /end MEASUREMENT
/begin MEASUREMENT VSwCtl_trqInrCurr_mp "aktuelles inneres Drehmoment für die Drallniveausteuerung" SWORD Trq 1 100 -3276.800 3276.700 FORMAT "%8.3" ECU_ADDRESS 0xC0001B0A /end MEASUREMENT
/begin MEASUREMENT VSwVlv_ctAdapCls_mp "" UBYTE OneToOne 1 100 0.00 255.0 FORMAT "%5.1" ECU_ADDRESS 0xC0001B0E /end MEASUREMENT
/begin MEASUREMENT VSwVlv_facCorFlt_mp "" SWORD Fact 1 100 -4.000000 3.999878 FORMAT "%8.6" ECU_ADDRESS 0xC0001B54 /end MEASUREMENT
/begin MEASUREMENT VSwVlv_r "" SWORD Prc 1 100 -400.0000 399.9878 FORMAT "%8.4" ECU_ADDRESS 0xD00075BA /end MEASUREMENT
/begin MEASUREMENT VSwVlv_rAct "" SWORD Prc 1 100 -400.0000 399.9878 FORMAT "%8.4" ECU_ADDRESS 0xD00075BC /end MEASUREMENT
/begin MEASUREMENT VSwVlv_rActPosMin_mp "" SWORD Prc 1 100 -400.0000 399.9878 FORMAT "%8.4" ECU_ADDRESS 0xC0001B10 /end MEASUREMENT
/begin MEASUREMENT VSwVlv_rActPosOfs_mp "" SWORD Prc 1 100 -400.0000 399.9878 FORMAT "%8.4" ECU_ADDRESS 0xC0001B12 /end MEASUREMENT
/begin MEASUREMENT VSwVlv_rActUnCor_mp "" SWORD Prc 1 100 -400.0000 399.9878 FORMAT "%8.4" ECU_ADDRESS 0xC0001B14 /end MEASUREMENT
/begin MEASUREMENT VSwVlv_rAdapLrnMax_mp "" SWORD Prc 1 100 -400.0000 399.9878 FORMAT "%8.4" ECU_ADDRESS 0xC0001B16 /end MEASUREMENT
/begin MEASUREMENT VSwVlv_rAdapLrnMinVal_mp "" SWORD Prc 1 100 -400.0000 399.9878 FORMAT "%8.4" ECU_ADDRESS 0xC0001B18 /end MEASUREMENT
/begin MEASUREMENT VSwVlv_rAdapLrnMin_mp "" SWORD Prc 1 100 -400.0000 399.9878 FORMAT "%8.4" ECU_ADDRESS 0xC0001B1A /end MEASUREMENT
/begin MEASUREMENT VSwVlv_rAdapLrn_mp "" SWORD Prc 1 100 -400.0000 399.9878 FORMAT "%8.4" ECU_ADDRESS 0xC0001B1C /end MEASUREMENT
/begin MEASUREMENT VSwVlv_rAdapMax_mp "" SWORD Prc 1 100 -400.0000 399.9878 FORMAT "%8.4" ECU_ADDRESS 0xC0001B1E /end MEASUREMENT
/begin MEASUREMENT VSwVlv_rAdapMin_mp "" SWORD Prc 1 100 -400.0000 399.9878 FORMAT "%8.4" ECU_ADDRESS 0xC0001B20 /end MEASUREMENT
/begin MEASUREMENT VSwVlv_rAdapPosMin_mp "" SWORD Prc 1 100 -400.0000 399.9878 FORMAT "%8.4" ECU_ADDRESS 0xC0001B22 /end MEASUREMENT
/begin MEASUREMENT VSwVlv_rAdapPos_mp "" SWORD Prc 1 100 -400.0000 399.9878 FORMAT "%8.4" ECU_ADDRESS 0xC0001B24 /end MEASUREMENT
/begin MEASUREMENT VSwVlv_rCnv_mp "" SWORD DtyCyc 1 100 -327.6800 327.6700 FORMAT "%8.4" ECU_ADDRESS 0xC0001B56 /end MEASUREMENT
/begin MEASUREMENT VSwVlv_rGovDvt "" SWORD Prc 1 100 -400.0000 399.9878 FORMAT "%8.4" ECU_ADDRESS 0xD00075C2 /end MEASUREMENT
/begin MEASUREMENT VSwVlv_rGovVSw "" SWORD Prc 1 100 -400.0000 399.9878 FORMAT "%8.4" ECU_ADDRESS 0xD00075C4 /end MEASUREMENT
/begin MEASUREMENT VSwVlv_rGov_mp "" SWORD Prc 1 100 -400.0000 399.9878 FORMAT "%8.4" ECU_ADDRESS 0xC0001B58 /end MEASUREMENT
/begin MEASUREMENT VSwVlv_rLinOfs_mp "" SWORD Prc 1 100 -400.0000 399.9878 FORMAT "%8.4" ECU_ADDRESS 0xC0001B26 /end MEASUREMENT
/begin MEASUREMENT VSwVlv_rMinLrnFrst "" SWORD Prc 1 100 -400.0000 399.9878 FORMAT "%8.4" ECU_ADDRESS 0xD00075C6 /end MEASUREMENT
/begin MEASUREMENT VSwVlv_rMinLrnLst "" SWORD Prc 1 100 -400.0000 399.9878 FORMAT "%8.4" ECU_ADDRESS 0xD00075C8 /end MEASUREMENT
/begin MEASUREMENT VSwVlv_rMinLrnNew "" SWORD Prc 1 100 -400.0000 399.9878 FORMAT "%8.4" ECU_ADDRESS 0xD00075CA /end MEASUREMENT
/begin MEASUREMENT VSwVlv_rNrm "" SWORD Prc 1 100 -400.0000 399.9878 FORMAT "%8.4" ECU_ADDRESS 0xD00075CC /end MEASUREMENT
/begin MEASUREMENT VSwVlv_rOfsLrnFrst "" SWORD Prc 1 100 -400.0000 399.9878 FORMAT "%8.4" ECU_ADDRESS 0xD00075CE /end MEASUREMENT
/begin MEASUREMENT VSwVlv_rOfsLrnLst "" SWORD Prc 1 100 -400.0000 399.9878 FORMAT "%8.4" ECU_ADDRESS 0xD00075D0 /end MEASUREMENT
/begin MEASUREMENT VSwVlv_rOfsLrnNew "" SWORD Prc 1 100 -400.0000 399.9878 FORMAT "%8.4" ECU_ADDRESS 0xD00075D2 /end MEASUREMENT
/begin MEASUREMENT VSwVlv_rOfsLrnVlv "" SWORD Prc 1 100 -400.0000 399.9878 FORMAT "%8.4" ECU_ADDRESS 0xD00075D4 /end MEASUREMENT
/begin MEASUREMENT VSwVlv_rOutD_mp "" SWORD Prc 1 100 -400.0000 399.9878 FORMAT "%8.4" ECU_ADDRESS 0xC0001B5A /end MEASUREMENT
/begin MEASUREMENT VSwVlv_rOutI_mp "" SWORD Prc 1 100 -400.0000 399.9878 FORMAT "%8.4" ECU_ADDRESS 0xC0001B5C /end MEASUREMENT
/begin MEASUREMENT VSwVlv_rOutP_mp "" SWORD Prc 1 100 -400.0000 399.9878 FORMAT "%8.4" ECU_ADDRESS 0xC0001B5E /end MEASUREMENT
/begin MEASUREMENT VSwVlv_rPlausLgTMin_mp "" SWORD Prc 1 100 -400.0000 399.9878 FORMAT "%8.4" ECU_ADDRESS 0xC0001B28 /end MEASUREMENT
/begin MEASUREMENT VSwVlv_rPlausLgT_mp "" SWORD Prc 1 100 -400.0000 399.9878 FORMAT "%8.4" ECU_ADDRESS 0xC0001B2A /end MEASUREMENT
/begin MEASUREMENT VSwVlv_rPlausShTMin_mp "" SWORD Prc 1 100 -400.0000 399.9878 FORMAT "%8.4" ECU_ADDRESS 0xC0001B2C /end MEASUREMENT
/begin MEASUREMENT VSwVlv_rPlausShT_mp "" SWORD Prc 1 100 -400.0000 399.9878 FORMAT "%8.4" ECU_ADDRESS 0xC0001B2E /end MEASUREMENT
/begin MEASUREMENT VSwVlv_rPlausValMin_mp "" SWORD Prc 1 100 -400.0000 399.9878 FORMAT "%8.4" ECU_ADDRESS 0xC0001B30 /end MEASUREMENT
/begin MEASUREMENT VSwVlv_rPlausVal_mp "" SWORD Prc 1 100 -400.0000 399.9878 FORMAT "%8.4" ECU_ADDRESS 0xC0001B32 /end MEASUREMENT
/begin MEASUREMENT VSwVlv_rPs "" SWORD DtyCyc 1 100 -327.6800 327.6700 FORMAT "%8.4" ECU_ADDRESS 0xD00075D6 /end MEASUREMENT
/begin MEASUREMENT VSwVlv_rRlsVSw "" SWORD Prc 1 100 -400.0000 399.9878 FORMAT "%8.4" ECU_ADDRESS 0xD00075D8 /end MEASUREMENT
/begin MEASUREMENT VSwVlv_rSens "" SWORD Prc 1 100 -400.0000 399.9878 FORMAT "%8.4" ECU_ADDRESS 0xD00075DA /end MEASUREMENT
/begin MEASUREMENT VSwVlv_rSumMin_mp "" SLONG Prc 1 100 -26214400.0000 26214399.9878 FORMAT "%13.4" ECU_ADDRESS 0xC0001B34 /end MEASUREMENT
/begin MEASUREMENT VSwVlv_rSum_mp "" SLONG Prc 1 100 -26214400.0000 26214399.9878 FORMAT "%13.4" ECU_ADDRESS 0xC0001B38 /end MEASUREMENT
/begin MEASUREMENT VSwVlv_rVSw "" SWORD Prc 1 100 -400.0000 399.9878 FORMAT "%8.4" ECU_ADDRESS 0xD00075DC /end MEASUREMENT
/begin MEASUREMENT VSwVlv_stAdap "" UWORD OneToOne 1 100 0.00 65535.00 FORMAT "%8.2" ECU_ADDRESS 0xD000769A /end MEASUREMENT
/begin MEASUREMENT VSwVlv_stAdapActv_mp "" UBYTE OneToOne 1 100 0.00 255.0 FORMAT "%5.1" ECU_ADDRESS 0xC0001B3C /end MEASUREMENT
/begin MEASUREMENT VSwVlv_stAdapRls_mp "" UBYTE OneToOne 1 100 0.00 255.0 FORMAT "%5.1" ECU_ADDRESS 0xC0001B3D /end MEASUREMENT
/begin MEASUREMENT VSwVlv_stAdapVlv_mp "" UBYTE OneToOne 1 100 0.00 255.0 FORMAT "%5.1" ECU_ADDRESS 0xC0001B3E /end MEASUREMENT
/begin MEASUREMENT VSwVlv_stEdgeCls_mp "" UBYTE OneToOne 1 100 0.00 255.0 FORMAT "%5.1" ECU_ADDRESS 0xC0001B3F /end MEASUREMENT
/begin MEASUREMENT VSwVlv_stFrstCls_mp "" UBYTE OneToOne 1 100 0.00 255.0 FORMAT "%5.1" ECU_ADDRESS 0xC0001B40 /end MEASUREMENT
/begin MEASUREMENT VSwVlv_stMon "" UWORD OneToOne 1 100 0.00 65535.00 FORMAT "%8.2" ECU_ADDRESS 0xD000769C /end MEASUREMENT
/begin MEASUREMENT VSwVlv_stMovFin_mp "" UBYTE OneToOne 1 100 0.00 255.0 FORMAT "%5.1" ECU_ADDRESS 0xC0001B41 /end MEASUREMENT
/begin MEASUREMENT VSwVlv_stNewVlvTrg_mp "" UBYTE OneToOne 1 100 0.00 255.0 FORMAT "%5.1" ECU_ADDRESS 0xC0001B42 /end MEASUREMENT
/begin MEASUREMENT VSwVlv_stOfsLrn "" UBYTE OneToOne 1 100 0.00 255.0 FORMAT "%5.1" ECU_ADDRESS 0xD0009192 /end MEASUREMENT
/begin MEASUREMENT VSwVlv_stOfsLrnDisbl_mp "" UBYTE OneToOne 1 100 0.00 255.0 FORMAT "%5.1" ECU_ADDRESS 0xC0001B43 /end MEASUREMENT
/begin MEASUREMENT VSwVlv_stOfsLrnStMch_mp "" UBYTE OneToOne 1 100 0.00 255.0 FORMAT "%5.1" ECU_ADDRESS 0xC0001B44 /end MEASUREMENT
/begin MEASUREMENT VSwVlv_stOfsLrnStrt "" UBYTE OneToOne 1 100 0.00 255.0 FORMAT "%5.1" ECU_ADDRESS 0xD0009193 /end MEASUREMENT
/begin MEASUREMENT VSwVlv_stOpnLdDia "" UBYTE OneToOne 1 100 0.00 255.0 FORMAT "%5.1" ECU_ADDRESS 0xD0009194 /end MEASUREMENT
/begin MEASUREMENT VSwVlv_stPullDwnBuf_mp "" UBYTE OneToOne 1 100 0.00 255.0 FORMAT "%5.1" ECU_ADDRESS 0xC0001B45 /end MEASUREMENT
/begin MEASUREMENT VSwVlv_stPullUpBuf_mp "" UBYTE OneToOne 1 100 0.00 255.0 FORMAT "%5.1" ECU_ADDRESS 0xC0001B46 /end MEASUREMENT
/begin MEASUREMENT VSwVlv_stRst_mp "" UBYTE OneToOne 1 100 0.00 255.0 FORMAT "%5.1" ECU_ADDRESS 0xC0001B47 /end MEASUREMENT
/begin MEASUREMENT VSwVlv_stStrStMch_mp "" UBYTE OneToOne 1 100 0.00 255.0 FORMAT "%5.1" ECU_ADDRESS 0xC0001B48 /end MEASUREMENT
/begin MEASUREMENT VSwVlv_stStr_mp "" UBYTE OneToOne 1 100 0.00 255.0 FORMAT "%5.1" ECU_ADDRESS 0xC0001B49 /end MEASUREMENT
/begin MEASUREMENT VSwVlv_stTPullDwn_mp "" UBYTE OneToOne 1 100 0.00 255.0 FORMAT "%5.1" ECU_ADDRESS 0xC0001B4A /end MEASUREMENT
/begin MEASUREMENT VSwVlv_stTPullUp_mp "" UBYTE OneToOne 1 100 0.00 255.0 FORMAT "%5.1" ECU_ADDRESS 0xC0001B4B /end MEASUREMENT
/begin MEASUREMENT VSwVlv_stTrg_mp "" UBYTE OneToOne 1 100 0.00 255.0 FORMAT "%5.1" ECU_ADDRESS 0xC0001B4C /end MEASUREMENT
/begin MEASUREMENT VSwVlv_stVlvClsBuf_mp "" UBYTE OneToOne 1 100 0.00 255.0 FORMAT "%5.1" ECU_ADDRESS 0xC0001B4D /end MEASUREMENT
/begin MEASUREMENT VSwVlv_stVlvJamBuf_mp "" UBYTE OneToOne 1 100 0.00 255.0 FORMAT "%5.1" ECU_ADDRESS 0xC0001B4E /end MEASUREMENT
/begin MEASUREMENT VSwVlv_stVlvOpnBuf_mp "" UBYTE OneToOne 1 100 0.00 255.0 FORMAT "%5.1" ECU_ADDRESS 0xC0001B4F /end MEASUREMENT
/begin MEASUREMENT VSwVlv_stVlvOpnd_mp "" UBYTE OneToOne 1 100 0.00 255.0 FORMAT "%5.1" ECU_ADDRESS 0xC0001B50 /end MEASUREMENT
/begin MEASUREMENT VSwVlv_stVlvStkOpn_mp "" UBYTE OneToOne 1 100 0.00 255.0 FORMAT "%5.1" ECU_ADDRESS 0xC0001B51 /end MEASUREMENT
/begin MEASUREMENT VSwVlv_stVlvStk_mp "" UBYTE OneToOne 1 100 0.00 255.0 FORMAT "%5.1" ECU_ADDRESS 0xC0001B52 /end MEASUREMENT
/begin MEASUREMENT VSwVlv_swtSlwCls_mp "" UBYTE OneToOne 1 100 0.00 255.0 FORMAT "%5.1" ECU_ADDRESS 0xC0001B60 /end MEASUREMENT
/begin MEASUREMENT VSwVlv_swtSlwOpn_mp "" UBYTE OneToOne 1 100 0.00 255.0 FORMAT "%5.1" ECU_ADDRESS 0xC0001B61 /end MEASUREMENT
/begin MEASUREMENT VSwVlv_uRaw "" SWORD Volt 1 100 -6553.600 6553.400 FORMAT "%8.3" ECU_ADDRESS 0xD00075DE /end MEASUREMENT
/begin MEASUREMENT WaHt_nMin "Erhöhte Leerlaufdrehzahl bei Zuschalten eines elektrischen Zusatzwasserheizers." SWORD EngN 1 100 -16384.00 16383.50 FORMAT "%8.2" ECU_ADDRESS 0xD000760A /end MEASUREMENT
/begin MEASUREMENT WaHt_rHtgOut "verfügbare Generatorlast für Zuheizer." SWORD DtyCyc 1 100 -327.6800 327.6700 FORMAT "%8.4" ECU_ADDRESS 0xD000760C /end MEASUREMENT
/begin MEASUREMENT WaHt_stHtgUp "Warmlaufzustand des Motors (0...Zustand Warmlauf, 1...Zustand Betriebswarm)." UBYTE OneToOne 1 100 0.00 255.0 FORMAT "%5.1" ECU_ADDRESS 0xD00091A3 /end MEASUREMENT
/begin MEASUREMENT WaHt_stShutOff_mp "Status Abschaltbedingengungen." UWORD OneToOne 1 100 0.00 65535.00 FORMAT "%8.2" ECU_ADDRESS 0xC0001B62 /end MEASUREMENT
/begin MEASUREMENT WaHt_tEnvLin_mp "Umgebungstemperatur nach Kennlinie" SWORD Temp_Cels 1 100 -3549.940 3003.560 FORMAT "%8.3" ECU_ADDRESS 0xC0001B64 /end MEASUREMENT
/begin MEASUREMENT ZFC_dpRailLim_mp "Aktuelle max Raildruckabweichung für die Nullmengenkalibrierung" SWORD Pres_Rail 1 100 -3276.800 2000.000 FORMAT "%5.3" ECU_ADDRESS 0xC0001B68 /end MEASUREMENT
/begin MEASUREMENT ZFC_dpRail_mp "Raildruckabweichung zum Raildruck Kalibrierungspunkt" SWORD Pres_Rail 1 100 -3276.800 2000.000 FORMAT "%5.3" ECU_ADDRESS 0xC0001B6A /end MEASUREMENT
/begin MEASUREMENT ZFC_idxFBCElm_mp "" UBYTE OneToOne 1 100 0.00 255.0 FORMAT "%5.1" ECU_ADDRESS 0xC0001B6C /end MEASUREMENT
/begin MEASUREMENT ZFC_numCylInj_mp "Aktuelle Zylindernummer für die Einspritzung der Nullmengenkalibrierung" UBYTE OneToOne 1 100 0.00 255.0 FORMAT "%5.1" ECU_ADDRESS 0xC0001B91 /end MEASUREMENT
/begin MEASUREMENT ZFC_phiInj_mp "Ansteuerbeginn der Einspritzung für die Nullmengenkalibrierung" SWORD AngleCrS 1 100 -720.0220 720.0000 FORMAT "%8.4" ECU_ADDRESS 0xC0001B92 /end MEASUREMENT
/begin MEASUREMENT ZFC_pRailSetPoint_mp "Angeforderter Raildrucksollwert der Nullmengenkalibrierung" SWORD Pres_Rail 1 100 -3276.800 2000.000 FORMAT "%5.3" ECU_ADDRESS 0xC0001B6E /end MEASUREMENT
/begin MEASUREMENT ZFC_SigThres_mp "Aktuelle Signalschwelle für die Nullmengenkalibrierung" SWORD OneToOne 1 100 -32768.00 32767.00 FORMAT "%8.2" ECU_ADDRESS 0xC0001B74 /end MEASUREMENT
/begin MEASUREMENT ZFC_Sig_mp "Messwert der Kalibrierung" SLONG OneToOne 1 100 -2147483648.00 2147483647.00 FORMAT "%13.2" ARRAY_SIZE 6 ECU_ADDRESS 0xC0001B78 /end MEASUREMENT
/begin MEASUREMENT ZFC_stCldCham "Zustand des Brennraums für die Nullmengenkalibrierung" UBYTE OneToOne 1 100 0.00 255.0 FORMAT "%5.1" ECU_ADDRESS 0xD00091A4 /end MEASUREMENT
/begin MEASUREMENT ZFC_stCmbCham_mp "Zustand der Erkennung kalter Brennraum für die Nullmengenkalibrierung" UBYTE OneToOne 1 100 0.00 255.0 FORMAT "%5.1" ECU_ADDRESS 0xC0001B66 /end MEASUREMENT
/begin MEASUREMENT ZFC_stDem_mp "Anforderungen der Nullmengenkalibrierung" UBYTE OneToOne 1 100 0.00 255.0 FORMAT "%5.1" ECU_ADDRESS 0xC0001B70 /end MEASUREMENT
/begin MEASUREMENT ZFC_stEvalSig_mp "Status der Auswertung des Signals der Nullmengenkalibrierung" UBYTE ZFC_EvalEngSpd_Rslt 1 100 0.00 2.00000000000 FORMAT "%13.11" ECU_ADDRESS 0xC0001B90 /end MEASUREMENT
/begin MEASUREMENT ZFC_stInj_mp "Status der Einspritzprogrammierung der Nullmengenkalibrierung" UBYTE ZFC_Inj_State 1 100 0.00 64.0000000000 FORMAT "%13.10" ECU_ADDRESS 0xC0001B94 /end MEASUREMENT
/begin MEASUREMENT ZFC_st_mp "Status der Nullmengenkalibrierung" UBYTE ZFC_State 1 100 1.00000000000 16.0000000000 FORMAT "%13.10" ECU_ADDRESS 0xC0001B71 /end MEASUREMENT
/begin MEASUREMENT ZFC_swtClbActv "SW-Schalter für die Aktivierung der ZFC Kalibrierung" UBYTE OneToOne 1 100 0.00 255.0 FORMAT "%5.1" ECU_ADDRESS 0xD00091A5 /end MEASUREMENT
/begin MEASUREMENT ZFC_tiET_mp "Ansteuerdauer für die Einspritzung der Nullmengenkalibrierung" SWORD InjTime_us 1 100 -13107.20 5000.00 FORMAT "%8.2" ECU_ADDRESS 0xC0001B96 /end MEASUREMENT
/begin MEASUREMENT ZFC_vStopClb_mp "Minimale Fahrzeuggeschwindigkeit der aktuellen Ansteuerdauerkalibrierung" SWORD Vel 1 100 -327.6800 327.6700 FORMAT "%8.4" ECU_ADDRESS 0xC0001B72 /end MEASUREMENT
/begin FUNCTION TOxiCatUs_VD ""
 /begin DEF_CHARACTERISTIC Exh_numFldTOxiCatUs_C Exh_numTOxiCatUs_C Exh_RmpSlpTOxiCatUs.Pos_C Exh_RmpSlpTOxiCatUs.Neg_C Exh_stMskLckNplTOxiCatUs_C Exh_tDiffNegTOxiCatUs_CUR Exh_tDiffPosTOxiCatUs_CUR Exh_tiLckNplRgnTOxiCatUs_C Exh_tiLckNplTOxiCatUs_C Exh_tiLPFltPT1TOxiCatUs_C Exh_TransStgTOxiCatUs.Dfl_C Exh_TransStgTOxiCatUs.stSensId_C /end DEF_CHARACTERISTIC
 /begin IN_MEASUREMENT ASMod_tEGFld CoEng_st CoEOM_stOpModeAct Exh_tFld /end IN_MEASUREMENT
 /begin OUT_MEASUREMENT Exh_tAdapTOxiCatUs Exh_tOxiCatUs /end OUT_MEASUREMENT
 /begin LOC_MEASUREMENT Exh_stEgtTOxiCatUs_mp Exh_stTmrPlausTOxiCatUs_mp Exh_tDiffNegTOxiCatUs_mp Exh_tDiffPosTOxiCatUs_mp Exh_tModTOxiCatUs_mp /end LOC_MEASUREMENT
/end FUNCTION
/begin FUNCTION TPFltUs_DD ""
 /begin DEF_CHARACTERISTIC Exh_SRCTPFltUs.uMin_C Exh_SRCTPFltUs.uMax_C Exh_tTransfTPFltUs_CUR /end DEF_CHARACTERISTIC
 /begin OUT_MEASUREMENT Exh_tSensTPFltUs Exh_uRawTPFltUs /end OUT_MEASUREMENT
/end FUNCTION
/begin FUNCTION TPFltUs_VD ""
 /begin DEF_CHARACTERISTIC Exh_numTPFltUs_C Exh_RmpSlpTPFltUs.Pos_C Exh_RmpSlpTPFltUs.Neg_C Exh_stMaskLckNplTPFltUs_C Exh_swtDflTPFltUs_C Exh_tDiffNegTPFltUs_CUR Exh_tDiffPosTPFltUs_CUR Exh_tiLckNplRgnTPFltUs_C Exh_tiLckNplTPFltUs_C Exh_TransStageParTPFltUs.Dfl_C Exh_TransStageParTPFltUs.stSensId_C /end DEF_CHARACTERISTIC
 /begin IN_MEASUREMENT ASMod_tEGFld CoEng_st CoEOM_stOpModeAct /end IN_MEASUREMENT
 /begin OUT_MEASUREMENT Exh_tAdapTPFltUs Exh_tPFltUs /end OUT_MEASUREMENT
 /begin LOC_MEASUREMENT Exh_tDiffNegTPFltUs_mp Exh_tDiffPosTPFltUs_mp Exh_tDiffTPFltUs_mp Exh_tEGFldTPFltUs_mp /end LOC_MEASUREMENT
/end FUNCTION
/begin FUNCTION tra_add ""
 /begin DEF_CHARACTERISTIC Tra_bCanAirCanPtd_C Tra_bCanClntCanPtd_C Tra_rClgDem_C Tra_tClntDes_C /end DEF_CHARACTERISTIC
 /begin IN_MEASUREMENT Gbx_rFanClgDem Gbx_tClntDes /end IN_MEASUREMENT
 /begin OUT_MEASUREMENT Tra_rClgDem Tra_tClntDes /end OUT_MEASUREMENT
/end FUNCTION
/begin FUNCTION Tra_GearInfo ""
 /begin DEF_CHARACTERISTIC PT_numTraGear1_C PT_numTraGear2_C PT_numTraGear3_C PT_numTraGear4_C PT_numTraGear5_C PT_numTraGear6_C PT_numTraGear7_C PT_numTraGearR_C PT_numTraNoGear_C PT_rTraGear1_C PT_rTraGear2_C PT_rTraGear3_C PT_rTraGear4_C PT_rTraGear5_C PT_rTraGear6_C PT_rTraGearR_C PT_rTraLoRng_C PT_rTraMax_C Tra_bCanInfoCan_C Tra_bCanLevPos_C Tra_bCanLoRng_C Tra_bCanRevGear_C Tra_bCanRTra_C Tra_bGbxNPosEna_C Tra_bStrtStopEnaDfl_C Tra_nEngMin_C Tra_numLevPosCan_C Tra_rV2NDfl_C Tra_rVn1H_C Tra_rVn1L_C Tra_rVn1To2Des_C Tra_rVn2H_C Tra_rVn2L_C Tra_rVn2To3Des_C Tra_rVn3H_C Tra_rVn3L_C Tra_rVn3To4Des_C Tra_rVn4H_C Tra_rVn4L_C Tra_rVn4To5Des_C Tra_rVn5H_C Tra_rVn5L_C Tra_rVn5To6Des_C Tra_rVn6H_C Tra_rVn6L_C Tra_rVnRH_C Tra_rVnRL_C Tra_stLevPosD_C Tra_swtLevPosSlct_CA Tra_swtTypeSlct_CA Tra_tOilDfl_C Tra_vMin_C /end DEF_CHARACTERISTIC
 /begin IN_MEASUREMENT Dfftl_bLowRng Epm_nEng GbxNPos_st Gbx_bRevGear Gbx_rTrqTra Gbx_stGear Gbx_stGearLvr Gbx_stGearTrgt GlbDa_vX PT_stTraType /end IN_MEASUREMENT
 /begin OUT_MEASUREMENT PT_numTraGear PT_numTraGearDes PT_numTraParGear PT_rTraGear PT_rTraGearDes PT_rTraV2N PT_stTraLoRng PT_stTraRevGear PT_stTraShftOp Tra_stStopEna Tra_stStrtEna /end OUT_MEASUREMENT
 /begin LOC_MEASUREMENT Tra_numDflGear_mp Tra_numOldGear Tra_numOldParGear Tra_rV2NLoRng_mp Tra_swtSlctGearInfoCan_mp Tra_tOil /end LOC_MEASUREMENT
/end FUNCTION
/begin FUNCTION tra_gearinfo_inl "" /end FUNCTION
/begin FUNCTION tra_grip "" /begin REF_CHARACTERISTIC PT_numTraNoGear_C /end REF_CHARACTERISTIC /begin IN_MEASUREMENT PT_numTraGear /end IN_MEASUREMENT /begin OUT_MEASUREMENT PT_stTraGrip /end OUT_MEASUREMENT /end FUNCTION
/begin FUNCTION Tra_Los "" /begin DEF_CHARACTERISTIC Tra_trqLos_C /end DEF_CHARACTERISTIC /begin OUT_MEASUREMENT Tra_trqLos /end OUT_MEASUREMENT /end FUNCTION
/begin FUNCTION tra_prt ""
 /begin DEF_CHARACTERISTIC Tra_dtrqPrtRmpP.Pos_C Tra_dtrqPrtRmpP.Neg_C Tra_stPrtCfg_C Tra_trqInMax_C Tra_trqMaxGear1_CUR Tra_trqMaxGear2_CUR Tra_trqMaxGear3_CUR Tra_trqMaxGear4_CUR Tra_trqMaxGear5_CUR Tra_trqMaxGear6_CUR Tra_trqMaxGearR_CUR /end DEF_CHARACTERISTIC
 /begin IN_MEASUREMENT Epm_nEng Gbx_trqPrt GlbDa_vX PT_numTraGear PT_stGrip /end IN_MEASUREMENT
 /begin OUT_MEASUREMENT PT_trqTraPrt /end OUT_MEASUREMENT
 /begin LOC_MEASUREMENT Tra_trqPrtGear_mp Tra_trqPrtKnall_mp /end LOC_MEASUREMENT
/end FUNCTION
/begin FUNCTION Tra_Prt_Inl ""
 /begin DEF_CHARACTERISTIC Tra_dtrqLimUp_C Tra_dtrqPrtRmp.Pos_C Tra_dtrqPrtRmp.Neg_C Tra_facLimUp_CUR Tra_swtDrvAway_C Tra_trqMaxErr_CUR /end DEF_CHARACTERISTIC
 /begin IN_MEASUREMENT Com_stTrqGbxLim CoVeh_trqDes Epm_nEng Gbx_trqPrt PT_rTrq PT_trqLos VehV_v /end IN_MEASUREMENT
 /begin LOC_MEASUREMENT Tra_dtrqLimUp_mp Tra_stDrvAway_mp Tra_trqLimDrvAway_mp Tra_trqLimRampIn_mp Tra_trqMaxCur_mp /end LOC_MEASUREMENT
/end FUNCTION
/begin FUNCTION tra_rtnintfc ""
 /begin DEF_CHARACTERISTIC Tra_bCANASTIntv_C Tra_bCANIdlSetP_C Tra_nASTDes_C Tra_nMax_C Tra_nMin_C Tra_tiASTDes_C /end DEF_CHARACTERISTIC
 /begin IN_MEASUREMENT Gbx_bASTIntv Gbx_bASTNeutr Gbx_nASTDes Gbx_nIdlDes Gbx_tiASTDes /end IN_MEASUREMENT
 /begin OUT_MEASUREMENT Tra_nASTDes Tra_nMax Tra_nMin Tra_stAST Tra_stNSetP Tra_tiASTDes /end OUT_MEASUREMENT
/end FUNCTION
/begin FUNCTION tra_rtnintfc_inl "" /begin DEF_CHARACTERISTIC Tra_bAST_C Tra_bFltIdlSpdDes_C /end DEF_CHARACTERISTIC /end FUNCTION
/begin FUNCTION tra_trqred ""
 /begin DEF_CHARACTERISTIC Tra_bCanPlausDecIntv_C Tra_bCanPlausIncIntv_C Tra_dtrqRmpDecP.Pos_C Tra_dtrqRmpDecP.Neg_C Tra_dtrqRmpIncP.Pos_C Tra_dtrqRmpIncP.Neg_C Tra_swtRmpPtd_C Tra_trqDesMaxTrq_CUR Tra_trqDesMax_C Tra_trqDesMin_C Tra_vMinTrqRed_C /end DEF_CHARACTERISTIC
 /begin IN_MEASUREMENT Epm_nEng Gbx_trqTIIDes Gbx_trqTSCIntv GlbDa_vX MoFExtInt_stTSCPtdMsg /end IN_MEASUREMENT
 /begin OUT_MEASUREMENT Tra_stTSCPtd Tra_trqDesMax Tra_trqDesMin Tra_trqLeadMax Tra_trqLeadMin /end OUT_MEASUREMENT
 /begin LOC_MEASUREMENT Tra_trqDecDem_mp Tra_trqIncDem_mp /end LOC_MEASUREMENT
/end FUNCTION
/begin FUNCTION tra_trqred_inl "" /end FUNCTION
/begin FUNCTION tra_typeinfo "" /begin DEF_CHARACTERISTIC Tra_stTraType_C /end DEF_CHARACTERISTIC /begin OUT_MEASUREMENT PT_stTraType /end OUT_MEASUREMENT /end FUNCTION
/begin FUNCTION TrbChAPos_DD "" /begin DEF_CHARACTERISTIC TrbCh_rTransf_CUR /end DEF_CHARACTERISTIC /begin REF_CHARACTERISTIC TrbCh_typ4WinDia_C /end REF_CHARACTERISTIC /begin OUT_MEASUREMENT TrbCh_rSens TrbCh_stActrErr /end OUT_MEASUREMENT /begin LOC_MEASUREMENT TrbCh_rRaw /end LOC_MEASUREMENT /end FUNCTION
/begin FUNCTION trbchlp_dd ""
 /begin DEF_CHARACTERISTIC TrbChLP_Pwm.tiPer_C TrbChLP_Pwm.stLvl_C TrbChLP_Pwm.rMaxDty_C TrbChLP_Pwm.rPerUn_C TrbChLP_Pwm.tiPh_C TrbChLP_PwmOut.rMin_C TrbChLP_PwmOut.rMax_C TrbChLP_PwmOut.tiBtwTstSCB_C TrbChLP_PwmOut.tiBtwTstOT_C TrbChLP_PwmOut.numTstMax_C TrbChLP_PwmOut.swtBattCor_C TrbChLP_PwmOut.swtPsInv_C TrbChLP_rCnv_CUR TrbChLP_stPsDiaDisbl_C TrbChLP_stPsDisbl_C /end DEF_CHARACTERISTIC
 /begin IN_MEASUREMENT BattU_facCor DevLib_stPwrStgEnaCond /end IN_MEASUREMENT
 /begin OUT_MEASUREMENT TrbChLP_r TrbChLP_rPs /end OUT_MEASUREMENT
/end FUNCTION
/begin FUNCTION trbchlp_ddvar "" /end FUNCTION
/begin FUNCTION TrbCh_DD ""
 /begin DEF_CHARACTERISTIC TrbCh_4WinSigDur.tiErr1Min_C TrbCh_4WinSigDur.tiErr1Max_C TrbCh_4WinSigDur.tiErr2Min_C TrbCh_4WinSigDur.tiErr2Max_C TrbCh_4WinSigDur.tiErr3Min_C TrbCh_4WinSigDur.tiErr3Max_C TrbCh_4WinSigDur.tiErr4Min_C TrbCh_4WinSigDur.tiErr4Max_C TrbCh_Pwm.tiPer_C TrbCh_Pwm.stLvl_C TrbCh_Pwm.rMaxDty_C TrbCh_Pwm.rPerUn_C TrbCh_Pwm.tiPh_C TrbCh_PwmOut.rMin_C TrbCh_PwmOut.rMax_C TrbCh_PwmOut.tiBtwTstSCB_C TrbCh_PwmOut.tiBtwTstOT_C TrbCh_PwmOut.numTstMax_C TrbCh_PwmOut.swtBattCor_C TrbCh_PwmOut.swtPsInv_C TrbCh_rCnv_CUR TrbCh_rPsDisbl_C TrbCh_stPsDiaDisbl_C TrbCh_stPsDisbl_C TrbCh_typ4WinDia_C /end DEF_CHARACTERISTIC
 /begin IN_MEASUREMENT BattU_facCor DevLib_stPwrStgEnaCond TrbCh_stActrErr /end IN_MEASUREMENT
 /begin OUT_MEASUREMENT TrbCh_r TrbCh_rPs /end OUT_MEASUREMENT
 /begin LOC_MEASUREMENT TrbCh_stErrMsg_mp /end LOC_MEASUREMENT
/end FUNCTION
/begin FUNCTION TSDa_TClnt "" /begin DEF_CHARACTERISTIC TSDa_tRadOutSubs_C /end DEF_CHARACTERISTIC /begin OUT_MEASUREMENT TSDa_tClntIniVal TSDa_tClntRadOut TS_tClntEngOut /end OUT_MEASUREMENT /begin LOC_MEASUREMENT TS_tClntEngIn /end LOC_MEASUREMENT /end FUNCTION
/begin FUNCTION Uart "" /end FUNCTION
/begin FUNCTION vehmot_calctrqdrag ""
 /begin DEF_CHARACTERISTIC VehMot_mInrt_C VehMot_tiFastLearn_C VehMot_tiTrqDragMin_C VehMot_tiTrqDragVx_CUR VehMot_tiTrqPrpPT1_C VehMot_trqDragMax_C VehMot_trqThresComp_C VehMot_vMinDragEst_C /end DEF_CHARACTERISTIC
 /begin IN_MEASUREMENT GlbDa_aX GlbDa_lWhlCirc GlbDa_vX PT_stGrip PT_swtMstShft PT_trqSpdGovLtd PT_trqWhl PT_trqWhlMaxEng PT_trqWhlMinEng VehMot_stAccPedOvrRun VehMot_stBrkPed VMD_trqDes /end IN_MEASUREMENT
 /begin OUT_MEASUREMENT VehMot_a2trq VehMot_aPrpCurr VehMot_aPrpMax VehMot_aPrpMin VehMot_tiTrqDragPT1 VehMot_trqDrag VehMot_trqDragEst_mp VehMot_trqPrpFlt_mp VehMot_trqThresComp VehMot_trqWoComp_mp /end OUT_MEASUREMENT
/end FUNCTION
/begin FUNCTION VehV_DD "" /begin DEF_CHARACTERISTIC VehV_ImpPerDist_C VehV_swtSig_C VehV_tiPerMax_C /end DEF_CHARACTERISTIC /begin IN_MEASUREMENT Com_v /end IN_MEASUREMENT
 /begin OUT_MEASUREMENT VehV_tiPerAvrg VehV_tiPerAvrgOld_mp VehV_vRawOld_mp VehV_vSens /end OUT_MEASUREMENT
/end FUNCTION
/begin FUNCTION VehV_VD ""
 /begin DEF_CHARACTERISTIC VehV_nThresPla_C VehV_swtTrqSel_C VehV_tiAPT1_C VehV_tiDebMonPla_C VehV_tiVPT1_C VehV_trqThresPla_C VehV_vDfl_C VehV_vMax_C VehV_vMin_C VehV_vThresPla_C /end DEF_CHARACTERISTIC
 /begin IN_MEASUREMENT ActMod_trqInr Epm_nEng PthSet_trqInrSet /end IN_MEASUREMENT
 /begin OUT_MEASUREMENT VehV_a VehV_aRawUnFlt_mp VehV_v VehV_vUnFlt_mp /end OUT_MEASUREMENT
/end FUNCTION
/begin FUNCTION Veh_Adapt ""
 /begin DEF_CHARACTERISTIC AccPed_rNotPressed_C DiffIO_rTrqDfftl_C DiffIO_stCfg_C DiffIO_trqPrtDfftl_C Eng_stOff_C Eng_stRun_C LiGov_nSetpoint_C PhyMod_pwrClntEntry_C SIIO_stDCSIntv_C SIIO_stTCSIntv_C SIIO_trqDesDCS_C SIIO_trqDesTCS_C SIIO_trqLeadTCS_C StWhl_dphiAg_C StWhl_phiAg_C /end DEF_CHARACTERISTIC
 /begin OUT_MEASUREMENT DiffIO_rTrqDfftl DiffIO_stCfg DiffIO_trqPrtDfftl EngPrt_nMax ETCtl_tiPoI2Cor LiGov_nStat PFltRgn_st SIIO_stDCSIntv SIIO_stTCSIntv SIIO_trqDesDCS SIIO_trqDesTCS SIIO_trqLeadTCS SSEUI_stStopStrtSwt /end OUT_MEASUREMENT
 /begin LOC_MEASUREMENT AltIO_trqDes CoPT_nMaxEng CoPT_nMinEng TS_tClntIniVal /end LOC_MEASUREMENT
/end FUNCTION
/begin FUNCTION vmadapt_adapt ""
 /begin DEF_CHARACTERISTIC StbIntv_bDCSIntv_C StbIntv_bDCSNeutr_C StbIntv_bTCSIntv_C StbIntv_bTCSNeutr_C StbIntv_trqDCSDes_C StbIntv_trqTCSDes_C StbIntv_trqTCSLead_C /end DEF_CHARACTERISTIC
 /begin OUT_MEASUREMENT StbIntv_bDCSIntv StbIntv_bDCSNeutr StbIntv_bTCSIntv StbIntv_bTCSNeutr StbIntv_trqDCSDes StbIntv_trqTCSDes StbIntv_trqTCSLead /end OUT_MEASUREMENT
/end FUNCTION
/begin FUNCTION vmd_virtapp "" /begin DEF_CHARACTERISTIC VMD_tiFltVirtAPP_C /end DEF_CHARACTERISTIC
 /begin IN_MEASUREMENT AccPed_rTrq Epm_nEng PT_trqSpdGovLtd PT_trqWhlMinWoCtOff VehMot_rAccPedFlt VehMot_stAccPedOvrRun VMD_trqDes /end IN_MEASUREMENT
 /begin OUT_MEASUREMENT VMD_rVirtAPP /end OUT_MEASUREMENT
/end FUNCTION
/begin FUNCTION vmd_virtapp_inl ""
 /begin DEF_CHARACTERISTIC VMD_rEng_MAP VMD_rPrp_MAP VMD_trqThresEng_CUR VMD_trqThresPrp_CUR /end DEF_CHARACTERISTIC
 /begin IN_MEASUREMENT AccPed_stMS AccPed_trqDes Epm_nEng GlbDa_vX /end IN_MEASUREMENT
 /begin LOC_MEASUREMENT VMD_trqEng VMD_trqPrpCorr /end LOC_MEASUREMENT
/end FUNCTION
/begin FUNCTION vmsi_plaustrqintv ""
 /begin DEF_CHARACTERISTIC VMSI_dtrqRmpDCSP.Pos_C VMSI_dtrqRmpDCSP.Neg_C VMSI_dtrqRmpTCSP.Pos_C VMSI_dtrqRmpTCSP.Neg_C VMSI_stCfg_C VMSI_swtSlipCtl_C /end DEF_CHARACTERISTIC
 /begin IN_MEASUREMENT MoFExtInt_stDCSPtdMsg StbIntv_bDCSIntv StbIntv_bDCSNeutr StbIntv_bTCSIntv StbIntv_bTCSNeutr StbIntv_trqDCSDes StbIntv_trqTCSDes StbIntv_trqTCSLead VehMot_stStabIntv /end IN_MEASUREMENT
 /begin OUT_MEASUREMENT VMSI_stDCSPtd VMSI_trqDesMax VMSI_trqLeadMax VMSI_trqMin /end OUT_MEASUREMENT
 /begin LOC_MEASUREMENT VMSI_trqDCSRmpOut_mp VMSI_trqTCSRmpOut_mp /end LOC_MEASUREMENT
/end FUNCTION
/begin FUNCTION vswctl_ctlvalcalc ""
 /begin DEF_CHARACTERISTIC VSwCtl_facEngTempCtlCor_CUR VSwCtl_facEnvPresCtlCor_CUR VSwCtl_numEngTempCtlVal_C VSwCtl_rCtlBasHiAltd_MAP VSwCtl_rCtlBas_MAP VSwCtl_rDflVal_CA VSwCtl_rEngTempCorBas_MAP VSwCtl_rThresMax_C VSwCtl_rThresMin_C VSwCtl_rVSAMax_C VSwCtl_rVSAMin_C VSwCtl_stPrioMon_CA VSwCtl_swtHysOff_C /end DEF_CHARACTERISTIC
 /begin IN_MEASUREMENT AFS_stDrft AirCtl_stMon EngDa_tFld EnvP_p Epm_nEng InjCtl_qCurr VSwVlv_r /end IN_MEASUREMENT
 /begin OUT_MEASUREMENT VSwCtl_stMon VSwCtl_stVSwBits /end OUT_MEASUREMENT
 /begin LOC_MEASUREMENT VSwCtl_facEngTempCtlCor_mp VSwCtl_facEnvPresCtlCor_mp VSwCtl_rCtlBasHiAltd_mp VSwCtl_rCtlBas_mp VSwCtl_rCtlCor_mp VSwCtl_rCtlVal1_mp VSwCtl_rCtlVal2_mp VSwCtl_rCtlValNrm_mp VSwCtl_rEngTempCorBas_mp VSwCtl_rEngTempCor_mp VSwCtl_stMonBits_mp VSwCtl_tEngCtlVal_mp /end LOC_MEASUREMENT
/end FUNCTION
/begin FUNCTION vswctl_ctlvalcalc_inl1 "" /begin DEF_CHARACTERISTIC VSwCtl_facRmpValCtlCor_CUR VSwCtl_stCtlValEOMMsk_CA /end DEF_CHARACTERISTIC /begin IN_MEASUREMENT CoEOM_facRmpVal CoEOM_stOpModeAct /end IN_MEASUREMENT
 /begin LOC_MEASUREMENT VSwCtl_facRmpValCtlCor_mp VSwCtl_facRmpVal_mp VSwCtl_stEOMCtlVal_mp /end LOC_MEASUREMENT
/end FUNCTION
/begin FUNCTION VSwCtl_CtlValCalc_Inl2 "" /begin DEF_CHARACTERISTIC VSwCtl_rVSAAirTempCorr_CUR /end DEF_CHARACTERISTIC /begin IN_MEASUREMENT Air_tAFS /end IN_MEASUREMENT /end FUNCTION
/begin FUNCTION vswctl_ctlvalcalc_inl3 ""
 /begin DEF_CHARACTERISTIC VSwCtl_stBitMskEOM_CA VSwCtl_stMonEOMMsk_CA VSwCtl_tiMonEOM_CA /end DEF_CHARACTERISTIC
 /begin IN_MEASUREMENT CoEOM_stOpModeAct /end IN_MEASUREMENT
 /begin LOC_MEASUREMENT VSwCtl_numEOMMode_mp VSwCtl_stBitMskEOM_mp VSwCtl_stSelBitMskEOM_mp VSwCtl_tiMonEOM_mp /end LOC_MEASUREMENT
/end FUNCTION
/begin FUNCTION vswctl_ctlvalcalc_inl4 "" /begin DEF_CHARACTERISTIC VSwCtl_stShOffEOMMsk_C /end DEF_CHARACTERISTIC /begin IN_MEASUREMENT CoEOM_stOpModeAct /end IN_MEASUREMENT /begin OUT_MEASUREMENT VSwCtl_stEOMMon /end OUT_MEASUREMENT /end FUNCTION
/begin FUNCTION vswctl_ctlvalcalc_inl5 ""
 /begin DEF_CHARACTERISTIC VSwCtl_facEnvPresCtlCorEOMQnt1_CUR VSwCtl_rCtlBasEOMQnt1_MAP VSwCtl_rCtlBasHiAltdEOMQnt1_MAP /end DEF_CHARACTERISTIC
 /begin IN_MEASUREMENT EnvP_p Epm_nEng InjCtl_qCurr PthLead_trqInrCurr /end IN_MEASUREMENT
 /begin LOC_MEASUREMENT VSwCtl_facEnvPresCtlCorEOMQnt1_mp VSwCtl_qCurr_mp VSwCtl_rCtlBasEOMQnt1_mp VSwCtl_rCtlBasEOMTrq4_mp VSwCtl_rCtlBasHiAltdEOMQnt1_mp VSwCtl_rCtlVal1EOMQnt1_mp VSwCtl_trqInrCurr_mp /end LOC_MEASUREMENT
/end FUNCTION
/begin FUNCTION VSwCtl_CtlValCalc_Inl6 "" /begin DEF_CHARACTERISTIC VSwCtl_tiStartDelay_CUR /end DEF_CHARACTERISTIC /begin IN_MEASUREMENT CoEng_st VSwCtl_tEngCtlVal_mp /end IN_MEASUREMENT /begin LOC_MEASUREMENT VSwCtl_tiStartDelay_mp /end LOC_MEASUREMENT /end FUNCTION
/begin FUNCTION vswvlvapos_dd ""
 /begin DEF_CHARACTERISTIC VSwVlv_rTransf_CUR VSwVlv_SRC.uMin_C VSwVlv_SRC.uMax_C VSwVlv_swtNrmSel_C VSwVlv_swtSensPrs_C VSwVlv_uRefSens_C /end DEF_CHARACTERISTIC
 /begin OUT_MEASUREMENT VSwVlv_rNrm VSwVlv_rSens VSwVlv_uRaw /end OUT_MEASUREMENT
/end FUNCTION
/begin FUNCTION vswvlvapos_vd ""
 /begin DEF_CHARACTERISTIC VSwVlv_drOfsLrnVlvSlpDwn_C VSwVlv_drOfsLrnVlvSlpUp_C VSwVlv_numAdapClsMax_C VSwVlv_rActMax_C VSwVlv_rActMin_C VSwVlv_rActPosMin_C VSwVlv_rActPosOfs_C VSwVlv_rAdapAgClsMin_C VSwVlv_rAdapAgOpnMax_C VSwVlv_rAdapDiffPlausLgT_C VSwVlv_rAdapDiffPlausMin_C VSwVlv_rAdapDiffPlausShT_C VSwVlv_rAdapDiffPlaus_C VSwVlv_rCmpNewCtlUn_C VSwVlv_rMinLrnLstCor_C VSwVlv_RmpSlp.Pos_C VSwVlv_RmpSlp.Neg_C VSwVlv_rOfsLrnLstCor_C VSwVlv_rOfsLrnVlvMax_C VSwVlv_rOfsLrnVlvMin_C VSwVlv_rPlausLgTMin_C VSwVlv_rPlausShTMin_C VSwVlv_stNewVlvTrg_C VSwVlv_stOfsLrnTrg_C VSwVlv_swtActPosOfs_C VSwVlv_swtOfsLrnActv_C VSwVlv_tEngMax_C VSwVlv_tEngMin_C VSwVlv_tiAdapJamVlv_C VSwVlv_tiAdapPullDwn_C VSwVlv_tiAdapPullUp_C VSwVlv_tiOpnJamVlv_C VSwVlv_TransStg.Dfl_C VSwVlv_TransStg.stSensId_C VSwVlv_uBattMax_C VSwVlv_uBattMin_C /end DEF_CHARACTERISTIC
 /begin IN_MEASUREMENT BattU_u DevLib_stPwrStgEnaCond EngDa_tEng SyC_stSub VSwVlv_rSens VSwVlv_stMon /end IN_MEASUREMENT
 /begin OUT_MEASUREMENT VSwVlv_rAct VSwVlv_rMinLrnFrst VSwVlv_rMinLrnLst VSwVlv_rMinLrnNew VSwVlv_rOfsLrnFrst VSwVlv_rOfsLrnLst VSwVlv_rOfsLrnNew VSwVlv_rOfsLrnVlv VSwVlv_stAdap VSwVlv_stOfsLrn VSwVlv_stOfsLrnStrt /end OUT_MEASUREMENT
 /begin LOC_MEASUREMENT VSwVlv_ctAdapCls_mp VSwVlv_rActPosMin_mp VSwVlv_rActPosOfs_mp VSwVlv_rActUnCor_mp VSwVlv_rAdapLrnMax_mp VSwVlv_rAdapLrnMinVal_mp VSwVlv_rAdapLrnMin_mp VSwVlv_rAdapLrn_mp VSwVlv_rAdapMax_mp VSwVlv_rAdapMin_mp VSwVlv_rAdapPosMin_mp VSwVlv_rAdapPos_mp VSwVlv_rLinOfs_mp VSwVlv_rPlausLgTMin_mp VSwVlv_rPlausLgT_mp VSwVlv_rPlausShTMin_mp VSwVlv_rPlausShT_mp VSwVlv_rPlausValMin_mp VSwVlv_rPlausVal_mp VSwVlv_rSumMin_mp VSwVlv_rSum_mp VSwVlv_stAdapActv_mp VSwVlv_stAdapRls_mp VSwVlv_stAdapVlv_mp VSwVlv_stEdgeCls_mp VSwVlv_stFrstCls_mp VSwVlv_stMovFin_mp VSwVlv_stNewVlvTrg_mp VSwVlv_stOfsLrnDisbl_mp VSwVlv_stOfsLrnStMch_mp VSwVlv_stPullDwnBuf_mp VSwVlv_stPullUpBuf_mp VSwVlv_stRst_mp VSwVlv_stStrStMch_mp VSwVlv_stStr_mp VSwVlv_stTPullDwn_mp VSwVlv_stTPullUp_mp VSwVlv_stTrg_mp VSwVlv_stVlvClsBuf_mp VSwVlv_stVlvJamBuf_mp VSwVlv_stVlvOpnBuf_mp VSwVlv_stVlvOpnd_mp VSwVlv_stVlvStkOpn_mp VSwVlv_stVlvStk_mp /end LOC_MEASUREMENT
/end FUNCTION
/begin FUNCTION vswvlv_dd ""
 /begin DEF_CHARACTERISTIC VSwVlv_facLpGnStrt_C VSwVlv_Pwm.tiPer_C VSwVlv_Pwm.stLvl_C VSwVlv_Pwm.rMaxDty_C VSwVlv_Pwm.rPerUn_C VSwVlv_Pwm.tiPh_C VSwVlv_PwmOut.rMin_C VSwVlv_PwmOut.rMax_C VSwVlv_PwmOut.tiBtwTstSCB_C VSwVlv_PwmOut.tiBtwTstOT_C VSwVlv_PwmOut.numTstMax_C VSwVlv_PwmOut.swtBattCor_C VSwVlv_PwmOut.swtPsInv_C VSwVlv_rCnv_CUR VSwVlv_stPsDiaDisbl_C VSwVlv_stPsDisbl_C VSwVlv_swtHwSel_C VSwVlv_tiPT1FacCor_C /end DEF_CHARACTERISTIC
 /begin IN_MEASUREMENT BattU_facCor DevLib_stPwrStgEnaCond VSwVlv_rVSw /end IN_MEASUREMENT
 /begin OUT_MEASUREMENT VSwVlv_rPs /end OUT_MEASUREMENT
 /begin LOC_MEASUREMENT VSwVlv_facCorFlt_mp VSwVlv_rCnv_mp VSwVlv_stOpnLdDia /end LOC_MEASUREMENT
/end FUNCTION
/begin FUNCTION vswvlv_vdmon ""
 /begin DEF_CHARACTERISTIC VSwVlv_rDvtMax_C VSwVlv_rDvtMin_C VSwVlv_RlsIKi_C VSwVlv_rRlsMax_C VSwVlv_rRlsMin_C VSwVlv_tiRepRls_C VSwVlv_tiRls_C /end DEF_CHARACTERISTIC
 /begin IN_MEASUREMENT CoEng_st VSwVlv_rGovDvt VSwVlv_stAdap /end IN_MEASUREMENT
 /begin OUT_MEASUREMENT VSwVlv_rRlsVSw VSwVlv_stMon /end OUT_MEASUREMENT
/end FUNCTION
/begin FUNCTION vswvlv_vdposgov ""
 /begin DEF_CHARACTERISTIC VSwVlv_DKdNgv_C VSwVlv_DKdPsv_C VSwVlv_drActNgv_C VSwVlv_drActPsv_C VSwVlv_IKiNgv_C VSwVlv_IKiPsv_C VSwVlv_PKpNgv_C VSwVlv_PKpPsv_C VSwVlv_rActNgv_C VSwVlv_rActPsv_C VSwVlv_rAdap_CUR VSwVlv_rDMax_C VSwVlv_rGovDvtThres_C VSwVlv_rGovMax_C VSwVlv_rGovMin_C VSwVlv_rMax_C VSwVlv_rMin_C VSwVlv_rOutDMax_C VSwVlv_rOutIMax_C VSwVlv_rPIDWinNgv_C VSwVlv_rPIDWinPsv_C VSwVlv_SlwClsDKd_C VSwVlv_SlwClsIKi_C VSwVlv_SlwClsPKp_C VSwVlv_SlwOpnDKd_C VSwVlv_SlwOpnIKi_C VSwVlv_SlwOpnPKp_C VSwVlv_SmlSigNgvDKd_C VSwVlv_SmlSigNgvIKi_C VSwVlv_SmlSigNgvPKp_C VSwVlv_SmlSigPsvDKd_C VSwVlv_SmlSigPsvIKi_C VSwVlv_SmlSigPsvPKp_C VSwVlv_swtGovByp_C VSwVlv_tiGovDT1_C VSwVlv_tiSlwParDT1_C /end DEF_CHARACTERISTIC
 /begin OUT_MEASUREMENT VSwVlv_r VSwVlv_rGovDvt VSwVlv_rGovVSw VSwVlv_rVSw /end OUT_MEASUREMENT
 /begin LOC_MEASUREMENT VSwVlv_rGov_mp VSwVlv_rOutD_mp VSwVlv_rOutI_mp VSwVlv_rOutP_mp VSwVlv_swtSlwCls_mp VSwVlv_swtSlwOpn_mp /end LOC_MEASUREMENT
/end FUNCTION
/begin FUNCTION waht_demand ""
 /begin DEF_CHARACTERISTIC WaHt_nACEngXHigh_C WaHt_nACEngXLow_C WaHt_nDAEng_C WaHt_nMin_C WaHt_rHtgOutMax_C WaHt_rHtgOutMin_C WaHt_swtHtgUp_C WaHt_tEnvHysDelta_C WaHt_tEnv_CUR WaHt_tiACMin_C WaHt_tiDAMin_C WaHt_tiStrt_C WaHt_trqInrLimDelta_C WaHt_vDAVeh_C /end DEF_CHARACTERISTIC
 /begin IN_MEASUREMENT GlbDa_tEnv /end IN_MEASUREMENT
 /begin OUT_MEASUREMENT WaHt_nMin WaHt_rHtgOut WaHt_stHtgUp /end OUT_MEASUREMENT
 /begin LOC_MEASUREMENT WaHt_stShutOff_mp WaHt_tEnvLin_mp /end LOC_MEASUREMENT
/end FUNCTION
/begin FUNCTION Xcp "" /begin SUB_FUNCTION XcpDrv XcpCan XcpUsb /end SUB_FUNCTION /end FUNCTION
/begin FUNCTION XcpCan "" /end FUNCTION
/begin FUNCTION XcpDrv "" /end FUNCTION
/begin FUNCTION XcpUsb "" /end FUNCTION
/begin FUNCTION ZFC_CldCmbCham "" /begin DEF_CHARACTERISTIC ZFC_tiCldCham_CUR ZFC_tiHotCham_C /end DEF_CHARACTERISTIC /begin IN_MEASUREMENT CACDsT_t InjCtl_qSetUnBal /end IN_MEASUREMENT /begin OUT_MEASUREMENT ZFC_stCldCham /end OUT_MEASUREMENT /begin LOC_MEASUREMENT ZFC_stCmbCham_mp /end LOC_MEASUREMENT /end FUNCTION
/begin FUNCTION ZFC_Co ""
 /begin DEF_CHARACTERISTIC ZFC_ClbActv.xVal_C ZFC_ClbActv.xTyp_C ZFC_dBPFacFBCG3_GMAP ZFC_dBPFacFBCG4_GMAP ZFC_dBPFacFBCG5_GMAP ZFC_dBPFacFBCG6_GMAP ZFC_dBPFacFBCG7_GMAP ZFC_dSegFBCCaSG3_GMAP ZFC_dSegFBCCaSG4_GMAP ZFC_dSegFBCCaSG5_GMAP ZFC_dSegFBCCaSG6_GMAP ZFC_dSegFBCCaSG7_GMAP ZFC_idxFBCElm_C ZFC_idxFBCVal_AXIS ZFC_nAvrgMax_C ZFC_nAvrgMin_C ZFC_nChngPRailMax_C ZFC_nFBCThresMax_C ZFC_nFBCVal_AXIS ZFC_nHyst_C ZFC_pACMax_C ZFC_pBstMin_C ZFC_rAccPedMax_C ZFC_stACSel_C ZFC_stClthSel_C ZFC_stGearRls_CA ZFC_tAirThres_C ZFC_tEngThres_C ZFC_tFuelThresMax_C ZFC_tFuelThresMin_C ZFC_tiDelOvrRun_C ZFC_tiDelpRailLim_C ZFC_uBattMin_C /end DEF_CHARACTERISTIC
 /begin IN_MEASUREMENT ACCtl_stOut AirC_pClnt Air_pCACDs APP_r BattU_u CACDsT_t Clth_st EngDa_tEng Epm_nEng Epm_numCyl ETClb_stLimClbFrq FBC_ctSegInt FBC_dBPSum FBC_stLearn FuelT_t PCR_stMon PthSet_stOvrRunCoord PT_numTraGearDes RailP_pFlt TS_stMnSwtAC VehV_v ZFC_stCldCham /end IN_MEASUREMENT
 /begin LOC_MEASUREMENT ZFC_dpRailLim_mp ZFC_dpRail_mp ZFC_idxFBCElm_mp ZFC_pRailSetPoint_mp ZFC_stDem_mp ZFC_st_mp ZFC_swtClbActv ZFC_vStopClb_mp /end LOC_MEASUREMENT
/end FUNCTION
/begin FUNCTION ZFC_EvalEngSpd "" /begin LOC_MEASUREMENT ZFC_SigThres_mp ZFC_Sig_mp ZFC_stEvalSig_mp /end LOC_MEASUREMENT /end FUNCTION
/begin FUNCTION ZFC_Inj "" /begin DEF_CHARACTERISTIC ZFC_phiSet_CUR /end DEF_CHARACTERISTIC /begin IN_MEASUREMENT Epm_nEng /end IN_MEASUREMENT /begin LOC_MEASUREMENT ZFC_numCylInj_mp ZFC_phiInj_mp ZFC_stInj_mp ZFC_tiET_mp /end LOC_MEASUREMENT /end FUNCTION
/begin COMPU_METHOD Acc "" RAT_FUNC "%6.5" "m/s^2" COEFFS 0 1000 0 0 0 1 /end COMPU_METHOD
/begin COMPU_METHOD Angle "" RAT_FUNC "%6.4" "deg" COEFFS 0 32 0 0 0 1 /end COMPU_METHOD
/begin COMPU_METHOD AngleCrS "" RAT_FUNC "%6.4" "deg CrS" COEFFS 0 45.5097222222222 0 0 0 1 /end COMPU_METHOD
/begin COMPU_METHOD AngleDerivative "" RAT_FUNC "%6.4" "deg/s" COEFFS 0 16 0 0 0 1 /end COMPU_METHOD
/begin COMPU_METHOD CoEOMSwt_S16 "" RAT_FUNC "%7.6" "-" COEFFS 0 16384 0 0 0 1 /end COMPU_METHOD
/begin COMPU_METHOD DtyCyc "" RAT_FUNC "%6.4" "%" COEFFS 0 100 0 0 0 1 /end COMPU_METHOD
/begin COMPU_METHOD EngN "" RAT_FUNC "%6.3" "rpm" COEFFS 0 2 0 0 0 1 /end COMPU_METHOD
/begin COMPU_METHOD EngTempFldSel "" TAB_VERB "%6.3" "-" COMPU_TAB_REF EngTempFldSel /end COMPU_METHOD
/begin COMPU_VTAB EngTempFldSel "" TAB_VERB 3 0 "Coolant_Temperature" 1 "Oil_Temperature" 2 "EngDa_tEng" /end COMPU_VTAB
/begin COMPU_METHOD Fact "" RAT_FUNC "%6.5" "-" COEFFS 0 8192 0 0 0 1 /end COMPU_METHOD
/begin COMPU_METHOD InjMass "" RAT_FUNC "%6.4" "mg/hub" COEFFS 0 100 0 0 0 1 /end COMPU_METHOD
/begin COMPU_METHOD InjTime_us "" RAT_FUNC "%6.3" "us" COEFFS 0 2.5 0 0 0 1 /end COMPU_METHOD
/begin COMPU_METHOD Kd "" RAT_FUNC "%7.6" "1/1" COEFFS 0 65536 0 0 0 1 /end COMPU_METHOD
/begin COMPU_METHOD Ki "" RAT_FUNC "%6.5" "1/s" COEFFS 0 2147.483648 0 0 0 1 /end COMPU_METHOD
/begin COMPU_METHOD Ki_ThrVlv "" RAT_FUNC "%6.4" "1/s" COEFFS 0 65 0 0 0 1 /end COMPU_METHOD
/begin COMPU_METHOD Kp "" RAT_FUNC "%7.6" "1/1" COEFFS 0 32768 0 0 0 1 /end COMPU_METHOD
/begin COMPU_METHOD Mass "" RAT_FUNC "%6.2" "-" COEFFS 0 1 0 0 0 1 /end COMPU_METHOD
/begin COMPU_METHOD MassLength "" RAT_FUNC "%6.3" "-" COEFFS 0 5 0 0 0 1 /end COMPU_METHOD
/begin COMPU_METHOD OneToOne "" RAT_FUNC "%6.2" "-" COEFFS 0 1 0 0 0 1 /end COMPU_METHOD
/begin COMPU_METHOD Period "" RAT_FUNC "%6.3" "ms" COEFFS 0 10 0 0 0 1 /end COMPU_METHOD
/begin COMPU_METHOD Prc "" RAT_FUNC "%6.4" "%" COEFFS 0 81.92 0 0 0 1 /end COMPU_METHOD
/begin COMPU_METHOD PresAC_hPa "" RAT_FUNC "%6.2" "hPa" COEFFS 0 0.5 0 0 0 1 /end COMPU_METHOD
/begin COMPU_METHOD Pres_hPa "" RAT_FUNC "%6.2" "hPa" COEFFS 0 1 0 0 0 1 /end COMPU_METHOD
/begin COMPU_METHOD Pres_Rail "" RAT_FUNC "%4.3" "bar" COEFFS 0 10.000000 0 0 0 1 /end COMPU_METHOD
/begin COMPU_METHOD Pwr2 "" RAT_FUNC "%6.1" "W" COEFFS 0 0.0530516476972949 0 0 0 1 /end COMPU_METHOD
/begin COMPU_METHOD RmpPrc "" RAT_FUNC "%6.5" "%/s" COEFFS 0 5368.70912 0 0 0 1 /end COMPU_METHOD
/begin COMPU_METHOD RmpTemp "" RAT_FUNC "%6.4" "K/s" COEFFS 0 655.36 0 0 0 1 /end COMPU_METHOD
/begin COMPU_METHOD RmpTrq "" RAT_FUNC "%6.4" "Nm/s" COEFFS 0 655.36 0 0 0 1 /end COMPU_METHOD
/begin COMPU_METHOD RmpTrqPrpHigh "" RAT_FUNC "%6.4" "Nm/s" COEFFS 0 655.36 0 0 0 1 /end COMPU_METHOD
/begin COMPU_METHOD SETPOINTCALC_TRQBASED_SY_Compu "" TAB_VERB "%6.3" "-" COMPU_TAB_REF SETPOINTCALC_TRQBASED_SY_Compu /end COMPU_METHOD
/begin COMPU_VTAB SETPOINTCALC_TRQBASED_SY_Compu "" TAB_VERB 2 0 "0" 1 "1" /end COMPU_VTAB
/begin COMPU_METHOD Signals_OneToOne "" RAT_FUNC "%6.2" "-" COEFFS 0 1 0 0 0 1 /end COMPU_METHOD
/begin COMPU_METHOD SqrVltg_s "" RAT_FUNC "%6.3" "V^2s" COEFFS 0 10 0 0 0 1 /end COMPU_METHOD
/begin COMPU_METHOD stroke_pml "" RAT_FUNC "%6.3" "1/ml" COEFFS 0 10 0 0 0 1 /end COMPU_METHOD
/begin COMPU_METHOD TempDiff_Cels "" RAT_FUNC "%6.2" "deg C" COEFFS 0 1 0 0 0 1 /end COMPU_METHOD
/begin COMPU_METHOD TempDiff_Kelv "" RAT_FUNC "%6.3" "K" COEFFS 0 10 0 0 0 1 /end COMPU_METHOD
/begin COMPU_METHOD Temp_Cels "" RAT_FUNC "%6.1" "deg C" COEFFS 0 10 2731.4 0 0 1 /end COMPU_METHOD
/begin COMPU_METHOD Temp_Fahr "" RAT_FUNC "%6.1" "deg F" COEFFS 0 5.55555555555556 2553.62222222222 0 0 1 /end COMPU_METHOD
/begin COMPU_METHOD TimeDeb "" RAT_FUNC "%6.1" "ms" COEFFS 0 0.1 0 0 0 1 /end COMPU_METHOD
/begin COMPU_METHOD TimeDelay_s "" RAT_FUNC "%12.4" "s" COEFFS 0 0 1 0 0.00023283064365387 0 /end COMPU_METHOD
/begin COMPU_METHOD Time_Dt "" RAT_FUNC "%9.8" "s" COEFFS 0 1000000 0 0 0 1 /end COMPU_METHOD
/begin COMPU_METHOD Time_ms "" RAT_FUNC "%6.1" "ms" COEFFS 0 0.1 0 0 0 1 /end COMPU_METHOD
/begin COMPU_METHOD Time_PwmHigh "" RAT_FUNC "%6.4" "us" COEFFS 0 20 0 0 0 1 /end COMPU_METHOD
/begin COMPU_METHOD Time_s "" RAT_FUNC "%6.4" "s" COEFFS 0 100 0 0 0 1 /end COMPU_METHOD
/begin COMPU_METHOD Time_s_1 "" RAT_FUNC "%6.5" "-" COEFFS 0 1000 0 0 0 1 /end COMPU_METHOD
/begin COMPU_METHOD TransR "" RAT_FUNC "%6.4" "-" COEFFS 0 100 0 0 0 1 /end COMPU_METHOD
/begin COMPU_METHOD Trq "" RAT_FUNC "%6.3" "Nm" COEFFS 0 10 0 0 0 1 /end COMPU_METHOD
/begin COMPU_METHOD TrqInrKd "" RAT_FUNC "%8.7" "%/Nm" COEFFS 0 655360 0 0 0 1 /end COMPU_METHOD
/begin COMPU_METHOD TrqPrp "" RAT_FUNC "%6.2" "Nm" COEFFS 0 0.625 0 0 0 1 /end COMPU_METHOD
/begin COMPU_METHOD TrqPrpHigh "" RAT_FUNC "%6.3" "Nm" COEFFS 0 10 0 0 0 1 /end COMPU_METHOD
/begin COMPU_METHOD Typ4WinDia "" TAB_VERB "%6.3" "-" COMPU_TAB_REF Typ4WinDia /end COMPU_METHOD
/begin COMPU_VTAB Typ4WinDia "" TAB_VERB 4 0 "4 Window diagnosis over PWM control line" 1 "4 Window diagnosis through Digital input" 2 "4 Window diagnosis over external interface" 3 "No 4 Window diagnosis." /end COMPU_VTAB
/begin COMPU_METHOD Vel "" RAT_FUNC "%6.4" "km/h" COEFFS 0 100 0 0 0 1 /end COMPU_METHOD
/begin COMPU_METHOD VelToN "" RAT_FUNC "%8.7" "(km/h)/rpm" COEFFS 0 100000 0 0 0 1 /end COMPU_METHOD
/begin COMPU_METHOD VlvVel "" RAT_FUNC "%6.3" "%/s" COEFFS 0 8.192 0 0 0 1 /end COMPU_METHOD
/begin COMPU_METHOD Volt "" RAT_FUNC "%6.3" "mV" COEFFS 0 5 0 0 0 1 /end COMPU_METHOD
/begin COMPU_METHOD Volt_Batt "" RAT_FUNC "%6.1" "mV" COEFFS 0 0.05 0 0 0 1 /end COMPU_METHOD
/begin COMPU_METHOD VSS_DistFac "" RAT_FUNC "%20.2" "Imp/m" COEFFS 0 0 1 0 1.38888888888889e-010 0 /end COMPU_METHOD
/begin COMPU_METHOD ZFC_BPfac "" RAT_FUNC "%6.4" "-" COEFFS 0 546.116666666667 0 0 0 1 /end COMPU_METHOD
/begin COMPU_METHOD ZFC_EvalEngSpd_Rslt "" TAB_VERB "%6.3" "-" COMPU_TAB_REF ZFC_EvalEngSpd_Rslt /end COMPU_METHOD
/begin COMPU_VTAB ZFC_EvalEngSpd_Rslt "" TAB_VERB 3 0 "ZFC_ST_ALL_INJ_LOW" 1 "ZFC_ST_DES_INJ_MAX" 2 "ZFC_ST_ERR_INJ_MAX" /end COMPU_VTAB
/begin COMPU_METHOD ZFC_Inj_State "" TAB_VERB "%6.3" "-" COMPU_TAB_REF ZFC_Inj_State /end COMPU_METHOD
/begin COMPU_VTAB ZFC_Inj_State "" TAB_VERB 5 0 "ZFC_ST_INJ_IDLE" 16 "ZFC_ST_INJ_DEM" 32 "ZFC_ST_INJ_PROG" 48 "ZFC_ST_INJ_RES_OK" 64 "ZFC_ST_INJ_RES_NOK" /end COMPU_VTAB
/begin COMPU_METHOD ZFC_PerHalfRatio "" RAT_FUNC "%6.4" "-" COEFFS 0 128 0 0 0 1 /end COMPU_METHOD
/begin COMPU_METHOD ZFC_State "" TAB_VERB "%6.3" "-" COMPU_TAB_REF ZFC_State /end COMPU_METHOD
/begin COMPU_VTAB ZFC_State "" TAB_VERB 8 1 "ZFC_ST_BREAK" 2 "ZFC_ST_WAIT" 3 "ZFC_ST_START_OVRRUN" 4 "ZFC_ST_CHANGE_PRAIL" 5 "ZFC_ST_CHECK_PRAIL" 6 "ZFC_ST_ETCLB" 7 "ZFC_ST_NVCLB" 16 "ZFC_ST_SUBS_FUNC" /end COMPU_VTAB
/begin COMPU_METHOD default "" RAT_FUNC "%6.2" "-" COEFFS 0 1 0 0 0 1 /end COMPU_METHOD
/begin RECORD_LAYOUT Axis_Xs16 NO_AXIS_PTS_X 1 SWORD AXIS_PTS_X 2 SWORD INDEX_INCR DIRECT /end RECORD_LAYOUT
/begin RECORD_LAYOUT Axis_Xu8 NO_AXIS_PTS_X 1 UBYTE AXIS_PTS_X 2 UBYTE INDEX_INCR DIRECT /end RECORD_LAYOUT
/begin RECORD_LAYOUT Cur_Xs16Ws16 NO_AXIS_PTS_X 1 SWORD AXIS_PTS_X 2 SWORD INDEX_INCR DIRECT FNC_VALUES 3 SWORD COLUMN_DIR DIRECT /end RECORD_LAYOUT
/begin RECORD_LAYOUT Kf_Xs16_Ys16_Ws16 NO_AXIS_PTS_X 1 SWORD NO_AXIS_PTS_Y 2 SWORD AXIS_PTS_X 3 SWORD INDEX_INCR DIRECT AXIS_PTS_Y 4 SWORD INDEX_INCR DIRECT FNC_VALUES 5 SWORD COLUMN_DIR DIRECT /end RECORD_LAYOUT
/begin RECORD_LAYOUT Kl_Xs16_Ws16 NO_AXIS_PTS_X 1 SWORD AXIS_PTS_X 2 SWORD INDEX_INCR DIRECT FNC_VALUES 3 SWORD COLUMN_DIR DIRECT /end RECORD_LAYOUT
/begin RECORD_LAYOUT Kw_Ws16 FNC_VALUES 1 SWORD COLUMN_DIR DIRECT /end RECORD_LAYOUT
/begin RECORD_LAYOUT Kw_Ws32 FNC_VALUES 1 SLONG COLUMN_DIR DIRECT /end RECORD_LAYOUT
/begin RECORD_LAYOUT Kw_Wu16 FNC_VALUES 1 UWORD COLUMN_DIR DIRECT /end RECORD_LAYOUT
/begin RECORD_LAYOUT Kw_Wu32 FNC_VALUES 1 ULONG COLUMN_DIR DIRECT /end RECORD_LAYOUT
/begin RECORD_LAYOUT Kw_Wu8 FNC_VALUES 1 UBYTE COLUMN_DIR DIRECT /end RECORD_LAYOUT
/begin RECORD_LAYOUT MapG_Ws16 FNC_VALUES 1 SWORD COLUMN_DIR DIRECT /end RECORD_LAYOUT
/begin RECORD_LAYOUT Map_Xs16Ys16Ws16 NO_AXIS_PTS_X 1 SWORD NO_AXIS_PTS_Y 2 SWORD AXIS_PTS_X 3 SWORD INDEX_INCR DIRECT AXIS_PTS_Y 4 SWORD INDEX_INCR DIRECT FNC_VALUES 5 SWORD COLUMN_DIR DIRECT /end RECORD_LAYOUT
/begin RECORD_LAYOUT ValA_Ws16 FNC_VALUES 1 SWORD COLUMN_DIR DIRECT /end RECORD_LAYOUT
/begin RECORD_LAYOUT ValA_Wu32 FNC_VALUES 1 ULONG COLUMN_DIR DIRECT /end RECORD_LAYOUT
/begin RECORD_LAYOUT ValA_Wu8 FNC_VALUES 1 UBYTE COLUMN_DIR DIRECT /end RECORD_LAYOUT
/begin RECORD_LAYOUT Val_Ws16 FNC_VALUES 1 SWORD COLUMN_DIR DIRECT /end RECORD_LAYOUT
/begin RECORD_LAYOUT Val_Ws32 FNC_VALUES 1 SLONG COLUMN_DIR DIRECT /end RECORD_LAYOUT
/begin RECORD_LAYOUT Val_Wu32 FNC_VALUES 1 ULONG COLUMN_DIR DIRECT /end RECORD_LAYOUT
/begin RECORD_LAYOUT Val_Wu8 FNC_VALUES 1 UBYTE COLUMN_DIR DIRECT /end RECORD_LAYOUT
/end MODULE
/end PROJECT
