ASAP2_VERSION 1 31
/begin PROJECT MS45 "BMW Motorsteuerung R6"
/begin HEADER "_default_HeaderComment" PROJECT_NO _52 /end HEADER
/begin MODULE _default_ModuleName "_default_ModuleLongIdentifier"
/begin MOD_COMMON "_default_ModCommonComment" DEPOSIT ABSOLUTE BYTE_ORDER MSB_FIRST ALIGNMENT_BYTE 1 ALIGNMENT_WORD 2 ALIGNMENT_LONG 4 ALIGNMENT_FLOAT32_IEEE 4 ALIGNMENT_FLOAT64_IEEE 8 /end MOD_COMMON
/begin MEASUREMENT LV_STATE_RR "Boolean for state of rough road detection (No : Yes)." UBYTE _CNV_S_2_RANGE______28_CM 1 100. 0. 1. ECU_ADDRESS 0x3fd031 /end MEASUREMENT
/begin MEASUREMENT SEG_T_MES_0_RR "Actual segment time measurement from the wheel speed signal." ULONG _CNV_A_R_LINEAR_____29_CM 1 100. 0. 4294967288. ECU_ADDRESS 0x3fe64c FORMAT "%10.0" /end MEASUREMENT
/begin MEASUREMENT SEG_T_MES_1_RR "Previous segment time measurement from the wheel speed signal." ULONG _CNV_A_R_LINEAR_____29_CM 1 100. 0. 4294967288. ECU_ADDRESS 0x3fe650 FORMAT "%10.0" /end MEASUREMENT
/begin MEASUREMENT WHEEL_GRD_MMV "Rough road value." UWORD _CNV_A_R_LINEAR_____30_CM 1 100. 0. 999.985 ECU_ADDRESS 0x3fe65c FORMAT "%6.2" /end MEASUREMENT
/begin MEASUREMENT WHEEL_GRD_MMV_THD "Threshold for rough road value" UWORD _CNV_A_R_LINEAR_____30_CM 1 100. 0. 999.985 ECU_ADDRESS 0x3fe65e FORMAT "%6.2" /end MEASUREMENT
/begin MEASUREMENT SUM_RR "Counter of rough road detection events." UWORD _CNV_A_R_LINEAR_____10_CM 1 100. 0. 65535. ECU_ADDRESS 0x3fe660 FORMAT "%5.0" /end MEASUREMENT
/begin CHARACTERISTIC C_VS_MIN_RR "Minimum vehicle speed for rough road detection." VALUE 0x42b3c _REC_VAL_20_u1 255. _CNV_A_R_LINEAR_____10_CM 0. 255. FORMAT "%3.0" /end CHARACTERISTIC
/begin CHARACTERISTIC C_VS_MAX_RR "Maximum vehicle speed for rough road detection." VALUE 0x42b30 _REC_VAL_20_u1 254. _CNV_A_R_LINEAR_____10_CM 1. 255. FORMAT "%3.0" /end CHARACTERISTIC
/begin CHARACTERISTIC C_WHEEL_GRD_CRLC_RR "Correlation factor for floating averaging of the rough road raw values" VALUE 0x431dc _REC_VAL_20_u2 0.99998474 _CNV_A_R_LINEAR_____31_CM 0. 0.99998474 FORMAT "%7.5" /end CHARACTERISTIC
/begin CHARACTERISTIC C_DLY_ER_RR "Fade out time for engine roughness after rough road detection" VALUE 0x42cc8 _REC_VAL_20_u2 655350. _CNV_A_R_LINEAR_____23_CM 0. 655350. FORMAT "%6.0" /end CHARACTERISTIC
/begin CHARACTERISTIC IP_WHEEL_GRD_MMV_THD_AT__VS "Threshold versus vehicle speed for rough road detection, automatic tzransmission" CURVE 0x4cb4c _REC_CUR_20_u2_u1 255. _CNV_A_R_LINEAR_____32_CM 0. 255. FORMAT "%6.2"
 /begin AXIS_DESCR COM_AXIS VS _CNV_A_R_LINEAR_____13_CM 9 0. 255. FORMAT "%3.0" AXIS_PTS_REF ldpm_vs_wheel_grd_mmv_thd /end AXIS_DESCR
/end CHARACTERISTIC
/begin CHARACTERISTIC IP_WHEEL_GRD_MMV_THD_MT__VS "Threshold versus vehicle speed for rough road detection, manual transmission" CURVE 0x4cb5e _REC_CUR_20_u2_u1 255. _CNV_A_R_LINEAR_____32_CM 0. 255. FORMAT "%6.2"
 /begin AXIS_DESCR COM_AXIS VS _CNV_A_R_LINEAR_____13_CM 9 0. 255. FORMAT "%3.0" AXIS_PTS_REF ldpm_vs_wheel_grd_mmv_thd /end AXIS_DESCR
/end CHARACTERISTIC
/begin AXIS_PTS ldpm_vs_wheel_grd_mmv_thd "" 0x440e0 VS _REC_AXS_20_u1 255. _CNV_A_R_LINEAR_____13_CM 9 0. 255. FORMAT "%3.0" /end AXIS_PTS
/begin MEASUREMENT LV_DUI_INJ_REQ "Double injection requested" UBYTE _CNV_S_2_RANGE______11_CM 1 100. 0. 1. ECU_ADDRESS 0x3fcec7 BIT_MASK 0x1 /end MEASUREMENT
/begin MEASUREMENT LV_CH_S_REQ "request bit to ask the comb.management for stratified combustion" UBYTE _CNV_S_2_RANGE______11_CM 1 100. 0. 1. ECU_ADDRESS 0x3fcec8 BIT_MASK 0x1 /end MEASUREMENT
/begin MEASUREMENT LV_T_TQI_SWI_SUPP "Request bit to suppress C_T_TQI_SWI for transition to Stratified mode" UBYTE _CNV_S_2_RANGE______11_CM 1 100. 0. 1. ECU_ADDRESS 0x3fcec6 BIT_MASK 0x1 /end MEASUREMENT
/begin CHARACTERISTIC C_TCO_DUI_MIN_ST "minimum temperature threshold for double injection" VALUE 0x42a4c _REC_VAL_20_u1 190.5 _CNV_A_R_LINEAR_____0_CM -48. 142.5 FORMAT "%5.1" /end CHARACTERISTIC
/begin CHARACTERISTIC C_TCO_DUI_MAX_ST "maximum temperature threshold for double injection" VALUE 0x42a4b _REC_VAL_20_u1 190.5 _CNV_A_R_LINEAR_____0_CM -48. 142.5 FORMAT "%5.1" /end CHARACTERISTIC
/begin CHARACTERISTIC C_TQI_DUI_THD "threshold for torque limitation for double injection" VALUE 0x4331c _REC_VAL_20_s2 2047.96875 _CNV_A_R_LINEAR_____48_CM -1024. 1023.96875 FORMAT "%8.2" /end CHARACTERISTIC
/begin CHARACTERISTIC C_CYC_CAST_DUI_THD "threshold for cycle counter limitation for double injection" VALUE 0x42cb0 _REC_VAL_20_u2 65535. _CNV_A_R_LINEAR_____10_CM 0. 65535. FORMAT "%5.0" /end CHARACTERISTIC
/begin CHARACTERISTIC C_OBD_STATE_1 "" VALUE 0x4297c _REC_VAL_20_u1 7. _CNV_A_R_LINEAR_____10_CM 0. 7. FORMAT "%2.0" /end CHARACTERISTIC
/begin CHARACTERISTIC C_OBD_STATE_2 "" VALUE 0x4297d _REC_VAL_20_u1 255. _CNV_A_R_LINEAR_____10_CM 0. 255. FORMAT "%3.0" /end CHARACTERISTIC
/begin CHARACTERISTIC LC_CLR_FMY "Boolean to clear failure memory when set to 1" VALUE 0x42b6a _REC_VAL_20_u1 1. _CNV_A_R_LINEAR_____10_CM 0. 1. FORMAT "%2.0" /end CHARACTERISTIC
/begin MEASUREMENT CTR_ERR_DYN_NR "" UBYTE _CNV_A_R_LINEAR_____10_CM 1 100. 0. 255. ECU_ADDRESS 0x3fd342 FORMAT "%3.0" /end MEASUREMENT
/begin MEASUREMENT LV_ERR_CAT_DIAG_1 "failure after filtering diagnosis value cat diag" UBYTE _CNV_S_2_RANGE______21_R_CM 1 100. 0. 255. ECU_ADDRESS 0x3fd5a7 /end MEASUREMENT
/begin MEASUREMENT LV_ERR_CAT_DIAG_2 "failure after filtering diagnosis value cat diag" UBYTE _CNV_S_2_RANGE______21_R_CM 1 100. 0. 255. ECU_ADDRESS 0x3fd5ab /end MEASUREMENT
/begin MEASUREMENT LV_ERR_LS_DOWN_SWT_1 "error bit for switchtime diagnosis" UBYTE _CNV_S_2_RANGE______21_R_CM 1 100. 0. 255. ECU_ADDRESS 0x3fd5af /end MEASUREMENT
/begin MEASUREMENT LV_ERR_LS_DOWN_SWT_2 "error bit for switchtime diagnosis" UBYTE _CNV_S_2_RANGE______21_R_CM 1 100. 0. 255. ECU_ADDRESS 0x3fd5b3 /end MEASUREMENT
/begin CHARACTERISTIC LC_CLR_HIS_FMY "Clearing the history memory" VALUE 0x42b6b _REC_VAL_20_u1 1. _CNV_A_R_LINEAR_____10_CM 0. 1. FORMAT "%2.0" /end CHARACTERISTIC
/begin MEASUREMENT CTR_ERR_HIS_NR "Number of failures in the history memory" UBYTE _CNV_A_R_LINEAR_____10_CM 1 100. 0. 255. ECU_ADDRESS 0x3feb3c FORMAT "%3.0" /end MEASUREMENT
/begin MEASUREMENT HIS_COD_1 "" UWORD _CNV_A_R_LINEAR_____10_CM 1 100. 0. 65535. ECU_ADDRESS 0x3feace FORMAT "%5.0" /end MEASUREMENT
/begin MEASUREMENT HIS_COD_2 "" UWORD _CNV_A_R_LINEAR_____10_CM 1 100. 0. 65535. ECU_ADDRESS 0x3fead0 FORMAT "%5.0" /end MEASUREMENT
/begin MEASUREMENT HIS_COD_3 "" UWORD _CNV_A_R_LINEAR_____10_CM 1 100. 0. 65535. ECU_ADDRESS 0x3fead2 FORMAT "%5.0" /end MEASUREMENT
/begin MEASUREMENT HIS_COD_4 "" UWORD _CNV_A_R_LINEAR_____10_CM 1 100. 0. 65535. ECU_ADDRESS 0x3fead4 FORMAT "%5.0" /end MEASUREMENT
/begin MEASUREMENT HIS_COD_5 "" UWORD _CNV_A_R_LINEAR_____10_CM 1 100. 0. 65535. ECU_ADDRESS 0x3fead6 FORMAT "%5.0" /end MEASUREMENT
/begin MEASUREMENT HIS_COD_6 "" UWORD _CNV_A_R_LINEAR_____10_CM 1 100. 0. 65535. ECU_ADDRESS 0x3fead8 FORMAT "%5.0" /end MEASUREMENT
/begin MEASUREMENT HIS_COD_7 "" UWORD _CNV_A_R_LINEAR_____10_CM 1 100. 0. 65535. ECU_ADDRESS 0x3feada FORMAT "%5.0" /end MEASUREMENT
/begin MEASUREMENT HIS_COD_8 "" UWORD _CNV_A_R_LINEAR_____10_CM 1 100. 0. 65535. ECU_ADDRESS 0x3feadc FORMAT "%5.0" /end MEASUREMENT
/begin MEASUREMENT HIS_COD_9 "" UWORD _CNV_A_R_LINEAR_____10_CM 1 100. 0. 65535. ECU_ADDRESS 0x3feade FORMAT "%5.0" /end MEASUREMENT
/begin MEASUREMENT HIS_COD_10 "" UWORD _CNV_A_R_LINEAR_____10_CM 1 100. 0. 65535. ECU_ADDRESS 0x3feae0 FORMAT "%5.0" /end MEASUREMENT
/begin MEASUREMENT REL_DIST_ACT_MIL "" ULONG _CNV_A_R_LINEAR_____6_CM 1 100. 0. 429496729500. ECU_ADDRESS 0x3feb48 FORMAT "%13.0" /end MEASUREMENT
/begin MEASUREMENT STATE_MIL "" UBYTE _CNV_S_3_RANGE_STAT_185_CM 1 100. 0. 2. ECU_ADDRESS 0x3fe899 /end MEASUREMENT
/begin MEASUREMENT REL_DIST_ACT_WAL_1 "" ULONG _CNV_A_R_LINEAR_____6_CM 1 100. 0. 429496729500. ECU_ADDRESS 0x3feb54 FORMAT "%13.0" /end MEASUREMENT
/begin MEASUREMENT REL_DIST_ACT_WAL_2 "" ULONG _CNV_A_R_LINEAR_____6_CM 1 100. 0. 429496729500. ECU_ADDRESS 0x3feb60 FORMAT "%13.0" /end MEASUREMENT
/begin MEASUREMENT LV_WAL_2 "" UBYTE _CNV_S_2_RANGE______186_R_CM 1 100. 0. 255. ECU_ADDRESS 0x3fe89c /end MEASUREMENT
/begin MEASUREMENT STATE_WAL_1 "" UBYTE _CNV_S_3_RANGE_STAT_185_CM 1 100. 0. 2. ECU_ADDRESS 0x3fe89b /end MEASUREMENT
/begin MEASUREMENT STATE_WAL_2 "" UBYTE _CNV_S_3_RANGE_STAT_185_CM 1 100. 0. 2. ECU_ADDRESS 0x3fe89d /end MEASUREMENT
/begin MEASUREMENT DIST_ACT_WAL_2 "" ULONG _CNV_A_R_LINEAR_____6_CM 1 100. 0. 429496729500. ECU_ADDRESS 0x3feb5c FORMAT "%13.0" /end MEASUREMENT
/begin MEASUREMENT DIST_ACT_WAL_1 "" ULONG _CNV_A_R_LINEAR_____6_CM 1 100. 0. 429496729500. ECU_ADDRESS 0x3feb50 FORMAT "%13.0" /end MEASUREMENT
/begin CHARACTERISTIC C_CONF_MIL "" VALUE 0x42812 _REC_VAL_20_u1 7. _CNV_A_R_LINEAR_____10_CM 0. 7. FORMAT "%1.0" /end CHARACTERISTIC
/begin CHARACTERISTIC C_CONF_WAL_1 "" VALUE 0x42815 _REC_VAL_20_u1 7. _CNV_A_R_LINEAR_____10_CM 0. 7. FORMAT "%1.0" /end CHARACTERISTIC
/begin CHARACTERISTIC C_CONF_WAL_2 "" VALUE 0x42816 _REC_VAL_20_u1 7. _CNV_A_R_LINEAR_____10_CM 0. 7. FORMAT "%1.0" /end CHARACTERISTIC
/begin CHARACTERISTIC LC_INH_WAL_ST "" VALUE 0x42ba1 _REC_VAL_20_u1 1. _CNV_A_R_LINEAR_____10_CM 0. 1. FORMAT "%2.0" /end CHARACTERISTIC
/begin MEASUREMENT DIST_ACT_MIL "" ULONG _CNV_A_R_LINEAR_____6_CM 1 100. 0. 429496729500. ECU_ADDRESS 0x3feb44 FORMAT "%13.0" /end MEASUREMENT
/begin CHARACTERISTIC C_DLY_WAL_ST "" VALUE 0x42881 _REC_VAL_20_u1 255. _CNV_A_R_LINEAR_____187_CM 0. 255. FORMAT "%3.0" /end CHARACTERISTIC
/begin CHARACTERISTIC C_DLY_INH_IV_MIS "Delay for MIL blinking in case of misfiring present failure with cylinder cut off" VALUE 0x4287f _REC_VAL_20_u1 255. _CNV_A_R_LINEAR_____187_CM 0. 255. FORMAT "%3.0" /end CHARACTERISTIC
/begin MEASUREMENT LV_MIL "" UBYTE _CNV_S_2_RANGE______186_R_CM 1 100. 0. 255. ECU_ADDRESS 0x3fe898 /end MEASUREMENT
/begin MEASUREMENT LV_WAL_1 "" UBYTE _CNV_S_2_RANGE______186_R_CM 1 100. 0. 255. ECU_ADDRESS 0x3fe89a /end MEASUREMENT
/begin MEASUREMENT LV_WAL_ST "Boolean indicating Pre-drive check mode (0 : off / 1 : on)" UBYTE _CNV_S_2_RANGE______28_CM 1 100. 0. 1. ECU_ADDRESS 0x3fe89e /end MEASUREMENT
/begin CHARACTERISTIC C_MAF_MAX "peak airflow of the engine" VALUE 0x42e68 _REC_VAL_20_u2 1389. _CNV_A_R_LINEAR_____95_CM 0. 1389. FORMAT "%7.2" /end CHARACTERISTIC
/begin CHARACTERISTIC C_MAF_SCDN_EQU "" VALUE 0x42e7c _REC_VAL_20_u2 1389. _CNV_A_R_LINEAR_____95_CM 0. 1389. FORMAT "%7.2" /end CHARACTERISTIC
/begin CHARACTERISTIC C_CTR_SCDN_EQU_DC_MAX "" VALUE 0x42872 _REC_VAL_20_u1 255. _CNV_A_R_LINEAR_____10_CM 0. 255. FORMAT "%3.0" /end CHARACTERISTIC
/begin CHARACTERISTIC C_N_SCDN_EQU "" VALUE 0x42ebc _REC_VAL_20_u2 8160. _CNV_A_R_LINEAR_____17_CM 0. 8160. FORMAT "%4.0" /end CHARACTERISTIC
/begin CHARACTERISTIC C_T_RAMP_LIM_I_DT_IS "Time constant for ramp limit of I-controller output in case of idle speed controller passive and drive train engaged" VALUE 0x4301a _REC_VAL_20_u2 1310.7 _CNV_A_R_LINEAR_____169_CM 0. 1310.7 FORMAT "%7.2" /end CHARACTERISTIC
/begin CHARACTERISTIC C_T_RAMP_LIM_I_IS "Time constant for ramp limit of I-controller output in case of idle speed controller passive" VALUE 0x4301c _REC_VAL_20_u2 1310.7 _CNV_A_R_LINEAR_____169_CM 0. 1310.7 FORMAT "%7.2" /end CHARACTERISTIC
/begin CHARACTERISTIC C_T_RAMP_LIM_P_D_DT_IS "Time constant for ramp limit of P-, D-controller output in case of idle speed controller passive and LV_DT=1" VALUE 0x4301e _REC_VAL_20_u2 655.35 _CNV_A_R_LINEAR_____27_CM 0. 655.35 FORMAT "%5.2" /end CHARACTERISTIC
/begin CHARACTERISTIC C_T_RAMP_LIM_P_D_IS "Time constant for ramp limit of P-, D-controller output in case of idle speed controller passive" VALUE 0x43020 _REC_VAL_20_u2 655.35 _CNV_A_R_LINEAR_____27_CM 0. 655.35 FORMAT "%5.2" /end CHARACTERISTIC
/begin CHARACTERISTIC C_TQ_BOL_I_DT_IS "Bottom limit for I-controller output and drive train closed" VALUE 0x432e0 _REC_VAL_20_s2 2047.96875 _CNV_A_R_LINEAR_____48_CM -1024. 1023.96875 FORMAT "%7.1" /end CHARACTERISTIC
/begin CHARACTERISTIC C_TQ_BOL_I_IS "Bottom limit for I-controller output" VALUE 0x432e2 _REC_VAL_20_s2 2047.96875 _CNV_A_R_LINEAR_____48_CM -1024. 1023.96875 FORMAT "%7.1" /end CHARACTERISTIC
/begin CHARACTERISTIC C_TQ_PAS_I_ACC_IS "Final passive value for I-controller output and air conditioning compressor active" VALUE 0x4330a _REC_VAL_20_s2 2047.96875 _CNV_A_R_LINEAR_____48_CM -1024. 1023.96875 FORMAT "%7.1" /end CHARACTERISTIC
/begin CHARACTERISTIC C_TQ_PAS_I_IS " Final passive value for I-controller output" VALUE 0x4330c _REC_VAL_20_s2 2047.96875 _CNV_A_R_LINEAR_____48_CM -1024. 1023.96875 FORMAT "%7.1" /end CHARACTERISTIC
/begin CHARACTERISTIC C_TQ_TOL_I_DT_IS "Top limit for I-controller output and drive train closed" VALUE 0x43310 _REC_VAL_20_s2 2047.96875 _CNV_A_R_LINEAR_____48_CM -1024. 1023.96875 FORMAT "%7.1" /end CHARACTERISTIC
/begin CHARACTERISTIC C_TQ_TOL_I_IS "Top limit for I-controller output" VALUE 0x43312 _REC_VAL_20_s2 2047.96875 _CNV_A_R_LINEAR_____48_CM -1024. 1023.96875 FORMAT "%7.1" /end CHARACTERISTIC
/begin CHARACTERISTIC IP_TQ_I_DT_IS "I-component for idle speed controller at closed drive train" CURVE 0x4bf2c _REC_CUR_20_u2_u2 7.99987793 _CNV_A_R_LINEAR_____212_CM -4. 3.99987793 FORMAT "%6.5"
 /begin AXIS_DESCR COM_AXIS N_DIF_COR _CNV_A_R_LINEAR_____213_CM 12 -32768. 32767. FORMAT "%6.0" AXIS_PTS_REF ldp_n_dif_cor__tq_i_dt_is /end AXIS_DESCR
/end CHARACTERISTIC
/begin MEASUREMENT TQ_DIF_P_D_SLOW_IS "TQ_DIF_P_D_IS for slow-path of torque coordination" SWORD _CNV_A_R_LINEAR_____48_CM 1 100. -1024. 1023.96875 ECU_ADDRESS 0x3fcf58 FORMAT "%6.2" /end MEASUREMENT
/begin MEASUREMENT TQ_DIF_P_D_IS "P- and D- controller output for idle speed control" SWORD _CNV_A_R_LINEAR_____48_CM 1 100. -1024. 1023.96875 ECU_ADDRESS 0x3fcf5e FORMAT "%6.2" /end MEASUREMENT
/begin MEASUREMENT TQ_DIF_P_D_FAST_IS "TQ_DIF_P_D_IS for fast-path of torque coordination" SWORD _CNV_A_R_LINEAR_____48_CM 1 100. -1024. 1023.96875 ECU_ADDRESS 0x3fcf5c FORMAT "%6.2" /end MEASUREMENT
/begin MEASUREMENT TQ_DIF_I_IS "I- controller output for idle speed control" SWORD _CNV_A_R_LINEAR_____48_CM 1 100. -1024. 1023.96875 ECU_ADDRESS 0x3fcf5a FORMAT "%6.2" /end MEASUREMENT
/begin MEASUREMENT TQ_ADD_I_IS "Incrememt of limited integrator" SWORD _CNV_A_R_LINEAR_____214_CM 1 100. -4. 3.99987793 ECU_ADDRESS 0x3fe4ec FORMAT "%7.4" /end MEASUREMENT
/begin CHARACTERISTIC IP_FAC_N_GRD_IS "Weighting factor N_GRD input for IP_P_D_IS" MAP 0x4e23b _REC_MAP_20_u1_u1_u2 1.9921875 _CNV_A_R_LINEAR_____103_CM 0. 1.9921875 FORMAT "%5.3"
 /begin AXIS_DESCR COM_AXIS TCO _CNV_A_R_LINEAR_____0_CM 8 -48. 142.5 FORMAT "%6.2" AXIS_PTS_REF ldp_tco__fac_n_grd_is /end AXIS_DESCR
 /begin AXIS_DESCR COM_AXIS T_AST _CNV_A_R_LINEAR_____14_CM 8 0. 6553.5 FORMAT "%5.1" AXIS_PTS_REF ldp_t_ast__fac_n_grd_is /end AXIS_DESCR
/end CHARACTERISTIC
/begin CHARACTERISTIC LC_TQ_DIF_I_INH_AS "Logical variable for ISCI I-part deactivation - default value at initialisation = 0" VALUE 0x42bd8 _REC_VAL_20_u1 1. _CNV_A_R_LINEAR_____12_CM 0. 1. FORMAT "%1.0" /end CHARACTERISTIC
/begin CHARACTERISTIC LC_TQ_DIF_P_D_INH_AS "Logical variable for deactivation of TQ_DIF_P_D_IS -default value at initialisation = 0" VALUE 0x42bd9 _REC_VAL_20_u1 1. _CNV_A_R_LINEAR_____12_CM 0. 1. FORMAT "%1.0" /end CHARACTERISTIC
/begin MEASUREMENT FAC_N_GRD_IS "Weighting factor for N_GRD input for IP_P_D_IS" UBYTE _CNV_A_R_LINEAR_____34_CM 1 100. 0. 1.99220002 ECU_ADDRESS 0x3fe4f5 FORMAT "%5.3" /end MEASUREMENT
/begin CHARACTERISTIC LC_N_GRD_FIL_P_D_INH_AS "Logical variable for switching between N_GRD and N_GRD_FIL_IS" VALUE 0x42bb8 _REC_VAL_20_u1 1. _CNV_A_R_LINEAR_____12_CM 0. 1. FORMAT "%1.0" /end CHARACTERISTIC
/begin CHARACTERISTIC LC_N_GRD_FIL_I_INH_AS "Logical variable for switching between N_GRD and N_GRD_FIL" VALUE 0x42bb7 _REC_VAL_20_u1 1. _CNV_A_R_LINEAR_____12_CM 0. 1. FORMAT "%1.0" /end CHARACTERISTIC
/begin MEASUREMENT N_GRD_FIL_IS "Filtered engine speed gradient for ISC" SBYTE _CNV_A_R_LINEAR_____215_CM 1 100. -4096. 4064. ECU_ADDRESS 0x3fe4f2 FORMAT "%4.0" /end MEASUREMENT
/begin MEASUREMENT N_GRD_P_D_IS "Filtered gradient for PD-part" SBYTE _CNV_A_R_LINEAR_____215_CM 1 100. -4096. 4064. ECU_ADDRESS 0x3fe4f3 FORMAT "%5.0" /end MEASUREMENT
/begin MEASUREMENT N_GRD_I_IS "Filtered gradient for I-part" SBYTE _CNV_A_R_LINEAR_____215_CM 1 100. -4096. 4064. ECU_ADDRESS 0x3fe4f7 FORMAT "%5.0" /end MEASUREMENT
/begin CHARACTERISTIC C_CRLC_N_GRD "Filter correlation constant" VALUE 0x42c7a _REC_VAL_20_u2 0.99998474 _CNV_A_R_LINEAR_____31_CM 0. 0.99998474 FORMAT "%7.5" /end CHARACTERISTIC
/begin CHARACTERISTIC ID_FAC_P_D_DT_IS "Weighting factor for IP_P_D_DT_IS" CURVE 0x45752 _REC_CUR_20_u2_u1 1.99996948 _CNV_A_R_LINEAR_____45_CM 0. 1.99996948 FORMAT "%7.5"
 /begin AXIS_DESCR COM_AXIS GR_MT _CNV_A_R_LINEAR_____10_CM 8 0. 255. FORMAT "%3.0" AXIS_PTS_REF ldpm_gr_mt_2 /end AXIS_DESCR
/end CHARACTERISTIC
/begin CHARACTERISTIC IP_FAC_P_D_FAST_TCO_IS "TCO depending factor foe fast-path of torque coordination" CURVE 0x4761c _REC_CUR_20_u2_u1 1.99996948 _CNV_A_R_LINEAR_____45_CM 0. 1.99996948 FORMAT "%7.5"
 /begin AXIS_DESCR COM_AXIS TCO _CNV_A_R_LINEAR_____0_CM 8 -48. 142.5 FORMAT "%5.1" AXIS_PTS_REF ldpm_tco_is_1 /end AXIS_DESCR
/end CHARACTERISTIC
/begin CHARACTERISTIC IP_FAC_P_D_SLOW_TCO_IS "TCO depending factor foe slow-path of torque coordination" CURVE 0x4762c _REC_CUR_20_u2_u1 1.99996948 _CNV_A_R_LINEAR_____45_CM 0. 1.99996948 FORMAT "%7.5"
 /begin AXIS_DESCR COM_AXIS TCO _CNV_A_R_LINEAR_____0_CM 8 -48. 142.5 FORMAT "%5.1" AXIS_PTS_REF ldpm_tco_is_1 /end AXIS_DESCR
/end CHARACTERISTIC
/begin MEASUREMENT LV_TQ_P_D_ACT "Logical variable P_D-Controller output is active" UBYTE _CNV_S_2_RANGE______28_CM 1 100. 0. 1. ECU_ADDRESS 0x3fe4f8 BIT_MASK 0x1 /end MEASUREMENT
/begin MEASUREMENT LV_PAS_RAMP_ACT_P_D_IS "Logical value for PD-part passive ramp active" UBYTE _CNV_S_2_RANGE______28_CM 1 100. 0. 1. ECU_ADDRESS 0x3fcf61 /end MEASUREMENT
/begin MEASUREMENT LV_PAS_RAMP_ACT_I_IS "Logical value for I-part passive ramp active" UBYTE _CNV_S_2_RANGE______28_CM 1 100. 0. 1. ECU_ADDRESS 0x3fcf60 /end MEASUREMENT
/begin MEASUREMENT TQ_DIF_P_D_DT_IS_1 "P_D_DT Controler output weighted  for certain gear-ratio" SWORD _CNV_A_R_LINEAR_____48_CM 1 100. -1024. 1023.96875 ECU_ADDRESS 0x3fe4e4 FORMAT "%6.2" /end MEASUREMENT
/begin MEASUREMENT TQ_ADD_P_D_RAMP "Increment of the PD-part ramps" SWORD _CNV_A_R_LINEAR_____48_CM 1 100. -1024. 1023.96875 ECU_ADDRESS 0x3fe4e2 FORMAT "%6.2" /end MEASUREMENT
/begin MEASUREMENT TQ_ADD_I_RAMP "Increment of the I-part ramps" SWORD _CNV_A_R_LINEAR_____48_CM 1 100. -1024. 1023.96875 ECU_ADDRESS 0x3fe4ee FORMAT "%6.2" /end MEASUREMENT
/begin MEASUREMENT STATE_P_D_ISC "State of the PD-part: P_D_PASSIVE, P_D_NORMAL, RAMP_TO_ZERO" UBYTE _CNV_S_3_STATE_P_D__216_CM 1 100. 0. 2. ECU_ADDRESS 0x3fe4f4 /end MEASUREMENT
/begin MEASUREMENT STATE_I_ISC "State of the integral part: I_PASSIVE, I_NORMAL, RAMP_TO_PAS, RAMP_TO_LIM" UBYTE _CNV_S_4_STATE_I_IS_217_CM 1 100. 0. 3. ECU_ADDRESS 0x3fe4f6 /end MEASUREMENT
/begin CHARACTERISTIC IP_P_D_DT_IS "P- and D-component for idle speed controller at closed drive train" MAP 0x49b00 _REC_MAP_20_u2_u2_u1 2047.96875 _CNV_A_R_LINEAR_____218_CM -1024. 1023.96875 FORMAT "%6.2"
 /begin AXIS_DESCR COM_AXIS N_DIF_COR _CNV_A_R_LINEAR_____213_CM 12 -32768. 32767. FORMAT "%6.0" AXIS_PTS_REF ldp_n_dif_cor_p_d_dt_is /end AXIS_DESCR
 /begin AXIS_DESCR COM_AXIS N_GRD _CNV_A_R_LINEAR_____219_CM 8 -4096. 4064. FORMAT "%5.0" AXIS_PTS_REF ldp_n_grd_p_d_dt_is /end AXIS_DESCR
/end CHARACTERISTIC
/begin CHARACTERISTIC IP_P_D_IS "P- and D-component for idle speed controller at open drive train" MAP 0x49bc0 _REC_MAP_20_u2_u2_u1 2047.96875 _CNV_A_R_LINEAR_____218_CM -1024. 1023.96875 FORMAT "%6.2"
 /begin AXIS_DESCR COM_AXIS N_DIF_COR _CNV_A_R_LINEAR_____213_CM 12 -32768. 32767. FORMAT "%6.0" AXIS_PTS_REF ldp_n_dif_cor_p_d_is /end AXIS_DESCR
 /begin AXIS_DESCR COM_AXIS N_GRD _CNV_A_R_LINEAR_____219_CM 8 -4096. 4064. FORMAT "%5.0" AXIS_PTS_REF ldp_n_grd_p_d_is /end AXIS_DESCR
/end CHARACTERISTIC
/begin CHARACTERISTIC IP_TQ_I_IS "I-component for idle speed controller at open drive train" MAP 0x4bf44 _REC_MAP_20_u2_u2_u1 7.99987793 _CNV_A_R_LINEAR_____212_CM -4. 3.99987793 FORMAT "%5.4"
 /begin AXIS_DESCR COM_AXIS N_DIF_COR _CNV_A_R_LINEAR_____213_CM 12 -32768. 32767. FORMAT "%6.0" AXIS_PTS_REF ldp_n_dif_cor_tq_i_is /end AXIS_DESCR
 /begin AXIS_DESCR COM_AXIS N_GRD _CNV_A_R_LINEAR_____219_CM 8 -4096. 4064. FORMAT "%5.0" AXIS_PTS_REF ldp_n_grd_tq_i_is /end AXIS_DESCR
/end CHARACTERISTIC
/begin CHARACTERISTIC LC_TQ_P_D_SLOW_INH_AS "Logical variable for deactivation of TQ_DIF_P_D_IS - default value at initialisation = 0" VALUE 0x42be7 _REC_VAL_20_u1 1. _CNV_A_R_LINEAR_____12_CM 0. 1. FORMAT "%1.0" /end CHARACTERISTIC
/begin CHARACTERISTIC LC_ISC_INH "Bit for inhibiting the PD- and integral part - default value = 0" VALUE 0x42ba6 _REC_VAL_20_u1 1. _CNV_A_R_LINEAR_____12_CM 0. 1. FORMAT "%1.0" /end CHARACTERISTIC
/begin CHARACTERISTIC LC_TQ_ADD_I_INH_AS "Logical variable for ISC I-part map output deactivation - default value at initialisation = 0" VALUE 0x42bd5 _REC_VAL_20_u1 1. _CNV_A_R_LINEAR_____12_CM 0. 1. FORMAT "%1.0" /end CHARACTERISTIC
/begin AXIS_PTS ldp_n_dif_cor__tq_i_dt_is "" 0x44832 N_DIF_COR _REC_AXS_20_u2 65535. _CNV_A_R_LINEAR_____213_CM 12 -32768. 32767. FORMAT "%6.0" /end AXIS_PTS
/begin AXIS_PTS ldp_n_dif_cor_p_d_dt_is "" 0x4484c N_DIF_COR _REC_AXS_20_u2 65535. _CNV_A_R_LINEAR_____213_CM 12 -32768. 32767. FORMAT "%6.0" /end AXIS_PTS
/begin AXIS_PTS ldp_n_dif_cor_p_d_is "" 0x44866 N_DIF_COR _REC_AXS_20_u2 65535. _CNV_A_R_LINEAR_____213_CM 12 -32768. 32767. FORMAT "%6.0" /end AXIS_PTS
/begin AXIS_PTS ldp_n_dif_cor_tq_i_is "" 0x44880 N_DIF_COR _REC_AXS_20_u2 65535. _CNV_A_R_LINEAR_____213_CM 12 -32768. 32767. FORMAT "%6.0" /end AXIS_PTS
/begin AXIS_PTS ldp_n_grd_p_d_dt_is "" 0x4373d N_GRD _REC_AXS_20_u1 8160. _CNV_A_R_LINEAR_____219_CM 8 -4096. 4064. FORMAT "%5.0" /end AXIS_PTS
/begin AXIS_PTS ldp_n_grd_p_d_is "" 0x43746 N_GRD _REC_AXS_20_u1 8160. _CNV_A_R_LINEAR_____219_CM 8 -4096. 4064. FORMAT "%5.0" /end AXIS_PTS
/begin AXIS_PTS ldp_n_grd_tq_i_is "" 0x4374f N_GRD _REC_AXS_20_u1 8160. _CNV_A_R_LINEAR_____219_CM 8 -4096. 4064. FORMAT "%5.0" /end AXIS_PTS
/begin AXIS_PTS ldp_t_ast__fac_n_grd_is "" 0x44a40 T_AST _REC_AXS_20_u2 6553.5 _CNV_A_R_LINEAR_____14_CM 8 0. 6553.5 FORMAT "%5.1" /end AXIS_PTS
/begin AXIS_PTS ldp_tco__fac_n_grd_is "" 0x4384d TCO _REC_AXS_20_u1 190.5 _CNV_A_R_LINEAR_____0_CM 8 -48. 142.5 FORMAT "%6.2" /end AXIS_PTS
/begin AXIS_PTS ldpm_tco_is_1 "" 0x43fe7 TCO _REC_AXS_20_u1 190.5 _CNV_A_R_LINEAR_____0_CM 8 -48. 142.5 FORMAT "%5.1" /end AXIS_PTS
/begin AXIS_PTS ldpm_gr_mt_2 "" 0x43c0e GR_MT _REC_AXS_20_u1 255. _CNV_A_R_LINEAR_____10_CM 8 0. 255. FORMAT "%3.0" /end AXIS_PTS
/begin MEASUREMENT LV_REQ_ISC "Logical variable for idle speed controller activatIon request" UBYTE _CNV_S_2_RANGE______28_CM 1 100. 0. 1. ECU_ADDRESS 0x3fcf80 BIT_MASK 0x1 /end MEASUREMENT
/begin MEASUREMENT STATE_REQ_ISC "actual state for ISC request" UBYTE _CNV_S_4_STATE_REQ__220_CM 1 100. 0. 3. ECU_ADDRESS 0x3fe509 /end MEASUREMENT
/begin MEASUREMENT LV_NEG_N_GRD_FIL_MEM "Memory bit for falling gradient after start" UBYTE _CNV_S_2_RANGE______28_CM 1 100. 0. 1. ECU_ADDRESS 0x3fe50c /end MEASUREMENT
/begin MEASUREMENT N_GRD_FIL_ISC_ACT_AST "Filtered gradient for ISC after start activation" SBYTE _CNV_A_R_LINEAR_____215_CM 1 100. -4096. 4064. ECU_ADDRESS 0x3fe508 FORMAT "%5.0" /end MEASUREMENT
/begin CHARACTERISTIC LC_ISC_ACT_CDN_SWI "Calibratible logical bit for switching between different activation conditions " VALUE 0x42ba5 _REC_VAL_20_u1 1. _CNV_A_R_LINEAR_____10_CM 0. 1. FORMAT "%2.0" /end CHARACTERISTIC
/begin CHARACTERISTIC LC_ISC_ACT_AST_CDN_SWI "Switch for using different after start ISC activation conditions" VALUE 0x42ba4 _REC_VAL_20_u1 1. _CNV_A_R_LINEAR_____10_CM 0. 1. FORMAT "%2.0" /end CHARACTERISTIC
/begin CHARACTERISTIC C_N_DIF_ISC_ACT_AST "Additive term to define the low limit for ISC activation after start" VALUE 0x432aa _REC_VAL_20_s2 65535. _CNV_A_R_LINEAR_____17_CM -32768. 32767. FORMAT "%6.0" /end CHARACTERISTIC
/begin CHARACTERISTIC C_CRLC_N_GRD_FIL_ISC_ACT_AST "Filter correlation factor for speed gradient filtering in connection with after start activation of ISC" VALUE 0x42c80 _REC_VAL_20_u2 0.99998474 _CNV_A_R_LINEAR_____31_CM 0. 0.99998474 FORMAT "%7.5" /end CHARACTERISTIC
/begin CHARACTERISTIC C_T_DLY_ISC_ACT_PU "Time limit for ISC activation in PU" VALUE 0x42f8c _REC_VAL_20_u2 655.35 _CNV_A_R_LINEAR_____27_CM 0. 655.35 FORMAT "%6.2" /end CHARACTERISTIC
/begin MEASUREMENT N_DIF_OFS_PRED "Predicted engine speed difference for torque reserve calculation" SWORD _CNV_A_R_LINEAR_____17_CM 1 100. -32768. 32767. ECU_ADDRESS 0x3fe4fc FORMAT "%6.0" /end MEASUREMENT
/begin MEASUREMENT T_N_DIF_OFS_PRED "Prediction time for engine speed difference" UBYTE _CNV_A_R_LINEAR_____221_CM 1 100. 0. 7.96875 ECU_ADDRESS 0x3fe4fe FORMAT "%4.2" /end MEASUREMENT
/begin CHARACTERISTIC IP_T_N_DIF_OFS_PRED__N "Time constant for calculation of predicted engine speed deviation" CURVE 0x506f6 _REC_CUR_20_u1_u2 7.96875 _CNV_A_R_LINEAR_____221_CM 0. 7.96875 FORMAT "%4.2"
 /begin AXIS_DESCR COM_AXIS N _CNV_A_R_LINEAR_____17_CM 8 0. 8160. FORMAT "%4.0" AXIS_PTS_REF ldp_n_t_n_dif_ofs_pred /end AXIS_DESCR
/end CHARACTERISTIC
/begin MEASUREMENT N_DIF_PRED "Predicted idle speed control variable" SWORD _CNV_A_R_LINEAR_____17_CM 1 100. -32768. 32767. ECU_ADDRESS 0x3fe4fa FORMAT "%6.0" /end MEASUREMENT
/begin MEASUREMENT TQ_ADD_IS_BOL "Torque reserve ad idle due to deviation of engine speed to set point at idle" SWORD _CNV_A_R_LINEAR_____48_CM 1 100. -1024. 1023.96875 ECU_ADDRESS 0x3fcf62 FORMAT "%8.2" /end MEASUREMENT
/begin MEASUREMENT TQ_DIF_ADD_IS_TOL "Idle speed torque reserve limitation for stabilization the ISC at high torque reserves" SWORD _CNV_A_R_LINEAR_____48_CM 1 100. -1024. 1023.96875 ECU_ADDRESS 0x3fcf64 FORMAT "%8.2" /end MEASUREMENT
/begin CHARACTERISTIC IP_TQ_ADD_IS_BOL__N_DIF_PRED "Torque reserve at idle due to a deviation of engine speed to set point at idle" CURVE 0x4be30 _REC_CUR_20_u2_u2 1023.96875 _CNV_A_R_LINEAR_____48_CM 0. 1023.96875 FORMAT "%7.2"
 /begin AXIS_DESCR COM_AXIS N_DIF_PRED _CNV_A_R_LINEAR_____213_CM 8 -32768. 32767. FORMAT "%6.0" AXIS_PTS_REF ldp_n_dif_pred_tq_add_is_bol /end AXIS_DESCR
/end CHARACTERISTIC
/begin CHARACTERISTIC C_TQ_ADD_IS_BOL_CRLC "Filter constant for torque reserve" VALUE 0x42ada _REC_VAL_20_u1 0.9960940000000002 _CNV_A_R_LINEAR_____44_CM 0. 0.996094 FORMAT "%5.3" /end CHARACTERISTIC
/begin CHARACTERISTIC C_TQ_DIF_ADD_IS_TOL "Idle speed torque reserve limitation for stabilizing the ISC at high torque reserve" VALUE 0x430f4 _REC_VAL_20_u2 1023.96875 _CNV_A_R_LINEAR_____48_CM 0. 1023.96875 FORMAT "%7.2" /end CHARACTERISTIC
/begin AXIS_PTS ldp_n_t_n_dif_ofs_pred "" 0x44952 N _REC_AXS_20_u2 8160. _CNV_A_R_LINEAR_____17_CM 8 0. 8160. FORMAT "%4.0" /end AXIS_PTS
/begin AXIS_PTS ldp_n_dif_pred_tq_add_is_bol "" 0x448ac N_DIF_PREF _REC_AXS_20_u2 65535. _CNV_A_R_LINEAR_____213_CM 8 -32768. 32767. FORMAT "%6.0" /end AXIS_PTS
/begin CHARACTERISTIC C_FAC_TQ_IS_AD_CONV_MAX "Max. limitation for converter torque Adaptation factor" VALUE 0x43250 _REC_VAL_20_s2 4.879900000000001e-004 _CNV_A_R_LINEAR_____222_CM -2.44e-004 2.4399e-004 FORMAT "%10.9" /end CHARACTERISTIC
/begin CHARACTERISTIC C_FAC_TQ_IS_AD_CONV_MIN "Min. limitation of converter torque Adaptation factor" VALUE 0x43252 _REC_VAL_20_s2 4.879900000000001e-004 _CNV_A_R_LINEAR_____222_CM -2.44e-004 2.4399e-004 FORMAT "%10.9" /end CHARACTERISTIC
/begin CHARACTERISTIC C_TQ_IS_AD_ACC_MIN "Min. limitation for ACC Adaptation" VALUE 0x432fa _REC_VAL_20_s2 2047.96875 _CNV_A_R_LINEAR_____48_CM -1024. 1023.96875 FORMAT "%7.1" /end CHARACTERISTIC
/begin CHARACTERISTIC C_TQ_IS_AD_MAX "Max. limitation of engine torque losses Adaptation" VALUE 0x43300 _REC_VAL_20_s2 2047.96875 _CNV_A_R_LINEAR_____48_CM -1024. 1023.96875 FORMAT "%7.1" /end CHARACTERISTIC
/begin CHARACTERISTIC C_TQ_IS_AD_MIN "Min. limitation of engine torque losses Adaptation" VALUE 0x43302 _REC_VAL_20_s2 2047.96875 _CNV_A_R_LINEAR_____48_CM -1024. 1023.96875 FORMAT "%7.1" /end CHARACTERISTIC
/begin MEASUREMENT FAC_TQ_IS_AD_CONV "Converter torque Adaptation factor" SWORD _CNV_A_R_LINEAR_____223_CM 1 100. -2.4414e-004 2.4414e-004 ECU_ADDRESS 0x3fcf7a FORMAT "%9.8" /end MEASUREMENT
/begin CHARACTERISTIC C_FAC_TQ_IS_AD_ACC "Calibration parameter, LV_ACC=1" VALUE 0x42d3e _REC_VAL_20_u2 0.99998474 _CNV_A_R_LINEAR_____31_CM 0. 0.99998474 FORMAT "%7.5" /end CHARACTERISTIC
/begin CHARACTERISTIC C_FAC_TQ_IS_AD_CONV "Calibration parameter, LV_ACC=0, LV_DRI=1" VALUE 0x42d42 _REC_VAL_20_u2 4.88e-004 _CNV_A_R_LINEAR_____224_CM 0. 4.88e-004 FORMAT "%10.9" /end CHARACTERISTIC
/begin CHARACTERISTIC C_FAC_TQ_IS_AD_ACC_CONV "Calibration parameter, LV_ACC=1, LV_DRI=1" VALUE 0x42d40 _REC_VAL_20_u2 0.99998474 _CNV_A_R_LINEAR_____31_CM 0. 0.99998474 FORMAT "%7.5" /end CHARACTERISTIC
/begin CHARACTERISTIC C_TQ_IS_AD_ACC_MAX "Max. limitation for ACC torque Adaptation" VALUE 0x432f8 _REC_VAL_20_s2 2047.96875 _CNV_A_R_LINEAR_____48_CM -1024. 1023.96875 FORMAT "%7.1" /end CHARACTERISTIC
/begin CHARACTERISTIC C_TQ_IS_AD_ACC_CONV_MAX "Max. limitation of air conditioning compressor and converter  torque Adaptation" VALUE 0x432f4 _REC_VAL_20_s2 2047.96875 _CNV_A_R_LINEAR_____48_CM -1024. 1023.96875 FORMAT "%7.1" /end CHARACTERISTIC
/begin CHARACTERISTIC C_TQ_IS_AD_ACC_CONV_MIN "Min. limitation of air conditioning compressor and converter  torque Adaptation" VALUE 0x432f6 _REC_VAL_20_s2 2047.96875 _CNV_A_R_LINEAR_____48_CM -1024. 1023.96875 FORMAT "%7.1" /end CHARACTERISTIC
/begin MEASUREMENT TQ_DIF_IS_AD_ACC_1 "ACC torque Adaptation" SWORD _CNV_A_R_LINEAR_____48_CM 1 100. -1024. 1023.96875 ECU_ADDRESS 0x3fe502 FORMAT "%6.2" /end MEASUREMENT
/begin MEASUREMENT TQ_DIF_IS_AD_ACC_CONV "ACC and converter torque Adaptation" SWORD _CNV_A_R_LINEAR_____48_CM 1 100. -1024. 1023.96875 ECU_ADDRESS 0x3fe500 FORMAT "%6.2" /end MEASUREMENT
/begin MEASUREMENT TQ_DIF_IS_AD "Basic ISC Adaptation" SWORD _CNV_A_R_LINEAR_____48_CM 1 100. -1024. 1023.96875 ECU_ADDRESS 0x3fcf78 FORMAT "%6.2" /end MEASUREMENT
/begin MEASUREMENT TQ_DIF_IS_AD_INTER "Basic ISC Adaptation, inetmediate value with high resolution (long signed word)" SLONG _CNV_A_R_LINEAR_____225_CM 1 100. -1024. 1023.99999952 ECU_ADDRESS 0x3fcf68 FORMAT "%12.7" /end MEASUREMENT
/begin MEASUREMENT TQ_DIF_IS_AD_ACC_1_INTER "Torque ACC Adaptation, inetmediate value with high resolution (long signed word)" SLONG _CNV_A_R_LINEAR_____225_CM 1 100. -1024. 1023.99999952 ECU_ADDRESS 0x3fcf6c FORMAT "%12.7" /end MEASUREMENT
/begin MEASUREMENT TQ_DIF_IS_AD_ACC_CONV_INTER "ACC and torque Adaptation, inetmediate value with high resolution (long signed word)" SLONG _CNV_A_R_LINEAR_____225_CM 1 100. -1024. 1023.99999952 ECU_ADDRESS 0x3fcf70 FORMAT "%12.7" /end MEASUREMENT
/begin CHARACTERISTIC C_FAC_TQ_IS_AD "Calibration parameter, LV_ACC=0, LV_DRI=0" VALUE 0x42d3c _REC_VAL_20_u2 0.99998474 _CNV_A_R_LINEAR_____31_CM 0. 0.99998474 FORMAT "%7.5" /end CHARACTERISTIC
/begin MEASUREMENT TQ_DIF_IS_AD_ACC "Low-pass filtered ACC torque Adaptation or ACC and converter torque Adaptation" SWORD _CNV_A_R_LINEAR_____48_CM 1 100. -1024. 1023.96875 ECU_ADDRESS 0x3fcf7c FORMAT "%6.2" /end MEASUREMENT
/begin CHARACTERISTIC C_CRLC_TQ_DIF_IS_AD_ACC "Filter constant for LOW_PASS_1" VALUE 0x4283c _REC_VAL_20_u1 0.9960940000000002 _CNV_A_R_LINEAR_____44_CM 0. 0.996094 FORMAT "%5.3" /end CHARACTERISTIC
/begin CHARACTERISTIC C_FAC_TQ_IS_AD_CONV_CAN "Calibration parameter, LV_ACC = 0 AND LV_DRI= 1" VALUE 0x42d44 _REC_VAL_20_u2 0.99998474 _CNV_A_R_LINEAR_____31_CM 0. 0.99998474 FORMAT "%7.5" /end CHARACTERISTIC
/begin MEASUREMENT TQ_DIF_IS_AD_CONV "Converter torque Adaptation" SWORD _CNV_A_R_LINEAR_____48_CM 1 100. -1024. 1023.96875 ECU_ADDRESS 0x3fcf7e FORMAT "%8.2" /end MEASUREMENT
/begin MEASUREMENT TQ_DIF_IS_AD_CONV_INTER "Converter torque Adaptation, intermediate value with high resolution (long signed word)" SLONG _CNV_A_R_LINEAR_____225_CM 1 100. -1024. 1023.99999952 ECU_ADDRESS 0x3fcf74 FORMAT "%12.7" /end MEASUREMENT
/begin CHARACTERISTIC C_TQ_IS_AD_CONV_CAN_MIN "Min. limitation converter torque adaptation" VALUE 0x432fe _REC_VAL_20_s2 2047.96875 _CNV_A_R_LINEAR_____48_CM -1024. 1023.96875 FORMAT "%8.2" /end CHARACTERISTIC
/begin CHARACTERISTIC C_TQ_IS_AD_CONV_CAN_MAX "Max. limitation converter torque adaptation" VALUE 0x432fc _REC_VAL_20_s2 2047.96875 _CNV_A_R_LINEAR_____48_CM -1024. 1023.96875 FORMAT "%8.2" /end CHARACTERISTIC
/begin CHARACTERISTIC C_N_DELTA "engine speed threshold for ISC Adaptation" VALUE 0x42e9c _REC_VAL_20_u2 8160. _CNV_A_R_LINEAR_____17_CM 0. 8160. FORMAT "%4.0" /end CHARACTERISTIC
/begin CHARACTERISTIC C_TCO_AD_MIN_IS "temperature bottom limit for ISC Adaptation" VALUE 0x42a42 _REC_VAL_20_u1 28.575 _CNV_A_R_LINEAR_____0_CM -48. 142.5 FORMAT "%5.1" /end CHARACTERISTIC
/begin MEASUREMENT LV_IS_AD_CND "Adaptation Condition" UBYTE _CNV_S_2_RANGE______28_CM 1 100. 0. 1. ECU_ADDRESS 0x3fcf52 BIT_MASK 0x1 /end MEASUREMENT
/begin MEASUREMENT LV_TCO_AD_CND_IS "Logical bit \"Coolant temperature in operating range\"" UBYTE _CNV_S_2_RANGE______28_CM 1 100. 0. 1. ECU_ADDRESS 0x3fcf53 /end MEASUREMENT
/begin MEASUREMENT LV_DLY_AD_IS "Logical bit \"Idle speed has settled for a given time delay\"" UBYTE _CNV_S_2_RANGE______28_CM 1 100. 0. 1. ECU_ADDRESS 0x3fcf54 /end MEASUREMENT
/begin CHARACTERISTIC C_TCO_AD_MAX_IS "temperature top limit for ISC Adaptation" VALUE 0x42a41 _REC_VAL_20_u1 28.575 _CNV_A_R_LINEAR_____0_CM -48. 142.5 FORMAT "%5.1" /end CHARACTERISTIC
/begin MEASUREMENT LV_IS_AD_INH_OBD "Application incidence value" UBYTE _CNV_S_2_RANGE______28_CM 1 100. 0. 1. ECU_ADDRESS 0x3fcf55 /end MEASUREMENT
/begin MEASUREMENT LV_IS_AD_INH "Application incidence value (additional adaptation conditions, project specific)" UBYTE _CNV_S_2_RANGE______28_CM 1 100. 0. 1. ECU_ADDRESS 0x3fcf56 /end MEASUREMENT
/begin MEASUREMENT T_MFF_AD_MIN "Time indicating the minimum time for next requested lambda Adaptation" UWORD _CNV_A_R_LINEAR_____14_CM 1 100. 0. 6553.5 ECU_ADDRESS 0x3fdc6a FORMAT "%6.1" /end MEASUREMENT
/begin MEASUREMENT LV_MFF_AD_END "Logical value signals the temporary end of  lambda Adaptation" UBYTE _CNV_S_2_RANGE______28_CM 1 100. 0. 1. ECU_ADDRESS 0x3fdc6c /end MEASUREMENT
/begin MEASUREMENT LV_MFF_AD_ENA_FIRST "Logical value which indicates the first lambda Adaptation phase " UBYTE _CNV_S_2_RANGE______28_CM 1 100. 0. 1. ECU_ADDRESS 0x3fdc6f /end MEASUREMENT
/begin MEASUREMENT LV_LAMB_AD_AFS_REQ "Boolean for Combustion Manager to force lambda eq. 1 conditions for lambda Adaptation" UBYTE _CNV_S_2_RANGE______28_CM 1 100. 0. 1. ECU_ADDRESS 0x3fdc6d /end MEASUREMENT
/begin CHARACTERISTIC C_MFF_AD_COR_CRLC "Correlation constant  Lambdaadapatation at  LV_IS = 0" VALUE 0x42909 _REC_VAL_20_u1 0.99610001 _CNV_A_R_LINEAR_____20_CM 0. 0.99610001 FORMAT "%5.3" /end CHARACTERISTIC
/begin CHARACTERISTIC C_MFF_AD_COR_CRLC_IS "Correlation constant  Lambdaadapatation at  LV_IS = 1" VALUE 0x4290a _REC_VAL_20_u1 0.99610001 _CNV_A_R_LINEAR_____20_CM 0. 0.99610001 FORMAT "%5.3" /end CHARACTERISTIC
/begin CHARACTERISTIC C_LAM_AD_SUM_P_IS "P component jump delay between two Adaptations in Idle" VALUE 0x428f5 _REC_VAL_20_u1 254. _CNV_A_R_LINEAR_____10_CM 1. 255. FORMAT "%3.0" /end CHARACTERISTIC
/begin CHARACTERISTIC C_LAM_AD_SUM_P "P component jump delay between two Adaptations out of Idle" VALUE 0x428f4 _REC_VAL_20_u1 255. _CNV_A_R_LINEAR_____10_CM 0. 255. FORMAT "%3.0" /end CHARACTERISTIC
/begin CHARACTERISTIC IP_MFF_AD_ADD_FAC "Multiplicative factor on additive Adaptation value during warm-up" MAP 0x4fb17 _REC_MAP_20_u1_u1_u2 0.99610001 _CNV_A_R_LINEAR_____20_CM 0. 0.99610001 FORMAT "%5.3"
 /begin AXIS_DESCR COM_AXIS TCO _CNV_A_R_LINEAR_____0_CM 5 -48. 142.5 FORMAT "%5.1" AXIS_PTS_REF ldpm_tco_1_mff_ad /end AXIS_DESCR
 /begin AXIS_DESCR COM_AXIS ONLINE_DUMMY _CNV_A_R_LINEAR_____270_CM 5 -695. 694.97 FORMAT "%7.2" AXIS_PTS_REF ldp_mff_ad_add_mmv_2_mff_add /end AXIS_DESCR
/end CHARACTERISTIC
/begin CHARACTERISTIC IP_MFF_AD_FAC_FAC "Multiplicative factor on multiplicative Adaptation value during warm-up" MAP 0x4fb36 _REC_MAP_20_u1_u1_u2 0.99610001 _CNV_A_R_LINEAR_____20_CM 0. 0.99610001 FORMAT "%5.3"
 /begin AXIS_DESCR COM_AXIS TCO _CNV_A_R_LINEAR_____0_CM 5 -48. 142.5 FORMAT "%5.1" AXIS_PTS_REF ldpm_tco_1_mff_ad /end AXIS_DESCR
 /begin AXIS_DESCR COM_AXIS ONLINE_DUMMY _CNV_A_R_LINEAR_____143_CM 5 -50. 49.99847412 FORMAT "%7.3" AXIS_PTS_REF ldp_mff_ad_fac_mmv_2_mff_fac /end AXIS_DESCR
/end CHARACTERISTIC
/begin CHARACTERISTIC C_N_MFF_AD_ADD_MAX "Maximum engine speed for additive Adaptation value calculation" VALUE 0x4295d _REC_VAL_20_u1 8160. _CNV_A_R_LINEAR_____5_CM 0. 8160. FORMAT "%4.0" /end CHARACTERISTIC
/begin CHARACTERISTIC C_N_MFF_AD_FAC_MIN "Minimum engine speed for multiplicative Adaptation value calculation" VALUE 0x4295e _REC_VAL_20_u1 8160. _CNV_A_R_LINEAR_____5_CM 0. 8160. FORMAT "%4.0" /end CHARACTERISTIC
/begin CHARACTERISTIC C_MAF_MFF_AD_ADD_MAX "Maximum MAF for additive Adaptation value calculation" VALUE 0x42e6e _REC_VAL_20_u2 1389. _CNV_A_R_LINEAR_____95_CM 0. 1389. FORMAT "%7.2" /end CHARACTERISTIC
/begin CHARACTERISTIC IP_MAF_MFF_AD_MAX "Maximum MAF for multiplicative adaptive learning" CURVE 0x4fad3 _REC_CUR_20_u1_u1 1389. _CNV_A_R_LINEAR_____18_CM 0. 1389. FORMAT "%4.0"
 /begin AXIS_DESCR COM_AXIS N_32 _CNV_A_R_LINEAR_____5_CM 6 0. 8160. FORMAT "%4.0" AXIS_PTS_REF ldpm_n_32_maf_mff_ad_max /end AXIS_DESCR
/end CHARACTERISTIC
/begin CHARACTERISTIC IP_MAF_MFF_AD_MIN "Minimum MAF for multiplicative adaptive learning" CURVE 0x4fad9 _REC_CUR_20_u1_u1 1389. _CNV_A_R_LINEAR_____18_CM 0. 1389. FORMAT "%4.0"
 /begin AXIS_DESCR COM_AXIS N_32 _CNV_A_R_LINEAR_____5_CM 6 0. 8160. FORMAT "%4.0" AXIS_PTS_REF ldpm_n_32_maf_mff_ad_min /end AXIS_DESCR
/end CHARACTERISTIC
/begin CHARACTERISTIC C_MFF_AD_FAC_MIN "Minimum value of adaptive multiplicative factor for injection" VALUE 0x43290 _REC_VAL_20_s2 99.99847412 _CNV_A_R_LINEAR_____98_CM -50. 49.99847412 FORMAT "%7.3" /end CHARACTERISTIC
/begin CHARACTERISTIC C_MFF_AD_FAC_MAX "Maximum value of adaptive multiplicative factor for injection" VALUE 0x4328e _REC_VAL_20_s2 99.99847412 _CNV_A_R_LINEAR_____98_CM -50. 49.99847412 FORMAT "%7.3" /end CHARACTERISTIC
/begin CHARACTERISTIC C_MFF_AD_ADD_MIN "Minimum value of adaptive additive factor for injection" VALUE 0x4328c _REC_VAL_20_s2 1388.978806 _CNV_A_R_LINEAR_____261_CM -694.5 694.478806 FORMAT "%7.2" /end CHARACTERISTIC
/begin CHARACTERISTIC C_MFF_AD_ADD_MAX "Maximum value of adaptive additive factor for injection" VALUE 0x4328a _REC_VAL_20_s2 1388.978806 _CNV_A_R_LINEAR_____261_CM -694.5 694.478806 FORMAT "%7.2" /end CHARACTERISTIC
/begin CHARACTERISTIC ID_T_MFF_AD_ADD "Minimum time for next requested lambda Adaptation according to additive factor difference" CURVE 0x45ea0 _REC_CUR_20_u2_u2 6553.5 _CNV_A_R_LINEAR_____14_CM 0. 6553.5 FORMAT "%6.1"
 /begin AXIS_DESCR COM_AXIS ONLINE_DUMMY _CNV_A_R_LINEAR_____270_CM 8 -695. 694.97 FORMAT "%7.2" AXIS_PTS_REF ldp_mff_ad_add_mmv_delta_add /end AXIS_DESCR
/end CHARACTERISTIC
/begin CHARACTERISTIC C_MAF_MFF_AD_FAC_MIN "Minimum MAF for multiplicative Adaptation value calculation" VALUE 0x42e70 _REC_VAL_20_u2 1389. _CNV_A_R_LINEAR_____95_CM 0. 1389. FORMAT "%7.2" /end CHARACTERISTIC
/begin CHARACTERISTIC LC_MFF_AD_FAC "Logical calibration to allow forced lambda-1 conditions for gain Adaptation at lower area" VALUE 0x42bb2 _REC_VAL_20_u1 1. _CNV_A_R_LINEAR_____10_CM 0. 1. FORMAT "%2.0" /end CHARACTERISTIC
/begin CHARACTERISTIC LC_MFF_AD_ADD "Logical calibration to allow forced lambda-1 conditions for offset Adaptation" VALUE 0x42bb1 _REC_VAL_20_u1 1. _CNV_A_R_LINEAR_____10_CM 0. 1. FORMAT "%2.0" /end CHARACTERISTIC
/begin MEASUREMENT LV_MFF_AD_CDN "Boolean for time scheduler indicating good conditions for lambda Adaptation" UBYTE _CNV_S_2_RANGE______28_CM 1 100. 0. 1. ECU_ADDRESS 0x3fdc6e /end MEASUREMENT
/begin CHARACTERISTIC ID_T_MFF_AD_FAC "Minimum time for next requested lambda Adaptation according to multiplicative factor difference of lower area" CURVE 0x45eb0 _REC_CUR_20_u2_u2 6553.5 _CNV_A_R_LINEAR_____14_CM 0. 6553.5 FORMAT "%6.1"
 /begin AXIS_DESCR COM_AXIS ONLINE_DUMMY _CNV_A_R_LINEAR_____143_CM 8 -50. 49.99847412 FORMAT "%7.3" AXIS_PTS_REF ldp_mff_ad_fac_mmv_delta /end AXIS_DESCR
/end CHARACTERISTIC
/begin CHARACTERISTIC C_T_MFF_AD_MIN_MAX "Maximum time to set temporary end of Adaptation flag" VALUE 0x43002 _REC_VAL_20_u2 6553.5 _CNV_A_R_LINEAR_____14_CM 0. 6553.5 FORMAT "%6.1" /end CHARACTERISTIC
/begin CHARACTERISTIC IP_MFF_AD_FAC "Weighting factor for MFF_AD_FAC versus N" CURVE 0x4fb30 _REC_CUR_20_u1_u1 0.99610001 _CNV_A_R_LINEAR_____20_CM 0. 0.99610001 FORMAT "%5.3"
 /begin AXIS_DESCR COM_AXIS N_32 _CNV_A_R_LINEAR_____5_CM 6 0. 8160. FORMAT "%4.0" AXIS_PTS_REF ldpm_n_32_1_mff_ad /end AXIS_DESCR
/end CHARACTERISTIC
/begin CHARACTERISTIC IP_MFF_AD_ADD "Weighting factor for MFF_AD_ADD versus N" CURVE 0x4fb11 _REC_CUR_20_u1_u1 0.99610001 _CNV_A_R_LINEAR_____20_CM 0. 0.99610001 FORMAT "%5.3"
 /begin AXIS_DESCR COM_AXIS N_32 _CNV_A_R_LINEAR_____5_CM 6 0. 8160. FORMAT "%4.0" AXIS_PTS_REF ldpm_n_32_1_mff_ad /end AXIS_DESCR
/end CHARACTERISTIC
/begin AXIS_PTS ldp_mff_ad_add_mmv_delta_add "" 0x446ea MFF_AD_FAC_MMV_DELTA_ADD _REC_AXS_20_u2 1389.97 _CNV_A_R_LINEAR_____270_CM 8 -695. 694.97 FORMAT "%7.2" /end AXIS_PTS
/begin AXIS_PTS ldpm_tco_1_mff_ad "" 0x43f5e TCO _REC_AXS_20_u1 190.5 _CNV_A_R_LINEAR_____0_CM 5 -48. 142.5 FORMAT "%5.1" /end AXIS_PTS
/begin AXIS_PTS ldp_mff_ad_add_mmv_2_mff_add "" 0x446de MFF_AD_ADD_MMV _REC_AXS_20_u2 1389.97 _CNV_A_R_LINEAR_____270_CM 5 -695. 694.97 FORMAT "%7.2" /end AXIS_PTS
/begin AXIS_PTS ldp_mff_ad_fac_mmv_2_mff_fac "" 0x446fc MFF_AD_FAC_MMV _REC_AXS_20_u2 99.99847412 _CNV_A_R_LINEAR_____143_CM 5 -50. 49.99847412 FORMAT "%7.3" /end AXIS_PTS
/begin AXIS_PTS ldpm_n_32_1_mff_ad "" 0x43d0b N_32 _REC_AXS_20_u1 8160. _CNV_A_R_LINEAR_____5_CM 6 0. 8160. FORMAT "%4.0" /end AXIS_PTS
/begin AXIS_PTS ldpm_n_32_maf_mff_ad_max "" 0x43e71 N_32 _REC_AXS_20_u1 816. _CNV_A_R_LINEAR_____5_CM 6 0. 8160. FORMAT "%4.0" /end AXIS_PTS
/begin AXIS_PTS ldpm_n_32_maf_mff_ad_min "" 0x43e78 N_32 _REC_AXS_20_u1 816. _CNV_A_R_LINEAR_____5_CM 6 0. 8160. FORMAT "%4.0" /end AXIS_PTS
/begin AXIS_PTS ldp_mff_ad_fac_mmv_delta "" 0x44708 MFF_AD_FAC_MMV_DELTA _REC_AXS_20_u2 99.99847412 _CNV_A_R_LINEAR_____143_CM 8 -50. 49.99847412 FORMAT "%7.3" /end AXIS_PTS
/begin MEASUREMENT LV_REQ_LAMB_SP_LS_ACT_TEST_1 "Request for lambda coordination and canister purge for active plausibility test" ULONG _CNV_S_2_RANGE______28_CM 1 100. 0. 1. ECU_ADDRESS 0x3fa928 BIT_MASK 0x80000000 /end MEASUREMENT
/begin MEASUREMENT LV_VLS_DOWN_AFL_1 "Monitoring sensor has detected lean " ULONG _CNV_S_2_RANGE______28_CM 1 100. 0. 1. ECU_ADDRESS 0x3fa928 BIT_MASK 0x40000000 /end MEASUREMENT
/begin MEASUREMENT LV_VLS_DOWN_AFR_1 " Monitoring sensor has detected rich " ULONG _CNV_S_2_RANGE______28_CM 1 100. 0. 1. ECU_ADDRESS 0x3fa928 BIT_MASK 0x20000000 /end MEASUREMENT
/begin MEASUREMENT LV_END_CYC_CHK_LS_DOWN_1 "End of cycle of active test of downstream sensor" ULONG _CNV_S_2_RANGE______28_CM 1 100. 0. 1. ECU_ADDRESS 0x3fa928 BIT_MASK 0x10000000 /end MEASUREMENT
/begin MEASUREMENT LV_CDN_CYC_CHK_LS_DOWN_1 "Conditions to run active test cycle" ULONG _CNV_S_2_RANGE______28_CM 1 100. 0. 1. ECU_ADDRESS 0x3fa928 BIT_MASK 0x8000000 /end MEASUREMENT
/begin MEASUREMENT LAMB_SP_LS_ACT_TEST_1 "Lambda set point for active plausibility test" UWORD _CNV_A_R_LINEAR_____276_CM 1 100. 0. 31.9990234 ECU_ADDRESS 0x3fa92c FORMAT "%10.7" /end MEASUREMENT
/begin MEASUREMENT LV_DOWN_LS_1 "Logical variable for operative readiness of downstream oxygen sensor(s)" ULONG _CNV_S_2_RANGE______28_CM 1 100. 0. 1. ECU_ADDRESS 0x3fa8b0 BIT_MASK 0x80000000 /end MEASUREMENT
/begin MEASUREMENT T_SUM_MAX_FSD_1 "Total duration over C_LAM_MAX_FSD" UWORD _CNV_A_R_LINEAR_____169_CM 1 100. 0. 1310.7 ECU_ADDRESS 0x3fa744 FORMAT "%7.2" /end MEASUREMENT
/begin MEASUREMENT T_SUM_MIN_FSD_1 "Total duration over C_LAM_MIN_FSD" UWORD _CNV_A_R_LINEAR_____169_CM 1 100. 0. 1310.7 ECU_ADDRESS 0x3fa748 FORMAT "%7.2" /end MEASUREMENT
/begin MEASUREMENT T_SUM_END_DIAG_WIN_FSD_1 "Time counter to set LV_END_DIAG_FSD_i" UWORD _CNV_A_R_LINEAR_____169_CM 1 100. 0. 1310.7 ECU_ADDRESS 0x3fa746 FORMAT "%7.2" /end MEASUREMENT
/begin MEASUREMENT T_SUM_RST_FSD_1 "Time counter to reset T_SUM_MAX_FSD_i and T_SUM_MIN_FSD_i" UWORD _CNV_A_R_LINEAR_____169_CM 1 100. 0. 1310.7 ECU_ADDRESS 0x3fa74a FORMAT "%7.2" /end MEASUREMENT
/begin MEASUREMENT LV_CAT_DIAG_CYC_VLD_1 "Monitoring cycle valid, used for calculation of diagnosis value" ULONG _CNV_S_2_RANGE______28_CM 1 100. 0. 1. ECU_ADDRESS 0x3fa70c BIT_MASK 0x80000000 /end MEASUREMENT
/begin MEASUREMENT SUM_CAT_DIAG_1 "monitoring cycle counter" UWORD _CNV_A_R_LINEAR_____10_CM 1 100. 0. 65535. ECU_ADDRESS 0x3fa71a FORMAT "%5.0" /end MEASUREMENT
/begin MEASUREMENT CAT_DIAG_CLC_1 "Diagnostic value, catalytic converter efficiency check, bank i (i=1,2)" UWORD _CNV_A_R_LINEAR_____288_CM 1 100. 0. 20. ECU_ADDRESS 0x3fa720 FORMAT "%5.2" /end MEASUREMENT
/begin MEASUREMENT CAT_DIAG_CUS_1 "Customer diagnostic value, catalytic converter efficiency check, bank i (i=1,2)" UWORD _CNV_A_R_LINEAR_____288_CM 1 100. 0. 20. ECU_ADDRESS 0x3fa728 FORMAT "%5.2" /end MEASUREMENT
/begin MEASUREMENT VLS_CYC_STEP_1 "state-counter for several phases of a rich-lean-cycle" UBYTE _CNV_S_8_STATE_VLS__289_CM 1 100. 0. 255. ECU_ADDRESS 0x3fa71e /end MEASUREMENT
/begin MEASUREMENT SUM_O2_CAT_DIF_1 "Sum of the difference between measured post-CAT oxygen exposure and mean oxygen exposure, bank i (i=1,2)" UWORD _CNV_A_R_LINEAR_____290_CM 1 100. 0. 511.99218 ECU_ADDRESS 0x3fa710 FORMAT "%7.3" /end MEASUREMENT
/begin MEASUREMENT SUM_O2_CAT_1 "Sum of post-catalyst oxygen exposure, bank i (i=1,2)" UWORD _CNV_A_R_LINEAR_____291_CM 1 100. 0. 5.119921 ECU_ADDRESS 0x3fa712 FORMAT "%7.5" /end MEASUREMENT
/begin MEASUREMENT O2_CAT_INT_1 "Mean value of the difference between measured post-CAT oxygen exposure and mean oxygen exposure, bank i (i=1,2)" UBYTE _CNV_A_R_LINEAR_____20_CM 1 100. 0. 0.99610001 ECU_ADDRESS 0x3fa714 FORMAT "%5.3" /end MEASUREMENT
/begin MEASUREMENT O2_CAT_MV_1 "Mean value of post-catalyst oxygen exposure, bank i (i=1,2)" UBYTE _CNV_A_R_LINEAR_____20_CM 1 100. 0. 0.99610001 ECU_ADDRESS 0x3fa715 FORMAT "%5.3" /end MEASUREMENT
/begin MEASUREMENT O2_CAT_RATIO_1 "Quotient of O2_CAT_INT_i and ID_VLS_CAT_INT_MAX_AT/MT__N__MAF, bank i (i=1,2)" UWORD _CNV_A_R_LINEAR_____288_CM 1 100. 0. 20. ECU_ADDRESS 0x3fa718 FORMAT "%5.2" /end MEASUREMENT
/begin MEASUREMENT SUM_O2_CAT_RATIO_1 "Sum of O2_CAT_RATIO_i" UWORD _CNV_A_R_LINEAR_____292_CM 1 100. 0. 2559.96094 ECU_ADDRESS 0x3fa71c FORMAT "%7.2" /end MEASUREMENT
/begin MEASUREMENT SUM_VLS_CAT_O2_1 "Oxygen oscillation at CAT-entry" ULONG _CNV_A_R_LINEAR_____12_CM 1 100. 0. 4294967295. ECU_ADDRESS 0x3fa724 FORMAT "%11.0" /end MEASUREMENT
/begin MEASUREMENT O2_CAT_1 "Value of post-catalyst oxygen exposure, bank i (i=1,2)" UBYTE _CNV_A_R_LINEAR_____20_CM 1 100. 0. 0.99610001 ECU_ADDRESS 0x3fa71f FORMAT "%5.3" /end MEASUREMENT
/begin MEASUREMENT CAT_DIAG_1 "Generic diagnosis value" UBYTE _CNV_A_R_LINEAR_____141_CM 1 100. 0. 1.984375 ECU_ADDRESS 0x3fa72a FORMAT "%4.2" /end MEASUREMENT
/begin MEASUREMENT LV_INH_DIAG_LS_UP_1 "OBD2 function: application incidence for inhibition" ULONG _CNV_S_2_RANGE______28_CM 1 100. 0. 1. ECU_ADDRESS 0x3fa9b4 BIT_MASK 0x40000000 /end MEASUREMENT
/begin MEASUREMENT VLS_CYCNR_MAX_1 "top limit diagnostic threshold for switching time monitoring" UWORD _CNV_A_R_LINEAR_____33_CM 1 100. 0. 4.99511719 ECU_ADDRESS 0x3fa9dc FORMAT "%5.3" /end MEASUREMENT
/begin MEASUREMENT VLS_CYCNR_MIN_1 "bottom limit diagnostic threshold for switching time monitoring" UWORD _CNV_A_R_LINEAR_____33_CM 1 100. 0. 4.99511719 ECU_ADDRESS 0x3fa9de FORMAT "%5.3" /end MEASUREMENT
/begin MEASUREMENT T_VLS_CYCNR_1 "actual switching time" UWORD _CNV_A_R_LINEAR_____27_CM 1 100. 0. 655.35 ECU_ADDRESS 0x3fa9e0 FORMAT "%5.2" /end MEASUREMENT
/begin MEASUREMENT RATIO_VLS_CYCNR_AFL_MV_1 "total ratio between measured and max. allowed switching times from rich to lean" UWORD _CNV_A_R_LINEAR_____111_CM 1 100. 0. 255.996094 ECU_ADDRESS 0x3fa9ee FORMAT "%7.3" /end MEASUREMENT
/begin MEASUREMENT RATIO_VLS_CYCNR_AFR_MV_1 "number of measured switching times from rich to lean" UWORD _CNV_A_R_LINEAR_____111_CM 1 100. 0. 255.996094 ECU_ADDRESS 0x3fa9f0 FORMAT "%7.3" /end MEASUREMENT
/begin MEASUREMENT SUM_CYCNR_AFL_1 "number of measured switching times from rich to lean" UWORD _CNV_A_R_LINEAR_____10_CM 1 100. 0. 65535. ECU_ADDRESS 0x3fa9e2 FORMAT "%5.0" /end MEASUREMENT
/begin MEASUREMENT SUM_CYCNR_AFR_1 "number of measured switching times from lean to rich" UWORD _CNV_A_R_LINEAR_____10_CM 1 100. 0. 65535. ECU_ADDRESS 0x3fa9e4 FORMAT "%5.0" /end MEASUREMENT
/begin MEASUREMENT RATIO_VLS_CYCNR_AFL_1 "ratio between measured and max. allowed switching times from rich to lean" UWORD _CNV_A_R_LINEAR_____111_CM 1 100. 0. 255.996094 ECU_ADDRESS 0x3fa9e6 FORMAT "%7.3" /end MEASUREMENT
/begin MEASUREMENT RATIO_SAE_VLS_CYCNR_AFL_MV_1 "ratio between measured and max. allowed switching times from rich to lean for scantool" UWORD _CNV_A_R_LINEAR_____111_CM 1 100. 0. 255.996094 ECU_ADDRESS 0x3fa9f2 FORMAT "%7.3" /end MEASUREMENT
/begin MEASUREMENT RATIO_SAE_VLS_CYCNR_AFR_MV_1 "ratio between measured and max. allowed switching times from lean to rich for scantool" UWORD _CNV_A_R_LINEAR_____111_CM 1 100. 0. 255.996094 ECU_ADDRESS 0x3fa9f4 FORMAT "%7.3" /end MEASUREMENT
/begin MEASUREMENT RATIO_VLS_CYCNR_AFR_1 "ratio between measured and max. allowed switching times from lean to rich" UWORD _CNV_A_R_LINEAR_____111_CM 1 100. 0. 255.996094 ECU_ADDRESS 0x3fa9e8 FORMAT "%7.3" /end MEASUREMENT
/begin MEASUREMENT T_VLS_AFR_TO_AFL_SUM_1 "sum of SWT rich to lean" UWORD _CNV_A_R_LINEAR_____27_CM 1 100. 0. 655.35 ECU_ADDRESS 0x3fa9f8 FORMAT "%6.2" /end MEASUREMENT
/begin MEASUREMENT T_VLS_AFR_TO_AFL_SUM_MAX_1 "sum of max SWT rich to lean" UWORD _CNV_A_R_LINEAR_____27_CM 1 100. 0. 655.35 ECU_ADDRESS 0x3fa9fa FORMAT "%6.2" /end MEASUREMENT
/begin MEASUREMENT T_VLS_AFL_TO_AFR_SUM_1 "sum of SWT lean to rich" UWORD _CNV_A_R_LINEAR_____27_CM 1 100. 0. 655.35 ECU_ADDRESS 0x3fa9fc FORMAT "%6.2" /end MEASUREMENT
/begin MEASUREMENT T_VLS_AFL_TO_AFR_SUM_MAX_1 "sum of max SWT lean to rich" UWORD _CNV_A_R_LINEAR_____27_CM 1 100. 0. 655.35 ECU_ADDRESS 0x3fa9fe FORMAT "%6.2" /end MEASUREMENT
/begin MEASUREMENT VLS_SAE_AFL_THD_1 "SWT lean threshold for scantool" UWORD _CNV_A_R_LINEAR_____33_CM 1 100. 0. 4.99511719 ECU_ADDRESS 0x3faa08 FORMAT "%5.3" /end MEASUREMENT
/begin MEASUREMENT VLS_SAE_AFR_THD_1 "SWT rich threshold for scantool" UWORD _CNV_A_R_LINEAR_____33_CM 1 100. 0. 4.99511719 ECU_ADDRESS 0x3faa0a FORMAT "%5.3" /end MEASUREMENT
/begin MEASUREMENT T_SAE_VLS_AFR_AFL_1 "SWT rich to lean for scantool" UBYTE _CNV_A_R_LINEAR_____27_CM 1 100. 0. 2.55 ECU_ADDRESS 0x3faa0c FORMAT "%4.2" /end MEASUREMENT
/begin MEASUREMENT T_SAE_VLS_AFR_AFL_MAX_1 "max. SWT rich to lean for scantool" UBYTE _CNV_A_R_LINEAR_____27_CM 1 100. 0. 2.55 ECU_ADDRESS 0x3faa0d FORMAT "%4.2" /end MEASUREMENT
/begin MEASUREMENT T_SAE_VLS_AFL_AFR_MAX_1 "max. SWT lean to rich for scantool" UBYTE _CNV_A_R_LINEAR_____27_CM 1 100. 0. 2.55 ECU_ADDRESS 0x3faa0f FORMAT "%4.2" /end MEASUREMENT
/begin MEASUREMENT T_SAE_VLS_AFL_AFR_1 "SWT lean to rich for scantool" UBYTE _CNV_A_R_LINEAR_____27_CM 1 100. 0. 2.55 ECU_ADDRESS 0x3faa0e FORMAT "%4.2" /end MEASUREMENT
/begin MEASUREMENT SUM_CYC_1 "number of measured complete controller periods" UWORD _CNV_A_R_LINEAR_____10_CM 1 100. 0. 65535. ECU_ADDRESS 0x3fa9b8 FORMAT "%5.0" /end MEASUREMENT
/begin MEASUREMENT RATIO_VLS_CYC_AFL_1 "ratio between measured and max. allowed lean time" UWORD _CNV_A_R_LINEAR_____111_CM 1 100. 0. 255.996094 ECU_ADDRESS 0x3fa9ba FORMAT "%7.3" /end MEASUREMENT
/begin MEASUREMENT RATIO_VLS_CYC_AFR_1 "ratio between measured and max. allowed  rich time" UWORD _CNV_A_R_LINEAR_____111_CM 1 100. 0. 255.996094 ECU_ADDRESS 0x3fa9bc FORMAT "%7.3" /end MEASUREMENT
/begin MEASUREMENT RATIO_VLS_CYC_AFL_SUM_1 "total value of lean time" UWORD _CNV_A_R_LINEAR_____195_CM 1 100. 0. 1023.984375 ECU_ADDRESS 0x3fa9be FORMAT "%7.2" /end MEASUREMENT
/begin MEASUREMENT RATIO_VLS_CYC_AFR_SUM_1 "total value of rich time" UWORD _CNV_A_R_LINEAR_____195_CM 1 100. 0. 1023.984375 ECU_ADDRESS 0x3fa9c0 FORMAT "%7.2" /end MEASUREMENT
/begin MEASUREMENT RATIO_VLS_CYC_AFL_MV_1 "total ratio between measured and max. allowed lean time" UWORD _CNV_A_R_LINEAR_____111_CM 1 100. 0. 255.996094 ECU_ADDRESS 0x3fa9c2 FORMAT "%7.3" /end MEASUREMENT
/begin MEASUREMENT RATIO_VLS_CYC_AFR_MV_1 "total ratio between measured and max. allowed rich time, saved for SAE Mode $6 output" UWORD _CNV_A_R_LINEAR_____111_CM 1 100. 0. 255.996094 ECU_ADDRESS 0x3fa9c4 FORMAT "%7.3" /end MEASUREMENT
/begin MEASUREMENT RATIO_SAE_VLS_CYC_AFL_MV_1 "total ratio between measured and max. allowed lean time, saved for SAE Mode $6 output" UWORD _CNV_A_R_LINEAR_____111_CM 1 100. 0. 255.996094 ECU_ADDRESS 0x3fa9c6 FORMAT "%7.3" /end MEASUREMENT
/begin MEASUREMENT RATIO_SAE_VLS_CYC_AFR_MV_1 "total ratio between measured and max. allowed rich time, saved for SAE Mode $6 output" UWORD _CNV_A_R_LINEAR_____111_CM 1 100. 0. 255.996094 ECU_ADDRESS 0x3fa9c8 FORMAT "%7.3" /end MEASUREMENT
/begin MEASUREMENT T_VLS_CYC_AFR_SUM_1 "sum of rich time" UWORD _CNV_A_R_LINEAR_____27_CM 1 100. 0. 655.35 ECU_ADDRESS 0x3faa00 FORMAT "%6.2" /end MEASUREMENT
/begin MEASUREMENT T_VLS_CYC_AFR_SUM_MAX_1 "sum of max rich time" UWORD _CNV_A_R_LINEAR_____27_CM 1 100. 0. 655.35 ECU_ADDRESS 0x3faa02 FORMAT "%6.2" /end MEASUREMENT
/begin MEASUREMENT T_SAE_VLS_CYC_AFR_1 "rich dwell time for scantool" UWORD _CNV_A_R_LINEAR_____27_CM 1 100. 0. 655.35 ECU_ADDRESS 0x3faa10 FORMAT "%6.2" /end MEASUREMENT
/begin MEASUREMENT T_SAE_VLS_CYC_AFR_MAX_1 "max. rich dwell time for scantool" UWORD _CNV_A_R_LINEAR_____27_CM 1 100. 0. 655.35 ECU_ADDRESS 0x3faa12 FORMAT "%6.2" /end MEASUREMENT
/begin MEASUREMENT T_LAM_DLY_P_OLD_1 "The T_LAM_DLY_i value witch was active at the last p-jump" SWORD _CNV_A_R_LINEAR_____280_CM 1 100. -15360. 15359.53125 ECU_ADDRESS 0x3faa04 FORMAT "%8.1" /end MEASUREMENT
/begin MEASUREMENT T_LAM_DLY_P_1 "The T_LAM_DLY_i value of actual p-jump" SWORD _CNV_A_R_LINEAR_____280_CM 1 100. -15360. 15359.53125 ECU_ADDRESS 0x3faa06 FORMAT "%8.1" /end MEASUREMENT
/begin MEASUREMENT SUM_RATIO_VLS_CYCNR_AFL_1 "total value of switching time from rich to lean" UWORD _CNV_A_R_LINEAR_____195_CM 1 100. 0. 1023.984375 ECU_ADDRESS 0x3fa9ea FORMAT "%7.2" /end MEASUREMENT
/begin MEASUREMENT SUM_RATIO_VLS_CYCNR_AFR_1 "total value of switching time from lean to rich" UWORD _CNV_A_R_LINEAR_____195_CM 1 100. 0. 1023.984375 ECU_ADDRESS 0x3fa9ec FORMAT "%7.2" /end MEASUREMENT
/begin MEASUREMENT T_VLS_CYC_AFR_MV_MAX_1 "mean value of rich time" UWORD _CNV_A_R_LINEAR_____27_CM 1 100. 0. 10.23 ECU_ADDRESS 0x3fa9ca FORMAT "%5.2" /end MEASUREMENT
/begin MEASUREMENT T_VLS_CYC_AFL_MV_MAX_1 "mean value of lean time" UWORD _CNV_A_R_LINEAR_____27_CM 1 100. 0. 10.23 ECU_ADDRESS 0x3fa9cc FORMAT "%5.2" /end MEASUREMENT
/begin MEASUREMENT LV_LS_DOWN_SWT_VLD_1 "Validity bit of the current switching time check" ULONG _CNV_S_2_RANGE______28_CM 1 100. 0. 1. ECU_ADDRESS 0x3fa890 BIT_MASK 0x80000000 /end MEASUREMENT
/begin MEASUREMENT LV_VLS_DOWN_PUE_VLD_1 "Debounced diagnosis result of pull end plausibility" ULONG _CNV_S_2_RANGE______28_CM 1 100. 0. 1. ECU_ADDRESS 0x3fa890 BIT_MASK 0x40000000 /end MEASUREMENT
/begin MEASUREMENT LV_CDN_DIAG_LS_DOWN_1 "Status of permission for diagnosis" ULONG _CNV_S_2_RANGE______28_CM 1 100. 0. 1. ECU_ADDRESS 0x3fa890 BIT_MASK 0x20000000 /end MEASUREMENT
/begin MEASUREMENT LV_INH_DIAG_LS_DOWN_1 "OBDII function downstream sensor" ULONG _CNV_S_2_RANGE______28_CM 1 100. 0. 1. ECU_ADDRESS 0x3fa890 BIT_MASK 0x10000000 /end MEASUREMENT
/begin MEASUREMENT CYCNR_VLS_DOWN_ACT_1 "Cycle counter for switching time determination, Bank i" UBYTE _CNV_A_R_LINEAR_____293_CM 1 100. 0. 5100. ECU_ADDRESS 0x3fa89a FORMAT "%5.0" /end MEASUREMENT
/begin MEASUREMENT CTR_VLS_DOWN_DIAG_1 "Number of valid switching times from rich to lean" UBYTE _CNV_A_R_LINEAR_____10_CM 1 100. 0. 255. ECU_ADDRESS 0x3fa89e FORMAT "%3.0" /end MEASUREMENT
/begin MEASUREMENT VLS_DOWN_TRAN_PUC_1 "Monitor sensor voltage on activating the trailing throttle fuel cut-off, Bank i " UWORD _CNV_A_R_LINEAR_____33_CM 1 100. 0. 4.99511719 ECU_ADDRESS 0x3fa896 FORMAT "%5.3" /end MEASUREMENT
/begin MEASUREMENT CTR_CYCNR_QUO_VLS_DOWN_SUM_1 "Sum of weighted CYCNR_VLS_DOWN_ACT_i, Bank i " UWORD _CNV_A_R_LINEAR_____111_CM 1 100. 0. 255.996094 ECU_ADDRESS 0x3fa8a0 FORMAT "%7.3" /end MEASUREMENT
/begin MEASUREMENT CYCNR_RATIO_VLS_DOWN_1 "mean value of the ratio between the monitor sensor switching time and the threshold value" UBYTE _CNV_A_R_LINEAR_____34_CM 1 100. 0. 1.99220002 ECU_ADDRESS 0x3fa8a2 FORMAT "%5.3" /end MEASUREMENT
/begin MEASUREMENT CYCNR_SAE_RATIO_VLS_DOWN_1 "mean value of the ratio between the monitor sensor switching time and the threshold value for scantool" UBYTE _CNV_A_R_LINEAR_____34_CM 1 100. 0. 1.99220002 ECU_ADDRESS 0x3fa8a3 FORMAT "%5.3" /end MEASUREMENT
/begin MEASUREMENT CYCNR_QUO_VLS_DOWN_1 "weighted value of CYCNR_VLS_DOWN_ACT_i " UWORD _CNV_A_R_LINEAR_____111_CM 1 100. 0. 255.996094 ECU_ADDRESS 0x3fa89c FORMAT "%7.3" /end MEASUREMENT
/begin MEASUREMENT VLS_DOWN_PUE_1 "Monitor sensor voltage at the time of leaving PUC, Bank i (i=1.2)" UWORD _CNV_A_R_LINEAR_____33_CM 1 100. 0. 4.99511719 ECU_ADDRESS 0x3fa8a6 FORMAT "%5.3" /end MEASUREMENT
/begin MEASUREMENT CTR_END_DIAG_VLS_DOWN_PUE_1 "Time counter to set LV_END_DIAG_VLS_DOWN_PUE_i" UWORD _CNV_A_R_LINEAR_____10_CM 1 100. 0. 65535. ECU_ADDRESS 0x3fa8ac FORMAT "%5.0" /end MEASUREMENT
/begin MEASUREMENT VLS_DOWN_DIF_DIAG_1 "difference of VLS_DOWN values from the beginning to the end of the MAF_INT_PUE calculation" UWORD _CNV_A_R_LINEAR_____33_CM 1 100. 0. 4.99511719 ECU_ADDRESS 0x3fa8a8 FORMAT "%5.3" /end MEASUREMENT
/begin MEASUREMENT VLS_SAE_DOWN_DIF_DIAG_1 "difference of VLS_DOWN values from the beginning to the end of the MAF_INT_PUE calculation for scantool" UWORD _CNV_A_R_LINEAR_____33_CM 1 100. 0. 4.99511719 ECU_ADDRESS 0x3fa8aa FORMAT "%5.3" /end MEASUREMENT
/begin MEASUREMENT CTR_VLS_DOWN_PUE_1 "counter for anti-bounce" UBYTE _CNV_A_R_LINEAR_____10_CM 1 100. 0. 255. ECU_ADDRESS 0x3fa8ae FORMAT "%3.0" /end MEASUREMENT
/begin MEASUREMENT LV_LAM_ADJ_AD_1 "logical value activates the shift of the lambda-controller" ULONG _CNV_S_2_RANGE______28_CM 1 100. 0. 1. ECU_ADDRESS 0x3fa74c BIT_MASK 0x80000000 /end MEASUREMENT
/begin MEASUREMENT LV_LAM_AD_STOP_1 "Logical variable indicates passing stop of the lambda Adaptation" ULONG _CNV_S_2_RANGE______28_CM 1 100. 0. 1. ECU_ADDRESS 0x3fa74c BIT_MASK 0x40000000 /end MEASUREMENT
/begin MEASUREMENT LV_MFF_AD_FAC_LIM_1 "Limitation of multiplicative adapted factor of lower area" ULONG _CNV_S_2_RANGE______28_CM 1 100. 0. 1. ECU_ADDRESS 0x3fa74c BIT_MASK 0x20000000 /end MEASUREMENT
/begin MEASUREMENT LV_MFF_AD_ADD_LIM_1 "Limitation of additive adapted factor" ULONG _CNV_S_2_RANGE______28_CM 1 100. 0. 1. ECU_ADDRESS 0x3fa74c BIT_MASK 0x10000000 /end MEASUREMENT
/begin MEASUREMENT MFF_AD_ADD_MMV_REL_1 "Relative additive adaptive factor" SWORD _CNV_A_R_LINEAR_____261_CM 1 100. -694.5 694.478806 ECU_ADDRESS 0x3fa754 FORMAT "%7.2" /end MEASUREMENT
/begin MEASUREMENT MFF_AD_ADD_MMV_REL_QUO_1 "Relative additive adaptive factor quotient" SWORD _CNV_A_R_LINEAR_____173_CM 1 100. -100. 99.99694824 ECU_ADDRESS 0x3fa756 FORMAT "%8.3" /end MEASUREMENT
/begin MEASUREMENT MFF_AD_FAC_MMV_REL_1 "Relative Multiplicative adaptive factor" SWORD _CNV_A_R_LINEAR_____98_CM 1 100. -50. 49.99847412 ECU_ADDRESS 0x3fa75e FORMAT "%7.3" /end MEASUREMENT
/begin MEASUREMENT MFF_AD_ADD_MMV_1 "Additive adaptive factor" SWORD _CNV_A_R_LINEAR_____261_CM 1 100. -694.5 694.478806 ECU_ADDRESS 0x3fa758 FORMAT "%7.2" /end MEASUREMENT
/begin MEASUREMENT MFF_AD_FAC_MMV_1 "Multiplicative adaptive factor" SWORD _CNV_A_R_LINEAR_____98_CM 1 100. -50. 49.99847412 ECU_ADDRESS 0x3fa760 FORMAT "%7.3" /end MEASUREMENT
/begin MEASUREMENT LAM_ADJ_AD_1 "output value for the lambda controller shift" SWORD _CNV_A_R_LINEAR_____98_CM 1 100. -50. 49.99847412 ECU_ADDRESS 0x3fa764 FORMAT "%7.3" /end MEASUREMENT
/begin MEASUREMENT MFF_AD_ADD_MMV_DELTA_1 "Difference of additive adaptive factor to previous Adaptation" SWORD _CNV_A_R_LINEAR_____261_CM 1 100. -694.5 694.478806 ECU_ADDRESS 0x3fa75a FORMAT "%7.2" /end MEASUREMENT
/begin MEASUREMENT MFF_AD_ADD_MMV_DELTA_H_RES_1 "Difference of additive adaptive factor to previous Adaptation" SWORD _CNV_A_R_LINEAR_____301_CM 1 100. -10.85 10.85 ECU_ADDRESS 0x3fa75c FORMAT "%7.2" /end MEASUREMENT
/begin MEASUREMENT MFF_AD_FAC_MMV_DELTA_1 "Difference of multiplicative adaptive factor to previous Adaptation" SWORD _CNV_A_R_LINEAR_____98_CM 1 100. -50. 49.99847412 ECU_ADDRESS 0x3fa762 FORMAT "%7.3" /end MEASUREMENT
/begin MEASUREMENT MFF_SAE_AD_MMV_REL_1 "Relative adaptive correction for cylinder bank i for scantool" SWORD _CNV_A_R_LINEAR_____173_CM 1 100. -100. 99.99694824 ECU_ADDRESS 0x3fa766 FORMAT "%8.3" /end MEASUREMENT
/begin MEASUREMENT LAM_AD_SUM_P_1 "Counter indicating the number of observed p jumps reported by the lambda controller" UBYTE _CNV_A_R_LINEAR_____10_CM 1 100. 1. 255. ECU_ADDRESS 0x3fa76c FORMAT "%3.0" /end MEASUREMENT
/begin MEASUREMENT STATE_MFF_AD_1 "State indicating the status of the lambda Adaptation, e.g. to concerned time scheduler with CP" UBYTE _CNV_S_6_STATE_MFF__302_CM 1 100. 0. 5. ECU_ADDRESS 0x3fa76d /end MEASUREMENT
/begin MEASUREMENT T_MFF_AD_FAC_1 "Time indicating the time for next requested multiplicative lambda Adaptation" UWORD _CNV_A_R_LINEAR_____14_CM 1 100. 0. 6553.5 ECU_ADDRESS 0x3fa750 FORMAT "%6.1" /end MEASUREMENT
/begin MEASUREMENT T_MFF_AD_ADD_1 "Time indicating the time for next requested additive lambda Adaptation" UWORD _CNV_A_R_LINEAR_____14_CM 1 100. 0. 6553.5 ECU_ADDRESS 0x3fa752 FORMAT "%6.1" /end MEASUREMENT
/begin MEASUREMENT LAMB_SCC_1 "Lambda setpoint at single cylinder cut off" UWORD _CNV_A_R_LINEAR_____148_CM 1 100. 0. 31.99902344 ECU_ADDRESS 0x3fa73e FORMAT "%7.4" /end MEASUREMENT
/begin MEASUREMENT LV_LS_CAT_DIAG_CDN_1 "Activation condidtions for O2 sensor and catalyst efficiency diagnosis" UBYTE _CNV_S_2_RANGE______28_CM 1 100. 0. 1. ECU_ADDRESS 0x3fa930 /end MEASUREMENT
/begin MEASUREMENT MAF_INT_CAT_DIAG_DLY_1 "Air mass flow integral after conditions fulfilled for cat diag activation" UWORD _CNV_A_R_LINEAR_____303_CM 1 100. 0. 1820.42 ECU_ADDRESS 0x3fa932 FORMAT "%7.2" /end MEASUREMENT
/begin MEASUREMENT LV_INH_DIAG_CAT_DIAG_1 "" UBYTE _CNV_S_2_RANGE______28_CM 1 100. 0. 1. ECU_ADDRESS 0x3fa934 /end MEASUREMENT
/begin MEASUREMENT T_VLS_CYC_EFC_1 "" UWORD _CNV_A_R_LINEAR_____27_CM 1 100. 0. 655.35 ECU_ADDRESS 0x3fa938 FORMAT "%5.2" /end MEASUREMENT
/begin MEASUREMENT LV_AUTH_CAT_DIAG_1 "" UBYTE _CNV_S_2_RANGE______28_CM 1 100. 0. 1. ECU_ADDRESS 0x3fa936 /end MEASUREMENT
/begin MEASUREMENT LV_LDC_CAT_1 "" UBYTE _CNV_S_2_RANGE______28_CM 1 100. 0. 1. ECU_ADDRESS 0x3fa707 /end MEASUREMENT
/begin MEASUREMENT MAF_INT_LDC_CAT_1 "integral of mass air flow since limited dynamic conditions fulfilled" UWORD _CNV_A_R_LINEAR_____277_CM 1 100. 0. 1820.398 ECU_ADDRESS 0x3fa700 FORMAT "%7.2" /end MEASUREMENT
/begin MEASUREMENT PV_AV_GRD_SUM "su. value for limited PV_AV gradient" UWORD _CNV_A_R_LINEAR_____304_CM 1 100. 0. 639990.2340000001 ECU_ADDRESS 0x3fa702 FORMAT "%8.1" /end MEASUREMENT
/begin MEASUREMENT LAM_MV_MMV_CAT_1 "floating mean value for limited lambda deviation" SWORD _CNV_A_R_LINEAR_____98_CM 1 100. -50. 49.99847412 ECU_ADDRESS 0x3fa704 FORMAT "%7.3" /end MEASUREMENT
/begin MEASUREMENT LV_REQ_LAMB_SP_LS_ACT_TEST_2 "Request for lambda coordination and canister purge for active plausibility test" ULONG _CNV_S_2_RANGE______28_CM 1 100. 0. 1. ECU_ADDRESS 0x3fac40 BIT_MASK 0x80000000 /end MEASUREMENT
/begin MEASUREMENT LV_VLS_DOWN_AFL_2 "Monitoring sensor has detected lean " ULONG _CNV_S_2_RANGE______28_CM 1 100. 0. 1. ECU_ADDRESS 0x3fac40 BIT_MASK 0x40000000 /end MEASUREMENT
/begin MEASUREMENT LV_VLS_DOWN_AFR_2 " Monitoring sensor has detected rich " ULONG _CNV_S_2_RANGE______28_CM 1 100. 0. 1. ECU_ADDRESS 0x3fac40 BIT_MASK 0x20000000 /end MEASUREMENT
/begin MEASUREMENT LV_END_CYC_CHK_LS_DOWN_2 "End of cycle of active test of downstream sensor" ULONG _CNV_S_2_RANGE______28_CM 1 100. 0. 1. ECU_ADDRESS 0x3fac40 BIT_MASK 0x10000000 /end MEASUREMENT
/begin MEASUREMENT LV_CDN_CYC_CHK_LS_DOWN_2 "Conditions to run active test cycle" ULONG _CNV_S_2_RANGE______28_CM 1 100. 0. 1. ECU_ADDRESS 0x3fac40 BIT_MASK 0x8000000 /end MEASUREMENT
/begin MEASUREMENT LAMB_SP_LS_ACT_TEST_2 "Lambda set point for active plausibility test" UWORD _CNV_A_R_LINEAR_____276_CM 1 100. 0. 31.9990234 ECU_ADDRESS 0x3fac44 FORMAT "%10.7" /end MEASUREMENT
/begin MEASUREMENT LV_DOWN_LS_2 "Logical variable for operative readiness of downstream oxygen sensor(s)" ULONG _CNV_S_2_RANGE______28_CM 1 100. 0. 1. ECU_ADDRESS 0x3fabc8 BIT_MASK 0x80000000 /end MEASUREMENT
/begin MEASUREMENT T_SUM_MAX_FSD_2 "Total duration over C_LAM_MAX_FSD" UWORD _CNV_A_R_LINEAR_____169_CM 1 100. 0. 1310.7 ECU_ADDRESS 0x3faa5c FORMAT "%7.2" /end MEASUREMENT
/begin MEASUREMENT T_SUM_MIN_FSD_2 "Total duration over C_LAM_MIN_FSD" UWORD _CNV_A_R_LINEAR_____169_CM 1 100. 0. 1310.7 ECU_ADDRESS 0x3faa60 FORMAT "%7.2" /end MEASUREMENT
/begin MEASUREMENT T_SUM_END_DIAG_WIN_FSD_2 "Time counter to set LV_END_DIAG_FSD_i" UWORD _CNV_A_R_LINEAR_____169_CM 1 100. 0. 1310.7 ECU_ADDRESS 0x3faa5e FORMAT "%7.2" /end MEASUREMENT
/begin MEASUREMENT T_SUM_RST_FSD_2 "Time counter to reset T_SUM_MAX_FSD_i and T_SUM_MIN_FSD_i" UWORD _CNV_A_R_LINEAR_____169_CM 1 100. 0. 1310.7 ECU_ADDRESS 0x3faa62 FORMAT "%7.2" /end MEASUREMENT
/begin MEASUREMENT LV_CAT_DIAG_CYC_VLD_2 "Monitoring cycle valid, used for calculation of diagnosis value" ULONG _CNV_S_2_RANGE______28_CM 1 100. 0. 1. ECU_ADDRESS 0x3faa24 BIT_MASK 0x80000000 /end MEASUREMENT
/begin MEASUREMENT SUM_CAT_DIAG_2 "monitoring cycle counter" UWORD _CNV_A_R_LINEAR_____10_CM 1 100. 0. 65535. ECU_ADDRESS 0x3faa32 FORMAT "%5.0" /end MEASUREMENT
/begin MEASUREMENT CAT_DIAG_CLC_2 "Diagnostic value, catalytic converter efficiency check, bank i (i=1,2)" UWORD _CNV_A_R_LINEAR_____288_CM 1 100. 0. 20. ECU_ADDRESS 0x3faa38 FORMAT "%5.2" /end MEASUREMENT
/begin MEASUREMENT CAT_DIAG_CUS_2 "Customer diagnostic value, catalytic converter efficiency check, bank i (i=1,2)" UWORD _CNV_A_R_LINEAR_____288_CM 1 100. 0. 20. ECU_ADDRESS 0x3faa40 FORMAT "%5.2" /end MEASUREMENT
/begin MEASUREMENT VLS_CYC_STEP_2 "state-counter for several phases of a rich-lean-cycle" UBYTE _CNV_S_8_STATE_VLS__289_CM 1 100. 0. 255. ECU_ADDRESS 0x3faa36 /end MEASUREMENT
/begin MEASUREMENT SUM_O2_CAT_DIF_2 "Sum of the difference between measured post-CAT oxygen exposure and mean oxygen exposure, bank i (i=1,2)" UWORD _CNV_A_R_LINEAR_____290_CM 1 100. 0. 511.99218 ECU_ADDRESS 0x3faa28 FORMAT "%7.3" /end MEASUREMENT
/begin MEASUREMENT SUM_O2_CAT_2 "Sum of post-catalyst oxygen exposure, bank i (i=1,2)" UWORD _CNV_A_R_LINEAR_____291_CM 1 100. 0. 5.119921 ECU_ADDRESS 0x3faa2a FORMAT "%7.5" /end MEASUREMENT
/begin MEASUREMENT O2_CAT_INT_2 "Mean value of the difference between measured post-CAT oxygen exposure and mean oxygen exposure, bank i (i=1,2)" UBYTE _CNV_A_R_LINEAR_____20_CM 1 100. 0. 0.99610001 ECU_ADDRESS 0x3faa2c FORMAT "%5.3" /end MEASUREMENT
/begin MEASUREMENT O2_CAT_MV_2 "Mean value of post-catalyst oxygen exposure, bank i (i=1,2)" UBYTE _CNV_A_R_LINEAR_____20_CM 1 100. 0. 0.99610001 ECU_ADDRESS 0x3faa2d FORMAT "%5.3" /end MEASUREMENT
/begin MEASUREMENT O2_CAT_RATIO_2 "Quotient of O2_CAT_INT_i and ID_VLS_CAT_INT_MAX_AT/MT__N__MAF, bank i (i=1,2)" UWORD _CNV_A_R_LINEAR_____288_CM 1 100. 0. 20. ECU_ADDRESS 0x3faa30 FORMAT "%5.2" /end MEASUREMENT
/begin MEASUREMENT SUM_O2_CAT_RATIO_2 "Sum of O2_CAT_RATIO_i" UWORD _CNV_A_R_LINEAR_____292_CM 1 100. 0. 2559.96094 ECU_ADDRESS 0x3faa34 FORMAT "%7.2" /end MEASUREMENT
/begin MEASUREMENT SUM_VLS_CAT_O2_2 "Oxygen oscillation at CAT-entry" ULONG _CNV_A_R_LINEAR_____12_CM 1 100. 0. 4294967295. ECU_ADDRESS 0x3faa3c FORMAT "%11.0" /end MEASUREMENT
/begin MEASUREMENT O2_CAT_2 "Value of post-catalyst oxygen exposure, bank i (i=1,2)" UBYTE _CNV_A_R_LINEAR_____20_CM 1 100. 0. 0.99610001 ECU_ADDRESS 0x3faa37 FORMAT "%5.3" /end MEASUREMENT
/begin MEASUREMENT CAT_DIAG_2 "Generic diagnosis value" UBYTE _CNV_A_R_LINEAR_____141_CM 1 100. 0. 1.984375 ECU_ADDRESS 0x3faa42 FORMAT "%4.2" /end MEASUREMENT
/begin MEASUREMENT LV_INH_DIAG_LS_UP_2 "OBD2 function: application incidence for inhibition" ULONG _CNV_S_2_RANGE______28_CM 1 100. 0. 1. ECU_ADDRESS 0x3faccc BIT_MASK 0x40000000 /end MEASUREMENT
/begin MEASUREMENT VLS_CYCNR_MAX_2 "top limit diagnostic threshold for switching time monitoring" UWORD _CNV_A_R_LINEAR_____33_CM 1 100. 0. 4.99511719 ECU_ADDRESS 0x3facf4 FORMAT "%5.3" /end MEASUREMENT
/begin MEASUREMENT VLS_CYCNR_MIN_2 "bottom limit diagnostic threshold for switching time monitoring" UWORD _CNV_A_R_LINEAR_____33_CM 1 100. 0. 4.99511719 ECU_ADDRESS 0x3facf6 FORMAT "%5.3" /end MEASUREMENT
/begin MEASUREMENT T_VLS_CYCNR_2 "actual switching time" UWORD _CNV_A_R_LINEAR_____27_CM 1 100. 0. 655.35 ECU_ADDRESS 0x3facf8 FORMAT "%5.2" /end MEASUREMENT
/begin MEASUREMENT RATIO_VLS_CYCNR_AFL_MV_2 "total ratio between measured and max. allowed switching times from rich to lean" UWORD _CNV_A_R_LINEAR_____111_CM 1 100. 0. 255.996094 ECU_ADDRESS 0x3fad06 FORMAT "%7.3" /end MEASUREMENT
/begin MEASUREMENT RATIO_VLS_CYCNR_AFR_MV_2 "number of measured switching times from rich to lean" UWORD _CNV_A_R_LINEAR_____111_CM 1 100. 0. 255.996094 ECU_ADDRESS 0x3fad08 FORMAT "%7.3" /end MEASUREMENT
/begin MEASUREMENT SUM_CYCNR_AFL_2 "number of measured switching times from rich to lean" UWORD _CNV_A_R_LINEAR_____10_CM 1 100. 0. 65535. ECU_ADDRESS 0x3facfa FORMAT "%5.0" /end MEASUREMENT
/begin MEASUREMENT SUM_CYCNR_AFR_2 "number of measured switching times from lean to rich" UWORD _CNV_A_R_LINEAR_____10_CM 1 100. 0. 65535. ECU_ADDRESS 0x3facfc FORMAT "%5.0" /end MEASUREMENT
/begin MEASUREMENT RATIO_VLS_CYCNR_AFL_2 "ratio between measured and max. allowed switching times from rich to lean" UWORD _CNV_A_R_LINEAR_____111_CM 1 100. 0. 255.996094 ECU_ADDRESS 0x3facfe FORMAT "%7.3" /end MEASUREMENT
/begin MEASUREMENT RATIO_SAE_VLS_CYCNR_AFL_MV_2 "ratio between measured and max. allowed switching times from rich to lean for scantool" UWORD _CNV_A_R_LINEAR_____111_CM 1 100. 0. 255.996094 ECU_ADDRESS 0x3fad0a FORMAT "%7.3" /end MEASUREMENT
/begin MEASUREMENT RATIO_SAE_VLS_CYCNR_AFR_MV_2 "ratio between measured and max. allowed switching times from lean to rich for scantool" UWORD _CNV_A_R_LINEAR_____111_CM 1 100. 0. 255.996094 ECU_ADDRESS 0x3fad0c FORMAT "%7.3" /end MEASUREMENT
/begin MEASUREMENT RATIO_VLS_CYCNR_AFR_2 "ratio between measured and max. allowed switching times from lean to rich" UWORD _CNV_A_R_LINEAR_____111_CM 1 100. 0. 255.996094 ECU_ADDRESS 0x3fad00 FORMAT "%7.3" /end MEASUREMENT
/begin MEASUREMENT T_VLS_AFR_TO_AFL_SUM_2 "sum of SWT rich to lean" UWORD _CNV_A_R_LINEAR_____27_CM 1 100. 0. 655.35 ECU_ADDRESS 0x3fad10 FORMAT "%6.2" /end MEASUREMENT
/begin MEASUREMENT T_VLS_AFR_TO_AFL_SUM_MAX_2 "sum of max SWT rich to lean" UWORD _CNV_A_R_LINEAR_____27_CM 1 100. 0. 655.35 ECU_ADDRESS 0x3fad12 FORMAT "%6.2" /end MEASUREMENT
/begin MEASUREMENT T_VLS_AFL_TO_AFR_SUM_2 "sum of SWT lean to rich" UWORD _CNV_A_R_LINEAR_____27_CM 1 100. 0. 655.35 ECU_ADDRESS 0x3fad14 FORMAT "%6.2" /end MEASUREMENT
/begin MEASUREMENT T_VLS_AFL_TO_AFR_SUM_MAX_2 "sum of max SWT lean to rich" UWORD _CNV_A_R_LINEAR_____27_CM 1 100. 0. 655.35 ECU_ADDRESS 0x3fad16 FORMAT "%6.2" /end MEASUREMENT
/begin MEASUREMENT VLS_SAE_AFL_THD_2 "SWT lean threshold for scantool" UWORD _CNV_A_R_LINEAR_____33_CM 1 100. 0. 4.99511719 ECU_ADDRESS 0x3fad20 FORMAT "%5.3" /end MEASUREMENT
/begin MEASUREMENT VLS_SAE_AFR_THD_2 "SWT rich threshold for scantool" UWORD _CNV_A_R_LINEAR_____33_CM 1 100. 0. 4.99511719 ECU_ADDRESS 0x3fad22 FORMAT "%5.3" /end MEASUREMENT
/begin MEASUREMENT T_SAE_VLS_AFR_AFL_2 "SWT rich to lean for scantool" UBYTE _CNV_A_R_LINEAR_____27_CM 1 100. 0. 2.55 ECU_ADDRESS 0x3fad24 FORMAT "%4.2" /end MEASUREMENT
/begin MEASUREMENT T_SAE_VLS_AFR_AFL_MAX_2 "max. SWT rich to lean for scantool" UBYTE _CNV_A_R_LINEAR_____27_CM 1 100. 0. 2.55 ECU_ADDRESS 0x3fad25 FORMAT "%4.2" /end MEASUREMENT
/begin MEASUREMENT T_SAE_VLS_AFL_AFR_MAX_2 "max. SWT lean to rich for scantool" UBYTE _CNV_A_R_LINEAR_____27_CM 1 100. 0. 2.55 ECU_ADDRESS 0x3fad27 FORMAT "%4.2" /end MEASUREMENT
/begin MEASUREMENT T_SAE_VLS_AFL_AFR_2 "SWT lean to rich for scantool" UBYTE _CNV_A_R_LINEAR_____27_CM 1 100. 0. 2.55 ECU_ADDRESS 0x3fad26 FORMAT "%4.2" /end MEASUREMENT
/begin MEASUREMENT SUM_CYC_2 "number of measured complete controller periods" UWORD _CNV_A_R_LINEAR_____10_CM 1 100. 0. 65535. ECU_ADDRESS 0x3facd0 FORMAT "%5.0" /end MEASUREMENT
/begin MEASUREMENT RATIO_VLS_CYC_AFL_2 "ratio between measured and max. allowed lean time" UWORD _CNV_A_R_LINEAR_____111_CM 1 100. 0. 255.996094 ECU_ADDRESS 0x3facd2 FORMAT "%7.3" /end MEASUREMENT
/begin MEASUREMENT RATIO_VLS_CYC_AFR_2 "ratio between measured and max. allowed  rich time" UWORD _CNV_A_R_LINEAR_____111_CM 1 100. 0. 255.996094 ECU_ADDRESS 0x3facd4 FORMAT "%7.3" /end MEASUREMENT
/begin MEASUREMENT RATIO_VLS_CYC_AFL_SUM_2 "total value of lean time" UWORD _CNV_A_R_LINEAR_____195_CM 1 100. 0. 1023.984375 ECU_ADDRESS 0x3facd6 FORMAT "%7.2" /end MEASUREMENT
/begin MEASUREMENT RATIO_VLS_CYC_AFR_SUM_2 "total value of rich time" UWORD _CNV_A_R_LINEAR_____195_CM 1 100. 0. 1023.984375 ECU_ADDRESS 0x3facd8 FORMAT "%7.2" /end MEASUREMENT
/begin MEASUREMENT RATIO_VLS_CYC_AFL_MV_2 "total ratio between measured and max. allowed lean time" UWORD _CNV_A_R_LINEAR_____111_CM 1 100. 0. 255.996094 ECU_ADDRESS 0x3facda FORMAT "%7.3" /end MEASUREMENT
/begin MEASUREMENT RATIO_VLS_CYC_AFR_MV_2 "total ratio between measured and max. allowed rich time, saved for SAE Mode $6 output" UWORD _CNV_A_R_LINEAR_____111_CM 1 100. 0. 255.996094 ECU_ADDRESS 0x3facdc FORMAT "%7.3" /end MEASUREMENT
/begin MEASUREMENT RATIO_SAE_VLS_CYC_AFL_MV_2 "total ratio between measured and max. allowed lean time, saved for SAE Mode $6 output" UWORD _CNV_A_R_LINEAR_____111_CM 1 100. 0. 255.996094 ECU_ADDRESS 0x3facde FORMAT "%7.3" /end MEASUREMENT
/begin MEASUREMENT RATIO_SAE_VLS_CYC_AFR_MV_2 "total ratio between measured and max. allowed rich time, saved for SAE Mode $6 output" UWORD _CNV_A_R_LINEAR_____111_CM 1 100. 0. 255.996094 ECU_ADDRESS 0x3face0 FORMAT "%7.3" /end MEASUREMENT
/begin MEASUREMENT T_VLS_CYC_AFR_SUM_2 "sum of rich time" UWORD _CNV_A_R_LINEAR_____27_CM 1 100. 0. 655.35 ECU_ADDRESS 0x3fad18 FORMAT "%6.2" /end MEASUREMENT
/begin MEASUREMENT T_VLS_CYC_AFR_SUM_MAX_2 "sum of max rich time" UWORD _CNV_A_R_LINEAR_____27_CM 1 100. 0. 655.35 ECU_ADDRESS 0x3fad1a FORMAT "%6.2" /end MEASUREMENT
/begin MEASUREMENT T_SAE_VLS_CYC_AFR_2 "rich dwell time for scantool" UWORD _CNV_A_R_LINEAR_____27_CM 1 100. 0. 655.35 ECU_ADDRESS 0x3fad28 FORMAT "%6.2" /end MEASUREMENT
/begin MEASUREMENT T_SAE_VLS_CYC_AFR_MAX_2 "max. rich dwell time for scantool" UWORD _CNV_A_R_LINEAR_____27_CM 1 100. 0. 655.35 ECU_ADDRESS 0x3fad2a FORMAT "%6.2" /end MEASUREMENT
/begin MEASUREMENT T_LAM_DLY_P_OLD_2 "The T_LAM_DLY_i value witch was active at the last p-jump" SWORD _CNV_A_R_LINEAR_____280_CM 1 100. -15360. 15359.53125 ECU_ADDRESS 0x3fad1c FORMAT "%8.1" /end MEASUREMENT
/begin MEASUREMENT T_LAM_DLY_P_2 "The T_LAM_DLY_i value of actual p-jump" SWORD _CNV_A_R_LINEAR_____280_CM 1 100. -15360. 15359.53125 ECU_ADDRESS 0x3fad1e FORMAT "%8.1" /end MEASUREMENT
/begin MEASUREMENT SUM_RATIO_VLS_CYCNR_AFL_2 "total value of switching time from rich to lean" UWORD _CNV_A_R_LINEAR_____195_CM 1 100. 0. 1023.984375 ECU_ADDRESS 0x3fad02 FORMAT "%7.2" /end MEASUREMENT
/begin MEASUREMENT SUM_RATIO_VLS_CYCNR_AFR_2 "total value of switching time from lean to rich" UWORD _CNV_A_R_LINEAR_____195_CM 1 100. 0. 1023.984375 ECU_ADDRESS 0x3fad04 FORMAT "%7.2" /end MEASUREMENT
/begin MEASUREMENT T_VLS_CYC_AFR_MV_MAX_2 "mean value of rich time" UWORD _CNV_A_R_LINEAR_____27_CM 1 100. 0. 10.23 ECU_ADDRESS 0x3face2 FORMAT "%5.2" /end MEASUREMENT
/begin MEASUREMENT T_VLS_CYC_AFL_MV_MAX_2 "mean value of lean time" UWORD _CNV_A_R_LINEAR_____27_CM 1 100. 0. 10.23 ECU_ADDRESS 0x3face4 FORMAT "%5.2" /end MEASUREMENT
/begin MEASUREMENT LV_LS_DOWN_SWT_VLD_2 "Validity bit of the current switching time check" ULONG _CNV_S_2_RANGE______28_CM 1 100. 0. 1. ECU_ADDRESS 0x3faba8 BIT_MASK 0x80000000 /end MEASUREMENT
/begin MEASUREMENT LV_VLS_DOWN_PUE_VLD_2 "Debounced diagnosis result of pull end plausibility" ULONG _CNV_S_2_RANGE______28_CM 1 100. 0. 1. ECU_ADDRESS 0x3faba8 BIT_MASK 0x40000000 /end MEASUREMENT
/begin MEASUREMENT LV_CDN_DIAG_LS_DOWN_2 "Status of permission for diagnosis" ULONG _CNV_S_2_RANGE______28_CM 1 100. 0. 1. ECU_ADDRESS 0x3faba8 BIT_MASK 0x20000000 /end MEASUREMENT
/begin MEASUREMENT LV_INH_DIAG_LS_DOWN_2 "OBDII function downstream sensor" ULONG _CNV_S_2_RANGE______28_CM 1 100. 0. 1. ECU_ADDRESS 0x3faba8 BIT_MASK 0x10000000 /end MEASUREMENT
/begin MEASUREMENT CYCNR_VLS_DOWN_ACT_2 "Cycle counter for switching time determination, Bank i" UBYTE _CNV_A_R_LINEAR_____293_CM 1 100. 0. 5100. ECU_ADDRESS 0x3fabb2 FORMAT "%5.0" /end MEASUREMENT
/begin MEASUREMENT CTR_VLS_DOWN_DIAG_2 "Number of valid switching times from rich to lean" UBYTE _CNV_A_R_LINEAR_____10_CM 1 100. 0. 255. ECU_ADDRESS 0x3fabb6 FORMAT "%3.0" /end MEASUREMENT
/begin MEASUREMENT VLS_DOWN_TRAN_PUC_2 "Monitor sensor voltage on activating the trailing throttle fuel cut-off, Bank i " UWORD _CNV_A_R_LINEAR_____33_CM 1 100. 0. 4.99511719 ECU_ADDRESS 0x3fabae FORMAT "%5.3" /end MEASUREMENT
/begin MEASUREMENT CTR_CYCNR_QUO_VLS_DOWN_SUM_2 "Sum of weighted CYCNR_VLS_DOWN_ACT_i, Bank i " UWORD _CNV_A_R_LINEAR_____111_CM 1 100. 0. 255.996094 ECU_ADDRESS 0x3fabb8 FORMAT "%7.3" /end MEASUREMENT
/begin MEASUREMENT CYCNR_RATIO_VLS_DOWN_2 "mean value of the ratio between the monitor sensor switching time and the threshold value" UBYTE _CNV_A_R_LINEAR_____34_CM 1 100. 0. 1.99220002 ECU_ADDRESS 0x3fabba FORMAT "%5.3" /end MEASUREMENT
/begin MEASUREMENT CYCNR_SAE_RATIO_VLS_DOWN_2 "mean value of the ratio between the monitor sensor switching time and the threshold value for scantool" UBYTE _CNV_A_R_LINEAR_____34_CM 1 100. 0. 1.99220002 ECU_ADDRESS 0x3fabbb FORMAT "%5.3" /end MEASUREMENT
/begin MEASUREMENT CYCNR_QUO_VLS_DOWN_2 "weighted value of CYCNR_VLS_DOWN_ACT_i " UWORD _CNV_A_R_LINEAR_____111_CM 1 100. 0. 255.996094 ECU_ADDRESS 0x3fabb4 FORMAT "%7.3" /end MEASUREMENT
/begin MEASUREMENT VLS_DOWN_PUE_2 "Monitor sensor voltage at the time of leaving PUC, Bank i (i=1.2)" UWORD _CNV_A_R_LINEAR_____33_CM 1 100. 0. 4.99511719 ECU_ADDRESS 0x3fabbe FORMAT "%5.3" /end MEASUREMENT
/begin MEASUREMENT CTR_END_DIAG_VLS_DOWN_PUE_2 "Time counter to set LV_END_DIAG_VLS_DOWN_PUE_i" UWORD _CNV_A_R_LINEAR_____10_CM 1 100. 0. 65535. ECU_ADDRESS 0x3fabc4 FORMAT "%5.0" /end MEASUREMENT
/begin MEASUREMENT VLS_DOWN_DIF_DIAG_2 "difference of VLS_DOWN values from the beginning to the end of the MAF_INT_PUE calculation" UWORD _CNV_A_R_LINEAR_____33_CM 1 100. 0. 4.99511719 ECU_ADDRESS 0x3fabc0 FORMAT "%5.3" /end MEASUREMENT
/begin MEASUREMENT VLS_SAE_DOWN_DIF_DIAG_2 "difference of VLS_DOWN values from the beginning to the end of the MAF_INT_PUE calculation for scantool" UWORD _CNV_A_R_LINEAR_____33_CM 1 100. 0. 4.99511719 ECU_ADDRESS 0x3fabc2 FORMAT "%5.3" /end MEASUREMENT
/begin MEASUREMENT CTR_VLS_DOWN_PUE_2 "counter for anti-bounce" UBYTE _CNV_A_R_LINEAR_____10_CM 1 100. 0. 255. ECU_ADDRESS 0x3fabc6 FORMAT "%3.0" /end MEASUREMENT
/begin MEASUREMENT LV_LAM_ADJ_AD_2 "logical value activates the shift of the lambda-controller" ULONG _CNV_S_2_RANGE______28_CM 1 100. 0. 1. ECU_ADDRESS 0x3faa64 BIT_MASK 0x80000000 /end MEASUREMENT
/begin MEASUREMENT LV_LAM_AD_STOP_2 "Logical variable indicates passing stop of the lambda Adaptation" ULONG _CNV_S_2_RANGE______28_CM 1 100. 0. 1. ECU_ADDRESS 0x3faa64 BIT_MASK 0x40000000 /end MEASUREMENT
/begin MEASUREMENT LV_MFF_AD_FAC_LIM_2 "Limitation of multiplicative adapted factor of lower area" ULONG _CNV_S_2_RANGE______28_CM 1 100. 0. 1. ECU_ADDRESS 0x3faa64 BIT_MASK 0x20000000 /end MEASUREMENT
/begin MEASUREMENT LV_MFF_AD_ADD_LIM_2 "Limitation of additive adapted factor" ULONG _CNV_S_2_RANGE______28_CM 1 100. 0. 1. ECU_ADDRESS 0x3faa64 BIT_MASK 0x10000000 /end MEASUREMENT
/begin MEASUREMENT MFF_AD_ADD_MMV_REL_2 "Relative additive adaptive factor" SWORD _CNV_A_R_LINEAR_____261_CM 1 100. -694.5 694.478806 ECU_ADDRESS 0x3faa6c FORMAT "%7.2" /end MEASUREMENT
/begin MEASUREMENT MFF_AD_ADD_MMV_REL_QUO_2 "Relative additive adaptive factor quotient" SWORD _CNV_A_R_LINEAR_____173_CM 1 100. -100. 99.99694824 ECU_ADDRESS 0x3faa6e FORMAT "%8.3" /end MEASUREMENT
/begin MEASUREMENT MFF_AD_FAC_MMV_REL_2 "Relative Multiplicative adaptive factor" SWORD _CNV_A_R_LINEAR_____98_CM 1 100. -50. 49.99847412 ECU_ADDRESS 0x3faa76 FORMAT "%7.3" /end MEASUREMENT
/begin MEASUREMENT MFF_AD_ADD_MMV_2 "Additive adaptive factor" SWORD _CNV_A_R_LINEAR_____261_CM 1 100. -694.5 694.478806 ECU_ADDRESS 0x3faa70 FORMAT "%7.2" /end MEASUREMENT
/begin MEASUREMENT MFF_AD_FAC_MMV_2 "Multiplicative adaptive factor" SWORD _CNV_A_R_LINEAR_____98_CM 1 100. -50. 49.99847412 ECU_ADDRESS 0x3faa78 FORMAT "%7.3" /end MEASUREMENT
/begin MEASUREMENT LAM_ADJ_AD_2 "output value for the lambda controller shift" SWORD _CNV_A_R_LINEAR_____98_CM 1 100. -50. 49.99847412 ECU_ADDRESS 0x3faa7c FORMAT "%7.3" /end MEASUREMENT
/begin MEASUREMENT MFF_AD_ADD_MMV_DELTA_2 "Difference of additive adaptive factor to previous Adaptation" SWORD _CNV_A_R_LINEAR_____261_CM 1 100. -694.5 694.478806 ECU_ADDRESS 0x3faa72 FORMAT "%7.2" /end MEASUREMENT
/begin MEASUREMENT MFF_AD_ADD_MMV_DELTA_H_RES_2 "Difference of additive adaptive factor to previous Adaptation" SWORD _CNV_A_R_LINEAR_____301_CM 1 100. -10.85 10.85 ECU_ADDRESS 0x3faa74 FORMAT "%7.2" /end MEASUREMENT
/begin MEASUREMENT MFF_AD_FAC_MMV_DELTA_2 "Difference of multiplicative adaptive factor to previous Adaptation" SWORD _CNV_A_R_LINEAR_____98_CM 1 100. -50. 49.99847412 ECU_ADDRESS 0x3faa7a FORMAT "%7.3" /end MEASUREMENT
/begin MEASUREMENT MFF_SAE_AD_MMV_REL_2 "Relative adaptive correction for cylinder bank i for scantool" SWORD _CNV_A_R_LINEAR_____173_CM 1 100. -100. 99.99694824 ECU_ADDRESS 0x3faa7e FORMAT "%8.3" /end MEASUREMENT
/begin MEASUREMENT LAM_AD_SUM_P_2 "Counter indicating the number of observed p jumps reported by the lambda controller" UBYTE _CNV_A_R_LINEAR_____10_CM 1 100. 1. 255. ECU_ADDRESS 0x3faa84 FORMAT "%3.0" /end MEASUREMENT
/begin MEASUREMENT STATE_MFF_AD_2 "State indicating the status of the lambda Adaptation, e.g. to concerned time scheduler with CP" UBYTE _CNV_S_6_STATE_MFF__302_CM 1 100. 0. 5. ECU_ADDRESS 0x3faa85 /end MEASUREMENT
/begin MEASUREMENT T_MFF_AD_FAC_2 "Time indicating the time for next requested multiplicative lambda Adaptation" UWORD _CNV_A_R_LINEAR_____14_CM 1 100. 0. 6553.5 ECU_ADDRESS 0x3faa68 FORMAT "%6.1" /end MEASUREMENT
/begin MEASUREMENT T_MFF_AD_ADD_2 "Time indicating the time for next requested additive lambda Adaptation" UWORD _CNV_A_R_LINEAR_____14_CM 1 100. 0. 6553.5 ECU_ADDRESS 0x3faa6a FORMAT "%6.1" /end MEASUREMENT
/begin MEASUREMENT LAMB_SCC_2 "Lambda setpoint at single cylinder cut off" UWORD _CNV_A_R_LINEAR_____148_CM 1 100. 0. 31.99902344 ECU_ADDRESS 0x3faa56 FORMAT "%7.4" /end MEASUREMENT
/begin MEASUREMENT LV_LS_CAT_DIAG_CDN_2 "Activation condidtions for O2 sensor and catalyst efficiency diagnosis" UBYTE _CNV_S_2_RANGE______28_CM 1 100. 0. 1. ECU_ADDRESS 0x3fac48 /end MEASUREMENT
/begin MEASUREMENT MAF_INT_CAT_DIAG_DLY_2 "Air mass flow integral after conditions fulfilled for cat diag activation" UWORD _CNV_A_R_LINEAR_____303_CM 1 100. 0. 1820.42 ECU_ADDRESS 0x3fac4a FORMAT "%7.2" /end MEASUREMENT
/begin MEASUREMENT LV_INH_DIAG_CAT_DIAG_2 "" UBYTE _CNV_S_2_RANGE______28_CM 1 100. 0. 1. ECU_ADDRESS 0x3fac4c /end MEASUREMENT
/begin MEASUREMENT T_VLS_CYC_EFC_2 "" UWORD _CNV_A_R_LINEAR_____27_CM 1 100. 0. 655.35 ECU_ADDRESS 0x3fac50 FORMAT "%5.2" /end MEASUREMENT
/begin MEASUREMENT LV_AUTH_CAT_DIAG_2 "" UBYTE _CNV_S_2_RANGE______28_CM 1 100. 0. 1. ECU_ADDRESS 0x3fac4e /end MEASUREMENT
/begin MEASUREMENT LV_LDC_CAT_2 "" UBYTE _CNV_S_2_RANGE______28_CM 1 100. 0. 1. ECU_ADDRESS 0x3faa1f /end MEASUREMENT
/begin MEASUREMENT MAF_INT_LDC_CAT_2 "integral of mass air flow since limited dynamic conditions fulfilled" UWORD _CNV_A_R_LINEAR_____277_CM 1 100. 0. 1820.398 ECU_ADDRESS 0x3faa18 FORMAT "%7.2" /end MEASUREMENT
/begin MEASUREMENT LAM_MV_MMV_CAT_2 "floating mean value for limited lambda deviation" SWORD _CNV_A_R_LINEAR_____98_CM 1 100. -50. 49.99847412 ECU_ADDRESS 0x3faa1c FORMAT "%7.3" /end MEASUREMENT
/begin CHARACTERISTIC IP_LAMB_SCC "lambda setpoint for single cylinder shut off" CURVE 0x48e02 _REC_CUR_20_u2_u1 31.99902344 _CNV_A_R_LINEAR_____148_CM 0. 31.99902344 FORMAT "%7.4"
 /begin AXIS_DESCR COM_AXIS TCO _CNV_A_R_LINEAR_____0_CM 8 -48. 142.5 FORMAT "%5.1" AXIS_PTS_REF ldp_tco_ip_lamb_scc /end AXIS_DESCR
/end CHARACTERISTIC
/begin AXIS_PTS ldp_tco_ip_lamb_scc "" 0x43918 TCO _REC_AXS_20_u1 190.5 _CNV_A_R_LINEAR_____0_CM 8 -48. 142.5 FORMAT "%5.1" /end AXIS_PTS
/begin CHARACTERISTIC C_TEMP_CAT_DOWN_LS_READY "Temperature threshold above which O2 sensor recognised as operatively ready" VALUE 0x4307e _REC_VAL_20_u2 1023.984375 _CNV_A_R_LINEAR_____305_CM -33. 990.984375 FORMAT "%5.2" /end CHARACTERISTIC
/begin MEASUREMENT LV_DLY_LS_READY "Logical variable set if delay time of operability detection has elapsed" UBYTE _CNV_S_2_RANGE______11_CM 1 100. 0. 1. ECU_ADDRESS 0x3fdc90 BIT_MASK 0x1 /end MEASUREMENT
/begin MEASUREMENT LV_T_MIN_LS "Logical variable set if delay time C_T_MIN_LS has elapsed" UBYTE _CNV_S_2_RANGE______28_CM 1 100. 0. 1. ECU_ADDRESS 0x3fcbc3 BIT_MASK 0x1 /end MEASUREMENT
/begin CHARACTERISTIC C_TEMP_MIN_LS_UP "Exhaust gas temperature minimum for the detection of the limited sensor operability" VALUE 0x43086 _REC_VAL_20_u2 2047. _CNV_A_R_LINEAR_____211_CM 0. 2047. FORMAT "%7.2" /end CHARACTERISTIC
/begin CHARACTERISTIC C_R_MIN_LS_READY "Internal resistance threshold for detection of operability" VALUE 0x42f12 _REC_VAL_20_u2 65535. _CNV_A_R_LINEAR_____285_CM 0. 65535. FORMAT "%5.0" /end CHARACTERISTIC
/begin CHARACTERISTIC C_VLS_AFL_MAX_DIAG "rich VLS_UP_i threshold for detection of operability" VALUE 0x43164 _REC_VAL_20_u2 4.99511719 _CNV_A_R_LINEAR_____33_CM 0. 4.99511719 FORMAT "%5.3" /end CHARACTERISTIC
/begin CHARACTERISTIC C_VLS_AFR_MIN_DIAG "" VALUE 0x4316e _REC_VAL_20_u2 4.99511719 _CNV_A_R_LINEAR_____33_CM 0. 4.99511719 FORMAT "%5.3" /end CHARACTERISTIC
/begin CHARACTERISTIC ID_T_DLY_LS_READY "Delay time before starting detection of operability" CURVE 0x4cf87 _REC_CUR_20_u1_u1 76.2 _CNV_A_R_LINEAR_____330_CM 0.3 76.5 FORMAT "%4.1"
 /begin AXIS_DESCR COM_AXIS TCO_ST _CNV_A_R_LINEAR_____0_CM 8 -48. 142.5 FORMAT "%5.1" AXIS_PTS_REF ldp_tco_st_t_dly_ls_ready /end AXIS_DESCR
/end CHARACTERISTIC
/begin AXIS_PTS ldp_tco_st_t_dly_ls_ready "" 0x4397b TCO_ST _REC_AXS_20_u1 190.5 _CNV_A_R_LINEAR_____0_CM 8 -48. 142.5 FORMAT "%5.1" /end AXIS_PTS
/begin MEASUREMENT LV_VLS_DOWN_MAF_INT_PUC "Minimum mass air flow integral in puc reached" UBYTE _CNV_S_2_RANGE______11_CM 1 100. 0. 1. ECU_ADDRESS 0x3fdc8a BIT_MASK 0x1 /end MEASUREMENT
/begin MEASUREMENT LV_VLS_DOWN_MAF_INT "Minimum mass air flow integral outside of puc reached" UBYTE _CNV_S_2_RANGE______11_CM 1 100. 0. 1. ECU_ADDRESS 0x3fdc8b BIT_MASK 0x1 /end MEASUREMENT
/begin MEASUREMENT LV_ERR_CHK_LS_DOWN_1 "Debounced failure in the downstream sensor" UBYTE _CNV_S_2_RANGE______11_CM 1 100. 0. 1. ECU_ADDRESS 0x3fd69f BIT_MASK 0x1 /end MEASUREMENT
/begin MEASUREMENT LV_ERR_CHK_LS_DOWN_2 "Debounced failure in the downstream sensor" UBYTE _CNV_S_2_RANGE______11_CM 1 100. 0. 1. ECU_ADDRESS 0x3fd6a3 BIT_MASK 0x1 /end MEASUREMENT
/begin MEASUREMENT MAF_INT_PUC_VLS_DOWN "Mass air flow integral in puc" UWORD _CNV_A_R_LINEAR_____303_CM 1 100. 0. 1820.42 ECU_ADDRESS 0x3fdc82 FORMAT "%7.2" /end MEASUREMENT
/begin MEASUREMENT MAF_INT_VLS_DOWN "Mass air flow integral outside of puc" UWORD _CNV_A_R_LINEAR_____303_CM 1 100. 0. 1820.42 ECU_ADDRESS 0x3fdc84 FORMAT "%7.2" /end MEASUREMENT
/begin MEASUREMENT MAF_INT_DIAG_AFL "Mass air flow integral lean" UWORD _CNV_A_R_LINEAR_____303_CM 1 100. 0. 1820.42 ECU_ADDRESS 0x3fdc86 FORMAT "%7.2" /end MEASUREMENT
/begin MEASUREMENT MAF_INT_DIAG_AFR "Mass air flow integral rich" UWORD _CNV_A_R_LINEAR_____303_CM 1 100. 0. 1820.42 ECU_ADDRESS 0x3fdc88 FORMAT "%7.2" /end MEASUREMENT
/begin CHARACTERISTIC C_VLS_DOWN_THD_AFL_DIAG "Lambda sensor voltage lean detected" VALUE 0x4319c _REC_VAL_20_u2 4.995 _CNV_A_R_LINEAR_____318_CM 0. 4.995 FORMAT "%5.3" /end CHARACTERISTIC
/begin CHARACTERISTIC C_VLS_DOWN_THD_AFR_DIAG "Lambda sensor voltage rich detected" VALUE 0x4319e _REC_VAL_20_u2 4.995 _CNV_A_R_LINEAR_____318_CM 0. 4.995 FORMAT "%5.3" /end CHARACTERISTIC
/begin CHARACTERISTIC C_MAF_INT_PUC_VLS_DOWN "Threshold for mass air flow integral in puc" VALUE 0x42e44 _REC_VAL_20_u2 1820.42 _CNV_A_R_LINEAR_____303_CM 0. 1820.42 FORMAT "%7.2" /end CHARACTERISTIC
/begin CHARACTERISTIC C_MAF_INT_VLS_DOWN "Threshold for mass air flow integral outside of puc" VALUE 0x42e4e _REC_VAL_20_u2 1820.42 _CNV_A_R_LINEAR_____303_CM 0. 1820.42 FORMAT "%7.2" /end CHARACTERISTIC
/begin CHARACTERISTIC C_MAF_INT_AFR_MAX_DIAG "Threshold for mass air flow integral rich" VALUE 0x42e22 _REC_VAL_20_u2 1820.42 _CNV_A_R_LINEAR_____303_CM 0. 1820.42 FORMAT "%7.2" /end CHARACTERISTIC
/begin CHARACTERISTIC C_MAF_INT_AFL_MAX_DIAG "Threshold for mass air flow integral lean" VALUE 0x42e20 _REC_VAL_20_u2 1820.42 _CNV_A_R_LINEAR_____303_CM 0. 1820.42 FORMAT "%7.2" /end CHARACTERISTIC
/begin CHARACTERISTIC C_T_DLY_LS_DIAG_MIN "Start of diagnosis after lambda sensor normal operation" VALUE 0x42f92 _REC_VAL_20_u2 6553.5 _CNV_A_R_LINEAR_____14_CM 0. 6553.5 FORMAT "%6.1" /end CHARACTERISTIC
/begin CHARACTERISTIC C_TCO_VLS_DOWN_DIAG_MIN "Minimum tco temperature for starting the diagnosis" VALUE 0x42a8e _REC_VAL_20_u1 190.5 _CNV_A_R_LINEAR_____0_CM -48. 142.5 FORMAT "%5.1" /end CHARACTERISTIC
/begin CHARACTERISTIC C_T_AST_VLS_DOWN_DIAG "Time after start for interrogation of the mass air flow integrals" VALUE 0x42f60 _REC_VAL_20_u2 6553.5 _CNV_A_R_LINEAR_____14_CM 0. 6553.5 FORMAT "%6.1" /end CHARACTERISTIC
/begin CHARACTERISTIC C_LAMB_SP_LS_ACT_AFR "Max. lambda set point for rich fault detection" VALUE 0x42dd6 _REC_VAL_20_u2 31.9990234 _CNV_A_R_LINEAR_____276_CM 0. 31.9990234 FORMAT "%10.7" /end CHARACTERISTIC
/begin CHARACTERISTIC C_LAMB_SP_LS_ACT_AFL "Min. lambda set point for rich fault detection" VALUE 0x42dd4 _REC_VAL_20_u2 31.9990234 _CNV_A_R_LINEAR_____276_CM 0. 31.9990234 FORMAT "%10.7" /end CHARACTERISTIC
/begin MEASUREMENT CTR_FRC_0 "Frequency counter of failure N" UBYTE _CNV_A_R_LINEAR_____10_CM 1 100. 0. 255. ECU_ADDRESS 0x3fd2e4 FORMAT "%3.0" /end MEASUREMENT
/begin MEASUREMENT CTR_WUP_CYC_0 "Counter for warm-up cycle" UBYTE _CNV_A_R_LINEAR_____10_CM 1 100. 0. 255. ECU_ADDRESS 0x3fd2e5 FORMAT "%3.0" /end MEASUREMENT
/begin MEASUREMENT CTR_DC_0 "Counter for driving cycle" UBYTE _CNV_A_R_LINEAR_____10_CM 1 100. 0. 255. ECU_ADDRESS 0x3fd2e6 FORMAT "%3.0" /end MEASUREMENT
/begin MEASUREMENT ERR_INFO_DYN "" UWORD _CNV_S_2_RANGE______21_R_CM 1 100. 0. 255. ECU_ADDRESS 0x3fd2e2 /end MEASUREMENT
/begin MEASUREMENT LV_ERR_DC_0 "" UWORD _CNV_S_2_RANGE______183_CM 1 100. 0. 1. ECU_ADDRESS 0x3fd2e2 BIT_MASK 0x20 /end MEASUREMENT
/begin MEASUREMENT LV_ERR_TMP_0 "" UWORD _CNV_S_2_RANGE______21_R_CM 1 100. 0. 255. ECU_ADDRESS 0x3fd2e2 BIT_MASK 0x40 /end MEASUREMENT
/begin MEASUREMENT LV_ERR_DISA_0 "" UWORD _CNV_S_2_RANGE______21_R_CM 1 100. 0. 255. ECU_ADDRESS 0x3fd2e2 BIT_MASK 0x100 /end MEASUREMENT
/begin MEASUREMENT LV_DC_MAX_0 "" UWORD _CNV_S_2_RANGE______21_R_CM 1 100. 0. 255. ECU_ADDRESS 0x3fd2e2 BIT_MASK 0x200 /end MEASUREMENT
/begin MEASUREMENT LV_ERR_CFM_0 "" UWORD _CNV_S_2_RANGE______21_R_CM 1 100. 0. 255. ECU_ADDRESS 0x3fd2e2 BIT_MASK 0x80 /end MEASUREMENT
/begin MEASUREMENT LV_ERR_MKD_0 "" UWORD _CNV_S_2_RANGE______21_R_CM 1 100. 0. 255. ECU_ADDRESS 0x3fd2e2 BIT_MASK 0x400 /end MEASUREMENT
/begin MEASUREMENT DIAG_INST_0 "" UWORD _CNV_S_234_RANGE_DIAG_382_CM 1 100. 0. 233. ECU_ADDRESS 0x3fd2e0 /end MEASUREMENT
/begin MEASUREMENT CTR_FRC_1 "Frequency counter of failure N" UBYTE _CNV_A_R_LINEAR_____10_CM 1 100. 0. 255. ECU_ADDRESS 0x3fd2ee FORMAT "%3.0" /end MEASUREMENT
/begin MEASUREMENT CTR_WUP_CYC_1 "Counter for warm-up cycle" UBYTE _CNV_A_R_LINEAR_____10_CM 1 100. 0. 255. ECU_ADDRESS 0x3fd2ef FORMAT "%3.0" /end MEASUREMENT
/begin MEASUREMENT CTR_DC_1 "Counter for driving cycle" UBYTE _CNV_A_R_LINEAR_____10_CM 1 100. 0. 255. ECU_ADDRESS 0x3fd2f0 FORMAT "%3.0" /end MEASUREMENT
/begin MEASUREMENT LV_ERR_DC_1 "" UWORD _CNV_S_2_RANGE______183_CM 1 100. 0. 1. ECU_ADDRESS 0x3fd2ec BIT_MASK 0x20 /end MEASUREMENT
/begin MEASUREMENT LV_ERR_TMP_1 "" UWORD _CNV_S_2_RANGE______21_R_CM 1 100. 0. 255. ECU_ADDRESS 0x3fd2ec BIT_MASK 0x40 /end MEASUREMENT
/begin MEASUREMENT LV_ERR_DISA_1 "" UWORD _CNV_S_2_RANGE______21_R_CM 1 100. 0. 255. ECU_ADDRESS 0x3fd2ec BIT_MASK 0x100 /end MEASUREMENT
/begin MEASUREMENT LV_DC_MAX_1 "" UWORD _CNV_S_2_RANGE______21_R_CM 1 100. 0. 255. ECU_ADDRESS 0x3fd2ec BIT_MASK 0x200 /end MEASUREMENT
/begin MEASUREMENT LV_ERR_CFM_1 "" UWORD _CNV_S_2_RANGE______21_R_CM 1 100. 0. 255. ECU_ADDRESS 0x3fd2ec BIT_MASK 0x80 /end MEASUREMENT
/begin MEASUREMENT LV_ERR_MKD_1 "" UWORD _CNV_S_2_RANGE______21_R_CM 1 100. 0. 255. ECU_ADDRESS 0x3fd2ec BIT_MASK 0x400 /end MEASUREMENT
/begin MEASUREMENT DIAG_INST_1 "" UWORD _CNV_S_234_RANGE_DIAG_382_CM 1 100. 0. 233. ECU_ADDRESS 0x3fd2ea /end MEASUREMENT
/begin MEASUREMENT CTR_FRC_2 "Frequency counter of failure N" UBYTE _CNV_A_R_LINEAR_____10_CM 1 100. 0. 255. ECU_ADDRESS 0x3fd2f8 FORMAT "%3.0" /end MEASUREMENT
/begin MEASUREMENT CTR_WUP_CYC_2 "Counter for warm-up cycle" UBYTE _CNV_A_R_LINEAR_____10_CM 1 100. 0. 255. ECU_ADDRESS 0x3fd2f9 FORMAT "%3.0" /end MEASUREMENT
/begin MEASUREMENT CTR_DC_2 "Counter for driving cycle" UBYTE _CNV_A_R_LINEAR_____10_CM 1 100. 0. 255. ECU_ADDRESS 0x3fd2fa FORMAT "%3.0" /end MEASUREMENT
/begin MEASUREMENT LV_ERR_DC_2 "" UWORD _CNV_S_2_RANGE______183_CM 1 100. 0. 1. ECU_ADDRESS 0x3fd2f6 BIT_MASK 0x20 /end MEASUREMENT
/begin MEASUREMENT LV_ERR_TMP_2 "" UWORD _CNV_S_2_RANGE______21_R_CM 1 100. 0. 255. ECU_ADDRESS 0x3fd2f6 BIT_MASK 0x40 /end MEASUREMENT
/begin MEASUREMENT LV_ERR_DISA_2 "" UWORD _CNV_S_2_RANGE______21_R_CM 1 100. 0. 255. ECU_ADDRESS 0x3fd2f6 BIT_MASK 0x100 /end MEASUREMENT
/begin MEASUREMENT LV_DC_MAX_2 "" UWORD _CNV_S_2_RANGE______21_R_CM 1 100. 0. 255. ECU_ADDRESS 0x3fd2f6 BIT_MASK 0x200 /end MEASUREMENT
/begin MEASUREMENT LV_ERR_CFM_2 "" UWORD _CNV_S_2_RANGE______21_R_CM 1 100. 0. 255. ECU_ADDRESS 0x3fd2f6 BIT_MASK 0x80 /end MEASUREMENT
/begin MEASUREMENT LV_ERR_MKD_2 "" UWORD _CNV_S_2_RANGE______21_R_CM 1 100. 0. 255. ECU_ADDRESS 0x3fd2f6 BIT_MASK 0x400 /end MEASUREMENT
/begin MEASUREMENT DIAG_INST_2 "" UWORD _CNV_S_234_RANGE_DIAG_382_CM 1 100. 0. 233. ECU_ADDRESS 0x3fd2f4 /end MEASUREMENT
/begin MEASUREMENT CTR_FRC_3 "Frequency counter of failure N" UBYTE _CNV_A_R_LINEAR_____10_CM 1 100. 0. 255. ECU_ADDRESS 0x3fd302 FORMAT "%3.0" /end MEASUREMENT
/begin MEASUREMENT CTR_WUP_CYC_3 "Counter for warm-up cycle" UBYTE _CNV_A_R_LINEAR_____10_CM 1 100. 0. 255. ECU_ADDRESS 0x3fd303 FORMAT "%3.0" /end MEASUREMENT
/begin MEASUREMENT CTR_DC_3 "Counter for driving cycle" UBYTE _CNV_A_R_LINEAR_____10_CM 1 100. 0. 255. ECU_ADDRESS 0x3fd304 FORMAT "%3.0" /end MEASUREMENT
/begin MEASUREMENT LV_ERR_DC_3 "" UWORD _CNV_S_2_RANGE______183_CM 1 100. 0. 1. ECU_ADDRESS 0x3fd300 BIT_MASK 0x20 /end MEASUREMENT
/begin MEASUREMENT LV_ERR_TMP_3 "" UWORD _CNV_S_2_RANGE______21_R_CM 1 100. 0. 255. ECU_ADDRESS 0x3fd300 BIT_MASK 0x40 /end MEASUREMENT
/begin MEASUREMENT LV_ERR_DISA_3 "" UWORD _CNV_S_2_RANGE______21_R_CM 1 100. 0. 255. ECU_ADDRESS 0x3fd300 BIT_MASK 0x100 /end MEASUREMENT
/begin MEASUREMENT LV_DC_MAX_3 "" UWORD _CNV_S_2_RANGE______21_R_CM 1 100. 0. 255. ECU_ADDRESS 0x3fd300 BIT_MASK 0x200 /end MEASUREMENT
/begin MEASUREMENT LV_ERR_CFM_3 "" UWORD _CNV_S_2_RANGE______21_R_CM 1 100. 0. 255. ECU_ADDRESS 0x3fd300 BIT_MASK 0x80 /end MEASUREMENT
/begin MEASUREMENT LV_ERR_MKD_3 "" UWORD _CNV_S_2_RANGE______21_R_CM 1 100. 0. 255. ECU_ADDRESS 0x3fd300 BIT_MASK 0x400 /end MEASUREMENT
/begin MEASUREMENT DIAG_INST_3 "" UWORD _CNV_S_234_RANGE_DIAG_382_CM 1 100. 0. 233. ECU_ADDRESS 0x3fd2fe /end MEASUREMENT
/begin MEASUREMENT CTR_FRC_4 "Frequency counter of failure N" UBYTE _CNV_A_R_LINEAR_____10_CM 1 100. 0. 255. ECU_ADDRESS 0x3fd30c FORMAT "%3.0" /end MEASUREMENT
/begin MEASUREMENT CTR_WUP_CYC_4 "Counter for warm-up cycle" UBYTE _CNV_A_R_LINEAR_____10_CM 1 100. 0. 255. ECU_ADDRESS 0x3fd30d FORMAT "%3.0" /end MEASUREMENT
/begin MEASUREMENT CTR_DC_4 "Counter for driving cycle" UBYTE _CNV_A_R_LINEAR_____10_CM 1 100. 0. 255. ECU_ADDRESS 0x3fd30e FORMAT "%3.0" /end MEASUREMENT
/begin MEASUREMENT LV_ERR_DC_4 "" UWORD _CNV_S_2_RANGE______183_CM 1 100. 0. 1. ECU_ADDRESS 0x3fd30a BIT_MASK 0x20 /end MEASUREMENT
/begin MEASUREMENT LV_ERR_TMP_4 "" UWORD _CNV_S_2_RANGE______21_R_CM 1 100. 0. 255. ECU_ADDRESS 0x3fd30a BIT_MASK 0x40 /end MEASUREMENT
/begin MEASUREMENT LV_ERR_DISA_4 "" UWORD _CNV_S_2_RANGE______21_R_CM 1 100. 0. 255. ECU_ADDRESS 0x3fd30a BIT_MASK 0x100 /end MEASUREMENT
/begin MEASUREMENT LV_DC_MAX_4 "" UWORD _CNV_S_2_RANGE______21_R_CM 1 100. 0. 255. ECU_ADDRESS 0x3fd30a BIT_MASK 0x200 /end MEASUREMENT
/begin MEASUREMENT LV_ERR_CFM_4 "" UWORD _CNV_S_2_RANGE______21_R_CM 1 100. 0. 255. ECU_ADDRESS 0x3fd30a BIT_MASK 0x80 /end MEASUREMENT
/begin MEASUREMENT LV_ERR_MKD_4 "" UWORD _CNV_S_2_RANGE______21_R_CM 1 100. 0. 255. ECU_ADDRESS 0x3fd30a BIT_MASK 0x400 /end MEASUREMENT
/begin MEASUREMENT DIAG_INST_4 "" UWORD _CNV_S_234_RANGE_DIAG_382_CM 1 100. 0. 233. ECU_ADDRESS 0x3fd308 /end MEASUREMENT
/begin MEASUREMENT CTR_FRC_5 "Frequency counter of failure N" UBYTE _CNV_A_R_LINEAR_____10_CM 1 100. 0. 255. ECU_ADDRESS 0x3fd316 FORMAT "%3.0" /end MEASUREMENT
/begin MEASUREMENT CTR_WUP_CYC_5 "Counter for warm-up cycle" UBYTE _CNV_A_R_LINEAR_____10_CM 1 100. 0. 255. ECU_ADDRESS 0x3fd317 FORMAT "%3.0" /end MEASUREMENT
/begin MEASUREMENT CTR_DC_5 "Counter for driving cycle" UBYTE _CNV_A_R_LINEAR_____10_CM 1 100. 0. 255. ECU_ADDRESS 0x3fd318 FORMAT "%3.0" /end MEASUREMENT
/begin MEASUREMENT LV_ERR_DC_5 "" UWORD _CNV_S_2_RANGE______183_CM 1 100. 0. 1. ECU_ADDRESS 0x3fd314 BIT_MASK 0x20 /end MEASUREMENT
/begin MEASUREMENT LV_ERR_TMP_5 "" UWORD _CNV_S_2_RANGE______21_R_CM 1 100. 0. 255. ECU_ADDRESS 0x3fd314 BIT_MASK 0x40 /end MEASUREMENT
/begin MEASUREMENT LV_ERR_DISA_5 "" UWORD _CNV_S_2_RANGE______21_R_CM 1 100. 0. 255. ECU_ADDRESS 0x3fd314 BIT_MASK 0x100 /end MEASUREMENT
/begin MEASUREMENT LV_DC_MAX_5 "" UWORD _CNV_S_2_RANGE______21_R_CM 1 100. 0. 255. ECU_ADDRESS 0x3fd314 BIT_MASK 0x200 /end MEASUREMENT
/begin MEASUREMENT LV_ERR_CFM_5 "" UWORD _CNV_S_2_RANGE______21_R_CM 1 100. 0. 255. ECU_ADDRESS 0x3fd314 BIT_MASK 0x80 /end MEASUREMENT
/begin MEASUREMENT LV_ERR_MKD_5 "" UWORD _CNV_S_2_RANGE______21_R_CM 1 100. 0. 255. ECU_ADDRESS 0x3fd314 BIT_MASK 0x400 /end MEASUREMENT
/begin MEASUREMENT DIAG_INST_5 "" UWORD _CNV_S_234_RANGE_DIAG_382_CM 1 100. 0. 233. ECU_ADDRESS 0x3fd312 /end MEASUREMENT
/begin MEASUREMENT CTR_FRC_6 "Frequency counter of failure N" UBYTE _CNV_A_R_LINEAR_____10_CM 1 100. 0. 255. ECU_ADDRESS 0x3fd320 FORMAT "%3.0" /end MEASUREMENT
/begin MEASUREMENT CTR_WUP_CYC_6 "Counter for warm-up cycle" UBYTE _CNV_A_R_LINEAR_____10_CM 1 100. 0. 255. ECU_ADDRESS 0x3fd321 FORMAT "%3.0" /end MEASUREMENT
/begin MEASUREMENT CTR_DC_6 "Counter for driving cycle" UBYTE _CNV_A_R_LINEAR_____10_CM 1 100. 0. 255. ECU_ADDRESS 0x3fd322 FORMAT "%3.0" /end MEASUREMENT
/begin MEASUREMENT LV_ERR_DC_6 "" UWORD _CNV_S_2_RANGE______183_CM 1 100. 0. 1. ECU_ADDRESS 0x3fd31e BIT_MASK 0x20 /end MEASUREMENT
/begin MEASUREMENT LV_ERR_TMP_6 "" UWORD _CNV_S_2_RANGE______21_R_CM 1 100. 0. 255. ECU_ADDRESS 0x3fd31e BIT_MASK 0x40 /end MEASUREMENT
/begin MEASUREMENT LV_ERR_DISA_6 "" UWORD _CNV_S_2_RANGE______21_R_CM 1 100. 0. 255. ECU_ADDRESS 0x3fd31e BIT_MASK 0x100 /end MEASUREMENT
/begin MEASUREMENT LV_DC_MAX_6 "" UWORD _CNV_S_2_RANGE______21_R_CM 1 100. 0. 255. ECU_ADDRESS 0x3fd31e BIT_MASK 0x200 /end MEASUREMENT
/begin MEASUREMENT LV_ERR_CFM_6 "" UWORD _CNV_S_2_RANGE______21_R_CM 1 100. 0. 255. ECU_ADDRESS 0x3fd31e BIT_MASK 0x80 /end MEASUREMENT
/begin MEASUREMENT LV_ERR_MKD_6 "" UWORD _CNV_S_2_RANGE______21_R_CM 1 100. 0. 255. ECU_ADDRESS 0x3fd31e BIT_MASK 0x400 /end MEASUREMENT
/begin MEASUREMENT DIAG_INST_6 "" UWORD _CNV_S_234_RANGE_DIAG_382_CM 1 100. 0. 233. ECU_ADDRESS 0x3fd31c /end MEASUREMENT
/begin MEASUREMENT CTR_FRC_7 "Frequency counter of failure N" UBYTE _CNV_A_R_LINEAR_____10_CM 1 100. 0. 255. ECU_ADDRESS 0x3fd32a FORMAT "%3.0" /end MEASUREMENT
/begin MEASUREMENT CTR_WUP_CYC_7 "Counter for warm-up cycle" UBYTE _CNV_A_R_LINEAR_____10_CM 1 100. 0. 255. ECU_ADDRESS 0x3fd32b FORMAT "%3.0" /end MEASUREMENT
/begin MEASUREMENT CTR_DC_7 "Counter for driving cycle" UBYTE _CNV_A_R_LINEAR_____10_CM 1 100. 0. 255. ECU_ADDRESS 0x3fd32c FORMAT "%3.0" /end MEASUREMENT
/begin MEASUREMENT LV_ERR_DC_7 "" UWORD _CNV_S_2_RANGE______183_CM 1 100. 0. 1. ECU_ADDRESS 0x3fd328 BIT_MASK 0x20 /end MEASUREMENT
/begin MEASUREMENT LV_ERR_TMP_7 "" UWORD _CNV_S_2_RANGE______21_R_CM 1 100. 0. 255. ECU_ADDRESS 0x3fd328 BIT_MASK 0x40 /end MEASUREMENT
/begin MEASUREMENT LV_ERR_DISA_7 "" UWORD _CNV_S_2_RANGE______21_R_CM 1 100. 0. 255. ECU_ADDRESS 0x3fd328 BIT_MASK 0x100 /end MEASUREMENT
/begin MEASUREMENT LV_DC_MAX_7 "" UWORD _CNV_S_2_RANGE______21_R_CM 1 100. 0. 255. ECU_ADDRESS 0x3fd328 BIT_MASK 0x200 /end MEASUREMENT
/begin MEASUREMENT LV_ERR_CFM_7 "" UWORD _CNV_S_2_RANGE______21_R_CM 1 100. 0. 255. ECU_ADDRESS 0x3fd328 BIT_MASK 0x80 /end MEASUREMENT
/begin MEASUREMENT LV_ERR_MKD_7 "" UWORD _CNV_S_2_RANGE______21_R_CM 1 100. 0. 255. ECU_ADDRESS 0x3fd328 BIT_MASK 0x400 /end MEASUREMENT
/begin MEASUREMENT DIAG_INST_7 "" UWORD _CNV_S_234_RANGE_DIAG_382_CM 1 100. 0. 233. ECU_ADDRESS 0x3fd326 /end MEASUREMENT
/begin MEASUREMENT CTR_FRC_8 "Frequency counter of failure N" UBYTE _CNV_A_R_LINEAR_____10_CM 1 100. 0. 255. ECU_ADDRESS 0x3fd334 FORMAT "%3.0" /end MEASUREMENT
/begin MEASUREMENT CTR_WUP_CYC_8 "Counter for warm-up cycle" UBYTE _CNV_A_R_LINEAR_____10_CM 1 100. 0. 255. ECU_ADDRESS 0x3fd335 FORMAT "%3.0" /end MEASUREMENT
/begin MEASUREMENT CTR_DC_8 "Counter for driving cycle" UBYTE _CNV_A_R_LINEAR_____10_CM 1 100. 0. 255. ECU_ADDRESS 0x3fd336 FORMAT "%3.0" /end MEASUREMENT
/begin MEASUREMENT LV_ERR_DC_8 "" UWORD _CNV_S_2_RANGE______183_CM 1 100. 0. 1. ECU_ADDRESS 0x3fd332 BIT_MASK 0x20 /end MEASUREMENT
/begin MEASUREMENT LV_ERR_TMP_8 "" UWORD _CNV_S_2_RANGE______21_R_CM 1 100. 0. 255. ECU_ADDRESS 0x3fd332 BIT_MASK 0x40 /end MEASUREMENT
/begin MEASUREMENT LV_ERR_DISA_8 "" UWORD _CNV_S_2_RANGE______21_R_CM 1 100. 0. 255. ECU_ADDRESS 0x3fd332 BIT_MASK 0x100 /end MEASUREMENT
/begin MEASUREMENT LV_DC_MAX_8 "" UWORD _CNV_S_2_RANGE______21_R_CM 1 100. 0. 255. ECU_ADDRESS 0x3fd332 BIT_MASK 0x200 /end MEASUREMENT
/begin MEASUREMENT LV_ERR_CFM_8 "" UWORD _CNV_S_2_RANGE______21_R_CM 1 100. 0. 255. ECU_ADDRESS 0x3fd332 BIT_MASK 0x80 /end MEASUREMENT
/begin MEASUREMENT LV_ERR_MKD_8 "" UWORD _CNV_S_2_RANGE______21_R_CM 1 100. 0. 255. ECU_ADDRESS 0x3fd332 BIT_MASK 0x400 /end MEASUREMENT
/begin MEASUREMENT DIAG_INST_8 "" UWORD _CNV_S_234_RANGE_DIAG_382_CM 1 100. 0. 233. ECU_ADDRESS 0x3fd330 /end MEASUREMENT
/begin MEASUREMENT CTR_FRC_9 "Frequency counter of failure N" UBYTE _CNV_A_R_LINEAR_____10_CM 1 100. 0. 255. ECU_ADDRESS 0x3fd33e FORMAT "%3.0" /end MEASUREMENT
/begin MEASUREMENT CTR_WUP_CYC_9 "Counter for warm-up cycle" UBYTE _CNV_A_R_LINEAR_____10_CM 1 100. 0. 255. ECU_ADDRESS 0x3fd33f FORMAT "%3.0" /end MEASUREMENT
/begin MEASUREMENT CTR_DC_9 "Counter for driving cycle" UBYTE _CNV_A_R_LINEAR_____10_CM 1 100. 0. 255. ECU_ADDRESS 0x3fd340 FORMAT "%3.0" /end MEASUREMENT
/begin MEASUREMENT LV_ERR_DC_9 "" UWORD _CNV_S_2_RANGE______183_CM 1 100. 0. 1. ECU_ADDRESS 0x3fd33c BIT_MASK 0x20 /end MEASUREMENT
/begin MEASUREMENT LV_ERR_TMP_9 "" UWORD _CNV_S_2_RANGE______21_R_CM 1 100. 0. 255. ECU_ADDRESS 0x3fd33c BIT_MASK 0x40 /end MEASUREMENT
/begin MEASUREMENT LV_ERR_DISA_9 "" UWORD _CNV_S_2_RANGE______21_R_CM 1 100. 0. 255. ECU_ADDRESS 0x3fd33c BIT_MASK 0x100 /end MEASUREMENT
/begin MEASUREMENT LV_DC_MAX_9 "" UWORD _CNV_S_2_RANGE______21_R_CM 1 100. 0. 255. ECU_ADDRESS 0x3fd33c BIT_MASK 0x200 /end MEASUREMENT
/begin MEASUREMENT LV_ERR_CFM_9 "" UWORD _CNV_S_2_RANGE______21_R_CM 1 100. 0. 255. ECU_ADDRESS 0x3fd33c BIT_MASK 0x80 /end MEASUREMENT
/begin MEASUREMENT LV_ERR_MKD_9 "" UWORD _CNV_S_2_RANGE______21_R_CM 1 100. 0. 255. ECU_ADDRESS 0x3fd33c BIT_MASK 0x400 /end MEASUREMENT
/begin MEASUREMENT DIAG_INST_9 "" UWORD _CNV_S_234_RANGE_DIAG_382_CM 1 100. 0. 233. ECU_ADDRESS 0x3fd33a /end MEASUREMENT
/begin MEASUREMENT MAF_MIN_SCDN_EQU_MIS_B1 "" UWORD _CNV_A_R_LINEAR_____95_CM 1 100. 0. 1389. ECU_ADDRESS 0x3fd6fc FORMAT "%7.2" /end MEASUREMENT
/begin MEASUREMENT MAF_MAX_SCDN_EQU_MIS_B1 "" UWORD _CNV_A_R_LINEAR_____95_CM 1 100. 0. 1389. ECU_ADDRESS 0x3fd6fe FORMAT "%7.2" /end MEASUREMENT
/begin MEASUREMENT N_MIN_SCDN_EQU_MIS_B1 "" UWORD _CNV_A_R_LINEAR_____17_CM 1 100. 0. 8160. ECU_ADDRESS 0x3fd700 FORMAT "%4.0" /end MEASUREMENT
/begin MEASUREMENT N_MAX_SCDN_EQU_MIS_B1 "" UWORD _CNV_A_R_LINEAR_____17_CM 1 100. 0. 8160. ECU_ADDRESS 0x3fd702 FORMAT "%4.0" /end MEASUREMENT
/begin MEASUREMENT CTR_SCDN_EQU_DC_MIS_B1 "" UBYTE _CNV_A_R_LINEAR_____10_CM 1 100. 0. 255. ECU_ADDRESS 0x3fd704 FORMAT "%3.0" /end MEASUREMENT
/begin MEASUREMENT X_STATE "" UBYTE _CNV_S_2_RANGE______21_R_CM 1 100. 0. 255. ECU_ADDRESS 0x3fd705 /end MEASUREMENT
/begin MEASUREMENT LV_SCDN_EQU_MIS_B1 "" UBYTE _CNV_S_2_RANGE______21_R_CM 1 100. 0. 255. ECU_ADDRESS 0x3fd705 BIT_MASK 0x1 /end MEASUREMENT
/begin MEASUREMENT LV_SCDN_EQU_DC_MIS_B1 "" UBYTE _CNV_S_2_RANGE______21_R_CM 1 100. 0. 255. ECU_ADDRESS 0x3fd705 BIT_MASK 0x2 /end MEASUREMENT
/begin MEASUREMENT LV_SCDN_EQU_NOT_ERR_MIS_B1 "" UBYTE _CNV_S_2_RANGE______21_R_CM 1 100. 0. 255. ECU_ADDRESS 0x3fd705 BIT_MASK 0x4 /end MEASUREMENT
/begin MEASUREMENT LV_WUP_SCDN_EQU_MIS_B1 "" UBYTE _CNV_S_2_RANGE______21_R_CM 1 100. 0. 255. ECU_ADDRESS 0x3fd705 BIT_MASK 0x8 /end MEASUREMENT
/begin MEASUREMENT MAF_MIN_SCDN_EQU_MIS_B4 "" UWORD _CNV_A_R_LINEAR_____95_CM 1 100. 0. 1389. ECU_ADDRESS 0x3fd706 FORMAT "%7.2" /end MEASUREMENT
/begin MEASUREMENT MAF_MAX_SCDN_EQU_MIS_B4 "" UWORD _CNV_A_R_LINEAR_____95_CM 1 100. 0. 1389. ECU_ADDRESS 0x3fd708 FORMAT "%7.2" /end MEASUREMENT
/begin MEASUREMENT N_MIN_SCDN_EQU_MIS_B4 "" UWORD _CNV_A_R_LINEAR_____17_CM 1 100. 0. 8160. ECU_ADDRESS 0x3fd70a FORMAT "%4.0" /end MEASUREMENT
/begin MEASUREMENT N_MAX_SCDN_EQU_MIS_B4 "" UWORD _CNV_A_R_LINEAR_____17_CM 1 100. 0. 8160. ECU_ADDRESS 0x3fd70c FORMAT "%4.0" /end MEASUREMENT
/begin MEASUREMENT CTR_SCDN_EQU_DC_MIS_B4 "" UBYTE _CNV_A_R_LINEAR_____10_CM 1 100. 0. 255. ECU_ADDRESS 0x3fd70e FORMAT "%3.0" /end MEASUREMENT
/begin MEASUREMENT LV_SCDN_EQU_MIS_B4 "" UBYTE _CNV_S_2_RANGE______21_R_CM 1 100. 0. 255. ECU_ADDRESS 0x3fd70f BIT_MASK 0x1 /end MEASUREMENT
/begin MEASUREMENT LV_SCDN_EQU_DC_MIS_B4 "" UBYTE _CNV_S_2_RANGE______21_R_CM 1 100. 0. 255. ECU_ADDRESS 0x3fd70f BIT_MASK 0x2 /end MEASUREMENT
/begin MEASUREMENT LV_SCDN_EQU_NOT_ERR_MIS_B4 "" UBYTE _CNV_S_2_RANGE______21_R_CM 1 100. 0. 255. ECU_ADDRESS 0x3fd70f BIT_MASK 0x4 /end MEASUREMENT
/begin MEASUREMENT LV_WUP_SCDN_EQU_MIS_B4 "" UBYTE _CNV_S_2_RANGE______21_R_CM 1 100. 0. 255. ECU_ADDRESS 0x3fd70f BIT_MASK 0x8 /end MEASUREMENT
/begin MEASUREMENT MAF_MIN_SCDN_EQU_MIS_A "" UWORD _CNV_A_R_LINEAR_____95_CM 1 100. 0. 1389. ECU_ADDRESS 0x3fd6f2 FORMAT "%7.2" /end MEASUREMENT
/begin MEASUREMENT MAF_MAX_SCDN_EQU_MIS_A "" UWORD _CNV_A_R_LINEAR_____95_CM 1 100. 0. 1389. ECU_ADDRESS 0x3fd6f4 FORMAT "%7.2" /end MEASUREMENT
/begin MEASUREMENT N_MIN_SCDN_EQU_MIS_A "" UWORD _CNV_A_R_LINEAR_____17_CM 1 100. 0. 8160. ECU_ADDRESS 0x3fd6f6 FORMAT "%4.0" /end MEASUREMENT
/begin MEASUREMENT N_MAX_SCDN_EQU_MIS_A "" UWORD _CNV_A_R_LINEAR_____17_CM 1 100. 0. 8160. ECU_ADDRESS 0x3fd6f8 FORMAT "%4.0" /end MEASUREMENT
/begin MEASUREMENT CTR_SCDN_EQU_DC_MIS_A "" UBYTE _CNV_A_R_LINEAR_____10_CM 1 100. 0. 255. ECU_ADDRESS 0x3fd6fa FORMAT "%3.0" /end MEASUREMENT
/begin MEASUREMENT LV_SCDN_EQU_MIS_A "" UBYTE _CNV_S_2_RANGE______21_R_CM 1 100. 0. 255. ECU_ADDRESS 0x3fd6fb BIT_MASK 0x1 /end MEASUREMENT
/begin MEASUREMENT LV_SCDN_EQU_DC_MIS_A "" UBYTE _CNV_S_2_RANGE______21_R_CM 1 100. 0. 255. ECU_ADDRESS 0x3fd6fb BIT_MASK 0x2 /end MEASUREMENT
/begin MEASUREMENT LV_SCDN_EQU_NOT_ERR_MIS_A "" UBYTE _CNV_S_2_RANGE______21_R_CM 1 100. 0. 255. ECU_ADDRESS 0x3fd6fb BIT_MASK 0x4 /end MEASUREMENT
/begin MEASUREMENT LV_WUP_SCDN_EQU_MIS_A "" UBYTE _CNV_S_2_RANGE______21_R_CM 1 100. 0. 255. ECU_ADDRESS 0x3fd6fb BIT_MASK 0x8 /end MEASUREMENT
/begin MEASUREMENT MAF_MIN_SCDN_EQU_FSD_1 "" UWORD _CNV_A_R_LINEAR_____95_CM 1 100. 0. 1389. ECU_ADDRESS 0x3fd710 FORMAT "%7.2" /end MEASUREMENT
/begin MEASUREMENT MAF_MAX_SCDN_EQU_FSD_1 "" UWORD _CNV_A_R_LINEAR_____95_CM 1 100. 0. 1389. ECU_ADDRESS 0x3fd712 FORMAT "%7.2" /end MEASUREMENT
/begin MEASUREMENT N_MIN_SCDN_EQU_FSD_1 "" UWORD _CNV_A_R_LINEAR_____17_CM 1 100. 0. 8160. ECU_ADDRESS 0x3fd714 FORMAT "%4.0" /end MEASUREMENT
/begin MEASUREMENT N_MAX_SCDN_EQU_FSD_1 "" UWORD _CNV_A_R_LINEAR_____17_CM 1 100. 0. 8160. ECU_ADDRESS 0x3fd716 FORMAT "%4.0" /end MEASUREMENT
/begin MEASUREMENT CTR_SCDN_EQU_DC_FSD_1 "" UBYTE _CNV_A_R_LINEAR_____10_CM 1 100. 0. 255. ECU_ADDRESS 0x3fd718 FORMAT "%3.0" /end MEASUREMENT
/begin MEASUREMENT LV_SCDN_EQU_FSD_1 "" UBYTE _CNV_S_2_RANGE______21_R_CM 1 100. 0. 255. ECU_ADDRESS 0x3fd719 BIT_MASK 0x1 /end MEASUREMENT
/begin MEASUREMENT LV_SCDN_EQU_DC_FSD_1 "" UBYTE _CNV_S_2_RANGE______21_R_CM 1 100. 0. 255. ECU_ADDRESS 0x3fd719 BIT_MASK 0x2 /end MEASUREMENT
/begin MEASUREMENT LV_SCDN_EQU_NOT_ERR_FSD_1 "" UBYTE _CNV_S_2_RANGE______21_R_CM 1 100. 0. 255. ECU_ADDRESS 0x3fd719 BIT_MASK 0x4 /end MEASUREMENT
/begin MEASUREMENT LV_WUP_SCDN_EQU_FSD_1 "" UBYTE _CNV_S_2_RANGE______21_R_CM 1 100. 0. 255. ECU_ADDRESS 0x3fd719 BIT_MASK 0x8 /end MEASUREMENT
/begin MEASUREMENT MAF_MIN_SCDN_EQU_FSD_2 "" UWORD _CNV_A_R_LINEAR_____95_CM 1 100. 0. 1389. ECU_ADDRESS 0x3fd71a FORMAT "%7.2" /end MEASUREMENT
/begin MEASUREMENT MAF_MAX_SCDN_EQU_FSD_2 "" UWORD _CNV_A_R_LINEAR_____95_CM 1 100. 0. 1389. ECU_ADDRESS 0x3fd71c FORMAT "%7.2" /end MEASUREMENT
/begin MEASUREMENT N_MIN_SCDN_EQU_FSD_2 "" UWORD _CNV_A_R_LINEAR_____17_CM 1 100. 0. 8160. ECU_ADDRESS 0x3fd71e FORMAT "%4.0" /end MEASUREMENT
/begin MEASUREMENT N_MAX_SCDN_EQU_FSD_2 "" UWORD _CNV_A_R_LINEAR_____17_CM 1 100. 0. 8160. ECU_ADDRESS 0x3fd720 FORMAT "%4.0" /end MEASUREMENT
/begin MEASUREMENT CTR_SCDN_EQU_DC_FSD_2 "" UBYTE _CNV_A_R_LINEAR_____10_CM 1 100. 0. 255. ECU_ADDRESS 0x3fd722 FORMAT "%3.0" /end MEASUREMENT
/begin MEASUREMENT LV_SCDN_EQU_FSD_2 "" UBYTE _CNV_S_2_RANGE______21_R_CM 1 100. 0. 255. ECU_ADDRESS 0x3fd723 BIT_MASK 0x1 /end MEASUREMENT
/begin MEASUREMENT LV_SCDN_EQU_DC_FSD_2 "" UBYTE _CNV_S_2_RANGE______21_R_CM 1 100. 0. 255. ECU_ADDRESS 0x3fd723 BIT_MASK 0x2 /end MEASUREMENT
/begin MEASUREMENT LV_SCDN_EQU_NOT_ERR_FSD_ "" UBYTE _CNV_S_2_RANGE______21_R_CM 1 100. 0. 255. ECU_ADDRESS 0x3fd723 BIT_MASK 0x4 /end MEASUREMENT
/begin MEASUREMENT LV_WUP_SCDN_EQU_FSD_2 "" UBYTE _CNV_S_2_RANGE______21_R_CM 1 100. 0. 255. ECU_ADDRESS 0x3fd723 BIT_MASK 0x8 /end MEASUREMENT
/begin CHARACTERISTIC C_CL_MAX_CAT_LS_DIAG "Maximum canister load to allow catalyst and O2 sensor diagnosis" VALUE 0x42c4a _REC_VAL_20_u2 1.99996948 _CNV_A_R_LINEAR_____45_CM 0. 1.99996948 FORMAT "%7.5" /end CHARACTERISTIC
/begin CHARACTERISTIC LC_LS_CAT_DIAG_CDN_MAN_ACT "Flag to set diagnosis condition manually" VALUE 0x42bab _REC_VAL_20_u1 1. _CNV_A_R_LINEAR_____10_CM 0. 1. FORMAT "%2.0" /end CHARACTERISTIC
/begin CHARACTERISTIC IP_MAF_LAM_CAT_MIN__N_32 "min. MAF threshold " CURVE 0x49076 _REC_CUR_20_u2_u1 1389. _CNV_A_R_LINEAR_____95_CM 0. 1389. FORMAT "%7.2"
 /begin AXIS_DESCR COM_AXIS N_32 _CNV_A_R_LINEAR_____5_CM 6 0. 8160. FORMAT "%4.0" AXIS_PTS_REF ldpm_n_32__lam_cat /end AXIS_DESCR
/end CHARACTERISTIC
/begin CHARACTERISTIC IP_MAF_LAM_CAT_MAX__N_32 "max MAF threshold for activation I-share" CURVE 0x4906a _REC_CUR_20_u2_u1 1389. _CNV_A_R_LINEAR_____95_CM 0. 1389. FORMAT "%7.2"
 /begin AXIS_DESCR COM_AXIS N_32 _CNV_A_R_LINEAR_____5_CM 6 0. 8160. FORMAT "%4.0" AXIS_PTS_REF ldpm_n_32__lam_cat /end AXIS_DESCR
/end CHARACTERISTIC
/begin CHARACTERISTIC C_TCO_MIN_CAT "Min TCO threshold" VALUE 0x42a64 _REC_VAL_20_u1 190.5 _CNV_A_R_LINEAR_____0_CM -48. 142.5 FORMAT "%5.1" /end CHARACTERISTIC
/begin CHARACTERISTIC C_TEMP_MIN_CAT "min. TEMP_CAT theshold" VALUE 0x42a9c _REC_VAL_20_u1 1020. _CNV_A_R_LINEAR_____160_CM -33. 987. FORMAT "%3.0" /end CHARACTERISTIC
/begin CHARACTERISTIC C_TEMP_MAX_CAT "max. TEMP_CAT theshold" VALUE 0x42a9b _REC_VAL_20_u1 1020. _CNV_A_R_LINEAR_____160_CM -33. 987. FORMAT "%3.0" /end CHARACTERISTIC
/begin CHARACTERISTIC C_TEMP_HYS_CAT "hysterese after exceeding TEMP_CAT threshold " VALUE 0x42a9a _REC_VAL_20_u1 1020. _CNV_A_R_LINEAR_____383_CM 0. 1020. FORMAT "%4.0" /end CHARACTERISTIC
/begin CHARACTERISTIC C_VS_MIN_CAT "min. VS threshold" VALUE 0x42b33 _REC_VAL_20_u1 255. _CNV_A_R_LINEAR_____13_CM 0. 255. FORMAT "%3.0" /end CHARACTERISTIC
/begin CHARACTERISTIC C_VS_MAX_CAT "max. VS threshold" VALUE 0x42b28 _REC_VAL_20_u1 255. _CNV_A_R_LINEAR_____13_CM 0. 255. FORMAT "%3.0" /end CHARACTERISTIC
/begin CHARACTERISTIC C_AMP_MIN_CAT_LS_DIAG "min. ambient pressure threshold " VALUE 0x42c2e _REC_VAL_20_u2 5434. _CNV_A_R_LINEAR_____43_CM 0. 5434. FORMAT "%7.2" /end CHARACTERISTIC
/begin AXIS_PTS ldpm_n_32__lam_cat "" 0x43dc7 N_32 _REC_AXS_20_u1 8160. _CNV_A_R_LINEAR_____5_CM 6 0. 8160. FORMAT "%4.0" /end AXIS_PTS
/begin CHARACTERISTIC C_MAF_INT_CAT_DIAG_DLY "Air mass flow threshold for cat diag activation after PUC, CL max purge, etc." VALUE 0x42e24 _REC_VAL_20_u2 1820.42 _CNV_A_R_LINEAR_____303_CM 0. 1820.42 FORMAT "%7.2" /end CHARACTERISTIC
/begin MEASUREMENT N_MMV_CAT "floating mean value for limited engine speed" UWORD _CNV_A_R_LINEAR_____17_CM 1 100. 0. 8160. ECU_ADDRESS 0x3fd032 FORMAT "%4.0" /end MEASUREMENT
/begin MEASUREMENT MAF_MMV_CAT "floating mean value for limited MAF" UWORD _CNV_A_R_LINEAR_____95_CM 1 100. 0. 1389. ECU_ADDRESS 0x3fd034 FORMAT "%7.2" /end MEASUREMENT
/begin MEASUREMENT LV_N_LDC "" UBYTE _CNV_S_2_RANGE______28_CM 1 100. 0. 1. ECU_ADDRESS 0x3fd036 /end MEASUREMENT
/begin MEASUREMENT LV_MAF_LDC "" UBYTE _CNV_S_2_RANGE______28_CM 1 100. 0. 1. ECU_ADDRESS 0x3fd037 /end MEASUREMENT
/begin CHARACTERISTIC C_N_CRLC_CAT "floating mean value calculation engine speed" VALUE 0x42e98 _REC_VAL_20_u2 0.99998474 _CNV_A_R_LINEAR_____31_CM 0. 0.99998474 FORMAT "%7.5" /end CHARACTERISTIC
/begin CHARACTERISTIC C_MAF_CRLC_CAT "floating mean value calculation MAF" VALUE 0x42e02 _REC_VAL_20_u2 0.99998474 _CNV_A_R_LINEAR_____31_CM 0. 0.99998474 FORMAT "%7.5" /end CHARACTERISTIC
/begin CHARACTERISTIC C_LAM_MV_CRLC_CAT "floating mean value calculation lambda " VALUE 0x42dba _REC_VAL_20_u2 0.99998474 _CNV_A_R_LINEAR_____31_CM 0. 0.99998474 FORMAT "%7.5" /end CHARACTERISTIC
/begin CHARACTERISTIC C_N_DYW_CAT "threshold limited dynamic engine speed" VALUE 0x42eaa _REC_VAL_20_u2 8160. _CNV_A_R_LINEAR_____17_CM 0. 8160. FORMAT "%4.0" /end CHARACTERISTIC
/begin CHARACTERISTIC C_MAF_DYW_CAT "threshold limited dynamic engine MAF" VALUE 0x42e10 _REC_VAL_20_u2 1389. _CNV_A_R_LINEAR_____95_CM 0. 1389. FORMAT "%7.2" /end CHARACTERISTIC
/begin CHARACTERISTIC C_LAM_MV_DYW_CAT "threshold limited dynamic lambda " VALUE 0x42dc0 _REC_VAL_20_u2 99.99847412 _CNV_A_R_LINEAR_____94_CM 0. 99.99847412 /end CHARACTERISTIC
/begin CHARACTERISTIC C_MAF_INT_MIN_CAT "MAF integral after setting limited dynamic conditions LV_LDC_CATi before starting the monitoring cycle" VALUE 0x42e2e _REC_VAL_20_u2 1820.398 _CNV_A_R_LINEAR_____277_CM 0. 1820.398 FORMAT "%7.2" /end CHARACTERISTIC
/begin CHARACTERISTIC C_PV_AV_GRD_DEC "decrement for calculation PV_AV gradient" VALUE 0x42984 _REC_VAL_20_u1 2490.234 _CNV_A_R_LINEAR_____315_CM 0. 2490.234 FORMAT "%6.1" /end CHARACTERISTIC
/begin CHARACTERISTIC C_PV_AV_GRD_SUM_MAX "max. threshold limited dynamic PV_AV gradient" VALUE 0x42f04 _REC_VAL_20_u2 639990.2340000001 _CNV_A_R_LINEAR_____304_CM 0. 639990.2340000001 FORMAT "%8.1" /end CHARACTERISTIC
/begin CHARACTERISTIC C_PV_AV_GRD_SUM_MIN "min. threshold limited dynamic PV_AV gradient" VALUE 0x42f08 _REC_VAL_20_u2 639990.2340000001 _CNV_A_R_LINEAR_____304_CM 0. 639990.2340000001 FORMAT "%8.1" /end CHARACTERISTIC
/begin CHARACTERISTIC C_T_PV_AV_GRD_DEC_SUM "time periods for calculation limited dynamic PV_AV  gradient" VALUE 0x42a27 _REC_VAL_20_u1 5.1 _CNV_A_R_LINEAR_____169_CM 0. 5.1 FORMAT "%4.2" /end CHARACTERISTIC
/begin CHARACTERISTIC C_O2_CAT_MV_MIN "O2_CAT_MV_i threshold" VALUE 0x4297a _REC_VAL_20_u1 0.9960940000000002 _CNV_A_R_LINEAR_____44_CM 0. 0.996094 FORMAT "%5.3" /end CHARACTERISTIC
/begin CHARACTERISTIC C_O2_CAT_MV_MAX "O2_CAT_MV_i threshold" VALUE 0x42979 _REC_VAL_20_u1 0.9960940000000002 _CNV_A_R_LINEAR_____44_CM 0. 0.996094 FORMAT "%5.3" /end CHARACTERISTIC
/begin CHARACTERISTIC C_O2_CAT_MV_DELTA_MAX "O2_CAT_MV_i threshold" VALUE 0x42977 _REC_VAL_20_u1 0.9960940000000002 _CNV_A_R_LINEAR_____44_CM 0. 0.996094 FORMAT "%5.3" /end CHARACTERISTIC
/begin CHARACTERISTIC C_O2_CAT_MV_DIF_MAX "max. value for O2_CAT_MV_i oscillation between two calculation cycles" VALUE 0x42978 _REC_VAL_20_u1 0.9960940000000002 _CNV_A_R_LINEAR_____44_CM 0. 0.996094 FORMAT "%5.3" /end CHARACTERISTIC
/begin CHARACTERISTIC C_SUM_MIN_CAT_DIAG "Threshold for cycle counter" VALUE 0x42f42 _REC_VAL_20_u2 65535. _CNV_A_R_LINEAR_____10_CM 0. 65535. FORMAT "%5.0" /end CHARACTERISTIC
/begin CHARACTERISTIC C_CAT_MAX_DIAG "Diagnostic threshold for CAT_DIAG_i - error entry" VALUE 0x42c44 _REC_VAL_20_u2 2559.96094 _CNV_A_R_LINEAR_____292_CM 0. 2559.96094 FORMAT "%7.2" /end CHARACTERISTIC
/begin CHARACTERISTIC ID_O2_INT_MAX_AT__N_32__MAF "map-dependent max. admissible value for O2_CAT_INT_i " MAP 0x45b8e _REC_MAP_20_u2_u2_u1 511.99218 _CNV_A_R_LINEAR_____384_CM 0. 511.99218 FORMAT "%7.3"
 /begin AXIS_DESCR COM_AXIS MAF _CNV_A_R_LINEAR_____95_CM 6 0. 1389. FORMAT "%7.2" AXIS_PTS_REF ldp_maf__o2_int_max_at /end AXIS_DESCR
 /begin AXIS_DESCR COM_AXIS N_32 _CNV_A_R_LINEAR_____5_CM 6 0. 8160. FORMAT "%4.0" AXIS_PTS_REF ldp_n_32__o2_int_max_at /end AXIS_DESCR
/end CHARACTERISTIC
/begin CHARACTERISTIC ID_O2_INT_MAX_MT__N_32__MAF "map-dependent max. admissible value for O2_CAT_INT_i " MAP 0x45bd6 _REC_MAP_20_u2_u2_u1 511.99218 _CNV_A_R_LINEAR_____384_CM 0. 511.99218 FORMAT "%7.3"
 /begin AXIS_DESCR COM_AXIS MAF _CNV_A_R_LINEAR_____95_CM 6 0. 1389. FORMAT "%7.2" AXIS_PTS_REF ldp_maf__o2_int_max_mt /end AXIS_DESCR
 /begin AXIS_DESCR COM_AXIS N_32 _CNV_A_R_LINEAR_____5_CM 6 0. 8160. FORMAT "%4.0" AXIS_PTS_REF ldp_n_32__o2_int_max_mt /end AXIS_DESCR
/end CHARACTERISTIC
/begin CHARACTERISTIC IP_O2_CAT_1__VLS_DOWN_1 "Characteristic curve for conversion of the sensor voltage into an oxygen characteristic quantity, bank 1" CURVE 0x4fd0f _REC_CUR_20_u1_u2 0.99610001 _CNV_A_R_LINEAR_____20_CM 0. 0.99610001 FORMAT "%5.3"
 /begin AXIS_DESCR COM_AXIS ONLINE_DUMMY _CNV_A_R_LINEAR_____33_CM 6 0. 4.99511719 FORMAT "%5.3" AXIS_PTS_REF ldpm_vls_down /end AXIS_DESCR
/end CHARACTERISTIC
/begin CHARACTERISTIC IP_O2_CAT_2__VLS_DOWN_2 "Characteristic curve for conversion of the sensor voltage into an oxygen characteristic quantity, bank 2" CURVE 0x4fd15 _REC_CUR_20_u1_u2 0.99610001 _CNV_A_R_LINEAR_____20_CM 0. 0.99610001 FORMAT "%5.3"
 /begin AXIS_DESCR COM_AXIS ONLINE_DUMMY _CNV_A_R_LINEAR_____33_CM 6 0. 4.99511719 FORMAT "%5.3" AXIS_PTS_REF ldpm_vls_down /end AXIS_DESCR
/end CHARACTERISTIC
/begin CHARACTERISTIC IP_O2_CAT_MAX__SUM_VLS_CAT_O2 "admissible integral of O2 oscillation downstream of catalyst" CURVE 0x4fd1b _REC_CUR_20_u1_u2 0.99610001 _CNV_A_R_LINEAR_____20_CM 0. 0.99610001 FORMAT "%5.3"
 /begin AXIS_DESCR COM_AXIS ONLINE_DUMMY _CNV_A_R_LINEAR_____385_CM 6 0. 4294967295. FORMAT "%11.0" AXIS_PTS_REF ldp_sum_vls_cat_o2 /end AXIS_DESCR
/end CHARACTERISTIC
/begin AXIS_PTS ldp_maf__o2_int_max_at "" 0x444e8 MAF _REC_AXS_20_u2 1389. _CNV_A_R_LINEAR_____95_CM 6 0. 1389. FORMAT "%7.2" /end AXIS_PTS
/begin AXIS_PTS ldp_maf__o2_int_max_mt "" 0x444f6 MAF _REC_AXS_20_u2 1389. _CNV_A_R_LINEAR_____95_CM 6 0. 1389. FORMAT "%7.2" /end AXIS_PTS
/begin AXIS_PTS ldp_n_32__o2_int_max_mt "" 0x435d5 N_32 _REC_AXS_20_u1 8160. _CNV_A_R_LINEAR_____5_CM 6 0. 8160. FORMAT "%4.0" /end AXIS_PTS
/begin AXIS_PTS ldp_n_32__o2_int_max_at "" 0x435ce N_32 _REC_AXS_20_u1 8160. _CNV_A_R_LINEAR_____5_CM 6 0. 8160. FORMAT "%4.0" /end AXIS_PTS
/begin AXIS_PTS ldp_sum_vls_cat_o2 "" 0x44a32 SUM_VLS_CAT_O2 _REC_AXS_20_u2 4294967295. _CNV_A_R_LINEAR_____385_CM 6 0. 4294967295. FORMAT "%11.0" /end AXIS_PTS
/begin AXIS_PTS ldpm_vls_down "" 0x4564c VLS_DOWN_1 _REC_AXS_20_u2 4.99511719 _CNV_A_R_LINEAR_____33_CM 6 0. 4.99511719 FORMAT "%5.3" /end AXIS_PTS
/begin CHARACTERISTIC C_LAM_MIN_FSD "Lambda controller maximum threshold for fuel system diagnosis" VALUE 0x43278 _REC_VAL_20_s2 199.99694824 _CNV_A_R_LINEAR_____173_CM -100. 99.99694824 FORMAT "%8.3" /end CHARACTERISTIC
/begin CHARACTERISTIC C_LAM_MAX_FSD "Lambda controller minimum threshold for fuel system diagnosis" VALUE 0x43274 _REC_VAL_20_s2 199.99694824 _CNV_A_R_LINEAR_____173_CM -100. 99.99694824 FORMAT "%8.3" /end CHARACTERISTIC
/begin CHARACTERISTIC C_T_SUM_MAX_MAX_FSD "Time counter threshold for T_SUM_MAX_FSD_i" VALUE 0x4302c _REC_VAL_20_u2 1310.68 _CNV_A_R_LINEAR_____169_CM 2.e-002 1310.7 FORMAT "%7.2" /end CHARACTERISTIC
/begin CHARACTERISTIC C_T_SUM_MIN_MAX_FSD "Time counter threshold for T_SUM_MIN_FSD_i" VALUE 0x4302e _REC_VAL_20_u2 1310.68 _CNV_A_R_LINEAR_____169_CM 2.e-002 1310.7 FORMAT "%7.2" /end CHARACTERISTIC
/begin CHARACTERISTIC C_T_SUM_RST_MAX_FSD "Time counter threshold for T_SUM_RST_FSD_i" VALUE 0x43030 _REC_VAL_20_u2 1310.68 _CNV_A_R_LINEAR_____169_CM 2.e-002 1310.7 FORMAT "%7.2" /end CHARACTERISTIC
/begin CHARACTERISTIC C_N_MIN_FSD "Engine speed threshold for fuel system diagnosis" VALUE 0x42964 _REC_VAL_20_u1 8160. _CNV_A_R_LINEAR_____5_CM 0. 8160. FORMAT "%4.0" /end CHARACTERISTIC
/begin CHARACTERISTIC C_MAF_MIN_FSD "Mass air flow threshold for fuel system diagnosis" VALUE 0x42902 _REC_VAL_20_u1 1389. _CNV_A_R_LINEAR_____18_CM 0. 1389. FORMAT "%4.0" /end CHARACTERISTIC
/begin CHARACTERISTIC C_TCO_MIN_FSD "Minimum threshold of TCO for fuel system diagnosis" VALUE 0x42a6e _REC_VAL_20_u1 190.5 _CNV_A_R_LINEAR_____0_CM -48. 142.5 FORMAT "%5.1" /end CHARACTERISTIC
/begin CHARACTERISTIC ID_STOP_INC_FSD__TCO_ST "Increasing value for the debounce counter STOP_FSD" CURVE 0x4cf7d _REC_CUR_20_u1_u1 255. _CNV_A_R_LINEAR_____10_CM 0. 255. FORMAT "%3.0"
 /begin AXIS_DESCR COM_AXIS TCO_ST _CNV_A_R_LINEAR_____0_CM 4 -48. 142.5 FORMAT "%5.1" AXIS_PTS_REF ldp_tco_st__stop_inc_fsd /end AXIS_DESCR
/end CHARACTERISTIC
/begin CHARACTERISTIC ID_STOP_DEC_FSD__TOIL_MAX "Decreasing value for the debounce counter STOP_FSD" CURVE 0x4cf79 _REC_CUR_20_u1_u1 255. _CNV_A_R_LINEAR_____10_CM 0. 255. FORMAT "%3.0"
 /begin AXIS_DESCR COM_AXIS TOIL_MAX _CNV_A_R_LINEAR_____3_CM 4 -40. 160. FORMAT "%3.0" AXIS_PTS_REF ldp_toil_max__stop_dec_fsd /end AXIS_DESCR
/end CHARACTERISTIC
/begin MEASUREMENT TOIL_MAX "Maximum oil temperature from the last engine running" UBYTE _CNV_A_R_LINEAR_____3_CM 1 100. -40. 160. ECU_ADDRESS 0x3fe667 FORMAT "%3.0" /end MEASUREMENT
/begin MEASUREMENT CTR_STOP_FSD "Counter value as a measure of the oil dilution under cold start conditions" UBYTE _CNV_A_R_LINEAR_____10_CM 1 100. 0. 255. ECU_ADDRESS 0x3fd038 FORMAT "%3.0" /end MEASUREMENT
/begin CHARACTERISTIC C_STOP_MAX_FSD "Maximum value for the debounce counter STOP_FSD" VALUE 0x429a7 _REC_VAL_20_u1 255. _CNV_A_R_LINEAR_____10_CM 0. 255. FORMAT "%3.0" /end CHARACTERISTIC
/begin CHARACTERISTIC C_TIA_MIN_FSD "Minimum intake air temperature threshold for fuel system diagnosis" VALUE 0x42ab7 _REC_VAL_20_u1 190.5 _CNV_A_R_LINEAR_____0_CM -48. 142.5 FORMAT "%5.1" /end CHARACTERISTIC
/begin CHARACTERISTIC C_AMP_MIN_FSD "Minimum ambient pressure threshold for fuel system diagnosis" VALUE 0x42c30 _REC_VAL_20_u2 5434. _CNV_A_R_LINEAR_____43_CM 0. 5434. FORMAT "%7.2" /end CHARACTERISTIC
/begin AXIS_PTS ldp_toil_max__stop_dec_fsd "" 0x43a39 TOIL_MAX _REC_AXS_20_u1 200. _CNV_A_R_LINEAR_____3_CM 4 -40. 160. FORMAT "%3.0" /end AXIS_PTS
/begin AXIS_PTS ldp_tco_st__stop_inc_fsd "" 0x43956 TCO_ST _REC_AXS_20_u1 190.5 _CNV_A_R_LINEAR_____0_CM 4 -48. 142.5 FORMAT "%5.1" /end AXIS_PTS
/begin CHARACTERISTIC LC_INH_LS_UP_MAN_DEAC "Manual deactivation of upstream oxygen sensor diagnosis" VALUE 0x42b97 _REC_VAL_20_u1 1. _CNV_A_R_LINEAR_____12_CM 0. 1. FORMAT "%2.0" /end CHARACTERISTIC
/begin CHARACTERISTIC IP_T_VLS_CYC_AFL_MAX__N_32__MAF "max. lean time interval for frequency monitoring" MAP 0x4b15c _REC_MAP_20_u2_u1_u2 10.23 _CNV_A_R_LINEAR_____27_CM 0. 10.23 FORMAT "%5.2"
 /begin AXIS_DESCR COM_AXIS N_32 _CNV_A_R_LINEAR_____5_CM 6 0. 8160. FORMAT "%4.0" AXIS_PTS_REF ldpm_n_32_1_t_vls_cyc /end AXIS_DESCR
 /begin AXIS_DESCR COM_AXIS MAF _CNV_A_R_LINEAR_____95_CM 6 0. 1389. FORMAT "%7.2" AXIS_PTS_REF ldpm_maf_2_t_vls_cyc /end AXIS_DESCR
/end CHARACTERISTIC
/begin CHARACTERISTIC C_SUM_CYC_MIN_DIAG "Min. total diagnostic cycles for frequency monitoring" VALUE 0x42f3e _REC_VAL_20_u2 65535. _CNV_A_R_LINEAR_____10_CM 0. 65535. FORMAT "%5.0" /end CHARACTERISTIC
/begin CHARACTERISTIC C_RATIO_VLS_CYC_AFL_MV_MAX "max. limit for total ratio between measured and max. allowed lean time" VALUE 0x42f1e _REC_VAL_20_u2 255.996094 _CNV_A_R_LINEAR_____111_CM 0. 255.996094 FORMAT "%7.3" /end CHARACTERISTIC
/begin CHARACTERISTIC C_RATIO_VLS_CYC_AFR_MV_MAX "max. limit for total ratio between measured and max. allowed rich time" VALUE 0x42f20 _REC_VAL_20_u2 255.996094 _CNV_A_R_LINEAR_____111_CM 0. 255.996094 FORMAT "%7.3" /end CHARACTERISTIC
/begin CHARACTERISTIC C_VLS_CYC_DIF_MAX "max. difference between lean and rich time ratio" VALUE 0x4332c _REC_VAL_20_s2 511.9921875 _CNV_A_R_LINEAR_____103_CM -256. 255.9921875 FORMAT "%8.3" /end CHARACTERISTIC
/begin CHARACTERISTIC C_VLS_CYC_DIF_MIN "min. difference between lean and rich time ratio" VALUE 0x4332e _REC_VAL_20_s2 511.9921875 _CNV_A_R_LINEAR_____103_CM -256. 255.9921875 FORMAT "%8.3" /end CHARACTERISTIC
/begin CHARACTERISTIC C_FAC_T_LAM_DLY_LS_FRQ_DIAG "weighting factor for considering Adaptation value of downstream fuel trim" VALUE 0x428ba _REC_VAL_20_u1 0.99610001 _CNV_A_R_LINEAR_____20_CM 0. 0.99610001 FORMAT "%5.3" /end CHARACTERISTIC
/begin CHARACTERISTIC IP_T_VLS_CYC_AFR_MAX__N_32__MAF "max. rich time interval for frequency monitoring" MAP 0x4b1a4 _REC_MAP_20_u2_u1_u2 10.23 _CNV_A_R_LINEAR_____27_CM 0. 10.23 FORMAT "%5.2"
 /begin AXIS_DESCR COM_AXIS N_32 _CNV_A_R_LINEAR_____5_CM 6 0. 8160. FORMAT "%4.0" AXIS_PTS_REF ldpm_n_32_1_t_vls_cyc /end AXIS_DESCR
 /begin AXIS_DESCR COM_AXIS MAF _CNV_A_R_LINEAR_____95_CM 6 0. 1389. FORMAT "%7.2" AXIS_PTS_REF ldpm_maf_2_t_vls_cyc /end AXIS_DESCR
/end CHARACTERISTIC
/begin CHARACTERISTIC C_VLS_HYS "max. allowed sensor output peak while switching" VALUE 0x431a0 _REC_VAL_20_u2 4.99511719 _CNV_A_R_LINEAR_____33_CM 0. 4.99511719 FORMAT "%5.3" /end CHARACTERISTIC
/begin CHARACTERISTIC C_SUM_CYCNR_MIN_DIAG "min. number diagnostic cycles for switching time monitoring" VALUE 0x42f40 _REC_VAL_20_u2 65535. _CNV_A_R_LINEAR_____10_CM 0. 65535. FORMAT "%5.0" /end CHARACTERISTIC
/begin CHARACTERISTIC C_RATIO_VLS_CYCNR_AFL_MV_MAX "limit for total ratio between measured and max. allowed switching times from rich to lean" VALUE 0x42f22 _REC_VAL_20_u2 255.996094 _CNV_A_R_LINEAR_____111_CM 0. 255.996094 FORMAT "%7.3" /end CHARACTERISTIC
/begin CHARACTERISTIC C_RATIO_VLS_CYCNR_AFR_MV_MAX "max. limit for total ratio between measured and max. allowed switching times from lean to rich" VALUE 0x42f24 _REC_VAL_20_u2 255.996094 _CNV_A_R_LINEAR_____111_CM 0. 255.996094 FORMAT "%7.3" /end CHARACTERISTIC
/begin CHARACTERISTIC C_RATIO_VLS_CYCNR_DIF_MAX "max. difference between lean and rich switching times ratio" VALUE 0x432ba _REC_VAL_20_s2 511.9921875 _CNV_A_R_LINEAR_____103_CM -256. 255.9921875 FORMAT "%8.3" /end CHARACTERISTIC
/begin CHARACTERISTIC C_RATIO_VLS_CYCNR_DIF_MIN "min. difference between lean and rich switching times ratio" VALUE 0x432bc _REC_VAL_20_s2 511.9921875 _CNV_A_R_LINEAR_____103_CM -256. 255.9921875 FORMAT "%8.3" /end CHARACTERISTIC
/begin CHARACTERISTIC ID_T_VLS_CYCNR_AFR_MAX "max. time interval for switching time monitoring (lean to rich)" CURVE 0x4cfb3 _REC_CUR_20_u1_u2 2.55 _CNV_A_R_LINEAR_____27_CM 0. 2.55 FORMAT "%4.2"
 /begin AXIS_DESCR COM_AXIS MAF_KGH _CNV_A_R_LINEAR_____101_CM 6 0. 2047.96875 FORMAT "%7.2" AXIS_PTS_REF ldpm_maf_kgh_1_t_vls_cycnr /end AXIS_DESCR
/end CHARACTERISTIC
/begin CHARACTERISTIC ID_T_VLS_CYCNR_AFL_MAX "max. time interval for switching time monitoring (rich to lean)" CURVE 0x4cfad _REC_CUR_20_u1_u2 2.55 _CNV_A_R_LINEAR_____27_CM 0. 2.55 FORMAT "%4.2"
 /begin AXIS_DESCR COM_AXIS MAF_KGH _CNV_A_R_LINEAR_____101_CM 6 0. 2047.96875 FORMAT "%7.2" AXIS_PTS_REF ldpm_maf_kgh_1_t_vls_cycnr /end AXIS_DESCR
/end CHARACTERISTIC
/begin AXIS_PTS ldpm_maf_kgh_1_t_vls_cycnr "" 0x4512c MAF_KGH _REC_AXS_20_u2 2047.96875 _CNV_A_R_LINEAR_____101_CM 6 0. 2047.96875 FORMAT "%7.2" /end AXIS_PTS
/begin AXIS_PTS ldpm_n_32_1_t_vls_cyc "" 0x43d12 N_32 _REC_AXS_20_u1 8160. _CNV_A_R_LINEAR_____5_CM 6 0. 8160. FORMAT "%4.0" /end AXIS_PTS
/begin AXIS_PTS ldpm_maf_2_t_vls_cyc "" 0x4505e MAF _REC_AXS_20_u2 1389. _CNV_A_R_LINEAR_____95_CM 6 0. 1389. FORMAT "%7.2" /end AXIS_PTS
/begin CHARACTERISTIC LC_INH_LS_DOWN_MAN_DEAC "Manual deactivation of downstream oxygen sensor diagnosis" VALUE 0x42b96 _REC_VAL_20_u1 1. _CNV_A_R_LINEAR_____12_CM 0. 1. FORMAT "%2.0" /end CHARACTERISTIC
/begin CHARACTERISTIC C_TCO_MIN_DOWN "Minimum coolant temperature for diagnosis of the monitor sensors" VALUE 0x42a68 _REC_VAL_20_u1 190.5 _CNV_A_R_LINEAR_____0_CM -48. 142.5 FORMAT "%5.1" /end CHARACTERISTIC
/begin CHARACTERISTIC C_TEMP_CAT_MIN_LS_DOWN_DIAG "Catalyst temperature threshold for diagnosis of the monitor sensors" VALUE 0x42a96 _REC_VAL_20_u1 1020. _CNV_A_R_LINEAR_____160_CM -33. 987. FORMAT "%3.0" /end CHARACTERISTIC
/begin CHARACTERISTIC C_MAF_KGH_MIN_PUC_DOWN_DIAG "Mass air flow threshold for diagnosis of the switching times" VALUE 0x42e58 _REC_VAL_20_u2 2047.96875 _CNV_A_R_LINEAR_____101_CM 0. 2047.96875 FORMAT "%7.2" /end CHARACTERISTIC
/begin CHARACTERISTIC C_MAF_KGH_MAX_PUC_DOWN_DIAG "Mass air flow threshold for diagnosis of the switching times" VALUE 0x42e56 _REC_VAL_20_u2 2047.96875 _CNV_A_R_LINEAR_____101_CM 0. 2047.96875 FORMAT "%7.2" /end CHARACTERISTIC
/begin CHARACTERISTIC C_VLS_DOWN_DIAG_MIN "Voltage threshold for monitor sensor diagnosis" VALUE 0x43188 _REC_VAL_20_u2 4.99511719 _CNV_A_R_LINEAR_____33_CM 0. 4.99511719 FORMAT "%5.3" /end CHARACTERISTIC
/begin CHARACTERISTIC C_FAC_VLS_DOWN_DIAG_MIN "Reduction factor for end of switching time determination" VALUE 0x428c1 _REC_VAL_20_u1 0.9960940000000002 _CNV_A_R_LINEAR_____44_CM 0. 0.996094 FORMAT "%5.3" /end CHARACTERISTIC
/begin CHARACTERISTIC C_FAC_VLS_DOWN_DIAG_MAX "Reduction factor for start of switching time determination" VALUE 0x428c0 _REC_VAL_20_u1 0.9960940000000002 _CNV_A_R_LINEAR_____44_CM 0. 0.996094 FORMAT "%5.3" /end CHARACTERISTIC
/begin CHARACTERISTIC C_VLS_DOWN_HYS "Monitor sensor voltage hysteresis" VALUE 0x4318c _REC_VAL_20_u2 4.99511719 _CNV_A_R_LINEAR_____33_CM 0. 4.99511719 FORMAT "%5.3" /end CHARACTERISTIC
/begin CHARACTERISTIC C_SUM_VLS_DOWN_DIAG_MIN "Condition for the start of the lambda sensor switching time check" VALUE 0x429b4 _REC_VAL_20_u1 254. _CNV_A_R_LINEAR_____10_CM 1. 255. FORMAT "%3.0" /end CHARACTERISTIC
/begin CHARACTERISTIC IP_VLS_DOWN_MAX_CYCNR "Weighting factor for CYCNR_VLS_DOWN_ACT_i" CURVE 0x50d8f _REC_CUR_20_u1_u2 5100. _CNV_A_R_LINEAR_____293_CM 0. 5100. FORMAT "%5.0"
 /begin AXIS_DESCR COM_AXIS MAF_KGH _CNV_A_R_LINEAR_____101_CM 8 0. 2047.96875 FORMAT "%7.2" AXIS_PTS_REF ldp_maf_kgh__vls_down_max_cycnr /end AXIS_DESCR
/end CHARACTERISTIC
/begin CHARACTERISTIC C_CYCNR_VLS_DOWN_MAX "Diagnostic threshold for VLS_DOWN_CYCNR_i" VALUE 0x42878 _REC_VAL_20_u1 1.99220002 _CNV_A_R_LINEAR_____34_CM 0. 1.99220002 FORMAT "%5.3" /end CHARACTERISTIC
/begin CHARACTERISTIC C_MAF_INT_VLS_DOWN_PUE "Threshold for start of the diagnosis" VALUE 0x42e50 _REC_VAL_20_u2 1820.398 _CNV_A_R_LINEAR_____277_CM 0. 1820.398 FORMAT "%7.2" /end CHARACTERISTIC
/begin CHARACTERISTIC C_VLS_DOWN_DIF_DIAG_MIN "Threshold for VLS_DOWN_DIF_DIAG" VALUE 0x4318a _REC_VAL_20_u2 4.99511719 _CNV_A_R_LINEAR_____33_CM 0. 4.99511719 FORMAT "%5.3" /end CHARACTERISTIC
/begin MEASUREMENT MAF_KGH_MIN_PUC "minimum value of MAF_KGH while switching time calculation" UWORD _CNV_A_R_LINEAR_____101_CM 1 100. 0. 2047.96875 ECU_ADDRESS 0x3fd03a FORMAT "%7.2" /end MEASUREMENT
/begin MEASUREMENT MAF_INT_PUE "sucked air mass after leaving PUC" UWORD _CNV_A_R_LINEAR_____277_CM 1 100. 0. 1820.398 ECU_ADDRESS 0x3fd03c FORMAT "%7.2" /end MEASUREMENT
/begin CHARACTERISTIC C_VS_MAX_DOWN "Maximum vehicle speed for diagnosis of the monitor sensors" VALUE 0x42b2d _REC_VAL_20_u1 255. _CNV_A_R_LINEAR_____13_CM 0. 255. FORMAT "%3.0" /end CHARACTERISTIC
/begin CHARACTERISTIC C_VS_MIN_DOWN "Minimum vehicle speed for diagnosis of the monitor sensors" VALUE 0x42b34 _REC_VAL_20_u1 255. _CNV_A_R_LINEAR_____13_CM 0. 255. FORMAT "%3.0" /end CHARACTERISTIC
/begin MEASUREMENT LV_REQ_DIAG_LS_DOWN "Logical variable" UBYTE _CNV_S_2_RANGE______28_CM 1 100. 0. 1. ECU_ADDRESS 0x3fd03e BIT_MASK 0x1 /end MEASUREMENT
/begin MEASUREMENT LV_END_DIAG_LS_DOWN "Logical variable" UBYTE _CNV_S_2_RANGE______28_CM 1 100. 0. 1. ECU_ADDRESS 0x3fd03f BIT_MASK 0x1 /end MEASUREMENT
/begin CHARACTERISTIC C_CTR_END_DIAG_VLS_DOWN_PUE_MIN "Time counter threshold for CTR_END_DIAG_VLS_DOWN_PUE_i" VALUE 0x42c96 _REC_VAL_20_u2 65534. _CNV_A_R_LINEAR_____10_CM 1. 65535. FORMAT "%5.0" /end CHARACTERISTIC
/begin CHARACTERISTIC C_CTR_INC_VLS_DOWN_PUE "Counter increment for VLS_DOWN_PUE diagnosis" VALUE 0x4286c _REC_VAL_20_u1 255. _CNV_A_R_LINEAR_____10_CM 0. 255. FORMAT "%3.0" /end CHARACTERISTIC
/begin CHARACTERISTIC C_CTR_MAX_VLS_DOWN_PUE "Max value of counter for VLS_DOWN_PUE diagnosis" VALUE 0x4286f _REC_VAL_20_u1 255. _CNV_A_R_LINEAR_____10_CM 0. 255. FORMAT "%3.0" /end CHARACTERISTIC
/begin AXIS_PTS ldp_maf_kgh__vls_down_max_cycnr "" 0x4461e MAF_KGH _REC_AXS_20_u2 2047.96875 _CNV_A_R_LINEAR_____101_CM 8 0. 2047.96875 FORMAT "%7.2" /end AXIS_PTS
/begin MEASUREMENT LV_ERR_VLS_DOWN_PUE_1 "debounded diagnosis result of pull end plausibility" UBYTE _CNV_S_2_RANGE______21_R_CM 1 100. 0. 255. ECU_ADDRESS 0x3fd5b7 /end MEASUREMENT
/begin MEASUREMENT LV_ERR_VLS_DOWN_PUE_2 "debounded diagnosis result of pull end plausibility" UBYTE _CNV_S_2_RANGE______21_R_CM 1 100. 0. 255. ECU_ADDRESS 0x3fd5bb /end MEASUREMENT
/begin MEASUREMENT LV_ERR_SA_SAP "Present failure: Minimum secondary air flow rate failure after filtering" UBYTE _CNV_S_2_RANGE______21_R_CM 1 100. 0. 255. ECU_ADDRESS 0x3fd58b /end MEASUREMENT
/begin MEASUREMENT LV_ERR_SA_SAV "Present failure: Mechanical jammed SAV after filtering" UBYTE _CNV_S_2_RANGE______21_R_CM 1 100. 0. 255. ECU_ADDRESS 0x3fd58f /end MEASUREMENT
/begin MEASUREMENT SUM_AFL_VLS_DIAG_SA_1 "Lean indication counter cylinder group 1" UWORD _CNV_A_R_LINEAR_____10_CM 1 100. 0. 65535. ECU_ADDRESS 0x3fddf0 FORMAT "%5.0" /end MEASUREMENT
/begin MEASUREMENT SUM_AFL_VLS_DIAG_SA_2 "Lean indication counter cylinder group 2" UWORD _CNV_A_R_LINEAR_____10_CM 1 100. 0. 65535. ECU_ADDRESS 0x3fddf2 FORMAT "%5.0" /end MEASUREMENT
/begin MEASUREMENT T_DLY_DIAG_SA "Time delay after secondary air activation to start the SA monitoring" UWORD _CNV_A_R_LINEAR_____397_CM 1 100. 0. 655.3200000000001 ECU_ADDRESS 0x3fddf4 FORMAT "%6.2" /end MEASUREMENT
/begin MEASUREMENT T_DIAG_SA "Timer for duration of Minimum air flow monitoring" UWORD _CNV_A_R_LINEAR_____397_CM 1 100. 0. 655.3200000000001 ECU_ADDRESS 0x3fcc82 FORMAT "%6.2" /end MEASUREMENT
/begin MEASUREMENT LAM_DIAG_SAV_MAX "Maximum LAM-value during SAV check with LAM threshold exceed" SWORD _CNV_A_R_LINEAR_____98_CM 1 100. -50. 49.99847412 ECU_ADDRESS 0x3fddf6 FORMAT "%7.3" /end MEASUREMENT
/begin MEASUREMENT LAM_MV_DIAG_SAV "Mean LAM-value during SAV check with active lambda control" SWORD _CNV_A_R_LINEAR_____98_CM 1 100. -50. 49.99847412 ECU_ADDRESS 0x3fddf8 FORMAT "%7.3" /end MEASUREMENT
/begin CHARACTERISTIC ID_T_DLY_DIAG_SA "Time after START  to start the SA diagnosis" CURVE 0x45e84 _REC_CUR_20_u2_u1 654.99 _CNV_A_R_LINEAR_____398_CM 1.e-002 655. FORMAT "%7.3"
 /begin AXIS_DESCR COM_AXIS TCO_ST _CNV_A_R_LINEAR_____0_CM 8 -48. 142.5 FORMAT "%5.1" AXIS_PTS_REF ldp_tco_st_id_t_dly_diag_sa /end AXIS_DESCR
/end CHARACTERISTIC
/begin CHARACTERISTIC C_LAM_THD_DIAG_SAV "LAM-threshold for SAV diagnosis" VALUE 0x42dc4 _REC_VAL_20_u2 31.25 _CNV_A_R_LINEAR_____399_CM 0. 31.25 /end CHARACTERISTIC
/begin CHARACTERISTIC C_SUM_AFL_VLS_MIN_DIAG_SA "Lean indication threshold for Monitoring of minimum flow rate" VALUE 0x42f3c _REC_VAL_20_u2 65535. _CNV_A_R_LINEAR_____10_CM 0. 65535. FORMAT "%5.0" /end CHARACTERISTIC
/begin CHARACTERISTIC C_T_DIAG_SA "Maximum duration for Monitoring of minimum flow rate" VALUE 0x42f78 _REC_VAL_20_u2 654.99 _CNV_A_R_LINEAR_____398_CM 1.e-002 655. FORMAT "%7.3" /end CHARACTERISTIC
/begin CHARACTERISTIC C_CTR_P_DIAG_SA "Nr. of P-jumps (lambda period = 2 \"P\" -jumps) to  weighten diagnosis results with exceed of the LAM-threshold  " VALUE 0x42c9a _REC_VAL_20_u2 65535. _CNV_A_R_LINEAR_____10_CM 0. 65535. FORMAT "%5.0" /end CHARACTERISTIC
/begin CHARACTERISTIC C_CONF_DIAG_SAV "Configuration byte for activation of the SAV diagnosis" VALUE 0x42810 _REC_VAL_20_u1 2. _CNV_S_3_RANGE_C_CO_400_CM 0. 2. /end CHARACTERISTIC
/begin AXIS_PTS ldp_tco_st_id_t_dly_diag_sa "" 0x43969 TCO _REC_AXS_20_u1 190.5 _CNV_A_R_LINEAR_____0_CM 8 -48. 142.5 FORMAT "%5.1" /end AXIS_PTS
/begin MEASUREMENT T_DLY_INTR_DIAG_SA "Time delay after secair interrupt to continue the SA monitoring" UBYTE _CNV_A_R_LINEAR_____402_CM 1 100. 0. 25.5 ECU_ADDRESS 0x3fdde8 FORMAT "%4.1" /end MEASUREMENT
/begin CHARACTERISTIC C_T_DLY_INTR_DIAG_SA "Time delay after leaving the STATE_SA = INTERRUPT to continue the SA monitoring" VALUE 0x429e2 _REC_VAL_20_u1 25.5 _CNV_A_R_LINEAR_____402_CM 0. 25.5 FORMAT "%4.1" /end CHARACTERISTIC
/begin MEASUREMENT LV_ERR_FSD_1 "" UBYTE _CNV_S_2_RANGE______21_R_CM 1 100. 0. 255. ECU_ADDRESS 0x3fd59f /end MEASUREMENT
/begin MEASUREMENT LV_ERR_FSD_2 "" UBYTE _CNV_S_2_RANGE______21_R_CM 1 100. 0. 255. ECU_ADDRESS 0x3fd5a3 /end MEASUREMENT
/begin MEASUREMENT LV_ERR_LS_UP_SWT_1 "status diagnosis result of switch time monitoring" UBYTE _CNV_S_2_RANGE______21_R_CM 1 100. 0. 255. ECU_ADDRESS 0x3fd6df /end MEASUREMENT
/begin MEASUREMENT LV_ERR_LS_UP_SWT_2 "status diagnosis result of switch time monitoring" UBYTE _CNV_S_2_RANGE______21_R_CM 1 100. 0. 255. ECU_ADDRESS 0x3fd6e3 /end MEASUREMENT
/begin MEASUREMENT LV_ERR_LS_UP_FRQ_1 "status diagnosis result of oxygen fequency monitoring" UBYTE _CNV_S_2_RANGE______21_R_CM 1 100. 0. 255. ECU_ADDRESS 0x3fd6e7 /end MEASUREMENT
/begin MEASUREMENT LV_ERR_LS_UP_FRQ_2 "status diagnosis result of oxygen fequency monitoring" UBYTE _CNV_S_2_RANGE______21_R_CM 1 100. 0. 255. ECU_ADDRESS 0x3fd6eb /end MEASUREMENT
/begin MEASUREMENT LAMB_SP_TEG_1 "Lambda setpoint for TEG calculation (bank 1,2)" UWORD _CNV_A_R_LINEAR_____148_CM 1 100. 0. 31.99902344 ECU_ADDRESS 0x3fde6c FORMAT "%7.4" /end MEASUREMENT
/begin MEASUREMENT EFF_IGA_AV_TEG_1 "Ignition efficiency actual actual value for TEG calculation" UWORD _CNV_A_R_LINEAR_____45_CM 1 100. 0. 1.99996948 ECU_ADDRESS 0x3fde74 FORMAT "%7.5" /end MEASUREMENT
/begin MEASUREMENT NR_CYL_SCC_TEG_1 "Number of shut off cyl for TEG calculation" UBYTE _CNV_A_R_LINEAR_____411_CM 1 100. 0. 13. ECU_ADDRESS 0x3fde7c FORMAT "%4.1" /end MEASUREMENT
/begin MEASUREMENT LAMB_SP_TEG_2 "Lambda setpoint for TEG calculation (bank 1,2)" UWORD _CNV_A_R_LINEAR_____148_CM 1 100. 0. 31.99902344 ECU_ADDRESS 0x3fdf68 FORMAT "%7.4" /end MEASUREMENT
/begin MEASUREMENT EFF_IGA_AV_TEG_2 "Ignition efficiency actual actual value for TEG calculation" UWORD _CNV_A_R_LINEAR_____45_CM 1 100. 0. 1.99996948 ECU_ADDRESS 0x3fdf70 FORMAT "%7.5" /end MEASUREMENT
/begin MEASUREMENT NR_CYL_SCC_TEG_2 "Number of shut off cyl for TEG calculation" UBYTE _CNV_A_R_LINEAR_____411_CM 1 100. 0. 13. ECU_ADDRESS 0x3fdf78 FORMAT "%4.1" /end MEASUREMENT
/begin MEASUREMENT TEMP_CAT "catalyst temperature" UWORD _CNV_A_R_LINEAR_____305_CM 1 100. -33. 990.984375 ECU_ADDRESS 0x3fe086 FORMAT "%6.2" /end MEASUREMENT
/begin MEASUREMENT MAF_TEG "Air mass for TEG calculation" UWORD _CNV_A_R_LINEAR_____95_CM 1 100. 0. 1389. ECU_ADDRESS 0x3fe07c FORMAT "%7.2" /end MEASUREMENT
/begin MEASUREMENT MAF_INT_TEG_ST "Mass air beginning at  start" UWORD _CNV_A_R_LINEAR_____277_CM 1 100. 0. 1820.398 ECU_ADDRESS 0x3fe080 FORMAT "%7.2" /end MEASUREMENT
/begin MEASUREMENT MAF_KGH_TEG "Mass air beginning at  start" UWORD _CNV_A_R_LINEAR_____101_CM 1 100. 0. 2047.96875 ECU_ADDRESS 0x3fe07e FORMAT "%7.2" /end MEASUREMENT
/begin MEASUREMENT N_TEG "Engine speed for TEG calculation" UWORD _CNV_A_R_LINEAR_____17_CM 1 100. 1. 8160. ECU_ADDRESS 0x3fe082 FORMAT "%4.0" /end MEASUREMENT
/begin MEASUREMENT TEG_DYN "model output signal of the exhaust gas temperature" UWORD _CNV_A_R_LINEAR_____211_CM 1 100. 0. 2047. ECU_ADDRESS 0x3fe084 FORMAT "%7.2" /end MEASUREMENT
/begin MEASUREMENT TEG_CAT_UP_MDL_1 "exhaust gas temperature" UWORD _CNV_A_R_LINEAR_____211_CM 1 100. 0. 2047. ECU_ADDRESS 0x3fe088 FORMAT "%7.2" /end MEASUREMENT
/begin MEASUREMENT TEG_CAT_UP_MDL_2 "exhaust gas temperature" UWORD _CNV_A_R_LINEAR_____211_CM 1 100. 0. 2047. ECU_ADDRESS 0x3fe08c FORMAT "%7.2" /end MEASUREMENT
/begin MEASUREMENT TEG_CAT_DOWN_MDL_2 "exhaust gas temperature" UWORD _CNV_A_R_LINEAR_____211_CM 1 100. 0. 2047. ECU_ADDRESS 0x3fe08e FORMAT "%7.2" /end MEASUREMENT
/begin MEASUREMENT TEG_CAT_DOWN_MDL_1 "exhaust gas temperature" UWORD _CNV_A_R_LINEAR_____211_CM 1 100. 0. 2047. ECU_ADDRESS 0x3fe08a FORMAT "%7.2" /end MEASUREMENT
/begin MEASUREMENT EOI_S_0 "End of injection phase for Stratified mode" UWORD _CNV_A_R_LINEAR_____75_CM 1 100. 0. 720. ECU_ADDRESS 0x3fcf22 FORMAT "%6.2" /end MEASUREMENT
/begin MEASUREMENT EOI_S_1 "End of injection phase for Stratified mode" UWORD _CNV_A_R_LINEAR_____75_CM 1 100. 0. 720. ECU_ADDRESS 0x3fcf24 FORMAT "%6.2" /end MEASUREMENT
/begin MEASUREMENT EOI_S_2 "End of injection phase for Stratified mode" UWORD _CNV_A_R_LINEAR_____75_CM 1 100. 0. 720. ECU_ADDRESS 0x3fcf26 FORMAT "%6.2" /end MEASUREMENT
/begin MEASUREMENT EOI_S_3 "End of injection phase for Stratified mode" UWORD _CNV_A_R_LINEAR_____75_CM 1 100. 0. 720. ECU_ADDRESS 0x3fcf28 FORMAT "%6.2" /end MEASUREMENT
/begin MEASUREMENT EOI_S_4 "End of injection phase for Stratified mode" UWORD _CNV_A_R_LINEAR_____75_CM 1 100. 0. 720. ECU_ADDRESS 0x3fcf2a FORMAT "%6.2" /end MEASUREMENT
/begin MEASUREMENT EOI_S_5 "End of injection phase for Stratified mode" UWORD _CNV_A_R_LINEAR_____75_CM 1 100. 0. 720. ECU_ADDRESS 0x3fcf2c FORMAT "%6.2" /end MEASUREMENT
/begin MEASUREMENT EOI_S_CLC_0 "End of injection phase for Stratified mode" UWORD _CNV_A_R_LINEAR_____75_CM 1 100. 0. 720. ECU_ADDRESS 0x3fcf34 FORMAT "%6.2" /end MEASUREMENT
/begin MEASUREMENT EOI_S_CLC_1 "End of injection phase for Stratified mode" UWORD _CNV_A_R_LINEAR_____75_CM 1 100. 0. 720. ECU_ADDRESS 0x3fcf36 FORMAT "%6.2" /end MEASUREMENT
/begin MEASUREMENT EOI_S_CLC_2 "End of injection phase for Stratified mode" UWORD _CNV_A_R_LINEAR_____75_CM 1 100. 0. 720. ECU_ADDRESS 0x3fcf38 FORMAT "%6.2" /end MEASUREMENT
/begin MEASUREMENT EOI_S_CLC_3 "End of injection phase for Stratified mode" UWORD _CNV_A_R_LINEAR_____75_CM 1 100. 0. 720. ECU_ADDRESS 0x3fcf3a FORMAT "%6.2" /end MEASUREMENT
/begin MEASUREMENT EOI_S_CLC_4 "End of injection phase for Stratified mode" UWORD _CNV_A_R_LINEAR_____75_CM 1 100. 0. 720. ECU_ADDRESS 0x3fcf3c FORMAT "%6.2" /end MEASUREMENT
/begin MEASUREMENT EOI_S_CLC_5 "End of injection phase for Stratified mode" UWORD _CNV_A_R_LINEAR_____75_CM 1 100. 0. 720. ECU_ADDRESS 0x3fcf3e FORMAT "%6.2" /end MEASUREMENT
/begin MEASUREMENT EOI_DIF_S "Difference of end of injection phase for Stratified mode" SWORD _CNV_A_R_LINEAR_____75_CM 1 100. -360. 360. ECU_ADDRESS 0x3fe480 FORMAT "%5.1" /end MEASUREMENT
/begin CHARACTERISTIC IP_EOI_DIF_S "End of injection for stratified mode relative to ignition angle" MAP 0x472b0 _REC_MAP_20_u2_u1_u2 720. _CNV_A_R_LINEAR_____435_CM -360. 360. FORMAT "%6.1"
 /begin AXIS_DESCR COM_AXIS N_32 _CNV_A_R_LINEAR_____5_CM 6 0. 8160. FORMAT "%4.0" AXIS_PTS_REF ldp_n__eoi_dif_s /end AXIS_DESCR
 /begin AXIS_DESCR COM_AXIS MFF_SP_S _CNV_A_R_LINEAR_____95_CM 6 0. 1389. FORMAT "%7.2" AXIS_PTS_REF ldp_mff_sp_s__eoi_dif_s /end AXIS_DESCR
/end CHARACTERISTIC
/begin CHARACTERISTIC C_EOI_S_AS "Global application assistance" VALUE 0x4324e _REC_VAL_20_s2 1440. _CNV_A_R_LINEAR_____75_CM -720. 720. FORMAT "%6.1" /end CHARACTERISTIC
/begin CHARACTERISTIC C_EOI_S_MAN "Global application assistance " VALUE 0x42cf6 _REC_VAL_20_u2 720. _CNV_A_R_LINEAR_____75_CM 0. 720. FORMAT "%6.2" /end CHARACTERISTIC
/begin CHARACTERISTIC LC_EOI_S_MAN_ACT "Global application assistance switch passive/active" VALUE 0x42b80 _REC_VAL_20_u1 1. _CNV_A_R_LINEAR_____10_CM 0. 1. FORMAT "%2.0" /end CHARACTERISTIC
/begin AXIS_PTS ldp_n__eoi_dif_s "" 0x436f2 N_32 _REC_AXS_20_u1 8160. _CNV_A_R_LINEAR_____5_CM 6 0. 8160. FORMAT "%4.0" /end AXIS_PTS
/begin AXIS_PTS ldp_mff_sp_s__eoi_dif_s "" 0x44768 MFF_SP_S _REC_AXS_20_u2 1389. _CNV_A_R_LINEAR_____95_CM 6 0. 1389. FORMAT "%7.2" /end AXIS_PTS
/begin MEASUREMENT TI_ST_REST "Cold start reduction factor in case of re-start detected" UBYTE _CNV_A_R_LINEAR_____44_CM 1 100. 0. 0.996094 ECU_ADDRESS 0x3fcf42 FORMAT "%5.3" /end MEASUREMENT
/begin CHARACTERISTIC IP_TQ_ADD_CP "MAP for dtermination of TQ_ADD_CP in dependence of CL_MMV" CURVE 0x4be18 _REC_CUR_20_u2_u2 2047.96875 _CNV_A_R_LINEAR_____218_CM -1024. 1023.96875 FORMAT "%6.2"
 /begin AXIS_DESCR COM_AXIS ONLINE_DUMMY _CNV_A_R_LINEAR_____348_CM 6 0. 7.99987793 FORMAT "%6.4" AXIS_PTS_REF ldp_cl_mmv /end AXIS_DESCR
/end CHARACTERISTIC
/begin MEASUREMENT TQ_ADD_CP "Torque reserve for canister purge at idle" SWORD _CNV_A_R_LINEAR_____48_CM 1 100. -1024. 1023.96875 ECU_ADDRESS 0x3fd276 FORMAT "%8.2" /end MEASUREMENT
/begin CHARACTERISTIC C_CRLC_TQ_ADD_CP "Filter constant" VALUE 0x4283b _REC_VAL_20_u1 0.9960940000000002 _CNV_A_R_LINEAR_____44_CM 0. 0.996094 FORMAT "%5.3" /end CHARACTERISTIC
/begin CHARACTERISTIC LC_TQ_ADD_CP_INH "Logical variable for inhibiting the torque reserve for canister purge in idle" VALUE 0x42bd4 _REC_VAL_20_u1 1. _CNV_A_R_LINEAR_____10_CM 0. 1. FORMAT "%2.0" /end CHARACTERISTIC
/begin AXIS_PTS ldp_cl_mmv "" 0x44202 CL_MMV _REC_AXS_20_u2 7.99987793 _CNV_A_R_LINEAR_____348_CM 6 0. 7.99987793 FORMAT "%6.4" /end AXIS_PTS
/begin CHARACTERISTIC C_DLY_IS_AD "time delay for ISC Adaptation" VALUE 0x42880 _REC_VAL_20_u1 255. _CNV_A_R_LINEAR_____187_CM 0. 255. FORMAT "%3.0" /end CHARACTERISTIC
/begin CHARACTERISTIC C_CTR_MAX_WUP_CYC "Initialization value for the warm-up cycle of diagnostics" VALUE 0x42870 _REC_VAL_20_u1 255. _CNV_A_R_LINEAR_____10_CM 0. 255. FORMAT "%3.0" /end CHARACTERISTIC
/begin CHARACTERISTIC LC_ENA_SCDN "Boolean to indicate iof similar conditions are inhibited (0) or (1)" VALUE 0x42b7d _REC_VAL_20_u1 1. _CNV_A_R_LINEAR_____10_CM 0. 1. FORMAT "%2.0" /end CHARACTERISTIC
/begin COMPU_METHOD _CNV_A_R_LINEAR_____0_CM "" RAT_FUNC "%6.3" "°C" COEFFS 0 1.333333333333333 64. 0 0 1 /end COMPU_METHOD
/begin COMPU_METHOD _CNV_A_R_LINEAR_____3_CM "" RAT_FUNC "%6.3" "°C" COEFFS 0 1. 40. 0 0 1 /end COMPU_METHOD
/begin COMPU_METHOD _CNV_A_R_LINEAR_____5_CM "" RAT_FUNC "%6.3" "rpm" COEFFS 0 3.125e-002 0. 0 0 1 /end COMPU_METHOD
/begin COMPU_METHOD _CNV_A_R_LINEAR_____6_CM "" RAT_FUNC "%6.3" "m" COEFFS 0 1.e-002 0. 0 0 1 /end COMPU_METHOD
/begin COMPU_METHOD _CNV_A_R_LINEAR_____10_CM "" RAT_FUNC "%6.3" "-" COEFFS 0 1. 0. 0 0 1 /end COMPU_METHOD
/begin COMPU_METHOD _CNV_S_2_RANGE______11_CM "" TAB_VERB "%6.3" "-" COMPU_TAB_REF _CNV_S_2_RANGE______11 /end COMPU_METHOD
/begin COMPU_VTAB _CNV_S_2_RANGE______11 "" TAB_VERB 2 0 "0" 1 "1" /end COMPU_VTAB
/begin COMPU_METHOD _CNV_A_R_LINEAR_____12_CM "" RAT_FUNC "%6.3" "[-]" COEFFS 0 1. 0. 0 0 1 /end COMPU_METHOD
/begin COMPU_METHOD _CNV_A_R_LINEAR_____13_CM "" RAT_FUNC "%6.3" "km/h" COEFFS 0 1. 0. 0 0 1 /end COMPU_METHOD
/begin COMPU_METHOD _CNV_A_R_LINEAR_____14_CM "" RAT_FUNC "%6.3" "s" COEFFS 0 10. 0. 0 0 1 /end COMPU_METHOD
/begin COMPU_METHOD _CNV_A_R_LINEAR_____17_CM "" RAT_FUNC "%6.3" "rpm" COEFFS 0 1. 0. 0 0 1 /end COMPU_METHOD
/begin COMPU_METHOD _CNV_A_R_LINEAR_____18_CM "" RAT_FUNC "%6.3" "mg/stk" COEFFS 0 0.183585313174946 0. 0 0 1 /end COMPU_METHOD
/begin COMPU_METHOD _CNV_A_R_LINEAR_____20_CM "" RAT_FUNC "%6.3" "-" COEFFS 0 255.9983911655618 0. 0 0 1 /end COMPU_METHOD
/begin COMPU_METHOD _CNV_S_2_RANGE______21_R_CM "" TAB_VERB "%6.3" "[-]" COMPU_TAB_REF _CNV_S_2_RANGE______21_R /end COMPU_METHOD
/begin COMPU_VTAB_RANGE _CNV_S_2_RANGE______21_R "" 2 0 0 "0" 1 255 "1" /end COMPU_VTAB_RANGE
/begin COMPU_METHOD _CNV_A_R_LINEAR_____23_CM "" RAT_FUNC "%6.3" "ms" COEFFS 0 0.1 0. 0 0 1 /end COMPU_METHOD
/begin COMPU_METHOD _CNV_A_R_LINEAR_____27_CM "" RAT_FUNC "%6.3" "s" COEFFS 0 100. 0. 0 0 1 /end COMPU_METHOD
/begin COMPU_METHOD _CNV_S_2_RANGE______28_CM "" TAB_VERB "%6.3" "[-]" COMPU_TAB_REF _CNV_S_2_RANGE______28 /end COMPU_METHOD
/begin COMPU_VTAB _CNV_S_2_RANGE______28 "" TAB_VERB 2 0 "0" 1 "1" /end COMPU_VTAB
/begin COMPU_METHOD _CNV_A_R_LINEAR_____29_CM "" RAT_FUNC "%6.3" "µs" COEFFS 0 0.125 0. 0 0 1 /end COMPU_METHOD
/begin COMPU_METHOD _CNV_A_R_LINEAR_____30_CM "" RAT_FUNC "%6.3" "%." COEFFS 0 65.5359830397456 0. 0 0 1 /end COMPU_METHOD
/begin COMPU_METHOD _CNV_A_R_LINEAR_____31_CM "" RAT_FUNC "%6.3" "-" COEFFS 0 65536.00007936121 0. 0 0 1 /end COMPU_METHOD
/begin COMPU_METHOD _CNV_A_R_LINEAR_____32_CM "" RAT_FUNC "%6.3" "%." COEFFS 0 65.77254901960784 0. 0 0 1 /end COMPU_METHOD
/begin COMPU_METHOD _CNV_A_R_LINEAR_____33_CM "" RAT_FUNC "%6.3" "V" COEFFS 0 204.7999998974999 0. 0 0 1 /end COMPU_METHOD
/begin COMPU_METHOD _CNV_A_R_LINEAR_____34_CM "" RAT_FUNC "%6.3" "-" COEFFS 0 127.9991955827809 0. 0 0 1 /end COMPU_METHOD
/begin COMPU_METHOD _CNV_A_R_LINEAR_____43_CM "" RAT_FUNC "%6.3" "hPa" COEFFS 0 12.06017666543982 0. 0 0 1 /end COMPU_METHOD
/begin COMPU_METHOD _CNV_A_R_LINEAR_____44_CM "" RAT_FUNC "%6.3" "[-]" COEFFS 0 255.9999357490357 0. 0 0 1 /end COMPU_METHOD
/begin COMPU_METHOD _CNV_A_R_LINEAR_____45_CM "" RAT_FUNC "%6.3" "-" COEFFS 0 32768.00003968061 0. 0 0 1 /end COMPU_METHOD
/begin COMPU_METHOD _CNV_A_R_LINEAR_____48_CM "" RAT_FUNC "%6.3" "Nm" COEFFS 0 32. 0. 0 0 1 /end COMPU_METHOD
/begin COMPU_METHOD _CNV_A_R_LINEAR_____75_CM "" RAT_FUNC "%6.3" "°CRK" COEFFS 0 2.666666666666667 0. 0 0 1 /end COMPU_METHOD
/begin COMPU_METHOD _CNV_A_R_LINEAR_____94_CM "" RAT_FUNC "%6.3" "%" COEFFS 0 655.3600000071681 0. 0 0 1 /end COMPU_METHOD
/begin COMPU_METHOD _CNV_A_R_LINEAR_____95_CM "" RAT_FUNC "%6.3" "mg/stk" COEFFS 0 47.18142548596112 0. 0 0 1 /end COMPU_METHOD
/begin COMPU_METHOD _CNV_A_R_LINEAR_____98_CM "" RAT_FUNC "%6.3" "%" COEFFS 0 655.3600000071681 3.584063961170614e-007 0 0 1 /end COMPU_METHOD
/begin COMPU_METHOD _CNV_A_R_LINEAR_____101_CM "" RAT_FUNC "%6.3" "kg/h" COEFFS 0 32. 0. 0 0 1 /end COMPU_METHOD
/begin COMPU_METHOD _CNV_A_R_LINEAR_____103_CM "" RAT_FUNC "%6.3" "-" COEFFS 0 128. 0. 0 0 1 /end COMPU_METHOD
/begin COMPU_METHOD _CNV_A_R_LINEAR_____111_CM "" RAT_FUNC "%6.3" "-" COEFFS 0 255.9999997499962 0. 0 0 1 /end COMPU_METHOD
/begin COMPU_METHOD _CNV_A_R_LINEAR_____141_CM "" RAT_FUNC "%6.3" "-" COEFFS 0 64. 0. 0 0 1 /end COMPU_METHOD
/begin COMPU_METHOD _CNV_A_R_LINEAR_____143_CM "" RAT_FUNC "%6.3" "%" COEFFS 0 655.3600000071681 32768.00000035841 0 0 1 /end COMPU_METHOD
/begin COMPU_METHOD _CNV_A_R_LINEAR_____148_CM "" RAT_FUNC "%6.3" "-" COEFFS 0 1023.999999919998 0. 0 0 1 /end COMPU_METHOD
/begin COMPU_METHOD _CNV_A_R_LINEAR_____160_CM "" RAT_FUNC "%6.3" "°C" COEFFS 0 0.25 8.25 0 0 1 /end COMPU_METHOD
/begin COMPU_METHOD _CNV_A_R_LINEAR_____169_CM "" RAT_FUNC "%6.3" "s" COEFFS 0 50. 0. 0 0 1 /end COMPU_METHOD
/begin COMPU_METHOD _CNV_A_R_LINEAR_____173_CM "" RAT_FUNC "%6.3" "%" COEFFS 0 327.680000003584 3.584063961170614e-007 0 0 1 /end COMPU_METHOD
/begin COMPU_METHOD _CNV_S_2_RANGE______183_CM "" TAB_VERB "%6.3" "[-]" COMPU_TAB_REF _CNV_S_2_RANGE______183 /end COMPU_METHOD
/begin COMPU_VTAB _CNV_S_2_RANGE______183 "" TAB_VERB 2 0 "PASSIVE" 1 "ACTIVE" /end COMPU_VTAB
/begin COMPU_METHOD _CNV_S_3_RANGE_STAT_185_CM "" TAB_VERB "%6.3" "[-]" COMPU_TAB_REF _CNV_S_3_RANGE_STAT_185 /end COMPU_METHOD
/begin COMPU_VTAB _CNV_S_3_RANGE_STAT_185 "" TAB_VERB 3 0 "OFF" 1 "ON" 2 "LAMP BLINKING" /end COMPU_VTAB
/begin COMPU_METHOD _CNV_S_2_RANGE______186_R_CM "" TAB_VERB "%6.3" "[-]" COMPU_TAB_REF _CNV_S_2_RANGE______186_R /end COMPU_METHOD
/begin COMPU_VTAB_RANGE _CNV_S_2_RANGE______186_R "" 2 0 0 "OFF" 1 255 "ON" /end COMPU_VTAB_RANGE
/begin COMPU_METHOD _CNV_A_R_LINEAR_____187_CM "" RAT_FUNC "%6.3" "*100ms" COEFFS 0 1. 0. 0 0 1 /end COMPU_METHOD
/begin COMPU_METHOD _CNV_A_R_LINEAR_____195_CM "" RAT_FUNC "%6.3" "[-]" COEFFS 0 64. 0. 0 0 1 /end COMPU_METHOD
/begin COMPU_METHOD _CNV_A_R_LINEAR_____211_CM "" RAT_FUNC "%6.3" "°C" COEFFS 0 16. 0. 0 0 1 /end COMPU_METHOD
/begin COMPU_METHOD _CNV_A_R_LINEAR_____212_CM "" RAT_FUNC "%6.3" "Nm" COEFFS 0 8191.999999679995 32767.99999871998 0 0 1 /end COMPU_METHOD
/begin COMPU_METHOD _CNV_A_R_LINEAR_____213_CM "" RAT_FUNC "%6.3" "rpm" COEFFS 0 1. 32768. 0 0 1 /end COMPU_METHOD
/begin COMPU_METHOD _CNV_A_R_LINEAR_____214_CM "" RAT_FUNC "%6.3" "Nm" COEFFS 0 8191.999999679995 -1.280019205296412e-006 0 0 1 /end COMPU_METHOD
/begin COMPU_METHOD _CNV_A_R_LINEAR_____215_CM "" RAT_FUNC "%6.3" "rpm/s" COEFFS 0 3.125e-002 0. 0 0 1 /end COMPU_METHOD
/begin COMPU_METHOD _CNV_S_3_STATE_P_D__216_CM "" TAB_VERB "%6.3" "[-]" COMPU_TAB_REF _CNV_S_3_STATE_P_D__216 /end COMPU_METHOD
/begin COMPU_VTAB _CNV_S_3_STATE_P_D__216 "" TAB_VERB 3 0 "P_D_PASSIVE" 1 "P_D_NORMAL" 2 "RAMP_TO_ZERO" /end COMPU_VTAB
/begin COMPU_METHOD _CNV_S_4_STATE_I_IS_217_CM "" TAB_VERB "%6.3" "[-]" COMPU_TAB_REF _CNV_S_4_STATE_I_IS_217 /end COMPU_METHOD
/begin COMPU_VTAB _CNV_S_4_STATE_I_IS_217 "" TAB_VERB 4 0 "I_PASSIVE" 1 "I_NORMAL" 2 "RAMP_TO_PAS" 3 "RAMP_TO_LIM" /end COMPU_VTAB
/begin COMPU_METHOD _CNV_A_R_LINEAR_____218_CM "" RAT_FUNC "%6.3" "Nm" COEFFS 0 32. 32768. 0 0 1 /end COMPU_METHOD
/begin COMPU_METHOD _CNV_A_R_LINEAR_____219_CM "" RAT_FUNC "%6.3" "rpm/s" COEFFS 0 3.125e-002 128. 0 0 1 /end COMPU_METHOD
/begin COMPU_METHOD _CNV_S_4_STATE_REQ__220_CM "" TAB_VERB "%6.3" "[-]" COMPU_TAB_REF _CNV_S_4_STATE_REQ__220 /end COMPU_METHOD
/begin COMPU_VTAB _CNV_S_4_STATE_REQ__220 "" TAB_VERB 4 0 "ISC_PASSIVE" 1 "AFTER_START" 2 "NORMAL" 3 "TRAILING_THR" /end COMPU_VTAB
/begin COMPU_METHOD _CNV_A_R_LINEAR_____221_CM "" RAT_FUNC "%6.3" "s" COEFFS 0 32. 0. 0 0 1 /end COMPU_METHOD
/begin COMPU_METHOD _CNV_A_R_LINEAR_____222_CM "" RAT_FUNC "%6.3" "Nm/rpm*rpm" COEFFS 0 134295784.7496875 0.1714789237448713 0 0 1 /end COMPU_METHOD
/begin COMPU_METHOD _CNV_A_R_LINEAR_____223_CM "" RAT_FUNC "%6.3" "Nm/rpm*rpm" COEFFS 0 134213975.5877775 -1. 0 0 1 /end COMPU_METHOD
/begin COMPU_METHOD _CNV_A_R_LINEAR_____224_CM "" RAT_FUNC "%6.3" "1/rpm²" COEFFS 0 134293032.7868853 0. 0 0 1 /end COMPU_METHOD
/begin COMPU_METHOD _CNV_A_R_LINEAR_____225_CM "" RAT_FUNC "%6.3" "Nm" COEFFS 0 2097152.000003239 3.316402435302734e-003 0 0 1 /end COMPU_METHOD
/begin COMPU_METHOD _CNV_A_R_LINEAR_____261_CM "" RAT_FUNC "%6.3" "mg/stk" COEFFS 0 47.18214541280769 -1.080506262951531e-005 0 0 1 /end COMPU_METHOD
/begin COMPU_METHOD _CNV_A_R_LINEAR_____270_CM "" RAT_FUNC "%6.3" "mg/stk" COEFFS 0 47.14849960790521 32768.20722749412 0 0 1 /end COMPU_METHOD
/begin COMPU_METHOD _CNV_A_R_LINEAR_____276_CM "" RAT_FUNC "%6.3" "-" COEFFS 0 1024.000001200037 0. 0 0 1 /end COMPU_METHOD
/begin COMPU_METHOD _CNV_A_R_LINEAR_____277_CM "" RAT_FUNC "%6.3" "g" COEFFS 0 36.00036915004301 0. 0 0 1 /end COMPU_METHOD
/begin COMPU_METHOD _CNV_A_R_LINEAR_____280_CM "" RAT_FUNC "%6.3" "ms" COEFFS 0 2.133333333333333 0. 0 0 1 /end COMPU_METHOD
/begin COMPU_METHOD _CNV_A_R_LINEAR_____285_CM "" RAT_FUNC "%6.3" "ohm" COEFFS 0 1. 0. 0 0 1 /end COMPU_METHOD
/begin COMPU_METHOD _CNV_A_R_LINEAR_____288_CM "" RAT_FUNC "%6.3" "-" COEFFS 0 25.6 0. 0 0 1 /end COMPU_METHOD
/begin COMPU_METHOD _CNV_S_8_STATE_VLS__289_CM "" TAB_VERB "%6.3" "[-]" COMPU_TAB_REF _CNV_S_8_STATE_VLS__289 /end COMPU_METHOD
/begin COMPU_VTAB _CNV_S_8_STATE_VLS__289 "" TAB_VERB 8 0 "Passive" 1 "Active" 2 "Monitoring 1" 3 "Monitoring 2" 4 "Validation" 5 "Calculation" 6 "Cycle end" 255 "Finished" /end COMPU_VTAB
/begin COMPU_METHOD _CNV_A_R_LINEAR_____290_CM "" RAT_FUNC "%6.3" "kg/h" COEFFS 0 128.0000018750286 0. 0 0 1 /end COMPU_METHOD
/begin COMPU_METHOD _CNV_A_R_LINEAR_____291_CM "" RAT_FUNC "%6.3" "[-]" COEFFS 0 12800.00218753375 0. 0 0 1 /end COMPU_METHOD
/begin COMPU_METHOD _CNV_A_R_LINEAR_____292_CM "" RAT_FUNC "%6.3" "-" COEFFS 0 25.59999997499962 0. 0 0 1 /end COMPU_METHOD
/begin COMPU_METHOD _CNV_A_R_LINEAR_____293_CM "" RAT_FUNC "%6.3" "ms" COEFFS 0 5.e-002 0. 0 0 1 /end COMPU_METHOD
/begin COMPU_METHOD _CNV_A_R_LINEAR_____301_CM "" RAT_FUNC "%6.3" "mg/stk" COEFFS 0 3020.046082949309 -0.499999999996362 0 0 1 /end COMPU_METHOD
/begin COMPU_METHOD _CNV_S_6_STATE_MFF__302_CM "" TAB_VERB "%6.3" "[-]" COMPU_TAB_REF _CNV_S_6_STATE_MFF__302 /end COMPU_METHOD
/begin COMPU_VTAB _CNV_S_6_STATE_MFF__302 "" TAB_VERB 6 0 "INIT" 1 "WAIT" 2 "CDN_ADD" 3 "ADAPT_ADD" 4 "CDN_FAC" 5 "ADAPT_FAC" /end COMPU_VTAB
/begin COMPU_METHOD _CNV_A_R_LINEAR_____303_CM "" RAT_FUNC "%6.3" "g" COEFFS 0 35.99993408114611 0. 0 0 1 /end COMPU_METHOD
/begin COMPU_METHOD _CNV_A_R_LINEAR_____304_CM "" RAT_FUNC "%6.3" "%/s" COEFFS 0 0.1024000000600009 0. 0 0 1 /end COMPU_METHOD
/begin COMPU_METHOD _CNV_A_R_LINEAR_____305_CM "" RAT_FUNC "%6.3" "°C" COEFFS 0 64. 2112. 0 0 1 /end COMPU_METHOD
/begin COMPU_METHOD _CNV_A_R_LINEAR_____315_CM "" RAT_FUNC "%6.3" "%/s" COEFFS 0 0.1024000154202376 0. 0 0 1 /end COMPU_METHOD
/begin COMPU_METHOD _CNV_A_R_LINEAR_____318_CM "" RAT_FUNC "%6.3" "V" COEFFS 0 204.8048048048048 0. 0 0 1 /end COMPU_METHOD
/begin COMPU_METHOD _CNV_A_R_LINEAR_____330_CM "" RAT_FUNC "%6.3" "s" COEFFS 0 3.333333333333333 1.110223024625157e-016 0 0 1 /end COMPU_METHOD
/begin COMPU_METHOD _CNV_A_R_LINEAR_____348_CM "" RAT_FUNC "%6.3" "-" COEFFS 0 8191.999999679995 0. 0 0 1 /end COMPU_METHOD
/begin COMPU_METHOD _CNV_S_234_RANGE_DIAG_382_CM "" TAB_VERB "%6.3" "[-]" COMPU_TAB_REF _CNV_S_234_RANGE_DIAG_382 /end COMPU_METHOD
/begin COMPU_VTAB _CNV_S_234_RANGE_DIAG_382 "" TAB_VERB 234 0 "NO_ERROR" 1 "TEG_PCAT_DOWN_1" 2 "TEG_PCAT_DOWN_2" 3 "TOIL" 4 "TCO_EX" 5 "TIA" 6 "AMP" 7 "MAF" 8 "VLS_DOWN_MAX_1" 9 "VLS_DOWN_MAX_2" 10 "VLS_DOWN_MIN_COLD_1" 11 "VLS_DOWN_MIN_COLD_2" 12 "VLS_DOWN_MIN_1" 13 "VLS_DOWN_MIN_2" 14 "VLS_DOWN_OC_1" 15 "VLS_DOWN_OC_2" 16 "LAM_LIM_1" 17 "LAM_LIM_2" 18 "IV_0" 19 "IV_1" 20 "IV_2" 21 "IV_3" 22 "IV_4" 23 "IV_5" 24 "LSH_UP_1" 25 "LSH_UP_2" 26 "LSH_DOWN_1" 27 "LSH_DOWN_2" 28 "RLY_EFP" 29 "CPS" 30 "MEC_IVVT_IN_1" 31 "MEC_IVVT_IN_2" 32 "MEC_IVVT_EX_1" 33 "MEC_IVVT_EX_2" 34 "REF_IVVT_IN_1" 35 "REF_IVVT_IN_2" 36 "REF_IVVT_EX_1" 37 "REF_IVVT_EX_2" 38 "SLV_IVVT_IN_1" 39 "SLV_IVVT_IN_2" 40 "SLV_IVVT_EX_1" 41 "SLV_IVVT_EX_2" 42 "ECU_CKS" 43 "TOIL_LEVEL" 44 "TOUT_ETCU_1" 45 "TOUT_ETCU_2" 46 "TOUT_ICL_2" 47 "TOUT_ICL_3" 48 "TOUT_ASR_1" 49 "TOUT_ASR_3" 50 "TOUT_PSTE_1" 51 "TOUT_AMT_1" 52 "VS" 53 "KNKS_1" 54 "KNKS_2" 55 "TD_IGC_CUT_0" 56 "TD_IGC_CUT_1" 57 "TD_IGC_CUT_2" 58 "TD_IGC_CUT_3" 59 "TD_IGC_CUT_4" 60 "TD_IGC_CUT_5" 61 "DUR_IGC_0" 62 "DUR_IGC_1" 63 "DUR_IGC_2" 64 "DUR_IGC_3" 65 "DUR_IGC_4" 66 "DUR_IGC_5" 67 "TPS_1" 68 "TPS_2" 69 "TPS_MAF_1" 70 "TPS_MAF_2" 71 "V_REF_1" 72 "V_REF_2" 73 "PVS_1" 74 "PVS_2" 75 "PVS_RATIO" 76 "PVS_DOUBLE" 77 "MTC_DR" 78 "MTC_CTL_1" 79 "MTC_CTL_2" 80 "MTC_CTL_3" 81 "TPS_AD" 82 "TPS_AD_BOL" 83 "TPS_ST_CHK_1" 84 "TPS_ST_CHK_2" 85 "GEN" 86 "GEN_IF" 87 "VIM" 88 "CAM_PER_0" 89 "CAM_PER_1" 90 "CAM_PSN_0" 91 "CAM_PSN_1" 92 "CAM_0_NOT_PLAUS" 93 "CAM_1_NOT_PLAUS" 94 "ENG_PSN" 95 "TOOTH_PER" 96 "TPU_SYN" 97 "CRK_NOT_PLAUS" 98 "TOUT_TXU_1" 99 "CAN_BOFF" 100 "RLY_MAIN" 101 "RLY_MAIN_DLY" 102 "RLY_ACCOUT" 103 "SAP" 104 "SAV" 105 "ECF" 106 "TCO_EL" 107 "TCO_STUCK" 108 "TCO_GRD" 109 "ECT_EL" 110 "ECT_MEC" 111 "TCO_PLAUS" 112 "ISC" 113 "IM_BLS_PLAUS" 114 "IM_BTS_PLAUS" 115 "MSW_TOG" 116 "MSW_2" 117 "MSW_3" 118 "ISA_1" 119 "ISA_2" 120 "MEC_ISA" 121 "SEG_T_AD" 122 "SEG_T" 123 "MIS_A" 124 "MIS_B1" 125 "MIS_B4" 126 "MIS_LOW_FUEL" 127 "MIS_MPL" 128 "CONV_MON_1" 129 "N_32_MON_1" 130 "PVS_MON_1" 131 "TPS_MON_1" 132 "TQ_LOSS_MON_1" 133 "TQ_MIN_CLU_MON_1" 134 "TQ_MAX_CLU_MON_1" 135 "TQ_DIF_P_D_IS_MON_1" 136 "TQ_DIF_I_IS_MON_1" 137 "TQI_AV_MON_1" 138 "TQI_N_MAX_MON_1" 139 "MSR_INH_MON_1" 140 "CRU_INH_MON_1" 141 "MAF_MON_1" 142 "TQI_ISC_MON_1" 143 "TQI_N_MAX_NVMY_MON" 144 "SA_SAFM" 145 "SA_SAP" 146 "SA_SAV" 147 "IMOB_1" 148 "IMOB_2" 149 "IMOB_3" 150 "FSD_1" 151 "FSD_2" 152 "CAT_DIAG_1" 153 "CAT_DIAG_2" 154 "LS_DOWN_SWT_1" 155 "LS_DOWN_SWT_2" 156 "VLS_DOWN_PUE_1" 157 "VLS_DOWN_PUE_2" 158 "EF" 159 "TECU" 160 "EBOX_CFA" 161 "ECU_RAM" 162 "TQI_LIM" 163 "PVS_BLS_NOT_PLAUS" 164 "OBD2_LSH_UP_1" 165 "OBD2_LSH_UP_2" 166 "OBD2_LSH_DOWN_1" 167 "OBD2_LSH_DOWN_2" 168 "DMTLS" 169 "DMTL_PUMP" 170 "DMTLM" 171 "DMTL_LEAK" 172 "SOF" 173 "SOF_REQ" 174 "RLY_ST" 175 "BSD" 176 "POIL_SWI" 177 "TOUT_EFP" 178 "DIAGCPS" 179 "TQ_GS_INC_PLAUS" 180 "DCC_REV" 181 "DCC_IRREV" 182 "ECRAS" 183 "DMTLH" 184 "BN_TQ_DCC" 185 "BN_ARS" 186 "BN_CAS" 187 "BN_TQ_TCS" 188 "BN_VS_TCS" 189 "BN_TCS" 190 "BN_TQ_ETCU" 191 "BN_ETCU" 192 "BN_TQ_AMT" 193 "BN_ACC" 194 "BN_T_ICL" 195 "BN_VEH_MOD" 196 "BN_KM_ICL" 197 "BN_ICL" 198 "BN_POW_VB" 199 "BN_POW_GEN" 200 "BN_MSW" 201 "BN_ANG_PSTE" 202 "LOAD_TPS_PLAUS" 203 "TPS_PLAUS" 204 "LOAD_PLAUS" 205 "CRASH_EFP" 206 "N_EFP_LOW" 207 "N_EFP_HIGH" 208 "EFP_TEMP" 209 "EFP_LIH" 210 "LOCAN_BOFF" 211 "CHG_LS_UP" 212 "CHG_LS_DOWN" 213 "QOIL_SENS" 214 "CHK_LS_DOWN_1" 215 "CHK_LS_DOWN_2" 216 "VLS_UP_MIN_COLD_1" 217 "VLS_UP_MIN_COLD_2" 218 "VLS_UP_MIN_1" 219 "VLS_UP_MIN_2" 220 "VLS_UP_MAX_1" 221 "VLS_UP_MAX_2" 222 "VLS_UP_OC_1" 223 "VLS_UP_OC_2" 224 "VLS_UP_PUC_1" 225 "VLS_UP_PUC_2" 226 "VLS_UP_STK_1" 227 "VLS_UP_STK_2" 228 "LAM_DLY_1" 229 "LAM_DLY_2" 230 "LS_UP_SWT_1" 231 "LS_UP_SWT_2" 232 "LS_UP_FRQ_1" 233 "LS_UP_FRQ_2" /end COMPU_VTAB
/begin COMPU_METHOD _CNV_A_R_LINEAR_____383_CM "" RAT_FUNC "%6.3" "°C" COEFFS 0 0.25 0. 0 0 1 /end COMPU_METHOD
/begin COMPU_METHOD _CNV_A_R_LINEAR_____384_CM "" RAT_FUNC "%6.3" "[-]" COEFFS 0 128.0000018750286 0. 0 0 1 /end COMPU_METHOD
/begin COMPU_METHOD _CNV_A_R_LINEAR_____385_CM "" RAT_FUNC "%6.3" "[-]" COEFFS 0 1.525855623540901e-005 0. 0 0 1 /end COMPU_METHOD
/begin COMPU_METHOD _CNV_A_R_LINEAR_____397_CM "" RAT_FUNC "%6.3" "s" COEFFS 0 100.0015259720442 0. 0 0 1 /end COMPU_METHOD
/begin COMPU_METHOD _CNV_A_R_LINEAR_____398_CM "" RAT_FUNC "%6.3" "s" COEFFS 0 100.0015267408663 -1.000015267408663 0 0 1 /end COMPU_METHOD
/begin COMPU_METHOD _CNV_A_R_LINEAR_____399_CM "" RAT_FUNC "%6.3" "%" COEFFS 0 655.36 32768. 0 0 1 /end COMPU_METHOD
/begin COMPU_METHOD _CNV_S_3_RANGE_C_CO_400_CM "" TAB_VERB "%6.3" "[-]" COMPU_TAB_REF _CNV_S_3_RANGE_C_CO_400 /end COMPU_METHOD
/begin COMPU_VTAB _CNV_S_3_RANGE_C_CO_400 "" TAB_VERB 3 0 "NO_SAV_DIAG" 1 "SAV_DIAG_Bank_1" 2 "SAV_DIAG_Bank_2" /end COMPU_VTAB
/begin COMPU_METHOD _CNV_A_R_LINEAR_____402_CM "" RAT_FUNC "%6.3" "0.1s" COEFFS 0 10. 0. 0 0 1 /end COMPU_METHOD
/begin COMPU_METHOD _CNV_A_R_LINEAR_____411_CM "" RAT_FUNC "%6.3" "-" COEFFS 0 2. 0. 0 0 1 /end COMPU_METHOD
/begin COMPU_METHOD _CNV_A_R_LINEAR_____435_CM "" RAT_FUNC "%6.3" "°CRK" COEFFS 0 2.666666666666667 960. 0 0 1 /end COMPU_METHOD
/begin RECORD_LAYOUT _REC_VAL_20_u1 FNC_VALUES 1 UBYTE COLUMN_DIR DIRECT /end RECORD_LAYOUT
/begin RECORD_LAYOUT _REC_AXS_20_u1 NO_AXIS_PTS_X 1 UBYTE AXIS_PTS_X 2 UBYTE INDEX_INCR DIRECT /end RECORD_LAYOUT
/begin RECORD_LAYOUT _REC_CUR_20_u1_u1 FNC_VALUES 1 UBYTE COLUMN_DIR DIRECT /end RECORD_LAYOUT
/begin RECORD_LAYOUT _REC_MAP_20_u2_u2_u1 FNC_VALUES 1 UWORD COLUMN_DIR DIRECT /end RECORD_LAYOUT
/begin RECORD_LAYOUT _REC_AXS_20_u2 NO_AXIS_PTS_X 1 UWORD AXIS_PTS_X 2 UWORD INDEX_INCR DIRECT /end RECORD_LAYOUT
/begin RECORD_LAYOUT _REC_CUR_20_u2_u2 FNC_VALUES 1 UWORD COLUMN_DIR DIRECT /end RECORD_LAYOUT
/begin RECORD_LAYOUT _REC_VAL_20_u2 FNC_VALUES 1 UWORD COLUMN_DIR DIRECT /end RECORD_LAYOUT
/begin RECORD_LAYOUT _REC_CUR_20_u2_u1 FNC_VALUES 1 UWORD COLUMN_DIR DIRECT /end RECORD_LAYOUT
/begin RECORD_LAYOUT _REC_MAP_20_u1_u1_u2 FNC_VALUES 1 UBYTE COLUMN_DIR DIRECT /end RECORD_LAYOUT
/begin RECORD_LAYOUT _REC_CUR_20_u1_u2 FNC_VALUES 1 UBYTE COLUMN_DIR DIRECT /end RECORD_LAYOUT
/begin RECORD_LAYOUT _REC_MAP_20_u2_u1_u2 FNC_VALUES 1 UWORD COLUMN_DIR DIRECT /end RECORD_LAYOUT
/begin RECORD_LAYOUT _REC_VAL_20_s2 FNC_VALUES 1 SWORD COLUMN_DIR DIRECT /end RECORD_LAYOUT
/begin FUNCTION INJ_Lambda_Adaptation "_Lambda Adaptation"
 /begin DEF_CHARACTERISTIC C_MFF_AD_COR_CRLC C_MFF_AD_COR_CRLC_IS C_LAM_AD_SUM_P_IS C_LAM_AD_SUM_P IP_MFF_AD_ADD_FAC IP_MFF_AD_FAC_FAC C_N_MFF_AD_ADD_MAX C_N_MFF_AD_FAC_MIN C_MAF_MFF_AD_ADD_MAX IP_MAF_MFF_AD_MAX IP_MAF_MFF_AD_MIN C_MFF_AD_FAC_MIN C_MFF_AD_FAC_MAX C_MFF_AD_ADD_MIN C_MFF_AD_ADD_MAX ID_T_MFF_AD_ADD C_MAF_MFF_AD_FAC_MIN LC_MFF_AD_FAC LC_MFF_AD_ADD ID_T_MFF_AD_FAC C_T_MFF_AD_MIN_MAX IP_MFF_AD_FAC IP_MFF_AD_ADD /end DEF_CHARACTERISTIC
 /begin OUT_MEASUREMENT T_MFF_AD_MIN LV_MFF_AD_END LV_MFF_AD_ENA_FIRST LV_LAMB_AD_AFS_REQ LV_MFF_AD_CDN LV_LAM_ADJ_AD_1 LV_LAM_AD_STOP_1 LV_MFF_AD_FAC_LIM_1 LV_MFF_AD_ADD_LIM_1 MFF_AD_ADD_MMV_REL_1 MFF_AD_ADD_MMV_REL_QUO_1 MFF_AD_FAC_MMV_REL_1 MFF_AD_ADD_MMV_1 MFF_AD_FAC_MMV_1 LAM_ADJ_AD_1 MFF_AD_ADD_MMV_DELTA_1 MFF_AD_ADD_MMV_DELTA_H_RES_1 MFF_AD_FAC_MMV_DELTA_1 MFF_SAE_AD_MMV_REL_1 LAM_AD_SUM_P_1 STATE_MFF_AD_1 T_MFF_AD_FAC_1 T_MFF_AD_ADD_1 LV_LAM_ADJ_AD_2 LV_LAM_AD_STOP_2 LV_MFF_AD_FAC_LIM_2 LV_MFF_AD_ADD_LIM_2 MFF_AD_ADD_MMV_REL_2 MFF_AD_ADD_MMV_REL_QUO_2 MFF_AD_FAC_MMV_REL_2 MFF_AD_ADD_MMV_2 MFF_AD_FAC_MMV_2 LAM_ADJ_AD_2 MFF_AD_ADD_MMV_DELTA_2 MFF_AD_ADD_MMV_DELTA_H_RES_2 MFF_AD_FAC_MMV_DELTA_2 MFF_SAE_AD_MMV_REL_2 LAM_AD_SUM_P_2 STATE_MFF_AD_2 T_MFF_AD_FAC_2 T_MFF_AD_ADD_2 /end OUT_MEASUREMENT
/end FUNCTION
/begin FUNCTION INJ_Injection_Phase_for_Stratifi "_Injection Phase for Stratified Mode" /begin DEF_CHARACTERISTIC IP_EOI_DIF_S C_EOI_S_AS C_EOI_S_MAN LC_EOI_S_MAN_ACT /end DEF_CHARACTERISTIC
 /begin OUT_MEASUREMENT EOI_S_0 EOI_S_1 EOI_S_2 EOI_S_3 EOI_S_4 EOI_S_5 EOI_S_CLC_0 EOI_S_CLC_1 EOI_S_CLC_2 EOI_S_CLC_3 EOI_S_CLC_4 EOI_S_CLC_5 EOI_DIF_S /end OUT_MEASUREMENT
/end FUNCTION
/begin FUNCTION INJ_Restart_function "_Restart function" /begin OUT_MEASUREMENT TI_ST_REST /end OUT_MEASUREMENT /end FUNCTION
/begin FUNCTION INJ_MFF_Split_Up_for_DUI_at_Stra "_MFF Split Up for DUI at Stratified Mode" /end FUNCTION
/begin FUNCTION INJ_Application_incidences_for_i "_Application incidences for injection mode management"
 /begin DEF_CHARACTERISTIC C_TCO_DUI_MIN_ST C_TCO_DUI_MAX_ST C_TQI_DUI_THD C_CYC_CAST_DUI_THD /end DEF_CHARACTERISTIC
 /begin OUT_MEASUREMENT LV_DUI_INJ_REQ LV_CH_S_REQ LV_T_TQI_SWI_SUPP /end OUT_MEASUREMENT
/end FUNCTION
/begin FUNCTION INJ_Upstream_oxygen_sensor_opera "_Upstream oxygen sensor operative readiness detection"
 /begin DEF_CHARACTERISTIC C_TEMP_MIN_LS_UP C_R_MIN_LS_READY C_VLS_AFL_MAX_DIAG C_VLS_AFR_MIN_DIAG ID_T_DLY_LS_READY /end DEF_CHARACTERISTIC
 /begin OUT_MEASUREMENT LV_DLY_LS_READY LV_T_MIN_LS /end OUT_MEASUREMENT
/end FUNCTION
/begin FUNCTION INJ_Downstream_oxygen_sensor_ope "_Downstream oxygen sensor operative readiness detection" /begin DEF_CHARACTERISTIC C_TEMP_CAT_DOWN_LS_READY /end DEF_CHARACTERISTIC /begin OUT_MEASUREMENT LV_DOWN_LS_1 LV_DOWN_LS_2 /end OUT_MEASUREMENT /end FUNCTION
/begin FUNCTION INJ_Application_incidence_exhaus "_Application incidence exhaust gas temperature model"
 /begin OUT_MEASUREMENT LAMB_SP_TEG_1 EFF_IGA_AV_TEG_1 NR_CYL_SCC_TEG_1 LAMB_SP_TEG_2 EFF_IGA_AV_TEG_2 NR_CYL_SCC_TEG_2 TEMP_CAT MAF_TEG MAF_INT_TEG_ST MAF_KGH_TEG N_TEG TEG_DYN TEG_CAT_UP_MDL_1 TEG_CAT_UP_MDL_2 TEG_CAT_DOWN_MDL_2 TEG_CAT_DOWN_MDL_1 /end OUT_MEASUREMENT
/end FUNCTION
/begin FUNCTION INJ_Lambda_Setpoint_for_Single_C "_Lambda Setpoint for Single Cylinder Fuel Shut Off" /begin DEF_CHARACTERISTIC IP_LAMB_SCC /end DEF_CHARACTERISTIC /begin OUT_MEASUREMENT LAMB_SCC_1 LAMB_SCC_2 /end OUT_MEASUREMENT /end FUNCTION
/begin FUNCTION ISC_Idle_Speed_Control_Adaptatio "ISC"
 /begin SUB_FUNCTION ISC_Idle_speed_control ISC_Idle_speed_Adaptation ISC_Idle_speed_torque_reserve ISC_Application_Incidence_for_Id ISC_Adaptation_Condition ISC__Adaptation_Algorithm ISC_Torque_Reserve_for_canister_ /end SUB_FUNCTION
/end FUNCTION
/begin FUNCTION ISC_Idle_speed_control "_Idle speed control"
 /begin DEF_CHARACTERISTIC C_T_RAMP_LIM_I_DT_IS C_T_RAMP_LIM_I_IS C_T_RAMP_LIM_P_D_DT_IS C_T_RAMP_LIM_P_D_IS C_TQ_BOL_I_DT_IS C_TQ_BOL_I_IS C_TQ_PAS_I_ACC_IS C_TQ_PAS_I_IS C_TQ_TOL_I_DT_IS C_TQ_TOL_I_IS IP_TQ_I_DT_IS IP_FAC_N_GRD_IS LC_TQ_DIF_I_INH_AS LC_TQ_DIF_P_D_INH_AS LC_N_GRD_FIL_P_D_INH_AS LC_N_GRD_FIL_I_INH_AS C_CRLC_N_GRD ID_FAC_P_D_DT_IS IP_FAC_P_D_FAST_TCO_IS IP_FAC_P_D_SLOW_TCO_IS IP_P_D_DT_IS IP_P_D_IS IP_TQ_I_IS LC_TQ_P_D_SLOW_INH_AS LC_ISC_INH LC_TQ_ADD_I_INH_AS /end DEF_CHARACTERISTIC
 /begin OUT_MEASUREMENT TQ_DIF_P_D_SLOW_IS TQ_DIF_P_D_IS TQ_DIF_P_D_FAST_IS TQ_DIF_I_IS TQ_ADD_I_IS FAC_N_GRD_IS N_GRD_FIL_IS N_GRD_P_D_IS N_GRD_I_IS LV_TQ_P_D_ACT LV_PAS_RAMP_ACT_P_D_IS LV_PAS_RAMP_ACT_I_IS TQ_DIF_P_D_DT_IS_1 TQ_ADD_P_D_RAMP TQ_ADD_I_RAMP STATE_P_D_ISC STATE_I_ISC LV_REQ_ISC /end OUT_MEASUREMENT
/end FUNCTION
/begin FUNCTION ISC_Idle_speed_Adaptation "_Idle speed Adaptation"
 /begin DEF_CHARACTERISTIC C_FAC_TQ_IS_AD_CONV_MAX C_FAC_TQ_IS_AD_CONV_MIN C_TQ_IS_AD_ACC_MIN C_TQ_IS_AD_MAX C_TQ_IS_AD_MIN C_FAC_TQ_IS_AD_ACC C_FAC_TQ_IS_AD_CONV C_FAC_TQ_IS_AD_ACC_CONV C_TQ_IS_AD_ACC_MAX C_TQ_IS_AD_ACC_CONV_MAX C_TQ_IS_AD_ACC_CONV_MIN C_FAC_TQ_IS_AD C_CRLC_TQ_DIF_IS_AD_ACC C_FAC_TQ_IS_AD_CONV_CAN C_TQ_IS_AD_CONV_CAN_MIN C_TQ_IS_AD_CONV_CAN_MAX C_N_DELTA C_TCO_AD_MIN_IS C_TCO_AD_MAX_IS C_DLY_IS_AD /end DEF_CHARACTERISTIC
/end FUNCTION
/begin FUNCTION ISC_Idle_speed_torque_reserve "_Idle speed torque reserve"
 /begin DEF_CHARACTERISTIC IP_T_N_DIF_OFS_PRED__N IP_TQ_ADD_IS_BOL__N_DIF_PRED C_TQ_ADD_IS_BOL_CRLC C_TQ_DIF_ADD_IS_TOL /end DEF_CHARACTERISTIC
 /begin OUT_MEASUREMENT N_DIF_OFS_PRED T_N_DIF_OFS_PRED N_DIF_PRED TQ_ADD_IS_BOL TQ_DIF_ADD_IS_TOL /end OUT_MEASUREMENT
/end FUNCTION
/begin FUNCTION ISC_Application_Incidence_for_Id "_Application Incidence for Idle Speed Control"
 /begin DEF_CHARACTERISTIC LC_ISC_ACT_CDN_SWI LC_ISC_ACT_AST_CDN_SWI C_N_DIF_ISC_ACT_AST C_CRLC_N_GRD_FIL_ISC_ACT_AST C_T_DLY_ISC_ACT_PU /end DEF_CHARACTERISTIC
 /begin OUT_MEASUREMENT STATE_REQ_ISC LV_NEG_N_GRD_FIL_MEM N_GRD_FIL_ISC_ACT_AST LV_IS_AD_INH_OBD LV_IS_AD_INH /end OUT_MEASUREMENT
/end FUNCTION
/begin FUNCTION ISC_Adaptation_Condition "_Adaptation Condition" /begin OUT_MEASUREMENT LV_IS_AD_CND LV_TCO_AD_CND_IS LV_DLY_AD_IS /end OUT_MEASUREMENT /end FUNCTION
/begin FUNCTION ISC__Adaptation_Algorithm "_ Adaptation Algorithm"
 /begin OUT_MEASUREMENT FAC_TQ_IS_AD_CONV TQ_DIF_IS_AD_ACC_1 TQ_DIF_IS_AD_ACC_CONV TQ_DIF_IS_AD TQ_DIF_IS_AD_INTER TQ_DIF_IS_AD_ACC_1_INTER TQ_DIF_IS_AD_ACC_CONV_INTER TQ_DIF_IS_AD_ACC TQ_DIF_IS_AD_CONV TQ_DIF_IS_AD_CONV_INTER /end OUT_MEASUREMENT
/end FUNCTION
/begin FUNCTION ISC_Torque_Reserve_for_canister_ "_Torque Reserve for canister purge at idle" /begin DEF_CHARACTERISTIC IP_TQ_ADD_CP C_CRLC_TQ_ADD_CP LC_TQ_ADD_CP_INH /end DEF_CHARACTERISTIC /begin OUT_MEASUREMENT TQ_ADD_CP /end OUT_MEASUREMENT /end FUNCTION
/begin FUNCTION OBD_OBD_II_Function "OBD"
 /begin SUB_FUNCTION OBD_Oxygen_downstream_sensor_act OBD_Dynamic_Error_management OBD_Misfire_detection OBD_Rough_road_detection OBD_History_memory OBD_Fuel_system_diagnosis OBD_Similar_conditions OBD_Lamp_management OBD_Activation_conditions_for_ca OBD_Cat_Efficiency_Diagnosis__OS OBD_Limited_dynamic_for_catalyst OBD_Oxygen_Sensor_diagnosis_with OBD_Diagnosis_of_monitor_sensors OBD_SA_system_monitoring_through OBD_Readiness_code OBD_Upstream_oxygen_sensor_heate OBD_Application_incidences_Secon OBD_Tank_leakage_diagnosis_based OBD_Cycle_manager OBD_Environmental_Data OBD_Diagnostic_Trouble_Code OBD_Failure_class OBD_Application_incidences_for_f OBD_Application_incidence_cataly OBD_Downstream_oxygen_sensor_hea OBD_SA_system_diagnosis_through_ OBD_Application_incidences_for_S OBD_Functional_Check_CPS OBD_Load_Throttle_position_ratio OBD_Application_incidences_Load_ OBD_Application_incidence_Oxygen OBD_Oxygen_Sensor_Interchanged_S OBD_OBD_II_diagnosis_of_the_lamb OBD_Application_incidences_of_Dy OBD_Application_incidence_enviro OBD_Application_incidences_of_th /end SUB_FUNCTION
/end FUNCTION
/begin FUNCTION OBD_Oxygen_downstream_sensor_act "_Oxygen downstream sensor active plausibility check"
 /begin DEF_CHARACTERISTIC C_VLS_DOWN_THD_AFL_DIAG C_VLS_DOWN_THD_AFR_DIAG C_MAF_INT_PUC_VLS_DOWN C_MAF_INT_VLS_DOWN C_MAF_INT_AFR_MAX_DIAG C_MAF_INT_AFL_MAX_DIAG C_T_DLY_LS_DIAG_MIN C_TCO_VLS_DOWN_DIAG_MIN C_T_AST_VLS_DOWN_DIAG C_LAMB_SP_LS_ACT_AFR C_LAMB_SP_LS_ACT_AFL /end DEF_CHARACTERISTIC
 /begin OUT_MEASUREMENT LV_REQ_LAMB_SP_LS_ACT_TEST_1 LV_VLS_DOWN_AFL_1 LV_VLS_DOWN_AFR_1 LV_END_CYC_CHK_LS_DOWN_1 LV_CDN_CYC_CHK_LS_DOWN_1 LAMB_SP_LS_ACT_TEST_1 LV_REQ_LAMB_SP_LS_ACT_TEST_2 LV_VLS_DOWN_AFL_2 LV_VLS_DOWN_AFR_2 LV_END_CYC_CHK_LS_DOWN_2 LV_CDN_CYC_CHK_LS_DOWN_2 LAMB_SP_LS_ACT_TEST_2 LV_VLS_DOWN_MAF_INT_PUC LV_VLS_DOWN_MAF_INT LV_ERR_CHK_LS_DOWN_1 LV_ERR_CHK_LS_DOWN_2 MAF_INT_PUC_VLS_DOWN MAF_INT_VLS_DOWN MAF_INT_DIAG_AFL MAF_INT_DIAG_AFR /end OUT_MEASUREMENT
/end FUNCTION
/begin FUNCTION OBD_Dynamic_Error_management "_Dynamic Error management" /begin DEF_CHARACTERISTIC LC_CLR_FMY C_MAF_MAX C_CTR_MAX_WUP_CYC LC_ENA_SCDN /end DEF_CHARACTERISTIC
 /begin OUT_MEASUREMENT CTR_ERR_DYN_NR CTR_FRC_0 CTR_WUP_CYC_0 CTR_DC_0 ERR_INFO_DYN LV_ERR_DC_0 LV_ERR_TMP_0 LV_ERR_DISA_0 LV_DC_MAX_0 LV_ERR_CFM_0 LV_ERR_MKD_0 DIAG_INST_0 CTR_FRC_1 CTR_WUP_CYC_1 CTR_DC_1 ERR_INFO_DYN LV_ERR_DC_1 LV_ERR_TMP_1 LV_ERR_DISA_1 LV_DC_MAX_1 LV_ERR_CFM_1 LV_ERR_MKD_1 DIAG_INST_1 CTR_FRC_2 CTR_WUP_CYC_2 CTR_DC_2 ERR_INFO_DYN LV_ERR_DC_2 LV_ERR_TMP_2 LV_ERR_DISA_2 LV_DC_MAX_2 LV_ERR_CFM_2 LV_ERR_MKD_2 DIAG_INST_2 CTR_FRC_3 CTR_WUP_CYC_3 CTR_DC_3 ERR_INFO_DYN LV_ERR_DC_3 LV_ERR_TMP_3 LV_ERR_DISA_3 LV_DC_MAX_3 LV_ERR_CFM_3 LV_ERR_MKD_3 DIAG_INST_3 CTR_FRC_4 CTR_WUP_CYC_4 CTR_DC_4 ERR_INFO_DYN LV_ERR_DC_4 LV_ERR_TMP_4 LV_ERR_DISA_4 LV_DC_MAX_4 LV_ERR_CFM_4 LV_ERR_MKD_4 DIAG_INST_4 CTR_FRC_5 CTR_WUP_CYC_5 CTR_DC_5 ERR_INFO_DYN LV_ERR_DC_5 LV_ERR_TMP_5 LV_ERR_DISA_5 LV_DC_MAX_5 LV_ERR_CFM_5 LV_ERR_MKD_5 DIAG_INST_5 CTR_FRC_6 CTR_WUP_CYC_6 CTR_DC_6 ERR_INFO_DYN LV_ERR_DC_6 LV_ERR_TMP_6 LV_ERR_DISA_6 LV_DC_MAX_6 LV_ERR_CFM_6 LV_ERR_MKD_6 DIAG_INST_6 CTR_FRC_7 CTR_WUP_CYC_7 CTR_DC_7 ERR_INFO_DYN LV_ERR_DC_7 LV_ERR_TMP_7 LV_ERR_DISA_7 LV_DC_MAX_7 LV_ERR_CFM_7 LV_ERR_MKD_7 DIAG_INST_7 CTR_FRC_8 CTR_WUP_CYC_8 CTR_DC_8 ERR_INFO_DYN LV_ERR_DC_8 LV_ERR_TMP_8 LV_ERR_DISA_8 LV_DC_MAX_8 LV_ERR_CFM_8 LV_ERR_MKD_8 DIAG_INST_8 CTR_FRC_9 CTR_WUP_CYC_9 CTR_DC_9 ERR_INFO_DYN LV_ERR_DC_9 LV_ERR_TMP_9 LV_ERR_DISA_9 LV_DC_MAX_9 LV_ERR_CFM_9 LV_ERR_MKD_9 DIAG_INST_9 /end OUT_MEASUREMENT
/end FUNCTION
/begin FUNCTION OBD_Misfire_detection "_Misfire detection" /end FUNCTION
/begin FUNCTION OBD_Rough_road_detection "_Rough road detection"
 /begin DEF_CHARACTERISTIC C_VS_MIN_RR C_VS_MAX_RR C_WHEEL_GRD_CRLC_RR C_DLY_ER_RR IP_WHEEL_GRD_MMV_THD_AT__VS IP_WHEEL_GRD_MMV_THD_MT__VS /end DEF_CHARACTERISTIC
 /begin OUT_MEASUREMENT LV_STATE_RR SEG_T_MES_0_RR SEG_T_MES_1_RR WHEEL_GRD_MMV WHEEL_GRD_MMV_THD SUM_RR /end OUT_MEASUREMENT
/end FUNCTION
/begin FUNCTION OBD_History_memory "_History memory" /begin DEF_CHARACTERISTIC LC_CLR_HIS_FMY /end DEF_CHARACTERISTIC
 /begin OUT_MEASUREMENT CTR_ERR_HIS_NR HIS_COD_1 HIS_COD_2 HIS_COD_3 HIS_COD_4 HIS_COD_5 HIS_COD_6 HIS_COD_7 HIS_COD_8 HIS_COD_9 HIS_COD_10 /end OUT_MEASUREMENT
/end FUNCTION
/begin FUNCTION OBD_Fuel_system_diagnosis "_Fuel system diagnosis"
 /begin DEF_CHARACTERISTIC C_LAM_MIN_FSD C_LAM_MAX_FSD C_T_SUM_MAX_MAX_FSD C_T_SUM_MIN_MAX_FSD C_T_SUM_RST_MAX_FSD C_N_MIN_FSD C_MAF_MIN_FSD C_TCO_MIN_FSD ID_STOP_INC_FSD__TCO_ST ID_STOP_DEC_FSD__TOIL_MAX C_STOP_MAX_FSD C_TIA_MIN_FSD C_AMP_MIN_FSD /end DEF_CHARACTERISTIC
 /begin OUT_MEASUREMENT T_SUM_MAX_FSD_1 T_SUM_MIN_FSD_1 T_SUM_END_DIAG_WIN_FSD_1 T_SUM_RST_FSD_1 T_SUM_MAX_FSD_2 T_SUM_MIN_FSD_2 T_SUM_END_DIAG_WIN_FSD_2 T_SUM_RST_FSD_2 TOIL_MAX CTR_STOP_FSD LV_ERR_FSD_1 LV_ERR_FSD_2 /end OUT_MEASUREMENT
/end FUNCTION
/begin FUNCTION OBD_Similar_conditions "_Similar conditions" /begin DEF_CHARACTERISTIC C_MAF_SCDN_EQU C_CTR_SCDN_EQU_DC_MAX C_N_SCDN_EQU /end DEF_CHARACTERISTIC
 /begin OUT_MEASUREMENT MAF_MIN_SCDN_EQU_MIS_B1 MAF_MAX_SCDN_EQU_MIS_B1 N_MIN_SCDN_EQU_MIS_B1 N_MAX_SCDN_EQU_MIS_B1 CTR_SCDN_EQU_DC_MIS_B1 X_STATE LV_SCDN_EQU_MIS_B1 LV_SCDN_EQU_DC_MIS_B1 LV_SCDN_EQU_NOT_ERR_MIS_B1 LV_WUP_SCDN_EQU_MIS_B1 MAF_MIN_SCDN_EQU_MIS_B4 MAF_MAX_SCDN_EQU_MIS_B4 N_MIN_SCDN_EQU_MIS_B4 N_MAX_SCDN_EQU_MIS_B4 CTR_SCDN_EQU_DC_MIS_B4 X_STATE LV_SCDN_EQU_MIS_B4 LV_SCDN_EQU_DC_MIS_B4 LV_SCDN_EQU_NOT_ERR_MIS_B4 LV_WUP_SCDN_EQU_MIS_B4 MAF_MIN_SCDN_EQU_MIS_A MAF_MAX_SCDN_EQU_MIS_A N_MIN_SCDN_EQU_MIS_A N_MAX_SCDN_EQU_MIS_A CTR_SCDN_EQU_DC_MIS_A X_STATE LV_SCDN_EQU_MIS_A LV_SCDN_EQU_DC_MIS_A LV_SCDN_EQU_NOT_ERR_MIS_A LV_WUP_SCDN_EQU_MIS_A MAF_MIN_SCDN_EQU_FSD_1 MAF_MAX_SCDN_EQU_FSD_1 N_MIN_SCDN_EQU_FSD_1 N_MAX_SCDN_EQU_FSD_1 CTR_SCDN_EQU_DC_FSD_1 X_STATE LV_SCDN_EQU_FSD_1 LV_SCDN_EQU_DC_FSD_1 LV_SCDN_EQU_NOT_ERR_FSD_1 LV_WUP_SCDN_EQU_FSD_1 MAF_MIN_SCDN_EQU_FSD_2 MAF_MAX_SCDN_EQU_FSD_2 N_MIN_SCDN_EQU_FSD_2 N_MAX_SCDN_EQU_FSD_2 CTR_SCDN_EQU_DC_FSD_2 X_STATE LV_SCDN_EQU_FSD_2 LV_SCDN_EQU_DC_FSD_2 LV_SCDN_EQU_NOT_ERR_FSD_ LV_WUP_SCDN_EQU_FSD_2 /end OUT_MEASUREMENT
/end FUNCTION
/begin FUNCTION OBD_Lamp_management "_Lamp management"
 /begin DEF_CHARACTERISTIC C_CONF_MIL C_CONF_WAL_1 C_CONF_WAL_2 LC_INH_WAL_ST C_DLY_WAL_ST C_DLY_INH_IV_MIS /end DEF_CHARACTERISTIC
 /begin OUT_MEASUREMENT REL_DIST_ACT_MIL STATE_MIL REL_DIST_ACT_WAL_1 REL_DIST_ACT_WAL_2 LV_WAL_2 STATE_WAL_1 STATE_WAL_2 DIST_ACT_WAL_2 DIST_ACT_WAL_1 DIST_ACT_MIL LV_MIL LV_WAL_1 LV_WAL_ST /end OUT_MEASUREMENT
/end FUNCTION
/begin FUNCTION OBD_Activation_conditions_for_ca "_Activation conditions for cat eff and O2 sensor diag"
 /begin DEF_CHARACTERISTIC C_CL_MAX_CAT_LS_DIAG LC_LS_CAT_DIAG_CDN_MAN_ACT IP_MAF_LAM_CAT_MIN__N_32 IP_MAF_LAM_CAT_MAX__N_32 C_TCO_MIN_CAT C_TEMP_MIN_CAT C_TEMP_MAX_CAT C_TEMP_HYS_CAT C_VS_MIN_CAT C_VS_MAX_CAT C_AMP_MIN_CAT_LS_DIAG C_MAF_INT_CAT_DIAG_DLY /end DEF_CHARACTERISTIC
 /begin OUT_MEASUREMENT LV_LS_CAT_DIAG_CDN_1 MAF_INT_CAT_DIAG_DLY_1 LV_LS_CAT_DIAG_CDN_2 MAF_INT_CAT_DIAG_DLY_2 /end OUT_MEASUREMENT
/end FUNCTION
/begin FUNCTION OBD_Cat_Efficiency_Diagnosis__OS "_Cat Efficiency Diagnosis (OSC Method)"
 /begin DEF_CHARACTERISTIC C_O2_CAT_MV_MIN C_O2_CAT_MV_MAX C_O2_CAT_MV_DELTA_MAX C_O2_CAT_MV_DIF_MAX C_SUM_MIN_CAT_DIAG C_CAT_MAX_DIAG ID_O2_INT_MAX_AT__N_32__MAF ID_O2_INT_MAX_MT__N_32__MAF IP_O2_CAT_1__VLS_DOWN_1 IP_O2_CAT_2__VLS_DOWN_2 IP_O2_CAT_MAX__SUM_VLS_CAT_O2 /end DEF_CHARACTERISTIC
 /begin OUT_MEASUREMENT LV_ERR_CAT_DIAG_1 LV_ERR_CAT_DIAG_2 LV_CAT_DIAG_CYC_VLD_1 SUM_CAT_DIAG_1 CAT_DIAG_CLC_1 CAT_DIAG_CUS_1 VLS_CYC_STEP_1 SUM_O2_CAT_DIF_1 SUM_O2_CAT_1 O2_CAT_INT_1 O2_CAT_MV_1 O2_CAT_RATIO_1 SUM_O2_CAT_RATIO_1 SUM_VLS_CAT_O2_1 O2_CAT_1 CAT_DIAG_1 LV_INH_DIAG_CAT_DIAG_1 T_VLS_CYC_EFC_1 LV_AUTH_CAT_DIAG_1 LV_CAT_DIAG_CYC_VLD_2 SUM_CAT_DIAG_2 CAT_DIAG_CLC_2 CAT_DIAG_CUS_2 VLS_CYC_STEP_2 SUM_O2_CAT_DIF_2 SUM_O2_CAT_2 O2_CAT_INT_2 O2_CAT_MV_2 O2_CAT_RATIO_2 SUM_O2_CAT_RATIO_2 SUM_VLS_CAT_O2_2 O2_CAT_2 CAT_DIAG_2 LV_INH_DIAG_CAT_DIAG_2 T_VLS_CYC_EFC_2 LV_AUTH_CAT_DIAG_2 /end OUT_MEASUREMENT
/end FUNCTION
/begin FUNCTION OBD_Limited_dynamic_for_catalyst "_Limited dynamic for catalyst effiency and oxygen sensor diagnosis"
 /begin DEF_CHARACTERISTIC C_N_CRLC_CAT C_MAF_CRLC_CAT C_LAM_MV_CRLC_CAT C_N_DYW_CAT C_MAF_DYW_CAT C_LAM_MV_DYW_CAT C_MAF_INT_MIN_CAT C_PV_AV_GRD_DEC C_PV_AV_GRD_SUM_MAX C_PV_AV_GRD_SUM_MIN C_T_PV_AV_GRD_DEC_SUM /end DEF_CHARACTERISTIC
 /begin OUT_MEASUREMENT LV_LDC_CAT_1 MAF_INT_LDC_CAT_1 PV_AV_GRD_SUM LAM_MV_MMV_CAT_1 LV_LDC_CAT_2 MAF_INT_LDC_CAT_2 PV_AV_GRD_SUM LAM_MV_MMV_CAT_2 N_MMV_CAT MAF_MMV_CAT LV_N_LDC LV_MAF_LDC /end OUT_MEASUREMENT
/end FUNCTION
/begin FUNCTION OBD_Oxygen_Sensor_diagnosis_with "_Oxygen Sensor diagnosis with multiple check"
 /begin DEF_CHARACTERISTIC LC_INH_LS_UP_MAN_DEAC IP_T_VLS_CYC_AFL_MAX__N_32__MAF C_SUM_CYC_MIN_DIAG C_RATIO_VLS_CYC_AFL_MV_MAX C_RATIO_VLS_CYC_AFR_MV_MAX C_VLS_CYC_DIF_MAX C_VLS_CYC_DIF_MIN C_FAC_T_LAM_DLY_LS_FRQ_DIAG IP_T_VLS_CYC_AFR_MAX__N_32__MAF C_VLS_HYS C_SUM_CYCNR_MIN_DIAG C_RATIO_VLS_CYCNR_AFL_MV_MAX C_RATIO_VLS_CYCNR_AFR_MV_MAX C_RATIO_VLS_CYCNR_DIF_MAX C_RATIO_VLS_CYCNR_DIF_MIN ID_T_VLS_CYCNR_AFR_MAX ID_T_VLS_CYCNR_AFL_MAX /end DEF_CHARACTERISTIC
 /begin OUT_MEASUREMENT LV_INH_DIAG_LS_UP_1 VLS_CYCNR_MAX_1 VLS_CYCNR_MIN_1 T_VLS_CYCNR_1 RATIO_VLS_CYCNR_AFL_MV_1 RATIO_VLS_CYCNR_AFR_MV_1 SUM_CYCNR_AFL_1 SUM_CYCNR_AFR_1 RATIO_VLS_CYCNR_AFL_1 RATIO_SAE_VLS_CYCNR_AFL_MV_1 RATIO_SAE_VLS_CYCNR_AFR_MV_1 RATIO_VLS_CYCNR_AFR_1 T_VLS_AFR_TO_AFL_SUM_1 T_VLS_AFR_TO_AFL_SUM_MAX_1 T_VLS_AFL_TO_AFR_SUM_1 T_VLS_AFL_TO_AFR_SUM_MAX_1 VLS_SAE_AFL_THD_1 VLS_SAE_AFR_THD_1 T_SAE_VLS_AFR_AFL_1 T_SAE_VLS_AFR_AFL_MAX_1 T_SAE_VLS_AFL_AFR_MAX_1 T_SAE_VLS_AFL_AFR_1 SUM_CYC_1 RATIO_VLS_CYC_AFL_1 RATIO_VLS_CYC_AFR_1 RATIO_VLS_CYC_AFL_SUM_1 RATIO_VLS_CYC_AFR_SUM_1 RATIO_VLS_CYC_AFL_MV_1 RATIO_VLS_CYC_AFR_MV_1 RATIO_SAE_VLS_CYC_AFL_MV_1 RATIO_SAE_VLS_CYC_AFR_MV_1 T_VLS_CYC_AFR_SUM_1 T_VLS_CYC_AFR_SUM_MAX_1 T_SAE_VLS_CYC_AFR_1 T_SAE_VLS_CYC_AFR_MAX_1 T_LAM_DLY_P_OLD_1 T_LAM_DLY_P_1 SUM_RATIO_VLS_CYCNR_AFL_1 SUM_RATIO_VLS_CYCNR_AFR_1 T_VLS_CYC_AFR_MV_MAX_1 T_VLS_CYC_AFL_MV_MAX_1 LV_INH_DIAG_LS_UP_2 VLS_CYCNR_MAX_2 VLS_CYCNR_MIN_2 T_VLS_CYCNR_2 RATIO_VLS_CYCNR_AFL_MV_2 RATIO_VLS_CYCNR_AFR_MV_2 SUM_CYCNR_AFL_2 SUM_CYCNR_AFR_2 RATIO_VLS_CYCNR_AFL_2 RATIO_SAE_VLS_CYCNR_AFL_MV_2 RATIO_SAE_VLS_CYCNR_AFR_MV_2 RATIO_VLS_CYCNR_AFR_2 T_VLS_AFR_TO_AFL_SUM_2 T_VLS_AFR_TO_AFL_SUM_MAX_2 T_VLS_AFL_TO_AFR_SUM_2 T_VLS_AFL_TO_AFR_SUM_MAX_2 VLS_SAE_AFL_THD_2 VLS_SAE_AFR_THD_2 T_SAE_VLS_AFR_AFL_2 T_SAE_VLS_AFR_AFL_MAX_2 T_SAE_VLS_AFL_AFR_MAX_2 T_SAE_VLS_AFL_AFR_2 SUM_CYC_2 RATIO_VLS_CYC_AFL_2 RATIO_VLS_CYC_AFR_2 RATIO_VLS_CYC_AFL_SUM_2 RATIO_VLS_CYC_AFR_SUM_2 RATIO_VLS_CYC_AFL_MV_2 RATIO_VLS_CYC_AFR_MV_2 RATIO_SAE_VLS_CYC_AFL_MV_2 RATIO_SAE_VLS_CYC_AFR_MV_2 T_VLS_CYC_AFR_SUM_2 T_VLS_CYC_AFR_SUM_MAX_2 T_SAE_VLS_CYC_AFR_2 T_SAE_VLS_CYC_AFR_MAX_2 T_LAM_DLY_P_OLD_2 T_LAM_DLY_P_2 SUM_RATIO_VLS_CYCNR_AFL_2 SUM_RATIO_VLS_CYCNR_AFR_2 T_VLS_CYC_AFR_MV_MAX_2 T_VLS_CYC_AFL_MV_MAX_2 LV_ERR_LS_UP_SWT_1 LV_ERR_LS_UP_SWT_2 LV_ERR_LS_UP_FRQ_1 LV_ERR_LS_UP_FRQ_2 /end OUT_MEASUREMENT
/end FUNCTION
/begin FUNCTION OBD_Diagnosis_of_monitor_sensors "_Diagnosis of monitor sensors"
 /begin DEF_CHARACTERISTIC LC_INH_LS_DOWN_MAN_DEAC C_TCO_MIN_DOWN C_TEMP_CAT_MIN_LS_DOWN_DIAG C_MAF_KGH_MIN_PUC_DOWN_DIAG C_MAF_KGH_MAX_PUC_DOWN_DIAG C_VLS_DOWN_DIAG_MIN C_FAC_VLS_DOWN_DIAG_MIN C_FAC_VLS_DOWN_DIAG_MAX C_VLS_DOWN_HYS C_SUM_VLS_DOWN_DIAG_MIN IP_VLS_DOWN_MAX_CYCNR C_CYCNR_VLS_DOWN_MAX C_MAF_INT_VLS_DOWN_PUE C_VLS_DOWN_DIF_DIAG_MIN C_VS_MAX_DOWN C_VS_MIN_DOWN C_CTR_END_DIAG_VLS_DOWN_PUE_MIN C_CTR_INC_VLS_DOWN_PUE C_CTR_MAX_VLS_DOWN_PUE /end DEF_CHARACTERISTIC
 /begin OUT_MEASUREMENT LV_ERR_LS_DOWN_SWT_1 LV_ERR_LS_DOWN_SWT_2 LV_LS_DOWN_SWT_VLD_1 LV_VLS_DOWN_PUE_VLD_1 LV_CDN_DIAG_LS_DOWN_1 LV_INH_DIAG_LS_DOWN_1 CYCNR_VLS_DOWN_ACT_1 CTR_VLS_DOWN_DIAG_1 VLS_DOWN_TRAN_PUC_1 CTR_CYCNR_QUO_VLS_DOWN_SUM_1 CYCNR_RATIO_VLS_DOWN_1 CYCNR_SAE_RATIO_VLS_DOWN_1 CYCNR_QUO_VLS_DOWN_1 VLS_DOWN_PUE_1 CTR_END_DIAG_VLS_DOWN_PUE_1 VLS_DOWN_DIF_DIAG_1 VLS_SAE_DOWN_DIF_DIAG_1 CTR_VLS_DOWN_PUE_1 LV_LS_DOWN_SWT_VLD_2 LV_VLS_DOWN_PUE_VLD_2 LV_CDN_DIAG_LS_DOWN_2 LV_INH_DIAG_LS_DOWN_2 CYCNR_VLS_DOWN_ACT_2 CTR_VLS_DOWN_DIAG_2 VLS_DOWN_TRAN_PUC_2 CTR_CYCNR_QUO_VLS_DOWN_SUM_2 CYCNR_RATIO_VLS_DOWN_2 CYCNR_SAE_RATIO_VLS_DOWN_2 CYCNR_QUO_VLS_DOWN_2 VLS_DOWN_PUE_2 CTR_END_DIAG_VLS_DOWN_PUE_2 VLS_DOWN_DIF_DIAG_2 VLS_SAE_DOWN_DIF_DIAG_2 CTR_VLS_DOWN_PUE_2 MAF_KGH_MIN_PUC MAF_INT_PUE LV_REQ_DIAG_LS_DOWN LV_END_DIAG_LS_DOWN LV_ERR_VLS_DOWN_PUE_1 LV_ERR_VLS_DOWN_PUE_2 /end OUT_MEASUREMENT
/end FUNCTION
/begin FUNCTION OBD_SA_system_monitoring_through "_SA system monitoring through binary lambda sensor (ZrO2)"
 /begin DEF_CHARACTERISTIC ID_T_DLY_DIAG_SA C_LAM_THD_DIAG_SAV C_SUM_AFL_VLS_MIN_DIAG_SA C_T_DIAG_SA C_CTR_P_DIAG_SA C_CONF_DIAG_SAV C_T_DLY_INTR_DIAG_SA /end DEF_CHARACTERISTIC
 /begin OUT_MEASUREMENT LV_ERR_SA_SAP LV_ERR_SA_SAV SUM_AFL_VLS_DIAG_SA_1 SUM_AFL_VLS_DIAG_SA_2 T_DLY_DIAG_SA T_DIAG_SA LAM_DIAG_SAV_MAX LAM_MV_DIAG_SAV T_DLY_INTR_DIAG_SA /end OUT_MEASUREMENT
/end FUNCTION
/begin FUNCTION OBD_Readiness_code "_Readiness code" /begin DEF_CHARACTERISTIC C_OBD_STATE_1 C_OBD_STATE_2 /end DEF_CHARACTERISTIC /end FUNCTION
/end MODULE
/end PROJECT
