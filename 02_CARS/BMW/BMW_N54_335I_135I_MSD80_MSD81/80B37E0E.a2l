ASAP2_VERSION 1 41
/begin PROJECT MSD70 "Spray Guided DI-System with Piezo Injectors for 6-Cylinder"
/begin HEADER "_default_HeaderComment" PROJECT_NO _0B /end HEADER
/begin MODULE _default_ModuleName "_default_ModuleLongIdentifier"
/begin MOD_COMMON "_default_ModCommonComment" DEPOSIT ABSOLUTE BYTE_ORDER MSB_LAST ALIGNMENT_BYTE 1 ALIGNMENT_WORD 2 ALIGNMENT_LONG 2 ALIGNMENT_FLOAT32_IEEE 2 ALIGNMENT_FLOAT64_IEEE 4 /end MOD_COMMON
/begin MEASUREMENT fmy_stat_bn_t_clk.err_info_stat.lv_ready "Readiness flag related to diagnosis XX" UWORD _CNV_S_2_RANGE__0___1_CM 1 100. 0. 1. DISPLAY_IDENTIFIER LV_READY_BN_T_CLK ECU_ADDRESS 0xd000420e BIT_MASK 0x10 /end MEASUREMENT
/begin MEASUREMENT fmy_stat_bn_t_clk.err_info_stat.lv_end_diag "End of diagnosis XX" UWORD _CNV_S_2_RANGE__0___1_CM 1 100. 0. 1. DISPLAY_IDENTIFIER LV_END_DIAG_BN_T_CLK ECU_ADDRESS 0xd000420e BIT_MASK 0x20 /end MEASUREMENT
/begin MEASUREMENT fmy_stat_bn_t_clk.err_info_stat.lv_cdn_diag "Diagnosis condition to start symptom detection (set to 1 when condition is fulfilled)" UWORD _CNV_S_2_RANGE__0___1_CM 1 100. 0. 1. DISPLAY_IDENTIFIER LV_CDN_DIAG_BN_T_CLK ECU_ADDRESS 0xd000420e BIT_MASK 0x40 /end MEASUREMENT
/begin MEASUREMENT fmy_stat_bn_t_clk.err_info_stat.err_sym "For each symptom: status of failure (set to 1 when failure symptom is detected)" UWORD _CNV_S_16_RANGE_ERR__485_CM 1 100. 0. 15. DISPLAY_IDENTIFIER ERR_SYM_BN_T_CLK ECU_ADDRESS 0xd000420e BIT_MASK 0x780 /end MEASUREMENT
/begin MEASUREMENT fmy_stat_bn_efp_crash.ctr_abc "anti-bounce counter for diagnosis XX" UBYTE _CNV_A_R_LINEAR_____0_CM 1 100. 0. 255. DISPLAY_IDENTIFIER CTR_ABC_BN_EFP_CRASH ECU_ADDRESS 0xd00041d8 FORMAT "%3.0" /end MEASUREMENT
/begin MEASUREMENT fmy_stat_bn_efp_crash.ctr_end_diag "Counter for the end of diagnosis XX generation" UBYTE _CNV_A_R_LINEAR_____0_CM 1 100. 0. 255. DISPLAY_IDENTIFIER CTR_ABC_END_DIAG_BN_EFP_CRASH ECU_ADDRESS 0xd00041d9 FORMAT "%3.0" /end MEASUREMENT
/begin MEASUREMENT fmy_stat_bn_efp_crash.err_info_stat.lv_err_mem "Failure is stored in dynamic memory (2nd layer)" UWORD _CNV_S_2_RANGE__0___1_CM 1 100. 0. 1. DISPLAY_IDENTIFIER LV_ERR_MEM_BN_EFP_CRASH ECU_ADDRESS 0xd00041da BIT_MASK 0x8 /end MEASUREMENT
/begin MEASUREMENT fmy_stat_bn_efp_crash.err_info_stat.lv_ready "Readiness flag related to diagnosis XX" UWORD _CNV_S_2_RANGE__0___1_CM 1 100. 0. 1. DISPLAY_IDENTIFIER LV_READY_BN_EFP_CRASH ECU_ADDRESS 0xd00041da BIT_MASK 0x10 /end MEASUREMENT
/begin MEASUREMENT fmy_stat_bn_efp_crash.err_info_stat.lv_end_diag "End of diagnosis XX" UWORD _CNV_S_2_RANGE__0___1_CM 1 100. 0. 1. DISPLAY_IDENTIFIER LV_END_DIAG_BN_EFP_CRASH ECU_ADDRESS 0xd00041da BIT_MASK 0x20 /end MEASUREMENT
/begin MEASUREMENT fmy_stat_bn_efp_crash.err_info_stat.lv_cdn_diag "Diagnosis condition to start symptom detection (set to 1 when condition is fulfilled)" UWORD _CNV_S_2_RANGE__0___1_CM 1 100. 0. 1. DISPLAY_IDENTIFIER LV_CDN_DIAG_BN_EFP_CRASH ECU_ADDRESS 0xd00041da BIT_MASK 0x40 /end MEASUREMENT
/begin MEASUREMENT fmy_stat_bn_efp_crash.err_info_stat.err_sym "For each symptom: status of failure (set to 1 when failure symptom is detected)" UWORD _CNV_S_16_RANGE_ERR__485_CM 1 100. 0. 15. DISPLAY_IDENTIFIER ERR_SYM_BN_EFP_CRASH ECU_ADDRESS 0xd00041da BIT_MASK 0x780 /end MEASUREMENT
/begin MEASUREMENT fmy_stat_bn_efp.ctr_abc "anti-bounce counter for diagnosis XX" UBYTE _CNV_A_R_LINEAR_____0_CM 1 100. 0. 255. DISPLAY_IDENTIFIER CTR_ABC_BN_EFP ECU_ADDRESS 0xd00041d4 FORMAT "%3.0" /end MEASUREMENT
/begin MEASUREMENT fmy_stat_bn_efp.ctr_end_diag "Counter for the end of diagnosis XX generation" UBYTE _CNV_A_R_LINEAR_____0_CM 1 100. 0. 255. DISPLAY_IDENTIFIER CTR_ABC_END_DIAG_BN_EFP ECU_ADDRESS 0xd00041d5 FORMAT "%3.0" /end MEASUREMENT
/begin MEASUREMENT fmy_stat_bn_efp.err_info_stat.lv_err_mem "Failure is stored in dynamic memory (2nd layer)" UWORD _CNV_S_2_RANGE__0___1_CM 1 100. 0. 1. DISPLAY_IDENTIFIER LV_ERR_MEM_BN_EFP ECU_ADDRESS 0xd00041d6 BIT_MASK 0x8 /end MEASUREMENT
/begin MEASUREMENT fmy_stat_bn_efp.err_info_stat.lv_ready "Readiness flag related to diagnosis XX" UWORD _CNV_S_2_RANGE__0___1_CM 1 100. 0. 1. DISPLAY_IDENTIFIER LV_READY_BN_EFP ECU_ADDRESS 0xd00041d6 BIT_MASK 0x10 /end MEASUREMENT
/begin MEASUREMENT fmy_stat_bn_efp.err_info_stat.lv_end_diag "End of diagnosis XX" UWORD _CNV_S_2_RANGE__0___1_CM 1 100. 0. 1. DISPLAY_IDENTIFIER LV_END_DIAG_BN_EFP ECU_ADDRESS 0xd00041d6 BIT_MASK 0x20 /end MEASUREMENT
/begin MEASUREMENT fmy_stat_bn_efp.err_info_stat.lv_cdn_diag "Diagnosis condition to start symptom detection (set to 1 when condition is fulfilled)" UWORD _CNV_S_2_RANGE__0___1_CM 1 100. 0. 1. DISPLAY_IDENTIFIER LV_CDN_DIAG_BN_EFP ECU_ADDRESS 0xd00041d6 BIT_MASK 0x40 /end MEASUREMENT
/begin MEASUREMENT fmy_stat_bn_efp.err_info_stat.err_sym "For each symptom: status of failure (set to 1 when failure symptom is detected)" UWORD _CNV_S_16_RANGE_ERR__485_CM 1 100. 0. 15. DISPLAY_IDENTIFIER ERR_SYM_BN_EFP ECU_ADDRESS 0xd00041d6 BIT_MASK 0x780 /end MEASUREMENT
/begin MEASUREMENT fmy_stat_load_tps_plaus.ctr_abc "anti-bounce counter for diagnosis XX" UBYTE _CNV_A_R_LINEAR_____0_CM 1 100. 0. 255. DISPLAY_IDENTIFIER CTR_ABC_LOAD_TPS_PLAUS ECU_ADDRESS 0xd00043d0 FORMAT "%3.0" /end MEASUREMENT
/begin MEASUREMENT fmy_stat_load_tps_plaus.ctr_end_diag "Counter for the end of diagnosis XX generation" UBYTE _CNV_A_R_LINEAR_____0_CM 1 100. 0. 255. DISPLAY_IDENTIFIER CTR_ABC_END_DIAG_LOAD_TPS_PLAUS ECU_ADDRESS 0xd00043d1 FORMAT "%3.0" /end MEASUREMENT
/begin MEASUREMENT fmy_stat_load_tps_plaus.err_info_stat.lv_err_mem "Failure is stored in dynamic memory (2nd layer)" UWORD _CNV_S_2_RANGE__0___1_CM 1 100. 0. 1. DISPLAY_IDENTIFIER LV_ERR_MEM_LOAD_TPS_PLAUS ECU_ADDRESS 0xd00043d2 BIT_MASK 0x8 /end MEASUREMENT
/begin MEASUREMENT fmy_stat_load_tps_plaus.err_info_stat.lv_ready "Readiness flag related to diagnosis XX" UWORD _CNV_S_2_RANGE__0___1_CM 1 100. 0. 1. DISPLAY_IDENTIFIER LV_READY_LOAD_TPS_PLAUS ECU_ADDRESS 0xd00043d2 BIT_MASK 0x10 /end MEASUREMENT
/begin MEASUREMENT fmy_stat_load_tps_plaus.err_info_stat.lv_end_diag "End of diagnosis XX" UWORD _CNV_S_2_RANGE__0___1_CM 1 100. 0. 1. DISPLAY_IDENTIFIER LV_END_DIAG_LOAD_TPS_PLAUS ECU_ADDRESS 0xd00043d2 BIT_MASK 0x20 /end MEASUREMENT
/begin MEASUREMENT fmy_stat_load_tps_plaus.err_info_stat.lv_cdn_diag "Diagnosis condition to start symptom detection (set to 1 when condition is fulfilled)" UWORD _CNV_S_2_RANGE__0___1_CM 1 100. 0. 1. DISPLAY_IDENTIFIER LV_CDN_DIAG_LOAD_TPS_PLAUS ECU_ADDRESS 0xd00043d2 BIT_MASK 0x40 /end MEASUREMENT
/begin MEASUREMENT fmy_stat_load_tps_plaus.err_info_stat.err_sym "For each symptom: status of failure (set to 1 when failure symptom is detected)" UWORD _CNV_S_16_RANGE_ERR__485_CM 1 100. 0. 15. DISPLAY_IDENTIFIER ERR_SYM_LOAD_TPS_PLAUS ECU_ADDRESS 0xd00043d2 BIT_MASK 0x780 /end MEASUREMENT
/begin MEASUREMENT fmy_stat_egy_min.ctr_abc "anti-bounce counter for diagnosis XX" UBYTE _CNV_A_R_LINEAR_____0_CM 1 100. 0. 255. DISPLAY_IDENTIFIER CTR_ABC_EGY_MIN ECU_ADDRESS 0xd0004300 FORMAT "%3.0" /end MEASUREMENT
/begin MEASUREMENT fmy_stat_egy_min.ctr_end_diag "Counter for the end of diagnosis XX generation" UBYTE _CNV_A_R_LINEAR_____0_CM 1 100. 0. 255. DISPLAY_IDENTIFIER CTR_ABC_END_DIAG_EGY_MIN ECU_ADDRESS 0xd0004301 FORMAT "%3.0" /end MEASUREMENT
/begin MEASUREMENT fmy_stat_egy_min.err_info_stat.lv_err_mem "Failure is stored in dynamic memory (2nd layer)" UWORD _CNV_S_2_RANGE__0___1_CM 1 100. 0. 1. DISPLAY_IDENTIFIER LV_ERR_MEM_EGY_MIN ECU_ADDRESS 0xd0004302 BIT_MASK 0x8 /end MEASUREMENT
/begin MEASUREMENT fmy_stat_egy_min.err_info_stat.lv_ready "Readiness flag related to diagnosis XX" UWORD _CNV_S_2_RANGE__0___1_CM 1 100. 0. 1. DISPLAY_IDENTIFIER LV_READY_EGY_MIN ECU_ADDRESS 0xd0004302 BIT_MASK 0x10 /end MEASUREMENT
/begin MEASUREMENT fmy_stat_egy_min.err_info_stat.lv_end_diag "End of diagnosis XX" UWORD _CNV_S_2_RANGE__0___1_CM 1 100. 0. 1. DISPLAY_IDENTIFIER LV_END_DIAG_EGY_MIN ECU_ADDRESS 0xd0004302 BIT_MASK 0x20 /end MEASUREMENT
/begin MEASUREMENT fmy_stat_egy_min.err_info_stat.lv_cdn_diag "Diagnosis condition to start symptom detection (set to 1 when condition is fulfilled)" UWORD _CNV_S_2_RANGE__0___1_CM 1 100. 0. 1. DISPLAY_IDENTIFIER LV_CDN_DIAG_EGY_MIN ECU_ADDRESS 0xd0004302 BIT_MASK 0x40 /end MEASUREMENT
/begin MEASUREMENT fmy_stat_egy_min.err_info_stat.err_sym "For each symptom: status of failure (set to 1 when failure symptom is detected)" UWORD _CNV_S_16_RANGE_ERR__485_CM 1 100. 0. 15. DISPLAY_IDENTIFIER ERR_SYM_EGY_MIN ECU_ADDRESS 0xd0004302 BIT_MASK 0x780 /end MEASUREMENT
/begin MEASUREMENT fmy_stat_efp_crash.ctr_abc "anti-bounce counter for diagnosis XX" UBYTE _CNV_A_R_LINEAR_____0_CM 1 100. 0. 255. DISPLAY_IDENTIFIER CTR_ABC_EFP_CRASH ECU_ADDRESS 0xd00042f8 FORMAT "%3.0" /end MEASUREMENT
/begin MEASUREMENT fmy_stat_efp_crash.ctr_end_diag "Counter for the end of diagnosis XX generation" UBYTE _CNV_A_R_LINEAR_____0_CM 1 100. 0. 255. DISPLAY_IDENTIFIER CTR_ABC_END_DIAG_EFP_CRASH ECU_ADDRESS 0xd00042f9 FORMAT "%3.0" /end MEASUREMENT
/begin MEASUREMENT fmy_stat_efp_crash.err_info_stat.lv_err_mem "Failure is stored in dynamic memory (2nd layer)" UWORD _CNV_S_2_RANGE__0___1_CM 1 100. 0. 1. DISPLAY_IDENTIFIER LV_ERR_MEM_EFP_CRASH ECU_ADDRESS 0xd00042fa BIT_MASK 0x8 /end MEASUREMENT
/begin MEASUREMENT fmy_stat_efp_crash.err_info_stat.lv_ready "Readiness flag related to diagnosis XX" UWORD _CNV_S_2_RANGE__0___1_CM 1 100. 0. 1. DISPLAY_IDENTIFIER LV_READY_EFP_CRASH ECU_ADDRESS 0xd00042fa BIT_MASK 0x10 /end MEASUREMENT
/begin MEASUREMENT fmy_stat_efp_crash.err_info_stat.lv_end_diag "End of diagnosis XX" UWORD _CNV_S_2_RANGE__0___1_CM 1 100. 0. 1. DISPLAY_IDENTIFIER LV_END_DIAG_EFP_CRASH ECU_ADDRESS 0xd00042fa BIT_MASK 0x20 /end MEASUREMENT
/begin MEASUREMENT fmy_stat_efp_crash.err_info_stat.lv_cdn_diag "Diagnosis condition to start symptom detection (set to 1 when condition is fulfilled)" UWORD _CNV_S_2_RANGE__0___1_CM 1 100. 0. 1. DISPLAY_IDENTIFIER LV_CDN_DIAG_EFP_CRASH ECU_ADDRESS 0xd00042fa BIT_MASK 0x40 /end MEASUREMENT
/begin MEASUREMENT fmy_stat_efp_crash.err_info_stat.err_sym "For each symptom: status of failure (set to 1 when failure symptom is detected)" UWORD _CNV_S_16_RANGE_ERR__485_CM 1 100. 0. 15. DISPLAY_IDENTIFIER ERR_SYM_EFP_CRASH ECU_ADDRESS 0xd00042fa BIT_MASK 0x780 /end MEASUREMENT
/begin MEASUREMENT fmy_stat_efp.ctr_abc "anti-bounce counter for diagnosis XX" UBYTE _CNV_A_R_LINEAR_____0_CM 1 100. 0. 255. DISPLAY_IDENTIFIER CTR_ABC_EFP ECU_ADDRESS 0xd00042f4 FORMAT "%3.0" /end MEASUREMENT
/begin MEASUREMENT fmy_stat_efp.ctr_end_diag "Counter for the end of diagnosis XX generation" UBYTE _CNV_A_R_LINEAR_____0_CM 1 100. 0. 255. DISPLAY_IDENTIFIER CTR_ABC_END_DIAG_EFP ECU_ADDRESS 0xd00042f5 FORMAT "%3.0" /end MEASUREMENT
/begin MEASUREMENT fmy_stat_efp.err_info_stat.lv_err_mem "Failure is stored in dynamic memory (2nd layer)" UWORD _CNV_S_2_RANGE__0___1_CM 1 100. 0. 1. DISPLAY_IDENTIFIER LV_ERR_MEM_EFP ECU_ADDRESS 0xd00042f6 BIT_MASK 0x8 /end MEASUREMENT
/begin MEASUREMENT fmy_stat_efp.err_info_stat.lv_ready "Readiness flag related to diagnosis XX" UWORD _CNV_S_2_RANGE__0___1_CM 1 100. 0. 1. DISPLAY_IDENTIFIER LV_READY_EFP ECU_ADDRESS 0xd00042f6 BIT_MASK 0x10 /end MEASUREMENT
/begin MEASUREMENT fmy_stat_efp.err_info_stat.lv_end_diag "End of diagnosis XX" UWORD _CNV_S_2_RANGE__0___1_CM 1 100. 0. 1. DISPLAY_IDENTIFIER LV_END_DIAG_EFP ECU_ADDRESS 0xd00042f6 BIT_MASK 0x20 /end MEASUREMENT
/begin MEASUREMENT fmy_stat_efp.err_info_stat.lv_cdn_diag "Diagnosis condition to start symptom detection (set to 1 when condition is fulfilled)" UWORD _CNV_S_2_RANGE__0___1_CM 1 100. 0. 1. DISPLAY_IDENTIFIER LV_CDN_DIAG_EFP ECU_ADDRESS 0xd00042f6 BIT_MASK 0x40 /end MEASUREMENT
/begin MEASUREMENT fmy_stat_efp.err_info_stat.err_sym "For each symptom: status of failure (set to 1 when failure symptom is detected)" UWORD _CNV_S_16_RANGE_ERR__485_CM 1 100. 0. 15. DISPLAY_IDENTIFIER ERR_SYM_EFP ECU_ADDRESS 0xd00042f6 BIT_MASK 0x780 /end MEASUREMENT
/begin MEASUREMENT fmy_stat_locan_boff.ctr_abc "anti-bounce counter for diagnosis XX" UBYTE _CNV_A_R_LINEAR_____0_CM 1 100. 0. 255. DISPLAY_IDENTIFIER CTR_ABC_LOCAN_BOFF ECU_ADDRESS 0xd00043d4 FORMAT "%3.0" /end MEASUREMENT
/begin MEASUREMENT fmy_stat_locan_boff.ctr_end_diag "Counter for the end of diagnosis XX generation" UBYTE _CNV_A_R_LINEAR_____0_CM 1 100. 0. 255. DISPLAY_IDENTIFIER CTR_ABC_END_DIAG_LOCAN_BOFF ECU_ADDRESS 0xd00043d5 FORMAT "%3.0" /end MEASUREMENT
/begin MEASUREMENT fmy_stat_locan_boff.err_info_stat.lv_err_mem "Failure is stored in dynamic memory (2nd layer)" UWORD _CNV_S_2_RANGE__0___1_CM 1 100. 0. 1. DISPLAY_IDENTIFIER LV_ERR_MEM_LOCAN_BOFF ECU_ADDRESS 0xd00043d6 BIT_MASK 0x8 /end MEASUREMENT
/begin MEASUREMENT fmy_stat_locan_boff.err_info_stat.lv_ready "Readiness flag related to diagnosis XX" UWORD _CNV_S_2_RANGE__0___1_CM 1 100. 0. 1. DISPLAY_IDENTIFIER LV_READY_LOCAN_BOFF ECU_ADDRESS 0xd00043d6 BIT_MASK 0x10 /end MEASUREMENT
/begin MEASUREMENT fmy_stat_locan_boff.err_info_stat.lv_end_diag "End of diagnosis XX" UWORD _CNV_S_2_RANGE__0___1_CM 1 100. 0. 1. DISPLAY_IDENTIFIER LV_END_DIAG_LOCAN_BOFF ECU_ADDRESS 0xd00043d6 BIT_MASK 0x20 /end MEASUREMENT
/begin MEASUREMENT fmy_stat_locan_boff.err_info_stat.lv_cdn_diag "Diagnosis condition to start symptom detection (set to 1 when condition is fulfilled)" UWORD _CNV_S_2_RANGE__0___1_CM 1 100. 0. 1. DISPLAY_IDENTIFIER LV_CDN_DIAG_LOCAN_BOFF ECU_ADDRESS 0xd00043d6 BIT_MASK 0x40 /end MEASUREMENT
/begin MEASUREMENT fmy_stat_locan_boff.err_info_stat.err_sym "For each symptom: status of failure (set to 1 when failure symptom is detected)" UWORD _CNV_S_16_RANGE_ERR__485_CM 1 100. 0. 15. DISPLAY_IDENTIFIER ERR_SYM_LOCAN_BOFF ECU_ADDRESS 0xd00043d6 BIT_MASK 0x780 /end MEASUREMENT
/begin MEASUREMENT fmy_stat_cwp_plaus.ctr_abc "anti-bounce counter for diagnosis XX" UBYTE _CNV_A_R_LINEAR_____0_CM 1 100. 0. 255. DISPLAY_IDENTIFIER CTR_ABC_CWP_PLAUS ECU_ADDRESS 0xd0004298 FORMAT "%3.0" /end MEASUREMENT
/begin MEASUREMENT fmy_stat_cwp_plaus.ctr_end_diag "Counter for the end of diagnosis XX generation" UBYTE _CNV_A_R_LINEAR_____0_CM 1 100. 0. 255. DISPLAY_IDENTIFIER CTR_ABC_END_DIAG_CWP_PLAUS ECU_ADDRESS 0xd0004299 FORMAT "%3.0" /end MEASUREMENT
/begin MEASUREMENT fmy_stat_cwp_plaus.err_info_stat.lv_err_mem "Failure is stored in dynamic memory (2nd layer)" UWORD _CNV_S_2_RANGE__0___1_CM 1 100. 0. 1. DISPLAY_IDENTIFIER LV_ERR_MEM_CWP_PLAUS ECU_ADDRESS 0xd000429a BIT_MASK 0x8 /end MEASUREMENT
/begin MEASUREMENT fmy_stat_cwp_plaus.err_info_stat.lv_ready "Readiness flag related to diagnosis XX" UWORD _CNV_S_2_RANGE__0___1_CM 1 100. 0. 1. DISPLAY_IDENTIFIER LV_READY_CWP_PLAUS ECU_ADDRESS 0xd000429a BIT_MASK 0x10 /end MEASUREMENT
/begin MEASUREMENT fmy_stat_cwp_plaus.err_info_stat.lv_end_diag "End of diagnosis XX" UWORD _CNV_S_2_RANGE__0___1_CM 1 100. 0. 1. DISPLAY_IDENTIFIER LV_END_DIAG_CWP_PLAUS ECU_ADDRESS 0xd000429a BIT_MASK 0x20 /end MEASUREMENT
/begin MEASUREMENT fmy_stat_cwp_plaus.err_info_stat.lv_cdn_diag "Diagnosis condition to start symptom detection (set to 1 when condition is fulfilled)" UWORD _CNV_S_2_RANGE__0___1_CM 1 100. 0. 1. DISPLAY_IDENTIFIER LV_CDN_DIAG_CWP_PLAUS ECU_ADDRESS 0xd000429a BIT_MASK 0x40 /end MEASUREMENT
/begin MEASUREMENT fmy_stat_cwp_plaus.err_info_stat.err_sym "For each symptom: status of failure (set to 1 when failure symptom is detected)" UWORD _CNV_S_16_RANGE_ERR__485_CM 1 100. 0. 15. DISPLAY_IDENTIFIER ERR_SYM_CWP_PLAUS ECU_ADDRESS 0xd000429a BIT_MASK 0x780 /end MEASUREMENT
/begin MEASUREMENT fmy_stat_cwp_int_off.ctr_abc "anti-bounce counter for diagnosis XX" UBYTE _CNV_A_R_LINEAR_____0_CM 1 100. 0. 255. DISPLAY_IDENTIFIER CTR_ABC_CWP_INT_OFF ECU_ADDRESS 0xd0004294 FORMAT "%3.0" /end MEASUREMENT
/begin MEASUREMENT fmy_stat_cwp_int_off.ctr_end_diag "Counter for the end of diagnosis XX generation" UBYTE _CNV_A_R_LINEAR_____0_CM 1 100. 0. 255. DISPLAY_IDENTIFIER CTR_ABC_END_DIAG_CWP_INT_OFF ECU_ADDRESS 0xd0004295 FORMAT "%3.0" /end MEASUREMENT
/begin MEASUREMENT fmy_stat_cwp_int_off.err_info_stat.lv_err_mem "Failure is stored in dynamic memory (2nd layer)" UWORD _CNV_S_2_RANGE__0___1_CM 1 100. 0. 1. DISPLAY_IDENTIFIER LV_ERR_MEM_CWP_INT_OFF ECU_ADDRESS 0xd0004296 BIT_MASK 0x8 /end MEASUREMENT
/begin MEASUREMENT fmy_stat_cwp_int_off.err_info_stat.lv_ready "Readiness flag related to diagnosis XX" UWORD _CNV_S_2_RANGE__0___1_CM 1 100. 0. 1. DISPLAY_IDENTIFIER LV_READY_CWP_INT_OFF ECU_ADDRESS 0xd0004296 BIT_MASK 0x10 /end MEASUREMENT
/begin MEASUREMENT fmy_stat_cwp_int_off.err_info_stat.lv_end_diag "End of diagnosis XX" UWORD _CNV_S_2_RANGE__0___1_CM 1 100. 0. 1. DISPLAY_IDENTIFIER LV_END_DIAG_CWP_INT_OFF ECU_ADDRESS 0xd0004296 BIT_MASK 0x20 /end MEASUREMENT
/begin MEASUREMENT fmy_stat_cwp_int_off.err_info_stat.lv_cdn_diag "Diagnosis condition to start symptom detection (set to 1 when condition is fulfilled)" UWORD _CNV_S_2_RANGE__0___1_CM 1 100. 0. 1. DISPLAY_IDENTIFIER LV_CDN_DIAG_CWP_INT_OFF ECU_ADDRESS 0xd0004296 BIT_MASK 0x40 /end MEASUREMENT
/begin MEASUREMENT fmy_stat_cwp_int_off.err_info_stat.err_sym "For each symptom: status of failure (set to 1 when failure symptom is detected)" UWORD _CNV_S_16_RANGE_ERR__485_CM 1 100. 0. 15. DISPLAY_IDENTIFIER ERR_SYM_CWP_INT_OFF ECU_ADDRESS 0xd0004296 BIT_MASK 0x780 /end MEASUREMENT
/begin MEASUREMENT fmy_stat_cwp_pwr.ctr_abc "anti-bounce counter for diagnosis XX" UBYTE _CNV_A_R_LINEAR_____0_CM 1 100. 0. 255. DISPLAY_IDENTIFIER CTR_ABC_CWP_PWR ECU_ADDRESS 0xd000429c FORMAT "%3.0" /end MEASUREMENT
/begin MEASUREMENT fmy_stat_cwp_pwr.ctr_end_diag "Counter for the end of diagnosis XX generation" UBYTE _CNV_A_R_LINEAR_____0_CM 1 100. 0. 255. DISPLAY_IDENTIFIER CTR_ABC_END_DIAG_CWP_PWR ECU_ADDRESS 0xd000429d FORMAT "%3.0" /end MEASUREMENT
/begin MEASUREMENT fmy_stat_cwp_pwr.err_info_stat.lv_err_mem "Failure is stored in dynamic memory (2nd layer)" UWORD _CNV_S_2_RANGE__0___1_CM 1 100. 0. 1. DISPLAY_IDENTIFIER LV_ERR_MEM_CWP_PWR ECU_ADDRESS 0xd000429e BIT_MASK 0x8 /end MEASUREMENT
/begin MEASUREMENT fmy_stat_cwp_pwr.err_info_stat.lv_ready "Readiness flag related to diagnosis XX" UWORD _CNV_S_2_RANGE__0___1_CM 1 100. 0. 1. DISPLAY_IDENTIFIER LV_READY_CWP_PWR ECU_ADDRESS 0xd000429e BIT_MASK 0x10 /end MEASUREMENT
/begin MEASUREMENT fmy_stat_cwp_pwr.err_info_stat.lv_end_diag "End of diagnosis XX" UWORD _CNV_S_2_RANGE__0___1_CM 1 100. 0. 1. DISPLAY_IDENTIFIER LV_END_DIAG_CWP_PWR ECU_ADDRESS 0xd000429e BIT_MASK 0x20 /end MEASUREMENT
/begin MEASUREMENT fmy_stat_cwp_pwr.err_info_stat.lv_cdn_diag "Diagnosis condition to start symptom detection (set to 1 when condition is fulfilled)" UWORD _CNV_S_2_RANGE__0___1_CM 1 100. 0. 1. DISPLAY_IDENTIFIER LV_CDN_DIAG_CWP_PWR ECU_ADDRESS 0xd000429e BIT_MASK 0x40 /end MEASUREMENT
/begin MEASUREMENT fmy_stat_cwp_pwr.err_info_stat.err_sym "For each symptom: status of failure (set to 1 when failure symptom is detected)" UWORD _CNV_S_16_RANGE_ERR__485_CM 1 100. 0. 15. DISPLAY_IDENTIFIER ERR_SYM_CWP_PWR ECU_ADDRESS 0xd000429e BIT_MASK 0x780 /end MEASUREMENT
/begin MEASUREMENT fmy_stat_cwp_com_plaus.ctr_abc "anti-bounce counter for diagnosis XX" UBYTE _CNV_A_R_LINEAR_____0_CM 1 100. 0. 255. DISPLAY_IDENTIFIER CTR_ABC_CWP_COM_PLAUS ECU_ADDRESS 0xd0004290 FORMAT "%3.0" /end MEASUREMENT
/begin MEASUREMENT fmy_stat_cwp_com_plaus.ctr_end_diag "Counter for the end of diagnosis XX generation" UBYTE _CNV_A_R_LINEAR_____0_CM 1 100. 0. 255. DISPLAY_IDENTIFIER CTR_ABC_END_DIAG_CWP_COM_PLAUS ECU_ADDRESS 0xd0004291 FORMAT "%3.0" /end MEASUREMENT
/begin MEASUREMENT fmy_stat_cwp_com_plaus.err_info_stat.lv_err_mem "Failure is stored in dynamic memory (2nd layer)" UWORD _CNV_S_2_RANGE__0___1_CM 1 100. 0. 1. DISPLAY_IDENTIFIER LV_ERR_MEM_CWP_COM_PLAUS ECU_ADDRESS 0xd0004292 BIT_MASK 0x8 /end MEASUREMENT
/begin MEASUREMENT fmy_stat_cwp_com_plaus.err_info_stat.lv_ready "Readiness flag related to diagnosis XX" UWORD _CNV_S_2_RANGE__0___1_CM 1 100. 0. 1. DISPLAY_IDENTIFIER LV_READY_CWP_COM_PLAUS ECU_ADDRESS 0xd0004292 BIT_MASK 0x10 /end MEASUREMENT
/begin MEASUREMENT fmy_stat_cwp_com_plaus.err_info_stat.lv_end_diag "End of diagnosis XX" UWORD _CNV_S_2_RANGE__0___1_CM 1 100. 0. 1. DISPLAY_IDENTIFIER LV_END_DIAG_CWP_COM_PLAUS ECU_ADDRESS 0xd0004292 BIT_MASK 0x20 /end MEASUREMENT
/begin MEASUREMENT fmy_stat_cwp_com_plaus.err_info_stat.lv_cdn_diag "Diagnosis condition to start symptom detection (set to 1 when condition is fulfilled)" UWORD _CNV_S_2_RANGE__0___1_CM 1 100. 0. 1. DISPLAY_IDENTIFIER LV_CDN_DIAG_CWP_COM_PLAUS ECU_ADDRESS 0xd0004292 BIT_MASK 0x40 /end MEASUREMENT
/begin MEASUREMENT fmy_stat_cwp_com_plaus.err_info_stat.err_sym "For each symptom: status of failure (set to 1 when failure symptom is detected)" UWORD _CNV_S_16_RANGE_ERR__485_CM 1 100. 0. 15. DISPLAY_IDENTIFIER ERR_SYM_CWP_COM_PLAUS ECU_ADDRESS 0xd0004292 BIT_MASK 0x780 /end MEASUREMENT
/begin MEASUREMENT fmy_stat_qoil_sens.ctr_abc "anti-bounce counter for diagnosis XX" UBYTE _CNV_A_R_LINEAR_____0_CM 1 100. 0. 255. DISPLAY_IDENTIFIER CTR_ABC_QOIL_SENS ECU_ADDRESS 0xd00044d8 FORMAT "%3.0" /end MEASUREMENT
/begin MEASUREMENT fmy_stat_qoil_sens.ctr_end_diag "Counter for the end of diagnosis XX generation" UBYTE _CNV_A_R_LINEAR_____0_CM 1 100. 0. 255. DISPLAY_IDENTIFIER CTR_ABC_END_DIAG_QOIL_SENS ECU_ADDRESS 0xd00044d9 FORMAT "%3.0" /end MEASUREMENT
/begin MEASUREMENT fmy_stat_qoil_sens.err_info_stat.lv_err_mem "Failure is stored in dynamic memory (2nd layer)" UWORD _CNV_S_2_RANGE__0___1_CM 1 100. 0. 1. DISPLAY_IDENTIFIER LV_ERR_MEM_QOIL_SENS ECU_ADDRESS 0xd00044da BIT_MASK 0x8 /end MEASUREMENT
/begin MEASUREMENT fmy_stat_qoil_sens.err_info_stat.lv_ready "Readiness flag related to diagnosis XX" UWORD _CNV_S_2_RANGE__0___1_CM 1 100. 0. 1. DISPLAY_IDENTIFIER LV_READY_QOIL_SENS ECU_ADDRESS 0xd00044da BIT_MASK 0x10 /end MEASUREMENT
/begin MEASUREMENT fmy_stat_qoil_sens.err_info_stat.lv_end_diag "End of diagnosis XX" UWORD _CNV_S_2_RANGE__0___1_CM 1 100. 0. 1. DISPLAY_IDENTIFIER LV_END_DIAG_QOIL_SENS ECU_ADDRESS 0xd00044da BIT_MASK 0x20 /end MEASUREMENT
/begin MEASUREMENT fmy_stat_qoil_sens.err_info_stat.lv_cdn_diag "Diagnosis condition to start symptom detection (set to 1 when condition is fulfilled)" UWORD _CNV_S_2_RANGE__0___1_CM 1 100. 0. 1. DISPLAY_IDENTIFIER LV_CDN_DIAG_QOIL_SENS ECU_ADDRESS 0xd00044da BIT_MASK 0x40 /end MEASUREMENT
/begin MEASUREMENT fmy_stat_qoil_sens.err_info_stat.err_sym "For each symptom: status of failure (set to 1 when failure symptom is detected)" UWORD _CNV_S_16_RANGE_ERR__485_CM 1 100. 0. 15. DISPLAY_IDENTIFIER ERR_SYM_QOIL_SENS ECU_ADDRESS 0xd00044da BIT_MASK 0x780 /end MEASUREMENT
/begin MEASUREMENT fmy_stat_bat_sens.ctr_abc "anti-bounce counter for diagnosis XX" UBYTE _CNV_A_R_LINEAR_____0_CM 1 100. 0. 255. DISPLAY_IDENTIFIER CTR_ABC_BAT_SENS ECU_ADDRESS 0xd00041b8 FORMAT "%3.0" /end MEASUREMENT
/begin MEASUREMENT fmy_stat_bat_sens.ctr_end_diag "Counter for the end of diagnosis XX generation" UBYTE _CNV_A_R_LINEAR_____0_CM 1 100. 0. 255. DISPLAY_IDENTIFIER CTR_ABC_END_DIAG_BAT_SENS ECU_ADDRESS 0xd00041b9 FORMAT "%3.0" /end MEASUREMENT
/begin MEASUREMENT fmy_stat_bat_sens.err_info_stat.lv_err_mem "Failure is stored in dynamic memory (2nd layer)" UWORD _CNV_S_2_RANGE__0___1_CM 1 100. 0. 1. DISPLAY_IDENTIFIER LV_ERR_MEM_BAT_SENS ECU_ADDRESS 0xd00041ba BIT_MASK 0x8 /end MEASUREMENT
/begin MEASUREMENT fmy_stat_bat_sens.err_info_stat.lv_ready "Readiness flag related to diagnosis XX" UWORD _CNV_S_2_RANGE__0___1_CM 1 100. 0. 1. DISPLAY_IDENTIFIER LV_READY_BAT_SENS ECU_ADDRESS 0xd00041ba BIT_MASK 0x10 /end MEASUREMENT
/begin MEASUREMENT fmy_stat_bat_sens.err_info_stat.lv_end_diag "End of diagnosis XX" UWORD _CNV_S_2_RANGE__0___1_CM 1 100. 0. 1. DISPLAY_IDENTIFIER LV_END_DIAG_BAT_SENS ECU_ADDRESS 0xd00041ba BIT_MASK 0x20 /end MEASUREMENT
/begin MEASUREMENT fmy_stat_bat_sens.err_info_stat.lv_cdn_diag "Diagnosis condition to start symptom detection (set to 1 when condition is fulfilled)" UWORD _CNV_S_2_RANGE__0___1_CM 1 100. 0. 1. DISPLAY_IDENTIFIER LV_CDN_DIAG_BAT_SENS ECU_ADDRESS 0xd00041ba BIT_MASK 0x40 /end MEASUREMENT
/begin MEASUREMENT fmy_stat_bat_sens.err_info_stat.err_sym "For each symptom: status of failure (set to 1 when failure symptom is detected)" UWORD _CNV_S_16_RANGE_ERR__485_CM 1 100. 0. 15. DISPLAY_IDENTIFIER ERR_SYM_BAT_SENS ECU_ADDRESS 0xd00041ba BIT_MASK 0x780 /end MEASUREMENT
/begin MEASUREMENT fmy_stat_bat_sens_it.ctr_abc "anti-bounce counter for diagnosis XX" UBYTE _CNV_A_R_LINEAR_____0_CM 1 100. 0. 255. DISPLAY_IDENTIFIER CTR_ABC_BAT_SENS_IT ECU_ADDRESS 0xd00041bc FORMAT "%3.0" /end MEASUREMENT
/begin MEASUREMENT fmy_stat_bat_sens_it.ctr_end_diag "Counter for the end of diagnosis XX generation" UBYTE _CNV_A_R_LINEAR_____0_CM 1 100. 0. 255. DISPLAY_IDENTIFIER CTR_ABC_END_DIAG_BAT_SENS_IT ECU_ADDRESS 0xd00041bd FORMAT "%3.0" /end MEASUREMENT
/begin MEASUREMENT fmy_stat_bat_sens_it.err_info_stat.lv_err_mem "Failure is stored in dynamic memory (2nd layer)" UWORD _CNV_S_2_RANGE__0___1_CM 1 100. 0. 1. DISPLAY_IDENTIFIER LV_ERR_MEM_BAT_SENS_IT ECU_ADDRESS 0xd00041be BIT_MASK 0x8 /end MEASUREMENT
/begin MEASUREMENT fmy_stat_bat_sens_it.err_info_stat.lv_ready "Readiness flag related to diagnosis XX" UWORD _CNV_S_2_RANGE__0___1_CM 1 100. 0. 1. DISPLAY_IDENTIFIER LV_READY_BAT_SENS_IT ECU_ADDRESS 0xd00041be BIT_MASK 0x10 /end MEASUREMENT
/begin MEASUREMENT fmy_stat_bat_sens_it.err_info_stat.lv_end_diag "End of diagnosis XX" UWORD _CNV_S_2_RANGE__0___1_CM 1 100. 0. 1. DISPLAY_IDENTIFIER LV_END_DIAG_BAT_SENS_IT ECU_ADDRESS 0xd00041be BIT_MASK 0x20 /end MEASUREMENT
/begin MEASUREMENT fmy_stat_bat_sens_it.err_info_stat.lv_cdn_diag "Diagnosis condition to start symptom detection (set to 1 when condition is fulfilled)" UWORD _CNV_S_2_RANGE__0___1_CM 1 100. 0. 1. DISPLAY_IDENTIFIER LV_CDN_DIAG_BAT_SENS_IT ECU_ADDRESS 0xd00041be BIT_MASK 0x40 /end MEASUREMENT
/begin MEASUREMENT fmy_stat_bat_sens_it.err_info_stat.err_sym "For each symptom: status of failure (set to 1 when failure symptom is detected)" UWORD _CNV_S_16_RANGE_ERR__485_CM 1 100. 0. 15. DISPLAY_IDENTIFIER ERR_SYM_BAT_SENS_IT ECU_ADDRESS 0xd00041be BIT_MASK 0x780 /end MEASUREMENT
/begin MEASUREMENT fmy_stat_bat_sens_it_el.ctr_abc "anti-bounce counter for diagnosis XX" UBYTE _CNV_A_R_LINEAR_____0_CM 1 100. 0. 255. DISPLAY_IDENTIFIER CTR_ABC_BAT_SENS_IT_EL ECU_ADDRESS 0xd00041c0 FORMAT "%3.0" /end MEASUREMENT
/begin MEASUREMENT fmy_stat_bat_sens_it_el.ctr_end_diag "Counter for the end of diagnosis XX generation" UBYTE _CNV_A_R_LINEAR_____0_CM 1 100. 0. 255. DISPLAY_IDENTIFIER CTR_ABC_END_DIAG_BAT_SENS_IT_EL ECU_ADDRESS 0xd00041c1 FORMAT "%3.0" /end MEASUREMENT
/begin MEASUREMENT fmy_stat_bat_sens_it_el.err_info_stat.lv_err_mem "Failure is stored in dynamic memory (2nd layer)" UWORD _CNV_S_2_RANGE__0___1_CM 1 100. 0. 1. DISPLAY_IDENTIFIER LV_ERR_MEM_BAT_SENS_IT_EL ECU_ADDRESS 0xd00041c2 BIT_MASK 0x8 /end MEASUREMENT
/begin MEASUREMENT fmy_stat_bat_sens_it_el.err_info_stat.lv_ready "Readiness flag related to diagnosis XX" UWORD _CNV_S_2_RANGE__0___1_CM 1 100. 0. 1. DISPLAY_IDENTIFIER LV_READY_BAT_SENS_IT_EL ECU_ADDRESS 0xd00041c2 BIT_MASK 0x10 /end MEASUREMENT
/begin MEASUREMENT fmy_stat_bat_sens_it_el.err_info_stat.lv_end_diag "End of diagnosis XX" UWORD _CNV_S_2_RANGE__0___1_CM 1 100. 0. 1. DISPLAY_IDENTIFIER LV_END_DIAG_BAT_SENS_IT_EL ECU_ADDRESS 0xd00041c2 BIT_MASK 0x20 /end MEASUREMENT
/begin MEASUREMENT fmy_stat_bat_sens_it_el.err_info_stat.lv_cdn_diag "Diagnosis condition to start symptom detection (set to 1 when condition is fulfilled)" UWORD _CNV_S_2_RANGE__0___1_CM 1 100. 0. 1. DISPLAY_IDENTIFIER LV_CDN_DIAG_BAT_SENS_IT_EL ECU_ADDRESS 0xd00041c2 BIT_MASK 0x40 /end MEASUREMENT
/begin MEASUREMENT fmy_stat_bat_sens_it_el.err_info_stat.err_sym "For each symptom: status of failure (set to 1 when failure symptom is detected)" UWORD _CNV_S_16_RANGE_ERR__485_CM 1 100. 0. 15. DISPLAY_IDENTIFIER ERR_SYM_BAT_SENS_IT_EL ECU_ADDRESS 0xd00041c2 BIT_MASK 0x780 /end MEASUREMENT
/begin MEASUREMENT fmy_stat_ecu_nvmy.ctr_abc "anti-bounce counter for diagnosis XX" UBYTE _CNV_A_R_LINEAR_____0_CM 1 100. 0. 255. DISPLAY_IDENTIFIER CTR_ABC_ECU_NVMY ECU_ADDRESS 0xd00042e8 FORMAT "%3.0" /end MEASUREMENT
/begin MEASUREMENT fmy_stat_ecu_nvmy.ctr_end_diag "Counter for the end of diagnosis XX generation" UBYTE _CNV_A_R_LINEAR_____0_CM 1 100. 0. 255. DISPLAY_IDENTIFIER CTR_ABC_END_DIAG_ECU_NVMY ECU_ADDRESS 0xd00042e9 FORMAT "%3.0" /end MEASUREMENT
/begin MEASUREMENT fmy_stat_ecu_nvmy.err_info_stat.lv_err_mem "Failure is stored in dynamic memory (2nd layer)" UWORD _CNV_S_2_RANGE__0___1_CM 1 100. 0. 1. DISPLAY_IDENTIFIER LV_ERR_MEM_ECU_NVMY ECU_ADDRESS 0xd00042ea BIT_MASK 0x8 /end MEASUREMENT
/begin MEASUREMENT fmy_stat_ecu_nvmy.err_info_stat.lv_ready "Readiness flag related to diagnosis XX" UWORD _CNV_S_2_RANGE__0___1_CM 1 100. 0. 1. DISPLAY_IDENTIFIER LV_READY_ECU_NVMY ECU_ADDRESS 0xd00042ea BIT_MASK 0x10 /end MEASUREMENT
/begin MEASUREMENT fmy_stat_ecu_nvmy.err_info_stat.lv_end_diag "End of diagnosis XX" UWORD _CNV_S_2_RANGE__0___1_CM 1 100. 0. 1. DISPLAY_IDENTIFIER LV_END_DIAG_ECU_NVMY ECU_ADDRESS 0xd00042ea BIT_MASK 0x20 /end MEASUREMENT
/begin MEASUREMENT fmy_stat_ecu_nvmy.err_info_stat.lv_cdn_diag "Diagnosis condition to start symptom detection (set to 1 when condition is fulfilled)" UWORD _CNV_S_2_RANGE__0___1_CM 1 100. 0. 1. DISPLAY_IDENTIFIER LV_CDN_DIAG_ECU_NVMY ECU_ADDRESS 0xd00042ea BIT_MASK 0x40 /end MEASUREMENT
/begin MEASUREMENT fmy_stat_ecu_nvmy.err_info_stat.err_sym "For each symptom: status of failure (set to 1 when failure symptom is detected)" UWORD _CNV_S_16_RANGE_ERR__485_CM 1 100. 0. 15. DISPLAY_IDENTIFIER ERR_SYM_ECU_NVMY ECU_ADDRESS 0xd00042ea BIT_MASK 0x780 /end MEASUREMENT
/begin MEASUREMENT fmy_stat_gs.ctr_abc "anti-bounce counter for diagnosis XX" UBYTE _CNV_A_R_LINEAR_____0_CM 1 100. 0. 255. DISPLAY_IDENTIFIER CTR_ABC_GS ECU_ADDRESS 0xd0004340 FORMAT "%3.0" /end MEASUREMENT
/begin MEASUREMENT fmy_stat_gs.ctr_end_diag "Counter for the end of diagnosis XX generation" UBYTE _CNV_A_R_LINEAR_____0_CM 1 100. 0. 255. DISPLAY_IDENTIFIER CTR_ABC_END_DIAG_GS ECU_ADDRESS 0xd0004341 FORMAT "%3.0" /end MEASUREMENT
/begin MEASUREMENT fmy_stat_gs.err_info_stat.lv_err_mem "Failure is stored in dynamic memory (2nd layer)" UWORD _CNV_S_2_RANGE__0___1_CM 1 100. 0. 1. DISPLAY_IDENTIFIER LV_ERR_MEM_GS ECU_ADDRESS 0xd0004342 BIT_MASK 0x8 /end MEASUREMENT
/begin MEASUREMENT fmy_stat_gs.err_info_stat.lv_ready "Readiness flag related to diagnosis XX" UWORD _CNV_S_2_RANGE__0___1_CM 1 100. 0. 1. DISPLAY_IDENTIFIER LV_READY_GS ECU_ADDRESS 0xd0004342 BIT_MASK 0x10 /end MEASUREMENT
/begin MEASUREMENT fmy_stat_gs.err_info_stat.lv_end_diag "End of diagnosis XX" UWORD _CNV_S_2_RANGE__0___1_CM 1 100. 0. 1. DISPLAY_IDENTIFIER LV_END_DIAG_GS ECU_ADDRESS 0xd0004342 BIT_MASK 0x20 /end MEASUREMENT
/begin MEASUREMENT fmy_stat_gs.err_info_stat.lv_cdn_diag "Diagnosis condition to start symptom detection (set to 1 when condition is fulfilled)" UWORD _CNV_S_2_RANGE__0___1_CM 1 100. 0. 1. DISPLAY_IDENTIFIER LV_CDN_DIAG_GS ECU_ADDRESS 0xd0004342 BIT_MASK 0x40 /end MEASUREMENT
/begin MEASUREMENT fmy_stat_gs.err_info_stat.err_sym "For each symptom: status of failure (set to 1 when failure symptom is detected)" UWORD _CNV_S_16_RANGE_ERR__485_CM 1 100. 0. 15. DISPLAY_IDENTIFIER ERR_SYM_GS ECU_ADDRESS 0xd0004342 BIT_MASK 0x780 /end MEASUREMENT
/begin MEASUREMENT fmy_stat_plaus_igk_bn.ctr_abc "anti-bounce counter for diagnosis XX" UBYTE _CNV_A_R_LINEAR_____0_CM 1 100. 0. 255. DISPLAY_IDENTIFIER CTR_ABC_PLAUS_IGK_BN ECU_ADDRESS 0xd000449c FORMAT "%3.0" /end MEASUREMENT
/begin MEASUREMENT fmy_stat_plaus_igk_bn.ctr_end_diag "Counter for the end of diagnosis XX generation" UBYTE _CNV_A_R_LINEAR_____0_CM 1 100. 0. 255. DISPLAY_IDENTIFIER CTR_ABC_END_DIAG_PLAUS_IGK_BN ECU_ADDRESS 0xd000449d FORMAT "%3.0" /end MEASUREMENT
/begin MEASUREMENT fmy_stat_plaus_igk_bn.err_info_stat.lv_err_mem "Failure is stored in dynamic memory (2nd layer)" UWORD _CNV_S_2_RANGE__0___1_CM 1 100. 0. 1. DISPLAY_IDENTIFIER LV_ERR_MEM_PLAUS_IGK_BN ECU_ADDRESS 0xd000449e BIT_MASK 0x8 /end MEASUREMENT
/begin MEASUREMENT fmy_stat_plaus_igk_bn.err_info_stat.lv_ready "Readiness flag related to diagnosis XX" UWORD _CNV_S_2_RANGE__0___1_CM 1 100. 0. 1. DISPLAY_IDENTIFIER LV_READY_PLAUS_IGK_BN ECU_ADDRESS 0xd000449e BIT_MASK 0x10 /end MEASUREMENT
/begin MEASUREMENT fmy_stat_plaus_igk_bn.err_info_stat.lv_end_diag "End of diagnosis XX" UWORD _CNV_S_2_RANGE__0___1_CM 1 100. 0. 1. DISPLAY_IDENTIFIER LV_END_DIAG_PLAUS_IGK_BN ECU_ADDRESS 0xd000449e BIT_MASK 0x20 /end MEASUREMENT
/begin MEASUREMENT fmy_stat_plaus_igk_bn.err_info_stat.lv_cdn_diag "Diagnosis condition to start symptom detection (set to 1 when condition is fulfilled)" UWORD _CNV_S_2_RANGE__0___1_CM 1 100. 0. 1. DISPLAY_IDENTIFIER LV_CDN_DIAG_PLAUS_IGK_BN ECU_ADDRESS 0xd000449e BIT_MASK 0x40 /end MEASUREMENT
/begin MEASUREMENT fmy_stat_plaus_igk_bn.err_info_stat.err_sym "For each symptom: status of failure (set to 1 when failure symptom is detected)" UWORD _CNV_S_16_RANGE_ERR__485_CM 1 100. 0. 15. DISPLAY_IDENTIFIER ERR_SYM_PLAUS_IGK_BN ECU_ADDRESS 0xd000449e BIT_MASK 0x780 /end MEASUREMENT
/begin MEASUREMENT fmy_stat_tq_req_can.ctr_abc "anti-bounce counter for diagnosis XX" UBYTE _CNV_A_R_LINEAR_____0_CM 1 100. 0. 255. DISPLAY_IDENTIFIER CTR_ABC_TQ_REQ_CAN ECU_ADDRESS 0xd0004610 FORMAT "%3.0" /end MEASUREMENT
/begin MEASUREMENT fmy_stat_tq_req_can.ctr_end_diag "Counter for the end of diagnosis XX generation" UBYTE _CNV_A_R_LINEAR_____0_CM 1 100. 0. 255. DISPLAY_IDENTIFIER CTR_ABC_END_DIAG_TQ_REQ_CAN ECU_ADDRESS 0xd0004611 FORMAT "%3.0" /end MEASUREMENT
/begin MEASUREMENT fmy_stat_tq_req_can.err_info_stat.lv_err_mem "Failure is stored in dynamic memory (2nd layer)" UWORD _CNV_S_2_RANGE__0___1_CM 1 100. 0. 1. DISPLAY_IDENTIFIER LV_ERR_MEM_TQ_REQ_CAN ECU_ADDRESS 0xd0004612 BIT_MASK 0x8 /end MEASUREMENT
/begin MEASUREMENT fmy_stat_tq_req_can.err_info_stat.lv_ready "Readiness flag related to diagnosis XX" UWORD _CNV_S_2_RANGE__0___1_CM 1 100. 0. 1. DISPLAY_IDENTIFIER LV_READY_TQ_REQ_CAN ECU_ADDRESS 0xd0004612 BIT_MASK 0x10 /end MEASUREMENT
/begin MEASUREMENT fmy_stat_tq_req_can.err_info_stat.lv_end_diag "End of diagnosis XX" UWORD _CNV_S_2_RANGE__0___1_CM 1 100. 0. 1. DISPLAY_IDENTIFIER LV_END_DIAG_TQ_REQ_CAN ECU_ADDRESS 0xd0004612 BIT_MASK 0x20 /end MEASUREMENT
/begin MEASUREMENT fmy_stat_tq_req_can.err_info_stat.lv_cdn_diag "Diagnosis condition to start symptom detection (set to 1 when condition is fulfilled)" UWORD _CNV_S_2_RANGE__0___1_CM 1 100. 0. 1. DISPLAY_IDENTIFIER LV_CDN_DIAG_TQ_REQ_CAN ECU_ADDRESS 0xd0004612 BIT_MASK 0x40 /end MEASUREMENT
/begin MEASUREMENT fmy_stat_tq_req_can.err_info_stat.err_sym "For each symptom: status of failure (set to 1 when failure symptom is detected)" UWORD _CNV_S_16_RANGE_ERR__485_CM 1 100. 0. 15. DISPLAY_IDENTIFIER ERR_SYM_TQ_REQ_CAN ECU_ADDRESS 0xd0004612 BIT_MASK 0x780 /end MEASUREMENT
/begin MEASUREMENT fmy_stat_map_dip_sens.ctr_abc "anti-bounce counter for diagnosis XX" UBYTE _CNV_A_R_LINEAR_____0_CM 1 100. 0. 255. DISPLAY_IDENTIFIER CTR_ABC_MAP_DIP_SENS ECU_ADDRESS 0xd0004400 FORMAT "%3.0" /end MEASUREMENT
/begin MEASUREMENT fmy_stat_map_dip_sens.ctr_end_diag "Counter for the end of diagnosis XX generation" UBYTE _CNV_A_R_LINEAR_____0_CM 1 100. 0. 255. DISPLAY_IDENTIFIER CTR_ABC_END_DIAG_MAP_DIP_SENS ECU_ADDRESS 0xd0004401 FORMAT "%3.0" /end MEASUREMENT
/begin MEASUREMENT fmy_stat_map_dip_sens.err_info_stat.lv_err_mem "Failure is stored in dynamic memory (2nd layer)" UWORD _CNV_S_2_RANGE__0___1_CM 1 100. 0. 1. DISPLAY_IDENTIFIER LV_ERR_MEM_MAP_DIP_SENS ECU_ADDRESS 0xd0004402 BIT_MASK 0x8 /end MEASUREMENT
/begin MEASUREMENT fmy_stat_map_dip_sens.err_info_stat.lv_ready "Readiness flag related to diagnosis XX" UWORD _CNV_S_2_RANGE__0___1_CM 1 100. 0. 1. DISPLAY_IDENTIFIER LV_READY_MAP_DIP_SENS ECU_ADDRESS 0xd0004402 BIT_MASK 0x10 /end MEASUREMENT
/begin MEASUREMENT fmy_stat_map_dip_sens.err_info_stat.lv_end_diag "End of diagnosis XX" UWORD _CNV_S_2_RANGE__0___1_CM 1 100. 0. 1. DISPLAY_IDENTIFIER LV_END_DIAG_MAP_DIP_SENS ECU_ADDRESS 0xd0004402 BIT_MASK 0x20 /end MEASUREMENT
/begin MEASUREMENT fmy_stat_map_dip_sens.err_info_stat.lv_cdn_diag "Diagnosis condition to start symptom detection (set to 1 when condition is fulfilled)" UWORD _CNV_S_2_RANGE__0___1_CM 1 100. 0. 1. DISPLAY_IDENTIFIER LV_CDN_DIAG_MAP_DIP_SENS ECU_ADDRESS 0xd0004402 BIT_MASK 0x40 /end MEASUREMENT
/begin MEASUREMENT fmy_stat_map_dip_sens.err_info_stat.err_sym "For each symptom: status of failure (set to 1 when failure symptom is detected)" UWORD _CNV_S_16_RANGE_ERR__485_CM 1 100. 0. 15. DISPLAY_IDENTIFIER ERR_SYM_MAP_DIP_SENS ECU_ADDRESS 0xd0004402 BIT_MASK 0x780 /end MEASUREMENT
/begin MEASUREMENT fmy_stat_mec_ivvt_in.ctr_abc "anti-bounce counter for diagnosis XX" UBYTE _CNV_A_R_LINEAR_____0_CM 1 100. 0. 255. DISPLAY_IDENTIFIER CTR_ABC_MEC_IVVT_IN ECU_ADDRESS 0xd000440c FORMAT "%3.0" /end MEASUREMENT
/begin MEASUREMENT fmy_stat_mec_ivvt_in.ctr_end_diag "Counter for the end of diagnosis XX generation" UBYTE _CNV_A_R_LINEAR_____0_CM 1 100. 0. 255. DISPLAY_IDENTIFIER CTR_ABC_END_DIAG_MEC_IVVT_IN ECU_ADDRESS 0xd000440d FORMAT "%3.0" /end MEASUREMENT
/begin MEASUREMENT fmy_stat_mec_ivvt_in.err_info_stat.lv_err_mem "Failure is stored in dynamic memory (2nd layer)" UWORD _CNV_S_2_RANGE__0___1_CM 1 100. 0. 1. DISPLAY_IDENTIFIER LV_ERR_MEM_MEC_IVVT_IN ECU_ADDRESS 0xd000440e BIT_MASK 0x8 /end MEASUREMENT
/begin MEASUREMENT fmy_stat_mec_ivvt_in.err_info_stat.lv_ready "Readiness flag related to diagnosis XX" UWORD _CNV_S_2_RANGE__0___1_CM 1 100. 0. 1. DISPLAY_IDENTIFIER LV_READY_MEC_IVVT_IN ECU_ADDRESS 0xd000440e BIT_MASK 0x10 /end MEASUREMENT
/begin MEASUREMENT fmy_stat_mec_ivvt_in.err_info_stat.lv_end_diag "End of diagnosis XX" UWORD _CNV_S_2_RANGE__0___1_CM 1 100. 0. 1. DISPLAY_IDENTIFIER LV_END_DIAG_MEC_IVVT_IN ECU_ADDRESS 0xd000440e BIT_MASK 0x20 /end MEASUREMENT
/begin MEASUREMENT fmy_stat_mec_ivvt_in.err_info_stat.lv_cdn_diag "Diagnosis condition to start symptom detection (set to 1 when condition is fulfilled)" UWORD _CNV_S_2_RANGE__0___1_CM 1 100. 0. 1. DISPLAY_IDENTIFIER LV_CDN_DIAG_MEC_IVVT_IN ECU_ADDRESS 0xd000440e BIT_MASK 0x40 /end MEASUREMENT
/begin MEASUREMENT fmy_stat_mec_ivvt_in.err_info_stat.err_sym "For each symptom: status of failure (set to 1 when failure symptom is detected)" UWORD _CNV_S_16_RANGE_ERR__485_CM 1 100. 0. 15. DISPLAY_IDENTIFIER ERR_SYM_MEC_IVVT_IN ECU_ADDRESS 0xd000440e BIT_MASK 0x780 /end MEASUREMENT
/begin MEASUREMENT fmy_stat_mec_ivvt_ex.ctr_abc "anti-bounce counter for diagnosis XX" UBYTE _CNV_A_R_LINEAR_____0_CM 1 100. 0. 255. DISPLAY_IDENTIFIER CTR_ABC_MEC_IVVT_EX ECU_ADDRESS 0xd0004408 FORMAT "%3.0" /end MEASUREMENT
/begin MEASUREMENT fmy_stat_mec_ivvt_ex.ctr_end_diag "Counter for the end of diagnosis XX generation" UBYTE _CNV_A_R_LINEAR_____0_CM 1 100. 0. 255. DISPLAY_IDENTIFIER CTR_ABC_END_DIAG_MEC_IVVT_EX ECU_ADDRESS 0xd0004409 FORMAT "%3.0" /end MEASUREMENT
/begin MEASUREMENT fmy_stat_mec_ivvt_ex.err_info_stat.lv_err_mem "Failure is stored in dynamic memory (2nd layer)" UWORD _CNV_S_2_RANGE__0___1_CM 1 100. 0. 1. DISPLAY_IDENTIFIER LV_ERR_MEM_MEC_IVVT_EX ECU_ADDRESS 0xd000440a BIT_MASK 0x8 /end MEASUREMENT
/begin MEASUREMENT fmy_stat_mec_ivvt_ex.err_info_stat.lv_ready "Readiness flag related to diagnosis XX" UWORD _CNV_S_2_RANGE__0___1_CM 1 100. 0. 1. DISPLAY_IDENTIFIER LV_READY_MEC_IVVT_EX ECU_ADDRESS 0xd000440a BIT_MASK 0x10 /end MEASUREMENT
/begin MEASUREMENT fmy_stat_mec_ivvt_ex.err_info_stat.lv_end_diag "End of diagnosis XX" UWORD _CNV_S_2_RANGE__0___1_CM 1 100. 0. 1. DISPLAY_IDENTIFIER LV_END_DIAG_MEC_IVVT_EX ECU_ADDRESS 0xd000440a BIT_MASK 0x20 /end MEASUREMENT
/begin MEASUREMENT fmy_stat_mec_ivvt_ex.err_info_stat.lv_cdn_diag "Diagnosis condition to start symptom detection (set to 1 when condition is fulfilled)" UWORD _CNV_S_2_RANGE__0___1_CM 1 100. 0. 1. DISPLAY_IDENTIFIER LV_CDN_DIAG_MEC_IVVT_EX ECU_ADDRESS 0xd000440a BIT_MASK 0x40 /end MEASUREMENT
/begin MEASUREMENT fmy_stat_mec_ivvt_ex.err_info_stat.err_sym "For each symptom: status of failure (set to 1 when failure symptom is detected)" UWORD _CNV_S_16_RANGE_ERR__485_CM 1 100. 0. 15. DISPLAY_IDENTIFIER ERR_SYM_MEC_IVVT_EX ECU_ADDRESS 0xd000440a BIT_MASK 0x780 /end MEASUREMENT
/begin MEASUREMENT fmy_stat_tout_nox_sens_1.ctr_abc "anti-bounce counter for diagnosis XX" UBYTE _CNV_A_R_LINEAR_____0_CM 1 100. 0. 255. DISPLAY_IDENTIFIER CTR_ABC_TOUT_NOX_SENS_1 ECU_ADDRESS 0xd00045d8 FORMAT "%3.0" /end MEASUREMENT
/begin MEASUREMENT fmy_stat_tout_nox_sens_1.ctr_end_diag "Counter for the end of diagnosis XX generation" UBYTE _CNV_A_R_LINEAR_____0_CM 1 100. 0. 255. DISPLAY_IDENTIFIER CTR_ABC_END_DIAG_TOUT_NOX_SENS_1 ECU_ADDRESS 0xd00045d9 FORMAT "%3.0" /end MEASUREMENT
/begin MEASUREMENT fmy_stat_tout_nox_sens_1.err_info_stat.lv_err_mem "Failure is stored in dynamic memory (2nd layer)" UWORD _CNV_S_2_RANGE__0___1_CM 1 100. 0. 1. DISPLAY_IDENTIFIER LV_ERR_MEM_TOUT_NOX_SENS_1 ECU_ADDRESS 0xd00045da BIT_MASK 0x8 /end MEASUREMENT
/begin MEASUREMENT fmy_stat_tout_nox_sens_1.err_info_stat.lv_ready "Readiness flag related to diagnosis XX" UWORD _CNV_S_2_RANGE__0___1_CM 1 100. 0. 1. DISPLAY_IDENTIFIER LV_READY_TOUT_NOX_SENS_1 ECU_ADDRESS 0xd00045da BIT_MASK 0x10 /end MEASUREMENT
/begin MEASUREMENT fmy_stat_tout_nox_sens_1.err_info_stat.lv_end_diag "End of diagnosis XX" UWORD _CNV_S_2_RANGE__0___1_CM 1 100. 0. 1. DISPLAY_IDENTIFIER LV_END_DIAG_TOUT_NOX_SENS_1 ECU_ADDRESS 0xd00045da BIT_MASK 0x20 /end MEASUREMENT
/begin MEASUREMENT fmy_stat_tout_nox_sens_1.err_info_stat.lv_cdn_diag "Diagnosis condition to start symptom detection (set to 1 when condition is fulfilled)" UWORD _CNV_S_2_RANGE__0___1_CM 1 100. 0. 1. DISPLAY_IDENTIFIER LV_CDN_DIAG_TOUT_NOX_SENS_1 ECU_ADDRESS 0xd00045da BIT_MASK 0x40 /end MEASUREMENT
/begin MEASUREMENT fmy_stat_tout_nox_sens_1.err_info_stat.err_sym "For each symptom: status of failure (set to 1 when failure symptom is detected)" UWORD _CNV_S_16_RANGE_ERR__485_CM 1 100. 0. 15. DISPLAY_IDENTIFIER ERR_SYM_TOUT_NOX_SENS_1 ECU_ADDRESS 0xd00045da BIT_MASK 0x780 /end MEASUREMENT
/begin MEASUREMENT fmy_stat_tout_nox_sens_2.ctr_abc "anti-bounce counter for diagnosis XX" UBYTE _CNV_A_R_LINEAR_____0_CM 1 100. 0. 255. DISPLAY_IDENTIFIER CTR_ABC_TOUT_NOX_SENS_2 ECU_ADDRESS 0xd00045dc FORMAT "%3.0" /end MEASUREMENT
/begin MEASUREMENT fmy_stat_tout_nox_sens_2.ctr_end_diag "Counter for the end of diagnosis XX generation" UBYTE _CNV_A_R_LINEAR_____0_CM 1 100. 0. 255. DISPLAY_IDENTIFIER CTR_ABC_END_DIAG_TOUT_NOX_SENS_2 ECU_ADDRESS 0xd00045dd FORMAT "%3.0" /end MEASUREMENT
/begin MEASUREMENT fmy_stat_tout_nox_sens_2.err_info_stat.lv_err_mem "Failure is stored in dynamic memory (2nd layer)" UWORD _CNV_S_2_RANGE__0___1_CM 1 100. 0. 1. DISPLAY_IDENTIFIER LV_ERR_MEM_TOUT_NOX_SENS_2 ECU_ADDRESS 0xd00045de BIT_MASK 0x8 /end MEASUREMENT
/begin MEASUREMENT fmy_stat_tout_nox_sens_2.err_info_stat.lv_ready "Readiness flag related to diagnosis XX" UWORD _CNV_S_2_RANGE__0___1_CM 1 100. 0. 1. DISPLAY_IDENTIFIER LV_READY_TOUT_NOX_SENS_2 ECU_ADDRESS 0xd00045de BIT_MASK 0x10 /end MEASUREMENT
/begin MEASUREMENT fmy_stat_tout_nox_sens_2.err_info_stat.lv_end_diag "End of diagnosis XX" UWORD _CNV_S_2_RANGE__0___1_CM 1 100. 0. 1. DISPLAY_IDENTIFIER LV_END_DIAG_TOUT_NOX_SENS_2 ECU_ADDRESS 0xd00045de BIT_MASK 0x20 /end MEASUREMENT
/begin MEASUREMENT fmy_stat_tout_nox_sens_2.err_info_stat.lv_cdn_diag "Diagnosis condition to start symptom detection (set to 1 when condition is fulfilled)" UWORD _CNV_S_2_RANGE__0___1_CM 1 100. 0. 1. DISPLAY_IDENTIFIER LV_CDN_DIAG_TOUT_NOX_SENS_2 ECU_ADDRESS 0xd00045de BIT_MASK 0x40 /end MEASUREMENT
/begin MEASUREMENT fmy_stat_tout_nox_sens_2.err_info_stat.err_sym "For each symptom: status of failure (set to 1 when failure symptom is detected)" UWORD _CNV_S_16_RANGE_ERR__485_CM 1 100. 0. 15. DISPLAY_IDENTIFIER ERR_SYM_TOUT_NOX_SENS_2 ECU_ADDRESS 0xd00045de BIT_MASK 0x780 /end MEASUREMENT
/begin MEASUREMENT fmy_stat_vvl_rot.ctr_abc "anti-bounce counter for diagnosis XX" UBYTE _CNV_A_R_LINEAR_____0_CM 1 100. 0. 255. DISPLAY_IDENTIFIER CTR_ABC_VVL_ROT ECU_ADDRESS 0xd0004660 FORMAT "%3.0" /end MEASUREMENT
/begin MEASUREMENT fmy_stat_vvl_rot.ctr_end_diag "Counter for the end of diagnosis XX generation" UBYTE _CNV_A_R_LINEAR_____0_CM 1 100. 0. 255. DISPLAY_IDENTIFIER CTR_ABC_END_DIAG_VVL_ROT ECU_ADDRESS 0xd0004661 FORMAT "%3.0" /end MEASUREMENT
/begin MEASUREMENT fmy_stat_vvl_rot.err_info_stat.lv_err_mem "Failure is stored in dynamic memory (2nd layer)" UWORD _CNV_S_2_RANGE__0___1_CM 1 100. 0. 1. DISPLAY_IDENTIFIER LV_ERR_MEM_VVL_ROT ECU_ADDRESS 0xd0004662 BIT_MASK 0x8 /end MEASUREMENT
/begin MEASUREMENT fmy_stat_vvl_rot.err_info_stat.lv_ready "Readiness flag related to diagnosis XX" UWORD _CNV_S_2_RANGE__0___1_CM 1 100. 0. 1. DISPLAY_IDENTIFIER LV_READY_VVL_ROT ECU_ADDRESS 0xd0004662 BIT_MASK 0x10 /end MEASUREMENT
/begin MEASUREMENT fmy_stat_vvl_rot.err_info_stat.lv_end_diag "End of diagnosis XX" UWORD _CNV_S_2_RANGE__0___1_CM 1 100. 0. 1. DISPLAY_IDENTIFIER LV_END_DIAG_VVL_ROT ECU_ADDRESS 0xd0004662 BIT_MASK 0x20 /end MEASUREMENT
/begin MEASUREMENT fmy_stat_vvl_rot.err_info_stat.lv_cdn_diag "Diagnosis condition to start symptom detection (set to 1 when condition is fulfilled)" UWORD _CNV_S_2_RANGE__0___1_CM 1 100. 0. 1. DISPLAY_IDENTIFIER LV_CDN_DIAG_VVL_ROT ECU_ADDRESS 0xd0004662 BIT_MASK 0x40 /end MEASUREMENT
/begin MEASUREMENT fmy_stat_vvl_rot.err_info_stat.err_sym "For each symptom: status of failure (set to 1 when failure symptom is detected)" UWORD _CNV_S_16_RANGE_ERR__485_CM 1 100. 0. 15. DISPLAY_IDENTIFIER ERR_SYM_VVL_ROT ECU_ADDRESS 0xd0004662 BIT_MASK 0x780 /end MEASUREMENT
/begin MEASUREMENT fmy_stat_rly_vvl.ctr_abc "anti-bounce counter for diagnosis XX" UBYTE _CNV_A_R_LINEAR_____0_CM 1 100. 0. 255. DISPLAY_IDENTIFIER CTR_ABC_RLY_VVL ECU_ADDRESS 0xd0004504 FORMAT "%3.0" /end MEASUREMENT
/begin MEASUREMENT fmy_stat_rly_vvl.ctr_end_diag "Counter for the end of diagnosis XX generation" UBYTE _CNV_A_R_LINEAR_____0_CM 1 100. 0. 255. DISPLAY_IDENTIFIER CTR_ABC_END_DIAG_RLY_VVL ECU_ADDRESS 0xd0004505 FORMAT "%3.0" /end MEASUREMENT
/begin MEASUREMENT fmy_stat_rly_vvl.err_info_stat.lv_err_mem "Failure is stored in dynamic memory (2nd layer)" UWORD _CNV_S_2_RANGE__0___1_CM 1 100. 0. 1. DISPLAY_IDENTIFIER LV_ERR_MEM_RLY_VVL ECU_ADDRESS 0xd0004506 BIT_MASK 0x8 /end MEASUREMENT
/begin MEASUREMENT fmy_stat_rly_vvl.err_info_stat.lv_ready "Readiness flag related to diagnosis XX" UWORD _CNV_S_2_RANGE__0___1_CM 1 100. 0. 1. DISPLAY_IDENTIFIER LV_READY_RLY_VVL ECU_ADDRESS 0xd0004506 BIT_MASK 0x10 /end MEASUREMENT
/begin MEASUREMENT fmy_stat_rly_vvl.err_info_stat.lv_end_diag "End of diagnosis XX" UWORD _CNV_S_2_RANGE__0___1_CM 1 100. 0. 1. DISPLAY_IDENTIFIER LV_END_DIAG_RLY_VVL ECU_ADDRESS 0xd0004506 BIT_MASK 0x20 /end MEASUREMENT
/begin MEASUREMENT fmy_stat_rly_vvl.err_info_stat.lv_cdn_diag "Diagnosis condition to start symptom detection (set to 1 when condition is fulfilled)" UWORD _CNV_S_2_RANGE__0___1_CM 1 100. 0. 1. DISPLAY_IDENTIFIER LV_CDN_DIAG_RLY_VVL ECU_ADDRESS 0xd0004506 BIT_MASK 0x40 /end MEASUREMENT
/begin MEASUREMENT fmy_stat_rly_vvl.err_info_stat.err_sym "For each symptom: status of failure (set to 1 when failure symptom is detected)" UWORD _CNV_S_16_RANGE_ERR__485_CM 1 100. 0. 15. DISPLAY_IDENTIFIER ERR_SYM_RLY_VVL ECU_ADDRESS 0xd0004506 BIT_MASK 0x780 /end MEASUREMENT
/begin MEASUREMENT fmy_stat_nox_sens_1.ctr_abc "anti-bounce counter for diagnosis XX" UBYTE _CNV_A_R_LINEAR_____0_CM 1 100. 0. 255. DISPLAY_IDENTIFIER CTR_ABC_NOX_SENS_1 ECU_ADDRESS 0xd0004458 FORMAT "%3.0" /end MEASUREMENT
/begin MEASUREMENT fmy_stat_nox_sens_1.ctr_end_diag "Counter for the end of diagnosis XX generation" UBYTE _CNV_A_R_LINEAR_____0_CM 1 100. 0. 255. DISPLAY_IDENTIFIER CTR_ABC_END_DIAG_NOX_SENS_1 ECU_ADDRESS 0xd0004459 FORMAT "%3.0" /end MEASUREMENT
/begin MEASUREMENT fmy_stat_nox_sens_1.err_info_stat.lv_err_mem "Failure is stored in dynamic memory (2nd layer)" UWORD _CNV_S_2_RANGE__0___1_CM 1 100. 0. 1. DISPLAY_IDENTIFIER LV_ERR_MEM_NOX_SENS_1 ECU_ADDRESS 0xd000445a BIT_MASK 0x8 /end MEASUREMENT
/begin MEASUREMENT fmy_stat_nox_sens_1.err_info_stat.lv_ready "Readiness flag related to diagnosis XX" UWORD _CNV_S_2_RANGE__0___1_CM 1 100. 0. 1. DISPLAY_IDENTIFIER LV_READY_NOX_SENS_1 ECU_ADDRESS 0xd000445a BIT_MASK 0x10 /end MEASUREMENT
/begin MEASUREMENT fmy_stat_nox_sens_1.err_info_stat.lv_end_diag "End of diagnosis XX" UWORD _CNV_S_2_RANGE__0___1_CM 1 100. 0. 1. DISPLAY_IDENTIFIER LV_END_DIAG_NOX_SENS_1 ECU_ADDRESS 0xd000445a BIT_MASK 0x20 /end MEASUREMENT
/begin MEASUREMENT fmy_stat_nox_sens_1.err_info_stat.lv_cdn_diag "Diagnosis condition to start symptom detection (set to 1 when condition is fulfilled)" UWORD _CNV_S_2_RANGE__0___1_CM 1 100. 0. 1. DISPLAY_IDENTIFIER LV_CDN_DIAG_NOX_SENS_1 ECU_ADDRESS 0xd000445a BIT_MASK 0x40 /end MEASUREMENT
/begin MEASUREMENT fmy_stat_nox_sens_1.err_info_stat.err_sym "For each symptom: status of failure (set to 1 when failure symptom is detected)" UWORD _CNV_S_16_RANGE_ERR__485_CM 1 100. 0. 15. DISPLAY_IDENTIFIER ERR_SYM_NOX_SENS_1 ECU_ADDRESS 0xd000445a BIT_MASK 0x780 /end MEASUREMENT
/begin MEASUREMENT fmy_stat_ovl_ecu_vvl.ctr_abc "anti-bounce counter for diagnosis XX" UBYTE _CNV_A_R_LINEAR_____0_CM 1 100. 0. 255. DISPLAY_IDENTIFIER CTR_ABC_OVL_ECU_VVL ECU_ADDRESS 0xd0004488 FORMAT "%3.0" /end MEASUREMENT
/begin MEASUREMENT fmy_stat_ovl_ecu_vvl.ctr_end_diag "Counter for the end of diagnosis XX generation" UBYTE _CNV_A_R_LINEAR_____0_CM 1 100. 0. 255. DISPLAY_IDENTIFIER CTR_ABC_END_DIAG_OVL_ECU_VVL ECU_ADDRESS 0xd0004489 FORMAT "%3.0" /end MEASUREMENT
/begin MEASUREMENT fmy_stat_ovl_ecu_vvl.err_info_stat.lv_err_mem "Failure is stored in dynamic memory (2nd layer)" UWORD _CNV_S_2_RANGE__0___1_CM 1 100. 0. 1. DISPLAY_IDENTIFIER LV_ERR_MEM_OVL_ECU_VVL ECU_ADDRESS 0xd000448a BIT_MASK 0x8 /end MEASUREMENT
/begin MEASUREMENT fmy_stat_ovl_ecu_vvl.err_info_stat.lv_ready "Readiness flag related to diagnosis XX" UWORD _CNV_S_2_RANGE__0___1_CM 1 100. 0. 1. DISPLAY_IDENTIFIER LV_READY_OVL_ECU_VVL ECU_ADDRESS 0xd000448a BIT_MASK 0x10 /end MEASUREMENT
/begin MEASUREMENT fmy_stat_ovl_ecu_vvl.err_info_stat.lv_end_diag "End of diagnosis XX" UWORD _CNV_S_2_RANGE__0___1_CM 1 100. 0. 1. DISPLAY_IDENTIFIER LV_END_DIAG_OVL_ECU_VVL ECU_ADDRESS 0xd000448a BIT_MASK 0x20 /end MEASUREMENT
/begin MEASUREMENT fmy_stat_ovl_ecu_vvl.err_info_stat.lv_cdn_diag "Diagnosis condition to start symptom detection (set to 1 when condition is fulfilled)" UWORD _CNV_S_2_RANGE__0___1_CM 1 100. 0. 1. DISPLAY_IDENTIFIER LV_CDN_DIAG_OVL_ECU_VVL ECU_ADDRESS 0xd000448a BIT_MASK 0x40 /end MEASUREMENT
/begin MEASUREMENT fmy_stat_ovl_ecu_vvl.err_info_stat.err_sym "For each symptom: status of failure (set to 1 when failure symptom is detected)" UWORD _CNV_S_16_RANGE_ERR__485_CM 1 100. 0. 15. DISPLAY_IDENTIFIER ERR_SYM_OVL_ECU_VVL ECU_ADDRESS 0xd000448a BIT_MASK 0x780 /end MEASUREMENT
/begin MEASUREMENT fmy_stat_dr_sc_vvl.ctr_abc "anti-bounce counter for diagnosis XX" UBYTE _CNV_A_R_LINEAR_____0_CM 1 100. 0. 255. DISPLAY_IDENTIFIER CTR_ABC_DR_SC_VVL ECU_ADDRESS 0xd00042c0 FORMAT "%3.0" /end MEASUREMENT
/begin MEASUREMENT fmy_stat_dr_sc_vvl.ctr_end_diag "Counter for the end of diagnosis XX generation" UBYTE _CNV_A_R_LINEAR_____0_CM 1 100. 0. 255. DISPLAY_IDENTIFIER CTR_ABC_END_DIAG_DR_SC_VVL ECU_ADDRESS 0xd00042c1 FORMAT "%3.0" /end MEASUREMENT
/begin MEASUREMENT fmy_stat_dr_sc_vvl.err_info_stat.lv_err_mem "Failure is stored in dynamic memory (2nd layer)" UWORD _CNV_S_2_RANGE__0___1_CM 1 100. 0. 1. DISPLAY_IDENTIFIER LV_ERR_MEM_DR_SC_VVL ECU_ADDRESS 0xd00042c2 BIT_MASK 0x8 /end MEASUREMENT
/begin MEASUREMENT fmy_stat_dr_sc_vvl.err_info_stat.lv_ready "Readiness flag related to diagnosis XX" UWORD _CNV_S_2_RANGE__0___1_CM 1 100. 0. 1. DISPLAY_IDENTIFIER LV_READY_DR_SC_VVL ECU_ADDRESS 0xd00042c2 BIT_MASK 0x10 /end MEASUREMENT
/begin MEASUREMENT fmy_stat_dr_sc_vvl.err_info_stat.lv_end_diag "End of diagnosis XX" UWORD _CNV_S_2_RANGE__0___1_CM 1 100. 0. 1. DISPLAY_IDENTIFIER LV_END_DIAG_DR_SC_VVL ECU_ADDRESS 0xd00042c2 BIT_MASK 0x20 /end MEASUREMENT
/begin MEASUREMENT fmy_stat_dr_sc_vvl.err_info_stat.lv_cdn_diag "Diagnosis condition to start symptom detection (set to 1 when condition is fulfilled)" UWORD _CNV_S_2_RANGE__0___1_CM 1 100. 0. 1. DISPLAY_IDENTIFIER LV_CDN_DIAG_DR_SC_VVL ECU_ADDRESS 0xd00042c2 BIT_MASK 0x40 /end MEASUREMENT
/begin MEASUREMENT fmy_stat_dr_sc_vvl.err_info_stat.err_sym "For each symptom: status of failure (set to 1 when failure symptom is detected)" UWORD _CNV_S_16_RANGE_ERR__485_CM 1 100. 0. 15. DISPLAY_IDENTIFIER ERR_SYM_DR_SC_VVL ECU_ADDRESS 0xd00042c2 BIT_MASK 0x780 /end MEASUREMENT
/begin MEASUREMENT fmy_stat_crit_ovl_ecu_vvl.ctr_abc "anti-bounce counter for diagnosis XX" UBYTE _CNV_A_R_LINEAR_____0_CM 1 100. 0. 255. DISPLAY_IDENTIFIER CTR_ABC_CRIT_OVL_ECU_VVL ECU_ADDRESS 0xd000426c FORMAT "%3.0" /end MEASUREMENT
/begin MEASUREMENT fmy_stat_crit_ovl_ecu_vvl.ctr_end_diag "Counter for the end of diagnosis XX generation" UBYTE _CNV_A_R_LINEAR_____0_CM 1 100. 0. 255. DISPLAY_IDENTIFIER CTR_ABC_END_DIAG_CRIT_OVL_ECU_VVL ECU_ADDRESS 0xd000426d FORMAT "%3.0" /end MEASUREMENT
/begin MEASUREMENT fmy_stat_crit_ovl_ecu_vvl.err_info_stat.lv_err_mem "Failure is stored in dynamic memory (2nd layer)" UWORD _CNV_S_2_RANGE__0___1_CM 1 100. 0. 1. DISPLAY_IDENTIFIER LV_ERR_MEM_CRIT_OVL_ECU_VVL ECU_ADDRESS 0xd000426e BIT_MASK 0x8 /end MEASUREMENT
/begin MEASUREMENT fmy_stat_crit_ovl_ecu_vvl.err_info_stat.lv_ready "Readiness flag related to diagnosis XX" UWORD _CNV_S_2_RANGE__0___1_CM 1 100. 0. 1. DISPLAY_IDENTIFIER LV_READY_CRIT_OVL_ECU_VVL ECU_ADDRESS 0xd000426e BIT_MASK 0x10 /end MEASUREMENT
/begin MEASUREMENT fmy_stat_crit_ovl_ecu_vvl.err_info_stat.lv_end_diag "End of diagnosis XX" UWORD _CNV_S_2_RANGE__0___1_CM 1 100. 0. 1. DISPLAY_IDENTIFIER LV_END_DIAG_CRIT_OVL_ECU_VVL ECU_ADDRESS 0xd000426e BIT_MASK 0x20 /end MEASUREMENT
/begin MEASUREMENT fmy_stat_crit_ovl_ecu_vvl.err_info_stat.lv_cdn_diag "Diagnosis condition to start symptom detection (set to 1 when condition is fulfilled)" UWORD _CNV_S_2_RANGE__0___1_CM 1 100. 0. 1. DISPLAY_IDENTIFIER LV_CDN_DIAG_CRIT_OVL_ECU_VVL ECU_ADDRESS 0xd000426e BIT_MASK 0x40 /end MEASUREMENT
/begin MEASUREMENT fmy_stat_crit_ovl_ecu_vvl.err_info_stat.err_sym "For each symptom: status of failure (set to 1 when failure symptom is detected)" UWORD _CNV_S_16_RANGE_ERR__485_CM 1 100. 0. 15. DISPLAY_IDENTIFIER ERR_SYM_CRIT_OVL_ECU_VVL ECU_ADDRESS 0xd000426e BIT_MASK 0x780 /end MEASUREMENT
/begin MEASUREMENT fmy_stat_nox_sens_2.ctr_abc "anti-bounce counter for diagnosis XX" UBYTE _CNV_A_R_LINEAR_____0_CM 1 100. 0. 255. DISPLAY_IDENTIFIER CTR_ABC_NOX_SENS_2 ECU_ADDRESS 0xd000445c FORMAT "%3.0" /end MEASUREMENT
/begin MEASUREMENT fmy_stat_nox_sens_2.ctr_end_diag "Counter for the end of diagnosis XX generation" UBYTE _CNV_A_R_LINEAR_____0_CM 1 100. 0. 255. DISPLAY_IDENTIFIER CTR_ABC_END_DIAG_NOX_SENS_2 ECU_ADDRESS 0xd000445d FORMAT "%3.0" /end MEASUREMENT
/begin MEASUREMENT fmy_stat_nox_sens_2.err_info_stat.lv_err_mem "Failure is stored in dynamic memory (2nd layer)" UWORD _CNV_S_2_RANGE__0___1_CM 1 100. 0. 1. DISPLAY_IDENTIFIER LV_ERR_MEM_NOX_SENS_2 ECU_ADDRESS 0xd000445e BIT_MASK 0x8 /end MEASUREMENT
/begin MEASUREMENT fmy_stat_nox_sens_2.err_info_stat.lv_ready "Readiness flag related to diagnosis XX" UWORD _CNV_S_2_RANGE__0___1_CM 1 100. 0. 1. DISPLAY_IDENTIFIER LV_READY_NOX_SENS_2 ECU_ADDRESS 0xd000445e BIT_MASK 0x10 /end MEASUREMENT
/begin MEASUREMENT fmy_stat_nox_sens_2.err_info_stat.lv_end_diag "End of diagnosis XX" UWORD _CNV_S_2_RANGE__0___1_CM 1 100. 0. 1. DISPLAY_IDENTIFIER LV_END_DIAG_NOX_SENS_2 ECU_ADDRESS 0xd000445e BIT_MASK 0x20 /end MEASUREMENT
/begin MEASUREMENT fmy_stat_nox_sens_2.err_info_stat.lv_cdn_diag "Diagnosis condition to start symptom detection (set to 1 when condition is fulfilled)" UWORD _CNV_S_2_RANGE__0___1_CM 1 100. 0. 1. DISPLAY_IDENTIFIER LV_CDN_DIAG_NOX_SENS_2 ECU_ADDRESS 0xd000445e BIT_MASK 0x40 /end MEASUREMENT
/begin MEASUREMENT fmy_stat_nox_sens_2.err_info_stat.err_sym "For each symptom: status of failure (set to 1 when failure symptom is detected)" UWORD _CNV_S_16_RANGE_ERR__485_CM 1 100. 0. 15. DISPLAY_IDENTIFIER ERR_SYM_NOX_SENS_2 ECU_ADDRESS 0xd000445e BIT_MASK 0x780 /end MEASUREMENT
/begin MEASUREMENT fmy_stat_cur_h_vvl.ctr_abc "anti-bounce counter for diagnosis XX" UBYTE _CNV_A_R_LINEAR_____0_CM 1 100. 0. 255. DISPLAY_IDENTIFIER CTR_ABC_CUR_H_VVL ECU_ADDRESS 0xd0004288 FORMAT "%3.0" /end MEASUREMENT
/begin MEASUREMENT fmy_stat_cur_h_vvl.ctr_end_diag "Counter for the end of diagnosis XX generation" UBYTE _CNV_A_R_LINEAR_____0_CM 1 100. 0. 255. DISPLAY_IDENTIFIER CTR_ABC_END_DIAG_CUR_H_VVL ECU_ADDRESS 0xd0004289 FORMAT "%3.0" /end MEASUREMENT
/begin MEASUREMENT fmy_stat_cur_h_vvl.err_info_stat.lv_err_mem "Failure is stored in dynamic memory (2nd layer)" UWORD _CNV_S_2_RANGE__0___1_CM 1 100. 0. 1. DISPLAY_IDENTIFIER LV_ERR_MEM_CUR_H_VVL ECU_ADDRESS 0xd000428a BIT_MASK 0x8 /end MEASUREMENT
/begin MEASUREMENT fmy_stat_cur_h_vvl.err_info_stat.lv_ready "Readiness flag related to diagnosis XX" UWORD _CNV_S_2_RANGE__0___1_CM 1 100. 0. 1. DISPLAY_IDENTIFIER LV_READY_CUR_H_VVL ECU_ADDRESS 0xd000428a BIT_MASK 0x10 /end MEASUREMENT
/begin MEASUREMENT fmy_stat_cur_h_vvl.err_info_stat.lv_end_diag "End of diagnosis XX" UWORD _CNV_S_2_RANGE__0___1_CM 1 100. 0. 1. DISPLAY_IDENTIFIER LV_END_DIAG_CUR_H_VVL ECU_ADDRESS 0xd000428a BIT_MASK 0x20 /end MEASUREMENT
/begin MEASUREMENT fmy_stat_cur_h_vvl.err_info_stat.lv_cdn_diag "Diagnosis condition to start symptom detection (set to 1 when condition is fulfilled)" UWORD _CNV_S_2_RANGE__0___1_CM 1 100. 0. 1. DISPLAY_IDENTIFIER LV_CDN_DIAG_CUR_H_VVL ECU_ADDRESS 0xd000428a BIT_MASK 0x40 /end MEASUREMENT
/begin MEASUREMENT fmy_stat_cur_h_vvl.err_info_stat.err_sym "For each symptom: status of failure (set to 1 when failure symptom is detected)" UWORD _CNV_S_16_RANGE_ERR__485_CM 1 100. 0. 15. DISPLAY_IDENTIFIER ERR_SYM_CUR_H_VVL ECU_ADDRESS 0xd000428a BIT_MASK 0x780 /end MEASUREMENT
/begin MEASUREMENT fmy_stat_teg_pcat_down_1.ctr_abc "anti-bounce counter for diagnosis XX" UBYTE _CNV_A_R_LINEAR_____0_CM 1 100. 0. 255. DISPLAY_IDENTIFIER CTR_ABC_TEG_PCAT_DOWN_1 ECU_ADDRESS 0xd000459c FORMAT "%3.0" /end MEASUREMENT
/begin MEASUREMENT fmy_stat_teg_pcat_down_1.ctr_end_diag "Counter for the end of diagnosis XX generation" UBYTE _CNV_A_R_LINEAR_____0_CM 1 100. 0. 255. DISPLAY_IDENTIFIER CTR_ABC_END_DIAG_TEG_PCAT_DOWN_1 ECU_ADDRESS 0xd000459d FORMAT "%3.0" /end MEASUREMENT
/begin MEASUREMENT fmy_stat_teg_pcat_down_1.err_info_stat.lv_err_mem "Failure is stored in dynamic memory (2nd layer)" UWORD _CNV_S_2_RANGE__0___1_CM 1 100. 0. 1. DISPLAY_IDENTIFIER LV_ERR_MEM_TEG_PCAT_DOWN_1 ECU_ADDRESS 0xd000459e BIT_MASK 0x8 /end MEASUREMENT
/begin MEASUREMENT fmy_stat_teg_pcat_down_1.err_info_stat.lv_ready "Readiness flag related to diagnosis XX" UWORD _CNV_S_2_RANGE__0___1_CM 1 100. 0. 1. DISPLAY_IDENTIFIER LV_READY_TEG_PCAT_DOWN_1 ECU_ADDRESS 0xd000459e BIT_MASK 0x10 /end MEASUREMENT
/begin MEASUREMENT fmy_stat_teg_pcat_down_1.err_info_stat.lv_end_diag "End of diagnosis XX" UWORD _CNV_S_2_RANGE__0___1_CM 1 100. 0. 1. DISPLAY_IDENTIFIER LV_END_DIAG_TEG_PCAT_DOWN_1 ECU_ADDRESS 0xd000459e BIT_MASK 0x20 /end MEASUREMENT
/begin MEASUREMENT fmy_stat_teg_pcat_down_1.err_info_stat.lv_cdn_diag "Diagnosis condition to start symptom detection (set to 1 when condition is fulfilled)" UWORD _CNV_S_2_RANGE__0___1_CM 1 100. 0. 1. DISPLAY_IDENTIFIER LV_CDN_DIAG_TEG_PCAT_DOWN_1 ECU_ADDRESS 0xd000459e BIT_MASK 0x40 /end MEASUREMENT
/begin MEASUREMENT fmy_stat_teg_pcat_down_1.err_info_stat.err_sym "For each symptom: status of failure (set to 1 when failure symptom is detected)" UWORD _CNV_S_16_RANGE_ERR__485_CM 1 100. 0. 15. DISPLAY_IDENTIFIER ERR_SYM_TEG_PCAT_DOWN_1 ECU_ADDRESS 0xd000459e BIT_MASK 0x780 /end MEASUREMENT
/begin MEASUREMENT fmy_stat_teg_pcat_down_2.ctr_abc "anti-bounce counter for diagnosis XX" UBYTE _CNV_A_R_LINEAR_____0_CM 1 100. 0. 255. DISPLAY_IDENTIFIER CTR_ABC_TEG_PCAT_DOWN_2 ECU_ADDRESS 0xd00045a0 FORMAT "%3.0" /end MEASUREMENT
/begin MEASUREMENT fmy_stat_teg_pcat_down_2.ctr_end_diag "Counter for the end of diagnosis XX generation" UBYTE _CNV_A_R_LINEAR_____0_CM 1 100. 0. 255. DISPLAY_IDENTIFIER CTR_ABC_END_DIAG_TEG_PCAT_DOWN_2 ECU_ADDRESS 0xd00045a1 FORMAT "%3.0" /end MEASUREMENT
/begin MEASUREMENT fmy_stat_teg_pcat_down_2.err_info_stat.lv_err_mem "Failure is stored in dynamic memory (2nd layer)" UWORD _CNV_S_2_RANGE__0___1_CM 1 100. 0. 1. DISPLAY_IDENTIFIER LV_ERR_MEM_TEG_PCAT_DOWN_2 ECU_ADDRESS 0xd00045a2 BIT_MASK 0x8 /end MEASUREMENT
/begin MEASUREMENT fmy_stat_teg_pcat_down_2.err_info_stat.lv_ready "Readiness flag related to diagnosis XX" UWORD _CNV_S_2_RANGE__0___1_CM 1 100. 0. 1. DISPLAY_IDENTIFIER LV_READY_TEG_PCAT_DOWN_2 ECU_ADDRESS 0xd00045a2 BIT_MASK 0x10 /end MEASUREMENT
/begin MEASUREMENT fmy_stat_teg_pcat_down_2.err_info_stat.lv_end_diag "End of diagnosis XX" UWORD _CNV_S_2_RANGE__0___1_CM 1 100. 0. 1. DISPLAY_IDENTIFIER LV_END_DIAG_TEG_PCAT_DOWN_2 ECU_ADDRESS 0xd00045a2 BIT_MASK 0x20 /end MEASUREMENT
/begin MEASUREMENT fmy_stat_teg_pcat_down_2.err_info_stat.lv_cdn_diag "Diagnosis condition to start symptom detection (set to 1 when condition is fulfilled)" UWORD _CNV_S_2_RANGE__0___1_CM 1 100. 0. 1. DISPLAY_IDENTIFIER LV_CDN_DIAG_TEG_PCAT_DOWN_2 ECU_ADDRESS 0xd00045a2 BIT_MASK 0x40 /end MEASUREMENT
/begin MEASUREMENT fmy_stat_teg_pcat_down_2.err_info_stat.err_sym "For each symptom: status of failure (set to 1 when failure symptom is detected)" UWORD _CNV_S_16_RANGE_ERR__485_CM 1 100. 0. 15. DISPLAY_IDENTIFIER ERR_SYM_TEG_PCAT_DOWN_2 ECU_ADDRESS 0xd00045a2 BIT_MASK 0x780 /end MEASUREMENT
/begin MEASUREMENT fmy_stat_t_seg_er.ctr_abc "anti-bounce counter for diagnosis XX" UBYTE _CNV_A_R_LINEAR_____0_CM 1 100. 0. 255. DISPLAY_IDENTIFIER CTR_ABC_T_SEG_ER ECU_ADDRESS 0xd0004570 FORMAT "%3.0" /end MEASUREMENT
/begin MEASUREMENT fmy_stat_t_seg_er.ctr_end_diag "Counter for the end of diagnosis XX generation" UBYTE _CNV_A_R_LINEAR_____0_CM 1 100. 0. 255. DISPLAY_IDENTIFIER CTR_ABC_END_DIAG_T_SEG_ER ECU_ADDRESS 0xd0004571 FORMAT "%3.0" /end MEASUREMENT
/begin MEASUREMENT fmy_stat_t_seg_er.err_info_stat.lv_err_mem "Failure is stored in dynamic memory (2nd layer)" UWORD _CNV_S_2_RANGE__0___1_CM 1 100. 0. 1. DISPLAY_IDENTIFIER LV_ERR_MEM_T_SEG_ER ECU_ADDRESS 0xd0004572 BIT_MASK 0x8 /end MEASUREMENT
/begin MEASUREMENT fmy_stat_t_seg_er.err_info_stat.lv_ready "Readiness flag related to diagnosis XX" UWORD _CNV_S_2_RANGE__0___1_CM 1 100. 0. 1. DISPLAY_IDENTIFIER LV_READY_T_SEG_ER ECU_ADDRESS 0xd0004572 BIT_MASK 0x10 /end MEASUREMENT
/begin MEASUREMENT fmy_stat_t_seg_er.err_info_stat.lv_end_diag "End of diagnosis XX" UWORD _CNV_S_2_RANGE__0___1_CM 1 100. 0. 1. DISPLAY_IDENTIFIER LV_END_DIAG_T_SEG_ER ECU_ADDRESS 0xd0004572 BIT_MASK 0x20 /end MEASUREMENT
/begin MEASUREMENT fmy_stat_t_seg_er.err_info_stat.lv_cdn_diag "Diagnosis condition to start symptom detection (set to 1 when condition is fulfilled)" UWORD _CNV_S_2_RANGE__0___1_CM 1 100. 0. 1. DISPLAY_IDENTIFIER LV_CDN_DIAG_T_SEG_ER ECU_ADDRESS 0xd0004572 BIT_MASK 0x40 /end MEASUREMENT
/begin MEASUREMENT fmy_stat_t_seg_er.err_info_stat.err_sym "For each symptom: status of failure (set to 1 when failure symptom is detected)" UWORD _CNV_S_16_RANGE_ERR__485_CM 1 100. 0. 15. DISPLAY_IDENTIFIER ERR_SYM_T_SEG_ER ECU_ADDRESS 0xd0004572 BIT_MASK 0x780 /end MEASUREMENT
/begin MEASUREMENT fmy_stat_seg_ad_er.ctr_abc "anti-bounce counter for diagnosis XX" UBYTE _CNV_A_R_LINEAR_____0_CM 1 100. 0. 255. DISPLAY_IDENTIFIER CTR_ABC_SEG_AD_ER ECU_ADDRESS 0xd000451c FORMAT "%3.0" /end MEASUREMENT
/begin MEASUREMENT fmy_stat_seg_ad_er.ctr_end_diag "Counter for the end of diagnosis XX generation" UBYTE _CNV_A_R_LINEAR_____0_CM 1 100. 0. 255. DISPLAY_IDENTIFIER CTR_ABC_END_DIAG_SEG_AD_ER ECU_ADDRESS 0xd000451d FORMAT "%3.0" /end MEASUREMENT
/begin MEASUREMENT fmy_stat_seg_ad_er.err_info_stat.lv_err_mem "Failure is stored in dynamic memory (2nd layer)" UWORD _CNV_S_2_RANGE__0___1_CM 1 100. 0. 1. DISPLAY_IDENTIFIER LV_ERR_MEM_SEG_AD_ER ECU_ADDRESS 0xd000451e BIT_MASK 0x8 /end MEASUREMENT
/begin MEASUREMENT fmy_stat_seg_ad_er.err_info_stat.lv_ready "Readiness flag related to diagnosis XX" UWORD _CNV_S_2_RANGE__0___1_CM 1 100. 0. 1. DISPLAY_IDENTIFIER LV_READY_SEG_AD_ER ECU_ADDRESS 0xd000451e BIT_MASK 0x10 /end MEASUREMENT
/begin MEASUREMENT fmy_stat_seg_ad_er.err_info_stat.lv_end_diag "End of diagnosis XX" UWORD _CNV_S_2_RANGE__0___1_CM 1 100. 0. 1. DISPLAY_IDENTIFIER LV_END_DIAG_SEG_AD_ER ECU_ADDRESS 0xd000451e BIT_MASK 0x20 /end MEASUREMENT
/begin MEASUREMENT fmy_stat_seg_ad_er.err_info_stat.lv_cdn_diag "Diagnosis condition to start symptom detection (set to 1 when condition is fulfilled)" UWORD _CNV_S_2_RANGE__0___1_CM 1 100. 0. 1. DISPLAY_IDENTIFIER LV_CDN_DIAG_SEG_AD_ER ECU_ADDRESS 0xd000451e BIT_MASK 0x40 /end MEASUREMENT
/begin MEASUREMENT fmy_stat_seg_ad_er.err_info_stat.err_sym "For each symptom: status of failure (set to 1 when failure symptom is detected)" UWORD _CNV_S_16_RANGE_ERR__485_CM 1 100. 0. 15. DISPLAY_IDENTIFIER ERR_SYM_SEG_AD_ER ECU_ADDRESS 0xd000451e BIT_MASK 0x780 /end MEASUREMENT
/begin MEASUREMENT fmy_stat_vs_plaus.ctr_abc "anti-bounce counter for diagnosis XX" UBYTE _CNV_A_R_LINEAR_____0_CM 1 100. 0. 255. DISPLAY_IDENTIFIER CTR_ABC_VS_PLAUS ECU_ADDRESS 0xd000465c FORMAT "%3.0" /end MEASUREMENT
/begin MEASUREMENT fmy_stat_vs_plaus.ctr_end_diag "Counter for the end of diagnosis XX generation" UBYTE _CNV_A_R_LINEAR_____0_CM 1 100. 0. 255. DISPLAY_IDENTIFIER CTR_ABC_END_DIAG_VS_PLAUS ECU_ADDRESS 0xd000465d FORMAT "%3.0" /end MEASUREMENT
/begin MEASUREMENT fmy_stat_vs_plaus.err_info_stat.lv_err_mem "Failure is stored in dynamic memory (2nd layer)" UWORD _CNV_S_2_RANGE__0___1_CM 1 100. 0. 1. DISPLAY_IDENTIFIER LV_ERR_MEM_VS_PLAUS ECU_ADDRESS 0xd000465e BIT_MASK 0x8 /end MEASUREMENT
/begin MEASUREMENT fmy_stat_vs_plaus.err_info_stat.lv_ready "Readiness flag related to diagnosis XX" UWORD _CNV_S_2_RANGE__0___1_CM 1 100. 0. 1. DISPLAY_IDENTIFIER LV_READY_VS_PLAUS ECU_ADDRESS 0xd000465e BIT_MASK 0x10 /end MEASUREMENT
/begin MEASUREMENT fmy_stat_vs_plaus.err_info_stat.lv_end_diag "End of diagnosis XX" UWORD _CNV_S_2_RANGE__0___1_CM 1 100. 0. 1. DISPLAY_IDENTIFIER LV_END_DIAG_VS_PLAUS ECU_ADDRESS 0xd000465e BIT_MASK 0x20 /end MEASUREMENT
/begin MEASUREMENT fmy_stat_vs_plaus.err_info_stat.lv_cdn_diag "Diagnosis condition to start symptom detection (set to 1 when condition is fulfilled)" UWORD _CNV_S_2_RANGE__0___1_CM 1 100. 0. 1. DISPLAY_IDENTIFIER LV_CDN_DIAG_VS_PLAUS ECU_ADDRESS 0xd000465e BIT_MASK 0x40 /end MEASUREMENT
/begin MEASUREMENT fmy_stat_vs_plaus.err_info_stat.err_sym "For each symptom: status of failure (set to 1 when failure symptom is detected)" UWORD _CNV_S_16_RANGE_ERR__485_CM 1 100. 0. 15. DISPLAY_IDENTIFIER ERR_SYM_VS_PLAUS ECU_ADDRESS 0xd000465e BIT_MASK 0x780 /end MEASUREMENT
/begin MEASUREMENT fmy_stat_ftl_obd.ctr_abc "anti-bounce counter for diagnosis XX" UBYTE _CNV_A_R_LINEAR_____0_CM 1 100. 0. 255. DISPLAY_IDENTIFIER CTR_ABC_FTL_OBD ECU_ADDRESS 0xd0004328 FORMAT "%3.0" /end MEASUREMENT
/begin MEASUREMENT fmy_stat_ftl_obd.ctr_end_diag "Counter for the end of diagnosis XX generation" UBYTE _CNV_A_R_LINEAR_____0_CM 1 100. 0. 255. DISPLAY_IDENTIFIER CTR_ABC_END_DIAG_FTL_OBD ECU_ADDRESS 0xd0004329 FORMAT "%3.0" /end MEASUREMENT
/begin MEASUREMENT fmy_stat_ftl_obd.err_info_stat.lv_err_mem "Failure is stored in dynamic memory (2nd layer)" UWORD _CNV_S_2_RANGE__0___1_CM 1 100. 0. 1. DISPLAY_IDENTIFIER LV_ERR_MEM_FTL_OBD ECU_ADDRESS 0xd000432a BIT_MASK 0x8 /end MEASUREMENT
/begin MEASUREMENT fmy_stat_ftl_obd.err_info_stat.lv_ready "Readiness flag related to diagnosis XX" UWORD _CNV_S_2_RANGE__0___1_CM 1 100. 0. 1. DISPLAY_IDENTIFIER LV_READY_FTL_OBD ECU_ADDRESS 0xd000432a BIT_MASK 0x10 /end MEASUREMENT
/begin MEASUREMENT fmy_stat_ftl_obd.err_info_stat.lv_end_diag "End of diagnosis XX" UWORD _CNV_S_2_RANGE__0___1_CM 1 100. 0. 1. DISPLAY_IDENTIFIER LV_END_DIAG_FTL_OBD ECU_ADDRESS 0xd000432a BIT_MASK 0x20 /end MEASUREMENT
/begin MEASUREMENT fmy_stat_ftl_obd.err_info_stat.lv_cdn_diag "Diagnosis condition to start symptom detection (set to 1 when condition is fulfilled)" UWORD _CNV_S_2_RANGE__0___1_CM 1 100. 0. 1. DISPLAY_IDENTIFIER LV_CDN_DIAG_FTL_OBD ECU_ADDRESS 0xd000432a BIT_MASK 0x40 /end MEASUREMENT
/begin MEASUREMENT fmy_stat_ftl_obd.err_info_stat.err_sym "For each symptom: status of failure (set to 1 when failure symptom is detected)" UWORD _CNV_S_16_RANGE_ERR__485_CM 1 100. 0. 15. DISPLAY_IDENTIFIER ERR_SYM_FTL_OBD ECU_ADDRESS 0xd000432a BIT_MASK 0x780 /end MEASUREMENT
/begin MEASUREMENT fmy_stat_ftl_can.ctr_abc "anti-bounce counter for diagnosis XX" UBYTE _CNV_A_R_LINEAR_____0_CM 1 100. 0. 255. DISPLAY_IDENTIFIER CTR_ABC_FTL_CAN ECU_ADDRESS 0xd0004320 FORMAT "%3.0" /end MEASUREMENT
/begin MEASUREMENT fmy_stat_ftl_can.ctr_end_diag "Counter for the end of diagnosis XX generation" UBYTE _CNV_A_R_LINEAR_____0_CM 1 100. 0. 255. DISPLAY_IDENTIFIER CTR_ABC_END_DIAG_FTL_CAN ECU_ADDRESS 0xd0004321 FORMAT "%3.0" /end MEASUREMENT
/begin MEASUREMENT fmy_stat_ftl_can.err_info_stat.lv_err_mem "Failure is stored in dynamic memory (2nd layer)" UWORD _CNV_S_2_RANGE__0___1_CM 1 100. 0. 1. DISPLAY_IDENTIFIER LV_ERR_MEM_FTL_CAN ECU_ADDRESS 0xd0004322 BIT_MASK 0x8 /end MEASUREMENT
/begin MEASUREMENT fmy_stat_ftl_can.err_info_stat.lv_ready "Readiness flag related to diagnosis XX" UWORD _CNV_S_2_RANGE__0___1_CM 1 100. 0. 1. DISPLAY_IDENTIFIER LV_READY_FTL_CAN ECU_ADDRESS 0xd0004322 BIT_MASK 0x10 /end MEASUREMENT
/begin MEASUREMENT fmy_stat_ftl_can.err_info_stat.lv_end_diag "End of diagnosis XX" UWORD _CNV_S_2_RANGE__0___1_CM 1 100. 0. 1. DISPLAY_IDENTIFIER LV_END_DIAG_FTL_CAN ECU_ADDRESS 0xd0004322 BIT_MASK 0x20 /end MEASUREMENT
/begin MEASUREMENT fmy_stat_ftl_can.err_info_stat.lv_cdn_diag "Diagnosis condition to start symptom detection (set to 1 when condition is fulfilled)" UWORD _CNV_S_2_RANGE__0___1_CM 1 100. 0. 1. DISPLAY_IDENTIFIER LV_CDN_DIAG_FTL_CAN ECU_ADDRESS 0xd0004322 BIT_MASK 0x40 /end MEASUREMENT
/begin MEASUREMENT fmy_stat_ftl_can.err_info_stat.err_sym "For each symptom: status of failure (set to 1 when failure symptom is detected)" UWORD _CNV_S_16_RANGE_ERR__485_CM 1 100. 0. 15. DISPLAY_IDENTIFIER ERR_SYM_FTL_CAN ECU_ADDRESS 0xd0004322 BIT_MASK 0x780 /end MEASUREMENT
/begin MEASUREMENT fmy_stat_tia_plaus.ctr_abc "anti-bounce counter for diagnosis XX" UBYTE _CNV_A_R_LINEAR_____0_CM 1 100. 0. 255. DISPLAY_IDENTIFIER CTR_ABC_TIA_PLAUS ECU_ADDRESS 0xd00045ac FORMAT "%3.0" /end MEASUREMENT
/begin MEASUREMENT fmy_stat_tia_plaus.ctr_end_diag "Counter for the end of diagnosis XX generation" UBYTE _CNV_A_R_LINEAR_____0_CM 1 100. 0. 255. DISPLAY_IDENTIFIER CTR_ABC_END_DIAG_TIA_PLAUS ECU_ADDRESS 0xd00045ad FORMAT "%3.0" /end MEASUREMENT
/begin MEASUREMENT fmy_stat_tia_plaus.err_info_stat.lv_err_mem "Failure is stored in dynamic memory (2nd layer)" UWORD _CNV_S_2_RANGE__0___1_CM 1 100. 0. 1. DISPLAY_IDENTIFIER LV_ERR_MEM_TIA_PLAUS ECU_ADDRESS 0xd00045ae BIT_MASK 0x8 /end MEASUREMENT
/begin MEASUREMENT fmy_stat_tia_plaus.err_info_stat.lv_ready "Readiness flag related to diagnosis XX" UWORD _CNV_S_2_RANGE__0___1_CM 1 100. 0. 1. DISPLAY_IDENTIFIER LV_READY_TIA_PLAUS ECU_ADDRESS 0xd00045ae BIT_MASK 0x10 /end MEASUREMENT
/begin MEASUREMENT fmy_stat_tia_plaus.err_info_stat.lv_end_diag "End of diagnosis XX" UWORD _CNV_S_2_RANGE__0___1_CM 1 100. 0. 1. DISPLAY_IDENTIFIER LV_END_DIAG_TIA_PLAUS ECU_ADDRESS 0xd00045ae BIT_MASK 0x20 /end MEASUREMENT
/begin MEASUREMENT fmy_stat_tia_plaus.err_info_stat.lv_cdn_diag "Diagnosis condition to start symptom detection (set to 1 when condition is fulfilled)" UWORD _CNV_S_2_RANGE__0___1_CM 1 100. 0. 1. DISPLAY_IDENTIFIER LV_CDN_DIAG_TIA_PLAUS ECU_ADDRESS 0xd00045ae BIT_MASK 0x40 /end MEASUREMENT
/begin MEASUREMENT fmy_stat_tia_plaus.err_info_stat.err_sym "For each symptom: status of failure (set to 1 when failure symptom is detected)" UWORD _CNV_S_16_RANGE_ERR__485_CM 1 100. 0. 15. DISPLAY_IDENTIFIER ERR_SYM_TIA_PLAUS ECU_ADDRESS 0xd00045ae BIT_MASK 0x780 /end MEASUREMENT
/begin MEASUREMENT fmy_stat_tam_can.ctr_abc "anti-bounce counter for diagnosis XX" UBYTE _CNV_A_R_LINEAR_____0_CM 1 100. 0. 255. DISPLAY_IDENTIFIER CTR_ABC_TAM_CAN ECU_ADDRESS 0xd0004574 FORMAT "%3.0" /end MEASUREMENT
/begin MEASUREMENT fmy_stat_tam_can.ctr_end_diag "Counter for the end of diagnosis XX generation" UBYTE _CNV_A_R_LINEAR_____0_CM 1 100. 0. 255. DISPLAY_IDENTIFIER CTR_ABC_END_DIAG_TAM_CAN ECU_ADDRESS 0xd0004575 FORMAT "%3.0" /end MEASUREMENT
/begin MEASUREMENT fmy_stat_tam_can.err_info_stat.lv_err_mem "Failure is stored in dynamic memory (2nd layer)" UWORD _CNV_S_2_RANGE__0___1_CM 1 100. 0. 1. DISPLAY_IDENTIFIER LV_ERR_MEM_TAM_CAN ECU_ADDRESS 0xd0004576 BIT_MASK 0x8 /end MEASUREMENT
/begin MEASUREMENT fmy_stat_tam_can.err_info_stat.lv_ready "Readiness flag related to diagnosis XX" UWORD _CNV_S_2_RANGE__0___1_CM 1 100. 0. 1. DISPLAY_IDENTIFIER LV_READY_TAM_CAN ECU_ADDRESS 0xd0004576 BIT_MASK 0x10 /end MEASUREMENT
/begin MEASUREMENT fmy_stat_tam_can.err_info_stat.lv_end_diag "End of diagnosis XX" UWORD _CNV_S_2_RANGE__0___1_CM 1 100. 0. 1. DISPLAY_IDENTIFIER LV_END_DIAG_TAM_CAN ECU_ADDRESS 0xd0004576 BIT_MASK 0x20 /end MEASUREMENT
/begin MEASUREMENT fmy_stat_tam_can.err_info_stat.lv_cdn_diag "Diagnosis condition to start symptom detection (set to 1 when condition is fulfilled)" UWORD _CNV_S_2_RANGE__0___1_CM 1 100. 0. 1. DISPLAY_IDENTIFIER LV_CDN_DIAG_TAM_CAN ECU_ADDRESS 0xd0004576 BIT_MASK 0x40 /end MEASUREMENT
/begin MEASUREMENT fmy_stat_tam_can.err_info_stat.err_sym "For each symptom: status of failure (set to 1 when failure symptom is detected)" UWORD _CNV_S_16_RANGE_ERR__485_CM 1 100. 0. 15. DISPLAY_IDENTIFIER ERR_SYM_TAM_CAN ECU_ADDRESS 0xd0004576 BIT_MASK 0x780 /end MEASUREMENT
/begin MEASUREMENT fmy_stat_tam_plaus.ctr_abc "anti-bounce counter for diagnosis XX" UBYTE _CNV_A_R_LINEAR_____0_CM 1 100. 0. 255. DISPLAY_IDENTIFIER CTR_ABC_TAM_PLAUS ECU_ADDRESS 0xd0004578 FORMAT "%3.0" /end MEASUREMENT
/begin MEASUREMENT fmy_stat_tam_plaus.ctr_end_diag "Counter for the end of diagnosis XX generation" UBYTE _CNV_A_R_LINEAR_____0_CM 1 100. 0. 255. DISPLAY_IDENTIFIER CTR_ABC_END_DIAG_TAM_PLAUS ECU_ADDRESS 0xd0004579 FORMAT "%3.0" /end MEASUREMENT
/begin MEASUREMENT fmy_stat_tam_plaus.err_info_stat.lv_err_mem "Failure is stored in dynamic memory (2nd layer)" UWORD _CNV_S_2_RANGE__0___1_CM 1 100. 0. 1. DISPLAY_IDENTIFIER LV_ERR_MEM_TAM_PLAUS ECU_ADDRESS 0xd000457a BIT_MASK 0x8 /end MEASUREMENT
/begin MEASUREMENT fmy_stat_tam_plaus.err_info_stat.lv_ready "Readiness flag related to diagnosis XX" UWORD _CNV_S_2_RANGE__0___1_CM 1 100. 0. 1. DISPLAY_IDENTIFIER LV_READY_TAM_PLAUS ECU_ADDRESS 0xd000457a BIT_MASK 0x10 /end MEASUREMENT
/begin MEASUREMENT fmy_stat_tam_plaus.err_info_stat.lv_end_diag "End of diagnosis XX" UWORD _CNV_S_2_RANGE__0___1_CM 1 100. 0. 1. DISPLAY_IDENTIFIER LV_END_DIAG_TAM_PLAUS ECU_ADDRESS 0xd000457a BIT_MASK 0x20 /end MEASUREMENT
/begin MEASUREMENT fmy_stat_tam_plaus.err_info_stat.lv_cdn_diag "Diagnosis condition to start symptom detection (set to 1 when condition is fulfilled)" UWORD _CNV_S_2_RANGE__0___1_CM 1 100. 0. 1. DISPLAY_IDENTIFIER LV_CDN_DIAG_TAM_PLAUS ECU_ADDRESS 0xd000457a BIT_MASK 0x40 /end MEASUREMENT
/begin MEASUREMENT fmy_stat_tam_plaus.err_info_stat.err_sym "For each symptom: status of failure (set to 1 when failure symptom is detected)" UWORD _CNV_S_16_RANGE_ERR__485_CM 1 100. 0. 15. DISPLAY_IDENTIFIER ERR_SYM_TAM_PLAUS ECU_ADDRESS 0xd000457a BIT_MASK 0x780 /end MEASUREMENT
/begin MEASUREMENT fmy_stat_map_dip_shift.ctr_abc "anti-bounce counter for diagnosis XX" UBYTE _CNV_A_R_LINEAR_____0_CM 1 100. 0. 255. DISPLAY_IDENTIFIER CTR_ABC_MAP_DIP_SHIFT ECU_ADDRESS 0xd0004404 FORMAT "%3.0" /end MEASUREMENT
/begin MEASUREMENT fmy_stat_map_dip_shift.ctr_end_diag "Counter for the end of diagnosis XX generation" UBYTE _CNV_A_R_LINEAR_____0_CM 1 100. 0. 255. DISPLAY_IDENTIFIER CTR_ABC_END_DIAG_MAP_DIP_SHIFT ECU_ADDRESS 0xd0004405 FORMAT "%3.0" /end MEASUREMENT
/begin MEASUREMENT fmy_stat_map_dip_shift.err_info_stat.lv_err_mem "Failure is stored in dynamic memory (2nd layer)" UWORD _CNV_S_2_RANGE__0___1_CM 1 100. 0. 1. DISPLAY_IDENTIFIER LV_ERR_MEM_MAP_DIP_SHIFT ECU_ADDRESS 0xd0004406 BIT_MASK 0x8 /end MEASUREMENT
/begin MEASUREMENT fmy_stat_map_dip_shift.err_info_stat.lv_ready "Readiness flag related to diagnosis XX" UWORD _CNV_S_2_RANGE__0___1_CM 1 100. 0. 1. DISPLAY_IDENTIFIER LV_READY_MAP_DIP_SHIFT ECU_ADDRESS 0xd0004406 BIT_MASK 0x10 /end MEASUREMENT
/begin MEASUREMENT fmy_stat_map_dip_shift.err_info_stat.lv_end_diag "End of diagnosis XX" UWORD _CNV_S_2_RANGE__0___1_CM 1 100. 0. 1. DISPLAY_IDENTIFIER LV_END_DIAG_MAP_DIP_SHIFT ECU_ADDRESS 0xd0004406 BIT_MASK 0x20 /end MEASUREMENT
/begin MEASUREMENT fmy_stat_map_dip_shift.err_info_stat.lv_cdn_diag "Diagnosis condition to start symptom detection (set to 1 when condition is fulfilled)" UWORD _CNV_S_2_RANGE__0___1_CM 1 100. 0. 1. DISPLAY_IDENTIFIER LV_CDN_DIAG_MAP_DIP_SHIFT ECU_ADDRESS 0xd0004406 BIT_MASK 0x40 /end MEASUREMENT
/begin MEASUREMENT fmy_stat_map_dip_shift.err_info_stat.err_sym "For each symptom: status of failure (set to 1 when failure symptom is detected)" UWORD _CNV_S_16_RANGE_ERR__485_CM 1 100. 0. 15. DISPLAY_IDENTIFIER ERR_SYM_MAP_DIP_SHIFT ECU_ADDRESS 0xd0004406 BIT_MASK 0x780 /end MEASUREMENT
/begin MEASUREMENT fmy_stat_cat_diag_1.ctr_abc "anti-bounce counter for diagnosis XX" UBYTE _CNV_A_R_LINEAR_____0_CM 1 100. 0. 255. DISPLAY_IDENTIFIER CTR_ABC_CAT_DIAG_1 ECU_ADDRESS 0xd0004244 FORMAT "%3.0" /end MEASUREMENT
/begin MEASUREMENT fmy_stat_cat_diag_1.ctr_end_diag "Counter for the end of diagnosis XX generation" UBYTE _CNV_A_R_LINEAR_____0_CM 1 100. 0. 255. DISPLAY_IDENTIFIER CTR_ABC_END_DIAG_CAT_DIAG_1 ECU_ADDRESS 0xd0004245 FORMAT "%3.0" /end MEASUREMENT
/begin MEASUREMENT fmy_stat_cat_diag_1.err_info_stat.lv_err_mem "Failure is stored in dynamic memory (2nd layer)" UWORD _CNV_S_2_RANGE__0___1_CM 1 100. 0. 1. DISPLAY_IDENTIFIER LV_ERR_MEM_CAT_DIAG_1 ECU_ADDRESS 0xd0004246 BIT_MASK 0x8 /end MEASUREMENT
/begin MEASUREMENT fmy_stat_cat_diag_1.err_info_stat.lv_ready "Readiness flag related to diagnosis XX" UWORD _CNV_S_2_RANGE__0___1_CM 1 100. 0. 1. DISPLAY_IDENTIFIER LV_READY_CAT_DIAG_1 ECU_ADDRESS 0xd0004246 BIT_MASK 0x10 /end MEASUREMENT
/begin MEASUREMENT fmy_stat_cat_diag_1.err_info_stat.lv_end_diag "End of diagnosis XX" UWORD _CNV_S_2_RANGE__0___1_CM 1 100. 0. 1. DISPLAY_IDENTIFIER LV_END_DIAG_CAT_DIAG_1 ECU_ADDRESS 0xd0004246 BIT_MASK 0x20 /end MEASUREMENT
/begin MEASUREMENT fmy_stat_cat_diag_1.err_info_stat.lv_cdn_diag "Diagnosis condition to start symptom detection (set to 1 when condition is fulfilled)" UWORD _CNV_S_2_RANGE__0___1_CM 1 100. 0. 1. DISPLAY_IDENTIFIER LV_CDN_DIAG_CAT_DIAG_1 ECU_ADDRESS 0xd0004246 BIT_MASK 0x40 /end MEASUREMENT
/begin MEASUREMENT fmy_stat_cat_diag_1.err_info_stat.err_sym "For each symptom: status of failure (set to 1 when failure symptom is detected)" UWORD _CNV_S_16_RANGE_ERR__485_CM 1 100. 0. 15. DISPLAY_IDENTIFIER ERR_SYM_CAT_DIAG_1 ECU_ADDRESS 0xd0004246 BIT_MASK 0x780 /end MEASUREMENT
/begin MEASUREMENT fmy_stat_cat_diag_2.ctr_abc "anti-bounce counter for diagnosis XX" UBYTE _CNV_A_R_LINEAR_____0_CM 1 100. 0. 255. DISPLAY_IDENTIFIER CTR_ABC_CAT_DIAG_2 ECU_ADDRESS 0xd0004248 FORMAT "%3.0" /end MEASUREMENT
/begin MEASUREMENT fmy_stat_cat_diag_2.ctr_end_diag "Counter for the end of diagnosis XX generation" UBYTE _CNV_A_R_LINEAR_____0_CM 1 100. 0. 255. DISPLAY_IDENTIFIER CTR_ABC_END_DIAG_CAT_DIAG_2 ECU_ADDRESS 0xd0004249 FORMAT "%3.0" /end MEASUREMENT
/begin MEASUREMENT fmy_stat_cat_diag_2.err_info_stat.lv_err_mem "Failure is stored in dynamic memory (2nd layer)" UWORD _CNV_S_2_RANGE__0___1_CM 1 100. 0. 1. DISPLAY_IDENTIFIER LV_ERR_MEM_CAT_DIAG_2 ECU_ADDRESS 0xd000424a BIT_MASK 0x8 /end MEASUREMENT
/begin MEASUREMENT fmy_stat_cat_diag_2.err_info_stat.lv_ready "Readiness flag related to diagnosis XX" UWORD _CNV_S_2_RANGE__0___1_CM 1 100. 0. 1. DISPLAY_IDENTIFIER LV_READY_CAT_DIAG_2 ECU_ADDRESS 0xd000424a BIT_MASK 0x10 /end MEASUREMENT
/begin MEASUREMENT fmy_stat_cat_diag_2.err_info_stat.lv_end_diag "End of diagnosis XX" UWORD _CNV_S_2_RANGE__0___1_CM 1 100. 0. 1. DISPLAY_IDENTIFIER LV_END_DIAG_CAT_DIAG_2 ECU_ADDRESS 0xd000424a BIT_MASK 0x20 /end MEASUREMENT
/begin MEASUREMENT fmy_stat_cat_diag_2.err_info_stat.lv_cdn_diag "Diagnosis condition to start symptom detection (set to 1 when condition is fulfilled)" UWORD _CNV_S_2_RANGE__0___1_CM 1 100. 0. 1. DISPLAY_IDENTIFIER LV_CDN_DIAG_CAT_DIAG_2 ECU_ADDRESS 0xd000424a BIT_MASK 0x40 /end MEASUREMENT
/begin MEASUREMENT fmy_stat_cat_diag_2.err_info_stat.err_sym "For each symptom: status of failure (set to 1 when failure symptom is detected)" UWORD _CNV_S_16_RANGE_ERR__485_CM 1 100. 0. 15. DISPLAY_IDENTIFIER ERR_SYM_CAT_DIAG_2 ECU_ADDRESS 0xd000424a BIT_MASK 0x780 /end MEASUREMENT
/begin MEASUREMENT fmy_stat_cat_diag_afl_1.ctr_abc "anti-bounce counter for diagnosis XX" UBYTE _CNV_A_R_LINEAR_____0_CM 1 100. 0. 255. DISPLAY_IDENTIFIER CTR_ABC_CAT_DIAG_AFL_1 ECU_ADDRESS 0xd000424c FORMAT "%3.0" /end MEASUREMENT
/begin MEASUREMENT fmy_stat_cat_diag_afl_1.ctr_end_diag "Counter for the end of diagnosis XX generation" UBYTE _CNV_A_R_LINEAR_____0_CM 1 100. 0. 255. DISPLAY_IDENTIFIER CTR_ABC_END_DIAG_CAT_DIAG_AFL_1 ECU_ADDRESS 0xd000424d FORMAT "%3.0" /end MEASUREMENT
/begin MEASUREMENT fmy_stat_cat_diag_afl_1.err_info_stat.lv_err_mem "Failure is stored in dynamic memory (2nd layer)" UWORD _CNV_S_2_RANGE__0___1_CM 1 100. 0. 1. DISPLAY_IDENTIFIER LV_ERR_MEM_CAT_DIAG_AFL_1 ECU_ADDRESS 0xd000424e BIT_MASK 0x8 /end MEASUREMENT
/begin MEASUREMENT fmy_stat_cat_diag_afl_1.err_info_stat.lv_ready "Readiness flag related to diagnosis XX" UWORD _CNV_S_2_RANGE__0___1_CM 1 100. 0. 1. DISPLAY_IDENTIFIER LV_READY_CAT_DIAG_AFL_1 ECU_ADDRESS 0xd000424e BIT_MASK 0x10 /end MEASUREMENT
/begin MEASUREMENT fmy_stat_cat_diag_afl_1.err_info_stat.lv_end_diag "End of diagnosis XX" UWORD _CNV_S_2_RANGE__0___1_CM 1 100. 0. 1. DISPLAY_IDENTIFIER LV_END_DIAG_CAT_DIAG_AFL_1 ECU_ADDRESS 0xd000424e BIT_MASK 0x20 /end MEASUREMENT
/begin MEASUREMENT fmy_stat_cat_diag_afl_1.err_info_stat.lv_cdn_diag "Diagnosis condition to start symptom detection (set to 1 when condition is fulfilled)" UWORD _CNV_S_2_RANGE__0___1_CM 1 100. 0. 1. DISPLAY_IDENTIFIER LV_CDN_DIAG_CAT_DIAG_AFL_1 ECU_ADDRESS 0xd000424e BIT_MASK 0x40 /end MEASUREMENT
/begin MEASUREMENT fmy_stat_cat_diag_afl_1.err_info_stat.err_sym "For each symptom: status of failure (set to 1 when failure symptom is detected)" UWORD _CNV_S_16_RANGE_ERR__485_CM 1 100. 0. 15. DISPLAY_IDENTIFIER ERR_SYM_CAT_DIAG_AFL_1 ECU_ADDRESS 0xd000424e BIT_MASK 0x780 /end MEASUREMENT
/begin MEASUREMENT fmy_stat_cat_diag_afl_2.ctr_abc "anti-bounce counter for diagnosis XX" UBYTE _CNV_A_R_LINEAR_____0_CM 1 100. 0. 255. DISPLAY_IDENTIFIER CTR_ABC_CAT_DIAG_AFL_2 ECU_ADDRESS 0xd0004250 FORMAT "%3.0" /end MEASUREMENT
/begin MEASUREMENT fmy_stat_cat_diag_afl_2.ctr_end_diag "Counter for the end of diagnosis XX generation" UBYTE _CNV_A_R_LINEAR_____0_CM 1 100. 0. 255. DISPLAY_IDENTIFIER CTR_ABC_END_DIAG_CAT_DIAG_AFL_2 ECU_ADDRESS 0xd0004251 FORMAT "%3.0" /end MEASUREMENT
/begin MEASUREMENT fmy_stat_cat_diag_afl_2.err_info_stat.lv_err_mem "Failure is stored in dynamic memory (2nd layer)" UWORD _CNV_S_2_RANGE__0___1_CM 1 100. 0. 1. DISPLAY_IDENTIFIER LV_ERR_MEM_CAT_DIAG_AFL_2 ECU_ADDRESS 0xd0004252 BIT_MASK 0x8 /end MEASUREMENT
/begin MEASUREMENT fmy_stat_cat_diag_afl_2.err_info_stat.lv_ready "Readiness flag related to diagnosis XX" UWORD _CNV_S_2_RANGE__0___1_CM 1 100. 0. 1. DISPLAY_IDENTIFIER LV_READY_CAT_DIAG_AFL_2 ECU_ADDRESS 0xd0004252 BIT_MASK 0x10 /end MEASUREMENT
/begin MEASUREMENT fmy_stat_cat_diag_afl_2.err_info_stat.lv_end_diag "End of diagnosis XX" UWORD _CNV_S_2_RANGE__0___1_CM 1 100. 0. 1. DISPLAY_IDENTIFIER LV_END_DIAG_CAT_DIAG_AFL_2 ECU_ADDRESS 0xd0004252 BIT_MASK 0x20 /end MEASUREMENT
/begin MEASUREMENT fmy_stat_cat_diag_afl_2.err_info_stat.lv_cdn_diag "Diagnosis condition to start symptom detection (set to 1 when condition is fulfilled)" UWORD _CNV_S_2_RANGE__0___1_CM 1 100. 0. 1. DISPLAY_IDENTIFIER LV_CDN_DIAG_CAT_DIAG_AFL_2 ECU_ADDRESS 0xd0004252 BIT_MASK 0x40 /end MEASUREMENT
/begin MEASUREMENT fmy_stat_cat_diag_afl_2.err_info_stat.err_sym "For each symptom: status of failure (set to 1 when failure symptom is detected)" UWORD _CNV_S_16_RANGE_ERR__485_CM 1 100. 0. 15. DISPLAY_IDENTIFIER ERR_SYM_CAT_DIAG_AFL_2 ECU_ADDRESS 0xd0004252 BIT_MASK 0x780 /end MEASUREMENT
/begin MEASUREMENT fmy_stat_scg_ls_down_1.ctr_abc "anti-bounce counter for diagnosis XX" UBYTE _CNV_A_R_LINEAR_____0_CM 1 100. 0. 255. DISPLAY_IDENTIFIER CTR_ABC_SCG_LS_DOWN_1 ECU_ADDRESS 0xd000450c FORMAT "%3.0" /end MEASUREMENT
/begin MEASUREMENT fmy_stat_scg_ls_down_1.ctr_end_diag "Counter for the end of diagnosis XX generation" UBYTE _CNV_A_R_LINEAR_____0_CM 1 100. 0. 255. DISPLAY_IDENTIFIER CTR_ABC_END_DIAG_SCG_LS_DOWN_1 ECU_ADDRESS 0xd000450d FORMAT "%3.0" /end MEASUREMENT
/begin MEASUREMENT fmy_stat_scg_ls_down_1.err_info_stat.lv_err_mem "Failure is stored in dynamic memory (2nd layer)" UWORD _CNV_S_2_RANGE__0___1_CM 1 100. 0. 1. DISPLAY_IDENTIFIER LV_ERR_MEM_SCG_LS_DOWN_1 ECU_ADDRESS 0xd000450e BIT_MASK 0x8 /end MEASUREMENT
/begin MEASUREMENT fmy_stat_scg_ls_down_1.err_info_stat.lv_ready "Readiness flag related to diagnosis XX" UWORD _CNV_S_2_RANGE__0___1_CM 1 100. 0. 1. DISPLAY_IDENTIFIER LV_READY_SCG_LS_DOWN_1 ECU_ADDRESS 0xd000450e BIT_MASK 0x10 /end MEASUREMENT
/begin MEASUREMENT fmy_stat_scg_ls_down_1.err_info_stat.lv_end_diag "End of diagnosis XX" UWORD _CNV_S_2_RANGE__0___1_CM 1 100. 0. 1. DISPLAY_IDENTIFIER LV_END_DIAG_SCG_LS_DOWN_1 ECU_ADDRESS 0xd000450e BIT_MASK 0x20 /end MEASUREMENT
/begin MEASUREMENT fmy_stat_scg_ls_down_1.err_info_stat.lv_cdn_diag "Diagnosis condition to start symptom detection (set to 1 when condition is fulfilled)" UWORD _CNV_S_2_RANGE__0___1_CM 1 100. 0. 1. DISPLAY_IDENTIFIER LV_CDN_DIAG_SCG_LS_DOWN_1 ECU_ADDRESS 0xd000450e BIT_MASK 0x40 /end MEASUREMENT
/begin MEASUREMENT fmy_stat_scg_ls_down_1.err_info_stat.err_sym "For each symptom: status of failure (set to 1 when failure symptom is detected)" UWORD _CNV_S_16_RANGE_ERR__485_CM 1 100. 0. 15. DISPLAY_IDENTIFIER ERR_SYM_SCG_LS_DOWN_1 ECU_ADDRESS 0xd000450e BIT_MASK 0x780 /end MEASUREMENT
/begin MEASUREMENT fmy_stat_scp_ls_down_1.ctr_abc "anti-bounce counter for diagnosis XX" UBYTE _CNV_A_R_LINEAR_____0_CM 1 100. 0. 255. DISPLAY_IDENTIFIER CTR_ABC_SCP_LS_DOWN_1 ECU_ADDRESS 0xd0004514 FORMAT "%3.0" /end MEASUREMENT
/begin MEASUREMENT fmy_stat_scp_ls_down_1.ctr_end_diag "Counter for the end of diagnosis XX generation" UBYTE _CNV_A_R_LINEAR_____0_CM 1 100. 0. 255. DISPLAY_IDENTIFIER CTR_ABC_END_DIAG_SCP_LS_DOWN_1 ECU_ADDRESS 0xd0004515 FORMAT "%3.0" /end MEASUREMENT
/begin MEASUREMENT fmy_stat_scp_ls_down_1.err_info_stat.lv_err_mem "Failure is stored in dynamic memory (2nd layer)" UWORD _CNV_S_2_RANGE__0___1_CM 1 100. 0. 1. DISPLAY_IDENTIFIER LV_ERR_MEM_SCP_LS_DOWN_1 ECU_ADDRESS 0xd0004516 BIT_MASK 0x8 /end MEASUREMENT
/begin MEASUREMENT fmy_stat_scp_ls_down_1.err_info_stat.lv_ready "Readiness flag related to diagnosis XX" UWORD _CNV_S_2_RANGE__0___1_CM 1 100. 0. 1. DISPLAY_IDENTIFIER LV_READY_SCP_LS_DOWN_1 ECU_ADDRESS 0xd0004516 BIT_MASK 0x10 /end MEASUREMENT
/begin MEASUREMENT fmy_stat_scp_ls_down_1.err_info_stat.lv_end_diag "End of diagnosis XX" UWORD _CNV_S_2_RANGE__0___1_CM 1 100. 0. 1. DISPLAY_IDENTIFIER LV_END_DIAG_SCP_LS_DOWN_1 ECU_ADDRESS 0xd0004516 BIT_MASK 0x20 /end MEASUREMENT
/begin MEASUREMENT fmy_stat_scp_ls_down_1.err_info_stat.lv_cdn_diag "Diagnosis condition to start symptom detection (set to 1 when condition is fulfilled)" UWORD _CNV_S_2_RANGE__0___1_CM 1 100. 0. 1. DISPLAY_IDENTIFIER LV_CDN_DIAG_SCP_LS_DOWN_1 ECU_ADDRESS 0xd0004516 BIT_MASK 0x40 /end MEASUREMENT
/begin MEASUREMENT fmy_stat_scp_ls_down_1.err_info_stat.err_sym "For each symptom: status of failure (set to 1 when failure symptom is detected)" UWORD _CNV_S_16_RANGE_ERR__485_CM 1 100. 0. 15. DISPLAY_IDENTIFIER ERR_SYM_SCP_LS_DOWN_1 ECU_ADDRESS 0xd0004516 BIT_MASK 0x780 /end MEASUREMENT
/begin MEASUREMENT fmy_stat_oc_ls_down_1.ctr_abc "anti-bounce counter for diagnosis XX" UBYTE _CNV_A_R_LINEAR_____0_CM 1 100. 0. 255. DISPLAY_IDENTIFIER CTR_ABC_OC_LS_DOWN_1 ECU_ADDRESS 0xd0004478 FORMAT "%3.0" /end MEASUREMENT
/begin MEASUREMENT fmy_stat_oc_ls_down_1.ctr_end_diag "Counter for the end of diagnosis XX generation" UBYTE _CNV_A_R_LINEAR_____0_CM 1 100. 0. 255. DISPLAY_IDENTIFIER CTR_ABC_END_DIAG_OC_LS_DOWN_1 ECU_ADDRESS 0xd0004479 FORMAT "%3.0" /end MEASUREMENT
/begin MEASUREMENT fmy_stat_oc_ls_down_1.err_info_stat.lv_err_mem "Failure is stored in dynamic memory (2nd layer)" UWORD _CNV_S_2_RANGE__0___1_CM 1 100. 0. 1. DISPLAY_IDENTIFIER LV_ERR_MEM_OC_LS_DOWN_1 ECU_ADDRESS 0xd000447a BIT_MASK 0x8 /end MEASUREMENT
/begin MEASUREMENT fmy_stat_oc_ls_down_1.err_info_stat.lv_ready "Readiness flag related to diagnosis XX" UWORD _CNV_S_2_RANGE__0___1_CM 1 100. 0. 1. DISPLAY_IDENTIFIER LV_READY_OC_LS_DOWN_1 ECU_ADDRESS 0xd000447a BIT_MASK 0x10 /end MEASUREMENT
/begin MEASUREMENT fmy_stat_oc_ls_down_1.err_info_stat.lv_end_diag "End of diagnosis XX" UWORD _CNV_S_2_RANGE__0___1_CM 1 100. 0. 1. DISPLAY_IDENTIFIER LV_END_DIAG_OC_LS_DOWN_1 ECU_ADDRESS 0xd000447a BIT_MASK 0x20 /end MEASUREMENT
/begin MEASUREMENT fmy_stat_oc_ls_down_1.err_info_stat.lv_cdn_diag "Diagnosis condition to start symptom detection (set to 1 when condition is fulfilled)" UWORD _CNV_S_2_RANGE__0___1_CM 1 100. 0. 1. DISPLAY_IDENTIFIER LV_CDN_DIAG_OC_LS_DOWN_1 ECU_ADDRESS 0xd000447a BIT_MASK 0x40 /end MEASUREMENT
/begin MEASUREMENT fmy_stat_oc_ls_down_1.err_info_stat.err_sym "For each symptom: status of failure (set to 1 when failure symptom is detected)" UWORD _CNV_S_16_RANGE_ERR__485_CM 1 100. 0. 15. DISPLAY_IDENTIFIER ERR_SYM_OC_LS_DOWN_1 ECU_ADDRESS 0xd000447a BIT_MASK 0x780 /end MEASUREMENT
/begin MEASUREMENT fmy_stat_puc_ls_down_1.ctr_abc "anti-bounce counter for diagnosis XX" UBYTE _CNV_A_R_LINEAR_____0_CM 1 100. 0. 255. DISPLAY_IDENTIFIER CTR_ABC_PUC_LS_DOWN_1 ECU_ADDRESS 0xd00044a4 FORMAT "%3.0" /end MEASUREMENT
/begin MEASUREMENT fmy_stat_puc_ls_down_1.ctr_end_diag "Counter for the end of diagnosis XX generation" UBYTE _CNV_A_R_LINEAR_____0_CM 1 100. 0. 255. DISPLAY_IDENTIFIER CTR_ABC_END_DIAG_PUC_LS_DOWN_1 ECU_ADDRESS 0xd00044a5 FORMAT "%3.0" /end MEASUREMENT
/begin MEASUREMENT fmy_stat_puc_ls_down_1.err_info_stat.lv_err_mem "Failure is stored in dynamic memory (2nd layer)" UWORD _CNV_S_2_RANGE__0___1_CM 1 100. 0. 1. DISPLAY_IDENTIFIER LV_ERR_MEM_PUC_LS_DOWN_1 ECU_ADDRESS 0xd00044a6 BIT_MASK 0x8 /end MEASUREMENT
/begin MEASUREMENT fmy_stat_puc_ls_down_1.err_info_stat.lv_ready "Readiness flag related to diagnosis XX" UWORD _CNV_S_2_RANGE__0___1_CM 1 100. 0. 1. DISPLAY_IDENTIFIER LV_READY_PUC_LS_DOWN_1 ECU_ADDRESS 0xd00044a6 BIT_MASK 0x10 /end MEASUREMENT
/begin MEASUREMENT fmy_stat_puc_ls_down_1.err_info_stat.lv_end_diag "End of diagnosis XX" UWORD _CNV_S_2_RANGE__0___1_CM 1 100. 0. 1. DISPLAY_IDENTIFIER LV_END_DIAG_PUC_LS_DOWN_1 ECU_ADDRESS 0xd00044a6 BIT_MASK 0x20 /end MEASUREMENT
/begin MEASUREMENT fmy_stat_puc_ls_down_1.err_info_stat.lv_cdn_diag "Diagnosis condition to start symptom detection (set to 1 when condition is fulfilled)" UWORD _CNV_S_2_RANGE__0___1_CM 1 100. 0. 1. DISPLAY_IDENTIFIER LV_CDN_DIAG_PUC_LS_DOWN_1 ECU_ADDRESS 0xd00044a6 BIT_MASK 0x40 /end MEASUREMENT
/begin MEASUREMENT fmy_stat_puc_ls_down_1.err_info_stat.err_sym "For each symptom: status of failure (set to 1 when failure symptom is detected)" UWORD _CNV_S_16_RANGE_ERR__485_CM 1 100. 0. 15. DISPLAY_IDENTIFIER ERR_SYM_PUC_LS_DOWN_1 ECU_ADDRESS 0xd00044a6 BIT_MASK 0x780 /end MEASUREMENT
/begin MEASUREMENT fmy_stat_fl_ls_down_1.ctr_abc "anti-bounce counter for diagnosis XX" UBYTE _CNV_A_R_LINEAR_____0_CM 1 100. 0. 255. DISPLAY_IDENTIFIER CTR_ABC_FL_LS_DOWN_1 ECU_ADDRESS 0xd0004310 FORMAT "%3.0" /end MEASUREMENT
/begin MEASUREMENT fmy_stat_fl_ls_down_1.ctr_end_diag "Counter for the end of diagnosis XX generation" UBYTE _CNV_A_R_LINEAR_____0_CM 1 100. 0. 255. DISPLAY_IDENTIFIER CTR_ABC_END_DIAG_FL_LS_DOWN_1 ECU_ADDRESS 0xd0004311 FORMAT "%3.0" /end MEASUREMENT
/begin MEASUREMENT fmy_stat_fl_ls_down_1.err_info_stat.lv_err_mem "Failure is stored in dynamic memory (2nd layer)" UWORD _CNV_S_2_RANGE__0___1_CM 1 100. 0. 1. DISPLAY_IDENTIFIER LV_ERR_MEM_FL_LS_DOWN_1 ECU_ADDRESS 0xd0004312 BIT_MASK 0x8 /end MEASUREMENT
/begin MEASUREMENT fmy_stat_fl_ls_down_1.err_info_stat.lv_ready "Readiness flag related to diagnosis XX" UWORD _CNV_S_2_RANGE__0___1_CM 1 100. 0. 1. DISPLAY_IDENTIFIER LV_READY_FL_LS_DOWN_1 ECU_ADDRESS 0xd0004312 BIT_MASK 0x10 /end MEASUREMENT
/begin MEASUREMENT fmy_stat_fl_ls_down_1.err_info_stat.lv_end_diag "End of diagnosis XX" UWORD _CNV_S_2_RANGE__0___1_CM 1 100. 0. 1. DISPLAY_IDENTIFIER LV_END_DIAG_FL_LS_DOWN_1 ECU_ADDRESS 0xd0004312 BIT_MASK 0x20 /end MEASUREMENT
/begin MEASUREMENT fmy_stat_fl_ls_down_1.err_info_stat.lv_cdn_diag "Diagnosis condition to start symptom detection (set to 1 when condition is fulfilled)" UWORD _CNV_S_2_RANGE__0___1_CM 1 100. 0. 1. DISPLAY_IDENTIFIER LV_CDN_DIAG_FL_LS_DOWN_1 ECU_ADDRESS 0xd0004312 BIT_MASK 0x40 /end MEASUREMENT
/begin MEASUREMENT fmy_stat_fl_ls_down_1.err_info_stat.err_sym "For each symptom: status of failure (set to 1 when failure symptom is detected)" UWORD _CNV_S_16_RANGE_ERR__485_CM 1 100. 0. 15. DISPLAY_IDENTIFIER ERR_SYM_FL_LS_DOWN_1 ECU_ADDRESS 0xd0004312 BIT_MASK 0x780 /end MEASUREMENT
/begin MEASUREMENT fmy_stat_lsl_up_if_1.ctr_abc "anti-bounce counter for diagnosis XX" UBYTE _CNV_A_R_LINEAR_____0_CM 1 100. 0. 255. DISPLAY_IDENTIFIER CTR_ABC_LSL_UP_IF_1 ECU_ADDRESS 0xd00043f0 FORMAT "%3.0" /end MEASUREMENT
/begin MEASUREMENT fmy_stat_lsl_up_if_1.ctr_end_diag "Counter for the end of diagnosis XX generation" UBYTE _CNV_A_R_LINEAR_____0_CM 1 100. 0. 255. DISPLAY_IDENTIFIER CTR_ABC_END_DIAG_LSL_UP_IF_1 ECU_ADDRESS 0xd00043f1 FORMAT "%3.0" /end MEASUREMENT
/begin MEASUREMENT fmy_stat_lsl_up_if_1.err_info_stat.lv_err_mem "Failure is stored in dynamic memory (2nd layer)" UWORD _CNV_S_2_RANGE__0___1_CM 1 100. 0. 1. DISPLAY_IDENTIFIER LV_ERR_MEM_LSL_UP_IF_1 ECU_ADDRESS 0xd00043f2 BIT_MASK 0x8 /end MEASUREMENT
/begin MEASUREMENT fmy_stat_lsl_up_if_1.err_info_stat.lv_ready "Readiness flag related to diagnosis XX" UWORD _CNV_S_2_RANGE__0___1_CM 1 100. 0. 1. DISPLAY_IDENTIFIER LV_READY_LSL_UP_IF_1 ECU_ADDRESS 0xd00043f2 BIT_MASK 0x10 /end MEASUREMENT
/begin MEASUREMENT fmy_stat_lsl_up_if_1.err_info_stat.lv_end_diag "End of diagnosis XX" UWORD _CNV_S_2_RANGE__0___1_CM 1 100. 0. 1. DISPLAY_IDENTIFIER LV_END_DIAG_LSL_UP_IF_1 ECU_ADDRESS 0xd00043f2 BIT_MASK 0x20 /end MEASUREMENT
/begin MEASUREMENT fmy_stat_lsl_up_if_1.err_info_stat.lv_cdn_diag "Diagnosis condition to start symptom detection (set to 1 when condition is fulfilled)" UWORD _CNV_S_2_RANGE__0___1_CM 1 100. 0. 1. DISPLAY_IDENTIFIER LV_CDN_DIAG_LSL_UP_IF_1 ECU_ADDRESS 0xd00043f2 BIT_MASK 0x40 /end MEASUREMENT
/begin MEASUREMENT fmy_stat_lsl_up_if_1.err_info_stat.err_sym "For each symptom: status of failure (set to 1 when failure symptom is detected)" UWORD _CNV_S_16_RANGE_ERR__485_CM 1 100. 0. 15. DISPLAY_IDENTIFIER ERR_SYM_LSL_UP_IF_1 ECU_ADDRESS 0xd00043f2 BIT_MASK 0x780 /end MEASUREMENT
/begin MEASUREMENT fmy_stat_el_lsl_up_1.ctr_abc "anti-bounce counter for diagnosis XX" UBYTE _CNV_A_R_LINEAR_____0_CM 1 100. 0. 255. DISPLAY_IDENTIFIER CTR_ABC_EL_LSL_UP_1 ECU_ADDRESS 0xd0004308 FORMAT "%3.0" /end MEASUREMENT
/begin MEASUREMENT fmy_stat_el_lsl_up_1.ctr_end_diag "Counter for the end of diagnosis XX generation" UBYTE _CNV_A_R_LINEAR_____0_CM 1 100. 0. 255. DISPLAY_IDENTIFIER CTR_ABC_END_DIAG_EL_LSL_UP_1 ECU_ADDRESS 0xd0004309 FORMAT "%3.0" /end MEASUREMENT
/begin MEASUREMENT fmy_stat_el_lsl_up_1.err_info_stat.lv_err_mem "Failure is stored in dynamic memory (2nd layer)" UWORD _CNV_S_2_RANGE__0___1_CM 1 100. 0. 1. DISPLAY_IDENTIFIER LV_ERR_MEM_EL_LSL_UP_1 ECU_ADDRESS 0xd000430a BIT_MASK 0x8 /end MEASUREMENT
/begin MEASUREMENT fmy_stat_el_lsl_up_1.err_info_stat.lv_ready "Readiness flag related to diagnosis XX" UWORD _CNV_S_2_RANGE__0___1_CM 1 100. 0. 1. DISPLAY_IDENTIFIER LV_READY_EL_LSL_UP_1 ECU_ADDRESS 0xd000430a BIT_MASK 0x10 /end MEASUREMENT
/begin MEASUREMENT fmy_stat_el_lsl_up_1.err_info_stat.lv_end_diag "End of diagnosis XX" UWORD _CNV_S_2_RANGE__0___1_CM 1 100. 0. 1. DISPLAY_IDENTIFIER LV_END_DIAG_EL_LSL_UP_1 ECU_ADDRESS 0xd000430a BIT_MASK 0x20 /end MEASUREMENT
/begin MEASUREMENT fmy_stat_el_lsl_up_1.err_info_stat.lv_cdn_diag "Diagnosis condition to start symptom detection (set to 1 when condition is fulfilled)" UWORD _CNV_S_2_RANGE__0___1_CM 1 100. 0. 1. DISPLAY_IDENTIFIER LV_CDN_DIAG_EL_LSL_UP_1 ECU_ADDRESS 0xd000430a BIT_MASK 0x40 /end MEASUREMENT
/begin MEASUREMENT fmy_stat_el_lsl_up_1.err_info_stat.err_sym "For each symptom: status of failure (set to 1 when failure symptom is detected)" UWORD _CNV_S_16_RANGE_ERR__485_CM 1 100. 0. 15. DISPLAY_IDENTIFIER ERR_SYM_EL_LSL_UP_1 ECU_ADDRESS 0xd000430a BIT_MASK 0x780 /end MEASUREMENT
/begin MEASUREMENT fmy_stat_lsh_up_1.ctr_abc "anti-bounce counter for diagnosis XX" UBYTE _CNV_A_R_LINEAR_____0_CM 1 100. 0. 255. DISPLAY_IDENTIFIER CTR_ABC_LSH_UP_1 ECU_ADDRESS 0xd00043e8 FORMAT "%3.0" /end MEASUREMENT
/begin MEASUREMENT fmy_stat_lsh_up_1.ctr_end_diag "Counter for the end of diagnosis XX generation" UBYTE _CNV_A_R_LINEAR_____0_CM 1 100. 0. 255. DISPLAY_IDENTIFIER CTR_ABC_END_DIAG_LSH_UP_1 ECU_ADDRESS 0xd00043e9 FORMAT "%3.0" /end MEASUREMENT
/begin MEASUREMENT fmy_stat_lsh_up_1.err_info_stat.lv_err_mem "Failure is stored in dynamic memory (2nd layer)" UWORD _CNV_S_2_RANGE__0___1_CM 1 100. 0. 1. DISPLAY_IDENTIFIER LV_ERR_MEM_LSH_UP_1 ECU_ADDRESS 0xd00043ea BIT_MASK 0x8 /end MEASUREMENT
/begin MEASUREMENT fmy_stat_lsh_up_1.err_info_stat.lv_ready "Readiness flag related to diagnosis XX" UWORD _CNV_S_2_RANGE__0___1_CM 1 100. 0. 1. DISPLAY_IDENTIFIER LV_READY_LSH_UP_1 ECU_ADDRESS 0xd00043ea BIT_MASK 0x10 /end MEASUREMENT
/begin MEASUREMENT fmy_stat_lsh_up_1.err_info_stat.lv_end_diag "End of diagnosis XX" UWORD _CNV_S_2_RANGE__0___1_CM 1 100. 0. 1. DISPLAY_IDENTIFIER LV_END_DIAG_LSH_UP_1 ECU_ADDRESS 0xd00043ea BIT_MASK 0x20 /end MEASUREMENT
/begin MEASUREMENT fmy_stat_lsh_up_1.err_info_stat.lv_cdn_diag "Diagnosis condition to start symptom detection (set to 1 when condition is fulfilled)" UWORD _CNV_S_2_RANGE__0___1_CM 1 100. 0. 1. DISPLAY_IDENTIFIER LV_CDN_DIAG_LSH_UP_1 ECU_ADDRESS 0xd00043ea BIT_MASK 0x40 /end MEASUREMENT
/begin MEASUREMENT fmy_stat_lsh_up_1.err_info_stat.err_sym "For each symptom: status of failure (set to 1 when failure symptom is detected)" UWORD _CNV_S_16_RANGE_ERR__485_CM 1 100. 0. 15. DISPLAY_IDENTIFIER ERR_SYM_LSH_UP_1 ECU_ADDRESS 0xd00043ea BIT_MASK 0x780 /end MEASUREMENT
/begin MEASUREMENT fmy_stat_lsh_down_1.ctr_abc "anti-bounce counter for diagnosis XX" UBYTE _CNV_A_R_LINEAR_____0_CM 1 100. 0. 255. DISPLAY_IDENTIFIER CTR_ABC_LSH_DOWN_1 ECU_ADDRESS 0xd00043d8 FORMAT "%3.0" /end MEASUREMENT
/begin MEASUREMENT fmy_stat_lsh_down_1.ctr_end_diag "Counter for the end of diagnosis XX generation" UBYTE _CNV_A_R_LINEAR_____0_CM 1 100. 0. 255. DISPLAY_IDENTIFIER CTR_ABC_END_DIAG_LSH_DOWN_1 ECU_ADDRESS 0xd00043d9 FORMAT "%3.0" /end MEASUREMENT
/begin MEASUREMENT fmy_stat_lsh_down_1.err_info_stat.lv_err_mem "Failure is stored in dynamic memory (2nd layer)" UWORD _CNV_S_2_RANGE__0___1_CM 1 100. 0. 1. DISPLAY_IDENTIFIER LV_ERR_MEM_LSH_DOWN_1 ECU_ADDRESS 0xd00043da BIT_MASK 0x8 /end MEASUREMENT
/begin MEASUREMENT fmy_stat_lsh_down_1.err_info_stat.lv_ready "Readiness flag related to diagnosis XX" UWORD _CNV_S_2_RANGE__0___1_CM 1 100. 0. 1. DISPLAY_IDENTIFIER LV_READY_LSH_DOWN_1 ECU_ADDRESS 0xd00043da BIT_MASK 0x10 /end MEASUREMENT
/begin MEASUREMENT fmy_stat_lsh_down_1.err_info_stat.lv_end_diag "End of diagnosis XX" UWORD _CNV_S_2_RANGE__0___1_CM 1 100. 0. 1. DISPLAY_IDENTIFIER LV_END_DIAG_LSH_DOWN_1 ECU_ADDRESS 0xd00043da BIT_MASK 0x20 /end MEASUREMENT
/begin MEASUREMENT fmy_stat_lsh_down_1.err_info_stat.lv_cdn_diag "Diagnosis condition to start symptom detection (set to 1 when condition is fulfilled)" UWORD _CNV_S_2_RANGE__0___1_CM 1 100. 0. 1. DISPLAY_IDENTIFIER LV_CDN_DIAG_LSH_DOWN_1 ECU_ADDRESS 0xd00043da BIT_MASK 0x40 /end MEASUREMENT
/begin MEASUREMENT fmy_stat_lsh_down_1.err_info_stat.err_sym "For each symptom: status of failure (set to 1 when failure symptom is detected)" UWORD _CNV_S_16_RANGE_ERR__485_CM 1 100. 0. 15. DISPLAY_IDENTIFIER ERR_SYM_LSH_DOWN_1 ECU_ADDRESS 0xd00043da BIT_MASK 0x780 /end MEASUREMENT
/begin MEASUREMENT fmy_stat_vls_down_dif_1.ctr_abc "anti-bounce counter for diagnosis XX" UBYTE _CNV_A_R_LINEAR_____0_CM 1 100. 0. 255. DISPLAY_IDENTIFIER CTR_ABC_VLS_DOWN_DIF_1 ECU_ADDRESS 0xd0004650 FORMAT "%3.0" /end MEASUREMENT
/begin MEASUREMENT fmy_stat_vls_down_dif_1.ctr_end_diag "Counter for the end of diagnosis XX generation" UBYTE _CNV_A_R_LINEAR_____0_CM 1 100. 0. 255. DISPLAY_IDENTIFIER CTR_ABC_END_DIAG_VLS_DOWN_DIF_1 ECU_ADDRESS 0xd0004651 FORMAT "%3.0" /end MEASUREMENT
/begin MEASUREMENT fmy_stat_vls_down_dif_1.err_info_stat.lv_err_mem "Failure is stored in dynamic memory (2nd layer)" UWORD _CNV_S_2_RANGE__0___1_CM 1 100. 0. 1. DISPLAY_IDENTIFIER LV_ERR_MEM_VLS_DOWN_DIF_1 ECU_ADDRESS 0xd0004652 BIT_MASK 0x8 /end MEASUREMENT
/begin MEASUREMENT fmy_stat_vls_down_dif_1.err_info_stat.lv_ready "Readiness flag related to diagnosis XX" UWORD _CNV_S_2_RANGE__0___1_CM 1 100. 0. 1. DISPLAY_IDENTIFIER LV_READY_VLS_DOWN_DIF_1 ECU_ADDRESS 0xd0004652 BIT_MASK 0x10 /end MEASUREMENT
/begin MEASUREMENT fmy_stat_vls_down_dif_1.err_info_stat.lv_end_diag "End of diagnosis XX" UWORD _CNV_S_2_RANGE__0___1_CM 1 100. 0. 1. DISPLAY_IDENTIFIER LV_END_DIAG_VLS_DOWN_DIF_1 ECU_ADDRESS 0xd0004652 BIT_MASK 0x20 /end MEASUREMENT
/begin MEASUREMENT fmy_stat_vls_down_dif_1.err_info_stat.lv_cdn_diag "Diagnosis condition to start symptom detection (set to 1 when condition is fulfilled)" UWORD _CNV_S_2_RANGE__0___1_CM 1 100. 0. 1. DISPLAY_IDENTIFIER LV_CDN_DIAG_VLS_DOWN_DIF_1 ECU_ADDRESS 0xd0004652 BIT_MASK 0x40 /end MEASUREMENT
/begin MEASUREMENT fmy_stat_vls_down_dif_1.err_info_stat.err_sym "For each symptom: status of failure (set to 1 when failure symptom is detected)" UWORD _CNV_S_16_RANGE_ERR__485_CM 1 100. 0. 15. DISPLAY_IDENTIFIER ERR_SYM_VLS_DOWN_DIF_1 ECU_ADDRESS 0xd0004652 BIT_MASK 0x780 /end MEASUREMENT
/begin MEASUREMENT fmy_stat_lsh_lsl_up_1.ctr_abc "anti-bounce counter for diagnosis XX" UBYTE _CNV_A_R_LINEAR_____0_CM 1 100. 0. 255. DISPLAY_IDENTIFIER CTR_ABC_LSH_LSL_UP_1 ECU_ADDRESS 0xd00043e0 FORMAT "%3.0" /end MEASUREMENT
/begin MEASUREMENT fmy_stat_lsh_lsl_up_1.ctr_end_diag "Counter for the end of diagnosis XX generation" UBYTE _CNV_A_R_LINEAR_____0_CM 1 100. 0. 255. DISPLAY_IDENTIFIER CTR_ABC_END_DIAG_LSH_LSL_UP_1 ECU_ADDRESS 0xd00043e1 FORMAT "%3.0" /end MEASUREMENT
/begin MEASUREMENT fmy_stat_lsh_lsl_up_1.err_info_stat.lv_err_mem "Failure is stored in dynamic memory (2nd layer)" UWORD _CNV_S_2_RANGE__0___1_CM 1 100. 0. 1. DISPLAY_IDENTIFIER LV_ERR_MEM_LSH_LSL_UP_1 ECU_ADDRESS 0xd00043e2 BIT_MASK 0x8 /end MEASUREMENT
/begin MEASUREMENT fmy_stat_lsh_lsl_up_1.err_info_stat.lv_ready "Readiness flag related to diagnosis XX" UWORD _CNV_S_2_RANGE__0___1_CM 1 100. 0. 1. DISPLAY_IDENTIFIER LV_READY_LSH_LSL_UP_1 ECU_ADDRESS 0xd00043e2 BIT_MASK 0x10 /end MEASUREMENT
/begin MEASUREMENT fmy_stat_lsh_lsl_up_1.err_info_stat.lv_end_diag "End of diagnosis XX" UWORD _CNV_S_2_RANGE__0___1_CM 1 100. 0. 1. DISPLAY_IDENTIFIER LV_END_DIAG_LSH_LSL_UP_1 ECU_ADDRESS 0xd00043e2 BIT_MASK 0x20 /end MEASUREMENT
/begin MEASUREMENT fmy_stat_lsh_lsl_up_1.err_info_stat.lv_cdn_diag "Diagnosis condition to start symptom detection (set to 1 when condition is fulfilled)" UWORD _CNV_S_2_RANGE__0___1_CM 1 100. 0. 1. DISPLAY_IDENTIFIER LV_CDN_DIAG_LSH_LSL_UP_1 ECU_ADDRESS 0xd00043e2 BIT_MASK 0x40 /end MEASUREMENT
/begin MEASUREMENT fmy_stat_lsh_lsl_up_1.err_info_stat.err_sym "For each symptom: status of failure (set to 1 when failure symptom is detected)" UWORD _CNV_S_16_RANGE_ERR__485_CM 1 100. 0. 15. DISPLAY_IDENTIFIER ERR_SYM_LSH_LSL_UP_1 ECU_ADDRESS 0xd00043e2 BIT_MASK 0x780 /end MEASUREMENT
/begin MEASUREMENT fmy_stat_air_lsl_up_1.ctr_abc "anti-bounce counter for diagnosis XX" UBYTE _CNV_A_R_LINEAR_____0_CM 1 100. 0. 255. DISPLAY_IDENTIFIER CTR_ABC_AIR_LSL_UP_1 ECU_ADDRESS 0xd0004198 FORMAT "%3.0" /end MEASUREMENT
/begin MEASUREMENT fmy_stat_air_lsl_up_1.ctr_end_diag "Counter for the end of diagnosis XX generation" UBYTE _CNV_A_R_LINEAR_____0_CM 1 100. 0. 255. DISPLAY_IDENTIFIER CTR_ABC_END_DIAG_AIR_LSL_UP_1 ECU_ADDRESS 0xd0004199 FORMAT "%3.0" /end MEASUREMENT
/begin MEASUREMENT fmy_stat_air_lsl_up_1.err_info_stat.lv_err_mem "Failure is stored in dynamic memory (2nd layer)" UWORD _CNV_S_2_RANGE__0___1_CM 1 100. 0. 1. DISPLAY_IDENTIFIER LV_ERR_MEM_AIR_LSL_UP_1 ECU_ADDRESS 0xd000419a BIT_MASK 0x8 /end MEASUREMENT
/begin MEASUREMENT fmy_stat_air_lsl_up_1.err_info_stat.lv_ready "Readiness flag related to diagnosis XX" UWORD _CNV_S_2_RANGE__0___1_CM 1 100. 0. 1. DISPLAY_IDENTIFIER LV_READY_AIR_LSL_UP_1 ECU_ADDRESS 0xd000419a BIT_MASK 0x10 /end MEASUREMENT
/begin MEASUREMENT fmy_stat_air_lsl_up_1.err_info_stat.lv_end_diag "End of diagnosis XX" UWORD _CNV_S_2_RANGE__0___1_CM 1 100. 0. 1. DISPLAY_IDENTIFIER LV_END_DIAG_AIR_LSL_UP_1 ECU_ADDRESS 0xd000419a BIT_MASK 0x20 /end MEASUREMENT
/begin MEASUREMENT fmy_stat_air_lsl_up_1.err_info_stat.lv_cdn_diag "Diagnosis condition to start symptom detection (set to 1 when condition is fulfilled)" UWORD _CNV_S_2_RANGE__0___1_CM 1 100. 0. 1. DISPLAY_IDENTIFIER LV_CDN_DIAG_AIR_LSL_UP_1 ECU_ADDRESS 0xd000419a BIT_MASK 0x40 /end MEASUREMENT
/begin MEASUREMENT fmy_stat_air_lsl_up_1.err_info_stat.err_sym "For each symptom: status of failure (set to 1 when failure symptom is detected)" UWORD _CNV_S_16_RANGE_ERR__485_CM 1 100. 0. 15. DISPLAY_IDENTIFIER ERR_SYM_AIR_LSL_UP_1 ECU_ADDRESS 0xd000419a BIT_MASK 0x780 /end MEASUREMENT
/begin MEASUREMENT fmy_stat_pue_ls_down_1.ctr_abc "anti-bounce counter for diagnosis XX" UBYTE _CNV_A_R_LINEAR_____0_CM 1 100. 0. 255. DISPLAY_IDENTIFIER CTR_ABC_PUE_LS_DOWN_1 ECU_ADDRESS 0xd00044b4 FORMAT "%3.0" /end MEASUREMENT
/begin MEASUREMENT fmy_stat_pue_ls_down_1.ctr_end_diag "Counter for the end of diagnosis XX generation" UBYTE _CNV_A_R_LINEAR_____0_CM 1 100. 0. 255. DISPLAY_IDENTIFIER CTR_ABC_END_DIAG_PUE_LS_DOWN_1 ECU_ADDRESS 0xd00044b5 FORMAT "%3.0" /end MEASUREMENT
/begin MEASUREMENT fmy_stat_pue_ls_down_1.err_info_stat.lv_err_mem "Failure is stored in dynamic memory (2nd layer)" UWORD _CNV_S_2_RANGE__0___1_CM 1 100. 0. 1. DISPLAY_IDENTIFIER LV_ERR_MEM_PUE_LS_DOWN_1 ECU_ADDRESS 0xd00044b6 BIT_MASK 0x8 /end MEASUREMENT
/begin MEASUREMENT fmy_stat_pue_ls_down_1.err_info_stat.lv_ready "Readiness flag related to diagnosis XX" UWORD _CNV_S_2_RANGE__0___1_CM 1 100. 0. 1. DISPLAY_IDENTIFIER LV_READY_PUE_LS_DOWN_1 ECU_ADDRESS 0xd00044b6 BIT_MASK 0x10 /end MEASUREMENT
/begin MEASUREMENT fmy_stat_pue_ls_down_1.err_info_stat.lv_end_diag "End of diagnosis XX" UWORD _CNV_S_2_RANGE__0___1_CM 1 100. 0. 1. DISPLAY_IDENTIFIER LV_END_DIAG_PUE_LS_DOWN_1 ECU_ADDRESS 0xd00044b6 BIT_MASK 0x20 /end MEASUREMENT
/begin MEASUREMENT fmy_stat_pue_ls_down_1.err_info_stat.lv_cdn_diag "Diagnosis condition to start symptom detection (set to 1 when condition is fulfilled)" UWORD _CNV_S_2_RANGE__0___1_CM 1 100. 0. 1. DISPLAY_IDENTIFIER LV_CDN_DIAG_PUE_LS_DOWN_1 ECU_ADDRESS 0xd00044b6 BIT_MASK 0x40 /end MEASUREMENT
/begin MEASUREMENT fmy_stat_pue_ls_down_1.err_info_stat.err_sym "For each symptom: status of failure (set to 1 when failure symptom is detected)" UWORD _CNV_S_16_RANGE_ERR__485_CM 1 100. 0. 15. DISPLAY_IDENTIFIER ERR_SYM_PUE_LS_DOWN_1 ECU_ADDRESS 0xd00044b6 BIT_MASK 0x780 /end MEASUREMENT
/begin MEASUREMENT fmy_stat_swt_ls_down_1.ctr_abc "anti-bounce counter for diagnosis XX" UBYTE _CNV_A_R_LINEAR_____0_CM 1 100. 0. 255. DISPLAY_IDENTIFIER CTR_ABC_SWT_LS_DOWN_1 ECU_ADDRESS 0xd0004554 FORMAT "%3.0" /end MEASUREMENT
/begin MEASUREMENT fmy_stat_swt_ls_down_1.ctr_end_diag "Counter for the end of diagnosis XX generation" UBYTE _CNV_A_R_LINEAR_____0_CM 1 100. 0. 255. DISPLAY_IDENTIFIER CTR_ABC_END_DIAG_SWT_LS_DOWN_1 ECU_ADDRESS 0xd0004555 FORMAT "%3.0" /end MEASUREMENT
/begin MEASUREMENT fmy_stat_swt_ls_down_1.err_info_stat.lv_err_mem "Failure is stored in dynamic memory (2nd layer)" UWORD _CNV_S_2_RANGE__0___1_CM 1 100. 0. 1. DISPLAY_IDENTIFIER LV_ERR_MEM_SWT_LS_DOWN_1 ECU_ADDRESS 0xd0004556 BIT_MASK 0x8 /end MEASUREMENT
/begin MEASUREMENT fmy_stat_swt_ls_down_1.err_info_stat.lv_ready "Readiness flag related to diagnosis XX" UWORD _CNV_S_2_RANGE__0___1_CM 1 100. 0. 1. DISPLAY_IDENTIFIER LV_READY_SWT_LS_DOWN_1 ECU_ADDRESS 0xd0004556 BIT_MASK 0x10 /end MEASUREMENT
/begin MEASUREMENT fmy_stat_swt_ls_down_1.err_info_stat.lv_end_diag "End of diagnosis XX" UWORD _CNV_S_2_RANGE__0___1_CM 1 100. 0. 1. DISPLAY_IDENTIFIER LV_END_DIAG_SWT_LS_DOWN_1 ECU_ADDRESS 0xd0004556 BIT_MASK 0x20 /end MEASUREMENT
/begin MEASUREMENT fmy_stat_swt_ls_down_1.err_info_stat.lv_cdn_diag "Diagnosis condition to start symptom detection (set to 1 when condition is fulfilled)" UWORD _CNV_S_2_RANGE__0___1_CM 1 100. 0. 1. DISPLAY_IDENTIFIER LV_CDN_DIAG_SWT_LS_DOWN_1 ECU_ADDRESS 0xd0004556 BIT_MASK 0x40 /end MEASUREMENT
/begin MEASUREMENT fmy_stat_swt_ls_down_1.err_info_stat.err_sym "For each symptom: status of failure (set to 1 when failure symptom is detected)" UWORD _CNV_S_16_RANGE_ERR__485_CM 1 100. 0. 15. DISPLAY_IDENTIFIER ERR_SYM_SWT_LS_DOWN_1 ECU_ADDRESS 0xd0004556 BIT_MASK 0x780 /end MEASUREMENT
/begin MEASUREMENT fmy_stat_obd_lsh_down_1.ctr_abc "anti-bounce counter for diagnosis XX" UBYTE _CNV_A_R_LINEAR_____0_CM 1 100. 0. 255. DISPLAY_IDENTIFIER CTR_ABC_OBD_LSH_DOWN_1 ECU_ADDRESS 0xd0004468 FORMAT "%3.0" /end MEASUREMENT
/begin MEASUREMENT fmy_stat_obd_lsh_down_1.ctr_end_diag "Counter for the end of diagnosis XX generation" UBYTE _CNV_A_R_LINEAR_____0_CM 1 100. 0. 255. DISPLAY_IDENTIFIER CTR_ABC_END_DIAG_OBD_LSH_DOWN_1 ECU_ADDRESS 0xd0004469 FORMAT "%3.0" /end MEASUREMENT
/begin MEASUREMENT fmy_stat_obd_lsh_down_1.err_info_stat.lv_err_mem "Failure is stored in dynamic memory (2nd layer)" UWORD _CNV_S_2_RANGE__0___1_CM 1 100. 0. 1. DISPLAY_IDENTIFIER LV_ERR_MEM_OBD_LSH_DOWN_1 ECU_ADDRESS 0xd000446a BIT_MASK 0x8 /end MEASUREMENT
/begin MEASUREMENT fmy_stat_obd_lsh_down_1.err_info_stat.lv_ready "Readiness flag related to diagnosis XX" UWORD _CNV_S_2_RANGE__0___1_CM 1 100. 0. 1. DISPLAY_IDENTIFIER LV_READY_OBD_LSH_DOWN_1 ECU_ADDRESS 0xd000446a BIT_MASK 0x10 /end MEASUREMENT
/begin MEASUREMENT fmy_stat_obd_lsh_down_1.err_info_stat.lv_end_diag "End of diagnosis XX" UWORD _CNV_S_2_RANGE__0___1_CM 1 100. 0. 1. DISPLAY_IDENTIFIER LV_END_DIAG_OBD_LSH_DOWN_1 ECU_ADDRESS 0xd000446a BIT_MASK 0x20 /end MEASUREMENT
/begin MEASUREMENT fmy_stat_obd_lsh_down_1.err_info_stat.lv_cdn_diag "Diagnosis condition to start symptom detection (set to 1 when condition is fulfilled)" UWORD _CNV_S_2_RANGE__0___1_CM 1 100. 0. 1. DISPLAY_IDENTIFIER LV_CDN_DIAG_OBD_LSH_DOWN_1 ECU_ADDRESS 0xd000446a BIT_MASK 0x40 /end MEASUREMENT
/begin MEASUREMENT fmy_stat_obd_lsh_down_1.err_info_stat.err_sym "For each symptom: status of failure (set to 1 when failure symptom is detected)" UWORD _CNV_S_16_RANGE_ERR__485_CM 1 100. 0. 15. DISPLAY_IDENTIFIER ERR_SYM_OBD_LSH_DOWN_1 ECU_ADDRESS 0xd000446a BIT_MASK 0x780 /end MEASUREMENT
/begin MEASUREMENT fmy_stat_dyn_vld_ls_up_1.ctr_abc "anti-bounce counter for diagnosis XX" UBYTE _CNV_A_R_LINEAR_____0_CM 1 100. 0. 255. DISPLAY_IDENTIFIER CTR_ABC_DYN_VLD_LS_UP_1 ECU_ADDRESS 0xd00042c4 FORMAT "%3.0" /end MEASUREMENT
/begin MEASUREMENT fmy_stat_dyn_vld_ls_up_1.ctr_end_diag "Counter for the end of diagnosis XX generation" UBYTE _CNV_A_R_LINEAR_____0_CM 1 100. 0. 255. DISPLAY_IDENTIFIER CTR_ABC_END_DIAG_DYN_VLD_LS_UP_1 ECU_ADDRESS 0xd00042c5 FORMAT "%3.0" /end MEASUREMENT
/begin MEASUREMENT fmy_stat_dyn_vld_ls_up_1.err_info_stat.lv_err_mem "Failure is stored in dynamic memory (2nd layer)" UWORD _CNV_S_2_RANGE__0___1_CM 1 100. 0. 1. DISPLAY_IDENTIFIER LV_ERR_MEM_DYN_VLD_LS_UP_1 ECU_ADDRESS 0xd00042c6 BIT_MASK 0x8 /end MEASUREMENT
/begin MEASUREMENT fmy_stat_dyn_vld_ls_up_1.err_info_stat.lv_ready "Readiness flag related to diagnosis XX" UWORD _CNV_S_2_RANGE__0___1_CM 1 100. 0. 1. DISPLAY_IDENTIFIER LV_READY_DYN_VLD_LS_UP_1 ECU_ADDRESS 0xd00042c6 BIT_MASK 0x10 /end MEASUREMENT
/begin MEASUREMENT fmy_stat_dyn_vld_ls_up_1.err_info_stat.lv_end_diag "End of diagnosis XX" UWORD _CNV_S_2_RANGE__0___1_CM 1 100. 0. 1. DISPLAY_IDENTIFIER LV_END_DIAG_DYN_VLD_LS_UP_1 ECU_ADDRESS 0xd00042c6 BIT_MASK 0x20 /end MEASUREMENT
/begin MEASUREMENT fmy_stat_dyn_vld_ls_up_1.err_info_stat.lv_cdn_diag "Diagnosis condition to start symptom detection (set to 1 when condition is fulfilled)" UWORD _CNV_S_2_RANGE__0___1_CM 1 100. 0. 1. DISPLAY_IDENTIFIER LV_CDN_DIAG_DYN_VLD_LS_UP_1 ECU_ADDRESS 0xd00042c6 BIT_MASK 0x40 /end MEASUREMENT
/begin MEASUREMENT fmy_stat_dyn_vld_ls_up_1.err_info_stat.err_sym "For each symptom: status of failure (set to 1 when failure symptom is detected)" UWORD _CNV_S_16_RANGE_ERR__485_CM 1 100. 0. 15. DISPLAY_IDENTIFIER ERR_SYM_DYN_VLD_LS_UP_1 ECU_ADDRESS 0xd00042c6 BIT_MASK 0x780 /end MEASUREMENT
/begin MEASUREMENT fmy_stat_puc_vld_ls_up_1.ctr_abc "anti-bounce counter for diagnosis XX" UBYTE _CNV_A_R_LINEAR_____0_CM 1 100. 0. 255. DISPLAY_IDENTIFIER CTR_ABC_PUC_VLD_LS_UP_1 ECU_ADDRESS 0xd00044ac FORMAT "%3.0" /end MEASUREMENT
/begin MEASUREMENT fmy_stat_puc_vld_ls_up_1.ctr_end_diag "Counter for the end of diagnosis XX generation" UBYTE _CNV_A_R_LINEAR_____0_CM 1 100. 0. 255. DISPLAY_IDENTIFIER CTR_ABC_END_DIAG_PUC_VLD_LS_UP_1 ECU_ADDRESS 0xd00044ad FORMAT "%3.0" /end MEASUREMENT
/begin MEASUREMENT fmy_stat_puc_vld_ls_up_1.err_info_stat.lv_err_mem "Failure is stored in dynamic memory (2nd layer)" UWORD _CNV_S_2_RANGE__0___1_CM 1 100. 0. 1. DISPLAY_IDENTIFIER LV_ERR_MEM_PUC_VLD_LS_UP_1 ECU_ADDRESS 0xd00044ae BIT_MASK 0x8 /end MEASUREMENT
/begin MEASUREMENT fmy_stat_puc_vld_ls_up_1.err_info_stat.lv_ready "Readiness flag related to diagnosis XX" UWORD _CNV_S_2_RANGE__0___1_CM 1 100. 0. 1. DISPLAY_IDENTIFIER LV_READY_PUC_VLD_LS_UP_1 ECU_ADDRESS 0xd00044ae BIT_MASK 0x10 /end MEASUREMENT
/begin MEASUREMENT fmy_stat_puc_vld_ls_up_1.err_info_stat.lv_end_diag "End of diagnosis XX" UWORD _CNV_S_2_RANGE__0___1_CM 1 100. 0. 1. DISPLAY_IDENTIFIER LV_END_DIAG_PUC_VLD_LS_UP_1 ECU_ADDRESS 0xd00044ae BIT_MASK 0x20 /end MEASUREMENT
/begin MEASUREMENT fmy_stat_puc_vld_ls_up_1.err_info_stat.lv_cdn_diag "Diagnosis condition to start symptom detection (set to 1 when condition is fulfilled)" UWORD _CNV_S_2_RANGE__0___1_CM 1 100. 0. 1. DISPLAY_IDENTIFIER LV_CDN_DIAG_PUC_VLD_LS_UP_1 ECU_ADDRESS 0xd00044ae BIT_MASK 0x40 /end MEASUREMENT
/begin MEASUREMENT fmy_stat_puc_vld_ls_up_1.err_info_stat.err_sym "For each symptom: status of failure (set to 1 when failure symptom is detected)" UWORD _CNV_S_16_RANGE_ERR__485_CM 1 100. 0. 15. DISPLAY_IDENTIFIER ERR_SYM_PUC_VLD_LS_UP_1 ECU_ADDRESS 0xd00044ae BIT_MASK 0x780 /end MEASUREMENT
/begin MEASUREMENT fmy_stat_obd_vld_lsh_up_1.ctr_abc "anti-bounce counter for diagnosis XX" UBYTE _CNV_A_R_LINEAR_____0_CM 1 100. 0. 255. DISPLAY_IDENTIFIER CTR_ABC_OBD_VLD_LSH_UP_1 ECU_ADDRESS 0xd0004470 FORMAT "%3.0" /end MEASUREMENT
/begin MEASUREMENT fmy_stat_obd_vld_lsh_up_1.ctr_end_diag "Counter for the end of diagnosis XX generation" UBYTE _CNV_A_R_LINEAR_____0_CM 1 100. 0. 255. DISPLAY_IDENTIFIER CTR_ABC_END_DIAG_OBD_VLD_LSH_UP_1 ECU_ADDRESS 0xd0004471 FORMAT "%3.0" /end MEASUREMENT
/begin MEASUREMENT fmy_stat_obd_vld_lsh_up_1.err_info_stat.lv_err_mem "Failure is stored in dynamic memory (2nd layer)" UWORD _CNV_S_2_RANGE__0___1_CM 1 100. 0. 1. DISPLAY_IDENTIFIER LV_ERR_MEM_OBD_VLD_LSH_UP_1 ECU_ADDRESS 0xd0004472 BIT_MASK 0x8 /end MEASUREMENT
/begin MEASUREMENT fmy_stat_obd_vld_lsh_up_1.err_info_stat.lv_ready "Readiness flag related to diagnosis XX" UWORD _CNV_S_2_RANGE__0___1_CM 1 100. 0. 1. DISPLAY_IDENTIFIER LV_READY_OBD_VLD_LSH_UP_1 ECU_ADDRESS 0xd0004472 BIT_MASK 0x10 /end MEASUREMENT
/begin MEASUREMENT fmy_stat_obd_vld_lsh_up_1.err_info_stat.lv_end_diag "End of diagnosis XX" UWORD _CNV_S_2_RANGE__0___1_CM 1 100. 0. 1. DISPLAY_IDENTIFIER LV_END_DIAG_OBD_VLD_LSH_UP_1 ECU_ADDRESS 0xd0004472 BIT_MASK 0x20 /end MEASUREMENT
/begin MEASUREMENT fmy_stat_obd_vld_lsh_up_1.err_info_stat.lv_cdn_diag "Diagnosis condition to start symptom detection (set to 1 when condition is fulfilled)" UWORD _CNV_S_2_RANGE__0___1_CM 1 100. 0. 1. DISPLAY_IDENTIFIER LV_CDN_DIAG_OBD_VLD_LSH_UP_1 ECU_ADDRESS 0xd0004472 BIT_MASK 0x40 /end MEASUREMENT
/begin MEASUREMENT fmy_stat_obd_vld_lsh_up_1.err_info_stat.err_sym "For each symptom: status of failure (set to 1 when failure symptom is detected)" UWORD _CNV_S_16_RANGE_ERR__485_CM 1 100. 0. 15. DISPLAY_IDENTIFIER ERR_SYM_OBD_VLD_LSH_UP_1 ECU_ADDRESS 0xd0004472 BIT_MASK 0x780 /end MEASUREMENT
/begin MEASUREMENT fmy_stat_chk_ls_down_1.ctr_abc "anti-bounce counter for diagnosis XX" UBYTE _CNV_A_R_LINEAR_____0_CM 1 100. 0. 255. DISPLAY_IDENTIFIER CTR_ABC_CHK_LS_DOWN_1 ECU_ADDRESS 0xd0004260 FORMAT "%3.0" /end MEASUREMENT
/begin MEASUREMENT fmy_stat_chk_ls_down_1.ctr_end_diag "Counter for the end of diagnosis XX generation" UBYTE _CNV_A_R_LINEAR_____0_CM 1 100. 0. 255. DISPLAY_IDENTIFIER CTR_ABC_END_DIAG_CHK_LS_DOWN_1 ECU_ADDRESS 0xd0004261 FORMAT "%3.0" /end MEASUREMENT
/begin MEASUREMENT fmy_stat_chk_ls_down_1.err_info_stat.lv_err_mem "Failure is stored in dynamic memory (2nd layer)" UWORD _CNV_S_2_RANGE__0___1_CM 1 100. 0. 1. DISPLAY_IDENTIFIER LV_ERR_MEM_CHK_LS_DOWN_1 ECU_ADDRESS 0xd0004262 BIT_MASK 0x8 /end MEASUREMENT
/begin MEASUREMENT fmy_stat_chk_ls_down_1.err_info_stat.lv_ready "Readiness flag related to diagnosis XX" UWORD _CNV_S_2_RANGE__0___1_CM 1 100. 0. 1. DISPLAY_IDENTIFIER LV_READY_CHK_LS_DOWN_1 ECU_ADDRESS 0xd0004262 BIT_MASK 0x10 /end MEASUREMENT
/begin MEASUREMENT fmy_stat_chk_ls_down_1.err_info_stat.lv_end_diag "End of diagnosis XX" UWORD _CNV_S_2_RANGE__0___1_CM 1 100. 0. 1. DISPLAY_IDENTIFIER LV_END_DIAG_CHK_LS_DOWN_1 ECU_ADDRESS 0xd0004262 BIT_MASK 0x20 /end MEASUREMENT
/begin MEASUREMENT fmy_stat_chk_ls_down_1.err_info_stat.lv_cdn_diag "Diagnosis condition to start symptom detection (set to 1 when condition is fulfilled)" UWORD _CNV_S_2_RANGE__0___1_CM 1 100. 0. 1. DISPLAY_IDENTIFIER LV_CDN_DIAG_CHK_LS_DOWN_1 ECU_ADDRESS 0xd0004262 BIT_MASK 0x40 /end MEASUREMENT
/begin MEASUREMENT fmy_stat_chk_ls_down_1.err_info_stat.err_sym "For each symptom: status of failure (set to 1 when failure symptom is detected)" UWORD _CNV_S_16_RANGE_ERR__485_CM 1 100. 0. 15. DISPLAY_IDENTIFIER ERR_SYM_CHK_LS_DOWN_1 ECU_ADDRESS 0xd0004262 BIT_MASK 0x780 /end MEASUREMENT
/begin MEASUREMENT fmy_stat_shift_afl_lsl_up_1.ctr_abc "anti-bounce counter for diagnosis XX" UBYTE _CNV_A_R_LINEAR_____0_CM 1 100. 0. 255. DISPLAY_IDENTIFIER CTR_ABC_SHIFT_AFL_LSL_UP_1 ECU_ADDRESS 0xd0004528 FORMAT "%3.0" /end MEASUREMENT
/begin MEASUREMENT fmy_stat_shift_afl_lsl_up_1.ctr_end_diag "Counter for the end of diagnosis XX generation" UBYTE _CNV_A_R_LINEAR_____0_CM 1 100. 0. 255. DISPLAY_IDENTIFIER CTR_ABC_END_DIAG_SHIFT_AFL_LSL_UP_1 ECU_ADDRESS 0xd0004529 FORMAT "%3.0" /end MEASUREMENT
/begin MEASUREMENT fmy_stat_shift_afl_lsl_up_1.err_info_stat.lv_err_mem "Failure is stored in dynamic memory (2nd layer)" UWORD _CNV_S_2_RANGE__0___1_CM 1 100. 0. 1. DISPLAY_IDENTIFIER LV_ERR_MEM_SHIFT_AFL_LSL_UP_1 ECU_ADDRESS 0xd000452a BIT_MASK 0x8 /end MEASUREMENT
/begin MEASUREMENT fmy_stat_shift_afl_lsl_up_1.err_info_stat.lv_ready "Readiness flag related to diagnosis XX" UWORD _CNV_S_2_RANGE__0___1_CM 1 100. 0. 1. DISPLAY_IDENTIFIER LV_READY_SHIFT_AFL_LSL_UP_1 ECU_ADDRESS 0xd000452a BIT_MASK 0x10 /end MEASUREMENT
/begin MEASUREMENT fmy_stat_shift_afl_lsl_up_1.err_info_stat.lv_end_diag "End of diagnosis XX" UWORD _CNV_S_2_RANGE__0___1_CM 1 100. 0. 1. DISPLAY_IDENTIFIER LV_END_DIAG_SHIFT_AFL_LSL_UP_1 ECU_ADDRESS 0xd000452a BIT_MASK 0x20 /end MEASUREMENT
/begin MEASUREMENT fmy_stat_shift_afl_lsl_up_1.err_info_stat.lv_cdn_diag "Diagnosis condition to start symptom detection (set to 1 when condition is fulfilled)" UWORD _CNV_S_2_RANGE__0___1_CM 1 100. 0. 1. DISPLAY_IDENTIFIER LV_CDN_DIAG_SHIFT_AFL_LSL_UP_1 ECU_ADDRESS 0xd000452a BIT_MASK 0x40 /end MEASUREMENT
/begin MEASUREMENT fmy_stat_shift_afl_lsl_up_1.err_info_stat.err_sym "For each symptom: status of failure (set to 1 when failure symptom is detected)" UWORD _CNV_S_16_RANGE_ERR__485_CM 1 100. 0. 15. DISPLAY_IDENTIFIER ERR_SYM_SHIFT_AFL_LSL_UP_1 ECU_ADDRESS 0xd000452a BIT_MASK 0x780 /end MEASUREMENT
/begin MEASUREMENT fmy_stat_shift_afr_lsl_up_1.ctr_abc "anti-bounce counter for diagnosis XX" UBYTE _CNV_A_R_LINEAR_____0_CM 1 100. 0. 255. DISPLAY_IDENTIFIER CTR_ABC_SHIFT_AFR_LSL_UP_1 ECU_ADDRESS 0xd0004530 FORMAT "%3.0" /end MEASUREMENT
/begin MEASUREMENT fmy_stat_shift_afr_lsl_up_1.ctr_end_diag "Counter for the end of diagnosis XX generation" UBYTE _CNV_A_R_LINEAR_____0_CM 1 100. 0. 255. DISPLAY_IDENTIFIER CTR_ABC_END_DIAG_SHIFT_AFR_LSL_UP_1 ECU_ADDRESS 0xd0004531 FORMAT "%3.0" /end MEASUREMENT
/begin MEASUREMENT fmy_stat_shift_afr_lsl_up_1.err_info_stat.lv_err_mem "Failure is stored in dynamic memory (2nd layer)" UWORD _CNV_S_2_RANGE__0___1_CM 1 100. 0. 1. DISPLAY_IDENTIFIER LV_ERR_MEM_SHIFT_AFR_LSL_UP_1 ECU_ADDRESS 0xd0004532 BIT_MASK 0x8 /end MEASUREMENT
/begin MEASUREMENT fmy_stat_shift_afr_lsl_up_1.err_info_stat.lv_ready "Readiness flag related to diagnosis XX" UWORD _CNV_S_2_RANGE__0___1_CM 1 100. 0. 1. DISPLAY_IDENTIFIER LV_READY_SHIFT_AFR_LSL_UP_1 ECU_ADDRESS 0xd0004532 BIT_MASK 0x10 /end MEASUREMENT
/begin MEASUREMENT fmy_stat_shift_afr_lsl_up_1.err_info_stat.lv_end_diag "End of diagnosis XX" UWORD _CNV_S_2_RANGE__0___1_CM 1 100. 0. 1. DISPLAY_IDENTIFIER LV_END_DIAG_SHIFT_AFR_LSL_UP_1 ECU_ADDRESS 0xd0004532 BIT_MASK 0x20 /end MEASUREMENT
/begin MEASUREMENT fmy_stat_shift_afr_lsl_up_1.err_info_stat.lv_cdn_diag "Diagnosis condition to start symptom detection (set to 1 when condition is fulfilled)" UWORD _CNV_S_2_RANGE__0___1_CM 1 100. 0. 1. DISPLAY_IDENTIFIER LV_CDN_DIAG_SHIFT_AFR_LSL_UP_1 ECU_ADDRESS 0xd0004532 BIT_MASK 0x40 /end MEASUREMENT
/begin MEASUREMENT fmy_stat_shift_afr_lsl_up_1.err_info_stat.err_sym "For each symptom: status of failure (set to 1 when failure symptom is detected)" UWORD _CNV_S_16_RANGE_ERR__485_CM 1 100. 0. 15. DISPLAY_IDENTIFIER ERR_SYM_SHIFT_AFR_LSL_UP_1 ECU_ADDRESS 0xd0004532 BIT_MASK 0x780 /end MEASUREMENT
/begin MEASUREMENT fmy_stat_oc_lsl_up_1.ctr_abc "anti-bounce counter for diagnosis XX" UBYTE _CNV_A_R_LINEAR_____0_CM 1 100. 0. 255. DISPLAY_IDENTIFIER CTR_ABC_OC_LSL_UP_1 ECU_ADDRESS 0xd0004480 FORMAT "%3.0" /end MEASUREMENT
/begin MEASUREMENT fmy_stat_oc_lsl_up_1.ctr_end_diag "Counter for the end of diagnosis XX generation" UBYTE _CNV_A_R_LINEAR_____0_CM 1 100. 0. 255. DISPLAY_IDENTIFIER CTR_ABC_END_DIAG_OC_LSL_UP_1 ECU_ADDRESS 0xd0004481 FORMAT "%3.0" /end MEASUREMENT
/begin MEASUREMENT fmy_stat_oc_lsl_up_1.err_info_stat.lv_err_mem "Failure is stored in dynamic memory (2nd layer)" UWORD _CNV_S_2_RANGE__0___1_CM 1 100. 0. 1. DISPLAY_IDENTIFIER LV_ERR_MEM_OC_LSL_UP_1 ECU_ADDRESS 0xd0004482 BIT_MASK 0x8 /end MEASUREMENT
/begin MEASUREMENT fmy_stat_oc_lsl_up_1.err_info_stat.lv_ready "Readiness flag related to diagnosis XX" UWORD _CNV_S_2_RANGE__0___1_CM 1 100. 0. 1. DISPLAY_IDENTIFIER LV_READY_OC_LSL_UP_1 ECU_ADDRESS 0xd0004482 BIT_MASK 0x10 /end MEASUREMENT
/begin MEASUREMENT fmy_stat_oc_lsl_up_1.err_info_stat.lv_end_diag "End of diagnosis XX" UWORD _CNV_S_2_RANGE__0___1_CM 1 100. 0. 1. DISPLAY_IDENTIFIER LV_END_DIAG_OC_LSL_UP_1 ECU_ADDRESS 0xd0004482 BIT_MASK 0x20 /end MEASUREMENT
/begin MEASUREMENT fmy_stat_oc_lsl_up_1.err_info_stat.lv_cdn_diag "Diagnosis condition to start symptom detection (set to 1 when condition is fulfilled)" UWORD _CNV_S_2_RANGE__0___1_CM 1 100. 0. 1. DISPLAY_IDENTIFIER LV_CDN_DIAG_OC_LSL_UP_1 ECU_ADDRESS 0xd0004482 BIT_MASK 0x40 /end MEASUREMENT
/begin MEASUREMENT fmy_stat_oc_lsl_up_1.err_info_stat.err_sym "For each symptom: status of failure (set to 1 when failure symptom is detected)" UWORD _CNV_S_16_RANGE_ERR__485_CM 1 100. 0. 15. DISPLAY_IDENTIFIER ERR_SYM_OC_LSL_UP_1 ECU_ADDRESS 0xd0004482 BIT_MASK 0x780 /end MEASUREMENT
/begin MEASUREMENT fmy_stat_delta_i_lam_1.ctr_abc "anti-bounce counter for diagnosis XX" UBYTE _CNV_A_R_LINEAR_____0_CM 1 100. 0. 255. DISPLAY_IDENTIFIER CTR_ABC_DELTA_I_LAM_1 ECU_ADDRESS 0xd00042a4 FORMAT "%3.0" /end MEASUREMENT
/begin MEASUREMENT fmy_stat_delta_i_lam_1.ctr_end_diag "Counter for the end of diagnosis XX generation" UBYTE _CNV_A_R_LINEAR_____0_CM 1 100. 0. 255. DISPLAY_IDENTIFIER CTR_ABC_END_DIAG_DELTA_I_LAM_1 ECU_ADDRESS 0xd00042a5 FORMAT "%3.0" /end MEASUREMENT
/begin MEASUREMENT fmy_stat_delta_i_lam_1.err_info_stat.lv_err_mem "Failure is stored in dynamic memory (2nd layer)" UWORD _CNV_S_2_RANGE__0___1_CM 1 100. 0. 1. DISPLAY_IDENTIFIER LV_ERR_MEM_DELTA_I_LAM_1 ECU_ADDRESS 0xd00042a6 BIT_MASK 0x8 /end MEASUREMENT
/begin MEASUREMENT fmy_stat_delta_i_lam_1.err_info_stat.lv_ready "Readiness flag related to diagnosis XX" UWORD _CNV_S_2_RANGE__0___1_CM 1 100. 0. 1. DISPLAY_IDENTIFIER LV_READY_DELTA_I_LAM_1 ECU_ADDRESS 0xd00042a6 BIT_MASK 0x10 /end MEASUREMENT
/begin MEASUREMENT fmy_stat_delta_i_lam_1.err_info_stat.lv_end_diag "End of diagnosis XX" UWORD _CNV_S_2_RANGE__0___1_CM 1 100. 0. 1. DISPLAY_IDENTIFIER LV_END_DIAG_DELTA_I_LAM_1 ECU_ADDRESS 0xd00042a6 BIT_MASK 0x20 /end MEASUREMENT
/begin MEASUREMENT fmy_stat_delta_i_lam_1.err_info_stat.lv_cdn_diag "Diagnosis condition to start symptom detection (set to 1 when condition is fulfilled)" UWORD _CNV_S_2_RANGE__0___1_CM 1 100. 0. 1. DISPLAY_IDENTIFIER LV_CDN_DIAG_DELTA_I_LAM_1 ECU_ADDRESS 0xd00042a6 BIT_MASK 0x40 /end MEASUREMENT
/begin MEASUREMENT fmy_stat_delta_i_lam_1.err_info_stat.err_sym "For each symptom: status of failure (set to 1 when failure symptom is detected)" UWORD _CNV_S_16_RANGE_ERR__485_CM 1 100. 0. 15. DISPLAY_IDENTIFIER ERR_SYM_DELTA_I_LAM_1 ECU_ADDRESS 0xd00042a6 BIT_MASK 0x780 /end MEASUREMENT
/begin MEASUREMENT fmy_stat_rgn_nt_ls_down_1.ctr_abc "anti-bounce counter for diagnosis XX" UBYTE _CNV_A_R_LINEAR_____0_CM 1 100. 0. 255. DISPLAY_IDENTIFIER CTR_ABC_RGN_NT_LS_DOWN_1 ECU_ADDRESS 0xd00044e4 FORMAT "%3.0" /end MEASUREMENT
/begin MEASUREMENT fmy_stat_rgn_nt_ls_down_1.ctr_end_diag "Counter for the end of diagnosis XX generation" UBYTE _CNV_A_R_LINEAR_____0_CM 1 100. 0. 255. DISPLAY_IDENTIFIER CTR_ABC_END_DIAG_RGN_NT_LS_DOWN_1 ECU_ADDRESS 0xd00044e5 FORMAT "%3.0" /end MEASUREMENT
/begin MEASUREMENT fmy_stat_rgn_nt_ls_down_1.err_info_stat.lv_err_mem "Failure is stored in dynamic memory (2nd layer)" UWORD _CNV_S_2_RANGE__0___1_CM 1 100. 0. 1. DISPLAY_IDENTIFIER LV_ERR_MEM_RGN_NT_LS_DOWN_1 ECU_ADDRESS 0xd00044e6 BIT_MASK 0x8 /end MEASUREMENT
/begin MEASUREMENT fmy_stat_rgn_nt_ls_down_1.err_info_stat.lv_ready "Readiness flag related to diagnosis XX" UWORD _CNV_S_2_RANGE__0___1_CM 1 100. 0. 1. DISPLAY_IDENTIFIER LV_READY_RGN_NT_LS_DOWN_1 ECU_ADDRESS 0xd00044e6 BIT_MASK 0x10 /end MEASUREMENT
/begin MEASUREMENT fmy_stat_rgn_nt_ls_down_1.err_info_stat.lv_end_diag "End of diagnosis XX" UWORD _CNV_S_2_RANGE__0___1_CM 1 100. 0. 1. DISPLAY_IDENTIFIER LV_END_DIAG_RGN_NT_LS_DOWN_1 ECU_ADDRESS 0xd00044e6 BIT_MASK 0x20 /end MEASUREMENT
/begin MEASUREMENT fmy_stat_rgn_nt_ls_down_1.err_info_stat.lv_cdn_diag "Diagnosis condition to start symptom detection (set to 1 when condition is fulfilled)" UWORD _CNV_S_2_RANGE__0___1_CM 1 100. 0. 1. DISPLAY_IDENTIFIER LV_CDN_DIAG_RGN_NT_LS_DOWN_1 ECU_ADDRESS 0xd00044e6 BIT_MASK 0x40 /end MEASUREMENT
/begin MEASUREMENT fmy_stat_rgn_nt_ls_down_1.err_info_stat.err_sym "For each symptom: status of failure (set to 1 when failure symptom is detected)" UWORD _CNV_S_16_RANGE_ERR__485_CM 1 100. 0. 15. DISPLAY_IDENTIFIER ERR_SYM_RGN_NT_LS_DOWN_1 ECU_ADDRESS 0xd00044e6 BIT_MASK 0x780 /end MEASUREMENT
/begin MEASUREMENT fmy_stat_chg_ls_down.ctr_abc "anti-bounce counter for diagnosis XX" UBYTE _CNV_A_R_LINEAR_____0_CM 1 100. 0. 255. DISPLAY_IDENTIFIER CTR_ABC_CHG_LS_DOWN ECU_ADDRESS 0xd0004254 FORMAT "%3.0" /end MEASUREMENT
/begin MEASUREMENT fmy_stat_chg_ls_down.ctr_end_diag "Counter for the end of diagnosis XX generation" UBYTE _CNV_A_R_LINEAR_____0_CM 1 100. 0. 255. DISPLAY_IDENTIFIER CTR_ABC_END_DIAG_CHG_LS_DOWN ECU_ADDRESS 0xd0004255 FORMAT "%3.0" /end MEASUREMENT
/begin MEASUREMENT fmy_stat_chg_ls_down.err_info_stat.lv_err_mem "Failure is stored in dynamic memory (2nd layer)" UWORD _CNV_S_2_RANGE__0___1_CM 1 100. 0. 1. DISPLAY_IDENTIFIER LV_ERR_MEM_CHG_LS_DOWN ECU_ADDRESS 0xd0004256 BIT_MASK 0x8 /end MEASUREMENT
/begin MEASUREMENT fmy_stat_chg_ls_down.err_info_stat.lv_ready "Readiness flag related to diagnosis XX" UWORD _CNV_S_2_RANGE__0___1_CM 1 100. 0. 1. DISPLAY_IDENTIFIER LV_READY_CHG_LS_DOWN ECU_ADDRESS 0xd0004256 BIT_MASK 0x10 /end MEASUREMENT
/begin MEASUREMENT fmy_stat_chg_ls_down.err_info_stat.lv_end_diag "End of diagnosis XX" UWORD _CNV_S_2_RANGE__0___1_CM 1 100. 0. 1. DISPLAY_IDENTIFIER LV_END_DIAG_CHG_LS_DOWN ECU_ADDRESS 0xd0004256 BIT_MASK 0x20 /end MEASUREMENT
/begin MEASUREMENT fmy_stat_chg_ls_down.err_info_stat.lv_cdn_diag "Diagnosis condition to start symptom detection (set to 1 when condition is fulfilled)" UWORD _CNV_S_2_RANGE__0___1_CM 1 100. 0. 1. DISPLAY_IDENTIFIER LV_CDN_DIAG_CHG_LS_DOWN ECU_ADDRESS 0xd0004256 BIT_MASK 0x40 /end MEASUREMENT
/begin MEASUREMENT fmy_stat_chg_ls_down.err_info_stat.err_sym "For each symptom: status of failure (set to 1 when failure symptom is detected)" UWORD _CNV_S_16_RANGE_ERR__485_CM 1 100. 0. 15. DISPLAY_IDENTIFIER ERR_SYM_CHG_LS_DOWN ECU_ADDRESS 0xd0004256 BIT_MASK 0x780 /end MEASUREMENT
/begin MEASUREMENT fmy_stat_scg_ls_down_2.ctr_abc "anti-bounce counter for diagnosis XX" UBYTE _CNV_A_R_LINEAR_____0_CM 1 100. 0. 255. DISPLAY_IDENTIFIER CTR_ABC_SCG_LS_DOWN_2 ECU_ADDRESS 0xd0004510 FORMAT "%3.0" /end MEASUREMENT
/begin MEASUREMENT fmy_stat_scg_ls_down_2.ctr_end_diag "Counter for the end of diagnosis XX generation" UBYTE _CNV_A_R_LINEAR_____0_CM 1 100. 0. 255. DISPLAY_IDENTIFIER CTR_ABC_END_DIAG_SCG_LS_DOWN_2 ECU_ADDRESS 0xd0004511 FORMAT "%3.0" /end MEASUREMENT
/begin MEASUREMENT fmy_stat_scg_ls_down_2.err_info_stat.lv_err_mem "Failure is stored in dynamic memory (2nd layer)" UWORD _CNV_S_2_RANGE__0___1_CM 1 100. 0. 1. DISPLAY_IDENTIFIER LV_ERR_MEM_SCG_LS_DOWN_2 ECU_ADDRESS 0xd0004512 BIT_MASK 0x8 /end MEASUREMENT
/begin MEASUREMENT fmy_stat_scg_ls_down_2.err_info_stat.lv_ready "Readiness flag related to diagnosis XX" UWORD _CNV_S_2_RANGE__0___1_CM 1 100. 0. 1. DISPLAY_IDENTIFIER LV_READY_SCG_LS_DOWN_2 ECU_ADDRESS 0xd0004512 BIT_MASK 0x10 /end MEASUREMENT
/begin MEASUREMENT fmy_stat_scg_ls_down_2.err_info_stat.lv_end_diag "End of diagnosis XX" UWORD _CNV_S_2_RANGE__0___1_CM 1 100. 0. 1. DISPLAY_IDENTIFIER LV_END_DIAG_SCG_LS_DOWN_2 ECU_ADDRESS 0xd0004512 BIT_MASK 0x20 /end MEASUREMENT
/begin MEASUREMENT fmy_stat_scg_ls_down_2.err_info_stat.lv_cdn_diag "Diagnosis condition to start symptom detection (set to 1 when condition is fulfilled)" UWORD _CNV_S_2_RANGE__0___1_CM 1 100. 0. 1. DISPLAY_IDENTIFIER LV_CDN_DIAG_SCG_LS_DOWN_2 ECU_ADDRESS 0xd0004512 BIT_MASK 0x40 /end MEASUREMENT
/begin MEASUREMENT fmy_stat_scg_ls_down_2.err_info_stat.err_sym "For each symptom: status of failure (set to 1 when failure symptom is detected)" UWORD _CNV_S_16_RANGE_ERR__485_CM 1 100. 0. 15. DISPLAY_IDENTIFIER ERR_SYM_SCG_LS_DOWN_2 ECU_ADDRESS 0xd0004512 BIT_MASK 0x780 /end MEASUREMENT
/begin MEASUREMENT fmy_stat_scp_ls_down_2.ctr_abc "anti-bounce counter for diagnosis XX" UBYTE _CNV_A_R_LINEAR_____0_CM 1 100. 0. 255. DISPLAY_IDENTIFIER CTR_ABC_SCP_LS_DOWN_2 ECU_ADDRESS 0xd0004518 FORMAT "%3.0" /end MEASUREMENT
/begin MEASUREMENT fmy_stat_scp_ls_down_2.ctr_end_diag "Counter for the end of diagnosis XX generation" UBYTE _CNV_A_R_LINEAR_____0_CM 1 100. 0. 255. DISPLAY_IDENTIFIER CTR_ABC_END_DIAG_SCP_LS_DOWN_2 ECU_ADDRESS 0xd0004519 FORMAT "%3.0" /end MEASUREMENT
/begin MEASUREMENT fmy_stat_scp_ls_down_2.err_info_stat.lv_err_mem "Failure is stored in dynamic memory (2nd layer)" UWORD _CNV_S_2_RANGE__0___1_CM 1 100. 0. 1. DISPLAY_IDENTIFIER LV_ERR_MEM_SCP_LS_DOWN_2 ECU_ADDRESS 0xd000451a BIT_MASK 0x8 /end MEASUREMENT
/begin MEASUREMENT fmy_stat_scp_ls_down_2.err_info_stat.lv_ready "Readiness flag related to diagnosis XX" UWORD _CNV_S_2_RANGE__0___1_CM 1 100. 0. 1. DISPLAY_IDENTIFIER LV_READY_SCP_LS_DOWN_2 ECU_ADDRESS 0xd000451a BIT_MASK 0x10 /end MEASUREMENT
/begin MEASUREMENT fmy_stat_scp_ls_down_2.err_info_stat.lv_end_diag "End of diagnosis XX" UWORD _CNV_S_2_RANGE__0___1_CM 1 100. 0. 1. DISPLAY_IDENTIFIER LV_END_DIAG_SCP_LS_DOWN_2 ECU_ADDRESS 0xd000451a BIT_MASK 0x20 /end MEASUREMENT
/begin MEASUREMENT fmy_stat_scp_ls_down_2.err_info_stat.lv_cdn_diag "Diagnosis condition to start symptom detection (set to 1 when condition is fulfilled)" UWORD _CNV_S_2_RANGE__0___1_CM 1 100. 0. 1. DISPLAY_IDENTIFIER LV_CDN_DIAG_SCP_LS_DOWN_2 ECU_ADDRESS 0xd000451a BIT_MASK 0x40 /end MEASUREMENT
/begin MEASUREMENT fmy_stat_scp_ls_down_2.err_info_stat.err_sym "For each symptom: status of failure (set to 1 when failure symptom is detected)" UWORD _CNV_S_16_RANGE_ERR__485_CM 1 100. 0. 15. DISPLAY_IDENTIFIER ERR_SYM_SCP_LS_DOWN_2 ECU_ADDRESS 0xd000451a BIT_MASK 0x780 /end MEASUREMENT
/begin MEASUREMENT fmy_stat_oc_ls_down_2.ctr_abc "anti-bounce counter for diagnosis XX" UBYTE _CNV_A_R_LINEAR_____0_CM 1 100. 0. 255. DISPLAY_IDENTIFIER CTR_ABC_OC_LS_DOWN_2 ECU_ADDRESS 0xd000447c FORMAT "%3.0" /end MEASUREMENT
/begin MEASUREMENT fmy_stat_oc_ls_down_2.ctr_end_diag "Counter for the end of diagnosis XX generation" UBYTE _CNV_A_R_LINEAR_____0_CM 1 100. 0. 255. DISPLAY_IDENTIFIER CTR_ABC_END_DIAG_OC_LS_DOWN_2 ECU_ADDRESS 0xd000447d FORMAT "%3.0" /end MEASUREMENT
/begin MEASUREMENT fmy_stat_oc_ls_down_2.err_info_stat.lv_err_mem "Failure is stored in dynamic memory (2nd layer)" UWORD _CNV_S_2_RANGE__0___1_CM 1 100. 0. 1. DISPLAY_IDENTIFIER LV_ERR_MEM_OC_LS_DOWN_2 ECU_ADDRESS 0xd000447e BIT_MASK 0x8 /end MEASUREMENT
/begin MEASUREMENT fmy_stat_oc_ls_down_2.err_info_stat.lv_ready "Readiness flag related to diagnosis XX" UWORD _CNV_S_2_RANGE__0___1_CM 1 100. 0. 1. DISPLAY_IDENTIFIER LV_READY_OC_LS_DOWN_2 ECU_ADDRESS 0xd000447e BIT_MASK 0x10 /end MEASUREMENT
/begin MEASUREMENT fmy_stat_oc_ls_down_2.err_info_stat.lv_end_diag "End of diagnosis XX" UWORD _CNV_S_2_RANGE__0___1_CM 1 100. 0. 1. DISPLAY_IDENTIFIER LV_END_DIAG_OC_LS_DOWN_2 ECU_ADDRESS 0xd000447e BIT_MASK 0x20 /end MEASUREMENT
/begin MEASUREMENT fmy_stat_oc_ls_down_2.err_info_stat.lv_cdn_diag "Diagnosis condition to start symptom detection (set to 1 when condition is fulfilled)" UWORD _CNV_S_2_RANGE__0___1_CM 1 100. 0. 1. DISPLAY_IDENTIFIER LV_CDN_DIAG_OC_LS_DOWN_2 ECU_ADDRESS 0xd000447e BIT_MASK 0x40 /end MEASUREMENT
/begin MEASUREMENT fmy_stat_oc_ls_down_2.err_info_stat.err_sym "For each symptom: status of failure (set to 1 when failure symptom is detected)" UWORD _CNV_S_16_RANGE_ERR__485_CM 1 100. 0. 15. DISPLAY_IDENTIFIER ERR_SYM_OC_LS_DOWN_2 ECU_ADDRESS 0xd000447e BIT_MASK 0x780 /end MEASUREMENT
/begin MEASUREMENT fmy_stat_puc_ls_down_2.ctr_abc "anti-bounce counter for diagnosis XX" UBYTE _CNV_A_R_LINEAR_____0_CM 1 100. 0. 255. DISPLAY_IDENTIFIER CTR_ABC_PUC_LS_DOWN_2 ECU_ADDRESS 0xd00044a8 FORMAT "%3.0" /end MEASUREMENT
/begin MEASUREMENT fmy_stat_puc_ls_down_2.ctr_end_diag "Counter for the end of diagnosis XX generation" UBYTE _CNV_A_R_LINEAR_____0_CM 1 100. 0. 255. DISPLAY_IDENTIFIER CTR_ABC_END_DIAG_PUC_LS_DOWN_2 ECU_ADDRESS 0xd00044a9 FORMAT "%3.0" /end MEASUREMENT
/begin MEASUREMENT fmy_stat_puc_ls_down_2.err_info_stat.lv_err_mem "Failure is stored in dynamic memory (2nd layer)" UWORD _CNV_S_2_RANGE__0___1_CM 1 100. 0. 1. DISPLAY_IDENTIFIER LV_ERR_MEM_PUC_LS_DOWN_2 ECU_ADDRESS 0xd00044aa BIT_MASK 0x8 /end MEASUREMENT
/begin MEASUREMENT fmy_stat_puc_ls_down_2.err_info_stat.lv_ready "Readiness flag related to diagnosis XX" UWORD _CNV_S_2_RANGE__0___1_CM 1 100. 0. 1. DISPLAY_IDENTIFIER LV_READY_PUC_LS_DOWN_2 ECU_ADDRESS 0xd00044aa BIT_MASK 0x10 /end MEASUREMENT
/begin MEASUREMENT fmy_stat_puc_ls_down_2.err_info_stat.lv_end_diag "End of diagnosis XX" UWORD _CNV_S_2_RANGE__0___1_CM 1 100. 0. 1. DISPLAY_IDENTIFIER LV_END_DIAG_PUC_LS_DOWN_2 ECU_ADDRESS 0xd00044aa BIT_MASK 0x20 /end MEASUREMENT
/begin MEASUREMENT fmy_stat_puc_ls_down_2.err_info_stat.lv_cdn_diag "Diagnosis condition to start symptom detection (set to 1 when condition is fulfilled)" UWORD _CNV_S_2_RANGE__0___1_CM 1 100. 0. 1. DISPLAY_IDENTIFIER LV_CDN_DIAG_PUC_LS_DOWN_2 ECU_ADDRESS 0xd00044aa BIT_MASK 0x40 /end MEASUREMENT
/begin MEASUREMENT fmy_stat_puc_ls_down_2.err_info_stat.err_sym "For each symptom: status of failure (set to 1 when failure symptom is detected)" UWORD _CNV_S_16_RANGE_ERR__485_CM 1 100. 0. 15. DISPLAY_IDENTIFIER ERR_SYM_PUC_LS_DOWN_2 ECU_ADDRESS 0xd00044aa BIT_MASK 0x780 /end MEASUREMENT
/begin MEASUREMENT fmy_stat_fl_ls_down_2.ctr_abc "anti-bounce counter for diagnosis XX" UBYTE _CNV_A_R_LINEAR_____0_CM 1 100. 0. 255. DISPLAY_IDENTIFIER CTR_ABC_FL_LS_DOWN_2 ECU_ADDRESS 0xd0004314 FORMAT "%3.0" /end MEASUREMENT
/begin MEASUREMENT fmy_stat_fl_ls_down_2.ctr_end_diag "Counter for the end of diagnosis XX generation" UBYTE _CNV_A_R_LINEAR_____0_CM 1 100. 0. 255. DISPLAY_IDENTIFIER CTR_ABC_END_DIAG_FL_LS_DOWN_2 ECU_ADDRESS 0xd0004315 FORMAT "%3.0" /end MEASUREMENT
/begin MEASUREMENT fmy_stat_fl_ls_down_2.err_info_stat.lv_err_mem "Failure is stored in dynamic memory (2nd layer)" UWORD _CNV_S_2_RANGE__0___1_CM 1 100. 0. 1. DISPLAY_IDENTIFIER LV_ERR_MEM_FL_LS_DOWN_2 ECU_ADDRESS 0xd0004316 BIT_MASK 0x8 /end MEASUREMENT
/begin MEASUREMENT fmy_stat_fl_ls_down_2.err_info_stat.lv_ready "Readiness flag related to diagnosis XX" UWORD _CNV_S_2_RANGE__0___1_CM 1 100. 0. 1. DISPLAY_IDENTIFIER LV_READY_FL_LS_DOWN_2 ECU_ADDRESS 0xd0004316 BIT_MASK 0x10 /end MEASUREMENT
/begin MEASUREMENT fmy_stat_fl_ls_down_2.err_info_stat.lv_end_diag "End of diagnosis XX" UWORD _CNV_S_2_RANGE__0___1_CM 1 100. 0. 1. DISPLAY_IDENTIFIER LV_END_DIAG_FL_LS_DOWN_2 ECU_ADDRESS 0xd0004316 BIT_MASK 0x20 /end MEASUREMENT
/begin MEASUREMENT fmy_stat_fl_ls_down_2.err_info_stat.lv_cdn_diag "Diagnosis condition to start symptom detection (set to 1 when condition is fulfilled)" UWORD _CNV_S_2_RANGE__0___1_CM 1 100. 0. 1. DISPLAY_IDENTIFIER LV_CDN_DIAG_FL_LS_DOWN_2 ECU_ADDRESS 0xd0004316 BIT_MASK 0x40 /end MEASUREMENT
/begin MEASUREMENT fmy_stat_fl_ls_down_2.err_info_stat.err_sym "For each symptom: status of failure (set to 1 when failure symptom is detected)" UWORD _CNV_S_16_RANGE_ERR__485_CM 1 100. 0. 15. DISPLAY_IDENTIFIER ERR_SYM_FL_LS_DOWN_2 ECU_ADDRESS 0xd0004316 BIT_MASK 0x780 /end MEASUREMENT
/begin MEASUREMENT fmy_stat_lsl_up_if_2.ctr_abc "anti-bounce counter for diagnosis XX" UBYTE _CNV_A_R_LINEAR_____0_CM 1 100. 0. 255. DISPLAY_IDENTIFIER CTR_ABC_LSL_UP_IF_2 ECU_ADDRESS 0xd00043f4 FORMAT "%3.0" /end MEASUREMENT
/begin MEASUREMENT fmy_stat_lsl_up_if_2.ctr_end_diag "Counter for the end of diagnosis XX generation" UBYTE _CNV_A_R_LINEAR_____0_CM 1 100. 0. 255. DISPLAY_IDENTIFIER CTR_ABC_END_DIAG_LSL_UP_IF_2 ECU_ADDRESS 0xd00043f5 FORMAT "%3.0" /end MEASUREMENT
/begin MEASUREMENT fmy_stat_lsl_up_if_2.err_info_stat.lv_err_mem "Failure is stored in dynamic memory (2nd layer)" UWORD _CNV_S_2_RANGE__0___1_CM 1 100. 0. 1. DISPLAY_IDENTIFIER LV_ERR_MEM_LSL_UP_IF_2 ECU_ADDRESS 0xd00043f6 BIT_MASK 0x8 /end MEASUREMENT
/begin MEASUREMENT fmy_stat_lsl_up_if_2.err_info_stat.lv_ready "Readiness flag related to diagnosis XX" UWORD _CNV_S_2_RANGE__0___1_CM 1 100. 0. 1. DISPLAY_IDENTIFIER LV_READY_LSL_UP_IF_2 ECU_ADDRESS 0xd00043f6 BIT_MASK 0x10 /end MEASUREMENT
/begin MEASUREMENT fmy_stat_lsl_up_if_2.err_info_stat.lv_end_diag "End of diagnosis XX" UWORD _CNV_S_2_RANGE__0___1_CM 1 100. 0. 1. DISPLAY_IDENTIFIER LV_END_DIAG_LSL_UP_IF_2 ECU_ADDRESS 0xd00043f6 BIT_MASK 0x20 /end MEASUREMENT
/begin MEASUREMENT fmy_stat_lsl_up_if_2.err_info_stat.lv_cdn_diag "Diagnosis condition to start symptom detection (set to 1 when condition is fulfilled)" UWORD _CNV_S_2_RANGE__0___1_CM 1 100. 0. 1. DISPLAY_IDENTIFIER LV_CDN_DIAG_LSL_UP_IF_2 ECU_ADDRESS 0xd00043f6 BIT_MASK 0x40 /end MEASUREMENT
/begin MEASUREMENT fmy_stat_lsl_up_if_2.err_info_stat.err_sym "For each symptom: status of failure (set to 1 when failure symptom is detected)" UWORD _CNV_S_16_RANGE_ERR__485_CM 1 100. 0. 15. DISPLAY_IDENTIFIER ERR_SYM_LSL_UP_IF_2 ECU_ADDRESS 0xd00043f6 BIT_MASK 0x780 /end MEASUREMENT
/begin MEASUREMENT fmy_stat_el_lsl_up_2.ctr_abc "anti-bounce counter for diagnosis XX" UBYTE _CNV_A_R_LINEAR_____0_CM 1 100. 0. 255. DISPLAY_IDENTIFIER CTR_ABC_EL_LSL_UP_2 ECU_ADDRESS 0xd000430c FORMAT "%3.0" /end MEASUREMENT
/begin MEASUREMENT fmy_stat_el_lsl_up_2.ctr_end_diag "Counter for the end of diagnosis XX generation" UBYTE _CNV_A_R_LINEAR_____0_CM 1 100. 0. 255. DISPLAY_IDENTIFIER CTR_ABC_END_DIAG_EL_LSL_UP_2 ECU_ADDRESS 0xd000430d FORMAT "%3.0" /end MEASUREMENT
/begin MEASUREMENT fmy_stat_el_lsl_up_2.err_info_stat.lv_err_mem "Failure is stored in dynamic memory (2nd layer)" UWORD _CNV_S_2_RANGE__0___1_CM 1 100. 0. 1. DISPLAY_IDENTIFIER LV_ERR_MEM_EL_LSL_UP_2 ECU_ADDRESS 0xd000430e BIT_MASK 0x8 /end MEASUREMENT
/begin MEASUREMENT fmy_stat_el_lsl_up_2.err_info_stat.lv_ready "Readiness flag related to diagnosis XX" UWORD _CNV_S_2_RANGE__0___1_CM 1 100. 0. 1. DISPLAY_IDENTIFIER LV_READY_EL_LSL_UP_2 ECU_ADDRESS 0xd000430e BIT_MASK 0x10 /end MEASUREMENT
/begin MEASUREMENT fmy_stat_el_lsl_up_2.err_info_stat.lv_end_diag "End of diagnosis XX" UWORD _CNV_S_2_RANGE__0___1_CM 1 100. 0. 1. DISPLAY_IDENTIFIER LV_END_DIAG_EL_LSL_UP_2 ECU_ADDRESS 0xd000430e BIT_MASK 0x20 /end MEASUREMENT
/begin MEASUREMENT fmy_stat_el_lsl_up_2.err_info_stat.lv_cdn_diag "Diagnosis condition to start symptom detection (set to 1 when condition is fulfilled)" UWORD _CNV_S_2_RANGE__0___1_CM 1 100. 0. 1. DISPLAY_IDENTIFIER LV_CDN_DIAG_EL_LSL_UP_2 ECU_ADDRESS 0xd000430e BIT_MASK 0x40 /end MEASUREMENT
/begin MEASUREMENT fmy_stat_el_lsl_up_2.err_info_stat.err_sym "For each symptom: status of failure (set to 1 when failure symptom is detected)" UWORD _CNV_S_16_RANGE_ERR__485_CM 1 100. 0. 15. DISPLAY_IDENTIFIER ERR_SYM_EL_LSL_UP_2 ECU_ADDRESS 0xd000430e BIT_MASK 0x780 /end MEASUREMENT
/begin MEASUREMENT fmy_stat_lsh_up_2.ctr_abc "anti-bounce counter for diagnosis XX" UBYTE _CNV_A_R_LINEAR_____0_CM 1 100. 0. 255. DISPLAY_IDENTIFIER CTR_ABC_LSH_UP_2 ECU_ADDRESS 0xd00043ec FORMAT "%3.0" /end MEASUREMENT
/begin MEASUREMENT fmy_stat_lsh_up_2.ctr_end_diag "Counter for the end of diagnosis XX generation" UBYTE _CNV_A_R_LINEAR_____0_CM 1 100. 0. 255. DISPLAY_IDENTIFIER CTR_ABC_END_DIAG_LSH_UP_2 ECU_ADDRESS 0xd00043ed FORMAT "%3.0" /end MEASUREMENT
/begin MEASUREMENT fmy_stat_lsh_up_2.err_info_stat.lv_err_mem "Failure is stored in dynamic memory (2nd layer)" UWORD _CNV_S_2_RANGE__0___1_CM 1 100. 0. 1. DISPLAY_IDENTIFIER LV_ERR_MEM_LSH_UP_2 ECU_ADDRESS 0xd00043ee BIT_MASK 0x8 /end MEASUREMENT
/begin MEASUREMENT fmy_stat_lsh_up_2.err_info_stat.lv_ready "Readiness flag related to diagnosis XX" UWORD _CNV_S_2_RANGE__0___1_CM 1 100. 0. 1. DISPLAY_IDENTIFIER LV_READY_LSH_UP_2 ECU_ADDRESS 0xd00043ee BIT_MASK 0x10 /end MEASUREMENT
/begin MEASUREMENT fmy_stat_lsh_up_2.err_info_stat.lv_end_diag "End of diagnosis XX" UWORD _CNV_S_2_RANGE__0___1_CM 1 100. 0. 1. DISPLAY_IDENTIFIER LV_END_DIAG_LSH_UP_2 ECU_ADDRESS 0xd00043ee BIT_MASK 0x20 /end MEASUREMENT
/begin MEASUREMENT fmy_stat_lsh_up_2.err_info_stat.lv_cdn_diag "Diagnosis condition to start symptom detection (set to 1 when condition is fulfilled)" UWORD _CNV_S_2_RANGE__0___1_CM 1 100. 0. 1. DISPLAY_IDENTIFIER LV_CDN_DIAG_LSH_UP_2 ECU_ADDRESS 0xd00043ee BIT_MASK 0x40 /end MEASUREMENT
/begin MEASUREMENT fmy_stat_lsh_up_2.err_info_stat.err_sym "For each symptom: status of failure (set to 1 when failure symptom is detected)" UWORD _CNV_S_16_RANGE_ERR__485_CM 1 100. 0. 15. DISPLAY_IDENTIFIER ERR_SYM_LSH_UP_2 ECU_ADDRESS 0xd00043ee BIT_MASK 0x780 /end MEASUREMENT
/begin MEASUREMENT fmy_stat_lsh_down_2.ctr_abc "anti-bounce counter for diagnosis XX" UBYTE _CNV_A_R_LINEAR_____0_CM 1 100. 0. 255. DISPLAY_IDENTIFIER CTR_ABC_LSH_DOWN_2 ECU_ADDRESS 0xd00043dc FORMAT "%3.0" /end MEASUREMENT
/begin MEASUREMENT fmy_stat_lsh_down_2.ctr_end_diag "Counter for the end of diagnosis XX generation" UBYTE _CNV_A_R_LINEAR_____0_CM 1 100. 0. 255. DISPLAY_IDENTIFIER CTR_ABC_END_DIAG_LSH_DOWN_2 ECU_ADDRESS 0xd00043dd FORMAT "%3.0" /end MEASUREMENT
/begin MEASUREMENT fmy_stat_lsh_down_2.err_info_stat.lv_err_mem "Failure is stored in dynamic memory (2nd layer)" UWORD _CNV_S_2_RANGE__0___1_CM 1 100. 0. 1. DISPLAY_IDENTIFIER LV_ERR_MEM_LSH_DOWN_2 ECU_ADDRESS 0xd00043de BIT_MASK 0x8 /end MEASUREMENT
/begin MEASUREMENT fmy_stat_lsh_down_2.err_info_stat.lv_ready "Readiness flag related to diagnosis XX" UWORD _CNV_S_2_RANGE__0___1_CM 1 100. 0. 1. DISPLAY_IDENTIFIER LV_READY_LSH_DOWN_2 ECU_ADDRESS 0xd00043de BIT_MASK 0x10 /end MEASUREMENT
/begin MEASUREMENT fmy_stat_lsh_down_2.err_info_stat.lv_end_diag "End of diagnosis XX" UWORD _CNV_S_2_RANGE__0___1_CM 1 100. 0. 1. DISPLAY_IDENTIFIER LV_END_DIAG_LSH_DOWN_2 ECU_ADDRESS 0xd00043de BIT_MASK 0x20 /end MEASUREMENT
/begin MEASUREMENT fmy_stat_lsh_down_2.err_info_stat.lv_cdn_diag "Diagnosis condition to start symptom detection (set to 1 when condition is fulfilled)" UWORD _CNV_S_2_RANGE__0___1_CM 1 100. 0. 1. DISPLAY_IDENTIFIER LV_CDN_DIAG_LSH_DOWN_2 ECU_ADDRESS 0xd00043de BIT_MASK 0x40 /end MEASUREMENT
/begin MEASUREMENT fmy_stat_lsh_down_2.err_info_stat.err_sym "For each symptom: status of failure (set to 1 when failure symptom is detected)" UWORD _CNV_S_16_RANGE_ERR__485_CM 1 100. 0. 15. DISPLAY_IDENTIFIER ERR_SYM_LSH_DOWN_2 ECU_ADDRESS 0xd00043de BIT_MASK 0x780 /end MEASUREMENT
/begin MEASUREMENT fmy_stat_vls_down_dif_2.ctr_abc "anti-bounce counter for diagnosis XX" UBYTE _CNV_A_R_LINEAR_____0_CM 1 100. 0. 255. DISPLAY_IDENTIFIER CTR_ABC_VLS_DOWN_DIF_2 ECU_ADDRESS 0xd0004654 FORMAT "%3.0" /end MEASUREMENT
/begin MEASUREMENT fmy_stat_vls_down_dif_2.ctr_end_diag "Counter for the end of diagnosis XX generation" UBYTE _CNV_A_R_LINEAR_____0_CM 1 100. 0. 255. DISPLAY_IDENTIFIER CTR_ABC_END_DIAG_VLS_DOWN_DIF_2 ECU_ADDRESS 0xd0004655 FORMAT "%3.0" /end MEASUREMENT
/begin MEASUREMENT fmy_stat_vls_down_dif_2.err_info_stat.lv_err_mem "Failure is stored in dynamic memory (2nd layer)" UWORD _CNV_S_2_RANGE__0___1_CM 1 100. 0. 1. DISPLAY_IDENTIFIER LV_ERR_MEM_VLS_DOWN_DIF_2 ECU_ADDRESS 0xd0004656 BIT_MASK 0x8 /end MEASUREMENT
/begin MEASUREMENT fmy_stat_vls_down_dif_2.err_info_stat.lv_ready "Readiness flag related to diagnosis XX" UWORD _CNV_S_2_RANGE__0___1_CM 1 100. 0. 1. DISPLAY_IDENTIFIER LV_READY_VLS_DOWN_DIF_2 ECU_ADDRESS 0xd0004656 BIT_MASK 0x10 /end MEASUREMENT
/begin MEASUREMENT fmy_stat_vls_down_dif_2.err_info_stat.lv_end_diag "End of diagnosis XX" UWORD _CNV_S_2_RANGE__0___1_CM 1 100. 0. 1. DISPLAY_IDENTIFIER LV_END_DIAG_VLS_DOWN_DIF_2 ECU_ADDRESS 0xd0004656 BIT_MASK 0x20 /end MEASUREMENT
/begin MEASUREMENT fmy_stat_vls_down_dif_2.err_info_stat.lv_cdn_diag "Diagnosis condition to start symptom detection (set to 1 when condition is fulfilled)" UWORD _CNV_S_2_RANGE__0___1_CM 1 100. 0. 1. DISPLAY_IDENTIFIER LV_CDN_DIAG_VLS_DOWN_DIF_2 ECU_ADDRESS 0xd0004656 BIT_MASK 0x40 /end MEASUREMENT
/begin MEASUREMENT fmy_stat_vls_down_dif_2.err_info_stat.err_sym "For each symptom: status of failure (set to 1 when failure symptom is detected)" UWORD _CNV_S_16_RANGE_ERR__485_CM 1 100. 0. 15. DISPLAY_IDENTIFIER ERR_SYM_VLS_DOWN_DIF_2 ECU_ADDRESS 0xd0004656 BIT_MASK 0x780 /end MEASUREMENT
/begin MEASUREMENT fmy_stat_lsh_lsl_up_2.ctr_abc "anti-bounce counter for diagnosis XX" UBYTE _CNV_A_R_LINEAR_____0_CM 1 100. 0. 255. DISPLAY_IDENTIFIER CTR_ABC_LSH_LSL_UP_2 ECU_ADDRESS 0xd00043e4 FORMAT "%3.0" /end MEASUREMENT
/begin MEASUREMENT fmy_stat_lsh_lsl_up_2.ctr_end_diag "Counter for the end of diagnosis XX generation" UBYTE _CNV_A_R_LINEAR_____0_CM 1 100. 0. 255. DISPLAY_IDENTIFIER CTR_ABC_END_DIAG_LSH_LSL_UP_2 ECU_ADDRESS 0xd00043e5 FORMAT "%3.0" /end MEASUREMENT
/begin MEASUREMENT fmy_stat_lsh_lsl_up_2.err_info_stat.lv_err_mem "Failure is stored in dynamic memory (2nd layer)" UWORD _CNV_S_2_RANGE__0___1_CM 1 100. 0. 1. DISPLAY_IDENTIFIER LV_ERR_MEM_LSH_LSL_UP_2 ECU_ADDRESS 0xd00043e6 BIT_MASK 0x8 /end MEASUREMENT
/begin MEASUREMENT fmy_stat_lsh_lsl_up_2.err_info_stat.lv_ready "Readiness flag related to diagnosis XX" UWORD _CNV_S_2_RANGE__0___1_CM 1 100. 0. 1. DISPLAY_IDENTIFIER LV_READY_LSH_LSL_UP_2 ECU_ADDRESS 0xd00043e6 BIT_MASK 0x10 /end MEASUREMENT
/begin MEASUREMENT fmy_stat_lsh_lsl_up_2.err_info_stat.lv_end_diag "End of diagnosis XX" UWORD _CNV_S_2_RANGE__0___1_CM 1 100. 0. 1. DISPLAY_IDENTIFIER LV_END_DIAG_LSH_LSL_UP_2 ECU_ADDRESS 0xd00043e6 BIT_MASK 0x20 /end MEASUREMENT
/begin MEASUREMENT fmy_stat_lsh_lsl_up_2.err_info_stat.lv_cdn_diag "Diagnosis condition to start symptom detection (set to 1 when condition is fulfilled)" UWORD _CNV_S_2_RANGE__0___1_CM 1 100. 0. 1. DISPLAY_IDENTIFIER LV_CDN_DIAG_LSH_LSL_UP_2 ECU_ADDRESS 0xd00043e6 BIT_MASK 0x40 /end MEASUREMENT
/begin MEASUREMENT fmy_stat_lsh_lsl_up_2.err_info_stat.err_sym "For each symptom: status of failure (set to 1 when failure symptom is detected)" UWORD _CNV_S_16_RANGE_ERR__485_CM 1 100. 0. 15. DISPLAY_IDENTIFIER ERR_SYM_LSH_LSL_UP_2 ECU_ADDRESS 0xd00043e6 BIT_MASK 0x780 /end MEASUREMENT
/begin MEASUREMENT fmy_stat_air_lsl_up_2.ctr_abc "anti-bounce counter for diagnosis XX" UBYTE _CNV_A_R_LINEAR_____0_CM 1 100. 0. 255. DISPLAY_IDENTIFIER CTR_ABC_AIR_LSL_UP_2 ECU_ADDRESS 0xd000419c FORMAT "%3.0" /end MEASUREMENT
/begin MEASUREMENT fmy_stat_air_lsl_up_2.ctr_end_diag "Counter for the end of diagnosis XX generation" UBYTE _CNV_A_R_LINEAR_____0_CM 1 100. 0. 255. DISPLAY_IDENTIFIER CTR_ABC_END_DIAG_AIR_LSL_UP_2 ECU_ADDRESS 0xd000419d FORMAT "%3.0" /end MEASUREMENT
/begin MEASUREMENT fmy_stat_air_lsl_up_2.err_info_stat.lv_err_mem "Failure is stored in dynamic memory (2nd layer)" UWORD _CNV_S_2_RANGE__0___1_CM 1 100. 0. 1. DISPLAY_IDENTIFIER LV_ERR_MEM_AIR_LSL_UP_2 ECU_ADDRESS 0xd000419e BIT_MASK 0x8 /end MEASUREMENT
/begin MEASUREMENT fmy_stat_air_lsl_up_2.err_info_stat.lv_ready "Readiness flag related to diagnosis XX" UWORD _CNV_S_2_RANGE__0___1_CM 1 100. 0. 1. DISPLAY_IDENTIFIER LV_READY_AIR_LSL_UP_2 ECU_ADDRESS 0xd000419e BIT_MASK 0x10 /end MEASUREMENT
/begin MEASUREMENT fmy_stat_air_lsl_up_2.err_info_stat.lv_end_diag "End of diagnosis XX" UWORD _CNV_S_2_RANGE__0___1_CM 1 100. 0. 1. DISPLAY_IDENTIFIER LV_END_DIAG_AIR_LSL_UP_2 ECU_ADDRESS 0xd000419e BIT_MASK 0x20 /end MEASUREMENT
/begin MEASUREMENT fmy_stat_air_lsl_up_2.err_info_stat.lv_cdn_diag "Diagnosis condition to start symptom detection (set to 1 when condition is fulfilled)" UWORD _CNV_S_2_RANGE__0___1_CM 1 100. 0. 1. DISPLAY_IDENTIFIER LV_CDN_DIAG_AIR_LSL_UP_2 ECU_ADDRESS 0xd000419e BIT_MASK 0x40 /end MEASUREMENT
/begin MEASUREMENT fmy_stat_air_lsl_up_2.err_info_stat.err_sym "For each symptom: status of failure (set to 1 when failure symptom is detected)" UWORD _CNV_S_16_RANGE_ERR__485_CM 1 100. 0. 15. DISPLAY_IDENTIFIER ERR_SYM_AIR_LSL_UP_2 ECU_ADDRESS 0xd000419e BIT_MASK 0x780 /end MEASUREMENT
/begin MEASUREMENT fmy_stat_pue_ls_down_2.ctr_abc "anti-bounce counter for diagnosis XX" UBYTE _CNV_A_R_LINEAR_____0_CM 1 100. 0. 255. DISPLAY_IDENTIFIER CTR_ABC_PUE_LS_DOWN_2 ECU_ADDRESS 0xd00044b8 FORMAT "%3.0" /end MEASUREMENT
/begin MEASUREMENT fmy_stat_pue_ls_down_2.ctr_end_diag "Counter for the end of diagnosis XX generation" UBYTE _CNV_A_R_LINEAR_____0_CM 1 100. 0. 255. DISPLAY_IDENTIFIER CTR_ABC_END_DIAG_PUE_LS_DOWN_2 ECU_ADDRESS 0xd00044b9 FORMAT "%3.0" /end MEASUREMENT
/begin MEASUREMENT fmy_stat_pue_ls_down_2.err_info_stat.lv_err_mem "Failure is stored in dynamic memory (2nd layer)" UWORD _CNV_S_2_RANGE__0___1_CM 1 100. 0. 1. DISPLAY_IDENTIFIER LV_ERR_MEM_PUE_LS_DOWN_2 ECU_ADDRESS 0xd00044ba BIT_MASK 0x8 /end MEASUREMENT
/begin MEASUREMENT fmy_stat_pue_ls_down_2.err_info_stat.lv_ready "Readiness flag related to diagnosis XX" UWORD _CNV_S_2_RANGE__0___1_CM 1 100. 0. 1. DISPLAY_IDENTIFIER LV_READY_PUE_LS_DOWN_2 ECU_ADDRESS 0xd00044ba BIT_MASK 0x10 /end MEASUREMENT
/begin MEASUREMENT fmy_stat_pue_ls_down_2.err_info_stat.lv_end_diag "End of diagnosis XX" UWORD _CNV_S_2_RANGE__0___1_CM 1 100. 0. 1. DISPLAY_IDENTIFIER LV_END_DIAG_PUE_LS_DOWN_2 ECU_ADDRESS 0xd00044ba BIT_MASK 0x20 /end MEASUREMENT
/begin MEASUREMENT fmy_stat_pue_ls_down_2.err_info_stat.lv_cdn_diag "Diagnosis condition to start symptom detection (set to 1 when condition is fulfilled)" UWORD _CNV_S_2_RANGE__0___1_CM 1 100. 0. 1. DISPLAY_IDENTIFIER LV_CDN_DIAG_PUE_LS_DOWN_2 ECU_ADDRESS 0xd00044ba BIT_MASK 0x40 /end MEASUREMENT
/begin MEASUREMENT fmy_stat_pue_ls_down_2.err_info_stat.err_sym "For each symptom: status of failure (set to 1 when failure symptom is detected)" UWORD _CNV_S_16_RANGE_ERR__485_CM 1 100. 0. 15. DISPLAY_IDENTIFIER ERR_SYM_PUE_LS_DOWN_2 ECU_ADDRESS 0xd00044ba BIT_MASK 0x780 /end MEASUREMENT
/begin MEASUREMENT fmy_stat_swt_ls_down_2.ctr_abc "anti-bounce counter for diagnosis XX" UBYTE _CNV_A_R_LINEAR_____0_CM 1 100. 0. 255. DISPLAY_IDENTIFIER CTR_ABC_SWT_LS_DOWN_2 ECU_ADDRESS 0xd0004558 FORMAT "%3.0" /end MEASUREMENT
/begin MEASUREMENT fmy_stat_swt_ls_down_2.ctr_end_diag "Counter for the end of diagnosis XX generation" UBYTE _CNV_A_R_LINEAR_____0_CM 1 100. 0. 255. DISPLAY_IDENTIFIER CTR_ABC_END_DIAG_SWT_LS_DOWN_2 ECU_ADDRESS 0xd0004559 FORMAT "%3.0" /end MEASUREMENT
/begin MEASUREMENT fmy_stat_swt_ls_down_2.err_info_stat.lv_err_mem "Failure is stored in dynamic memory (2nd layer)" UWORD _CNV_S_2_RANGE__0___1_CM 1 100. 0. 1. DISPLAY_IDENTIFIER LV_ERR_MEM_SWT_LS_DOWN_2 ECU_ADDRESS 0xd000455a BIT_MASK 0x8 /end MEASUREMENT
/begin MEASUREMENT fmy_stat_swt_ls_down_2.err_info_stat.lv_ready "Readiness flag related to diagnosis XX" UWORD _CNV_S_2_RANGE__0___1_CM 1 100. 0. 1. DISPLAY_IDENTIFIER LV_READY_SWT_LS_DOWN_2 ECU_ADDRESS 0xd000455a BIT_MASK 0x10 /end MEASUREMENT
/begin MEASUREMENT fmy_stat_swt_ls_down_2.err_info_stat.lv_end_diag "End of diagnosis XX" UWORD _CNV_S_2_RANGE__0___1_CM 1 100. 0. 1. DISPLAY_IDENTIFIER LV_END_DIAG_SWT_LS_DOWN_2 ECU_ADDRESS 0xd000455a BIT_MASK 0x20 /end MEASUREMENT
/begin MEASUREMENT fmy_stat_swt_ls_down_2.err_info_stat.lv_cdn_diag "Diagnosis condition to start symptom detection (set to 1 when condition is fulfilled)" UWORD _CNV_S_2_RANGE__0___1_CM 1 100. 0. 1. DISPLAY_IDENTIFIER LV_CDN_DIAG_SWT_LS_DOWN_2 ECU_ADDRESS 0xd000455a BIT_MASK 0x40 /end MEASUREMENT
/begin MEASUREMENT fmy_stat_swt_ls_down_2.err_info_stat.err_sym "For each symptom: status of failure (set to 1 when failure symptom is detected)" UWORD _CNV_S_16_RANGE_ERR__485_CM 1 100. 0. 15. DISPLAY_IDENTIFIER ERR_SYM_SWT_LS_DOWN_2 ECU_ADDRESS 0xd000455a BIT_MASK 0x780 /end MEASUREMENT
/begin MEASUREMENT fmy_stat_obd_lsh_down_2.ctr_abc "anti-bounce counter for diagnosis XX" UBYTE _CNV_A_R_LINEAR_____0_CM 1 100. 0. 255. DISPLAY_IDENTIFIER CTR_ABC_OBD_LSH_DOWN_2 ECU_ADDRESS 0xd000446c FORMAT "%3.0" /end MEASUREMENT
/begin MEASUREMENT fmy_stat_obd_lsh_down_2.ctr_end_diag "Counter for the end of diagnosis XX generation" UBYTE _CNV_A_R_LINEAR_____0_CM 1 100. 0. 255. DISPLAY_IDENTIFIER CTR_ABC_END_DIAG_OBD_LSH_DOWN_2 ECU_ADDRESS 0xd000446d FORMAT "%3.0" /end MEASUREMENT
/begin MEASUREMENT fmy_stat_obd_lsh_down_2.err_info_stat.lv_err_mem "Failure is stored in dynamic memory (2nd layer)" UWORD _CNV_S_2_RANGE__0___1_CM 1 100. 0. 1. DISPLAY_IDENTIFIER LV_ERR_MEM_OBD_LSH_DOWN_2 ECU_ADDRESS 0xd000446e BIT_MASK 0x8 /end MEASUREMENT
/begin MEASUREMENT fmy_stat_obd_lsh_down_2.err_info_stat.lv_ready "Readiness flag related to diagnosis XX" UWORD _CNV_S_2_RANGE__0___1_CM 1 100. 0. 1. DISPLAY_IDENTIFIER LV_READY_OBD_LSH_DOWN_2 ECU_ADDRESS 0xd000446e BIT_MASK 0x10 /end MEASUREMENT
/begin MEASUREMENT fmy_stat_obd_lsh_down_2.err_info_stat.lv_end_diag "End of diagnosis XX" UWORD _CNV_S_2_RANGE__0___1_CM 1 100. 0. 1. DISPLAY_IDENTIFIER LV_END_DIAG_OBD_LSH_DOWN_2 ECU_ADDRESS 0xd000446e BIT_MASK 0x20 /end MEASUREMENT
/begin MEASUREMENT fmy_stat_obd_lsh_down_2.err_info_stat.lv_cdn_diag "Diagnosis condition to start symptom detection (set to 1 when condition is fulfilled)" UWORD _CNV_S_2_RANGE__0___1_CM 1 100. 0. 1. DISPLAY_IDENTIFIER LV_CDN_DIAG_OBD_LSH_DOWN_2 ECU_ADDRESS 0xd000446e BIT_MASK 0x40 /end MEASUREMENT
/begin MEASUREMENT fmy_stat_obd_lsh_down_2.err_info_stat.err_sym "For each symptom: status of failure (set to 1 when failure symptom is detected)" UWORD _CNV_S_16_RANGE_ERR__485_CM 1 100. 0. 15. DISPLAY_IDENTIFIER ERR_SYM_OBD_LSH_DOWN_2 ECU_ADDRESS 0xd000446e BIT_MASK 0x780 /end MEASUREMENT
/begin MEASUREMENT fmy_stat_dyn_vld_ls_up_2.ctr_abc "anti-bounce counter for diagnosis XX" UBYTE _CNV_A_R_LINEAR_____0_CM 1 100. 0. 255. DISPLAY_IDENTIFIER CTR_ABC_DYN_VLD_LS_UP_2 ECU_ADDRESS 0xd00042c8 FORMAT "%3.0" /end MEASUREMENT
/begin MEASUREMENT fmy_stat_dyn_vld_ls_up_2.ctr_end_diag "Counter for the end of diagnosis XX generation" UBYTE _CNV_A_R_LINEAR_____0_CM 1 100. 0. 255. DISPLAY_IDENTIFIER CTR_ABC_END_DIAG_DYN_VLD_LS_UP_2 ECU_ADDRESS 0xd00042c9 FORMAT "%3.0" /end MEASUREMENT
/begin MEASUREMENT fmy_stat_dyn_vld_ls_up_2.err_info_stat.lv_err_mem "Failure is stored in dynamic memory (2nd layer)" UWORD _CNV_S_2_RANGE__0___1_CM 1 100. 0. 1. DISPLAY_IDENTIFIER LV_ERR_MEM_DYN_VLD_LS_UP_2 ECU_ADDRESS 0xd00042ca BIT_MASK 0x8 /end MEASUREMENT
/begin MEASUREMENT fmy_stat_dyn_vld_ls_up_2.err_info_stat.lv_ready "Readiness flag related to diagnosis XX" UWORD _CNV_S_2_RANGE__0___1_CM 1 100. 0. 1. DISPLAY_IDENTIFIER LV_READY_DYN_VLD_LS_UP_2 ECU_ADDRESS 0xd00042ca BIT_MASK 0x10 /end MEASUREMENT
/begin MEASUREMENT fmy_stat_dyn_vld_ls_up_2.err_info_stat.lv_end_diag "End of diagnosis XX" UWORD _CNV_S_2_RANGE__0___1_CM 1 100. 0. 1. DISPLAY_IDENTIFIER LV_END_DIAG_DYN_VLD_LS_UP_2 ECU_ADDRESS 0xd00042ca BIT_MASK 0x20 /end MEASUREMENT
/begin MEASUREMENT fmy_stat_dyn_vld_ls_up_2.err_info_stat.lv_cdn_diag "Diagnosis condition to start symptom detection (set to 1 when condition is fulfilled)" UWORD _CNV_S_2_RANGE__0___1_CM 1 100. 0. 1. DISPLAY_IDENTIFIER LV_CDN_DIAG_DYN_VLD_LS_UP_2 ECU_ADDRESS 0xd00042ca BIT_MASK 0x40 /end MEASUREMENT
/begin MEASUREMENT fmy_stat_dyn_vld_ls_up_2.err_info_stat.err_sym "For each symptom: status of failure (set to 1 when failure symptom is detected)" UWORD _CNV_S_16_RANGE_ERR__485_CM 1 100. 0. 15. DISPLAY_IDENTIFIER ERR_SYM_DYN_VLD_LS_UP_2 ECU_ADDRESS 0xd00042ca BIT_MASK 0x780 /end MEASUREMENT
/begin MEASUREMENT fmy_stat_puc_vld_ls_up_2.ctr_abc "anti-bounce counter for diagnosis XX" UBYTE _CNV_A_R_LINEAR_____0_CM 1 100. 0. 255. DISPLAY_IDENTIFIER CTR_ABC_PUC_VLD_LS_UP_2 ECU_ADDRESS 0xd00044b0 FORMAT "%3.0" /end MEASUREMENT
/begin MEASUREMENT fmy_stat_puc_vld_ls_up_2.ctr_end_diag "Counter for the end of diagnosis XX generation" UBYTE _CNV_A_R_LINEAR_____0_CM 1 100. 0. 255. DISPLAY_IDENTIFIER CTR_ABC_END_DIAG_PUC_VLD_LS_UP_2 ECU_ADDRESS 0xd00044b1 FORMAT "%3.0" /end MEASUREMENT
/begin MEASUREMENT fmy_stat_puc_vld_ls_up_2.err_info_stat.lv_err_mem "Failure is stored in dynamic memory (2nd layer)" UWORD _CNV_S_2_RANGE__0___1_CM 1 100. 0. 1. DISPLAY_IDENTIFIER LV_ERR_MEM_PUC_VLD_LS_UP_2 ECU_ADDRESS 0xd00044b2 BIT_MASK 0x8 /end MEASUREMENT
/begin MEASUREMENT fmy_stat_puc_vld_ls_up_2.err_info_stat.lv_ready "Readiness flag related to diagnosis XX" UWORD _CNV_S_2_RANGE__0___1_CM 1 100. 0. 1. DISPLAY_IDENTIFIER LV_READY_PUC_VLD_LS_UP_2 ECU_ADDRESS 0xd00044b2 BIT_MASK 0x10 /end MEASUREMENT
/begin MEASUREMENT fmy_stat_puc_vld_ls_up_2.err_info_stat.lv_end_diag "End of diagnosis XX" UWORD _CNV_S_2_RANGE__0___1_CM 1 100. 0. 1. DISPLAY_IDENTIFIER LV_END_DIAG_PUC_VLD_LS_UP_2 ECU_ADDRESS 0xd00044b2 BIT_MASK 0x20 /end MEASUREMENT
/begin MEASUREMENT fmy_stat_puc_vld_ls_up_2.err_info_stat.lv_cdn_diag "Diagnosis condition to start symptom detection (set to 1 when condition is fulfilled)" UWORD _CNV_S_2_RANGE__0___1_CM 1 100. 0. 1. DISPLAY_IDENTIFIER LV_CDN_DIAG_PUC_VLD_LS_UP_2 ECU_ADDRESS 0xd00044b2 BIT_MASK 0x40 /end MEASUREMENT
/begin MEASUREMENT fmy_stat_puc_vld_ls_up_2.err_info_stat.err_sym "For each symptom: status of failure (set to 1 when failure symptom is detected)" UWORD _CNV_S_16_RANGE_ERR__485_CM 1 100. 0. 15. DISPLAY_IDENTIFIER ERR_SYM_PUC_VLD_LS_UP_2 ECU_ADDRESS 0xd00044b2 BIT_MASK 0x780 /end MEASUREMENT
/begin MEASUREMENT fmy_stat_obd_vld_lsh_up_2.ctr_abc "anti-bounce counter for diagnosis XX" UBYTE _CNV_A_R_LINEAR_____0_CM 1 100. 0. 255. DISPLAY_IDENTIFIER CTR_ABC_OBD_VLD_LSH_UP_2 ECU_ADDRESS 0xd0004474 FORMAT "%3.0" /end MEASUREMENT
/begin MEASUREMENT fmy_stat_obd_vld_lsh_up_2.ctr_end_diag "Counter for the end of diagnosis XX generation" UBYTE _CNV_A_R_LINEAR_____0_CM 1 100. 0. 255. DISPLAY_IDENTIFIER CTR_ABC_END_DIAG_OBD_VLD_LSH_UP_2 ECU_ADDRESS 0xd0004475 FORMAT "%3.0" /end MEASUREMENT
/begin MEASUREMENT fmy_stat_obd_vld_lsh_up_2.err_info_stat.lv_err_mem "Failure is stored in dynamic memory (2nd layer)" UWORD _CNV_S_2_RANGE__0___1_CM 1 100. 0. 1. DISPLAY_IDENTIFIER LV_ERR_MEM_OBD_VLD_LSH_UP_2 ECU_ADDRESS 0xd0004476 BIT_MASK 0x8 /end MEASUREMENT
/begin MEASUREMENT fmy_stat_obd_vld_lsh_up_2.err_info_stat.lv_ready "Readiness flag related to diagnosis XX" UWORD _CNV_S_2_RANGE__0___1_CM 1 100. 0. 1. DISPLAY_IDENTIFIER LV_READY_OBD_VLD_LSH_UP_2 ECU_ADDRESS 0xd0004476 BIT_MASK 0x10 /end MEASUREMENT
/begin MEASUREMENT fmy_stat_obd_vld_lsh_up_2.err_info_stat.lv_end_diag "End of diagnosis XX" UWORD _CNV_S_2_RANGE__0___1_CM 1 100. 0. 1. DISPLAY_IDENTIFIER LV_END_DIAG_OBD_VLD_LSH_UP_2 ECU_ADDRESS 0xd0004476 BIT_MASK 0x20 /end MEASUREMENT
/begin MEASUREMENT fmy_stat_obd_vld_lsh_up_2.err_info_stat.lv_cdn_diag "Diagnosis condition to start symptom detection (set to 1 when condition is fulfilled)" UWORD _CNV_S_2_RANGE__0___1_CM 1 100. 0. 1. DISPLAY_IDENTIFIER LV_CDN_DIAG_OBD_VLD_LSH_UP_2 ECU_ADDRESS 0xd0004476 BIT_MASK 0x40 /end MEASUREMENT
/begin MEASUREMENT fmy_stat_obd_vld_lsh_up_2.err_info_stat.err_sym "For each symptom: status of failure (set to 1 when failure symptom is detected)" UWORD _CNV_S_16_RANGE_ERR__485_CM 1 100. 0. 15. DISPLAY_IDENTIFIER ERR_SYM_OBD_VLD_LSH_UP_2 ECU_ADDRESS 0xd0004476 BIT_MASK 0x780 /end MEASUREMENT
/begin MEASUREMENT fmy_stat_chk_ls_down_2.ctr_abc "anti-bounce counter for diagnosis XX" UBYTE _CNV_A_R_LINEAR_____0_CM 1 100. 0. 255. DISPLAY_IDENTIFIER CTR_ABC_CHK_LS_DOWN_2 ECU_ADDRESS 0xd0004264 FORMAT "%3.0" /end MEASUREMENT
/begin MEASUREMENT fmy_stat_chk_ls_down_2.ctr_end_diag "Counter for the end of diagnosis XX generation" UBYTE _CNV_A_R_LINEAR_____0_CM 1 100. 0. 255. DISPLAY_IDENTIFIER CTR_ABC_END_DIAG_CHK_LS_DOWN_2 ECU_ADDRESS 0xd0004265 FORMAT "%3.0" /end MEASUREMENT
/begin MEASUREMENT fmy_stat_chk_ls_down_2.err_info_stat.lv_err_mem "Failure is stored in dynamic memory (2nd layer)" UWORD _CNV_S_2_RANGE__0___1_CM 1 100. 0. 1. DISPLAY_IDENTIFIER LV_ERR_MEM_CHK_LS_DOWN_2 ECU_ADDRESS 0xd0004266 BIT_MASK 0x8 /end MEASUREMENT
/begin MEASUREMENT fmy_stat_chk_ls_down_2.err_info_stat.lv_ready "Readiness flag related to diagnosis XX" UWORD _CNV_S_2_RANGE__0___1_CM 1 100. 0. 1. DISPLAY_IDENTIFIER LV_READY_CHK_LS_DOWN_2 ECU_ADDRESS 0xd0004266 BIT_MASK 0x10 /end MEASUREMENT
/begin MEASUREMENT fmy_stat_chk_ls_down_2.err_info_stat.lv_end_diag "End of diagnosis XX" UWORD _CNV_S_2_RANGE__0___1_CM 1 100. 0. 1. DISPLAY_IDENTIFIER LV_END_DIAG_CHK_LS_DOWN_2 ECU_ADDRESS 0xd0004266 BIT_MASK 0x20 /end MEASUREMENT
/begin MEASUREMENT fmy_stat_chk_ls_down_2.err_info_stat.lv_cdn_diag "Diagnosis condition to start symptom detection (set to 1 when condition is fulfilled)" UWORD _CNV_S_2_RANGE__0___1_CM 1 100. 0. 1. DISPLAY_IDENTIFIER LV_CDN_DIAG_CHK_LS_DOWN_2 ECU_ADDRESS 0xd0004266 BIT_MASK 0x40 /end MEASUREMENT
/begin MEASUREMENT fmy_stat_chk_ls_down_2.err_info_stat.err_sym "For each symptom: status of failure (set to 1 when failure symptom is detected)" UWORD _CNV_S_16_RANGE_ERR__485_CM 1 100. 0. 15. DISPLAY_IDENTIFIER ERR_SYM_CHK_LS_DOWN_2 ECU_ADDRESS 0xd0004266 BIT_MASK 0x780 /end MEASUREMENT
/begin MEASUREMENT fmy_stat_shift_afl_lsl_up_2.ctr_abc "anti-bounce counter for diagnosis XX" UBYTE _CNV_A_R_LINEAR_____0_CM 1 100. 0. 255. DISPLAY_IDENTIFIER CTR_ABC_SHIFT_AFL_LSL_UP_2 ECU_ADDRESS 0xd000452c FORMAT "%3.0" /end MEASUREMENT
/begin MEASUREMENT fmy_stat_shift_afl_lsl_up_2.ctr_end_diag "Counter for the end of diagnosis XX generation" UBYTE _CNV_A_R_LINEAR_____0_CM 1 100. 0. 255. DISPLAY_IDENTIFIER CTR_ABC_END_DIAG_SHIFT_AFL_LSL_UP_2 ECU_ADDRESS 0xd000452d FORMAT "%3.0" /end MEASUREMENT
/begin MEASUREMENT fmy_stat_shift_afl_lsl_up_2.err_info_stat.lv_err_mem "Failure is stored in dynamic memory (2nd layer)" UWORD _CNV_S_2_RANGE__0___1_CM 1 100. 0. 1. DISPLAY_IDENTIFIER LV_ERR_MEM_SHIFT_AFL_LSL_UP_2 ECU_ADDRESS 0xd000452e BIT_MASK 0x8 /end MEASUREMENT
/begin MEASUREMENT fmy_stat_shift_afl_lsl_up_2.err_info_stat.lv_ready "Readiness flag related to diagnosis XX" UWORD _CNV_S_2_RANGE__0___1_CM 1 100. 0. 1. DISPLAY_IDENTIFIER LV_READY_SHIFT_AFL_LSL_UP_2 ECU_ADDRESS 0xd000452e BIT_MASK 0x10 /end MEASUREMENT
/begin MEASUREMENT fmy_stat_shift_afl_lsl_up_2.err_info_stat.lv_end_diag "End of diagnosis XX" UWORD _CNV_S_2_RANGE__0___1_CM 1 100. 0. 1. DISPLAY_IDENTIFIER LV_END_DIAG_SHIFT_AFL_LSL_UP_2 ECU_ADDRESS 0xd000452e BIT_MASK 0x20 /end MEASUREMENT
/begin MEASUREMENT fmy_stat_shift_afl_lsl_up_2.err_info_stat.lv_cdn_diag "Diagnosis condition to start symptom detection (set to 1 when condition is fulfilled)" UWORD _CNV_S_2_RANGE__0___1_CM 1 100. 0. 1. DISPLAY_IDENTIFIER LV_CDN_DIAG_SHIFT_AFL_LSL_UP_2 ECU_ADDRESS 0xd000452e BIT_MASK 0x40 /end MEASUREMENT
/begin MEASUREMENT fmy_stat_shift_afl_lsl_up_2.err_info_stat.err_sym "For each symptom: status of failure (set to 1 when failure symptom is detected)" UWORD _CNV_S_16_RANGE_ERR__485_CM 1 100. 0. 15. DISPLAY_IDENTIFIER ERR_SYM_SHIFT_AFL_LSL_UP_2 ECU_ADDRESS 0xd000452e BIT_MASK 0x780 /end MEASUREMENT
/begin MEASUREMENT fmy_stat_shift_afr_lsl_up_2.ctr_abc "anti-bounce counter for diagnosis XX" UBYTE _CNV_A_R_LINEAR_____0_CM 1 100. 0. 255. DISPLAY_IDENTIFIER CTR_ABC_SHIFT_AFR_LSL_UP_2 ECU_ADDRESS 0xd0004534 FORMAT "%3.0" /end MEASUREMENT
/begin MEASUREMENT fmy_stat_shift_afr_lsl_up_2.ctr_end_diag "Counter for the end of diagnosis XX generation" UBYTE _CNV_A_R_LINEAR_____0_CM 1 100. 0. 255. DISPLAY_IDENTIFIER CTR_ABC_END_DIAG_SHIFT_AFR_LSL_UP_2 ECU_ADDRESS 0xd0004535 FORMAT "%3.0" /end MEASUREMENT
/begin MEASUREMENT fmy_stat_shift_afr_lsl_up_2.err_info_stat.lv_err_mem "Failure is stored in dynamic memory (2nd layer)" UWORD _CNV_S_2_RANGE__0___1_CM 1 100. 0. 1. DISPLAY_IDENTIFIER LV_ERR_MEM_SHIFT_AFR_LSL_UP_2 ECU_ADDRESS 0xd0004536 BIT_MASK 0x8 /end MEASUREMENT
/begin MEASUREMENT fmy_stat_shift_afr_lsl_up_2.err_info_stat.lv_ready "Readiness flag related to diagnosis XX" UWORD _CNV_S_2_RANGE__0___1_CM 1 100. 0. 1. DISPLAY_IDENTIFIER LV_READY_SHIFT_AFR_LSL_UP_2 ECU_ADDRESS 0xd0004536 BIT_MASK 0x10 /end MEASUREMENT
/begin MEASUREMENT fmy_stat_shift_afr_lsl_up_2.err_info_stat.lv_end_diag "End of diagnosis XX" UWORD _CNV_S_2_RANGE__0___1_CM 1 100. 0. 1. DISPLAY_IDENTIFIER LV_END_DIAG_SHIFT_AFR_LSL_UP_2 ECU_ADDRESS 0xd0004536 BIT_MASK 0x20 /end MEASUREMENT
/begin MEASUREMENT fmy_stat_shift_afr_lsl_up_2.err_info_stat.lv_cdn_diag "Diagnosis condition to start symptom detection (set to 1 when condition is fulfilled)" UWORD _CNV_S_2_RANGE__0___1_CM 1 100. 0. 1. DISPLAY_IDENTIFIER LV_CDN_DIAG_SHIFT_AFR_LSL_UP_2 ECU_ADDRESS 0xd0004536 BIT_MASK 0x40 /end MEASUREMENT
/begin MEASUREMENT fmy_stat_shift_afr_lsl_up_2.err_info_stat.err_sym "For each symptom: status of failure (set to 1 when failure symptom is detected)" UWORD _CNV_S_16_RANGE_ERR__485_CM 1 100. 0. 15. DISPLAY_IDENTIFIER ERR_SYM_SHIFT_AFR_LSL_UP_2 ECU_ADDRESS 0xd0004536 BIT_MASK 0x780 /end MEASUREMENT
/begin MEASUREMENT fmy_stat_oc_lsl_up_2.ctr_abc "anti-bounce counter for diagnosis XX" UBYTE _CNV_A_R_LINEAR_____0_CM 1 100. 0. 255. DISPLAY_IDENTIFIER CTR_ABC_OC_LSL_UP_2 ECU_ADDRESS 0xd0004484 FORMAT "%3.0" /end MEASUREMENT
/begin MEASUREMENT fmy_stat_oc_lsl_up_2.ctr_end_diag "Counter for the end of diagnosis XX generation" UBYTE _CNV_A_R_LINEAR_____0_CM 1 100. 0. 255. DISPLAY_IDENTIFIER CTR_ABC_END_DIAG_OC_LSL_UP_2 ECU_ADDRESS 0xd0004485 FORMAT "%3.0" /end MEASUREMENT
/begin MEASUREMENT fmy_stat_oc_lsl_up_2.err_info_stat.lv_err_mem "Failure is stored in dynamic memory (2nd layer)" UWORD _CNV_S_2_RANGE__0___1_CM 1 100. 0. 1. DISPLAY_IDENTIFIER LV_ERR_MEM_OC_LSL_UP_2 ECU_ADDRESS 0xd0004486 BIT_MASK 0x8 /end MEASUREMENT
/begin MEASUREMENT fmy_stat_oc_lsl_up_2.err_info_stat.lv_ready "Readiness flag related to diagnosis XX" UWORD _CNV_S_2_RANGE__0___1_CM 1 100. 0. 1. DISPLAY_IDENTIFIER LV_READY_OC_LSL_UP_2 ECU_ADDRESS 0xd0004486 BIT_MASK 0x10 /end MEASUREMENT
/begin MEASUREMENT fmy_stat_oc_lsl_up_2.err_info_stat.lv_end_diag "End of diagnosis XX" UWORD _CNV_S_2_RANGE__0___1_CM 1 100. 0. 1. DISPLAY_IDENTIFIER LV_END_DIAG_OC_LSL_UP_2 ECU_ADDRESS 0xd0004486 BIT_MASK 0x20 /end MEASUREMENT
/begin MEASUREMENT fmy_stat_oc_lsl_up_2.err_info_stat.lv_cdn_diag "Diagnosis condition to start symptom detection (set to 1 when condition is fulfilled)" UWORD _CNV_S_2_RANGE__0___1_CM 1 100. 0. 1. DISPLAY_IDENTIFIER LV_CDN_DIAG_OC_LSL_UP_2 ECU_ADDRESS 0xd0004486 BIT_MASK 0x40 /end MEASUREMENT
/begin MEASUREMENT fmy_stat_oc_lsl_up_2.err_info_stat.err_sym "For each symptom: status of failure (set to 1 when failure symptom is detected)" UWORD _CNV_S_16_RANGE_ERR__485_CM 1 100. 0. 15. DISPLAY_IDENTIFIER ERR_SYM_OC_LSL_UP_2 ECU_ADDRESS 0xd0004486 BIT_MASK 0x780 /end MEASUREMENT
/begin MEASUREMENT fmy_stat_delta_i_lam_2.ctr_abc "anti-bounce counter for diagnosis XX" UBYTE _CNV_A_R_LINEAR_____0_CM 1 100. 0. 255. DISPLAY_IDENTIFIER CTR_ABC_DELTA_I_LAM_2 ECU_ADDRESS 0xd00042a8 FORMAT "%3.0" /end MEASUREMENT
/begin MEASUREMENT fmy_stat_delta_i_lam_2.ctr_end_diag "Counter for the end of diagnosis XX generation" UBYTE _CNV_A_R_LINEAR_____0_CM 1 100. 0. 255. DISPLAY_IDENTIFIER CTR_ABC_END_DIAG_DELTA_I_LAM_2 ECU_ADDRESS 0xd00042a9 FORMAT "%3.0" /end MEASUREMENT
/begin MEASUREMENT fmy_stat_delta_i_lam_2.err_info_stat.lv_err_mem "Failure is stored in dynamic memory (2nd layer)" UWORD _CNV_S_2_RANGE__0___1_CM 1 100. 0. 1. DISPLAY_IDENTIFIER LV_ERR_MEM_DELTA_I_LAM_2 ECU_ADDRESS 0xd00042aa BIT_MASK 0x8 /end MEASUREMENT
/begin COMPU_METHOD _CNV_A_R_LINEAR_____0_CM "" RAT_FUNC "%6.3" "-" COEFFS 0 1. 0. 0 0 1 /end COMPU_METHOD
/begin COMPU_METHOD _CNV_S_2_RANGE__0___1_CM "" TAB_VERB "%6.3" "-" COMPU_TAB_REF _CNV_S_2_RANGE__0___1 /end COMPU_METHOD
/begin COMPU_VTAB _CNV_S_2_RANGE__0___1 "" TAB_VERB 2 0 "0" 1 "1" /end COMPU_VTAB
/begin COMPU_METHOD _CNV_S_16_RANGE_ERR__485_CM "" TAB_VERB "%6.3" "-" COMPU_TAB_REF _CNV_S_16_RANGE_ERR__485 /end COMPU_METHOD
/begin COMPU_VTAB _CNV_S_16_RANGE_ERR__485 "" TAB_VERB 16 0 "NO_SYM" 1 "SYM_0" 2 "SYM_1" 3 "SYM_0, SYM_1" 4 "SYM_2" 5 "SYM_0, SYM_2" 6 "SYM_1, SYM_2" 7 "SYM_0, SYM_1, SYM_2" 8 "SYM_3" 9 "SYM_0, SYM_3" 10 "SYM_1, SYM_3" 11 "SYM_0, SYM_1,SYM_3" 12 "SYM_2, SYM_3" 13 "SYM_0, SYM_2, SYM_3" 14 "SYM_1, SYM_2, SYM_3" 15 "SYM_0, SYM_1, SYM_2, SYM_3" /end COMPU_VTAB
/begin FUNCTION ERRM_Table_of_Failures "Table_of_Failures"
 /begin OUT_MEASUREMENT fmy_stat_bn_t_clk.err_info_stat.lv_ready fmy_stat_bn_t_clk.err_info_stat.lv_end_diag fmy_stat_bn_t_clk.err_info_stat.lv_cdn_diag fmy_stat_bn_t_clk.err_info_stat.err_sym fmy_stat_bn_efp_crash.ctr_abc fmy_stat_bn_efp_crash.ctr_end_diag fmy_stat_bn_efp_crash.err_info_stat.lv_err_mem fmy_stat_bn_efp_crash.err_info_stat.lv_ready fmy_stat_bn_efp_crash.err_info_stat.lv_end_diag fmy_stat_bn_efp_crash.err_info_stat.lv_cdn_diag fmy_stat_bn_efp_crash.err_info_stat.err_sym fmy_stat_bn_efp.ctr_abc fmy_stat_bn_efp.ctr_end_diag fmy_stat_bn_efp.err_info_stat.lv_err_mem fmy_stat_bn_efp.err_info_stat.lv_ready fmy_stat_bn_efp.err_info_stat.lv_end_diag fmy_stat_bn_efp.err_info_stat.lv_cdn_diag fmy_stat_bn_efp.err_info_stat.err_sym fmy_stat_load_tps_plaus.ctr_abc fmy_stat_load_tps_plaus.ctr_end_diag fmy_stat_load_tps_plaus.err_info_stat.lv_err_mem fmy_stat_load_tps_plaus.err_info_stat.lv_ready fmy_stat_load_tps_plaus.err_info_stat.lv_end_diag fmy_stat_load_tps_plaus.err_info_stat.lv_cdn_diag fmy_stat_load_tps_plaus.err_info_stat.err_sym fmy_stat_egy_min.ctr_abc fmy_stat_egy_min.ctr_end_diag fmy_stat_egy_min.err_info_stat.lv_err_mem fmy_stat_egy_min.err_info_stat.lv_ready fmy_stat_egy_min.err_info_stat.lv_end_diag fmy_stat_egy_min.err_info_stat.lv_cdn_diag fmy_stat_egy_min.err_info_stat.err_sym fmy_stat_efp_crash.ctr_abc fmy_stat_efp_crash.ctr_end_diag fmy_stat_efp_crash.err_info_stat.lv_err_mem fmy_stat_efp_crash.err_info_stat.lv_ready fmy_stat_efp_crash.err_info_stat.lv_end_diag fmy_stat_efp_crash.err_info_stat.lv_cdn_diag fmy_stat_efp_crash.err_info_stat.err_sym fmy_stat_efp.ctr_abc fmy_stat_efp.ctr_end_diag fmy_stat_efp.err_info_stat.lv_err_mem fmy_stat_efp.err_info_stat.lv_ready fmy_stat_efp.err_info_stat.lv_end_diag fmy_stat_efp.err_info_stat.lv_cdn_diag fmy_stat_efp.err_info_stat.err_sym fmy_stat_locan_boff.ctr_abc fmy_stat_locan_boff.ctr_end_diag fmy_stat_locan_boff.err_info_stat.lv_err_mem fmy_stat_locan_boff.err_info_stat.lv_ready fmy_stat_locan_boff.err_info_stat.lv_end_diag fmy_stat_locan_boff.err_info_stat.lv_cdn_diag fmy_stat_locan_boff.err_info_stat.err_sym fmy_stat_cwp_plaus.ctr_abc fmy_stat_cwp_plaus.ctr_end_diag fmy_stat_cwp_plaus.err_info_stat.lv_err_mem fmy_stat_cwp_plaus.err_info_stat.lv_ready fmy_stat_cwp_plaus.err_info_stat.lv_end_diag fmy_stat_cwp_plaus.err_info_stat.lv_cdn_diag fmy_stat_cwp_plaus.err_info_stat.err_sym fmy_stat_cwp_int_off.ctr_abc fmy_stat_cwp_int_off.ctr_end_diag fmy_stat_cwp_int_off.err_info_stat.lv_err_mem fmy_stat_cwp_int_off.err_info_stat.lv_ready fmy_stat_cwp_int_off.err_info_stat.lv_end_diag fmy_stat_cwp_int_off.err_info_stat.lv_cdn_diag fmy_stat_cwp_int_off.err_info_stat.err_sym fmy_stat_cwp_pwr.ctr_abc fmy_stat_cwp_pwr.ctr_end_diag fmy_stat_cwp_pwr.err_info_stat.lv_err_mem fmy_stat_cwp_pwr.err_info_stat.lv_ready fmy_stat_cwp_pwr.err_info_stat.lv_end_diag fmy_stat_cwp_pwr.err_info_stat.lv_cdn_diag fmy_stat_cwp_pwr.err_info_stat.err_sym fmy_stat_cwp_com_plaus.ctr_abc fmy_stat_cwp_com_plaus.ctr_end_diag fmy_stat_cwp_com_plaus.err_info_stat.lv_err_mem fmy_stat_cwp_com_plaus.err_info_stat.lv_ready fmy_stat_cwp_com_plaus.err_info_stat.lv_end_diag fmy_stat_cwp_com_plaus.err_info_stat.lv_cdn_diag fmy_stat_cwp_com_plaus.err_info_stat.err_sym fmy_stat_qoil_sens.ctr_abc fmy_stat_qoil_sens.ctr_end_diag fmy_stat_qoil_sens.err_info_stat.lv_err_mem fmy_stat_qoil_sens.err_info_stat.lv_ready fmy_stat_qoil_sens.err_info_stat.lv_end_diag fmy_stat_qoil_sens.err_info_stat.lv_cdn_diag fmy_stat_qoil_sens.err_info_stat.err_sym fmy_stat_bat_sens.ctr_abc fmy_stat_bat_sens.ctr_end_diag fmy_stat_bat_sens.err_info_stat.lv_err_mem fmy_stat_bat_sens.err_info_stat.lv_ready fmy_stat_bat_sens.err_info_stat.lv_end_diag fmy_stat_bat_sens.err_info_stat.lv_cdn_diag fmy_stat_bat_sens.err_info_stat.err_sym fmy_stat_bat_sens_it.ctr_abc fmy_stat_bat_sens_it.ctr_end_diag fmy_stat_bat_sens_it.err_info_stat.lv_err_mem fmy_stat_bat_sens_it.err_info_stat.lv_ready fmy_stat_bat_sens_it.err_info_stat.lv_end_diag fmy_stat_bat_sens_it.err_info_stat.lv_cdn_diag fmy_stat_bat_sens_it.err_info_stat.err_sym fmy_stat_bat_sens_it_el.ctr_abc fmy_stat_bat_sens_it_el.ctr_end_diag fmy_stat_bat_sens_it_el.err_info_stat.lv_err_mem fmy_stat_bat_sens_it_el.err_info_stat.lv_ready fmy_stat_bat_sens_it_el.err_info_stat.lv_end_diag fmy_stat_bat_sens_it_el.err_info_stat.lv_cdn_diag fmy_stat_bat_sens_it_el.err_info_stat.err_sym fmy_stat_ecu_nvmy.ctr_abc fmy_stat_ecu_nvmy.ctr_end_diag fmy_stat_ecu_nvmy.err_info_stat.lv_err_mem fmy_stat_ecu_nvmy.err_info_stat.lv_ready fmy_stat_ecu_nvmy.err_info_stat.lv_end_diag fmy_stat_ecu_nvmy.err_info_stat.lv_cdn_diag fmy_stat_ecu_nvmy.err_info_stat.err_sym fmy_stat_gs.ctr_abc fmy_stat_gs.ctr_end_diag fmy_stat_gs.err_info_stat.lv_err_mem fmy_stat_gs.err_info_stat.lv_ready fmy_stat_gs.err_info_stat.lv_end_diag fmy_stat_gs.err_info_stat.lv_cdn_diag fmy_stat_gs.err_info_stat.err_sym fmy_stat_plaus_igk_bn.ctr_abc fmy_stat_plaus_igk_bn.ctr_end_diag fmy_stat_plaus_igk_bn.err_info_stat.lv_err_mem fmy_stat_plaus_igk_bn.err_info_stat.lv_ready fmy_stat_plaus_igk_bn.err_info_stat.lv_end_diag fmy_stat_plaus_igk_bn.err_info_stat.lv_cdn_diag fmy_stat_plaus_igk_bn.err_info_stat.err_sym fmy_stat_tq_req_can.ctr_abc fmy_stat_tq_req_can.ctr_end_diag fmy_stat_tq_req_can.err_info_stat.lv_err_mem fmy_stat_tq_req_can.err_info_stat.lv_ready fmy_stat_tq_req_can.err_info_stat.lv_end_diag fmy_stat_tq_req_can.err_info_stat.lv_cdn_diag fmy_stat_tq_req_can.err_info_stat.err_sym fmy_stat_map_dip_sens.ctr_abc fmy_stat_map_dip_sens.ctr_end_diag fmy_stat_map_dip_sens.err_info_stat.lv_err_mem fmy_stat_map_dip_sens.err_info_stat.lv_ready fmy_stat_map_dip_sens.err_info_stat.lv_end_diag fmy_stat_map_dip_sens.err_info_stat.lv_cdn_diag fmy_stat_map_dip_sens.err_info_stat.err_sym fmy_stat_mec_ivvt_in.ctr_abc fmy_stat_mec_ivvt_in.ctr_end_diag fmy_stat_mec_ivvt_in.err_info_stat.lv_err_mem fmy_stat_mec_ivvt_in.err_info_stat.lv_ready fmy_stat_mec_ivvt_in.err_info_stat.lv_end_diag fmy_stat_mec_ivvt_in.err_info_stat.lv_cdn_diag fmy_stat_mec_ivvt_in.err_info_stat.err_sym fmy_stat_mec_ivvt_ex.ctr_abc fmy_stat_mec_ivvt_ex.ctr_end_diag fmy_stat_mec_ivvt_ex.err_info_stat.lv_err_mem fmy_stat_mec_ivvt_ex.err_info_stat.lv_ready fmy_stat_mec_ivvt_ex.err_info_stat.lv_end_diag fmy_stat_mec_ivvt_ex.err_info_stat.lv_cdn_diag fmy_stat_mec_ivvt_ex.err_info_stat.err_sym fmy_stat_tout_nox_sens_1.ctr_abc fmy_stat_tout_nox_sens_1.ctr_end_diag fmy_stat_tout_nox_sens_1.err_info_stat.lv_err_mem fmy_stat_tout_nox_sens_1.err_info_stat.lv_ready fmy_stat_tout_nox_sens_1.err_info_stat.lv_end_diag fmy_stat_tout_nox_sens_1.err_info_stat.lv_cdn_diag fmy_stat_tout_nox_sens_1.err_info_stat.err_sym fmy_stat_tout_nox_sens_2.ctr_abc fmy_stat_tout_nox_sens_2.ctr_end_diag fmy_stat_tout_nox_sens_2.err_info_stat.lv_err_mem fmy_stat_tout_nox_sens_2.err_info_stat.lv_ready fmy_stat_tout_nox_sens_2.err_info_stat.lv_end_diag fmy_stat_tout_nox_sens_2.err_info_stat.lv_cdn_diag fmy_stat_tout_nox_sens_2.err_info_stat.err_sym fmy_stat_vvl_rot.ctr_abc fmy_stat_vvl_rot.ctr_end_diag fmy_stat_vvl_rot.err_info_stat.lv_err_mem fmy_stat_vvl_rot.err_info_stat.lv_ready fmy_stat_vvl_rot.err_info_stat.lv_end_diag fmy_stat_vvl_rot.err_info_stat.lv_cdn_diag fmy_stat_vvl_rot.err_info_stat.err_sym fmy_stat_rly_vvl.ctr_abc fmy_stat_rly_vvl.ctr_end_diag fmy_stat_rly_vvl.err_info_stat.lv_err_mem fmy_stat_rly_vvl.err_info_stat.lv_ready fmy_stat_rly_vvl.err_info_stat.lv_end_diag fmy_stat_rly_vvl.err_info_stat.lv_cdn_diag fmy_stat_rly_vvl.err_info_stat.err_sym fmy_stat_nox_sens_1.ctr_abc fmy_stat_nox_sens_1.ctr_end_diag fmy_stat_nox_sens_1.err_info_stat.lv_err_mem fmy_stat_nox_sens_1.err_info_stat.lv_ready fmy_stat_nox_sens_1.err_info_stat.lv_end_diag fmy_stat_nox_sens_1.err_info_stat.lv_cdn_diag fmy_stat_nox_sens_1.err_info_stat.err_sym fmy_stat_ovl_ecu_vvl.ctr_abc fmy_stat_ovl_ecu_vvl.ctr_end_diag fmy_stat_ovl_ecu_vvl.err_info_stat.lv_err_mem fmy_stat_ovl_ecu_vvl.err_info_stat.lv_ready fmy_stat_ovl_ecu_vvl.err_info_stat.lv_end_diag fmy_stat_ovl_ecu_vvl.err_info_stat.lv_cdn_diag fmy_stat_ovl_ecu_vvl.err_info_stat.err_sym fmy_stat_dr_sc_vvl.ctr_abc fmy_stat_dr_sc_vvl.ctr_end_diag fmy_stat_dr_sc_vvl.err_info_stat.lv_err_mem fmy_stat_dr_sc_vvl.err_info_stat.lv_ready fmy_stat_dr_sc_vvl.err_info_stat.lv_end_diag fmy_stat_dr_sc_vvl.err_info_stat.lv_cdn_diag fmy_stat_dr_sc_vvl.err_info_stat.err_sym fmy_stat_crit_ovl_ecu_vvl.ctr_abc fmy_stat_crit_ovl_ecu_vvl.ctr_end_diag fmy_stat_crit_ovl_ecu_vvl.err_info_stat.lv_err_mem fmy_stat_crit_ovl_ecu_vvl.err_info_stat.lv_ready fmy_stat_crit_ovl_ecu_vvl.err_info_stat.lv_end_diag fmy_stat_crit_ovl_ecu_vvl.err_info_stat.lv_cdn_diag fmy_stat_crit_ovl_ecu_vvl.err_info_stat.err_sym fmy_stat_nox_sens_2.ctr_abc fmy_stat_nox_sens_2.ctr_end_diag fmy_stat_nox_sens_2.err_info_stat.lv_err_mem fmy_stat_nox_sens_2.err_info_stat.lv_ready fmy_stat_nox_sens_2.err_info_stat.lv_end_diag fmy_stat_nox_sens_2.err_info_stat.lv_cdn_diag fmy_stat_nox_sens_2.err_info_stat.err_sym fmy_stat_cur_h_vvl.ctr_abc fmy_stat_cur_h_vvl.ctr_end_diag fmy_stat_cur_h_vvl.err_info_stat.lv_err_mem fmy_stat_cur_h_vvl.err_info_stat.lv_ready fmy_stat_cur_h_vvl.err_info_stat.lv_end_diag fmy_stat_cur_h_vvl.err_info_stat.lv_cdn_diag fmy_stat_cur_h_vvl.err_info_stat.err_sym fmy_stat_teg_pcat_down_1.ctr_abc fmy_stat_teg_pcat_down_1.ctr_end_diag fmy_stat_teg_pcat_down_1.err_info_stat.lv_err_mem fmy_stat_teg_pcat_down_1.err_info_stat.lv_ready fmy_stat_teg_pcat_down_1.err_info_stat.lv_end_diag fmy_stat_teg_pcat_down_1.err_info_stat.lv_cdn_diag fmy_stat_teg_pcat_down_1.err_info_stat.err_sym fmy_stat_teg_pcat_down_2.ctr_abc fmy_stat_teg_pcat_down_2.ctr_end_diag fmy_stat_teg_pcat_down_2.err_info_stat.lv_err_mem fmy_stat_teg_pcat_down_2.err_info_stat.lv_ready fmy_stat_teg_pcat_down_2.err_info_stat.lv_end_diag fmy_stat_teg_pcat_down_2.err_info_stat.lv_cdn_diag fmy_stat_teg_pcat_down_2.err_info_stat.err_sym fmy_stat_t_seg_er.ctr_abc fmy_stat_t_seg_er.ctr_end_diag fmy_stat_t_seg_er.err_info_stat.lv_err_mem fmy_stat_t_seg_er.err_info_stat.lv_ready fmy_stat_t_seg_er.err_info_stat.lv_end_diag fmy_stat_t_seg_er.err_info_stat.lv_cdn_diag fmy_stat_t_seg_er.err_info_stat.err_sym fmy_stat_seg_ad_er.ctr_abc fmy_stat_seg_ad_er.ctr_end_diag fmy_stat_seg_ad_er.err_info_stat.lv_err_mem fmy_stat_seg_ad_er.err_info_stat.lv_ready fmy_stat_seg_ad_er.err_info_stat.lv_end_diag fmy_stat_seg_ad_er.err_info_stat.lv_cdn_diag fmy_stat_seg_ad_er.err_info_stat.err_sym fmy_stat_vs_plaus.ctr_abc fmy_stat_vs_plaus.ctr_end_diag fmy_stat_vs_plaus.err_info_stat.lv_err_mem fmy_stat_vs_plaus.err_info_stat.lv_ready fmy_stat_vs_plaus.err_info_stat.lv_end_diag fmy_stat_vs_plaus.err_info_stat.lv_cdn_diag fmy_stat_vs_plaus.err_info_stat.err_sym fmy_stat_ftl_obd.ctr_abc fmy_stat_ftl_obd.ctr_end_diag fmy_stat_ftl_obd.err_info_stat.lv_err_mem fmy_stat_ftl_obd.err_info_stat.lv_ready fmy_stat_ftl_obd.err_info_stat.lv_end_diag fmy_stat_ftl_obd.err_info_stat.lv_cdn_diag fmy_stat_ftl_obd.err_info_stat.err_sym fmy_stat_ftl_can.ctr_abc fmy_stat_ftl_can.ctr_end_diag fmy_stat_ftl_can.err_info_stat.lv_err_mem fmy_stat_ftl_can.err_info_stat.lv_ready fmy_stat_ftl_can.err_info_stat.lv_end_diag fmy_stat_ftl_can.err_info_stat.lv_cdn_diag fmy_stat_ftl_can.err_info_stat.err_sym fmy_stat_tia_plaus.ctr_abc fmy_stat_tia_plaus.ctr_end_diag fmy_stat_tia_plaus.err_info_stat.lv_err_mem fmy_stat_tia_plaus.err_info_stat.lv_ready fmy_stat_tia_plaus.err_info_stat.lv_end_diag fmy_stat_tia_plaus.err_info_stat.lv_cdn_diag fmy_stat_tia_plaus.err_info_stat.err_sym fmy_stat_tam_can.ctr_abc fmy_stat_tam_can.ctr_end_diag fmy_stat_tam_can.err_info_stat.lv_err_mem fmy_stat_tam_can.err_info_stat.lv_ready fmy_stat_tam_can.err_info_stat.lv_end_diag fmy_stat_tam_can.err_info_stat.lv_cdn_diag fmy_stat_tam_can.err_info_stat.err_sym fmy_stat_tam_plaus.ctr_abc fmy_stat_tam_plaus.ctr_end_diag fmy_stat_tam_plaus.err_info_stat.lv_err_mem fmy_stat_tam_plaus.err_info_stat.lv_ready fmy_stat_tam_plaus.err_info_stat.lv_end_diag fmy_stat_tam_plaus.err_info_stat.lv_cdn_diag fmy_stat_tam_plaus.err_info_stat.err_sym fmy_stat_map_dip_shift.ctr_abc fmy_stat_map_dip_shift.ctr_end_diag fmy_stat_map_dip_shift.err_info_stat.lv_err_mem fmy_stat_map_dip_shift.err_info_stat.lv_ready fmy_stat_map_dip_shift.err_info_stat.lv_end_diag fmy_stat_map_dip_shift.err_info_stat.lv_cdn_diag fmy_stat_map_dip_shift.err_info_stat.err_sym fmy_stat_cat_diag_1.ctr_abc fmy_stat_cat_diag_1.ctr_end_diag fmy_stat_cat_diag_1.err_info_stat.lv_err_mem fmy_stat_cat_diag_1.err_info_stat.lv_ready fmy_stat_cat_diag_1.err_info_stat.lv_end_diag fmy_stat_cat_diag_1.err_info_stat.lv_cdn_diag fmy_stat_cat_diag_1.err_info_stat.err_sym fmy_stat_cat_diag_2.ctr_abc fmy_stat_cat_diag_2.ctr_end_diag fmy_stat_cat_diag_2.err_info_stat.lv_err_mem fmy_stat_cat_diag_2.err_info_stat.lv_ready fmy_stat_cat_diag_2.err_info_stat.lv_end_diag fmy_stat_cat_diag_2.err_info_stat.lv_cdn_diag fmy_stat_cat_diag_2.err_info_stat.err_sym fmy_stat_cat_diag_afl_1.ctr_abc fmy_stat_cat_diag_afl_1.ctr_end_diag fmy_stat_cat_diag_afl_1.err_info_stat.lv_err_mem fmy_stat_cat_diag_afl_1.err_info_stat.lv_ready fmy_stat_cat_diag_afl_1.err_info_stat.lv_end_diag fmy_stat_cat_diag_afl_1.err_info_stat.lv_cdn_diag fmy_stat_cat_diag_afl_1.err_info_stat.err_sym fmy_stat_cat_diag_afl_2.ctr_abc fmy_stat_cat_diag_afl_2.ctr_end_diag fmy_stat_cat_diag_afl_2.err_info_stat.lv_err_mem fmy_stat_cat_diag_afl_2.err_info_stat.lv_ready fmy_stat_cat_diag_afl_2.err_info_stat.lv_end_diag fmy_stat_cat_diag_afl_2.err_info_stat.lv_cdn_diag fmy_stat_cat_diag_afl_2.err_info_stat.err_sym fmy_stat_scg_ls_down_1.ctr_abc fmy_stat_scg_ls_down_1.ctr_end_diag fmy_stat_scg_ls_down_1.err_info_stat.lv_err_mem fmy_stat_scg_ls_down_1.err_info_stat.lv_ready fmy_stat_scg_ls_down_1.err_info_stat.lv_end_diag fmy_stat_scg_ls_down_1.err_info_stat.lv_cdn_diag fmy_stat_scg_ls_down_1.err_info_stat.err_sym fmy_stat_scp_ls_down_1.ctr_abc fmy_stat_scp_ls_down_1.ctr_end_diag fmy_stat_scp_ls_down_1.err_info_stat.lv_err_mem fmy_stat_scp_ls_down_1.err_info_stat.lv_ready fmy_stat_scp_ls_down_1.err_info_stat.lv_end_diag fmy_stat_scp_ls_down_1.err_info_stat.lv_cdn_diag fmy_stat_scp_ls_down_1.err_info_stat.err_sym fmy_stat_oc_ls_down_1.ctr_abc fmy_stat_oc_ls_down_1.ctr_end_diag fmy_stat_oc_ls_down_1.err_info_stat.lv_err_mem fmy_stat_oc_ls_down_1.err_info_stat.lv_ready fmy_stat_oc_ls_down_1.err_info_stat.lv_end_diag fmy_stat_oc_ls_down_1.err_info_stat.lv_cdn_diag fmy_stat_oc_ls_down_1.err_info_stat.err_sym fmy_stat_puc_ls_down_1.ctr_abc fmy_stat_puc_ls_down_1.ctr_end_diag fmy_stat_puc_ls_down_1.err_info_stat.lv_err_mem fmy_stat_puc_ls_down_1.err_info_stat.lv_ready fmy_stat_puc_ls_down_1.err_info_stat.lv_end_diag fmy_stat_puc_ls_down_1.err_info_stat.lv_cdn_diag fmy_stat_puc_ls_down_1.err_info_stat.err_sym fmy_stat_fl_ls_down_1.ctr_abc fmy_stat_fl_ls_down_1.ctr_end_diag fmy_stat_fl_ls_down_1.err_info_stat.lv_err_mem fmy_stat_fl_ls_down_1.err_info_stat.lv_ready fmy_stat_fl_ls_down_1.err_info_stat.lv_end_diag fmy_stat_fl_ls_down_1.err_info_stat.lv_cdn_diag fmy_stat_fl_ls_down_1.err_info_stat.err_sym fmy_stat_lsl_up_if_1.ctr_abc fmy_stat_lsl_up_if_1.ctr_end_diag fmy_stat_lsl_up_if_1.err_info_stat.lv_err_mem fmy_stat_lsl_up_if_1.err_info_stat.lv_ready fmy_stat_lsl_up_if_1.err_info_stat.lv_end_diag fmy_stat_lsl_up_if_1.err_info_stat.lv_cdn_diag fmy_stat_lsl_up_if_1.err_info_stat.err_sym fmy_stat_el_lsl_up_1.ctr_abc fmy_stat_el_lsl_up_1.ctr_end_diag fmy_stat_el_lsl_up_1.err_info_stat.lv_err_mem fmy_stat_el_lsl_up_1.err_info_stat.lv_ready fmy_stat_el_lsl_up_1.err_info_stat.lv_end_diag fmy_stat_el_lsl_up_1.err_info_stat.lv_cdn_diag fmy_stat_el_lsl_up_1.err_info_stat.err_sym fmy_stat_lsh_up_1.ctr_abc fmy_stat_lsh_up_1.ctr_end_diag fmy_stat_lsh_up_1.err_info_stat.lv_err_mem fmy_stat_lsh_up_1.err_info_stat.lv_ready fmy_stat_lsh_up_1.err_info_stat.lv_end_diag fmy_stat_lsh_up_1.err_info_stat.lv_cdn_diag fmy_stat_lsh_up_1.err_info_stat.err_sym fmy_stat_lsh_down_1.ctr_abc fmy_stat_lsh_down_1.ctr_end_diag fmy_stat_lsh_down_1.err_info_stat.lv_err_mem fmy_stat_lsh_down_1.err_info_stat.lv_ready fmy_stat_lsh_down_1.err_info_stat.lv_end_diag fmy_stat_lsh_down_1.err_info_stat.lv_cdn_diag fmy_stat_lsh_down_1.err_info_stat.err_sym fmy_stat_vls_down_dif_1.ctr_abc fmy_stat_vls_down_dif_1.ctr_end_diag fmy_stat_vls_down_dif_1.err_info_stat.lv_err_mem fmy_stat_vls_down_dif_1.err_info_stat.lv_ready fmy_stat_vls_down_dif_1.err_info_stat.lv_end_diag fmy_stat_vls_down_dif_1.err_info_stat.lv_cdn_diag fmy_stat_vls_down_dif_1.err_info_stat.err_sym fmy_stat_lsh_lsl_up_1.ctr_abc fmy_stat_lsh_lsl_up_1.ctr_end_diag fmy_stat_lsh_lsl_up_1.err_info_stat.lv_err_mem fmy_stat_lsh_lsl_up_1.err_info_stat.lv_ready fmy_stat_lsh_lsl_up_1.err_info_stat.lv_end_diag fmy_stat_lsh_lsl_up_1.err_info_stat.lv_cdn_diag fmy_stat_lsh_lsl_up_1.err_info_stat.err_sym fmy_stat_air_lsl_up_1.ctr_abc fmy_stat_air_lsl_up_1.ctr_end_diag fmy_stat_air_lsl_up_1.err_info_stat.lv_err_mem fmy_stat_air_lsl_up_1.err_info_stat.lv_ready fmy_stat_air_lsl_up_1.err_info_stat.lv_end_diag fmy_stat_air_lsl_up_1.err_info_stat.lv_cdn_diag fmy_stat_air_lsl_up_1.err_info_stat.err_sym fmy_stat_pue_ls_down_1.ctr_abc fmy_stat_pue_ls_down_1.ctr_end_diag fmy_stat_pue_ls_down_1.err_info_stat.lv_err_mem fmy_stat_pue_ls_down_1.err_info_stat.lv_ready fmy_stat_pue_ls_down_1.err_info_stat.lv_end_diag fmy_stat_pue_ls_down_1.err_info_stat.lv_cdn_diag fmy_stat_pue_ls_down_1.err_info_stat.err_sym fmy_stat_swt_ls_down_1.ctr_abc fmy_stat_swt_ls_down_1.ctr_end_diag fmy_stat_swt_ls_down_1.err_info_stat.lv_err_mem fmy_stat_swt_ls_down_1.err_info_stat.lv_ready fmy_stat_swt_ls_down_1.err_info_stat.lv_end_diag fmy_stat_swt_ls_down_1.err_info_stat.lv_cdn_diag fmy_stat_swt_ls_down_1.err_info_stat.err_sym fmy_stat_obd_lsh_down_1.ctr_abc fmy_stat_obd_lsh_down_1.ctr_end_diag fmy_stat_obd_lsh_down_1.err_info_stat.lv_err_mem fmy_stat_obd_lsh_down_1.err_info_stat.lv_ready fmy_stat_obd_lsh_down_1.err_info_stat.lv_end_diag fmy_stat_obd_lsh_down_1.err_info_stat.lv_cdn_diag fmy_stat_obd_lsh_down_1.err_info_stat.err_sym fmy_stat_dyn_vld_ls_up_1.ctr_abc fmy_stat_dyn_vld_ls_up_1.ctr_end_diag fmy_stat_dyn_vld_ls_up_1.err_info_stat.lv_err_mem fmy_stat_dyn_vld_ls_up_1.err_info_stat.lv_ready fmy_stat_dyn_vld_ls_up_1.err_info_stat.lv_end_diag fmy_stat_dyn_vld_ls_up_1.err_info_stat.lv_cdn_diag fmy_stat_dyn_vld_ls_up_1.err_info_stat.err_sym fmy_stat_puc_vld_ls_up_1.ctr_abc fmy_stat_puc_vld_ls_up_1.ctr_end_diag fmy_stat_puc_vld_ls_up_1.err_info_stat.lv_err_mem fmy_stat_puc_vld_ls_up_1.err_info_stat.lv_ready fmy_stat_puc_vld_ls_up_1.err_info_stat.lv_end_diag fmy_stat_puc_vld_ls_up_1.err_info_stat.lv_cdn_diag fmy_stat_puc_vld_ls_up_1.err_info_stat.err_sym fmy_stat_obd_vld_lsh_up_1.ctr_abc fmy_stat_obd_vld_lsh_up_1.ctr_end_diag fmy_stat_obd_vld_lsh_up_1.err_info_stat.lv_err_mem fmy_stat_obd_vld_lsh_up_1.err_info_stat.lv_ready fmy_stat_obd_vld_lsh_up_1.err_info_stat.lv_end_diag fmy_stat_obd_vld_lsh_up_1.err_info_stat.lv_cdn_diag fmy_stat_obd_vld_lsh_up_1.err_info_stat.err_sym fmy_stat_chk_ls_down_1.ctr_abc fmy_stat_chk_ls_down_1.ctr_end_diag fmy_stat_chk_ls_down_1.err_info_stat.lv_err_mem fmy_stat_chk_ls_down_1.err_info_stat.lv_ready fmy_stat_chk_ls_down_1.err_info_stat.lv_end_diag fmy_stat_chk_ls_down_1.err_info_stat.lv_cdn_diag fmy_stat_chk_ls_down_1.err_info_stat.err_sym fmy_stat_shift_afl_lsl_up_1.ctr_abc fmy_stat_shift_afl_lsl_up_1.ctr_end_diag fmy_stat_shift_afl_lsl_up_1.err_info_stat.lv_err_mem fmy_stat_shift_afl_lsl_up_1.err_info_stat.lv_ready fmy_stat_shift_afl_lsl_up_1.err_info_stat.lv_end_diag fmy_stat_shift_afl_lsl_up_1.err_info_stat.lv_cdn_diag fmy_stat_shift_afl_lsl_up_1.err_info_stat.err_sym fmy_stat_shift_afr_lsl_up_1.ctr_abc fmy_stat_shift_afr_lsl_up_1.ctr_end_diag fmy_stat_shift_afr_lsl_up_1.err_info_stat.lv_err_mem fmy_stat_shift_afr_lsl_up_1.err_info_stat.lv_ready fmy_stat_shift_afr_lsl_up_1.err_info_stat.lv_end_diag fmy_stat_shift_afr_lsl_up_1.err_info_stat.lv_cdn_diag fmy_stat_shift_afr_lsl_up_1.err_info_stat.err_sym fmy_stat_oc_lsl_up_1.ctr_abc fmy_stat_oc_lsl_up_1.ctr_end_diag fmy_stat_oc_lsl_up_1.err_info_stat.lv_err_mem fmy_stat_oc_lsl_up_1.err_info_stat.lv_ready fmy_stat_oc_lsl_up_1.err_info_stat.lv_end_diag fmy_stat_oc_lsl_up_1.err_info_stat.lv_cdn_diag fmy_stat_oc_lsl_up_1.err_info_stat.err_sym fmy_stat_delta_i_lam_1.ctr_abc fmy_stat_delta_i_lam_1.ctr_end_diag fmy_stat_delta_i_lam_1.err_info_stat.lv_err_mem fmy_stat_delta_i_lam_1.err_info_stat.lv_ready fmy_stat_delta_i_lam_1.err_info_stat.lv_end_diag fmy_stat_delta_i_lam_1.err_info_stat.lv_cdn_diag fmy_stat_delta_i_lam_1.err_info_stat.err_sym fmy_stat_rgn_nt_ls_down_1.ctr_abc fmy_stat_rgn_nt_ls_down_1.ctr_end_diag fmy_stat_rgn_nt_ls_down_1.err_info_stat.lv_err_mem fmy_stat_rgn_nt_ls_down_1.err_info_stat.lv_ready fmy_stat_rgn_nt_ls_down_1.err_info_stat.lv_end_diag fmy_stat_rgn_nt_ls_down_1.err_info_stat.lv_cdn_diag fmy_stat_rgn_nt_ls_down_1.err_info_stat.err_sym fmy_stat_chg_ls_down.ctr_abc fmy_stat_chg_ls_down.ctr_end_diag fmy_stat_chg_ls_down.err_info_stat.lv_err_mem fmy_stat_chg_ls_down.err_info_stat.lv_ready fmy_stat_chg_ls_down.err_info_stat.lv_end_diag fmy_stat_chg_ls_down.err_info_stat.lv_cdn_diag fmy_stat_chg_ls_down.err_info_stat.err_sym fmy_stat_scg_ls_down_2.ctr_abc fmy_stat_scg_ls_down_2.ctr_end_diag fmy_stat_scg_ls_down_2.err_info_stat.lv_err_mem fmy_stat_scg_ls_down_2.err_info_stat.lv_ready fmy_stat_scg_ls_down_2.err_info_stat.lv_end_diag fmy_stat_scg_ls_down_2.err_info_stat.lv_cdn_diag fmy_stat_scg_ls_down_2.err_info_stat.err_sym fmy_stat_scp_ls_down_2.ctr_abc fmy_stat_scp_ls_down_2.ctr_end_diag fmy_stat_scp_ls_down_2.err_info_stat.lv_err_mem fmy_stat_scp_ls_down_2.err_info_stat.lv_ready fmy_stat_scp_ls_down_2.err_info_stat.lv_end_diag fmy_stat_scp_ls_down_2.err_info_stat.lv_cdn_diag fmy_stat_scp_ls_down_2.err_info_stat.err_sym fmy_stat_oc_ls_down_2.ctr_abc fmy_stat_oc_ls_down_2.ctr_end_diag fmy_stat_oc_ls_down_2.err_info_stat.lv_err_mem fmy_stat_oc_ls_down_2.err_info_stat.lv_ready fmy_stat_oc_ls_down_2.err_info_stat.lv_end_diag fmy_stat_oc_ls_down_2.err_info_stat.lv_cdn_diag fmy_stat_oc_ls_down_2.err_info_stat.err_sym fmy_stat_puc_ls_down_2.ctr_abc fmy_stat_puc_ls_down_2.ctr_end_diag fmy_stat_puc_ls_down_2.err_info_stat.lv_err_mem fmy_stat_puc_ls_down_2.err_info_stat.lv_ready fmy_stat_puc_ls_down_2.err_info_stat.lv_end_diag fmy_stat_puc_ls_down_2.err_info_stat.lv_cdn_diag fmy_stat_puc_ls_down_2.err_info_stat.err_sym fmy_stat_fl_ls_down_2.ctr_abc fmy_stat_fl_ls_down_2.ctr_end_diag fmy_stat_fl_ls_down_2.err_info_stat.lv_err_mem fmy_stat_fl_ls_down_2.err_info_stat.lv_ready fmy_stat_fl_ls_down_2.err_info_stat.lv_end_diag fmy_stat_fl_ls_down_2.err_info_stat.lv_cdn_diag fmy_stat_fl_ls_down_2.err_info_stat.err_sym fmy_stat_lsl_up_if_2.ctr_abc fmy_stat_lsl_up_if_2.ctr_end_diag fmy_stat_lsl_up_if_2.err_info_stat.lv_err_mem fmy_stat_lsl_up_if_2.err_info_stat.lv_ready fmy_stat_lsl_up_if_2.err_info_stat.lv_end_diag fmy_stat_lsl_up_if_2.err_info_stat.lv_cdn_diag fmy_stat_lsl_up_if_2.err_info_stat.err_sym fmy_stat_el_lsl_up_2.ctr_abc fmy_stat_el_lsl_up_2.ctr_end_diag fmy_stat_el_lsl_up_2.err_info_stat.lv_err_mem fmy_stat_el_lsl_up_2.err_info_stat.lv_ready fmy_stat_el_lsl_up_2.err_info_stat.lv_end_diag fmy_stat_el_lsl_up_2.err_info_stat.lv_cdn_diag fmy_stat_el_lsl_up_2.err_info_stat.err_sym fmy_stat_lsh_up_2.ctr_abc fmy_stat_lsh_up_2.ctr_end_diag fmy_stat_lsh_up_2.err_info_stat.lv_err_mem fmy_stat_lsh_up_2.err_info_stat.lv_ready fmy_stat_lsh_up_2.err_info_stat.lv_end_diag fmy_stat_lsh_up_2.err_info_stat.lv_cdn_diag fmy_stat_lsh_up_2.err_info_stat.err_sym fmy_stat_lsh_down_2.ctr_abc fmy_stat_lsh_down_2.ctr_end_diag fmy_stat_lsh_down_2.err_info_stat.lv_err_mem fmy_stat_lsh_down_2.err_info_stat.lv_ready fmy_stat_lsh_down_2.err_info_stat.lv_end_diag fmy_stat_lsh_down_2.err_info_stat.lv_cdn_diag fmy_stat_lsh_down_2.err_info_stat.err_sym fmy_stat_vls_down_dif_2.ctr_abc fmy_stat_vls_down_dif_2.ctr_end_diag fmy_stat_vls_down_dif_2.err_info_stat.lv_err_mem fmy_stat_vls_down_dif_2.err_info_stat.lv_ready fmy_stat_vls_down_dif_2.err_info_stat.lv_end_diag fmy_stat_vls_down_dif_2.err_info_stat.lv_cdn_diag fmy_stat_vls_down_dif_2.err_info_stat.err_sym fmy_stat_lsh_lsl_up_2.ctr_abc fmy_stat_lsh_lsl_up_2.ctr_end_diag fmy_stat_lsh_lsl_up_2.err_info_stat.lv_err_mem fmy_stat_lsh_lsl_up_2.err_info_stat.lv_ready fmy_stat_lsh_lsl_up_2.err_info_stat.lv_end_diag fmy_stat_lsh_lsl_up_2.err_info_stat.lv_cdn_diag fmy_stat_lsh_lsl_up_2.err_info_stat.err_sym fmy_stat_air_lsl_up_2.ctr_abc fmy_stat_air_lsl_up_2.ctr_end_diag fmy_stat_air_lsl_up_2.err_info_stat.lv_err_mem fmy_stat_air_lsl_up_2.err_info_stat.lv_ready fmy_stat_air_lsl_up_2.err_info_stat.lv_end_diag fmy_stat_air_lsl_up_2.err_info_stat.lv_cdn_diag fmy_stat_air_lsl_up_2.err_info_stat.err_sym fmy_stat_pue_ls_down_2.ctr_abc fmy_stat_pue_ls_down_2.ctr_end_diag fmy_stat_pue_ls_down_2.err_info_stat.lv_err_mem fmy_stat_pue_ls_down_2.err_info_stat.lv_ready fmy_stat_pue_ls_down_2.err_info_stat.lv_end_diag fmy_stat_pue_ls_down_2.err_info_stat.lv_cdn_diag fmy_stat_pue_ls_down_2.err_info_stat.err_sym fmy_stat_swt_ls_down_2.ctr_abc fmy_stat_swt_ls_down_2.ctr_end_diag fmy_stat_swt_ls_down_2.err_info_stat.lv_err_mem fmy_stat_swt_ls_down_2.err_info_stat.lv_ready fmy_stat_swt_ls_down_2.err_info_stat.lv_end_diag fmy_stat_swt_ls_down_2.err_info_stat.lv_cdn_diag fmy_stat_swt_ls_down_2.err_info_stat.err_sym fmy_stat_obd_lsh_down_2.ctr_abc fmy_stat_obd_lsh_down_2.ctr_end_diag fmy_stat_obd_lsh_down_2.err_info_stat.lv_err_mem fmy_stat_obd_lsh_down_2.err_info_stat.lv_ready fmy_stat_obd_lsh_down_2.err_info_stat.lv_end_diag fmy_stat_obd_lsh_down_2.err_info_stat.lv_cdn_diag fmy_stat_obd_lsh_down_2.err_info_stat.err_sym fmy_stat_dyn_vld_ls_up_2.ctr_abc fmy_stat_dyn_vld_ls_up_2.ctr_end_diag fmy_stat_dyn_vld_ls_up_2.err_info_stat.lv_err_mem fmy_stat_dyn_vld_ls_up_2.err_info_stat.lv_ready fmy_stat_dyn_vld_ls_up_2.err_info_stat.lv_end_diag fmy_stat_dyn_vld_ls_up_2.err_info_stat.lv_cdn_diag fmy_stat_dyn_vld_ls_up_2.err_info_stat.err_sym fmy_stat_puc_vld_ls_up_2.ctr_abc fmy_stat_puc_vld_ls_up_2.ctr_end_diag fmy_stat_puc_vld_ls_up_2.err_info_stat.lv_err_mem fmy_stat_puc_vld_ls_up_2.err_info_stat.lv_ready fmy_stat_puc_vld_ls_up_2.err_info_stat.lv_end_diag fmy_stat_puc_vld_ls_up_2.err_info_stat.lv_cdn_diag fmy_stat_puc_vld_ls_up_2.err_info_stat.err_sym fmy_stat_obd_vld_lsh_up_2.ctr_abc fmy_stat_obd_vld_lsh_up_2.ctr_end_diag fmy_stat_obd_vld_lsh_up_2.err_info_stat.lv_err_mem fmy_stat_obd_vld_lsh_up_2.err_info_stat.lv_ready fmy_stat_obd_vld_lsh_up_2.err_info_stat.lv_end_diag fmy_stat_obd_vld_lsh_up_2.err_info_stat.lv_cdn_diag fmy_stat_obd_vld_lsh_up_2.err_info_stat.err_sym fmy_stat_chk_ls_down_2.ctr_abc fmy_stat_chk_ls_down_2.ctr_end_diag fmy_stat_chk_ls_down_2.err_info_stat.lv_err_mem fmy_stat_chk_ls_down_2.err_info_stat.lv_ready fmy_stat_chk_ls_down_2.err_info_stat.lv_end_diag fmy_stat_chk_ls_down_2.err_info_stat.lv_cdn_diag fmy_stat_chk_ls_down_2.err_info_stat.err_sym fmy_stat_shift_afl_lsl_up_2.ctr_abc fmy_stat_shift_afl_lsl_up_2.ctr_end_diag fmy_stat_shift_afl_lsl_up_2.err_info_stat.lv_err_mem fmy_stat_shift_afl_lsl_up_2.err_info_stat.lv_ready fmy_stat_shift_afl_lsl_up_2.err_info_stat.lv_end_diag fmy_stat_shift_afl_lsl_up_2.err_info_stat.lv_cdn_diag fmy_stat_shift_afl_lsl_up_2.err_info_stat.err_sym fmy_stat_shift_afr_lsl_up_2.ctr_abc fmy_stat_shift_afr_lsl_up_2.ctr_end_diag fmy_stat_shift_afr_lsl_up_2.err_info_stat.lv_err_mem fmy_stat_shift_afr_lsl_up_2.err_info_stat.lv_ready fmy_stat_shift_afr_lsl_up_2.err_info_stat.lv_end_diag fmy_stat_shift_afr_lsl_up_2.err_info_stat.lv_cdn_diag fmy_stat_shift_afr_lsl_up_2.err_info_stat.err_sym fmy_stat_oc_lsl_up_2.ctr_abc fmy_stat_oc_lsl_up_2.ctr_end_diag fmy_stat_oc_lsl_up_2.err_info_stat.lv_err_mem fmy_stat_oc_lsl_up_2.err_info_stat.lv_ready fmy_stat_oc_lsl_up_2.err_info_stat.lv_end_diag fmy_stat_oc_lsl_up_2.err_info_stat.lv_cdn_diag fmy_stat_oc_lsl_up_2.err_info_stat.err_sym fmy_stat_delta_i_lam_2.ctr_abc fmy_stat_delta_i_lam_2.ctr_end_diag fmy_stat_delta_i_lam_2.err_info_stat.lv_err_mem /end OUT_MEASUREMENT
/end FUNCTION
/end MODULE
/end PROJECT
