ASAP2_VERSION 1 31
/begin PROJECT MS45 "BMW Motorsteuerung R6"
/begin HEADER "_default_HeaderComment" PROJECT_NO _56 /end HEADER
/begin MODULE _default_ModuleName "_default_ModuleLongIdentifier"
/begin MOD_COMMON "_default_ModCommonComment" DEPOSIT ABSOLUTE BYTE_ORDER MSB_FIRST ALIGNMENT_BYTE 1 ALIGNMENT_WORD 2 ALIGNMENT_LONG 4 ALIGNMENT_FLOAT32_IEEE 4 ALIGNMENT_FLOAT64_IEEE 8 /end MOD_COMMON
/begin AXIS_PTS ldp_tco__ip_n_max_iv_diag "" 0x0115d tco _REC_AXS_20_u1 190.5 _CNV_A_R_LINEAR_____12_CM 6 -48. 142.5 DISPLAY_IDENTIFIER LDP_TCO__IP_N_MAX_IV_DIAG FORMAT "%5.1" /end AXIS_PTS
/begin MEASUREMENT tco_dif "" SBYTE _CNV_A_R_LINEAR_____13_CM 1 100. -96. 95.25 DISPLAY_IDENTIFIER TCO_DIF ECU_ADDRESS 0x3fe3e0 FORMAT "%3.1" /end MEASUREMENT
/begin AXIS_PTS ldpm_n_32_28 "" 0x08028 n_32 _REC_AXS_20_u1 8160. _CNV_A_R_LINEAR_____16_CM 12 0. 8160. DISPLAY_IDENTIFIER LDPM_N_32_28 FORMAT "%4.0" /end AXIS_PTS
/begin AXIS_PTS ldpm_fac_tq_req_ect_1 "" 0x11672 fac_tq_req _REC_AXS_20_u2 1.99996948 _CNV_A_R_LINEAR_____21_CM 6 0. 1.99996948 DISPLAY_IDENTIFIER LDPM_FAC_TQ_REQ_ECT_1 FORMAT "%7.5" /end AXIS_PTS
/begin AXIS_PTS ldpm_gear_ef_1 "" 0x07f3e gear_ef _REC_AXS_20_u1 12. _CNV_A_R_LINEAR_____22_CM 13 0. 12. DISPLAY_IDENTIFIER LDPM_GEAR_EF_1 FORMAT "%3.0" /end AXIS_PTS
/begin AXIS_PTS ldpm_n_32__ef "" 0x01346 n_32 _REC_AXS_20_u1 8160. _CNV_A_R_LINEAR_____16_CM 5 0. 8160. DISPLAY_IDENTIFIER LDPM_N_32__EF FORMAT "%4.0" /end AXIS_PTS
/begin AXIS_PTS ldp_maf__thd_is_er_diag "" 0x00feb maf _REC_AXS_20_u1 1389. _CNV_A_R_LINEAR_____27_CM 4 0. 1389. DISPLAY_IDENTIFIER LDP_MAF__THD_IS_ER_DIAG FORMAT "%4.0" /end AXIS_PTS
/begin AXIS_PTS ldp_n__thd_is_er_diag "" 0x10f18 n _REC_AXS_20_u2 816. _CNV_A_R_LINEAR_____11_CM 4 0. 8160. DISPLAY_IDENTIFIER LDP_N__THD_IS_ER_DIAG FORMAT "%4.0" /end AXIS_PTS
/begin AXIS_PTS ldp_tco__fac_thd_is_er_diag "" 0x07d83 tco _REC_AXS_20_u1 190.5 _CNV_A_R_LINEAR_____12_CM 8 -48. 142.5 DISPLAY_IDENTIFIER LDP_TCO__FAC_THD_IS_ER_DIAG FORMAT "%5.1" /end AXIS_PTS
/begin AXIS_PTS ldpm_vs_wheel_grd_mmv_thd "" 0x082c6 vs _REC_AXS_20_u1 255. _CNV_A_R_LINEAR_____23_CM 9 0. 255. DISPLAY_IDENTIFIER LDPM_VS_WHEEL_GRD_MMV_THD FORMAT "%3.0" /end AXIS_PTS
/begin AXIS_PTS ldp_vb_sof "" 0x07edb vb _REC_AXS_20_u1 25.8984 _CNV_A_R_LINEAR_____34_CM 8 0. 25.8984 DISPLAY_IDENTIFIER LDP_VB_SOF FORMAT "%3.1" /end AXIS_PTS
/begin AXIS_PTS ldp_tia_sof "" 0x07e54 tia _REC_AXS_20_u1 190.5 _CNV_A_R_LINEAR_____12_CM 8 -48. 142.5 DISPLAY_IDENTIFIER LDP_TIA_SOF FORMAT "%5.1" /end AXIS_PTS
/begin AXIS_PTS ldpm_t_sof_act "" 0x11b36 t_sof_act _REC_AXS_20_u2 655.35 _CNV_A_R_LINEAR_____4_CM 15 0. 655.35 DISPLAY_IDENTIFIER LDPM_T_SOF_ACT FORMAT "%6.2" /end AXIS_PTS
/begin AXIS_PTS ldp_pv_av_sof_req_1 "" 0x01103 pv_av_sof_req _REC_AXS_20_u1 99.609375 _CNV_A_R_LINEAR_____10_CM 4 0. 99.609375 DISPLAY_IDENTIFIER LDP_PV_AV_SOF_REQ_1 FORMAT "%4.1" /end AXIS_PTS
/begin AXIS_PTS ldp_pv_av_sof_req_2 "" 0x01108 pv_av_sof_req _REC_AXS_20_u1 99.609375 _CNV_A_R_LINEAR_____10_CM 4 0. 99.609375 DISPLAY_IDENTIFIER LDP_PV_AV_SOF_REQ_2 FORMAT "%4.1" /end AXIS_PTS
/begin AXIS_PTS ldp_pv_av_sof_req_3 "" 0x0110d pv_av_sof_req _REC_AXS_20_u1 99.609375 _CNV_A_R_LINEAR_____10_CM 4 0. 99.609375 DISPLAY_IDENTIFIER LDP_PV_AV_SOF_REQ_3 FORMAT "%4.1" /end AXIS_PTS
/begin AXIS_PTS ldp_pv_av_sof_req_4 "" 0x01112 pv_av_sof_req _REC_AXS_20_u1 99.609375 _CNV_A_R_LINEAR_____10_CM 4 0. 99.609375 DISPLAY_IDENTIFIER LDP_PV_AV_SOF_REQ_4 FORMAT "%4.1" /end AXIS_PTS
/begin AXIS_PTS ldp_pv_av_sof_req_5 "" 0x01117 pv_av_sof_req _REC_AXS_20_u1 99.609375 _CNV_A_R_LINEAR_____10_CM 4 0. 99.609375 DISPLAY_IDENTIFIER LDP_PV_AV_SOF_REQ_5 FORMAT "%4.1" /end AXIS_PTS
/begin AXIS_PTS ldp_pv_av_sof_req_0 "" 0x010fe pv_av_sof_req _REC_AXS_20_u1 99.609375 _CNV_A_R_LINEAR_____10_CM 4 0. 99.609375 DISPLAY_IDENTIFIER LDP_PV_AV_SOF_REQ_0 FORMAT "%4.1" /end AXIS_PTS
/begin AXIS_PTS ldp_pv_av_sof_req_6 "" 0x0111c pv_av_sof_req _REC_AXS_20_u1 99.609375 _CNV_A_R_LINEAR_____10_CM 4 0. 99.609375 DISPLAY_IDENTIFIER LDP_PV_AV_SOF_REQ_6 FORMAT "%4.1" /end AXIS_PTS
/begin AXIS_PTS ldp_n_sof_req_1 "" 0x10fb2 n_sof_req _REC_AXS_20_u2 8160. _CNV_A_R_LINEAR_____11_CM 6 0. 8160. DISPLAY_IDENTIFIER LDP_N_SOF_REQ_1 FORMAT "%4.0" /end AXIS_PTS
/begin AXIS_PTS ldp_n_sof_req_2 "" 0x10fc0 n_sof_req _REC_AXS_20_u2 8160. _CNV_A_R_LINEAR_____11_CM 6 0. 8160. DISPLAY_IDENTIFIER LDP_N_SOF_REQ_2 FORMAT "%4.0" /end AXIS_PTS
/begin AXIS_PTS ldp_n_sof_req_3 "" 0x10fce n_sof_req _REC_AXS_20_u2 8160. _CNV_A_R_LINEAR_____11_CM 6 0. 8160. DISPLAY_IDENTIFIER LDP_N_SOF_REQ_3 FORMAT "%4.0" /end AXIS_PTS
/begin AXIS_PTS ldp_n_sof_req_4 "" 0x10fdc n_sof_req _REC_AXS_20_u2 8160. _CNV_A_R_LINEAR_____11_CM 6 0. 8160. DISPLAY_IDENTIFIER LDP_N_SOF_REQ_4 FORMAT "%4.0" /end AXIS_PTS
/begin AXIS_PTS ldp_n_sof_req_5 "" 0x10fea n_sof_req _REC_AXS_20_u2 8160. _CNV_A_R_LINEAR_____11_CM 6 0. 8160. DISPLAY_IDENTIFIER LDP_N_SOF_REQ_5 FORMAT "%4.0" /end AXIS_PTS
/begin AXIS_PTS ldp_n_sof_req_0 "" 0x10fa4 n_sof_req _REC_AXS_20_u2 8160. _CNV_A_R_LINEAR_____11_CM 6 0. 8160. DISPLAY_IDENTIFIER LDP_N_SOF_REQ_0 FORMAT "%4.0" /end AXIS_PTS
/begin AXIS_PTS ldp_n_sof_req_6 "" 0x10ff8 n_sof_req _REC_AXS_20_u2 8160. _CNV_A_R_LINEAR_____11_CM 6 0. 8160. DISPLAY_IDENTIFIER LDP_N_SOF_REQ_6 FORMAT "%4.0" /end AXIS_PTS
/begin AXIS_PTS ldpm_n_32__t_acc "" 0x01353 n_32 _REC_AXS_20_u1 8160. _CNV_A_R_LINEAR_____16_CM 3 0. 8160. DISPLAY_IDENTIFIER LDPM_N_32__T_ACC FORMAT "%4.0" /end AXIS_PTS
/begin AXIS_PTS ldp_vs__amp_raw_cor "" 0x07ef6 vs _REC_AXS_20_u1 255. _CNV_A_R_LINEAR_____23_CM 8 0. 255. DISPLAY_IDENTIFIER LDP_VS__AMP_RAW_COR FORMAT "%3.0" /end AXIS_PTS
/begin AXIS_PTS ldp_v_amp_1__amp_raw "" 0x1143a v_amp _REC_AXS_20_u2 4.99511719 _CNV_A_R_LINEAR_____3_CM 8 0. 4.99511719 DISPLAY_IDENTIFIER LDP_V_AMP_1__AMP_RAW FORMAT "%5.3" /end AXIS_PTS
/begin AXIS_PTS ldp_v_amp_2__amp_raw "" 0x1144c v_amp _REC_AXS_20_u2 4.99511719 _CNV_A_R_LINEAR_____3_CM 8 0. 4.99511719 DISPLAY_IDENTIFIER LDP_V_AMP_2__AMP_RAW FORMAT "%5.3" /end AXIS_PTS
/begin AXIS_PTS ldpm_n_2_3 "" 0x118c0 n _REC_AXS_20_u2 816. _CNV_A_R_LINEAR_____11_CM 16 0. 8160. DISPLAY_IDENTIFIER LDPM_N_2_3 FORMAT "%4.0" /end AXIS_PTS
/begin AXIS_PTS ldp_n_23 "" 0x0100a n_32 _REC_AXS_20_u1 816. _CNV_A_R_LINEAR_____16_CM 6 0. 8160. DISPLAY_IDENTIFIER LDP_N_23 FORMAT "%4.0" /end AXIS_PTS
/begin AXIS_PTS ldp_tps_av_id_tps_grd_bol_ae "" 0x1125e tps_av _REC_AXS_20_u2 11.95 _CNV_A_R_LINEAR_____53_CM 4 0. 119.5 DISPLAY_IDENTIFIER LDP_TPS_AV_ID_TPS_GRD_BOL_AE FORMAT "%7.3" /end AXIS_PTS
/begin AXIS_PTS ldp_toil__t_dly_poil_swi_can "" 0x0123b toil _REC_AXS_20_u1 200. _CNV_A_R_LINEAR_____15_CM 6 -40. 160. DISPLAY_IDENTIFIER LDP_TOIL__T_DLY_POIL_SWI_CAN FORMAT "%3.0" /end AXIS_PTS
/begin AXIS_PTS ldpm_cam_edge_nr_0__win_chk "" 0x012be cam_edge_nr_0 _REC_AXS_20_u1 3. _CNV_A_R_LINEAR_____1_CM 4 0. 3. DISPLAY_IDENTIFIER LDPM_CAM_EDGE_NR_0__WIN_CHK FORMAT "%2.0" /end AXIS_PTS
/begin AXIS_PTS ldpm_cam_edge_nr_1__win_chk "" 0x012c3 cam_edge_nr_1 _REC_AXS_20_u1 3. _CNV_A_R_LINEAR_____1_CM 4 0. 3. DISPLAY_IDENTIFIER LDPM_CAM_EDGE_NR_1__WIN_CHK FORMAT "%2.0" /end AXIS_PTS
/begin AXIS_PTS ldpm_ctr_km_can "" 0x115ce ctr_km_can _REC_AXS_20_u2 655340. _CNV_A_R_LINEAR_____88_CM 4 0. 655340. DISPLAY_IDENTIFIER LDPM_CTR_KM_CAN FORMAT "%6.0" /end AXIS_PTS
/begin AXIS_PTS ldp_vs_fil__tq_gs_inc_mon "" 0x1220e vs_fil _REC_AXS_20_u2 511.99218 _CNV_A_R_LINEAR_____85_CM 6 0. 511.99218 DISPLAY_IDENTIFIER LDP_VS_FIL__TQ_GS_INC_MON FORMAT "%7.3" /end AXIS_PTS
/begin AXIS_PTS ldp_n_32__tq_gs_inc_mon "" 0x12023 n_32 _REC_AXS_20_u1 8160. _CNV_A_R_LINEAR_____16_CM 6 0. 8160. DISPLAY_IDENTIFIER LDP_N_32__TQ_GS_INC_MON FORMAT "%4.0" /end AXIS_PTS
/begin AXIS_PTS ldpm_tco_2 "" 0x081ae tco _REC_AXS_20_u1 190.5 _CNV_A_R_LINEAR_____12_CM 8 -48. 142.5 DISPLAY_IDENTIFIER LDPM_TCO_2 FORMAT "%5.1" /end AXIS_PTS
/begin AXIS_PTS ldp_flow_cor_cps_ip_cppwm "" 0x10ac4 flow_cor_cps _REC_AXS_20_u2 7.99987793 _CNV_A_R_LINEAR_____111_CM 12 0. 7.99987793 DISPLAY_IDENTIFIER LDP_FLOW_COR_CPS_IP_CPPWM FORMAT "%7.4" /end AXIS_PTS
/begin AXIS_PTS ldpm_prs_cps_ip_cppwm "" 0x11a9a prs_cps _REC_AXS_20_u2 5434. _CNV_A_R_LINEAR_____114_CM 12 -2717. 2717. DISPLAY_IDENTIFIER LDPM_PRS_CPS_IP_CPPWM FORMAT "%7.2" /end AXIS_PTS
/begin AXIS_PTS ldp_amp_ip_fac_amp_cp "" 0x108a6 amp _REC_AXS_20_u2 5434. _CNV_A_R_LINEAR_____49_CM 6 0. 5434. DISPLAY_IDENTIFIER LDP_AMP_IP_FAC_AMP_CP FORMAT "%7.2" /end AXIS_PTS
/begin AXIS_PTS ldp_tia_thr_ip_fac_tia_cp "" 0x01223 tia _REC_AXS_20_u1 190.5 _CNV_A_R_LINEAR_____12_CM 6 -48. 142.5 DISPLAY_IDENTIFIER LDP_TIA_THR_IP_FAC_TIA_CP FORMAT "%5.1" /end AXIS_PTS
/begin AXIS_PTS ldp_cl_ip_rel_flow_fac_cp "" 0x1098c cl _REC_AXS_20_u2 1.999878 _CNV_A_R_LINEAR_____120_CM 6 0. 1.999878 DISPLAY_IDENTIFIER LDP_CL_IP_REL_FLOW_FAC_CP FORMAT "%6.4" /end AXIS_PTS
/begin AXIS_PTS ldpm_maf_ip_rel_flow_max_cps "" 0x07fcc maf _REC_AXS_20_u1 1389. _CNV_A_R_LINEAR_____27_CM 12 0. 1389. DISPLAY_IDENTIFIER LDPM_MAF_IP_REL_FLOW_MAX_CPS FORMAT "%4.0" /end AXIS_PTS
/begin AXIS_PTS ldpm_cl_mmv_ip_nr_step_cl "" 0x01ba6 maf _REC_AXS_20_u2 1.99996948 _CNV_A_R_LINEAR_____21_CM 3 0. 1.99996948 DISPLAY_IDENTIFIER LDPM_CL_MMV_IP_NR_STEP_CL FORMAT "%7.5" /end AXIS_PTS
/begin AXIS_PTS ldp_tco_ip_rel_fuel_max_cp_cor "" 0x01197 tco _REC_AXS_20_u1 190.5 _CNV_A_R_LINEAR_____12_CM 5 -48. 142.5 DISPLAY_IDENTIFIER LDP_TCO_IP_REL_FUEL_MAX_CP_COR FORMAT "%5.1" /end AXIS_PTS
/begin AXIS_PTS ldpm_vb_ip_cppwm_vb "" 0x082a7 vb _REC_AXS_20_u1 25.8984 _CNV_A_R_LINEAR_____34_CM 8 0. 25.8984 DISPLAY_IDENTIFIER LDPM_VB_IP_CPPWM_VB FORMAT "%3.1" /end AXIS_PTS
/begin AXIS_PTS ldp_cppwm_ref_ip_cppwm_cor_frq "" 0x07ad7 cppwm_ref _REC_AXS_20_u1 99.609375 _CNV_A_R_LINEAR_____10_CM 8 0. 99.609375 DISPLAY_IDENTIFIER LDP_CPPWM_REF_IP_CPPWM_COR_FRQ FORMAT "%5.1" /end AXIS_PTS
/begin AXIS_PTS ldp_cl_mmv_ip_t_max_cp "" 0x109a8 cl_mmv _REC_AXS_20_u2 1.99996948 _CNV_A_R_LINEAR_____21_CM 6 0. 1.99996948 DISPLAY_IDENTIFIER LDP_CL_MMV_IP_T_MAX_CP FORMAT "%6.4" /end AXIS_PTS
/begin MEASUREMENT state_mff_ad_1_act "State of fixed adaptation phases" UBYTE _CNV_S_6_RANGE_STAT_132_CM 1 100. 0. 5. DISPLAY_IDENTIFIER STATE_MFF_AD_1_ACT ECU_ADDRESS 0x3fdeb1 /end MEASUREMENT
/begin AXIS_PTS ldpm_t_ctl_cru_1 "" 0x013a2 t_ctl_cru _REC_AXS_20_u1 2.55 _CNV_A_R_LINEAR_____24_CM 5 0. 25.5 DISPLAY_IDENTIFIER LDPM_T_CTL_CRU_1 FORMAT "%4.1" /end AXIS_PTS
/begin AXIS_PTS ldp_vs_dif_cru__fac_prop_cru "" 0x11524 vs_dif_cru _REC_AXS_20_u2 511.9921875 _CNV_A_R_LINEAR_____148_CM 4 -256. 255.9921875 DISPLAY_IDENTIFIER LDP_VS_DIF_CRU__FAC_PROP_CRU FORMAT "%7.3" /end AXIS_PTS
/begin AXIS_PTS ldpm_vs_sp_dif_cru_1 "" 0x11d12 vs_sp_dif_cru _REC_AXS_20_u2 511.9921875 _CNV_A_R_LINEAR_____148_CM 5 -256. 255.9921875 DISPLAY_IDENTIFIER LDPM_VS_SP_DIF_CRU_1 FORMAT "%7.3" /end AXIS_PTS
/begin AXIS_PTS ldpm_n_21 "" 0x0130b n_32 _REC_AXS_20_u1 8160. _CNV_A_R_LINEAR_____16_CM 3 0. 8160. DISPLAY_IDENTIFIER LDPM_N_21 FORMAT "%4.0" /end AXIS_PTS
/begin AXIS_PTS ldpm_vs_sp_cru_1 "" 0x11d06 vs_sp_cru _REC_AXS_20_u2 511.99218 _CNV_A_R_LINEAR_____85_CM 5 0. 511.99218 DISPLAY_IDENTIFIER LDPM_VS_SP_CRU_1 FORMAT "%7.3" /end AXIS_PTS
/begin AXIS_PTS ldpm_ac_cru__fac_tq_cru "" 0x1154a ac_cru _REC_AXS_20_u2 31.43952 _CNV_A_R_LINEAR_____152_CM 6 -15.72 15.71952 DISPLAY_IDENTIFIER LDPM_AC_CRU__FAC_TQ_CRU FORMAT "%8.4" /end AXIS_PTS
/begin AXIS_PTS ldpm_gear__fac_tq_cru "" 0x07f23 gear _REC_AXS_20_u1 255. _CNV_A_R_LINEAR_____1_CM 12 0. 255. DISPLAY_IDENTIFIER LDPM_GEAR__FAC_TQ_CRU FORMAT "%3.0" /end AXIS_PTS
/begin AXIS_PTS ldp_n_32__fac_tq_cru "" 0x01024 n_32 _REC_AXS_20_u1 816. _CNV_A_R_LINEAR_____16_CM 5 0. 8160. DISPLAY_IDENTIFIER LDP_N_32__FAC_TQ_CRU FORMAT "%4.0" /end AXIS_PTS
/begin AXIS_PTS ldpm_fac_tq_cru_1 "" 0x01bae fac_tq_cru _REC_AXS_20_u2 99.99847412 _CNV_A_R_LINEAR_____9_CM 3 0. 99.99847412 DISPLAY_IDENTIFIER LDPM_FAC_TQ_CRU_1 /end AXIS_PTS
/begin AXIS_PTS ldp_n_32__fac_tq_req_clu_is "" 0x0102a n_32 _REC_AXS_20_u1 8160. _CNV_A_R_LINEAR_____16_CM 3 0. 8160. DISPLAY_IDENTIFIER LDP_N_32__FAC_TQ_REQ_CLU_IS FORMAT "%4.0" /end AXIS_PTS
/begin AXIS_PTS ldp_vls_cyc_ratio_mv_1_ip_fac "" 0x01278 cyl_ad_struct[0].vls_cyc_ratio_mv _REC_AXS_20_u1 1.984375 _CNV_A_R_LINEAR_____157_CM 6 0. 1.984375 DISPLAY_IDENTIFIER LDP_VLS_CYC_RATIO_MV_1_IP_FAC FORMAT "%4.2" /end AXIS_PTS
/begin AXIS_PTS ldp_vls_cyc_ratio_mv_2_ip_fac "" 0x0127f cyl_ad_struct[1].vls_cyc_ratio_mv _REC_AXS_20_u1 1.984375 _CNV_A_R_LINEAR_____157_CM 6 0. 1.984375 DISPLAY_IDENTIFIER LDP_VLS_CYC_RATIO_MV_2_IP_FAC FORMAT "%4.2" /end AXIS_PTS
/begin AXIS_PTS ldp_maf_kgh_ip_fac_maf_1_cyl "" 0x10d4a maf_kgh _REC_AXS_20_u2 2047.96875 _CNV_A_R_LINEAR_____113_CM 6 0. 2047.96875 DISPLAY_IDENTIFIER LDP_MAF_KGH_IP_FAC_MAF_1_CYL FORMAT "%7.2" /end AXIS_PTS
/begin AXIS_PTS ldp_maf_kgh_ip_fac_maf_2_cyl "" 0x10d58 maf_kgh _REC_AXS_20_u2 2047.96875 _CNV_A_R_LINEAR_____113_CM 6 0. 2047.96875 DISPLAY_IDENTIFIER LDP_MAF_KGH_IP_FAC_MAF_2_CYL FORMAT "%7.2" /end AXIS_PTS
/begin AXIS_PTS ldpm_n_1_cybl "" 0x1189c n _REC_AXS_20_u2 8160. _CNV_A_R_LINEAR_____11_CM 8 0. 8160. DISPLAY_IDENTIFIER LDPM_N_1_CYBL FORMAT "%4.0" /end AXIS_PTS
/begin AXIS_PTS ldpm_n_2_cybl "" 0x118e2 n _REC_AXS_20_u2 8160. _CNV_A_R_LINEAR_____11_CM 6 0. 8160. DISPLAY_IDENTIFIER LDPM_N_2_CYBL FORMAT "%4.0" /end AXIS_PTS
/begin AXIS_PTS ldp_maf_ip_dly_cyl_lam "" 0x10c76 maf _REC_AXS_20_u2 1389. _CNV_A_R_LINEAR_____106_CM 8 0. 1389. DISPLAY_IDENTIFIER LDP_MAF_IP_DLY_CYL_LAM FORMAT "%7.2" /end AXIS_PTS
/begin AXIS_PTS ldp_maf_ip_vls_dif_val "" 0x10cb2 maf _REC_AXS_20_u2 1389. _CNV_A_R_LINEAR_____106_CM 8 0. 1389. DISPLAY_IDENTIFIER LDP_MAF_IP_VLS_DIF_VAL FORMAT "%7.2" /end AXIS_PTS
/begin AXIS_PTS ldp_vls_dif_val_ip_ti_ad_cyl "" 0x114f2 online_dummy _REC_AXS_20_u2 1.275 _CNV_A_R_LINEAR_____163_CM 8 -0.6375 0.6375 DISPLAY_IDENTIFIER LDP_VLS_DIF_VAL_IP_TI_AD_CYL FORMAT "%7.5" /end AXIS_PTS
/begin AXIS_PTS ldp_vls_dif_val_ip_ti_cyl "" 0x11504 online_dummy _REC_AXS_20_u2 1.275 _CNV_A_R_LINEAR_____163_CM 6 -0.6375 0.6375 DISPLAY_IDENTIFIER LDP_VLS_DIF_VAL_IP_TI_CYL FORMAT "%7.5" /end AXIS_PTS
/begin AXIS_PTS ldp_lamb_sp_ip_fac_vls_dif_lamb "" 0x10b7e lamb_sp _REC_AXS_20_u2 31.99902344 _CNV_A_R_LINEAR_____164_CM 4 0. 31.99902344 DISPLAY_IDENTIFIER LDP_LAMB_SP_IP_FAC_VLS_DIF_LAMB FORMAT "%7.4" /end AXIS_PTS
/begin AXIS_PTS ldp_maf_kgh__crlc_vls_down "" 0x10cc4 maf_kgh _REC_AXS_20_u2 2047.96875 _CNV_A_R_LINEAR_____113_CM 6 0. 2047.96875 DISPLAY_IDENTIFIER LDP_MAF_KGH__CRLC_VLS_DOWN FORMAT "%6.2" /end AXIS_PTS
/begin AXIS_PTS ldp_ftl__t_cur_dmtl_stat "" 0x07ae9 ftl _REC_AXS_20_u1 126. _CNV_A_R_LINEAR_____96_CM 8 0. 126. DISPLAY_IDENTIFIER LDP_FTL__T_CUR_DMTL_STAT FORMAT "%3.0" /end AXIS_PTS
/begin AXIS_PTS ldp_ftl__t_small_leak_test "" 0x00fc9 ftl _REC_AXS_20_u1 126. _CNV_A_R_LINEAR_____96_CM 5 0. 126. DISPLAY_IDENTIFIER LDP_FTL__T_SMALL_LEAK_TEST FORMAT "%3.0" /end AXIS_PTS
/begin AXIS_PTS ldp_vb_dmtl_fil__fac_cur_dmtl "" 0x114c4 vb_dmtl_fil _REC_AXS_20_u2 26. _CNV_A_R_LINEAR_____172_CM 6 0. 26. DISPLAY_IDENTIFIER LDP_VB_DMTL_FIL__FAC_CUR_DMTL FORMAT "%7.4" /end AXIS_PTS
/begin AXIS_PTS ldpm_cur_dmtldifrefroughleak_1 "" 0x115f6 cur_dmtl_dif_ref_rough_leak _REC_AXS_20_u2 400. _CNV_A_R_LINEAR_____167_CM 8 0. 400. DISPLAY_IDENTIFIER LDPM_CUR_DMTLDIFREFROUGHLEAK_1 FORMAT "%7.3" /end AXIS_PTS
/begin AXIS_PTS ldp_ftl__t_rough_leak_test "" 0x00fc3 ftl _REC_AXS_20_u1 126. _CNV_A_R_LINEAR_____96_CM 5 0. 126. DISPLAY_IDENTIFIER LDP_FTL__T_ROUGH_LEAK_TEST FORMAT "%3.0" /end AXIS_PTS
/begin AXIS_PTS ldp_n_ecf__n_ecf_min_accin "" 0x07cdc n_ecf _REC_AXS_20_u1 15. _CNV_A_R_LINEAR_____1_CM 16 0. 15. DISPLAY_IDENTIFIER LDP_N_ECF__N_ECF_MIN_ACCIN FORMAT "%2.0" /end AXIS_PTS
/begin AXIS_PTS ldp_tco__temp_sub_ecf_ini "" 0x0117e tco _REC_AXS_20_u1 190.5 _CNV_A_R_LINEAR_____12_CM 6 -48. 142.5 DISPLAY_IDENTIFIER LDP_TCO__TEMP_SUB_ECF_INI FORMAT "%5.1" /end AXIS_PTS
/begin AXIS_PTS ldp_n_ecf_cor_fil__n_perc_ecf "" 0x010c0 n_ecf_cor_fil _REC_AXS_20_u1 15.9375 _CNV_A_R_LINEAR_____46_CM 6 0. 15.9375 DISPLAY_IDENTIFIER LDP_N_ECF_COR_FIL__N_PERC_ECF FORMAT "%5.2" /end AXIS_PTS
/begin AXIS_PTS ldp_tco_ex__n_ecf "" 0x01190 tco_ex _REC_AXS_20_u1 190.5 _CNV_A_R_LINEAR_____12_CM 6 -48. 142.5 DISPLAY_IDENTIFIER LDP_TCO_EX__N_ECF FORMAT "%5.1" /end AXIS_PTS
/begin AXIS_PTS ldp_tam__temp_sub_ecf_ini "" 0x01136 tam _REC_AXS_20_u1 190.5 _CNV_A_R_LINEAR_____12_CM 6 -48. 142.5 DISPLAY_IDENTIFIER LDP_TAM__TEMP_SUB_ECF_INI FORMAT "%5.1" /end AXIS_PTS
/begin AXIS_PTS ldpm_temp_mmv_sub_cat_ecf_1 "" 0x01407 temp_mmv_sub_cat_ecf _REC_AXS_20_u1 1020. _CNV_A_R_LINEAR_____177_CM 6 -33. 987. DISPLAY_IDENTIFIER LDPM_TEMP_MMV_SUB_CAT_ECF_1 FORMAT "%3.0" /end AXIS_PTS
/begin AXIS_PTS ldp_vs__n_ecf_vs_cor "" 0x0128d vs _REC_AXS_20_u1 255. _CNV_A_R_LINEAR_____23_CM 5 0. 255. DISPLAY_IDENTIFIER LDP_VS__N_ECF_VS_COR FORMAT "%3.0" /end AXIS_PTS
/begin AXIS_PTS ldp_temp_gb__n_ecf_temp_gb "" 0x011db temp_gb _REC_AXS_20_u1 255. _CNV_A_R_LINEAR_____15_CM 6 -40. 215. DISPLAY_IDENTIFIER LDP_TEMP_GB__N_ECF_TEMP_GB FORMAT "%3.0" /end AXIS_PTS
/begin AXIS_PTS ldp_tco__t_tooth_max "" 0x01177 tco _REC_AXS_20_u1 190.5 _CNV_A_R_LINEAR_____12_CM 6 -48. 142.5 DISPLAY_IDENTIFIER LDP_TCO__T_TOOTH_MAX FORMAT "%5.1" /end AXIS_PTS
/begin AXIS_PTS ldp_vb__t_tooth_max "" 0x01265 tco _REC_AXS_20_u1 26. _CNV_A_R_LINEAR_____60_CM 6 0. 26. DISPLAY_IDENTIFIER LDP_VB__T_TOOTH_MAX FORMAT "%4.1" /end AXIS_PTS
/begin AXIS_PTS ldp_n_32_vff_efp "" 0x07cac n_32 _REC_AXS_20_u1 8160. _CNV_A_R_LINEAR_____16_CM 8 0. 8160. DISPLAY_IDENTIFIER LDP_N_32_VFF_EFP FORMAT "%4.0" /end AXIS_PTS
/begin AXIS_PTS ldp_tco_t_efp_ast_max "" 0x011bc tco _REC_AXS_20_u1 190.5 _CNV_A_R_LINEAR_____12_CM 6 -48. 142.5 DISPLAY_IDENTIFIER LDP_TCO_T_EFP_AST_MAX FORMAT "%5.1" /end AXIS_PTS
/begin AXIS_PTS ldp_ftl_vff_vepu_ftl "" 0x00fd6 ftl _REC_AXS_20_u1 127. _CNV_A_R_LINEAR_____96_CM 6 0. 127. DISPLAY_IDENTIFIER LDP_FTL_VFF_VEPU_FTL FORMAT "%3.0" /end AXIS_PTS
/begin AXIS_PTS ldp_ftl_dif_vff_vepu_ftl_dif "" 0x00fcf ftl_dif _REC_AXS_20_u1 127. _CNV_A_R_LINEAR_____96_CM 6 0. 127. DISPLAY_IDENTIFIER LDP_FTL_DIF_VFF_VEPU_FTL_DIF FORMAT "%3.0" /end AXIS_PTS
/begin MEASUREMENT cycnr_puc "" UWORD _CNV_A_R_LINEAR_____1_CM 1 100. 0. 65535. DISPLAY_IDENTIFIER CYCNR_PUC ECU_ADDRESS 0x3fd432 BYTE_ORDER MSB_LAST FORMAT "%5.0" /end MEASUREMENT
/begin MEASUREMENT n_hys_puc "" UBYTE _CNV_A_R_LINEAR_____16_CM 1 100. 0. 8160. DISPLAY_IDENTIFIER N_HYS_PUC ECU_ADDRESS 0x3fe267 FORMAT "%4.0" /end MEASUREMENT
/begin MEASUREMENT n_min_puc "" UBYTE _CNV_A_R_LINEAR_____16_CM 1 100. 0. 8160. DISPLAY_IDENTIFIER N_MIN_PUC ECU_ADDRESS 0x3fe266 FORMAT "%4.0" /end MEASUREMENT
/begin AXIS_PTS ldpm_tco_1_6 "" 0x013b3 tco _REC_AXS_20_u1 28.575 _CNV_A_R_LINEAR_____12_CM 6 -48. 142.5 DISPLAY_IDENTIFIER LDPM_TCO_1_6 FORMAT "%5.1" /end AXIS_PTS
/begin AXIS_PTS ldpm_gr_mt_3 "" 0x07f7f gr_mt _REC_AXS_20_u1 255. _CNV_A_R_LINEAR_____1_CM 13 0. 255. DISPLAY_IDENTIFIER LDPM_GR_MT_3 FORMAT "%3.0" /end AXIS_PTS
/begin AXIS_PTS ldpm_gr_at_3 "" 0x07f5a gr_at _REC_AXS_20_u1 255. _CNV_A_R_LINEAR_____1_CM 13 0. 255. DISPLAY_IDENTIFIER LDPM_GR_AT_3 FORMAT "%3.0" /end AXIS_PTS
/begin AXIS_PTS ldp_tq_loss_ars_sp_can__puc "" 0x1133e tq_loss_ars_sp_can _REC_AXS_20_u2 2047.96875 _CNV_A_R_LINEAR_____186_CM 6 -1024. 1023.96875 DISPLAY_IDENTIFIER LDP_TQ_LOSS_ARS_SP_CAN__PUC FORMAT "%6.2" /end AXIS_PTS
/begin AXIS_PTS ldpm_tco_9 "" 0x081b7 tco _REC_AXS_20_u1 28.575 _CNV_A_R_LINEAR_____12_CM 9 -48. 142.5 DISPLAY_IDENTIFIER LDPM_TCO_9 FORMAT "%5.1" /end AXIS_PTS
/begin AXIS_PTS ldp_n__t_min_pu "" 0x10f06 n _REC_AXS_20_u2 8159. _CNV_A_R_LINEAR_____11_CM 8 1. 8160. DISPLAY_IDENTIFIER LDP_N__T_MIN_PU FORMAT "%4.0" /end AXIS_PTS
/begin AXIS_PTS ldp_tco__t_min_pu "" 0x01170 tco _REC_AXS_20_u1 190.5 _CNV_A_R_LINEAR_____12_CM 6 -48. 142.5 DISPLAY_IDENTIFIER LDP_TCO__T_MIN_PU FORMAT "%5.1" /end AXIS_PTS
/begin AXIS_PTS ldp_n_grd_n_dif_max_is "" 0x010c7 n_grd _REC_AXS_20_u1 8160. _CNV_A_R_LINEAR_____54_CM 6 -4096. 4064. DISPLAY_IDENTIFIER LDP_N_GRD_N_DIF_MAX_IS FORMAT "%5.0" /end AXIS_PTS
/begin AXIS_PTS ldp_amp_ip_load_clc_amp "" 0x108de amp _REC_AXS_20_u2 5434. _CNV_A_R_LINEAR_____49_CM 6 0. 5434. DISPLAY_IDENTIFIER LDP_AMP_IP_LOAD_CLC_AMP FORMAT "%7.2" /end AXIS_PTS
/begin AXIS_PTS ldp_n_32_ip_load_clc "" 0x07c91 n_32 _REC_AXS_20_u1 8160. _CNV_A_R_LINEAR_____16_CM 8 0. 8160. DISPLAY_IDENTIFIER LDP_N_32_IP_LOAD_CLC FORMAT "%4.0" /end AXIS_PTS
/begin AXIS_PTS ldp_maf_ip_load_clc "" 0x10ca0 maf _REC_AXS_20_u2 1389. _CNV_A_R_LINEAR_____106_CM 8 0. 1389. DISPLAY_IDENTIFIER LDP_MAF_IP_LOAD_CLC FORMAT "%7.2" /end AXIS_PTS
/begin AXIS_PTS ldp_n_vs_ratio_gr_mt "" 0x07d23 n_vs_ratio _REC_AXS_20_u1 255. _CNV_A_R_LINEAR_____1_CM 13 0. 255. DISPLAY_IDENTIFIER LDP_N_VS_RATIO_GR_MT FORMAT "%3.0" /end AXIS_PTS
/begin AXIS_PTS ldp_iga_dif_eff_iga "" 0x07b4d iga_dif_min _REC_AXS_20_u1 -95.625 _CNV_A_R_LINEAR_____204_CM 16 0. -95.625 DISPLAY_IDENTIFIER LDP_IGA_DIF_EFF_IGA FORMAT "%5.1" /end AXIS_PTS
/begin AXIS_PTS ldpm_tco_1_igsp "" 0x0819c tco _REC_AXS_20_u1 190.5 _CNV_A_R_LINEAR_____12_CM 8 -48. 142.5 DISPLAY_IDENTIFIER LDPM_TCO_1_IGSP FORMAT "%5.1" /end AXIS_PTS
/begin AXIS_PTS ldp_lamb_sp__iga_bas_lamb "" 0x10b5a lamb_sp _REC_AXS_20_u2 31.99902344 _CNV_A_R_LINEAR_____164_CM 8 0. 31.99902344 DISPLAY_IDENTIFIER LDP_LAMB_SP__IGA_BAS_LAMB FORMAT "%7.4" /end AXIS_PTS
/begin AXIS_PTS ldpm_n_14 "" 0x11872 n _REC_AXS_20_u2 8160. _CNV_A_R_LINEAR_____11_CM 20 0. 8160. DISPLAY_IDENTIFIER LDPM_N_14 FORMAT "%4.0" /end AXIS_PTS
/begin AXIS_PTS ldpm_maf_2 "" 0x116e0 maf _REC_AXS_20_u2 69.45 _CNV_A_R_LINEAR_____106_CM 16 0. 1389. DISPLAY_IDENTIFIER LDPM_MAF_2 FORMAT "%7.2" /end AXIS_PTS
/begin AXIS_PTS ldp_tco__fac_iga_ch_tco "" 0x07d7a tco _REC_AXS_20_u1 190.5 _CNV_A_R_LINEAR_____12_CM 8 -48. 142.5 DISPLAY_IDENTIFIER LDP_TCO__FAC_IGA_CH_TCO FORMAT "%6.2" /end AXIS_PTS
/begin AXIS_PTS ldpm_n_32_1_iga "" 0x0800d n_32 _REC_AXS_20_u1 8160. _CNV_A_R_LINEAR_____16_CM 8 0. 8160. DISPLAY_IDENTIFIER LDPM_N_32_1_IGA FORMAT "%4.0" /end AXIS_PTS
/begin AXIS_PTS ldpm_t_ast_1_iga "" 0x11adc t_ast _REC_AXS_20_u2 6553.5 _CNV_A_R_LINEAR_____24_CM 8 0. 6553.5 DISPLAY_IDENTIFIER LDPM_T_AST_1_IGA FORMAT "%6.1" /end AXIS_PTS
/begin AXIS_PTS ldpm_tco_st_1_iga "" 0x0822f tco_st _REC_AXS_20_u1 190.5 _CNV_A_R_LINEAR_____12_CM 8 -48. 142.5 DISPLAY_IDENTIFIER LDPM_TCO_ST_1_IGA FORMAT "%5.1" /end AXIS_PTS
/begin AXIS_PTS ldp_fac_tq_req_clu__crlc_tq_add "" 0x10aba fac_tq_req_clu _REC_AXS_20_u2 1.99996948 _CNV_A_R_LINEAR_____21_CM 4 0. 1.99996948 DISPLAY_IDENTIFIER LDP_FAC_TQ_REQ_CLU__CRLC_TQ_ADD FORMAT "%7.5" /end AXIS_PTS
/begin AXIS_PTS ldpm_n_32_2_iga "" 0x08035 n_32 _REC_AXS_20_u1 8160. _CNV_A_R_LINEAR_____16_CM 8 0. 8160. DISPLAY_IDENTIFIER LDPM_N_32_2_IGA FORMAT "%4.0" /end AXIS_PTS
/begin AXIS_PTS ldpm_maf_hb_1_iga "" 0x07f9f maf _REC_AXS_20_u1 1389. _CNV_A_R_LINEAR_____27_CM 8 0. 1389. DISPLAY_IDENTIFIER LDPM_MAF_HB_1_IGA FORMAT "%4.0" /end AXIS_PTS
/begin AXIS_PTS ldp_tco__iga_bas_temp_cor "" 0x0114a tco _REC_AXS_20_u1 190.5 _CNV_A_R_LINEAR_____12_CM 6 -48. 142.5 DISPLAY_IDENTIFIER LDP_TCO__IGA_BAS_TEMP_COR FORMAT "%5.1" /end AXIS_PTS
/begin AXIS_PTS ldp_tia__iga_bas_temp_cor "" 0x011ec tia _REC_AXS_20_u1 28.575 _CNV_A_R_LINEAR_____12_CM 6 -48. 142.5 DISPLAY_IDENTIFIER LDP_TIA__IGA_BAS_TEMP_COR FORMAT "%5.1" /end AXIS_PTS
/begin AXIS_PTS ldpm_n_32_fac_iga_pos_neg "" 0x080cc n_32 _REC_AXS_20_u1 8160. _CNV_A_R_LINEAR_____16_CM 8 0. 8160. DISPLAY_IDENTIFIER LDPM_N_32_FAC_IGA_POS_NEG FORMAT "%4.0" /end AXIS_PTS
/begin AXIS_PTS ldp_maf_fac_iga_pos_neg "" 0x00ff7 maf _REC_AXS_20_u1 1389. _CNV_A_R_LINEAR_____27_CM 6 0. 1389. DISPLAY_IDENTIFIER LDP_MAF_FAC_IGA_POS_NEG FORMAT "%4.0" /end AXIS_PTS
/begin AXIS_PTS ldpm_cyc_cast_ip_iga_dif_min "" 0x11608 cyc_cast _REC_AXS_20_u2 65535. _CNV_A_R_LINEAR_____1_CM 8 0. 65535. DISPLAY_IDENTIFIER LDPM_CYC_CAST_IP_IGA_DIF_MIN FORMAT "%5.0" /end AXIS_PTS
/begin AXIS_PTS ldpm_n_32_2_igsp "" 0x0803e n_32 _REC_AXS_20_u1 8160. _CNV_A_R_LINEAR_____16_CM 8 0. 8160. DISPLAY_IDENTIFIER LDPM_N_32_2_IGSP FORMAT "%4.0" /end AXIS_PTS
/begin AXIS_PTS ldpm_maf_hb_2_igsp "" 0x012f8 maf _REC_AXS_20_u1 1389. _CNV_A_R_LINEAR_____27_CM 6 0. 1389. DISPLAY_IDENTIFIER LDPM_MAF_HB_2_IGSP FORMAT "%4.0" /end AXIS_PTS
/begin AXIS_PTS ldp_amp_ip_iga_dif_min_cyc_amp "" 0x108c2 amp _REC_AXS_20_u2 5434. _CNV_A_R_LINEAR_____49_CM 6 0. 5434. DISPLAY_IDENTIFIER LDP_AMP_IP_IGA_DIF_MIN_CYC_AMP FORMAT "%7.2" /end AXIS_PTS
/begin AXIS_PTS ldpm_n_dif_igsp "" 0x11992 n_dif _REC_AXS_20_u2 65535. _CNV_A_R_LINEAR_____206_CM 8 -32768. 32767. DISPLAY_IDENTIFIER LDPM_N_DIF_IGSP FORMAT "%6.0" /end AXIS_PTS
/begin AXIS_PTS ldpm_vb__td "" 0x11c8c vb _REC_AXS_20_u2 28.7055 _CNV_A_R_LINEAR_____207_CM 8 0. 28.7055 DISPLAY_IDENTIFIER LDPM_VB__TD FORMAT "%5.2" /end AXIS_PTS
/begin AXIS_PTS ldp_lamb_sp_iga_ref_lamb "" 0x10b6c lamb_sp _REC_AXS_20_u2 31.99902344 _CNV_A_R_LINEAR_____164_CM 8 0. 31.99902344 DISPLAY_IDENTIFIER LDP_LAMB_SP_IGA_REF_LAMB FORMAT "%7.4" /end AXIS_PTS
/begin AXIS_PTS ldp_n_iga_ref_temp "" 0x07cf6 n_32 _REC_AXS_20_u1 8160. _CNV_A_R_LINEAR_____16_CM 8 0. 8160. DISPLAY_IDENTIFIER LDP_N_IGA_REF_TEMP FORMAT "%4.0" /end AXIS_PTS
/begin AXIS_PTS ldp_maf_iga_ref_temp "" 0x01003 maf _REC_AXS_20_u1 1389. _CNV_A_R_LINEAR_____27_CM 6 0. 1389. DISPLAY_IDENTIFIER LDP_MAF_IGA_REF_TEMP FORMAT "%4.0" /end AXIS_PTS
/begin AXIS_PTS ldp_tia__iga_ref_temp_fac "" 0x011f3 tia _REC_AXS_20_u1 190.5 _CNV_A_R_LINEAR_____12_CM 6 -48. 142.5 DISPLAY_IDENTIFIER LDP_TIA__IGA_REF_TEMP_FAC FORMAT "%5.1" /end AXIS_PTS
/begin AXIS_PTS ldp_n__iga_ref_vvt "" 0x07cb5 n_32 _REC_AXS_20_u1 8160. _CNV_A_R_LINEAR_____16_CM 16 0. 8160. DISPLAY_IDENTIFIER LDP_N__IGA_REF_VVT FORMAT "%4.0" /end AXIS_PTS
/begin AXIS_PTS ldp_tco__iga_ref_temp_fac "" 0x01151 tco _REC_AXS_20_u1 190.5 _CNV_A_R_LINEAR_____12_CM 6 -48. 142.5 DISPLAY_IDENTIFIER LDP_TCO__IGA_REF_TEMP_FAC FORMAT "%5.1" /end AXIS_PTS
/begin AXIS_PTS ldp_maf__iga_ref_vvt "" 0x07b67 maf _REC_AXS_20_u1 1389. _CNV_A_R_LINEAR_____27_CM 12 0. 1389. DISPLAY_IDENTIFIER LDP_MAF__IGA_REF_VVT FORMAT "%4.0" /end AXIS_PTS
/begin AXIS_PTS ldp_egr_ratio_cor__iga_ref_egr "" 0x10a70 egr_ratio_cor _REC_AXS_20_u2 99.99847412 _CNV_A_R_LINEAR_____9_CM 6 0. 99.99847412 DISPLAY_IDENTIFIER LDP_EGR_RATIO_COR__IGA_REF_EGR /end AXIS_PTS
/begin AXIS_PTS ldp_maf__iga_ref_port "" 0x10b88 maf _REC_AXS_20_u2 1389. _CNV_A_R_LINEAR_____106_CM 8 0. 1389. DISPLAY_IDENTIFIER LDP_MAF__IGA_REF_PORT FORMAT "%7.2" /end AXIS_PTS
/begin AXIS_PTS ldp_n_32__iga_bas_port "" 0x07be8 n_32 _REC_AXS_20_u1 8160. _CNV_A_R_LINEAR_____16_CM 8 0. 8160. DISPLAY_IDENTIFIER LDP_N_32__IGA_BAS_PORT FORMAT "%4.0" /end AXIS_PTS
/begin AXIS_PTS ldp_port_av__fac_iga_bas_port "" 0x11060 port_av _REC_AXS_20_u2 99.99847412 _CNV_A_R_LINEAR_____209_CM 8 0. 99.99847412 DISPLAY_IDENTIFIER LDP_PORT_AV__FAC_IGA_BAS_PORT /end AXIS_PTS
/begin AXIS_PTS ldp_eff_iga_sp_iga_dif_sp "" 0x10a10 eff_iga_sp _REC_AXS_20_u2 1.99996948 _CNV_A_R_LINEAR_____21_CM 16 0. 1.99996948 DISPLAY_IDENTIFIER LDP_EFF_IGA_SP_IGA_DIF_SP FORMAT "%7.5" /end AXIS_PTS
/begin AXIS_PTS ldp_cyc_st_ip_iga_st_cyc_st_cor "" 0x00fa7 cycnr_st _REC_AXS_20_u1 255. _CNV_A_R_LINEAR_____1_CM 6 0. 255. DISPLAY_IDENTIFIER LDP_CYC_ST_IP_IGA_ST_CYC_ST_COR FORMAT "%3.0" /end AXIS_PTS
/begin AXIS_PTS ldp_n_ip_iga_st_bas "" 0x10f76 n _REC_AXS_20_u2 8160. _CNV_A_R_LINEAR_____11_CM 6 0. 8160. DISPLAY_IDENTIFIER LDP_N_IP_IGA_ST_BAS FORMAT "%4.0" /end AXIS_PTS
/begin AXIS_PTS ldp_amp_ip_iga_st_amp_cor "" 0x108d0 amp _REC_AXS_20_u2 5434. _CNV_A_R_LINEAR_____49_CM 6 0. 5434. DISPLAY_IDENTIFIER LDP_AMP_IP_IGA_ST_AMP_COR FORMAT "%7.2" /end AXIS_PTS
/begin AXIS_PTS ldp_teg_dyn_hys "" 0x111ba teg_dyn_hys _REC_AXS_20_u2 2047. _CNV_A_R_LINEAR_____7_CM 16 0. 2047. DISPLAY_IDENTIFIER LDP_TEG_DYN_HYS FORMAT "%7.2" /end AXIS_PTS
/begin AXIS_PTS ldp_n__v_dur_igc_min "" 0x07cd3 n_32 _REC_AXS_20_u1 816. _CNV_A_R_LINEAR_____16_CM 8 0. 8160. DISPLAY_IDENTIFIER LDP_N__V_DUR_IGC_MIN FORMAT "%4.0" /end AXIS_PTS
/begin AXIS_PTS ldp_maf__v_dur_igc_min "" 0x00ff0 maf _REC_AXS_20_u1 138.9 _CNV_A_R_LINEAR_____27_CM 6 0. 1389. DISPLAY_IDENTIFIER LDP_MAF__V_DUR_IGC_MIN FORMAT "%4.0" /end AXIS_PTS
/begin AXIS_PTS ldp_n_dif_cor__tq_i_dt_is "" 0x10f30 n_dif_cor _REC_AXS_20_u2 65535. _CNV_A_R_LINEAR_____206_CM 12 -32768. 32767. DISPLAY_IDENTIFIER LDP_N_DIF_COR__TQ_I_DT_IS FORMAT "%6.0" /end AXIS_PTS
/begin AXIS_PTS ldp_n_dif_cor_tq_i_is "" 0x10f4a n_dif_cor _REC_AXS_20_u2 65535. _CNV_A_R_LINEAR_____206_CM 12 -32768. 32767. DISPLAY_IDENTIFIER LDP_N_DIF_COR_TQ_I_IS FORMAT "%6.0" /end AXIS_PTS
/begin AXIS_PTS ldp_n_grd_tq_i_is "" 0x07ced n_grd _REC_AXS_20_u1 8160. _CNV_A_R_LINEAR_____54_CM 8 -4096. 4064. DISPLAY_IDENTIFIER LDP_N_GRD_TQ_I_IS FORMAT "%5.0" /end AXIS_PTS
/begin AXIS_PTS ldpm_tco_is_1 "" 0x08214 tco _REC_AXS_20_u1 190.5 _CNV_A_R_LINEAR_____12_CM 8 -48. 142.5 DISPLAY_IDENTIFIER LDPM_TCO_IS_1 FORMAT "%5.1" /end AXIS_PTS
/begin AXIS_PTS ldpm_gr_mt_2 "" 0x07f76 gr_mt _REC_AXS_20_u1 255. _CNV_A_R_LINEAR_____1_CM 8 0. 255. DISPLAY_IDENTIFIER LDPM_GR_MT_2 FORMAT "%3.0" /end AXIS_PTS
/begin AXIS_PTS ldpm_n_dif_cor_p_d_dt_is "" 0x11954 n_dif_cor _REC_AXS_20_u2 65535. _CNV_A_R_LINEAR_____206_CM 12 -32768. 32767. DISPLAY_IDENTIFIER LDPM_N_DIF_COR_P_D_DT_IS FORMAT "%6.0" /end AXIS_PTS
/begin AXIS_PTS ldpm_n_grd_p_d_dt_is "" 0x0812d n_grd _REC_AXS_20_u1 8160. _CNV_A_R_LINEAR_____54_CM 8 -4096. 4064. DISPLAY_IDENTIFIER LDPM_N_GRD_P_D_DT_IS FORMAT "%5.0" /end AXIS_PTS
/begin AXIS_PTS ldpm_n_dif_cor_p_d_is "" 0x1196e n_dif_cor _REC_AXS_20_u2 65535. _CNV_A_R_LINEAR_____206_CM 12 -32768. 32767. DISPLAY_IDENTIFIER LDPM_N_DIF_COR_P_D_IS FORMAT "%6.0" /end AXIS_PTS
/begin AXIS_PTS ldpm_n_grd_p_d_is "" 0x08136 n_grd _REC_AXS_20_u1 8160. _CNV_A_R_LINEAR_____54_CM 8 -4096. 4064. DISPLAY_IDENTIFIER LDPM_N_GRD_P_D_IS FORMAT "%5.0" /end AXIS_PTS
/begin AXIS_PTS ldpm_t_ast__fac_n_grd_is "" 0x11b00 t_ast _REC_AXS_20_u2 6553.5 _CNV_A_R_LINEAR_____24_CM 8 0. 6553.5 DISPLAY_IDENTIFIER LDPM_T_AST__FAC_N_GRD_IS FORMAT "%5.1" /end AXIS_PTS
/begin AXIS_PTS ldpm_tco__fac_n_grd_is "" 0x081ca tco _REC_AXS_20_u1 190.5 _CNV_A_R_LINEAR_____12_CM 8 -48. 142.5 DISPLAY_IDENTIFIER LDPM_TCO__FAC_N_GRD_IS FORMAT "%6.2" /end AXIS_PTS
/begin AXIS_PTS ldpm_n_dif_cor_tq_i_is "" 0x11988 n_dif_cor _REC_AXS_20_u2 65535. _CNV_A_R_LINEAR_____206_CM 4 -32768. 32767. DISPLAY_IDENTIFIER LDPM_N_DIF_COR_TQ_I_IS FORMAT "%6.0" /end AXIS_PTS
/begin AXIS_PTS ldpm_n_grd_tq_i_is "" 0x0138f n_grd _REC_AXS_20_u1 8160. _CNV_A_R_LINEAR_____215_CM 4 -4096. 4064. DISPLAY_IDENTIFIER LDPM_N_GRD_TQ_I_IS FORMAT "%5.0" /end AXIS_PTS
/begin AXIS_PTS ldp_maf_lgrd_tq_add_is_bol "" 0x10d92 maf _REC_AXS_20_u2 1389. _CNV_A_R_LINEAR_____106_CM 6 0. 1389. DISPLAY_IDENTIFIER LDP_MAF_LGRD_TQ_ADD_IS_BOL FORMAT "%7.2" /end AXIS_PTS
/begin AXIS_PTS ldp_n_sp_is_tq_add_is_bol_bas "" 0x11018 n_sp_is _REC_AXS_20_u2 8160. _CNV_A_R_LINEAR_____11_CM 6 0. 8160. DISPLAY_IDENTIFIER LDP_N_SP_IS_TQ_ADD_IS_BOL_BAS FORMAT "%4.0" /end AXIS_PTS
/begin AXIS_PTS ldp_n_lgrd_tq_add_is_bol "" 0x10f96 n _REC_AXS_20_u2 8160. _CNV_A_R_LINEAR_____11_CM 6 0. 8160. DISPLAY_IDENTIFIER LDP_N_LGRD_TQ_ADD_IS_BOL FORMAT "%4.0" /end AXIS_PTS
/begin AXIS_PTS ldpm_maf_fac_tq_add_is "" 0x11766 maf _REC_AXS_20_u2 1389. _CNV_A_R_LINEAR_____106_CM 6 0. 1389. DISPLAY_IDENTIFIER LDPM_MAF_FAC_TQ_ADD_IS FORMAT "%7.2" /end AXIS_PTS
/begin AXIS_PTS ldp_tco_tq_add_is_bol_bas "" 0x011c8 tco _REC_AXS_20_u1 190.5 _CNV_A_R_LINEAR_____12_CM 6 -48. 142.5 DISPLAY_IDENTIFIER LDP_TCO_TQ_ADD_IS_BOL_BAS FORMAT "%5.1" /end AXIS_PTS
/begin AXIS_PTS ldp_tia_ip_fac_temp_tq_add_is "" 0x0120b tia _REC_AXS_20_u1 190.5 _CNV_A_R_LINEAR_____12_CM 6 -48. 142.5 DISPLAY_IDENTIFIER LDP_TIA_IP_FAC_TEMP_TQ_ADD_IS FORMAT "%5.1" /end AXIS_PTS
/begin AXIS_PTS ldp_toil_ip_fac_temp_tq_add_is "" 0x01242 toil _REC_AXS_20_u1 200. _CNV_A_R_LINEAR_____15_CM 6 -40. 160. DISPLAY_IDENTIFIER LDP_TOIL_IP_FAC_TEMP_TQ_ADD_IS FORMAT "%3.0" /end AXIS_PTS
/begin AXIS_PTS ldp_nr_pat__pat_ind "" 0x010dc online_dummy _REC_AXS_20_u1 255. _CNV_A_R_LINEAR_____1_CM 7 0. 255. DISPLAY_IDENTIFIER LDP_NR_PAT__PAT_IND FORMAT "%3.0" /end AXIS_PTS
/begin AXIS_PTS ldpm_tco_st_4 "" 0x0824a tco_st _REC_AXS_20_u1 190.5 _CNV_A_R_LINEAR_____12_CM 8 -48. 142.5 DISPLAY_IDENTIFIER LDPM_TCO_ST_4 FORMAT "%5.1" /end AXIS_PTS
/begin AXIS_PTS ldpm_n_11 "ldpm 6 points N for IGA" 0x11842 n _REC_AXS_20_u2 8160. _CNV_A_R_LINEAR_____11_CM 16 0. 8160. DISPLAY_IDENTIFIER LDPM_N_11 FORMAT "%4.0" /end AXIS_PTS
/begin AXIS_PTS ldpm_maf_ivvt_1 "" 0x117a0 maf_ivvt _REC_AXS_20_u2 1389. _CNV_A_R_LINEAR_____106_CM 6 0. 1389. DISPLAY_IDENTIFIER LDPM_MAF_IVVT_1 FORMAT "%7.2" /end AXIS_PTS
/begin AXIS_PTS ldpm_tco_17 "" 0x08193 tco _REC_AXS_20_u1 190.5 _CNV_A_R_LINEAR_____12_CM 8 -48. 142.5 DISPLAY_IDENTIFIER LDPM_TCO_17 FORMAT "%5.1" /end AXIS_PTS
/begin AXIS_PTS ldpm_tco_st_1_ivvt "" 0x08238 tco_st _REC_AXS_20_u1 190.5 _CNV_A_R_LINEAR_____12_CM 8 -48. 142.5 DISPLAY_IDENTIFIER LDPM_TCO_ST_1_IVVT FORMAT "%5.1" /end AXIS_PTS
/begin AXIS_PTS ldpm_t_ast_1_ivvt "" 0x11aee t_ast _REC_AXS_20_u2 6553.5 _CNV_A_R_LINEAR_____24_CM 8 0. 6553.5 DISPLAY_IDENTIFIER LDPM_T_AST_1_IVVT FORMAT "%6.1" /end AXIS_PTS
/begin AXIS_PTS ldp_n_32__fac_cam_sp_ch_opp "" 0x10e8a n_32 _REC_AXS_20_u2 8160. _CNV_A_R_LINEAR_____11_CM 4 0. 8160. DISPLAY_IDENTIFIER LDP_N_32__FAC_CAM_SP_CH_OPP FORMAT "%4.0" /end AXIS_PTS
/begin AXIS_PTS ldp_dip__fac_cam_sp_ch_opp "" 0x10a06 online_dummy _REC_AXS_20_u2 5434. _CNV_A_R_LINEAR_____49_CM 4 0. 5434. DISPLAY_IDENTIFIER LDP_DIP__FAC_CAM_SP_CH_OPP FORMAT "%7.2" /end AXIS_PTS
/begin AXIS_PTS ldp_state_cmb_ctl_id_cmb_ivvt "" 0x07d43 state_cmb_ctl _REC_AXS_20_u1 8. _CNV_A_R_LINEAR_____1_CM 9 0. 8. DISPLAY_IDENTIFIER LDP_STATE_CMB_CTL_ID_CMB_IVVT FORMAT "%2.0" /end AXIS_PTS
/begin AXIS_PTS ldpm_ctr_km_can_1 "" 0x115d8 ctr_km_can _REC_AXS_20_u2 655350. _CNV_A_R_LINEAR_____88_CM 4 0. 655350. DISPLAY_IDENTIFIER LDPM_CTR_KM_CAN_1 FORMAT "%7.0" /end AXIS_PTS
/begin AXIS_PTS ldpm_n_13 "" 0x11864 n _REC_AXS_20_u2 8160. _CNV_A_R_LINEAR_____11_CM 6 0. 8160. DISPLAY_IDENTIFIER LDPM_N_13 FORMAT "%4.0" /end AXIS_PTS
/begin AXIS_PTS ldpm_n_5 "" 0x118f0 n _REC_AXS_20_u2 8160. _CNV_A_R_LINEAR_____11_CM 16 0. 8160. DISPLAY_IDENTIFIER LDPM_N_5 FORMAT "%4.0" /end AXIS_PTS
/begin AXIS_PTS ldpm_maf_ivvt_2 "" 0x117ae maf _REC_AXS_20_u2 1389. _CNV_A_R_LINEAR_____106_CM 12 0. 1389. DISPLAY_IDENTIFIER LDPM_MAF_IVVT_2 FORMAT "%7.2" /end AXIS_PTS
/begin AXIS_PTS ldpm_toil_2_ivvt "" 0x01415 toil _REC_AXS_20_u1 200. _CNV_A_R_LINEAR_____15_CM 6 -40. 160. DISPLAY_IDENTIFIER LDPM_TOIL_2_IVVT FORMAT "%3.0" /end AXIS_PTS
/begin AXIS_PTS ldpm_cam_mdl_dif_ivvt "" 0x07eff ivvt_in_1.struct_ctl_ivvt.cam_mdl_dif_ivvt _REC_AXS_20_u1 60. _CNV_A_R_LINEAR_____82_CM 8 0. 60. DISPLAY_IDENTIFIER LDPM_CAM_MDL_DIF_IVVT /end AXIS_PTS
/begin AXIS_PTS ldpm_dly_ivvt_1_ivvt "" 0x012d6 ivvt_in_1.struct_ctl_ivvt.dly_ivvt _REC_AXS_20_u1 2550. _CNV_A_R_LINEAR_____31_CM 6 0. 2550. DISPLAY_IDENTIFIER LDPM_DLY_IVVT_1_IVVT FORMAT "%4.0" /end AXIS_PTS
/begin AXIS_PTS ldpm_n_32_4_ivvt "" 0x0133c n_32 _REC_AXS_20_u1 8160. _CNV_A_R_LINEAR_____16_CM 4 0. 8160. DISPLAY_IDENTIFIER LDPM_N_32_4_IVVT FORMAT "%4.0" /end AXIS_PTS
/begin AXIS_PTS ldpm_n_32_3_ivvt "" 0x01335 n_32 _REC_AXS_20_u1 8160. _CNV_A_R_LINEAR_____16_CM 6 0. 8160. DISPLAY_IDENTIFIER LDPM_N_32_3_IVVT FORMAT "%4.0" /end AXIS_PTS
/begin AXIS_PTS ldpm_n_32_2_ivvt "" 0x08047 n_32 _REC_AXS_20_u1 8160. _CNV_A_R_LINEAR_____16_CM 8 0. 8160. DISPLAY_IDENTIFIER LDPM_N_32_2_IVVT FORMAT "%4.0" /end AXIS_PTS
/begin AXIS_PTS ldpm_n_32_1_ivvt "" 0x0131d n_32 _REC_AXS_20_u1 8160. _CNV_A_R_LINEAR_____16_CM 4 0. 8160. DISPLAY_IDENTIFIER LDPM_N_32_1_IVVT FORMAT "%4.0" /end AXIS_PTS
/begin AXIS_PTS ldpm_toil_1_ivvt "" 0x08272 toil _REC_AXS_20_u1 200. _CNV_A_R_LINEAR_____15_CM 8 -40. 160. DISPLAY_IDENTIFIER LDPM_TOIL_1_IVVT FORMAT "%3.0" /end AXIS_PTS
/begin MEASUREMENT ivvt_in_1.struct_ctl_ivvt.t_add_min_ivvt_adh "Offset on energization time due to adhesion detection - inlet" UBYTE _CNV_A_R_LINEAR_____234_CM 1 100. 0. 159.375 DISPLAY_IDENTIFIER T_ADD_MIN_IVVT_ADH_IN_1 ECU_ADDRESS 0x3fc056 FORMAT "%6.1" /end MEASUREMENT
/begin MEASUREMENT ivvt_in_1.struct_ctl_ivvt.lv_adh_cdn_ivvt "Logical variable: adhesion detection conditions inlet cam i fullfilled (=1) / not fullfilled (=0)" UBYTE _CNV_S_2_RANGE______0_CM 1 100. 0. 1. DISPLAY_IDENTIFIER LV_ADH_CDN_IVVT_IN_1 ECU_ADDRESS 0x3fc059 /end MEASUREMENT
/begin MEASUREMENT ivvt_in_1.struct_ctl_ivvt.t_sum_adh_ivvt "Energization time integral inlet cam i" UBYTE _CNV_A_R_LINEAR_____234_CM 1 100. 0. 159.375 DISPLAY_IDENTIFIER T_SUM_ADH_IVVT_IN_1 ECU_ADDRESS 0x3fc058 FORMAT "%6.1" /end MEASUREMENT
/begin MEASUREMENT ivvt_in_1.struct_ctl_ivvt.t_dly_adh_ivvt "Reaction time before adhesion detection inlet cam" UWORD _CNV_A_R_LINEAR_____234_CM 1 100. 0. 40959.375 DISPLAY_IDENTIFIER T_DLY_ADH_IVVT_IN_1 ECU_ADDRESS 0x3fc050 BYTE_ORDER MSB_LAST FORMAT "%7.1" /end MEASUREMENT
/begin MEASUREMENT ivvt_in_1.struct_ctl_ivvt.cam_adh_old "Inlet cam position at start of reaction time" UBYTE _CNV_A_R_LINEAR_____229_CM 1 100. 60. 155.625 DISPLAY_IDENTIFIER CAM_ADH_OLD_IN_1 ECU_ADDRESS 0x3fc052 FORMAT "%8.3" /end MEASUREMENT
/begin MEASUREMENT ivvt_in_1.struct_ctl_ivvt.cam_adh_act "Inlet cam position closest to cam set point during reaction time" UBYTE _CNV_A_R_LINEAR_____229_CM 1 100. 60. 155.625 DISPLAY_IDENTIFIER CAM_ADH_ACT_IN_1 ECU_ADDRESS 0x3fc053 FORMAT "%8.3" /end MEASUREMENT
/begin MEASUREMENT ivvt_in_1.struct_ctl_ivvt.cam_adj_dif_adh_ivvt "De-jittered movement  of inlet cam in target direction during reaction delay time" SWORD _CNV_A_R_LINEAR_____82_CM 1 100. -60. 60. DISPLAY_IDENTIFIER CAM_ADJ_DIF_ADH_IVVT_IN_1 ECU_ADDRESS 0x3fc054 BYTE_ORDER MSB_LAST FORMAT "%7.3" /end MEASUREMENT
/begin MEASUREMENT ivvt_in_1.struct_ctl_ivvt.lv_err_ivvt_mec_ass "Logivcal variable for mechanical error assumed on inlet cam i" UBYTE _CNV_S_2_RANGE______0_CM 1 100. 0. 1. DISPLAY_IDENTIFIER LV_ERR_IVVT_MEC_ASS_IN_1 ECU_ADDRESS 0x3fc05a /end MEASUREMENT
/begin MEASUREMENT ivvt_in_1.struct_pwm_ivvt.t_drift_ivvthpwm "Time period for calculation of drift speed inlet cam" ULONG _CNV_A_R_LINEAR_____243_CM 1 100. 0. 17179869180. DISPLAY_IDENTIFIER T_DRIFT_IVVTHPWM_IN_1 ECU_ADDRESS 0x3fc078 BYTE_ORDER MSB_LAST FORMAT "%11.0" /end MEASUREMENT
/begin MEASUREMENT ivvt_in_1.struct_prj_ivvt.lv_ivvtpwm_ext_adj "activation bit for external adjustment inlet CAM" UBYTE _CNV_S_2_RANGE______0_CM 1 100. 0. 1. DISPLAY_IDENTIFIER LV_IVVTPWM_EXT_ADJ_IN_1 ECU_ADDRESS 0x3fc096 /end MEASUREMENT
/begin MEASUREMENT ivvt_in_1.struct_prj_ivvt.ivvtpwm_ext_adj "Pulse width modulated signal for external adjustment of inlet CAM" UBYTE _CNV_A_R_LINEAR_____10_CM 1 100. 0. 99.609375 DISPLAY_IDENTIFIER IVVTPWM_EXT_ADJ_IN_1 ECU_ADDRESS 0x3fc095 FORMAT "%4.1" /end MEASUREMENT
/begin MEASUREMENT ivvt_ex_1.struct_ctl_ivvt.t_add_min_ivvt_adh "Offset on energization time due to adhesion detection - exhaust" UBYTE _CNV_A_R_LINEAR_____234_CM 1 100. 0. 159.375 DISPLAY_IDENTIFIER T_ADD_MIN_IVVT_ADH_EX_1 ECU_ADDRESS 0x3fc172 FORMAT "%6.1" /end MEASUREMENT
/begin MEASUREMENT ivvt_ex_1.struct_ctl_ivvt.lv_adh_cdn_ivvt "Logical variable: adhesion detection conditions exhaust cam i fullfilled (=1) / not fullfilled (=0)" UBYTE _CNV_S_2_RANGE______0_CM 1 100. 0. 1. DISPLAY_IDENTIFIER LV_ADH_CDN_IVVT_EX_1 ECU_ADDRESS 0x3fc175 /end MEASUREMENT
/begin MEASUREMENT ivvt_ex_1.struct_ctl_ivvt.t_sum_adh_ivvt "Energization time integral exhaust cam i" UBYTE _CNV_A_R_LINEAR_____234_CM 1 100. 0. 159.375 DISPLAY_IDENTIFIER T_SUM_ADH_IVVT_EX_1 ECU_ADDRESS 0x3fc174 FORMAT "%6.1" /end MEASUREMENT
/begin MEASUREMENT ivvt_ex_1.struct_ctl_ivvt.t_dly_adh_ivvt "Reaction time before adhesion detection exhaust cam" UWORD _CNV_A_R_LINEAR_____234_CM 1 100. 0. 40959.375 DISPLAY_IDENTIFIER T_DLY_ADH_IVVT_EX_1 ECU_ADDRESS 0x3fc16c BYTE_ORDER MSB_LAST FORMAT "%7.1" /end MEASUREMENT
/begin MEASUREMENT ivvt_ex_1.struct_ctl_ivvt.cam_adh_old "Exhaust cam position at start of reaction time" UBYTE _CNV_A_R_LINEAR_____226_CM 1 100. -40. -135.625 DISPLAY_IDENTIFIER CAM_ADH_OLD_EX_1 ECU_ADDRESS 0x3fc16e FORMAT "%8.3" /end MEASUREMENT
/begin MEASUREMENT ivvt_ex_1.struct_ctl_ivvt.cam_adh_act "Exhaust cam position closest to cam set point during reaction time" UBYTE _CNV_A_R_LINEAR_____226_CM 1 100. -40. -135.625 DISPLAY_IDENTIFIER CAM_ADH_ACT_EX_1 ECU_ADDRESS 0x3fc16f FORMAT "%8.3" /end MEASUREMENT
/begin MEASUREMENT ivvt_ex_1.struct_ctl_ivvt.cam_adj_dif_adh_ivvt "De-jittered movement  of exhaust cam in target direction during reaction delay time" SWORD _CNV_A_R_LINEAR_____82_CM 1 100. -60. 60. DISPLAY_IDENTIFIER CAM_ADJ_DIF_ADH_IVVT_EX_1 ECU_ADDRESS 0x3fc170 BYTE_ORDER MSB_LAST FORMAT "%7.3" /end MEASUREMENT
/begin MEASUREMENT ivvt_ex_1.struct_ctl_ivvt.lv_err_ivvt_mec_ass "Logivcal variable for mechanical error assumed on exhaust cam i" UBYTE _CNV_S_2_RANGE______0_CM 1 100. 0. 1. DISPLAY_IDENTIFIER LV_ERR_IVVT_MEC_ASS_EX_1 ECU_ADDRESS 0x3fc176 /end MEASUREMENT
/begin MEASUREMENT ivvt_ex_1.struct_pwm_ivvt.t_drift_ivvthpwm "Time period for calculation of drift speed exhaust cam" ULONG _CNV_A_R_LINEAR_____243_CM 1 100. 0. 17179869180. DISPLAY_IDENTIFIER T_DRIFT_IVVTHPWM_EX_1 ECU_ADDRESS 0x3fc194 BYTE_ORDER MSB_LAST FORMAT "%11.0" /end MEASUREMENT
/begin MEASUREMENT ivvt_ex_1.struct_prj_ivvt.lv_ivvtpwm_ext_adj "activation bit for external adjustment exhaust CAM" UBYTE _CNV_S_2_RANGE______0_CM 1 100. 0. 1. DISPLAY_IDENTIFIER LV_IVVTPWM_EXT_ADJ_EX_1 ECU_ADDRESS 0x3fc1b2 /end MEASUREMENT
/begin MEASUREMENT ivvt_ex_1.struct_prj_ivvt.ivvtpwm_ext_adj "Pulse width modulated signal for external adjustment of exhaust CAM" UBYTE _CNV_A_R_LINEAR_____10_CM 1 100. 0. 99.609375 DISPLAY_IDENTIFIER IVVTPWM_EXT_ADJ_EX_1 ECU_ADDRESS 0x3fc1b1 FORMAT "%4.1" /end MEASUREMENT
/begin AXIS_PTS ldpm_cam_edge_nr "" 0x012b9 online_dummy _REC_AXS_20_u1 3. _CNV_A_R_LINEAR_____1_CM 4 0. 3. DISPLAY_IDENTIFIER LDPM_CAM_EDGE_NR FORMAT "%2.0" /end AXIS_PTS
/begin AXIS_PTS ldp_vb__fac_ivvtpwm "" 0x01261 vb _REC_AXS_20_u1 26. _CNV_A_R_LINEAR_____60_CM 3 0. 26. DISPLAY_IDENTIFIER LDP_VB__FAC_IVVTPWM FORMAT "%4.1" /end AXIS_PTS
/begin AXIS_PTS ldp_vb_ip_ivvthpwm "" 0x0126c vb _REC_AXS_20_u1 26. _CNV_A_R_LINEAR_____60_CM 4 0. 26. DISPLAY_IDENTIFIER LDP_VB_IP_IVVTHPWM FORMAT "%4.1" /end AXIS_PTS
/begin AXIS_PTS ldpm_cam_dif_ivvt "" 0x115a0 online_dummy _REC_AXS_20_u2 120. _CNV_A_R_LINEAR_____246_CM 5 -60. 60. DISPLAY_IDENTIFIER LDPM_CAM_DIF_IVVT FORMAT "%7.3" /end AXIS_PTS
/begin AXIS_PTS ldp_vel_drift_ip_ivvthpwm_cor "" 0x01271 online_dummy _REC_AXS_20_u1 95.625 _CNV_A_R_LINEAR_____242_CM 6 0. 95.625 DISPLAY_IDENTIFIER LDP_VEL_DRIFT_IP_IVVTHPWM_COR FORMAT "%5.2" /end AXIS_PTS
/begin AXIS_PTS ldp_t_drift_ivvthpwm "" 0x1118c online_dummy _REC_AXS_20_u2 65535. _CNV_A_R_LINEAR_____140_CM 6 0. 65535. DISPLAY_IDENTIFIER LDP_T_DRIFT_IVVTHPWM FORMAT "%5.0" /end AXIS_PTS
/begin AXIS_PTS ldpm_tmag_ivvt_1_ivvt "" 0x08265 tmag_ivvt _REC_AXS_20_u1 200. _CNV_A_R_LINEAR_____15_CM 12 -40. 160. DISPLAY_IDENTIFIER LDPM_TMAG_IVVT_1_IVVT FORMAT "%3.0" /end AXIS_PTS
/begin AXIS_PTS ldpm_mff_mmv "" 0x11812 mff_mmv _REC_AXS_20_u2 1389. _CNV_A_R_LINEAR_____106_CM 6 0. 1389. DISPLAY_IDENTIFIER LDPM_MFF_MMV FORMAT "%7.2" /end AXIS_PTS
/begin AXIS_PTS ldp_vo_fac_ivvt "" 0x07eed vo _REC_AXS_20_u1 95.625 _CNV_A_R_LINEAR_____82_CM 8 0. 95.625 DISPLAY_IDENTIFIER LDP_VO_FAC_IVVT FORMAT "%5.2" /end AXIS_PTS
/begin AXIS_PTS ldp_n_32__crlc_maf_ivvt "" 0x01016 n_32 _REC_AXS_20_u1 816. _CNV_A_R_LINEAR_____16_CM 6 0. 8160. DISPLAY_IDENTIFIER LDP_N_32__CRLC_MAF_IVVT FORMAT "%4.0" /end AXIS_PTS
/begin AXIS_PTS ldp_maf_sp__crlc_maf_ivvt "" 0x10da0 maf_sp_tqi _REC_AXS_20_u2 1389. _CNV_A_R_LINEAR_____106_CM 6 0. 1389. DISPLAY_IDENTIFIER LDP_MAF_SP__CRLC_MAF_IVVT FORMAT "%7.2" /end AXIS_PTS
/begin AXIS_PTS ldpm_n_4_9 "" 0x0137a n_knk _REC_AXS_20_u1 8160. _CNV_A_R_LINEAR_____16_CM 3 0. 8160. DISPLAY_IDENTIFIER LDPM_N_4_9 FORMAT "%4.0" /end AXIS_PTS
/begin AXIS_PTS ldpm_n_6_4 "" 0x0137e n_knk _REC_AXS_20_u1 8160. _CNV_A_R_LINEAR_____16_CM 4 0. 8160. DISPLAY_IDENTIFIER LDPM_N_6_4 FORMAT "%4.0" /end AXIS_PTS
/begin AXIS_PTS ldpm_n_iga_max_knk "" 0x08148 n_32 _REC_AXS_20_u1 8160. _CNV_A_R_LINEAR_____16_CM 8 0. 8160. DISPLAY_IDENTIFIER LDPM_N_IGA_MAX_KNK FORMAT "%4.0" /end AXIS_PTS
/begin AXIS_PTS ldpm_maf_iga_max_knk "" 0x07fc3 maf _REC_AXS_20_u1 1389. _CNV_A_R_LINEAR_____27_CM 8 0. 1389. DISPLAY_IDENTIFIER LDPM_MAF_IGA_MAX_KNK FORMAT "%4.0" /end AXIS_PTS
/begin AXIS_PTS ldp_tco__fac_iga_max_knk "" 0x01140 tco _REC_AXS_20_u1 190.5 _CNV_A_R_LINEAR_____12_CM 4 -48. 142.5 DISPLAY_IDENTIFIER LDP_TCO__FAC_IGA_MAX_KNK FORMAT "%5.1" /end AXIS_PTS
/begin AXIS_PTS ldp_tia__fac_iga_max_knk "" 0x011e2 tia _REC_AXS_20_u1 190.5 _CNV_A_R_LINEAR_____12_CM 4 -48. 142.5 DISPLAY_IDENTIFIER LDP_TIA__FAC_IGA_MAX_KNK FORMAT "%5.1" /end AXIS_PTS
/begin AXIS_PTS ldpm_n_2_9 "" 0x07feb n_knk _REC_AXS_20_u1 8160. _CNV_A_R_LINEAR_____16_CM 16 0. 8160. DISPLAY_IDENTIFIER LDPM_N_2_9 FORMAT "%4.0" /end AXIS_PTS
/begin AXIS_PTS ldpm_maf_1_9 "" 0x012f3 maf_knk _REC_AXS_20_u1 69.45 _CNV_A_R_LINEAR_____27_CM 4 0. 1389. DISPLAY_IDENTIFIER LDPM_MAF_1_9 FORMAT "%4.0" /end AXIS_PTS
/begin AXIS_PTS ldp_n_32__maf_min_knk_ad_2 "" 0x07c38 n_32 _REC_AXS_20_u1 8160. _CNV_A_R_LINEAR_____16_CM 16 0. 8160. DISPLAY_IDENTIFIER LDP_N_32__MAF_MIN_KNK_AD_2 FORMAT "%4.0" /end AXIS_PTS
/begin AXIS_PTS ldp_tia__ip_fac_ron_ad_max "" 0x011fa tia _REC_AXS_20_u1 190.5 _CNV_A_R_LINEAR_____12_CM 4 -48. 142.5 DISPLAY_IDENTIFIER LDP_TIA__IP_FAC_RON_AD_MAX FORMAT "%5.1" /end AXIS_PTS
/begin AXIS_PTS ldp_tco__ip_fac_ron_ad_max "" 0x01158 tco _REC_AXS_20_u1 190.5 _CNV_A_R_LINEAR_____12_CM 4 -48. 142.5 DISPLAY_IDENTIFIER LDP_TCO__IP_FAC_RON_AD_MAX FORMAT "%5.1" /end AXIS_PTS
/begin AXIS_PTS ldpm_n_32_3_iga "" 0x01330 n_32 _REC_AXS_20_u1 8160. _CNV_A_R_LINEAR_____16_CM 4 0. 8160. DISPLAY_IDENTIFIER LDPM_N_32_3_IGA FORMAT "%4.0" /end AXIS_PTS
/begin AXIS_PTS ldp_maf_iga__iga_tra_knk "" 0x00ffe maf _REC_AXS_20_u1 1389. _CNV_A_R_LINEAR_____27_CM 4 0. 1389. DISPLAY_IDENTIFIER LDP_MAF_IGA__IGA_TRA_KNK FORMAT "%4.0" /end AXIS_PTS
/begin AXIS_PTS ldpm_n_32_7 "" 0x01341 n_32 _REC_AXS_20_u1 8160. _CNV_A_R_LINEAR_____16_CM 4 0. 8160. DISPLAY_IDENTIFIER LDPM_N_32_7 FORMAT "%4.0" /end AXIS_PTS
/begin AXIS_PTS ldp_fac_ron_ad_fac_iga_tra "" 0x00fba fac_ron_ad _REC_AXS_20_u1 0.99610001 _CNV_A_R_LINEAR_____29_CM 3 0. 0.99610001 DISPLAY_IDENTIFIER LDP_FAC_RON_AD_FAC_IGA_TRA FORMAT "%5.3" /end AXIS_PTS
/begin AXIS_PTS ldp_tia_fac_iga_tra "" 0x011ff tia _REC_AXS_20_u1 190.5 _CNV_A_R_LINEAR_____12_CM 4 -48. 142.5 DISPLAY_IDENTIFIER LDP_TIA_FAC_IGA_TRA FORMAT "%5.1" /end AXIS_PTS
/begin AXIS_PTS ldpm_gear_1 "" 0x012e4 gear _REC_AXS_20_u1 7. _CNV_A_R_LINEAR_____1_CM 6 0. 7. DISPLAY_IDENTIFIER LDPM_GEAR_1 FORMAT "%2.0" /end AXIS_PTS
/begin AXIS_PTS ldp_vs_fac_iga_tra_gear_mt "" 0x012a1 vs _REC_AXS_20_u1 255. _CNV_A_R_LINEAR_____23_CM 6 0. 255. DISPLAY_IDENTIFIER LDP_VS_FAC_IGA_TRA_GEAR_MT FORMAT "%3.0" /end AXIS_PTS
/begin AXIS_PTS ldp_vs_fac_iga_tra_gear_at "" 0x0129a vs _REC_AXS_20_u1 255. _CNV_A_R_LINEAR_____23_CM 6 0. 255. DISPLAY_IDENTIFIER LDP_VS_FAC_IGA_TRA_GEAR_AT FORMAT "%3.0" /end AXIS_PTS
/begin AXIS_PTS ldpm_n_32_1_lamb_ctl "" 0x08016 n_32 _REC_AXS_20_u1 8160. _CNV_A_R_LINEAR_____16_CM 8 0. 8160. DISPLAY_IDENTIFIER LDPM_N_32_1_LAMB_CTL FORMAT "%4.0" /end AXIS_PTS
/begin AXIS_PTS ldpm_maf_1_lamb_ctl "" 0x116bc maf _REC_AXS_20_u2 1389. _CNV_A_R_LINEAR_____106_CM 8 0. 1389. DISPLAY_IDENTIFIER LDPM_MAF_1_LAMB_CTL FORMAT "%7.2" /end AXIS_PTS
/begin AXIS_PTS ldpm_maf_2_lamb_ctl "" 0x11702 maf _REC_AXS_20_u2 1389. _CNV_A_R_LINEAR_____106_CM 8 0. 1389. DISPLAY_IDENTIFIER LDPM_MAF_2_LAMB_CTL FORMAT "%7.2" /end AXIS_PTS
/begin AXIS_PTS ldpm_tco_1_lam "" 0x013ba tco _REC_AXS_20_u1 190.5 _CNV_A_R_LINEAR_____12_CM 6 -48. 142.5 DISPLAY_IDENTIFIER LDPM_TCO_1_LAM FORMAT "%5.1" /end AXIS_PTS
/begin AXIS_PTS ldpm_n_32_2_lamb_ctl "" 0x08050 n_32 _REC_AXS_20_u1 8160. _CNV_A_R_LINEAR_____16_CM 8 0. 8160. DISPLAY_IDENTIFIER LDPM_N_32_2_LAMB_CTL FORMAT "%4.0" /end AXIS_PTS
/begin AXIS_PTS ldp_maf_cyl_ip_crlc_lam_mv_lpf "" 0x10c14 maf_cyl _REC_AXS_20_u2 2047.96875 _CNV_A_R_LINEAR_____113_CM 6 0. 2047.96875 DISPLAY_IDENTIFIER LDP_MAF_CYL_IP_CRLC_LAM_MV_LPF FORMAT "%7.2" /end AXIS_PTS
/begin AXIS_PTS ldpm_teg_cat_down_mdl_1_lam "" 0x11b64 teg_cat_up_mdl_max _REC_AXS_20_u2 1507.3 _CNV_A_R_LINEAR_____262_CM 6 -48. 1459.3 DISPLAY_IDENTIFIER LDPM_TEG_CAT_DOWN_MDL_1_LAM FORMAT "%7.2" /end AXIS_PTS
/begin AXIS_PTS ldp_mff_ad_add_mmv_delta_add "" 0x10e12 online_dummy _REC_AXS_20_u2 1389.97 _CNV_A_R_LINEAR_____263_CM 8 -695. 694.97 DISPLAY_IDENTIFIER LDP_MFF_AD_ADD_MMV_DELTA_ADD FORMAT "%7.2" /end AXIS_PTS
/begin AXIS_PTS ldpm_tco_1_mff_ad "" 0x013c1 tco _REC_AXS_20_u1 190.5 _CNV_A_R_LINEAR_____12_CM 5 -48. 142.5 DISPLAY_IDENTIFIER LDPM_TCO_1_MFF_AD FORMAT "%5.1" /end AXIS_PTS
/begin AXIS_PTS ldp_mff_ad_add_mmv_2_mff_add "" 0x10e06 online_dummy _REC_AXS_20_u2 1389.97 _CNV_A_R_LINEAR_____263_CM 5 -695. 694.97 DISPLAY_IDENTIFIER LDP_MFF_AD_ADD_MMV_2_MFF_ADD FORMAT "%7.2" /end AXIS_PTS
/begin AXIS_PTS ldp_mff_ad_fac_mmv_2_mff_fac "" 0x10e24 online_dummy _REC_AXS_20_u2 99.99847412 _CNV_A_R_LINEAR_____159_CM 5 -50. 49.99847412 DISPLAY_IDENTIFIER LDP_MFF_AD_FAC_MMV_2_MFF_FAC FORMAT "%7.3" /end AXIS_PTS
/begin AXIS_PTS ldpm_n_32_1_mff_ad "" 0x01322 n_32 _REC_AXS_20_u1 8160. _CNV_A_R_LINEAR_____16_CM 6 0. 8160. DISPLAY_IDENTIFIER LDPM_N_32_1_MFF_AD FORMAT "%4.0" /end AXIS_PTS
/begin AXIS_PTS ldp_mff_ad_fac_mmv_delta_h "" 0x10e30 online_dummy _REC_AXS_20_u2 99.99847412 _CNV_A_R_LINEAR_____159_CM 8 -50. 49.99847412 DISPLAY_IDENTIFIER LDP_MFF_AD_FAC_MMV_DELTA_H FORMAT "%7.3" /end AXIS_PTS
/begin AXIS_PTS ldp_mff_ad_fac_mmv_delta_l "" 0x10e42 online_dummy _REC_AXS_20_u2 99.99847412 _CNV_A_R_LINEAR_____159_CM 8 -50. 49.99847412 DISPLAY_IDENTIFIER LDP_MFF_AD_FAC_MMV_DELTA_L FORMAT "%7.3" /end AXIS_PTS
/begin AXIS_PTS ldp_n_32_maf_mff_ad_fac_l_max "" 0x010ad n_32 _REC_AXS_20_u1 816. _CNV_A_R_LINEAR_____16_CM 6 0. 8160. DISPLAY_IDENTIFIER LDP_N_32_MAF_MFF_AD_FAC_L_MAX FORMAT "%4.0" /end AXIS_PTS
/begin AXIS_PTS ldpm_n_32_maf_mff_ad_fac_l_min "" 0x01373 n_32 _REC_AXS_20_u1 816. _CNV_A_R_LINEAR_____16_CM 6 0. 8160. DISPLAY_IDENTIFIER LDPM_N_32_MAF_MFF_AD_FAC_L_MIN FORMAT "%4.0" /end AXIS_PTS
/begin AXIS_PTS ldpm_n_32_maf_mff_ad_fac_h_min "" 0x0136c n_32 _REC_AXS_20_u1 816. _CNV_A_R_LINEAR_____16_CM 6 0. 8160. DISPLAY_IDENTIFIER LDPM_N_32_MAF_MFF_AD_FAC_H_MIN FORMAT "%4.0" /end AXIS_PTS
/begin AXIS_PTS ldpm_maf_1_lasp "" 0x116ce maf _REC_AXS_20_u2 1389. _CNV_A_R_LINEAR_____106_CM 8 0. 1389. DISPLAY_IDENTIFIER LDPM_MAF_1_LASP FORMAT "%7.2" /end AXIS_PTS
/begin AXIS_PTS ldpm_n_32_1_lasp "" 0x0801f n_32 _REC_AXS_20_u1 8160. _CNV_A_R_LINEAR_____16_CM 8 0. 8160. DISPLAY_IDENTIFIER LDPM_N_32_1_LASP FORMAT "%4.0" /end AXIS_PTS
/begin AXIS_PTS ldp_n_32_ip_lamb_afl_1 "" 0x07c76 n_32 _REC_AXS_20_u1 8160. _CNV_A_R_LINEAR_____16_CM 8 0. 8160. DISPLAY_IDENTIFIER LDP_N_32_IP_LAMB_AFL_1 FORMAT "%4.0" /end AXIS_PTS
/begin AXIS_PTS ldp_tqi_req_slow_ip_lamb_afl_1 "" 0x113b4 tqi_req_slow _REC_AXS_20_u2 2047.96875 _CNV_A_R_LINEAR_____186_CM 8 -1024. 1023.96875 DISPLAY_IDENTIFIER LDP_TQI_REQ_SLOW_IP_LAMB_AFL_1 FORMAT "%6.2" /end AXIS_PTS
/begin AXIS_PTS ldp_tco_st_ip_lamb_bas_wup_cor "" 0x07e30 tco_st _REC_AXS_20_u1 190.5 _CNV_A_R_LINEAR_____12_CM 8 -48. 142.5 DISPLAY_IDENTIFIER LDP_TCO_ST_IP_LAMB_BAS_WUP_COR FORMAT "%5.1" /end AXIS_PTS
/begin AXIS_PTS ldp_n_32_ip_lamb_hom_afl "" 0x07c7f n_32 _REC_AXS_20_u1 8160. _CNV_A_R_LINEAR_____16_CM 8 0. 8160. DISPLAY_IDENTIFIER LDP_N_32_IP_LAMB_HOM_AFL FORMAT "%4.0" /end AXIS_PTS
/begin AXIS_PTS ldp_tqi_req_slow_ip_lamb_hom_afl "" 0x113c6 tqi_req_slow _REC_AXS_20_u2 2047.96875 _CNV_A_R_LINEAR_____186_CM 8 -1024. 1023.96875 DISPLAY_IDENTIFIER LDP_TQI_REQ_SLOW_IP_LAMB_HOM_AFL FORMAT "%6.2" /end AXIS_PTS
/begin AXIS_PTS ldp_tco_ip_lamb_bas_wup_cor "" 0x07de6 tco _REC_AXS_20_u1 190.5 _CNV_A_R_LINEAR_____12_CM 8 -48. 142.5 DISPLAY_IDENTIFIER LDP_TCO_IP_LAMB_BAS_WUP_COR FORMAT "%5.1" /end AXIS_PTS
/begin AXIS_PTS ldp_n_32_ip_fac_lamb_wup "" 0x0108d n_32 _REC_AXS_20_u1 8160. _CNV_A_R_LINEAR_____16_CM 6 0. 8160. DISPLAY_IDENTIFIER LDP_N_32_IP_FAC_LAMB_WUP FORMAT "%4.0" /end AXIS_PTS
/begin AXIS_PTS ldp_n_32_ip_fac_lamb_wup_is "" 0x01094 n_32 _REC_AXS_20_u1 8160. _CNV_A_R_LINEAR_____16_CM 3 0. 8160. DISPLAY_IDENTIFIER LDP_N_32_IP_FAC_LAMB_WUP_IS FORMAT "%4.0" /end AXIS_PTS
/begin AXIS_PTS ldp_maf_ip_fac_lamb_wup "" 0x10c88 maf _REC_AXS_20_u2 1389. _CNV_A_R_LINEAR_____106_CM 6 0. 1389. DISPLAY_IDENTIFIER LDP_MAF_IP_FAC_LAMB_WUP FORMAT "%7.2" /end AXIS_PTS
/begin AXIS_PTS ldp_maf_ip_fac_lamb_wup_is "" 0x10c96 maf _REC_AXS_20_u2 1389. _CNV_A_R_LINEAR_____106_CM 4 0. 1389. DISPLAY_IDENTIFIER LDP_MAF_IP_FAC_LAMB_WUP_IS FORMAT "%7.2" /end AXIS_PTS
/begin AXIS_PTS ldp_tco__lamb_add_afl_ch "" 0x07d8c tco _REC_AXS_20_u1 190.5 _CNV_A_R_LINEAR_____12_CM 8 -48. 142.5 DISPLAY_IDENTIFIER LDP_TCO__LAMB_ADD_AFL_CH FORMAT "%5.1" /end AXIS_PTS
/begin AXIS_PTS ldp_t_ast__lamb_add_afl_ch "" 0x11156 t_ast _REC_AXS_20_u2 983.025 _CNV_A_R_LINEAR_____24_CM 8 0. 6553.5 DISPLAY_IDENTIFIER LDP_T_AST__LAMB_ADD_AFL_CH FORMAT "%5.1" /end AXIS_PTS
/begin AXIS_PTS ldp_tqi_req_slow__lamb_ch_rgl "" 0x1137e tqi_req_slow _REC_AXS_20_u2 2047.96875 _CNV_A_R_LINEAR_____186_CM 8 -1024. 1023.96875 DISPLAY_IDENTIFIER LDP_TQI_REQ_SLOW__LAMB_CH_RGL FORMAT "%6.2" /end AXIS_PTS
/begin AXIS_PTS ldp_n_32__lamb_ch_rgl "" 0x07c03 n_32 _REC_AXS_20_u1 8160. _CNV_A_R_LINEAR_____16_CM 8 0. 8160. DISPLAY_IDENTIFIER LDP_N_32__LAMB_CH_RGL FORMAT "%4.0" /end AXIS_PTS
/begin AXIS_PTS ldp_tqi_req_slow__lamb_ch_is "" 0x1136c tqi_req_slow _REC_AXS_20_u2 2047.96875 _CNV_A_R_LINEAR_____186_CM 8 -1024. 1023.96875 DISPLAY_IDENTIFIER LDP_TQI_REQ_SLOW__LAMB_CH_IS FORMAT "%6.2" /end AXIS_PTS
/begin AXIS_PTS ldp_n_32__lamb_ch_is "" 0x07bfa n_32 _REC_AXS_20_u1 8160. _CNV_A_R_LINEAR_____16_CM 8 0. 8160. DISPLAY_IDENTIFIER LDP_N_32__LAMB_CH_IS FORMAT "%4.0" /end AXIS_PTS
/begin AXIS_PTS ldp_t_cop_i__teg_cop "" 0x0112f online_dummy _REC_AXS_20_u1 127.5 _CNV_A_R_LINEAR_____268_CM 6 0. 127.5 DISPLAY_IDENTIFIER LDP_T_COP_I__TEG_COP FORMAT "%5.1" /end AXIS_PTS
/begin AXIS_PTS ldp_fac_cop_i__teg_cop "" 0x10a98 online_dummy _REC_AXS_20_u2 1.99996948 _CNV_A_R_LINEAR_____21_CM 16 0. 1.99996948 DISPLAY_IDENTIFIER LDP_FAC_COP_I__TEG_COP FORMAT "%7.5" /end AXIS_PTS
/begin AXIS_PTS ldpm_eff_iga_av_teg_i__teg_cop "" 0x1162c online_dummy _REC_AXS_20_u2 1.99996948 _CNV_A_R_LINEAR_____21_CM 4 0. 1.99996948 DISPLAY_IDENTIFIER LDPM_EFF_IGA_AV_TEG_I__TEG_COP FORMAT "%7.5" /end AXIS_PTS
/begin MEASUREMENT lam_bank_1.ls_act_chk_pl_inci.lv_inh_diag_chk_ls_down "Inhibit sensor signal plausibility active test" UBYTE _CNV_S_2_RANGE______0_CM 1 100. 0. 1. DISPLAY_IDENTIFIER LV_INH_DIAG_CHK_LS_DOWN_1 ECU_ADDRESS 0x3fc450 /end MEASUREMENT
/begin MEASUREMENT lam_bank_1.ls_down.bf.lv_vls_down_mmv_lmt "Boolean flag indicating VLS_DOWN_MMV_xxx_1 signals being limited when set" ULONG _CNV_S_2_RANGE______0_CM 1 100. 0. 1. DISPLAY_IDENTIFIER LV_VLS_DOWN_MMV_LMT_1 ECU_ADDRESS 0x3fc3d8 BYTE_ORDER MSB_LAST BIT_MASK 0x80000000 /end MEASUREMENT
/begin MEASUREMENT lam_bank_1.ls_down.vls_down "" UWORD _CNV_A_R_LINEAR_____3_CM 1 100. 0. 4.99511719 DISPLAY_IDENTIFIER VLS_DOWN_1 ECU_ADDRESS 0x3fc3dc BYTE_ORDER MSB_LAST FORMAT "%5.3" /end MEASUREMENT
/begin MEASUREMENT lam_bank_1.ls_down.vls_down_bol "Variable switching threshold for calculation of VLS_DOWN_MMV_MIN_1" UWORD _CNV_A_R_LINEAR_____3_CM 1 100. 0. 4.99511719 DISPLAY_IDENTIFIER VLS_DOWN_BOL_1 ECU_ADDRESS 0x3fc3de BYTE_ORDER MSB_LAST FORMAT "%5.3" /end MEASUREMENT
/begin MEASUREMENT lam_bank_1.ls_down.vls_down_tol "Variable switching threshold for calculation of VLS_DOWN_MMV_MAX_1" UWORD _CNV_A_R_LINEAR_____3_CM 1 100. 0. 4.99511719 DISPLAY_IDENTIFIER VLS_DOWN_TOL_1 ECU_ADDRESS 0x3fc3e0 BYTE_ORDER MSB_LAST FORMAT "%5.3" /end MEASUREMENT
/begin MEASUREMENT lam_bank_1.ls_down.vls_down_mmv_max "Mean oxygen sensor rich voltage" UWORD _CNV_A_R_LINEAR_____250_CM 1 100. 0. 4.99992371 DISPLAY_IDENTIFIER VLS_DOWN_MMV_MAX_1 ECU_ADDRESS 0x3fc3e2 BYTE_ORDER MSB_LAST FORMAT "%7.5" /end MEASUREMENT
/begin MEASUREMENT lam_bank_1.ls_down.vls_down_mmv_min "Mean oxygen sensor lean voltage" UWORD _CNV_A_R_LINEAR_____250_CM 1 100. 0. 4.99992371 DISPLAY_IDENTIFIER VLS_DOWN_MMV_MIN_1 ECU_ADDRESS 0x3fc3e4 BYTE_ORDER MSB_LAST FORMAT "%7.5" /end MEASUREMENT
/begin MEASUREMENT lam_bank_1.ls_down.vls_down_mmv_hys "Variable hysteresis used to determine switching thresholds" UWORD _CNV_A_R_LINEAR_____275_CM 1 100. 0. 1. DISPLAY_IDENTIFIER VLS_DOWN_MMV_HYS_1 ECU_ADDRESS 0x3fc3e6 BYTE_ORDER MSB_LAST FORMAT "%7.5" /end MEASUREMENT
/begin MEASUREMENT lam_bank_1.ls_down.drv1_vls_down_mmv "Mean of buffer containing 1st derivative of VLS_DOWN_1 signal" SWORD _CNV_A_R_LINEAR_____276_CM 1 100. -2.5 2.4999 DISPLAY_IDENTIFIER DRV1_VLS_DOWN_MMV_1 ECU_ADDRESS 0x3fc3ea BYTE_ORDER MSB_LAST FORMAT "%7.4" /end MEASUREMENT
/begin MEASUREMENT lam_bank_1.ls_down.drv1_vls_down_abs_max "Absolute maximum value within buffer containing 1st derivative of VLS_DOWN_1 signal" UWORD _CNV_A_R_LINEAR_____277_CM 1 100. 0. 4.9999237 DISPLAY_IDENTIFIER DRV1_VLS_DOWN_ABS_MAX_1 ECU_ADDRESS 0x3fc3e8 BYTE_ORDER MSB_LAST FORMAT "%6.4" /end MEASUREMENT
/begin MEASUREMENT lam_bank_1.ls_down.drv1_vls_down_mmv_min "Minimum value of mean of buffer containing 1st derivative of VLS_DOWN_i signal in lean phase" SWORD _CNV_A_R_LINEAR_____276_CM 1 100. -2.5 2.4999 DISPLAY_IDENTIFIER DRV1_VLS_DOWN_MMV_MIN_1 ECU_ADDRESS 0x3fc3ec BYTE_ORDER MSB_LAST FORMAT "%7.4" /end MEASUREMENT
/begin MEASUREMENT lam_bank_1.fsd_obd2.bf.lv_end_diag_win_fsd "End diagnosis cycle for similar conditions window" ULONG _CNV_S_2_RANGE______0_CM 1 100. 0. 1. DISPLAY_IDENTIFIER LV_END_DIAG_WIN_FSD_1 ECU_ADDRESS 0x3fc238 BYTE_ORDER MSB_LAST BIT_MASK 0x80000000 /end MEASUREMENT
/begin MEASUREMENT lam_bank_1.lsh_up_obd2.r_up_ls_thd_obd2_lsh_up "" UWORD _CNV_A_R_LINEAR_____279_CM 1 100. 0. 65535. DISPLAY_IDENTIFIER R_UP_LS_THD_OBD2_LSH_UP_1 ECU_ADDRESS 0x3fc49c BYTE_ORDER MSB_LAST FORMAT "%5.0" /end MEASUREMENT
/begin MEASUREMENT lam_bank_1.lsh_down_obd2.r_down_ls_thd_obd2_lsh_down "" UWORD _CNV_A_R_LINEAR_____279_CM 1 100. 0. 65535. DISPLAY_IDENTIFIER R_DOWN_LS_THD_OBD2_LSH_DOWN_1 ECU_ADDRESS 0x3fc334 BYTE_ORDER MSB_LAST FORMAT "%5.0" /end MEASUREMENT
/begin MEASUREMENT lam_bank_1.cat_eff_ldc_obd2.lv_lam_mv_ldc "" UBYTE _CNV_S_2_RANGE______0_CM 1 100. 0. 1. DISPLAY_IDENTIFIER LV_LAM_MV_LDC_1 ECU_ADDRESS 0x3fc1fc /end MEASUREMENT
/begin MEASUREMENT lam_bank_1.ls_down_rdy.bf.lv_down_ls "Logical variable for operative readiness of downstream oxygen sensor(s)" ULONG _CNV_S_2_RANGE______0_CM 1 100. 0. 1. DISPLAY_IDENTIFIER LV_DOWN_LS_1 ECU_ADDRESS 0x3fc404 BYTE_ORDER MSB_LAST BIT_MASK 0x80000000 /end MEASUREMENT
/begin MEASUREMENT lam_bank_2.ls_act_chk_pl_inci.lv_inh_diag_chk_ls_down "Inhibit sensor signal plausibility active test" UBYTE _CNV_S_2_RANGE______0_CM 1 100. 0. 1. DISPLAY_IDENTIFIER LV_INH_DIAG_CHK_LS_DOWN_2 ECU_ADDRESS 0x3fc7b4 /end MEASUREMENT
/begin MEASUREMENT lam_bank_2.ls_down.bf.lv_vls_down_mmv_lmt "Boolean flag indicating VLS_DOWN_MMV_xxx_1 signals being limited when set" ULONG _CNV_S_2_RANGE______0_CM 1 100. 0. 1. DISPLAY_IDENTIFIER LV_VLS_DOWN_MMV_LMT_2 ECU_ADDRESS 0x3fc73c BYTE_ORDER MSB_LAST BIT_MASK 0x80000000 /end MEASUREMENT
/begin MEASUREMENT lam_bank_2.ls_down.vls_down "" UWORD _CNV_A_R_LINEAR_____3_CM 1 100. 0. 4.99511719 DISPLAY_IDENTIFIER VLS_DOWN_2 ECU_ADDRESS 0x3fc740 BYTE_ORDER MSB_LAST FORMAT "%5.3" /end MEASUREMENT
/begin MEASUREMENT lam_bank_2.ls_down.vls_down_bol "Variable switching threshold for calculation of VLS_DOWN_MMV_MIN_1" UWORD _CNV_A_R_LINEAR_____3_CM 1 100. 0. 4.99511719 DISPLAY_IDENTIFIER VLS_DOWN_BOL_2 ECU_ADDRESS 0x3fc742 BYTE_ORDER MSB_LAST FORMAT "%5.3" /end MEASUREMENT
/begin MEASUREMENT lam_bank_2.ls_down.vls_down_tol "Variable switching threshold for calculation of VLS_DOWN_MMV_MAX_1" UWORD _CNV_A_R_LINEAR_____3_CM 1 100. 0. 4.99511719 DISPLAY_IDENTIFIER VLS_DOWN_TOL_2 ECU_ADDRESS 0x3fc744 BYTE_ORDER MSB_LAST FORMAT "%5.3" /end MEASUREMENT
/begin MEASUREMENT lam_bank_2.ls_down.vls_down_mmv_max "Mean oxygen sensor rich voltage" UWORD _CNV_A_R_LINEAR_____250_CM 1 100. 0. 4.99992371 DISPLAY_IDENTIFIER VLS_DOWN_MMV_MAX_2 ECU_ADDRESS 0x3fc746 BYTE_ORDER MSB_LAST FORMAT "%7.5" /end MEASUREMENT
/begin MEASUREMENT lam_bank_2.ls_down.vls_down_mmv_min "Mean oxygen sensor lean voltage" UWORD _CNV_A_R_LINEAR_____250_CM 1 100. 0. 4.99992371 DISPLAY_IDENTIFIER VLS_DOWN_MMV_MIN_2 ECU_ADDRESS 0x3fc748 BYTE_ORDER MSB_LAST FORMAT "%7.5" /end MEASUREMENT
/begin MEASUREMENT lam_bank_2.ls_down.vls_down_mmv_hys "Variable hysteresis used to determine switching thresholds" UWORD _CNV_A_R_LINEAR_____275_CM 1 100. 0. 1. DISPLAY_IDENTIFIER VLS_DOWN_MMV_HYS_2 ECU_ADDRESS 0x3fc74a BYTE_ORDER MSB_LAST FORMAT "%7.5" /end MEASUREMENT
/begin MEASUREMENT lam_bank_2.ls_down.drv1_vls_down_mmv "Mean of buffer containing 1st derivative of VLS_DOWN_1 signal" SWORD _CNV_A_R_LINEAR_____276_CM 1 100. -2.5 2.4999 DISPLAY_IDENTIFIER DRV1_VLS_DOWN_MMV_2 ECU_ADDRESS 0x3fc74e BYTE_ORDER MSB_LAST FORMAT "%7.4" /end MEASUREMENT
/begin MEASUREMENT lam_bank_2.ls_down.drv1_vls_down_abs_max "Absolute maximum value within buffer containing 1st derivative of VLS_DOWN_1 signal" UWORD _CNV_A_R_LINEAR_____277_CM 1 100. 0. 4.9999237 DISPLAY_IDENTIFIER DRV1_VLS_DOWN_ABS_MAX_2 ECU_ADDRESS 0x3fc74c BYTE_ORDER MSB_LAST FORMAT "%6.4" /end MEASUREMENT
/begin MEASUREMENT lam_bank_2.ls_down.drv1_vls_down_mmv_min "Minimum value of mean of buffer containing 1st derivative of VLS_DOWN_i signal in lean phase" SWORD _CNV_A_R_LINEAR_____276_CM 1 100. -2.5 2.4999 DISPLAY_IDENTIFIER DRV1_VLS_DOWN_MMV_MIN_2 ECU_ADDRESS 0x3fc750 BYTE_ORDER MSB_LAST FORMAT "%7.4" /end MEASUREMENT
/begin MEASUREMENT lam_bank_2.fsd_obd2.bf.lv_end_diag_win_fsd "End diagnosis cycle for similar conditions window" ULONG _CNV_S_2_RANGE______0_CM 1 100. 0. 1. DISPLAY_IDENTIFIER LV_END_DIAG_WIN_FSD_2 ECU_ADDRESS 0x3fc59c BYTE_ORDER MSB_LAST BIT_MASK 0x80000000 /end MEASUREMENT
/begin MEASUREMENT lam_bank_2.lsh_up_obd2.r_up_ls_thd_obd2_lsh_up "" UWORD _CNV_A_R_LINEAR_____279_CM 1 100. 0. 65535. DISPLAY_IDENTIFIER R_UP_LS_THD_OBD2_LSH_UP_2 ECU_ADDRESS 0x3fc800 BYTE_ORDER MSB_LAST FORMAT "%5.0" /end MEASUREMENT
/begin MEASUREMENT lam_bank_2.lsh_down_obd2.r_down_ls_thd_obd2_lsh_down "" UWORD _CNV_A_R_LINEAR_____279_CM 1 100. 0. 65535. DISPLAY_IDENTIFIER R_DOWN_LS_THD_OBD2_LSH_DOWN_2 ECU_ADDRESS 0x3fc698 BYTE_ORDER MSB_LAST FORMAT "%5.0" /end MEASUREMENT
/begin MEASUREMENT lam_bank_2.cat_eff_ldc_obd2.lv_lam_mv_ldc "" UBYTE _CNV_S_2_RANGE______0_CM 1 100. 0. 1. DISPLAY_IDENTIFIER LV_LAM_MV_LDC_2 ECU_ADDRESS 0x3fc560 /end MEASUREMENT
/begin MEASUREMENT lam_bank_2.ls_down_rdy.bf.lv_down_ls "Logical variable for operative readiness of downstream oxygen sensor(s)" ULONG _CNV_S_2_RANGE______0_CM 1 100. 0. 1. DISPLAY_IDENTIFIER LV_DOWN_LS_2 ECU_ADDRESS 0x3fc768 BYTE_ORDER MSB_LAST BIT_MASK 0x80000000 /end MEASUREMENT
/begin AXIS_PTS ldp_n__lamb_fl "" 0x07cc6 n_32 _REC_AXS_20_u1 8160. _CNV_A_R_LINEAR_____16_CM 12 0. 8160. DISPLAY_IDENTIFIER LDP_N__LAMB_FL FORMAT "%4.0" /end AXIS_PTS
/begin AXIS_PTS ldpm_tco_st_tco_lam_min "" 0x01400 tco_st _REC_AXS_20_u1 190.5 _CNV_A_R_LINEAR_____12_CM 6 -48. 142.5 DISPLAY_IDENTIFIER LDPM_TCO_ST_TCO_LAM_MIN FORMAT "%5.1" /end AXIS_PTS
/begin AXIS_PTS ldpm_tco_st_t_min_lscl "" 0x013f9 tco_st _REC_AXS_20_u1 190.5 _CNV_A_R_LINEAR_____12_CM 6 -48. 142.5 DISPLAY_IDENTIFIER LDPM_TCO_ST_T_MIN_LSCL FORMAT "%5.1" /end AXIS_PTS
/begin AXIS_PTS ldp_tco__lamb_ref_add "" 0x01164 tco _REC_AXS_20_u1 190.5 _CNV_A_R_LINEAR_____12_CM 6 -48. 142.5 DISPLAY_IDENTIFIER LDP_TCO__LAMB_REF_ADD FORMAT "%5.1" /end AXIS_PTS
/begin AXIS_PTS ldp_n__lamb_ref "" 0x010b9 n_32 _REC_AXS_20_u1 816. _CNV_A_R_LINEAR_____16_CM 6 0. 8160. DISPLAY_IDENTIFIER LDP_N__LAMB_REF FORMAT "%4.0" /end AXIS_PTS
/begin AXIS_PTS ldp_maf__lamb_ref "" 0x00fe4 maf _REC_AXS_20_u1 1389. _CNV_A_R_LINEAR_____27_CM 6 0. 1389. DISPLAY_IDENTIFIER LDP_MAF__LAMB_REF FORMAT "%4.0" /end AXIS_PTS
/begin AXIS_PTS ldp_lamb_dif__eff_lamb "" 0x10b38 online_dummy _REC_AXS_20_u2 63.99902344 _CNV_A_R_LINEAR_____266_CM 16 -32. 31.99902344 DISPLAY_IDENTIFIER LDP_LAMB_DIF__EFF_LAMB FORMAT "%8.4" /end AXIS_PTS
/begin AXIS_PTS ldp_ntl_ip_lamb_rgn_fac_mdl "" 0x11034 ntl _REC_AXS_20_u2 10485.6 _CNV_A_R_LINEAR_____308_CM 8 0. 10485.6 DISPLAY_IDENTIFIER LDP_NTL_IP_LAMB_RGN_FAC_MDL FORMAT "%7.1" /end AXIS_PTS
/begin AXIS_PTS ldp_vls_down_ip_lamb_rgn "" 0x11512 online_dummy _REC_AXS_20_u2 4.99511719 _CNV_A_R_LINEAR_____3_CM 8 0. 4.99511719 DISPLAY_IDENTIFIER LDP_VLS_DOWN_IP_LAMB_RGN FORMAT "%5.3" /end AXIS_PTS
/begin AXIS_PTS ldp_n_32_ip_lamb_rgn_afr "" 0x07c88 n_32 _REC_AXS_20_u1 8160. _CNV_A_R_LINEAR_____16_CM 8 0. 8160. DISPLAY_IDENTIFIER LDP_N_32_IP_LAMB_RGN_AFR FORMAT "%4.0" /end AXIS_PTS
/begin AXIS_PTS ldp_maf_ip_lamb_rgn_afr "" 0x07b93 maf _REC_AXS_20_u1 1389. _CNV_A_R_LINEAR_____27_CM 8 0. 1389. DISPLAY_IDENTIFIER LDP_MAF_IP_LAMB_RGN_AFR FORMAT "%4.0" /end AXIS_PTS
/begin AXIS_PTS ldp_tqi_req_slow__lamb_sawup "" 0x11390 tqi_req_slow _REC_AXS_20_u2 2047.96875 _CNV_A_R_LINEAR_____186_CM 8 -1024. 1023.96875 DISPLAY_IDENTIFIER LDP_TQI_REQ_SLOW__LAMB_SAWUP FORMAT "%6.2" /end AXIS_PTS
/begin AXIS_PTS ldp_tqi_req_slow__lamb_sawup_is "" 0x113a2 tqi_req_slow _REC_AXS_20_u2 2047.96875 _CNV_A_R_LINEAR_____186_CM 8 -1024. 1023.96875 DISPLAY_IDENTIFIER LDP_TQI_REQ_SLOW__LAMB_SAWUP_IS FORMAT "%6.2" /end AXIS_PTS
/begin AXIS_PTS ldp_n_32__lamb_sawup "" 0x07c1d n_32 _REC_AXS_20_u1 8160. _CNV_A_R_LINEAR_____16_CM 8 0. 8160. DISPLAY_IDENTIFIER LDP_N_32__LAMB_SAWUP FORMAT "%4.0" /end AXIS_PTS
/begin AXIS_PTS ldp_n_32__lamb_sawup_is "" 0x07c26 n_32 _REC_AXS_20_u1 8160. _CNV_A_R_LINEAR_____16_CM 8 0. 8160. DISPLAY_IDENTIFIER LDP_N_32__LAMB_SAWUP_IS FORMAT "%4.0" /end AXIS_PTS
/begin AXIS_PTS ldp_t_ast__lamb_add_sawup "" 0x11168 t_ast _REC_AXS_20_u2 6553.5 _CNV_A_R_LINEAR_____24_CM 8 0. 6553.5 DISPLAY_IDENTIFIER LDP_T_AST__LAMB_ADD_SAWUP FORMAT "%6.1" /end AXIS_PTS
/begin AXIS_PTS ldp_tco__lamb_add_sawup "" 0x07d95 tco _REC_AXS_20_u1 190.5 _CNV_A_R_LINEAR_____12_CM 8 -48. 142.5 DISPLAY_IDENTIFIER LDP_TCO__LAMB_ADD_SAWUP FORMAT "%5.1" /end AXIS_PTS
/begin AXIS_PTS ldp_eff_lamb_sp__lamb_dif_sp "" 0x10a32 eff_lamb_sp _REC_AXS_20_u2 0.199996948 _CNV_A_R_LINEAR_____21_CM 16 0. 1.99996948 DISPLAY_IDENTIFIER LDP_EFF_LAMB_SP__LAMB_DIF_SP FORMAT "%7.5" /end AXIS_PTS
/begin AXIS_PTS ldp_n_32__lamb_iga_afl "" 0x07c0c n_32 _REC_AXS_20_u1 8160. _CNV_A_R_LINEAR_____16_CM 16 0. 8160. DISPLAY_IDENTIFIER LDP_N_32__LAMB_IGA_AFL FORMAT "%4.0" /end AXIS_PTS
/begin AXIS_PTS ldp_maf_hb__lamb_iga_afl "" 0x07b7d maf _REC_AXS_20_u1 1389. _CNV_A_R_LINEAR_____27_CM 12 0. 1389. DISPLAY_IDENTIFIER LDP_MAF_HB__LAMB_IGA_AFL FORMAT "%4.0" /end AXIS_PTS
/begin AXIS_PTS ldp_tco_ip_lamb_scc "" 0x07def tco _REC_AXS_20_u1 190.5 _CNV_A_R_LINEAR_____12_CM 8 -48. 142.5 DISPLAY_IDENTIFIER LDP_TCO_IP_LAMB_SCC FORMAT "%5.1" /end AXIS_PTS
/begin AXIS_PTS ldpm_n_32 "" 0x0130f n_32 _REC_AXS_20_u1 8160. _CNV_A_R_LINEAR_____16_CM 6 0. 8160. DISPLAY_IDENTIFIER LDPM_N_32 FORMAT "%4.0" /end AXIS_PTS
/begin AXIS_PTS ldp_n_ip_vls_sp_dly "" 0x07d08 n_32 _REC_AXS_20_u1 8160. _CNV_A_R_LINEAR_____16_CM 8 0. 8160. DISPLAY_IDENTIFIER LDP_N_IP_VLS_SP_DLY FORMAT "%4.0" /end AXIS_PTS
/begin AXIS_PTS ldp_maf_ip_vls_sp_dly "" 0x07b9c maf _REC_AXS_20_u1 1389. _CNV_A_R_LINEAR_____27_CM 8 0. 1389. DISPLAY_IDENTIFIER LDP_MAF_IP_VLS_SP_DLY FORMAT "%4.0" /end AXIS_PTS
/begin AXIS_PTS ldp_n_ip_fac_lam_dly "" 0x07cff n_32 _REC_AXS_20_u1 8160. _CNV_A_R_LINEAR_____16_CM 8 0. 8160. DISPLAY_IDENTIFIER LDP_N_IP_FAC_LAM_DLY FORMAT "%4.0" /end AXIS_PTS
/begin AXIS_PTS ldp_maf_ip_fac_lam_dly "" 0x07b8a maf _REC_AXS_20_u1 1389. _CNV_A_R_LINEAR_____27_CM 8 0. 1389. DISPLAY_IDENTIFIER LDP_MAF_IP_FAC_LAM_DLY FORMAT "%4.0" /end AXIS_PTS
/begin AXIS_PTS ldp_maf_kgh_ip_fac_dly_p "" 0x10d3c maf_kgh _REC_AXS_20_u2 2047.96875 _CNV_A_R_LINEAR_____113_CM 6 0. 2047.96875 DISPLAY_IDENTIFIER LDP_MAF_KGH_IP_FAC_DLY_P FORMAT "%6.2" /end AXIS_PTS
/begin AXIS_PTS ldpm_vls_dif_dly "" 0x11c9e online_dummy _REC_AXS_20_u2 9.99034 _CNV_A_R_LINEAR_____312_CM 12 -4.99517 4.99517 DISPLAY_IDENTIFIER LDPM_VLS_DIF_DLY FORMAT "%5.3" /end AXIS_PTS
/begin AXIS_PTS ldpm_cat_ip_fac_cat_dly "" 0x012cf online_dummy _REC_AXS_20_u1 1.9968 _CNV_A_R_LINEAR_____313_CM 6 0. 1.9968 DISPLAY_IDENTIFIER LDPM_CAT_IP_FAC_CAT_DLY FORMAT "%4.2" /end AXIS_PTS
/begin AXIS_PTS ldp_maf_kgh_ip_crlc_dly_i "" 0x10d2e maf_kgh _REC_AXS_20_u2 2047.96875 _CNV_A_R_LINEAR_____113_CM 6 0. 2047.96875 DISPLAY_IDENTIFIER LDP_MAF_KGH_IP_CRLC_DLY_I FORMAT "%6.2" /end AXIS_PTS
/begin AXIS_PTS ldp_maf_int_puc "" 0x10c68 maf_int_puc _REC_AXS_20_u2 1820.398 _CNV_A_R_LINEAR_____271_CM 6 0. 1820.398 DISPLAY_IDENTIFIER LDP_MAF_INT_PUC FORMAT "%7.2" /end AXIS_PTS
/begin AXIS_PTS ldp_temp_main_cat "" 0x111fc online_dummy _REC_AXS_20_u2 1023.984375 _CNV_A_R_LINEAR_____302_CM 6 -33. 990.984375 DISPLAY_IDENTIFIER LDP_TEMP_MAIN_CAT FORMAT "%6.2" /end AXIS_PTS
/begin AXIS_PTS ldp_maf_cyl "" 0x10bea maf_cyl _REC_AXS_20_u2 2047.96875 _CNV_A_R_LINEAR_____113_CM 6 0. 2047.96875 DISPLAY_IDENTIFIER LDP_MAF_CYL FORMAT "%7.2" /end AXIS_PTS
/begin AXIS_PTS ldp_quo_maf_int_purge "" 0x07d3a lam_bank_1.lam_puc.quo_maf_int_purge _REC_AXS_20_u1 0.9960940000000002 _CNV_A_R_LINEAR_____50_CM 8 0. 0.996094 DISPLAY_IDENTIFIER LDP_QUO_MAF_INT_PURGE FORMAT "%5.3" /end AXIS_PTS
/begin AXIS_PTS ldpm_cat_diag "" 0x012c8 online_dummy _REC_AXS_20_u1 1.984375 _CNV_A_R_LINEAR_____157_CM 6 0. 1.984375 DISPLAY_IDENTIFIER LDPM_CAT_DIAG FORMAT "%4.2" /end AXIS_PTS
/begin AXIS_PTS ldp_temp_pcat "" 0x1120a online_dummy _REC_AXS_20_u2 1023.984375 _CNV_A_R_LINEAR_____302_CM 6 -33. 990.984375 DISPLAY_IDENTIFIER LDP_TEMP_PCAT FORMAT "%6.2" /end AXIS_PTS
/begin AXIS_PTS ldp_r_down_ls_ip_ttip_ls_down "" 0x11106 lam_bank_1.ls_down_cur.r_down_ls _REC_AXS_20_u2 65535. _CNV_A_R_LINEAR_____279_CM 8 0. 65535. DISPLAY_IDENTIFIER LDP_R_DOWN_LS_IP_TTIP_LS_DOWN FORMAT "%5.0" /end AXIS_PTS
/begin AXIS_PTS ldp_maf_kgh_crlc_ttip_ref_ls "" 0x10d0a maf_kgh _REC_AXS_20_u2 2047.96875 _CNV_A_R_LINEAR_____113_CM 8 0. 2047.96875 DISPLAY_IDENTIFIER LDP_MAF_KGH_CRLC_TTIP_REF_LS FORMAT "%7.2" /end AXIS_PTS
/begin AXIS_PTS ldp_pow_lsh_down_mmv_r_down_ls "" 0x11080 lam_bank_1.ls_down_cur.pow_lsh_down_mmv _REC_AXS_20_u2 65.535 _CNV_A_R_LINEAR_____281_CM 8 0. 65.535 DISPLAY_IDENTIFIER LDP_POW_LSH_DOWN_MMV_R_DOWN_LS /end AXIS_PTS
/begin AXIS_PTS ldp_ttip_ref_ls_down_mdl_r_down "" 0x11404 lam_bank_1.ls_down_cur.ttip_ref_ls_down_mdl_mmv _REC_AXS_20_u2 2047.938 _CNV_A_R_LINEAR_____282_CM 8 0. 2047.938 DISPLAY_IDENTIFIER LDP_TTIP_REF_LS_DOWN_MDL_R_DOWN FORMAT "%7.3" /end AXIS_PTS
/begin AXIS_PTS ldpm_t_vls_cyc_afl_hld "" 0x08181 lam_bank_1.ls_up.t_vls_cyc_afl_hld _REC_AXS_20_u1 2.55 _CNV_A_R_LINEAR_____4_CM 8 0. 2.55 DISPLAY_IDENTIFIER LDPM_T_VLS_CYC_AFL_HLD FORMAT "%4.2" /end AXIS_PTS
/begin AXIS_PTS ldp_maf_kgh_crlc_ttip_ref_ls_up "" 0x10d1c maf_kgh _REC_AXS_20_u2 2047.96875 _CNV_A_R_LINEAR_____113_CM 8 0. 2047.96875 DISPLAY_IDENTIFIER LDP_MAF_KGH_CRLC_TTIP_REF_LS_UP FORMAT "%7.2" /end AXIS_PTS
/begin AXIS_PTS ldp_r_up_ls_ip_ttip_ls_up "" 0x11122 lam_bank_1.ls_up_cur.r_up_ls _REC_AXS_20_u2 65535. _CNV_A_R_LINEAR_____279_CM 8 0. 65535. DISPLAY_IDENTIFIER LDP_R_UP_LS_IP_TTIP_LS_UP FORMAT "%5.0" /end AXIS_PTS
/begin AXIS_PTS ldp_pow_lsh_up_mmv_r_up_ls_mdl "" 0x11092 online_dummy _REC_AXS_20_u2 65.535 _CNV_A_R_LINEAR_____281_CM 8 0. 65.535 DISPLAY_IDENTIFIER LDP_POW_LSH_UP_MMV_R_UP_LS_MDL /end AXIS_PTS
/begin AXIS_PTS ldp_ttip_ref_ls_up_mdl_r_up_ls "" 0x11428 online_dummy _REC_AXS_20_u2 2047.96875 _CNV_A_R_LINEAR_____283_CM 8 0. 2047.96875 DISPLAY_IDENTIFIER LDP_TTIP_REF_LS_UP_MDL_R_UP_LS FORMAT "%7.2" /end AXIS_PTS
/begin AXIS_PTS ldpm_temp_ls_ini_1_egcp "" 0x11c28 online_dummy _REC_AXS_20_u2 4095.938 _CNV_A_R_LINEAR_____321_CM 6 -2048. 2047.938 DISPLAY_IDENTIFIER LDPM_TEMP_LS_INI_1_EGCP FORMAT "%8.2" /end AXIS_PTS
/begin AXIS_PTS ldp_vs_fac_v_efc_teg "" 0x012a8 vs _REC_AXS_20_u1 255. _CNV_A_R_LINEAR_____23_CM 6 0. 255. DISPLAY_IDENTIFIER LDP_VS_FAC_V_EFC_TEG FORMAT "%3.0" /end AXIS_PTS
/begin AXIS_PTS ldpm_n_32_1_egcp "" 0x01316 n_32 _REC_AXS_20_u1 8160. _CNV_A_R_LINEAR_____16_CM 6 0. 8160. DISPLAY_IDENTIFIER LDPM_N_32_1_EGCP FORMAT "%4.0" /end AXIS_PTS
/begin AXIS_PTS ldpm_teg_cat_up_mdl_1_egcp "" 0x11b72 teg_cat_up_mdl_max _REC_AXS_20_u2 2047. _CNV_A_R_LINEAR_____7_CM 6 0. 2047. DISPLAY_IDENTIFIER LDPM_TEG_CAT_UP_MDL_1_EGCP FORMAT "%7.2" /end AXIS_PTS
/begin AXIS_PTS ldpm_teg_cat_down_mdl_1_egcp "" 0x11b56 online_dummy _REC_AXS_20_u2 2047. _CNV_A_R_LINEAR_____7_CM 6 0. 2047. DISPLAY_IDENTIFIER LDPM_TEG_CAT_DOWN_MDL_1_EGCP FORMAT "%7.2" /end AXIS_PTS
/begin AXIS_PTS ldpm_temp_ls_down_ini_1_egcp "" 0x11c1a online_dummy _REC_AXS_20_u2 4095.938 _CNV_A_R_LINEAR_____321_CM 6 -2048. 2047.938 DISPLAY_IDENTIFIER LDPM_TEMP_LS_DOWN_INI_1_EGCP FORMAT "%8.2" /end AXIS_PTS
/begin AXIS_PTS ldp_n_32_ip_v_efc_lsh_down_ctl "" 0x010a6 n_32 _REC_AXS_20_u1 8160. _CNV_A_R_LINEAR_____16_CM 6 0. 8160. DISPLAY_IDENTIFIER LDP_N_32_IP_V_EFC_LSH_DOWN_CTL FORMAT "%4.0" /end AXIS_PTS
/begin AXIS_PTS ldp_vs_ip_fac_v_efc_down_teg "" 0x012af vs _REC_AXS_20_u1 255. _CNV_A_R_LINEAR_____23_CM 6 0. 255. DISPLAY_IDENTIFIER LDP_VS_IP_FAC_V_EFC_DOWN_TEG FORMAT "%3.0" /end AXIS_PTS
/begin AXIS_PTS ldpm_tco_st_1_laco "" 0x013eb tco_st _REC_AXS_20_u1 190.5 _CNV_A_R_LINEAR_____12_CM 6 -48. 142.5 DISPLAY_IDENTIFIER LDPM_TCO_ST_1_LACO FORMAT "%5.1" /end AXIS_PTS
/begin AXIS_PTS ldp_tco_st_t_dly_ls_ready "" 0x07e39 tco_st _REC_AXS_20_u1 190.5 _CNV_A_R_LINEAR_____12_CM 8 -48. 142.5 DISPLAY_IDENTIFIER LDP_TCO_ST_T_DLY_LS_READY FORMAT "%5.1" /end AXIS_PTS
/begin AXIS_PTS ldpm_n_32__ti_lam "" 0x0809b n_32 _REC_AXS_20_u1 8160. _CNV_A_R_LINEAR_____16_CM 8 0. 8160. DISPLAY_IDENTIFIER LDPM_N_32__TI_LAM FORMAT "%4.0" /end AXIS_PTS
/begin AXIS_PTS ldpm_maf__ti_lam "" 0x11734 maf _REC_AXS_20_u2 1389. _CNV_A_R_LINEAR_____106_CM 8 0. 1389. DISPLAY_IDENTIFIER LDPM_MAF__TI_LAM FORMAT "%7.2" /end AXIS_PTS
/begin AXIS_PTS ldp_id_maf_tab_1 "" 0x07b00 online_dummy _REC_AXS_20_u1 255. _CNV_A_R_LINEAR_____1_CM 16 0. 255. DISPLAY_IDENTIFIER LDP_ID_MAF_TAB_1 FORMAT "%3.0" /end AXIS_PTS
/begin AXIS_PTS ldp_id_maf_tab_2 "" 0x07b11 online_dummy _REC_AXS_20_u1 255. _CNV_A_R_LINEAR_____1_CM 16 0. 255. DISPLAY_IDENTIFIER LDP_ID_MAF_TAB_2 FORMAT "%3.0" /end AXIS_PTS
/begin AXIS_PTS ldp_n__pq_sp_puls "" 0x10ef8 n _REC_AXS_20_u2 816. _CNV_A_R_LINEAR_____11_CM 6 0. 8160. DISPLAY_IDENTIFIER LDP_N__PQ_SP_PULS FORMAT "%4.0" /end AXIS_PTS
/begin AXIS_PTS ldpm_tia_maf_mdl_con_1 "" 0x0825c tia _REC_AXS_20_u1 190.5 _CNV_A_R_LINEAR_____12_CM 8 -48. 142.5 DISPLAY_IDENTIFIER LDPM_TIA_MAF_MDL_CON_1 FORMAT "%5.1" /end AXIS_PTS
/begin AXIS_PTS ldp_teg_egr_maf_egr_con_1 "" 0x111dc teg_egr _REC_AXS_20_u2 2047. _CNV_A_R_LINEAR_____7_CM 8 0. 2047. DISPLAY_IDENTIFIER LDP_TEG_EGR_MAF_EGR_CON_1 FORMAT "%7.2" /end AXIS_PTS
/begin AXIS_PTS ldpm_n_32_ar_red "" 0x0135e n_32 _REC_AXS_20_u1 816. _CNV_A_R_LINEAR_____16_CM 6 0. 8160. DISPLAY_IDENTIFIER LDPM_N_32_AR_RED FORMAT "%4.0" /end AXIS_PTS
/begin AXIS_PTS ldpm_maf_mes__vol_im "" 0x117e0 maf_mes _REC_AXS_20_u2 1389. _CNV_A_R_LINEAR_____106_CM 6 0. 1389. DISPLAY_IDENTIFIER LDPM_MAF_MES__VOL_IM FORMAT "%7.2" /end AXIS_PTS
/begin AXIS_PTS ldpm_n_32__vol_im "" 0x080c3 n_32 _REC_AXS_20_u1 8160. _CNV_A_R_LINEAR_____16_CM 8 0. 8160. DISPLAY_IDENTIFIER LDPM_N_32__VOL_IM FORMAT "%4.0" /end AXIS_PTS
/begin AXIS_PTS ldpm_n_32__vol_im_is "" 0x01357 n_32 _REC_AXS_20_u1 8160. _CNV_A_R_LINEAR_____16_CM 6 0. 8160. DISPLAY_IDENTIFIER LDPM_N_32__VOL_IM_IS FORMAT "%4.0" /end AXIS_PTS
/begin AXIS_PTS ldp_pq__ip_pq_isa "" 0x110a4 online_dummy _REC_AXS_20_u2 0.99998474 _CNV_A_R_LINEAR_____37_CM 16 0. 0.99998474 DISPLAY_IDENTIFIER LDP_PQ__IP_PQ_ISA FORMAT "%7.5" /end AXIS_PTS
/begin AXIS_PTS ldp_ar_red__ip_pq_isa "" 0x1092c online_dummy _REC_AXS_20_u2 58.592855 _CNV_A_R_LINEAR_____333_CM 8 0. 58.592855 DISPLAY_IDENTIFIER LDP_AR_RED__IP_PQ_ISA FORMAT "%7.4" /end AXIS_PTS
/begin AXIS_PTS ldpm_pq_ar_red "" 0x11a6e pq _REC_AXS_20_u2 0.99998474 _CNV_A_R_LINEAR_____37_CM 4 0. 0.99998474 DISPLAY_IDENTIFIER LDPM_PQ_AR_RED FORMAT "%7.5" /end AXIS_PTS
/begin AXIS_PTS ldpm_maf_kgh_t_1_hfm "" 0x117d6 maf_kgh _REC_AXS_20_u2 204.796875 _CNV_A_R_LINEAR_____113_CM 4 0. 2047.96875 DISPLAY_IDENTIFIER LDPM_MAF_KGH_T_1_HFM FORMAT "%7.2" /end AXIS_PTS
/begin AXIS_PTS ldpm_n_ar_red "" 0x01383 n_32 _REC_AXS_20_u1 8160. _CNV_A_R_LINEAR_____16_CM 6 0. 8160. DISPLAY_IDENTIFIER LDPM_N_AR_RED FORMAT "%4.0" /end AXIS_PTS
/begin AXIS_PTS ldpm_pq__fac_ar_red_cor "" 0x11a5c pq _REC_AXS_20_u2 0.99998474 _CNV_A_R_LINEAR_____37_CM 8 0. 0.99998474 DISPLAY_IDENTIFIER LDPM_PQ__FAC_AR_RED_COR FORMAT "%7.5" /end AXIS_PTS
/begin AXIS_PTS ldp_t_seg_t_1_ratio_crlc_hfm "" 0x111ac online_dummy _REC_AXS_20_u2 7.99987793 _CNV_A_R_LINEAR_____345_CM 6 0. 7.99987793 DISPLAY_IDENTIFIER LDP_T_SEG_T_1_RATIO_CRLC_HFM FORMAT "%6.4" /end AXIS_PTS
/begin AXIS_PTS ldp_ar_red_ad_add_dif "" 0x1093e ar_red_ad_add_dif _REC_AXS_20_u2 58.592855 _CNV_A_R_LINEAR_____333_CM 4 0. 58.592855 DISPLAY_IDENTIFIER LDP_AR_RED_AD_ADD_DIF FORMAT "%7.4" /end AXIS_PTS
/begin AXIS_PTS ldp_n_32_ar_red_egr "" 0x0107f n_32 _REC_AXS_20_u1 816. _CNV_A_R_LINEAR_____16_CM 6 0. 8160. DISPLAY_IDENTIFIER LDP_N_32_AR_RED_EGR FORMAT "%4.0" /end AXIS_PTS
/begin AXIS_PTS ldp_stk_av_egr_ar_red_egr "" 0x07d4d stk_av_egr _REC_AXS_20_u1 99.609375 _CNV_A_R_LINEAR_____10_CM 8 0. 99.609375 DISPLAY_IDENTIFIER LDP_STK_AV_EGR_AR_RED_EGR FORMAT "%5.2" /end AXIS_PTS
/begin AXIS_PTS ldpm_maf_cyl_ex "" 0x11746 maf_cyl _REC_AXS_20_u2 2047.96875 _CNV_A_R_LINEAR_____113_CM 8 0. 2047.96875 DISPLAY_IDENTIFIER LDPM_MAF_CYL_EX FORMAT "%6.2" /end AXIS_PTS
/begin AXIS_PTS ldp_n_32__ip_t_vim_eff_vol "" 0x0102e n_32 _REC_AXS_20_u1 8160. _CNV_A_R_LINEAR_____16_CM 2 0. 8160. DISPLAY_IDENTIFIER LDP_N_32__IP_T_VIM_EFF_VOL FORMAT "%4.0" /end AXIS_PTS
/begin AXIS_PTS ldp_maf_cyl_amp_dec "" 0x10c0a maf_cyl _REC_AXS_20_u2 2047.96875 _CNV_A_R_LINEAR_____113_CM 4 0. 2047.96875 DISPLAY_IDENTIFIER LDP_MAF_CYL_AMP_DEC FORMAT "%6.2" /end AXIS_PTS
/begin AXIS_PTS ldp_maf_kgh_mes_bas "" 0x10d66 maf_kgh_mes_bas _REC_AXS_20_u2 2047.96875 _CNV_A_R_LINEAR_____113_CM 16 0. 2047.96875 DISPLAY_IDENTIFIER LDP_MAF_KGH_MES_BAS FORMAT "%7.2" /end AXIS_PTS
/begin AXIS_PTS ldpm_vo__eff_vol "" 0x082b9 vo _REC_AXS_20_u1 95.625 _CNV_A_R_LINEAR_____82_CM 12 0. 95.625 DISPLAY_IDENTIFIER LDPM_VO__EFF_VOL FORMAT "%5.2" /end AXIS_PTS
/begin AXIS_PTS ldp_n_32_ip_crlc_eff_vol_temp "" 0x01086 n_32 _REC_AXS_20_u1 8160. _CNV_A_R_LINEAR_____16_CM 6 0. 8160. DISPLAY_IDENTIFIER LDP_N_32_IP_CRLC_EFF_VOL_TEMP FORMAT "%4.0" /end AXIS_PTS
/begin AXIS_PTS ldpm_amp__eff_vol_amp "" 0x1156a amp _REC_AXS_20_u2 5434. _CNV_A_R_LINEAR_____49_CM 6 0. 5434. DISPLAY_IDENTIFIER LDPM_AMP__EFF_VOL_AMP FORMAT "%7.2" /end AXIS_PTS
/begin AXIS_PTS ldpm_n_32__eff_vol_cor "" 0x0806a n_32 _REC_AXS_20_u1 8160. _CNV_A_R_LINEAR_____16_CM 8 0. 8160. DISPLAY_IDENTIFIER LDPM_N_32__EFF_VOL_COR FORMAT "%4.0" /end AXIS_PTS
/begin AXIS_PTS ldpm_maf__eff_vol_cor "" 0x11722 maf _REC_AXS_20_u2 1389. _CNV_A_R_LINEAR_____106_CM 8 0. 1389. DISPLAY_IDENTIFIER LDPM_MAF__EFF_VOL_COR FORMAT "%7.2" /end AXIS_PTS
/begin AXIS_PTS ldpm_n__eff_vol "" 0x11912 n _REC_AXS_20_u2 8160. _CNV_A_R_LINEAR_____11_CM 18 0. 8160. DISPLAY_IDENTIFIER LDPM_N__EFF_VOL FORMAT "%4.0" /end AXIS_PTS
/begin AXIS_PTS ldpm_cam_av_mv_in__eff_vol "" 0x11586 cam_av_mv_in _REC_AXS_20_u2 1535.9765625 _CNV_A_R_LINEAR_____347_CM 12 -768. 767.9765625 DISPLAY_IDENTIFIER LDPM_CAM_AV_MV_IN__EFF_VOL FORMAT "%7.2" /end AXIS_PTS
/begin AXIS_PTS ldp_tps_seg_ar_red_thr "" 0x112ca tps_seg _REC_AXS_20_u2 119.5 _CNV_A_R_LINEAR_____53_CM 16 0. 119.5 DISPLAY_IDENTIFIER LDP_TPS_SEG_AR_RED_THR /end AXIS_PTS
/begin AXIS_PTS ldp_isapwm_mmv "" 0x10b16 isapwm_mmv _REC_AXS_20_u2 99.99847412 _CNV_A_R_LINEAR_____9_CM 16 0. 99.99847412 DISPLAY_IDENTIFIER LDP_ISAPWM_MMV /end AXIS_PTS
/begin AXIS_PTS ldp_n_32__pq_egr_sp "" 0x07c49 n_32 _REC_AXS_20_u1 816. _CNV_A_R_LINEAR_____16_CM 8 0. 8160. DISPLAY_IDENTIFIER LDP_N_32__PQ_EGR_SP FORMAT "%4.0" /end AXIS_PTS
/begin AXIS_PTS ldp_n_32__fac_maf_max_s "" 0x07bcd n_32 _REC_AXS_20_u1 816. _CNV_A_R_LINEAR_____16_CM 8 0. 8160. DISPLAY_IDENTIFIER LDP_N_32__FAC_MAF_MAX_S FORMAT "%4.0" /end AXIS_PTS
/begin AXIS_PTS ldp_mff_sp_s__fac_maf_max_s "" 0x10e54 mff_sp_s _REC_AXS_20_u2 1389. _CNV_A_R_LINEAR_____106_CM 6 0. 1389. DISPLAY_IDENTIFIER LDP_MFF_SP_S__FAC_MAF_MAX_S FORMAT "%7.2" /end AXIS_PTS
/begin AXIS_PTS ldp_maf_dif_s__eff_maf_s "" 0x10c34 maf_dif_s _REC_AXS_20_u2 1389. _CNV_A_R_LINEAR_____350_CM 16 -694.5 694.5 DISPLAY_IDENTIFIER LDP_MAF_DIF_S__EFF_MAF_S FORMAT "%7.2" /end AXIS_PTS
/begin AXIS_PTS ldp_mff_sp_s__pq_egr_sp "" 0x10e62 mff_sp_s _REC_AXS_20_u2 1389. _CNV_A_R_LINEAR_____106_CM 6 0. 1389. DISPLAY_IDENTIFIER LDP_MFF_SP_S__PQ_EGR_SP FORMAT "%7.2" /end AXIS_PTS
/begin AXIS_PTS ldp_maf_turb_ratio__maf_sp_isa "" 0x07bae maf_turb_ratio_max _REC_AXS_20_u1 3.984375 _CNV_A_R_LINEAR_____127_CM 8 0. 3.984375 DISPLAY_IDENTIFIER LDP_MAF_TURB_RATIO__MAF_SP_ISA FORMAT "%4.2" /end AXIS_PTS
/begin AXIS_PTS ldp_n__maf_sp_isa "" 0x10ea6 n _REC_AXS_20_u2 816. _CNV_A_R_LINEAR_____11_CM 6 0. 8160. DISPLAY_IDENTIFIER LDP_N__MAF_SP_ISA FORMAT "%4.0" /end AXIS_PTS
/begin AXIS_PTS ldp_n_32__crlc_maf_diag "" 0x01011 n_32 _REC_AXS_20_u1 8160. _CNV_A_R_LINEAR_____16_CM 4 0. 8160. DISPLAY_IDENTIFIER LDP_N_32__CRLC_MAF_DIAG FORMAT "%4.0" /end AXIS_PTS
/begin AXIS_PTS ldpm_pq_turb_sys "" 0x01394 n_32 _REC_AXS_20_u1 0.99610001 _CNV_A_R_LINEAR_____29_CM 6 0. 0.99610001 DISPLAY_IDENTIFIER LDPM_PQ_TURB_SYS FORMAT "%5.3" /end AXIS_PTS
/begin AXIS_PTS ldp_isapwm__fac_pq_isa "" 0x10afa isapwm _REC_AXS_20_u2 99.99847412 _CNV_A_R_LINEAR_____9_CM 4 0. 99.99847412 DISPLAY_IDENTIFIER LDP_ISAPWM__FAC_PQ_ISA /end AXIS_PTS
/begin AXIS_PTS ldp_n_32_mon__maf_sub_mon "" 0x12038 n_32_mon _REC_AXS_20_u1 8160. _CNV_A_R_LINEAR_____16_CM 8 0. 8160. DISPLAY_IDENTIFIER LDP_N_32_MON__MAF_SUB_MON FORMAT "%4.0" /end AXIS_PTS
/begin AXIS_PTS ldp_pq_turb_sys_mon__fac_pq_isa "" 0x12074 pq_turb_sys_mon _REC_AXS_20_u1 0.9960940000000002 _CNV_A_R_LINEAR_____354_CM 6 0. 0.996094 DISPLAY_IDENTIFIER LDP_PQ_TURB_SYS_MON__FAC_PQ_ISA FORMAT "%5.3" /end AXIS_PTS
/begin AXIS_PTS ldp_tps_av_mon__fac_tps_isa_mon "" 0x120b0 tps_av_mon _REC_AXS_20_u1 11.95 _CNV_A_R_LINEAR_____353_CM 6 0. 119.5 DISPLAY_IDENTIFIER LDP_TPS_AV_MON__FAC_TPS_ISA_MON FORMAT "%5.1" /end AXIS_PTS
/begin AXIS_PTS ldp_tps_av_mon__maf_sub_mon "" 0x120b7 tps_av_mon _REC_AXS_20_u1 11.95 _CNV_A_R_LINEAR_____353_CM 8 0. 119.5 DISPLAY_IDENTIFIER LDP_TPS_AV_MON__MAF_SUB_MON FORMAT "%5.1" /end AXIS_PTS
/begin AXIS_PTS ldp_amp__fac_maf_sub_cor_mon "" 0x121ea amp _REC_AXS_20_u2 5434. _CNV_A_R_LINEAR_____49_CM 6 0. 5434. DISPLAY_IDENTIFIER LDP_AMP__FAC_MAF_SUB_COR_MON FORMAT "%7.2" /end AXIS_PTS
/begin AXIS_PTS ldp_n_32_mon__pq_mon "" 0x12041 n_32_mon _REC_AXS_20_u1 816. _CNV_A_R_LINEAR_____16_CM 8 0. 8160. DISPLAY_IDENTIFIER LDP_N_32_MON__PQ_MON FORMAT "%4.0" /end AXIS_PTS
/begin AXIS_PTS ldp_tps_sum_av_mon__pq_mon "" 0x120c0 tps_sum_av_mon _REC_AXS_20_u1 119.5 _CNV_A_R_LINEAR_____353_CM 8 0. 119.5 DISPLAY_IDENTIFIER LDP_TPS_SUM_AV_MON__PQ_MON FORMAT "%5.1" /end AXIS_PTS
/begin AXIS_PTS ldp_tia__fac_maf_sub_cor_mon "Correction factor for MAF_SUB_COR_MON calculation" 0x120a9 tia _REC_AXS_20_u1 190.5 _CNV_A_R_LINEAR_____12_CM 6 -48. 142.5 DISPLAY_IDENTIFIER LDP_TIA__FAC_MAF_SUB_COR_MON FORMAT "%5.1" /end AXIS_PTS
/begin AXIS_PTS ldp_isapwm__fac_pq_isa_mon "" 0x12204 isapwm _REC_AXS_20_u2 14.999771118 _CNV_A_R_LINEAR_____9_CM 4 0. 99.99847412 DISPLAY_IDENTIFIER LDP_ISAPWM__FAC_PQ_ISA_MON /end AXIS_PTS
/begin AXIS_PTS ldp_v_map_map_mes_bas "" 0x01b9a v_map _REC_AXS_20_u2 4.5 _CNV_A_R_LINEAR_____355_CM 2 0. 5. DISPLAY_IDENTIFIER LDP_V_MAP_MAP_MES_BAS FORMAT "%5.3" /end AXIS_PTS
/begin AXIS_PTS ldp_maf__mff_cor_1 "" 0x10b9a maf _REC_AXS_20_u2 138.9 _CNV_A_R_LINEAR_____106_CM 12 0. 1389. DISPLAY_IDENTIFIER LDP_MAF__MFF_COR_1 FORMAT "%7.2" /end AXIS_PTS
/begin AXIS_PTS ldp_maf__mff_cor_2 "" 0x10bb4 maf _REC_AXS_20_u2 138.9 _CNV_A_R_LINEAR_____106_CM 12 0. 1389. DISPLAY_IDENTIFIER LDP_MAF__MFF_COR_2 FORMAT "%7.2" /end AXIS_PTS
/begin AXIS_PTS ldp_n__mff_cor_1 "" 0x10eb4 n _REC_AXS_20_u2 816. _CNV_A_R_LINEAR_____11_CM 16 0. 8160. DISPLAY_IDENTIFIER LDP_N__MFF_COR_1 FORMAT "%4.0" /end AXIS_PTS
/begin AXIS_PTS ldp_n__mff_cor_2 "" 0x10ed6 n _REC_AXS_20_u2 816. _CNV_A_R_LINEAR_____11_CM 16 0. 8160. DISPLAY_IDENTIFIER LDP_N__MFF_COR_2 FORMAT "%4.0" /end AXIS_PTS
/begin AXIS_PTS ldpm_tqi_sp_mff_s "" 0x11c72 tqi_sp_mff _REC_AXS_20_u2 1023.96875 _CNV_A_R_LINEAR_____55_CM 12 0. 1023.96875 DISPLAY_IDENTIFIER LDPM_TQI_SP_MFF_S FORMAT "%7.2" /end AXIS_PTS
/begin MEASUREMENT lv_err_mis_low_fuel "??????????????????????????????" UBYTE _CNV_S_2_RANGE______2_R_CM 1 100. 0. 255. DISPLAY_IDENTIFIER LV_ERR_MIS_LOW_FUEL ECU_ADDRESS 0x3fb9f4 /end MEASUREMENT
/begin AXIS_PTS ldp_tps_dif__mtcpwm_p "" 0x1128c tps_dif _REC_AXS_20_u2 239. _CNV_A_R_LINEAR_____359_CM 8 -119.5 119.5 DISPLAY_IDENTIFIER LDP_TPS_DIF__MTCPWM_P FORMAT "%8.3" /end AXIS_PTS
/begin AXIS_PTS ldp_tps_dif__mtcpwm_i "" 0x1127a tps_dif _REC_AXS_20_u2 239. _CNV_A_R_LINEAR_____359_CM 8 -119.5 119.5 DISPLAY_IDENTIFIER LDP_TPS_DIF__MTCPWM_I FORMAT "%8.3" /end AXIS_PTS
/begin AXIS_PTS ldp_tps_av_lih_dif_mtcpwm_i "" 0x11268 tps_av_lih_dif _REC_AXS_20_u2 239. _CNV_A_R_LINEAR_____359_CM 8 -119.5 119.5 DISPLAY_IDENTIFIER LDP_TPS_AV_LIH_DIF_MTCPWM_I FORMAT "%8.3" /end AXIS_PTS
/begin AXIS_PTS ldp_tps_dif_grd__mtcpwm_d "" 0x1129e tps_dif_grd _REC_AXS_20_u2 239. _CNV_A_R_LINEAR_____359_CM 8 -119.5 119.5 DISPLAY_IDENTIFIER LDP_TPS_DIF_GRD__MTCPWM_D FORMAT "%8.3" /end AXIS_PTS
/begin AXIS_PTS ldp_tps_sp_lih_dif__mtcpwm_add "" 0x112ec tps_sp_lih_dif _REC_AXS_20_u2 239. _CNV_A_R_LINEAR_____359_CM 8 -119.5 119.5 DISPLAY_IDENTIFIER LDP_TPS_SP_LIH_DIF__MTCPWM_ADD FORMAT "%8.3" /end AXIS_PTS
/begin AXIS_PTS ldp_vb__mtcpwm_vb_fac "" 0x07ec0 vb _REC_AXS_20_u1 25.8984 _CNV_A_R_LINEAR_____34_CM 8 0. 25.8984 DISPLAY_IDENTIFIER LDP_VB__MTCPWM_VB_FAC FORMAT "%3.1" /end AXIS_PTS
/begin MEASUREMENT seg_nr "" UBYTE _CNV_A_R_LINEAR_____1_CM 1 100. 0. 255. DISPLAY_IDENTIFIER SEG_NR ECU_ADDRESS 0x3fe083 FORMAT "%3.0" /end MEASUREMENT
/begin AXIS_PTS ldpm_n_tooth__eoi_st "" 0x11a52 n_tooth _REC_AXS_20_u2 816. _CNV_A_R_LINEAR_____11_CM 4 0. 8160. DISPLAY_IDENTIFIER LDPM_N_TOOTH__EOI_ST FORMAT "%4.0" /end AXIS_PTS
/begin AXIS_PTS ldpm_tco__eoi_tco "" 0x081c1 tco _REC_AXS_20_u1 19.05 _CNV_A_R_LINEAR_____12_CM 8 -48. 142.5 DISPLAY_IDENTIFIER LDPM_TCO__EOI_TCO FORMAT "%5.1" /end AXIS_PTS
/begin AXIS_PTS ldpm_tco_n_sp_2 "" 0x08226 tco _REC_AXS_20_u1 190.5 _CNV_A_R_LINEAR_____12_CM 8 -48. 142.5 DISPLAY_IDENTIFIER LDPM_TCO_N_SP_2 FORMAT "%5.1" /end AXIS_PTS
/begin AXIS_PTS ldpm_tco_n_sp_1 "" 0x0821d tco _REC_AXS_20_u1 190.5 _CNV_A_R_LINEAR_____12_CM 8 -48. 142.5 DISPLAY_IDENTIFIER LDPM_TCO_N_SP_1 FORMAT "%5.1" /end AXIS_PTS
/begin AXIS_PTS ldpm_t_ast_n_sp_1 "" 0x11b12 t_ast _REC_AXS_20_u2 6553.5 _CNV_A_R_LINEAR_____24_CM 8 0. 6553.5 DISPLAY_IDENTIFIER LDPM_T_AST_N_SP_1 FORMAT "%6.1" /end AXIS_PTS
/begin AXIS_PTS ldpm_ctr_km_can_n_sp_1 "" 0x115ec ctr_km_can _REC_AXS_20_u2 655350. _CNV_A_R_LINEAR_____88_CM 4 0. 655350. DISPLAY_IDENTIFIER LDPM_CTR_KM_CAN_N_SP_1 FORMAT "%7.0" /end AXIS_PTS
/begin AXIS_PTS ldpm_toil_ip_n_sp_is_cs "" 0x0827b toil _REC_AXS_20_u1 200. _CNV_A_R_LINEAR_____15_CM 8 -40. 160. DISPLAY_IDENTIFIER LDPM_TOIL_IP_N_SP_IS_CS FORMAT "%3.0" /end AXIS_PTS
/begin AXIS_PTS ldp_n_32_n_grd_thd "" 0x07c9a n_32 _REC_AXS_20_u1 8160. _CNV_A_R_LINEAR_____16_CM 8 0. 8160. DISPLAY_IDENTIFIER LDP_N_32_N_GRD_THD FORMAT "%4.0" /end AXIS_PTS
/begin AXIS_PTS ldpm_gear "" 0x07f19 gear _REC_AXS_20_u1 255. _CNV_A_R_LINEAR_____1_CM 9 0. 255. DISPLAY_IDENTIFIER LDPM_GEAR FORMAT "%3.0" /end AXIS_PTS
/begin AXIS_PTS ldp_pv_av__n_max_mtc_cur_off "" 0x010e4 pv_av _REC_AXS_20_u1 99.609375 _CNV_A_R_LINEAR_____10_CM 4 0. 99.609375 DISPLAY_IDENTIFIER LDP_PV_AV__N_MAX_MTC_CUR_OFF FORMAT "%5.2" /end AXIS_PTS
/begin AXIS_PTS ldp_toil__n_max_2 "" 0x01236 toil _REC_AXS_20_u1 200. _CNV_A_R_LINEAR_____15_CM 4 -40. 160. DISPLAY_IDENTIFIER LDP_TOIL__N_MAX_2 FORMAT "%3.0" /end AXIS_PTS
/begin AXIS_PTS ldp_toil__n_max_1 "" 0x01231 toil _REC_AXS_20_u1 200. _CNV_A_R_LINEAR_____15_CM 4 -40. 160. DISPLAY_IDENTIFIER LDP_TOIL__N_MAX_1 FORMAT "%3.0" /end AXIS_PTS
/begin MEASUREMENT lv_fmy_exit_st "" UBYTE _CNV_S_2_RANGE______5_CM 1 100. 0. 1. DISPLAY_IDENTIFIER LV_FMY_EXIT_ST ECU_ADDRESS 0x3fe1e2 BIT_MASK 0x1 /end MEASUREMENT
/begin MEASUREMENT lv_max_err_fsd_1 "" UBYTE _CNV_S_2_RANGE______2_R_CM 1 100. 0. 255. DISPLAY_IDENTIFIER LV_MAX_ERR_FSD_1 ECU_ADDRESS 0x3fe1f7 /end MEASUREMENT
/begin MEASUREMENT lv_min_err_fsd_1 "" UBYTE _CNV_S_2_RANGE______2_R_CM 1 100. 0. 255. DISPLAY_IDENTIFIER LV_MIN_ERR_FSD_1 ECU_ADDRESS 0x3fe1fa /end MEASUREMENT
/begin MEASUREMENT cycnr_st "" UWORD _CNV_A_R_LINEAR_____1_CM 1 100. 0. 65535. DISPLAY_IDENTIFIER CYCNR_ST ECU_ADDRESS 0x3fd34a BYTE_ORDER MSB_LAST FORMAT "%5.0" /end MEASUREMENT
/begin MEASUREMENT port_av "Actual value port flap" UWORD _CNV_A_R_LINEAR_____209_CM 1 100. 0. 99.99847412 DISPLAY_IDENTIFIER PORT_AV ECU_ADDRESS 0x3fd348 BYTE_ORDER MSB_LAST /end MEASUREMENT
/begin MEASUREMENT stk_av_egr "" UBYTE _CNV_A_R_LINEAR_____10_CM 1 100. 0. 99.609375 DISPLAY_IDENTIFIER STK_AV_EGR ECU_ADDRESS 0x3fe1eb /end MEASUREMENT
/begin AXIS_PTS ldpm_n_32__lam_cat "" 0x0134c n_32 _REC_AXS_20_u1 8160. _CNV_A_R_LINEAR_____16_CM 6 0. 8160. DISPLAY_IDENTIFIER LDPM_N_32__LAM_CAT FORMAT "%4.0" /end AXIS_PTS
/begin AXIS_PTS ldp_maf__o2_int_max_at "" 0x10bce maf _REC_AXS_20_u2 1389. _CNV_A_R_LINEAR_____106_CM 6 0. 1389. DISPLAY_IDENTIFIER LDP_MAF__O2_INT_MAX_AT FORMAT "%7.2" /end AXIS_PTS
/begin AXIS_PTS ldp_maf__o2_int_max_mt "" 0x10bdc maf _REC_AXS_20_u2 1389. _CNV_A_R_LINEAR_____106_CM 6 0. 1389. DISPLAY_IDENTIFIER LDP_MAF__O2_INT_MAX_MT FORMAT "%7.2" /end AXIS_PTS
/begin AXIS_PTS ldp_n_32__o2_int_max_mt "" 0x0103d n_32 _REC_AXS_20_u1 8160. _CNV_A_R_LINEAR_____16_CM 6 0. 8160. DISPLAY_IDENTIFIER LDP_N_32__O2_INT_MAX_MT FORMAT "%4.0" /end AXIS_PTS
/begin AXIS_PTS ldp_n_32__o2_int_max_at "" 0x01036 n_32 _REC_AXS_20_u1 8160. _CNV_A_R_LINEAR_____16_CM 6 0. 8160. DISPLAY_IDENTIFIER LDP_N_32__O2_INT_MAX_AT FORMAT "%4.0" /end AXIS_PTS
/begin AXIS_PTS ldp_sum_vls_cat_o2 "" 0x11148 online_dummy _REC_AXS_20_u2 4294967295. _CNV_A_R_LINEAR_____387_CM 6 0. 4294967295. DISPLAY_IDENTIFIER LDP_SUM_VLS_CAT_O2 FORMAT "%11.0" /end AXIS_PTS
/begin AXIS_PTS ldpm_vls_down "" 0x11cb8 online_dummy _REC_AXS_20_u2 4.99511719 _CNV_A_R_LINEAR_____3_CM 6 0. 4.99511719 DISPLAY_IDENTIFIER LDPM_VLS_DOWN FORMAT "%5.3" /end AXIS_PTS
/begin AXIS_PTS ldp_toil_max__stop_dec_fsd "" 0x01249 toil_max _REC_AXS_20_u1 200. _CNV_A_R_LINEAR_____15_CM 4 -40. 160. DISPLAY_IDENTIFIER LDP_TOIL_MAX__STOP_DEC_FSD FORMAT "%3.0" /end AXIS_PTS
/begin AXIS_PTS ldp_tco_st__stop_inc_fsd "" 0x0119d tco_st _REC_AXS_20_u1 190.5 _CNV_A_R_LINEAR_____12_CM 4 -48. 142.5 DISPLAY_IDENTIFIER LDP_TCO_ST__STOP_INC_FSD FORMAT "%5.1" /end AXIS_PTS
/begin AXIS_PTS ldpm_maf_kgh_1_t_vls_cycnr "" 0x117c8 maf_kgh _REC_AXS_20_u2 2047.96875 _CNV_A_R_LINEAR_____113_CM 6 0. 2047.96875 DISPLAY_IDENTIFIER LDPM_MAF_KGH_1_T_VLS_CYCNR FORMAT "%7.2" /end AXIS_PTS
/begin AXIS_PTS ldpm_n_32_1_t_vls_cyc "" 0x01329 n_32 _REC_AXS_20_u1 8160. _CNV_A_R_LINEAR_____16_CM 6 0. 8160. DISPLAY_IDENTIFIER LDPM_N_32_1_T_VLS_CYC FORMAT "%4.0" /end AXIS_PTS
/begin AXIS_PTS ldpm_maf_2_t_vls_cyc "" 0x11714 maf _REC_AXS_20_u2 1389. _CNV_A_R_LINEAR_____106_CM 6 0. 1389. DISPLAY_IDENTIFIER LDPM_MAF_2_T_VLS_CYC FORMAT "%7.2" /end AXIS_PTS
/begin AXIS_PTS ldp_maf_kgh__vls_down_max_cycnr "" 0x10cf8 maf_kgh _REC_AXS_20_u2 2047.96875 _CNV_A_R_LINEAR_____113_CM 8 0. 2047.96875 DISPLAY_IDENTIFIER LDP_MAF_KGH__VLS_DOWN_MAX_CYCNR FORMAT "%7.2" /end AXIS_PTS
/begin MEASUREMENT lv_inh_diag_ls_down_1 "" UBYTE _CNV_S_2_RANGE______0_CM 1 100. 0. 1. DISPLAY_IDENTIFIER LV_INH_DIAG_LS_DOWN_1 ECU_ADDRESS 0x3fe4e0 /end MEASUREMENT
/begin MEASUREMENT lv_inh_diag_ls_down_2 "" UBYTE _CNV_S_2_RANGE______0_CM 1 100. 0. 1. DISPLAY_IDENTIFIER LV_INH_DIAG_LS_DOWN_2 ECU_ADDRESS 0x3fe4e1 /end MEASUREMENT
/begin AXIS_PTS ldp_maf_kgh__fac_maf_lsh_down "" 0x10cd2 maf_kgh _REC_AXS_20_u2 2047.96875 _CNV_A_R_LINEAR_____113_CM 6 0. 2047.96875 DISPLAY_IDENTIFIER LDP_MAF_KGH__FAC_MAF_LSH_DOWN FORMAT "%7.2" /end AXIS_PTS
/begin AXIS_PTS ldp_ttip_ref_ls_down_ip_fac_teg "" 0x113f2 online_dummy _REC_AXS_20_u2 2047. _CNV_A_R_LINEAR_____7_CM 8 0. 2047. DISPLAY_IDENTIFIER LDP_TTIP_REF_LS_DOWN_IP_FAC_TEG FORMAT "%7.2" /end AXIS_PTS
/begin AXIS_PTS ldp_r_up_mdl_sens_new_r_thd "" 0x11134 online_dummy _REC_AXS_20_u2 65535. _CNV_A_R_LINEAR_____279_CM 4 0. 65535. DISPLAY_IDENTIFIER LDP_R_UP_MDL_SENS_NEW_R_THD FORMAT "%5.0" /end AXIS_PTS
/begin AXIS_PTS ldp_maf_kgh__fac_maf_lsh_up "" 0x10ce0 maf_kgh _REC_AXS_20_u2 2047.96875 _CNV_A_R_LINEAR_____113_CM 6 0. 2047.96875 DISPLAY_IDENTIFIER LDP_MAF_KGH__FAC_MAF_LSH_UP FORMAT "%7.2" /end AXIS_PTS
/begin AXIS_PTS ldp_ttip_ref_ls_up_ip_fac_teg "" 0x11416 online_dummy _REC_AXS_20_u2 2047. _CNV_A_R_LINEAR_____7_CM 8 0. 2047. DISPLAY_IDENTIFIER LDP_TTIP_REF_LS_UP_IP_FAC_TEG FORMAT "%7.2" /end AXIS_PTS
/begin AXIS_PTS ldpm_ar_red_tot_bas "" 0x11578 ar_red_tot_bas _REC_AXS_20_u2 58.592855 _CNV_A_R_LINEAR_____333_CM 6 0. 58.592855 DISPLAY_IDENTIFIER LDPM_AR_RED_TOT_BAS FORMAT "%7.4" /end AXIS_PTS
/begin AXIS_PTS ldp_opg_rel_st_ip_opg_sp_st_isa "" 0x11046 opg_rel_st _REC_AXS_20_u2 99.99847412 _CNV_A_R_LINEAR_____9_CM 12 0. 99.99847412 DISPLAY_IDENTIFIER LDP_OPG_REL_ST_IP_OPG_SP_ST_ISA /end AXIS_PTS
/begin AXIS_PTS ldp_amp_ip_fac_amp_opg_st_isa "" 0x108b4 amp _REC_AXS_20_u2 5434. _CNV_A_R_LINEAR_____49_CM 6 0. 5434. DISPLAY_IDENTIFIER LDP_AMP_IP_FAC_AMP_OPG_ST_ISA FORMAT "%7.2" /end AXIS_PTS
/begin AXIS_PTS ldp_tia_ip_fac_tia_opg_st_isa "" 0x01212 tia _REC_AXS_20_u1 190.5 _CNV_A_R_LINEAR_____12_CM 6 -48. 142.5 DISPLAY_IDENTIFIER LDP_TIA_IP_FAC_TIA_OPG_ST_ISA FORMAT "%5.1" /end AXIS_PTS
/begin AXIS_PTS ldp_pv_av_ip_opg_rel_st_isa_pv "" 0x010f0 pv_av _REC_AXS_20_u1 99.609375 _CNV_A_R_LINEAR_____10_CM 6 0. 99.609375 DISPLAY_IDENTIFIER LDP_PV_AV_IP_OPG_REL_ST_ISA_PV FORMAT "%4.1" /end AXIS_PTS
/begin AXIS_PTS ldp_n_32__pv_lih_max "" 0x01044 n_32 _REC_AXS_20_u1 816. _CNV_A_R_LINEAR_____16_CM 6 0. 8160. DISPLAY_IDENTIFIER LDP_N_32__PV_LIH_MAX FORMAT "%4.0" /end AXIS_PTS
/begin AXIS_PTS ldpm_vs_fil__pv_fac_cor "" 0x11ce6 vs_fil _REC_AXS_20_u2 51.199218 _CNV_A_R_LINEAR_____394_CM 8 0. 511.99218 DISPLAY_IDENTIFIER LDPM_VS_FIL__PV_FAC_COR FORMAT "%7.3" /end AXIS_PTS
/begin AXIS_PTS ldpm_n_dif__pv_fac_cor "" 0x11946 n_dif _REC_AXS_20_u2 6553.5 _CNV_A_R_LINEAR_____206_CM 6 -32768. 32767. DISPLAY_IDENTIFIER LDPM_N_DIF__PV_FAC_COR FORMAT "%6.0" /end AXIS_PTS
/begin AXIS_PTS ldpm_n__pv_fac_cor "" 0x11938 n _REC_AXS_20_u2 815.9 _CNV_A_R_LINEAR_____11_CM 6 1. 8160. DISPLAY_IDENTIFIER LDPM_N__PV_FAC_COR FORMAT "%4.0" /end AXIS_PTS
/begin AXIS_PTS ldpm_pv_av_raw__pv_fac_cor "" 0x0139b pv_av_raw _REC_AXS_20_u1 9.9609375 _CNV_A_R_LINEAR_____10_CM 6 0. 99.609375 DISPLAY_IDENTIFIER LDPM_PV_AV_RAW__PV_FAC_COR FORMAT "%4.1" /end AXIS_PTS
/begin AXIS_PTS ldpm_n_32__fac_tq_req_driv "" 0x08073 n_32 _REC_AXS_20_u1 8160. _CNV_A_R_LINEAR_____16_CM 8 0. 8160. DISPLAY_IDENTIFIER LDPM_N_32__FAC_TQ_REQ_DRIV FORMAT "%4.0" /end AXIS_PTS
/begin AXIS_PTS ldpm_fac_tq_cru_dcc "" 0x11652 fac_tq_req_cru _REC_AXS_20_u2 1.99996948 _CNV_A_R_LINEAR_____21_CM 8 0. 1.99996948 DISPLAY_IDENTIFIER LDPM_FAC_TQ_CRU_DCC FORMAT "%7.5" /end AXIS_PTS
/begin AXIS_PTS ldp_v_pvs_min "" 0x01ba0 online_dummy _REC_AXS_20_u2 4.99511719 _CNV_A_R_LINEAR_____3_CM 2 0. 4.99511719 DISPLAY_IDENTIFIER LDP_V_PVS_MIN FORMAT "%5.3" /end AXIS_PTS
/begin AXIS_PTS ldp_pv_av_min_mon_ip_pv_mon "" 0x12084 pv_av_mon _REC_AXS_20_u1 99.609375 _CNV_A_R_LINEAR_____10_CM 6 0. 99.609375 DISPLAY_IDENTIFIER LDP_PV_AV_MIN_MON_IP_PV_MON FORMAT "%4.1" /end AXIS_PTS
/begin AXIS_PTS ldpm_tco_st_1_sair "" 0x08241 tco_st _REC_AXS_20_u1 190.5 _CNV_A_R_LINEAR_____12_CM 8 -48. 142.5 DISPLAY_IDENTIFIER LDPM_TCO_ST_1_SAIR FORMAT "%5.1" /end AXIS_PTS
/begin AXIS_PTS ldpm_n_32_maf_sa_deac "" 0x0810a n_32 _REC_AXS_20_u1 8160. _CNV_A_R_LINEAR_____16_CM 8 0. 8160. DISPLAY_IDENTIFIER LDPM_N_32_MAF_SA_DEAC FORMAT "%4.0" /end AXIS_PTS
/begin AXIS_PTS ldpm_n_32_maf_sa_act "" 0x08101 n_32 _REC_AXS_20_u1 8160. _CNV_A_R_LINEAR_____16_CM 8 0. 8160. DISPLAY_IDENTIFIER LDPM_N_32_MAF_SA_ACT FORMAT "%4.0" /end AXIS_PTS
/begin AXIS_PTS ldp_ctr_km_can "" 0x109e2 ctr_km_can _REC_AXS_20_u2 655350. _CNV_A_R_LINEAR_____88_CM 8 0. 655350. DISPLAY_IDENTIFIER LDP_CTR_KM_CAN FORMAT "%7.0" /end AXIS_PTS
/begin AXIS_PTS ldp_tco_st_id_t_dly_diag_sa "" 0x07e27 tco_st _REC_AXS_20_u1 190.5 _CNV_A_R_LINEAR_____12_CM 8 -48. 142.5 DISPLAY_IDENTIFIER LDP_TCO_ST_ID_T_DLY_DIAG_SA FORMAT "%5.1" /end AXIS_PTS
/begin AXIS_PTS ldp_tia_id_tco_min_diag_sa "" 0x01204 tia _REC_AXS_20_u1 190.5 _CNV_A_R_LINEAR_____12_CM 6 -48. 142.5 DISPLAY_IDENTIFIER LDP_TIA_ID_TCO_MIN_DIAG_SA FORMAT "%5.1" /end AXIS_PTS
/begin AXIS_PTS ldpm_fac_amp "" 0x11644 fac_amp _REC_AXS_20_u2 1.99996948 _CNV_A_R_LINEAR_____21_CM 6 0. 1.99996948 DISPLAY_IDENTIFIER LDPM_FAC_AMP FORMAT "%7.5" /end AXIS_PTS
/begin AXIS_PTS ldp_n_32__maf_max_diag_sa "" 0x07c2f n_32 _REC_AXS_20_u1 816. _CNV_A_R_LINEAR_____16_CM 8 0. 8160. DISPLAY_IDENTIFIER LDP_N_32__MAF_MAX_DIAG_SA FORMAT "%4.0" /end AXIS_PTS
/begin AXIS_PTS ldpm_n_32_id_saf_kgh_diag_min "" 0x080de n_32 _REC_AXS_20_u1 8160. _CNV_A_R_LINEAR_____16_CM 8 0. 8160. DISPLAY_IDENTIFIER LDPM_N_32_ID_SAF_KGH_DIAG_MIN FORMAT "%4.0" /end AXIS_PTS
/begin AXIS_PTS ldpm_n_32_id_saf_kgh_diag_max "" 0x080d5 n_32 _REC_AXS_20_u1 8160. _CNV_A_R_LINEAR_____16_CM 8 0. 8160. DISPLAY_IDENTIFIER LDPM_N_32_ID_SAF_KGH_DIAG_MAX FORMAT "%4.0" /end AXIS_PTS
/begin AXIS_PTS ldpm_maf_id_saf_kgh_diag_min "" 0x07fba maf _REC_AXS_20_u1 1389. _CNV_A_R_LINEAR_____27_CM 8 0. 1389. DISPLAY_IDENTIFIER LDPM_MAF_ID_SAF_KGH_DIAG_MIN FORMAT "%4.0" /end AXIS_PTS
/begin AXIS_PTS ldpm_maf_id_saf_kgh_diag_max "" 0x07fb1 maf _REC_AXS_20_u1 1389. _CNV_A_R_LINEAR_____27_CM 8 0. 1389. DISPLAY_IDENTIFIER LDPM_MAF_ID_SAF_KGH_DIAG_MAX FORMAT "%4.0" /end AXIS_PTS
/begin AXIS_PTS ldp_tco_st_id_sum_safm_diag "" 0x07e1e tco_st _REC_AXS_20_u1 190.5 _CNV_A_R_LINEAR_____12_CM 8 -48. 142.5 DISPLAY_IDENTIFIER LDP_TCO_ST_ID_SUM_SAFM_DIAG FORMAT "%5.1" /end AXIS_PTS
/begin AXIS_PTS ldp_maf_cyl__saf_mdl "secondary air mass flow depending of MAF_CYL" 0x10bf8 maf_cyl _REC_AXS_20_u2 2047.96875 _CNV_A_R_LINEAR_____113_CM 8 0. 2047.96875 DISPLAY_IDENTIFIER LDP_MAF_CYL__SAF_MDL FORMAT "%7.2" /end AXIS_PTS
/begin AXIS_PTS ldp_amp__saf_cor_amp "correction of secondary air mass flow depending of ambient pressure" 0x1088a amp _REC_AXS_20_u2 5434. _CNV_A_R_LINEAR_____49_CM 8 0. 5434. DISPLAY_IDENTIFIER LDP_AMP__SAF_COR_AMP FORMAT "%7.2" /end AXIS_PTS
/begin AXIS_PTS ldp_vb__saf_cor_vb "correction of secondary air mass flow depending of battery voltage" 0x07ec9 vb _REC_AXS_20_u1 26. _CNV_A_R_LINEAR_____60_CM 8 0. 26. DISPLAY_IDENTIFIER LDP_VB__SAF_COR_VB FORMAT "%4.1" /end AXIS_PTS
/begin AXIS_PTS ldp_tam_ip_saf_cor_tam "correction of secondary air mass flow depending of ambient temperature" 0x07d68 tia _REC_AXS_20_u1 190.5 _CNV_A_R_LINEAR_____12_CM 8 -48. 142.5 DISPLAY_IDENTIFIER LDP_TAM_IP_SAF_COR_TAM FORMAT "%5.1" /end AXIS_PTS
/begin AXIS_PTS ldp_maf_kgh__tco_sub_inc "" 0x10cee maf_kgh _REC_AXS_20_u2 2047.96875 _CNV_A_R_LINEAR_____113_CM 4 0. 2047.96875 DISPLAY_IDENTIFIER LDP_MAF_KGH__TCO_SUB_INC FORMAT "%7.2" /end AXIS_PTS
/begin AXIS_PTS ldp_v_tco__tco "" 0x1145e online_dummy _REC_AXS_20_u2 4.425292971 _CNV_A_R_LINEAR_____412_CM 16 7.8125e-002 4.99511719 DISPLAY_IDENTIFIER LDP_V_TCO__TCO FORMAT "%5.3" /end AXIS_PTS
/begin AXIS_PTS ldpm_tco_st__tco_dif_diag "" 0x013f2 tco_st _REC_AXS_20_u1 190.5 _CNV_A_R_LINEAR_____12_CM 6 -48. 142.5 DISPLAY_IDENTIFIER LDPM_TCO_ST__TCO_DIF_DIAG FORMAT "%5.1" /end AXIS_PTS
/begin AXIS_PTS ldp_tco_st_id_t_tco_min "Locking time after start for lambda activation monitoring" 0x011b0 tco_st _REC_AXS_20_u1 190.5 _CNV_A_R_LINEAR_____12_CM 6 -48. 142.5 DISPLAY_IDENTIFIER LDP_TCO_ST_ID_T_TCO_MIN FORMAT "%5.1" /end AXIS_PTS
/begin AXIS_PTS ldpm_tia_1 "" 0x0140e tia _REC_AXS_20_u1 190.5 _CNV_A_R_LINEAR_____12_CM 6 -48. 142.5 DISPLAY_IDENTIFIER LDPM_TIA_1 FORMAT "%5.1" /end AXIS_PTS
/begin AXIS_PTS ldp_vs_fil__tq_gs_inc "" 0x1153c vs_fil _REC_AXS_20_u2 511.99218 _CNV_A_R_LINEAR_____85_CM 6 0. 511.99218 DISPLAY_IDENTIFIER LDP_VS_FIL__TQ_GS_INC FORMAT "%7.3" /end AXIS_PTS
/begin AXIS_PTS ldp_n_32__tq_gs_inc "" 0x01065 n_32 _REC_AXS_20_u1 8160. _CNV_A_R_LINEAR_____16_CM 6 0. 8160. DISPLAY_IDENTIFIER LDP_N_32__TQ_GS_INC FORMAT "%4.0" /end AXIS_PTS
/begin AXIS_PTS ldp_v_tecu__tecu "" 0x11480 v_tecu _REC_AXS_20_u2 4.495605471 _CNV_A_R_LINEAR_____3_CM 16 0. 4.99511719 DISPLAY_IDENTIFIER LDP_V_TECU__TECU FORMAT "%5.3" /end AXIS_PTS
/begin AXIS_PTS ldp_v_teg__teg "" 0x114a2 online_dummy _REC_AXS_20_u2 4.99511719 _CNV_A_R_LINEAR_____3_CM 16 0. 4.99511719 DISPLAY_IDENTIFIER LDP_V_TEG__TEG FORMAT "%5.3" /end AXIS_PTS
/begin AXIS_PTS ldpm_teg_stat_eng_pre "" 0x11bb4 online_dummy _REC_AXS_20_u2 1507.3 _CNV_A_R_LINEAR_____262_CM 6 -48. 1459.3 DISPLAY_IDENTIFIER LDPM_TEG_STAT_ENG_PRE FORMAT "%7.2" /end AXIS_PTS
/begin AXIS_PTS ldpm_egr_ratio__teg "" 0x11636 egr_ratio _REC_AXS_20_u2 99.99847412 _CNV_A_R_LINEAR_____9_CM 6 0. 99.99847412 DISPLAY_IDENTIFIER LDPM_EGR_RATIO__TEG /end AXIS_PTS
/begin AXIS_PTS ldpm_temp_toil_dif__fac_temp "" 0x11c5a temp_toil_dif _REC_AXS_20_u2 404. _CNV_A_R_LINEAR_____422_CM 6 -202. 202. DISPLAY_IDENTIFIER LDPM_TEMP_TOIL_DIF__FAC_TEMP FORMAT "%6.1" /end AXIS_PTS
/begin AXIS_PTS ldpm_lamb_sp_teg__fac_cor "" 0x11680 teg_1.appl_inc_struct.lamb_sp_teg _REC_AXS_20_u2 31.99902344 _CNV_A_R_LINEAR_____164_CM 16 0. 31.99902344 DISPLAY_IDENTIFIER LDPM_LAMB_SP_TEG__FAC_COR FORMAT "%7.4" /end AXIS_PTS
/begin AXIS_PTS ldpm_nr_cyl_scc_teg__fac_scc "" 0x0815c teg_1.appl_inc_struct.nr_cyl_scc_teg _REC_AXS_20_u1 13. _CNV_A_R_LINEAR_____388_CM 14 0. 13. DISPLAY_IDENTIFIER LDPM_NR_CYL_SCC_TEG__FAC_SCC FORMAT "%4.1" /end AXIS_PTS
/begin AXIS_PTS ldpm_ecfpwm_ecf__fac_cor "" 0x012dd ecfpwm_ecf _REC_AXS_20_u1 99.609375 _CNV_A_R_LINEAR_____10_CM 6 0. 99.609375 DISPLAY_IDENTIFIER LDPM_ECFPWM_ECF__FAC_COR FORMAT "%4.1" /end AXIS_PTS
/begin AXIS_PTS ldp_teg_stat__fac_tam "" 0x111ee online_dummy _REC_AXS_20_u2 1507.3 _CNV_A_R_LINEAR_____262_CM 6 -48. 1459.3 DISPLAY_IDENTIFIER LDP_TEG_STAT__FAC_TAM FORMAT "%7.2" /end AXIS_PTS
/begin AXIS_PTS ldpm_tam_dew__fac_teg "" 0x013a8 tam_dew _REC_AXS_20_u1 190.5 _CNV_A_R_LINEAR_____12_CM 6 -48. 142.5 DISPLAY_IDENTIFIER LDPM_TAM_DEW__FAC_TEG FORMAT "%5.1" /end AXIS_PTS
/begin AXIS_PTS ldpm_t_es_dew__fac_teg "" 0x11b24 t_es_dew _REC_AXS_20_u2 65535. _CNV_A_R_LINEAR_____97_CM 8 0. 65535. DISPLAY_IDENTIFIER LDPM_T_ES_DEW__FAC_TEG FORMAT "%5.0" /end AXIS_PTS
/begin AXIS_PTS ldpm_temp_toil_dif__crlc_teg "" 0x11c48 temp_toil_dif _REC_AXS_20_u2 404. _CNV_A_R_LINEAR_____422_CM 8 -202. 202. DISPLAY_IDENTIFIER LDPM_TEMP_TOIL_DIF__CRLC_TEG FORMAT "%6.1" /end AXIS_PTS
/begin AXIS_PTS ldpm_temp_tco_dif__crlc_teg "" 0x11c36 temp_tco_dif _REC_AXS_20_u2 404. _CNV_A_R_LINEAR_____423_CM 8 -202. 202. DISPLAY_IDENTIFIER LDPM_TEMP_TCO_DIF__CRLC_TEG FORMAT "%6.1" /end AXIS_PTS
/begin AXIS_PTS ldpm_maf_int_puc__crlc_teg "" 0x11774 online_dummy _REC_AXS_20_u2 1820.398 _CNV_A_R_LINEAR_____271_CM 8 0. 1820.398 DISPLAY_IDENTIFIER LDPM_MAF_INT_PUC__CRLC_TEG FORMAT "%7.2" /end AXIS_PTS
/begin AXIS_PTS ldpm_n_teg__vs_teg "" 0x11a40 n_teg _REC_AXS_20_u2 8160. _CNV_A_R_LINEAR_____11_CM 8 0. 8160. DISPLAY_IDENTIFIER LDPM_N_TEG__VS_TEG FORMAT "%4.0" /end AXIS_PTS
/begin AXIS_PTS ldpm_tco_st__dew "" 0x08253 tco_st _REC_AXS_20_u1 190.5 _CNV_A_R_LINEAR_____12_CM 8 -48. 142.5 DISPLAY_IDENTIFIER LDPM_TCO_ST__DEW FORMAT "%5.1" /end AXIS_PTS
/begin AXIS_PTS ldpm_teg_wall_cat_up_mdl_1 "" 0x11bd4 online_dummy _REC_AXS_20_u2 1507.3 _CNV_A_R_LINEAR_____262_CM 8 -48. 1459.3 DISPLAY_IDENTIFIER LDPM_TEG_WALL_CAT_UP_MDL_1 FORMAT "%7.2" /end AXIS_PTS
/begin AXIS_PTS ldpm_teg_wall_cat_down_mdl_1 "" 0x11bc2 online_dummy _REC_AXS_20_u2 1507.3 _CNV_A_R_LINEAR_____262_CM 8 -48. 1459.3 DISPLAY_IDENTIFIER LDPM_TEG_WALL_CAT_DOWN_MDL_1 FORMAT "%7.2" /end AXIS_PTS
/begin AXIS_PTS ldp_vs__fac_vs_teg "" 0x01286 vs _REC_AXS_20_u1 255. _CNV_A_R_LINEAR_____23_CM 6 0. 255. DISPLAY_IDENTIFIER LDP_VS__FAC_VS_TEG FORMAT "%3.0" /end AXIS_PTS
/begin AXIS_PTS ldp_pow_dif_max__add_teg_iga "" 0x11072 pow_dif_max _REC_AXS_20_u2 434.0555000000001 _CNV_A_R_LINEAR_____425_CM 6 0. 434.0555 DISPLAY_IDENTIFIER LDP_POW_DIF_MAX__ADD_TEG_IGA FORMAT "%7.3" /end AXIS_PTS
/begin AXIS_PTS ldpm_vo_dif_teg__teg_stat "" 0x11cc6 vo_dif_teg _REC_AXS_20_u2 191.25 _CNV_A_R_LINEAR_____426_CM 6 -95.625 95.625 DISPLAY_IDENTIFIER LDPM_VO_DIF_TEG__TEG_STAT FORMAT "%5.1" /end AXIS_PTS
/begin AXIS_PTS ldpm_eff_iga_av_teg_cor "" 0x1161a online_dummy _REC_AXS_20_u2 1.99996948 _CNV_A_R_LINEAR_____21_CM 8 0. 1.99996948 DISPLAY_IDENTIFIER LDPM_EFF_IGA_AV_TEG_COR FORMAT "%7.5" /end AXIS_PTS
/begin AXIS_PTS ldpm_teg_stat__crlc_dec "" 0x11b80 online_dummy _REC_AXS_20_u2 1507.3 _CNV_A_R_LINEAR_____262_CM 12 -48. 1459.3 DISPLAY_IDENTIFIER LDPM_TEG_STAT__CRLC_DEC FORMAT "%7.2" /end AXIS_PTS
/begin AXIS_PTS ldpm_teg_wall_stat__crlc_dec "" 0x11be6 online_dummy _REC_AXS_20_u2 1507.3 _CNV_A_R_LINEAR_____262_CM 12 -48. 1459.3 DISPLAY_IDENTIFIER LDPM_TEG_WALL_STAT__CRLC_DEC FORMAT "%7.2" /end AXIS_PTS
/begin AXIS_PTS ldpm_teg_stat__crlc_inc "" 0x11b9a online_dummy _REC_AXS_20_u2 1507.3 _CNV_A_R_LINEAR_____262_CM 12 -48. 1459.3 DISPLAY_IDENTIFIER LDPM_TEG_STAT__CRLC_INC FORMAT "%7.2" /end AXIS_PTS
/begin AXIS_PTS ldpm_teg_wall_stat__crlc_inc "" 0x11c00 online_dummy _REC_AXS_20_u2 1507.3 _CNV_A_R_LINEAR_____262_CM 12 -48. 1459.3 DISPLAY_IDENTIFIER LDPM_TEG_WALL_STAT__CRLC_INC FORMAT "%7.2" /end AXIS_PTS
/begin AXIS_PTS ldpm_maf_teg__vs_teg "" 0x11800 maf_teg _REC_AXS_20_u2 1389. _CNV_A_R_LINEAR_____106_CM 8 0. 1389. DISPLAY_IDENTIFIER LDPM_MAF_TEG__VS_TEG FORMAT "%7.2" /end AXIS_PTS
/begin AXIS_PTS ldpm_vs__fac_cor_vs_teg_ecf "" 0x0142a vs _REC_AXS_20_u1 255. _CNV_A_R_LINEAR_____23_CM 6 0. 255. DISPLAY_IDENTIFIER LDPM_VS__FAC_COR_VS_TEG_ECF FORMAT "%3.0" /end AXIS_PTS
/begin AXIS_PTS ldpm_vs_cor_teg__fac_cor "" 0x01431 online_dummy _REC_AXS_20_u1 255. _CNV_A_R_LINEAR_____23_CM 6 0. 255. DISPLAY_IDENTIFIER LDPM_VS_COR_TEG__FAC_COR FORMAT "%3.0" /end AXIS_PTS
/begin AXIS_PTS ldp_vs_cor_teg_up_1__fac_cor "" 0x01293 teg_1.gas_up_struct.vs_cor_teg_up _REC_AXS_20_u1 255. _CNV_A_R_LINEAR_____23_CM 6 0. 255. DISPLAY_IDENTIFIER LDP_VS_COR_TEG_UP_1__FAC_COR FORMAT "%3.0" /end AXIS_PTS
/begin AXIS_PTS ldpm_vs__fac_cor_vs_teg "" 0x01423 vs _REC_AXS_20_u1 255. _CNV_A_R_LINEAR_____23_CM 6 0. 255. DISPLAY_IDENTIFIER LDPM_VS__FAC_COR_VS_TEG FORMAT "%3.0" /end AXIS_PTS
/begin AXIS_PTS ldpm_maf_teg__teg_stat "" 0x117ee maf_teg _REC_AXS_20_u2 1389. _CNV_A_R_LINEAR_____106_CM 8 0. 1389. DISPLAY_IDENTIFIER LDPM_MAF_TEG__TEG_STAT FORMAT "%7.2" /end AXIS_PTS
/begin AXIS_PTS ldpm_n_teg__teg_stat "" 0x11a2e n_teg _REC_AXS_20_u2 8160. _CNV_A_R_LINEAR_____11_CM 8 0. 8160. DISPLAY_IDENTIFIER LDPM_N_TEG__TEG_STAT FORMAT "%4.0" /end AXIS_PTS
/begin AXIS_PTS ldpm_saf_kgh__fac_cor_saf "" 0x11ace saf_kgh _REC_AXS_20_u2 1023.984375 _CNV_A_R_LINEAR_____47_CM 6 0. 1023.984375 DISPLAY_IDENTIFIER LDPM_SAF_KGH__FAC_COR_SAF FORMAT "%7.2" /end AXIS_PTS
/begin AXIS_PTS ldpm_tco__fac_cor_tco_teg "" 0x013c7 tco _REC_AXS_20_u1 190.5 _CNV_A_R_LINEAR_____12_CM 6 -48. 142.5 DISPLAY_IDENTIFIER LDPM_TCO__FAC_COR_TCO_TEG FORMAT "%5.1" /end AXIS_PTS
/begin AXIS_PTS ldpm_tco__tco_eff_iga_teg "" 0x013da tco _REC_AXS_20_u1 190.5 _CNV_A_R_LINEAR_____12_CM 6 -48. 142.5 DISPLAY_IDENTIFIER LDPM_TCO__TCO_EFF_IGA_TEG FORMAT "%5.1" /end AXIS_PTS
/begin AXIS_PTS ldpm_n_teg__crlc_teg "" 0x11a1c n_teg _REC_AXS_20_u2 8160. _CNV_A_R_LINEAR_____11_CM 8 0. 8160. DISPLAY_IDENTIFIER LDPM_N_TEG__CRLC_TEG FORMAT "%4.0" /end AXIS_PTS
/begin AXIS_PTS ldp_maf_kgh_sp__amp_dec "" 0x10d88 maf_kgh_sp _REC_AXS_20_u2 2047.96875 _CNV_A_R_LINEAR_____113_CM 4 0. 2047.96875 DISPLAY_IDENTIFIER LDP_MAF_KGH_SP__AMP_DEC FORMAT "%6.2" /end AXIS_PTS
/begin AXIS_PTS ldp_maf_sp__tps_sp_mdl_max "" 0x10dae maf_sp _REC_AXS_20_u2 1389. _CNV_A_R_LINEAR_____106_CM 4 0. 1389. DISPLAY_IDENTIFIER LDP_MAF_SP__TPS_SP_MDL_MAX FORMAT "%7.2" /end AXIS_PTS
/begin AXIS_PTS ldp_n_32__tps_sp_mdl_max "" 0x07c5b n_32 _REC_AXS_20_u1 816. _CNV_A_R_LINEAR_____16_CM 8 0. 8160. DISPLAY_IDENTIFIER LDP_N_32__TPS_SP_MDL_MAX FORMAT "%4.0" /end AXIS_PTS
/begin AXIS_PTS ldp_pq_sp__crlc_ar_red_sp "" 0x110d0 pq_sp _REC_AXS_20_u2 0.99998474 _CNV_A_R_LINEAR_____37_CM 8 0. 0.99998474 DISPLAY_IDENTIFIER LDP_PQ_SP__CRLC_AR_RED_SP FORMAT "%7.5" /end AXIS_PTS
/begin AXIS_PTS ldp_pq_sp_isa "" 0x110e2 pq_sp_isa _REC_AXS_20_u2 0.99998474 _CNV_A_R_LINEAR_____37_CM 8 0. 0.99998474 DISPLAY_IDENTIFIER LDP_PQ_SP_ISA FORMAT "%7.5" /end AXIS_PTS
/begin AXIS_PTS ldp_ar_red_isa_sp_mmv "" 0x10948 ar_red_isa_sp_mmv _REC_AXS_20_u2 58.592855 _CNV_A_R_LINEAR_____333_CM 16 0. 58.592855 DISPLAY_IDENTIFIER LDP_AR_RED_ISA_SP_MMV FORMAT "%7.4" /end AXIS_PTS
/begin AXIS_PTS ldp_maf_turb_ratio "" 0x07ba5 maf_turb_ratio _REC_AXS_20_u1 0.99610001 _CNV_A_R_LINEAR_____29_CM 8 0. 0.99610001 DISPLAY_IDENTIFIER LDP_MAF_TURB_RATIO FORMAT "%5.3" /end AXIS_PTS
/begin AXIS_PTS ldpm_vb_1 "" 0x0829e vb _REC_AXS_20_u1 25.8984 _CNV_A_R_LINEAR_____34_CM 8 0. 25.8984 DISPLAY_IDENTIFIER LDPM_VB_1 FORMAT "%3.1" /end AXIS_PTS
/begin AXIS_PTS ldp_n_32__isapwm_isa_pwl "" 0x01031 n_32 _REC_AXS_20_u1 8160. _CNV_A_R_LINEAR_____16_CM 4 0. 8160. DISPLAY_IDENTIFIER LDP_N_32__ISAPWM_ISA_PWL FORMAT "%4.0" /end AXIS_PTS
/begin AXIS_PTS ldp_isapwm_cor_isa__isapwm_isa "" 0x10b04 isapwm_cor_isa _REC_AXS_20_u2 99.99847412 _CNV_A_R_LINEAR_____9_CM 8 0. 99.99847412 DISPLAY_IDENTIFIER LDP_ISAPWM_COR_ISA__ISAPWM_ISA /end AXIS_PTS
/begin AXIS_PTS ldp_ar_red_sp_mmv "" 0x1096a ar_red_sp_mmv _REC_AXS_20_u2 58.592855 _CNV_A_R_LINEAR_____333_CM 16 0. 58.592855 DISPLAY_IDENTIFIER LDP_AR_RED_SP_MMV FORMAT "%7.4" /end AXIS_PTS
/begin AXIS_PTS ldp_n_ip_fac_maf_dif_sp "" 0x10f64 n _REC_AXS_20_u2 8160. _CNV_A_R_LINEAR_____11_CM 8 0. 8160. DISPLAY_IDENTIFIER LDP_N_IP_FAC_MAF_DIF_SP FORMAT "%4.0" /end AXIS_PTS
/begin AXIS_PTS ldp_maf_dif_sp_cor_ip_maf_add "" 0x10c56 online_dummy _REC_AXS_20_u2 16383.75 _CNV_A_R_LINEAR_____435_CM 8 -8192. 8191.75 DISPLAY_IDENTIFIER LDP_MAF_DIF_SP_COR_IP_MAF_ADD FORMAT "%8.2" /end AXIS_PTS
/begin AXIS_PTS ldp_pq_sp_wout_maf_add_ip_fac "" 0x110f4 pq_sp_wout_maf_add _REC_AXS_20_u2 0.99998474 _CNV_A_R_LINEAR_____37_CM 8 0. 0.99998474 DISPLAY_IDENTIFIER LDP_PQ_SP_WOUT_MAF_ADD_IP_FAC FORMAT "%7.6" /end AXIS_PTS
/begin AXIS_PTS ldp_eoi__prs_inc_cmp "" 0x10a7e online_dummy _REC_AXS_20_u2 36. _CNV_A_R_LINEAR_____82_CM 12 0. 720. DISPLAY_IDENTIFIER LDP_EOI__PRS_INC_CMP FORMAT "%6.2" /end AXIS_PTS
/begin AXIS_PTS ldp_crk_inj__prs_inc_cmp "" 0x109c0 online_dummy _REC_AXS_20_u2 30. _CNV_A_R_LINEAR_____82_CM 16 0. 600. DISPLAY_IDENTIFIER LDP_CRK_INJ__PRS_INC_CMP FORMAT "%5.1" /end AXIS_PTS
/begin AXIS_PTS ldpm_prs_dec_inj__fac_ti_prs "" 0x11ab4 fup _REC_AXS_20_u2 173888. _CNV_A_R_LINEAR_____199_CM 12 0. 173888. DISPLAY_IDENTIFIER LDPM_PRS_DEC_INJ__FAC_TI_PRS FORMAT "%6.0" /end AXIS_PTS
/begin AXIS_PTS ldp_amp_mes_ti_st_amp_fac "" 0x108fa amp_mes _REC_AXS_20_u2 5434. _CNV_A_R_LINEAR_____49_CM 6 0. 5434. DISPLAY_IDENTIFIER LDP_AMP_MES_TI_ST_AMP_FAC FORMAT "%7.2" /end AXIS_PTS
/begin AXIS_PTS ldp_tco__mff_lgrd_ast "" 0x07d9e tco _REC_AXS_20_u1 190.5 _CNV_A_R_LINEAR_____12_CM 8 -48. 142.5 DISPLAY_IDENTIFIER LDP_TCO__MFF_LGRD_AST FORMAT "%5.1" /end AXIS_PTS
/begin AXIS_PTS ldp_cyc__mff_cst "" 0x00fa2 cycnr_st _REC_AXS_20_u1 255. _CNV_A_R_LINEAR_____1_CM 4 0. 255. DISPLAY_IDENTIFIER LDP_CYC__MFF_CST FORMAT "%3.0" /end AXIS_PTS
/begin AXIS_PTS ldp_cyc_cast_ip_ti_deac_cast "" 0x109f4 cyc_cast _REC_AXS_20_u2 65535. _CNV_A_R_LINEAR_____1_CM 8 0. 65535. DISPLAY_IDENTIFIER LDP_CYC_CAST_IP_TI_DEAC_CAST FORMAT "%5.0" /end AXIS_PTS
/begin AXIS_PTS ldp_n_tooth__mff_cst "" 0x01b92 n_tooth _REC_AXS_20_u2 816. _CNV_A_R_LINEAR_____11_CM 3 0. 8160. DISPLAY_IDENTIFIER LDP_N_TOOTH__MFF_CST FORMAT "%4.0" /end AXIS_PTS
/begin AXIS_PTS ldp_tia_ip_ti_cast "" 0x01220 tia _REC_AXS_20_u1 28.575 _CNV_A_R_LINEAR_____12_CM 2 -48. 142.5 DISPLAY_IDENTIFIER LDP_TIA_IP_TI_CAST FORMAT "%5.1" /end AXIS_PTS
/begin AXIS_PTS ldp_fac_cor_ti_cast "" 0x00fb5 online_dummy _REC_AXS_20_u1 0.298830003 _CNV_A_R_LINEAR_____39_CM 4 0. 1.99220002 DISPLAY_IDENTIFIER LDP_FAC_COR_TI_CAST FORMAT "%5.3" /end AXIS_PTS
/begin AXIS_PTS ldp_map__ti_cast_fac_map "" 0x10dd4 map _REC_AXS_20_u2 815.1 _CNV_A_R_LINEAR_____49_CM 6 0. 5434. DISPLAY_IDENTIFIER LDP_MAP__TI_CAST_FAC_MAP FORMAT "%7.2" /end AXIS_PTS
/begin AXIS_PTS ldpm_tco__mff_cst "" 0x081dc tco _REC_AXS_20_u1 19.05 _CNV_A_R_LINEAR_____12_CM 8 -48. 142.5 DISPLAY_IDENTIFIER LDPM_TCO__MFF_CST FORMAT "%5.1" /end AXIS_PTS
/begin AXIS_PTS ldpm_tco__mff_deac_cst "" 0x081e5 tco _REC_AXS_20_u1 19.05 _CNV_A_R_LINEAR_____12_CM 10 -48. 142.5 DISPLAY_IDENTIFIER LDPM_TCO__MFF_DEAC_CST FORMAT "%5.1" /end AXIS_PTS
/begin AXIS_PTS ldp_vb__ti_add_dly "" 0x07ed2 vb _REC_AXS_20_u1 3.107808 _CNV_A_R_LINEAR_____34_CM 8 0. 25.8984 DISPLAY_IDENTIFIER LDP_VB__TI_ADD_DLY FORMAT "%3.1" /end AXIS_PTS
/begin AXIS_PTS ldp_fup_map_dif__ti_add_dly "Injector dead time correction" 0x10aec fup _REC_AXS_20_u2 17388.8 _CNV_A_R_LINEAR_____199_CM 6 0. 173888. DISPLAY_IDENTIFIER LDP_FUP_MAP_DIF__TI_ADD_DLY FORMAT "%6.0" /end AXIS_PTS
/begin AXIS_PTS ldp_vlft_av__cam_op_in_vvl "" 0x114e4 online_dummy _REC_AXS_20_u2 65.535 _CNV_A_R_LINEAR_____441_CM 6 0. 65.535 DISPLAY_IDENTIFIER LDP_VLFT_AV__CAM_OP_IN_VVL /end AXIS_PTS
/begin AXIS_PTS ldp_n_32__eoi_bas "" 0x07bc0 n_32 _REC_AXS_20_u1 816. _CNV_A_R_LINEAR_____16_CM 12 0. 8160. DISPLAY_IDENTIFIER LDP_N_32__EOI_BAS FORMAT "%4.0" /end AXIS_PTS
/begin AXIS_PTS ldp_n_32__eoi_bas_is "" 0x0101d n_32 _REC_AXS_20_u1 816. _CNV_A_R_LINEAR_____16_CM 6 0. 8160. DISPLAY_IDENTIFIER LDP_N_32__EOI_BAS_IS FORMAT "%4.0" /end AXIS_PTS
/begin AXIS_PTS ldp_ti_hom__eoi_bas "" 0x11218 ti_hom_1 _REC_AXS_20_u2 26.214 _CNV_A_R_LINEAR_____198_CM 10 0. 262.14 DISPLAY_IDENTIFIER LDP_TI_HOM__EOI_BAS FORMAT "%7.3" /end AXIS_PTS
/begin AXIS_PTS ldp_ti_hom__eoi_bas_is "" 0x1122e ti_hom_1 _REC_AXS_20_u2 26.214 _CNV_A_R_LINEAR_____198_CM 6 0. 262.14 DISPLAY_IDENTIFIER LDP_TI_HOM__EOI_BAS_IS FORMAT "%7.3" /end AXIS_PTS
/begin AXIS_PTS ldp_tco__eoi_min_tipr "" 0x07d71 tco _REC_AXS_20_u1 190.5 _CNV_A_R_LINEAR_____12_CM 8 -48. 142.5 DISPLAY_IDENTIFIER LDP_TCO__EOI_MIN_TIPR FORMAT "%5.1" /end AXIS_PTS
/begin AXIS_PTS ldp_cycnr_cst__fac_tipr_deac "" 0x00fae cycnr_cst _REC_AXS_20_u1 7. _CNV_A_R_LINEAR_____1_CM 6 0. 7. DISPLAY_IDENTIFIER LDP_CYCNR_CST__FAC_TIPR_DEAC FORMAT "%2.0" /end AXIS_PTS
/begin AXIS_PTS ldp_tco__mffpr_cst "" 0x07da7 tco _REC_AXS_20_u1 190.5 _CNV_A_R_LINEAR_____12_CM 8 -48. 142.5 DISPLAY_IDENTIFIER LDP_TCO__MFFPR_CST FORMAT "%5.1" /end AXIS_PTS
/begin AXIS_PTS ldp_tco__mffpr_fac_st_es "" 0x07db0 tco _REC_AXS_20_u1 190.5 _CNV_A_R_LINEAR_____12_CM 8 -48. 142.5 DISPLAY_IDENTIFIER LDP_TCO__MFFPR_FAC_ST_ES FORMAT "%5.1" /end AXIS_PTS
/begin AXIS_PTS ldpm_tco__ti_st_rest "" 0x081f9 tco _REC_AXS_20_u1 28.575 _CNV_A_R_LINEAR_____12_CM 8 -48. 142.5 DISPLAY_IDENTIFIER LDPM_TCO__TI_ST_REST FORMAT "%5.1" /end AXIS_PTS
/begin AXIS_PTS ldp_tco_stop__fac_rest "" 0x07e42 tco_stop _REC_AXS_20_u1 28.575 _CNV_A_R_LINEAR_____12_CM 8 -48. 142.5 DISPLAY_IDENTIFIER LDP_TCO_STOP__FAC_REST FORMAT "%5.1" /end AXIS_PTS
/begin AXIS_PTS ldpm_tco__fac_stall "" 0x081d3 tco _REC_AXS_20_u1 28.575 _CNV_A_R_LINEAR_____12_CM 8 -48. 142.5 DISPLAY_IDENTIFIER LDPM_TCO__FAC_STALL FORMAT "%5.1" /end AXIS_PTS
/begin AXIS_PTS ldp_t_es__rest "" 0x1119a t_es _REC_AXS_20_u2 9830.25 _CNV_A_R_LINEAR_____97_CM 8 0. 65535. DISPLAY_IDENTIFIER LDP_T_ES__REST FORMAT "%5.0" /end AXIS_PTS
/begin AXIS_PTS ldp_t_ast_rest "" 0x1117a t_ast_rest _REC_AXS_20_u2 983.025 _CNV_A_R_LINEAR_____24_CM 8 0. 6553.5 DISPLAY_IDENTIFIER LDP_T_AST_REST FORMAT "%6.1" /end AXIS_PTS
/begin AXIS_PTS ldpm_maf_hb__ti_wup "" 0x07fa8 maf _REC_AXS_20_u1 1389. _CNV_A_R_LINEAR_____27_CM 8 0. 1389. DISPLAY_IDENTIFIER LDPM_MAF_HB__TI_WUP FORMAT "%4.0" /end AXIS_PTS
/begin AXIS_PTS ldpm_tco__ti_wup "" 0x08202 tco _REC_AXS_20_u1 190.5 _CNV_A_R_LINEAR_____12_CM 8 -48. 142.5 DISPLAY_IDENTIFIER LDPM_TCO__TI_WUP FORMAT "%5.1" /end AXIS_PTS
/begin AXIS_PTS ldp_tco_st__ti_tco_wup "" 0x011a2 tco_st _REC_AXS_20_u1 190.5 _CNV_A_R_LINEAR_____12_CM 3 -48. 142.5 DISPLAY_IDENTIFIER LDP_TCO_ST__TI_TCO_WUP FORMAT "%5.1" /end AXIS_PTS
/begin AXIS_PTS ldp_vo__ti_vo_wup "" 0x07ee4 vo _REC_AXS_20_u1 95.625 _CNV_A_R_LINEAR_____82_CM 8 0. 95.625 DISPLAY_IDENTIFIER LDP_VO__TI_VO_WUP FORMAT "%5.2" /end AXIS_PTS
/begin AXIS_PTS ldpm_n_32__ti_wup "" 0x080a4 n_32 _REC_AXS_20_u1 8160. _CNV_A_R_LINEAR_____16_CM 8 0. 8160. DISPLAY_IDENTIFIER LDPM_N_32__TI_WUP FORMAT "%4.0" /end AXIS_PTS
/begin AXIS_PTS ldp_map_dif__fac_ti_vo_wup "" 0x10df4 online_dummy _REC_AXS_20_u2 5434. _CNV_A_R_LINEAR_____49_CM 8 0. 5434. DISPLAY_IDENTIFIER LDP_MAP_DIF__FAC_TI_VO_WUP FORMAT "%7.2" /end AXIS_PTS
/begin AXIS_PTS ldp_map__ti_fac_n_map "" 0x10de2 map _REC_AXS_20_u2 5434. _CNV_A_R_LINEAR_____49_CM 8 0. 5434. DISPLAY_IDENTIFIER LDP_MAP__TI_FAC_N_MAP FORMAT "%7.2" /end AXIS_PTS
/begin AXIS_PTS ldp_n_32__ti_fac_n_map "" 0x07c52 n_32 _REC_AXS_20_u1 8160. _CNV_A_R_LINEAR_____16_CM 8 0. 8160. DISPLAY_IDENTIFIER LDP_N_32__TI_FAC_N_MAP FORMAT "%4.0" /end AXIS_PTS
/begin AXIS_PTS ldp_toil_ti_fac_tia_toil "" 0x0124e toil _REC_AXS_20_u1 200. _CNV_A_R_LINEAR_____15_CM 6 -40. 160. DISPLAY_IDENTIFIER LDP_TOIL_TI_FAC_TIA_TOIL FORMAT "%3.0" /end AXIS_PTS
/begin AXIS_PTS ldp_tia_ti_fac_tia_toil "" 0x0122a tia _REC_AXS_20_u1 190.5 _CNV_A_R_LINEAR_____12_CM 6 -48. 142.5 DISPLAY_IDENTIFIER LDP_TIA_TI_FAC_TIA_TOIL FORMAT "%5.1" /end AXIS_PTS
/begin AXIS_PTS ldp_tco__ti_fac_tco "" 0x01185 tco _REC_AXS_20_u1 190.5 _CNV_A_R_LINEAR_____12_CM 3 -48. 142.5 DISPLAY_IDENTIFIER LDP_TCO__TI_FAC_TCO FORMAT "%5.1" /end AXIS_PTS
/begin AXIS_PTS ldp_v_tia_tia "" 0x07e9e v_tia _REC_AXS_20_u1 4.447265625 _CNV_A_R_LINEAR_____443_CM 16 3.90625e-002 4.98046875 DISPLAY_IDENTIFIER LDP_V_TIA_TIA FORMAT "%5.3" /end AXIS_PTS
/begin AXIS_PTS ldpm_tco__reac "" 0x081f0 tco _REC_AXS_20_u1 190.5 _CNV_A_R_LINEAR_____12_CM 8 -48. 142.5 DISPLAY_IDENTIFIER LDPM_TCO__REAC FORMAT "%5.1" /end AXIS_PTS
/begin AXIS_PTS ldp_map__fac_mff_map_wf "" 0x10dca map _REC_AXS_20_u2 5434. _CNV_A_R_LINEAR_____49_CM 4 0. 5434. DISPLAY_IDENTIFIER LDP_MAP__FAC_MFF_MAP_WF FORMAT "%7.2" /end AXIS_PTS
/begin AXIS_PTS ldpm_n_32__reac "" 0x08092 n_32 _REC_AXS_20_u1 8160. _CNV_A_R_LINEAR_____16_CM 8 0. 8160. DISPLAY_IDENTIFIER LDPM_N_32__REAC FORMAT "%4.0" /end AXIS_PTS
/begin AXIS_PTS ldpm_cycnr_reac__reac "" 0x07f08 online_dummy _REC_AXS_20_u1 15. _CNV_A_R_LINEAR_____1_CM 16 1. 16. DISPLAY_IDENTIFIER LDPM_CYCNR_REAC__REAC FORMAT "%2.0" /end AXIS_PTS
/begin AXIS_PTS ldp_tco_ip_tmag_ivvt "" 0x07df8 tco _REC_AXS_20_u1 190.5 _CNV_A_R_LINEAR_____12_CM 10 -48. 142.5 DISPLAY_IDENTIFIER LDP_TCO_IP_TMAG_IVVT FORMAT "%6.2" /end AXIS_PTS
/begin AXIS_PTS ldp_toil_ip_tmag_ivvt "" 0x07e66 toil _REC_AXS_20_u1 200. _CNV_A_R_LINEAR_____15_CM 10 -40. 160. DISPLAY_IDENTIFIER LDP_TOIL_IP_TMAG_IVVT FORMAT "%3.0" /end AXIS_PTS
/begin AXIS_PTS ldp_pv_av_ip_tps_sp_st_pv "" 0x010f7 pv_av _REC_AXS_20_u1 99.609375 _CNV_A_R_LINEAR_____10_CM 6 0. 99.609375 DISPLAY_IDENTIFIER LDP_PV_AV_IP_TPS_SP_ST_PV FORMAT "%4.1" /end AXIS_PTS
/begin AXIS_PTS ldp_tia_ip_fac_tia_tps_sp_st "" 0x01219 tia _REC_AXS_20_u1 190.5 _CNV_A_R_LINEAR_____12_CM 6 -48. 142.5 DISPLAY_IDENTIFIER LDP_TIA_IP_FAC_TIA_TPS_SP_ST FORMAT "%5.1" /end AXIS_PTS
/begin AXIS_PTS ldp_amp_ip_tps_sp_st_amp "" 0x108ec amp _REC_AXS_20_u2 5434. _CNV_A_R_LINEAR_____49_CM 6 0. 5434. DISPLAY_IDENTIFIER LDP_AMP_IP_TPS_SP_ST_AMP FORMAT "%7.2" /end AXIS_PTS
/begin AXIS_PTS ldp_tps_rel_st_ip_tps_sp_st "" 0x112b0 tps_rel_st _REC_AXS_20_u2 99.99847412 _CNV_A_R_LINEAR_____9_CM 12 0. 99.99847412 DISPLAY_IDENTIFIER LDP_TPS_REL_ST_IP_TPS_SP_ST /end AXIS_PTS
/begin AXIS_PTS ldpm_tco__fac_tco_tqi "" 0x013ce tco _REC_AXS_20_u1 190.5 _CNV_A_R_LINEAR_____12_CM 6 -48. 142.5 DISPLAY_IDENTIFIER LDPM_TCO__FAC_TCO_TQI FORMAT "%5.1" /end AXIS_PTS
/begin AXIS_PTS ldpm_n_32_6 "" 0x08059 n_32 _REC_AXS_20_u1 8160. _CNV_A_R_LINEAR_____16_CM 16 0. 8160. DISPLAY_IDENTIFIER LDPM_N_32_6 FORMAT "%4.0" /end AXIS_PTS
/begin AXIS_PTS ldp_tps_av__maf_1_diag "" 0x1123c tps_av _REC_AXS_20_u2 119.5 _CNV_A_R_LINEAR_____447_CM 16 0. 119.5 DISPLAY_IDENTIFIER LDP_TPS_AV__MAF_1_DIAG FORMAT "%7.3" /end AXIS_PTS
/begin AXIS_PTS ldp_n_32__tps_max_ratio_diag "" 0x0104b n_32 _REC_AXS_20_u1 8160. _CNV_A_R_LINEAR_____16_CM 4 0. 8160. DISPLAY_IDENTIFIER LDP_N_32__TPS_MAX_RATIO_DIAG FORMAT "%4.0" /end AXIS_PTS
/begin AXIS_PTS ldp_n_32_tps_sp_pwl "" 0x010b4 n_32 _REC_AXS_20_u1 816. _CNV_A_R_LINEAR_____16_CM 4 0. 8160. DISPLAY_IDENTIFIER LDP_N_32_TPS_SP_PWL FORMAT "%4.0" /end AXIS_PTS
/begin AXIS_PTS ldp_pv_av__tps_sp_ext "" 0x010e9 pv_av _REC_AXS_20_u1 99.609375 _CNV_A_R_LINEAR_____10_CM 6 0. 99.609375 DISPLAY_IDENTIFIER LDP_PV_AV__TPS_SP_EXT FORMAT "%4.1" /end AXIS_PTS
/begin AXIS_PTS ldpm_tco_1_thro "" 0x081a5 tco _REC_AXS_20_u1 190.5 _CNV_A_R_LINEAR_____12_CM 8 -48. 142.5 DISPLAY_IDENTIFIER LDPM_TCO_1_THRO FORMAT "%5.1" /end AXIS_PTS
/begin AXIS_PTS ldp_n_ip_tps_sp_lgrd_st "" 0x10f84 n _REC_AXS_20_u2 8160. _CNV_A_R_LINEAR_____11_CM 8 0. 8160. DISPLAY_IDENTIFIER LDP_N_IP_TPS_SP_LGRD_ST FORMAT "%4.0" /end AXIS_PTS
/begin AXIS_PTS ldp_tco_ip_tps_sp_lgrd_st "" 0x07e03 tco _REC_AXS_20_u1 190.5 _CNV_A_R_LINEAR_____12_CM 8 -48. 142.5 DISPLAY_IDENTIFIER LDP_TCO_IP_TPS_SP_LGRD_ST FORMAT "%5.1" /end AXIS_PTS
/begin AXIS_PTS ldp_t_acc_ip_fac_tq_loss_acc_on "" 0x07d5f t_acc _REC_AXS_20_u1 2.55 _CNV_A_R_LINEAR_____4_CM 8 0. 2.55 DISPLAY_IDENTIFIER LDP_T_ACC_IP_FAC_TQ_LOSS_ACC_ON FORMAT "%4.2" /end AXIS_PTS
/begin AXIS_PTS ldp_n_32_ip_fac_tq_loss_acc_on "" 0x07c6d n_32 _REC_AXS_20_u1 8160. _CNV_A_R_LINEAR_____16_CM 8 0. 8160. DISPLAY_IDENTIFIER LDP_N_32_IP_FAC_TQ_LOSS_ACC_ON FORMAT "%4.0" /end AXIS_PTS
/begin AXIS_PTS ldp_n_32__tq_add_acc "" 0x01050 n_32 _REC_AXS_20_u1 8160. _CNV_A_R_LINEAR_____16_CM 6 0. 8160. DISPLAY_IDENTIFIER LDP_N_32__TQ_ADD_ACC FORMAT "%4.0" /end AXIS_PTS
/begin AXIS_PTS ldp_t_acc_fac_tq_loss_acc "" 0x07d56 t_acc _REC_AXS_20_u1 2.55 _CNV_A_R_LINEAR_____4_CM 8 0. 2.55 DISPLAY_IDENTIFIER LDP_T_ACC_FAC_TQ_LOSS_ACC FORMAT "%4.2" /end AXIS_PTS
/begin AXIS_PTS ldp_n_32__tq_add_heat_acc "" 0x01057 n_32 _REC_AXS_20_u1 8160. _CNV_A_R_LINEAR_____16_CM 6 0. 8160. DISPLAY_IDENTIFIER LDP_N_32__TQ_ADD_HEAT_ACC FORMAT "%4.0" /end AXIS_PTS
/begin AXIS_PTS ldp_n_32__tq_loss_acc "" 0x0106c n_32 _REC_AXS_20_u1 8160. _CNV_A_R_LINEAR_____16_CM 6 0. 8160. DISPLAY_IDENTIFIER LDP_N_32__TQ_LOSS_ACC FORMAT "%4.0" /end AXIS_PTS
/begin AXIS_PTS ldp_tq_accin_can__tq_loss_acc "" 0x01255 tq_accin_can _REC_AXS_20_u1 31. _CNV_A_R_LINEAR_____95_CM 6 0. 31. DISPLAY_IDENTIFIER LDP_TQ_ACCIN_CAN__TQ_LOSS_ACC FORMAT "%3.0" /end AXIS_PTS
/begin AXIS_PTS ldp_tq_loss_acc_inp__tq_add_acc "" 0x11310 tq_loss_acc_inp _REC_AXS_20_u2 2047.96875 _CNV_A_R_LINEAR_____186_CM 6 -1024. 1023.96875 DISPLAY_IDENTIFIER LDP_TQ_LOSS_ACC_INP__TQ_ADD_ACC FORMAT "%6.2" /end AXIS_PTS
/begin AXIS_PTS ldpm_gr_at_100 "" 0x07f4c gr_at _REC_AXS_20_u1 255. _CNV_A_R_LINEAR_____1_CM 13 0. 255. DISPLAY_IDENTIFIER LDPM_GR_AT_100 FORMAT "%3.0" /end AXIS_PTS
/begin AXIS_PTS ldpm_gr_mt_100 "" 0x07f68 gr_mt _REC_AXS_20_u1 255. _CNV_A_R_LINEAR_____1_CM 13 0. 255. DISPLAY_IDENTIFIER LDPM_GR_MT_100 FORMAT "%3.0" /end AXIS_PTS
/begin AXIS_PTS ldp_n_32__fac_tq_aj "" 0x07bd6 n_32 _REC_AXS_20_u1 8160. _CNV_A_R_LINEAR_____16_CM 8 0. 8160. DISPLAY_IDENTIFIER LDP_N_32__FAC_TQ_AJ FORMAT "%4.0" /end AXIS_PTS
/begin AXIS_PTS ldp_gear__fac_tq_aj "" 0x00fdd gear _REC_AXS_20_u1 6. _CNV_A_R_LINEAR_____1_CM 6 0. 6. DISPLAY_IDENTIFIER LDP_GEAR__FAC_TQ_AJ FORMAT "%1.0" /end AXIS_PTS
/begin AXIS_PTS ldpm_ac_veh_trv_tcs "" 0x11558 ac_veh_trv_tcs _REC_AXS_20_u2 102.35 _CNV_A_R_LINEAR_____103_CM 8 -51.175 51.175 DISPLAY_IDENTIFIER LDPM_AC_VEH_TRV_TCS FORMAT "%7.4" /end AXIS_PTS
/begin AXIS_PTS ldpm_vs_fil "" 0x11cd4 vs_fil _REC_AXS_20_u2 511.99218 _CNV_A_R_LINEAR_____85_CM 8 0. 511.99218 DISPLAY_IDENTIFIER LDPM_VS_FIL FORMAT "%7.3" /end AXIS_PTS
/begin AXIS_PTS ldpm_n_32__tq_loss_ars "" 0x080ad n_32 _REC_AXS_20_u1 8160. _CNV_A_R_LINEAR_____16_CM 8 0. 8160. DISPLAY_IDENTIFIER LDPM_N_32__TQ_LOSS_ARS FORMAT "%4.0" /end AXIS_PTS
/begin AXIS_PTS ldp_tq_loss_ars_sp_can_max "" 0x1134c tq_loss_ars_sp_can _REC_AXS_20_u2 2047.96875 _CNV_A_R_LINEAR_____186_CM 8 -1024. 1023.96875 DISPLAY_IDENTIFIER LDP_TQ_LOSS_ARS_SP_CAN_MAX FORMAT "%6.2" /end AXIS_PTS
/begin AXIS_PTS ldp_tq_loss_ars_av_can_max "" 0x1132c tq_loss_ars_av_can _REC_AXS_20_u2 2047.96875 _CNV_A_R_LINEAR_____186_CM 8 -1024. 1023.96875 DISPLAY_IDENTIFIER LDP_TQ_LOSS_ARS_AV_CAN_MAX FORMAT "%6.2" /end AXIS_PTS
/begin MEASUREMENT n_ratio_conv "" UBYTE _CNV_A_R_LINEAR_____354_CM 1 100. 0. 0.996094 DISPLAY_IDENTIFIER N_RATIO_CONV ECU_ADDRESS 0x3fe579 FORMAT "%4.3" /end MEASUREMENT
/begin AXIS_PTS ldp_tco__tq_clu_amt "" 0x01189 tco _REC_AXS_20_u1 190.5 _CNV_A_R_LINEAR_____12_CM 6 -48. 142.5 DISPLAY_IDENTIFIER LDP_TCO__TQ_CLU_AMT FORMAT "%5.1" /end AXIS_PTS
/begin AXIS_PTS ldp_n_dif__tq_clu_amt "" 0x10f22 n_dif _REC_AXS_20_u2 65535. _CNV_A_R_LINEAR_____206_CM 6 -32768. 32767. DISPLAY_IDENTIFIER LDP_N_DIF__TQ_CLU_AMT FORMAT "%6.0" /end AXIS_PTS
/begin AXIS_PTS ldp_n_32_ip_tq_add_conv "" 0x0109f n_32 _REC_AXS_20_u1 8160. _CNV_A_R_LINEAR_____16_CM 6 0. 8160. DISPLAY_IDENTIFIER LDP_N_32_IP_TQ_ADD_CONV FORMAT "%4.0" /end AXIS_PTS
/begin AXIS_PTS ldp_n_32_ip_tq_add_amt "" 0x01098 n_32 _REC_AXS_20_u1 8160. _CNV_A_R_LINEAR_____16_CM 6 0. 8160. DISPLAY_IDENTIFIER LDP_N_32_IP_TQ_ADD_AMT FORMAT "%4.0" /end AXIS_PTS
/begin AXIS_PTS ldp_vs_fil__tq_clu_amt "" 0x1152e vs_fil _REC_AXS_20_u2 511.99218 _CNV_A_R_LINEAR_____85_CM 6 0. 511.99218 DISPLAY_IDENTIFIER LDP_VS_FIL__TQ_CLU_AMT FORMAT "%7.3" /end AXIS_PTS
/begin AXIS_PTS ldp_n_ratio_conv_fac_tq_conv "" 0x07d11 n_ratio_conv _REC_AXS_20_u1 0.9960940000000002 _CNV_A_R_LINEAR_____50_CM 8 0. 0.996094 DISPLAY_IDENTIFIER LDP_N_RATIO_CONV_FAC_TQ_CONV FORMAT "%5.3" /end AXIS_PTS
/begin AXIS_PTS ldp_toil_t_dly_n_sp_is "" 0x07e7a toil _REC_AXS_20_u1 200. _CNV_A_R_LINEAR_____15_CM 8 -40. 160. DISPLAY_IDENTIFIER LDP_TOIL_T_DLY_N_SP_IS FORMAT "%3.0" /end AXIS_PTS
/begin AXIS_PTS ldp_toil_t_dly_conv "" 0x07e71 toil _REC_AXS_20_u1 200. _CNV_A_R_LINEAR_____15_CM 8 -40. 160. DISPLAY_IDENTIFIER LDP_TOIL_T_DLY_CONV FORMAT "%3.0" /end AXIS_PTS
/begin AXIS_PTS ldp_toil_fac_conv "" 0x07e5d toil _REC_AXS_20_u1 200. _CNV_A_R_LINEAR_____15_CM 8 -40. 160. DISPLAY_IDENTIFIER LDP_TOIL_FAC_CONV FORMAT "%3.0" /end AXIS_PTS
/begin AXIS_PTS ldp_gr_at_n_tur "" 0x07af2 gr_at _REC_AXS_20_u1 8. _CNV_A_R_LINEAR_____1_CM 13 0. 8. DISPLAY_IDENTIFIER LDP_GR_AT_N_TUR FORMAT "%1.0" /end AXIS_PTS
/begin AXIS_PTS ldp_n_32__tq_conv "" 0x07c64 n_32 _REC_AXS_20_u1 8160. _CNV_A_R_LINEAR_____16_CM 8 0. 8160. DISPLAY_IDENTIFIER LDP_N_32__TQ_CONV FORMAT "%4.0" /end AXIS_PTS
/begin AXIS_PTS ldp_vs_n_tur "" 0x012b6 vs _REC_AXS_20_u1 255. _CNV_A_R_LINEAR_____23_CM 2 0. 255. DISPLAY_IDENTIFIER LDP_VS_N_TUR FORMAT "%3.0" /end AXIS_PTS
/begin AXIS_PTS ldp_tq_conv_can__tq_conv "" 0x112fe tq_conv_can _REC_AXS_20_u2 2047.96875 _CNV_A_R_LINEAR_____186_CM 8 -1024. 1023.96875 DISPLAY_IDENTIFIER LDP_TQ_CONV_CAN__TQ_CONV FORMAT "%6.2" /end AXIS_PTS
/begin AXIS_PTS ldpm_toil_tq_add_conv "" 0x0141c toil _REC_AXS_20_u1 200. _CNV_A_R_LINEAR_____15_CM 6 -40. 160. DISPLAY_IDENTIFIER LDPM_TOIL_TQ_ADD_CONV FORMAT "%3.0" /end AXIS_PTS
/begin AXIS_PTS ldpm_vs_tq_add_conv "" 0x01438 vs _REC_AXS_20_u1 255. _CNV_A_R_LINEAR_____23_CM 6 0. 255. DISPLAY_IDENTIFIER LDPM_VS_TQ_ADD_CONV FORMAT "%3.0" /end AXIS_PTS
/begin AXIS_PTS ldp_n_grd_tq_add_conv "" 0x010d5 n_grd _REC_AXS_20_u1 8160. _CNV_A_R_LINEAR_____54_CM 6 -4096. 4064. DISPLAY_IDENTIFIER LDP_N_GRD_TQ_ADD_CONV FORMAT "%5.0" /end AXIS_PTS
/begin AXIS_PTS ldp_ac_cru_tq_add_conv "" 0x1087c ac_cru _REC_AXS_20_u2 31.43952 _CNV_A_R_LINEAR_____460_CM 6 -15.72 15.71952 DISPLAY_IDENTIFIER LDP_AC_CRU_TQ_ADD_CONV FORMAT "%8.4" /end AXIS_PTS
/begin AXIS_PTS ldp_cl_mmv "" 0x1099a online_dummy _REC_AXS_20_u2 7.99987793 _CNV_A_R_LINEAR_____345_CM 6 0. 7.99987793 DISPLAY_IDENTIFIER LDP_CL_MMV FORMAT "%6.4" /end AXIS_PTS
/begin AXIS_PTS ldpm_n_100 "" 0x11820 n _REC_AXS_20_u2 8160. _CNV_A_R_LINEAR_____11_CM 16 0. 8160. DISPLAY_IDENTIFIER LDPM_N_100 FORMAT "%4.0" /end AXIS_PTS
/begin AXIS_PTS ldp_maf_cyl_stk__tqfr "" 0x10c22 maf _REC_AXS_20_u2 1389. _CNV_A_R_LINEAR_____106_CM 8 0. 1389. DISPLAY_IDENTIFIER LDP_MAF_CYL_STK__TQFR FORMAT "%7.2" /end AXIS_PTS
/begin AXIS_PTS ldp_tco__tqfr_add "" 0x07dcb tco _REC_AXS_20_u1 190.5 _CNV_A_R_LINEAR_____12_CM 8 -48. 142.5 DISPLAY_IDENTIFIER LDP_TCO__TQFR_ADD FORMAT "%5.1" /end AXIS_PTS
/begin AXIS_PTS ldp_toil_tqfr_add "" 0x07e95 toil _REC_AXS_20_u1 200. _CNV_A_R_LINEAR_____15_CM 8 -40. 160. DISPLAY_IDENTIFIER LDP_TOIL_TQFR_ADD FORMAT "%3.0" /end AXIS_PTS
/begin AXIS_PTS ldp_n_tq_loss_lim "" 0x11026 n _REC_AXS_20_u2 8160. _CNV_A_R_LINEAR_____11_CM 6 0. 8160. DISPLAY_IDENTIFIER LDP_N_TQ_LOSS_LIM FORMAT "%4.0" /end AXIS_PTS
/begin AXIS_PTS ldp_tco_tq_loss_lim "" 0x011d4 tco _REC_AXS_20_u1 190.5 _CNV_A_R_LINEAR_____12_CM 6 -48. 142.5 DISPLAY_IDENTIFIER LDP_TCO_TQ_LOSS_LIM FORMAT "%5.1" /end AXIS_PTS
/begin AXIS_PTS ldp_tco_st__tqfr_st "" 0x011ab tco_st _REC_AXS_20_u1 190.5 _CNV_A_R_LINEAR_____12_CM 4 -48. 142.5 DISPLAY_IDENTIFIER LDP_TCO_ST__TQFR_ST FORMAT "%5.1" /end AXIS_PTS
/begin AXIS_PTS ldp_tco_st__tqfr_dec_st "" 0x011a6 tco_st _REC_AXS_20_u1 190.5 _CNV_A_R_LINEAR_____12_CM 4 -48. 142.5 DISPLAY_IDENTIFIER LDP_TCO_ST__TQFR_DEC_ST FORMAT "%5.1" /end AXIS_PTS
/begin AXIS_PTS ldp_amp_dif__tqfr_amp "AMP correction of friction  torque" 0x1089c online_dummy _REC_AXS_20_u2 5434. _CNV_A_R_LINEAR_____114_CM 4 -2717. 2717. DISPLAY_IDENTIFIER LDP_AMP_DIF__TQFR_AMP FORMAT "%7.2" /end AXIS_PTS
/begin AXIS_PTS ldp_pq__tqfr_amp "AMP correction of friction  torque" 0x110c6 online_dummy _REC_AXS_20_u2 0.99998474 _CNV_A_R_LINEAR_____37_CM 4 0. 0.99998474 DISPLAY_IDENTIFIER LDP_PQ__TQFR_AMP FORMAT "%7.5" /end AXIS_PTS
/begin AXIS_PTS ldp_eff_scc_sp__nr_pat_scc "" 0x10a54 eff_scc_sp _REC_AXS_20_u2 1.99996948 _CNV_A_R_LINEAR_____21_CM 13 0. 1.99996948 DISPLAY_IDENTIFIER LDP_EFF_SCC_SP__NR_PAT_SCC FORMAT "%7.5" /end AXIS_PTS
/begin AXIS_PTS ldpm_tco_ip_tq_st "" 0x0820b tco _REC_AXS_20_u1 190.5 _CNV_A_R_LINEAR_____12_CM 8 -48. 142.5 DISPLAY_IDENTIFIER LDPM_TCO_IP_TQ_ST FORMAT "%5.1" /end AXIS_PTS
/begin AXIS_PTS ldpm_n_dif_ip_tq_st "" 0x119a4 n_dif _REC_AXS_20_u2 65535. _CNV_A_R_LINEAR_____206_CM 8 -32768. 32767. DISPLAY_IDENTIFIER LDPM_N_DIF_IP_TQ_ST FORMAT "%6.0" /end AXIS_PTS
/begin AXIS_PTS ldp_n_32_mon__tqi_ref_mon "" 0x1205c n_32_mon _REC_AXS_20_u1 8160. _CNV_A_R_LINEAR_____16_CM 6 0. 8160. DISPLAY_IDENTIFIER LDP_N_32_MON__TQI_REF_MON FORMAT "%4.0" /end AXIS_PTS
/begin AXIS_PTS ldp_maf_mon__tqi_ref_mon "" 0x1200e maf_mon _REC_AXS_20_u1 1389. _CNV_A_R_LINEAR_____27_CM 8 0. 1389. DISPLAY_IDENTIFIER LDP_MAF_MON__TQI_REF_MON FORMAT "%4.0" /end AXIS_PTS
/begin AXIS_PTS ldp_n_32_mon__iga_ref_mon "" 0x1202f n_32_mon _REC_AXS_20_u1 8160. _CNV_A_R_LINEAR_____16_CM 8 0. 8160. DISPLAY_IDENTIFIER LDP_N_32_MON__IGA_REF_MON FORMAT "%4.0" /end AXIS_PTS
/begin AXIS_PTS ldp_maf_mon__iga_ref_mon "" 0x11fff maf_mon _REC_AXS_20_u1 1389. _CNV_A_R_LINEAR_____27_CM 8 0. 1389. DISPLAY_IDENTIFIER LDP_MAF_MON__IGA_REF_MON FORMAT "%4.0" /end AXIS_PTS
/begin AXIS_PTS ldp_iga_dif_av_mon__eff_iga_mon "" 0x11ff6 iga_dif_av _REC_AXS_20_u1 -95.625 _CNV_A_R_LINEAR_____204_CM 8 0. -95.625 DISPLAY_IDENTIFIER LDP_IGA_DIF_AV_MON__EFF_IGA_MON FORMAT "%6.2" /end AXIS_PTS
/begin AXIS_PTS ldpm_n_fac_tq_req_driv "" 0x119c8 n _REC_AXS_20_u2 8160. _CNV_A_R_LINEAR_____11_CM 12 0. 8160. DISPLAY_IDENTIFIER LDPM_N_FAC_TQ_REQ_DRIV FORMAT "%4.0" /end AXIS_PTS
/begin AXIS_PTS ldpm_pv_av_fac_tq_req_driv "" 0x0816b pv_av _REC_AXS_20_u1 99.609375 _CNV_A_R_LINEAR_____10_CM 12 0. 99.609375 DISPLAY_IDENTIFIER LDPM_PV_AV_FAC_TQ_REQ_DRIV FORMAT "%4.1" /end AXIS_PTS
/begin AXIS_PTS ldpm_n_32_100 "" 0x07ffc n_32 _REC_AXS_20_u1 8160. _CNV_A_R_LINEAR_____16_CM 16 0. 8160. DISPLAY_IDENTIFIER LDPM_N_32_100 FORMAT "%4.0" /end AXIS_PTS
/begin AXIS_PTS ldpm_maf_100 "" 0x116a2 maf _REC_AXS_20_u2 1389. _CNV_A_R_LINEAR_____106_CM 12 0. 1389. DISPLAY_IDENTIFIER LDPM_MAF_100 FORMAT "%7.2" /end AXIS_PTS
/begin AXIS_PTS ldp_n_sp_is_ratio "" 0x11006 n_sp_is_ratio _REC_AXS_20_u2 7.99987793 _CNV_A_R_LINEAR_____345_CM 8 0. 7.99987793 DISPLAY_IDENTIFIER LDP_N_SP_IS_RATIO FORMAT "%6.4" /end AXIS_PTS
/begin AXIS_PTS ldp_ecfpwm_ecf__pow_loss_ecf "" 0x07ae0 ecfpwm_ecf _REC_AXS_20_u1 99.609375 _CNV_A_R_LINEAR_____10_CM 8 0. 99.609375 DISPLAY_IDENTIFIER LDP_ECFPWM_ECF__POW_LOSS_ECF FORMAT "%4.1" /end AXIS_PTS
/begin AXIS_PTS ldpm_n_32__maf_min_pu "" 0x0807c n_32 _REC_AXS_20_u1 8160. _CNV_A_R_LINEAR_____16_CM 12 0. 8160. DISPLAY_IDENTIFIER LDPM_N_32__MAF_MIN_PU FORMAT "%4.0" /end AXIS_PTS
/begin AXIS_PTS ldpm_tco__maf_min_pu "" 0x013d5 tco _REC_AXS_20_u1 190.5 _CNV_A_R_LINEAR_____12_CM 4 -48. 142.5 DISPLAY_IDENTIFIER LDPM_TCO__MAF_MIN_PU FORMAT "%5.1" /end AXIS_PTS
/begin AXIS_PTS ldp_mff_sp_s__tqi_ref_s "" 0x10e70 mff_sp_s _REC_AXS_20_u2 1389. _CNV_A_R_LINEAR_____106_CM 12 0. 1389. DISPLAY_IDENTIFIER LDP_MFF_SP_S__TQI_REF_S FORMAT "%7.2" /end AXIS_PTS
/begin MEASUREMENT tq_dif_tra "" SWORD _CNV_A_R_LINEAR_____55_CM 1 100. -1024. 1023.96875 DISPLAY_IDENTIFIER TQ_DIF_TRA ECU_ADDRESS 0x3fda12 BYTE_ORDER MSB_LAST FORMAT "%6.2" /end MEASUREMENT
/begin AXIS_PTS ldp_tqi_sp_maf__maf_sp "" 0x113d8 tqi_sp_maf _REC_AXS_20_u2 1023.96875 _CNV_A_R_LINEAR_____55_CM 12 0. 1023.96875 DISPLAY_IDENTIFIER LDP_TQI_SP_MAF__MAF_SP FORMAT "%7.2" /end AXIS_PTS
/begin AXIS_PTS ldp_n_32__tqi_dif_lim "" 0x1202a n_32 _REC_AXS_20_u1 8160. _CNV_A_R_LINEAR_____16_CM 4 0. 8160. DISPLAY_IDENTIFIER LDP_N_32__TQI_DIF_LIM FORMAT "%4.0" /end AXIS_PTS
/begin AXIS_PTS ldp_tqi_sp_mon__tqi_dif_lim "" 0x120c9 tqi_sp_mon _REC_AXS_20_u1 510. _CNV_A_R_LINEAR_____101_CM 4 0. 510. DISPLAY_IDENTIFIER LDP_TQI_SP_MON__TQI_DIF_LIM FORMAT "%3.0" /end AXIS_PTS
/begin AXIS_PTS ldp_tqi_sp_mon__tqi_dif_max_mon "" 0x120ce tqi_sp_mon _REC_AXS_20_u1 510. _CNV_A_R_LINEAR_____101_CM 4 0. 510. DISPLAY_IDENTIFIER LDP_TQI_SP_MON__TQI_DIF_MAX_MON FORMAT "%3.0" /end AXIS_PTS
/begin AXIS_PTS ldp_n_32_mon__tqi_dif_max_mon "" 0x12057 n_32_mon _REC_AXS_20_u1 8160. _CNV_A_R_LINEAR_____16_CM 4 0. 8160. DISPLAY_IDENTIFIER LDP_N_32_MON__TQI_DIF_MAX_MON FORMAT "%4.0" /end AXIS_PTS
/begin AXIS_PTS ldp_n_dif_cor_mon_ip_tq_mon "maximum PD-part depending on speed deviation to idle speed setpoint" 0x1206a n_dif_cor_mon _REC_AXS_20_u1 8160. _CNV_A_R_LINEAR_____215_CM 4 -4096. 4064. DISPLAY_IDENTIFIER LDP_N_DIF_COR_MON_IP_TQ_MON FORMAT "%5.0" /end AXIS_PTS
/begin AXIS_PTS ldp_tco_mon_ip_fac_tq_p_d_mon "" 0x12098 tco_mon _REC_AXS_20_u1 190.5 _CNV_A_R_LINEAR_____12_CM 5 -48. 142.5 DISPLAY_IDENTIFIER LDP_TCO_MON_IP_FAC_TQ_P_D_MON FORMAT "%4.0" /end AXIS_PTS
/begin AXIS_PTS ldp_tco_mon_ip_n_sp_is_mon "" 0x1209e tco_mon _REC_AXS_20_u1 190.5 _CNV_A_R_LINEAR_____12_CM 5 -48. 142.5 DISPLAY_IDENTIFIER LDP_TCO_MON_IP_N_SP_IS_MON FORMAT "%5.1" /end AXIS_PTS
/begin AXIS_PTS ldp_n_tq_add_st "" 0x07d1a n_32 _REC_AXS_20_u1 8160. _CNV_A_R_LINEAR_____16_CM 8 0. 8160. DISPLAY_IDENTIFIER LDP_N_TQ_ADD_ST FORMAT "%4.0" /end AXIS_PTS
/begin AXIS_PTS ldp_tco_tq_add_st "" 0x011cf tco _REC_AXS_20_u1 190.5 _CNV_A_R_LINEAR_____12_CM 4 -48. 142.5 DISPLAY_IDENTIFIER LDP_TCO_TQ_ADD_ST FORMAT "%5.1" /end AXIS_PTS
/begin AXIS_PTS ldp_n_32_tq_add_tra "" 0x07ca3 n_32 _REC_AXS_20_u1 8160. _CNV_A_R_LINEAR_____16_CM 8 0. 8160. DISPLAY_IDENTIFIER LDP_N_32_TQ_ADD_TRA FORMAT "%4.0" /end AXIS_PTS
/begin AXIS_PTS ldp_tq_req_dif_tra_fac_tq_tra "" 0x1135e tq_req_dif_tra _REC_AXS_20_u2 1023.96875 _CNV_A_R_LINEAR_____55_CM 6 0. 1023.96875 DISPLAY_IDENTIFIER LDP_TQ_REQ_DIF_TRA_FAC_TQ_TRA FORMAT "%7.2" /end AXIS_PTS
/begin AXIS_PTS ldp_maf_mon__tq_loss_mon "" 0x12008 maf_mon _REC_AXS_20_u1 1389. _CNV_A_R_LINEAR_____27_CM 5 0. 1389. DISPLAY_IDENTIFIER LDP_MAF_MON__TQ_LOSS_MON FORMAT "%4.0" /end AXIS_PTS
/begin AXIS_PTS ldp_n_32_mon__tq_loss_mon "" 0x1204a n_32_mon _REC_AXS_20_u1 8160. _CNV_A_R_LINEAR_____16_CM 5 0. 8160. DISPLAY_IDENTIFIER LDP_N_32_MON__TQ_LOSS_MON FORMAT "%4.0" /end AXIS_PTS
/begin AXIS_PTS ldp_tco_mon__tq_loss_mon "" 0x1208b tco_mon _REC_AXS_20_u1 190.5 _CNV_A_R_LINEAR_____12_CM 5 -48. 142.5 DISPLAY_IDENTIFIER LDP_TCO_MON__TQ_LOSS_MON FORMAT "%5.1" /end AXIS_PTS
/begin AXIS_PTS ldp_ctr_km_can__tq_loss_mon "" 0x121f8 ctr_km_can _REC_AXS_20_u2 655350. _CNV_A_R_LINEAR_____88_CM 5 0. 655350. DISPLAY_IDENTIFIER LDP_CTR_KM_CAN__TQ_LOSS_MON FORMAT "%7.0" /end AXIS_PTS
/begin AXIS_PTS ldp_n_32_mon__tq_max_clu_max_mon "" 0x12050 n_32_mon _REC_AXS_20_u1 8160. _CNV_A_R_LINEAR_____16_CM 6 0. 8160. DISPLAY_IDENTIFIER LDP_N_32_MON__TQ_MAX_CLU_MAX_MON FORMAT "%4.0" /end AXIS_PTS
/begin AXIS_PTS ldp_n_dif_mon_ip_tq_min_mon "" 0x1206f n_dif_sp_is_mon _REC_AXS_20_u1 8160. _CNV_A_R_LINEAR_____215_CM 4 -4096. 4064. DISPLAY_IDENTIFIER LDP_N_DIF_MON_IP_TQ_MIN_MON FORMAT "%5.0" /end AXIS_PTS
/begin AXIS_PTS ldp_n_32_mon_ip_tqi_min_pu_mon "" 0x12063 n_32_mon _REC_AXS_20_u1 8160. _CNV_A_R_LINEAR_____16_CM 6 0. 8160. DISPLAY_IDENTIFIER LDP_N_32_MON_IP_TQI_MIN_PU_MON FORMAT "%4.0" /end AXIS_PTS
/begin AXIS_PTS ldp_tco_mon_ip_fac_conv_mon "" 0x12091 tco_mon _REC_AXS_20_u1 190.5 _CNV_A_R_LINEAR_____12_CM 6 -48. 142.5 DISPLAY_IDENTIFIER LDP_TCO_MON_IP_FAC_CONV_MON FORMAT "%5.1" /end AXIS_PTS
/begin AXIS_PTS ldp_tco_mon_ip_tqi_min_pu_mon "" 0x120a4 tco_mon _REC_AXS_20_u1 190.5 _CNV_A_R_LINEAR_____12_CM 4 -48. 142.5 DISPLAY_IDENTIFIER LDP_TCO_MON_IP_TQI_MIN_PU_MON FORMAT "%5.1" /end AXIS_PTS
/begin AXIS_PTS ldpm_gear__tq_p_max "" 0x07f30 gear _REC_AXS_20_u1 12. _CNV_A_R_LINEAR_____22_CM 13 0. 12. DISPLAY_IDENTIFIER LDPM_GEAR__TQ_P_MAX FORMAT "%3.0" /end AXIS_PTS
/begin AXIS_PTS ldpm_vs_fil__tq_p_max "" 0x11cf8 vs_fil _REC_AXS_20_u2 511.99218 _CNV_A_R_LINEAR_____85_CM 6 0. 511.99218 DISPLAY_IDENTIFIER LDPM_VS_FIL__TQ_P_MAX FORMAT "%7.3" /end AXIS_PTS
/begin AXIS_PTS ldp_ang_pste__tq_loss_pste "" 0x1091a ang_pste _REC_AXS_20_u2 2879.935575 _CNV_A_R_LINEAR_____476_CM 8 -1439.98976 1439.945815 DISPLAY_IDENTIFIER LDP_ANG_PSTE__TQ_LOSS_PSTE FORMAT "%8.2" /end AXIS_PTS
/begin AXIS_PTS ldp_vel_ang_pste__tq_loss_pste "" 0x114d2 vel_ang_pste _REC_AXS_20_u2 2879.935575 _CNV_A_R_LINEAR_____477_CM 8 -1439.98976 1439.945815 DISPLAY_IDENTIFIER LDP_VEL_ANG_PSTE__TQ_LOSS_PSTE FORMAT "%8.2" /end AXIS_PTS
/begin AXIS_PTS ldp_ang_pste__tq_add_pste "" 0x10908 ang_pste _REC_AXS_20_u2 2879.935575 _CNV_A_R_LINEAR_____476_CM 8 -1439.98976 1439.945815 DISPLAY_IDENTIFIER LDP_ANG_PSTE__TQ_ADD_PSTE FORMAT "%8.2" /end AXIS_PTS
/begin AXIS_PTS ldp_n__fac_tq_add_pste "" 0x10e94 n _REC_AXS_20_u2 8160. _CNV_A_R_LINEAR_____11_CM 8 0. 8160. DISPLAY_IDENTIFIER LDP_N__FAC_TQ_ADD_PSTE FORMAT "%4.0" /end AXIS_PTS
/begin AXIS_PTS ldp_n_32__fac_tq_req_driv_mon "" 0x1201a n_32_mon _REC_AXS_20_u1 8160. _CNV_A_R_LINEAR_____16_CM 8 0. 8160. DISPLAY_IDENTIFIER LDP_N_32__FAC_TQ_REQ_DRIV_MON FORMAT "%4.0" /end AXIS_PTS
/begin AXIS_PTS ldp_pv_av__fac_tq_req_driv_mon "" 0x1207b pv_av_mon _REC_AXS_20_u1 99.609375 _CNV_A_R_LINEAR_____10_CM 8 0. 99.609375 DISPLAY_IDENTIFIER LDP_PV_AV__FAC_TQ_REQ_DRIV_MON FORMAT "%5.2" /end AXIS_PTS
/begin AXIS_PTS ldp_tia_fac_n_vim "" 0x07e4b tia _REC_AXS_20_u1 190.5 _CNV_A_R_LINEAR_____12_CM 8 -48. 142.5 DISPLAY_IDENTIFIER LDP_TIA_FAC_N_VIM FORMAT "%5.1" /end AXIS_PTS
/begin AXIS_PTS ldp_seg_ctr_fac_wf "" 0x1113e seg_ctr_wf _REC_AXS_20_u2 65535. _CNV_A_R_LINEAR_____184_CM 4 0. 65535. DISPLAY_IDENTIFIER LDP_SEG_CTR_FAC_WF FORMAT "%5.0" /end AXIS_PTS
/begin AXIS_PTS ldp_tco_st_ti_fac_wf "" 0x011b7 tco_st _REC_AXS_20_u1 190.5 _CNV_A_R_LINEAR_____12_CM 4 -48. 142.5 DISPLAY_IDENTIFIER LDP_TCO_ST_TI_FAC_WF FORMAT "%5.1" /end AXIS_PTS
/begin AXIS_PTS ldp_tco_ti_wf_thd "" 0x011c3 tco _REC_AXS_20_u1 28.575 _CNV_A_R_LINEAR_____12_CM 4 -48. 142.5 DISPLAY_IDENTIFIER LDP_TCO_TI_WF_THD FORMAT "%5.1" /end AXIS_PTS
/begin AXIS_PTS ldpm_maf_6 "" 0x07f96 maf _REC_AXS_20_u1 1389. _CNV_A_R_LINEAR_____27_CM 8 0. 1389. DISPLAY_IDENTIFIER LDPM_MAF_6 FORMAT "%4.0" /end AXIS_PTS
/begin AXIS_PTS ldpm_n_29 "" 0x07fe2 n_32 _REC_AXS_20_u1 8160. _CNV_A_R_LINEAR_____16_CM 8 0. 8160. DISPLAY_IDENTIFIER LDPM_N_29 FORMAT "%4.0" /end AXIS_PTS
/begin AXIS_PTS ldpm_tib_ti_wf_thd "" 0x11c68 tib _REC_AXS_20_u2 262.14 _CNV_A_R_LINEAR_____198_CM 4 0. 262.14 DISPLAY_IDENTIFIER LDPM_TIB_TI_WF_THD FORMAT "%7.3" /end AXIS_PTS
/begin AXIS_PTS ldpm_vo_1 "" 0x082b0 vo _REC_AXS_20_u1 95.625 _CNV_A_R_LINEAR_____82_CM 8 0. 95.625 DISPLAY_IDENTIFIER LDPM_VO_1 FORMAT "%4.1" /end AXIS_PTS
/begin AXIS_PTS ldp_maf_sp_tqi "" 0x10db8 maf_sp_tqi _REC_AXS_20_u2 1389. _CNV_A_R_LINEAR_____106_CM 8 0. 1389. DISPLAY_IDENTIFIER LDP_MAF_SP_TQI FORMAT "%7.2" /end AXIS_PTS
/begin AXIS_PTS ldp_tia__fac_ti_wf "" 0x011e7 tia _REC_AXS_20_u1 190.5 _CNV_A_R_LINEAR_____12_CM 4 -48. 142.5 DISPLAY_IDENTIFIER LDP_TIA__FAC_TI_WF FORMAT "%5.1" /end AXIS_PTS
/begin AXIS_PTS ldp_tco__fac_ti_wf "" 0x01145 tco _REC_AXS_20_u1 190.5 _CNV_A_R_LINEAR_____12_CM 4 -48. 142.5 DISPLAY_IDENTIFIER LDP_TCO__FAC_TI_WF FORMAT "%5.1" /end AXIS_PTS
/begin AXIS_PTS ldpm_tco_15 "" 0x0818a tco _REC_AXS_20_u1 190.5 _CNV_A_R_LINEAR_____12_CM 8 -48. 142.5 DISPLAY_IDENTIFIER LDPM_TCO_15 FORMAT "%5.1" /end AXIS_PTS
/begin AXIS_PTS ldpm_tco_16 "" 0x013af tco _REC_AXS_20_u1 190.5 _CNV_A_R_LINEAR_____12_CM 3 -48. 142.5 DISPLAY_IDENTIFIER LDPM_TCO_16 FORMAT "%5.1" /end AXIS_PTS
/begin AXIS_PTS ldpm_n_32__seg_ad_cor "" 0x002ad n_32 _REC_AXS_20_u1 8160. _CNV_A_R_LINEAR_____16_CM 6 0. 8160. DISPLAY_IDENTIFIER LDPM_N_32__SEG_AD_COR FORMAT "%4.0" /end AXIS_PTS
/begin AXIS_PTS ldp_maf__maf_dif_max_er_ad "" 0x0320a maf _REC_AXS_20_u2 1389. _CNV_A_R_LINEAR_____106_CM 6 0. 1389. DISPLAY_IDENTIFIER LDP_MAF__MAF_DIF_MAX_ER_AD FORMAT "%7.2" /end AXIS_PTS
/begin AXIS_PTS ldp_tps_av__tps_grd_max_er_ad "" 0x03218 tps_av _REC_AXS_20_u2 119.5 _CNV_A_R_LINEAR_____53_CM 6 0. 119.5 DISPLAY_IDENTIFIER LDP_TPS_AV__TPS_GRD_MAX_ER_AD FORMAT "%7.3" /end AXIS_PTS
/begin AXIS_PTS ldp_load_mis__load_mis_dif_max "" 0x031fc load_mis _REC_AXS_20_u2 100. _CNV_A_R_LINEAR_____367_CM 6 0. 100. DISPLAY_IDENTIFIER LDP_LOAD_MIS__LOAD_MIS_DIF_MAX FORMAT "%7.3" /end AXIS_PTS
/begin AXIS_PTS ldp_load_mis__fac_add_er_0_at "" 0x03154 load_mis _REC_AXS_20_u2 99.99694824000001 _CNV_A_R_LINEAR_____519_CM 6 0. 99.99694824 DISPLAY_IDENTIFIER LDP_LOAD_MIS__FAC_ADD_ER_0_AT /end AXIS_PTS
/begin AXIS_PTS ldp_load_mis__fac_add_er_0_mt "" 0x03162 load_mis _REC_AXS_20_u2 99.99694824000001 _CNV_A_R_LINEAR_____519_CM 6 0. 99.99694824 DISPLAY_IDENTIFIER LDP_LOAD_MIS__FAC_ADD_ER_0_MT /end AXIS_PTS
/begin AXIS_PTS ldp_load_mis__fac_add_er_1_at "" 0x03170 load_mis _REC_AXS_20_u2 99.99694824000001 _CNV_A_R_LINEAR_____519_CM 6 0. 99.99694824 DISPLAY_IDENTIFIER LDP_LOAD_MIS__FAC_ADD_ER_1_AT /end AXIS_PTS
/begin AXIS_PTS ldp_load_mis__fac_add_er_1_mt "" 0x0317e load_mis _REC_AXS_20_u2 99.99694824000001 _CNV_A_R_LINEAR_____519_CM 6 0. 99.99694824 DISPLAY_IDENTIFIER LDP_LOAD_MIS__FAC_ADD_ER_1_MT /end AXIS_PTS
/begin AXIS_PTS ldp_load_mis__fac_add_er_2_at "" 0x0318c load_mis _REC_AXS_20_u2 99.99694824000001 _CNV_A_R_LINEAR_____519_CM 6 0. 99.99694824 DISPLAY_IDENTIFIER LDP_LOAD_MIS__FAC_ADD_ER_2_AT /end AXIS_PTS
/begin AXIS_PTS ldp_load_mis__fac_add_er_2_mt "" 0x0319a load_mis _REC_AXS_20_u2 99.99694824000001 _CNV_A_R_LINEAR_____519_CM 6 0. 99.99694824 DISPLAY_IDENTIFIER LDP_LOAD_MIS__FAC_ADD_ER_2_MT /end AXIS_PTS
/begin AXIS_PTS ldp_load_mis__fac_add_er_3_at "" 0x031a8 load_mis _REC_AXS_20_u2 99.99694824000001 _CNV_A_R_LINEAR_____519_CM 6 0. 99.99694824 DISPLAY_IDENTIFIER LDP_LOAD_MIS__FAC_ADD_ER_3_AT /end AXIS_PTS
/begin AXIS_PTS ldp_load_mis__fac_add_er_3_mt "" 0x031b6 load_mis _REC_AXS_20_u2 99.99694824000001 _CNV_A_R_LINEAR_____519_CM 6 0. 99.99694824 DISPLAY_IDENTIFIER LDP_LOAD_MIS__FAC_ADD_ER_3_MT /end AXIS_PTS
/begin AXIS_PTS ldp_load_mis__fac_add_er_4_at "" 0x031c4 load_mis _REC_AXS_20_u2 99.99694824000001 _CNV_A_R_LINEAR_____519_CM 6 0. 99.99694824 DISPLAY_IDENTIFIER LDP_LOAD_MIS__FAC_ADD_ER_4_AT /end AXIS_PTS
/begin AXIS_PTS ldp_load_mis__fac_add_er_4_mt "" 0x031d2 load_mis _REC_AXS_20_u2 99.99694824000001 _CNV_A_R_LINEAR_____519_CM 6 0. 99.99694824 DISPLAY_IDENTIFIER LDP_LOAD_MIS__FAC_ADD_ER_4_MT /end AXIS_PTS
/begin AXIS_PTS ldp_load_mis__fac_add_er_5_at "" 0x031e0 load_mis _REC_AXS_20_u2 99.99694824000001 _CNV_A_R_LINEAR_____519_CM 6 0. 99.99694824 DISPLAY_IDENTIFIER LDP_LOAD_MIS__FAC_ADD_ER_5_AT /end AXIS_PTS
/begin AXIS_PTS ldp_load_mis__fac_add_er_5_mt "" 0x031ee load_mis _REC_AXS_20_u2 99.99694824000001 _CNV_A_R_LINEAR_____519_CM 6 0. 99.99694824 DISPLAY_IDENTIFIER LDP_LOAD_MIS__FAC_ADD_ER_5_MT /end AXIS_PTS
/begin AXIS_PTS ldp_load_ip_fac_load_drv2_er_at "" 0x03120 load_mis _REC_AXS_20_u2 99.99694824000001 _CNV_A_R_LINEAR_____519_CM 12 0. 99.99694824 DISPLAY_IDENTIFIER LDP_LOAD_IP_FAC_LOAD_DRV2_ER_AT /end AXIS_PTS
/begin AXIS_PTS ldp_load_ip_fac_load_drv2_er_mt "" 0x0313a load_mis _REC_AXS_20_u2 99.99694824000001 _CNV_A_R_LINEAR_____519_CM 12 0. 99.99694824 DISPLAY_IDENTIFIER LDP_LOAD_IP_FAC_LOAD_DRV2_ER_MT /end AXIS_PTS
/begin AXIS_PTS ldp_n_32_ip_fac_n_drv2_er_at "" 0x02ce6 n_32 _REC_AXS_20_u1 8160. _CNV_A_R_LINEAR_____16_CM 12 0. 8160. DISPLAY_IDENTIFIER LDP_N_32_IP_FAC_N_DRV2_ER_AT FORMAT "%4.0" /end AXIS_PTS
/begin AXIS_PTS ldp_n_32_ip_fac_n_drv2_er_mt "" 0x02cf3 n_32 _REC_AXS_20_u1 8160. _CNV_A_R_LINEAR_____16_CM 12 0. 8160. DISPLAY_IDENTIFIER LDP_N_32_IP_FAC_N_DRV2_ER_MT FORMAT "%4.0" /end AXIS_PTS
/begin AXIS_PTS ldp_n_32_ip_crlc_drv2_er_at "" 0x02ccc n_32 _REC_AXS_20_u1 8160. _CNV_A_R_LINEAR_____16_CM 12 0. 8160. DISPLAY_IDENTIFIER LDP_N_32_IP_CRLC_DRV2_ER_AT FORMAT "%4.0" /end AXIS_PTS
/begin AXIS_PTS ldp_n_32_ip_crlc_drv2_er_mt "" 0x02cd9 n_32 _REC_AXS_20_u1 8160. _CNV_A_R_LINEAR_____16_CM 12 0. 8160. DISPLAY_IDENTIFIER LDP_N_32_IP_CRLC_DRV2_ER_MT FORMAT "%4.0" /end AXIS_PTS
/begin AXIS_PTS ldpm_n_32__fac_er_0_at "" 0x00259 n_32 _REC_AXS_20_u1 8160. _CNV_A_R_LINEAR_____16_CM 6 0. 8160. DISPLAY_IDENTIFIER LDPM_N_32__FAC_ER_0_AT FORMAT "%4.0" /end AXIS_PTS
/begin AXIS_PTS ldpm_n_32__fac_er_0_mt "" 0x00260 n_32 _REC_AXS_20_u1 8160. _CNV_A_R_LINEAR_____16_CM 6 0. 8160. DISPLAY_IDENTIFIER LDPM_N_32__FAC_ER_0_MT FORMAT "%4.0" /end AXIS_PTS
/begin AXIS_PTS ldpm_n_32__fac_er_1_at "" 0x00267 n_32 _REC_AXS_20_u1 8160. _CNV_A_R_LINEAR_____16_CM 6 0. 8160. DISPLAY_IDENTIFIER LDPM_N_32__FAC_ER_1_AT FORMAT "%4.0" /end AXIS_PTS
/begin AXIS_PTS ldpm_n_32__fac_er_1_mt "" 0x0026e n_32 _REC_AXS_20_u1 8160. _CNV_A_R_LINEAR_____16_CM 6 0. 8160. DISPLAY_IDENTIFIER LDPM_N_32__FAC_ER_1_MT FORMAT "%4.0" /end AXIS_PTS
/begin AXIS_PTS ldpm_n_32__fac_er_2_at "" 0x00275 n_32 _REC_AXS_20_u1 8160. _CNV_A_R_LINEAR_____16_CM 6 0. 8160. DISPLAY_IDENTIFIER LDPM_N_32__FAC_ER_2_AT FORMAT "%4.0" /end AXIS_PTS
/begin AXIS_PTS ldpm_n_32__fac_er_2_mt "" 0x0027c n_32 _REC_AXS_20_u1 8160. _CNV_A_R_LINEAR_____16_CM 6 0. 8160. DISPLAY_IDENTIFIER LDPM_N_32__FAC_ER_2_MT FORMAT "%4.0" /end AXIS_PTS
/begin AXIS_PTS ldpm_n_32__fac_er_3_at "" 0x00283 n_32 _REC_AXS_20_u1 8160. _CNV_A_R_LINEAR_____16_CM 6 0. 8160. DISPLAY_IDENTIFIER LDPM_N_32__FAC_ER_3_AT FORMAT "%4.0" /end AXIS_PTS
/begin AXIS_PTS ldpm_n_32__fac_er_3_mt "" 0x0028a n_32 _REC_AXS_20_u1 8160. _CNV_A_R_LINEAR_____16_CM 6 0. 8160. DISPLAY_IDENTIFIER LDPM_N_32__FAC_ER_3_MT FORMAT "%4.0" /end AXIS_PTS
/begin AXIS_PTS ldpm_n_32__fac_er_4_at "" 0x00291 n_32 _REC_AXS_20_u1 8160. _CNV_A_R_LINEAR_____16_CM 6 0. 8160. DISPLAY_IDENTIFIER LDPM_N_32__FAC_ER_4_AT FORMAT "%4.0" /end AXIS_PTS
/begin AXIS_PTS ldpm_n_32__fac_er_4_mt "" 0x00298 n_32 _REC_AXS_20_u1 8160. _CNV_A_R_LINEAR_____16_CM 6 0. 8160. DISPLAY_IDENTIFIER LDPM_N_32__FAC_ER_4_MT FORMAT "%4.0" /end AXIS_PTS
/begin AXIS_PTS ldpm_n_32__fac_er_5_at "" 0x0029f n_32 _REC_AXS_20_u1 8160. _CNV_A_R_LINEAR_____16_CM 6 0. 8160. DISPLAY_IDENTIFIER LDPM_N_32__FAC_ER_5_AT FORMAT "%4.0" /end AXIS_PTS
/begin AXIS_PTS ldpm_n_32__fac_er_5_mt "" 0x002a6 n_32 _REC_AXS_20_u1 8160. _CNV_A_R_LINEAR_____16_CM 6 0. 8160. DISPLAY_IDENTIFIER LDPM_N_32__FAC_ER_5_MT FORMAT "%4.0" /end AXIS_PTS
/begin MEASUREMENT B_dslfa "" UBYTE _CNV_A_R_LINEAR_____22_CM 1 100. 0. 255. DISPLAY_IDENTIFIER B_DSLFA ECU_ADDRESS 0x3fdf3c BIT_MASK 0x1 /end MEASUREMENT
/begin MEASUREMENT B_fasls "" UBYTE _CNV_A_R_LINEAR_____22_CM 1 100. 0. 255. DISPLAY_IDENTIFIER B_FASLS ECU_ADDRESS 0x3fdf3d BIT_MASK 0x1 /end MEASUREMENT
/begin MEASUREMENT imlpr "Relatives Luftmassenintegral bei Katheizung" UBYTE _CNV_R_R_fak_ub_b1_534_CM 1 100. 0. 0.99609375 DISPLAY_IDENTIFIER IMLPR ECU_ADDRESS 0x3fdf3b FORMAT "%8.4" /end MEASUREMENT
/begin MEASUREMENT B_idlgspec "Bedingung LLR-Anforderung" UBYTE _CNV_A_R_LINEAR_____22_CM 1 100. 0. 255. DISPLAY_IDENTIFIER B_IDLGSPEC ECU_ADDRESS 0x3fa42b BIT_MASK 0x1 /end MEASUREMENT
/begin MEASUREMENT ozpermBits1_1s "???" UBYTE _CNV_A_R_LINEAR_____1_CM 1 100. 0. 255. DISPLAY_IDENTIFIER OZPERMBITS1_1S ECU_ADDRESS 0x3fad73 FORMAT "%3.0" /end MEASUREMENT
/begin MEASUREMENT ozpermBits1_1s.B_ozdperm "Bedingung Delta Er-Ermittlung aktiv" UBYTE _CNV_A_R_LINEAR_____1_CM 1 100. 0. 255. DISPLAY_IDENTIFIER B_OZDPERM ECU_ADDRESS 0x3fad73 FORMAT "%3.0" BIT_MASK 0x1 /end MEASUREMENT
/begin MEASUREMENT ozpermBits1_1s.B_ozer0ok "Bedingung Permittivität beim letztem Ölwechsel endgültig berechnet" UBYTE _CNV_A_R_LINEAR_____1_CM 1 100. 0. 255. DISPLAY_IDENTIFIER B_OZER0OK ECU_ADDRESS 0x3fad73 FORMAT "%3.0" BIT_MASK 0x2 /end MEASUREMENT
/begin MEASUREMENT ozpermBits1_1s.B_ozerplt "Bedingung Ausheizzeit erfüllt" UBYTE _CNV_A_R_LINEAR_____1_CM 1 100. 0. 255. DISPLAY_IDENTIFIER B_OZERPLT ECU_ADDRESS 0x3fad73 FORMAT "%3.0" BIT_MASK 0x4 /end MEASUREMENT
/begin MEASUREMENT ozpermBits1_1s.B_ozregstg "Bedingung Schieberegistersteuerung" UBYTE _CNV_A_R_LINEAR_____1_CM 1 100. 0. 255. DISPLAY_IDENTIFIER B_OZREGSTG ECU_ADDRESS 0x3fad73 FORMAT "%3.0" BIT_MASK 0x8 /end MEASUREMENT
/begin MEASUREMENT ozpermBits1_1s.B_ozeranz "Bedingung für Anzeige Restweg aus Er" UBYTE _CNV_A_R_LINEAR_____1_CM 1 100. 0. 255. DISPLAY_IDENTIFIER B_OZERANZ ECU_ADDRESS 0x3fad73 FORMAT "%3.0" BIT_MASK 0x10 /end MEASUREMENT
/begin MEASUREMENT ozpermBits3_1s "???" UBYTE _CNV_A_R_LINEAR_____1_CM 1 100. 0. 255. DISPLAY_IDENTIFIER OZPERMBITS3_1S ECU_ADDRESS 0x3fad74 FORMAT "%3.0" /end MEASUREMENT
/begin MEASUREMENT ozpermBits3_1s.B_ozper0ok "Bedingung gültiger Start-Permittivitätswert" UBYTE _CNV_A_R_LINEAR_____1_CM 1 100. 0. 255. DISPLAY_IDENTIFIER B_OZPER0OK ECU_ADDRESS 0x3fad74 FORMAT "%3.0" BIT_MASK 0x1 /end MEASUREMENT
/begin MEASUREMENT ozpermBits3_1s.B_calcdper "Bedingung für Berechnung Restweg aus Er" UBYTE _CNV_A_R_LINEAR_____1_CM 1 100. 0. 255. DISPLAY_IDENTIFIER B_CALCDPER ECU_ADDRESS 0x3fad74 FORMAT "%3.0" BIT_MASK 0x2 /end MEASUREMENT
/begin MEASUREMENT ozpermBits2_1s "???" UBYTE _CNV_A_R_LINEAR_____1_CM 1 100. 0. 255. DISPLAY_IDENTIFIER OZPERMBITS2_1S ECU_ADDRESS 0x3faad2 FORMAT "%3.0" /end MEASUREMENT
/begin MEASUREMENT ozpermBits2_1s.B_ozpermgl "Bedingung gültiger Start-Permittivitätswert" UBYTE _CNV_A_R_LINEAR_____1_CM 1 100. 0. 255. DISPLAY_IDENTIFIER B_OZPERMGL ECU_ADDRESS 0x3faad2 FORMAT "%3.0" BIT_MASK 0x1 /end MEASUREMENT
/begin MEASUREMENT ozpermBits2_1s.B_ozpermpl "Bedingung für Berechnung Restweg aus Er" UBYTE _CNV_A_R_LINEAR_____1_CM 1 100. 0. 255. DISPLAY_IDENTIFIER B_OZPERMPL ECU_ADDRESS 0x3faad2 FORMAT "%3.0" BIT_MASK 0x2 /end MEASUREMENT
/begin MEASUREMENT ozrestkmBits_1s "???" UBYTE _CNV_A_R_LINEAR_____1_CM 1 100. 0. 255. DISPLAY_IDENTIFIER OZRESTKMBITS_1S ECU_ADDRESS 0x3fad8a FORMAT "%3.0" /end MEASUREMENT
/begin MEASUREMENT ozrestkmBits_1s.B_ozcntini "Bedingung für Initialisierung Ölzeitzähler" UBYTE _CNV_A_R_LINEAR_____1_CM 1 100. 0. 255. DISPLAY_IDENTIFIER B_OZCNTINI ECU_ADDRESS 0x3fad8a FORMAT "%3.0" BIT_MASK 0x1 /end MEASUREMENT
/begin MEASUREMENT ozrestkmBits_1s.B_ozrwanz0 "Bedingung für Restweganzeige = NULL" UBYTE _CNV_A_R_LINEAR_____1_CM 1 100. 0. 255. DISPLAY_IDENTIFIER B_OZRWANZ0 ECU_ADDRESS 0x3fad8a FORMAT "%3.0" BIT_MASK 0x2 /end MEASUREMENT
/begin AXIS_PTS ldp_tq_loss_alter_1__tq_alter "" 0x1131e tq_loss_alter_1 _REC_AXS_20_u2 2047.96875 _CNV_A_R_LINEAR_____186_CM 6 -1024. 1023.96875 DISPLAY_IDENTIFIER LDP_TQ_LOSS_ALTER_1__TQ_ALTER FORMAT "%6.2" /end AXIS_PTS
/begin AXIS_PTS ldp_n_32__tq_alter "" 0x0105e n_32 _REC_AXS_20_u1 816. _CNV_A_R_LINEAR_____16_CM 6 0. 8160. DISPLAY_IDENTIFIER LDP_N_32__TQ_ALTER FORMAT "%4.0" /end AXIS_PTS
/begin MEASUREMENT ugenslp "" UBYTE _CNV_R_R_spg_gencan_76_CM 1 100. 10.6 16.975 DISPLAY_IDENTIFIER UGENSLP ECU_ADDRESS 0x3fdef6 FORMAT "%8.4" /end MEASUREMENT
/begin AXIS_PTS ldp_iga_dif_av__eff_iga_mon2 "" 0x07b44 iga_dif_av _REC_AXS_20_u1 -95.625 _CNV_A_R_LINEAR_____204_CM 8 0. -95.625 DISPLAY_IDENTIFIER LDP_IGA_DIF_AV__EFF_IGA_MON2 FORMAT "%6.2" /end AXIS_PTS
/begin AXIS_PTS ldp_maf__iga_ref_mon2 "" 0x07b5e maf_mon2 _REC_AXS_20_u1 1389. _CNV_A_R_LINEAR_____27_CM 8 0. 1389. DISPLAY_IDENTIFIER LDP_MAF__IGA_REF_MON2 FORMAT "%4.0" /end AXIS_PTS
/begin AXIS_PTS ldp_maf__tqi_ref_mon2 "" 0x07b74 maf_mon2 _REC_AXS_20_u1 1389. _CNV_A_R_LINEAR_____27_CM 8 0. 1389. DISPLAY_IDENTIFIER LDP_MAF__TQI_REF_MON2 FORMAT "%4.0" /end AXIS_PTS
/begin AXIS_PTS ldp_n_32__iga_ref_mon2 "" 0x07bf1 n_32_mon2 _REC_AXS_20_u1 8160. _CNV_A_R_LINEAR_____16_CM 8 0. 8160. DISPLAY_IDENTIFIER LDP_N_32__IGA_REF_MON2 FORMAT "%4.0" /end AXIS_PTS
/begin AXIS_PTS ldp_n_32__tqi_dif_max_mon2 "" 0x01073 n_32_mon2 _REC_AXS_20_u1 8160. _CNV_A_R_LINEAR_____16_CM 4 0. 8160. DISPLAY_IDENTIFIER LDP_N_32__TQI_DIF_MAX_MON2 FORMAT "%4.0" /end AXIS_PTS
/begin AXIS_PTS ldp_n_32__tqi_ref_mon2 "" 0x01078 n_32_mon2 _REC_AXS_20_u1 8160. _CNV_A_R_LINEAR_____16_CM 6 0. 8160. DISPLAY_IDENTIFIER LDP_N_32__TQI_REF_MON2 FORMAT "%4.0" /end AXIS_PTS
/begin AXIS_PTS ldp_tqi_sp__tqi_dif_max_mon2 "" 0x0125c tqi_sp_mon2 _REC_AXS_20_u1 510. _CNV_A_R_LINEAR_____101_CM 4 0. 510. DISPLAY_IDENTIFIER LDP_TQI_SP__TQI_DIF_MAX_MON2 FORMAT "%3.0" /end AXIS_PTS
/begin AXIS_PTS ldp_n_32__fac_tq_req_driv_mon2 "" 0x07bdf n_32_mon2 _REC_AXS_20_u1 8160. _CNV_A_R_LINEAR_____16_CM 8 0. 8160. DISPLAY_IDENTIFIER LDP_N_32__FAC_TQ_REQ_DRIV_MON2 FORMAT "%4.0" /end AXIS_PTS
/begin AXIS_PTS ldp_pv_av__fac_tq_req_driv_mon2 "" 0x07d31 pv_av_mon2 _REC_AXS_20_u1 99.609375 _CNV_A_R_LINEAR_____10_CM 8 0. 99.609375 DISPLAY_IDENTIFIER LDP_PV_AV__FAC_TQ_REQ_DRIV_MON2 FORMAT "%5.2" /end AXIS_PTS
/begin AXIS_PTS ldpm_val_mo3_tst_rec_idx_mo2 "" 0x08291 val_mo3_tst_rec_idx_mo2 _REC_AXS_20_u1 11. _CNV_A_R_LINEAR_____1_CM 12 0. 11. DISPLAY_IDENTIFIER LDPM_VAL_MO3_TST_REC_IDX_MO2 FORMAT "%2.0" /end AXIS_PTS
/begin AXIS_PTS ldpm_tst_rec "" 0x08284 val_mo3_tst_rec_idx_mo2 _REC_AXS_20_u1 12. _CNV_A_R_LINEAR_____1_CM 12 0. 12. DISPLAY_IDENTIFIER LDPM_TST_REC FORMAT "%3.0" /end AXIS_PTS
/begin AXIS_PTS ldp_v_toil__toil "" 0x07eaf v_toil _REC_AXS_20_u1 4.998 _CNV_A_R_LINEAR_____44_CM 16 0. 4.998 DISPLAY_IDENTIFIER LDP_V_TOIL__TOIL FORMAT "%6.4" /end AXIS_PTS
/begin AXIS_PTS ldp_2_id_err_dtc_mis "" 0x1086a online_dummy _REC_AXS_20_u2 65535. _CNV_A_R_LINEAR_____1_CM 8 0. 65535. DISPLAY_IDENTIFIER LDP_2_ID_ERR_DTC_MIS FORMAT "%5.0" /end AXIS_PTS
/begin AXIS_PTS ldp_1_id_err_dtc_mis "" 0x01b8c online_dummy _REC_AXS_20_u2 65535. _CNV_A_R_LINEAR_____1_CM 2 0. 65535. DISPLAY_IDENTIFIER LDP_1_ID_ERR_DTC_MIS FORMAT "%5.0" /end AXIS_PTS
/begin AXIS_PTS ldpm_n_32_ip_egr_ratio "" 0x080e7 n_32 _REC_AXS_20_u1 8160. _CNV_A_R_LINEAR_____16_CM 12 0. 8160. DISPLAY_IDENTIFIER LDPM_N_32_IP_EGR_RATIO FORMAT "%4.0" /end AXIS_PTS
/begin AXIS_PTS ldpm_maf_ip_egr_ratio "" 0x11786 maf _REC_AXS_20_u2 1389. _CNV_A_R_LINEAR_____106_CM 12 0. 1389. DISPLAY_IDENTIFIER LDPM_MAF_IP_EGR_RATIO FORMAT "%7.2" /end AXIS_PTS
/begin AXIS_PTS ldpm_n_32__tqi_min_pu "" 0x080b6 n_32 _REC_AXS_20_u1 8160. _CNV_A_R_LINEAR_____16_CM 12 0. 8160. DISPLAY_IDENTIFIER LDPM_N_32__TQI_MIN_PU FORMAT "%4.0" /end AXIS_PTS
/begin AXIS_PTS ldpm_tco__tqi_min_pu "" 0x013e6 tco _REC_AXS_20_u1 190.5 _CNV_A_R_LINEAR_____12_CM 4 -48. 142.5 DISPLAY_IDENTIFIER LDPM_TCO__TQI_MIN_PU FORMAT "%5.1" /end AXIS_PTS
/begin AXIS_PTS ldpm_maf_cyl_ip_rel_flow_inc_cp "" 0x11758 maf_cyl _REC_AXS_20_u2 2047.96875 _CNV_A_R_LINEAR_____113_CM 6 0. 2047.96875 DISPLAY_IDENTIFIER LDPM_MAF_CYL_IP_REL_FLOW_INC_CP FORMAT "%6.2" /end AXIS_PTS
/begin AXIS_PTS ldpm_n_32_ip_rel_flow_max_cps "" 0x080f4 n_32 _REC_AXS_20_u1 8160. _CNV_A_R_LINEAR_____16_CM 12 0. 8160. DISPLAY_IDENTIFIER LDPM_N_32_IP_REL_FLOW_MAX_CPS FORMAT "%4.0" /end AXIS_PTS
/begin AXIS_PTS ldpm_n_32_ip_fuel_dly_cps "" 0x01365 n_32 _REC_AXS_20_u1 8160. _CNV_A_R_LINEAR_____16_CM 6 0. 8160. DISPLAY_IDENTIFIER LDPM_N_32_IP_FUEL_DLY_CPS FORMAT "%4.0" /end AXIS_PTS
/begin AXIS_PTS ldpm_n_32_s "" 0x08113 n_32 _REC_AXS_20_u1 8160. _CNV_A_R_LINEAR_____16_CM 16 0. 8160. DISPLAY_IDENTIFIER LDPM_N_32_S FORMAT "%4.0" /end AXIS_PTS
/begin AXIS_PTS ldpm_pq_estim_id_maf_fac_ofs "" 0x11a78 pq_estim _REC_AXS_20_u2 0.99998474 _CNV_A_R_LINEAR_____37_CM 16 0. 0.99998474 DISPLAY_IDENTIFIER LDPM_PQ_ESTIM_ID_MAF_FAC_OFS FORMAT "%7.5" /end AXIS_PTS
/begin AXIS_PTS ldpm_n_1_thro "" 0x118ae n _REC_AXS_20_u2 8160. _CNV_A_R_LINEAR_____11_CM 8 0. 8160. DISPLAY_IDENTIFIER LDPM_N_1_THRO FORMAT "%4.0" /end AXIS_PTS
/begin AXIS_PTS ldp_maf_sub__maf_sub_thd_mon "" 0x12017 maf_sub_1 _REC_AXS_20_u1 1389. _CNV_A_R_LINEAR_____27_CM 2 0. 1389. DISPLAY_IDENTIFIER LDP_MAF_SUB__MAF_SUB_THD_MON FORMAT "%4.0" /end AXIS_PTS
/begin MEASUREMENT cks_crc_ecu "" ULONG _CNV_A_R_LINEAR_____22_CM 1 100. 0. 4294967295. DISPLAY_IDENTIFIER CKS_CRC_ECU ECU_ADDRESS 0x3f9848 BYTE_ORDER MSB_LAST FORMAT "%11.0" /end MEASUREMENT
/begin MEASUREMENT state_iv "" UWORD _CNV_A_R_LINEAR_____1_CM 1 100. 0. 65535. DISPLAY_IDENTIFIER STATE_IV ECU_ADDRESS 0x3fb396 BYTE_ORDER MSB_LAST FORMAT "%5.0" /end MEASUREMENT
/begin MEASUREMENT cyl_id_sam_trig "" UBYTE _CNV_A_R_LINEAR_____176_CM 1 100. 1. 4. DISPLAY_IDENTIFIER CYL_ID_SAM_TRIG ECU_ADDRESS 0xffc5f3be FORMAT "%1.0" /end MEASUREMENT
/begin AXIS_PTS ldp_id_saf_tab_1 "" 0x07b22 online_dummy _REC_AXS_20_u1 255. _CNV_A_R_LINEAR_____1_CM 16 0. 255. DISPLAY_IDENTIFIER LDP_ID_SAF_TAB_1 FORMAT "%3.0" /end AXIS_PTS
/begin AXIS_PTS ldp_id_saf_tab_2 "" 0x07b33 online_dummy _REC_AXS_20_u1 255. _CNV_A_R_LINEAR_____1_CM 16 0. 255. DISPLAY_IDENTIFIER LDP_ID_SAF_TAB_2 FORMAT "%3.0" /end AXIS_PTS
/begin AXIS_PTS ldpm_n_id_crk_acq "" 0x119fc n _REC_AXS_20_u2 8160. _CNV_A_R_LINEAR_____11_CM 6 0. 8160. DISPLAY_IDENTIFIER LDPM_N_ID_CRK_ACQ FORMAT "%4.0" /end AXIS_PTS
/begin AXIS_PTS ldpm_n_id_cam_acq "" 0x119e2 n _REC_AXS_20_u2 8160. _CNV_A_R_LINEAR_____11_CM 12 0. 8160. DISPLAY_IDENTIFIER LDPM_N_ID_CAM_ACQ FORMAT "%4.0" /end AXIS_PTS
/begin AXIS_PTS ldpm_clas_a_id_clas_fmy "" 0x115ac online_dummy _REC_AXS_20_u2 65535. _CNV_A_R_LINEAR_____1_CM 16 0. 65535. DISPLAY_IDENTIFIER LDPM_CLAS_A_ID_CLAS_FMY FORMAT "%5.0" /end AXIS_PTS
/begin AXIS_PTS ldp_clas_b_id_clas_fmy "" 0x109b6 online_dummy _REC_AXS_20_u2 65535. _CNV_A_R_LINEAR_____1_CM 4 0. 65535. DISPLAY_IDENTIFIER LDP_CLAS_B_ID_CLAS_FMY FORMAT "%5.0" /end AXIS_PTS
/begin AXIS_PTS ldp_fmy_dtc "" 0x10ade online_dummy _REC_AXS_20_u2 5. _CNV_A_R_LINEAR_____22_CM 6 0. 5. DISPLAY_IDENTIFIER LDP_FMY_DTC FORMAT "%2.0" /end AXIS_PTS
/begin AXIS_PTS ldp_fmy_envd "" 0x00fbe online_dummy _REC_AXS_20_u1 3. _CNV_A_R_LINEAR_____22_CM 4 0. 3. DISPLAY_IDENTIFIER LDP_FMY_ENVD FORMAT "%2.0" /end AXIS_PTS
/begin AXIS_PTS ldpm_n_110 "" 0x07fd9 n_32 _REC_AXS_20_u1 8160. _CNV_A_R_LINEAR_____16_CM 8 0. 8160. DISPLAY_IDENTIFIER LDPM_N_110 FORMAT "%4.0" /end AXIS_PTS
/begin AXIS_PTS ldpm_gr_tra_at_2 "" 0x012eb gr_at _REC_AXS_20_u1 255. _CNV_A_R_LINEAR_____1_CM 7 0. 255. DISPLAY_IDENTIFIER LDPM_GR_TRA_AT_2 FORMAT "%3.0" /end AXIS_PTS
/begin AXIS_PTS ldpm_gr_tra_mt_2 "" 0x07f8d gr_mt _REC_AXS_20_u1 255. _CNV_A_R_LINEAR_____1_CM 8 0. 255. DISPLAY_IDENTIFIER LDPM_GR_TRA_MT_2 FORMAT "%3.0" /end AXIS_PTS
/begin AXIS_PTS ldp_toil_t_ramp_conv_pos "" 0x07e8c toil _REC_AXS_20_u1 200. _CNV_A_R_LINEAR_____15_CM 8 -40. 160. DISPLAY_IDENTIFIER LDP_TOIL_T_RAMP_CONV_POS FORMAT "%3.0" /end AXIS_PTS
/begin AXIS_PTS ldp_toil_t_ramp_conv_neg "" 0x07e83 toil _REC_AXS_20_u1 200. _CNV_A_R_LINEAR_____15_CM 8 -40. 160. DISPLAY_IDENTIFIER LDP_TOIL_T_RAMP_CONV_NEG FORMAT "%3.0" /end AXIS_PTS
/begin AXIS_PTS ldpm_n_dif_pred_fac_tq_add_is "" 0x119b6 n_dif_pred_pl_drof _REC_AXS_20_u2 65535. _CNV_A_R_LINEAR_____206_CM 8 -32768. 32767. DISPLAY_IDENTIFIER LDPM_N_DIF_PRED_FAC_TQ_ADD_IS FORMAT "%6.0" /end AXIS_PTS
/begin AXIS_PTS ldpm_n_t_n_dif_ofs_pred "" 0x11a0a n _REC_AXS_20_u2 8160. _CNV_A_R_LINEAR_____11_CM 8 0. 8160. DISPLAY_IDENTIFIER LDPM_N_T_N_DIF_OFS_PRED FORMAT "%4.0" /end AXIS_PTS
/begin AXIS_PTS ldpm_fac_tq_req_drof "" 0x11664 fac_tq_req _REC_AXS_20_u2 1.99996948 _CNV_A_R_LINEAR_____21_CM 6 0. 1.99996948 DISPLAY_IDENTIFIER LDPM_FAC_TQ_REQ_DROF FORMAT "%7.5" /end AXIS_PTS
/begin MEASUREMENT lv_inh_diag_obd2_lsh_up_1 "" UBYTE _CNV_S_2_RANGE______0_CM 1 100. 0. 1. DISPLAY_IDENTIFIER LV_INH_DIAG_OBD2_LSH_UP_1 ECU_ADDRESS 0x3fe4e4 /end MEASUREMENT
/begin MEASUREMENT lv_inh_diag_obd2_lsh_up_2 "" UBYTE _CNV_S_2_RANGE______0_CM 1 100. 0. 1. DISPLAY_IDENTIFIER LV_INH_DIAG_OBD2_LSH_UP_2 ECU_ADDRESS 0x3fe4e5 /end MEASUREMENT
/begin COMPU_METHOD _CNV_S_2_RANGE______0_CM "" TAB_VERB "%6.3" "[-]" COMPU_TAB_REF _CNV_S_2_RANGE______0 /end COMPU_METHOD
/begin COMPU_VTAB _CNV_S_2_RANGE______0 "" TAB_VERB 2 0 "0" 1 "1" /end COMPU_VTAB
/begin COMPU_METHOD _CNV_A_R_LINEAR_____1_CM "" RAT_FUNC "%6.3" "-" COEFFS 0 1. 0. 0 0 1 /end COMPU_METHOD
/begin COMPU_METHOD _CNV_S_2_RANGE______2_R_CM "" TAB_VERB "%6.3" "[-]" COMPU_TAB_REF _CNV_S_2_RANGE______2_R /end COMPU_METHOD
/begin COMPU_VTAB_RANGE _CNV_S_2_RANGE______2_R "" 2 0 0 "0" 1 255 "1" /end COMPU_VTAB_RANGE
/begin COMPU_METHOD _CNV_A_R_LINEAR_____3_CM "" RAT_FUNC "%6.3" "V" COEFFS 0 204.7999998974999 0. 0 0 1 /end COMPU_METHOD
/begin COMPU_METHOD _CNV_A_R_LINEAR_____4_CM "" RAT_FUNC "%6.3" "s" COEFFS 0 100. 0. 0 0 1 /end COMPU_METHOD
/begin COMPU_METHOD _CNV_S_2_RANGE______5_CM "" TAB_VERB "%6.3" "-" COMPU_TAB_REF _CNV_S_2_RANGE______5 /end COMPU_METHOD
/begin COMPU_VTAB _CNV_S_2_RANGE______5 "" TAB_VERB 2 0 "0" 1 "1" /end COMPU_VTAB
/begin COMPU_METHOD _CNV_A_R_LINEAR_____7_CM "" RAT_FUNC "%6.3" "°C" COEFFS 0 16. 0. 0 0 1 /end COMPU_METHOD
/begin COMPU_METHOD _CNV_A_R_LINEAR_____9_CM "" RAT_FUNC "%6.3" "%" COEFFS 0 655.3600000071681 0. 0 0 1 /end COMPU_METHOD
/begin COMPU_METHOD _CNV_A_R_LINEAR_____10_CM "" RAT_FUNC "%6.3" "%" COEFFS 0 2.56 0. 0 0 1 /end COMPU_METHOD
/begin COMPU_METHOD _CNV_A_R_LINEAR_____11_CM "" RAT_FUNC "%6.3" "rpm" COEFFS 0 1. 0. 0 0 1 /end COMPU_METHOD
/begin COMPU_METHOD _CNV_A_R_LINEAR_____12_CM "" RAT_FUNC "%6.3" "°C" COEFFS 0 1.333333333333333 64. 0 0 1 /end COMPU_METHOD
/begin COMPU_METHOD _CNV_A_R_LINEAR_____13_CM "" RAT_FUNC "%6.3" "°C" COEFFS 0 1.333333333333333 0. 0 0 1 /end COMPU_METHOD
/begin COMPU_METHOD _CNV_A_R_LINEAR_____15_CM "" RAT_FUNC "%6.3" "°C" COEFFS 0 1. 40. 0 0 1 /end COMPU_METHOD
/begin COMPU_METHOD _CNV_A_R_LINEAR_____16_CM "" RAT_FUNC "%6.3" "rpm" COEFFS 0 3.125e-002 0. 0 0 1 /end COMPU_METHOD
/begin COMPU_METHOD _CNV_A_R_LINEAR_____21_CM "" RAT_FUNC "%6.3" "-" COEFFS 0 32768.00003968061 0. 0 0 1 /end COMPU_METHOD
/begin COMPU_METHOD _CNV_A_R_LINEAR_____22_CM "" RAT_FUNC "%6.3" "[-]" COEFFS 0 1. 0. 0 0 1 /end COMPU_METHOD
/begin COMPU_METHOD _CNV_A_R_LINEAR_____23_CM "" RAT_FUNC "%6.3" "km/h" COEFFS 0 1. 0. 0 0 1 /end COMPU_METHOD
/begin COMPU_METHOD _CNV_A_R_LINEAR_____24_CM "" RAT_FUNC "%6.3" "s" COEFFS 0 10. 0. 0 0 1 /end COMPU_METHOD
/begin COMPU_METHOD _CNV_A_R_LINEAR_____27_CM "" RAT_FUNC "%6.3" "mg/stk" COEFFS 0 0.183585313174946 0. 0 0 1 /end COMPU_METHOD
/begin COMPU_METHOD _CNV_A_R_LINEAR_____29_CM "" RAT_FUNC "%6.3" "-" COEFFS 0 255.9983911655618 0. 0 0 1 /end COMPU_METHOD
/begin COMPU_METHOD _CNV_A_R_LINEAR_____31_CM "" RAT_FUNC "%6.3" "ms" COEFFS 0 0.1 0. 0 0 1 /end COMPU_METHOD
/begin COMPU_METHOD _CNV_A_R_LINEAR_____34_CM "" RAT_FUNC "%6.3" "V" COEFFS 0 9.846168103048838 0. 0 0 1 /end COMPU_METHOD
/begin COMPU_METHOD _CNV_A_R_LINEAR_____37_CM "" RAT_FUNC "%6.3" "-" COEFFS 0 65536.00007936121 0. 0 0 1 /end COMPU_METHOD
/begin COMPU_METHOD _CNV_A_R_LINEAR_____39_CM "" RAT_FUNC "%6.3" "-" COEFFS 0 127.9991955827809 0. 0 0 1 /end COMPU_METHOD
/begin COMPU_METHOD _CNV_A_R_LINEAR_____44_CM "" RAT_FUNC "%6.3" "V" COEFFS 0 51.0204081632653 0. 0 0 1 /end COMPU_METHOD
/begin COMPU_METHOD _CNV_A_R_LINEAR_____46_CM "" RAT_FUNC "%6.3" "-" COEFFS 0 16. 0. 0 0 1 /end COMPU_METHOD
/begin COMPU_METHOD _CNV_A_R_LINEAR_____47_CM "" RAT_FUNC "%6.3" "kg/h" COEFFS 0 64. 0. 0 0 1 /end COMPU_METHOD
/begin COMPU_METHOD _CNV_A_R_LINEAR_____49_CM "" RAT_FUNC "%6.3" "hPa" COEFFS 0 12.06017666543982 0. 0 0 1 /end COMPU_METHOD
/begin COMPU_METHOD _CNV_A_R_LINEAR_____50_CM "" RAT_FUNC "%6.3" "[-]" COEFFS 0 255.9999357490357 0. 0 0 1 /end COMPU_METHOD
/begin COMPU_METHOD _CNV_A_R_LINEAR_____53_CM "" RAT_FUNC "%6.3" "°TPS" COEFFS 0 137.0962343096234 0. 0 0 1 /end COMPU_METHOD
/begin COMPU_METHOD _CNV_A_R_LINEAR_____54_CM "" RAT_FUNC "%6.3" "rpm/s" COEFFS 0 3.125e-002 128. 0 0 1 /end COMPU_METHOD
/begin COMPU_METHOD _CNV_A_R_LINEAR_____55_CM "" RAT_FUNC "%6.3" "Nm" COEFFS 0 32. 0. 0 0 1 /end COMPU_METHOD
/begin COMPU_METHOD _CNV_A_R_LINEAR_____60_CM "" RAT_FUNC "%6.3" "V" COEFFS 0 9.807692307692308 0. 0 0 1 /end COMPU_METHOD
/begin COMPU_METHOD _CNV_R_R_spg_gencan_76_CM "" RAT_FUNC "%6.3" "V" COEFFS 0. 40. -424. 0. 0. 1. /end COMPU_METHOD
/begin COMPU_METHOD _CNV_A_R_LINEAR_____82_CM "" RAT_FUNC "%6.3" "°CRK" COEFFS 0 2.666666666666667 0. 0 0 1 /end COMPU_METHOD
/begin COMPU_METHOD _CNV_A_R_LINEAR_____85_CM "" RAT_FUNC "%6.3" "km/h" COEFFS 0 128.0000018750286 0. 0 0 1 /end COMPU_METHOD
/begin COMPU_METHOD _CNV_A_R_LINEAR_____88_CM "" RAT_FUNC "%6.3" "km" COEFFS 0 0.1 0. 0 0 1 /end COMPU_METHOD
/begin COMPU_METHOD _CNV_A_R_LINEAR_____95_CM "" RAT_FUNC "%6.3" "Nm" COEFFS 0 1. 0. 0 0 1 /end COMPU_METHOD
/begin COMPU_METHOD _CNV_A_R_LINEAR_____96_CM "" RAT_FUNC "%6.3" "l" COEFFS 0 1. 0. 0 0 1 /end COMPU_METHOD
/begin COMPU_METHOD _CNV_A_R_LINEAR_____97_CM "" RAT_FUNC "%6.3" "min" COEFFS 0 1. 0. 0 0 1 /end COMPU_METHOD
/begin COMPU_METHOD _CNV_A_R_LINEAR_____101_CM "" RAT_FUNC "%6.3" "Nm" COEFFS 0 0.5 0. 0 0 1 /end COMPU_METHOD
/begin COMPU_METHOD _CNV_A_R_LINEAR_____103_CM "" RAT_FUNC "%6.3" "m/s²" COEFFS 0 640. 32768. 0 0 1 /end COMPU_METHOD
/begin COMPU_METHOD _CNV_A_R_LINEAR_____106_CM "" RAT_FUNC "%6.3" "mg/stk" COEFFS 0 47.18142548596112 0. 0 0 1 /end COMPU_METHOD
/begin COMPU_METHOD _CNV_A_R_LINEAR_____111_CM "" RAT_FUNC "%6.3" "kg/h" COEFFS 0 8191.999999679995 0. 0 0 1 /end COMPU_METHOD
/begin COMPU_METHOD _CNV_A_R_LINEAR_____113_CM "" RAT_FUNC "%6.3" "kg/h" COEFFS 0 32. 0. 0 0 1 /end COMPU_METHOD
/begin COMPU_METHOD _CNV_A_R_LINEAR_____114_CM "" RAT_FUNC "%6.3" "hPa" COEFFS 0 12.06017666543982 32767.5 0 0 1 /end COMPU_METHOD
/begin COMPU_METHOD _CNV_A_R_LINEAR_____120_CM "" RAT_FUNC "%6.3" "[-]" COEFFS 0 32769.4989394353 0. 0 0 1 /end COMPU_METHOD
/begin COMPU_METHOD _CNV_A_R_LINEAR_____127_CM "" RAT_FUNC "%6.3" "[-]" COEFFS 0 64. 0. 0 0 1 /end COMPU_METHOD
/begin COMPU_METHOD _CNV_S_6_RANGE_STAT_132_CM "" TAB_VERB "%6.3" "-" COMPU_TAB_REF _CNV_S_6_RANGE_STAT_132 /end COMPU_METHOD
/begin COMPU_VTAB _CNV_S_6_RANGE_STAT_132 "" TAB_VERB 6 0 "ST_FIX_MFF_AD" 1 "S1_FIX_MFF_AD" 2 "S2_FIX_MFF_AD" 3 "S3_FIX_MFF_AD" 4 "S4_FIX_MFF_AD" 5 "END_FIX_MFF_AD" /end COMPU_VTAB
/begin COMPU_METHOD _CNV_A_R_LINEAR_____140_CM "" RAT_FUNC "%6.3" "ms" COEFFS 0 1. 0. 0 0 1 /end COMPU_METHOD
/begin COMPU_METHOD _CNV_A_R_LINEAR_____148_CM "" RAT_FUNC "%6.3" "km/h" COEFFS 0 128. 32768. 0 0 1 /end COMPU_METHOD
/begin COMPU_METHOD _CNV_A_R_LINEAR_____152_CM "" RAT_FUNC "%6.3" "%" COEFFS 0 2084.478388983038 32768.00027481336 0 0 1 /end COMPU_METHOD
/begin COMPU_METHOD _CNV_A_R_LINEAR_____157_CM "" RAT_FUNC "%6.3" "-" COEFFS 0 64. 0. 0 0 1 /end COMPU_METHOD
/begin COMPU_METHOD _CNV_A_R_LINEAR_____159_CM "" RAT_FUNC "%6.3" "%" COEFFS 0 655.3600000071681 32768.00000035841 0 0 1 /end COMPU_METHOD
/begin COMPU_METHOD _CNV_A_R_LINEAR_____163_CM "" RAT_FUNC "%6.3" "V" COEFFS 0 51400. 32767.5 0 0 1 /end COMPU_METHOD
/begin COMPU_METHOD _CNV_A_R_LINEAR_____164_CM "" RAT_FUNC "%6.3" "-" COEFFS 0 1023.999999919998 0. 0 0 1 /end COMPU_METHOD
/begin COMPU_METHOD _CNV_A_R_LINEAR_____167_CM "" RAT_FUNC "%6.3" "mA" COEFFS 0 163.8375 0. 0 0 1 /end COMPU_METHOD
/begin COMPU_METHOD _CNV_A_R_LINEAR_____172_CM "" RAT_FUNC "%6.3" "V" COEFFS 0 2510.769230769231 0. 0 0 1 /end COMPU_METHOD
/begin COMPU_METHOD _CNV_A_R_LINEAR_____176_CM "" RAT_FUNC "%6.3" "-" COEFFS 0 1. -1. 0 0 1 /end COMPU_METHOD
/begin COMPU_METHOD _CNV_A_R_LINEAR_____177_CM "" RAT_FUNC "%6.3" "°C" COEFFS 0 0.25 8.25 0 0 1 /end COMPU_METHOD
/begin COMPU_METHOD _CNV_A_R_LINEAR_____184_CM "" RAT_FUNC "%6.3" "Seg" COEFFS 0 1. 0. 0 0 1 /end COMPU_METHOD
/begin COMPU_METHOD _CNV_A_R_LINEAR_____186_CM "" RAT_FUNC "%6.3" "Nm" COEFFS 0 32. 32768. 0 0 1 /end COMPU_METHOD
/begin COMPU_METHOD _CNV_A_R_LINEAR_____198_CM "" RAT_FUNC "%6.3" "ms" COEFFS 0 250. 0. 0 0 1 /end COMPU_METHOD
/begin COMPU_METHOD _CNV_A_R_LINEAR_____199_CM "" RAT_FUNC "%6.3" "hPa" COEFFS 0 0.3768805207949945 0. 0 0 1 /end COMPU_METHOD
/begin COMPU_METHOD _CNV_A_R_LINEAR_____204_CM "" RAT_FUNC "%6.3" "°CRK" COEFFS 0 -2.666666666666667 0. 0 0 1 /end COMPU_METHOD
/begin COMPU_METHOD _CNV_A_R_LINEAR_____206_CM "" RAT_FUNC "%6.3" "rpm" COEFFS 0 1. 32768. 0 0 1 /end COMPU_METHOD
/begin COMPU_METHOD _CNV_A_R_LINEAR_____207_CM "" RAT_FUNC "%6.3" "V" COEFFS 0 35.63776976537597 0. 0 0 1 /end COMPU_METHOD
/begin COMPU_METHOD _CNV_A_R_LINEAR_____209_CM "" RAT_FUNC "%6.3" "°PORT" COEFFS 0 655.3600000071681 0. 0 0 1 /end COMPU_METHOD
/begin COMPU_METHOD _CNV_A_R_LINEAR_____215_CM "" RAT_FUNC "%6.3" "rpm" COEFFS 0 3.125e-002 128. 0 0 1 /end COMPU_METHOD
/begin COMPU_METHOD _CNV_A_R_LINEAR_____226_CM "" RAT_FUNC "%6.3" "°CRK" COEFFS 0 -2.666666666666667 -106.6666666666667 0 0 1 /end COMPU_METHOD
/begin COMPU_METHOD _CNV_A_R_LINEAR_____229_CM "" RAT_FUNC "%6.3" "°CRK" COEFFS 0 2.666666666666667 -160. 0 0 1 /end COMPU_METHOD
/begin COMPU_METHOD _CNV_A_R_LINEAR_____234_CM "" RAT_FUNC "%6.3" "ms" COEFFS 0 1.6 0. 0 0 1 /end COMPU_METHOD
/begin COMPU_METHOD _CNV_A_R_LINEAR_____242_CM "" RAT_FUNC "%6.3" "°CRK/s" COEFFS 0 2.666666666666667 0. 0 0 1 /end COMPU_METHOD
/begin COMPU_METHOD _CNV_A_R_LINEAR_____243_CM "" RAT_FUNC "%6.3" "µs" COEFFS 0 0.25 0. 0 0 1 /end COMPU_METHOD
/begin COMPU_METHOD _CNV_A_R_LINEAR_____246_CM "" RAT_FUNC "%6.3" "°CRK" COEFFS 0 2.666666666666667 160. 0 0 1 /end COMPU_METHOD
/begin COMPU_METHOD _CNV_A_R_LINEAR_____250_CM "" RAT_FUNC "%6.3" "V" COEFFS 0 13107.19998965744 0. 0 0 1 /end COMPU_METHOD
/begin COMPU_METHOD _CNV_A_R_LINEAR_____262_CM "" RAT_FUNC "%6.3" "°C" COEFFS 0 43.47840509520334 2086.96344456976 0 0 1 /end COMPU_METHOD
/begin COMPU_METHOD _CNV_A_R_LINEAR_____263_CM "" RAT_FUNC "%6.3" "mg/stk" COEFFS 0 47.14849960790521 32768.20722749412 0 0 1 /end COMPU_METHOD
/begin COMPU_METHOD _CNV_A_R_LINEAR_____266_CM "" RAT_FUNC "%6.3" "[-]" COEFFS 0 1023.999999959999 32767.99999871998 0 0 1 /end COMPU_METHOD
/begin COMPU_METHOD _CNV_A_R_LINEAR_____268_CM "" RAT_FUNC "%6.3" "s" COEFFS 0 2. 0. 0 0 1 /end COMPU_METHOD
/begin COMPU_METHOD _CNV_A_R_LINEAR_____271_CM "" RAT_FUNC "%6.3" "g" COEFFS 0 36.00036915004301 0. 0 0 1 /end COMPU_METHOD
/begin COMPU_METHOD _CNV_A_R_LINEAR_____275_CM "" RAT_FUNC "%6.3" "V" COEFFS 0 13107. 0. 0 0 1 /end COMPU_METHOD
/begin COMPU_METHOD _CNV_A_R_LINEAR_____276_CM "" RAT_FUNC "%6.3" "V/10ms" COEFFS 0 13107.26214524291 0.1553631072602002 0 0 1 /end COMPU_METHOD
/begin COMPU_METHOD _CNV_A_R_LINEAR_____277_CM "" RAT_FUNC "%6.3" "V/10ms" COEFFS 0 13107.20001587224 0. 0 0 1 /end COMPU_METHOD
/begin COMPU_METHOD _CNV_A_R_LINEAR_____279_CM "" RAT_FUNC "%6.3" "ohm" COEFFS 0 1. 0. 0 0 1 /end COMPU_METHOD
/begin COMPU_METHOD _CNV_A_R_LINEAR_____281_CM "" RAT_FUNC "%6.3" "W" COEFFS 0 1000. 0. 0 0 1 /end COMPU_METHOD
/begin COMPU_METHOD _CNV_A_R_LINEAR_____282_CM "" RAT_FUNC "%6.3" "°C" COEFFS 0 15.99999609363174 0. 0 0 1 /end COMPU_METHOD
/begin COMPU_METHOD _CNV_A_R_LINEAR_____283_CM "" RAT_FUNC "%6.3" "°C" COEFFS 0 15.99975585564965 0. 0 0 1 /end COMPU_METHOD
/begin COMPU_METHOD _CNV_A_R_LINEAR_____302_CM "" RAT_FUNC "%6.3" "°C" COEFFS 0 64. 2112. 0 0 1 /end COMPU_METHOD
/begin COMPU_METHOD _CNV_A_R_LINEAR_____308_CM "" RAT_FUNC "%6.3" "mg" COEFFS 0 6.25 0. 0 0 1 /end COMPU_METHOD
/begin COMPU_METHOD _CNV_A_R_LINEAR_____312_CM "" RAT_FUNC "%6.3" "V" COEFFS 0 204.8979314017341 1023.5 0 0 1 /end COMPU_METHOD
/begin COMPU_METHOD _CNV_A_R_LINEAR_____313_CM "" RAT_FUNC "%6.3" "-" COEFFS 0 63.60176282051283 0. 0 0 1 /end COMPU_METHOD
/begin COMPU_METHOD _CNV_A_R_LINEAR_____321_CM "" RAT_FUNC "%6.3" "°C" COEFFS 0 15.99999804684544 32767.99599993945 0 0 1 /end COMPU_METHOD
/begin COMPU_METHOD _CNV_A_R_LINEAR_____333_CM "" RAT_FUNC "%6.3" "cm²" COEFFS 0 1118.481084425738 0. 0 0 1 /end COMPU_METHOD
/begin COMPU_METHOD _CNV_A_R_LINEAR_____345_CM "" RAT_FUNC "%6.3" "-" COEFFS 0 8191.999999679995 0. 0 0 1 /end COMPU_METHOD
/begin COMPU_METHOD _CNV_A_R_LINEAR_____347_CM "" RAT_FUNC "%6.3" "°CRK" COEFFS 0 42.66666666666666 32768. 0 0 1 /end COMPU_METHOD
/begin COMPU_METHOD _CNV_A_R_LINEAR_____350_CM "" RAT_FUNC "%6.3" "mg/stk" COEFFS 0 47.18142548596112 32767.5 0 0 1 /end COMPU_METHOD
/begin COMPU_METHOD _CNV_A_R_LINEAR_____353_CM "" RAT_FUNC "%6.3" "°TPS" COEFFS 0 2.133891213389121 0. 0 0 1 /end COMPU_METHOD
/begin COMPU_METHOD _CNV_A_R_LINEAR_____354_CM "" RAT_FUNC "%6.3" "-" COEFFS 0 255.9999357490357 0. 0 0 1 /end COMPU_METHOD
/begin COMPU_METHOD _CNV_A_R_LINEAR_____355_CM "" RAT_FUNC "%6.3" "V" COEFFS 0 204.8 0. 0 0 1 /end COMPU_METHOD
/begin COMPU_METHOD _CNV_A_R_LINEAR_____359_CM "" RAT_FUNC "%6.3" "°TPS" COEFFS 0 137.0962343096234 16383. 0 0 1 /end COMPU_METHOD
/begin COMPU_METHOD _CNV_A_R_LINEAR_____367_CM "" RAT_FUNC "%6.3" "%" COEFFS 0 327.67 0. 0 0 1 /end COMPU_METHOD
/begin COMPU_METHOD _CNV_A_R_LINEAR_____387_CM "" RAT_FUNC "%6.3" "[-]" COEFFS 0 1.525855623540901e-005 0. 0 0 1 /end COMPU_METHOD
/begin COMPU_METHOD _CNV_A_R_LINEAR_____388_CM "" RAT_FUNC "%6.3" "-" COEFFS 0 2. 0. 0 0 1 /end COMPU_METHOD
/begin COMPU_METHOD _CNV_A_R_LINEAR_____394_CM "" RAT_FUNC "%6.3" "kg/h" COEFFS 0 128.0000018750286 0. 0 0 1 /end COMPU_METHOD
/begin COMPU_METHOD _CNV_A_R_LINEAR_____412_CM "" RAT_FUNC "%6.3" "V" COEFFS 0 204.7999998958713 8.135057072422569e-009 0 0 1 /end COMPU_METHOD
/begin COMPU_METHOD _CNV_A_R_LINEAR_____422_CM "" RAT_FUNC "%6.3" "°C" COEFFS 0 1.262376237623762 255. 0 0 1 /end COMPU_METHOD
/begin COMPU_METHOD _CNV_A_R_LINEAR_____423_CM "" RAT_FUNC "%6.3" "°C" COEFFS 0 1.331683168316832 269. 0 0 1 /end COMPU_METHOD
/begin COMPU_METHOD _CNV_A_R_LINEAR_____425_CM "" RAT_FUNC "%6.3" "KW" COEFFS 0 149.2228528379436 0. 0 0 1 /end COMPU_METHOD
/begin COMPU_METHOD _CNV_A_R_LINEAR_____426_CM "" RAT_FUNC "%6.3" "°CRK" COEFFS 0 2.666666666666667 255. 0 0 1 /end COMPU_METHOD
/begin COMPU_METHOD _CNV_A_R_LINEAR_____435_CM "" RAT_FUNC "%6.3" "mg" COEFFS 0 4. 32768. 0 0 1 /end COMPU_METHOD
/begin COMPU_METHOD _CNV_A_R_LINEAR_____441_CM "" RAT_FUNC "%6.3" "mm" COEFFS 0 1000. 0. 0 0 1 /end COMPU_METHOD
/begin COMPU_METHOD _CNV_A_R_LINEAR_____443_CM "" RAT_FUNC "%6.3" "V" COEFFS 0 51.2 0. 0 0 1 /end COMPU_METHOD
/begin COMPU_METHOD _CNV_A_R_LINEAR_____447_CM "" RAT_FUNC "%6.3" "°TPS" COEFFS 0 548.4100418410042 0. 0 0 1 /end COMPU_METHOD
/begin COMPU_METHOD _CNV_A_R_LINEAR_____460_CM "" RAT_FUNC "%6.3" "m/s²" COEFFS 0 2084.478388983038 32768.00027481336 0 0 1 /end COMPU_METHOD
/begin COMPU_METHOD _CNV_A_R_LINEAR_____476_CM "" RAT_FUNC "%6.3" "°STW" COEFFS 0 22.75571737399022 32768. 0 0 1 /end COMPU_METHOD
/begin COMPU_METHOD _CNV_A_R_LINEAR_____477_CM "" RAT_FUNC "%6.3" "°STW/s" COEFFS 0 22.75571737399022 32768. 0 0 1 /end COMPU_METHOD
/begin COMPU_METHOD _CNV_A_R_LINEAR_____519_CM "" RAT_FUNC "%6.3" "%" COEFFS 0 327.6800000071683 0. 0 0 1 /end COMPU_METHOD
/begin COMPU_METHOD _CNV_R_R_fak_ub_b1_534_CM "" RAT_FUNC "%6.3" "[-]" COEFFS 0. 256. 0. 0. 0. 1. /end COMPU_METHOD
/begin RECORD_LAYOUT _REC_AXS_20_u1 NO_AXIS_PTS_X 1 UBYTE AXIS_PTS_X 2 UBYTE INDEX_INCR DIRECT /end RECORD_LAYOUT
/begin RECORD_LAYOUT _REC_AXS_20_u2 NO_AXIS_PTS_X 1 UWORD AXIS_PTS_X 2 UWORD INDEX_INCR DIRECT /end RECORD_LAYOUT
/begin FUNCTION X__DDS_EXPA2_DEFAULT_FUNC__ "X__DDS_EXPA2_DEFAULT_FUNC__"
 /begin DEF_CHARACTERISTIC ldp_tco__ip_n_max_iv_diag ldpm_n_32_28 ldpm_fac_tq_req_ect_1 ldpm_gear_ef_1 ldpm_n_32__ef ldp_maf__thd_is_er_diag ldp_n__thd_is_er_diag ldp_tco__fac_thd_is_er_diag ldpm_vs_wheel_grd_mmv_thd ldp_vb_sof ldp_tia_sof ldpm_t_sof_act ldp_pv_av_sof_req_1 ldp_pv_av_sof_req_2 ldp_pv_av_sof_req_3 ldp_pv_av_sof_req_4 ldp_pv_av_sof_req_5 ldp_pv_av_sof_req_0 ldp_pv_av_sof_req_6 ldp_n_sof_req_1 ldp_n_sof_req_2 ldp_n_sof_req_3 ldp_n_sof_req_4 ldp_n_sof_req_5 ldp_n_sof_req_0 ldp_n_sof_req_6 ldpm_n_32__t_acc ldp_vs__amp_raw_cor ldp_v_amp_1__amp_raw ldp_v_amp_2__amp_raw ldpm_n_2_3 ldp_n_23 ldp_tps_av_id_tps_grd_bol_ae ldp_toil__t_dly_poil_swi_can ldpm_cam_edge_nr_0__win_chk ldpm_cam_edge_nr_1__win_chk ldpm_ctr_km_can ldp_vs_fil__tq_gs_inc_mon ldp_n_32__tq_gs_inc_mon ldpm_tco_2 ldp_flow_cor_cps_ip_cppwm ldpm_prs_cps_ip_cppwm ldp_amp_ip_fac_amp_cp ldp_tia_thr_ip_fac_tia_cp ldp_cl_ip_rel_flow_fac_cp ldpm_maf_ip_rel_flow_max_cps ldpm_cl_mmv_ip_nr_step_cl ldp_tco_ip_rel_fuel_max_cp_cor ldpm_vb_ip_cppwm_vb ldp_cppwm_ref_ip_cppwm_cor_frq ldp_cl_mmv_ip_t_max_cp ldpm_t_ctl_cru_1 ldp_vs_dif_cru__fac_prop_cru ldpm_vs_sp_dif_cru_1 ldpm_n_21 ldpm_vs_sp_cru_1 ldpm_ac_cru__fac_tq_cru ldpm_gear__fac_tq_cru ldp_n_32__fac_tq_cru ldpm_fac_tq_cru_1 ldp_n_32__fac_tq_req_clu_is ldp_vls_cyc_ratio_mv_1_ip_fac ldp_vls_cyc_ratio_mv_2_ip_fac ldp_maf_kgh_ip_fac_maf_1_cyl ldp_maf_kgh_ip_fac_maf_2_cyl ldpm_n_1_cybl ldpm_n_2_cybl ldp_maf_ip_dly_cyl_lam ldp_maf_ip_vls_dif_val ldp_vls_dif_val_ip_ti_ad_cyl ldp_vls_dif_val_ip_ti_cyl ldp_lamb_sp_ip_fac_vls_dif_lamb ldp_maf_kgh__crlc_vls_down ldp_ftl__t_cur_dmtl_stat ldp_ftl__t_small_leak_test ldp_vb_dmtl_fil__fac_cur_dmtl ldpm_cur_dmtldifrefroughleak_1 ldp_ftl__t_rough_leak_test ldp_n_ecf__n_ecf_min_accin ldp_tco__temp_sub_ecf_ini ldp_n_ecf_cor_fil__n_perc_ecf ldp_tco_ex__n_ecf ldp_tam__temp_sub_ecf_ini ldpm_temp_mmv_sub_cat_ecf_1 ldp_vs__n_ecf_vs_cor ldp_temp_gb__n_ecf_temp_gb ldp_tco__t_tooth_max ldp_vb__t_tooth_max ldp_n_32_vff_efp ldp_tco_t_efp_ast_max ldp_ftl_vff_vepu_ftl ldp_ftl_dif_vff_vepu_ftl_dif ldpm_tco_1_6 ldpm_gr_mt_3 ldpm_gr_at_3 ldp_tq_loss_ars_sp_can__puc ldpm_tco_9 ldp_n__t_min_pu ldp_tco__t_min_pu ldp_n_grd_n_dif_max_is ldp_amp_ip_load_clc_amp ldp_n_32_ip_load_clc ldp_maf_ip_load_clc ldp_n_vs_ratio_gr_mt ldp_iga_dif_eff_iga ldpm_tco_1_igsp ldp_lamb_sp__iga_bas_lamb ldpm_n_14 ldpm_maf_2 ldp_tco__fac_iga_ch_tco ldpm_n_32_1_iga ldpm_t_ast_1_iga ldpm_tco_st_1_iga ldp_fac_tq_req_clu__crlc_tq_add ldpm_n_32_2_iga ldpm_maf_hb_1_iga ldp_tco__iga_bas_temp_cor ldp_tia__iga_bas_temp_cor ldpm_n_32_fac_iga_pos_neg ldp_maf_fac_iga_pos_neg ldpm_cyc_cast_ip_iga_dif_min ldpm_n_32_2_igsp ldpm_maf_hb_2_igsp ldp_amp_ip_iga_dif_min_cyc_amp ldpm_n_dif_igsp ldpm_vb__td ldp_lamb_sp_iga_ref_lamb ldp_n_iga_ref_temp ldp_maf_iga_ref_temp ldp_tia__iga_ref_temp_fac ldp_n__iga_ref_vvt ldp_tco__iga_ref_temp_fac ldp_maf__iga_ref_vvt ldp_egr_ratio_cor__iga_ref_egr ldp_maf__iga_ref_port ldp_n_32__iga_bas_port ldp_port_av__fac_iga_bas_port ldp_eff_iga_sp_iga_dif_sp ldp_cyc_st_ip_iga_st_cyc_st_cor ldp_n_ip_iga_st_bas ldp_amp_ip_iga_st_amp_cor ldp_teg_dyn_hys ldp_n__v_dur_igc_min ldp_maf__v_dur_igc_min ldp_n_dif_cor__tq_i_dt_is ldp_n_dif_cor_tq_i_is ldp_n_grd_tq_i_is ldpm_tco_is_1 ldpm_gr_mt_2 ldpm_n_dif_cor_p_d_dt_is ldpm_n_grd_p_d_dt_is ldpm_n_dif_cor_p_d_is ldpm_n_grd_p_d_is ldpm_t_ast__fac_n_grd_is ldpm_tco__fac_n_grd_is ldpm_n_dif_cor_tq_i_is ldpm_n_grd_tq_i_is ldp_maf_lgrd_tq_add_is_bol ldp_n_sp_is_tq_add_is_bol_bas ldp_n_lgrd_tq_add_is_bol ldpm_maf_fac_tq_add_is ldp_tco_tq_add_is_bol_bas ldp_tia_ip_fac_temp_tq_add_is ldp_toil_ip_fac_temp_tq_add_is ldp_nr_pat__pat_ind ldpm_tco_st_4 ldpm_n_11 ldpm_maf_ivvt_1 ldpm_tco_17 ldpm_tco_st_1_ivvt ldpm_t_ast_1_ivvt ldp_n_32__fac_cam_sp_ch_opp ldp_dip__fac_cam_sp_ch_opp ldp_state_cmb_ctl_id_cmb_ivvt ldpm_ctr_km_can_1 ldpm_n_13 ldpm_n_5 ldpm_maf_ivvt_2 ldpm_toil_2_ivvt ldpm_cam_mdl_dif_ivvt ldpm_dly_ivvt_1_ivvt ldpm_n_32_4_ivvt ldpm_n_32_3_ivvt ldpm_n_32_2_ivvt ldpm_n_32_1_ivvt ldpm_toil_1_ivvt ldpm_cam_edge_nr ldp_vb__fac_ivvtpwm ldp_vb_ip_ivvthpwm ldpm_cam_dif_ivvt ldp_vel_drift_ip_ivvthpwm_cor ldp_t_drift_ivvthpwm ldpm_tmag_ivvt_1_ivvt ldpm_mff_mmv ldp_vo_fac_ivvt ldp_n_32__crlc_maf_ivvt ldp_maf_sp__crlc_maf_ivvt ldpm_n_4_9 ldpm_n_6_4 ldpm_n_iga_max_knk ldpm_maf_iga_max_knk ldp_tco__fac_iga_max_knk ldp_tia__fac_iga_max_knk ldpm_n_2_9 ldpm_maf_1_9 ldp_n_32__maf_min_knk_ad_2 ldp_tia__ip_fac_ron_ad_max ldp_tco__ip_fac_ron_ad_max ldpm_n_32_3_iga ldp_maf_iga__iga_tra_knk ldpm_n_32_7 ldp_fac_ron_ad_fac_iga_tra ldp_tia_fac_iga_tra ldpm_gear_1 ldp_vs_fac_iga_tra_gear_mt ldp_vs_fac_iga_tra_gear_at ldpm_n_32_1_lamb_ctl ldpm_maf_1_lamb_ctl ldpm_maf_2_lamb_ctl ldpm_tco_1_lam ldpm_n_32_2_lamb_ctl ldp_maf_cyl_ip_crlc_lam_mv_lpf ldpm_teg_cat_down_mdl_1_lam ldp_mff_ad_add_mmv_delta_add ldpm_tco_1_mff_ad ldp_mff_ad_add_mmv_2_mff_add ldp_mff_ad_fac_mmv_2_mff_fac ldpm_n_32_1_mff_ad ldp_mff_ad_fac_mmv_delta_h ldp_mff_ad_fac_mmv_delta_l ldp_n_32_maf_mff_ad_fac_l_max ldpm_n_32_maf_mff_ad_fac_l_min ldpm_n_32_maf_mff_ad_fac_h_min ldpm_maf_1_lasp ldpm_n_32_1_lasp ldp_n_32_ip_lamb_afl_1 ldp_tqi_req_slow_ip_lamb_afl_1 ldp_tco_st_ip_lamb_bas_wup_cor ldp_n_32_ip_lamb_hom_afl ldp_tqi_req_slow_ip_lamb_hom_afl ldp_tco_ip_lamb_bas_wup_cor ldp_n_32_ip_fac_lamb_wup ldp_n_32_ip_fac_lamb_wup_is ldp_maf_ip_fac_lamb_wup ldp_maf_ip_fac_lamb_wup_is ldp_tco__lamb_add_afl_ch ldp_t_ast__lamb_add_afl_ch ldp_tqi_req_slow__lamb_ch_rgl ldp_n_32__lamb_ch_rgl ldp_tqi_req_slow__lamb_ch_is ldp_n_32__lamb_ch_is ldp_t_cop_i__teg_cop ldp_fac_cop_i__teg_cop ldpm_eff_iga_av_teg_i__teg_cop ldp_n__lamb_fl ldpm_tco_st_tco_lam_min ldpm_tco_st_t_min_lscl ldp_tco__lamb_ref_add ldp_n__lamb_ref ldp_maf__lamb_ref ldp_lamb_dif__eff_lamb ldp_ntl_ip_lamb_rgn_fac_mdl ldp_vls_down_ip_lamb_rgn ldp_n_32_ip_lamb_rgn_afr ldp_maf_ip_lamb_rgn_afr ldp_tqi_req_slow__lamb_sawup ldp_tqi_req_slow__lamb_sawup_is ldp_n_32__lamb_sawup ldp_n_32__lamb_sawup_is ldp_t_ast__lamb_add_sawup ldp_tco__lamb_add_sawup ldp_eff_lamb_sp__lamb_dif_sp ldp_n_32__lamb_iga_afl ldp_maf_hb__lamb_iga_afl ldp_tco_ip_lamb_scc ldpm_n_32 ldp_n_ip_vls_sp_dly ldp_maf_ip_vls_sp_dly ldp_n_ip_fac_lam_dly ldp_maf_ip_fac_lam_dly ldp_maf_kgh_ip_fac_dly_p ldpm_vls_dif_dly ldpm_cat_ip_fac_cat_dly ldp_maf_kgh_ip_crlc_dly_i ldp_maf_int_puc ldp_temp_main_cat ldp_maf_cyl ldp_quo_maf_int_purge ldpm_cat_diag ldp_temp_pcat ldp_r_down_ls_ip_ttip_ls_down ldp_maf_kgh_crlc_ttip_ref_ls ldp_pow_lsh_down_mmv_r_down_ls ldp_ttip_ref_ls_down_mdl_r_down ldpm_t_vls_cyc_afl_hld ldp_maf_kgh_crlc_ttip_ref_ls_up ldp_r_up_ls_ip_ttip_ls_up ldp_pow_lsh_up_mmv_r_up_ls_mdl ldp_ttip_ref_ls_up_mdl_r_up_ls ldpm_temp_ls_ini_1_egcp ldp_vs_fac_v_efc_teg ldpm_n_32_1_egcp ldpm_teg_cat_up_mdl_1_egcp ldpm_teg_cat_down_mdl_1_egcp ldpm_temp_ls_down_ini_1_egcp ldp_n_32_ip_v_efc_lsh_down_ctl ldp_vs_ip_fac_v_efc_down_teg ldpm_tco_st_1_laco ldp_tco_st_t_dly_ls_ready ldpm_n_32__ti_lam ldpm_maf__ti_lam ldp_id_maf_tab_1 ldp_id_maf_tab_2 ldp_n__pq_sp_puls ldpm_tia_maf_mdl_con_1 ldp_teg_egr_maf_egr_con_1 ldpm_n_32_ar_red ldpm_maf_mes__vol_im ldpm_n_32__vol_im ldpm_n_32__vol_im_is ldp_pq__ip_pq_isa ldp_ar_red__ip_pq_isa ldpm_pq_ar_red ldpm_maf_kgh_t_1_hfm ldpm_n_ar_red ldpm_pq__fac_ar_red_cor ldp_t_seg_t_1_ratio_crlc_hfm ldp_ar_red_ad_add_dif ldp_n_32_ar_red_egr ldp_stk_av_egr_ar_red_egr ldpm_maf_cyl_ex ldp_n_32__ip_t_vim_eff_vol ldp_maf_cyl_amp_dec ldp_maf_kgh_mes_bas ldpm_vo__eff_vol ldp_n_32_ip_crlc_eff_vol_temp ldpm_amp__eff_vol_amp ldpm_n_32__eff_vol_cor ldpm_maf__eff_vol_cor ldpm_n__eff_vol ldpm_cam_av_mv_in__eff_vol ldp_tps_seg_ar_red_thr ldp_isapwm_mmv ldp_n_32__pq_egr_sp ldp_n_32__fac_maf_max_s ldp_mff_sp_s__fac_maf_max_s ldp_maf_dif_s__eff_maf_s ldp_mff_sp_s__pq_egr_sp ldp_maf_turb_ratio__maf_sp_isa ldp_n__maf_sp_isa ldp_n_32__crlc_maf_diag ldpm_pq_turb_sys ldp_isapwm__fac_pq_isa ldp_n_32_mon__maf_sub_mon ldp_pq_turb_sys_mon__fac_pq_isa ldp_tps_av_mon__fac_tps_isa_mon ldp_tps_av_mon__maf_sub_mon ldp_amp__fac_maf_sub_cor_mon ldp_n_32_mon__pq_mon ldp_tps_sum_av_mon__pq_mon ldp_tia__fac_maf_sub_cor_mon ldp_isapwm__fac_pq_isa_mon ldp_v_map_map_mes_bas ldp_maf__mff_cor_1 ldp_maf__mff_cor_2 ldp_n__mff_cor_1 ldp_n__mff_cor_2 ldpm_tqi_sp_mff_s ldp_tps_dif__mtcpwm_p ldp_tps_dif__mtcpwm_i ldp_tps_av_lih_dif_mtcpwm_i ldp_tps_dif_grd__mtcpwm_d ldp_tps_sp_lih_dif__mtcpwm_add ldp_vb__mtcpwm_vb_fac ldpm_n_tooth__eoi_st ldpm_tco__eoi_tco ldpm_tco_n_sp_2 ldpm_tco_n_sp_1 ldpm_t_ast_n_sp_1 ldpm_ctr_km_can_n_sp_1 ldpm_toil_ip_n_sp_is_cs ldp_n_32_n_grd_thd ldpm_gear ldp_pv_av__n_max_mtc_cur_off ldp_toil__n_max_2 ldp_toil__n_max_1 ldpm_n_32__lam_cat ldp_maf__o2_int_max_at ldp_maf__o2_int_max_mt ldp_n_32__o2_int_max_mt ldp_n_32__o2_int_max_at ldp_sum_vls_cat_o2 ldpm_vls_down ldp_toil_max__stop_dec_fsd ldp_tco_st__stop_inc_fsd ldpm_maf_kgh_1_t_vls_cycnr ldpm_n_32_1_t_vls_cyc ldpm_maf_2_t_vls_cyc ldp_maf_kgh__vls_down_max_cycnr ldp_maf_kgh__fac_maf_lsh_down ldp_ttip_ref_ls_down_ip_fac_teg ldp_r_up_mdl_sens_new_r_thd ldp_maf_kgh__fac_maf_lsh_up ldp_ttip_ref_ls_up_ip_fac_teg ldpm_ar_red_tot_bas ldp_opg_rel_st_ip_opg_sp_st_isa ldp_amp_ip_fac_amp_opg_st_isa ldp_tia_ip_fac_tia_opg_st_isa ldp_pv_av_ip_opg_rel_st_isa_pv ldp_n_32__pv_lih_max ldpm_vs_fil__pv_fac_cor ldpm_n_dif__pv_fac_cor ldpm_n__pv_fac_cor ldpm_pv_av_raw__pv_fac_cor ldpm_n_32__fac_tq_req_driv ldpm_fac_tq_cru_dcc ldp_v_pvs_min ldp_pv_av_min_mon_ip_pv_mon ldpm_tco_st_1_sair ldpm_n_32_maf_sa_deac ldpm_n_32_maf_sa_act ldp_ctr_km_can ldp_tco_st_id_t_dly_diag_sa ldp_tia_id_tco_min_diag_sa ldpm_fac_amp ldp_n_32__maf_max_diag_sa ldpm_n_32_id_saf_kgh_diag_min ldpm_n_32_id_saf_kgh_diag_max ldpm_maf_id_saf_kgh_diag_min ldpm_maf_id_saf_kgh_diag_max ldp_tco_st_id_sum_safm_diag ldp_maf_cyl__saf_mdl ldp_amp__saf_cor_amp ldp_vb__saf_cor_vb ldp_tam_ip_saf_cor_tam ldp_maf_kgh__tco_sub_inc ldp_v_tco__tco ldpm_tco_st__tco_dif_diag ldp_tco_st_id_t_tco_min ldpm_tia_1 ldp_vs_fil__tq_gs_inc ldp_n_32__tq_gs_inc ldp_v_tecu__tecu ldp_v_teg__teg ldpm_teg_stat_eng_pre ldpm_egr_ratio__teg ldpm_temp_toil_dif__fac_temp ldpm_lamb_sp_teg__fac_cor ldpm_nr_cyl_scc_teg__fac_scc ldpm_ecfpwm_ecf__fac_cor ldp_teg_stat__fac_tam ldpm_tam_dew__fac_teg ldpm_t_es_dew__fac_teg ldpm_temp_toil_dif__crlc_teg ldpm_temp_tco_dif__crlc_teg ldpm_maf_int_puc__crlc_teg ldpm_n_teg__vs_teg ldpm_tco_st__dew ldpm_teg_wall_cat_up_mdl_1 ldpm_teg_wall_cat_down_mdl_1 ldp_vs__fac_vs_teg ldp_pow_dif_max__add_teg_iga ldpm_vo_dif_teg__teg_stat ldpm_eff_iga_av_teg_cor ldpm_teg_stat__crlc_dec ldpm_teg_wall_stat__crlc_dec ldpm_teg_stat__crlc_inc ldpm_teg_wall_stat__crlc_inc ldpm_maf_teg__vs_teg ldpm_vs__fac_cor_vs_teg_ecf ldpm_vs_cor_teg__fac_cor ldp_vs_cor_teg_up_1__fac_cor ldpm_vs__fac_cor_vs_teg ldpm_maf_teg__teg_stat ldpm_n_teg__teg_stat ldpm_saf_kgh__fac_cor_saf ldpm_tco__fac_cor_tco_teg ldpm_tco__tco_eff_iga_teg ldpm_n_teg__crlc_teg ldp_maf_kgh_sp__amp_dec ldp_maf_sp__tps_sp_mdl_max ldp_n_32__tps_sp_mdl_max ldp_pq_sp__crlc_ar_red_sp ldp_pq_sp_isa ldp_ar_red_isa_sp_mmv ldp_maf_turb_ratio ldpm_vb_1 ldp_n_32__isapwm_isa_pwl ldp_isapwm_cor_isa__isapwm_isa ldp_ar_red_sp_mmv ldp_n_ip_fac_maf_dif_sp ldp_maf_dif_sp_cor_ip_maf_add ldp_pq_sp_wout_maf_add_ip_fac ldp_eoi__prs_inc_cmp ldp_crk_inj__prs_inc_cmp ldpm_prs_dec_inj__fac_ti_prs ldp_amp_mes_ti_st_amp_fac ldp_tco__mff_lgrd_ast ldp_cyc__mff_cst ldp_cyc_cast_ip_ti_deac_cast ldp_n_tooth__mff_cst ldp_tia_ip_ti_cast ldp_fac_cor_ti_cast ldp_map__ti_cast_fac_map ldpm_tco__mff_cst ldpm_tco__mff_deac_cst ldp_vb__ti_add_dly ldp_fup_map_dif__ti_add_dly ldp_vlft_av__cam_op_in_vvl ldp_n_32__eoi_bas ldp_n_32__eoi_bas_is ldp_ti_hom__eoi_bas ldp_ti_hom__eoi_bas_is ldp_tco__eoi_min_tipr ldp_cycnr_cst__fac_tipr_deac ldp_tco__mffpr_cst ldp_tco__mffpr_fac_st_es ldpm_tco__ti_st_rest ldp_tco_stop__fac_rest ldpm_tco__fac_stall ldp_t_es__rest ldp_t_ast_rest ldpm_maf_hb__ti_wup ldpm_tco__ti_wup ldp_tco_st__ti_tco_wup ldp_vo__ti_vo_wup ldpm_n_32__ti_wup ldp_map_dif__fac_ti_vo_wup ldp_map__ti_fac_n_map ldp_n_32__ti_fac_n_map ldp_toil_ti_fac_tia_toil ldp_tia_ti_fac_tia_toil ldp_tco__ti_fac_tco ldp_v_tia_tia ldpm_tco__reac ldp_map__fac_mff_map_wf ldpm_n_32__reac ldpm_cycnr_reac__reac ldp_tco_ip_tmag_ivvt ldp_toil_ip_tmag_ivvt ldp_pv_av_ip_tps_sp_st_pv ldp_tia_ip_fac_tia_tps_sp_st ldp_amp_ip_tps_sp_st_amp ldp_tps_rel_st_ip_tps_sp_st ldpm_tco__fac_tco_tqi ldpm_n_32_6 ldp_tps_av__maf_1_diag ldp_n_32__tps_max_ratio_diag ldp_n_32_tps_sp_pwl ldp_pv_av__tps_sp_ext ldpm_tco_1_thro ldp_n_ip_tps_sp_lgrd_st ldp_tco_ip_tps_sp_lgrd_st ldp_t_acc_ip_fac_tq_loss_acc_on ldp_n_32_ip_fac_tq_loss_acc_on ldp_n_32__tq_add_acc ldp_t_acc_fac_tq_loss_acc ldp_n_32__tq_add_heat_acc ldp_n_32__tq_loss_acc ldp_tq_accin_can__tq_loss_acc ldp_tq_loss_acc_inp__tq_add_acc ldpm_gr_at_100 ldpm_gr_mt_100 ldp_n_32__fac_tq_aj ldp_gear__fac_tq_aj ldpm_ac_veh_trv_tcs ldpm_vs_fil ldpm_n_32__tq_loss_ars ldp_tq_loss_ars_sp_can_max ldp_tq_loss_ars_av_can_max ldp_tco__tq_clu_amt ldp_n_dif__tq_clu_amt ldp_n_32_ip_tq_add_conv ldp_n_32_ip_tq_add_amt ldp_vs_fil__tq_clu_amt ldp_n_ratio_conv_fac_tq_conv ldp_toil_t_dly_n_sp_is ldp_toil_t_dly_conv ldp_toil_fac_conv ldp_gr_at_n_tur ldp_n_32__tq_conv ldp_vs_n_tur ldp_tq_conv_can__tq_conv ldpm_toil_tq_add_conv ldpm_vs_tq_add_conv ldp_n_grd_tq_add_conv ldp_ac_cru_tq_add_conv ldp_cl_mmv ldpm_n_100 ldp_maf_cyl_stk__tqfr ldp_tco__tqfr_add ldp_toil_tqfr_add ldp_n_tq_loss_lim ldp_tco_tq_loss_lim ldp_tco_st__tqfr_st ldp_tco_st__tqfr_dec_st ldp_amp_dif__tqfr_amp ldp_pq__tqfr_amp ldp_eff_scc_sp__nr_pat_scc ldpm_tco_ip_tq_st ldpm_n_dif_ip_tq_st ldp_n_32_mon__tqi_ref_mon ldp_maf_mon__tqi_ref_mon ldp_n_32_mon__iga_ref_mon ldp_maf_mon__iga_ref_mon ldp_iga_dif_av_mon__eff_iga_mon ldpm_n_fac_tq_req_driv ldpm_pv_av_fac_tq_req_driv ldpm_n_32_100 ldpm_maf_100 ldp_n_sp_is_ratio ldp_ecfpwm_ecf__pow_loss_ecf ldpm_n_32__maf_min_pu ldpm_tco__maf_min_pu ldp_mff_sp_s__tqi_ref_s ldp_tqi_sp_maf__maf_sp ldp_n_32__tqi_dif_lim ldp_tqi_sp_mon__tqi_dif_lim ldp_tqi_sp_mon__tqi_dif_max_mon ldp_n_32_mon__tqi_dif_max_mon ldp_n_dif_cor_mon_ip_tq_mon ldp_tco_mon_ip_fac_tq_p_d_mon ldp_tco_mon_ip_n_sp_is_mon ldp_n_tq_add_st ldp_tco_tq_add_st ldp_n_32_tq_add_tra ldp_tq_req_dif_tra_fac_tq_tra ldp_maf_mon__tq_loss_mon ldp_n_32_mon__tq_loss_mon ldp_tco_mon__tq_loss_mon ldp_ctr_km_can__tq_loss_mon ldp_n_32_mon__tq_max_clu_max_mon ldp_n_dif_mon_ip_tq_min_mon ldp_n_32_mon_ip_tqi_min_pu_mon ldp_tco_mon_ip_fac_conv_mon ldp_tco_mon_ip_tqi_min_pu_mon ldpm_gear__tq_p_max ldpm_vs_fil__tq_p_max ldp_ang_pste__tq_loss_pste ldp_vel_ang_pste__tq_loss_pste ldp_ang_pste__tq_add_pste ldp_n__fac_tq_add_pste ldp_n_32__fac_tq_req_driv_mon ldp_pv_av__fac_tq_req_driv_mon ldp_tia_fac_n_vim ldp_seg_ctr_fac_wf ldp_tco_st_ti_fac_wf ldp_tco_ti_wf_thd ldpm_maf_6 ldpm_n_29 ldpm_tib_ti_wf_thd ldpm_vo_1 ldp_maf_sp_tqi ldp_tia__fac_ti_wf ldp_tco__fac_ti_wf ldpm_tco_15 ldpm_tco_16 ldpm_n_32__seg_ad_cor ldp_maf__maf_dif_max_er_ad ldp_tps_av__tps_grd_max_er_ad ldp_load_mis__load_mis_dif_max ldp_load_mis__fac_add_er_0_at ldp_load_mis__fac_add_er_0_mt ldp_load_mis__fac_add_er_1_at ldp_load_mis__fac_add_er_1_mt ldp_load_mis__fac_add_er_2_at ldp_load_mis__fac_add_er_2_mt ldp_load_mis__fac_add_er_3_at ldp_load_mis__fac_add_er_3_mt ldp_load_mis__fac_add_er_4_at ldp_load_mis__fac_add_er_4_mt ldp_load_mis__fac_add_er_5_at ldp_load_mis__fac_add_er_5_mt ldp_load_ip_fac_load_drv2_er_at ldp_load_ip_fac_load_drv2_er_mt ldp_n_32_ip_fac_n_drv2_er_at ldp_n_32_ip_fac_n_drv2_er_mt ldp_n_32_ip_crlc_drv2_er_at ldp_n_32_ip_crlc_drv2_er_mt ldpm_n_32__fac_er_0_at ldpm_n_32__fac_er_0_mt ldpm_n_32__fac_er_1_at ldpm_n_32__fac_er_1_mt ldpm_n_32__fac_er_2_at ldpm_n_32__fac_er_2_mt ldpm_n_32__fac_er_3_at ldpm_n_32__fac_er_3_mt ldpm_n_32__fac_er_4_at ldpm_n_32__fac_er_4_mt ldpm_n_32__fac_er_5_at ldpm_n_32__fac_er_5_mt ldp_tq_loss_alter_1__tq_alter ldp_n_32__tq_alter ldp_iga_dif_av__eff_iga_mon2 ldp_maf__iga_ref_mon2 ldp_maf__tqi_ref_mon2 ldp_n_32__iga_ref_mon2 ldp_n_32__tqi_dif_max_mon2 ldp_n_32__tqi_ref_mon2 ldp_tqi_sp__tqi_dif_max_mon2 ldp_n_32__fac_tq_req_driv_mon2 ldp_pv_av__fac_tq_req_driv_mon2 ldpm_val_mo3_tst_rec_idx_mo2 ldpm_tst_rec ldp_v_toil__toil ldp_2_id_err_dtc_mis ldp_1_id_err_dtc_mis ldpm_n_32_ip_egr_ratio ldpm_maf_ip_egr_ratio ldpm_n_32__tqi_min_pu ldpm_tco__tqi_min_pu ldpm_maf_cyl_ip_rel_flow_inc_cp ldpm_n_32_ip_rel_flow_max_cps ldpm_n_32_ip_fuel_dly_cps ldpm_n_32_s ldpm_pq_estim_id_maf_fac_ofs ldpm_n_1_thro ldp_maf_sub__maf_sub_thd_mon ldp_id_saf_tab_1 ldp_id_saf_tab_2 ldpm_n_id_crk_acq ldpm_n_id_cam_acq ldpm_clas_a_id_clas_fmy ldp_clas_b_id_clas_fmy ldp_fmy_dtc ldp_fmy_envd ldpm_n_110 ldpm_gr_tra_at_2 ldpm_gr_tra_mt_2 ldp_toil_t_ramp_conv_pos ldp_toil_t_ramp_conv_neg ldpm_n_dif_pred_fac_tq_add_is ldpm_n_t_n_dif_ofs_pred ldpm_fac_tq_req_drof /end DEF_CHARACTERISTIC
 /begin OUT_MEASUREMENT tco_dif state_mff_ad_1_act cycnr_puc n_hys_puc n_min_puc ivvt_in_1.struct_ctl_ivvt.t_add_min_ivvt_adh ivvt_in_1.struct_ctl_ivvt.lv_adh_cdn_ivvt ivvt_in_1.struct_ctl_ivvt.t_sum_adh_ivvt ivvt_in_1.struct_ctl_ivvt.t_dly_adh_ivvt ivvt_in_1.struct_ctl_ivvt.cam_adh_old ivvt_in_1.struct_ctl_ivvt.cam_adh_act ivvt_in_1.struct_ctl_ivvt.cam_adj_dif_adh_ivvt ivvt_in_1.struct_ctl_ivvt.lv_err_ivvt_mec_ass ivvt_in_1.struct_pwm_ivvt.t_drift_ivvthpwm ivvt_in_1.struct_prj_ivvt.lv_ivvtpwm_ext_adj ivvt_in_1.struct_prj_ivvt.ivvtpwm_ext_adj ivvt_ex_1.struct_ctl_ivvt.t_add_min_ivvt_adh ivvt_ex_1.struct_ctl_ivvt.lv_adh_cdn_ivvt ivvt_ex_1.struct_ctl_ivvt.t_sum_adh_ivvt ivvt_ex_1.struct_ctl_ivvt.t_dly_adh_ivvt ivvt_ex_1.struct_ctl_ivvt.cam_adh_old ivvt_ex_1.struct_ctl_ivvt.cam_adh_act ivvt_ex_1.struct_ctl_ivvt.cam_adj_dif_adh_ivvt ivvt_ex_1.struct_ctl_ivvt.lv_err_ivvt_mec_ass ivvt_ex_1.struct_pwm_ivvt.t_drift_ivvthpwm ivvt_ex_1.struct_prj_ivvt.lv_ivvtpwm_ext_adj ivvt_ex_1.struct_prj_ivvt.ivvtpwm_ext_adj lam_bank_1.ls_act_chk_pl_inci.lv_inh_diag_chk_ls_down lam_bank_1.ls_down.bf.lv_vls_down_mmv_lmt lam_bank_1.ls_down.vls_down lam_bank_1.ls_down.vls_down_bol lam_bank_1.ls_down.vls_down_tol lam_bank_1.ls_down.vls_down_mmv_max lam_bank_1.ls_down.vls_down_mmv_min lam_bank_1.ls_down.vls_down_mmv_hys lam_bank_1.ls_down.drv1_vls_down_mmv lam_bank_1.ls_down.drv1_vls_down_abs_max lam_bank_1.ls_down.drv1_vls_down_mmv_min lam_bank_1.fsd_obd2.bf.lv_end_diag_win_fsd lam_bank_1.lsh_up_obd2.r_up_ls_thd_obd2_lsh_up lam_bank_1.lsh_down_obd2.r_down_ls_thd_obd2_lsh_down lam_bank_1.cat_eff_ldc_obd2.lv_lam_mv_ldc lam_bank_1.ls_down_rdy.bf.lv_down_ls lam_bank_2.ls_act_chk_pl_inci.lv_inh_diag_chk_ls_down lam_bank_2.ls_down.bf.lv_vls_down_mmv_lmt lam_bank_2.ls_down.vls_down lam_bank_2.ls_down.vls_down_bol lam_bank_2.ls_down.vls_down_tol lam_bank_2.ls_down.vls_down_mmv_max lam_bank_2.ls_down.vls_down_mmv_min lam_bank_2.ls_down.vls_down_mmv_hys lam_bank_2.ls_down.drv1_vls_down_mmv lam_bank_2.ls_down.drv1_vls_down_abs_max lam_bank_2.ls_down.drv1_vls_down_mmv_min lam_bank_2.fsd_obd2.bf.lv_end_diag_win_fsd lam_bank_2.lsh_up_obd2.r_up_ls_thd_obd2_lsh_up lam_bank_2.lsh_down_obd2.r_down_ls_thd_obd2_lsh_down lam_bank_2.cat_eff_ldc_obd2.lv_lam_mv_ldc lam_bank_2.ls_down_rdy.bf.lv_down_ls lv_err_mis_low_fuel seg_nr lv_fmy_exit_st lv_max_err_fsd_1 lv_min_err_fsd_1 cycnr_st port_av stk_av_egr lv_inh_diag_ls_down_1 lv_inh_diag_ls_down_2 n_ratio_conv tq_dif_tra B_dslfa B_fasls imlpr B_idlgspec ozpermBits1_1s ozpermBits1_1s.B_ozdperm ozpermBits1_1s.B_ozer0ok ozpermBits1_1s.B_ozerplt ozpermBits1_1s.B_ozregstg ozpermBits1_1s.B_ozeranz ozpermBits3_1s ozpermBits3_1s.B_ozper0ok ozpermBits3_1s.B_calcdper ozpermBits2_1s ozpermBits2_1s.B_ozpermgl ozpermBits2_1s.B_ozpermpl ozrestkmBits_1s ozrestkmBits_1s.B_ozcntini ozrestkmBits_1s.B_ozrwanz0 ugenslp cks_crc_ecu state_iv cyl_id_sam_trig lv_inh_diag_obd2_lsh_up_1 lv_inh_diag_obd2_lsh_up_2 /end OUT_MEASUREMENT
/end FUNCTION
/end MODULE
/end PROJECT
