ASAP2_VERSION 1 4
/begin PROJECT P_558 "EDC17_CP02"
/begin HEADER "" VERSION "V1C1" PROJECT_NO P_558 /end HEADER
/begin MODULE DIM ""
/begin MOD_COMMON "" BYTE_ORDER MSB_LAST ALIGNMENT_BYTE 1 ALIGNMENT_WORD 2 ALIGNMENT_LONG 4 ALIGNMENT_FLOAT32_IEEE 4 /end MOD_COMMON
/begin CHARACTERISTIC DINH_FId.DFC_AirCtlGovDvtEOMMax_CA "/" VAL_BLK 0x80074EE2 ValA_Wu16 413. DINH_FIdVerb 0.00 413. FORMAT "%2.0" NUMBER 5 /end CHARACTERISTIC
/begin CHARACTERISTIC DINH_FId.DFC_AirCtlGovDvtEOMMin_CA "/" VAL_BLK 0x80074EEC ValA_Wu16 413. DINH_FIdVerb 0.00 413. FORMAT "%2.0" NUMBER 5 /end CHARACTERISTIC
/begin CHARACTERISTIC DINH_FId.DFC_AirCtlGovDvtMax_CA "/" VAL_BLK 0x80074EF6 ValA_Wu16 413. DINH_FIdVerb 0.00 413. FORMAT "%2.0" NUMBER 10 /end CHARACTERISTIC
/begin CHARACTERISTIC DINH_FId.DFC_AirCtlGovDvtMin_CA "/" VAL_BLK 0x80074F0A ValA_Wu16 413. DINH_FIdVerb 0.00 413. FORMAT "%2.0" NUMBER 6 /end CHARACTERISTIC
/begin CHARACTERISTIC DINH_FId.DFC_Cj945SpiCom1_CA "/" VAL_BLK 0x80074F16 ValA_Wu16 413. DINH_FIdVerb 0.00 413. FORMAT "%2.0" NUMBER 6 /end CHARACTERISTIC
/begin CHARACTERISTIC DINH_FId.DFC_ComButtonMSASig_CA "/" VAL_BLK 0x80074F22 ValA_Wu16 413. DINH_FIdVerb 0.00 413. FORMAT "%2.0" NUMBER 5 /end CHARACTERISTIC
/begin CHARACTERISTIC DINH_FId.DFC_ComButtonMSATo_CA "/" VAL_BLK 0x80074F2C ValA_Wu16 413. DINH_FIdVerb 0.00 413. FORMAT "%2.0" NUMBER 5 /end CHARACTERISTIC
/begin CHARACTERISTIC DINH_FId.DFC_ComGearboxData2Sig_CA "/" VAL_BLK 0x80074F36 ValA_Wu16 413. DINH_FIdVerb 0.00 413. FORMAT "%2.0" NUMBER 5 /end CHARACTERISTIC
/begin CHARACTERISTIC DINH_FId.DFC_ComGearboxData2To_CA "/" VAL_BLK 0x80074F40 ValA_Wu16 413. DINH_FIdVerb 0.00 413. FORMAT "%2.0" NUMBER 5 /end CHARACTERISTIC
/begin CHARACTERISTIC DINH_FId.DFC_ComGearboxDataSig_CA "/" VAL_BLK 0x80074F4A ValA_Wu16 413. DINH_FIdVerb 0.00 413. FORMAT "%2.0" NUMBER 5 /end CHARACTERISTIC
/begin CHARACTERISTIC DINH_FId.DFC_ComGearboxDataTo_CA "/" VAL_BLK 0x80074F54 ValA_Wu16 413. DINH_FIdVerb 0.00 413. FORMAT "%2.0" NUMBER 5 /end CHARACTERISTIC
/begin CHARACTERISTIC DINH_FId.DFC_ComHeatACSig_CA "/" VAL_BLK 0x80074F5E ValA_Wu16 413. DINH_FIdVerb 0.00 413. FORMAT "%2.0" NUMBER 5 /end CHARACTERISTIC
/begin CHARACTERISTIC DINH_FId.DFC_ComHeatACTo_CA "/" VAL_BLK 0x80074F68 ValA_Wu16 413. DINH_FIdVerb 0.00 413. FORMAT "%2.0" NUMBER 5 /end CHARACTERISTIC
/begin CHARACTERISTIC DINH_FId.DFC_ComLenkradwinkelSig_CA "/" VAL_BLK 0x80074F72 ValA_Wu16 413. DINH_FIdVerb 0.00 413. FORMAT "%2.0" NUMBER 5 /end CHARACTERISTIC
/begin CHARACTERISTIC DINH_FId.DFC_ComLenkradwinkelTo_CA "/" VAL_BLK 0x80074F7C ValA_Wu16 413. DINH_FIdVerb 0.00 413. FORMAT "%2.0" NUMBER 5 /end CHARACTERISTIC
/begin CHARACTERISTIC DINH_FId.DFC_ComMileageRangeSig_CA "/" VAL_BLK 0x80074F86 ValA_Wu16 413. DINH_FIdVerb 0.00 413. FORMAT "%2.0" NUMBER 5 /end CHARACTERISTIC
/begin CHARACTERISTIC DINH_FId.DFC_ComMileageRangeTo_CA "/" VAL_BLK 0x80074F90 ValA_Wu16 413. DINH_FIdVerb 0.00 413. FORMAT "%2.0" NUMBER 5 /end CHARACTERISTIC
/begin CHARACTERISTIC DINH_FId.DFC_ComPspSig_CA "/" VAL_BLK 0x80074F9A ValA_Wu16 413. DINH_FIdVerb 0.00 413. FORMAT "%2.0" NUMBER 5 /end CHARACTERISTIC
/begin CHARACTERISTIC DINH_FId.DFC_ComPspTo_CA "/" VAL_BLK 0x80074FA4 ValA_Wu16 413. DINH_FIdVerb 0.00 413. FORMAT "%2.0" NUMBER 5 /end CHARACTERISTIC
/begin CHARACTERISTIC DINH_FId.DFC_ComShutOffPSPSig_CA "/" VAL_BLK 0x80074FAE ValA_Wu16 413. DINH_FIdVerb 0.00 413. FORMAT "%2.0" NUMBER 5 /end CHARACTERISTIC
/begin CHARACTERISTIC DINH_FId.DFC_ComShutOffPSPTo_CA "/" VAL_BLK 0x80074FB8 ValA_Wu16 413. DINH_FIdVerb 0.00 413. FORMAT "%2.0" NUMBER 5 /end CHARACTERISTIC
/begin CHARACTERISTIC DINH_FId.DFC_ComStKombiCtr_CA "/" VAL_BLK 0x80074FC2 ValA_Wu16 413. DINH_FIdVerb 0.00 413. FORMAT "%2.0" NUMBER 5 /end CHARACTERISTIC
/begin CHARACTERISTIC DINH_FId.DFC_ComStKombiSig_CA "/" VAL_BLK 0x80074FCC ValA_Wu16 413. DINH_FIdVerb 0.00 413. FORMAT "%2.0" NUMBER 5 /end CHARACTERISTIC
/begin CHARACTERISTIC DINH_FId.DFC_ComStKombiTo_CA "/" VAL_BLK 0x80074FD6 ValA_Wu16 413. DINH_FIdVerb 0.00 413. FORMAT "%2.0" NUMBER 5 /end CHARACTERISTIC
/begin CHARACTERISTIC DINH_FId.DFC_ComStateARSCtr_CA "/" VAL_BLK 0x80074FE0 ValA_Wu16 413. DINH_FIdVerb 0.00 413. FORMAT "%2.0" NUMBER 5 /end CHARACTERISTIC
/begin CHARACTERISTIC DINH_FId.DFC_ComStateARSSig_CA "/" VAL_BLK 0x80074FEA ValA_Wu16 413. DINH_FIdVerb 0.00 413. FORMAT "%2.0" NUMBER 5 /end CHARACTERISTIC
/begin CHARACTERISTIC DINH_FId.DFC_ComStateARSTo_CA "/" VAL_BLK 0x80074FF4 ValA_Wu16 413. DINH_FIdVerb 0.00 413. FORMAT "%2.0" NUMBER 5 /end CHARACTERISTIC
/begin CHARACTERISTIC DINH_FId.DFC_ComStateDscSig_CA "/" VAL_BLK 0x80074FFE ValA_Wu16 413. DINH_FIdVerb 0.00 413. FORMAT "%2.0" NUMBER 5 /end CHARACTERISTIC
/begin CHARACTERISTIC DINH_FId.DFC_ComStateDscTo_CA "/" VAL_BLK 0x80075008 ValA_Wu16 413. DINH_FIdVerb 0.00 413. FORMAT "%2.0" NUMBER 5 /end CHARACTERISTIC
/begin CHARACTERISTIC DINH_FId.DFC_ComStateSeatSig_CA "/" VAL_BLK 0x80075012 ValA_Wu16 413. DINH_FIdVerb 0.00 413. FORMAT "%2.0" NUMBER 5 /end CHARACTERISTIC
/begin CHARACTERISTIC DINH_FId.DFC_ComStateSeatTo_CA "/" VAL_BLK 0x8007501C ValA_Wu16 413. DINH_FIdVerb 0.00 413. FORMAT "%2.0" NUMBER 5 /end CHARACTERISTIC
/begin CHARACTERISTIC DINH_FId.DFC_ComTempRelTimeSig_CA "/" VAL_BLK 0x80075026 ValA_Wu16 413. DINH_FIdVerb 0.00 413. FORMAT "%2.0" NUMBER 5 /end CHARACTERISTIC
/begin CHARACTERISTIC DINH_FId.DFC_ComTempRelTimeTo_CA "/" VAL_BLK 0x80075030 ValA_Wu16 413. DINH_FIdVerb 0.00 413. FORMAT "%2.0" NUMBER 5 /end CHARACTERISTIC
/begin CHARACTERISTIC DINH_FId.DFC_ComTerminalChk_CA "/" VAL_BLK 0x8007503A ValA_Wu16 413. DINH_FIdVerb 0.00 413. FORMAT "%2.0" NUMBER 5 /end CHARACTERISTIC
/begin CHARACTERISTIC DINH_FId.DFC_ComTerminalCtr_CA "/" VAL_BLK 0x80075044 ValA_Wu16 413. DINH_FIdVerb 0.00 413. FORMAT "%2.0" NUMBER 5 /end CHARACTERISTIC
/begin CHARACTERISTIC DINH_FId.DFC_ComTerminalSig_CA "/" VAL_BLK 0x8007504E ValA_Wu16 413. DINH_FIdVerb 0.00 413. FORMAT "%2.0" NUMBER 5 /end CHARACTERISTIC
/begin CHARACTERISTIC DINH_FId.DFC_ComTerminalTo_CA "/" VAL_BLK 0x80075058 ValA_Wu16 413. DINH_FIdVerb 0.00 413. FORMAT "%2.0" NUMBER 5 /end CHARACTERISTIC
/begin CHARACTERISTIC DINH_FId.DFC_ComTimeDateSig_CA "/" VAL_BLK 0x80075062 ValA_Wu16 413. DINH_FIdVerb 0.00 413. FORMAT "%2.0" NUMBER 5 /end CHARACTERISTIC
/begin CHARACTERISTIC DINH_FId.DFC_ComTimeDateTo_CA "/" VAL_BLK 0x8007506C ValA_Wu16 413. DINH_FIdVerb 0.00 413. FORMAT "%2.0" NUMBER 5 /end CHARACTERISTIC
/begin CHARACTERISTIC DINH_FId.DFC_ComTrailerSig_CA "/" VAL_BLK 0x80075076 ValA_Wu16 413. DINH_FIdVerb 0.00 413. FORMAT "%2.0" NUMBER 5 /end CHARACTERISTIC
/begin CHARACTERISTIC DINH_FId.DFC_ComTrailerTo_CA "/" VAL_BLK 0x80075080 ValA_Wu16 413. DINH_FIdVerb 0.00 413. FORMAT "%2.0" NUMBER 5 /end CHARACTERISTIC
/begin CHARACTERISTIC DINH_FId.DFC_ComTrqDemandAfsChk_CA "/" VAL_BLK 0x8007508A ValA_Wu16 413. DINH_FIdVerb 0.00 413. FORMAT "%2.0" NUMBER 5 /end CHARACTERISTIC
/begin CHARACTERISTIC DINH_FId.DFC_ComTrqDemandAfsCtr_CA "/" VAL_BLK 0x80075094 ValA_Wu16 413. DINH_FIdVerb 0.00 413. FORMAT "%2.0" NUMBER 5 /end CHARACTERISTIC
/begin CHARACTERISTIC DINH_FId.DFC_ComTrqDemandAfsSig_CA "/" VAL_BLK 0x8007509E ValA_Wu16 413. DINH_FIdVerb 0.00 413. FORMAT "%2.0" NUMBER 5 /end CHARACTERISTIC
/begin CHARACTERISTIC DINH_FId.DFC_ComTrqDemandAfsTo_CA "/" VAL_BLK 0x800750A8 ValA_Wu16 413. DINH_FIdVerb 0.00 413. FORMAT "%2.0" NUMBER 5 /end CHARACTERISTIC
/begin CHARACTERISTIC DINH_FId.DFC_ComTrqDemandDscChk_CA "/" VAL_BLK 0x800750B2 ValA_Wu16 413. DINH_FIdVerb 0.00 413. FORMAT "%2.0" NUMBER 5 /end CHARACTERISTIC
/begin CHARACTERISTIC DINH_FId.DFC_ComTrqDemandDscCtr_CA "/" VAL_BLK 0x800750BC ValA_Wu16 413. DINH_FIdVerb 0.00 413. FORMAT "%2.0" NUMBER 5 /end CHARACTERISTIC
/begin CHARACTERISTIC DINH_FId.DFC_ComTrqDemandDscSig_CA "/" VAL_BLK 0x800750C6 ValA_Wu16 413. DINH_FIdVerb 0.00 413. FORMAT "%2.0" NUMBER 5 /end CHARACTERISTIC
/begin CHARACTERISTIC DINH_FId.DFC_ComTrqDemandDscTo_CA "/" VAL_BLK 0x800750D0 ValA_Wu16 413. DINH_FIdVerb 0.00 413. FORMAT "%2.0" NUMBER 5 /end CHARACTERISTIC
/begin CHARACTERISTIC DINH_FId.DFC_ComTrqDemandGbxChk_CA "/" VAL_BLK 0x800750DA ValA_Wu16 413. DINH_FIdVerb 0.00 413. FORMAT "%2.0" NUMBER 5 /end CHARACTERISTIC
/begin CHARACTERISTIC DINH_FId.DFC_ComTrqDemandGbxCtr_CA "/" VAL_BLK 0x800750E4 ValA_Wu16 413. DINH_FIdVerb 0.00 413. FORMAT "%2.0" NUMBER 5 /end CHARACTERISTIC
/begin CHARACTERISTIC DINH_FId.DFC_ComTrqDemandGbxSig_CA "/" VAL_BLK 0x800750EE ValA_Wu16 413. DINH_FIdVerb 0.00 413. FORMAT "%2.0" NUMBER 5 /end CHARACTERISTIC
/begin CHARACTERISTIC DINH_FId.DFC_ComTrqDemandGbxTo_CA "/" VAL_BLK 0x800750F8 ValA_Wu16 413. DINH_FIdVerb 0.00 413. FORMAT "%2.0" NUMBER 5 /end CHARACTERISTIC
/begin CHARACTERISTIC DINH_FId.DFC_ComVelocitySig_CA "/" VAL_BLK 0x80075102 ValA_Wu16 413. DINH_FIdVerb 0.00 413. FORMAT "%2.0" NUMBER 5 /end CHARACTERISTIC
/begin CHARACTERISTIC DINH_FId.DFC_ComVelocityTo_CA "/" VAL_BLK 0x8007510C ValA_Wu16 413. DINH_FIdVerb 0.00 413. FORMAT "%2.0" NUMBER 5 /end CHARACTERISTIC
/begin CHARACTERISTIC DINH_FId.DFC_ComWheelSpeedSig_CA "/" VAL_BLK 0x80075116 ValA_Wu16 413. DINH_FIdVerb 0.00 413. FORMAT "%2.0" NUMBER 7 /end CHARACTERISTIC
/begin CHARACTERISTIC DINH_FId.DFC_ComWheelSpeedTo_CA "/" VAL_BLK 0x80075124 ValA_Wu16 413. DINH_FIdVerb 0.00 413. FORMAT "%2.0" NUMBER 7 /end CHARACTERISTIC
/begin CHARACTERISTIC DINH_FId.DFC_ComZvKlappenSig_CA "/" VAL_BLK 0x80075132 ValA_Wu16 413. DINH_FIdVerb 0.00 413. FORMAT "%2.0" NUMBER 5 /end CHARACTERISTIC
/begin CHARACTERISTIC DINH_FId.DFC_ComZvKlappenTo_CA "/" VAL_BLK 0x8007513C ValA_Wu16 413. DINH_FIdVerb 0.00 413. FORMAT "%2.0" NUMBER 5 /end CHARACTERISTIC
/begin CHARACTERISTIC DINH_FId.DFC_Cy150SpiCom_CA "/" VAL_BLK 0x80075146 ValA_Wu16 413. DINH_FIdVerb 0.00 413. FORMAT "%2.0" NUMBER 5 /end CHARACTERISTIC
/begin CHARACTERISTIC DINH_FId.DFC_Cy320SpiCom_CA "/" VAL_BLK 0x80075150 ValA_Wu16 413. DINH_FIdVerb 0.00 413. FORMAT "%2.0" NUMBER 5 /end CHARACTERISTIC
/begin CHARACTERISTIC DINH_FId.DFC_ETCtlDvtInrMax_CA "/" VAL_BLK 0x8007515A ValA_Wu16 413. DINH_FIdVerb 0.00 413. FORMAT "%2.0" NUMBER 5 /end CHARACTERISTIC
/begin CHARACTERISTIC DINH_FId.DFC_ETCtlDvtInrMin_CA "/" VAL_BLK 0x80075164 ValA_Wu16 413. DINH_FIdVerb 0.00 413. FORMAT "%2.0" NUMBER 5 /end CHARACTERISTIC
/begin CHARACTERISTIC DINH_FId.DFC_ETCtlDvtOutrMax_CA "/" VAL_BLK 0x8007516E ValA_Wu16 413. DINH_FIdVerb 0.00 413. FORMAT "%2.0" NUMBER 5 /end CHARACTERISTIC
/begin CHARACTERISTIC DINH_FId.DFC_ETCtlDvtOutrMin_CA "/" VAL_BLK 0x80075178 ValA_Wu16 413. DINH_FIdVerb 0.00 413. FORMAT "%2.0" NUMBER 5 /end CHARACTERISTIC
/begin CHARACTERISTIC DINH_FId.DFC_Fan4WinErr1_CA "/" VAL_BLK 0x80075182 ValA_Wu16 413. DINH_FIdVerb 0.00 413. FORMAT "%2.0" NUMBER 5 /end CHARACTERISTIC
/begin CHARACTERISTIC DINH_FId.DFC_Fan4WinErr2_CA "/" VAL_BLK 0x8007518C ValA_Wu16 413. DINH_FIdVerb 0.00 413. FORMAT "%2.0" NUMBER 5 /end CHARACTERISTIC
/begin CHARACTERISTIC DINH_FId.DFC_Fan4WinErr3_CA "/" VAL_BLK 0x80075196 ValA_Wu16 413. DINH_FIdVerb 0.00 413. FORMAT "%2.0" NUMBER 5 /end CHARACTERISTIC
/begin CHARACTERISTIC DINH_FId.DFC_Fan4WinErr4_CA "/" VAL_BLK 0x800751A0 ValA_Wu16 413. DINH_FIdVerb 0.00 413. FORMAT "%2.0" NUMBER 5 /end CHARACTERISTIC
/begin CHARACTERISTIC DINH_FId.DFC_FanSCG_CA "/" VAL_BLK 0x800751AA ValA_Wu16 413. DINH_FIdVerb 0.00 413. FORMAT "%2.0" NUMBER 5 /end CHARACTERISTIC
/begin CHARACTERISTIC DINH_FId.DFC_PCRGovDvtLPMax_CA "/" VAL_BLK 0x800751B4 ValA_Wu16 413. DINH_FIdVerb 0.00 413. FORMAT "%2.0" NUMBER 6 /end CHARACTERISTIC
/begin CHARACTERISTIC DINH_FId.DFC_PCRGovDvtLPMin_CA "/" VAL_BLK 0x800751C0 ValA_Wu16 413. DINH_FIdVerb 0.00 413. FORMAT "%2.0" NUMBER 6 /end CHARACTERISTIC
/begin CHARACTERISTIC DINH_FId.DFC_PCRGovDvtMax_CA "/" VAL_BLK 0x800751CC ValA_Wu16 413. DINH_FIdVerb 0.00 413. FORMAT "%2.0" NUMBER 8 /end CHARACTERISTIC
/begin CHARACTERISTIC DINH_FId.DFC_PCRGovDvtMin_CA "/" VAL_BLK 0x800751DC ValA_Wu16 413. DINH_FIdVerb 0.00 413. FORMAT "%2.0" NUMBER 8 /end CHARACTERISTIC
/begin CHARACTERISTIC DINH_FId.DFC_RailCPC1_CA "/" VAL_BLK 0x800751EC ValA_Wu16 413. DINH_FIdVerb 0.00 413. FORMAT "%2.0" NUMBER 6 /end CHARACTERISTIC
/begin CHARACTERISTIC DINH_FId.DFC_RailCPC3_CA "/" VAL_BLK 0x800751F8 ValA_Wu16 413. DINH_FIdVerb 0.00 413. FORMAT "%2.0" NUMBER 5 /end CHARACTERISTIC
/begin CHARACTERISTIC DINH_FId.DFC_RailCPC4_CA "/" VAL_BLK 0x80075202 ValA_Wu16 413. DINH_FIdVerb 0.00 413. FORMAT "%2.0" NUMBER 5 /end CHARACTERISTIC
/begin CHARACTERISTIC DINH_FId.DFC_RailMeUn0_CA "/" VAL_BLK 0x8007520C ValA_Wu16 413. DINH_FIdVerb 0.00 413. FORMAT "%2.0" NUMBER 15 /end CHARACTERISTIC
/begin CHARACTERISTIC DINH_FId.DFC_RailMeUn1_CA "/" VAL_BLK 0x8007522A ValA_Wu16 413. DINH_FIdVerb 0.00 413. FORMAT "%2.0" NUMBER 13 /end CHARACTERISTIC
/begin CHARACTERISTIC DINH_FId.DFC_RailMeUn2_CA "/" VAL_BLK 0x80075244 ValA_Wu16 413. DINH_FIdVerb 0.00 413. FORMAT "%2.0" NUMBER 14 /end CHARACTERISTIC
/begin CHARACTERISTIC DINH_FId.DFC_RailMeUn3_CA "/" VAL_BLK 0x80075260 ValA_Wu16 413. DINH_FIdVerb 0.00 413. FORMAT "%2.0" NUMBER 16 /end CHARACTERISTIC
/begin CHARACTERISTIC DINH_FId.DFC_RailMeUn4_CA "/" VAL_BLK 0x80075280 ValA_Wu16 413. DINH_FIdVerb 0.00 413. FORMAT "%2.0" NUMBER 14 /end CHARACTERISTIC
/begin CHARACTERISTIC DINH_FId.DFC_RailPCV0_CA "/" VAL_BLK 0x8007529C ValA_Wu16 413. DINH_FIdVerb 0.00 413. FORMAT "%2.0" NUMBER 17 /end CHARACTERISTIC
/begin CHARACTERISTIC DINH_FId.DFC_RailPCV1_CA "/" VAL_BLK 0x800752BE ValA_Wu16 413. DINH_FIdVerb 0.00 413. FORMAT "%2.0" NUMBER 14 /end CHARACTERISTIC
/begin CHARACTERISTIC DINH_FId.DFC_RailPCV2_CA "/" VAL_BLK 0x800752DA ValA_Wu16 413. DINH_FIdVerb 0.00 413. FORMAT "%2.0" NUMBER 14 /end CHARACTERISTIC
/begin CHARACTERISTIC DINH_FId.DFC_RailPCV3_CA "/" VAL_BLK 0x800752F6 ValA_Wu16 413. DINH_FIdVerb 0.00 413. FORMAT "%2.0" NUMBER 16 /end CHARACTERISTIC
/begin CHARACTERISTIC DINH_FId.DFC_RailPCV4_CA "/" VAL_BLK 0x80075316 ValA_Wu16 413. DINH_FIdVerb 0.00 413. FORMAT "%2.0" NUMBER 14 /end CHARACTERISTIC
/begin CHARACTERISTIC DINH_FId.DFC_RailPMonStrt_CA "/" VAL_BLK 0x80075332 ValA_Wu16 413. DINH_FIdVerb 0.00 413. FORMAT "%2.0" NUMBER 5 /end CHARACTERISTIC
/begin CHARACTERISTIC DINH_FId.DFC_SSpMon1_CA "/" VAL_BLK 0x8007533C ValA_Wu16 413. DINH_FIdVerb 0.00 413. FORMAT "%2.0" NUMBER 10 /end CHARACTERISTIC
/begin CHARACTERISTIC DINH_FId.DFC_SSpMon2_CA "/" VAL_BLK 0x80075350 ValA_Wu16 413. DINH_FIdVerb 0.00 413. FORMAT "%2.0" NUMBER 8 /end CHARACTERISTIC
/begin CHARACTERISTIC DINH_FId.DFC_SSpMon3_CA "/" VAL_BLK 0x80075360 ValA_Wu16 413. DINH_FIdVerb 0.00 413. FORMAT "%2.0" NUMBER 8 /end CHARACTERISTIC
/begin CHARACTERISTIC DINH_FId.DFC_Sia_E1_CA "/" VAL_BLK 0x80075370 ValA_Wu16 413. DINH_FIdVerb 0.00 413. FORMAT "%2.0" NUMBER 5 /end CHARACTERISTIC
/begin CHARACTERISTIC DINH_FId.DFC_Sia_E10_CA "/" VAL_BLK 0x8007537A ValA_Wu16 413. DINH_FIdVerb 0.00 413. FORMAT "%2.0" NUMBER 5 /end CHARACTERISTIC
/begin CHARACTERISTIC DINH_FId.DFC_Sia_E11_CA "/" VAL_BLK 0x80075384 ValA_Wu16 413. DINH_FIdVerb 0.00 413. FORMAT "%2.0" NUMBER 5 /end CHARACTERISTIC
/begin CHARACTERISTIC DINH_FId.DFC_Sia_E12_CA "/" VAL_BLK 0x8007538E ValA_Wu16 413. DINH_FIdVerb 0.00 413. FORMAT "%2.0" NUMBER 5 /end CHARACTERISTIC
/begin CHARACTERISTIC DINH_FId.DFC_Sia_E13_CA "/" VAL_BLK 0x80075398 ValA_Wu16 413. DINH_FIdVerb 0.00 413. FORMAT "%2.0" NUMBER 5 /end CHARACTERISTIC
/begin CHARACTERISTIC DINH_FId.DFC_Sia_E14_CA "/" VAL_BLK 0x800753A2 ValA_Wu16 413. DINH_FIdVerb 0.00 413. FORMAT "%2.0" NUMBER 5 /end CHARACTERISTIC
/begin CHARACTERISTIC DINH_FId.DFC_Sia_E15_CA "/" VAL_BLK 0x800753AC ValA_Wu16 413. DINH_FIdVerb 0.00 413. FORMAT "%2.0" NUMBER 5 /end CHARACTERISTIC
/begin CHARACTERISTIC DINH_FId.DFC_Sia_E2_CA "/" VAL_BLK 0x800753B6 ValA_Wu16 413. DINH_FIdVerb 0.00 413. FORMAT "%2.0" NUMBER 5 /end CHARACTERISTIC
/begin CHARACTERISTIC DINH_FId.DFC_Sia_E3_CA "/" VAL_BLK 0x800753C0 ValA_Wu16 413. DINH_FIdVerb 0.00 413. FORMAT "%2.0" NUMBER 5 /end CHARACTERISTIC
/begin CHARACTERISTIC DINH_FId.DFC_Sia_E4_CA "/" VAL_BLK 0x800753CA ValA_Wu16 413. DINH_FIdVerb 0.00 413. FORMAT "%2.0" NUMBER 5 /end CHARACTERISTIC
/begin CHARACTERISTIC DINH_FId.DFC_Sia_E5_CA "/" VAL_BLK 0x800753D4 ValA_Wu16 413. DINH_FIdVerb 0.00 413. FORMAT "%2.0" NUMBER 5 /end CHARACTERISTIC
/begin CHARACTERISTIC DINH_FId.DFC_Sia_E6_CA "/" VAL_BLK 0x800753DE ValA_Wu16 413. DINH_FIdVerb 0.00 413. FORMAT "%2.0" NUMBER 5 /end CHARACTERISTIC
/begin CHARACTERISTIC DINH_FId.DFC_Sia_E7_CA "/" VAL_BLK 0x800753E8 ValA_Wu16 413. DINH_FIdVerb 0.00 413. FORMAT "%2.0" NUMBER 5 /end CHARACTERISTIC
/begin CHARACTERISTIC DINH_FId.DFC_Sia_E8_CA "/" VAL_BLK 0x800753F2 ValA_Wu16 413. DINH_FIdVerb 0.00 413. FORMAT "%2.0" NUMBER 5 /end CHARACTERISTIC
/begin CHARACTERISTIC DINH_FId.DFC_Sia_E9_CA "/" VAL_BLK 0x800753FC ValA_Wu16 413. DINH_FIdVerb 0.00 413. FORMAT "%2.0" NUMBER 5 /end CHARACTERISTIC
/begin CHARACTERISTIC DINH_FId.DFC_ThrVlv4WinErr1_CA "/" VAL_BLK 0x80075406 ValA_Wu16 413. DINH_FIdVerb 0.00 413. FORMAT "%2.0" NUMBER 5 /end CHARACTERISTIC
/begin CHARACTERISTIC DINH_FId.DFC_ThrVlv4WinErr2_CA "/" VAL_BLK 0x80075410 ValA_Wu16 413. DINH_FIdVerb 0.00 413. FORMAT "%2.0" NUMBER 5 /end CHARACTERISTIC
/begin CHARACTERISTIC DINH_FId.DFC_ThrVlv4WinErr3_CA "/" VAL_BLK 0x8007541A ValA_Wu16 413. DINH_FIdVerb 0.00 413. FORMAT "%2.0" NUMBER 5 /end CHARACTERISTIC
/begin CHARACTERISTIC DINH_FId.DFC_ThrVlv4WinErr4_CA "/" VAL_BLK 0x80075424 ValA_Wu16 413. DINH_FIdVerb 0.00 413. FORMAT "%2.0" NUMBER 5 /end CHARACTERISTIC
/begin CHARACTERISTIC DINH_FId.DFC_ThrVlvSCG_CA "/" VAL_BLK 0x8007542E ValA_Wu16 413. DINH_FIdVerb 0.00 413. FORMAT "%2.0" NUMBER 7 /end CHARACTERISTIC
/begin CHARACTERISTIC DINH_FId.DFC_TrbCh4WinErr1_CA "/" VAL_BLK 0x8007543C ValA_Wu16 413. DINH_FIdVerb 0.00 413. FORMAT "%2.0" NUMBER 5 /end CHARACTERISTIC
/begin CHARACTERISTIC DINH_FId.DFC_TrbCh4WinErr2_CA "/" VAL_BLK 0x80075446 ValA_Wu16 413. DINH_FIdVerb 0.00 413. FORMAT "%2.0" NUMBER 5 /end CHARACTERISTIC
/begin CHARACTERISTIC DINH_FId.DFC_TrbCh4WinErr3_CA "/" VAL_BLK 0x80075450 ValA_Wu16 413. DINH_FIdVerb 0.00 413. FORMAT "%2.0" NUMBER 5 /end CHARACTERISTIC
/begin CHARACTERISTIC DINH_FId.DFC_TrbCh4WinErr4_CA "/" VAL_BLK 0x8007545A ValA_Wu16 413. DINH_FIdVerb 0.00 413. FORMAT "%2.0" NUMBER 5 /end CHARACTERISTIC
/begin CHARACTERISTIC DINH_FId.DFC_TrbChSCG_CA "/" VAL_BLK 0x80075464 ValA_Wu16 413. DINH_FIdVerb 0.00 413. FORMAT "%2.0" NUMBER 10 /end CHARACTERISTIC
/begin CHARACTERISTIC DINH_FId.DFC_TrbChSRCMax_CA "/" VAL_BLK 0x80075478 ValA_Wu16 413. DINH_FIdVerb 0.00 413. FORMAT "%2.0" NUMBER 6 /end CHARACTERISTIC
/begin CHARACTERISTIC DINH_FId.DFC_TrbChSRCMin_CA "/" VAL_BLK 0x80075484 ValA_Wu16 413. DINH_FIdVerb 0.00 413. FORMAT "%2.0" NUMBER 6 /end CHARACTERISTIC
/begin CHARACTERISTIC DINH_FId.DFC_WaHtEl4WinErr1_CA "/" VAL_BLK 0x80075490 ValA_Wu16 413. DINH_FIdVerb 0.00 413. FORMAT "%2.0" NUMBER 5 /end CHARACTERISTIC
/begin CHARACTERISTIC DINH_FId.DFC_WaHtEl4WinErr2_CA "/" VAL_BLK 0x8007549A ValA_Wu16 413. DINH_FIdVerb 0.00 413. FORMAT "%2.0" NUMBER 5 /end CHARACTERISTIC
/begin CHARACTERISTIC DINH_FId.DFC_WaHtEl4WinErr3_CA "/" VAL_BLK 0x800754A4 ValA_Wu16 413. DINH_FIdVerb 0.00 413. FORMAT "%2.0" NUMBER 5 /end CHARACTERISTIC
/begin CHARACTERISTIC DINH_FId.DFC_WaHtEl4WinErr4_CA "/" VAL_BLK 0x800754AE ValA_Wu16 413. DINH_FIdVerb 0.00 413. FORMAT "%2.0" NUMBER 5 /end CHARACTERISTIC
/begin CHARACTERISTIC DINH_FId.DFC_WaHtElSCG_CA "/" VAL_BLK 0x800754B8 ValA_Wu16 413. DINH_FIdVerb 0.00 413. FORMAT "%2.0" NUMBER 5 /end CHARACTERISTIC
/begin CHARACTERISTIC DINH_FId.DFC_ETClbETFltMax_CA "/" VAL_BLK 0x800754C2 ValA_Wu16 413. DINH_FIdVerb 0.00 413. FORMAT "%2.0" NUMBER 5 /end CHARACTERISTIC
/begin CHARACTERISTIC DINH_FId.DFC_ETClbETFltMin_CA "/" VAL_BLK 0x800754CC ValA_Wu16 413. DINH_FIdVerb 0.00 413. FORMAT "%2.0" NUMBER 5 /end CHARACTERISTIC
/begin CHARACTERISTIC DINH_FId.DFC_InjCrvInjLimChrgBal_CA "/" VAL_BLK 0x800754D6 ValA_Wu16 413. DINH_FIdVerb 0.00 413. FORMAT "%2.0" NUMBER 5 /end CHARACTERISTIC
/begin CHARACTERISTIC DINH_FId.DFC_InjCrvInjLimQntBal_CA "/" VAL_BLK 0x800754E0 ValA_Wu16 413. DINH_FIdVerb 0.00 413. FORMAT "%2.0" NUMBER 5 /end CHARACTERISTIC
/begin CHARACTERISTIC DINH_FId.DFC_InjCrvInjLimSys_CA "/" VAL_BLK 0x800754EA ValA_Wu16 413. DINH_FIdVerb 0.00 413. FORMAT "%2.0" NUMBER 5 /end CHARACTERISTIC
/begin CHARACTERISTIC DINH_FId.DFC_InjCrvNumInjRtmLim_CA "/" VAL_BLK 0x800754F4 ValA_Wu16 413. DINH_FIdVerb 0.00 413. FORMAT "%2.0" NUMBER 5 /end CHARACTERISTIC
/begin CHARACTERISTIC DINH_FId.DFC_LSUHtCoupSig_0_CA "/" VAL_BLK 0x800754FE ValA_Wu16 413. DINH_FIdVerb 0.00 413. FORMAT "%2.0" NUMBER 7 /end CHARACTERISTIC
/begin CHARACTERISTIC DINH_FId.DFC_LSUHtCoupSig_1_CA "/" VAL_BLK 0x8007550C ValA_Wu16 413. DINH_FIdVerb 0.00 413. FORMAT "%2.0" NUMBER 7 /end CHARACTERISTIC
/begin CHARACTERISTIC DINH_FId.DFC_LSUHtCoupSig_2_CA "/" VAL_BLK 0x8007551A ValA_Wu16 413. DINH_FIdVerb 0.00 413. FORMAT "%2.0" NUMBER 5 /end CHARACTERISTIC
/begin CHARACTERISTIC DINH_FId.DFC_LSUHtCoupSig_3_CA "/" VAL_BLK 0x80075524 ValA_Wu16 413. DINH_FIdVerb 0.00 413. FORMAT "%2.0" NUMBER 5 /end CHARACTERISTIC
/begin CHARACTERISTIC DINH_FId.DFC_CtT_CA "/" VAL_BLK 0x8007552E ValA_Wu16 413. DINH_FIdVerb 0.00 413. FORMAT "%2.0" NUMBER 6 /end CHARACTERISTIC
/begin CHARACTERISTIC DINH_FId.DFC_DSMDummy_CA "/" VAL_BLK 0x8007553A ValA_Wu16 413. DINH_FIdVerb 0.00 413. FORMAT "%2.0" NUMBER 5 /end CHARACTERISTIC
/begin CHARACTERISTIC DINH_FId.DFC_MeUnOL_CA "/" VAL_BLK 0x80075544 ValA_Wu16 413. DINH_FIdVerb 0.00 413. FORMAT "%2.0" NUMBER 11 /end CHARACTERISTIC
/begin CHARACTERISTIC DINH_FId.DFC_MeUnSCB_CA "/" VAL_BLK 0x8007555A ValA_Wu16 413. DINH_FIdVerb 0.00 413. FORMAT "%2.0" NUMBER 11 /end CHARACTERISTIC
/begin CHARACTERISTIC DINH_FId.DFC_MeUnSRCMax_CA "/" VAL_BLK 0x80075570 ValA_Wu16 413. DINH_FIdVerb 0.00 413. FORMAT "%2.0" NUMBER 7 /end CHARACTERISTIC
/begin CHARACTERISTIC DINH_FId.DFC_MeUnSRCMin_CA "/" VAL_BLK 0x8007557E ValA_Wu16 413. DINH_FIdVerb 0.00 413. FORMAT "%2.0" NUMBER 7 /end CHARACTERISTIC
/begin CHARACTERISTIC DINH_FId.DFC_PCVOL_CA "/" VAL_BLK 0x8007558C ValA_Wu16 413. DINH_FIdVerb 0.00 413. FORMAT "%2.0" NUMBER 11 /end CHARACTERISTIC
/begin CHARACTERISTIC DINH_FId.DFC_PCVSCB_CA "/" VAL_BLK 0x800755A2 ValA_Wu16 413. DINH_FIdVerb 0.00 413. FORMAT "%2.0" NUMBER 11 /end CHARACTERISTIC
/begin CHARACTERISTIC DINH_FId.DFC_PCVSRCMax_CA "/" VAL_BLK 0x800755B8 ValA_Wu16 413. DINH_FIdVerb 0.00 413. FORMAT "%2.0" NUMBER 6 /end CHARACTERISTIC
/begin CHARACTERISTIC DINH_FId.DFC_PCVSRCMin_CA "/" VAL_BLK 0x800755C4 ValA_Wu16 413. DINH_FIdVerb 0.00 413. FORMAT "%2.0" NUMBER 6 /end CHARACTERISTIC
/begin CHARACTERISTIC DINH_FId.DFC_RailPSRCMax_CA "/" VAL_BLK 0x800755D0 ValA_Wu16 413. DINH_FIdVerb 0.00 413. FORMAT "%2.0" NUMBER 16 /end CHARACTERISTIC
/begin CHARACTERISTIC DINH_FId.DFC_RailPSRCMin_CA "/" VAL_BLK 0x800755F0 ValA_Wu16 413. DINH_FIdVerb 0.00 413. FORMAT "%2.0" NUMBER 16 /end CHARACTERISTIC
/begin CHARACTERISTIC DINH_FId.DFC_IVActrVltgSRCMax_CA "/" VAL_BLK 0x80075610 ValA_Wu16 413. DINH_FIdVerb 0.00 413. FORMAT "%2.0" NUMBER 5 /end CHARACTERISTIC
/begin CHARACTERISTIC DINH_FId.DFC_IVActrVltgSRCMin_CA "/" VAL_BLK 0x8007561A ValA_Wu16 413. DINH_FIdVerb 0.00 413. FORMAT "%2.0" NUMBER 5 /end CHARACTERISTIC
/begin CHARACTERISTIC DINH_FId.DFC_IVPSplyDCDC_CA "/" VAL_BLK 0x80075624 ValA_Wu16 413. DINH_FIdVerb 0.00 413. FORMAT "%2.0" NUMBER 5 /end CHARACTERISTIC
/begin CHARACTERISTIC DINH_FId.DFC_IVPSplyVltgSRCMax_CA "/" VAL_BLK 0x8007562E ValA_Wu16 413. DINH_FIdVerb 0.00 413. FORMAT "%2.0" NUMBER 5 /end CHARACTERISTIC
/begin CHARACTERISTIC DINH_FId.DFC_IVPSplyVltgSRCMin_CA "/" VAL_BLK 0x80075638 ValA_Wu16 413. DINH_FIdVerb 0.00 413. FORMAT "%2.0" NUMBER 5 /end CHARACTERISTIC
/begin CHARACTERISTIC DINH_FId.DFC_AFSOffsDrftMax_CA "/" VAL_BLK 0x80075642 ValA_Wu16 413. DINH_FIdVerb 0.00 413. FORMAT "%2.0" NUMBER 17 /end CHARACTERISTIC
/begin CHARACTERISTIC DINH_FId.DFC_AFSOffsDrftMin_CA "/" VAL_BLK 0x80075664 ValA_Wu16 413. DINH_FIdVerb 0.00 413. FORMAT "%2.0" NUMBER 17 /end CHARACTERISTIC
/begin CHARACTERISTIC DINH_FId.DFC_AFSSRCCorMax_CA "/" VAL_BLK 0x80075686 ValA_Wu16 413. DINH_FIdVerb 0.00 413. FORMAT "%2.0" NUMBER 9 /end CHARACTERISTIC
/begin CHARACTERISTIC DINH_FId.DFC_AFSSRCCorMin_CA "/" VAL_BLK 0x80075698 ValA_Wu16 413. DINH_FIdVerb 0.00 413. FORMAT "%2.0" NUMBER 9 /end CHARACTERISTIC
/begin CHARACTERISTIC DINH_FId.DFC_AFSSRCRawMax_CA "/" VAL_BLK 0x800756AA ValA_Wu16 413. DINH_FIdVerb 0.00 413. FORMAT "%2.0" NUMBER 9 /end CHARACTERISTIC
/begin CHARACTERISTIC DINH_FId.DFC_AFSSRCRawMin_CA "/" VAL_BLK 0x800756BC ValA_Wu16 413. DINH_FIdVerb 0.00 413. FORMAT "%2.0" NUMBER 9 /end CHARACTERISTIC
/begin CHARACTERISTIC DINH_FId.DFC_AFSSetyDrftMax_CA "/" VAL_BLK 0x800756CE ValA_Wu16 413. DINH_FIdVerb 0.00 413. FORMAT "%2.0" NUMBER 18 /end CHARACTERISTIC
/begin CHARACTERISTIC DINH_FId.DFC_AFSSetyDrftMin_CA "/" VAL_BLK 0x800756F2 ValA_Wu16 413. DINH_FIdVerb 0.00 413. FORMAT "%2.0" NUMBER 18 /end CHARACTERISTIC
/begin CHARACTERISTIC DINH_FId.DFC_AirCClntPAnaSRCMax_CA "/" VAL_BLK 0x80075716 ValA_Wu16 413. DINH_FIdVerb 0.00 413. FORMAT "%2.0" NUMBER 7 /end CHARACTERISTIC
/begin CHARACTERISTIC DINH_FId.DFC_AirCClntPAnaSRCMin_CA "/" VAL_BLK 0x80075724 ValA_Wu16 413. DINH_FIdVerb 0.00 413. FORMAT "%2.0" NUMBER 7 /end CHARACTERISTIC
/begin CHARACTERISTIC DINH_FId.DFC_AirCClntPPerSRCMax_CA "/" VAL_BLK 0x80075732 ValA_Wu16 413. DINH_FIdVerb 0.00 413. FORMAT "%2.0" NUMBER 6 /end CHARACTERISTIC
/begin CHARACTERISTIC DINH_FId.DFC_AirCClntPPerSRCMin_CA "/" VAL_BLK 0x8007573E ValA_Wu16 413. DINH_FIdVerb 0.00 413. FORMAT "%2.0" NUMBER 6 /end CHARACTERISTIC
/begin CHARACTERISTIC DINH_FId.DFC_AirCClntPdcycSRCMax_CA "/" VAL_BLK 0x8007574A ValA_Wu16 413. DINH_FIdVerb 0.00 413. FORMAT "%2.0" NUMBER 6 /end CHARACTERISTIC
/begin CHARACTERISTIC DINH_FId.DFC_AirCClntPdcycSRCMin_CA "/" VAL_BLK 0x80075756 ValA_Wu16 413. DINH_FIdVerb 0.00 413. FORMAT "%2.0" NUMBER 6 /end CHARACTERISTIC
/begin CHARACTERISTIC DINH_FId.DFC_AirCCmprOL_CA "/" VAL_BLK 0x80075762 ValA_Wu16 413. DINH_FIdVerb 0.00 413. FORMAT "%2.0" NUMBER 5 /end CHARACTERISTIC
/begin CHARACTERISTIC DINH_FId.DFC_AirCCmprRedTrqOL_CA "/" VAL_BLK 0x8007576C ValA_Wu16 413. DINH_FIdVerb 0.00 413. FORMAT "%2.0" NUMBER 5 /end CHARACTERISTIC
/begin CHARACTERISTIC DINH_FId.DFC_AirCCmprRedTrqSCB_CA "/" VAL_BLK 0x80075776 ValA_Wu16 413. DINH_FIdVerb 0.00 413. FORMAT "%2.0" NUMBER 5 /end CHARACTERISTIC
/begin CHARACTERISTIC DINH_FId.DFC_AirCCmprRedTrqSCG_CA "/" VAL_BLK 0x80075780 ValA_Wu16 413. DINH_FIdVerb 0.00 413. FORMAT "%2.0" NUMBER 5 /end CHARACTERISTIC
/begin CHARACTERISTIC DINH_FId.DFC_AirCCmprSCB_CA "/" VAL_BLK 0x8007578A ValA_Wu16 413. DINH_FIdVerb 0.00 413. FORMAT "%2.0" NUMBER 5 /end CHARACTERISTIC
/begin CHARACTERISTIC DINH_FId.DFC_AirCCmprSCG_CA "/" VAL_BLK 0x80075794 ValA_Wu16 413. DINH_FIdVerb 0.00 413. FORMAT "%2.0" NUMBER 5 /end CHARACTERISTIC
/begin CHARACTERISTIC DINH_FId.DFC_AirCSwtNpl_CA "/" VAL_BLK 0x8007579E ValA_Wu16 413. DINH_FIdVerb 0.00 413. FORMAT "%2.0" NUMBER 6 /end CHARACTERISTIC
/begin CHARACTERISTIC DINH_FId.DFC_AirCSwtSig_CA "/" VAL_BLK 0x800757AA ValA_Wu16 413. DINH_FIdVerb 0.00 413. FORMAT "%2.0" NUMBER 6 /end CHARACTERISTIC
/begin CHARACTERISTIC DINH_FId.DFC_BattUSRCMax_CA "/" VAL_BLK 0x800757B6 ValA_Wu16 413. DINH_FIdVerb 0.00 413. FORMAT "%2.0" NUMBER 10 /end CHARACTERISTIC
/begin CHARACTERISTIC DINH_FId.DFC_BattUSRCMin_CA "/" VAL_BLK 0x800757CA ValA_Wu16 413. DINH_FIdVerb 0.00 413. FORMAT "%2.0" NUMBER 10 /end CHARACTERISTIC
/begin CHARACTERISTIC DINH_FId.DFC_BrkNpl_CA "/" VAL_BLK 0x800757DE ValA_Wu16 413. DINH_FIdVerb 0.00 413. FORMAT "%2.0" NUMBER 9 /end CHARACTERISTIC
/begin CHARACTERISTIC DINH_FId.DFC_BrkPSRCMax_CA "/" VAL_BLK 0x800757F0 ValA_Wu16 413. DINH_FIdVerb 0.00 413. FORMAT "%2.0" NUMBER 8 /end CHARACTERISTIC
/begin CHARACTERISTIC DINH_FId.DFC_BrkPSRCMin_CA "/" VAL_BLK 0x80075800 ValA_Wu16 413. DINH_FIdVerb 0.00 413. FORMAT "%2.0" NUMBER 8 /end CHARACTERISTIC
/begin CHARACTERISTIC DINH_FId.DFC_BrkSig_CA "/" VAL_BLK 0x80075810 ValA_Wu16 413. DINH_FIdVerb 0.00 413. FORMAT "%2.0" NUMBER 8 /end CHARACTERISTIC
/begin CHARACTERISTIC DINH_FId.DFC_CByVlvOL_CA "/" VAL_BLK 0x80075820 ValA_Wu16 413. DINH_FIdVerb 0.00 413. FORMAT "%2.0" NUMBER 5 /end CHARACTERISTIC
/begin CHARACTERISTIC DINH_FId.DFC_CByVlvSCB_CA "/" VAL_BLK 0x8007582A ValA_Wu16 413. DINH_FIdVerb 0.00 413. FORMAT "%2.0" NUMBER 5 /end CHARACTERISTIC
/begin CHARACTERISTIC DINH_FId.DFC_CByVlvSCG_CA "/" VAL_BLK 0x80075834 ValA_Wu16 413. DINH_FIdVerb 0.00 413. FORMAT "%2.0" NUMBER 5 /end CHARACTERISTIC
/begin CHARACTERISTIC DINH_FId.DFC_CEngDsTSRCMax_CA "/" VAL_BLK 0x8007583E ValA_Wu16 413. DINH_FIdVerb 0.00 413. FORMAT "%2.0" NUMBER 20 /end CHARACTERISTIC
/begin CHARACTERISTIC DINH_FId.DFC_CEngDsTSRCMin_CA "/" VAL_BLK 0x80075866 ValA_Wu16 413. DINH_FIdVerb 0.00 413. FORMAT "%2.0" NUMBER 20 /end CHARACTERISTIC
/begin CHARACTERISTIC DINH_FId.DFC_CEngDsTSig_CA "/" VAL_BLK 0x8007588E ValA_Wu16 413. DINH_FIdVerb 0.00 413. FORMAT "%2.0" NUMBER 7 /end CHARACTERISTIC
/begin CHARACTERISTIC DINH_FId.DFC_CEngUsTSRCMax_CA "/" VAL_BLK 0x8007589C ValA_Wu16 413. DINH_FIdVerb 0.00 413. FORMAT "%2.0" NUMBER 7 /end CHARACTERISTIC
/begin CHARACTERISTIC DINH_FId.DFC_CEngUsTSRCMin_CA "/" VAL_BLK 0x800758AA ValA_Wu16 413. DINH_FIdVerb 0.00 413. FORMAT "%2.0" NUMBER 7 /end CHARACTERISTIC
/begin CHARACTERISTIC DINH_FId.DFC_CThmstOL_CA "/" VAL_BLK 0x800758B8 ValA_Wu16 413. DINH_FIdVerb 0.00 413. FORMAT "%2.0" NUMBER 5 /end CHARACTERISTIC
/begin CHARACTERISTIC DINH_FId.DFC_CThmstSCB_CA "/" VAL_BLK 0x800758C2 ValA_Wu16 413. DINH_FIdVerb 0.00 413. FORMAT "%2.0" NUMBER 5 /end CHARACTERISTIC
/begin CHARACTERISTIC DINH_FId.DFC_CThmstSCG_CA "/" VAL_BLK 0x800758CC ValA_Wu16 413. DINH_FIdVerb 0.00 413. FORMAT "%2.0" NUMBER 5 /end CHARACTERISTIC
/begin CHARACTERISTIC DINH_FId.DFC_ClthSig_CA "/" VAL_BLK 0x800758D6 ValA_Wu16 413. DINH_FIdVerb 0.00 413. FORMAT "%2.0" NUMBER 11 /end CHARACTERISTIC
/begin CHARACTERISTIC DINH_FId.DFC_ECBVlvOL_CA "/" VAL_BLK 0x800758EC ValA_Wu16 413. DINH_FIdVerb 0.00 413. FORMAT "%2.0" NUMBER 5 /end CHARACTERISTIC
/begin CHARACTERISTIC DINH_FId.DFC_ECBVlvSCB_CA "/" VAL_BLK 0x800758F6 ValA_Wu16 413. DINH_FIdVerb 0.00 413. FORMAT "%2.0" NUMBER 5 /end CHARACTERISTIC
/begin CHARACTERISTIC DINH_FId.DFC_ECBVlvSCG_CA "/" VAL_BLK 0x80075900 ValA_Wu16 413. DINH_FIdVerb 0.00 413. FORMAT "%2.0" NUMBER 5 /end CHARACTERISTIC
/begin CHARACTERISTIC DINH_FId.DFC_ECBVlvSRCMax_CA "/" VAL_BLK 0x8007590A ValA_Wu16 413. DINH_FIdVerb 0.00 413. FORMAT "%2.0" NUMBER 7 /end CHARACTERISTIC
/begin CHARACTERISTIC DINH_FId.DFC_ECBVlvSRCMin_CA "/" VAL_BLK 0x80075918 ValA_Wu16 413. DINH_FIdVerb 0.00 413. FORMAT "%2.0" NUMBER 7 /end CHARACTERISTIC
/begin CHARACTERISTIC DINH_FId.DFC_EGRVlvGovDvtMax_CA "/" VAL_BLK 0x80075926 ValA_Wu16 413. DINH_FIdVerb 0.00 413. FORMAT "%2.0" NUMBER 5 /end CHARACTERISTIC
/begin CHARACTERISTIC DINH_FId.DFC_EGRVlvGovDvtMin_CA "/" VAL_BLK 0x80075930 ValA_Wu16 413. DINH_FIdVerb 0.00 413. FORMAT "%2.0" NUMBER 5 /end CHARACTERISTIC
/begin CHARACTERISTIC DINH_FId.DFC_EGRVlvOL_CA "/" VAL_BLK 0x8007593A ValA_Wu16 413. DINH_FIdVerb 0.00 413. FORMAT "%2.0" NUMBER 9 /end CHARACTERISTIC
/begin CHARACTERISTIC DINH_FId.DFC_EGRVlvSCB_CA "/" VAL_BLK 0x8007594C ValA_Wu16 413. DINH_FIdVerb 0.00 413. FORMAT "%2.0" NUMBER 9 /end CHARACTERISTIC
/begin CHARACTERISTIC DINH_FId.DFC_EGRVlvSCG_CA "/" VAL_BLK 0x8007595E ValA_Wu16 413. DINH_FIdVerb 0.00 413. FORMAT "%2.0" NUMBER 13 /end CHARACTERISTIC
/begin CHARACTERISTIC DINH_FId.DFC_EGRVlvSRCMax_CA "/" VAL_BLK 0x80075978 ValA_Wu16 413. DINH_FIdVerb 0.00 413. FORMAT "%2.0" NUMBER 9 /end CHARACTERISTIC
/begin CHARACTERISTIC DINH_FId.DFC_EGRVlvSRCMin_CA "/" VAL_BLK 0x8007598A ValA_Wu16 413. DINH_FIdVerb 0.00 413. FORMAT "%2.0" NUMBER 9 /end CHARACTERISTIC
/begin CHARACTERISTIC DINH_FId.DFC_EMDmpOL_0_CA "/" VAL_BLK 0x8007599C ValA_Wu16 413. DINH_FIdVerb 0.00 413. FORMAT "%2.0" NUMBER 5 /end CHARACTERISTIC
/begin CHARACTERISTIC DINH_FId.DFC_EMDmpOL_1_CA "/" VAL_BLK 0x800759A6 ValA_Wu16 413. DINH_FIdVerb 0.00 413. FORMAT "%2.0" NUMBER 5 /end CHARACTERISTIC
/begin CHARACTERISTIC DINH_FId.DFC_EMDmpSCB_0_CA "/" VAL_BLK 0x800759B0 ValA_Wu16 413. DINH_FIdVerb 0.00 413. FORMAT "%2.0" NUMBER 5 /end CHARACTERISTIC
/begin CHARACTERISTIC DINH_FId.DFC_EMDmpSCB_1_CA "/" VAL_BLK 0x800759BA ValA_Wu16 413. DINH_FIdVerb 0.00 413. FORMAT "%2.0" NUMBER 5 /end CHARACTERISTIC
/begin CHARACTERISTIC DINH_FId.DFC_EMDmpSCG_0_CA "/" VAL_BLK 0x800759C4 ValA_Wu16 413. DINH_FIdVerb 0.00 413. FORMAT "%2.0" NUMBER 5 /end CHARACTERISTIC
/begin CHARACTERISTIC DINH_FId.DFC_EMDmpSCG_1_CA "/" VAL_BLK 0x800759CE ValA_Wu16 413. DINH_FIdVerb 0.00 413. FORMAT "%2.0" NUMBER 5 /end CHARACTERISTIC
/begin CHARACTERISTIC DINH_FId.DFC_EngStAOL_CA "/" VAL_BLK 0x800759D8 ValA_Wu16 413. DINH_FIdVerb 0.00 413. FORMAT "%2.0" NUMBER 5 /end CHARACTERISTIC
/begin CHARACTERISTIC DINH_FId.DFC_EngStASCB_CA "/" VAL_BLK 0x800759E2 ValA_Wu16 413. DINH_FIdVerb 0.00 413. FORMAT "%2.0" NUMBER 5 /end CHARACTERISTIC
/begin CHARACTERISTIC DINH_FId.DFC_EngStASCG_CA "/" VAL_BLK 0x800759EC ValA_Wu16 413. DINH_FIdVerb 0.00 413. FORMAT "%2.0" NUMBER 5 /end CHARACTERISTIC
/begin CHARACTERISTIC DINH_FId.DFC_EnvPSRCMax_CA "/" VAL_BLK 0x800759F6 ValA_Wu16 413. DINH_FIdVerb 0.00 413. FORMAT "%2.0" NUMBER 17 /end CHARACTERISTIC
/begin CHARACTERISTIC DINH_FId.DFC_EnvPSRCMin_CA "/" VAL_BLK 0x80075A18 ValA_Wu16 413. DINH_FIdVerb 0.00 413. FORMAT "%2.0" NUMBER 17 /end CHARACTERISTIC
/begin CHARACTERISTIC DINH_FId.DFC_EnvPSig_CA "/" VAL_BLK 0x80075A3A ValA_Wu16 413. DINH_FIdVerb 0.00 413. FORMAT "%2.0" NUMBER 7 /end CHARACTERISTIC
/begin CHARACTERISTIC DINH_FId.DFC_EnvTSRCMax_CA "/" VAL_BLK 0x80075A48 ValA_Wu16 413. DINH_FIdVerb 0.00 413. FORMAT "%2.0" NUMBER 16 /end CHARACTERISTIC
/begin CHARACTERISTIC DINH_FId.DFC_EnvTSRCMin_CA "/" VAL_BLK 0x80075A68 ValA_Wu16 413. DINH_FIdVerb 0.00 413. FORMAT "%2.0" NUMBER 16 /end CHARACTERISTIC
/begin CHARACTERISTIC DINH_FId.DFC_FanOL_CA "/" VAL_BLK 0x80075A88 ValA_Wu16 413. DINH_FIdVerb 0.00 413. FORMAT "%2.0" NUMBER 5 /end CHARACTERISTIC
/begin CHARACTERISTIC DINH_FId.DFC_FanSCB_CA "/" VAL_BLK 0x80075A92 ValA_Wu16 413. DINH_FIdVerb 0.00 413. FORMAT "%2.0" NUMBER 5 /end CHARACTERISTIC
/begin CHARACTERISTIC DINH_FId.DFC_FlFltSig_CA "/" VAL_BLK 0x80075A9C ValA_Wu16 413. DINH_FIdVerb 0.00 413. FORMAT "%2.0" NUMBER 5 /end CHARACTERISTIC
/begin CHARACTERISTIC DINH_FId.DFC_FuelTSRCMax_CA "/" VAL_BLK 0x80075AA6 ValA_Wu16 413. DINH_FIdVerb 0.00 413. FORMAT "%2.0" NUMBER 10 /end CHARACTERISTIC
/begin CHARACTERISTIC DINH_FId.DFC_FuelTSRCMin_CA "/" VAL_BLK 0x80075ABA ValA_Wu16 413. DINH_FIdVerb 0.00 413. FORMAT "%2.0" NUMBER 10 /end CHARACTERISTIC
/begin CHARACTERISTIC DINH_FId.DFC_GbxNPosPPerSRCMax_CA "/" VAL_BLK 0x80075ACE ValA_Wu16 413. DINH_FIdVerb 0.00 413. FORMAT "%2.0" NUMBER 6 /end CHARACTERISTIC
/begin CHARACTERISTIC DINH_FId.DFC_GbxNPosPPerSRCMin_CA "/" VAL_BLK 0x80075ADA ValA_Wu16 413. DINH_FIdVerb 0.00 413. FORMAT "%2.0" NUMBER 6 /end CHARACTERISTIC
/begin CHARACTERISTIC DINH_FId.DFC_GbxNPosPdcycSRCMax_CA "/" VAL_BLK 0x80075AE6 ValA_Wu16 413. DINH_FIdVerb 0.00 413. FORMAT "%2.0" NUMBER 6 /end CHARACTERISTIC
/begin CHARACTERISTIC DINH_FId.DFC_GbxNPosPdcycSRCMin_CA "/" VAL_BLK 0x80075AF2 ValA_Wu16 413. DINH_FIdVerb 0.00 413. FORMAT "%2.0" NUMBER 6 /end CHARACTERISTIC
/begin CHARACTERISTIC DINH_FId.DFC_GbxNPosSig_CA "/" VAL_BLK 0x80075AFE ValA_Wu16 413. DINH_FIdVerb 0.00 413. FORMAT "%2.0" NUMBER 6 /end CHARACTERISTIC
/begin CHARACTERISTIC DINH_FId.DFC_GlwPlgBSDOL_0_CA "/" VAL_BLK 0x80075B0A ValA_Wu16 413. DINH_FIdVerb 0.00 413. FORMAT "%2.0" NUMBER 5 /end CHARACTERISTIC
/begin CHARACTERISTIC DINH_FId.DFC_GlwPlgBSDOL_1_CA "/" VAL_BLK 0x80075B14 ValA_Wu16 413. DINH_FIdVerb 0.00 413. FORMAT "%2.0" NUMBER 5 /end CHARACTERISTIC
/begin CHARACTERISTIC DINH_FId.DFC_GlwPlgBSDOL_2_CA "/" VAL_BLK 0x80075B1E ValA_Wu16 413. DINH_FIdVerb 0.00 413. FORMAT "%2.0" NUMBER 5 /end CHARACTERISTIC
/begin CHARACTERISTIC DINH_FId.DFC_GlwPlgBSDOL_3_CA "/" VAL_BLK 0x80075B28 ValA_Wu16 413. DINH_FIdVerb 0.00 413. FORMAT "%2.0" NUMBER 5 /end CHARACTERISTIC
/begin CHARACTERISTIC DINH_FId.DFC_GlwPlgBSDOL_4_CA "/" VAL_BLK 0x80075B32 ValA_Wu16 413. DINH_FIdVerb 0.00 413. FORMAT "%2.0" NUMBER 5 /end CHARACTERISTIC
/begin CHARACTERISTIC DINH_FId.DFC_GlwPlgBSDOL_5_CA "/" VAL_BLK 0x80075B3C ValA_Wu16 413. DINH_FIdVerb 0.00 413. FORMAT "%2.0" NUMBER 5 /end CHARACTERISTIC
/begin CHARACTERISTIC DINH_FId.DFC_GlwPlgBSDOL_6_CA "/" VAL_BLK 0x80075B46 ValA_Wu16 413. DINH_FIdVerb 0.00 413. FORMAT "%2.0" NUMBER 5 /end CHARACTERISTIC
/begin CHARACTERISTIC DINH_FId.DFC_GlwPlgBSDOL_7_CA "/" VAL_BLK 0x80075B50 ValA_Wu16 413. DINH_FIdVerb 0.00 413. FORMAT "%2.0" NUMBER 5 /end CHARACTERISTIC
/begin CHARACTERISTIC DINH_FId.DFC_GlwPlgBSDOT_0_CA "/" VAL_BLK 0x80075B5A ValA_Wu16 413. DINH_FIdVerb 0.00 413. FORMAT "%2.0" NUMBER 5 /end CHARACTERISTIC
/begin CHARACTERISTIC DINH_FId.DFC_GlwPlgBSDOT_1_CA "/" VAL_BLK 0x80075B64 ValA_Wu16 413. DINH_FIdVerb 0.00 413. FORMAT "%2.0" NUMBER 5 /end CHARACTERISTIC
/begin CHARACTERISTIC DINH_FId.DFC_GlwPlgBSDOT_2_CA "/" VAL_BLK 0x80075B6E ValA_Wu16 413. DINH_FIdVerb 0.00 413. FORMAT "%2.0" NUMBER 5 /end CHARACTERISTIC
/begin CHARACTERISTIC DINH_FId.DFC_GlwPlgBSDOT_3_CA "/" VAL_BLK 0x80075B78 ValA_Wu16 413. DINH_FIdVerb 0.00 413. FORMAT "%2.0" NUMBER 5 /end CHARACTERISTIC
/begin CHARACTERISTIC DINH_FId.DFC_GlwPlgBSDOT_4_CA "/" VAL_BLK 0x80075B82 ValA_Wu16 413. DINH_FIdVerb 0.00 413. FORMAT "%2.0" NUMBER 5 /end CHARACTERISTIC
/begin CHARACTERISTIC DINH_FId.DFC_GlwPlgBSDOT_5_CA "/" VAL_BLK 0x80075B8C ValA_Wu16 413. DINH_FIdVerb 0.00 413. FORMAT "%2.0" NUMBER 5 /end CHARACTERISTIC
/begin CHARACTERISTIC DINH_FId.DFC_GlwPlgBSDOT_6_CA "/" VAL_BLK 0x80075B96 ValA_Wu16 413. DINH_FIdVerb 0.00 413. FORMAT "%2.0" NUMBER 5 /end CHARACTERISTIC
/begin CHARACTERISTIC DINH_FId.DFC_GlwPlgBSDOT_7_CA "/" VAL_BLK 0x80075BA0 ValA_Wu16 413. DINH_FIdVerb 0.00 413. FORMAT "%2.0" NUMBER 5 /end CHARACTERISTIC
/begin CHARACTERISTIC DINH_FId.DFC_GlwPlgBSDSC_0_CA "/" VAL_BLK 0x80075BAA ValA_Wu16 413. DINH_FIdVerb 0.00 413. FORMAT "%2.0" NUMBER 5 /end CHARACTERISTIC
/begin CHARACTERISTIC DINH_FId.DFC_GlwPlgBSDSC_1_CA "/" VAL_BLK 0x80075BB4 ValA_Wu16 413. DINH_FIdVerb 0.00 413. FORMAT "%2.0" NUMBER 5 /end CHARACTERISTIC
/begin CHARACTERISTIC DINH_FId.DFC_GlwPlgBSDSC_2_CA "/" VAL_BLK 0x80075BBE ValA_Wu16 413. DINH_FIdVerb 0.00 413. FORMAT "%2.0" NUMBER 5 /end CHARACTERISTIC
/begin CHARACTERISTIC DINH_FId.DFC_GlwPlgBSDSC_3_CA "/" VAL_BLK 0x80075BC8 ValA_Wu16 413. DINH_FIdVerb 0.00 413. FORMAT "%2.0" NUMBER 5 /end CHARACTERISTIC
/begin CHARACTERISTIC DINH_FId.DFC_GlwPlgBSDSC_4_CA "/" VAL_BLK 0x80075BD2 ValA_Wu16 413. DINH_FIdVerb 0.00 413. FORMAT "%2.0" NUMBER 5 /end CHARACTERISTIC
/begin CHARACTERISTIC DINH_FId.DFC_GlwPlgBSDSC_5_CA "/" VAL_BLK 0x80075BDC ValA_Wu16 413. DINH_FIdVerb 0.00 413. FORMAT "%2.0" NUMBER 5 /end CHARACTERISTIC
/begin CHARACTERISTIC DINH_FId.DFC_GlwPlgBSDSC_6_CA "/" VAL_BLK 0x80075BE6 ValA_Wu16 413. DINH_FIdVerb 0.00 413. FORMAT "%2.0" NUMBER 5 /end CHARACTERISTIC
/begin CHARACTERISTIC DINH_FId.DFC_GlwPlgBSDSC_7_CA "/" VAL_BLK 0x80075BF0 ValA_Wu16 413. DINH_FIdVerb 0.00 413. FORMAT "%2.0" NUMBER 5 /end CHARACTERISTIC
/begin CHARACTERISTIC DINH_FId.DFC_GlwPlgComErr_CA "/" VAL_BLK 0x80075BFA ValA_Wu16 413. DINH_FIdVerb 0.00 413. FORMAT "%2.0" NUMBER 5 /end CHARACTERISTIC
/begin CHARACTERISTIC DINH_FId.DFC_InjVlvPresMin_CA "/" VAL_BLK 0x80075C04 ValA_Wu16 413. DINH_FIdVerb 0.00 413. FORMAT "%2.0" NUMBER 5 /end CHARACTERISTIC
/begin CHARACTERISTIC DINH_FId.DFC_LSUCircNernstMax_0_CA "/" VAL_BLK 0x80075C0E ValA_Wu16 413. DINH_FIdVerb 0.00 413. FORMAT "%2.0" NUMBER 10 /end CHARACTERISTIC
/begin CHARACTERISTIC DINH_FId.DFC_LSUCircNernstMax_1_CA "/" VAL_BLK 0x80075C22 ValA_Wu16 413. DINH_FIdVerb 0.00 413. FORMAT "%2.0" NUMBER 10 /end CHARACTERISTIC
/begin CHARACTERISTIC DINH_FId.DFC_LSUCircNernstMax_2_CA "/" VAL_BLK 0x80075C36 ValA_Wu16 413. DINH_FIdVerb 0.00 413. FORMAT "%2.0" NUMBER 5 /end CHARACTERISTIC
/begin CHARACTERISTIC DINH_FId.DFC_LSUCircNernstMax_3_CA "/" VAL_BLK 0x80075C40 ValA_Wu16 413. DINH_FIdVerb 0.00 413. FORMAT "%2.0" NUMBER 5 /end CHARACTERISTIC
/begin CHARACTERISTIC DINH_FId.DFC_LSUCircNernstMin_0_CA "/" VAL_BLK 0x80075C4A ValA_Wu16 413. DINH_FIdVerb 0.00 413. FORMAT "%2.0" NUMBER 10 /end CHARACTERISTIC
/begin CHARACTERISTIC DINH_FId.DFC_LSUCircNernstMin_1_CA "/" VAL_BLK 0x80075C5E ValA_Wu16 413. DINH_FIdVerb 0.00 413. FORMAT "%2.0" NUMBER 10 /end CHARACTERISTIC
/begin CHARACTERISTIC DINH_FId.DFC_LSUCircNernstMin_2_CA "/" VAL_BLK 0x80075C72 ValA_Wu16 413. DINH_FIdVerb 0.00 413. FORMAT "%2.0" NUMBER 5 /end CHARACTERISTIC
/begin CHARACTERISTIC DINH_FId.DFC_LSUCircNernstMin_3_CA "/" VAL_BLK 0x80075C7C ValA_Wu16 413. DINH_FIdVerb 0.00 413. FORMAT "%2.0" NUMBER 5 /end CHARACTERISTIC
/begin CHARACTERISTIC DINH_FId.DFC_LSUCircNernstSig_0_CA "/" VAL_BLK 0x80075C86 ValA_Wu16 413. DINH_FIdVerb 0.00 413. FORMAT "%2.0" NUMBER 10 /end CHARACTERISTIC
/begin CHARACTERISTIC DINH_FId.DFC_LSUCircNernstSig_1_CA "/" VAL_BLK 0x80075C9A ValA_Wu16 413. DINH_FIdVerb 0.00 413. FORMAT "%2.0" NUMBER 10 /end CHARACTERISTIC
/begin CHARACTERISTIC DINH_FId.DFC_LSUCircNernstSig_2_CA "/" VAL_BLK 0x80075CAE ValA_Wu16 413. DINH_FIdVerb 0.00 413. FORMAT "%2.0" NUMBER 5 /end CHARACTERISTIC
/begin CHARACTERISTIC DINH_FId.DFC_LSUCircNernstSig_3_CA "/" VAL_BLK 0x80075CB8 ValA_Wu16 413. DINH_FIdVerb 0.00 413. FORMAT "%2.0" NUMBER 5 /end CHARACTERISTIC
/begin CHARACTERISTIC DINH_FId.DFC_LSUCircPmpCurMax_0_CA "/" VAL_BLK 0x80075CC2 ValA_Wu16 413. DINH_FIdVerb 0.00 413. FORMAT "%2.0" NUMBER 9 /end CHARACTERISTIC
/begin CHARACTERISTIC DINH_FId.DFC_LSUCircPmpCurMax_1_CA "/" VAL_BLK 0x80075CD4 ValA_Wu16 413. DINH_FIdVerb 0.00 413. FORMAT "%2.0" NUMBER 9 /end CHARACTERISTIC
/begin CHARACTERISTIC DINH_FId.DFC_LSUCircPmpCurMax_2_CA "/" VAL_BLK 0x80075CE6 ValA_Wu16 413. DINH_FIdVerb 0.00 413. FORMAT "%2.0" NUMBER 5 /end CHARACTERISTIC
/begin CHARACTERISTIC DINH_FId.DFC_LSUCircPmpCurMax_3_CA "/" VAL_BLK 0x80075CF0 ValA_Wu16 413. DINH_FIdVerb 0.00 413. FORMAT "%2.0" NUMBER 5 /end CHARACTERISTIC
/begin CHARACTERISTIC DINH_FId.DFC_LSUCircPmpCurMin_0_CA "/" VAL_BLK 0x80075CFA ValA_Wu16 413. DINH_FIdVerb 0.00 413. FORMAT "%2.0" NUMBER 9 /end CHARACTERISTIC
/begin CHARACTERISTIC DINH_FId.DFC_LSUCircPmpCurMin_1_CA "/" VAL_BLK 0x80075D0C ValA_Wu16 413. DINH_FIdVerb 0.00 413. FORMAT "%2.0" NUMBER 9 /end CHARACTERISTIC
/begin CHARACTERISTIC DINH_FId.DFC_LSUCircPmpCurMin_2_CA "/" VAL_BLK 0x80075D1E ValA_Wu16 413. DINH_FIdVerb 0.00 413. FORMAT "%2.0" NUMBER 5 /end CHARACTERISTIC
/begin CHARACTERISTIC DINH_FId.DFC_LSUCircPmpCurMin_3_CA "/" VAL_BLK 0x80075D28 ValA_Wu16 413. DINH_FIdVerb 0.00 413. FORMAT "%2.0" NUMBER 5 /end CHARACTERISTIC
/begin CHARACTERISTIC DINH_FId.DFC_LSUCircPmpCurSig_0_CA "/" VAL_BLK 0x80075D32 ValA_Wu16 413. DINH_FIdVerb 0.00 413. FORMAT "%2.0" NUMBER 9 /end CHARACTERISTIC
/begin CHARACTERISTIC DINH_FId.DFC_LSUCircPmpCurSig_1_CA "/" VAL_BLK 0x80075D44 ValA_Wu16 413. DINH_FIdVerb 0.00 413. FORMAT "%2.0" NUMBER 9 /end CHARACTERISTIC
/begin CHARACTERISTIC DINH_FId.DFC_LSUCircPmpCurSig_2_CA "/" VAL_BLK 0x80075D56 ValA_Wu16 413. DINH_FIdVerb 0.00 413. FORMAT "%2.0" NUMBER 5 /end CHARACTERISTIC
/begin CHARACTERISTIC DINH_FId.DFC_LSUCircPmpCurSig_3_CA "/" VAL_BLK 0x80075D60 ValA_Wu16 413. DINH_FIdVerb 0.00 413. FORMAT "%2.0" NUMBER 5 /end CHARACTERISTIC
/begin CHARACTERISTIC DINH_FId.DFC_LSUCircVirtGndMax_0_CA "/" VAL_BLK 0x80075D6A ValA_Wu16 413. DINH_FIdVerb 0.00 413. FORMAT "%2.0" NUMBER 10 /end CHARACTERISTIC
/begin CHARACTERISTIC DINH_FId.DFC_LSUCircVirtGndMax_1_CA "/" VAL_BLK 0x80075D7E ValA_Wu16 413. DINH_FIdVerb 0.00 413. FORMAT "%2.0" NUMBER 10 /end CHARACTERISTIC
/begin CHARACTERISTIC DINH_FId.DFC_LSUCircVirtGndMax_2_CA "/" VAL_BLK 0x80075D92 ValA_Wu16 413. DINH_FIdVerb 0.00 413. FORMAT "%2.0" NUMBER 5 /end CHARACTERISTIC
/begin CHARACTERISTIC DINH_FId.DFC_LSUCircVirtGndMax_3_CA "/" VAL_BLK 0x80075D9C ValA_Wu16 413. DINH_FIdVerb 0.00 413. FORMAT "%2.0" NUMBER 5 /end CHARACTERISTIC
/begin CHARACTERISTIC DINH_FId.DFC_LSUCircVirtGndMin_0_CA "/" VAL_BLK 0x80075DA6 ValA_Wu16 413. DINH_FIdVerb 0.00 413. FORMAT "%2.0" NUMBER 10 /end CHARACTERISTIC
/begin CHARACTERISTIC DINH_FId.DFC_LSUCircVirtGndMin_1_CA "/" VAL_BLK 0x80075DBA ValA_Wu16 413. DINH_FIdVerb 0.00 413. FORMAT "%2.0" NUMBER 10 /end CHARACTERISTIC
/begin CHARACTERISTIC DINH_FId.DFC_LSUCircVirtGndMin_2_CA "/" VAL_BLK 0x80075DCE ValA_Wu16 413. DINH_FIdVerb 0.00 413. FORMAT "%2.0" NUMBER 5 /end CHARACTERISTIC
/begin CHARACTERISTIC DINH_FId.DFC_LSUCircVirtGndMin_3_CA "/" VAL_BLK 0x80075DD8 ValA_Wu16 413. DINH_FIdVerb 0.00 413. FORMAT "%2.0" NUMBER 5 /end CHARACTERISTIC
/begin CHARACTERISTIC DINH_FId.DFC_LSUCircVirtGndSig_0_CA "/" VAL_BLK 0x80075DE2 ValA_Wu16 413. DINH_FIdVerb 0.00 413. FORMAT "%2.0" NUMBER 9 /end CHARACTERISTIC
/begin CHARACTERISTIC DINH_FId.DFC_LSUCircVirtGndSig_1_CA "/" VAL_BLK 0x80075DF4 ValA_Wu16 413. DINH_FIdVerb 0.00 413. FORMAT "%2.0" NUMBER 9 /end CHARACTERISTIC
/begin CHARACTERISTIC DINH_FId.DFC_LSUCircVirtGndSig_2_CA "/" VAL_BLK 0x80075E06 ValA_Wu16 413. DINH_FIdVerb 0.00 413. FORMAT "%2.0" NUMBER 5 /end CHARACTERISTIC
/begin CHARACTERISTIC DINH_FId.DFC_LSUCircVirtGndSig_3_CA "/" VAL_BLK 0x80075E10 ValA_Wu16 413. DINH_FIdVerb 0.00 413. FORMAT "%2.0" NUMBER 5 /end CHARACTERISTIC
/begin CHARACTERISTIC DINH_FId.DFC_LSUHtrMax_0_CA "/" VAL_BLK 0x80075E1A ValA_Wu16 413. DINH_FIdVerb 0.00 413. FORMAT "%2.0" NUMBER 10 /end CHARACTERISTIC
/begin CHARACTERISTIC DINH_FId.DFC_LSUHtrMax_1_CA "/" VAL_BLK 0x80075E2E ValA_Wu16 413. DINH_FIdVerb 0.00 413. FORMAT "%2.0" NUMBER 8 /end CHARACTERISTIC
/begin CHARACTERISTIC DINH_FId.DFC_LSUHtrMax_2_CA "/" VAL_BLK 0x80075E3E ValA_Wu16 413. DINH_FIdVerb 0.00 413. FORMAT "%2.0" NUMBER 5 /end CHARACTERISTIC
/begin CHARACTERISTIC DINH_FId.DFC_LSUHtrMax_3_CA "/" VAL_BLK 0x80075E48 ValA_Wu16 413. DINH_FIdVerb 0.00 413. FORMAT "%2.0" NUMBER 5 /end CHARACTERISTIC
/begin CHARACTERISTIC DINH_FId.DFC_LSUHtrMin_0_CA "/" VAL_BLK 0x80075E52 ValA_Wu16 413. DINH_FIdVerb 0.00 413. FORMAT "%2.0" NUMBER 9 /end CHARACTERISTIC
/begin CHARACTERISTIC DINH_FId.DFC_LSUHtrMin_1_CA "/" VAL_BLK 0x80075E64 ValA_Wu16 413. DINH_FIdVerb 0.00 413. FORMAT "%2.0" NUMBER 9 /end CHARACTERISTIC
/begin CHARACTERISTIC DINH_FId.DFC_LSUHtrMin_2_CA "/" VAL_BLK 0x80075E76 ValA_Wu16 413. DINH_FIdVerb 0.00 413. FORMAT "%2.0" NUMBER 5 /end CHARACTERISTIC
/begin CHARACTERISTIC DINH_FId.DFC_LSUHtrMin_3_CA "/" VAL_BLK 0x80075E80 ValA_Wu16 413. DINH_FIdVerb 0.00 413. FORMAT "%2.0" NUMBER 5 /end CHARACTERISTIC
/begin CHARACTERISTIC DINH_FId.DFC_LSUHtrSig_0_CA "/" VAL_BLK 0x80075E8A ValA_Wu16 413. DINH_FIdVerb 0.00 413. FORMAT "%2.0" NUMBER 9 /end CHARACTERISTIC
/begin CHARACTERISTIC DINH_FId.DFC_LSUHtrSig_1_CA "/" VAL_BLK 0x80075E9C ValA_Wu16 413. DINH_FIdVerb 0.00 413. FORMAT "%2.0" NUMBER 9 /end CHARACTERISTIC
/begin CHARACTERISTIC DINH_FId.DFC_LSUHtrSig_2_CA "/" VAL_BLK 0x80075EAE ValA_Wu16 413. DINH_FIdVerb 0.00 413. FORMAT "%2.0" NUMBER 5 /end CHARACTERISTIC
/begin CHARACTERISTIC DINH_FId.DFC_LSUHtrSig_3_CA "/" VAL_BLK 0x80075EB8 ValA_Wu16 413. DINH_FIdVerb 0.00 413. FORMAT "%2.0" NUMBER 5 /end CHARACTERISTIC
/begin CHARACTERISTIC DINH_FId.DFC_LSUO2Max_0_CA "/" VAL_BLK 0x80075EC2 ValA_Wu16 413. DINH_FIdVerb 0.00 413. FORMAT "%2.0" NUMBER 8 /end CHARACTERISTIC
/begin CHARACTERISTIC DINH_FId.DFC_LSUO2Max_1_CA "/" VAL_BLK 0x80075ED2 ValA_Wu16 413. DINH_FIdVerb 0.00 413. FORMAT "%2.0" NUMBER 8 /end CHARACTERISTIC
/begin CHARACTERISTIC DINH_FId.DFC_LSUO2Max_2_CA "/" VAL_BLK 0x80075EE2 ValA_Wu16 413. DINH_FIdVerb 0.00 413. FORMAT "%2.0" NUMBER 5 /end CHARACTERISTIC
/begin CHARACTERISTIC DINH_FId.DFC_LSUO2Max_3_CA "/" VAL_BLK 0x80075EEC ValA_Wu16 413. DINH_FIdVerb 0.00 413. FORMAT "%2.0" NUMBER 5 /end CHARACTERISTIC
/begin CHARACTERISTIC DINH_FId.DFC_LSUO2Min_0_CA "/" VAL_BLK 0x80075EF6 ValA_Wu16 413. DINH_FIdVerb 0.00 413. FORMAT "%2.0" NUMBER 8 /end CHARACTERISTIC
/begin CHARACTERISTIC DINH_FId.DFC_LSUO2Min_1_CA "/" VAL_BLK 0x80075F06 ValA_Wu16 413. DINH_FIdVerb 0.00 413. FORMAT "%2.0" NUMBER 8 /end CHARACTERISTIC
/begin CHARACTERISTIC DINH_FId.DFC_LSUO2Min_2_CA "/" VAL_BLK 0x80075F16 ValA_Wu16 413. DINH_FIdVerb 0.00 413. FORMAT "%2.0" NUMBER 5 /end CHARACTERISTIC
/begin CHARACTERISTIC DINH_FId.DFC_LSUO2Min_3_CA "/" VAL_BLK 0x80075F20 ValA_Wu16 413. DINH_FIdVerb 0.00 413. FORMAT "%2.0" NUMBER 5 /end CHARACTERISTIC
/begin CHARACTERISTIC DINH_FId.DFC_LSUSPIBattLowMin_0_CA "/" VAL_BLK 0x80075F2A ValA_Wu16 413. DINH_FIdVerb 0.00 413. FORMAT "%2.0" NUMBER 12 /end CHARACTERISTIC
/begin CHARACTERISTIC DINH_FId.DFC_LSUSPIBattLowMin_1_CA "/" VAL_BLK 0x80075F42 ValA_Wu16 413. DINH_FIdVerb 0.00 413. FORMAT "%2.0" NUMBER 12 /end CHARACTERISTIC
/begin CHARACTERISTIC DINH_FId.DFC_LSUSPIBattLowMin_2_CA "/" VAL_BLK 0x80075F5A ValA_Wu16 413. DINH_FIdVerb 0.00 413. FORMAT "%2.0" NUMBER 5 /end CHARACTERISTIC
/begin CHARACTERISTIC DINH_FId.DFC_LSUSPIBattLowMin_3_CA "/" VAL_BLK 0x80075F64 ValA_Wu16 413. DINH_FIdVerb 0.00 413. FORMAT "%2.0" NUMBER 5 /end CHARACTERISTIC
/begin CHARACTERISTIC DINH_FId.DFC_LSUSPISig_0_CA "/" VAL_BLK 0x80075F6E ValA_Wu16 413. DINH_FIdVerb 0.00 413. FORMAT "%2.0" NUMBER 9 /end CHARACTERISTIC
/begin CHARACTERISTIC DINH_FId.DFC_LSUSPISig_1_CA "/" VAL_BLK 0x80075F80 ValA_Wu16 413. DINH_FIdVerb 0.00 413. FORMAT "%2.0" NUMBER 9 /end CHARACTERISTIC
/begin CHARACTERISTIC DINH_FId.DFC_LSUSPISig_2_CA "/" VAL_BLK 0x80075F92 ValA_Wu16 413. DINH_FIdVerb 0.00 413. FORMAT "%2.0" NUMBER 5 /end CHARACTERISTIC
/begin CHARACTERISTIC DINH_FId.DFC_LSUSPISig_3_CA "/" VAL_BLK 0x80075F9C ValA_Wu16 413. DINH_FIdVerb 0.00 413. FORMAT "%2.0" NUMBER 5 /end CHARACTERISTIC
/begin CHARACTERISTIC DINH_FId.DFC_LSUtExcMax_0_CA "/" VAL_BLK 0x80075FA6 ValA_Wu16 413. DINH_FIdVerb 0.00 413. FORMAT "%2.0" NUMBER 8 /end CHARACTERISTIC
/begin CHARACTERISTIC DINH_FId.DFC_LSUtExcMax_1_CA "/" VAL_BLK 0x80075FB6 ValA_Wu16 413. DINH_FIdVerb 0.00 413. FORMAT "%2.0" NUMBER 8 /end CHARACTERISTIC
/begin CHARACTERISTIC DINH_FId.DFC_LSUtExcMax_2_CA "/" VAL_BLK 0x80075FC6 ValA_Wu16 413. DINH_FIdVerb 0.00 413. FORMAT "%2.0" NUMBER 5 /end CHARACTERISTIC
/begin CHARACTERISTIC DINH_FId.DFC_LSUtExcMax_3_CA "/" VAL_BLK 0x80075FD0 ValA_Wu16 413. DINH_FIdVerb 0.00 413. FORMAT "%2.0" NUMBER 5 /end CHARACTERISTIC
/begin CHARACTERISTIC DINH_FId.DFC_LSUtExcMin_0_CA "/" VAL_BLK 0x80075FDA ValA_Wu16 413. DINH_FIdVerb 0.00 413. FORMAT "%2.0" NUMBER 8 /end CHARACTERISTIC
/begin CHARACTERISTIC DINH_FId.DFC_LSUtExcMin_1_CA "/" VAL_BLK 0x80075FEA ValA_Wu16 413. DINH_FIdVerb 0.00 413. FORMAT "%2.0" NUMBER 8 /end CHARACTERISTIC
/begin CHARACTERISTIC DINH_FId.DFC_LSUtExcMin_2_CA "/" VAL_BLK 0x80075FFA ValA_Wu16 413. DINH_FIdVerb 0.00 413. FORMAT "%2.0" NUMBER 5 /end CHARACTERISTIC
/begin CHARACTERISTIC DINH_FId.DFC_LSUtExcMin_3_CA "/" VAL_BLK 0x80076004 ValA_Wu16 413. DINH_FIdVerb 0.00 413. FORMAT "%2.0" NUMBER 5 /end CHARACTERISTIC
/begin CHARACTERISTIC DINH_FId.DFC_MILOL_CA "/" VAL_BLK 0x8007600E ValA_Wu16 413. DINH_FIdVerb 0.00 413. FORMAT "%2.0" NUMBER 5 /end CHARACTERISTIC
/begin CHARACTERISTIC DINH_FId.DFC_MILSCB_CA "/" VAL_BLK 0x80076018 ValA_Wu16 413. DINH_FIdVerb 0.00 413. FORMAT "%2.0" NUMBER 5 /end CHARACTERISTIC
/begin CHARACTERISTIC DINH_FId.DFC_MILSCG_CA "/" VAL_BLK 0x80076022 ValA_Wu16 413. DINH_FIdVerb 0.00 413. FORMAT "%2.0" NUMBER 5 /end CHARACTERISTIC
/begin CHARACTERISTIC DINH_FId.DFC_MeUnSCG_CA "/" VAL_BLK 0x8007602C ValA_Wu16 413. DINH_FIdVerb 0.00 413. FORMAT "%2.0" NUMBER 12 /end CHARACTERISTIC
/begin CHARACTERISTIC DINH_FId.DFC_NplHsChngPPFltDiff_CA "/" VAL_BLK 0x80076044 ValA_Wu16 413. DINH_FIdVerb 0.00 413. FORMAT "%2.0" NUMBER 5 /end CHARACTERISTIC
/begin CHARACTERISTIC DINH_FId.DFC_NplPAirFltDs_CA "/" VAL_BLK 0x8007604E ValA_Wu16 413. DINH_FIdVerb 0.00 413. FORMAT "%2.0" NUMBER 7 /end CHARACTERISTIC
/begin CHARACTERISTIC DINH_FId.DFC_NplTPFltUs_CA "/" VAL_BLK 0x8007605C ValA_Wu16 413. DINH_FIdVerb 0.00 413. FORMAT "%2.0" NUMBER 6 /end CHARACTERISTIC
/begin CHARACTERISTIC DINH_FId.DFC_OilComErr_CA "/" VAL_BLK 0x80076068 ValA_Wu16 413. DINH_FIdVerb 0.00 413. FORMAT "%2.0" NUMBER 5 /end CHARACTERISTIC
/begin CHARACTERISTIC DINH_FId.DFC_OilPLmpOL_CA "/" VAL_BLK 0x80076072 ValA_Wu16 413. DINH_FIdVerb 0.00 413. FORMAT "%2.0" NUMBER 5 /end CHARACTERISTIC
/begin CHARACTERISTIC DINH_FId.DFC_OilPLmpSCB_CA "/" VAL_BLK 0x8007607C ValA_Wu16 413. DINH_FIdVerb 0.00 413. FORMAT "%2.0" NUMBER 5 /end CHARACTERISTIC
/begin CHARACTERISTIC DINH_FId.DFC_OilPLmpSCG_CA "/" VAL_BLK 0x80076086 ValA_Wu16 413. DINH_FIdVerb 0.00 413. FORMAT "%2.0" NUMBER 5 /end CHARACTERISTIC
/begin CHARACTERISTIC DINH_FId.DFC_OilPNpl_CA "/" VAL_BLK 0x80076090 ValA_Wu16 413. DINH_FIdVerb 0.00 413. FORMAT "%2.0" NUMBER 5 /end CHARACTERISTIC
/begin CHARACTERISTIC DINH_FId.DFC_OilTNpl_CA "/" VAL_BLK 0x8007609A ValA_Wu16 413. DINH_FIdVerb 0.00 413. FORMAT "%2.0" NUMBER 8 /end CHARACTERISTIC
/begin CHARACTERISTIC DINH_FId.DFC_OilTSRCMax_CA "/" VAL_BLK 0x800760AA ValA_Wu16 413. DINH_FIdVerb 0.00 413. FORMAT "%2.0" NUMBER 11 /end CHARACTERISTIC
/begin CHARACTERISTIC DINH_FId.DFC_OilTSRCMin_CA "/" VAL_BLK 0x800760C0 ValA_Wu16 413. DINH_FIdVerb 0.00 413. FORMAT "%2.0" NUMBER 10 /end CHARACTERISTIC
/begin CHARACTERISTIC DINH_FId.DFC_PCACDsEnvPPls_CA "/" VAL_BLK 0x800760D4 ValA_Wu16 413. DINH_FIdVerb 0.00 413. FORMAT "%2.0" NUMBER 8 /end CHARACTERISTIC
/begin CHARACTERISTIC DINH_FId.DFC_PCACDsSRCMax_CA "/" VAL_BLK 0x800760E4 ValA_Wu16 413. DINH_FIdVerb 0.00 413. FORMAT "%2.0" NUMBER 13 /end CHARACTERISTIC
/begin CHARACTERISTIC DINH_FId.DFC_PCACDsSRCMin_CA "/" VAL_BLK 0x800760FE ValA_Wu16 413. DINH_FIdVerb 0.00 413. FORMAT "%2.0" NUMBER 13 /end CHARACTERISTIC
/begin CHARACTERISTIC DINH_FId.DFC_PCVSCG_CA "/" VAL_BLK 0x80076118 ValA_Wu16 413. DINH_FIdVerb 0.00 413. FORMAT "%2.0" NUMBER 9 /end CHARACTERISTIC
/begin CHARACTERISTIC DINH_FId.DFC_PFltCharPDiffMin_CA "/" VAL_BLK 0x8007612A ValA_Wu16 413. DINH_FIdVerb 0.00 413. FORMAT "%2.0" NUMBER 5 /end CHARACTERISTIC
/begin CHARACTERISTIC DINH_FId.DFC_PFltDstrMin_CA "/" VAL_BLK 0x80076134 ValA_Wu16 413. DINH_FIdVerb 0.00 413. FORMAT "%2.0" NUMBER 5 /end CHARACTERISTIC
/begin CHARACTERISTIC DINH_FId.DFC_PFltEngPrt_CA "/" VAL_BLK 0x8007613E ValA_Wu16 413. DINH_FIdVerb 0.00 413. FORMAT "%2.0" NUMBER 5 /end CHARACTERISTIC
/begin CHARACTERISTIC DINH_FId.DFC_PFltLmpOL_CA "/" VAL_BLK 0x80076148 ValA_Wu16 413. DINH_FIdVerb 0.00 413. FORMAT "%2.0" NUMBER 5 /end CHARACTERISTIC
/begin CHARACTERISTIC DINH_FId.DFC_PFltLmpSCB_CA "/" VAL_BLK 0x80076152 ValA_Wu16 413. DINH_FIdVerb 0.00 413. FORMAT "%2.0" NUMBER 5 /end CHARACTERISTIC
/begin CHARACTERISTIC DINH_FId.DFC_PFltLmpSCG_CA "/" VAL_BLK 0x8007615C ValA_Wu16 413. DINH_FIdVerb 0.00 413. FORMAT "%2.0" NUMBER 5 /end CHARACTERISTIC
/begin CHARACTERISTIC DINH_FId.DFC_PFltRgnPerm_CA "/" VAL_BLK 0x80076166 ValA_Wu16 413. DINH_FIdVerb 0.00 413. FORMAT "%2.0" NUMBER 5 /end CHARACTERISTIC
/begin CHARACTERISTIC DINH_FId.DFC_PFltSRCMaxFlwRstn_CA "/" VAL_BLK 0x80076170 ValA_Wu16 413. DINH_FIdVerb 0.00 413. FORMAT "%2.0" NUMBER 6 /end CHARACTERISTIC
/begin CHARACTERISTIC DINH_FId.DFC_PFltSRCMinFlwRstn_CA "/" VAL_BLK 0x8007617C ValA_Wu16 413. DINH_FIdVerb 0.00 413. FORMAT "%2.0" NUMBER 6 /end CHARACTERISTIC
/begin CHARACTERISTIC DINH_FId.DFC_PFltSotMsDvtMax_CA "/" VAL_BLK 0x80076188 ValA_Wu16 413. DINH_FIdVerb 0.00 413. FORMAT "%2.0" NUMBER 5 /end CHARACTERISTIC
/begin CHARACTERISTIC DINH_FId.DFC_PFltSotMsDvtMin_CA "/" VAL_BLK 0x80076192 ValA_Wu16 413. DINH_FIdVerb 0.00 413. FORMAT "%2.0" NUMBER 5 /end CHARACTERISTIC
/begin CHARACTERISTIC DINH_FId.DFC_PFltSotMsMax_CA "/" VAL_BLK 0x8007619C ValA_Wu16 413. DINH_FIdVerb 0.00 413. FORMAT "%2.0" NUMBER 5 /end CHARACTERISTIC
/begin CHARACTERISTIC DINH_FId.DFC_PSPOL_CA "/" VAL_BLK 0x800761A6 ValA_Wu16 413. DINH_FIdVerb 0.00 413. FORMAT "%2.0" NUMBER 5 /end CHARACTERISTIC
/begin CHARACTERISTIC DINH_FId.DFC_PSPSCB_CA "/" VAL_BLK 0x800761B0 ValA_Wu16 413. DINH_FIdVerb 0.00 413. FORMAT "%2.0" NUMBER 5 /end CHARACTERISTIC
/begin CHARACTERISTIC DINH_FId.DFC_PSPSCG_CA "/" VAL_BLK 0x800761BA ValA_Wu16 413. DINH_FIdVerb 0.00 413. FORMAT "%2.0" NUMBER 5 /end CHARACTERISTIC
/begin CHARACTERISTIC DINH_FId.DFC_SRCHighAPP1_CA "/" VAL_BLK 0x800761C4 ValA_Wu16 413. DINH_FIdVerb 0.00 413. FORMAT "%2.0" NUMBER 6 /end CHARACTERISTIC
/begin CHARACTERISTIC DINH_FId.DFC_SRCHighAPP2_CA "/" VAL_BLK 0x800761D0 ValA_Wu16 413. DINH_FIdVerb 0.00 413. FORMAT "%2.0" NUMBER 6 /end CHARACTERISTIC
/begin CHARACTERISTIC DINH_FId.DFC_SRCLowAPP1_CA "/" VAL_BLK 0x800761DC ValA_Wu16 413. DINH_FIdVerb 0.00 413. FORMAT "%2.0" NUMBER 5 /end CHARACTERISTIC
/begin CHARACTERISTIC DINH_FId.DFC_SRCLowAPP2_CA "/" VAL_BLK 0x800761E6 ValA_Wu16 413. DINH_FIdVerb 0.00 413. FORMAT "%2.0" NUMBER 5 /end CHARACTERISTIC
/begin CHARACTERISTIC DINH_FId.DFC_SRCMaxPAirFltDs_CA "/" VAL_BLK 0x800761F0 ValA_Wu16 413. DINH_FIdVerb 0.00 413. FORMAT "%2.0" NUMBER 8 /end CHARACTERISTIC
/begin CHARACTERISTIC DINH_FId.DFC_SRCMaxPPFltUs_CA "/" VAL_BLK 0x80076200 ValA_Wu16 413. DINH_FIdVerb 0.00 413. FORMAT "%2.0" NUMBER 11 /end CHARACTERISTIC
/begin CHARACTERISTIC DINH_FId.DFC_SRCMaxTECU_CA "/" VAL_BLK 0x80076216 ValA_Wu16 413. DINH_FIdVerb 0.00 413. FORMAT "%2.0" NUMBER 7 /end CHARACTERISTIC
/begin CHARACTERISTIC DINH_FId.DFC_SRCMaxTOxiCatUs_CA "/" VAL_BLK 0x80076224 ValA_Wu16 413. DINH_FIdVerb 0.00 413. FORMAT "%2.0" NUMBER 10 /end CHARACTERISTIC
/begin CHARACTERISTIC DINH_FId.DFC_SRCMaxTPFltUs_CA "/" VAL_BLK 0x80076238 ValA_Wu16 413. DINH_FIdVerb 0.00 413. FORMAT "%2.0" NUMBER 16 /end CHARACTERISTIC
/begin CHARACTERISTIC DINH_FId.DFC_SRCMinPAirFltDs_CA "/" VAL_BLK 0x80076258 ValA_Wu16 413. DINH_FIdVerb 0.00 413. FORMAT "%2.0" NUMBER 8 /end CHARACTERISTIC
/begin CHARACTERISTIC DINH_FId.DFC_SRCMinPPFltUs_CA "/" VAL_BLK 0x80076268 ValA_Wu16 413. DINH_FIdVerb 0.00 413. FORMAT "%2.0" NUMBER 9 /end CHARACTERISTIC
/begin CHARACTERISTIC DINH_FId.DFC_SRCMinTECU_CA "/" VAL_BLK 0x8007627A ValA_Wu16 413. DINH_FIdVerb 0.00 413. FORMAT "%2.0" NUMBER 7 /end CHARACTERISTIC
/begin CHARACTERISTIC DINH_FId.DFC_SRCMinTOxiCatUs_CA "/" VAL_BLK 0x80076288 ValA_Wu16 413. DINH_FIdVerb 0.00 413. FORMAT "%2.0" NUMBER 10 /end CHARACTERISTIC
/begin CHARACTERISTIC DINH_FId.DFC_SRCMinTPFltUs_CA "/" VAL_BLK 0x8007629C ValA_Wu16 413. DINH_FIdVerb 0.00 413. FORMAT "%2.0" NUMBER 17 /end CHARACTERISTIC
/begin CHARACTERISTIC DINH_FId.DFC_SVSOL_CA "/" VAL_BLK 0x800762BE ValA_Wu16 413. DINH_FIdVerb 0.00 413. FORMAT "%2.0" NUMBER 5 /end CHARACTERISTIC
/begin CHARACTERISTIC DINH_FId.DFC_SVSSCB_CA "/" VAL_BLK 0x800762C8 ValA_Wu16 413. DINH_FIdVerb 0.00 413. FORMAT "%2.0" NUMBER 5 /end CHARACTERISTIC
/begin CHARACTERISTIC DINH_FId.DFC_SVSSCG_CA "/" VAL_BLK 0x800762D2 ValA_Wu16 413. DINH_FIdVerb 0.00 413. FORMAT "%2.0" NUMBER 5 /end CHARACTERISTIC
/begin CHARACTERISTIC DINH_FId.DFC_StrtOL_CA "/" VAL_BLK 0x800762DC ValA_Wu16 413. DINH_FIdVerb 0.00 413. FORMAT "%2.0" NUMBER 5 /end CHARACTERISTIC
/begin CHARACTERISTIC DINH_FId.DFC_StrtSCB_CA "/" VAL_BLK 0x800762E6 ValA_Wu16 413. DINH_FIdVerb 0.00 413. FORMAT "%2.0" NUMBER 5 /end CHARACTERISTIC
/begin CHARACTERISTIC DINH_FId.DFC_StrtSCG_CA "/" VAL_BLK 0x800762F0 ValA_Wu16 413. DINH_FIdVerb 0.00 413. FORMAT "%2.0" NUMBER 5 /end CHARACTERISTIC
/begin CHARACTERISTIC DINH_FId.DFC_SyncAPP_CA "/" VAL_BLK 0x800762FA ValA_Wu16 413. DINH_FIdVerb 0.00 413. FORMAT "%2.0" NUMBER 7 /end CHARACTERISTIC
/begin CHARACTERISTIC DINH_FId.DFC_T15Npl_CA "/" VAL_BLK 0x80076308 ValA_Wu16 413. DINH_FIdVerb 0.00 413. FORMAT "%2.0" NUMBER 5 /end CHARACTERISTIC
/begin CHARACTERISTIC DINH_FId.DFC_TAFSDtyCycHi_CA "/" VAL_BLK 0x80076312 ValA_Wu16 413. DINH_FIdVerb 0.00 413. FORMAT "%2.0" NUMBER 7 /end CHARACTERISTIC
/begin CHARACTERISTIC DINH_FId.DFC_TAFSDtyCycLo_CA "/" VAL_BLK 0x80076320 ValA_Wu16 413. DINH_FIdVerb 0.00 413. FORMAT "%2.0" NUMBER 7 /end CHARACTERISTIC
/begin CHARACTERISTIC DINH_FId.DFC_TAFSPerHi_CA "/" VAL_BLK 0x8007632E ValA_Wu16 413. DINH_FIdVerb 0.00 413. FORMAT "%2.0" NUMBER 7 /end CHARACTERISTIC
/begin CHARACTERISTIC DINH_FId.DFC_TAFSPerLo_CA "/" VAL_BLK 0x8007633C ValA_Wu16 413. DINH_FIdVerb 0.00 413. FORMAT "%2.0" NUMBER 7 /end CHARACTERISTIC
/begin CHARACTERISTIC DINH_FId.DFC_TCACDsSRCMax_CA "/" VAL_BLK 0x8007634A ValA_Wu16 413. DINH_FIdVerb 0.00 413. FORMAT "%2.0" NUMBER 11 /end CHARACTERISTIC
/begin CHARACTERISTIC DINH_FId.DFC_TCACDsSRCMin_CA "/" VAL_BLK 0x80076360 ValA_Wu16 413. DINH_FIdVerb 0.00 413. FORMAT "%2.0" NUMBER 11 /end CHARACTERISTIC
/begin CHARACTERISTIC DINH_FId.DFC_ThrVlvOL_CA "/" VAL_BLK 0x80076376 ValA_Wu16 413. DINH_FIdVerb 0.00 413. FORMAT "%2.0" NUMBER 6 /end CHARACTERISTIC
/begin CHARACTERISTIC DINH_FId.DFC_ThrVlvSCB_CA "/" VAL_BLK 0x80076382 ValA_Wu16 413. DINH_FIdVerb 0.00 413. FORMAT "%2.0" NUMBER 6 /end CHARACTERISTIC
/begin CHARACTERISTIC DINH_FId.DFC_ThrVlvSRCMax_CA "/" VAL_BLK 0x8007638E ValA_Wu16 413. DINH_FIdVerb 0.00 413. FORMAT "%2.0" NUMBER 7 /end CHARACTERISTIC
/begin CHARACTERISTIC DINH_FId.DFC_ThrVlvSRCMin_CA "/" VAL_BLK 0x8007639C ValA_Wu16 413. DINH_FIdVerb 0.00 413. FORMAT "%2.0" NUMBER 7 /end CHARACTERISTIC
/begin CHARACTERISTIC DINH_FId.DFC_TrbChLPOL_CA "/" VAL_BLK 0x800763AA ValA_Wu16 413. DINH_FIdVerb 0.00 413. FORMAT "%2.0" NUMBER 5 /end CHARACTERISTIC
/begin CHARACTERISTIC DINH_FId.DFC_TrbChLPSCB_CA "/" VAL_BLK 0x800763B4 ValA_Wu16 413. DINH_FIdVerb 0.00 413. FORMAT "%2.0" NUMBER 5 /end CHARACTERISTIC
/begin CHARACTERISTIC DINH_FId.DFC_TrbChLPSCG_CA "/" VAL_BLK 0x800763BE ValA_Wu16 413. DINH_FIdVerb 0.00 413. FORMAT "%2.0" NUMBER 5 /end CHARACTERISTIC
/begin CHARACTERISTIC DINH_FId.DFC_TrbChOL_CA "/" VAL_BLK 0x800763C8 ValA_Wu16 413. DINH_FIdVerb 0.00 413. FORMAT "%2.0" NUMBER 10 /end CHARACTERISTIC
/begin CHARACTERISTIC DINH_FId.DFC_TrbChSCB_CA "/" VAL_BLK 0x800763DC ValA_Wu16 413. DINH_FIdVerb 0.00 413. FORMAT "%2.0" NUMBER 10 /end CHARACTERISTIC
/begin CHARACTERISTIC DINH_FId.DFC_VSwVlvGovDvtMax_CA "/" VAL_BLK 0x800763F0 ValA_Wu16 413. DINH_FIdVerb 0.00 413. FORMAT "%2.0" NUMBER 5 /end CHARACTERISTIC
/begin CHARACTERISTIC DINH_FId.DFC_VSwVlvGovDvtMin_CA "/" VAL_BLK 0x800763FA ValA_Wu16 413. DINH_FIdVerb 0.00 413. FORMAT "%2.0" NUMBER 5 /end CHARACTERISTIC
/begin CHARACTERISTIC DINH_FId.DFC_VSwVlvOL_CA "/" VAL_BLK 0x80076404 ValA_Wu16 413. DINH_FIdVerb 0.00 413. FORMAT "%2.0" NUMBER 8 /end CHARACTERISTIC
/begin CHARACTERISTIC DINH_FId.DFC_VSwVlvSCB_CA "/" VAL_BLK 0x80076414 ValA_Wu16 413. DINH_FIdVerb 0.00 413. FORMAT "%2.0" NUMBER 8 /end CHARACTERISTIC
/begin CHARACTERISTIC DINH_FId.DFC_VSwVlvSCG_CA "/" VAL_BLK 0x80076424 ValA_Wu16 413. DINH_FIdVerb 0.00 413. FORMAT "%2.0" NUMBER 8 /end CHARACTERISTIC
/begin CHARACTERISTIC DINH_FId.DFC_VSwVlvSRCMax_CA "/" VAL_BLK 0x80076434 ValA_Wu16 413. DINH_FIdVerb 0.00 413. FORMAT "%2.0" NUMBER 9 /end CHARACTERISTIC
/begin CHARACTERISTIC DINH_FId.DFC_VSwVlvSRCMin_CA "/" VAL_BLK 0x80076446 ValA_Wu16 413. DINH_FIdVerb 0.00 413. FORMAT "%2.0" NUMBER 9 /end CHARACTERISTIC
/begin CHARACTERISTIC DINH_FId.DFC_VehVHW_CA "/" VAL_BLK 0x80076458 ValA_Wu16 413. DINH_FIdVerb 0.00 413. FORMAT "%2.0" NUMBER 13 /end CHARACTERISTIC
/begin CHARACTERISTIC DINH_FId.DFC_VehVMax_CA "/" VAL_BLK 0x80076472 ValA_Wu16 413. DINH_FIdVerb 0.00 413. FORMAT "%2.0" NUMBER 15 /end CHARACTERISTIC
/begin CHARACTERISTIC DINH_FId.DFC_VehVPlaus_CA "/" VAL_BLK 0x80076490 ValA_Wu16 413. DINH_FIdVerb 0.00 413. FORMAT "%2.0" NUMBER 15 /end CHARACTERISTIC
/begin CHARACTERISTIC DINH_FId.DFC_VehVSig_CA "/" VAL_BLK 0x800764AE ValA_Wu16 413. DINH_FIdVerb 0.00 413. FORMAT "%2.0" NUMBER 13 /end CHARACTERISTIC
/begin CHARACTERISTIC DINH_FId.DFC_WaHtElOL_CA "/" VAL_BLK 0x800764C8 ValA_Wu16 413. DINH_FIdVerb 0.00 413. FORMAT "%2.0" NUMBER 5 /end CHARACTERISTIC
/begin CHARACTERISTIC DINH_FId.DFC_WaHtElSCB_CA "/" VAL_BLK 0x800764D2 ValA_Wu16 413. DINH_FIdVerb 0.00 413. FORMAT "%2.0" NUMBER 5 /end CHARACTERISTIC
/begin CHARACTERISTIC DINH_FId.DFC_ClthNpl_CA "/" VAL_BLK 0x800764DC ValA_Wu16 413. DINH_FIdVerb 0.00 413. FORMAT "%2.0" NUMBER 12 /end CHARACTERISTIC
/begin CHARACTERISTIC DINH_FId.DFC_ETClbETMax_0_CA "/" VAL_BLK 0x800764F4 ValA_Wu16 413. DINH_FIdVerb 0.00 413. FORMAT "%2.0" NUMBER 5 /end CHARACTERISTIC
/begin CHARACTERISTIC DINH_FId.DFC_ETClbETMax_1_CA "/" VAL_BLK 0x800764FE ValA_Wu16 413. DINH_FIdVerb 0.00 413. FORMAT "%2.0" NUMBER 5 /end CHARACTERISTIC
/begin CHARACTERISTIC DINH_FId.DFC_ETClbETMax_2_CA "/" VAL_BLK 0x80076508 ValA_Wu16 413. DINH_FIdVerb 0.00 413. FORMAT "%2.0" NUMBER 5 /end CHARACTERISTIC
/begin CHARACTERISTIC DINH_FId.DFC_ETClbETMax_3_CA "/" VAL_BLK 0x80076512 ValA_Wu16 413. DINH_FIdVerb 0.00 413. FORMAT "%2.0" NUMBER 5 /end CHARACTERISTIC
/begin CHARACTERISTIC DINH_FId.DFC_ETClbETMax_4_CA "/" VAL_BLK 0x8007651C ValA_Wu16 413. DINH_FIdVerb 0.00 413. FORMAT "%2.0" NUMBER 5 /end CHARACTERISTIC
/begin CHARACTERISTIC DINH_FId.DFC_ETClbETMax_5_CA "/" VAL_BLK 0x80076526 ValA_Wu16 413. DINH_FIdVerb 0.00 413. FORMAT "%2.0" NUMBER 5 /end CHARACTERISTIC
/begin CHARACTERISTIC DINH_FId.DFC_ETClbETMin_0_CA "/" VAL_BLK 0x80076530 ValA_Wu16 413. DINH_FIdVerb 0.00 413. FORMAT "%2.0" NUMBER 5 /end CHARACTERISTIC
/begin CHARACTERISTIC DINH_FId.DFC_ETClbETMin_1_CA "/" VAL_BLK 0x8007653A ValA_Wu16 413. DINH_FIdVerb 0.00 413. FORMAT "%2.0" NUMBER 5 /end CHARACTERISTIC
/begin CHARACTERISTIC DINH_FId.DFC_ETClbETMin_2_CA "/" VAL_BLK 0x80076544 ValA_Wu16 413. DINH_FIdVerb 0.00 413. FORMAT "%2.0" NUMBER 5 /end CHARACTERISTIC
/begin CHARACTERISTIC DINH_FId.DFC_ETClbETMin_3_CA "/" VAL_BLK 0x8007654E ValA_Wu16 413. DINH_FIdVerb 0.00 413. FORMAT "%2.0" NUMBER 5 /end CHARACTERISTIC
/begin CHARACTERISTIC DINH_FId.DFC_ETClbETMin_4_CA "/" VAL_BLK 0x80076558 ValA_Wu16 413. DINH_FIdVerb 0.00 413. FORMAT "%2.0" NUMBER 5 /end CHARACTERISTIC
/begin CHARACTERISTIC DINH_FId.DFC_ETClbETMin_5_CA "/" VAL_BLK 0x80076562 ValA_Wu16 413. DINH_FIdVerb 0.00 413. FORMAT "%2.0" NUMBER 5 /end CHARACTERISTIC
/begin CHARACTERISTIC DINH_FId.DFC_IVDiaBnkShCirBSH_0_CA "/" VAL_BLK 0x8007656C ValA_Wu16 413. DINH_FIdVerb 0.00 413. FORMAT "%2.0" NUMBER 5 /end CHARACTERISTIC
/begin CHARACTERISTIC DINH_FId.DFC_IVDiaBnkShCirBSH_1_CA "/" VAL_BLK 0x80076576 ValA_Wu16 413. DINH_FIdVerb 0.00 413. FORMAT "%2.0" NUMBER 5 /end CHARACTERISTIC
/begin CHARACTERISTIC DINH_FId.DFC_IVDiaBnkShCirChSwt_0_CA "/" VAL_BLK 0x80076580 ValA_Wu16 413. DINH_FIdVerb 0.00 413. FORMAT "%2.0" NUMBER 5 /end CHARACTERISTIC
/begin CHARACTERISTIC DINH_FId.DFC_IVDiaBnkShCirChSwt_1_CA "/" VAL_BLK 0x8007658A ValA_Wu16 413. DINH_FIdVerb 0.00 413. FORMAT "%2.0" NUMBER 5 /end CHARACTERISTIC
/begin CHARACTERISTIC DINH_FId.DFC_IVDiaBnkShCirHSBatt_0_CA "/" VAL_BLK 0x80076594 ValA_Wu16 413. DINH_FIdVerb 0.00 413. FORMAT "%2.0" NUMBER 9 /end CHARACTERISTIC
/begin CHARACTERISTIC DINH_FId.DFC_IVDiaBnkShCirHSBatt_1_CA "/" VAL_BLK 0x800765A6 ValA_Wu16 413. DINH_FIdVerb 0.00 413. FORMAT "%2.0" NUMBER 9 /end CHARACTERISTIC
/begin CHARACTERISTIC DINH_FId.DFC_IVDiaBnkShCirHiRstnc_0_CA "/" VAL_BLK 0x800765B8 ValA_Wu16 413. DINH_FIdVerb 0.00 413. FORMAT "%2.0" NUMBER 5 /end CHARACTERISTIC
/begin CHARACTERISTIC DINH_FId.DFC_IVDiaBnkShCirHiRstnc_1_CA "/" VAL_BLK 0x800765C2 ValA_Wu16 413. DINH_FIdVerb 0.00 413. FORMAT "%2.0" NUMBER 5 /end CHARACTERISTIC
/begin CHARACTERISTIC DINH_FId.DFC_IVDiaBnkShCirLSHSGnd_0_CA "/" VAL_BLK 0x800765CC ValA_Wu16 413. DINH_FIdVerb 0.00 413. FORMAT "%2.0" NUMBER 5 /end CHARACTERISTIC
/begin CHARACTERISTIC DINH_FId.DFC_IVDiaBnkShCirLSHSGnd_1_CA "/" VAL_BLK 0x800765D6 ValA_Wu16 413. DINH_FIdVerb 0.00 413. FORMAT "%2.0" NUMBER 5 /end CHARACTERISTIC
/begin CHARACTERISTIC DINH_FId.DFC_IVDiaBnkShCirTransfer_0_CA "/" VAL_BLK 0x800765E0 ValA_Wu16 413. DINH_FIdVerb 0.00 413. FORMAT "%2.0" NUMBER 5 /end CHARACTERISTIC
/begin CHARACTERISTIC DINH_FId.DFC_IVDiaBnkShCirTransfer_1_CA "/" VAL_BLK 0x800765EA ValA_Wu16 413. DINH_FIdVerb 0.00 413. FORMAT "%2.0" NUMBER 5 /end CHARACTERISTIC
/begin CHARACTERISTIC DINH_FId.DFC_IVDiaCylNoCls_0_CA "/" VAL_BLK 0x800765F4 ValA_Wu16 413. DINH_FIdVerb 0.00 413. FORMAT "%2.0" NUMBER 5 /end CHARACTERISTIC
/begin CHARACTERISTIC DINH_FId.DFC_IVDiaCylNoCls_1_CA "/" VAL_BLK 0x800765FE ValA_Wu16 413. DINH_FIdVerb 0.00 413. FORMAT "%2.0" NUMBER 5 /end CHARACTERISTIC
/begin CHARACTERISTIC DINH_FId.DFC_IVDiaCylNoCls_2_CA "/" VAL_BLK 0x80076608 ValA_Wu16 413. DINH_FIdVerb 0.00 413. FORMAT "%2.0" NUMBER 5 /end CHARACTERISTIC
/begin CHARACTERISTIC DINH_FId.DFC_IVDiaCylNoCls_3_CA "/" VAL_BLK 0x80076612 ValA_Wu16 413. DINH_FIdVerb 0.00 413. FORMAT "%2.0" NUMBER 5 /end CHARACTERISTIC
/begin CHARACTERISTIC DINH_FId.DFC_IVDiaCylNoCls_4_CA "/" VAL_BLK 0x8007661C ValA_Wu16 413. DINH_FIdVerb 0.00 413. FORMAT "%2.0" NUMBER 5 /end CHARACTERISTIC
/begin CHARACTERISTIC DINH_FId.DFC_IVDiaCylNoCls_5_CA "/" VAL_BLK 0x80076626 ValA_Wu16 413. DINH_FIdVerb 0.00 413. FORMAT "%2.0" NUMBER 5 /end CHARACTERISTIC
/begin CHARACTERISTIC DINH_FId.DFC_IVDiaCylNoLd_0_CA "/" VAL_BLK 0x80076630 ValA_Wu16 413. DINH_FIdVerb 0.00 413. FORMAT "%2.0" NUMBER 5 /end CHARACTERISTIC
/begin CHARACTERISTIC DINH_FId.DFC_IVDiaCylNoLd_1_CA "/" VAL_BLK 0x8007663A ValA_Wu16 413. DINH_FIdVerb 0.00 413. FORMAT "%2.0" NUMBER 5 /end CHARACTERISTIC
/begin CHARACTERISTIC DINH_FId.DFC_IVDiaCylNoLd_2_CA "/" VAL_BLK 0x80076644 ValA_Wu16 413. DINH_FIdVerb 0.00 413. FORMAT "%2.0" NUMBER 5 /end CHARACTERISTIC
/begin CHARACTERISTIC DINH_FId.DFC_IVDiaCylNoLd_3_CA "/" VAL_BLK 0x8007664E ValA_Wu16 413. DINH_FIdVerb 0.00 413. FORMAT "%2.0" NUMBER 5 /end CHARACTERISTIC
/begin CHARACTERISTIC DINH_FId.DFC_IVDiaCylNoLd_4_CA "/" VAL_BLK 0x80076658 ValA_Wu16 413. DINH_FIdVerb 0.00 413. FORMAT "%2.0" NUMBER 5 /end CHARACTERISTIC
/begin CHARACTERISTIC DINH_FId.DFC_IVDiaCylNoLd_5_CA "/" VAL_BLK 0x80076662 ValA_Wu16 413. DINH_FIdVerb 0.00 413. FORMAT "%2.0" NUMBER 5 /end CHARACTERISTIC
/begin CHARACTERISTIC DINH_FId.DFC_IVDiaCylShCirHiRstnc_0_CA "/" VAL_BLK 0x8007666C ValA_Wu16 413. DINH_FIdVerb 0.00 413. FORMAT "%2.0" NUMBER 5 /end CHARACTERISTIC
/begin CHARACTERISTIC DINH_FId.DFC_IVDiaCylShCirHiRstnc_1_CA "/" VAL_BLK 0x80076676 ValA_Wu16 413. DINH_FIdVerb 0.00 413. FORMAT "%2.0" NUMBER 5 /end CHARACTERISTIC
/begin CHARACTERISTIC DINH_FId.DFC_IVDiaCylShCirHiRstnc_2_CA "/" VAL_BLK 0x80076680 ValA_Wu16 413. DINH_FIdVerb 0.00 413. FORMAT "%2.0" NUMBER 5 /end CHARACTERISTIC
/begin CHARACTERISTIC DINH_FId.DFC_IVDiaCylShCirHiRstnc_3_CA "/" VAL_BLK 0x8007668A ValA_Wu16 413. DINH_FIdVerb 0.00 413. FORMAT "%2.0" NUMBER 5 /end CHARACTERISTIC
/begin CHARACTERISTIC DINH_FId.DFC_IVDiaCylShCirHiRstnc_4_CA "/" VAL_BLK 0x80076694 ValA_Wu16 413. DINH_FIdVerb 0.00 413. FORMAT "%2.0" NUMBER 5 /end CHARACTERISTIC
/begin CHARACTERISTIC DINH_FId.DFC_IVDiaCylShCirHiRstnc_5_CA "/" VAL_BLK 0x8007669E ValA_Wu16 413. DINH_FIdVerb 0.00 413. FORMAT "%2.0" NUMBER 5 /end CHARACTERISTIC
/begin CHARACTERISTIC DINH_FId.DFC_IVDiaCylShCirLSBatt_0_CA "/" VAL_BLK 0x800766A8 ValA_Wu16 413. DINH_FIdVerb 0.00 413. FORMAT "%2.0" NUMBER 9 /end CHARACTERISTIC
/begin CHARACTERISTIC DINH_FId.DFC_IVDiaCylShCirLSBatt_1_CA "/" VAL_BLK 0x800766BA ValA_Wu16 413. DINH_FIdVerb 0.00 413. FORMAT "%2.0" NUMBER 9 /end CHARACTERISTIC
/begin CHARACTERISTIC DINH_FId.DFC_IVDiaCylShCirLSBatt_2_CA "/" VAL_BLK 0x800766CC ValA_Wu16 413. DINH_FIdVerb 0.00 413. FORMAT "%2.0" NUMBER 9 /end CHARACTERISTIC
/begin CHARACTERISTIC DINH_FId.DFC_IVDiaCylShCirLSBatt_3_CA "/" VAL_BLK 0x800766DE ValA_Wu16 413. DINH_FIdVerb 0.00 413. FORMAT "%2.0" NUMBER 9 /end CHARACTERISTIC
/begin CHARACTERISTIC DINH_FId.DFC_IVDiaCylShCirLSBatt_4_CA "/" VAL_BLK 0x800766F0 ValA_Wu16 413. DINH_FIdVerb 0.00 413. FORMAT "%2.0" NUMBER 9 /end CHARACTERISTIC
/begin CHARACTERISTIC DINH_FId.DFC_IVDiaCylShCirLSBatt_5_CA "/" VAL_BLK 0x80076702 ValA_Wu16 413. DINH_FIdVerb 0.00 413. FORMAT "%2.0" NUMBER 9 /end CHARACTERISTIC
/begin CHARACTERISTIC DINH_FId.DFC_IVDiaCylShCirLSHS_0_CA "/" VAL_BLK 0x80076714 ValA_Wu16 413. DINH_FIdVerb 0.00 413. FORMAT "%2.0" NUMBER 9 /end CHARACTERISTIC
/begin CHARACTERISTIC DINH_FId.DFC_IVDiaCylShCirLSHS_1_CA "/" VAL_BLK 0x80076726 ValA_Wu16 413. DINH_FIdVerb 0.00 413. FORMAT "%2.0" NUMBER 9 /end CHARACTERISTIC
/begin CHARACTERISTIC DINH_FId.DFC_IVDiaCylShCirLSHS_2_CA "/" VAL_BLK 0x80076738 ValA_Wu16 413. DINH_FIdVerb 0.00 413. FORMAT "%2.0" NUMBER 9 /end CHARACTERISTIC
/begin CHARACTERISTIC DINH_FId.DFC_IVDiaCylShCirLSHS_3_CA "/" VAL_BLK 0x8007674A ValA_Wu16 413. DINH_FIdVerb 0.00 413. FORMAT "%2.0" NUMBER 9 /end CHARACTERISTIC
/begin CHARACTERISTIC DINH_FId.DFC_IVDiaCylShCirLSHS_4_CA "/" VAL_BLK 0x8007675C ValA_Wu16 413. DINH_FIdVerb 0.00 413. FORMAT "%2.0" NUMBER 9 /end CHARACTERISTIC
/begin CHARACTERISTIC DINH_FId.DFC_IVDiaCylShCirLSHS_5_CA "/" VAL_BLK 0x8007676E ValA_Wu16 413. DINH_FIdVerb 0.00 413. FORMAT "%2.0" NUMBER 9 /end CHARACTERISTIC
/begin CHARACTERISTIC DINH_FId.DFC_IVDiaCylShCirLsLs_0_CA "/" VAL_BLK 0x80076780 ValA_Wu16 413. DINH_FIdVerb 0.00 413. FORMAT "%2.0" NUMBER 5 /end CHARACTERISTIC
/begin CHARACTERISTIC DINH_FId.DFC_IVDiaCylShCirLsLs_1_CA "/" VAL_BLK 0x8007678A ValA_Wu16 413. DINH_FIdVerb 0.00 413. FORMAT "%2.0" NUMBER 5 /end CHARACTERISTIC
/begin CHARACTERISTIC DINH_FId.DFC_IVDiaCylShCirLsLs_2_CA "/" VAL_BLK 0x80076794 ValA_Wu16 413. DINH_FIdVerb 0.00 413. FORMAT "%2.0" NUMBER 5 /end CHARACTERISTIC
/begin CHARACTERISTIC DINH_FId.DFC_IVDiaCylShCirLsLs_3_CA "/" VAL_BLK 0x8007679E ValA_Wu16 413. DINH_FIdVerb 0.00 413. FORMAT "%2.0" NUMBER 5 /end CHARACTERISTIC
/begin CHARACTERISTIC DINH_FId.DFC_IVDiaCylShCirLsLs_4_CA "/" VAL_BLK 0x800767A8 ValA_Wu16 413. DINH_FIdVerb 0.00 413. FORMAT "%2.0" NUMBER 5 /end CHARACTERISTIC
/begin CHARACTERISTIC DINH_FId.DFC_IVDiaCylShCirLsLs_5_CA "/" VAL_BLK 0x800767B2 ValA_Wu16 413. DINH_FIdVerb 0.00 413. FORMAT "%2.0" NUMBER 5 /end CHARACTERISTIC
/begin CHARACTERISTIC DINH_FId.DFC_IVDiaSPICfg_CA "/" VAL_BLK 0x800767BC ValA_Wu16 413. DINH_FIdVerb 0.00 413. FORMAT "%2.0" NUMBER 5 /end CHARACTERISTIC
/begin CHARACTERISTIC DINH_FId.DFC_IVDiaSPIColl_CA "/" VAL_BLK 0x800767C6 ValA_Wu16 413. DINH_FIdVerb 0.00 413. FORMAT "%2.0" NUMBER 5 /end CHARACTERISTIC
/begin CHARACTERISTIC DINH_FId.DFC_IVDiaSPICtrl_CA "/" VAL_BLK 0x800767D0 ValA_Wu16 413. DINH_FIdVerb 0.00 413. FORMAT "%2.0" NUMBER 5 /end CHARACTERISTIC
/begin CHARACTERISTIC DINH_FId.DFC_IVDiaSPIRam_CA "/" VAL_BLK 0x800767DA ValA_Wu16 413. DINH_FIdVerb 0.00 413. FORMAT "%2.0" NUMBER 5 /end CHARACTERISTIC
/begin CHARACTERISTIC DINH_FId.DFC_IVDiaSPITrans_CA "/" VAL_BLK 0x800767E4 ValA_Wu16 413. DINH_FIdVerb 0.00 413. FORMAT "%2.0" NUMBER 5 /end CHARACTERISTIC
/begin CHARACTERISTIC DINH_FId.DFC_LSUCmpChk_0_CA "/" VAL_BLK 0x800767EE ValA_Wu16 413. DINH_FIdVerb 0.00 413. FORMAT "%2.0" NUMBER 11 /end CHARACTERISTIC
/begin CHARACTERISTIC DINH_FId.DFC_LSUCmpChk_1_CA "/" VAL_BLK 0x80076804 ValA_Wu16 413. DINH_FIdVerb 0.00 413. FORMAT "%2.0" NUMBER 5 /end CHARACTERISTIC
/begin CHARACTERISTIC DINH_FId.DFC_LSUCmpChk_2_CA "/" VAL_BLK 0x8007680E ValA_Wu16 413. DINH_FIdVerb 0.00 413. FORMAT "%2.0" NUMBER 5 /end CHARACTERISTIC
/begin CHARACTERISTIC DINH_FId.DFC_LSUCmpChk_3_CA "/" VAL_BLK 0x80076818 ValA_Wu16 413. DINH_FIdVerb 0.00 413. FORMAT "%2.0" NUMBER 5 /end CHARACTERISTIC
/begin CHARACTERISTIC DINH_FId.DFC_LSUCmpChk_4_CA "/" VAL_BLK 0x80076822 ValA_Wu16 413. DINH_FIdVerb 0.00 413. FORMAT "%2.0" NUMBER 5 /end CHARACTERISTIC
/begin CHARACTERISTIC DINH_FId.DFC_LSUCmpChk_5_CA "/" VAL_BLK 0x8007682C ValA_Wu16 413. DINH_FIdVerb 0.00 413. FORMAT "%2.0" NUMBER 5 /end CHARACTERISTIC
/begin CHARACTERISTIC DINH_FId.DFC_LSUDynChk_0_CA "/" VAL_BLK 0x80076836 ValA_Wu16 413. DINH_FIdVerb 0.00 413. FORMAT "%2.0" NUMBER 8 /end CHARACTERISTIC
/begin CHARACTERISTIC DINH_FId.DFC_LSUDynChk_1_CA "/" VAL_BLK 0x80076846 ValA_Wu16 413. DINH_FIdVerb 0.00 413. FORMAT "%2.0" NUMBER 8 /end CHARACTERISTIC
/begin CHARACTERISTIC DINH_FId.DFC_LSUDynChk_2_CA "/" VAL_BLK 0x80076856 ValA_Wu16 413. DINH_FIdVerb 0.00 413. FORMAT "%2.0" NUMBER 5 /end CHARACTERISTIC
/begin CHARACTERISTIC DINH_FId.DFC_LSUDynChk_3_CA "/" VAL_BLK 0x80076860 ValA_Wu16 413. DINH_FIdVerb 0.00 413. FORMAT "%2.0" NUMBER 5 /end CHARACTERISTIC
/begin CHARACTERISTIC DINH_FId.DFC_LSUO2ClbMax_0_CA "/" VAL_BLK 0x8007686A ValA_Wu16 413. DINH_FIdVerb 0.00 413. FORMAT "%2.0" NUMBER 8 /end CHARACTERISTIC
/begin CHARACTERISTIC DINH_FId.DFC_LSUO2ClbMax_1_CA "/" VAL_BLK 0x8007687A ValA_Wu16 413. DINH_FIdVerb 0.00 413. FORMAT "%2.0" NUMBER 8 /end CHARACTERISTIC
/begin CHARACTERISTIC DINH_FId.DFC_LSUO2ClbMax_2_CA "/" VAL_BLK 0x8007688A ValA_Wu16 413. DINH_FIdVerb 0.00 413. FORMAT "%2.0" NUMBER 5 /end CHARACTERISTIC
/begin CHARACTERISTIC DINH_FId.DFC_LSUO2ClbMax_3_CA "/" VAL_BLK 0x80076894 ValA_Wu16 413. DINH_FIdVerb 0.00 413. FORMAT "%2.0" NUMBER 5 /end CHARACTERISTIC
/begin CHARACTERISTIC DINH_FId.DFC_LSUO2ClbMin_0_CA "/" VAL_BLK 0x8007689E ValA_Wu16 413. DINH_FIdVerb 0.00 413. FORMAT "%2.0" NUMBER 8 /end CHARACTERISTIC
/begin CHARACTERISTIC DINH_FId.DFC_LSUO2ClbMin_1_CA "/" VAL_BLK 0x800768AE ValA_Wu16 413. DINH_FIdVerb 0.00 413. FORMAT "%2.0" NUMBER 8 /end CHARACTERISTIC
/begin CHARACTERISTIC DINH_FId.DFC_LSUO2ClbMin_2_CA "/" VAL_BLK 0x800768BE ValA_Wu16 413. DINH_FIdVerb 0.00 413. FORMAT "%2.0" NUMBER 5 /end CHARACTERISTIC
/begin CHARACTERISTIC DINH_FId.DFC_LSUO2ClbMin_3_CA "/" VAL_BLK 0x800768C8 ValA_Wu16 413. DINH_FIdVerb 0.00 413. FORMAT "%2.0" NUMBER 5 /end CHARACTERISTIC
/begin CHARACTERISTIC DINH_FId.DFC_LSUO2PlausMax_0_CA "/" VAL_BLK 0x800768D2 ValA_Wu16 413. DINH_FIdVerb 0.00 413. FORMAT "%2.0" NUMBER 8 /end CHARACTERISTIC
/begin CHARACTERISTIC DINH_FId.DFC_LSUO2PlausMax_1_CA "/" VAL_BLK 0x800768E2 ValA_Wu16 413. DINH_FIdVerb 0.00 413. FORMAT "%2.0" NUMBER 8 /end CHARACTERISTIC
/begin CHARACTERISTIC DINH_FId.DFC_LSUO2PlausMax_2_CA "/" VAL_BLK 0x800768F2 ValA_Wu16 413. DINH_FIdVerb 0.00 413. FORMAT "%2.0" NUMBER 5 /end CHARACTERISTIC
/begin CHARACTERISTIC DINH_FId.DFC_LSUO2PlausMax_3_CA "/" VAL_BLK 0x800768FC ValA_Wu16 413. DINH_FIdVerb 0.00 413. FORMAT "%2.0" NUMBER 5 /end CHARACTERISTIC
/begin CHARACTERISTIC DINH_FId.DFC_LSUO2PlausMin_0_CA "/" VAL_BLK 0x80076906 ValA_Wu16 413. DINH_FIdVerb 0.00 413. FORMAT "%2.0" NUMBER 8 /end CHARACTERISTIC
/begin CHARACTERISTIC DINH_FId.DFC_LSUO2PlausMin_1_CA "/" VAL_BLK 0x80076916 ValA_Wu16 413. DINH_FIdVerb 0.00 413. FORMAT "%2.0" NUMBER 8 /end CHARACTERISTIC
/begin CHARACTERISTIC DINH_FId.DFC_LSUO2PlausMin_2_CA "/" VAL_BLK 0x80076926 ValA_Wu16 413. DINH_FIdVerb 0.00 413. FORMAT "%2.0" NUMBER 5 /end CHARACTERISTIC
/begin CHARACTERISTIC DINH_FId.DFC_LSUO2PlausMin_3_CA "/" VAL_BLK 0x80076930 ValA_Wu16 413. DINH_FIdVerb 0.00 413. FORMAT "%2.0" NUMBER 5 /end CHARACTERISTIC
/begin CHARACTERISTIC DINH_FId.DFC_LSURiClbMax_0_CA "/" VAL_BLK 0x8007693A ValA_Wu16 413. DINH_FIdVerb 0.00 413. FORMAT "%2.0" NUMBER 10 /end CHARACTERISTIC
/begin CHARACTERISTIC DINH_FId.DFC_LSURiClbMax_1_CA "/" VAL_BLK 0x8007694E ValA_Wu16 413. DINH_FIdVerb 0.00 413. FORMAT "%2.0" NUMBER 10 /end CHARACTERISTIC
/begin CHARACTERISTIC DINH_FId.DFC_LSURiClbMax_2_CA "/" VAL_BLK 0x80076962 ValA_Wu16 413. DINH_FIdVerb 0.00 413. FORMAT "%2.0" NUMBER 5 /end CHARACTERISTIC
/begin CHARACTERISTIC DINH_FId.DFC_LSURiClbMax_3_CA "/" VAL_BLK 0x8007696C ValA_Wu16 413. DINH_FIdVerb 0.00 413. FORMAT "%2.0" NUMBER 5 /end CHARACTERISTIC
/begin CHARACTERISTIC DINH_FId.DFC_LSURiClbMin_0_CA "/" VAL_BLK 0x80076976 ValA_Wu16 413. DINH_FIdVerb 0.00 413. FORMAT "%2.0" NUMBER 10 /end CHARACTERISTIC
/begin CHARACTERISTIC DINH_FId.DFC_LSURiClbMin_1_CA "/" VAL_BLK 0x8007698A ValA_Wu16 413. DINH_FIdVerb 0.00 413. FORMAT "%2.0" NUMBER 10 /end CHARACTERISTIC
/begin CHARACTERISTIC DINH_FId.DFC_LSURiClbMin_2_CA "/" VAL_BLK 0x8007699E ValA_Wu16 413. DINH_FIdVerb 0.00 413. FORMAT "%2.0" NUMBER 5 /end CHARACTERISTIC
/begin CHARACTERISTIC DINH_FId.DFC_LSURiClbMin_3_CA "/" VAL_BLK 0x800769A8 ValA_Wu16 413. DINH_FIdVerb 0.00 413. FORMAT "%2.0" NUMBER 5 /end CHARACTERISTIC
/begin CHARACTERISTIC DINH_FId.DFC_LSUWireIPSig_0_CA "/" VAL_BLK 0x800769B2 ValA_Wu16 413. DINH_FIdVerb 0.00 413. FORMAT "%2.0" NUMBER 7 /end CHARACTERISTIC
/begin CHARACTERISTIC DINH_FId.DFC_LSUWireIPSig_1_CA "/" VAL_BLK 0x800769C0 ValA_Wu16 413. DINH_FIdVerb 0.00 413. FORMAT "%2.0" NUMBER 7 /end CHARACTERISTIC
/begin CHARACTERISTIC DINH_FId.DFC_LSUWireIPSig_2_CA "/" VAL_BLK 0x800769CE ValA_Wu16 413. DINH_FIdVerb 0.00 413. FORMAT "%2.0" NUMBER 5 /end CHARACTERISTIC
/begin CHARACTERISTIC DINH_FId.DFC_LSUWireIPSig_3_CA "/" VAL_BLK 0x800769D8 ValA_Wu16 413. DINH_FIdVerb 0.00 413. FORMAT "%2.0" NUMBER 5 /end CHARACTERISTIC
/begin CHARACTERISTIC DINH_FId.DFC_AFSDrftIdlAdjVal_CA "/" VAL_BLK 0x800769E2 ValA_Wu16 413. DINH_FIdVerb 0.00 413. FORMAT "%2.0" NUMBER 6 /end CHARACTERISTIC
/begin CHARACTERISTIC DINH_FId.DFC_AFSDrftLdAdjVal_CA "/" VAL_BLK 0x800769EE ValA_Wu16 413. DINH_FIdVerb 0.00 413. FORMAT "%2.0" NUMBER 6 /end CHARACTERISTIC
/begin CHARACTERISTIC DINH_FId.DFC_AdcI_ADC0_Cal_CA "/" VAL_BLK 0x800769FA ValA_Wu16 413. DINH_FIdVerb 0.00 413. FORMAT "%2.0" NUMBER 6 /end CHARACTERISTIC
/begin CHARACTERISTIC DINH_FId.DFC_AdcI_ADC0_Conv_CA "/" VAL_BLK 0x80076A06 ValA_Wu16 413. DINH_FIdVerb 0.00 413. FORMAT "%2.0" NUMBER 6 /end CHARACTERISTIC
/begin CHARACTERISTIC DINH_FId.DFC_CmbChbMisfireMax_0_CA "/" VAL_BLK 0x80076A12 ValA_Wu16 413. DINH_FIdVerb 0.00 413. FORMAT "%2.0" NUMBER 5 /end CHARACTERISTIC
/begin CHARACTERISTIC DINH_FId.DFC_CmbChbMisfireMax_1_CA "/" VAL_BLK 0x80076A1C ValA_Wu16 413. DINH_FIdVerb 0.00 413. FORMAT "%2.0" NUMBER 5 /end CHARACTERISTIC
/begin CHARACTERISTIC DINH_FId.DFC_CmbChbMisfireMax_2_CA "/" VAL_BLK 0x80076A26 ValA_Wu16 413. DINH_FIdVerb 0.00 413. FORMAT "%2.0" NUMBER 5 /end CHARACTERISTIC
/begin CHARACTERISTIC DINH_FId.DFC_CmbChbMisfireMax_3_CA "/" VAL_BLK 0x80076A30 ValA_Wu16 413. DINH_FIdVerb 0.00 413. FORMAT "%2.0" NUMBER 5 /end CHARACTERISTIC
/begin CHARACTERISTIC DINH_FId.DFC_CmbChbMisfireMax_4_CA "/" VAL_BLK 0x80076A3A ValA_Wu16 413. DINH_FIdVerb 0.00 413. FORMAT "%2.0" NUMBER 5 /end CHARACTERISTIC
/begin CHARACTERISTIC DINH_FId.DFC_CmbChbMisfireMax_5_CA "/" VAL_BLK 0x80076A44 ValA_Wu16 413. DINH_FIdVerb 0.00 413. FORMAT "%2.0" NUMBER 5 /end CHARACTERISTIC
/begin CHARACTERISTIC DINH_FId.DFC_CmbChbMisfireMul_CA "/" VAL_BLK 0x80076A4E ValA_Wu16 413. DINH_FIdVerb 0.00 413. FORMAT "%2.0" NUMBER 5 /end CHARACTERISTIC
/begin CHARACTERISTIC DINH_FId.DFC_INJVLVBUSY_CA "/" VAL_BLK 0x80076A58 ValA_Wu16 413. DINH_FIdVerb 0.00 413. FORMAT "%2.0" NUMBER 5 /end CHARACTERISTIC
/begin CHARACTERISTIC DINH_FId.DFC_IVAdjIVA_0_CA "/" VAL_BLK 0x80076A62 ValA_Wu16 413. DINH_FIdVerb 0.00 413. FORMAT "%2.0" NUMBER 5 /end CHARACTERISTIC
/begin CHARACTERISTIC DINH_FId.DFC_IVAdjIVA_1_CA "/" VAL_BLK 0x80076A6C ValA_Wu16 413. DINH_FIdVerb 0.00 413. FORMAT "%2.0" NUMBER 5 /end CHARACTERISTIC
/begin CHARACTERISTIC DINH_FId.DFC_IVAdjIVA_2_CA "/" VAL_BLK 0x80076A76 ValA_Wu16 413. DINH_FIdVerb 0.00 413. FORMAT "%2.0" NUMBER 5 /end CHARACTERISTIC
/begin CHARACTERISTIC DINH_FId.DFC_IVAdjIVA_3_CA "/" VAL_BLK 0x80076A80 ValA_Wu16 413. DINH_FIdVerb 0.00 413. FORMAT "%2.0" NUMBER 5 /end CHARACTERISTIC
/begin MEASUREMENT DINH_xWhy.FId_Unused "" UWORD DFCDSQ_Verb 1 100 0.00 656. FORMAT "%2.0" ECU_ADDRESS 0xD0005F68 /end MEASUREMENT
/begin MEASUREMENT DINH_xWhy.FId_InhibitAlways "" UWORD DFCDSQ_Verb 1 100 0.00 656. FORMAT "%2.0" ECU_ADDRESS 0xD0005F6A /end MEASUREMENT
/begin MEASUREMENT DINH_xWhy.FId_CoordALS "" UWORD DFCDSQ_Verb 1 100 0.00 656. FORMAT "%2.0" ECU_ADDRESS 0xD0005F6C /end MEASUREMENT
/begin MEASUREMENT DINH_xWhy.FId_CoordFBC "" UWORD DFCDSQ_Verb 1 100 0.00 656. FORMAT "%2.0" ECU_ADDRESS 0xD0005F6E /end MEASUREMENT
/begin MEASUREMENT DINH_xWhy.FId_CoordTAA "" UWORD DFCDSQ_Verb 1 100 0.00 656. FORMAT "%2.0" ECU_ADDRESS 0xD0005F70 /end MEASUREMENT
/begin MEASUREMENT DINH_xWhy.FId_CoordZFC "" UWORD DFCDSQ_Verb 1 100 0.00 656. FORMAT "%2.0" ECU_ADDRESS 0xD0005F72 /end MEASUREMENT
/begin MEASUREMENT DINH_xWhy.FId_ACCtlTEngErr "" UWORD DFCDSQ_Verb 1 100 0.00 656. FORMAT "%2.0" ECU_ADDRESS 0xD0005F74 /end MEASUREMENT
/begin MEASUREMENT DINH_xWhy.FId_ACCtlTGearbxErr "" UWORD DFCDSQ_Verb 1 100 0.00 656. FORMAT "%2.0" ECU_ADDRESS 0xD0005F76 /end MEASUREMENT
/begin MEASUREMENT DINH_xWhy.FId_ACCtlVehVErr "" UWORD DFCDSQ_Verb 1 100 0.00 656. FORMAT "%2.0" ECU_ADDRESS 0xD0005F78 /end MEASUREMENT
/begin MEASUREMENT DINH_xWhy.FId_ACCtl_AC "" UWORD DFCDSQ_Verb 1 100 0.00 656. FORMAT "%2.0" ECU_ADDRESS 0xD0005F7A /end MEASUREMENT
/begin MEASUREMENT DINH_xWhy.FId_ACCtl_Fan "" UWORD DFCDSQ_Verb 1 100 0.00 656. FORMAT "%2.0" ECU_ADDRESS 0xD0005F7C /end MEASUREMENT
/begin MEASUREMENT DINH_xWhy.FId_AC_pAC "" UWORD DFCDSQ_Verb 1 100 0.00 656. FORMAT "%2.0" ECU_ADDRESS 0xD0005F7E /end MEASUREMENT
/begin MEASUREMENT DINH_xWhy.FId_AFS "" UWORD DFCDSQ_Verb 1 100 0.00 656. FORMAT "%2.0" ECU_ADDRESS 0xD0005F80 /end MEASUREMENT
/begin MEASUREMENT DINH_xWhy.FId_AFSActrTst "" UWORD DFCDSQ_Verb 1 100 0.00 656. FORMAT "%2.0" ECU_ADDRESS 0xD0005F82 /end MEASUREMENT
/begin MEASUREMENT DINH_xWhy.FId_AFSDrftMaxLim "" UWORD DFCDSQ_Verb 1 100 0.00 656. FORMAT "%2.0" ECU_ADDRESS 0xD0005F84 /end MEASUREMENT
/begin MEASUREMENT DINH_xWhy.FId_AFSFrzAirMs "" UWORD DFCDSQ_Verb 1 100 0.00 656. FORMAT "%2.0" ECU_ADDRESS 0xD0005F86 /end MEASUREMENT
/begin MEASUREMENT DINH_xWhy.FId_AFSPlOffsDrft "" UWORD DFCDSQ_Verb 1 100 0.00 656. FORMAT "%2.0" ECU_ADDRESS 0xD0005F88 /end MEASUREMENT
/begin MEASUREMENT DINH_xWhy.FId_AFSPlSetyDrft "" UWORD DFCDSQ_Verb 1 100 0.00 656. FORMAT "%2.0" ECU_ADDRESS 0xD0005F8A /end MEASUREMENT
/begin MEASUREMENT DINH_xWhy.FId_AFSSRC "" UWORD DFCDSQ_Verb 1 100 0.00 656. FORMAT "%2.0" ECU_ADDRESS 0xD0005F8C /end MEASUREMENT
/begin MEASUREMENT DINH_xWhy.FId_AFSSysErr "" UWORD DFCDSQ_Verb 1 100 0.00 656. FORMAT "%2.0" ECU_ADDRESS 0xD0005F8E /end MEASUREMENT
/begin MEASUREMENT DINH_xWhy.FId_AFSTPer "" UWORD DFCDSQ_Verb 1 100 0.00 656. FORMAT "%2.0" ECU_ADDRESS 0xD0005F90 /end MEASUREMENT
/begin MEASUREMENT DINH_xWhy.FId_APP1FinalDef "" UWORD DFCDSQ_Verb 1 100 0.00 656. FORMAT "%2.0" ECU_ADDRESS 0xD0005F92 /end MEASUREMENT
/begin MEASUREMENT DINH_xWhy.FId_APP1ProvDef "" UWORD DFCDSQ_Verb 1 100 0.00 656. FORMAT "%2.0" ECU_ADDRESS 0xD0005F94 /end MEASUREMENT
/begin MEASUREMENT DINH_xWhy.FId_APP1SRCHigh "" UWORD DFCDSQ_Verb 1 100 0.00 656. FORMAT "%2.0" ECU_ADDRESS 0xD0005F96 /end MEASUREMENT
/begin MEASUREMENT DINH_xWhy.FId_APP1SigPath "" UWORD DFCDSQ_Verb 1 100 0.00 656. FORMAT "%2.0" ECU_ADDRESS 0xD0005F98 /end MEASUREMENT
/begin MEASUREMENT DINH_xWhy.FId_APP2FinalDef "" UWORD DFCDSQ_Verb 1 100 0.00 656. FORMAT "%2.0" ECU_ADDRESS 0xD0005F9A /end MEASUREMENT
/begin MEASUREMENT DINH_xWhy.FId_APP2ProvDef "" UWORD DFCDSQ_Verb 1 100 0.00 656. FORMAT "%2.0" ECU_ADDRESS 0xD0005F9C /end MEASUREMENT
/begin MEASUREMENT DINH_xWhy.FId_APP2SRCHigh "" UWORD DFCDSQ_Verb 1 100 0.00 656. FORMAT "%2.0" ECU_ADDRESS 0xD0005F9E /end MEASUREMENT
/begin MEASUREMENT DINH_xWhy.FId_APP2SigPath "" UWORD DFCDSQ_Verb 1 100 0.00 656. FORMAT "%2.0" ECU_ADDRESS 0xD0005FA0 /end MEASUREMENT
/begin MEASUREMENT DINH_xWhy.FId_APPBrkDef "" UWORD DFCDSQ_Verb 1 100 0.00 656. FORMAT "%2.0" ECU_ADDRESS 0xD0005FA2 /end MEASUREMENT
/begin MEASUREMENT DINH_xWhy.FId_APPBrkPres "" UWORD DFCDSQ_Verb 1 100 0.00 656. FORMAT "%2.0" ECU_ADDRESS 0xD0005FA4 /end MEASUREMENT
/begin MEASUREMENT DINH_xWhy.FId_APPNTP "" UWORD DFCDSQ_Verb 1 100 0.00 656. FORMAT "%2.0" ECU_ADDRESS 0xD0005FA6 /end MEASUREMENT
/begin MEASUREMENT DINH_xWhy.FId_APPSyncChk "" UWORD DFCDSQ_Verb 1 100 0.00 656. FORMAT "%2.0" ECU_ADDRESS 0xD0005FA8 /end MEASUREMENT
/begin MEASUREMENT DINH_xWhy.FId_APPSyncDef "" UWORD DFCDSQ_Verb 1 100 0.00 656. FORMAT "%2.0" ECU_ADDRESS 0xD0005FAA /end MEASUREMENT
/begin MEASUREMENT DINH_xWhy.FId_APPSyncProvDef "" UWORD DFCDSQ_Verb 1 100 0.00 656. FORMAT "%2.0" ECU_ADDRESS 0xD0005FAC /end MEASUREMENT
/begin MEASUREMENT DINH_xWhy.FId_APPSyncSigProv "" UWORD DFCDSQ_Verb 1 100 0.00 656. FORMAT "%2.0" ECU_ADDRESS 0xD0005FAE /end MEASUREMENT
/begin MEASUREMENT DINH_xWhy.FId_APPVel "" UWORD DFCDSQ_Verb 1 100 0.00 656. FORMAT "%2.0" ECU_ADDRESS 0xD0005FB0 /end MEASUREMENT
/begin MEASUREMENT DINH_xWhy.FId_APProvDef "" UWORD DFCDSQ_Verb 1 100 0.00 656. FORMAT "%2.0" ECU_ADDRESS 0xD0005FB2 /end MEASUREMENT
/begin MEASUREMENT DINH_xWhy.FId_ASDdc "" UWORD DFCDSQ_Verb 1 100 0.00 656. FORMAT "%2.0" ECU_ADDRESS 0xD0005FB4 /end MEASUREMENT
/begin MEASUREMENT DINH_xWhy.FId_ASModNSC "" UWORD DFCDSQ_Verb 1 100 0.00 656. FORMAT "%2.0" ECU_ADDRESS 0xD0005FB6 /end MEASUREMENT
/begin MEASUREMENT DINH_xWhy.FId_ASModOxiC "" UWORD DFCDSQ_Verb 1 100 0.00 656. FORMAT "%2.0" ECU_ADDRESS 0xD0005FB8 /end MEASUREMENT
/begin MEASUREMENT DINH_xWhy.FId_ASModPipe "" UWORD DFCDSQ_Verb 1 100 0.00 656. FORMAT "%2.0" ECU_ADDRESS 0xD0005FBA /end MEASUREMENT
/begin MEASUREMENT DINH_xWhy.FId_ASModPipeSlw "" UWORD DFCDSQ_Verb 1 100 0.00 656. FORMAT "%2.0" ECU_ADDRESS 0xD0005FBC /end MEASUREMENT
/begin MEASUREMENT DINH_xWhy.FId_ASModPresCalc "" UWORD DFCDSQ_Verb 1 100 0.00 656. FORMAT "%2.0" ECU_ADDRESS 0xD0005FBE /end MEASUREMENT
/begin MEASUREMENT DINH_xWhy.FId_ASModPresEnv "" UWORD DFCDSQ_Verb 1 100 0.00 656. FORMAT "%2.0" ECU_ADDRESS 0xD0005FC0 /end MEASUREMENT
/begin MEASUREMENT DINH_xWhy.FId_ASModStrt "" UWORD DFCDSQ_Verb 1 100 0.00 656. FORMAT "%2.0" ECU_ADDRESS 0xD0005FC2 /end MEASUREMENT
/begin MEASUREMENT DINH_xWhy.FId_ASModSwtOffEng "" UWORD DFCDSQ_Verb 1 100 0.00 656. FORMAT "%2.0" ECU_ADDRESS 0xD0005FC4 /end MEASUREMENT
/begin MEASUREMENT DINH_xWhy.FId_ASModSwtOffIndVol "" UWORD DFCDSQ_Verb 1 100 0.00 656. FORMAT "%2.0" ECU_ADDRESS 0xD0005FC6 /end MEASUREMENT
/begin MEASUREMENT DINH_xWhy.FId_ASModTrbn "" UWORD DFCDSQ_Verb 1 100 0.00 656. FORMAT "%2.0" ECU_ADDRESS 0xD0005FC8 /end MEASUREMENT
/begin MEASUREMENT DINH_xWhy.FId_AccPedNMaxLim "" UWORD DFCDSQ_Verb 1 100 0.00 656. FORMAT "%2.0" ECU_ADDRESS 0xD0005FCA /end MEASUREMENT
/begin MEASUREMENT DINH_xWhy.FId_AccPedNMinLim "" UWORD DFCDSQ_Verb 1 100 0.00 656. FORMAT "%2.0" ECU_ADDRESS 0xD0005FCC /end MEASUREMENT
/begin MEASUREMENT DINH_xWhy.FId_AccPedNMinLimBrkApp "" UWORD DFCDSQ_Verb 1 100 0.00 656. FORMAT "%2.0" ECU_ADDRESS 0xD0005FCE /end MEASUREMENT
/begin MEASUREMENT DINH_xWhy.FId_AccPedTrqLim "" UWORD DFCDSQ_Verb 1 100 0.00 656. FORMAT "%2.0" ECU_ADDRESS 0xD0005FD0 /end MEASUREMENT
/begin MEASUREMENT DINH_xWhy.FId_AdcI_ADC0 "" UWORD DFCDSQ_Verb 1 100 0.00 656. FORMAT "%2.0" ECU_ADDRESS 0xD0005FD2 /end MEASUREMENT
/begin MEASUREMENT DINH_xWhy.FId_AirCClntPFrzVal "" UWORD DFCDSQ_Verb 1 100 0.00 656. FORMAT "%2.0" ECU_ADDRESS 0xD0005FD4 /end MEASUREMENT
/begin MEASUREMENT DINH_xWhy.FId_AirCClntPPwmChk "" UWORD DFCDSQ_Verb 1 100 0.00 656. FORMAT "%2.0" ECU_ADDRESS 0xD0005FD6 /end MEASUREMENT
/begin MEASUREMENT DINH_xWhy.FId_AirCClntPRplVal "" UWORD DFCDSQ_Verb 1 100 0.00 656. FORMAT "%2.0" ECU_ADDRESS 0xD0005FD8 /end MEASUREMENT
/begin MEASUREMENT DINH_xWhy.FId_AirCSwt "" UWORD DFCDSQ_Verb 1 100 0.00 656. FORMAT "%2.0" ECU_ADDRESS 0xD0005FDA /end MEASUREMENT
/begin MEASUREMENT DINH_xWhy.FId_AirCtl "" UWORD DFCDSQ_Verb 1 100 0.00 656. FORMAT "%2.0" ECU_ADDRESS 0xD0005FDC /end MEASUREMENT
/begin MEASUREMENT DINH_xWhy.FId_AirCtlBstPresCor "" UWORD DFCDSQ_Verb 1 100 0.00 656. FORMAT "%2.0" ECU_ADDRESS 0xD0005FDE /end MEASUREMENT
/begin MEASUREMENT DINH_xWhy.FId_AirCtlCmpntActv "" UWORD DFCDSQ_Verb 1 100 0.00 656. FORMAT "%2.0" ECU_ADDRESS 0xD0005FE0 /end MEASUREMENT
/begin MEASUREMENT DINH_xWhy.FId_AirCtlEGR "" UWORD DFCDSQ_Verb 1 100 0.00 656. FORMAT "%2.0" ECU_ADDRESS 0xD0005FE2 /end MEASUREMENT
/begin MEASUREMENT DINH_xWhy.FId_AirCtlGear "" UWORD DFCDSQ_Verb 1 100 0.00 656. FORMAT "%2.0" ECU_ADDRESS 0xD0005FE4 /end MEASUREMENT
/begin MEASUREMENT DINH_xWhy.FId_AirCtlGovDvt "" UWORD DFCDSQ_Verb 1 100 0.00 656. FORMAT "%2.0" ECU_ADDRESS 0xD0005FE6 /end MEASUREMENT
/begin MEASUREMENT DINH_xWhy.FId_AirCtlPFltEGRRed "" UWORD DFCDSQ_Verb 1 100 0.00 656. FORMAT "%2.0" ECU_ADDRESS 0xD0005FE8 /end MEASUREMENT
/begin MEASUREMENT DINH_xWhy.FId_AirCtlStrg "" UWORD DFCDSQ_Verb 1 100 0.00 656. FORMAT "%2.0" ECU_ADDRESS 0xD0005FEA /end MEASUREMENT
/begin MEASUREMENT DINH_xWhy.FId_AirCtlTVA "" UWORD DFCDSQ_Verb 1 100 0.00 656. FORMAT "%2.0" ECU_ADDRESS 0xD0005FEC /end MEASUREMENT
/begin MEASUREMENT DINH_xWhy.FId_BattUFrzVal "" UWORD DFCDSQ_Verb 1 100 0.00 656. FORMAT "%2.0" ECU_ADDRESS 0xD0005FEE /end MEASUREMENT
/begin MEASUREMENT DINH_xWhy.FId_BattUReplVal "" UWORD DFCDSQ_Verb 1 100 0.00 656. FORMAT "%2.0" ECU_ADDRESS 0xD0005FF0 /end MEASUREMENT
/begin MEASUREMENT DINH_xWhy.FId_BattUSRC "" UWORD DFCDSQ_Verb 1 100 0.00 656. FORMAT "%2.0" ECU_ADDRESS 0xD0005FF2 /end MEASUREMENT
/begin MEASUREMENT DINH_xWhy.FId_BrkP "" UWORD DFCDSQ_Verb 1 100 0.00 656. FORMAT "%2.0" ECU_ADDRESS 0xD0005FF4 /end MEASUREMENT
/begin MEASUREMENT DINH_xWhy.FId_BrkPFrzVal "" UWORD DFCDSQ_Verb 1 100 0.00 656. FORMAT "%2.0" ECU_ADDRESS 0xD0005FF6 /end MEASUREMENT
/begin MEASUREMENT DINH_xWhy.FId_BrkPReplVal "" UWORD DFCDSQ_Verb 1 100 0.00 656. FORMAT "%2.0" ECU_ADDRESS 0xD0005FF8 /end MEASUREMENT
/begin MEASUREMENT DINH_xWhy.FId_CEngDsTCANFrzVal "" UWORD DFCDSQ_Verb 1 100 0.00 656. FORMAT "%2.0" ECU_ADDRESS 0xD0005FFA /end MEASUREMENT
/begin MEASUREMENT DINH_xWhy.FId_CEngDsTCANRplVal "" UWORD DFCDSQ_Verb 1 100 0.00 656. FORMAT "%2.0" ECU_ADDRESS 0xD0005FFC /end MEASUREMENT
/begin MEASUREMENT DINH_xWhy.FId_CEngDsTDynTst "" UWORD DFCDSQ_Verb 1 100 0.00 656. FORMAT "%2.0" ECU_ADDRESS 0xD0005FFE /end MEASUREMENT
/begin MEASUREMENT DINH_xWhy.FId_CEngDsTFrzVal "" UWORD DFCDSQ_Verb 1 100 0.00 656. FORMAT "%2.0" ECU_ADDRESS 0xD0006000 /end MEASUREMENT
/begin MEASUREMENT DINH_xWhy.FId_CEngDsTModel "" UWORD DFCDSQ_Verb 1 100 0.00 656. FORMAT "%2.0" ECU_ADDRESS 0xD0006002 /end MEASUREMENT
/begin MEASUREMENT DINH_xWhy.FId_CEngDsTRdClnt "" UWORD DFCDSQ_Verb 1 100 0.00 656. FORMAT "%2.0" ECU_ADDRESS 0xD0006004 /end MEASUREMENT
/begin MEASUREMENT DINH_xWhy.FId_CEngDsTRplVal "" UWORD DFCDSQ_Verb 1 100 0.00 656. FORMAT "%2.0" ECU_ADDRESS 0xD0006006 /end MEASUREMENT
/begin MEASUREMENT DINH_xWhy.FId_CEngDsTSS "" UWORD DFCDSQ_Verb 1 100 0.00 656. FORMAT "%2.0" ECU_ADDRESS 0xD0006008 /end MEASUREMENT
/begin MEASUREMENT DINH_xWhy.FId_CEngUsTFrzVal "" UWORD DFCDSQ_Verb 1 100 0.00 656. FORMAT "%2.0" ECU_ADDRESS 0xD000600A /end MEASUREMENT
/begin MEASUREMENT DINH_xWhy.FId_CEngUsTReplVal "" UWORD DFCDSQ_Verb 1 100 0.00 656. FORMAT "%2.0" ECU_ADDRESS 0xD000600C /end MEASUREMENT
/begin MEASUREMENT DINH_xWhy.FId_CEngUsTSS "" UWORD DFCDSQ_Verb 1 100 0.00 656. FORMAT "%2.0" ECU_ADDRESS 0xD000600E /end MEASUREMENT
/begin MEASUREMENT DINH_xWhy.FId_Clth "" UWORD DFCDSQ_Verb 1 100 0.00 656. FORMAT "%2.0" ECU_ADDRESS 0xD0006010 /end MEASUREMENT
/begin MEASUREMENT DINH_xWhy.FId_ClthCAN "" UWORD DFCDSQ_Verb 1 100 0.00 656. FORMAT "%2.0" ECU_ADDRESS 0xD0006012 /end MEASUREMENT
/begin MEASUREMENT DINH_xWhy.FId_CmbChb "" UWORD DFCDSQ_Verb 1 100 0.00 656. FORMAT "%2.0" ECU_ADDRESS 0xD0006014 /end MEASUREMENT
/begin MEASUREMENT DINH_xWhy.FId_CoETM "" UWORD DFCDSQ_Verb 1 100 0.00 656. FORMAT "%2.0" ECU_ADDRESS 0xD0006016 /end MEASUREMENT
/begin MEASUREMENT DINH_xWhy.FId_CoEngNrml2Strt "" UWORD DFCDSQ_Verb 1 100 0.00 656. FORMAT "%2.0" ECU_ADDRESS 0xD0006018 /end MEASUREMENT
/begin MEASUREMENT DINH_xWhy.FId_CoEngPthClsEGR "" UWORD DFCDSQ_Verb 1 100 0.00 656. FORMAT "%2.0" ECU_ADDRESS 0xD000601A /end MEASUREMENT
/begin MEASUREMENT DINH_xWhy.FId_CoEngPthClsThr "" UWORD DFCDSQ_Verb 1 100 0.00 656. FORMAT "%2.0" ECU_ADDRESS 0xD000601C /end MEASUREMENT
/begin MEASUREMENT DINH_xWhy.FId_CoEngPthCylOff "" UWORD DFCDSQ_Verb 1 100 0.00 656. FORMAT "%2.0" ECU_ADDRESS 0xD000601E /end MEASUREMENT
/begin MEASUREMENT DINH_xWhy.FId_CoEngPthETZr "" UWORD DFCDSQ_Verb 1 100 0.00 656. FORMAT "%2.0" ECU_ADDRESS 0xD0006020 /end MEASUREMENT
/begin MEASUREMENT DINH_xWhy.FId_CoEngPthFlQnt "" UWORD DFCDSQ_Verb 1 100 0.00 656. FORMAT "%2.0" ECU_ADDRESS 0xD0006022 /end MEASUREMENT
/begin MEASUREMENT DINH_xWhy.FId_CoEngPthInjVlvOff "" UWORD DFCDSQ_Verb 1 100 0.00 656. FORMAT "%2.0" ECU_ADDRESS 0xD0006024 /end MEASUREMENT
/begin MEASUREMENT DINH_xWhy.FId_CoEngPthLpSysOff "" UWORD DFCDSQ_Verb 1 100 0.00 656. FORMAT "%2.0" ECU_ADDRESS 0xD0006026 /end MEASUREMENT
/begin MEASUREMENT DINH_xWhy.FId_CoEngPthRPMin "" UWORD DFCDSQ_Verb 1 100 0.00 656. FORMAT "%2.0" ECU_ADDRESS 0xD0006028 /end MEASUREMENT
/begin MEASUREMENT DINH_xWhy.FId_CoTS_SwtOff "" UWORD DFCDSQ_Verb 1 100 0.00 656. FORMAT "%2.0" ECU_ADDRESS 0xD000602A /end MEASUREMENT
/begin MEASUREMENT DINH_xWhy.FId_CoVehPrpLimErr "" UWORD DFCDSQ_Verb 1 100 0.00 656. FORMAT "%2.0" ECU_ADDRESS 0xD000602C /end MEASUREMENT
/begin MEASUREMENT DINH_xWhy.FId_ComAPP "" UWORD DFCDSQ_Verb 1 100 0.00 656. FORMAT "%2.0" ECU_ADDRESS 0xD000602E /end MEASUREMENT
/begin MEASUREMENT DINH_xWhy.FId_ComClth "" UWORD DFCDSQ_Verb 1 100 0.00 656. FORMAT "%2.0" ECU_ADDRESS 0xD0006030 /end MEASUREMENT
/begin MEASUREMENT DINH_xWhy.FId_ComCoEng "" UWORD DFCDSQ_Verb 1 100 0.00 656. FORMAT "%2.0" ECU_ADDRESS 0xD0006032 /end MEASUREMENT
/begin MEASUREMENT DINH_xWhy.FId_ComDscAck1 "" UWORD DFCDSQ_Verb 1 100 0.00 656. FORMAT "%2.0" ECU_ADDRESS 0xD0006034 /end MEASUREMENT
/begin MEASUREMENT DINH_xWhy.FId_ComDscAck2 "" UWORD DFCDSQ_Verb 1 100 0.00 656. FORMAT "%2.0" ECU_ADDRESS 0xD0006036 /end MEASUREMENT
/begin MEASUREMENT DINH_xWhy.FId_ComDscAck3 "" UWORD DFCDSQ_Verb 1 100 0.00 656. FORMAT "%2.0" ECU_ADDRESS 0xD0006038 /end MEASUREMENT
/begin MEASUREMENT DINH_xWhy.FId_ComDscTrqIntv "" UWORD DFCDSQ_Verb 1 100 0.00 656. FORMAT "%2.0" ECU_ADDRESS 0xD000603A /end MEASUREMENT
/begin MEASUREMENT DINH_xWhy.FId_ComEngDem "" UWORD DFCDSQ_Verb 1 100 0.00 656. FORMAT "%2.0" ECU_ADDRESS 0xD000603C /end MEASUREMENT
/begin MEASUREMENT DINH_xWhy.FId_ComGbxAck1 "" UWORD DFCDSQ_Verb 1 100 0.00 656. FORMAT "%2.0" ECU_ADDRESS 0xD000603E /end MEASUREMENT
/begin MEASUREMENT DINH_xWhy.FId_ComGbxAck2 "" UWORD DFCDSQ_Verb 1 100 0.00 656. FORMAT "%2.0" ECU_ADDRESS 0xD0006040 /end MEASUREMENT
/begin MEASUREMENT DINH_xWhy.FId_ComGbxAck3 "" UWORD DFCDSQ_Verb 1 100 0.00 656. FORMAT "%2.0" ECU_ADDRESS 0xD0006042 /end MEASUREMENT
/begin MEASUREMENT DINH_xWhy.FId_ComGbxTrqIntv "" UWORD DFCDSQ_Verb 1 100 0.00 656. FORMAT "%2.0" ECU_ADDRESS 0xD0006044 /end MEASUREMENT
/begin MEASUREMENT DINH_xWhy.FId_ComInjDu1 "" UWORD DFCDSQ_Verb 1 100 0.00 656. FORMAT "%2.0" ECU_ADDRESS 0xD0006046 /end MEASUREMENT
/begin MEASUREMENT DINH_xWhy.FId_ComInjDu2 "" UWORD DFCDSQ_Verb 1 100 0.00 656. FORMAT "%2.0" ECU_ADDRESS 0xD0006048 /end MEASUREMENT
/begin MEASUREMENT DINH_xWhy.FId_ComInjVlv "" UWORD DFCDSQ_Verb 1 100 0.00 656. FORMAT "%2.0" ECU_ADDRESS 0xD000604A /end MEASUREMENT
/begin MEASUREMENT DINH_xWhy.FId_ComMSA "" UWORD DFCDSQ_Verb 1 100 0.00 656. FORMAT "%2.0" ECU_ADDRESS 0xD000604C /end MEASUREMENT
/begin MEASUREMENT DINH_xWhy.FId_ComStBrkPedal "" UWORD DFCDSQ_Verb 1 100 0.00 656. FORMAT "%2.0" ECU_ADDRESS 0xD000604E /end MEASUREMENT
/begin MEASUREMENT DINH_xWhy.FId_ComStTrq "" UWORD DFCDSQ_Verb 1 100 0.00 656. FORMAT "%2.0" ECU_ADDRESS 0xD0006050 /end MEASUREMENT
/begin MEASUREMENT DINH_xWhy.FId_ComnEng "" UWORD DFCDSQ_Verb 1 100 0.00 656. FORMAT "%2.0" ECU_ADDRESS 0xD0006052 /end MEASUREMENT
/begin MEASUREMENT DINH_xWhy.FId_ComnSetPLo "" UWORD DFCDSQ_Verb 1 100 0.00 656. FORMAT "%2.0" ECU_ADDRESS 0xD0006054 /end MEASUREMENT
/begin MEASUREMENT DINH_xWhy.FId_CompEnv "" UWORD DFCDSQ_Verb 1 100 0.00 656. FORMAT "%2.0" ECU_ADDRESS 0xD0006056 /end MEASUREMENT
/begin MEASUREMENT DINH_xWhy.FId_ComrWaterVlv "" UWORD DFCDSQ_Verb 1 100 0.00 656. FORMAT "%2.0" ECU_ADDRESS 0xD0006058 /end MEASUREMENT
/begin MEASUREMENT DINH_xWhy.FId_ConvLdNTrbnCan "" UWORD DFCDSQ_Verb 1 100 0.00 656. FORMAT "%2.0" ECU_ADDRESS 0xD000605A /end MEASUREMENT
/begin MEASUREMENT DINH_xWhy.FId_ConvLdOilTemp "" UWORD DFCDSQ_Verb 1 100 0.00 656. FORMAT "%2.0" ECU_ADDRESS 0xD000605C /end MEASUREMENT
/begin MEASUREMENT DINH_xWhy.FId_ConvLdTrqLdCan "" UWORD DFCDSQ_Verb 1 100 0.00 656. FORMAT "%2.0" ECU_ADDRESS 0xD000605E /end MEASUREMENT
/begin MEASUREMENT DINH_xWhy.FId_ConvLdVel "" UWORD DFCDSQ_Verb 1 100 0.00 656. FORMAT "%2.0" ECU_ADDRESS 0xD0006060 /end MEASUREMENT
/begin MEASUREMENT DINH_xWhy.FId_CoordEGT "" UWORD DFCDSQ_Verb 1 100 0.00 656. FORMAT "%2.0" ECU_ADDRESS 0xD0006062 /end MEASUREMENT
/begin MEASUREMENT DINH_xWhy.FId_CrCtl_irrev "" UWORD DFCDSQ_Verb 1 100 0.00 656. FORMAT "%2.0" ECU_ADDRESS 0xD0006064 /end MEASUREMENT
/begin MEASUREMENT DINH_xWhy.FId_CrCtl_rev "" UWORD DFCDSQ_Verb 1 100 0.00 656. FORMAT "%2.0" ECU_ADDRESS 0xD0006066 /end MEASUREMENT
/begin MEASUREMENT DINH_xWhy.FId_CtTSwtOff "" UWORD DFCDSQ_Verb 1 100 0.00 656. FORMAT "%2.0" ECU_ADDRESS 0xD0006068 /end MEASUREMENT
/begin MEASUREMENT DINH_xWhy.FId_Cy100Dev1 "" UWORD DFCDSQ_Verb 1 100 0.00 656. FORMAT "%2.0" ECU_ADDRESS 0xD000606A /end MEASUREMENT
/begin MEASUREMENT DINH_xWhy.FId_DCSRmpShOff "" UWORD DFCDSQ_Verb 1 100 0.00 656. FORMAT "%2.0" ECU_ADDRESS 0xD000606C /end MEASUREMENT
/begin MEASUREMENT DINH_xWhy.FId_DCSShOff "" UWORD DFCDSQ_Verb 1 100 0.00 656. FORMAT "%2.0" ECU_ADDRESS 0xD000606E /end MEASUREMENT
/begin MEASUREMENT DINH_xWhy.FId_DIOnumChip1Cj945 "" UWORD DFCDSQ_Verb 1 100 0.00 656. FORMAT "%2.0" ECU_ADDRESS 0xD0006070 /end MEASUREMENT
/begin MEASUREMENT DINH_xWhy.FId_DIUMPRGenDenom1 "" UWORD DFCDSQ_Verb 1 100 0.00 656. FORMAT "%2.0" ECU_ADDRESS 0xD0006072 /end MEASUREMENT
/begin MEASUREMENT DINH_xWhy.FId_DIUMPRGenDenom2 "" UWORD DFCDSQ_Verb 1 100 0.00 656. FORMAT "%2.0" ECU_ADDRESS 0xD0006074 /end MEASUREMENT
/begin MEASUREMENT DINH_xWhy.FId_DIUMPRGenDenom3 "" UWORD DFCDSQ_Verb 1 100 0.00 656. FORMAT "%2.0" ECU_ADDRESS 0xD0006076 /end MEASUREMENT
/begin MEASUREMENT DINH_xWhy.FId_DIUMPRIgn "" UWORD DFCDSQ_Verb 1 100 0.00 656. FORMAT "%2.0" ECU_ADDRESS 0xD0006078 /end MEASUREMENT
/begin MEASUREMENT DINH_xWhy.FId_DSMWarmUpCycle "" UWORD DFCDSQ_Verb 1 100 0.00 656. FORMAT "%2.0" ECU_ADDRESS 0xD000607A /end MEASUREMENT
/begin MEASUREMENT DINH_xWhy.FId_DevLibActrPrt "" UWORD DFCDSQ_Verb 1 100 0.00 656. FORMAT "%2.0" ECU_ADDRESS 0xD000607C /end MEASUREMENT
/begin MEASUREMENT DINH_xWhy.FId_DewDetHtgDel "" UWORD DFCDSQ_Verb 1 100 0.00 656. FORMAT "%2.0" ECU_ADDRESS 0xD000607E /end MEASUREMENT
/begin MEASUREMENT DINH_xWhy.FId_ECBVlvFrzVal "" UWORD DFCDSQ_Verb 1 100 0.00 656. FORMAT "%2.0" ECU_ADDRESS 0xD0006080 /end MEASUREMENT
/begin MEASUREMENT DINH_xWhy.FId_ECBVlvReplVal "" UWORD DFCDSQ_Verb 1 100 0.00 656. FORMAT "%2.0" ECU_ADDRESS 0xD0006082 /end MEASUREMENT
/begin MEASUREMENT DINH_xWhy.FId_ECBVlvSS "" UWORD DFCDSQ_Verb 1 100 0.00 656. FORMAT "%2.0" ECU_ADDRESS 0xD0006084 /end MEASUREMENT
/begin MEASUREMENT DINH_xWhy.FId_EGRClg "" UWORD DFCDSQ_Verb 1 100 0.00 656. FORMAT "%2.0" ECU_ADDRESS 0xD0006086 /end MEASUREMENT
/begin MEASUREMENT DINH_xWhy.FId_EGRVlvActr "" UWORD DFCDSQ_Verb 1 100 0.00 656. FORMAT "%2.0" ECU_ADDRESS 0xD0006088 /end MEASUREMENT
/begin MEASUREMENT DINH_xWhy.FId_EGRVlvFrzVal "" UWORD DFCDSQ_Verb 1 100 0.00 656. FORMAT "%2.0" ECU_ADDRESS 0xD000608A /end MEASUREMENT
/begin MEASUREMENT DINH_xWhy.FId_EGRVlvGovOn "" UWORD DFCDSQ_Verb 1 100 0.00 656. FORMAT "%2.0" ECU_ADDRESS 0xD000608C /end MEASUREMENT
/begin MEASUREMENT DINH_xWhy.FId_EGRVlvOfsLrnInhib "" UWORD DFCDSQ_Verb 1 100 0.00 656. FORMAT "%2.0" ECU_ADDRESS 0xD000608E /end MEASUREMENT
/begin MEASUREMENT DINH_xWhy.FId_EGRVlvReplVal "" UWORD DFCDSQ_Verb 1 100 0.00 656. FORMAT "%2.0" ECU_ADDRESS 0xD0006090 /end MEASUREMENT
/begin MEASUREMENT DINH_xWhy.FId_EGRVlvSSpMon "" UWORD DFCDSQ_Verb 1 100 0.00 656. FORMAT "%2.0" ECU_ADDRESS 0xD0006092 /end MEASUREMENT
/begin MEASUREMENT DINH_xWhy.FId_EGTRgnLck "" UWORD DFCDSQ_Verb 1 100 0.00 656. FORMAT "%2.0" ECU_ADDRESS 0xD0006094 /end MEASUREMENT
/begin MEASUREMENT DINH_xWhy.FId_EMCtl "" UWORD DFCDSQ_Verb 1 100 0.00 656. FORMAT "%2.0" ECU_ADDRESS 0xD0006096 /end MEASUREMENT
/begin MEASUREMENT DINH_xWhy.FId_ETClbCorActv "" UWORD DFCDSQ_Verb 1 100 0.00 656. FORMAT "%2.0" ECU_ADDRESS 0xD0006098 /end MEASUREMENT
/begin MEASUREMENT DINH_xWhy.FId_ETCtlAirCtl "" UWORD DFCDSQ_Verb 1 100 0.00 656. FORMAT "%2.0" ECU_ADDRESS 0xD000609A /end MEASUREMENT
/begin MEASUREMENT DINH_xWhy.FId_ETCtlInr "" UWORD DFCDSQ_Verb 1 100 0.00 656. FORMAT "%2.0" ECU_ADDRESS 0xD000609C /end MEASUREMENT
/begin MEASUREMENT DINH_xWhy.FId_ETCtlOutr "" UWORD DFCDSQ_Verb 1 100 0.00 656. FORMAT "%2.0" ECU_ADDRESS 0xD000609E /end MEASUREMENT
/begin MEASUREMENT DINH_xWhy.FId_EngDemPFltErr "" UWORD DFCDSQ_Verb 1 100 0.00 656. FORMAT "%2.0" ECU_ADDRESS 0xD00060A0 /end MEASUREMENT
/begin MEASUREMENT DINH_xWhy.FId_EngDemTrqLimErr "" UWORD DFCDSQ_Verb 1 100 0.00 656. FORMAT "%2.0" ECU_ADDRESS 0xD00060A2 /end MEASUREMENT
/begin MEASUREMENT DINH_xWhy.FId_EngDemTrqLimErr1 "" UWORD DFCDSQ_Verb 1 100 0.00 656. FORMAT "%2.0" ECU_ADDRESS 0xD00060A4 /end MEASUREMENT
/begin MEASUREMENT DINH_xWhy.FId_EngDemTrqLimErr2 "" UWORD DFCDSQ_Verb 1 100 0.00 656. FORMAT "%2.0" ECU_ADDRESS 0xD00060A6 /end MEASUREMENT
/begin MEASUREMENT DINH_xWhy.FId_EngDemTrqLimErr3 "" UWORD DFCDSQ_Verb 1 100 0.00 656. FORMAT "%2.0" ECU_ADDRESS 0xD00060A8 /end MEASUREMENT
/begin MEASUREMENT DINH_xWhy.FId_EngDemTrqLimErr4 "" UWORD DFCDSQ_Verb 1 100 0.00 656. FORMAT "%2.0" ECU_ADDRESS 0xD00060AA /end MEASUREMENT
/begin MEASUREMENT DINH_xWhy.FId_EngPrtEnvP "" UWORD DFCDSQ_Verb 1 100 0.00 656. FORMAT "%2.0" ECU_ADDRESS 0xD00060AC /end MEASUREMENT
/begin MEASUREMENT DINH_xWhy.FId_EngPrtNLimErr "" UWORD DFCDSQ_Verb 1 100 0.00 656. FORMAT "%2.0" ECU_ADDRESS 0xD00060AE /end MEASUREMENT
/begin MEASUREMENT DINH_xWhy.FId_EnvPCANFrzVal "" UWORD DFCDSQ_Verb 1 100 0.00 656. FORMAT "%2.0" ECU_ADDRESS 0xD00060B0 /end MEASUREMENT
/begin MEASUREMENT DINH_xWhy.FId_EnvPCANRplVal "" UWORD DFCDSQ_Verb 1 100 0.00 656. FORMAT "%2.0" ECU_ADDRESS 0xD00060B2 /end MEASUREMENT
/begin MEASUREMENT DINH_xWhy.FId_EnvPFrzVal "" UWORD DFCDSQ_Verb 1 100 0.00 656. FORMAT "%2.0" ECU_ADDRESS 0xD00060B4 /end MEASUREMENT
/begin MEASUREMENT DINH_xWhy.FId_EnvPModel "" UWORD DFCDSQ_Verb 1 100 0.00 656. FORMAT "%2.0" ECU_ADDRESS 0xD00060B6 /end MEASUREMENT
/begin MEASUREMENT DINH_xWhy.FId_EnvPRplVal "" UWORD DFCDSQ_Verb 1 100 0.00 656. FORMAT "%2.0" ECU_ADDRESS 0xD00060B8 /end MEASUREMENT
/begin MEASUREMENT DINH_xWhy.FId_EnvPSS "" UWORD DFCDSQ_Verb 1 100 0.00 656. FORMAT "%2.0" ECU_ADDRESS 0xD00060BA /end MEASUREMENT
/begin MEASUREMENT DINH_xWhy.FId_EnvTCANFrzVal "" UWORD DFCDSQ_Verb 1 100 0.00 656. FORMAT "%2.0" ECU_ADDRESS 0xD00060BC /end MEASUREMENT
/begin MEASUREMENT DINH_xWhy.FId_EnvTCANRplVal "" UWORD DFCDSQ_Verb 1 100 0.00 656. FORMAT "%2.0" ECU_ADDRESS 0xD00060BE /end MEASUREMENT
/begin MEASUREMENT DINH_xWhy.FId_EnvTFrzVal "" UWORD DFCDSQ_Verb 1 100 0.00 656. FORMAT "%2.0" ECU_ADDRESS 0xD00060C0 /end MEASUREMENT
/begin MEASUREMENT DINH_xWhy.FId_EnvTModel "" UWORD DFCDSQ_Verb 1 100 0.00 656. FORMAT "%2.0" ECU_ADDRESS 0xD00060C2 /end MEASUREMENT
/begin MEASUREMENT DINH_xWhy.FId_EnvTRplVal "" UWORD DFCDSQ_Verb 1 100 0.00 656. FORMAT "%2.0" ECU_ADDRESS 0xD00060C4 /end MEASUREMENT
/begin MEASUREMENT DINH_xWhy.FId_EnvTSS "" UWORD DFCDSQ_Verb 1 100 0.00 656. FORMAT "%2.0" ECU_ADDRESS 0xD00060C6 /end MEASUREMENT
/begin MEASUREMENT DINH_xWhy.FId_EpmCaSDiag "" UWORD DFCDSQ_Verb 1 100 0.00 656. FORMAT "%2.0" ECU_ADDRESS 0xD00060C8 /end MEASUREMENT
/begin MEASUREMENT DINH_xWhy.FId_EpmCaSOfsDiag_I1 "" UWORD DFCDSQ_Verb 1 100 0.00 656. FORMAT "%2.0" ECU_ADDRESS 0xD00060CA /end MEASUREMENT
/begin MEASUREMENT DINH_xWhy.FId_EpmCaSOfsDiag_I2 "" UWORD DFCDSQ_Verb 1 100 0.00 656. FORMAT "%2.0" ECU_ADDRESS 0xD00060CC /end MEASUREMENT
/begin MEASUREMENT DINH_xWhy.FId_EpmCaSOfsDiag_O1 "" UWORD DFCDSQ_Verb 1 100 0.00 656. FORMAT "%2.0" ECU_ADDRESS 0xD00060CE /end MEASUREMENT
/begin MEASUREMENT DINH_xWhy.FId_EpmCaSOfsDiag_O2 "" UWORD DFCDSQ_Verb 1 100 0.00 656. FORMAT "%2.0" ECU_ADDRESS 0xD00060D0 /end MEASUREMENT
/begin MEASUREMENT DINH_xWhy.FId_EpmCaSOfsDiag_SglCaSI1 "" UWORD DFCDSQ_Verb 1 100 0.00 656. FORMAT "%2.0" ECU_ADDRESS 0xD00060D2 /end MEASUREMENT
/begin MEASUREMENT DINH_xWhy.FId_EpmCaSSegCor "" UWORD DFCDSQ_Verb 1 100 0.00 656. FORMAT "%2.0" ECU_ADDRESS 0xD00060D4 /end MEASUREMENT
/begin MEASUREMENT DINH_xWhy.FId_EpmCrSDiag "" UWORD DFCDSQ_Verb 1 100 0.00 656. FORMAT "%2.0" ECU_ADDRESS 0xD00060D6 /end MEASUREMENT
/begin MEASUREMENT DINH_xWhy.FId_EpmOpMode_InjLock "" UWORD DFCDSQ_Verb 1 100 0.00 656. FORMAT "%2.0" ECU_ADDRESS 0xD00060D8 /end MEASUREMENT
/begin MEASUREMENT DINH_xWhy.FId_FBC "" UWORD DFCDSQ_Verb 1 100 0.00 656. FORMAT "%2.0" ECU_ADDRESS 0xD00060DA /end MEASUREMENT
/begin MEASUREMENT DINH_xWhy.FId_FanCtl "" UWORD DFCDSQ_Verb 1 100 0.00 656. FORMAT "%2.0" ECU_ADDRESS 0xD00060DC /end MEASUREMENT
/begin MEASUREMENT DINH_xWhy.FId_FanCtlCor "" UWORD DFCDSQ_Verb 1 100 0.00 656. FORMAT "%2.0" ECU_ADDRESS 0xD00060DE /end MEASUREMENT
/begin MEASUREMENT DINH_xWhy.FId_FanCtlCor2 "" UWORD DFCDSQ_Verb 1 100 0.00 656. FORMAT "%2.0" ECU_ADDRESS 0xD00060E0 /end MEASUREMENT
/begin MEASUREMENT DINH_xWhy.FId_FanTraOil "" UWORD DFCDSQ_Verb 1 100 0.00 656. FORMAT "%2.0" ECU_ADDRESS 0xD00060E2 /end MEASUREMENT
/begin MEASUREMENT DINH_xWhy.FId_FansVelCor "" UWORD DFCDSQ_Verb 1 100 0.00 656. FORMAT "%2.0" ECU_ADDRESS 0xD00060E4 /end MEASUREMENT
/begin MEASUREMENT DINH_xWhy.FId_FlSysDens "" UWORD DFCDSQ_Verb 1 100 0.00 656. FORMAT "%2.0" ECU_ADDRESS 0xD00060E6 /end MEASUREMENT
/begin MEASUREMENT DINH_xWhy.FId_FrzPrtTrqDfftl "" UWORD DFCDSQ_Verb 1 100 0.00 656. FORMAT "%2.0" ECU_ADDRESS 0xD00060E8 /end MEASUREMENT
/begin MEASUREMENT DINH_xWhy.FId_FrzValPAirFltDs "" UWORD DFCDSQ_Verb 1 100 0.00 656. FORMAT "%2.0" ECU_ADDRESS 0xD00060EA /end MEASUREMENT
/begin MEASUREMENT DINH_xWhy.FId_FrzValPPFltUs "" UWORD DFCDSQ_Verb 1 100 0.00 656. FORMAT "%2.0" ECU_ADDRESS 0xD00060EC /end MEASUREMENT
/begin MEASUREMENT DINH_xWhy.FId_FrzValTOxiCatUs "" UWORD DFCDSQ_Verb 1 100 0.00 656. FORMAT "%2.0" ECU_ADDRESS 0xD00060EE /end MEASUREMENT
/begin MEASUREMENT DINH_xWhy.FId_FrzValTPFltUs "" UWORD DFCDSQ_Verb 1 100 0.00 656. FORMAT "%2.0" ECU_ADDRESS 0xD00060F0 /end MEASUREMENT
/begin MEASUREMENT DINH_xWhy.FId_FuelTCTS "" UWORD DFCDSQ_Verb 1 100 0.00 656. FORMAT "%2.0" ECU_ADDRESS 0xD00060F2 /end MEASUREMENT
/begin MEASUREMENT DINH_xWhy.FId_FuelTFlSys "" UWORD DFCDSQ_Verb 1 100 0.00 656. FORMAT "%2.0" ECU_ADDRESS 0xD00060F4 /end MEASUREMENT
/begin MEASUREMENT DINH_xWhy.FId_FuelTFrzVal "" UWORD DFCDSQ_Verb 1 100 0.00 656. FORMAT "%2.0" ECU_ADDRESS 0xD00060F6 /end MEASUREMENT
/begin MEASUREMENT DINH_xWhy.FId_FuelTReplVal "" UWORD DFCDSQ_Verb 1 100 0.00 656. FORMAT "%2.0" ECU_ADDRESS 0xD00060F8 /end MEASUREMENT
/begin MEASUREMENT DINH_xWhy.FId_GbxNPos "" UWORD DFCDSQ_Verb 1 100 0.00 656. FORMAT "%2.0" ECU_ADDRESS 0xD00060FA /end MEASUREMENT
/begin MEASUREMENT DINH_xWhy.FId_GbxNPosPWM "" UWORD DFCDSQ_Verb 1 100 0.00 656. FORMAT "%2.0" ECU_ADDRESS 0xD00060FC /end MEASUREMENT
/begin MEASUREMENT DINH_xWhy.FId_GlbDaLSumvXPtd "" UWORD DFCDSQ_Verb 1 100 0.00 656. FORMAT "%2.0" ECU_ADDRESS 0xD00060FE /end MEASUREMENT
/begin MEASUREMENT DINH_xWhy.FId_GlwCtl1 "" UWORD DFCDSQ_Verb 1 100 0.00 656. FORMAT "%2.0" ECU_ADDRESS 0xD0006100 /end MEASUREMENT
/begin MEASUREMENT DINH_xWhy.FId_HLSDemDfrstI "" UWORD DFCDSQ_Verb 1 100 0.00 656. FORMAT "%2.0" ECU_ADDRESS 0xD0006102 /end MEASUREMENT
/begin MEASUREMENT DINH_xWhy.FId_HLSDemSetPLoDrvAwy "" UWORD DFCDSQ_Verb 1 100 0.00 656. FORMAT "%2.0" ECU_ADDRESS 0xD0006104 /end MEASUREMENT
/begin MEASUREMENT DINH_xWhy.FId_HLSDemUndrBrk "" UWORD DFCDSQ_Verb 1 100 0.00 656. FORMAT "%2.0" ECU_ADDRESS 0xD0006106 /end MEASUREMENT
/begin MEASUREMENT DINH_xWhy.FId_ISCnTrbnMod "" UWORD DFCDSQ_Verb 1 100 0.00 656. FORMAT "%2.0" ECU_ADDRESS 0xD0006108 /end MEASUREMENT
/begin MEASUREMENT DINH_xWhy.FId_ISCvBd "" UWORD DFCDSQ_Verb 1 100 0.00 656. FORMAT "%2.0" ECU_ADDRESS 0xD000610A /end MEASUREMENT
/begin MEASUREMENT DINH_xWhy.FId_IVPSplyDCDCOff "" UWORD DFCDSQ_Verb 1 100 0.00 656. FORMAT "%2.0" ECU_ADDRESS 0xD000610C /end MEASUREMENT
/begin MEASUREMENT DINH_xWhy.FId_InhibitNever "" UWORD DFCDSQ_Verb 1 100 0.00 656. FORMAT "%2.0" ECU_ADDRESS 0xD000610E /end MEASUREMENT
/begin MEASUREMENT DINH_xWhy.FId_InjCrvCoErr "" UWORD DFCDSQ_Verb 1 100 0.00 656. FORMAT "%2.0" ECU_ADDRESS 0xD0006110 /end MEASUREMENT
/begin MEASUREMENT DINH_xWhy.FId_InjCrvDisblPoI1 "" UWORD DFCDSQ_Verb 1 100 0.00 656. FORMAT "%2.0" ECU_ADDRESS 0xD0006112 /end MEASUREMENT
/begin MEASUREMENT DINH_xWhy.FId_InjCrvDisblPoI2 "" UWORD DFCDSQ_Verb 1 100 0.00 656. FORMAT "%2.0" ECU_ADDRESS 0xD0006114 /end MEASUREMENT
/begin MEASUREMENT DINH_xWhy.FId_InjSys_qLimErr "" UWORD DFCDSQ_Verb 1 100 0.00 656. FORMAT "%2.0" ECU_ADDRESS 0xD0006116 /end MEASUREMENT
/begin MEASUREMENT DINH_xWhy.FId_InjSysqFuelT "" UWORD DFCDSQ_Verb 1 100 0.00 656. FORMAT "%2.0" ECU_ADDRESS 0xD0006118 /end MEASUREMENT
/begin MEASUREMENT DINH_xWhy.FId_InjUnStrtPlsBlk "" UWORD DFCDSQ_Verb 1 100 0.00 656. FORMAT "%2.0" ECU_ADDRESS 0xD000611A /end MEASUREMENT
/begin MEASUREMENT DINH_xWhy.FId_InjVlvPresMin "" UWORD DFCDSQ_Verb 1 100 0.00 656. FORMAT "%2.0" ECU_ADDRESS 0xD000611C /end MEASUREMENT
/begin MEASUREMENT DINH_xWhy.FId_LSUAllChecks0 "" UWORD DFCDSQ_Verb 1 100 0.00 656. FORMAT "%2.0" ECU_ADDRESS 0xD000611E /end MEASUREMENT
/begin MEASUREMENT DINH_xWhy.FId_LSUAllChecks1 "" UWORD DFCDSQ_Verb 1 100 0.00 656. FORMAT "%2.0" ECU_ADDRESS 0xD0006120 /end MEASUREMENT
/begin MEASUREMENT DINH_xWhy.FId_LSUClbSched "" UWORD DFCDSQ_Verb 1 100 0.00 656. FORMAT "%2.0" ECU_ADDRESS 0xD0006122 /end MEASUREMENT
/begin MEASUREMENT DINH_xWhy.FId_LSUCmpChk0 "" UWORD DFCDSQ_Verb 1 100 0.00 656. FORMAT "%2.0" ECU_ADDRESS 0xD0006124 /end MEASUREMENT
/begin MEASUREMENT DINH_xWhy.FId_LSUCmpChk1 "" UWORD DFCDSQ_Verb 1 100 0.00 656. FORMAT "%2.0" ECU_ADDRESS 0xD0006126 /end MEASUREMENT
/begin MEASUREMENT DINH_xWhy.FId_LSUCtl0 "" UWORD DFCDSQ_Verb 1 100 0.00 656. FORMAT "%2.0" ECU_ADDRESS 0xD0006128 /end MEASUREMENT
/begin MEASUREMENT DINH_xWhy.FId_LSUCtl1 "" UWORD DFCDSQ_Verb 1 100 0.00 656. FORMAT "%2.0" ECU_ADDRESS 0xD000612A /end MEASUREMENT
/begin MEASUREMENT DINH_xWhy.FId_LSUMon0 "" UWORD DFCDSQ_Verb 1 100 0.00 656. FORMAT "%2.0" ECU_ADDRESS 0xD000612C /end MEASUREMENT
/begin MEASUREMENT DINH_xWhy.FId_LSUMon1 "" UWORD DFCDSQ_Verb 1 100 0.00 656. FORMAT "%2.0" ECU_ADDRESS 0xD000612E /end MEASUREMENT
/begin MEASUREMENT DINH_xWhy.FId_LSUO20 "" UWORD DFCDSQ_Verb 1 100 0.00 656. FORMAT "%2.0" ECU_ADDRESS 0xD0006130 /end MEASUREMENT
/begin MEASUREMENT DINH_xWhy.FId_LSUO21 "" UWORD DFCDSQ_Verb 1 100 0.00 656. FORMAT "%2.0" ECU_ADDRESS 0xD0006132 /end MEASUREMENT
/begin MEASUREMENT DINH_xWhy.FId_LSURi0 "" UWORD DFCDSQ_Verb 1 100 0.00 656. FORMAT "%2.0" ECU_ADDRESS 0xD0006134 /end MEASUREMENT
/begin MEASUREMENT DINH_xWhy.FId_LSURi1 "" UWORD DFCDSQ_Verb 1 100 0.00 656. FORMAT "%2.0" ECU_ADDRESS 0xD0006136 /end MEASUREMENT
/begin MEASUREMENT DINH_xWhy.FId_LSUactiv0 "" UWORD DFCDSQ_Verb 1 100 0.00 656. FORMAT "%2.0" ECU_ADDRESS 0xD0006138 /end MEASUREMENT
/begin MEASUREMENT DINH_xWhy.FId_LSUactiv1 "" UWORD DFCDSQ_Verb 1 100 0.00 656. FORMAT "%2.0" ECU_ADDRESS 0xD000613A /end MEASUREMENT
/begin MEASUREMENT DINH_xWhy.FId_LSUlsu0 "" UWORD DFCDSQ_Verb 1 100 0.00 656. FORMAT "%2.0" ECU_ADDRESS 0xD000613C /end MEASUREMENT
/begin MEASUREMENT DINH_xWhy.FId_LSUlsu1 "" UWORD DFCDSQ_Verb 1 100 0.00 656. FORMAT "%2.0" ECU_ADDRESS 0xD000613E /end MEASUREMENT
/begin MEASUREMENT DINH_xWhy.FId_MeUnFrzI "" UWORD DFCDSQ_Verb 1 100 0.00 656. FORMAT "%2.0" ECU_ADDRESS 0xD0006140 /end MEASUREMENT
/begin MEASUREMENT DINH_xWhy.FId_MeUnRot "" UWORD DFCDSQ_Verb 1 100 0.00 656. FORMAT "%2.0" ECU_ADDRESS 0xD0006142 /end MEASUREMENT
/begin MEASUREMENT DINH_xWhy.FId_NplPAirFltDs "" UWORD DFCDSQ_Verb 1 100 0.00 656. FORMAT "%2.0" ECU_ADDRESS 0xD0006144 /end MEASUREMENT
/begin MEASUREMENT DINH_xWhy.FId_NplTOxiCatUs "" UWORD DFCDSQ_Verb 1 100 0.00 656. FORMAT "%2.0" ECU_ADDRESS 0xD0006146 /end MEASUREMENT
/begin MEASUREMENT DINH_xWhy.FId_NplTPFltUs "" UWORD DFCDSQ_Verb 1 100 0.00 656. FORMAT "%2.0" ECU_ADDRESS 0xD0006148 /end MEASUREMENT
/begin MEASUREMENT DINH_xWhy.FId_OilTCANFrzVal "" UWORD DFCDSQ_Verb 1 100 0.00 656. FORMAT "%2.0" ECU_ADDRESS 0xD000614A /end MEASUREMENT
/begin MEASUREMENT DINH_xWhy.FId_OilTCANRplVal "" UWORD DFCDSQ_Verb 1 100 0.00 656. FORMAT "%2.0" ECU_ADDRESS 0xD000614C /end MEASUREMENT
/begin MEASUREMENT DINH_xWhy.FId_OilTFrzVal "" UWORD DFCDSQ_Verb 1 100 0.00 656. FORMAT "%2.0" ECU_ADDRESS 0xD000614E /end MEASUREMENT
/begin MEASUREMENT DINH_xWhy.FId_OilTModel "" UWORD DFCDSQ_Verb 1 100 0.00 656. FORMAT "%2.0" ECU_ADDRESS 0xD0006150 /end MEASUREMENT
/begin MEASUREMENT DINH_xWhy.FId_OilTNpl "" UWORD DFCDSQ_Verb 1 100 0.00 656. FORMAT "%2.0" ECU_ADDRESS 0xD0006152 /end MEASUREMENT
/begin MEASUREMENT DINH_xWhy.FId_OilTRplVal "" UWORD DFCDSQ_Verb 1 100 0.00 656. FORMAT "%2.0" ECU_ADDRESS 0xD0006154 /end MEASUREMENT
/begin MEASUREMENT DINH_xWhy.FId_OilTSS "" UWORD DFCDSQ_Verb 1 100 0.00 656. FORMAT "%2.0" ECU_ADDRESS 0xD0006156 /end MEASUREMENT
/begin MEASUREMENT DINH_xWhy.FId_PAirFltDsCANFrzVal "" UWORD DFCDSQ_Verb 1 100 0.00 656. FORMAT "%2.0" ECU_ADDRESS 0xD0006158 /end MEASUREMENT
/begin MEASUREMENT DINH_xWhy.FId_PAirFltDsCANRplVal "" UWORD DFCDSQ_Verb 1 100 0.00 656. FORMAT "%2.0" ECU_ADDRESS 0xD000615A /end MEASUREMENT
/begin MEASUREMENT DINH_xWhy.FId_PCACDsCANFrzVal "" UWORD DFCDSQ_Verb 1 100 0.00 656. FORMAT "%2.0" ECU_ADDRESS 0xD000615C /end MEASUREMENT
/begin MEASUREMENT DINH_xWhy.FId_PCACDsCANRplVal "" UWORD DFCDSQ_Verb 1 100 0.00 656. FORMAT "%2.0" ECU_ADDRESS 0xD000615E /end MEASUREMENT
/begin MEASUREMENT DINH_xWhy.FId_PCACDsEnvPPls "" UWORD DFCDSQ_Verb 1 100 0.00 656. FORMAT "%2.0" ECU_ADDRESS 0xD0006160 /end MEASUREMENT
/begin MEASUREMENT DINH_xWhy.FId_PCACDsFrzVal "" UWORD DFCDSQ_Verb 1 100 0.00 656. FORMAT "%2.0" ECU_ADDRESS 0xD0006162 /end MEASUREMENT
/begin MEASUREMENT DINH_xWhy.FId_PCACDsModel "" UWORD DFCDSQ_Verb 1 100 0.00 656. FORMAT "%2.0" ECU_ADDRESS 0xD0006164 /end MEASUREMENT
/begin MEASUREMENT DINH_xWhy.FId_PCACDsRplVal "" UWORD DFCDSQ_Verb 1 100 0.00 656. FORMAT "%2.0" ECU_ADDRESS 0xD0006166 /end MEASUREMENT
/begin MEASUREMENT DINH_xWhy.FId_PCACDsSS "" UWORD DFCDSQ_Verb 1 100 0.00 656. FORMAT "%2.0" ECU_ADDRESS 0xD0006168 /end MEASUREMENT
/begin MEASUREMENT DINH_xWhy.FId_PCR "" UWORD DFCDSQ_Verb 1 100 0.00 656. FORMAT "%2.0" ECU_ADDRESS 0xD000616A /end MEASUREMENT
/begin MEASUREMENT DINH_xWhy.FId_PCRCByVlvOff "" UWORD DFCDSQ_Verb 1 100 0.00 656. FORMAT "%2.0" ECU_ADDRESS 0xD000616C /end MEASUREMENT
/begin MEASUREMENT DINH_xWhy.FId_PCRCmpntActv "" UWORD DFCDSQ_Verb 1 100 0.00 656. FORMAT "%2.0" ECU_ADDRESS 0xD000616E /end MEASUREMENT
/begin MEASUREMENT DINH_xWhy.FId_PCRCmpntActvLP "" UWORD DFCDSQ_Verb 1 100 0.00 656. FORMAT "%2.0" ECU_ADDRESS 0xD0006170 /end MEASUREMENT
/begin MEASUREMENT DINH_xWhy.FId_PCRExtnLimActr "" UWORD DFCDSQ_Verb 1 100 0.00 656. FORMAT "%2.0" ECU_ADDRESS 0xD0006172 /end MEASUREMENT
/begin MEASUREMENT DINH_xWhy.FId_PCRGovDvt "" UWORD DFCDSQ_Verb 1 100 0.00 656. FORMAT "%2.0" ECU_ADDRESS 0xD0006174 /end MEASUREMENT
/begin MEASUREMENT DINH_xWhy.FId_PCRGovDvtLP "" UWORD DFCDSQ_Verb 1 100 0.00 656. FORMAT "%2.0" ECU_ADDRESS 0xD0006176 /end MEASUREMENT
/begin MEASUREMENT DINH_xWhy.FId_PCRLP "" UWORD DFCDSQ_Verb 1 100 0.00 656. FORMAT "%2.0" ECU_ADDRESS 0xD0006178 /end MEASUREMENT
/begin MEASUREMENT DINH_xWhy.FId_PCROfsRls "" UWORD DFCDSQ_Verb 1 100 0.00 656. FORMAT "%2.0" ECU_ADDRESS 0xD000617A /end MEASUREMENT
/begin MEASUREMENT DINH_xWhy.FId_PCRPFltPresCor "" UWORD DFCDSQ_Verb 1 100 0.00 656. FORMAT "%2.0" ECU_ADDRESS 0xD000617C /end MEASUREMENT
/begin MEASUREMENT DINH_xWhy.FId_PCVFrzI "" UWORD DFCDSQ_Verb 1 100 0.00 656. FORMAT "%2.0" ECU_ADDRESS 0xD000617E /end MEASUREMENT
/begin MEASUREMENT DINH_xWhy.FId_PCVPwrStgTst "" UWORD DFCDSQ_Verb 1 100 0.00 656. FORMAT "%2.0" ECU_ADDRESS 0xD0006180 /end MEASUREMENT
/begin MEASUREMENT DINH_xWhy.FId_PFltAirSysFail "" UWORD DFCDSQ_Verb 1 100 0.00 656. FORMAT "%2.0" ECU_ADDRESS 0xD0006182 /end MEASUREMENT
/begin MEASUREMENT DINH_xWhy.FId_PFltChar "" UWORD DFCDSQ_Verb 1 100 0.00 656. FORMAT "%2.0" ECU_ADDRESS 0xD0006184 /end MEASUREMENT
/begin MEASUREMENT DINH_xWhy.FId_PFltDstr "" UWORD DFCDSQ_Verb 1 100 0.00 656. FORMAT "%2.0" ECU_ADDRESS 0xD0006186 /end MEASUREMENT
/begin MEASUREMENT DINH_xWhy.FId_PFltLckRgnErr "" UWORD DFCDSQ_Verb 1 100 0.00 656. FORMAT "%2.0" ECU_ADDRESS 0xD0006188 /end MEASUREMENT
/begin MEASUREMENT DINH_xWhy.FId_PFltLckRgnFl "" UWORD DFCDSQ_Verb 1 100 0.00 656. FORMAT "%2.0" ECU_ADDRESS 0xD000618A /end MEASUREMENT
/begin MEASUREMENT DINH_xWhy.FId_PFltLdSimRgnThr "" UWORD DFCDSQ_Verb 1 100 0.00 656. FORMAT "%2.0" ECU_ADDRESS 0xD000618C /end MEASUREMENT
/begin MEASUREMENT DINH_xWhy.FId_PFltPOpBrk "" UWORD DFCDSQ_Verb 1 100 0.00 656. FORMAT "%2.0" ECU_ADDRESS 0xD000618E /end MEASUREMENT
/begin MEASUREMENT DINH_xWhy.FId_PFltPOpClth "" UWORD DFCDSQ_Verb 1 100 0.00 656. FORMAT "%2.0" ECU_ADDRESS 0xD0006190 /end MEASUREMENT
/begin MEASUREMENT DINH_xWhy.FId_PFltPOpGearDet "" UWORD DFCDSQ_Verb 1 100 0.00 656. FORMAT "%2.0" ECU_ADDRESS 0xD0006192 /end MEASUREMENT
/begin MEASUREMENT DINH_xWhy.FId_PFltPOpSpdVeh "" UWORD DFCDSQ_Verb 1 100 0.00 656. FORMAT "%2.0" ECU_ADDRESS 0xD0006194 /end MEASUREMENT
/begin MEASUREMENT DINH_xWhy.FId_PFltPOpTempAir "" UWORD DFCDSQ_Verb 1 100 0.00 656. FORMAT "%2.0" ECU_ADDRESS 0xD0006196 /end MEASUREMENT
/begin MEASUREMENT DINH_xWhy.FId_PFltPOpTempClnt "" UWORD DFCDSQ_Verb 1 100 0.00 656. FORMAT "%2.0" ECU_ADDRESS 0xD0006198 /end MEASUREMENT
/begin MEASUREMENT DINH_xWhy.FId_PFltPOpVltgBatt "" UWORD DFCDSQ_Verb 1 100 0.00 656. FORMAT "%2.0" ECU_ADDRESS 0xD000619A /end MEASUREMENT
/begin MEASUREMENT DINH_xWhy.FId_PFltPoI1Fail "" UWORD DFCDSQ_Verb 1 100 0.00 656. FORMAT "%2.0" ECU_ADDRESS 0xD000619C /end MEASUREMENT
/begin MEASUREMENT DINH_xWhy.FId_PFltPoI2Fail "" UWORD DFCDSQ_Verb 1 100 0.00 656. FORMAT "%2.0" ECU_ADDRESS 0xD000619E /end MEASUREMENT
/begin MEASUREMENT DINH_xWhy.FId_PFltRgnChngPar "" UWORD DFCDSQ_Verb 1 100 0.00 656. FORMAT "%2.0" ECU_ADDRESS 0xD00061A0 /end MEASUREMENT
/begin MEASUREMENT DINH_xWhy.FId_PFltSimOn "" UWORD DFCDSQ_Verb 1 100 0.00 656. FORMAT "%2.0" ECU_ADDRESS 0xD00061A2 /end MEASUREMENT
/begin MEASUREMENT DINH_xWhy.FId_PFltSrvRgnRlsEng "" UWORD DFCDSQ_Verb 1 100 0.00 656. FORMAT "%2.0" ECU_ADDRESS 0xD00061A4 /end MEASUREMENT
/begin MEASUREMENT DINH_xWhy.FId_PFltSrvRgnRlsPFlt "" UWORD DFCDSQ_Verb 1 100 0.00 656. FORMAT "%2.0" ECU_ADDRESS 0xD00061A6 /end MEASUREMENT
/begin MEASUREMENT DINH_xWhy.FId_PFltSysFail "" UWORD DFCDSQ_Verb 1 100 0.00 656. FORMAT "%2.0" ECU_ADDRESS 0xD00061A8 /end MEASUREMENT
/begin MEASUREMENT DINH_xWhy.FId_PTGripDebPtd "" UWORD DFCDSQ_Verb 1 100 0.00 656. FORMAT "%2.0" ECU_ADDRESS 0xD00061AA /end MEASUREMENT
/begin MEASUREMENT DINH_xWhy.FId_PTTrqRatCANPtd "" UWORD DFCDSQ_Verb 1 100 0.00 656. FORMAT "%2.0" ECU_ADDRESS 0xD00061AC /end MEASUREMENT
/begin MEASUREMENT DINH_xWhy.FId_PresSensFrzPPFltUs "" UWORD DFCDSQ_Verb 1 100 0.00 656. FORMAT "%2.0" ECU_ADDRESS 0xD00061AE /end MEASUREMENT
/begin MEASUREMENT DINH_xWhy.FId_QWCCTSDef "" UWORD DFCDSQ_Verb 1 100 0.00 656. FORMAT "%2.0" ECU_ADDRESS 0xD00061B0 /end MEASUREMENT
/begin MEASUREMENT DINH_xWhy.FId_QWCFTSDef "" UWORD DFCDSQ_Verb 1 100 0.00 656. FORMAT "%2.0" ECU_ADDRESS 0xD00061B2 /end MEASUREMENT
/begin MEASUREMENT DINH_xWhy.FId_QWCOff "" UWORD DFCDSQ_Verb 1 100 0.00 656. FORMAT "%2.0" ECU_ADDRESS 0xD00061B4 /end MEASUREMENT
/begin MEASUREMENT DINH_xWhy.FId_RadShtCTS "" UWORD DFCDSQ_Verb 1 100 0.00 656. FORMAT "%2.0" ECU_ADDRESS 0xD00061B6 /end MEASUREMENT
/begin MEASUREMENT DINH_xWhy.FId_RadShtEGS "" UWORD DFCDSQ_Verb 1 100 0.00 656. FORMAT "%2.0" ECU_ADDRESS 0xD00061B8 /end MEASUREMENT
/begin MEASUREMENT DINH_xWhy.FId_RailCPCtlMeUnMode "" UWORD DFCDSQ_Verb 1 100 0.00 656. FORMAT "%2.0" ECU_ADDRESS 0xD00061BA /end MEASUREMENT
/begin MEASUREMENT DINH_xWhy.FId_RailCPCtlPCVMode "" UWORD DFCDSQ_Verb 1 100 0.00 656. FORMAT "%2.0" ECU_ADDRESS 0xD00061BC /end MEASUREMENT
/begin MEASUREMENT DINH_xWhy.FId_RailCtlMode "" UWORD DFCDSQ_Verb 1 100 0.00 656. FORMAT "%2.0" ECU_ADDRESS 0xD00061BE /end MEASUREMENT
/begin MEASUREMENT DINH_xWhy.FId_RailFuelTErr "" UWORD DFCDSQ_Verb 1 100 0.00 656. FORMAT "%2.0" ECU_ADDRESS 0xD00061C0 /end MEASUREMENT
/begin MEASUREMENT DINH_xWhy.FId_RailMeUn0Blk "" UWORD DFCDSQ_Verb 1 100 0.00 656. FORMAT "%2.0" ECU_ADDRESS 0xD00061C2 /end MEASUREMENT
/begin MEASUREMENT DINH_xWhy.FId_RailMeUn0Rls "" UWORD DFCDSQ_Verb 1 100 0.00 656. FORMAT "%2.0" ECU_ADDRESS 0xD00061C4 /end MEASUREMENT
/begin MEASUREMENT DINH_xWhy.FId_RailMeUn1Blk "" UWORD DFCDSQ_Verb 1 100 0.00 656. FORMAT "%2.0" ECU_ADDRESS 0xD00061C6 /end MEASUREMENT
/begin MEASUREMENT DINH_xWhy.FId_RailMeUn1Rls "" UWORD DFCDSQ_Verb 1 100 0.00 656. FORMAT "%2.0" ECU_ADDRESS 0xD00061C8 /end MEASUREMENT
/begin MEASUREMENT DINH_xWhy.FId_RailMeUn2Blk "" UWORD DFCDSQ_Verb 1 100 0.00 656. FORMAT "%2.0" ECU_ADDRESS 0xD00061CA /end MEASUREMENT
/begin MEASUREMENT DINH_xWhy.FId_RailMeUn2Rls "" UWORD DFCDSQ_Verb 1 100 0.00 656. FORMAT "%2.0" ECU_ADDRESS 0xD00061CC /end MEASUREMENT
/begin MEASUREMENT DINH_xWhy.FId_RailMeUn3Blk "" UWORD DFCDSQ_Verb 1 100 0.00 656. FORMAT "%2.0" ECU_ADDRESS 0xD00061CE /end MEASUREMENT
/begin MEASUREMENT DINH_xWhy.FId_RailMeUn3Rls "" UWORD DFCDSQ_Verb 1 100 0.00 656. FORMAT "%2.0" ECU_ADDRESS 0xD00061D0 /end MEASUREMENT
/begin MEASUREMENT DINH_xWhy.FId_RailMeUn4Blk "" UWORD DFCDSQ_Verb 1 100 0.00 656. FORMAT "%2.0" ECU_ADDRESS 0xD00061D2 /end MEASUREMENT
/begin MEASUREMENT DINH_xWhy.FId_RailMeUn4Rls "" UWORD DFCDSQ_Verb 1 100 0.00 656. FORMAT "%2.0" ECU_ADDRESS 0xD00061D4 /end MEASUREMENT
/begin MEASUREMENT DINH_xWhy.FId_RailMeUnCtlMode "" UWORD DFCDSQ_Verb 1 100 0.00 656. FORMAT "%2.0" ECU_ADDRESS 0xD00061D6 /end MEASUREMENT
/begin MEASUREMENT DINH_xWhy.FId_RailPCV0Blk "" UWORD DFCDSQ_Verb 1 100 0.00 656. FORMAT "%2.0" ECU_ADDRESS 0xD00061D8 /end MEASUREMENT
/begin MEASUREMENT DINH_xWhy.FId_RailPCV0Rls "" UWORD DFCDSQ_Verb 1 100 0.00 656. FORMAT "%2.0" ECU_ADDRESS 0xD00061DA /end MEASUREMENT
/begin MEASUREMENT DINH_xWhy.FId_RailPCV1Blk "" UWORD DFCDSQ_Verb 1 100 0.00 656. FORMAT "%2.0" ECU_ADDRESS 0xD00061DC /end MEASUREMENT
/begin MEASUREMENT DINH_xWhy.FId_RailPCV1Rls "" UWORD DFCDSQ_Verb 1 100 0.00 656. FORMAT "%2.0" ECU_ADDRESS 0xD00061DE /end MEASUREMENT
/begin MEASUREMENT DINH_xWhy.FId_RailPCV2Blk "" UWORD DFCDSQ_Verb 1 100 0.00 656. FORMAT "%2.0" ECU_ADDRESS 0xD00061E0 /end MEASUREMENT
/begin MEASUREMENT DINH_xWhy.FId_RailPCV2Rls "" UWORD DFCDSQ_Verb 1 100 0.00 656. FORMAT "%2.0" ECU_ADDRESS 0xD00061E2 /end MEASUREMENT
/begin MEASUREMENT DINH_xWhy.FId_RailPCV3Blk "" UWORD DFCDSQ_Verb 1 100 0.00 656. FORMAT "%2.0" ECU_ADDRESS 0xD00061E4 /end MEASUREMENT
/begin MEASUREMENT DINH_xWhy.FId_RailPCV3Rls "" UWORD DFCDSQ_Verb 1 100 0.00 656. FORMAT "%2.0" ECU_ADDRESS 0xD00061E6 /end MEASUREMENT
/begin MEASUREMENT DINH_xWhy.FId_RailPCV4Blk "" UWORD DFCDSQ_Verb 1 100 0.00 656. FORMAT "%2.0" ECU_ADDRESS 0xD00061E8 /end MEASUREMENT
/begin MEASUREMENT DINH_xWhy.FId_RailPCV4Rls "" UWORD DFCDSQ_Verb 1 100 0.00 656. FORMAT "%2.0" ECU_ADDRESS 0xD00061EA /end MEASUREMENT
/begin MEASUREMENT DINH_xWhy.FId_RailPCVCtlMode "" UWORD DFCDSQ_Verb 1 100 0.00 656. FORMAT "%2.0" ECU_ADDRESS 0xD00061EC /end MEASUREMENT
/begin MEASUREMENT DINH_xWhy.FId_RailPFrzVal "" UWORD DFCDSQ_Verb 1 100 0.00 656. FORMAT "%2.0" ECU_ADDRESS 0xD00061EE /end MEASUREMENT
/begin MEASUREMENT DINH_xWhy.FId_RailPMonStrt "" UWORD DFCDSQ_Verb 1 100 0.00 656. FORMAT "%2.0" ECU_ADDRESS 0xD00061F0 /end MEASUREMENT
/begin MEASUREMENT DINH_xWhy.FId_RailPSS "" UWORD DFCDSQ_Verb 1 100 0.00 656. FORMAT "%2.0" ECU_ADDRESS 0xD00061F2 /end MEASUREMENT
/begin MEASUREMENT DINH_xWhy.FId_RailPSubsVal "" UWORD DFCDSQ_Verb 1 100 0.00 656. FORMAT "%2.0" ECU_ADDRESS 0xD00061F4 /end MEASUREMENT
/begin MEASUREMENT DINH_xWhy.FId_RailSetPointLim "" UWORD DFCDSQ_Verb 1 100 0.00 656. FORMAT "%2.0" ECU_ADDRESS 0xD00061F6 /end MEASUREMENT
/begin MEASUREMENT DINH_xWhy.FId_RailSetPointRed "" UWORD DFCDSQ_Verb 1 100 0.00 656. FORMAT "%2.0" ECU_ADDRESS 0xD00061F8 /end MEASUREMENT
/begin MEASUREMENT DINH_xWhy.FId_ReplValTPFltUs "" UWORD DFCDSQ_Verb 1 100 0.00 656. FORMAT "%2.0" ECU_ADDRESS 0xD00061FA /end MEASUREMENT
/begin MEASUREMENT DINH_xWhy.FId_RplValPAirFltDs "" UWORD DFCDSQ_Verb 1 100 0.00 656. FORMAT "%2.0" ECU_ADDRESS 0xD00061FC /end MEASUREMENT
/begin MEASUREMENT DINH_xWhy.FId_RplValPPFltUs "" UWORD DFCDSQ_Verb 1 100 0.00 656. FORMAT "%2.0" ECU_ADDRESS 0xD00061FE /end MEASUREMENT
/begin MEASUREMENT DINH_xWhy.FId_RplValTOxiCatUs "" UWORD DFCDSQ_Verb 1 100 0.00 656. FORMAT "%2.0" ECU_ADDRESS 0xD0006200 /end MEASUREMENT
/begin MEASUREMENT DINH_xWhy.FId_SRCFlwRstn "" UWORD DFCDSQ_Verb 1 100 0.00 656. FORMAT "%2.0" ECU_ADDRESS 0xD0006202 /end MEASUREMENT
/begin MEASUREMENT DINH_xWhy.FId_SSEStart "" UWORD DFCDSQ_Verb 1 100 0.00 656. FORMAT "%2.0" ECU_ADDRESS 0xD0006204 /end MEASUREMENT
/begin MEASUREMENT DINH_xWhy.FId_SSEStartAST "" UWORD DFCDSQ_Verb 1 100 0.00 656. FORMAT "%2.0" ECU_ADDRESS 0xD0006206 /end MEASUREMENT
/begin MEASUREMENT DINH_xWhy.FId_SSEStartMTClPressed10 "" UWORD DFCDSQ_Verb 1 100 0.00 656. FORMAT "%2.0" ECU_ADDRESS 0xD0006208 /end MEASUREMENT
/begin MEASUREMENT DINH_xWhy.FId_SSEStartMTClPressed90 "" UWORD DFCDSQ_Verb 1 100 0.00 656. FORMAT "%2.0" ECU_ADDRESS 0xD000620A /end MEASUREMENT
/begin MEASUREMENT DINH_xWhy.FId_SSEStop "" UWORD DFCDSQ_Verb 1 100 0.00 656. FORMAT "%2.0" ECU_ADDRESS 0xD000620C /end MEASUREMENT
/begin MEASUREMENT DINH_xWhy.FId_SSEStopAST "" UWORD DFCDSQ_Verb 1 100 0.00 656. FORMAT "%2.0" ECU_ADDRESS 0xD000620E /end MEASUREMENT
/begin MEASUREMENT DINH_xWhy.FId_SSEStopMT "" UWORD DFCDSQ_Verb 1 100 0.00 656. FORMAT "%2.0" ECU_ADDRESS 0xD0006210 /end MEASUREMENT
/begin MEASUREMENT DINH_xWhy.FId_SSPAirFltDs "" UWORD DFCDSQ_Verb 1 100 0.00 656. FORMAT "%2.0" ECU_ADDRESS 0xD0006212 /end MEASUREMENT
/begin MEASUREMENT DINH_xWhy.FId_SSTOxiCatUs "" UWORD DFCDSQ_Verb 1 100 0.00 656. FORMAT "%2.0" ECU_ADDRESS 0xD0006214 /end MEASUREMENT
/begin MEASUREMENT DINH_xWhy.FId_SSTPFltUs "" UWORD DFCDSQ_Verb 1 100 0.00 656. FORMAT "%2.0" ECU_ADDRESS 0xD0006216 /end MEASUREMENT
/begin MEASUREMENT DINH_xWhy.FId_SensAdapTPFltUs "" UWORD DFCDSQ_Verb 1 100 0.00 656. FORMAT "%2.0" ECU_ADDRESS 0xD0006218 /end MEASUREMENT
/begin MEASUREMENT DINH_xWhy.FId_StAPmp "" UWORD DFCDSQ_Verb 1 100 0.00 656. FORMAT "%2.0" ECU_ADDRESS 0xD000621A /end MEASUREMENT
/begin MEASUREMENT DINH_xWhy.FId_StDa "" UWORD DFCDSQ_Verb 1 100 0.00 656. FORMAT "%2.0" ECU_ADDRESS 0xD000621C /end MEASUREMENT
/begin MEASUREMENT DINH_xWhy.FId_SubsValPrtTrqDfftl "" UWORD DFCDSQ_Verb 1 100 0.00 656. FORMAT "%2.0" ECU_ADDRESS 0xD000621E /end MEASUREMENT
/begin MEASUREMENT DINH_xWhy.FId_SubsValRatTrqDfftl "" UWORD DFCDSQ_Verb 1 100 0.00 656. FORMAT "%2.0" ECU_ADDRESS 0xD0006220 /end MEASUREMENT
/begin MEASUREMENT DINH_xWhy.FId_T15 "" UWORD DFCDSQ_Verb 1 100 0.00 656. FORMAT "%2.0" ECU_ADDRESS 0xD0006222 /end MEASUREMENT
/begin MEASUREMENT DINH_xWhy.FId_T50Sig "" UWORD DFCDSQ_Verb 1 100 0.00 656. FORMAT "%2.0" ECU_ADDRESS 0xD0006224 /end MEASUREMENT
/begin MEASUREMENT DINH_xWhy.FId_TAFSFrzVal "" UWORD DFCDSQ_Verb 1 100 0.00 656. FORMAT "%2.0" ECU_ADDRESS 0xD0006226 /end MEASUREMENT
/begin MEASUREMENT DINH_xWhy.FId_TAFSReplVal "" UWORD DFCDSQ_Verb 1 100 0.00 656. FORMAT "%2.0" ECU_ADDRESS 0xD0006228 /end MEASUREMENT
/begin MEASUREMENT DINH_xWhy.FId_TAFSSRC "" UWORD DFCDSQ_Verb 1 100 0.00 656. FORMAT "%2.0" ECU_ADDRESS 0xD000622A /end MEASUREMENT
/begin MEASUREMENT DINH_xWhy.FId_TCACDsCANFrzVal "" UWORD DFCDSQ_Verb 1 100 0.00 656. FORMAT "%2.0" ECU_ADDRESS 0xD000622C /end MEASUREMENT
/begin MEASUREMENT DINH_xWhy.FId_TCACDsCANRplVal "" UWORD DFCDSQ_Verb 1 100 0.00 656. FORMAT "%2.0" ECU_ADDRESS 0xD000622E /end MEASUREMENT
/begin MEASUREMENT DINH_xWhy.FId_TCACDsFrzVal "" UWORD DFCDSQ_Verb 1 100 0.00 656. FORMAT "%2.0" ECU_ADDRESS 0xD0006230 /end MEASUREMENT
/begin MEASUREMENT DINH_xWhy.FId_TCACDsModel "" UWORD DFCDSQ_Verb 1 100 0.00 656. FORMAT "%2.0" ECU_ADDRESS 0xD0006232 /end MEASUREMENT
/begin MEASUREMENT DINH_xWhy.FId_TCACDsRplVal "" UWORD DFCDSQ_Verb 1 100 0.00 656. FORMAT "%2.0" ECU_ADDRESS 0xD0006234 /end MEASUREMENT
/begin MEASUREMENT DINH_xWhy.FId_TCACDsSS "" UWORD DFCDSQ_Verb 1 100 0.00 656. FORMAT "%2.0" ECU_ADDRESS 0xD0006236 /end MEASUREMENT
/begin MEASUREMENT DINH_xWhy.FId_TCPrtChrgPmpCtl "" UWORD DFCDSQ_Verb 1 100 0.00 656. FORMAT "%2.0" ECU_ADDRESS 0xD0006238 /end MEASUREMENT
/begin MEASUREMENT DINH_xWhy.FId_TCPrtChrgPmpGov "" UWORD DFCDSQ_Verb 1 100 0.00 656. FORMAT "%2.0" ECU_ADDRESS 0xD000623A /end MEASUREMENT
/begin MEASUREMENT DINH_xWhy.FId_TCPrtChrgPmpHLSDem "" UWORD DFCDSQ_Verb 1 100 0.00 656. FORMAT "%2.0" ECU_ADDRESS 0xD000623C /end MEASUREMENT
/begin MEASUREMENT DINH_xWhy.FId_TCPrt_ChrgPmpDet "" UWORD DFCDSQ_Verb 1 100 0.00 656. FORMAT "%2.0" ECU_ADDRESS 0xD000623E /end MEASUREMENT
/begin MEASUREMENT DINH_xWhy.FId_TCSRmpShOff "" UWORD DFCDSQ_Verb 1 100 0.00 656. FORMAT "%2.0" ECU_ADDRESS 0xD0006240 /end MEASUREMENT
/begin MEASUREMENT DINH_xWhy.FId_TCSShOff "" UWORD DFCDSQ_Verb 1 100 0.00 656. FORMAT "%2.0" ECU_ADDRESS 0xD0006242 /end MEASUREMENT
/begin MEASUREMENT DINH_xWhy.FId_TECUFrzVal "" UWORD DFCDSQ_Verb 1 100 0.00 656. FORMAT "%2.0" ECU_ADDRESS 0xD0006244 /end MEASUREMENT
/begin MEASUREMENT DINH_xWhy.FId_TECURplVal "" UWORD DFCDSQ_Verb 1 100 0.00 656. FORMAT "%2.0" ECU_ADDRESS 0xD0006246 /end MEASUREMENT
/begin MEASUREMENT DINH_xWhy.FId_TOxiCatUs "" UWORD DFCDSQ_Verb 1 100 0.00 656. FORMAT "%2.0" ECU_ADDRESS 0xD0006248 /end MEASUREMENT
/begin MEASUREMENT DINH_xWhy.FId_TempSensFrzPPFltUs "" UWORD DFCDSQ_Verb 1 100 0.00 656. FORMAT "%2.0" ECU_ADDRESS 0xD000624A /end MEASUREMENT
/begin MEASUREMENT DINH_xWhy.FId_ThrVlvFrzVal "" UWORD DFCDSQ_Verb 1 100 0.00 656. FORMAT "%2.0" ECU_ADDRESS 0xD000624C /end MEASUREMENT
/begin MEASUREMENT DINH_xWhy.FId_ThrVlvRplVal "" UWORD DFCDSQ_Verb 1 100 0.00 656. FORMAT "%2.0" ECU_ADDRESS 0xD000624E /end MEASUREMENT
/begin MEASUREMENT DINH_xWhy.FId_ThrVlvSS "" UWORD DFCDSQ_Verb 1 100 0.00 656. FORMAT "%2.0" ECU_ADDRESS 0xD0006250 /end MEASUREMENT
/begin MEASUREMENT DINH_xWhy.FId_TraAddAirCANPtd "" UWORD DFCDSQ_Verb 1 100 0.00 656. FORMAT "%2.0" ECU_ADDRESS 0xD0006252 /end MEASUREMENT
/begin MEASUREMENT DINH_xWhy.FId_TraAddClntCANPtd "" UWORD DFCDSQ_Verb 1 100 0.00 656. FORMAT "%2.0" ECU_ADDRESS 0xD0006254 /end MEASUREMENT
/begin MEASUREMENT DINH_xWhy.FId_TraDrvAway "" UWORD DFCDSQ_Verb 1 100 0.00 656. FORMAT "%2.0" ECU_ADDRESS 0xD0006256 /end MEASUREMENT
/begin MEASUREMENT DINH_xWhy.FId_TraDrvAwayInactiv "" UWORD DFCDSQ_Verb 1 100 0.00 656. FORMAT "%2.0" ECU_ADDRESS 0xD0006258 /end MEASUREMENT
/begin MEASUREMENT DINH_xWhy.FId_TraGearInfoDet "" UWORD DFCDSQ_Verb 1 100 0.00 656. FORMAT "%2.0" ECU_ADDRESS 0xD000625A /end MEASUREMENT
/begin MEASUREMENT DINH_xWhy.FId_TraGearInfoInfoCan "" UWORD DFCDSQ_Verb 1 100 0.00 656. FORMAT "%2.0" ECU_ADDRESS 0xD000625C /end MEASUREMENT
/begin MEASUREMENT DINH_xWhy.FId_TraGearInfoLevPos "" UWORD DFCDSQ_Verb 1 100 0.00 656. FORMAT "%2.0" ECU_ADDRESS 0xD000625E /end MEASUREMENT
/begin MEASUREMENT DINH_xWhy.FId_TraGearInfoLoRng "" UWORD DFCDSQ_Verb 1 100 0.00 656. FORMAT "%2.0" ECU_ADDRESS 0xD0006260 /end MEASUREMENT
/begin MEASUREMENT DINH_xWhy.FId_TraGearInfoRTra "" UWORD DFCDSQ_Verb 1 100 0.00 656. FORMAT "%2.0" ECU_ADDRESS 0xD0006262 /end MEASUREMENT
/begin MEASUREMENT DINH_xWhy.FId_TraGearInfoRevGear "" UWORD DFCDSQ_Verb 1 100 0.00 656. FORMAT "%2.0" ECU_ADDRESS 0xD0006264 /end MEASUREMENT
/begin MEASUREMENT DINH_xWhy.FId_TraGripDeb "" UWORD DFCDSQ_Verb 1 100 0.00 656. FORMAT "%2.0" ECU_ADDRESS 0xD0006266 /end MEASUREMENT
/begin MEASUREMENT DINH_xWhy.FId_TraOilTemp "" UWORD DFCDSQ_Verb 1 100 0.00 656. FORMAT "%2.0" ECU_ADDRESS 0xD0006268 /end MEASUREMENT
/begin MEASUREMENT DINH_xWhy.FId_TraPrtGearCANPtd "" UWORD DFCDSQ_Verb 1 100 0.00 656. FORMAT "%2.0" ECU_ADDRESS 0xD000626A /end MEASUREMENT
/begin MEASUREMENT DINH_xWhy.FId_TraRtnIntfcASTIntv "" UWORD DFCDSQ_Verb 1 100 0.00 656. FORMAT "%2.0" ECU_ADDRESS 0xD000626C /end MEASUREMENT
/begin MEASUREMENT DINH_xWhy.FId_TraRtnIntfcIdlSetP "" UWORD DFCDSQ_Verb 1 100 0.00 656. FORMAT "%2.0" ECU_ADDRESS 0xD000626E /end MEASUREMENT
/begin MEASUREMENT DINH_xWhy.FId_TraTrqLimErr "" UWORD DFCDSQ_Verb 1 100 0.00 656. FORMAT "%2.0" ECU_ADDRESS 0xD0006270 /end MEASUREMENT
/begin MEASUREMENT DINH_xWhy.FId_TraTrqLos "" UWORD DFCDSQ_Verb 1 100 0.00 656. FORMAT "%2.0" ECU_ADDRESS 0xD0006272 /end MEASUREMENT
/begin MEASUREMENT DINH_xWhy.FId_TraTrqRedLmpHmeDec "" UWORD DFCDSQ_Verb 1 100 0.00 656. FORMAT "%2.0" ECU_ADDRESS 0xD0006274 /end MEASUREMENT
/begin MEASUREMENT DINH_xWhy.FId_TraTrqRedLmpHmeInc "" UWORD DFCDSQ_Verb 1 100 0.00 656. FORMAT "%2.0" ECU_ADDRESS 0xD0006276 /end MEASUREMENT
/begin MEASUREMENT DINH_xWhy.FId_TraTrqRedPlausDecIntv "" UWORD DFCDSQ_Verb 1 100 0.00 656. FORMAT "%2.0" ECU_ADDRESS 0xD0006278 /end MEASUREMENT
/begin MEASUREMENT DINH_xWhy.FId_TraTrqRedPlausIncIntv "" UWORD DFCDSQ_Verb 1 100 0.00 656. FORMAT "%2.0" ECU_ADDRESS 0xD000627A /end MEASUREMENT
/begin MEASUREMENT DINH_xWhy.FId_TrbChPWMIn "" UWORD DFCDSQ_Verb 1 100 0.00 656. FORMAT "%2.0" ECU_ADDRESS 0xD000627C /end MEASUREMENT
/begin MEASUREMENT DINH_xWhy.FId_VSwCtl "" UWORD DFCDSQ_Verb 1 100 0.00 656. FORMAT "%2.0" ECU_ADDRESS 0xD000627E /end MEASUREMENT
/begin MEASUREMENT DINH_xWhy.FId_VSwVlvFrzVal "" UWORD DFCDSQ_Verb 1 100 0.00 656. FORMAT "%2.0" ECU_ADDRESS 0xD0006280 /end MEASUREMENT
/begin MEASUREMENT DINH_xWhy.FId_VSwVlvGovOn "" UWORD DFCDSQ_Verb 1 100 0.00 656. FORMAT "%2.0" ECU_ADDRESS 0xD0006282 /end MEASUREMENT
/begin MEASUREMENT DINH_xWhy.FId_VSwVlvOfsLrnInhib "" UWORD DFCDSQ_Verb 1 100 0.00 656. FORMAT "%2.0" ECU_ADDRESS 0xD0006284 /end MEASUREMENT
/begin MEASUREMENT DINH_xWhy.FId_VSwVlvOpnLd "" UWORD DFCDSQ_Verb 1 100 0.00 656. FORMAT "%2.0" ECU_ADDRESS 0xD0006286 /end MEASUREMENT
/begin MEASUREMENT DINH_xWhy.FId_VSwVlvRplVal "" UWORD DFCDSQ_Verb 1 100 0.00 656. FORMAT "%2.0" ECU_ADDRESS 0xD0006288 /end MEASUREMENT
/begin MEASUREMENT DINH_xWhy.FId_VSwVlvSS "" UWORD DFCDSQ_Verb 1 100 0.00 656. FORMAT "%2.0" ECU_ADDRESS 0xD000628A /end MEASUREMENT
/begin MEASUREMENT DINH_xWhy.FId_VehMotvBd "" UWORD DFCDSQ_Verb 1 100 0.00 656. FORMAT "%2.0" ECU_ADDRESS 0xD000628C /end MEASUREMENT
/begin MEASUREMENT DINH_xWhy.FId_VehVCANFrzVal "" UWORD DFCDSQ_Verb 1 100 0.00 656. FORMAT "%2.0" ECU_ADDRESS 0xD000628E /end MEASUREMENT
/begin MEASUREMENT DINH_xWhy.FId_VehVCANReplVal "" UWORD DFCDSQ_Verb 1 100 0.00 656. FORMAT "%2.0" ECU_ADDRESS 0xD0006290 /end MEASUREMENT
/begin MEASUREMENT DINH_xWhy.FId_VehVFrzVal "" UWORD DFCDSQ_Verb 1 100 0.00 656. FORMAT "%2.0" ECU_ADDRESS 0xD0006292 /end MEASUREMENT
/begin MEASUREMENT DINH_xWhy.FId_VehVMon "" UWORD DFCDSQ_Verb 1 100 0.00 656. FORMAT "%2.0" ECU_ADDRESS 0xD0006294 /end MEASUREMENT
/begin MEASUREMENT DINH_xWhy.FId_VehVReplVal "" UWORD DFCDSQ_Verb 1 100 0.00 656. FORMAT "%2.0" ECU_ADDRESS 0xD0006296 /end MEASUREMENT
/begin MEASUREMENT DINH_xWhy.FId_ZFCClbActv "" UWORD DFCDSQ_Verb 1 100 0.00 656. FORMAT "%2.0" ECU_ADDRESS 0xD0006298 /end MEASUREMENT
/begin MEASUREMENT DINH_xWhy.FId_ZFCCldCmbCham "" UWORD DFCDSQ_Verb 1 100 0.00 656. FORMAT "%2.0" ECU_ADDRESS 0xD000629A /end MEASUREMENT
/begin MEASUREMENT DINH_xWhy.FId_stAVSCoESLSU "" UWORD DFCDSQ_Verb 1 100 0.00 656. FORMAT "%2.0" ECU_ADDRESS 0xD000629C /end MEASUREMENT
/begin MEASUREMENT DINH_xWhy.Fid_HLSDemHDC "" UWORD DFCDSQ_Verb 1 100 0.00 656. FORMAT "%2.0" ECU_ADDRESS 0xD000629E /end MEASUREMENT
/begin MEASUREMENT DINH_xWhy.Fid_StSysStrtTipGbxDat "" UWORD DFCDSQ_Verb 1 100 0.00 656. FORMAT "%2.0" ECU_ADDRESS 0xD00062A0 /end MEASUREMENT
/begin MEASUREMENT DINH_xWhy.Fid_WaHtShOffErr "" UWORD DFCDSQ_Verb 1 100 0.00 656. FORMAT "%2.0" ECU_ADDRESS 0xD00062A2 /end MEASUREMENT
/begin FUNCTION dinh_auto ""
 /begin DEF_CHARACTERISTIC DINH_FId.DFC_AirCtlGovDvtEOMMax_CA DINH_FId.DFC_AirCtlGovDvtEOMMin_CA DINH_FId.DFC_AirCtlGovDvtMax_CA DINH_FId.DFC_AirCtlGovDvtMin_CA DINH_FId.DFC_Cj945SpiCom1_CA DINH_FId.DFC_ComButtonMSASig_CA DINH_FId.DFC_ComButtonMSATo_CA DINH_FId.DFC_ComGearboxData2Sig_CA DINH_FId.DFC_ComGearboxData2To_CA DINH_FId.DFC_ComGearboxDataSig_CA DINH_FId.DFC_ComGearboxDataTo_CA DINH_FId.DFC_ComHeatACSig_CA DINH_FId.DFC_ComHeatACTo_CA DINH_FId.DFC_ComLenkradwinkelSig_CA DINH_FId.DFC_ComLenkradwinkelTo_CA DINH_FId.DFC_ComMileageRangeSig_CA DINH_FId.DFC_ComMileageRangeTo_CA DINH_FId.DFC_ComPspSig_CA DINH_FId.DFC_ComPspTo_CA DINH_FId.DFC_ComShutOffPSPSig_CA DINH_FId.DFC_ComShutOffPSPTo_CA DINH_FId.DFC_ComStKombiCtr_CA DINH_FId.DFC_ComStKombiSig_CA DINH_FId.DFC_ComStKombiTo_CA DINH_FId.DFC_ComStateARSCtr_CA DINH_FId.DFC_ComStateARSSig_CA DINH_FId.DFC_ComStateARSTo_CA DINH_FId.DFC_ComStateDscSig_CA DINH_FId.DFC_ComStateDscTo_CA DINH_FId.DFC_ComStateSeatSig_CA DINH_FId.DFC_ComStateSeatTo_CA DINH_FId.DFC_ComTempRelTimeSig_CA DINH_FId.DFC_ComTempRelTimeTo_CA DINH_FId.DFC_ComTerminalChk_CA DINH_FId.DFC_ComTerminalCtr_CA DINH_FId.DFC_ComTerminalSig_CA DINH_FId.DFC_ComTerminalTo_CA DINH_FId.DFC_ComTimeDateSig_CA DINH_FId.DFC_ComTimeDateTo_CA DINH_FId.DFC_ComTrailerSig_CA DINH_FId.DFC_ComTrailerTo_CA DINH_FId.DFC_ComTrqDemandAfsChk_CA DINH_FId.DFC_ComTrqDemandAfsCtr_CA DINH_FId.DFC_ComTrqDemandAfsSig_CA DINH_FId.DFC_ComTrqDemandAfsTo_CA DINH_FId.DFC_ComTrqDemandDscChk_CA DINH_FId.DFC_ComTrqDemandDscCtr_CA DINH_FId.DFC_ComTrqDemandDscSig_CA DINH_FId.DFC_ComTrqDemandDscTo_CA DINH_FId.DFC_ComTrqDemandGbxChk_CA DINH_FId.DFC_ComTrqDemandGbxCtr_CA DINH_FId.DFC_ComTrqDemandGbxSig_CA DINH_FId.DFC_ComTrqDemandGbxTo_CA DINH_FId.DFC_ComVelocitySig_CA DINH_FId.DFC_ComVelocityTo_CA DINH_FId.DFC_ComWheelSpeedSig_CA DINH_FId.DFC_ComWheelSpeedTo_CA DINH_FId.DFC_ComZvKlappenSig_CA DINH_FId.DFC_ComZvKlappenTo_CA DINH_FId.DFC_Cy150SpiCom_CA DINH_FId.DFC_Cy320SpiCom_CA DINH_FId.DFC_ETCtlDvtInrMax_CA DINH_FId.DFC_ETCtlDvtInrMin_CA DINH_FId.DFC_ETCtlDvtOutrMax_CA DINH_FId.DFC_ETCtlDvtOutrMin_CA DINH_FId.DFC_Fan4WinErr1_CA DINH_FId.DFC_Fan4WinErr2_CA DINH_FId.DFC_Fan4WinErr3_CA DINH_FId.DFC_Fan4WinErr4_CA DINH_FId.DFC_FanSCG_CA DINH_FId.DFC_PCRGovDvtLPMax_CA DINH_FId.DFC_PCRGovDvtLPMin_CA DINH_FId.DFC_PCRGovDvtMax_CA DINH_FId.DFC_PCRGovDvtMin_CA DINH_FId.DFC_RailCPC1_CA DINH_FId.DFC_RailCPC3_CA DINH_FId.DFC_RailCPC4_CA DINH_FId.DFC_RailMeUn0_CA DINH_FId.DFC_RailMeUn1_CA DINH_FId.DFC_RailMeUn2_CA DINH_FId.DFC_RailMeUn3_CA DINH_FId.DFC_RailMeUn4_CA DINH_FId.DFC_RailPCV0_CA DINH_FId.DFC_RailPCV1_CA DINH_FId.DFC_RailPCV2_CA DINH_FId.DFC_RailPCV3_CA DINH_FId.DFC_RailPCV4_CA DINH_FId.DFC_RailPMonStrt_CA DINH_FId.DFC_SSpMon1_CA DINH_FId.DFC_SSpMon2_CA DINH_FId.DFC_SSpMon3_CA DINH_FId.DFC_Sia_E1_CA DINH_FId.DFC_Sia_E10_CA DINH_FId.DFC_Sia_E11_CA DINH_FId.DFC_Sia_E12_CA DINH_FId.DFC_Sia_E13_CA DINH_FId.DFC_Sia_E14_CA DINH_FId.DFC_Sia_E15_CA DINH_FId.DFC_Sia_E2_CA DINH_FId.DFC_Sia_E3_CA DINH_FId.DFC_Sia_E4_CA DINH_FId.DFC_Sia_E5_CA DINH_FId.DFC_Sia_E6_CA DINH_FId.DFC_Sia_E7_CA DINH_FId.DFC_Sia_E8_CA DINH_FId.DFC_Sia_E9_CA DINH_FId.DFC_ThrVlv4WinErr1_CA DINH_FId.DFC_ThrVlv4WinErr2_CA DINH_FId.DFC_ThrVlv4WinErr3_CA DINH_FId.DFC_ThrVlv4WinErr4_CA DINH_FId.DFC_ThrVlvSCG_CA DINH_FId.DFC_TrbCh4WinErr1_CA DINH_FId.DFC_TrbCh4WinErr2_CA DINH_FId.DFC_TrbCh4WinErr3_CA DINH_FId.DFC_TrbCh4WinErr4_CA DINH_FId.DFC_TrbChSCG_CA DINH_FId.DFC_TrbChSRCMax_CA DINH_FId.DFC_TrbChSRCMin_CA DINH_FId.DFC_WaHtEl4WinErr1_CA DINH_FId.DFC_WaHtEl4WinErr2_CA DINH_FId.DFC_WaHtEl4WinErr3_CA DINH_FId.DFC_WaHtEl4WinErr4_CA DINH_FId.DFC_WaHtElSCG_CA DINH_FId.DFC_ETClbETFltMax_CA DINH_FId.DFC_ETClbETFltMin_CA DINH_FId.DFC_InjCrvInjLimChrgBal_CA DINH_FId.DFC_InjCrvInjLimQntBal_CA DINH_FId.DFC_InjCrvInjLimSys_CA DINH_FId.DFC_InjCrvNumInjRtmLim_CA DINH_FId.DFC_LSUHtCoupSig_0_CA DINH_FId.DFC_LSUHtCoupSig_1_CA DINH_FId.DFC_LSUHtCoupSig_2_CA DINH_FId.DFC_LSUHtCoupSig_3_CA DINH_FId.DFC_CtT_CA DINH_FId.DFC_DSMDummy_CA DINH_FId.DFC_MeUnOL_CA DINH_FId.DFC_MeUnSCB_CA DINH_FId.DFC_MeUnSRCMax_CA DINH_FId.DFC_MeUnSRCMin_CA DINH_FId.DFC_PCVOL_CA DINH_FId.DFC_PCVSCB_CA DINH_FId.DFC_PCVSRCMax_CA DINH_FId.DFC_PCVSRCMin_CA DINH_FId.DFC_RailPSRCMax_CA DINH_FId.DFC_RailPSRCMin_CA DINH_FId.DFC_IVActrVltgSRCMax_CA DINH_FId.DFC_IVActrVltgSRCMin_CA DINH_FId.DFC_IVPSplyDCDC_CA DINH_FId.DFC_IVPSplyVltgSRCMax_CA DINH_FId.DFC_IVPSplyVltgSRCMin_CA DINH_FId.DFC_AFSOffsDrftMax_CA DINH_FId.DFC_AFSOffsDrftMin_CA DINH_FId.DFC_AFSSRCCorMax_CA DINH_FId.DFC_AFSSRCCorMin_CA DINH_FId.DFC_AFSSRCRawMax_CA DINH_FId.DFC_AFSSRCRawMin_CA DINH_FId.DFC_AFSSetyDrftMax_CA DINH_FId.DFC_AFSSetyDrftMin_CA DINH_FId.DFC_AirCClntPAnaSRCMax_CA DINH_FId.DFC_AirCClntPAnaSRCMin_CA DINH_FId.DFC_AirCClntPPerSRCMax_CA DINH_FId.DFC_AirCClntPPerSRCMin_CA DINH_FId.DFC_AirCClntPdcycSRCMax_CA DINH_FId.DFC_AirCClntPdcycSRCMin_CA DINH_FId.DFC_AirCCmprOL_CA DINH_FId.DFC_AirCCmprRedTrqOL_CA DINH_FId.DFC_AirCCmprRedTrqSCB_CA DINH_FId.DFC_AirCCmprRedTrqSCG_CA DINH_FId.DFC_AirCCmprSCB_CA DINH_FId.DFC_AirCCmprSCG_CA DINH_FId.DFC_AirCSwtNpl_CA DINH_FId.DFC_AirCSwtSig_CA DINH_FId.DFC_BattUSRCMax_CA DINH_FId.DFC_BattUSRCMin_CA DINH_FId.DFC_BrkNpl_CA DINH_FId.DFC_BrkPSRCMax_CA DINH_FId.DFC_BrkPSRCMin_CA DINH_FId.DFC_BrkSig_CA DINH_FId.DFC_CByVlvOL_CA DINH_FId.DFC_CByVlvSCB_CA DINH_FId.DFC_CByVlvSCG_CA DINH_FId.DFC_CEngDsTSRCMax_CA DINH_FId.DFC_CEngDsTSRCMin_CA DINH_FId.DFC_CEngDsTSig_CA DINH_FId.DFC_CEngUsTSRCMax_CA DINH_FId.DFC_CEngUsTSRCMin_CA DINH_FId.DFC_CThmstOL_CA DINH_FId.DFC_CThmstSCB_CA DINH_FId.DFC_CThmstSCG_CA DINH_FId.DFC_ClthSig_CA DINH_FId.DFC_ECBVlvOL_CA DINH_FId.DFC_ECBVlvSCB_CA DINH_FId.DFC_ECBVlvSCG_CA DINH_FId.DFC_ECBVlvSRCMax_CA DINH_FId.DFC_ECBVlvSRCMin_CA DINH_FId.DFC_EGRVlvGovDvtMax_CA DINH_FId.DFC_EGRVlvGovDvtMin_CA DINH_FId.DFC_EGRVlvOL_CA DINH_FId.DFC_EGRVlvSCB_CA DINH_FId.DFC_EGRVlvSCG_CA DINH_FId.DFC_EGRVlvSRCMax_CA DINH_FId.DFC_EGRVlvSRCMin_CA DINH_FId.DFC_EMDmpOL_0_CA DINH_FId.DFC_EMDmpOL_1_CA DINH_FId.DFC_EMDmpSCB_0_CA DINH_FId.DFC_EMDmpSCB_1_CA DINH_FId.DFC_EMDmpSCG_0_CA DINH_FId.DFC_EMDmpSCG_1_CA DINH_FId.DFC_EngStAOL_CA DINH_FId.DFC_EngStASCB_CA DINH_FId.DFC_EngStASCG_CA DINH_FId.DFC_EnvPSRCMax_CA DINH_FId.DFC_EnvPSRCMin_CA DINH_FId.DFC_EnvPSig_CA DINH_FId.DFC_EnvTSRCMax_CA DINH_FId.DFC_EnvTSRCMin_CA DINH_FId.DFC_FanOL_CA DINH_FId.DFC_FanSCB_CA DINH_FId.DFC_FlFltSig_CA DINH_FId.DFC_FuelTSRCMax_CA DINH_FId.DFC_FuelTSRCMin_CA DINH_FId.DFC_GbxNPosPPerSRCMax_CA DINH_FId.DFC_GbxNPosPPerSRCMin_CA DINH_FId.DFC_GbxNPosPdcycSRCMax_CA DINH_FId.DFC_GbxNPosPdcycSRCMin_CA DINH_FId.DFC_GbxNPosSig_CA DINH_FId.DFC_GlwPlgBSDOL_0_CA DINH_FId.DFC_GlwPlgBSDOL_1_CA DINH_FId.DFC_GlwPlgBSDOL_2_CA DINH_FId.DFC_GlwPlgBSDOL_3_CA DINH_FId.DFC_GlwPlgBSDOL_4_CA DINH_FId.DFC_GlwPlgBSDOL_5_CA DINH_FId.DFC_GlwPlgBSDOL_6_CA DINH_FId.DFC_GlwPlgBSDOL_7_CA DINH_FId.DFC_GlwPlgBSDOT_0_CA DINH_FId.DFC_GlwPlgBSDOT_1_CA DINH_FId.DFC_GlwPlgBSDOT_2_CA DINH_FId.DFC_GlwPlgBSDOT_3_CA DINH_FId.DFC_GlwPlgBSDOT_4_CA DINH_FId.DFC_GlwPlgBSDOT_5_CA DINH_FId.DFC_GlwPlgBSDOT_6_CA DINH_FId.DFC_GlwPlgBSDOT_7_CA DINH_FId.DFC_GlwPlgBSDSC_0_CA DINH_FId.DFC_GlwPlgBSDSC_1_CA DINH_FId.DFC_GlwPlgBSDSC_2_CA DINH_FId.DFC_GlwPlgBSDSC_3_CA DINH_FId.DFC_GlwPlgBSDSC_4_CA DINH_FId.DFC_GlwPlgBSDSC_5_CA DINH_FId.DFC_GlwPlgBSDSC_6_CA DINH_FId.DFC_GlwPlgBSDSC_7_CA DINH_FId.DFC_GlwPlgComErr_CA DINH_FId.DFC_InjVlvPresMin_CA DINH_FId.DFC_LSUCircNernstMax_0_CA DINH_FId.DFC_LSUCircNernstMax_1_CA DINH_FId.DFC_LSUCircNernstMax_2_CA DINH_FId.DFC_LSUCircNernstMax_3_CA DINH_FId.DFC_LSUCircNernstMin_0_CA DINH_FId.DFC_LSUCircNernstMin_1_CA DINH_FId.DFC_LSUCircNernstMin_2_CA DINH_FId.DFC_LSUCircNernstMin_3_CA DINH_FId.DFC_LSUCircNernstSig_0_CA DINH_FId.DFC_LSUCircNernstSig_1_CA DINH_FId.DFC_LSUCircNernstSig_2_CA DINH_FId.DFC_LSUCircNernstSig_3_CA DINH_FId.DFC_LSUCircPmpCurMax_0_CA DINH_FId.DFC_LSUCircPmpCurMax_1_CA DINH_FId.DFC_LSUCircPmpCurMax_2_CA DINH_FId.DFC_LSUCircPmpCurMax_3_CA DINH_FId.DFC_LSUCircPmpCurMin_0_CA DINH_FId.DFC_LSUCircPmpCurMin_1_CA DINH_FId.DFC_LSUCircPmpCurMin_2_CA DINH_FId.DFC_LSUCircPmpCurMin_3_CA DINH_FId.DFC_LSUCircPmpCurSig_0_CA DINH_FId.DFC_LSUCircPmpCurSig_1_CA DINH_FId.DFC_LSUCircPmpCurSig_2_CA DINH_FId.DFC_LSUCircPmpCurSig_3_CA DINH_FId.DFC_LSUCircVirtGndMax_0_CA DINH_FId.DFC_LSUCircVirtGndMax_1_CA DINH_FId.DFC_LSUCircVirtGndMax_2_CA DINH_FId.DFC_LSUCircVirtGndMax_3_CA DINH_FId.DFC_LSUCircVirtGndMin_0_CA DINH_FId.DFC_LSUCircVirtGndMin_1_CA DINH_FId.DFC_LSUCircVirtGndMin_2_CA DINH_FId.DFC_LSUCircVirtGndMin_3_CA DINH_FId.DFC_LSUCircVirtGndSig_0_CA DINH_FId.DFC_LSUCircVirtGndSig_1_CA DINH_FId.DFC_LSUCircVirtGndSig_2_CA DINH_FId.DFC_LSUCircVirtGndSig_3_CA DINH_FId.DFC_LSUHtrMax_0_CA DINH_FId.DFC_LSUHtrMax_1_CA DINH_FId.DFC_LSUHtrMax_2_CA DINH_FId.DFC_LSUHtrMax_3_CA DINH_FId.DFC_LSUHtrMin_0_CA DINH_FId.DFC_LSUHtrMin_1_CA DINH_FId.DFC_LSUHtrMin_2_CA DINH_FId.DFC_LSUHtrMin_3_CA DINH_FId.DFC_LSUHtrSig_0_CA DINH_FId.DFC_LSUHtrSig_1_CA DINH_FId.DFC_LSUHtrSig_2_CA DINH_FId.DFC_LSUHtrSig_3_CA DINH_FId.DFC_LSUO2Max_0_CA DINH_FId.DFC_LSUO2Max_1_CA DINH_FId.DFC_LSUO2Max_2_CA DINH_FId.DFC_LSUO2Max_3_CA DINH_FId.DFC_LSUO2Min_0_CA DINH_FId.DFC_LSUO2Min_1_CA DINH_FId.DFC_LSUO2Min_2_CA DINH_FId.DFC_LSUO2Min_3_CA DINH_FId.DFC_LSUSPIBattLowMin_0_CA DINH_FId.DFC_LSUSPIBattLowMin_1_CA DINH_FId.DFC_LSUSPIBattLowMin_2_CA DINH_FId.DFC_LSUSPIBattLowMin_3_CA DINH_FId.DFC_LSUSPISig_0_CA DINH_FId.DFC_LSUSPISig_1_CA DINH_FId.DFC_LSUSPISig_2_CA DINH_FId.DFC_LSUSPISig_3_CA DINH_FId.DFC_LSUtExcMax_0_CA DINH_FId.DFC_LSUtExcMax_1_CA DINH_FId.DFC_LSUtExcMax_2_CA DINH_FId.DFC_LSUtExcMax_3_CA DINH_FId.DFC_LSUtExcMin_0_CA DINH_FId.DFC_LSUtExcMin_1_CA DINH_FId.DFC_LSUtExcMin_2_CA DINH_FId.DFC_LSUtExcMin_3_CA DINH_FId.DFC_MILOL_CA DINH_FId.DFC_MILSCB_CA DINH_FId.DFC_MILSCG_CA DINH_FId.DFC_MeUnSCG_CA DINH_FId.DFC_NplHsChngPPFltDiff_CA DINH_FId.DFC_NplPAirFltDs_CA DINH_FId.DFC_NplTPFltUs_CA DINH_FId.DFC_OilComErr_CA DINH_FId.DFC_OilPLmpOL_CA DINH_FId.DFC_OilPLmpSCB_CA DINH_FId.DFC_OilPLmpSCG_CA DINH_FId.DFC_OilPNpl_CA DINH_FId.DFC_OilTNpl_CA DINH_FId.DFC_OilTSRCMax_CA DINH_FId.DFC_OilTSRCMin_CA DINH_FId.DFC_PCACDsEnvPPls_CA DINH_FId.DFC_PCACDsSRCMax_CA DINH_FId.DFC_PCACDsSRCMin_CA DINH_FId.DFC_PCVSCG_CA DINH_FId.DFC_PFltCharPDiffMin_CA DINH_FId.DFC_PFltDstrMin_CA DINH_FId.DFC_PFltEngPrt_CA DINH_FId.DFC_PFltLmpOL_CA DINH_FId.DFC_PFltLmpSCB_CA DINH_FId.DFC_PFltLmpSCG_CA DINH_FId.DFC_PFltRgnPerm_CA DINH_FId.DFC_PFltSRCMaxFlwRstn_CA DINH_FId.DFC_PFltSRCMinFlwRstn_CA DINH_FId.DFC_PFltSotMsDvtMax_CA DINH_FId.DFC_PFltSotMsDvtMin_CA DINH_FId.DFC_PFltSotMsMax_CA DINH_FId.DFC_PSPOL_CA DINH_FId.DFC_PSPSCB_CA DINH_FId.DFC_PSPSCG_CA DINH_FId.DFC_SRCHighAPP1_CA DINH_FId.DFC_SRCHighAPP2_CA DINH_FId.DFC_SRCLowAPP1_CA DINH_FId.DFC_SRCLowAPP2_CA DINH_FId.DFC_SRCMaxPAirFltDs_CA DINH_FId.DFC_SRCMaxPPFltUs_CA DINH_FId.DFC_SRCMaxTECU_CA DINH_FId.DFC_SRCMaxTOxiCatUs_CA DINH_FId.DFC_SRCMaxTPFltUs_CA DINH_FId.DFC_SRCMinPAirFltDs_CA DINH_FId.DFC_SRCMinPPFltUs_CA DINH_FId.DFC_SRCMinTECU_CA DINH_FId.DFC_SRCMinTOxiCatUs_CA DINH_FId.DFC_SRCMinTPFltUs_CA DINH_FId.DFC_SVSOL_CA DINH_FId.DFC_SVSSCB_CA DINH_FId.DFC_SVSSCG_CA DINH_FId.DFC_StrtOL_CA DINH_FId.DFC_StrtSCB_CA DINH_FId.DFC_StrtSCG_CA DINH_FId.DFC_SyncAPP_CA DINH_FId.DFC_T15Npl_CA DINH_FId.DFC_TAFSDtyCycHi_CA DINH_FId.DFC_TAFSDtyCycLo_CA DINH_FId.DFC_TAFSPerHi_CA DINH_FId.DFC_TAFSPerLo_CA DINH_FId.DFC_TCACDsSRCMax_CA DINH_FId.DFC_TCACDsSRCMin_CA DINH_FId.DFC_ThrVlvOL_CA DINH_FId.DFC_ThrVlvSCB_CA DINH_FId.DFC_ThrVlvSRCMax_CA DINH_FId.DFC_ThrVlvSRCMin_CA DINH_FId.DFC_TrbChLPOL_CA DINH_FId.DFC_TrbChLPSCB_CA DINH_FId.DFC_TrbChLPSCG_CA DINH_FId.DFC_TrbChOL_CA DINH_FId.DFC_TrbChSCB_CA DINH_FId.DFC_VSwVlvGovDvtMax_CA DINH_FId.DFC_VSwVlvGovDvtMin_CA DINH_FId.DFC_VSwVlvOL_CA DINH_FId.DFC_VSwVlvSCB_CA DINH_FId.DFC_VSwVlvSCG_CA DINH_FId.DFC_VSwVlvSRCMax_CA DINH_FId.DFC_VSwVlvSRCMin_CA DINH_FId.DFC_VehVHW_CA DINH_FId.DFC_VehVMax_CA DINH_FId.DFC_VehVPlaus_CA DINH_FId.DFC_VehVSig_CA DINH_FId.DFC_WaHtElOL_CA DINH_FId.DFC_WaHtElSCB_CA DINH_FId.DFC_ClthNpl_CA DINH_FId.DFC_ETClbETMax_0_CA DINH_FId.DFC_ETClbETMax_1_CA DINH_FId.DFC_ETClbETMax_2_CA DINH_FId.DFC_ETClbETMax_3_CA DINH_FId.DFC_ETClbETMax_4_CA DINH_FId.DFC_ETClbETMax_5_CA DINH_FId.DFC_ETClbETMin_0_CA DINH_FId.DFC_ETClbETMin_1_CA DINH_FId.DFC_ETClbETMin_2_CA DINH_FId.DFC_ETClbETMin_3_CA DINH_FId.DFC_ETClbETMin_4_CA DINH_FId.DFC_ETClbETMin_5_CA DINH_FId.DFC_IVDiaBnkShCirBSH_0_CA DINH_FId.DFC_IVDiaBnkShCirBSH_1_CA DINH_FId.DFC_IVDiaBnkShCirChSwt_0_CA DINH_FId.DFC_IVDiaBnkShCirChSwt_1_CA DINH_FId.DFC_IVDiaBnkShCirHSBatt_0_CA DINH_FId.DFC_IVDiaBnkShCirHSBatt_1_CA DINH_FId.DFC_IVDiaBnkShCirHiRstnc_0_CA DINH_FId.DFC_IVDiaBnkShCirHiRstnc_1_CA DINH_FId.DFC_IVDiaBnkShCirLSHSGnd_0_CA DINH_FId.DFC_IVDiaBnkShCirLSHSGnd_1_CA DINH_FId.DFC_IVDiaBnkShCirTransfer_0_CA DINH_FId.DFC_IVDiaBnkShCirTransfer_1_CA DINH_FId.DFC_IVDiaCylNoCls_0_CA DINH_FId.DFC_IVDiaCylNoCls_1_CA DINH_FId.DFC_IVDiaCylNoCls_2_CA DINH_FId.DFC_IVDiaCylNoCls_3_CA DINH_FId.DFC_IVDiaCylNoCls_4_CA DINH_FId.DFC_IVDiaCylNoCls_5_CA DINH_FId.DFC_IVDiaCylNoLd_0_CA DINH_FId.DFC_IVDiaCylNoLd_1_CA DINH_FId.DFC_IVDiaCylNoLd_2_CA DINH_FId.DFC_IVDiaCylNoLd_3_CA DINH_FId.DFC_IVDiaCylNoLd_4_CA DINH_FId.DFC_IVDiaCylNoLd_5_CA DINH_FId.DFC_IVDiaCylShCirHiRstnc_0_CA DINH_FId.DFC_IVDiaCylShCirHiRstnc_1_CA DINH_FId.DFC_IVDiaCylShCirHiRstnc_2_CA DINH_FId.DFC_IVDiaCylShCirHiRstnc_3_CA DINH_FId.DFC_IVDiaCylShCirHiRstnc_4_CA DINH_FId.DFC_IVDiaCylShCirHiRstnc_5_CA DINH_FId.DFC_IVDiaCylShCirLSBatt_0_CA DINH_FId.DFC_IVDiaCylShCirLSBatt_1_CA DINH_FId.DFC_IVDiaCylShCirLSBatt_2_CA DINH_FId.DFC_IVDiaCylShCirLSBatt_3_CA DINH_FId.DFC_IVDiaCylShCirLSBatt_4_CA DINH_FId.DFC_IVDiaCylShCirLSBatt_5_CA DINH_FId.DFC_IVDiaCylShCirLSHS_0_CA DINH_FId.DFC_IVDiaCylShCirLSHS_1_CA DINH_FId.DFC_IVDiaCylShCirLSHS_2_CA DINH_FId.DFC_IVDiaCylShCirLSHS_3_CA DINH_FId.DFC_IVDiaCylShCirLSHS_4_CA DINH_FId.DFC_IVDiaCylShCirLSHS_5_CA DINH_FId.DFC_IVDiaCylShCirLsLs_0_CA DINH_FId.DFC_IVDiaCylShCirLsLs_1_CA DINH_FId.DFC_IVDiaCylShCirLsLs_2_CA DINH_FId.DFC_IVDiaCylShCirLsLs_3_CA DINH_FId.DFC_IVDiaCylShCirLsLs_4_CA DINH_FId.DFC_IVDiaCylShCirLsLs_5_CA DINH_FId.DFC_IVDiaSPICfg_CA DINH_FId.DFC_IVDiaSPIColl_CA DINH_FId.DFC_IVDiaSPICtrl_CA DINH_FId.DFC_IVDiaSPIRam_CA DINH_FId.DFC_IVDiaSPITrans_CA DINH_FId.DFC_LSUCmpChk_0_CA DINH_FId.DFC_LSUCmpChk_1_CA DINH_FId.DFC_LSUCmpChk_2_CA DINH_FId.DFC_LSUCmpChk_3_CA DINH_FId.DFC_LSUCmpChk_4_CA DINH_FId.DFC_LSUCmpChk_5_CA DINH_FId.DFC_LSUDynChk_0_CA DINH_FId.DFC_LSUDynChk_1_CA DINH_FId.DFC_LSUDynChk_2_CA DINH_FId.DFC_LSUDynChk_3_CA DINH_FId.DFC_LSUO2ClbMax_0_CA DINH_FId.DFC_LSUO2ClbMax_1_CA DINH_FId.DFC_LSUO2ClbMax_2_CA DINH_FId.DFC_LSUO2ClbMax_3_CA DINH_FId.DFC_LSUO2ClbMin_0_CA DINH_FId.DFC_LSUO2ClbMin_1_CA DINH_FId.DFC_LSUO2ClbMin_2_CA DINH_FId.DFC_LSUO2ClbMin_3_CA DINH_FId.DFC_LSUO2PlausMax_0_CA DINH_FId.DFC_LSUO2PlausMax_1_CA DINH_FId.DFC_LSUO2PlausMax_2_CA DINH_FId.DFC_LSUO2PlausMax_3_CA DINH_FId.DFC_LSUO2PlausMin_0_CA DINH_FId.DFC_LSUO2PlausMin_1_CA DINH_FId.DFC_LSUO2PlausMin_2_CA DINH_FId.DFC_LSUO2PlausMin_3_CA DINH_FId.DFC_LSURiClbMax_0_CA DINH_FId.DFC_LSURiClbMax_1_CA DINH_FId.DFC_LSURiClbMax_2_CA DINH_FId.DFC_LSURiClbMax_3_CA DINH_FId.DFC_LSURiClbMin_0_CA DINH_FId.DFC_LSURiClbMin_1_CA DINH_FId.DFC_LSURiClbMin_2_CA DINH_FId.DFC_LSURiClbMin_3_CA DINH_FId.DFC_LSUWireIPSig_0_CA DINH_FId.DFC_LSUWireIPSig_1_CA DINH_FId.DFC_LSUWireIPSig_2_CA DINH_FId.DFC_LSUWireIPSig_3_CA DINH_FId.DFC_AFSDrftIdlAdjVal_CA DINH_FId.DFC_AFSDrftLdAdjVal_CA DINH_FId.DFC_AdcI_ADC0_Cal_CA DINH_FId.DFC_AdcI_ADC0_Conv_CA DINH_FId.DFC_CmbChbMisfireMax_0_CA DINH_FId.DFC_CmbChbMisfireMax_1_CA DINH_FId.DFC_CmbChbMisfireMax_2_CA DINH_FId.DFC_CmbChbMisfireMax_3_CA DINH_FId.DFC_CmbChbMisfireMax_4_CA DINH_FId.DFC_CmbChbMisfireMax_5_CA DINH_FId.DFC_CmbChbMisfireMul_CA DINH_FId.DFC_INJVLVBUSY_CA DINH_FId.DFC_IVAdjIVA_0_CA DINH_FId.DFC_IVAdjIVA_1_CA DINH_FId.DFC_IVAdjIVA_2_CA DINH_FId.DFC_IVAdjIVA_3_CA /end DEF_CHARACTERISTIC
 /begin OUT_MEASUREMENT DINH_xWhy.FId_Unused DINH_xWhy.FId_InhibitAlways DINH_xWhy.FId_CoordALS DINH_xWhy.FId_CoordFBC DINH_xWhy.FId_CoordTAA DINH_xWhy.FId_CoordZFC DINH_xWhy.FId_ACCtlTEngErr DINH_xWhy.FId_ACCtlTGearbxErr DINH_xWhy.FId_ACCtlVehVErr DINH_xWhy.FId_ACCtl_AC DINH_xWhy.FId_ACCtl_Fan DINH_xWhy.FId_AC_pAC DINH_xWhy.FId_AFS DINH_xWhy.FId_AFSActrTst DINH_xWhy.FId_AFSDrftMaxLim DINH_xWhy.FId_AFSFrzAirMs DINH_xWhy.FId_AFSPlOffsDrft DINH_xWhy.FId_AFSPlSetyDrft DINH_xWhy.FId_AFSSRC DINH_xWhy.FId_AFSSysErr DINH_xWhy.FId_AFSTPer DINH_xWhy.FId_APP1FinalDef DINH_xWhy.FId_APP1ProvDef DINH_xWhy.FId_APP1SRCHigh DINH_xWhy.FId_APP1SigPath DINH_xWhy.FId_APP2FinalDef DINH_xWhy.FId_APP2ProvDef DINH_xWhy.FId_APP2SRCHigh DINH_xWhy.FId_APP2SigPath DINH_xWhy.FId_APPBrkDef DINH_xWhy.FId_APPBrkPres DINH_xWhy.FId_APPNTP DINH_xWhy.FId_APPSyncChk DINH_xWhy.FId_APPSyncDef DINH_xWhy.FId_APPSyncProvDef DINH_xWhy.FId_APPSyncSigProv DINH_xWhy.FId_APPVel DINH_xWhy.FId_APProvDef DINH_xWhy.FId_ASDdc DINH_xWhy.FId_ASModNSC DINH_xWhy.FId_ASModOxiC DINH_xWhy.FId_ASModPipe DINH_xWhy.FId_ASModPipeSlw DINH_xWhy.FId_ASModPresCalc DINH_xWhy.FId_ASModPresEnv DINH_xWhy.FId_ASModStrt DINH_xWhy.FId_ASModSwtOffEng DINH_xWhy.FId_ASModSwtOffIndVol DINH_xWhy.FId_ASModTrbn DINH_xWhy.FId_AccPedNMaxLim DINH_xWhy.FId_AccPedNMinLim DINH_xWhy.FId_AccPedNMinLimBrkApp DINH_xWhy.FId_AccPedTrqLim DINH_xWhy.FId_AdcI_ADC0 DINH_xWhy.FId_AirCClntPFrzVal DINH_xWhy.FId_AirCClntPPwmChk DINH_xWhy.FId_AirCClntPRplVal DINH_xWhy.FId_AirCSwt DINH_xWhy.FId_AirCtl DINH_xWhy.FId_AirCtlBstPresCor DINH_xWhy.FId_AirCtlCmpntActv DINH_xWhy.FId_AirCtlEGR DINH_xWhy.FId_AirCtlGear DINH_xWhy.FId_AirCtlGovDvt DINH_xWhy.FId_AirCtlPFltEGRRed DINH_xWhy.FId_AirCtlStrg DINH_xWhy.FId_AirCtlTVA DINH_xWhy.FId_BattUFrzVal DINH_xWhy.FId_BattUReplVal DINH_xWhy.FId_BattUSRC DINH_xWhy.FId_BrkP DINH_xWhy.FId_BrkPFrzVal DINH_xWhy.FId_BrkPReplVal DINH_xWhy.FId_CEngDsTCANFrzVal DINH_xWhy.FId_CEngDsTCANRplVal DINH_xWhy.FId_CEngDsTDynTst DINH_xWhy.FId_CEngDsTFrzVal DINH_xWhy.FId_CEngDsTModel DINH_xWhy.FId_CEngDsTRdClnt DINH_xWhy.FId_CEngDsTRplVal DINH_xWhy.FId_CEngDsTSS DINH_xWhy.FId_CEngUsTFrzVal DINH_xWhy.FId_CEngUsTReplVal DINH_xWhy.FId_CEngUsTSS DINH_xWhy.FId_Clth DINH_xWhy.FId_ClthCAN DINH_xWhy.FId_CmbChb DINH_xWhy.FId_CoETM DINH_xWhy.FId_CoEngNrml2Strt DINH_xWhy.FId_CoEngPthClsEGR DINH_xWhy.FId_CoEngPthClsThr DINH_xWhy.FId_CoEngPthCylOff DINH_xWhy.FId_CoEngPthETZr DINH_xWhy.FId_CoEngPthFlQnt DINH_xWhy.FId_CoEngPthInjVlvOff DINH_xWhy.FId_CoEngPthLpSysOff DINH_xWhy.FId_CoEngPthRPMin DINH_xWhy.FId_CoTS_SwtOff DINH_xWhy.FId_CoVehPrpLimErr DINH_xWhy.FId_ComAPP DINH_xWhy.FId_ComClth DINH_xWhy.FId_ComCoEng DINH_xWhy.FId_ComDscAck1 DINH_xWhy.FId_ComDscAck2 DINH_xWhy.FId_ComDscAck3 DINH_xWhy.FId_ComDscTrqIntv DINH_xWhy.FId_ComEngDem DINH_xWhy.FId_ComGbxAck1 DINH_xWhy.FId_ComGbxAck2 DINH_xWhy.FId_ComGbxAck3 DINH_xWhy.FId_ComGbxTrqIntv DINH_xWhy.FId_ComInjDu1 DINH_xWhy.FId_ComInjDu2 DINH_xWhy.FId_ComInjVlv DINH_xWhy.FId_ComMSA DINH_xWhy.FId_ComStBrkPedal DINH_xWhy.FId_ComStTrq DINH_xWhy.FId_ComnEng DINH_xWhy.FId_ComnSetPLo DINH_xWhy.FId_CompEnv DINH_xWhy.FId_ComrWaterVlv DINH_xWhy.FId_ConvLdNTrbnCan DINH_xWhy.FId_ConvLdOilTemp DINH_xWhy.FId_ConvLdTrqLdCan DINH_xWhy.FId_ConvLdVel DINH_xWhy.FId_CoordEGT DINH_xWhy.FId_CrCtl_irrev DINH_xWhy.FId_CrCtl_rev DINH_xWhy.FId_CtTSwtOff DINH_xWhy.FId_Cy100Dev1 DINH_xWhy.FId_DCSRmpShOff DINH_xWhy.FId_DCSShOff DINH_xWhy.FId_DIOnumChip1Cj945 DINH_xWhy.FId_DIUMPRGenDenom1 DINH_xWhy.FId_DIUMPRGenDenom2 DINH_xWhy.FId_DIUMPRGenDenom3 DINH_xWhy.FId_DIUMPRIgn DINH_xWhy.FId_DSMWarmUpCycle DINH_xWhy.FId_DevLibActrPrt DINH_xWhy.FId_DewDetHtgDel DINH_xWhy.FId_ECBVlvFrzVal DINH_xWhy.FId_ECBVlvReplVal DINH_xWhy.FId_ECBVlvSS DINH_xWhy.FId_EGRClg DINH_xWhy.FId_EGRVlvActr DINH_xWhy.FId_EGRVlvFrzVal DINH_xWhy.FId_EGRVlvGovOn DINH_xWhy.FId_EGRVlvOfsLrnInhib DINH_xWhy.FId_EGRVlvReplVal DINH_xWhy.FId_EGRVlvSSpMon DINH_xWhy.FId_EGTRgnLck DINH_xWhy.FId_EMCtl DINH_xWhy.FId_ETClbCorActv DINH_xWhy.FId_ETCtlAirCtl DINH_xWhy.FId_ETCtlInr DINH_xWhy.FId_ETCtlOutr DINH_xWhy.FId_EngDemPFltErr DINH_xWhy.FId_EngDemTrqLimErr DINH_xWhy.FId_EngDemTrqLimErr1 DINH_xWhy.FId_EngDemTrqLimErr2 DINH_xWhy.FId_EngDemTrqLimErr3 DINH_xWhy.FId_EngDemTrqLimErr4 DINH_xWhy.FId_EngPrtEnvP DINH_xWhy.FId_EngPrtNLimErr DINH_xWhy.FId_EnvPCANFrzVal DINH_xWhy.FId_EnvPCANRplVal DINH_xWhy.FId_EnvPFrzVal DINH_xWhy.FId_EnvPModel DINH_xWhy.FId_EnvPRplVal DINH_xWhy.FId_EnvPSS DINH_xWhy.FId_EnvTCANFrzVal DINH_xWhy.FId_EnvTCANRplVal DINH_xWhy.FId_EnvTFrzVal DINH_xWhy.FId_EnvTModel DINH_xWhy.FId_EnvTRplVal DINH_xWhy.FId_EnvTSS DINH_xWhy.FId_EpmCaSDiag DINH_xWhy.FId_EpmCaSOfsDiag_I1 DINH_xWhy.FId_EpmCaSOfsDiag_I2 DINH_xWhy.FId_EpmCaSOfsDiag_O1 DINH_xWhy.FId_EpmCaSOfsDiag_O2 DINH_xWhy.FId_EpmCaSOfsDiag_SglCaSI1 DINH_xWhy.FId_EpmCaSSegCor DINH_xWhy.FId_EpmCrSDiag DINH_xWhy.FId_EpmOpMode_InjLock DINH_xWhy.FId_FBC DINH_xWhy.FId_FanCtl DINH_xWhy.FId_FanCtlCor DINH_xWhy.FId_FanCtlCor2 DINH_xWhy.FId_FanTraOil DINH_xWhy.FId_FansVelCor DINH_xWhy.FId_FlSysDens DINH_xWhy.FId_FrzPrtTrqDfftl DINH_xWhy.FId_FrzValPAirFltDs DINH_xWhy.FId_FrzValPPFltUs DINH_xWhy.FId_FrzValTOxiCatUs DINH_xWhy.FId_FrzValTPFltUs DINH_xWhy.FId_FuelTCTS DINH_xWhy.FId_FuelTFlSys DINH_xWhy.FId_FuelTFrzVal DINH_xWhy.FId_FuelTReplVal DINH_xWhy.FId_GbxNPos DINH_xWhy.FId_GbxNPosPWM DINH_xWhy.FId_GlbDaLSumvXPtd DINH_xWhy.FId_GlwCtl1 DINH_xWhy.FId_HLSDemDfrstI DINH_xWhy.FId_HLSDemSetPLoDrvAwy DINH_xWhy.FId_HLSDemUndrBrk DINH_xWhy.FId_ISCnTrbnMod DINH_xWhy.FId_ISCvBd DINH_xWhy.FId_IVPSplyDCDCOff DINH_xWhy.FId_InhibitNever DINH_xWhy.FId_InjCrvCoErr DINH_xWhy.FId_InjCrvDisblPoI1 DINH_xWhy.FId_InjCrvDisblPoI2 DINH_xWhy.FId_InjSys_qLimErr DINH_xWhy.FId_InjSysqFuelT DINH_xWhy.FId_InjUnStrtPlsBlk DINH_xWhy.FId_InjVlvPresMin DINH_xWhy.FId_LSUAllChecks0 DINH_xWhy.FId_LSUAllChecks1 DINH_xWhy.FId_LSUClbSched DINH_xWhy.FId_LSUCmpChk0 DINH_xWhy.FId_LSUCmpChk1 DINH_xWhy.FId_LSUCtl0 DINH_xWhy.FId_LSUCtl1 DINH_xWhy.FId_LSUMon0 DINH_xWhy.FId_LSUMon1 DINH_xWhy.FId_LSUO20 DINH_xWhy.FId_LSUO21 DINH_xWhy.FId_LSURi0 DINH_xWhy.FId_LSURi1 DINH_xWhy.FId_LSUactiv0 DINH_xWhy.FId_LSUactiv1 DINH_xWhy.FId_LSUlsu0 DINH_xWhy.FId_LSUlsu1 DINH_xWhy.FId_MeUnFrzI DINH_xWhy.FId_MeUnRot DINH_xWhy.FId_NplPAirFltDs DINH_xWhy.FId_NplTOxiCatUs DINH_xWhy.FId_NplTPFltUs DINH_xWhy.FId_OilTCANFrzVal DINH_xWhy.FId_OilTCANRplVal DINH_xWhy.FId_OilTFrzVal DINH_xWhy.FId_OilTModel DINH_xWhy.FId_OilTNpl DINH_xWhy.FId_OilTRplVal DINH_xWhy.FId_OilTSS DINH_xWhy.FId_PAirFltDsCANFrzVal DINH_xWhy.FId_PAirFltDsCANRplVal DINH_xWhy.FId_PCACDsCANFrzVal DINH_xWhy.FId_PCACDsCANRplVal DINH_xWhy.FId_PCACDsEnvPPls DINH_xWhy.FId_PCACDsFrzVal DINH_xWhy.FId_PCACDsModel DINH_xWhy.FId_PCACDsRplVal DINH_xWhy.FId_PCACDsSS DINH_xWhy.FId_PCR DINH_xWhy.FId_PCRCByVlvOff DINH_xWhy.FId_PCRCmpntActv DINH_xWhy.FId_PCRCmpntActvLP DINH_xWhy.FId_PCRExtnLimActr DINH_xWhy.FId_PCRGovDvt DINH_xWhy.FId_PCRGovDvtLP DINH_xWhy.FId_PCRLP DINH_xWhy.FId_PCROfsRls DINH_xWhy.FId_PCRPFltPresCor DINH_xWhy.FId_PCVFrzI DINH_xWhy.FId_PCVPwrStgTst DINH_xWhy.FId_PFltAirSysFail DINH_xWhy.FId_PFltChar DINH_xWhy.FId_PFltDstr DINH_xWhy.FId_PFltLckRgnErr DINH_xWhy.FId_PFltLckRgnFl DINH_xWhy.FId_PFltLdSimRgnThr DINH_xWhy.FId_PFltPOpBrk DINH_xWhy.FId_PFltPOpClth DINH_xWhy.FId_PFltPOpGearDet DINH_xWhy.FId_PFltPOpSpdVeh DINH_xWhy.FId_PFltPOpTempAir DINH_xWhy.FId_PFltPOpTempClnt DINH_xWhy.FId_PFltPOpVltgBatt DINH_xWhy.FId_PFltPoI1Fail DINH_xWhy.FId_PFltPoI2Fail DINH_xWhy.FId_PFltRgnChngPar DINH_xWhy.FId_PFltSimOn DINH_xWhy.FId_PFltSrvRgnRlsEng DINH_xWhy.FId_PFltSrvRgnRlsPFlt DINH_xWhy.FId_PFltSysFail DINH_xWhy.FId_PTGripDebPtd DINH_xWhy.FId_PTTrqRatCANPtd DINH_xWhy.FId_PresSensFrzPPFltUs DINH_xWhy.FId_QWCCTSDef DINH_xWhy.FId_QWCFTSDef DINH_xWhy.FId_QWCOff DINH_xWhy.FId_RadShtCTS DINH_xWhy.FId_RadShtEGS DINH_xWhy.FId_RailCPCtlMeUnMode DINH_xWhy.FId_RailCPCtlPCVMode DINH_xWhy.FId_RailCtlMode DINH_xWhy.FId_RailFuelTErr DINH_xWhy.FId_RailMeUn0Blk DINH_xWhy.FId_RailMeUn0Rls DINH_xWhy.FId_RailMeUn1Blk DINH_xWhy.FId_RailMeUn1Rls DINH_xWhy.FId_RailMeUn2Blk DINH_xWhy.FId_RailMeUn2Rls DINH_xWhy.FId_RailMeUn3Blk DINH_xWhy.FId_RailMeUn3Rls DINH_xWhy.FId_RailMeUn4Blk DINH_xWhy.FId_RailMeUn4Rls DINH_xWhy.FId_RailMeUnCtlMode DINH_xWhy.FId_RailPCV0Blk DINH_xWhy.FId_RailPCV0Rls DINH_xWhy.FId_RailPCV1Blk DINH_xWhy.FId_RailPCV1Rls DINH_xWhy.FId_RailPCV2Blk DINH_xWhy.FId_RailPCV2Rls DINH_xWhy.FId_RailPCV3Blk DINH_xWhy.FId_RailPCV3Rls DINH_xWhy.FId_RailPCV4Blk DINH_xWhy.FId_RailPCV4Rls DINH_xWhy.FId_RailPCVCtlMode DINH_xWhy.FId_RailPFrzVal DINH_xWhy.FId_RailPMonStrt DINH_xWhy.FId_RailPSS DINH_xWhy.FId_RailPSubsVal DINH_xWhy.FId_RailSetPointLim DINH_xWhy.FId_RailSetPointRed DINH_xWhy.FId_ReplValTPFltUs DINH_xWhy.FId_RplValPAirFltDs DINH_xWhy.FId_RplValPPFltUs DINH_xWhy.FId_RplValTOxiCatUs DINH_xWhy.FId_SRCFlwRstn DINH_xWhy.FId_SSEStart DINH_xWhy.FId_SSEStartAST DINH_xWhy.FId_SSEStartMTClPressed10 DINH_xWhy.FId_SSEStartMTClPressed90 DINH_xWhy.FId_SSEStop DINH_xWhy.FId_SSEStopAST DINH_xWhy.FId_SSEStopMT DINH_xWhy.FId_SSPAirFltDs DINH_xWhy.FId_SSTOxiCatUs DINH_xWhy.FId_SSTPFltUs DINH_xWhy.FId_SensAdapTPFltUs DINH_xWhy.FId_StAPmp DINH_xWhy.FId_StDa DINH_xWhy.FId_SubsValPrtTrqDfftl DINH_xWhy.FId_SubsValRatTrqDfftl DINH_xWhy.FId_T15 DINH_xWhy.FId_T50Sig DINH_xWhy.FId_TAFSFrzVal DINH_xWhy.FId_TAFSReplVal DINH_xWhy.FId_TAFSSRC DINH_xWhy.FId_TCACDsCANFrzVal DINH_xWhy.FId_TCACDsCANRplVal DINH_xWhy.FId_TCACDsFrzVal DINH_xWhy.FId_TCACDsModel DINH_xWhy.FId_TCACDsRplVal DINH_xWhy.FId_TCACDsSS DINH_xWhy.FId_TCPrtChrgPmpCtl DINH_xWhy.FId_TCPrtChrgPmpGov DINH_xWhy.FId_TCPrtChrgPmpHLSDem DINH_xWhy.FId_TCPrt_ChrgPmpDet DINH_xWhy.FId_TCSRmpShOff DINH_xWhy.FId_TCSShOff DINH_xWhy.FId_TECUFrzVal DINH_xWhy.FId_TECURplVal DINH_xWhy.FId_TOxiCatUs DINH_xWhy.FId_TempSensFrzPPFltUs DINH_xWhy.FId_ThrVlvFrzVal DINH_xWhy.FId_ThrVlvRplVal DINH_xWhy.FId_ThrVlvSS DINH_xWhy.FId_TraAddAirCANPtd DINH_xWhy.FId_TraAddClntCANPtd DINH_xWhy.FId_TraDrvAway DINH_xWhy.FId_TraDrvAwayInactiv DINH_xWhy.FId_TraGearInfoDet DINH_xWhy.FId_TraGearInfoInfoCan DINH_xWhy.FId_TraGearInfoLevPos DINH_xWhy.FId_TraGearInfoLoRng DINH_xWhy.FId_TraGearInfoRTra DINH_xWhy.FId_TraGearInfoRevGear DINH_xWhy.FId_TraGripDeb DINH_xWhy.FId_TraOilTemp DINH_xWhy.FId_TraPrtGearCANPtd DINH_xWhy.FId_TraRtnIntfcASTIntv DINH_xWhy.FId_TraRtnIntfcIdlSetP DINH_xWhy.FId_TraTrqLimErr DINH_xWhy.FId_TraTrqLos DINH_xWhy.FId_TraTrqRedLmpHmeDec DINH_xWhy.FId_TraTrqRedLmpHmeInc DINH_xWhy.FId_TraTrqRedPlausDecIntv DINH_xWhy.FId_TraTrqRedPlausIncIntv DINH_xWhy.FId_TrbChPWMIn DINH_xWhy.FId_VSwCtl DINH_xWhy.FId_VSwVlvFrzVal DINH_xWhy.FId_VSwVlvGovOn DINH_xWhy.FId_VSwVlvOfsLrnInhib DINH_xWhy.FId_VSwVlvOpnLd DINH_xWhy.FId_VSwVlvRplVal DINH_xWhy.FId_VSwVlvSS DINH_xWhy.FId_VehMotvBd DINH_xWhy.FId_VehVCANFrzVal DINH_xWhy.FId_VehVCANReplVal DINH_xWhy.FId_VehVFrzVal DINH_xWhy.FId_VehVMon DINH_xWhy.FId_VehVReplVal DINH_xWhy.FId_ZFCClbActv DINH_xWhy.FId_ZFCCldCmbCham DINH_xWhy.FId_stAVSCoESLSU DINH_xWhy.Fid_HLSDemHDC DINH_xWhy.Fid_StSysStrtTipGbxDat DINH_xWhy.Fid_WaHtShOffErr /end OUT_MEASUREMENT
/end FUNCTION
/begin COMPU_METHOD DFCDSQ_Verb "" TAB_VERB "%2.1" "-" COMPU_TAB_REF DFCDSQ_Verb /end COMPU_METHOD
/begin COMPU_VTAB DFCDSQ_Verb "" TAB_VERB 657 0 "NoInhibit" 1 "DFC_AirCtlGovDvtEOMMax" 2 "DFC_AirCtlGovDvtEOMMin" 3 "DFC_AirCtlGovDvtMax" 4 "DFC_AirCtlGovDvtMin" 5 "DFC_Cj945SpiCom1" 6 "DFC_ComButtonMSASig" 7 "DFC_ComButtonMSATo" 8 "DFC_ComGearboxData2Sig" 9 "DFC_ComGearboxData2To" 10 "DFC_ComGearboxDataSig" 11 "DFC_ComGearboxDataTo" 12 "DFC_ComHeatACSig" 13 "DFC_ComHeatACTo" 14 "DFC_ComLenkradwinkelSig" 15 "DFC_ComLenkradwinkelTo" 16 "DFC_ComMileageRangeSig" 17 "DFC_ComMileageRangeTo" 18 "DFC_ComPspSig" 19 "DFC_ComPspTo" 20 "DFC_ComShutOffPSPSig" 21 "DFC_ComShutOffPSPTo" 22 "DFC_ComStKombiCtr" 23 "DFC_ComStKombiSig" 24 "DFC_ComStKombiTo" 25 "DFC_ComStateARSCtr" 26 "DFC_ComStateARSSig" 27 "DFC_ComStateARSTo" 28 "DFC_ComStateDscSig" 29 "DFC_ComStateDscTo" 30 "DFC_ComStateSeatSig" 31 "DFC_ComStateSeatTo" 32 "DFC_ComTempRelTimeSig" 33 "DFC_ComTempRelTimeTo" 34 "DFC_ComTerminalChk" 35 "DFC_ComTerminalCtr" 36 "DFC_ComTerminalSig" 37 "DFC_ComTerminalTo" 38 "DFC_ComTimeDateSig" 39 "DFC_ComTimeDateTo" 40 "DFC_ComTrailerSig" 41 "DFC_ComTrailerTo" 42 "DFC_ComTrqDemandAfsChk" 43 "DFC_ComTrqDemandAfsCtr" 44 "DFC_ComTrqDemandAfsSig" 45 "DFC_ComTrqDemandAfsTo" 46 "DFC_ComTrqDemandDscChk" 47 "DFC_ComTrqDemandDscCtr" 48 "DFC_ComTrqDemandDscSig" 49 "DFC_ComTrqDemandDscTo" 50 "DFC_ComTrqDemandGbxChk" 51 "DFC_ComTrqDemandGbxCtr" 52 "DFC_ComTrqDemandGbxSig" 53 "DFC_ComTrqDemandGbxTo" 54 "DFC_ComVelocitySig" 55 "DFC_ComVelocityTo" 56 "DFC_ComWheelSpeedSig" 57 "DFC_ComWheelSpeedTo" 58 "DFC_ComZvKlappenSig" 59 "DFC_ComZvKlappenTo" 60 "DFC_Cy150SpiCom" 61 "DFC_Cy320SpiCom" 62 "DFC_ETCtlDvtInrMax" 63 "DFC_ETCtlDvtInrMin" 64 "DFC_ETCtlDvtOutrMax" 65 "DFC_ETCtlDvtOutrMin" 66 "DFC_Fan4WinErr1" 67 "DFC_Fan4WinErr2" 68 "DFC_Fan4WinErr3" 69 "DFC_Fan4WinErr4" 70 "DFC_FanSCG" 71 "DFC_PCRGovDvtLPMax" 72 "DFC_PCRGovDvtLPMin" 73 "DFC_PCRGovDvtMax" 74 "DFC_PCRGovDvtMin" 75 "DFC_RailCPC1" 76 "DFC_RailCPC3" 77 "DFC_RailCPC4" 78 "DFC_RailMeUn0" 79 "DFC_RailMeUn1" 80 "DFC_RailMeUn2" 81 "DFC_RailMeUn3" 82 "DFC_RailMeUn4" 83 "DFC_RailPCV0" 84 "DFC_RailPCV1" 85 "DFC_RailPCV2" 86 "DFC_RailPCV3" 87 "DFC_RailPCV4" 88 "DFC_RailPMonStrt" 89 "DFC_SSpMon1" 90 "DFC_SSpMon2" 91 "DFC_SSpMon3" 92 "DFC_Sia_E1" 93 "DFC_Sia_E10" 94 "DFC_Sia_E11" 95 "DFC_Sia_E12" 96 "DFC_Sia_E13" 97 "DFC_Sia_E14" 98 "DFC_Sia_E15" 99 "DFC_Sia_E2" 100 "DFC_Sia_E3" 101 "DFC_Sia_E4" 102 "DFC_Sia_E5" 103 "DFC_Sia_E6" 104 "DFC_Sia_E7" 105 "DFC_Sia_E8" 106 "DFC_Sia_E9" 107 "DFC_ThrVlv4WinErr1" 108 "DFC_ThrVlv4WinErr2" 109 "DFC_ThrVlv4WinErr3" 110 "DFC_ThrVlv4WinErr4" 111 "DFC_ThrVlvSCG" 112 "DFC_TrbCh4WinErr1" 113 "DFC_TrbCh4WinErr2" 114 "DFC_TrbCh4WinErr3" 115 "DFC_TrbCh4WinErr4" 116 "DFC_TrbChSCG" 117 "DFC_TrbChSRCMax" 118 "DFC_TrbChSRCMin" 119 "DFC_WaHtEl4WinErr1" 120 "DFC_WaHtEl4WinErr2" 121 "DFC_WaHtEl4WinErr3" 122 "DFC_WaHtEl4WinErr4" 123 "DFC_WaHtElSCG" 124 "DFC_ETClbETFltMax" 125 "DFC_ETClbETFltMin" 126 "DFC_InjCrvInjLimChrgBal" 127 "DFC_InjCrvInjLimQntBal" 128 "DFC_InjCrvInjLimSys" 129 "DFC_InjCrvNumInjRtmLim" 130 "DFC_LSUHtCoupSig_0" 131 "DFC_LSUHtCoupSig_1" 132 "DFC_LSUHtCoupSig_2" 133 "DFC_LSUHtCoupSig_3" 134 "DFC_CtT" 135 "DFC_DSMDummy" 136 "DFC_MeUnOL" 137 "DFC_MeUnSCB" 138 "DFC_MeUnSRCMax" 139 "DFC_MeUnSRCMin" 140 "DFC_PCVOL" 141 "DFC_PCVSCB" 142 "DFC_PCVSRCMax" 143 "DFC_PCVSRCMin" 144 "DFC_RailPSRCMax" 145 "DFC_RailPSRCMin" 146 "DFC_IVActrVltgSRCMax" 147 "DFC_IVActrVltgSRCMin" 148 "DFC_IVPSplyDCDC" 149 "DFC_IVPSplyVltgSRCMax" 150 "DFC_IVPSplyVltgSRCMin" 151 "DFC_AFSOffsDrftMax" 152 "DFC_AFSOffsDrftMin" 153 "DFC_AFSSRCCorMax" 154 "DFC_AFSSRCCorMin" 155 "DFC_AFSSRCRawMax" 156 "DFC_AFSSRCRawMin" 157 "DFC_AFSSetyDrftMax" 158 "DFC_AFSSetyDrftMin" 159 "DFC_AirCClntPAnaSRCMax" 160 "DFC_AirCClntPAnaSRCMin" 161 "DFC_AirCClntPPerSRCMax" 162 "DFC_AirCClntPPerSRCMin" 163 "DFC_AirCClntPdcycSRCMax" 164 "DFC_AirCClntPdcycSRCMin" 165 "DFC_AirCCmprOL" 166 "DFC_AirCCmprRedTrqOL" 167 "DFC_AirCCmprRedTrqSCB" 168 "DFC_AirCCmprRedTrqSCG" 169 "DFC_AirCCmprSCB" 170 "DFC_AirCCmprSCG" 171 "DFC_AirCSwtNpl" 172 "DFC_AirCSwtSig" 173 "DFC_BattUSRCMax" 174 "DFC_BattUSRCMin" 175 "DFC_BrkNpl" 176 "DFC_BrkPSRCMax" 177 "DFC_BrkPSRCMin" 178 "DFC_BrkSig" 179 "DFC_CByVlvOL" 180 "DFC_CByVlvSCB" 181 "DFC_CByVlvSCG" 182 "DFC_CEngDsTSRCMax" 183 "DFC_CEngDsTSRCMin" 184 "DFC_CEngDsTSig" 185 "DFC_CEngUsTSRCMax" 186 "DFC_CEngUsTSRCMin" 187 "DFC_CThmstOL" 188 "DFC_CThmstSCB" 189 "DFC_CThmstSCG" 190 "DFC_ClthSig" 191 "DFC_ECBVlvOL" 192 "DFC_ECBVlvSCB" 193 "DFC_ECBVlvSCG" 194 "DFC_ECBVlvSRCMax" 195 "DFC_ECBVlvSRCMin" 196 "DFC_EGRVlvGovDvtMax" 197 "DFC_EGRVlvGovDvtMin" 198 "DFC_EGRVlvOL" 199 "DFC_EGRVlvSCB" 200 "DFC_EGRVlvSCG" 201 "DFC_EGRVlvSRCMax" 202 "DFC_EGRVlvSRCMin" 203 "DFC_EMDmpOL_0" 204 "DFC_EMDmpOL_1" 205 "DFC_EMDmpSCB_0" 206 "DFC_EMDmpSCB_1" 207 "DFC_EMDmpSCG_0" 208 "DFC_EMDmpSCG_1" 209 "DFC_EngStAOL" 210 "DFC_EngStASCB" 211 "DFC_EngStASCG" 212 "DFC_EnvPSRCMax" 213 "DFC_EnvPSRCMin" 214 "DFC_EnvPSig" 215 "DFC_EnvTSRCMax" 216 "DFC_EnvTSRCMin" 217 "DFC_FanOL" 218 "DFC_FanSCB" 219 "DFC_FlFltSig" 220 "DFC_FuelTSRCMax" 221 "DFC_FuelTSRCMin" 222 "DFC_GbxNPosPPerSRCMax" 223 "DFC_GbxNPosPPerSRCMin" 224 "DFC_GbxNPosPdcycSRCMax" 225 "DFC_GbxNPosPdcycSRCMin" 226 "DFC_GbxNPosSig" 227 "DFC_GlwPlgBSDOL_0" 228 "DFC_GlwPlgBSDOL_1" 229 "DFC_GlwPlgBSDOL_2" 230 "DFC_GlwPlgBSDOL_3" 231 "DFC_GlwPlgBSDOL_4" 232 "DFC_GlwPlgBSDOL_5" 233 "DFC_GlwPlgBSDOL_6" 234 "DFC_GlwPlgBSDOL_7" 235 "DFC_GlwPlgBSDOT_0" 236 "DFC_GlwPlgBSDOT_1" 237 "DFC_GlwPlgBSDOT_2" 238 "DFC_GlwPlgBSDOT_3" 239 "DFC_GlwPlgBSDOT_4" 240 "DFC_GlwPlgBSDOT_5" 241 "DFC_GlwPlgBSDOT_6" 242 "DFC_GlwPlgBSDOT_7" 243 "DFC_GlwPlgBSDSC_0" 244 "DFC_GlwPlgBSDSC_1" 245 "DFC_GlwPlgBSDSC_2" 246 "DFC_GlwPlgBSDSC_3" 247 "DFC_GlwPlgBSDSC_4" 248 "DFC_GlwPlgBSDSC_5" 249 "DFC_GlwPlgBSDSC_6" 250 "DFC_GlwPlgBSDSC_7" 251 "DFC_GlwPlgComErr" 252 "DFC_InjVlvPresMin" 253 "DFC_LSUCircNernstMax_0" 254 "DFC_LSUCircNernstMax_1" 255 "DFC_LSUCircNernstMax_2" 256 "DFC_LSUCircNernstMax_3" 257 "DFC_LSUCircNernstMin_0" 258 "DFC_LSUCircNernstMin_1" 259 "DFC_LSUCircNernstMin_2" 260 "DFC_LSUCircNernstMin_3" 261 "DFC_LSUCircNernstSig_0" 262 "DFC_LSUCircNernstSig_1" 263 "DFC_LSUCircNernstSig_2" 264 "DFC_LSUCircNernstSig_3" 265 "DFC_LSUCircPmpCurMax_0" 266 "DFC_LSUCircPmpCurMax_1" 267 "DFC_LSUCircPmpCurMax_2" 268 "DFC_LSUCircPmpCurMax_3" 269 "DFC_LSUCircPmpCurMin_0" 270 "DFC_LSUCircPmpCurMin_1" 271 "DFC_LSUCircPmpCurMin_2" 272 "DFC_LSUCircPmpCurMin_3" 273 "DFC_LSUCircPmpCurSig_0" 274 "DFC_LSUCircPmpCurSig_1" 275 "DFC_LSUCircPmpCurSig_2" 276 "DFC_LSUCircPmpCurSig_3" 277 "DFC_LSUCircVirtGndMax_0" 278 "DFC_LSUCircVirtGndMax_1" 279 "DFC_LSUCircVirtGndMax_2" 280 "DFC_LSUCircVirtGndMax_3" 281 "DFC_LSUCircVirtGndMin_0" 282 "DFC_LSUCircVirtGndMin_1" 283 "DFC_LSUCircVirtGndMin_2" 284 "DFC_LSUCircVirtGndMin_3" 285 "DFC_LSUCircVirtGndSig_0" 286 "DFC_LSUCircVirtGndSig_1" 287 "DFC_LSUCircVirtGndSig_2" 288 "DFC_LSUCircVirtGndSig_3" 289 "DFC_LSUHtrMax_0" 290 "DFC_LSUHtrMax_1" 291 "DFC_LSUHtrMax_2" 292 "DFC_LSUHtrMax_3" 293 "DFC_LSUHtrMin_0" 294 "DFC_LSUHtrMin_1" 295 "DFC_LSUHtrMin_2" 296 "DFC_LSUHtrMin_3" 297 "DFC_LSUHtrSig_0" 298 "DFC_LSUHtrSig_1" 299 "DFC_LSUHtrSig_2" 300 "DFC_LSUHtrSig_3" 301 "DFC_LSUO2Max_0" 302 "DFC_LSUO2Max_1" 303 "DFC_LSUO2Max_2" 304 "DFC_LSUO2Max_3" 305 "DFC_LSUO2Min_0" 306 "DFC_LSUO2Min_1" 307 "DFC_LSUO2Min_2" 308 "DFC_LSUO2Min_3" 309 "DFC_LSUSPIBattLowMin_0" 310 "DFC_LSUSPIBattLowMin_1" 311 "DFC_LSUSPIBattLowMin_2" 312 "DFC_LSUSPIBattLowMin_3" 313 "DFC_LSUSPISig_0" 314 "DFC_LSUSPISig_1" 315 "DFC_LSUSPISig_2" 316 "DFC_LSUSPISig_3" 317 "DFC_LSUtExcMax_0" 318 "DFC_LSUtExcMax_1" 319 "DFC_LSUtExcMax_2" 320 "DFC_LSUtExcMax_3" 321 "DFC_LSUtExcMin_0" 322 "DFC_LSUtExcMin_1" 323 "DFC_LSUtExcMin_2" 324 "DFC_LSUtExcMin_3" 325 "DFC_MILOL" 326 "DFC_MILSCB" 327 "DFC_MILSCG" 328 "DFC_MeUnSCG" 329 "DFC_NplHsChngPPFltDiff" 330 "DFC_NplPAirFltDs" 331 "DFC_NplTPFltUs" 332 "DFC_OilComErr" 333 "DFC_OilPLmpOL" 334 "DFC_OilPLmpSCB" 335 "DFC_OilPLmpSCG" 336 "DFC_OilPNpl" 337 "DFC_OilTNpl" 338 "DFC_OilTSRCMax" 339 "DFC_OilTSRCMin" 340 "DFC_PCACDsEnvPPls" 341 "DFC_PCACDsSRCMax" 342 "DFC_PCACDsSRCMin" 343 "DFC_PCVSCG" 344 "DFC_PFltCharPDiffMin" 345 "DFC_PFltDstrMin" 346 "DFC_PFltEngPrt" 347 "DFC_PFltLmpOL" 348 "DFC_PFltLmpSCB" 349 "DFC_PFltLmpSCG" 350 "DFC_PFltRgnPerm" 351 "DFC_PFltSRCMaxFlwRstn" 352 "DFC_PFltSRCMinFlwRstn" 353 "DFC_PFltSotMsDvtMax" 354 "DFC_PFltSotMsDvtMin" 355 "DFC_PFltSotMsMax" 356 "DFC_PSPOL" 357 "DFC_PSPSCB" 358 "DFC_PSPSCG" 359 "DFC_SRCHighAPP1" 360 "DFC_SRCHighAPP2" 361 "DFC_SRCLowAPP1" 362 "DFC_SRCLowAPP2" 363 "DFC_SRCMaxPAirFltDs" 364 "DFC_SRCMaxPPFltUs" 365 "DFC_SRCMaxTECU" 366 "DFC_SRCMaxTOxiCatUs" 367 "DFC_SRCMaxTPFltUs" 368 "DFC_SRCMinPAirFltDs" 369 "DFC_SRCMinPPFltUs" 370 "DFC_SRCMinTECU" 371 "DFC_SRCMinTOxiCatUs" 372 "DFC_SRCMinTPFltUs" 373 "DFC_SVSOL" 374 "DFC_SVSSCB" 375 "DFC_SVSSCG" 376 "DFC_StrtOL" 377 "DFC_StrtSCB" 378 "DFC_StrtSCG" 379 "DFC_SyncAPP" 380 "DFC_T15Npl" 381 "DFC_TAFSDtyCycHi" 382 "DFC_TAFSDtyCycLo" 383 "DFC_TAFSPerHi" 384 "DFC_TAFSPerLo" 385 "DFC_TCACDsSRCMax" 386 "DFC_TCACDsSRCMin" 387 "DFC_ThrVlvOL" 388 "DFC_ThrVlvSCB" 389 "DFC_ThrVlvSRCMax" 390 "DFC_ThrVlvSRCMin" 391 "DFC_TrbChLPOL" 392 "DFC_TrbChLPSCB" 393 "DFC_TrbChLPSCG" 394 "DFC_TrbChOL" 395 "DFC_TrbChSCB" 396 "DFC_VSwVlvGovDvtMax" 397 "DFC_VSwVlvGovDvtMin" 398 "DFC_VSwVlvOL" 399 "DFC_VSwVlvSCB" 400 "DFC_VSwVlvSCG" 401 "DFC_VSwVlvSRCMax" 402 "DFC_VSwVlvSRCMin" 403 "DFC_VehVHW" 404 "DFC_VehVMax" 405 "DFC_VehVPlaus" 406 "DFC_VehVSig" 407 "DFC_WaHtElOL" 408 "DFC_WaHtElSCB" 409 "DFC_ClthNpl" 410 "DFC_ETClbETMax_0" 411 "DFC_ETClbETMax_1" 412 "DFC_ETClbETMax_2" 413 "DFC_ETClbETMax_3" 414 "DFC_ETClbETMax_4" 415 "DFC_ETClbETMax_5" 416 "DFC_ETClbETMin_0" 417 "DFC_ETClbETMin_1" 418 "DFC_ETClbETMin_2" 419 "DFC_ETClbETMin_3" 420 "DFC_ETClbETMin_4" 421 "DFC_ETClbETMin_5" 422 "DFC_IVDiaBnkShCirBSH_0" 423 "DFC_IVDiaBnkShCirBSH_1" 424 "DFC_IVDiaBnkShCirChSwt_0" 425 "DFC_IVDiaBnkShCirChSwt_1" 426 "DFC_IVDiaBnkShCirHSBatt_0" 427 "DFC_IVDiaBnkShCirHSBatt_1" 428 "DFC_IVDiaBnkShCirHiRstnc_0" 429 "DFC_IVDiaBnkShCirHiRstnc_1" 430 "DFC_IVDiaBnkShCirLSHSGnd_0" 431 "DFC_IVDiaBnkShCirLSHSGnd_1" 432 "DFC_IVDiaBnkShCirTransfer_0" 433 "DFC_IVDiaBnkShCirTransfer_1" 434 "DFC_IVDiaCylNoCls_0" 435 "DFC_IVDiaCylNoCls_1" 436 "DFC_IVDiaCylNoCls_2" 437 "DFC_IVDiaCylNoCls_3" 438 "DFC_IVDiaCylNoCls_4" 439 "DFC_IVDiaCylNoCls_5" 440 "DFC_IVDiaCylNoLd_0" 441 "DFC_IVDiaCylNoLd_1" 442 "DFC_IVDiaCylNoLd_2" 443 "DFC_IVDiaCylNoLd_3" 444 "DFC_IVDiaCylNoLd_4" 445 "DFC_IVDiaCylNoLd_5" 446 "DFC_IVDiaCylShCirHiRstnc_0" 447 "DFC_IVDiaCylShCirHiRstnc_1" 448 "DFC_IVDiaCylShCirHiRstnc_2" 449 "DFC_IVDiaCylShCirHiRstnc_3" 450 "DFC_IVDiaCylShCirHiRstnc_4" 451 "DFC_IVDiaCylShCirHiRstnc_5" 452 "DFC_IVDiaCylShCirLSBatt_0" 453 "DFC_IVDiaCylShCirLSBatt_1" 454 "DFC_IVDiaCylShCirLSBatt_2" 455 "DFC_IVDiaCylShCirLSBatt_3" 456 "DFC_IVDiaCylShCirLSBatt_4" 457 "DFC_IVDiaCylShCirLSBatt_5" 458 "DFC_IVDiaCylShCirLSHS_0" 459 "DFC_IVDiaCylShCirLSHS_1" 460 "DFC_IVDiaCylShCirLSHS_2" 461 "DFC_IVDiaCylShCirLSHS_3" 462 "DFC_IVDiaCylShCirLSHS_4" 463 "DFC_IVDiaCylShCirLSHS_5" 464 "DFC_IVDiaCylShCirLsLs_0" 465 "DFC_IVDiaCylShCirLsLs_1" 466 "DFC_IVDiaCylShCirLsLs_2" 467 "DFC_IVDiaCylShCirLsLs_3" 468 "DFC_IVDiaCylShCirLsLs_4" 469 "DFC_IVDiaCylShCirLsLs_5" 470 "DFC_IVDiaSPICfg" 471 "DFC_IVDiaSPIColl" 472 "DFC_IVDiaSPICtrl" 473 "DFC_IVDiaSPIRam" 474 "DFC_IVDiaSPITrans" 475 "DFC_LSUCmpChk_0" 476 "DFC_LSUCmpChk_1" 477 "DFC_LSUCmpChk_2" 478 "DFC_LSUCmpChk_3" 479 "DFC_LSUCmpChk_4" 480 "DFC_LSUCmpChk_5" 481 "DFC_LSUDynChk_0" 482 "DFC_LSUDynChk_1" 483 "DFC_LSUDynChk_2" 484 "DFC_LSUDynChk_3" 485 "DFC_LSUO2ClbMax_0" 486 "DFC_LSUO2ClbMax_1" 487 "DFC_LSUO2ClbMax_2" 488 "DFC_LSUO2ClbMax_3" 489 "DFC_LSUO2ClbMin_0" 490 "DFC_LSUO2ClbMin_1" 491 "DFC_LSUO2ClbMin_2" 492 "DFC_LSUO2ClbMin_3" 493 "DFC_LSUO2PlausMax_0" 494 "DFC_LSUO2PlausMax_1" 495 "DFC_LSUO2PlausMax_2" 496 "DFC_LSUO2PlausMax_3" 497 "DFC_LSUO2PlausMin_0" 498 "DFC_LSUO2PlausMin_1" 499 "DFC_LSUO2PlausMin_2" 500 "DFC_LSUO2PlausMin_3" 501 "DFC_LSURiClbMax_0" 502 "DFC_LSURiClbMax_1" 503 "DFC_LSURiClbMax_2" 504 "DFC_LSURiClbMax_3" 505 "DFC_LSURiClbMin_0" 506 "DFC_LSURiClbMin_1" 507 "DFC_LSURiClbMin_2" 508 "DFC_LSURiClbMin_3" 509 "DFC_LSUWireIPSig_0" 510 "DFC_LSUWireIPSig_1" 511 "DFC_LSUWireIPSig_2" 512 "DFC_LSUWireIPSig_3" 513 "DFC_AFSDrftIdlAdjVal" 514 "DFC_AFSDrftLdAdjVal" 515 "DFC_AdcI_ADC0_Cal" 516 "DFC_AdcI_ADC0_Conv" 517 "DFC_CmbChbMisfireMax_0" 518 "DFC_CmbChbMisfireMax_1" 519 "DFC_CmbChbMisfireMax_2" 520 "DFC_CmbChbMisfireMax_3" 521 "DFC_CmbChbMisfireMax_4" 522 "DFC_CmbChbMisfireMax_5" 523 "DFC_CmbChbMisfireMul" 524 "DFC_INJVLVBUSY" 525 "DFC_IVAdjIVA_0" 526 "DFC_IVAdjIVA_1" 527 "DFC_IVAdjIVA_2" 528 "DFC_IVAdjIVA_3" 529 "DFC_IVAdjIVA_4" 530 "DFC_IVAdjIVA_5" 531 "DFC_InjCtlAdjQntEEPCS" 532 "DFC_InjCtlDriftEEPCS" 533 "DFC_MRlyErlyOpng" 534 "DFC_MRlyStk" 535 "DFC_SensFrzPPFltUs" 536 "DFC_T15Sig" 537 "DFC_AirCtlRmpTOut" 538 "DFC_CEngDsTDynTst" 539 "DFC_EGRVlvJamVlvClsd" 540 "DFC_EGRVlvJamVlvOpn" 541 "DFC_EGRVlvLgTDrft" 542 "DFC_EGRVlvOfsLrnJamVlv" 543 "DFC_EGRVlvShTDrft" 544 "DFC_EGTRgnOilDilMax" 545 "DFC_EngICO" 546 "DFC_EpmCaSI1ErrSig" 547 "DFC_EpmCaSI1NoSig" 548 "DFC_EpmCaSI1OfsErr" 549 "DFC_EpmCrSErrSig" 550 "DFC_EpmCrSNoSig" 551 "DFC_MoCADCCmp" 552 "DFC_MoCADCTst" 553 "DFC_MoCADCVltgRatio" 554 "DFC_MoCSOPLoLi" 555 "DFC_MoCSOPMM" 556 "DFC_MoCSOPTimeOut" 557 "DFC_MoCSOPUpLi" 558 "DFC_MoFAPP" 559 "DFC_MoFESpd" 560 "DFC_MoFInjDatPhi" 561 "DFC_MoFInjDatQnt" 562 "DFC_MoFInjQnt" 563 "DFC_MoFOvR" 564 "DFC_MoFQntCor" 565 "DFC_MoFTrqCmp" 566 "DFC_NplTOxiCatUs" 567 "DFC_PhyModNonMonMapNpl" 568 "DFC_RailPOfsTstMax" 569 "DFC_RailPOfsTstMin" 570 "DFC_SWReset_0" 571 "DFC_SWReset_1" 572 "DFC_SWReset_2" 573 "DFC_VSwVlvJamVlv" 574 "DFC_VSwVlvLgTDrft" 575 "DFC_VSwVlvOfsLrnJamVlv" 576 "DFC_VSwVlvShTDrft" 577 "DSQ_AFS" 578 "DSQ_BattU" 579 "DSQ_BrkP" 580 "DSQ_CByVlvActr" 581 "DSQ_CEngDsT" 582 "DSQ_CEngUsT" 583 "DSQ_CThmstActr" 584 "DSQ_Com_aDirect" 585 "DSQ_Com_aSide" 586 "DSQ_Com_nTSC" 587 "DSQ_Com_pBrkSys" 588 "DSQ_Com_stButtonMSA" 589 "DSQ_Com_stClCtr" 590 "DSQ_Com_stDSC" 591 "DSQ_Com_stDecellDSC" 592 "DSQ_Com_stDrWghSeat" 593 "DSQ_Com_stGear" 594 "DSQ_Com_stKeyVld" 595 "DSQ_Com_stReqMSA" 596 "DSQ_Com_stT15" 597 "DSQ_Com_stT50" 598 "DSQ_Com_stTrqDSCDes" 599 "DSQ_Com_swtDrBltb" 600 "DSQ_Com_tEnvT" 601 "DSQ_Com_tGbxOil" 602 "DSQ_Com_trqAC" 603 "DSQ_Com_trqARSCur" 604 "DSQ_Com_trqARSDes" 605 "DSQ_Com_trqAvlAFS" 606 "DSQ_Com_trqDSCDes" 607 "DSQ_Com_trqGbxDes" 608 "DSQ_Com_trqGbxFrc" 609 "DSQ_Com_trqGbxMax" 610 "DSQ_Com_trqTarAFS" 611 "DSQ_Com_v" 612 "DSQ_Com_vBd" 613 "DSQ_DSMInhibitAlways" 614 "DSQ_ECBVlvActr" 615 "DSQ_ECBVlvSens" 616 "DSQ_EGRVlvActr" 617 "DSQ_EGRVlvSens" 618 "DSQ_EMDmp_0" 619 "DSQ_EMDmp_1" 620 "DSQ_EngPrtFWOsc" 621 "DSQ_EnvP" 622 "DSQ_EnvT" 623 "DSQ_FanActr" 624 "DSQ_FuelT" 625 "DSQ_LAYER2EDCMSAStp" 626 "DSQ_LSUO2_0" 627 "DSQ_LSUO2_1" 628 "DSQ_LSUO2_2" 629 "DSQ_LSUO2_3" 630 "DSQ_MeUnActr" 631 "DSQ_NSCDsRLamO2" 632 "DSQ_OilStSens" 633 "DSQ_OilT" 634 "DSQ_PAirFltDs" 635 "DSQ_PCACDs" 636 "DSQ_PCVActr" 637 "DSQ_PPFltUs" 638 "DSQ_TAFS" 639 "DSQ_TCACDs" 640 "DSQ_TECU" 641 "DSQ_TOxiCatUs" 642 "DSQ_TPFltUs" 643 "DSQ_ThrVlvActr" 644 "DSQ_ThrVlvSens" 645 "DSQ_TrbChActr" 646 "DSQ_TrbChLPActr" 647 "DSQ_TrbChSens" 648 "DSQ_TrbnDsRLamO2" 649 "DSQ_VSwVlvActr" 650 "DSQ_VSwVlvSens" 651 "DSQ_VehV" 652 "DSQ_WaHtElActr" 653 "DSQ_stAPP" 654 "DSQ_stAPP1" 655 "DSQ_stAPP2" 656 "DSQ_stLSUSrvTstDem" DEFAULT_VALUE "---" /end COMPU_VTAB
/begin COMPU_METHOD DINH_FIdVerb "" TAB_VERB "%2.1" "-" COMPU_TAB_REF DINH_FIdVerb /end COMPU_METHOD
/begin COMPU_VTAB DINH_FIdVerb "" TAB_VERB 414 0 "FId_Unused" 1 "FId_InhibitAlways" 2 "FId_CoordALS" 3 "FId_CoordFBC" 4 "FId_CoordTAA" 5 "FId_CoordZFC" 6 "FId_ACCtlTEngErr" 7 "FId_ACCtlTGearbxErr" 8 "FId_ACCtlVehVErr" 9 "FId_ACCtl_AC" 10 "FId_ACCtl_Fan" 11 "FId_AC_pAC" 12 "FId_AFS" 13 "FId_AFSActrTst" 14 "FId_AFSDrftMaxLim" 15 "FId_AFSFrzAirMs" 16 "FId_AFSPlOffsDrft" 17 "FId_AFSPlSetyDrft" 18 "FId_AFSSRC" 19 "FId_AFSSysErr" 20 "FId_AFSTPer" 21 "FId_APP1FinalDef" 22 "FId_APP1ProvDef" 23 "FId_APP1SRCHigh" 24 "FId_APP1SigPath" 25 "FId_APP2FinalDef" 26 "FId_APP2ProvDef" 27 "FId_APP2SRCHigh" 28 "FId_APP2SigPath" 29 "FId_APPBrkDef" 30 "FId_APPBrkPres" 31 "FId_APPNTP" 32 "FId_APPSyncChk" 33 "FId_APPSyncDef" 34 "FId_APPSyncProvDef" 35 "FId_APPSyncSigProv" 36 "FId_APPVel" 37 "FId_APProvDef" 38 "FId_ASDdc" 39 "FId_ASModNSC" 40 "FId_ASModOxiC" 41 "FId_ASModPipe" 42 "FId_ASModPipeSlw" 43 "FId_ASModPresCalc" 44 "FId_ASModPresEnv" 45 "FId_ASModStrt" 46 "FId_ASModSwtOffEng" 47 "FId_ASModSwtOffIndVol" 48 "FId_ASModTrbn" 49 "FId_AccPedNMaxLim" 50 "FId_AccPedNMinLim" 51 "FId_AccPedNMinLimBrkApp" 52 "FId_AccPedTrqLim" 53 "FId_AdcI_ADC0" 54 "FId_AirCClntPFrzVal" 55 "FId_AirCClntPPwmChk" 56 "FId_AirCClntPRplVal" 57 "FId_AirCSwt" 58 "FId_AirCtl" 59 "FId_AirCtlBstPresCor" 60 "FId_AirCtlCmpntActv" 61 "FId_AirCtlEGR" 62 "FId_AirCtlGear" 63 "FId_AirCtlGovDvt" 64 "FId_AirCtlPFltEGRRed" 65 "FId_AirCtlStrg" 66 "FId_AirCtlTVA" 67 "FId_BattUFrzVal" 68 "FId_BattUReplVal" 69 "FId_BattUSRC" 70 "FId_BrkP" 71 "FId_BrkPFrzVal" 72 "FId_BrkPReplVal" 73 "FId_CEngDsTCANFrzVal" 74 "FId_CEngDsTCANRplVal" 75 "FId_CEngDsTDynTst" 76 "FId_CEngDsTFrzVal" 77 "FId_CEngDsTModel" 78 "FId_CEngDsTRdClnt" 79 "FId_CEngDsTRplVal" 80 "FId_CEngDsTSS" 81 "FId_CEngUsTFrzVal" 82 "FId_CEngUsTReplVal" 83 "FId_CEngUsTSS" 84 "FId_Clth" 85 "FId_ClthCAN" 86 "FId_CmbChb" 87 "FId_CoETM" 88 "FId_CoEngNrml2Strt" 89 "FId_CoEngPthClsEGR" 90 "FId_CoEngPthClsThr" 91 "FId_CoEngPthCylOff" 92 "FId_CoEngPthETZr" 93 "FId_CoEngPthFlQnt" 94 "FId_CoEngPthInjVlvOff" 95 "FId_CoEngPthLpSysOff" 96 "FId_CoEngPthRPMin" 97 "FId_CoTS_SwtOff" 98 "FId_CoVehPrpLimErr" 99 "FId_ComAPP" 100 "FId_ComClth" 101 "FId_ComCoEng" 102 "FId_ComDscAck1" 103 "FId_ComDscAck2" 104 "FId_ComDscAck3" 105 "FId_ComDscTrqIntv" 106 "FId_ComEngDem" 107 "FId_ComGbxAck1" 108 "FId_ComGbxAck2" 109 "FId_ComGbxAck3" 110 "FId_ComGbxTrqIntv" 111 "FId_ComInjDu1" 112 "FId_ComInjDu2" 113 "FId_ComInjVlv" 114 "FId_ComMSA" 115 "FId_ComStBrkPedal" 116 "FId_ComStTrq" 117 "FId_ComnEng" 118 "FId_ComnSetPLo" 119 "FId_CompEnv" 120 "FId_ComrWaterVlv" 121 "FId_ConvLdNTrbnCan" 122 "FId_ConvLdOilTemp" 123 "FId_ConvLdTrqLdCan" 124 "FId_ConvLdVel" 125 "FId_CoordEGT" 126 "FId_CrCtl_irrev" 127 "FId_CrCtl_rev" 128 "FId_CtTSwtOff" 129 "FId_Cy100Dev1" 130 "FId_DCSRmpShOff" 131 "FId_DCSShOff" 132 "FId_DIOnumChip1Cj945" 133 "FId_DIUMPRGenDenom1" 134 "FId_DIUMPRGenDenom2" 135 "FId_DIUMPRGenDenom3" 136 "FId_DIUMPRIgn" 137 "FId_DSMWarmUpCycle" 138 "FId_DevLibActrPrt" 139 "FId_DewDetHtgDel" 140 "FId_ECBVlvFrzVal" 141 "FId_ECBVlvReplVal" 142 "FId_ECBVlvSS" 143 "FId_EGRClg" 144 "FId_EGRVlvActr" 145 "FId_EGRVlvFrzVal" 146 "FId_EGRVlvGovOn" 147 "FId_EGRVlvOfsLrnInhib" 148 "FId_EGRVlvReplVal" 149 "FId_EGRVlvSSpMon" 150 "FId_EGTRgnLck" 151 "FId_EMCtl" 152 "FId_ETClbCorActv" 153 "FId_ETCtlAirCtl" 154 "FId_ETCtlInr" 155 "FId_ETCtlOutr" 156 "FId_EngDemPFltErr" 157 "FId_EngDemTrqLimErr" 158 "FId_EngDemTrqLimErr1" 159 "FId_EngDemTrqLimErr2" 160 "FId_EngDemTrqLimErr3" 161 "FId_EngDemTrqLimErr4" 162 "FId_EngPrtEnvP" 163 "FId_EngPrtNLimErr" 164 "FId_EnvPCANFrzVal" 165 "FId_EnvPCANRplVal" 166 "FId_EnvPFrzVal" 167 "FId_EnvPModel" 168 "FId_EnvPRplVal" 169 "FId_EnvPSS" 170 "FId_EnvTCANFrzVal" 171 "FId_EnvTCANRplVal" 172 "FId_EnvTFrzVal" 173 "FId_EnvTModel" 174 "FId_EnvTRplVal" 175 "FId_EnvTSS" 176 "FId_EpmCaSDiag" 177 "FId_EpmCaSOfsDiag_I1" 178 "FId_EpmCaSOfsDiag_I2" 179 "FId_EpmCaSOfsDiag_O1" 180 "FId_EpmCaSOfsDiag_O2" 181 "FId_EpmCaSOfsDiag_SglCaSI1" 182 "FId_EpmCaSSegCor" 183 "FId_EpmCrSDiag" 184 "FId_EpmOpMode_InjLock" 185 "FId_FBC" 186 "FId_FanCtl" 187 "FId_FanCtlCor" 188 "FId_FanCtlCor2" 189 "FId_FanTraOil" 190 "FId_FansVelCor" 191 "FId_FlSysDens" 192 "FId_FrzPrtTrqDfftl" 193 "FId_FrzValPAirFltDs" 194 "FId_FrzValPPFltUs" 195 "FId_FrzValTOxiCatUs" 196 "FId_FrzValTPFltUs" 197 "FId_FuelTCTS" 198 "FId_FuelTFlSys" 199 "FId_FuelTFrzVal" 200 "FId_FuelTReplVal" 201 "FId_GbxNPos" 202 "FId_GbxNPosPWM" 203 "FId_GlbDaLSumvXPtd" 204 "FId_GlwCtl1" 205 "FId_HLSDemDfrstI" 206 "FId_HLSDemSetPLoDrvAwy" 207 "FId_HLSDemUndrBrk" 208 "FId_ISCnTrbnMod" 209 "FId_ISCvBd" 210 "FId_IVPSplyDCDCOff" 211 "FId_InhibitNever" 212 "FId_InjCrvCoErr" 213 "FId_InjCrvDisblPoI1" 214 "FId_InjCrvDisblPoI2" 215 "FId_InjSys_qLimErr" 216 "FId_InjSysqFuelT" 217 "FId_InjUnStrtPlsBlk" 218 "FId_InjVlvPresMin" 219 "FId_LSUAllChecks0" 220 "FId_LSUAllChecks1" 221 "FId_LSUClbSched" 222 "FId_LSUCmpChk0" 223 "FId_LSUCmpChk1" 224 "FId_LSUCtl0" 225 "FId_LSUCtl1" 226 "FId_LSUMon0" 227 "FId_LSUMon1" 228 "FId_LSUO20" 229 "FId_LSUO21" 230 "FId_LSURi0" 231 "FId_LSURi1" 232 "FId_LSUactiv0" 233 "FId_LSUactiv1" 234 "FId_LSUlsu0" 235 "FId_LSUlsu1" 236 "FId_MeUnFrzI" 237 "FId_MeUnRot" 238 "FId_NplPAirFltDs" 239 "FId_NplTOxiCatUs" 240 "FId_NplTPFltUs" 241 "FId_OilTCANFrzVal" 242 "FId_OilTCANRplVal" 243 "FId_OilTFrzVal" 244 "FId_OilTModel" 245 "FId_OilTNpl" 246 "FId_OilTRplVal" 247 "FId_OilTSS" 248 "FId_PAirFltDsCANFrzVal" 249 "FId_PAirFltDsCANRplVal" 250 "FId_PCACDsCANFrzVal" 251 "FId_PCACDsCANRplVal" 252 "FId_PCACDsEnvPPls" 253 "FId_PCACDsFrzVal" 254 "FId_PCACDsModel" 255 "FId_PCACDsRplVal" 256 "FId_PCACDsSS" 257 "FId_PCR" 258 "FId_PCRCByVlvOff" 259 "FId_PCRCmpntActv" 260 "FId_PCRCmpntActvLP" 261 "FId_PCRExtnLimActr" 262 "FId_PCRGovDvt" 263 "FId_PCRGovDvtLP" 264 "FId_PCRLP" 265 "FId_PCROfsRls" 266 "FId_PCRPFltPresCor" 267 "FId_PCVFrzI" 268 "FId_PCVPwrStgTst" 269 "FId_PFltAirSysFail" 270 "FId_PFltChar" 271 "FId_PFltDstr" 272 "FId_PFltLckRgnErr" 273 "FId_PFltLckRgnFl" 274 "FId_PFltLdSimRgnThr" 275 "FId_PFltPOpBrk" 276 "FId_PFltPOpClth" 277 "FId_PFltPOpGearDet" 278 "FId_PFltPOpSpdVeh" 279 "FId_PFltPOpTempAir" 280 "FId_PFltPOpTempClnt" 281 "FId_PFltPOpVltgBatt" 282 "FId_PFltPoI1Fail" 283 "FId_PFltPoI2Fail" 284 "FId_PFltRgnChngPar" 285 "FId_PFltSimOn" 286 "FId_PFltSrvRgnRlsEng" 287 "FId_PFltSrvRgnRlsPFlt" 288 "FId_PFltSysFail" 289 "FId_PTGripDebPtd" 290 "FId_PTTrqRatCANPtd" 291 "FId_PresSensFrzPPFltUs" 292 "FId_QWCCTSDef" 293 "FId_QWCFTSDef" 294 "FId_QWCOff" 295 "FId_RadShtCTS" 296 "FId_RadShtEGS" 297 "FId_RailCPCtlMeUnMode" 298 "FId_RailCPCtlPCVMode" 299 "FId_RailCtlMode" 300 "FId_RailFuelTErr" 301 "FId_RailMeUn0Blk" 302 "FId_RailMeUn0Rls" 303 "FId_RailMeUn1Blk" 304 "FId_RailMeUn1Rls" 305 "FId_RailMeUn2Blk" 306 "FId_RailMeUn2Rls" 307 "FId_RailMeUn3Blk" 308 "FId_RailMeUn3Rls" 309 "FId_RailMeUn4Blk" 310 "FId_RailMeUn4Rls" 311 "FId_RailMeUnCtlMode" 312 "FId_RailPCV0Blk" 313 "FId_RailPCV0Rls" 314 "FId_RailPCV1Blk" 315 "FId_RailPCV1Rls" 316 "FId_RailPCV2Blk" 317 "FId_RailPCV2Rls" 318 "FId_RailPCV3Blk" 319 "FId_RailPCV3Rls" 320 "FId_RailPCV4Blk" 321 "FId_RailPCV4Rls" 322 "FId_RailPCVCtlMode" 323 "FId_RailPFrzVal" 324 "FId_RailPMonStrt" 325 "FId_RailPSS" 326 "FId_RailPSubsVal" 327 "FId_RailSetPointLim" 328 "FId_RailSetPointRed" 329 "FId_ReplValTPFltUs" 330 "FId_RplValPAirFltDs" 331 "FId_RplValPPFltUs" 332 "FId_RplValTOxiCatUs" 333 "FId_SRCFlwRstn" 334 "FId_SSEStart" 335 "FId_SSEStartAST" 336 "FId_SSEStartMTClPressed10" 337 "FId_SSEStartMTClPressed90" 338 "FId_SSEStop" 339 "FId_SSEStopAST" 340 "FId_SSEStopMT" 341 "FId_SSPAirFltDs" 342 "FId_SSTOxiCatUs" 343 "FId_SSTPFltUs" 344 "FId_SensAdapTPFltUs" 345 "FId_StAPmp" 346 "FId_StDa" 347 "FId_SubsValPrtTrqDfftl" 348 "FId_SubsValRatTrqDfftl" 349 "FId_T15" 350 "FId_T50Sig" 351 "FId_TAFSFrzVal" 352 "FId_TAFSReplVal" 353 "FId_TAFSSRC" 354 "FId_TCACDsCANFrzVal" 355 "FId_TCACDsCANRplVal" 356 "FId_TCACDsFrzVal" 357 "FId_TCACDsModel" 358 "FId_TCACDsRplVal" 359 "FId_TCACDsSS" 360 "FId_TCPrtChrgPmpCtl" 361 "FId_TCPrtChrgPmpGov" 362 "FId_TCPrtChrgPmpHLSDem" 363 "FId_TCPrt_ChrgPmpDet" 364 "FId_TCSRmpShOff" 365 "FId_TCSShOff" 366 "FId_TECUFrzVal" 367 "FId_TECURplVal" 368 "FId_TOxiCatUs" 369 "FId_TempSensFrzPPFltUs" 370 "FId_ThrVlvFrzVal" 371 "FId_ThrVlvRplVal" 372 "FId_ThrVlvSS" 373 "FId_TraAddAirCANPtd" 374 "FId_TraAddClntCANPtd" 375 "FId_TraDrvAway" 376 "FId_TraDrvAwayInactiv" 377 "FId_TraGearInfoDet" 378 "FId_TraGearInfoInfoCan" 379 "FId_TraGearInfoLevPos" 380 "FId_TraGearInfoLoRng" 381 "FId_TraGearInfoRTra" 382 "FId_TraGearInfoRevGear" 383 "FId_TraGripDeb" 384 "FId_TraOilTemp" 385 "FId_TraPrtGearCANPtd" 386 "FId_TraRtnIntfcASTIntv" 387 "FId_TraRtnIntfcIdlSetP" 388 "FId_TraTrqLimErr" 389 "FId_TraTrqLos" 390 "FId_TraTrqRedLmpHmeDec" 391 "FId_TraTrqRedLmpHmeInc" 392 "FId_TraTrqRedPlausDecIntv" 393 "FId_TraTrqRedPlausIncIntv" 394 "FId_TrbChPWMIn" 395 "FId_VSwCtl" 396 "FId_VSwVlvFrzVal" 397 "FId_VSwVlvGovOn" 398 "FId_VSwVlvOfsLrnInhib" 399 "FId_VSwVlvOpnLd" 400 "FId_VSwVlvRplVal" 401 "FId_VSwVlvSS" 402 "FId_VehMotvBd" 403 "FId_VehVCANFrzVal" 404 "FId_VehVCANReplVal" 405 "FId_VehVFrzVal" 406 "FId_VehVMon" 407 "FId_VehVReplVal" 408 "FId_ZFCClbActv" 409 "FId_ZFCCldCmbCham" 410 "FId_stAVSCoESLSU" 411 "Fid_HLSDemHDC" 412 "Fid_StSysStrtTipGbxDat" 413 "Fid_WaHtShOffErr" DEFAULT_VALUE "---" /end COMPU_VTAB
/begin RECORD_LAYOUT ValA_Wu16 FNC_VALUES 1 UWORD COLUMN_DIR DIRECT /end RECORD_LAYOUT
/end MODULE
/end PROJECT
