ASAP2_VERSION 1 3
/begin PROJECT P390 "BMW DDE6.2 6-Zylinder VP0.1 11.11.2003 CAN12H"
/begin HEADER "" VERSION "VP01_6Z_CAN12H" PROJECT_NO P390 /end HEADER
/begin MODULE DIM ""
/begin MOD_COMMON "" BYTE_ORDER MSB_FIRST ALIGNMENT_BYTE 1 ALIGNMENT_WORD 2 ALIGNMENT_LONG 4 ALIGNMENT_FLOAT32_IEEE 4 /end MOD_COMMON
/begin CHARACTERISTIC DSM_SdwDfp_Layer_TANS_C "Enprellzeit Shadow Zustand für Fehlerpfad Dfp_Layer_TANS" VALUE 0xCBFE8 Kw_Wu16 655350.0 Time_ms 0.00 655350.0 FORMAT "%8.1" /end CHARACTERISTIC
/begin CHARACTERISTIC DSM_SdwDfp_ACCDSwtin_C "Enprellzeit Shadow Zustand für Fehlerpfad Dfp_ACCDSwtin" VALUE 0xCBFEA Kw_Wu16 655350.0 Time_ms 0.00 655350.0 FORMAT "%8.1" /end CHARACTERISTIC
/begin CHARACTERISTIC DSM_SdwDfp_ACC_PlausTrqDes_C "Enprellzeit Shadow Zustand für Fehlerpfad Dfp_ACC_PlausTrqDes" VALUE 0xCBFEC Kw_Wu16 655350.0 Time_ms 0.00 655350.0 FORMAT "%8.1" /end CHARACTERISTIC
/begin CHARACTERISTIC DSM_SdwDfp_ACC_trqInr_C "Enprellzeit Shadow Zustand für Fehlerpfad Dfp_ACC_trqInr" VALUE 0xCBFEE Kw_Wu16 655350.0 Time_ms 0.00 655350.0 FORMAT "%8.1" /end CHARACTERISTIC
/begin CHARACTERISTIC DSM_SdwDfp_ACTrq_C "Enprellzeit Shadow Zustand für Fehlerpfad Dfp_ACTrq" VALUE 0xCBFF0 Kw_Wu16 655350.0 Time_ms 0.00 655350.0 FORMAT "%8.1" /end CHARACTERISTIC
/begin CHARACTERISTIC DSM_SdwDfp_ADCMon_C "Enprellzeit Shadow Zustand für Fehlerpfad Dfp_ADCMon" VALUE 0xCBFF2 Kw_Wu16 655350.0 Time_ms 0.00 655350.0 FORMAT "%8.1" /end CHARACTERISTIC
/begin CHARACTERISTIC DSM_SdwDfp_AFSCDIdlAdjVal_C "Enprellzeit Shadow Zustand für Fehlerpfad Dfp_AFSCDIdlAdjVal" VALUE 0xCBFF4 Kw_Wu16 655350.0 Time_ms 0.00 655350.0 FORMAT "%8.1" /end CHARACTERISTIC
/begin CHARACTERISTIC DSM_SdwDfp_AFSCDLdAdjVal_C "Enprellzeit Shadow Zustand für Fehlerpfad Dfp_AFSCDLdAdjVal" VALUE 0xCBFF6 Kw_Wu16 655350.0 Time_ms 0.00 655350.0 FORMAT "%8.1" /end CHARACTERISTIC
/begin CHARACTERISTIC DSM_SdwDfp_AFSCD_AirTempDcyc_C "Enprellzeit Shadow Zustand für Fehlerpfad Dfp_AFSCD_AirTempDcyc" VALUE 0xCBFF8 Kw_Wu16 655350.0 Time_ms 0.00 655350.0 FORMAT "%8.1" /end CHARACTERISTIC
/begin CHARACTERISTIC DSM_SdwDfp_AFSCD_PlOffsDrft_C "Enprellzeit Shadow Zustand für Fehlerpfad Dfp_AFSCD_PlOffsDrft" VALUE 0xCBFFA Kw_Wu16 655350.0 Time_ms 0.00 655350.0 FORMAT "%8.1" /end CHARACTERISTIC
/begin CHARACTERISTIC DSM_SdwDfp_AFSCD_PlSetyDrft_C "Enprellzeit Shadow Zustand für Fehlerpfad Dfp_AFSCD_PlSetyDrft" VALUE 0xCBFFC Kw_Wu16 655350.0 Time_ms 0.00 655350.0 FORMAT "%8.1" /end CHARACTERISTIC
/begin CHARACTERISTIC DSM_SdwDfp_AFSCD_SRCAirTemp_C "Enprellzeit Shadow Zustand für Fehlerpfad Dfp_AFSCD_SRCAirTemp" VALUE 0xCBFFE Kw_Wu16 655350.0 Time_ms 0.00 655350.0 FORMAT "%8.1" /end CHARACTERISTIC
/begin CHARACTERISTIC DSM_SdwDfp_AFSCD_SRCBatt_C "Enprellzeit Shadow Zustand für Fehlerpfad Dfp_AFSCD_SRCBatt" VALUE 0xCC000 Kw_Wu16 655350.0 Time_ms 0.00 655350.0 FORMAT "%8.1" /end CHARACTERISTIC
/begin CHARACTERISTIC DSM_SdwDfp_AFSCD_SRCCorrAirm_C "Enprellzeit Shadow Zustand für Fehlerpfad Dfp_AFSCD_SRCCorrAirm" VALUE 0xCC002 Kw_Wu16 655350.0 Time_ms 0.00 655350.0 FORMAT "%8.1" /end CHARACTERISTIC
/begin CHARACTERISTIC DSM_SdwDfp_AFSCD_SRCRawAirm_C "Enprellzeit Shadow Zustand für Fehlerpfad Dfp_AFSCD_SRCRawAirm" VALUE 0xCC004 Kw_Wu16 655350.0 Time_ms 0.00 655350.0 FORMAT "%8.1" /end CHARACTERISTIC
/begin CHARACTERISTIC DSM_SdwDfp_AFSCD_SRCRefSigPer_C "Enprellzeit Shadow Zustand für Fehlerpfad Dfp_AFSCD_SRCRefSigPer" VALUE 0xCC006 Kw_Wu16 655350.0 Time_ms 0.00 655350.0 FORMAT "%8.1" /end CHARACTERISTIC
/begin CHARACTERISTIC DSM_SdwDfp_AOHtCD_C "Enprellzeit Shadow Zustand für Fehlerpfad Dfp_AOHtCD" VALUE 0xCC008 Kw_Wu16 655350.0 Time_ms 0.00 655350.0 FORMAT "%8.1" /end CHARACTERISTIC
/begin CHARACTERISTIC DSM_SdwDfp_AOHtCD_AOHtDia1_C "Enprellzeit Shadow Zustand für Fehlerpfad Dfp_AOHtCD_AOHtDia1" VALUE 0xCC00A Kw_Wu16 655350.0 Time_ms 0.00 655350.0 FORMAT "%8.1" /end CHARACTERISTIC
/begin CHARACTERISTIC DSM_SdwDfp_AOHtCD_AOHtDia2_C "Enprellzeit Shadow Zustand für Fehlerpfad Dfp_AOHtCD_AOHtDia2" VALUE 0xCC00C Kw_Wu16 655350.0 Time_ms 0.00 655350.0 FORMAT "%8.1" /end CHARACTERISTIC
/begin CHARACTERISTIC DSM_SdwDfp_Layer_TUMG_C "Enprellzeit Shadow Zustand für Fehlerpfad Dfp_Layer_TUMG" VALUE 0xCC00E Kw_Wu16 655350.0 Time_ms 0.00 655350.0 FORMAT "%8.1" /end CHARACTERISTIC
/begin CHARACTERISTIC DSM_SdwDfp_AOHtCD_AOHtDia3_C "Enprellzeit Shadow Zustand für Fehlerpfad Dfp_AOHtCD_AOHtDia3" VALUE 0xCC010 Kw_Wu16 655350.0 Time_ms 0.00 655350.0 FORMAT "%8.1" /end CHARACTERISTIC
/begin CHARACTERISTIC DSM_SdwDfp_APP1_C "Enprellzeit Shadow Zustand für Fehlerpfad Dfp_APP1" VALUE 0xCC012 Kw_Wu16 655350.0 Time_ms 0.00 655350.0 FORMAT "%8.1" /end CHARACTERISTIC
/begin CHARACTERISTIC DSM_SdwDfp_Layer_GEN_C "Enprellzeit Shadow Zustand für Fehlerpfad Dfp_Layer_GEN" VALUE 0xCC014 Kw_Wu16 655350.0 Time_ms 0.00 655350.0 FORMAT "%8.1" /end CHARACTERISTIC
/begin CHARACTERISTIC DSM_SdwDfp_Layer_BSD_C "Enprellzeit Shadow Zustand für Fehlerpfad Dfp_Layer_BSD" VALUE 0xCC016 Kw_Wu16 655350.0 Time_ms 0.00 655350.0 FORMAT "%8.1" /end CHARACTERISTIC
/begin CHARACTERISTIC DSM_SdwDfp_APP2_C "#SSD Enprellzeit Shadow Zustand für Fehlerpfad Dfp_APP2" VALUE 0xCC018 Kw_Wu16 655350.0 Time_ms 0.00 655350.0 FORMAT "%8.1" /end CHARACTERISTIC
/begin CHARACTERISTIC DSM_SdwDfp_APSCD_C "Enprellzeit Shadow Zustand für Fehlerpfad Dfp_APSCD" VALUE 0xCC01A Kw_Wu16 655350.0 Time_ms 0.00 655350.0 FORMAT "%8.1" /end CHARACTERISTIC
/begin CHARACTERISTIC DSM_SdwDfp_ARS_C "Enprellzeit Shadow Zustand für Fehlerpfad Dfp_ARS" VALUE 0xCC01C Kw_Wu16 655350.0 Time_ms 0.00 655350.0 FORMAT "%8.1" /end CHARACTERISTIC
/begin CHARACTERISTIC DSM_SdwDfp_AccPedPlausBrk_C "Enprellzeit Shadow Zustand für Fehlerpfad Dfp_AccPedPlausBrk" VALUE 0xCC01E Kw_Wu16 655350.0 Time_ms 0.00 655350.0 FORMAT "%8.1" /end CHARACTERISTIC
/begin CHARACTERISTIC DSM_SdwDfp_AirCtlPlateBreak_C "DSM variable for Dfp_AirCtlPlateBreak_mp" VALUE 0xCC020 Kw_Wu16 655350.0 Time_ms 0.00 655350.0 FORMAT "%8.1" /end CHARACTERISTIC
/begin CHARACTERISTIC DSM_SdwDfp_AirCtl_GovNegDev_C "Enprellzeit Shadow Zustand für Fehlerpfad Dfp_AirCtl_GovNegDev" VALUE 0xCC022 Kw_Wu16 655350.0 Time_ms 0.00 655350.0 FORMAT "%8.1" /end CHARACTERISTIC
/begin CHARACTERISTIC DSM_SdwDfp_AirCtl_GovNegDev2_C "Enprellzeit Shadow Zustand für Fehlerpfad Dfp_AirCtl_GovNegDev2" VALUE 0xCC024 Kw_Wu16 655350.0 Time_ms 0.00 655350.0 FORMAT "%8.1" /end CHARACTERISTIC
/begin CHARACTERISTIC DSM_SdwDfp_AirCtl_GovPosDev_C "Enprellzeit Shadow Zustand für Fehlerpfad Dfp_AirCtl_GovPosDev" VALUE 0xCC026 Kw_Wu16 655350.0 Time_ms 0.00 655350.0 FORMAT "%8.1" /end CHARACTERISTIC
/begin CHARACTERISTIC DSM_SdwDfp_AirCtl_GovPosDev2_C "Enprellzeit Shadow Zustand für Fehlerpfad Dfp_AirCtl_GovPosDev2" VALUE 0xCC028 Kw_Wu16 655350.0 Time_ms 0.00 655350.0 FORMAT "%8.1" /end CHARACTERISTIC
/begin CHARACTERISTIC DSM_SdwDfp_AltCD_C "Enprellzeit Shadow Zustand für Fehlerpfad Dfp_AltCD" VALUE 0xCC02A Kw_Wu16 655350.0 Time_ms 0.00 655350.0 FORMAT "%8.1" /end CHARACTERISTIC
/begin CHARACTERISTIC DSM_SdwDfp_Layer_QLT_C "Enprellzeit Shadow Zustand für Fehlerpfad Dfp_Layer_QLT" VALUE 0xCC02C Kw_Wu16 655350.0 Time_ms 0.00 655350.0 FORMAT "%8.1" /end CHARACTERISTIC
/begin CHARACTERISTIC DSM_SdwDfp_BPACD_BPADia1_C "Enprellzeit Shadow Zustand für Fehlerpfad Dfp_BPACD_BPADia1" VALUE 0xCC02E Kw_Wu16 655350.0 Time_ms 0.00 655350.0 FORMAT "%8.1" /end CHARACTERISTIC
/begin CHARACTERISTIC DSM_SdwDfp_Layer_IBS1_C "Enprellzeit Shadow Zustand für Fehlerpfad Dfp_Layer_IBS1" VALUE 0xCC030 Kw_Wu16 655350.0 Time_ms 0.00 655350.0 FORMAT "%8.1" /end CHARACTERISTIC
/begin CHARACTERISTIC DSM_SdwDfp_Layer_IBS2_C "Enprellzeit Shadow Zustand für Fehlerpfad Dfp_Layer_IBS2" VALUE 0xCC032 Kw_Wu16 655350.0 Time_ms 0.00 655350.0 FORMAT "%8.1" /end CHARACTERISTIC
/begin CHARACTERISTIC DSM_SdwDfp_Layer_IBS3_C "Enprellzeit Shadow Zustand für Fehlerpfad Dfp_Layer_IBS3" VALUE 0xCC034 Kw_Wu16 655350.0 Time_ms 0.00 655350.0 FORMAT "%8.1" /end CHARACTERISTIC
/begin CHARACTERISTIC DSM_SdwDfp_Layer_PMBN_C "Enprellzeit Shadow Zustand für Fehlerpfad Dfp_Layer_PMBN" VALUE 0xCC036 Kw_Wu16 655350.0 Time_ms 0.00 655350.0 FORMAT "%8.1" /end CHARACTERISTIC
/begin CHARACTERISTIC DSM_SdwDfp_Layer_PMBATT_C "Enprellzeit Shadow Zustand für Fehlerpfad Dfp_Layer_PMBATT" VALUE 0xCC038 Kw_Wu16 655350.0 Time_ms 0.00 655350.0 FORMAT "%8.1" /end CHARACTERISTIC
/begin CHARACTERISTIC DSM_SdwDfp_BPACD_BPADia2_C "Enprellzeit Shadow Zustand für Fehlerpfad Dfp_BPACD_BPADia2" VALUE 0xCC03A Kw_Wu16 655350.0 Time_ms 0.00 655350.0 FORMAT "%8.1" /end CHARACTERISTIC
/begin CHARACTERISTIC DSM_SdwDfp_BPACD_BPADia3_C "Enprellzeit Shadow Zustand für Fehlerpfad Dfp_BPACD_BPADia3" VALUE 0xCC03C Kw_Wu16 655350.0 Time_ms 0.00 655350.0 FORMAT "%8.1" /end CHARACTERISTIC
/begin CHARACTERISTIC DSM_SdwDfp_BPACD_Max_C "Enprellzeit Shadow Zustand für Fehlerpfad Dfp_BPACD_Max" VALUE 0xCC03E Kw_Wu16 655350.0 Time_ms 0.00 655350.0 FORMAT "%8.1" /end CHARACTERISTIC
/begin CHARACTERISTIC DSM_SdwDfp_BPACD_Min_C "Enprellzeit Shadow Zustand für Fehlerpfad Dfp_BPACD_Min" VALUE 0xCC040 Kw_Wu16 655350.0 Time_ms 0.00 655350.0 FORMAT "%8.1" /end CHARACTERISTIC
/begin CHARACTERISTIC DSM_SdwDfp_BPACD_SigNpl_C "Enprellzeit Shadow Zustand für Fehlerpfad Dfp_BPACD_SigNpl" VALUE 0xCC042 Kw_Wu16 655350.0 Time_ms 0.00 655350.0 FORMAT "%8.1" /end CHARACTERISTIC
/begin CHARACTERISTIC DSM_SdwDfp_BPSCD_C "Enprellzeit Shadow Zustand für Fehlerpfad Dfp_BPSCD" VALUE 0xCC044 Kw_Wu16 655350.0 Time_ms 0.00 655350.0 FORMAT "%8.1" /end CHARACTERISTIC
/begin CHARACTERISTIC DSM_SdwDfp_BattCD_C "Enprellzeit Shadow Zustand für Fehlerpfad Dfp_BattCD" VALUE 0xCC046 Kw_Wu16 655350.0 Time_ms 0.00 655350.0 FORMAT "%8.1" /end CHARACTERISTIC
/begin CHARACTERISTIC DSM_SdwDfp_BrkCD_C "Enprellzeit Shadow Zustand für Fehlerpfad Dfp_BrkCD" VALUE 0xCC048 Kw_Wu16 655350.0 Time_ms 0.00 655350.0 FORMAT "%8.1" /end CHARACTERISTIC
/begin CHARACTERISTIC DSM_SdwDfp_Bss_C "Enprellzeit Shadow Zustand für Fehlerpfad Dfp_Bss" VALUE 0xCC04A Kw_Wu16 655350.0 Time_ms 0.00 655350.0 FORMAT "%8.1" /end CHARACTERISTIC
/begin CHARACTERISTIC DSM_SdwDfp_CBACD_C "Enprellzeit Shadow Zustand für Fehlerpfad Dfp_CBACD" VALUE 0xCC04C Kw_Wu16 655350.0 Time_ms 0.00 655350.0 FORMAT "%8.1" /end CHARACTERISTIC
/begin CHARACTERISTIC DSM_SdwDfp_CTSCD_C "Enprellzeit Shadow Zustand für Fehlerpfad Dfp_CTSCD" VALUE 0xCC04E Kw_Wu16 655350.0 Time_ms 0.00 655350.0 FORMAT "%8.1" /end CHARACTERISTIC
/begin CHARACTERISTIC DSM_SdwDfp_Clg_DynTst_C "Enprellzeit Shadow Zustand für Fehlerpfad Dfp_Clg_DynTst" VALUE 0xCC050 Kw_Wu16 655350.0 Time_ms 0.00 655350.0 FORMAT "%8.1" /end CHARACTERISTIC
/begin CHARACTERISTIC DSM_SdwDfp_CmbChbMisfire1_C "Enprellzeit Shadow Zustand für Fehlerpfad Dfp_CmbChbMisfire1" VALUE 0xCC052 Kw_Wu16 655350.0 Time_ms 0.00 655350.0 FORMAT "%8.1" /end CHARACTERISTIC
/begin CHARACTERISTIC DSM_SdwDfp_CmbChbMisfire2_C "Enprellzeit Shadow Zustand für Fehlerpfad Dfp_CmbChbMisfire2" VALUE 0xCC054 Kw_Wu16 655350.0 Time_ms 0.00 655350.0 FORMAT "%8.1" /end CHARACTERISTIC
/begin CHARACTERISTIC DSM_SdwDfp_CmbChbMisfire3_C "Enprellzeit Shadow Zustand für Fehlerpfad Dfp_CmbChbMisfire3" VALUE 0xCC056 Kw_Wu16 655350.0 Time_ms 0.00 655350.0 FORMAT "%8.1" /end CHARACTERISTIC
/begin CHARACTERISTIC DSM_SdwDfp_CmbChbMisfire4_C "Enprellzeit Shadow Zustand für Fehlerpfad Dfp_CmbChbMisfire4" VALUE 0xCC058 Kw_Wu16 655350.0 Time_ms 0.00 655350.0 FORMAT "%8.1" /end CHARACTERISTIC
/begin CHARACTERISTIC DSM_SdwDfp_CmbChbMisfire5_C "Enprellzeit Shadow Zustand für Fehlerpfad Dfp_CmbChbMisfire5" VALUE 0xCC05A Kw_Wu16 655350.0 Time_ms 0.00 655350.0 FORMAT "%8.1" /end CHARACTERISTIC
/begin CHARACTERISTIC DSM_SdwDfp_CmbChbMisfire6_C "Enprellzeit Shadow Zustand für Fehlerpfad Dfp_CmbChbMisfire6" VALUE 0xCC05C Kw_Wu16 655350.0 Time_ms 0.00 655350.0 FORMAT "%8.1" /end CHARACTERISTIC
/begin CHARACTERISTIC DSM_SdwDfp_CmbChbMisfireMul_C "Enprellzeit Shadow Zustand für Fehlerpfad Dfp_CmbChbMisfireMul" VALUE 0xCC05E Kw_Wu16 655350.0 Time_ms 0.00 655350.0 FORMAT "%8.1" /end CHARACTERISTIC
/begin CHARACTERISTIC DSM_SdwDfp_CoVMDCSh_C "Enprellzeit Shadow Zustand für Fehlerpfad Dfp_CoVMDCSh" VALUE 0xCC060 Kw_Wu16 655350.0 Time_ms 0.00 655350.0 FORMAT "%8.1" /end CHARACTERISTIC
/begin CHARACTERISTIC DSM_SdwDfp_ConvCD_C "Enprellzeit Shadow Zustand für Fehlerpfad Dfp_ConvCD" VALUE 0xCC062 Kw_Wu16 655350.0 Time_ms 0.00 655350.0 FORMAT "%8.1" /end CHARACTERISTIC
/begin CHARACTERISTIC DSM_SdwDfp_CrCCDMFL_C "Enprellzeit Shadow Zustand für Fehlerpfad Dfp_CrCCDMFL" VALUE 0xCC064 Kw_Wu16 655350.0 Time_ms 0.00 655350.0 FORMAT "%8.1" /end CHARACTERISTIC
/begin CHARACTERISTIC DSM_SdwDfp_CrCtl_vCrCtl_C "Enprellzeit Shadow Zustand für Fehlerpfad Dfp_CrCtl_vCrCtl" VALUE 0xCC066 Kw_Wu16 655350.0 Time_ms 0.00 655350.0 FORMAT "%8.1" /end CHARACTERISTIC
/begin CHARACTERISTIC DSM_SdwDfp_Dummy1_C "Enprellzeit Shadow Zustand für Fehlerpfad Dfp_Dummy1" VALUE 0xCC068 Kw_Wu16 655350.0 Time_ms 0.00 655350.0 FORMAT "%8.1" /end CHARACTERISTIC
/begin CHARACTERISTIC DSM_SdwDfp_EATSCD_C "Enprellzeit Shadow Zustand für Fehlerpfad Dfp_EATSCD" VALUE 0xCC06A Kw_Wu16 655350.0 Time_ms 0.00 655350.0 FORMAT "%8.1" /end CHARACTERISTIC
/begin CHARACTERISTIC DSM_SdwDfp_EBAFCD_C "Enprellzeit Shadow Zustand für Fehlerpfad Dfp_EBAFCD" VALUE 0xCC06C Kw_Wu16 655350.0 Time_ms 0.00 655350.0 FORMAT "%8.1" /end CHARACTERISTIC
/begin CHARACTERISTIC DSM_SdwDfp_EBFCD_C "Enprellzeit Shadow Zustand für Fehlerpfad Dfp_EBFCD" VALUE 0xCC06E Kw_Wu16 655350.0 Time_ms 0.00 655350.0 FORMAT "%8.1" /end CHARACTERISTIC
/begin CHARACTERISTIC DSM_SdwDfp_EBTSCD_C "Enprellzeit Shadow Zustand für Fehlerpfad Dfp_EBTSCD" VALUE 0xCC070 Kw_Wu16 655350.0 Time_ms 0.00 655350.0 FORMAT "%8.1" /end CHARACTERISTIC
/begin CHARACTERISTIC DSM_SdwDfp_EBTSCD_OvrTemp_C "Enprellzeit Shadow Zustand für Fehlerpfad Dfp_EBTSCD_OvrTemp" VALUE 0xCC072 Kw_Wu16 655350.0 Time_ms 0.00 655350.0 FORMAT "%8.1" /end CHARACTERISTIC
/begin CHARACTERISTIC DSM_SdwDfp_EEPCDVarMng_C "Enprellzeit Shadow Zustand für Fehlerpfad Dfp_EEPCDVarMng" VALUE 0xCC074 Kw_Wu16 655350.0 Time_ms 0.00 655350.0 FORMAT "%8.1" /end CHARACTERISTIC
/begin CHARACTERISTIC DSM_SdwDfp_EGPpCD_C "Enprellzeit Shadow Zustand für Fehlerpfad Dfp_EGPpCD" VALUE 0xCC076 Kw_Wu16 655350.0 Time_ms 0.00 655350.0 FORMAT "%8.1" /end CHARACTERISTIC
/begin CHARACTERISTIC DSM_SdwDfp_EGPpCDTPreTrbn_C "Enprellzeit Shadow Zustand für Fehlerpfad Dfp_EgPpCDTPreTrbn" VALUE 0xCC078 Kw_Wu16 655350.0 Time_ms 0.00 655350.0 FORMAT "%8.1" /end CHARACTERISTIC
/begin CHARACTERISTIC DSM_SdwDfp_Layer_PMRUHVERL_C "" VALUE 0xCC07A Kw_Wu16 655350.0 Time_ms 0.00 655350.0 FORMAT "%8.1" /end CHARACTERISTIC
/begin CHARACTERISTIC DSM_SdwDfp_EGRCD_Max_C "Enprellzeit Shadow Zustand für Fehlerpfad Dfp_EGRCD_Max" VALUE 0xCC07C Kw_Wu16 655350.0 Time_ms 0.00 655350.0 FORMAT "%8.1" /end CHARACTERISTIC
/begin CHARACTERISTIC DSM_SdwDfp_EGRCD_Min_C "Enprellzeit Shadow Zustand für Fehlerpfad Dfp_EGRCD_Min" VALUE 0xCC07E Kw_Wu16 655350.0 Time_ms 0.00 655350.0 FORMAT "%8.1" /end CHARACTERISTIC
/begin CHARACTERISTIC DSM_SdwDfp_EGRCD_SigNpl_C "Enprellzeit Shadow Zustand für Fehlerpfad Dfp_EGRCD_SigNpl" VALUE 0xCC080 Kw_Wu16 655350.0 Time_ms 0.00 655350.0 FORMAT "%8.1" /end CHARACTERISTIC
/begin CHARACTERISTIC DSM_SdwDfp_EGTRgnOilDil_C "Enprellzeit Shadow Zustand für Fehlerpfad Dfp_EGTRgnOilDil" VALUE 0xCC082 Kw_Wu16 655350.0 Time_ms 0.00 655350.0 FORMAT "%8.1" /end CHARACTERISTIC
/begin CHARACTERISTIC DSM_SdwDfp_Layer_TOENS_C "" VALUE 0xCC084 Kw_Wu16 655350.0 Time_ms 0.00 655350.0 FORMAT "%8.1" /end CHARACTERISTIC
/begin CHARACTERISTIC DSM_SdwDfp_Layer_MANHYDR_C "" VALUE 0xCC086 Kw_Wu16 655350.0 Time_ms 0.00 655350.0 FORMAT "%8.1" /end CHARACTERISTIC
/begin CHARACTERISTIC DSM_SdwDfp_Layer_MANLUFT_C "" VALUE 0xCC088 Kw_Wu16 655350.0 Time_ms 0.00 655350.0 FORMAT "%8.1" /end CHARACTERISTIC
/begin CHARACTERISTIC DSM_SdwDfp_ETClbETFltInj1_C "Enprellzeit Shadow Zustand für Fehlerpfad Dfp_ETClbETFltInj1" VALUE 0xCC08A Kw_Wu16 655350.0 Time_ms 0.00 655350.0 FORMAT "%8.1" /end CHARACTERISTIC
/begin CHARACTERISTIC DSM_SdwDfp_ETClbETFltInj2_C "Enprellzeit Shadow Zustand für Fehlerpfad Dfp_ETClbETFltInj2" VALUE 0xCC08C Kw_Wu16 655350.0 Time_ms 0.00 655350.0 FORMAT "%8.1" /end CHARACTERISTIC
/begin CHARACTERISTIC DSM_SdwDfp_ETClbETFltInj3_C "Enprellzeit Shadow Zustand für Fehlerpfad Dfp_ETClbETFltInj3" VALUE 0xCC08E Kw_Wu16 655350.0 Time_ms 0.00 655350.0 FORMAT "%8.1" /end CHARACTERISTIC
/begin CHARACTERISTIC DSM_SdwDfp_ETClbETFltInj4_C "Enprellzeit Shadow Zustand für Fehlerpfad Dfp_ETClbETFltInj4" VALUE 0xCC090 Kw_Wu16 655350.0 Time_ms 0.00 655350.0 FORMAT "%8.1" /end CHARACTERISTIC
/begin CHARACTERISTIC DSM_SdwDfp_ETClbETFltInj5_C "Enprellzeit Shadow Zustand für Fehlerpfad Dfp_ETClbETFltInj5" VALUE 0xCC092 Kw_Wu16 655350.0 Time_ms 0.00 655350.0 FORMAT "%8.1" /end CHARACTERISTIC
/begin CHARACTERISTIC DSM_SdwDfp_ETClbETFltInj6_C "Enprellzeit Shadow Zustand für Fehlerpfad Dfp_ETClbETFltInj6" VALUE 0xCC094 Kw_Wu16 655350.0 Time_ms 0.00 655350.0 FORMAT "%8.1" /end CHARACTERISTIC
/begin CHARACTERISTIC DSM_SdwDfp_ETClbInj1_C "Enprellzeit Shadow Zustand für Fehlerpfad Dfp_ETClbInj1" VALUE 0xCC096 Kw_Wu16 655350.0 Time_ms 0.00 655350.0 FORMAT "%8.1" /end CHARACTERISTIC
/begin CHARACTERISTIC DSM_SdwDfp_ETClbInj2_C "Enprellzeit Shadow Zustand für Fehlerpfad Dfp_ETClbInj2" VALUE 0xCC098 Kw_Wu16 655350.0 Time_ms 0.00 655350.0 FORMAT "%8.1" /end CHARACTERISTIC
/begin CHARACTERISTIC DSM_SdwDfp_ETClbInj3_C "Enprellzeit Shadow Zustand für Fehlerpfad Dfp_ETClbInj3" VALUE 0xCC09A Kw_Wu16 655350.0 Time_ms 0.00 655350.0 FORMAT "%8.1" /end CHARACTERISTIC
/begin CHARACTERISTIC DSM_SdwDfp_ETClbInj4_C "Enprellzeit Shadow Zustand für Fehlerpfad Dfp_ETClbInj4" VALUE 0xCC09C Kw_Wu16 655350.0 Time_ms 0.00 655350.0 FORMAT "%8.1" /end CHARACTERISTIC
/begin CHARACTERISTIC DSM_SdwDfp_ETClbInj5_C "Enprellzeit Shadow Zustand für Fehlerpfad Dfp_ETClbInj5" VALUE 0xCC09E Kw_Wu16 655350.0 Time_ms 0.00 655350.0 FORMAT "%8.1" /end CHARACTERISTIC
/begin CHARACTERISTIC DSM_SdwDfp_ETClbInj6_C "Enprellzeit Shadow Zustand für Fehlerpfad Dfp_ETClbInj6" VALUE 0xCC0A0 Kw_Wu16 655350.0 Time_ms 0.00 655350.0 FORMAT "%8.1" /end CHARACTERISTIC
/begin CHARACTERISTIC DSM_SdwDfp_EngMCaS1_C "Enprellzeit Shadow Zustand für Fehlerpfad Dfp_EngMCaS1" VALUE 0xCC0A2 Kw_Wu16 655350.0 Time_ms 0.00 655350.0 FORMAT "%8.1" /end CHARACTERISTIC
/begin CHARACTERISTIC DSM_SdwDfp_EngMCrS1_C "Enprellzeit Shadow Zustand für Fehlerpfad Dfp_EngMCrS1" VALUE 0xCC0A4 Kw_Wu16 655350.0 Time_ms 0.00 655350.0 FORMAT "%8.1" /end CHARACTERISTIC
/begin CHARACTERISTIC DSM_SdwDfp_EngMOfsCaSCrS_C "Enprellzeit Shadow Zustand für Fehlerpfad Dfp_EngMOfsCaSCrS" VALUE 0xCC0A6 Kw_Wu16 655350.0 Time_ms 0.00 655350.0 FORMAT "%8.1" /end CHARACTERISTIC
/begin CHARACTERISTIC DSM_SdwDfp_EngMntCtl1_Dia1_C "" VALUE 0xCC0A8 Kw_Wu16 655350.0 Time_ms 0.00 655350.0 FORMAT "%8.1" /end CHARACTERISTIC
/begin CHARACTERISTIC DSM_SdwDfp_EngMntCtl1_Dia2_C "" VALUE 0xCC0AA Kw_Wu16 655350.0 Time_ms 0.00 655350.0 FORMAT "%8.1" /end CHARACTERISTIC
/begin CHARACTERISTIC DSM_SdwDfp_EngMntCtl1_Dia3_C "" VALUE 0xCC0AC Kw_Wu16 655350.0 Time_ms 0.00 655350.0 FORMAT "%8.1" /end CHARACTERISTIC
/begin CHARACTERISTIC DSM_SdwDfp_EngMntCtl1_Max_C "" VALUE 0xCC0AE Kw_Wu16 655350.0 Time_ms 0.00 655350.0 FORMAT "%8.1" /end CHARACTERISTIC
/begin CHARACTERISTIC DSM_SdwDfp_EngMntCtl1_Min_C "" VALUE 0xCC0B0 Kw_Wu16 655350.0 Time_ms 0.00 655350.0 FORMAT "%8.1" /end CHARACTERISTIC
/begin CHARACTERISTIC DSM_SdwDfp_EngMntCtl1_SigNpl_C "" VALUE 0xCC0B2 Kw_Wu16 655350.0 Time_ms 0.00 655350.0 FORMAT "%8.1" /end CHARACTERISTIC
/begin CHARACTERISTIC DSM_SdwDfp_EngMntCtlCD_C "Enprellzeit Shadow Zustand für Fehlerpfad Dfp_EngMntCtlCD" VALUE 0xCC0B4 Kw_Wu16 655350.0 Time_ms 0.00 655350.0 FORMAT "%8.1" /end CHARACTERISTIC
/begin CHARACTERISTIC DSM_SdwDfp_EngMntCtl_Dia1_C "" VALUE 0xCC0B6 Kw_Wu16 655350.0 Time_ms 0.00 655350.0 FORMAT "%8.1" /end CHARACTERISTIC
/begin CHARACTERISTIC DSM_SdwDfp_EngMntCtl_Dia2_C "" VALUE 0xCC0B8 Kw_Wu16 655350.0 Time_ms 0.00 655350.0 FORMAT "%8.1" /end CHARACTERISTIC
/begin CHARACTERISTIC DSM_SdwDfp_EngMntCtl_Dia3_C "" VALUE 0xCC0BA Kw_Wu16 655350.0 Time_ms 0.00 655350.0 FORMAT "%8.1" /end CHARACTERISTIC
/begin CHARACTERISTIC DSM_SdwDfp_EngMntCtl_Max_C "" VALUE 0xCC0BC Kw_Wu16 655350.0 Time_ms 0.00 655350.0 FORMAT "%8.1" /end CHARACTERISTIC
/begin CHARACTERISTIC DSM_SdwDfp_EngMntCtl_Min_C "" VALUE 0xCC0BE Kw_Wu16 655350.0 Time_ms 0.00 655350.0 FORMAT "%8.1" /end CHARACTERISTIC
/begin CHARACTERISTIC DSM_SdwDfp_EngMntCtl_SigNpl_C "" VALUE 0xCC0C0 Kw_Wu16 655350.0 Time_ms 0.00 655350.0 FORMAT "%8.1" /end CHARACTERISTIC
/begin CHARACTERISTIC DSM_SdwDfp_EngPrtFWODet_C "Enprellzeit Shadow Zustand für Fehlerpfad Dfp_EngPrtFWODet" VALUE 0xCC0C2 Kw_Wu16 655350.0 Time_ms 0.00 655350.0 FORMAT "%8.1" /end CHARACTERISTIC
/begin CHARACTERISTIC DSM_SdwDfp_FBCqDvt_C "Enprellzeit Shadow Zustand für Fehlerpfad Dfp_FBCqDvt" VALUE 0xCC0C4 Kw_Wu16 655350.0 Time_ms 0.00 655350.0 FORMAT "%8.1" /end CHARACTERISTIC
/begin CHARACTERISTIC DSM_SdwDfp_FMTC_NonMonotonMap_C "Enprellzeit Shadow Zustand für Fehlerpfad Dfp_FMTC_NonMonotonMap" VALUE 0xCC0C6 Kw_Wu16 655350.0 Time_ms 0.00 655350.0 FORMAT "%8.1" /end CHARACTERISTIC
/begin CHARACTERISTIC DSM_SdwDfp_FTSCD_C "Enprellzeit Shadow Zustand für Fehlerpfad Dfp_FTSCD" VALUE 0xCC0C8 Kw_Wu16 655350.0 Time_ms 0.00 655350.0 FORMAT "%8.1" /end CHARACTERISTIC
/begin CHARACTERISTIC DSM_SdwDfp_FanCD_C "Enprellzeit Shadow Zustand für Fehlerpfad Dfp_FanCD" VALUE 0xCC0CA Kw_Wu16 655350.0 Time_ms 0.00 655350.0 FORMAT "%8.1" /end CHARACTERISTIC
/begin CHARACTERISTIC DSM_SdwDfp_FanCD_FanCtlr1_C "Enprellzeit Shadow Zustand für Fehlerpfad Dfp_FanCD_FanCtlr1" VALUE 0xCC0CC Kw_Wu16 655350.0 Time_ms 0.00 655350.0 FORMAT "%8.1" /end CHARACTERISTIC
/begin CHARACTERISTIC DSM_SdwDfp_FanCD_FanCtlr2_C "Enprellzeit Shadow Zustand für Fehlerpfad Dfp_FanCD_FanCtlr2" VALUE 0xCC0CE Kw_Wu16 655350.0 Time_ms 0.00 655350.0 FORMAT "%8.1" /end CHARACTERISTIC
/begin CHARACTERISTIC DSM_SdwDfp_FanCD_FanCtlr3_C "Enprellzeit Shadow Zustand für Fehlerpfad Dfp_FanCD_FanCtlr3" VALUE 0xCC0D0 Kw_Wu16 655350.0 Time_ms 0.00 655350.0 FORMAT "%8.1" /end CHARACTERISTIC
/begin CHARACTERISTIC DSM_SdwDfp_FlFCD_C "Enprellzeit Shadow Zustand für Fehlerpfad Dfp_FlFCD" VALUE 0xCC0D2 Kw_Wu16 655350.0 Time_ms 0.00 655350.0 FORMAT "%8.1" /end CHARACTERISTIC
/begin CHARACTERISTIC DSM_SdwDfp_FlMngSmkDefect_C "Enprellzeit Shadow Zustand für Fehlerpfad Dfp_FlMngSmkDefect" VALUE 0xCC0D4 Kw_Wu16 655350.0 Time_ms 0.00 655350.0 FORMAT "%8.1" /end CHARACTERISTIC
/begin CHARACTERISTIC DSM_SdwDfp_FrmMngBOS_RESET_C "Enprellzeit Shadow Zustand für Fehlerpfad Dfp_FrmMngBOS_RESET" VALUE 0xCC0D6 Kw_Wu16 655350.0 Time_ms 0.00 655350.0 FORMAT "%8.1" /end CHARACTERISTIC
/begin CHARACTERISTIC DSM_SdwDfp_FrmMngBOS_RESET_2_C "" VALUE 0xCC0D8 Kw_Wu16 655350.0 Time_ms 0.00 655350.0 FORMAT "%8.1" /end CHARACTERISTIC
/begin CHARACTERISTIC DSM_SdwDfp_FrmMngDMANFAFS_C "Enprellzeit Shadow Zustand für Fehlerpfad Dfp_FrmMngDMANFAFS" VALUE 0xCC0DA Kw_Wu16 655350.0 Time_ms 0.00 655350.0 FORMAT "%8.1" /end CHARACTERISTIC
/begin CHARACTERISTIC DSM_SdwDfp_FrmMngDRMANFSSG_C "#SSD Enprellzeit Shadow Zustand für Fehlerpfad Dfp_FrmMngDRMANFSSG" VALUE 0xCC0DC Kw_Wu16 655350.0 Time_ms 0.00 655350.0 FORMAT "%8.1" /end CHARACTERISTIC
/begin CHARACTERISTIC DSM_SdwDfp_FrmMngGEARBX_DATA_C "Enprellzeit Shadow Zustand für Fehlerpfad Dfp_FrmMngGEARBX_DATA" VALUE 0xCC0DE Kw_Wu16 655350.0 Time_ms 0.00 655350.0 FORMAT "%8.1" /end CHARACTERISTIC
/begin CHARACTERISTIC DSM_SdwDfp_FrmMngGEARBX_DATA2_C "Enprellzeit Shadow Zustand für Fehlerpfad Dfp_FrmMngGEARBX_DATA2" VALUE 0xCC0E0 Kw_Wu16 655350.0 Time_ms 0.00 655350.0 FORMAT "%8.1" /end CHARACTERISTIC
/begin CHARACTERISTIC DSM_SdwDfp_FrmMngHEAT_AC_C "Enprellzeit Shadow Zustand für Fehlerpfad Dfp_FrmMngHEAT_AC" VALUE 0xCC0E2 Kw_Wu16 655350.0 Time_ms 0.00 655350.0 FORMAT "%8.1" /end CHARACTERISTIC
/begin CHARACTERISTIC DSM_SdwDfp_FrmMngLENKRADWINKEL_C "Enprellzeit Shadow Zustand für Fehlerpfad Dfp_FrmMngLENKRADWINKEL" VALUE 0xCC0E4 Kw_Wu16 655350.0 Time_ms 0.00 655350.0 FORMAT "%8.1" /end CHARACTERISTIC
/begin CHARACTERISTIC DSM_SdwDfp_FrmMngMILEAGE_RANGE_C "Enprellzeit Shadow Zustand für Fehlerpfad Dfp_FrmMngMILEAGE_RANGE" VALUE 0xCC0E6 Kw_Wu16 655350.0 Time_ms 0.00 655350.0 FORMAT "%8.1" /end CHARACTERISTIC
/begin CHARACTERISTIC DSM_SdwDfp_FrmMngOPCRCTLACC_C "#SSD Enprellzeit Shadow Zustand für Fehlerpfad Dfp_FrmMngOPCRCTLACC" VALUE 0xCC0E8 Kw_Wu16 655350.0 Time_ms 0.00 655350.0 FORMAT "%8.1" /end CHARACTERISTIC
/begin CHARACTERISTIC DSM_SdwDfp_FrmMngPRGG_CCTR_C "Enprellzeit Shadow Zustand für Fehlerpfad Dfp_FrmMngPRGG_CCTR" VALUE 0xCC0EA Kw_Wu16 655350.0 Time_ms 0.00 655350.0 FORMAT "%8.1" /end CHARACTERISTIC
/begin CHARACTERISTIC DSM_SdwDfp_FrmMngPWRMNG_LOADV_C "Enprellzeit Shadow Zustand für Fehlerpfad Dfp_FrmMngPWRMNG_LOADV" VALUE 0xCC0EC Kw_Wu16 655350.0 Time_ms 0.00 655350.0 FORMAT "%8.1" /end CHARACTERISTIC
/begin CHARACTERISTIC DSM_SdwDfp_FrmMngParkConsumer_C "Entprellzeit Shadow Zusand für Fehlerpfad Dfp_FrmMngParkConsumer" VALUE 0xCC0EE Kw_Wu16 655350.0 Time_ms 0.00 655350.0 FORMAT "%8.1" /end CHARACTERISTIC
/begin CHARACTERISTIC DSM_SdwDfp_FrmMngRQSTGEFAN_C "RQ_STG_EFAN - CAN-message related errors" VALUE 0xCC0F0 Kw_Wu16 655350.0 Time_ms 0.00 655350.0 FORMAT "%8.1" /end CHARACTERISTIC
/begin CHARACTERISTIC DSM_SdwDfp_FrmMngSSGErr_C "Enprellzeit Shadow Zustand für Fehlerpfad Dfp_FrmMngSSGErr" VALUE 0xCC0F2 Kw_Wu16 655350.0 Time_ms 0.00 655350.0 FORMAT "%8.1" /end CHARACTERISTIC
/begin CHARACTERISTIC DSM_SdwDfp_FrmMngSSGShOff_C "Enprellzeit Shadow Zustand für Fehlerpfad Dfp_FrmMngSSGShOff" VALUE 0xCC0F4 Kw_Wu16 655350.0 Time_ms 0.00 655350.0 FORMAT "%8.1" /end CHARACTERISTIC
/begin CHARACTERISTIC DSM_SdwDfp_FrmMngSTAT_ANH_C "Enprellzeit Shadow Zustand für Fehlerpfad Dfp_FrmMngSTAT_ANH" VALUE 0xCC0F6 Kw_Wu16 655350.0 Time_ms 0.00 655350.0 FORMAT "%8.1" /end CHARACTERISTIC
/begin CHARACTERISTIC DSM_SdwDfp_FrmMngSTAT_ARS_C "Enprellzeit Shadow Zustand für Fehlerpfad Dfp_FrmMngSTAT_ARS" VALUE 0xCC0F8 Kw_Wu16 655350.0 Time_ms 0.00 655350.0 FORMAT "%8.1" /end CHARACTERISTIC
/begin CHARACTERISTIC DSM_SdwDfp_FrmMngSTAT_DSC_C "Enprellzeit Shadow Zustand für Fehlerpfad Dfp_FrmMngSTAT_DSC" VALUE 0xCC0FA Kw_Wu16 655350.0 Time_ms 0.00 655350.0 FORMAT "%8.1" /end CHARACTERISTIC
/begin CHARACTERISTIC DSM_SdwDfp_FrmMngSTAT_EKP_C "Enprellzeit Shadow Zustand für Fehlerpfad Dfp_FrmMngSTAT_EKP" VALUE 0xCC0FC Kw_Wu16 655350.0 Time_ms 0.00 655350.0 FORMAT "%8.1" /end CHARACTERISTIC
/begin CHARACTERISTIC DSM_SdwDfp_FrmMngSTAT_KOMBI_C "Enprellzeit Shadow Zustand für Fehlerpfad Dfp_FrmMngSTAT_KOMBI" VALUE 0xCC0FE Kw_Wu16 655350.0 Time_ms 0.00 655350.0 FORMAT "%8.1" /end CHARACTERISTIC
/begin CHARACTERISTIC DSM_SdwDfp_FrmMngSTAT_SITZ_C "Enprellzeit Shadow Zustand für Fehlerpfad Dfp_FrmMngSTAT_SITZ" VALUE 0xCC100 Kw_Wu16 655350.0 Time_ms 0.00 655350.0 FORMAT "%8.1" /end CHARACTERISTIC
/begin CHARACTERISTIC DSM_SdwDfp_FrmMngStOBDGbxMilOf_C "Enprellzeit Shadow Zustand für Fehlerpfad Dfp_FrmMngStOBDGbxMilOf" VALUE 0xCC102 Kw_Wu16 655350.0 Time_ms 0.00 655350.0 FORMAT "%8.1" /end CHARACTERISTIC
/begin CHARACTERISTIC DSM_SdwDfp_FrmMngStOBDGbxMilOn_C "Enprellzeit Shadow Zustand für Fehlerpfad Dfp_FrmMngStOBDGbxMilOn" VALUE 0xCC104 Kw_Wu16 655350.0 Time_ms 0.00 655350.0 FORMAT "%8.1" /end CHARACTERISTIC
/begin CHARACTERISTIC DSM_SdwDfp_FrmMngTEMPRELTIME_C "Enprellzeit Shadow Zustand für Fehlerpfad Dfp_FrmMngTEMPRELTIME" VALUE 0xCC106 Kw_Wu16 655350.0 Time_ms 0.00 655350.0 FORMAT "%8.1" /end CHARACTERISTIC
/begin CHARACTERISTIC DSM_SdwDfp_FrmMngTERMINAL_C "Enprellzeit Shadow Zustand für Fehlerpfad Dfp_FrmMngTERMINAL" VALUE 0xCC108 Kw_Wu16 655350.0 Time_ms 0.00 655350.0 FORMAT "%8.1" /end CHARACTERISTIC
/begin CHARACTERISTIC DSM_SdwDfp_FrmMngTIME_DATE_C "Enprellzeit Shadow Zustand für Fehlerpfad Dfp_FrmMngTIME_DATE" VALUE 0xCC10A Kw_Wu16 655350.0 Time_ms 0.00 655350.0 FORMAT "%8.1" /end CHARACTERISTIC
/begin CHARACTERISTIC DSM_SdwDfp_FrmMngTORQUE_DSC_C "#SSD Enprellzeit Shadow Zustand für Fehlerpfad Dfp_FrmMngTORQUE_DSC" VALUE 0xCC10C Kw_Wu16 655350.0 Time_ms 0.00 655350.0 FORMAT "%8.1" /end CHARACTERISTIC
/begin CHARACTERISTIC DSM_SdwDfp_FrmMngTORQUE_GEARBX_C "#SSD Enprellzeit Shadow Zustand für Fehlerpfad Dfp_FrmMngTORQUE_GEARBX" VALUE 0xCC10E Kw_Wu16 655350.0 Time_ms 0.00 655350.0 FORMAT "%8.1" /end CHARACTERISTIC
/begin CHARACTERISTIC DSM_SdwDfp_FrmMngTrq_ReqACC_C "#SSD Enprellzeit Shadow Zustand für Fehlerpfad Dfp_FrmMngTrq_ReqACC" VALUE 0xCC110 Kw_Wu16 655350.0 Time_ms 0.00 655350.0 FORMAT "%8.1" /end CHARACTERISTIC
/begin CHARACTERISTIC DSM_SdwDfp_FrmMngVEH_MOD_C "VEH_MOD - CAN-message related errors" VALUE 0xCC112 Kw_Wu16 655350.0 Time_ms 0.00 655350.0 FORMAT "%8.1" /end CHARACTERISTIC
/begin CHARACTERISTIC DSM_SdwDfp_FrmMngVELOCITY_C "Enprellzeit Shadow Zustand für Fehlerpfad Dfp_FrmMngVELOCITY" VALUE 0xCC114 Kw_Wu16 655350.0 Time_ms 0.00 655350.0 FORMAT "%8.1" /end CHARACTERISTIC
/begin CHARACTERISTIC DSM_SdwDfp_FrmMngWHEEL_SPEED_C "Enprellzeit Shadow Zustand für Fehlerpfad Dfp_FrmMngWHEEL_SPEED" VALUE 0xCC116 Kw_Wu16 655350.0 Time_ms 0.00 655350.0 FORMAT "%8.1" /end CHARACTERISTIC
/begin CHARACTERISTIC DSM_SdwDfp_FrmMngstCurr_C "Entprellzeit für Dfp_FrmMngstCurr" VALUE 0xCC118 Kw_Wu16 655350.0 Time_ms 0.00 655350.0 FORMAT "%8.1" /end CHARACTERISTIC
/begin CHARACTERISTIC DSM_SdwDfp_FrmMngswtPSPOff_C "Entprellzeit für Dfp_FrmMngswtPSPOff" VALUE 0xCC11A Kw_Wu16 655350.0 Time_ms 0.00 655350.0 FORMAT "%8.1" /end CHARACTERISTIC
/begin CHARACTERISTIC DSM_SdwDfp_GearbxIncMax_C "Enprellzeit Shadow Zustand für Fehlerpfad Dfp_GearbxIncMax" VALUE 0xCC11C Kw_Wu16 655350.0 Time_ms 0.00 655350.0 FORMAT "%8.1" /end CHARACTERISTIC
/begin CHARACTERISTIC DSM_SdwDfp_GlwCD_C "Enprellzeit Shadow Zustand für Fehlerpfad Dfp_GlwCD" VALUE 0xCC11E Kw_Wu16 655350.0 Time_ms 0.00 655350.0 FORMAT "%8.1" /end CHARACTERISTIC
/begin CHARACTERISTIC DSM_SdwDfp_GlwCDGlwCirc1_C "Enprellzeit Shadow Zustand für Fehlerpfad Dfp_GlwCDGlwCirc1" VALUE 0xCC120 Kw_Wu16 655350.0 Time_ms 0.00 655350.0 FORMAT "%8.1" /end CHARACTERISTIC
/begin CHARACTERISTIC DSM_SdwDfp_GlwCDGlwCirc2_C "Enprellzeit Shadow Zustand für Fehlerpfad Dfp_GlwCDGlwCirc2" VALUE 0xCC122 Kw_Wu16 655350.0 Time_ms 0.00 655350.0 FORMAT "%8.1" /end CHARACTERISTIC
/begin CHARACTERISTIC DSM_SdwDfp_GlwCDGlwCirc3_C "Enprellzeit Shadow Zustand für Fehlerpfad Dfp_GlwCDGlwCirc3" VALUE 0xCC124 Kw_Wu16 655350.0 Time_ms 0.00 655350.0 FORMAT "%8.1" /end CHARACTERISTIC
/begin CHARACTERISTIC DSM_SdwDfp_GlwCDGlwCirc4_C "Enprellzeit Shadow Zustand für Fehlerpfad Dfp_GlwCDGlwCirc4" VALUE 0xCC126 Kw_Wu16 655350.0 Time_ms 0.00 655350.0 FORMAT "%8.1" /end CHARACTERISTIC
/begin CHARACTERISTIC DSM_SdwDfp_GlwCDGlwCirc5_C "Enprellzeit Shadow Zustand für Fehlerpfad Dfp_GlwCDGlwCirc5" VALUE 0xCC128 Kw_Wu16 655350.0 Time_ms 0.00 655350.0 FORMAT "%8.1" /end CHARACTERISTIC
/begin CHARACTERISTIC DSM_SdwDfp_GlwCDGlwCirc6_C "Enprellzeit Shadow Zustand für Fehlerpfad Dfp_GlwCDGlwCirc6" VALUE 0xCC12A Kw_Wu16 655350.0 Time_ms 0.00 655350.0 FORMAT "%8.1" /end CHARACTERISTIC
/begin CHARACTERISTIC DSM_SdwDfp_GlwCDGlwCirc7_C "Enprellzeit Shadow Zustand für Fehlerpfad Dfp_GlwCDGlwCirc7" VALUE 0xCC12C Kw_Wu16 655350.0 Time_ms 0.00 655350.0 FORMAT "%8.1" /end CHARACTERISTIC
/begin CHARACTERISTIC DSM_SdwDfp_GlwCDGlwCirc8_C "Enprellzeit Shadow Zustand für Fehlerpfad Dfp_GlwCDGlwCirc8" VALUE 0xCC12E Kw_Wu16 655350.0 Time_ms 0.00 655350.0 FORMAT "%8.1" /end CHARACTERISTIC
/begin CHARACTERISTIC DSM_SdwDfp_GlwCtl_C "Enprellzeit Shadow Zustand für Fehlerpfad Dfp_GlwCtl" VALUE 0xCC130 Kw_Wu16 655350.0 Time_ms 0.00 655350.0 FORMAT "%8.1" /end CHARACTERISTIC
/begin CHARACTERISTIC DSM_SdwDfp_HWEMonCom_C "Enprellzeit Shadow Zustand für Fehlerpfad Dfp_HWEMonCom" VALUE 0xCC132 Kw_Wu16 655350.0 Time_ms 0.00 655350.0 FORMAT "%8.1" /end CHARACTERISTIC
/begin CHARACTERISTIC DSM_SdwDfp_HWEMonEEPROM_C "Enprellzeit Shadow Zustand für Fehlerpfad Dfp_HWEMonEEPROM" VALUE 0xCC134 Kw_Wu16 655350.0 Time_ms 0.00 655350.0 FORMAT "%8.1" /end CHARACTERISTIC
/begin CHARACTERISTIC DSM_SdwDfp_HWEMonRcyLocked_C "Enprellzeit Shadow Zustand für Fehlerpfad Dfp_HWEMonRcyLocked" VALUE 0xCC136 Kw_Wu16 655350.0 Time_ms 0.00 655350.0 FORMAT "%8.1" /end CHARACTERISTIC
/begin CHARACTERISTIC DSM_SdwDfp_HWEMonRcySuppressed_C "Enprellzeit Shadow Zustand für Fehlerpfad Dfp_HWEMonRcySuppressed" VALUE 0xCC138 Kw_Wu16 655350.0 Time_ms 0.00 655350.0 FORMAT "%8.1" /end CHARACTERISTIC
/begin CHARACTERISTIC DSM_SdwDfp_HWEMonRcyVisible_C "Enprellzeit Shadow Zustand für Fehlerpfad Dfp_HWEMonRcyVisible" VALUE 0xCC13A Kw_Wu16 655350.0 Time_ms 0.00 655350.0 FORMAT "%8.1" /end CHARACTERISTIC
/begin CHARACTERISTIC DSM_SdwDfp_HWEMonUMaxSupply_C "Enprellzeit Shadow Zustand für Fehlerpfad Dfp_HWEMonUMaxSupply" VALUE 0xCC13C Kw_Wu16 655350.0 Time_ms 0.00 655350.0 FORMAT "%8.1" /end CHARACTERISTIC
/begin CHARACTERISTIC DSM_SdwDfp_HWEMonUMinSupply_C "Enprellzeit Shadow Zustand für Fehlerpfad Dfp_HWEMonUMinSupply" VALUE 0xCC13E Kw_Wu16 655350.0 Time_ms 0.00 655350.0 FORMAT "%8.1" /end CHARACTERISTIC
/begin CHARACTERISTIC DSM_SdwDfp_IATSCD_C "Enprellzeit Shadow Zustand für Fehlerpfad Dfp_IATSCD" VALUE 0xCC140 Kw_Wu16 655350.0 Time_ms 0.00 655350.0 FORMAT "%8.1" /end CHARACTERISTIC
/begin CHARACTERISTIC DSM_SdwDfp_IATSCD_CATS_C "Enprellzeit Shadow Zustand für Fehlerpfad Dfp_IATSCD_CATS" VALUE 0xCC142 Kw_Wu16 655350.0 Time_ms 0.00 655350.0 FORMAT "%8.1" /end CHARACTERISTIC
/begin CHARACTERISTIC DSM_SdwDfp_ImmCtlImmCD_C "Enprellzeit Shadow Zustand für Fehlerpfad Dfp_ImmCtlImmCD" VALUE 0xCC144 Kw_Wu16 655350.0 Time_ms 0.00 655350.0 FORMAT "%8.1" /end CHARACTERISTIC
/begin CHARACTERISTIC DSM_SdwDfp_ImmCtlImmEep_C "Enprellzeit Shadow Zustand für Fehlerpfad Dfp_ImmCtlImmEep" VALUE 0xCC146 Kw_Wu16 655350.0 Time_ms 0.00 655350.0 FORMAT "%8.1" /end CHARACTERISTIC
/begin CHARACTERISTIC DSM_SdwDfp_ImmCtlMpl_C "Enprellzeit Shadow Zustand für Fehlerpfad Dfp_ImmCtlMpl" VALUE 0xCC148 Kw_Wu16 655350.0 Time_ms 0.00 655350.0 FORMAT "%8.1" /end CHARACTERISTIC
/begin CHARACTERISTIC DSM_SdwDfp_IndSys1_C "Enprellzeit Shadow Zustand für Fehlerpfad Dfp_IndSys1" VALUE 0xCC14A Kw_Wu16 655350.0 Time_ms 0.00 655350.0 FORMAT "%8.1" /end CHARACTERISTIC
/begin CHARACTERISTIC DSM_SdwDfp_IndSys2_C "Enprellzeit Shadow Zustand für Fehlerpfad Dfp_IndSys2" VALUE 0xCC14C Kw_Wu16 655350.0 Time_ms 0.00 655350.0 FORMAT "%8.1" /end CHARACTERISTIC
/begin CHARACTERISTIC DSM_SdwDfp_InjCrv_InjLim_C "Enprellzeit Shadow Zustand für Fehlerpfad Dfp_InjCrv_InjLim" VALUE 0xCC14E Kw_Wu16 655350.0 Time_ms 0.00 655350.0 FORMAT "%8.1" /end CHARACTERISTIC
/begin CHARACTERISTIC DSM_SdwDfp_InjCtlAdjQnt_C "Enprellzeit Shadow Zustand für Fehlerpfad Dfp_InjCtlAdjQnt" VALUE 0xCC150 Kw_Wu16 655350.0 Time_ms 0.00 655350.0 FORMAT "%8.1" /end CHARACTERISTIC
/begin CHARACTERISTIC DSM_SdwDfp_InjCtlDrift_C "Enprellzeit Shadow Zustand für Fehlerpfad Dfp_InjCtlDrift" VALUE 0xCC152 Kw_Wu16 655350.0 Time_ms 0.00 655350.0 FORMAT "%8.1" /end CHARACTERISTIC
/begin CHARACTERISTIC DSM_SdwDfp_InjVCDActrChrg_C "Enprellzeit Shadow Zustand für Fehlerpfad Dfp_InjVCDActrChrg" VALUE 0xCC154 Kw_Wu16 655350.0 Time_ms 0.00 655350.0 FORMAT "%8.1" /end CHARACTERISTIC
/begin CHARACTERISTIC DSM_SdwDfp_InjVCDActrEnrg1_C "Enprellzeit Shadow Zustand für Fehlerpfad Dfp_InjVCDActrEnrg1" VALUE 0xCC156 Kw_Wu16 655350.0 Time_ms 0.00 655350.0 FORMAT "%8.1" /end CHARACTERISTIC
/begin CHARACTERISTIC DSM_SdwDfp_InjVCDActrEnrg2_C "Enprellzeit Shadow Zustand für Fehlerpfad Dfp_InjVCDActrEnrg2" VALUE 0xCC158 Kw_Wu16 655350.0 Time_ms 0.00 655350.0 FORMAT "%8.1" /end CHARACTERISTIC
/begin CHARACTERISTIC DSM_SdwDfp_InjVCDActrEnrg3_C "Enprellzeit Shadow Zustand für Fehlerpfad Dfp_InjVCDActrEnrg3" VALUE 0xCC15A Kw_Wu16 655350.0 Time_ms 0.00 655350.0 FORMAT "%8.1" /end CHARACTERISTIC
/begin CHARACTERISTIC DSM_SdwDfp_InjVCDActrEnrg4_C "Enprellzeit Shadow Zustand für Fehlerpfad Dfp_InjVCDActrEnrg4" VALUE 0xCC15C Kw_Wu16 655350.0 Time_ms 0.00 655350.0 FORMAT "%8.1" /end CHARACTERISTIC
/begin CHARACTERISTIC DSM_SdwDfp_InjVCDActrEnrg5_C "Enprellzeit Shadow Zustand für Fehlerpfad Dfp_InjVCDActrEnrg5" VALUE 0xCC15E Kw_Wu16 655350.0 Time_ms 0.00 655350.0 FORMAT "%8.1" /end CHARACTERISTIC
/begin CHARACTERISTIC DSM_SdwDfp_InjVCDActrEnrg6_C "Enprellzeit Shadow Zustand für Fehlerpfad Dfp_InjVCDActrEnrg6" VALUE 0xCC160 Kw_Wu16 655350.0 Time_ms 0.00 655350.0 FORMAT "%8.1" /end CHARACTERISTIC
/begin CHARACTERISTIC DSM_SdwDfp_InjVCDActrEnrg7_C "Enprellzeit Shadow Zustand für Fehlerpfad Dfp_InjVCDActrEnrg7" VALUE 0xCC162 Kw_Wu16 655350.0 Time_ms 0.00 655350.0 FORMAT "%8.1" /end CHARACTERISTIC
/begin CHARACTERISTIC DSM_SdwDfp_InjVCDActrEnrg8_C "Enprellzeit Shadow Zustand für Fehlerpfad Dfp_InjVCDActrEnrg8" VALUE 0xCC164 Kw_Wu16 655350.0 Time_ms 0.00 655350.0 FORMAT "%8.1" /end CHARACTERISTIC
/begin CHARACTERISTIC DSM_SdwDfp_InjVCDActrVolt_C "Enprellzeit Shadow Zustand für Fehlerpfad Dfp_InjVCDActrVolt" VALUE 0xCC166 Kw_Wu16 655350.0 Time_ms 0.00 655350.0 FORMAT "%8.1" /end CHARACTERISTIC
/begin CHARACTERISTIC DSM_SdwDfp_InjVCDClsBank1_C "Enprellzeit Shadow Zustand für Fehlerpfad Dfp_InjVCDClsBank1" VALUE 0xCC168 Kw_Wu16 655350.0 Time_ms 0.00 655350.0 FORMAT "%8.1" /end CHARACTERISTIC
/begin CHARACTERISTIC DSM_SdwDfp_InjVCDClsBank2_C "Enprellzeit Shadow Zustand für Fehlerpfad Dfp_InjVCDClsBank2" VALUE 0xCC16A Kw_Wu16 655350.0 Time_ms 0.00 655350.0 FORMAT "%8.1" /end CHARACTERISTIC
/begin CHARACTERISTIC DSM_SdwDfp_InjVCDMonCab_C "Enprellzeit Shadow Zustand für Fehlerpfad Dfp_InjVCDMonCab" VALUE 0xCC16C Kw_Wu16 655350.0 Time_ms 0.00 655350.0 FORMAT "%8.1" /end CHARACTERISTIC
/begin CHARACTERISTIC DSM_SdwDfp_InjVCDMonSwt_C "Enprellzeit Shadow Zustand für Fehlerpfad Dfp_InjVCDMonSwt" VALUE 0xCC16E Kw_Wu16 655350.0 Time_ms 0.00 655350.0 FORMAT "%8.1" /end CHARACTERISTIC
/begin CHARACTERISTIC DSM_SdwDfp_InjVCDShOffDCDC_C "Enprellzeit Shadow Zustand für Fehlerpfad Dfp_InjVCDShOffDCDC" VALUE 0xCC170 Kw_Wu16 655350.0 Time_ms 0.00 655350.0 FORMAT "%8.1" /end CHARACTERISTIC
/begin CHARACTERISTIC DSM_SdwDfp_InjVCDUBuf_C "Enprellzeit Shadow Zustand für Fehlerpfad Dfp_InjVCDUBuf" VALUE 0xCC172 Kw_Wu16 655350.0 Time_ms 0.00 655350.0 FORMAT "%8.1" /end CHARACTERISTIC
/begin CHARACTERISTIC DSM_SdwDfp_InjVCD_CY370Ampl_C "Enprellzeit Shadow Zustand für Fehlerpfad Dfp_InjVCD_CY370Ampl" VALUE 0xCC174 Kw_Wu16 655350.0 Time_ms 0.00 655350.0 FORMAT "%8.1" /end CHARACTERISTIC
/begin CHARACTERISTIC DSM_SdwDfp_InjVlvBnk1A_C "Enprellzeit Shadow Zustand für Fehlerpfad Dfp_InjVlvBnk1A" VALUE 0xCC176 Kw_Wu16 655350.0 Time_ms 0.00 655350.0 FORMAT "%8.1" /end CHARACTERISTIC
/begin CHARACTERISTIC DSM_SdwDfp_InjVlvBnk1B_C "Enprellzeit Shadow Zustand für Fehlerpfad Dfp_InjVlvBnk1B" VALUE 0xCC178 Kw_Wu16 655350.0 Time_ms 0.00 655350.0 FORMAT "%8.1" /end CHARACTERISTIC
/begin CHARACTERISTIC DSM_SdwDfp_InjVlvBnk2A_C "Enprellzeit Shadow Zustand für Fehlerpfad Dfp_InjVlvBnk2A" VALUE 0xCC17A Kw_Wu16 655350.0 Time_ms 0.00 655350.0 FORMAT "%8.1" /end CHARACTERISTIC
/begin CHARACTERISTIC DSM_SdwDfp_InjVlvBnk2B_C "Enprellzeit Shadow Zustand für Fehlerpfad Dfp_InjVlvBnk2B" VALUE 0xCC17C Kw_Wu16 655350.0 Time_ms 0.00 655350.0 FORMAT "%8.1" /end CHARACTERISTIC
/begin CHARACTERISTIC DSM_SdwDfp_InjVlvChipA_C "Enprellzeit Shadow Zustand für Fehlerpfad Dfp_InjVlvChipA" VALUE 0xCC17E Kw_Wu16 655350.0 Time_ms 0.00 655350.0 FORMAT "%8.1" /end CHARACTERISTIC
/begin CHARACTERISTIC DSM_SdwDfp_InjVlvChipB_C "Enprellzeit Shadow Zustand für Fehlerpfad Dfp_InjVlvChipB" VALUE 0xCC180 Kw_Wu16 655350.0 Time_ms 0.00 655350.0 FORMAT "%8.1" /end CHARACTERISTIC
/begin CHARACTERISTIC DSM_SdwDfp_InjVlvCyl1A_C "Enprellzeit Shadow Zustand für Fehlerpfad Dfp_InjVlvCyl1A" VALUE 0xCC182 Kw_Wu16 655350.0 Time_ms 0.00 655350.0 FORMAT "%8.1" /end CHARACTERISTIC
/begin CHARACTERISTIC DSM_SdwDfp_InjVlvCyl1B_C "Enprellzeit Shadow Zustand für Fehlerpfad Dfp_InjVlvCyl1B" VALUE 0xCC184 Kw_Wu16 655350.0 Time_ms 0.00 655350.0 FORMAT "%8.1" /end CHARACTERISTIC
/begin CHARACTERISTIC DSM_SdwDfp_InjVlvCyl1C_C "Enprellzeit Shadow Zustand für Fehlerpfad Dfp_InjVlvCyl1C" VALUE 0xCC186 Kw_Wu16 655350.0 Time_ms 0.00 655350.0 FORMAT "%8.1" /end CHARACTERISTIC
/begin CHARACTERISTIC DSM_SdwDfp_InjVlvCyl2A_C "Enprellzeit Shadow Zustand für Fehlerpfad Dfp_InjVlvCyl2A" VALUE 0xCC188 Kw_Wu16 655350.0 Time_ms 0.00 655350.0 FORMAT "%8.1" /end CHARACTERISTIC
/begin CHARACTERISTIC DSM_SdwDfp_InjVlvCyl2B_C "Enprellzeit Shadow Zustand für Fehlerpfad Dfp_InjVlvCyl2B" VALUE 0xCC18A Kw_Wu16 655350.0 Time_ms 0.00 655350.0 FORMAT "%8.1" /end CHARACTERISTIC
/begin CHARACTERISTIC DSM_SdwDfp_InjVlvCyl2C_C "Enprellzeit Shadow Zustand für Fehlerpfad Dfp_InjVlvCyl2C" VALUE 0xCC18C Kw_Wu16 655350.0 Time_ms 0.00 655350.0 FORMAT "%8.1" /end CHARACTERISTIC
/begin CHARACTERISTIC DSM_SdwDfp_InjVlvCyl3A_C "Enprellzeit Shadow Zustand für Fehlerpfad Dfp_InjVlvCyl3A" VALUE 0xCC18E Kw_Wu16 655350.0 Time_ms 0.00 655350.0 FORMAT "%8.1" /end CHARACTERISTIC
/begin CHARACTERISTIC DSM_SdwDfp_InjVlvCyl3B_C "Enprellzeit Shadow Zustand für Fehlerpfad Dfp_InjVlvCyl3B" VALUE 0xCC190 Kw_Wu16 655350.0 Time_ms 0.00 655350.0 FORMAT "%8.1" /end CHARACTERISTIC
/begin CHARACTERISTIC DSM_SdwDfp_InjVlvCyl3C_C "Enprellzeit Shadow Zustand für Fehlerpfad Dfp_InjVlvCyl3C" VALUE 0xCC192 Kw_Wu16 655350.0 Time_ms 0.00 655350.0 FORMAT "%8.1" /end CHARACTERISTIC
/begin CHARACTERISTIC DSM_SdwDfp_InjVlvCyl4A_C "Enprellzeit Shadow Zustand für Fehlerpfad Dfp_InjVlvCyl4A" VALUE 0xCC194 Kw_Wu16 655350.0 Time_ms 0.00 655350.0 FORMAT "%8.1" /end CHARACTERISTIC
/begin CHARACTERISTIC DSM_SdwDfp_InjVlvCyl4B_C "Enprellzeit Shadow Zustand für Fehlerpfad Dfp_InjVlvCyl4B" VALUE 0xCC196 Kw_Wu16 655350.0 Time_ms 0.00 655350.0 FORMAT "%8.1" /end CHARACTERISTIC
/begin CHARACTERISTIC DSM_SdwDfp_InjVlvCyl4C_C "Enprellzeit Shadow Zustand für Fehlerpfad Dfp_InjVlvCyl4C" VALUE 0xCC198 Kw_Wu16 655350.0 Time_ms 0.00 655350.0 FORMAT "%8.1" /end CHARACTERISTIC
/begin CHARACTERISTIC DSM_SdwDfp_InjVlvCyl5A_C "Enprellzeit Shadow Zustand für Fehlerpfad Dfp_InjVlvCyl5A" VALUE 0xCC19A Kw_Wu16 655350.0 Time_ms 0.00 655350.0 FORMAT "%8.1" /end CHARACTERISTIC
/begin CHARACTERISTIC DSM_SdwDfp_InjVlvCyl5B_C "Enprellzeit Shadow Zustand für Fehlerpfad Dfp_InjVlvCyl5B" VALUE 0xCC19C Kw_Wu16 655350.0 Time_ms 0.00 655350.0 FORMAT "%8.1" /end CHARACTERISTIC
/begin CHARACTERISTIC DSM_SdwDfp_InjVlvCyl5C_C "Enprellzeit Shadow Zustand für Fehlerpfad Dfp_InjVlvCyl5C" VALUE 0xCC19E Kw_Wu16 655350.0 Time_ms 0.00 655350.0 FORMAT "%8.1" /end CHARACTERISTIC
/begin CHARACTERISTIC DSM_SdwDfp_InjVlvCyl6A_C "Enprellzeit Shadow Zustand für Fehlerpfad Dfp_InjVlvCyl6A" VALUE 0xCC1A0 Kw_Wu16 655350.0 Time_ms 0.00 655350.0 FORMAT "%8.1" /end CHARACTERISTIC
/begin CHARACTERISTIC DSM_SdwDfp_InjVlvCyl6B_C "Enprellzeit Shadow Zustand für Fehlerpfad Dfp_InjVlvCyl6B" VALUE 0xCC1A2 Kw_Wu16 655350.0 Time_ms 0.00 655350.0 FORMAT "%8.1" /end CHARACTERISTIC
/begin CHARACTERISTIC DSM_SdwDfp_InjVlvCyl6C_C "Enprellzeit Shadow Zustand für Fehlerpfad Dfp_InjVlvCyl6C" VALUE 0xCC1A4 Kw_Wu16 655350.0 Time_ms 0.00 655350.0 FORMAT "%8.1" /end CHARACTERISTIC
/begin CHARACTERISTIC DSM_SdwDfp_InjVlvCyl7A_C "Enprellzeit Shadow Zustand für Fehlerpfad Dfp_InjVlvCyl7A" VALUE 0xCC1A6 Kw_Wu16 655350.0 Time_ms 0.00 655350.0 FORMAT "%8.1" /end CHARACTERISTIC
/begin CHARACTERISTIC DSM_SdwDfp_InjVlvCyl7B_C "Enprellzeit Shadow Zustand für Fehlerpfad Dfp_InjVlvCyl7B" VALUE 0xCC1A8 Kw_Wu16 655350.0 Time_ms 0.00 655350.0 FORMAT "%8.1" /end CHARACTERISTIC
/begin CHARACTERISTIC DSM_SdwDfp_InjVlvCyl7C_C "Enprellzeit Shadow Zustand für Fehlerpfad Dfp_InjVlvCyl7C" VALUE 0xCC1AA Kw_Wu16 655350.0 Time_ms 0.00 655350.0 FORMAT "%8.1" /end CHARACTERISTIC
/begin CHARACTERISTIC DSM_SdwDfp_InjVlvCyl8A_C "Enprellzeit Shadow Zustand für Fehlerpfad Dfp_InjVlvCyl8A" VALUE 0xCC1AC Kw_Wu16 655350.0 Time_ms 0.00 655350.0 FORMAT "%8.1" /end CHARACTERISTIC
/begin CHARACTERISTIC DSM_SdwDfp_InjVlvCyl8B_C "Enprellzeit Shadow Zustand für Fehlerpfad Dfp_InjVlvCyl8B" VALUE 0xCC1AE Kw_Wu16 655350.0 Time_ms 0.00 655350.0 FORMAT "%8.1" /end CHARACTERISTIC
/begin CHARACTERISTIC DSM_SdwDfp_InjVlvCyl8C_C "Enprellzeit Shadow Zustand für Fehlerpfad Dfp_InjVlvCyl8C" VALUE 0xCC1B0 Kw_Wu16 655350.0 Time_ms 0.00 655350.0 FORMAT "%8.1" /end CHARACTERISTIC
/begin CHARACTERISTIC DSM_SdwDfp_InjVlvNVC1_C "Enprellzeit Shadow Zustand für Fehlerpfad Dfp_InjVlvNVC1" VALUE 0xCC1B2 Kw_Wu16 655350.0 Time_ms 0.00 655350.0 FORMAT "%8.1" /end CHARACTERISTIC
/begin CHARACTERISTIC DSM_SdwDfp_InjVlvNVC2_C "Enprellzeit Shadow Zustand für Fehlerpfad Dfp_InjVlvNVC2" VALUE 0xCC1B4 Kw_Wu16 655350.0 Time_ms 0.00 655350.0 FORMAT "%8.1" /end CHARACTERISTIC
/begin CHARACTERISTIC DSM_SdwDfp_InjVlvNVC3_C "Enprellzeit Shadow Zustand für Fehlerpfad Dfp_InjVlvNVC3" VALUE 0xCC1B6 Kw_Wu16 655350.0 Time_ms 0.00 655350.0 FORMAT "%8.1" /end CHARACTERISTIC
/begin CHARACTERISTIC DSM_SdwDfp_InjVlvNVC4_C "Enprellzeit Shadow Zustand für Fehlerpfad Dfp_InjVlvNVC4" VALUE 0xCC1B8 Kw_Wu16 655350.0 Time_ms 0.00 655350.0 FORMAT "%8.1" /end CHARACTERISTIC
/begin CHARACTERISTIC DSM_SdwDfp_InjVlvNVC5_C "Enprellzeit Shadow Zustand für Fehlerpfad Dfp_InjVlvNVC5" VALUE 0xCC1BA Kw_Wu16 655350.0 Time_ms 0.00 655350.0 FORMAT "%8.1" /end CHARACTERISTIC
/begin CHARACTERISTIC DSM_SdwDfp_InjVlvNVC6_C "Enprellzeit Shadow Zustand für Fehlerpfad Dfp_InjVlvNVC6" VALUE 0xCC1BC Kw_Wu16 655350.0 Time_ms 0.00 655350.0 FORMAT "%8.1" /end CHARACTERISTIC
/begin CHARACTERISTIC DSM_SdwDfp_InjVlvNVC7_C "Enprellzeit Shadow Zustand für Fehlerpfad Dfp_InjVlvNVC7" VALUE 0xCC1BE Kw_Wu16 655350.0 Time_ms 0.00 655350.0 FORMAT "%8.1" /end CHARACTERISTIC
/begin CHARACTERISTIC DSM_SdwDfp_InjVlvNVC8_C "Enprellzeit Shadow Zustand für Fehlerpfad Dfp_InjVlvNVC8" VALUE 0xCC1C0 Kw_Wu16 655350.0 Time_ms 0.00 655350.0 FORMAT "%8.1" /end CHARACTERISTIC
/begin CHARACTERISTIC DSM_SdwDfp_LPACD_Max_C "Enprellzeit Shadow Zustand für Fehlerpfad Dfp_LPACD_Max" VALUE 0xCC1C2 Kw_Wu16 655350.0 Time_ms 0.00 655350.0 FORMAT "%8.1" /end CHARACTERISTIC
/begin CHARACTERISTIC DSM_SdwDfp_LPACD_Min_C "Enprellzeit Shadow Zustand für Fehlerpfad Dfp_LPACD_Min" VALUE 0xCC1C4 Kw_Wu16 655350.0 Time_ms 0.00 655350.0 FORMAT "%8.1" /end CHARACTERISTIC
/begin CHARACTERISTIC DSM_SdwDfp_LPACD_SigNpl_C "Enprellzeit Shadow Zustand für Fehlerpfad Dfp_LPACD_SigNpl" VALUE 0xCC1C6 Kw_Wu16 655350.0 Time_ms 0.00 655350.0 FORMAT "%8.1" /end CHARACTERISTIC
/begin CHARACTERISTIC DSM_SdwDfp_LSUCDCircNernst0_C "Enprellzeit Shadow Zustand für Fehlerpfad Dfp_LSUCDCircNernst0" VALUE 0xCC1C8 Kw_Wu16 655350.0 Time_ms 0.00 655350.0 FORMAT "%8.1" /end CHARACTERISTIC
/begin CHARACTERISTIC DSM_SdwDfp_LSUCDCircPumpCur0_C "Enprellzeit Shadow Zustand für Fehlerpfad Dfp_LSUCDCircPumpCur0" VALUE 0xCC1CA Kw_Wu16 655350.0 Time_ms 0.00 655350.0 FORMAT "%8.1" /end CHARACTERISTIC
/begin CHARACTERISTIC DSM_SdwDfp_LSUCDCircVirtGnd0_C "Enprellzeit Shadow Zustand für Fehlerpfad Dfp_LSUCDCircVirtGnd0" VALUE 0xCC1CC Kw_Wu16 655350.0 Time_ms 0.00 655350.0 FORMAT "%8.1" /end CHARACTERISTIC
/begin CHARACTERISTIC DSM_SdwDfp_LSUCDHeater0_C "Enprellzeit Shadow Zustand für Fehlerpfad Dfp_LSUCDHeater0" VALUE 0xCC1CE Kw_Wu16 655350.0 Time_ms 0.00 655350.0 FORMAT "%8.1" /end CHARACTERISTIC
/begin CHARACTERISTIC DSM_SdwDfp_LSUCDHtCoup0_C "Enprellzeit Shadow Zustand für Fehlerpfad Dfp_LSUCDHtCoup0" VALUE 0xCC1D0 Kw_Wu16 655350.0 Time_ms 0.00 655350.0 FORMAT "%8.1" /end CHARACTERISTIC
/begin CHARACTERISTIC DSM_SdwDfp_LSUCDO20_C "Enprellzeit Shadow Zustand für Fehlerpfad Dfp_LSUCDO20" VALUE 0xCC1D2 Kw_Wu16 655350.0 Time_ms 0.00 655350.0 FORMAT "%8.1" /end CHARACTERISTIC
/begin CHARACTERISTIC DSM_SdwDfp_LSUCDO2Clb0_C "Enprellzeit Shadow Zustand für Fehlerpfad Dfp_LSUCDO2Clb0" VALUE 0xCC1D4 Kw_Wu16 655350.0 Time_ms 0.00 655350.0 FORMAT "%8.1" /end CHARACTERISTIC
/begin CHARACTERISTIC DSM_SdwDfp_LSUCDRiClb0_C "Enprellzeit Shadow Zustand für Fehlerpfad Dfp_LSUCDRiClb0" VALUE 0xCC1D6 Kw_Wu16 655350.0 Time_ms 0.00 655350.0 FORMAT "%8.1" /end CHARACTERISTIC
/begin CHARACTERISTIC DSM_SdwDfp_LSUCDSPI0_C "Enprellzeit Shadow Zustand für Fehlerpfad Dfp_LSUCDSPI0" VALUE 0xCC1D8 Kw_Wu16 655350.0 Time_ms 0.00 655350.0 FORMAT "%8.1" /end CHARACTERISTIC
/begin CHARACTERISTIC DSM_SdwDfp_LSUCDSPIBattLow0_C "Enprellzeit Shadow Zustand für Fehlerpfad Dfp_LSUCDSPIBattLow0" VALUE 0xCC1DA Kw_Wu16 655350.0 Time_ms 0.00 655350.0 FORMAT "%8.1" /end CHARACTERISTIC
/begin CHARACTERISTIC DSM_SdwDfp_LSUCDWireIP0_C "Enprellzeit Shadow Zustand für Fehlerpfad Dfp_LSUCDWireIP0" VALUE 0xCC1DC Kw_Wu16 655350.0 Time_ms 0.00 655350.0 FORMAT "%8.1" /end CHARACTERISTIC
/begin CHARACTERISTIC DSM_SdwDfp_LSUCtlRiExc0_C "Enprellzeit Shadow Zustand für Fehlerpfad Dfp_LSUCtlRiExc0" VALUE 0xCC1DE Kw_Wu16 655350.0 Time_ms 0.00 655350.0 FORMAT "%8.1" /end CHARACTERISTIC
/begin CHARACTERISTIC DSM_SdwDfp_LSUMon1Sens_C "Enprellzeit Shadow Zustand für Fehlerpfad Dfp_LSUMon1Sens" VALUE 0xCC1E0 Kw_Wu16 655350.0 Time_ms 0.00 655350.0 FORMAT "%8.1" /end CHARACTERISTIC
/begin CHARACTERISTIC DSM_SdwDfp_LSUMon2Sens_C "Enprellzeit Shadow Zustand für Fehlerpfad Dfp_LSUMon2Sens" VALUE 0xCC1E2 Kw_Wu16 655350.0 Time_ms 0.00 655350.0 FORMAT "%8.1" /end CHARACTERISTIC
/begin CHARACTERISTIC DSM_SdwDfp_LubCD_C "Enprellzeit Shadow Zustand für Fehlerpfad Dfp_LubCD" VALUE 0xCC1E4 Kw_Wu16 655350.0 Time_ms 0.00 655350.0 FORMAT "%8.1" /end CHARACTERISTIC
/begin CHARACTERISTIC DSM_SdwDfp_MIL_C "Enprellzeit Shadow Zustand für Fehlerpfad Dfp_MIL" VALUE 0xCC1E6 Kw_Wu16 655350.0 Time_ms 0.00 655350.0 FORMAT "%8.1" /end CHARACTERISTIC
/begin CHARACTERISTIC DSM_SdwDfp_MRlyCD_C "Enprellzeit Shadow Zustand für Fehlerpfad Dfp_MRlyCD" VALUE 0xCC1E8 Kw_Wu16 655350.0 Time_ms 0.00 655350.0 FORMAT "%8.1" /end CHARACTERISTIC
/begin CHARACTERISTIC DSM_SdwDfp_MSidCD_Comm_C "Enprellzeit Shadow Zustand für Fehlerpfad Dfp_MSidCD_Comm" VALUE 0xCC1EA Kw_Wu16 655350.0 Time_ms 0.00 655350.0 FORMAT "%8.1" /end CHARACTERISTIC
/begin CHARACTERISTIC DSM_SdwDfp_MSidCD_Pin_C "Enprellzeit Shadow Zustand für Fehlerpfad Dfp_MSidCD_Pin" VALUE 0xCC1EC Kw_Wu16 655350.0 Time_ms 0.00 655350.0 FORMAT "%8.1" /end CHARACTERISTIC
/begin CHARACTERISTIC DSM_SdwDfp_MSidCD_Sel_INI_C "Enprellzeit Shadow Zustand für Fehlerpfad Dfp_MSidCD_Sel_INI" VALUE 0xCC1EE Kw_Wu16 655350.0 Time_ms 0.00 655350.0 FORMAT "%8.1" /end CHARACTERISTIC
/begin CHARACTERISTIC DSM_SdwDfp_MSidCD_Select_C "Enprellzeit Shadow Zustand für Fehlerpfad Dfp_MSidCD_Select" VALUE 0xCC1F0 Kw_Wu16 655350.0 Time_ms 0.00 655350.0 FORMAT "%8.1" /end CHARACTERISTIC
/begin CHARACTERISTIC DSM_SdwDfp_MeUnCDNoLoad_C "Enprellzeit Shadow Zustand für Fehlerpfad Dfp_MeUnCDNoLoad" VALUE 0xCC1F2 Kw_Wu16 655350.0 Time_ms 0.00 655350.0 FORMAT "%8.1" /end CHARACTERISTIC
/begin CHARACTERISTIC DSM_SdwDfp_MeUnCDSCBat_C "Enprellzeit Shadow Zustand für Fehlerpfad Dfp_MeUnCDSCBat" VALUE 0xCC1F4 Kw_Wu16 655350.0 Time_ms 0.00 655350.0 FORMAT "%8.1" /end CHARACTERISTIC
/begin CHARACTERISTIC DSM_SdwDfp_MeUnCDSCGnd_C "Enprellzeit Shadow Zustand für Fehlerpfad Dfp_MeUnCDSCGnd" VALUE 0xCC1F6 Kw_Wu16 655350.0 Time_ms 0.00 655350.0 FORMAT "%8.1" /end CHARACTERISTIC
/begin CHARACTERISTIC DSM_SdwDfp_MeUnCD_ADC_C "Enprellzeit Shadow Zustand für Fehlerpfad Dfp_MeUnCD_ADC" VALUE 0xCC1F8 Kw_Wu16 655350.0 Time_ms 0.00 655350.0 FORMAT "%8.1" /end CHARACTERISTIC
/begin CHARACTERISTIC DSM_SdwDfp_MeUnCD_SigTst_C "Enprellzeit Shadow Zustand für Fehlerpfad Dfp_MeUnCD_SigTst" VALUE 0xCC1FA Kw_Wu16 655350.0 Time_ms 0.00 655350.0 FORMAT "%8.1" /end CHARACTERISTIC
/begin CHARACTERISTIC DSM_SdwDfp_Montr_C "Enprellzeit Shadow Zustand für Fehlerpfad Dfp_Montr" VALUE 0xCC1FC Kw_Wu16 655350.0 Time_ms 0.00 655350.0 FORMAT "%8.1" /end CHARACTERISTIC
/begin CHARACTERISTIC DSM_SdwDfp_NetMngDeviceA_C "Enprellzeit Shadow Zustand für Fehlerpfad Dfp_NetMngDeviceA" VALUE 0xCC1FE Kw_Wu16 655350.0 Time_ms 0.00 655350.0 FORMAT "%8.1" /end CHARACTERISTIC
/begin CHARACTERISTIC DSM_SdwDfp_NetMngDeviceB_C "Enprellzeit Shadow Zustand für Fehlerpfad Dfp_NetMngDeviceB" VALUE 0xCC200 Kw_Wu16 655350.0 Time_ms 0.00 655350.0 FORMAT "%8.1" /end CHARACTERISTIC
/begin CHARACTERISTIC DSM_SdwDfp_NetMngDeviceC_C "Enprellzeit Shadow Zustand für Fehlerpfad Dfp_NetMngDeviceC" VALUE 0xCC202 Kw_Wu16 655350.0 Time_ms 0.00 655350.0 FORMAT "%8.1" /end CHARACTERISTIC
/begin CHARACTERISTIC DSM_SdwDfp_OPSCD_Lamp_C "Enprellzeit Shadow Zustand für Fehlerpfad Dfp_OPSCD_Lamp" VALUE 0xCC204 Kw_Wu16 655350.0 Time_ms 0.00 655350.0 FORMAT "%8.1" /end CHARACTERISTIC
/begin CHARACTERISTIC DSM_SdwDfp_OPSCD_anain_C "Enprellzeit Shadow Zustand für Fehlerpfad Dfp_OPSCD_anain" VALUE 0xCC206 Kw_Wu16 655350.0 Time_ms 0.00 655350.0 FORMAT "%8.1" /end CHARACTERISTIC
/begin CHARACTERISTIC DSM_SdwDfp_OTSCD_C "Enprellzeit Shadow Zustand für Fehlerpfad Dfp_OTSCD" VALUE 0xCC208 Kw_Wu16 655350.0 Time_ms 0.00 655350.0 FORMAT "%8.1" /end CHARACTERISTIC
/begin CHARACTERISTIC DSM_SdwDfp_OvRMon_C "Enprellzeit Shadow Zustand für Fehlerpfad Dfp_OvRMon" VALUE 0xCC20A Kw_Wu16 655350.0 Time_ms 0.00 655350.0 FORMAT "%8.1" /end CHARACTERISTIC
/begin CHARACTERISTIC DSM_SdwDfp_OvRMonBrk_C "Enprellzeit Shadow Zustand für Fehlerpfad Dfp_OvRMonBrk" VALUE 0xCC20C Kw_Wu16 655350.0 Time_ms 0.00 655350.0 FORMAT "%8.1" /end CHARACTERISTIC
/begin CHARACTERISTIC DSM_SdwDfp_OvRMonSigA_C "Enprellzeit Shadow Zustand für Fehlerpfad Dfp_OvRMonSigA" VALUE 0xCC20E Kw_Wu16 655350.0 Time_ms 0.00 655350.0 FORMAT "%8.1" /end CHARACTERISTIC
/begin CHARACTERISTIC DSM_SdwDfp_OxiCCDTPre_C "Enprellzeit Shadow Zustand für Fehlerpfad Dfp_OxiCCDTPre" VALUE 0xCC210 Kw_Wu16 655350.0 Time_ms 0.00 655350.0 FORMAT "%8.1" /end CHARACTERISTIC
/begin CHARACTERISTIC DSM_SdwDfp_PCR_GovDevNeg_C "Enprellzeit Shadow Zustand für Fehlerpfad Dfp_PCR_GovDevNeg" VALUE 0xCC212 Kw_Wu16 655350.0 Time_ms 0.00 655350.0 FORMAT "%8.1" /end CHARACTERISTIC
/begin CHARACTERISTIC DSM_SdwDfp_PCR_GovDevPos_C "Enprellzeit Shadow Zustand für Fehlerpfad Dfp_PCR_GovDevPos" VALUE 0xCC214 Kw_Wu16 655350.0 Time_ms 0.00 655350.0 FORMAT "%8.1" /end CHARACTERISTIC
/begin CHARACTERISTIC DSM_SdwDfp_PCVCDNoLoad_C "Enprellzeit Shadow Zustand für Fehlerpfad Dfp_PCVCDNoLoad" VALUE 0xCC216 Kw_Wu16 655350.0 Time_ms 0.00 655350.0 FORMAT "%8.1" /end CHARACTERISTIC
/begin CHARACTERISTIC DSM_SdwDfp_PCVCDSCBat_C "Enprellzeit Shadow Zustand für Fehlerpfad Dfp_PCVCDSCBat" VALUE 0xCC218 Kw_Wu16 655350.0 Time_ms 0.00 655350.0 FORMAT "%8.1" /end CHARACTERISTIC
/begin CHARACTERISTIC DSM_SdwDfp_PCVCDSCGnd_C "Enprellzeit Shadow Zustand für Fehlerpfad Dfp_PCVCDSCGnd" VALUE 0xCC21A Kw_Wu16 655350.0 Time_ms 0.00 655350.0 FORMAT "%8.1" /end CHARACTERISTIC
/begin CHARACTERISTIC DSM_SdwDfp_PCVCD_ADC_C "Enprellzeit Shadow Zustand für Fehlerpfad Dfp_PCVCD_ADC" VALUE 0xCC21C Kw_Wu16 655350.0 Time_ms 0.00 655350.0 FORMAT "%8.1" /end CHARACTERISTIC
/begin CHARACTERISTIC DSM_SdwDfp_PCVCD_SigTst_C "Enprellzeit Shadow Zustand für Fehlerpfad Dfp_PCVCD_SigTst" VALUE 0xCC21E Kw_Wu16 655350.0 Time_ms 0.00 655350.0 FORMAT "%8.1" /end CHARACTERISTIC
/begin CHARACTERISTIC DSM_SdwDfp_PFltAPSens_C "Enprellzeit Shadow Zustand für Fehlerpfad Dfp_PFltAPSens" VALUE 0xCC220 Kw_Wu16 655350.0 Time_ms 0.00 655350.0 FORMAT "%8.1" /end CHARACTERISTIC
/begin CHARACTERISTIC DSM_SdwDfp_PFltCDPPre_C "Enprellzeit Shadow Zustand für Fehlerpfad Dfp_PFltCDPPre" VALUE 0xCC222 Kw_Wu16 655350.0 Time_ms 0.00 655350.0 FORMAT "%8.1" /end CHARACTERISTIC
/begin CHARACTERISTIC DSM_SdwDfp_PFltCDTempPre_C "Enprellzeit Shadow Zustand für Fehlerpfad Dfp_PFltCDTempPre" VALUE 0xCC224 Kw_Wu16 655350.0 Time_ms 0.00 655350.0 FORMAT "%8.1" /end CHARACTERISTIC
/begin CHARACTERISTIC DSM_SdwDfp_PFltChar_C "Enprellzeit Shadow Zustand für Fehlerpfad Dfp_PFltChar" VALUE 0xCC226 Kw_Wu16 655350.0 Time_ms 0.00 655350.0 FORMAT "%8.1" /end CHARACTERISTIC
/begin CHARACTERISTIC DSM_SdwDfp_PFltEngPrt_C "Enprellzeit Shadow Zustand für Fehlerpfad Dfp_PFltEngPrt" VALUE 0xCC228 Kw_Wu16 655350.0 Time_ms 0.00 655350.0 FORMAT "%8.1" /end CHARACTERISTIC
/begin CHARACTERISTIC DSM_SdwDfp_PFltPresDynPlaus_C "Enprellzeit Shadow Zustand für Fehlerpfad Dfp_PFltPresDynPlaus" VALUE 0xCC22A Kw_Wu16 655350.0 Time_ms 0.00 655350.0 FORMAT "%8.1" /end CHARACTERISTIC
/begin CHARACTERISTIC DSM_SdwDfp_PFltPresSens_C "Enprellzeit Shadow Zustand für Fehlerpfad Dfp_PFltPresSens" VALUE 0xCC22C Kw_Wu16 655350.0 Time_ms 0.00 655350.0 FORMAT "%8.1" /end CHARACTERISTIC
/begin CHARACTERISTIC DSM_SdwDfp_PFltPresSensFrz_C "Enprellzeit Shadow Zustand für Fehlerpfad Dfp_PFltPresSensFrz" VALUE 0xCC22E Kw_Wu16 655350.0 Time_ms 0.00 655350.0 FORMAT "%8.1" /end CHARACTERISTIC
/begin CHARACTERISTIC DSM_SdwDfp_PFltPresSensHsLn_C "Enprellzeit Shadow Zustand für Fehlerpfad Dfp_PFltPresSensHsLn" VALUE 0xCC230 Kw_Wu16 655350.0 Time_ms 0.00 655350.0 FORMAT "%8.1" /end CHARACTERISTIC
/begin CHARACTERISTIC DSM_SdwDfp_PFltPresSensSot_C "Enprellzeit Shadow Zustand für Fehlerpfad Dfp_PFltPresSensSot" VALUE 0xCC232 Kw_Wu16 655350.0 Time_ms 0.00 655350.0 FORMAT "%8.1" /end CHARACTERISTIC
/begin CHARACTERISTIC DSM_SdwDfp_PFltRgnPerm_C "Enprellzeit Shadow Zustand für Fehlerpfad Dfp_PFltRgnPerm" VALUE 0xCC234 Kw_Wu16 655350.0 Time_ms 0.00 655350.0 FORMAT "%8.1" /end CHARACTERISTIC
/begin CHARACTERISTIC DSM_SdwDfp_PFltTempDwnStrm_C "Enprellzeit Shadow Zustand für Fehlerpfad Dfp_PFltTempDwnStrm" VALUE 0xCC236 Kw_Wu16 655350.0 Time_ms 0.00 655350.0 FORMAT "%8.1" /end CHARACTERISTIC
/begin CHARACTERISTIC DSM_SdwDfp_PFltTempSens_C "Enprellzeit Shadow Zustand für Fehlerpfad Dfp_PFltTempSens" VALUE 0xCC238 Kw_Wu16 655350.0 Time_ms 0.00 655350.0 FORMAT "%8.1" /end CHARACTERISTIC
/begin CHARACTERISTIC DSM_SdwDfp_PFltTempUpStrm_C "Enprellzeit Shadow Zustand für Fehlerpfad Dfp_PFltTempUpStrm" VALUE 0xCC23A Kw_Wu16 655350.0 Time_ms 0.00 655350.0 FORMAT "%8.1" /end CHARACTERISTIC
/begin CHARACTERISTIC DSM_SdwDfp_PFltmSotDiffMax_C "Enprellzeit Shadow Zustand für Fehlerpfad Dfp_PFltmSotDiffMax" VALUE 0xCC23C Kw_Wu16 655350.0 Time_ms 0.00 655350.0 FORMAT "%8.1" /end CHARACTERISTIC
/begin CHARACTERISTIC DSM_SdwDfp_QLTCD_C "Enprellzeit Shadow Zustand für Fehlerpfad Dfp_QLTCD" VALUE 0xCC23E Kw_Wu16 655350.0 Time_ms 0.00 655350.0 FORMAT "%8.1" /end CHARACTERISTIC
/begin CHARACTERISTIC DSM_SdwDfp_RTMMon_C "Enprellzeit Shadow Zustand für Fehlerpfad Dfp_RTMMon" VALUE 0xCC240 Kw_Wu16 655350.0 Time_ms 0.00 655350.0 FORMAT "%8.1" /end CHARACTERISTIC
/begin CHARACTERISTIC DSM_SdwDfp_RailCD_C "Enprellzeit Shadow Zustand für Fehlerpfad Dfp_RailCD" VALUE 0xCC242 Kw_Wu16 655350.0 Time_ms 0.00 655350.0 FORMAT "%8.1" /end CHARACTERISTIC
/begin CHARACTERISTIC DSM_SdwDfp_RailCDOfsTst_C "Enprellzeit Shadow Zustand für Fehlerpfad Dfp_RailCDOfsTst" VALUE 0xCC244 Kw_Wu16 655350.0 Time_ms 0.00 655350.0 FORMAT "%8.1" /end CHARACTERISTIC
/begin CHARACTERISTIC DSM_SdwDfp_RailCD_PMonStrt_C "Enprellzeit Shadow Zustand für Fehlerpfad Dfp_RailCD_PMonStrt" VALUE 0xCC246 Kw_Wu16 655350.0 Time_ms 0.00 655350.0 FORMAT "%8.1" /end CHARACTERISTIC
/begin CHARACTERISTIC DSM_SdwDfp_RailCtlModeMeUnDiag_C "Enprellzeit Shadow Zustand für Fehlerpfad Dfp_RailCtlModeMeUnDiag" VALUE 0xCC248 Kw_Wu16 655350.0 Time_ms 0.00 655350.0 FORMAT "%8.1" /end CHARACTERISTIC
/begin CHARACTERISTIC DSM_SdwDfp_RailCtlModePCVDiag_C "Enprellzeit Shadow Zustand für Fehlerpfad Dfp_RailCtlModePCVDiag" VALUE 0xCC24A Kw_Wu16 655350.0 Time_ms 0.00 655350.0 FORMAT "%8.1" /end CHARACTERISTIC
/begin CHARACTERISTIC DSM_SdwDfp_RailMeUn0_C "Enprellzeit Shadow Zustand für Fehlerpfad Dfp_RailMeUn0" VALUE 0xCC24C Kw_Wu16 655350.0 Time_ms 0.00 655350.0 FORMAT "%8.1" /end CHARACTERISTIC
/begin CHARACTERISTIC DSM_SdwDfp_RailMeUn1_C "Enprellzeit Shadow Zustand für Fehlerpfad Dfp_RailMeUn1" VALUE 0xCC24E Kw_Wu16 655350.0 Time_ms 0.00 655350.0 FORMAT "%8.1" /end CHARACTERISTIC
/begin CHARACTERISTIC DSM_SdwDfp_RailMeUn2_C "Enprellzeit Shadow Zustand für Fehlerpfad Dfp_RailMeUn2" VALUE 0xCC250 Kw_Wu16 655350.0 Time_ms 0.00 655350.0 FORMAT "%8.1" /end CHARACTERISTIC
/begin CHARACTERISTIC DSM_SdwDfp_RailMeUn3_C "Enprellzeit Shadow Zustand für Fehlerpfad Dfp_RailMeUn3" VALUE 0xCC252 Kw_Wu16 655350.0 Time_ms 0.00 655350.0 FORMAT "%8.1" /end CHARACTERISTIC
/begin CHARACTERISTIC DSM_SdwDfp_RailMeUn4_C "Enprellzeit Shadow Zustand für Fehlerpfad Dfp_RailMeUn4" VALUE 0xCC254 Kw_Wu16 655350.0 Time_ms 0.00 655350.0 FORMAT "%8.1" /end CHARACTERISTIC
/begin CHARACTERISTIC DSM_SdwDfp_RailPCV0_C "Enprellzeit Shadow Zustand für Fehlerpfad Dfp_RailPCV0" VALUE 0xCC256 Kw_Wu16 655350.0 Time_ms 0.00 655350.0 FORMAT "%8.1" /end CHARACTERISTIC
/begin CHARACTERISTIC DSM_SdwDfp_RailPCV1_C "Enprellzeit Shadow Zustand für Fehlerpfad Dfp_RailPCV1" VALUE 0xCC258 Kw_Wu16 655350.0 Time_ms 0.00 655350.0 FORMAT "%8.1" /end CHARACTERISTIC
/begin CHARACTERISTIC DSM_SdwDfp_RailPCV2_C "Enprellzeit Shadow Zustand für Fehlerpfad Dfp_RailPCV2" VALUE 0xCC25A Kw_Wu16 655350.0 Time_ms 0.00 655350.0 FORMAT "%8.1" /end CHARACTERISTIC
/begin CHARACTERISTIC DSM_SdwDfp_RailPCV3_C "Enprellzeit Shadow Zustand für Fehlerpfad Dfp_RailPCV3" VALUE 0xCC25C Kw_Wu16 655350.0 Time_ms 0.00 655350.0 FORMAT "%8.1" /end CHARACTERISTIC
/begin CHARACTERISTIC DSM_SdwDfp_RailPCV4_C "Enprellzeit Shadow Zustand für Fehlerpfad Dfp_RailPCV4" VALUE 0xCC25E Kw_Wu16 655350.0 Time_ms 0.00 655350.0 FORMAT "%8.1" /end CHARACTERISTIC
/begin CHARACTERISTIC DSM_SdwDfp_RailPCV5_C "Enprellzeit Shadow Zustand für Fehlerpfad Dfp_RailPCV5" VALUE 0xCC260 Kw_Wu16 655350.0 Time_ms 0.00 655350.0 FORMAT "%8.1" /end CHARACTERISTIC
/begin CHARACTERISTIC DSM_SdwDfp_SOPTst_C "Enprellzeit Shadow Zustand für Fehlerpfad Dfp_SOPTst" VALUE 0xCC262 Kw_Wu16 655350.0 Time_ms 0.00 655350.0 FORMAT "%8.1" /end CHARACTERISTIC
/begin CHARACTERISTIC DSM_SdwDfp_SSpMon1_C "Enprellzeit Shadow Zustand für Fehlerpfad Dfp_SSpMon1" VALUE 0xCC264 Kw_Wu16 655350.0 Time_ms 0.00 655350.0 FORMAT "%8.1" /end CHARACTERISTIC
/begin CHARACTERISTIC DSM_SdwDfp_SSpMon2_C "Enprellzeit Shadow Zustand für Fehlerpfad Dfp_SSpMon2" VALUE 0xCC266 Kw_Wu16 655350.0 Time_ms 0.00 655350.0 FORMAT "%8.1" /end CHARACTERISTIC
/begin CHARACTERISTIC DSM_SdwDfp_SSpMon3_C "Enprellzeit Shadow Zustand für Fehlerpfad Dfp_SSpMon3" VALUE 0xCC268 Kw_Wu16 655350.0 Time_ms 0.00 655350.0 FORMAT "%8.1" /end CHARACTERISTIC
/begin CHARACTERISTIC DSM_SdwDfp_ShutCD_C "Enprellzeit Shadow Zustand für Fehlerpfad Dfp_ShutCD" VALUE 0xCC26A Kw_Wu16 655350.0 Time_ms 0.00 655350.0 FORMAT "%8.1" /end CHARACTERISTIC
/begin CHARACTERISTIC DSM_SdwDfp_StSysTrqShutOff_C "Enprellzeit Shadow Zustand für Fehlerpfad Dfp_StSysTrqShutOff" VALUE 0xCC26C Kw_Wu16 655350.0 Time_ms 0.00 655350.0 FORMAT "%8.1" /end CHARACTERISTIC
/begin CHARACTERISTIC DSM_SdwDfp_StrtCD_Actr_C "Enprellzeit Shadow Zustand für Fehlerpfad Dfp_StrtCD_Actr" VALUE 0xCC26E Kw_Wu16 655350.0 Time_ms 0.00 655350.0 FORMAT "%8.1" /end CHARACTERISTIC
/begin CHARACTERISTIC DSM_SdwDfp_SysLamp_C "Enprellzeit Shadow Zustand für Fehlerpfad Dfp_SysLamp" VALUE 0xCC270 Kw_Wu16 655350.0 Time_ms 0.00 655350.0 FORMAT "%8.1" /end CHARACTERISTIC
/begin CHARACTERISTIC DSM_SdwDfp_T15CD_C "Enprellzeit Shadow Zustand für Fehlerpfad Dfp_T15CD" VALUE 0xCC272 Kw_Wu16 655350.0 Time_ms 0.00 655350.0 FORMAT "%8.1" /end CHARACTERISTIC
/begin CHARACTERISTIC DSM_SdwDfp_TGearbx_C "Enprellzeit Shadow Zustand für Fehlerpfad Dfp_TGearbx" VALUE 0xCC274 Kw_Wu16 655350.0 Time_ms 0.00 655350.0 FORMAT "%8.1" /end CHARACTERISTIC
/begin CHARACTERISTIC DSM_SdwDfp_TPUMon_C "Enprellzeit Shadow Zustand für Fehlerpfad Dfp_TPUMon" VALUE 0xCC276 Kw_Wu16 655350.0 Time_ms 0.00 655350.0 FORMAT "%8.1" /end CHARACTERISTIC
/begin CHARACTERISTIC DSM_SdwDfp_TVACD_Max_C "Enprellzeit Shadow Zustand für Fehlerpfad Dfp_TVACD_Max" VALUE 0xCC278 Kw_Wu16 655350.0 Time_ms 0.00 655350.0 FORMAT "%8.1" /end CHARACTERISTIC
/begin CHARACTERISTIC DSM_SdwDfp_TVACD_Min_C "Enprellzeit Shadow Zustand für Fehlerpfad Dfp_TVACD_Min" VALUE 0xCC27A Kw_Wu16 655350.0 Time_ms 0.00 655350.0 FORMAT "%8.1" /end CHARACTERISTIC
/begin CHARACTERISTIC DSM_SdwDfp_TVACD_SigNpl_C "Enprellzeit Shadow Zustand für Fehlerpfad Dfp_TVACD_SigNpl" VALUE 0xCC27C Kw_Wu16 655350.0 Time_ms 0.00 655350.0 FORMAT "%8.1" /end CHARACTERISTIC
/begin CHARACTERISTIC DSM_SdwDfp_TVACD_TVADia1_C "Enprellzeit Shadow Zustand für Fehlerpfad Dfp_TVACD_TVADia1" VALUE 0xCC27E Kw_Wu16 655350.0 Time_ms 0.00 655350.0 FORMAT "%8.1" /end CHARACTERISTIC
/begin CHARACTERISTIC DSM_SdwDfp_TVACD_TVADia2_C "Enprellzeit Shadow Zustand für Fehlerpfad Dfp_TVACD_TVADia2" VALUE 0xCC280 Kw_Wu16 655350.0 Time_ms 0.00 655350.0 FORMAT "%8.1" /end CHARACTERISTIC
/begin CHARACTERISTIC DSM_SdwDfp_TVACD_TVADia3_C "Enprellzeit Shadow Zustand für Fehlerpfad Dfp_TVACD_TVADia3" VALUE 0xCC282 Kw_Wu16 655350.0 Time_ms 0.00 655350.0 FORMAT "%8.1" /end CHARACTERISTIC
/begin CHARACTERISTIC DSM_SdwDfp_VSACD_Max_C "Enprellzeit Shadow Zustand für Fehlerpfad Dfp_VSACD_Max" VALUE 0xCC284 Kw_Wu16 655350.0 Time_ms 0.00 655350.0 FORMAT "%8.1" /end CHARACTERISTIC
/begin CHARACTERISTIC DSM_SdwDfp_VSACD_Min_C "Enprellzeit Shadow Zustand für Fehlerpfad Dfp_VSACD_Min" VALUE 0xCC286 Kw_Wu16 655350.0 Time_ms 0.00 655350.0 FORMAT "%8.1" /end CHARACTERISTIC
/begin CHARACTERISTIC DSM_SdwDfp_VSACD_SigNpl_C "Enprellzeit Shadow Zustand für Fehlerpfad Dfp_VSACD_SigNpl" VALUE 0xCC288 Kw_Wu16 655350.0 Time_ms 0.00 655350.0 FORMAT "%8.1" /end CHARACTERISTIC
/begin CHARACTERISTIC DSM_SdwDfp_VSACD_VSADia1_C "Enprellzeit Shadow Zustand für Fehlerpfad Dfp_VSACD_VSADia1" VALUE 0xCC28A Kw_Wu16 655350.0 Time_ms 0.00 655350.0 FORMAT "%8.1" /end CHARACTERISTIC
/begin CHARACTERISTIC DSM_SdwDfp_VSACD_VSADia2_C "Enprellzeit Shadow Zustand für Fehlerpfad Dfp_VSACD_VSADia2" VALUE 0xCC28C Kw_Wu16 655350.0 Time_ms 0.00 655350.0 FORMAT "%8.1" /end CHARACTERISTIC
/begin CHARACTERISTIC DSM_SdwDfp_VSACD_VSADia3_C "Enprellzeit Shadow Zustand für Fehlerpfad Dfp_VSACD_VSADia3" VALUE 0xCC28E Kw_Wu16 655350.0 Time_ms 0.00 655350.0 FORMAT "%8.1" /end CHARACTERISTIC
/begin CHARACTERISTIC DSM_SdwDfp_VSACD_VSADia4_C "Enprellzeit Shadow Zustand für Fehlerpfad Dfp_VSACD_VSADia4" VALUE 0xCC290 Kw_Wu16 655350.0 Time_ms 0.00 655350.0 FORMAT "%8.1" /end CHARACTERISTIC
/begin CHARACTERISTIC DSM_SdwDfp_VSSCD1_C "Enprellzeit Shadow Zustand für Fehlerpfad Dfp_VSSCD1" VALUE 0xCC292 Kw_Wu16 655350.0 Time_ms 0.00 655350.0 FORMAT "%8.1" /end CHARACTERISTIC
/begin CHARACTERISTIC DSM_SdwDfp_VSSCD2_C "Enprellzeit Shadow Zustand für Fehlerpfad Dfp_VSSCD2" VALUE 0xCC294 Kw_Wu16 655350.0 Time_ms 0.00 655350.0 FORMAT "%8.1" /end CHARACTERISTIC
/begin CHARACTERISTIC DSM_SdwDfp_WdCom_C "Enprellzeit Shadow Zustand für Fehlerpfad Dfp_WdCom" VALUE 0xCC296 Kw_Wu16 655350.0 Time_ms 0.00 655350.0 FORMAT "%8.1" /end CHARACTERISTIC
/begin MEASUREMENT DSM_FCM_mp "Fehlerspeicher" UBYTE OneToOne 1 100 0.00 255.0 FORMAT "%5.1" ARRAY_SIZE 644 ECU_ADDRESS 0x8FE840 /end MEASUREMENT
/begin MEASUREMENT Fid_ACCIRevErr_mp "Ist diese Fid verriegelt, so geht die ACC-Momentenschnittstelle in den Zustand ""irreversibler Fehler""" UBYTE OneToOne 1 100 0.00 255.0 FORMAT "%5.1" ECU_ADDRESS 0x8FEAC4 /end MEASUREMENT
/begin MEASUREMENT Fid_AccPed_Brk_mp "Verriegelung der Freigabe der Überprüfung auf Unplausibilität  bei defekter Bremse" UBYTE OneToOne 1 100 0.00 255.0 FORMAT "%5.1" ECU_ADDRESS 0x8FEAC5 /end MEASUREMENT
/begin MEASUREMENT Fid_AccPed_mp "Messpunkt fuer Funktions Identifier Fid_AccPed" UBYTE OneToOne 1 100 0.00 255.0 FORMAT "%5.1" ECU_ADDRESS 0x8FEAC6 /end MEASUREMENT
/begin MEASUREMENT Fid_ACCRevErr_mp "Ist diese Fid verriegelt, so geht die ACC-Momentenschnittstelle in den Zustand ""reversibler Fehler""" UBYTE OneToOne 1 100 0.00 255.0 FORMAT "%5.1" ECU_ADDRESS 0x8FEAC7 /end MEASUREMENT
/begin MEASUREMENT Fid_ACCtl_ACTrqErr_mp "Messpunkt fuer Funktions Identifier Fid_ACCtl_ACTrqErr" UBYTE OneToOne 1 100 0.00 255.0 FORMAT "%5.1" ECU_ADDRESS 0x8FEAC8 /end MEASUREMENT
/begin MEASUREMENT Fid_ACCtl_CTSErr_mp "Messpunkt fuer Funktions Identifier Fid_ACCtl_CTSErr" UBYTE OneToOne 1 100 0.00 255.0 FORMAT "%5.1" ECU_ADDRESS 0x8FEAC9 /end MEASUREMENT
/begin MEASUREMENT Fid_ACCtl_FanErr_mp "Messpunkt fuer Funktions Identifier Fid_ACCtl_FanErr" UBYTE OneToOne 1 100 0.00 255.0 FORMAT "%5.1" ECU_ADDRESS 0x8FEACA /end MEASUREMENT
/begin MEASUREMENT Fid_ACCtl_TGearbxErr_mp "Messpunkt fuer Funktions Identifier Fid_ACCtl_TGearbxErr" UBYTE OneToOne 1 100 0.00 255.0 FORMAT "%5.1" ECU_ADDRESS 0x8FEACB /end MEASUREMENT
/begin MEASUREMENT Fid_ACCtl_VSSErr_mp "Messpunkt fuer Funktions Identifier Fid_ACCtl_VSSErr" UBYTE OneToOne 1 100 0.00 255.0 FORMAT "%5.1" ECU_ADDRESS 0x8FEACC /end MEASUREMENT
/begin MEASUREMENT Fid_ACC_AliveErr_mp "Ist diese Fid verriegelt, so geht die ACC-Momentenschnittstelle in Zustand ""irreversiler Fehler""" UBYTE OneToOne 1 100 0.00 255.0 FORMAT "%5.1" ECU_ADDRESS 0x8FEACD /end MEASUREMENT
/begin MEASUREMENT Fid_ACC_CsErr_mp "Ist diese Fid verriegelt, so geht die ACC-Momentenschnittstelle in den Zustand ""irreversibler Fehler""" UBYTE OneToOne 1 100 0.00 255.0 FORMAT "%5.1" ECU_ADDRESS 0x8FEACE /end MEASUREMENT
/begin MEASUREMENT Fid_ACC_TiOutErr_mp "Ist diese Fid verriegelt, so geht die ACC-Momentenschnittstelle in den Zustand ""reversibler Fehler""" UBYTE OneToOne 1 100 0.00 255.0 FORMAT "%5.1" ECU_ADDRESS 0x8FEACF /end MEASUREMENT
/begin MEASUREMENT Fid_AFSCD_AirPerTime_mp "Messpunkt für Funktions Identifier Fid_AFSCD_AirPerTime" UBYTE OneToOne 1 100 0.00 255.0 FORMAT "%5.1" ECU_ADDRESS 0x8FEAD0 /end MEASUREMENT
/begin MEASUREMENT Fid_AFSCD_mp "Messpunkt für Funktions Identifier Fid_AFSCD" UBYTE OneToOne 1 100 0.00 255.0 FORMAT "%5.1" ECU_ADDRESS 0x8FEAD1 /end MEASUREMENT
/begin MEASUREMENT Fid_AFSCD_PlOffsDrft_mp "Messpunkt fuer Funktions Identifier Fid_AFSCD_PlOffsDrft" UBYTE OneToOne 1 100 0.00 255.0 FORMAT "%5.1" ECU_ADDRESS 0x8FEAD2 /end MEASUREMENT
/begin MEASUREMENT Fid_AFSCD_PlSetyDrft_mp "Messpunkt für Funktions Identifier Fid_AFSCD_PlSetyDrft" UBYTE OneToOne 1 100 0.00 255.0 FORMAT "%5.1" ECU_ADDRESS 0x8FEAD3 /end MEASUREMENT
/begin MEASUREMENT Fid_AFSCD_SRCCorrAirm_mp "Fid zur Verriegelung des SRC des korrigierten Sensorsignals (HFM6)" UBYTE OneToOne 1 100 0.00 255.0 FORMAT "%5.1" ECU_ADDRESS 0x8FEAD4 /end MEASUREMENT
/begin MEASUREMENT Fid_AFSCD_SRCDcyc_mp "Fid zur Verriegelung des SRC des Tastverhältnisses des Temperatursignals" UBYTE OneToOne 1 100 0.00 255.0 FORMAT "%5.1" ECU_ADDRESS 0x8FEAD5 /end MEASUREMENT
/begin MEASUREMENT Fid_AFSCD_SRCRawAirm_mp "Fid zur Verriegelung des SRC des unkorrigierten Sensorsignals (HFM6)" UBYTE OneToOne 1 100 0.00 255.0 FORMAT "%5.1" ECU_ADDRESS 0x8FEAD6 /end MEASUREMENT
/begin MEASUREMENT Fid_AFSCD_SRCRefSig_mp "Fid zur Verriegelung des SRC der Periodendauer des Referenz- bzw Temperatursignals" UBYTE OneToOne 1 100 0.00 255.0 FORMAT "%5.1" ECU_ADDRESS 0x8FEAD7 /end MEASUREMENT
/begin MEASUREMENT Fid_AFS_CanMon_mp "Messpunkt fuer Funktions Identifier Fid_AFS_CanMon" UBYTE OneToOne 1 100 0.00 255.0 FORMAT "%5.1" ECU_ADDRESS 0x8FEAD8 /end MEASUREMENT
/begin MEASUREMENT Fid_AFS_GenDisableCond_mp "Messpunkt fuer Funktions Identifier Fid_AFS_GenDisableCond" UBYTE OneToOne 1 100 0.00 255.0 FORMAT "%5.1" ECU_ADDRESS 0x8FEAD9 /end MEASUREMENT
/begin MEASUREMENT Fid_AirCtlNeg2_mp "Messpunkt fuer Funktions Identifier Fid_AirCtlNeg2" UBYTE OneToOne 1 100 0.00 255.0 FORMAT "%5.1" ECU_ADDRESS 0x8FEADA /end MEASUREMENT
/begin MEASUREMENT Fid_AirCtlNeg_mp "Messpunkt fuer Funktions Identifier Fid_AirCtlNeg" UBYTE OneToOne 1 100 0.00 255.0 FORMAT "%5.1" ECU_ADDRESS 0x8FEADB /end MEASUREMENT
/begin MEASUREMENT Fid_AirCtlPFltEGRRed_mp "AirCtlPFltEGRRed fault identifier" UBYTE OneToOne 1 100 0.00 255.0 FORMAT "%5.1" ECU_ADDRESS 0x8FEADC /end MEASUREMENT
/begin MEASUREMENT Fid_AirCtlPlateBreakActv_mp "Messpunkt fuer Funktions Identifier Fid_AirCtlPlateBreakActv" UBYTE OneToOne 1 100 0.00 255.0 FORMAT "%5.1" ECU_ADDRESS 0x8FEADD /end MEASUREMENT
/begin MEASUREMENT Fid_AirCtlPlateBreak_mp "Fid for plate break monitoring" UBYTE OneToOne 1 100 0.00 255.0 FORMAT "%5.1" ECU_ADDRESS 0x8FEADE /end MEASUREMENT
/begin MEASUREMENT Fid_AirCtlPos2_mp "Messpunkt fuer Funktions Identifier Fid_AirCtlPos2" UBYTE OneToOne 1 100 0.00 255.0 FORMAT "%5.1" ECU_ADDRESS 0x8FEADF /end MEASUREMENT
/begin MEASUREMENT Fid_AirCtlPos_mp "Messpunkt fuer Funktions Identifier Fid_AirCtlPos" UBYTE OneToOne 1 100 0.00 255.0 FORMAT "%5.1" ECU_ADDRESS 0x8FEAE0 /end MEASUREMENT
/begin MEASUREMENT Fid_AirCtl_Brk_mp "Fid zum Deaktvieren der Fehlerausblendung bei betätigter Bremse" UBYTE OneToOne 1 100 0.00 255.0 FORMAT "%5.1" ECU_ADDRESS 0x8FEAE1 /end MEASUREMENT
/begin MEASUREMENT Fid_AirCtl_mp "Messpunkt fuer Funktions Identifier Fid_AirCtl" UBYTE OneToOne 1 100 0.00 255.0 FORMAT "%5.1" ECU_ADDRESS 0x8FEAE2 /end MEASUREMENT
/begin MEASUREMENT Fid_AOHt_ShutOffErr_mp "Messpunkt fuer Funktions Identifier Fid_AOHt_ShutOffErr" UBYTE OneToOne 1 100 0.00 255.0 FORMAT "%5.1" ECU_ADDRESS 0x8FEAE3 /end MEASUREMENT
/begin MEASUREMENT Fid_APP1_mp "Messpunkt fuer Funktions Identifier Fid_APP1" UBYTE OneToOne 1 100 0.00 255.0 FORMAT "%5.1" ECU_ADDRESS 0x8FEAE4 /end MEASUREMENT
/begin MEASUREMENT Fid_APP2_mp "Messpunkt fuer Funktions Identifier Fid_APP2" UBYTE OneToOne 1 100 0.00 255.0 FORMAT "%5.1" ECU_ADDRESS 0x8FEAE5 /end MEASUREMENT
/begin MEASUREMENT Fid_APSCD_mp "Messpunkt fuer Funktions Identifier Fid_APSCD" UBYTE OneToOne 1 100 0.00 255.0 FORMAT "%5.1" ECU_ADDRESS 0x8FEAE6 /end MEASUREMENT
/begin MEASUREMENT Fid_ARSOff_mp "Fid for error reaction" UBYTE OneToOne 1 100 0.00 255.0 FORMAT "%5.1" ECU_ADDRESS 0x8FEAE7 /end MEASUREMENT
/begin MEASUREMENT Fid_ASDdc_mp "Messpunkt fuer Funktions Identifier Fid_ASDdc" UBYTE OneToOne 1 100 0.00 255.0 FORMAT "%5.1" ECU_ADDRESS 0x8FEAE8 /end MEASUREMENT
/begin MEASUREMENT Fid_ASModSwtOffEng_mp "Messpunkt für function identifier Fid_ASModSwtOffEng" UBYTE OneToOne 1 100 0.00 255.0 FORMAT "%5.1" ECU_ADDRESS 0x8FEAE9 /end MEASUREMENT
/begin MEASUREMENT Fid_ASModSwtOffIndVol_mp "Meßpunkt für function identifier Fid_ASModSwtOffIndVol" UBYTE OneToOne 1 100 0.00 255.0 FORMAT "%5.1" ECU_ADDRESS 0x8FEAEA /end MEASUREMENT
/begin MEASUREMENT Fid_BPSCDMon_mp "Messpunkt fuer Funktions Identifier Fid_BPSCDMon" UBYTE OneToOne 1 100 0.00 255.0 FORMAT "%5.1" ECU_ADDRESS 0x8FEAEB /end MEASUREMENT
/begin MEASUREMENT Fid_ClgDynTst_mp "Messpunkt fuer Funktions Identifier Fid_ClgDynTst" UBYTE OneToOne 1 100 0.00 255.0 FORMAT "%5.1" ECU_ADDRESS 0x8FEAEC /end MEASUREMENT
/begin MEASUREMENT Fid_CmbChb_mp "Messpunkt fuer Funktions Identifier Fid_CmbChb" UBYTE OneToOne 1 100 0.00 255.0 FORMAT "%5.1" ECU_ADDRESS 0x8FEAED /end MEASUREMENT
/begin MEASUREMENT Fid_CoDT_GripDeb_mp "Messpunkt fuer Funktions Identifier Fid_CoDT_GripDeb" UBYTE OneToOne 1 100 0.00 255.0 FORMAT "%5.1" ECU_ADDRESS 0x8FEAEE /end MEASUREMENT
/begin MEASUREMENT Fid_CoEngIRevSys1_mp "Messpunkt fuer Funktions Identifier Fid_CoEngIRevSys1" UBYTE OneToOne 1 100 0.00 255.0 FORMAT "%5.1" ECU_ADDRESS 0x8FEAEF /end MEASUREMENT
/begin MEASUREMENT Fid_CoEngIRevSys2_mp "Messpunkt fuer Funktions Identifier Fid_CoEngIRevSys2" UBYTE OneToOne 1 100 0.00 255.0 FORMAT "%5.1" ECU_ADDRESS 0x8FEAF0 /end MEASUREMENT
/begin MEASUREMENT Fid_CoEngIRevVeh_mp "Freigabe, sofern keine irreversiblen Fahrzeugfehler vorhanden" UBYTE OneToOne 1 100 0.00 255.0 FORMAT "%5.1" ECU_ADDRESS 0x8FEAF1 /end MEASUREMENT
/begin MEASUREMENT Fid_CoEngPFltErr_mp "Messpunkt fuer Funktions Identifier Fid_CoEngPFltErr" UBYTE OneToOne 1 100 0.00 255.0 FORMAT "%5.1" ECU_ADDRESS 0x8FEAF2 /end MEASUREMENT
/begin MEASUREMENT Fid_CoEngRevSys1_mp "Messpunkt fuer Funktions Identifier Fid_CoEngRevSys1" UBYTE OneToOne 1 100 0.00 255.0 FORMAT "%5.1" ECU_ADDRESS 0x8FEAF3 /end MEASUREMENT
/begin MEASUREMENT Fid_CoEngRevSys2_mp "Messpunkt fuer Funktions Identifier Fid_CoEngRevSys2" UBYTE OneToOne 1 100 0.00 255.0 FORMAT "%5.1" ECU_ADDRESS 0x8FEAF4 /end MEASUREMENT
/begin MEASUREMENT Fid_CoEngRevVeh_mp "Freigabe, sofern keine reversiblen Fahrzeugfehler vorliegen" UBYTE OneToOne 1 100 0.00 255.0 FORMAT "%5.1" ECU_ADDRESS 0x8FEAF5 /end MEASUREMENT
/begin MEASUREMENT Fid_CoEngShOffTst_mp "Messpunkt fuer Funktions Identifier Fid_CoEngShOffTst" UBYTE OneToOne 1 100 0.00 255.0 FORMAT "%5.1" ECU_ADDRESS 0x8FEAF6 /end MEASUREMENT
/begin MEASUREMENT Fid_CoEngSoftShOffTV_mp "Messpunkt fuer Funktions Identifier Fid_CoEngSoftShOffTV" UBYTE OneToOne 1 100 0.00 255.0 FORMAT "%5.1" ECU_ADDRESS 0x8FEAF7 /end MEASUREMENT
/begin MEASUREMENT Fid_CoEng_ActrPrt_mp "Messpunkt fuer Funktions Identifier Fid_CoEng_ActrPrt" UBYTE OneToOne 1 100 0.00 255.0 FORMAT "%5.1" ECU_ADDRESS 0x8FEAF8 /end MEASUREMENT
/begin MEASUREMENT Fid_CoEng_Nrml2Strt_mp "Messpunkt fuer Funktions Identifier Fid_CoEng_Nrml2Strt" UBYTE OneToOne 1 100 0.00 255.0 FORMAT "%5.1" ECU_ADDRESS 0x8FEAF9 /end MEASUREMENT
/begin MEASUREMENT Fid_CoEng_PwrStgEnable_mp "Messpunkt fuer Funktions Identifier Fid_CoEng_PwrStgEnable" UBYTE OneToOne 1 100 0.00 255.0 FORMAT "%5.1" ECU_ADDRESS 0x8FEAFA /end MEASUREMENT
/begin MEASUREMENT Fid_CoEng_trqLimErr1_mp "Fid für die Aktivierung eines limitierten Moments bei fehlerhaften Raildruck" UBYTE OneToOne 1 100 0.00 255.0 FORMAT "%5.1" ECU_ADDRESS 0x8FEAFB /end MEASUREMENT
/begin MEASUREMENT Fid_CoEng_trqLimErr2_mp "Messpunkt fuer Funktions Identifier Fid_CoEng_trqLimErr2" UBYTE OneToOne 1 100 0.00 255.0 FORMAT "%5.1" ECU_ADDRESS 0x8FEAFC /end MEASUREMENT
/begin MEASUREMENT Fid_CoEng_trqLimErr_mp "Messpunkt für Funktions Identifier Fid_CoEng_trqLimErr" UBYTE OneToOne 1 100 0.00 255.0 FORMAT "%5.1" ECU_ADDRESS 0x8FEAFD /end MEASUREMENT
/begin MEASUREMENT Fid_CoVehtrqLimErr_mp "Messpunkt fuer Funktions Identifier Fid_CoVehtrqLimErr" UBYTE OneToOne 1 100 0.00 255.0 FORMAT "%5.1" ECU_ADDRESS 0x8FEAFE /end MEASUREMENT
/begin MEASUREMENT Fid_CoVM_StabDem_Err_mp "Messpunkt fuer Funktions Identifier Fid_CoVM_StabDem_Err" UBYTE OneToOne 1 100 0.00 255.0 FORMAT "%5.1" ECU_ADDRESS 0x8FEAFF /end MEASUREMENT
/begin MEASUREMENT Fid_CrCtlShutOffIr_mp "Messpunkt fuer Funktions Identifier Fid_CrCtlShutOffIr" UBYTE OneToOne 1 100 0.00 255.0 FORMAT "%5.1" ECU_ADDRESS 0x8FEB00 /end MEASUREMENT
/begin MEASUREMENT Fid_CrCtl_ASCTimeout_mp "Messpunkt fuer Funktions Identifier Fid_CrCtl_ASCTimeout" UBYTE OneToOne 1 100 0.00 255.0 FORMAT "%5.1" ECU_ADDRESS 0x8FEB01 /end MEASUREMENT
/begin MEASUREMENT Fid_CrCtl_CanDef_mp "Abschaltung CrCtl am Slave bei Fehler Privater CAN" UBYTE OneToOne 1 100 0.00 255.0 FORMAT "%5.1" ECU_ADDRESS 0x8FEB02 /end MEASUREMENT
/begin MEASUREMENT Fid_CrCtl_KombiTimeout_mp "lokale Größe" UBYTE OneToOne 1 100 0.00 255.0 FORMAT "%5.1" ECU_ADDRESS 0x8FEB03 /end MEASUREMENT
/begin MEASUREMENT Fid_CrCtl_vCrCtl_mp "Messpunkt fuer Funktions Identifier Fid_CrCtl_vCrCtl" UBYTE OneToOne 1 100 0.00 255.0 FORMAT "%5.1" ECU_ADDRESS 0x8FEB04 /end MEASUREMENT
/begin MEASUREMENT Fid_CTSCDFlTemp_mp "Messpunkt fuer Funktions Identifier Fid_CTSCDFlTemp" UBYTE OneToOne 1 100 0.00 255.0 FORMAT "%5.1" ECU_ADDRESS 0x8FEB05 /end MEASUREMENT
/begin MEASUREMENT Fid_CTSCD_Plaus_mp "Messpunkt fuer Funktions Identifier Fid_CTSCD_Plaus" UBYTE OneToOne 1 100 0.00 255.0 FORMAT "%5.1" ECU_ADDRESS 0x8FEB06 /end MEASUREMENT
/begin MEASUREMENT Fid_DSM_Wuc_mp "Messpunkt fuer Funktions Identifier Fid_DSM_Wuc" UBYTE OneToOne 1 100 0.00 255.0 FORMAT "%5.1" ECU_ADDRESS 0x8FEB07 /end MEASUREMENT
/begin MEASUREMENT Fid_EATSCDTSubs_mp "Messpunkt fuer Funktions Identifier Fid_EATSCDTSubs" UBYTE OneToOne 1 100 0.00 255.0 FORMAT "%5.1" ECU_ADDRESS 0x8FEB08 /end MEASUREMENT
/begin MEASUREMENT Fid_EBAFCD_mp "Messpunkt fuer Funktions Identifier Fid_EBAFCD" UBYTE OneToOne 1 100 0.00 255.0 FORMAT "%5.1" ECU_ADDRESS 0x8FEB09 /end MEASUREMENT
/begin MEASUREMENT Fid_EBFCD_mp "Messpunkt fuer Funktions Identifier Fid_EBFCD" UBYTE OneToOne 1 100 0.00 255.0 FORMAT "%5.1" ECU_ADDRESS 0x8FEB0A /end MEASUREMENT
/begin MEASUREMENT Fid_ECU_mp "Messpunkt fuer Funktions Identifier Fid_ECU" UBYTE OneToOne 1 100 0.00 255.0 FORMAT "%5.1" ECU_ADDRESS 0x8FEB0B /end MEASUREMENT
/begin MEASUREMENT Fid_EGSysCoLSU0_mp "Messpunkt für Function Identifier Fid_EGSysCoLSU0" UBYTE OneToOne 1 100 0.00 255.0 FORMAT "%5.1" ECU_ADDRESS 0x8FEB0C /end MEASUREMENT
/begin MEASUREMENT Fid_EGSysCoNSC_mp "Messpunkt für Function Identifier Fid_EGSysCoNSC" UBYTE OneToOne 1 100 0.00 255.0 FORMAT "%5.1" ECU_ADDRESS 0x8FEB0D /end MEASUREMENT
/begin MEASUREMENT Fid_EGSysCoOxi_mp "Messpunkt für Function Identifier Fid_EGSysCoOxi" UBYTE OneToOne 1 100 0.00 255.0 FORMAT "%5.1" ECU_ADDRESS 0x8FEB0E /end MEASUREMENT
/begin MEASUREMENT Fid_EGSysCoTrbn_mp "Messpunkt für Function Identifier Fid_EGSysCoTrbn" UBYTE OneToOne 1 100 0.00 255.0 FORMAT "%5.1" ECU_ADDRESS 0x8FEB0F /end MEASUREMENT
/begin MEASUREMENT Fid_EGSysCoTube0_mp "Messpunkt für Function Identifier Fid_EGSysCoTube0" UBYTE OneToOne 1 100 0.00 255.0 FORMAT "%5.1" ECU_ADDRESS 0x8FEB10 /end MEASUREMENT
/begin MEASUREMENT Fid_EGSysCoTube1_mp "Messpunkt für Function Identifier Fid_EGSysCoTube1" UBYTE OneToOne 1 100 0.00 255.0 FORMAT "%5.1" ECU_ADDRESS 0x8FEB11 /end MEASUREMENT
/begin MEASUREMENT Fid_EGSysHtgDel_mp "Messpunkt für Function Identifier Fid_EGSysHtgDel" UBYTE OneToOne 1 100 0.00 255.0 FORMAT "%5.1" ECU_ADDRESS 0x8FEB12 /end MEASUREMENT
/begin MEASUREMENT Fid_EGSysNSC_mp "Messpunkt für Function Identifier NSC" UBYTE OneToOne 1 100 0.00 255.0 FORMAT "%5.1" ECU_ADDRESS 0x8FEB13 /end MEASUREMENT
/begin MEASUREMENT Fid_EGSysOxiCat_mp "Messpunkt für Function Identifier OxiCat" UBYTE OneToOne 1 100 0.00 255.0 FORMAT "%5.1" ECU_ADDRESS 0x8FEB14 /end MEASUREMENT
/begin MEASUREMENT Fid_EGSysPresEnv_mp "Messpunkt für Function Identifier Fid_EGSysPresEnv" UBYTE OneToOne 1 100 0.00 255.0 FORMAT "%5.1" ECU_ADDRESS 0x8FEB15 /end MEASUREMENT
/begin MEASUREMENT Fid_EGSysStrt_mp "Messpunkt für Function Identifier Fid_EGSysStrt" UBYTE OneToOne 1 100 0.00 255.0 FORMAT "%5.1" ECU_ADDRESS 0x8FEB16 /end MEASUREMENT
/begin MEASUREMENT Fid_EGSysTemp_mp "Messpunkt für Function Identifier Fid_EGSysTemp" UBYTE OneToOne 1 100 0.00 255.0 FORMAT "%5.1" ECU_ADDRESS 0x8FEB17 /end MEASUREMENT
/begin MEASUREMENT Fid_EGSysTrbn_mp "Messpunkt für Function Identifier Fid_EGSysTrbn" UBYTE OneToOne 1 100 0.00 255.0 FORMAT "%5.1" ECU_ADDRESS 0x8FEB18 /end MEASUREMENT
/begin MEASUREMENT Fid_EGSysTube_mp "Messpunkt für Function Identifier Tube" UBYTE OneToOne 1 100 0.00 255.0 FORMAT "%5.1" ECU_ADDRESS 0x8FEB19 /end MEASUREMENT
/begin MEASUREMENT Fid_EGSys_AP_mp "Fehler des Atmosphärendruckfühlers" UBYTE OneToOne 1 100 0.00 255.0 FORMAT "%5.1" ECU_ADDRESS 0x8FEB1A /end MEASUREMENT
/begin MEASUREMENT Fid_EGTRgnLck_mp "Function indentifier zur Verriegelung einer Regeneration bei Überschreiten der kritischen Ölverdünnungszeit" UBYTE OneToOne 1 100 0.00 255.0 FORMAT "%5.1" ECU_ADDRESS 0x8FEB1B /end MEASUREMENT
/begin MEASUREMENT Fid_EGTTempGvnrAirCtl_mp "Fehler Erkennung für dauernde Regelabweichung des Luftmassenreglers" UBYTE OneToOne 1 100 0.00 255.0 FORMAT "%5.1" ECU_ADDRESS 0x8FEB1C /end MEASUREMENT
/begin MEASUREMENT Fid_EGTTempGvnrInr_mp "Function Identifier für Temperatur des inneren Regelkreises" UBYTE OneToOne 1 100 0.00 255.0 FORMAT "%5.1" ECU_ADDRESS 0x8FEB1D /end MEASUREMENT
/begin MEASUREMENT Fid_EGTTempGvnrOutr_mp "Function Identifier für Temperatur des äußeren Regelkreises" UBYTE OneToOne 1 100 0.00 255.0 FORMAT "%5.1" ECU_ADDRESS 0x8FEB1E /end MEASUREMENT
/begin MEASUREMENT Fid_EngCTSCD_mp "Messpunkt fuer Funktions Identifier Fid_EngCTSCD" UBYTE OneToOne 1 100 0.00 255.0 FORMAT "%5.1" ECU_ADDRESS 0x8FEB1F /end MEASUREMENT
/begin MEASUREMENT Fid_EngMCaSBackUp_mp "Verriegelung des Betriebs nur mit Nockenwellensignal bei einem Nockenwellensignalfehler" UBYTE OneToOne 1 100 0.00 255.0 FORMAT "%5.1" ECU_ADDRESS 0x8FEB20 /end MEASUREMENT
/begin MEASUREMENT Fid_EngMCrSBackUp_mp "sobald der Komponententreiber CrSCD einen Fehler meldet wird über diese Fid in den BackUp mode gewechselt" UBYTE OneToOne 1 100 0.00 255.0 FORMAT "%5.1" ECU_ADDRESS 0x8FEB21 /end MEASUREMENT
/begin MEASUREMENT Fid_EngMTEng_mp "Fid for EngM_EngMntCtl subsystem" UBYTE OneToOne 1 100 0.00 255.0 FORMAT "%5.1" ECU_ADDRESS 0x8FEB22 /end MEASUREMENT
/begin MEASUREMENT Fid_EngMTrqFrcPDiff_mp "Messpunkt für Function Identifier" UBYTE OneToOne 1 100 0.00 255.0 FORMAT "%5.1" ECU_ADDRESS 0x8FEB23 /end MEASUREMENT
/begin MEASUREMENT Fid_EngMVVeh_mp "Fid for EngM_EngMntCtl subsystem" UBYTE OneToOne 1 100 0.00 255.0 FORMAT "%5.1" ECU_ADDRESS 0x8FEB24 /end MEASUREMENT
/begin MEASUREMENT Fid_EngM_ChkStrtSpd_mp "Messpunkt fuer Funktions Identifier Fid_EngM_ChkStrtSpd" UBYTE OneToOne 1 100 0.00 255.0 FORMAT "%5.1" ECU_ADDRESS 0x8FEB25 /end MEASUREMENT
/begin MEASUREMENT Fid_EngPrt_nLimErr_mp "Messpunkt für Funktions Identifier bei zusätzlicher Drezahlbegrenzung im Systemfehlerfall" UBYTE OneToOne 1 100 0.00 255.0 FORMAT "%5.1" ECU_ADDRESS 0x8FEB26 /end MEASUREMENT
/begin MEASUREMENT Fid_ETClbCorActv_mp "Messpunkt fuer Funktions Identifier Fid_ETClbCorActv" UBYTE OneToOne 1 100 0.00 255.0 FORMAT "%5.1" ECU_ADDRESS 0x8FEB27 /end MEASUREMENT
/begin MEASUREMENT Fid_FanCtl_mp "Messpunkt fuer Funktions Identifier Fid_FanCtl" UBYTE OneToOne 1 100 0.00 255.0 FORMAT "%5.1" ECU_ADDRESS 0x8FEB28 /end MEASUREMENT
/begin MEASUREMENT Fid_FanGbxOil_mp "fault identifier for Gear box oil temperature" UBYTE OneToOne 1 100 0.00 255.0 FORMAT "%5.1" ECU_ADDRESS 0x8FEB29 /end MEASUREMENT
/begin MEASUREMENT Fid_FBCMonI_mp "Messpunkt fuer Funktions Identifier Fid_FBCMonI" UBYTE OneToOne 1 100 0.00 255.0 FORMAT "%5.1" ECU_ADDRESS 0x8FEB2A /end MEASUREMENT
/begin MEASUREMENT Fid_FBC_mp "Messpunkt für Funktions-Identifier Fid_FBC_mp" UBYTE OneToOne 1 100 0.00 255.0 FORMAT "%5.1" ECU_ADDRESS 0x8FEB2B /end MEASUREMENT
/begin MEASUREMENT Fid_FlMngFullLdRglOff_mp "Messpunkt fuer Funktions Identifier Fid_FlMngFullLdRglOff" UBYTE OneToOne 1 100 0.00 255.0 FORMAT "%5.1" ECU_ADDRESS 0x8FEB2C /end MEASUREMENT
/begin MEASUREMENT Fid_FlMngSmkDefect_mp "Messpunkt fuer Funktions Identifier Fid_FlMngSmkDefect" UBYTE OneToOne 1 100 0.00 255.0 FORMAT "%5.1" ECU_ADDRESS 0x8FEB2D /end MEASUREMENT
/begin MEASUREMENT Fid_FlSysCTSSens_mp "Fid zur Deaktivierung der Verwendung der Wassertemperatur als Kraftstoffsystemtemperatur" UBYTE OneToOne 1 100 0.00 255.0 FORMAT "%5.1" ECU_ADDRESS 0x8FEB2E /end MEASUREMENT
/begin MEASUREMENT Fid_FlSysDens_mp "Verriegelung der Sensorerfassung für die Kraftstofftemperatur" UBYTE OneToOne 1 100 0.00 255.0 FORMAT "%5.1" ECU_ADDRESS 0x8FEB2F /end MEASUREMENT
/begin MEASUREMENT Fid_FlSysFTSSens_mp "Fid zur Deaktivierung der Verwendung der Kraftstofftemperatur als Kraftstoffsystemtemperatur" UBYTE OneToOne 1 100 0.00 255.0 FORMAT "%5.1" ECU_ADDRESS 0x8FEB30 /end MEASUREMENT
/begin MEASUREMENT Fid_FMASwtOff1_mp "Meßpunkt für FMA-Abschaltung bei leichten Systemfehlern (Abschaltmöglichkeit 1)" UBYTE OneToOne 1 100 0.00 255.0 FORMAT "%5.1" ECU_ADDRESS 0x8FEB31 /end MEASUREMENT
/begin MEASUREMENT Fid_FMASwtOff3_mp "Meßpunkt für FMA-Abschaltung bei schweren Systemfehlern (Abschaltmöglichkeit 3)" UBYTE OneToOne 1 100 0.00 255.0 FORMAT "%5.1" ECU_ADDRESS 0x8FEB32 /end MEASUREMENT
/begin MEASUREMENT Fid_FMTC_AirCorr_mp "Veriegelung der Eta-Korrektur für Luftmasse pro Zylinder" UBYTE OneToOne 1 100 0.00 255.0 FORMAT "%5.1" ECU_ADDRESS 0x8FEB33 /end MEASUREMENT
/begin MEASUREMENT Fid_FMTC_SOECorr_mp "Veriegelung der Eta-Korrektur für den Spritzbeginn" UBYTE OneToOne 1 100 0.00 255.0 FORMAT "%5.1" ECU_ADDRESS 0x8FEB34 /end MEASUREMENT
/begin MEASUREMENT Fid_FrmMngAddLevl_mp "Messpunkt fuer Funktions Identifier Fid_FrmMngAddLevl" UBYTE OneToOne 1 100 0.00 255.0 FORMAT "%5.1" ECU_ADDRESS 0x8FEB35 /end MEASUREMENT
/begin MEASUREMENT Fid_FrmMngAPP_mp "Messpunkt fuer Funktions Identifier Fid_FrmMngAPP" UBYTE OneToOne 1 100 0.00 255.0 FORMAT "%5.1" ECU_ADDRESS 0x8FEB36 /end MEASUREMENT
/begin MEASUREMENT Fid_FrmMngARS_mp "Messpunkt fuer Funktions Identifier Fid_FrmMngARS" UBYTE OneToOne 1 100 0.00 255.0 FORMAT "%5.1" ECU_ADDRESS 0x8FEB37 /end MEASUREMENT
/begin MEASUREMENT Fid_FrmMngBrkDef_mp "Messpunkt fuer Funktions Identifier Fid_FrmMngBrkDef" UBYTE OneToOne 1 100 0.00 255.0 FORMAT "%5.1" ECU_ADDRESS 0x8FEB38 /end MEASUREMENT
/begin MEASUREMENT Fid_FrmMngBrk_mp "Messpunkt fuer Funktions Identifier Fid_FrmMngBrk" UBYTE OneToOne 1 100 0.00 255.0 FORMAT "%5.1" ECU_ADDRESS 0x8FEB39 /end MEASUREMENT
/begin MEASUREMENT Fid_FrmMngCoEng_mp "Messpunkt fuer Funktions Identifier Fid_FrmMngCoEng" UBYTE OneToOne 1 100 0.00 255.0 FORMAT "%5.1" ECU_ADDRESS 0x8FEB3A /end MEASUREMENT
/begin MEASUREMENT Fid_FrmMngCoEng_St2_mp "Messpunkt fuer Funktions Identifier Fid_FrmMngCoEng_St2" UBYTE OneToOne 1 100 0.00 255.0 FORMAT "%5.1" ECU_ADDRESS 0x8FEB3B /end MEASUREMENT
/begin MEASUREMENT Fid_FrmMngConvDef_mp "Messpunkt fuer Funktions Identifier Fid_FrmMngConvDef" UBYTE OneToOne 1 100 0.00 255.0 FORMAT "%5.1" ECU_ADDRESS 0x8FEB3C /end MEASUREMENT
/begin MEASUREMENT Fid_FrmMngEngRpmTemp_mp "Messpunkt für Funktions Identifier Fid_FrmMngEngRpmTemp" UBYTE OneToOne 1 100 0.00 255.0 FORMAT "%5.1" ECU_ADDRESS 0x8FEB3D /end MEASUREMENT
/begin MEASUREMENT Fid_FrmMngEngSpd_mp "Messpunkt fuer Funktions Identifier Fid_FrmMngEngSpd" UBYTE OneToOne 1 100 0.00 255.0 FORMAT "%5.1" ECU_ADDRESS 0x8FEB3E /end MEASUREMENT
/begin MEASUREMENT Fid_FrmMngInjDU1_mp "Messpunkt fuer Funktions Identifier Fid_FrmMngInjDU1" UBYTE OneToOne 1 100 0.00 255.0 FORMAT "%5.1" ECU_ADDRESS 0x8FEB3F /end MEASUREMENT
/begin MEASUREMENT Fid_FrmMngInjDU2_mp "Messpunkt fuer Funktions Identifier Fid_FrmMngInjDU2" UBYTE OneToOne 1 100 0.00 255.0 FORMAT "%5.1" ECU_ADDRESS 0x8FEB40 /end MEASUREMENT
/begin MEASUREMENT Fid_FrmMngInjVlv_mp "Messpunkt fuer Funktions Identifier Fid_FrmMngInjVlv" UBYTE OneToOne 1 100 0.00 255.0 FORMAT "%5.1" ECU_ADDRESS 0x8FEB41 /end MEASUREMENT
/begin MEASUREMENT Fid_FrmMngnSetpoint_mp "Messpunkt fuer Funktions Identifier Fid_FrmMngnSetpoint" UBYTE OneToOne 1 100 0.00 255.0 FORMAT "%5.1" ECU_ADDRESS 0x8FEB42 /end MEASUREMENT
/begin MEASUREMENT Fid_FrmMngOBDCtl_mp "Messpunkt fuer Funktions Identifier Fid_FrmMngOBDCtl" UBYTE OneToOne 1 100 0.00 255.0 FORMAT "%5.1" ECU_ADDRESS 0x8FEB43 /end MEASUREMENT
/begin MEASUREMENT Fid_FrmMngParkConsumer_mp "Messpunkt fuer Funktions Identifier Fid_FrmMngParkConsumer" UBYTE OneToOne 1 100 0.00 255.0 FORMAT "%5.1" ECU_ADDRESS 0x8FEB44 /end MEASUREMENT
/begin MEASUREMENT Fid_FrmMngPFltDef_mp "Messpunkt fuer Funktions Identifier Fid_FrmMngPFltDef" UBYTE OneToOne 1 100 0.00 255.0 FORMAT "%5.1" ECU_ADDRESS 0x8FEB45 /end MEASUREMENT
/begin MEASUREMENT Fid_FrmMngPla_DSC_mp "Fid for DSC defect" UBYTE OneToOne 1 100 0.00 255.0 FORMAT "%5.1" ECU_ADDRESS 0x8FEB46 /end MEASUREMENT
/begin MEASUREMENT Fid_FrmMngPla_EGS_mp "Messpunkt fuer Funktions Identifier Fid_FrmMngPla_EGS" UBYTE OneToOne 1 100 0.00 255.0 FORMAT "%5.1" ECU_ADDRESS 0x8FEB47 /end MEASUREMENT
/begin MEASUREMENT Fid_FrmMngpVal_mp "Messpunkt fuer Funktions Identifier Fid_FrmMngpVal" UBYTE OneToOne 1 100 0.00 255.0 FORMAT "%5.1" ECU_ADDRESS 0x8FEB48 /end MEASUREMENT
/begin MEASUREMENT Fid_FrmMngPwrMngLIGovSt_mp "Messpunkt fuer Funktions Identifier Fid_FrmMngPwrMngLIGovSt" UBYTE OneToOne 1 100 0.00 255.0 FORMAT "%5.1" ECU_ADDRESS 0x8FEB49 /end MEASUREMENT
/begin MEASUREMENT Fid_FrmMngSIG_ARS_mp "Messpunkt fuer Funktions Identifier Fid_FrmMngSIG_ARS" UBYTE OneToOne 1 100 0.00 255.0 FORMAT "%5.1" ECU_ADDRESS 0x8FEB4A /end MEASUREMENT
/begin MEASUREMENT Fid_FrmMngSIG_DSC_mp "Messpunkt fuer Funktions Identifier Fid_FrmMngSIG_DSC" UBYTE OneToOne 1 100 0.00 255.0 FORMAT "%5.1" ECU_ADDRESS 0x8FEB4B /end MEASUREMENT
/begin MEASUREMENT Fid_FrmMngSig_EGS_mp "Messpunkt fuer Funktions Identifier Fid_FrmMngSIG_EGS" UBYTE OneToOne 1 100 0.00 255.0 FORMAT "%5.1" ECU_ADDRESS 0x8FEB4C /end MEASUREMENT
/begin MEASUREMENT Fid_FrmMngtEng_mp "Messpunkt fuer Funktions Identifier Fid_FrmMngtEng" UBYTE OneToOne 1 100 0.00 255.0 FORMAT "%5.1" ECU_ADDRESS 0x8FEB4D /end MEASUREMENT
/begin MEASUREMENT Fid_FrmMngTO_ARS_mp "Messpunkt fuer Funktions Identifier Fid_FrmMngTO_ARS" UBYTE OneToOne 1 100 0.00 255.0 FORMAT "%5.1" ECU_ADDRESS 0x8FEB4E /end MEASUREMENT
/begin MEASUREMENT Fid_FrmMngTO_DSC_mp "Messpunkt fuer Funktions Identifier Fid_FrmMngTO_DSC" UBYTE OneToOne 1 100 0.00 255.0 FORMAT "%5.1" ECU_ADDRESS 0x8FEB4F /end MEASUREMENT
/begin MEASUREMENT Fid_FrmMngTo_EGS_mp "Messpunkt fuer Funktions Identifier Fid_FrmMngTO_EGS" UBYTE OneToOne 1 100 0.00 255.0 FORMAT "%5.1" ECU_ADDRESS 0x8FEB50 /end MEASUREMENT
/begin MEASUREMENT Fid_FrmMngWaterVlv_mp "Fid for heating current defect" UBYTE OneToOne 1 100 0.00 255.0 FORMAT "%5.1" ECU_ADDRESS 0x8FEB51 /end MEASUREMENT
/begin MEASUREMENT Fid_FrmMng_ST_TORQ_mp "Messpunkt fuer Funktions Identifier Fid_FrmMng_ST_TORQ" UBYTE OneToOne 1 100 0.00 255.0 FORMAT "%5.1" ECU_ADDRESS 0x8FEB52 /end MEASUREMENT
/begin MEASUREMENT Fid_FTSCDErr_mp "Messpunkt fuer Funktions Identifier Fid_FTSCDErr" UBYTE OneToOne 1 100 0.00 255.0 FORMAT "%5.1" ECU_ADDRESS 0x8FEB53 /end MEASUREMENT
/begin MEASUREMENT Fid_FWOscDet_mp "Fid for Fly Wheel Oscillation detection" UBYTE OneToOne 1 100 0.00 255.0 FORMAT "%5.1" ECU_ADDRESS 0x8FEB54 /end MEASUREMENT
/begin MEASUREMENT Fid_GearbxDrvAwayInactiv_mp "Fid zur Deaktivierung der Anfahrmomentbegrenzung" UBYTE OneToOne 1 100 0.00 255.0 FORMAT "%5.1" ECU_ADDRESS 0x8FEB55 /end MEASUREMENT
/begin MEASUREMENT Fid_GearbxDrvAway_mp "Fid zur Aktivierung der Anfahrmomentbegrenzung" UBYTE OneToOne 1 100 0.00 255.0 FORMAT "%5.1" ECU_ADDRESS 0x8FEB56 /end MEASUREMENT
/begin MEASUREMENT Fid_GearbxPtCANErr_mp "Messpunkt fuer Funktions Identifier Fid_GearbxPtCANErr" UBYTE OneToOne 1 100 0.00 255.0 FORMAT "%5.1" ECU_ADDRESS 0x8FEB57 /end MEASUREMENT
/begin MEASUREMENT Fid_GearbxTrqLimErr_mp "Messpunkt fuer Funktions Identifier Fid_GearbxTrqLimErr" UBYTE OneToOne 1 100 0.00 255.0 FORMAT "%5.1" ECU_ADDRESS 0x8FEB58 /end MEASUREMENT
/begin MEASUREMENT Fid_Gearbx_GearDet_mp "Messpunkt fuer Funktions Identifier Fid_Gearbx_GearDet" UBYTE OneToOne 1 100 0.00 255.0 FORMAT "%5.1" ECU_ADDRESS 0x8FEB59 /end MEASUREMENT
/begin MEASUREMENT Fid_Gearbx_TrqIntv_Err_mp "Messpunkt fuer Funktions Identifier Fid_Gearbx_TrqIntv_Err" UBYTE OneToOne 1 100 0.00 255.0 FORMAT "%5.1" ECU_ADDRESS 0x8FEB5A /end MEASUREMENT
/begin MEASUREMENT Fid_GlwCtl1_mp "Freigabe der Berechnung der Nachglühzeit aus einem Kennfeld; keine Freigabe bei defektem Kühlmittel-Temperatur-Sensor" UBYTE OneToOne 1 100 0.00 255.0 FORMAT "%5.1" ECU_ADDRESS 0x8FEB5B /end MEASUREMENT
/begin MEASUREMENT Fid_HDC_mp "Messpunkt fuer Funktions Identifier Fid_HDC" UBYTE OneToOne 1 100 0.00 255.0 FORMAT "%5.1" ECU_ADDRESS 0x8FEB5C /end MEASUREMENT
/begin MEASUREMENT Fid_IndSys1_mp "Messpunkt fuer Funktions Identifier Fid_IndSys1" UBYTE OneToOne 1 100 0.00 255.0 FORMAT "%5.1" ECU_ADDRESS 0x8FEB5D /end MEASUREMENT
/begin MEASUREMENT Fid_IndSys2_mp "Messpunkt fuer Funktions Identifier Fid_IndSys2" UBYTE OneToOne 1 100 0.00 255.0 FORMAT "%5.1" ECU_ADDRESS 0x8FEB5E /end MEASUREMENT
/begin MEASUREMENT Fid_InjCrvCoErr_mp "Messpunkt fuer Funktions Identifier Fid_InjCtl_qLimErr" UBYTE OneToOne 1 100 0.00 255.0 FORMAT "%5.1" ECU_ADDRESS 0x8FEB5F /end MEASUREMENT
/begin MEASUREMENT Fid_InjCtl_qLimErr_mp "Messpunkt fuer Funktions Identifier Fid_InjCtl_qLimErr" UBYTE OneToOne 1 100 0.00 255.0 FORMAT "%5.1" ECU_ADDRESS 0x8FEB60 /end MEASUREMENT
/begin MEASUREMENT Fid_InjVCDCls_mp "Messpunkt für Funktionsidentifier Fid_InjVCDCls" UBYTE OneToOne 1 100 0.00 255.0 FORMAT "%5.1" ECU_ADDRESS 0x8FEB61 /end MEASUREMENT
/begin MEASUREMENT Fid_InjVlvActrTemp_mp "Messpunkt für Funktionsidentifier Fid_InjVlvActrTemp" UBYTE OneToOne 1 100 0.00 255.0 FORMAT "%5.1" ECU_ADDRESS 0x8FEB62 /end MEASUREMENT
/begin MEASUREMENT Fid_InjVlvInjLim_mp "Messpunkt für Funktionsidentifier Fid_InjVlvInjLim" UBYTE OneToOne 1 100 0.00 255.0 FORMAT "%5.1" ECU_ADDRESS 0x8FEB63 /end MEASUREMENT
/begin MEASUREMENT Fid_InjVlvMon_mp "Messpunkt fuer Funktions Identifier Fid_InjVlvMon" UBYTE OneToOne 1 100 0.00 255.0 FORMAT "%5.1" ECU_ADDRESS 0x8FEB64 /end MEASUREMENT
/begin MEASUREMENT Fid_InjVlvNVC_mp "Messpunkt fuer Funktions Identifier Fid_InjVlvNVC" UBYTE OneToOne 1 100 0.00 255.0 FORMAT "%5.1" ECU_ADDRESS 0x8FEB65 /end MEASUREMENT
/begin MEASUREMENT Fid_InjVlvSetUpVolt_mp "Meßpunkt für Funktionsidentifier Fid_InjVlvSetUpVolt" UBYTE OneToOne 1 100 0.00 255.0 FORMAT "%5.1" ECU_ADDRESS 0x8FEB66 /end MEASUREMENT
/begin MEASUREMENT Fid_InjVlvWvCorOff_mp "Fid der Druckwellenkorrektur" UBYTE OneToOne 1 100 0.00 255.0 FORMAT "%5.1" ECU_ADDRESS 0x8FEB67 /end MEASUREMENT
/begin MEASUREMENT Fid_Layer_FI_TANS_mp "" UBYTE OneToOne 1 100 0.00 255.0 FORMAT "%5.1" ECU_ADDRESS 0x8FEB68 /end MEASUREMENT
/begin MEASUREMENT Fid_Layer_FI_TUMG_mp "" UBYTE OneToOne 1 100 0.00 255.0 FORMAT "%5.1" ECU_ADDRESS 0x8FEB69 /end MEASUREMENT
/begin MEASUREMENT Fid_LIGovSetpDrvAway_mp "Messpunkt fuer Funktions Identifier Fid_LIGovSetpDrvAway" UBYTE OneToOne 1 100 0.00 255.0 FORMAT "%5.1" ECU_ADDRESS 0x8FEB6A /end MEASUREMENT
/begin MEASUREMENT Fid_LIGovSetpointDrvAwy_mp "Messpunkt fuer Funktions Identifier Fid_LIGovSetpointDrvAwy" UBYTE OneToOne 1 100 0.00 255.0 FORMAT "%5.1" ECU_ADDRESS 0x8FEB6B /end MEASUREMENT
/begin MEASUREMENT Fid_LIGovUbr_mp "Messpunkt fuer Funktions Identifier Fid_LIGovUbr" UBYTE OneToOne 1 100 0.00 255.0 FORMAT "%5.1" ECU_ADDRESS 0x8FEB6C /end MEASUREMENT
/begin MEASUREMENT Fid_LSUCDactiv0_mp "Messpunkt fuer Funktions Identifier Fid_LSUCDactiv0" UBYTE OneToOne 1 100 0.00 255.0 FORMAT "%5.1" ECU_ADDRESS 0x8FEB6D /end MEASUREMENT
/begin MEASUREMENT Fid_LSUCDlsu0_mp "Messpunkt fuer Funktions Identifier Fid_LSUCDlsu0" UBYTE OneToOne 1 100 0.00 255.0 FORMAT "%5.1" ECU_ADDRESS 0x8FEB6E /end MEASUREMENT
/begin MEASUREMENT Fid_LSUCDMon0_mp "Messpunkt fuer Funktions Identifier Fid_LSUCDMon0" UBYTE OneToOne 1 100 0.00 255.0 FORMAT "%5.1" ECU_ADDRESS 0x8FEB6F /end MEASUREMENT
/begin MEASUREMENT Fid_LSUCDO20_mp "Messpunkt fuer Funktions Identifier Fid_LSUCDO20" UBYTE OneToOne 1 100 0.00 255.0 FORMAT "%5.1" ECU_ADDRESS 0x8FEB70 /end MEASUREMENT
/begin MEASUREMENT Fid_LSUCDRi0_mp "Messpunkt fuer Funktions Identifier Fid_LSUCDRi0" UBYTE OneToOne 1 100 0.00 255.0 FORMAT "%5.1" ECU_ADDRESS 0x8FEB71 /end MEASUREMENT
/begin MEASUREMENT Fid_LSUClbSched_mp "Fid zur Unterdrückung der CJ125-Kalibrierung im Falle einer defekten Batterie" UBYTE OneToOne 1 100 0.00 255.0 FORMAT "%5.1" ECU_ADDRESS 0x8FEB72 /end MEASUREMENT
/begin MEASUREMENT Fid_LSUCtl0_mp "Messpunkt fuer Funktions Identifier Fid_LSUCtl0" UBYTE OneToOne 1 100 0.00 255.0 FORMAT "%5.1" ECU_ADDRESS 0x8FEB73 /end MEASUREMENT
/begin MEASUREMENT Fid_LSUMonAllChecks_mp "Messpunkt fuer Funktions Identifier Fid_LSUMonAllChecks" UBYTE OneToOne 1 100 0.00 255.0 FORMAT "%5.1" ECU_ADDRESS 0x8FEB74 /end MEASUREMENT
/begin MEASUREMENT Fid_LSUMonPlausChk_mp "Messpunkt fuer Funktions Identifier Fid_LSUMonPlausChk" UBYTE OneToOne 1 100 0.00 255.0 FORMAT "%5.1" ECU_ADDRESS 0x8FEB75 /end MEASUREMENT
/begin MEASUREMENT Fid_MeUnCDCalcI_mp "Fehleridentifier um den I-Anteil des Stromreglers für die Zumesseinheit einzufrieren" UBYTE OneToOne 1 100 0.00 255.0 FORMAT "%5.1" ECU_ADDRESS 0x8FEB76 /end MEASUREMENT
/begin MEASUREMENT Fid_MSidCD_ECU_mp "Messpunkt fuer Funktions Identifier Fid_MSidCD_ECU" UBYTE OneToOne 1 100 0.00 255.0 FORMAT "%5.1" ECU_ADDRESS 0x8FEB77 /end MEASUREMENT
/begin MEASUREMENT Fid_MSidCD_Pin_mp "Messpunkt fuer Funktions Identifier Fid_MSidCD_Pin" UBYTE OneToOne 1 100 0.00 255.0 FORMAT "%5.1" ECU_ADDRESS 0x8FEB78 /end MEASUREMENT
/begin MEASUREMENT Fid_OTSCD_mp "Messpunkt fuer Funktions Identifier Fid_OTSCD" UBYTE OneToOne 1 100 0.00 255.0 FORMAT "%5.1" ECU_ADDRESS 0x8FEB79 /end MEASUREMENT
/begin MEASUREMENT Fid_PCRBalGvnr_mp "Messpunkt fuer Funktions Identifier Fid_PCRBalGvnr" UBYTE OneToOne 1 100 0.00 255.0 FORMAT "%5.1" ECU_ADDRESS 0x8FEB7A /end MEASUREMENT
/begin MEASUREMENT Fid_PCRExtnLimActr_mp "Function identifier shut-off correction of the actuator limitation because of increasing backpressure upstream from  part. filte" UBYTE OneToOne 1 100 0.00 255.0 FORMAT "%5.1" ECU_ADDRESS 0x8FEB7B /end MEASUREMENT
/begin MEASUREMENT Fid_PCRGvnrDvtNeg_mp "Messpunkt fuer Funktions Identifier Fid_PCRGvnrDvtNeg" UBYTE OneToOne 1 100 0.00 255.0 FORMAT "%5.1" ECU_ADDRESS 0x8FEB7C /end MEASUREMENT
/begin MEASUREMENT Fid_PCRGvnrDvtPos_mp "Messpunkt fuer Funktions Identifier Fid_PCRGvnrDvtPos" UBYTE OneToOne 1 100 0.00 255.0 FORMAT "%5.1" ECU_ADDRESS 0x8FEB7D /end MEASUREMENT
/begin MEASUREMENT Fid_PCRSurgeLIGov_mp "Fault path identifier for Anti-Surge LIGov" UBYTE OneToOne 1 100 0.00 255.0 FORMAT "%5.1" ECU_ADDRESS 0x8FEB7E /end MEASUREMENT
/begin MEASUREMENT Fid_PCR_mp "Messpunkt fuer Funktions Identifier Fid_PCR" UBYTE OneToOne 1 100 0.00 255.0 FORMAT "%5.1" ECU_ADDRESS 0x8FEB7F /end MEASUREMENT
/begin MEASUREMENT Fid_PCR_MS_mp "Messpunkt fuer Funktions Identifier Fid_PCR_MS" UBYTE OneToOne 1 100 0.00 255.0 FORMAT "%5.1" ECU_ADDRESS 0x8FEB80 /end MEASUREMENT
/begin MEASUREMENT Fid_PCVCDCalcI_mp "Fehleridentifier um den I-Anteil des Stromreglers für das Druckregelventil einzufrieren" UBYTE OneToOne 1 100 0.00 255.0 FORMAT "%5.1" ECU_ADDRESS 0x8FEB81 /end MEASUREMENT
/begin MEASUREMENT Fid_PFltAshCorRgn_mp "function identifier zur Freigabe der Regenerationsanforderung" UBYTE OneToOne 1 100 0.00 255.0 FORMAT "%5.1" ECU_ADDRESS 0x8FEB82 /end MEASUREMENT
/begin MEASUREMENT Fid_PFltAshCor_mp "Messpunkt fuer Funktions Identifier Fid_PFltAshCor" UBYTE OneToOne 1 100 0.00 255.0 FORMAT "%5.1" ECU_ADDRESS 0x8FEB83 /end MEASUREMENT
/begin MEASUREMENT Fid_PFltBrk_mp "Function Identifier für Bremssignal" UBYTE OneToOne 1 100 0.00 255.0 FORMAT "%5.1" ECU_ADDRESS 0x8FEB84 /end MEASUREMENT
/begin MEASUREMENT Fid_PFltChar_mp "Fid für Verhinderung Resflow-SRC" UBYTE OneToOne 1 100 0.00 255.0 FORMAT "%5.1" ECU_ADDRESS 0x8FEB85 /end MEASUREMENT
/begin MEASUREMENT Fid_PFltChngPar_mp "Messpunkt fuer Funktions Identifier Fid_PFltChngPar" UBYTE OneToOne 1 100 0.00 255.0 FORMAT "%5.1" ECU_ADDRESS 0x8FEB86 /end MEASUREMENT
/begin MEASUREMENT Fid_PFltClth_mp "Function Identifier für Kupplungssignal" UBYTE OneToOne 1 100 0.00 255.0 FORMAT "%5.1" ECU_ADDRESS 0x8FEB87 /end MEASUREMENT
/begin MEASUREMENT Fid_PFltDiagRls1_mp "Messpunkt fuer Funktions Identifier Fid_PFltDiagRls" UBYTE OneToOne 1 100 0.00 255.0 FORMAT "%5.1" ECU_ADDRESS 0x8FEB88 /end MEASUREMENT
/begin MEASUREMENT Fid_PFltDiagRls2_mp "Messpunkt fuer Funktions Identifier Fid_PFltDiagRls" UBYTE OneToOne 1 100 0.00 255.0 FORMAT "%5.1" ECU_ADDRESS 0x8FEB89 /end MEASUREMENT
/begin MEASUREMENT Fid_PFltDynChk_mp "Messpunkt fuer Funktions Identifier Fid_PFltDynChk" UBYTE OneToOne 1 100 0.00 255.0 FORMAT "%5.1" ECU_ADDRESS 0x8FEB8A /end MEASUREMENT
/begin MEASUREMENT Fid_PFltGearDet_mp "Function Identifier für Gangsignal" UBYTE OneToOne 1 100 0.00 255.0 FORMAT "%5.1" ECU_ADDRESS 0x8FEB8B /end MEASUREMENT
/begin MEASUREMENT Fid_PFltHsLnChk_mp "Messpunkt fuer Funktions Identifier Fid_PFltHsLnChk" UBYTE OneToOne 1 100 0.00 255.0 FORMAT "%5.1" ECU_ADDRESS 0x8FEB8C /end MEASUREMENT
/begin MEASUREMENT Fid_PFltLckRgnErr_mp "Messpunkt fuer Funktions Identifier Fid_PFltLckRgnErr" UBYTE OneToOne 1 100 0.00 255.0 FORMAT "%5.1" ECU_ADDRESS 0x8FEB8D /end MEASUREMENT
/begin MEASUREMENT Fid_PFltLckRgnFuel_mp "Fid für PFlt-Kraftstoff-Verriegelungsregeneration" UBYTE OneToOne 1 100 0.00 255.0 FORMAT "%5.1" ECU_ADDRESS 0x8FEB8E /end MEASUREMENT
/begin MEASUREMENT Fid_PFltPlausPres_mp "Messpunkt fuer Funktions Identifier Fid_PFltPlausPres" UBYTE OneToOne 1 100 0.00 255.0 FORMAT "%5.1" ECU_ADDRESS 0x8FEB8F /end MEASUREMENT
/begin MEASUREMENT Fid_PFltPlausTemp_mp "Messpunkt fuer Funktions Identifier Fid_PFltPlausTemp" UBYTE OneToOne 1 100 0.00 255.0 FORMAT "%5.1" ECU_ADDRESS 0x8FEB90 /end MEASUREMENT
/begin MEASUREMENT Fid_PFltPPreErr_mp "function identifier,Pressure sensor" UBYTE OneToOne 1 100 0.00 255.0 FORMAT "%5.1" ECU_ADDRESS 0x8FEB91 /end MEASUREMENT
/begin MEASUREMENT Fid_PFltPresSensFrz_mp "Messpunkt fuer Funktions Identifier Fid_PFltPresSensFrz" UBYTE OneToOne 1 100 0.00 255.0 FORMAT "%5.1" ECU_ADDRESS 0x8FEB92 /end MEASUREMENT
/begin MEASUREMENT Fid_PFltPresSensHsLn_mp "Fid für Verhinderung der Schlauchleitungsüberwachung der Drucksensoren" UBYTE OneToOne 1 100 0.00 255.0 FORMAT "%5.1" ECU_ADDRESS 0x8FEB93 /end MEASUREMENT
/begin MEASUREMENT Fid_PFltSimOn_mp "wenn aktiv wird von Beladungsmessung auf Simulation umgesch." UBYTE OneToOne 1 100 0.00 255.0 FORMAT "%5.1" ECU_ADDRESS 0x8FEB94 /end MEASUREMENT
/begin MEASUREMENT Fid_PFltSpdVeh_mp "Function Identifier für Fahrzeugsgeschwindigkeit" UBYTE OneToOne 1 100 0.00 255.0 FORMAT "%5.1" ECU_ADDRESS 0x8FEB95 /end MEASUREMENT
/begin MEASUREMENT Fid_PFltSRCPres_mp "Messpunkt fuer Funktions Identifier Fid_PFltSRCPres" UBYTE OneToOne 1 100 0.00 255.0 FORMAT "%5.1" ECU_ADDRESS 0x8FEB96 /end MEASUREMENT
/begin MEASUREMENT Fid_PFltSRCTemp_mp "Fid für Verhinderung Temperatursensor-SRC" UBYTE OneToOne 1 100 0.00 255.0 FORMAT "%5.1" ECU_ADDRESS 0x8FEB97 /end MEASUREMENT
/begin MEASUREMENT Fid_PFltTempAir_mp "Function Identifier für Ansaugsluft-temperatur" UBYTE OneToOne 1 100 0.00 255.0 FORMAT "%5.1" ECU_ADDRESS 0x8FEB98 /end MEASUREMENT
/begin MEASUREMENT Fid_PFltTempClnt_mp "Function identifier für Kühlflüssigkeitstemperatur" UBYTE OneToOne 1 100 0.00 255.0 FORMAT "%5.1" ECU_ADDRESS 0x8FEB99 /end MEASUREMENT
/begin MEASUREMENT Fid_PFltTempOxiPre_mp "Messpunkt fuer Funktions Identifier Fid_PFltTempOxiPre" UBYTE OneToOne 1 100 0.00 255.0 FORMAT "%5.1" ECU_ADDRESS 0x8FEB9A /end MEASUREMENT
/begin MEASUREMENT Fid_PFltTempPre_mp "Messpunkt fuer Funktions Identifier Fid_PFltTempPre" UBYTE OneToOne 1 100 0.00 255.0 FORMAT "%5.1" ECU_ADDRESS 0x8FEB9B /end MEASUREMENT
/begin MEASUREMENT Fid_PFltTempSensFrz_mp "Messpunkt fuer Funktions Identifier Fid_PFltTempSensFrz" UBYTE OneToOne 1 100 0.00 255.0 FORMAT "%5.1" ECU_ADDRESS 0x8FEB9C /end MEASUREMENT
/begin MEASUREMENT Fid_PFltVltgBatt_mp "Function Identifier für Akkumulatorspannung" UBYTE OneToOne 1 100 0.00 255.0 FORMAT "%5.1" ECU_ADDRESS 0x8FEB9D /end MEASUREMENT
/begin MEASUREMENT Fid_RailCDRPSErrChk_mp "Fid zur Reaktion auf Fehler des Kraftstoffdrucksensors: Dfp_RailCD_mp wird nicht weiter gestestet." UBYTE OneToOne 1 100 0.00 255.0 FORMAT "%5.1" ECU_ADDRESS 0x8FEB9E /end MEASUREMENT
/begin MEASUREMENT Fid_RailCDSubstVal_mp "Fid zur Reaktion auf Fehler des Kraftstoffdrucksensors" UBYTE OneToOne 1 100 0.00 255.0 FORMAT "%5.1" ECU_ADDRESS 0x8FEB9F /end MEASUREMENT
/begin MEASUREMENT Fid_RailCD_PMonStrt_mp "Messpunkt fuer Funktions Identifier Fid_RailCD_PMonStrt" UBYTE OneToOne 1 100 0.00 255.0 FORMAT "%5.1" ECU_ADDRESS 0x8FEBA0 /end MEASUREMENT
/begin MEASUREMENT Fid_RailCtlMode_mp "Fehlerverriegelung allgemein für die Druckregelung" UBYTE OneToOne 1 100 0.00 255.0 FORMAT "%5.1" ECU_ADDRESS 0x8FEBA1 /end MEASUREMENT
/begin MEASUREMENT Fid_RailMeUn0Blk_mp "Fehleridentifier zur Verriegelung der Überwachung auf positive Regelabweichung" UBYTE OneToOne 1 100 0.00 255.0 FORMAT "%5.1" ECU_ADDRESS 0x8FEBA2 /end MEASUREMENT
/begin MEASUREMENT Fid_RailMeUn0Rls_mp "Fehleridentifier zur Freigabe der Überwachung auf positive Regelabweichung" UBYTE OneToOne 1 100 0.00 255.0 FORMAT "%5.1" ECU_ADDRESS 0x8FEBA3 /end MEASUREMENT
/begin MEASUREMENT Fid_RailMeUn1Blk_mp "Fehleridentifier zur Verriegelung der Überwachung auf positive Regelabweichung und Sollwert des Volumenstroms d. Zumesseinheit" UBYTE OneToOne 1 100 0.00 255.0 FORMAT "%5.1" ECU_ADDRESS 0x8FEBA4 /end MEASUREMENT
/begin MEASUREMENT Fid_RailMeUn1Rls_mp "Fehleridentifier zur Freigabe der Überwachung auf positive Regelabweichung und Sollwert des Volumenstroms d. Zumesseinheit" UBYTE OneToOne 1 100 0.00 255.0 FORMAT "%5.1" ECU_ADDRESS 0x8FEBA5 /end MEASUREMENT
/begin MEASUREMENT Fid_RailMeUn2Blk_mp "Fehleridentifier zur Verriegelung der Überwachung auf negative Regelabweichung bei Nullförderung" UBYTE OneToOne 1 100 0.00 255.0 FORMAT "%5.1" ECU_ADDRESS 0x8FEBA6 /end MEASUREMENT
/begin MEASUREMENT Fid_RailMeUn2Rls_mp "Fehleridentifier zur Freigabe der Überwachung auf negative Regelabweichung bei Nullförderung" UBYTE OneToOne 1 100 0.00 255.0 FORMAT "%5.1" ECU_ADDRESS 0x8FEBA7 /end MEASUREMENT
/begin MEASUREMENT Fid_RailMeUn3Blk_mp "Fehleridentifier zur Verriegelung der Überwachung auf minimalen Raildruck" UBYTE OneToOne 1 100 0.00 255.0 FORMAT "%5.1" ECU_ADDRESS 0x8FEBA8 /end MEASUREMENT
/begin MEASUREMENT Fid_RailMeUn3Rls_mp "Fehleridentifier zur Freigabe der Überwachung auf minimalen Raildruck" UBYTE OneToOne 1 100 0.00 255.0 FORMAT "%5.1" ECU_ADDRESS 0x8FEBA9 /end MEASUREMENT
/begin MEASUREMENT Fid_RailMeUn4Blk_mp "Fehleridentifier zur Verriegelung der Überwachung auf maximalen Raildruck" UBYTE OneToOne 1 100 0.00 255.0 FORMAT "%5.1" ECU_ADDRESS 0x8FEBAA /end MEASUREMENT
/begin MEASUREMENT Fid_RailMeUn4Rls_mp "Fehleridentifier zur Freigabe der Überwachung auf maximalen Raildruck" UBYTE OneToOne 1 100 0.00 255.0 FORMAT "%5.1" ECU_ADDRESS 0x8FEBAB /end MEASUREMENT
/begin MEASUREMENT Fid_RailMeUnCtlMode_mp "Fehlerverriegelung für die Druckregelung über Zumesseinheit" UBYTE OneToOne 1 100 0.00 255.0 FORMAT "%5.1" ECU_ADDRESS 0x8FEBAC /end MEASUREMENT
/begin MEASUREMENT Fid_RailPCV0Blk_mp "Fehleridentifier zur Verriegelung der Überwachung auf positive Regelabweichung" UBYTE OneToOne 1 100 0.00 255.0 FORMAT "%5.1" ECU_ADDRESS 0x8FEBAD /end MEASUREMENT
/begin MEASUREMENT Fid_RailPCV0Rls_mp "Fehleridentifier zur Freigabe der Überwachung auf positive Regelabweichung" UBYTE OneToOne 1 100 0.00 255.0 FORMAT "%5.1" ECU_ADDRESS 0x8FEBAE /end MEASUREMENT
/begin MEASUREMENT Fid_RailPCV1Blk_mp "Fehleridentifier zur Verriegelung der Überwachung auf positive Regelabweichung kombiniert mit Stellgröße des Druckregelventils" UBYTE OneToOne 1 100 0.00 255.0 FORMAT "%5.1" ECU_ADDRESS 0x8FEBAF /end MEASUREMENT
/begin MEASUREMENT Fid_RailPCV1Rls_mp "Fehleridentifier zur Freigabe der Überwachung auf positive Regelabweichung kombiniert mit Stellgröße des Druckregelventils" UBYTE OneToOne 1 100 0.00 255.0 FORMAT "%5.1" ECU_ADDRESS 0x8FEBB0 /end MEASUREMENT
/begin MEASUREMENT Fid_RailPCV2Blk_mp "Fehleridentifier zur Verriegelung der Überwachung auf negative Regelabweichung kombiniert mit Stellgröße des Druckregelventils" UBYTE OneToOne 1 100 0.00 255.0 FORMAT "%5.1" ECU_ADDRESS 0x8FEBB1 /end MEASUREMENT
/begin MEASUREMENT Fid_RailPCV2Rls_mp "Fehleridentifier zur Freigabe der Überwachung auf negative Regelabweichung kombiniert mit Stellgröße des Druckregelventils" UBYTE OneToOne 1 100 0.00 255.0 FORMAT "%5.1" ECU_ADDRESS 0x8FEBB2 /end MEASUREMENT
/begin MEASUREMENT Fid_RailPCV3Blk_mp "Fehleridentifier zur Verriegelung der Überwachung auf minimalen Raildruck" UBYTE OneToOne 1 100 0.00 255.0 FORMAT "%5.1" ECU_ADDRESS 0x8FEBB3 /end MEASUREMENT
/begin MEASUREMENT Fid_RailPCV3Rls_mp "Fehleridentifier zur Freigabe der Überwachung auf minimalen Raildruck" UBYTE OneToOne 1 100 0.00 255.0 FORMAT "%5.1" ECU_ADDRESS 0x8FEBB4 /end MEASUREMENT
/begin MEASUREMENT Fid_RailPCV4Blk_mp "Fehleridentifier zur Verriegelung der Überwachung auf maximalen Raildruck" UBYTE OneToOne 1 100 0.00 255.0 FORMAT "%5.1" ECU_ADDRESS 0x8FEBB5 /end MEASUREMENT
/begin MEASUREMENT Fid_RailPCV4Rls_mp "Fehleridentifier zur Freigabe der Überwachung auf maximalen Raildruck" UBYTE OneToOne 1 100 0.00 255.0 FORMAT "%5.1" ECU_ADDRESS 0x8FEBB6 /end MEASUREMENT
/begin MEASUREMENT Fid_RailPCV5Blk_mp "Fehleridentifier zur Verriegelung der Plausibilisierung des Raildruck mit dem Strom durch das Druckregelventil" UBYTE OneToOne 1 100 0.00 255.0 FORMAT "%5.1" ECU_ADDRESS 0x8FEBB7 /end MEASUREMENT
/begin MEASUREMENT Fid_RailPCV5Rls_mp "Fehleridentifier zur Freigabe der Plausibilisierung des Raildruck mit dem Strom durch das Druckregelventil" UBYTE OneToOne 1 100 0.00 255.0 FORMAT "%5.1" ECU_ADDRESS 0x8FEBB8 /end MEASUREMENT
/begin MEASUREMENT Fid_RailPCVCtlMode_mp "Fehlerverriegelung für die Druckregelung über Druckregelventil" UBYTE OneToOne 1 100 0.00 255.0 FORMAT "%5.1" ECU_ADDRESS 0x8FEBB9 /end MEASUREMENT
/begin MEASUREMENT Fid_RailSetPointLim_mp "Fid zur Verriegelung der ""normalen"" Begrenzung des Raildruck-Sollwertes" UBYTE OneToOne 1 100 0.00 255.0 FORMAT "%5.1" ECU_ADDRESS 0x8FEBBA /end MEASUREMENT
/begin MEASUREMENT Fid_RailSetPointRed_mp "Fehlerverriegelung zur Freigabe der Solldruckabsenkung im Systemfehlerfall" UBYTE OneToOne 1 100 0.00 255.0 FORMAT "%5.1" ECU_ADDRESS 0x8FEBBB /end MEASUREMENT
/begin MEASUREMENT Fid_ShuttrCTS_mp "Messpunkt fuer Funktions Identifier Fid_ShuttrCTS" UBYTE OneToOne 1 100 0.00 255.0 FORMAT "%5.1" ECU_ADDRESS 0x8FEBBC /end MEASUREMENT
/begin MEASUREMENT Fid_ShuttrEGS_mp "Messpunkt fuer Funktions Identifier Fid_ShuttrEGS" UBYTE OneToOne 1 100 0.00 255.0 FORMAT "%5.1" ECU_ADDRESS 0x8FEBBD /end MEASUREMENT
/begin MEASUREMENT Fid_SignalsTstNLim_mp "Messpunkt fuer Funktions Identifier Fid_SignalsTstNLim" UBYTE OneToOne 1 100 0.00 255.0 FORMAT "%5.1" ECU_ADDRESS 0x8FEBBE /end MEASUREMENT
/begin MEASUREMENT Fid_StSysImmo_mp "FID WFS sperrt Starter" UBYTE OneToOne 1 100 0.00 255.0 FORMAT "%5.1" ECU_ADDRESS 0x8FEBBF /end MEASUREMENT
/begin MEASUREMENT Fid_StSysStrtTipGbxDat_mp "fid Getriebedaten für Automatik Start" UBYTE OneToOne 1 100 0.00 255.0 FORMAT "%5.1" ECU_ADDRESS 0x8FEBC0 /end MEASUREMENT
/begin MEASUREMENT Fid_T15CDCanError_mp "Function Identifier für Ersatzwert bei CAN- Fehler" UBYTE OneToOne 1 100 0.00 255.0 FORMAT "%5.1" ECU_ADDRESS 0x8FEBC1 /end MEASUREMENT
/begin MEASUREMENT Fid_T50CDSig_mp "Messpunkt fuer Funktions Identifier Fid_T50CDSig" UBYTE OneToOne 1 100 0.00 255.0 FORMAT "%5.1" ECU_ADDRESS 0x8FEBC2 /end MEASUREMENT
/begin MEASUREMENT Fid_UsrDa_FDCOff_mp "Messpunkt fuer Funktions Identifier Fid_UsrDa_FDCOff" UBYTE OneToOne 1 100 0.00 255.0 FORMAT "%5.1" ECU_ADDRESS 0x8FEBC3 /end MEASUREMENT
/begin MEASUREMENT Fid_VehDaDist_mp "Status Funktionsidentifier Fid_VehDaDist zur Verriegelung Kilometerzähler VehDa_lSum" UBYTE OneToOne 1 100 0.00 255.0 FORMAT "%5.1" ECU_ADDRESS 0x8FEBC4 /end MEASUREMENT
/begin MEASUREMENT Fid_ZFCClbActv_mp "FID für Ersatzreaktion für die Nullmengenkalibrierung" UBYTE OneToOne 1 100 0.00 255.0 FORMAT "%5.1" ECU_ADDRESS 0x8FEBC5 /end MEASUREMENT
/begin MEASUREMENT Fid_ZFCCldCmbCham_mp "Function Identifier für die Erkennung ausgekühlter Brennraum der Nullmengenkalibrierung" UBYTE OneToOne 1 100 0.00 255.0 FORMAT "%5.1" ECU_ADDRESS 0x8FEBC6 /end MEASUREMENT
/begin FUNCTION dsm_auto_oldas ""
 /begin OUT_MEASUREMENT DSM_FCM_mp Fid_ACCIRevErr_mp Fid_AccPed_Brk_mp Fid_AccPed_mp Fid_ACCRevErr_mp Fid_ACCtl_ACTrqErr_mp Fid_ACCtl_CTSErr_mp Fid_ACCtl_FanErr_mp Fid_ACCtl_TGearbxErr_mp Fid_ACCtl_VSSErr_mp Fid_ACC_AliveErr_mp Fid_ACC_CsErr_mp Fid_ACC_TiOutErr_mp Fid_AFSCD_AirPerTime_mp Fid_AFSCD_mp Fid_AFSCD_PlOffsDrft_mp Fid_AFSCD_PlSetyDrft_mp Fid_AFSCD_SRCCorrAirm_mp Fid_AFSCD_SRCDcyc_mp Fid_AFSCD_SRCRawAirm_mp Fid_AFSCD_SRCRefSig_mp Fid_AFS_CanMon_mp Fid_AFS_GenDisableCond_mp Fid_AirCtlNeg2_mp Fid_AirCtlNeg_mp Fid_AirCtlPFltEGRRed_mp Fid_AirCtlPlateBreakActv_mp Fid_AirCtlPlateBreak_mp Fid_AirCtlPos2_mp Fid_AirCtlPos_mp Fid_AirCtl_Brk_mp Fid_AirCtl_mp Fid_AOHt_ShutOffErr_mp Fid_APP1_mp Fid_APP2_mp Fid_APSCD_mp Fid_ARSOff_mp Fid_ASDdc_mp Fid_ASModSwtOffEng_mp Fid_ASModSwtOffIndVol_mp Fid_BPSCDMon_mp Fid_ClgDynTst_mp Fid_CmbChb_mp Fid_CoDT_GripDeb_mp Fid_CoEngIRevSys1_mp Fid_CoEngIRevSys2_mp Fid_CoEngIRevVeh_mp Fid_CoEngPFltErr_mp Fid_CoEngRevSys1_mp Fid_CoEngRevSys2_mp Fid_CoEngRevVeh_mp Fid_CoEngShOffTst_mp Fid_CoEngSoftShOffTV_mp Fid_CoEng_ActrPrt_mp Fid_CoEng_Nrml2Strt_mp Fid_CoEng_PwrStgEnable_mp Fid_CoEng_trqLimErr1_mp Fid_CoEng_trqLimErr2_mp Fid_CoEng_trqLimErr_mp Fid_CoVehtrqLimErr_mp Fid_CoVM_StabDem_Err_mp Fid_CrCtlShutOffIr_mp Fid_CrCtl_ASCTimeout_mp Fid_CrCtl_CanDef_mp Fid_CrCtl_KombiTimeout_mp Fid_CrCtl_vCrCtl_mp Fid_CTSCDFlTemp_mp Fid_CTSCD_Plaus_mp Fid_DSM_Wuc_mp Fid_EATSCDTSubs_mp Fid_EBAFCD_mp Fid_EBFCD_mp Fid_ECU_mp Fid_EGSysCoLSU0_mp Fid_EGSysCoNSC_mp Fid_EGSysCoOxi_mp Fid_EGSysCoTrbn_mp Fid_EGSysCoTube0_mp Fid_EGSysCoTube1_mp Fid_EGSysHtgDel_mp Fid_EGSysNSC_mp Fid_EGSysOxiCat_mp Fid_EGSysPresEnv_mp Fid_EGSysStrt_mp Fid_EGSysTemp_mp Fid_EGSysTrbn_mp Fid_EGSysTube_mp Fid_EGSys_AP_mp Fid_EGTRgnLck_mp Fid_EGTTempGvnrAirCtl_mp Fid_EGTTempGvnrInr_mp Fid_EGTTempGvnrOutr_mp Fid_EngCTSCD_mp Fid_EngMCaSBackUp_mp Fid_EngMCrSBackUp_mp Fid_EngMTEng_mp Fid_EngMTrqFrcPDiff_mp Fid_EngMVVeh_mp Fid_EngM_ChkStrtSpd_mp Fid_EngPrt_nLimErr_mp Fid_ETClbCorActv_mp Fid_FanCtl_mp Fid_FanGbxOil_mp Fid_FBCMonI_mp Fid_FBC_mp Fid_FlMngFullLdRglOff_mp Fid_FlMngSmkDefect_mp Fid_FlSysCTSSens_mp Fid_FlSysDens_mp Fid_FlSysFTSSens_mp Fid_FMASwtOff1_mp Fid_FMASwtOff3_mp Fid_FMTC_AirCorr_mp Fid_FMTC_SOECorr_mp Fid_FrmMngAddLevl_mp Fid_FrmMngAPP_mp Fid_FrmMngARS_mp Fid_FrmMngBrkDef_mp Fid_FrmMngBrk_mp Fid_FrmMngCoEng_mp Fid_FrmMngCoEng_St2_mp Fid_FrmMngConvDef_mp Fid_FrmMngEngRpmTemp_mp Fid_FrmMngEngSpd_mp Fid_FrmMngInjDU1_mp Fid_FrmMngInjDU2_mp Fid_FrmMngInjVlv_mp Fid_FrmMngnSetpoint_mp Fid_FrmMngOBDCtl_mp Fid_FrmMngParkConsumer_mp Fid_FrmMngPFltDef_mp Fid_FrmMngPla_DSC_mp Fid_FrmMngPla_EGS_mp Fid_FrmMngpVal_mp Fid_FrmMngPwrMngLIGovSt_mp Fid_FrmMngSIG_ARS_mp Fid_FrmMngSIG_DSC_mp Fid_FrmMngSig_EGS_mp Fid_FrmMngtEng_mp Fid_FrmMngTO_ARS_mp Fid_FrmMngTO_DSC_mp Fid_FrmMngTo_EGS_mp Fid_FrmMngWaterVlv_mp Fid_FrmMng_ST_TORQ_mp Fid_FTSCDErr_mp Fid_FWOscDet_mp Fid_GearbxDrvAwayInactiv_mp Fid_GearbxDrvAway_mp Fid_GearbxPtCANErr_mp Fid_GearbxTrqLimErr_mp Fid_Gearbx_GearDet_mp Fid_Gearbx_TrqIntv_Err_mp Fid_GlwCtl1_mp Fid_HDC_mp Fid_IndSys1_mp Fid_IndSys2_mp Fid_InjCrvCoErr_mp Fid_InjCtl_qLimErr_mp Fid_InjVCDCls_mp Fid_InjVlvActrTemp_mp Fid_InjVlvInjLim_mp Fid_InjVlvMon_mp Fid_InjVlvNVC_mp Fid_InjVlvSetUpVolt_mp Fid_InjVlvWvCorOff_mp Fid_Layer_FI_TANS_mp Fid_Layer_FI_TUMG_mp Fid_LIGovSetpDrvAway_mp Fid_LIGovSetpointDrvAwy_mp Fid_LIGovUbr_mp Fid_LSUCDactiv0_mp Fid_LSUCDlsu0_mp Fid_LSUCDMon0_mp Fid_LSUCDO20_mp Fid_LSUCDRi0_mp Fid_LSUClbSched_mp Fid_LSUCtl0_mp Fid_LSUMonAllChecks_mp Fid_LSUMonPlausChk_mp Fid_MeUnCDCalcI_mp Fid_MSidCD_ECU_mp Fid_MSidCD_Pin_mp Fid_OTSCD_mp Fid_PCRBalGvnr_mp Fid_PCRExtnLimActr_mp Fid_PCRGvnrDvtNeg_mp Fid_PCRGvnrDvtPos_mp Fid_PCRSurgeLIGov_mp Fid_PCR_mp Fid_PCR_MS_mp Fid_PCVCDCalcI_mp Fid_PFltAshCorRgn_mp Fid_PFltAshCor_mp Fid_PFltBrk_mp Fid_PFltChar_mp Fid_PFltChngPar_mp Fid_PFltClth_mp Fid_PFltDiagRls1_mp Fid_PFltDiagRls2_mp Fid_PFltDynChk_mp Fid_PFltGearDet_mp Fid_PFltHsLnChk_mp Fid_PFltLckRgnErr_mp Fid_PFltLckRgnFuel_mp Fid_PFltPlausPres_mp Fid_PFltPlausTemp_mp Fid_PFltPPreErr_mp Fid_PFltPresSensFrz_mp Fid_PFltPresSensHsLn_mp Fid_PFltSimOn_mp Fid_PFltSpdVeh_mp Fid_PFltSRCPres_mp Fid_PFltSRCTemp_mp Fid_PFltTempAir_mp Fid_PFltTempClnt_mp Fid_PFltTempOxiPre_mp Fid_PFltTempPre_mp Fid_PFltTempSensFrz_mp Fid_PFltVltgBatt_mp Fid_RailCDRPSErrChk_mp Fid_RailCDSubstVal_mp Fid_RailCD_PMonStrt_mp Fid_RailCtlMode_mp Fid_RailMeUn0Blk_mp Fid_RailMeUn0Rls_mp Fid_RailMeUn1Blk_mp Fid_RailMeUn1Rls_mp Fid_RailMeUn2Blk_mp Fid_RailMeUn2Rls_mp Fid_RailMeUn3Blk_mp Fid_RailMeUn3Rls_mp Fid_RailMeUn4Blk_mp Fid_RailMeUn4Rls_mp Fid_RailMeUnCtlMode_mp Fid_RailPCV0Blk_mp Fid_RailPCV0Rls_mp Fid_RailPCV1Blk_mp Fid_RailPCV1Rls_mp Fid_RailPCV2Blk_mp Fid_RailPCV2Rls_mp Fid_RailPCV3Blk_mp Fid_RailPCV3Rls_mp Fid_RailPCV4Blk_mp Fid_RailPCV4Rls_mp Fid_RailPCV5Blk_mp Fid_RailPCV5Rls_mp Fid_RailPCVCtlMode_mp Fid_RailSetPointLim_mp Fid_RailSetPointRed_mp Fid_ShuttrCTS_mp Fid_ShuttrEGS_mp Fid_SignalsTstNLim_mp Fid_StSysImmo_mp Fid_StSysStrtTipGbxDat_mp Fid_T15CDCanError_mp Fid_T50CDSig_mp Fid_UsrDa_FDCOff_mp Fid_VehDaDist_mp Fid_ZFCClbActv_mp Fid_ZFCCldCmbCham_mp /end OUT_MEASUREMENT
/end FUNCTION
/begin FUNCTION dsm_auto_sdw ""
 /begin DEF_CHARACTERISTIC DSM_SdwDfp_Layer_TANS_C DSM_SdwDfp_ACCDSwtin_C DSM_SdwDfp_ACC_PlausTrqDes_C DSM_SdwDfp_ACC_trqInr_C DSM_SdwDfp_ACTrq_C DSM_SdwDfp_ADCMon_C DSM_SdwDfp_AFSCDIdlAdjVal_C DSM_SdwDfp_AFSCDLdAdjVal_C DSM_SdwDfp_AFSCD_AirTempDcyc_C DSM_SdwDfp_AFSCD_PlOffsDrft_C DSM_SdwDfp_AFSCD_PlSetyDrft_C DSM_SdwDfp_AFSCD_SRCAirTemp_C DSM_SdwDfp_AFSCD_SRCBatt_C DSM_SdwDfp_AFSCD_SRCCorrAirm_C DSM_SdwDfp_AFSCD_SRCRawAirm_C DSM_SdwDfp_AFSCD_SRCRefSigPer_C DSM_SdwDfp_AOHtCD_C DSM_SdwDfp_AOHtCD_AOHtDia1_C DSM_SdwDfp_AOHtCD_AOHtDia2_C DSM_SdwDfp_Layer_TUMG_C DSM_SdwDfp_AOHtCD_AOHtDia3_C DSM_SdwDfp_APP1_C DSM_SdwDfp_Layer_GEN_C DSM_SdwDfp_Layer_BSD_C DSM_SdwDfp_APP2_C DSM_SdwDfp_APSCD_C DSM_SdwDfp_ARS_C DSM_SdwDfp_AccPedPlausBrk_C DSM_SdwDfp_AirCtlPlateBreak_C DSM_SdwDfp_AirCtl_GovNegDev_C DSM_SdwDfp_AirCtl_GovNegDev2_C DSM_SdwDfp_AirCtl_GovPosDev_C DSM_SdwDfp_AirCtl_GovPosDev2_C DSM_SdwDfp_AltCD_C DSM_SdwDfp_Layer_QLT_C DSM_SdwDfp_BPACD_BPADia1_C DSM_SdwDfp_Layer_IBS1_C DSM_SdwDfp_Layer_IBS2_C DSM_SdwDfp_Layer_IBS3_C DSM_SdwDfp_Layer_PMBN_C DSM_SdwDfp_Layer_PMBATT_C DSM_SdwDfp_BPACD_BPADia2_C DSM_SdwDfp_BPACD_BPADia3_C DSM_SdwDfp_BPACD_Max_C DSM_SdwDfp_BPACD_Min_C DSM_SdwDfp_BPACD_SigNpl_C DSM_SdwDfp_BPSCD_C DSM_SdwDfp_BattCD_C DSM_SdwDfp_BrkCD_C DSM_SdwDfp_Bss_C DSM_SdwDfp_CBACD_C DSM_SdwDfp_CTSCD_C DSM_SdwDfp_Clg_DynTst_C DSM_SdwDfp_CmbChbMisfire1_C DSM_SdwDfp_CmbChbMisfire2_C DSM_SdwDfp_CmbChbMisfire3_C DSM_SdwDfp_CmbChbMisfire4_C DSM_SdwDfp_CmbChbMisfire5_C DSM_SdwDfp_CmbChbMisfire6_C DSM_SdwDfp_CmbChbMisfireMul_C DSM_SdwDfp_CoVMDCSh_C DSM_SdwDfp_ConvCD_C DSM_SdwDfp_CrCCDMFL_C DSM_SdwDfp_CrCtl_vCrCtl_C DSM_SdwDfp_Dummy1_C DSM_SdwDfp_EATSCD_C DSM_SdwDfp_EBAFCD_C DSM_SdwDfp_EBFCD_C DSM_SdwDfp_EBTSCD_C DSM_SdwDfp_EBTSCD_OvrTemp_C DSM_SdwDfp_EEPCDVarMng_C DSM_SdwDfp_EGPpCD_C DSM_SdwDfp_EGPpCDTPreTrbn_C DSM_SdwDfp_Layer_PMRUHVERL_C DSM_SdwDfp_EGRCD_Max_C DSM_SdwDfp_EGRCD_Min_C DSM_SdwDfp_EGRCD_SigNpl_C DSM_SdwDfp_EGTRgnOilDil_C DSM_SdwDfp_Layer_TOENS_C DSM_SdwDfp_Layer_MANHYDR_C DSM_SdwDfp_Layer_MANLUFT_C DSM_SdwDfp_ETClbETFltInj1_C DSM_SdwDfp_ETClbETFltInj2_C DSM_SdwDfp_ETClbETFltInj3_C DSM_SdwDfp_ETClbETFltInj4_C DSM_SdwDfp_ETClbETFltInj5_C DSM_SdwDfp_ETClbETFltInj6_C DSM_SdwDfp_ETClbInj1_C DSM_SdwDfp_ETClbInj2_C DSM_SdwDfp_ETClbInj3_C DSM_SdwDfp_ETClbInj4_C DSM_SdwDfp_ETClbInj5_C DSM_SdwDfp_ETClbInj6_C DSM_SdwDfp_EngMCaS1_C DSM_SdwDfp_EngMCrS1_C DSM_SdwDfp_EngMOfsCaSCrS_C DSM_SdwDfp_EngMntCtl1_Dia1_C DSM_SdwDfp_EngMntCtl1_Dia2_C DSM_SdwDfp_EngMntCtl1_Dia3_C DSM_SdwDfp_EngMntCtl1_Max_C DSM_SdwDfp_EngMntCtl1_Min_C DSM_SdwDfp_EngMntCtl1_SigNpl_C DSM_SdwDfp_EngMntCtlCD_C DSM_SdwDfp_EngMntCtl_Dia1_C DSM_SdwDfp_EngMntCtl_Dia2_C DSM_SdwDfp_EngMntCtl_Dia3_C DSM_SdwDfp_EngMntCtl_Max_C DSM_SdwDfp_EngMntCtl_Min_C DSM_SdwDfp_EngMntCtl_SigNpl_C DSM_SdwDfp_EngPrtFWODet_C DSM_SdwDfp_FBCqDvt_C DSM_SdwDfp_FMTC_NonMonotonMap_C DSM_SdwDfp_FTSCD_C DSM_SdwDfp_FanCD_C DSM_SdwDfp_FanCD_FanCtlr1_C DSM_SdwDfp_FanCD_FanCtlr2_C DSM_SdwDfp_FanCD_FanCtlr3_C DSM_SdwDfp_FlFCD_C DSM_SdwDfp_FlMngSmkDefect_C DSM_SdwDfp_FrmMngBOS_RESET_C DSM_SdwDfp_FrmMngBOS_RESET_2_C DSM_SdwDfp_FrmMngDMANFAFS_C DSM_SdwDfp_FrmMngDRMANFSSG_C DSM_SdwDfp_FrmMngGEARBX_DATA_C DSM_SdwDfp_FrmMngGEARBX_DATA2_C DSM_SdwDfp_FrmMngHEAT_AC_C DSM_SdwDfp_FrmMngLENKRADWINKEL_C DSM_SdwDfp_FrmMngMILEAGE_RANGE_C DSM_SdwDfp_FrmMngOPCRCTLACC_C DSM_SdwDfp_FrmMngPRGG_CCTR_C DSM_SdwDfp_FrmMngPWRMNG_LOADV_C DSM_SdwDfp_FrmMngParkConsumer_C DSM_SdwDfp_FrmMngRQSTGEFAN_C DSM_SdwDfp_FrmMngSSGErr_C DSM_SdwDfp_FrmMngSSGShOff_C DSM_SdwDfp_FrmMngSTAT_ANH_C DSM_SdwDfp_FrmMngSTAT_ARS_C DSM_SdwDfp_FrmMngSTAT_DSC_C DSM_SdwDfp_FrmMngSTAT_EKP_C DSM_SdwDfp_FrmMngSTAT_KOMBI_C DSM_SdwDfp_FrmMngSTAT_SITZ_C DSM_SdwDfp_FrmMngStOBDGbxMilOf_C DSM_SdwDfp_FrmMngStOBDGbxMilOn_C DSM_SdwDfp_FrmMngTEMPRELTIME_C DSM_SdwDfp_FrmMngTERMINAL_C DSM_SdwDfp_FrmMngTIME_DATE_C DSM_SdwDfp_FrmMngTORQUE_DSC_C DSM_SdwDfp_FrmMngTORQUE_GEARBX_C DSM_SdwDfp_FrmMngTrq_ReqACC_C DSM_SdwDfp_FrmMngVEH_MOD_C DSM_SdwDfp_FrmMngVELOCITY_C DSM_SdwDfp_FrmMngWHEEL_SPEED_C DSM_SdwDfp_FrmMngstCurr_C DSM_SdwDfp_FrmMngswtPSPOff_C DSM_SdwDfp_GearbxIncMax_C DSM_SdwDfp_GlwCD_C DSM_SdwDfp_GlwCDGlwCirc1_C DSM_SdwDfp_GlwCDGlwCirc2_C DSM_SdwDfp_GlwCDGlwCirc3_C DSM_SdwDfp_GlwCDGlwCirc4_C DSM_SdwDfp_GlwCDGlwCirc5_C DSM_SdwDfp_GlwCDGlwCirc6_C DSM_SdwDfp_GlwCDGlwCirc7_C DSM_SdwDfp_GlwCDGlwCirc8_C DSM_SdwDfp_GlwCtl_C DSM_SdwDfp_HWEMonCom_C DSM_SdwDfp_HWEMonEEPROM_C DSM_SdwDfp_HWEMonRcyLocked_C DSM_SdwDfp_HWEMonRcySuppressed_C DSM_SdwDfp_HWEMonRcyVisible_C DSM_SdwDfp_HWEMonUMaxSupply_C DSM_SdwDfp_HWEMonUMinSupply_C DSM_SdwDfp_IATSCD_C DSM_SdwDfp_IATSCD_CATS_C DSM_SdwDfp_ImmCtlImmCD_C DSM_SdwDfp_ImmCtlImmEep_C DSM_SdwDfp_ImmCtlMpl_C DSM_SdwDfp_IndSys1_C DSM_SdwDfp_IndSys2_C DSM_SdwDfp_InjCrv_InjLim_C DSM_SdwDfp_InjCtlAdjQnt_C DSM_SdwDfp_InjCtlDrift_C DSM_SdwDfp_InjVCDActrChrg_C DSM_SdwDfp_InjVCDActrEnrg1_C DSM_SdwDfp_InjVCDActrEnrg2_C DSM_SdwDfp_InjVCDActrEnrg3_C DSM_SdwDfp_InjVCDActrEnrg4_C DSM_SdwDfp_InjVCDActrEnrg5_C DSM_SdwDfp_InjVCDActrEnrg6_C DSM_SdwDfp_InjVCDActrEnrg7_C DSM_SdwDfp_InjVCDActrEnrg8_C DSM_SdwDfp_InjVCDActrVolt_C DSM_SdwDfp_InjVCDClsBank1_C DSM_SdwDfp_InjVCDClsBank2_C DSM_SdwDfp_InjVCDMonCab_C DSM_SdwDfp_InjVCDMonSwt_C DSM_SdwDfp_InjVCDShOffDCDC_C DSM_SdwDfp_InjVCDUBuf_C DSM_SdwDfp_InjVCD_CY370Ampl_C DSM_SdwDfp_InjVlvBnk1A_C DSM_SdwDfp_InjVlvBnk1B_C DSM_SdwDfp_InjVlvBnk2A_C DSM_SdwDfp_InjVlvBnk2B_C DSM_SdwDfp_InjVlvChipA_C DSM_SdwDfp_InjVlvChipB_C DSM_SdwDfp_InjVlvCyl1A_C DSM_SdwDfp_InjVlvCyl1B_C DSM_SdwDfp_InjVlvCyl1C_C DSM_SdwDfp_InjVlvCyl2A_C DSM_SdwDfp_InjVlvCyl2B_C DSM_SdwDfp_InjVlvCyl2C_C DSM_SdwDfp_InjVlvCyl3A_C DSM_SdwDfp_InjVlvCyl3B_C DSM_SdwDfp_InjVlvCyl3C_C DSM_SdwDfp_InjVlvCyl4A_C DSM_SdwDfp_InjVlvCyl4B_C DSM_SdwDfp_InjVlvCyl4C_C DSM_SdwDfp_InjVlvCyl5A_C DSM_SdwDfp_InjVlvCyl5B_C DSM_SdwDfp_InjVlvCyl5C_C DSM_SdwDfp_InjVlvCyl6A_C DSM_SdwDfp_InjVlvCyl6B_C DSM_SdwDfp_InjVlvCyl6C_C DSM_SdwDfp_InjVlvCyl7A_C DSM_SdwDfp_InjVlvCyl7B_C DSM_SdwDfp_InjVlvCyl7C_C DSM_SdwDfp_InjVlvCyl8A_C DSM_SdwDfp_InjVlvCyl8B_C DSM_SdwDfp_InjVlvCyl8C_C DSM_SdwDfp_InjVlvNVC1_C DSM_SdwDfp_InjVlvNVC2_C DSM_SdwDfp_InjVlvNVC3_C DSM_SdwDfp_InjVlvNVC4_C DSM_SdwDfp_InjVlvNVC5_C DSM_SdwDfp_InjVlvNVC6_C DSM_SdwDfp_InjVlvNVC7_C DSM_SdwDfp_InjVlvNVC8_C DSM_SdwDfp_LPACD_Max_C DSM_SdwDfp_LPACD_Min_C DSM_SdwDfp_LPACD_SigNpl_C DSM_SdwDfp_LSUCDCircNernst0_C DSM_SdwDfp_LSUCDCircPumpCur0_C DSM_SdwDfp_LSUCDCircVirtGnd0_C DSM_SdwDfp_LSUCDHeater0_C DSM_SdwDfp_LSUCDHtCoup0_C DSM_SdwDfp_LSUCDO20_C DSM_SdwDfp_LSUCDO2Clb0_C DSM_SdwDfp_LSUCDRiClb0_C DSM_SdwDfp_LSUCDSPI0_C DSM_SdwDfp_LSUCDSPIBattLow0_C DSM_SdwDfp_LSUCDWireIP0_C DSM_SdwDfp_LSUCtlRiExc0_C DSM_SdwDfp_LSUMon1Sens_C DSM_SdwDfp_LSUMon2Sens_C DSM_SdwDfp_LubCD_C DSM_SdwDfp_MIL_C DSM_SdwDfp_MRlyCD_C DSM_SdwDfp_MSidCD_Comm_C DSM_SdwDfp_MSidCD_Pin_C DSM_SdwDfp_MSidCD_Sel_INI_C DSM_SdwDfp_MSidCD_Select_C DSM_SdwDfp_MeUnCDNoLoad_C DSM_SdwDfp_MeUnCDSCBat_C DSM_SdwDfp_MeUnCDSCGnd_C DSM_SdwDfp_MeUnCD_ADC_C DSM_SdwDfp_MeUnCD_SigTst_C DSM_SdwDfp_Montr_C DSM_SdwDfp_NetMngDeviceA_C DSM_SdwDfp_NetMngDeviceB_C DSM_SdwDfp_NetMngDeviceC_C DSM_SdwDfp_OPSCD_Lamp_C DSM_SdwDfp_OPSCD_anain_C DSM_SdwDfp_OTSCD_C DSM_SdwDfp_OvRMon_C DSM_SdwDfp_OvRMonBrk_C DSM_SdwDfp_OvRMonSigA_C DSM_SdwDfp_OxiCCDTPre_C DSM_SdwDfp_PCR_GovDevNeg_C DSM_SdwDfp_PCR_GovDevPos_C DSM_SdwDfp_PCVCDNoLoad_C DSM_SdwDfp_PCVCDSCBat_C DSM_SdwDfp_PCVCDSCGnd_C DSM_SdwDfp_PCVCD_ADC_C DSM_SdwDfp_PCVCD_SigTst_C DSM_SdwDfp_PFltAPSens_C DSM_SdwDfp_PFltCDPPre_C DSM_SdwDfp_PFltCDTempPre_C DSM_SdwDfp_PFltChar_C DSM_SdwDfp_PFltEngPrt_C DSM_SdwDfp_PFltPresDynPlaus_C DSM_SdwDfp_PFltPresSens_C DSM_SdwDfp_PFltPresSensFrz_C DSM_SdwDfp_PFltPresSensHsLn_C DSM_SdwDfp_PFltPresSensSot_C DSM_SdwDfp_PFltRgnPerm_C DSM_SdwDfp_PFltTempDwnStrm_C DSM_SdwDfp_PFltTempSens_C DSM_SdwDfp_PFltTempUpStrm_C DSM_SdwDfp_PFltmSotDiffMax_C DSM_SdwDfp_QLTCD_C DSM_SdwDfp_RTMMon_C DSM_SdwDfp_RailCD_C DSM_SdwDfp_RailCDOfsTst_C DSM_SdwDfp_RailCD_PMonStrt_C DSM_SdwDfp_RailCtlModeMeUnDiag_C DSM_SdwDfp_RailCtlModePCVDiag_C DSM_SdwDfp_RailMeUn0_C DSM_SdwDfp_RailMeUn1_C DSM_SdwDfp_RailMeUn2_C DSM_SdwDfp_RailMeUn3_C DSM_SdwDfp_RailMeUn4_C DSM_SdwDfp_RailPCV0_C DSM_SdwDfp_RailPCV1_C DSM_SdwDfp_RailPCV2_C DSM_SdwDfp_RailPCV3_C DSM_SdwDfp_RailPCV4_C DSM_SdwDfp_RailPCV5_C DSM_SdwDfp_SOPTst_C DSM_SdwDfp_SSpMon1_C DSM_SdwDfp_SSpMon2_C DSM_SdwDfp_SSpMon3_C DSM_SdwDfp_ShutCD_C DSM_SdwDfp_StSysTrqShutOff_C DSM_SdwDfp_StrtCD_Actr_C DSM_SdwDfp_SysLamp_C DSM_SdwDfp_T15CD_C DSM_SdwDfp_TGearbx_C DSM_SdwDfp_TPUMon_C DSM_SdwDfp_TVACD_Max_C DSM_SdwDfp_TVACD_Min_C DSM_SdwDfp_TVACD_SigNpl_C DSM_SdwDfp_TVACD_TVADia1_C DSM_SdwDfp_TVACD_TVADia2_C DSM_SdwDfp_TVACD_TVADia3_C DSM_SdwDfp_VSACD_Max_C DSM_SdwDfp_VSACD_Min_C DSM_SdwDfp_VSACD_SigNpl_C DSM_SdwDfp_VSACD_VSADia1_C DSM_SdwDfp_VSACD_VSADia2_C DSM_SdwDfp_VSACD_VSADia3_C DSM_SdwDfp_VSACD_VSADia4_C DSM_SdwDfp_VSSCD1_C DSM_SdwDfp_VSSCD2_C DSM_SdwDfp_WdCom_C /end DEF_CHARACTERISTIC
/end FUNCTION
/begin COMPU_METHOD OneToOne "eins zu eins (physikalischer Wert ist gleich dem internen Wert)" RAT_FUNC "%6.2" "-" COEFFS 0 1 0 0 0 1 /end COMPU_METHOD
/begin COMPU_METHOD Time_ms "Zeit in ms für Fehlerentprellung (DSM) und SW-Timer" RAT_FUNC "%6.1" "ms" COEFFS 0 0.1 0 0 0 1 /end COMPU_METHOD
/begin RECORD_LAYOUT Kw_Wu16 FNC_VALUES 1 UWORD COLUMN_DIR DIRECT /end RECORD_LAYOUT
/end MODULE
/end PROJECT
