ASAP2_VERSION 1 30
/begin PROJECT MSS65-ign "Generiert am 14.10.05 um 09:57:47"
/begin HEADER "" VERSION "R341" /end HEADER
/begin MODULE _MSS65-ign "Generiert am 14.10.05 um 09:57:47"
/begin MOD_COMMON "" BYTE_ORDER MSB_FIRST ALIGNMENT_BYTE 1 ALIGNMENT_WORD 2 ALIGNMENT_LONG 4 ALIGNMENT_FLOAT32_IEEE 4 ALIGNMENT_FLOAT64_IEEE 8 /end MOD_COMMON
/begin CHARACTERISTIC GKF_KR_ANZ_ASP_AUF "Anzahl der Arbeitsspiele fuer Aufregelphase." MAP 0x74E42 TGF_VV_VV_UB 254.0 FORMULA_0003 1.0 255.0
 /begin AXIS_DESCR COM_AXIS n FORMULA_0006 12 0.0 10000.0 AXIS_PTS_REF AXIS_N12 MAX_GRAD 0.0 /end AXIS_DESCR
 /begin AXIS_DESCR COM_AXIS n_grad_asp FORMULA_0105 6 -10000.0 10000.0 AXIS_PTS_REF AXIS_N_GRAD6 MAX_GRAD 0.0 /end AXIS_DESCR
/end CHARACTERISTIC
/begin CHARACTERISTIC GKF_KR_ANZ_ASP_HOLD "Anzahl der Arbeitsspiele in Haltephase." MAP 0x74C92 TGF_VV_VV_UB 255.0 FORMULA_0003 0.0 255.0
 /begin AXIS_DESCR COM_AXIS n FORMULA_0006 12 0.0 10000.0 AXIS_PTS_REF AXIS_N12 MAX_GRAD 0.0 /end AXIS_DESCR
 /begin AXIS_DESCR COM_AXIS fbs FORMULA_0733 12 0.0 74.43340301513672 AXIS_PTS_REF GKL_KR_AXIS_FBS MAX_GRAD 0.0 /end AXIS_DESCR
/end CHARACTERISTIC
/begin CHARACTERISTIC GKF_KR_DTZ_AB "Klopfregelungseingriff in Abregelphase." MAP 0x74D22 TGF_VV_VV_SW 110.0 FORMULA_0102 -50.0 60.0 FORMAT "%4.1"
 /begin AXIS_DESCR COM_AXIS n FORMULA_0006 12 0.0 10000.0 AXIS_PTS_REF AXIS_N12 MAX_GRAD 0.0 /end AXIS_DESCR
 /begin AXIS_DESCR COM_AXIS fbs FORMULA_0733 12 0.0 74.43340301513672 AXIS_PTS_REF GKL_KR_AXIS_FBS MAX_GRAD 0.0 /end AXIS_DESCR
/end CHARACTERISTIC
/begin CHARACTERISTIC GKF_KR_FBS_AVG_OFF_MAX "Zulaessiges Delta zum Mittelwert Engeriespektrum der Klopffrequenz." MAP 0x74B52 TGF_VV_VV_SW 74.40000152587891 FORMULA_0733 0.0 74.43340301513672 FORMAT "%5.2"
 /begin AXIS_DESCR COM_AXIS n FORMULA_0006 16 0.0 10000.0 AXIS_PTS_REF AXIS_N16 MAX_GRAD 0.0 /end AXIS_DESCR
 /begin AXIS_DESCR COM_AXIS rf_m FORMULA_0007 10 0.0 2.0 AXIS_PTS_REF AXIS_RF10 MAX_GRAD 0.0 /end AXIS_DESCR
/end CHARACTERISTIC
/begin CHARACTERISTIC GKF_KR_KNOCK_LAENGE "Laenge des Klopffensters." MAP 0x74A12 TGF_VV_VV_SW 180.0 FORMULA_0709 0.0 180.0 FORMAT "%4.1"
 /begin AXIS_DESCR COM_AXIS n FORMULA_0006 16 0.0 10000.0 AXIS_PTS_REF AXIS_N16 MAX_GRAD 0.0 /end AXIS_DESCR
 /begin AXIS_DESCR COM_AXIS rf_m FORMULA_0007 10 0.0 2.0 AXIS_PTS_REF AXIS_RF10 MAX_GRAD 0.0 /end AXIS_DESCR
/end CHARACTERISTIC
/begin CHARACTERISTIC GKF_KR_KNOCK_TZ_OFFS "Offset des Klopffensters gegenueber dem Zuendwinkel." MAP 0x748D2 TGF_VV_VV_SW 180.0 FORMULA_0709 0.0 180.0 FORMAT "%4.1"
 /begin AXIS_DESCR COM_AXIS n FORMULA_0006 16 0.0 10000.0 AXIS_PTS_REF AXIS_N16 MAX_GRAD 0.0 /end AXIS_DESCR
 /begin AXIS_DESCR COM_AXIS rf_m FORMULA_0007 10 0.0 2.0 AXIS_PTS_REF AXIS_RF10 MAX_GRAD 0.0 /end AXIS_DESCR
/end CHARACTERISTIC
/begin CHARACTERISTIC GKF_N_LW_A_WICHT "Wichtung Auslassladungswechseldrehzahloffset." MAP 0x783CC TGF_VV_VV_UW 4.0 FORMULA_0073 0.0 4.0 FORMAT "%6.3"
 /begin AXIS_DESCR COM_AXIS n FORMULA_0006 6 0.0 10000.0 AXIS_PTS_REF AXIS_N_LW_N6 MAX_GRAD 0.0 /end AXIS_DESCR
 /begin AXIS_DESCR COM_AXIS rf_m FORMULA_0007 6 0.0 2.0 AXIS_PTS_REF AXIS_N_LW_RF6 MAX_GRAD 0.0 /end AXIS_DESCR
/end CHARACTERISTIC
/begin CHARACTERISTIC GKF_N_LW_E_WICHT "Wichtung Einlassladungswechseldrehzahloffset." MAP 0x78384 TGF_VV_VV_UW 4.0 FORMULA_0073 0.0 4.0 FORMAT "%6.3"
 /begin AXIS_DESCR COM_AXIS n FORMULA_0006 6 0.0 10000.0 AXIS_PTS_REF AXIS_N_LW_N6 MAX_GRAD 0.0 /end AXIS_DESCR
 /begin AXIS_DESCR COM_AXIS rf_m FORMULA_0007 6 0.0 2.0 AXIS_PTS_REF AXIS_N_LW_RF6 MAX_GRAD 0.0 /end AXIS_DESCR
/end CHARACTERISTIC
/begin CHARACTERISTIC GKF_N_LW_WICHT "Wichtung Ladungswechseldrehzahloffset." MAP 0x78414 TGF_VV_VV_UW 4.0 FORMULA_0073 0.0 4.0 FORMAT "%6.3"
 /begin AXIS_DESCR COM_AXIS n FORMULA_0006 6 0.0 10000.0 AXIS_PTS_REF AXIS_N_LW_N6 MAX_GRAD 0.0 /end AXIS_DESCR
 /begin AXIS_DESCR COM_AXIS rf_m FORMULA_0007 6 0.0 2.0 AXIS_PTS_REF AXIS_N_LW_RF6 MAX_GRAD 0.0 /end AXIS_DESCR
/end CHARACTERISTIC
/begin CHARACTERISTIC GKF_VR_VORST_BAS "Basisvorsteuereung der Erfassungstufe." MAP 0x7AF1E TGF_VV_VV_SW 64.0 FORMULA_0447 -32.0 32.0 FORMAT "%6.3"
 /begin AXIS_DESCR COM_AXIS n FORMULA_0006 16 0.0 10000.0 AXIS_PTS_REF AXIS_N16 MAX_GRAD 0.0 /end AXIS_DESCR
 /begin AXIS_DESCR COM_AXIS rf_m FORMULA_0007 10 0.0 2.0 AXIS_PTS_REF AXIS_RF10 MAX_GRAD 0.0 /end AXIS_DESCR
/end CHARACTERISTIC
/begin CHARACTERISTIC GKL_KA_ADAPT_MIN "Min KA Zuendwinkeleingriff." CURVE 0x7367A TGL_VV_VV_SW 110.0 FORMULA_0102 -50.0 60.0 FORMAT "%4.1"
 /begin AXIS_DESCR COM_AXIS n FORMULA_0006 10 0.0 10000.0 AXIS_PTS_REF AXIS_N10 MAX_GRAD 0.0 /end AXIS_DESCR
/end CHARACTERISTIC
/begin CHARACTERISTIC GKL_KR_DTZ_MAX "Maximal zulaessiger Klopfregelungseingriff." CURVE 0x74860 TGL_VV_VV_SW 110.0 FORMULA_0102 -50.0 60.0 FORMAT "%4.1"
 /begin AXIS_DESCR COM_AXIS n FORMULA_0006 10 0.0 10000.0 AXIS_PTS_REF AXIS_N10 MAX_GRAD 0.0 /end AXIS_DESCR
/end CHARACTERISTIC
/begin CHARACTERISTIC GKL_KR_FBS_AVG_OFF_MAX "Zulaessiges Delta zum Mittelwert Engeriespektrum der Klopffrequenz bei VL." CURVE 0x748B2 TGL_VV_VV_SW 74.40000152587891 FORMULA_0733 0.0 74.43340301513672 FORMAT "%5.2"
 /begin AXIS_DESCR COM_AXIS n FORMULA_0006 16 0.0 10000.0 AXIS_PTS_REF AXIS_N16 MAX_GRAD 0.0 /end AXIS_DESCR
/end CHARACTERISTIC
/begin CHARACTERISTIC GKL_KR_RF_MIN "Mindestfuellung fuer KR-Freigabe." CURVE 0x74874 TGL_VV_VV_SW 2.0 FORMULA_0007 0.0 2.0 FORMAT "%6.3"
 /begin AXIS_DESCR COM_AXIS n FORMULA_0006 12 0.0 10000.0 AXIS_PTS_REF AXIS_N12 MAX_GRAD 0.0 /end AXIS_DESCR
/end CHARACTERISTIC
/begin CHARACTERISTIC K_KA_ADAPT_MAX "Max KA Zuendwinkeleingriff." VALUE 0x735DC TKW_VV_VV_SW 100.0 FORMULA_0102 -50.0 60.0 FORMAT "%4.1" /end CHARACTERISTIC
/begin CHARACTERISTIC K_KA_AQ_GRAD_MAX "Trigger Dynamik Deaktivierung." VALUE 0x735D8 TKW_VV_VV_SW 100.0 FORMULA_0020 -655360.0 655340.0 /end CHARACTERISTIC
/begin CHARACTERISTIC K_KA_AQ_GRAD_SEGM_CNT "Anzahl Segmente Deaktivierung nach Dynamik." VALUE 0x735D6 TKW_VV_VV_UW 100.0 FORMULA_0010 0.0 65535.0 /end CHARACTERISTIC
/begin CHARACTERISTIC K_KA_DIAG_T "Maximalzeit der Diagnose Bereichsueberwachung." VALUE 0x735D0 TKW_VV_VV_UW 100.0 FORMULA_0071 0.0 6553.5 FORMAT "%4.1" /end CHARACTERISTIC
/begin CHARACTERISTIC K_KA_DTZ_MAX "Max Klopfadaptionsrueckziehwinkel." VALUE 0x735DE TKW_VV_VV_SW 100.0 FORMULA_0102 -50.0 60.0 FORMAT "%4.1" /end CHARACTERISTIC
/begin CHARACTERISTIC K_KA_FILT_KK_KA "Max Zuendwinkelgradient bei pos. ka_offs." VALUE 0x735E0 TKW_VV_VV_SW 100.0 FORMULA_0700 0.0 1.0 FORMAT "%6.3" /end CHARACTERISTIC
/begin CHARACTERISTIC K_KA_FILT_KK_KKA "Max Zuendwinkelgradient bei neg. ka_offs." VALUE 0x735E2 TKW_VV_VV_SW 100.0 FORMULA_0700 0.0 1.0 FORMAT "%6.3" /end CHARACTERISTIC
/begin CHARACTERISTIC K_KA_FILT_LK "Max Zuendwinkelgradient bei leichtem Klopfer." VALUE 0x735E4 TKW_VV_VV_SW 100.0 FORMULA_0700 0.0 1.0 FORMAT "%6.3" /end CHARACTERISTIC
/begin CHARACTERISTIC K_KA_FILT_SK "Max Zuendwinkelgradient bei starkem Klopfer." VALUE 0x735E6 TKW_VV_VV_SW 100.0 FORMULA_0700 0.0 1.0 FORMAT "%6.3" /end CHARACTERISTIC
/begin CHARACTERISTIC K_KA_KLIPPING_MAX "Klopfschutzschwelle fuer Klipping im Klopffenster." VALUE 0x735EA TKW_VV_VV_UB 100.0 FORMULA_0003 0.0 255.0 /end CHARACTERISTIC
/begin CHARACTERISTIC K_KA_KS_CFG "Freigabe Klopfschutz." VALUE 0x735CE TKW_VV_VV_UB 100.0 FORMULA_0697 0.0 1.0 /end CHARACTERISTIC
/begin CHARACTERISTIC K_KA_RESET_CFG "Reset Klopfadaption." VALUE 0x735CF TKW_VV_VV_UB 100.0 FORMULA_0698 0.0 1.0 /end CHARACTERISTIC
/begin CHARACTERISTIC K_KA_TP_TAU "Tau Tiefpassfilter Klopfrueckziehwinkel." VALUE 0x735D2 TKW_VV_VV_UW 100.0 FORMULA_0699 0.100100003182888 6553.60009765625 FORMAT "%7.4" /end CHARACTERISTIC
/begin CHARACTERISTIC K_KA_TREPP_F "Wichtungsfaktor." VALUE 0x735D4 TKW_VV_VV_UW 100.0 FORMULA_0482 0.0 7.999800205230713 FORMAT "%7.4" /end CHARACTERISTIC
/begin CHARACTERISTIC K_KA_TZ_KS "Klopfschutzzuendwinkeloffset." VALUE 0x735E8 TKW_VV_VV_SW 100.0 FORMULA_0102 -50.0 60.0 FORMAT "%4.1" /end CHARACTERISTIC
/begin CHARACTERISTIC K_KA_TZ_MIN_HYST "tz_min Hysterese." VALUE 0x735DA TKW_VV_VV_SW 100.0 FORMULA_0102 -50.0 60.0 FORMAT "%4.1" /end CHARACTERISTIC
/begin CHARACTERISTIC K_KH_MD_ETA_GRAD_INAKTIV "Gradient Aenderungsbegrenzung" VALUE 0x73D36 TKW_VV_VV_UW 100.0 FORMULA_0701 0.0 100.0 FORMAT "%6.3" /end CHARACTERISTIC
/begin CHARACTERISTIC K_KH_MD_ETA_GRAD_START "Gradient Aenderungsbegrenzung" VALUE 0x73D34 TKW_VV_VV_UW 100.0 FORMULA_0701 0.0 100.0 FORMAT "%6.3" /end CHARACTERISTIC
/begin CHARACTERISTIC K_KH_MD_ETA_GRAD_START_SL "Gradient Aenderungsbegrenzung" VALUE 0x73D32 TKW_VV_VV_UW 100.0 FORMULA_0701 0.0 100.0 FORMAT "%6.3" /end CHARACTERISTIC
/begin CHARACTERISTIC K_KH_MD_ETA_MAX "maximales ETA bei KH" VALUE 0x73D3A TKW_VV_VV_UW 100.0 FORMULA_0437 0.0 150.0 FORMAT "%4.1" /end CHARACTERISTIC
/begin CHARACTERISTIC K_KH_MD_ETA_MIN "minimales ETA bei KH" VALUE 0x73D38 TKW_VV_VV_UW 100.0 FORMULA_0437 0.0 150.0 FORMAT "%4.1" /end CHARACTERISTIC
/begin CHARACTERISTIC K_KH_N_MAX "Drehzalschwelle fuer Katheizen aus" VALUE 0x73D16 TKW_VV_VV_SW 100.0 FORMULA_0006 0.0 10000.0 /end CHARACTERISTIC
/begin CHARACTERISTIC K_KH_N_MAX_HYS "Drehzalhysterese fuer Katheizen aus" VALUE 0x73D18 TKW_VV_VV_SW 100.0 FORMULA_0006 0.0 10000.0 /end CHARACTERISTIC
/begin CHARACTERISTIC K_KH_PUMG_MIN "min. zulaessige PUMG fuer KH" VALUE 0x73D2C TKW_VV_VV_SW 100.0 FORMULA_0075 10.0 1200.0 FORMAT "%4.1" /end CHARACTERISTIC
/begin CHARACTERISTIC K_KH_PUMG_MIN_HYS "Hysterese fuer min. zulaessige PUMG" VALUE 0x73D2E TKW_VV_VV_SW 100.0 FORMULA_0075 10.0 1200.0 FORMAT "%4.1" /end CHARACTERISTIC
/begin CHARACTERISTIC K_KH_RF_MAX "Lastschwelle fuer Katheizen aus" VALUE 0x73D12 TKW_VV_VV_SW 100.0 FORMULA_0007 0.0 2.0 FORMAT "%6.3" /end CHARACTERISTIC
/begin CHARACTERISTIC K_KH_RF_MAX_HYS "Lasthysterese fuer Katheizen aus" VALUE 0x73D14 TKW_VV_VV_SW 100.0 FORMULA_0007 0.0 2.0 FORMAT "%6.3" /end CHARACTERISTIC
/begin CHARACTERISTIC K_KH_SLP_DAUER_MIN "Minimale Dauer der SLP Laufzeit fuer KH" VALUE 0x73D30 TKW_VV_VV_UW 100.0 FORMULA_0071 0.0 6553.5 FORMAT "%4.1" /end CHARACTERISTIC
/begin CHARACTERISTIC K_KH_SMG_TMOT_MAX "Temperaturschwelle fuer SMG-KH" VALUE 0x73D26 TKW_VV_VV_SW 100.0 FORMULA_0023 -50.0 150.0 FORMAT "%4.1" /end CHARACTERISTIC
/begin CHARACTERISTIC K_KH_SMG_TMOT_MIN "min. Temperaturschwelle fuer SMG-KH" VALUE 0x73D24 TKW_VV_VV_SW 100.0 FORMULA_0023 -50.0 150.0 FORMAT "%4.1" /end CHARACTERISTIC
/begin CHARACTERISTIC K_KH_TAN_MAX "max. zulaessige Ansaugtemperatur fuer KH" VALUE 0x73D28 TKW_VV_VV_SW 100.0 FORMULA_0023 -50.0 170.0 FORMAT "%4.1" /end CHARACTERISTIC
/begin CHARACTERISTIC K_KH_TAN_MAX_HYS "Hysterese fuer max. zulaessige Ansaugtemperatur" VALUE 0x73D2A TKW_VV_VV_SW 100.0 FORMULA_0023 -50.0 170.0 FORMAT "%4.1" /end CHARACTERISTIC
/begin CHARACTERISTIC K_KH_TKAT_CFG "Konfigbyte zur Kat.Temperaturwahl fuer die Alterung" VALUE 0x73D10 TKW_VV_VV_UB 100.0 FORMULA_0702 0.0 255.0 /end CHARACTERISTIC
/begin CHARACTERISTIC K_KH_TKAT_HYST "Hysterese fuer TKAT-Ende" VALUE 0x73D1A TKW_VV_VV_SW 100.0 FORMULA_0074 0.0 1000.0 FORMAT "%4.1" /end CHARACTERISTIC
/begin CHARACTERISTIC K_KH_TZ_ABS_AB "Aenderungsbegr. Faktor Ende KH" VALUE 0x73D22 TKW_VV_VV_UW 100.0 FORMULA_0705 0.0 2.0 FORMAT "%7.4" /end CHARACTERISTIC
/begin CHARACTERISTIC K_KH_TZ_CFG "Konfigbyte fuer TZ-Eingriff" VALUE 0x73D11 TKW_VV_VV_UB 100.0 FORMULA_0703 0.0 255.0 /end CHARACTERISTIC
/begin CHARACTERISTIC K_KH_VAN_AB_Auslass "Katheizen Abregelzeit" VALUE 0x73D20 TKW_VV_VV_SW 100.0 FORMULA_0704 164.0 9.999999776482582e-003 FORMAT "%5.2" /end CHARACTERISTIC
/begin CHARACTERISTIC K_KH_VAN_AB_Einlass "Katheizen Abregelzeit" VALUE 0x73D1E TKW_VV_VV_SW 100.0 FORMULA_0704 164.0 9.999999776482582e-003 FORMAT "%5.2" /end CHARACTERISTIC
/begin CHARACTERISTIC K_KH_VAN_TMOT_MAX "Katheizen Obergrenze" VALUE 0x73D1C TKW_VV_VV_SW 100.0 FORMULA_0023 -50.0 170.0 FORMAT "%4.1" /end CHARACTERISTIC
/begin CHARACTERISTIC K_KIS_ACTIVE_PULSE "Aktiv Puls Konfiguration." VALUE 0x74811 TKW_VV_VV_UB 100.0 FORMULA_0708 0.0 1.0 /end CHARACTERISTIC
/begin CHARACTERISTIC K_KIS_CFG "KIS-Konfiguration" VALUE 0x74810 TKW_VV_VV_UB 100.0 FORMULA_0707 0.0 255.0 /end CHARACTERISTIC
/begin CHARACTERISTIC K_KIS_LEN "Pulslaenge." VALUE 0x74814 TKW_VV_VV_UW 100.0 FORMULA_0709 0.0 719.989013671875 FORMAT "%4.1" /end CHARACTERISTIC
/begin CHARACTERISTIC K_KIS_PERIOD "Pulsperiode." VALUE 0x74816 TKW_VV_VV_UW 100.0 FORMULA_0709 0.0 719.989013671875 FORMAT "%4.1" /end CHARACTERISTIC
/begin CHARACTERISTIC K_KIS_START "Pulsstart." VALUE 0x74812 TKW_VV_VV_UW 100.0 FORMULA_0709 0.0 719.989013671875 FORMAT "%4.1" /end CHARACTERISTIC
/begin CHARACTERISTIC K_KIS_TIME_OUT "Maximal Pulszeit." VALUE 0x74818 TKW_VV_VV_UL 100.0 FORMULA_0017 0.0 1198.3724 FORMAT "%5.2" /end CHARACTERISTIC
/begin CHARACTERISTIC K_KR_APPL_CFG "Schalter Freigabe Applikationshilfe." VALUE 0x7481F TKW_VV_VV_UB 100.0 FORMULA_0565 0.0 255.0 /end CHARACTERISTIC
/begin CHARACTERISTIC K_KR_APPL_DTZ_ZYL1 "Applikationszuendwinkeloffset." VALUE 0x74832 TKW_VV_VV_SW 100.0 FORMULA_0102 -50.0 60.0 FORMAT "%4.1" /end CHARACTERISTIC
/begin CHARACTERISTIC K_KR_APPL_DTZ_ZYL10 "Applikationszuendwinkeloffset." VALUE 0x74844 TKW_VV_VV_SW 100.0 FORMULA_0102 -50.0 60.0 FORMAT "%4.1" /end CHARACTERISTIC
/begin CHARACTERISTIC K_KR_APPL_DTZ_ZYL2 "Applikationszuendwinkeloffset." VALUE 0x74834 TKW_VV_VV_SW 100.0 FORMULA_0102 -50.0 60.0 FORMAT "%4.1" /end CHARACTERISTIC
/begin CHARACTERISTIC K_KR_APPL_DTZ_ZYL3 "Applikationszuendwinkeloffset." VALUE 0x74836 TKW_VV_VV_SW 100.0 FORMULA_0102 -50.0 60.0 FORMAT "%4.1" /end CHARACTERISTIC
/begin CHARACTERISTIC K_KR_APPL_DTZ_ZYL4 "Applikationszuendwinkeloffset." VALUE 0x74838 TKW_VV_VV_SW 100.0 FORMULA_0102 -50.0 60.0 FORMAT "%4.1" /end CHARACTERISTIC
/begin CHARACTERISTIC K_KR_APPL_DTZ_ZYL5 "Applikationszuendwinkeloffset." VALUE 0x7483A TKW_VV_VV_SW 100.0 FORMULA_0102 -50.0 60.0 FORMAT "%4.1" /end CHARACTERISTIC
/begin CHARACTERISTIC K_KR_APPL_DTZ_ZYL6 "Applikationszuendwinkeloffset." VALUE 0x7483C TKW_VV_VV_SW 100.0 FORMULA_0102 -50.0 60.0 FORMAT "%4.1" /end CHARACTERISTIC
/begin CHARACTERISTIC K_KR_APPL_DTZ_ZYL7 "Applikationszuendwinkeloffset." VALUE 0x7483E TKW_VV_VV_SW 100.0 FORMULA_0102 -50.0 60.0 FORMAT "%4.1" /end CHARACTERISTIC
/begin CHARACTERISTIC K_KR_APPL_DTZ_ZYL8 "Applikationszuendwinkeloffset." VALUE 0x74840 TKW_VV_VV_SW 100.0 FORMULA_0102 -50.0 60.0 FORMAT "%4.1" /end CHARACTERISTIC
/begin CHARACTERISTIC K_KR_APPL_DTZ_ZYL9 "Applikationszuendwinkeloffset." VALUE 0x74842 TKW_VV_VV_SW 100.0 FORMULA_0102 -50.0 60.0 FORMAT "%4.1" /end CHARACTERISTIC
/begin CHARACTERISTIC K_KR_APPL_NUM_ZYL1 "Anzahl Applikationszuendwinkelverstellung." VALUE 0x74828 TKW_VV_VV_UB 100.0 FORMULA_0003 0.0 255.0 /end CHARACTERISTIC
/begin CHARACTERISTIC K_KR_APPL_NUM_ZYL10 "Anzahl Applikationszuendwinkelverstellung." VALUE 0x74831 TKW_VV_VV_UB 100.0 FORMULA_0003 0.0 255.0 /end CHARACTERISTIC
/begin CHARACTERISTIC K_KR_APPL_NUM_ZYL2 "Anzahl Applikationszuendwinkelverstellung." VALUE 0x74829 TKW_VV_VV_UB 100.0 FORMULA_0003 0.0 255.0 /end CHARACTERISTIC
/begin CHARACTERISTIC K_KR_APPL_NUM_ZYL3 "Anzahl Applikationszuendwinkelverstellung." VALUE 0x7482A TKW_VV_VV_UB 100.0 FORMULA_0003 0.0 255.0 /end CHARACTERISTIC
/begin CHARACTERISTIC K_KR_APPL_NUM_ZYL4 "Anzahl Applikationszuendwinkelverstellung." VALUE 0x7482B TKW_VV_VV_UB 100.0 FORMULA_0003 0.0 255.0 /end CHARACTERISTIC
/begin CHARACTERISTIC K_KR_APPL_NUM_ZYL5 "Anzahl Applikationszuendwinkelverstellung." VALUE 0x7482C TKW_VV_VV_UB 100.0 FORMULA_0003 0.0 255.0 /end CHARACTERISTIC
/begin CHARACTERISTIC K_KR_APPL_NUM_ZYL6 "Anzahl Applikationszuendwinkelverstellung." VALUE 0x7482D TKW_VV_VV_UB 100.0 FORMULA_0003 0.0 255.0 /end CHARACTERISTIC
/begin CHARACTERISTIC K_KR_APPL_NUM_ZYL7 "Anzahl Applikationszuendwinkelverstellung." VALUE 0x7482E TKW_VV_VV_UB 100.0 FORMULA_0003 0.0 255.0 /end CHARACTERISTIC
/begin CHARACTERISTIC K_KR_APPL_NUM_ZYL8 "Anzahl Applikationszuendwinkelverstellung." VALUE 0x7482F TKW_VV_VV_UB 100.0 FORMULA_0003 0.0 255.0 /end CHARACTERISTIC
/begin CHARACTERISTIC K_KR_APPL_NUM_ZYL9 "Anzahl Applikationszuendwinkelverstellung." VALUE 0x74830 TKW_VV_VV_UB 100.0 FORMULA_0003 0.0 255.0 /end CHARACTERISTIC
/begin CHARACTERISTIC K_KR_APPL_PER "Periode Applikationshilfe." VALUE 0x74820 TKW_VV_VV_UB 100.0 FORMULA_0003 0.0 255.0 /end CHARACTERISTIC
/begin CHARACTERISTIC K_KR_CFG "Schalter Freigabe Klopfregelung." VALUE 0x7481C TKW_VV_VV_UB 100.0 FORMULA_0565 0.0 255.0 /end CHARACTERISTIC
/begin CHARACTERISTIC K_KR_DIAG_T "Maximalzeit der Bereichsueberwachungdiagnose." VALUE 0x74822 TKW_VV_VV_UW 100.0 FORMULA_0071 0.0 6553.5 FORMAT "%4.1" /end CHARACTERISTIC
/begin CHARACTERISTIC K_KR_FB_LEN "Frequenzbandlaenge." VALUE 0x7481E TKW_VV_VV_UB 100.0 FORMULA_0734 0.1221000030636787 3.78410005569458 /end CHARACTERISTIC
/begin CHARACTERISTIC K_KR_FB_START "Frequenzbandstart." VALUE 0x7481D TKW_VV_VV_UB 100.0 FORMULA_0734 0.0 31.12789916992188 /end CHARACTERISTIC
/begin CHARACTERISTIC K_KR_KLIPPING_MAX "Max zulaessiges Klipping im Klopffenster." VALUE 0x74826 TKW_VV_VV_SW 100.0 FORMULA_0442 0.0 3.299999952316284 FORMAT "%5.2" /end CHARACTERISTIC
/begin CHARACTERISTIC K_KR_TMOT_MIN "Maximaltemperatur fuer KR-Freigabe" VALUE 0x74824 TKW_VV_VV_SW 100.0 FORMULA_0023 -50.0 170.0 FORMAT "%4.1" /end CHARACTERISTIC
/begin CHARACTERISTIC K_KUS_CFG "Schalter Konfiguration Kupplungsschlupfregelung" VALUE 0x74E8A TKW_VV_VV_UB 100.0 FORMULA_0736 0.0 255.0 /end CHARACTERISTIC
/begin CHARACTERISTIC K_KUS_GANG_MAX "maximaler Gang, bei dem noch eine Freigabe erfolgt" VALUE 0x74E90 TKW_VV_VV_SB 100.0 FORMULA_0135 -1.0 10.0 /end CHARACTERISTIC
/begin CHARACTERISTIC K_KUS_N_DELTA_AUS "Begrenzung Abregelrampe Motordrehzahl" VALUE 0x74E8E TKW_VV_VV_UW 100.0 FORMULA_0737 0.0 20000.0 FORMAT "%5.2" /end CHARACTERISTIC
/begin CHARACTERISTIC K_KUS_N_DELTA_EIN "Begrenzung Abregelrampe Motordrehzahl" VALUE 0x74E8C TKW_VV_VV_UW 100.0 FORMULA_0737 0.0 20000.0 FORMAT "%5.2" /end CHARACTERISTIC
/begin CHARACTERISTIC K_KUS_N_GETR_EIN_HYS "Hysterese minimale Getriebeeingangsdrehzahl KUS Timer" VALUE 0x74E94 TKW_VV_VV_SW 100.0 FORMULA_0006 0.0 10000.0 /end CHARACTERISTIC
/begin CHARACTERISTIC K_KUS_N_GETR_EIN_MIN "minimale Getriebeeingangsdrehzahl KUS Timer" VALUE 0x74E92 TKW_VV_VV_SW 100.0 FORMULA_0006 0.0 10000.0 /end CHARACTERISTIC
/begin CHARACTERISTIC K_KUS_STUFE "Eingriffsstufe Kupplungsschlupfregelung" VALUE 0x74E8B TKW_VV_VV_UB 100.0 FORMULA_0003 0.0 255.0 /end CHARACTERISTIC
/begin CHARACTERISTIC K_KUS_V_VORNE_HYS "Hysterese maximale Geschwindigkeit, bei der noch Freigabe" VALUE 0x74E98 TKW_VV_VV_SW 100.0 FORMULA_0076 -80.0 360.0 FORMAT "%4.1" /end CHARACTERISTIC
/begin CHARACTERISTIC K_KUS_V_VORNE_MAX "maximale Geschwindigkeit, bei der noch Freigabe" VALUE 0x74E96 TKW_VV_VV_SW 100.0 FORMULA_0076 -80.0 360.0 FORMAT "%4.1" /end CHARACTERISTIC
/begin CHARACTERISTIC K_LAZ_ANZ_SEG "Anzahl der Versoegerungssegmente" VALUE 0x74F04 TKW_VV_VV_UB 100.0 FORMULA_0003 1.0 5.0 /end CHARACTERISTIC
/begin CHARACTERISTIC K_LLR_AD_AC_MAX "Maxwert Klima" VALUE 0x754B0 TKW_VV_VV_SW 100.0 FORMULA_0009 0.0 25.0 FORMAT "%4.1" /end CHARACTERISTIC
/begin CHARACTERISTIC K_LLR_AD_AC_MIN "Minwert Klima" VALUE 0x754AE TKW_VV_VV_SW 100.0 FORMULA_0009 -25.0 0.0 FORMAT "%4.1" /end CHARACTERISTIC
/begin CHARACTERISTIC K_LLR_AD_CFG "Konfiguration" VALUE 0x7549C TKW_VV_VV_UB 100.0 FORMULA_0753 0.0 255.0 /end CHARACTERISTIC
/begin CHARACTERISTIC K_LLR_AD_I_ANTEIL_OFF "Restwert I-Anteil" VALUE 0x754B4 TKW_VV_VV_SW 100.0 FORMULA_0009 -25.0 0.0 FORMAT "%4.1" /end CHARACTERISTIC
/begin CHARACTERISTIC K_LLR_AD_I_TAU "Filterzeit" VALUE 0x7549D TKW_VV_VV_UB 100.0 FORMULA_0754 1.003999948501587 256.0 /end CHARACTERISTIC
/begin CHARACTERISTIC K_LLR_AD_MD_GRAD "Änderungsbegrenzung" VALUE 0x754B2 TKW_VV_VV_SW 100.0 FORMULA_0755 -3000.0 25.0 FORMAT "%4.1" /end CHARACTERISTIC
/begin CHARACTERISTIC K_LLR_AD_MD_NEUZUSTAND "Werte Neuzustand" VALUE 0x754B8 TKW_VV_VV_SW 100.0 FORMULA_0009 -50.0 50.0 FORMAT "%4.1" /end CHARACTERISTIC
/begin CHARACTERISTIC K_LLR_AD_MD_ZYKLUS_MAX "max. Änderung pro Zyklus" VALUE 0x754B6 TKW_VV_VV_SW 100.0 FORMULA_0009 0.0 25.0 FORMAT "%4.1" /end CHARACTERISTIC
/begin CHARACTERISTIC K_LLR_AD_N_HYS_NEG "negativer Offset" VALUE 0x754A4 TKW_VV_VV_SW 100.0 FORMULA_0006 -500.0 0.0 /end CHARACTERISTIC
/begin CHARACTERISTIC K_LLR_AD_N_HYS_POS "positiver Offset" VALUE 0x754A2 TKW_VV_VV_SW 100.0 FORMULA_0006 0.0 500.0 /end CHARACTERISTIC
/begin CHARACTERISTIC K_LLR_AD_NORM_MAX "Maxwert normal" VALUE 0x754AC TKW_VV_VV_SW 100.0 FORMULA_0009 0.0 25.0 FORMAT "%4.1" /end CHARACTERISTIC
/begin CHARACTERISTIC K_LLR_AD_NORM_MIN "Minwert normal" VALUE 0x754AA TKW_VV_VV_SW 100.0 FORMULA_0009 -25.0 0.0 FORMAT "%4.1" /end CHARACTERISTIC
/begin CHARACTERISTIC K_LLR_AD_TIME_STABIL "Stabilisierzeit" VALUE 0x754A6 TKW_VV_VV_UW 100.0 FORMULA_0071 0.0 6553.5 FORMAT "%4.1" /end CHARACTERISTIC
/begin CHARACTERISTIC K_LLR_AD_TMOT "Tmot-Schwelle" VALUE 0x7549E TKW_VV_VV_SW 100.0 FORMULA_0023 -50.0 170.0 FORMAT "%4.1" /end CHARACTERISTIC
/begin CHARACTERISTIC K_LLR_AD_TOEL "Toel-Schwelle" VALUE 0x754A0 TKW_VV_VV_SW 100.0 FORMULA_0023 -50.0 170.0 FORMAT "%4.1" /end CHARACTERISTIC
/begin CHARACTERISTIC K_LLR_AD_UMSCHALT_RAMPE "Umschaltrampe" VALUE 0x754A8 TKW_VV_VV_SW 100.0 FORMULA_0755 -3000.0 25.0 FORMAT "%4.1" /end CHARACTERISTIC
/begin CHARACTERISTIC K_LLR_CFG_MIN "Konfiguration Begr Min-Moment" VALUE 0x74F69 TKW_VV_VV_UB 100.0 FORMULA_0744 0.0 255.0 /end CHARACTERISTIC
/begin CHARACTERISTIC K_LLR_CFG_N_NACHF "Konfiguration nachgef. nSoll" VALUE 0x74F68 TKW_VV_VV_UB 100.0 FORMULA_0743 0.0 255.0 /end CHARACTERISTIC
/begin CHARACTERISTIC K_LLR_D_GRAD "Aktivieren D-Anteil" VALUE 0x74F8C TKW_VV_VV_SW 100.0 FORMULA_0105 -10000.0 10000.0 /end CHARACTERISTIC
/begin CHARACTERISTIC K_LLR_D_OFFSET "Aktivieren D-Anteil" VALUE 0x74F8E TKW_VV_VV_SW 100.0 FORMULA_0006 0.0 10000.0 /end CHARACTERISTIC
/begin CHARACTERISTIC K_LLR_DIAG_CSS_N_ZU_GROSS "Schwelle fuer n zu gross" VALUE 0x74FB6 TKW_VV_VV_UB 100.0 FORMULA_0745 0.0 250.0 /end CHARACTERISTIC
/begin CHARACTERISTIC K_LLR_DIAG_CSS_N_ZU_KLEIN "Schwelle fuer n zu klein" VALUE 0x74FB7 TKW_VV_VV_UB 100.0 FORMULA_0745 0.0 250.0 /end CHARACTERISTIC
/begin CHARACTERISTIC K_LLR_DIAG_CSS_T "Diagnosezeit" VALUE 0x74FB8 TKW_VV_VV_UB 100.0 FORMULA_0492 0.0 25.5 /end CHARACTERISTIC
/begin CHARACTERISTIC K_LLR_DIAG_CSS_T_IO "Diagnosezeit iO" VALUE 0x74FB9 TKW_VV_VV_UB 100.0 FORMULA_0492 0.0 25.5 /end CHARACTERISTIC
/begin CHARACTERISTIC K_LLR_DIAG_CSS_TMOT "Tmot-Schwelle" VALUE 0x74FB2 TKW_VV_VV_SW 100.0 FORMULA_0023 -50.0 170.0 FORMAT "%4.1" /end CHARACTERISTIC
/begin CHARACTERISTIC K_LLR_DIAG_CSS_TOEL "Toel-Schwelle" VALUE 0x74FB4 TKW_VV_VV_SW 100.0 FORMULA_0023 -50.0 170.0 FORMAT "%4.1" /end CHARACTERISTIC
/begin CHARACTERISTIC K_LLR_DIAG_FRA_MAX "max. Leckluftadaption" VALUE 0x74FA8 TKW_VV_VV_SW 100.0 FORMULA_0424 0.0 50.0 FORMAT "%5.2" /end CHARACTERISTIC
/begin CHARACTERISTIC K_LLR_DIAG_FRA_MIN "min. Leckluftadaption" VALUE 0x74FA6 TKW_VV_VV_SW 100.0 FORMULA_0424 -50.0 0.0 FORMAT "%5.2" /end CHARACTERISTIC
/begin CHARACTERISTIC K_LLR_DIAG_MD_ERR_ABR "Absteuerrampe Fehlerfall" VALUE 0x74FAC TKW_VV_VV_UB 100.0 FORMULA_0748 0.0 255.0 /end CHARACTERISTIC
/begin CHARACTERISTIC K_LLR_DIAG_MD_FAK "Faktor auf min. Moment" VALUE 0x74FAA TKW_VV_VV_UW 100.0 FORMULA_0073 0.0 4.0 FORMAT "%6.3" /end CHARACTERISTIC
/begin CHARACTERISTIC K_LLR_DIAG_N_ZU_GROSS "Schwelle fuer n zu gross" VALUE 0x74FAF TKW_VV_VV_UB 100.0 FORMULA_0745 0.0 250.0 /end CHARACTERISTIC
/begin CHARACTERISTIC K_LLR_DIAG_N_ZU_KLEIN "Schwelle fuer n zu klein" VALUE 0x74FB0 TKW_VV_VV_UB 100.0 FORMULA_0745 0.0 250.0 /end CHARACTERISTIC
/begin CHARACTERISTIC K_LLR_DIAG_T "Diagnosezeit" VALUE 0x74FAD TKW_VV_VV_UB 100.0 FORMULA_0492 0.0 25.5 /end CHARACTERISTIC
/begin CHARACTERISTIC K_LLR_DIAG_T_IO "Diagnosezeit iO" VALUE 0x74FAE TKW_VV_VV_UB 100.0 FORMULA_0492 0.0 25.5 /end CHARACTERISTIC
/begin CHARACTERISTIC K_LLR_DIAG_TMOT "Tmot-Schwelle" VALUE 0x74FA2 TKW_VV_VV_SW 100.0 FORMULA_0023 -50.0 170.0 FORMAT "%4.1" /end CHARACTERISTIC
/begin CHARACTERISTIC K_LLR_DIAG_TOEL "Toel-Schwelle" VALUE 0x74FA4 TKW_VV_VV_SW 100.0 FORMULA_0023 -50.0 170.0 FORMAT "%4.1" /end CHARACTERISTIC
/begin CHARACTERISTIC K_LLR_DMD_MAX_E2 "Rampe max. I-Anteil Ebene 2" VALUE 0x7B07B TKW_VV_VV_UB 100.0 FORMULA_0748 0.0 255.0 /end CHARACTERISTIC
/begin CHARACTERISTIC K_LLR_ERR_MAX_E2 "max. Fehler LLR Ebene 2" VALUE 0x7B07A TKW_VV_VV_UB 100.0 FORMULA_0003 0.0 255.0 /end CHARACTERISTIC
/begin CHARACTERISTIC K_LLR_IA_B1_ABR "Absteuerrampe B1" VALUE 0x74F82 TKW_VV_VV_UB 100.0 FORMULA_0748 0.0 255.0 /end CHARACTERISTIC
/begin CHARACTERISTIC K_LLR_IA_B2_ABR "Absteuerrampe B2" VALUE 0x74F83 TKW_VV_VV_UB 100.0 FORMULA_0748 0.0 255.0 /end CHARACTERISTIC
/begin CHARACTERISTIC K_LLR_MD_D_MAX "max. D-Anteil oKS" VALUE 0x74F94 TKW_VV_VV_SW 100.0 FORMULA_0009 -100.0 1000.0 FORMAT "%4.1" /end CHARACTERISTIC
/begin CHARACTERISTIC K_LLR_MD_D_MIN "min. D-Anteil" VALUE 0x74F92 TKW_VV_VV_SW 100.0 FORMULA_0009 -100.0 1000.0 FORMAT "%4.1" /end CHARACTERISTIC
/begin CHARACTERISTIC K_LLR_MD_MAX_E2 "max. I-Anteil Ebene 2" VALUE 0x7B07E TKW_VV_VV_SW 100.0 FORMULA_0009 0.0 1000.0 FORMAT "%4.1" /end CHARACTERISTIC
/begin CHARACTERISTIC K_LLR_MD_MIN_E2 "min. I-Anteil Ebene 2" VALUE 0x7B07C TKW_VV_VV_SW 100.0 FORMULA_0009 -150.0 0.0 FORMAT "%4.1" /end CHARACTERISTIC
/begin CHARACTERISTIC K_LLR_MD_MKS_MAX "max. I-Anteil mKS" VALUE 0x74F8A TKW_VV_VV_SW 100.0 FORMULA_0009 0.0 150.0 FORMAT "%4.1" /end CHARACTERISTIC
/begin CHARACTERISTIC K_LLR_MD_MKS_MIN "min. I-Anteil mKS" VALUE 0x74F88 TKW_VV_VV_SW 100.0 FORMULA_0009 -150.0 0.0 FORMAT "%4.1" /end CHARACTERISTIC
/begin CHARACTERISTIC K_LLR_MD_OKS_MAX "max. I-Anteil oKS" VALUE 0x74F86 TKW_VV_VV_SW 100.0 FORMULA_0009 0.0 150.0 FORMAT "%4.1" /end CHARACTERISTIC
/begin CHARACTERISTIC K_LLR_MD_OKS_MIN "min. I-Anteil oKS" VALUE 0x74F84 TKW_VV_VV_SW 100.0 FORMULA_0009 -150.0 0.0 FORMAT "%4.1" /end CHARACTERISTIC
/begin CHARACTERISTIC K_LLR_MD_RES_AUFR "Rampe fuer Reserve" VALUE 0x74F99 TKW_VV_VV_UB 100.0 FORMULA_0748 0.0 255.0 /end CHARACTERISTIC
/begin CHARACTERISTIC K_LLR_MD_RES_WAIT "Wartezeit fuer Reserve" VALUE 0x74F9A TKW_VV_VV_UW 100.0 FORMULA_0021 0.0 655.0 FORMAT "%5.2" /end CHARACTERISTIC
/begin CHARACTERISTIC K_LLR_MD_TZ_RUECK_HYS "Hysterese TZ-Rueckfuehrung" VALUE 0x74F9D TKW_VV_VV_UB 100.0 FORMULA_0749 0.1000000014901161 20.0 /end CHARACTERISTIC
/begin CHARACTERISTIC K_LLR_MD_TZ_RUECK_NEG "Negative TZ-Rueckfuehrung" VALUE 0x74FA0 TKW_VV_VV_SW 100.0 FORMULA_0750 0.0 15.0 FORMAT "%7.4" /end CHARACTERISTIC
/begin CHARACTERISTIC K_LLR_MD_TZ_RUECK_POS "Positive TZ-Rueckfuehrung" VALUE 0x74F9E TKW_VV_VV_SW 100.0 FORMULA_0750 0.0 15.0 FORMAT "%7.4" /end CHARACTERISTIC
/begin CHARACTERISTIC K_LLR_MD_TZ_TAU "Filter LLR TZ-Eingriff" VALUE 0x74F9C TKW_VV_VV_UB 100.0 FORMULA_0746 0.1004000008106232 25.60000038146973 /end CHARACTERISTIC
/begin CHARACTERISTIC K_LLR_N_DIFF_MAX_E2 "Schwelle Max-Rampe Ebene 2" VALUE 0x7B080 TKW_VV_VV_SW 100.0 FORMULA_0006 -5000.0 5000.0 /end CHARACTERISTIC
/begin CHARACTERISTIC K_LLR_N_EINGEREGELT "Schwelle fuer n eingeregelt" VALUE 0x74F6A TKW_VV_VV_UB 100.0 FORMULA_0745 0.0 100.0 /end CHARACTERISTIC
/begin CHARACTERISTIC K_LLR_N_KATH_ABR "Kath-Abregelrampe" VALUE 0x74F74 TKW_VV_VV_UW 100.0 FORMULA_0747 0.0 655350.0 /end CHARACTERISTIC
/begin CHARACTERISTIC K_LLR_N_KATH_AUFR "Kath-Aufregelrampe" VALUE 0x74F72 TKW_VV_VV_UW 100.0 FORMULA_0747 0.0 655350.0 /end CHARACTERISTIC
/begin CHARACTERISTIC K_LLR_N_KATH_HYS "n-Sollsprung ohne Rampe beim KH" VALUE 0x74F96 TKW_VV_VV_SW 100.0 FORMULA_0006 0.0 10000.0 /end CHARACTERISTIC
/begin CHARACTERISTIC K_LLR_N_OFFSET_B1 "Offset fuer Start IA_B1" VALUE 0x74F6C TKW_VV_VV_SW 100.0 FORMULA_0006 0.0 10000.0 /end CHARACTERISTIC
/begin CHARACTERISTIC K_LLR_N_OFFSET_B2 "Offset fuer Start IA_B2" VALUE 0x74F6E TKW_VV_VV_SW 100.0 FORMULA_0006 0.0 10000.0 /end CHARACTERISTIC
/begin CHARACTERISTIC K_LLR_N_RESET "Resetschwelle" VALUE 0x74F90 TKW_VV_VV_SW 100.0 FORMULA_0006 0.0 10000.0 /end CHARACTERISTIC
/begin CHARACTERISTIC K_LLR_N_SOLL_AC_OFFSET "Offset durch Klima" VALUE 0x74F76 TKW_VV_VV_SW 100.0 FORMULA_0006 0.0 10000.0 /end CHARACTERISTIC
/begin CHARACTERISTIC K_LLR_N_SOLL_MAX "max. Solldrehzahl" VALUE 0x74F7C TKW_VV_VV_SW 100.0 FORMULA_0006 0.0 10000.0 /end CHARACTERISTIC
/begin CHARACTERISTIC K_LLR_N_SOLL_MIN "min. Solldrehzahl" VALUE 0x74F7A TKW_VV_VV_SW 100.0 FORMULA_0006 0.0 10000.0 /end CHARACTERISTIC
/begin CHARACTERISTIC K_LLR_N_SOLL_NF_FAKTOR "Faktor Nachführsolldrehzahl" VALUE 0x74F7E TKW_VV_VV_UW 100.0 FORMULA_0073 0.0 4.0 FORMAT "%6.3" /end CHARACTERISTIC
/begin CHARACTERISTIC K_LLR_N_SOLL_NF_FAKTOR_E2 "Faktor Nachführsolldrehzahl Ebene 2" VALUE 0x7B082 TKW_VV_VV_UW 100.0 FORMULA_0073 0.0 4.0 FORMAT "%6.3" /end CHARACTERISTIC
/begin CHARACTERISTIC K_LLR_N_SOLL_NF_MAX "max. Nachführsolldrehzahl" VALUE 0x74F80 TKW_VV_VV_SW 100.0 FORMULA_0006 0.0 10000.0 /end CHARACTERISTIC
/begin CHARACTERISTIC K_LLR_N_SOLL_NF_MAX_E2 "max. Nachführsolldrehzahl Ebene 2" VALUE 0x7B084 TKW_VV_VV_SW 100.0 FORMULA_0006 0.0 10000.0 /end CHARACTERISTIC
/begin CHARACTERISTIC K_LLR_N_SOLL_TAU "Filter Solldrehzahl" VALUE 0x74F6B TKW_VV_VV_UB 100.0 FORMULA_0746 0.1004000008106232 25.60000038146973 /end CHARACTERISTIC
/begin CHARACTERISTIC K_LLR_N_SOLL_ZH_OFFSET "Offset durch Zusatzheizung" VALUE 0x74F78 TKW_VV_VV_SW 100.0 FORMULA_0006 0.0 10000.0 /end CHARACTERISTIC
/begin CHARACTERISTIC K_LLR_OMEGA_TAU "Omega-Tau" VALUE 0x74F98 TKW_VV_VV_UB 100.0 FORMULA_0470 5.100000184029341e-003 1.279999971389771 /end CHARACTERISTIC
/begin CHARACTERISTIC K_LLR_PWG_ANFAHR "PWG-Schwelle" VALUE 0x74F70 TKW_VV_VV_SW 100.0 FORMULA_0001 -10.0 120.0 FORMAT "%4.1" /end CHARACTERISTIC
/begin CHARACTERISTIC K_LU_WIN_LEN_B1 "Messfensterlaenge" VALUE 0x7552A TKW_VV_VV_UB 100.0 FORMULA_0756 1.0 59.0 /end CHARACTERISTIC
/begin CHARACTERISTIC K_LU_WIN_LEN_B2 "Messfensterlaenge" VALUE 0x7552B TKW_VV_VV_UB 100.0 FORMULA_0756 1.0 59.0 /end CHARACTERISTIC
/begin CHARACTERISTIC K_LU_WIN_PERIOD_B1 "Zykluswiederholung Messfenster." VALUE 0x7552C TKW_VV_VV_UB 100.0 FORMULA_0756 1.0 59.0 /end CHARACTERISTIC
/begin CHARACTERISTIC K_LU_WIN_PERIOD_B2 "Zykluswiederholung Messfenster." VALUE 0x7552D TKW_VV_VV_UB 100.0 FORMULA_0756 1.0 59.0 /end CHARACTERISTIC
/begin CHARACTERISTIC K_LU_WIN_START_B1 "Start Messfenster." VALUE 0x75528 TKW_VV_VV_UB 100.0 FORMULA_0756 0.0 34.0 /end CHARACTERISTIC
/begin CHARACTERISTIC K_LU_WIN_START_B2 "Start Messfenster." VALUE 0x75529 TKW_VV_VV_UB 100.0 FORMULA_0756 0.0 34.0 /end CHARACTERISTIC
/begin CHARACTERISTIC K_MD_CFG_FGR_EINGR "Cfg fuer Index" VALUE 0x770FA TKW_VV_VV_UB 100.0 FORMULA_0792 0.0 255.0 /end CHARACTERISTIC
/begin CHARACTERISTIC K_MD_CFG_IDX "Cfg fuer Index" VALUE 0x770F9 TKW_VV_VV_UB 100.0 FORMULA_0791 0.0 255.0 /end CHARACTERISTIC
/begin CHARACTERISTIC K_MD_ETA_GETR "Getriebewirkungsgrad" VALUE 0x770FC TKW_VV_VV_UW 100.0 FORMULA_0437 0.0 150.0 FORMAT "%4.1" /end CHARACTERISTIC
/begin CHARACTERISTIC K_MD_KUS_BEGR_TAU_AUS "Zeitkonstante weiches Aufsteuern ein" VALUE 0x775CB TKW_VV_VV_UB 100.0 FORMULA_0470 5.100000184029341e-003 1.279999971389771 /end CHARACTERISTIC
/begin CHARACTERISTIC K_MD_KUS_BEGR_TAU_EIN "Zeitkonstante weiches Aufsteuern ein" VALUE 0x775CA TKW_VV_VV_UB 100.0 FORMULA_0470 5.100000184029341e-003 1.279999971389771 /end CHARACTERISTIC
/begin CHARACTERISTIC K_MD_KUS_BEGR_TAU1_AUS "Zeitkonstante weiches Aufsteuern ein" VALUE 0x775C9 TKW_VV_VV_UB 100.0 FORMULA_0470 5.100000184029341e-003 1.279999971389771 /end CHARACTERISTIC
/begin CHARACTERISTIC K_MD_KUS_BEGR_TAU1_EIN "Zeitkonstante weiches Aufsteuern ein" VALUE 0x775C8 TKW_VV_VV_UB 100.0 FORMULA_0470 5.100000184029341e-003 1.279999971389771 /end CHARACTERISTIC
/begin CHARACTERISTIC K_MD_KUS_PID_A1 "Koeffizient a1, PID-Regler" VALUE 0x775C6 TKW_VV_VV_SW 100.0 FORMULA_0488 -10.0 10.0 FORMAT "%5.2" /end CHARACTERISTIC
/begin CHARACTERISTIC K_MD_N_ABTRIEB_MIN "min. Abtriebsdrehzahl" VALUE 0x77102 TKW_VV_VV_SW 100.0 FORMULA_0006 0.0 10000.0 /end CHARACTERISTIC
/begin CHARACTERISTIC K_MD_N_PEMAX "Drehzahl fuer PeMax" VALUE 0x770FE TKW_VV_VV_SW 100.0 FORMULA_0006 0.0 10000.0 /end CHARACTERISTIC
/begin CHARACTERISTIC K_MD_N_PVMAX "Drehzahl fuer PvMax" VALUE 0x77100 TKW_VV_VV_SW 100.0 FORMULA_0006 0.0 10000.0 /end CHARACTERISTIC
/begin CHARACTERISTIC K_MD_RAD_STEIGUNG_TAU "Tau Steigung" VALUE 0x770F8 TKW_VV_VV_UB 100.0 FORMULA_0470 5.100000184029341e-003 1.279999971389771 /end CHARACTERISTIC
/begin CHARACTERISTIC K_N_LW_A_NOFFS_MAX "Maximale Begrenzung Auslassladungswechseldrehzahloffset." VALUE 0x78342 TKW_VV_VV_SW 100.0 FORMULA_0006 -10000.0 10000.0 /end CHARACTERISTIC
/begin CHARACTERISTIC K_N_LW_A_NOFFS_MIN "Minimale Begrenzung Auslassladungswechseldrehzahloffset." VALUE 0x78344 TKW_VV_VV_SW 100.0 FORMULA_0006 -10000.0 10000.0 /end CHARACTERISTIC
/begin CHARACTERISTIC K_N_LW_CFG "Auswahlt Quelle Einlasstemperatur." VALUE 0x7833C TKW_VV_VV_UB 100.0 FORMULA_0817 0.0 255.0 /end CHARACTERISTIC
/begin CHARACTERISTIC K_N_LW_E_NOFFS_MAX "Maximale Begrenzung Einlassladungswechseldrehzahloffset." VALUE 0x7833E TKW_VV_VV_SW 100.0 FORMULA_0006 -10000.0 10000.0 /end CHARACTERISTIC
/begin CHARACTERISTIC K_N_LW_E_NOFFS_MIN "Minimale Begrenzung Einlassladungswechseldrehzahloffset." VALUE 0x78340 TKW_VV_VV_SW 100.0 FORMULA_0006 -10000.0 10000.0 /end CHARACTERISTIC
/begin CHARACTERISTIC K_N_LW_NOFFS_MAX "Maximale Begrenzung Ladungswechseldrehzahloffset." VALUE 0x78346 TKW_VV_VV_SW 100.0 FORMULA_0006 -10000.0 10000.0 /end CHARACTERISTIC
/begin CHARACTERISTIC K_N_LW_NOFFS_MIN "Minimale Begrenzung Ladungswechseldrehzahloffset." VALUE 0x78348 TKW_VV_VV_SW 100.0 FORMULA_0006 -10000.0 10000.0 /end CHARACTERISTIC
/begin CHARACTERISTIC K_TKA_DIAG_MAX "Obere Grenze Kuehlwasseraustrittstemperatur" VALUE 0x7A2D6 TKW_VV_VV_SW 100.0 FORMULA_0975 -50.0 170.0 FORMAT "%6.3" /end CHARACTERISTIC
/begin CHARACTERISTIC K_TKA_DIAG_MIN "Unter Grenze Kuehlwasseraustrittstemperatur" VALUE 0x7A2D4 TKW_VV_VV_SW 100.0 FORMULA_0975 -50.0 170.0 FORMAT "%6.3" /end CHARACTERISTIC
/begin CHARACTERISTIC K_TKA_OBD_DELTA_HIGH "Maximale Ueberhoehung von tka gegenueber tmot" VALUE 0x7A2DA TKW_VV_VV_SW 100.0 FORMULA_0074 -1000.0 1000.0 FORMAT "%4.1" /end CHARACTERISTIC
/begin CHARACTERISTIC K_TKA_OBD_DELTA_NORM "Erwartete Temperaturerhoehung von tka" VALUE 0x7A2DC TKW_VV_VV_SW 100.0 FORMULA_0074 -1000.0 1000.0 FORMAT "%4.1" /end CHARACTERISTIC
/begin CHARACTERISTIC K_TKA_OBD_TMOT_MIN "Temperaturschwelle fuer TKA-Diagnose" VALUE 0x7A2DE TKW_VV_VV_SW 100.0 FORMULA_0023 -50.0 170.0 FORMAT "%4.1" /end CHARACTERISTIC
/begin CHARACTERISTIC K_TKA_TAU "Filterkonstante fuer die Kuehlwasseraustrittstemperatur" VALUE 0x7A2D8 TKW_VV_VV_UB 100.0 FORMULA_0746 0.1004000008106232 25.60000038146973 /end CHARACTERISTIC
/begin CHARACTERISTIC K_VR_DIAG_MAX_OFFSET "Maximal zul. Diagnoseoffset der M-Spule." VALUE 0x7AEA0 TKW_VV_VV_SW 100.0 FORMULA_0442 0.0 3.299999952316284 FORMAT "%5.2" /end CHARACTERISTIC
/begin CHARACTERISTIC K_VR_HYST "Hysterese fuer Schaltschwelle." VALUE 0x7AEA6 TKW_VV_VV_SW 100.0 FORMULA_0569 0.0 100.0 FORMAT "%5.2" /end CHARACTERISTIC
/begin CHARACTERISTIC K_VR_LP_COEF "Tief-Pass Filter zur Maximalwertbestimmung." VAL_BLK 0x7AEAC TKW_VV_VV_SF 100.0 FORMULA_0570 -3.402823466385289e+038 3.402823466385289e+038 FORMAT "%7.4" NUMBER 20 /end CHARACTERISTIC
/begin CHARACTERISTIC K_VR_MESS_ED "Messverstaerkung im Fehlerfall." VALUE 0x7AEA2 TKW_VV_VV_SW 100.0 FORMULA_0447 0.0 32.0 FORMAT "%6.3" /end CHARACTERISTIC
/begin CHARACTERISTIC K_VR_SET_INI "Initialwert aller Verstaerkungsstufen." VALUE 0x7AE9C TKW_VV_VV_UB 100.0 FORMULA_1045 0.0 8.0 /end CHARACTERISTIC
/begin CHARACTERISTIC K_VR_SET_MAX "Initialwert aller Verstaerkungsstufen." VALUE 0x7AE9E TKW_VV_VV_UB 100.0 FORMULA_1045 0.0 8.0 /end CHARACTERISTIC
/begin CHARACTERISTIC K_VR_SET_MIN "Initialwert aller Verstaerkungsstufen." VALUE 0x7AE9D TKW_VV_VV_UB 100.0 FORMULA_1045 0.0 8.0 /end CHARACTERISTIC
/begin CHARACTERISTIC K_VR_SOLL "Sollaussteuerung." VALUE 0x7AEA4 TKW_VV_VV_SW 100.0 FORMULA_0569 0.0 100.0 FORMAT "%5.2" /end CHARACTERISTIC
/begin CHARACTERISTIC K_VR_TEST_DIAG "Test Diagnose M-Spule." VALUE 0x7AE9B TKW_VV_VV_UB 100.0 FORMULA_1049 0.0 255.0 /end CHARACTERISTIC
/begin CHARACTERISTIC K_VR_TEST_SEND_ENABLE "Freigabe Testfunktion" VALUE 0x7AE98 TKW_VV_VV_UB 100.0 FORMULA_1047 0.0 255.0 /end CHARACTERISTIC
/begin CHARACTERISTIC K_VR_TEST_U_MESS "Test Spannungswahl." VALUE 0x7AE99 TKW_VV_VV_UB 100.0 FORMULA_1048 0.0 255.0 /end CHARACTERISTIC
/begin CHARACTERISTIC K_VR_TEST_V_MESS "Test Verstaerkungsstufe." VALUE 0x7AE9A TKW_VV_VV_UB 100.0 FORMULA_0003 0.0 7.0 /end CHARACTERISTIC
/begin CHARACTERISTIC K_VR_VORST_MAX "Maximale Verstaerkung der Vorsteuerung." VALUE 0x7AEAA TKW_VV_VV_SW 100.0 FORMULA_0447 0.0 32.0 FORMAT "%6.3" /end CHARACTERISTIC
/begin CHARACTERISTIC K_VR_VORST_MIN "Minimale Verstaerkung der Vorsteuerung." VALUE 0x7AEA8 TKW_VV_VV_SW 100.0 FORMULA_0447 0.0 32.0 FORMAT "%6.3" /end CHARACTERISTIC
/begin CHARACTERISTIC KF_KA_F "Gewichtungsfaktor" MAP 0x738D2 TKF_SW_SW_UW 100.0 FORMULA_0073 0.0 63.99900054931641 FORMAT "%6.3" /begin AXIS_DESCR STD_AXIS n FORMULA_0006 18 0.0 10000.0 MAX_GRAD 0.0 /end AXIS_DESCR
 /begin AXIS_DESCR STD_AXIS rf_m FORMULA_0007 12 0.0 2.0 MAX_GRAD 0.0 FORMAT "%6.3" /end AXIS_DESCR
/end CHARACTERISTIC
/begin CHARACTERISTIC KF_KA_F_K "Korrekturwert vom Gewichtungsfaktor." MAP 0x73830 TKF_SW_SW_UW 100.0 FORMULA_0073 0.0 63.99900054931641 FORMAT "%6.3" /begin AXIS_DESCR STD_AXIS n FORMULA_0006 8 0.0 10000.0 MAX_GRAD 0.0 /end AXIS_DESCR
 /begin AXIS_DESCR STD_AXIS dtz FORMULA_0102 8 -3276.800048828125 3276.699951171875 MAX_GRAD 0.0 FORMAT "%4.1" /end AXIS_DESCR
/end CHARACTERISTIC
/begin CHARACTERISTIC KF_KA_OFFS "Abstand Klopfgrenze" MAP 0x73AC0 TKF_SW_SW_SW 100.0 FORMULA_0102 -50.0 60.0 FORMAT "%4.1" /begin AXIS_DESCR STD_AXIS n FORMULA_0006 18 0.0 10000.0 MAX_GRAD 0.0 /end AXIS_DESCR
 /begin AXIS_DESCR STD_AXIS rf_m FORMULA_0007 12 0.0 2.0 MAX_GRAD 0.0 FORMAT "%6.3" /end AXIS_DESCR
/end CHARACTERISTIC
/begin CHARACTERISTIC KF_KA_OFFS_VL "Abstand Klopfgrenze" MAP 0x7368E TKF_SW_SW_SW 100.0 FORMULA_0102 -50.0 60.0 FORMAT "%4.1" /begin AXIS_DESCR STD_AXIS n FORMULA_0006 18 0.0 10000.0 MAX_GRAD 0.0 /end AXIS_DESCR /begin AXIS_DESCR STD_AXIS Zyl FORMULA_0010 10 1.0 10.0 MAX_GRAD 0.0 /end AXIS_DESCR /end CHARACTERISTIC
/begin CHARACTERISTIC KF_KA_T_KOMP "Temperaturkompensation Klopfadaption" MAP 0x73CAE TKF_SW_SW_SW 100.0 FORMULA_0102 -50.0 60.0 FORMAT "%4.1"
 /begin AXIS_DESCR STD_AXIS tmot FORMULA_0023 6 -50.0 170.0 MAX_GRAD 0.0 FORMAT "%4.1" /end AXIS_DESCR
 /begin AXIS_DESCR STD_AXIS tan FORMULA_0023 6 -50.0 170.0 MAX_GRAD 0.0 FORMAT "%4.1" /end AXIS_DESCR
/end CHARACTERISTIC
/begin CHARACTERISTIC KF_KH_MD_ETA_F_LLMKS "Faktor-KF fuer ETA" MAP 0x74302 TKF_SW_SW_UW 100.0 FORMULA_0073 0.0 4.0 FORMAT "%6.3"
 /begin AXIS_DESCR STD_AXIS kh_tmot_start FORMULA_0023 8 -50.0 170.0 MAX_GRAD 0.0 FORMAT "%4.1" /end AXIS_DESCR
 /begin AXIS_DESCR STD_AXIS kh_time_on FORMULA_0109 8 0.0 325.0 MAX_GRAD 0.0 FORMAT "%5.2" /end AXIS_DESCR
/end CHARACTERISTIC
/begin CHARACTERISTIC KF_KH_MD_ETA_F_LLMKS_SL "Faktor-KF fuer ETA" MAP 0x74260 TKF_SW_SW_UW 100.0 FORMULA_0073 0.0 4.0 FORMAT "%6.3"
 /begin AXIS_DESCR STD_AXIS kh_tmot_start FORMULA_0023 8 -50.0 170.0 MAX_GRAD 0.0 FORMAT "%4.1" /end AXIS_DESCR
 /begin AXIS_DESCR STD_AXIS kh_time_on FORMULA_0109 8 0.0 325.0 MAX_GRAD 0.0 FORMAT "%5.2" /end AXIS_DESCR
/end CHARACTERISTIC
/begin CHARACTERISTIC KF_KH_MD_ETA_F_LLOKS "Faktor-KF fuer ETA" MAP 0x74446 TKF_SW_SW_UW 100.0 FORMULA_0073 0.0 4.0 FORMAT "%6.3"
 /begin AXIS_DESCR STD_AXIS kh_tmot_start FORMULA_0023 8 -50.0 170.0 MAX_GRAD 0.0 FORMAT "%4.1" /end AXIS_DESCR
 /begin AXIS_DESCR STD_AXIS kh_time_on FORMULA_0109 8 0.0 325.0 MAX_GRAD 0.0 FORMAT "%5.2" /end AXIS_DESCR
/end CHARACTERISTIC
/begin CHARACTERISTIC KF_KH_MD_ETA_F_LLOKS_SL "Faktor-KF fuer ETA" MAP 0x743A4 TKF_SW_SW_UW 100.0 FORMULA_0073 0.0 4.0 FORMAT "%6.3"
 /begin AXIS_DESCR STD_AXIS kh_tmot_start FORMULA_0023 8 -50.0 170.0 MAX_GRAD 0.0 FORMAT "%4.1" /end AXIS_DESCR
 /begin AXIS_DESCR STD_AXIS kh_time_on FORMULA_0109 8 0.0 325.0 MAX_GRAD 0.0 FORMAT "%5.2" /end AXIS_DESCR
/end CHARACTERISTIC
/begin CHARACTERISTIC KF_KH_MD_ETA_F_SB "Faktor-KF fuer ETA" MAP 0x7458A TKF_SW_SW_UW 100.0 FORMULA_0073 0.0 4.0 FORMAT "%6.3"
 /begin AXIS_DESCR STD_AXIS kh_tmot_start FORMULA_0023 8 -50.0 170.0 MAX_GRAD 0.0 FORMAT "%4.1" /end AXIS_DESCR
 /begin AXIS_DESCR STD_AXIS kh_time_on FORMULA_0109 8 0.0 325.0 MAX_GRAD 0.0 FORMAT "%5.2" /end AXIS_DESCR
/end CHARACTERISTIC
/begin CHARACTERISTIC KF_KH_MD_ETA_F_SB_SL "Faktor-KF fuer ETA" MAP 0x744E8 TKF_SW_SW_UW 100.0 FORMULA_0073 0.0 4.0 FORMAT "%6.3"
 /begin AXIS_DESCR STD_AXIS kh_tmot_start FORMULA_0023 8 -50.0 170.0 MAX_GRAD 0.0 FORMAT "%4.1" /end AXIS_DESCR
 /begin AXIS_DESCR STD_AXIS kh_time_on FORMULA_0109 8 0.0 325.0 MAX_GRAD 0.0 FORMAT "%5.2" /end AXIS_DESCR
/end CHARACTERISTIC
/begin CHARACTERISTIC KF_KH_MD_ETA_F_TL "Faktor-KF fuer ETA" MAP 0x741BE TKF_SW_SW_UW 100.0 FORMULA_0073 0.0 4.0 FORMAT "%6.3"
 /begin AXIS_DESCR STD_AXIS kh_tmot_start FORMULA_0023 8 -50.0 170.0 MAX_GRAD 0.0 FORMAT "%4.1" /end AXIS_DESCR
 /begin AXIS_DESCR STD_AXIS kh_time_on FORMULA_0109 8 0.0 325.0 MAX_GRAD 0.0 FORMAT "%5.2" /end AXIS_DESCR
/end CHARACTERISTIC
/begin CHARACTERISTIC KF_KH_MD_ETA_F_TL_SL "Faktor-KF fuer ETA" MAP 0x7411C TKF_SW_SW_UW 100.0 FORMULA_0073 0.0 4.0 FORMAT "%6.3"
 /begin AXIS_DESCR STD_AXIS kh_tmot_start FORMULA_0023 8 -50.0 170.0 MAX_GRAD 0.0 FORMAT "%4.1" /end AXIS_DESCR
 /begin AXIS_DESCR STD_AXIS kh_time_on FORMULA_0109 8 0.0 325.0 MAX_GRAD 0.0 FORMAT "%5.2" /end AXIS_DESCR
/end CHARACTERISTIC
/begin CHARACTERISTIC KF_KH_MD_ETA_GRUND "ETA Grund-KF fuer Katheizen" MAP 0x7462C TKF_SW_SW_UW 100.0 FORMULA_0437 0.0 100.0 FORMAT "%4.1" /begin AXIS_DESCR STD_AXIS n FORMULA_0006 10 0.0 10000.0 MAX_GRAD 0.0 /end AXIS_DESCR
 /begin AXIS_DESCR STD_AXIS md_ind_wunsch_tz FORMULA_0009 10 -100.0 1000.0 MAX_GRAD 0.0 FORMAT "%4.1" /end AXIS_DESCR
/end CHARACTERISTIC
/begin CHARACTERISTIC KF_KH_MD_ETA_GRUND_SL "ETA Grund-KF fuer Katheizen" MAP 0x7471E TKF_SW_SW_UW 100.0 FORMULA_0437 0.0 100.0 FORMAT "%4.1" /begin AXIS_DESCR STD_AXIS n FORMULA_0006 10 0.0 10000.0 MAX_GRAD 0.0 /end AXIS_DESCR
 /begin AXIS_DESCR STD_AXIS md_ind_wunsch_tz FORMULA_0009 10 -100.0 1000.0 MAX_GRAD 0.0 FORMAT "%4.1" /end AXIS_DESCR
/end CHARACTERISTIC
/begin CHARACTERISTIC KF_KH_TZ_ETA_GRUND_SL "ETA Grund-KF fuer Katheizen mit SL" MAP 0x7402A TKF_SW_SW_UW 100.0 FORMULA_0437 0.0 100.0 FORMAT "%4.1" /begin AXIS_DESCR STD_AXIS n FORMULA_0006 10 0.0 10000.0 MAX_GRAD 0.0 /end AXIS_DESCR
 /begin AXIS_DESCR STD_AXIS md_ind_wunsch_tz FORMULA_0009 10 -100.0 1000.0 MAX_GRAD 0.0 FORMAT "%4.1" /end AXIS_DESCR
/end CHARACTERISTIC
/begin CHARACTERISTIC KF_KH_TZ_GRUND "Grundkennfeld Zuendwinkel fuer KH" MAP 0x73F0C TKF_SW_SW_SW 100.0 FORMULA_0102 -50.0 60.0 FORMAT "%4.1" /begin AXIS_DESCR STD_AXIS n FORMULA_0006 12 0.0 10000.0 MAX_GRAD 0.0 /end AXIS_DESCR
 /begin AXIS_DESCR STD_AXIS rf FORMULA_0007 10 0.0 2.0 MAX_GRAD 0.0 FORMAT "%6.3" /end AXIS_DESCR
/end CHARACTERISTIC
/begin CHARACTERISTIC KF_KUS_N_MIN "untere Begrenzung maximale Motordrehzahl" MAP 0x74ED2 TKF_SW_SW_SW 100.0 FORMULA_0006 0.0 10000.0
 /begin AXIS_DESCR STD_AXIS Timer FORMULA_0109 4 0.0 160.0 MAX_GRAD 0.0 FORMAT "%5.2" /end AXIS_DESCR
 /begin AXIS_DESCR STD_AXIS n FORMULA_0006 4 -10000.0 10000.0 MAX_GRAD 0.0 /end AXIS_DESCR
/end CHARACTERISTIC
/begin CHARACTERISTIC KF_LAZ_TAU "Tau fuer LAZ" MAP 0x74F06 TKF_SW_SW_UB 100.0 FORMULA_0470 5.100000184029341e-003 1.279999971389771 /begin AXIS_DESCR STD_AXIS n FORMULA_0006 8 0.0 10000.0 MAX_GRAD 0.0 /end AXIS_DESCR
 /begin AXIS_DESCR STD_AXIS laz_md_rf_soll_pt_roh_del FORMULA_0007 8 0.0 2.0 MAX_GRAD 0.0 FORMAT "%6.3" /end AXIS_DESCR
/end CHARACTERISTIC
/begin CHARACTERISTIC KF_LLR_MD_I_NEG_MKS "I-Anteil bei neg. Abweichung" MAP 0x753B2 TKF_SW_SW_SW 100.0 FORMULA_0751 -50.0 50.0 FORMAT "%4.1"
 /begin AXIS_DESCR STD_AXIS llr_n_diff FORMULA_0006 8 -5000.0 0.0 MAX_GRAD 0.0 /end AXIS_DESCR
 /begin AXIS_DESCR STD_AXIS n_grad_asp FORMULA_0105 12 -10000.0 10000.0 MAX_GRAD 0.0 /end AXIS_DESCR
/end CHARACTERISTIC
/begin CHARACTERISTIC KF_LLR_MD_I_NEG_OKS "I-Anteil bei neg. Abweichung" MAP 0x751DE TKF_SW_SW_SW 100.0 FORMULA_0751 -50.0 50.0 FORMAT "%4.1"
 /begin AXIS_DESCR STD_AXIS llr_n_diff FORMULA_0006 8 -5000.0 0.0 MAX_GRAD 0.0 /end AXIS_DESCR
 /begin AXIS_DESCR STD_AXIS n_grad_asp FORMULA_0105 12 -10000.0 10000.0 MAX_GRAD 0.0 /end AXIS_DESCR
/end CHARACTERISTIC
/begin CHARACTERISTIC KF_LLR_MD_I_POS_MKS "I-Anteil bei pos. Abweichung" MAP 0x752C8 TKF_SW_SW_SW 100.0 FORMULA_0751 -50.0 50.0 FORMAT "%4.1" /begin AXIS_DESCR STD_AXIS llr_n_diff FORMULA_0006 8 0.0 5000.0 MAX_GRAD 0.0 /end AXIS_DESCR
 /begin AXIS_DESCR STD_AXIS n_grad_asp FORMULA_0105 12 -10000.0 10000.0 MAX_GRAD 0.0 /end AXIS_DESCR
/end CHARACTERISTIC
/begin CHARACTERISTIC KF_LLR_MD_I_POS_OKS "I-Anteil bei pos. Abweichung" MAP 0x750F4 TKF_SW_SW_SW 100.0 FORMULA_0751 -50.0 50.0 FORMAT "%4.1" /begin AXIS_DESCR STD_AXIS llr_n_diff FORMULA_0006 8 0.0 5000.0 MAX_GRAD 0.0 /end AXIS_DESCR
 /begin AXIS_DESCR STD_AXIS n_grad_asp FORMULA_0105 12 -10000.0 10000.0 MAX_GRAD 0.0 /end AXIS_DESCR
/end CHARACTERISTIC
/begin CHARACTERISTIC KF_MD_KUS_KR "Regelparameter KR" MAP 0x7762C TKF_SW_SW_SW 100.0 FORMULA_0796 0.0 2.0 FORMAT "%5.2"
 /begin AXIS_DESCR STD_AXIS Gang FORMULA_0073 7 -1.0 10.0 MAX_GRAD 0.0 FORMAT "%6.3" /end AXIS_DESCR
 /begin AXIS_DESCR STD_AXIS n FORMULA_0006 6 0.0 10000.0 MAX_GRAD 0.0 /end AXIS_DESCR
/end CHARACTERISTIC
/begin CHARACTERISTIC KF_MD_KUS_TN "Regelparameter TN" MAP 0x7769C TKF_SW_SW_SW 100.0 FORMULA_0490 3.000000026077032e-003 30.0 FORMAT "%6.3"
 /begin AXIS_DESCR STD_AXIS Gang FORMULA_0073 7 -1.0 10.0 MAX_GRAD 0.0 FORMAT "%6.3" /end AXIS_DESCR
 /begin AXIS_DESCR STD_AXIS n FORMULA_0006 6 0.0 10000.0 MAX_GRAD 0.0 /end AXIS_DESCR
/end CHARACTERISTIC
/begin CHARACTERISTIC KF_MD_KUS_TV "Regelparameter TV" MAP 0x7770C TKF_SW_SW_SW 100.0 FORMULA_0490 0.0 20.0 FORMAT "%6.3"
 /begin AXIS_DESCR STD_AXIS Gang FORMULA_0073 7 -1.0 10.0 MAX_GRAD 0.0 FORMAT "%6.3" /end AXIS_DESCR
 /begin AXIS_DESCR STD_AXIS n FORMULA_0006 6 0.0 10000.0 MAX_GRAD 0.0 /end AXIS_DESCR
/end CHARACTERISTIC
/begin CHARACTERISTIC KF_MD_WUNSCH_REL_KOMFORT "Abtriebswunschmoment - Komfort" MAP 0x7726C TKF_SW_SW_SW 100.0 FORMULA_0001 -10.0 200.0 FORMAT "%4.1"
 /begin AXIS_DESCR STD_AXIS v_vorne FORMULA_0076 12 -80.0 360.0 MAX_GRAD 0.0 FORMAT "%4.1" /end AXIS_DESCR
 /begin AXIS_DESCR STD_AXIS md_ipm_pwg_pos FORMULA_0001 10 -10.0 120.0 MAX_GRAD 0.0 FORMAT "%4.1" /end AXIS_DESCR
/end CHARACTERISTIC
/begin CHARACTERISTIC KF_MD_WUNSCH_REL_NORMAL "Abtriebswunschmoment - Normal" MAP 0x7738A TKF_SW_SW_SW 100.0 FORMULA_0001 -10.0 200.0 FORMAT "%4.1"
 /begin AXIS_DESCR STD_AXIS v_vorne FORMULA_0076 12 -80.0 360.0 MAX_GRAD 0.0 FORMAT "%4.1" /end AXIS_DESCR
 /begin AXIS_DESCR STD_AXIS md_ipm_pwg_pos FORMULA_0001 10 -10.0 120.0 MAX_GRAD 0.0 FORMAT "%4.1" /end AXIS_DESCR
/end CHARACTERISTIC
/begin CHARACTERISTIC KF_MD_WUNSCH_REL_SPORT "Abtriebswunschmoment - Sport" MAP 0x774A8 TKF_SW_SW_SW 100.0 FORMULA_0001 -10.0 200.0 FORMAT "%4.1"
 /begin AXIS_DESCR STD_AXIS v_vorne FORMULA_0076 12 -80.0 360.0 MAX_GRAD 0.0 FORMAT "%4.1" /end AXIS_DESCR
 /begin AXIS_DESCR STD_AXIS md_ipm_pwg_pos FORMULA_0001 10 -10.0 120.0 MAX_GRAD 0.0 FORMAT "%4.1" /end AXIS_DESCR
/end CHARACTERISTIC
/begin CHARACTERISTIC KL_E_FUNKTION "Approximation der E-Funktion" CURVE 0x754BC TKL_SF_VV_SF 100.0 FORMULA_0044 -3.402823466385289e+038 3.402823466385289e+038 FORMAT "%5.2"
 /begin AXIS_DESCR STD_AXIS NO_INPUT_QUANTITY FORMULA_0044 13 -3.402823466385289e+038 3.402823466385289e+038 MAX_GRAD 0.0 FORMAT "%5.2" /end AXIS_DESCR
/end CHARACTERISTIC
/begin CHARACTERISTIC KL_KA_F_VL "Gewichtungsfaktor" CURVE 0x735EC TKL_SW_VV_UW 100.0 FORMULA_0073 0.0 63.99900054931641 FORMAT "%6.3" /begin AXIS_DESCR STD_AXIS n FORMULA_0006 18 0.0 10000.0 MAX_GRAD 0.0 /end AXIS_DESCR /end CHARACTERISTIC
/begin CHARACTERISTIC KL_KA_PUMG_VL "Zuendwinkeloffset" CURVE 0x73636 TKL_SW_VV_SW 100.0 FORMULA_0102 -50.0 60.0 FORMAT "%4.1"
 /begin AXIS_DESCR STD_AXIS pumg FORMULA_0075 6 400.0 1200.0 MAX_GRAD 0.0 FORMAT "%4.1" /end AXIS_DESCR
/end CHARACTERISTIC
/begin CHARACTERISTIC KL_KA_RF_MIN "Lastschwelle KA" CURVE 0x73650 TKL_SW_VV_SW 100.0 FORMULA_0007 0.0 2.0 FORMAT "%6.3" /begin AXIS_DESCR STD_AXIS n FORMULA_0006 10 0.0 10000.0 MAX_GRAD 0.0 /end AXIS_DESCR /end CHARACTERISTIC
/begin CHARACTERISTIC KL_KH_ALT_OFFSET "Katalterungsoffset" CURVE 0x73D94 TKL_UW_VV_SW 100.0 FORMULA_0074 -1000.0 1000.0 FORMAT "%4.1"
 /begin AXIS_DESCR STD_AXIS kat_obd_wert_nv FORMULA_0025 7 0.0 3.999000072479248 MAX_GRAD 0.0 FORMAT "%6.3" /end AXIS_DESCR
/end CHARACTERISTIC
/begin CHARACTERISTIC KL_KH_MD_ETA_F_PUMG "Korrekturfaktor pumg" CURVE 0x73EDC TKL_SW_VV_UW 100.0 FORMULA_0073 0.0 4.0 FORMAT "%6.3"
 /begin AXIS_DESCR STD_AXIS pumg FORMULA_0075 5 400.0 1200.0 MAX_GRAD 0.0 FORMAT "%4.1" /end AXIS_DESCR
/end CHARACTERISTIC
/begin CHARACTERISTIC KL_KH_MD_ETA_GRAD_LLMKS "Gradient Aenderungsbegrenzung" CURVE 0x73E26 TKL_SW_VV_UW 100.0 FORMULA_0701 0.0 100.0 FORMAT "%6.3"
 /begin AXIS_DESCR STD_AXIS tmot FORMULA_0023 6 -50.0 170.0 MAX_GRAD 0.0 FORMAT "%4.1" /end AXIS_DESCR
/end CHARACTERISTIC
/begin CHARACTERISTIC KL_KH_MD_ETA_GRAD_LLMKS_SL "Gradient Aenderungsbegrenzung" CURVE 0x73E0C TKL_SW_VV_UW 100.0 FORMULA_0701 0.0 100.0 FORMAT "%6.3"
 /begin AXIS_DESCR STD_AXIS tmot FORMULA_0023 6 -50.0 170.0 MAX_GRAD 0.0 FORMAT "%4.1" /end AXIS_DESCR
/end CHARACTERISTIC
/begin CHARACTERISTIC KL_KH_MD_ETA_GRAD_LLOKS "Gradient Aenderungsbegrenzung" CURVE 0x73E5A TKL_SW_VV_UW 100.0 FORMULA_0701 0.0 100.0 FORMAT "%6.3"
 /begin AXIS_DESCR STD_AXIS tmot FORMULA_0023 6 -50.0 170.0 MAX_GRAD 0.0 FORMAT "%4.1" /end AXIS_DESCR
/end CHARACTERISTIC
/begin CHARACTERISTIC KL_KH_MD_ETA_GRAD_LLOKS_SL "Gradient Aenderungsbegrenzung" CURVE 0x73E40 TKL_SW_VV_UW 100.0 FORMULA_0701 0.0 100.0 FORMAT "%6.3"
 /begin AXIS_DESCR STD_AXIS tmot FORMULA_0023 6 -50.0 170.0 MAX_GRAD 0.0 FORMAT "%4.1" /end AXIS_DESCR
/end CHARACTERISTIC
/begin CHARACTERISTIC KL_KH_MD_ETA_GRAD_SB "Gradient Aenderungsbegrenzung" CURVE 0x73EC2 TKL_SW_VV_UW 100.0 FORMULA_0701 0.0 100.0 FORMAT "%6.3"
 /begin AXIS_DESCR STD_AXIS tmot FORMULA_0023 6 -50.0 170.0 MAX_GRAD 0.0 FORMAT "%4.1" /end AXIS_DESCR
/end CHARACTERISTIC
/begin CHARACTERISTIC KL_KH_MD_ETA_GRAD_SB_SL "Gradient Aenderungsbegrenzung" CURVE 0x73EA8 TKL_SW_VV_UW 100.0 FORMULA_0701 0.0 100.0 FORMAT "%6.3"
 /begin AXIS_DESCR STD_AXIS tmot FORMULA_0023 6 -50.0 170.0 MAX_GRAD 0.0 FORMAT "%4.1" /end AXIS_DESCR
/end CHARACTERISTIC
/begin CHARACTERISTIC KL_KH_MD_ETA_GRAD_TL "Gradient Aenderungsbegrenzung" CURVE 0x73E8E TKL_SW_VV_UW 100.0 FORMULA_0701 0.0 100.0 FORMAT "%6.3"
 /begin AXIS_DESCR STD_AXIS tmot FORMULA_0023 6 -50.0 170.0 MAX_GRAD 0.0 FORMAT "%4.1" /end AXIS_DESCR
/end CHARACTERISTIC
/begin CHARACTERISTIC KL_KH_MD_ETA_GRAD_TL_SL "Gradient Aenderungsbegrenzung" CURVE 0x73E74 TKL_SW_VV_UW 100.0 FORMULA_0701 0.0 100.0 FORMAT "%6.3"
 /begin AXIS_DESCR STD_AXIS tmot FORMULA_0023 6 -50.0 170.0 MAX_GRAD 0.0 FORMAT "%4.1" /end AXIS_DESCR
/end CHARACTERISTIC
/begin CHARACTERISTIC KL_KH_MD_ETA_START "Faktor-KL fuer ETA" CURVE 0x73DEA TKL_SW_VV_UW 100.0 FORMULA_0437 0.0 150.0 FORMAT "%4.1"
 /begin AXIS_DESCR STD_AXIS kh_tmot_start FORMULA_0023 8 -50.0 170.0 MAX_GRAD 0.0 FORMAT "%4.1" /end AXIS_DESCR
/end CHARACTERISTIC
/begin CHARACTERISTIC KL_KH_MD_ETA_START_SL "Faktor-KL fuer ETA" CURVE 0x73DC8 TKL_SW_VV_UW 100.0 FORMULA_0437 0.0 150.0 FORMAT "%4.1"
 /begin AXIS_DESCR STD_AXIS kh_tmot_start FORMULA_0023 8 -50.0 170.0 MAX_GRAD 0.0 FORMAT "%4.1" /end AXIS_DESCR
/end CHARACTERISTIC
/begin CHARACTERISTIC KL_KH_T_MAX "Maximale KH-Zeit" CURVE 0x73DB2 TKL_SW_VV_UW 100.0 FORMULA_0109 0.0 163.0 FORMAT "%5.2"
 /begin AXIS_DESCR STD_AXIS zust_tmot_start FORMULA_0023 5 -50.0 170.0 MAX_GRAD 0.0 FORMAT "%4.1" /end AXIS_DESCR
/end CHARACTERISTIC
/begin CHARACTERISTIC KL_KH_TKAT_ENDE "Temperaturschwelle fuer Katheizende" CURVE 0x73EF2 TKL_UW_VV_SW 100.0 FORMULA_0023 -50.0 1200.0 FORMAT "%4.1"
 /begin AXIS_DESCR STD_AXIS time_ms FORMULA_0706 6 0.0 1092.25 MAX_GRAD 0.0 FORMAT "%5.2" /end AXIS_DESCR
/end CHARACTERISTIC
/begin CHARACTERISTIC KL_KH_VAN_AUF_TMOT_A "Faktor zwischen KF_VAN_A und KF_VAN_KH_A" CURVE 0x73D68 TKL_SW_VV_SW 100.0 FORMULA_0704 164.0 9.999999776482582e-003 FORMAT "%5.2"
 /begin AXIS_DESCR STD_AXIS tmot FORMULA_0023 4 -50.0 170.0 MAX_GRAD 0.0 FORMAT "%4.1" /end AXIS_DESCR
/end CHARACTERISTIC
/begin CHARACTERISTIC KL_KH_VAN_AUF_TMOT_E "Faktor zwischen KF_VAN_E und KF_VAN_KH_E" CURVE 0x73D56 TKL_SW_VV_SW 100.0 FORMULA_0704 164.0 9.999999776482582e-003 FORMAT "%5.2"
 /begin AXIS_DESCR STD_AXIS tmot FORMULA_0023 4 -50.0 170.0 MAX_GRAD 0.0 FORMAT "%4.1" /end AXIS_DESCR
/end CHARACTERISTIC
/begin CHARACTERISTIC KL_KH_VAN_DELAY_TMOT "Katheizdelay abhaengig von tmot" CURVE 0x73D3C TKL_SW_VV_UW 100.0 FORMULA_0109 0.0 325.0 FORMAT "%5.2"
 /begin AXIS_DESCR STD_AXIS tmot FORMULA_0023 6 -50.0 170.0 MAX_GRAD 0.0 FORMAT "%4.1" /end AXIS_DESCR
/end CHARACTERISTIC
/begin CHARACTERISTIC KL_KH_VAN_TMOT_F "Faktor zwischen KF_VAN_A und KF_VAN_KH_A" CURVE 0x73D7A TKL_SW_VV_UW 100.0 FORMULA_0199 0.0 2.0 FORMAT "%7.4"
 /begin AXIS_DESCR STD_AXIS tmot FORMULA_0023 6 -50.0 170.0 MAX_GRAD 0.0 FORMAT "%4.1" /end AXIS_DESCR
/end CHARACTERISTIC
/begin CHARACTERISTIC KL_KR_FBS_AVG_NO "Anzahl der Arbeitsspiele fuer Mittelwertsbildung." CURVE 0x7488C TKL_SW_VV_UB 100.0 FORMULA_0003 0.0 255.0
 /begin AXIS_DESCR STD_AXIS rf_dyn_delta FORMULA_0187 12 -200.0 200.0 MAX_GRAD 0.0 FORMAT "%6.3" /end AXIS_DESCR
/end CHARACTERISTIC
/begin CHARACTERISTIC KL_KUS_GANG_FAK "Ganganteil abh. vom Schlupf" CURVE 0x74EAE TKL_SW_VV_SW 100.0 FORMULA_0073 -1.0 10.0 FORMAT "%6.3" /begin AXIS_DESCR STD_AXIS Schlupf FORMULA_0006 4 0.0 10000.0 MAX_GRAD 0.0 /end AXIS_DESCR /end CHARACTERISTIC
/begin CHARACTERISTIC KL_KUS_N_MIN_AFZ "untere Motordrehzahl abh. von der Steigung" CURVE 0x74EC0 TKL_SW_VV_SW 100.0 FORMULA_0006 0.0 10000.0
 /begin AXIS_DESCR STD_AXIS Laengsbeschleunigung FORMULA_0123 4 -50.0 50.0 MAX_GRAD 0.0 FORMAT "%5.2" /end AXIS_DESCR
/end CHARACTERISTIC
/begin CHARACTERISTIC KL_KUS_SCHLUPF_MAX "zulaessiger Kupplungsschlupf" CURVE 0x74E9A TKL_UB_VV_SW 100.0 FORMULA_0006 0.0 10000.0 /begin AXIS_DESCR STD_AXIS Kusstufe FORMULA_0003 6 0.0 255.0 MAX_GRAD 0.0 /end AXIS_DESCR /end CHARACTERISTIC
/begin CHARACTERISTIC KL_LLR_D_FAK_TOEL "D-Anteil" CURVE 0x75018 TKL_SW_VV_UW 100.0 FORMULA_0073 0.0 4.0 FORMAT "%6.3"
 /begin AXIS_DESCR STD_AXIS toel FORMULA_0023 8 -50.0 170.0 MAX_GRAD 0.0 FORMAT "%4.1" /end AXIS_DESCR
/end CHARACTERISTIC
/begin CHARACTERISTIC KL_LLR_MD_RES_TMOT "Reserve ueber Tmot" CURVE 0x7503A TKL_SW_VV_SW 100.0 FORMULA_0009 0.0 100.0 FORMAT "%4.1"
 /begin AXIS_DESCR STD_AXIS tmot FORMULA_0023 8 -50.0 170.0 MAX_GRAD 0.0 FORMAT "%4.1" /end AXIS_DESCR
/end CHARACTERISTIC
/begin CHARACTERISTIC KL_LLR_MD_TZ_MKS "LLR TZ-Eingriff" CURVE 0x75082 TKL_SW_VV_SW 100.0 FORMULA_0009 -40.0 40.0 FORMAT "%4.1"
 /begin AXIS_DESCR STD_AXIS llr_n_diff FORMULA_0006 9 -500.0 500.0 MAX_GRAD 0.0 /end AXIS_DESCR
/end CHARACTERISTIC
/begin CHARACTERISTIC KL_LLR_MD_TZ_MKS_KH "LLR TZ-Eingriff bei KH" CURVE 0x750CE TKL_SW_VV_SW 100.0 FORMULA_0009 -40.0 40.0 FORMAT "%4.1"
 /begin AXIS_DESCR STD_AXIS llr_n_diff FORMULA_0006 9 -500.0 500.0 MAX_GRAD 0.0 /end AXIS_DESCR
/end CHARACTERISTIC
/begin CHARACTERISTIC KL_LLR_MD_TZ_OKS "LLR TZ-Eingriff" CURVE 0x7505C TKL_SW_VV_SW 100.0 FORMULA_0009 -40.0 40.0 FORMAT "%4.1"
 /begin AXIS_DESCR STD_AXIS llr_n_diff FORMULA_0006 9 -500.0 500.0 MAX_GRAD 0.0 /end AXIS_DESCR
/end CHARACTERISTIC
/begin CHARACTERISTIC KL_LLR_MD_TZ_OKS_KH "LLR TZ-Eingriff bei KH" CURVE 0x750A8 TKL_SW_VV_SW 100.0 FORMULA_0009 -40.0 40.0 FORMAT "%4.1"
 /begin AXIS_DESCR STD_AXIS llr_n_diff FORMULA_0006 9 -500.0 500.0 MAX_GRAD 0.0 /end AXIS_DESCR
/end CHARACTERISTIC
/begin CHARACTERISTIC KL_LLR_N_SOLL_KH_OFF "Offset ueber Katheizen" CURVE 0x74FFE TKL_SW_VV_SW 100.0 FORMULA_0006 0.0 10000.0
 /begin AXIS_DESCR STD_AXIS tmot FORMULA_0023 6 -50.0 170.0 MAX_GRAD 0.0 FORMAT "%4.1" /end AXIS_DESCR
/end CHARACTERISTIC
/begin CHARACTERISTIC KL_LLR_N_SOLL_TMOT "Leerlaufdrehzahl ueber Tmot" CURVE 0x74FBA TKL_SW_VV_SW 100.0 FORMULA_0006 0.0 10000.0
 /begin AXIS_DESCR STD_AXIS tmot FORMULA_0023 8 -50.0 170.0 MAX_GRAD 0.0 FORMAT "%4.1" /end AXIS_DESCR
/end CHARACTERISTIC
/begin CHARACTERISTIC KL_LLR_N_SOLL_TMOT_E2 "Leerlaufdrehzahl Ebene 2" CURVE 0x7B086 TKL_SW_VV_SW 100.0 FORMULA_0006 0.0 10000.0
 /begin AXIS_DESCR STD_AXIS tmot FORMULA_0023 4 -50.0 170.0 MAX_GRAD 0.0 FORMAT "%4.1" /end AXIS_DESCR
/end CHARACTERISTIC
/begin CHARACTERISTIC KL_LLR_N_SOLL_TOEL_OFF "Offset ueber Toel" CURVE 0x74FDC TKL_SW_VV_SW 100.0 FORMULA_0006 0.0 10000.0
 /begin AXIS_DESCR STD_AXIS toel FORMULA_0023 8 -50.0 170.0 MAX_GRAD 0.0 FORMAT "%4.1" /end AXIS_DESCR
/end CHARACTERISTIC
/begin CHARACTERISTIC KL_MD_ABTRIEB_NULL_KOMFORT "Abtriebsnullmoment - Komfort" CURVE 0x771BC TKL_SW_VV_SW 100.0 FORMULA_0001 -10.0 120.0 FORMAT "%4.1"
 /begin AXIS_DESCR STD_AXIS v_vorne FORMULA_0076 6 -80.0 360.0 MAX_GRAD 0.0 FORMAT "%4.1" /end AXIS_DESCR
/end CHARACTERISTIC
/begin CHARACTERISTIC KL_MD_ABTRIEB_NULL_SPORT "Abtriebsnullmoment - Sport" CURVE 0x771D6 TKL_SW_VV_SW 100.0 FORMULA_0001 -10.0 120.0 FORMAT "%4.1"
 /begin AXIS_DESCR STD_AXIS v_vorne FORMULA_0076 6 -80.0 360.0 MAX_GRAD 0.0 FORMAT "%4.1" /end AXIS_DESCR
/end CHARACTERISTIC
/begin CHARACTERISTIC KL_MD_ABTRIEB_SCHLEPP_FAK "Steigungs-Faktor" CURVE 0x7718E TKL_SW_VV_UW 100.0 FORMULA_0073 0.0 4.0 FORMAT "%6.3"
 /begin AXIS_DESCR STD_AXIS md_idx_fp FORMULA_0073 6 -1.0 1.0 MAX_GRAD 0.0 FORMAT "%6.3" /end AXIS_DESCR
/end CHARACTERISTIC
/begin CHARACTERISTIC KL_MD_ABTRIEB_SCHLEPP_MAX "Max. IPM-Schleppmoment" CURVE 0x77160 TKL_SW_VV_SW 100.0 FORMULA_0009 -1000.0 2000.0 FORMAT "%4.1"
 /begin AXIS_DESCR STD_AXIS v_vorne FORMULA_0076 11 -80.0 360.0 MAX_GRAD 0.0 FORMAT "%4.1" /end AXIS_DESCR
/end CHARACTERISTIC
/begin CHARACTERISTIC KL_MD_IDX_FP "Umnormierung FP-Index" CURVE 0x771A8 TKL_UB_VV_SW 100.0 FORMULA_0073 -1.0 1.0 FORMAT "%6.3" /begin AXIS_DESCR STD_AXIS can_idx_fp FORMULA_0003 6 0.0 5.0 MAX_GRAD 0.0 /end AXIS_DESCR /end CHARACTERISTIC
/begin CHARACTERISTIC KL_MD_KUPP_MAX "Max. IPM-Kupplungsmoment" CURVE 0x77132 TKL_SW_VV_SW 100.0 FORMULA_0009 -100.0 1000.0 FORMAT "%4.1" /begin AXIS_DESCR STD_AXIS n_ab FORMULA_0006 11 0.0 10000.0 MAX_GRAD 0.0 /end AXIS_DESCR /end CHARACTERISTIC
/begin CHARACTERISTIC KL_MD_KUPP_MIN "Max. IPM-Kupplungsmoment" CURVE 0x77104 TKL_SW_VV_SW 100.0 FORMULA_0009 -200.0 1000.0 FORMAT "%4.1" /begin AXIS_DESCR STD_AXIS n_ab FORMULA_0006 11 0.0 10000.0 MAX_GRAD 0.0 /end AXIS_DESCR /end CHARACTERISTIC
/begin CHARACTERISTIC KL_MD_KUS_KR_FAK "Faktor auf KR" CURVE 0x775CC TKL_SW_VV_UW 100.0 FORMULA_0073 0.0 10.0 FORMAT "%6.3"
 /begin AXIS_DESCR STD_AXIS Regelabweichung FORMULA_0006 6 -10000.0 10000.0 MAX_GRAD 0.0 /end AXIS_DESCR
/end CHARACTERISTIC
/begin CHARACTERISTIC KL_MD_KUS_KUPP_MIN "Minimalmoment fuer Regler" CURVE 0x775E6 TKL_SW_VV_SW 100.0 FORMULA_0009 -100.0 1000.0 FORMAT "%4.1"
 /begin AXIS_DESCR STD_AXIS Kupplungsschlupf FORMULA_0006 4 -10000.0 10000.0 MAX_GRAD 0.0 /end AXIS_DESCR
/end CHARACTERISTIC
/begin CHARACTERISTIC KL_MD_KUS_TN_FAK "Faktor auf TN" CURVE 0x775F8 TKL_SW_VV_UW 100.0 FORMULA_0073 0.0 10.0 FORMAT "%6.3"
 /begin AXIS_DESCR STD_AXIS Regelabweichung FORMULA_0006 6 -10000.0 10000.0 MAX_GRAD 0.0 /end AXIS_DESCR
/end CHARACTERISTIC
/begin CHARACTERISTIC KL_MD_KUS_TV_FAK "Faktor auf TV" CURVE 0x77612 TKL_SW_VV_UW 100.0 FORMULA_0073 0.0 10.0 FORMAT "%6.3"
 /begin AXIS_DESCR STD_AXIS Regelabweichung FORMULA_0006 6 -10000.0 10000.0 MAX_GRAD 0.0 /end AXIS_DESCR
/end CHARACTERISTIC
/begin CHARACTERISTIC KL_MD_RAD_BREMSE "Bremsmoment" CURVE 0x77224 TKL_UB_VV_UW 100.0 FORMULA_0793 0.0 -65535.0 /begin AXIS_DESCR STD_AXIS can_brp FORMULA_0129 6 0.0 200.0 MAX_GRAD 0.0 /end AXIS_DESCR /end CHARACTERISTIC
/begin CHARACTERISTIC KL_MD_RAD_BREMSE_TAU "Filter Bremsmoment" CURVE 0x77252 TKL_UW_VV_UW 100.0 FORMULA_0469 4.999999888241291e-003 327.6700134277344 FORMAT "%5.2" /begin AXIS_DESCR STD_AXIS md_brems FORMULA_0793 6 0.0 -65535.0 MAX_GRAD 0.0 /end AXIS_DESCR /end CHARACTERISTIC
/begin CHARACTERISTIC KL_MD_RAD_STEIG_BREMS "Steigungseinfluss Bremsmoment" CURVE 0x77238 TKL_SW_VV_SW 100.0 FORMULA_0794 -32000.0 32000.0
 /begin AXIS_DESCR STD_AXIS md_rad_steigung FORMULA_0009 6 -3200.0 3200.0 MAX_GRAD 0.0 FORMAT "%4.1" /end AXIS_DESCR
/end CHARACTERISTIC
/begin CHARACTERISTIC KL_MD_RAD_STEIG_FAK "Steigungs-Faktor" CURVE 0x7720A TKL_SW_VV_UW 100.0 FORMULA_0073 0.0 4.0 FORMAT "%6.3"
 /begin AXIS_DESCR STD_AXIS md_ipm_pwg_pos FORMULA_0001 6 -10.0 120.0 MAX_GRAD 0.0 FORMAT "%4.1" /end AXIS_DESCR
/end CHARACTERISTIC
/begin CHARACTERISTIC KL_MD_RAD_STEIGUNG "Steigungskorrektur" CURVE 0x771F0 TKL_SW_VV_SW 100.0 FORMULA_0009 -3200.0 3200.0 FORMAT "%4.1"
 /begin AXIS_DESCR STD_AXIS can_md_rad_steigung FORMULA_0009 6 -3200.0 3200.0 MAX_GRAD 0.0 FORMAT "%4.1" /end AXIS_DESCR
/end CHARACTERISTIC
/begin CHARACTERISTIC KL_N_LW_TAN_LW_VERH_WURZEL "Wurzel-Verhaeltnis der Einlassladungswechseltemperaturen." CURVE 0x78366 TKL_SW_VV_UW 100.0 FORMULA_0073 0.0 4.0 FORMAT "%6.3"
 /begin AXIS_DESCR STD_AXIS tan FORMULA_0023 7 -50.0 170.0 MAX_GRAD 0.0 FORMAT "%4.1" /end AXIS_DESCR
/end CHARACTERISTIC
/begin CHARACTERISTIC KL_TKA_NTC "Kennlinie Kuehleraustrittstemperatur" CURVE 0x7A2E0 TKL_SW_VV_SW 100.0 FORMULA_0975 -50.0 170.0 FORMAT "%6.3" /begin AXIS_DESCR STD_AXIS tka_ad FORMULA_0114 8 0.0 1023.0 MAX_GRAD 0.0 /end AXIS_DESCR /end CHARACTERISTIC
/begin CHARACTERISTIC KL_TKA_OBD_TMOT_T "Kennlinie Diagnosezeit" CURVE 0x7A302 TKL_SW_VV_UW 100.0 FORMULA_0071 0.0 6553.5 FORMAT "%4.1"
 /begin AXIS_DESCR STD_AXIS tka FORMULA_0023 8 -50.0 170.0 MAX_GRAD 0.0 FORMAT "%4.1" /end AXIS_DESCR
/end CHARACTERISTIC
/begin CHARACTERISTIC KL_VR_VORST_DTZ "Korrekturfaktor ueber Rueckziehwinkel." CURVE 0x7AEFC TKL_SW_VV_SW 100.0 FORMULA_0447 -32.0 32.0 FORMAT "%6.3"
 /begin AXIS_DESCR STD_AXIS tz FORMULA_0102 8 -50.0 60.0 MAX_GRAD 0.0 FORMAT "%4.1" /end AXIS_DESCR
/end CHARACTERISTIC
/begin AXIS_PTS AXIS_N_GRAD6 "Stuetzstellen ueber Drehzahlgradient pro Arbeitsspiel." 0x7355E n_grad_asp TAD_UB_VV_SW 20000.0 FORMULA_0105 6 -10000.0 10000.0 /end AXIS_PTS
/begin AXIS_PTS AXIS_N_LW_N6 "Stuetzstellen ueber Drehzahl." 0x7834A n TAD_UB_VV_SW 10000.0 FORMULA_0006 6 0.0 10000.0 /end AXIS_PTS
/begin AXIS_PTS AXIS_N_LW_RF6 "Stuetzstellen ueber rf." 0x78358 rf_m TAD_UB_VV_SW 2.0 FORMULA_0007 6 0.0 2.0 FORMAT "%6.3" /end AXIS_PTS
/begin AXIS_PTS AXIS_N10 "Stuetzstellen ueber Drehzahl." 0x7350C n TAD_UB_VV_SW 10000.0 FORMULA_0006 10 0.0 10000.0 /end AXIS_PTS
/begin AXIS_PTS AXIS_N12 "Stuetzstellen ueber Drehzahl." 0x73522 n TAD_UB_VV_SW 10000.0 FORMULA_0006 12 0.0 10000.0 /end AXIS_PTS
/begin AXIS_PTS AXIS_N16 "Stuetzstellen ueber Drehzahl." 0x7353C n TAD_UB_VV_SW 10000.0 FORMULA_0006 16 0.0 10000.0 /end AXIS_PTS
/begin AXIS_PTS AXIS_RF10 "Stuetzstellen ueber rf." 0x73578 rf_m TAD_UB_VV_SW 2.0 FORMULA_0007 10 0.0 2.0 FORMAT "%6.3" /end AXIS_PTS
/begin AXIS_PTS GKL_KR_AXIS_FBS "Stuetzstellen ueber Frequenz-Band-Spektrum." 0x74846 fbs TAD_UB_VV_SW 74.40000152587891 FORMULA_0733 12 0.0 74.43340301513672 FORMAT "%5.2" /end AXIS_PTS
/begin MEASUREMENT B_MD_IPM_POS "IPM-Bereich" UBYTE FORMULA_0790 0 0 0.0 255.0 READ_WRITE BIT_MASK 0x1 ECU_ADDRESS 0x3FC0F8 /end MEASUREMENT
/begin MEASUREMENT ka_adapt_min "Min KA Zuendwinkeleingriff." SWORD FORMULA_0102 0 0.0 -50.0 60.0 READ_WRITE ECU_ADDRESS 0x3FBB56 /end MEASUREMENT
/begin MEASUREMENT ka_adapt_tz_zyl_int "Limitierter Klopfadaptionrueckziehwinkel." SLONG FORMULA_0225 0 0.0 -50.0 60.0 READ_WRITE ECU_ADDRESS 0x3FBB30 /end MEASUREMENT
/begin MEASUREMENT ka_adapt_tz_zyl_int_max "Maximaler Klopfadaptionrueckziehwinkel." SLONG FORMULA_0225 0 0.0 -50.0 60.0 READ_WRITE ECU_ADDRESS 0x3FBB34 /end MEASUREMENT
/begin MEASUREMENT ka_adapt_tz_zyl_int_roh "Rohwert Klopfadaptionrueckziehwinkel." SLONG FORMULA_0225 0 0.0 -50.0 60.0 READ_WRITE ECU_ADDRESS 0x3FBB38 /end MEASUREMENT
/begin MEASUREMENT ka_aq_grad_segm_cnt_b1 "Zaehler Segmente Deaktivierung nach Dynamik" UWORD FORMULA_0010 0 0.0 0.0 65535.0 READ_WRITE ECU_ADDRESS 0x3FBB52 /end MEASUREMENT
/begin MEASUREMENT ka_aq_grad_segm_cnt_b2 "Zaehler Segmente Deaktivierung nach Dynamik" UWORD FORMULA_0010 0 0.0 0.0 65535.0 READ_WRITE ECU_ADDRESS 0x3FBB54 /end MEASUREMENT
/begin MEASUREMENT ka_dtz_diag_st "Status Diagnose Bereichsueberwachung von ka_dtz pro Bank" UBYTE FORMULA_0696 0 0.0 0.0 255.0 READ_WRITE ECU_ADDRESS 0x3FBB29 /end MEASUREMENT
/begin MEASUREMENT ka_dtz_diag_t_b1 "Zeit der Bereichsueberwachung von ka_dtz pro Bank" UWORD FORMULA_0071 0 0.0 0.0 6553.5 READ_WRITE ECU_ADDRESS 0x3FBB4E /end MEASUREMENT
/begin MEASUREMENT ka_dtz_diag_t_b2 "Zeit der Bereichsueberwachung von ka_dtz pro Bank" UWORD FORMULA_0071 0 0.0 0.0 6553.5 READ_WRITE ECU_ADDRESS 0x3FBB50 /end MEASUREMENT
/begin MEASUREMENT ka_dtz_tp_zyl1 "Tiefpassgefilterter Klopfregelrueckziehwinkel." SLONG FORMULA_0225 0 0.0 -50.0 60.0 READ_WRITE ECU_ADDRESS 0x3FBB80 /end MEASUREMENT
/begin MEASUREMENT ka_dtz_tp_zyl10 "Tiefpassgefilterter Klopfregelrueckziehwinkel." SLONG FORMULA_0225 0 0.0 -50.0 60.0 READ_WRITE ECU_ADDRESS 0x3FBBA4 /end MEASUREMENT
/begin MEASUREMENT ka_dtz_tp_zyl2 "Tiefpassgefilterter Klopfregelrueckziehwinkel." SLONG FORMULA_0225 0 0.0 -50.0 60.0 READ_WRITE ECU_ADDRESS 0x3FBB84 /end MEASUREMENT
/begin MEASUREMENT ka_dtz_tp_zyl3 "Tiefpassgefilterter Klopfregelrueckziehwinkel." SLONG FORMULA_0225 0 0.0 -50.0 60.0 READ_WRITE ECU_ADDRESS 0x3FBB88 /end MEASUREMENT
/begin MEASUREMENT ka_dtz_tp_zyl4 "Tiefpassgefilterter Klopfregelrueckziehwinkel." SLONG FORMULA_0225 0 0.0 -50.0 60.0 READ_WRITE ECU_ADDRESS 0x3FBB8C /end MEASUREMENT
/begin MEASUREMENT ka_dtz_tp_zyl5 "Tiefpassgefilterter Klopfregelrueckziehwinkel." SLONG FORMULA_0225 0 0.0 -50.0 60.0 READ_WRITE ECU_ADDRESS 0x3FBB90 /end MEASUREMENT
/begin MEASUREMENT ka_dtz_tp_zyl6 "Tiefpassgefilterter Klopfregelrueckziehwinkel." SLONG FORMULA_0225 0 0.0 -50.0 60.0 READ_WRITE ECU_ADDRESS 0x3FBB94 /end MEASUREMENT
/begin MEASUREMENT ka_dtz_tp_zyl7 "Tiefpassgefilterter Klopfregelrueckziehwinkel." SLONG FORMULA_0225 0 0.0 -50.0 60.0 READ_WRITE ECU_ADDRESS 0x3FBB98 /end MEASUREMENT
/begin MEASUREMENT ka_dtz_tp_zyl8 "Tiefpassgefilterter Klopfregelrueckziehwinkel." SLONG FORMULA_0225 0 0.0 -50.0 60.0 READ_WRITE ECU_ADDRESS 0x3FBB9C /end MEASUREMENT
/begin MEASUREMENT ka_dtz_tp_zyl9 "Tiefpassgefilterter Klopfregelrueckziehwinkel." SLONG FORMULA_0225 0 0.0 -50.0 60.0 READ_WRITE ECU_ADDRESS 0x3FBBA0 /end MEASUREMENT
/begin MEASUREMENT ka_dtz_vl "Klopfadaptionrueckziehwinkel unter Vollast." SWORD FORMULA_0102 0 0.0 -50.0 60.0 READ_WRITE ECU_ADDRESS 0x3FBB2E /end MEASUREMENT
/begin MEASUREMENT ka_dtz_zyl1 "Klopfadaptionrueckziehwinkel." SWORD FORMULA_0102 0 0.0 -50.0 60.0 READ_WRITE ECU_ADDRESS 0x3FBB6C /end MEASUREMENT
/begin MEASUREMENT ka_dtz_zyl10 "Klopfadaptionrueckziehwinkel." SWORD FORMULA_0102 0 0.0 -50.0 60.0 READ_WRITE ECU_ADDRESS 0x3FBB7E /end MEASUREMENT
/begin MEASUREMENT ka_dtz_zyl2 "Klopfadaptionrueckziehwinkel." SWORD FORMULA_0102 0 0.0 -50.0 60.0 READ_WRITE ECU_ADDRESS 0x3FBB6E /end MEASUREMENT
/begin MEASUREMENT ka_dtz_zyl3 "Klopfadaptionrueckziehwinkel." SWORD FORMULA_0102 0 0.0 -50.0 60.0 READ_WRITE ECU_ADDRESS 0x3FBB70 /end MEASUREMENT
/begin MEASUREMENT ka_dtz_zyl4 "Klopfadaptionrueckziehwinkel." SWORD FORMULA_0102 0 0.0 -50.0 60.0 READ_WRITE ECU_ADDRESS 0x3FBB72 /end MEASUREMENT
/begin MEASUREMENT ka_dtz_zyl5 "Klopfadaptionrueckziehwinkel." SWORD FORMULA_0102 0 0.0 -50.0 60.0 READ_WRITE ECU_ADDRESS 0x3FBB74 /end MEASUREMENT
/begin MEASUREMENT ka_dtz_zyl6 "Klopfadaptionrueckziehwinkel." SWORD FORMULA_0102 0 0.0 -50.0 60.0 READ_WRITE ECU_ADDRESS 0x3FBB76 /end MEASUREMENT
/begin MEASUREMENT ka_dtz_zyl7 "Klopfadaptionrueckziehwinkel." SWORD FORMULA_0102 0 0.0 -50.0 60.0 READ_WRITE ECU_ADDRESS 0x3FBB78 /end MEASUREMENT
/begin MEASUREMENT ka_dtz_zyl8 "Klopfadaptionrueckziehwinkel." SWORD FORMULA_0102 0 0.0 -50.0 60.0 READ_WRITE ECU_ADDRESS 0x3FBB7A /end MEASUREMENT
/begin MEASUREMENT ka_dtz_zyl9 "Klopfadaptionrueckziehwinkel." SWORD FORMULA_0102 0 0.0 -50.0 60.0 READ_WRITE ECU_ADDRESS 0x3FBB7C /end MEASUREMENT
/begin MEASUREMENT ka_f "Gewichtungsfaktor der Klopfadaption." UWORD FORMULA_0073 0 0.0 0.0 63.99900054931641 READ_WRITE ECU_ADDRESS 0x3FBB3C /end MEASUREMENT
/begin MEASUREMENT ka_f_k_b1 "Korrekturwert vom Gewichtungsfaktor." UWORD FORMULA_0073 0 0.0 0.0 63.99900054931641 READ_WRITE ECU_ADDRESS 0x3FBB46 /end MEASUREMENT
/begin MEASUREMENT ka_f_k_b2 "Korrekturwert vom Gewichtungsfaktor." UWORD FORMULA_0073 0 0.0 0.0 63.99900054931641 READ_WRITE ECU_ADDRESS 0x3FBB48 /end MEASUREMENT
/begin MEASUREMENT ka_offs_zyl1 "Offset zur Klopfgrenze" SWORD FORMULA_0102 0 0.0 -50.0 60.0 READ_WRITE ECU_ADDRESS 0x3FBB58 /end MEASUREMENT
/begin MEASUREMENT ka_offs_zyl10 "Offset zur Klopfgrenze" SWORD FORMULA_0102 0 0.0 -50.0 60.0 READ_WRITE ECU_ADDRESS 0x3FBB6A /end MEASUREMENT
/begin MEASUREMENT ka_offs_zyl2 "Offset zur Klopfgrenze" SWORD FORMULA_0102 0 0.0 -50.0 60.0 READ_WRITE ECU_ADDRESS 0x3FBB5A /end MEASUREMENT
/begin MEASUREMENT ka_offs_zyl3 "Offset zur Klopfgrenze" SWORD FORMULA_0102 0 0.0 -50.0 60.0 READ_WRITE ECU_ADDRESS 0x3FBB5C /end MEASUREMENT
/begin MEASUREMENT ka_offs_zyl4 "Offset zur Klopfgrenze" SWORD FORMULA_0102 0 0.0 -50.0 60.0 READ_WRITE ECU_ADDRESS 0x3FBB5E /end MEASUREMENT
/begin MEASUREMENT ka_offs_zyl5 "Offset zur Klopfgrenze" SWORD FORMULA_0102 0 0.0 -50.0 60.0 READ_WRITE ECU_ADDRESS 0x3FBB60 /end MEASUREMENT
/begin MEASUREMENT ka_offs_zyl6 "Offset zur Klopfgrenze" SWORD FORMULA_0102 0 0.0 -50.0 60.0 READ_WRITE ECU_ADDRESS 0x3FBB62 /end MEASUREMENT
/begin MEASUREMENT ka_offs_zyl7 "Offset zur Klopfgrenze" SWORD FORMULA_0102 0 0.0 -50.0 60.0 READ_WRITE ECU_ADDRESS 0x3FBB64 /end MEASUREMENT
/begin MEASUREMENT ka_offs_zyl8 "Offset zur Klopfgrenze" SWORD FORMULA_0102 0 0.0 -50.0 60.0 READ_WRITE ECU_ADDRESS 0x3FBB66 /end MEASUREMENT
/begin MEASUREMENT ka_offs_zyl9 "Offset zur Klopfgrenze" SWORD FORMULA_0102 0 0.0 -50.0 60.0 READ_WRITE ECU_ADDRESS 0x3FBB68 /end MEASUREMENT
/begin MEASUREMENT ka_pumg "Zuendwinkeloffset durch Umgebungsdruck" SWORD FORMULA_0102 0 0.0 -50.0 60.0 READ_WRITE ECU_ADDRESS 0x3FBB2C /end MEASUREMENT
/begin MEASUREMENT ka_rf_min_b1 "Lastschwelle KA" SWORD FORMULA_0007 0 0.0 0.0 2.0 READ_WRITE ECU_ADDRESS 0x3FBB42 /end MEASUREMENT
/begin MEASUREMENT ka_rf_min_b2 "Lastschwelle KA" SWORD FORMULA_0007 0 0.0 0.0 2.0 READ_WRITE ECU_ADDRESS 0x3FBB44 /end MEASUREMENT
/begin MEASUREMENT ka_st_b1 "Klopfschutz." UWORD FORMULA_0695 0 0.0 0.0 65535.0 READ_WRITE ECU_ADDRESS 0x3FBB24 /end MEASUREMENT
/begin MEASUREMENT ka_st_b2 "Klopfschutz." UWORD FORMULA_0695 0 0.0 0.0 65535.0 READ_WRITE ECU_ADDRESS 0x3FBB26 /end MEASUREMENT
/begin MEASUREMENT ka_t_komp_b1 "Zuendwinkeloffset durch Temperatur" SWORD FORMULA_0102 0 0.0 -50.0 60.0 READ_WRITE ECU_ADDRESS 0x3FBB3E /end MEASUREMENT
/begin MEASUREMENT ka_t_komp_b2 "Zuendwinkeloffset durch Temperatur" SWORD FORMULA_0102 0 0.0 -50.0 60.0 READ_WRITE ECU_ADDRESS 0x3FBB40 /end MEASUREMENT
/begin MEASUREMENT ka_tz_diag_st "Status Diagnose Bereichsueberwachung von ka_tz_nv pro Bank" UBYTE FORMULA_0696 0 0.0 0.0 255.0 READ_WRITE ECU_ADDRESS 0x3FBB28 /end MEASUREMENT
/begin MEASUREMENT ka_tz_diag_t_b1 "Zeit der Bereichsueberwachung von ka_tz_nv pro Bank" UWORD FORMULA_0071 0 0.0 0.0 6553.5 READ_WRITE ECU_ADDRESS 0x3FBB4A /end MEASUREMENT
/begin MEASUREMENT ka_tz_diag_t_b2 "Zeit der Bereichsueberwachung von ka_tz_nv pro Bank" UWORD FORMULA_0071 0 0.0 0.0 6553.5 READ_WRITE ECU_ADDRESS 0x3FBB4C /end MEASUREMENT
/begin MEASUREMENT ka_tz_min_st "Status Anschlag an tz_min" UWORD FORMULA_0010 0 0.0 0.0 65535.0 READ_WRITE ECU_ADDRESS 0x3FBB2A /end MEASUREMENT
/begin MEASUREMENT kh_md_eta "Momentenwirkungsgrad fuer KH" UWORD FORMULA_0437 0 0.0 0.0 150.0 READ_WRITE ECU_ADDRESS 0x3FBBBA /end MEASUREMENT
/begin MEASUREMENT kh_md_eta_aeb "Momentenwirkungsgrad nach Aenderungsbegr. fuer KH" UWORD FORMULA_0437 0 0.0 0.0 150.0 READ_WRITE ECU_ADDRESS 0x3FBBB8 /end MEASUREMENT
/begin MEASUREMENT kh_md_eta_diff "Eta-Diff, Wirkungsgradverschlechterung" UWORD FORMULA_0437 0 0.0 0.0 150.0 READ_WRITE ECU_ADDRESS 0x3FBBBE /end MEASUREMENT
/begin MEASUREMENT kh_md_eta_grad "" UWORD FORMULA_0701 0 0.0 0.0 100.0 READ_WRITE ECU_ADDRESS 0x3FBBBC /end MEASUREMENT
/begin MEASUREMENT kh_md_eta_grund "Momentengrundwirkungsgrad fuer KH" UWORD FORMULA_0437 0 0.0 0.0 150.0 READ_WRITE ECU_ADDRESS 0x3FBBB4 /end MEASUREMENT
/begin MEASUREMENT kh_md_eta_roh "Momentenwirkungsgrad vor Aenderungsbegr. fuer KH" UWORD FORMULA_0437 0 0.0 0.0 150.0 READ_WRITE ECU_ADDRESS 0x3FBBB6 /end MEASUREMENT
/begin MEASUREMENT kh_time_on "Zeit seit Katheizen aktive" UWORD FORMULA_0109 0 0.0 0.0 325.0 READ_WRITE ECU_ADDRESS 0x3FBBAE /end MEASUREMENT
/begin MEASUREMENT kh_tkat "Kattemperatur fuer die KH" SWORD FORMULA_0023 0 0.0 -50.0 170.0 READ_WRITE ECU_ADDRESS 0x3FBBA8 /end MEASUREMENT
/begin MEASUREMENT kh_tkat_alt "Katalterungtemperaturschwelle" SWORD FORMULA_0023 0 0.0 -50.0 170.0 READ_WRITE ECU_ADDRESS 0x3FBBAC /end MEASUREMENT
/begin MEASUREMENT kh_tkat_alt_offset "Temperaturoffset Katalterung" SWORD FORMULA_0074 0 0.0 -1000.0 1000.0 READ_WRITE ECU_ADDRESS 0x3FBBAA /end MEASUREMENT
/begin MEASUREMENT kh_tmot_start "Kattemperatur bei KH beginn" SWORD FORMULA_0023 0 0.0 -50.0 170.0 READ_WRITE ECU_ADDRESS 0x3FBBB2 /end MEASUREMENT
/begin MEASUREMENT kh_van_fakt_max "Max. Gewichtungsfaktor KH" UWORD FORMULA_0199 0 0.0 0.0 2.0 READ_WRITE ECU_ADDRESS 0x3FBBB0 /end MEASUREMENT
/begin MEASUREMENT kr_ab_st "Status Klopfregelung." UWORD FORMULA_0010 0 0.0 0.0 65535.0 READ_WRITE ECU_ADDRESS 0x3FBD3E /end MEASUREMENT
/begin MEASUREMENT kr_ab_st_zyl1 "Klopfregelung Zylinder 1 aktiv." UWORD FORMULA_0723 0 0 0.0 255.0 READ_WRITE BIT_MASK 0x1 ECU_ADDRESS 0x3FBD3E /end MEASUREMENT
/begin MEASUREMENT kr_ab_st_zyl10 "Klopfregelung Zylinder 10 aktiv." UWORD FORMULA_0732 0 0 0.0 255.0 READ_WRITE BIT_MASK 0x200 ECU_ADDRESS 0x3FBD3E /end MEASUREMENT
/begin MEASUREMENT kr_ab_st_zyl2 "Klopfregelung Zylinder 2 aktiv." UWORD FORMULA_0724 0 0 0.0 255.0 READ_WRITE BIT_MASK 0x2 ECU_ADDRESS 0x3FBD3E /end MEASUREMENT
/begin MEASUREMENT kr_ab_st_zyl3 "Klopfregelung Zylinder 3 aktiv." UWORD FORMULA_0725 0 0 0.0 255.0 READ_WRITE BIT_MASK 0x4 ECU_ADDRESS 0x3FBD3E /end MEASUREMENT
/begin MEASUREMENT kr_ab_st_zyl4 "Klopfregelung Zylinder 4 aktiv." UWORD FORMULA_0726 0 0 0.0 255.0 READ_WRITE BIT_MASK 0x8 ECU_ADDRESS 0x3FBD3E /end MEASUREMENT
/begin MEASUREMENT kr_ab_st_zyl5 "Klopfregelung Zylinder 5 aktiv." UWORD FORMULA_0727 0 0 0.0 255.0 READ_WRITE BIT_MASK 0x10 ECU_ADDRESS 0x3FBD3E /end MEASUREMENT
/begin MEASUREMENT kr_ab_st_zyl6 "Klopfregelung Zylinder 6 aktiv." UWORD FORMULA_0728 0 0 0.0 255.0 READ_WRITE BIT_MASK 0x20 ECU_ADDRESS 0x3FBD3E /end MEASUREMENT
/begin MEASUREMENT kr_ab_st_zyl7 "Klopfregelung Zylinder 7 aktiv." UWORD FORMULA_0729 0 0 0.0 255.0 READ_WRITE BIT_MASK 0x40 ECU_ADDRESS 0x3FBD3E /end MEASUREMENT
/begin MEASUREMENT kr_ab_st_zyl8 "Klopfregelung Zylinder 8 aktiv." UWORD FORMULA_0730 0 0 0.0 255.0 READ_WRITE BIT_MASK 0x80 ECU_ADDRESS 0x3FBD3E /end MEASUREMENT
/begin MEASUREMENT kr_ab_st_zyl9 "Klopfregelung Zylinder 9 aktiv." UWORD FORMULA_0731 0 0 0.0 255.0 READ_WRITE BIT_MASK 0x100 ECU_ADDRESS 0x3FBD3E /end MEASUREMENT
/begin MEASUREMENT kr_akt_st "Status Abregelung." UWORD FORMULA_0010 0 0.0 0.0 65535.0 READ_WRITE ECU_ADDRESS 0x3FBD3C /end MEASUREMENT
/begin MEASUREMENT kr_akt_st_zyl1 "Abregelung Zylinder 1 aktiv." UWORD FORMULA_0723 0 0 0.0 255.0 READ_WRITE BIT_MASK 0x1 ECU_ADDRESS 0x3FBD3C /end MEASUREMENT
/begin MEASUREMENT kr_akt_st_zyl10 "Abregelung Zylinder 10 aktiv." UWORD FORMULA_0732 0 0 0.0 255.0 READ_WRITE BIT_MASK 0x200 ECU_ADDRESS 0x3FBD3C /end MEASUREMENT
/begin MEASUREMENT kr_akt_st_zyl2 "Abregelung Zylinder 2 aktiv." UWORD FORMULA_0724 0 0 0.0 255.0 READ_WRITE BIT_MASK 0x2 ECU_ADDRESS 0x3FBD3C /end MEASUREMENT
/begin MEASUREMENT kr_akt_st_zyl3 "Abregelung Zylinder 3 aktiv." UWORD FORMULA_0725 0 0 0.0 255.0 READ_WRITE BIT_MASK 0x4 ECU_ADDRESS 0x3FBD3C /end MEASUREMENT
/begin MEASUREMENT kr_akt_st_zyl4 "Abregelung Zylinder 4 aktiv." UWORD FORMULA_0726 0 0 0.0 255.0 READ_WRITE BIT_MASK 0x8 ECU_ADDRESS 0x3FBD3C /end MEASUREMENT
/begin MEASUREMENT kr_akt_st_zyl5 "Abregelung Zylinder 5 aktiv." UWORD FORMULA_0727 0 0 0.0 255.0 READ_WRITE BIT_MASK 0x10 ECU_ADDRESS 0x3FBD3C /end MEASUREMENT
/begin MEASUREMENT kr_akt_st_zyl6 "Abregelung Zylinder 6 aktiv." UWORD FORMULA_0728 0 0 0.0 255.0 READ_WRITE BIT_MASK 0x20 ECU_ADDRESS 0x3FBD3C /end MEASUREMENT
/begin MEASUREMENT kr_akt_st_zyl7 "Abregelung Zylinder 7 aktiv." UWORD FORMULA_0729 0 0 0.0 255.0 READ_WRITE BIT_MASK 0x40 ECU_ADDRESS 0x3FBD3C /end MEASUREMENT
/begin MEASUREMENT kr_akt_st_zyl8 "Abregelung Zylinder 8 aktiv." UWORD FORMULA_0730 0 0 0.0 255.0 READ_WRITE BIT_MASK 0x80 ECU_ADDRESS 0x3FBD3C /end MEASUREMENT
/begin MEASUREMENT kr_akt_st_zyl9 "Abregelung Zylinder 9 aktiv." UWORD FORMULA_0731 0 0 0.0 255.0 READ_WRITE BIT_MASK 0x100 ECU_ADDRESS 0x3FBD3C /end MEASUREMENT
/begin MEASUREMENT kr_anz_asp_auf "Anzahl der Arbeitsspiele fuer Aufregelphase." UBYTE FORMULA_0003 0 0.0 1.0 255.0 READ_WRITE ECU_ADDRESS 0x3FBD0E /end MEASUREMENT
/begin MEASUREMENT kr_anz_asp_auf_bez_zyl1 "Bezugsanzahl der Arbeitsspiele fuer Aufregelphase." UBYTE FORMULA_0003 0 0.0 0.0 255.0 READ_WRITE ECU_ADDRESS 0x3FBD11 /end MEASUREMENT
/begin MEASUREMENT kr_anz_asp_auf_bez_zyl10 "Bezugsanzahl der Arbeitsspiele fuer Aufregelphase." UBYTE FORMULA_0003 0 0.0 0.0 255.0 READ_WRITE ECU_ADDRESS 0x3FBD1A /end MEASUREMENT
/begin MEASUREMENT kr_anz_asp_auf_bez_zyl2 "Bezugsanzahl der Arbeitsspiele fuer Aufregelphase." UBYTE FORMULA_0003 0 0.0 0.0 255.0 READ_WRITE ECU_ADDRESS 0x3FBD12 /end MEASUREMENT
/begin MEASUREMENT kr_anz_asp_auf_bez_zyl3 "Bezugsanzahl der Arbeitsspiele fuer Aufregelphase." UBYTE FORMULA_0003 0 0.0 0.0 255.0 READ_WRITE ECU_ADDRESS 0x3FBD13 /end MEASUREMENT
/begin MEASUREMENT kr_anz_asp_auf_bez_zyl4 "Bezugsanzahl der Arbeitsspiele fuer Aufregelphase." UBYTE FORMULA_0003 0 0.0 0.0 255.0 READ_WRITE ECU_ADDRESS 0x3FBD14 /end MEASUREMENT
/begin MEASUREMENT kr_anz_asp_auf_bez_zyl5 "Bezugsanzahl der Arbeitsspiele fuer Aufregelphase." UBYTE FORMULA_0003 0 0.0 0.0 255.0 READ_WRITE ECU_ADDRESS 0x3FBD15 /end MEASUREMENT
/begin MEASUREMENT kr_anz_asp_auf_bez_zyl6 "Bezugsanzahl der Arbeitsspiele fuer Aufregelphase." UBYTE FORMULA_0003 0 0.0 0.0 255.0 READ_WRITE ECU_ADDRESS 0x3FBD16 /end MEASUREMENT
/begin MEASUREMENT kr_anz_asp_auf_bez_zyl7 "Bezugsanzahl der Arbeitsspiele fuer Aufregelphase." UBYTE FORMULA_0003 0 0.0 0.0 255.0 READ_WRITE ECU_ADDRESS 0x3FBD17 /end MEASUREMENT
/begin MEASUREMENT kr_anz_asp_auf_bez_zyl8 "Bezugsanzahl der Arbeitsspiele fuer Aufregelphase." UBYTE FORMULA_0003 0 0.0 0.0 255.0 READ_WRITE ECU_ADDRESS 0x3FBD18 /end MEASUREMENT
/begin MEASUREMENT kr_anz_asp_auf_bez_zyl9 "Bezugsanzahl der Arbeitsspiele fuer Aufregelphase." UBYTE FORMULA_0003 0 0.0 0.0 255.0 READ_WRITE ECU_ADDRESS 0x3FBD19 /end MEASUREMENT
/begin MEASUREMENT kr_anz_asp_hold "Anzahl der Arbeitsspiele in Haltephase." UBYTE FORMULA_0003 0 0.0 0.0 255.0 READ_WRITE ECU_ADDRESS 0x3FBD0F /end MEASUREMENT
/begin MEASUREMENT kr_appl_cnt_zyl1 "Zaehler Klopfapplikation." UBYTE FORMULA_0003 0 0.0 0.0 255.0 READ_WRITE ECU_ADDRESS 0x3FBD25 /end MEASUREMENT
/begin MEASUREMENT kr_appl_cnt_zyl10 "Zaehler Klopfapplikation." UBYTE FORMULA_0003 0 0.0 0.0 255.0 READ_WRITE ECU_ADDRESS 0x3FBD2E /end MEASUREMENT
/begin MEASUREMENT kr_appl_cnt_zyl2 "Zaehler Klopfapplikation." UBYTE FORMULA_0003 0 0.0 0.0 255.0 READ_WRITE ECU_ADDRESS 0x3FBD26 /end MEASUREMENT
/begin MEASUREMENT kr_appl_cnt_zyl3 "Zaehler Klopfapplikation." UBYTE FORMULA_0003 0 0.0 0.0 255.0 READ_WRITE ECU_ADDRESS 0x3FBD27 /end MEASUREMENT
/begin MEASUREMENT kr_appl_cnt_zyl4 "Zaehler Klopfapplikation." UBYTE FORMULA_0003 0 0.0 0.0 255.0 READ_WRITE ECU_ADDRESS 0x3FBD28 /end MEASUREMENT
/begin MEASUREMENT kr_appl_cnt_zyl5 "Zaehler Klopfapplikation." UBYTE FORMULA_0003 0 0.0 0.0 255.0 READ_WRITE ECU_ADDRESS 0x3FBD29 /end MEASUREMENT
/begin MEASUREMENT kr_appl_cnt_zyl6 "Zaehler Klopfapplikation." UBYTE FORMULA_0003 0 0.0 0.0 255.0 READ_WRITE ECU_ADDRESS 0x3FBD2A /end MEASUREMENT
/begin MEASUREMENT kr_appl_cnt_zyl7 "Zaehler Klopfapplikation." UBYTE FORMULA_0003 0 0.0 0.0 255.0 READ_WRITE ECU_ADDRESS 0x3FBD2B /end MEASUREMENT
/begin MEASUREMENT kr_appl_cnt_zyl8 "Zaehler Klopfapplikation." UBYTE FORMULA_0003 0 0.0 0.0 255.0 READ_WRITE ECU_ADDRESS 0x3FBD2C /end MEASUREMENT
/begin MEASUREMENT kr_appl_cnt_zyl9 "Zaehler Klopfapplikation." UBYTE FORMULA_0003 0 0.0 0.0 255.0 READ_WRITE ECU_ADDRESS 0x3FBD2D /end MEASUREMENT
/begin MEASUREMENT kr_asp_cnt "KR Arbeitsspielzaehler." UWORD FORMULA_0010 0 0.0 0.0 65535.0 READ_WRITE ECU_ADDRESS 0x3FBD40 /end MEASUREMENT
/begin MEASUREMENT kr_diag_st "Status Diagnose Bereichsueberwachung" UBYTE FORMULA_0711 0 0.0 0.0 255.0 READ_WRITE ECU_ADDRESS 0x3FBD10 /end MEASUREMENT
/begin MEASUREMENT kr_dtz_ab_zyl1 "Klopfregelungseingriff in Abregelphase." SWORD FORMULA_0102 0 0.0 -50.0 60.0 READ_WRITE ECU_ADDRESS 0x3FBDD4 /end MEASUREMENT
/begin MEASUREMENT kr_dtz_ab_zyl10 "Klopfregelungseingriff in Abregelphase." SWORD FORMULA_0102 0 0.0 -50.0 60.0 READ_WRITE ECU_ADDRESS 0x3FBDE6 /end MEASUREMENT
/begin MEASUREMENT kr_dtz_ab_zyl2 "Klopfregelungseingriff in Abregelphase." SWORD FORMULA_0102 0 0.0 -50.0 60.0 READ_WRITE ECU_ADDRESS 0x3FBDD6 /end MEASUREMENT
/begin MEASUREMENT kr_dtz_ab_zyl3 "Klopfregelungseingriff in Abregelphase." SWORD FORMULA_0102 0 0.0 -50.0 60.0 READ_WRITE ECU_ADDRESS 0x3FBDD8 /end MEASUREMENT
/begin MEASUREMENT kr_dtz_ab_zyl4 "Klopfregelungseingriff in Abregelphase." SWORD FORMULA_0102 0 0.0 -50.0 60.0 READ_WRITE ECU_ADDRESS 0x3FBDDA /end MEASUREMENT
/begin MEASUREMENT kr_dtz_ab_zyl5 "Klopfregelungseingriff in Abregelphase." SWORD FORMULA_0102 0 0.0 -50.0 60.0 READ_WRITE ECU_ADDRESS 0x3FBDDC /end MEASUREMENT
/begin MEASUREMENT kr_dtz_ab_zyl6 "Klopfregelungseingriff in Abregelphase." SWORD FORMULA_0102 0 0.0 -50.0 60.0 READ_WRITE ECU_ADDRESS 0x3FBDDE /end MEASUREMENT
/begin MEASUREMENT kr_dtz_ab_zyl7 "Klopfregelungseingriff in Abregelphase." SWORD FORMULA_0102 0 0.0 -50.0 60.0 READ_WRITE ECU_ADDRESS 0x3FBDE0 /end MEASUREMENT
/begin MEASUREMENT kr_dtz_ab_zyl8 "Klopfregelungseingriff in Abregelphase." SWORD FORMULA_0102 0 0.0 -50.0 60.0 READ_WRITE ECU_ADDRESS 0x3FBDE2 /end MEASUREMENT
/begin MEASUREMENT kr_dtz_ab_zyl9 "Klopfregelungseingriff in Abregelphase." SWORD FORMULA_0102 0 0.0 -50.0 60.0 READ_WRITE ECU_ADDRESS 0x3FBDE4 /end MEASUREMENT
/begin MEASUREMENT kr_dtz_bez_zyl1 "Bezugszuendwinkel fuer Aufregelphase." SLONG FORMULA_0225 0 0.0 -50.0 60.0 READ_WRITE ECU_ADDRESS 0x3FBE14 /end MEASUREMENT
/begin MEASUREMENT kr_dtz_bez_zyl10 "Bezugszuendwinkel fuer Aufregelphase." SLONG FORMULA_0225 0 0.0 -50.0 60.0 READ_WRITE ECU_ADDRESS 0x3FBE38 /end MEASUREMENT
/begin MEASUREMENT kr_dtz_bez_zyl2 "Bezugszuendwinkel fuer Aufregelphase." SLONG FORMULA_0225 0 0.0 -50.0 60.0 READ_WRITE ECU_ADDRESS 0x3FBE18 /end MEASUREMENT
/begin MEASUREMENT kr_dtz_bez_zyl3 "Bezugszuendwinkel fuer Aufregelphase." SLONG FORMULA_0225 0 0.0 -50.0 60.0 READ_WRITE ECU_ADDRESS 0x3FBE1C /end MEASUREMENT
/begin MEASUREMENT kr_dtz_bez_zyl4 "Bezugszuendwinkel fuer Aufregelphase." SLONG FORMULA_0225 0 0.0 -50.0 60.0 READ_WRITE ECU_ADDRESS 0x3FBE20 /end MEASUREMENT
/begin MEASUREMENT kr_dtz_bez_zyl5 "Bezugszuendwinkel fuer Aufregelphase." SLONG FORMULA_0225 0 0.0 -50.0 60.0 READ_WRITE ECU_ADDRESS 0x3FBE24 /end MEASUREMENT
/begin MEASUREMENT kr_dtz_bez_zyl6 "Bezugszuendwinkel fuer Aufregelphase." SLONG FORMULA_0225 0 0.0 -50.0 60.0 READ_WRITE ECU_ADDRESS 0x3FBE28 /end MEASUREMENT
/begin MEASUREMENT kr_dtz_bez_zyl7 "Bezugszuendwinkel fuer Aufregelphase." SLONG FORMULA_0225 0 0.0 -50.0 60.0 READ_WRITE ECU_ADDRESS 0x3FBE2C /end MEASUREMENT
/begin MEASUREMENT kr_dtz_bez_zyl8 "Bezugszuendwinkel fuer Aufregelphase." SLONG FORMULA_0225 0 0.0 -50.0 60.0 READ_WRITE ECU_ADDRESS 0x3FBE30 /end MEASUREMENT
/begin MEASUREMENT kr_dtz_bez_zyl9 "Bezugszuendwinkel fuer Aufregelphase." SLONG FORMULA_0225 0 0.0 -50.0 60.0 READ_WRITE ECU_ADDRESS 0x3FBE34 /end MEASUREMENT
/begin MEASUREMENT kr_dtz_diag_t_b1 "Zeit der Bereichsueberwachung von kr_dtz pro Bank" UWORD FORMULA_0071 0 0.0 0.0 6553.5 READ_WRITE ECU_ADDRESS 0x3FBD80 /end MEASUREMENT
/begin MEASUREMENT kr_dtz_diag_t_b2 "Zeit der Bereichsueberwachung von kr_dtz pro Bank" UWORD FORMULA_0071 0 0.0 0.0 6553.5 READ_WRITE ECU_ADDRESS 0x3FBD82 /end MEASUREMENT
/begin MEASUREMENT kr_dtz_grad_zyl1 "Klopfregelungseingriffgradient." SLONG FORMULA_0225 0 0.0 -50.0 60.0 READ_WRITE ECU_ADDRESS 0x3FBE3C /end MEASUREMENT
/begin MEASUREMENT kr_dtz_grad_zyl10 "Klopfregelungseingriffgradient." SLONG FORMULA_0225 0 0.0 -50.0 60.0 READ_WRITE ECU_ADDRESS 0x3FBE60 /end MEASUREMENT
/begin MEASUREMENT kr_dtz_grad_zyl2 "Klopfregelungseingriffgradient." SLONG FORMULA_0225 0 0.0 -50.0 60.0 READ_WRITE ECU_ADDRESS 0x3FBE40 /end MEASUREMENT
/begin MEASUREMENT kr_dtz_grad_zyl3 "Klopfregelungseingriffgradient." SLONG FORMULA_0225 0 0.0 -50.0 60.0 READ_WRITE ECU_ADDRESS 0x3FBE44 /end MEASUREMENT
/begin MEASUREMENT kr_dtz_grad_zyl4 "Klopfregelungseingriffgradient." SLONG FORMULA_0225 0 0.0 -50.0 60.0 READ_WRITE ECU_ADDRESS 0x3FBE48 /end MEASUREMENT
/begin MEASUREMENT kr_dtz_grad_zyl5 "Klopfregelungseingriffgradient." SLONG FORMULA_0225 0 0.0 -50.0 60.0 READ_WRITE ECU_ADDRESS 0x3FBE4C /end MEASUREMENT
/begin MEASUREMENT kr_dtz_grad_zyl6 "Klopfregelungseingriffgradient." SLONG FORMULA_0225 0 0.0 -50.0 60.0 READ_WRITE ECU_ADDRESS 0x3FBE50 /end MEASUREMENT
/begin MEASUREMENT kr_dtz_grad_zyl7 "Klopfregelungseingriffgradient." SLONG FORMULA_0225 0 0.0 -50.0 60.0 READ_WRITE ECU_ADDRESS 0x3FBE54 /end MEASUREMENT
/begin MEASUREMENT kr_dtz_grad_zyl8 "Klopfregelungseingriffgradient." SLONG FORMULA_0225 0 0.0 -50.0 60.0 READ_WRITE ECU_ADDRESS 0x3FBE58 /end MEASUREMENT
/begin MEASUREMENT kr_dtz_grad_zyl9 "Klopfregelungseingriffgradient." SLONG FORMULA_0225 0 0.0 -50.0 60.0 READ_WRITE ECU_ADDRESS 0x3FBE5C /end MEASUREMENT
/begin MEASUREMENT kr_dtz_int_zyl1 "Klopfreglungseingriff (intern)." SLONG FORMULA_0225 0 0.0 -50.0 60.0 READ_WRITE ECU_ADDRESS 0x3FBDEC /end MEASUREMENT
/begin MEASUREMENT kr_dtz_int_zyl10 "Klopfreglungseingriff (intern)." SLONG FORMULA_0225 0 0.0 -50.0 60.0 READ_WRITE ECU_ADDRESS 0x3FBE10 /end MEASUREMENT
/begin MEASUREMENT kr_dtz_int_zyl2 "Klopfreglungseingriff (intern)." SLONG FORMULA_0225 0 0.0 -50.0 60.0 READ_WRITE ECU_ADDRESS 0x3FBDF0 /end MEASUREMENT
/begin MEASUREMENT kr_dtz_int_zyl3 "Klopfreglungseingriff (intern)." SLONG FORMULA_0225 0 0.0 -50.0 60.0 READ_WRITE ECU_ADDRESS 0x3FBDF4 /end MEASUREMENT
/begin MEASUREMENT kr_dtz_int_zyl4 "Klopfreglungseingriff (intern)." SLONG FORMULA_0225 0 0.0 -50.0 60.0 READ_WRITE ECU_ADDRESS 0x3FBDF8 /end MEASUREMENT
/begin MEASUREMENT kr_dtz_int_zyl5 "Klopfreglungseingriff (intern)." SLONG FORMULA_0225 0 0.0 -50.0 60.0 READ_WRITE ECU_ADDRESS 0x3FBDFC /end MEASUREMENT
/begin MEASUREMENT kr_dtz_int_zyl6 "Klopfreglungseingriff (intern)." SLONG FORMULA_0225 0 0.0 -50.0 60.0 READ_WRITE ECU_ADDRESS 0x3FBE00 /end MEASUREMENT
/begin MEASUREMENT kr_dtz_int_zyl7 "Klopfreglungseingriff (intern)." SLONG FORMULA_0225 0 0.0 -50.0 60.0 READ_WRITE ECU_ADDRESS 0x3FBE04 /end MEASUREMENT
/begin MEASUREMENT kr_dtz_int_zyl8 "Klopfreglungseingriff (intern)." SLONG FORMULA_0225 0 0.0 -50.0 60.0 READ_WRITE ECU_ADDRESS 0x3FBE08 /end MEASUREMENT
/begin MEASUREMENT kr_dtz_int_zyl9 "Klopfreglungseingriff (intern)." SLONG FORMULA_0225 0 0.0 -50.0 60.0 READ_WRITE ECU_ADDRESS 0x3FBE0C /end MEASUREMENT
/begin MEASUREMENT kr_dtz_max "Maximal zulaessiger Klopfregelungseingriff." SWORD FORMULA_0102 0 0.0 -50.0 60.0 READ_WRITE ECU_ADDRESS 0x3FBD42 /end MEASUREMENT
/begin MEASUREMENT kr_dtz_mw_b1 "Mittelwert Klopfregelungseingriff." SWORD FORMULA_0102 0 0.0 -50.0 60.0 READ_WRITE ECU_ADDRESS 0x3FBD7C /end MEASUREMENT
/begin MEASUREMENT kr_dtz_mw_b2 "Mittelwert Klopfregelungseingriff." SWORD FORMULA_0102 0 0.0 -50.0 60.0 READ_WRITE ECU_ADDRESS 0x3FBD7E /end MEASUREMENT
/begin MEASUREMENT kr_dtz_sum_all "Klopfregelungseingriffsumme." SLONG FORMULA_0226 0 0.0 -100.0 100.0 READ_WRITE ECU_ADDRESS 0x3FBDE8 /end MEASUREMENT
/begin MEASUREMENT kr_dtz_zyl1 "Klopfreglungseingriff." SWORD FORMULA_0102 0 0.0 -50.0 60.0 READ_WRITE ECU_ADDRESS 0x3FBDAC /end MEASUREMENT
/begin MEASUREMENT kr_dtz_zyl10 "Klopfreglungseingriff." SWORD FORMULA_0102 0 0.0 -50.0 60.0 READ_WRITE ECU_ADDRESS 0x3FBDBE /end MEASUREMENT
/begin MEASUREMENT kr_dtz_zyl2 "Klopfreglungseingriff." SWORD FORMULA_0102 0 0.0 -50.0 60.0 READ_WRITE ECU_ADDRESS 0x3FBDAE /end MEASUREMENT
/begin MEASUREMENT kr_dtz_zyl3 "Klopfreglungseingriff." SWORD FORMULA_0102 0 0.0 -50.0 60.0 READ_WRITE ECU_ADDRESS 0x3FBDB0 /end MEASUREMENT
/begin MEASUREMENT kr_dtz_zyl4 "Klopfreglungseingriff." SWORD FORMULA_0102 0 0.0 -50.0 60.0 READ_WRITE ECU_ADDRESS 0x3FBDB2 /end MEASUREMENT
/begin MEASUREMENT kr_dtz_zyl5 "Klopfreglungseingriff." SWORD FORMULA_0102 0 0.0 -50.0 60.0 READ_WRITE ECU_ADDRESS 0x3FBDB4 /end MEASUREMENT
/begin MEASUREMENT kr_dtz_zyl6 "Klopfreglungseingriff." SWORD FORMULA_0102 0 0.0 -50.0 60.0 READ_WRITE ECU_ADDRESS 0x3FBDB6 /end MEASUREMENT
/begin MEASUREMENT kr_dtz_zyl7 "Klopfreglungseingriff." SWORD FORMULA_0102 0 0.0 -50.0 60.0 READ_WRITE ECU_ADDRESS 0x3FBDB8 /end MEASUREMENT
/begin MEASUREMENT kr_dtz_zyl8 "Klopfreglungseingriff." SWORD FORMULA_0102 0 0.0 -50.0 60.0 READ_WRITE ECU_ADDRESS 0x3FBDBA /end MEASUREMENT
/begin MEASUREMENT kr_dtz_zyl9 "Klopfreglungseingriff." SWORD FORMULA_0102 0 0.0 -50.0 60.0 READ_WRITE ECU_ADDRESS 0x3FBDBC /end MEASUREMENT
/begin MEASUREMENT kr_fbs_avg_delta_zyl1 "Delta zum Mittelwert Engeriespektrum der Klopffrequenz." SWORD FORMULA_0733 0 0.0 0.0 74.43340301513672 READ_WRITE ECU_ADDRESS 0x3FBD84 /end MEASUREMENT
/begin MEASUREMENT kr_fbs_avg_delta_zyl10 "Delta zum Mittelwert Engeriespektrum der Klopffrequenz." SWORD FORMULA_0733 0 0.0 0.0 74.43340301513672 READ_WRITE ECU_ADDRESS 0x3FBD96 /end MEASUREMENT
/begin MEASUREMENT kr_fbs_avg_delta_zyl2 "Delta zum Mittelwert Engeriespektrum der Klopffrequenz." SWORD FORMULA_0733 0 0.0 0.0 74.43340301513672 READ_WRITE ECU_ADDRESS 0x3FBD86 /end MEASUREMENT
/begin MEASUREMENT kr_fbs_avg_delta_zyl3 "Delta zum Mittelwert Engeriespektrum der Klopffrequenz." SWORD FORMULA_0733 0 0.0 0.0 74.43340301513672 READ_WRITE ECU_ADDRESS 0x3FBD88 /end MEASUREMENT
/begin MEASUREMENT kr_fbs_avg_delta_zyl4 "Delta zum Mittelwert Engeriespektrum der Klopffrequenz." SWORD FORMULA_0733 0 0.0 0.0 74.43340301513672 READ_WRITE ECU_ADDRESS 0x3FBD8A /end MEASUREMENT
/begin MEASUREMENT kr_fbs_avg_delta_zyl5 "Delta zum Mittelwert Engeriespektrum der Klopffrequenz." SWORD FORMULA_0733 0 0.0 0.0 74.43340301513672 READ_WRITE ECU_ADDRESS 0x3FBD8C /end MEASUREMENT
/begin MEASUREMENT kr_fbs_avg_delta_zyl6 "Delta zum Mittelwert Engeriespektrum der Klopffrequenz." SWORD FORMULA_0733 0 0.0 0.0 74.43340301513672 READ_WRITE ECU_ADDRESS 0x3FBD8E /end MEASUREMENT
/begin MEASUREMENT kr_fbs_avg_delta_zyl7 "Delta zum Mittelwert Engeriespektrum der Klopffrequenz." SWORD FORMULA_0733 0 0.0 0.0 74.43340301513672 READ_WRITE ECU_ADDRESS 0x3FBD90 /end MEASUREMENT
/begin MEASUREMENT kr_fbs_avg_delta_zyl8 "Delta zum Mittelwert Engeriespektrum der Klopffrequenz." SWORD FORMULA_0733 0 0.0 0.0 74.43340301513672 READ_WRITE ECU_ADDRESS 0x3FBD92 /end MEASUREMENT
/begin MEASUREMENT kr_fbs_avg_delta_zyl9 "Delta zum Mittelwert Engeriespektrum der Klopffrequenz." SWORD FORMULA_0733 0 0.0 0.0 74.43340301513672 READ_WRITE ECU_ADDRESS 0x3FBD94 /end MEASUREMENT
/begin MEASUREMENT kr_fbs_avg_no_b1 "Anzahl der Arbeitsspiele fuer Mittelwertsbildung." UBYTE FORMULA_0003 0 0.0 0.0 255.0 READ_WRITE ECU_ADDRESS 0x3FBD0A /end MEASUREMENT
/begin MEASUREMENT kr_fbs_avg_no_b2 "Anzahl der Arbeitsspiele fuer Mittelwertsbildung." UBYTE FORMULA_0003 0 0.0 0.0 255.0 READ_WRITE ECU_ADDRESS 0x3FBD0B /end MEASUREMENT
/begin MEASUREMENT kr_fbs_avg_off_max_b1 "Zulaessiges Offset zum Mittelwert Engeriespektrum der Klopffrequenz." SWORD FORMULA_0733 0 0.0 0.0 74.43340301513672 READ_WRITE ECU_ADDRESS 0x3FBD6C /end MEASUREMENT
/begin MEASUREMENT kr_fbs_avg_off_max_b2 "Zulaessiges Offset zum Mittelwert Engeriespektrum der Klopffrequenz." SWORD FORMULA_0733 0 0.0 0.0 74.43340301513672 READ_WRITE ECU_ADDRESS 0x3FBD6E /end MEASUREMENT
/begin MEASUREMENT kr_fbs_avg_zyl1 "Mittelwert Engeriespektrum der Klopffrequenz." SWORD FORMULA_0733 0 0.0 0.0 74.43340301513672 READ_WRITE ECU_ADDRESS 0x3FBD98 /end MEASUREMENT
/begin MEASUREMENT kr_fbs_avg_zyl10 "Mittelwert Engeriespektrum der Klopffrequenz." SWORD FORMULA_0733 0 0.0 0.0 74.43340301513672 READ_WRITE ECU_ADDRESS 0x3FBDAA /end MEASUREMENT
/begin MEASUREMENT kr_fbs_avg_zyl2 "Mittelwert Engeriespektrum der Klopffrequenz." SWORD FORMULA_0733 0 0.0 0.0 74.43340301513672 READ_WRITE ECU_ADDRESS 0x3FBD9A /end MEASUREMENT
/begin MEASUREMENT kr_fbs_avg_zyl3 "Mittelwert Engeriespektrum der Klopffrequenz." SWORD FORMULA_0733 0 0.0 0.0 74.43340301513672 READ_WRITE ECU_ADDRESS 0x3FBD9C /end MEASUREMENT
/begin MEASUREMENT kr_fbs_avg_zyl4 "Mittelwert Engeriespektrum der Klopffrequenz." SWORD FORMULA_0733 0 0.0 0.0 74.43340301513672 READ_WRITE ECU_ADDRESS 0x3FBD9E /end MEASUREMENT
/begin MEASUREMENT kr_fbs_avg_zyl5 "Mittelwert Engeriespektrum der Klopffrequenz." SWORD FORMULA_0733 0 0.0 0.0 74.43340301513672 READ_WRITE ECU_ADDRESS 0x3FBDA0 /end MEASUREMENT
/begin MEASUREMENT kr_fbs_avg_zyl6 "Mittelwert Engeriespektrum der Klopffrequenz." SWORD FORMULA_0733 0 0.0 0.0 74.43340301513672 READ_WRITE ECU_ADDRESS 0x3FBDA2 /end MEASUREMENT
/begin MEASUREMENT kr_fbs_avg_zyl7 "Mittelwert Engeriespektrum der Klopffrequenz." SWORD FORMULA_0733 0 0.0 0.0 74.43340301513672 READ_WRITE ECU_ADDRESS 0x3FBDA4 /end MEASUREMENT
/begin MEASUREMENT kr_fbs_avg_zyl8 "Mittelwert Engeriespektrum der Klopffrequenz." SWORD FORMULA_0733 0 0.0 0.0 74.43340301513672 READ_WRITE ECU_ADDRESS 0x3FBDA6 /end MEASUREMENT
/begin MEASUREMENT kr_fbs_avg_zyl9 "Mittelwert Engeriespektrum der Klopffrequenz." SWORD FORMULA_0733 0 0.0 0.0 74.43340301513672 READ_WRITE ECU_ADDRESS 0x3FBDA8 /end MEASUREMENT
/begin MEASUREMENT kr_fbs_zyl1 "Engeriespektrum der Klopffrequenz." SWORD FORMULA_0733 0 0.0 0.0 74.43340301513672 READ_WRITE ECU_ADDRESS 0x3FBDC0 /end MEASUREMENT
/begin MEASUREMENT kr_fbs_zyl10 "Engeriespektrum der Klopffrequenz." SWORD FORMULA_0733 0 0.0 0.0 74.43340301513672 READ_WRITE ECU_ADDRESS 0x3FBDD2 /end MEASUREMENT
/begin MEASUREMENT kr_fbs_zyl2 "Engeriespektrum der Klopffrequenz." SWORD FORMULA_0733 0 0.0 0.0 74.43340301513672 READ_WRITE ECU_ADDRESS 0x3FBDC2 /end MEASUREMENT
/begin MEASUREMENT kr_fbs_zyl3 "Engeriespektrum der Klopffrequenz." SWORD FORMULA_0733 0 0.0 0.0 74.43340301513672 READ_WRITE ECU_ADDRESS 0x3FBDC4 /end MEASUREMENT
/begin MEASUREMENT kr_fbs_zyl4 "Engeriespektrum der Klopffrequenz." SWORD FORMULA_0733 0 0.0 0.0 74.43340301513672 READ_WRITE ECU_ADDRESS 0x3FBDC6 /end MEASUREMENT
/begin MEASUREMENT kr_fbs_zyl5 "Engeriespektrum der Klopffrequenz." SWORD FORMULA_0733 0 0.0 0.0 74.43340301513672 READ_WRITE ECU_ADDRESS 0x3FBDC8 /end MEASUREMENT
/begin MEASUREMENT kr_fbs_zyl6 "Engeriespektrum der Klopffrequenz." SWORD FORMULA_0733 0 0.0 0.0 74.43340301513672 READ_WRITE ECU_ADDRESS 0x3FBDCA /end MEASUREMENT
/begin MEASUREMENT kr_fbs_zyl7 "Engeriespektrum der Klopffrequenz." SWORD FORMULA_0733 0 0.0 0.0 74.43340301513672 READ_WRITE ECU_ADDRESS 0x3FBDCC /end MEASUREMENT
/begin MEASUREMENT kr_fbs_zyl8 "Engeriespektrum der Klopffrequenz." SWORD FORMULA_0733 0 0.0 0.0 74.43340301513672 READ_WRITE ECU_ADDRESS 0x3FBDCE /end MEASUREMENT
/begin MEASUREMENT kr_fbs_zyl9 "Engeriespektrum der Klopffrequenz." SWORD FORMULA_0733 0 0.0 0.0 74.43340301513672 READ_WRITE ECU_ADDRESS 0x3FBDD0 /end MEASUREMENT
/begin MEASUREMENT kr_hold_count_zyl1 "Zaehler fuer Haltephase." UBYTE FORMULA_0003 0 0.0 0.0 255.0 READ_WRITE ECU_ADDRESS 0x3FBD1B /end MEASUREMENT
/begin MEASUREMENT kr_hold_count_zyl10 "Zaehler fuer Haltephase." UBYTE FORMULA_0003 0 0.0 0.0 255.0 READ_WRITE ECU_ADDRESS 0x3FBD24 /end MEASUREMENT
/begin MEASUREMENT kr_hold_count_zyl2 "Zaehler fuer Haltephase." UBYTE FORMULA_0003 0 0.0 0.0 255.0 READ_WRITE ECU_ADDRESS 0x3FBD1C /end MEASUREMENT
/begin MEASUREMENT kr_hold_count_zyl3 "Zaehler fuer Haltephase." UBYTE FORMULA_0003 0 0.0 0.0 255.0 READ_WRITE ECU_ADDRESS 0x3FBD1D /end MEASUREMENT
/begin MEASUREMENT kr_hold_count_zyl4 "Zaehler fuer Haltephase." UBYTE FORMULA_0003 0 0.0 0.0 255.0 READ_WRITE ECU_ADDRESS 0x3FBD1E /end MEASUREMENT
/begin MEASUREMENT kr_hold_count_zyl5 "Zaehler fuer Haltephase." UBYTE FORMULA_0003 0 0.0 0.0 255.0 READ_WRITE ECU_ADDRESS 0x3FBD1F /end MEASUREMENT
/begin MEASUREMENT kr_hold_count_zyl6 "Zaehler fuer Haltephase." UBYTE FORMULA_0003 0 0.0 0.0 255.0 READ_WRITE ECU_ADDRESS 0x3FBD20 /end MEASUREMENT
/begin MEASUREMENT kr_hold_count_zyl7 "Zaehler fuer Haltephase." UBYTE FORMULA_0003 0 0.0 0.0 255.0 READ_WRITE ECU_ADDRESS 0x3FBD21 /end MEASUREMENT
/begin MEASUREMENT kr_hold_count_zyl8 "Zaehler fuer Haltephase." UBYTE FORMULA_0003 0 0.0 0.0 255.0 READ_WRITE ECU_ADDRESS 0x3FBD22 /end MEASUREMENT
/begin MEASUREMENT kr_hold_count_zyl9 "Zaehler fuer Haltephase." UBYTE FORMULA_0003 0 0.0 0.0 255.0 READ_WRITE ECU_ADDRESS 0x3FBD23 /end MEASUREMENT
/begin MEASUREMENT kr_int_avg_norm_zyl1 "Normierter Mittelwert vom Integral im Klopffenster." SWORD FORMULA_0442 0 0.0 0.0 3.299999952316284 READ_WRITE ECU_ADDRESS 0x3FBD58 /end MEASUREMENT
/begin MEASUREMENT kr_int_avg_norm_zyl10 "Normierter Mittelwert vom Integral im Klopffenster." SWORD FORMULA_0442 0 0.0 0.0 3.299999952316284 READ_WRITE ECU_ADDRESS 0x3FBD6A /end MEASUREMENT
/begin MEASUREMENT kr_int_avg_norm_zyl2 "Normierter Mittelwert vom Integral im Klopffenster." SWORD FORMULA_0442 0 0.0 0.0 3.299999952316284 READ_WRITE ECU_ADDRESS 0x3FBD5A /end MEASUREMENT
/begin MEASUREMENT kr_int_avg_norm_zyl3 "Normierter Mittelwert vom Integral im Klopffenster." SWORD FORMULA_0442 0 0.0 0.0 3.299999952316284 READ_WRITE ECU_ADDRESS 0x3FBD5C /end MEASUREMENT
/begin MEASUREMENT kr_int_avg_norm_zyl4 "Normierter Mittelwert vom Integral im Klopffenster." SWORD FORMULA_0442 0 0.0 0.0 3.299999952316284 READ_WRITE ECU_ADDRESS 0x3FBD5E /end MEASUREMENT
/begin MEASUREMENT kr_int_avg_norm_zyl5 "Normierter Mittelwert vom Integral im Klopffenster." SWORD FORMULA_0442 0 0.0 0.0 3.299999952316284 READ_WRITE ECU_ADDRESS 0x3FBD60 /end MEASUREMENT
/begin MEASUREMENT kr_int_avg_norm_zyl6 "Normierter Mittelwert vom Integral im Klopffenster." SWORD FORMULA_0442 0 0.0 0.0 3.299999952316284 READ_WRITE ECU_ADDRESS 0x3FBD62 /end MEASUREMENT
/begin MEASUREMENT kr_int_avg_norm_zyl7 "Normierter Mittelwert vom Integral im Klopffenster." SWORD FORMULA_0442 0 0.0 0.0 3.299999952316284 READ_WRITE ECU_ADDRESS 0x3FBD64 /end MEASUREMENT
/begin MEASUREMENT kr_int_avg_norm_zyl8 "Normierter Mittelwert vom Integral im Klopffenster." SWORD FORMULA_0442 0 0.0 0.0 3.299999952316284 READ_WRITE ECU_ADDRESS 0x3FBD66 /end MEASUREMENT
/begin MEASUREMENT kr_int_avg_norm_zyl9 "Normierter Mittelwert vom Integral im Klopffenster." SWORD FORMULA_0442 0 0.0 0.0 3.299999952316284 READ_WRITE ECU_ADDRESS 0x3FBD68 /end MEASUREMENT
/begin MEASUREMENT kr_int_avg_zyl1 "Mittelwert vom Integral im Klopffenster." SWORD FORMULA_0442 0 0.0 0.0 3.299999952316284 READ_WRITE ECU_ADDRESS 0x3FBD44 /end MEASUREMENT
/begin MEASUREMENT kr_int_avg_zyl10 "Mittelwert vom Integral im Klopffenster." SWORD FORMULA_0442 0 0.0 0.0 3.299999952316284 READ_WRITE ECU_ADDRESS 0x3FBD56 /end MEASUREMENT
/begin MEASUREMENT kr_int_avg_zyl2 "Mittelwert vom Integral im Klopffenster." SWORD FORMULA_0442 0 0.0 0.0 3.299999952316284 READ_WRITE ECU_ADDRESS 0x3FBD46 /end MEASUREMENT
/begin MEASUREMENT kr_int_avg_zyl3 "Mittelwert vom Integral im Klopffenster." SWORD FORMULA_0442 0 0.0 0.0 3.299999952316284 READ_WRITE ECU_ADDRESS 0x3FBD48 /end MEASUREMENT
/begin MEASUREMENT kr_int_avg_zyl4 "Mittelwert vom Integral im Klopffenster." SWORD FORMULA_0442 0 0.0 0.0 3.299999952316284 READ_WRITE ECU_ADDRESS 0x3FBD4A /end MEASUREMENT
/begin MEASUREMENT kr_int_avg_zyl5 "Mittelwert vom Integral im Klopffenster." SWORD FORMULA_0442 0 0.0 0.0 3.299999952316284 READ_WRITE ECU_ADDRESS 0x3FBD4C /end MEASUREMENT
/begin MEASUREMENT kr_int_avg_zyl6 "Mittelwert vom Integral im Klopffenster." SWORD FORMULA_0442 0 0.0 0.0 3.299999952316284 READ_WRITE ECU_ADDRESS 0x3FBD4E /end MEASUREMENT
/begin MEASUREMENT kr_int_avg_zyl7 "Mittelwert vom Integral im Klopffenster." SWORD FORMULA_0442 0 0.0 0.0 3.299999952316284 READ_WRITE ECU_ADDRESS 0x3FBD50 /end MEASUREMENT
/begin MEASUREMENT kr_int_avg_zyl8 "Mittelwert vom Integral im Klopffenster." SWORD FORMULA_0442 0 0.0 0.0 3.299999952316284 READ_WRITE ECU_ADDRESS 0x3FBD52 /end MEASUREMENT
/begin MEASUREMENT kr_int_avg_zyl9 "Mittelwert vom Integral im Klopffenster." SWORD FORMULA_0442 0 0.0 0.0 3.299999952316284 READ_WRITE ECU_ADDRESS 0x3FBD54 /end MEASUREMENT
/begin MEASUREMENT kr_klipping_cnt_zyl1 "Zaehler Klipping im Klopffenster." UBYTE FORMULA_0003 0 0.0 0.0 255.0 READ_WRITE ECU_ADDRESS 0x3FBD2F /end MEASUREMENT
/begin MEASUREMENT kr_klipping_cnt_zyl10 "Zaehler Klipping im Klopffenster." UBYTE FORMULA_0003 0 0.0 0.0 255.0 READ_WRITE ECU_ADDRESS 0x3FBD38 /end MEASUREMENT
/begin MEASUREMENT kr_klipping_cnt_zyl2 "Zaehler Klipping im Klopffenster." UBYTE FORMULA_0003 0 0.0 0.0 255.0 READ_WRITE ECU_ADDRESS 0x3FBD30 /end MEASUREMENT
/begin MEASUREMENT kr_klipping_cnt_zyl3 "Zaehler Klipping im Klopffenster." UBYTE FORMULA_0003 0 0.0 0.0 255.0 READ_WRITE ECU_ADDRESS 0x3FBD31 /end MEASUREMENT
/begin MEASUREMENT kr_klipping_cnt_zyl4 "Zaehler Klipping im Klopffenster." UBYTE FORMULA_0003 0 0.0 0.0 255.0 READ_WRITE ECU_ADDRESS 0x3FBD32 /end MEASUREMENT
/begin MEASUREMENT kr_klipping_cnt_zyl5 "Zaehler Klipping im Klopffenster." UBYTE FORMULA_0003 0 0.0 0.0 255.0 READ_WRITE ECU_ADDRESS 0x3FBD33 /end MEASUREMENT
/begin MEASUREMENT kr_klipping_cnt_zyl6 "Zaehler Klipping im Klopffenster." UBYTE FORMULA_0003 0 0.0 0.0 255.0 READ_WRITE ECU_ADDRESS 0x3FBD34 /end MEASUREMENT
/begin MEASUREMENT kr_klipping_cnt_zyl7 "Zaehler Klipping im Klopffenster." UBYTE FORMULA_0003 0 0.0 0.0 255.0 READ_WRITE ECU_ADDRESS 0x3FBD35 /end MEASUREMENT
/begin MEASUREMENT kr_klipping_cnt_zyl8 "Zaehler Klipping im Klopffenster." UBYTE FORMULA_0003 0 0.0 0.0 255.0 READ_WRITE ECU_ADDRESS 0x3FBD36 /end MEASUREMENT
/begin MEASUREMENT kr_klipping_cnt_zyl9 "Zaehler Klipping im Klopffenster." UBYTE FORMULA_0003 0 0.0 0.0 255.0 READ_WRITE ECU_ADDRESS 0x3FBD37 /end MEASUREMENT
/begin MEASUREMENT kr_knock_laenge_b1 "Laenge des Klopffensters." SWORD FORMULA_0709 0 0.0 -360.0 359.8999938964844 READ_WRITE ECU_ADDRESS 0x3FBD78 /end MEASUREMENT
/begin MEASUREMENT kr_knock_laenge_b2 "Laenge des Klopffensters." SWORD FORMULA_0709 0 0.0 -360.0 359.8999938964844 READ_WRITE ECU_ADDRESS 0x3FBD7A /end MEASUREMENT
/begin MEASUREMENT kr_knock_tz_offs_b1 "Offsets vom Klopffensters gegenueber dem Zuendwinkel." SWORD FORMULA_0709 0 0.0 -360.0 359.8999938964844 READ_WRITE ECU_ADDRESS 0x3FBD74 /end MEASUREMENT
/begin MEASUREMENT kr_knock_tz_offs_b2 "Offsets vom Klopffensters gegenueber dem Zuendwinkel." SWORD FORMULA_0709 0 0.0 -360.0 359.8999938964844 READ_WRITE ECU_ADDRESS 0x3FBD76 /end MEASUREMENT
/begin MEASUREMENT kr_rf_min_b1 "Mindestfuellung fuer KR-Freigabe." SWORD FORMULA_0007 0 0.0 0.0 2.0 READ_WRITE ECU_ADDRESS 0x3FBD70 /end MEASUREMENT
/begin MEASUREMENT kr_rf_min_b2 "Mindestfuellung fuer KR-Freigabe." SWORD FORMULA_0007 0 0.0 0.0 2.0 READ_WRITE ECU_ADDRESS 0x3FBD72 /end MEASUREMENT
/begin MEASUREMENT kr_sst_fbs12_zyl1 "SST" ULONG FORMULA_0000 0 0.0 0.0 4294967295.0 READ_WRITE ECU_ADDRESS 0x3FBE64 /end MEASUREMENT
/begin MEASUREMENT kr_sst_fbs12_zyl10 "SST" ULONG FORMULA_0000 0 0.0 0.0 4294967295.0 READ_WRITE ECU_ADDRESS 0x3FBE88 /end MEASUREMENT
/begin MEASUREMENT kr_sst_fbs12_zyl2 "SST" ULONG FORMULA_0000 0 0.0 0.0 4294967295.0 READ_WRITE ECU_ADDRESS 0x3FBE68 /end MEASUREMENT
/begin MEASUREMENT kr_sst_fbs12_zyl3 "SST" ULONG FORMULA_0000 0 0.0 0.0 4294967295.0 READ_WRITE ECU_ADDRESS 0x3FBE6C /end MEASUREMENT
/begin MEASUREMENT kr_sst_fbs12_zyl4 "SST" ULONG FORMULA_0000 0 0.0 0.0 4294967295.0 READ_WRITE ECU_ADDRESS 0x3FBE70 /end MEASUREMENT
/begin MEASUREMENT kr_sst_fbs12_zyl5 "SST" ULONG FORMULA_0000 0 0.0 0.0 4294967295.0 READ_WRITE ECU_ADDRESS 0x3FBE74 /end MEASUREMENT
/begin MEASUREMENT kr_sst_fbs12_zyl6 "SST" ULONG FORMULA_0000 0 0.0 0.0 4294967295.0 READ_WRITE ECU_ADDRESS 0x3FBE78 /end MEASUREMENT
/begin MEASUREMENT kr_sst_fbs12_zyl7 "SST" ULONG FORMULA_0000 0 0.0 0.0 4294967295.0 READ_WRITE ECU_ADDRESS 0x3FBE7C /end MEASUREMENT
/begin MEASUREMENT kr_sst_fbs12_zyl8 "SST" ULONG FORMULA_0000 0 0.0 0.0 4294967295.0 READ_WRITE ECU_ADDRESS 0x3FBE80 /end MEASUREMENT
/begin MEASUREMENT kr_sst_fbs12_zyl9 "SST" ULONG FORMULA_0000 0 0.0 0.0 4294967295.0 READ_WRITE ECU_ADDRESS 0x3FBE84 /end MEASUREMENT
/begin MEASUREMENT kr_st_b1 "Status Klopfregelung." UBYTE FORMULA_0710 0 0.0 0.0 255.0 READ_WRITE ECU_ADDRESS 0x3FBD0C /end MEASUREMENT
/begin MEASUREMENT kr_st_b2 "Status Klopfregelung." UBYTE FORMULA_0710 0 0.0 0.0 255.0 READ_WRITE ECU_ADDRESS 0x3FBD0D /end MEASUREMENT
/begin MEASUREMENT kr_st_erk "Status Klopferkennung ueber Mittelwert." UWORD FORMULA_0712 0 0.0 0.0 4095.0 READ_WRITE ECU_ADDRESS 0x3FBD3A /end MEASUREMENT
/begin MEASUREMENT kr_st_erk_zyl1 "Status Klopferkennung ueber Mittelwert 1." UWORD FORMULA_0713 0 0 0.0 255.0 READ_WRITE BIT_MASK 0x1 ECU_ADDRESS 0x3FBD3A /end MEASUREMENT
/begin MEASUREMENT kr_st_erk_zyl10 "Status Klopferkennung ueber Mittelwert 10." UWORD FORMULA_0722 0 0 0.0 255.0 READ_WRITE BIT_MASK 0x200 ECU_ADDRESS 0x3FBD3A /end MEASUREMENT
/begin MEASUREMENT kr_st_erk_zyl2 "Status Klopferkennung ueber Mittelwert 2." UWORD FORMULA_0714 0 0 0.0 255.0 READ_WRITE BIT_MASK 0x2 ECU_ADDRESS 0x3FBD3A /end MEASUREMENT
/begin MEASUREMENT kr_st_erk_zyl3 "Status Klopferkennung ueber Mittelwert 3." UWORD FORMULA_0715 0 0 0.0 255.0 READ_WRITE BIT_MASK 0x4 ECU_ADDRESS 0x3FBD3A /end MEASUREMENT
/begin MEASUREMENT kr_st_erk_zyl4 "Status Klopferkennung ueber Mittelwert 4." UWORD FORMULA_0716 0 0 0.0 255.0 READ_WRITE BIT_MASK 0x8 ECU_ADDRESS 0x3FBD3A /end MEASUREMENT
/begin MEASUREMENT kr_st_erk_zyl5 "Status Klopferkennung ueber Mittelwert 5." UWORD FORMULA_0717 0 0 0.0 255.0 READ_WRITE BIT_MASK 0x10 ECU_ADDRESS 0x3FBD3A /end MEASUREMENT
/begin MEASUREMENT kr_st_erk_zyl6 "Status Klopferkennung ueber Mittelwert 6." UWORD FORMULA_0718 0 0 0.0 255.0 READ_WRITE BIT_MASK 0x20 ECU_ADDRESS 0x3FBD3A /end MEASUREMENT
/begin MEASUREMENT kr_st_erk_zyl7 "Status Klopferkennung ueber Mittelwert 7." UWORD FORMULA_0719 0 0 0.0 255.0 READ_WRITE BIT_MASK 0x40 ECU_ADDRESS 0x3FBD3A /end MEASUREMENT
/begin MEASUREMENT kr_st_erk_zyl8 "Status Klopferkennung ueber Mittelwert 8." UWORD FORMULA_0720 0 0 0.0 255.0 READ_WRITE BIT_MASK 0x80 ECU_ADDRESS 0x3FBD3A /end MEASUREMENT
/begin MEASUREMENT kr_st_erk_zyl9 "Status Klopferkennung ueber Mittelwert 9." UWORD FORMULA_0721 0 0 0.0 255.0 READ_WRITE BIT_MASK 0x100 ECU_ADDRESS 0x3FBD3A /end MEASUREMENT
/begin MEASUREMENT kus_gang "Gang mit Zwischenstufen, Kupplungsschlupfregelung" SWORD FORMULA_0073 0 0.0 -1.0 10.0 READ_WRITE ECU_ADDRESS 0x3FBE94 /end MEASUREMENT
/begin MEASUREMENT kus_n_getr_ein_alt "Getriebeeingangsdrehzahl" SWORD FORMULA_0006 0 0.0 0.0 12000.0 READ_WRITE ECU_ADDRESS 0x3FBE96 /end MEASUREMENT
/begin MEASUREMENT kus_n_max "maximale Motordrehzahl, Kupplungsschlupfregelung" SWORD FORMULA_0006 0 0.0 0.0 10000.0 READ_WRITE ECU_ADDRESS 0x3FBE90 /end MEASUREMENT
/begin MEASUREMENT kus_n_schlupf "Kupplungsschlupf" SWORD FORMULA_0006 0 0.0 -10000.0 10000.0 READ_WRITE ECU_ADDRESS 0x3FBE92 /end MEASUREMENT
/begin MEASUREMENT kus_st "Status Kupplungsschlupf-Funktion" UBYTE FORMULA_0037 0 0.0 0.0 255.0 READ_WRITE ECU_ADDRESS 0x3FBE8C /end MEASUREMENT
/begin MEASUREMENT kus_st_enable "Status Kupplungsschlupf-Funktion Enable" UBYTE FORMULA_0735 0 0 0.0 255.0 READ_WRITE BIT_MASK 0x1 ECU_ADDRESS 0x3FBE8C /end MEASUREMENT
/begin MEASUREMENT kus_timer "Timer Motor Teillast oder Volllast" UWORD FORMULA_0109 0 0.0 0.0 150.0 READ_WRITE ECU_ADDRESS 0x3FBE8E /end MEASUREMENT
/begin MEASUREMENT laz_aq_rf_b1 "LAZ-Fuellung aus inv. Ipol gefiltert mit alle korrekturen" SWORD FORMULA_0007 0 0.0 0.0 2.0 READ_WRITE ECU_ADDRESS 0x3FBFAC /end MEASUREMENT
/begin MEASUREMENT laz_aq_rf_b2 "LAZ-Fuellung aus inv. Ipol gefiltert mit alle korrekturen" SWORD FORMULA_0007 0 0.0 0.0 2.0 READ_WRITE ECU_ADDRESS 0x3FBFAE /end MEASUREMENT
/begin MEASUREMENT laz_idx_b1 "Index Counter" UBYTE FORMULA_0037 0 0.0 0.0 255.0 READ_WRITE ECU_ADDRESS 0x3FBFA0 /end MEASUREMENT
/begin MEASUREMENT laz_idx_b2 "Index Counter" UBYTE FORMULA_0037 0 0.0 0.0 255.0 READ_WRITE ECU_ADDRESS 0x3FBFA1 /end MEASUREMENT
/begin MEASUREMENT laz_md_rf_soll "Verzoegertes md_rf_soll" SWORD FORMULA_0007 0 0.0 0.0 2.0 READ_WRITE ECU_ADDRESS 0x3FBFA4 /end MEASUREMENT
/begin MEASUREMENT laz_md_rf_soll_pt_roh "LAZ-Soll-rf mit pt-Korr" SWORD FORMULA_0007 0 0.0 0.0 2.0 READ_WRITE ECU_ADDRESS 0x3FBFA6 /end MEASUREMENT
/begin MEASUREMENT laz_n_lw_b1 "LAZ-Ladungswechseldrehzahloffset." SWORD FORMULA_0006 0 0.0 0.0 10000.0 READ_WRITE ECU_ADDRESS 0x3FBFA8 /end MEASUREMENT
/begin MEASUREMENT laz_n_lw_b2 "LAZ-Ladungswechseldrehzahloffset." SWORD FORMULA_0006 0 0.0 0.0 10000.0 READ_WRITE ECU_ADDRESS 0x3FBFAA /end MEASUREMENT
/begin MEASUREMENT laz_rf_hfm_b1 "LAZ-relative Fuellung aus HFM" SWORD FORMULA_0007 0 0.0 0.0 2.0 READ_WRITE ECU_ADDRESS 0x3FBFB0 /end MEASUREMENT
/begin MEASUREMENT laz_rf_hfm_b2 "LAZ-relative Fuellung aus HFM" SWORD FORMULA_0007 0 0.0 0.0 2.0 READ_WRITE ECU_ADDRESS 0x3FBFB2 /end MEASUREMENT
/begin MEASUREMENT laz_tau "Filterkonstante TAU" UBYTE FORMULA_0470 0 0.0 5.100000184029341e-003 1.279999971389771 READ_WRITE ECU_ADDRESS 0x3FBFA2 /end MEASUREMENT
/begin MEASUREMENT llr_ad_flags "Zustand" UBYTE FORMULA_0003 0 0.0 0.0 255.0 READ_WRITE ECU_ADDRESS 0x3FBFF1 /end MEASUREMENT
/begin MEASUREMENT llr_ad_i_smooth "Mittelwert I-Anteil" SWORD FORMULA_0009 0 0.0 -50.0 50.0 READ_WRITE ECU_ADDRESS 0x3FBFF2 /end MEASUREMENT
/begin MEASUREMENT llr_ad_md "aktueller Adaptionwert" SWORD FORMULA_0009 0 0.0 -50.0 50.0 READ_WRITE ECU_ADDRESS 0x3FBFF4 /end MEASUREMENT
/begin MEASUREMENT llr_ad_timer "Timer" UWORD FORMULA_0071 0 0.0 0.0 6553.5 READ_WRITE ECU_ADDRESS 0x3FBFF6 /end MEASUREMENT
/begin MEASUREMENT llr_ad_zustand "Zustand" UBYTE FORMULA_0752 0 0.0 0.0 255.0 READ_WRITE ECU_ADDRESS 0x3FBFF0 /end MEASUREMENT
/begin MEASUREMENT llr_diag_flags "Diagnose Flags" UBYTE FORMULA_0003 0 0.0 0.0 255.0 READ_WRITE ECU_ADDRESS 0x3FBFB7 /end MEASUREMENT
/begin MEASUREMENT llr_diag_flags_css "Diagnose Flags" UBYTE FORMULA_0740 0 0 0.0 255.0 READ_WRITE BIT_MASK 0x1 ECU_ADDRESS 0x3FBFB7 /end MEASUREMENT
/begin MEASUREMENT llr_diag_state "Diagnose Status" UBYTE FORMULA_0738 0 0.0 0.0 255.0 READ_WRITE ECU_ADDRESS 0x3FBFB5 /end MEASUREMENT
/begin MEASUREMENT llr_diag_timer "Diagnose-Timer" UBYTE FORMULA_0492 0 0.0 0.0 25.5 READ_WRITE ECU_ADDRESS 0x3FBFE9 /end MEASUREMENT
/begin MEASUREMENT llr_diag_timer_io "Diagnose-Timer iO" UBYTE FORMULA_0492 0 0.0 0.0 25.5 READ_WRITE ECU_ADDRESS 0x3FBFEA /end MEASUREMENT
/begin MEASUREMENT llr_exd_state "Exd-State" UBYTE FORMULA_0739 0 0.0 0.0 255.0 READ_WRITE ECU_ADDRESS 0x3FBFB6 /end MEASUREMENT
/begin MEASUREMENT llr_md_d "einmaliger D-Anteil" SWORD FORMULA_0009 0 0.0 -50.0 50.0 READ_WRITE ECU_ADDRESS 0x3FBFDA /end MEASUREMENT
/begin MEASUREMENT llr_md_d_roh "einmaliger D-Anteil ohne Begr" SWORD FORMULA_0009 0 0.0 -50.0 50.0 READ_WRITE ECU_ADDRESS 0x3FBFD8 /end MEASUREMENT
/begin MEASUREMENT llr_md_i "I-Anteil" SWORD FORMULA_0009 0 0.0 -50.0 50.0 READ_WRITE ECU_ADDRESS 0x3FBFD2 /end MEASUREMENT
/begin MEASUREMENT llr_md_i_max "max. I-Anteil" SWORD FORMULA_0009 0 0.0 -100.0 0.0 READ_WRITE ECU_ADDRESS 0x3FBFCE /end MEASUREMENT
/begin MEASUREMENT llr_md_i_max_e2 "max. I-Anteil Ebene 2" SWORD FORMULA_0009 0 0.0 -100.0 1000.0 READ_WRITE ECU_ADDRESS 0x3FC824 /end MEASUREMENT
/begin MEASUREMENT llr_md_i_min "min. I-Anteil" SWORD FORMULA_0009 0 0.0 -100.0 0.0 READ_WRITE ECU_ADDRESS 0x3FBFCC /end MEASUREMENT
/begin MEASUREMENT llr_md_p "P-Anteil (inaktiv)" SWORD FORMULA_0009 0 0.0 -50.0 50.0 READ_WRITE ECU_ADDRESS 0x3FBFD0 /end MEASUREMENT
/begin MEASUREMENT llr_md_res "LLR-Reserve" SWORD FORMULA_0009 0 0.0 0.0 100.0 READ_WRITE ECU_ADDRESS 0x3FBFDC /end MEASUREMENT
/begin MEASUREMENT llr_md_schw_ist "Istmoment" SWORD FORMULA_0009 0 0.0 -100.0 1000.0 READ_WRITE ECU_ADDRESS 0x3FBFE2 /end MEASUREMENT
/begin MEASUREMENT llr_md_tz "LLR TZ-Eingriff" SWORD FORMULA_0009 0 0.0 -40.0 40.0 READ_WRITE ECU_ADDRESS 0x3FBFDE /end MEASUREMENT
/begin MEASUREMENT llr_md_tz_fil "LLR TZ-Eingriff gefiltert" SWORD FORMULA_0009 0 0.0 -40.0 40.0 READ_WRITE ECU_ADDRESS 0x3FBFE4 /end MEASUREMENT
/begin MEASUREMENT llr_md_tz_rueck "LLR TZ-Rueckfuehrung" SWORD FORMULA_0742 0 0.0 -15.0 15.0 READ_WRITE ECU_ADDRESS 0x3FBFE6 /end MEASUREMENT
/begin MEASUREMENT llr_n_diff "Regeldifferenz" SWORD FORMULA_0006 0 0.0 -10000.0 10000.0 READ_WRITE ECU_ADDRESS 0x3FBFC8 /end MEASUREMENT
/begin MEASUREMENT llr_n_diff_nachf "nachgef. Regeldifferenz" SWORD FORMULA_0006 0 0.0 -10000.0 10000.0 READ_WRITE ECU_ADDRESS 0x3FBFCA /end MEASUREMENT
/begin MEASUREMENT llr_n_soll_diff_e2 "Regeldifferenz Ebene 2" SWORD FORMULA_0006 0 0.0 0.0 10000.0 READ_WRITE ECU_ADDRESS 0x3FC822 /end MEASUREMENT
/begin MEASUREMENT llr_n_soll_exd "Exd-Solldrehzahl" SWORD FORMULA_0006 0 0.0 0.0 10000.0 READ_WRITE ECU_ADDRESS 0x3FBFBE /end MEASUREMENT
/begin MEASUREMENT llr_n_soll_fil "gefilt. Leerlaufsolldrehzahl" SWORD FORMULA_0006 0 0.0 0.0 10000.0 READ_WRITE ECU_ADDRESS 0x3FBFC4 /end MEASUREMENT
/begin MEASUREMENT llr_n_soll_kh "KH-Einfluss" SWORD FORMULA_0006 0 0.0 0.0 10000.0 READ_WRITE ECU_ADDRESS 0x3FBFC0 /end MEASUREMENT
/begin MEASUREMENT llr_n_soll_kh_fil "KH-Einfluss gefiltert" SWORD FORMULA_0006 0 0.0 0.0 10000.0 READ_WRITE ECU_ADDRESS 0x3FBFC2 /end MEASUREMENT
/begin MEASUREMENT llr_n_soll_kkos "Tmot, Toel und KKOS-Einfluss" SWORD FORMULA_0006 0 0.0 0.0 10000.0 READ_WRITE ECU_ADDRESS 0x3FBFBC /end MEASUREMENT
/begin MEASUREMENT llr_n_soll_nachf "nachgeführte Leerlaufsolldrehzahl" SWORD FORMULA_0006 0 0.0 0.0 10000.0 READ_WRITE ECU_ADDRESS 0x3FBFC6 /end MEASUREMENT
/begin MEASUREMENT llr_n_soll_tmot "Tmot-Einfluss" SWORD FORMULA_0006 0 0.0 0.0 10000.0 READ_WRITE ECU_ADDRESS 0x3FBFB8 /end MEASUREMENT
/begin MEASUREMENT llr_n_soll_toel "Toel-Einfluss" SWORD FORMULA_0006 0 0.0 0.0 10000.0 READ_WRITE ECU_ADDRESS 0x3FBFBA /end MEASUREMENT
/begin MEASUREMENT llr_omega_grad_ist "Omega" SWORD FORMULA_0741 0 0.0 -327.6799926757813 327.6700134277344 READ_WRITE ECU_ADDRESS 0x3FBFE0 /end MEASUREMENT
/begin MEASUREMENT llr_plausi_e2_err "Anzahl der Plausi-Fehler" UBYTE FORMULA_0003 0 0.0 0.0 255.0 READ_WRITE ECU_ADDRESS 0x3FC820 /end MEASUREMENT
/begin MEASUREMENT llr_timer "interner LLR-Timer" UBYTE FORMULA_0357 0 0.0 0.0 1.274999976158142 READ_WRITE ECU_ADDRESS 0x3FBFE8 /end MEASUREMENT
/begin MEASUREMENT lu_win_time_b1 "Messfensterzeit." ULONG FORMULA_0017 0 0.0 0.0 1198.3724 READ_WRITE ECU_ADDRESS 0x3FBFF8 /end MEASUREMENT
/begin MEASUREMENT lu_win_time_b2 "Messfensterzeit." ULONG FORMULA_0017 0 0.0 0.0 1198.3724 READ_WRITE ECU_ADDRESS 0x3FBFFC /end MEASUREMENT
/begin MEASUREMENT md_abtrieb_bremse "Bremsabtriebsmoment" SLONG FORMULA_0272 0 0.0 -1500.0 10000.0 READ_WRITE ECU_ADDRESS 0x3FC120 /end MEASUREMENT
/begin MEASUREMENT md_abtrieb_ist "Abtriebsistmoment" SWORD FORMULA_0009 0 0.0 -1000.0 2000.0 READ_WRITE ECU_ADDRESS 0x3FC904 /end MEASUREMENT
/begin MEASUREMENT md_abtrieb_max "Max. Abtriebsmoment" SWORD FORMULA_0009 0 0.0 -1000.0 2000.0 READ_WRITE ECU_ADDRESS 0x3FC0FE /end MEASUREMENT
/begin MEASUREMENT md_abtrieb_min "Min. Abtriebsmoment" SWORD FORMULA_0009 0 0.0 -1000.0 2000.0 READ_WRITE ECU_ADDRESS 0x3FC0FC /end MEASUREMENT
/begin MEASUREMENT md_abtrieb_neg "neg. Abtriebswunsch" SWORD FORMULA_0009 0 0.0 -1000.0 2000.0 READ_WRITE ECU_ADDRESS 0x3FC10A /end MEASUREMENT
/begin MEASUREMENT md_abtrieb_pos "pos. Abtriebswunsch" SWORD FORMULA_0009 0 0.0 -1000.0 2000.0 READ_WRITE ECU_ADDRESS 0x3FC10C /end MEASUREMENT
/begin MEASUREMENT md_abtrieb_pos_rel "rel. Abtriebswunsch" SWORD FORMULA_0001 0 0.0 0.0 100.0 READ_WRITE ECU_ADDRESS 0x3FC108 /end MEASUREMENT
/begin MEASUREMENT md_abtrieb_pos_rel_fgr "rel. Abtriebswunsch vom FGR" SWORD FORMULA_0001 0 0.0 0.0 100.0 READ_WRITE ECU_ADDRESS 0x3FC906 /end MEASUREMENT
/begin MEASUREMENT md_abtrieb_steigung "Steigungseinfluss" SWORD FORMULA_0009 0 0.0 -1000.0 2000.0 READ_WRITE ECU_ADDRESS 0x3FC110 /end MEASUREMENT
/begin MEASUREMENT md_abtrieb_wunsch "Abtriebswunsch" SWORD FORMULA_0009 0 0.0 -1000.0 2000.0 READ_WRITE ECU_ADDRESS 0x3FC10E /end MEASUREMENT
/begin MEASUREMENT md_i_getr_md_max "Uebersetzung fuer PEMAX" UWORD FORMULA_0073 0 0.0 0.0 15.0 READ_WRITE ECU_ADDRESS 0x3FC128 /end MEASUREMENT
/begin MEASUREMENT md_i_getr_md_min "Uebersetzung fuer PVMAX" UWORD FORMULA_0073 0 0.0 0.0 15.0 READ_WRITE ECU_ADDRESS 0x3FC126 /end MEASUREMENT
/begin MEASUREMENT md_idx_fp "Umnormierter FP-Index" SWORD FORMULA_0073 0 0.0 -1.0 1.0 READ_WRITE ECU_ADDRESS 0x3FC12A /end MEASUREMENT
/begin MEASUREMENT md_ipm_n_opt_max "Drehzahl" SWORD FORMULA_0006 0 0.0 0.0 10000.0 READ_WRITE ECU_ADDRESS 0x3FC0FA /end MEASUREMENT
/begin MEASUREMENT md_ipm_pwg_diff "Differenz" SWORD FORMULA_0001 0 0.0 -10.0 120.0 READ_WRITE ECU_ADDRESS 0x3FC102 /end MEASUREMENT
/begin MEASUREMENT md_ipm_pwg_neg "neg. Fahrerwunsch" SWORD FORMULA_0001 0 0.0 -10.0 120.0 READ_WRITE ECU_ADDRESS 0x3FC106 /end MEASUREMENT
/begin MEASUREMENT md_ipm_pwg_null "Nulllinie" SWORD FORMULA_0001 0 0.0 -10.0 120.0 READ_WRITE ECU_ADDRESS 0x3FC100 /end MEASUREMENT
/begin MEASUREMENT md_ipm_pwg_pos "pos. Fahrerwunsch" SWORD FORMULA_0001 0 0.0 -10.0 120.0 READ_WRITE ECU_ADDRESS 0x3FC104 /end MEASUREMENT
/begin MEASUREMENT md_ipm_st "IPM-Status" UBYTE FORMULA_0003 0 0.0 0.0 255.0 READ_WRITE ECU_ADDRESS 0x3FC0F8 /end MEASUREMENT
/begin MEASUREMENT md_kupp_wunsch_ipm "Kupplungswunschmoment IPM" SWORD FORMULA_0009 0 0.0 -100.0 1000.0 READ_WRITE ECU_ADDRESS 0x3FC124 /end MEASUREMENT
/begin MEASUREMENT md_kus_begr "effektive Motormomentenbegrenzung" SWORD FORMULA_0009 0 0.0 -100.0 1000.0 READ_WRITE ECU_ADDRESS 0x3FC144 /end MEASUREMENT
/begin MEASUREMENT md_kus_begr1 "effektive Motormomentenbegrenzung, PT1" SWORD FORMULA_0009 0 0.0 -100.0 1000.0 READ_WRITE ECU_ADDRESS 0x3FC142 /end MEASUREMENT
/begin MEASUREMENT md_kus_n_dif "Regelabweichung, Kupplungsschlupf" SWORD FORMULA_0006 0 0.0 0.0 10000.0 READ_WRITE ECU_ADDRESS 0x3FC12C /end MEASUREMENT
/begin MEASUREMENT md_kus_n_dif_verz1 "Regelabweichung, 1 x verzoegert, Kupplungsschlupf" SWORD FORMULA_0006 0 0.0 0.0 10000.0 READ_WRITE ECU_ADDRESS 0x3FC12E /end MEASUREMENT
/begin MEASUREMENT md_kus_n_dif_verz2 "Regelabweichung, 2 x verzoegert, Kupplungsschlupf" SWORD FORMULA_0006 0 0.0 0.0 10000.0 READ_WRITE ECU_ADDRESS 0x3FC130 /end MEASUREMENT
/begin MEASUREMENT md_kus_pid "Motormomentenbegrenzung des PID-Reglers" SWORD FORMULA_0009 0 0.0 -100.0 1000.0 READ_WRITE ECU_ADDRESS 0x3FC140 /end MEASUREMENT
/begin MEASUREMENT md_kus_pid_b0 "Koeffizient b0, PID-Regler" SLONG FORMULA_0795 0 0.0 -2147483.648 2147483.647 READ_WRITE ECU_ADDRESS 0x3FC134 /end MEASUREMENT
/begin MEASUREMENT md_kus_pid_b1 "Koeffizient b1, PID-Regler" SLONG FORMULA_0795 0 0.0 -2147483.648 2147483.647 READ_WRITE ECU_ADDRESS 0x3FC138 /end MEASUREMENT
/begin MEASUREMENT md_kus_pid_b2 "Koeffizient b2, PID-Regler" SLONG FORMULA_0795 0 0.0 -2147483.648 2147483.647 READ_WRITE ECU_ADDRESS 0x3FC13C /end MEASUREMENT
/begin MEASUREMENT md_kus_st_freigabe_alt "Status Kupplungsschlupf-Funktion" UBYTE FORMULA_0037 0 0.0 0.0 255.0 READ_WRITE ECU_ADDRESS 0x3FC146 /end MEASUREMENT
/begin MEASUREMENT md_kus_st_freigabe_alt_enable "Status Kupplungsschlupf-Funktion Enable" UBYTE FORMULA_0735 0 0 0.0 255.0 READ_WRITE BIT_MASK 0x1 ECU_ADDRESS 0x3FC146 /end MEASUREMENT
/begin MEASUREMENT md_rad_bremse "Bremsradmoment" SLONG FORMULA_0272 0 0.0 -1500.0 10000.0 READ_WRITE ECU_ADDRESS 0x3FC11C /end MEASUREMENT
/begin MEASUREMENT md_rad_steigung_fil "Steigung gefiltert" SWORD FORMULA_0009 0 0.0 -3200.0 3200.0 READ_WRITE ECU_ADDRESS 0x3FC118 /end MEASUREMENT
/begin MEASUREMENT md_rad_wunsch "Radsollmoment" SLONG FORMULA_0272 0 0.0 -1500.0 10000.0 READ_WRITE ECU_ADDRESS 0x3FC114 /end MEASUREMENT
/begin MEASUREMENT n_lw_a_b1 "Auslassladungswechseldrehzahl." SWORD FORMULA_0006 0 0.0 0.0 10000.0 READ_WRITE ECU_ADDRESS 0x3FC250 /end MEASUREMENT
/begin MEASUREMENT n_lw_a_b2 "Auslassladungswechseldrehzahl." SWORD FORMULA_0006 0 0.0 0.0 10000.0 READ_WRITE ECU_ADDRESS 0x3FC252 /end MEASUREMENT
/begin MEASUREMENT n_lw_a_wicht_b1 "Wichtung Auslassladungswechseldrehzahloffset." UWORD FORMULA_0073 0 0.0 0.0 4.0 READ_WRITE ECU_ADDRESS 0x3FC244 /end MEASUREMENT
/begin MEASUREMENT n_lw_a_wicht_b2 "Wichtung Auslassladungswechseldrehzahloffset." UWORD FORMULA_0073 0 0.0 0.0 4.0 READ_WRITE ECU_ADDRESS 0x3FC246 /end MEASUREMENT
/begin MEASUREMENT n_lw_e_b1 "Einlassladungswechseldrehzahl." SWORD FORMULA_0006 0 0.0 0.0 10000.0 READ_WRITE ECU_ADDRESS 0x3FC24C /end MEASUREMENT
/begin MEASUREMENT n_lw_e_b2 "Einlassladungswechseldrehzahl." SWORD FORMULA_0006 0 0.0 0.0 10000.0 READ_WRITE ECU_ADDRESS 0x3FC24E /end MEASUREMENT
/begin MEASUREMENT n_lw_e_wicht_b1 "Wichtung Einlassladungswechseldrehzahloffset." UWORD FORMULA_0073 0 0.0 0.0 4.0 READ_WRITE ECU_ADDRESS 0x3FC240 /end MEASUREMENT
/begin MEASUREMENT n_lw_e_wicht_b2 "Wichtung Einlassladungswechseldrehzahloffset." UWORD FORMULA_0073 0 0.0 0.0 4.0 READ_WRITE ECU_ADDRESS 0x3FC242 /end MEASUREMENT
/begin MEASUREMENT n_lw_n_sst6 "SST" ULONG FORMULA_0000 0 0.0 0.0 4294967295.0 READ_WRITE ECU_ADDRESS 0x3FC254 /end MEASUREMENT
/begin MEASUREMENT n_lw_rf_sst6_b1 "SST" ULONG FORMULA_0000 0 0.0 0.0 4294967295.0 READ_WRITE ECU_ADDRESS 0x3FC258 /end MEASUREMENT
/begin MEASUREMENT n_lw_rf_sst6_b2 "SST" ULONG FORMULA_0000 0 0.0 0.0 4294967295.0 READ_WRITE ECU_ADDRESS 0x3FC25C /end MEASUREMENT
/begin MEASUREMENT n_lw_tan_lw_verh_wurzel_b1 "Wurzel-Verhaeltnis der Einlassladungswechseltemperaturen." UWORD FORMULA_0073 0 0.0 0.0 4.0 READ_WRITE ECU_ADDRESS 0x3FC23C /end MEASUREMENT
/begin MEASUREMENT n_lw_tan_lw_verh_wurzel_b2 "Wurzel-Verhaeltnis der Einlassladungswechseltemperaturen." UWORD FORMULA_0073 0 0.0 0.0 4.0 READ_WRITE ECU_ADDRESS 0x3FC23E /end MEASUREMENT
/begin MEASUREMENT n_lw_wicht_b1 "Wichtung Ladungswechseldrehzahloffset." UWORD FORMULA_0073 0 0.0 0.0 4.0 READ_WRITE ECU_ADDRESS 0x3FC248 /end MEASUREMENT
/begin MEASUREMENT n_lw_wicht_b2 "Wichtung Ladungswechseldrehzahloffset." UWORD FORMULA_0073 0 0.0 0.0 4.0 READ_WRITE ECU_ADDRESS 0x3FC24A /end MEASUREMENT
/begin MEASUREMENT tka_ad "Eingelesener Spannungswert fuer Kuehlwasseraustrittstemperatur" SWORD FORMULA_0114 0 0.0 0.0 1023.0 READ_WRITE ECU_ADDRESS 0x3FC560 /end MEASUREMENT
/begin MEASUREMENT tka_filter "Gefilterter Messwert der Kuehlwasseraustrittstemperatur" SWORD FORMULA_0975 0 0.0 -50.0 170.0 READ_WRITE ECU_ADDRESS 0x3FC564 /end MEASUREMENT
/begin MEASUREMENT tka_obd_st "" UWORD FORMULA_0991 0 0.0 0.0 65535.0 READ_WRITE ECU_ADDRESS 0x3FC568 /end MEASUREMENT
/begin MEASUREMENT tka_obd_tmot_t "" UWORD FORMULA_0071 0 0.0 0.0 6553.5 READ_WRITE ECU_ADDRESS 0x3FC566 /end MEASUREMENT
/begin MEASUREMENT tka_roh "Ungefilterter Messwert der Kuehlwasseraustrittstemperatur" SWORD FORMULA_0975 0 0.0 -50.0 170.0 READ_WRITE ECU_ADDRESS 0x3FC562 /end MEASUREMENT
/begin MEASUREMENT vr_diag_st_zyl1 "Diagnose-Status der M-Spule." UBYTE FORMULA_1046 0 0.0 0.0 4.0 READ_WRITE ECU_ADDRESS 0x3FC780 /end MEASUREMENT
/begin MEASUREMENT vr_diag_st_zyl10 "Diagnose-Status der M-Spule." UBYTE FORMULA_1046 0 0.0 0.0 4.0 READ_WRITE ECU_ADDRESS 0x3FC789 /end MEASUREMENT
/begin MEASUREMENT vr_diag_st_zyl2 "Diagnose-Status der M-Spule." UBYTE FORMULA_1046 0 0.0 0.0 4.0 READ_WRITE ECU_ADDRESS 0x3FC781 /end MEASUREMENT
/begin MEASUREMENT vr_diag_st_zyl3 "Diagnose-Status der M-Spule." UBYTE FORMULA_1046 0 0.0 0.0 4.0 READ_WRITE ECU_ADDRESS 0x3FC782 /end MEASUREMENT
/begin MEASUREMENT vr_diag_st_zyl4 "Diagnose-Status der M-Spule." UBYTE FORMULA_1046 0 0.0 0.0 4.0 READ_WRITE ECU_ADDRESS 0x3FC783 /end MEASUREMENT
/begin MEASUREMENT vr_diag_st_zyl5 "Diagnose-Status der M-Spule." UBYTE FORMULA_1046 0 0.0 0.0 4.0 READ_WRITE ECU_ADDRESS 0x3FC784 /end MEASUREMENT
/begin MEASUREMENT vr_diag_st_zyl6 "Diagnose-Status der M-Spule." UBYTE FORMULA_1046 0 0.0 0.0 4.0 READ_WRITE ECU_ADDRESS 0x3FC785 /end MEASUREMENT
/begin MEASUREMENT vr_diag_st_zyl7 "Diagnose-Status der M-Spule." UBYTE FORMULA_1046 0 0.0 0.0 4.0 READ_WRITE ECU_ADDRESS 0x3FC786 /end MEASUREMENT
/begin MEASUREMENT vr_diag_st_zyl8 "Diagnose-Status der M-Spule." UBYTE FORMULA_1046 0 0.0 0.0 4.0 READ_WRITE ECU_ADDRESS 0x3FC787 /end MEASUREMENT
/begin MEASUREMENT vr_diag_st_zyl9 "Diagnose-Status der M-Spule." UBYTE FORMULA_1046 0 0.0 0.0 4.0 READ_WRITE ECU_ADDRESS 0x3FC788 /end MEASUREMENT
/begin MEASUREMENT vr_ist_zyl1 "Ist-Aussteuerung = TP-Maxwerte." SWORD FORMULA_0569 0 0.0 0.0 100.0 READ_WRITE ECU_ADDRESS 0x3FC7B2 /end MEASUREMENT
/begin MEASUREMENT vr_ist_zyl10 "Ist-Aussteuerung = TP-Maxwerte." SWORD FORMULA_0569 0 0.0 0.0 100.0 READ_WRITE ECU_ADDRESS 0x3FC7C4 /end MEASUREMENT
/begin MEASUREMENT vr_ist_zyl2 "Ist-Aussteuerung = TP-Maxwerte." SWORD FORMULA_0569 0 0.0 0.0 100.0 READ_WRITE ECU_ADDRESS 0x3FC7B4 /end MEASUREMENT
/begin MEASUREMENT vr_ist_zyl3 "Ist-Aussteuerung = TP-Maxwerte." SWORD FORMULA_0569 0 0.0 0.0 100.0 READ_WRITE ECU_ADDRESS 0x3FC7B6 /end MEASUREMENT
/begin MEASUREMENT vr_ist_zyl4 "Ist-Aussteuerung = TP-Maxwerte." SWORD FORMULA_0569 0 0.0 0.0 100.0 READ_WRITE ECU_ADDRESS 0x3FC7B8 /end MEASUREMENT
/begin MEASUREMENT vr_ist_zyl5 "Ist-Aussteuerung = TP-Maxwerte." SWORD FORMULA_0569 0 0.0 0.0 100.0 READ_WRITE ECU_ADDRESS 0x3FC7BA /end MEASUREMENT
/begin MEASUREMENT vr_ist_zyl6 "Ist-Aussteuerung = TP-Maxwerte." SWORD FORMULA_0569 0 0.0 0.0 100.0 READ_WRITE ECU_ADDRESS 0x3FC7BC /end MEASUREMENT
/begin MEASUREMENT vr_ist_zyl7 "Ist-Aussteuerung = TP-Maxwerte." SWORD FORMULA_0569 0 0.0 0.0 100.0 READ_WRITE ECU_ADDRESS 0x3FC7BE /end MEASUREMENT
/begin MEASUREMENT vr_ist_zyl8 "Ist-Aussteuerung = TP-Maxwerte." SWORD FORMULA_0569 0 0.0 0.0 100.0 READ_WRITE ECU_ADDRESS 0x3FC7C0 /end MEASUREMENT
/begin MEASUREMENT vr_ist_zyl9 "Ist-Aussteuerung = TP-Maxwerte." SWORD FORMULA_0569 0 0.0 0.0 100.0 READ_WRITE ECU_ADDRESS 0x3FC7C2 /end MEASUREMENT
/begin MEASUREMENT vr_mess_zyl1 "Messverstaerkung." SWORD FORMULA_0447 0 0.0 0.0 32.0 READ_WRITE ECU_ADDRESS 0x3FC7C6 /end MEASUREMENT
/begin MEASUREMENT vr_mess_zyl10 "Messverstaerkung." SWORD FORMULA_0447 0 0.0 0.0 32.0 READ_WRITE ECU_ADDRESS 0x3FC7D8 /end MEASUREMENT
/begin MEASUREMENT vr_mess_zyl2 "Messverstaerkung." SWORD FORMULA_0447 0 0.0 0.0 32.0 READ_WRITE ECU_ADDRESS 0x3FC7C8 /end MEASUREMENT
/begin MEASUREMENT vr_mess_zyl3 "Messverstaerkung." SWORD FORMULA_0447 0 0.0 0.0 32.0 READ_WRITE ECU_ADDRESS 0x3FC7CA /end MEASUREMENT
/begin MEASUREMENT vr_mess_zyl4 "Messverstaerkung." SWORD FORMULA_0447 0 0.0 0.0 32.0 READ_WRITE ECU_ADDRESS 0x3FC7CC /end MEASUREMENT
/begin MEASUREMENT vr_mess_zyl5 "Messverstaerkung." SWORD FORMULA_0447 0 0.0 0.0 32.0 READ_WRITE ECU_ADDRESS 0x3FC7CE /end MEASUREMENT
/begin MEASUREMENT vr_mess_zyl6 "Messverstaerkung." SWORD FORMULA_0447 0 0.0 0.0 32.0 READ_WRITE ECU_ADDRESS 0x3FC7D0 /end MEASUREMENT
/begin MEASUREMENT vr_mess_zyl7 "Messverstaerkung." SWORD FORMULA_0447 0 0.0 0.0 32.0 READ_WRITE ECU_ADDRESS 0x3FC7D2 /end MEASUREMENT
/begin MEASUREMENT vr_mess_zyl8 "Messverstaerkung." SWORD FORMULA_0447 0 0.0 0.0 32.0 READ_WRITE ECU_ADDRESS 0x3FC7D4 /end MEASUREMENT
/begin MEASUREMENT vr_mess_zyl9 "Messverstaerkung." SWORD FORMULA_0447 0 0.0 0.0 32.0 READ_WRITE ECU_ADDRESS 0x3FC7D6 /end MEASUREMENT
/begin MEASUREMENT vr_set_zyl1 "Verstaerkungsstufe." UBYTE FORMULA_1045 0 0.0 0.0 8.0 READ_WRITE ECU_ADDRESS 0x3FC776 /end MEASUREMENT
/begin MEASUREMENT vr_set_zyl10 "Verstaerkungsstufe." UBYTE FORMULA_1045 0 0.0 0.0 8.0 READ_WRITE ECU_ADDRESS 0x3FC77F /end MEASUREMENT
/begin MEASUREMENT vr_set_zyl2 "Verstaerkungsstufe." UBYTE FORMULA_1045 0 0.0 0.0 8.0 READ_WRITE ECU_ADDRESS 0x3FC777 /end MEASUREMENT
/begin MEASUREMENT vr_set_zyl3 "Verstaerkungsstufe." UBYTE FORMULA_1045 0 0.0 0.0 8.0 READ_WRITE ECU_ADDRESS 0x3FC778 /end MEASUREMENT
/begin MEASUREMENT vr_set_zyl4 "Verstaerkungsstufe." UBYTE FORMULA_1045 0 0.0 0.0 8.0 READ_WRITE ECU_ADDRESS 0x3FC779 /end MEASUREMENT
/begin MEASUREMENT vr_set_zyl5 "Verstaerkungsstufe." UBYTE FORMULA_1045 0 0.0 0.0 8.0 READ_WRITE ECU_ADDRESS 0x3FC77A /end MEASUREMENT
/begin MEASUREMENT vr_set_zyl6 "Verstaerkungsstufe." UBYTE FORMULA_1045 0 0.0 0.0 8.0 READ_WRITE ECU_ADDRESS 0x3FC77B /end MEASUREMENT
/begin MEASUREMENT vr_set_zyl7 "Verstaerkungsstufe." UBYTE FORMULA_1045 0 0.0 0.0 8.0 READ_WRITE ECU_ADDRESS 0x3FC77C /end MEASUREMENT
/begin MEASUREMENT vr_set_zyl8 "Verstaerkungsstufe." UBYTE FORMULA_1045 0 0.0 0.0 8.0 READ_WRITE ECU_ADDRESS 0x3FC77D /end MEASUREMENT
/begin MEASUREMENT vr_set_zyl9 "Verstaerkungsstufe." UBYTE FORMULA_1045 0 0.0 0.0 8.0 READ_WRITE ECU_ADDRESS 0x3FC77E /end MEASUREMENT
/begin MEASUREMENT vr_st "Zustandsvariable Verstaerkungsregeler." UWORD FORMULA_1034 0 0.0 0.0 1023.0 READ_WRITE ECU_ADDRESS 0x3FC770 /end MEASUREMENT
/begin MEASUREMENT vr_st_zyl1 "Verstaerkungsregeler Zylinder 1." UWORD FORMULA_1035 0 0 0.0 255.0 READ_WRITE BIT_MASK 0x1 ECU_ADDRESS 0x3FC770 /end MEASUREMENT
/begin MEASUREMENT vr_st_zyl10 "Verstaerkungsregeler Zylinder 10." UWORD FORMULA_1044 0 0 0.0 255.0 READ_WRITE BIT_MASK 0x200 ECU_ADDRESS 0x3FC770 /end MEASUREMENT
/begin MEASUREMENT vr_st_zyl2 "Verstaerkungsregeler Zylinder 2." UWORD FORMULA_1036 0 0 0.0 255.0 READ_WRITE BIT_MASK 0x2 ECU_ADDRESS 0x3FC770 /end MEASUREMENT
/begin MEASUREMENT vr_st_zyl3 "Verstaerkungsregeler Zylinder 3." UWORD FORMULA_1037 0 0 0.0 255.0 READ_WRITE BIT_MASK 0x4 ECU_ADDRESS 0x3FC770 /end MEASUREMENT
/begin MEASUREMENT vr_st_zyl4 "Verstaerkungsregeler Zylinder 4." UWORD FORMULA_1038 0 0 0.0 255.0 READ_WRITE BIT_MASK 0x8 ECU_ADDRESS 0x3FC770 /end MEASUREMENT
/begin MEASUREMENT vr_st_zyl5 "Verstaerkungsregeler Zylinder 5." UWORD FORMULA_1039 0 0 0.0 255.0 READ_WRITE BIT_MASK 0x10 ECU_ADDRESS 0x3FC770 /end MEASUREMENT
/begin MEASUREMENT vr_st_zyl6 "Verstaerkungsregeler Zylinder 6." UWORD FORMULA_1040 0 0 0.0 255.0 READ_WRITE BIT_MASK 0x20 ECU_ADDRESS 0x3FC770 /end MEASUREMENT
/begin MEASUREMENT vr_st_zyl7 "Verstaerkungsregeler Zylinder 7." UWORD FORMULA_1041 0 0 0.0 255.0 READ_WRITE BIT_MASK 0x40 ECU_ADDRESS 0x3FC770 /end MEASUREMENT
/begin MEASUREMENT vr_st_zyl8 "Verstaerkungsregeler Zylinder 8." UWORD FORMULA_1042 0 0 0.0 255.0 READ_WRITE BIT_MASK 0x80 ECU_ADDRESS 0x3FC770 /end MEASUREMENT
/begin MEASUREMENT vr_st_zyl9 "Verstaerkungsregeler Zylinder 9." UWORD FORMULA_1043 0 0 0.0 255.0 READ_WRITE BIT_MASK 0x100 ECU_ADDRESS 0x3FC770 /end MEASUREMENT
/begin MEASUREMENT vr_vorst_bas_b1 "Basisvorsteuereung der Erfassungstufe." SWORD FORMULA_0447 0 0.0 0.0 32.0 READ_WRITE ECU_ADDRESS 0x3FC772 /end MEASUREMENT
/begin MEASUREMENT vr_vorst_bas_b2 "Basisvorsteuereung der Erfassungstufe." SWORD FORMULA_0447 0 0.0 0.0 32.0 READ_WRITE ECU_ADDRESS 0x3FC774 /end MEASUREMENT
/begin MEASUREMENT vr_vorst_offs_zyl1 "Offsetvorsteuerung der Erfassungstufe." SWORD FORMULA_0447 0 0.0 0.0 32.0 READ_WRITE ECU_ADDRESS 0x3FC78A /end MEASUREMENT
/begin MEASUREMENT vr_vorst_offs_zyl10 "Offsetvorsteuerung der Erfassungstufe." SWORD FORMULA_0447 0 0.0 0.0 32.0 READ_WRITE ECU_ADDRESS 0x3FC79C /end MEASUREMENT
/begin MEASUREMENT vr_vorst_offs_zyl2 "Offsetvorsteuerung der Erfassungstufe." SWORD FORMULA_0447 0 0.0 0.0 32.0 READ_WRITE ECU_ADDRESS 0x3FC78C /end MEASUREMENT
/begin MEASUREMENT vr_vorst_offs_zyl3 "Offsetvorsteuerung der Erfassungstufe." SWORD FORMULA_0447 0 0.0 0.0 32.0 READ_WRITE ECU_ADDRESS 0x3FC78E /end MEASUREMENT
/begin MEASUREMENT vr_vorst_offs_zyl4 "Offsetvorsteuerung der Erfassungstufe." SWORD FORMULA_0447 0 0.0 0.0 32.0 READ_WRITE ECU_ADDRESS 0x3FC790 /end MEASUREMENT
/begin MEASUREMENT vr_vorst_offs_zyl5 "Offsetvorsteuerung der Erfassungstufe." SWORD FORMULA_0447 0 0.0 0.0 32.0 READ_WRITE ECU_ADDRESS 0x3FC792 /end MEASUREMENT
/begin MEASUREMENT vr_vorst_offs_zyl6 "Offsetvorsteuerung der Erfassungstufe." SWORD FORMULA_0447 0 0.0 0.0 32.0 READ_WRITE ECU_ADDRESS 0x3FC794 /end MEASUREMENT
/begin MEASUREMENT vr_vorst_offs_zyl7 "Offsetvorsteuerung der Erfassungstufe." SWORD FORMULA_0447 0 0.0 0.0 32.0 READ_WRITE ECU_ADDRESS 0x3FC796 /end MEASUREMENT
/begin MEASUREMENT vr_vorst_offs_zyl8 "Offsetvorsteuerung der Erfassungstufe." SWORD FORMULA_0447 0 0.0 0.0 32.0 READ_WRITE ECU_ADDRESS 0x3FC798 /end MEASUREMENT
/begin MEASUREMENT vr_vorst_offs_zyl9 "Offsetvorsteuerung der Erfassungstufe." SWORD FORMULA_0447 0 0.0 0.0 32.0 READ_WRITE ECU_ADDRESS 0x3FC79A /end MEASUREMENT
/begin MEASUREMENT vr_vorst_zyl1 "Vorsteuerung der Erfassungstufe." SWORD FORMULA_0447 0 0.0 0.0 32.0 READ_WRITE ECU_ADDRESS 0x3FC79E /end MEASUREMENT
/begin MEASUREMENT vr_vorst_zyl10 "Vorsteuerung der Erfassungstufe." SWORD FORMULA_0447 0 0.0 0.0 32.0 READ_WRITE ECU_ADDRESS 0x3FC7B0 /end MEASUREMENT
/begin MEASUREMENT vr_vorst_zyl2 "Vorsteuerung der Erfassungstufe." SWORD FORMULA_0447 0 0.0 0.0 32.0 READ_WRITE ECU_ADDRESS 0x3FC7A0 /end MEASUREMENT
/begin MEASUREMENT vr_vorst_zyl3 "Vorsteuerung der Erfassungstufe." SWORD FORMULA_0447 0 0.0 0.0 32.0 READ_WRITE ECU_ADDRESS 0x3FC7A2 /end MEASUREMENT
/begin MEASUREMENT vr_vorst_zyl4 "Vorsteuerung der Erfassungstufe." SWORD FORMULA_0447 0 0.0 0.0 32.0 READ_WRITE ECU_ADDRESS 0x3FC7A4 /end MEASUREMENT
/begin MEASUREMENT vr_vorst_zyl5 "Vorsteuerung der Erfassungstufe." SWORD FORMULA_0447 0 0.0 0.0 32.0 READ_WRITE ECU_ADDRESS 0x3FC7A6 /end MEASUREMENT
/begin MEASUREMENT vr_vorst_zyl6 "Vorsteuerung der Erfassungstufe." SWORD FORMULA_0447 0 0.0 0.0 32.0 READ_WRITE ECU_ADDRESS 0x3FC7A8 /end MEASUREMENT
/begin MEASUREMENT vr_vorst_zyl7 "Vorsteuerung der Erfassungstufe." SWORD FORMULA_0447 0 0.0 0.0 32.0 READ_WRITE ECU_ADDRESS 0x3FC7AA /end MEASUREMENT
/begin MEASUREMENT vr_vorst_zyl8 "Vorsteuerung der Erfassungstufe." SWORD FORMULA_0447 0 0.0 0.0 32.0 READ_WRITE ECU_ADDRESS 0x3FC7AC /end MEASUREMENT
/begin MEASUREMENT vr_vorst_zyl9 "Vorsteuerung der Erfassungstufe." SWORD FORMULA_0447 0 0.0 0.0 32.0 READ_WRITE ECU_ADDRESS 0x3FC7AE /end MEASUREMENT
/begin COMPU_METHOD FORMULA_0000 "FORMULA_0000" RAT_FUNC "%7.0" "-" COEFFS 0 1 0 0 0 1 /end COMPU_METHOD
/begin COMPU_METHOD FORMULA_0001 "FORMULA_0001" RAT_FUNC "%6.1" "%" COEFFS 0 10.0 0.0 0 0.0 1.0 /end COMPU_METHOD
/begin COMPU_METHOD FORMULA_0003 "FORMULA_0003" RAT_FUNC "%3.0" "-" COEFFS 0 1 0 0 0 1 /end COMPU_METHOD
/begin COMPU_METHOD FORMULA_0006 "FORMULA_0006" RAT_FUNC "%5.0" "Upm" COEFFS 0 1 0 0 0 1 /end COMPU_METHOD
/begin COMPU_METHOD FORMULA_0007 "FORMULA_0007" RAT_FUNC "%8.3" "-" COEFFS 0 10000.0 0.0 0 0.0 1.0 /end COMPU_METHOD
/begin COMPU_METHOD FORMULA_0009 "FORMULA_0009" RAT_FUNC "%6.1" "Nm" COEFFS 0 10.0 0.0 0 0.0 1.0 /end COMPU_METHOD
/begin COMPU_METHOD FORMULA_0010 "FORMULA_0010" RAT_FUNC "%5.0" "-" COEFFS 0 1 0 0 0 1 /end COMPU_METHOD
/begin COMPU_METHOD FORMULA_0017 "FORMULA_0017" RAT_FUNC "%9.2" "ms" COEFFS 0 7000.0 0.0 0 0.0 1.0 /end COMPU_METHOD
/begin COMPU_METHOD FORMULA_0020 "FORMULA_0020" RAT_FUNC "%5.0" "qmm/s" COEFFS 0 5.e-002 0.0 0 0.0 1.0 /end COMPU_METHOD
/begin COMPU_METHOD FORMULA_0021 "FORMULA_0021" RAT_FUNC "%7.2" "s" COEFFS 0 100.0 0.0 0 0.0 1.0 /end COMPU_METHOD
/begin COMPU_METHOD FORMULA_0023 "FORMULA_0023" RAT_FUNC "%6.1" "°C" COEFFS 0 10.0 2732.0 0 0.0 1.0 /end COMPU_METHOD
/begin COMPU_METHOD FORMULA_0025 "FORMULA_0025" RAT_FUNC "%8.3" "-" COEFFS 0 16384.0 0.0 0 0.0 1.0 /end COMPU_METHOD
/begin COMPU_METHOD FORMULA_0037 "FORMULA_0037" RAT_FUNC "%5.2" "-" COEFFS 0 1 0 0 0 1 /end COMPU_METHOD
/begin COMPU_METHOD FORMULA_0044 "FORMULA_0044" RAT_FUNC "%9.2" "-" COEFFS 0 1 0 0 0 1 /end COMPU_METHOD
/begin COMPU_METHOD FORMULA_0071 "FORMULA_0071" RAT_FUNC "%6.1" "s" COEFFS 0 10.0 0.0 0 0.0 1.0 /end COMPU_METHOD
/begin COMPU_METHOD FORMULA_0073 "FORMULA_0073" RAT_FUNC "%8.3" "-" COEFFS 0 1024.0 0.0 0 0.0 1.0 /end COMPU_METHOD
/begin COMPU_METHOD FORMULA_0074 "FORMULA_0074" RAT_FUNC "%6.1" "Kelvin" COEFFS 0 10.0 0.0 0 0.0 1.0 /end COMPU_METHOD
/begin COMPU_METHOD FORMULA_0075 "FORMULA_0075" RAT_FUNC "%6.1" "mbar" COEFFS 0 16.0 0.0 0 0.0 1.0 /end COMPU_METHOD
/begin COMPU_METHOD FORMULA_0076 "FORMULA_0076" RAT_FUNC "%6.1" "km/h" COEFFS 0 16.0 0.0 0 0.0 1.0 /end COMPU_METHOD
/begin COMPU_METHOD FORMULA_0102 "FORMULA_0102" RAT_FUNC "%6.1" "°KW" COEFFS 0 10.0 0.0 0 0.0 1.0 /end COMPU_METHOD
/begin COMPU_METHOD FORMULA_0105 "FORMULA_0105" RAT_FUNC "%5.0" "Upm/s" COEFFS 0 1 0 0 0 1 /end COMPU_METHOD
/begin COMPU_METHOD FORMULA_0109 "FORMULA_0109" RAT_FUNC "%7.2" "s" COEFFS 0 200.0 0.0 0 0.0 1.0 /end COMPU_METHOD
/begin COMPU_METHOD FORMULA_0114 "FORMULA_0114" RAT_FUNC "%5.0" "digit" COEFFS 0 1 0 0 0 1 /end COMPU_METHOD
/begin COMPU_METHOD FORMULA_0123 "FORMULA_0123" RAT_FUNC "%7.2" "m/(s*s)" COEFFS 0 40.0 0.0 0 0.0 1.0 /end COMPU_METHOD
/begin COMPU_METHOD FORMULA_0129 "FORMULA_0129" RAT_FUNC "%3.0" "bar" COEFFS 0 1 0 0 0 1 /end COMPU_METHOD
/begin COMPU_METHOD FORMULA_0135 "FORMULA_0135" RAT_FUNC "%3.0" ".Gang" COEFFS 0 1 0 0 0 1 /end COMPU_METHOD
/begin COMPU_METHOD FORMULA_0187 "FORMULA_0187" RAT_FUNC "%8.3" "100/10ms" COEFFS 0 100.0 0.0 0 0.0 1.0 /end COMPU_METHOD
/begin COMPU_METHOD FORMULA_0199 "FORMULA_0199" RAT_FUNC "%9.4" "-" COEFFS 0 16384.0 0.0 0 0.0 1.0 /end COMPU_METHOD
/begin COMPU_METHOD FORMULA_0225 "FORMULA_0225" RAT_FUNC "%10.3" "°KW" COEFFS 0 81920.0 0.0 0 0.0 1.0 /end COMPU_METHOD
/begin COMPU_METHOD FORMULA_0226 "FORMULA_0226" RAT_FUNC "%8.1" "°KW" COEFFS 0 10.0 0.0 0 0.0 1.0 /end COMPU_METHOD
/begin COMPU_METHOD FORMULA_0272 "FORMULA_0272" RAT_FUNC "%8.1" "Nm" COEFFS 0 10.0 0.0 0 0.0 1.0 /end COMPU_METHOD
/begin COMPU_METHOD FORMULA_0357 "FORMULA_0357" RAT_FUNC "%5.2" "s" COEFFS 0 200.0 0.0 0 0.0 1.0 /end COMPU_METHOD
/begin COMPU_METHOD FORMULA_0424 "FORMULA_0424" RAT_FUNC "%7.2" "qmm" COEFFS 0 100.0 0.0 0 0.0 1.0 /end COMPU_METHOD
/begin COMPU_METHOD FORMULA_0437 "FORMULA_0437" RAT_FUNC "%6.1" "%" COEFFS 0 327.68 0.0 0 0.0 1.0 /end COMPU_METHOD
/begin COMPU_METHOD FORMULA_0442 "FORMULA_0442" RAT_FUNC "%7.2" "V" COEFFS 0 1241.21837996177 0.0 0 0.0 1.0 /end COMPU_METHOD
/begin COMPU_METHOD FORMULA_0447 "FORMULA_0447" RAT_FUNC "%8.3" "*" COEFFS 0 512.0 0.0 0 0.0 1.0 /end COMPU_METHOD
/begin COMPU_METHOD FORMULA_0469 "FORMULA_0469" RAT_FUNC "%7.2" "s" COEFFS 0 0 327.67 0 1 0 /end COMPU_METHOD
/begin COMPU_METHOD FORMULA_0470 "FORMULA_0470" RAT_FUNC "%6.3" "s" COEFFS 0 0 1.28 0 1 0 /end COMPU_METHOD
/begin COMPU_METHOD FORMULA_0482 "FORMULA_0482" RAT_FUNC "%9.4" "-" COEFFS 0 8192.0 0.0 0 0.0 1.0 /end COMPU_METHOD
/begin COMPU_METHOD FORMULA_0488 "FORMULA_0488" RAT_FUNC "%7.2" "-" COEFFS 0 100.0 0.0 0 0.0 1.0 /end COMPU_METHOD
/begin COMPU_METHOD FORMULA_0490 "FORMULA_0490" RAT_FUNC "%8.3" "s" COEFFS 0 1000.0 0.0 0 0.0 1.0 /end COMPU_METHOD
/begin COMPU_METHOD FORMULA_0492 "FORMULA_0492" RAT_FUNC "%4.1" "s" COEFFS 0 10.0 0.0 0 0.0 1.0 /end COMPU_METHOD
/begin COMPU_METHOD FORMULA_0565 "FORMULA_0565" TAB_VERB "%3.0" "-" COMPU_TAB_REF FORMULA_0565_VTAB /end COMPU_METHOD
/begin COMPU_METHOD FORMULA_0569 "FORMULA_0569" RAT_FUNC "%7.2" "%" COEFFS 0 40.96 0.0 0 0.0 1.0 /end COMPU_METHOD
/begin COMPU_METHOD FORMULA_0570 "FORMULA_0570" RAT_FUNC "%11.4" "-" COEFFS 0 1 0 0 0 1 /end COMPU_METHOD
/begin COMPU_METHOD FORMULA_0695 "FORMULA_0695" TAB_VERB "%5.0" "-" COMPU_TAB_REF FORMULA_0695_VTAB /end COMPU_METHOD
/begin COMPU_METHOD FORMULA_0696 "FORMULA_0696" TAB_VERB "%3.0" "-" COMPU_TAB_REF FORMULA_0696_VTAB /end COMPU_METHOD
/begin COMPU_METHOD FORMULA_0697 "FORMULA_0697" TAB_VERB "%3.0" "-" COMPU_TAB_REF FORMULA_0697_VTAB /end COMPU_METHOD
/begin COMPU_METHOD FORMULA_0698 "FORMULA_0698" TAB_VERB "%3.0" "-" COMPU_TAB_REF FORMULA_0698_VTAB /end COMPU_METHOD
/begin COMPU_METHOD FORMULA_0699 "FORMULA_0699" RAT_FUNC "%9.4" "s" COEFFS 0 0 6553.6 0 1 0 /end COMPU_METHOD
/begin COMPU_METHOD FORMULA_0700 "FORMULA_0700" RAT_FUNC "%8.3" "°KW/Segm" COEFFS 0 20480.0 0.0 0 0.0 1.0 /end COMPU_METHOD
/begin COMPU_METHOD FORMULA_0701 "FORMULA_0701" RAT_FUNC "%8.3" "%/5ms" COEFFS 0 327.68 0.0 0 0.0 1.0 /end COMPU_METHOD
/begin COMPU_METHOD FORMULA_0702 "FORMULA_0702" TAB_VERB "%5.2" "-" COMPU_TAB_REF FORMULA_0702_VTAB /end COMPU_METHOD
/begin COMPU_METHOD FORMULA_0703 "FORMULA_0703" TAB_VERB "%5.2" "-" COMPU_TAB_REF FORMULA_0703_VTAB /end COMPU_METHOD
/begin COMPU_METHOD FORMULA_0704 "FORMULA_0704" RAT_FUNC "%7.2" "s" COEFFS 0 0 164 0 1 0 /end COMPU_METHOD
/begin COMPU_METHOD FORMULA_0705 "FORMULA_0705" RAT_FUNC "%9.4" "-/seg(144°KW)" COEFFS 0 16384.0 0.0 0 0.0 1.0 /end COMPU_METHOD
/begin COMPU_METHOD FORMULA_0706 "FORMULA_0706" RAT_FUNC "%7.2" "min" COEFFS 0 60.0 0.0 0 0.0 1.0 /end COMPU_METHOD
/begin COMPU_METHOD FORMULA_0707 "FORMULA_0707" TAB_VERB "%5.2" "-" COMPU_TAB_REF FORMULA_0707_VTAB /end COMPU_METHOD
/begin COMPU_METHOD FORMULA_0708 "FORMULA_0708" TAB_VERB "%5.2" "-" COMPU_TAB_REF FORMULA_0708_VTAB /end COMPU_METHOD
/begin COMPU_METHOD FORMULA_0709 "FORMULA_0709" RAT_FUNC "%6.1" "°KW" COEFFS 0 91.02222222222223 0.0 0 0.0 1.0 /end COMPU_METHOD
/begin COMPU_METHOD FORMULA_0710 "FORMULA_0710" TAB_VERB "%3.0" "-" COMPU_TAB_REF FORMULA_0710_VTAB /end COMPU_METHOD
/begin COMPU_METHOD FORMULA_0711 "FORMULA_0711" TAB_VERB "%3.0" "-" COMPU_TAB_REF FORMULA_0711_VTAB /end COMPU_METHOD
/begin COMPU_METHOD FORMULA_0712 "FORMULA_0712" TAB_VERB "%5.0" "-" COMPU_TAB_REF FORMULA_0712_VTAB /end COMPU_METHOD
/begin COMPU_METHOD FORMULA_0713 "FORMULA_0713" TAB_VERB "%5.0" "-" COMPU_TAB_REF FORMULA_0713_VTAB /end COMPU_METHOD
/begin COMPU_METHOD FORMULA_0714 "FORMULA_0714" TAB_VERB "%5.0" "-" COMPU_TAB_REF FORMULA_0714_VTAB /end COMPU_METHOD
/begin COMPU_METHOD FORMULA_0715 "FORMULA_0715" TAB_VERB "%5.0" "-" COMPU_TAB_REF FORMULA_0715_VTAB /end COMPU_METHOD
/begin COMPU_METHOD FORMULA_0716 "FORMULA_0716" TAB_VERB "%5.0" "-" COMPU_TAB_REF FORMULA_0716_VTAB /end COMPU_METHOD
/begin COMPU_METHOD FORMULA_0717 "FORMULA_0717" TAB_VERB "%5.0" "-" COMPU_TAB_REF FORMULA_0717_VTAB /end COMPU_METHOD
/begin COMPU_METHOD FORMULA_0718 "FORMULA_0718" TAB_VERB "%5.0" "-" COMPU_TAB_REF FORMULA_0718_VTAB /end COMPU_METHOD
/begin COMPU_METHOD FORMULA_0719 "FORMULA_0719" TAB_VERB "%5.0" "-" COMPU_TAB_REF FORMULA_0719_VTAB /end COMPU_METHOD
/begin COMPU_METHOD FORMULA_0720 "FORMULA_0720" TAB_VERB "%5.0" "-" COMPU_TAB_REF FORMULA_0720_VTAB /end COMPU_METHOD
/begin COMPU_METHOD FORMULA_0721 "FORMULA_0721" TAB_VERB "%5.0" "-" COMPU_TAB_REF FORMULA_0721_VTAB /end COMPU_METHOD
/begin COMPU_METHOD FORMULA_0722 "FORMULA_0722" TAB_VERB "%5.0" "-" COMPU_TAB_REF FORMULA_0722_VTAB /end COMPU_METHOD
/begin COMPU_METHOD FORMULA_0723 "FORMULA_0723" TAB_VERB "%5.0" "-" COMPU_TAB_REF FORMULA_0723_VTAB /end COMPU_METHOD
/begin COMPU_METHOD FORMULA_0724 "FORMULA_0724" TAB_VERB "%5.0" "-" COMPU_TAB_REF FORMULA_0724_VTAB /end COMPU_METHOD
/begin COMPU_METHOD FORMULA_0725 "FORMULA_0725" TAB_VERB "%5.0" "-" COMPU_TAB_REF FORMULA_0725_VTAB /end COMPU_METHOD
/begin COMPU_METHOD FORMULA_0726 "FORMULA_0726" TAB_VERB "%5.0" "-" COMPU_TAB_REF FORMULA_0726_VTAB /end COMPU_METHOD
/begin COMPU_METHOD FORMULA_0727 "FORMULA_0727" TAB_VERB "%5.0" "-" COMPU_TAB_REF FORMULA_0727_VTAB /end COMPU_METHOD
/begin COMPU_METHOD FORMULA_0728 "FORMULA_0728" TAB_VERB "%5.0" "-" COMPU_TAB_REF FORMULA_0728_VTAB /end COMPU_METHOD
/begin COMPU_METHOD FORMULA_0729 "FORMULA_0729" TAB_VERB "%5.0" "-" COMPU_TAB_REF FORMULA_0729_VTAB /end COMPU_METHOD
/begin COMPU_METHOD FORMULA_0730 "FORMULA_0730" TAB_VERB "%5.0" "-" COMPU_TAB_REF FORMULA_0730_VTAB /end COMPU_METHOD
/begin COMPU_METHOD FORMULA_0731 "FORMULA_0731" TAB_VERB "%5.0" "-" COMPU_TAB_REF FORMULA_0731_VTAB /end COMPU_METHOD
/begin COMPU_METHOD FORMULA_0732 "FORMULA_0732" TAB_VERB "%5.0" "-" COMPU_TAB_REF FORMULA_0732_VTAB /end COMPU_METHOD
/begin COMPU_METHOD FORMULA_0733 "FORMULA_0733" RAT_FUNC "%7.2" "fS²" COEFFS 0 440.2183483007572 0.0 0 0.0 1.0 /end COMPU_METHOD
/begin COMPU_METHOD FORMULA_0734 "FORMULA_0734" RAT_FUNC "%6.3" "kHz" COEFFS 0 8.192000167772163 0.0 0 0.0 1.0 /end COMPU_METHOD
/begin COMPU_METHOD FORMULA_0735 "FORMULA_0735" TAB_VERB "%5.2" "-" COMPU_TAB_REF FORMULA_0735_VTAB /end COMPU_METHOD
/begin COMPU_METHOD FORMULA_0736 "FORMULA_0736" TAB_VERB "%3.0" "-" COMPU_TAB_REF FORMULA_0736_VTAB /end COMPU_METHOD
/begin COMPU_METHOD FORMULA_0737 "FORMULA_0737" RAT_FUNC "%7.2" "Upm/s" COEFFS 0 5.e-003 0.0 0 0.0 1.0 /end COMPU_METHOD
/begin COMPU_METHOD FORMULA_0738 "FORMULA_0738" TAB_VERB "%3.0" "-" COMPU_TAB_REF FORMULA_0738_VTAB /end COMPU_METHOD
/begin COMPU_METHOD FORMULA_0739 "FORMULA_0739" TAB_VERB "%3.0" "-" COMPU_TAB_REF FORMULA_0739_VTAB /end COMPU_METHOD
/begin COMPU_METHOD FORMULA_0740 "FORMULA_0740" TAB_VERB "%3.0" "-" COMPU_TAB_REF FORMULA_0740_VTAB /end COMPU_METHOD
/begin COMPU_METHOD FORMULA_0741 "FORMULA_0741" RAT_FUNC "%7.2" "rad/s" COEFFS 0 100.0 0.0 0 0.0 1.0 /end COMPU_METHOD
/begin COMPU_METHOD FORMULA_0742 "FORMULA_0742" RAT_FUNC "%9.4" "Nm" COEFFS 0 2000.0 0.0 0 0.0 1.0 /end COMPU_METHOD
/begin COMPU_METHOD FORMULA_0743 "FORMULA_0743" TAB_VERB "%5.2" "-" COMPU_TAB_REF FORMULA_0743_VTAB /end COMPU_METHOD
/begin COMPU_METHOD FORMULA_0744 "FORMULA_0744" TAB_VERB "%5.2" "-" COMPU_TAB_REF FORMULA_0744_VTAB /end COMPU_METHOD
/begin COMPU_METHOD FORMULA_0745 "FORMULA_0745" RAT_FUNC "%3.0" "Upm" COEFFS 0 1 0 0 0 1 /end COMPU_METHOD
/begin COMPU_METHOD FORMULA_0746 "FORMULA_0746" RAT_FUNC "%5.2" "s" COEFFS 0 0 25.6 0 1 0 /end COMPU_METHOD
/begin COMPU_METHOD FORMULA_0747 "FORMULA_0747" RAT_FUNC "%5.0" "Upm/s" COEFFS 0 0.1 0.0 0 0.0 1.0 /end COMPU_METHOD
/begin COMPU_METHOD FORMULA_0748 "FORMULA_0748" RAT_FUNC "%3.0" "Nm/s" COEFFS 0 1 0 0 0 1 /end COMPU_METHOD
/begin COMPU_METHOD FORMULA_0749 "FORMULA_0749" RAT_FUNC "%4.1" "Nm" COEFFS 0 10.0 0.0 0 0.0 1.0 /end COMPU_METHOD
/begin COMPU_METHOD FORMULA_0750 "FORMULA_0750" RAT_FUNC "%9.4" "Nm/s" COEFFS 0 2000.0 0.0 0 0.0 1.0 /end COMPU_METHOD
/begin COMPU_METHOD FORMULA_0751 "FORMULA_0751" RAT_FUNC "%6.1" "Nm/s" COEFFS 0 5.0 0.0 0 0.0 1.0 /end COMPU_METHOD
/begin COMPU_METHOD FORMULA_0752 "FORMULA_0752" TAB_VERB "%5.2" "-" COMPU_TAB_REF FORMULA_0752_VTAB /end COMPU_METHOD
/begin COMPU_METHOD FORMULA_0753 "FORMULA_0753" TAB_VERB "%5.2" "-" COMPU_TAB_REF FORMULA_0753_VTAB /end COMPU_METHOD
/begin COMPU_METHOD FORMULA_0754 "FORMULA_0754" RAT_FUNC "%5.2" "s" COEFFS 0 0 256 0 1 0 /end COMPU_METHOD
/begin COMPU_METHOD FORMULA_0755 "FORMULA_0755" RAT_FUNC "%6.1" "Nm/s" COEFFS 0 10.0 0.0 0 0.0 1.0 /end COMPU_METHOD
/begin COMPU_METHOD FORMULA_0756 "FORMULA_0756" RAT_FUNC "%3.0" "KW-Zahn" COEFFS 0 1 0 0 0 1 /end COMPU_METHOD
/begin COMPU_METHOD FORMULA_0790 "FORMULA_0790" TAB_VERB "%5.2" "-" COMPU_TAB_REF FORMULA_0790_VTAB /end COMPU_METHOD
/begin COMPU_METHOD FORMULA_0791 "FORMULA_0791" TAB_VERB "%5.2" "-" COMPU_TAB_REF FORMULA_0791_VTAB /end COMPU_METHOD
/begin COMPU_METHOD FORMULA_0792 "FORMULA_0792" TAB_VERB "%5.2" "-" COMPU_TAB_REF FORMULA_0792_VTAB /end COMPU_METHOD
/begin COMPU_METHOD FORMULA_0793 "FORMULA_0793" RAT_FUNC "%5.0" "Nm" COEFFS 0 -1.0 0.0 0 0.0 1.0 /end COMPU_METHOD
/begin COMPU_METHOD FORMULA_0794 "FORMULA_0794" RAT_FUNC "%5.0" "Nm" COEFFS 0 1 0 0 0 1 /end COMPU_METHOD
/begin COMPU_METHOD FORMULA_0795 "FORMULA_0795" RAT_FUNC "%10.3" "Nm/Upm" COEFFS 0 1000.0 0.0 0 0.0 1.0 /end COMPU_METHOD
/begin COMPU_METHOD FORMULA_0796 "FORMULA_0796" RAT_FUNC "%7.2" "Nm/Upm" COEFFS 0 100.0 0.0 0 0.0 1.0 /end COMPU_METHOD
/begin COMPU_METHOD FORMULA_0817 "FORMULA_0817" TAB_VERB "%3.0" "-" COMPU_TAB_REF FORMULA_0817_VTAB /end COMPU_METHOD
/begin COMPU_METHOD FORMULA_0975 "FORMULA_0975" RAT_FUNC "%8.3" "°C" COEFFS 0 40.0 10926.0 0 0.0 1.0 /end COMPU_METHOD
/begin COMPU_METHOD FORMULA_0991 "FORMULA_0991" TAB_VERB "%6.1" "-" COMPU_TAB_REF FORMULA_0991_VTAB /end COMPU_METHOD
/begin COMPU_METHOD FORMULA_1034 "FORMULA_1034" TAB_VERB "%5.0" "-" COMPU_TAB_REF FORMULA_1034_VTAB /end COMPU_METHOD
/begin COMPU_METHOD FORMULA_1035 "FORMULA_1035" TAB_VERB "%5.0" "-" COMPU_TAB_REF FORMULA_1035_VTAB /end COMPU_METHOD
/begin COMPU_METHOD FORMULA_1036 "FORMULA_1036" TAB_VERB "%5.0" "-" COMPU_TAB_REF FORMULA_1036_VTAB /end COMPU_METHOD
/begin COMPU_METHOD FORMULA_1037 "FORMULA_1037" TAB_VERB "%5.0" "-" COMPU_TAB_REF FORMULA_1037_VTAB /end COMPU_METHOD
/begin COMPU_METHOD FORMULA_1038 "FORMULA_1038" TAB_VERB "%5.0" "-" COMPU_TAB_REF FORMULA_1038_VTAB /end COMPU_METHOD
/begin COMPU_METHOD FORMULA_1039 "FORMULA_1039" TAB_VERB "%5.0" "-" COMPU_TAB_REF FORMULA_1039_VTAB /end COMPU_METHOD
/begin COMPU_METHOD FORMULA_1040 "FORMULA_1040" TAB_VERB "%5.0" "-" COMPU_TAB_REF FORMULA_1040_VTAB /end COMPU_METHOD
/begin COMPU_METHOD FORMULA_1041 "FORMULA_1041" TAB_VERB "%5.0" "-" COMPU_TAB_REF FORMULA_1041_VTAB /end COMPU_METHOD
/begin COMPU_METHOD FORMULA_1042 "FORMULA_1042" TAB_VERB "%5.0" "-" COMPU_TAB_REF FORMULA_1042_VTAB /end COMPU_METHOD
/begin COMPU_METHOD FORMULA_1043 "FORMULA_1043" TAB_VERB "%5.0" "-" COMPU_TAB_REF FORMULA_1043_VTAB /end COMPU_METHOD
/begin COMPU_METHOD FORMULA_1044 "FORMULA_1044" TAB_VERB "%5.0" "-" COMPU_TAB_REF FORMULA_1044_VTAB /end COMPU_METHOD
/begin COMPU_METHOD FORMULA_1045 "FORMULA_1045" TAB_VERB "%3.0" "*" COMPU_TAB_REF FORMULA_1045_VTAB /end COMPU_METHOD
/begin COMPU_METHOD FORMULA_1046 "FORMULA_1046" TAB_VERB "%3.0" "-" COMPU_TAB_REF FORMULA_1046_VTAB /end COMPU_METHOD
/begin COMPU_METHOD FORMULA_1047 "FORMULA_1047" TAB_VERB "%3.0" "-" COMPU_TAB_REF FORMULA_1047_VTAB /end COMPU_METHOD
/begin COMPU_METHOD FORMULA_1048 "FORMULA_1048" TAB_VERB "%3.0" "V" COMPU_TAB_REF FORMULA_1048_VTAB /end COMPU_METHOD
/begin COMPU_METHOD FORMULA_1049 "FORMULA_1049" TAB_VERB "%3.0" "-" COMPU_TAB_REF FORMULA_1049_VTAB /end COMPU_METHOD
/begin COMPU_VTAB FORMULA_0565_VTAB "FORMULA_0565_VTAB" TAB_VERB 2 0 "Aus" 1 "Ein" DEFAULT_VALUE "undefiniert" /end COMPU_VTAB
/begin COMPU_VTAB FORMULA_0695_VTAB "FORMULA_0695_VTAB" TAB_VERB 19 0 "kein Klopfschutz" 1 "K_KA_KS_CFG = Ein" 65 "K_KA_KS_CFG = Ein" 2 "K_KR_CFG = Aus" 66 "K_KR_CFG = Aus" 4 "Anschlag an tz_min" 8 "Doppelzuendung" 72 "Doppelzuendung" 16 "Klipping" 80 "Klipping" 32 "Fehlerspeicher" 96 "Fehlerspeicher" 112 "Fehlerspeicher" 40 "Fehlerspeicher" 104 "Fehlerspeicher" 120 "Fehlerspeicher" 64 "rf-Schwelle" 128 "Katheizen" 256 "Dynamik" DEFAULT_VALUE "Mehrfachanforderung" /end COMPU_VTAB
/begin COMPU_VTAB FORMULA_0696_VTAB "FORMULA_0696_VTAB" TAB_VERB 4 0 "Ok" 1 "Bank 1" 2 "Bank 2" 3 "Bank 1+2" DEFAULT_VALUE "undefiniert" /end COMPU_VTAB
/begin COMPU_VTAB FORMULA_0697_VTAB "FORMULA_0697_VTAB" TAB_VERB 2 0 "Klopfschutz Aus" 1 "Klopfschutz Ein" DEFAULT_VALUE "undefiniert" /end COMPU_VTAB
/begin COMPU_VTAB FORMULA_0698_VTAB "FORMULA_0698_VTAB" TAB_VERB 2 0 "Aus" 1 "Reset" DEFAULT_VALUE "undefiniert" /end COMPU_VTAB
/begin COMPU_VTAB FORMULA_0702_VTAB "FORMULA_0702_VTAB" TAB_VERB 3 1 "vkat" 2 "nkat" 4 "mess" DEFAULT_VALUE "ungueltig" /end COMPU_VTAB
/begin COMPU_VTAB FORMULA_0703_VTAB "FORMULA_0703_VTAB" TAB_VERB 2 0 "absolut" 1 "Eta" DEFAULT_VALUE "undef" /end COMPU_VTAB
/begin COMPU_VTAB FORMULA_0707_VTAB "FORMULA_0707_VTAB" TAB_VERB 2 0 "Aus" 1 "Senden" DEFAULT_VALUE "undefiniert" /end COMPU_VTAB
/begin COMPU_VTAB FORMULA_0708_VTAB "FORMULA_0708_VTAB" TAB_VERB 2 0 "Low Active" 1 "High Active" DEFAULT_VALUE "undefiniert" /end COMPU_VTAB
/begin COMPU_VTAB FORMULA_0710_VTAB "FORMULA_0710_VTAB" TAB_VERB 8 0 "Aktiv" 1 "K_KR_CFG = Aus" 2 "rf-Schwelle" 4 "Doppelzuendung" 8 "tmot-Schwelle" 10 "rf + tmot-Schwelle" 16 "Fehlerspeicher" 32 "dtz ausserhalb" DEFAULT_VALUE "Mehrfachdeaktiviert" /end COMPU_VTAB
/begin COMPU_VTAB FORMULA_0711_VTAB "FORMULA_0711_VTAB" TAB_VERB 4 0 "Ok" 1 "Bank 1" 2 "Bank 2" 3 "Bank 1+2" DEFAULT_VALUE "undefiniert" /end COMPU_VTAB
/begin COMPU_VTAB FORMULA_0712_VTAB "FORMULA_0712_VTAB" TAB_VERB 1 0 "Kein Klopfen." DEFAULT_VALUE "Klopfen Erkannt." /end COMPU_VTAB
/begin COMPU_VTAB FORMULA_0713_VTAB "FORMULA_0713_VTAB" TAB_VERB 1 0 "Kein Klopfen." DEFAULT_VALUE "Klopfen Erkannt." /end COMPU_VTAB
/begin COMPU_VTAB FORMULA_0714_VTAB "FORMULA_0714_VTAB" TAB_VERB 1 0 "Kein Klopfen." DEFAULT_VALUE "Klopfen Erkannt." /end COMPU_VTAB
/begin COMPU_VTAB FORMULA_0715_VTAB "FORMULA_0715_VTAB" TAB_VERB 1 0 "Kein Klopfen." DEFAULT_VALUE "Klopfen Erkannt." /end COMPU_VTAB
/begin COMPU_VTAB FORMULA_0716_VTAB "FORMULA_0716_VTAB" TAB_VERB 1 0 "Kein Klopfen." DEFAULT_VALUE "Klopfen Erkannt." /end COMPU_VTAB
/begin COMPU_VTAB FORMULA_0717_VTAB "FORMULA_0717_VTAB" TAB_VERB 1 0 "Kein Klopfen." DEFAULT_VALUE "Klopfen Erkannt." /end COMPU_VTAB
/begin COMPU_VTAB FORMULA_0718_VTAB "FORMULA_0718_VTAB" TAB_VERB 1 0 "Kein Klopfen." DEFAULT_VALUE "Klopfen Erkannt." /end COMPU_VTAB
/begin COMPU_VTAB FORMULA_0719_VTAB "FORMULA_0719_VTAB" TAB_VERB 1 0 "Kein Klopfen." DEFAULT_VALUE "Klopfen Erkannt." /end COMPU_VTAB
/begin COMPU_VTAB FORMULA_0720_VTAB "FORMULA_0720_VTAB" TAB_VERB 1 0 "Kein Klopfen." DEFAULT_VALUE "Klopfen Erkannt." /end COMPU_VTAB
/begin COMPU_VTAB FORMULA_0721_VTAB "FORMULA_0721_VTAB" TAB_VERB 1 0 "Kein Klopfen." DEFAULT_VALUE "Klopfen Erkannt." /end COMPU_VTAB
/begin COMPU_VTAB FORMULA_0722_VTAB "FORMULA_0722_VTAB" TAB_VERB 1 0 "Kein Klopfen." DEFAULT_VALUE "Klopfen Erkannt." /end COMPU_VTAB
/begin COMPU_VTAB FORMULA_0723_VTAB "FORMULA_0723_VTAB" TAB_VERB 1 0 "Zyl. 1 idle." DEFAULT_VALUE "Zyl. 1 aktiv." /end COMPU_VTAB
/begin COMPU_VTAB FORMULA_0724_VTAB "FORMULA_0724_VTAB" TAB_VERB 1 0 "Zyl. 2 idle." DEFAULT_VALUE "Zyl. 2 aktiv." /end COMPU_VTAB
/begin COMPU_VTAB FORMULA_0725_VTAB "FORMULA_0725_VTAB" TAB_VERB 1 0 "Zyl. 3 idle." DEFAULT_VALUE "Zyl. 3 aktiv." /end COMPU_VTAB
/begin COMPU_VTAB FORMULA_0726_VTAB "FORMULA_0726_VTAB" TAB_VERB 1 0 "Zyl. 4 idle." DEFAULT_VALUE "Zyl. 4 aktiv." /end COMPU_VTAB
/begin COMPU_VTAB FORMULA_0727_VTAB "FORMULA_0727_VTAB" TAB_VERB 1 0 "Zyl. 5 idle." DEFAULT_VALUE "Zyl. 5 aktiv." /end COMPU_VTAB
/begin COMPU_VTAB FORMULA_0728_VTAB "FORMULA_0728_VTAB" TAB_VERB 1 0 "Zyl. 6 idle." DEFAULT_VALUE "Zyl. 6 aktiv." /end COMPU_VTAB
/begin COMPU_VTAB FORMULA_0729_VTAB "FORMULA_0729_VTAB" TAB_VERB 1 0 "Zyl. 7 idle." DEFAULT_VALUE "Zyl. 7 aktiv." /end COMPU_VTAB
/begin COMPU_VTAB FORMULA_0730_VTAB "FORMULA_0730_VTAB" TAB_VERB 1 0 "Zyl. 8 idle." DEFAULT_VALUE "Zyl. 8 aktiv." /end COMPU_VTAB
/begin COMPU_VTAB FORMULA_0731_VTAB "FORMULA_0731_VTAB" TAB_VERB 1 0 "Zyl. 9 idle." DEFAULT_VALUE "Zyl. 9 aktiv." /end COMPU_VTAB
/begin COMPU_VTAB FORMULA_0732_VTAB "FORMULA_0732_VTAB" TAB_VERB 1 0 "Zyl. 10 idle." DEFAULT_VALUE "Zyl. 10 aktiv." /end COMPU_VTAB
/begin COMPU_VTAB FORMULA_0735_VTAB "FORMULA_0735_VTAB" TAB_VERB 2 0 "KUS gesperrt" 1 "KUS freigegeben" /end COMPU_VTAB
/begin COMPU_VTAB FORMULA_0736_VTAB "FORMULA_0736_VTAB" TAB_VERB 2 0 "Aus" 1 "Aktiv" /end COMPU_VTAB
/begin COMPU_VTAB FORMULA_0738_VTAB "FORMULA_0738_VTAB" TAB_VERB 6 0 "Inaktiv" 1 "Aktiv" 2 "Filter HI" 3 "Filter LO" 4 "Fehler HI" 5 "Fehler HI" /end COMPU_VTAB
/begin COMPU_VTAB FORMULA_0739_VTAB "FORMULA_0739_VTAB" TAB_VERB 5 0 "Inaktiv" 1 "Bed. niO" 5 "Aktiv" 6 "Ende" 7 "Abbruch" /end COMPU_VTAB
/begin COMPU_VTAB FORMULA_0740_VTAB "FORMULA_0740_VTAB" TAB_VERB 2 0 "Normal" 1 "CSS" /end COMPU_VTAB
/begin COMPU_VTAB FORMULA_0743_VTAB "FORMULA_0743_VTAB" TAB_VERB 4 0 "nie" 1 "MKS" 2 "OKS" 3 "beide" /end COMPU_VTAB
/begin COMPU_VTAB FORMULA_0744_VTAB "FORMULA_0744_VTAB" TAB_VERB 4 0 "Keiner" 1 "Reib" 2 "Start" 3 "Reib+Start" /end COMPU_VTAB
/begin COMPU_VTAB FORMULA_0752_VTAB "FORMULA_0752_VTAB" TAB_VERB 6 0 "Inaktiv" 1 "Aktiv" 3 "Wait" 5 "Normal" 9 "mit AC" 16 "Init" /end COMPU_VTAB
/begin COMPU_VTAB FORMULA_0753_VTAB "FORMULA_0753_VTAB" TAB_VERB 4 0 "Aus" 1 "Ein" 2 "Ein o.TE" 255 "Init" /end COMPU_VTAB
/begin COMPU_VTAB FORMULA_0790_VTAB "FORMULA_0790_VTAB" TAB_VERB 2 0 "negativ" 1 "positiv" /end COMPU_VTAB
/begin COMPU_VTAB FORMULA_0791_VTAB "FORMULA_0791_VTAB" TAB_VERB 8 0 "FP0" 1 "FP1" 2 "FP2" 3 "FP3" 4 "FP4" 5 "FP5" 6 "CAN" 7 "Mdrv" /end COMPU_VTAB
/begin COMPU_VTAB FORMULA_0792_VTAB "FORMULA_0792_VTAB" TAB_VERB 2 0 "mKupp" 1 "mRad" /end COMPU_VTAB
/begin COMPU_VTAB FORMULA_0817_VTAB "FORMULA_0817_VTAB" TAB_VERB 2 0 "Quelle ist tan" 1 "Quelle ist tanzyl" DEFAULT_VALUE "undefiniert" /end COMPU_VTAB
/begin COMPU_VTAB FORMULA_0991_VTAB "FORMULA_0991_VTAB" TAB_VERB 10 0 "-" 1 "Diag. aktiv" 2 "Diag.bed. n. erf." 4 "TKA-Diag. i.O." 17 "Motor kalt" 33 "Thermostat offen" 65 "unplaus. tka haengt" 129 "unplaus. tka>tmot" 16385 "KS nach UB" 32769 "KS nach Masse" /end COMPU_VTAB
/begin COMPU_VTAB FORMULA_1034_VTAB "FORMULA_1034_VTAB" TAB_VERB 1 0 "Alle aktiv." DEFAULT_VALUE "Mindestens einer aus." /end COMPU_VTAB
/begin COMPU_VTAB FORMULA_1035_VTAB "FORMULA_1035_VTAB" TAB_VERB 1 0 "Zyl. 1 aktiv." DEFAULT_VALUE "Zyl. 1 vorgesteuert." /end COMPU_VTAB
/begin COMPU_VTAB FORMULA_1036_VTAB "FORMULA_1036_VTAB" TAB_VERB 1 0 "Zyl. 2 aktiv." DEFAULT_VALUE "Zyl. 2 vorgesteuert." /end COMPU_VTAB
/begin COMPU_VTAB FORMULA_1037_VTAB "FORMULA_1037_VTAB" TAB_VERB 1 0 "Zyl. 3 aktiv." DEFAULT_VALUE "Zyl. 3 vorgesteuert." /end COMPU_VTAB
/begin COMPU_VTAB FORMULA_1038_VTAB "FORMULA_1038_VTAB" TAB_VERB 1 0 "Zyl. 4 aktiv." DEFAULT_VALUE "Zyl. 4 vorgesteuert." /end COMPU_VTAB
/begin COMPU_VTAB FORMULA_1039_VTAB "FORMULA_1039_VTAB" TAB_VERB 1 0 "Zyl. 5 aktiv." DEFAULT_VALUE "Zyl. 5 vorgesteuert." /end COMPU_VTAB
/begin COMPU_VTAB FORMULA_1040_VTAB "FORMULA_1040_VTAB" TAB_VERB 1 0 "Zyl. 6 aktiv." DEFAULT_VALUE "Zyl. 6 vorgesteuert." /end COMPU_VTAB
/begin COMPU_VTAB FORMULA_1041_VTAB "FORMULA_1041_VTAB" TAB_VERB 1 0 "Zyl. 7 aktiv." DEFAULT_VALUE "Zyl. 7 vorgesteuert." /end COMPU_VTAB
/begin COMPU_VTAB FORMULA_1042_VTAB "FORMULA_1042_VTAB" TAB_VERB 1 0 "Zyl. 8 aktiv." DEFAULT_VALUE "Zyl. 8 vorgesteuert." /end COMPU_VTAB
/begin COMPU_VTAB FORMULA_1043_VTAB "FORMULA_1043_VTAB" TAB_VERB 1 0 "Zyl. 9 aktiv." DEFAULT_VALUE "Zyl. 9 vorgesteuert." /end COMPU_VTAB
/begin COMPU_VTAB FORMULA_1044_VTAB "FORMULA_1044_VTAB" TAB_VERB 1 0 "Zyl. 10 aktiv." DEFAULT_VALUE "Zyl. 10 vorgesteuert." /end COMPU_VTAB
/begin COMPU_VTAB FORMULA_1045_VTAB "FORMULA_1045_VTAB" TAB_VERB 9 0 "0.625" 1 "1.000" 2 "1.600" 3 "2.559" 4 "4.096" 5 "6.553" 6 "10.484" 7 "16.775" 8 "26.842" DEFAULT_VALUE "Undefiniert" /end COMPU_VTAB
/begin COMPU_VTAB FORMULA_1046_VTAB "FORMULA_1046_VTAB" TAB_VERB 4 0 "idle" 1 "aktive" 2 "ok" 4 "error" DEFAULT_VALUE "undefiniert" /end COMPU_VTAB
/begin COMPU_VTAB FORMULA_1047_VTAB "FORMULA_1047_VTAB" TAB_VERB 2 0 "Aus" 1 "Ein" DEFAULT_VALUE "undefined" /end COMPU_VTAB
/begin COMPU_VTAB FORMULA_1048_VTAB "FORMULA_1048_VTAB" TAB_VERB 2 0 "100" 1 "160" DEFAULT_VALUE "undefined" /end COMPU_VTAB
/begin COMPU_VTAB FORMULA_1049_VTAB "FORMULA_1049_VTAB" TAB_VERB 2 0 "Aus" 1 "Ein" DEFAULT_VALUE "undefined" /end COMPU_VTAB
/begin FUNCTION Ionenstrom ""
 /begin DEF_CHARACTERISTIC GKF_VR_VORST_BAS K_VR_DIAG_MAX_OFFSET K_VR_HYST K_VR_LP_COEF K_VR_MESS_ED K_VR_SET_INI K_VR_SET_MAX K_VR_SET_MIN K_VR_SOLL K_VR_TEST_DIAG K_VR_TEST_SEND_ENABLE K_VR_TEST_U_MESS K_VR_TEST_V_MESS K_VR_VORST_MAX K_VR_VORST_MIN KL_VR_VORST_DTZ /end DEF_CHARACTERISTIC
 /begin OUT_MEASUREMENT vr_diag_st_zyl1 vr_diag_st_zyl10 vr_diag_st_zyl2 vr_diag_st_zyl3 vr_diag_st_zyl4 vr_diag_st_zyl5 vr_diag_st_zyl6 vr_diag_st_zyl7 vr_diag_st_zyl8 vr_diag_st_zyl9 vr_ist_zyl1 vr_ist_zyl10 vr_ist_zyl2 vr_ist_zyl3 vr_ist_zyl4 vr_ist_zyl5 vr_ist_zyl6 vr_ist_zyl7 vr_ist_zyl8 vr_ist_zyl9 vr_mess_zyl1 vr_mess_zyl10 vr_mess_zyl2 vr_mess_zyl3 vr_mess_zyl4 vr_mess_zyl5 vr_mess_zyl6 vr_mess_zyl7 vr_mess_zyl8 vr_mess_zyl9 vr_set_zyl1 vr_set_zyl10 vr_set_zyl2 vr_set_zyl3 vr_set_zyl4 vr_set_zyl5 vr_set_zyl6 vr_set_zyl7 vr_set_zyl8 vr_set_zyl9 vr_st vr_st_zyl1 vr_st_zyl10 vr_st_zyl2 vr_st_zyl3 vr_st_zyl4 vr_st_zyl5 vr_st_zyl6 vr_st_zyl7 vr_st_zyl8 vr_st_zyl9 vr_vorst_bas_b1 vr_vorst_bas_b2 vr_vorst_offs_zyl1 vr_vorst_offs_zyl10 vr_vorst_offs_zyl2 vr_vorst_offs_zyl3 vr_vorst_offs_zyl4 vr_vorst_offs_zyl5 vr_vorst_offs_zyl6 vr_vorst_offs_zyl7 vr_vorst_offs_zyl8 vr_vorst_offs_zyl9 vr_vorst_zyl1 vr_vorst_zyl10 vr_vorst_zyl2 vr_vorst_zyl3 vr_vorst_zyl4 vr_vorst_zyl5 vr_vorst_zyl6 vr_vorst_zyl7 vr_vorst_zyl8 vr_vorst_zyl9 /end OUT_MEASUREMENT
/end FUNCTION
/begin FUNCTION IPM ""
 /begin DEF_CHARACTERISTIC K_MD_CFG_FGR_EINGR K_MD_CFG_IDX K_MD_ETA_GETR K_MD_N_ABTRIEB_MIN K_MD_N_PEMAX K_MD_N_PVMAX K_MD_RAD_STEIGUNG_TAU KF_MD_WUNSCH_REL_KOMFORT KF_MD_WUNSCH_REL_NORMAL KF_MD_WUNSCH_REL_SPORT KL_MD_ABTRIEB_NULL_KOMFORT KL_MD_ABTRIEB_NULL_SPORT KL_MD_ABTRIEB_SCHLEPP_FAK KL_MD_ABTRIEB_SCHLEPP_MAX KL_MD_IDX_FP KL_MD_KUPP_MAX KL_MD_KUPP_MIN KL_MD_RAD_BREMSE KL_MD_RAD_BREMSE_TAU KL_MD_RAD_STEIG_BREMS KL_MD_RAD_STEIG_FAK KL_MD_RAD_STEIGUNG /end DEF_CHARACTERISTIC
 /begin OUT_MEASUREMENT B_MD_IPM_POS md_abtrieb_bremse md_abtrieb_ist md_abtrieb_max md_abtrieb_min md_abtrieb_neg md_abtrieb_pos md_abtrieb_pos_rel md_abtrieb_pos_rel_fgr md_abtrieb_steigung md_abtrieb_wunsch md_i_getr_md_max md_i_getr_md_min md_idx_fp md_ipm_n_opt_max md_ipm_pwg_diff md_ipm_pwg_neg md_ipm_pwg_null md_ipm_pwg_pos md_ipm_st md_kupp_wunsch_ipm md_rad_bremse md_rad_steigung_fil md_rad_wunsch /end OUT_MEASUREMENT
/end FUNCTION
/begin FUNCTION KFIPOL "" /end FUNCTION
/begin FUNCTION Kh ""
 /begin DEF_CHARACTERISTIC K_KH_MD_ETA_GRAD_INAKTIV K_KH_MD_ETA_GRAD_START K_KH_MD_ETA_GRAD_START_SL K_KH_MD_ETA_MAX K_KH_MD_ETA_MIN K_KH_N_MAX K_KH_N_MAX_HYS K_KH_PUMG_MIN K_KH_PUMG_MIN_HYS K_KH_RF_MAX K_KH_RF_MAX_HYS K_KH_SLP_DAUER_MIN K_KH_SMG_TMOT_MAX K_KH_SMG_TMOT_MIN K_KH_TAN_MAX K_KH_TAN_MAX_HYS K_KH_TKAT_CFG K_KH_TKAT_HYST K_KH_TZ_ABS_AB K_KH_TZ_CFG K_KH_VAN_AB_Auslass K_KH_VAN_AB_Einlass K_KH_VAN_TMOT_MAX KF_KH_MD_ETA_F_LLMKS KF_KH_MD_ETA_F_LLMKS_SL KF_KH_MD_ETA_F_LLOKS KF_KH_MD_ETA_F_LLOKS_SL KF_KH_MD_ETA_F_SB KF_KH_MD_ETA_F_SB_SL KF_KH_MD_ETA_F_TL KF_KH_MD_ETA_F_TL_SL KF_KH_MD_ETA_GRUND KF_KH_MD_ETA_GRUND_SL KF_KH_TZ_ETA_GRUND_SL KF_KH_TZ_GRUND KL_KH_ALT_OFFSET KL_KH_MD_ETA_F_PUMG KL_KH_MD_ETA_GRAD_LLMKS KL_KH_MD_ETA_GRAD_LLMKS_SL KL_KH_MD_ETA_GRAD_LLOKS KL_KH_MD_ETA_GRAD_LLOKS_SL KL_KH_MD_ETA_GRAD_SB KL_KH_MD_ETA_GRAD_SB_SL KL_KH_MD_ETA_GRAD_TL KL_KH_MD_ETA_GRAD_TL_SL KL_KH_MD_ETA_START KL_KH_MD_ETA_START_SL KL_KH_T_MAX KL_KH_TKAT_ENDE KL_KH_VAN_AUF_TMOT_A KL_KH_VAN_AUF_TMOT_E KL_KH_VAN_DELAY_TMOT KL_KH_VAN_TMOT_F /end DEF_CHARACTERISTIC
 /begin OUT_MEASUREMENT kh_md_eta kh_md_eta_aeb kh_md_eta_diff kh_md_eta_grad kh_md_eta_grund kh_md_eta_roh kh_time_on kh_tkat kh_tkat_alt kh_tkat_alt_offset kh_tmot_start kh_van_fakt_max /end OUT_MEASUREMENT
/end FUNCTION
/begin FUNCTION KIS-Schnittstelle ""
 /begin DEF_CHARACTERISTIC K_KIS_ACTIVE_PULSE K_KIS_CFG K_KIS_LEN K_KIS_PERIOD K_KIS_START K_KIS_TIME_OUT /end DEF_CHARACTERISTIC
/end FUNCTION
/begin FUNCTION Klopfadaption ""
 /begin DEF_CHARACTERISTIC GKL_KA_ADAPT_MIN K_KA_ADAPT_MAX K_KA_AQ_GRAD_MAX K_KA_AQ_GRAD_SEGM_CNT K_KA_DIAG_T K_KA_DTZ_MAX K_KA_FILT_KK_KA K_KA_FILT_KK_KKA K_KA_FILT_LK K_KA_FILT_SK K_KA_KLIPPING_MAX K_KA_KS_CFG K_KA_RESET_CFG K_KA_TP_TAU K_KA_TREPP_F K_KA_TZ_KS K_KA_TZ_MIN_HYST KF_KA_F KF_KA_F_K KF_KA_OFFS KF_KA_OFFS_VL KF_KA_T_KOMP KL_KA_F_VL KL_KA_PUMG_VL KL_KA_RF_MIN /end DEF_CHARACTERISTIC
 /begin OUT_MEASUREMENT ka_adapt_min ka_adapt_tz_zyl_int ka_adapt_tz_zyl_int_max ka_adapt_tz_zyl_int_roh ka_aq_grad_segm_cnt_b1 ka_aq_grad_segm_cnt_b2 ka_dtz_diag_st ka_dtz_diag_t_b1 ka_dtz_diag_t_b2 ka_dtz_tp_zyl1 ka_dtz_tp_zyl10 ka_dtz_tp_zyl2 ka_dtz_tp_zyl3 ka_dtz_tp_zyl4 ka_dtz_tp_zyl5 ka_dtz_tp_zyl6 ka_dtz_tp_zyl7 ka_dtz_tp_zyl8 ka_dtz_tp_zyl9 ka_dtz_vl ka_dtz_zyl1 ka_dtz_zyl10 ka_dtz_zyl2 ka_dtz_zyl3 ka_dtz_zyl4 ka_dtz_zyl5 ka_dtz_zyl6 ka_dtz_zyl7 ka_dtz_zyl8 ka_dtz_zyl9 ka_f ka_f_k_b1 ka_f_k_b2 ka_offs_zyl1 ka_offs_zyl10 ka_offs_zyl2 ka_offs_zyl3 ka_offs_zyl4 ka_offs_zyl5 ka_offs_zyl6 ka_offs_zyl7 ka_offs_zyl8 ka_offs_zyl9 ka_pumg ka_rf_min_b1 ka_rf_min_b2 ka_st_b1 ka_st_b2 ka_t_komp_b1 ka_t_komp_b2 ka_tz_diag_st ka_tz_diag_t_b1 ka_tz_diag_t_b2 ka_tz_min_st /end OUT_MEASUREMENT
/end FUNCTION
/begin FUNCTION Klopfregelung ""
 /begin DEF_CHARACTERISTIC GKF_KR_ANZ_ASP_AUF GKF_KR_ANZ_ASP_HOLD GKF_KR_DTZ_AB GKF_KR_FBS_AVG_OFF_MAX GKF_KR_KNOCK_LAENGE GKF_KR_KNOCK_TZ_OFFS GKL_KR_AXIS_FBS GKL_KR_DTZ_MAX GKL_KR_FBS_AVG_OFF_MAX GKL_KR_RF_MIN K_KR_APPL_CFG K_KR_APPL_DTZ_ZYL1 K_KR_APPL_DTZ_ZYL10 K_KR_APPL_DTZ_ZYL2 K_KR_APPL_DTZ_ZYL3 K_KR_APPL_DTZ_ZYL4 K_KR_APPL_DTZ_ZYL5 K_KR_APPL_DTZ_ZYL6 K_KR_APPL_DTZ_ZYL7 K_KR_APPL_DTZ_ZYL8 K_KR_APPL_DTZ_ZYL9 K_KR_APPL_NUM_ZYL1 K_KR_APPL_NUM_ZYL10 K_KR_APPL_NUM_ZYL2 K_KR_APPL_NUM_ZYL3 K_KR_APPL_NUM_ZYL4 K_KR_APPL_NUM_ZYL5 K_KR_APPL_NUM_ZYL6 K_KR_APPL_NUM_ZYL7 K_KR_APPL_NUM_ZYL8 K_KR_APPL_NUM_ZYL9 K_KR_APPL_PER K_KR_CFG K_KR_DIAG_T K_KR_FB_LEN K_KR_FB_START K_KR_KLIPPING_MAX K_KR_TMOT_MIN KL_KR_FBS_AVG_NO /end DEF_CHARACTERISTIC
 /begin OUT_MEASUREMENT kr_ab_st kr_ab_st_zyl1 kr_ab_st_zyl10 kr_ab_st_zyl2 kr_ab_st_zyl3 kr_ab_st_zyl4 kr_ab_st_zyl5 kr_ab_st_zyl6 kr_ab_st_zyl7 kr_ab_st_zyl8 kr_ab_st_zyl9 kr_akt_st kr_akt_st_zyl1 kr_akt_st_zyl10 kr_akt_st_zyl2 kr_akt_st_zyl3 kr_akt_st_zyl4 kr_akt_st_zyl5 kr_akt_st_zyl6 kr_akt_st_zyl7 kr_akt_st_zyl8 kr_akt_st_zyl9 kr_anz_asp_auf kr_anz_asp_auf_bez_zyl1 kr_anz_asp_auf_bez_zyl10 kr_anz_asp_auf_bez_zyl2 kr_anz_asp_auf_bez_zyl3 kr_anz_asp_auf_bez_zyl4 kr_anz_asp_auf_bez_zyl5 kr_anz_asp_auf_bez_zyl6 kr_anz_asp_auf_bez_zyl7 kr_anz_asp_auf_bez_zyl8 kr_anz_asp_auf_bez_zyl9 kr_anz_asp_hold kr_appl_cnt_zyl1 kr_appl_cnt_zyl10 kr_appl_cnt_zyl2 kr_appl_cnt_zyl3 kr_appl_cnt_zyl4 kr_appl_cnt_zyl5 kr_appl_cnt_zyl6 kr_appl_cnt_zyl7 kr_appl_cnt_zyl8 kr_appl_cnt_zyl9 kr_asp_cnt kr_diag_st kr_dtz_ab_zyl1 kr_dtz_ab_zyl10 kr_dtz_ab_zyl2 kr_dtz_ab_zyl3 kr_dtz_ab_zyl4 kr_dtz_ab_zyl5 kr_dtz_ab_zyl6 kr_dtz_ab_zyl7 kr_dtz_ab_zyl8 kr_dtz_ab_zyl9 kr_dtz_bez_zyl1 kr_dtz_bez_zyl10 kr_dtz_bez_zyl2 kr_dtz_bez_zyl3 kr_dtz_bez_zyl4 kr_dtz_bez_zyl5 kr_dtz_bez_zyl6 kr_dtz_bez_zyl7 kr_dtz_bez_zyl8 kr_dtz_bez_zyl9 kr_dtz_diag_t_b1 kr_dtz_diag_t_b2 kr_dtz_grad_zyl1 kr_dtz_grad_zyl10 kr_dtz_grad_zyl2 kr_dtz_grad_zyl3 kr_dtz_grad_zyl4 kr_dtz_grad_zyl5 kr_dtz_grad_zyl6 kr_dtz_grad_zyl7 kr_dtz_grad_zyl8 kr_dtz_grad_zyl9 kr_dtz_int_zyl1 kr_dtz_int_zyl10 kr_dtz_int_zyl2 kr_dtz_int_zyl3 kr_dtz_int_zyl4 kr_dtz_int_zyl5 kr_dtz_int_zyl6 kr_dtz_int_zyl7 kr_dtz_int_zyl8 kr_dtz_int_zyl9 kr_dtz_max kr_dtz_mw_b1 kr_dtz_mw_b2 kr_dtz_sum_all kr_dtz_zyl1 kr_dtz_zyl10 kr_dtz_zyl2 kr_dtz_zyl3 kr_dtz_zyl4 kr_dtz_zyl5 kr_dtz_zyl6 kr_dtz_zyl7 kr_dtz_zyl8 kr_dtz_zyl9 kr_fbs_avg_delta_zyl1 kr_fbs_avg_delta_zyl10 kr_fbs_avg_delta_zyl2 kr_fbs_avg_delta_zyl3 kr_fbs_avg_delta_zyl4 kr_fbs_avg_delta_zyl5 kr_fbs_avg_delta_zyl6 kr_fbs_avg_delta_zyl7 kr_fbs_avg_delta_zyl8 kr_fbs_avg_delta_zyl9 kr_fbs_avg_no_b1 kr_fbs_avg_no_b2 kr_fbs_avg_off_max_b1 kr_fbs_avg_off_max_b2 kr_fbs_avg_zyl1 kr_fbs_avg_zyl10 kr_fbs_avg_zyl2 kr_fbs_avg_zyl3 kr_fbs_avg_zyl4 kr_fbs_avg_zyl5 kr_fbs_avg_zyl6 kr_fbs_avg_zyl7 kr_fbs_avg_zyl8 kr_fbs_avg_zyl9 kr_fbs_zyl1 kr_fbs_zyl10 kr_fbs_zyl2 kr_fbs_zyl3 kr_fbs_zyl4 kr_fbs_zyl5 kr_fbs_zyl6 kr_fbs_zyl7 kr_fbs_zyl8 kr_fbs_zyl9 kr_hold_count_zyl1 kr_hold_count_zyl10 kr_hold_count_zyl2 kr_hold_count_zyl3 kr_hold_count_zyl4 kr_hold_count_zyl5 kr_hold_count_zyl6 kr_hold_count_zyl7 kr_hold_count_zyl8 kr_hold_count_zyl9 kr_int_avg_norm_zyl1 kr_int_avg_norm_zyl10 kr_int_avg_norm_zyl2 kr_int_avg_norm_zyl3 kr_int_avg_norm_zyl4 kr_int_avg_norm_zyl5 kr_int_avg_norm_zyl6 kr_int_avg_norm_zyl7 kr_int_avg_norm_zyl8 kr_int_avg_norm_zyl9 kr_int_avg_zyl1 kr_int_avg_zyl10 kr_int_avg_zyl2 kr_int_avg_zyl3 kr_int_avg_zyl4 kr_int_avg_zyl5 kr_int_avg_zyl6 kr_int_avg_zyl7 kr_int_avg_zyl8 kr_int_avg_zyl9 kr_klipping_cnt_zyl1 kr_klipping_cnt_zyl10 kr_klipping_cnt_zyl2 kr_klipping_cnt_zyl3 kr_klipping_cnt_zyl4 kr_klipping_cnt_zyl5 kr_klipping_cnt_zyl6 kr_klipping_cnt_zyl7 kr_klipping_cnt_zyl8 kr_klipping_cnt_zyl9 kr_knock_laenge_b1 kr_knock_laenge_b2 kr_knock_tz_offs_b1 kr_knock_tz_offs_b2 kr_rf_min_b1 kr_rf_min_b2 kr_sst_fbs12_zyl1 kr_sst_fbs12_zyl10 kr_sst_fbs12_zyl2 kr_sst_fbs12_zyl3 kr_sst_fbs12_zyl4 kr_sst_fbs12_zyl5 kr_sst_fbs12_zyl6 kr_sst_fbs12_zyl7 kr_sst_fbs12_zyl8 kr_sst_fbs12_zyl9 kr_st_b1 kr_st_b2 kr_st_erk kr_st_erk_zyl1 kr_st_erk_zyl10 kr_st_erk_zyl2 kr_st_erk_zyl3 kr_st_erk_zyl4 kr_st_erk_zyl5 kr_st_erk_zyl6 kr_st_erk_zyl7 kr_st_erk_zyl8 kr_st_erk_zyl9 /end OUT_MEASUREMENT
/end FUNCTION
/begin FUNCTION Kuehleraustrittstemperatur ""
 /begin DEF_CHARACTERISTIC K_TKA_DIAG_MAX K_TKA_DIAG_MIN K_TKA_OBD_DELTA_HIGH K_TKA_OBD_DELTA_NORM K_TKA_OBD_TMOT_MIN K_TKA_TAU KL_TKA_NTC KL_TKA_OBD_TMOT_T /end DEF_CHARACTERISTIC
 /begin OUT_MEASUREMENT tka_ad tka_filter tka_obd_st tka_obd_tmot_t tka_roh /end OUT_MEASUREMENT
/end FUNCTION
/begin FUNCTION Kupplungsschlupfregelung ""
 /begin DEF_CHARACTERISTIC K_KUS_CFG K_KUS_GANG_MAX K_KUS_N_DELTA_AUS K_KUS_N_DELTA_EIN K_KUS_N_GETR_EIN_HYS K_KUS_N_GETR_EIN_MIN K_KUS_STUFE K_KUS_V_VORNE_HYS K_KUS_V_VORNE_MAX K_MD_KUS_BEGR_TAU_AUS K_MD_KUS_BEGR_TAU_EIN K_MD_KUS_BEGR_TAU1_AUS K_MD_KUS_BEGR_TAU1_EIN K_MD_KUS_PID_A1 KF_KUS_N_MIN KF_MD_KUS_KR KF_MD_KUS_TN KF_MD_KUS_TV KL_KUS_GANG_FAK KL_KUS_N_MIN_AFZ KL_KUS_SCHLUPF_MAX KL_MD_KUS_KR_FAK KL_MD_KUS_KUPP_MIN KL_MD_KUS_TN_FAK KL_MD_KUS_TV_FAK /end DEF_CHARACTERISTIC
 /begin OUT_MEASUREMENT kus_gang kus_n_getr_ein_alt kus_n_max kus_n_schlupf kus_st kus_st_enable kus_timer md_kus_begr md_kus_begr1 md_kus_n_dif md_kus_n_dif_verz1 md_kus_n_dif_verz2 md_kus_pid md_kus_pid_b0 md_kus_pid_b1 md_kus_pid_b2 md_kus_st_freigabe_alt md_kus_st_freigabe_alt_enable /end OUT_MEASUREMENT
/end FUNCTION
/begin FUNCTION KWP-Jobs "" /end FUNCTION
/begin FUNCTION KWP-Programmierung "" /end FUNCTION
/begin FUNCTION Ladungswechsel ""
 /begin DEF_CHARACTERISTIC AXIS_N_LW_N6 AXIS_N_LW_RF6 GKF_N_LW_A_WICHT GKF_N_LW_E_WICHT GKF_N_LW_WICHT K_N_LW_A_NOFFS_MAX K_N_LW_A_NOFFS_MIN K_N_LW_CFG K_N_LW_E_NOFFS_MAX K_N_LW_E_NOFFS_MIN K_N_LW_NOFFS_MAX K_N_LW_NOFFS_MIN KL_N_LW_TAN_LW_VERH_WURZEL /end DEF_CHARACTERISTIC
 /begin OUT_MEASUREMENT n_lw_a_b1 n_lw_a_b2 n_lw_a_wicht_b1 n_lw_a_wicht_b2 n_lw_e_b1 n_lw_e_b2 n_lw_e_wicht_b1 n_lw_e_wicht_b2 n_lw_n_sst6 n_lw_rf_sst6_b1 n_lw_rf_sst6_b2 n_lw_tan_lw_verh_wurzel_b1 n_lw_tan_lw_verh_wurzel_b2 n_lw_wicht_b1 n_lw_wicht_b2 /end OUT_MEASUREMENT
/end FUNCTION
/begin FUNCTION Laufunruhe ""
 /begin DEF_CHARACTERISTIC K_LU_WIN_LEN_B1 K_LU_WIN_LEN_B2 K_LU_WIN_PERIOD_B1 K_LU_WIN_PERIOD_B2 K_LU_WIN_START_B1 K_LU_WIN_START_B2 /end DEF_CHARACTERISTIC
 /begin OUT_MEASUREMENT lu_win_time_b1 lu_win_time_b2 /end OUT_MEASUREMENT
/end FUNCTION
/begin FUNCTION LAZ "" /begin DEF_CHARACTERISTIC K_LAZ_ANZ_SEG KF_LAZ_TAU /end DEF_CHARACTERISTIC
 /begin OUT_MEASUREMENT laz_aq_rf_b1 laz_aq_rf_b2 laz_idx_b1 laz_idx_b2 laz_md_rf_soll laz_md_rf_soll_pt_roh laz_n_lw_b1 laz_n_lw_b2 laz_rf_hfm_b1 laz_rf_hfm_b2 laz_tau /end OUT_MEASUREMENT
/end FUNCTION
/begin FUNCTION Leerlaufregler ""
 /begin DEF_CHARACTERISTIC K_LLR_CFG_MIN K_LLR_CFG_N_NACHF K_LLR_D_GRAD K_LLR_D_OFFSET K_LLR_DIAG_CSS_N_ZU_GROSS K_LLR_DIAG_CSS_N_ZU_KLEIN K_LLR_DIAG_CSS_T K_LLR_DIAG_CSS_T_IO K_LLR_DIAG_CSS_TMOT K_LLR_DIAG_CSS_TOEL K_LLR_DIAG_FRA_MAX K_LLR_DIAG_FRA_MIN K_LLR_DIAG_MD_ERR_ABR K_LLR_DIAG_MD_FAK K_LLR_DIAG_N_ZU_GROSS K_LLR_DIAG_N_ZU_KLEIN K_LLR_DIAG_T K_LLR_DIAG_T_IO K_LLR_DIAG_TMOT K_LLR_DIAG_TOEL K_LLR_DMD_MAX_E2 K_LLR_ERR_MAX_E2 K_LLR_IA_B1_ABR K_LLR_IA_B2_ABR K_LLR_MD_D_MAX K_LLR_MD_D_MIN K_LLR_MD_MAX_E2 K_LLR_MD_MIN_E2 K_LLR_MD_MKS_MAX K_LLR_MD_MKS_MIN K_LLR_MD_OKS_MAX K_LLR_MD_OKS_MIN K_LLR_MD_RES_AUFR K_LLR_MD_RES_WAIT K_LLR_MD_TZ_RUECK_HYS K_LLR_MD_TZ_RUECK_NEG K_LLR_MD_TZ_RUECK_POS K_LLR_MD_TZ_TAU K_LLR_N_DIFF_MAX_E2 K_LLR_N_EINGEREGELT K_LLR_N_KATH_ABR K_LLR_N_KATH_AUFR K_LLR_N_KATH_HYS K_LLR_N_OFFSET_B1 K_LLR_N_OFFSET_B2 K_LLR_N_RESET K_LLR_N_SOLL_AC_OFFSET K_LLR_N_SOLL_MAX K_LLR_N_SOLL_MIN K_LLR_N_SOLL_NF_FAKTOR K_LLR_N_SOLL_NF_FAKTOR_E2 K_LLR_N_SOLL_NF_MAX K_LLR_N_SOLL_NF_MAX_E2 K_LLR_N_SOLL_TAU K_LLR_N_SOLL_ZH_OFFSET K_LLR_OMEGA_TAU K_LLR_PWG_ANFAHR KF_LLR_MD_I_NEG_MKS KF_LLR_MD_I_NEG_OKS KF_LLR_MD_I_POS_MKS KF_LLR_MD_I_POS_OKS KL_LLR_D_FAK_TOEL KL_LLR_MD_RES_TMOT KL_LLR_MD_TZ_MKS KL_LLR_MD_TZ_MKS_KH KL_LLR_MD_TZ_OKS KL_LLR_MD_TZ_OKS_KH KL_LLR_N_SOLL_KH_OFF KL_LLR_N_SOLL_TMOT KL_LLR_N_SOLL_TMOT_E2 KL_LLR_N_SOLL_TOEL_OFF /end DEF_CHARACTERISTIC
 /begin OUT_MEASUREMENT llr_diag_flags llr_diag_flags_css llr_diag_state llr_diag_timer llr_diag_timer_io llr_exd_state llr_md_d llr_md_d_roh llr_md_i llr_md_i_max llr_md_i_max_e2 llr_md_i_min llr_md_p llr_md_res llr_md_schw_ist llr_md_tz llr_md_tz_fil llr_md_tz_rueck llr_n_diff llr_n_diff_nachf llr_n_soll_diff_e2 llr_n_soll_exd llr_n_soll_fil llr_n_soll_kh llr_n_soll_kh_fil llr_n_soll_kkos llr_n_soll_nachf llr_n_soll_tmot llr_n_soll_toel llr_omega_grad_ist llr_plausi_e2_err llr_timer /end OUT_MEASUREMENT
/end FUNCTION
/begin FUNCTION Leerlaufregleradaption ""
 /begin DEF_CHARACTERISTIC K_LLR_AD_AC_MAX K_LLR_AD_AC_MIN K_LLR_AD_CFG K_LLR_AD_I_ANTEIL_OFF K_LLR_AD_I_TAU K_LLR_AD_MD_GRAD K_LLR_AD_MD_NEUZUSTAND K_LLR_AD_MD_ZYKLUS_MAX K_LLR_AD_N_HYS_NEG K_LLR_AD_N_HYS_POS K_LLR_AD_NORM_MAX K_LLR_AD_NORM_MIN K_LLR_AD_TIME_STABIL K_LLR_AD_TMOT K_LLR_AD_TOEL K_LLR_AD_UMSCHALT_RAMPE /end DEF_CHARACTERISTIC
 /begin OUT_MEASUREMENT llr_ad_flags llr_ad_i_smooth llr_ad_md llr_ad_timer llr_ad_zustand /end OUT_MEASUREMENT
/end FUNCTION
/begin FUNCTION LOLIMOT "" /begin DEF_CHARACTERISTIC KL_E_FUNKTION /end DEF_CHARACTERISTIC /end FUNCTION
/begin RECORD_LAYOUT TAD_UB_VV_SW AXIS_PTS_X 3 SWORD INDEX_INCR DIRECT NO_AXIS_PTS_X 1 UBYTE RESERVED 2 BYTE /end RECORD_LAYOUT
/begin RECORD_LAYOUT TGF_VV_VV_SW FNC_VALUES 1 SWORD COLUMN_DIR DIRECT /end RECORD_LAYOUT
/begin RECORD_LAYOUT TGF_VV_VV_UB FNC_VALUES 1 UBYTE COLUMN_DIR DIRECT /end RECORD_LAYOUT
/begin RECORD_LAYOUT TGF_VV_VV_UW FNC_VALUES 1 UWORD COLUMN_DIR DIRECT /end RECORD_LAYOUT
/begin RECORD_LAYOUT TGL_VV_VV_SW FNC_VALUES 1 SWORD COLUMN_DIR DIRECT /end RECORD_LAYOUT
/begin RECORD_LAYOUT TKF_SW_SW_SW FNC_VALUES 5 SWORD COLUMN_DIR DIRECT AXIS_PTS_X 3 SWORD INDEX_INCR DIRECT AXIS_PTS_Y 4 SWORD INDEX_INCR DIRECT NO_AXIS_PTS_X 1 UBYTE NO_AXIS_PTS_Y 2 UBYTE /end RECORD_LAYOUT
/begin RECORD_LAYOUT TKF_SW_SW_UB FNC_VALUES 5 UBYTE COLUMN_DIR DIRECT AXIS_PTS_X 3 SWORD INDEX_INCR DIRECT AXIS_PTS_Y 4 SWORD INDEX_INCR DIRECT NO_AXIS_PTS_X 1 UBYTE NO_AXIS_PTS_Y 2 UBYTE /end RECORD_LAYOUT
/begin RECORD_LAYOUT TKF_SW_SW_UW FNC_VALUES 5 UWORD COLUMN_DIR DIRECT AXIS_PTS_X 3 SWORD INDEX_INCR DIRECT AXIS_PTS_Y 4 SWORD INDEX_INCR DIRECT NO_AXIS_PTS_X 1 UBYTE NO_AXIS_PTS_Y 2 UBYTE /end RECORD_LAYOUT
/begin RECORD_LAYOUT TKL_SF_VV_SF FNC_VALUES 5 FLOAT32_IEEE COLUMN_DIR DIRECT AXIS_PTS_X 4 FLOAT32_IEEE INDEX_INCR DIRECT NO_AXIS_PTS_X 1 UBYTE RESERVED 2 BYTE RESERVED 3 WORD /end RECORD_LAYOUT
/begin RECORD_LAYOUT TKL_SW_VV_SW FNC_VALUES 4 SWORD COLUMN_DIR DIRECT AXIS_PTS_X 3 SWORD INDEX_INCR DIRECT NO_AXIS_PTS_X 1 UBYTE RESERVED 2 BYTE /end RECORD_LAYOUT
/begin RECORD_LAYOUT TKL_SW_VV_UB FNC_VALUES 4 UBYTE COLUMN_DIR DIRECT AXIS_PTS_X 3 SWORD INDEX_INCR DIRECT NO_AXIS_PTS_X 1 UBYTE RESERVED 2 BYTE /end RECORD_LAYOUT
/begin RECORD_LAYOUT TKL_SW_VV_UW FNC_VALUES 4 UWORD COLUMN_DIR DIRECT AXIS_PTS_X 3 SWORD INDEX_INCR DIRECT NO_AXIS_PTS_X 1 UBYTE RESERVED 2 BYTE /end RECORD_LAYOUT
/begin RECORD_LAYOUT TKL_UB_VV_SW FNC_VALUES 4 SWORD COLUMN_DIR DIRECT AXIS_PTS_X 3 UBYTE INDEX_INCR DIRECT NO_AXIS_PTS_X 1 UBYTE RESERVED 2 BYTE /end RECORD_LAYOUT
/begin RECORD_LAYOUT TKL_UB_VV_UW FNC_VALUES 4 UWORD COLUMN_DIR DIRECT AXIS_PTS_X 3 UBYTE INDEX_INCR DIRECT NO_AXIS_PTS_X 1 UBYTE RESERVED 2 BYTE /end RECORD_LAYOUT
/begin RECORD_LAYOUT TKL_UW_VV_SW FNC_VALUES 4 SWORD COLUMN_DIR DIRECT AXIS_PTS_X 3 UWORD INDEX_INCR DIRECT NO_AXIS_PTS_X 1 UBYTE RESERVED 2 BYTE /end RECORD_LAYOUT
/begin RECORD_LAYOUT TKL_UW_VV_UW FNC_VALUES 4 UWORD COLUMN_DIR DIRECT AXIS_PTS_X 3 UWORD INDEX_INCR DIRECT NO_AXIS_PTS_X 1 UBYTE RESERVED 2 BYTE /end RECORD_LAYOUT
/begin RECORD_LAYOUT TKW_VV_VV_SB FNC_VALUES 1 SBYTE COLUMN_DIR DIRECT /end RECORD_LAYOUT
/begin RECORD_LAYOUT TKW_VV_VV_SF FNC_VALUES 1 FLOAT32_IEEE COLUMN_DIR DIRECT /end RECORD_LAYOUT
/begin RECORD_LAYOUT TKW_VV_VV_SW FNC_VALUES 1 SWORD COLUMN_DIR DIRECT /end RECORD_LAYOUT
/begin RECORD_LAYOUT TKW_VV_VV_UB FNC_VALUES 1 UBYTE COLUMN_DIR DIRECT /end RECORD_LAYOUT
/begin RECORD_LAYOUT TKW_VV_VV_UL FNC_VALUES 1 ULONG COLUMN_DIR DIRECT /end RECORD_LAYOUT
/begin RECORD_LAYOUT TKW_VV_VV_UW FNC_VALUES 1 UWORD COLUMN_DIR DIRECT /end RECORD_LAYOUT
/end MODULE
/end PROJECT
