ASAP2_VERSION 1 4
/begin PROJECT P_558 "EDC17_CP02"
/begin HEADER "" VERSION "V1C1" PROJECT_NO P_558 /end HEADER
/begin MODULE DIM ""
/begin MOD_COMMON "" BYTE_ORDER MSB_LAST ALIGNMENT_BYTE 1 ALIGNMENT_WORD 2 ALIGNMENT_LONG 4 ALIGNMENT_FLOAT32_IEEE 4 /end MOD_COMMON
/begin CHARACTERISTIC DFES_FaultTyp.DFC_AirCtlGovDvtEOMMax_C "/" VALUE 0x80074C92 Val_Wu8 255.0 DFES_OneToOne 0.00 255.0 FORMAT "%5.1" /end CHARACTERISTIC
/begin CHARACTERISTIC DFES_FaultTyp.DFC_AirCtlGovDvtEOMMin_C "/" VALUE 0x80074C93 Val_Wu8 255.0 DFES_OneToOne 0.00 255.0 FORMAT "%5.1" /end CHARACTERISTIC
/begin CHARACTERISTIC DFES_FaultTyp.DFC_AirCtlGovDvtMax_C "/" VALUE 0x80074C94 Val_Wu8 255.0 DFES_OneToOne 0.00 255.0 FORMAT "%5.1" /end CHARACTERISTIC
/begin CHARACTERISTIC DFES_FaultTyp.DFC_AirCtlGovDvtMin_C "/" VALUE 0x80074C95 Val_Wu8 255.0 DFES_OneToOne 0.00 255.0 FORMAT "%5.1" /end CHARACTERISTIC
/begin CHARACTERISTIC DFES_FaultTyp.DFC_Cj945SpiCom1_C "/" VALUE 0x80074C96 Val_Wu8 255.0 DFES_OneToOne 0.00 255.0 FORMAT "%5.1" /end CHARACTERISTIC
/begin CHARACTERISTIC DFES_FaultTyp.DFC_ComButtonMSASig_C "/" VALUE 0x80074C97 Val_Wu8 255.0 DFES_OneToOne 0.00 255.0 FORMAT "%5.1" /end CHARACTERISTIC
/begin CHARACTERISTIC DFES_FaultTyp.DFC_ComButtonMSATo_C "/" VALUE 0x80074C98 Val_Wu8 255.0 DFES_OneToOne 0.00 255.0 FORMAT "%5.1" /end CHARACTERISTIC
/begin CHARACTERISTIC DFES_FaultTyp.DFC_ComGearboxData2Sig_C "/" VALUE 0x80074C99 Val_Wu8 255.0 DFES_OneToOne 0.00 255.0 FORMAT "%5.1" /end CHARACTERISTIC
/begin CHARACTERISTIC DFES_FaultTyp.DFC_ComGearboxData2To_C "/" VALUE 0x80074C9A Val_Wu8 255.0 DFES_OneToOne 0.00 255.0 FORMAT "%5.1" /end CHARACTERISTIC
/begin CHARACTERISTIC DFES_FaultTyp.DFC_ComGearboxDataSig_C "/" VALUE 0x80074C9B Val_Wu8 255.0 DFES_OneToOne 0.00 255.0 FORMAT "%5.1" /end CHARACTERISTIC
/begin CHARACTERISTIC DFES_FaultTyp.DFC_ComGearboxDataTo_C "/" VALUE 0x80074C9C Val_Wu8 255.0 DFES_OneToOne 0.00 255.0 FORMAT "%5.1" /end CHARACTERISTIC
/begin CHARACTERISTIC DFES_FaultTyp.DFC_ComHeatACSig_C "/" VALUE 0x80074C9D Val_Wu8 255.0 DFES_OneToOne 0.00 255.0 FORMAT "%5.1" /end CHARACTERISTIC
/begin CHARACTERISTIC DFES_FaultTyp.DFC_ComHeatACTo_C "/" VALUE 0x80074C9E Val_Wu8 255.0 DFES_OneToOne 0.00 255.0 FORMAT "%5.1" /end CHARACTERISTIC
/begin CHARACTERISTIC DFES_FaultTyp.DFC_ComLenkradwinkelSig_C "/" VALUE 0x80074C9F Val_Wu8 255.0 DFES_OneToOne 0.00 255.0 FORMAT "%5.1" /end CHARACTERISTIC
/begin CHARACTERISTIC DFES_FaultTyp.DFC_ComLenkradwinkelTo_C "/" VALUE 0x80074CA0 Val_Wu8 255.0 DFES_OneToOne 0.00 255.0 FORMAT "%5.1" /end CHARACTERISTIC
/begin CHARACTERISTIC DFES_FaultTyp.DFC_ComMileageRangeSig_C "/" VALUE 0x80074CA1 Val_Wu8 255.0 DFES_OneToOne 0.00 255.0 FORMAT "%5.1" /end CHARACTERISTIC
/begin CHARACTERISTIC DFES_FaultTyp.DFC_ComMileageRangeTo_C "/" VALUE 0x80074CA2 Val_Wu8 255.0 DFES_OneToOne 0.00 255.0 FORMAT "%5.1" /end CHARACTERISTIC
/begin CHARACTERISTIC DFES_FaultTyp.DFC_ComPspSig_C "/" VALUE 0x80074CA3 Val_Wu8 255.0 DFES_OneToOne 0.00 255.0 FORMAT "%5.1" /end CHARACTERISTIC
/begin CHARACTERISTIC DFES_FaultTyp.DFC_ComPspTo_C "/" VALUE 0x80074CA4 Val_Wu8 255.0 DFES_OneToOne 0.00 255.0 FORMAT "%5.1" /end CHARACTERISTIC
/begin CHARACTERISTIC DFES_FaultTyp.DFC_ComShutOffPSPSig_C "/" VALUE 0x80074CA5 Val_Wu8 255.0 DFES_OneToOne 0.00 255.0 FORMAT "%5.1" /end CHARACTERISTIC
/begin CHARACTERISTIC DFES_FaultTyp.DFC_ComShutOffPSPTo_C "/" VALUE 0x80074CA6 Val_Wu8 255.0 DFES_OneToOne 0.00 255.0 FORMAT "%5.1" /end CHARACTERISTIC
/begin CHARACTERISTIC DFES_FaultTyp.DFC_ComStKombiCtr_C "/" VALUE 0x80074CA7 Val_Wu8 255.0 DFES_OneToOne 0.00 255.0 FORMAT "%5.1" /end CHARACTERISTIC
/begin CHARACTERISTIC DFES_FaultTyp.DFC_ComStKombiSig_C "/" VALUE 0x80074CA8 Val_Wu8 255.0 DFES_OneToOne 0.00 255.0 FORMAT "%5.1" /end CHARACTERISTIC
/begin CHARACTERISTIC DFES_FaultTyp.DFC_ComStKombiTo_C "/" VALUE 0x80074CA9 Val_Wu8 255.0 DFES_OneToOne 0.00 255.0 FORMAT "%5.1" /end CHARACTERISTIC
/begin CHARACTERISTIC DFES_FaultTyp.DFC_ComStateARSCtr_C "/" VALUE 0x80074CAA Val_Wu8 255.0 DFES_OneToOne 0.00 255.0 FORMAT "%5.1" /end CHARACTERISTIC
/begin CHARACTERISTIC DFES_FaultTyp.DFC_ComStateARSSig_C "/" VALUE 0x80074CAB Val_Wu8 255.0 DFES_OneToOne 0.00 255.0 FORMAT "%5.1" /end CHARACTERISTIC
/begin CHARACTERISTIC DFES_FaultTyp.DFC_ComStateARSTo_C "/" VALUE 0x80074CAC Val_Wu8 255.0 DFES_OneToOne 0.00 255.0 FORMAT "%5.1" /end CHARACTERISTIC
/begin CHARACTERISTIC DFES_FaultTyp.DFC_ComStateDscSig_C "/" VALUE 0x80074CAD Val_Wu8 255.0 DFES_OneToOne 0.00 255.0 FORMAT "%5.1" /end CHARACTERISTIC
/begin CHARACTERISTIC DFES_FaultTyp.DFC_ComStateDscTo_C "/" VALUE 0x80074CAE Val_Wu8 255.0 DFES_OneToOne 0.00 255.0 FORMAT "%5.1" /end CHARACTERISTIC
/begin CHARACTERISTIC DFES_FaultTyp.DFC_ComStateSeatSig_C "/" VALUE 0x80074CAF Val_Wu8 255.0 DFES_OneToOne 0.00 255.0 FORMAT "%5.1" /end CHARACTERISTIC
/begin CHARACTERISTIC DFES_FaultTyp.DFC_ComStateSeatTo_C "/" VALUE 0x80074CB0 Val_Wu8 255.0 DFES_OneToOne 0.00 255.0 FORMAT "%5.1" /end CHARACTERISTIC
/begin CHARACTERISTIC DFES_FaultTyp.DFC_ComTempRelTimeSig_C "/" VALUE 0x80074CB1 Val_Wu8 255.0 DFES_OneToOne 0.00 255.0 FORMAT "%5.1" /end CHARACTERISTIC
/begin CHARACTERISTIC DFES_FaultTyp.DFC_ComTempRelTimeTo_C "/" VALUE 0x80074CB2 Val_Wu8 255.0 DFES_OneToOne 0.00 255.0 FORMAT "%5.1" /end CHARACTERISTIC
/begin CHARACTERISTIC DFES_FaultTyp.DFC_ComTerminalChk_C "/" VALUE 0x80074CB3 Val_Wu8 255.0 DFES_OneToOne 0.00 255.0 FORMAT "%5.1" /end CHARACTERISTIC
/begin CHARACTERISTIC DFES_FaultTyp.DFC_ComTerminalCtr_C "/" VALUE 0x80074CB4 Val_Wu8 255.0 DFES_OneToOne 0.00 255.0 FORMAT "%5.1" /end CHARACTERISTIC
/begin CHARACTERISTIC DFES_FaultTyp.DFC_ComTerminalSig_C "/" VALUE 0x80074CB5 Val_Wu8 255.0 DFES_OneToOne 0.00 255.0 FORMAT "%5.1" /end CHARACTERISTIC
/begin CHARACTERISTIC DFES_FaultTyp.DFC_ComTerminalTo_C "/" VALUE 0x80074CB6 Val_Wu8 255.0 DFES_OneToOne 0.00 255.0 FORMAT "%5.1" /end CHARACTERISTIC
/begin CHARACTERISTIC DFES_FaultTyp.DFC_ComTimeDateSig_C "/" VALUE 0x80074CB7 Val_Wu8 255.0 DFES_OneToOne 0.00 255.0 FORMAT "%5.1" /end CHARACTERISTIC
/begin CHARACTERISTIC DFES_FaultTyp.DFC_ComTimeDateTo_C "/" VALUE 0x80074CB8 Val_Wu8 255.0 DFES_OneToOne 0.00 255.0 FORMAT "%5.1" /end CHARACTERISTIC
/begin CHARACTERISTIC DFES_FaultTyp.DFC_ComTrailerSig_C "/" VALUE 0x80074CB9 Val_Wu8 255.0 DFES_OneToOne 0.00 255.0 FORMAT "%5.1" /end CHARACTERISTIC
/begin CHARACTERISTIC DFES_FaultTyp.DFC_ComTrailerTo_C "/" VALUE 0x80074CBA Val_Wu8 255.0 DFES_OneToOne 0.00 255.0 FORMAT "%5.1" /end CHARACTERISTIC
/begin CHARACTERISTIC DFES_FaultTyp.DFC_ComTrqDemandAfsChk_C "/" VALUE 0x80074CBB Val_Wu8 255.0 DFES_OneToOne 0.00 255.0 FORMAT "%5.1" /end CHARACTERISTIC
/begin CHARACTERISTIC DFES_FaultTyp.DFC_ComTrqDemandAfsCtr_C "/" VALUE 0x80074CBC Val_Wu8 255.0 DFES_OneToOne 0.00 255.0 FORMAT "%5.1" /end CHARACTERISTIC
/begin CHARACTERISTIC DFES_FaultTyp.DFC_ComTrqDemandAfsSig_C "/" VALUE 0x80074CBD Val_Wu8 255.0 DFES_OneToOne 0.00 255.0 FORMAT "%5.1" /end CHARACTERISTIC
/begin CHARACTERISTIC DFES_FaultTyp.DFC_ComTrqDemandAfsTo_C "/" VALUE 0x80074CBE Val_Wu8 255.0 DFES_OneToOne 0.00 255.0 FORMAT "%5.1" /end CHARACTERISTIC
/begin CHARACTERISTIC DFES_FaultTyp.DFC_ComTrqDemandDscChk_C "/" VALUE 0x80074CBF Val_Wu8 255.0 DFES_OneToOne 0.00 255.0 FORMAT "%5.1" /end CHARACTERISTIC
/begin CHARACTERISTIC DFES_FaultTyp.DFC_ComTrqDemandDscCtr_C "/" VALUE 0x80074CC0 Val_Wu8 255.0 DFES_OneToOne 0.00 255.0 FORMAT "%5.1" /end CHARACTERISTIC
/begin CHARACTERISTIC DFES_FaultTyp.DFC_ComTrqDemandDscSig_C "/" VALUE 0x80074CC1 Val_Wu8 255.0 DFES_OneToOne 0.00 255.0 FORMAT "%5.1" /end CHARACTERISTIC
/begin CHARACTERISTIC DFES_FaultTyp.DFC_ComTrqDemandDscTo_C "/" VALUE 0x80074CC2 Val_Wu8 255.0 DFES_OneToOne 0.00 255.0 FORMAT "%5.1" /end CHARACTERISTIC
/begin CHARACTERISTIC DFES_FaultTyp.DFC_ComTrqDemandGbxChk_C "/" VALUE 0x80074CC3 Val_Wu8 255.0 DFES_OneToOne 0.00 255.0 FORMAT "%5.1" /end CHARACTERISTIC
/begin CHARACTERISTIC DFES_FaultTyp.DFC_ComTrqDemandGbxCtr_C "/" VALUE 0x80074CC4 Val_Wu8 255.0 DFES_OneToOne 0.00 255.0 FORMAT "%5.1" /end CHARACTERISTIC
/begin CHARACTERISTIC DFES_FaultTyp.DFC_ComTrqDemandGbxSig_C "/" VALUE 0x80074CC5 Val_Wu8 255.0 DFES_OneToOne 0.00 255.0 FORMAT "%5.1" /end CHARACTERISTIC
/begin CHARACTERISTIC DFES_FaultTyp.DFC_ComTrqDemandGbxTo_C "/" VALUE 0x80074CC6 Val_Wu8 255.0 DFES_OneToOne 0.00 255.0 FORMAT "%5.1" /end CHARACTERISTIC
/begin CHARACTERISTIC DFES_FaultTyp.DFC_ComVelocitySig_C "/" VALUE 0x80074CC7 Val_Wu8 255.0 DFES_OneToOne 0.00 255.0 FORMAT "%5.1" /end CHARACTERISTIC
/begin CHARACTERISTIC DFES_FaultTyp.DFC_ComVelocityTo_C "/" VALUE 0x80074CC8 Val_Wu8 255.0 DFES_OneToOne 0.00 255.0 FORMAT "%5.1" /end CHARACTERISTIC
/begin CHARACTERISTIC DFES_FaultTyp.DFC_ComWheelSpeedSig_C "/" VALUE 0x80074CC9 Val_Wu8 255.0 DFES_OneToOne 0.00 255.0 FORMAT "%5.1" /end CHARACTERISTIC
/begin CHARACTERISTIC DFES_FaultTyp.DFC_ComWheelSpeedTo_C "/" VALUE 0x80074CCA Val_Wu8 255.0 DFES_OneToOne 0.00 255.0 FORMAT "%5.1" /end CHARACTERISTIC
/begin CHARACTERISTIC DFES_FaultTyp.DFC_ComZvKlappenSig_C "/" VALUE 0x80074CCB Val_Wu8 255.0 DFES_OneToOne 0.00 255.0 FORMAT "%5.1" /end CHARACTERISTIC
/begin CHARACTERISTIC DFES_FaultTyp.DFC_ComZvKlappenTo_C "/" VALUE 0x80074CCC Val_Wu8 255.0 DFES_OneToOne 0.00 255.0 FORMAT "%5.1" /end CHARACTERISTIC
/begin CHARACTERISTIC DFES_FaultTyp.DFC_Cy150SpiCom_C "/" VALUE 0x80074CCD Val_Wu8 255.0 DFES_OneToOne 0.00 255.0 FORMAT "%5.1" /end CHARACTERISTIC
/begin CHARACTERISTIC DFES_FaultTyp.DFC_Cy320SpiCom_C "/" VALUE 0x80074CCE Val_Wu8 255.0 DFES_OneToOne 0.00 255.0 FORMAT "%5.1" /end CHARACTERISTIC
/begin CHARACTERISTIC DFES_FaultTyp.DFC_ETCtlDvtInrMax_C "/" VALUE 0x80074CCF Val_Wu8 255.0 DFES_OneToOne 0.00 255.0 FORMAT "%5.1" /end CHARACTERISTIC
/begin CHARACTERISTIC DFES_FaultTyp.DFC_ETCtlDvtInrMin_C "/" VALUE 0x80074CD0 Val_Wu8 255.0 DFES_OneToOne 0.00 255.0 FORMAT "%5.1" /end CHARACTERISTIC
/begin CHARACTERISTIC DFES_FaultTyp.DFC_ETCtlDvtOutrMax_C "/" VALUE 0x80074CD1 Val_Wu8 255.0 DFES_OneToOne 0.00 255.0 FORMAT "%5.1" /end CHARACTERISTIC
/begin CHARACTERISTIC DFES_FaultTyp.DFC_ETCtlDvtOutrMin_C "/" VALUE 0x80074CD2 Val_Wu8 255.0 DFES_OneToOne 0.00 255.0 FORMAT "%5.1" /end CHARACTERISTIC
/begin CHARACTERISTIC DFES_FaultTyp.DFC_Fan4WinErr1_C "/" VALUE 0x80074CD3 Val_Wu8 255.0 DFES_OneToOne 0.00 255.0 FORMAT "%5.1" /end CHARACTERISTIC
/begin CHARACTERISTIC DFES_FaultTyp.DFC_Fan4WinErr2_C "/" VALUE 0x80074CD4 Val_Wu8 255.0 DFES_OneToOne 0.00 255.0 FORMAT "%5.1" /end CHARACTERISTIC
/begin CHARACTERISTIC DFES_FaultTyp.DFC_Fan4WinErr3_C "/" VALUE 0x80074CD5 Val_Wu8 255.0 DFES_OneToOne 0.00 255.0 FORMAT "%5.1" /end CHARACTERISTIC
/begin CHARACTERISTIC DFES_FaultTyp.DFC_Fan4WinErr4_C "/" VALUE 0x80074CD6 Val_Wu8 255.0 DFES_OneToOne 0.00 255.0 FORMAT "%5.1" /end CHARACTERISTIC
/begin CHARACTERISTIC DFES_FaultTyp.DFC_FanSCG_C "/" VALUE 0x80074CD7 Val_Wu8 255.0 DFES_OneToOne 0.00 255.0 FORMAT "%5.1" /end CHARACTERISTIC
/begin CHARACTERISTIC DFES_FaultTyp.DFC_PCRGovDvtLPMax_C "/" VALUE 0x80074CD8 Val_Wu8 255.0 DFES_OneToOne 0.00 255.0 FORMAT "%5.1" /end CHARACTERISTIC
/begin CHARACTERISTIC DFES_FaultTyp.DFC_PCRGovDvtLPMin_C "/" VALUE 0x80074CD9 Val_Wu8 255.0 DFES_OneToOne 0.00 255.0 FORMAT "%5.1" /end CHARACTERISTIC
/begin CHARACTERISTIC DFES_FaultTyp.DFC_PCRGovDvtMax_C "/" VALUE 0x80074CDA Val_Wu8 255.0 DFES_OneToOne 0.00 255.0 FORMAT "%5.1" /end CHARACTERISTIC
/begin CHARACTERISTIC DFES_FaultTyp.DFC_PCRGovDvtMin_C "/" VALUE 0x80074CDB Val_Wu8 255.0 DFES_OneToOne 0.00 255.0 FORMAT "%5.1" /end CHARACTERISTIC
/begin CHARACTERISTIC DFES_FaultTyp.DFC_RailCPC1_C "/" VALUE 0x80074CDC Val_Wu8 255.0 DFES_OneToOne 0.00 255.0 FORMAT "%5.1" /end CHARACTERISTIC
/begin CHARACTERISTIC DFES_FaultTyp.DFC_RailCPC3_C "/" VALUE 0x80074CDD Val_Wu8 255.0 DFES_OneToOne 0.00 255.0 FORMAT "%5.1" /end CHARACTERISTIC
/begin CHARACTERISTIC DFES_FaultTyp.DFC_RailCPC4_C "/" VALUE 0x80074CDE Val_Wu8 255.0 DFES_OneToOne 0.00 255.0 FORMAT "%5.1" /end CHARACTERISTIC
/begin CHARACTERISTIC DFES_FaultTyp.DFC_RailMeUn0_C "/" VALUE 0x80074CDF Val_Wu8 255.0 DFES_OneToOne 0.00 255.0 FORMAT "%5.1" /end CHARACTERISTIC
/begin CHARACTERISTIC DFES_FaultTyp.DFC_RailMeUn1_C "/" VALUE 0x80074CE0 Val_Wu8 255.0 DFES_OneToOne 0.00 255.0 FORMAT "%5.1" /end CHARACTERISTIC
/begin CHARACTERISTIC DFES_FaultTyp.DFC_RailMeUn2_C "/" VALUE 0x80074CE1 Val_Wu8 255.0 DFES_OneToOne 0.00 255.0 FORMAT "%5.1" /end CHARACTERISTIC
/begin CHARACTERISTIC DFES_FaultTyp.DFC_RailMeUn3_C "/" VALUE 0x80074CE2 Val_Wu8 255.0 DFES_OneToOne 0.00 255.0 FORMAT "%5.1" /end CHARACTERISTIC
/begin CHARACTERISTIC DFES_FaultTyp.DFC_RailMeUn4_C "/" VALUE 0x80074CE3 Val_Wu8 255.0 DFES_OneToOne 0.00 255.0 FORMAT "%5.1" /end CHARACTERISTIC
/begin CHARACTERISTIC DFES_FaultTyp.DFC_RailPCV0_C "/" VALUE 0x80074CE4 Val_Wu8 255.0 DFES_OneToOne 0.00 255.0 FORMAT "%5.1" /end CHARACTERISTIC
/begin CHARACTERISTIC DFES_FaultTyp.DFC_RailPCV1_C "/" VALUE 0x80074CE5 Val_Wu8 255.0 DFES_OneToOne 0.00 255.0 FORMAT "%5.1" /end CHARACTERISTIC
/begin CHARACTERISTIC DFES_FaultTyp.DFC_RailPCV2_C "/" VALUE 0x80074CE6 Val_Wu8 255.0 DFES_OneToOne 0.00 255.0 FORMAT "%5.1" /end CHARACTERISTIC
/begin CHARACTERISTIC DFES_FaultTyp.DFC_RailPCV3_C "/" VALUE 0x80074CE7 Val_Wu8 255.0 DFES_OneToOne 0.00 255.0 FORMAT "%5.1" /end CHARACTERISTIC
/begin CHARACTERISTIC DFES_FaultTyp.DFC_RailPCV4_C "/" VALUE 0x80074CE8 Val_Wu8 255.0 DFES_OneToOne 0.00 255.0 FORMAT "%5.1" /end CHARACTERISTIC
/begin CHARACTERISTIC DFES_FaultTyp.DFC_RailPMonStrt_C "/" VALUE 0x80074CE9 Val_Wu8 255.0 DFES_OneToOne 0.00 255.0 FORMAT "%5.1" /end CHARACTERISTIC
/begin CHARACTERISTIC DFES_FaultTyp.DFC_SSpMon1_C "/" VALUE 0x80074CEA Val_Wu8 255.0 DFES_OneToOne 0.00 255.0 FORMAT "%5.1" /end CHARACTERISTIC
/begin CHARACTERISTIC DFES_FaultTyp.DFC_SSpMon2_C "/" VALUE 0x80074CEB Val_Wu8 255.0 DFES_OneToOne 0.00 255.0 FORMAT "%5.1" /end CHARACTERISTIC
/begin CHARACTERISTIC DFES_FaultTyp.DFC_SSpMon3_C "/" VALUE 0x80074CEC Val_Wu8 255.0 DFES_OneToOne 0.00 255.0 FORMAT "%5.1" /end CHARACTERISTIC
/begin CHARACTERISTIC DFES_FaultTyp.DFC_Sia_E1_C "/" VALUE 0x80074CED Val_Wu8 255.0 DFES_OneToOne 0.00 255.0 FORMAT "%5.1" /end CHARACTERISTIC
/begin CHARACTERISTIC DFES_FaultTyp.DFC_Sia_E10_C "/" VALUE 0x80074CEE Val_Wu8 255.0 DFES_OneToOne 0.00 255.0 FORMAT "%5.1" /end CHARACTERISTIC
/begin CHARACTERISTIC DFES_FaultTyp.DFC_Sia_E11_C "/" VALUE 0x80074CEF Val_Wu8 255.0 DFES_OneToOne 0.00 255.0 FORMAT "%5.1" /end CHARACTERISTIC
/begin CHARACTERISTIC DFES_FaultTyp.DFC_Sia_E12_C "/" VALUE 0x80074CF0 Val_Wu8 255.0 DFES_OneToOne 0.00 255.0 FORMAT "%5.1" /end CHARACTERISTIC
/begin CHARACTERISTIC DFES_FaultTyp.DFC_Sia_E13_C "/" VALUE 0x80074CF1 Val_Wu8 255.0 DFES_OneToOne 0.00 255.0 FORMAT "%5.1" /end CHARACTERISTIC
/begin CHARACTERISTIC DFES_FaultTyp.DFC_Sia_E14_C "/" VALUE 0x80074CF2 Val_Wu8 255.0 DFES_OneToOne 0.00 255.0 FORMAT "%5.1" /end CHARACTERISTIC
/begin CHARACTERISTIC DFES_FaultTyp.DFC_Sia_E15_C "/" VALUE 0x80074CF3 Val_Wu8 255.0 DFES_OneToOne 0.00 255.0 FORMAT "%5.1" /end CHARACTERISTIC
/begin CHARACTERISTIC DFES_FaultTyp.DFC_Sia_E2_C "/" VALUE 0x80074CF4 Val_Wu8 255.0 DFES_OneToOne 0.00 255.0 FORMAT "%5.1" /end CHARACTERISTIC
/begin CHARACTERISTIC DFES_FaultTyp.DFC_Sia_E3_C "/" VALUE 0x80074CF5 Val_Wu8 255.0 DFES_OneToOne 0.00 255.0 FORMAT "%5.1" /end CHARACTERISTIC
/begin CHARACTERISTIC DFES_FaultTyp.DFC_Sia_E4_C "/" VALUE 0x80074CF6 Val_Wu8 255.0 DFES_OneToOne 0.00 255.0 FORMAT "%5.1" /end CHARACTERISTIC
/begin CHARACTERISTIC DFES_FaultTyp.DFC_Sia_E5_C "/" VALUE 0x80074CF7 Val_Wu8 255.0 DFES_OneToOne 0.00 255.0 FORMAT "%5.1" /end CHARACTERISTIC
/begin CHARACTERISTIC DFES_FaultTyp.DFC_Sia_E6_C "/" VALUE 0x80074CF8 Val_Wu8 255.0 DFES_OneToOne 0.00 255.0 FORMAT "%5.1" /end CHARACTERISTIC
/begin CHARACTERISTIC DFES_FaultTyp.DFC_Sia_E7_C "/" VALUE 0x80074CF9 Val_Wu8 255.0 DFES_OneToOne 0.00 255.0 FORMAT "%5.1" /end CHARACTERISTIC
/begin CHARACTERISTIC DFES_FaultTyp.DFC_Sia_E8_C "/" VALUE 0x80074CFA Val_Wu8 255.0 DFES_OneToOne 0.00 255.0 FORMAT "%5.1" /end CHARACTERISTIC
/begin CHARACTERISTIC DFES_FaultTyp.DFC_Sia_E9_C "/" VALUE 0x80074CFB Val_Wu8 255.0 DFES_OneToOne 0.00 255.0 FORMAT "%5.1" /end CHARACTERISTIC
/begin CHARACTERISTIC DFES_FaultTyp.DFC_ThrVlv4WinErr1_C "/" VALUE 0x80074CFC Val_Wu8 255.0 DFES_OneToOne 0.00 255.0 FORMAT "%5.1" /end CHARACTERISTIC
/begin CHARACTERISTIC DFES_FaultTyp.DFC_ThrVlv4WinErr2_C "/" VALUE 0x80074CFD Val_Wu8 255.0 DFES_OneToOne 0.00 255.0 FORMAT "%5.1" /end CHARACTERISTIC
/begin CHARACTERISTIC DFES_FaultTyp.DFC_ThrVlv4WinErr3_C "/" VALUE 0x80074CFE Val_Wu8 255.0 DFES_OneToOne 0.00 255.0 FORMAT "%5.1" /end CHARACTERISTIC
/begin CHARACTERISTIC DFES_FaultTyp.DFC_ThrVlv4WinErr4_C "/" VALUE 0x80074CFF Val_Wu8 255.0 DFES_OneToOne 0.00 255.0 FORMAT "%5.1" /end CHARACTERISTIC
/begin CHARACTERISTIC DFES_FaultTyp.DFC_ThrVlvSCG_C "/" VALUE 0x80074D00 Val_Wu8 255.0 DFES_OneToOne 0.00 255.0 FORMAT "%5.1" /end CHARACTERISTIC
/begin CHARACTERISTIC DFES_FaultTyp.DFC_TrbCh4WinErr1_C "/" VALUE 0x80074D01 Val_Wu8 255.0 DFES_OneToOne 0.00 255.0 FORMAT "%5.1" /end CHARACTERISTIC
/begin CHARACTERISTIC DFES_FaultTyp.DFC_TrbCh4WinErr2_C "/" VALUE 0x80074D02 Val_Wu8 255.0 DFES_OneToOne 0.00 255.0 FORMAT "%5.1" /end CHARACTERISTIC
/begin CHARACTERISTIC DFES_FaultTyp.DFC_TrbCh4WinErr3_C "/" VALUE 0x80074D03 Val_Wu8 255.0 DFES_OneToOne 0.00 255.0 FORMAT "%5.1" /end CHARACTERISTIC
/begin CHARACTERISTIC DFES_FaultTyp.DFC_TrbCh4WinErr4_C "/" VALUE 0x80074D04 Val_Wu8 255.0 DFES_OneToOne 0.00 255.0 FORMAT "%5.1" /end CHARACTERISTIC
/begin CHARACTERISTIC DFES_FaultTyp.DFC_TrbChSCG_C "/" VALUE 0x80074D05 Val_Wu8 255.0 DFES_OneToOne 0.00 255.0 FORMAT "%5.1" /end CHARACTERISTIC
/begin CHARACTERISTIC DFES_FaultTyp.DFC_TrbChSRCMax_C "/" VALUE 0x80074D06 Val_Wu8 255.0 DFES_OneToOne 0.00 255.0 FORMAT "%5.1" /end CHARACTERISTIC
/begin CHARACTERISTIC DFES_FaultTyp.DFC_TrbChSRCMin_C "/" VALUE 0x80074D07 Val_Wu8 255.0 DFES_OneToOne 0.00 255.0 FORMAT "%5.1" /end CHARACTERISTIC
/begin CHARACTERISTIC DFES_FaultTyp.DFC_WaHtEl4WinErr1_C "/" VALUE 0x80074D08 Val_Wu8 255.0 DFES_OneToOne 0.00 255.0 FORMAT "%5.1" /end CHARACTERISTIC
/begin CHARACTERISTIC DFES_FaultTyp.DFC_WaHtEl4WinErr2_C "/" VALUE 0x80074D09 Val_Wu8 255.0 DFES_OneToOne 0.00 255.0 FORMAT "%5.1" /end CHARACTERISTIC
/begin CHARACTERISTIC DFES_FaultTyp.DFC_WaHtEl4WinErr3_C "/" VALUE 0x80074D0A Val_Wu8 255.0 DFES_OneToOne 0.00 255.0 FORMAT "%5.1" /end CHARACTERISTIC
/begin CHARACTERISTIC DFES_FaultTyp.DFC_WaHtEl4WinErr4_C "/" VALUE 0x80074D0B Val_Wu8 255.0 DFES_OneToOne 0.00 255.0 FORMAT "%5.1" /end CHARACTERISTIC
/begin CHARACTERISTIC DFES_FaultTyp.DFC_WaHtElSCG_C "/" VALUE 0x80074D0C Val_Wu8 255.0 DFES_OneToOne 0.00 255.0 FORMAT "%5.1" /end CHARACTERISTIC
/begin CHARACTERISTIC DFES_FaultTyp.DFC_ETClbETFltMax_C "/" VALUE 0x80074D0D Val_Wu8 255.0 DFES_OneToOne 0.00 255.0 FORMAT "%5.1" /end CHARACTERISTIC
/begin CHARACTERISTIC DFES_FaultTyp.DFC_ETClbETFltMin_C "/" VALUE 0x80074D0E Val_Wu8 255.0 DFES_OneToOne 0.00 255.0 FORMAT "%5.1" /end CHARACTERISTIC
/begin CHARACTERISTIC DFES_FaultTyp.DFC_InjCrvInjLimChrgBal_C "/" VALUE 0x80074D0F Val_Wu8 255.0 DFES_OneToOne 0.00 255.0 FORMAT "%5.1" /end CHARACTERISTIC
/begin CHARACTERISTIC DFES_FaultTyp.DFC_InjCrvInjLimQntBal_C "/" VALUE 0x80074D10 Val_Wu8 255.0 DFES_OneToOne 0.00 255.0 FORMAT "%5.1" /end CHARACTERISTIC
/begin CHARACTERISTIC DFES_FaultTyp.DFC_InjCrvInjLimSys_C "/" VALUE 0x80074D11 Val_Wu8 255.0 DFES_OneToOne 0.00 255.0 FORMAT "%5.1" /end CHARACTERISTIC
/begin CHARACTERISTIC DFES_FaultTyp.DFC_InjCrvNumInjRtmLim_C "/" VALUE 0x80074D12 Val_Wu8 255.0 DFES_OneToOne 0.00 255.0 FORMAT "%5.1" /end CHARACTERISTIC
/begin CHARACTERISTIC DFES_FaultTyp.DFC_LSUHtCoupSig_0_C "/" VALUE 0x80074D13 Val_Wu8 255.0 DFES_OneToOne 0.00 255.0 FORMAT "%5.1" /end CHARACTERISTIC
/begin CHARACTERISTIC DFES_FaultTyp.DFC_LSUHtCoupSig_1_C "/" VALUE 0x80074D14 Val_Wu8 255.0 DFES_OneToOne 0.00 255.0 FORMAT "%5.1" /end CHARACTERISTIC
/begin CHARACTERISTIC DFES_FaultTyp.DFC_LSUHtCoupSig_2_C "/" VALUE 0x80074D15 Val_Wu8 255.0 DFES_OneToOne 0.00 255.0 FORMAT "%5.1" /end CHARACTERISTIC
/begin CHARACTERISTIC DFES_FaultTyp.DFC_LSUHtCoupSig_3_C "/" VALUE 0x80074D16 Val_Wu8 255.0 DFES_OneToOne 0.00 255.0 FORMAT "%5.1" /end CHARACTERISTIC
/begin CHARACTERISTIC DFES_FaultTyp.DFC_CtT_C "/" VALUE 0x80074D17 Val_Wu8 255.0 DFES_OneToOne 0.00 255.0 FORMAT "%5.1" /end CHARACTERISTIC
/begin CHARACTERISTIC DFES_FaultTyp.DFC_DSMDummy_C "/" VALUE 0x80074D18 Val_Wu8 255.0 DFES_OneToOne 0.00 255.0 FORMAT "%5.1" /end CHARACTERISTIC
/begin CHARACTERISTIC DFES_FaultTyp.DFC_MeUnOL_C "/" VALUE 0x80074D19 Val_Wu8 255.0 DFES_OneToOne 0.00 255.0 FORMAT "%5.1" /end CHARACTERISTIC
/begin CHARACTERISTIC DFES_FaultTyp.DFC_MeUnSCB_C "/" VALUE 0x80074D1A Val_Wu8 255.0 DFES_OneToOne 0.00 255.0 FORMAT "%5.1" /end CHARACTERISTIC
/begin CHARACTERISTIC DFES_FaultTyp.DFC_MeUnSRCMax_C "/" VALUE 0x80074D1B Val_Wu8 255.0 DFES_OneToOne 0.00 255.0 FORMAT "%5.1" /end CHARACTERISTIC
/begin CHARACTERISTIC DFES_FaultTyp.DFC_MeUnSRCMin_C "/" VALUE 0x80074D1C Val_Wu8 255.0 DFES_OneToOne 0.00 255.0 FORMAT "%5.1" /end CHARACTERISTIC
/begin CHARACTERISTIC DFES_FaultTyp.DFC_PCVOL_C "/" VALUE 0x80074D1D Val_Wu8 255.0 DFES_OneToOne 0.00 255.0 FORMAT "%5.1" /end CHARACTERISTIC
/begin CHARACTERISTIC DFES_FaultTyp.DFC_PCVSCB_C "/" VALUE 0x80074D1E Val_Wu8 255.0 DFES_OneToOne 0.00 255.0 FORMAT "%5.1" /end CHARACTERISTIC
/begin CHARACTERISTIC DFES_FaultTyp.DFC_PCVSRCMax_C "/" VALUE 0x80074D1F Val_Wu8 255.0 DFES_OneToOne 0.00 255.0 FORMAT "%5.1" /end CHARACTERISTIC
/begin CHARACTERISTIC DFES_FaultTyp.DFC_PCVSRCMin_C "/" VALUE 0x80074D20 Val_Wu8 255.0 DFES_OneToOne 0.00 255.0 FORMAT "%5.1" /end CHARACTERISTIC
/begin CHARACTERISTIC DFES_FaultTyp.DFC_RailPSRCMax_C "/" VALUE 0x80074D21 Val_Wu8 255.0 DFES_OneToOne 0.00 255.0 FORMAT "%5.1" /end CHARACTERISTIC
/begin CHARACTERISTIC DFES_FaultTyp.DFC_RailPSRCMin_C "/" VALUE 0x80074D22 Val_Wu8 255.0 DFES_OneToOne 0.00 255.0 FORMAT "%5.1" /end CHARACTERISTIC
/begin CHARACTERISTIC DFES_FaultTyp.DFC_IVActrVltgSRCMax_C "/" VALUE 0x80074D23 Val_Wu8 255.0 DFES_OneToOne 0.00 255.0 FORMAT "%5.1" /end CHARACTERISTIC
/begin CHARACTERISTIC DFES_FaultTyp.DFC_IVActrVltgSRCMin_C "/" VALUE 0x80074D24 Val_Wu8 255.0 DFES_OneToOne 0.00 255.0 FORMAT "%5.1" /end CHARACTERISTIC
/begin CHARACTERISTIC DFES_FaultTyp.DFC_IVPSplyDCDC_C "/" VALUE 0x80074D25 Val_Wu8 255.0 DFES_OneToOne 0.00 255.0 FORMAT "%5.1" /end CHARACTERISTIC
/begin CHARACTERISTIC DFES_FaultTyp.DFC_IVPSplyVltgSRCMax_C "/" VALUE 0x80074D26 Val_Wu8 255.0 DFES_OneToOne 0.00 255.0 FORMAT "%5.1" /end CHARACTERISTIC
/begin CHARACTERISTIC DFES_FaultTyp.DFC_IVPSplyVltgSRCMin_C "/" VALUE 0x80074D27 Val_Wu8 255.0 DFES_OneToOne 0.00 255.0 FORMAT "%5.1" /end CHARACTERISTIC
/begin CHARACTERISTIC DFES_FaultTyp.DFC_AFSOffsDrftMax_C "/" VALUE 0x80074D28 Val_Wu8 255.0 DFES_OneToOne 0.00 255.0 FORMAT "%5.1" /end CHARACTERISTIC
/begin CHARACTERISTIC DFES_FaultTyp.DFC_AFSOffsDrftMin_C "/" VALUE 0x80074D29 Val_Wu8 255.0 DFES_OneToOne 0.00 255.0 FORMAT "%5.1" /end CHARACTERISTIC
/begin CHARACTERISTIC DFES_FaultTyp.DFC_AFSSRCCorMax_C "/" VALUE 0x80074D2A Val_Wu8 255.0 DFES_OneToOne 0.00 255.0 FORMAT "%5.1" /end CHARACTERISTIC
/begin CHARACTERISTIC DFES_FaultTyp.DFC_AFSSRCCorMin_C "/" VALUE 0x80074D2B Val_Wu8 255.0 DFES_OneToOne 0.00 255.0 FORMAT "%5.1" /end CHARACTERISTIC
/begin CHARACTERISTIC DFES_FaultTyp.DFC_AFSSRCRawMax_C "/" VALUE 0x80074D2C Val_Wu8 255.0 DFES_OneToOne 0.00 255.0 FORMAT "%5.1" /end CHARACTERISTIC
/begin CHARACTERISTIC DFES_FaultTyp.DFC_AFSSRCRawMin_C "/" VALUE 0x80074D2D Val_Wu8 255.0 DFES_OneToOne 0.00 255.0 FORMAT "%5.1" /end CHARACTERISTIC
/begin CHARACTERISTIC DFES_FaultTyp.DFC_AFSSetyDrftMax_C "/" VALUE 0x80074D2E Val_Wu8 255.0 DFES_OneToOne 0.00 255.0 FORMAT "%5.1" /end CHARACTERISTIC
/begin CHARACTERISTIC DFES_FaultTyp.DFC_AFSSetyDrftMin_C "/" VALUE 0x80074D2F Val_Wu8 255.0 DFES_OneToOne 0.00 255.0 FORMAT "%5.1" /end CHARACTERISTIC
/begin CHARACTERISTIC DFES_FaultTyp.DFC_AirCClntPAnaSRCMax_C "/" VALUE 0x80074D30 Val_Wu8 255.0 DFES_OneToOne 0.00 255.0 FORMAT "%5.1" /end CHARACTERISTIC
/begin CHARACTERISTIC DFES_FaultTyp.DFC_AirCClntPAnaSRCMin_C "/" VALUE 0x80074D31 Val_Wu8 255.0 DFES_OneToOne 0.00 255.0 FORMAT "%5.1" /end CHARACTERISTIC
/begin CHARACTERISTIC DFES_FaultTyp.DFC_AirCClntPPerSRCMax_C "/" VALUE 0x80074D32 Val_Wu8 255.0 DFES_OneToOne 0.00 255.0 FORMAT "%5.1" /end CHARACTERISTIC
/begin CHARACTERISTIC DFES_FaultTyp.DFC_AirCClntPPerSRCMin_C "/" VALUE 0x80074D33 Val_Wu8 255.0 DFES_OneToOne 0.00 255.0 FORMAT "%5.1" /end CHARACTERISTIC
/begin CHARACTERISTIC DFES_FaultTyp.DFC_AirCClntPdcycSRCMax_C "/" VALUE 0x80074D34 Val_Wu8 255.0 DFES_OneToOne 0.00 255.0 FORMAT "%5.1" /end CHARACTERISTIC
/begin CHARACTERISTIC DFES_FaultTyp.DFC_AirCClntPdcycSRCMin_C "/" VALUE 0x80074D35 Val_Wu8 255.0 DFES_OneToOne 0.00 255.0 FORMAT "%5.1" /end CHARACTERISTIC
/begin CHARACTERISTIC DFES_FaultTyp.DFC_AirCCmprOL_C "/" VALUE 0x80074D36 Val_Wu8 255.0 DFES_OneToOne 0.00 255.0 FORMAT "%5.1" /end CHARACTERISTIC
/begin CHARACTERISTIC DFES_FaultTyp.DFC_AirCCmprRedTrqOL_C "/" VALUE 0x80074D37 Val_Wu8 255.0 DFES_OneToOne 0.00 255.0 FORMAT "%5.1" /end CHARACTERISTIC
/begin CHARACTERISTIC DFES_FaultTyp.DFC_AirCCmprRedTrqSCB_C "/" VALUE 0x80074D38 Val_Wu8 255.0 DFES_OneToOne 0.00 255.0 FORMAT "%5.1" /end CHARACTERISTIC
/begin CHARACTERISTIC DFES_FaultTyp.DFC_AirCCmprRedTrqSCG_C "/" VALUE 0x80074D39 Val_Wu8 255.0 DFES_OneToOne 0.00 255.0 FORMAT "%5.1" /end CHARACTERISTIC
/begin CHARACTERISTIC DFES_FaultTyp.DFC_AirCCmprSCB_C "/" VALUE 0x80074D3A Val_Wu8 255.0 DFES_OneToOne 0.00 255.0 FORMAT "%5.1" /end CHARACTERISTIC
/begin CHARACTERISTIC DFES_FaultTyp.DFC_AirCCmprSCG_C "/" VALUE 0x80074D3B Val_Wu8 255.0 DFES_OneToOne 0.00 255.0 FORMAT "%5.1" /end CHARACTERISTIC
/begin CHARACTERISTIC DFES_FaultTyp.DFC_AirCSwtNpl_C "/" VALUE 0x80074D3C Val_Wu8 255.0 DFES_OneToOne 0.00 255.0 FORMAT "%5.1" /end CHARACTERISTIC
/begin CHARACTERISTIC DFES_FaultTyp.DFC_AirCSwtSig_C "/" VALUE 0x80074D3D Val_Wu8 255.0 DFES_OneToOne 0.00 255.0 FORMAT "%5.1" /end CHARACTERISTIC
/begin CHARACTERISTIC DFES_FaultTyp.DFC_BattUSRCMax_C "/" VALUE 0x80074D3E Val_Wu8 255.0 DFES_OneToOne 0.00 255.0 FORMAT "%5.1" /end CHARACTERISTIC
/begin CHARACTERISTIC DFES_FaultTyp.DFC_BattUSRCMin_C "/" VALUE 0x80074D3F Val_Wu8 255.0 DFES_OneToOne 0.00 255.0 FORMAT "%5.1" /end CHARACTERISTIC
/begin CHARACTERISTIC DFES_FaultTyp.DFC_BrkNpl_C "/" VALUE 0x80074D40 Val_Wu8 255.0 DFES_OneToOne 0.00 255.0 FORMAT "%5.1" /end CHARACTERISTIC
/begin CHARACTERISTIC DFES_FaultTyp.DFC_BrkPSRCMax_C "/" VALUE 0x80074D41 Val_Wu8 255.0 DFES_OneToOne 0.00 255.0 FORMAT "%5.1" /end CHARACTERISTIC
/begin CHARACTERISTIC DFES_FaultTyp.DFC_BrkPSRCMin_C "/" VALUE 0x80074D42 Val_Wu8 255.0 DFES_OneToOne 0.00 255.0 FORMAT "%5.1" /end CHARACTERISTIC
/begin CHARACTERISTIC DFES_FaultTyp.DFC_BrkSig_C "/" VALUE 0x80074D43 Val_Wu8 255.0 DFES_OneToOne 0.00 255.0 FORMAT "%5.1" /end CHARACTERISTIC
/begin CHARACTERISTIC DFES_FaultTyp.DFC_CByVlvOL_C "/" VALUE 0x80074D44 Val_Wu8 255.0 DFES_OneToOne 0.00 255.0 FORMAT "%5.1" /end CHARACTERISTIC
/begin CHARACTERISTIC DFES_FaultTyp.DFC_CByVlvSCB_C "/" VALUE 0x80074D45 Val_Wu8 255.0 DFES_OneToOne 0.00 255.0 FORMAT "%5.1" /end CHARACTERISTIC
/begin CHARACTERISTIC DFES_FaultTyp.DFC_CByVlvSCG_C "/" VALUE 0x80074D46 Val_Wu8 255.0 DFES_OneToOne 0.00 255.0 FORMAT "%5.1" /end CHARACTERISTIC
/begin CHARACTERISTIC DFES_FaultTyp.DFC_CEngDsTSRCMax_C "/" VALUE 0x80074D47 Val_Wu8 255.0 DFES_OneToOne 0.00 255.0 FORMAT "%5.1" /end CHARACTERISTIC
/begin CHARACTERISTIC DFES_FaultTyp.DFC_CEngDsTSRCMin_C "/" VALUE 0x80074D48 Val_Wu8 255.0 DFES_OneToOne 0.00 255.0 FORMAT "%5.1" /end CHARACTERISTIC
/begin CHARACTERISTIC DFES_FaultTyp.DFC_CEngDsTSig_C "/" VALUE 0x80074D49 Val_Wu8 255.0 DFES_OneToOne 0.00 255.0 FORMAT "%5.1" /end CHARACTERISTIC
/begin CHARACTERISTIC DFES_FaultTyp.DFC_CEngUsTSRCMax_C "/" VALUE 0x80074D4A Val_Wu8 255.0 DFES_OneToOne 0.00 255.0 FORMAT "%5.1" /end CHARACTERISTIC
/begin CHARACTERISTIC DFES_FaultTyp.DFC_CEngUsTSRCMin_C "/" VALUE 0x80074D4B Val_Wu8 255.0 DFES_OneToOne 0.00 255.0 FORMAT "%5.1" /end CHARACTERISTIC
/begin CHARACTERISTIC DFES_FaultTyp.DFC_CThmstOL_C "/" VALUE 0x80074D4C Val_Wu8 255.0 DFES_OneToOne 0.00 255.0 FORMAT "%5.1" /end CHARACTERISTIC
/begin CHARACTERISTIC DFES_FaultTyp.DFC_CThmstSCB_C "/" VALUE 0x80074D4D Val_Wu8 255.0 DFES_OneToOne 0.00 255.0 FORMAT "%5.1" /end CHARACTERISTIC
/begin CHARACTERISTIC DFES_FaultTyp.DFC_CThmstSCG_C "/" VALUE 0x80074D4E Val_Wu8 255.0 DFES_OneToOne 0.00 255.0 FORMAT "%5.1" /end CHARACTERISTIC
/begin CHARACTERISTIC DFES_FaultTyp.DFC_ClthSig_C "/" VALUE 0x80074D4F Val_Wu8 255.0 DFES_OneToOne 0.00 255.0 FORMAT "%5.1" /end CHARACTERISTIC
/begin CHARACTERISTIC DFES_FaultTyp.DFC_ECBVlvOL_C "/" VALUE 0x80074D50 Val_Wu8 255.0 DFES_OneToOne 0.00 255.0 FORMAT "%5.1" /end CHARACTERISTIC
/begin CHARACTERISTIC DFES_FaultTyp.DFC_ECBVlvSCB_C "/" VALUE 0x80074D51 Val_Wu8 255.0 DFES_OneToOne 0.00 255.0 FORMAT "%5.1" /end CHARACTERISTIC
/begin CHARACTERISTIC DFES_FaultTyp.DFC_ECBVlvSCG_C "/" VALUE 0x80074D52 Val_Wu8 255.0 DFES_OneToOne 0.00 255.0 FORMAT "%5.1" /end CHARACTERISTIC
/begin CHARACTERISTIC DFES_FaultTyp.DFC_ECBVlvSRCMax_C "/" VALUE 0x80074D53 Val_Wu8 255.0 DFES_OneToOne 0.00 255.0 FORMAT "%5.1" /end CHARACTERISTIC
/begin CHARACTERISTIC DFES_FaultTyp.DFC_ECBVlvSRCMin_C "/" VALUE 0x80074D54 Val_Wu8 255.0 DFES_OneToOne 0.00 255.0 FORMAT "%5.1" /end CHARACTERISTIC
/begin CHARACTERISTIC DFES_FaultTyp.DFC_EGRVlvGovDvtMax_C "/" VALUE 0x80074D55 Val_Wu8 255.0 DFES_OneToOne 0.00 255.0 FORMAT "%5.1" /end CHARACTERISTIC
/begin CHARACTERISTIC DFES_FaultTyp.DFC_EGRVlvGovDvtMin_C "/" VALUE 0x80074D56 Val_Wu8 255.0 DFES_OneToOne 0.00 255.0 FORMAT "%5.1" /end CHARACTERISTIC
/begin CHARACTERISTIC DFES_FaultTyp.DFC_EGRVlvOL_C "/" VALUE 0x80074D57 Val_Wu8 255.0 DFES_OneToOne 0.00 255.0 FORMAT "%5.1" /end CHARACTERISTIC
/begin CHARACTERISTIC DFES_FaultTyp.DFC_EGRVlvSCB_C "/" VALUE 0x80074D58 Val_Wu8 255.0 DFES_OneToOne 0.00 255.0 FORMAT "%5.1" /end CHARACTERISTIC
/begin CHARACTERISTIC DFES_FaultTyp.DFC_EGRVlvSCG_C "/" VALUE 0x80074D59 Val_Wu8 255.0 DFES_OneToOne 0.00 255.0 FORMAT "%5.1" /end CHARACTERISTIC
/begin CHARACTERISTIC DFES_FaultTyp.DFC_EGRVlvSRCMax_C "/" VALUE 0x80074D5A Val_Wu8 255.0 DFES_OneToOne 0.00 255.0 FORMAT "%5.1" /end CHARACTERISTIC
/begin CHARACTERISTIC DFES_FaultTyp.DFC_EGRVlvSRCMin_C "/" VALUE 0x80074D5B Val_Wu8 255.0 DFES_OneToOne 0.00 255.0 FORMAT "%5.1" /end CHARACTERISTIC
/begin CHARACTERISTIC DFES_FaultTyp.DFC_EMDmpOL_0_C "/" VALUE 0x80074D5C Val_Wu8 255.0 DFES_OneToOne 0.00 255.0 FORMAT "%5.1" /end CHARACTERISTIC
/begin CHARACTERISTIC DFES_FaultTyp.DFC_EMDmpOL_1_C "/" VALUE 0x80074D5D Val_Wu8 255.0 DFES_OneToOne 0.00 255.0 FORMAT "%5.1" /end CHARACTERISTIC
/begin CHARACTERISTIC DFES_FaultTyp.DFC_EMDmpSCB_0_C "/" VALUE 0x80074D5E Val_Wu8 255.0 DFES_OneToOne 0.00 255.0 FORMAT "%5.1" /end CHARACTERISTIC
/begin CHARACTERISTIC DFES_FaultTyp.DFC_EMDmpSCB_1_C "/" VALUE 0x80074D5F Val_Wu8 255.0 DFES_OneToOne 0.00 255.0 FORMAT "%5.1" /end CHARACTERISTIC
/begin CHARACTERISTIC DFES_FaultTyp.DFC_EMDmpSCG_0_C "/" VALUE 0x80074D60 Val_Wu8 255.0 DFES_OneToOne 0.00 255.0 FORMAT "%5.1" /end CHARACTERISTIC
/begin CHARACTERISTIC DFES_FaultTyp.DFC_EMDmpSCG_1_C "/" VALUE 0x80074D61 Val_Wu8 255.0 DFES_OneToOne 0.00 255.0 FORMAT "%5.1" /end CHARACTERISTIC
/begin CHARACTERISTIC DFES_FaultTyp.DFC_EngStAOL_C "/" VALUE 0x80074D62 Val_Wu8 255.0 DFES_OneToOne 0.00 255.0 FORMAT "%5.1" /end CHARACTERISTIC
/begin CHARACTERISTIC DFES_FaultTyp.DFC_EngStASCB_C "/" VALUE 0x80074D63 Val_Wu8 255.0 DFES_OneToOne 0.00 255.0 FORMAT "%5.1" /end CHARACTERISTIC
/begin CHARACTERISTIC DFES_FaultTyp.DFC_EngStASCG_C "/" VALUE 0x80074D64 Val_Wu8 255.0 DFES_OneToOne 0.00 255.0 FORMAT "%5.1" /end CHARACTERISTIC
/begin CHARACTERISTIC DFES_FaultTyp.DFC_EnvPSRCMax_C "/" VALUE 0x80074D65 Val_Wu8 255.0 DFES_OneToOne 0.00 255.0 FORMAT "%5.1" /end CHARACTERISTIC
/begin CHARACTERISTIC DFES_FaultTyp.DFC_EnvPSRCMin_C "/" VALUE 0x80074D66 Val_Wu8 255.0 DFES_OneToOne 0.00 255.0 FORMAT "%5.1" /end CHARACTERISTIC
/begin CHARACTERISTIC DFES_FaultTyp.DFC_EnvPSig_C "/" VALUE 0x80074D67 Val_Wu8 255.0 DFES_OneToOne 0.00 255.0 FORMAT "%5.1" /end CHARACTERISTIC
/begin CHARACTERISTIC DFES_FaultTyp.DFC_EnvTSRCMax_C "/" VALUE 0x80074D68 Val_Wu8 255.0 DFES_OneToOne 0.00 255.0 FORMAT "%5.1" /end CHARACTERISTIC
/begin CHARACTERISTIC DFES_FaultTyp.DFC_EnvTSRCMin_C "/" VALUE 0x80074D69 Val_Wu8 255.0 DFES_OneToOne 0.00 255.0 FORMAT "%5.1" /end CHARACTERISTIC
/begin CHARACTERISTIC DFES_FaultTyp.DFC_FanOL_C "/" VALUE 0x80074D6A Val_Wu8 255.0 DFES_OneToOne 0.00 255.0 FORMAT "%5.1" /end CHARACTERISTIC
/begin CHARACTERISTIC DFES_FaultTyp.DFC_FanSCB_C "/" VALUE 0x80074D6B Val_Wu8 255.0 DFES_OneToOne 0.00 255.0 FORMAT "%5.1" /end CHARACTERISTIC
/begin CHARACTERISTIC DFES_FaultTyp.DFC_FlFltSig_C "/" VALUE 0x80074D6C Val_Wu8 255.0 DFES_OneToOne 0.00 255.0 FORMAT "%5.1" /end CHARACTERISTIC
/begin CHARACTERISTIC DFES_FaultTyp.DFC_FuelTSRCMax_C "/" VALUE 0x80074D6D Val_Wu8 255.0 DFES_OneToOne 0.00 255.0 FORMAT "%5.1" /end CHARACTERISTIC
/begin CHARACTERISTIC DFES_FaultTyp.DFC_FuelTSRCMin_C "/" VALUE 0x80074D6E Val_Wu8 255.0 DFES_OneToOne 0.00 255.0 FORMAT "%5.1" /end CHARACTERISTIC
/begin CHARACTERISTIC DFES_FaultTyp.DFC_GbxNPosPPerSRCMax_C "/" VALUE 0x80074D6F Val_Wu8 255.0 DFES_OneToOne 0.00 255.0 FORMAT "%5.1" /end CHARACTERISTIC
/begin CHARACTERISTIC DFES_FaultTyp.DFC_GbxNPosPPerSRCMin_C "/" VALUE 0x80074D70 Val_Wu8 255.0 DFES_OneToOne 0.00 255.0 FORMAT "%5.1" /end CHARACTERISTIC
/begin CHARACTERISTIC DFES_FaultTyp.DFC_GbxNPosPdcycSRCMax_C "/" VALUE 0x80074D71 Val_Wu8 255.0 DFES_OneToOne 0.00 255.0 FORMAT "%5.1" /end CHARACTERISTIC
/begin CHARACTERISTIC DFES_FaultTyp.DFC_GbxNPosPdcycSRCMin_C "/" VALUE 0x80074D72 Val_Wu8 255.0 DFES_OneToOne 0.00 255.0 FORMAT "%5.1" /end CHARACTERISTIC
/begin CHARACTERISTIC DFES_FaultTyp.DFC_GbxNPosSig_C "/" VALUE 0x80074D73 Val_Wu8 255.0 DFES_OneToOne 0.00 255.0 FORMAT "%5.1" /end CHARACTERISTIC
/begin CHARACTERISTIC DFES_FaultTyp.DFC_GlwPlgBSDOL_0_C "/" VALUE 0x80074D74 Val_Wu8 255.0 DFES_OneToOne 0.00 255.0 FORMAT "%5.1" /end CHARACTERISTIC
/begin CHARACTERISTIC DFES_FaultTyp.DFC_GlwPlgBSDOL_1_C "/" VALUE 0x80074D75 Val_Wu8 255.0 DFES_OneToOne 0.00 255.0 FORMAT "%5.1" /end CHARACTERISTIC
/begin CHARACTERISTIC DFES_FaultTyp.DFC_GlwPlgBSDOL_2_C "/" VALUE 0x80074D76 Val_Wu8 255.0 DFES_OneToOne 0.00 255.0 FORMAT "%5.1" /end CHARACTERISTIC
/begin CHARACTERISTIC DFES_FaultTyp.DFC_GlwPlgBSDOL_3_C "/" VALUE 0x80074D77 Val_Wu8 255.0 DFES_OneToOne 0.00 255.0 FORMAT "%5.1" /end CHARACTERISTIC
/begin CHARACTERISTIC DFES_FaultTyp.DFC_GlwPlgBSDOL_4_C "/" VALUE 0x80074D78 Val_Wu8 255.0 DFES_OneToOne 0.00 255.0 FORMAT "%5.1" /end CHARACTERISTIC
/begin CHARACTERISTIC DFES_FaultTyp.DFC_GlwPlgBSDOL_5_C "/" VALUE 0x80074D79 Val_Wu8 255.0 DFES_OneToOne 0.00 255.0 FORMAT "%5.1" /end CHARACTERISTIC
/begin CHARACTERISTIC DFES_FaultTyp.DFC_GlwPlgBSDOL_6_C "/" VALUE 0x80074D7A Val_Wu8 255.0 DFES_OneToOne 0.00 255.0 FORMAT "%5.1" /end CHARACTERISTIC
/begin CHARACTERISTIC DFES_FaultTyp.DFC_GlwPlgBSDOL_7_C "/" VALUE 0x80074D7B Val_Wu8 255.0 DFES_OneToOne 0.00 255.0 FORMAT "%5.1" /end CHARACTERISTIC
/begin CHARACTERISTIC DFES_FaultTyp.DFC_GlwPlgBSDOT_0_C "/" VALUE 0x80074D7C Val_Wu8 255.0 DFES_OneToOne 0.00 255.0 FORMAT "%5.1" /end CHARACTERISTIC
/begin CHARACTERISTIC DFES_FaultTyp.DFC_GlwPlgBSDOT_1_C "/" VALUE 0x80074D7D Val_Wu8 255.0 DFES_OneToOne 0.00 255.0 FORMAT "%5.1" /end CHARACTERISTIC
/begin CHARACTERISTIC DFES_FaultTyp.DFC_GlwPlgBSDOT_2_C "/" VALUE 0x80074D7E Val_Wu8 255.0 DFES_OneToOne 0.00 255.0 FORMAT "%5.1" /end CHARACTERISTIC
/begin CHARACTERISTIC DFES_FaultTyp.DFC_GlwPlgBSDOT_3_C "/" VALUE 0x80074D7F Val_Wu8 255.0 DFES_OneToOne 0.00 255.0 FORMAT "%5.1" /end CHARACTERISTIC
/begin CHARACTERISTIC DFES_FaultTyp.DFC_GlwPlgBSDOT_4_C "/" VALUE 0x80074D80 Val_Wu8 255.0 DFES_OneToOne 0.00 255.0 FORMAT "%5.1" /end CHARACTERISTIC
/begin CHARACTERISTIC DFES_FaultTyp.DFC_GlwPlgBSDOT_5_C "/" VALUE 0x80074D81 Val_Wu8 255.0 DFES_OneToOne 0.00 255.0 FORMAT "%5.1" /end CHARACTERISTIC
/begin CHARACTERISTIC DFES_FaultTyp.DFC_GlwPlgBSDOT_6_C "/" VALUE 0x80074D82 Val_Wu8 255.0 DFES_OneToOne 0.00 255.0 FORMAT "%5.1" /end CHARACTERISTIC
/begin CHARACTERISTIC DFES_FaultTyp.DFC_GlwPlgBSDOT_7_C "/" VALUE 0x80074D83 Val_Wu8 255.0 DFES_OneToOne 0.00 255.0 FORMAT "%5.1" /end CHARACTERISTIC
/begin CHARACTERISTIC DFES_FaultTyp.DFC_GlwPlgBSDSC_0_C "/" VALUE 0x80074D84 Val_Wu8 255.0 DFES_OneToOne 0.00 255.0 FORMAT "%5.1" /end CHARACTERISTIC
/begin CHARACTERISTIC DFES_FaultTyp.DFC_GlwPlgBSDSC_1_C "/" VALUE 0x80074D85 Val_Wu8 255.0 DFES_OneToOne 0.00 255.0 FORMAT "%5.1" /end CHARACTERISTIC
/begin CHARACTERISTIC DFES_FaultTyp.DFC_GlwPlgBSDSC_2_C "/" VALUE 0x80074D86 Val_Wu8 255.0 DFES_OneToOne 0.00 255.0 FORMAT "%5.1" /end CHARACTERISTIC
/begin CHARACTERISTIC DFES_FaultTyp.DFC_GlwPlgBSDSC_3_C "/" VALUE 0x80074D87 Val_Wu8 255.0 DFES_OneToOne 0.00 255.0 FORMAT "%5.1" /end CHARACTERISTIC
/begin CHARACTERISTIC DFES_FaultTyp.DFC_GlwPlgBSDSC_4_C "/" VALUE 0x80074D88 Val_Wu8 255.0 DFES_OneToOne 0.00 255.0 FORMAT "%5.1" /end CHARACTERISTIC
/begin CHARACTERISTIC DFES_FaultTyp.DFC_GlwPlgBSDSC_5_C "/" VALUE 0x80074D89 Val_Wu8 255.0 DFES_OneToOne 0.00 255.0 FORMAT "%5.1" /end CHARACTERISTIC
/begin CHARACTERISTIC DFES_FaultTyp.DFC_GlwPlgBSDSC_6_C "/" VALUE 0x80074D8A Val_Wu8 255.0 DFES_OneToOne 0.00 255.0 FORMAT "%5.1" /end CHARACTERISTIC
/begin CHARACTERISTIC DFES_FaultTyp.DFC_GlwPlgBSDSC_7_C "/" VALUE 0x80074D8B Val_Wu8 255.0 DFES_OneToOne 0.00 255.0 FORMAT "%5.1" /end CHARACTERISTIC
/begin CHARACTERISTIC DFES_FaultTyp.DFC_GlwPlgComErr_C "/" VALUE 0x80074D8C Val_Wu8 255.0 DFES_OneToOne 0.00 255.0 FORMAT "%5.1" /end CHARACTERISTIC
/begin CHARACTERISTIC DFES_FaultTyp.DFC_InjVlvPresMin_C "/" VALUE 0x80074D8D Val_Wu8 255.0 DFES_OneToOne 0.00 255.0 FORMAT "%5.1" /end CHARACTERISTIC
/begin CHARACTERISTIC DFES_FaultTyp.DFC_LSUCircNernstMax_0_C "/" VALUE 0x80074D8E Val_Wu8 255.0 DFES_OneToOne 0.00 255.0 FORMAT "%5.1" /end CHARACTERISTIC
/begin CHARACTERISTIC DFES_FaultTyp.DFC_LSUCircNernstMax_1_C "/" VALUE 0x80074D8F Val_Wu8 255.0 DFES_OneToOne 0.00 255.0 FORMAT "%5.1" /end CHARACTERISTIC
/begin CHARACTERISTIC DFES_FaultTyp.DFC_LSUCircNernstMax_2_C "/" VALUE 0x80074D90 Val_Wu8 255.0 DFES_OneToOne 0.00 255.0 FORMAT "%5.1" /end CHARACTERISTIC
/begin CHARACTERISTIC DFES_FaultTyp.DFC_LSUCircNernstMax_3_C "/" VALUE 0x80074D91 Val_Wu8 255.0 DFES_OneToOne 0.00 255.0 FORMAT "%5.1" /end CHARACTERISTIC
/begin CHARACTERISTIC DFES_FaultTyp.DFC_LSUCircNernstMin_0_C "/" VALUE 0x80074D92 Val_Wu8 255.0 DFES_OneToOne 0.00 255.0 FORMAT "%5.1" /end CHARACTERISTIC
/begin CHARACTERISTIC DFES_FaultTyp.DFC_LSUCircNernstMin_1_C "/" VALUE 0x80074D93 Val_Wu8 255.0 DFES_OneToOne 0.00 255.0 FORMAT "%5.1" /end CHARACTERISTIC
/begin CHARACTERISTIC DFES_FaultTyp.DFC_LSUCircNernstMin_2_C "/" VALUE 0x80074D94 Val_Wu8 255.0 DFES_OneToOne 0.00 255.0 FORMAT "%5.1" /end CHARACTERISTIC
/begin CHARACTERISTIC DFES_FaultTyp.DFC_LSUCircNernstMin_3_C "/" VALUE 0x80074D95 Val_Wu8 255.0 DFES_OneToOne 0.00 255.0 FORMAT "%5.1" /end CHARACTERISTIC
/begin CHARACTERISTIC DFES_FaultTyp.DFC_LSUCircNernstSig_0_C "/" VALUE 0x80074D96 Val_Wu8 255.0 DFES_OneToOne 0.00 255.0 FORMAT "%5.1" /end CHARACTERISTIC
/begin CHARACTERISTIC DFES_FaultTyp.DFC_LSUCircNernstSig_1_C "/" VALUE 0x80074D97 Val_Wu8 255.0 DFES_OneToOne 0.00 255.0 FORMAT "%5.1" /end CHARACTERISTIC
/begin CHARACTERISTIC DFES_FaultTyp.DFC_LSUCircNernstSig_2_C "/" VALUE 0x80074D98 Val_Wu8 255.0 DFES_OneToOne 0.00 255.0 FORMAT "%5.1" /end CHARACTERISTIC
/begin CHARACTERISTIC DFES_FaultTyp.DFC_LSUCircNernstSig_3_C "/" VALUE 0x80074D99 Val_Wu8 255.0 DFES_OneToOne 0.00 255.0 FORMAT "%5.1" /end CHARACTERISTIC
/begin CHARACTERISTIC DFES_FaultTyp.DFC_LSUCircPmpCurMax_0_C "/" VALUE 0x80074D9A Val_Wu8 255.0 DFES_OneToOne 0.00 255.0 FORMAT "%5.1" /end CHARACTERISTIC
/begin CHARACTERISTIC DFES_FaultTyp.DFC_LSUCircPmpCurMax_1_C "/" VALUE 0x80074D9B Val_Wu8 255.0 DFES_OneToOne 0.00 255.0 FORMAT "%5.1" /end CHARACTERISTIC
/begin CHARACTERISTIC DFES_FaultTyp.DFC_LSUCircPmpCurMax_2_C "/" VALUE 0x80074D9C Val_Wu8 255.0 DFES_OneToOne 0.00 255.0 FORMAT "%5.1" /end CHARACTERISTIC
/begin CHARACTERISTIC DFES_FaultTyp.DFC_LSUCircPmpCurMax_3_C "/" VALUE 0x80074D9D Val_Wu8 255.0 DFES_OneToOne 0.00 255.0 FORMAT "%5.1" /end CHARACTERISTIC
/begin CHARACTERISTIC DFES_FaultTyp.DFC_LSUCircPmpCurMin_0_C "/" VALUE 0x80074D9E Val_Wu8 255.0 DFES_OneToOne 0.00 255.0 FORMAT "%5.1" /end CHARACTERISTIC
/begin CHARACTERISTIC DFES_FaultTyp.DFC_LSUCircPmpCurMin_1_C "/" VALUE 0x80074D9F Val_Wu8 255.0 DFES_OneToOne 0.00 255.0 FORMAT "%5.1" /end CHARACTERISTIC
/begin CHARACTERISTIC DFES_FaultTyp.DFC_LSUCircPmpCurMin_2_C "/" VALUE 0x80074DA0 Val_Wu8 255.0 DFES_OneToOne 0.00 255.0 FORMAT "%5.1" /end CHARACTERISTIC
/begin CHARACTERISTIC DFES_FaultTyp.DFC_LSUCircPmpCurMin_3_C "/" VALUE 0x80074DA1 Val_Wu8 255.0 DFES_OneToOne 0.00 255.0 FORMAT "%5.1" /end CHARACTERISTIC
/begin CHARACTERISTIC DFES_FaultTyp.DFC_LSUCircPmpCurSig_0_C "/" VALUE 0x80074DA2 Val_Wu8 255.0 DFES_OneToOne 0.00 255.0 FORMAT "%5.1" /end CHARACTERISTIC
/begin CHARACTERISTIC DFES_FaultTyp.DFC_LSUCircPmpCurSig_1_C "/" VALUE 0x80074DA3 Val_Wu8 255.0 DFES_OneToOne 0.00 255.0 FORMAT "%5.1" /end CHARACTERISTIC
/begin CHARACTERISTIC DFES_FaultTyp.DFC_LSUCircPmpCurSig_2_C "/" VALUE 0x80074DA4 Val_Wu8 255.0 DFES_OneToOne 0.00 255.0 FORMAT "%5.1" /end CHARACTERISTIC
/begin CHARACTERISTIC DFES_FaultTyp.DFC_LSUCircPmpCurSig_3_C "/" VALUE 0x80074DA5 Val_Wu8 255.0 DFES_OneToOne 0.00 255.0 FORMAT "%5.1" /end CHARACTERISTIC
/begin CHARACTERISTIC DFES_FaultTyp.DFC_LSUCircVirtGndMax_0_C "/" VALUE 0x80074DA6 Val_Wu8 255.0 DFES_OneToOne 0.00 255.0 FORMAT "%5.1" /end CHARACTERISTIC
/begin CHARACTERISTIC DFES_FaultTyp.DFC_LSUCircVirtGndMax_1_C "/" VALUE 0x80074DA7 Val_Wu8 255.0 DFES_OneToOne 0.00 255.0 FORMAT "%5.1" /end CHARACTERISTIC
/begin CHARACTERISTIC DFES_FaultTyp.DFC_LSUCircVirtGndMax_2_C "/" VALUE 0x80074DA8 Val_Wu8 255.0 DFES_OneToOne 0.00 255.0 FORMAT "%5.1" /end CHARACTERISTIC
/begin CHARACTERISTIC DFES_FaultTyp.DFC_LSUCircVirtGndMax_3_C "/" VALUE 0x80074DA9 Val_Wu8 255.0 DFES_OneToOne 0.00 255.0 FORMAT "%5.1" /end CHARACTERISTIC
/begin CHARACTERISTIC DFES_FaultTyp.DFC_LSUCircVirtGndMin_0_C "/" VALUE 0x80074DAA Val_Wu8 255.0 DFES_OneToOne 0.00 255.0 FORMAT "%5.1" /end CHARACTERISTIC
/begin CHARACTERISTIC DFES_FaultTyp.DFC_LSUCircVirtGndMin_1_C "/" VALUE 0x80074DAB Val_Wu8 255.0 DFES_OneToOne 0.00 255.0 FORMAT "%5.1" /end CHARACTERISTIC
/begin CHARACTERISTIC DFES_FaultTyp.DFC_LSUCircVirtGndMin_2_C "/" VALUE 0x80074DAC Val_Wu8 255.0 DFES_OneToOne 0.00 255.0 FORMAT "%5.1" /end CHARACTERISTIC
/begin CHARACTERISTIC DFES_FaultTyp.DFC_LSUCircVirtGndMin_3_C "/" VALUE 0x80074DAD Val_Wu8 255.0 DFES_OneToOne 0.00 255.0 FORMAT "%5.1" /end CHARACTERISTIC
/begin CHARACTERISTIC DFES_FaultTyp.DFC_LSUCircVirtGndSig_0_C "/" VALUE 0x80074DAE Val_Wu8 255.0 DFES_OneToOne 0.00 255.0 FORMAT "%5.1" /end CHARACTERISTIC
/begin CHARACTERISTIC DFES_FaultTyp.DFC_LSUCircVirtGndSig_1_C "/" VALUE 0x80074DAF Val_Wu8 255.0 DFES_OneToOne 0.00 255.0 FORMAT "%5.1" /end CHARACTERISTIC
/begin CHARACTERISTIC DFES_FaultTyp.DFC_LSUCircVirtGndSig_2_C "/" VALUE 0x80074DB0 Val_Wu8 255.0 DFES_OneToOne 0.00 255.0 FORMAT "%5.1" /end CHARACTERISTIC
/begin CHARACTERISTIC DFES_FaultTyp.DFC_LSUCircVirtGndSig_3_C "/" VALUE 0x80074DB1 Val_Wu8 255.0 DFES_OneToOne 0.00 255.0 FORMAT "%5.1" /end CHARACTERISTIC
/begin CHARACTERISTIC DFES_FaultTyp.DFC_LSUHtrMax_0_C "/" VALUE 0x80074DB2 Val_Wu8 255.0 DFES_OneToOne 0.00 255.0 FORMAT "%5.1" /end CHARACTERISTIC
/begin CHARACTERISTIC DFES_FaultTyp.DFC_LSUHtrMax_1_C "/" VALUE 0x80074DB3 Val_Wu8 255.0 DFES_OneToOne 0.00 255.0 FORMAT "%5.1" /end CHARACTERISTIC
/begin CHARACTERISTIC DFES_FaultTyp.DFC_LSUHtrMax_2_C "/" VALUE 0x80074DB4 Val_Wu8 255.0 DFES_OneToOne 0.00 255.0 FORMAT "%5.1" /end CHARACTERISTIC
/begin CHARACTERISTIC DFES_FaultTyp.DFC_LSUHtrMax_3_C "/" VALUE 0x80074DB5 Val_Wu8 255.0 DFES_OneToOne 0.00 255.0 FORMAT "%5.1" /end CHARACTERISTIC
/begin CHARACTERISTIC DFES_FaultTyp.DFC_LSUHtrMin_0_C "/" VALUE 0x80074DB6 Val_Wu8 255.0 DFES_OneToOne 0.00 255.0 FORMAT "%5.1" /end CHARACTERISTIC
/begin CHARACTERISTIC DFES_FaultTyp.DFC_LSUHtrMin_1_C "/" VALUE 0x80074DB7 Val_Wu8 255.0 DFES_OneToOne 0.00 255.0 FORMAT "%5.1" /end CHARACTERISTIC
/begin CHARACTERISTIC DFES_FaultTyp.DFC_LSUHtrMin_2_C "/" VALUE 0x80074DB8 Val_Wu8 255.0 DFES_OneToOne 0.00 255.0 FORMAT "%5.1" /end CHARACTERISTIC
/begin CHARACTERISTIC DFES_FaultTyp.DFC_LSUHtrMin_3_C "/" VALUE 0x80074DB9 Val_Wu8 255.0 DFES_OneToOne 0.00 255.0 FORMAT "%5.1" /end CHARACTERISTIC
/begin CHARACTERISTIC DFES_FaultTyp.DFC_LSUHtrSig_0_C "/" VALUE 0x80074DBA Val_Wu8 255.0 DFES_OneToOne 0.00 255.0 FORMAT "%5.1" /end CHARACTERISTIC
/begin CHARACTERISTIC DFES_FaultTyp.DFC_LSUHtrSig_1_C "/" VALUE 0x80074DBB Val_Wu8 255.0 DFES_OneToOne 0.00 255.0 FORMAT "%5.1" /end CHARACTERISTIC
/begin CHARACTERISTIC DFES_FaultTyp.DFC_LSUHtrSig_2_C "/" VALUE 0x80074DBC Val_Wu8 255.0 DFES_OneToOne 0.00 255.0 FORMAT "%5.1" /end CHARACTERISTIC
/begin CHARACTERISTIC DFES_FaultTyp.DFC_LSUHtrSig_3_C "/" VALUE 0x80074DBD Val_Wu8 255.0 DFES_OneToOne 0.00 255.0 FORMAT "%5.1" /end CHARACTERISTIC
/begin CHARACTERISTIC DFES_FaultTyp.DFC_LSUO2Max_0_C "/" VALUE 0x80074DBE Val_Wu8 255.0 DFES_OneToOne 0.00 255.0 FORMAT "%5.1" /end CHARACTERISTIC
/begin CHARACTERISTIC DFES_FaultTyp.DFC_LSUO2Max_1_C "/" VALUE 0x80074DBF Val_Wu8 255.0 DFES_OneToOne 0.00 255.0 FORMAT "%5.1" /end CHARACTERISTIC
/begin CHARACTERISTIC DFES_FaultTyp.DFC_LSUO2Max_2_C "/" VALUE 0x80074DC0 Val_Wu8 255.0 DFES_OneToOne 0.00 255.0 FORMAT "%5.1" /end CHARACTERISTIC
/begin CHARACTERISTIC DFES_FaultTyp.DFC_LSUO2Max_3_C "/" VALUE 0x80074DC1 Val_Wu8 255.0 DFES_OneToOne 0.00 255.0 FORMAT "%5.1" /end CHARACTERISTIC
/begin CHARACTERISTIC DFES_FaultTyp.DFC_LSUO2Min_0_C "/" VALUE 0x80074DC2 Val_Wu8 255.0 DFES_OneToOne 0.00 255.0 FORMAT "%5.1" /end CHARACTERISTIC
/begin CHARACTERISTIC DFES_FaultTyp.DFC_LSUO2Min_1_C "/" VALUE 0x80074DC3 Val_Wu8 255.0 DFES_OneToOne 0.00 255.0 FORMAT "%5.1" /end CHARACTERISTIC
/begin CHARACTERISTIC DFES_FaultTyp.DFC_LSUO2Min_2_C "/" VALUE 0x80074DC4 Val_Wu8 255.0 DFES_OneToOne 0.00 255.0 FORMAT "%5.1" /end CHARACTERISTIC
/begin CHARACTERISTIC DFES_FaultTyp.DFC_LSUO2Min_3_C "/" VALUE 0x80074DC5 Val_Wu8 255.0 DFES_OneToOne 0.00 255.0 FORMAT "%5.1" /end CHARACTERISTIC
/begin CHARACTERISTIC DFES_FaultTyp.DFC_LSUSPIBattLowMin_0_C "/" VALUE 0x80074DC6 Val_Wu8 255.0 DFES_OneToOne 0.00 255.0 FORMAT "%5.1" /end CHARACTERISTIC
/begin CHARACTERISTIC DFES_FaultTyp.DFC_LSUSPIBattLowMin_1_C "/" VALUE 0x80074DC7 Val_Wu8 255.0 DFES_OneToOne 0.00 255.0 FORMAT "%5.1" /end CHARACTERISTIC
/begin CHARACTERISTIC DFES_FaultTyp.DFC_LSUSPIBattLowMin_2_C "/" VALUE 0x80074DC8 Val_Wu8 255.0 DFES_OneToOne 0.00 255.0 FORMAT "%5.1" /end CHARACTERISTIC
/begin CHARACTERISTIC DFES_FaultTyp.DFC_LSUSPIBattLowMin_3_C "/" VALUE 0x80074DC9 Val_Wu8 255.0 DFES_OneToOne 0.00 255.0 FORMAT "%5.1" /end CHARACTERISTIC
/begin CHARACTERISTIC DFES_FaultTyp.DFC_LSUSPISig_0_C "/" VALUE 0x80074DCA Val_Wu8 255.0 DFES_OneToOne 0.00 255.0 FORMAT "%5.1" /end CHARACTERISTIC
/begin CHARACTERISTIC DFES_FaultTyp.DFC_LSUSPISig_1_C "/" VALUE 0x80074DCB Val_Wu8 255.0 DFES_OneToOne 0.00 255.0 FORMAT "%5.1" /end CHARACTERISTIC
/begin CHARACTERISTIC DFES_FaultTyp.DFC_LSUSPISig_2_C "/" VALUE 0x80074DCC Val_Wu8 255.0 DFES_OneToOne 0.00 255.0 FORMAT "%5.1" /end CHARACTERISTIC
/begin CHARACTERISTIC DFES_FaultTyp.DFC_LSUSPISig_3_C "/" VALUE 0x80074DCD Val_Wu8 255.0 DFES_OneToOne 0.00 255.0 FORMAT "%5.1" /end CHARACTERISTIC
/begin CHARACTERISTIC DFES_FaultTyp.DFC_LSUtExcMax_0_C "/" VALUE 0x80074DCE Val_Wu8 255.0 DFES_OneToOne 0.00 255.0 FORMAT "%5.1" /end CHARACTERISTIC
/begin CHARACTERISTIC DFES_FaultTyp.DFC_LSUtExcMax_1_C "/" VALUE 0x80074DCF Val_Wu8 255.0 DFES_OneToOne 0.00 255.0 FORMAT "%5.1" /end CHARACTERISTIC
/begin CHARACTERISTIC DFES_FaultTyp.DFC_LSUtExcMax_2_C "/" VALUE 0x80074DD0 Val_Wu8 255.0 DFES_OneToOne 0.00 255.0 FORMAT "%5.1" /end CHARACTERISTIC
/begin CHARACTERISTIC DFES_FaultTyp.DFC_LSUtExcMax_3_C "/" VALUE 0x80074DD1 Val_Wu8 255.0 DFES_OneToOne 0.00 255.0 FORMAT "%5.1" /end CHARACTERISTIC
/begin CHARACTERISTIC DFES_FaultTyp.DFC_LSUtExcMin_0_C "/" VALUE 0x80074DD2 Val_Wu8 255.0 DFES_OneToOne 0.00 255.0 FORMAT "%5.1" /end CHARACTERISTIC
/begin CHARACTERISTIC DFES_FaultTyp.DFC_LSUtExcMin_1_C "/" VALUE 0x80074DD3 Val_Wu8 255.0 DFES_OneToOne 0.00 255.0 FORMAT "%5.1" /end CHARACTERISTIC
/begin CHARACTERISTIC DFES_FaultTyp.DFC_LSUtExcMin_2_C "/" VALUE 0x80074DD4 Val_Wu8 255.0 DFES_OneToOne 0.00 255.0 FORMAT "%5.1" /end CHARACTERISTIC
/begin CHARACTERISTIC DFES_FaultTyp.DFC_LSUtExcMin_3_C "/" VALUE 0x80074DD5 Val_Wu8 255.0 DFES_OneToOne 0.00 255.0 FORMAT "%5.1" /end CHARACTERISTIC
/begin CHARACTERISTIC DFES_FaultTyp.DFC_MILOL_C "/" VALUE 0x80074DD6 Val_Wu8 255.0 DFES_OneToOne 0.00 255.0 FORMAT "%5.1" /end CHARACTERISTIC
/begin CHARACTERISTIC DFES_FaultTyp.DFC_MILSCB_C "/" VALUE 0x80074DD7 Val_Wu8 255.0 DFES_OneToOne 0.00 255.0 FORMAT "%5.1" /end CHARACTERISTIC
/begin CHARACTERISTIC DFES_FaultTyp.DFC_MILSCG_C "/" VALUE 0x80074DD8 Val_Wu8 255.0 DFES_OneToOne 0.00 255.0 FORMAT "%5.1" /end CHARACTERISTIC
/begin CHARACTERISTIC DFES_FaultTyp.DFC_MeUnSCG_C "/" VALUE 0x80074DD9 Val_Wu8 255.0 DFES_OneToOne 0.00 255.0 FORMAT "%5.1" /end CHARACTERISTIC
/begin CHARACTERISTIC DFES_FaultTyp.DFC_NplHsChngPPFltDiff_C "/" VALUE 0x80074DDA Val_Wu8 255.0 DFES_OneToOne 0.00 255.0 FORMAT "%5.1" /end CHARACTERISTIC
/begin CHARACTERISTIC DFES_FaultTyp.DFC_NplPAirFltDs_C "/" VALUE 0x80074DDB Val_Wu8 255.0 DFES_OneToOne 0.00 255.0 FORMAT "%5.1" /end CHARACTERISTIC
/begin CHARACTERISTIC DFES_FaultTyp.DFC_NplTPFltUs_C "/" VALUE 0x80074DDC Val_Wu8 255.0 DFES_OneToOne 0.00 255.0 FORMAT "%5.1" /end CHARACTERISTIC
/begin CHARACTERISTIC DFES_FaultTyp.DFC_OilComErr_C "/" VALUE 0x80074DDD Val_Wu8 255.0 DFES_OneToOne 0.00 255.0 FORMAT "%5.1" /end CHARACTERISTIC
/begin CHARACTERISTIC DFES_FaultTyp.DFC_OilPLmpOL_C "/" VALUE 0x80074DDE Val_Wu8 255.0 DFES_OneToOne 0.00 255.0 FORMAT "%5.1" /end CHARACTERISTIC
/begin CHARACTERISTIC DFES_FaultTyp.DFC_OilPLmpSCB_C "/" VALUE 0x80074DDF Val_Wu8 255.0 DFES_OneToOne 0.00 255.0 FORMAT "%5.1" /end CHARACTERISTIC
/begin CHARACTERISTIC DFES_FaultTyp.DFC_OilPLmpSCG_C "/" VALUE 0x80074DE0 Val_Wu8 255.0 DFES_OneToOne 0.00 255.0 FORMAT "%5.1" /end CHARACTERISTIC
/begin CHARACTERISTIC DFES_FaultTyp.DFC_OilPNpl_C "/" VALUE 0x80074DE1 Val_Wu8 255.0 DFES_OneToOne 0.00 255.0 FORMAT "%5.1" /end CHARACTERISTIC
/begin CHARACTERISTIC DFES_FaultTyp.DFC_OilTNpl_C "/" VALUE 0x80074DE2 Val_Wu8 255.0 DFES_OneToOne 0.00 255.0 FORMAT "%5.1" /end CHARACTERISTIC
/begin CHARACTERISTIC DFES_FaultTyp.DFC_OilTSRCMax_C "/" VALUE 0x80074DE3 Val_Wu8 255.0 DFES_OneToOne 0.00 255.0 FORMAT "%5.1" /end CHARACTERISTIC
/begin CHARACTERISTIC DFES_FaultTyp.DFC_OilTSRCMin_C "/" VALUE 0x80074DE4 Val_Wu8 255.0 DFES_OneToOne 0.00 255.0 FORMAT "%5.1" /end CHARACTERISTIC
/begin CHARACTERISTIC DFES_FaultTyp.DFC_PCACDsEnvPPls_C "/" VALUE 0x80074DE5 Val_Wu8 255.0 DFES_OneToOne 0.00 255.0 FORMAT "%5.1" /end CHARACTERISTIC
/begin CHARACTERISTIC DFES_FaultTyp.DFC_PCACDsSRCMax_C "/" VALUE 0x80074DE6 Val_Wu8 255.0 DFES_OneToOne 0.00 255.0 FORMAT "%5.1" /end CHARACTERISTIC
/begin CHARACTERISTIC DFES_FaultTyp.DFC_PCACDsSRCMin_C "/" VALUE 0x80074DE7 Val_Wu8 255.0 DFES_OneToOne 0.00 255.0 FORMAT "%5.1" /end CHARACTERISTIC
/begin CHARACTERISTIC DFES_FaultTyp.DFC_PCVSCG_C "/" VALUE 0x80074DE8 Val_Wu8 255.0 DFES_OneToOne 0.00 255.0 FORMAT "%5.1" /end CHARACTERISTIC
/begin CHARACTERISTIC DFES_FaultTyp.DFC_PFltCharPDiffMin_C "/" VALUE 0x80074DE9 Val_Wu8 255.0 DFES_OneToOne 0.00 255.0 FORMAT "%5.1" /end CHARACTERISTIC
/begin CHARACTERISTIC DFES_FaultTyp.DFC_PFltDstrMin_C "/" VALUE 0x80074DEA Val_Wu8 255.0 DFES_OneToOne 0.00 255.0 FORMAT "%5.1" /end CHARACTERISTIC
/begin CHARACTERISTIC DFES_FaultTyp.DFC_PFltEngPrt_C "/" VALUE 0x80074DEB Val_Wu8 255.0 DFES_OneToOne 0.00 255.0 FORMAT "%5.1" /end CHARACTERISTIC
/begin CHARACTERISTIC DFES_FaultTyp.DFC_PFltLmpOL_C "/" VALUE 0x80074DEC Val_Wu8 255.0 DFES_OneToOne 0.00 255.0 FORMAT "%5.1" /end CHARACTERISTIC
/begin CHARACTERISTIC DFES_FaultTyp.DFC_PFltLmpSCB_C "/" VALUE 0x80074DED Val_Wu8 255.0 DFES_OneToOne 0.00 255.0 FORMAT "%5.1" /end CHARACTERISTIC
/begin CHARACTERISTIC DFES_FaultTyp.DFC_PFltLmpSCG_C "/" VALUE 0x80074DEE Val_Wu8 255.0 DFES_OneToOne 0.00 255.0 FORMAT "%5.1" /end CHARACTERISTIC
/begin CHARACTERISTIC DFES_FaultTyp.DFC_PFltRgnPerm_C "/" VALUE 0x80074DEF Val_Wu8 255.0 DFES_OneToOne 0.00 255.0 FORMAT "%5.1" /end CHARACTERISTIC
/begin CHARACTERISTIC DFES_FaultTyp.DFC_PFltSRCMaxFlwRstn_C "/" VALUE 0x80074DF0 Val_Wu8 255.0 DFES_OneToOne 0.00 255.0 FORMAT "%5.1" /end CHARACTERISTIC
/begin CHARACTERISTIC DFES_FaultTyp.DFC_PFltSRCMinFlwRstn_C "/" VALUE 0x80074DF1 Val_Wu8 255.0 DFES_OneToOne 0.00 255.0 FORMAT "%5.1" /end CHARACTERISTIC
/begin CHARACTERISTIC DFES_FaultTyp.DFC_PFltSotMsDvtMax_C "/" VALUE 0x80074DF2 Val_Wu8 255.0 DFES_OneToOne 0.00 255.0 FORMAT "%5.1" /end CHARACTERISTIC
/begin CHARACTERISTIC DFES_FaultTyp.DFC_PFltSotMsDvtMin_C "/" VALUE 0x80074DF3 Val_Wu8 255.0 DFES_OneToOne 0.00 255.0 FORMAT "%5.1" /end CHARACTERISTIC
/begin CHARACTERISTIC DFES_FaultTyp.DFC_PFltSotMsMax_C "/" VALUE 0x80074DF4 Val_Wu8 255.0 DFES_OneToOne 0.00 255.0 FORMAT "%5.1" /end CHARACTERISTIC
/begin CHARACTERISTIC DFES_FaultTyp.DFC_PSPOL_C "/" VALUE 0x80074DF5 Val_Wu8 255.0 DFES_OneToOne 0.00 255.0 FORMAT "%5.1" /end CHARACTERISTIC
/begin CHARACTERISTIC DFES_FaultTyp.DFC_PSPSCB_C "/" VALUE 0x80074DF6 Val_Wu8 255.0 DFES_OneToOne 0.00 255.0 FORMAT "%5.1" /end CHARACTERISTIC
/begin CHARACTERISTIC DFES_FaultTyp.DFC_PSPSCG_C "/" VALUE 0x80074DF7 Val_Wu8 255.0 DFES_OneToOne 0.00 255.0 FORMAT "%5.1" /end CHARACTERISTIC
/begin CHARACTERISTIC DFES_FaultTyp.DFC_SRCHighAPP1_C "/" VALUE 0x80074DF8 Val_Wu8 255.0 DFES_OneToOne 0.00 255.0 FORMAT "%5.1" /end CHARACTERISTIC
/begin CHARACTERISTIC DFES_FaultTyp.DFC_SRCHighAPP2_C "/" VALUE 0x80074DF9 Val_Wu8 255.0 DFES_OneToOne 0.00 255.0 FORMAT "%5.1" /end CHARACTERISTIC
/begin CHARACTERISTIC DFES_FaultTyp.DFC_SRCLowAPP1_C "/" VALUE 0x80074DFA Val_Wu8 255.0 DFES_OneToOne 0.00 255.0 FORMAT "%5.1" /end CHARACTERISTIC
/begin CHARACTERISTIC DFES_FaultTyp.DFC_SRCLowAPP2_C "/" VALUE 0x80074DFB Val_Wu8 255.0 DFES_OneToOne 0.00 255.0 FORMAT "%5.1" /end CHARACTERISTIC
/begin CHARACTERISTIC DFES_FaultTyp.DFC_SRCMaxPAirFltDs_C "/" VALUE 0x80074DFC Val_Wu8 255.0 DFES_OneToOne 0.00 255.0 FORMAT "%5.1" /end CHARACTERISTIC
/begin CHARACTERISTIC DFES_FaultTyp.DFC_SRCMaxPPFltUs_C "/" VALUE 0x80074DFD Val_Wu8 255.0 DFES_OneToOne 0.00 255.0 FORMAT "%5.1" /end CHARACTERISTIC
/begin CHARACTERISTIC DFES_FaultTyp.DFC_SRCMaxTECU_C "/" VALUE 0x80074DFE Val_Wu8 255.0 DFES_OneToOne 0.00 255.0 FORMAT "%5.1" /end CHARACTERISTIC
/begin CHARACTERISTIC DFES_FaultTyp.DFC_SRCMaxTOxiCatUs_C "/" VALUE 0x80074DFF Val_Wu8 255.0 DFES_OneToOne 0.00 255.0 FORMAT "%5.1" /end CHARACTERISTIC
/begin CHARACTERISTIC DFES_FaultTyp.DFC_SRCMaxTPFltUs_C "/" VALUE 0x80074E00 Val_Wu8 255.0 DFES_OneToOne 0.00 255.0 FORMAT "%5.1" /end CHARACTERISTIC
/begin CHARACTERISTIC DFES_FaultTyp.DFC_SRCMinPAirFltDs_C "/" VALUE 0x80074E01 Val_Wu8 255.0 DFES_OneToOne 0.00 255.0 FORMAT "%5.1" /end CHARACTERISTIC
/begin CHARACTERISTIC DFES_FaultTyp.DFC_SRCMinPPFltUs_C "/" VALUE 0x80074E02 Val_Wu8 255.0 DFES_OneToOne 0.00 255.0 FORMAT "%5.1" /end CHARACTERISTIC
/begin CHARACTERISTIC DFES_FaultTyp.DFC_SRCMinTECU_C "/" VALUE 0x80074E03 Val_Wu8 255.0 DFES_OneToOne 0.00 255.0 FORMAT "%5.1" /end CHARACTERISTIC
/begin CHARACTERISTIC DFES_FaultTyp.DFC_SRCMinTOxiCatUs_C "/" VALUE 0x80074E04 Val_Wu8 255.0 DFES_OneToOne 0.00 255.0 FORMAT "%5.1" /end CHARACTERISTIC
/begin CHARACTERISTIC DFES_FaultTyp.DFC_SRCMinTPFltUs_C "/" VALUE 0x80074E05 Val_Wu8 255.0 DFES_OneToOne 0.00 255.0 FORMAT "%5.1" /end CHARACTERISTIC
/begin CHARACTERISTIC DFES_FaultTyp.DFC_SVSOL_C "/" VALUE 0x80074E06 Val_Wu8 255.0 DFES_OneToOne 0.00 255.0 FORMAT "%5.1" /end CHARACTERISTIC
/begin CHARACTERISTIC DFES_FaultTyp.DFC_SVSSCB_C "/" VALUE 0x80074E07 Val_Wu8 255.0 DFES_OneToOne 0.00 255.0 FORMAT "%5.1" /end CHARACTERISTIC
/begin CHARACTERISTIC DFES_FaultTyp.DFC_SVSSCG_C "/" VALUE 0x80074E08 Val_Wu8 255.0 DFES_OneToOne 0.00 255.0 FORMAT "%5.1" /end CHARACTERISTIC
/begin CHARACTERISTIC DFES_FaultTyp.DFC_StrtOL_C "/" VALUE 0x80074E09 Val_Wu8 255.0 DFES_OneToOne 0.00 255.0 FORMAT "%5.1" /end CHARACTERISTIC
/begin CHARACTERISTIC DFES_FaultTyp.DFC_StrtSCB_C "/" VALUE 0x80074E0A Val_Wu8 255.0 DFES_OneToOne 0.00 255.0 FORMAT "%5.1" /end CHARACTERISTIC
/begin CHARACTERISTIC DFES_FaultTyp.DFC_StrtSCG_C "/" VALUE 0x80074E0B Val_Wu8 255.0 DFES_OneToOne 0.00 255.0 FORMAT "%5.1" /end CHARACTERISTIC
/begin CHARACTERISTIC DFES_FaultTyp.DFC_SyncAPP_C "/" VALUE 0x80074E0C Val_Wu8 255.0 DFES_OneToOne 0.00 255.0 FORMAT "%5.1" /end CHARACTERISTIC
/begin CHARACTERISTIC DFES_FaultTyp.DFC_T15Npl_C "/" VALUE 0x80074E0D Val_Wu8 255.0 DFES_OneToOne 0.00 255.0 FORMAT "%5.1" /end CHARACTERISTIC
/begin CHARACTERISTIC DFES_FaultTyp.DFC_TAFSDtyCycHi_C "/" VALUE 0x80074E0E Val_Wu8 255.0 DFES_OneToOne 0.00 255.0 FORMAT "%5.1" /end CHARACTERISTIC
/begin CHARACTERISTIC DFES_FaultTyp.DFC_TAFSDtyCycLo_C "/" VALUE 0x80074E0F Val_Wu8 255.0 DFES_OneToOne 0.00 255.0 FORMAT "%5.1" /end CHARACTERISTIC
/begin CHARACTERISTIC DFES_FaultTyp.DFC_TAFSPerHi_C "/" VALUE 0x80074E10 Val_Wu8 255.0 DFES_OneToOne 0.00 255.0 FORMAT "%5.1" /end CHARACTERISTIC
/begin CHARACTERISTIC DFES_FaultTyp.DFC_TAFSPerLo_C "/" VALUE 0x80074E11 Val_Wu8 255.0 DFES_OneToOne 0.00 255.0 FORMAT "%5.1" /end CHARACTERISTIC
/begin CHARACTERISTIC DFES_FaultTyp.DFC_TCACDsSRCMax_C "/" VALUE 0x80074E12 Val_Wu8 255.0 DFES_OneToOne 0.00 255.0 FORMAT "%5.1" /end CHARACTERISTIC
/begin CHARACTERISTIC DFES_FaultTyp.DFC_TCACDsSRCMin_C "/" VALUE 0x80074E13 Val_Wu8 255.0 DFES_OneToOne 0.00 255.0 FORMAT "%5.1" /end CHARACTERISTIC
/begin CHARACTERISTIC DFES_FaultTyp.DFC_ThrVlvOL_C "/" VALUE 0x80074E14 Val_Wu8 255.0 DFES_OneToOne 0.00 255.0 FORMAT "%5.1" /end CHARACTERISTIC
/begin CHARACTERISTIC DFES_FaultTyp.DFC_ThrVlvSCB_C "/" VALUE 0x80074E15 Val_Wu8 255.0 DFES_OneToOne 0.00 255.0 FORMAT "%5.1" /end CHARACTERISTIC
/begin CHARACTERISTIC DFES_FaultTyp.DFC_ThrVlvSRCMax_C "/" VALUE 0x80074E16 Val_Wu8 255.0 DFES_OneToOne 0.00 255.0 FORMAT "%5.1" /end CHARACTERISTIC
/begin CHARACTERISTIC DFES_FaultTyp.DFC_ThrVlvSRCMin_C "/" VALUE 0x80074E17 Val_Wu8 255.0 DFES_OneToOne 0.00 255.0 FORMAT "%5.1" /end CHARACTERISTIC
/begin CHARACTERISTIC DFES_FaultTyp.DFC_TrbChLPOL_C "/" VALUE 0x80074E18 Val_Wu8 255.0 DFES_OneToOne 0.00 255.0 FORMAT "%5.1" /end CHARACTERISTIC
/begin CHARACTERISTIC DFES_FaultTyp.DFC_TrbChLPSCB_C "/" VALUE 0x80074E19 Val_Wu8 255.0 DFES_OneToOne 0.00 255.0 FORMAT "%5.1" /end CHARACTERISTIC
/begin CHARACTERISTIC DFES_FaultTyp.DFC_TrbChLPSCG_C "/" VALUE 0x80074E1A Val_Wu8 255.0 DFES_OneToOne 0.00 255.0 FORMAT "%5.1" /end CHARACTERISTIC
/begin CHARACTERISTIC DFES_FaultTyp.DFC_TrbChOL_C "/" VALUE 0x80074E1B Val_Wu8 255.0 DFES_OneToOne 0.00 255.0 FORMAT "%5.1" /end CHARACTERISTIC
/begin CHARACTERISTIC DFES_FaultTyp.DFC_TrbChSCB_C "/" VALUE 0x80074E1C Val_Wu8 255.0 DFES_OneToOne 0.00 255.0 FORMAT "%5.1" /end CHARACTERISTIC
/begin CHARACTERISTIC DFES_FaultTyp.DFC_VSwVlvGovDvtMax_C "/" VALUE 0x80074E1D Val_Wu8 255.0 DFES_OneToOne 0.00 255.0 FORMAT "%5.1" /end CHARACTERISTIC
/begin CHARACTERISTIC DFES_FaultTyp.DFC_VSwVlvGovDvtMin_C "/" VALUE 0x80074E1E Val_Wu8 255.0 DFES_OneToOne 0.00 255.0 FORMAT "%5.1" /end CHARACTERISTIC
/begin CHARACTERISTIC DFES_FaultTyp.DFC_VSwVlvOL_C "/" VALUE 0x80074E1F Val_Wu8 255.0 DFES_OneToOne 0.00 255.0 FORMAT "%5.1" /end CHARACTERISTIC
/begin CHARACTERISTIC DFES_FaultTyp.DFC_VSwVlvSCB_C "/" VALUE 0x80074E20 Val_Wu8 255.0 DFES_OneToOne 0.00 255.0 FORMAT "%5.1" /end CHARACTERISTIC
/begin CHARACTERISTIC DFES_FaultTyp.DFC_VSwVlvSCG_C "/" VALUE 0x80074E21 Val_Wu8 255.0 DFES_OneToOne 0.00 255.0 FORMAT "%5.1" /end CHARACTERISTIC
/begin CHARACTERISTIC DFES_FaultTyp.DFC_VSwVlvSRCMax_C "/" VALUE 0x80074E22 Val_Wu8 255.0 DFES_OneToOne 0.00 255.0 FORMAT "%5.1" /end CHARACTERISTIC
/begin CHARACTERISTIC DFES_FaultTyp.DFC_VSwVlvSRCMin_C "/" VALUE 0x80074E23 Val_Wu8 255.0 DFES_OneToOne 0.00 255.0 FORMAT "%5.1" /end CHARACTERISTIC
/begin CHARACTERISTIC DFES_FaultTyp.DFC_VehVHW_C "/" VALUE 0x80074E24 Val_Wu8 255.0 DFES_OneToOne 0.00 255.0 FORMAT "%5.1" /end CHARACTERISTIC
/begin CHARACTERISTIC DFES_FaultTyp.DFC_VehVMax_C "/" VALUE 0x80074E25 Val_Wu8 255.0 DFES_OneToOne 0.00 255.0 FORMAT "%5.1" /end CHARACTERISTIC
/begin CHARACTERISTIC DFES_FaultTyp.DFC_VehVPlaus_C "/" VALUE 0x80074E26 Val_Wu8 255.0 DFES_OneToOne 0.00 255.0 FORMAT "%5.1" /end CHARACTERISTIC
/begin CHARACTERISTIC DFES_FaultTyp.DFC_VehVSig_C "/" VALUE 0x80074E27 Val_Wu8 255.0 DFES_OneToOne 0.00 255.0 FORMAT "%5.1" /end CHARACTERISTIC
/begin CHARACTERISTIC DFES_FaultTyp.DFC_WaHtElOL_C "/" VALUE 0x80074E28 Val_Wu8 255.0 DFES_OneToOne 0.00 255.0 FORMAT "%5.1" /end CHARACTERISTIC
/begin CHARACTERISTIC DFES_FaultTyp.DFC_WaHtElSCB_C "/" VALUE 0x80074E29 Val_Wu8 255.0 DFES_OneToOne 0.00 255.0 FORMAT "%5.1" /end CHARACTERISTIC
/begin CHARACTERISTIC DFES_FaultTyp.DFC_ClthNpl_C "/" VALUE 0x80074E2A Val_Wu8 255.0 DFES_OneToOne 0.00 255.0 FORMAT "%5.1" /end CHARACTERISTIC
/begin CHARACTERISTIC DFES_FaultTyp.DFC_ETClbETMax_0_C "/" VALUE 0x80074E2B Val_Wu8 255.0 DFES_OneToOne 0.00 255.0 FORMAT "%5.1" /end CHARACTERISTIC
/begin CHARACTERISTIC DFES_FaultTyp.DFC_ETClbETMax_1_C "/" VALUE 0x80074E2C Val_Wu8 255.0 DFES_OneToOne 0.00 255.0 FORMAT "%5.1" /end CHARACTERISTIC
/begin CHARACTERISTIC DFES_FaultTyp.DFC_ETClbETMax_2_C "/" VALUE 0x80074E2D Val_Wu8 255.0 DFES_OneToOne 0.00 255.0 FORMAT "%5.1" /end CHARACTERISTIC
/begin CHARACTERISTIC DFES_FaultTyp.DFC_ETClbETMax_3_C "/" VALUE 0x80074E2E Val_Wu8 255.0 DFES_OneToOne 0.00 255.0 FORMAT "%5.1" /end CHARACTERISTIC
/begin CHARACTERISTIC DFES_FaultTyp.DFC_ETClbETMax_4_C "/" VALUE 0x80074E2F Val_Wu8 255.0 DFES_OneToOne 0.00 255.0 FORMAT "%5.1" /end CHARACTERISTIC
/begin CHARACTERISTIC DFES_FaultTyp.DFC_ETClbETMax_5_C "/" VALUE 0x80074E30 Val_Wu8 255.0 DFES_OneToOne 0.00 255.0 FORMAT "%5.1" /end CHARACTERISTIC
/begin CHARACTERISTIC DFES_FaultTyp.DFC_ETClbETMin_0_C "/" VALUE 0x80074E31 Val_Wu8 255.0 DFES_OneToOne 0.00 255.0 FORMAT "%5.1" /end CHARACTERISTIC
/begin CHARACTERISTIC DFES_FaultTyp.DFC_ETClbETMin_1_C "/" VALUE 0x80074E32 Val_Wu8 255.0 DFES_OneToOne 0.00 255.0 FORMAT "%5.1" /end CHARACTERISTIC
/begin CHARACTERISTIC DFES_FaultTyp.DFC_ETClbETMin_2_C "/" VALUE 0x80074E33 Val_Wu8 255.0 DFES_OneToOne 0.00 255.0 FORMAT "%5.1" /end CHARACTERISTIC
/begin CHARACTERISTIC DFES_FaultTyp.DFC_ETClbETMin_3_C "/" VALUE 0x80074E34 Val_Wu8 255.0 DFES_OneToOne 0.00 255.0 FORMAT "%5.1" /end CHARACTERISTIC
/begin CHARACTERISTIC DFES_FaultTyp.DFC_ETClbETMin_4_C "/" VALUE 0x80074E35 Val_Wu8 255.0 DFES_OneToOne 0.00 255.0 FORMAT "%5.1" /end CHARACTERISTIC
/begin CHARACTERISTIC DFES_FaultTyp.DFC_ETClbETMin_5_C "/" VALUE 0x80074E36 Val_Wu8 255.0 DFES_OneToOne 0.00 255.0 FORMAT "%5.1" /end CHARACTERISTIC
/begin CHARACTERISTIC DFES_FaultTyp.DFC_IVDiaBnkShCirBSH_0_C "/" VALUE 0x80074E37 Val_Wu8 255.0 DFES_OneToOne 0.00 255.0 FORMAT "%5.1" /end CHARACTERISTIC
/begin CHARACTERISTIC DFES_FaultTyp.DFC_IVDiaBnkShCirBSH_1_C "/" VALUE 0x80074E38 Val_Wu8 255.0 DFES_OneToOne 0.00 255.0 FORMAT "%5.1" /end CHARACTERISTIC
/begin CHARACTERISTIC DFES_FaultTyp.DFC_IVDiaBnkShCirChSwt_0_C "/" VALUE 0x80074E39 Val_Wu8 255.0 DFES_OneToOne 0.00 255.0 FORMAT "%5.1" /end CHARACTERISTIC
/begin CHARACTERISTIC DFES_FaultTyp.DFC_IVDiaBnkShCirChSwt_1_C "/" VALUE 0x80074E3A Val_Wu8 255.0 DFES_OneToOne 0.00 255.0 FORMAT "%5.1" /end CHARACTERISTIC
/begin CHARACTERISTIC DFES_FaultTyp.DFC_IVDiaBnkShCirHSBatt_0_C "/" VALUE 0x80074E3B Val_Wu8 255.0 DFES_OneToOne 0.00 255.0 FORMAT "%5.1" /end CHARACTERISTIC
/begin CHARACTERISTIC DFES_FaultTyp.DFC_IVDiaBnkShCirHSBatt_1_C "/" VALUE 0x80074E3C Val_Wu8 255.0 DFES_OneToOne 0.00 255.0 FORMAT "%5.1" /end CHARACTERISTIC
/begin CHARACTERISTIC DFES_FaultTyp.DFC_IVDiaBnkShCirHiRstnc_0_C "/" VALUE 0x80074E3D Val_Wu8 255.0 DFES_OneToOne 0.00 255.0 FORMAT "%5.1" /end CHARACTERISTIC
/begin CHARACTERISTIC DFES_FaultTyp.DFC_IVDiaBnkShCirHiRstnc_1_C "/" VALUE 0x80074E3E Val_Wu8 255.0 DFES_OneToOne 0.00 255.0 FORMAT "%5.1" /end CHARACTERISTIC
/begin CHARACTERISTIC DFES_FaultTyp.DFC_IVDiaBnkShCirLSHSGnd_0_C "/" VALUE 0x80074E3F Val_Wu8 255.0 DFES_OneToOne 0.00 255.0 FORMAT "%5.1" /end CHARACTERISTIC
/begin CHARACTERISTIC DFES_FaultTyp.DFC_IVDiaBnkShCirLSHSGnd_1_C "/" VALUE 0x80074E40 Val_Wu8 255.0 DFES_OneToOne 0.00 255.0 FORMAT "%5.1" /end CHARACTERISTIC
/begin CHARACTERISTIC DFES_FaultTyp.DFC_IVDiaBnkShCirTransfer_0_C "/" VALUE 0x80074E41 Val_Wu8 255.0 DFES_OneToOne 0.00 255.0 FORMAT "%5.1" /end CHARACTERISTIC
/begin CHARACTERISTIC DFES_FaultTyp.DFC_IVDiaBnkShCirTransfer_1_C "/" VALUE 0x80074E42 Val_Wu8 255.0 DFES_OneToOne 0.00 255.0 FORMAT "%5.1" /end CHARACTERISTIC
/begin CHARACTERISTIC DFES_FaultTyp.DFC_IVDiaCylNoCls_0_C "/" VALUE 0x80074E43 Val_Wu8 255.0 DFES_OneToOne 0.00 255.0 FORMAT "%5.1" /end CHARACTERISTIC
/begin CHARACTERISTIC DFES_FaultTyp.DFC_IVDiaCylNoCls_1_C "/" VALUE 0x80074E44 Val_Wu8 255.0 DFES_OneToOne 0.00 255.0 FORMAT "%5.1" /end CHARACTERISTIC
/begin CHARACTERISTIC DFES_FaultTyp.DFC_IVDiaCylNoCls_2_C "/" VALUE 0x80074E45 Val_Wu8 255.0 DFES_OneToOne 0.00 255.0 FORMAT "%5.1" /end CHARACTERISTIC
/begin CHARACTERISTIC DFES_FaultTyp.DFC_IVDiaCylNoCls_3_C "/" VALUE 0x80074E46 Val_Wu8 255.0 DFES_OneToOne 0.00 255.0 FORMAT "%5.1" /end CHARACTERISTIC
/begin CHARACTERISTIC DFES_FaultTyp.DFC_IVDiaCylNoCls_4_C "/" VALUE 0x80074E47 Val_Wu8 255.0 DFES_OneToOne 0.00 255.0 FORMAT "%5.1" /end CHARACTERISTIC
/begin CHARACTERISTIC DFES_FaultTyp.DFC_IVDiaCylNoCls_5_C "/" VALUE 0x80074E48 Val_Wu8 255.0 DFES_OneToOne 0.00 255.0 FORMAT "%5.1" /end CHARACTERISTIC
/begin CHARACTERISTIC DFES_FaultTyp.DFC_IVDiaCylNoLd_0_C "/" VALUE 0x80074E49 Val_Wu8 255.0 DFES_OneToOne 0.00 255.0 FORMAT "%5.1" /end CHARACTERISTIC
/begin CHARACTERISTIC DFES_FaultTyp.DFC_IVDiaCylNoLd_1_C "/" VALUE 0x80074E4A Val_Wu8 255.0 DFES_OneToOne 0.00 255.0 FORMAT "%5.1" /end CHARACTERISTIC
/begin CHARACTERISTIC DFES_FaultTyp.DFC_IVDiaCylNoLd_2_C "/" VALUE 0x80074E4B Val_Wu8 255.0 DFES_OneToOne 0.00 255.0 FORMAT "%5.1" /end CHARACTERISTIC
/begin CHARACTERISTIC DFES_FaultTyp.DFC_IVDiaCylNoLd_3_C "/" VALUE 0x80074E4C Val_Wu8 255.0 DFES_OneToOne 0.00 255.0 FORMAT "%5.1" /end CHARACTERISTIC
/begin CHARACTERISTIC DFES_FaultTyp.DFC_IVDiaCylNoLd_4_C "/" VALUE 0x80074E4D Val_Wu8 255.0 DFES_OneToOne 0.00 255.0 FORMAT "%5.1" /end CHARACTERISTIC
/begin CHARACTERISTIC DFES_FaultTyp.DFC_IVDiaCylNoLd_5_C "/" VALUE 0x80074E4E Val_Wu8 255.0 DFES_OneToOne 0.00 255.0 FORMAT "%5.1" /end CHARACTERISTIC
/begin CHARACTERISTIC DFES_FaultTyp.DFC_IVDiaCylShCirHiRstnc_0_C "/" VALUE 0x80074E4F Val_Wu8 255.0 DFES_OneToOne 0.00 255.0 FORMAT "%5.1" /end CHARACTERISTIC
/begin CHARACTERISTIC DFES_FaultTyp.DFC_IVDiaCylShCirHiRstnc_1_C "/" VALUE 0x80074E50 Val_Wu8 255.0 DFES_OneToOne 0.00 255.0 FORMAT "%5.1" /end CHARACTERISTIC
/begin CHARACTERISTIC DFES_FaultTyp.DFC_IVDiaCylShCirHiRstnc_2_C "/" VALUE 0x80074E51 Val_Wu8 255.0 DFES_OneToOne 0.00 255.0 FORMAT "%5.1" /end CHARACTERISTIC
/begin CHARACTERISTIC DFES_FaultTyp.DFC_IVDiaCylShCirHiRstnc_3_C "/" VALUE 0x80074E52 Val_Wu8 255.0 DFES_OneToOne 0.00 255.0 FORMAT "%5.1" /end CHARACTERISTIC
/begin CHARACTERISTIC DFES_FaultTyp.DFC_IVDiaCylShCirHiRstnc_4_C "/" VALUE 0x80074E53 Val_Wu8 255.0 DFES_OneToOne 0.00 255.0 FORMAT "%5.1" /end CHARACTERISTIC
/begin CHARACTERISTIC DFES_FaultTyp.DFC_IVDiaCylShCirHiRstnc_5_C "/" VALUE 0x80074E54 Val_Wu8 255.0 DFES_OneToOne 0.00 255.0 FORMAT "%5.1" /end CHARACTERISTIC
/begin CHARACTERISTIC DFES_FaultTyp.DFC_IVDiaCylShCirLSBatt_0_C "/" VALUE 0x80074E55 Val_Wu8 255.0 DFES_OneToOne 0.00 255.0 FORMAT "%5.1" /end CHARACTERISTIC
/begin CHARACTERISTIC DFES_FaultTyp.DFC_IVDiaCylShCirLSBatt_1_C "/" VALUE 0x80074E56 Val_Wu8 255.0 DFES_OneToOne 0.00 255.0 FORMAT "%5.1" /end CHARACTERISTIC
/begin CHARACTERISTIC DFES_FaultTyp.DFC_IVDiaCylShCirLSBatt_2_C "/" VALUE 0x80074E57 Val_Wu8 255.0 DFES_OneToOne 0.00 255.0 FORMAT "%5.1" /end CHARACTERISTIC
/begin CHARACTERISTIC DFES_FaultTyp.DFC_IVDiaCylShCirLSBatt_3_C "/" VALUE 0x80074E58 Val_Wu8 255.0 DFES_OneToOne 0.00 255.0 FORMAT "%5.1" /end CHARACTERISTIC
/begin CHARACTERISTIC DFES_FaultTyp.DFC_IVDiaCylShCirLSBatt_4_C "/" VALUE 0x80074E59 Val_Wu8 255.0 DFES_OneToOne 0.00 255.0 FORMAT "%5.1" /end CHARACTERISTIC
/begin CHARACTERISTIC DFES_FaultTyp.DFC_IVDiaCylShCirLSBatt_5_C "/" VALUE 0x80074E5A Val_Wu8 255.0 DFES_OneToOne 0.00 255.0 FORMAT "%5.1" /end CHARACTERISTIC
/begin CHARACTERISTIC DFES_FaultTyp.DFC_IVDiaCylShCirLSHS_0_C "/" VALUE 0x80074E5B Val_Wu8 255.0 DFES_OneToOne 0.00 255.0 FORMAT "%5.1" /end CHARACTERISTIC
/begin CHARACTERISTIC DFES_FaultTyp.DFC_IVDiaCylShCirLSHS_1_C "/" VALUE 0x80074E5C Val_Wu8 255.0 DFES_OneToOne 0.00 255.0 FORMAT "%5.1" /end CHARACTERISTIC
/begin CHARACTERISTIC DFES_FaultTyp.DFC_IVDiaCylShCirLSHS_2_C "/" VALUE 0x80074E5D Val_Wu8 255.0 DFES_OneToOne 0.00 255.0 FORMAT "%5.1" /end CHARACTERISTIC
/begin CHARACTERISTIC DFES_FaultTyp.DFC_IVDiaCylShCirLSHS_3_C "/" VALUE 0x80074E5E Val_Wu8 255.0 DFES_OneToOne 0.00 255.0 FORMAT "%5.1" /end CHARACTERISTIC
/begin CHARACTERISTIC DFES_FaultTyp.DFC_IVDiaCylShCirLSHS_4_C "/" VALUE 0x80074E5F Val_Wu8 255.0 DFES_OneToOne 0.00 255.0 FORMAT "%5.1" /end CHARACTERISTIC
/begin CHARACTERISTIC DFES_FaultTyp.DFC_IVDiaCylShCirLSHS_5_C "/" VALUE 0x80074E60 Val_Wu8 255.0 DFES_OneToOne 0.00 255.0 FORMAT "%5.1" /end CHARACTERISTIC
/begin CHARACTERISTIC DFES_FaultTyp.DFC_IVDiaCylShCirLsLs_0_C "/" VALUE 0x80074E61 Val_Wu8 255.0 DFES_OneToOne 0.00 255.0 FORMAT "%5.1" /end CHARACTERISTIC
/begin CHARACTERISTIC DFES_FaultTyp.DFC_IVDiaCylShCirLsLs_1_C "/" VALUE 0x80074E62 Val_Wu8 255.0 DFES_OneToOne 0.00 255.0 FORMAT "%5.1" /end CHARACTERISTIC
/begin CHARACTERISTIC DFES_FaultTyp.DFC_IVDiaCylShCirLsLs_2_C "/" VALUE 0x80074E63 Val_Wu8 255.0 DFES_OneToOne 0.00 255.0 FORMAT "%5.1" /end CHARACTERISTIC
/begin CHARACTERISTIC DFES_FaultTyp.DFC_IVDiaCylShCirLsLs_3_C "/" VALUE 0x80074E64 Val_Wu8 255.0 DFES_OneToOne 0.00 255.0 FORMAT "%5.1" /end CHARACTERISTIC
/begin CHARACTERISTIC DFES_FaultTyp.DFC_IVDiaCylShCirLsLs_4_C "/" VALUE 0x80074E65 Val_Wu8 255.0 DFES_OneToOne 0.00 255.0 FORMAT "%5.1" /end CHARACTERISTIC
/begin CHARACTERISTIC DFES_FaultTyp.DFC_IVDiaCylShCirLsLs_5_C "/" VALUE 0x80074E66 Val_Wu8 255.0 DFES_OneToOne 0.00 255.0 FORMAT "%5.1" /end CHARACTERISTIC
/begin CHARACTERISTIC DFES_FaultTyp.DFC_IVDiaSPICfg_C "/" VALUE 0x80074E67 Val_Wu8 255.0 DFES_OneToOne 0.00 255.0 FORMAT "%5.1" /end CHARACTERISTIC
/begin CHARACTERISTIC DFES_FaultTyp.DFC_IVDiaSPIColl_C "/" VALUE 0x80074E68 Val_Wu8 255.0 DFES_OneToOne 0.00 255.0 FORMAT "%5.1" /end CHARACTERISTIC
/begin CHARACTERISTIC DFES_FaultTyp.DFC_IVDiaSPICtrl_C "/" VALUE 0x80074E69 Val_Wu8 255.0 DFES_OneToOne 0.00 255.0 FORMAT "%5.1" /end CHARACTERISTIC
/begin CHARACTERISTIC DFES_FaultTyp.DFC_IVDiaSPIRam_C "/" VALUE 0x80074E6A Val_Wu8 255.0 DFES_OneToOne 0.00 255.0 FORMAT "%5.1" /end CHARACTERISTIC
/begin CHARACTERISTIC DFES_FaultTyp.DFC_IVDiaSPITrans_C "/" VALUE 0x80074E6B Val_Wu8 255.0 DFES_OneToOne 0.00 255.0 FORMAT "%5.1" /end CHARACTERISTIC
/begin CHARACTERISTIC DFES_FaultTyp.DFC_LSUCmpChk_0_C "/" VALUE 0x80074E6C Val_Wu8 255.0 DFES_OneToOne 0.00 255.0 FORMAT "%5.1" /end CHARACTERISTIC
/begin CHARACTERISTIC DFES_FaultTyp.DFC_LSUCmpChk_1_C "/" VALUE 0x80074E6D Val_Wu8 255.0 DFES_OneToOne 0.00 255.0 FORMAT "%5.1" /end CHARACTERISTIC
/begin CHARACTERISTIC DFES_FaultTyp.DFC_LSUCmpChk_2_C "/" VALUE 0x80074E6E Val_Wu8 255.0 DFES_OneToOne 0.00 255.0 FORMAT "%5.1" /end CHARACTERISTIC
/begin CHARACTERISTIC DFES_FaultTyp.DFC_LSUCmpChk_3_C "/" VALUE 0x80074E6F Val_Wu8 255.0 DFES_OneToOne 0.00 255.0 FORMAT "%5.1" /end CHARACTERISTIC
/begin CHARACTERISTIC DFES_FaultTyp.DFC_LSUCmpChk_4_C "/" VALUE 0x80074E70 Val_Wu8 255.0 DFES_OneToOne 0.00 255.0 FORMAT "%5.1" /end CHARACTERISTIC
/begin CHARACTERISTIC DFES_FaultTyp.DFC_LSUCmpChk_5_C "/" VALUE 0x80074E71 Val_Wu8 255.0 DFES_OneToOne 0.00 255.0 FORMAT "%5.1" /end CHARACTERISTIC
/begin CHARACTERISTIC DFES_FaultTyp.DFC_LSUDynChk_0_C "/" VALUE 0x80074E72 Val_Wu8 255.0 DFES_OneToOne 0.00 255.0 FORMAT "%5.1" /end CHARACTERISTIC
/begin CHARACTERISTIC DFES_FaultTyp.DFC_LSUDynChk_1_C "/" VALUE 0x80074E73 Val_Wu8 255.0 DFES_OneToOne 0.00 255.0 FORMAT "%5.1" /end CHARACTERISTIC
/begin CHARACTERISTIC DFES_FaultTyp.DFC_LSUDynChk_2_C "/" VALUE 0x80074E74 Val_Wu8 255.0 DFES_OneToOne 0.00 255.0 FORMAT "%5.1" /end CHARACTERISTIC
/begin CHARACTERISTIC DFES_FaultTyp.DFC_LSUDynChk_3_C "/" VALUE 0x80074E75 Val_Wu8 255.0 DFES_OneToOne 0.00 255.0 FORMAT "%5.1" /end CHARACTERISTIC
/begin CHARACTERISTIC DFES_FaultTyp.DFC_LSUO2ClbMax_0_C "/" VALUE 0x80074E76 Val_Wu8 255.0 DFES_OneToOne 0.00 255.0 FORMAT "%5.1" /end CHARACTERISTIC
/begin CHARACTERISTIC DFES_FaultTyp.DFC_LSUO2ClbMax_1_C "/" VALUE 0x80074E77 Val_Wu8 255.0 DFES_OneToOne 0.00 255.0 FORMAT "%5.1" /end CHARACTERISTIC
/begin CHARACTERISTIC DFES_FaultTyp.DFC_LSUO2ClbMax_2_C "/" VALUE 0x80074E78 Val_Wu8 255.0 DFES_OneToOne 0.00 255.0 FORMAT "%5.1" /end CHARACTERISTIC
/begin CHARACTERISTIC DFES_FaultTyp.DFC_LSUO2ClbMax_3_C "/" VALUE 0x80074E79 Val_Wu8 255.0 DFES_OneToOne 0.00 255.0 FORMAT "%5.1" /end CHARACTERISTIC
/begin CHARACTERISTIC DFES_FaultTyp.DFC_LSUO2ClbMin_0_C "/" VALUE 0x80074E7A Val_Wu8 255.0 DFES_OneToOne 0.00 255.0 FORMAT "%5.1" /end CHARACTERISTIC
/begin CHARACTERISTIC DFES_FaultTyp.DFC_LSUO2ClbMin_1_C "/" VALUE 0x80074E7B Val_Wu8 255.0 DFES_OneToOne 0.00 255.0 FORMAT "%5.1" /end CHARACTERISTIC
/begin CHARACTERISTIC DFES_FaultTyp.DFC_LSUO2ClbMin_2_C "/" VALUE 0x80074E7C Val_Wu8 255.0 DFES_OneToOne 0.00 255.0 FORMAT "%5.1" /end CHARACTERISTIC
/begin CHARACTERISTIC DFES_FaultTyp.DFC_LSUO2ClbMin_3_C "/" VALUE 0x80074E7D Val_Wu8 255.0 DFES_OneToOne 0.00 255.0 FORMAT "%5.1" /end CHARACTERISTIC
/begin CHARACTERISTIC DFES_FaultTyp.DFC_LSUO2PlausMax_0_C "/" VALUE 0x80074E7E Val_Wu8 255.0 DFES_OneToOne 0.00 255.0 FORMAT "%5.1" /end CHARACTERISTIC
/begin CHARACTERISTIC DFES_FaultTyp.DFC_LSUO2PlausMax_1_C "/" VALUE 0x80074E7F Val_Wu8 255.0 DFES_OneToOne 0.00 255.0 FORMAT "%5.1" /end CHARACTERISTIC
/begin CHARACTERISTIC DFES_FaultTyp.DFC_LSUO2PlausMax_2_C "/" VALUE 0x80074E80 Val_Wu8 255.0 DFES_OneToOne 0.00 255.0 FORMAT "%5.1" /end CHARACTERISTIC
/begin CHARACTERISTIC DFES_FaultTyp.DFC_LSUO2PlausMax_3_C "/" VALUE 0x80074E81 Val_Wu8 255.0 DFES_OneToOne 0.00 255.0 FORMAT "%5.1" /end CHARACTERISTIC
/begin CHARACTERISTIC DFES_FaultTyp.DFC_LSUO2PlausMin_0_C "/" VALUE 0x80074E82 Val_Wu8 255.0 DFES_OneToOne 0.00 255.0 FORMAT "%5.1" /end CHARACTERISTIC
/begin CHARACTERISTIC DFES_FaultTyp.DFC_LSUO2PlausMin_1_C "/" VALUE 0x80074E83 Val_Wu8 255.0 DFES_OneToOne 0.00 255.0 FORMAT "%5.1" /end CHARACTERISTIC
/begin CHARACTERISTIC DFES_FaultTyp.DFC_LSUO2PlausMin_2_C "/" VALUE 0x80074E84 Val_Wu8 255.0 DFES_OneToOne 0.00 255.0 FORMAT "%5.1" /end CHARACTERISTIC
/begin CHARACTERISTIC DFES_FaultTyp.DFC_LSUO2PlausMin_3_C "/" VALUE 0x80074E85 Val_Wu8 255.0 DFES_OneToOne 0.00 255.0 FORMAT "%5.1" /end CHARACTERISTIC
/begin CHARACTERISTIC DFES_FaultTyp.DFC_LSURiClbMax_0_C "/" VALUE 0x80074E86 Val_Wu8 255.0 DFES_OneToOne 0.00 255.0 FORMAT "%5.1" /end CHARACTERISTIC
/begin CHARACTERISTIC DFES_FaultTyp.DFC_LSURiClbMax_1_C "/" VALUE 0x80074E87 Val_Wu8 255.0 DFES_OneToOne 0.00 255.0 FORMAT "%5.1" /end CHARACTERISTIC
/begin CHARACTERISTIC DFES_FaultTyp.DFC_LSURiClbMax_2_C "/" VALUE 0x80074E88 Val_Wu8 255.0 DFES_OneToOne 0.00 255.0 FORMAT "%5.1" /end CHARACTERISTIC
/begin CHARACTERISTIC DFES_FaultTyp.DFC_LSURiClbMax_3_C "/" VALUE 0x80074E89 Val_Wu8 255.0 DFES_OneToOne 0.00 255.0 FORMAT "%5.1" /end CHARACTERISTIC
/begin CHARACTERISTIC DFES_FaultTyp.DFC_LSURiClbMin_0_C "/" VALUE 0x80074E8A Val_Wu8 255.0 DFES_OneToOne 0.00 255.0 FORMAT "%5.1" /end CHARACTERISTIC
/begin CHARACTERISTIC DFES_FaultTyp.DFC_LSURiClbMin_1_C "/" VALUE 0x80074E8B Val_Wu8 255.0 DFES_OneToOne 0.00 255.0 FORMAT "%5.1" /end CHARACTERISTIC
/begin CHARACTERISTIC DFES_FaultTyp.DFC_LSURiClbMin_2_C "/" VALUE 0x80074E8C Val_Wu8 255.0 DFES_OneToOne 0.00 255.0 FORMAT "%5.1" /end CHARACTERISTIC
/begin CHARACTERISTIC DFES_FaultTyp.DFC_LSURiClbMin_3_C "/" VALUE 0x80074E8D Val_Wu8 255.0 DFES_OneToOne 0.00 255.0 FORMAT "%5.1" /end CHARACTERISTIC
/begin CHARACTERISTIC DFES_FaultTyp.DFC_LSUWireIPSig_0_C "/" VALUE 0x80074E8E Val_Wu8 255.0 DFES_OneToOne 0.00 255.0 FORMAT "%5.1" /end CHARACTERISTIC
/begin CHARACTERISTIC DFES_FaultTyp.DFC_LSUWireIPSig_1_C "/" VALUE 0x80074E8F Val_Wu8 255.0 DFES_OneToOne 0.00 255.0 FORMAT "%5.1" /end CHARACTERISTIC
/begin CHARACTERISTIC DFES_FaultTyp.DFC_LSUWireIPSig_2_C "/" VALUE 0x80074E90 Val_Wu8 255.0 DFES_OneToOne 0.00 255.0 FORMAT "%5.1" /end CHARACTERISTIC
/begin CHARACTERISTIC DFES_FaultTyp.DFC_LSUWireIPSig_3_C "/" VALUE 0x80074E91 Val_Wu8 255.0 DFES_OneToOne 0.00 255.0 FORMAT "%5.1" /end CHARACTERISTIC
/begin CHARACTERISTIC DFES_FaultTyp.DFC_AFSDrftIdlAdjVal_C "/" VALUE 0x80074E92 Val_Wu8 255.0 DFES_OneToOne 0.00 255.0 FORMAT "%5.1" /end CHARACTERISTIC
/begin CHARACTERISTIC DFES_FaultTyp.DFC_AFSDrftLdAdjVal_C "/" VALUE 0x80074E93 Val_Wu8 255.0 DFES_OneToOne 0.00 255.0 FORMAT "%5.1" /end CHARACTERISTIC
/begin CHARACTERISTIC DFES_FaultTyp.DFC_AdcI_ADC0_Cal_C "/" VALUE 0x80074E94 Val_Wu8 255.0 DFES_OneToOne 0.00 255.0 FORMAT "%5.1" /end CHARACTERISTIC
/begin CHARACTERISTIC DFES_FaultTyp.DFC_AdcI_ADC0_Conv_C "/" VALUE 0x80074E95 Val_Wu8 255.0 DFES_OneToOne 0.00 255.0 FORMAT "%5.1" /end CHARACTERISTIC
/begin CHARACTERISTIC DFES_FaultTyp.DFC_CmbChbMisfireMax_0_C "/" VALUE 0x80074E96 Val_Wu8 255.0 DFES_OneToOne 0.00 255.0 FORMAT "%5.1" /end CHARACTERISTIC
/begin CHARACTERISTIC DFES_FaultTyp.DFC_CmbChbMisfireMax_1_C "/" VALUE 0x80074E97 Val_Wu8 255.0 DFES_OneToOne 0.00 255.0 FORMAT "%5.1" /end CHARACTERISTIC
/begin CHARACTERISTIC DFES_FaultTyp.DFC_CmbChbMisfireMax_2_C "/" VALUE 0x80074E98 Val_Wu8 255.0 DFES_OneToOne 0.00 255.0 FORMAT "%5.1" /end CHARACTERISTIC
/begin CHARACTERISTIC DFES_FaultTyp.DFC_CmbChbMisfireMax_3_C "/" VALUE 0x80074E99 Val_Wu8 255.0 DFES_OneToOne 0.00 255.0 FORMAT "%5.1" /end CHARACTERISTIC
/begin CHARACTERISTIC DFES_FaultTyp.DFC_CmbChbMisfireMax_4_C "/" VALUE 0x80074E9A Val_Wu8 255.0 DFES_OneToOne 0.00 255.0 FORMAT "%5.1" /end CHARACTERISTIC
/begin CHARACTERISTIC DFES_FaultTyp.DFC_CmbChbMisfireMax_5_C "/" VALUE 0x80074E9B Val_Wu8 255.0 DFES_OneToOne 0.00 255.0 FORMAT "%5.1" /end CHARACTERISTIC
/begin CHARACTERISTIC DFES_FaultTyp.DFC_CmbChbMisfireMul_C "/" VALUE 0x80074E9C Val_Wu8 255.0 DFES_OneToOne 0.00 255.0 FORMAT "%5.1" /end CHARACTERISTIC
/begin CHARACTERISTIC DFES_FaultTyp.DFC_INJVLVBUSY_C "/" VALUE 0x80074E9D Val_Wu8 255.0 DFES_OneToOne 0.00 255.0 FORMAT "%5.1" /end CHARACTERISTIC
/begin CHARACTERISTIC DFES_FaultTyp.DFC_IVAdjIVA_0_C "/" VALUE 0x80074E9E Val_Wu8 255.0 DFES_OneToOne 0.00 255.0 FORMAT "%5.1" /end CHARACTERISTIC
/begin CHARACTERISTIC DFES_FaultTyp.DFC_IVAdjIVA_1_C "/" VALUE 0x80074E9F Val_Wu8 255.0 DFES_OneToOne 0.00 255.0 FORMAT "%5.1" /end CHARACTERISTIC
/begin CHARACTERISTIC DFES_FaultTyp.DFC_IVAdjIVA_2_C "/" VALUE 0x80074EA0 Val_Wu8 255.0 DFES_OneToOne 0.00 255.0 FORMAT "%5.1" /end CHARACTERISTIC
/begin CHARACTERISTIC DFES_FaultTyp.DFC_IVAdjIVA_3_C "/" VALUE 0x80074EA1 Val_Wu8 255.0 DFES_OneToOne 0.00 255.0 FORMAT "%5.1" /end CHARACTERISTIC
/begin CHARACTERISTIC DFES_FaultTyp.DFC_IVAdjIVA_4_C "/" VALUE 0x80074EA2 Val_Wu8 255.0 DFES_OneToOne 0.00 255.0 FORMAT "%5.1" /end CHARACTERISTIC
/begin CHARACTERISTIC DFES_FaultTyp.DFC_IVAdjIVA_5_C "/" VALUE 0x80074EA3 Val_Wu8 255.0 DFES_OneToOne 0.00 255.0 FORMAT "%5.1" /end CHARACTERISTIC
/begin CHARACTERISTIC DFES_FaultTyp.DFC_InjCtlAdjQntEEPCS_C "/" VALUE 0x80074EA4 Val_Wu8 255.0 DFES_OneToOne 0.00 255.0 FORMAT "%5.1" /end CHARACTERISTIC
/begin CHARACTERISTIC DFES_FaultTyp.DFC_InjCtlDriftEEPCS_C "/" VALUE 0x80074EA5 Val_Wu8 255.0 DFES_OneToOne 0.00 255.0 FORMAT "%5.1" /end CHARACTERISTIC
/begin CHARACTERISTIC DFES_FaultTyp.DFC_MRlyErlyOpng_C "/" VALUE 0x80074EA6 Val_Wu8 255.0 DFES_OneToOne 0.00 255.0 FORMAT "%5.1" /end CHARACTERISTIC
/begin CHARACTERISTIC DFES_FaultTyp.DFC_MRlyStk_C "/" VALUE 0x80074EA7 Val_Wu8 255.0 DFES_OneToOne 0.00 255.0 FORMAT "%5.1" /end CHARACTERISTIC
/begin CHARACTERISTIC DFES_FaultTyp.DFC_SensFrzPPFltUs_C "/" VALUE 0x80074EA8 Val_Wu8 255.0 DFES_OneToOne 0.00 255.0 FORMAT "%5.1" /end CHARACTERISTIC
/begin CHARACTERISTIC DFES_FaultTyp.DFC_T15Sig_C "/" VALUE 0x80074EA9 Val_Wu8 255.0 DFES_OneToOne 0.00 255.0 FORMAT "%5.1" /end CHARACTERISTIC
/begin CHARACTERISTIC DFES_FaultTyp.DFC_AirCtlRmpTOut_C "/" VALUE 0x80074EAA Val_Wu8 255.0 DFES_OneToOne 0.00 255.0 FORMAT "%5.1" /end CHARACTERISTIC
/begin CHARACTERISTIC DFES_FaultTyp.DFC_CEngDsTDynTst_C "/" VALUE 0x80074EAB Val_Wu8 255.0 DFES_OneToOne 0.00 255.0 FORMAT "%5.1" /end CHARACTERISTIC
/begin CHARACTERISTIC DFES_FaultTyp.DFC_EGRVlvJamVlvClsd_C "/" VALUE 0x80074EAC Val_Wu8 255.0 DFES_OneToOne 0.00 255.0 FORMAT "%5.1" /end CHARACTERISTIC
/begin CHARACTERISTIC DFES_FaultTyp.DFC_EGRVlvJamVlvOpn_C "/" VALUE 0x80074EAD Val_Wu8 255.0 DFES_OneToOne 0.00 255.0 FORMAT "%5.1" /end CHARACTERISTIC
/begin CHARACTERISTIC DFES_FaultTyp.DFC_EGRVlvLgTDrft_C "/" VALUE 0x80074EAE Val_Wu8 255.0 DFES_OneToOne 0.00 255.0 FORMAT "%5.1" /end CHARACTERISTIC
/begin CHARACTERISTIC DFES_FaultTyp.DFC_EGRVlvOfsLrnJamVlv_C "/" VALUE 0x80074EAF Val_Wu8 255.0 DFES_OneToOne 0.00 255.0 FORMAT "%5.1" /end CHARACTERISTIC
/begin CHARACTERISTIC DFES_FaultTyp.DFC_EGRVlvShTDrft_C "/" VALUE 0x80074EB0 Val_Wu8 255.0 DFES_OneToOne 0.00 255.0 FORMAT "%5.1" /end CHARACTERISTIC
/begin CHARACTERISTIC DFES_FaultTyp.DFC_EGTRgnOilDilMax_C "/" VALUE 0x80074EB1 Val_Wu8 255.0 DFES_OneToOne 0.00 255.0 FORMAT "%5.1" /end CHARACTERISTIC
/begin CHARACTERISTIC DFES_FaultTyp.DFC_EngICO_C "/" VALUE 0x80074EB2 Val_Wu8 255.0 DFES_OneToOne 0.00 255.0 FORMAT "%5.1" /end CHARACTERISTIC
/begin CHARACTERISTIC DFES_FaultTyp.DFC_EpmCaSI1ErrSig_C "/" VALUE 0x80074EB3 Val_Wu8 255.0 DFES_OneToOne 0.00 255.0 FORMAT "%5.1" /end CHARACTERISTIC
/begin CHARACTERISTIC DFES_FaultTyp.DFC_EpmCaSI1NoSig_C "/" VALUE 0x80074EB4 Val_Wu8 255.0 DFES_OneToOne 0.00 255.0 FORMAT "%5.1" /end CHARACTERISTIC
/begin CHARACTERISTIC DFES_FaultTyp.DFC_EpmCaSI1OfsErr_C "/" VALUE 0x80074EB5 Val_Wu8 255.0 DFES_OneToOne 0.00 255.0 FORMAT "%5.1" /end CHARACTERISTIC
/begin CHARACTERISTIC DFES_FaultTyp.DFC_EpmCrSErrSig_C "/" VALUE 0x80074EB6 Val_Wu8 255.0 DFES_OneToOne 0.00 255.0 FORMAT "%5.1" /end CHARACTERISTIC
/begin CHARACTERISTIC DFES_FaultTyp.DFC_EpmCrSNoSig_C "/" VALUE 0x80074EB7 Val_Wu8 255.0 DFES_OneToOne 0.00 255.0 FORMAT "%5.1" /end CHARACTERISTIC
/begin CHARACTERISTIC DFES_FaultTyp.DFC_MoCADCCmp_C "/" VALUE 0x80074EB8 Val_Wu8 255.0 DFES_OneToOne 0.00 255.0 FORMAT "%5.1" /end CHARACTERISTIC
/begin CHARACTERISTIC DFES_FaultTyp.DFC_MoCADCTst_C "/" VALUE 0x80074EB9 Val_Wu8 255.0 DFES_OneToOne 0.00 255.0 FORMAT "%5.1" /end CHARACTERISTIC
/begin CHARACTERISTIC DFES_FaultTyp.DFC_MoCADCVltgRatio_C "/" VALUE 0x80074EBA Val_Wu8 255.0 DFES_OneToOne 0.00 255.0 FORMAT "%5.1" /end CHARACTERISTIC
/begin CHARACTERISTIC DFES_FaultTyp.DFC_MoCSOPLoLi_C "/" VALUE 0x80074EBB Val_Wu8 255.0 DFES_OneToOne 0.00 255.0 FORMAT "%5.1" /end CHARACTERISTIC
/begin CHARACTERISTIC DFES_FaultTyp.DFC_MoCSOPMM_C "/" VALUE 0x80074EBC Val_Wu8 255.0 DFES_OneToOne 0.00 255.0 FORMAT "%5.1" /end CHARACTERISTIC
/begin CHARACTERISTIC DFES_FaultTyp.DFC_MoCSOPTimeOut_C "/" VALUE 0x80074EBD Val_Wu8 255.0 DFES_OneToOne 0.00 255.0 FORMAT "%5.1" /end CHARACTERISTIC
/begin CHARACTERISTIC DFES_FaultTyp.DFC_MoCSOPUpLi_C "/" VALUE 0x80074EBE Val_Wu8 255.0 DFES_OneToOne 0.00 255.0 FORMAT "%5.1" /end CHARACTERISTIC
/begin CHARACTERISTIC DFES_FaultTyp.DFC_MoFAPP_C "/" VALUE 0x80074EBF Val_Wu8 255.0 DFES_OneToOne 0.00 255.0 FORMAT "%5.1" /end CHARACTERISTIC
/begin CHARACTERISTIC DFES_FaultTyp.DFC_MoFESpd_C "/" VALUE 0x80074EC0 Val_Wu8 255.0 DFES_OneToOne 0.00 255.0 FORMAT "%5.1" /end CHARACTERISTIC
/begin CHARACTERISTIC DFES_FaultTyp.DFC_MoFInjDatPhi_C "/" VALUE 0x80074EC1 Val_Wu8 255.0 DFES_OneToOne 0.00 255.0 FORMAT "%5.1" /end CHARACTERISTIC
/begin CHARACTERISTIC DFES_FaultTyp.DFC_MoFInjDatQnt_C "/" VALUE 0x80074EC2 Val_Wu8 255.0 DFES_OneToOne 0.00 255.0 FORMAT "%5.1" /end CHARACTERISTIC
/begin CHARACTERISTIC DFES_FaultTyp.DFC_MoFInjQnt_C "/" VALUE 0x80074EC3 Val_Wu8 255.0 DFES_OneToOne 0.00 255.0 FORMAT "%5.1" /end CHARACTERISTIC
/begin CHARACTERISTIC DFES_FaultTyp.DFC_MoFOvR_C "/" VALUE 0x80074EC4 Val_Wu8 255.0 DFES_OneToOne 0.00 255.0 FORMAT "%5.1" /end CHARACTERISTIC
/begin CHARACTERISTIC DFES_FaultTyp.DFC_MoFQntCor_C "/" VALUE 0x80074EC5 Val_Wu8 255.0 DFES_OneToOne 0.00 255.0 FORMAT "%5.1" /end CHARACTERISTIC
/begin CHARACTERISTIC DFES_FaultTyp.DFC_MoFTrqCmp_C "/" VALUE 0x80074EC6 Val_Wu8 255.0 DFES_OneToOne 0.00 255.0 FORMAT "%5.1" /end CHARACTERISTIC
/begin CHARACTERISTIC DFES_FaultTyp.DFC_NplTOxiCatUs_C "/" VALUE 0x80074EC7 Val_Wu8 255.0 DFES_OneToOne 0.00 255.0 FORMAT "%5.1" /end CHARACTERISTIC
/begin CHARACTERISTIC DFES_FaultTyp.DFC_PhyModNonMonMapNpl_C "/" VALUE 0x80074EC8 Val_Wu8 255.0 DFES_OneToOne 0.00 255.0 FORMAT "%5.1" /end CHARACTERISTIC
/begin CHARACTERISTIC DFES_FaultTyp.DFC_RailPOfsTstMax_C "/" VALUE 0x80074EC9 Val_Wu8 255.0 DFES_OneToOne 0.00 255.0 FORMAT "%5.1" /end CHARACTERISTIC
/begin CHARACTERISTIC DFES_FaultTyp.DFC_RailPOfsTstMin_C "/" VALUE 0x80074ECA Val_Wu8 255.0 DFES_OneToOne 0.00 255.0 FORMAT "%5.1" /end CHARACTERISTIC
/begin CHARACTERISTIC DFES_FaultTyp.DFC_SWReset_0_C "/" VALUE 0x80074ECB Val_Wu8 255.0 DFES_OneToOne 0.00 255.0 FORMAT "%5.1" /end CHARACTERISTIC
/begin CHARACTERISTIC DFES_FaultTyp.DFC_SWReset_1_C "/" VALUE 0x80074ECC Val_Wu8 255.0 DFES_OneToOne 0.00 255.0 FORMAT "%5.1" /end CHARACTERISTIC
/begin CHARACTERISTIC DFES_FaultTyp.DFC_SWReset_2_C "/" VALUE 0x80074ECD Val_Wu8 255.0 DFES_OneToOne 0.00 255.0 FORMAT "%5.1" /end CHARACTERISTIC
/begin CHARACTERISTIC DFES_FaultTyp.DFC_VSwVlvJamVlv_C "/" VALUE 0x80074ECE Val_Wu8 255.0 DFES_OneToOne 0.00 255.0 FORMAT "%5.1" /end CHARACTERISTIC
/begin CHARACTERISTIC DFES_FaultTyp.DFC_VSwVlvLgTDrft_C "/" VALUE 0x80074ECF Val_Wu8 255.0 DFES_OneToOne 0.00 255.0 FORMAT "%5.1" /end CHARACTERISTIC
/begin CHARACTERISTIC DFES_FaultTyp.DFC_VSwVlvOfsLrnJamVlv_C "/" VALUE 0x80074ED0 Val_Wu8 255.0 DFES_OneToOne 0.00 255.0 FORMAT "%5.1" /end CHARACTERISTIC
/begin CHARACTERISTIC DFES_FaultTyp.DFC_VSwVlvShTDrft_C "/" VALUE 0x80074ED1 Val_Wu8 255.0 DFES_OneToOne 0.00 255.0 FORMAT "%5.1" /end CHARACTERISTIC
/begin CHARACTERISTIC Diff_dtrqRmpP.Pos_C "/" VALUE 0x80074ED4 Kw_Ws32 3276799.99847 RmpTrqPrpHigh 0.00 3276799.99847 FORMAT "%13.5" EXTENDED_LIMITS -3276800.00000 3276799.99847 /end CHARACTERISTIC
/begin CHARACTERISTIC Diff_dtrqRmpP.Neg_C "/" VALUE 0x80074ED8 Kw_Ws32 3276799.99847 RmpTrqPrpHigh 0.00 3276799.99847 FORMAT "%13.5" EXTENDED_LIMITS -3276800.00000 3276799.99847 /end CHARACTERISTIC
/begin CHARACTERISTIC Diff_rTrqDfftl_C "Ersatzwert für Differentialübersetzung" VALUE 0x80074EE0 Kw_Ws16 655.3500 TransR -327.6800 327.6700 FORMAT "%8.4" /end CHARACTERISTIC
/begin CHARACTERISTIC Diff_trqPrtErrLim_C "Ersatzwert für Differentialschutzmoment" VALUE 0x80074EDC Kw_Ws16 104856.0 TrqPrp -52428.80 52427.20 FORMAT "%8.2" /end CHARACTERISTIC
/begin MEASUREMENT DINH_stClctFId "" UWORD DFC_OneToOne 1 100 0.00 65535.00 FORMAT "%8.2" ARRAY_SIZE 26 ECU_ADDRESS 0xD00062A4 /end MEASUREMENT
/begin MEASUREMENT DINH_stFId.FId_Unused "" UBYTE DFC_OneToOne 1 100 0.00 255.0000 FORMAT "%8.4" ECU_ADDRESS 0xD0008455 /end MEASUREMENT
/begin MEASUREMENT DINH_stFId.FId_InhibitAlways "" UBYTE DFC_OneToOne 1 100 0.00 255.0000 FORMAT "%8.4" ECU_ADDRESS 0xD0008456 /end MEASUREMENT
/begin MEASUREMENT DINH_stFId.FId_CoordALS "" UBYTE DFC_OneToOne 1 100 0.00 255.0000 FORMAT "%8.4" ECU_ADDRESS 0xD0008457 /end MEASUREMENT
/begin MEASUREMENT DINH_stFId.FId_CoordFBC "" UBYTE DFC_OneToOne 1 100 0.00 255.0000 FORMAT "%8.4" ECU_ADDRESS 0xD0008458 /end MEASUREMENT
/begin MEASUREMENT DINH_stFId.FId_CoordTAA "" UBYTE DFC_OneToOne 1 100 0.00 255.0000 FORMAT "%8.4" ECU_ADDRESS 0xD0008459 /end MEASUREMENT
/begin MEASUREMENT DINH_stFId.FId_CoordZFC "" UBYTE DFC_OneToOne 1 100 0.00 255.0000 FORMAT "%8.4" ECU_ADDRESS 0xD000845A /end MEASUREMENT
/begin MEASUREMENT DINH_stFId.FId_ACCtlTEngErr "" UBYTE DFC_OneToOne 1 100 0.00 255.0000 FORMAT "%8.4" ECU_ADDRESS 0xD000845B /end MEASUREMENT
/begin MEASUREMENT DINH_stFId.FId_ACCtlTGearbxErr "" UBYTE DFC_OneToOne 1 100 0.00 255.0000 FORMAT "%8.4" ECU_ADDRESS 0xD000845C /end MEASUREMENT
/begin MEASUREMENT DINH_stFId.FId_ACCtlVehVErr "" UBYTE DFC_OneToOne 1 100 0.00 255.0000 FORMAT "%8.4" ECU_ADDRESS 0xD000845D /end MEASUREMENT
/begin MEASUREMENT DINH_stFId.FId_ACCtl_AC "" UBYTE DFC_OneToOne 1 100 0.00 255.0000 FORMAT "%8.4" ECU_ADDRESS 0xD000845E /end MEASUREMENT
/begin MEASUREMENT DINH_stFId.FId_ACCtl_Fan "" UBYTE DFC_OneToOne 1 100 0.00 255.0000 FORMAT "%8.4" ECU_ADDRESS 0xD000845F /end MEASUREMENT
/begin MEASUREMENT DINH_stFId.FId_AC_pAC "" UBYTE DFC_OneToOne 1 100 0.00 255.0000 FORMAT "%8.4" ECU_ADDRESS 0xD0008460 /end MEASUREMENT
/begin MEASUREMENT DINH_stFId.FId_AFS "" UBYTE DFC_OneToOne 1 100 0.00 255.0000 FORMAT "%8.4" ECU_ADDRESS 0xD0008461 /end MEASUREMENT
/begin MEASUREMENT DINH_stFId.FId_AFSActrTst "" UBYTE DFC_OneToOne 1 100 0.00 255.0000 FORMAT "%8.4" ECU_ADDRESS 0xD0008462 /end MEASUREMENT
/begin MEASUREMENT DINH_stFId.FId_AFSDrftMaxLim "" UBYTE DFC_OneToOne 1 100 0.00 255.0000 FORMAT "%8.4" ECU_ADDRESS 0xD0008463 /end MEASUREMENT
/begin MEASUREMENT DINH_stFId.FId_AFSFrzAirMs "" UBYTE DFC_OneToOne 1 100 0.00 255.0000 FORMAT "%8.4" ECU_ADDRESS 0xD0008464 /end MEASUREMENT
/begin MEASUREMENT DINH_stFId.FId_AFSPlOffsDrft "" UBYTE DFC_OneToOne 1 100 0.00 255.0000 FORMAT "%8.4" ECU_ADDRESS 0xD0008465 /end MEASUREMENT
/begin MEASUREMENT DINH_stFId.FId_AFSPlSetyDrft "" UBYTE DFC_OneToOne 1 100 0.00 255.0000 FORMAT "%8.4" ECU_ADDRESS 0xD0008466 /end MEASUREMENT
/begin MEASUREMENT DINH_stFId.FId_AFSSRC "" UBYTE DFC_OneToOne 1 100 0.00 255.0000 FORMAT "%8.4" ECU_ADDRESS 0xD0008467 /end MEASUREMENT
/begin MEASUREMENT DINH_stFId.FId_AFSSysErr "" UBYTE DFC_OneToOne 1 100 0.00 255.0000 FORMAT "%8.4" ECU_ADDRESS 0xD0008468 /end MEASUREMENT
/begin MEASUREMENT DINH_stFId.FId_AFSTPer "" UBYTE DFC_OneToOne 1 100 0.00 255.0000 FORMAT "%8.4" ECU_ADDRESS 0xD0008469 /end MEASUREMENT
/begin MEASUREMENT DINH_stFId.FId_APP1FinalDef "" UBYTE DFC_OneToOne 1 100 0.00 255.0000 FORMAT "%8.4" ECU_ADDRESS 0xD000846A /end MEASUREMENT
/begin MEASUREMENT DINH_stFId.FId_APP1ProvDef "" UBYTE DFC_OneToOne 1 100 0.00 255.0000 FORMAT "%8.4" ECU_ADDRESS 0xD000846B /end MEASUREMENT
/begin MEASUREMENT DINH_stFId.FId_APP1SRCHigh "" UBYTE DFC_OneToOne 1 100 0.00 255.0000 FORMAT "%8.4" ECU_ADDRESS 0xD000846C /end MEASUREMENT
/begin MEASUREMENT DINH_stFId.FId_APP1SigPath "" UBYTE DFC_OneToOne 1 100 0.00 255.0000 FORMAT "%8.4" ECU_ADDRESS 0xD000846D /end MEASUREMENT
/begin MEASUREMENT DINH_stFId.FId_APP2FinalDef "" UBYTE DFC_OneToOne 1 100 0.00 255.0000 FORMAT "%8.4" ECU_ADDRESS 0xD000846E /end MEASUREMENT
/begin MEASUREMENT DINH_stFId.FId_APP2ProvDef "" UBYTE DFC_OneToOne 1 100 0.00 255.0000 FORMAT "%8.4" ECU_ADDRESS 0xD000846F /end MEASUREMENT
/begin MEASUREMENT DINH_stFId.FId_APP2SRCHigh "" UBYTE DFC_OneToOne 1 100 0.00 255.0000 FORMAT "%8.4" ECU_ADDRESS 0xD0008470 /end MEASUREMENT
/begin MEASUREMENT DINH_stFId.FId_APP2SigPath "" UBYTE DFC_OneToOne 1 100 0.00 255.0000 FORMAT "%8.4" ECU_ADDRESS 0xD0008471 /end MEASUREMENT
/begin MEASUREMENT DINH_stFId.FId_APPBrkDef "" UBYTE DFC_OneToOne 1 100 0.00 255.0000 FORMAT "%8.4" ECU_ADDRESS 0xD0008472 /end MEASUREMENT
/begin MEASUREMENT DINH_stFId.FId_APPBrkPres "" UBYTE DFC_OneToOne 1 100 0.00 255.0000 FORMAT "%8.4" ECU_ADDRESS 0xD0008473 /end MEASUREMENT
/begin MEASUREMENT DINH_stFId.FId_APPNTP "" UBYTE DFC_OneToOne 1 100 0.00 255.0000 FORMAT "%8.4" ECU_ADDRESS 0xD0008474 /end MEASUREMENT
/begin MEASUREMENT DINH_stFId.FId_APPSyncChk "" UBYTE DFC_OneToOne 1 100 0.00 255.0000 FORMAT "%8.4" ECU_ADDRESS 0xD0008475 /end MEASUREMENT
/begin MEASUREMENT DINH_stFId.FId_APPSyncDef "" UBYTE DFC_OneToOne 1 100 0.00 255.0000 FORMAT "%8.4" ECU_ADDRESS 0xD0008476 /end MEASUREMENT
/begin MEASUREMENT DINH_stFId.FId_APPSyncProvDef "" UBYTE DFC_OneToOne 1 100 0.00 255.0000 FORMAT "%8.4" ECU_ADDRESS 0xD0008477 /end MEASUREMENT
/begin MEASUREMENT DINH_stFId.FId_APPSyncSigProv "" UBYTE DFC_OneToOne 1 100 0.00 255.0000 FORMAT "%8.4" ECU_ADDRESS 0xD0008478 /end MEASUREMENT
/begin MEASUREMENT DINH_stFId.FId_APPVel "" UBYTE DFC_OneToOne 1 100 0.00 255.0000 FORMAT "%8.4" ECU_ADDRESS 0xD0008479 /end MEASUREMENT
/begin MEASUREMENT DINH_stFId.FId_APProvDef "" UBYTE DFC_OneToOne 1 100 0.00 255.0000 FORMAT "%8.4" ECU_ADDRESS 0xD000847A /end MEASUREMENT
/begin MEASUREMENT DINH_stFId.FId_ASDdc "" UBYTE DFC_OneToOne 1 100 0.00 255.0000 FORMAT "%8.4" ECU_ADDRESS 0xD000847B /end MEASUREMENT
/begin MEASUREMENT DINH_stFId.FId_ASModNSC "" UBYTE DFC_OneToOne 1 100 0.00 255.0000 FORMAT "%8.4" ECU_ADDRESS 0xD000847C /end MEASUREMENT
/begin MEASUREMENT DINH_stFId.FId_ASModOxiC "" UBYTE DFC_OneToOne 1 100 0.00 255.0000 FORMAT "%8.4" ECU_ADDRESS 0xD000847D /end MEASUREMENT
/begin MEASUREMENT DINH_stFId.FId_ASModPipe "" UBYTE DFC_OneToOne 1 100 0.00 255.0000 FORMAT "%8.4" ECU_ADDRESS 0xD000847E /end MEASUREMENT
/begin MEASUREMENT DINH_stFId.FId_ASModPipeSlw "" UBYTE DFC_OneToOne 1 100 0.00 255.0000 FORMAT "%8.4" ECU_ADDRESS 0xD000847F /end MEASUREMENT
/begin MEASUREMENT DINH_stFId.FId_ASModPresCalc "" UBYTE DFC_OneToOne 1 100 0.00 255.0000 FORMAT "%8.4" ECU_ADDRESS 0xD0008480 /end MEASUREMENT
/begin MEASUREMENT DINH_stFId.FId_ASModPresEnv "" UBYTE DFC_OneToOne 1 100 0.00 255.0000 FORMAT "%8.4" ECU_ADDRESS 0xD0008481 /end MEASUREMENT
/begin MEASUREMENT DINH_stFId.FId_ASModStrt "" UBYTE DFC_OneToOne 1 100 0.00 255.0000 FORMAT "%8.4" ECU_ADDRESS 0xD0008482 /end MEASUREMENT
/begin MEASUREMENT DINH_stFId.FId_ASModSwtOffEng "" UBYTE DFC_OneToOne 1 100 0.00 255.0000 FORMAT "%8.4" ECU_ADDRESS 0xD0008483 /end MEASUREMENT
/begin MEASUREMENT DINH_stFId.FId_ASModSwtOffIndVol "" UBYTE DFC_OneToOne 1 100 0.00 255.0000 FORMAT "%8.4" ECU_ADDRESS 0xD0008484 /end MEASUREMENT
/begin MEASUREMENT DINH_stFId.FId_ASModTrbn "" UBYTE DFC_OneToOne 1 100 0.00 255.0000 FORMAT "%8.4" ECU_ADDRESS 0xD0008485 /end MEASUREMENT
/begin MEASUREMENT DINH_stFId.FId_AccPedNMaxLim "" UBYTE DFC_OneToOne 1 100 0.00 255.0000 FORMAT "%8.4" ECU_ADDRESS 0xD0008486 /end MEASUREMENT
/begin MEASUREMENT DINH_stFId.FId_AccPedNMinLim "" UBYTE DFC_OneToOne 1 100 0.00 255.0000 FORMAT "%8.4" ECU_ADDRESS 0xD0008487 /end MEASUREMENT
/begin MEASUREMENT DINH_stFId.FId_AccPedNMinLimBrkApp "" UBYTE DFC_OneToOne 1 100 0.00 255.0000 FORMAT "%8.4" ECU_ADDRESS 0xD0008488 /end MEASUREMENT
/begin MEASUREMENT DINH_stFId.FId_AccPedTrqLim "" UBYTE DFC_OneToOne 1 100 0.00 255.0000 FORMAT "%8.4" ECU_ADDRESS 0xD0008489 /end MEASUREMENT
/begin MEASUREMENT DINH_stFId.FId_AdcI_ADC0 "" UBYTE DFC_OneToOne 1 100 0.00 255.0000 FORMAT "%8.4" ECU_ADDRESS 0xD000848A /end MEASUREMENT
/begin MEASUREMENT DINH_stFId.FId_AirCClntPFrzVal "" UBYTE DFC_OneToOne 1 100 0.00 255.0000 FORMAT "%8.4" ECU_ADDRESS 0xD000848B /end MEASUREMENT
/begin MEASUREMENT DINH_stFId.FId_AirCClntPPwmChk "" UBYTE DFC_OneToOne 1 100 0.00 255.0000 FORMAT "%8.4" ECU_ADDRESS 0xD000848C /end MEASUREMENT
/begin MEASUREMENT DINH_stFId.FId_AirCClntPRplVal "" UBYTE DFC_OneToOne 1 100 0.00 255.0000 FORMAT "%8.4" ECU_ADDRESS 0xD000848D /end MEASUREMENT
/begin MEASUREMENT DINH_stFId.FId_AirCSwt "" UBYTE DFC_OneToOne 1 100 0.00 255.0000 FORMAT "%8.4" ECU_ADDRESS 0xD000848E /end MEASUREMENT
/begin MEASUREMENT DINH_stFId.FId_AirCtl "" UBYTE DFC_OneToOne 1 100 0.00 255.0000 FORMAT "%8.4" ECU_ADDRESS 0xD000848F /end MEASUREMENT
/begin MEASUREMENT DINH_stFId.FId_AirCtlBstPresCor "" UBYTE DFC_OneToOne 1 100 0.00 255.0000 FORMAT "%8.4" ECU_ADDRESS 0xD0008490 /end MEASUREMENT
/begin MEASUREMENT DINH_stFId.FId_AirCtlCmpntActv "" UBYTE DFC_OneToOne 1 100 0.00 255.0000 FORMAT "%8.4" ECU_ADDRESS 0xD0008491 /end MEASUREMENT
/begin MEASUREMENT DINH_stFId.FId_AirCtlEGR "" UBYTE DFC_OneToOne 1 100 0.00 255.0000 FORMAT "%8.4" ECU_ADDRESS 0xD0008492 /end MEASUREMENT
/begin MEASUREMENT DINH_stFId.FId_AirCtlGear "" UBYTE DFC_OneToOne 1 100 0.00 255.0000 FORMAT "%8.4" ECU_ADDRESS 0xD0008493 /end MEASUREMENT
/begin MEASUREMENT DINH_stFId.FId_AirCtlGovDvt "" UBYTE DFC_OneToOne 1 100 0.00 255.0000 FORMAT "%8.4" ECU_ADDRESS 0xD0008494 /end MEASUREMENT
/begin MEASUREMENT DINH_stFId.FId_AirCtlPFltEGRRed "" UBYTE DFC_OneToOne 1 100 0.00 255.0000 FORMAT "%8.4" ECU_ADDRESS 0xD0008495 /end MEASUREMENT
/begin MEASUREMENT DINH_stFId.FId_AirCtlStrg "" UBYTE DFC_OneToOne 1 100 0.00 255.0000 FORMAT "%8.4" ECU_ADDRESS 0xD0008496 /end MEASUREMENT
/begin MEASUREMENT DINH_stFId.FId_AirCtlTVA "" UBYTE DFC_OneToOne 1 100 0.00 255.0000 FORMAT "%8.4" ECU_ADDRESS 0xD0008497 /end MEASUREMENT
/begin MEASUREMENT DINH_stFId.FId_BattUFrzVal "" UBYTE DFC_OneToOne 1 100 0.00 255.0000 FORMAT "%8.4" ECU_ADDRESS 0xD0008498 /end MEASUREMENT
/begin MEASUREMENT DINH_stFId.FId_BattUReplVal "" UBYTE DFC_OneToOne 1 100 0.00 255.0000 FORMAT "%8.4" ECU_ADDRESS 0xD0008499 /end MEASUREMENT
/begin MEASUREMENT DINH_stFId.FId_BattUSRC "" UBYTE DFC_OneToOne 1 100 0.00 255.0000 FORMAT "%8.4" ECU_ADDRESS 0xD000849A /end MEASUREMENT
/begin MEASUREMENT DINH_stFId.FId_BrkP "" UBYTE DFC_OneToOne 1 100 0.00 255.0000 FORMAT "%8.4" ECU_ADDRESS 0xD000849B /end MEASUREMENT
/begin MEASUREMENT DINH_stFId.FId_BrkPFrzVal "" UBYTE DFC_OneToOne 1 100 0.00 255.0000 FORMAT "%8.4" ECU_ADDRESS 0xD000849C /end MEASUREMENT
/begin MEASUREMENT DINH_stFId.FId_BrkPReplVal "" UBYTE DFC_OneToOne 1 100 0.00 255.0000 FORMAT "%8.4" ECU_ADDRESS 0xD000849D /end MEASUREMENT
/begin MEASUREMENT DINH_stFId.FId_CEngDsTCANFrzVal "" UBYTE DFC_OneToOne 1 100 0.00 255.0000 FORMAT "%8.4" ECU_ADDRESS 0xD000849E /end MEASUREMENT
/begin MEASUREMENT DINH_stFId.FId_CEngDsTCANRplVal "" UBYTE DFC_OneToOne 1 100 0.00 255.0000 FORMAT "%8.4" ECU_ADDRESS 0xD000849F /end MEASUREMENT
/begin MEASUREMENT DINH_stFId.FId_CEngDsTDynTst "" UBYTE DFC_OneToOne 1 100 0.00 255.0000 FORMAT "%8.4" ECU_ADDRESS 0xD00084A0 /end MEASUREMENT
/begin MEASUREMENT DINH_stFId.FId_CEngDsTFrzVal "" UBYTE DFC_OneToOne 1 100 0.00 255.0000 FORMAT "%8.4" ECU_ADDRESS 0xD00084A1 /end MEASUREMENT
/begin MEASUREMENT DINH_stFId.FId_CEngDsTModel "" UBYTE DFC_OneToOne 1 100 0.00 255.0000 FORMAT "%8.4" ECU_ADDRESS 0xD00084A2 /end MEASUREMENT
/begin MEASUREMENT DINH_stFId.FId_CEngDsTRdClnt "" UBYTE DFC_OneToOne 1 100 0.00 255.0000 FORMAT "%8.4" ECU_ADDRESS 0xD00084A3 /end MEASUREMENT
/begin MEASUREMENT DINH_stFId.FId_CEngDsTRplVal "" UBYTE DFC_OneToOne 1 100 0.00 255.0000 FORMAT "%8.4" ECU_ADDRESS 0xD00084A4 /end MEASUREMENT
/begin MEASUREMENT DINH_stFId.FId_CEngDsTSS "" UBYTE DFC_OneToOne 1 100 0.00 255.0000 FORMAT "%8.4" ECU_ADDRESS 0xD00084A5 /end MEASUREMENT
/begin MEASUREMENT DINH_stFId.FId_CEngUsTFrzVal "" UBYTE DFC_OneToOne 1 100 0.00 255.0000 FORMAT "%8.4" ECU_ADDRESS 0xD00084A6 /end MEASUREMENT
/begin MEASUREMENT DINH_stFId.FId_CEngUsTReplVal "" UBYTE DFC_OneToOne 1 100 0.00 255.0000 FORMAT "%8.4" ECU_ADDRESS 0xD00084A7 /end MEASUREMENT
/begin MEASUREMENT DINH_stFId.FId_CEngUsTSS "" UBYTE DFC_OneToOne 1 100 0.00 255.0000 FORMAT "%8.4" ECU_ADDRESS 0xD00084A8 /end MEASUREMENT
/begin MEASUREMENT DINH_stFId.FId_Clth "" UBYTE DFC_OneToOne 1 100 0.00 255.0000 FORMAT "%8.4" ECU_ADDRESS 0xD00084A9 /end MEASUREMENT
/begin MEASUREMENT DINH_stFId.FId_ClthCAN "" UBYTE DFC_OneToOne 1 100 0.00 255.0000 FORMAT "%8.4" ECU_ADDRESS 0xD00084AA /end MEASUREMENT
/begin MEASUREMENT DINH_stFId.FId_CmbChb "" UBYTE DFC_OneToOne 1 100 0.00 255.0000 FORMAT "%8.4" ECU_ADDRESS 0xD00084AB /end MEASUREMENT
/begin MEASUREMENT DINH_stFId.FId_CoETM "" UBYTE DFC_OneToOne 1 100 0.00 255.0000 FORMAT "%8.4" ECU_ADDRESS 0xD00084AC /end MEASUREMENT
/begin MEASUREMENT DINH_stFId.FId_CoEngNrml2Strt "" UBYTE DFC_OneToOne 1 100 0.00 255.0000 FORMAT "%8.4" ECU_ADDRESS 0xD00084AD /end MEASUREMENT
/begin MEASUREMENT DINH_stFId.FId_CoEngPthClsEGR "" UBYTE DFC_OneToOne 1 100 0.00 255.0000 FORMAT "%8.4" ECU_ADDRESS 0xD00084AE /end MEASUREMENT
/begin MEASUREMENT DINH_stFId.FId_CoEngPthClsThr "" UBYTE DFC_OneToOne 1 100 0.00 255.0000 FORMAT "%8.4" ECU_ADDRESS 0xD00084AF /end MEASUREMENT
/begin MEASUREMENT DINH_stFId.FId_CoEngPthCylOff "" UBYTE DFC_OneToOne 1 100 0.00 255.0000 FORMAT "%8.4" ECU_ADDRESS 0xD00084B0 /end MEASUREMENT
/begin MEASUREMENT DINH_stFId.FId_CoEngPthETZr "" UBYTE DFC_OneToOne 1 100 0.00 255.0000 FORMAT "%8.4" ECU_ADDRESS 0xD00084B1 /end MEASUREMENT
/begin MEASUREMENT DINH_stFId.FId_CoEngPthFlQnt "" UBYTE DFC_OneToOne 1 100 0.00 255.0000 FORMAT "%8.4" ECU_ADDRESS 0xD00084B2 /end MEASUREMENT
/begin MEASUREMENT DINH_stFId.FId_CoEngPthInjVlvOff "" UBYTE DFC_OneToOne 1 100 0.00 255.0000 FORMAT "%8.4" ECU_ADDRESS 0xD00084B3 /end MEASUREMENT
/begin MEASUREMENT DINH_stFId.FId_CoEngPthLpSysOff "" UBYTE DFC_OneToOne 1 100 0.00 255.0000 FORMAT "%8.4" ECU_ADDRESS 0xD00084B4 /end MEASUREMENT
/begin MEASUREMENT DINH_stFId.FId_CoEngPthRPMin "" UBYTE DFC_OneToOne 1 100 0.00 255.0000 FORMAT "%8.4" ECU_ADDRESS 0xD00084B5 /end MEASUREMENT
/begin MEASUREMENT DINH_stFId.FId_CoTS_SwtOff "" UBYTE DFC_OneToOne 1 100 0.00 255.0000 FORMAT "%8.4" ECU_ADDRESS 0xD00084B6 /end MEASUREMENT
/begin MEASUREMENT DINH_stFId.FId_CoVehPrpLimErr "" UBYTE DFC_OneToOne 1 100 0.00 255.0000 FORMAT "%8.4" ECU_ADDRESS 0xD00084B7 /end MEASUREMENT
/begin MEASUREMENT DINH_stFId.FId_ComAPP "" UBYTE DFC_OneToOne 1 100 0.00 255.0000 FORMAT "%8.4" ECU_ADDRESS 0xD00084B8 /end MEASUREMENT
/begin MEASUREMENT DINH_stFId.FId_ComClth "" UBYTE DFC_OneToOne 1 100 0.00 255.0000 FORMAT "%8.4" ECU_ADDRESS 0xD00084B9 /end MEASUREMENT
/begin MEASUREMENT DINH_stFId.FId_ComCoEng "" UBYTE DFC_OneToOne 1 100 0.00 255.0000 FORMAT "%8.4" ECU_ADDRESS 0xD00084BA /end MEASUREMENT
/begin MEASUREMENT DINH_stFId.FId_ComDscAck1 "" UBYTE DFC_OneToOne 1 100 0.00 255.0000 FORMAT "%8.4" ECU_ADDRESS 0xD00084BB /end MEASUREMENT
/begin MEASUREMENT DINH_stFId.FId_ComDscAck2 "" UBYTE DFC_OneToOne 1 100 0.00 255.0000 FORMAT "%8.4" ECU_ADDRESS 0xD00084BC /end MEASUREMENT
/begin MEASUREMENT DINH_stFId.FId_ComDscAck3 "" UBYTE DFC_OneToOne 1 100 0.00 255.0000 FORMAT "%8.4" ECU_ADDRESS 0xD00084BD /end MEASUREMENT
/begin MEASUREMENT DINH_stFId.FId_ComDscTrqIntv "" UBYTE DFC_OneToOne 1 100 0.00 255.0000 FORMAT "%8.4" ECU_ADDRESS 0xD00084BE /end MEASUREMENT
/begin MEASUREMENT DINH_stFId.FId_ComEngDem "" UBYTE DFC_OneToOne 1 100 0.00 255.0000 FORMAT "%8.4" ECU_ADDRESS 0xD00084BF /end MEASUREMENT
/begin MEASUREMENT DINH_stFId.FId_ComGbxAck1 "" UBYTE DFC_OneToOne 1 100 0.00 255.0000 FORMAT "%8.4" ECU_ADDRESS 0xD00084C0 /end MEASUREMENT
/begin MEASUREMENT DINH_stFId.FId_ComGbxAck2 "" UBYTE DFC_OneToOne 1 100 0.00 255.0000 FORMAT "%8.4" ECU_ADDRESS 0xD00084C1 /end MEASUREMENT
/begin MEASUREMENT DINH_stFId.FId_ComGbxAck3 "" UBYTE DFC_OneToOne 1 100 0.00 255.0000 FORMAT "%8.4" ECU_ADDRESS 0xD00084C2 /end MEASUREMENT
/begin MEASUREMENT DINH_stFId.FId_ComGbxTrqIntv "" UBYTE DFC_OneToOne 1 100 0.00 255.0000 FORMAT "%8.4" ECU_ADDRESS 0xD00084C3 /end MEASUREMENT
/begin MEASUREMENT DINH_stFId.FId_ComInjDu1 "" UBYTE DFC_OneToOne 1 100 0.00 255.0000 FORMAT "%8.4" ECU_ADDRESS 0xD00084C4 /end MEASUREMENT
/begin MEASUREMENT DINH_stFId.FId_ComInjDu2 "" UBYTE DFC_OneToOne 1 100 0.00 255.0000 FORMAT "%8.4" ECU_ADDRESS 0xD00084C5 /end MEASUREMENT
/begin MEASUREMENT DINH_stFId.FId_ComInjVlv "" UBYTE DFC_OneToOne 1 100 0.00 255.0000 FORMAT "%8.4" ECU_ADDRESS 0xD00084C6 /end MEASUREMENT
/begin MEASUREMENT DINH_stFId.FId_ComMSA "" UBYTE DFC_OneToOne 1 100 0.00 255.0000 FORMAT "%8.4" ECU_ADDRESS 0xD00084C7 /end MEASUREMENT
/begin MEASUREMENT DINH_stFId.FId_ComStBrkPedal "" UBYTE DFC_OneToOne 1 100 0.00 255.0000 FORMAT "%8.4" ECU_ADDRESS 0xD00084C8 /end MEASUREMENT
/begin MEASUREMENT DINH_stFId.FId_ComStTrq "" UBYTE DFC_OneToOne 1 100 0.00 255.0000 FORMAT "%8.4" ECU_ADDRESS 0xD00084C9 /end MEASUREMENT
/begin MEASUREMENT DINH_stFId.FId_ComnEng "" UBYTE DFC_OneToOne 1 100 0.00 255.0000 FORMAT "%8.4" ECU_ADDRESS 0xD00084CA /end MEASUREMENT
/begin MEASUREMENT DINH_stFId.FId_ComnSetPLo "" UBYTE DFC_OneToOne 1 100 0.00 255.0000 FORMAT "%8.4" ECU_ADDRESS 0xD00084CB /end MEASUREMENT
/begin MEASUREMENT DINH_stFId.FId_CompEnv "" UBYTE DFC_OneToOne 1 100 0.00 255.0000 FORMAT "%8.4" ECU_ADDRESS 0xD00084CC /end MEASUREMENT
/begin MEASUREMENT DINH_stFId.FId_ComrWaterVlv "" UBYTE DFC_OneToOne 1 100 0.00 255.0000 FORMAT "%8.4" ECU_ADDRESS 0xD00084CD /end MEASUREMENT
/begin MEASUREMENT DINH_stFId.FId_ConvLdNTrbnCan "" UBYTE DFC_OneToOne 1 100 0.00 255.0000 FORMAT "%8.4" ECU_ADDRESS 0xD00084CE /end MEASUREMENT
/begin MEASUREMENT DINH_stFId.FId_ConvLdOilTemp "" UBYTE DFC_OneToOne 1 100 0.00 255.0000 FORMAT "%8.4" ECU_ADDRESS 0xD00084CF /end MEASUREMENT
/begin MEASUREMENT DINH_stFId.FId_ConvLdTrqLdCan "" UBYTE DFC_OneToOne 1 100 0.00 255.0000 FORMAT "%8.4" ECU_ADDRESS 0xD00084D0 /end MEASUREMENT
/begin MEASUREMENT DINH_stFId.FId_ConvLdVel "" UBYTE DFC_OneToOne 1 100 0.00 255.0000 FORMAT "%8.4" ECU_ADDRESS 0xD00084D1 /end MEASUREMENT
/begin MEASUREMENT DINH_stFId.FId_CoordEGT "" UBYTE DFC_OneToOne 1 100 0.00 255.0000 FORMAT "%8.4" ECU_ADDRESS 0xD00084D2 /end MEASUREMENT
/begin MEASUREMENT DINH_stFId.FId_CrCtl_irrev "" UBYTE DFC_OneToOne 1 100 0.00 255.0000 FORMAT "%8.4" ECU_ADDRESS 0xD00084D3 /end MEASUREMENT
/begin MEASUREMENT DINH_stFId.FId_CrCtl_rev "" UBYTE DFC_OneToOne 1 100 0.00 255.0000 FORMAT "%8.4" ECU_ADDRESS 0xD00084D4 /end MEASUREMENT
/begin MEASUREMENT DINH_stFId.FId_CtTSwtOff "" UBYTE DFC_OneToOne 1 100 0.00 255.0000 FORMAT "%8.4" ECU_ADDRESS 0xD00084D5 /end MEASUREMENT
/begin MEASUREMENT DINH_stFId.FId_Cy100Dev1 "" UBYTE DFC_OneToOne 1 100 0.00 255.0000 FORMAT "%8.4" ECU_ADDRESS 0xD00084D6 /end MEASUREMENT
/begin MEASUREMENT DINH_stFId.FId_DCSRmpShOff "" UBYTE DFC_OneToOne 1 100 0.00 255.0000 FORMAT "%8.4" ECU_ADDRESS 0xD00084D7 /end MEASUREMENT
/begin MEASUREMENT DINH_stFId.FId_DCSShOff "" UBYTE DFC_OneToOne 1 100 0.00 255.0000 FORMAT "%8.4" ECU_ADDRESS 0xD00084D8 /end MEASUREMENT
/begin MEASUREMENT DINH_stFId.FId_DIOnumChip1Cj945 "" UBYTE DFC_OneToOne 1 100 0.00 255.0000 FORMAT "%8.4" ECU_ADDRESS 0xD00084D9 /end MEASUREMENT
/begin MEASUREMENT DINH_stFId.FId_DIUMPRGenDenom1 "" UBYTE DFC_OneToOne 1 100 0.00 255.0000 FORMAT "%8.4" ECU_ADDRESS 0xD00084DA /end MEASUREMENT
/begin MEASUREMENT DINH_stFId.FId_DIUMPRGenDenom2 "" UBYTE DFC_OneToOne 1 100 0.00 255.0000 FORMAT "%8.4" ECU_ADDRESS 0xD00084DB /end MEASUREMENT
/begin MEASUREMENT DINH_stFId.FId_DIUMPRGenDenom3 "" UBYTE DFC_OneToOne 1 100 0.00 255.0000 FORMAT "%8.4" ECU_ADDRESS 0xD00084DC /end MEASUREMENT
/begin MEASUREMENT DINH_stFId.FId_DIUMPRIgn "" UBYTE DFC_OneToOne 1 100 0.00 255.0000 FORMAT "%8.4" ECU_ADDRESS 0xD00084DD /end MEASUREMENT
/begin MEASUREMENT DINH_stFId.FId_DSMWarmUpCycle "" UBYTE DFC_OneToOne 1 100 0.00 255.0000 FORMAT "%8.4" ECU_ADDRESS 0xD00084DE /end MEASUREMENT
/begin MEASUREMENT DINH_stFId.FId_DevLibActrPrt "" UBYTE DFC_OneToOne 1 100 0.00 255.0000 FORMAT "%8.4" ECU_ADDRESS 0xD00084DF /end MEASUREMENT
/begin MEASUREMENT DINH_stFId.FId_DewDetHtgDel "" UBYTE DFC_OneToOne 1 100 0.00 255.0000 FORMAT "%8.4" ECU_ADDRESS 0xD00084E0 /end MEASUREMENT
/begin MEASUREMENT DINH_stFId.FId_ECBVlvFrzVal "" UBYTE DFC_OneToOne 1 100 0.00 255.0000 FORMAT "%8.4" ECU_ADDRESS 0xD00084E1 /end MEASUREMENT
/begin MEASUREMENT DINH_stFId.FId_ECBVlvReplVal "" UBYTE DFC_OneToOne 1 100 0.00 255.0000 FORMAT "%8.4" ECU_ADDRESS 0xD00084E2 /end MEASUREMENT
/begin MEASUREMENT DINH_stFId.FId_ECBVlvSS "" UBYTE DFC_OneToOne 1 100 0.00 255.0000 FORMAT "%8.4" ECU_ADDRESS 0xD00084E3 /end MEASUREMENT
/begin MEASUREMENT DINH_stFId.FId_EGRClg "" UBYTE DFC_OneToOne 1 100 0.00 255.0000 FORMAT "%8.4" ECU_ADDRESS 0xD00084E4 /end MEASUREMENT
/begin MEASUREMENT DINH_stFId.FId_EGRVlvActr "" UBYTE DFC_OneToOne 1 100 0.00 255.0000 FORMAT "%8.4" ECU_ADDRESS 0xD00084E5 /end MEASUREMENT
/begin MEASUREMENT DINH_stFId.FId_EGRVlvFrzVal "" UBYTE DFC_OneToOne 1 100 0.00 255.0000 FORMAT "%8.4" ECU_ADDRESS 0xD00084E6 /end MEASUREMENT
/begin MEASUREMENT DINH_stFId.FId_EGRVlvGovOn "" UBYTE DFC_OneToOne 1 100 0.00 255.0000 FORMAT "%8.4" ECU_ADDRESS 0xD00084E7 /end MEASUREMENT
/begin MEASUREMENT DINH_stFId.FId_EGRVlvOfsLrnInhib "" UBYTE DFC_OneToOne 1 100 0.00 255.0000 FORMAT "%8.4" ECU_ADDRESS 0xD00084E8 /end MEASUREMENT
/begin MEASUREMENT DINH_stFId.FId_EGRVlvReplVal "" UBYTE DFC_OneToOne 1 100 0.00 255.0000 FORMAT "%8.4" ECU_ADDRESS 0xD00084E9 /end MEASUREMENT
/begin MEASUREMENT DINH_stFId.FId_EGRVlvSSpMon "" UBYTE DFC_OneToOne 1 100 0.00 255.0000 FORMAT "%8.4" ECU_ADDRESS 0xD00084EA /end MEASUREMENT
/begin MEASUREMENT DINH_stFId.FId_EGTRgnLck "" UBYTE DFC_OneToOne 1 100 0.00 255.0000 FORMAT "%8.4" ECU_ADDRESS 0xD00084EB /end MEASUREMENT
/begin MEASUREMENT DINH_stFId.FId_EMCtl "" UBYTE DFC_OneToOne 1 100 0.00 255.0000 FORMAT "%8.4" ECU_ADDRESS 0xD00084EC /end MEASUREMENT
/begin MEASUREMENT DINH_stFId.FId_ETClbCorActv "" UBYTE DFC_OneToOne 1 100 0.00 255.0000 FORMAT "%8.4" ECU_ADDRESS 0xD00084ED /end MEASUREMENT
/begin MEASUREMENT DINH_stFId.FId_ETCtlAirCtl "" UBYTE DFC_OneToOne 1 100 0.00 255.0000 FORMAT "%8.4" ECU_ADDRESS 0xD00084EE /end MEASUREMENT
/begin MEASUREMENT DINH_stFId.FId_ETCtlInr "" UBYTE DFC_OneToOne 1 100 0.00 255.0000 FORMAT "%8.4" ECU_ADDRESS 0xD00084EF /end MEASUREMENT
/begin MEASUREMENT DINH_stFId.FId_ETCtlOutr "" UBYTE DFC_OneToOne 1 100 0.00 255.0000 FORMAT "%8.4" ECU_ADDRESS 0xD00084F0 /end MEASUREMENT
/begin MEASUREMENT DINH_stFId.FId_EngDemPFltErr "" UBYTE DFC_OneToOne 1 100 0.00 255.0000 FORMAT "%8.4" ECU_ADDRESS 0xD00084F1 /end MEASUREMENT
/begin MEASUREMENT DINH_stFId.FId_EngDemTrqLimErr "" UBYTE DFC_OneToOne 1 100 0.00 255.0000 FORMAT "%8.4" ECU_ADDRESS 0xD00084F2 /end MEASUREMENT
/begin MEASUREMENT DINH_stFId.FId_EngDemTrqLimErr1 "" UBYTE DFC_OneToOne 1 100 0.00 255.0000 FORMAT "%8.4" ECU_ADDRESS 0xD00084F3 /end MEASUREMENT
/begin MEASUREMENT DINH_stFId.FId_EngDemTrqLimErr2 "" UBYTE DFC_OneToOne 1 100 0.00 255.0000 FORMAT "%8.4" ECU_ADDRESS 0xD00084F4 /end MEASUREMENT
/begin MEASUREMENT DINH_stFId.FId_EngDemTrqLimErr3 "" UBYTE DFC_OneToOne 1 100 0.00 255.0000 FORMAT "%8.4" ECU_ADDRESS 0xD00084F5 /end MEASUREMENT
/begin MEASUREMENT DINH_stFId.FId_EngDemTrqLimErr4 "" UBYTE DFC_OneToOne 1 100 0.00 255.0000 FORMAT "%8.4" ECU_ADDRESS 0xD00084F6 /end MEASUREMENT
/begin MEASUREMENT DINH_stFId.FId_EngPrtEnvP "" UBYTE DFC_OneToOne 1 100 0.00 255.0000 FORMAT "%8.4" ECU_ADDRESS 0xD00084F7 /end MEASUREMENT
/begin MEASUREMENT DINH_stFId.FId_EngPrtNLimErr "" UBYTE DFC_OneToOne 1 100 0.00 255.0000 FORMAT "%8.4" ECU_ADDRESS 0xD00084F8 /end MEASUREMENT
/begin MEASUREMENT DINH_stFId.FId_EnvPCANFrzVal "" UBYTE DFC_OneToOne 1 100 0.00 255.0000 FORMAT "%8.4" ECU_ADDRESS 0xD00084F9 /end MEASUREMENT
/begin MEASUREMENT DINH_stFId.FId_EnvPCANRplVal "" UBYTE DFC_OneToOne 1 100 0.00 255.0000 FORMAT "%8.4" ECU_ADDRESS 0xD00084FA /end MEASUREMENT
/begin MEASUREMENT DINH_stFId.FId_EnvPFrzVal "" UBYTE DFC_OneToOne 1 100 0.00 255.0000 FORMAT "%8.4" ECU_ADDRESS 0xD00084FB /end MEASUREMENT
/begin MEASUREMENT DINH_stFId.FId_EnvPModel "" UBYTE DFC_OneToOne 1 100 0.00 255.0000 FORMAT "%8.4" ECU_ADDRESS 0xD00084FC /end MEASUREMENT
/begin MEASUREMENT DINH_stFId.FId_EnvPRplVal "" UBYTE DFC_OneToOne 1 100 0.00 255.0000 FORMAT "%8.4" ECU_ADDRESS 0xD00084FD /end MEASUREMENT
/begin MEASUREMENT DINH_stFId.FId_EnvPSS "" UBYTE DFC_OneToOne 1 100 0.00 255.0000 FORMAT "%8.4" ECU_ADDRESS 0xD00084FE /end MEASUREMENT
/begin MEASUREMENT DINH_stFId.FId_EnvTCANFrzVal "" UBYTE DFC_OneToOne 1 100 0.00 255.0000 FORMAT "%8.4" ECU_ADDRESS 0xD00084FF /end MEASUREMENT
/begin MEASUREMENT DINH_stFId.FId_EnvTCANRplVal "" UBYTE DFC_OneToOne 1 100 0.00 255.0000 FORMAT "%8.4" ECU_ADDRESS 0xD0008500 /end MEASUREMENT
/begin MEASUREMENT DINH_stFId.FId_EnvTFrzVal "" UBYTE DFC_OneToOne 1 100 0.00 255.0000 FORMAT "%8.4" ECU_ADDRESS 0xD0008501 /end MEASUREMENT
/begin MEASUREMENT DINH_stFId.FId_EnvTModel "" UBYTE DFC_OneToOne 1 100 0.00 255.0000 FORMAT "%8.4" ECU_ADDRESS 0xD0008502 /end MEASUREMENT
/begin MEASUREMENT DINH_stFId.FId_EnvTRplVal "" UBYTE DFC_OneToOne 1 100 0.00 255.0000 FORMAT "%8.4" ECU_ADDRESS 0xD0008503 /end MEASUREMENT
/begin MEASUREMENT DINH_stFId.FId_EnvTSS "" UBYTE DFC_OneToOne 1 100 0.00 255.0000 FORMAT "%8.4" ECU_ADDRESS 0xD0008504 /end MEASUREMENT
/begin MEASUREMENT DINH_stFId.FId_EpmCaSDiag "" UBYTE DFC_OneToOne 1 100 0.00 255.0000 FORMAT "%8.4" ECU_ADDRESS 0xD0008505 /end MEASUREMENT
/begin MEASUREMENT DINH_stFId.FId_EpmCaSOfsDiag_I1 "" UBYTE DFC_OneToOne 1 100 0.00 255.0000 FORMAT "%8.4" ECU_ADDRESS 0xD0008506 /end MEASUREMENT
/begin MEASUREMENT DINH_stFId.FId_EpmCaSOfsDiag_I2 "" UBYTE DFC_OneToOne 1 100 0.00 255.0000 FORMAT "%8.4" ECU_ADDRESS 0xD0008507 /end MEASUREMENT
/begin MEASUREMENT DINH_stFId.FId_EpmCaSOfsDiag_O1 "" UBYTE DFC_OneToOne 1 100 0.00 255.0000 FORMAT "%8.4" ECU_ADDRESS 0xD0008508 /end MEASUREMENT
/begin MEASUREMENT DINH_stFId.FId_EpmCaSOfsDiag_O2 "" UBYTE DFC_OneToOne 1 100 0.00 255.0000 FORMAT "%8.4" ECU_ADDRESS 0xD0008509 /end MEASUREMENT
/begin MEASUREMENT DINH_stFId.FId_EpmCaSOfsDiag_SglCaSI1 "" UBYTE DFC_OneToOne 1 100 0.00 255.0000 FORMAT "%8.4" ECU_ADDRESS 0xD000850A /end MEASUREMENT
/begin MEASUREMENT DINH_stFId.FId_EpmCaSSegCor "" UBYTE DFC_OneToOne 1 100 0.00 255.0000 FORMAT "%8.4" ECU_ADDRESS 0xD000850B /end MEASUREMENT
/begin MEASUREMENT DINH_stFId.FId_EpmCrSDiag "" UBYTE DFC_OneToOne 1 100 0.00 255.0000 FORMAT "%8.4" ECU_ADDRESS 0xD000850C /end MEASUREMENT
/begin MEASUREMENT DINH_stFId.FId_EpmOpMode_InjLock "" UBYTE DFC_OneToOne 1 100 0.00 255.0000 FORMAT "%8.4" ECU_ADDRESS 0xD000850D /end MEASUREMENT
/begin MEASUREMENT DINH_stFId.FId_FBC "" UBYTE DFC_OneToOne 1 100 0.00 255.0000 FORMAT "%8.4" ECU_ADDRESS 0xD000850E /end MEASUREMENT
/begin MEASUREMENT DINH_stFId.FId_FanCtl "" UBYTE DFC_OneToOne 1 100 0.00 255.0000 FORMAT "%8.4" ECU_ADDRESS 0xD000850F /end MEASUREMENT
/begin MEASUREMENT DINH_stFId.FId_FanCtlCor "" UBYTE DFC_OneToOne 1 100 0.00 255.0000 FORMAT "%8.4" ECU_ADDRESS 0xD0008510 /end MEASUREMENT
/begin MEASUREMENT DINH_stFId.FId_FanCtlCor2 "" UBYTE DFC_OneToOne 1 100 0.00 255.0000 FORMAT "%8.4" ECU_ADDRESS 0xD0008511 /end MEASUREMENT
/begin MEASUREMENT DINH_stFId.FId_FanTraOil "" UBYTE DFC_OneToOne 1 100 0.00 255.0000 FORMAT "%8.4" ECU_ADDRESS 0xD0008512 /end MEASUREMENT
/begin MEASUREMENT DINH_stFId.FId_FansVelCor "" UBYTE DFC_OneToOne 1 100 0.00 255.0000 FORMAT "%8.4" ECU_ADDRESS 0xD0008513 /end MEASUREMENT
/begin MEASUREMENT DINH_stFId.FId_FlSysDens "" UBYTE DFC_OneToOne 1 100 0.00 255.0000 FORMAT "%8.4" ECU_ADDRESS 0xD0008514 /end MEASUREMENT
/begin MEASUREMENT DINH_stFId.FId_FrzPrtTrqDfftl "" UBYTE DFC_OneToOne 1 100 0.00 255.0000 FORMAT "%8.4" ECU_ADDRESS 0xD0008515 /end MEASUREMENT
/begin MEASUREMENT DINH_stFId.FId_FrzValPAirFltDs "" UBYTE DFC_OneToOne 1 100 0.00 255.0000 FORMAT "%8.4" ECU_ADDRESS 0xD0008516 /end MEASUREMENT
/begin MEASUREMENT DINH_stFId.FId_FrzValPPFltUs "" UBYTE DFC_OneToOne 1 100 0.00 255.0000 FORMAT "%8.4" ECU_ADDRESS 0xD0008517 /end MEASUREMENT
/begin MEASUREMENT DINH_stFId.FId_FrzValTOxiCatUs "" UBYTE DFC_OneToOne 1 100 0.00 255.0000 FORMAT "%8.4" ECU_ADDRESS 0xD0008518 /end MEASUREMENT
/begin MEASUREMENT DINH_stFId.FId_FrzValTPFltUs "" UBYTE DFC_OneToOne 1 100 0.00 255.0000 FORMAT "%8.4" ECU_ADDRESS 0xD0008519 /end MEASUREMENT
/begin MEASUREMENT DINH_stFId.FId_FuelTCTS "" UBYTE DFC_OneToOne 1 100 0.00 255.0000 FORMAT "%8.4" ECU_ADDRESS 0xD000851A /end MEASUREMENT
/begin MEASUREMENT DINH_stFId.FId_FuelTFlSys "" UBYTE DFC_OneToOne 1 100 0.00 255.0000 FORMAT "%8.4" ECU_ADDRESS 0xD000851B /end MEASUREMENT
/begin MEASUREMENT DINH_stFId.FId_FuelTFrzVal "" UBYTE DFC_OneToOne 1 100 0.00 255.0000 FORMAT "%8.4" ECU_ADDRESS 0xD000851C /end MEASUREMENT
/begin MEASUREMENT DINH_stFId.FId_FuelTReplVal "" UBYTE DFC_OneToOne 1 100 0.00 255.0000 FORMAT "%8.4" ECU_ADDRESS 0xD000851D /end MEASUREMENT
/begin MEASUREMENT DINH_stFId.FId_GbxNPos "" UBYTE DFC_OneToOne 1 100 0.00 255.0000 FORMAT "%8.4" ECU_ADDRESS 0xD000851E /end MEASUREMENT
/begin MEASUREMENT DINH_stFId.FId_GbxNPosPWM "" UBYTE DFC_OneToOne 1 100 0.00 255.0000 FORMAT "%8.4" ECU_ADDRESS 0xD000851F /end MEASUREMENT
/begin MEASUREMENT DINH_stFId.FId_GlbDaLSumvXPtd "" UBYTE DFC_OneToOne 1 100 0.00 255.0000 FORMAT "%8.4" ECU_ADDRESS 0xD0008520 /end MEASUREMENT
/begin MEASUREMENT DINH_stFId.FId_GlwCtl1 "" UBYTE DFC_OneToOne 1 100 0.00 255.0000 FORMAT "%8.4" ECU_ADDRESS 0xD0008521 /end MEASUREMENT
/begin MEASUREMENT DINH_stFId.FId_HLSDemDfrstI "" UBYTE DFC_OneToOne 1 100 0.00 255.0000 FORMAT "%8.4" ECU_ADDRESS 0xD0008522 /end MEASUREMENT
/begin MEASUREMENT DINH_stFId.FId_HLSDemSetPLoDrvAwy "" UBYTE DFC_OneToOne 1 100 0.00 255.0000 FORMAT "%8.4" ECU_ADDRESS 0xD0008523 /end MEASUREMENT
/begin MEASUREMENT DINH_stFId.FId_HLSDemUndrBrk "" UBYTE DFC_OneToOne 1 100 0.00 255.0000 FORMAT "%8.4" ECU_ADDRESS 0xD0008524 /end MEASUREMENT
/begin MEASUREMENT DINH_stFId.FId_ISCnTrbnMod "" UBYTE DFC_OneToOne 1 100 0.00 255.0000 FORMAT "%8.4" ECU_ADDRESS 0xD0008525 /end MEASUREMENT
/begin MEASUREMENT DINH_stFId.FId_ISCvBd "" UBYTE DFC_OneToOne 1 100 0.00 255.0000 FORMAT "%8.4" ECU_ADDRESS 0xD0008526 /end MEASUREMENT
/begin MEASUREMENT DINH_stFId.FId_IVPSplyDCDCOff "" UBYTE DFC_OneToOne 1 100 0.00 255.0000 FORMAT "%8.4" ECU_ADDRESS 0xD0008527 /end MEASUREMENT
/begin MEASUREMENT DINH_stFId.FId_InhibitNever "" UBYTE DFC_OneToOne 1 100 0.00 255.0000 FORMAT "%8.4" ECU_ADDRESS 0xD0008528 /end MEASUREMENT
/begin MEASUREMENT DINH_stFId.FId_InjCrvCoErr "" UBYTE DFC_OneToOne 1 100 0.00 255.0000 FORMAT "%8.4" ECU_ADDRESS 0xD0008529 /end MEASUREMENT
/begin MEASUREMENT DINH_stFId.FId_InjCrvDisblPoI1 "" UBYTE DFC_OneToOne 1 100 0.00 255.0000 FORMAT "%8.4" ECU_ADDRESS 0xD000852A /end MEASUREMENT
/begin MEASUREMENT DINH_stFId.FId_InjCrvDisblPoI2 "" UBYTE DFC_OneToOne 1 100 0.00 255.0000 FORMAT "%8.4" ECU_ADDRESS 0xD000852B /end MEASUREMENT
/begin MEASUREMENT DINH_stFId.FId_InjSys_qLimErr "" UBYTE DFC_OneToOne 1 100 0.00 255.0000 FORMAT "%8.4" ECU_ADDRESS 0xD000852C /end MEASUREMENT
/begin MEASUREMENT DINH_stFId.FId_InjSysqFuelT "" UBYTE DFC_OneToOne 1 100 0.00 255.0000 FORMAT "%8.4" ECU_ADDRESS 0xD000852D /end MEASUREMENT
/begin MEASUREMENT DINH_stFId.FId_InjUnStrtPlsBlk "" UBYTE DFC_OneToOne 1 100 0.00 255.0000 FORMAT "%8.4" ECU_ADDRESS 0xD000852E /end MEASUREMENT
/begin MEASUREMENT DINH_stFId.FId_InjVlvPresMin "" UBYTE DFC_OneToOne 1 100 0.00 255.0000 FORMAT "%8.4" ECU_ADDRESS 0xD000852F /end MEASUREMENT
/begin MEASUREMENT DINH_stFId.FId_LSUAllChecks0 "" UBYTE DFC_OneToOne 1 100 0.00 255.0000 FORMAT "%8.4" ECU_ADDRESS 0xD0008530 /end MEASUREMENT
/begin MEASUREMENT DINH_stFId.FId_LSUAllChecks1 "" UBYTE DFC_OneToOne 1 100 0.00 255.0000 FORMAT "%8.4" ECU_ADDRESS 0xD0008531 /end MEASUREMENT
/begin MEASUREMENT DINH_stFId.FId_LSUClbSched "" UBYTE DFC_OneToOne 1 100 0.00 255.0000 FORMAT "%8.4" ECU_ADDRESS 0xD0008532 /end MEASUREMENT
/begin MEASUREMENT DINH_stFId.FId_LSUCmpChk0 "" UBYTE DFC_OneToOne 1 100 0.00 255.0000 FORMAT "%8.4" ECU_ADDRESS 0xD0008533 /end MEASUREMENT
/begin MEASUREMENT DINH_stFId.FId_LSUCmpChk1 "" UBYTE DFC_OneToOne 1 100 0.00 255.0000 FORMAT "%8.4" ECU_ADDRESS 0xD0008534 /end MEASUREMENT
/begin MEASUREMENT DINH_stFId.FId_LSUCtl0 "" UBYTE DFC_OneToOne 1 100 0.00 255.0000 FORMAT "%8.4" ECU_ADDRESS 0xD0008535 /end MEASUREMENT
/begin MEASUREMENT DINH_stFId.FId_LSUCtl1 "" UBYTE DFC_OneToOne 1 100 0.00 255.0000 FORMAT "%8.4" ECU_ADDRESS 0xD0008536 /end MEASUREMENT
/begin MEASUREMENT DINH_stFId.FId_LSUMon0 "" UBYTE DFC_OneToOne 1 100 0.00 255.0000 FORMAT "%8.4" ECU_ADDRESS 0xD0008537 /end MEASUREMENT
/begin MEASUREMENT DINH_stFId.FId_LSUMon1 "" UBYTE DFC_OneToOne 1 100 0.00 255.0000 FORMAT "%8.4" ECU_ADDRESS 0xD0008538 /end MEASUREMENT
/begin MEASUREMENT DINH_stFId.FId_LSUO20 "" UBYTE DFC_OneToOne 1 100 0.00 255.0000 FORMAT "%8.4" ECU_ADDRESS 0xD0008539 /end MEASUREMENT
/begin MEASUREMENT DINH_stFId.FId_LSUO21 "" UBYTE DFC_OneToOne 1 100 0.00 255.0000 FORMAT "%8.4" ECU_ADDRESS 0xD000853A /end MEASUREMENT
/begin MEASUREMENT DINH_stFId.FId_LSURi0 "" UBYTE DFC_OneToOne 1 100 0.00 255.0000 FORMAT "%8.4" ECU_ADDRESS 0xD000853B /end MEASUREMENT
/begin MEASUREMENT DINH_stFId.FId_LSURi1 "" UBYTE DFC_OneToOne 1 100 0.00 255.0000 FORMAT "%8.4" ECU_ADDRESS 0xD000853C /end MEASUREMENT
/begin MEASUREMENT DINH_stFId.FId_LSUactiv0 "" UBYTE DFC_OneToOne 1 100 0.00 255.0000 FORMAT "%8.4" ECU_ADDRESS 0xD000853D /end MEASUREMENT
/begin MEASUREMENT DINH_stFId.FId_LSUactiv1 "" UBYTE DFC_OneToOne 1 100 0.00 255.0000 FORMAT "%8.4" ECU_ADDRESS 0xD000853E /end MEASUREMENT
/begin MEASUREMENT DINH_stFId.FId_LSUlsu0 "" UBYTE DFC_OneToOne 1 100 0.00 255.0000 FORMAT "%8.4" ECU_ADDRESS 0xD000853F /end MEASUREMENT
/begin MEASUREMENT DINH_stFId.FId_LSUlsu1 "" UBYTE DFC_OneToOne 1 100 0.00 255.0000 FORMAT "%8.4" ECU_ADDRESS 0xD0008540 /end MEASUREMENT
/begin MEASUREMENT DINH_stFId.FId_MeUnFrzI "" UBYTE DFC_OneToOne 1 100 0.00 255.0000 FORMAT "%8.4" ECU_ADDRESS 0xD0008541 /end MEASUREMENT
/begin MEASUREMENT DINH_stFId.FId_MeUnRot "" UBYTE DFC_OneToOne 1 100 0.00 255.0000 FORMAT "%8.4" ECU_ADDRESS 0xD0008542 /end MEASUREMENT
/begin MEASUREMENT DINH_stFId.FId_NplPAirFltDs "" UBYTE DFC_OneToOne 1 100 0.00 255.0000 FORMAT "%8.4" ECU_ADDRESS 0xD0008543 /end MEASUREMENT
/begin MEASUREMENT DINH_stFId.FId_NplTOxiCatUs "" UBYTE DFC_OneToOne 1 100 0.00 255.0000 FORMAT "%8.4" ECU_ADDRESS 0xD0008544 /end MEASUREMENT
/begin MEASUREMENT DINH_stFId.FId_NplTPFltUs "" UBYTE DFC_OneToOne 1 100 0.00 255.0000 FORMAT "%8.4" ECU_ADDRESS 0xD0008545 /end MEASUREMENT
/begin MEASUREMENT DINH_stFId.FId_OilTCANFrzVal "" UBYTE DFC_OneToOne 1 100 0.00 255.0000 FORMAT "%8.4" ECU_ADDRESS 0xD0008546 /end MEASUREMENT
/begin MEASUREMENT DINH_stFId.FId_OilTCANRplVal "" UBYTE DFC_OneToOne 1 100 0.00 255.0000 FORMAT "%8.4" ECU_ADDRESS 0xD0008547 /end MEASUREMENT
/begin MEASUREMENT DINH_stFId.FId_OilTFrzVal "" UBYTE DFC_OneToOne 1 100 0.00 255.0000 FORMAT "%8.4" ECU_ADDRESS 0xD0008548 /end MEASUREMENT
/begin MEASUREMENT DINH_stFId.FId_OilTModel "" UBYTE DFC_OneToOne 1 100 0.00 255.0000 FORMAT "%8.4" ECU_ADDRESS 0xD0008549 /end MEASUREMENT
/begin MEASUREMENT DINH_stFId.FId_OilTNpl "" UBYTE DFC_OneToOne 1 100 0.00 255.0000 FORMAT "%8.4" ECU_ADDRESS 0xD000854A /end MEASUREMENT
/begin MEASUREMENT DINH_stFId.FId_OilTRplVal "" UBYTE DFC_OneToOne 1 100 0.00 255.0000 FORMAT "%8.4" ECU_ADDRESS 0xD000854B /end MEASUREMENT
/begin MEASUREMENT DINH_stFId.FId_OilTSS "" UBYTE DFC_OneToOne 1 100 0.00 255.0000 FORMAT "%8.4" ECU_ADDRESS 0xD000854C /end MEASUREMENT
/begin MEASUREMENT DINH_stFId.FId_PAirFltDsCANFrzVal "" UBYTE DFC_OneToOne 1 100 0.00 255.0000 FORMAT "%8.4" ECU_ADDRESS 0xD000854D /end MEASUREMENT
/begin MEASUREMENT DINH_stFId.FId_PAirFltDsCANRplVal "" UBYTE DFC_OneToOne 1 100 0.00 255.0000 FORMAT "%8.4" ECU_ADDRESS 0xD000854E /end MEASUREMENT
/begin MEASUREMENT DINH_stFId.FId_PCACDsCANFrzVal "" UBYTE DFC_OneToOne 1 100 0.00 255.0000 FORMAT "%8.4" ECU_ADDRESS 0xD000854F /end MEASUREMENT
/begin MEASUREMENT DINH_stFId.FId_PCACDsCANRplVal "" UBYTE DFC_OneToOne 1 100 0.00 255.0000 FORMAT "%8.4" ECU_ADDRESS 0xD0008550 /end MEASUREMENT
/begin MEASUREMENT DINH_stFId.FId_PCACDsEnvPPls "" UBYTE DFC_OneToOne 1 100 0.00 255.0000 FORMAT "%8.4" ECU_ADDRESS 0xD0008551 /end MEASUREMENT
/begin MEASUREMENT DINH_stFId.FId_PCACDsFrzVal "" UBYTE DFC_OneToOne 1 100 0.00 255.0000 FORMAT "%8.4" ECU_ADDRESS 0xD0008552 /end MEASUREMENT
/begin MEASUREMENT DINH_stFId.FId_PCACDsModel "" UBYTE DFC_OneToOne 1 100 0.00 255.0000 FORMAT "%8.4" ECU_ADDRESS 0xD0008553 /end MEASUREMENT
/begin MEASUREMENT DINH_stFId.FId_PCACDsRplVal "" UBYTE DFC_OneToOne 1 100 0.00 255.0000 FORMAT "%8.4" ECU_ADDRESS 0xD0008554 /end MEASUREMENT
/begin MEASUREMENT DINH_stFId.FId_PCACDsSS "" UBYTE DFC_OneToOne 1 100 0.00 255.0000 FORMAT "%8.4" ECU_ADDRESS 0xD0008555 /end MEASUREMENT
/begin MEASUREMENT DINH_stFId.FId_PCR "" UBYTE DFC_OneToOne 1 100 0.00 255.0000 FORMAT "%8.4" ECU_ADDRESS 0xD0008556 /end MEASUREMENT
/begin MEASUREMENT DINH_stFId.FId_PCRCByVlvOff "" UBYTE DFC_OneToOne 1 100 0.00 255.0000 FORMAT "%8.4" ECU_ADDRESS 0xD0008557 /end MEASUREMENT
/begin MEASUREMENT DINH_stFId.FId_PCRCmpntActv "" UBYTE DFC_OneToOne 1 100 0.00 255.0000 FORMAT "%8.4" ECU_ADDRESS 0xD0008558 /end MEASUREMENT
/begin MEASUREMENT DINH_stFId.FId_PCRCmpntActvLP "" UBYTE DFC_OneToOne 1 100 0.00 255.0000 FORMAT "%8.4" ECU_ADDRESS 0xD0008559 /end MEASUREMENT
/begin MEASUREMENT DINH_stFId.FId_PCRExtnLimActr "" UBYTE DFC_OneToOne 1 100 0.00 255.0000 FORMAT "%8.4" ECU_ADDRESS 0xD000855A /end MEASUREMENT
/begin MEASUREMENT DINH_stFId.FId_PCRGovDvt "" UBYTE DFC_OneToOne 1 100 0.00 255.0000 FORMAT "%8.4" ECU_ADDRESS 0xD000855B /end MEASUREMENT
/begin MEASUREMENT DINH_stFId.FId_PCRGovDvtLP "" UBYTE DFC_OneToOne 1 100 0.00 255.0000 FORMAT "%8.4" ECU_ADDRESS 0xD000855C /end MEASUREMENT
/begin MEASUREMENT DINH_stFId.FId_PCRLP "" UBYTE DFC_OneToOne 1 100 0.00 255.0000 FORMAT "%8.4" ECU_ADDRESS 0xD000855D /end MEASUREMENT
/begin MEASUREMENT DINH_stFId.FId_PCROfsRls "" UBYTE DFC_OneToOne 1 100 0.00 255.0000 FORMAT "%8.4" ECU_ADDRESS 0xD000855E /end MEASUREMENT
/begin MEASUREMENT DINH_stFId.FId_PCRPFltPresCor "" UBYTE DFC_OneToOne 1 100 0.00 255.0000 FORMAT "%8.4" ECU_ADDRESS 0xD000855F /end MEASUREMENT
/begin MEASUREMENT DINH_stFId.FId_PCVFrzI "" UBYTE DFC_OneToOne 1 100 0.00 255.0000 FORMAT "%8.4" ECU_ADDRESS 0xD0008560 /end MEASUREMENT
/begin MEASUREMENT DINH_stFId.FId_PCVPwrStgTst "" UBYTE DFC_OneToOne 1 100 0.00 255.0000 FORMAT "%8.4" ECU_ADDRESS 0xD0008561 /end MEASUREMENT
/begin MEASUREMENT DINH_stFId.FId_PFltAirSysFail "" UBYTE DFC_OneToOne 1 100 0.00 255.0000 FORMAT "%8.4" ECU_ADDRESS 0xD0008562 /end MEASUREMENT
/begin MEASUREMENT DINH_stFId.FId_PFltChar "" UBYTE DFC_OneToOne 1 100 0.00 255.0000 FORMAT "%8.4" ECU_ADDRESS 0xD0008563 /end MEASUREMENT
/begin MEASUREMENT DINH_stFId.FId_PFltDstr "" UBYTE DFC_OneToOne 1 100 0.00 255.0000 FORMAT "%8.4" ECU_ADDRESS 0xD0008564 /end MEASUREMENT
/begin MEASUREMENT DINH_stFId.FId_PFltLckRgnErr "" UBYTE DFC_OneToOne 1 100 0.00 255.0000 FORMAT "%8.4" ECU_ADDRESS 0xD0008565 /end MEASUREMENT
/begin MEASUREMENT DINH_stFId.FId_PFltLckRgnFl "" UBYTE DFC_OneToOne 1 100 0.00 255.0000 FORMAT "%8.4" ECU_ADDRESS 0xD0008566 /end MEASUREMENT
/begin MEASUREMENT DINH_stFId.FId_PFltLdSimRgnThr "" UBYTE DFC_OneToOne 1 100 0.00 255.0000 FORMAT "%8.4" ECU_ADDRESS 0xD0008567 /end MEASUREMENT
/begin MEASUREMENT DINH_stFId.FId_PFltPOpBrk "" UBYTE DFC_OneToOne 1 100 0.00 255.0000 FORMAT "%8.4" ECU_ADDRESS 0xD0008568 /end MEASUREMENT
/begin MEASUREMENT DINH_stFId.FId_PFltPOpClth "" UBYTE DFC_OneToOne 1 100 0.00 255.0000 FORMAT "%8.4" ECU_ADDRESS 0xD0008569 /end MEASUREMENT
/begin MEASUREMENT DINH_stFId.FId_PFltPOpGearDet "" UBYTE DFC_OneToOne 1 100 0.00 255.0000 FORMAT "%8.4" ECU_ADDRESS 0xD000856A /end MEASUREMENT
/begin MEASUREMENT DINH_stFId.FId_PFltPOpSpdVeh "" UBYTE DFC_OneToOne 1 100 0.00 255.0000 FORMAT "%8.4" ECU_ADDRESS 0xD000856B /end MEASUREMENT
/begin MEASUREMENT DINH_stFId.FId_PFltPOpTempAir "" UBYTE DFC_OneToOne 1 100 0.00 255.0000 FORMAT "%8.4" ECU_ADDRESS 0xD000856C /end MEASUREMENT
/begin MEASUREMENT DINH_stFId.FId_PFltPOpTempClnt "" UBYTE DFC_OneToOne 1 100 0.00 255.0000 FORMAT "%8.4" ECU_ADDRESS 0xD000856D /end MEASUREMENT
/begin MEASUREMENT DINH_stFId.FId_PFltPOpVltgBatt "" UBYTE DFC_OneToOne 1 100 0.00 255.0000 FORMAT "%8.4" ECU_ADDRESS 0xD000856E /end MEASUREMENT
/begin MEASUREMENT DINH_stFId.FId_PFltPoI1Fail "" UBYTE DFC_OneToOne 1 100 0.00 255.0000 FORMAT "%8.4" ECU_ADDRESS 0xD000856F /end MEASUREMENT
/begin MEASUREMENT DINH_stFId.FId_PFltPoI2Fail "" UBYTE DFC_OneToOne 1 100 0.00 255.0000 FORMAT "%8.4" ECU_ADDRESS 0xD0008570 /end MEASUREMENT
/begin MEASUREMENT DINH_stFId.FId_PFltRgnChngPar "" UBYTE DFC_OneToOne 1 100 0.00 255.0000 FORMAT "%8.4" ECU_ADDRESS 0xD0008571 /end MEASUREMENT
/begin MEASUREMENT DINH_stFId.FId_PFltSimOn "" UBYTE DFC_OneToOne 1 100 0.00 255.0000 FORMAT "%8.4" ECU_ADDRESS 0xD0008572 /end MEASUREMENT
/begin MEASUREMENT DINH_stFId.FId_PFltSrvRgnRlsEng "" UBYTE DFC_OneToOne 1 100 0.00 255.0000 FORMAT "%8.4" ECU_ADDRESS 0xD0008573 /end MEASUREMENT
/begin MEASUREMENT DINH_stFId.FId_PFltSrvRgnRlsPFlt "" UBYTE DFC_OneToOne 1 100 0.00 255.0000 FORMAT "%8.4" ECU_ADDRESS 0xD0008574 /end MEASUREMENT
/begin MEASUREMENT DINH_stFId.FId_PFltSysFail "" UBYTE DFC_OneToOne 1 100 0.00 255.0000 FORMAT "%8.4" ECU_ADDRESS 0xD0008575 /end MEASUREMENT
/begin MEASUREMENT DINH_stFId.FId_PTGripDebPtd "" UBYTE DFC_OneToOne 1 100 0.00 255.0000 FORMAT "%8.4" ECU_ADDRESS 0xD0008576 /end MEASUREMENT
/begin MEASUREMENT DINH_stFId.FId_PTTrqRatCANPtd "" UBYTE DFC_OneToOne 1 100 0.00 255.0000 FORMAT "%8.4" ECU_ADDRESS 0xD0008577 /end MEASUREMENT
/begin MEASUREMENT DINH_stFId.FId_PresSensFrzPPFltUs "" UBYTE DFC_OneToOne 1 100 0.00 255.0000 FORMAT "%8.4" ECU_ADDRESS 0xD0008578 /end MEASUREMENT
/begin MEASUREMENT DINH_stFId.FId_QWCCTSDef "" UBYTE DFC_OneToOne 1 100 0.00 255.0000 FORMAT "%8.4" ECU_ADDRESS 0xD0008579 /end MEASUREMENT
/begin MEASUREMENT DINH_stFId.FId_QWCFTSDef "" UBYTE DFC_OneToOne 1 100 0.00 255.0000 FORMAT "%8.4" ECU_ADDRESS 0xD000857A /end MEASUREMENT
/begin MEASUREMENT DINH_stFId.FId_QWCOff "" UBYTE DFC_OneToOne 1 100 0.00 255.0000 FORMAT "%8.4" ECU_ADDRESS 0xD000857B /end MEASUREMENT
/begin MEASUREMENT DINH_stFId.FId_RadShtCTS "" UBYTE DFC_OneToOne 1 100 0.00 255.0000 FORMAT "%8.4" ECU_ADDRESS 0xD000857C /end MEASUREMENT
/begin MEASUREMENT DINH_stFId.FId_RadShtEGS "" UBYTE DFC_OneToOne 1 100 0.00 255.0000 FORMAT "%8.4" ECU_ADDRESS 0xD000857D /end MEASUREMENT
/begin MEASUREMENT DINH_stFId.FId_RailCPCtlMeUnMode "" UBYTE DFC_OneToOne 1 100 0.00 255.0000 FORMAT "%8.4" ECU_ADDRESS 0xD000857E /end MEASUREMENT
/begin MEASUREMENT DINH_stFId.FId_RailCPCtlPCVMode "" UBYTE DFC_OneToOne 1 100 0.00 255.0000 FORMAT "%8.4" ECU_ADDRESS 0xD000857F /end MEASUREMENT
/begin MEASUREMENT DINH_stFId.FId_RailCtlMode "" UBYTE DFC_OneToOne 1 100 0.00 255.0000 FORMAT "%8.4" ECU_ADDRESS 0xD0008580 /end MEASUREMENT
/begin MEASUREMENT DINH_stFId.FId_RailFuelTErr "" UBYTE DFC_OneToOne 1 100 0.00 255.0000 FORMAT "%8.4" ECU_ADDRESS 0xD0008581 /end MEASUREMENT
/begin MEASUREMENT DINH_stFId.FId_RailMeUn0Blk "" UBYTE DFC_OneToOne 1 100 0.00 255.0000 FORMAT "%8.4" ECU_ADDRESS 0xD0008582 /end MEASUREMENT
/begin MEASUREMENT DINH_stFId.FId_RailMeUn0Rls "" UBYTE DFC_OneToOne 1 100 0.00 255.0000 FORMAT "%8.4" ECU_ADDRESS 0xD0008583 /end MEASUREMENT
/begin MEASUREMENT DINH_stFId.FId_RailMeUn1Blk "" UBYTE DFC_OneToOne 1 100 0.00 255.0000 FORMAT "%8.4" ECU_ADDRESS 0xD0008584 /end MEASUREMENT
/begin MEASUREMENT DINH_stFId.FId_RailMeUn1Rls "" UBYTE DFC_OneToOne 1 100 0.00 255.0000 FORMAT "%8.4" ECU_ADDRESS 0xD0008585 /end MEASUREMENT
/begin MEASUREMENT DINH_stFId.FId_RailMeUn2Blk "" UBYTE DFC_OneToOne 1 100 0.00 255.0000 FORMAT "%8.4" ECU_ADDRESS 0xD0008586 /end MEASUREMENT
/begin MEASUREMENT DINH_stFId.FId_RailMeUn2Rls "" UBYTE DFC_OneToOne 1 100 0.00 255.0000 FORMAT "%8.4" ECU_ADDRESS 0xD0008587 /end MEASUREMENT
/begin MEASUREMENT DINH_stFId.FId_RailMeUn3Blk "" UBYTE DFC_OneToOne 1 100 0.00 255.0000 FORMAT "%8.4" ECU_ADDRESS 0xD0008588 /end MEASUREMENT
/begin MEASUREMENT DINH_stFId.FId_RailMeUn3Rls "" UBYTE DFC_OneToOne 1 100 0.00 255.0000 FORMAT "%8.4" ECU_ADDRESS 0xD0008589 /end MEASUREMENT
/begin MEASUREMENT DINH_stFId.FId_RailMeUn4Blk "" UBYTE DFC_OneToOne 1 100 0.00 255.0000 FORMAT "%8.4" ECU_ADDRESS 0xD000858A /end MEASUREMENT
/begin MEASUREMENT DINH_stFId.FId_RailMeUn4Rls "" UBYTE DFC_OneToOne 1 100 0.00 255.0000 FORMAT "%8.4" ECU_ADDRESS 0xD000858B /end MEASUREMENT
/begin MEASUREMENT DINH_stFId.FId_RailMeUnCtlMode "" UBYTE DFC_OneToOne 1 100 0.00 255.0000 FORMAT "%8.4" ECU_ADDRESS 0xD000858C /end MEASUREMENT
/begin MEASUREMENT DINH_stFId.FId_RailPCV0Blk "" UBYTE DFC_OneToOne 1 100 0.00 255.0000 FORMAT "%8.4" ECU_ADDRESS 0xD000858D /end MEASUREMENT
/begin MEASUREMENT DINH_stFId.FId_RailPCV0Rls "" UBYTE DFC_OneToOne 1 100 0.00 255.0000 FORMAT "%8.4" ECU_ADDRESS 0xD000858E /end MEASUREMENT
/begin MEASUREMENT DINH_stFId.FId_RailPCV1Blk "" UBYTE DFC_OneToOne 1 100 0.00 255.0000 FORMAT "%8.4" ECU_ADDRESS 0xD000858F /end MEASUREMENT
/begin MEASUREMENT DINH_stFId.FId_RailPCV1Rls "" UBYTE DFC_OneToOne 1 100 0.00 255.0000 FORMAT "%8.4" ECU_ADDRESS 0xD0008590 /end MEASUREMENT
/begin MEASUREMENT DINH_stFId.FId_RailPCV2Blk "" UBYTE DFC_OneToOne 1 100 0.00 255.0000 FORMAT "%8.4" ECU_ADDRESS 0xD0008591 /end MEASUREMENT
/begin MEASUREMENT DINH_stFId.FId_RailPCV2Rls "" UBYTE DFC_OneToOne 1 100 0.00 255.0000 FORMAT "%8.4" ECU_ADDRESS 0xD0008592 /end MEASUREMENT
/begin MEASUREMENT DINH_stFId.FId_RailPCV3Blk "" UBYTE DFC_OneToOne 1 100 0.00 255.0000 FORMAT "%8.4" ECU_ADDRESS 0xD0008593 /end MEASUREMENT
/begin MEASUREMENT DINH_stFId.FId_RailPCV3Rls "" UBYTE DFC_OneToOne 1 100 0.00 255.0000 FORMAT "%8.4" ECU_ADDRESS 0xD0008594 /end MEASUREMENT
/begin MEASUREMENT DINH_stFId.FId_RailPCV4Blk "" UBYTE DFC_OneToOne 1 100 0.00 255.0000 FORMAT "%8.4" ECU_ADDRESS 0xD0008595 /end MEASUREMENT
/begin MEASUREMENT DINH_stFId.FId_RailPCV4Rls "" UBYTE DFC_OneToOne 1 100 0.00 255.0000 FORMAT "%8.4" ECU_ADDRESS 0xD0008596 /end MEASUREMENT
/begin MEASUREMENT DINH_stFId.FId_RailPCVCtlMode "" UBYTE DFC_OneToOne 1 100 0.00 255.0000 FORMAT "%8.4" ECU_ADDRESS 0xD0008597 /end MEASUREMENT
/begin MEASUREMENT DINH_stFId.FId_RailPFrzVal "" UBYTE DFC_OneToOne 1 100 0.00 255.0000 FORMAT "%8.4" ECU_ADDRESS 0xD0008598 /end MEASUREMENT
/begin MEASUREMENT DINH_stFId.FId_RailPMonStrt "" UBYTE DFC_OneToOne 1 100 0.00 255.0000 FORMAT "%8.4" ECU_ADDRESS 0xD0008599 /end MEASUREMENT
/begin MEASUREMENT DINH_stFId.FId_RailPSS "" UBYTE DFC_OneToOne 1 100 0.00 255.0000 FORMAT "%8.4" ECU_ADDRESS 0xD000859A /end MEASUREMENT
/begin MEASUREMENT DINH_stFId.FId_RailPSubsVal "" UBYTE DFC_OneToOne 1 100 0.00 255.0000 FORMAT "%8.4" ECU_ADDRESS 0xD000859B /end MEASUREMENT
/begin MEASUREMENT DINH_stFId.FId_RailSetPointLim "" UBYTE DFC_OneToOne 1 100 0.00 255.0000 FORMAT "%8.4" ECU_ADDRESS 0xD000859C /end MEASUREMENT
/begin MEASUREMENT DINH_stFId.FId_RailSetPointRed "" UBYTE DFC_OneToOne 1 100 0.00 255.0000 FORMAT "%8.4" ECU_ADDRESS 0xD000859D /end MEASUREMENT
/begin MEASUREMENT DINH_stFId.FId_ReplValTPFltUs "" UBYTE DFC_OneToOne 1 100 0.00 255.0000 FORMAT "%8.4" ECU_ADDRESS 0xD000859E /end MEASUREMENT
/begin MEASUREMENT DINH_stFId.FId_RplValPAirFltDs "" UBYTE DFC_OneToOne 1 100 0.00 255.0000 FORMAT "%8.4" ECU_ADDRESS 0xD000859F /end MEASUREMENT
/begin MEASUREMENT DINH_stFId.FId_RplValPPFltUs "" UBYTE DFC_OneToOne 1 100 0.00 255.0000 FORMAT "%8.4" ECU_ADDRESS 0xD00085A0 /end MEASUREMENT
/begin MEASUREMENT DINH_stFId.FId_RplValTOxiCatUs "" UBYTE DFC_OneToOne 1 100 0.00 255.0000 FORMAT "%8.4" ECU_ADDRESS 0xD00085A1 /end MEASUREMENT
/begin MEASUREMENT DINH_stFId.FId_SRCFlwRstn "" UBYTE DFC_OneToOne 1 100 0.00 255.0000 FORMAT "%8.4" ECU_ADDRESS 0xD00085A2 /end MEASUREMENT
/begin MEASUREMENT DINH_stFId.FId_SSEStart "" UBYTE DFC_OneToOne 1 100 0.00 255.0000 FORMAT "%8.4" ECU_ADDRESS 0xD00085A3 /end MEASUREMENT
/begin MEASUREMENT DINH_stFId.FId_SSEStartAST "" UBYTE DFC_OneToOne 1 100 0.00 255.0000 FORMAT "%8.4" ECU_ADDRESS 0xD00085A4 /end MEASUREMENT
/begin MEASUREMENT DINH_stFId.FId_SSEStartMTClPressed10 "" UBYTE DFC_OneToOne 1 100 0.00 255.0000 FORMAT "%8.4" ECU_ADDRESS 0xD00085A5 /end MEASUREMENT
/begin MEASUREMENT DINH_stFId.FId_SSEStartMTClPressed90 "" UBYTE DFC_OneToOne 1 100 0.00 255.0000 FORMAT "%8.4" ECU_ADDRESS 0xD00085A6 /end MEASUREMENT
/begin MEASUREMENT DINH_stFId.FId_SSEStop "" UBYTE DFC_OneToOne 1 100 0.00 255.0000 FORMAT "%8.4" ECU_ADDRESS 0xD00085A7 /end MEASUREMENT
/begin MEASUREMENT DINH_stFId.FId_SSEStopAST "" UBYTE DFC_OneToOne 1 100 0.00 255.0000 FORMAT "%8.4" ECU_ADDRESS 0xD00085A8 /end MEASUREMENT
/begin MEASUREMENT DINH_stFId.FId_SSEStopMT "" UBYTE DFC_OneToOne 1 100 0.00 255.0000 FORMAT "%8.4" ECU_ADDRESS 0xD00085A9 /end MEASUREMENT
/begin MEASUREMENT DINH_stFId.FId_SSPAirFltDs "" UBYTE DFC_OneToOne 1 100 0.00 255.0000 FORMAT "%8.4" ECU_ADDRESS 0xD00085AA /end MEASUREMENT
/begin MEASUREMENT DINH_stFId.FId_SSTOxiCatUs "" UBYTE DFC_OneToOne 1 100 0.00 255.0000 FORMAT "%8.4" ECU_ADDRESS 0xD00085AB /end MEASUREMENT
/begin MEASUREMENT DINH_stFId.FId_SSTPFltUs "" UBYTE DFC_OneToOne 1 100 0.00 255.0000 FORMAT "%8.4" ECU_ADDRESS 0xD00085AC /end MEASUREMENT
/begin MEASUREMENT DINH_stFId.FId_SensAdapTPFltUs "" UBYTE DFC_OneToOne 1 100 0.00 255.0000 FORMAT "%8.4" ECU_ADDRESS 0xD00085AD /end MEASUREMENT
/begin MEASUREMENT DINH_stFId.FId_StAPmp "" UBYTE DFC_OneToOne 1 100 0.00 255.0000 FORMAT "%8.4" ECU_ADDRESS 0xD00085AE /end MEASUREMENT
/begin MEASUREMENT DINH_stFId.FId_StDa "" UBYTE DFC_OneToOne 1 100 0.00 255.0000 FORMAT "%8.4" ECU_ADDRESS 0xD00085AF /end MEASUREMENT
/begin MEASUREMENT DINH_stFId.FId_SubsValPrtTrqDfftl "" UBYTE DFC_OneToOne 1 100 0.00 255.0000 FORMAT "%8.4" ECU_ADDRESS 0xD00085B0 /end MEASUREMENT
/begin MEASUREMENT DINH_stFId.FId_SubsValRatTrqDfftl "" UBYTE DFC_OneToOne 1 100 0.00 255.0000 FORMAT "%8.4" ECU_ADDRESS 0xD00085B1 /end MEASUREMENT
/begin MEASUREMENT DINH_stFId.FId_T15 "" UBYTE DFC_OneToOne 1 100 0.00 255.0000 FORMAT "%8.4" ECU_ADDRESS 0xD00085B2 /end MEASUREMENT
/begin MEASUREMENT DINH_stFId.FId_T50Sig "" UBYTE DFC_OneToOne 1 100 0.00 255.0000 FORMAT "%8.4" ECU_ADDRESS 0xD00085B3 /end MEASUREMENT
/begin MEASUREMENT DINH_stFId.FId_TAFSFrzVal "" UBYTE DFC_OneToOne 1 100 0.00 255.0000 FORMAT "%8.4" ECU_ADDRESS 0xD00085B4 /end MEASUREMENT
/begin MEASUREMENT DINH_stFId.FId_TAFSReplVal "" UBYTE DFC_OneToOne 1 100 0.00 255.0000 FORMAT "%8.4" ECU_ADDRESS 0xD00085B5 /end MEASUREMENT
/begin MEASUREMENT DINH_stFId.FId_TAFSSRC "" UBYTE DFC_OneToOne 1 100 0.00 255.0000 FORMAT "%8.4" ECU_ADDRESS 0xD00085B6 /end MEASUREMENT
/begin MEASUREMENT DINH_stFId.FId_TCACDsCANFrzVal "" UBYTE DFC_OneToOne 1 100 0.00 255.0000 FORMAT "%8.4" ECU_ADDRESS 0xD00085B7 /end MEASUREMENT
/begin MEASUREMENT DINH_stFId.FId_TCACDsCANRplVal "" UBYTE DFC_OneToOne 1 100 0.00 255.0000 FORMAT "%8.4" ECU_ADDRESS 0xD00085B8 /end MEASUREMENT
/begin MEASUREMENT DINH_stFId.FId_TCACDsFrzVal "" UBYTE DFC_OneToOne 1 100 0.00 255.0000 FORMAT "%8.4" ECU_ADDRESS 0xD00085B9 /end MEASUREMENT
/begin MEASUREMENT DINH_stFId.FId_TCACDsModel "" UBYTE DFC_OneToOne 1 100 0.00 255.0000 FORMAT "%8.4" ECU_ADDRESS 0xD00085BA /end MEASUREMENT
/begin MEASUREMENT DINH_stFId.FId_TCACDsRplVal "" UBYTE DFC_OneToOne 1 100 0.00 255.0000 FORMAT "%8.4" ECU_ADDRESS 0xD00085BB /end MEASUREMENT
/begin MEASUREMENT DINH_stFId.FId_TCACDsSS "" UBYTE DFC_OneToOne 1 100 0.00 255.0000 FORMAT "%8.4" ECU_ADDRESS 0xD00085BC /end MEASUREMENT
/begin MEASUREMENT DINH_stFId.FId_TCPrtChrgPmpCtl "" UBYTE DFC_OneToOne 1 100 0.00 255.0000 FORMAT "%8.4" ECU_ADDRESS 0xD00085BD /end MEASUREMENT
/begin MEASUREMENT DINH_stFId.FId_TCPrtChrgPmpGov "" UBYTE DFC_OneToOne 1 100 0.00 255.0000 FORMAT "%8.4" ECU_ADDRESS 0xD00085BE /end MEASUREMENT
/begin MEASUREMENT DINH_stFId.FId_TCPrtChrgPmpHLSDem "" UBYTE DFC_OneToOne 1 100 0.00 255.0000 FORMAT "%8.4" ECU_ADDRESS 0xD00085BF /end MEASUREMENT
/begin MEASUREMENT DINH_stFId.FId_TCPrt_ChrgPmpDet "" UBYTE DFC_OneToOne 1 100 0.00 255.0000 FORMAT "%8.4" ECU_ADDRESS 0xD00085C0 /end MEASUREMENT
/begin MEASUREMENT DINH_stFId.FId_TCSRmpShOff "" UBYTE DFC_OneToOne 1 100 0.00 255.0000 FORMAT "%8.4" ECU_ADDRESS 0xD00085C1 /end MEASUREMENT
/begin MEASUREMENT DINH_stFId.FId_TCSShOff "" UBYTE DFC_OneToOne 1 100 0.00 255.0000 FORMAT "%8.4" ECU_ADDRESS 0xD00085C2 /end MEASUREMENT
/begin MEASUREMENT DINH_stFId.FId_TECUFrzVal "" UBYTE DFC_OneToOne 1 100 0.00 255.0000 FORMAT "%8.4" ECU_ADDRESS 0xD00085C3 /end MEASUREMENT
/begin MEASUREMENT DINH_stFId.FId_TECURplVal "" UBYTE DFC_OneToOne 1 100 0.00 255.0000 FORMAT "%8.4" ECU_ADDRESS 0xD00085C4 /end MEASUREMENT
/begin MEASUREMENT DINH_stFId.FId_TOxiCatUs "" UBYTE DFC_OneToOne 1 100 0.00 255.0000 FORMAT "%8.4" ECU_ADDRESS 0xD00085C5 /end MEASUREMENT
/begin MEASUREMENT DINH_stFId.FId_TempSensFrzPPFltUs "" UBYTE DFC_OneToOne 1 100 0.00 255.0000 FORMAT "%8.4" ECU_ADDRESS 0xD00085C6 /end MEASUREMENT
/begin MEASUREMENT DINH_stFId.FId_ThrVlvFrzVal "" UBYTE DFC_OneToOne 1 100 0.00 255.0000 FORMAT "%8.4" ECU_ADDRESS 0xD00085C7 /end MEASUREMENT
/begin MEASUREMENT DINH_stFId.FId_ThrVlvRplVal "" UBYTE DFC_OneToOne 1 100 0.00 255.0000 FORMAT "%8.4" ECU_ADDRESS 0xD00085C8 /end MEASUREMENT
/begin MEASUREMENT DINH_stFId.FId_ThrVlvSS "" UBYTE DFC_OneToOne 1 100 0.00 255.0000 FORMAT "%8.4" ECU_ADDRESS 0xD00085C9 /end MEASUREMENT
/begin MEASUREMENT DINH_stFId.FId_TraAddAirCANPtd "" UBYTE DFC_OneToOne 1 100 0.00 255.0000 FORMAT "%8.4" ECU_ADDRESS 0xD00085CA /end MEASUREMENT
/begin MEASUREMENT DINH_stFId.FId_TraAddClntCANPtd "" UBYTE DFC_OneToOne 1 100 0.00 255.0000 FORMAT "%8.4" ECU_ADDRESS 0xD00085CB /end MEASUREMENT
/begin MEASUREMENT DINH_stFId.FId_TraDrvAway "" UBYTE DFC_OneToOne 1 100 0.00 255.0000 FORMAT "%8.4" ECU_ADDRESS 0xD00085CC /end MEASUREMENT
/begin MEASUREMENT DINH_stFId.FId_TraDrvAwayInactiv "" UBYTE DFC_OneToOne 1 100 0.00 255.0000 FORMAT "%8.4" ECU_ADDRESS 0xD00085CD /end MEASUREMENT
/begin MEASUREMENT DINH_stFId.FId_TraGearInfoDet "" UBYTE DFC_OneToOne 1 100 0.00 255.0000 FORMAT "%8.4" ECU_ADDRESS 0xD00085CE /end MEASUREMENT
/begin MEASUREMENT DINH_stFId.FId_TraGearInfoInfoCan "" UBYTE DFC_OneToOne 1 100 0.00 255.0000 FORMAT "%8.4" ECU_ADDRESS 0xD00085CF /end MEASUREMENT
/begin MEASUREMENT DINH_stFId.FId_TraGearInfoLevPos "" UBYTE DFC_OneToOne 1 100 0.00 255.0000 FORMAT "%8.4" ECU_ADDRESS 0xD00085D0 /end MEASUREMENT
/begin MEASUREMENT DINH_stFId.FId_TraGearInfoLoRng "" UBYTE DFC_OneToOne 1 100 0.00 255.0000 FORMAT "%8.4" ECU_ADDRESS 0xD00085D1 /end MEASUREMENT
/begin MEASUREMENT DINH_stFId.FId_TraGearInfoRTra "" UBYTE DFC_OneToOne 1 100 0.00 255.0000 FORMAT "%8.4" ECU_ADDRESS 0xD00085D2 /end MEASUREMENT
/begin MEASUREMENT DINH_stFId.FId_TraGearInfoRevGear "" UBYTE DFC_OneToOne 1 100 0.00 255.0000 FORMAT "%8.4" ECU_ADDRESS 0xD00085D3 /end MEASUREMENT
/begin MEASUREMENT DINH_stFId.FId_TraGripDeb "" UBYTE DFC_OneToOne 1 100 0.00 255.0000 FORMAT "%8.4" ECU_ADDRESS 0xD00085D4 /end MEASUREMENT
/begin MEASUREMENT DINH_stFId.FId_TraOilTemp "" UBYTE DFC_OneToOne 1 100 0.00 255.0000 FORMAT "%8.4" ECU_ADDRESS 0xD00085D5 /end MEASUREMENT
/begin MEASUREMENT DINH_stFId.FId_TraPrtGearCANPtd "" UBYTE DFC_OneToOne 1 100 0.00 255.0000 FORMAT "%8.4" ECU_ADDRESS 0xD00085D6 /end MEASUREMENT
/begin MEASUREMENT DINH_stFId.FId_TraRtnIntfcASTIntv "" UBYTE DFC_OneToOne 1 100 0.00 255.0000 FORMAT "%8.4" ECU_ADDRESS 0xD00085D7 /end MEASUREMENT
/begin MEASUREMENT DINH_stFId.FId_TraRtnIntfcIdlSetP "" UBYTE DFC_OneToOne 1 100 0.00 255.0000 FORMAT "%8.4" ECU_ADDRESS 0xD00085D8 /end MEASUREMENT
/begin MEASUREMENT DINH_stFId.FId_TraTrqLimErr "" UBYTE DFC_OneToOne 1 100 0.00 255.0000 FORMAT "%8.4" ECU_ADDRESS 0xD00085D9 /end MEASUREMENT
/begin MEASUREMENT DINH_stFId.FId_TraTrqLos "" UBYTE DFC_OneToOne 1 100 0.00 255.0000 FORMAT "%8.4" ECU_ADDRESS 0xD00085DA /end MEASUREMENT
/begin MEASUREMENT DINH_stFId.FId_TraTrqRedLmpHmeDec "" UBYTE DFC_OneToOne 1 100 0.00 255.0000 FORMAT "%8.4" ECU_ADDRESS 0xD00085DB /end MEASUREMENT
/begin MEASUREMENT DINH_stFId.FId_TraTrqRedLmpHmeInc "" UBYTE DFC_OneToOne 1 100 0.00 255.0000 FORMAT "%8.4" ECU_ADDRESS 0xD00085DC /end MEASUREMENT
/begin MEASUREMENT DINH_stFId.FId_TraTrqRedPlausDecIntv "" UBYTE DFC_OneToOne 1 100 0.00 255.0000 FORMAT "%8.4" ECU_ADDRESS 0xD00085DD /end MEASUREMENT
/begin MEASUREMENT DINH_stFId.FId_TraTrqRedPlausIncIntv "" UBYTE DFC_OneToOne 1 100 0.00 255.0000 FORMAT "%8.4" ECU_ADDRESS 0xD00085DE /end MEASUREMENT
/begin MEASUREMENT DINH_stFId.FId_TrbChPWMIn "" UBYTE DFC_OneToOne 1 100 0.00 255.0000 FORMAT "%8.4" ECU_ADDRESS 0xD00085DF /end MEASUREMENT
/begin MEASUREMENT DINH_stFId.FId_VSwCtl "" UBYTE DFC_OneToOne 1 100 0.00 255.0000 FORMAT "%8.4" ECU_ADDRESS 0xD00085E0 /end MEASUREMENT
/begin MEASUREMENT DINH_stFId.FId_VSwVlvFrzVal "" UBYTE DFC_OneToOne 1 100 0.00 255.0000 FORMAT "%8.4" ECU_ADDRESS 0xD00085E1 /end MEASUREMENT
/begin MEASUREMENT DINH_stFId.FId_VSwVlvGovOn "" UBYTE DFC_OneToOne 1 100 0.00 255.0000 FORMAT "%8.4" ECU_ADDRESS 0xD00085E2 /end MEASUREMENT
/begin MEASUREMENT DINH_stFId.FId_VSwVlvOfsLrnInhib "" UBYTE DFC_OneToOne 1 100 0.00 255.0000 FORMAT "%8.4" ECU_ADDRESS 0xD00085E3 /end MEASUREMENT
/begin MEASUREMENT DINH_stFId.FId_VSwVlvOpnLd "" UBYTE DFC_OneToOne 1 100 0.00 255.0000 FORMAT "%8.4" ECU_ADDRESS 0xD00085E4 /end MEASUREMENT
/begin MEASUREMENT DINH_stFId.FId_VSwVlvRplVal "" UBYTE DFC_OneToOne 1 100 0.00 255.0000 FORMAT "%8.4" ECU_ADDRESS 0xD00085E5 /end MEASUREMENT
/begin MEASUREMENT DINH_stFId.FId_VSwVlvSS "" UBYTE DFC_OneToOne 1 100 0.00 255.0000 FORMAT "%8.4" ECU_ADDRESS 0xD00085E6 /end MEASUREMENT
/begin MEASUREMENT DINH_stFId.FId_VehMotvBd "" UBYTE DFC_OneToOne 1 100 0.00 255.0000 FORMAT "%8.4" ECU_ADDRESS 0xD00085E7 /end MEASUREMENT
/begin MEASUREMENT DINH_stFId.FId_VehVCANFrzVal "" UBYTE DFC_OneToOne 1 100 0.00 255.0000 FORMAT "%8.4" ECU_ADDRESS 0xD00085E8 /end MEASUREMENT
/begin MEASUREMENT DINH_stFId.FId_VehVCANReplVal "" UBYTE DFC_OneToOne 1 100 0.00 255.0000 FORMAT "%8.4" ECU_ADDRESS 0xD00085E9 /end MEASUREMENT
/begin MEASUREMENT DINH_stFId.FId_VehVFrzVal "" UBYTE DFC_OneToOne 1 100 0.00 255.0000 FORMAT "%8.4" ECU_ADDRESS 0xD00085EA /end MEASUREMENT
/begin MEASUREMENT DINH_stFId.FId_VehVMon "" UBYTE DFC_OneToOne 1 100 0.00 255.0000 FORMAT "%8.4" ECU_ADDRESS 0xD00085EB /end MEASUREMENT
/begin MEASUREMENT DINH_stFId.FId_VehVReplVal "" UBYTE DFC_OneToOne 1 100 0.00 255.0000 FORMAT "%8.4" ECU_ADDRESS 0xD00085EC /end MEASUREMENT
/begin MEASUREMENT DINH_stFId.FId_ZFCClbActv "" UBYTE DFC_OneToOne 1 100 0.00 255.0000 FORMAT "%8.4" ECU_ADDRESS 0xD00085ED /end MEASUREMENT
/begin MEASUREMENT DINH_stFId.FId_ZFCCldCmbCham "" UBYTE DFC_OneToOne 1 100 0.00 255.0000 FORMAT "%8.4" ECU_ADDRESS 0xD00085EE /end MEASUREMENT
/begin MEASUREMENT DINH_stFId.FId_stAVSCoESLSU "" UBYTE DFC_OneToOne 1 100 0.00 255.0000 FORMAT "%8.4" ECU_ADDRESS 0xD00085EF /end MEASUREMENT
/begin MEASUREMENT DINH_stFId.Fid_HLSDemHDC "" UBYTE DFC_OneToOne 1 100 0.00 255.0000 FORMAT "%8.4" ECU_ADDRESS 0xD00085F0 /end MEASUREMENT
/begin MEASUREMENT DINH_stFId.Fid_StSysStrtTipGbxDat "" UBYTE DFC_OneToOne 1 100 0.00 255.0000 FORMAT "%8.4" ECU_ADDRESS 0xD00085F1 /end MEASUREMENT
/begin MEASUREMENT DINH_stFId.Fid_WaHtShOffErr "" UBYTE DFC_OneToOne 1 100 0.00 255.0000 FORMAT "%8.4" ECU_ADDRESS 0xD00085F2 /end MEASUREMENT
/begin MEASUREMENT VehMot_rTrqDfftl "Differentialübersetzung" SWORD TransR 1 100 -327.6800 327.6700 FORMAT "%8.4" ECU_ADDRESS 0xD00075FA /end MEASUREMENT
/begin MEASUREMENT VehMot_trqPrtDfftl "Differentialschutzmoment" SLONG TrqPrpHigh 1 100 -214748364.800 214748364.700 FORMAT "%13.3" ECU_ADDRESS 0xD00043FC /end MEASUREMENT
/begin FUNCTION dfes_type_auto ""
 /begin DEF_CHARACTERISTIC DFES_FaultTyp.DFC_AirCtlGovDvtEOMMax_C DFES_FaultTyp.DFC_AirCtlGovDvtEOMMin_C DFES_FaultTyp.DFC_AirCtlGovDvtMax_C DFES_FaultTyp.DFC_AirCtlGovDvtMin_C DFES_FaultTyp.DFC_Cj945SpiCom1_C DFES_FaultTyp.DFC_ComButtonMSASig_C DFES_FaultTyp.DFC_ComButtonMSATo_C DFES_FaultTyp.DFC_ComGearboxData2Sig_C DFES_FaultTyp.DFC_ComGearboxData2To_C DFES_FaultTyp.DFC_ComGearboxDataSig_C DFES_FaultTyp.DFC_ComGearboxDataTo_C DFES_FaultTyp.DFC_ComHeatACSig_C DFES_FaultTyp.DFC_ComHeatACTo_C DFES_FaultTyp.DFC_ComLenkradwinkelSig_C DFES_FaultTyp.DFC_ComLenkradwinkelTo_C DFES_FaultTyp.DFC_ComMileageRangeSig_C DFES_FaultTyp.DFC_ComMileageRangeTo_C DFES_FaultTyp.DFC_ComPspSig_C DFES_FaultTyp.DFC_ComPspTo_C DFES_FaultTyp.DFC_ComShutOffPSPSig_C DFES_FaultTyp.DFC_ComShutOffPSPTo_C DFES_FaultTyp.DFC_ComStKombiCtr_C DFES_FaultTyp.DFC_ComStKombiSig_C DFES_FaultTyp.DFC_ComStKombiTo_C DFES_FaultTyp.DFC_ComStateARSCtr_C DFES_FaultTyp.DFC_ComStateARSSig_C DFES_FaultTyp.DFC_ComStateARSTo_C DFES_FaultTyp.DFC_ComStateDscSig_C DFES_FaultTyp.DFC_ComStateDscTo_C DFES_FaultTyp.DFC_ComStateSeatSig_C DFES_FaultTyp.DFC_ComStateSeatTo_C DFES_FaultTyp.DFC_ComTempRelTimeSig_C DFES_FaultTyp.DFC_ComTempRelTimeTo_C DFES_FaultTyp.DFC_ComTerminalChk_C DFES_FaultTyp.DFC_ComTerminalCtr_C DFES_FaultTyp.DFC_ComTerminalSig_C DFES_FaultTyp.DFC_ComTerminalTo_C DFES_FaultTyp.DFC_ComTimeDateSig_C DFES_FaultTyp.DFC_ComTimeDateTo_C DFES_FaultTyp.DFC_ComTrailerSig_C DFES_FaultTyp.DFC_ComTrailerTo_C DFES_FaultTyp.DFC_ComTrqDemandAfsChk_C DFES_FaultTyp.DFC_ComTrqDemandAfsCtr_C DFES_FaultTyp.DFC_ComTrqDemandAfsSig_C DFES_FaultTyp.DFC_ComTrqDemandAfsTo_C DFES_FaultTyp.DFC_ComTrqDemandDscChk_C DFES_FaultTyp.DFC_ComTrqDemandDscCtr_C DFES_FaultTyp.DFC_ComTrqDemandDscSig_C DFES_FaultTyp.DFC_ComTrqDemandDscTo_C DFES_FaultTyp.DFC_ComTrqDemandGbxChk_C DFES_FaultTyp.DFC_ComTrqDemandGbxCtr_C DFES_FaultTyp.DFC_ComTrqDemandGbxSig_C DFES_FaultTyp.DFC_ComTrqDemandGbxTo_C DFES_FaultTyp.DFC_ComVelocitySig_C DFES_FaultTyp.DFC_ComVelocityTo_C DFES_FaultTyp.DFC_ComWheelSpeedSig_C DFES_FaultTyp.DFC_ComWheelSpeedTo_C DFES_FaultTyp.DFC_ComZvKlappenSig_C DFES_FaultTyp.DFC_ComZvKlappenTo_C DFES_FaultTyp.DFC_Cy150SpiCom_C DFES_FaultTyp.DFC_Cy320SpiCom_C DFES_FaultTyp.DFC_ETCtlDvtInrMax_C DFES_FaultTyp.DFC_ETCtlDvtInrMin_C DFES_FaultTyp.DFC_ETCtlDvtOutrMax_C DFES_FaultTyp.DFC_ETCtlDvtOutrMin_C DFES_FaultTyp.DFC_Fan4WinErr1_C DFES_FaultTyp.DFC_Fan4WinErr2_C DFES_FaultTyp.DFC_Fan4WinErr3_C DFES_FaultTyp.DFC_Fan4WinErr4_C DFES_FaultTyp.DFC_FanSCG_C DFES_FaultTyp.DFC_PCRGovDvtLPMax_C DFES_FaultTyp.DFC_PCRGovDvtLPMin_C DFES_FaultTyp.DFC_PCRGovDvtMax_C DFES_FaultTyp.DFC_PCRGovDvtMin_C DFES_FaultTyp.DFC_RailCPC1_C DFES_FaultTyp.DFC_RailCPC3_C DFES_FaultTyp.DFC_RailCPC4_C DFES_FaultTyp.DFC_RailMeUn0_C DFES_FaultTyp.DFC_RailMeUn1_C DFES_FaultTyp.DFC_RailMeUn2_C DFES_FaultTyp.DFC_RailMeUn3_C DFES_FaultTyp.DFC_RailMeUn4_C DFES_FaultTyp.DFC_RailPCV0_C DFES_FaultTyp.DFC_RailPCV1_C DFES_FaultTyp.DFC_RailPCV2_C DFES_FaultTyp.DFC_RailPCV3_C DFES_FaultTyp.DFC_RailPCV4_C DFES_FaultTyp.DFC_RailPMonStrt_C DFES_FaultTyp.DFC_SSpMon1_C DFES_FaultTyp.DFC_SSpMon2_C DFES_FaultTyp.DFC_SSpMon3_C DFES_FaultTyp.DFC_Sia_E1_C DFES_FaultTyp.DFC_Sia_E10_C DFES_FaultTyp.DFC_Sia_E11_C DFES_FaultTyp.DFC_Sia_E12_C DFES_FaultTyp.DFC_Sia_E13_C DFES_FaultTyp.DFC_Sia_E14_C DFES_FaultTyp.DFC_Sia_E15_C DFES_FaultTyp.DFC_Sia_E2_C DFES_FaultTyp.DFC_Sia_E3_C DFES_FaultTyp.DFC_Sia_E4_C DFES_FaultTyp.DFC_Sia_E5_C DFES_FaultTyp.DFC_Sia_E6_C DFES_FaultTyp.DFC_Sia_E7_C DFES_FaultTyp.DFC_Sia_E8_C DFES_FaultTyp.DFC_Sia_E9_C DFES_FaultTyp.DFC_ThrVlv4WinErr1_C DFES_FaultTyp.DFC_ThrVlv4WinErr2_C DFES_FaultTyp.DFC_ThrVlv4WinErr3_C DFES_FaultTyp.DFC_ThrVlv4WinErr4_C DFES_FaultTyp.DFC_ThrVlvSCG_C DFES_FaultTyp.DFC_TrbCh4WinErr1_C DFES_FaultTyp.DFC_TrbCh4WinErr2_C DFES_FaultTyp.DFC_TrbCh4WinErr3_C DFES_FaultTyp.DFC_TrbCh4WinErr4_C DFES_FaultTyp.DFC_TrbChSCG_C DFES_FaultTyp.DFC_TrbChSRCMax_C DFES_FaultTyp.DFC_TrbChSRCMin_C DFES_FaultTyp.DFC_WaHtEl4WinErr1_C DFES_FaultTyp.DFC_WaHtEl4WinErr2_C DFES_FaultTyp.DFC_WaHtEl4WinErr3_C DFES_FaultTyp.DFC_WaHtEl4WinErr4_C DFES_FaultTyp.DFC_WaHtElSCG_C DFES_FaultTyp.DFC_ETClbETFltMax_C DFES_FaultTyp.DFC_ETClbETFltMin_C DFES_FaultTyp.DFC_InjCrvInjLimChrgBal_C DFES_FaultTyp.DFC_InjCrvInjLimQntBal_C DFES_FaultTyp.DFC_InjCrvInjLimSys_C DFES_FaultTyp.DFC_InjCrvNumInjRtmLim_C DFES_FaultTyp.DFC_LSUHtCoupSig_0_C DFES_FaultTyp.DFC_LSUHtCoupSig_1_C DFES_FaultTyp.DFC_LSUHtCoupSig_2_C DFES_FaultTyp.DFC_LSUHtCoupSig_3_C DFES_FaultTyp.DFC_CtT_C DFES_FaultTyp.DFC_DSMDummy_C DFES_FaultTyp.DFC_MeUnOL_C DFES_FaultTyp.DFC_MeUnSCB_C DFES_FaultTyp.DFC_MeUnSRCMax_C DFES_FaultTyp.DFC_MeUnSRCMin_C DFES_FaultTyp.DFC_PCVOL_C DFES_FaultTyp.DFC_PCVSCB_C DFES_FaultTyp.DFC_PCVSRCMax_C DFES_FaultTyp.DFC_PCVSRCMin_C DFES_FaultTyp.DFC_RailPSRCMax_C DFES_FaultTyp.DFC_RailPSRCMin_C DFES_FaultTyp.DFC_IVActrVltgSRCMax_C DFES_FaultTyp.DFC_IVActrVltgSRCMin_C DFES_FaultTyp.DFC_IVPSplyDCDC_C DFES_FaultTyp.DFC_IVPSplyVltgSRCMax_C DFES_FaultTyp.DFC_IVPSplyVltgSRCMin_C DFES_FaultTyp.DFC_AFSOffsDrftMax_C DFES_FaultTyp.DFC_AFSOffsDrftMin_C DFES_FaultTyp.DFC_AFSSRCCorMax_C DFES_FaultTyp.DFC_AFSSRCCorMin_C DFES_FaultTyp.DFC_AFSSRCRawMax_C DFES_FaultTyp.DFC_AFSSRCRawMin_C DFES_FaultTyp.DFC_AFSSetyDrftMax_C DFES_FaultTyp.DFC_AFSSetyDrftMin_C DFES_FaultTyp.DFC_AirCClntPAnaSRCMax_C DFES_FaultTyp.DFC_AirCClntPAnaSRCMin_C DFES_FaultTyp.DFC_AirCClntPPerSRCMax_C DFES_FaultTyp.DFC_AirCClntPPerSRCMin_C DFES_FaultTyp.DFC_AirCClntPdcycSRCMax_C DFES_FaultTyp.DFC_AirCClntPdcycSRCMin_C DFES_FaultTyp.DFC_AirCCmprOL_C DFES_FaultTyp.DFC_AirCCmprRedTrqOL_C DFES_FaultTyp.DFC_AirCCmprRedTrqSCB_C DFES_FaultTyp.DFC_AirCCmprRedTrqSCG_C DFES_FaultTyp.DFC_AirCCmprSCB_C DFES_FaultTyp.DFC_AirCCmprSCG_C DFES_FaultTyp.DFC_AirCSwtNpl_C DFES_FaultTyp.DFC_AirCSwtSig_C DFES_FaultTyp.DFC_BattUSRCMax_C DFES_FaultTyp.DFC_BattUSRCMin_C DFES_FaultTyp.DFC_BrkNpl_C DFES_FaultTyp.DFC_BrkPSRCMax_C DFES_FaultTyp.DFC_BrkPSRCMin_C DFES_FaultTyp.DFC_BrkSig_C DFES_FaultTyp.DFC_CByVlvOL_C DFES_FaultTyp.DFC_CByVlvSCB_C DFES_FaultTyp.DFC_CByVlvSCG_C DFES_FaultTyp.DFC_CEngDsTSRCMax_C DFES_FaultTyp.DFC_CEngDsTSRCMin_C DFES_FaultTyp.DFC_CEngDsTSig_C DFES_FaultTyp.DFC_CEngUsTSRCMax_C DFES_FaultTyp.DFC_CEngUsTSRCMin_C DFES_FaultTyp.DFC_CThmstOL_C DFES_FaultTyp.DFC_CThmstSCB_C DFES_FaultTyp.DFC_CThmstSCG_C DFES_FaultTyp.DFC_ClthSig_C DFES_FaultTyp.DFC_ECBVlvOL_C DFES_FaultTyp.DFC_ECBVlvSCB_C DFES_FaultTyp.DFC_ECBVlvSCG_C DFES_FaultTyp.DFC_ECBVlvSRCMax_C DFES_FaultTyp.DFC_ECBVlvSRCMin_C DFES_FaultTyp.DFC_EGRVlvGovDvtMax_C DFES_FaultTyp.DFC_EGRVlvGovDvtMin_C DFES_FaultTyp.DFC_EGRVlvOL_C DFES_FaultTyp.DFC_EGRVlvSCB_C DFES_FaultTyp.DFC_EGRVlvSCG_C DFES_FaultTyp.DFC_EGRVlvSRCMax_C DFES_FaultTyp.DFC_EGRVlvSRCMin_C DFES_FaultTyp.DFC_EMDmpOL_0_C DFES_FaultTyp.DFC_EMDmpOL_1_C DFES_FaultTyp.DFC_EMDmpSCB_0_C DFES_FaultTyp.DFC_EMDmpSCB_1_C DFES_FaultTyp.DFC_EMDmpSCG_0_C DFES_FaultTyp.DFC_EMDmpSCG_1_C DFES_FaultTyp.DFC_EngStAOL_C DFES_FaultTyp.DFC_EngStASCB_C DFES_FaultTyp.DFC_EngStASCG_C DFES_FaultTyp.DFC_EnvPSRCMax_C DFES_FaultTyp.DFC_EnvPSRCMin_C DFES_FaultTyp.DFC_EnvPSig_C DFES_FaultTyp.DFC_EnvTSRCMax_C DFES_FaultTyp.DFC_EnvTSRCMin_C DFES_FaultTyp.DFC_FanOL_C DFES_FaultTyp.DFC_FanSCB_C DFES_FaultTyp.DFC_FlFltSig_C DFES_FaultTyp.DFC_FuelTSRCMax_C DFES_FaultTyp.DFC_FuelTSRCMin_C DFES_FaultTyp.DFC_GbxNPosPPerSRCMax_C DFES_FaultTyp.DFC_GbxNPosPPerSRCMin_C DFES_FaultTyp.DFC_GbxNPosPdcycSRCMax_C DFES_FaultTyp.DFC_GbxNPosPdcycSRCMin_C DFES_FaultTyp.DFC_GbxNPosSig_C DFES_FaultTyp.DFC_GlwPlgBSDOL_0_C DFES_FaultTyp.DFC_GlwPlgBSDOL_1_C DFES_FaultTyp.DFC_GlwPlgBSDOL_2_C DFES_FaultTyp.DFC_GlwPlgBSDOL_3_C DFES_FaultTyp.DFC_GlwPlgBSDOL_4_C DFES_FaultTyp.DFC_GlwPlgBSDOL_5_C DFES_FaultTyp.DFC_GlwPlgBSDOL_6_C DFES_FaultTyp.DFC_GlwPlgBSDOL_7_C DFES_FaultTyp.DFC_GlwPlgBSDOT_0_C DFES_FaultTyp.DFC_GlwPlgBSDOT_1_C DFES_FaultTyp.DFC_GlwPlgBSDOT_2_C DFES_FaultTyp.DFC_GlwPlgBSDOT_3_C DFES_FaultTyp.DFC_GlwPlgBSDOT_4_C DFES_FaultTyp.DFC_GlwPlgBSDOT_5_C DFES_FaultTyp.DFC_GlwPlgBSDOT_6_C DFES_FaultTyp.DFC_GlwPlgBSDOT_7_C DFES_FaultTyp.DFC_GlwPlgBSDSC_0_C DFES_FaultTyp.DFC_GlwPlgBSDSC_1_C DFES_FaultTyp.DFC_GlwPlgBSDSC_2_C DFES_FaultTyp.DFC_GlwPlgBSDSC_3_C DFES_FaultTyp.DFC_GlwPlgBSDSC_4_C DFES_FaultTyp.DFC_GlwPlgBSDSC_5_C DFES_FaultTyp.DFC_GlwPlgBSDSC_6_C DFES_FaultTyp.DFC_GlwPlgBSDSC_7_C DFES_FaultTyp.DFC_GlwPlgComErr_C DFES_FaultTyp.DFC_InjVlvPresMin_C DFES_FaultTyp.DFC_LSUCircNernstMax_0_C DFES_FaultTyp.DFC_LSUCircNernstMax_1_C DFES_FaultTyp.DFC_LSUCircNernstMax_2_C DFES_FaultTyp.DFC_LSUCircNernstMax_3_C DFES_FaultTyp.DFC_LSUCircNernstMin_0_C DFES_FaultTyp.DFC_LSUCircNernstMin_1_C DFES_FaultTyp.DFC_LSUCircNernstMin_2_C DFES_FaultTyp.DFC_LSUCircNernstMin_3_C DFES_FaultTyp.DFC_LSUCircNernstSig_0_C DFES_FaultTyp.DFC_LSUCircNernstSig_1_C DFES_FaultTyp.DFC_LSUCircNernstSig_2_C DFES_FaultTyp.DFC_LSUCircNernstSig_3_C DFES_FaultTyp.DFC_LSUCircPmpCurMax_0_C DFES_FaultTyp.DFC_LSUCircPmpCurMax_1_C DFES_FaultTyp.DFC_LSUCircPmpCurMax_2_C DFES_FaultTyp.DFC_LSUCircPmpCurMax_3_C DFES_FaultTyp.DFC_LSUCircPmpCurMin_0_C DFES_FaultTyp.DFC_LSUCircPmpCurMin_1_C DFES_FaultTyp.DFC_LSUCircPmpCurMin_2_C DFES_FaultTyp.DFC_LSUCircPmpCurMin_3_C DFES_FaultTyp.DFC_LSUCircPmpCurSig_0_C DFES_FaultTyp.DFC_LSUCircPmpCurSig_1_C DFES_FaultTyp.DFC_LSUCircPmpCurSig_2_C DFES_FaultTyp.DFC_LSUCircPmpCurSig_3_C DFES_FaultTyp.DFC_LSUCircVirtGndMax_0_C DFES_FaultTyp.DFC_LSUCircVirtGndMax_1_C DFES_FaultTyp.DFC_LSUCircVirtGndMax_2_C DFES_FaultTyp.DFC_LSUCircVirtGndMax_3_C DFES_FaultTyp.DFC_LSUCircVirtGndMin_0_C DFES_FaultTyp.DFC_LSUCircVirtGndMin_1_C DFES_FaultTyp.DFC_LSUCircVirtGndMin_2_C DFES_FaultTyp.DFC_LSUCircVirtGndMin_3_C DFES_FaultTyp.DFC_LSUCircVirtGndSig_0_C DFES_FaultTyp.DFC_LSUCircVirtGndSig_1_C DFES_FaultTyp.DFC_LSUCircVirtGndSig_2_C DFES_FaultTyp.DFC_LSUCircVirtGndSig_3_C DFES_FaultTyp.DFC_LSUHtrMax_0_C DFES_FaultTyp.DFC_LSUHtrMax_1_C DFES_FaultTyp.DFC_LSUHtrMax_2_C DFES_FaultTyp.DFC_LSUHtrMax_3_C DFES_FaultTyp.DFC_LSUHtrMin_0_C DFES_FaultTyp.DFC_LSUHtrMin_1_C DFES_FaultTyp.DFC_LSUHtrMin_2_C DFES_FaultTyp.DFC_LSUHtrMin_3_C DFES_FaultTyp.DFC_LSUHtrSig_0_C DFES_FaultTyp.DFC_LSUHtrSig_1_C DFES_FaultTyp.DFC_LSUHtrSig_2_C DFES_FaultTyp.DFC_LSUHtrSig_3_C DFES_FaultTyp.DFC_LSUO2Max_0_C DFES_FaultTyp.DFC_LSUO2Max_1_C DFES_FaultTyp.DFC_LSUO2Max_2_C DFES_FaultTyp.DFC_LSUO2Max_3_C DFES_FaultTyp.DFC_LSUO2Min_0_C DFES_FaultTyp.DFC_LSUO2Min_1_C DFES_FaultTyp.DFC_LSUO2Min_2_C DFES_FaultTyp.DFC_LSUO2Min_3_C DFES_FaultTyp.DFC_LSUSPIBattLowMin_0_C DFES_FaultTyp.DFC_LSUSPIBattLowMin_1_C DFES_FaultTyp.DFC_LSUSPIBattLowMin_2_C DFES_FaultTyp.DFC_LSUSPIBattLowMin_3_C DFES_FaultTyp.DFC_LSUSPISig_0_C DFES_FaultTyp.DFC_LSUSPISig_1_C DFES_FaultTyp.DFC_LSUSPISig_2_C DFES_FaultTyp.DFC_LSUSPISig_3_C DFES_FaultTyp.DFC_LSUtExcMax_0_C DFES_FaultTyp.DFC_LSUtExcMax_1_C DFES_FaultTyp.DFC_LSUtExcMax_2_C DFES_FaultTyp.DFC_LSUtExcMax_3_C DFES_FaultTyp.DFC_LSUtExcMin_0_C DFES_FaultTyp.DFC_LSUtExcMin_1_C DFES_FaultTyp.DFC_LSUtExcMin_2_C DFES_FaultTyp.DFC_LSUtExcMin_3_C DFES_FaultTyp.DFC_MILOL_C DFES_FaultTyp.DFC_MILSCB_C DFES_FaultTyp.DFC_MILSCG_C DFES_FaultTyp.DFC_MeUnSCG_C DFES_FaultTyp.DFC_NplHsChngPPFltDiff_C DFES_FaultTyp.DFC_NplPAirFltDs_C DFES_FaultTyp.DFC_NplTPFltUs_C DFES_FaultTyp.DFC_OilComErr_C DFES_FaultTyp.DFC_OilPLmpOL_C DFES_FaultTyp.DFC_OilPLmpSCB_C DFES_FaultTyp.DFC_OilPLmpSCG_C DFES_FaultTyp.DFC_OilPNpl_C DFES_FaultTyp.DFC_OilTNpl_C DFES_FaultTyp.DFC_OilTSRCMax_C DFES_FaultTyp.DFC_OilTSRCMin_C DFES_FaultTyp.DFC_PCACDsEnvPPls_C DFES_FaultTyp.DFC_PCACDsSRCMax_C DFES_FaultTyp.DFC_PCACDsSRCMin_C DFES_FaultTyp.DFC_PCVSCG_C DFES_FaultTyp.DFC_PFltCharPDiffMin_C DFES_FaultTyp.DFC_PFltDstrMin_C DFES_FaultTyp.DFC_PFltEngPrt_C DFES_FaultTyp.DFC_PFltLmpOL_C DFES_FaultTyp.DFC_PFltLmpSCB_C DFES_FaultTyp.DFC_PFltLmpSCG_C DFES_FaultTyp.DFC_PFltRgnPerm_C DFES_FaultTyp.DFC_PFltSRCMaxFlwRstn_C DFES_FaultTyp.DFC_PFltSRCMinFlwRstn_C DFES_FaultTyp.DFC_PFltSotMsDvtMax_C DFES_FaultTyp.DFC_PFltSotMsDvtMin_C DFES_FaultTyp.DFC_PFltSotMsMax_C DFES_FaultTyp.DFC_PSPOL_C DFES_FaultTyp.DFC_PSPSCB_C DFES_FaultTyp.DFC_PSPSCG_C DFES_FaultTyp.DFC_SRCHighAPP1_C DFES_FaultTyp.DFC_SRCHighAPP2_C DFES_FaultTyp.DFC_SRCLowAPP1_C DFES_FaultTyp.DFC_SRCLowAPP2_C DFES_FaultTyp.DFC_SRCMaxPAirFltDs_C DFES_FaultTyp.DFC_SRCMaxPPFltUs_C DFES_FaultTyp.DFC_SRCMaxTECU_C DFES_FaultTyp.DFC_SRCMaxTOxiCatUs_C DFES_FaultTyp.DFC_SRCMaxTPFltUs_C DFES_FaultTyp.DFC_SRCMinPAirFltDs_C DFES_FaultTyp.DFC_SRCMinPPFltUs_C DFES_FaultTyp.DFC_SRCMinTECU_C DFES_FaultTyp.DFC_SRCMinTOxiCatUs_C DFES_FaultTyp.DFC_SRCMinTPFltUs_C DFES_FaultTyp.DFC_SVSOL_C DFES_FaultTyp.DFC_SVSSCB_C DFES_FaultTyp.DFC_SVSSCG_C DFES_FaultTyp.DFC_StrtOL_C DFES_FaultTyp.DFC_StrtSCB_C DFES_FaultTyp.DFC_StrtSCG_C DFES_FaultTyp.DFC_SyncAPP_C DFES_FaultTyp.DFC_T15Npl_C DFES_FaultTyp.DFC_TAFSDtyCycHi_C DFES_FaultTyp.DFC_TAFSDtyCycLo_C DFES_FaultTyp.DFC_TAFSPerHi_C DFES_FaultTyp.DFC_TAFSPerLo_C DFES_FaultTyp.DFC_TCACDsSRCMax_C DFES_FaultTyp.DFC_TCACDsSRCMin_C DFES_FaultTyp.DFC_ThrVlvOL_C DFES_FaultTyp.DFC_ThrVlvSCB_C DFES_FaultTyp.DFC_ThrVlvSRCMax_C DFES_FaultTyp.DFC_ThrVlvSRCMin_C DFES_FaultTyp.DFC_TrbChLPOL_C DFES_FaultTyp.DFC_TrbChLPSCB_C DFES_FaultTyp.DFC_TrbChLPSCG_C DFES_FaultTyp.DFC_TrbChOL_C DFES_FaultTyp.DFC_TrbChSCB_C DFES_FaultTyp.DFC_VSwVlvGovDvtMax_C DFES_FaultTyp.DFC_VSwVlvGovDvtMin_C DFES_FaultTyp.DFC_VSwVlvOL_C DFES_FaultTyp.DFC_VSwVlvSCB_C DFES_FaultTyp.DFC_VSwVlvSCG_C DFES_FaultTyp.DFC_VSwVlvSRCMax_C DFES_FaultTyp.DFC_VSwVlvSRCMin_C DFES_FaultTyp.DFC_VehVHW_C DFES_FaultTyp.DFC_VehVMax_C DFES_FaultTyp.DFC_VehVPlaus_C DFES_FaultTyp.DFC_VehVSig_C DFES_FaultTyp.DFC_WaHtElOL_C DFES_FaultTyp.DFC_WaHtElSCB_C DFES_FaultTyp.DFC_ClthNpl_C DFES_FaultTyp.DFC_ETClbETMax_0_C DFES_FaultTyp.DFC_ETClbETMax_1_C DFES_FaultTyp.DFC_ETClbETMax_2_C DFES_FaultTyp.DFC_ETClbETMax_3_C DFES_FaultTyp.DFC_ETClbETMax_4_C DFES_FaultTyp.DFC_ETClbETMax_5_C DFES_FaultTyp.DFC_ETClbETMin_0_C DFES_FaultTyp.DFC_ETClbETMin_1_C DFES_FaultTyp.DFC_ETClbETMin_2_C DFES_FaultTyp.DFC_ETClbETMin_3_C DFES_FaultTyp.DFC_ETClbETMin_4_C DFES_FaultTyp.DFC_ETClbETMin_5_C DFES_FaultTyp.DFC_IVDiaBnkShCirBSH_0_C DFES_FaultTyp.DFC_IVDiaBnkShCirBSH_1_C DFES_FaultTyp.DFC_IVDiaBnkShCirChSwt_0_C DFES_FaultTyp.DFC_IVDiaBnkShCirChSwt_1_C DFES_FaultTyp.DFC_IVDiaBnkShCirHSBatt_0_C DFES_FaultTyp.DFC_IVDiaBnkShCirHSBatt_1_C DFES_FaultTyp.DFC_IVDiaBnkShCirHiRstnc_0_C DFES_FaultTyp.DFC_IVDiaBnkShCirHiRstnc_1_C DFES_FaultTyp.DFC_IVDiaBnkShCirLSHSGnd_0_C DFES_FaultTyp.DFC_IVDiaBnkShCirLSHSGnd_1_C DFES_FaultTyp.DFC_IVDiaBnkShCirTransfer_0_C DFES_FaultTyp.DFC_IVDiaBnkShCirTransfer_1_C DFES_FaultTyp.DFC_IVDiaCylNoCls_0_C DFES_FaultTyp.DFC_IVDiaCylNoCls_1_C DFES_FaultTyp.DFC_IVDiaCylNoCls_2_C DFES_FaultTyp.DFC_IVDiaCylNoCls_3_C DFES_FaultTyp.DFC_IVDiaCylNoCls_4_C DFES_FaultTyp.DFC_IVDiaCylNoCls_5_C DFES_FaultTyp.DFC_IVDiaCylNoLd_0_C DFES_FaultTyp.DFC_IVDiaCylNoLd_1_C DFES_FaultTyp.DFC_IVDiaCylNoLd_2_C DFES_FaultTyp.DFC_IVDiaCylNoLd_3_C DFES_FaultTyp.DFC_IVDiaCylNoLd_4_C DFES_FaultTyp.DFC_IVDiaCylNoLd_5_C DFES_FaultTyp.DFC_IVDiaCylShCirHiRstnc_0_C DFES_FaultTyp.DFC_IVDiaCylShCirHiRstnc_1_C DFES_FaultTyp.DFC_IVDiaCylShCirHiRstnc_2_C DFES_FaultTyp.DFC_IVDiaCylShCirHiRstnc_3_C DFES_FaultTyp.DFC_IVDiaCylShCirHiRstnc_4_C DFES_FaultTyp.DFC_IVDiaCylShCirHiRstnc_5_C DFES_FaultTyp.DFC_IVDiaCylShCirLSBatt_0_C DFES_FaultTyp.DFC_IVDiaCylShCirLSBatt_1_C DFES_FaultTyp.DFC_IVDiaCylShCirLSBatt_2_C DFES_FaultTyp.DFC_IVDiaCylShCirLSBatt_3_C DFES_FaultTyp.DFC_IVDiaCylShCirLSBatt_4_C DFES_FaultTyp.DFC_IVDiaCylShCirLSBatt_5_C DFES_FaultTyp.DFC_IVDiaCylShCirLSHS_0_C DFES_FaultTyp.DFC_IVDiaCylShCirLSHS_1_C DFES_FaultTyp.DFC_IVDiaCylShCirLSHS_2_C DFES_FaultTyp.DFC_IVDiaCylShCirLSHS_3_C DFES_FaultTyp.DFC_IVDiaCylShCirLSHS_4_C DFES_FaultTyp.DFC_IVDiaCylShCirLSHS_5_C DFES_FaultTyp.DFC_IVDiaCylShCirLsLs_0_C DFES_FaultTyp.DFC_IVDiaCylShCirLsLs_1_C DFES_FaultTyp.DFC_IVDiaCylShCirLsLs_2_C DFES_FaultTyp.DFC_IVDiaCylShCirLsLs_3_C DFES_FaultTyp.DFC_IVDiaCylShCirLsLs_4_C DFES_FaultTyp.DFC_IVDiaCylShCirLsLs_5_C DFES_FaultTyp.DFC_IVDiaSPICfg_C DFES_FaultTyp.DFC_IVDiaSPIColl_C DFES_FaultTyp.DFC_IVDiaSPICtrl_C DFES_FaultTyp.DFC_IVDiaSPIRam_C DFES_FaultTyp.DFC_IVDiaSPITrans_C DFES_FaultTyp.DFC_LSUCmpChk_0_C DFES_FaultTyp.DFC_LSUCmpChk_1_C DFES_FaultTyp.DFC_LSUCmpChk_2_C DFES_FaultTyp.DFC_LSUCmpChk_3_C DFES_FaultTyp.DFC_LSUCmpChk_4_C DFES_FaultTyp.DFC_LSUCmpChk_5_C DFES_FaultTyp.DFC_LSUDynChk_0_C DFES_FaultTyp.DFC_LSUDynChk_1_C DFES_FaultTyp.DFC_LSUDynChk_2_C DFES_FaultTyp.DFC_LSUDynChk_3_C DFES_FaultTyp.DFC_LSUO2ClbMax_0_C DFES_FaultTyp.DFC_LSUO2ClbMax_1_C DFES_FaultTyp.DFC_LSUO2ClbMax_2_C DFES_FaultTyp.DFC_LSUO2ClbMax_3_C DFES_FaultTyp.DFC_LSUO2ClbMin_0_C DFES_FaultTyp.DFC_LSUO2ClbMin_1_C DFES_FaultTyp.DFC_LSUO2ClbMin_2_C DFES_FaultTyp.DFC_LSUO2ClbMin_3_C DFES_FaultTyp.DFC_LSUO2PlausMax_0_C DFES_FaultTyp.DFC_LSUO2PlausMax_1_C DFES_FaultTyp.DFC_LSUO2PlausMax_2_C DFES_FaultTyp.DFC_LSUO2PlausMax_3_C DFES_FaultTyp.DFC_LSUO2PlausMin_0_C DFES_FaultTyp.DFC_LSUO2PlausMin_1_C DFES_FaultTyp.DFC_LSUO2PlausMin_2_C DFES_FaultTyp.DFC_LSUO2PlausMin_3_C DFES_FaultTyp.DFC_LSURiClbMax_0_C DFES_FaultTyp.DFC_LSURiClbMax_1_C DFES_FaultTyp.DFC_LSURiClbMax_2_C DFES_FaultTyp.DFC_LSURiClbMax_3_C DFES_FaultTyp.DFC_LSURiClbMin_0_C DFES_FaultTyp.DFC_LSURiClbMin_1_C DFES_FaultTyp.DFC_LSURiClbMin_2_C DFES_FaultTyp.DFC_LSURiClbMin_3_C DFES_FaultTyp.DFC_LSUWireIPSig_0_C DFES_FaultTyp.DFC_LSUWireIPSig_1_C DFES_FaultTyp.DFC_LSUWireIPSig_2_C DFES_FaultTyp.DFC_LSUWireIPSig_3_C DFES_FaultTyp.DFC_AFSDrftIdlAdjVal_C DFES_FaultTyp.DFC_AFSDrftLdAdjVal_C DFES_FaultTyp.DFC_AdcI_ADC0_Cal_C DFES_FaultTyp.DFC_AdcI_ADC0_Conv_C DFES_FaultTyp.DFC_CmbChbMisfireMax_0_C DFES_FaultTyp.DFC_CmbChbMisfireMax_1_C DFES_FaultTyp.DFC_CmbChbMisfireMax_2_C DFES_FaultTyp.DFC_CmbChbMisfireMax_3_C DFES_FaultTyp.DFC_CmbChbMisfireMax_4_C DFES_FaultTyp.DFC_CmbChbMisfireMax_5_C DFES_FaultTyp.DFC_CmbChbMisfireMul_C DFES_FaultTyp.DFC_INJVLVBUSY_C DFES_FaultTyp.DFC_IVAdjIVA_0_C DFES_FaultTyp.DFC_IVAdjIVA_1_C DFES_FaultTyp.DFC_IVAdjIVA_2_C DFES_FaultTyp.DFC_IVAdjIVA_3_C DFES_FaultTyp.DFC_IVAdjIVA_4_C DFES_FaultTyp.DFC_IVAdjIVA_5_C DFES_FaultTyp.DFC_InjCtlAdjQntEEPCS_C DFES_FaultTyp.DFC_InjCtlDriftEEPCS_C DFES_FaultTyp.DFC_MRlyErlyOpng_C DFES_FaultTyp.DFC_MRlyStk_C DFES_FaultTyp.DFC_SensFrzPPFltUs_C DFES_FaultTyp.DFC_T15Sig_C DFES_FaultTyp.DFC_AirCtlRmpTOut_C DFES_FaultTyp.DFC_CEngDsTDynTst_C DFES_FaultTyp.DFC_EGRVlvJamVlvClsd_C DFES_FaultTyp.DFC_EGRVlvJamVlvOpn_C DFES_FaultTyp.DFC_EGRVlvLgTDrft_C DFES_FaultTyp.DFC_EGRVlvOfsLrnJamVlv_C DFES_FaultTyp.DFC_EGRVlvShTDrft_C DFES_FaultTyp.DFC_EGTRgnOilDilMax_C DFES_FaultTyp.DFC_EngICO_C DFES_FaultTyp.DFC_EpmCaSI1ErrSig_C DFES_FaultTyp.DFC_EpmCaSI1NoSig_C DFES_FaultTyp.DFC_EpmCaSI1OfsErr_C DFES_FaultTyp.DFC_EpmCrSErrSig_C DFES_FaultTyp.DFC_EpmCrSNoSig_C DFES_FaultTyp.DFC_MoCADCCmp_C DFES_FaultTyp.DFC_MoCADCTst_C DFES_FaultTyp.DFC_MoCADCVltgRatio_C DFES_FaultTyp.DFC_MoCSOPLoLi_C DFES_FaultTyp.DFC_MoCSOPMM_C DFES_FaultTyp.DFC_MoCSOPTimeOut_C DFES_FaultTyp.DFC_MoCSOPUpLi_C DFES_FaultTyp.DFC_MoFAPP_C DFES_FaultTyp.DFC_MoFESpd_C DFES_FaultTyp.DFC_MoFInjDatPhi_C DFES_FaultTyp.DFC_MoFInjDatQnt_C DFES_FaultTyp.DFC_MoFInjQnt_C DFES_FaultTyp.DFC_MoFOvR_C DFES_FaultTyp.DFC_MoFQntCor_C DFES_FaultTyp.DFC_MoFTrqCmp_C DFES_FaultTyp.DFC_NplTOxiCatUs_C DFES_FaultTyp.DFC_PhyModNonMonMapNpl_C DFES_FaultTyp.DFC_RailPOfsTstMax_C DFES_FaultTyp.DFC_RailPOfsTstMin_C DFES_FaultTyp.DFC_SWReset_0_C DFES_FaultTyp.DFC_SWReset_1_C DFES_FaultTyp.DFC_SWReset_2_C DFES_FaultTyp.DFC_VSwVlvJamVlv_C DFES_FaultTyp.DFC_VSwVlvLgTDrft_C DFES_FaultTyp.DFC_VSwVlvOfsLrnJamVlv_C DFES_FaultTyp.DFC_VSwVlvShTDrft_C /end DEF_CHARACTERISTIC
/end FUNCTION
/begin FUNCTION DFP "" /end FUNCTION
/begin FUNCTION diff_plausprttrq ""
 /begin DEF_CHARACTERISTIC Diff_dtrqRmpP.Pos_C Diff_dtrqRmpP.Neg_C Diff_trqPrtErrLim_C /end DEF_CHARACTERISTIC
 /begin IN_MEASUREMENT DiffIO_stCfg DiffIO_trqPrtDfftl /end IN_MEASUREMENT
 /begin OUT_MEASUREMENT VehMot_trqPrtDfftl /end OUT_MEASUREMENT
/end FUNCTION
/begin FUNCTION diff_trqrat "" /begin DEF_CHARACTERISTIC Diff_rTrqDfftl_C /end DEF_CHARACTERISTIC /begin IN_MEASUREMENT DiffIO_rTrqDfftl DiffIO_stCfg /end IN_MEASUREMENT /begin OUT_MEASUREMENT VehMot_rTrqDfftl /end OUT_MEASUREMENT /end FUNCTION
/begin FUNCTION DINH "" /end FUNCTION
/begin FUNCTION dinh_auto ""
 /begin OUT_MEASUREMENT DINH_stClctFId DINH_stFId.FId_Unused DINH_stFId.FId_InhibitAlways DINH_stFId.FId_CoordALS DINH_stFId.FId_CoordFBC DINH_stFId.FId_CoordTAA DINH_stFId.FId_CoordZFC DINH_stFId.FId_ACCtlTEngErr DINH_stFId.FId_ACCtlTGearbxErr DINH_stFId.FId_ACCtlVehVErr DINH_stFId.FId_ACCtl_AC DINH_stFId.FId_ACCtl_Fan DINH_stFId.FId_AC_pAC DINH_stFId.FId_AFS DINH_stFId.FId_AFSActrTst DINH_stFId.FId_AFSDrftMaxLim DINH_stFId.FId_AFSFrzAirMs DINH_stFId.FId_AFSPlOffsDrft DINH_stFId.FId_AFSPlSetyDrft DINH_stFId.FId_AFSSRC DINH_stFId.FId_AFSSysErr DINH_stFId.FId_AFSTPer DINH_stFId.FId_APP1FinalDef DINH_stFId.FId_APP1ProvDef DINH_stFId.FId_APP1SRCHigh DINH_stFId.FId_APP1SigPath DINH_stFId.FId_APP2FinalDef DINH_stFId.FId_APP2ProvDef DINH_stFId.FId_APP2SRCHigh DINH_stFId.FId_APP2SigPath DINH_stFId.FId_APPBrkDef DINH_stFId.FId_APPBrkPres DINH_stFId.FId_APPNTP DINH_stFId.FId_APPSyncChk DINH_stFId.FId_APPSyncDef DINH_stFId.FId_APPSyncProvDef DINH_stFId.FId_APPSyncSigProv DINH_stFId.FId_APPVel DINH_stFId.FId_APProvDef DINH_stFId.FId_ASDdc DINH_stFId.FId_ASModNSC DINH_stFId.FId_ASModOxiC DINH_stFId.FId_ASModPipe DINH_stFId.FId_ASModPipeSlw DINH_stFId.FId_ASModPresCalc DINH_stFId.FId_ASModPresEnv DINH_stFId.FId_ASModStrt DINH_stFId.FId_ASModSwtOffEng DINH_stFId.FId_ASModSwtOffIndVol DINH_stFId.FId_ASModTrbn DINH_stFId.FId_AccPedNMaxLim DINH_stFId.FId_AccPedNMinLim DINH_stFId.FId_AccPedNMinLimBrkApp DINH_stFId.FId_AccPedTrqLim DINH_stFId.FId_AdcI_ADC0 DINH_stFId.FId_AirCClntPFrzVal DINH_stFId.FId_AirCClntPPwmChk DINH_stFId.FId_AirCClntPRplVal DINH_stFId.FId_AirCSwt DINH_stFId.FId_AirCtl DINH_stFId.FId_AirCtlBstPresCor DINH_stFId.FId_AirCtlCmpntActv DINH_stFId.FId_AirCtlEGR DINH_stFId.FId_AirCtlGear DINH_stFId.FId_AirCtlGovDvt DINH_stFId.FId_AirCtlPFltEGRRed DINH_stFId.FId_AirCtlStrg DINH_stFId.FId_AirCtlTVA DINH_stFId.FId_BattUFrzVal DINH_stFId.FId_BattUReplVal DINH_stFId.FId_BattUSRC DINH_stFId.FId_BrkP DINH_stFId.FId_BrkPFrzVal DINH_stFId.FId_BrkPReplVal DINH_stFId.FId_CEngDsTCANFrzVal DINH_stFId.FId_CEngDsTCANRplVal DINH_stFId.FId_CEngDsTDynTst DINH_stFId.FId_CEngDsTFrzVal DINH_stFId.FId_CEngDsTModel DINH_stFId.FId_CEngDsTRdClnt DINH_stFId.FId_CEngDsTRplVal DINH_stFId.FId_CEngDsTSS DINH_stFId.FId_CEngUsTFrzVal DINH_stFId.FId_CEngUsTReplVal DINH_stFId.FId_CEngUsTSS DINH_stFId.FId_Clth DINH_stFId.FId_ClthCAN DINH_stFId.FId_CmbChb DINH_stFId.FId_CoETM DINH_stFId.FId_CoEngNrml2Strt DINH_stFId.FId_CoEngPthClsEGR DINH_stFId.FId_CoEngPthClsThr DINH_stFId.FId_CoEngPthCylOff DINH_stFId.FId_CoEngPthETZr DINH_stFId.FId_CoEngPthFlQnt DINH_stFId.FId_CoEngPthInjVlvOff DINH_stFId.FId_CoEngPthLpSysOff DINH_stFId.FId_CoEngPthRPMin DINH_stFId.FId_CoTS_SwtOff DINH_stFId.FId_CoVehPrpLimErr DINH_stFId.FId_ComAPP DINH_stFId.FId_ComClth DINH_stFId.FId_ComCoEng DINH_stFId.FId_ComDscAck1 DINH_stFId.FId_ComDscAck2 DINH_stFId.FId_ComDscAck3 DINH_stFId.FId_ComDscTrqIntv DINH_stFId.FId_ComEngDem DINH_stFId.FId_ComGbxAck1 DINH_stFId.FId_ComGbxAck2 DINH_stFId.FId_ComGbxAck3 DINH_stFId.FId_ComGbxTrqIntv DINH_stFId.FId_ComInjDu1 DINH_stFId.FId_ComInjDu2 DINH_stFId.FId_ComInjVlv DINH_stFId.FId_ComMSA DINH_stFId.FId_ComStBrkPedal DINH_stFId.FId_ComStTrq DINH_stFId.FId_ComnEng DINH_stFId.FId_ComnSetPLo DINH_stFId.FId_CompEnv DINH_stFId.FId_ComrWaterVlv DINH_stFId.FId_ConvLdNTrbnCan DINH_stFId.FId_ConvLdOilTemp DINH_stFId.FId_ConvLdTrqLdCan DINH_stFId.FId_ConvLdVel DINH_stFId.FId_CoordEGT DINH_stFId.FId_CrCtl_irrev DINH_stFId.FId_CrCtl_rev DINH_stFId.FId_CtTSwtOff DINH_stFId.FId_Cy100Dev1 DINH_stFId.FId_DCSRmpShOff DINH_stFId.FId_DCSShOff DINH_stFId.FId_DIOnumChip1Cj945 DINH_stFId.FId_DIUMPRGenDenom1 DINH_stFId.FId_DIUMPRGenDenom2 DINH_stFId.FId_DIUMPRGenDenom3 DINH_stFId.FId_DIUMPRIgn DINH_stFId.FId_DSMWarmUpCycle DINH_stFId.FId_DevLibActrPrt DINH_stFId.FId_DewDetHtgDel DINH_stFId.FId_ECBVlvFrzVal DINH_stFId.FId_ECBVlvReplVal DINH_stFId.FId_ECBVlvSS DINH_stFId.FId_EGRClg DINH_stFId.FId_EGRVlvActr DINH_stFId.FId_EGRVlvFrzVal DINH_stFId.FId_EGRVlvGovOn DINH_stFId.FId_EGRVlvOfsLrnInhib DINH_stFId.FId_EGRVlvReplVal DINH_stFId.FId_EGRVlvSSpMon DINH_stFId.FId_EGTRgnLck DINH_stFId.FId_EMCtl DINH_stFId.FId_ETClbCorActv DINH_stFId.FId_ETCtlAirCtl DINH_stFId.FId_ETCtlInr DINH_stFId.FId_ETCtlOutr DINH_stFId.FId_EngDemPFltErr DINH_stFId.FId_EngDemTrqLimErr DINH_stFId.FId_EngDemTrqLimErr1 DINH_stFId.FId_EngDemTrqLimErr2 DINH_stFId.FId_EngDemTrqLimErr3 DINH_stFId.FId_EngDemTrqLimErr4 DINH_stFId.FId_EngPrtEnvP DINH_stFId.FId_EngPrtNLimErr DINH_stFId.FId_EnvPCANFrzVal DINH_stFId.FId_EnvPCANRplVal DINH_stFId.FId_EnvPFrzVal DINH_stFId.FId_EnvPModel DINH_stFId.FId_EnvPRplVal DINH_stFId.FId_EnvPSS DINH_stFId.FId_EnvTCANFrzVal DINH_stFId.FId_EnvTCANRplVal DINH_stFId.FId_EnvTFrzVal DINH_stFId.FId_EnvTModel DINH_stFId.FId_EnvTRplVal DINH_stFId.FId_EnvTSS DINH_stFId.FId_EpmCaSDiag DINH_stFId.FId_EpmCaSOfsDiag_I1 DINH_stFId.FId_EpmCaSOfsDiag_I2 DINH_stFId.FId_EpmCaSOfsDiag_O1 DINH_stFId.FId_EpmCaSOfsDiag_O2 DINH_stFId.FId_EpmCaSOfsDiag_SglCaSI1 DINH_stFId.FId_EpmCaSSegCor DINH_stFId.FId_EpmCrSDiag DINH_stFId.FId_EpmOpMode_InjLock DINH_stFId.FId_FBC DINH_stFId.FId_FanCtl DINH_stFId.FId_FanCtlCor DINH_stFId.FId_FanCtlCor2 DINH_stFId.FId_FanTraOil DINH_stFId.FId_FansVelCor DINH_stFId.FId_FlSysDens DINH_stFId.FId_FrzPrtTrqDfftl DINH_stFId.FId_FrzValPAirFltDs DINH_stFId.FId_FrzValPPFltUs DINH_stFId.FId_FrzValTOxiCatUs DINH_stFId.FId_FrzValTPFltUs DINH_stFId.FId_FuelTCTS DINH_stFId.FId_FuelTFlSys DINH_stFId.FId_FuelTFrzVal DINH_stFId.FId_FuelTReplVal DINH_stFId.FId_GbxNPos DINH_stFId.FId_GbxNPosPWM DINH_stFId.FId_GlbDaLSumvXPtd DINH_stFId.FId_GlwCtl1 DINH_stFId.FId_HLSDemDfrstI DINH_stFId.FId_HLSDemSetPLoDrvAwy DINH_stFId.FId_HLSDemUndrBrk DINH_stFId.FId_ISCnTrbnMod DINH_stFId.FId_ISCvBd DINH_stFId.FId_IVPSplyDCDCOff DINH_stFId.FId_InhibitNever DINH_stFId.FId_InjCrvCoErr DINH_stFId.FId_InjCrvDisblPoI1 DINH_stFId.FId_InjCrvDisblPoI2 DINH_stFId.FId_InjSys_qLimErr DINH_stFId.FId_InjSysqFuelT DINH_stFId.FId_InjUnStrtPlsBlk DINH_stFId.FId_InjVlvPresMin DINH_stFId.FId_LSUAllChecks0 DINH_stFId.FId_LSUAllChecks1 DINH_stFId.FId_LSUClbSched DINH_stFId.FId_LSUCmpChk0 DINH_stFId.FId_LSUCmpChk1 DINH_stFId.FId_LSUCtl0 DINH_stFId.FId_LSUCtl1 DINH_stFId.FId_LSUMon0 DINH_stFId.FId_LSUMon1 DINH_stFId.FId_LSUO20 DINH_stFId.FId_LSUO21 DINH_stFId.FId_LSURi0 DINH_stFId.FId_LSURi1 DINH_stFId.FId_LSUactiv0 DINH_stFId.FId_LSUactiv1 DINH_stFId.FId_LSUlsu0 DINH_stFId.FId_LSUlsu1 DINH_stFId.FId_MeUnFrzI DINH_stFId.FId_MeUnRot DINH_stFId.FId_NplPAirFltDs DINH_stFId.FId_NplTOxiCatUs DINH_stFId.FId_NplTPFltUs DINH_stFId.FId_OilTCANFrzVal DINH_stFId.FId_OilTCANRplVal DINH_stFId.FId_OilTFrzVal DINH_stFId.FId_OilTModel DINH_stFId.FId_OilTNpl DINH_stFId.FId_OilTRplVal DINH_stFId.FId_OilTSS DINH_stFId.FId_PAirFltDsCANFrzVal DINH_stFId.FId_PAirFltDsCANRplVal DINH_stFId.FId_PCACDsCANFrzVal DINH_stFId.FId_PCACDsCANRplVal DINH_stFId.FId_PCACDsEnvPPls DINH_stFId.FId_PCACDsFrzVal DINH_stFId.FId_PCACDsModel DINH_stFId.FId_PCACDsRplVal DINH_stFId.FId_PCACDsSS DINH_stFId.FId_PCR DINH_stFId.FId_PCRCByVlvOff DINH_stFId.FId_PCRCmpntActv DINH_stFId.FId_PCRCmpntActvLP DINH_stFId.FId_PCRExtnLimActr DINH_stFId.FId_PCRGovDvt DINH_stFId.FId_PCRGovDvtLP DINH_stFId.FId_PCRLP DINH_stFId.FId_PCROfsRls DINH_stFId.FId_PCRPFltPresCor DINH_stFId.FId_PCVFrzI DINH_stFId.FId_PCVPwrStgTst DINH_stFId.FId_PFltAirSysFail DINH_stFId.FId_PFltChar DINH_stFId.FId_PFltDstr DINH_stFId.FId_PFltLckRgnErr DINH_stFId.FId_PFltLckRgnFl DINH_stFId.FId_PFltLdSimRgnThr DINH_stFId.FId_PFltPOpBrk DINH_stFId.FId_PFltPOpClth DINH_stFId.FId_PFltPOpGearDet DINH_stFId.FId_PFltPOpSpdVeh DINH_stFId.FId_PFltPOpTempAir DINH_stFId.FId_PFltPOpTempClnt DINH_stFId.FId_PFltPOpVltgBatt DINH_stFId.FId_PFltPoI1Fail DINH_stFId.FId_PFltPoI2Fail DINH_stFId.FId_PFltRgnChngPar DINH_stFId.FId_PFltSimOn DINH_stFId.FId_PFltSrvRgnRlsEng DINH_stFId.FId_PFltSrvRgnRlsPFlt DINH_stFId.FId_PFltSysFail DINH_stFId.FId_PTGripDebPtd DINH_stFId.FId_PTTrqRatCANPtd DINH_stFId.FId_PresSensFrzPPFltUs DINH_stFId.FId_QWCCTSDef DINH_stFId.FId_QWCFTSDef DINH_stFId.FId_QWCOff DINH_stFId.FId_RadShtCTS DINH_stFId.FId_RadShtEGS DINH_stFId.FId_RailCPCtlMeUnMode DINH_stFId.FId_RailCPCtlPCVMode DINH_stFId.FId_RailCtlMode DINH_stFId.FId_RailFuelTErr DINH_stFId.FId_RailMeUn0Blk DINH_stFId.FId_RailMeUn0Rls DINH_stFId.FId_RailMeUn1Blk DINH_stFId.FId_RailMeUn1Rls DINH_stFId.FId_RailMeUn2Blk DINH_stFId.FId_RailMeUn2Rls DINH_stFId.FId_RailMeUn3Blk DINH_stFId.FId_RailMeUn3Rls DINH_stFId.FId_RailMeUn4Blk DINH_stFId.FId_RailMeUn4Rls DINH_stFId.FId_RailMeUnCtlMode DINH_stFId.FId_RailPCV0Blk DINH_stFId.FId_RailPCV0Rls DINH_stFId.FId_RailPCV1Blk DINH_stFId.FId_RailPCV1Rls DINH_stFId.FId_RailPCV2Blk DINH_stFId.FId_RailPCV2Rls DINH_stFId.FId_RailPCV3Blk DINH_stFId.FId_RailPCV3Rls DINH_stFId.FId_RailPCV4Blk DINH_stFId.FId_RailPCV4Rls DINH_stFId.FId_RailPCVCtlMode DINH_stFId.FId_RailPFrzVal DINH_stFId.FId_RailPMonStrt DINH_stFId.FId_RailPSS DINH_stFId.FId_RailPSubsVal DINH_stFId.FId_RailSetPointLim DINH_stFId.FId_RailSetPointRed DINH_stFId.FId_ReplValTPFltUs DINH_stFId.FId_RplValPAirFltDs DINH_stFId.FId_RplValPPFltUs DINH_stFId.FId_RplValTOxiCatUs DINH_stFId.FId_SRCFlwRstn DINH_stFId.FId_SSEStart DINH_stFId.FId_SSEStartAST DINH_stFId.FId_SSEStartMTClPressed10 DINH_stFId.FId_SSEStartMTClPressed90 DINH_stFId.FId_SSEStop DINH_stFId.FId_SSEStopAST DINH_stFId.FId_SSEStopMT DINH_stFId.FId_SSPAirFltDs DINH_stFId.FId_SSTOxiCatUs DINH_stFId.FId_SSTPFltUs DINH_stFId.FId_SensAdapTPFltUs DINH_stFId.FId_StAPmp DINH_stFId.FId_StDa DINH_stFId.FId_SubsValPrtTrqDfftl DINH_stFId.FId_SubsValRatTrqDfftl DINH_stFId.FId_T15 DINH_stFId.FId_T50Sig DINH_stFId.FId_TAFSFrzVal DINH_stFId.FId_TAFSReplVal DINH_stFId.FId_TAFSSRC DINH_stFId.FId_TCACDsCANFrzVal DINH_stFId.FId_TCACDsCANRplVal DINH_stFId.FId_TCACDsFrzVal DINH_stFId.FId_TCACDsModel DINH_stFId.FId_TCACDsRplVal DINH_stFId.FId_TCACDsSS DINH_stFId.FId_TCPrtChrgPmpCtl DINH_stFId.FId_TCPrtChrgPmpGov DINH_stFId.FId_TCPrtChrgPmpHLSDem DINH_stFId.FId_TCPrt_ChrgPmpDet DINH_stFId.FId_TCSRmpShOff DINH_stFId.FId_TCSShOff DINH_stFId.FId_TECUFrzVal DINH_stFId.FId_TECURplVal DINH_stFId.FId_TOxiCatUs DINH_stFId.FId_TempSensFrzPPFltUs DINH_stFId.FId_ThrVlvFrzVal DINH_stFId.FId_ThrVlvRplVal DINH_stFId.FId_ThrVlvSS DINH_stFId.FId_TraAddAirCANPtd DINH_stFId.FId_TraAddClntCANPtd DINH_stFId.FId_TraDrvAway DINH_stFId.FId_TraDrvAwayInactiv DINH_stFId.FId_TraGearInfoDet DINH_stFId.FId_TraGearInfoInfoCan DINH_stFId.FId_TraGearInfoLevPos DINH_stFId.FId_TraGearInfoLoRng DINH_stFId.FId_TraGearInfoRTra DINH_stFId.FId_TraGearInfoRevGear DINH_stFId.FId_TraGripDeb DINH_stFId.FId_TraOilTemp DINH_stFId.FId_TraPrtGearCANPtd DINH_stFId.FId_TraRtnIntfcASTIntv DINH_stFId.FId_TraRtnIntfcIdlSetP DINH_stFId.FId_TraTrqLimErr DINH_stFId.FId_TraTrqLos DINH_stFId.FId_TraTrqRedLmpHmeDec DINH_stFId.FId_TraTrqRedLmpHmeInc DINH_stFId.FId_TraTrqRedPlausDecIntv DINH_stFId.FId_TraTrqRedPlausIncIntv DINH_stFId.FId_TrbChPWMIn DINH_stFId.FId_VSwCtl DINH_stFId.FId_VSwVlvFrzVal DINH_stFId.FId_VSwVlvGovOn DINH_stFId.FId_VSwVlvOfsLrnInhib DINH_stFId.FId_VSwVlvOpnLd DINH_stFId.FId_VSwVlvRplVal DINH_stFId.FId_VSwVlvSS DINH_stFId.FId_VehMotvBd DINH_stFId.FId_VehVCANFrzVal DINH_stFId.FId_VehVCANReplVal DINH_stFId.FId_VehVFrzVal DINH_stFId.FId_VehVMon DINH_stFId.FId_VehVReplVal DINH_stFId.FId_ZFCClbActv DINH_stFId.FId_ZFCCldCmbCham DINH_stFId.FId_stAVSCoESLSU DINH_stFId.Fid_HLSDemHDC DINH_stFId.Fid_StSysStrtTipGbxDat DINH_stFId.Fid_WaHtShOffErr /end OUT_MEASUREMENT
/end FUNCTION
/begin COMPU_METHOD DEFAULT_FORMULA "DEFAULT_FORMULA" RAT_FUNC "%7.0" "" COEFFS 0 1 0 0 0 1 /end COMPU_METHOD
/begin COMPU_METHOD DFC_OneToOne "" RAT_FUNC "%8.3" "-" COEFFS 0 1 0 0 0 1 /end COMPU_METHOD
/begin COMPU_METHOD DFES_OneToOne "" RAT_FUNC "%6.2" "-" COEFFS 0 1 0 0 0 1 /end COMPU_METHOD
/begin COMPU_METHOD RmpTrqPrpHigh "" RAT_FUNC "%6.4" "Nm/s" COEFFS 0 655.36 0 0 0 1 /end COMPU_METHOD
/begin COMPU_METHOD TransR "" RAT_FUNC "%6.4" "-" COEFFS 0 100 0 0 0 1 /end COMPU_METHOD
/begin COMPU_METHOD TrqPrp "" RAT_FUNC "%6.2" "Nm" COEFFS 0 0.625 0 0 0 1 /end COMPU_METHOD
/begin COMPU_METHOD TrqPrpHigh "" RAT_FUNC "%6.3" "Nm" COEFFS 0 10 0 0 0 1 /end COMPU_METHOD
/begin RECORD_LAYOUT Kw_Ws16 FNC_VALUES 1 SWORD COLUMN_DIR DIRECT /end RECORD_LAYOUT
/begin RECORD_LAYOUT Kw_Ws32 FNC_VALUES 1 SLONG COLUMN_DIR DIRECT /end RECORD_LAYOUT
/begin RECORD_LAYOUT Val_Wu8 FNC_VALUES 1 UBYTE COLUMN_DIR DIRECT /end RECORD_LAYOUT
/end MODULE
/end PROJECT
