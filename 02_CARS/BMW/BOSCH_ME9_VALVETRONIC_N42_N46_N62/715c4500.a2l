ASAP2_VERSION 1 3
/begin PROJECT _715C4500 "basisme9"
/begin HEADER "" VERSION "_715C4500" PROJECT_NO _715C4500 /end HEADER
/begin MODULE DIM ""
/begin MOD_COMMON "" BYTE_ORDER MSB_FIRST ALIGNMENT_BYTE 1 ALIGNMENT_WORD 2 ALIGNMENT_LONG 2 ALIGNMENT_FLOAT32_IEEE 4 /end MOD_COMMON
/begin CHARACTERISTIC CDCAAA "Dummy: Tabellenanfang" VAL_BLK 0xFD0A9C KwbUw 65535.00 dez 0.00 65535.00 FORMAT "%8.2" NUMBER 4 /end CHARACTERISTIC
/begin CHARACTERISTIC CDCAS "Codewort CARB: ASR - Eingriff" VAL_BLK 0xFD0AC4 KwbWU16 65535.00 dez 0.00 65535.00 FORMAT "%8.2" NUMBER 4 /end CHARACTERISTIC
/begin CHARACTERISTIC CDCBKVPE "Codewort CARB: BKVPE (Bremskraftverst‰rker Pumpe)" VAL_BLK 0xFD0AD4 KwbWU16 65535.00 dez 0.00 65535.00 FORMAT "%8.2" NUMBER 4 /end CHARACTERISTIC
/begin CHARACTERISTIC CDCBM "Codewort CARB: Bezugsmarkengeber" VAL_BLK 0xFD0ADC KwbUw 65535.00 dez 0.00 65535.00 FORMAT "%8.2" NUMBER 4 /end CHARACTERISTIC
/begin CHARACTERISTIC CDCCANA "" VAL_BLK 0xFD0AF4 KwbWU16 65535.00 dez 0.00 65535.00 FORMAT "%8.2" NUMBER 4 /end CHARACTERISTIC
/begin CHARACTERISTIC CDCCAS "Codewort CARB: CAN-Schnittstelle, Timeout ASC" VAL_BLK 0xFD0AFC KwbWU16 65535.00 dez 0.00 65535.00 FORMAT "%8.2" NUMBER 4 /end CHARACTERISTIC
/begin CHARACTERISTIC CDCCEZ "" VAL_BLK 0xFD0B04 KwbWU16 65535.00 dez 0.00 65535.00 FORMAT "%8.2" NUMBER 4 /end CHARACTERISTIC
/begin CHARACTERISTIC CDCCGE "Codewort CARB: CAN-Schnittstelle, Timeout EGS" VAL_BLK 0xFD0B0C KwbWU16 65535.00 dez 0.00 65535.00 FORMAT "%8.2" NUMBER 4 /end CHARACTERISTIC
/begin CHARACTERISTIC CDCCINS "Codewort CARB: CAN-Schnittstelle, Timeout Instrument" VAL_BLK 0xFD0B14 KwbWU16 65535.00 dez 0.00 65535.00 FORMAT "%8.2" NUMBER 4 /end CHARACTERISTIC
/begin CHARACTERISTIC CDCCOD "Tabelle Umweltbedingungen: Steuerger‰t noch nicht codiert" VAL_BLK 0xFD0B1C KwbWU16 65535.00 dez 0.00 65535.00 FORMAT "%8.2" NUMBER 4 /end CHARACTERISTIC
/begin CHARACTERISTIC CDCDISA "" VAL_BLK 0xFD0B3C KwbWU16 65535.00 dez 0.00 65535.00 FORMAT "%8.2" NUMBER 4 /end CHARACTERISTIC
/begin CHARACTERISTIC CDCDK "Codewort CARB:	DK - Potentiometer" VAL_BLK 0xFD0B44 KwbUw 65535.00 dez 0.00 65535.00 FORMAT "%8.2" NUMBER 4 /end CHARACTERISTIC
/begin CHARACTERISTIC CDCDK1P "Codewort CARB: Drosselklappe 1. Poti" VAL_BLK 0xFD0B4C KwbUw 65535.00 dez 0.00 65535.00 FORMAT "%8.2" NUMBER 4 /end CHARACTERISTIC
/begin CHARACTERISTIC CDCDK2P "Codewort CARB: Drosselklappe 2. Poti" VAL_BLK 0xFD0B54 KwbUw 65535.00 dez 0.00 65535.00 FORMAT "%8.2" NUMBER 4 /end CHARACTERISTIC
/begin CHARACTERISTIC CDCDVEE "Codewort CARB: DV-E Endstufe" VAL_BLK 0xFD0B7C KwbUw 65535.00 dez 0.00 65535.00 FORMAT "%8.2" NUMBER 4 /end CHARACTERISTIC
/begin CHARACTERISTIC CDCDVEF "Codewort CARB: DV-E Fehler bei Federpr¸fung" VAL_BLK 0xFD0B84 KwbUw 65535.00 dez 0.00 65535.00 FORMAT "%8.2" NUMBER 4 /end CHARACTERISTIC
/begin CHARACTERISTIC CDCDVEFO "" VAL_BLK 0xFD0B8C KwbUw 65535.00 dez 0.00 65535.00 FORMAT "%8.2" NUMBER 4 /end CHARACTERISTIC
/begin CHARACTERISTIC CDCDVEL "Codewort CARB: DV-E Lageabweichung" VAL_BLK 0xFD0B94 KwbUw 65535.00 dez 0.00 65535.00 FORMAT "%8.2" NUMBER 4 /end CHARACTERISTIC
/begin CHARACTERISTIC CDCDVEN "Codewort CARB: DV-E Fehler bei Pr¸fung Notluftposition" VAL_BLK 0xFD0B9C KwbUw 65535.00 dez 0.00 65535.00 FORMAT "%8.2" NUMBER 4 /end CHARACTERISTIC
/begin CHARACTERISTIC CDCDVER "Codewort CARB: DV-E Regelbereich" VAL_BLK 0xFD0BA4 KwbUw 65535.00 dez 0.00 65535.00 FORMAT "%8.2" NUMBER 4 /end CHARACTERISTIC
/begin CHARACTERISTIC CDCDVET "" VAL_BLK 0xFD0BAC KwbUw 65535.00 dez 0.00 65535.00 FORMAT "%8.2" NUMBER 4 /end CHARACTERISTIC
/begin CHARACTERISTIC CDCDVEU "Codewort CARB: DV-E Fehler beim UMA-Lernen" VAL_BLK 0xFD0BB4 KwbUw 65535.00 dez 0.00 65535.00 FORMAT "%8.2" NUMBER 4 /end CHARACTERISTIC
/begin CHARACTERISTIC CDCDVEUB "" VAL_BLK 0xFD0BBC KwbUw 65535.00 dez 0.00 65535.00 FORMAT "%8.2" NUMBER 4 /end CHARACTERISTIC
/begin CHARACTERISTIC CDCDVEUW "" VAL_BLK 0xFD0BC4 KwbUw 65535.00 dez 0.00 65535.00 FORMAT "%8.2" NUMBER 4 /end CHARACTERISTIC
/begin CHARACTERISTIC CDCDVEV "Codewort CARB: DV-E Fehler bei Verst‰rkerabgleich" VAL_BLK 0xFD0BCC KwbUw 65535.00 dez 0.00 65535.00 FORMAT "%8.2" NUMBER 4 /end CHARACTERISTIC
/begin CHARACTERISTIC CDCELS "Codewort CARB: Elektrischer E-Box L¸fter" VAL_BLK 0xFD0C24 KwbWU16 65535.00 dez 0.00 65535.00 FORMAT "%8.2" NUMBER 4 /end CHARACTERISTIC
/begin CHARACTERISTIC CDCETS "Codewort CARB: Elektrisches Thermostat" VAL_BLK 0xFD0C3C KwbWU16 65535.00 dez 0.00 65535.00 FORMAT "%8.2" NUMBER 4 /end CHARACTERISTIC
/begin CHARACTERISTIC CDCEV1 "Codewort CARB: EV von Zyl. 1" VAL_BLK 0xFD0C44 KwbWU16 65535.00 dez 0.00 65535.00 FORMAT "%8.2" NUMBER 4 /end CHARACTERISTIC
/begin CHARACTERISTIC CDCEV2 "Codewort CARB: EV von Zyl. 2" VAL_BLK 0xFD0C4C KwbWU16 65535.00 dez 0.00 65535.00 FORMAT "%8.2" NUMBER 4 /end CHARACTERISTIC
/begin CHARACTERISTIC CDCEV3 "Codewort CARB: EV von Zyl. 3" VAL_BLK 0xFD0C54 KwbWU16 65535.00 dez 0.00 65535.00 FORMAT "%8.2" NUMBER 4 /end CHARACTERISTIC
/begin CHARACTERISTIC CDCEV4 "Codewort CARB: EV von Zyl. 4" VAL_BLK 0xFD0C5C KwbWU16 65535.00 dez 0.00 65535.00 FORMAT "%8.2" NUMBER 4 /end CHARACTERISTIC
/begin CHARACTERISTIC CDCEZH "" VAL_BLK 0xFD0C84 KwbWU16 65535.00 dez 0.00 65535.00 FORMAT "%8.2" NUMBER 4 /end CHARACTERISTIC
/begin CHARACTERISTIC CDCHSH "Codewort CARB:	Lambdasonden-Heizung hinter Katalysator" VAL_BLK 0xFD0CC4 KwbWU16 65535.00 dez 0.00 65535.00 FORMAT "%8.2" NUMBER 4 /end CHARACTERISTIC
/begin CHARACTERISTIC CDCHSH2 "Codewort CARB:	Lambdasonden-Heizung hinter Katalysator; (Bank2)" VAL_BLK 0xFD0CCC KwbWU16 65535.00 dez 0.00 65535.00 FORMAT "%8.2" NUMBER 4 /end CHARACTERISTIC
/begin CHARACTERISTIC CDCHSV "Codewort CARB:	Lambdasonden-Heizung vor Katalysator" VAL_BLK 0xFD0CD4 KwbWU16 65535.00 dez 0.00 65535.00 FORMAT "%8.2" NUMBER 4 /end CHARACTERISTIC
/begin CHARACTERISTIC CDCHSV2 "Codewort CARB:	Lambdasonden-Heizung vor Katalysator; (Bank2)" VAL_BLK 0xFD0CDC KwbWU16 65535.00 dez 0.00 65535.00 FORMAT "%8.2" NUMBER 4 /end CHARACTERISTIC
/begin CHARACTERISTIC CDCKAT "Codewort CARB:	Katalysator-Konvertierung" VAL_BLK 0xFD0CEC KwbWU16 65535.00 dez 0.00 65535.00 FORMAT "%8.2" NUMBER 4 /end CHARACTERISTIC
/begin CHARACTERISTIC CDCKKUE "Codewort CARB: Kraftstoffkreislauf-Umschaltung Endstufe" VAL_BLK 0xFD0CFC KwbUw 65535.00 dez 0.00 65535.00 FORMAT "%8.2" NUMBER 4 /end CHARACTERISTIC
/begin CHARACTERISTIC CDCKOSE "Codewort CARB: Klima- Kompressorsteurung Endstufe" VAL_BLK 0xFD0D04 KwbWU16 65535.00 dez 0.00 65535.00 FORMAT "%8.2" NUMBER 4 /end CHARACTERISTIC
/begin CHARACTERISTIC CDCKPE "Codewort CARB: EKP-Relais Endstufe" VAL_BLK 0xFD0D0C KwbWU16 65535.00 dez 0.00 65535.00 FORMAT "%8.2" NUMBER 4 /end CHARACTERISTIC
/begin CHARACTERISTIC CDCKRNT "Codewort CARB:	Klopfregelung Nulltest" VAL_BLK 0xFD0D14 KwbUw 65535.00 dez 0.00 65535.00 FORMAT "%8.2" NUMBER 4 /end CHARACTERISTIC
/begin CHARACTERISTIC CDCKROF "Codewort CARB: Klopfregelung Offset" VAL_BLK 0xFD0D1C KwbUw 65535.00 dez 0.00 65535.00 FORMAT "%8.2" NUMBER 4 /end CHARACTERISTIC
/begin CHARACTERISTIC CDCLDE "Codewort CARB: Ladedrucksteuerventil (Endstufe)" VAL_BLK 0xFD0D74 KwbUw 65535.00 dez 0.00 65535.00 FORMAT "%8.2" NUMBER 4 /end CHARACTERISTIC
/begin CHARACTERISTIC CDCLDPE "Codewort CARB: Leckdiagnosepumpe Endstufe" VAL_BLK 0xFD0D84 KwbUw 65535.00 dez 0.00 65535.00 FORMAT "%8.2" NUMBER 4 /end CHARACTERISTIC
/begin CHARACTERISTIC CDCLM "Codewort CARB:	LMM/HLM/HFM" VAL_BLK 0xFD0D94 KwbWU16 65535.00 dez 0.00 65535.00 FORMAT "%8.2" NUMBER 4 /end CHARACTERISTIC
/begin CHARACTERISTIC CDCLUEA "Codewort CARB: Endstufe L¸fter A" VAL_BLK 0xFD0DB4 KwbUw 65535.00 dez 0.00 65535.00 FORMAT "%8.2" NUMBER 4 /end CHARACTERISTIC
/begin CHARACTERISTIC CDCLUVE "Codewort CARB: EV-Luftumfassungsventil Endstufe" VAL_BLK 0xFD0DBC KwbUw 65535.00 dez 0.00 65535.00 FORMAT "%8.2" NUMBER 4 /end CHARACTERISTIC
/begin CHARACTERISTIC CDCN "Codewort CARB: Drehzahlsignalgeber" VAL_BLK 0xFD0E4C KwbUw 65535.00 dez 0.00 65535.00 FORMAT "%8.2" NUMBER 4 /end CHARACTERISTIC
/begin CHARACTERISTIC CDCSTAE "Codewort CARB: Startautomatik Endstufe" VAL_BLK 0xFD0EC4 KwbUw 65535.00 dez 0.00 65535.00 FORMAT "%8.2" NUMBER 4 /end CHARACTERISTIC
/begin CHARACTERISTIC CDCSWE "Codewort CARB:	Beschleunigungssensor der Schlechtwegeerkennung" VAL_BLK 0xFD0ED4 KwbWU16 65535.00 dez 0.00 65535.00 FORMAT "%8.2" NUMBER 4 /end CHARACTERISTIC
/begin CHARACTERISTIC CDCZZZ "Dummy: Tabellenende" VAL_BLK 0xFD0F94 KwbUw 65535.00 dez 0.00 65535.00 FORMAT "%8.2" NUMBER 4 /end CHARACTERISTIC
/begin CHARACTERISTIC CDKAAA "Dummy: Tabellenanfang" VALUE 0xFD0F9C KwUw 65535.00 dez 0.00 65535.00 FORMAT "%8.2" /end CHARACTERISTIC
/begin CHARACTERISTIC CDKAS "Codewort Kunde: ASR - Eingriff" VALUE 0xFD0FA6 KwWU16 65535.00 dez 0.00 65535.00 FORMAT "%8.2" /end CHARACTERISTIC
/begin CHARACTERISTIC CDKBKVPE "" VALUE 0xFD0FAA KwWU16 65535.00 dez 0.00 65535.00 FORMAT "%8.2" /end CHARACTERISTIC
/begin CHARACTERISTIC CDKBM "Codewort Kunde: Bezugsmarkengeber" VALUE 0xFD0FAC KwUw 65535.00 dez 0.00 65535.00 FORMAT "%8.2" /end CHARACTERISTIC
/begin CHARACTERISTIC CDKCANA "" VALUE 0xFD0FB2 KwWU16 65535.00 dez 0.00 65535.00 FORMAT "%8.2" /end CHARACTERISTIC
/begin CHARACTERISTIC CDKCAS "Codewort Kunde: CAN-Schnittstelle, Timeout ASC" VALUE 0xFD0FB4 KwWU16 65535.00 dez 0.00 65535.00 FORMAT "%8.2" /end CHARACTERISTIC
/begin CHARACTERISTIC CDKCEZ "" VALUE 0xFD0FB6 KwWU16 65535.00 dez 0.00 65535.00 FORMAT "%8.2" /end CHARACTERISTIC
/begin CHARACTERISTIC CDKCGE "Codewort Kunde: CAN-Schnittstelle, Timeout EGS" VALUE 0xFD0FB8 KwWU16 65535.00 dez 0.00 65535.00 FORMAT "%8.2" /end CHARACTERISTIC
/begin CHARACTERISTIC CDKCINS "Codewort Kunde: CAN- timeout, Instrumente" VALUE 0xFD0FBA KwWU16 65535.00 dez 0.00 65535.00 FORMAT "%8.2" /end CHARACTERISTIC
/begin CHARACTERISTIC CDKCOD "" VALUE 0xFD0FBC KwWU16 65535.00 dez 0.00 65535.00 FORMAT "%8.2" /end CHARACTERISTIC
/begin CHARACTERISTIC CDKDISA "" VALUE 0xFD0FC4 KwWU16 65535.00 dez 0.00 65535.00 FORMAT "%8.2" /end CHARACTERISTIC
/begin CHARACTERISTIC CDKDK "Codewort Kunde: DK - Potentiometer" VALUE 0xFD0FC6 KwUw 65535.00 dez 0.00 65535.00 FORMAT "%8.2" /end CHARACTERISTIC
/begin CHARACTERISTIC CDKDK1P "Codewort Kunde: Drosselklappe 1. Poti" VALUE 0xFD0FC8 KwUw 65535.00 dez 0.00 65535.00 FORMAT "%8.2" /end CHARACTERISTIC
/begin CHARACTERISTIC CDKDK2P "Codewort Kunde: Drosselklappenpotentiometer 2" VALUE 0xFD0FCA KwUw 65535.00 dez 0.00 65535.00 FORMAT "%8.2" /end CHARACTERISTIC
/begin CHARACTERISTIC CDKDVEE "Codewort Kunde: DV-E Endstufe" VALUE 0xFD0FD4 KwUw 65535.00 dez 0.00 65535.00 FORMAT "%8.2" /end CHARACTERISTIC
/begin CHARACTERISTIC CDKDVEF "Codewort Kunde: DV-E Fehler bei Federpr¸fung" VALUE 0xFD0FD6 KwUw 65535.00 dez 0.00 65535.00 FORMAT "%8.2" /end CHARACTERISTIC
/begin CHARACTERISTIC CDKDVEFO "" VALUE 0xFD0FD8 KwUw 65535.00 dez 0.00 65535.00 FORMAT "%8.2" /end CHARACTERISTIC
/begin CHARACTERISTIC CDKDVEL "Codewort Kunde: DV-E Lageabweichung" VALUE 0xFD0FDA KwUw 65535.00 dez 0.00 65535.00 FORMAT "%8.2" /end CHARACTERISTIC
/begin CHARACTERISTIC CDKDVEN "Codewort Kunde: DV-E Fehler bei Pr¸fung Notlufposition" VALUE 0xFD0FDC KwUw 65535.00 dez 0.00 65535.00 FORMAT "%8.2" /end CHARACTERISTIC
/begin CHARACTERISTIC CDKDVER "Codewort Kunde: DV-E Regelbereich" VALUE 0xFD0FDE KwUw 65535.00 dez 0.00 65535.00 FORMAT "%8.2" /end CHARACTERISTIC
/begin CHARACTERISTIC CDKDVET "" VALUE 0xFD0FE0 KwUw 65535.00 dez 0.00 65535.00 FORMAT "%8.2" /end CHARACTERISTIC
/begin CHARACTERISTIC CDKDVEU "Codewort Kunde: DV-E Fehler beim UMA-Lernen" VALUE 0xFD0FE2 KwUw 65535.00 dez 0.00 65535.00 FORMAT "%8.2" /end CHARACTERISTIC
/begin CHARACTERISTIC CDKDVEUB "" VALUE 0xFD0FE4 KwUw 65535.00 dez 0.00 65535.00 FORMAT "%8.2" /end CHARACTERISTIC
/begin CHARACTERISTIC CDKDVEUW "" VALUE 0xFD0FE6 KwUw 65535.00 dez 0.00 65535.00 FORMAT "%8.2" /end CHARACTERISTIC
/begin CHARACTERISTIC CDKDVEV "Codewort Kunde: DV-E Fehler bei Verst‰rkerabgleich" VALUE 0xFD0FE8 KwUw 65535.00 dez 0.00 65535.00 FORMAT "%8.2" /end CHARACTERISTIC
/begin CHARACTERISTIC CDKELS "Codewort Kunde: Elektrischer E-Box L¸fter" VALUE 0xFD0FFE KwWU16 65535.00 dez 0.00 65535.00 FORMAT "%8.2" /end CHARACTERISTIC
/begin CHARACTERISTIC CDKETS "Codewort Kunde: Elektrisches Thermostat" VALUE 0xFD1004 KwWU16 65535.00 dez 0.00 65535.00 FORMAT "%8.2" /end CHARACTERISTIC
/begin CHARACTERISTIC CDKEV1 "Codewort Kunde: EV von Zyl. 1" VALUE 0xFD1006 KwWU16 65535.00 dez 0.00 65535.00 FORMAT "%8.2" /end CHARACTERISTIC
/begin CHARACTERISTIC CDKEV2 "Codewort Kunde: EV von Zyl. 2" VALUE 0xFD1008 KwWU16 65535.00 dez 0.00 65535.00 FORMAT "%8.2" /end CHARACTERISTIC
/begin CHARACTERISTIC CDKEV3 "Codewort Kunde: EV von Zyl. 3" VALUE 0xFD100A KwWU16 65535.00 dez 0.00 65535.00 FORMAT "%8.2" /end CHARACTERISTIC
/begin CHARACTERISTIC CDKEV4 "Codewort Kunde: EV von Zyl. 4" VALUE 0xFD100C KwWU16 65535.00 dez 0.00 65535.00 FORMAT "%8.2" /end CHARACTERISTIC
/begin CHARACTERISTIC CDKEZH "" VALUE 0xFD1016 KwWU16 65535.00 dez 0.00 65535.00 FORMAT "%8.2" /end CHARACTERISTIC
/begin CHARACTERISTIC CDKHSH "Codewort Kunde:Lambdasonden-Heizung hinter Katalysator" VALUE 0xFD1026 KwWU16 65535.00 dez 0.00 65535.00 FORMAT "%8.2" /end CHARACTERISTIC
/begin CHARACTERISTIC CDKHSH2 "Codewort Kunde:	Lambdasonden-Heizung hinter Katalysator, Bank 2" VALUE 0xFD1028 KwWU16 65535.00 dez 0.00 65535.00 FORMAT "%8.2" /end CHARACTERISTIC
/begin CHARACTERISTIC CDKHSV "Codewort Kunde: Lambdasonden-Heizung vor Katalysator" VALUE 0xFD102A KwWU16 65535.00 dez 0.00 65535.00 FORMAT "%8.2" /end CHARACTERISTIC
/begin CHARACTERISTIC CDKHSV2 "Codewort Kunde:	Lambdasonden-Heizung vor Katalysator, Bank 2" VALUE 0xFD102C KwWU16 65535.00 dez 0.00 65535.00 FORMAT "%8.2" /end CHARACTERISTIC
/begin CHARACTERISTIC CDKKAT "Codewort Kunde:	Katalysator-Konvertierung" VALUE 0xFD1030 KwWU16 65535.00 dez 0.00 65535.00 FORMAT "%8.2" /end CHARACTERISTIC
/begin CHARACTERISTIC CDKKKUE "Codewort Kunde: Kraftstoffkreislauf-Umschaltung Endstufe" VALUE 0xFD1034 KwUw 65535.00 dez 0.00 65535.00 FORMAT "%8.2" /end CHARACTERISTIC
/begin CHARACTERISTIC CDKKOSE "Codewort Kunde: Klima- Kompressorsteurung Endstufe" VALUE 0xFD1036 KwWU16 65535.00 dez 0.00 65535.00 FORMAT "%8.2" /end CHARACTERISTIC
/begin CHARACTERISTIC CDKKPE "Codewort Kunde: EKP-Relais Endstufe" VALUE 0xFD1038 KwWU16 65535.00 dez 0.00 65535.00 FORMAT "%8.2" /end CHARACTERISTIC
/begin CHARACTERISTIC CDKKRNT "Codewort Kunde:	Klopfregelung Nulltest" VALUE 0xFD103A KwUw 65535.00 dez 0.00 65535.00 FORMAT "%8.2" /end CHARACTERISTIC
/begin CHARACTERISTIC CDKKROF "Codewort Kunde:	Klopfregelung Offset" VALUE 0xFD103C KwUw 65535.00 dez 0.00 65535.00 FORMAT "%8.2" /end CHARACTERISTIC
/begin CHARACTERISTIC CDKLDE "Codeword Kunde: Ladedrucksteuerventil (Endstufe)" VALUE 0xFD1052 KwUw 65535.00 dez 0.00 65535.00 FORMAT "%8.2" /end CHARACTERISTIC
/begin CHARACTERISTIC CDKLDPE "Codewort Kunde: Leckdiagnosepumpe Endstufe" VALUE 0xFD1056 KwUw 65535.00 dez 0.00 65535.00 FORMAT "%8.2" /end CHARACTERISTIC
/begin CHARACTERISTIC CDKLM "Codewort Kunde:	LMM/HLM/HFM" VALUE 0xFD105A KwWU16 65535.00 dez 0.00 65535.00 FORMAT "%8.2" /end CHARACTERISTIC
/begin CHARACTERISTIC CDKLUEA "Codewort Kunde:	Endstufe L¸fter A" VALUE 0xFD1062 KwUw 65535.00 dez 0.00 65535.00 FORMAT "%8.2" /end CHARACTERISTIC
/begin CHARACTERISTIC CDKLUVE "Codewort Kunde: EV-Luftumfassungsventil Endstufe" VALUE 0xFD1064 KwUw 65535.00 dez 0.00 65535.00 FORMAT "%8.2" /end CHARACTERISTIC
/begin CHARACTERISTIC CDKN "Codewort Kunde: Drehzahlsignalgeber" VALUE 0xFD1088 KwUw 65535.00 dez 0.00 65535.00 FORMAT "%8.2" /end CHARACTERISTIC
/begin CHARACTERISTIC CDKSTAE "Codewort Kunde: Startautomatik (Endstufe)" VALUE 0xFD10A6 KwUw 65535.00 dez 0.00 65535.00 FORMAT "%8.2" /end CHARACTERISTIC
/begin CHARACTERISTIC CDKSWE "Codewort Kunde:	Beschleunigungssensor der Schlechtwegeerkennung" VALUE 0xFD10AA KwWU16 65535.00 dez 0.00 65535.00 FORMAT "%8.2" /end CHARACTERISTIC
/begin CHARACTERISTIC CDKZZZ "Dummy: Tabellenendeng" VALUE 0xFD10DA KwUw 65535.00 dez 0.00 65535.00 FORMAT "%8.2" /end CHARACTERISTIC
/begin CHARACTERISTIC CDTAAA "Dummy: Tabellenanfang" VALUE 0xFD10DC KwUw 65535.00 dez 0.00 65535.00 FORMAT "%8.2" /end CHARACTERISTIC
/begin CHARACTERISTIC CDTAS "Codewort Tester: ASR - Eingriff" VALUE 0xFD10E6 KwWU16 65535.00 dez 0.00 65535.00 FORMAT "%8.2" /end CHARACTERISTIC
/begin CHARACTERISTIC CDTBKVPE "" VALUE 0xFD10EA KwWU16 65535.00 dez 0.00 65535.00 FORMAT "%8.2" /end CHARACTERISTIC
/begin CHARACTERISTIC CDTBM "Codewort Tester: Bezugsmarkengeber" VALUE 0xFD10EC KwUw 65535.00 dez 0.00 65535.00 FORMAT "%8.2" /end CHARACTERISTIC
/begin CHARACTERISTIC CDTCANA "" VALUE 0xFD10F2 KwWU16 65535.00 dez 0.00 65535.00 FORMAT "%8.2" /end CHARACTERISTIC
/begin CHARACTERISTIC CDTCAS "Codewort Tester: CAN-Schnittstelle, Timeout ASC" VALUE 0xFD10F4 KwWU16 65535.00 dez 0.00 65535.00 FORMAT "%8.2" /end CHARACTERISTIC
/begin CHARACTERISTIC CDTCEZ "" VALUE 0xFD10F6 KwWU16 65535.00 dez 0.00 65535.00 FORMAT "%8.2" /end CHARACTERISTIC
/begin CHARACTERISTIC CDTCGE "Codewort Tester: CAN-Schnittstelle, Timeout EGS" VALUE 0xFD10F8 KwWU16 65535.00 dez 0.00 65535.00 FORMAT "%8.2" /end CHARACTERISTIC
/begin CHARACTERISTIC CDTCINS "Codewort Tester: CAN-Timeout, Instrumente" VALUE 0xFD10FA KwWU16 65535.00 dez 0.00 65535.00 FORMAT "%8.2" /end CHARACTERISTIC
/begin CHARACTERISTIC CDTCOD "Codewort Tester: Steuerger‰t noch nicht codiert" VALUE 0xFD10FC KwWU16 65535.00 dez 0.00 65535.00 FORMAT "%8.2" /end CHARACTERISTIC
/begin CHARACTERISTIC CDTDISA "" VALUE 0xFD1104 KwWU16 65535.00 dez 0.00 65535.00 FORMAT "%8.2" /end CHARACTERISTIC
/begin CHARACTERISTIC CDTDK "Codewort Tester: DK - Potentiometer" VALUE 0xFD1106 KwUw 65535.00 dez 0.00 65535.00 FORMAT "%8.2" /end CHARACTERISTIC
/begin CHARACTERISTIC CDTDK1P "Codewort Tester: Drosselklappe 1. Poti" VALUE 0xFD1108 KwUw 65535.00 dez 0.00 65535.00 FORMAT "%8.2" /end CHARACTERISTIC
/begin CHARACTERISTIC CDTDK2P "Codewort Tester: Drosselklappenpotentiometer 2" VALUE 0xFD110A KwUw 65535.00 dez 0.00 65535.00 FORMAT "%8.2" /end CHARACTERISTIC
/begin CHARACTERISTIC CDTDVEE "Codewort Tester: DV-E Endstufe" VALUE 0xFD1114 KwUw 65535.00 dez 0.00 65535.00 FORMAT "%8.2" /end CHARACTERISTIC
/begin CHARACTERISTIC CDTDVEF "Codewort Tester: DV-E Fehler bei Federpr¸fung" VALUE 0xFD1116 KwUw 65535.00 dez 0.00 65535.00 FORMAT "%8.2" /end CHARACTERISTIC
/begin CHARACTERISTIC CDTDVEFO "" VALUE 0xFD1118 KwUw 65535.00 dez 0.00 65535.00 FORMAT "%8.2" /end CHARACTERISTIC
/begin CHARACTERISTIC CDTDVEL "Codewort Tester: DV-E Lageabweichung" VALUE 0xFD111A KwUw 65535.00 dez 0.00 65535.00 FORMAT "%8.2" /end CHARACTERISTIC
/begin CHARACTERISTIC CDTDVEN "Codewort Tester: DV-E Fehler bei Pr¸fung Notlufposition" VALUE 0xFD111C KwUw 65535.00 dez 0.00 65535.00 FORMAT "%8.2" /end CHARACTERISTIC
/begin CHARACTERISTIC CDTDVER "Codewort Tester: DV-E Regelbereich" VALUE 0xFD111E KwUw 65535.00 dez 0.00 65535.00 FORMAT "%8.2" /end CHARACTERISTIC
/begin CHARACTERISTIC CDTDVET "" VALUE 0xFD1120 KwUw 65535.00 dez 0.00 65535.00 FORMAT "%8.2" /end CHARACTERISTIC
/begin CHARACTERISTIC CDTDVEU "Codewort Tester: DV-E Fehler beim UMA-Lernen" VALUE 0xFD1122 KwUw 65535.00 dez 0.00 65535.00 FORMAT "%8.2" /end CHARACTERISTIC
/begin CHARACTERISTIC CDTDVEUB "" VALUE 0xFD1124 KwUw 65535.00 dez 0.00 65535.00 FORMAT "%8.2" /end CHARACTERISTIC
/begin CHARACTERISTIC CDTDVEUW "" VALUE 0xFD1126 KwUw 65535.00 dez 0.00 65535.00 FORMAT "%8.2" /end CHARACTERISTIC
/begin CHARACTERISTIC CDTDVEV "Codewort Tester: DV-E Fehler bei Verst‰rkerabgleich" VALUE 0xFD1128 KwUw 65535.00 dez 0.00 65535.00 FORMAT "%8.2" /end CHARACTERISTIC
/begin CHARACTERISTIC CDTELS "Codewort Tester: Elektrischer E-Box L¸fter" VALUE 0xFD113E KwWU16 65535.00 dez 0.00 65535.00 FORMAT "%8.2" /end CHARACTERISTIC
/begin CHARACTERISTIC CDTETS "Codewort Tester: Elektrisches Thermostat" VALUE 0xFD1144 KwWU16 65535.00 dez 0.00 65535.00 FORMAT "%8.2" /end CHARACTERISTIC
/begin CHARACTERISTIC CDTEV1 "Codewort Tester: EV von Zyl. 1" VALUE 0xFD1146 KwWU16 65535.00 dez 0.00 65535.00 FORMAT "%8.2" /end CHARACTERISTIC
/begin CHARACTERISTIC CDTEV2 "Codewort Tester: EV von Zyl. 2" VALUE 0xFD1148 KwWU16 65535.00 dez 0.00 65535.00 FORMAT "%8.2" /end CHARACTERISTIC
/begin CHARACTERISTIC CDTEV3 "Codewort Tester: EV von Zyl. 3" VALUE 0xFD114A KwWU16 65535.00 dez 0.00 65535.00 FORMAT "%8.2" /end CHARACTERISTIC
/begin CHARACTERISTIC CDTEV4 "Codewort Tester: EV von Zyl. 4" VALUE 0xFD114C KwWU16 65535.00 dez 0.00 65535.00 FORMAT "%8.2" /end CHARACTERISTIC
/begin CHARACTERISTIC CDTEZH "" VALUE 0xFD1156 KwWU16 65535.00 dez 0.00 65535.00 FORMAT "%8.2" /end CHARACTERISTIC
/begin CHARACTERISTIC CDTHSH "Codewort Tester: Lambdasonden-Heizung hinter Katalysator" VALUE 0xFD1166 KwWU16 65535.00 dez 0.00 65535.00 FORMAT "%8.2" /end CHARACTERISTIC
/begin CHARACTERISTIC CDTHSH2 "Codewort Tester: Lambdasonden-Heizung hinter Kat., Bank 2" VALUE 0xFD1168 KwWU16 65535.00 dez 0.00 65535.00 FORMAT "%8.2" /end CHARACTERISTIC
/begin CHARACTERISTIC CDTHSV "Codewort Tester: Lambdasonden-Heizung vor Katalysator" VALUE 0xFD116A KwWU16 65535.00 dez 0.00 65535.00 FORMAT "%8.2" /end CHARACTERISTIC
/begin CHARACTERISTIC CDTHSV2 "Codewort Tester: Lambdasonden-Heizung vor Kat., Bank 2" VALUE 0xFD116C KwWU16 65535.00 dez 0.00 65535.00 FORMAT "%8.2" /end CHARACTERISTIC
/begin CHARACTERISTIC CDTKAT "Codewort Tester: Katalysator-Konvertierung" VALUE 0xFD1170 KwWU16 65535.00 dez 0.00 65535.00 FORMAT "%8.2" /end CHARACTERISTIC
/begin CHARACTERISTIC CDTKKUE "Codewort Tester: Kraftstoffkreislauf-Umschaltung Endstufe" VALUE 0xFD1174 KwUw 65535.00 dez 0.00 65535.00 FORMAT "%8.2" /end CHARACTERISTIC
/begin CHARACTERISTIC CDTKOSE "Codewort Tester: Klima- Kompressorsteurung Endstufe" VALUE 0xFD1176 KwWU16 65535.00 dez 0.00 65535.00 FORMAT "%8.2" /end CHARACTERISTIC
/begin CHARACTERISTIC CDTKPE "Codewort Tester: EKP-Relais Endstufe" VALUE 0xFD1178 KwWU16 65535.00 dez 0.00 65535.00 FORMAT "%8.2" /end CHARACTERISTIC
/begin CHARACTERISTIC CDTKRNT "Codewort Tester: Klopfregelung Nulltest" VALUE 0xFD117A KwUw 65535.00 dez 0.00 65535.00 FORMAT "%8.2" /end CHARACTERISTIC
/begin CHARACTERISTIC CDTKROF "Codewort Tester: Klopfregelung Offset" VALUE 0xFD117C KwUw 65535.00 dez 0.00 65535.00 FORMAT "%8.2" /end CHARACTERISTIC
/begin CHARACTERISTIC CDTLDE "Codewort Tester: Ladedrucksteuerventil (Endstufe)" VALUE 0xFD1192 KwUw 65535.00 dez 0.00 65535.00 FORMAT "%8.2" /end CHARACTERISTIC
/begin CHARACTERISTIC CDTLDPE "Codewort Tester: Leckdiagnosepumpe Endstufe" VALUE 0xFD1196 KwUw 65535.00 dez 0.00 65535.00 FORMAT "%8.2" /end CHARACTERISTIC
/begin CHARACTERISTIC CDTLM "Codewort Tester: LMM/HLM/HFM" VALUE 0xFD119A KwWU16 65535.00 dez 0.00 65535.00 FORMAT "%8.2" /end CHARACTERISTIC
/begin CHARACTERISTIC CDTLUEA "Codewort Tester: Endstufe L¸fter A" VALUE 0xFD11A2 KwUw 65535.00 dez 0.00 65535.00 FORMAT "%8.2" /end CHARACTERISTIC
/begin CHARACTERISTIC CDTLUVE "Codewort Tester: EV-Luftumfassungsventil Endstufe" VALUE 0xFD11A4 KwUw 65535.00 dez 0.00 65535.00 FORMAT "%8.2" /end CHARACTERISTIC
/begin CHARACTERISTIC CDTN "Codewort Tester: Drehzahlsignalgeber" VALUE 0xFD11C8 KwUw 65535.00 dez 0.00 65535.00 FORMAT "%8.2" /end CHARACTERISTIC
/begin CHARACTERISTIC CDTSTAE "Codewort Tester: Startautomatik     (Endstufe)" VALUE 0xFD11E6 KwUw 65535.00 dez 0.00 65535.00 FORMAT "%8.2" /end CHARACTERISTIC
/begin CHARACTERISTIC CDTSWE "Codewort Tester: Beschleunigungssensor Schlechtwegeerk." VALUE 0xFD11EA KwWU16 65535.00 dez 0.00 65535.00 FORMAT "%8.2" /end CHARACTERISTIC
/begin CHARACTERISTIC CDTZZZ "Dummy: Tabellenende" VALUE 0xFD121A KwUw 65535.00 dez 0.00 65535.00 FORMAT "%8.2" /end CHARACTERISTIC
/begin CHARACTERISTIC CLAAAA "Dummy: Tabellenanfang" VALUE 0xFD06DA KwUb 255.0 dez 0.00 255.0 FORMAT "%5.1" /end CHARACTERISTIC
/begin CHARACTERISTIC CLAAS "Fehlerklasse: ASR- Eingriff" VALUE 0xFD06DF KwWU8 255.0 dez 0.00 255.0 FORMAT "%5.1" /end CHARACTERISTIC
/begin CHARACTERISTIC CLABKVPE "" VALUE 0xFD06E1 KwWU8 255.0 dez 0.00 255.0 FORMAT "%5.1" /end CHARACTERISTIC
/begin CHARACTERISTIC CLABM "Fehlerklasse: Bezugsmarkengeber" VALUE 0xFD06E2 KwUb 255.0 dez 0.00 255.0 FORMAT "%5.1" /end CHARACTERISTIC
/begin CHARACTERISTIC CLACANA "" VALUE 0xFD06E5 KwWU8 255.0 dez 0.00 255.0 FORMAT "%5.1" /end CHARACTERISTIC
/begin CHARACTERISTIC CLACAS "Fehlerklasse: CAN-Timeout ASC-Botschaft" VALUE 0xFD06E6 KwWU8 255.0 dez 0.00 255.0 FORMAT "%5.1" /end CHARACTERISTIC
/begin CHARACTERISTIC CLACEZ "" VALUE 0xFD06E7 KwWU8 255.0 dez 0.00 255.0 FORMAT "%5.1" /end CHARACTERISTIC
/begin CHARACTERISTIC CLACGE "Fehlerklasse: CAN-Timeout EGS-Botschaft" VALUE 0xFD06E8 KwWU8 255.0 dez 0.00 255.0 FORMAT "%5.1" /end CHARACTERISTIC
/begin CHARACTERISTIC CLACINS "Fehlerklasse: CAN-Timeout Botschaft Kombiinstrument" VALUE 0xFD06E9 KwWU8 255.0 dez 0.00 255.0 FORMAT "%5.1" /end CHARACTERISTIC
/begin CHARACTERISTIC CLACOD "Fehlerklasse: Steuerger‰t noch nicht codiert" VALUE 0xFD06EA KwWU8 255.0 dez 0.00 255.0 FORMAT "%5.1" /end CHARACTERISTIC
/begin CHARACTERISTIC CLADISA "" VALUE 0xFD06EE KwWU8 255.0 dez 0.00 255.0 FORMAT "%5.1" /end CHARACTERISTIC
/begin CHARACTERISTIC CLADK "Fehlerklasse: DK- Potentiometer" VALUE 0xFD06EF KwUb 255.0 dez 0.00 255.0 FORMAT "%5.1" /end CHARACTERISTIC
/begin CHARACTERISTIC CLADK1P "Fehlerklassse: Drosselklappe 1. Poti" VALUE 0xFD06F0 KwUb 255.0 dez 0.00 255.0 FORMAT "%5.1" /end CHARACTERISTIC
/begin CHARACTERISTIC CLADK2P "Fehlerklasse: Drosselklappenpotentiometer 2" VALUE 0xFD06F1 KwUb 255.0 dez 0.00 255.0 FORMAT "%5.1" /end CHARACTERISTIC
/begin CHARACTERISTIC CLADVEE "Fehlerklasse: DV-E Endstufe" VALUE 0xFD06F6 KwUb 255.0 dez 0.00 255.0 FORMAT "%5.1" /end CHARACTERISTIC
/begin CHARACTERISTIC CLADVEF "Fehlerklasse: DV-E Fehler bei Federpr¸fung" VALUE 0xFD06F7 KwUb 255.0 dez 0.00 255.0 FORMAT "%5.1" /end CHARACTERISTIC
/begin CHARACTERISTIC CLADVEFO "" VALUE 0xFD06F8 KwUb 255.0 dez 0.00 255.0 FORMAT "%5.1" /end CHARACTERISTIC
/begin CHARACTERISTIC CLADVEL "Fehlerklasse: DV-E Lageabweichung" VALUE 0xFD06F9 KwUb 255.0 dez 0.00 255.0 FORMAT "%5.1" /end CHARACTERISTIC
/begin CHARACTERISTIC CLADVEN "Fehlerklasse: DV-E Fehler bei Pr¸fung Notluftposition" VALUE 0xFD06FA KwUb 255.0 dez 0.00 255.0 FORMAT "%5.1" /end CHARACTERISTIC
/begin CHARACTERISTIC CLADVER "Fehlerklasse: DV-E Regelbereich" VALUE 0xFD06FB KwUb 255.0 dez 0.00 255.0 FORMAT "%5.1" /end CHARACTERISTIC
/begin CHARACTERISTIC CLADVET "" VALUE 0xFD06FC KwUb 255.0 dez 0.00 255.0 FORMAT "%5.1" /end CHARACTERISTIC
/begin CHARACTERISTIC CLADVEU "Fehlerklasse: DV-E Fehler beim UMA-Lernen" VALUE 0xFD06FD KwUb 255.0 dez 0.00 255.0 FORMAT "%5.1" /end CHARACTERISTIC
/begin CHARACTERISTIC CLADVEUB "" VALUE 0xFD06FE KwUb 255.0 dez 0.00 255.0 FORMAT "%5.1" /end CHARACTERISTIC
/begin CHARACTERISTIC CLADVEUW "" VALUE 0xFD06FF KwUb 255.0 dez 0.00 255.0 FORMAT "%5.1" /end CHARACTERISTIC
/begin CHARACTERISTIC CLADVEV "Fehlerklasse: DV-E Fehler bei Verst‰rkerabgleich" VALUE 0xFD0700 KwUb 255.0 dez 0.00 255.0 FORMAT "%5.1" /end CHARACTERISTIC
/begin CHARACTERISTIC CLAELS "Fehlerklasse: Endstufe E-Box L¸fter" VALUE 0xFD070B KwWU8 255.0 dez 0.00 255.0 FORMAT "%5.1" /end CHARACTERISTIC
/begin CHARACTERISTIC CLAETS "Fehlerklasse: ETS-Endstufe" VALUE 0xFD070E KwWU8 255.0 dez 0.00 255.0 FORMAT "%5.1" /end CHARACTERISTIC
/begin CHARACTERISTIC CLAEV1 "Fehlerklasse: EV Endtsufe 1" VALUE 0xFD070F KwWU8 255.0 dez 0.00 255.0 FORMAT "%5.1" /end CHARACTERISTIC
/begin CHARACTERISTIC CLAEV2 "Fehlerklasse: EV Endstufe 2" VALUE 0xFD0710 KwWU8 255.0 dez 0.00 255.0 FORMAT "%5.1" /end CHARACTERISTIC
/begin CHARACTERISTIC CLAEV3 "Fehlerklasse: EV Endstufe 3" VALUE 0xFD0711 KwWU8 255.0 dez 0.00 255.0 FORMAT "%5.1" /end CHARACTERISTIC
/begin CHARACTERISTIC CLAEV4 "Fehlerklasse: EV Endstufe 4" VALUE 0xFD0712 KwWU8 255.0 dez 0.00 255.0 FORMAT "%5.1" /end CHARACTERISTIC
/begin CHARACTERISTIC CLAEZH "" VALUE 0xFD0717 KwWU8 255.0 dez 0.00 255.0 FORMAT "%5.1" /end CHARACTERISTIC
/begin CHARACTERISTIC CLAHSH "Fehlerklasse: Heizung Lambdasonde hinter Kat" VALUE 0xFD071F KwWU8 255.0 dez 0.00 255.0 FORMAT "%5.1" /end CHARACTERISTIC
/begin CHARACTERISTIC CLAHSH2 "Fehlerklasse: Heizung Lambdasonde 2 hinter Kat" VALUE 0xFD0720 KwWU8 255.0 dez 0.00 255.0 FORMAT "%5.1" /end CHARACTERISTIC
/begin CHARACTERISTIC CLAHSV "Fehlerklasse: Heizung Lambdasonde vor Kat" VALUE 0xFD0721 KwWU8 255.0 dez 0.00 255.0 FORMAT "%5.1" /end CHARACTERISTIC
/begin CHARACTERISTIC CLAHSV2 "Fehlerklasse: Heizung Lambdasonde 2 vor Kat" VALUE 0xFD0722 KwWU8 255.0 dez 0.00 255.0 FORMAT "%5.1" /end CHARACTERISTIC
/begin CHARACTERISTIC CLAKAT "Fehlerklasse: Katalysator" VALUE 0xFD0724 KwWU8 255.0 dez 0.00 255.0 FORMAT "%5.1" /end CHARACTERISTIC
/begin CHARACTERISTIC CLAKKUE "" VALUE 0xFD0726 KwUb 255.0 dez 0.00 255.0 FORMAT "%5.1" /end CHARACTERISTIC
/begin CHARACTERISTIC CLAKOSE "Fehlerklasse: Klima- Kompressorsteurung Endstufe" VALUE 0xFD0727 KwWU8 255.0 dez 0.00 255.0 FORMAT "%5.1" /end CHARACTERISTIC
/begin CHARACTERISTIC CLAKPE "Fehlerklasse: EKP-Relais Endstufe" VALUE 0xFD0728 KwWU8 255.0 dez 0.00 255.0 FORMAT "%5.1" /end CHARACTERISTIC
/begin CHARACTERISTIC CLAKRNT "Fehlerklasse: Klopfregelung Nulltest" VALUE 0xFD0729 KwUb 255.0 dez 0.00 255.0 FORMAT "%5.1" /end CHARACTERISTIC
/begin CHARACTERISTIC CLAKROF "Fehlerklasse: Klopfreglung Offset" VALUE 0xFD072A KwUb 255.0 dez 0.00 255.0 FORMAT "%5.1" /end CHARACTERISTIC
/begin CHARACTERISTIC CLALDE "Fehlerklasse: LDR-Taktventil Endstufe" VALUE 0xFD0735 KwUb 255.0 dez 0.00 255.0 FORMAT "%5.1" /end CHARACTERISTIC
/begin CHARACTERISTIC CLALDPE "Fehlerklasse: LDP  Endstufe" VALUE 0xFD0737 KwUb 255.0 dez 0.00 255.0 FORMAT "%5.1" /end CHARACTERISTIC
/begin CHARACTERISTIC CLALM "Fehlerklasse: Hauptf¸llungssignal" VALUE 0xFD0739 KwWU8 255.0 dez 0.00 255.0 FORMAT "%5.1" /end CHARACTERISTIC
/begin CHARACTERISTIC CLALUEA "Fehlerklasse: Motorl¸fter Endstufe A" VALUE 0xFD073D KwUb 255.0 dez 0.00 255.0 FORMAT "%5.1" /end CHARACTERISTIC
/begin CHARACTERISTIC CLALUVE "Fehlerklasse: EV- Luftumfassungsventil Endstufe" VALUE 0xFD073E KwUb 255.0 dez 0.00 255.0 FORMAT "%5.1" /end CHARACTERISTIC
/begin CHARACTERISTIC CLAN "Fehlerklasse: Drehzahlgeber" VALUE 0xFD0750 KwUb 255.0 dez 0.00 255.0 FORMAT "%5.1" /end CHARACTERISTIC
/begin CHARACTERISTIC CLASTAE "Fehlerklasse: Start-Relais Endstufe" VALUE 0xFD075F KwUb 255.0 dez 0.00 255.0 FORMAT "%5.1" /end CHARACTERISTIC
/begin CHARACTERISTIC CLASWE "Fehlerklasse: Beschleunigungssensor der Schlechtwegerkennung" VALUE 0xFD0761 KwWU8 255.0 dez 0.00 255.0 FORMAT "%5.1" /end CHARACTERISTIC
/begin CHARACTERISTIC CLAZZZ "Dummy: Tabellenende" VALUE 0xFD0779 KwUb 255.0 dez 0.00 255.0 FORMAT "%5.1" /end CHARACTERISTIC
/begin CHARACTERISTIC FFTAAA "Dummy: Tabellenanfang" VAL_BLK 0xFD077C KwbUb 255.0 dez 0.00 255.0 FORMAT "%5.1" NUMBER 4 /end CHARACTERISTIC
/begin CHARACTERISTIC FFTAS "Freeze Frame Tabelle: ASR- Eingriff" VAL_BLK 0xFD0790 KwbWU8 255.0 dez 0.00 255.0 FORMAT "%5.1" NUMBER 4 /end CHARACTERISTIC
/begin CHARACTERISTIC FFTBKVPE "" VAL_BLK 0xFD0798 KwbWU8 255.0 dez 0.00 255.0 FORMAT "%5.1" NUMBER 4 /end CHARACTERISTIC
/begin CHARACTERISTIC FFTBM "Freeze Frame Tabelle: Bezugsmarkengeber" VAL_BLK 0xFD079C KwbUb 255.0 dez 0.00 255.0 FORMAT "%5.1" NUMBER 4 /end CHARACTERISTIC
/begin CHARACTERISTIC FFTCANA "" VAL_BLK 0xFD07A8 KwbWU8 255.0 dez 0.00 255.0 FORMAT "%5.1" NUMBER 4 /end CHARACTERISTIC
/begin CHARACTERISTIC FFTCAS "Freeze Frame Tabelle: CAN-Timeout ASC-Botschaft" VAL_BLK 0xFD07AC KwbWU8 255.0 dez 0.00 255.0 FORMAT "%5.1" NUMBER 4 /end CHARACTERISTIC
/begin CHARACTERISTIC FFTCEZ "" VAL_BLK 0xFD07B0 KwbWU8 255.0 dez 0.00 255.0 FORMAT "%5.1" NUMBER 4 /end CHARACTERISTIC
/begin CHARACTERISTIC FFTCGE "Freeze Frame Tabelle: CAN-Timeout EGS-Botschaft" VAL_BLK 0xFD07B4 KwbWU8 255.0 dez 0.00 255.0 FORMAT "%5.1" NUMBER 4 /end CHARACTERISTIC
/begin CHARACTERISTIC FFTCINS "Freeze Frame Tabelle: CAN-Timeout Instr.-Botschaft" VAL_BLK 0xFD07B8 KwbWU8 255.0 dez 0.00 255.0 FORMAT "%5.1" NUMBER 4 /end CHARACTERISTIC
/begin CHARACTERISTIC FFTCOD "Tabelle Umweltbedingungen: Steuerger‰t noch nicht codiert" VAL_BLK 0xFD07BC KwbWU8 255.0 dez 0.00 255.0 FORMAT "%5.1" NUMBER 4 /end CHARACTERISTIC
/begin CHARACTERISTIC FFTDISA "" VAL_BLK 0xFD07CC KwbWU8 255.0 dez 0.00 255.0 FORMAT "%5.1" NUMBER 4 /end CHARACTERISTIC
/begin CHARACTERISTIC FFTDK "Freeze Frame Tabelle: DK- Potentiometer" VAL_BLK 0xFD07D0 KwbUb 255.0 dez 0.00 255.0 FORMAT "%5.1" NUMBER 4 /end CHARACTERISTIC
/begin CHARACTERISTIC FFTDK1P "Freeze Frame Tabelle: Drosselklappe 1. Poti" VAL_BLK 0xFD07D4 KwbUb 255.0 dez 0.00 255.0 FORMAT "%5.1" NUMBER 4 /end CHARACTERISTIC
/begin CHARACTERISTIC FFTDK2P "Freeze Frame Tabelle: Drosselklappenpotentiometer 2" VAL_BLK 0xFD07D8 KwbUb 255.0 dez 0.00 255.0 FORMAT "%5.1" NUMBER 4 /end CHARACTERISTIC
/begin CHARACTERISTIC FFTDVEE "Freeze Frame Tabelle: DV-E Endstufe" VAL_BLK 0xFD07EC KwbUb 255.0 dez 0.00 255.0 FORMAT "%5.1" NUMBER 4 /end CHARACTERISTIC
/begin CHARACTERISTIC FFTDVEF "Freeze Frame Tabelle: DV-E Fehler bei Federpr¸fung" VAL_BLK 0xFD07F0 KwbUb 255.0 dez 0.00 255.0 FORMAT "%5.1" NUMBER 4 /end CHARACTERISTIC
/begin CHARACTERISTIC FFTDVEFO "" VAL_BLK 0xFD07F4 KwbUb 255.0 dez 0.00 255.0 FORMAT "%5.1" NUMBER 4 /end CHARACTERISTIC
/begin CHARACTERISTIC FFTDVEL "Freeze Frame Tabelle: DV-E Lageabweichung" VAL_BLK 0xFD07F8 KwbUb 255.0 dez 0.00 255.0 FORMAT "%5.1" NUMBER 4 /end CHARACTERISTIC
/begin CHARACTERISTIC FFTDVEN "Freeze Frame Tabelle: DV-E Fehler bei Pr¸fung Notluftposition" VAL_BLK 0xFD07FC KwbUb 255.0 dez 0.00 255.0 FORMAT "%5.1" NUMBER 4 /end CHARACTERISTIC
/begin CHARACTERISTIC FFTDVER "Freeze Frame Tabelle: DV-E Regelbereich" VAL_BLK 0xFD0800 KwbUb 255.0 dez 0.00 255.0 FORMAT "%5.1" NUMBER 4 /end CHARACTERISTIC
/begin CHARACTERISTIC FFTDVET "" VAL_BLK 0xFD0804 KwbUb 255.0 dez 0.00 255.0 FORMAT "%5.1" NUMBER 4 /end CHARACTERISTIC
/begin CHARACTERISTIC FFTDVEU "Freeze Frame Tabelle: DV-E Fehler beim UMA-Lernen" VAL_BLK 0xFD0808 KwbUb 255.0 dez 0.00 255.0 FORMAT "%5.1" NUMBER 4 /end CHARACTERISTIC
/begin CHARACTERISTIC FFTDVEUB "" VAL_BLK 0xFD080C KwbUb 255.0 dez 0.00 255.0 FORMAT "%5.1" NUMBER 4 /end CHARACTERISTIC
/begin CHARACTERISTIC FFTDVEUW "" VAL_BLK 0xFD0810 KwbUb 255.0 dez 0.00 255.0 FORMAT "%5.1" NUMBER 4 /end CHARACTERISTIC
/begin CHARACTERISTIC FFTDVEV "Freeze Frame Tabelle: DV-E Fehler bei Verst‰rkerabgleich" VAL_BLK 0xFD0814 KwbUb 255.0 dez 0.00 255.0 FORMAT "%5.1" NUMBER 4 /end CHARACTERISTIC
/begin CHARACTERISTIC FFTELS "Freeze Frame Tabelle: Endstufe E-Box l¸fter" VAL_BLK 0xFD0840 KwbWU8 255.0 dez 0.00 255.0 FORMAT "%5.1" NUMBER 4 /end CHARACTERISTIC
/begin CHARACTERISTIC FFTETS "Freeze Frame Tabelle: ETS-Endstufe" VAL_BLK 0xFD084C KwbWU8 255.0 dez 0.00 255.0 FORMAT "%5.1" NUMBER 4 /end CHARACTERISTIC
/begin CHARACTERISTIC FFTEV1 "Freeze Frame Tabelle: EV Endstufe 1" VAL_BLK 0xFD0850 KwbWU8 255.0 dez 0.00 255.0 FORMAT "%5.1" NUMBER 4 /end CHARACTERISTIC
/begin CHARACTERISTIC FFTEV2 "Freeze Frame Tabelle: EV Endstufe 2" VAL_BLK 0xFD0854 KwbWU8 255.0 dez 0.00 255.0 FORMAT "%5.1" NUMBER 4 /end CHARACTERISTIC
/begin CHARACTERISTIC FFTEV3 "Freeze Frame Tabelle: EV Endstufe 3" VAL_BLK 0xFD0858 KwbWU8 255.0 dez 0.00 255.0 FORMAT "%5.1" NUMBER 4 /end CHARACTERISTIC
/begin CHARACTERISTIC FFTEV4 "Freeze Frame Tabelle: EV Endstufe 4" VAL_BLK 0xFD085C KwbWU8 255.0 dez 0.00 255.0 FORMAT "%5.1" NUMBER 4 /end CHARACTERISTIC
/begin CHARACTERISTIC FFTEZH "" VAL_BLK 0xFD0870 KwbWU8 255.0 dez 0.00 255.0 FORMAT "%5.1" NUMBER 4 /end CHARACTERISTIC
/begin CHARACTERISTIC FFTHSH "Tabelle Umweltbedingungen Heizung Lambdasonde hinter Kat" VAL_BLK 0xFD0890 KwbWU8 255.0 dez 0.00 255.0 FORMAT "%5.1" NUMBER 4 /end CHARACTERISTIC
/begin CHARACTERISTIC FFTHSH2 "Tabelle Umweltbedingungen Heizung Lambdasonde hinter Kat Bank2" VAL_BLK 0xFD0894 KwbWU8 255.0 dez 0.00 255.0 FORMAT "%5.1" NUMBER 4 /end CHARACTERISTIC
/begin CHARACTERISTIC FFTHSV "Tabelle Umweltbedingungen Heizung Lambdasonde vor Kat" VAL_BLK 0xFD0898 KwbWU8 255.0 dez 0.00 255.0 FORMAT "%5.1" NUMBER 4 /end CHARACTERISTIC
/begin CHARACTERISTIC FFTHSV2 "Tabelle Umweltbedingungen Heizung Lambdasonde vor Kat Bank2" VAL_BLK 0xFD089C KwbWU8 255.0 dez 0.00 255.0 FORMAT "%5.1" NUMBER 4 /end CHARACTERISTIC
/begin CHARACTERISTIC FFTKAT "Freeze Frame Tabelle: Katalysator" VAL_BLK 0xFD08A4 KwbWU8 255.0 dez 0.00 255.0 FORMAT "%5.1" NUMBER 4 /end CHARACTERISTIC
/begin CHARACTERISTIC FFTKKUE "" VAL_BLK 0xFD08AC KwbUb 255.0 dez 0.00 255.0 FORMAT "%5.1" NUMBER 4 /end CHARACTERISTIC
/begin CHARACTERISTIC FFTKOSE "Freeze Frame Tabelle: Klima- Kompressorsteurung Endstufe" VAL_BLK 0xFD08B0 KwbWU8 255.0 dez 0.00 255.0 FORMAT "%5.1" NUMBER 4 /end CHARACTERISTIC
/begin CHARACTERISTIC FFTKPE "Freeze Frame Tabelle: EKP-Relais Endstufe" VAL_BLK 0xFD08B4 KwbWU8 255.0 dez 0.00 255.0 FORMAT "%5.1" NUMBER 4 /end CHARACTERISTIC
/begin CHARACTERISTIC FFTKRNT "Freeze frame Tabelle: Klopfregelung Nulltest" VAL_BLK 0xFD08B8 KwbUb 255.0 dez 0.00 255.0 FORMAT "%5.1" NUMBER 4 /end CHARACTERISTIC
/begin CHARACTERISTIC FFTKROF "Freeze Frame Tabelle: Klopfregelung Offset" VAL_BLK 0xFD08BC KwbUb 255.0 dez 0.00 255.0 FORMAT "%5.1" NUMBER 4 /end CHARACTERISTIC
/begin CHARACTERISTIC FFTLDE "Freeze Frame Tabelle: LDR Taktventil Endstufe" VAL_BLK 0xFD08E8 KwbUb 255.0 dez 0.00 255.0 FORMAT "%5.1" NUMBER 4 /end CHARACTERISTIC
/begin CHARACTERISTIC FFTLDPE "Freeze Frame Tabelle: LDP Endstufe" VAL_BLK 0xFD08F0 KwbUb 255.0 dez 0.00 255.0 FORMAT "%5.1" NUMBER 4 /end CHARACTERISTIC
/begin CHARACTERISTIC FFTLM "Freeze Frame Tabelle: Hauptf¸llungssensor" VAL_BLK 0xFD08F8 KwbWU8 255.0 dez 0.00 255.0 FORMAT "%5.1" NUMBER 4 /end CHARACTERISTIC
/begin CHARACTERISTIC FFTLUEA "Freeze Frame Tabelle: L¸fterendstufe A" VAL_BLK 0xFD0908 KwbUb 255.0 dez 0.00 255.0 FORMAT "%5.1" NUMBER 4 /end CHARACTERISTIC
/begin CHARACTERISTIC FFTLUVE "Freeze Frame Tabelle: EV- Luftumfassungsventil Endstufe" VAL_BLK 0xFD090C KwbUb 255.0 dez 0.00 255.0 FORMAT "%5.1" NUMBER 4 /end CHARACTERISTIC
/begin CHARACTERISTIC FFTN "Freeze Frame Tabelle: Drehzahlgeber" VAL_BLK 0xFD0954 KwbUb 255.0 dez 0.00 255.0 FORMAT "%5.1" NUMBER 4 /end CHARACTERISTIC
/begin CHARACTERISTIC FFTSTAE "Freeze Frame Tabelle: Start-Relais Endstufe" VAL_BLK 0xFD0990 KwbUb 255.0 dez 0.00 255.0 FORMAT "%5.1" NUMBER 4 /end CHARACTERISTIC
/begin CHARACTERISTIC FFTSWE "Freeze Frame Tabelle: Beschleunigungssensor Schlechtwegeerk." VAL_BLK 0xFD0998 KwbWU8 255.0 dez 0.00 255.0 FORMAT "%5.1" NUMBER 4 /end CHARACTERISTIC
/begin CHARACTERISTIC FFTZZZ "Dummy: Tabellenende" VAL_BLK 0xFD09F8 KwbUb 255.0 dez 0.00 255.0 FORMAT "%5.1" NUMBER 4 /end CHARACTERISTIC
/begin CHARACTERISTIC TSFAAA "Dummy: Tabellenanfang" VALUE 0xFD09FC KwUb 255.0 dez 0.00 255.0 FORMAT "%5.1" /end CHARACTERISTIC
/begin CHARACTERISTIC TSFAS "Fehlersummenzeit: ASR - Eingriff" VALUE 0xFD0A01 KwWU8 255.0 dez 0.00 255.0 FORMAT "%5.1" /end CHARACTERISTIC
/begin CHARACTERISTIC TSFBKVPE "" VALUE 0xFD0A03 KwWU8 255.0 dez 0.00 255.0 FORMAT "%5.1" /end CHARACTERISTIC
/begin CHARACTERISTIC TSFBM "Fehlersummenzeit: Bezugsmarkengeber" VALUE 0xFD0A04 KwUb 255.0 dez 0.00 255.0 FORMAT "%5.1" /end CHARACTERISTIC
/begin CHARACTERISTIC TSFCANA "" VALUE 0xFD0A07 KwWU8 255.0 dez 0.00 255.0 FORMAT "%5.1" /end CHARACTERISTIC
/begin CHARACTERISTIC TSFCAS "Fehlersummenzeit: CAN-Schnittstelle, Timeout ASC" VALUE 0xFD0A08 KwWU8 255.0 dez 0.00 255.0 FORMAT "%5.1" /end CHARACTERISTIC
/begin CHARACTERISTIC TSFCEZ "" VALUE 0xFD0A09 KwWU8 255.0 dez 0.00 255.0 FORMAT "%5.1" /end CHARACTERISTIC
/begin CHARACTERISTIC TSFCGE "Fehlersummenzeit: CAN-Schnittstelle, Timeout EGS" VALUE 0xFD0A0A KwWU8 255.0 dez 0.00 255.0 FORMAT "%5.1" /end CHARACTERISTIC
/begin CHARACTERISTIC TSFCINS "Fehlersummenzeit: CAN-Schnittstelle, Timeout Instrument" VALUE 0xFD0A0B KwWU8 255.0 dez 0.00 255.0 FORMAT "%5.1" /end CHARACTERISTIC
/begin CHARACTERISTIC TSFCOD "Fehlersummenzeit: Steuerger‰t noch nicht codiert" VALUE 0xFD0A0C KwWU8 255.0 dez 0.00 255.0 FORMAT "%5.1" /end CHARACTERISTIC
/begin CHARACTERISTIC TSFDISA "" VALUE 0xFD0A10 KwWU8 255.0 dez 0.00 255.0 FORMAT "%5.1" /end CHARACTERISTIC
/begin CHARACTERISTIC TSFDK "Fehlersummenzeit: DK - Potentiometer" VALUE 0xFD0A11 KwUb 255.0 dez 0.00 255.0 FORMAT "%5.1" /end CHARACTERISTIC
/begin CHARACTERISTIC TSFDK1P "Fehlersummenzeit: Drosselklappe 1. Poti" VALUE 0xFD0A12 KwUb 255.0 dez 0.00 255.0 FORMAT "%5.1" /end CHARACTERISTIC
/begin CHARACTERISTIC TSFDK2P "Fehlersummenzeit: Drosselklappenpotentiometer 2" VALUE 0xFD0A13 KwUb 255.0 dez 0.00 255.0 FORMAT "%5.1" /end CHARACTERISTIC
/begin CHARACTERISTIC TSFDVEE "Fehlersummenzeit: DV-E Endstufe" VALUE 0xFD0A18 KwUb 255.0 dez 0.00 255.0 FORMAT "%5.1" /end CHARACTERISTIC
/begin CHARACTERISTIC TSFDVEF "Fehlersummenzeit: DV-E Fehler bei Federpr¸fung" VALUE 0xFD0A19 KwUb 255.0 dez 0.00 255.0 FORMAT "%5.1" /end CHARACTERISTIC
/begin CHARACTERISTIC TSFDVEFO "" VALUE 0xFD0A1A KwUb 255.0 dez 0.00 255.0 FORMAT "%5.1" /end CHARACTERISTIC
/begin CHARACTERISTIC TSFDVEL "Fehlersummenzeit: DV-E Lageabweichung" VALUE 0xFD0A1B KwUb 255.0 dez 0.00 255.0 FORMAT "%5.1" /end CHARACTERISTIC
/begin CHARACTERISTIC TSFDVEN "Fehlersummenzeit: DV-E Fehler bei Pr¸fung Notluftposition" VALUE 0xFD0A1C KwUb 255.0 dez 0.00 255.0 FORMAT "%5.1" /end CHARACTERISTIC
/begin CHARACTERISTIC TSFDVER "Fehlersummenzeit: DV-E Regelbereich" VALUE 0xFD0A1D KwUb 255.0 dez 0.00 255.0 FORMAT "%5.1" /end CHARACTERISTIC
/begin CHARACTERISTIC TSFDVET "" VALUE 0xFD0A1E KwUb 255.0 dez 0.00 255.0 FORMAT "%5.1" /end CHARACTERISTIC
/begin CHARACTERISTIC TSFDVEU "Fehlersummenzeit: DV-E Fehler beim UMA-Lernen" VALUE 0xFD0A1F KwUb 255.0 dez 0.00 255.0 FORMAT "%5.1" /end CHARACTERISTIC
/begin CHARACTERISTIC TSFDVEUB "" VALUE 0xFD0A20 KwUb 255.0 dez 0.00 255.0 FORMAT "%5.1" /end CHARACTERISTIC
/begin CHARACTERISTIC TSFDVEUW "" VALUE 0xFD0A21 KwUb 255.0 dez 0.00 255.0 FORMAT "%5.1" /end CHARACTERISTIC
/begin CHARACTERISTIC TSFDVEV "Fehlersummenzeit: DV-E Fehler bei Verst‰rkerabgleich" VALUE 0xFD0A22 KwUb 255.0 dez 0.00 255.0 FORMAT "%5.1" /end CHARACTERISTIC
/begin CHARACTERISTIC TSFELS "Fehlersummenzeit: Endstufe E-Box L¸fter" VALUE 0xFD0A2D KwWU8 255.0 dez 0.00 255.0 FORMAT "%5.1" /end CHARACTERISTIC
/begin CHARACTERISTIC TSFETS "Fehlersummenzeit: Elektrisches Thermostat" VALUE 0xFD0A30 KwWU8 255.0 dez 0.00 255.0 FORMAT "%5.1" /end CHARACTERISTIC
/begin CHARACTERISTIC TSFEV1 "Fehlersummenzeit: EV von Zyl. 1" VALUE 0xFD0A31 KwWU8 255.0 dez 0.00 255.0 FORMAT "%5.1" /end CHARACTERISTIC
/begin CHARACTERISTIC TSFEV2 "Fehlersummenzeit: EV von Zyl. 2" VALUE 0xFD0A32 KwWU8 255.0 dez 0.00 255.0 FORMAT "%5.1" /end CHARACTERISTIC
/begin CHARACTERISTIC TSFEV3 "Fehlersummenzeit: EV von Zyl. 3" VALUE 0xFD0A33 KwWU8 255.0 dez 0.00 255.0 FORMAT "%5.1" /end CHARACTERISTIC
/begin CHARACTERISTIC TSFEV4 "Fehlersummenzeit: EV von Zyl. 4" VALUE 0xFD0A34 KwWU8 255.0 dez 0.00 255.0 FORMAT "%5.1" /end CHARACTERISTIC
/begin CHARACTERISTIC TSFEZH "" VALUE 0xFD0A39 KwWU8 255.0 dez 0.00 255.0 FORMAT "%5.1" /end CHARACTERISTIC
/begin CHARACTERISTIC TSFHSH "Fehlersummenzeit: Lambdasonden-Heizung hinter Katalysator" VALUE 0xFD0A41 KwWU8 255.0 dez 0.00 255.0 FORMAT "%5.1" /end CHARACTERISTIC
/begin CHARACTERISTIC TSFHSH2 "Fehlersummenzeit: Lambdasonden-Heizung hinter Katalysator, Bank 2" VALUE 0xFD0A42 KwWU8 255.0 dez 0.00 255.0 FORMAT "%5.1" /end CHARACTERISTIC
/begin CHARACTERISTIC TSFHSV "Fehlersummenzeit: Lambdasonden-Heizung vor Katalysator" VALUE 0xFD0A43 KwWU8 255.0 dez 0.00 255.0 FORMAT "%5.1" /end CHARACTERISTIC
/begin CHARACTERISTIC TSFHSV2 "Fehlersummenzeit: Lambdasonden-Heizung vor Katalysator, Bank 2" VALUE 0xFD0A44 KwWU8 255.0 dez 0.00 255.0 FORMAT "%5.1" /end CHARACTERISTIC
/begin CHARACTERISTIC TSFKAT "Fehlersummenzeit: Katalysator-Konvertierung" VALUE 0xFD0A46 KwWU8 255.0 dez 0.00 255.0 FORMAT "%5.1" /end CHARACTERISTIC
/begin CHARACTERISTIC TSFKKUE "Fehlersummenzeit: Kraftstoffkreislauf-Umschaltung Endstufe" VALUE 0xFD0A48 KwUb 255.0 dez 0.00 255.0 FORMAT "%5.1" /end CHARACTERISTIC
/begin CHARACTERISTIC TSFKOSE "Fehlersummenzeit: Klima- Kompressorsteurung Endstufe" VALUE 0xFD0A49 KwWU8 255.0 dez 0.00 255.0 FORMAT "%5.1" /end CHARACTERISTIC
/begin CHARACTERISTIC TSFKPE "Fehlersummenzeit: EKP-Relais Endstufe" VALUE 0xFD0A4A KwWU8 255.0 dez 0.00 255.0 FORMAT "%5.1" /end CHARACTERISTIC
/begin CHARACTERISTIC TSFKRNT "Fehlersummenzeit: Klopfregelung Nulltest" VALUE 0xFD0A4B KwUb 255.0 dez 0.00 255.0 FORMAT "%5.1" /end CHARACTERISTIC
/begin CHARACTERISTIC TSFKROF "Fehlersummenzeit: Klopfregelung Offset" VALUE 0xFD0A4C KwUb 255.0 dez 0.00 255.0 FORMAT "%5.1" /end CHARACTERISTIC
/begin CHARACTERISTIC TSFLDE "Fehlersummenzeit: Ladedrucksteuerventil (Endstufe)" VALUE 0xFD0A57 KwUb 255.0 dez 0.00 255.0 FORMAT "%5.1" /end CHARACTERISTIC
/begin CHARACTERISTIC TSFLDPE "Fehlersummenzeit: Leckdiagnosepumpe Endstufe" VALUE 0xFD0A59 KwUb 255.0 dez 0.00 255.0 FORMAT "%5.1" /end CHARACTERISTIC
/begin CHARACTERISTIC TSFLM "Fehlersummenzeit: LMM/HLM/HFM" VALUE 0xFD0A5B KwWU8 255.0 dez 0.00 255.0 FORMAT "%5.1" /end CHARACTERISTIC
/begin CHARACTERISTIC TSFLUEA "Fehlersummenzeit: L¸fterendstufe A" VALUE 0xFD0A5F KwUb 255.0 dez 0.00 255.0 FORMAT "%5.1" /end CHARACTERISTIC
/begin CHARACTERISTIC TSFLUVE "Fehlersummenzeit: EV-Luftumfassungsventil Endstufe" VALUE 0xFD0A60 KwUb 255.0 dez 0.00 255.0 FORMAT "%5.1" /end CHARACTERISTIC
/begin CHARACTERISTIC TSFN "Fehlersummenzeit: Drehzahlgeber" VALUE 0xFD0A72 KwUb 255.0 dez 0.00 255.0 FORMAT "%5.1" /end CHARACTERISTIC
/begin CHARACTERISTIC TSFSTAE "Fehlersummenzeit: Startautomatik (Endstufe)" VALUE 0xFD0A81 KwUb 255.0 dez 0.00 255.0 FORMAT "%5.1" /end CHARACTERISTIC
/begin CHARACTERISTIC TSFSWE "Fehlersummenzeit: Beschleunigungssensor der Schlechtwegeerkennung" VALUE 0xFD0A83 KwWU8 255.0 dez 0.00 255.0 FORMAT "%5.1" /end CHARACTERISTIC
/begin CHARACTERISTIC TSFZZZ "Dummy: Tabellenende" VALUE 0xFD0A9B KwUb 255.0 dez 0.00 255.0 FORMAT "%5.1" /end CHARACTERISTIC
/begin MEASUREMENT bbno "Byte f¸r Bedingung B_no  als Triggerevent in DCLA" UBYTE dez 1 100 0 255 FORMAT "%5.1" ECU_ADDRESS 0x3FD7F9 /end MEASUREMENT
/begin MEASUREMENT bbsp3 "Byte f¸r Bedingung B_sp3 als Triggerevent in DCLA" UBYTE dez 1 100 0 255 FORMAT "%5.1" ECU_ADDRESS 0x3FD7FA /end MEASUREMENT
/begin MEASUREMENT bbtim "Byte f¸r Bedingung B_tim als Triggerevent in DCLA" UBYTE dez 1 100 0 255 FORMAT "%5.1" ECU_ADDRESS 0x5B8E25 /end MEASUREMENT
/begin MEASUREMENT B_beas "Bedingung Bandendeanford. f¸r Fehler ASR-Eingriff" UWORD B_TRUE 1 100 0 1 BIT_MASK 0x20 FORMAT "%13.11" ECU_ADDRESS 0x3FDD20 /end MEASUREMENT
/begin MEASUREMENT B_bebkvpe "Bedingung Bandende-Funktionsanforderung BKV-Pumpe Endstufe" UWORD B_TRUE 1 100 0 1 BIT_MASK 0x20 FORMAT "%13.11" ECU_ADDRESS 0x3FDD24 /end MEASUREMENT
/begin MEASUREMENT B_bebm "Bedingung Bandende-Funktionsanforderung Bezugsmarke erkannt" UWORD B_TRUE 1 100 0 1 BIT_MASK 0x20 FORMAT "%13.11" ECU_ADDRESS 0x3FDD26 /end MEASUREMENT
/begin MEASUREMENT B_becana "" UWORD B_TRUE 1 100 0 1 BIT_MASK 0x20 FORMAT "%13.11" ECU_ADDRESS 0x3FDD2C /end MEASUREMENT
/begin MEASUREMENT B_becas "Bedingung Bandende-Funktionsanforderung: CAN-Schnittstelle ABS" UWORD B_TRUE 1 100 0 1 BIT_MASK 0x20 FORMAT "%13.11" ECU_ADDRESS 0x3FDD2E /end MEASUREMENT
/begin MEASUREMENT B_becez "" UWORD B_TRUE 1 100 0 1 BIT_MASK 0x20 FORMAT "%13.11" ECU_ADDRESS 0x3FDD30 /end MEASUREMENT
/begin MEASUREMENT B_becge "Bedingung Bandende-Funktionsanforderung: CAN-Schnittstelle TCM" UWORD B_TRUE 1 100 0 1 BIT_MASK 0x20 FORMAT "%13.11" ECU_ADDRESS 0x3FDD32 /end MEASUREMENT
/begin MEASUREMENT B_becins "" UWORD B_TRUE 1 100 0 1 BIT_MASK 0x20 FORMAT "%13.11" ECU_ADDRESS 0x3FDD34 /end MEASUREMENT
/begin MEASUREMENT B_becod "Bedingung Bandende-Test" UWORD B_TRUE 1 100 0 1 BIT_MASK 0x20 FORMAT "%13.11" ECU_ADDRESS 0x3FDD36 /end MEASUREMENT
/begin MEASUREMENT B_bedisa "Pruefung am Bandende" UWORD B_TRUE 1 100 0 1 BIT_MASK 0x20 FORMAT "%13.11" ECU_ADDRESS 0x3FDD3E /end MEASUREMENT
/begin MEASUREMENT B_bedk "Bedingung Bandende-Funktionsanforderung Drosselklappe" UWORD B_TRUE 1 100 0 1 BIT_MASK 0x20 FORMAT "%13.11" ECU_ADDRESS 0x3FDD40 /end MEASUREMENT
/begin MEASUREMENT B_bedk1p "" UWORD B_TRUE 1 100 0 1 BIT_MASK 0x20 FORMAT "%13.11" ECU_ADDRESS 0x3FDD42 /end MEASUREMENT
/begin MEASUREMENT B_bedk2p "" UWORD B_TRUE 1 100 0 1 BIT_MASK 0x20 FORMAT "%13.11" ECU_ADDRESS 0x3FDD44 /end MEASUREMENT
/begin MEASUREMENT B_bedvee "" UWORD B_TRUE 1 100 0 1 BIT_MASK 0x20 FORMAT "%13.11" ECU_ADDRESS 0x3FDD4E /end MEASUREMENT
/begin MEASUREMENT B_bedvef "" UWORD B_TRUE 1 100 0 1 BIT_MASK 0x20 FORMAT "%13.11" ECU_ADDRESS 0x3FDD50 /end MEASUREMENT
/begin MEASUREMENT B_bedvefo "" UWORD B_TRUE 1 100 0 1 BIT_MASK 0x20 FORMAT "%13.11" ECU_ADDRESS 0x3FDD52 /end MEASUREMENT
/begin MEASUREMENT B_bedvel "" UWORD B_TRUE 1 100 0 1 BIT_MASK 0x20 FORMAT "%13.11" ECU_ADDRESS 0x3FDD54 /end MEASUREMENT
/begin MEASUREMENT B_bedven "" UWORD B_TRUE 1 100 0 1 BIT_MASK 0x20 FORMAT "%13.11" ECU_ADDRESS 0x3FDD56 /end MEASUREMENT
/begin MEASUREMENT B_bedver "" UWORD B_TRUE 1 100 0 1 BIT_MASK 0x20 FORMAT "%13.11" ECU_ADDRESS 0x3FDD58 /end MEASUREMENT
/begin MEASUREMENT B_bedvet "" UWORD B_TRUE 1 100 0 1 BIT_MASK 0x20 FORMAT "%13.11" ECU_ADDRESS 0x3FDD5A /end MEASUREMENT
/begin MEASUREMENT B_bedveu "" UWORD B_TRUE 1 100 0 1 BIT_MASK 0x20 FORMAT "%13.11" ECU_ADDRESS 0x3FDD5C /end MEASUREMENT
/begin MEASUREMENT B_bedveub "" UWORD B_TRUE 1 100 0 1 BIT_MASK 0x20 FORMAT "%13.11" ECU_ADDRESS 0x3FDD5E /end MEASUREMENT
/begin MEASUREMENT B_bedveuw "" UWORD B_TRUE 1 100 0 1 BIT_MASK 0x20 FORMAT "%13.11" ECU_ADDRESS 0x3FDD60 /end MEASUREMENT
/begin MEASUREMENT B_bedvev "" UWORD B_TRUE 1 100 0 1 BIT_MASK 0x20 FORMAT "%13.11" ECU_ADDRESS 0x3FDD62 /end MEASUREMENT
/begin MEASUREMENT B_beels "Bedingung Bandendeanforderung f¸r Fehler Endstufe E-Box-L¸fter" UWORD B_TRUE 1 100 0 1 BIT_MASK 0x20 FORMAT "%13.11" ECU_ADDRESS 0x3FDD78 /end MEASUREMENT
/begin MEASUREMENT B_beets "Bedingung Bandendeanforderung f¸r el. Thermostat-Endstufe" UWORD B_TRUE 1 100 0 1 BIT_MASK 0x20 FORMAT "%13.11" ECU_ADDRESS 0x3FDD7E /end MEASUREMENT
/begin MEASUREMENT B_beev1 "Bedingung Bandendeanforderung  f¸r Fehler Endstufe EV1" UWORD B_TRUE 1 100 0 1 BIT_MASK 0x20 FORMAT "%13.11" ECU_ADDRESS 0x3FDD80 /end MEASUREMENT
/begin MEASUREMENT B_beev2 "Bedingung Bandendeanforderung  f¸r Fehler Endstufe EV2" UWORD B_TRUE 1 100 0 1 BIT_MASK 0x20 FORMAT "%13.11" ECU_ADDRESS 0x3FDD82 /end MEASUREMENT
/begin MEASUREMENT B_beev3 "Bedingung Bandendeanforderung  f¸r Fehler Endstufe EV3" UWORD B_TRUE 1 100 0 1 BIT_MASK 0x20 FORMAT "%13.11" ECU_ADDRESS 0x3FDD84 /end MEASUREMENT
/begin MEASUREMENT B_beev4 "Bedingung Bandendeanforderung  f¸r Fehler Endstufe EV4" UWORD B_TRUE 1 100 0 1 BIT_MASK 0x20 FORMAT "%13.11" ECU_ADDRESS 0x3FDD86 /end MEASUREMENT
/begin MEASUREMENT B_beezh "" UWORD B_TRUE 1 100 0 1 BIT_MASK 0x20 FORMAT "%13.11" ECU_ADDRESS 0x3FDD90 /end MEASUREMENT
/begin MEASUREMENT B_behsh "Bedingung: Bandendefunktionanford. f¸r %DHLS" UWORD B_TRUE 1 100 0 1 BIT_MASK 0x20 FORMAT "%13.11" ECU_ADDRESS 0x3FDDA0 /end MEASUREMENT
/begin MEASUREMENT B_behsh2 "Bedingung: Bandendefunktionanford. f¸r %DHLS Bank 2" UWORD B_TRUE 1 100 0 1 BIT_MASK 0x20 FORMAT "%13.11" ECU_ADDRESS 0x3FDDA2 /end MEASUREMENT
/begin MEASUREMENT B_behsv "Bedingung: Bandendefunktionanford. f¸r %DHRLSU" UWORD B_TRUE 1 100 0 1 BIT_MASK 0x20 FORMAT "%13.11" ECU_ADDRESS 0x3FDDA4 /end MEASUREMENT
/begin MEASUREMENT B_behsv2 "Bedingung: Bandendefunktionanford. f¸r %DHRLSU, Bank 2" UWORD B_TRUE 1 100 0 1 BIT_MASK 0x20 FORMAT "%13.11" ECU_ADDRESS 0x3FDDA6 /end MEASUREMENT
/begin MEASUREMENT B_bekat "Bedingung Bandende-Funktionsanforderung Katalysatordiagnose" UWORD B_TRUE 1 100 0 1 BIT_MASK 0x20 FORMAT "%13.11" ECU_ADDRESS 0x3FDDAA /end MEASUREMENT
/begin MEASUREMENT B_bekkue "" UWORD B_TRUE 1 100 0 1 BIT_MASK 0x20 FORMAT "%13.11" ECU_ADDRESS 0x3FDDAE /end MEASUREMENT
/begin MEASUREMENT B_bekose "Bedingung Bandendeanforderung f¸r Klimakompressor" UWORD B_TRUE 1 100 0 1 BIT_MASK 0x20 FORMAT "%13.11" ECU_ADDRESS 0x3FDDB0 /end MEASUREMENT
/begin MEASUREMENT B_bekpe "Bedingung Bandendeanforderung f¸r Fehler Endstufe EKP" UWORD B_TRUE 1 100 0 1 BIT_MASK 0x20 FORMAT "%13.11" ECU_ADDRESS 0x3FDDB2 /end MEASUREMENT
/begin MEASUREMENT B_bekrnt "Bedingung Bandende-Funktionsanforderung Klopfregelung Diagnose Nulltest" UWORD B_TRUE 1 100 0 1 BIT_MASK 0x20 FORMAT "%13.11" ECU_ADDRESS 0x3FDDB4 /end MEASUREMENT
/begin MEASUREMENT B_bekrof "Bedingung Bandende-Funktionsanforderung Klopfregelung Diagnose Integrator Offset" UWORD B_TRUE 1 100 0 1 BIT_MASK 0x20 FORMAT "%13.11" ECU_ADDRESS 0x3FDDB6 /end MEASUREMENT
/begin MEASUREMENT B_belde "Bedingung: Fehlereintrag  LDR-Taktventil (Bandende)" UWORD B_TRUE 1 100 0 1 BIT_MASK 0x20 FORMAT "%13.11" ECU_ADDRESS 0x3FDDCC /end MEASUREMENT
/begin MEASUREMENT B_beldpe "" UWORD B_TRUE 1 100 0 1 BIT_MASK 0x20 FORMAT "%13.11" ECU_ADDRESS 0x3FDDD0 /end MEASUREMENT
/begin MEASUREMENT B_belm "Bedingung Bandende-Funktionsanforderung Luftmassensensor (HFM/DSS)" UWORD B_TRUE 1 100 0 1 BIT_MASK 0x20 FORMAT "%13.11" ECU_ADDRESS 0x3FDDD4 /end MEASUREMENT
/begin MEASUREMENT B_beluea "Bedingung Bandende-Funktionsanforderung Endstufe L¸ftermotor A" UWORD B_TRUE 1 100 0 1 BIT_MASK 0x20 FORMAT "%13.11" ECU_ADDRESS 0x3FDDDC /end MEASUREMENT
/begin MEASUREMENT B_beluve "" UWORD B_TRUE 1 100 0 1 BIT_MASK 0x20 FORMAT "%13.11" ECU_ADDRESS 0x3FDDDE /end MEASUREMENT
/begin MEASUREMENT B_ben "" UWORD B_TRUE 1 100 0 1 BIT_MASK 0x20 FORMAT "%13.11" ECU_ADDRESS 0x3FDE02 /end MEASUREMENT
/begin MEASUREMENT B_bestae "Bedingung Bandendeanforderung f¸r Fehler Endstufe Starter Relais" UWORD B_TRUE 1 100 0 1 BIT_MASK 0x20 FORMAT "%13.11" ECU_ADDRESS 0x3FDE20 /end MEASUREMENT
/begin MEASUREMENT B_beswe "Bedingung Bandende-Funktionsanforderung Beschleunigungss. f Schlechtwegerkennung" UWORD B_TRUE 1 100 0 1 BIT_MASK 0x20 FORMAT "%13.11" ECU_ADDRESS 0x3FDE24 /end MEASUREMENT
/begin MEASUREMENT B_bkas "Bedingung: Ersatzwert aktiv fuer ASR-Eingriff" UWORD B_TRUE 1 100 0 1 BIT_MASK 0x40 FORMAT "%13.11" ECU_ADDRESS 0x3FDD20 /end MEASUREMENT
/begin MEASUREMENT B_bkbkvpe "Bedingung: Bremskraftverst‰rker-Pumpe-Endstufe aktiv" UWORD B_TRUE 1 100 0 1 BIT_MASK 0x40 FORMAT "%13.11" ECU_ADDRESS 0x3FDD24 /end MEASUREMENT
/begin MEASUREMENT B_bkbm "Bedingung Ersatzwert aktiv: Bezugsmarke" UWORD B_TRUE 1 100 0 1 BIT_MASK 0x40 FORMAT "%13.11" ECU_ADDRESS 0x3FDD26 /end MEASUREMENT
/begin MEASUREMENT B_bkcana "" UWORD B_TRUE 1 100 0 1 BIT_MASK 0x40 FORMAT "%13.11" ECU_ADDRESS 0x3FDD2C /end MEASUREMENT
/begin MEASUREMENT B_bkcas "Bedingung: CAN-Schnittstelle, Timeout ASC" UWORD B_TRUE 1 100 0 1 BIT_MASK 0x40 FORMAT "%13.11" ECU_ADDRESS 0x3FDD2E /end MEASUREMENT
/begin MEASUREMENT B_bkcez "" UWORD B_TRUE 1 100 0 1 BIT_MASK 0x40 FORMAT "%13.11" ECU_ADDRESS 0x3FDD30 /end MEASUREMENT
/begin MEASUREMENT B_bkcge "Bedingung: CAN-Schnittstelle, Timeout EGS" UWORD B_TRUE 1 100 0 1 BIT_MASK 0x40 FORMAT "%13.11" ECU_ADDRESS 0x3FDD32 /end MEASUREMENT
/begin MEASUREMENT B_bkcins "Bedingung: CAN-Schnittstelle, Timeout Instrument" UWORD B_TRUE 1 100 0 1 BIT_MASK 0x40 FORMAT "%13.11" ECU_ADDRESS 0x3FDD34 /end MEASUREMENT
/begin MEASUREMENT B_bkcod "Bedingung: Ersatzwert aktiv" UWORD B_TRUE 1 100 0 1 BIT_MASK 0x40 FORMAT "%13.11" ECU_ADDRESS 0x3FDD36 /end MEASUREMENT
/begin MEASUREMENT B_bkdisa "Diagnose verwendet Ersatzwert" UWORD B_TRUE 1 100 0 1 BIT_MASK 0x40 FORMAT "%13.11" ECU_ADDRESS 0x3FDD3E /end MEASUREMENT
/begin MEASUREMENT B_bkdk "Bedingung Eratzwert aktiv: Fehler Drosselklappenpoti lˆschen" UWORD B_TRUE 1 100 0 1 BIT_MASK 0x40 FORMAT "%13.11" ECU_ADDRESS 0x3FDD40 /end MEASUREMENT
/begin MEASUREMENT B_bkdk1p "Bedingung Ersatzwert aktiv: Drosselklappe 1.Poti" UWORD B_TRUE 1 100 0 1 BIT_MASK 0x40 FORMAT "%13.11" ECU_ADDRESS 0x3FDD42 /end MEASUREMENT
/begin MEASUREMENT B_bkdk2p "Bedingung Ersatzwert aktiv: Drosselklappe 2.Poti" UWORD B_TRUE 1 100 0 1 BIT_MASK 0x40 FORMAT "%13.11" ECU_ADDRESS 0x3FDD44 /end MEASUREMENT
/begin MEASUREMENT B_bkdvee "Bedingung: DV-E Endstufe" UWORD B_TRUE 1 100 0 1 BIT_MASK 0x40 FORMAT "%13.11" ECU_ADDRESS 0x3FDD4E /end MEASUREMENT
/begin MEASUREMENT B_bkdvef "Bedingung: DV-E Fehler bei Federpr¸fung" UWORD B_TRUE 1 100 0 1 BIT_MASK 0x40 FORMAT "%13.11" ECU_ADDRESS 0x3FDD50 /end MEASUREMENT
/begin MEASUREMENT B_bkdvefo "" UWORD B_TRUE 1 100 0 1 BIT_MASK 0x40 FORMAT "%13.11" ECU_ADDRESS 0x3FDD52 /end MEASUREMENT
/begin MEASUREMENT B_bkdvel "Bedingung: DV-E Lageabweichung" UWORD B_TRUE 1 100 0 1 BIT_MASK 0x40 FORMAT "%13.11" ECU_ADDRESS 0x3FDD54 /end MEASUREMENT
/begin MEASUREMENT B_bkdven "Ersatzwert aktiv: DV-E Notluftposition" UWORD B_TRUE 1 100 0 1 BIT_MASK 0x40 FORMAT "%13.11" ECU_ADDRESS 0x3FDD56 /end MEASUREMENT
/begin MEASUREMENT B_bkdver "Bedingung: DV-E Regelbereich" UWORD B_TRUE 1 100 0 1 BIT_MASK 0x40 FORMAT "%13.11" ECU_ADDRESS 0x3FDD58 /end MEASUREMENT
/begin MEASUREMENT B_bkdvet "" UWORD B_TRUE 1 100 0 1 BIT_MASK 0x40 FORMAT "%13.11" ECU_ADDRESS 0x3FDD5A /end MEASUREMENT
/begin MEASUREMENT B_bkdveu "Ersatzwert aktiv: DV-E UMA-Lernen" UWORD B_TRUE 1 100 0 1 BIT_MASK 0x40 FORMAT "%13.11" ECU_ADDRESS 0x3FDD5C /end MEASUREMENT
/begin MEASUREMENT B_bkdveub "" UWORD B_TRUE 1 100 0 1 BIT_MASK 0x40 FORMAT "%13.11" ECU_ADDRESS 0x3FDD5E /end MEASUREMENT
/begin MEASUREMENT B_bkdveuw "Bedingung Ersatzwert aktiv: Fehler bei UMA-Wiederlernen" UWORD B_TRUE 1 100 0 1 BIT_MASK 0x40 FORMAT "%13.11" ECU_ADDRESS 0x3FDD60 /end MEASUREMENT
/begin MEASUREMENT B_bkdvev "Ersatzwert aktiv: DV-E Verst‰rkerabgleich" UWORD B_TRUE 1 100 0 1 BIT_MASK 0x40 FORMAT "%13.11" ECU_ADDRESS 0x3FDD62 /end MEASUREMENT
/begin MEASUREMENT B_bkels "Bedingung Ersatzwert aktiv E-Box-L¸fter" UWORD B_TRUE 1 100 0 1 BIT_MASK 0x40 FORMAT "%13.11" ECU_ADDRESS 0x3FDD78 /end MEASUREMENT
/begin MEASUREMENT B_bkets "Bedingung: Ersatzwert aktiv bei el. Thermostat-Endstufe" UWORD B_TRUE 1 100 0 1 BIT_MASK 0x40 FORMAT "%13.11" ECU_ADDRESS 0x3FDD7E /end MEASUREMENT
/begin MEASUREMENT B_bkev1 "Bedingung: Einspritzventil 1 aktiv" UWORD B_TRUE 1 100 0 1 BIT_MASK 0x40 FORMAT "%13.11" ECU_ADDRESS 0x3FDD80 /end MEASUREMENT
/begin MEASUREMENT B_bkev2 "Bedingung: Einspritzventil 2 aktiv" UWORD B_TRUE 1 100 0 1 BIT_MASK 0x40 FORMAT "%13.11" ECU_ADDRESS 0x3FDD82 /end MEASUREMENT
/begin MEASUREMENT B_bkev3 "Bedingung: Einspritzventil 3 aktiv" UWORD B_TRUE 1 100 0 1 BIT_MASK 0x40 FORMAT "%13.11" ECU_ADDRESS 0x3FDD84 /end MEASUREMENT
/begin MEASUREMENT B_bkev4 "Bedingung: Einspritzventil 4 aktiv" UWORD B_TRUE 1 100 0 1 BIT_MASK 0x40 FORMAT "%13.11" ECU_ADDRESS 0x3FDD86 /end MEASUREMENT
/begin MEASUREMENT B_bkezh "" UWORD B_TRUE 1 100 0 1 BIT_MASK 0x40 FORMAT "%13.11" ECU_ADDRESS 0x3FDD90 /end MEASUREMENT
/begin MEASUREMENT B_bkhsh "Bedingung: Lambdasondenheizung hinter Kat. aktiv" UWORD B_TRUE 1 100 0 1 BIT_MASK 0x40 FORMAT "%13.11" ECU_ADDRESS 0x3FDDA0 /end MEASUREMENT
/begin MEASUREMENT B_bkhsh2 "Bedingung: Lambdasondenheizung hinter Kat. aktiv, Bank 2" UWORD B_TRUE 1 100 0 1 BIT_MASK 0x40 FORMAT "%13.11" ECU_ADDRESS 0x3FDDA2 /end MEASUREMENT
/begin MEASUREMENT B_bkhsv "Bedingung:Lambdasondenheizung vor Kat. aktiv" UWORD B_TRUE 1 100 0 1 BIT_MASK 0x40 FORMAT "%13.11" ECU_ADDRESS 0x3FDDA4 /end MEASUREMENT
/begin MEASUREMENT B_bkhsv2 "Bedingung:Lambdasondenheizung vor Kat. aktiv, Bank 2" UWORD B_TRUE 1 100 0 1 BIT_MASK 0x40 FORMAT "%13.11" ECU_ADDRESS 0x3FDDA6 /end MEASUREMENT
/begin MEASUREMENT B_bkkat "Bedingung Ersatzwert f¸r Katalysator" UWORD B_TRUE 1 100 0 1 BIT_MASK 0x40 FORMAT "%13.11" ECU_ADDRESS 0x3FDDAA /end MEASUREMENT
/begin MEASUREMENT B_bkkkue "" UWORD B_TRUE 1 100 0 1 BIT_MASK 0x40 FORMAT "%13.11" ECU_ADDRESS 0x3FDDAE /end MEASUREMENT
/begin MEASUREMENT B_bkkose "Bedingung: Ersatzwert aktiv bei Klimakompressor" UWORD B_TRUE 1 100 0 1 BIT_MASK 0x40 FORMAT "%13.11" ECU_ADDRESS 0x3FDDB0 /end MEASUREMENT
/begin MEASUREMENT B_bkkpe "Bedingung Ersatzwert f¸r EKP-Relais Endstufe" UWORD B_TRUE 1 100 0 1 BIT_MASK 0x40 FORMAT "%13.11" ECU_ADDRESS 0x3FDDB2 /end MEASUREMENT
/begin MEASUREMENT B_bkkrnt "Bedingung: Klopfregelung Nulltest aktiv" UWORD B_TRUE 1 100 0 1 BIT_MASK 0x40 FORMAT "%13.11" ECU_ADDRESS 0x3FDDB4 /end MEASUREMENT
/begin MEASUREMENT B_bkkrof "Bedingung: Klopfregelung Offset aktiv" UWORD B_TRUE 1 100 0 1 BIT_MASK 0x40 FORMAT "%13.11" ECU_ADDRESS 0x3FDDB6 /end MEASUREMENT
/begin MEASUREMENT B_bklde "Bedingung: Ladedrucksteuerventil Endstufe aktiv" UWORD B_TRUE 1 100 0 1 BIT_MASK 0x40 FORMAT "%13.11" ECU_ADDRESS 0x3FDDCC /end MEASUREMENT
/begin MEASUREMENT B_bkldpe "Bedingung: Leckdiagnosemodul Endstufe aktiv" UWORD B_TRUE 1 100 0 1 BIT_MASK 0x40 FORMAT "%13.11" ECU_ADDRESS 0x3FDDD0 /end MEASUREMENT
/begin MEASUREMENT B_bklm "Bedingung: Hauptlastsensor aktiv" UWORD B_TRUE 1 100 0 1 BIT_MASK 0x40 FORMAT "%13.11" ECU_ADDRESS 0x3FDDD4 /end MEASUREMENT
/begin MEASUREMENT B_bkluea "Bedingung Ersatzwert aktiv: Motor-L¸fter Endstufe A" UWORD B_TRUE 1 100 0 1 BIT_MASK 0x40 FORMAT "%13.11" ECU_ADDRESS 0x3FDDDC /end MEASUREMENT
/begin MEASUREMENT B_bkluve "Bedingung: EV-Luftumfassungsventil Endstufe" UWORD B_TRUE 1 100 0 1 BIT_MASK 0x40 FORMAT "%13.11" ECU_ADDRESS 0x3FDDDE /end MEASUREMENT
/begin MEASUREMENT B_bkn "Bedingung: Drehzahlsignalgeber aktiv" UWORD B_TRUE 1 100 0 1 BIT_MASK 0x40 FORMAT "%13.11" ECU_ADDRESS 0x3FDE02 /end MEASUREMENT
/begin MEASUREMENT B_bkstae "Bedingung Ersatzwert f¸r Starter Relais Endstufe" UWORD B_TRUE 1 100 0 1 BIT_MASK 0x40 FORMAT "%13.11" ECU_ADDRESS 0x3FDE20 /end MEASUREMENT
/begin MEASUREMENT B_bkswe "Bedingung Ersatzwert aktiv: Schlechtwegerkennung" UWORD B_TRUE 1 100 0 1 BIT_MASK 0x40 FORMAT "%13.11" ECU_ADDRESS 0x3FDE24 /end MEASUREMENT
/begin MEASUREMENT B_clas "Bedingung Fehlerpfad ASR/TC Schnittstelle lˆschen" UWORD B_TRUE 1 100 0 1 BIT_MASK 0x80 FORMAT "%13.11" ECU_ADDRESS 0x3FDD20 /end MEASUREMENT
/begin MEASUREMENT B_clbkvpe "Bedingung Fehlerpfad Bremskraftverst‰rker-Pumpe-Endstufe lˆschen" UWORD B_TRUE 1 100 0 1 BIT_MASK 0x80 FORMAT "%13.11" ECU_ADDRESS 0x3FDD24 /end MEASUREMENT
/begin MEASUREMENT B_clbm "Bedingung Fehlerpfad Bezugsmarkengeber lˆschen" UWORD B_TRUE 1 100 0 1 BIT_MASK 0x80 FORMAT "%13.11" ECU_ADDRESS 0x3FDD26 /end MEASUREMENT
/begin MEASUREMENT B_clcana "" UWORD B_TRUE 1 100 0 1 BIT_MASK 0x80 FORMAT "%13.11" ECU_ADDRESS 0x3FDD2C /end MEASUREMENT
/begin MEASUREMENT B_clcas "Bedingung Fehlerpfad CAS lˆschen" UWORD B_TRUE 1 100 0 1 BIT_MASK 0x80 FORMAT "%13.11" ECU_ADDRESS 0x3FDD2E /end MEASUREMENT
/begin MEASUREMENT B_clcez "" UWORD B_TRUE 1 100 0 1 BIT_MASK 0x80 FORMAT "%13.11" ECU_ADDRESS 0x3FDD30 /end MEASUREMENT
/begin MEASUREMENT B_clcge "Bedingung Fehlerpfad CGE lˆschen" UWORD B_TRUE 1 100 0 1 BIT_MASK 0x80 FORMAT "%13.11" ECU_ADDRESS 0x3FDD32 /end MEASUREMENT
/begin MEASUREMENT B_clcins "Bedingung Fehlerpfad CINS lˆschen" UWORD B_TRUE 1 100 0 1 BIT_MASK 0x80 FORMAT "%13.11" ECU_ADDRESS 0x3FDD34 /end MEASUREMENT
/begin MEASUREMENT B_clcod "Bedingung Fehlerpfad E_COD lˆschen" UWORD B_TRUE 1 100 0 1 BIT_MASK 0x80 FORMAT "%13.11" ECU_ADDRESS 0x3FDD36 /end MEASUREMENT
/begin MEASUREMENT B_cldisa "" UWORD B_TRUE 1 100 0 1 BIT_MASK 0x80 FORMAT "%13.11" ECU_ADDRESS 0x3FDD3E /end MEASUREMENT
/begin MEASUREMENT B_cldk "Bedingung Fehlerpfad DK (Drosselklappen-Poti) lˆschen" UWORD B_TRUE 1 100 0 1 BIT_MASK 0x80 FORMAT "%13.11" ECU_ADDRESS 0x3FDD40 /end MEASUREMENT
/begin MEASUREMENT B_cldk1p "Bedingung Fehlerpfad DK1P (Drosselklappen-Poti 1) lˆschen" UWORD B_TRUE 1 100 0 1 BIT_MASK 0x80 FORMAT "%13.11" ECU_ADDRESS 0x3FDD42 /end MEASUREMENT
/begin MEASUREMENT B_cldk2p "Bedingung Fehlerpfad DK2P (Drosselklappen-Poti 2) lˆschen" UWORD B_TRUE 1 100 0 1 BIT_MASK 0x80 FORMAT "%13.11" ECU_ADDRESS 0x3FDD44 /end MEASUREMENT
/begin MEASUREMENT B_cldvee "Flag f¸r Lˆschmaﬂnahmen: DV-E Endstufe" UWORD B_TRUE 1 100 0 1 BIT_MASK 0x80 FORMAT "%13.11" ECU_ADDRESS 0x3FDD4E /end MEASUREMENT
/begin MEASUREMENT B_cldvef "Flag f¸r Lˆschung: DV-E Fehler bei Federpr¸fung" UWORD B_TRUE 1 100 0 1 BIT_MASK 0x80 FORMAT "%13.11" ECU_ADDRESS 0x3FDD50 /end MEASUREMENT
/begin MEASUREMENT B_cldvefo "Flag f¸r Lˆschung: Fehler bei Federpr¸fung ""÷ffnen""" UWORD B_TRUE 1 100 0 1 BIT_MASK 0x80 FORMAT "%13.11" ECU_ADDRESS 0x3FDD52 /end MEASUREMENT
/begin MEASUREMENT B_cldvel "Flag f¸r Lˆschmaﬂnahmen: DV-E Lageabweichung" UWORD B_TRUE 1 100 0 1 BIT_MASK 0x80 FORMAT "%13.11" ECU_ADDRESS 0x3FDD54 /end MEASUREMENT
/begin MEASUREMENT B_cldven "Flag f¸r Lˆschung: DV-E Fehler bei Pr¸fung Notluftposition" UWORD B_TRUE 1 100 0 1 BIT_MASK 0x80 FORMAT "%13.11" ECU_ADDRESS 0x3FDD56 /end MEASUREMENT
/begin MEASUREMENT B_cldver "Flag f¸r Lˆschmaﬂnahmen: DV-E Regelabweichung" UWORD B_TRUE 1 100 0 1 BIT_MASK 0x80 FORMAT "%13.11" ECU_ADDRESS 0x3FDD58 /end MEASUREMENT
/begin MEASUREMENT B_cldvet "Flag f¸r Lˆschung: DV-E-Tauscherkennung ohne Adaption" UWORD B_TRUE 1 100 0 1 BIT_MASK 0x80 FORMAT "%13.11" ECU_ADDRESS 0x3FDD5A /end MEASUREMENT
/begin MEASUREMENT B_cldveu "Flag f¸r Lˆschung: DV-E Fehler beim UMA-Lernen" UWORD B_TRUE 1 100 0 1 BIT_MASK 0x80 FORMAT "%13.11" ECU_ADDRESS 0x3FDD5C /end MEASUREMENT
/begin MEASUREMENT B_cldveub "Flag f¸r Lˆschung: DV-E-Adaption Abbruch wg. Umweltbedingung" UWORD B_TRUE 1 100 0 1 BIT_MASK 0x80 FORMAT "%13.11" ECU_ADDRESS 0x3FDD5E /end MEASUREMENT
/begin MEASUREMENT B_cldveuw "Flag f¸r Lˆschung: Fehler bei UMA-Wiederlernen" UWORD B_TRUE 1 100 0 1 BIT_MASK 0x80 FORMAT "%13.11" ECU_ADDRESS 0x3FDD60 /end MEASUREMENT
/begin MEASUREMENT B_cldvev "Flag f¸r Lˆschung: DV-E Fehler bei Verst‰rkerabgleich" UWORD B_TRUE 1 100 0 1 BIT_MASK 0x80 FORMAT "%13.11" ECU_ADDRESS 0x3FDD62 /end MEASUREMENT
/begin MEASUREMENT B_clels "Bedingung Fehlerpfad ELS lˆschen" UWORD B_TRUE 1 100 0 1 BIT_MASK 0x80 FORMAT "%13.11" ECU_ADDRESS 0x3FDD78 /end MEASUREMENT
/begin MEASUREMENT B_clets "Bedingung Fehlerpfad ETS lˆschen" UWORD B_TRUE 1 100 0 1 BIT_MASK 0x80 FORMAT "%13.11" ECU_ADDRESS 0x3FDD7E /end MEASUREMENT
/begin MEASUREMENT B_clev1 "Bedingung Fehlerpfad EV 1 lˆschen" UWORD B_TRUE 1 100 0 1 BIT_MASK 0x80 FORMAT "%13.11" ECU_ADDRESS 0x3FDD80 /end MEASUREMENT
/begin MEASUREMENT B_clev2 "Bedingung Fehlerpfad EV 2 lˆschen" UWORD B_TRUE 1 100 0 1 BIT_MASK 0x80 FORMAT "%13.11" ECU_ADDRESS 0x3FDD82 /end MEASUREMENT
/begin MEASUREMENT B_clev3 "Bedingung Fehlerpfad EV 3 lˆschen" UWORD B_TRUE 1 100 0 1 BIT_MASK 0x80 FORMAT "%13.11" ECU_ADDRESS 0x3FDD84 /end MEASUREMENT
/begin MEASUREMENT B_clev4 "Bedingung Fehlerpfad EV 4 lˆschen" UWORD B_TRUE 1 100 0 1 BIT_MASK 0x80 FORMAT "%13.11" ECU_ADDRESS 0x3FDD86 /end MEASUREMENT
/begin MEASUREMENT B_clezh "" UWORD B_TRUE 1 100 0 1 BIT_MASK 0x80 FORMAT "%13.11" ECU_ADDRESS 0x3FDD90 /end MEASUREMENT
/begin MEASUREMENT B_clhsh "Bedingung Fehlerpfad DHLSHK lˆschen" UWORD B_TRUE 1 100 0 1 BIT_MASK 0x80 FORMAT "%13.11" ECU_ADDRESS 0x3FDDA0 /end MEASUREMENT
/begin MEASUREMENT B_clhsh2 "Bedingung Fehlerpfad DHLSHK2 lˆschen" UWORD B_TRUE 1 100 0 1 BIT_MASK 0x80 FORMAT "%13.11" ECU_ADDRESS 0x3FDDA2 /end MEASUREMENT
/begin MEASUREMENT B_clhsv "Bedingung Fehlerpfad DHLSVK lˆschen" UWORD B_TRUE 1 100 0 1 BIT_MASK 0x80 FORMAT "%13.11" ECU_ADDRESS 0x3FDDA4 /end MEASUREMENT
/begin MEASUREMENT B_clhsv2 "Bedingung Fehlerpfad DHLSVK2 lˆschen" UWORD B_TRUE 1 100 0 1 BIT_MASK 0x80 FORMAT "%13.11" ECU_ADDRESS 0x3FDDA6 /end MEASUREMENT
/begin MEASUREMENT B_clkat "Bedingung Fehlerpfad DKAT lˆschen" UWORD B_TRUE 1 100 0 1 BIT_MASK 0x80 FORMAT "%13.11" ECU_ADDRESS 0x3FDDAA /end MEASUREMENT
/begin MEASUREMENT B_clkkue "" UWORD B_TRUE 1 100 0 1 BIT_MASK 0x80 FORMAT "%13.11" ECU_ADDRESS 0x3FDDAE /end MEASUREMENT
/begin MEASUREMENT B_clkose "Bedingung: Fehlerpfad Endstufe Klimakompressor lˆschen" UWORD B_TRUE 1 100 0 1 BIT_MASK 0x80 FORMAT "%13.11" ECU_ADDRESS 0x3FDDB0 /end MEASUREMENT
/begin MEASUREMENT B_clkpe "Bedingung Fehlerpfad EKP-Relais Endstufe lˆschen" UWORD B_TRUE 1 100 0 1 BIT_MASK 0x80 FORMAT "%13.11" ECU_ADDRESS 0x3FDDB2 /end MEASUREMENT
/begin MEASUREMENT B_clkrnt "Bedingung Fehlerpfad KR-Diagnose Integratorsteigung lˆschen" UWORD B_TRUE 1 100 0 1 BIT_MASK 0x80 FORMAT "%13.11" ECU_ADDRESS 0x3FDDB4 /end MEASUREMENT
/begin MEASUREMENT B_clkrof "Bedingung Fehlerpfad KR-Diagnose Resetwert lˆschen" UWORD B_TRUE 1 100 0 1 BIT_MASK 0x80 FORMAT "%13.11" ECU_ADDRESS 0x3FDDB6 /end MEASUREMENT
/begin MEASUREMENT B_cllde "Bedingung Fehlerpfad LDE lˆschen" UWORD B_TRUE 1 100 0 1 BIT_MASK 0x80 FORMAT "%13.11" ECU_ADDRESS 0x3FDDCC /end MEASUREMENT
/begin MEASUREMENT B_clldpe "Bedingung: Fehlerpfad Endstufe LDP lˆschen" UWORD B_TRUE 1 100 0 1 BIT_MASK 0x80 FORMAT "%13.11" ECU_ADDRESS 0x3FDDD0 /end MEASUREMENT
/begin MEASUREMENT B_cllm "Bedingung: Fehlerpfad Hauptf¸llungssensor lˆschen" UWORD B_TRUE 1 100 0 1 BIT_MASK 0x80 FORMAT "%13.11" ECU_ADDRESS 0x3FDDD4 /end MEASUREMENT
/begin MEASUREMENT B_clluea "Bedingung: Fehlerpfad Endstufe Motor L¸fter A Lˆschen" UWORD B_TRUE 1 100 0 1 BIT_MASK 0x80 FORMAT "%13.11" ECU_ADDRESS 0x3FDDDC /end MEASUREMENT
/begin MEASUREMENT B_clluve "Bedingung EV-Luftumfassungsventil Endstufe lˆschen" UWORD B_TRUE 1 100 0 1 BIT_MASK 0x80 FORMAT "%13.11" ECU_ADDRESS 0x3FDDDE /end MEASUREMENT
/begin MEASUREMENT B_cln "Bedingung Fehlerpfad Drehzahlgeber lˆschen" UWORD B_TRUE 1 100 0 1 BIT_MASK 0x80 FORMAT "%13.11" ECU_ADDRESS 0x3FDE02 /end MEASUREMENT
/begin MEASUREMENT B_clstae "Bedingung: Fehlerpfad Endstufe Start Relais lˆschen" UWORD B_TRUE 1 100 0 1 BIT_MASK 0x80 FORMAT "%13.11" ECU_ADDRESS 0x3FDE20 /end MEASUREMENT
/begin MEASUREMENT B_clswe "Flag : Fehlerpfad Diagnose Beschleunigungssensor lˆschen" UWORD B_TRUE 1 100 0 1 BIT_MASK 0x80 FORMAT "%13.11" ECU_ADDRESS 0x3FDE24 /end MEASUREMENT
/begin MEASUREMENT B_fahsh "Bedingung Funktionsanforderung Diagnose Heizung Hinterkat-Lambdasonde" UWORD B_TRUE 1 100 0 1 BIT_MASK 0x10 FORMAT "%13.11" ECU_ADDRESS 0x3FDDA0 /end MEASUREMENT
/begin MEASUREMENT B_fahsh2 "" UWORD B_TRUE 1 100 0 1 BIT_MASK 0x10 FORMAT "%13.11" ECU_ADDRESS 0x3FDDA2 /end MEASUREMENT
/begin MEASUREMENT B_fahsv "Bedingung Funktionsanforderung Diagnose Heizung Vorkat-Lambdasonde" UWORD B_TRUE 1 100 0 1 BIT_MASK 0x10 FORMAT "%13.11" ECU_ADDRESS 0x3FDDA4 /end MEASUREMENT
/begin MEASUREMENT B_fahsv2 "" UWORD B_TRUE 1 100 0 1 BIT_MASK 0x10 FORMAT "%13.11" ECU_ADDRESS 0x3FDDA6 /end MEASUREMENT
/begin MEASUREMENT B_ftas "Bedingung: Fehlereintrag durch Tester f¸r ASR-Eingriff" UWORD B_TRUE 1 100 0 1 BIT_MASK 0x10 FORMAT "%13.11" ECU_ADDRESS 0x3FDD20 /end MEASUREMENT
/begin MEASUREMENT B_ftbkvpe "Bedingung: Fehlereintrag durch Tester f¸r BKV-Pumpe-Endstufe" UWORD B_TRUE 1 100 0 1 BIT_MASK 0x10 FORMAT "%13.11" ECU_ADDRESS 0x3FDD24 /end MEASUREMENT
/begin MEASUREMENT B_ftbm "" UWORD B_TRUE 1 100 0 1 BIT_MASK 0x10 FORMAT "%13.11" ECU_ADDRESS 0x3FDD26 /end MEASUREMENT
/begin MEASUREMENT B_ftcana "" UWORD B_TRUE 1 100 0 1 BIT_MASK 0x10 FORMAT "%13.11" ECU_ADDRESS 0x3FDD2C /end MEASUREMENT
/begin MEASUREMENT B_ftcas "Bedingung Fehlereintrag durch Tester: CAN-Schnittstelle ABS" UWORD B_TRUE 1 100 0 1 BIT_MASK 0x10 FORMAT "%13.11" ECU_ADDRESS 0x3FDD2E /end MEASUREMENT
/begin MEASUREMENT B_ftcez "" UWORD B_TRUE 1 100 0 1 BIT_MASK 0x10 FORMAT "%13.11" ECU_ADDRESS 0x3FDD30 /end MEASUREMENT
/begin MEASUREMENT B_ftcge "Bedingung Fehlereintrag durch Tester: CAN-Schnittstelle TCM" UWORD B_TRUE 1 100 0 1 BIT_MASK 0x10 FORMAT "%13.11" ECU_ADDRESS 0x3FDD32 /end MEASUREMENT
/begin MEASUREMENT B_ftcins "" UWORD B_TRUE 1 100 0 1 BIT_MASK 0x10 FORMAT "%13.11" ECU_ADDRESS 0x3FDD34 /end MEASUREMENT
/begin MEASUREMENT B_ftcod "Bedingung: Fehlereintrag durch Tester" UWORD B_TRUE 1 100 0 1 BIT_MASK 0x10 FORMAT "%13.11" ECU_ADDRESS 0x3FDD36 /end MEASUREMENT
/begin MEASUREMENT B_ftdisa "Pruefung durch Kundendiensttester" UWORD B_TRUE 1 100 0 1 BIT_MASK 0x10 FORMAT "%13.11" ECU_ADDRESS 0x3FDD3E /end MEASUREMENT
/begin MEASUREMENT B_ftdk "" UWORD B_TRUE 1 100 0 1 BIT_MASK 0x10 FORMAT "%13.11" ECU_ADDRESS 0x3FDD40 /end MEASUREMENT
/begin MEASUREMENT B_ftdk1p "" UWORD B_TRUE 1 100 0 1 BIT_MASK 0x10 FORMAT "%13.11" ECU_ADDRESS 0x3FDD42 /end MEASUREMENT
/begin MEASUREMENT B_ftdk2p "" UWORD B_TRUE 1 100 0 1 BIT_MASK 0x10 FORMAT "%13.11" ECU_ADDRESS 0x3FDD44 /end MEASUREMENT
/begin MEASUREMENT B_ftdvee "" UWORD B_TRUE 1 100 0 1 BIT_MASK 0x10 FORMAT "%13.11" ECU_ADDRESS 0x3FDD4E /end MEASUREMENT
/begin MEASUREMENT B_ftdvef "" UWORD B_TRUE 1 100 0 1 BIT_MASK 0x10 FORMAT "%13.11" ECU_ADDRESS 0x3FDD50 /end MEASUREMENT
/begin MEASUREMENT B_ftdvefo "" UWORD B_TRUE 1 100 0 1 BIT_MASK 0x10 FORMAT "%13.11" ECU_ADDRESS 0x3FDD52 /end MEASUREMENT
/begin MEASUREMENT B_ftdvel "" UWORD B_TRUE 1 100 0 1 BIT_MASK 0x10 FORMAT "%13.11" ECU_ADDRESS 0x3FDD54 /end MEASUREMENT
/begin MEASUREMENT B_ftdven "" UWORD B_TRUE 1 100 0 1 BIT_MASK 0x10 FORMAT "%13.11" ECU_ADDRESS 0x3FDD56 /end MEASUREMENT
/begin MEASUREMENT B_ftdver "" UWORD B_TRUE 1 100 0 1 BIT_MASK 0x10 FORMAT "%13.11" ECU_ADDRESS 0x3FDD58 /end MEASUREMENT
/begin MEASUREMENT B_ftdvet "" UWORD B_TRUE 1 100 0 1 BIT_MASK 0x10 FORMAT "%13.11" ECU_ADDRESS 0x3FDD5A /end MEASUREMENT
/begin MEASUREMENT B_ftdveu "" UWORD B_TRUE 1 100 0 1 BIT_MASK 0x10 FORMAT "%13.11" ECU_ADDRESS 0x3FDD5C /end MEASUREMENT
/begin MEASUREMENT B_ftdveub "" UWORD B_TRUE 1 100 0 1 BIT_MASK 0x10 FORMAT "%13.11" ECU_ADDRESS 0x3FDD5E /end MEASUREMENT
/begin MEASUREMENT B_ftdveuw "" UWORD B_TRUE 1 100 0 1 BIT_MASK 0x10 FORMAT "%13.11" ECU_ADDRESS 0x3FDD60 /end MEASUREMENT
/begin MEASUREMENT B_ftdvev "" UWORD B_TRUE 1 100 0 1 BIT_MASK 0x10 FORMAT "%13.11" ECU_ADDRESS 0x3FDD62 /end MEASUREMENT
/begin MEASUREMENT B_ftels "Bedingung: Fehlereintrag durch Tester f¸r E-Box-L¸fter" UWORD B_TRUE 1 100 0 1 BIT_MASK 0x10 FORMAT "%13.11" ECU_ADDRESS 0x3FDD78 /end MEASUREMENT
/begin MEASUREMENT B_ftets "Bedingung: Fehlereintrag durch Tester f¸r el. Thermostat-Endstufe" UWORD B_TRUE 1 100 0 1 BIT_MASK 0x10 FORMAT "%13.11" ECU_ADDRESS 0x3FDD7E /end MEASUREMENT
/begin MEASUREMENT B_ftev1 "Bedingung: Fehlereintrag durch Tester f¸r Endstufendiagnose EV1" UWORD B_TRUE 1 100 0 1 BIT_MASK 0x10 FORMAT "%13.11" ECU_ADDRESS 0x3FDD80 /end MEASUREMENT
/begin MEASUREMENT B_ftev2 "Bedingung: Fehlereintrag durch Tester f¸r Endstufendiagnose EV2" UWORD B_TRUE 1 100 0 1 BIT_MASK 0x10 FORMAT "%13.11" ECU_ADDRESS 0x3FDD82 /end MEASUREMENT
/begin MEASUREMENT B_ftev3 "Bedingung: Fehlereintrag durch Tester f¸r Endstufendiagnose EV3" UWORD B_TRUE 1 100 0 1 BIT_MASK 0x10 FORMAT "%13.11" ECU_ADDRESS 0x3FDD84 /end MEASUREMENT
/begin MEASUREMENT B_ftev4 "Bedingung: Fehlereintrag durch Tester f¸r Endstufendiagnose EV4" UWORD B_TRUE 1 100 0 1 BIT_MASK 0x10 FORMAT "%13.11" ECU_ADDRESS 0x3FDD86 /end MEASUREMENT
/begin MEASUREMENT B_ftezh "" UWORD B_TRUE 1 100 0 1 BIT_MASK 0x10 FORMAT "%13.11" ECU_ADDRESS 0x3FDD90 /end MEASUREMENT
/begin MEASUREMENT B_ftkat "Bedingung: Fehlereintrag durch Tester f¸r Katalysator" UWORD B_TRUE 1 100 0 1 BIT_MASK 0x10 FORMAT "%13.11" ECU_ADDRESS 0x3FDDAA /end MEASUREMENT
/begin MEASUREMENT B_ftkkue "" UWORD B_TRUE 1 100 0 1 BIT_MASK 0x10 FORMAT "%13.11" ECU_ADDRESS 0x3FDDAE /end MEASUREMENT
/begin MEASUREMENT B_ftkose "Bedingung: Fehlereintrag durch Tester f¸r Klimakompressor" UWORD B_TRUE 1 100 0 1 BIT_MASK 0x10 FORMAT "%13.11" ECU_ADDRESS 0x3FDDB0 /end MEASUREMENT
/begin MEASUREMENT B_ftkpe "Bedingung: Fehlereintrag durch Tester f¸r Endstufendiagnose EKP" UWORD B_TRUE 1 100 0 1 BIT_MASK 0x10 FORMAT "%13.11" ECU_ADDRESS 0x3FDDB2 /end MEASUREMENT
/begin MEASUREMENT B_ftkrnt "" UWORD B_TRUE 1 100 0 1 BIT_MASK 0x10 FORMAT "%13.11" ECU_ADDRESS 0x3FDDB4 /end MEASUREMENT
/begin MEASUREMENT B_ftkrof "" UWORD B_TRUE 1 100 0 1 BIT_MASK 0x10 FORMAT "%13.11" ECU_ADDRESS 0x3FDDB6 /end MEASUREMENT
/begin MEASUREMENT B_ftlde "Bedingung: Fehlereintrag durch Ladedrucksteuerventil (Tester)" UWORD B_TRUE 1 100 0 1 BIT_MASK 0x10 FORMAT "%13.11" ECU_ADDRESS 0x3FDDCC /end MEASUREMENT
/begin MEASUREMENT B_ftldpe "" UWORD B_TRUE 1 100 0 1 BIT_MASK 0x10 FORMAT "%13.11" ECU_ADDRESS 0x3FDDD0 /end MEASUREMENT
/begin MEASUREMENT B_ftlm "Bedingung: Fehlereintrag durch Tester f¸r Luftmassensensor (HFM/DSS/DK)" UWORD B_TRUE 1 100 0 1 BIT_MASK 0x10 FORMAT "%13.11" ECU_ADDRESS 0x3FDDD4 /end MEASUREMENT
/begin MEASUREMENT B_ftluea "Bedingung: Fehlereintrag durch Tester f¸r L¸fter Endstufe A" UWORD B_TRUE 1 100 0 1 BIT_MASK 0x10 FORMAT "%13.11" ECU_ADDRESS 0x3FDDDC /end MEASUREMENT
/begin MEASUREMENT B_ftluve "" UWORD B_TRUE 1 100 0 1 BIT_MASK 0x10 FORMAT "%13.11" ECU_ADDRESS 0x3FDDDE /end MEASUREMENT
/begin MEASUREMENT B_ftn "" UWORD B_TRUE 1 100 0 1 BIT_MASK 0x10 FORMAT "%13.11" ECU_ADDRESS 0x3FDE02 /end MEASUREMENT
/begin MEASUREMENT B_ftstae "Bedingung: Fehlereintrag durch Tester f¸r Endstufendiagnose Starter Relais" UWORD B_TRUE 1 100 0 1 BIT_MASK 0x10 FORMAT "%13.11" ECU_ADDRESS 0x3FDE20 /end MEASUREMENT
/begin MEASUREMENT B_ftswe "Bedingung Fehlereintrag durch Tester:  Schlechtwegerkennung" UWORD B_TRUE 1 100 0 1 BIT_MASK 0x10 FORMAT "%13.11" ECU_ADDRESS 0x3FDE24 /end MEASUREMENT
/begin MEASUREMENT B_mnas "Fehlertyp min.: ASR-Eingriff" UWORD B_TRUE 1 100 0 1 BIT_MASK 0x200 FORMAT "%13.11" ECU_ADDRESS 0x3FDD20 /end MEASUREMENT
/begin MEASUREMENT B_mnbkvpe "Fehlerart: Kurzschluﬂ Masse an BKV-Pumpe-Endstufe" UWORD B_TRUE 1 100 0 1 BIT_MASK 0x200 FORMAT "%13.11" ECU_ADDRESS 0x3FDD24 /end MEASUREMENT
/begin MEASUREMENT B_mnbm "Fehlertyp: h‰ufige Korrektur bei einem Zahn zuwenig" UWORD B_TRUE 1 100 0 1 BIT_MASK 0x200 FORMAT "%13.11" ECU_ADDRESS 0x3FDD26 /end MEASUREMENT
/begin MEASUREMENT B_mncana "Bedingung min-Fehler,  DPRAM defekt (von CAN_A)" UWORD B_TRUE 1 100 0 1 BIT_MASK 0x200 FORMAT "%13.11" ECU_ADDRESS 0x3FDD2C /end MEASUREMENT
/begin MEASUREMENT B_mncas "Fehlertyp min.: CAN-Schnittstelle, Timeout ASC" UWORD B_TRUE 1 100 0 1 BIT_MASK 0x200 FORMAT "%13.11" ECU_ADDRESS 0x3FDD2E /end MEASUREMENT
/begin MEASUREMENT B_mncez "" UWORD B_TRUE 1 100 0 1 BIT_MASK 0x200 FORMAT "%13.11" ECU_ADDRESS 0x3FDD30 /end MEASUREMENT
/begin MEASUREMENT B_mncge "Fehlertyp min.: CAN-Schnittstelle, Timeout EGS" UWORD B_TRUE 1 100 0 1 BIT_MASK 0x200 FORMAT "%13.11" ECU_ADDRESS 0x3FDD32 /end MEASUREMENT
/begin MEASUREMENT B_mncins "Fehlertyp min.: CAN-Schnittstelle, Timeout Instrument" UWORD B_TRUE 1 100 0 1 BIT_MASK 0x200 FORMAT "%13.11" ECU_ADDRESS 0x3FDD34 /end MEASUREMENT
/begin MEASUREMENT B_mncod "Fehlertyp Min: Steuerger‰t noch nicht codiert" UWORD B_TRUE 1 100 0 1 BIT_MASK 0x200 FORMAT "%13.11" ECU_ADDRESS 0x3FDD36 /end MEASUREMENT
/begin MEASUREMENT B_mndisa "Minimalwert unterschritten" UWORD B_TRUE 1 100 0 1 BIT_MASK 0x200 FORMAT "%13.11" ECU_ADDRESS 0x3FDD3E /end MEASUREMENT
/begin MEASUREMENT B_mndk "Fehlertype: Kurzschluﬂ nach Masse Drosselklappenpoti" UWORD B_TRUE 1 100 0 1 BIT_MASK 0x200 FORMAT "%13.11" ECU_ADDRESS 0x3FDD40 /end MEASUREMENT
/begin MEASUREMENT B_mndk1p "Fehlertyp min.: Drosselklappe 1. Poti" UWORD B_TRUE 1 100 0 1 BIT_MASK 0x200 FORMAT "%13.11" ECU_ADDRESS 0x3FDD42 /end MEASUREMENT
/begin MEASUREMENT B_mndk2p "Fehlertyp min.: Drosselklappe 2. Poti" UWORD B_TRUE 1 100 0 1 BIT_MASK 0x200 FORMAT "%13.11" ECU_ADDRESS 0x3FDD44 /end MEASUREMENT
/begin MEASUREMENT B_mndvee "Fehlerzyp min.: DV-E Endstufe" UWORD B_TRUE 1 100 0 1 BIT_MASK 0x200 FORMAT "%13.11" ECU_ADDRESS 0x3FDD4E /end MEASUREMENT
/begin MEASUREMENT B_mndvef "Fehlertyp min.: DV-E Fehler bei Pr¸fung der ˆffnenden Feder" UWORD B_TRUE 1 100 0 1 BIT_MASK 0x200 FORMAT "%13.11" ECU_ADDRESS 0x3FDD50 /end MEASUREMENT
/begin MEASUREMENT B_mndvefo "Fehlertyp min.: Fehler bei Federpr¸fung ""÷ffnen""" UWORD B_TRUE 1 100 0 1 BIT_MASK 0x200 FORMAT "%13.11" ECU_ADDRESS 0x3FDD52 /end MEASUREMENT
/begin MEASUREMENT B_mndvel "Fehlertyp min.: DV-E Lageabweichung" UWORD B_TRUE 1 100 0 1 BIT_MASK 0x200 FORMAT "%13.11" ECU_ADDRESS 0x3FDD54 /end MEASUREMENT
/begin MEASUREMENT B_mndven "Fehlertyp min.: DV-E Fehler bei Pr¸fung Notluftposition" UWORD B_TRUE 1 100 0 1 BIT_MASK 0x200 FORMAT "%13.11" ECU_ADDRESS 0x3FDD56 /end MEASUREMENT
/begin MEASUREMENT B_mndver "Fehlerzyp min.: DV-E Regelbereich, kurzfristig ¸berschritten" UWORD B_TRUE 1 100 0 1 BIT_MASK 0x200 FORMAT "%13.11" ECU_ADDRESS 0x3FDD58 /end MEASUREMENT
/begin MEASUREMENT B_mndvet "" UWORD B_TRUE 1 100 0 1 BIT_MASK 0x200 FORMAT "%13.11" ECU_ADDRESS 0x3FDD5A /end MEASUREMENT
/begin MEASUREMENT B_mndveu "Fehlertyp min.: DV-E Fehler beim UMA-Lernen" UWORD B_TRUE 1 100 0 1 BIT_MASK 0x200 FORMAT "%13.11" ECU_ADDRESS 0x3FDD5C /end MEASUREMENT
/begin MEASUREMENT B_mndveub "Fehlertyp min.: DV-E-Adaption Abbruch wg. Umweltbed/Unterspng" UWORD B_TRUE 1 100 0 1 BIT_MASK 0x200 FORMAT "%13.11" ECU_ADDRESS 0x3FDD5E /end MEASUREMENT
/begin MEASUREMENT B_mndveuw "" UWORD B_TRUE 1 100 0 1 BIT_MASK 0x200 FORMAT "%13.11" ECU_ADDRESS 0x3FDD60 /end MEASUREMENT
/begin MEASUREMENT B_mndvev "Fehlertyp min.: DV-E Fehler bei Verst‰rkerabgleich" UWORD B_TRUE 1 100 0 1 BIT_MASK 0x200 FORMAT "%13.11" ECU_ADDRESS 0x3FDD62 /end MEASUREMENT
/begin MEASUREMENT B_mnels "Fehlertype: Kurzschluﬂ nach Masse Endstufe E-Box L¸fter" UWORD B_TRUE 1 100 0 1 BIT_MASK 0x200 FORMAT "%13.11" ECU_ADDRESS 0x3FDD78 /end MEASUREMENT
/begin MEASUREMENT B_mnets "Fehlertype: Kurzschluﬂ nach Masse Endstufe Elektr. Thermostat" UWORD B_TRUE 1 100 0 1 BIT_MASK 0x200 FORMAT "%13.11" ECU_ADDRESS 0x3FDD7E /end MEASUREMENT
/begin MEASUREMENT B_mnev1 "Fehlerart: Kurzschluﬂ Masse an Endstufe EV1" UWORD B_TRUE 1 100 0 1 BIT_MASK 0x200 FORMAT "%13.11" ECU_ADDRESS 0x3FDD80 /end MEASUREMENT
/begin MEASUREMENT B_mnev2 "Fehlerart: Kurzschluﬂ Masse an Endstufe EV2" UWORD B_TRUE 1 100 0 1 BIT_MASK 0x200 FORMAT "%13.11" ECU_ADDRESS 0x3FDD82 /end MEASUREMENT
/begin MEASUREMENT B_mnev3 "Fehlerart: Kurzschluﬂ Masse an Endstufe EV3" UWORD B_TRUE 1 100 0 1 BIT_MASK 0x200 FORMAT "%13.11" ECU_ADDRESS 0x3FDD84 /end MEASUREMENT
/begin MEASUREMENT B_mnev4 "Fehlerart: Kurzschluﬂ Masse an Endstufe EV4" UWORD B_TRUE 1 100 0 1 BIT_MASK 0x200 FORMAT "%13.11" ECU_ADDRESS 0x3FDD86 /end MEASUREMENT
/begin MEASUREMENT B_mnezh "" UWORD B_TRUE 1 100 0 1 BIT_MASK 0x200 FORMAT "%13.11" ECU_ADDRESS 0x3FDD90 /end MEASUREMENT
/begin MEASUREMENT B_mnhsh "Kurzschluﬂ Heizung Lambdasonde hinter Kat nach Masse" UWORD B_TRUE 1 100 0 1 BIT_MASK 0x200 FORMAT "%13.11" ECU_ADDRESS 0x3FDDA0 /end MEASUREMENT
/begin MEASUREMENT B_mnhsh2 "Kurzschluﬂ Heizung Lambdasonde2 hinter Kat nach Masse" UWORD B_TRUE 1 100 0 1 BIT_MASK 0x200 FORMAT "%13.11" ECU_ADDRESS 0x3FDDA2 /end MEASUREMENT
/begin MEASUREMENT B_mnhsv "Kurzschluﬂ Heizung Lambdasonde vor Kat nach Masse" UWORD B_TRUE 1 100 0 1 BIT_MASK 0x200 FORMAT "%13.11" ECU_ADDRESS 0x3FDDA4 /end MEASUREMENT
/begin MEASUREMENT B_mnhsv2 "Kurzschluﬂ Heizung Lambdasonde2 vor Kat nach Masse" UWORD B_TRUE 1 100 0 1 BIT_MASK 0x200 FORMAT "%13.11" ECU_ADDRESS 0x3FDDA6 /end MEASUREMENT
/begin MEASUREMENT B_mnkat "Fehlertyp 'Minimalwert' erkannt (Katalysator defekt)" UWORD B_TRUE 1 100 0 1 BIT_MASK 0x200 FORMAT "%13.11" ECU_ADDRESS 0x3FDDAA /end MEASUREMENT
/begin MEASUREMENT B_mnkkue "" UWORD B_TRUE 1 100 0 1 BIT_MASK 0x200 FORMAT "%13.11" ECU_ADDRESS 0x3FDDAE /end MEASUREMENT
/begin MEASUREMENT B_mnkose "Fehlertype: Kurzschluﬂ nach Masse Endstufe Klimakompressor" UWORD B_TRUE 1 100 0 1 BIT_MASK 0x200 FORMAT "%13.11" ECU_ADDRESS 0x3FDDB0 /end MEASUREMENT
/begin MEASUREMENT B_mnkpe "Bedingung f¸r Fehlertyp Kurzschluﬂ nach Masse f¸r EKP-Relais Endstufe erkannt" UWORD B_TRUE 1 100 0 1 BIT_MASK 0x200 FORMAT "%13.11" ECU_ADDRESS 0x3FDDB2 /end MEASUREMENT
/begin MEASUREMENT B_mnkrnt "Fehlertyp min.: Klopfregelung Nulltest" UWORD B_TRUE 1 100 0 1 BIT_MASK 0x200 FORMAT "%13.11" ECU_ADDRESS 0x3FDDB4 /end MEASUREMENT
/begin MEASUREMENT B_mnkrof "Fehlertyp min.: Klopfregelung Offset" UWORD B_TRUE 1 100 0 1 BIT_MASK 0x200 FORMAT "%13.11" ECU_ADDRESS 0x3FDDB6 /end MEASUREMENT
/begin MEASUREMENT B_mnlde "Fehlertyp: Kurzschluﬂ Masse LDR-Taktventil" UWORD B_TRUE 1 100 0 1 BIT_MASK 0x200 FORMAT "%13.11" ECU_ADDRESS 0x3FDDCC /end MEASUREMENT
/begin MEASUREMENT B_mnldpe "Fehlertype: Kurzschluﬂ nach Masse LDP-Endstufe" UWORD B_TRUE 1 100 0 1 BIT_MASK 0x200 FORMAT "%13.11" ECU_ADDRESS 0x3FDDD0 /end MEASUREMENT
/begin MEASUREMENT B_mnlm "Bedingung: min-Fehler Hauptf¸llungssensor" UWORD B_TRUE 1 100 0 1 BIT_MASK 0x200 FORMAT "%13.11" ECU_ADDRESS 0x3FDDD4 /end MEASUREMENT
/begin MEASUREMENT B_mnluea "Fehlertype: Kurzschluﬂ nach Masse Endstufe Motor L¸fter A" UWORD B_TRUE 1 100 0 1 BIT_MASK 0x200 FORMAT "%13.11" ECU_ADDRESS 0x3FDDDC /end MEASUREMENT
/begin MEASUREMENT B_mnluve "Fehlertyp min.: EV-Luftumfassungsventil Endstufe" UWORD B_TRUE 1 100 0 1 BIT_MASK 0x200 FORMAT "%13.11" ECU_ADDRESS 0x3FDDDE /end MEASUREMENT
/begin MEASUREMENT B_mnn "Fehlerart: Synchronisationsmarke h‰ufig nicht gefunden" UWORD B_TRUE 1 100 0 1 BIT_MASK 0x200 FORMAT "%13.11" ECU_ADDRESS 0x3FDE02 /end MEASUREMENT
/begin MEASUREMENT B_mnstae "Fehlertype: Kurzschluﬂ nach Masse Endstufe Start Relais" UWORD B_TRUE 1 100 0 1 BIT_MASK 0x200 FORMAT "%13.11" ECU_ADDRESS 0x3FDE20 /end MEASUREMENT
/begin MEASUREMENT B_mnswe "Beschleunigungssensorsignal kleiner als Plausibilit‰tsschwelle" UWORD B_TRUE 1 100 0 1 BIT_MASK 0x200 FORMAT "%13.11" ECU_ADDRESS 0x3FDE24 /end MEASUREMENT
/begin MEASUREMENT B_mxas "Fehlertyp max.: ASR-Eingriff" UWORD B_TRUE 1 100 0 1 BIT_MASK 0x100 FORMAT "%13.11" ECU_ADDRESS 0x3FDD20 /end MEASUREMENT
/begin MEASUREMENT B_mxbkvpe "Fehlerart: Kurzschluﬂ Ubat an BKV-Pumpe-Endstufe" UWORD B_TRUE 1 100 0 1 BIT_MASK 0x100 FORMAT "%13.11" ECU_ADDRESS 0x3FDD24 /end MEASUREMENT
/begin MEASUREMENT B_mxbm "Fehlertyp: h‰ufige Korrektur bei einem Zahn zuviel" UWORD B_TRUE 1 100 0 1 BIT_MASK 0x100 FORMAT "%13.11" ECU_ADDRESS 0x3FDD26 /end MEASUREMENT
/begin MEASUREMENT B_mxcana "Bedingung max-Fehler,   (CAN_A ""Error passiv"")" UWORD B_TRUE 1 100 0 1 BIT_MASK 0x100 FORMAT "%13.11" ECU_ADDRESS 0x3FDD2C /end MEASUREMENT
/begin MEASUREMENT B_mxcas "Fehlertyp max.: CAN-Schnittstelle, Timeout Botschaft ASC" UWORD B_TRUE 1 100 0 1 BIT_MASK 0x100 FORMAT "%13.11" ECU_ADDRESS 0x3FDD2E /end MEASUREMENT
/begin MEASUREMENT B_mxcez "" UWORD B_TRUE 1 100 0 1 BIT_MASK 0x100 FORMAT "%13.11" ECU_ADDRESS 0x3FDD30 /end MEASUREMENT
/begin MEASUREMENT B_mxcge "Fehlertyp max.: CAN-Schnittstelle, Timeout EGS" UWORD B_TRUE 1 100 0 1 BIT_MASK 0x100 FORMAT "%13.11" ECU_ADDRESS 0x3FDD32 /end MEASUREMENT
/begin MEASUREMENT B_mxcins "Fehlertyp max.: CAN-Schnittstelle, Timeout Instrument" UWORD B_TRUE 1 100 0 1 BIT_MASK 0x100 FORMAT "%13.11" ECU_ADDRESS 0x3FDD34 /end MEASUREMENT
/begin MEASUREMENT B_mxcod "Fehlertyp Max: Steuerger‰t noch nicht codiert" UWORD B_TRUE 1 100 0 1 BIT_MASK 0x100 FORMAT "%13.11" ECU_ADDRESS 0x3FDD36 /end MEASUREMENT
/begin MEASUREMENT B_mxdisa "Maximalwert ueberschritten" UWORD B_TRUE 1 100 0 1 BIT_MASK 0x100 FORMAT "%13.11" ECU_ADDRESS 0x3FDD3E /end MEASUREMENT
/begin MEASUREMENT B_mxdk "Fehlertype: Kurzschluﬂ nach Ubat Drosselklappenpoti" UWORD B_TRUE 1 100 0 1 BIT_MASK 0x100 FORMAT "%13.11" ECU_ADDRESS 0x3FDD40 /end MEASUREMENT
/begin MEASUREMENT B_mxdk1p "Fehlertyp max.: Drosselklappe 1. Poti" UWORD B_TRUE 1 100 0 1 BIT_MASK 0x100 FORMAT "%13.11" ECU_ADDRESS 0x3FDD42 /end MEASUREMENT
/begin MEASUREMENT B_mxdk2p "Fehlertyp max.: Drosselklappe 2. Poti" UWORD B_TRUE 1 100 0 1 BIT_MASK 0x100 FORMAT "%13.11" ECU_ADDRESS 0x3FDD44 /end MEASUREMENT
/begin MEASUREMENT B_mxdvee "Fehlertyp max.: DV-E Endstufe" UWORD B_TRUE 1 100 0 1 BIT_MASK 0x100 FORMAT "%13.11" ECU_ADDRESS 0x3FDD4E /end MEASUREMENT
/begin MEASUREMENT B_mxdvef "Fehlertyp max.: DV-E Fehler bei Pr¸fung der R¸ckstellfeder" UWORD B_TRUE 1 100 0 1 BIT_MASK 0x100 FORMAT "%13.11" ECU_ADDRESS 0x3FDD50 /end MEASUREMENT
/begin MEASUREMENT B_mxdvefo "Fehlertyp max.: Fehler bei Federpr¸fung ""÷ffnen""" UWORD B_TRUE 1 100 0 1 BIT_MASK 0x100 FORMAT "%13.11" ECU_ADDRESS 0x3FDD52 /end MEASUREMENT
/begin MEASUREMENT B_mxdvel "Fehlerzyp max.: DV-E Lageabweichung" UWORD B_TRUE 1 100 0 1 BIT_MASK 0x100 FORMAT "%13.11" ECU_ADDRESS 0x3FDD54 /end MEASUREMENT
/begin MEASUREMENT B_mxdven "Fehlertyp max.: DV-E Fehler bei Pr¸fung Notluftposition" UWORD B_TRUE 1 100 0 1 BIT_MASK 0x100 FORMAT "%13.11" ECU_ADDRESS 0x3FDD56 /end MEASUREMENT
/begin MEASUREMENT B_mxdver "Fehlertyp max.: DV-E Regelbereich, langfristig verletzt" UWORD B_TRUE 1 100 0 1 BIT_MASK 0x100 FORMAT "%13.11" ECU_ADDRESS 0x3FDD58 /end MEASUREMENT
/begin MEASUREMENT B_mxdvet "" UWORD B_TRUE 1 100 0 1 BIT_MASK 0x100 FORMAT "%13.11" ECU_ADDRESS 0x3FDD5A /end MEASUREMENT
/begin MEASUREMENT B_mxdveu "Fehlertyp max.: DV-E Fehler beim UMA-Lernen" UWORD B_TRUE 1 100 0 1 BIT_MASK 0x100 FORMAT "%13.11" ECU_ADDRESS 0x3FDD5C /end MEASUREMENT
/begin MEASUREMENT B_mxdveub "Fehlertyp max.: DV-E-Adaption Abbruch wg. Umweltbedingung" UWORD B_TRUE 1 100 0 1 BIT_MASK 0x100 FORMAT "%13.11" ECU_ADDRESS 0x3FDD5E /end MEASUREMENT
/begin MEASUREMENT B_mxdveuw "" UWORD B_TRUE 1 100 0 1 BIT_MASK 0x100 FORMAT "%13.11" ECU_ADDRESS 0x3FDD60 /end MEASUREMENT
/begin MEASUREMENT B_mxdvev "Fehlertyp max.: DV-E Fehler bei Verst‰rkerabgleich" UWORD B_TRUE 1 100 0 1 BIT_MASK 0x100 FORMAT "%13.11" ECU_ADDRESS 0x3FDD62 /end MEASUREMENT
/begin MEASUREMENT B_mxels "Fehlertype: Kurzschluﬂ nach Ubatt Endstufe E-Box L¸fter" UWORD B_TRUE 1 100 0 1 BIT_MASK 0x100 FORMAT "%13.11" ECU_ADDRESS 0x3FDD78 /end MEASUREMENT
/begin MEASUREMENT B_mxets "Fehlertype: Kurzschluﬂ nach Ubatt Endstufe Elektr. Thermostat" UWORD B_TRUE 1 100 0 1 BIT_MASK 0x100 FORMAT "%13.11" ECU_ADDRESS 0x3FDD7E /end MEASUREMENT
/begin MEASUREMENT B_mxev1 "Fehlerart: Kurzschluﬂ UBat an Endstufe EV1" UWORD B_TRUE 1 100 0 1 BIT_MASK 0x100 FORMAT "%13.11" ECU_ADDRESS 0x3FDD80 /end MEASUREMENT
/begin MEASUREMENT B_mxev2 "Fehlerart: Kurzschluﬂ UBat an Endstufe EV2" UWORD B_TRUE 1 100 0 1 BIT_MASK 0x100 FORMAT "%13.11" ECU_ADDRESS 0x3FDD82 /end MEASUREMENT
/begin MEASUREMENT B_mxev3 "Fehlerart: Kurzschluﬂ UBat an Endstufe EV3" UWORD B_TRUE 1 100 0 1 BIT_MASK 0x100 FORMAT "%13.11" ECU_ADDRESS 0x3FDD84 /end MEASUREMENT
/begin MEASUREMENT B_mxev4 "Fehlerart: Kurzschluﬂ UBat an Endstufe EV4" UWORD B_TRUE 1 100 0 1 BIT_MASK 0x100 FORMAT "%13.11" ECU_ADDRESS 0x3FDD86 /end MEASUREMENT
/begin MEASUREMENT B_mxezh "" UWORD B_TRUE 1 100 0 1 BIT_MASK 0x100 FORMAT "%13.11" ECU_ADDRESS 0x3FDD90 /end MEASUREMENT
/begin MEASUREMENT B_mxhsh "Kurzschluﬂ Heizung Lambdasonde hinter Kat nach UB" UWORD B_TRUE 1 100 0 1 BIT_MASK 0x100 FORMAT "%13.11" ECU_ADDRESS 0x3FDDA0 /end MEASUREMENT
/begin MEASUREMENT B_mxhsh2 "Kurzschluﬂ Heizung Lambdasonde2 hinter Kat nach UB" UWORD B_TRUE 1 100 0 1 BIT_MASK 0x100 FORMAT "%13.11" ECU_ADDRESS 0x3FDDA2 /end MEASUREMENT
/begin MEASUREMENT B_mxhsv "Kurzschluﬂ Heizung Lambdasonde vor Kat nach UB" UWORD B_TRUE 1 100 0 1 BIT_MASK 0x100 FORMAT "%13.11" ECU_ADDRESS 0x3FDDA4 /end MEASUREMENT
/begin MEASUREMENT B_mxhsv2 "Kurzschluﬂ Heizung Lambdasonde2 vor Kat nach UB" UWORD B_TRUE 1 100 0 1 BIT_MASK 0x100 FORMAT "%13.11" ECU_ADDRESS 0x3FDDA6 /end MEASUREMENT
/begin MEASUREMENT B_mxkat "Bedingung obere Plausibilit‰tsschwelle ¸berschritten" UWORD B_TRUE 1 100 0 1 BIT_MASK 0x100 FORMAT "%13.11" ECU_ADDRESS 0x3FDDAA /end MEASUREMENT
/begin MEASUREMENT B_mxkkue "" UWORD B_TRUE 1 100 0 1 BIT_MASK 0x100 FORMAT "%13.11" ECU_ADDRESS 0x3FDDAE /end MEASUREMENT
/begin MEASUREMENT B_mxkose "Fehlertype: Kurzschluﬂ nach Ubatt Endstufe Klimakompressor" UWORD B_TRUE 1 100 0 1 BIT_MASK 0x100 FORMAT "%13.11" ECU_ADDRESS 0x3FDDB0 /end MEASUREMENT
/begin MEASUREMENT B_mxkpe "Fehlertyp Kurzschluﬂ nach Ubat f¸r EKP-Relais Endstufe erkannt" UWORD B_TRUE 1 100 0 1 BIT_MASK 0x100 FORMAT "%13.11" ECU_ADDRESS 0x3FDDB2 /end MEASUREMENT
/begin MEASUREMENT B_mxkrnt "Fehlertyp max.: Klopfregelung Nulltest" UWORD B_TRUE 1 100 0 1 BIT_MASK 0x100 FORMAT "%13.11" ECU_ADDRESS 0x3FDDB4 /end MEASUREMENT
/begin MEASUREMENT B_mxkrof "Fehlertyp max.: Klopfregelung Offset" UWORD B_TRUE 1 100 0 1 BIT_MASK 0x100 FORMAT "%13.11" ECU_ADDRESS 0x3FDDB6 /end MEASUREMENT
/begin MEASUREMENT B_mxlde "Fehlertyp: Kurzschluﬂ Ubat LDR-Taktventil" UWORD B_TRUE 1 100 0 1 BIT_MASK 0x100 FORMAT "%13.11" ECU_ADDRESS 0x3FDDCC /end MEASUREMENT
/begin MEASUREMENT B_mxldpe "Fehlertype: Kurzschluﬂ nach Ubatt Endstufe LDP" UWORD B_TRUE 1 100 0 1 BIT_MASK 0x100 FORMAT "%13.11" ECU_ADDRESS 0x3FDDD0 /end MEASUREMENT
/begin MEASUREMENT B_mxlm "Bedingung: max-Fehler Hauptf¸llungssensor" UWORD B_TRUE 1 100 0 1 BIT_MASK 0x100 FORMAT "%13.11" ECU_ADDRESS 0x3FDDD4 /end MEASUREMENT
/begin MEASUREMENT B_mxluea "Fehlertype: Kurzschluﬂ nach Ubat Endstufe Motor L¸fter A" UWORD B_TRUE 1 100 0 1 BIT_MASK 0x100 FORMAT "%13.11" ECU_ADDRESS 0x3FDDDC /end MEASUREMENT
/begin MEASUREMENT B_mxluve "Fehlertyp max.: EV-Luftumfassungsventil Endstufe" UWORD B_TRUE 1 100 0 1 BIT_MASK 0x100 FORMAT "%13.11" ECU_ADDRESS 0x3FDDDE /end MEASUREMENT
/begin MEASUREMENT B_mxn "Fehlerart: h‰ufiger L¸ckenverlust beim L¸ckencheck" UWORD B_TRUE 1 100 0 1 BIT_MASK 0x100 FORMAT "%13.11" ECU_ADDRESS 0x3FDE02 /end MEASUREMENT
/begin MEASUREMENT B_mxstae "Fehlertype: Kurzschluﬂ nach Ubatt Endstufe Start Relais" UWORD B_TRUE 1 100 0 1 BIT_MASK 0x100 FORMAT "%13.11" ECU_ADDRESS 0x3FDE20 /end MEASUREMENT
/begin MEASUREMENT B_mxswe "Beschleunigungssensorsignal grˆﬂer als Plausibilit‰tsschwelle" UWORD B_TRUE 1 100 0 1 BIT_MASK 0x100 FORMAT "%13.11" ECU_ADDRESS 0x3FDE24 /end MEASUREMENT
/begin MEASUREMENT B_no "unendlich-Trigger f¸r Fehlerpfadmanagement" UBYTE B_TRUE 1 100 0 1 BIT_MASK 0x1 FORMAT "%13.11" ECU_ADDRESS 0x3FD7F9 /end MEASUREMENT
/begin MEASUREMENT B_npas "Signal unplausibel: ASR/TC Schnittstelle" UWORD B_TRUE 1 100 0 1 BIT_MASK 0x800 FORMAT "%13.11" ECU_ADDRESS 0x3FDD20 /end MEASUREMENT
/begin MEASUREMENT B_npbkvpe "Fehlerart: Zustand nicht plausibel an BKV-Pumpe-Endstufe" UWORD B_TRUE 1 100 0 1 BIT_MASK 0x800 FORMAT "%13.11" ECU_ADDRESS 0x3FDD24 /end MEASUREMENT
/begin MEASUREMENT B_npbm "Fehlertyp: Bezugsmarkenfehler beim L¸ckencheck" UWORD B_TRUE 1 100 0 1 BIT_MASK 0x800 FORMAT "%13.11" ECU_ADDRESS 0x3FDD26 /end MEASUREMENT
/begin MEASUREMENT B_npcana "Bedingung Plausfehler  (CAN_A ""Bus off"")" UWORD B_TRUE 1 100 0 1 BIT_MASK 0x800 FORMAT "%13.11" ECU_ADDRESS 0x3FDD2C /end MEASUREMENT
/begin MEASUREMENT B_npcas "Fehlertyp: CAN-Schnittstelle, Timeout ASC" UWORD B_TRUE 1 100 0 1 BIT_MASK 0x800 FORMAT "%13.11" ECU_ADDRESS 0x3FDD2E /end MEASUREMENT
/begin MEASUREMENT B_npcez "" UWORD B_TRUE 1 100 0 1 BIT_MASK 0x800 FORMAT "%13.11" ECU_ADDRESS 0x3FDD30 /end MEASUREMENT
/begin MEASUREMENT B_npcge "Fehlerart:CAN-Schnittstelle, Timeout EGS" UWORD B_TRUE 1 100 0 1 BIT_MASK 0x800 FORMAT "%13.11" ECU_ADDRESS 0x3FDD32 /end MEASUREMENT
/begin MEASUREMENT B_npcins "Fehlerart:CAN-Schnittstelle, Timeout Instrument" UWORD B_TRUE 1 100 0 1 BIT_MASK 0x800 FORMAT "%13.11" ECU_ADDRESS 0x3FDD34 /end MEASUREMENT
/begin MEASUREMENT B_npcod "Fehlerart: Plausibilit‰tsfehler Steuerger‰t noch nicht codiert" UWORD B_TRUE 1 100 0 1 BIT_MASK 0x800 FORMAT "%13.11" ECU_ADDRESS 0x3FDD36 /end MEASUREMENT
/begin MEASUREMENT B_npdisa "Pruefresultat nicht plausibel" UWORD B_TRUE 1 100 0 1 BIT_MASK 0x800 FORMAT "%13.11" ECU_ADDRESS 0x3FDD3E /end MEASUREMENT
/begin MEASUREMENT B_npdk "Bedingung unplausible Potisignale von der Drosselklappe" UWORD B_TRUE 1 100 0 1 BIT_MASK 0x800 FORMAT "%13.11" ECU_ADDRESS 0x3FDD40 /end MEASUREMENT
/begin MEASUREMENT B_npdk1p "Fehlertyp unplaus.: Drosselklappe 1. Poti" UWORD B_TRUE 1 100 0 1 BIT_MASK 0x800 FORMAT "%13.11" ECU_ADDRESS 0x3FDD42 /end MEASUREMENT
/begin MEASUREMENT B_npdk2p "Fehlertyp unplaus.: Drosselklappe 2. Poti" UWORD B_TRUE 1 100 0 1 BIT_MASK 0x800 FORMAT "%13.11" ECU_ADDRESS 0x3FDD44 /end MEASUREMENT
/begin MEASUREMENT B_npdvee "Fehlerzyp unplaus.: DV-E Endstufe" UWORD B_TRUE 1 100 0 1 BIT_MASK 0x800 FORMAT "%13.11" ECU_ADDRESS 0x3FDD4E /end MEASUREMENT
/begin MEASUREMENT B_npdvef "Fehlertyp unplaus.: DV-E Fehler bei Federpr¸fung" UWORD B_TRUE 1 100 0 1 BIT_MASK 0x800 FORMAT "%13.11" ECU_ADDRESS 0x3FDD50 /end MEASUREMENT
/begin MEASUREMENT B_npdvefo "" UWORD B_TRUE 1 100 0 1 BIT_MASK 0x800 FORMAT "%13.11" ECU_ADDRESS 0x3FDD52 /end MEASUREMENT
/begin MEASUREMENT B_npdvel "Fehlerzyp unplaus.: DV-E Lageabweichung" UWORD B_TRUE 1 100 0 1 BIT_MASK 0x800 FORMAT "%13.11" ECU_ADDRESS 0x3FDD54 /end MEASUREMENT
/begin MEASUREMENT B_npdven "Fehlertyp unplaus.: DV-E Fehler bei Pr¸fung Notluftposition" UWORD B_TRUE 1 100 0 1 BIT_MASK 0x800 FORMAT "%13.11" ECU_ADDRESS 0x3FDD56 /end MEASUREMENT
/begin MEASUREMENT B_npdver "Fehlerzyp unplaus.: DV-E Regelbereich" UWORD B_TRUE 1 100 0 1 BIT_MASK 0x800 FORMAT "%13.11" ECU_ADDRESS 0x3FDD58 /end MEASUREMENT
/begin MEASUREMENT B_npdvet "Fehlertyp ""unplausibel"": DV-E-Tauscherkennung ohne Adaption" UWORD B_TRUE 1 100 0 1 BIT_MASK 0x800 FORMAT "%13.11" ECU_ADDRESS 0x3FDD5A /end MEASUREMENT
/begin MEASUREMENT B_npdveu "Fehlertyp unplaus.: DV-E Fehler beim UMA-Lernen" UWORD B_TRUE 1 100 0 1 BIT_MASK 0x800 FORMAT "%13.11" ECU_ADDRESS 0x3FDD5C /end MEASUREMENT
/begin MEASUREMENT B_npdveub "" UWORD B_TRUE 1 100 0 1 BIT_MASK 0x800 FORMAT "%13.11" ECU_ADDRESS 0x3FDD5E /end MEASUREMENT
/begin MEASUREMENT B_npdveuw "Fehlertyp ""unplausibel"" bei UMA-Wiederlernen" UWORD B_TRUE 1 100 0 1 BIT_MASK 0x800 FORMAT "%13.11" ECU_ADDRESS 0x3FDD60 /end MEASUREMENT
/begin MEASUREMENT B_npdvev "Fehlertyp unplaus.: DV-E Fehler bei Verst‰rkerabgleich" UWORD B_TRUE 1 100 0 1 BIT_MASK 0x800 FORMAT "%13.11" ECU_ADDRESS 0x3FDD62 /end MEASUREMENT
/begin MEASUREMENT B_npels "Fehlertyp unplaus.: E-Box-L¸fter" UWORD B_TRUE 1 100 0 1 BIT_MASK 0x800 FORMAT "%13.11" ECU_ADDRESS 0x3FDD78 /end MEASUREMENT
/begin MEASUREMENT B_npets "Bedingung f¸r Fehlertyp 'Wert unplausibel' f¸r el. Thermostat-Endstufe erkannt" UWORD B_TRUE 1 100 0 1 BIT_MASK 0x800 FORMAT "%13.11" ECU_ADDRESS 0x3FDD7E /end MEASUREMENT
/begin MEASUREMENT B_npev1 "Fehlerart: Zustand nicht plausibel EV1" UWORD B_TRUE 1 100 0 1 BIT_MASK 0x800 FORMAT "%13.11" ECU_ADDRESS 0x3FDD80 /end MEASUREMENT
/begin MEASUREMENT B_npev2 "Fehlerart: Zustand nicht plausibel EV2" UWORD B_TRUE 1 100 0 1 BIT_MASK 0x800 FORMAT "%13.11" ECU_ADDRESS 0x3FDD82 /end MEASUREMENT
/begin MEASUREMENT B_npev3 "Fehlerart: Zustand nicht plausibel EV3" UWORD B_TRUE 1 100 0 1 BIT_MASK 0x800 FORMAT "%13.11" ECU_ADDRESS 0x3FDD84 /end MEASUREMENT
/begin MEASUREMENT B_npev4 "Fehlerart: Zustand nicht plausibel EV4" UWORD B_TRUE 1 100 0 1 BIT_MASK 0x800 FORMAT "%13.11" ECU_ADDRESS 0x3FDD86 /end MEASUREMENT
/begin MEASUREMENT B_npezh "" UWORD B_TRUE 1 100 0 1 BIT_MASK 0x800 FORMAT "%13.11" ECU_ADDRESS 0x3FDD90 /end MEASUREMENT
/begin MEASUREMENT B_nphsh "Nernstwiderstand Sonde hinter Kat zu groﬂ" UWORD B_TRUE 1 100 0 1 BIT_MASK 0x800 FORMAT "%13.11" ECU_ADDRESS 0x3FDDA0 /end MEASUREMENT
/begin MEASUREMENT B_nphsh2 "Nernstwiderstand Sonde 2 hinter Kat zu groﬂ" UWORD B_TRUE 1 100 0 1 BIT_MASK 0x800 FORMAT "%13.11" ECU_ADDRESS 0x3FDDA2 /end MEASUREMENT
/begin MEASUREMENT B_nphsv "Nernstwiderstand Sonde vor Kat zu groﬂ" UWORD B_TRUE 1 100 0 1 BIT_MASK 0x800 FORMAT "%13.11" ECU_ADDRESS 0x3FDDA4 /end MEASUREMENT
/begin MEASUREMENT B_nphsv2 "Nernstwiderstand Sonde 2 vor Kat zu groﬂ" UWORD B_TRUE 1 100 0 1 BIT_MASK 0x800 FORMAT "%13.11" ECU_ADDRESS 0x3FDDA6 /end MEASUREMENT
/begin MEASUREMENT B_npkat "Fehlertyp 'unplausibles Pr¸fresultat' erkannt (Katalysator)" UWORD B_TRUE 1 100 0 1 BIT_MASK 0x800 FORMAT "%13.11" ECU_ADDRESS 0x3FDDAA /end MEASUREMENT
/begin MEASUREMENT B_npkkue "" UWORD B_TRUE 1 100 0 1 BIT_MASK 0x800 FORMAT "%13.11" ECU_ADDRESS 0x3FDDAE /end MEASUREMENT
/begin MEASUREMENT B_npkose "Bedingung f¸r Fehlertyp 'Wert unplausibel' f¸r Klimakompressor-Endstufe erkannt" UWORD B_TRUE 1 100 0 1 BIT_MASK 0x800 FORMAT "%13.11" ECU_ADDRESS 0x3FDDB0 /end MEASUREMENT
/begin MEASUREMENT B_npkpe "Bedingung f¸r Fehlertyp 'Wert unplausibel' f¸r EKP-Relais Endstufe erkannt" UWORD B_TRUE 1 100 0 1 BIT_MASK 0x800 FORMAT "%13.11" ECU_ADDRESS 0x3FDDB2 /end MEASUREMENT
/begin MEASUREMENT B_npkrnt "Bedingung Plausibilit‰tsfehler der KR-Diagnose Integratorsteigung" UWORD B_TRUE 1 100 0 1 BIT_MASK 0x800 FORMAT "%13.11" ECU_ADDRESS 0x3FDDB4 /end MEASUREMENT
/begin MEASUREMENT B_npkrof "Bedingung Plausibilit‰tsfehler der KR-Diagnose Resetwert" UWORD B_TRUE 1 100 0 1 BIT_MASK 0x800 FORMAT "%13.11" ECU_ADDRESS 0x3FDDB6 /end MEASUREMENT
/begin MEASUREMENT B_nplde "Nicht plausibler Fehler: Ladedrucksteuerventil Endstufe" UWORD B_TRUE 1 100 0 1 BIT_MASK 0x800 FORMAT "%13.11" ECU_ADDRESS 0x3FDDCC /end MEASUREMENT
/begin MEASUREMENT B_npldpe "Nicht plausibler Fehler: Leckdiagnosemodul Endstufe" UWORD B_TRUE 1 100 0 1 BIT_MASK 0x800 FORMAT "%13.11" ECU_ADDRESS 0x3FDDD0 /end MEASUREMENT
/begin MEASUREMENT B_nplm "Bedingung Plausfehler Hauptf¸llungssensor" UWORD B_TRUE 1 100 0 1 BIT_MASK 0x800 FORMAT "%13.11" ECU_ADDRESS 0x3FDDD4 /end MEASUREMENT
/begin MEASUREMENT B_npluea "Bedingung: Endstufe Motor-L¸fter A  Fehlertype nicht plausibel" UWORD B_TRUE 1 100 0 1 BIT_MASK 0x800 FORMAT "%13.11" ECU_ADDRESS 0x3FDDDC /end MEASUREMENT
/begin MEASUREMENT B_npluve "Fehlerart: EV-Luftumfassungsventil Endstufe" UWORD B_TRUE 1 100 0 1 BIT_MASK 0x800 FORMAT "%13.11" ECU_ADDRESS 0x3FDDDE /end MEASUREMENT
/begin MEASUREMENT B_npn "Fehlerart: h‰ufiger Bezugsmarkenfehler beim L¸ckencheck" UWORD B_TRUE 1 100 0 1 BIT_MASK 0x800 FORMAT "%13.11" ECU_ADDRESS 0x3FDE02 /end MEASUREMENT
/begin MEASUREMENT B_npstae "Bedingung f¸r Fehlertyp ""Wert bunplausibel"" f¸r Starter Relais Endstufe erkannt" UWORD B_TRUE 1 100 0 1 BIT_MASK 0x800 FORMAT "%13.11" ECU_ADDRESS 0x3FDE20 /end MEASUREMENT
/begin MEASUREMENT B_npswe "Beschleunigungssensorsignal ist nicht plausibel" UWORD B_TRUE 1 100 0 1 BIT_MASK 0x800 FORMAT "%13.11" ECU_ADDRESS 0x3FDE24 /end MEASUREMENT
/begin MEASUREMENT B_sias "Fehlertyp Signal: ASR-Eingriff" UWORD B_TRUE 1 100 0 1 BIT_MASK 0x400 FORMAT "%13.11" ECU_ADDRESS 0x3FDD20 /end MEASUREMENT
/begin MEASUREMENT B_sibkvpe "Fehlerart: Unterbrechung an BKV-Pumpe-Endstufe" UWORD B_TRUE 1 100 0 1 BIT_MASK 0x400 FORMAT "%13.11" ECU_ADDRESS 0x3FDD24 /end MEASUREMENT
/begin MEASUREMENT B_sibm "Fehlertyp: keine Bezugsmarke im Start gefunden" UWORD B_TRUE 1 100 0 1 BIT_MASK 0x400 FORMAT "%13.11" ECU_ADDRESS 0x3FDD26 /end MEASUREMENT
/begin MEASUREMENT B_sicana "" UWORD B_TRUE 1 100 0 1 BIT_MASK 0x400 FORMAT "%13.11" ECU_ADDRESS 0x3FDD2C /end MEASUREMENT
/begin MEASUREMENT B_sicas "Signalfehler CAN-Timeout ASC-Botschaften" UWORD B_TRUE 1 100 0 1 BIT_MASK 0x400 FORMAT "%13.11" ECU_ADDRESS 0x3FDD2E /end MEASUREMENT
/begin MEASUREMENT B_sicez "Signalfehler CAN-Timeout EZH-Botschaft" UWORD B_TRUE 1 100 0 1 BIT_MASK 0x400 FORMAT "%13.11" ECU_ADDRESS 0x3FDD30 /end MEASUREMENT
/begin MEASUREMENT B_sicge "Signalfehler CAN-Timeout EGS-Botschaft" UWORD B_TRUE 1 100 0 1 BIT_MASK 0x400 FORMAT "%13.11" ECU_ADDRESS 0x3FDD32 /end MEASUREMENT
/begin MEASUREMENT B_sicins "Signalfehler CAN-Timeout Botschaft Kombi-Instruments" UWORD B_TRUE 1 100 0 1 BIT_MASK 0x400 FORMAT "%13.11" ECU_ADDRESS 0x3FDD34 /end MEASUREMENT
/begin MEASUREMENT B_sicod "Fehlertyp Sig.: Steuerger‰t noch nicht codiert" UWORD B_TRUE 1 100 0 1 BIT_MASK 0x400 FORMAT "%13.11" ECU_ADDRESS 0x3FDD36 /end MEASUREMENT
/begin MEASUREMENT B_sidisa "Signal inaktiv" UWORD B_TRUE 1 100 0 1 BIT_MASK 0x400 FORMAT "%13.11" ECU_ADDRESS 0x3FDD3E /end MEASUREMENT
/begin MEASUREMENT B_sidk "Fehlertyp signal: Drosselklappenpoti" UWORD B_TRUE 1 100 0 1 BIT_MASK 0x400 FORMAT "%13.11" ECU_ADDRESS 0x3FDD40 /end MEASUREMENT
/begin MEASUREMENT B_sidk1p "Fehlendes Signal: Drosselklappe 1. Poti" UWORD B_TRUE 1 100 0 1 BIT_MASK 0x400 FORMAT "%13.11" ECU_ADDRESS 0x3FDD42 /end MEASUREMENT
/begin MEASUREMENT B_sidk2p "Fehlendes Signal: Drosselklappe 2. Poti" UWORD B_TRUE 1 100 0 1 BIT_MASK 0x400 FORMAT "%13.11" ECU_ADDRESS 0x3FDD44 /end MEASUREMENT
/begin MEASUREMENT B_sidvee "Fehlertyp sig.: DV-E Endstufe" UWORD B_TRUE 1 100 0 1 BIT_MASK 0x400 FORMAT "%13.11" ECU_ADDRESS 0x3FDD4E /end MEASUREMENT
/begin MEASUREMENT B_sidvef "Fehlertyp sig.: DV-E Fehler bei Federpr¸fung" UWORD B_TRUE 1 100 0 1 BIT_MASK 0x400 FORMAT "%13.11" ECU_ADDRESS 0x3FDD50 /end MEASUREMENT
/begin MEASUREMENT B_sidvefo "" UWORD B_TRUE 1 100 0 1 BIT_MASK 0x400 FORMAT "%13.11" ECU_ADDRESS 0x3FDD52 /end MEASUREMENT
/begin MEASUREMENT B_sidvel "Fehlertyp sig.: DV-E Lageabweichung" UWORD B_TRUE 1 100 0 1 BIT_MASK 0x400 FORMAT "%13.11" ECU_ADDRESS 0x3FDD54 /end MEASUREMENT
/begin MEASUREMENT B_sidven "Fehlertyp sig.: DV-E Fehler bei Pr¸fung Notluftposition" UWORD B_TRUE 1 100 0 1 BIT_MASK 0x400 FORMAT "%13.11" ECU_ADDRESS 0x3FDD56 /end MEASUREMENT
/begin MEASUREMENT B_sidver "Fehlertyp sig.: DV-E Regelbereich" UWORD B_TRUE 1 100 0 1 BIT_MASK 0x400 FORMAT "%13.11" ECU_ADDRESS 0x3FDD58 /end MEASUREMENT
/begin MEASUREMENT B_sidvet "" UWORD B_TRUE 1 100 0 1 BIT_MASK 0x400 FORMAT "%13.11" ECU_ADDRESS 0x3FDD5A /end MEASUREMENT
/begin MEASUREMENT B_sidveu "Fehlertyp sig.: DV-E Fehler beim UMA-Lernen" UWORD B_TRUE 1 100 0 1 BIT_MASK 0x400 FORMAT "%13.11" ECU_ADDRESS 0x3FDD5C /end MEASUREMENT
/begin MEASUREMENT B_sidveub "" UWORD B_TRUE 1 100 0 1 BIT_MASK 0x400 FORMAT "%13.11" ECU_ADDRESS 0x3FDD5E /end MEASUREMENT
/begin MEASUREMENT B_sidveuw "" UWORD B_TRUE 1 100 0 1 BIT_MASK 0x400 FORMAT "%13.11" ECU_ADDRESS 0x3FDD60 /end MEASUREMENT
/begin MEASUREMENT B_sidvev "Fehlertyp sig.: DV-E Fehler bei Verst‰rkerabgleich" UWORD B_TRUE 1 100 0 1 BIT_MASK 0x400 FORMAT "%13.11" ECU_ADDRESS 0x3FDD62 /end MEASUREMENT
/begin MEASUREMENT B_siels "Fehlertype: Leitungsabfall Endstufe E-Box L¸fter" UWORD B_TRUE 1 100 0 1 BIT_MASK 0x400 FORMAT "%13.11" ECU_ADDRESS 0x3FDD78 /end MEASUREMENT
/begin MEASUREMENT B_siets "Fehlertype: Leitungsabfall Endstufe Elektr. Thermostat" UWORD B_TRUE 1 100 0 1 BIT_MASK 0x400 FORMAT "%13.11" ECU_ADDRESS 0x3FDD7E /end MEASUREMENT
/begin MEASUREMENT B_siev1 "Fehlerart: Unterbrechung an Endstufe EV1" UWORD B_TRUE 1 100 0 1 BIT_MASK 0x400 FORMAT "%13.11" ECU_ADDRESS 0x3FDD80 /end MEASUREMENT
/begin MEASUREMENT B_siev2 "Fehlerart: Unterbrechung an Endstufe EV2" UWORD B_TRUE 1 100 0 1 BIT_MASK 0x400 FORMAT "%13.11" ECU_ADDRESS 0x3FDD82 /end MEASUREMENT
/begin MEASUREMENT B_siev3 "Fehlerart: Unterbrechung an Endstufe EV3" UWORD B_TRUE 1 100 0 1 BIT_MASK 0x400 FORMAT "%13.11" ECU_ADDRESS 0x3FDD84 /end MEASUREMENT
/begin MEASUREMENT B_siev4 "Fehlerart: Unterbrechung an Endstufe EV4" UWORD B_TRUE 1 100 0 1 BIT_MASK 0x400 FORMAT "%13.11" ECU_ADDRESS 0x3FDD86 /end MEASUREMENT
/begin MEASUREMENT B_siezh "" UWORD B_TRUE 1 100 0 1 BIT_MASK 0x400 FORMAT "%13.11" ECU_ADDRESS 0x3FDD90 /end MEASUREMENT
/begin MEASUREMENT B_sihsh "Lastabfall Sondenheizung hinter Kat" UWORD B_TRUE 1 100 0 1 BIT_MASK 0x400 FORMAT "%13.11" ECU_ADDRESS 0x3FDDA0 /end MEASUREMENT
/begin MEASUREMENT B_sihsh2 "Lastabfall Sondenheizung2 hinter Kat" UWORD B_TRUE 1 100 0 1 BIT_MASK 0x400 FORMAT "%13.11" ECU_ADDRESS 0x3FDDA2 /end MEASUREMENT
/begin MEASUREMENT B_sihsv "Lastabfall Sondenheizung vor Kat" UWORD B_TRUE 1 100 0 1 BIT_MASK 0x400 FORMAT "%13.11" ECU_ADDRESS 0x3FDDA4 /end MEASUREMENT
/begin MEASUREMENT B_sihsv2 "Lastabfall Sondenheizung2 vor Kat" UWORD B_TRUE 1 100 0 1 BIT_MASK 0x400 FORMAT "%13.11" ECU_ADDRESS 0x3FDDA6 /end MEASUREMENT
/begin MEASUREMENT B_sikat "Fehlertyp 'Signal fehlt' f¸r DKAT erkannt" UWORD B_TRUE 1 100 0 1 BIT_MASK 0x400 FORMAT "%13.11" ECU_ADDRESS 0x3FDDAA /end MEASUREMENT
/begin MEASUREMENT B_sikkue "" UWORD B_TRUE 1 100 0 1 BIT_MASK 0x400 FORMAT "%13.11" ECU_ADDRESS 0x3FDDAE /end MEASUREMENT
/begin MEASUREMENT B_sikose "Fehlertype: Leitungsabfall Endstufe Klimakompressor" UWORD B_TRUE 1 100 0 1 BIT_MASK 0x400 FORMAT "%13.11" ECU_ADDRESS 0x3FDDB0 /end MEASUREMENT
/begin MEASUREMENT B_sikpe "Bedingung f¸r Fehlertyp Leitungsabfall f¸r EKP-Relais Endstufe erkannt" UWORD B_TRUE 1 100 0 1 BIT_MASK 0x400 FORMAT "%13.11" ECU_ADDRESS 0x3FDDB2 /end MEASUREMENT
/begin MEASUREMENT B_sikrnt "Fehlertyp: Klopfregelung Nulltest" UWORD B_TRUE 1 100 0 1 BIT_MASK 0x400 FORMAT "%13.11" ECU_ADDRESS 0x3FDDB4 /end MEASUREMENT
/begin MEASUREMENT B_sikrof "Fehlertyp: Klopfregelung Offset" UWORD B_TRUE 1 100 0 1 BIT_MASK 0x400 FORMAT "%13.11" ECU_ADDRESS 0x3FDDB6 /end MEASUREMENT
/begin MEASUREMENT B_silde "Fehlertyp: Leitungsabfall LDR-Taktventil" UWORD B_TRUE 1 100 0 1 BIT_MASK 0x400 FORMAT "%13.11" ECU_ADDRESS 0x3FDDCC /end MEASUREMENT
/begin MEASUREMENT B_sildpe "Fehlertype: Leitungsabfall Endstufe Leckage Pumpe" UWORD B_TRUE 1 100 0 1 BIT_MASK 0x400 FORMAT "%13.11" ECU_ADDRESS 0x3FDDD0 /end MEASUREMENT
/begin MEASUREMENT B_silm "Bedingung Signalfehler Hauptf¸llungssensor" UWORD B_TRUE 1 100 0 1 BIT_MASK 0x400 FORMAT "%13.11" ECU_ADDRESS 0x3FDDD4 /end MEASUREMENT
/begin MEASUREMENT B_siluea "Fehlertype: Leitungsabfall Endstufe Motor L¸fter A" UWORD B_TRUE 1 100 0 1 BIT_MASK 0x400 FORMAT "%13.11" ECU_ADDRESS 0x3FDDDC /end MEASUREMENT
/begin MEASUREMENT B_siluve "Fehlerart: EV-Luftumfassungsventil Endstufe" UWORD B_TRUE 1 100 0 1 BIT_MASK 0x400 FORMAT "%13.11" ECU_ADDRESS 0x3FDDDE /end MEASUREMENT
/begin MEASUREMENT B_sin "Fehlertyp: kein Drehzahlsignal vorhanden" UWORD B_TRUE 1 100 0 1 BIT_MASK 0x400 FORMAT "%13.11" ECU_ADDRESS 0x3FDE02 /end MEASUREMENT
/begin MEASUREMENT B_sistae "Fehlertype: Leitungsabfall Endstufe Start Relais" UWORD B_TRUE 1 100 0 1 BIT_MASK 0x400 FORMAT "%13.11" ECU_ADDRESS 0x3FDE20 /end MEASUREMENT
/begin MEASUREMENT B_siswe "Fehlertyp: Geschwindigkeitssignal nicht vorhanden" UWORD B_TRUE 1 100 0 1 BIT_MASK 0x400 FORMAT "%13.11" ECU_ADDRESS 0x3FDE24 /end MEASUREMENT
/begin MEASUREMENT B_sp3 "Spezial-Bereichs-Trigger der Diagnose Kraftstoffversorgungssystem" UBYTE B_TRUE 1 100 0 1 BIT_MASK 0x1 FORMAT "%13.11" ECU_ADDRESS 0x3FD7FA /end MEASUREMENT
/begin MEASUREMENT B_tim "Zeit-Trigger f¸r Fehlerpfadmanagement" UBYTE B_TRUE 1 100 0 1 BIT_MASK 0x1 FORMAT "%13.11" ECU_ADDRESS 0x5B8E25 /end MEASUREMENT
/begin MEASUREMENT dfcmFcm "" UBYTE dez 1 100 0 255 FORMAT "%5.1" ECU_ADDRESS 0x3FD7FB /end MEASUREMENT
/begin MEASUREMENT dfcmNo "" UBYTE dez 1 100 0 255 FORMAT "%5.1" ECU_ADDRESS 0x3FD7FC /end MEASUREMENT
/begin MEASUREMENT dfcmSfp "" UBYTE dez 1 100 0 255 FORMAT "%5.1" ECU_ADDRESS 0x3FD7FD /end MEASUREMENT
/begin MEASUREMENT dfpmEpclState "" UWORD dez 1 100 0 65535 FORMAT "%8.2" ECU_ADDRESS 0x3FD7F8 /end MEASUREMENT
/begin MEASUREMENT dfpmMilState "" UWORD dez 1 100 0 65535 FORMAT "%8.2" ECU_ADDRESS 0x3FD7F7 /end MEASUREMENT
/begin MEASUREMENT dfp_ap "" UBYTE dez 1 100 0 255 FORMAT "%5.1" ECU_ADDRESS 0x3FD7FE /end MEASUREMENT
/begin MEASUREMENT E_as "Errorflag: ASR-Eingriff" UWORD B_TRUE 1 100 0 1 BIT_MASK 0x1 FORMAT "%13.11" ECU_ADDRESS 0x3FDD20 /end MEASUREMENT
/begin MEASUREMENT E_bkvpe "Fehlerflag: BKV-Pumpe-Endstufe" UWORD B_TRUE 1 100 0 1 BIT_MASK 0x1 FORMAT "%13.11" ECU_ADDRESS 0x3FDD24 /end MEASUREMENT
/begin MEASUREMENT E_bm "Errorflag: Bezugsmarkengeber" UWORD B_TRUE 1 100 0 1 BIT_MASK 0x1 FORMAT "%13.11" ECU_ADDRESS 0x3FDD26 /end MEASUREMENT
/begin MEASUREMENT E_cana "Errorflag: CAN-Schnittstelle ""CAN_A defekt""" UWORD B_TRUE 1 100 0 1 BIT_MASK 0x1 FORMAT "%13.11" ECU_ADDRESS 0x3FDD2C /end MEASUREMENT
/begin MEASUREMENT E_CAS "Errorflag: CAN-Schnittstelle, Timeout ASC" UWORD B_TRUE 1 100 0 1 BIT_MASK 0x1 FORMAT "%13.11" ECU_ADDRESS 0x3FDD2E /end MEASUREMENT
/begin MEASUREMENT E_cez "Errorflag: CAN-Schnittstelle, Timeout EZH" UWORD B_TRUE 1 100 0 1 BIT_MASK 0x1 FORMAT "%13.11" ECU_ADDRESS 0x3FDD30 /end MEASUREMENT
/begin MEASUREMENT E_CGE "Errorflag: CAN-Schnittstelle, Timeout EGS" UWORD B_TRUE 1 100 0 1 BIT_MASK 0x1 FORMAT "%13.11" ECU_ADDRESS 0x3FDD32 /end MEASUREMENT
/begin MEASUREMENT E_CINS "Errorflag: CAN-Schnittstelle, Timeout Instrument" UWORD B_TRUE 1 100 0 1 BIT_MASK 0x1 FORMAT "%13.11" ECU_ADDRESS 0x3FDD34 /end MEASUREMENT
/begin MEASUREMENT E_cod "Errorflag: Steuerger‰t noch nicht codiert" UWORD B_TRUE 1 100 0 1 BIT_MASK 0x1 FORMAT "%13.11" ECU_ADDRESS 0x3FDD36 /end MEASUREMENT
/begin MEASUREMENT E_disa "Fehlerflag aus DDISA" UWORD B_TRUE 1 100 0 1 BIT_MASK 0x1 FORMAT "%13.11" ECU_ADDRESS 0x3FDD3E /end MEASUREMENT
/begin MEASUREMENT E_dk "Errorflag: DK - Potentiometer" UWORD B_TRUE 1 100 0 1 BIT_MASK 0x1 FORMAT "%13.11" ECU_ADDRESS 0x3FDD40 /end MEASUREMENT
/begin MEASUREMENT E_dk1p "Errorflag: Drosselklappe 1. Poti" UWORD B_TRUE 1 100 0 1 BIT_MASK 0x1 FORMAT "%13.11" ECU_ADDRESS 0x3FDD42 /end MEASUREMENT
/begin MEASUREMENT E_dk2p "Errorflag: Drosselklappe 2. Poti" UWORD B_TRUE 1 100 0 1 BIT_MASK 0x1 FORMAT "%13.11" ECU_ADDRESS 0x3FDD44 /end MEASUREMENT
/begin MEASUREMENT E_dvee "Errorflag: DV-E Endstufe" UWORD B_TRUE 1 100 0 1 BIT_MASK 0x1 FORMAT "%13.11" ECU_ADDRESS 0x3FDD4E /end MEASUREMENT
/begin MEASUREMENT E_dvef "Errorflag: DV-E Fehler bei Federpr¸fung" UWORD B_TRUE 1 100 0 1 BIT_MASK 0x1 FORMAT "%13.11" ECU_ADDRESS 0x3FDD50 /end MEASUREMENT
/begin MEASUREMENT E_dvefo "Errorflag: DV-E-Fehler bei Federpr¸fung ""÷ffnen""" UWORD B_TRUE 1 100 0 1 BIT_MASK 0x1 FORMAT "%13.11" ECU_ADDRESS 0x3FDD52 /end MEASUREMENT
/begin MEASUREMENT E_dvel "Errorflag: DV-E Lageabweichung" UWORD B_TRUE 1 100 0 1 BIT_MASK 0x1 FORMAT "%13.11" ECU_ADDRESS 0x3FDD54 /end MEASUREMENT
/begin MEASUREMENT E_dven "Errorflag: DV-E Fehler bei Pr¸fung Notluftposition" UWORD B_TRUE 1 100 0 1 BIT_MASK 0x1 FORMAT "%13.11" ECU_ADDRESS 0x3FDD56 /end MEASUREMENT
/begin MEASUREMENT E_dver "Errorflag: DV-E Regelbereich" UWORD B_TRUE 1 100 0 1 BIT_MASK 0x1 FORMAT "%13.11" ECU_ADDRESS 0x3FDD58 /end MEASUREMENT
/begin MEASUREMENT E_dvet "Errorflag: DV-E-Tauscherkennung ohne Adaption" UWORD B_TRUE 1 100 0 1 BIT_MASK 0x1 FORMAT "%13.11" ECU_ADDRESS 0x3FDD5A /end MEASUREMENT
/begin MEASUREMENT E_dveu "Errorflag: DV-E Fehler beim UMA-Lernen" UWORD B_TRUE 1 100 0 1 BIT_MASK 0x1 FORMAT "%13.11" ECU_ADDRESS 0x3FDD5C /end MEASUREMENT
/begin MEASUREMENT E_dveub "Errorflag: DV-E-Adaption Abbruch wg. Umweltbedingung" UWORD B_TRUE 1 100 0 1 BIT_MASK 0x1 FORMAT "%13.11" ECU_ADDRESS 0x3FDD5E /end MEASUREMENT
/begin MEASUREMENT E_dveuw "Errorflag: Fehler bei UMA-Wiederlernen" UWORD B_TRUE 1 100 0 1 BIT_MASK 0x1 FORMAT "%13.11" ECU_ADDRESS 0x3FDD60 /end MEASUREMENT
/begin MEASUREMENT E_dvev "Errorflag: DV-E Fehler bei Verst‰rkerabgleich" UWORD B_TRUE 1 100 0 1 BIT_MASK 0x1 FORMAT "%13.11" ECU_ADDRESS 0x3FDD62 /end MEASUREMENT
/begin MEASUREMENT E_els "Errorflag: Endstufe E-Box L¸fter" UWORD B_TRUE 1 100 0 1 BIT_MASK 0x1 FORMAT "%13.11" ECU_ADDRESS 0x3FDD78 /end MEASUREMENT
/begin MEASUREMENT E_ets "Errorflag: elektronisches Thermostat" UWORD B_TRUE 1 100 0 1 BIT_MASK 0x1 FORMAT "%13.11" ECU_ADDRESS 0x3FDD7E /end MEASUREMENT
/begin MEASUREMENT E_ev1 "Errorflag: EV von Zyl. 1" UWORD B_TRUE 1 100 0 1 BIT_MASK 0x1 FORMAT "%13.11" ECU_ADDRESS 0x3FDD80 /end MEASUREMENT
/begin MEASUREMENT E_ev2 "Errorflag: EV von Zyl. 2" UWORD B_TRUE 1 100 0 1 BIT_MASK 0x1 FORMAT "%13.11" ECU_ADDRESS 0x3FDD82 /end MEASUREMENT
/begin MEASUREMENT E_ev3 "Errorflag: EV von Zyl. 3" UWORD B_TRUE 1 100 0 1 BIT_MASK 0x1 FORMAT "%13.11" ECU_ADDRESS 0x3FDD84 /end MEASUREMENT
/begin MEASUREMENT E_ev4 "Errorflag: EV von Zyl. 4" UWORD B_TRUE 1 100 0 1 BIT_MASK 0x1 FORMAT "%13.11" ECU_ADDRESS 0x3FDD86 /end MEASUREMENT
/begin MEASUREMENT E_ezh "" UWORD B_TRUE 1 100 0 1 BIT_MASK 0x1 FORMAT "%13.11" ECU_ADDRESS 0x3FDD90 /end MEASUREMENT
/begin MEASUREMENT E_hsh "Errorflag: Lambdasonden-Heizung hinter Katalysator" UWORD B_TRUE 1 100 0 1 BIT_MASK 0x1 FORMAT "%13.11" ECU_ADDRESS 0x3FDDA0 /end MEASUREMENT
/begin MEASUREMENT E_hsh2 "Errorflag: Lambdasonden-Heizung hinter Katalysator Bank 2" UWORD B_TRUE 1 100 0 1 BIT_MASK 0x1 FORMAT "%13.11" ECU_ADDRESS 0x3FDDA2 /end MEASUREMENT
/begin MEASUREMENT E_hsv "Errorflag: Lambdasonden-Heizung vor Katalysator" UWORD B_TRUE 1 100 0 1 BIT_MASK 0x1 FORMAT "%13.11" ECU_ADDRESS 0x3FDDA4 /end MEASUREMENT
/begin MEASUREMENT E_hsv2 "Errorflag: Lambdasonden-Heizung vor Katalysator Bank 2" UWORD B_TRUE 1 100 0 1 BIT_MASK 0x1 FORMAT "%13.11" ECU_ADDRESS 0x3FDDA6 /end MEASUREMENT
/begin MEASUREMENT E_kat "Errorflag: Katalysator-Konvertierung" UWORD B_TRUE 1 100 0 1 BIT_MASK 0x1 FORMAT "%13.11" ECU_ADDRESS 0x3FDDAA /end MEASUREMENT
/begin MEASUREMENT E_kkue "Errorflag: Kraftstoffkreislauf-Umschaltung Endstufe" UWORD B_TRUE 1 100 0 1 BIT_MASK 0x1 FORMAT "%13.11" ECU_ADDRESS 0x3FDDAE /end MEASUREMENT
/begin MEASUREMENT E_kose "Errorflag: Klimakompressorsteuerung, Endstufe" UWORD B_TRUE 1 100 0 1 BIT_MASK 0x1 FORMAT "%13.11" ECU_ADDRESS 0x3FDDB0 /end MEASUREMENT
/begin MEASUREMENT E_kpe "Errorflag: EKP-Relais Endstufe" UWORD B_TRUE 1 100 0 1 BIT_MASK 0x1 FORMAT "%13.11" ECU_ADDRESS 0x3FDDB2 /end MEASUREMENT
/begin MEASUREMENT E_krnt "Errorflag: Klopfregelung Nulltest" UWORD B_TRUE 1 100 0 1 BIT_MASK 0x1 FORMAT "%13.11" ECU_ADDRESS 0x3FDDB4 /end MEASUREMENT
/begin MEASUREMENT E_krof "Errorflag: Klopfregelung Offset" UWORD B_TRUE 1 100 0 1 BIT_MASK 0x1 FORMAT "%13.11" ECU_ADDRESS 0x3FDDB6 /end MEASUREMENT
/begin MEASUREMENT E_lde "Errorflag: Ladedrucksteuerventil (Endstufe)" UWORD B_TRUE 1 100 0 1 BIT_MASK 0x1 FORMAT "%13.11" ECU_ADDRESS 0x3FDDCC /end MEASUREMENT
/begin MEASUREMENT E_ldpe "Errorflag: Leckdiagnosepumpe Endstufe" UWORD B_TRUE 1 100 0 1 BIT_MASK 0x1 FORMAT "%13.11" ECU_ADDRESS 0x3FDDD0 /end MEASUREMENT
/begin MEASUREMENT E_lm "Errorflag: Hauptlastsensor" UWORD B_TRUE 1 100 0 1 BIT_MASK 0x1 FORMAT "%13.11" ECU_ADDRESS 0x3FDDD4 /end MEASUREMENT
/begin MEASUREMENT E_luea "Errorflag: L¸fterendstufe A" UWORD B_TRUE 1 100 0 1 BIT_MASK 0x1 FORMAT "%13.11" ECU_ADDRESS 0x3FDDDC /end MEASUREMENT
/begin MEASUREMENT E_luve "Errorflag: EV-Luftumfassungsventil Endstufe" UWORD B_TRUE 1 100 0 1 BIT_MASK 0x1 FORMAT "%13.11" ECU_ADDRESS 0x3FDDDE /end MEASUREMENT
/begin MEASUREMENT E_n "Errorflag: Drehzahlsignalgeber" UWORD B_TRUE 1 100 0 1 BIT_MASK 0x1 FORMAT "%13.11" ECU_ADDRESS 0x3FDE02 /end MEASUREMENT
/begin MEASUREMENT E_stae "Errorflag: Startautomatik" UWORD B_TRUE 1 100 0 1 BIT_MASK 0x1 FORMAT "%13.11" ECU_ADDRESS 0x3FDE20 /end MEASUREMENT
/begin MEASUREMENT E_swe "Errorflag: Beschleunigungssensor der Schlechtwegeerkennung" UWORD B_TRUE 1 100 0 1 BIT_MASK 0x1 FORMAT "%13.11" ECU_ADDRESS 0x3FDE24 /end MEASUREMENT
/begin MEASUREMENT fcmcla_0_A "" UBYTE default 1 100 0 255 FORMAT "%5.1" ECU_ADDRESS 0x3FCF50 /end MEASUREMENT
/begin MEASUREMENT fcmcla_1_A "" UBYTE default 1 100 0 255 FORMAT "%5.1" ECU_ADDRESS 0x3FCF78 /end MEASUREMENT
/begin MEASUREMENT fcmcla_2_A "" UBYTE default 1 100 0 255 FORMAT "%5.1" ECU_ADDRESS 0x3FCFA0 /end MEASUREMENT
/begin MEASUREMENT fcmcla_3_A "" UBYTE default 1 100 0 255 FORMAT "%5.1" ECU_ADDRESS 0x3FCFC8 /end MEASUREMENT
/begin MEASUREMENT fcmcla_4_A "" UBYTE default 1 100 0 255 FORMAT "%5.1" ECU_ADDRESS 0x3FCFF0 /end MEASUREMENT
/begin MEASUREMENT fcmcla_5_A "" UBYTE default 1 100 0 255 FORMAT "%5.1" ECU_ADDRESS 0x3FD018 /end MEASUREMENT
/begin MEASUREMENT fcmcla_6_A "" UBYTE default 1 100 0 255 FORMAT "%5.1" ECU_ADDRESS 0x3FD040 /end MEASUREMENT
/begin MEASUREMENT fcmcla_7_A "" UBYTE default 1 100 0 255 FORMAT "%5.1" ECU_ADDRESS 0x3FD068 /end MEASUREMENT
/begin MEASUREMENT fcmcla_8_A "" UBYTE default 1 100 0 255 FORMAT "%5.1" ECU_ADDRESS 0x3FD090 /end MEASUREMENT
/begin MEASUREMENT fcmcla_9_A "" UBYTE default 1 100 0 255 FORMAT "%5.1" ECU_ADDRESS 0x3FD0B8 /end MEASUREMENT
/begin MEASUREMENT fcmdfp_0_A "" UBYTE default 1 100 0 255 FORMAT "%5.1" ECU_ADDRESS 0x3FCF4C /end MEASUREMENT
/begin MEASUREMENT fcmdfp_1_A "" UBYTE default 1 100 0 255 FORMAT "%5.1" ECU_ADDRESS 0x3FCF74 /end MEASUREMENT
/begin MEASUREMENT fcmdfp_2_A "" UBYTE default 1 100 0 255 FORMAT "%5.1" ECU_ADDRESS 0x3FCF9C /end MEASUREMENT
/begin MEASUREMENT fcmdfp_3_A "" UBYTE default 1 100 0 255 FORMAT "%5.1" ECU_ADDRESS 0x3FCFC4 /end MEASUREMENT
/begin MEASUREMENT fcmdfp_4_A "" UBYTE default 1 100 0 255 FORMAT "%5.1" ECU_ADDRESS 0x3FCFEC /end MEASUREMENT
/begin MEASUREMENT fcmdfp_5_A "" UBYTE default 1 100 0 255 FORMAT "%5.1" ECU_ADDRESS 0x3FD014 /end MEASUREMENT
/begin MEASUREMENT fcmdfp_6_A "" UBYTE default 1 100 0 255 FORMAT "%5.1" ECU_ADDRESS 0x3FD03C /end MEASUREMENT
/begin MEASUREMENT fcmdfp_7_A "" UBYTE default 1 100 0 255 FORMAT "%5.1" ECU_ADDRESS 0x3FD064 /end MEASUREMENT
/begin MEASUREMENT fcmdfp_8_A "" UBYTE default 1 100 0 255 FORMAT "%5.1" ECU_ADDRESS 0x3FD08C /end MEASUREMENT
/begin MEASUREMENT fcmdfp_9_A "" UBYTE default 1 100 0 255 FORMAT "%5.1" ECU_ADDRESS 0x3FD0B4 /end MEASUREMENT
/begin MEASUREMENT fcmdlc_0_A "" UBYTE default 1 100 0 255 FORMAT "%5.1" ECU_ADDRESS 0x3FCF54 /end MEASUREMENT
/begin MEASUREMENT fcmdlc_1_A "" UBYTE default 1 100 0 255 FORMAT "%5.1" ECU_ADDRESS 0x3FCF7C /end MEASUREMENT
/begin MEASUREMENT fcmdlc_2_A "" UBYTE default 1 100 0 255 FORMAT "%5.1" ECU_ADDRESS 0x3FCFA4 /end MEASUREMENT
/begin MEASUREMENT fcmdlc_3_A "" UBYTE default 1 100 0 255 FORMAT "%5.1" ECU_ADDRESS 0x3FCFCC /end MEASUREMENT
/begin MEASUREMENT fcmdlc_4_A "" UBYTE default 1 100 0 255 FORMAT "%5.1" ECU_ADDRESS 0x3FCFF4 /end MEASUREMENT
/begin MEASUREMENT fcmdlc_5_A "" UBYTE default 1 100 0 255 FORMAT "%5.1" ECU_ADDRESS 0x3FD01C /end MEASUREMENT
/begin MEASUREMENT fcmdlc_6_A "" UBYTE default 1 100 0 255 FORMAT "%5.1" ECU_ADDRESS 0x3FD044 /end MEASUREMENT
/begin MEASUREMENT fcmdlc_7_A "" UBYTE default 1 100 0 255 FORMAT "%5.1" ECU_ADDRESS 0x3FD06C /end MEASUREMENT
/begin MEASUREMENT fcmdlc_8_A "" UBYTE default 1 100 0 255 FORMAT "%5.1" ECU_ADDRESS 0x3FD094 /end MEASUREMENT
/begin MEASUREMENT fcmdlc_9_A "" UBYTE default 1 100 0 255 FORMAT "%5.1" ECU_ADDRESS 0x3FD0BC /end MEASUREMENT
/begin MEASUREMENT fcmEnd "Anzahl Eintr‰ge im Fehlerspeicher" UBYTE dez 1 100 0 255 FORMAT "%5.1" ECU_ADDRESS 0x3FD7FF /end MEASUREMENT
/begin MEASUREMENT fcmfes_0_A "" UBYTE default 1 100 0 255 FORMAT "%5.1" ECU_ADDRESS 0x3FCF51 /end MEASUREMENT
/begin MEASUREMENT fcmfes_1_A "" UBYTE default 1 100 0 255 FORMAT "%5.1" ECU_ADDRESS 0x3FCF79 /end MEASUREMENT
/begin MEASUREMENT fcmfes_2_A "" UBYTE default 1 100 0 255 FORMAT "%5.1" ECU_ADDRESS 0x3FCFA1 /end MEASUREMENT
/begin MEASUREMENT fcmfes_3_A "" UBYTE default 1 100 0 255 FORMAT "%5.1" ECU_ADDRESS 0x3FCFC9 /end MEASUREMENT
/begin MEASUREMENT fcmfes_4_A "" UBYTE default 1 100 0 255 FORMAT "%5.1" ECU_ADDRESS 0x3FCFF1 /end MEASUREMENT
/begin MEASUREMENT fcmfes_5_A "" UBYTE default 1 100 0 255 FORMAT "%5.1" ECU_ADDRESS 0x3FD019 /end MEASUREMENT
/begin MEASUREMENT fcmfes_6_A "" UBYTE default 1 100 0 255 FORMAT "%5.1" ECU_ADDRESS 0x3FD041 /end MEASUREMENT
/begin MEASUREMENT fcmfes_7_A "" UBYTE default 1 100 0 255 FORMAT "%5.1" ECU_ADDRESS 0x3FD069 /end MEASUREMENT
/begin MEASUREMENT fcmfes_8_A "" UBYTE default 1 100 0 255 FORMAT "%5.1" ECU_ADDRESS 0x3FD091 /end MEASUREMENT
/begin MEASUREMENT fcmfes_9_A "" UBYTE default 1 100 0 255 FORMAT "%5.1" ECU_ADDRESS 0x3FD0B9 /end MEASUREMENT
/begin MEASUREMENT fcmflc_0_A "" UBYTE default 1 100 0 255 FORMAT "%5.1" ECU_ADDRESS 0x3FCF52 /end MEASUREMENT
/begin MEASUREMENT fcmflc_1_A "" UBYTE default 1 100 0 255 FORMAT "%5.1" ECU_ADDRESS 0x3FCF7A /end MEASUREMENT
/begin MEASUREMENT fcmflc_2_A "" UBYTE default 1 100 0 255 FORMAT "%5.1" ECU_ADDRESS 0x3FCFA2 /end MEASUREMENT
/begin MEASUREMENT fcmflc_3_A "" UBYTE default 1 100 0 255 FORMAT "%5.1" ECU_ADDRESS 0x3FCFCA /end MEASUREMENT
/begin MEASUREMENT fcmflc_4_A "" UBYTE default 1 100 0 255 FORMAT "%5.1" ECU_ADDRESS 0x3FCFF2 /end MEASUREMENT
/begin MEASUREMENT fcmflc_5_A "" UBYTE default 1 100 0 255 FORMAT "%5.1" ECU_ADDRESS 0x3FD01A /end MEASUREMENT
/begin MEASUREMENT fcmflc_6_A "" UBYTE default 1 100 0 255 FORMAT "%5.1" ECU_ADDRESS 0x3FD042 /end MEASUREMENT
/begin MEASUREMENT fcmflc_7_A "" UBYTE default 1 100 0 255 FORMAT "%5.1" ECU_ADDRESS 0x3FD06A /end MEASUREMENT
/begin MEASUREMENT fcmflc_8_A "" UBYTE default 1 100 0 255 FORMAT "%5.1" ECU_ADDRESS 0x3FD092 /end MEASUREMENT
/begin MEASUREMENT fcmflc_9_A "" UBYTE default 1 100 0 255 FORMAT "%5.1" ECU_ADDRESS 0x3FD0BA /end MEASUREMENT
/begin MEASUREMENT fcmfps_0_A "" UBYTE default 1 100 0 255 FORMAT "%5.1" ECU_ADDRESS 0x3FCF4F /end MEASUREMENT
/begin MEASUREMENT fcmfps_1_A "" UBYTE default 1 100 0 255 FORMAT "%5.1" ECU_ADDRESS 0x3FCF77 /end MEASUREMENT
/begin MEASUREMENT fcmfps_2_A "" UBYTE default 1 100 0 255 FORMAT "%5.1" ECU_ADDRESS 0x3FCF9F /end MEASUREMENT
/begin MEASUREMENT fcmfps_3_A "" UBYTE default 1 100 0 255 FORMAT "%5.1" ECU_ADDRESS 0x3FCFC7 /end MEASUREMENT
/begin MEASUREMENT fcmfps_4_A "" UBYTE default 1 100 0 255 FORMAT "%5.1" ECU_ADDRESS 0x3FCFEF /end MEASUREMENT
/begin MEASUREMENT fcmfps_5_A "" UBYTE default 1 100 0 255 FORMAT "%5.1" ECU_ADDRESS 0x3FD017 /end MEASUREMENT
/begin MEASUREMENT fcmfps_6_A "" UBYTE default 1 100 0 255 FORMAT "%5.1" ECU_ADDRESS 0x3FD03F /end MEASUREMENT
/begin MEASUREMENT fcmfps_7_A "" UBYTE default 1 100 0 255 FORMAT "%5.1" ECU_ADDRESS 0x3FD067 /end MEASUREMENT
/begin MEASUREMENT fcmfps_8_A "" UBYTE default 1 100 0 255 FORMAT "%5.1" ECU_ADDRESS 0x3FD08F /end MEASUREMENT
/begin MEASUREMENT fcmfps_9_A "" UBYTE default 1 100 0 255 FORMAT "%5.1" ECU_ADDRESS 0x3FD0B7 /end MEASUREMENT
/begin MEASUREMENT fcmfrz0_0_A "" UBYTE default 1 100 0 255 FORMAT "%5.1" ECU_ADDRESS 0x3FCF55 /end MEASUREMENT
/begin MEASUREMENT fcmfrz0_1_A "" UBYTE default 1 100 0 255 FORMAT "%5.1" ECU_ADDRESS 0x3FCF7D /end MEASUREMENT
/begin MEASUREMENT fcmfrz0_2_A "" UBYTE default 1 100 0 255 FORMAT "%5.1" ECU_ADDRESS 0x3FCFA5 /end MEASUREMENT
/begin MEASUREMENT fcmfrz0_3_A "" UBYTE default 1 100 0 255 FORMAT "%5.1" ECU_ADDRESS 0x3FCFCD /end MEASUREMENT
/begin MEASUREMENT fcmfrz0_4_A "" UBYTE default 1 100 0 255 FORMAT "%5.1" ECU_ADDRESS 0x3FCFF5 /end MEASUREMENT
/begin MEASUREMENT fcmfrz0_5_A "" UBYTE default 1 100 0 255 FORMAT "%5.1" ECU_ADDRESS 0x3FD01D /end MEASUREMENT
/begin MEASUREMENT fcmfrz0_6_A "" UBYTE default 1 100 0 255 FORMAT "%5.1" ECU_ADDRESS 0x3FD045 /end MEASUREMENT
/begin MEASUREMENT fcmfrz0_7_A "" UBYTE default 1 100 0 255 FORMAT "%5.1" ECU_ADDRESS 0x3FD06D /end MEASUREMENT
/begin MEASUREMENT fcmfrz0_8_A "" UBYTE default 1 100 0 255 FORMAT "%5.1" ECU_ADDRESS 0x3FD095 /end MEASUREMENT
/begin MEASUREMENT fcmfrz0_9_A "" UBYTE default 1 100 0 255 FORMAT "%5.1" ECU_ADDRESS 0x3FD0BD /end MEASUREMENT
/begin MEASUREMENT fcmfrz1_0_A "" UBYTE default 1 100 0 255 FORMAT "%5.1" ECU_ADDRESS 0x3FCF56 /end MEASUREMENT
/begin MEASUREMENT fcmfrz1_1_A "" UBYTE default 1 100 0 255 FORMAT "%5.1" ECU_ADDRESS 0x3FCF7E /end MEASUREMENT
/begin MEASUREMENT fcmfrz1_2_A "" UBYTE default 1 100 0 255 FORMAT "%5.1" ECU_ADDRESS 0x3FCFA6 /end MEASUREMENT
/begin MEASUREMENT fcmfrz1_3_A "" UBYTE default 1 100 0 255 FORMAT "%5.1" ECU_ADDRESS 0x3FCFCE /end MEASUREMENT
/begin MEASUREMENT fcmfrz1_4_A "" UBYTE default 1 100 0 255 FORMAT "%5.1" ECU_ADDRESS 0x3FCFF6 /end MEASUREMENT
/begin MEASUREMENT fcmfrz1_5_A "" UBYTE default 1 100 0 255 FORMAT "%5.1" ECU_ADDRESS 0x3FD01E /end MEASUREMENT
/begin MEASUREMENT fcmfrz1_6_A "" UBYTE default 1 100 0 255 FORMAT "%5.1" ECU_ADDRESS 0x3FD046 /end MEASUREMENT
/begin MEASUREMENT fcmfrz1_7_A "" UBYTE default 1 100 0 255 FORMAT "%5.1" ECU_ADDRESS 0x3FD06E /end MEASUREMENT
/begin MEASUREMENT fcmfrz1_8_A "" UBYTE default 1 100 0 255 FORMAT "%5.1" ECU_ADDRESS 0x3FD096 /end MEASUREMENT
/begin MEASUREMENT fcmfrz1_9_A "" UBYTE default 1 100 0 255 FORMAT "%5.1" ECU_ADDRESS 0x3FD0BE /end MEASUREMENT
/begin MEASUREMENT fcmfrz10_0_A "" UBYTE default 1 100 0 255 FORMAT "%5.1" ECU_ADDRESS 0x3FCF5F /end MEASUREMENT
/begin MEASUREMENT fcmfrz10_1_A "" UBYTE default 1 100 0 255 FORMAT "%5.1" ECU_ADDRESS 0x3FCF87 /end MEASUREMENT
/begin MEASUREMENT fcmfrz10_2_A "" UBYTE default 1 100 0 255 FORMAT "%5.1" ECU_ADDRESS 0x3FCFAF /end MEASUREMENT
/begin MEASUREMENT fcmfrz10_3_A "" UBYTE default 1 100 0 255 FORMAT "%5.1" ECU_ADDRESS 0x3FCFD7 /end MEASUREMENT
/begin MEASUREMENT fcmfrz10_4_A "" UBYTE default 1 100 0 255 FORMAT "%5.1" ECU_ADDRESS 0x3FCFFF /end MEASUREMENT
/begin MEASUREMENT fcmfrz10_5_A "" UBYTE default 1 100 0 255 FORMAT "%5.1" ECU_ADDRESS 0x3FD027 /end MEASUREMENT
/begin MEASUREMENT fcmfrz10_6_A "" UBYTE default 1 100 0 255 FORMAT "%5.1" ECU_ADDRESS 0x3FD04F /end MEASUREMENT
/begin MEASUREMENT fcmfrz10_7_A "" UBYTE default 1 100 0 255 FORMAT "%5.1" ECU_ADDRESS 0x3FD077 /end MEASUREMENT
/begin MEASUREMENT fcmfrz10_8_A "" UBYTE default 1 100 0 255 FORMAT "%5.1" ECU_ADDRESS 0x3FD09F /end MEASUREMENT
/begin MEASUREMENT fcmfrz10_9_A "" UBYTE default 1 100 0 255 FORMAT "%5.1" ECU_ADDRESS 0x3FD0C7 /end MEASUREMENT
/begin MEASUREMENT fcmfrz2_0_A "" UBYTE default 1 100 0 255 FORMAT "%5.1" ECU_ADDRESS 0x3FCF57 /end MEASUREMENT
/begin MEASUREMENT fcmfrz2_1_A "" UBYTE default 1 100 0 255 FORMAT "%5.1" ECU_ADDRESS 0x3FCF7F /end MEASUREMENT
/begin MEASUREMENT fcmfrz2_2_A "" UBYTE default 1 100 0 255 FORMAT "%5.1" ECU_ADDRESS 0x3FCFA7 /end MEASUREMENT
/begin MEASUREMENT fcmfrz2_3_A "" UBYTE default 1 100 0 255 FORMAT "%5.1" ECU_ADDRESS 0x3FCFCF /end MEASUREMENT
/begin MEASUREMENT fcmfrz2_4_A "" UBYTE default 1 100 0 255 FORMAT "%5.1" ECU_ADDRESS 0x3FCFF7 /end MEASUREMENT
/begin MEASUREMENT fcmfrz2_5_A "" UBYTE default 1 100 0 255 FORMAT "%5.1" ECU_ADDRESS 0x3FD01F /end MEASUREMENT
/begin MEASUREMENT fcmfrz2_6_A "" UBYTE default 1 100 0 255 FORMAT "%5.1" ECU_ADDRESS 0x3FD047 /end MEASUREMENT
/begin MEASUREMENT fcmfrz2_7_A "" UBYTE default 1 100 0 255 FORMAT "%5.1" ECU_ADDRESS 0x3FD06F /end MEASUREMENT
/begin MEASUREMENT fcmfrz2_8_A "" UBYTE default 1 100 0 255 FORMAT "%5.1" ECU_ADDRESS 0x3FD097 /end MEASUREMENT
/begin MEASUREMENT fcmfrz2_9_A "" UBYTE default 1 100 0 255 FORMAT "%5.1" ECU_ADDRESS 0x3FD0BF /end MEASUREMENT
/begin MEASUREMENT fcmfrz3_0_A "" UBYTE default 1 100 0 255 FORMAT "%5.1" ECU_ADDRESS 0x3FCF58 /end MEASUREMENT
/begin MEASUREMENT fcmfrz3_1_A "" UBYTE default 1 100 0 255 FORMAT "%5.1" ECU_ADDRESS 0x3FCF80 /end MEASUREMENT
/begin MEASUREMENT fcmfrz3_2_A "" UBYTE default 1 100 0 255 FORMAT "%5.1" ECU_ADDRESS 0x3FCFA8 /end MEASUREMENT
/begin MEASUREMENT fcmfrz3_3_A "" UBYTE default 1 100 0 255 FORMAT "%5.1" ECU_ADDRESS 0x3FCFD0 /end MEASUREMENT
/begin MEASUREMENT fcmfrz3_4_A "" UBYTE default 1 100 0 255 FORMAT "%5.1" ECU_ADDRESS 0x3FCFF8 /end MEASUREMENT
/begin MEASUREMENT fcmfrz3_5_A "" UBYTE default 1 100 0 255 FORMAT "%5.1" ECU_ADDRESS 0x3FD020 /end MEASUREMENT
/begin MEASUREMENT fcmfrz3_6_A "" UBYTE default 1 100 0 255 FORMAT "%5.1" ECU_ADDRESS 0x3FD048 /end MEASUREMENT
/begin MEASUREMENT fcmfrz3_7_A "" UBYTE default 1 100 0 255 FORMAT "%5.1" ECU_ADDRESS 0x3FD070 /end MEASUREMENT
/begin MEASUREMENT fcmfrz3_8_A "" UBYTE default 1 100 0 255 FORMAT "%5.1" ECU_ADDRESS 0x3FD098 /end MEASUREMENT
/begin MEASUREMENT fcmfrz3_9_A "" UBYTE default 1 100 0 255 FORMAT "%5.1" ECU_ADDRESS 0x3FD0C0 /end MEASUREMENT
/begin MEASUREMENT fcmfrz4_0_A "" UBYTE default 1 100 0 255 FORMAT "%5.1" ECU_ADDRESS 0x3FCF59 /end MEASUREMENT
/begin MEASUREMENT fcmfrz4_1_A "" UBYTE default 1 100 0 255 FORMAT "%5.1" ECU_ADDRESS 0x3FCF81 /end MEASUREMENT
/begin MEASUREMENT fcmfrz4_2_A "" UBYTE default 1 100 0 255 FORMAT "%5.1" ECU_ADDRESS 0x3FCFA9 /end MEASUREMENT
/begin MEASUREMENT fcmfrz4_3_A "" UBYTE default 1 100 0 255 FORMAT "%5.1" ECU_ADDRESS 0x3FCFD1 /end MEASUREMENT
/begin MEASUREMENT fcmfrz4_4_A "" UBYTE default 1 100 0 255 FORMAT "%5.1" ECU_ADDRESS 0x3FCFF9 /end MEASUREMENT
/begin MEASUREMENT fcmfrz4_5_A "" UBYTE default 1 100 0 255 FORMAT "%5.1" ECU_ADDRESS 0x3FD021 /end MEASUREMENT
/begin MEASUREMENT fcmfrz4_6_A "" UBYTE default 1 100 0 255 FORMAT "%5.1" ECU_ADDRESS 0x3FD049 /end MEASUREMENT
/begin MEASUREMENT fcmfrz4_7_A "" UBYTE default 1 100 0 255 FORMAT "%5.1" ECU_ADDRESS 0x3FD071 /end MEASUREMENT
/begin MEASUREMENT fcmfrz4_8_A "" UBYTE default 1 100 0 255 FORMAT "%5.1" ECU_ADDRESS 0x3FD099 /end MEASUREMENT
/begin MEASUREMENT fcmfrz4_9_A "" UBYTE default 1 100 0 255 FORMAT "%5.1" ECU_ADDRESS 0x3FD0C1 /end MEASUREMENT
/begin MEASUREMENT fcmfrz5_0_A "" UBYTE default 1 100 0 255 FORMAT "%5.1" ECU_ADDRESS 0x3FCF5A /end MEASUREMENT
/begin MEASUREMENT fcmfrz5_1_A "" UBYTE default 1 100 0 255 FORMAT "%5.1" ECU_ADDRESS 0x3FCF82 /end MEASUREMENT
/begin MEASUREMENT fcmfrz5_2_A "" UBYTE default 1 100 0 255 FORMAT "%5.1" ECU_ADDRESS 0x3FCFAA /end MEASUREMENT
/begin MEASUREMENT fcmfrz5_3_A "" UBYTE default 1 100 0 255 FORMAT "%5.1" ECU_ADDRESS 0x3FCFD2 /end MEASUREMENT
/begin MEASUREMENT fcmfrz5_4_A "" UBYTE default 1 100 0 255 FORMAT "%5.1" ECU_ADDRESS 0x3FCFFA /end MEASUREMENT
/begin MEASUREMENT fcmfrz5_5_A "" UBYTE default 1 100 0 255 FORMAT "%5.1" ECU_ADDRESS 0x3FD022 /end MEASUREMENT
/begin MEASUREMENT fcmfrz5_6_A "" UBYTE default 1 100 0 255 FORMAT "%5.1" ECU_ADDRESS 0x3FD04A /end MEASUREMENT
/begin MEASUREMENT fcmfrz5_7_A "" UBYTE default 1 100 0 255 FORMAT "%5.1" ECU_ADDRESS 0x3FD072 /end MEASUREMENT
/begin MEASUREMENT fcmfrz5_8_A "" UBYTE default 1 100 0 255 FORMAT "%5.1" ECU_ADDRESS 0x3FD09A /end MEASUREMENT
/begin MEASUREMENT fcmfrz5_9_A "" UBYTE default 1 100 0 255 FORMAT "%5.1" ECU_ADDRESS 0x3FD0C2 /end MEASUREMENT
/begin MEASUREMENT fcmfrz6_0_A "" UBYTE default 1 100 0 255 FORMAT "%5.1" ECU_ADDRESS 0x3FCF5B /end MEASUREMENT
/begin MEASUREMENT fcmfrz6_1_A "" UBYTE default 1 100 0 255 FORMAT "%5.1" ECU_ADDRESS 0x3FCF83 /end MEASUREMENT
/begin MEASUREMENT fcmfrz6_2_A "" UBYTE default 1 100 0 255 FORMAT "%5.1" ECU_ADDRESS 0x3FCFAB /end MEASUREMENT
/begin MEASUREMENT fcmfrz6_3_A "" UBYTE default 1 100 0 255 FORMAT "%5.1" ECU_ADDRESS 0x3FCFD3 /end MEASUREMENT
/begin MEASUREMENT fcmfrz6_4_A "" UBYTE default 1 100 0 255 FORMAT "%5.1" ECU_ADDRESS 0x3FCFFB /end MEASUREMENT
/begin MEASUREMENT fcmfrz6_5_A "" UBYTE default 1 100 0 255 FORMAT "%5.1" ECU_ADDRESS 0x3FD023 /end MEASUREMENT
/begin MEASUREMENT fcmfrz6_6_A "" UBYTE default 1 100 0 255 FORMAT "%5.1" ECU_ADDRESS 0x3FD04B /end MEASUREMENT
/begin MEASUREMENT fcmfrz6_7_A "" UBYTE default 1 100 0 255 FORMAT "%5.1" ECU_ADDRESS 0x3FD073 /end MEASUREMENT
/begin MEASUREMENT fcmfrz6_8_A "" UBYTE default 1 100 0 255 FORMAT "%5.1" ECU_ADDRESS 0x3FD09B /end MEASUREMENT
/begin MEASUREMENT fcmfrz6_9_A "" UBYTE default 1 100 0 255 FORMAT "%5.1" ECU_ADDRESS 0x3FD0C3 /end MEASUREMENT
/begin MEASUREMENT fcmfrz7_0_A "" UBYTE default 1 100 0 255 FORMAT "%5.1" ECU_ADDRESS 0x3FCF5C /end MEASUREMENT
/begin MEASUREMENT fcmfrz7_1_A "" UBYTE default 1 100 0 255 FORMAT "%5.1" ECU_ADDRESS 0x3FCF84 /end MEASUREMENT
/begin MEASUREMENT fcmfrz7_2_A "" UBYTE default 1 100 0 255 FORMAT "%5.1" ECU_ADDRESS 0x3FCFAC /end MEASUREMENT
/begin MEASUREMENT fcmfrz7_3_A "" UBYTE default 1 100 0 255 FORMAT "%5.1" ECU_ADDRESS 0x3FCFD4 /end MEASUREMENT
/begin MEASUREMENT fcmfrz7_4_A "" UBYTE default 1 100 0 255 FORMAT "%5.1" ECU_ADDRESS 0x3FCFFC /end MEASUREMENT
/begin MEASUREMENT fcmfrz7_5_A "" UBYTE default 1 100 0 255 FORMAT "%5.1" ECU_ADDRESS 0x3FD024 /end MEASUREMENT
/begin MEASUREMENT fcmfrz7_6_A "" UBYTE default 1 100 0 255 FORMAT "%5.1" ECU_ADDRESS 0x3FD04C /end MEASUREMENT
/begin MEASUREMENT fcmfrz7_7_A "" UBYTE default 1 100 0 255 FORMAT "%5.1" ECU_ADDRESS 0x3FD074 /end MEASUREMENT
/begin MEASUREMENT fcmfrz7_8_A "" UBYTE default 1 100 0 255 FORMAT "%5.1" ECU_ADDRESS 0x3FD09C /end MEASUREMENT
/begin MEASUREMENT fcmfrz7_9_A "" UBYTE default 1 100 0 255 FORMAT "%5.1" ECU_ADDRESS 0x3FD0C4 /end MEASUREMENT
/begin MEASUREMENT fcmfrz8_0_A "" UBYTE default 1 100 0 255 FORMAT "%5.1" ECU_ADDRESS 0x3FCF5D /end MEASUREMENT
/begin MEASUREMENT fcmfrz8_1_A "" UBYTE default 1 100 0 255 FORMAT "%5.1" ECU_ADDRESS 0x3FCF85 /end MEASUREMENT
/begin MEASUREMENT fcmfrz8_2_A "" UBYTE default 1 100 0 255 FORMAT "%5.1" ECU_ADDRESS 0x3FCFAD /end MEASUREMENT
/begin MEASUREMENT fcmfrz8_3_A "" UBYTE default 1 100 0 255 FORMAT "%5.1" ECU_ADDRESS 0x3FCFD5 /end MEASUREMENT
/begin MEASUREMENT fcmfrz8_4_A "" UBYTE default 1 100 0 255 FORMAT "%5.1" ECU_ADDRESS 0x3FCFFD /end MEASUREMENT
/begin MEASUREMENT fcmfrz8_5_A "" UBYTE default 1 100 0 255 FORMAT "%5.1" ECU_ADDRESS 0x3FD025 /end MEASUREMENT
/begin MEASUREMENT fcmfrz8_6_A "" UBYTE default 1 100 0 255 FORMAT "%5.1" ECU_ADDRESS 0x3FD04D /end MEASUREMENT
/begin MEASUREMENT fcmfrz8_7_A "" UBYTE default 1 100 0 255 FORMAT "%5.1" ECU_ADDRESS 0x3FD075 /end MEASUREMENT
/begin MEASUREMENT fcmfrz8_8_A "" UBYTE default 1 100 0 255 FORMAT "%5.1" ECU_ADDRESS 0x3FD09D /end MEASUREMENT
/begin MEASUREMENT fcmfrz8_9_A "" UBYTE default 1 100 0 255 FORMAT "%5.1" ECU_ADDRESS 0x3FD0C5 /end MEASUREMENT
/begin MEASUREMENT fcmfrz9_0_A "" UBYTE default 1 100 0 255 FORMAT "%5.1" ECU_ADDRESS 0x3FCF5E /end MEASUREMENT
/begin MEASUREMENT fcmfrz9_1_A "" UBYTE default 1 100 0 255 FORMAT "%5.1" ECU_ADDRESS 0x3FCF86 /end MEASUREMENT
/begin MEASUREMENT fcmfrz9_2_A "" UBYTE default 1 100 0 255 FORMAT "%5.1" ECU_ADDRESS 0x3FCFAE /end MEASUREMENT
/begin MEASUREMENT fcmfrz9_3_A "" UBYTE default 1 100 0 255 FORMAT "%5.1" ECU_ADDRESS 0x3FCFD6 /end MEASUREMENT
/begin MEASUREMENT fcmfrz9_4_A "" UBYTE default 1 100 0 255 FORMAT "%5.1" ECU_ADDRESS 0x3FCFFE /end MEASUREMENT
/begin MEASUREMENT fcmfrz9_5_A "" UBYTE default 1 100 0 255 FORMAT "%5.1" ECU_ADDRESS 0x3FD026 /end MEASUREMENT
/begin MEASUREMENT fcmfrz9_6_A "" UBYTE default 1 100 0 255 FORMAT "%5.1" ECU_ADDRESS 0x3FD04E /end MEASUREMENT
/begin MEASUREMENT fcmfrz9_7_A "" UBYTE default 1 100 0 255 FORMAT "%5.1" ECU_ADDRESS 0x3FD076 /end MEASUREMENT
/begin MEASUREMENT fcmfrz9_8_A "" UBYTE default 1 100 0 255 FORMAT "%5.1" ECU_ADDRESS 0x3FD09E /end MEASUREMENT
/begin MEASUREMENT fcmfrz9_9_A "" UBYTE default 1 100 0 255 FORMAT "%5.1" ECU_ADDRESS 0x3FD0C6 /end MEASUREMENT
/begin MEASUREMENT fcmHis "" UBYTE dez 1 100 0 255 FORMAT "%5.1" ECU_ADDRESS 0x3FE8B2 /end MEASUREMENT
/begin MEASUREMENT fcmhlc_0_A "" UBYTE default 1 100 0 255 FORMAT "%5.1" ECU_ADDRESS 0x3FCF53 /end MEASUREMENT
/begin MEASUREMENT fcmhlc_1_A "" UBYTE default 1 100 0 255 FORMAT "%5.1" ECU_ADDRESS 0x3FCF7B /end MEASUREMENT
/begin MEASUREMENT fcmhlc_2_A "" UBYTE default 1 100 0 255 FORMAT "%5.1" ECU_ADDRESS 0x3FCFA3 /end MEASUREMENT
/begin MEASUREMENT fcmhlc_3_A "" UBYTE default 1 100 0 255 FORMAT "%5.1" ECU_ADDRESS 0x3FCFCB /end MEASUREMENT
/begin MEASUREMENT fcmhlc_4_A "" UBYTE default 1 100 0 255 FORMAT "%5.1" ECU_ADDRESS 0x3FCFF3 /end MEASUREMENT
/begin MEASUREMENT fcmhlc_5_A "" UBYTE default 1 100 0 255 FORMAT "%5.1" ECU_ADDRESS 0x3FD01B /end MEASUREMENT
/begin MEASUREMENT fcmhlc_6_A "" UBYTE default 1 100 0 255 FORMAT "%5.1" ECU_ADDRESS 0x3FD043 /end MEASUREMENT
/begin MEASUREMENT fcmhlc_7_A "" UBYTE default 1 100 0 255 FORMAT "%5.1" ECU_ADDRESS 0x3FD06B /end MEASUREMENT
/begin MEASUREMENT fcmhlc_8_A "" UBYTE default 1 100 0 255 FORMAT "%5.1" ECU_ADDRESS 0x3FD093 /end MEASUREMENT
/begin MEASUREMENT fcmhlc_9_A "" UBYTE default 1 100 0 255 FORMAT "%5.1" ECU_ADDRESS 0x3FD0BB /end MEASUREMENT
/begin MEASUREMENT fcmhz_0_A "" UBYTE default 1 100 0 255 FORMAT "%5.1" ECU_ADDRESS 0x3FCF72 /end MEASUREMENT
/begin MEASUREMENT fcmhz_1_A "" UBYTE default 1 100 0 255 FORMAT "%5.1" ECU_ADDRESS 0x3FCF9A /end MEASUREMENT
/begin MEASUREMENT fcmhz_2_A "" UBYTE default 1 100 0 255 FORMAT "%5.1" ECU_ADDRESS 0x3FCFC2 /end MEASUREMENT
/begin MEASUREMENT fcmhz_3_A "" UBYTE default 1 100 0 255 FORMAT "%5.1" ECU_ADDRESS 0x3FCFEA /end MEASUREMENT
/begin MEASUREMENT fcmhz_4_A "" UBYTE default 1 100 0 255 FORMAT "%5.1" ECU_ADDRESS 0x3FD012 /end MEASUREMENT
/begin MEASUREMENT fcmhz_5_A "" UBYTE default 1 100 0 255 FORMAT "%5.1" ECU_ADDRESS 0x3FD03A /end MEASUREMENT
/begin MEASUREMENT fcmhz_6_A "" UBYTE default 1 100 0 255 FORMAT "%5.1" ECU_ADDRESS 0x3FD062 /end MEASUREMENT
/begin MEASUREMENT fcmhz_7_A "" UBYTE default 1 100 0 255 FORMAT "%5.1" ECU_ADDRESS 0x3FD08A /end MEASUREMENT
/begin MEASUREMENT fcmhz_8_A "" UBYTE default 1 100 0 255 FORMAT "%5.1" ECU_ADDRESS 0x3FD0B2 /end MEASUREMENT
/begin MEASUREMENT fcmhz_9_A "" UBYTE default 1 100 0 255 FORMAT "%5.1" ECU_ADDRESS 0x3FD0DA /end MEASUREMENT
/begin MEASUREMENT FCMTab "" UWORD dez 1 100 0 65535 FORMAT "%8.2" ECU_ADDRESS 0x3FCF4C /end MEASUREMENT
/begin MEASUREMENT fcmtsf_0_A "" UBYTE default 1 100 0 255 FORMAT "%5.1" ECU_ADDRESS 0x3FCF4D /end MEASUREMENT
/begin MEASUREMENT fcmtsf_1_A "" UBYTE default 1 100 0 255 FORMAT "%5.1" ECU_ADDRESS 0x3FCF75 /end MEASUREMENT
/begin MEASUREMENT fcmtsf_2_A "" UBYTE default 1 100 0 255 FORMAT "%5.1" ECU_ADDRESS 0x3FCF9D /end MEASUREMENT
/begin MEASUREMENT fcmtsf_3_A "" UBYTE default 1 100 0 255 FORMAT "%5.1" ECU_ADDRESS 0x3FCFC5 /end MEASUREMENT
/begin MEASUREMENT fcmtsf_4_A "" UBYTE default 1 100 0 255 FORMAT "%5.1" ECU_ADDRESS 0x3FCFED /end MEASUREMENT
/begin MEASUREMENT fcmtsf_5_A "" UBYTE default 1 100 0 255 FORMAT "%5.1" ECU_ADDRESS 0x3FD015 /end MEASUREMENT
/begin MEASUREMENT fcmtsf_6_A "" UBYTE default 1 100 0 255 FORMAT "%5.1" ECU_ADDRESS 0x3FD03D /end MEASUREMENT
/begin MEASUREMENT fcmtsf_7_A "" UBYTE default 1 100 0 255 FORMAT "%5.1" ECU_ADDRESS 0x3FD065 /end MEASUREMENT
/begin MEASUREMENT fcmtsf_8_A "" UBYTE default 1 100 0 255 FORMAT "%5.1" ECU_ADDRESS 0x3FD08D /end MEASUREMENT
/begin MEASUREMENT fcmtsf_9_A "" UBYTE default 1 100 0 255 FORMAT "%5.1" ECU_ADDRESS 0x3FD0B5 /end MEASUREMENT
/begin MEASUREMENT fcmtyp_0_A "" UBYTE default 1 100 0 255 FORMAT "%5.1" ECU_ADDRESS 0x3FCF4E /end MEASUREMENT
/begin MEASUREMENT fcmtyp_1_A "" UBYTE default 1 100 0 255 FORMAT "%5.1" ECU_ADDRESS 0x3FCF76 /end MEASUREMENT
/begin MEASUREMENT fcmtyp_2_A "" UBYTE default 1 100 0 255 FORMAT "%5.1" ECU_ADDRESS 0x3FCF9E /end MEASUREMENT
/begin MEASUREMENT fcmtyp_3_A "" UBYTE default 1 100 0 255 FORMAT "%5.1" ECU_ADDRESS 0x3FCFC6 /end MEASUREMENT
/begin MEASUREMENT fcmtyp_4_A "" UBYTE default 1 100 0 255 FORMAT "%5.1" ECU_ADDRESS 0x3FCFEE /end MEASUREMENT
/begin MEASUREMENT fcmtyp_5_A "" UBYTE default 1 100 0 255 FORMAT "%5.1" ECU_ADDRESS 0x3FD016 /end MEASUREMENT
/begin MEASUREMENT fcmtyp_6_A "" UBYTE default 1 100 0 255 FORMAT "%5.1" ECU_ADDRESS 0x3FD03E /end MEASUREMENT
/begin MEASUREMENT fcmtyp_7_A "" UBYTE default 1 100 0 255 FORMAT "%5.1" ECU_ADDRESS 0x3FD066 /end MEASUREMENT
/begin MEASUREMENT fcmtyp_8_A "" UBYTE default 1 100 0 255 FORMAT "%5.1" ECU_ADDRESS 0x3FD08E /end MEASUREMENT
/begin MEASUREMENT fcmtyp_9_A "" UBYTE default 1 100 0 255 FORMAT "%5.1" ECU_ADDRESS 0x3FD0B6 /end MEASUREMENT
/begin MEASUREMENT sfpaaa "Status Fehlerpfad: Tabellenanfang" UWORD dez 1 100 0 65535 FORMAT "%8.2" ECU_ADDRESS 0x3FDD16 /end MEASUREMENT
/begin MEASUREMENT sfpas "Status Fehlerpfad: ASR/TC Schnittstelle" UWORD default 1 100 0 65535 FORMAT "%8.2" ECU_ADDRESS 0x3FDD20 /end MEASUREMENT
/begin MEASUREMENT sfpbkvpe "Status Fehlerpfad: BKV-Pumpe - Endstufe" UWORD dez 1 100 0 65535 FORMAT "%8.2" ECU_ADDRESS 0x3FDD24 /end MEASUREMENT
/begin MEASUREMENT sfpbm "Status Fehlerpfad: Bezugsmarkengeber" UWORD dez 1 100 0 65535 FORMAT "%8.2" ECU_ADDRESS 0x3FDD26 /end MEASUREMENT
/begin MEASUREMENT sfpcana "Status Fehlerpfad: Diagnose CAN A (Fahrzeug-CAN)" UWORD default 1 100 0 65535 FORMAT "%8.2" ECU_ADDRESS 0x3FDD2C /end MEASUREMENT
/begin MEASUREMENT sfpcas "Status Fehlerpfad: Diagnose CAN-Timeout ASC-Schnittstelle" UWORD dez 1 100 0 65535 FORMAT "%8.2" ECU_ADDRESS 0x3FDD2E /end MEASUREMENT
/begin MEASUREMENT sfpcez "" UWORD dez 1 100 0 65535 FORMAT "%8.2" ECU_ADDRESS 0x3FDD30 /end MEASUREMENT
/begin MEASUREMENT sfpcge "Status Fehlerpfad: Diagnose CAN-Timeout EGS-Schnittstelle" UWORD dez 1 100 0 65535 FORMAT "%8.2" ECU_ADDRESS 0x3FDD32 /end MEASUREMENT
/begin MEASUREMENT sfpcins "Status Fehlerpfad: Diagnose CAN-Timeout Kombiinstr." UWORD dez 1 100 0 65535 FORMAT "%8.2" ECU_ADDRESS 0x3FDD34 /end MEASUREMENT
/begin MEASUREMENT sfpcod "Status Fehlerpfad: Steuerger‰t noch nicht codiert" UWORD default 1 100 0 65535 FORMAT "%8.2" ECU_ADDRESS 0x3FDD36 /end MEASUREMENT
/begin MEASUREMENT sfpdisa "Status des Fehlerpfades" UWORD dez 1 100 0 65535 FORMAT "%8.2" ECU_ADDRESS 0x3FDD3E /end MEASUREMENT
/begin MEASUREMENT sfpdk "Status Fehlerpfad DK: Drosselklappe" UWORD dez 1 100 0 65535 FORMAT "%8.2" ECU_ADDRESS 0x3FDD40 /end MEASUREMENT
/begin MEASUREMENT sfpdk1p "Status Fehlerpfad DK1P: Drosselklappe 1. Poti" UWORD dez 1 100 0 65535 FORMAT "%8.2" ECU_ADDRESS 0x3FDD42 /end MEASUREMENT
/begin MEASUREMENT sfpdk2p "Status Fehlerpfad DK2P: Drosselklappe 2. Poti" UWORD dez 1 100 0 65535 FORMAT "%8.2" ECU_ADDRESS 0x3FDD44 /end MEASUREMENT
/begin MEASUREMENT sfpdvee "Statuswort: DV-E Endstufe" UWORD dez 1 100 0 65535 FORMAT "%8.2" ECU_ADDRESS 0x3FDD4E /end MEASUREMENT
/begin MEASUREMENT sfpdvef "Statuswort: DV-E Fehler bei Federpr¸fung" UWORD dez 1 100 0 65535 FORMAT "%8.2" ECU_ADDRESS 0x3FDD50 /end MEASUREMENT
/begin MEASUREMENT sfpdvefo "Status Fehlerpfad: DV-E-Fehler bei Federpr¸fung ""÷ffnen""" UWORD dez 1 100 0 65535 FORMAT "%8.2" ECU_ADDRESS 0x3FDD52 /end MEASUREMENT
/begin MEASUREMENT sfpdvel "Statuswort: DV-E Lageabweichung" UWORD dez 1 100 0 65535 FORMAT "%8.2" ECU_ADDRESS 0x3FDD54 /end MEASUREMENT
/begin MEASUREMENT sfpdven "Statuswort: DV-E Fehler bei Pr¸fung Notluftposition" UWORD dez 1 100 0 65535 FORMAT "%8.2" ECU_ADDRESS 0x3FDD56 /end MEASUREMENT
/begin MEASUREMENT sfpdver "Statuswort: DV-E Regelbereich" UWORD dez 1 100 0 65535 FORMAT "%8.2" ECU_ADDRESS 0x3FDD58 /end MEASUREMENT
/begin MEASUREMENT sfpdvet "Status Fehlerpfad: DV-E-Tauchserkennung ohne Adaption" UWORD dez 1 100 0 65535 FORMAT "%8.2" ECU_ADDRESS 0x3FDD5A /end MEASUREMENT
/begin MEASUREMENT sfpdveu "Statuswort: DV-E Fehler beim UMA-Lernen" UWORD dez 1 100 0 65535 FORMAT "%8.2" ECU_ADDRESS 0x3FDD5C /end MEASUREMENT
/begin MEASUREMENT sfpdveub "Status Fehlerpfad: DV-E-Adaption Abbruch wg. Umweltbedingung" UWORD dez 1 100 0 65535 FORMAT "%8.2" ECU_ADDRESS 0x3FDD5E /end MEASUREMENT
/begin MEASUREMENT sfpdveuw "Status Fehlerpfad: UMA-Wiederlernen" UWORD dez 1 100 0 65535 FORMAT "%8.2" ECU_ADDRESS 0x3FDD60 /end MEASUREMENT
/begin MEASUREMENT sfpdvev "Statuswort: DV-E Fehler bei Verst‰rkerabgleich" UWORD dez 1 100 0 65535 FORMAT "%8.2" ECU_ADDRESS 0x3FDD62 /end MEASUREMENT
/begin MEASUREMENT sfpels "Status Fehlerpfad: E-Box-L¸fter" UWORD dez 1 100 0 65535 FORMAT "%8.2" ECU_ADDRESS 0x3FDD78 /end MEASUREMENT
/begin MEASUREMENT sfpets "Status Fehlerpfad: Diagnose el.Thermostat-Endstufe" UWORD default 1 100 0 65535 FORMAT "%8.2" ECU_ADDRESS 0x3FDD7E /end MEASUREMENT
/begin MEASUREMENT sfpev1 "Status Fehlerpfad: EV1" UWORD dez 1 100 0 65535 FORMAT "%8.2" ECU_ADDRESS 0x3FDD80 /end MEASUREMENT
/begin MEASUREMENT sfpev2 "Status Fehlerpfad: EV2" UWORD dez 1 100 0 65535 FORMAT "%8.2" ECU_ADDRESS 0x3FDD82 /end MEASUREMENT
/begin MEASUREMENT sfpev3 "Status Fehlerpfad: EV3" UWORD dez 1 100 0 65535 FORMAT "%8.2" ECU_ADDRESS 0x3FDD84 /end MEASUREMENT
/begin MEASUREMENT sfpev4 "Status Fehlerpfad: EV4" UWORD dez 1 100 0 65535 FORMAT "%8.2" ECU_ADDRESS 0x3FDD86 /end MEASUREMENT
/begin MEASUREMENT sfpezh "" UWORD dez 1 100 0 65535 FORMAT "%8.2" ECU_ADDRESS 0x3FDD90 /end MEASUREMENT
/begin MEASUREMENT sfphsh "Status Fehlerpfad: Heizung Lambdasonde hinter Kat" UWORD dez 1 100 0 65535 FORMAT "%8.2" ECU_ADDRESS 0x3FDDA0 /end MEASUREMENT
/begin MEASUREMENT sfphsh2 "Status Fehlerpfad: Heizung Lambdasonde 2 hinter Kat" UWORD dez 1 100 0 65535 FORMAT "%8.2" ECU_ADDRESS 0x3FDDA2 /end MEASUREMENT
/begin MEASUREMENT sfphsv "Status Fehlerpfad: Heizung Lambdasonde vor Kat" UWORD dez 1 100 0 65535 FORMAT "%8.2" ECU_ADDRESS 0x3FDDA4 /end MEASUREMENT
/begin MEASUREMENT sfphsv2 "Status Fehlerpfad: Heizung Lambdasonde 2 vor Kat" UWORD dez 1 100 0 65535 FORMAT "%8.2" ECU_ADDRESS 0x3FDDA6 /end MEASUREMENT
/begin MEASUREMENT sfpkat "Status Fehlerpfad: Katalysator-‹berwachung" UWORD dez 1 100 0 65535 FORMAT "%8.2" ECU_ADDRESS 0x3FDDAA /end MEASUREMENT
/begin MEASUREMENT sfpkkue "" UWORD default 1 100 0 65535 FORMAT "%8.2" ECU_ADDRESS 0x3FDDAE /end MEASUREMENT
/begin MEASUREMENT sfpkose "Status Fehlerpfad: Diagnose Klimakompressor-Endstufe" UWORD dez 1 100 0 65535 FORMAT "%8.2" ECU_ADDRESS 0x3FDDB0 /end MEASUREMENT
/begin MEASUREMENT sfpkpe "Status Fehlerpfad: EKP-Relais Endstufe" UWORD dez 1 100 0 65535 FORMAT "%8.2" ECU_ADDRESS 0x3FDDB2 /end MEASUREMENT
/begin MEASUREMENT sfpkrnt "Status Fehlerpfad: Klopfregelung Nulltest" UWORD dez 1 100 0 65535 FORMAT "%8.2" ECU_ADDRESS 0x3FDDB4 /end MEASUREMENT
/begin MEASUREMENT sfpkrof "Status Fehlerpfad: Klopfregelung Offset" UWORD dez 1 100 0 65535 FORMAT "%8.2" ECU_ADDRESS 0x3FDDB6 /end MEASUREMENT
/begin MEASUREMENT sfplde "Status Fehlerpfad: Ladedrucksteuerventil Endstufe" UWORD default 1 100 0 65535 FORMAT "%8.2" ECU_ADDRESS 0x3FDDCC /end MEASUREMENT
/begin MEASUREMENT sfpldpe "Status Fehlerpfad: Leckdiagnosepumpe - Endstufe" UWORD default 1 100 0 65535 FORMAT "%8.2" ECU_ADDRESS 0x3FDDD0 /end MEASUREMENT
/begin MEASUREMENT sfplm "Status Fehlerpfad: Hauptf¸llungssensor" UWORD dez 1 100 0 65535 FORMAT "%8.2" ECU_ADDRESS 0x3FDDD4 /end MEASUREMENT
/begin MEASUREMENT sfpluea "Status Fehlerpfad: Endstufe Motor L¸fter A" UWORD default 1 100 0 65535 FORMAT "%8.2" ECU_ADDRESS 0x3FDDDC /end MEASUREMENT
/begin MEASUREMENT sfpluve "Status Fehlerpfad: EV-Luftumfassungsventil Endstufe" UWORD default 1 100 0 65535 FORMAT "%8.2" ECU_ADDRESS 0x3FDDDE /end MEASUREMENT
/begin MEASUREMENT sfpn "Status Fehlerpfad: Drehzahlgeber" UWORD dez 1 100 0 65535 FORMAT "%8.2" ECU_ADDRESS 0x3FDE02 /end MEASUREMENT
/begin MEASUREMENT sfpstae "Status Fehlerpfad: Starter Endstufe" UWORD default 1 100 0 65535 FORMAT "%8.2" ECU_ADDRESS 0x3FDE20 /end MEASUREMENT
/begin MEASUREMENT sfpswe "Status Fehlerpfad: Schlechtwegerkennung" UWORD dez 1 100 0 65535 FORMAT "%8.2" ECU_ADDRESS 0x3FDE24 /end MEASUREMENT
/begin MEASUREMENT sfpzzz "Dummy: Tabellenende" UWORD dez 1 100 0 65535 FORMAT "%8.2" ECU_ADDRESS 0x3FDE54 /end MEASUREMENT
/begin MEASUREMENT TYP_as "" UWORD B_TRUE 1 100 0 1 BIT_MASK 0xf00 FORMAT "%13.11" ECU_ADDRESS 0x3FDD20 /end MEASUREMENT
/begin MEASUREMENT TYP_bkvpe "" UWORD B_TRUE 1 100 0 1 BIT_MASK 0xf00 FORMAT "%13.11" ECU_ADDRESS 0x3FDD24 /end MEASUREMENT
/begin MEASUREMENT TYP_bm "" UWORD B_TRUE 1 100 0 1 BIT_MASK 0xf00 FORMAT "%13.11" ECU_ADDRESS 0x3FDD26 /end MEASUREMENT
/begin MEASUREMENT TYP_cana "" UWORD B_TRUE 1 100 0 1 BIT_MASK 0xf00 FORMAT "%13.11" ECU_ADDRESS 0x3FDD2C /end MEASUREMENT
/begin MEASUREMENT TYP_cas "" UWORD B_TRUE 1 100 0 1 BIT_MASK 0xf00 FORMAT "%13.11" ECU_ADDRESS 0x3FDD2E /end MEASUREMENT
/begin MEASUREMENT TYP_cez "" UWORD B_TRUE 1 100 0 1 BIT_MASK 0xf00 FORMAT "%13.11" ECU_ADDRESS 0x3FDD30 /end MEASUREMENT
/begin MEASUREMENT TYP_cge "" UWORD B_TRUE 1 100 0 1 BIT_MASK 0xf00 FORMAT "%13.11" ECU_ADDRESS 0x3FDD32 /end MEASUREMENT
/begin MEASUREMENT TYP_cins "" UWORD B_TRUE 1 100 0 1 BIT_MASK 0xf00 FORMAT "%13.11" ECU_ADDRESS 0x3FDD34 /end MEASUREMENT
/begin MEASUREMENT TYP_cod "" UWORD B_TRUE 1 100 0 1 BIT_MASK 0xf00 FORMAT "%13.11" ECU_ADDRESS 0x3FDD36 /end MEASUREMENT
/begin MEASUREMENT TYP_disa "" UWORD B_TRUE 1 100 0 1 BIT_MASK 0xf00 FORMAT "%13.11" ECU_ADDRESS 0x3FDD3E /end MEASUREMENT
/begin MEASUREMENT TYP_dk "" UWORD B_TRUE 1 100 0 1 BIT_MASK 0xf00 FORMAT "%13.11" ECU_ADDRESS 0x3FDD40 /end MEASUREMENT
/begin MEASUREMENT TYP_dk1p "" UWORD B_TRUE 1 100 0 1 BIT_MASK 0xf00 FORMAT "%13.11" ECU_ADDRESS 0x3FDD42 /end MEASUREMENT
/begin MEASUREMENT TYP_dk2p "" UWORD B_TRUE 1 100 0 1 BIT_MASK 0xf00 FORMAT "%13.11" ECU_ADDRESS 0x3FDD44 /end MEASUREMENT
/begin MEASUREMENT TYP_dvee "Fehlertyp: DV-E Endstufe" UWORD B_TRUE 1 100 0 1 BIT_MASK 0xf00 FORMAT "%13.11" ECU_ADDRESS 0x3FDD4E /end MEASUREMENT
/begin MEASUREMENT TYP_dvef "Fehlertyp: DV-E Fehler bei Federpr¸fung" UWORD B_TRUE 1 100 0 1 BIT_MASK 0xf00 FORMAT "%13.11" ECU_ADDRESS 0x3FDD50 /end MEASUREMENT
/begin MEASUREMENT TYP_dvefo "" UWORD B_TRUE 1 100 0 1 BIT_MASK 0xf00 FORMAT "%13.11" ECU_ADDRESS 0x3FDD52 /end MEASUREMENT
/begin MEASUREMENT TYP_dvel "Fehlertyp: DV-E Lageabweichung" UWORD B_TRUE 1 100 0 1 BIT_MASK 0xf00 FORMAT "%13.11" ECU_ADDRESS 0x3FDD54 /end MEASUREMENT
/begin MEASUREMENT TYP_dven "Fehlertyp: DV-E Fehler bei Pr¸fung Notluftposition" UWORD B_TRUE 1 100 0 1 BIT_MASK 0xf00 FORMAT "%13.11" ECU_ADDRESS 0x3FDD56 /end MEASUREMENT
/begin MEASUREMENT TYP_dver "Fehlertyp: DV-E Regelbereich" UWORD B_TRUE 1 100 0 1 BIT_MASK 0xf00 FORMAT "%13.11" ECU_ADDRESS 0x3FDD58 /end MEASUREMENT
/begin MEASUREMENT TYP_dvet "" UWORD B_TRUE 1 100 0 1 BIT_MASK 0xf00 FORMAT "%13.11" ECU_ADDRESS 0x3FDD5A /end MEASUREMENT
/begin MEASUREMENT TYP_dveu "Fehlertyp: DV-E Fehler beim UMA-Lernen" UWORD B_TRUE 1 100 0 1 BIT_MASK 0xf00 FORMAT "%13.11" ECU_ADDRESS 0x3FDD5C /end MEASUREMENT
/begin MEASUREMENT TYP_dveub "" UWORD B_TRUE 1 100 0 1 BIT_MASK 0xf00 FORMAT "%13.11" ECU_ADDRESS 0x3FDD5E /end MEASUREMENT
/begin MEASUREMENT TYP_dveuw "" UWORD B_TRUE 1 100 0 1 BIT_MASK 0xf00 FORMAT "%13.11" ECU_ADDRESS 0x3FDD60 /end MEASUREMENT
/begin MEASUREMENT TYP_dvev "Fehlertyp: DV-E Fehler bei Verst‰rkerabgleich" UWORD B_TRUE 1 100 0 1 BIT_MASK 0xf00 FORMAT "%13.11" ECU_ADDRESS 0x3FDD62 /end MEASUREMENT
/begin MEASUREMENT TYP_els "" UWORD B_TRUE 1 100 0 1 BIT_MASK 0xf00 FORMAT "%13.11" ECU_ADDRESS 0x3FDD78 /end MEASUREMENT
/begin MEASUREMENT TYP_ets "" UWORD B_TRUE 1 100 0 1 BIT_MASK 0xf00 FORMAT "%13.11" ECU_ADDRESS 0x3FDD7E /end MEASUREMENT
/begin MEASUREMENT TYP_ev1 "" UWORD B_TRUE 1 100 0 1 BIT_MASK 0xf00 FORMAT "%13.11" ECU_ADDRESS 0x3FDD80 /end MEASUREMENT
/begin MEASUREMENT TYP_ev2 "" UWORD B_TRUE 1 100 0 1 BIT_MASK 0xf00 FORMAT "%13.11" ECU_ADDRESS 0x3FDD82 /end MEASUREMENT
/begin MEASUREMENT TYP_ev3 "" UWORD B_TRUE 1 100 0 1 BIT_MASK 0xf00 FORMAT "%13.11" ECU_ADDRESS 0x3FDD84 /end MEASUREMENT
/begin MEASUREMENT TYP_ev4 "" UWORD B_TRUE 1 100 0 1 BIT_MASK 0xf00 FORMAT "%13.11" ECU_ADDRESS 0x3FDD86 /end MEASUREMENT
/begin MEASUREMENT TYP_ezh "" UWORD B_TRUE 1 100 0 1 BIT_MASK 0xf00 FORMAT "%13.11" ECU_ADDRESS 0x3FDD90 /end MEASUREMENT
/begin MEASUREMENT TYP_hsh "Fehlertyp: Heizung Lambdasonde 1 hinter Kat" UWORD B_TRUE 1 100 0 1 BIT_MASK 0xf00 FORMAT "%13.11" ECU_ADDRESS 0x3FDDA0 /end MEASUREMENT
/begin MEASUREMENT TYP_hsh2 "Fehlertyp: Heizung Lambdasonde 2 hinter Kat" UWORD B_TRUE 1 100 0 1 BIT_MASK 0xf00 FORMAT "%13.11" ECU_ADDRESS 0x3FDDA2 /end MEASUREMENT
/begin MEASUREMENT TYP_hsv "Fehlertyp: Heizung Lambdasonde 1 vor Kat" UWORD B_TRUE 1 100 0 1 BIT_MASK 0xf00 FORMAT "%13.11" ECU_ADDRESS 0x3FDDA4 /end MEASUREMENT
/begin MEASUREMENT TYP_hsv2 "Fehlertyp: Heizung Lambdasonde 2 vor Kat" UWORD B_TRUE 1 100 0 1 BIT_MASK 0xf00 FORMAT "%13.11" ECU_ADDRESS 0x3FDDA6 /end MEASUREMENT
/begin MEASUREMENT TYP_kat "Fehlertyp: Katalysator-Diagnose" UWORD B_TRUE 1 100 0 1 BIT_MASK 0xf00 FORMAT "%13.11" ECU_ADDRESS 0x3FDDAA /end MEASUREMENT
/begin MEASUREMENT TYP_kkue "" UWORD B_TRUE 1 100 0 1 BIT_MASK 0xf00 FORMAT "%13.11" ECU_ADDRESS 0x3FDDAE /end MEASUREMENT
/begin MEASUREMENT TYP_kose "" UWORD B_TRUE 1 100 0 1 BIT_MASK 0xf00 FORMAT "%13.11" ECU_ADDRESS 0x3FDDB0 /end MEASUREMENT
/begin MEASUREMENT TYP_kpe "Fehlertyp: EKP-Relais Endstufe" UWORD B_TRUE 1 100 0 1 BIT_MASK 0xf00 FORMAT "%13.11" ECU_ADDRESS 0x3FDDB2 /end MEASUREMENT
/begin MEASUREMENT TYP_krnt "" UWORD B_TRUE 1 100 0 1 BIT_MASK 0xf00 FORMAT "%13.11" ECU_ADDRESS 0x3FDDB4 /end MEASUREMENT
/begin MEASUREMENT TYP_krof "" UWORD B_TRUE 1 100 0 1 BIT_MASK 0xf00 FORMAT "%13.11" ECU_ADDRESS 0x3FDDB6 /end MEASUREMENT
/begin MEASUREMENT TYP_lde "" UWORD B_TRUE 1 100 0 1 BIT_MASK 0xf00 FORMAT "%13.11" ECU_ADDRESS 0x3FDDCC /end MEASUREMENT
/begin MEASUREMENT TYP_ldpe "" UWORD B_TRUE 1 100 0 1 BIT_MASK 0xf00 FORMAT "%13.11" ECU_ADDRESS 0x3FDDD0 /end MEASUREMENT
/begin MEASUREMENT TYP_lm "" UWORD B_TRUE 1 100 0 1 BIT_MASK 0xf00 FORMAT "%13.11" ECU_ADDRESS 0x3FDDD4 /end MEASUREMENT
/begin MEASUREMENT TYP_luea "" UWORD B_TRUE 1 100 0 1 BIT_MASK 0xf00 FORMAT "%13.11" ECU_ADDRESS 0x3FDDDC /end MEASUREMENT
/begin MEASUREMENT TYP_luve "" UWORD B_TRUE 1 100 0 1 BIT_MASK 0xf00 FORMAT "%13.11" ECU_ADDRESS 0x3FDDDE /end MEASUREMENT
/begin MEASUREMENT TYP_n "" UWORD B_TRUE 1 100 0 1 BIT_MASK 0xf00 FORMAT "%13.11" ECU_ADDRESS 0x3FDE02 /end MEASUREMENT
/begin MEASUREMENT TYP_stae "" UWORD B_TRUE 1 100 0 1 BIT_MASK 0xf00 FORMAT "%13.11" ECU_ADDRESS 0x3FDE20 /end MEASUREMENT
/begin MEASUREMENT TYP_swe "" UWORD B_TRUE 1 100 0 1 BIT_MASK 0xf00 FORMAT "%13.11" ECU_ADDRESS 0x3FDE24 /end MEASUREMENT
/begin MEASUREMENT Z_as "Zyklusflag: ASR-Eingriff" UWORD B_TRUE 1 100 0 1 BIT_MASK 0x2 FORMAT "%13.11" ECU_ADDRESS 0x3FDD20 /end MEASUREMENT
/begin MEASUREMENT Z_bkvpe "Zyklusflag: BKV-Pumpe-Endstufe" UWORD B_TRUE 1 100 0 1 BIT_MASK 0x2 FORMAT "%13.11" ECU_ADDRESS 0x3FDD24 /end MEASUREMENT
/begin MEASUREMENT Z_bm "Zyklusflag: Bezugsmarkengeber" UWORD B_TRUE 1 100 0 1 BIT_MASK 0x2 FORMAT "%13.11" ECU_ADDRESS 0x3FDD26 /end MEASUREMENT
/begin MEASUREMENT Z_cana "Zyklusflag: CAN-Schnittstelle ""CAN_A""" UWORD B_TRUE 1 100 0 1 BIT_MASK 0x2 FORMAT "%13.11" ECU_ADDRESS 0x3FDD2C /end MEASUREMENT
/begin MEASUREMENT Z_CAS "Zyklusflag: CAN-Schnittstelle, Timeout ASC" UWORD B_TRUE 1 100 0 1 BIT_MASK 0x2 FORMAT "%13.11" ECU_ADDRESS 0x3FDD2E /end MEASUREMENT
/begin MEASUREMENT Z_cez "Zyklusflag: CAN-Schnittstelle" UWORD B_TRUE 1 100 0 1 BIT_MASK 0x2 FORMAT "%13.11" ECU_ADDRESS 0x3FDD30 /end MEASUREMENT
/begin MEASUREMENT Z_CGE "Zyklusflag: CAN-Schnittstelle, Timeout EGS" UWORD B_TRUE 1 100 0 1 BIT_MASK 0x2 FORMAT "%13.11" ECU_ADDRESS 0x3FDD32 /end MEASUREMENT
/begin MEASUREMENT Z_CINS "Zyklusflag: CAN-Schnittstelle, Timeout Instrument" UWORD B_TRUE 1 100 0 1 BIT_MASK 0x2 FORMAT "%13.11" ECU_ADDRESS 0x3FDD34 /end MEASUREMENT
/begin MEASUREMENT Z_cod "Zyklusflag: Steuerger‰t noch nicht codiert" UWORD B_TRUE 1 100 0 1 BIT_MASK 0x2 FORMAT "%13.11" ECU_ADDRESS 0x3FDD36 /end MEASUREMENT
/begin MEASUREMENT Z_disa "Zyklus-Bit" UWORD B_TRUE 1 100 0 1 BIT_MASK 0x2 FORMAT "%13.11" ECU_ADDRESS 0x3FDD3E /end MEASUREMENT
/begin MEASUREMENT Z_dk "Zyklusflag:	DK - Potentiometer" UWORD B_TRUE 1 100 0 1 BIT_MASK 0x2 FORMAT "%13.11" ECU_ADDRESS 0x3FDD40 /end MEASUREMENT
/begin MEASUREMENT Z_dk1p "Zyklusflag: Drosselklappe 1. Poti" UWORD B_TRUE 1 100 0 1 BIT_MASK 0x2 FORMAT "%13.11" ECU_ADDRESS 0x3FDD42 /end MEASUREMENT
/begin MEASUREMENT Z_dk2p "Zyklusflag: Drosselklappe 2. Poti" UWORD B_TRUE 1 100 0 1 BIT_MASK 0x2 FORMAT "%13.11" ECU_ADDRESS 0x3FDD44 /end MEASUREMENT
/begin MEASUREMENT Z_dvee "Zyklusflag: DV-E Endstufe" UWORD B_TRUE 1 100 0 1 BIT_MASK 0x2 FORMAT "%13.11" ECU_ADDRESS 0x3FDD4E /end MEASUREMENT
/begin MEASUREMENT Z_dvef "Zyklusflag: DV-E Fehler bei Federpr¸fung" UWORD B_TRUE 1 100 0 1 BIT_MASK 0x2 FORMAT "%13.11" ECU_ADDRESS 0x3FDD50 /end MEASUREMENT
/begin MEASUREMENT Z_dvefo "Zyklusflag: DV-E-Fehler bei Federpr¸fung ""÷ffnen""" UWORD B_TRUE 1 100 0 1 BIT_MASK 0x2 FORMAT "%13.11" ECU_ADDRESS 0x3FDD52 /end MEASUREMENT
/begin MEASUREMENT Z_dvel "Zyklusflag: DV-E Lageabweichung" UWORD B_TRUE 1 100 0 1 BIT_MASK 0x2 FORMAT "%13.11" ECU_ADDRESS 0x3FDD54 /end MEASUREMENT
/begin MEASUREMENT Z_dven "Zyklusflag: DV-E Fehler bei Pr¸fung Notluftposition" UWORD B_TRUE 1 100 0 1 BIT_MASK 0x2 FORMAT "%13.11" ECU_ADDRESS 0x3FDD56 /end MEASUREMENT
/begin MEASUREMENT Z_dver "Zyklusflag: DV-E Regelbereich" UWORD B_TRUE 1 100 0 1 BIT_MASK 0x2 FORMAT "%13.11" ECU_ADDRESS 0x3FDD58 /end MEASUREMENT
/begin MEASUREMENT Z_dvet "Zyklusflag: DV-E-Tauscherkennung ohne Adaption" UWORD B_TRUE 1 100 0 1 BIT_MASK 0x2 FORMAT "%13.11" ECU_ADDRESS 0x3FDD5A /end MEASUREMENT
/begin MEASUREMENT Z_dveu "Zyklusflag: DV-E Fehler beim UMA-Lernen" UWORD B_TRUE 1 100 0 1 BIT_MASK 0x2 FORMAT "%13.11" ECU_ADDRESS 0x3FDD5C /end MEASUREMENT
/begin MEASUREMENT Z_dveub "Zyklusflag: DV-E-Adaption Abbruch wg. Umweltbedingung" UWORD B_TRUE 1 100 0 1 BIT_MASK 0x2 FORMAT "%13.11" ECU_ADDRESS 0x3FDD5E /end MEASUREMENT
/begin MEASUREMENT Z_dveuw "Zyklusflag: Fehler bei UMA-Wiederlernen" UWORD B_TRUE 1 100 0 1 BIT_MASK 0x2 FORMAT "%13.11" ECU_ADDRESS 0x3FDD60 /end MEASUREMENT
/begin MEASUREMENT Z_dvev "Zyklusflag: DV-E Fehler bei Verst‰rkerabgleich" UWORD B_TRUE 1 100 0 1 BIT_MASK 0x2 FORMAT "%13.11" ECU_ADDRESS 0x3FDD62 /end MEASUREMENT
/begin MEASUREMENT Z_els "Zyklusflag: Endstufe E-Box L¸fter" UWORD B_TRUE 1 100 0 1 BIT_MASK 0x2 FORMAT "%13.11" ECU_ADDRESS 0x3FDD78 /end MEASUREMENT
/begin MEASUREMENT Z_ets "Zyklusflag: elektronisches Thermostat" UWORD B_TRUE 1 100 0 1 BIT_MASK 0x2 FORMAT "%13.11" ECU_ADDRESS 0x3FDD7E /end MEASUREMENT
/begin MEASUREMENT Z_ev1 "Zyklusflag: EV von Zyl. 1" UWORD B_TRUE 1 100 0 1 BIT_MASK 0x2 FORMAT "%13.11" ECU_ADDRESS 0x3FDD80 /end MEASUREMENT
/begin MEASUREMENT Z_ev2 "Zyklusflag:	EV von Zyl. 2" UWORD B_TRUE 1 100 0 1 BIT_MASK 0x2 FORMAT "%13.11" ECU_ADDRESS 0x3FDD82 /end MEASUREMENT
/begin MEASUREMENT Z_ev3 "Zyklusflag:	EV von Zyl. 3" UWORD B_TRUE 1 100 0 1 BIT_MASK 0x2 FORMAT "%13.11" ECU_ADDRESS 0x3FDD84 /end MEASUREMENT
/begin MEASUREMENT Z_ev4 "Zyklusflag:	EV von Zyl. 4" UWORD B_TRUE 1 100 0 1 BIT_MASK 0x2 FORMAT "%13.11" ECU_ADDRESS 0x3FDD86 /end MEASUREMENT
/begin MEASUREMENT Z_ezh "" UWORD B_TRUE 1 100 0 1 BIT_MASK 0x2 FORMAT "%13.11" ECU_ADDRESS 0x3FDD90 /end MEASUREMENT
/begin MEASUREMENT Z_hsh "Zyklusflag:Lambdasonden-Heizung hinter Katalysator" UWORD B_TRUE 1 100 0 1 BIT_MASK 0x2 FORMAT "%13.11" ECU_ADDRESS 0x3FDDA0 /end MEASUREMENT
/begin MEASUREMENT Z_hsh2 "Zyklusflag:Lambdasonden-Heizung hinter Katalysator, Bank2" UWORD B_TRUE 1 100 0 1 BIT_MASK 0x2 FORMAT "%13.11" ECU_ADDRESS 0x3FDDA2 /end MEASUREMENT
/begin MEASUREMENT Z_hsv "Zyklusflag:Lambdasonden-Heizung vor Katalysator" UWORD B_TRUE 1 100 0 1 BIT_MASK 0x2 FORMAT "%13.11" ECU_ADDRESS 0x3FDDA4 /end MEASUREMENT
/begin MEASUREMENT Z_hsv2 "Zyklusflag:Lambdasonden-Heizung vor Katalysator, Bank2" UWORD B_TRUE 1 100 0 1 BIT_MASK 0x2 FORMAT "%13.11" ECU_ADDRESS 0x3FDDA6 /end MEASUREMENT
/begin MEASUREMENT Z_kat "Zyklusflag:	Katalysator-Konvertierung" UWORD B_TRUE 1 100 0 1 BIT_MASK 0x2 FORMAT "%13.11" ECU_ADDRESS 0x3FDDAA /end MEASUREMENT
/begin MEASUREMENT Z_kkue "Zyklusflag: Kraftstoffkreislauf-Umschaltung Endstufe" UWORD B_TRUE 1 100 0 1 BIT_MASK 0x2 FORMAT "%13.11" ECU_ADDRESS 0x3FDDAE /end MEASUREMENT
/begin MEASUREMENT Z_kose "Zyklusflag:Klimakompressorsteuerung, Endstufe" UWORD B_TRUE 1 100 0 1 BIT_MASK 0x2 FORMAT "%13.11" ECU_ADDRESS 0x3FDDB0 /end MEASUREMENT
/begin MEASUREMENT Z_kpe "Zyklusflag: EKP-Relais Endstufe" UWORD B_TRUE 1 100 0 1 BIT_MASK 0x2 FORMAT "%13.11" ECU_ADDRESS 0x3FDDB2 /end MEASUREMENT
/begin MEASUREMENT Z_krnt "Zyklusflag: Klopfregelung Nulltest" UWORD B_TRUE 1 100 0 1 BIT_MASK 0x2 FORMAT "%13.11" ECU_ADDRESS 0x3FDDB4 /end MEASUREMENT
/begin MEASUREMENT Z_krof "Zyklusflag: Klopfregelung Offset" UWORD B_TRUE 1 100 0 1 BIT_MASK 0x2 FORMAT "%13.11" ECU_ADDRESS 0x3FDDB6 /end MEASUREMENT
/begin MEASUREMENT Z_lde "Zyklusflag: Ladedrucksteuerventil (Endstufe)" UWORD B_TRUE 1 100 0 1 BIT_MASK 0x2 FORMAT "%13.11" ECU_ADDRESS 0x3FDDCC /end MEASUREMENT
/begin MEASUREMENT Z_ldpe "Zyklusflag: Leckdiagnosepumpe Endstufe" UWORD B_TRUE 1 100 0 1 BIT_MASK 0x2 FORMAT "%13.11" ECU_ADDRESS 0x3FDDD0 /end MEASUREMENT
/begin MEASUREMENT Z_lm "Zyklusflag:	LMM/HLM/HFM" UWORD B_TRUE 1 100 0 1 BIT_MASK 0x2 FORMAT "%13.11" ECU_ADDRESS 0x3FDDD4 /end MEASUREMENT
/begin MEASUREMENT Z_luea "Zyklusflag: L¸fterendstufe A" UWORD B_TRUE 1 100 0 1 BIT_MASK 0x2 FORMAT "%13.11" ECU_ADDRESS 0x3FDDDC /end MEASUREMENT
/begin MEASUREMENT Z_luve "Zyklusflag: EV-Luftumfassungsventil Endstufe" UWORD B_TRUE 1 100 0 1 BIT_MASK 0x2 FORMAT "%13.11" ECU_ADDRESS 0x3FDDDE /end MEASUREMENT
/begin MEASUREMENT Z_n "Zyklusflag: Drehzahlsignalgeber" UWORD B_TRUE 1 100 0 1 BIT_MASK 0x2 FORMAT "%13.11" ECU_ADDRESS 0x3FDE02 /end MEASUREMENT
/begin MEASUREMENT Z_stae "Zyklusflag: Startautomatik (Endstufe)" UWORD B_TRUE 1 100 0 1 BIT_MASK 0x2 FORMAT "%13.11" ECU_ADDRESS 0x3FDE20 /end MEASUREMENT
/begin MEASUREMENT Z_swe "Zyklusflag: Beschleunigungssensor der Schlechtwegeerkennung" UWORD B_TRUE 1 100 0 1 BIT_MASK 0x2 FORMAT "%13.11" ECU_ADDRESS 0x3FDE24 /end MEASUREMENT
/begin FUNCTION DFPM "OBDII; Fehlerpfadmanager"
 /begin IN_MEASUREMENT bbwuc B_pwf egaspfad mi_duf mpfad nmot rstpfad skapfad tans tmot tmotlin top_w ushk usvk vfzg /end IN_MEASUREMENT
 /begin OUT_MEASUREMENT bbno bbsp3 bbtim B_no B_sp3 B_tim dfcmFcm dfcmNo dfcmSfp dfpmEpclState dfpmMilState dfp_ap fcmcla_0_A fcmcla_1_A fcmcla_2_A fcmcla_3_A fcmcla_4_A fcmcla_5_A fcmcla_6_A fcmcla_7_A fcmcla_8_A fcmcla_9_A fcmdfp_0_A fcmdfp_1_A fcmdfp_2_A fcmdfp_3_A fcmdfp_4_A fcmdfp_5_A fcmdfp_6_A fcmdfp_7_A fcmdfp_8_A fcmdfp_9_A fcmdlc_0_A fcmdlc_1_A fcmdlc_2_A fcmdlc_3_A fcmdlc_4_A fcmdlc_5_A fcmdlc_6_A fcmdlc_7_A fcmdlc_8_A fcmdlc_9_A fcmEnd fcmfes_0_A fcmfes_1_A fcmfes_2_A fcmfes_3_A fcmfes_4_A fcmfes_5_A fcmfes_6_A fcmfes_7_A fcmfes_8_A fcmfes_9_A fcmflc_0_A fcmflc_1_A fcmflc_2_A fcmflc_3_A fcmflc_4_A fcmflc_5_A fcmflc_6_A fcmflc_7_A fcmflc_8_A fcmflc_9_A fcmfps_0_A fcmfps_1_A fcmfps_2_A fcmfps_3_A fcmfps_4_A fcmfps_5_A fcmfps_6_A fcmfps_7_A fcmfps_8_A fcmfps_9_A fcmfrz0_0_A fcmfrz0_1_A fcmfrz0_2_A fcmfrz0_3_A fcmfrz0_4_A fcmfrz0_5_A fcmfrz0_6_A fcmfrz0_7_A fcmfrz0_8_A fcmfrz0_9_A fcmfrz1_0_A fcmfrz1_1_A fcmfrz1_2_A fcmfrz1_3_A fcmfrz1_4_A fcmfrz1_5_A fcmfrz1_6_A fcmfrz1_7_A fcmfrz1_8_A fcmfrz1_9_A fcmfrz10_0_A fcmfrz10_1_A fcmfrz10_2_A fcmfrz10_3_A fcmfrz10_4_A fcmfrz10_5_A fcmfrz10_6_A fcmfrz10_7_A fcmfrz10_8_A fcmfrz10_9_A fcmfrz2_0_A fcmfrz2_1_A fcmfrz2_2_A fcmfrz2_3_A fcmfrz2_4_A fcmfrz2_5_A fcmfrz2_6_A fcmfrz2_7_A fcmfrz2_8_A fcmfrz2_9_A fcmfrz3_0_A fcmfrz3_1_A fcmfrz3_2_A fcmfrz3_3_A fcmfrz3_4_A fcmfrz3_5_A fcmfrz3_6_A fcmfrz3_7_A fcmfrz3_8_A fcmfrz3_9_A fcmfrz4_0_A fcmfrz4_1_A fcmfrz4_2_A fcmfrz4_3_A fcmfrz4_4_A fcmfrz4_5_A fcmfrz4_6_A fcmfrz4_7_A fcmfrz4_8_A fcmfrz4_9_A fcmfrz5_0_A fcmfrz5_1_A fcmfrz5_2_A fcmfrz5_3_A fcmfrz5_4_A fcmfrz5_5_A fcmfrz5_6_A fcmfrz5_7_A fcmfrz5_8_A fcmfrz5_9_A fcmfrz6_0_A fcmfrz6_1_A fcmfrz6_2_A fcmfrz6_3_A fcmfrz6_4_A fcmfrz6_5_A fcmfrz6_6_A fcmfrz6_7_A fcmfrz6_8_A fcmfrz6_9_A fcmfrz7_0_A fcmfrz7_1_A fcmfrz7_2_A fcmfrz7_3_A fcmfrz7_4_A fcmfrz7_5_A fcmfrz7_6_A fcmfrz7_7_A fcmfrz7_8_A fcmfrz7_9_A fcmfrz8_0_A fcmfrz8_1_A fcmfrz8_2_A fcmfrz8_3_A fcmfrz8_4_A fcmfrz8_5_A fcmfrz8_6_A fcmfrz8_7_A fcmfrz8_8_A fcmfrz8_9_A fcmfrz9_0_A fcmfrz9_1_A fcmfrz9_2_A fcmfrz9_3_A fcmfrz9_4_A fcmfrz9_5_A fcmfrz9_6_A fcmfrz9_7_A fcmfrz9_8_A fcmfrz9_9_A fcmhlc_0_A fcmhlc_1_A fcmhlc_2_A fcmhlc_3_A fcmhlc_4_A fcmhlc_5_A fcmhlc_6_A fcmhlc_7_A fcmhlc_8_A fcmhlc_9_A fcmhz_0_A fcmhz_1_A fcmhz_2_A fcmhz_3_A fcmhz_4_A fcmhz_5_A fcmhz_6_A fcmhz_7_A fcmhz_8_A fcmhz_9_A FCMTab fcmtsf_0_A fcmtsf_1_A fcmtsf_2_A fcmtsf_3_A fcmtsf_4_A fcmtsf_5_A fcmtsf_6_A fcmtsf_7_A fcmtsf_8_A fcmtsf_9_A fcmtyp_0_A fcmtyp_1_A fcmtyp_2_A fcmtyp_3_A fcmtyp_4_A fcmtyp_5_A fcmtyp_6_A fcmtyp_7_A fcmtyp_8_A fcmtyp_9_A /end OUT_MEASUREMENT
/end FUNCTION
/begin FUNCTION DFPMHIS "Diagnose Fehlerpfadmanagement; History-Speicher" /begin IN_MEASUREMENT B_eemrdy B_eepwf fcmEnd FCMTab /end IN_MEASUREMENT /begin OUT_MEASUREMENT fcmHis /end OUT_MEASUREMENT /end FUNCTION
/begin FUNCTION DFPMOVF "Diagnose Fehlerpfadmanagement, Memory Overflow" /begin IN_MEASUREMENT fcmEnd /end IN_MEASUREMENT /end FUNCTION
/begin FUNCTION DFPM_BGRBS "" /begin DEF_CHARACTERISTIC CDCSWE CDKSWE CDTSWE CLASWE FFTSWE TSFSWE /end DEF_CHARACTERISTIC
 /begin OUT_MEASUREMENT B_beswe B_bkswe B_clswe B_ftswe B_mnswe B_mxswe B_npswe B_siswe E_swe sfpswe TYP_swe Z_swe /end OUT_MEASUREMENT
/end FUNCTION
/begin FUNCTION DFPM_CANEZH "" /begin DEF_CHARACTERISTIC CDCEZH CDKEZH CDTEZH CLAEZH FFTEZH TSFEZH /end DEF_CHARACTERISTIC
 /begin OUT_MEASUREMENT B_beezh B_bkezh B_clezh B_ftezh B_mnezh B_mxezh B_npezh B_siezh E_ezh sfpezh TYP_ezh Z_ezh /end OUT_MEASUREMENT
/end FUNCTION
/begin FUNCTION DFPM_DASC "" /begin DEF_CHARACTERISTIC CDCAS CDKAS CDTAS CLAAS FFTAS TSFAS /end DEF_CHARACTERISTIC
 /begin OUT_MEASUREMENT B_beas B_bkas B_clas B_ftas B_mnas B_mxas B_npas B_sias E_as sfpas TYP_as Z_as /end OUT_MEASUREMENT
/end FUNCTION
/begin FUNCTION DFPM_DBKVPE "" /begin DEF_CHARACTERISTIC CDCBKVPE CDKBKVPE CDTBKVPE CLABKVPE FFTBKVPE TSFBKVPE /end DEF_CHARACTERISTIC
 /begin OUT_MEASUREMENT B_bebkvpe B_bkbkvpe B_clbkvpe B_ftbkvpe B_mnbkvpe B_mxbkvpe B_npbkvpe B_sibkvpe E_bkvpe sfpbkvpe TYP_bkvpe Z_bkvpe /end OUT_MEASUREMENT
/end FUNCTION
/begin FUNCTION DFPM_DCANA "" /begin DEF_CHARACTERISTIC CDCCANA CDKCANA CDTCANA CLACANA FFTCANA TSFCANA /end DEF_CHARACTERISTIC
 /begin OUT_MEASUREMENT B_becana B_bkcana B_clcana B_ftcana B_mncana B_mxcana B_npcana B_sicana E_cana sfpcana TYP_cana Z_cana /end OUT_MEASUREMENT
/end FUNCTION
/begin FUNCTION DFPM_DCAS "" /begin DEF_CHARACTERISTIC CDCCAS CDKCAS CDTCAS CLACAS FFTCAS TSFCAS /end DEF_CHARACTERISTIC
 /begin OUT_MEASUREMENT B_becas B_bkcas B_clcas B_ftcas B_mncas B_mxcas B_npcas B_sicas E_CAS sfpcas TYP_cas Z_CAS /end OUT_MEASUREMENT
/end FUNCTION
/begin FUNCTION DFPM_DCEZ "" /begin DEF_CHARACTERISTIC CDCCEZ CDKCEZ CDTCEZ CLACEZ FFTCEZ TSFCEZ /end DEF_CHARACTERISTIC
 /begin OUT_MEASUREMENT B_becez B_bkcez B_clcez B_ftcez B_mncez B_mxcez B_npcez B_sicez E_cez sfpcez TYP_cez Z_cez /end OUT_MEASUREMENT
/end FUNCTION
/begin FUNCTION DFPM_DCGE "" /begin DEF_CHARACTERISTIC CDCCGE CDKCGE CDTCGE CLACGE FFTCGE TSFCGE /end DEF_CHARACTERISTIC
 /begin OUT_MEASUREMENT B_becge B_bkcge B_clcge B_ftcge B_mncge B_mxcge B_npcge B_sicge E_CGE sfpcge TYP_cge Z_CGE /end OUT_MEASUREMENT
/end FUNCTION
/begin FUNCTION DFPM_DCINS "" /begin DEF_CHARACTERISTIC CDCCINS CDKCINS CDTCINS CLACINS FFTCINS TSFCINS /end DEF_CHARACTERISTIC
 /begin OUT_MEASUREMENT B_becins B_bkcins B_clcins B_ftcins B_mncins B_mxcins B_npcins B_sicins E_CINS sfpcins TYP_cins Z_CINS /end OUT_MEASUREMENT
/end FUNCTION
/begin FUNCTION DFPM_DCOD "" /begin DEF_CHARACTERISTIC CDCCOD CDKCOD CDTCOD CLACOD FFTCOD TSFCOD /end DEF_CHARACTERISTIC
 /begin OUT_MEASUREMENT B_becod B_bkcod B_clcod B_ftcod B_mncod B_mxcod B_npcod B_sicod E_cod sfpcod TYP_cod Z_cod /end OUT_MEASUREMENT
/end FUNCTION
/begin FUNCTION DFPM_DDG ""
 /begin DEF_CHARACTERISTIC CDCBM CDCN CDKBM CDKN CDTBM CDTN CLABM CLAN FFTBM FFTN TSFBM TSFN /end DEF_CHARACTERISTIC
 /begin OUT_MEASUREMENT B_bebm B_ben B_bkbm B_bkn B_clbm B_cln B_ftbm B_ftn B_mnbm B_mnn B_mxbm B_mxn B_npbm B_npn B_sibm B_sin E_bm E_n sfpbm sfpn TYP_bm TYP_n Z_bm Z_n /end OUT_MEASUREMENT
/end FUNCTION
/begin FUNCTION DFPM_DDVE ""
 /begin DEF_CHARACTERISTIC CDCDK CDCDK1P CDCDK2P CDCDVEE CDCDVEF CDCDVEFO CDCDVEL CDCDVEN CDCDVER CDCDVET CDCDVEU CDCDVEUB CDCDVEUW CDCDVEV CDKDK CDKDK1P CDKDK2P CDKDVEE CDKDVEF CDKDVEFO CDKDVEL CDKDVEN CDKDVER CDKDVET CDKDVEU CDKDVEUB CDKDVEUW CDKDVEV CDTDK CDTDK1P CDTDK2P CDTDVEE CDTDVEF CDTDVEFO CDTDVEL CDTDVEN CDTDVER CDTDVET CDTDVEU CDTDVEUB CDTDVEUW CDTDVEV CLADK CLADK1P CLADK2P CLADVEE CLADVEF CLADVEFO CLADVEL CLADVEN CLADVER CLADVET CLADVEU CLADVEUB CLADVEUW CLADVEV FFTDK FFTDK1P FFTDK2P FFTDVEE FFTDVEF FFTDVEFO FFTDVEL FFTDVEN FFTDVER FFTDVET FFTDVEU FFTDVEUB FFTDVEUW FFTDVEV TSFDK TSFDK1P TSFDK2P TSFDVEE TSFDVEF TSFDVEFO TSFDVEL TSFDVEN TSFDVER TSFDVET TSFDVEU TSFDVEUB TSFDVEUW TSFDVEV /end DEF_CHARACTERISTIC
 /begin OUT_MEASUREMENT B_bedk B_bedk1p B_bedk2p B_bedvee B_bedvef B_bedvefo B_bedvel B_bedven B_bedver B_bedvet B_bedveu B_bedveub B_bedveuw B_bedvev B_bkdk B_bkdk1p B_bkdk2p B_bkdvee B_bkdvef B_bkdvefo B_bkdvel B_bkdven B_bkdver B_bkdvet B_bkdveu B_bkdveub B_bkdveuw B_bkdvev B_cldk B_cldk1p B_cldk2p B_cldvee B_cldvef B_cldvefo B_cldvel B_cldven B_cldver B_cldvet B_cldveu B_cldveub B_cldveuw B_cldvev B_ftdk B_ftdk1p B_ftdk2p B_ftdvee B_ftdvef B_ftdvefo B_ftdvel B_ftdven B_ftdver B_ftdvet B_ftdveu B_ftdveub B_ftdveuw B_ftdvev B_mndk B_mndk1p B_mndk2p B_mndvee B_mndvef B_mndvefo B_mndvel B_mndven B_mndver B_mndvet B_mndveu B_mndveub B_mndveuw B_mndvev B_mxdk B_mxdk1p B_mxdk2p B_mxdvee B_mxdvef B_mxdvefo B_mxdvel B_mxdven B_mxdver B_mxdvet B_mxdveu B_mxdveub B_mxdveuw B_mxdvev B_npdk B_npdk1p B_npdk2p B_npdvee B_npdvef B_npdvefo B_npdvel B_npdven B_npdver B_npdvet B_npdveu B_npdveub B_npdveuw B_npdvev B_sidk B_sidk1p B_sidk2p B_sidvee B_sidvef B_sidvefo B_sidvel B_sidven B_sidver B_sidvet B_sidveu B_sidveub B_sidveuw B_sidvev E_dk E_dk1p E_dk2p E_dvee E_dvef E_dvefo E_dvel E_dven E_dver E_dvet E_dveu E_dveub E_dveuw E_dvev sfpdk sfpdk1p sfpdk2p sfpdvee sfpdvef sfpdvefo sfpdvel sfpdven sfpdver sfpdvet sfpdveu sfpdveub sfpdveuw sfpdvev TYP_dk TYP_dk1p TYP_dk2p TYP_dvee TYP_dvef TYP_dvefo TYP_dvel TYP_dven TYP_dver TYP_dvet TYP_dveu TYP_dveub TYP_dveuw TYP_dvev Z_dk Z_dk1p Z_dk2p Z_dvee Z_dvef Z_dvefo Z_dvel Z_dven Z_dver Z_dvet Z_dveu Z_dveub Z_dveuw Z_dvev /end OUT_MEASUREMENT
/end FUNCTION
/begin FUNCTION DFPM_DEKON ""
 /begin DEF_CHARACTERISTIC CDCKKUE CDCLDE CDCLDPE CDCLUEA CDCLUVE CDCSTAE CDKKKUE CDKLDE CDKLDPE CDKLUEA CDKLUVE CDKSTAE CDTKKUE CDTLDE CDTLDPE CDTLUEA CDTLUVE CDTSTAE CLAKKUE CLALDE CLALDPE CLALUEA CLALUVE CLASTAE FFTKKUE FFTLDE FFTLDPE FFTLUEA FFTLUVE FFTSTAE TSFKKUE TSFLDE TSFLDPE TSFLUEA TSFLUVE TSFSTAE /end DEF_CHARACTERISTIC
 /begin OUT_MEASUREMENT B_bekkue B_belde B_beldpe B_beluea B_beluve B_bestae B_bkkkue B_bklde B_bkldpe B_bkluea B_bkluve B_bkstae B_clkkue B_cllde B_clldpe B_clluea B_clluve B_clstae B_ftkkue B_ftlde B_ftldpe B_ftluea B_ftluve B_ftstae B_mnkkue B_mnlde B_mnldpe B_mnluea B_mnluve B_mnstae B_mxkkue B_mxlde B_mxldpe B_mxluea B_mxluve B_mxstae B_npkkue B_nplde B_npldpe B_npluea B_npluve B_npstae B_sikkue B_silde B_sildpe B_siluea B_siluve B_sistae E_kkue E_lde E_ldpe E_luea E_luve E_stae sfpkkue sfplde sfpldpe sfpluea sfpluve sfpstae TYP_kkue TYP_lde TYP_ldpe TYP_luea TYP_luve TYP_stae Z_kkue Z_lde Z_ldpe Z_luea Z_luve Z_stae /end OUT_MEASUREMENT
/end FUNCTION
/begin FUNCTION DFPM_DEKPE "" /begin DEF_CHARACTERISTIC CDCKPE CDKKPE CDTKPE CLAKPE FFTKPE TSFKPE /end DEF_CHARACTERISTIC
 /begin OUT_MEASUREMENT B_bekpe B_bkkpe B_clkpe B_ftkpe B_mnkpe B_mxkpe B_npkpe B_sikpe E_kpe sfpkpe TYP_kpe Z_kpe /end OUT_MEASUREMENT
/end FUNCTION
/begin FUNCTION DFPM_DELSE "" /begin DEF_CHARACTERISTIC CDCELS CDKELS CDTELS CLAELS FFTELS TSFELS /end DEF_CHARACTERISTIC
 /begin OUT_MEASUREMENT B_beels B_bkels B_clels B_ftels B_mnels B_mxels B_npels B_siels E_els sfpels TYP_els Z_els /end OUT_MEASUREMENT
/end FUNCTION
/begin FUNCTION DFPM_DETS "" /begin DEF_CHARACTERISTIC CDCETS CDKETS CDTETS CLAETS FFTETS TSFETS /end DEF_CHARACTERISTIC
 /begin OUT_MEASUREMENT B_beets B_bkets B_clets B_ftets B_mnets B_mxets B_npets B_siets E_ets sfpets TYP_ets Z_ets /end OUT_MEASUREMENT
/end FUNCTION
/begin FUNCTION DFPM_DEVE ""
 /begin DEF_CHARACTERISTIC CDCEV1 CDCEV2 CDCEV3 CDCEV4 CDKEV1 CDKEV2 CDKEV3 CDKEV4 CDTEV1 CDTEV2 CDTEV3 CDTEV4 CLAEV1 CLAEV2 CLAEV3 CLAEV4 FFTEV1 FFTEV2 FFTEV3 FFTEV4 TSFEV1 TSFEV2 TSFEV3 TSFEV4 /end DEF_CHARACTERISTIC
 /begin OUT_MEASUREMENT B_beev1 B_beev2 B_beev3 B_beev4 B_bkev1 B_bkev2 B_bkev3 B_bkev4 B_clev1 B_clev2 B_clev3 B_clev4 B_ftev1 B_ftev2 B_ftev3 B_ftev4 B_mnev1 B_mnev2 B_mnev3 B_mnev4 B_mxev1 B_mxev2 B_mxev3 B_mxev4 B_npev1 B_npev2 B_npev3 B_npev4 B_siev1 B_siev2 B_siev3 B_siev4 E_ev1 E_ev2 E_ev3 E_ev4 sfpev1 sfpev2 sfpev3 sfpev4 TYP_ev1 TYP_ev2 TYP_ev3 TYP_ev4 Z_ev1 Z_ev2 Z_ev3 Z_ev4 /end OUT_MEASUREMENT
/end FUNCTION
/begin FUNCTION DFPM_DFPM ""
 /begin DEF_CHARACTERISTIC CDCAAA CDCZZZ CDKAAA CDKZZZ CDTAAA CDTZZZ CLAAAA CLAZZZ FFTAAA FFTZZZ TSFAAA TSFZZZ /end DEF_CHARACTERISTIC
 /begin OUT_MEASUREMENT sfpaaa sfpzzz /end OUT_MEASUREMENT
/end FUNCTION
/begin FUNCTION DFPM_DHFM "" /begin DEF_CHARACTERISTIC CDCLM CDKLM CDTLM CLALM FFTLM TSFLM /end DEF_CHARACTERISTIC
 /begin OUT_MEASUREMENT B_belm B_bklm B_cllm B_ftlm B_mnlm B_mxlm B_nplm B_silm E_lm sfplm TYP_lm Z_lm /end OUT_MEASUREMENT
/end FUNCTION
/begin FUNCTION DFPM_DHLS ""
 /begin DEF_CHARACTERISTIC CDCHSH CDCHSH2 CDCHSV CDCHSV2 CDKHSH CDKHSH2 CDKHSV CDKHSV2 CDTHSH CDTHSH2 CDTHSV CDTHSV2 CLAHSH CLAHSH2 CLAHSV CLAHSV2 FFTHSH FFTHSH2 FFTHSV FFTHSV2 TSFHSH TSFHSH2 TSFHSV TSFHSV2 /end DEF_CHARACTERISTIC
 /begin OUT_MEASUREMENT B_behsh B_behsh2 B_behsv B_behsv2 B_bkhsh B_bkhsh2 B_bkhsv B_bkhsv2 B_clhsh B_clhsh2 B_clhsv B_clhsv2 B_fahsh B_fahsh2 B_fahsv B_fahsv2 B_mnhsh B_mnhsh2 B_mnhsv B_mnhsv2 B_mxhsh B_mxhsh2 B_mxhsv B_mxhsv2 B_nphsh B_nphsh2 B_nphsv B_nphsv2 B_sihsh B_sihsh2 B_sihsv B_sihsv2 E_hsh E_hsh2 E_hsv E_hsv2 sfphsh sfphsh2 sfphsv sfphsv2 TYP_hsh TYP_hsh2 TYP_hsv TYP_hsv2 Z_hsh Z_hsh2 Z_hsv Z_hsv2 /end OUT_MEASUREMENT
/end FUNCTION
/begin FUNCTION DFPM_DISA "" /begin DEF_CHARACTERISTIC CDCDISA CDKDISA CDTDISA CLADISA FFTDISA TSFDISA /end DEF_CHARACTERISTIC
 /begin OUT_MEASUREMENT B_bedisa B_bkdisa B_cldisa B_ftdisa B_mndisa B_mxdisa B_npdisa B_sidisa E_disa sfpdisa TYP_disa Z_disa /end OUT_MEASUREMENT
/end FUNCTION
/begin FUNCTION DFPM_DKAT "" /begin DEF_CHARACTERISTIC CDCKAT CDKKAT CDTKAT CLAKAT FFTKAT TSFKAT /end DEF_CHARACTERISTIC
 /begin OUT_MEASUREMENT B_bekat B_bkkat B_clkat B_ftkat B_mnkat B_mxkat B_npkat B_sikat E_kat sfpkat TYP_kat Z_kat /end OUT_MEASUREMENT
/end FUNCTION
/begin FUNCTION DFPM_DKOSE "" /begin DEF_CHARACTERISTIC CDCKOSE CDKKOSE CDTKOSE CLAKOSE FFTKOSE TSFKOSE /end DEF_CHARACTERISTIC
 /begin OUT_MEASUREMENT B_bekose B_bkkose B_clkose B_ftkose B_mnkose B_mxkose B_npkose B_sikose E_kose sfpkose TYP_kose Z_kose /end OUT_MEASUREMENT
/end FUNCTION
/begin FUNCTION DFPM_DKRNT ""
 /begin DEF_CHARACTERISTIC CDCKRNT CDCKROF CDKKRNT CDKKROF CDTKRNT CDTKROF CLAKRNT CLAKROF FFTKRNT FFTKROF TSFKRNT TSFKROF /end DEF_CHARACTERISTIC
 /begin OUT_MEASUREMENT B_bekrnt B_bekrof B_bkkrnt B_bkkrof B_clkrnt B_clkrof B_ftkrnt B_ftkrof B_mnkrnt B_mnkrof B_mxkrnt B_mxkrof B_npkrnt B_npkrof B_sikrnt B_sikrof E_krnt E_krof sfpkrnt sfpkrof TYP_krnt TYP_krof Z_krnt Z_krof /end OUT_MEASUREMENT
/end FUNCTION
/begin COMPU_METHOD B_TRUE "boolsche Zust‰nde, positive Logik" TAB_VERB "%6.3" "" COMPU_TAB_REF B_TRUE /end COMPU_METHOD
/begin COMPU_VTAB B_TRUE "boolsche Zust‰nde, positive Logik" TAB_VERB 2 0 "----" 1 "TRUE" /end COMPU_VTAB
/begin COMPU_METHOD dez "1 : 1 Umrechnug (dez/hex)" RAT_FUNC "%6.2" "" COEFFS 0 1 0 0 0 1 /end COMPU_METHOD
/begin COMPU_METHOD default "" RAT_FUNC "%6.2" "" COEFFS 0 1 0 0 0 1 /end COMPU_METHOD
/begin RECORD_LAYOUT KwbUb FNC_VALUES 1 UBYTE COLUMN_DIR DIRECT /end RECORD_LAYOUT
/begin RECORD_LAYOUT KwbUw FNC_VALUES 1 UWORD COLUMN_DIR DIRECT /end RECORD_LAYOUT
/begin RECORD_LAYOUT KwbWU16 FNC_VALUES 1 UWORD COLUMN_DIR DIRECT /end RECORD_LAYOUT
/begin RECORD_LAYOUT KwbWU8 FNC_VALUES 1 UBYTE COLUMN_DIR DIRECT /end RECORD_LAYOUT
/begin RECORD_LAYOUT KwUb FNC_VALUES 1 UBYTE COLUMN_DIR DIRECT /end RECORD_LAYOUT
/begin RECORD_LAYOUT KwUw FNC_VALUES 1 UWORD COLUMN_DIR DIRECT /end RECORD_LAYOUT
/begin RECORD_LAYOUT KwWU16 FNC_VALUES 1 UWORD COLUMN_DIR DIRECT /end RECORD_LAYOUT
/begin RECORD_LAYOUT KwWU8 FNC_VALUES 1 UBYTE COLUMN_DIR DIRECT /end RECORD_LAYOUT
/end MODULE
/end PROJECT
