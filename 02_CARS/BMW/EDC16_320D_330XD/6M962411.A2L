ASAP2_VERSION 1 3
/begin PROJECT P411 "BMW DDE6.0 6-Zylinder V96.2 14.10.2004"
/begin HEADER "" VERSION "V96.2_6Z" PROJECT_NO P411 /end HEADER
/begin MODULE DIM ""
/begin MOD_COMMON "" BYTE_ORDER MSB_FIRST ALIGNMENT_BYTE 1 ALIGNMENT_WORD 2 ALIGNMENT_LONG 4 ALIGNMENT_FLOAT32_IEEE 4 /end MOD_COMMON
/begin CHARACTERISTIC PFlt_cpExhGs_C "Spezifische Wärmekapazität des Abgases" VALUE 0xF1F30 Kw_Wu16 2000.000 Thr_Cpty_ExhGs 0.00 2000.000 FORMAT "%8.3" EXTENDED_LIMITS 0.00 655350.0 /end CHARACTERISTIC
/begin CHARACTERISTIC PFlt_CPFlt_C "Wärmekapazität des Partikelfilters" VALUE 0xF1F32 Kw_Wu16 32900.00 Thr_Cpty 100.0000 33000.00 FORMAT "%8.2" EXTENDED_LIMITS 0.00 65535.00 /end CHARACTERISTIC
/begin CHARACTERISTIC PFlt_ctEngPrtRgn_C "Schwelle für Maschinenschutz-Regenerationszählimpuls" VALUE 0xF1780 Kw_Wu16 65535.00 OneToOne 0.00 65535.00 FORMAT "%8.2" /end CHARACTERISTIC
/begin CHARACTERISTIC PFlt_ddvolHsLnPlausNeg_C "Negativer Schwellwert Volumenstromänderung zur Dynamikplausibilisierung" VALUE 0xF16E4 Kw_Ws16 1500.000 CubMtrPerHrPerSec -1500.000 0.00 FORMAT "%8.3" EXTENDED_LIMITS -3276.800 3276.700 /end CHARACTERISTIC
/begin CHARACTERISTIC PFlt_ddvolHsLnPlausPos_C "Positiver Schwellwert Volumenstromänderung zur Dynamikplausibilisierung" VALUE 0xF16E6 Kw_Ws16 1500.000 CubMtrPerHrPerSec 0.00 1500.000 FORMAT "%8.3" EXTENDED_LIMITS -3276.800 3276.700 /end CHARACTERISTIC
/begin CHARACTERISTIC PFlt_ddvolHsLnSot_C "Schwellwert Volumenstromänderung zur Schlauchleitungsüberwachung" VALUE 0xF16E8 Kw_Ws16 3000.000 CubMtrPerHrPerSec -1500.000 1500.000 FORMAT "%8.3" EXTENDED_LIMITS -3276.800 3276.700 /end CHARACTERISTIC
/begin CHARACTERISTIC PFlt_DebAPSPlausDefHigh_C "Defektentprellzeit der APS-Plaus positiven Abweichung (MAX) bei projektspezifischen Druck-Plausibilitätsprüfungen" VALUE 0xF1782 Kw_Wu16 1000.000 Time_ms 0.00 1000.000 FORMAT "%8.3" EXTENDED_LIMITS 0.00 655350.0 /end CHARACTERISTIC
/begin CHARACTERISTIC PFlt_DebAPSPlausDefLow_C "Defektentprellzeit der APS-Plaus negativen Abweichung (MIN) bei projektspezifischen Druck-Plausibilitätsprüfungen" VALUE 0xF1784 Kw_Wu16 1000.000 Time_ms 0.00 1000.000 FORMAT "%8.3" EXTENDED_LIMITS 0.00 655350.0 /end CHARACTERISTIC
/begin CHARACTERISTIC PFlt_DebBPSPlausDefHigh_C "Defektentprellzeit der BPS-Plaus positiven Abweichung (MAX) bei projektspezifischen Druck-Plausibilitätsprüfungen" VALUE 0xF1786 Kw_Wu16 1000.000 Time_ms 0.00 1000.000 FORMAT "%8.3" EXTENDED_LIMITS 0.00 655350.0 /end CHARACTERISTIC
/begin CHARACTERISTIC PFlt_DebBPSPlausDefLow_C "Defektentprellzeit der BPS-Plaus negativen Abweichung (MIN) bei projektspezifischen Druck-Plausibilitätsprüfungen" VALUE 0xF1788 Kw_Wu16 1000.000 Time_ms 0.00 1000.000 FORMAT "%8.3" EXTENDED_LIMITS 0.00 655350.0 /end CHARACTERISTIC
/begin CHARACTERISTIC PFlt_DebPFltOvldInhRgnDef_C "Defekt debounce Zeit für Dfp_PFltOvldInhRgn" VALUE 0xF178A Kw_Wu16 20000.00 Time_ms 0.00 20000.00 FORMAT "%8.2" EXTENDED_LIMITS 0.00 655350.0 /end CHARACTERISTIC
/begin CHARACTERISTIC PFlt_DebPFltOvldInhRgnOk_C "Heilende Zeit für Dfp_PFltOvldInhRgn" VALUE 0xF178C Kw_Wu16 20000.00 Time_ms 0.00 20000.00 FORMAT "%8.2" EXTENDED_LIMITS 0.00 655350.0 /end CHARACTERISTIC
/begin CHARACTERISTIC PFlt_DebPFltOvldTrqLimDef_C "Defekt debounce Zeit fuer Dfp_PFltOvldTrqLim" VALUE 0xF178E Kw_Wu16 20000.00 Time_ms 0.00 20000.00 FORMAT "%8.2" EXTENDED_LIMITS 0.00 655350.0 /end CHARACTERISTIC
/begin CHARACTERISTIC PFlt_DebPFltOvldTrqLimOk_C "Heilende entprell Zeit für Dfp_PFltOvldTrqLim" VALUE 0xF1790 Kw_Wu16 20000.00 Time_ms 0.00 20000.00 FORMAT "%8.2" EXTENDED_LIMITS 0.00 655350.0 /end CHARACTERISTIC
/begin CHARACTERISTIC PFlt_DebPresPlausDefHigh_C "Defektentprellzeit der Pre-PFlt-Pres-Plaus positiven Abweichung (MAX) bei projektspezifischen Druck-Plausibilitätsprüfungen" VALUE 0xF1792 Kw_Wu16 1000.000 Time_ms 0.00 1000.000 FORMAT "%8.3" EXTENDED_LIMITS 0.00 655350.0 /end CHARACTERISTIC
/begin CHARACTERISTIC PFlt_DebPresPlausDefLow_C "Defektentprellzeit der Pre-PFlt-Pres-Plaus negativen Abweichung (MIN) bei projektspezifischen Druck-Plausibilitätsprüfungen" VALUE 0xF1794 Kw_Wu16 1000.000 Time_ms 0.00 1000.000 FORMAT "%8.3" EXTENDED_LIMITS 0.00 655350.0 /end CHARACTERISTIC
/begin CHARACTERISTIC PFlt_DebRstDfpEngPrtRgnMon_C "Entprellzeit zum Zurücksetzen von DfpEngPrtRgnMon_C" VALUE 0xF1796 Kw_Wu16 655.3500 Time_s 0.00 655.3500 FORMAT "%8.4" /end CHARACTERISTIC
/begin CHARACTERISTIC PFlt_dvolCharMonMin_C "Mindestvolumenstrom für Überwachung des Strömungswiderstandes" VALUE 0xF16EA Kw_Ws16 100.0000 CubMtrPerHr 0.00 100.0000 FORMAT "%8.4" EXTENDED_LIMITS -3276.800 3276.700 /end CHARACTERISTIC
/begin CHARACTERISTIC PFlt_dvolRstDfpEngPrtMon_C "Luftstromschwelle zum Zurücksetzen von dpf_pfltmsotdiffmax" VALUE 0xF1798 Kw_Ws16 3000.000 CubMtrPerHr 0.00 3000.000 FORMAT "%8.3" EXTENDED_LIMITS -3276.800 3276.700 /end CHARACTERISTIC
/begin CHARACTERISTIC PFlt_facBlwBy_C "Thermischer Austauschfaktor für Abgas im Filter" VALUE 0xF1F34 Kw_Ws16 1.000000 Fact 0.00 1.000000 FORMAT "%8.6" EXTENDED_LIMITS -4.000000 3.999878 /end CHARACTERISTIC
/begin CHARACTERISTIC PFlt_facDpn_MAP "Kennfeld für Bestimmung der Wärmeverlustfaktor nach Abgastemperatursensor" MAP 0xF1F36 Kf_Xs16_Ys16_Ws16 1.000000 Fact 0.00 1.000000 FORMAT "%8.6" EXTENDED_LIMITS -4.000000 3.999878
 /begin AXIS_DESCR STD_AXIS IATSCD_tAir Temp_Cels 8 -50.14000 199.8600 FORMAT "%8.4" EXTENDED_LIMITS -3549.940 3003.560 DEPOSIT ABSOLUTE /end AXIS_DESCR
 /begin AXIS_DESCR STD_AXIS VSSCD_v Vel 8 0.00 300.0000 FORMAT "%8.4" EXTENDED_LIMITS -327.6800 327.6700 DEPOSIT ABSOLUTE /end AXIS_DESCR
/end CHARACTERISTIC
/begin CHARACTERISTIC PFlt_facHtTransNoLin_CUR "Nichtlinearitätsfaktor in der Wärmeübertragung im Filter" CURVE 0xF1FDA Kl_Xs16_Ws16 1.000000 Fact 0.00 1.000000 FORMAT "%8.6" EXTENDED_LIMITS -4.000000 3.999878
 /begin AXIS_DESCR STD_AXIS PFlt_tDiffCorr_mp TempDiff_Cels 8 500.0000 1000.000 FORMAT "%8.3" EXTENDED_LIMITS -3276.800 3276.700 DEPOSIT ABSOLUTE /end AXIS_DESCR
/end CHARACTERISTIC
/begin CHARACTERISTIC PFlt_facNO2RgnInhRgn_CUR "" CURVE 0xF179A Kl_Xs16_Ws16 7.999878 Fact -4.000000 3.999878 FORMAT "%8.6"
 /begin AXIS_DESCR STD_AXIS PFlt_facNO2Rgn Fact 10 0.00 1.000000 FORMAT "%8.6" EXTENDED_LIMITS -4.000000 3.999878 DEPOSIT ABSOLUTE /end AXIS_DESCR
/end CHARACTERISTIC
/begin CHARACTERISTIC PFlt_facNO2RgnTrqLim_CUR "" CURVE 0xF17C4 Kl_Xs16_Ws16 7.999878 Fact -4.000000 3.999878 FORMAT "%8.6"
 /begin AXIS_DESCR STD_AXIS PFlt_facNO2Rgn Fact 10 0.00 1.000000 FORMAT "%8.6" EXTENDED_LIMITS -4.000000 3.999878 DEPOSIT ABSOLUTE /end AXIS_DESCR
/end CHARACTERISTIC
/begin CHARACTERISTIC PFlt_KdDT1TempCor_C "Sprunghöhe des DT1-Filters der Wärmeübergangssim. im Filter" VALUE 0xF1FFC Kw_Ws32 100.000000000 Kd -50.0000000000 50.0000000000 FORMAT "%13.10" EXTENDED_LIMITS -32768.0000000 32767.9999847 /end CHARACTERISTIC
/begin CHARACTERISTIC PFlt_kiITempMod_C "Verstärkungsfaktor Integrator Temperaturmodell" VALUE 0xF2000 Kw_Ws32 999999.999767 Ki -500000.000000 499999.999767 FORMAT "%13.6" /end CHARACTERISTIC
/begin CHARACTERISTIC PFlt_lRstDfpEngPrtMon_C "Strecke seit der letzten erfolgreichen Regeneration zum Zurücksetzen von dpf_pfltmsotdiffmax" VALUE 0xF17F0 Kw_Wu32 4294967295.00 Length 0.00 4294967295.00 FORMAT "%13.2" /end CHARACTERISTIC
/begin CHARACTERISTIC PFlt_lSumDiffMax_C "Maximum erlaubte Unterschied für gefahrene Länge in Kilometer" VALUE 0xF17F4 Kw_Wu32 4294967295.00 LengthKm 0.00 4294967295.00 FORMAT "%13.2" /end CHARACTERISTIC
/begin CHARACTERISTIC PFlt_mLoIdlSotSimMax_C "maximaler Wert des simulierten Rußes, über den Druck-Plausibilitätsprüfungen im niedrigen Leerlaufzustand verhindert werden" VALUE 0xF17F8 Kw_Ws16 300.0000 mSoot_g 0.00 300.0000 FORMAT "%8.4" EXTENDED_LIMITS -327.6800 327.6700 /end CHARACTERISTIC
/begin CHARACTERISTIC PFlt_mSotDiff_C "Threshold value for difference between simulated and measured value of soot mass" VALUE 0xF17FA Kw_Ws16 300.0000 mSoot_g 0.00 300.0000 FORMAT "%8.4" EXTENDED_LIMITS -327.6800 327.6700 /end CHARACTERISTIC
/begin CHARACTERISTIC PFlt_mSot_Vector "#SSD Konfigurationslabel für Bypass" VALUE 0xC39FC Kw_Wu8 255.0 OneToOne 0.00 255.0 FORMAT "%5.1" /end CHARACTERISTIC
/begin CHARACTERISTIC PFlt_mSot_Channel "#SSD Konfigurationslabels für Bypass" VALUE 0xC39FD Kw_Wu8 255.0 OneToOne 0.00 255.0 FORMAT "%5.1" /end CHARACTERISTIC
/begin CHARACTERISTIC PFlt_nLoIdlMax_C "obere Grenze des Drehzahlfensters, um Druck-Plausibilitätsprüfungen im niedrigen Leerlaufzustand zu ermöglichen" VALUE 0xF17FC Kw_Ws16 5000.000 EngN 0.00 5000.000 FORMAT "%8.3" EXTENDED_LIMITS -32768.00 32767.00 /end CHARACTERISTIC
/begin CHARACTERISTIC PFlt_nLoIdlMin_C "untere Grenze des Drehzahlfensters, um Druck-Plausibilitätsprüfungen im niedrigen Leerlaufzustand zu ermöglichen" VALUE 0xF17FE Kw_Ws16 5000.000 EngN 0.00 5000.000 FORMAT "%8.3" EXTENDED_LIMITS -32768.00 32767.00 /end CHARACTERISTIC
/begin CHARACTERISTIC PFlt_nMin_C "minimale Drehzahl, um Druck-Plausibilitätsprüfungen bei Kl15-EIN und nach dem Aufwachungszustand zu deaktivieren" VALUE 0xF1800 Kw_Ws16 5000.000 EngN 0.00 5000.000 FORMAT "%8.3" EXTENDED_LIMITS -32768.00 32767.00 /end CHARACTERISTIC
/begin CHARACTERISTIC PFlt_nPFltOvldHeal_C "Minimale Motordrehzahlschwelle für das Heilend von PFlt Überlastung dfps" VALUE 0xF1802 Kw_Ws16 5000.000 EngN 0.00 5000.000 FORMAT "%8.3" EXTENDED_LIMITS -32768.00 32767.00 /end CHARACTERISTIC
/begin CHARACTERISTIC PFlt_nStrtMax_C "obere Grenze des Drehzahlfensters, um Druck-Plausibilitätsprüfungen im Startzustand zu ermöglichen" VALUE 0xF1804 Kw_Ws16 5000.000 EngN 0.00 5000.000 FORMAT "%8.3" EXTENDED_LIMITS -32768.00 32767.00 /end CHARACTERISTIC
/begin CHARACTERISTIC PFlt_nStrtMin_C "untere Grenze des Drehzahlfensters, um Druck-Plausibilitätsprüfungen im Startzustand zu ermöglichen" VALUE 0xF1806 Kw_Ws16 5000.000 EngN 0.00 5000.000 FORMAT "%8.3" EXTENDED_LIMITS -32768.00 32767.00 /end CHARACTERISTIC
/begin CHARACTERISTIC PFlt_nTempChkTrg_C "Drehzahlschwelle zur Triggerung Zeitfenster Temperaturplausibilisierung" VALUE 0xF16EC Kw_Ws16 1500.000 EngN 500.0000 2000.000 FORMAT "%8.3" EXTENDED_LIMITS -32768.00 32767.00 /end CHARACTERISTIC
/begin CHARACTERISTIC PFlt_numCntBck_C "Backstep value of the counter for IATSCD minimum search" VALUE 0xF16EE Kw_Wu16 65535.00 OneToOne 0.00 65535.00 FORMAT "%8.2" /end CHARACTERISTIC
/begin CHARACTERISTIC PFlt_numCntMax_C "Maximum counter value for IATSCD minimum search" VALUE 0xF16F0 Kw_Wu16 65535.00 OneToOne 0.00 65535.00 FORMAT "%8.2" /end CHARACTERISTIC
/begin CHARACTERISTIC PFlt_numEngPrtActvMsk_C "Aktivierungsmaske des Motorschutzes abhängig von der Regeneration" VALUE 0xF1808 Kw_Wu8 255.0 OneToOne 0.00 255.0 FORMAT "%5.1" /end CHARACTERISTIC
/begin CHARACTERISTIC PFlt_numPFltMon_C "Zeiger für Motortemperaturfeld" VALUE 0xF16F2 Kw_Wu8 2.00000000000 EngTempFldSel 0.00 2.00000000000 FORMAT "%13.11" /end CHARACTERISTIC
/begin CHARACTERISTIC PFlt_numRgnStep1_C "Partikelfilterregeneration im 1. Schritt" VALUE 0xF1809 Kw_Wu8 255.0 OneToOne 0.00 255.0 FORMAT "%5.1" /end CHARACTERISTIC
/begin CHARACTERISTIC PFlt_numRgnStep2_C "Partikelfilterregeneration im 2 . Schritt" VALUE 0xF180A Kw_Wu8 255.0 OneToOne 0.00 255.0 FORMAT "%5.1" /end CHARACTERISTIC
/begin CHARACTERISTIC PFlt_numRgnStep3_C "Partikelfilterregeneration im 3. Schritt" VALUE 0xF180B Kw_Wu8 255.0 OneToOne 0.00 255.0 FORMAT "%5.1" /end CHARACTERISTIC
/begin CHARACTERISTIC PFlt_numRgnStep4_C "Partikelfilterregeneration im 4. Schritt" VALUE 0xF180C Kw_Wu8 255.0 OneToOne 0.00 255.0 FORMAT "%5.1" /end CHARACTERISTIC
/begin CHARACTERISTIC PFlt_numRgnStep5_C "Partikelfilterregeneration im 5. Schritt" VALUE 0xF180D Kw_Wu8 255.0 OneToOne 0.00 255.0 FORMAT "%5.1" /end CHARACTERISTIC
/begin CHARACTERISTIC PFlt_numRgnStep6_C "Partikelfilterregeneration im 6. Schritt" VALUE 0xF180E Kw_Wu8 255.0 OneToOne 0.00 255.0 FORMAT "%5.1" /end CHARACTERISTIC
/begin CHARACTERISTIC PFlt_numRgnStep7_C "Partikelfilterregeneration im 7. Schritt" VALUE 0xF180F Kw_Wu8 255.0 OneToOne 0.00 255.0 FORMAT "%5.1" /end CHARACTERISTIC
/begin CHARACTERISTIC PFlt_numRgnStep8_C "Partikelfilterregeneration im 8. Schritt" VALUE 0xF1810 Kw_Wu8 255.0 OneToOne 0.00 255.0 FORMAT "%5.1" /end CHARACTERISTIC
/begin CHARACTERISTIC PFlt_numTimeStpPlausSens_C "Anzahl Zeitschritte für numerische Differentiation der Sensorsignale" VALUE 0xF16F3 Kw_Wu8 9.000 OneToOne 1.000 10.00 FORMAT "%5.2" EXTENDED_LIMITS 0.00 255.0 /end CHARACTERISTIC
/begin CHARACTERISTIC PFlt_pAPSNegDvt_C "Begrenzung der APS unter welchem der MIN-Fehler bei Druck-Plausibilitätsprüfungen auf APS-Plaus gesetzt wird" VALUE 0xF1812 Kw_Ws16 5000.000 Pres_hPa 0.00 5000.000 FORMAT "%8.3" EXTENDED_LIMITS -32768.00 32767.00 /end CHARACTERISTIC
/begin CHARACTERISTIC PFlt_pAPSPosDvt_C "Begrenzung der APS über welchem der MAX-Fehler bei Druck-Plausibilitätsprüfungen auf APS-Plaus gesetzt wird" VALUE 0xF1814 Kw_Ws16 5000.000 Pres_hPa 0.00 5000.000 FORMAT "%8.3" EXTENDED_LIMITS -32768.00 32767.00 /end CHARACTERISTIC
/begin CHARACTERISTIC PFlt_pBPAndAPTolcMax_C "Toleranzband für Ladedrucksensor und Atmosphärendrucksensor" VALUE 0xF16F4 Kw_Wu16 65535.00 Pres_hPa 0.00 65535.00 FORMAT "%8.2" /end CHARACTERISTIC
/begin CHARACTERISTIC PFlt_pBPSNegDvt_C "Begrenzung der BPS unter welchem der MIN-Fehler bei Druck-Plausibilitätsprüfungen auf APS Plaus gesetzt wird" VALUE 0xF1816 Kw_Ws16 5000.000 Pres_hPa 0.00 5000.000 FORMAT "%8.3" EXTENDED_LIMITS -32768.00 32767.00 /end CHARACTERISTIC
/begin CHARACTERISTIC PFlt_pBPSPosDvt_C "Begrenzung der BPS über den maximalen Fehler auf BPS-Plaus bei Druck-Plausibilitätsprüfungen gestellt" VALUE 0xF1818 Kw_Ws16 5000.000 Pres_hPa 0.00 5000.000 FORMAT "%8.3" EXTENDED_LIMITS -32768.00 32767.00 /end CHARACTERISTIC
/begin CHARACTERISTIC PFlt_pDfl_C "Vorgabewert Absolutdruck vor Partikelfilter" VALUE 0xF1E74 Kw_Ws16 65535.00 Pres_hPa -32768.00 32767.00 FORMAT "%8.2" /end CHARACTERISTIC
/begin CHARACTERISTIC PFlt_pDiffCharMonMin_C "Mindestdifferenzdruck für Überwachung des Strömungswiderstandes" VALUE 0xF16F6 Kw_Ws16 4500.000 Pres_hPa -1000.000 3500.000 FORMAT "%8.3" EXTENDED_LIMITS -32768.00 32767.00 /end CHARACTERISTIC
/begin CHARACTERISTIC PFlt_pDiffDfl_MAP "Interpolation des Wertes bei defektivem Drucksensor" MAP 0xF1E76 Kf_Xs16_Ys16_Ws16 3500.000 Pres_hPa 0.00 3500.000 FORMAT "%8.3" EXTENDED_LIMITS -32768.00 32767.00
 /begin AXIS_DESCR STD_AXIS Eng_nAvrg EngN 8 40.00000 6000.000 FORMAT "%8.3" EXTENDED_LIMITS -32768.00 32767.00 DEPOSIT ABSOLUTE /end AXIS_DESCR
 /begin AXIS_DESCR STD_AXIS InjCtl_qSetUnBal InjMassCyc 8 0.00 327.6700 FORMAT "%8.4" EXTENDED_LIMITS -327.6800 327.6700 DEPOSIT ABSOLUTE /end AXIS_DESCR
/end CHARACTERISTIC
/begin CHARACTERISTIC PFlt_pDiffHsLnNeg_C "Untere Schwelle Differenzdruck zur Schlauchleitungsüberwachung" VALUE 0xF16F8 Kw_Ws16 3277.0000 Pres_hPa 223.0000 3500.0000 FORMAT "%8.4" EXTENDED_LIMITS -32768.00 32767.00 /end CHARACTERISTIC
/begin CHARACTERISTIC PFlt_pDiffMax1_C "maximale Schwelle für die Regenerationsüberwachung des Motorschutzes" VALUE 0xF181A Kw_Ws16 3277.0000 Pres_hPa 223.0000 3500.0000 FORMAT "%8.4" EXTENDED_LIMITS -32768.00 32767.00 /end CHARACTERISTIC
/begin CHARACTERISTIC PFlt_pDiffMax_C "Obere Schwelle SRC Differenzdruck" VALUE 0xF16FA Kw_Ws16 3277.0000 Pres_hPa 223.0000 3500.0000 FORMAT "%8.4" EXTENDED_LIMITS -32768.00 32767.00 /end CHARACTERISTIC
/begin CHARACTERISTIC PFlt_pDiffMin_C "Untere Schwelle SRC Differenzdruck" VALUE 0xF16FC Kw_Ws16 3277.0000 Pres_hPa 223.0000 3500.0000 FORMAT "%8.4" EXTENDED_LIMITS -32768.00 32767.00 /end CHARACTERISTIC
/begin CHARACTERISTIC PFlt_dpDiffUp_C "Rampensteigung bei Aufreten eines Systemfehlers" VALUE 0xF1F1C Kw_Wu32 65535999.9847 RmpPres_hPa 0.00 65535999.9847 FORMAT "%13.4" /end CHARACTERISTIC
/begin CHARACTERISTIC PFlt_dpDiffDwn_C "Rampensteigung bei Wegfall des Systemfehlers" VALUE 0xF1F20 Kw_Wu32 65535999.9847 RmpPres_hPa 0.00 65535999.9847 FORMAT "%13.4" /end CHARACTERISTIC
/begin CHARACTERISTIC PFlt_pDiffTolcMax_C "Toleranzband Differenzdrucksensor" VALUE 0xF16FE Kw_Ws16 3277.0000 Pres_hPa 223.0000 3500.0000 FORMAT "%8.4" EXTENDED_LIMITS -32768.00 32767.00 /end CHARACTERISTIC
/begin CHARACTERISTIC PFlt_pMinNrmCldStrt_C "Mindestumgebungsdruck für normalen Kaltstart" VALUE 0xF1700 Kw_Ws16 2700.000 Pres_hPa 800.0000 3500.000 FORMAT "%8.3" EXTENDED_LIMITS -32768.00 32767.00 /end CHARACTERISTIC
/begin CHARACTERISTIC PFlt_pPFltOvldInhRgn_MAP "Kennfeld für PFlt Überlastung Regenerationshemmung" MAP 0xF181C Kf_Xs16_Ys16_Ws16 3500.000 Pres_hPa 0.00 3500.000 FORMAT "%8.3" EXTENDED_LIMITS -32768.00 32767.00
 /begin AXIS_DESCR STD_AXIS Eng_nAvrg EngN 8 40.00000 6000.000 FORMAT "%8.3" EXTENDED_LIMITS -32768.00 32767.00 DEPOSIT ABSOLUTE /end AXIS_DESCR
 /begin AXIS_DESCR STD_AXIS InjCtl_qSetUnBal InjMassCyc 8 0.00 327.6700 FORMAT "%8.4" EXTENDED_LIMITS -327.6800 327.6700 DEPOSIT ABSOLUTE /end AXIS_DESCR
/end CHARACTERISTIC
/begin CHARACTERISTIC PFlt_pPFltOvldInit_C "Initwert des PT1Filter fuer PFlt_pPFltOvldLckRgn_mp" VALUE 0xF18C0 Kw_Ws16 32767.00 Pres_hPa 0.00 32767.00 FORMAT "%8.2" EXTENDED_LIMITS -32768.00 32767.00 /end CHARACTERISTIC
/begin CHARACTERISTIC PFlt_pPFltOvldOfsHeal_C "Schwelle für die Heilung" VALUE 0xF18C2 Kw_Ws16 32767.00 Pres_hPa 0.00 32767.00 FORMAT "%8.2" EXTENDED_LIMITS -32768.00 32767.00 /end CHARACTERISTIC
/begin CHARACTERISTIC PFlt_pPFltOvldTrqLim_MAP "Kennfeld fuer PFlt Uberladung Drehkraft-Beschränkung Berechnung" MAP 0xF18C4 Kf_Xs16_Ys16_Ws16 3500.000 Pres_hPa 0.00 3500.000 FORMAT "%8.3" EXTENDED_LIMITS -32768.00 32767.00
 /begin AXIS_DESCR STD_AXIS Eng_nAvrg EngN 8 40.00000 6000.000 FORMAT "%8.3" EXTENDED_LIMITS -32768.00 32767.00 DEPOSIT ABSOLUTE /end AXIS_DESCR
 /begin AXIS_DESCR STD_AXIS InjCtl_qSetUnBal InjMassCyc 8 0.00 327.6700 FORMAT "%8.4" EXTENDED_LIMITS -327.6800 327.6700 DEPOSIT ABSOLUTE /end AXIS_DESCR
/end CHARACTERISTIC
/begin CHARACTERISTIC PFlt_pPreAndBPTolcMax_C "Toleranzband für Ladedrucksensor und absolut Drucksensor" VALUE 0xF1702 Kw_Ws16 65535.00 Pres_hPa -32768.00 32767.00 FORMAT "%8.2" /end CHARACTERISTIC
/begin CHARACTERISTIC PFlt_pPreAshOilCorr_MAP "von Auf PFlt_dvol und PFlt_mAshOil abhängiges Kennfeld zur Korrekturwertberechnung von PFlt_pPre" MAP 0xF1968 Kf_Xs16_Ys16_Ws16 5000.000 Pres_hPa 0.00 5000.000 FORMAT "%8.3" EXTENDED_LIMITS -32768.00 32767.00
 /begin AXIS_DESCR STD_AXIS PFlt_dvol CubMtrPerHr 5 0.00 3000.000 FORMAT "%8.3" EXTENDED_LIMITS -3276.800 3276.700 DEPOSIT ABSOLUTE /end AXIS_DESCR
 /begin AXIS_DESCR STD_AXIS PFlt_mAshOil mSoot_g 5 0.00 300.0000 FORMAT "%8.4" EXTENDED_LIMITS -327.6800 327.6700 DEPOSIT ABSOLUTE /end AXIS_DESCR
/end CHARACTERISTIC
/begin CHARACTERISTIC PFlt_pPreCorrMax_C "maximaler Korrekturwert, welcher für PFlt_pPre zum Plausibilitätstest appliziert werden kann" VALUE 0xF19B2 Kw_Ws16 5000.000 Pres_hPa 0.00 5000.000 FORMAT "%8.3" EXTENDED_LIMITS -32768.00 32767.00 /end CHARACTERISTIC
/begin CHARACTERISTIC PFlt_pPresNegDvt_C "Begrenzung der pPreCorr  unter welchem der MIN-Fehler bei  Druck-Plausibilitätsprüfungen auf pPre Plaus gesetzt wird" VALUE 0xF19B4 Kw_Ws16 5000.000 Pres_hPa 0.00 5000.000 FORMAT "%8.3" EXTENDED_LIMITS -32768.00 32767.00 /end CHARACTERISTIC
/begin CHARACTERISTIC PFlt_pPreSotSimCorr_MAP "von PFlt_dvol und PFlt_mSotSim abhängiges Kennfeld zur Korrekturwertberechnung von PFlt_pPre" MAP 0xF19B6 Kf_Xs16_Ys16_Ws16 5000.000 Pres_hPa 0.00 5000.000 FORMAT "%8.3" EXTENDED_LIMITS -32768.00 32767.00
 /begin AXIS_DESCR STD_AXIS PFlt_dvol CubMtrPerHr 5 0.00 3000.000 FORMAT "%8.3" EXTENDED_LIMITS -3276.800 3276.700 DEPOSIT ABSOLUTE /end AXIS_DESCR
 /begin AXIS_DESCR STD_AXIS PFlt_mSotSim mSoot_g 5 0.00 300.0000 FORMAT "%8.4" EXTENDED_LIMITS -327.6800 327.6700 DEPOSIT ABSOLUTE /end AXIS_DESCR
/end CHARACTERISTIC
/begin CHARACTERISTIC PFlt_pPresPlausMaxDvt_C "Begrenzung für Druckunterschied  über den NPL-Fehler auf Doppeldefekt Plaus bei den Druck-Plausibilitätsprüfungen gestellt" VALUE 0xF1A00 Kw_Ws16 5000.000 Pres_hPa 0.00 5000.000 FORMAT "%8.3" EXTENDED_LIMITS -32768.00 32767.00 /end CHARACTERISTIC
/begin CHARACTERISTIC PFlt_pPresPlausMinDvt_C "Begrenzung der Druckdifferenz unter welchem alle Fehler bei  Druck-Plausibilitätsprüfungen gelöscht werden" VALUE 0xF1A02 Kw_Ws16 5000.000 Pres_hPa 0.00 5000.000 FORMAT "%8.3" EXTENDED_LIMITS -32768.00 32767.00 /end CHARACTERISTIC
/begin CHARACTERISTIC PFlt_pPresPosDvt_C "Begrenzung der pPreCorr über den  maximalen Fehler auf pPre Plaus für Druck-Plausibilitätsprüfungen" VALUE 0xF1A04 Kw_Ws16 5000.000 Pres_hPa 0.00 5000.000 FORMAT "%8.3" EXTENDED_LIMITS -32768.00 32767.00 /end CHARACTERISTIC
/begin CHARACTERISTIC PFlt_pPreTolcMax_C "Toleranzband Absolutdrucksensor" VALUE 0xF1704 Kw_Ws16 3277.0000 Pres_hPa 223.0000 3500.0000 FORMAT "%8.4" EXTENDED_LIMITS -32768.00 32767.00 /end CHARACTERISTIC
/begin CHARACTERISTIC PFlt_pPreVolCorr_CUR "von PFlt_dvol abhängige Kennlinie zur Korrekturwertberechnung von PFlt_pPre" CURVE 0xF1A06 Kl_Xs16_Ws16 5000.000 Pres_hPa 0.00 5000.000 FORMAT "%8.3" EXTENDED_LIMITS -32768.00 32767.00
 /begin AXIS_DESCR STD_AXIS PFlt_dvol CubMtrPerHr 5 0.00 3000.000 FORMAT "%8.3" EXTENDED_LIMITS -3276.800 3276.700 DEPOSIT ABSOLUTE /end AXIS_DESCR
/end CHARACTERISTIC
/begin CHARACTERISTIC PFlt_qLoIdlMax_C "obere Grenze der Einspritzmenge für den Leerlaufdruckplausibilitätstest" VALUE 0xF1A1C Kw_Ws16 327.6700 InjMassCyc 0.00 327.6700 FORMAT "%8.4" EXTENDED_LIMITS -327.6800 327.6700 /end CHARACTERISTIC
/begin CHARACTERISTIC PFlt_qLoIdlMin_C "untere Grenze der Einspritzmenge für den Leerlaufdruckplausibilitätstest" VALUE 0xF1A1E Kw_Ws16 327.6700 InjMassCyc 0.00 327.6700 FORMAT "%8.4" EXTENDED_LIMITS -327.6800 327.6700 /end CHARACTERISTIC
/begin CHARACTERISTIC PFlt_qPFltOvldHeal_C "Schwelle für die Einspritzmenge" VALUE 0xF1A20 Kw_Ws16 327.6700 InjMassInj 0.00 327.6700 FORMAT "%8.4" EXTENDED_LIMITS -327.6800 327.6700 /end CHARACTERISTIC
/begin CHARACTERISTIC PFlt_rEngPrtRgnMax_C "Schwellwert für das Verhältnis der Aufgabezeit und letzter Regenerationszeit" VALUE 0xF1A22 Kw_Ws16 799.9878 Prc -400.0000 399.9878 FORMAT "%8.4" /end CHARACTERISTIC
/begin CHARACTERISTIC PFlt_resFlowMax_C "Obere Schwelle SRC Strömungswiderstand" VALUE 0xF1706 Kw_Ws16 25.00000 Res_hPaHrPerCM 0.00 25.00000 FORMAT "%8.5" EXTENDED_LIMITS -32.76800 32.76700 /end CHARACTERISTIC
/begin CHARACTERISTIC PFlt_resFlowMin_C "Untere Schwelle SRC Strömungswiderstand" VALUE 0xF1708 Kw_Ws16 25.00000 Res_hPaHrPerCM 0.00 25.00000 FORMAT "%8.5" EXTENDED_LIMITS -32.76800 32.76700 /end CHARACTERISTIC
/begin CHARACTERISTIC PFlt_resFlowOvldInhRgn_MAP "" MAP 0xF1A24 Kf_Xs16_Ys16_Ws16 25.00000 Res_hPaHrPerCM 0.00 25.00000 FORMAT "%8.5" EXTENDED_LIMITS -32.76800 32.76700
 /begin AXIS_DESCR STD_AXIS Eng_nAvrg EngN 8 40.00000 6000.000 FORMAT "%8.3" EXTENDED_LIMITS -32768.00 32767.00 DEPOSIT ABSOLUTE /end AXIS_DESCR
 /begin AXIS_DESCR STD_AXIS InjCtl_qSetUnBal InjMassCyc 8 0.00 327.6700 FORMAT "%8.4" EXTENDED_LIMITS -327.6800 327.6700 DEPOSIT ABSOLUTE /end AXIS_DESCR
/end CHARACTERISTIC
/begin CHARACTERISTIC PFlt_resFlowOvldInit_C "" VALUE 0xF1AC8 Kw_Ws16 25.00000 Res_hPaHrPerCM 0.00 25.00000 FORMAT "%8.5" EXTENDED_LIMITS -32.76800 32.76700 /end CHARACTERISTIC
/begin CHARACTERISTIC PFlt_resFlowOvldOfsHeal_C "" VALUE 0xF1ACA Kw_Ws16 25.00000 Res_hPaHrPerCM 0.00 25.00000 FORMAT "%8.5" EXTENDED_LIMITS -32.76800 32.76700 /end CHARACTERISTIC
/begin CHARACTERISTIC PFlt_resFlowOvldTrqLim_MAP "" MAP 0xF1ACC Kf_Xs16_Ys16_Ws16 25.00000 Res_hPaHrPerCM 0.00 25.00000 FORMAT "%8.5" EXTENDED_LIMITS -32.76800 32.76700
 /begin AXIS_DESCR STD_AXIS Eng_nAvrg EngN 8 40.00000 6000.000 FORMAT "%8.3" EXTENDED_LIMITS -32768.00 32767.00 DEPOSIT ABSOLUTE /end AXIS_DESCR
 /begin AXIS_DESCR STD_AXIS InjCtl_qSetUnBal InjMassCyc 8 0.00 327.6700 FORMAT "%8.4" EXTENDED_LIMITS -327.6800 327.6700 DEPOSIT ABSOLUTE /end AXIS_DESCR
/end CHARACTERISTIC
/begin CHARACTERISTIC PFlt_resFlowTolcDynPlaus_C "Faktor für Festlegung Toleranzschwelle dynamische Drucküberwachung" VALUE 0xF170A Kw_Ws16 25.00000 Res_hPaHrPerCM 0.00 25.00000 FORMAT "%8.5" EXTENDED_LIMITS -32.76800 32.76700 /end CHARACTERISTIC
/begin CHARACTERISTIC PFlt_resFlow_Vector "#SSD Konfigurationslabel für Bypass" VALUE 0xC39FE Kw_Wu8 255.0 OneToOne 0.00 255.0 FORMAT "%5.1" /end CHARACTERISTIC
/begin CHARACTERISTIC PFlt_resFlow_Channel "#SSD Konfigurationslabels für Bypass" VALUE 0xC39FF Kw_Wu8 255.0 OneToOne 0.00 255.0 FORMAT "%5.1" /end CHARACTERISTIC
/begin CHARACTERISTIC PFlt_rLoIdlTVAMax_C "maximaler Wert des TVACD-Tastverhältnisses, über welchem die Plausibilitätsprüfungen im niedrigen Leerlauf deaktiviert werden" VALUE 0xF1B70 Kw_Ws16 100.0000 DtyCyc 0.00 100.0000 FORMAT "%8.4" EXTENDED_LIMITS -327.6800 327.6700 /end CHARACTERISTIC
/begin CHARACTERISTIC PFlt_stCfgTempSens_C "Bitleiste zur Auswahl der Abgastemperatursensoren" VALUE 0xF170C Kw_Wu8 255.0 OneToOne 0.00 255.0 FORMAT "%5.1" /end CHARACTERISTIC
/begin CHARACTERISTIC PFlt_stLoIdlEGTMsk_C "Abgasnachbehandlungsmaske für Druck-Plausibilitätsprüfungen im niedrigen Leerlaufzustand" VALUE 0xF1B74 Kw_Wu32 2147483647.00 OneToOne 0.00 2147483647.00 FORMAT "%13.2" EXTENDED_LIMITS 0.00 4294967295.00 /end CHARACTERISTIC
/begin CHARACTERISTIC PFlt_stMaxEGTMsk_C "Mask zur Regenerationserkennung" VALUE 0xF1B78 Kw_Wu32 2147483647.00 OneToOne 0.00 2147483647.00 FORMAT "%13.2" EXTENDED_LIMITS 0.00 4294967295.00 /end CHARACTERISTIC
/begin CHARACTERISTIC PFlt_stRgnMsk1_C "Abdecken für EGT_CmpSt Funktion" VALUE 0xF2004 Kw_Wu32 2147483647.00 OneToOne 0.00 2147483647.00 FORMAT "%13.2" EXTENDED_LIMITS 0.00 4294967295.00 /end CHARACTERISTIC
/begin CHARACTERISTIC PFlt_stRgnMsk2_C "Abdecken für EGT_CmpSt Funktion" VALUE 0xF2008 Kw_Wu32 2147483647.00 OneToOne 0.00 2147483647.00 FORMAT "%13.2" EXTENDED_LIMITS 0.00 4294967295.00 /end CHARACTERISTIC
/begin CHARACTERISTIC PFlt_swtDiagRlsmSotCtl_C "Schalter zur Meldung von stDiagRlsmSotCtl an dfp" VALUE 0xF1B7C Kw_Wu8 1.000 OneToOne 0.00 1.000 FORMAT "%5.3" EXTENDED_LIMITS 0.00 255.0 /end CHARACTERISTIC
/begin CHARACTERISTIC PFlt_swtDTempOxiCor_C "Schalten  um Korrekturfaktorhinzufügung zur oxicattemperatur zu ermöglichen" VALUE 0xF1F24 Kw_Wu8 1.000 OneToOne 0.00 1.000 FORMAT "%5.3" EXTENDED_LIMITS 0.00 255.0 /end CHARACTERISTIC
/begin CHARACTERISTIC PFlt_swtEngPrtWrEEPROM_C "Schalter, um Schreiben der regeneration protection counter ins EEPROM freizugeben. (1: freigegeben, 0: gesperrt)" VALUE 0xF1B7D Kw_Wu8 1.000 OneToOne 0.00 1.000 FORMAT "%5.3" EXTENDED_LIMITS 0.00 255.0 /end CHARACTERISTIC
/begin CHARACTERISTIC PFlt_swtEnvTempSens_C "Schalter Umgebungstemperatursensorfühler appliziert (1: appliziert, 0: nicht appliziert)" VALUE 0xF170D Kw_Wu8 1.000 OneToOne 0.00 1.000 FORMAT "%5.3" EXTENDED_LIMITS 0.00 255.0 /end CHARACTERISTIC
/begin CHARACTERISTIC PFlt_swtFacDpn_C "Schalter zur überlegeung der Verlustleistung (1: motornaher Kat. - Filter 0: kombinierter Kat. - Filter)" VALUE 0xF200C Kw_Wu8 1.000 OneToOne 0.00 1.000 FORMAT "%5.3" EXTENDED_LIMITS 0.00 255.0 /end CHARACTERISTIC
/begin CHARACTERISTIC PFlt_swtMonCharMin_C "Schalter Auswahl Überwachung Strömungswiderstand (1: Überwachung Filterdurchbruch, 0: Grenzwert für Volumenstrom)" VALUE 0xF170E Kw_Wu8 1.000 OneToOne 0.00 1.000 FORMAT "%5.3" EXTENDED_LIMITS 0.00 255.0 /end CHARACTERISTIC
/begin CHARACTERISTIC PFlt_swtPDiffOfsOn_C "Schalter zur Berücksichtigung des Differenzdruckoffsets (1: Berücksichtigt, 0: nicht Berücksichtigt)" VALUE 0xF1F25 Kw_Wu8 1.000 OneToOne 0.00 1.000 FORMAT "%5.3" EXTENDED_LIMITS 0.00 255.0 /end CHARACTERISTIC
/begin CHARACTERISTIC PFlt_swtPFltOvldInhRgnCor_C "Schalter für schreiben er EEPROM Größen" VALUE 0xF1B7E Kw_Wu8 1.000 OneToOne 0.00 1.000 FORMAT "%5.3" EXTENDED_LIMITS 0.00 255.0 /end CHARACTERISTIC
/begin CHARACTERISTIC PFlt_swtPFltOvldTrqLimCor_C "Schalter für schreiben er EEPROM Größen" VALUE 0xF1B7F Kw_Wu8 1.000 OneToOne 0.00 1.000 FORMAT "%5.3" EXTENDED_LIMITS 0.00 255.0 /end CHARACTERISTIC
/begin CHARACTERISTIC PFlt_swtPresSensCfg_C "Auswahlwert für Sensorkonfiguration (0...nur Differenzdrucksensor verwendet, 1...nur Absolutdrucksensor verwendet)" VALUE 0xF1F26 Kw_Wu8 2.000 OneToOne 0.00 2.000 FORMAT "%5.3" EXTENDED_LIMITS 0.00 255.0 /end CHARACTERISTIC
/begin CHARACTERISTIC PFlt_swtSvcSensChng_C "Schalter für Rücksetzen der EEPROM-Werte bei Differenzdrucksensoraustausch (1: Rücksetzen, 0: kein Rücksetzen)" VALUE 0xF170F Kw_Wu8 255.0 OneToOne 0.00 255.0 FORMAT "%5.1" /end CHARACTERISTIC
/begin CHARACTERISTIC PFlt_swtSvcTmrRst_C "Schalter für Rücksetzen der EEPROM-Timer-Werte bei Steuergerätetausch (1: Rücksetzen, 0: kein Rücksetzen)" VALUE 0xF1710 Kw_Wu8 255.0 OneToOne 0.00 255.0 FORMAT "%5.1" /end CHARACTERISTIC
/begin CHARACTERISTIC PFlt_swtTempModOff_C "Schalter zur Abschaltung des Partikelfiltertemperaturmodells (1: aus, 0: ein)" VALUE 0xF200D Kw_Wu8 1.000 OneToOne 0.00 1.000 FORMAT "%5.3" EXTENDED_LIMITS 0.00 255.0 /end CHARACTERISTIC
/begin CHARACTERISTIC PFlt_swtTSensCfg_C "Wahl der Oxicat Temperaturvorwähler" VALUE 0xF1F27 Kw_Wu8 2.000 OneToOne 0.00 2.000 FORMAT "%5.3" EXTENDED_LIMITS 0.00 255.0 /end CHARACTERISTIC
/begin CHARACTERISTIC PFlt_tCldStrtDfl_C "Obere Temperaturschwelle für Kaltstarterkennung" VALUE 0xF1712 Kw_Ws16 950.0000 Temp_Cels -50.14000 899.8600 FORMAT "%8.4" EXTENDED_LIMITS -3549.940 3003.560 /end CHARACTERISTIC
/begin CHARACTERISTIC PFlt_tClntPFltOvldHeal_C "Schwelle für Fehlerheilung" VALUE 0xF1B80 Kw_Ws16 950.0000 Temp_Cels -50.1400 899.8600 FORMAT "%8.4" EXTENDED_LIMITS -3549.940 3003.560 /end CHARACTERISTIC
/begin CHARACTERISTIC PFlt_tDevOxiPreMax_C "Grenzwert für den Schleppzeiger, um Fehlerpfad zu setzen" VALUE 0xF1B82 Kw_Ws16 600.0000 TempDiff_Cels -100.0000 500.0000 FORMAT "%8.4" EXTENDED_LIMITS -3276.800 3276.700 /end CHARACTERISTIC
/begin CHARACTERISTIC PFlt_tDevOxiPreRgnMax_C "Grenzwert für den Schleppzeiger um bei Regeneration einen Fehlerpfad zu setzen" VALUE 0xF1B84 Kw_Ws16 600.0000 TempDiff_Cels -100.0000 500.0000 FORMAT "%8.4" EXTENDED_LIMITS -3276.800 3276.700 /end CHARACTERISTIC
/begin CHARACTERISTIC PFlt_tDevPreMax_C "Grenzwert für den Schleppzeiger um Fehlerpfad zu setzen" VALUE 0xF1B86 Kw_Ws16 600.0000 TempDiff_Cels -100.0000 500.0000 FORMAT "%8.4" EXTENDED_LIMITS -3276.800 3276.700 /end CHARACTERISTIC
/begin CHARACTERISTIC PFlt_tDevPreRgnMax_C "Grenzwert für den Schleppzeiger um im Regenerationsfall einen Fehlerpfad zu setzen" VALUE 0xF1B88 Kw_Ws16 600.0000 TempDiff_Cels -100.0000 500.0000 FORMAT "%8.4" EXTENDED_LIMITS -3276.800 3276.700 /end CHARACTERISTIC
/begin CHARACTERISTIC PFlt_tDiffCldMax_C "Maximal erlaubte Abweichung Temperatursensoren bei Kaltstart" VALUE 0xF1714 Kw_Ws16 250.2000 TempDiff_Cels -50.10000 200.1000 FORMAT "%8.4" EXTENDED_LIMITS -3276.800 3276.700 /end CHARACTERISTIC
/begin CHARACTERISTIC PFlt_tDiffTolcMax_C "Maximal erlaubte Toleranzabweichung Temperaturplausibilisierung" VALUE 0xF1716 Kw_Ws16 250.2000 TempDiff_Cels -50.10000 200.1000 FORMAT "%8.4" EXTENDED_LIMITS -3276.800 3276.700 /end CHARACTERISTIC
/begin CHARACTERISTIC PFlt_tDwnStrmTolcMax_C "Maximal zulässige Toleranz bei Plausibilisierung des zweiten Abgastemperatursensors" VALUE 0xF1718 Kw_Ws16 250.2000 TempDiff_Cels -50.10000 200.1000 FORMAT "%8.4" EXTENDED_LIMITS -3276.800 3276.700 /end CHARACTERISTIC
/begin CHARACTERISTIC PFlt_tEGMax_C "Obere Schwelle SRC Temperatursensoren" VALUE 0xF171A Kw_Ws16 950.0000 Temp_Cels -50.14000 899.8600 FORMAT "%8.4" EXTENDED_LIMITS -3549.940 3003.560 /end CHARACTERISTIC
/begin CHARACTERISTIC PFlt_tEGMin_C "Untere Schwelle SRC Temperatursensoren" VALUE 0xF171C Kw_Ws16 950.0000 Temp_Cels -50.14000 899.8600 FORMAT "%8.4" EXTENDED_LIMITS -3549.940 3003.560 /end CHARACTERISTIC
/begin CHARACTERISTIC PFlt_tExhGsStyRgn1_MAP "Temperatur der statischen Rußemission für Regeneration 1" MAP 0xF200E Kf_Xs16_Ys16_Ws16 700.0000 TempDiff_Cels 100.0000 800.0000 FORMAT "%8.4" EXTENDED_LIMITS -3276.800 3276.700
 /begin AXIS_DESCR STD_AXIS Eng_nAvrg EngN 12 40.00000 6000.000 FORMAT "%8.3" EXTENDED_LIMITS -32768.00 32767.00 DEPOSIT ABSOLUTE /end AXIS_DESCR
 /begin AXIS_DESCR STD_AXIS InjCtl_qSetUnBal InjMassCyc 12 0.00 327.6700 FORMAT "%8.4" EXTENDED_LIMITS -327.6800 327.6700 DEPOSIT ABSOLUTE /end AXIS_DESCR
/end CHARACTERISTIC
/begin CHARACTERISTIC PFlt_tExhGsStyRgn2_MAP "static soot emission" MAP 0xF2162 Kf_Xs16_Ys16_Ws16 700.0000 TempDiff_Cels 100.0000 800.0000 FORMAT "%8.4" EXTENDED_LIMITS -3276.800 3276.700
 /begin AXIS_DESCR STD_AXIS Eng_nAvrg EngN 12 40.00000 6000.000 FORMAT "%8.3" EXTENDED_LIMITS -32768.00 32767.00 DEPOSIT ABSOLUTE /end AXIS_DESCR
 /begin AXIS_DESCR STD_AXIS InjCtl_qSetUnBal InjMassCyc 12 0.00 327.6700 FORMAT "%8.4" EXTENDED_LIMITS -327.6800 327.6700 DEPOSIT ABSOLUTE /end AXIS_DESCR
/end CHARACTERISTIC
/begin CHARACTERISTIC PFlt_tExhGsSty_MAP "Kennfeld für Stationärtemperaturen" MAP 0xF22B6 Kf_Xs16_Ys16_Ws16 950.0000 Temp_Cels -50.1400 899.8600 FORMAT "%8.4" EXTENDED_LIMITS -3549.940 3003.560
 /begin AXIS_DESCR STD_AXIS Eng_nAvrg EngN 12 40.00000 6000.000 FORMAT "%8.3" EXTENDED_LIMITS -32768.00 32767.00 DEPOSIT ABSOLUTE /end AXIS_DESCR
 /begin AXIS_DESCR STD_AXIS InjCtl_qSetUnBal InjMassCyc 12 0.00 327.6700 FORMAT "%8.4" EXTENDED_LIMITS -327.6800 327.6700 DEPOSIT ABSOLUTE /end AXIS_DESCR
/end CHARACTERISTIC
/begin CHARACTERISTIC PFlt_tFrzMin_C "Minimale Temperatur, unter der vor einem Einfrieren des Drucksensors gewarnt wird" VALUE 0xF171E Kw_Ws16 950.0000 Temp_Cels -50.14000 899.8600 FORMAT "%8.4" EXTENDED_LIMITS -3549.940 3003.560 /end CHARACTERISTIC
/begin CHARACTERISTIC PFlt_tiChkTempPlausMax_CUR "Kennlinie zur Bestimmung des maximalen Zeitfensters zur Durchführung der Temp.-Plausibilisierung" CURVE 0xF1720 Kl_Xs16_Ws16 5.000000 Time_s 0.00 5.000000 FORMAT "%8.6" EXTENDED_LIMITS -327.6800 327.6700
 /begin AXIS_DESCR STD_AXIS BattCD_u Volt_Batt 8 0.00 5004.888 FORMAT "%8.3" EXTENDED_LIMITS -640625.6 640606.1 DEPOSIT ABSOLUTE /end AXIS_DESCR
/end CHARACTERISTIC
/begin CHARACTERISTIC PFlt_tiDebAftRunTst_C "Entprellzeit der Nachlaufbedingung zur Freigabe der Druck-Plausibilitätsprüfungen" VALUE 0xF1B8A Kw_Wu16 1000.000 Time_ms 0.00 1000.000 FORMAT "%8.3" EXTENDED_LIMITS 0.00 655350.0 /end CHARACTERISTIC
/begin CHARACTERISTIC PFlt_DebCharMaxDef_C "Entprellzeit setzen Strömungswiderstand SRC high" VALUE 0xF1742 Kw_Wu16 1000.000 Time_ms 0.00 1000.000 FORMAT "%8.3" EXTENDED_LIMITS 0.00 655350.0 /end CHARACTERISTIC
/begin CHARACTERISTIC PFlt_DebCharMaxOk_C "Entprellzeit heilen Strömungswiderstand SRC high" VALUE 0xF1744 Kw_Wu16 1000.000 Time_ms 0.00 1000.000 FORMAT "%8.3" EXTENDED_LIMITS 0.00 655350.0 /end CHARACTERISTIC
/begin CHARACTERISTIC PFlt_DebCharMinDef_C "Entprellzeit setzen Strömungswiderstand SRC low" VALUE 0xF1746 Kw_Wu16 1000.000 Time_ms 0.00 1000.000 FORMAT "%8.3" EXTENDED_LIMITS 0.00 655350.0 /end CHARACTERISTIC
/begin CHARACTERISTIC PFlt_DebCharMinOk_C "Entprellzeit heilen Strömungswiderstand SRC low" VALUE 0xF1748 Kw_Wu16 1000.000 Time_ms 0.00 1000.000 FORMAT "%8.3" EXTENDED_LIMITS 0.00 655350.0 /end CHARACTERISTIC
/begin CHARACTERISTIC PFlt_DebEngPrtMaxDef_C "Entprellzeit setzen Motorschutz-Fehler" VALUE 0xF174A Kw_Wu16 1000.000 Time_ms 0.00 1000.000 FORMAT "%8.3" EXTENDED_LIMITS 0.00 655350.0 /end CHARACTERISTIC
/begin CHARACTERISTIC PFlt_DebEngPrtMaxOk_C "Entprellzeit heilen Motorschutz-Fehler" VALUE 0xF174C Kw_Wu16 1000.000 Time_ms 0.00 1000.000 FORMAT "%8.3" EXTENDED_LIMITS 0.00 655350.0 /end CHARACTERISTIC
/begin CHARACTERISTIC PFlt_tiDebLoIdl_C "Entprellzeit der Leerlaufbedingung zur Freigabe der Druck-Plausibilitätsprüfungen" VALUE 0xF1B8C Kw_Wu16 1000.000 Time_ms 0.00 1000.000 FORMAT "%8.3" EXTENDED_LIMITS 0.00 655350.0 /end CHARACTERISTIC
/begin CHARACTERISTIC PFlt_DebmSotMaxDef_C "Debouncing time for defect recognition of unsuccessful regeneration" VALUE 0xF1B8E Kw_Wu16 20000.00 Time_ms 0.00 20000.00 FORMAT "%8.2" EXTENDED_LIMITS 0.00 655350.0 /end CHARACTERISTIC
/begin CHARACTERISTIC PFlt_DebmSotMaxOk_C "Debouncing time for error healing of unsuccessful regeneration" VALUE 0xF1B90 Kw_Wu16 20000.00 Time_ms 0.00 20000.00 FORMAT "%8.2" EXTENDED_LIMITS 0.00 655350.0 /end CHARACTERISTIC
/begin CHARACTERISTIC PFlt_DebOxiPreMaxDef_C "Defekterkennungszeit für den tOxiPre MAX Fehler" VALUE 0xF1B92 Kw_Wu16 20000.00 Time_ms 0.00 20000.00 FORMAT "%8.2" EXTENDED_LIMITS 0.00 655350.0 /end CHARACTERISTIC
/begin CHARACTERISTIC PFlt_DebOxiPreMaxOk_C "Heilungszeit für den tOxiPre MAX Fehler" VALUE 0xF1B94 Kw_Wu16 20000.00 Time_ms 0.00 20000.00 FORMAT "%8.2" EXTENDED_LIMITS 0.00 655350.0 /end CHARACTERISTIC
/begin CHARACTERISTIC PFlt_DebOxiPreNplDef_C "Defekterkennungszeit für den tOxiPre NPL Fehler" VALUE 0xF1B96 Kw_Wu16 20000.00 Time_ms 0.00 20000.00 FORMAT "%8.2" EXTENDED_LIMITS 0.00 655350.0 /end CHARACTERISTIC
/begin CHARACTERISTIC PFlt_DebOxiPreNplOk_C "Heilungszeit für den tOxiPre NPL Fehler" VALUE 0xF1B98 Kw_Wu16 20000.00 Time_ms 0.00 20000.00 FORMAT "%8.2" EXTENDED_LIMITS 0.00 655350.0 /end CHARACTERISTIC
/begin CHARACTERISTIC PFlt_DebOxiPreRgnMaxDef_C "Defekterkennungszeit für den tOxiPre MAX Fehler während der Regeneration" VALUE 0xF1B9A Kw_Wu16 20000.00 Time_ms 0.00 20000.00 FORMAT "%8.2" EXTENDED_LIMITS 0.00 655350.0 /end CHARACTERISTIC
/begin CHARACTERISTIC PFlt_DebOxiPreRgnMaxOk_C "Heilungszeit für den tOxiPre MAX Fehler während der Regeneration" VALUE 0xF1B9C Kw_Wu16 20000.00 Time_ms 0.00 20000.00 FORMAT "%8.2" EXTENDED_LIMITS 0.00 655350.0 /end CHARACTERISTIC
/begin CHARACTERISTIC PFlt_DebPreMaxDef_C "Defekterkennungszeit für den tPre MAX Fehler" VALUE 0xF1B9E Kw_Wu16 20000.00 Time_ms 0.00 20000.00 FORMAT "%8.2" EXTENDED_LIMITS 0.00 655350.0 /end CHARACTERISTIC
/begin CHARACTERISTIC PFlt_DebPreMaxOk_C "Heilungszeit für den tPre MAX Fehler" VALUE 0xF1BA0 Kw_Wu16 20000.00 Time_ms 0.00 20000.00 FORMAT "%8.2" EXTENDED_LIMITS 0.00 655350.0 /end CHARACTERISTIC
/begin CHARACTERISTIC PFlt_DebPreNplDef_C "Defekterkennungszeit für den tPre NPL Fehler" VALUE 0xF1BA2 Kw_Wu16 20000.00 Time_ms 0.00 20000.00 FORMAT "%8.2" EXTENDED_LIMITS 0.00 655350.0 /end CHARACTERISTIC
/begin CHARACTERISTIC PFlt_DebPreNplOk_C "Heilungszeit für den tPre NPL Fehler" VALUE 0xF1BA4 Kw_Wu16 20000.00 Time_ms 0.00 20000.00 FORMAT "%8.2" EXTENDED_LIMITS 0.00 655350.0 /end CHARACTERISTIC
/begin CHARACTERISTIC PFlt_DebPreRgnMaxDef_C "Entprellzeit für die Erkennung einen unvollständigen regeneration" VALUE 0xF1BA6 Kw_Wu16 20000.00 Time_ms 0.00 20000.00 FORMAT "%8.2" EXTENDED_LIMITS 0.00 655350.0 /end CHARACTERISTIC
/begin CHARACTERISTIC PFlt_DebPreRgnMaxOk_C "Entprellzeit für die Fehlerheilung" VALUE 0xF1BA8 Kw_Wu16 20000.00 Time_ms 0.00 20000.00 FORMAT "%8.2" EXTENDED_LIMITS 0.00 655350.0 /end CHARACTERISTIC
/begin CHARACTERISTIC PFlt_tiDebPresDblDef_C "Entprellzeit für APS BPS pPre Druck Plausibilitätsdoppeldefekt" VALUE 0xF1BAA Kw_Wu16 1000.000 Time_ms 0.00 1000.000 FORMAT "%8.3" EXTENDED_LIMITS 0.00 655350.0 /end CHARACTERISTIC
/begin CHARACTERISTIC PFlt_DebPDiffDynPlausDef_C "Entprellzeit setzen dynamischer Fehler Differenzdruck" VALUE 0xF174E Kw_Wu16 1000.000 Time_ms 0.00 1000.000 FORMAT "%8.3" EXTENDED_LIMITS 0.00 655350.0 /end CHARACTERISTIC
/begin CHARACTERISTIC PFlt_DebPDiffDynPlausOk_C "Entprellzeit heilen dynamischer Fehler Differenzdruck" VALUE 0xF1750 Kw_Wu16 1000.000 Time_ms 0.00 1000.000 FORMAT "%8.3" EXTENDED_LIMITS 0.00 655350.0 /end CHARACTERISTIC
/begin CHARACTERISTIC PFlt_tiDebPresPlausOk_C "Entprellzeit für APS BPS pPre Druck Plausibilitätsprüfungen" VALUE 0xF1BAC Kw_Wu16 1000.000 Time_ms 0.00 1000.000 FORMAT "%8.3" EXTENDED_LIMITS 0.00 655350.0 /end CHARACTERISTIC
/begin CHARACTERISTIC PFlt_DebHsLnPlausDef_C "Entprellzeit setzen Plausibilisierungsfehler Schlauchleitung" VALUE 0xF1752 Kw_Wu16 1000.000 Time_ms 0.00 1000.000 FORMAT "%8.3" EXTENDED_LIMITS 0.00 655350.0 /end CHARACTERISTIC
/begin CHARACTERISTIC PFlt_DebHsLnPlausOk_C "Entprellzeit heilen Plausibilisierungsfehler Schlauchleitung" VALUE 0xF1754 Kw_Wu16 1000.000 Time_ms 0.00 1000.000 FORMAT "%8.3" EXTENDED_LIMITS 0.00 655350.0 /end CHARACTERISTIC
/begin CHARACTERISTIC PFlt_DebPDiffMaxDef_C "Entprellzeit setzen Drucksensoren SRC high" VALUE 0xF1756 Kw_Wu16 1000.000 Time_ms 0.00 1000.000 FORMAT "%8.3" EXTENDED_LIMITS 0.00 655350.0 /end CHARACTERISTIC
/begin CHARACTERISTIC PFlt_DebPDiffMaxOk_C "Entprellzeit heilen Drucksensoren SRC high" VALUE 0xF1758 Kw_Wu16 1000.000 Time_ms 0.00 1000.000 FORMAT "%8.3" EXTENDED_LIMITS 0.00 655350.0 /end CHARACTERISTIC
/begin CHARACTERISTIC PFlt_DebPDiffMinDef_C "Entprellzeit setzen Drucksensoren SRC low" VALUE 0xF175A Kw_Wu16 1000.000 Time_ms 0.00 1000.000 FORMAT "%8.3" EXTENDED_LIMITS 0.00 655350.0 /end CHARACTERISTIC
/begin CHARACTERISTIC PFlt_DebPDiffMinOk_C "Entprellzeit heilen Drucksensoren SRC low" VALUE 0xF175C Kw_Wu16 1000.000 Time_ms 0.00 1000.000 FORMAT "%8.3" EXTENDED_LIMITS 0.00 655350.0 /end CHARACTERISTIC
/begin CHARACTERISTIC PFlt_DebSotPlausDef_C "Entprellzeit setzen Plausibilisierungsfehler Versottung" VALUE 0xF175E Kw_Wu16 1000.000 Time_ms 0.00 1000.000 FORMAT "%8.3" EXTENDED_LIMITS 0.00 655350.0 /end CHARACTERISTIC
/begin CHARACTERISTIC PFlt_DebSotPlausOk_C "Entprellzeit heilen Plausibilisierungsfehler Versottung" VALUE 0xF1760 Kw_Wu16 1000.000 Time_ms 0.00 1000.000 FORMAT "%8.3" EXTENDED_LIMITS 0.00 655350.0 /end CHARACTERISTIC
/begin CHARACTERISTIC PFlt_DebRgnPermMaxDef_C "Entprellzeit setzen permanente Regeneration" VALUE 0xF1762 Kw_Wu16 1000.000 Time_ms 0.00 1000.000 FORMAT "%8.3" EXTENDED_LIMITS 0.00 655350.0 /end CHARACTERISTIC
/begin CHARACTERISTIC PFlt_DebRgnPermMaxOk_C "Entprellzeit heilen permanente Regeneration" VALUE 0xF1764 Kw_Wu16 1000.000 Time_ms 0.00 1000.000 FORMAT "%8.3" EXTENDED_LIMITS 0.00 655350.0 /end CHARACTERISTIC
/begin CHARACTERISTIC PFlt_tiDebT15On_C "Entprellzeit der T15 EIN Bedingung zur Freigabe der Plausibilitätsprüfungen" VALUE 0xF1BAE Kw_Wu16 1000.000 Time_ms 0.00 1000.000 FORMAT "%8.3" EXTENDED_LIMITS 0.00 655350.0 /end CHARACTERISTIC
/begin CHARACTERISTIC PFlt_DebTEGMaxDef_C "Entprellzeit setzen Temperatursensoren SRC high" VALUE 0xF1766 Kw_Wu16 1000.000 Time_ms 0.00 1000.000 FORMAT "%8.3" EXTENDED_LIMITS 0.00 655350.0 /end CHARACTERISTIC
/begin CHARACTERISTIC PFlt_DebTEGMaxOk_C "Entprellzeit heilen Temperatursensoren SRC high" VALUE 0xF1768 Kw_Wu16 1000.000 Time_ms 0.00 1000.000 FORMAT "%8.3" EXTENDED_LIMITS 0.00 655350.0 /end CHARACTERISTIC
/begin CHARACTERISTIC PFlt_DebTEGMinDef_C "Entprellzeit setzen Temperatursensoren SRC low" VALUE 0xF176A Kw_Wu16 1000.000 Time_ms 0.00 1000.000 FORMAT "%8.3" EXTENDED_LIMITS 0.00 655350.0 /end CHARACTERISTIC
/begin CHARACTERISTIC PFlt_DebTEGMinOk_C "Entprellzeit heilen Temperatursensoren SRC low" VALUE 0xF176C Kw_Wu16 1000.000 Time_ms 0.00 1000.000 FORMAT "%8.3" EXTENDED_LIMITS 0.00 655350.0 /end CHARACTERISTIC
/begin CHARACTERISTIC PFlt_tiDelOfsCalc_C "Verzögerungszeit zur Berechnung des Differenzdrucksensoroffsets im Motornachlauf" VALUE 0xF176E Kw_Wu16 99.30000 Time_s 0.7000000 100.0000 FORMAT "%8.4" EXTENDED_LIMITS 0.00 655.3500 /end CHARACTERISTIC
/begin CHARACTERISTIC PFlt_tiExhGsDel_CUR "Abgasstromverzögerung" CURVE 0xF240A Kl_Xs16_Ws16 10.01007 TimeDelay_s_Lin_16_2 0.00 10.01007 FORMAT "%8.5" EXTENDED_LIMITS -2000.061 2000.000
 /begin AXIS_DESCR STD_AXIS PFlt_dmEG AirMassPerTime 8 -1000.000 1000.000 FORMAT "%8.3" EXTENDED_LIMITS -3276.800 3276.700 DEPOSIT ABSOLUTE /end AXIS_DESCR
/end CHARACTERISTIC
/begin CHARACTERISTIC PFlt_tiFstEngPrtRgnMax_C "Schwelle zum Zurücksetzen des Zählers für Regeneration wegen Motorschutz" VALUE 0xF1BB0 Kw_Wu32 4294967295.00 TimeEngOn 0.00 4294967295.00 FORMAT "%13.2" /end CHARACTERISTIC
/begin CHARACTERISTIC PFlt_tiHtTransDT1_CUR "Wärmeübertragungszeit" CURVE 0xF242C Kl_Xs16_Ws16 2000.000 TimeDelay_s_Lin_16_2 0.00 2000.000 FORMAT "%8.3" EXTENDED_LIMITS -2000.061 2000.000
 /begin AXIS_DESCR STD_AXIS PFlt_dmEG AirMassPerTime 8 -1000.000 1000.000 FORMAT "%8.3" EXTENDED_LIMITS -3276.800 3276.700 DEPOSIT ABSOLUTE /end AXIS_DESCR
/end CHARACTERISTIC
/begin CHARACTERISTIC PFlt_tiLckChkTempPlaus_C "Verriegelungszeit Temperatursensorplausibilisierung nach kurzem Motorlauf" VALUE 0xF1770 Kw_Wu16 50.00000 Time_s 50.00000 100.0000 FORMAT "%8.4" EXTENDED_LIMITS 0.00 655.3500 /end CHARACTERISTIC
/begin CHARACTERISTIC PFlt_tiLoIdlSnceRgnMax_C "Zeit seit letzter erfolgreicher Regeneration, nach der Plausibilitätsprüfungen freigegeben werden" VALUE 0xF1BB4 Kw_Wu32 4294967295.00 TimeEngOn 0.00 4294967295.00 FORMAT "%13.2" /end CHARACTERISTIC
/begin CHARACTERISTIC PFlt_tIncrDwnStrm_C "Korrekturwert Erwärmung zweite Abgastemperatur zur Überwachung" VALUE 0xF1772 Kw_Ws16 300.0000 TempDiff_Cels 0.00 300.0000 FORMAT "%8.4" EXTENDED_LIMITS -3276.800 3276.700 /end CHARACTERISTIC
/begin CHARACTERISTIC PFlt_tIncrUpStrm_C "Korrekturwert Erwärmung erste Abgastemperatur zur Überwachung" VALUE 0xF1774 Kw_Ws16 300.0000 TempDiff_Cels 0.00 300.0000 FORMAT "%8.4" EXTENDED_LIMITS -3276.800 3276.700 /end CHARACTERISTIC
/begin CHARACTERISTIC PFlt_tiPFltOvld1PT1_C "Zeitkonstante für Überladungserkennung" VALUE 0xF1BB8 Kw_Wu32 4294.9673 TimeDelay_s 0.0000010000000 4294.9673 FORMAT "%9.4" /end CHARACTERISTIC
/begin CHARACTERISTIC PFlt_tiPFltOvld2PT1_C "Zeitkonstante für Überladungserkennung" VALUE 0xF1BBC Kw_Wu32 4294.9673 TimeDelay_s 0.0000010000000 4294.9673 FORMAT "%9.4" /end CHARACTERISTIC
/begin CHARACTERISTIC PFlt_tiPPrePT1_C "Filterzeitkonstante für gefilterten Absolutdruck vor Partikelfilter" VALUE 0xF1F28 Kw_Wu32 99.582970 TimeDelay_s 0.29999073 99.882960 FORMAT "%9.5" EXTENDED_LIMITS 0.0000010000000 4294.9673 /end CHARACTERISTIC
/begin CHARACTERISTIC PFlt_tiFltHsLnPT1_C "Filterzeitkonstante Signalfilterung für Schlauchleitungsüberwachung" VALUE 0xF1778 Kw_Wu32 4294.9673 TimeDelay_s 0.0000010000000 4294.9673 FORMAT "%9.4" /end CHARACTERISTIC
/begin CHARACTERISTIC PFlt_titPrePhysPT1_C "Zeitkonstante des PT1-Filters zur Filterung von PFlt_tOxiPre." VALUE 0xF1F2C Kw_Wu32 330.28210 TimeDelay_s 0.099999239 330.38210 FORMAT "%9.5" EXTENDED_LIMITS 0.0000010000000 4294.9673 /end CHARACTERISTIC
/begin CHARACTERISTIC PFlt_tOxiPreDiffMax_MAP "Schwelle für Maximale Differenztemperatur  den tOxiPre" MAP 0xF1BC0 Kf_Xs16_Ys16_Ws16 950.0000 Temp_Cels -50.1400 899.8600 FORMAT "%8.4" EXTENDED_LIMITS -3549.940 3003.560
 /begin AXIS_DESCR STD_AXIS Eng_nAvrg EngN 12 40.00000 6000.000 FORMAT "%8.3" EXTENDED_LIMITS -32768.00 32767.00 DEPOSIT ABSOLUTE /end AXIS_DESCR
 /begin AXIS_DESCR STD_AXIS InjCtl_qSetUnBal InjMassCyc 12 0.00 327.6700 FORMAT "%8.4" EXTENDED_LIMITS -327.6800 327.6700 DEPOSIT ABSOLUTE /end AXIS_DESCR
/end CHARACTERISTIC
/begin CHARACTERISTIC PFlt_tiOxiPreStyPT1_C " Zeitkonstant des PT1-Gliedes für stationäre Abgastemperatur vor dem Oxi-Kat" VALUE 0xF2450 Kw_Wu32 4294.9673 TimeDelay_s 0.0000010000000 4294.9673 FORMAT "%9.4" /end CHARACTERISTIC
/begin CHARACTERISTIC PFlt_tPreDiffMax_MAP "Schwelle für Maximale Differenztemperatur" MAP 0xF1D14 Kf_Xs16_Ys16_Ws16 950.0000 Temp_Cels -50.1400 899.8600 FORMAT "%8.4" EXTENDED_LIMITS -3549.940 3003.560
 /begin AXIS_DESCR STD_AXIS Eng_nAvrg EngN 12 40.00000 6000.000 FORMAT "%8.3" EXTENDED_LIMITS -32768.00 32767.00 DEPOSIT ABSOLUTE /end AXIS_DESCR
 /begin AXIS_DESCR STD_AXIS InjCtl_qSetUnBal InjMassCyc 12 0.00 327.6700 FORMAT "%8.4" EXTENDED_LIMITS -327.6800 327.6700 DEPOSIT ABSOLUTE /end AXIS_DESCR
/end CHARACTERISTIC
/begin CHARACTERISTIC PFlt_tiFltTempPT1_C "Filterzeitkonstante für Oberflächentemperatursimulation" VALUE 0xF2454 Kw_Wu32 4294.9673 TimeDelay_s 0.0000010000000 4294.9673 FORMAT "%9.4" /end CHARACTERISTIC
/begin CHARACTERISTIC PFlt_tiPreStyPT1_C "Zeitkonstant des PT1-Gliedes für stationäre Abgastemperatur vor dem Partikelfilter" VALUE 0xF2458 Kw_Wu32 4294.9673 TimeDelay_s 0.0000010000000 4294.9673 FORMAT "%9.4" /end CHARACTERISTIC
/begin CHARACTERISTIC PFlt_tRefSty_C "Referenztemperatur für das Festlegen des Abgastemperaturenkennfeldes" VALUE 0xF245C Kw_Ws16 250.0000 Temp_Cels -50.1400 199.8600 FORMAT "%8.4" EXTENDED_LIMITS -3549.940 3003.560 /end CHARACTERISTIC
/begin CHARACTERISTIC PFlt_tThresOxiPreMax_C "Grenzwert für die Fehlerpfadaktivierung" VALUE 0xF1E68 Kw_Ws16 950.0000 Temp_Cels -50.1400 899.8600 FORMAT "%8.4" EXTENDED_LIMITS -3549.940 3003.560 /end CHARACTERISTIC
/begin CHARACTERISTIC PFlt_tThresOxiPreRgnMax_C "Grenzwert zum Setzen eines Fehlerpfades im regenerationsfall" VALUE 0xF1E6A Kw_Ws16 950.0000 Temp_Cels -50.1400 899.8600 FORMAT "%8.4" EXTENDED_LIMITS -3549.940 3003.560 /end CHARACTERISTIC
/begin CHARACTERISTIC PFlt_tThresPreMax_C "Grenzwert von PFlt_tPre zum setzen eines Fehlerpfades" VALUE 0xF1E6C Kw_Ws16 950.0000 Temp_Cels -50.1400 899.8600 FORMAT "%8.4" EXTENDED_LIMITS -3549.940 3003.560 /end CHARACTERISTIC
/begin CHARACTERISTIC PFlt_tThresPreRgnMax_C "Grenzwert von PFlt_tPre zum Setzen eines Fehlerpfades im Regenerationsfall" VALUE 0xF1E6E Kw_Ws16 950.0000 Temp_Cels -50.1400 899.8600 FORMAT "%8.4" EXTENDED_LIMITS -3549.940 3003.560 /end CHARACTERISTIC
/begin CHARACTERISTIC PFlt_tUpStrmTolcMax_C "Maximal zulässige Toleranz bei Plausibilisierung des ersten Abgastemperatursensors" VALUE 0xF177C Kw_Ws16 250.2000 TempDiff_Cels -50.10000 200.1000 FORMAT "%8.4" EXTENDED_LIMITS -3276.800 3276.700 /end CHARACTERISTIC
/begin CHARACTERISTIC PFlt_vLoIdlSpeedMax_C "VSSCD_v Grenze für Plausibilitätstests im Leerlaufzustand" VALUE 0xF1E70 Kw_Ws16 655.3500 Vel -327.6800 327.6700 FORMAT "%8.4" /end CHARACTERISTIC
/begin CHARACTERISTIC PFlt_vPFltOvldHeal_C "VSSCD_v Schwelle für Fehlerheilung" VALUE 0xF1E72 Kw_Ws16 655.3500 Vel -327.6800 327.6700 FORMAT "%8.4" /end CHARACTERISTIC
/begin CHARACTERISTIC PrpCtl_facSpdCorr_C "Faktor zur Fahrzeuggeschwindigkeitskorrektur" VALUE 0xF281C Kw_Ws16 1.000000 FactLow 0.5000000 1.500000 FORMAT "%8.6" EXTENDED_LIMITS -32.00000 31.99902 /end CHARACTERISTIC
/begin CHARACTERISTIC PrpCtl_SpdLim4IKi_C "Regler I-Anteil 4. Gang" VALUE 0xF2820 Kw_Wu32 19999999.9953 Ki_Vel2TrqPrp 0.00 19999999.9953 FORMAT "%13.4" /end CHARACTERISTIC
/begin CHARACTERISTIC PrpCtl_SpdLim4IKiPos_C "Regler I-Anteil für positive Großsignale 4. Gang" VALUE 0xF2824 Kw_Wu32 19999999.9953 Ki_Vel2TrqPrp 0.00 19999999.9953 FORMAT "%13.4" /end CHARACTERISTIC
/begin CHARACTERISTIC PrpCtl_SpdLim4IKiNeg_C "Regler I-Anteil für negative Großsignale 4. Gang" VALUE 0xF2828 Kw_Wu32 19999999.9953 Ki_Vel2TrqPrp 0.00 19999999.9953 FORMAT "%13.4" /end CHARACTERISTIC
/begin CHARACTERISTIC PrpCtl_vSpdLim4IWinPos_C "obere Fenstergrenze für I-Anteil Kleinsignale 4.Gang" VALUE 0xF282C Kw_Ws16 300.0000 Vel 0.00 300.0000 FORMAT "%8.4" EXTENDED_LIMITS -327.6800 327.6700 /end CHARACTERISTIC
/begin CHARACTERISTIC PrpCtl_vSpdLim4IWinNeg_C "untere Fenstergrenze für I-Anteil Kleinsignale 4.Gang" VALUE 0xF282E Kw_Ws16 300.0000 Vel -300.0000 0.00 FORMAT "%8.4" EXTENDED_LIMITS -327.6800 327.6700 /end CHARACTERISTIC
/begin CHARACTERISTIC PrpCtl_SpdLim4PKp_C "Regler P-Anteil 4. Gang" VALUE 0xF2830 Kw_Wu32 1310719.99969 Kp_Vel2TrqPrp 0.00 1310719.99969 FORMAT "%13.5" /end CHARACTERISTIC
/begin CHARACTERISTIC PrpCtl_SpdLim4PKpPos_C "Regler P-Anteil für positive Großsignale 4. Gang" VALUE 0xF2834 Kw_Wu32 1310719.99969 Kp_Vel2TrqPrp 0.00 1310719.99969 FORMAT "%13.5" /end CHARACTERISTIC
/begin CHARACTERISTIC PrpCtl_SpdLim4PKpNeg_C "Regler P-Anteil für negative Großsignale 4. Gang" VALUE 0xF2838 Kw_Wu32 1310719.99969 Kp_Vel2TrqPrp 0.00 1310719.99969 FORMAT "%13.5" /end CHARACTERISTIC
/begin CHARACTERISTIC PrpCtl_vSpdLim4PWinPos_C "obere Fenstergrenze für P-Anteil Kleinsignale 4.Gang" VALUE 0xF283C Kw_Ws16 300.0000 Vel 0.00 300.0000 FORMAT "%8.4" EXTENDED_LIMITS -327.6800 327.6700 /end CHARACTERISTIC
/begin CHARACTERISTIC PrpCtl_vSpdLim4PWinNeg_C "untere Fenstergrenze für P-Anteil Kleinsignale 4.Gang" VALUE 0xF283E Kw_Ws16 300.0000 Vel -300.0000 0.00 FORMAT "%8.4" EXTENDED_LIMITS -327.6800 327.6700 /end CHARACTERISTIC
/begin CHARACTERISTIC PrpCtl_SpdLim5IKi_C "Regler I-Anteil 5. Gang" VALUE 0xF2840 Kw_Wu32 19999999.9953 Ki_Vel2TrqPrp 0.00 19999999.9953 FORMAT "%13.4" /end CHARACTERISTIC
/begin CHARACTERISTIC PrpCtl_SpdLim5IKiPos_C "Regler I-Anteil für positive Großsignale 5. Gang" VALUE 0xF2844 Kw_Wu32 19999999.9953 Ki_Vel2TrqPrp 0.00 19999999.9953 FORMAT "%13.4" /end CHARACTERISTIC
/begin CHARACTERISTIC PrpCtl_SpdLim5IKiNeg_C "Regler I-Anteil für negative Großsignale 5. Gang" VALUE 0xF2848 Kw_Wu32 19999999.9953 Ki_Vel2TrqPrp 0.00 19999999.9953 FORMAT "%13.4" /end CHARACTERISTIC
/begin CHARACTERISTIC PrpCtl_vSpdLim5IWinPos_C "obere Fenstergrenze für I-Anteil Kleinsignale 5.Gang" VALUE 0xF284C Kw_Ws16 300.0000 Vel 0.00 300.0000 FORMAT "%8.4" EXTENDED_LIMITS -327.6800 327.6700 /end CHARACTERISTIC
/begin CHARACTERISTIC PrpCtl_vSpdLim5IWinNeg_C "untere Fenstergrenze für I-Anteil Kleinsignale 5.Gang" VALUE 0xF284E Kw_Ws16 300.0000 Vel -300.0000 0.00 FORMAT "%8.4" EXTENDED_LIMITS -327.6800 327.6700 /end CHARACTERISTIC
/begin CHARACTERISTIC PrpCtl_SpdLim5PKp_C "Regler P-Anteil 5. Gang" VALUE 0xF2850 Kw_Wu32 1310719.99969 Kp_Vel2TrqPrp 0.00 1310719.99969 FORMAT "%13.5" /end CHARACTERISTIC
/begin CHARACTERISTIC PrpCtl_SpdLim5PKpPos_C "Regler P-Anteil für positive Großsignale 5. Gang" VALUE 0xF2854 Kw_Wu32 1310719.99969 Kp_Vel2TrqPrp 0.00 1310719.99969 FORMAT "%13.5" /end CHARACTERISTIC
/begin CHARACTERISTIC PrpCtl_SpdLim5PKpNeg_C "Regler P-Anteil für negative Großsignale 5. Gang" VALUE 0xF2858 Kw_Wu32 1310719.99969 Kp_Vel2TrqPrp 0.00 1310719.99969 FORMAT "%13.5" /end CHARACTERISTIC
/begin CHARACTERISTIC PrpCtl_vSpdLim5PWinPos_C "obere Fenstergrenze für P-Anteil Kleinsignale 5.Gang" VALUE 0xF285C Kw_Ws16 300.0000 Vel 0.00 300.0000 FORMAT "%8.4" EXTENDED_LIMITS -327.6800 327.6700 /end CHARACTERISTIC
/begin CHARACTERISTIC PrpCtl_vSpdLim5PWinNeg_C "untere Fenstergrenze für P-Anteil Kleinsignale 5.Gang" VALUE 0xF285E Kw_Ws16 300.0000 Vel -300.0000 0.00 FORMAT "%8.4" EXTENDED_LIMITS -327.6800 327.6700 /end CHARACTERISTIC
/begin CHARACTERISTIC PrpCtl_tiSpdLimPT1_C "Zeitkonstante PT1-Glied" VALUE 0xF2860 Kw_Wu32 4294.9673 TimeDelay_s 0.0000010000000 4294.9673 FORMAT "%9.4" /end CHARACTERISTIC
/begin CHARACTERISTIC PrpCtl_swtSpdLimVal_C "Datensatzwert für PrpCtl_swtSpdLim für Activierung (1) oder Deaktivierung (0) der Geschwindigkeitsbegrenzung" VALUE 0xF2864 Kw_Wu8 1.000 OneToOne 0.00 1.000 FORMAT "%5.3" EXTENDED_LIMITS 0.00 255.0 /end CHARACTERISTIC
/begin CHARACTERISTIC PrpCtl_swtSpdLimType_C "Auswahlschalter für PrpCtl_swtSpdLim bei Ini: E2PROM(1) oder PrpCtl_swtSpdLimVal_C(2)" VALUE 0xF2865 Kw_Wu8 1.000 OneToOne 1.000 2.000 FORMAT "%5.3" EXTENDED_LIMITS 0.00 255.0 /end CHARACTERISTIC
/begin CHARACTERISTIC PrpCtl_vSpdLimMax_C "Fahrzeughöchstgeschwindigkeit" VALUE 0xF2866 Kw_Ws16 300.0000 Vel 0.00 300.0000 FORMAT "%8.4" EXTENDED_LIMITS -327.6800 327.6700 /end CHARACTERISTIC
/begin CHARACTERISTIC PrpCtl_vSpdLimThreshFree_C "Schwellwert Sollwertnachführung frei laufend" VALUE 0xF2868 Kw_Ws16 300.0000 Vel 0.00 300.0000 FORMAT "%8.4" EXTENDED_LIMITS -327.6800 327.6700 /end CHARACTERISTIC
/begin CHARACTERISTIC PrpCtl_vSpdLimThreshOff_C "Schwellwert Sollwertnachführung ausgeschalten" VALUE 0xF286A Kw_Ws16 300.0000 Vel 0.00 300.0000 FORMAT "%8.4" EXTENDED_LIMITS -327.6800 327.6700 /end CHARACTERISTIC
/begin CHARACTERISTIC PrpCtl_vSpdLimThreshOn_C "Schwellwert Sollwertnachführung eingeschalten" VALUE 0xF286C Kw_Ws16 300.0000 Vel 0.00 300.0000 FORMAT "%8.4" EXTENDED_LIMITS -327.6800 327.6700 /end CHARACTERISTIC
/begin CHARACTERISTIC Prp_rEng_MAP "inverses Fahrverhaltenkennfeld für konventionelle Triebstrangsteuerung" MAP 0xF2584 Kf_Xs16_Ys16_Ws16 799.9878 Prc -400.0000 399.9878 FORMAT "%8.4"
 /begin AXIS_DESCR STD_AXIS Eng_nAvrg EngN 16 -32768.00 32767.00 FORMAT "%8.2" DEPOSIT ABSOLUTE /end AXIS_DESCR
 /begin AXIS_DESCR STD_AXIS Prp_trqEng Trq 16 -3276.800 3276.700 FORMAT "%8.3" DEPOSIT ABSOLUTE /end AXIS_DESCR
/end CHARACTERISTIC
/begin CHARACTERISTIC Prp_rPrp_MAP "inverses Fahrverhaltenkennfeld für Mastershift" MAP 0xF27C8 Kf_Xs16_Ys16_Ws16 799.9878 Prc -400.0000 399.9878 FORMAT "%8.4"
 /begin AXIS_DESCR STD_AXIS VSSCD_v Vel 1 -327.6800 327.6700 FORMAT "%8.4" DEPOSIT ABSOLUTE /end AXIS_DESCR
 /begin AXIS_DESCR STD_AXIS Prp_trqPrp TrqPrp 1 -6553.600 6553.400 FORMAT "%8.3" DEPOSIT ABSOLUTE /end AXIS_DESCR
/end CHARACTERISTIC
/begin CHARACTERISTIC Prp_swtVirtAPPSel_C "Schalter zur Auswahl der Logik zur Bestimmung des virtuellen AccPed-Wertes" VALUE 0xF27D2 Kw_Ws8 1.000 OneToOne 0.00 1.000 FORMAT "%5.3" EXTENDED_LIMITS -128.0 127.0 /end CHARACTERISTIC
/begin CHARACTERISTIC Prp_trqThresEng_CUR "Schwellwert-Kennlinie zur Unterscheidung zwischen Zug- und Schubbetrieb" CURVE 0xF27D4 Kl_Xs16_Ws16 300.0000 TrqPrp 0.00 300.0000 FORMAT "%8.4" EXTENDED_LIMITS -6553.600 6553.400
 /begin AXIS_DESCR STD_AXIS Eng_nAvrg EngN 16 0.00 6000.000 FORMAT "%8.3" EXTENDED_LIMITS -32768.00 32767.00 DEPOSIT ABSOLUTE /end AXIS_DESCR
/end CHARACTERISTIC
/begin CHARACTERISTIC Prp_trqThresPrp_CUR "Schwellwert-Kennlinie zur Unterscheidung zwischen Zug- und Schubbetrieb" CURVE 0xF2816 Kl_Xs16_Ws16 300.0000 TrqPrp 0.00 300.0000 FORMAT "%8.4" EXTENDED_LIMITS -6553.600 6553.400
 /begin AXIS_DESCR STD_AXIS VSSCD_v Vel 1 0.00 300.0000 FORMAT "%8.4" EXTENDED_LIMITS -327.6800 327.6700 DEPOSIT ABSOLUTE /end AXIS_DESCR
/end CHARACTERISTIC
/begin CHARACTERISTIC PSPCD_ctPwrStgOnMax_C "maximale Anzahl von Endstufen-Einschaltungen pro Fahrzyklus bei SCB oder Übertemperatur" VALUE 0xF28A6 Kw_Wu16 65535.00 OneToOne 0.00 65535.00 FORMAT "%8.2" /end CHARACTERISTIC
/begin CHARACTERISTIC PSPCD_DebExcTempDef_C "Fehlerentprellzeit Uebertemperatur" VALUE 0xF28A8 Kw_Wu16 655350.0 Time_ms 0.00 655350.0 FORMAT "%8.1" /end CHARACTERISTIC
/begin CHARACTERISTIC PSPCD_DebExcTempOk_C "Heilungsentprellzeit Uebertemperatur" VALUE 0xF28AA Kw_Wu16 655350.0 Time_ms 0.00 655350.0 FORMAT "%8.1" /end CHARACTERISTIC
/begin CHARACTERISTIC PSPCD_DebNoLoadDef_C "Fehlerentprellzeit keine Last" VALUE 0xF28AC Kw_Wu16 655350.0 Time_ms 0.00 655350.0 FORMAT "%8.1" /end CHARACTERISTIC
/begin CHARACTERISTIC PSPCD_DebNoLoadOk_C "Heilungsentprellzeit keine Last" VALUE 0xF28AE Kw_Wu16 655350.0 Time_ms 0.00 655350.0 FORMAT "%8.1" /end CHARACTERISTIC
/begin CHARACTERISTIC PSPCD_DebShortCircBatDef_C "Fehlerentprellzeit Kurzschluß nach UBatt" VALUE 0xF28B0 Kw_Wu16 655350.0 Time_ms 0.00 655350.0 FORMAT "%8.1" /end CHARACTERISTIC
/begin CHARACTERISTIC PSPCD_DebShortCircBatOk_C "Heilungsentprellzeit für Kurzschluß nach UBatt" VALUE 0xF28B2 Kw_Wu16 655350.0 Time_ms 0.00 655350.0 FORMAT "%8.1" /end CHARACTERISTIC
/begin CHARACTERISTIC PSPCD_DebShortCircGndDef_C "Fehlerentprellzeit für Kurzschluß nach Masse" VALUE 0xF28B4 Kw_Wu16 655350.0 Time_ms 0.00 655350.0 FORMAT "%8.1" /end CHARACTERISTIC
/begin CHARACTERISTIC PSPCD_DebShortCircGndOk_C "Heilungsentprellzeit für Kurzschluß nach Masse" VALUE 0xF28B6 Kw_Wu16 655350.0 Time_ms 0.00 655350.0 FORMAT "%8.1" /end CHARACTERISTIC
/begin CHARACTERISTIC PSPCD_dvolBase_CUR "Curve to calculate the fuel quantity consumption based on the Engine Speed" CURVE 0xF28B8 Kl_Xs16_Ws16 100.0000 FlConsum_l_h 0.00 100.0000 FORMAT "%8.4" EXTENDED_LIMITS -327.6800 327.6700
 /begin AXIS_DESCR STD_AXIS Eng_nAvrg EngN 16 0.00 6000.000 FORMAT "%8.3" EXTENDED_LIMITS -32768.00 32767.00 DEPOSIT ABSOLUTE /end AXIS_DESCR
/end CHARACTERISTIC
/begin CHARACTERISTIC PSPCD_dvolMax_C "Maximum limit of fuel consumption quantity" VALUE 0xF28FA Kw_Ws16 100.0000 FlConsum_l_h 0.00 100.0000 FORMAT "%8.4" EXTENDED_LIMITS -327.6800 327.6700 /end CHARACTERISTIC
/begin CHARACTERISTIC PSPCD_dvolMin_C "Minimum limit of the  fuel consumption quantity" VALUE 0xF28FC Kw_Ws16 100.0000 FlConsum_l_h 0.00 100.0000 FORMAT "%8.4" EXTENDED_LIMITS -327.6800 327.6700 /end CHARACTERISTIC
/begin CHARACTERISTIC PSPCD_dvolOut1_C "output fuel quantity incase of T15 changes from FALSE to TRUE" VALUE 0xF28FE Kw_Ws16 100.0000 FlConsum_l_h 0.00 100.0000 FORMAT "%8.4" EXTENDED_LIMITS -327.6800 327.6700 /end CHARACTERISTIC
/begin CHARACTERISTIC PSPCD_dvolTempLim_MAP "Map for limiting value of fuel depending on engine speed and fuel temperature" MAP 0xF2900 Kf_Xs16_Ys16_Ws16 100.0000 FlConsum_l_h 0.00 100.0000 FORMAT "%8.4" EXTENDED_LIMITS -327.6800 327.6700
 /begin AXIS_DESCR STD_AXIS Eng_nAvrg EngN 6 40.00000 6000.000 FORMAT "%8.3" EXTENDED_LIMITS -32768.00 32767.00 DEPOSIT ABSOLUTE /end AXIS_DESCR
 /begin AXIS_DESCR STD_AXIS FTSCD_tFuel Temp_Cels 6 -50.14000 199.8600 FORMAT "%8.4" EXTENDED_LIMITS -3549.940 3003.560 DEPOSIT ABSOLUTE /end AXIS_DESCR
/end CHARACTERISTIC
/begin CHARACTERISTIC PSPCD_facFTSCor_CUR "Curve to calculate the factor based on the Fuel temperature" CURVE 0xF2964 Kl_Xs16_Ws16 50.00000 Fact1 0.00 50.00000 FORMAT "%8.5" EXTENDED_LIMITS -256.0000 255.9922
 /begin AXIS_DESCR STD_AXIS FTSCD_tFuel Temp_Cels 8 -50.14000 199.8600 FORMAT "%8.4" EXTENDED_LIMITS -3549.940 3003.560 DEPOSIT ABSOLUTE /end AXIS_DESCR
/end CHARACTERISTIC
/begin CHARACTERISTIC PSPCD_nLim_C "Threshold value for engine speed" VALUE 0xF2986 Kw_Ws16 5960.000 EngN 40.00000 6000.000 FORMAT "%8.3" EXTENDED_LIMITS -32768.00 32767.00 /end CHARACTERISTIC
/begin CHARACTERISTIC PSPCD_numDia_C "#SSD Auswahlparameter für Hardware Diagnose-Pin" VALUE 0xF2988 Kw_Wu8 27.0000000000 NumPinDia 0.00 27.0000000000 FORMAT "%13.10" /end CHARACTERISTIC
/begin CHARACTERISTIC PSPCD_numDioOut_C "#SSD Auswahlparameter für Hardware Digitalausgang-Pin" VALUE 0xF2989 Kw_Wu8 11.0000000000 NumPinDioOut 0.00 11.0000000000 FORMAT "%13.10" /end CHARACTERISTIC
/begin CHARACTERISTIC PSPCD_stInvOut_C "Invertierungsinformation des Digitalausgangs der Partikelfilterheizung" VALUE 0xF298A Kw_Wu8 1.000 OneToOne 0.00 1.000 FORMAT "%5.3" EXTENDED_LIMITS 0.00 255.0 /end CHARACTERISTIC
/begin CHARACTERISTIC PSPCD_stSPICtl_C "Parameter um Endstufentyp festzulegen (1=SPI Endstufe; 0=Non_SPI Endstufe)" VALUE 0xF298B Kw_Wu8 1.000 OneToOne 0.00 1.000 FORMAT "%5.3" EXTENDED_LIMITS 0.00 255.0 /end CHARACTERISTIC
/begin CHARACTERISTIC PSPCD_swtCAN_C "Schalter für PSP über CAN (1) oder PIN (0)" VALUE 0xF298C Kw_Wu8 1.000 OneToOne 0.00 1.000 FORMAT "%5.3" EXTENDED_LIMITS 0.00 255.0 /end CHARACTERISTIC
/begin CHARACTERISTIC PSPCD_tiBtwTst_C "Zeitraster zwischen der Endstufeneinschaltung zur Prüfung der Fehlerbedingung" VALUE 0xF298E Kw_Wu16 655140.0 Time_ms 0.00 655140.0 FORMAT "%8.1" EXTENDED_LIMITS 0.00 655350.0 /end CHARACTERISTIC
/begin CHARACTERISTIC PSPCD_tiPwrStgOn_C "Zeit, für welche die Endstufe beim Fall der nicht-SPI-Endstufe eingeschaltet wird" VALUE 0xF2990 Kw_Wu16 655140.0 Time_ms 0.00 655140.0 FORMAT "%8.1" EXTENDED_LIMITS 0.00 655350.0 /end CHARACTERISTIC
/begin CHARACTERISTIC PSPCD_tiT15Delay_CUR "curve for calculation of time till which timer should run from the coolant temperature" CURVE 0xF2992 Kl_Xs16_Ws16 10000.00 Time_ms 0.00 10000.00 FORMAT "%8.2" EXTENDED_LIMITS -327680.0 327670.0
 /begin AXIS_DESCR STD_AXIS CTSCD_tClnt Temp_Cels 16 -50.14000 199.8600 FORMAT "%8.4" EXTENDED_LIMITS -3549.940 3003.560 DEPOSIT ABSOLUTE /end AXIS_DESCR
/end CHARACTERISTIC
/begin CHARACTERISTIC PSP_nStart_C "Drehzahlschwelle für Shutoff" VALUE 0xF2870 Kw_Ws16 8000.000 EngN 0.00 8000.000 FORMAT "%8.3" EXTENDED_LIMITS -32768.00 32767.00 /end CHARACTERISTIC
/begin CHARACTERISTIC PSP_tiArming_C "Armingzeit" VALUE 0xF2872 Kw_Wu16 1000.000 Time_ms 0.00 1000.000 FORMAT "%8.3" EXTENDED_LIMITS 0.00 655350.0 /end CHARACTERISTIC
/begin CHARACTERISTIC PSP_tiClnt_CUR "swirl control CT correction curve" CURVE 0xF2874 Kl_Xs16_Ws16 100.0000 Time_ms 0.00 100.0000 FORMAT "%8.4" EXTENDED_LIMITS -327680.0 327670.0
 /begin AXIS_DESCR STD_AXIS CTSCD_tClnt Temp_Cels 12 -50.1400 899.8600 FORMAT "%8.4" EXTENDED_LIMITS -3549.940 3003.560 DEPOSIT ABSOLUTE /end AXIS_DESCR
/end CHARACTERISTIC
/begin CHARACTERISTIC QLTCD_cntComOk_C "Anzahl der positiven Prüfungen zur QLT-Erkennung" VALUE 0xF29D4 Kw_Wu8 255.0 OneToOne 0.00 255.0 FORMAT "%5.1" /end CHARACTERISTIC
/begin CHARACTERISTIC QLTCD_tiDebDefect_C "Defektentprellzeit für BSD-Kommunikationsfehler" VALUE 0xF29D6 Kw_Wu16 655350.0 Time_ms 0.00 655350.0 FORMAT "%8.1" /end CHARACTERISTIC
/begin CHARACTERISTIC QLTCD_tiDebOk_C "Heilungsentprellzeit für BSD-Kommunikationsfehler" VALUE 0xF29D8 Kw_Wu16 655350.0 Time_ms 0.00 655350.0 FORMAT "%8.1" /end CHARACTERISTIC
/begin CHARACTERISTIC QLTCD_tiOutput_C "Botschaftsausgabe-Intervallzeit [ms" VALUE 0xF29DA Kw_Wu16 1980.000 Time_ms 20.00000 2000.000 FORMAT "%8.3" EXTENDED_LIMITS 0.00 655350.0 /end CHARACTERISTIC
/begin CHARACTERISTIC QLTCD_tiReset_C "Regenerationszeit nach Schnittstellenreset [ms" VALUE 0xF29DC Kw_Wu16 1980.000 Time_ms 20.00000 2000.000 FORMAT "%8.3" EXTENDED_LIMITS 0.00 655350.0 /end CHARACTERISTIC
/begin CHARACTERISTIC QLTCD_tiTryDetection_C "Zeit für Erkennung selbst" VALUE 0xF29DE Kw_Wu16 655350.0 Time_ms 0.00 655350.0 FORMAT "%8.1" /end CHARACTERISTIC
/begin CHARACTERISTIC QLTCD_tiWaitDetection_C "Zeit bis zum Start der Erkennung" VALUE 0xF29E0 Kw_Wu16 655350.0 Time_ms 0.00 655350.0 FORMAT "%8.1" /end CHARACTERISTIC
/begin CHARACTERISTIC RailCD_uSRCMin_C "#SSD SRC-Minimum Vorgabewert" VALUE 0xF4E18 Kw_Ws16 5200.391 Volt 0.00 5200.391 FORMAT "%8.3" EXTENDED_LIMITS -160156.4 160151.5 /end CHARACTERISTIC
/begin CHARACTERISTIC RailCD_uSRCMax_C "#SSD SRC-Maximum Vorgabewert" VALUE 0xF4E1A Kw_Ws16 5200.391 Volt 0.00 5200.391 FORMAT "%8.3" EXTENDED_LIMITS -160156.4 160151.5 /end CHARACTERISTIC
/begin CHARACTERISTIC RailCD_pLin_CUR "#SSD Linearisierungskennlinie für Kraftstoffdrucksensor" CURVE 0xF4E1C Kl_Xs16_Ws16 2000.000 Pres_Rail 0.00 2000.000 FORMAT "%5.3" EXTENDED_LIMITS -3276.800 3276.700
 /begin AXIS_DESCR STD_AXIS RailCD_uPeakRaw Volt 4 0.00 5200.391 FORMAT "%8.3" EXTENDED_LIMITS -160156.4 160151.5 DEPOSIT ABSOLUTE /end AXIS_DESCR
/end CHARACTERISTIC
/begin CHARACTERISTIC RailCD_DebSRCHighDef_C "#SSD Kraftstoffdruck Fehlerentprellzeit SRC-High" VALUE 0xF4E2E Kw_Wu16 655350.0 Time_ms 0.00 655350.0 FORMAT "%8.1" /end CHARACTERISTIC
/begin CHARACTERISTIC RailCD_DebSRCHighOk_C "#SSD Kraftstoffdruck Heilungsentprellzeit SRC-High" VALUE 0xF4E30 Kw_Wu16 655350.0 Time_ms 0.00 655350.0 FORMAT "%8.1" /end CHARACTERISTIC
/begin CHARACTERISTIC RailCD_DebSRCLowDef_C "#SSD Kraftstoffdruck Fehlerentprellzeit SRC-Low" VALUE 0xF4E32 Kw_Wu16 655350.0 Time_ms 0.00 655350.0 FORMAT "%8.1" /end CHARACTERISTIC
/begin CHARACTERISTIC RailCD_DebSRCLowOk_C "#SSD Kraftstoffdruck Heilungsentprellzeit SRC-Low" VALUE 0xF4E34 Kw_Wu16 655350.0 Time_ms 0.00 655350.0 FORMAT "%8.1" /end CHARACTERISTIC
/begin CHARACTERISTIC RailCD_nStrtLim_C "start phase speed  threshold" VALUE 0xF4E94 Kw_Ws16 6000.000 EngN 0.00 6000.000 FORMAT "%8.3" EXTENDED_LIMITS -32768.00 32767.00 /end CHARACTERISTIC
/begin CHARACTERISTIC RAILCD_numAdc2_C "#SSD application parameter for Exhaust Temperature Sensor 1" VALUE 0xF4E36 Kw_Wu8 26.0000000000 NumPinAdc 0.00 26.0000000000 FORMAT "%13.10" /end CHARACTERISTIC
/begin CHARACTERISTIC RAILCD_numAdc_C "#SSD application parameter for Rail pressure Sensor" VALUE 0xF4E37 Kw_Wu8 26.0000000000 NumPinAdc 0.00 26.0000000000 FORMAT "%13.10" /end CHARACTERISTIC
/begin CHARACTERISTIC RailCD_pFltWinNeg_CUR "Raildruckabfall, ab welchem auf Großsignalparameter umgeschaltet wird" CURVE 0xF4E38 Kl_Xs16_Ws16 6553.500 Pres_Rail -3276.800 3276.700 FORMAT "%5.3"
 /begin AXIS_DESCR STD_AXIS InjCtl_qSetUnBal InjMassCyc 10 -327.6800 327.6700 FORMAT "%8.4" DEPOSIT ABSOLUTE /end AXIS_DESCR
/end CHARACTERISTIC
/begin CHARACTERISTIC RailCD_pStrtLim_C "start phase Pressure threshold" VALUE 0xF4E96 Kw_Ws16 2000.000 Pres_Rail 0.00 2000.000 FORMAT "%5.3" EXTENDED_LIMITS -3276.800 3276.700 /end CHARACTERISTIC
/begin CHARACTERISTIC RailCD_stRPSFlt_C "Funktionsweise der Raildruck-Spitzenwertermittlung im 10ms Raster" VALUE 0xF4E62 Kw_Wu8 1.000 OneToOne 0.00 1.000 FORMAT "%5.3" EXTENDED_LIMITS 0.00 255.0 /end CHARACTERISTIC
/begin CHARACTERISTIC RailCD_swtOfsTst_C "Schalter für Freigabe des Offset-Tests für den Raildrucksensor im Start oder Nachlauf (0: Start, 1: Nachlauf)" VALUE 0xF4E70 Kw_Wu8 3.000 OneToOne 0.00 3.000 FORMAT "%5.3" EXTENDED_LIMITS 0.00 255.0 /end CHARACTERISTIC
/begin CHARACTERISTIC RailCD_tiEvalDel_C "#SSD Verzögerungszeit zur Auswertung des Überwachungsergebnisses beim Offset-Tests für den Raildrucksensor" VALUE 0xF4E72 Kw_Wu16 655350.0 Time_ms 0.00 655350.0 FORMAT "%8.1" /end CHARACTERISTIC
/begin CHARACTERISTIC RailCD_tiFlt1PT1_C "PT1 Filterparameter für steigenden Raildruck" VALUE 0xF4E64 Kw_Wu32 4294.9673 TimeDelay_s 0.0000010000000 4294.9673 FORMAT "%9.4" /end CHARACTERISTIC
/begin CHARACTERISTIC RailCD_tiFlt2PT1_C "PT1 Filterparameter für fallenden Raildruck (Kleinsignalverhalten)" VALUE 0xF4E68 Kw_Wu32 4294.9673 TimeDelay_s 0.0000010000000 4294.9673 FORMAT "%9.4" /end CHARACTERISTIC
/begin CHARACTERISTIC RailCD_tiFlt3PT1_C "PT1 Filterparameter für stark fallenden Raildruck (Großsignalverhalten)" VALUE 0xF4E6C Kw_Wu32 4294.9673 TimeDelay_s 0.0000010000000 4294.9673 FORMAT "%9.4" /end CHARACTERISTIC
/begin CHARACTERISTIC RailCD_tiOfsTstAftRun_C "#SSD Überwachungszeitraum des Offset-Tests für den Raildrucksensor im Nachlauf" VALUE 0xF4E74 Kw_Wu16 655350.0 Time_ms 0.00 655350.0 FORMAT "%8.1" /end CHARACTERISTIC
/begin CHARACTERISTIC RailCD_tiOfsTstDel_CUR "Verzögerungszeit für Offset-Ueberwachung des Raildrucksensors" CURVE 0xF4E76 Kl_Xs16_Ws16 5242.720 TimeRed 0.00 5242.720 FORMAT "%8.3" EXTENDED_LIMITS -5242.880 5242.720
 /begin AXIS_DESCR STD_AXIS RailCD_pPeak Pres_Rail 2 0.00 2000.000 FORMAT "%5.3" EXTENDED_LIMITS -3276.800 3276.700 DEPOSIT ABSOLUTE /end AXIS_DESCR
/end CHARACTERISTIC
/begin CHARACTERISTIC RailCD_tiOfsTstStrt_C "#SSD Überwachungszeitraum des Offset-Tests für den Raildrucksensor im Start" VALUE 0xF4E80 Kw_Wu16 655350.0 Time_ms 0.00 655350.0 FORMAT "%8.1" /end CHARACTERISTIC
/begin CHARACTERISTIC RailCD_tiPMonStrtLim_C "time duration  for error monitoring" VALUE 0xF4E98 Kw_Wu32 10000.0000000 Time_ms 0.00 10000.0000000 FORMAT "%13.7" EXTENDED_LIMITS 0.00 42949672950.0 /end CHARACTERISTIC
/begin CHARACTERISTIC RailCD_tiStrErrDel_C "Timeout zur Speicherung des Überwachungsergebnisses beim Offset-Tests für den Raildrucksensor" VALUE 0xF4E82 Kw_Wu16 655350.0 Time_ms 0.00 655350.0 FORMAT "%8.1" /end CHARACTERISTIC
/begin CHARACTERISTIC RailCD_tOfsTstAftRun_C "Systemtemperaturschwelle zur Freigabe der Offset-Überwachung des Raildrucksensors im Nachlauf" VALUE 0xF4E84 Kw_Ws16 250.0000 Temp_Cels -50.14000 199.8600 FORMAT "%8.4" EXTENDED_LIMITS -3549.940 3003.560 /end CHARACTERISTIC
/begin CHARACTERISTIC RailCD_tOfsTstDec_C "Wassertemperaturdifferenz 'Abkühlung' zur Freigabe der Offset-Überwachung des Raildrucksensors im Start" VALUE 0xF4E86 Kw_Ws16 100.0000 TempDiff_Cels 0.00 100.0000 FORMAT "%8.4" EXTENDED_LIMITS -3276.800 3276.700 /end CHARACTERISTIC
/begin CHARACTERISTIC RailCD_tOfsTstInc_C "Wassertemperaturdifferenz 'Erwärmung' zur Freigabe der Offset-Überwachung des Raildrucksensors im Start" VALUE 0xF4E88 Kw_Ws16 100.0000 TempDiff_Cels -100.0000 0.00 FORMAT "%8.4" EXTENDED_LIMITS -3276.800 3276.700 /end CHARACTERISTIC
/begin CHARACTERISTIC RailCD_tOfsTstStrt_C "Systemtemperaturschwelle zur Freigabe der Offset-Überwachung des Raildrucksensors im Start" VALUE 0xF4E8A Kw_Ws16 250.0000 Temp_Cels -50.14000 199.8600 FORMAT "%8.4" EXTENDED_LIMITS -3549.940 3003.560 /end CHARACTERISTIC
/begin CHARACTERISTIC RailCD_uOfsAftRunMax_C "obere Offsetschwelle der Offset-Überwachung des Raildrucksensors im Nachlauf" VALUE 0xF4E8C Kw_Ws16 5200.391 Volt 0.00 5200.391 FORMAT "%8.3" EXTENDED_LIMITS -160156.4 160151.5 /end CHARACTERISTIC
/begin CHARACTERISTIC RailCD_uOfsAftRunMin_C "untere Offsetschwelle der Offset-Überwachung des Raildrucksensors im Nachlauf" VALUE 0xF4E8E Kw_Ws16 5200.391 Volt 0.00 5200.391 FORMAT "%8.3" EXTENDED_LIMITS -160156.4 160151.5 /end CHARACTERISTIC
/begin CHARACTERISTIC RailCD_uOfsStrtMax_C "obere Offsetschwelle der Offset-Überwachung des Raildrucksensors im Start" VALUE 0xF4E90 Kw_Ws16 5200.391 Volt 0.00 5200.391 FORMAT "%8.3" EXTENDED_LIMITS -160156.4 160151.5 /end CHARACTERISTIC
/begin CHARACTERISTIC RailCD_uOfsStrtMin_C "untere Offsetschwelle der Offset-Überwachung des Raildrucksensors im Start" VALUE 0xF4E92 Kw_Ws16 5200.391 Volt 0.00 5200.391 FORMAT "%8.3" EXTENDED_LIMITS -160156.4 160151.5 /end CHARACTERISTIC
/begin CHARACTERISTIC Rail_tiEGTMskHiLo_C "Entprellzeit für High auf Low" VALUE 0xF2E70 Kw_Wu16 655350.0 TimeDeb 0.00 655350.0 FORMAT "%8.1" /end CHARACTERISTIC
/begin CHARACTERISTIC Rail_tiEGTMskLoHi_C "Entprellzeit Low auf High" VALUE 0xF2E72 Kw_Wu16 655350.0 TimeDeb 0.00 655350.0 FORMAT "%8.1" /end CHARACTERISTIC
/begin CHARACTERISTIC Rail_DebMeUn0MaxDef_C "#SSD Fehlerentprellzeit für Überwachung auf positive Regelabweichung" VALUE 0xF2EF0 Kw_Wu16 655350.0 Time_ms 0.00 655350.0 FORMAT "%8.1" /end CHARACTERISTIC
/begin CHARACTERISTIC Rail_DebMeUn0MaxOk_C "#SSD Heilungsentprellzeit für Überwachung auf positive Regelabweichung" VALUE 0xF2EF2 Kw_Wu16 655350.0 Time_ms 0.00 655350.0 FORMAT "%8.1" /end CHARACTERISTIC
/begin CHARACTERISTIC Rail_DebMeUn1MaxDef_C "#SSD Fehlerentprellzeit für Überwachung auf positive Regelabweichung und Sollwert des Volumenstroms durch die Zumesseinheit" VALUE 0xF2EF4 Kw_Wu16 655350.0 Time_ms 0.00 655350.0 FORMAT "%8.1" /end CHARACTERISTIC
/begin CHARACTERISTIC Rail_DebMeUn1MaxOk_C "#SSD Heilungsentprellzeit für Überwachung auf positive Regelabweichung und Sollwert des Volumenstroms durch die Zumesseinheit" VALUE 0xF2EF6 Kw_Wu16 655350.0 Time_ms 0.00 655350.0 FORMAT "%8.1" /end CHARACTERISTIC
/begin CHARACTERISTIC Rail_DebMeUn2MaxDef_C "#SSD Fehlerentprellzeit für negative Regelabweichung bei Nullförderung" VALUE 0xF2EF8 Kw_Wu16 655350.0 Time_ms 0.00 655350.0 FORMAT "%8.1" /end CHARACTERISTIC
/begin CHARACTERISTIC Rail_DebMeUn2MaxOk_C "#SSD Heilungsentprellzeit für negative Regelabweichung bei Nullförderung" VALUE 0xF2EFA Kw_Wu16 655350.0 Time_ms 0.00 655350.0 FORMAT "%8.1" /end CHARACTERISTIC
/begin CHARACTERISTIC Rail_DebMeUn3MaxDef_C "#SSD Fehlerentprellzeit für minimalen Raildruck" VALUE 0xF2EFC Kw_Wu16 655350.0 Time_ms 0.00 655350.0 FORMAT "%8.1" /end CHARACTERISTIC
/begin CHARACTERISTIC Rail_DebMeUn3MaxOk_C "#SSD Heilungsentprellzeit für minimalen Raildruck" VALUE 0xF2EFE Kw_Wu16 655350.0 Time_ms 0.00 655350.0 FORMAT "%8.1" /end CHARACTERISTIC
/begin CHARACTERISTIC Rail_DebMeUn4MaxDef_C "#SSD Fehlerentprellzeit für maximalen Raildruck" VALUE 0xF2F00 Kw_Wu16 655350.0 Time_ms 0.00 655350.0 FORMAT "%8.1" /end CHARACTERISTIC
/begin CHARACTERISTIC Rail_DebMeUn4MaxOk_C "#SSD Heilungsentprellzeit für maximalen Raildruck" VALUE 0xF2F02 Kw_Wu16 655350.0 Time_ms 0.00 655350.0 FORMAT "%8.1" /end CHARACTERISTIC
/begin CHARACTERISTIC Rail_DebPCV0MaxDef_C "#SSD Fehlerentprellzeit für Überwachung auf positive Regelabweichung" VALUE 0xF2F4A Kw_Wu16 655350.0 Time_ms 0.00 655350.0 FORMAT "%8.1" /end CHARACTERISTIC
/begin CHARACTERISTIC Rail_DebPCV0MaxOk_C "#SSD Heilungsentprellzeit für Überwachung auf positive Regelabweichung" VALUE 0xF2F4C Kw_Wu16 655350.0 Time_ms 0.00 655350.0 FORMAT "%8.1" /end CHARACTERISTIC
/begin CHARACTERISTIC Rail_DebPCV1MaxDef_C "#SSD Fehlerentprellzeit für positive Regelabweichung kombiniert mit Stellgröße Druckregelventil" VALUE 0xF2F4E Kw_Wu16 655350.0 Time_ms 0.00 655350.0 FORMAT "%8.1" /end CHARACTERISTIC
/begin CHARACTERISTIC Rail_DebPCV1MaxOk_C "#SSD Heilungsentprellzeit für positive Regelaweichung kombiniert mit Stellgröße Druckregelventil" VALUE 0xF2F50 Kw_Wu16 655350.0 Time_ms 0.00 655350.0 FORMAT "%8.1" /end CHARACTERISTIC
/begin CHARACTERISTIC Rail_DebPCV2MaxDef_C "#SSD Fehlerentprellzeit für negative Regelabweichung kombiniert mit Stellgröße Druckregelventil" VALUE 0xF2F52 Kw_Wu16 655350.0 Time_ms 0.00 655350.0 FORMAT "%8.1" /end CHARACTERISTIC
/begin CHARACTERISTIC Rail_DebPCV2MaxOk_C "#SSD Heilungsentprellzeit für negative Regelabweichung kombiniert mit Stellgröße Druckregelventil" VALUE 0xF2F54 Kw_Wu16 655350.0 Time_ms 0.00 655350.0 FORMAT "%8.1" /end CHARACTERISTIC
/begin CHARACTERISTIC Rail_DebPCV3MaxDef_C "#SSD Fehlerentprellzeit für minimalen Raildruck" VALUE 0xF2F56 Kw_Wu16 655350.0 Time_ms 0.00 655350.0 FORMAT "%8.1" /end CHARACTERISTIC
/begin CHARACTERISTIC Rail_DebPCV3MaxOk_C "#SSD Heilungsentprellzeit für minimalen Raildruck" VALUE 0xF2F58 Kw_Wu16 655350.0 Time_ms 0.00 655350.0 FORMAT "%8.1" /end CHARACTERISTIC
/begin CHARACTERISTIC Rail_DebPCV4MaxDef_C "#SSD Fehlerentprellzeit für maximalen Raildruck" VALUE 0xF2F5A Kw_Wu16 655350.0 Time_ms 0.00 655350.0 FORMAT "%8.1" /end CHARACTERISTIC
/begin CHARACTERISTIC Rail_DebPCV4MaxOk_C "#SSD Heilungsentprellzeit für maximalen Raildruck" VALUE 0xF2F5C Kw_Wu16 655350.0 Time_ms 0.00 655350.0 FORMAT "%8.1" /end CHARACTERISTIC
/begin CHARACTERISTIC Rail_DebPCV5MaxDef_C "#SSD Fehlerentprellzeit für Plausibilisierung Raildruck mit Strom durch das PCV" VALUE 0xF2F5E Kw_Wu16 655350.0 Time_ms 0.00 655350.0 FORMAT "%8.1" /end CHARACTERISTIC
/begin CHARACTERISTIC Rail_DebPCV5MaxOk_C "#SSD Heilungsentprellzeit für Plausibilisierung Raildruck mit Strom durch das PCV" VALUE 0xF2F60 Kw_Wu16 655350.0 Time_ms 0.00 655350.0 FORMAT "%8.1" /end CHARACTERISTIC
/begin CHARACTERISTIC Rail_dvolMeUnCtlInitI_CUR "Kennlinie zur Initialisierung des I-Anteils als Funktion der Systemtemperatur" CURVE 0xF2D6E Kl_Xs16_Ws16 150000.0 Qp_mm3_sec 0.00 150000.0 FORMAT "%8.1" EXTENDED_LIMITS -327680.0 327670.0
 /begin AXIS_DESCR STD_AXIS FlSys_t Temp_Cels 3 -50.14000 199.8600 FORMAT "%8.4" EXTENDED_LIMITS -3549.940 3003.560 DEPOSIT ABSOLUTE /end AXIS_DESCR
/end CHARACTERISTIC
/begin CHARACTERISTIC Rail_dvolMeUnCtlLoLim_C "#SSD untere Stellwertbegrenzung" VALUE 0xF2A28 Kw_Ws16 655350.0 Qp_mm3_sec -327680.0 327670.0 FORMAT "%8.1" /end CHARACTERISTIC
/begin CHARACTERISTIC Rail_dvolMeUnCtlUpLim_CUR "#SSD obere Stellwertbegrenzung" CURVE 0xF2A2A Kl_Xs16_Ws16 655350.0 Qp_mm3_sec -327680.0 327670.0 FORMAT "%8.1"
 /begin AXIS_DESCR STD_AXIS Eng_nAvrg EngN 11 0.00 6000.000 FORMAT "%8.3" EXTENDED_LIMITS -32768.00 32767.00 DEPOSIT ABSOLUTE /end AXIS_DESCR
/end CHARACTERISTIC
/begin CHARACTERISTIC Rail_dvolMeUnSet_Vector "#SSD Bypass-Label für Rail_dvolMeUnSet (Nicht verstellen!)" VALUE 0xC3A00 Kw_Wu8 255.0 OneToOne 0.00 255.0 FORMAT "%5.1" /end CHARACTERISTIC
/begin CHARACTERISTIC Rail_dvolMeUnSet_Channel "#SSD Bypass-Label für Rail_dvolMeUnSet, nicht editieren!" VALUE 0xC3A01 Kw_Wu8 255.0 OneToOne 0.00 255.0 FORMAT "%5.1" /end CHARACTERISTIC
/begin CHARACTERISTIC Rail_dvolOff_C "#SSD Volumenstrom beim Abstellen des Systems (Nullförderung)" VALUE 0xF29F8 Kw_Ws16 655350.0 Qp_mm3_sec -327680.0 327670.0 FORMAT "%8.1" /end CHARACTERISTIC
/begin CHARACTERISTIC Rail_dvolPreCtlCor_Vector "#SSD Bypass Label, nicht ändern!" VALUE 0xC3A02 Kw_Wu8 255.0 OneToOne 0.00 255.0 FORMAT "%5.1" /end CHARACTERISTIC
/begin CHARACTERISTIC Rail_dvolPreCtlCor_Channel "#SSD Bypass Label, nicht ändern!" VALUE 0xC3A03 Kw_Wu8 255.0 OneToOne 0.00 255.0 FORMAT "%5.1" /end CHARACTERISTIC
/begin CHARACTERISTIC Rail_dvolStrt_C "#SSD Volumenstrom während der Startphase (2-Stellerkonzept)" VALUE 0xF29FA Kw_Ws16 655350.0 Qp_mm3_sec -327680.0 327670.0 FORMAT "%8.1" /end CHARACTERISTIC
/begin CHARACTERISTIC Rail_facOvrMeUnNegIncr_C "#SSD Multiplikativer Faktor zur Erhöhung der I-Verstärkung für negative Großsignale bei Überdruck (Druckregelung über MeUn)" VALUE 0xF2A60 Kw_Ws16 255.9922 Fact1 0.00 255.9922 FORMAT "%8.4" EXTENDED_LIMITS -256.0000 255.9922 /end CHARACTERISTIC
/begin CHARACTERISTIC Rail_facOvrPCVNegIncr_C "#SSD Multiplikativer Faktor zur Erhöhung der I-Verstärkung für negative Großsignale bei Überdruck (Druckregelung über PCV)" VALUE 0xF2BF8 Kw_Ws16 255.9922 Fact1 0.00 255.9922 FORMAT "%8.4" EXTENDED_LIMITS -256.0000 255.9922 /end CHARACTERISTIC
/begin CHARACTERISTIC Rail_MeUnCtlDKd_CUR "D-Verstärkung der Druckregelung über Zumesseinheit" CURVE 0xF2A62 Kl_Xs16_Ws16 500.0000 Kd_pRail2Q_1 0.00 500.0000 FORMAT "%12.4" EXTENDED_LIMITS -800.0000 799.9756
 /begin AXIS_DESCR STD_AXIS Eng_nAvrg EngN 3 0.00 6000.000 FORMAT "%8.3" EXTENDED_LIMITS -32768.00 32767.00 DEPOSIT ABSOLUTE /end AXIS_DESCR
/end CHARACTERISTIC
/begin CHARACTERISTIC Rail_MeUnCtlIKiNeg_CUR "I-Verstärkung für negative Großsignale für die Druckregelung über Zumesseinheit" CURVE 0xF2A70 Kl_Xs16_Ws16 2000.015 Ki_pRail2Q_1 0.00 2000.015 FORMAT "%11.3" EXTENDED_LIMITS -3051.758 3051.665
 /begin AXIS_DESCR STD_AXIS Eng_nAvrg EngN 13 0.00 6000.000 FORMAT "%8.3" EXTENDED_LIMITS -32768.00 32767.00 DEPOSIT ABSOLUTE /end AXIS_DESCR
/end CHARACTERISTIC
/begin CHARACTERISTIC Rail_MeUnCtlIKiPos_CUR "I-Verstärkung für positive Großsignale für die Druckregelung über Zumesseinheit" CURVE 0xF2AA6 Kl_Xs16_Ws16 2000.015 Ki_pRail2Q_1 0.00 2000.015 FORMAT "%11.3" EXTENDED_LIMITS -3051.758 3051.665
 /begin AXIS_DESCR STD_AXIS Eng_nAvrg EngN 13 0.00 6000.000 FORMAT "%8.3" EXTENDED_LIMITS -32768.00 32767.00 DEPOSIT ABSOLUTE /end AXIS_DESCR
/end CHARACTERISTIC
/begin CHARACTERISTIC Rail_MeUnCtlIKi_CUR "I-Verstärkung für Kleinsignale für die Druckregelung über Zumesseinheit" CURVE 0xF2ADC Kl_Xs16_Ws16 2000.015 Ki_pRail2Q_1 0.00 2000.015 FORMAT "%11.3" EXTENDED_LIMITS -3051.758 3051.665
 /begin AXIS_DESCR STD_AXIS Eng_nAvrg EngN 13 0.00 6000.000 FORMAT "%8.3" EXTENDED_LIMITS -32768.00 32767.00 DEPOSIT ABSOLUTE /end AXIS_DESCR
/end CHARACTERISTIC
/begin CHARACTERISTIC Rail_MeUnCtlPKpNeg_CUR "P-Verstärkung für negative Großsignale für die Druckregelung über Zumesseinheit" CURVE 0xF2B12 Kl_Xs16_Ws16 200.0000 Kp_pRail2Q_1 0.00 200.0000 FORMAT "%12.4" EXTENDED_LIMITS -400.0000 399.9878
 /begin AXIS_DESCR STD_AXIS Eng_nAvrg EngN 13 0.00 6000.000 FORMAT "%8.3" EXTENDED_LIMITS -32768.00 32767.00 DEPOSIT ABSOLUTE /end AXIS_DESCR
/end CHARACTERISTIC
/begin CHARACTERISTIC Rail_MeUnCtlPKpPos_CUR "P-Verstärkung für positive Großsignale für die Druckregelung über Zumesseinheit" CURVE 0xF2B48 Kl_Xs16_Ws16 200.0000 Kp_pRail2Q_1 0.00 200.0000 FORMAT "%12.4" EXTENDED_LIMITS -400.0000 399.9878
 /begin AXIS_DESCR STD_AXIS Eng_nAvrg EngN 13 0.00 6000.000 FORMAT "%8.3" EXTENDED_LIMITS -32768.00 32767.00 DEPOSIT ABSOLUTE /end AXIS_DESCR
/end CHARACTERISTIC
/begin CHARACTERISTIC Rail_MeUnCtlPKp_CUR "P-Verstärkung für Kleinsignale für die Druckregelung über Zumesseinheit" CURVE 0xF2B7E Kl_Xs16_Ws16 200.0000 Kp_pRail2Q_1 0.00 200.0000 FORMAT "%12.4" EXTENDED_LIMITS -400.0000 399.9878
 /begin AXIS_DESCR STD_AXIS Eng_nAvrg EngN 13 0.00 6000.000 FORMAT "%8.3" EXTENDED_LIMITS -32768.00 32767.00 DEPOSIT ABSOLUTE /end AXIS_DESCR
/end CHARACTERISTIC
/begin CHARACTERISTIC Rail_dvolMeUnSetMin_C "#SSD minimal zulässiger Volumenstrom durch Zumesseinheit für Raildrucküberwachung" VALUE 0xF2F04 Kw_Ws16 50000.00 Qp_mm3_sec 0.00 50000.00 FORMAT "%8.2" EXTENDED_LIMITS -327680.0 327670.0 /end CHARACTERISTIC
/begin CHARACTERISTIC Rail_pMeUnPeakMax_C "#SSD Maximal zulässiger Raildruck" VALUE 0xF2F06 Kw_Ws16 2000.000 Pres_Rail 0.00 2000.000 FORMAT "%5.3" EXTENDED_LIMITS -3276.800 3276.700 /end CHARACTERISTIC
/begin CHARACTERISTIC Rail_pMeUnDvtMax_C "#SSD Maximal zulässige Regelabweichung für Raildrucküberwachung" VALUE 0xF2F08 Kw_Ws16 2000.000 Pres_Rail 0.00 2000.000 FORMAT "%5.3" EXTENDED_LIMITS -3276.800 3276.700 /end CHARACTERISTIC
/begin CHARACTERISTIC Rail_qMeUnLoIdle_C "#SSD Mengenschwelle zur Erkennung der Schubbedingung bei der Raildrucküberwachung" VALUE 0xF2F0A Kw_Ws16 327.6700 InjMassCyc 0.00 327.6700 FORMAT "%8.4" EXTENDED_LIMITS -327.6800 327.6700 /end CHARACTERISTIC
/begin CHARACTERISTIC Rail_stMonMeUnRls_C "#SSD Generelle Freigabemaske für Überwachungen der Druckregelung über Zumesseinheit" VALUE 0xF2F0C Kw_Wu16 65535.00 OneToOne 0.00 65535.00 FORMAT "%8.2" /end CHARACTERISTIC
/begin CHARACTERISTIC Rail_tMeUnLoIdle_C "#SSD Systemtemperaturschwelle für die Raildrucküberwachung" VALUE 0xF2F0E Kw_Ws16 250.0000 Temp_Cels -50.14000 199.8600 FORMAT "%8.4" EXTENDED_LIMITS -3549.940 3003.560 /end CHARACTERISTIC
/begin CHARACTERISTIC Rail_nCloseCtl_C "Drehzahlschwelle für Wechsel zwischen gesteuertem und geregeltem Betrieb" VALUE 0xF29E2 Kw_Ws16 65535.00 EngN -32768.00 32767.00 FORMAT "%8.2" /end CHARACTERISTIC
/begin CHARACTERISTIC Rail_nMeUnFrzI_C "Drehzahlschwelle zum Einfrieren des I-Anteils für den Druckregler über Zumesseinheit" VALUE 0xF2D7C Kw_Ws16 65535.00 EngN -32768.00 32767.00 FORMAT "%8.2" /end CHARACTERISTIC
/begin CHARACTERISTIC Rail_nThresStrt_C "#SSD Drehzahlschwelle zum Verlassen des Startzustandes der Zustandssteuerung" VALUE 0xF29E4 Kw_Ws16 65535.00 EngN -32768.00 32767.00 FORMAT "%8.2" /end CHARACTERISTIC
/begin CHARACTERISTIC Rail_numRevDel_C "Anzahl der Motorumdrehungen um von Steuern auf Regeln umzuschalten" VALUE 0xF29FC Kw_Wu16 65535.00 OneToOne 0.00 65535.00 FORMAT "%8.2" /end CHARACTERISTIC
/begin CHARACTERISTIC Rail_numRevPlaus_C "#SSD Anzahl der Motorumdrehungen um von Vorregelung auf Regelung umzuschalten" VALUE 0xF29E6 Kw_Wu16 65535.00 OneToOne 0.00 65535.00 FORMAT "%8.2" /end CHARACTERISTIC
/begin CHARACTERISTIC Rail_pCloseCtl_C "#SSD Absolutdruckschwelle zum Umschaltung in den Regelbetrieb" VALUE 0xF29E8 Kw_Ws16 6553.500 Pres_Rail -3276.800 3276.700 FORMAT "%5.3" /end CHARACTERISTIC
/begin CHARACTERISTIC Rail_PCVCtlDKd_CUR "D-Verstärkung der Druckregelung über Druckregelventil" CURVE 0xF2BFA Kl_Xs16_Ws16 50.00000 Kd_1 0.00 50.00000 FORMAT "%8.5" EXTENDED_LIMITS -64.00000 63.99805
 /begin AXIS_DESCR STD_AXIS Eng_nAvrg EngN 3 0.00 6000.000 FORMAT "%8.3" EXTENDED_LIMITS -32768.00 32767.00 DEPOSIT ABSOLUTE /end AXIS_DESCR
/end CHARACTERISTIC
/begin CHARACTERISTIC Rail_PCVCtlIKiNeg_CUR "I-Verstärkung für negative Großsignale für die Druckregelung über Druckregelventil" CURVE 0xF2C08 Kl_Xs16_Ws16 249.9968 Ki_1 0.00 249.9968 FORMAT "%8.4" EXTENDED_LIMITS -488.2812 488.2663
 /begin AXIS_DESCR STD_AXIS Eng_nAvrg EngN 13 0.00 6000.000 FORMAT "%8.3" EXTENDED_LIMITS -32768.00 32767.00 DEPOSIT ABSOLUTE /end AXIS_DESCR
/end CHARACTERISTIC
/begin CHARACTERISTIC Rail_PCVCtlIKiPos_CUR "I-Verstärkung für positive Großsignale für die Druckregelung über Druckregelventil" CURVE 0xF2C3E Kl_Xs16_Ws16 249.9968 Ki_1 0.00 249.9968 FORMAT "%8.4" EXTENDED_LIMITS -488.2812 488.2663
 /begin AXIS_DESCR STD_AXIS Eng_nAvrg EngN 13 0.00 6000.000 FORMAT "%8.3" EXTENDED_LIMITS -32768.00 32767.00 DEPOSIT ABSOLUTE /end AXIS_DESCR
/end CHARACTERISTIC
/begin CHARACTERISTIC Rail_PCVCtlIKi_CUR "I-Verstärkung für Kleinsignale für die Druckregelung über Druckregelventil" CURVE 0xF2C74 Kl_Xs16_Ws16 249.9968 Ki_1 0.00 249.9968 FORMAT "%8.4" EXTENDED_LIMITS -488.2812 488.2663
 /begin AXIS_DESCR STD_AXIS Eng_nAvrg EngN 13 0.00 6000.000 FORMAT "%8.3" EXTENDED_LIMITS -32768.00 32767.00 DEPOSIT ABSOLUTE /end AXIS_DESCR
/end CHARACTERISTIC
/begin CHARACTERISTIC Rail_PCVCtlPKpNeg_CUR "P-Verstärkung für negative Großsignale für die Druckregelung über Druckregelventil" CURVE 0xF2CAA Kl_Xs16_Ws16 300.0000 Kp_1 0.00 300.0000 FORMAT "%8.4" EXTENDED_LIMITS -512.0000 511.9844
 /begin AXIS_DESCR STD_AXIS Eng_nAvrg EngN 13 0.00 6000.000 FORMAT "%8.3" EXTENDED_LIMITS -32768.00 32767.00 DEPOSIT ABSOLUTE /end AXIS_DESCR
/end CHARACTERISTIC
/begin CHARACTERISTIC Rail_PCVCtlPKpPos_CUR "P-Verstärkung für positive Großsignale für die Druckregelung über Druckregelventil" CURVE 0xF2CE0 Kl_Xs16_Ws16 300.0000 Kp_1 0.00 300.0000 FORMAT "%8.4" EXTENDED_LIMITS -512.0000 511.9844
 /begin AXIS_DESCR STD_AXIS Eng_nAvrg EngN 13 0.00 6000.000 FORMAT "%8.3" EXTENDED_LIMITS -32768.00 32767.00 DEPOSIT ABSOLUTE /end AXIS_DESCR
/end CHARACTERISTIC
/begin CHARACTERISTIC Rail_PCVCtlPKp_CUR "P-Verstärkung für Kleinsignale für die Druckregelung über Druckregelventil" CURVE 0xF2D16 Kl_Xs16_Ws16 300.0000 Kp_1 0.00 300.0000 FORMAT "%8.4" EXTENDED_LIMITS -512.0000 511.9844
 /begin AXIS_DESCR STD_AXIS Eng_nAvrg EngN 13 0.00 6000.000 FORMAT "%8.3" EXTENDED_LIMITS -32768.00 32767.00 DEPOSIT ABSOLUTE /end AXIS_DESCR
/end CHARACTERISTIC
/begin CHARACTERISTIC Rail_pPCVDvtMax_C "#SSD maximale positive Soll/Ist Druckdifferenz" VALUE 0xF2F62 Kw_Ws16 3800.000 Pres_Rail -1800.000 2000.000 FORMAT "%5.3" EXTENDED_LIMITS -3276.800 3276.700 /end CHARACTERISTIC
/begin CHARACTERISTIC Rail_pPCVDvtMin_C "#SSD maximale negative Soll/Ist Druckdifferenz" VALUE 0xF2F64 Kw_Ws16 3800.000 Pres_Rail -1800.000 2000.000 FORMAT "%5.3" EXTENDED_LIMITS -3276.800 3276.700 /end CHARACTERISTIC
/begin CHARACTERISTIC Rail_pPCVSetMin_C "#SSD Minimal zulässiger Solldruck für Raildrucküberwachung" VALUE 0xF2F66 Kw_Ws16 2000.000 Pres_Rail 0.00 2000.000 FORMAT "%5.3" EXTENDED_LIMITS -3276.800 3276.700 /end CHARACTERISTIC
/begin CHARACTERISTIC Rail_pAbsDvtMax_C "#SSD Maximaler Betrag der Regelabweichung für Raildrucküberwachung" VALUE 0xF2F68 Kw_Ws16 3800.000 Pres_Rail -1800.000 2000.000 FORMAT "%5.3" EXTENDED_LIMITS -3276.800 3276.700 /end CHARACTERISTIC
/begin CHARACTERISTIC Rail_tiThresMonEna_C "#SSD Zeitschwelle für Freigabe der Plausibilisierung des Raildrucks während der Raildrucküberwachung" VALUE 0xF2F6A Kw_Wu16 655350.0 Time_ms 0.00 655350.0 FORMAT "%8.1" /end CHARACTERISTIC
/begin CHARACTERISTIC Rail_qMonEnaMax_C "#SSD Maximale Menge für Raildrucküberwachung" VALUE 0xF2F6C Kw_Ws16 327.6700 InjMassCyc 0.00 327.6700 FORMAT "%8.4" EXTENDED_LIMITS -327.6800 327.6700 /end CHARACTERISTIC
/begin CHARACTERISTIC Rail_nMonEnaMin_C "#SSD Minimale Drehzahl für Raildrucküberwachung" VALUE 0xF2F6E Kw_Ws16 6000.000 EngN 0.00 6000.000 FORMAT "%8.3" EXTENDED_LIMITS -32768.00 32767.00 /end CHARACTERISTIC
/begin CHARACTERISTIC Rail_nMonEnaMax_C "#SSD Maximale Drehzahl für Raildrucküberwachung" VALUE 0xF2F70 Kw_Ws16 6000.000 EngN 0.00 6000.000 FORMAT "%8.3" EXTENDED_LIMITS -32768.00 32767.00 /end CHARACTERISTIC
/begin CHARACTERISTIC Rail_pPCVPeakMax_C "#SSD Maximal zulässiger Raildruck" VALUE 0xF2F72 Kw_Ws16 2000.000 Pres_Rail 0.00 2000.000 FORMAT "%5.3" EXTENDED_LIMITS -3276.800 3276.700 /end CHARACTERISTIC
/begin CHARACTERISTIC Rail_stMonPCVRls_C "#SSD Generelle Freigabemaske für Überwachungen der Druckregelung über Druckregelventil" VALUE 0xF2F74 Kw_Wu16 65535.00 OneToOne 0.00 65535.00 FORMAT "%8.2" /end CHARACTERISTIC
/begin CHARACTERISTIC Rail_pDiffCloseCtl_C "Differenzdruckschwelle zum Umschalten in den Regelbetrieb" VALUE 0xF29EA Kw_Ws16 6553.500 Pres_Rail -3276.800 3276.700 FORMAT "%5.3" /end CHARACTERISTIC
/begin CHARACTERISTIC Rail_pDvtFltMin_C "minimale absolute Regelabweichung als eingangssignal des DT1-Gliedes" VALUE 0xF2D7E Kw_Ws16 6553.500 Pres_Rail -3276.800 3276.700 FORMAT "%5.3" /end CHARACTERISTIC
/begin CHARACTERISTIC Rail_pMeUnCtlIWinNeg_C "untere Kleinsignalgrenze für den I-Anteil des Druckreglers über Zumesseinheit" VALUE 0xF2BB4 Kw_Ws16 6553.500 Pres_Rail -3276.800 3276.700 FORMAT "%5.3" /end CHARACTERISTIC
/begin CHARACTERISTIC Rail_pMeUnCtlIWinPos_C "obere Kleinsignalgrenze für den I-Anteil des Druckreglers über Zumesseinheit" VALUE 0xF2BB6 Kw_Ws16 6553.500 Pres_Rail -3276.800 3276.700 FORMAT "%5.3" /end CHARACTERISTIC
/begin CHARACTERISTIC Rail_pMeUnCtlPWinNeg_C "untere Kleinsignalgrenze für den P-Anteil des Druckreglers über Zumesseinheit" VALUE 0xF2BB8 Kw_Ws16 6553.500 Pres_Rail -3276.800 3276.700 FORMAT "%5.3" /end CHARACTERISTIC
/begin CHARACTERISTIC Rail_pMeUnCtlPWinPos_C "obere Kleinsignalgrenze für den P-Anteil des Druckreglers über Zumesseinheit" VALUE 0xF2BBA Kw_Ws16 6553.500 Pres_Rail -3276.800 3276.700 FORMAT "%5.3" /end CHARACTERISTIC
/begin CHARACTERISTIC Rail_pMeUnDvtMax_CUR "#SSD Maximal zulässige Regelabweichung für Raildrucküberwachung als Funktion der Drehzahl" CURVE 0xF2F10 Kl_Xs16_Ws16 3800.000 Pres_Rail -1800.000 2000.000 FORMAT "%5.3" EXTENDED_LIMITS -3276.800 3276.700
 /begin AXIS_DESCR STD_AXIS Eng_nAvrg EngN 4 0.00 6000.000 FORMAT "%8.3" EXTENDED_LIMITS -32768.00 32767.00 DEPOSIT ABSOLUTE /end AXIS_DESCR
/end CHARACTERISTIC
/begin CHARACTERISTIC Rail_pMeUnDvtMin_CUR "#SSD Minimal zulässige Regelabweichung für Raildrucküberwachung als Funktion der Drehzahl" CURVE 0xF2F22 Kl_Xs16_Ws16 3800.000 Pres_Rail -1800.000 2000.000 FORMAT "%5.3" EXTENDED_LIMITS -3276.800 3276.700
 /begin AXIS_DESCR STD_AXIS Eng_nAvrg EngN 4 0.00 6000.000 FORMAT "%8.3" EXTENDED_LIMITS -32768.00 32767.00 DEPOSIT ABSOLUTE /end AXIS_DESCR
/end CHARACTERISTIC
/begin CHARACTERISTIC Rail_pMeUnPeakMin_CUR "#SSD Minimal zulässiger Raildruck als Funktion der Motordrehzahl" CURVE 0xF2F34 Kl_Xs16_Ws16 2000.000 Pres_Rail 0.00 2000.000 FORMAT "%5.3" EXTENDED_LIMITS -3276.800 3276.700
 /begin AXIS_DESCR STD_AXIS Eng_nAvrg EngN 5 0.00 6000.000 FORMAT "%8.3" EXTENDED_LIMITS -32768.00 32767.00 DEPOSIT ABSOLUTE /end AXIS_DESCR
/end CHARACTERISTIC
/begin CHARACTERISTIC Rail_pNIPCVMax_MAP "#SSD Obere Grenze für Drucksensorplausibilisierung" MAP 0xF2F76 Kf_Xs16_Ys16_Ws16 2000.000 Pres_Rail 0.00 2000.000 FORMAT "%5.3" EXTENDED_LIMITS -3276.800 3276.700
 /begin AXIS_DESCR STD_AXIS Eng_nAvrg EngN 6 0.00 6000.000 FORMAT "%8.3" EXTENDED_LIMITS -32768.00 32767.00 DEPOSIT ABSOLUTE /end AXIS_DESCR
 /begin AXIS_DESCR STD_AXIS PCVCD_iActVal Curr 8 0.00 5000.000 FORMAT "%8.3" EXTENDED_LIMITS -32768.00 32767.00 DEPOSIT ABSOLUTE /end AXIS_DESCR
/end CHARACTERISTIC
/begin CHARACTERISTIC Rail_pNIPCVMin_MAP "#SSD Untere Grenze für Drucksensorplausibilisierung" MAP 0xF2FF6 Kf_Xs16_Ys16_Ws16 2000.000 Pres_Rail 0.00 2000.000 FORMAT "%5.3" EXTENDED_LIMITS -3276.800 3276.700
 /begin AXIS_DESCR STD_AXIS Eng_nAvrg EngN 6 0.00 6000.000 FORMAT "%8.3" EXTENDED_LIMITS -32768.00 32767.00 DEPOSIT ABSOLUTE /end AXIS_DESCR
 /begin AXIS_DESCR STD_AXIS PCVCD_iActVal Curr 8 0.00 5000.000 FORMAT "%8.3" EXTENDED_LIMITS -32768.00 32767.00 DEPOSIT ABSOLUTE /end AXIS_DESCR
/end CHARACTERISTIC
/begin CHARACTERISTIC Rail_pOpnCtl_C "#SSD Absolutdruckschwelle zum Umschaltung in den Steuerbetrieb" VALUE 0xF29EC Kw_Ws16 6553.500 Pres_Rail -3276.800 3276.700 FORMAT "%5.3" /end CHARACTERISTIC
/begin CHARACTERISTIC Rail_pOvrMeUnThresHigh_C "#SSD Obere Hystereseschwelle für Überdruckerkennung MeUn" VALUE 0xF2BBC Kw_Ws16 2000.000 Pres_Rail 0.00 2000.000 FORMAT "%5.3" EXTENDED_LIMITS -3276.800 3276.700 /end CHARACTERISTIC
/begin CHARACTERISTIC Rail_pOvrMeUnThresLow_C "#SSD Untere Hystereseschwelle für Überdruckerkennung MeUn" VALUE 0xF2BBE Kw_Ws16 2000.000 Pres_Rail 0.00 2000.000 FORMAT "%5.3" EXTENDED_LIMITS -3276.800 3276.700 /end CHARACTERISTIC
/begin CHARACTERISTIC Rail_pOvrPCVThresHigh_C "#SSD Obere Hystereseschwelle für Überdruckerkennung PCV" VALUE 0xF2D4C Kw_Ws16 2000.000 Pres_Rail 0.00 2000.000 FORMAT "%5.3" EXTENDED_LIMITS -3276.800 3276.700 /end CHARACTERISTIC
/begin CHARACTERISTIC Rail_pOvrPCVThresLow_C "#SSD Untere Hystereseschwelle für Überdruckerkennung PCV" VALUE 0xF2D4E Kw_Ws16 2000.000 Pres_Rail 0.00 2000.000 FORMAT "%5.3" EXTENDED_LIMITS -3276.800 3276.700 /end CHARACTERISTIC
/begin CHARACTERISTIC Rail_pPCVCtlIWinNeg_C "untere Kleinsignalgrenze für den I-Anteil des Druckreglers über Druckregelventil" VALUE 0xF2D50 Kw_Ws16 6553.500 Pres_Rail -3276.800 3276.700 FORMAT "%5.3" /end CHARACTERISTIC
/begin CHARACTERISTIC Rail_pPCVCtlIWinPos_C "obere Kleinsignalgrenze für den I-Anteil des Druckreglers über Druckregelventil" VALUE 0xF2D52 Kw_Ws16 6553.500 Pres_Rail -3276.800 3276.700 FORMAT "%5.3" /end CHARACTERISTIC
/begin CHARACTERISTIC Rail_pPCVCtlLoLimStrt_C "#SSD untere Stellwertbegrenzung des Raildruckreglers über Druckregelventil während der Startphase" VALUE 0xF2A58 Kw_Ws16 6553.500 Pres_Rail -3276.800 3276.700 FORMAT "%5.3" /end CHARACTERISTIC
/begin CHARACTERISTIC Rail_pPCVCtlLoLim_C "#SSD untere Stellwertbegrenzung des Raildruckreglers über Druckregelventil" VALUE 0xF2A5A Kw_Ws16 6553.500 Pres_Rail -3276.800 3276.700 FORMAT "%5.3" /end CHARACTERISTIC
/begin CHARACTERISTIC Rail_pPCVCtlPWinNeg_C "untere Kleinsignalgrenze für den P-Anteil des Druckreglers über Druckregelventil" VALUE 0xF2D54 Kw_Ws16 6553.500 Pres_Rail -3276.800 3276.700 FORMAT "%5.3" /end CHARACTERISTIC
/begin CHARACTERISTIC Rail_pPCVCtlPWinPos_C "obere Kleinsignalgrenze für den P-Anteil des Druckreglers über Druckregelventil" VALUE 0xF2D56 Kw_Ws16 6553.500 Pres_Rail -3276.800 3276.700 FORMAT "%5.3" /end CHARACTERISTIC
/begin CHARACTERISTIC Rail_pPCVCtlUpLimStrt_C "#SSD obere Stellwertbegrenzung des Raildruckreglers über Druckregelventil während der Startphase" VALUE 0xF2A5C Kw_Ws16 6553.500 Pres_Rail -3276.800 3276.700 FORMAT "%5.3" /end CHARACTERISTIC
/begin CHARACTERISTIC Rail_pPCVCtlUpLim_C "#SSD obere Stellwertbegrenzung des Raildruckreglers über Druckregelventil" VALUE 0xF2A5E Kw_Ws16 6553.500 Pres_Rail -3276.800 3276.700 FORMAT "%5.3" /end CHARACTERISTIC
/begin CHARACTERISTIC Rail_pPCVDvtMax_CUR "#SSD maximale Regelabweichung als Funktion der Drehzahl für die Raildrucküberwachung" CURVE 0xF3076 Kl_Xs16_Ws16 3800.000 Pres_Rail -1800.000 2000.000 FORMAT "%5.3" EXTENDED_LIMITS -3276.800 3276.700
 /begin AXIS_DESCR STD_AXIS Eng_nAvrg EngN 4 0.00 6000.000 FORMAT "%8.3" EXTENDED_LIMITS -32768.00 32767.00 DEPOSIT ABSOLUTE /end AXIS_DESCR
/end CHARACTERISTIC
/begin CHARACTERISTIC Rail_pPCVInitI_MAP "Kennfeld für Initialisierungswert I-Anteil des PCV-Druckreglers, beim Umschalten von Zumesseinheit auf Druckregelventil" MAP 0xF2D82 Kf_Xs16_Ys16_Ws16 2000.000 Pres_Rail 0.00 2000.000 FORMAT "%5.3" EXTENDED_LIMITS -3276.800 3276.700
 /begin AXIS_DESCR STD_AXIS Eng_nAvrg EngN 8 0.00 6000.000 FORMAT "%8.3" EXTENDED_LIMITS -32768.00 32767.00 DEPOSIT ABSOLUTE /end AXIS_DESCR
 /begin AXIS_DESCR STD_AXIS Rail_pSetPoint Pres_Rail 12 0.00 2000.000 FORMAT "%5.3" EXTENDED_LIMITS -3276.800 3276.700 DEPOSIT ABSOLUTE /end AXIS_DESCR
/end CHARACTERISTIC
/begin CHARACTERISTIC Rail_pPCVPeakMin_CUR "#SSD Minimal zulässiger Raildruck als Funktion der Motordrehzahl" CURVE 0xF3088 Kl_Xs16_Ws16 2000.000 Pres_Rail 0.00 2000.000 FORMAT "%5.3" EXTENDED_LIMITS -3276.800 3276.700
 /begin AXIS_DESCR STD_AXIS Eng_nAvrg EngN 4 0.00 6000.000 FORMAT "%8.3" EXTENDED_LIMITS -32768.00 32767.00 DEPOSIT ABSOLUTE /end AXIS_DESCR
/end CHARACTERISTIC
/begin CHARACTERISTIC Rail_pPCVSetMax_CUR "maximal zulässiger Solldruck für die Raildrucküberwachung" CURVE 0xF309A Kl_Xs16_Ws16 2000.000 Pres_Rail 0.00 2000.000 FORMAT "%5.3" EXTENDED_LIMITS -3276.800 3276.700
 /begin AXIS_DESCR STD_AXIS Rail_pSetPoint Pres_Rail 4 0.00 2000.000 FORMAT "%5.3" EXTENDED_LIMITS -3276.800 3276.700 DEPOSIT ABSOLUTE /end AXIS_DESCR
/end CHARACTERISTIC
/begin CHARACTERISTIC Rail_pPCVSet_Vector "#SSD Bypass-Label für Rail_pPCVSet (Nicht verstellen!)" VALUE 0xC3A04 Kw_Wu8 255.0 OneToOne 0.00 255.0 FORMAT "%5.1" /end CHARACTERISTIC
/begin CHARACTERISTIC Rail_pPCVSet_Channel "#SSD Bypass-Label, nicht editieren !" VALUE 0xC3A05 Kw_Wu8 255.0 OneToOne 0.00 255.0 FORMAT "%5.1" /end CHARACTERISTIC
/begin CHARACTERISTIC Rail_pPreCtlCor_Vector "#SSD Bypass Label, nicht ändern!" VALUE 0xC3A06 Kw_Wu8 255.0 OneToOne 0.00 255.0 FORMAT "%5.1" /end CHARACTERISTIC
/begin CHARACTERISTIC Rail_pPreCtlCor_Channel "#SSD Bypass Label, nicht ändern!" VALUE 0xC3A07 Kw_Wu8 255.0 OneToOne 0.00 255.0 FORMAT "%5.1" /end CHARACTERISTIC
/begin CHARACTERISTIC Rail_pSetMin_C "#SSD minimaler Druck als Stellwertvorgabe" VALUE 0xF29FE Kw_Ws16 6553.500 Pres_Rail -3276.800 3276.700 FORMAT "%5.3" /end CHARACTERISTIC
/begin CHARACTERISTIC Rail_qMeUnCtlType_CUR "Kennlinie zur mengenabhängigen Umschaltung auf Druckregelung über Zumesseinheit (Rail_swtConInv_C beachten!)" CURVE 0xF2E74 Kl_Xs16_Ws16 327.6700 InjMassCyc 0.00 327.6700 FORMAT "%8.4" EXTENDED_LIMITS -327.6800 327.6700
 /begin AXIS_DESCR STD_AXIS Eng_nAvrg EngN 8 0.00 6000.000 FORMAT "%8.3" EXTENDED_LIMITS -32768.00 32767.00 DEPOSIT ABSOLUTE /end AXIS_DESCR
/end CHARACTERISTIC
/begin CHARACTERISTIC Rail_qPCVCtlType_CUR "Kennlinie zur mengenabhängigen Umschaltung auf Druckregelung über Druckregelventil (Rail_swtConInv_C beachten!)" CURVE 0xF2E96 Kl_Xs16_Ws16 327.6700 InjMassCyc 0.00 327.6700 FORMAT "%8.4" EXTENDED_LIMITS -327.6800 327.6700
 /begin AXIS_DESCR STD_AXIS Eng_nAvrg EngN 8 0.00 6000.000 FORMAT "%8.3" EXTENDED_LIMITS -32768.00 32767.00 DEPOSIT ABSOLUTE /end AXIS_DESCR
/end CHARACTERISTIC
/begin CHARACTERISTIC Rail_stCondRgnMsk_C "Maske zur Verknüpfung mit EGT_st" VALUE 0xF2EB8 Kw_Wu32 4294967295.00 OneToOne 0.00 4294967295.00 FORMAT "%13.2" /end CHARACTERISTIC
/begin CHARACTERISTIC Rail_stCtlLoopSel_C "Schalterauswahl fuer die Raildruckregelung" VALUE 0xF2A00 Kw_Wu8 255.0 OneToOne 0.00 255.0 FORMAT "%5.1" /end CHARACTERISTIC
/begin CHARACTERISTIC Rail_swtCtlModeAdjVal_C "Abgleichersatzwert für Hochdruckregelungs-Modus MeUn/PCV (0x00: no error, 0x01: MeUn, 0x02: PCV)" VALUE 0xF29EE Kw_Wu8 2.000 OneToOne 0.00 2.000 FORMAT "%5.3" EXTENDED_LIMITS 0.00 255.0 /end CHARACTERISTIC
/begin CHARACTERISTIC Rail_swtPCVInitI_C "Auswahl, PCV-Reglerinitialisierung mit Vorsteuerwert oder mit Sollwert (Bit0: 1: Sollwert, 0: Vorsteuerwert)" VALUE 0xF2E6E Kw_Wu8 255.0 OneToOne 0.00 255.0 FORMAT "%5.1" /end CHARACTERISTIC
/begin CHARACTERISTIC Rail_tFlSysRgnMin_C "obere Hystereseschwelle für Kraftstofftemperatur" VALUE 0xF2EBC Kw_Ws16 250.0000 Temp_Cels -50.14000 199.8600 FORMAT "%8.4" EXTENDED_LIMITS -3549.940 3003.560 /end CHARACTERISTIC
/begin CHARACTERISTIC Rail_tFlSysRgnMax_C "obere Hystereseschwelle für Kraftstofftemperatur" VALUE 0xF2EBE Kw_Ws16 250.0000 Temp_Cels -50.14000 199.8600 FORMAT "%8.4" EXTENDED_LIMITS -3549.940 3003.560 /end CHARACTERISTIC
/begin CHARACTERISTIC Rail_stFlSysRgnLow_C "Ausgangwert bei Bedingung OFF" VALUE 0xF2EC0 Kw_Ws16 65535.00 OneToOne -32768.00 32767.00 FORMAT "%8.2" /end CHARACTERISTIC
/begin CHARACTERISTIC Rail_stFlSysRgnHigh_C "Kraftstofftemperatur Hystereseschwelle ON" VALUE 0xF2EC2 Kw_Ws16 65535.00 OneToOne -32768.00 32767.00 FORMAT "%8.2" /end CHARACTERISTIC
/begin CHARACTERISTIC Rail_tiDebDefMeUnDiag_C "Fehlerentprellzeit fuer Fehlerpfad Dfp_RailCtlModeMeUnDiag" VALUE 0xF29F0 Kw_Wu16 655350.0 Time_ms 0.00 655350.0 FORMAT "%8.1" /end CHARACTERISTIC
/begin CHARACTERISTIC Rail_tiDebOkMeUnDiag_C "Heilungsentprellzeit fuer Fehlerpfad Dfp_RailCtlModeMeUnDiag" VALUE 0xF29F2 Kw_Wu16 655350.0 Time_ms 0.00 655350.0 FORMAT "%8.1" /end CHARACTERISTIC
/begin CHARACTERISTIC Rail_tiDebDefPCVDiag_C "Fehlerentprellzeit fuer Fehlerpfad Dfp_RailCtlModePCVDiag" VALUE 0xF29F4 Kw_Wu16 655350.0 Time_ms 0.00 655350.0 FORMAT "%8.1" /end CHARACTERISTIC
/begin CHARACTERISTIC Rail_tiDebOkPCVDiag_C "Heilungsentprellzeit fuer Fehlerpfad Dfp_RailCtlModePCVDiag" VALUE 0xF29F6 Kw_Wu16 655350.0 Time_ms 0.00 655350.0 FORMAT "%8.1" /end CHARACTERISTIC
/begin CHARACTERISTIC Rail_tiDeflate_C "#SSD Maximale Zeit für die Entlüftung des Niederdruckkreises" VALUE 0xF2A02 Kw_Wu16 655350.0 Time_ms 0.00 655350.0 FORMAT "%8.1" /end CHARACTERISTIC
/begin CHARACTERISTIC Rail_tiDRMin_C "Minimalzeit Druckregelung" VALUE 0xF2EC4 Kw_Wu16 655350.0 Time_ms 0.00 655350.0 FORMAT "%8.1" /end CHARACTERISTIC
/begin CHARACTERISTIC Rail_tiFrzIDel_C "Verzögerungszeit zum Einfrieren des I-Anteils für den Druckregler über Zumesseinheit" VALUE 0xF2D80 Kw_Wu16 1000.000 Time_ms 0.00 1000.000 FORMAT "%8.3" EXTENDED_LIMITS 0.00 655350.0 /end CHARACTERISTIC
/begin CHARACTERISTIC Rail_tiMeUnCtlDT1_CUR "Zeitkonstante des DT1-Gliedes (Druckregelung über Zumesseinheit)" CURVE 0xF2BC0 Kl_Xs16_Ws16 16.776216 TimeDelay_s_2 0.0010000129 16.777216 FORMAT "%9.6" EXTENDED_LIMITS 0.00051201563 16.777216
 /begin AXIS_DESCR STD_AXIS Eng_nAvrg EngN 5 0.00 6000.000 FORMAT "%8.3" EXTENDED_LIMITS -32768.00 32767.00 DEPOSIT ABSOLUTE /end AXIS_DESCR
/end CHARACTERISTIC
/begin CHARACTERISTIC Rail_tiMeUnCtlPT1_CUR "Zeitkonstante des PT1-Filters (Druckregelung über Zumesseinheit)" CURVE 0xF2BD6 Kl_Xs16_Ws16 16.776216 TimeDelay_s_2 0.0010000129 16.777216 FORMAT "%9.6" EXTENDED_LIMITS 0.00051201563 16.777216
 /begin AXIS_DESCR STD_AXIS Eng_nAvrg EngN 8 0.00 6000.000 FORMAT "%8.3" EXTENDED_LIMITS -32768.00 32767.00 DEPOSIT ABSOLUTE /end AXIS_DESCR
/end CHARACTERISTIC
/begin CHARACTERISTIC Rail_tiMeUnCtlTypeDel_C "Zeitverzögerung im Schubbetrieb bis zur Umschaltung auf Druckregelung über Zumesseinheit" VALUE 0xF2EC6 Kw_Wu16 655350.0 Time_ms 0.00 655350.0 FORMAT "%8.1" /end CHARACTERISTIC
/begin CHARACTERISTIC Rail_tiMeUnRmpDur_CUR "Laufzeit der Rampe um das Fördervolumen der Zumesseinheit vom aktuellen Sollwert auf die Maximalförderung zu rampen" CURVE 0xF2A04 Kl_Xs16_Ws16 655350.0 Time_ms -327680.0 327670.0 FORMAT "%8.1"
 /begin AXIS_DESCR STD_AXIS Eng_nAvrg EngN 8 0.00 6000.000 FORMAT "%8.3" EXTENDED_LIMITS -32768.00 32767.00 DEPOSIT ABSOLUTE /end AXIS_DESCR
/end CHARACTERISTIC
/begin CHARACTERISTIC Rail_tiPCVCtlDT1_CUR "Zeitkonstante des DT1-Gliedes für die Druckregelung über Druckregelventil" CURVE 0xF2D58 Kl_Xs16_Ws16 16.776216 TimeDelay_s_2 0.0010000129 16.777216 FORMAT "%9.6" EXTENDED_LIMITS 0.00051201563 16.777216
 /begin AXIS_DESCR STD_AXIS Eng_nAvrg EngN 5 0.00 6000.000 FORMAT "%8.3" EXTENDED_LIMITS -32768.00 32767.00 DEPOSIT ABSOLUTE /end AXIS_DESCR
/end CHARACTERISTIC
/begin CHARACTERISTIC Rail_tiSwtCtlTypeDel_C "Verzögerungszeit bis zur Freigabe der Umschaltung des Regelprinzips" VALUE 0xF2EC8 Kw_Wu16 655350.0 Time_ms 0.00 655350.0 FORMAT "%8.1" /end CHARACTERISTIC
/begin CHARACTERISTIC Rail_tiSwtToMeUnCtl_C "Verzögerungszeit bis zum Umschalten auf Druckregelung über Zumesseinheit" VALUE 0xF2A26 Kw_Wu16 655350.0 Time_ms 0.00 655350.0 FORMAT "%8.1" /end CHARACTERISTIC
/begin CHARACTERISTIC Rail_tMeUnCtlType_CUR "Kennlinie zur temperaturabhängigen Umschaltung auf Druckregelung über Zumesseinheit" CURVE 0xF2ECA Kl_Xs16_Ws16 250.0000 Temp_Cels -50.14000 199.8600 FORMAT "%8.4" EXTENDED_LIMITS -3549.940 3003.560
 /begin AXIS_DESCR STD_AXIS Eng_nAvrg EngN 3 0.00 6000.000 FORMAT "%8.3" EXTENDED_LIMITS -32768.00 32767.00 DEPOSIT ABSOLUTE /end AXIS_DESCR
/end CHARACTERISTIC
/begin CHARACTERISTIC Rail_tOvrRunThres_C "Systemtemperaturschwelle zur Umschaltung auf Druckregelung über Zumesseinheit bei Schubbetrieb" VALUE 0xF2ED8 Kw_Ws16 250.0000 Temp_Cels -50.14000 199.8600 FORMAT "%8.4" EXTENDED_LIMITS -3549.940 3003.560 /end CHARACTERISTIC
/begin CHARACTERISTIC Rail_tPCVCtlType_CUR "Kennlinie zur temperaturabhängigen Umschaltung auf Druckregelung über Druckregelventil" CURVE 0xF2EDA Kl_Xs16_Ws16 250.0000 Temp_Cels -50.14000 199.8600 FORMAT "%8.4" EXTENDED_LIMITS -3549.940 3003.560
 /begin AXIS_DESCR STD_AXIS Eng_nAvrg EngN 3 0.00 6000.000 FORMAT "%8.3" EXTENDED_LIMITS -32768.00 32767.00 DEPOSIT ABSOLUTE /end AXIS_DESCR
/end CHARACTERISTIC
/begin CHARACTERISTIC Rail_tSwtCtlTypeHi_C "Obere Hystereseschwelle der Systemtemperatur bis zur Freigabe der Umschaltung des Regelprinzips" VALUE 0xF2EE8 Kw_Ws16 250.0000 Temp_Cels -50.14000 199.8600 FORMAT "%8.4" EXTENDED_LIMITS -3549.940 3003.560 /end CHARACTERISTIC
/begin CHARACTERISTIC Rail_tSwtCtlTypeLo_C "Untere Hystereseschwelle der Systemtemperatur bis zur Freigabe der Umschaltung des Regelprinzips" VALUE 0xF2EEA Kw_Ws16 250.0000 Temp_Cels -50.14000 199.8600 FORMAT "%8.4" EXTENDED_LIMITS -3549.940 3003.560 /end CHARACTERISTIC
/begin CHARACTERISTIC Rail_vMaxDR_C "Geschwindigkeitsswelle für die Fahrgeschwindigkeit VSSCD_v" VALUE 0xF2EEC Kw_Ws16 655.3500 Vel -327.6800 327.6700 FORMAT "%8.4" /end CHARACTERISTIC
/begin MEASUREMENT PFlt_ctEngPrtRgn_mp "Motorschutz-Regenerationszähler" UWORD OneToOne 1 100 0.00 65535.00 FORMAT "%8.2" ECU_ADDRESS 0x6F8210 /end MEASUREMENT
/begin MEASUREMENT PFlt_ctRgnStep1_mp "Regenerationsschritt 1" UBYTE OneToOne 1 100 0.00 255.0 FORMAT "%5.1" ECU_ADDRESS 0x6F8212 /end MEASUREMENT
/begin MEASUREMENT PFlt_ctRgnStep2_mp "Regenerationsschritt 2" UBYTE OneToOne 1 100 0.00 255.0 FORMAT "%5.1" ECU_ADDRESS 0x6F8213 /end MEASUREMENT
/begin MEASUREMENT PFlt_ctRgnStep3_mp "Regenerationsschritt 3" UBYTE OneToOne 1 100 0.00 255.0 FORMAT "%5.1" ECU_ADDRESS 0x6F8214 /end MEASUREMENT
/begin MEASUREMENT PFlt_ctRgnStep4_mp "Regenerationsschritt 4" UBYTE OneToOne 1 100 0.00 255.0 FORMAT "%5.1" ECU_ADDRESS 0x6F8215 /end MEASUREMENT
/begin MEASUREMENT PFlt_ctRgnStep5_mp "Regenerationsschritt 5" UBYTE OneToOne 1 100 0.00 255.0 FORMAT "%5.1" ECU_ADDRESS 0x6F8216 /end MEASUREMENT
/begin MEASUREMENT PFlt_ctRgnStep6_mp "Regenerationsschritt 6" UBYTE OneToOne 1 100 0.00 255.0 FORMAT "%5.1" ECU_ADDRESS 0x6F8217 /end MEASUREMENT
/begin MEASUREMENT PFlt_ctRgnStep7_mp "Regenerationsschritt 1" UBYTE OneToOne 1 100 0.00 255.0 FORMAT "%5.1" ECU_ADDRESS 0x6F8218 /end MEASUREMENT
/begin MEASUREMENT PFlt_ctRgnStep8_mp "Regenerationsschritt 8" UBYTE OneToOne 1 100 0.00 255.0 FORMAT "%5.1" ECU_ADDRESS 0x6F8219 /end MEASUREMENT
/begin MEASUREMENT PFlt_ctRgnSum_mp "Summe Regenerationschritte 1 bis 8" UWORD OneToOne 1 100 0.00 65535.00 FORMAT "%8.2" ECU_ADDRESS 0x8FFC60 /end MEASUREMENT
/begin MEASUREMENT PFlt_ddvolFlt_mp "Änderung Abgasvolumenstrom" SWORD CubMtrPerHrPerSec 1 100 -3276.800 3276.700 FORMAT "%8.3" ECU_ADDRESS 0x8FFCA8 /end MEASUREMENT
/begin MEASUREMENT PFlt_dmNO2Tot_mp "insgesamt zur Verfügung stehender NO2-Massenstrom" SWORD dmSoot_mg_p_s 1 100 -327.6800 327.6700 FORMAT "%8.4" ECU_ADDRESS 0x8FFC36 /end MEASUREMENT
/begin MEASUREMENT PFlt_dmNOxRaw_mp "simulierte NOx-Basisemission" SWORD dmSoot_mg_p_s 1 100 -327.6800 327.6700 FORMAT "%8.4" ECU_ADDRESS 0x8FFC38 /end MEASUREMENT
/begin MEASUREMENT PFlt_dmSotSimDyn_mp "Dynamischer Anteil für produzierte Rußmasse = f(dq)" SWORD dmSoot_mg_p_s 1 100 -327.6800 327.6700 FORMAT "%8.4" ECU_ADDRESS 0x8FFC3A /end MEASUREMENT
/begin MEASUREMENT PFlt_dmSotSimEmi_mp "generierte Partikelmasse" SWORD dmSoot_mg_p_s 1 100 -327.6800 327.6700 FORMAT "%8.4" ECU_ADDRESS 0x6F8202 /end MEASUREMENT
/begin MEASUREMENT PFlt_dmSotSimRgnCRT_mp "abgebauter Partikelmassenstrom in Simulation durch CRT" SWORD dmSoot_mg_p_s 1 100 -327.6800 327.6700 FORMAT "%8.4" ECU_ADDRESS 0x6F8204 /end MEASUREMENT
/begin MEASUREMENT PFlt_dmSotSimRgnThr_mp "abgebauter Partikelmassenstrom in Simulation durch thermische Regeneration" SWORD dmSoot_mg_p_s 1 100 -327.6800 327.6700 FORMAT "%8.4" ECU_ADDRESS 0x6F8206 /end MEASUREMENT
/begin MEASUREMENT PFlt_dmSotSimRgn_mp "regenerierte Partikelmasse" SWORD dmSoot_mg_p_s 1 100 -327.6800 327.6700 FORMAT "%8.4" ECU_ADDRESS 0x6F8208 /end MEASUREMENT
/begin MEASUREMENT PFlt_dmSotSimSty_mp "stationärer Partikelmassenstrom in Simulation" SWORD dmSoot_mg_p_s 1 100 -327.6800 327.6700 FORMAT "%8.4" ECU_ADDRESS 0x8FFC3C /end MEASUREMENT
/begin MEASUREMENT PFlt_dmSotSim_mp "gesamt produzierte Partikelmasse" SWORD dmSoot_mg_p_s 1 100 -327.6800 327.6700 FORMAT "%8.4" ECU_ADDRESS 0x8FFC3E /end MEASUREMENT
/begin MEASUREMENT PFlt_dpDiffFlt_mp "Änderung Druckdifferenz" SWORD hPaPerSec 1 100 -3276.800 3276.700 FORMAT "%8.3" ECU_ADDRESS 0x8FFCAA /end MEASUREMENT
/begin MEASUREMENT PFlt_dpDiffNegDef_mp "Untere Schwelle Änderung Differenzdrucksignal" SWORD hPaPerSec 1 100 -3276.800 3276.700 FORMAT "%8.3" ECU_ADDRESS 0x8FFCAC /end MEASUREMENT
/begin MEASUREMENT PFlt_dpDiffPosDef_mp "Obere Schwelle Änderung Differenzdrucksignal" SWORD hPaPerSec 1 100 -3276.800 3276.700 FORMAT "%8.3" ECU_ADDRESS 0x8FFCAE /end MEASUREMENT
/begin MEASUREMENT PFlt_dpDiff_mp "PFlt_pDiff DT1 gefiltert" SWORD Pres_hPa 1 100 -32768.00 32767.00 FORMAT "%8.2" ECU_ADDRESS 0x8FFC40 /end MEASUREMENT
/begin MEASUREMENT PFlt_dqSetUnBal_mp "DT1-gefilterte Einspritzmasse" SWORD InjMass 1 100 -327.6800 327.6700 FORMAT "%8.4" ECU_ADDRESS 0x8FFC42 /end MEASUREMENT
/begin MEASUREMENT PFlt_dvolFlt_mp "gefilterter Abgasvolumenstrom" SWORD CubMtrPerHr 1 100 -3276.800 3276.700 FORMAT "%8.3" ECU_ADDRESS 0x8FFCB0 /end MEASUREMENT
/begin MEASUREMENT PFlt_dvolMassFlt_mp "gefillterter Abgasvolumenstrom" SWORD CubMtrPerHr 1 100 -3276.800 3276.700 FORMAT "%8.3" ECU_ADDRESS 0x8FFC44 /end MEASUREMENT
/begin MEASUREMENT PFlt_facDesCor_mp "Massenverhältnis nach Korrektur" SWORD Fact 1 100 -4.000000 3.999878 FORMAT "%8.6" ECU_ADDRESS 0x8FFC46 /end MEASUREMENT
/begin MEASUREMENT PFlt_facDpn_mp "Wärmeverlustfaktor nach Temperatursensor" SWORD Fact 1 100 -4.000000 3.999878 FORMAT "%8.6" ECU_ADDRESS 0x8FFCCE /end MEASUREMENT
/begin MEASUREMENT PFlt_facMltCor_mp "Korrekturfaktor Additivasche" SWORD Fact 1 100 -4.000000 3.999878 FORMAT "%8.6" ECU_ADDRESS 0x6F820A /end MEASUREMENT
/begin MEASUREMENT PFlt_lAvrgRgn "Mittlere Strecke der Regeneration in Kilometer" UWORD LengthKm 1 100 0.00 65535.00 FORMAT "%8.2" ECU_ADDRESS 0x7F9080 /end MEASUREMENT
/begin MEASUREMENT PFlt_mAshAdi_mp "Additivaschenmasse" SWORD mSoot_g 1 100 -327.6800 327.6700 FORMAT "%8.4" ECU_ADDRESS 0x8FFC48 /end MEASUREMENT
/begin MEASUREMENT PFlt_mAsh_mp "Aschen-Masse" SWORD mSoot_g 1 100 -327.6800 327.6700 FORMAT "%8.4" ECU_ADDRESS 0x8FFC4A /end MEASUREMENT
/begin MEASUREMENT PFlt_mSotCrv_mp "Partikelmasse zur Berücksichtung des Korrekturfaktors" SWORD mSoot_g 1 100 -327.6800 327.6700 FORMAT "%8.4" ECU_ADDRESS 0x8FFC4C /end MEASUREMENT
/begin MEASUREMENT PFlt_mSotEEPROM_mp "EEPROM wert für in DPF gespeicherte Partikelmasse" SWORD mSoot_g 1 100 -327.6800 327.6700 FORMAT "%8.4" ECU_ADDRESS 0x8FFC4E /end MEASUREMENT
/begin MEASUREMENT PFlt_mSotMeasRaw_mp "Strömungswdst. in Partikelmasse umgerechnet" SWORD mSoot_g 1 100 -327.6800 327.6700 FORMAT "%8.4" ECU_ADDRESS 0x6F820C /end MEASUREMENT
/begin MEASUREMENT PFlt_numIdxCntRgn_mp "Index der Regeneration" UBYTE OneToOne 1 100 0.00 255.0 FORMAT "%5.1" ECU_ADDRESS 0x8FFC62 /end MEASUREMENT
/begin MEASUREMENT PFlt_pAPSBPSDiff_mp "absoluter Wertunterschied zwischen APSCD_pVal und BPSCD_pLin" SWORD Pres_hPa 1 100 -32768.00 32767.00 FORMAT "%8.2" ECU_ADDRESS 0x8FFC64 /end MEASUREMENT
/begin MEASUREMENT PFlt_pAPSDvt_mp "Abweichung von APSCD_pVal bezüglich Mittelwert von BPSCD_pLin und korrigiertem PFlt_pPre" SWORD Pres_hPa 1 100 -32768.00 32767.00 FORMAT "%8.2" ECU_ADDRESS 0x8FFC66 /end MEASUREMENT
/begin MEASUREMENT PFlt_pAPSPFltPresDiff_mp "absoluter Wertunterschied zwischen APSCD_pVal und korrigiertem PFlt_pPre" SWORD Pres_hPa 1 100 -32768.00 32767.00 FORMAT "%8.2" ECU_ADDRESS 0x8FFC68 /end MEASUREMENT
/begin MEASUREMENT PFlt_pBPSDvt_mp "Abweichung von BPSCD_pLin bezüglich Mittelwert von APSCD_pVal und korrigiertem PFlt_pPre" SWORD Pres_hPa 1 100 -32768.00 32767.00 FORMAT "%8.2" ECU_ADDRESS 0x8FFC6A /end MEASUREMENT
/begin MEASUREMENT PFlt_pBPSPFltPresDiff_mp "absoluter Wertunterschied zwischen BPSCD_pLin und korrigiertem PFlt_pPre" SWORD Pres_hPa 1 100 -32768.00 32767.00 FORMAT "%8.2" ECU_ADDRESS 0x8FFC6C /end MEASUREMENT
/begin MEASUREMENT PFlt_pDiff "Differenzdruck über Partikelfilter" SWORD Pres_hPa 1 100 -32768.00 32767.00 FORMAT "%8.2" ECU_ADDRESS 0x7F9098 /end MEASUREMENT
/begin MEASUREMENT PFlt_pDiffDfl_mp "Ersatzwert für PFlt_pDiff" SWORD Pres_hPa 1 100 -32768.00 32767.00 FORMAT "%8.2" ECU_ADDRESS 0x8FFCCA /end MEASUREMENT
/begin MEASUREMENT PFlt_pDiffFlt "gefilterte Druckdifferenz" SWORD Pres_hPa 1 100 -32768.00 32767.00 FORMAT "%8.2" ECU_ADDRESS 0x7F909A /end MEASUREMENT
/begin MEASUREMENT PFlt_pDiffFlt_mp "gefilterte Druckdifferenz über Partikelfilter" SWORD Pres_hPa 1 100 -32768.00 32767.00 FORMAT "%8.2" ECU_ADDRESS 0x8FFCB2 /end MEASUREMENT
/begin MEASUREMENT PFlt_pDiffOfsValActMid_mp "Im Nachlauf gemittelter offset des Differenzdrucks[hpa]" SWORD Pres_hPa 1 100 -32768.00 32767.00 FORMAT "%8.2" ECU_ADDRESS 0x8FFCB4 /end MEASUREMENT
/begin MEASUREMENT PFlt_pDiffOfsValAct_mp "Aktueller Offset des Differenzdrucks über Partikelfilter" SWORD Pres_hPa 1 100 -32768.00 32767.00 FORMAT "%8.2" ECU_ADDRESS 0x8FFCB6 /end MEASUREMENT
/begin MEASUREMENT PFlt_pDiffOfsValOld_mp "Bisheriger Offset des Differenzdrucks über Partikelfilter" SWORD Pres_hPa 1 100 -32768.00 32767.00 FORMAT "%8.2" ECU_ADDRESS 0x8FFCB8 /end MEASUREMENT
/begin MEASUREMENT PFlt_pDiffRaw "Unkorrigierter Differenzdruck über Partikelfilter" SWORD Pres_hPa 1 100 -32768.00 32767.00 FORMAT "%8.2" ECU_ADDRESS 0x7F909C /end MEASUREMENT
/begin MEASUREMENT PFlt_pMid "Absolutdruck im Partikelfilter" SWORD Pres_hPa 1 100 -32768.00 32767.00 FORMAT "%8.2" ECU_ADDRESS 0x7F90A0 /end MEASUREMENT
/begin MEASUREMENT PFlt_pPFltOvldLckRgn_mp "Druckschwelle Überladungserkennung" SWORD Pres_hPa 1 100 -32768.00 32767.00 FORMAT "%8.2" ECU_ADDRESS 0x8FFC6E /end MEASUREMENT
/begin MEASUREMENT PFlt_pPFltOvldTrqLim_mp "Druckschwelle Überladungserkennung" SWORD Pres_hPa 1 100 -32768.00 32767.00 FORMAT "%8.2" ECU_ADDRESS 0x8FFC70 /end MEASUREMENT
/begin MEASUREMENT PFlt_pPFltPresDvt_mp "Abweichung des korrigierten PFlt_pPre bezüglich Mittelwert von APSCD_pVal und BPSCD_pLin" SWORD Pres_hPa 1 100 -32768.00 32767.00 FORMAT "%8.2" ECU_ADDRESS 0x8FFC72 /end MEASUREMENT
/begin MEASUREMENT PFlt_pPre "Druck vor Partikelfilter" SWORD Pres_hPa 1 100 -32768.00 32767.00 FORMAT "%8.2" ECU_ADDRESS 0x7F90A2 /end MEASUREMENT
/begin MEASUREMENT PFlt_pPreAshOilCorr_mp "Ausgang des PFlt_pPre-Korrekturkennfelds mit den Eingängen PFlt_dvol und PFlt_mAshOil" SWORD Pres_hPa 1 100 -32768.00 32767.00 FORMAT "%8.2" ECU_ADDRESS 0x8FFC74 /end MEASUREMENT
/begin MEASUREMENT PFlt_pPreCorr_mp "korrigierter Wert von PFlt_pPre zur Nutzung durch projektspezifische Druck-Plausibilitätsprüfungen" SWORD Pres_hPa 1 100 -32768.00 32767.00 FORMAT "%8.2" ECU_ADDRESS 0x6F821A /end MEASUREMENT
/begin MEASUREMENT PFlt_pPreFlt "gefilterter Absolutdruck vor Partikelfilter" SWORD Pres_hPa 1 100 -32768.00 32767.00 FORMAT "%8.2" ECU_ADDRESS 0x7F90A4 /end MEASUREMENT
/begin MEASUREMENT PFlt_pPreSotAshCorrSum_mp "Summe aus PFlt_pPreSotSimCorr_mp und  PFlt_pPreAshOilCorr_mp" SWORD Pres_hPa 1 100 -32768.00 32767.00 FORMAT "%8.2" ECU_ADDRESS 0x8FFC76 /end MEASUREMENT
/begin MEASUREMENT PFlt_pPreSotSimCorr_mp "Ausgang des PFlt_pPre Korrekturkennfelds mit den Eingängen PFlt_dvol und PFlt_mSotSim" SWORD Pres_hPa 1 100 -32768.00 32767.00 FORMAT "%8.2" ECU_ADDRESS 0x8FFC78 /end MEASUREMENT
/begin MEASUREMENT PFlt_pPreVolCorr_mp "Ausgang der PFlt_pPre Korrekturkennlinie mit den Eingängen PFlt_dvol und PFlt_dvol" SWORD Pres_hPa 1 100 -32768.00 32767.00 FORMAT "%8.2" ECU_ADDRESS 0x8FFC7A /end MEASUREMENT
/begin MEASUREMENT PFlt_qPoI1Des_mp "Gewünschte Einspritzmenge für Nacheinspritzung 1" SWORD InjMassInj 1 100 -327.6800 327.6700 FORMAT "%8.4" ECU_ADDRESS 0x8FFCD0 /end MEASUREMENT
/begin MEASUREMENT PFlt_rEngPrtRgn_mp "Motorschutz Regenerationsverhältnis der Aufgabezeit und letzter Regenerationszeit" SWORD Prc 1 100 -400.0000 399.9878 FORMAT "%8.4" ECU_ADDRESS 0x6F821C /end MEASUREMENT
/begin MEASUREMENT PFlt_resFlowAdiOfs_mp "Strömungswiderstandoffset durch Additivasche" SWORD Res_hPaHrPerCM 1 100 -32.76800 32.76700 FORMAT "%8.5" ECU_ADDRESS 0x8FFC50 /end MEASUREMENT
/begin MEASUREMENT PFlt_resFlowInv_mp "Strömungswiderstand abgeleitet aus Russmasse" SWORD Res_hPaHrPerCM 1 100 -32.76800 32.76700 FORMAT "%8.5" ECU_ADDRESS 0x8FFC52 /end MEASUREMENT
/begin MEASUREMENT PFlt_resFlowOilOfs_mp "Strömungswiderstandoffset durch Additivasche" SWORD Res_hPaHrPerCM 1 100 -32.76800 32.76700 FORMAT "%8.5" ECU_ADDRESS 0x8FFC54 /end MEASUREMENT
/begin MEASUREMENT PFlt_resFlowOvldLckRgn_mp "" SWORD Res_hPaHrPerCM 1 100 -32.76800 32.76700 FORMAT "%8.5" ECU_ADDRESS 0x8FFC7C /end MEASUREMENT
/begin MEASUREMENT PFlt_resFlowOvldTrqLim_mp "" SWORD Res_hPaHrPerCM 1 100 -32.76800 32.76700 FORMAT "%8.5" ECU_ADDRESS 0x8FFC7E /end MEASUREMENT
/begin MEASUREMENT PFlt_resFlowRaw_mp "Strömungswiderstand Rohwert" SWORD Res_hPaHrPerCM 1 100 -32.76800 32.76700 FORMAT "%8.5" ECU_ADDRESS 0x6F820E /end MEASUREMENT
/begin MEASUREMENT PFlt_stAftRunDelDem "Nachlaufverzögerung für Partikelfiltermonitor" UBYTE OneToOne 1 100 0.00 255.0 FORMAT "%5.1" ECU_ADDRESS 0x7F89AA /end MEASUREMENT
/begin MEASUREMENT PFlt_stAPSPlausDefHigh_mp "APSCD_pVal Abweichung ist positiv und fehlerhaft" UBYTE OneToOne 1 100 0.00 255.0 FORMAT "%5.1" ECU_ADDRESS 0x8FFC80 /end MEASUREMENT
/begin MEASUREMENT PFlt_stAPSPlausDefLow_mp "APSCD_pVal Abweichung ist negativ und fehlerhaft" UBYTE OneToOne 1 100 0.00 255.0 FORMAT "%5.1" ECU_ADDRESS 0x8FFC81 /end MEASUREMENT
/begin MEASUREMENT PFlt_stBPSPlausDefHigh_mp "BPSCD_pLin Abweichung ist positiv und fehlerhaft" UBYTE OneToOne 1 100 0.00 255.0 FORMAT "%5.1" ECU_ADDRESS 0x8FFC82 /end MEASUREMENT
/begin MEASUREMENT PFlt_stBPSPlausDefLow_mp "BPSCD_pLin Abweichung ist negativ und fehlerhaft" UBYTE OneToOne 1 100 0.00 255.0 FORMAT "%5.1" ECU_ADDRESS 0x8FFC83 /end MEASUREMENT
/begin MEASUREMENT PFlt_stEngPrtRgn_mp "Status der Motorschutz-Regeneration" UWORD OneToOne 1 100 0.00 65535.00 FORMAT "%8.2" ECU_ADDRESS 0x8FFC84 /end MEASUREMENT
/begin MEASUREMENT PFlt_stLckTempPlaus_mp "Verriegelungsstatus Plausibilisierung Temperatursensoren" UBYTE OneToOne 1 100 0.00 255.0 FORMAT "%5.1" ECU_ADDRESS 0x8FFCBA /end MEASUREMENT
/begin MEASUREMENT PFlt_stLckTmr_mp "Verriegelung Timer Temperaturplausibilisierung" UBYTE OneToOne 1 100 0.00 255.0 FORMAT "%5.1" ECU_ADDRESS 0x8FFCBB /end MEASUREMENT
/begin MEASUREMENT PFlt_stPresDiffPlaus_mp "Zustand Plausibilisierung Differenzdrucksignal" UBYTE OneToOne 1 100 0.00 255.0 FORMAT "%5.1" ECU_ADDRESS 0x8FFCBC /end MEASUREMENT
/begin MEASUREMENT PFlt_stPresPlausDefHigh_mp "PFlt_pPreCorr_mp ist positiv und fehlerhaft" UBYTE OneToOne 1 100 0.00 255.0 FORMAT "%5.1" ECU_ADDRESS 0x8FFC86 /end MEASUREMENT
/begin MEASUREMENT PFlt_stPresPlausDefLow_mp "PFlt_pPreCorr_mp ist negativ und fehlerhaft" UBYTE OneToOne 1 100 0.00 255.0 FORMAT "%5.1" ECU_ADDRESS 0x8FFC87 /end MEASUREMENT
/begin MEASUREMENT PFlt_stPresPlausLoIdl_mp "Bit-kodierte Informationen, um projektspezifische Druck-Plausibilitätsprüfungen im niedrigen Leerlaufzustand zu ermöglichen" UBYTE OneToOne 1 100 0.00 255.0 FORMAT "%5.1" ECU_ADDRESS 0x8FFC88 /end MEASUREMENT
/begin MEASUREMENT PFlt_stPresPlausOk_mp "Zur Anzeige, ob projektspezifische Druck-Plausibilitätsprüfungen in Ordnung sind" UBYTE OneToOne 1 100 0.00 255.0 FORMAT "%5.1" ECU_ADDRESS 0x8FFC89 /end MEASUREMENT
/begin MEASUREMENT PFlt_stPresPlausTst_mp "Zustandsgröße zur Anzeige, ob projektspezifische Druck-Plausibilitätsprüfungen aktiv sind oder nicht" UBYTE OneToOne 1 100 0.00 255.0 FORMAT "%5.1" ECU_ADDRESS 0x8FFC8A /end MEASUREMENT
/begin MEASUREMENT PFlt_stPresPlaus_mp "Bit-kodierte Informationen, um projektspezifische Druck-Plausibilitätsprüfungen zu ermöglichen" UBYTE OneToOne 1 100 0.00 255.0 FORMAT "%5.1" ECU_ADDRESS 0x6F821E /end MEASUREMENT
/begin MEASUREMENT PFlt_stResFlowHi_mp "Obere Schwelle Resflow-SRC überschritten" UBYTE OneToOne 1 100 0.00 255.0 FORMAT "%5.1" ECU_ADDRESS 0x8FFCBD /end MEASUREMENT
/begin MEASUREMENT PFlt_stResFlowLo_mp "Untere Schwelle ResFlow-SRC unterschritten" UBYTE OneToOne 1 100 0.00 255.0 FORMAT "%5.1" ECU_ADDRESS 0x8FFCBE /end MEASUREMENT
/begin MEASUREMENT PFlt_stRgnRlsOff_mp "Filter is no longer regeneratable" UBYTE OneToOne 1 100 0.00 255.0 FORMAT "%5.1" ECU_ADDRESS 0x8FFC8B /end MEASUREMENT
/begin MEASUREMENT PFlt_stRlsmSotCtl_mp "Status der Motorschutz-Regeneration zur Freigabe der Rußregelung" UBYTE OneToOne 1 100 0.00 255.0 FORMAT "%5.1" ECU_ADDRESS 0x8FFC8C /end MEASUREMENT
/begin MEASUREMENT PFlt_stSimOn_mp "Statuswort Simulation aktiv" UBYTE OneToOne 1 100 0.00 255.0 FORMAT "%5.1" ECU_ADDRESS 0x8FFC56 /end MEASUREMENT
/begin MEASUREMENT PFlt_stTempPlausDone_mp "Statusbit Plausibilisierung Temperatursensoren durchgeführt" UBYTE OneToOne 1 100 0.00 255.0 FORMAT "%5.1" ECU_ADDRESS 0x8FFCBF /end MEASUREMENT
/begin MEASUREMENT PFlt_tDiffCorr_mp "Temperaturabweichung durch instationären Betrieb" SWORD TempDiff_Cels 1 100 -3276.800 3276.700 FORMAT "%8.3" ECU_ADDRESS 0x8FFCD2 /end MEASUREMENT
/begin MEASUREMENT PFlt_tDwnStrm_mp "Zweite Abgastemperatur zur Überwachung" SWORD Temp_Cels 1 100 -50.140 899.860 FORMAT "%8.3" ECU_ADDRESS 0x8FFCC0 /end MEASUREMENT
/begin MEASUREMENT PFlt_tExhGsStyRgn1_mp "Temperatur der statischen Rußemission für Regeneration 1" SWORD TempDiff_Cels 1 100 -3276.800 3276.700 FORMAT "%8.3" ECU_ADDRESS 0x8FFCD4 /end MEASUREMENT
/begin MEASUREMENT PFlt_tExhGsStyRgn2 "OxiCat Temperatur-Korrekturfaktor" SWORD TempDiff_Cels 1 100 -3276.800 3276.700 FORMAT "%8.3" ECU_ADDRESS 0x7F90BE /end MEASUREMENT
/begin MEASUREMENT PFlt_tHtTransCor_mp "Temperaturkorrekturwert Wärmeübergang" SWORD TempDiff_Cels 1 100 -3276.800 3276.700 FORMAT "%8.3" ECU_ADDRESS 0x8FFCD6 /end MEASUREMENT
/begin MEASUREMENT PFlt_tIATLoLvl_mp "niedrigster Wert der Ansauglufttemperatur" SWORD Temp_Cels 1 100 -50.140 899.860 FORMAT "%8.3" ECU_ADDRESS 0x8FFCC2 /end MEASUREMENT
/begin MEASUREMENT PFlt_tiChkTmpPlaus_mp "Abgelaufene Zeit nach Motorstopp, wenn die EEPROM-Zähler noch nicht abgelaufen ist." UWORD Time_s 1 100 0.00 655.3500 FORMAT "%8.4" ECU_ADDRESS 0x8FFCC4 /end MEASUREMENT
/begin MEASUREMENT PFlt_tiExhGsDel_mp "Verzögerungszeit Abgas" SWORD TimeDelay_s_Lin_16_2 1 100 -2000.061 2000.000 FORMAT "%8.3" ECU_ADDRESS 0x8FFCD8 /end MEASUREMENT
/begin MEASUREMENT PFlt_tiHtTransDT1_mp "Wärmeübergangszeit" SWORD TimeDelay_s_Lin_16_2 1 100 -2000.061 2000.000 FORMAT "%8.3" ECU_ADDRESS 0x8FFCDA /end MEASUREMENT
/begin MEASUREMENT PFlt_tiOpOld_mp "Aus EEPROM gelesene Dauer des Motorschutzes bei der Initialisierung" ULONG TimeEngOn 1 100 0.00 4294967295.00 FORMAT "%13.2" ECU_ADDRESS 0x8FFC90 /end MEASUREMENT
/begin MEASUREMENT PFlt_tiSnceFstEngPrtRgn_mp "Zeit seit der ersten Motorschutz-Regeneration" ULONG TimeEngOn 1 100 0.00 4294967295.00 FORMAT "%13.2" ECU_ADDRESS 0x8FFC94 /end MEASUREMENT
/begin MEASUREMENT PFlt_tOxiPre "Temperatur vor Oxidationskatalysator" SWORD Temp_Cels 1 100 -50.140 899.860 FORMAT "%8.3" ECU_ADDRESS 0x7F90C0 /end MEASUREMENT
/begin MEASUREMENT PFlt_tOxiPreDiffMax_mp "Maximaler Schwellwert für die Differenz zwischen Temperatur vor Partikelfilter und stationärer Temperatur für den Oxicat" SWORD Temp_Cels 1 100 -50.140 899.860 FORMAT "%8.3" ECU_ADDRESS 0x8FFC98 /end MEASUREMENT
/begin MEASUREMENT PFlt_tOxiPreDiff_mp "Difference between upstream temperature and stationary temperature" SWORD Temp_Cels 1 100 -50.140 899.860 FORMAT "%8.3" ECU_ADDRESS 0x8FFC9A /end MEASUREMENT
/begin MEASUREMENT PFlt_tOxiPreMax_mp "Maximale Temperatur vor Partikelfilter für den Oxicat" SWORD Temp_Cels 1 100 -50.140 899.860 FORMAT "%8.3" ECU_ADDRESS 0x8FFC9C /end MEASUREMENT
/begin MEASUREMENT PFlt_tOxiPreRaw_mp "Kennfeldberechnete Temperatur vor dem Oxi-Kat" SWORD Temp_Cels 1 100 -50.140 899.860 FORMAT "%8.3" ECU_ADDRESS 0x8FFCDC /end MEASUREMENT
/begin MEASUREMENT PFlt_tOxiPreRgnMax_mp "Maximaler Abgasgegendruck vor Oxicat im Regenerationsfall" SWORD Temp_Cels 1 100 -50.140 899.860 FORMAT "%8.3" ECU_ADDRESS 0x8FFC9E /end MEASUREMENT
/begin MEASUREMENT PFlt_tOxiPreSty "Stationäre Temperatur vor Oxidationskatalysator" SWORD Temp_Cels 1 100 -50.140 899.860 FORMAT "%8.3" ECU_ADDRESS 0x7F90C2 /end MEASUREMENT
/begin MEASUREMENT PFlt_tPFltMon_mp "Motortemperatur aus Kennfeld" SWORD Temp_Cels 1 100 -50.140 899.860 FORMAT "%8.3" ECU_ADDRESS 0x8FFCC6 /end MEASUREMENT
/begin MEASUREMENT PFlt_tPre "Abgastemp. vor Partikelfilter" SWORD Temp_Cels 1 100 -50.140 899.860 FORMAT "%8.3" ECU_ADDRESS 0x7F90C6 /end MEASUREMENT
/begin MEASUREMENT PFlt_tPreCorr_mp "Korrigiertes Temperatursignal vor Partikelfilter" SWORD Temp_Cels 1 100 -50.140 899.860 FORMAT "%8.3" ECU_ADDRESS 0x8FFCDE /end MEASUREMENT
/begin MEASUREMENT PFlt_tPreDiffMax_mp "Maximaler Schwellwert für die Differenz zwischen Temperatur vor Partikelfilter und Stationärer Temperatur für Oxicat" SWORD Temp_Cels 1 100 -50.140 899.860 FORMAT "%8.3" ECU_ADDRESS 0x8FFCA0 /end MEASUREMENT
/begin MEASUREMENT PFlt_tPreDiff_mp "Difference between upstream temperature and stationary temperature" SWORD Temp_Cels 1 100 -50.140 899.860 FORMAT "%8.3" ECU_ADDRESS 0x8FFCA2 /end MEASUREMENT
/begin MEASUREMENT PFlt_tPreMax_mp "Maximale Temperatur vor Partikelfilter" SWORD Temp_Cels 1 100 -50.140 899.860 FORMAT "%8.3" ECU_ADDRESS 0x8FFCA4 /end MEASUREMENT
/begin MEASUREMENT PFlt_tPrePhysFlt_mp "PT1-gefilterter Wert von PFlt_tOxiPre" SWORD Temp_Cels 1 100 -50.140 899.860 FORMAT "%8.3" ECU_ADDRESS 0x8FFCCC /end MEASUREMENT
/begin MEASUREMENT PFlt_tPreRaw_mp "Kennfeldberechnete Temperatur vor dem Partikelfilter" SWORD Temp_Cels 1 100 -50.140 899.860 FORMAT "%8.3" ECU_ADDRESS 0x8FFCE0 /end MEASUREMENT
/begin MEASUREMENT PFlt_tPreRgnMax_mp "Maximaler Abgasdruck im Regenerationsfall" SWORD Temp_Cels 1 100 -50.140 899.860 FORMAT "%8.3" ECU_ADDRESS 0x8FFCA6 /end MEASUREMENT
/begin MEASUREMENT PFlt_tPreSty "Stationäre Temperatur vor Partikelfilter" SWORD Temp_Cels 1 100 -50.140 899.860 FORMAT "%8.3" ECU_ADDRESS 0x7F90C8 /end MEASUREMENT
/begin MEASUREMENT PFlt_tPstSim "Simulierte Temperatur nach Partikelfilter" SWORD Temp_Cels 1 100 -50.140 899.860 FORMAT "%8.3" ECU_ADDRESS 0x7F90CA /end MEASUREMENT
/begin MEASUREMENT PFlt_tSurf "Oberflächen Temperatur vom Partikel Filter" SWORD Temp_Cels 1 100 -50.140 899.860 FORMAT "%8.3" ECU_ADDRESS 0x7F90CC /end MEASUREMENT
/begin MEASUREMENT PFlt_tSurfSim_mp "modellierte Partikelfilteroberflächentemperatur" SWORD Temp_Cels 1 100 -50.140 899.860 FORMAT "%8.3" ECU_ADDRESS 0x8FFCE2 /end MEASUREMENT
/begin MEASUREMENT PFlt_tTotCor_mp "Additiver Temperaturkorrekturwert" SWORD TempDiff_Cels 1 100 -3276.800 3276.700 FORMAT "%8.3" ECU_ADDRESS 0x8FFCE4 /end MEASUREMENT
/begin MEASUREMENT PFlt_tUpStrm_mp "Erste Abgastemperatur zur Überwachung" SWORD Temp_Cels 1 100 -50.140 899.860 FORMAT "%8.3" ECU_ADDRESS 0x8FFCC8 /end MEASUREMENT
/begin MEASUREMENT PFlt_volAddTot_mp "Gesamt eingespritzte Additivvolumen (grob Auflösung)" SWORD volAdd_ml2 1 100 -32768.00 32767.00 FORMAT "%8.2" ECU_ADDRESS 0x8FFC58 /end MEASUREMENT
/begin MEASUREMENT PrpBrk_trqDes "Vortriebsmomentwunsch der Längsbewegung" SWORD TrqPrp 1 100 -6553.600 6553.400 FORMAT "%8.3" ECU_ADDRESS 0x7F90D2 /end MEASUREMENT
/begin MEASUREMENT PrpBrk_trqLead "Vorhaltmoment der Längsbewegung" SWORD TrqPrp 1 100 -6553.600 6553.400 FORMAT "%8.3" ECU_ADDRESS 0x7F90D4 /end MEASUREMENT
/begin MEASUREMENT PrpCtl_stSPTrack_mp "Messpunkt Status Sollwertnachführung" UBYTE OneToOne 1 100 0.00 255.0 FORMAT "%5.1" ECU_ADDRESS 0x8FFCEE /end MEASUREMENT
/begin MEASUREMENT PrpCtl_swtSpdLim "SW-Schalter Aktivierung Geschwindigkeitsbegrenzung (0: deaktiviert, 1 aktiviert)" UBYTE OneToOne 1 100 0.00 255.0 FORMAT "%5.1" ECU_ADDRESS 0x7F89BB /end MEASUREMENT
/begin MEASUREMENT PrpCtl_trqI_mp "Status I-Anteil" SLONG TrqPrp 1 100 -429496729.600 429496729.400 FORMAT "%13.3" ECU_ADDRESS 0x8FFCF0 /end MEASUREMENT
/begin MEASUREMENT PrpCtl_trqP_mp "Status PI-Anteil" SWORD TrqPrp 1 100 -6553.600 6553.400 FORMAT "%8.3" ECU_ADDRESS 0x8FFCF4 /end MEASUREMENT
/begin MEASUREMENT PrpCtl_trqSpdLim "begrenztes Moment für Höchstgeschwindigkeitsbegrenzung" SWORD TrqPrp 1 100 -6553.600 6553.400 FORMAT "%8.3" ECU_ADDRESS 0x7F90D6 /end MEASUREMENT
/begin MEASUREMENT PrpCtl_vCurrTrack_mp "Messpunkt des nachgeführten Geschwindigkeitssollwertes" SWORD Vel 1 100 -327.6800 327.6700 FORMAT "%8.4" ECU_ADDRESS 0x8FFCF6 /end MEASUREMENT
/begin MEASUREMENT PrpCtl_vSpdCorr_mp "Fahrzeuggeschwindigkeit nach Multiplikation mit Korrekturfaktor" SWORD Vel 1 100 -327.6800 327.6700 FORMAT "%8.4" ECU_ADDRESS 0x8FFCF8 /end MEASUREMENT
/begin MEASUREMENT Prp_rAPP "verknüpfte Fahrpedalstellung PWG und virtuelles PWG" SWORD Prc 1 100 -400.0000 399.9878 FORMAT "%8.4" ECU_ADDRESS 0x7F90D8 /end MEASUREMENT
/begin MEASUREMENT Prp_rVirtAPP "virtuelle Fahrpedalstellung bei FGR oder HGB" SWORD Prc 1 100 -400.0000 399.9878 FORMAT "%8.4" ECU_ADDRESS 0x7F90DA /end MEASUREMENT
/begin MEASUREMENT Prp_rVirtEngPrp_mp "Virtuelle Fahrpedalstellung aus inversem Fahrverhaltenkennfeld" SWORD Prc 1 100 -400.0000 399.9878 FORMAT "%8.4" ECU_ADDRESS 0x8FFCE6 /end MEASUREMENT
/begin MEASUREMENT Prp_rVirtOvrRun_mp "Virtuelle Fahrpedalstellung aus der inversen Schubkennlinie" SWORD Prc 1 100 -400.0000 399.9878 FORMAT "%8.4" ECU_ADDRESS 0x8FFCE8 /end MEASUREMENT
/begin MEASUREMENT Prp_stPrpSel "ACC or FGR present" UBYTE OneToOne 1 100 0.00 255.0 FORMAT "%5.1" ECU_ADDRESS 0x7F89BC /end MEASUREMENT
/begin MEASUREMENT Prp_stTrqTypePrp "Indikator ob Verlustmomentenkompensation applikativ deaktiviert ist" UBYTE OneToOne 1 100 0.00 255.0 FORMAT "%5.1" ECU_ADDRESS 0x7F89BD /end MEASUREMENT
/begin MEASUREMENT Prp_stVirtApp "virtuellle PWG-Stellung überschreibt die gemessene" UBYTE OneToOne 1 100 0.00 255.0 FORMAT "%5.1" ECU_ADDRESS 0x7F89BE /end MEASUREMENT
/begin MEASUREMENT Prp_trqDesCC "Momentenanforderung FGR oder ACC" SWORD TrqPrp 1 100 -6553.600 6553.400 FORMAT "%8.3" ECU_ADDRESS 0x7F90DC /end MEASUREMENT
/begin MEASUREMENT Prp_trqEng "Vortriebsmoment in innerem Moment" SWORD Trq 1 100 -3276.800 3276.700 FORMAT "%8.3" ECU_ADDRESS 0x7F90DE /end MEASUREMENT
/begin MEASUREMENT Prp_trqEngPrp_mp "Meßpunkt der Auswahl zwischen Prp_trqEng oder Prp_trqPrp" SWORD TrqPrp 1 100 -6553.600 6553.400 FORMAT "%8.3" ECU_ADDRESS 0x8FFCEA /end MEASUREMENT
/begin MEASUREMENT Prp_trqLead "Vorhaltmoment des Vortriebs" SWORD TrqPrp 1 100 -6553.600 6553.400 FORMAT "%8.3" ECU_ADDRESS 0x7F90E0 /end MEASUREMENT
/begin MEASUREMENT Prp_trqPrp "Vortriebsmoment" SWORD TrqPrp 1 100 -6553.600 6553.400 FORMAT "%8.3" ECU_ADDRESS 0x7F90E2 /end MEASUREMENT
/begin MEASUREMENT Prp_trqRaw "Vortriebsmomentwunsch vor Führungsformer" SWORD TrqPrp 1 100 -6553.600 6553.400 FORMAT "%8.3" ECU_ADDRESS 0x7F90E4 /end MEASUREMENT
/begin MEASUREMENT Prp_trqRawLim "Grenzwert des Vortriebsmomentenrohwertes" SWORD TrqPrp 1 100 -6553.600 6553.400 FORMAT "%8.3" ECU_ADDRESS 0x7F90E6 /end MEASUREMENT
/begin MEASUREMENT Prp_trqThresPrp_mp "Drehmomentenschwelle zur Unterscheidung zwischen Zug- und Schubbetrieb" SWORD TrqPrp 1 100 -6553.600 6553.400 FORMAT "%8.3" ECU_ADDRESS 0x8FFCEC /end MEASUREMENT
/begin MEASUREMENT PSPCD_dvol1_mp "limiting value of fuel depending on engine speed  and fuel temperature" SWORD FlConsum_l_h 1 100 -327.6800 327.6700 FORMAT "%8.4" ECU_ADDRESS 0x8FFCFC /end MEASUREMENT
/begin MEASUREMENT PSPCD_dvol2_mp "Output value after correction based on fuel temperature" SWORD FlConsum_l_h 1 100 -327.6800 327.6700 FORMAT "%8.4" ECU_ADDRESS 0x8FFCFE /end MEASUREMENT
/begin MEASUREMENT PSPCD_dvolOut "Output fuel consumption quantity from PSPCD" SWORD FlConsum_l_h 1 100 -327.6800 327.6700 FORMAT "%8.4" ECU_ADDRESS 0x7F90D0 /end MEASUREMENT
/begin MEASUREMENT PSPCD_dvolOut0_mp "limiting output fuel volume" SWORD FlConsum_l_h 1 100 -327.6800 327.6700 FORMAT "%8.4" ECU_ADDRESS 0x8FFD00 /end MEASUREMENT
/begin MEASUREMENT PSPCD_dvolOut1_mp "Fuel quantity value depending on timer" SWORD FlConsum_l_h 1 100 -327.6800 327.6700 FORMAT "%8.4" ECU_ADDRESS 0x8FFD02 /end MEASUREMENT
/begin MEASUREMENT PSPCD_dvolOut2_mp "Output fuel quantity depending on the Engine speed" SWORD FlConsum_l_h 1 100 -327.6800 327.6700 FORMAT "%8.4" ECU_ADDRESS 0x8FFD04 /end MEASUREMENT
/begin MEASUREMENT PSPCD_dvolOut3_mp "Pre Supply Pump output value" SWORD FlConsum_l_h 1 100 -327.6800 327.6700 FORMAT "%8.4" ECU_ADDRESS 0x8FFD06 /end MEASUREMENT
/begin MEASUREMENT PSPCD_rActrOut_mp "Vorförderpumpe Ansteuertastverhältnis" SWORD OneToOne 1 100 -32768.00 32767.00 FORMAT "%8.2" ECU_ADDRESS 0x8FFD08 /end MEASUREMENT
/begin MEASUREMENT PSPCD_stLogic_mp "Status of Engine,T15" UBYTE OneToOne 1 100 0.00 255.0 FORMAT "%5.1" ECU_ADDRESS 0x8FFD0A /end MEASUREMENT
/begin MEASUREMENT PSPCD_tiT15Delay_mp "Time till which timer should run" SWORD Time_ms 1 100 -327680.0 327670.0 FORMAT "%8.1" ECU_ADDRESS 0x8FFD0C /end MEASUREMENT
/begin MEASUREMENT PSP_stEKPCrash_mp "Abschaltung der EKP" UBYTE OneToOne 1 100 0.00 255.0 FORMAT "%5.1" ECU_ADDRESS 0x8FFCFA /end MEASUREMENT
/begin MEASUREMENT PSP_stLogicOut "Quelle für Aktivierung der Vorförderpumpr (1=Ein / 0=Aus)" UBYTE OneToOne 1 100 0.00 255.0 FORMAT "%5.1" ECU_ADDRESS 0x7F89B9 /end MEASUREMENT
/begin MEASUREMENT PSP_stPSPOff "EKP shutoff if crash dedected" UBYTE OneToOne 1 100 0.00 255.0 FORMAT "%5.1" ECU_ADDRESS 0x7F89BA /end MEASUREMENT
/begin MEASUREMENT QLTCD_B_ozfbsd_mp "oz-Kommunikationsfehler" UBYTE B_TRUE 1 100 0.00 1.00000000000 FORMAT "%13.11" ECU_ADDRESS 0x8FFD0E /end MEASUREMENT
/begin MEASUREMENT QLTCD_B_qltdetec_mp "" UBYTE B_TRUE 1 100 0.00 1.00000000000 FORMAT "%13.11" ECU_ADDRESS 0x8FFD0F /end MEASUREMENT
/begin MEASUREMENT QLTCD_cntComOk_mp "" UBYTE OneToOne 1 100 0.00 255.0 FORMAT "%5.1" ECU_ADDRESS 0x8FFD10 /end MEASUREMENT
/begin MEASUREMENT QLTCD_CommErr_mp "bss-Kommunikationsfehler" UBYTE OneToOne 1 100 0.00 255.0 FORMAT "%5.1" ECU_ADDRESS 0x8FFD11 /end MEASUREMENT
/begin MEASUREMENT QLTCD_oznivr "Ölstand von der BSD-Schnittstelle" UBYTE DEZ 1 100 0.00 255.0 FORMAT "%5.1" ECU_ADDRESS 0x7F89D5 /end MEASUREMENT
/begin MEASUREMENT QLTCD_ozpermr_w "Ölpermittivität von der BSD-Schnittstelle" UWORD DEZ 1 100 0.00 65535.00 FORMAT "%8.2" ECU_ADDRESS 0x7F9100 /end MEASUREMENT
/begin MEASUREMENT QLTCD_ozstatus "Zustand der BSD-Schnittstelle" UBYTE DEZ 1 100 0.00 255.0 FORMAT "%5.1" ECU_ADDRESS 0x7F89D6 /end MEASUREMENT
/begin MEASUREMENT QLTCD_oztempr "Öltemperatur von der BSD-Schnittstelle" UBYTE DEZ 1 100 0.00 255.0 FORMAT "%5.1" ECU_ADDRESS 0x7F89D7 /end MEASUREMENT
/begin MEASUREMENT QLTCD_oz_permh_r_mp "High-Byte der Ölpermittivität" UBYTE OneToOne 1 100 0.00 255.0 FORMAT "%5.1" ECU_ADDRESS 0x8FFD12 /end MEASUREMENT
/begin MEASUREMENT QLTCD_oz_perml_r_mp "Low-Byte der Ölpermittivität" UBYTE OneToOne 1 100 0.00 255.0 FORMAT "%5.1" ECU_ADDRESS 0x8FFD13 /end MEASUREMENT
/begin MEASUREMENT QLTCD_State_Handler_mp "Zustand nach Meldung oder Fehlerbehandler" UWORD OneToOne 1 100 0.00 65535.00 FORMAT "%8.2" ECU_ADDRESS 0x8FFD14 /end MEASUREMENT
/begin MEASUREMENT QLTCD_State_mp "Zustand des ibs-Komponententreibers" UWORD OneToOne 1 100 0.00 65535.00 FORMAT "%8.2" ECU_ADDRESS 0x8FFD16 /end MEASUREMENT
/begin MEASUREMENT QLTCD_stComQLTActiv "Zustand der BSD-Schnittstelle" UBYTE DEZ 1 100 0.00 255.0 FORMAT "%5.1" ECU_ADDRESS 0x7F89D8 /end MEASUREMENT
/begin MEASUREMENT QLTCD_stDetection_mp "" UBYTE QltDet 1 100 0.00 2.00000000000 FORMAT "%13.11" ECU_ADDRESS 0x8FFD18 /end MEASUREMENT
/begin MEASUREMENT QLTCD_stTBss_Active_mp "Zustand der BSD-Schnittstelle" UBYTE B_TRUE 1 100 0.00 1.00000000000 FORMAT "%13.11" ECU_ADDRESS 0x8FFD19 /end MEASUREMENT
/begin MEASUREMENT QLTCD_SwitchState_mp "Zustand des Lesen-/Schreiben-Registerteils" UWORD OneToOne 1 100 0.00 65535.00 FORMAT "%8.2" ECU_ADDRESS 0x8FFD1A /end MEASUREMENT
/begin MEASUREMENT RailCD_ctPMonStrt_mp "counter for error monitoring" ULONG Time_ms 1 100 0.00 42949672950.0 FORMAT "%13.1" ECU_ADDRESS 0x8FFE14 /end MEASUREMENT
/begin MEASUREMENT RailCD_pAct_mp "aktueller Kraftstoffdruck" SWORD Pres_Rail 1 100 -3276.800 3276.700 FORMAT "%5.3" ECU_ADDRESS 0x6F823A /end MEASUREMENT
/begin MEASUREMENT RailCD_pFltWinNeg_mp "Raildruckabfall, ab welchem auf Großsignalparameter umgeschaltet wird" SWORD Pres_Rail 1 100 -3276.800 3276.700 FORMAT "%5.3" ECU_ADDRESS 0x8FFE02 /end MEASUREMENT
/begin MEASUREMENT RailCD_pLin_mp "linearisierter Wert des Kraftstoffdrucksensors" SWORD Pres_Rail 1 100 -3276.800 3276.700 FORMAT "%5.3" ECU_ADDRESS 0x8FFE04 /end MEASUREMENT
/begin MEASUREMENT RailCD_pPeak "maximaler Raildruck der letzten 10ms" SWORD Pres_Rail 1 100 -3276.800 3276.700 FORMAT "%5.3" ECU_ADDRESS 0x7F9102 /end MEASUREMENT
/begin MEASUREMENT RailCD_stEngStrtMov_mp "Motorbewegung bei Offset-Überwachung des Raildrucksensors festgestellt" UBYTE OneToOne 1 100 0.00 255.0 FORMAT "%5.1" ECU_ADDRESS 0x8FFE0C /end MEASUREMENT
/begin MEASUREMENT RailCD_stMon_mp "Überwachungsstatus des Spannungsoffsets des Raildrucksensors" UBYTE OneToOne 1 100 0.00 255.0 FORMAT "%5.1" ECU_ADDRESS 0x8FFE0D /end MEASUREMENT
/begin MEASUREMENT RailCD_stOfsTstMon "aktueller Zustand der Offset-Überwachung für den Raildrucksensor" UBYTE OneToOne 1 100 0.00 255.0 FORMAT "%5.1" ECU_ADDRESS 0x7F89D9 /end MEASUREMENT
/begin MEASUREMENT RailCD_tClntLstCyc_mp "Wassertemperatur vom letzten Fahrzyklus für die Offset-Überwachung des Raildrucksensors" SWORD Temp_Cels 1 100 -50.140 899.860 FORMAT "%8.3" ECU_ADDRESS 0x8FFE0E /end MEASUREMENT
/begin MEASUREMENT RailCD_tiFltPT1_mp "momentane Filterzeit für PT1 Filter" ULONG TimeDelay_s 1 100 0.0000010000000 4294.9673 FORMAT "%9.4" ECU_ADDRESS 0x8FFE08 /end MEASUREMENT
/begin MEASUREMENT RailCD_tiOfsTstDel_mp "Verzögerungszeit = f(RailCD_pPeak) für Offset-Test des Raildrucksensors im Nachlauf" SWORD TimeRed 1 100 -5242.880 5242.720 FORMAT "%8.3" ECU_ADDRESS 0x8FFE10 /end MEASUREMENT
/begin MEASUREMENT RailCD_uOfsAftRun "Spannungswert des Raildrucksensors während aktiver Überwachung im Nachlauf" SWORD Volt 1 100 -160156.4 160151.5 FORMAT "%8.1" ECU_ADDRESS 0x7F9104 /end MEASUREMENT
/begin MEASUREMENT RailCD_uOfsStrt "Spannungswert des Raildrucksensors während aktiver Überwachung in der Startphase" SWORD Volt 1 100 -160156.4 160151.5 FORMAT "%8.1" ECU_ADDRESS 0x7F910A /end MEASUREMENT
/begin MEASUREMENT RailCD_uPeakRaw "Rohwert des Raildrucks" SWORD Volt 1 100 -160156.4 160151.5 FORMAT "%8.1" ECU_ADDRESS 0x7F9110 /end MEASUREMENT
/begin MEASUREMENT Rail_dvolEstAged "geschätzer Volumenstrom eines gealterten Systems" SWORD Qp_mm3_sec 1 100 -327680.0 327670.0 FORMAT "%8.1" ECU_ADDRESS 0x7F9114 /end MEASUREMENT
/begin MEASUREMENT Rail_dvolMeUnCtlDT1_mp "DT1-Anteil des Druckreglers über Zumesseinheit" SWORD Qp_mm3_sec 1 100 -327680.0 327670.0 FORMAT "%8.1" ECU_ADDRESS 0x8FFD68 /end MEASUREMENT
/begin MEASUREMENT Rail_dvolMeUnCtlI "I-Anteil des Druckreglers der Zumesseinheit" SWORD Qp_mm3_sec 1 100 -327680.0 327670.0 FORMAT "%8.1" ECU_ADDRESS 0x7F9116 /end MEASUREMENT
/begin MEASUREMENT Rail_dvolMeUnCtlP_mp "P-Anteil des Druckreglers über Zumesseinheit" SWORD Qp_mm3_sec 1 100 -327680.0 327670.0 FORMAT "%8.1" ECU_ADDRESS 0x8FFD6A /end MEASUREMENT
/begin MEASUREMENT Rail_dvolMeUnCtlUpLim "obere Stellwertbegrenzung für Druckregelung über Zumesseinheit" SWORD Qp_mm3_sec 1 100 -327680.0 327670.0 FORMAT "%8.1" ECU_ADDRESS 0x7F9118 /end MEASUREMENT
/begin MEASUREMENT Rail_dvolMeUnSet "Sollwert (Volumenstrom) von der Raildruckregelung" SWORD Qp_mm3_sec 1 100 -327680.0 327670.0 FORMAT "%8.1" ECU_ADDRESS 0x7F911C /end MEASUREMENT
/begin MEASUREMENT Rail_dvolPreCtlCor "Botschaft für Bypasseingriff" SWORD Qp_mm3_sec 1 100 -327680.0 327670.0 FORMAT "%8.1" ECU_ADDRESS 0x7F911E /end MEASUREMENT
/begin MEASUREMENT Rail_facMeUnTiRmpVal_mp "aktueller Rampenwert der Rampe bei Umschaltung von Regelung über Zumesseinheit auf Regelung über Druckregelventil" SWORD Fact 1 100 -4.000000 3.999878 FORMAT "%8.6" ECU_ADDRESS 0x8FFD1C /end MEASUREMENT
/begin MEASUREMENT Rail_MeUnCtlDKd_mp "D-Verstärkung der Druckregelung über Zumesseinheit" SLONG Kd_pRail2Q 1 100 -3276800.00000 3276799.99847 FORMAT "%16.5" ECU_ADDRESS 0x8FFD24 /end MEASUREMENT
/begin MEASUREMENT Rail_MeUnCtlIKiNeg_mp "I-Verstärkung für negative Großsignale für die Druckregelung über Zumesseinheit" ULONG Ki_pRail2Q 1 100 0.00 99999999.9767 FORMAT "%16.4" ECU_ADDRESS 0x8FFD28 /end MEASUREMENT
/begin MEASUREMENT Rail_MeUnCtlIKiPos_mp "I-Verstärkung für positive Großsignale für die Druckregelung über Zumesseinheit" ULONG Ki_pRail2Q 1 100 0.00 99999999.9767 FORMAT "%16.4" ECU_ADDRESS 0x8FFD2C /end MEASUREMENT
/begin MEASUREMENT Rail_MeUnCtlIKi_mp "I-Verstärkung für Kleinsignale für die Druckregelung über Zumesseinheit" ULONG Ki_pRail2Q 1 100 0.00 99999999.9767 FORMAT "%16.4" ECU_ADDRESS 0x8FFD30 /end MEASUREMENT
/begin MEASUREMENT Rail_MeUnCtlPKpNeg_mp "P-Verstärkung für negative Großsignale für die Druckregelung über Zumesseinheit" SLONG Kp_pRail2Q 1 100 -3276800.00000 3276799.99847 FORMAT "%16.5" ECU_ADDRESS 0x8FFD34 /end MEASUREMENT
/begin MEASUREMENT Rail_MeUnCtlPKpPos_mp "P-Verstärkung für positive Großsignale für die Druckregelung über Zumesseinheit" SLONG Kp_pRail2Q 1 100 -3276800.00000 3276799.99847 FORMAT "%16.5" ECU_ADDRESS 0x8FFD38 /end MEASUREMENT
/begin MEASUREMENT Rail_MeUnCtlPKp_mp "P-Verstärkung für Kleinsignale für die Druckregelung über Zumesseinheit" SLONG Kp_pRail2Q 1 100 -3276800.00000 3276799.99847 FORMAT "%16.5" ECU_ADDRESS 0x8FFD3C /end MEASUREMENT
/begin MEASUREMENT Rail_PCVCtlDKd_mp "D-Verstärkung der Druckregelung über Druckregelventil" SLONG Kd 1 100 -32768.0000000 32767.9999847 FORMAT "%13.7" ECU_ADDRESS 0x8FFD48 /end MEASUREMENT
/begin MEASUREMENT Rail_PCVCtlIKiNeg_mp "I-Verstärkung für negative Großsignale für die Druckregelung über Druckregelventil" ULONG Ki 1 100 0.00 999999.999767 FORMAT "%13.6" ECU_ADDRESS 0x8FFD4C /end MEASUREMENT
/begin MEASUREMENT Rail_PCVCtlIKiPos_mp "I-Verstärkung für positive Großsignale für die Druckregelung über Druckregelventil" ULONG Ki 1 100 0.00 999999.999767 FORMAT "%13.6" ECU_ADDRESS 0x8FFD50 /end MEASUREMENT
/begin MEASUREMENT Rail_PCVCtlIKi_mp "I-Verstärkung für Kleinsignale für die Druckregelung über Druckregelventil" ULONG Ki 1 100 0.00 999999.999767 FORMAT "%13.6" ECU_ADDRESS 0x8FFD54 /end MEASUREMENT
/begin MEASUREMENT Rail_PCVCtlPKpNeg_mp "P-Verstärkung für negative Großsignale für die Druckregelung über Druckregelventil" SLONG Kp 1 100 -32768.0000000 32767.9999847 FORMAT "%13.7" ECU_ADDRESS 0x8FFD58 /end MEASUREMENT
/begin MEASUREMENT Rail_PCVCtlPKpPos_mp "P-Verstärkung für positive Großsignale für die Druckregelung über Druckregelventil" SLONG Kp 1 100 -32768.0000000 32767.9999847 FORMAT "%13.7" ECU_ADDRESS 0x8FFD5C /end MEASUREMENT
/begin MEASUREMENT Rail_PCVCtlPKp_mp "P-Verstärkung für Kleinsignale für die Druckregelung über Druckregelventil" SLONG Kp 1 100 -32768.0000000 32767.9999847 FORMAT "%13.7" ECU_ADDRESS 0x8FFD60 /end MEASUREMENT
/begin MEASUREMENT Rail_pDvt "Raildruckregler-Regelabweichung" SWORD Pres_Rail 1 100 -3276.800 3276.700 FORMAT "%5.3" ECU_ADDRESS 0x7F912E /end MEASUREMENT
/begin MEASUREMENT Rail_pDvtFltLim_mp "gefilterte Regelabweichung des Raildrucks" SWORD Pres_Rail 1 100 -3276.800 3276.700 FORMAT "%5.3" ECU_ADDRESS 0x8FFD6C /end MEASUREMENT
/begin MEASUREMENT Rail_pMeUnDvt "Regelabweichung für den ZME-Regler" SWORD Pres_Rail 1 100 -3276.800 3276.700 FORMAT "%5.3" ECU_ADDRESS 0x7F9130 /end MEASUREMENT
/begin MEASUREMENT Rail_pMeUnDvtMax_mp "Ausgang der Kennlinie Rail_pMeUnDvtMax_CUR" SWORD Pres_Rail 1 100 -3276.800 3276.700 FORMAT "%5.3" ECU_ADDRESS 0x8FFD88 /end MEASUREMENT
/begin MEASUREMENT Rail_pMeUnDvtMin_mp "Ausgang der Kennlinie Rail_pMeUnDvtMin_CUR" SWORD Pres_Rail 1 100 -3276.800 3276.700 FORMAT "%5.3" ECU_ADDRESS 0x8FFD8A /end MEASUREMENT
/begin MEASUREMENT Rail_pMeUnPeakMin_mp "Ausgang der Kennlinie Rail_pMeUnPeakMin_CUR" SWORD Pres_Rail 1 100 -3276.800 3276.700 FORMAT "%5.3" ECU_ADDRESS 0x8FFD8C /end MEASUREMENT
/begin MEASUREMENT Rail_pPCVCtlDT1_mp "DT1-Anteil des Druckreglers über Druckregelventil" SWORD Pres_Rail 1 100 -3276.800 3276.700 FORMAT "%5.3" ECU_ADDRESS 0x8FFD72 /end MEASUREMENT
/begin MEASUREMENT Rail_pPCVCtlI_mp "I-Anteil des Druckreglers über Druckregelventil" SWORD Pres_Rail 1 100 -3276.800 3276.700 FORMAT "%5.3" ECU_ADDRESS 0x8FFD74 /end MEASUREMENT
/begin MEASUREMENT Rail_pPCVCtlLoLim_mp "untere Stellwertbegrenzung des Raildruckreglers über Druckregelventil" SWORD Pres_Rail 1 100 -3276.800 3276.700 FORMAT "%5.3" ECU_ADDRESS 0x8FFD20 /end MEASUREMENT
/begin MEASUREMENT Rail_pPCVCtlPILim_mp "DT1-Anteil des Druckreglers über Druckregelventil (begrenzt)" SWORD Pres_Rail 1 100 -3276.800 3276.700 FORMAT "%5.3" ECU_ADDRESS 0x8FFD76 /end MEASUREMENT
/begin MEASUREMENT Rail_pPCVCtlP_mp "P-Anteil des Druckreglers über Druckregelventil" SWORD Pres_Rail 1 100 -3276.800 3276.700 FORMAT "%5.3" ECU_ADDRESS 0x8FFD78 /end MEASUREMENT
/begin MEASUREMENT Rail_pPCVCtlUpLim_mp "obere Stellwertbegrenzung des Raildruckreglers über Druckregelventil" SWORD Pres_Rail 1 100 -3276.800 3276.700 FORMAT "%5.3" ECU_ADDRESS 0x8FFD22 /end MEASUREMENT
/begin MEASUREMENT Rail_pPCVDvt "Regelabweichung für den DRV Regler" SWORD Pres_Rail 1 100 -3276.800 3276.700 FORMAT "%5.3" ECU_ADDRESS 0x7F9132 /end MEASUREMENT
/begin MEASUREMENT Rail_pPCVInitI_mp "Initialisierung I-Anteil des Druckreglers über Druckregelventil, beim Umschalten von Zumesseinheit auf Druckregelventil" SWORD Pres_Rail 1 100 -3276.800 3276.700 FORMAT "%5.3" ECU_ADDRESS 0x8FFD7A /end MEASUREMENT
/begin MEASUREMENT Rail_pPCVSet "Stellwertvorgabe für das Druckregelventil" SWORD Pres_Rail 1 100 -3276.800 3276.700 FORMAT "%5.3" ECU_ADDRESS 0x7F9134 /end MEASUREMENT
/begin MEASUREMENT Rail_pPeakFlt_mp "PT1-gefilterter Raildruck für die Druckregelung über Zumesseinheit" SWORD Pres_Rail 1 100 -3276.800 3276.700 FORMAT "%5.3" ECU_ADDRESS 0x8FFD6E /end MEASUREMENT
/begin MEASUREMENT Rail_pPreCtlCor "Botschaft für Bypasseingriff" SWORD Pres_Rail 1 100 -3276.800 3276.700 FORMAT "%5.3" ECU_ADDRESS 0x7F9136 /end MEASUREMENT
/begin MEASUREMENT Rail_pWindUp_mp "rückgerechneter I-Anteil wenn Stellerbegrenzung erreicht ist" SWORD Pres_Rail 1 100 -3276.800 3276.700 FORMAT "%5.3" ECU_ADDRESS 0x8FFD7C /end MEASUREMENT
/begin MEASUREMENT Rail_qMeUnCtlType_mp "mengenabhängige Hystereseschwelle zur Umschaltung auf Druckregelung über Zumesseinheit" SWORD InjMassCyc 1 100 -327.6800 327.6700 FORMAT "%8.4" ECU_ADDRESS 0x8FFD7E /end MEASUREMENT
/begin MEASUREMENT Rail_qPCVCtlType_mp "mengenabhängige Hystereseschwelle zur Umschaltung auf Druckregelung über Druckregelventil" SWORD InjMassCyc 1 100 -327.6800 327.6700 FORMAT "%8.4" ECU_ADDRESS 0x8FFD80 /end MEASUREMENT
/begin MEASUREMENT Rail_stCtlLoop "Zustand der Steuerung Raildruckregler" UBYTE OneToOne 1 100 0.00 255.0 FORMAT "%5.1" ECU_ADDRESS 0x7F89DB /end MEASUREMENT
/begin MEASUREMENT Rail_stMeUnFrzI_mp "Status des rückgerechneten I-Anteils für die Stellwertbegrenzung für die Regelung der Zumesseinheit" UBYTE OneToOne 1 100 0.00 255.0 FORMAT "%5.1" ECU_ADDRESS 0x8FFD70 /end MEASUREMENT
/begin MEASUREMENT Rail_stMeUnMon0_mp "Zustandsbits für Überwachung auf positive Regelabweichung" UBYTE OneToOne 1 100 0.00 255.0 FORMAT "%5.1" ECU_ADDRESS 0x8FFD8E /end MEASUREMENT
/begin MEASUREMENT Rail_stMeUnMon1_mp "Zustandsbits für Überwachung auf positive Regelabweichung und Sollwert des Volumenstroms durch die Zumesseinheit" UBYTE OneToOne 1 100 0.00 255.0 FORMAT "%5.1" ECU_ADDRESS 0x8FFD8F /end MEASUREMENT
/begin MEASUREMENT Rail_stMeUnMon2_mp "Zustandsbits für Überwachung auf negative Regelabweichung bei Nullförderung" UBYTE OneToOne 1 100 0.00 255.0 FORMAT "%5.1" ECU_ADDRESS 0x8FFD90 /end MEASUREMENT
/begin MEASUREMENT Rail_stMeUnMon3_mp "Zustandsbits für Überwachung auf minimalen Raildruck" UBYTE OneToOne 1 100 0.00 255.0 FORMAT "%5.1" ECU_ADDRESS 0x8FFD91 /end MEASUREMENT
/begin MEASUREMENT Rail_stMeUnMon4_mp "Zustandsbits für Überwachung auf maximalen Raildruck" UBYTE OneToOne 1 100 0.00 255.0 FORMAT "%5.1" ECU_ADDRESS 0x8FFD92 /end MEASUREMENT
/begin MEASUREMENT Rail_stPCVWindUp "Status des rückgerechneten I-Anteils für die Stellwertbegren zung für die Regelung des Druckregelventils" UBYTE OneToOne 1 100 0.00 255.0 FORMAT "%5.1" ECU_ADDRESS 0x7F89DD /end MEASUREMENT
/begin MEASUREMENT Rail_stShOffTstAck "Quittierung für Nachlauftestanforderung" UBYTE OneToOne 1 100 0.00 255.0 FORMAT "%5.1" ECU_ADDRESS 0x7F89DE /end MEASUREMENT
/begin MEASUREMENT Rail_stSwtConRgn_mp "" UBYTE OneToOne 1 100 0.00 255.0 FORMAT "%5.1" ECU_ADDRESS 0x8FFD82 /end MEASUREMENT
/begin MEASUREMENT Rail_stSwtCon_mp "Status der Umschaltbedingungen für das Regelprinzip" UBYTE OneToOne 1 100 0.00 255.0 FORMAT "%5.1" ECU_ADDRESS 0x8FFD83 /end MEASUREMENT
/begin MEASUREMENT Rail_tiMeUn0Deb_mp "MeUn0: Messpunkt fuer laufende Entprellzaehler" UWORD Time_ms 1 100 0.00 655350.0 FORMAT "%8.1" ECU_ADDRESS 0x6F8222 /end MEASUREMENT
/begin MEASUREMENT Rail_tiMeUn1Deb_mp "MeUn1: Messpunkt fuer laufende Entprellzaehler" UWORD Time_ms 1 100 0.00 655350.0 FORMAT "%8.1" ECU_ADDRESS 0x6F8224 /end MEASUREMENT
/begin MEASUREMENT Rail_tiMeUn2Deb_mp "MeUn2: Messpunkt fuer laufende Entprellzaehler" UWORD Time_ms 1 100 0.00 655350.0 FORMAT "%8.1" ECU_ADDRESS 0x6F8226 /end MEASUREMENT
/begin MEASUREMENT Rail_tiMeUn3Deb_mp "MeUn3: Messpunkt fuer laufende Entprellzaehler" UWORD Time_ms 1 100 0.00 655350.0 FORMAT "%8.1" ECU_ADDRESS 0x6F8228 /end MEASUREMENT
/begin MEASUREMENT Rail_tiMeUn4Deb_mp "MeUn4: Messpunkt fuer laufende Entprellzaehler" UWORD Time_ms 1 100 0.00 655350.0 FORMAT "%8.1" ECU_ADDRESS 0x6F822A /end MEASUREMENT
/begin MEASUREMENT Rail_tiMeUnCtlDT1_mp "Zeitkonstante des DT1-Gliedes für die Druckregelung über Zumesseinheit" ULONG TimeDelay_s 1 100 0.0000010000000 4294.9673 FORMAT "%9.4" ECU_ADDRESS 0x8FFD40 /end MEASUREMENT
/begin MEASUREMENT Rail_tiMeUnCtlPT1_mp "Zeitkonstante des PT1-Filters für die Druckregelung über Zumesseinheit" ULONG TimeDelay_s 1 100 0.0000010000000 4294.9673 FORMAT "%9.4" ECU_ADDRESS 0x8FFD44 /end MEASUREMENT
/begin MEASUREMENT Rail_tiMeUnRmpDur_mp "Laufzeit der Rampe um das Fördervolumen der Zumesseinheit vom aktuellen Sollwert auf die Maximalförderung zu rampen" SWORD InjTime_us 1 100 -32768.00 32767.00 FORMAT "%8.2" ECU_ADDRESS 0x8FFD1E /end MEASUREMENT
/begin MEASUREMENT Rail_tiPCVCtlDT1_mp "Zeitkonstante des DT1-Gliedes für die Druckregelung über Druckregelventil" ULONG TimeDelay_s 1 100 0.0000010000000 4294.9673 FORMAT "%9.4" ECU_ADDRESS 0x8FFD64 /end MEASUREMENT
/begin MEASUREMENT Rail_tiThresMonEna "Zeitverzögerung um Plausibilisierung des Raildrucks freizugeben" UWORD Time_ms 1 100 0.00 655350.0 FORMAT "%8.1" ECU_ADDRESS 0x7F9150 /end MEASUREMENT
/begin MEASUREMENT Rail_tMeUnCtlType_mp "temperaturabhängige Hystereseschwelle zur Umschaltung auf Druckregelung über Zumesseinheit" SWORD Temp_Cels 1 100 -50.140 899.860 FORMAT "%8.3" ECU_ADDRESS 0x8FFD84 /end MEASUREMENT
/begin MEASUREMENT Rail_tPCVCtlType_mp "temperaturabhängige Hystereseschwelle zur Umschaltung auf Druckregelung über Druckregelventil" SWORD Temp_Cels 1 100 -50.140 899.860 FORMAT "%8.3" ECU_ADDRESS 0x8FFD86 /end MEASUREMENT
/begin FUNCTION pflt_masscalc_uic ""
 /begin DEF_CHARACTERISTIC PFlt_mSot_Vector PFlt_mSot_Channel PFlt_resFlow_Vector PFlt_resFlow_Channel /end DEF_CHARACTERISTIC
 /begin OUT_MEASUREMENT PFlt_dmNO2Tot_mp PFlt_dmNOxRaw_mp PFlt_dmSotSimDyn_mp PFlt_dmSotSimEmi_mp PFlt_dmSotSimRgnCRT_mp PFlt_dmSotSimRgnThr_mp PFlt_dmSotSimRgn_mp PFlt_dmSotSimSty_mp PFlt_dmSotSim_mp PFlt_dpDiff_mp PFlt_dqSetUnBal_mp PFlt_dvolMassFlt_mp PFlt_facDesCor_mp PFlt_facMltCor_mp PFlt_mAshAdi_mp PFlt_mAsh_mp PFlt_mSotCrv_mp PFlt_mSotEEPROM_mp PFlt_mSotMeasRaw_mp PFlt_resFlowAdiOfs_mp PFlt_resFlowInv_mp PFlt_resFlowOilOfs_mp PFlt_resFlowRaw_mp PFlt_stSimOn_mp PFlt_volAddTot_mp /end OUT_MEASUREMENT
/end FUNCTION
/begin FUNCTION pflt_monitor "Überwachung des Partikelfilters"
 /begin DEF_CHARACTERISTIC PFlt_ddvolHsLnPlausNeg_C PFlt_ddvolHsLnPlausPos_C PFlt_ddvolHsLnSot_C PFlt_dvolCharMonMin_C PFlt_nTempChkTrg_C PFlt_numCntBck_C PFlt_numCntMax_C PFlt_numPFltMon_C PFlt_numTimeStpPlausSens_C PFlt_pBPAndAPTolcMax_C PFlt_pDiffCharMonMin_C PFlt_pDiffHsLnNeg_C PFlt_pDiffMax_C PFlt_pDiffMin_C PFlt_pDiffTolcMax_C PFlt_pMinNrmCldStrt_C PFlt_pPreAndBPTolcMax_C PFlt_pPreTolcMax_C PFlt_resFlowMax_C PFlt_resFlowMin_C PFlt_resFlowTolcDynPlaus_C PFlt_stCfgTempSens_C PFlt_swtEnvTempSens_C PFlt_swtMonCharMin_C PFlt_swtSvcSensChng_C PFlt_swtSvcTmrRst_C PFlt_tCldStrtDfl_C PFlt_tDiffCldMax_C PFlt_tDiffTolcMax_C PFlt_tDwnStrmTolcMax_C PFlt_tEGMax_C PFlt_tEGMin_C PFlt_tFrzMin_C PFlt_tiChkTempPlausMax_CUR PFlt_DebCharMaxDef_C PFlt_DebCharMaxOk_C PFlt_DebCharMinDef_C PFlt_DebCharMinOk_C PFlt_DebEngPrtMaxDef_C PFlt_DebEngPrtMaxOk_C PFlt_DebPDiffDynPlausDef_C PFlt_DebPDiffDynPlausOk_C PFlt_DebHsLnPlausDef_C PFlt_DebHsLnPlausOk_C PFlt_DebPDiffMaxDef_C PFlt_DebPDiffMaxOk_C PFlt_DebPDiffMinDef_C PFlt_DebPDiffMinOk_C PFlt_DebSotPlausDef_C PFlt_DebSotPlausOk_C PFlt_DebRgnPermMaxDef_C PFlt_DebRgnPermMaxOk_C PFlt_DebTEGMaxDef_C PFlt_DebTEGMaxOk_C PFlt_DebTEGMinDef_C PFlt_DebTEGMinOk_C PFlt_tiDelOfsCalc_C PFlt_tiLckChkTempPlaus_C PFlt_tIncrDwnStrm_C PFlt_tIncrUpStrm_C PFlt_tiFltHsLnPT1_C PFlt_tUpStrmTolcMax_C /end DEF_CHARACTERISTIC
 /begin IN_MEASUREMENT BattCD_u /end IN_MEASUREMENT
/end FUNCTION
/begin FUNCTION pflt_monitor_msg "" /begin OUT_MEASUREMENT PFlt_pDiffFlt PFlt_stAftRunDelDem /end OUT_MEASUREMENT /end FUNCTION
/begin FUNCTION pflt_monitor_proj "Customer specific particulate filter monitoring functions."
 /begin DEF_CHARACTERISTIC PFlt_ctEngPrtRgn_C PFlt_DebAPSPlausDefHigh_C PFlt_DebAPSPlausDefLow_C PFlt_DebBPSPlausDefHigh_C PFlt_DebBPSPlausDefLow_C PFlt_DebPFltOvldInhRgnDef_C PFlt_DebPFltOvldInhRgnOk_C PFlt_DebPFltOvldTrqLimDef_C PFlt_DebPFltOvldTrqLimOk_C PFlt_DebPresPlausDefHigh_C PFlt_DebPresPlausDefLow_C PFlt_DebRstDfpEngPrtRgnMon_C PFlt_dvolRstDfpEngPrtMon_C PFlt_facNO2RgnInhRgn_CUR PFlt_facNO2RgnTrqLim_CUR PFlt_lRstDfpEngPrtMon_C PFlt_lSumDiffMax_C PFlt_mLoIdlSotSimMax_C PFlt_mSotDiff_C PFlt_nLoIdlMax_C PFlt_nLoIdlMin_C PFlt_nMin_C PFlt_nPFltOvldHeal_C PFlt_nStrtMax_C PFlt_nStrtMin_C PFlt_numEngPrtActvMsk_C PFlt_numRgnStep1_C PFlt_numRgnStep2_C PFlt_numRgnStep3_C PFlt_numRgnStep4_C PFlt_numRgnStep5_C PFlt_numRgnStep6_C PFlt_numRgnStep7_C PFlt_numRgnStep8_C PFlt_pAPSNegDvt_C PFlt_pAPSPosDvt_C PFlt_pBPSNegDvt_C PFlt_pBPSPosDvt_C PFlt_pDiffMax1_C PFlt_pPFltOvldInhRgn_MAP PFlt_pPFltOvldInit_C PFlt_pPFltOvldOfsHeal_C PFlt_pPFltOvldTrqLim_MAP PFlt_pPreAshOilCorr_MAP PFlt_pPreCorrMax_C PFlt_pPresNegDvt_C PFlt_pPreSotSimCorr_MAP PFlt_pPresPlausMaxDvt_C PFlt_pPresPlausMinDvt_C PFlt_pPresPosDvt_C PFlt_pPreVolCorr_CUR PFlt_qLoIdlMax_C PFlt_qLoIdlMin_C PFlt_qPFltOvldHeal_C PFlt_rEngPrtRgnMax_C PFlt_resFlowOvldInhRgn_MAP PFlt_resFlowOvldInit_C PFlt_resFlowOvldOfsHeal_C PFlt_resFlowOvldTrqLim_MAP PFlt_rLoIdlTVAMax_C PFlt_stLoIdlEGTMsk_C PFlt_stMaxEGTMsk_C PFlt_swtDiagRlsmSotCtl_C PFlt_swtEngPrtWrEEPROM_C PFlt_swtPFltOvldInhRgnCor_C PFlt_swtPFltOvldTrqLimCor_C PFlt_tClntPFltOvldHeal_C PFlt_tDevOxiPreMax_C PFlt_tDevOxiPreRgnMax_C PFlt_tDevPreMax_C PFlt_tDevPreRgnMax_C PFlt_tiDebAftRunTst_C PFlt_tiDebLoIdl_C PFlt_DebmSotMaxDef_C PFlt_DebmSotMaxOk_C PFlt_DebOxiPreMaxDef_C PFlt_DebOxiPreMaxOk_C PFlt_DebOxiPreNplDef_C PFlt_DebOxiPreNplOk_C PFlt_DebOxiPreRgnMaxDef_C PFlt_DebOxiPreRgnMaxOk_C PFlt_DebPreMaxDef_C PFlt_DebPreMaxOk_C PFlt_DebPreNplDef_C PFlt_DebPreNplOk_C PFlt_DebPreRgnMaxDef_C PFlt_DebPreRgnMaxOk_C PFlt_tiDebPresDblDef_C PFlt_tiDebPresPlausOk_C PFlt_tiDebT15On_C PFlt_tiFstEngPrtRgnMax_C PFlt_tiLoIdlSnceRgnMax_C PFlt_tiPFltOvld1PT1_C PFlt_tiPFltOvld2PT1_C PFlt_tOxiPreDiffMax_MAP PFlt_tPreDiffMax_MAP PFlt_tThresOxiPreMax_C PFlt_tThresOxiPreRgnMax_C PFlt_tThresPreMax_C PFlt_tThresPreRgnMax_C PFlt_vLoIdlSpeedMax_C PFlt_vPFltOvldHeal_C /end DEF_CHARACTERISTIC
 /begin IN_MEASUREMENT Eng_nAvrg InjCtl_qSetUnBal PFlt_dvol PFlt_facNO2Rgn PFlt_mAshOil PFlt_mSotSim /end IN_MEASUREMENT
/end FUNCTION
/begin FUNCTION pflt_monitor_proj_msg "" /begin OUT_MEASUREMENT PFlt_lAvrgRgn /end OUT_MEASUREMENT /end FUNCTION
/begin FUNCTION pflt_monitor_proj_uic ""
 /begin OUT_MEASUREMENT PFlt_ctEngPrtRgn_mp PFlt_ctRgnStep1_mp PFlt_ctRgnStep2_mp PFlt_ctRgnStep3_mp PFlt_ctRgnStep4_mp PFlt_ctRgnStep5_mp PFlt_ctRgnStep6_mp PFlt_ctRgnStep7_mp PFlt_ctRgnStep8_mp PFlt_ctRgnSum_mp PFlt_numIdxCntRgn_mp PFlt_pAPSBPSDiff_mp PFlt_pAPSDvt_mp PFlt_pAPSPFltPresDiff_mp PFlt_pBPSDvt_mp PFlt_pBPSPFltPresDiff_mp PFlt_pPFltOvldLckRgn_mp PFlt_pPFltOvldTrqLim_mp PFlt_pPFltPresDvt_mp PFlt_pPreAshOilCorr_mp PFlt_pPreCorr_mp PFlt_pPreSotAshCorrSum_mp PFlt_pPreSotSimCorr_mp PFlt_pPreVolCorr_mp PFlt_rEngPrtRgn_mp PFlt_resFlowOvldLckRgn_mp PFlt_resFlowOvldTrqLim_mp PFlt_stAPSPlausDefHigh_mp PFlt_stAPSPlausDefLow_mp PFlt_stBPSPlausDefHigh_mp PFlt_stBPSPlausDefLow_mp PFlt_stEngPrtRgn_mp PFlt_stPresPlausDefHigh_mp PFlt_stPresPlausDefLow_mp PFlt_stPresPlausLoIdl_mp PFlt_stPresPlausOk_mp PFlt_stPresPlausTst_mp PFlt_stPresPlaus_mp PFlt_stRgnRlsOff_mp PFlt_stRlsmSotCtl_mp PFlt_tiOpOld_mp PFlt_tiSnceFstEngPrtRgn_mp PFlt_tOxiPreDiffMax_mp PFlt_tOxiPreDiff_mp PFlt_tOxiPreMax_mp PFlt_tOxiPreRgnMax_mp PFlt_tPreDiffMax_mp PFlt_tPreDiff_mp PFlt_tPreMax_mp PFlt_tPreRgnMax_mp /end OUT_MEASUREMENT
/end FUNCTION
/begin FUNCTION pflt_monitor_uic ""
 /begin OUT_MEASUREMENT PFlt_ddvolFlt_mp PFlt_dpDiffFlt_mp PFlt_dpDiffNegDef_mp PFlt_dpDiffPosDef_mp PFlt_dvolFlt_mp PFlt_pDiffFlt_mp PFlt_pDiffOfsValActMid_mp PFlt_pDiffOfsValAct_mp PFlt_pDiffOfsValOld_mp PFlt_stLckTempPlaus_mp PFlt_stLckTmr_mp PFlt_stPresDiffPlaus_mp PFlt_stResFlowHi_mp PFlt_stResFlowLo_mp PFlt_stTempPlausDone_mp PFlt_tDwnStrm_mp PFlt_tIATLoLvl_mp PFlt_tiChkTmpPlaus_mp PFlt_tPFltMon_mp PFlt_tUpStrm_mp /end OUT_MEASUREMENT
/end FUNCTION
/begin FUNCTION pflt_sensadapt "Sensor Adaption"
 /begin DEF_CHARACTERISTIC PFlt_pDfl_C PFlt_pDiffDfl_MAP PFlt_dpDiffUp_C PFlt_dpDiffDwn_C PFlt_swtDTempOxiCor_C PFlt_swtPDiffOfsOn_C PFlt_swtPresSensCfg_C PFlt_swtTSensCfg_C PFlt_tiPPrePT1_C PFlt_titPrePhysPT1_C /end DEF_CHARACTERISTIC
 /begin IN_MEASUREMENT Eng_nAvrg InjCtl_qSetUnBal /end IN_MEASUREMENT
/end FUNCTION
/begin FUNCTION pflt_sensadapt_msg ""
 /begin OUT_MEASUREMENT PFlt_pDiff PFlt_pDiffRaw PFlt_pMid PFlt_pPre PFlt_pPreFlt PFlt_tOxiPre PFlt_tPre /end OUT_MEASUREMENT
/end FUNCTION
/begin FUNCTION pflt_sensadapt_uic "" /begin OUT_MEASUREMENT PFlt_pDiffDfl_mp PFlt_tPrePhysFlt_mp /end OUT_MEASUREMENT /end FUNCTION
/begin FUNCTION pflt_tempmod "Partikelfiltertemperaturmodell"
 /begin DEF_CHARACTERISTIC PFlt_cpExhGs_C PFlt_CPFlt_C PFlt_facBlwBy_C PFlt_facDpn_MAP PFlt_facHtTransNoLin_CUR PFlt_KdDT1TempCor_C PFlt_kiITempMod_C PFlt_stRgnMsk1_C PFlt_stRgnMsk2_C PFlt_swtFacDpn_C PFlt_swtTempModOff_C PFlt_tExhGsStyRgn1_MAP PFlt_tExhGsStyRgn2_MAP PFlt_tExhGsSty_MAP PFlt_tiExhGsDel_CUR PFlt_tiHtTransDT1_CUR PFlt_tiOxiPreStyPT1_C PFlt_tiFltTempPT1_C PFlt_tiPreStyPT1_C PFlt_tRefSty_C /end DEF_CHARACTERISTIC
 /begin IN_MEASUREMENT Eng_nAvrg IATSCD_tAir InjCtl_qSetUnBal PFlt_dmEG PFlt_tDiffCorr_mp VSSCD_v /end IN_MEASUREMENT
/end FUNCTION
/begin FUNCTION pflt_tempmod_msg ""
 /begin OUT_MEASUREMENT PFlt_tExhGsStyRgn2 PFlt_tOxiPreSty PFlt_tPreSty PFlt_tPstSim PFlt_tSurf /end OUT_MEASUREMENT
/end FUNCTION
/begin FUNCTION pflt_tempmod_uic ""
 /begin OUT_MEASUREMENT PFlt_facDpn_mp PFlt_qPoI1Des_mp PFlt_tDiffCorr_mp PFlt_tExhGsStyRgn1_mp PFlt_tHtTransCor_mp PFlt_tiExhGsDel_mp PFlt_tiHtTransDT1_mp PFlt_tOxiPreRaw_mp PFlt_tPreCorr_mp PFlt_tPreRaw_mp PFlt_tSurfSim_mp PFlt_tTotCor_mp /end OUT_MEASUREMENT
/end FUNCTION
/begin FUNCTION prpbrk_msg "" /begin OUT_MEASUREMENT PrpBrk_trqDes PrpBrk_trqLead /end OUT_MEASUREMENT /end FUNCTION
/begin FUNCTION prpctl "Vortriebsregelung"
 /begin DEF_CHARACTERISTIC PrpCtl_facSpdCorr_C PrpCtl_SpdLim4IKi_C PrpCtl_SpdLim4IKiPos_C PrpCtl_SpdLim4IKiNeg_C PrpCtl_vSpdLim4IWinPos_C PrpCtl_vSpdLim4IWinNeg_C PrpCtl_SpdLim4PKp_C PrpCtl_SpdLim4PKpPos_C PrpCtl_SpdLim4PKpNeg_C PrpCtl_vSpdLim4PWinPos_C PrpCtl_vSpdLim4PWinNeg_C PrpCtl_SpdLim5IKi_C PrpCtl_SpdLim5IKiPos_C PrpCtl_SpdLim5IKiNeg_C PrpCtl_vSpdLim5IWinPos_C PrpCtl_vSpdLim5IWinNeg_C PrpCtl_SpdLim5PKp_C PrpCtl_SpdLim5PKpPos_C PrpCtl_SpdLim5PKpNeg_C PrpCtl_vSpdLim5PWinPos_C PrpCtl_vSpdLim5PWinNeg_C PrpCtl_tiSpdLimPT1_C PrpCtl_swtSpdLimVal_C PrpCtl_swtSpdLimType_C PrpCtl_vSpdLimMax_C PrpCtl_vSpdLimThreshFree_C PrpCtl_vSpdLimThreshOff_C PrpCtl_vSpdLimThreshOn_C /end DEF_CHARACTERISTIC
/end FUNCTION
/begin FUNCTION prpctl_msg "" /begin OUT_MEASUREMENT PrpCtl_swtSpdLim PrpCtl_trqSpdLim /end OUT_MEASUREMENT /end FUNCTION
/begin FUNCTION prpctl_uic ""
 /begin OUT_MEASUREMENT PrpCtl_stSPTrack_mp PrpCtl_trqI_mp PrpCtl_trqP_mp PrpCtl_vCurrTrack_mp PrpCtl_vSpdCorr_mp /end OUT_MEASUREMENT
/end FUNCTION
/begin FUNCTION prp_cocrctlprpctl "" /end FUNCTION
/begin FUNCTION prp_cocrctlprpctl_msg "" /end FUNCTION
/begin FUNCTION prp_cocrctlprpctl_uic "" /end FUNCTION
/begin FUNCTION prp_demsel "Anforderungs-Auswahl" /end FUNCTION
/begin FUNCTION prp_demsel_msg "" /begin OUT_MEASUREMENT Prp_stPrpSel Prp_trqDesCC Prp_trqLead Prp_trqRaw /end OUT_MEASUREMENT /end FUNCTION
/begin FUNCTION prp_demsel_uic "" /end FUNCTION
/begin FUNCTION prp_virtapp "virtuelle Fahrpedalstellung"
 /begin DEF_CHARACTERISTIC Prp_rEng_MAP Prp_rPrp_MAP Prp_swtVirtAPPSel_C Prp_trqThresEng_CUR Prp_trqThresPrp_CUR /end DEF_CHARACTERISTIC
 /begin IN_MEASUREMENT Eng_nAvrg Prp_trqEng Prp_trqPrp VSSCD_v /end IN_MEASUREMENT
/end FUNCTION
/begin FUNCTION prp_virtapp_msg ""
 /begin OUT_MEASUREMENT Prp_rAPP Prp_rVirtAPP Prp_stTrqTypePrp Prp_stVirtApp Prp_trqEng Prp_trqPrp Prp_trqRawLim /end OUT_MEASUREMENT
/end FUNCTION
/begin FUNCTION prp_virtapp_uic ""
 /begin OUT_MEASUREMENT Prp_rVirtEngPrp_mp Prp_rVirtOvrRun_mp Prp_trqEngPrp_mp Prp_trqThresPrp_mp /end OUT_MEASUREMENT
/end FUNCTION
/begin FUNCTION psp "Vorförderpumpe" /begin DEF_CHARACTERISTIC PSP_nStart_C PSP_tiArming_C PSP_tiClnt_CUR /end DEF_CHARACTERISTIC /begin IN_MEASUREMENT CTSCD_tClnt /end IN_MEASUREMENT /end FUNCTION
/begin FUNCTION pspcd "Komponententreiber Vorförderpumpe"
 /begin DEF_CHARACTERISTIC PSPCD_ctPwrStgOnMax_C PSPCD_DebExcTempDef_C PSPCD_DebExcTempOk_C PSPCD_DebNoLoadDef_C PSPCD_DebNoLoadOk_C PSPCD_DebShortCircBatDef_C PSPCD_DebShortCircBatOk_C PSPCD_DebShortCircGndDef_C PSPCD_DebShortCircGndOk_C PSPCD_dvolBase_CUR PSPCD_dvolMax_C PSPCD_dvolMin_C PSPCD_dvolOut1_C PSPCD_dvolTempLim_MAP PSPCD_facFTSCor_CUR PSPCD_nLim_C PSPCD_numDia_C PSPCD_numDioOut_C PSPCD_stInvOut_C PSPCD_stSPICtl_C PSPCD_swtCAN_C PSPCD_tiBtwTst_C PSPCD_tiPwrStgOn_C PSPCD_tiT15Delay_CUR /end DEF_CHARACTERISTIC
 /begin IN_MEASUREMENT CTSCD_tClnt Eng_nAvrg FTSCD_tFuel /end IN_MEASUREMENT
/end FUNCTION
/begin FUNCTION pspcd_msg "" /begin OUT_MEASUREMENT PSPCD_dvolOut /end OUT_MEASUREMENT /end FUNCTION
/begin FUNCTION pspcd_uic ""
 /begin OUT_MEASUREMENT PSPCD_dvol1_mp PSPCD_dvol2_mp PSPCD_dvolOut0_mp PSPCD_dvolOut1_mp PSPCD_dvolOut2_mp PSPCD_dvolOut3_mp PSPCD_rActrOut_mp PSPCD_stLogic_mp PSPCD_tiT15Delay_mp /end OUT_MEASUREMENT
/end FUNCTION
/begin FUNCTION psp_msg "" /begin OUT_MEASUREMENT PSP_stLogicOut PSP_stPSPOff /end OUT_MEASUREMENT /end FUNCTION
/begin FUNCTION psp_uic "" /begin OUT_MEASUREMENT PSP_stEKPCrash_mp /end OUT_MEASUREMENT /end FUNCTION
/begin FUNCTION qltcd "QLT mit BSD-Schnittstelle - Componententreiber"
 /begin DEF_CHARACTERISTIC QLTCD_cntComOk_C QLTCD_tiDebDefect_C QLTCD_tiDebOk_C QLTCD_tiOutput_C QLTCD_tiReset_C QLTCD_tiTryDetection_C QLTCD_tiWaitDetection_C /end DEF_CHARACTERISTIC
/end FUNCTION
/begin FUNCTION qltcd_msg ""
 /begin OUT_MEASUREMENT QLTCD_oznivr QLTCD_ozpermr_w QLTCD_ozstatus QLTCD_oztempr QLTCD_stComQLTActiv /end OUT_MEASUREMENT
/end FUNCTION
/begin FUNCTION qltcd_uic ""
 /begin OUT_MEASUREMENT QLTCD_B_ozfbsd_mp QLTCD_B_qltdetec_mp QLTCD_cntComOk_mp QLTCD_CommErr_mp QLTCD_oz_permh_r_mp QLTCD_oz_perml_r_mp QLTCD_State_Handler_mp QLTCD_State_mp QLTCD_stDetection_mp QLTCD_stTBss_Active_mp QLTCD_SwitchState_mp /end OUT_MEASUREMENT
/end FUNCTION
/begin FUNCTION railcd_clreeprom_uic "" /end FUNCTION
/begin FUNCTION railcd_co "Komponententreiber Rail"
 /begin DEF_CHARACTERISTIC RailCD_uSRCMin_C RailCD_uSRCMax_C RailCD_pLin_CUR RailCD_DebSRCHighDef_C RailCD_DebSRCHighOk_C RailCD_DebSRCLowDef_C RailCD_DebSRCLowOk_C RAILCD_numAdc2_C RAILCD_numAdc_C RailCD_pFltWinNeg_CUR RailCD_stRPSFlt_C RailCD_tiFlt1PT1_C RailCD_tiFlt2PT1_C RailCD_tiFlt3PT1_C /end DEF_CHARACTERISTIC
 /begin IN_MEASUREMENT InjCtl_qSetUnBal RailCD_uPeakRaw /end IN_MEASUREMENT
/end FUNCTION
/begin FUNCTION railcd_co_msg "" /begin OUT_MEASUREMENT RailCD_pPeak RailCD_uPeakRaw /end OUT_MEASUREMENT /end FUNCTION
/begin FUNCTION railcd_co_uic ""
 /begin OUT_MEASUREMENT RailCD_pAct_mp RailCD_pFltWinNeg_mp RailCD_pLin_mp RailCD_tiFltPT1_mp /end OUT_MEASUREMENT
/end FUNCTION
/begin FUNCTION railcd_offstst "RPS Offset Überwachung"
 /begin DEF_CHARACTERISTIC RailCD_swtOfsTst_C RailCD_tiEvalDel_C RailCD_tiOfsTstAftRun_C RailCD_tiOfsTstDel_CUR RailCD_tiOfsTstStrt_C RailCD_tiStrErrDel_C RailCD_tOfsTstAftRun_C RailCD_tOfsTstDec_C RailCD_tOfsTstInc_C RailCD_tOfsTstStrt_C RailCD_uOfsAftRunMax_C RailCD_uOfsAftRunMin_C RailCD_uOfsStrtMax_C RailCD_uOfsStrtMin_C /end DEF_CHARACTERISTIC
 /begin IN_MEASUREMENT RailCD_pPeak /end IN_MEASUREMENT
/end FUNCTION
/begin FUNCTION railcd_offstst_msg "" /begin OUT_MEASUREMENT RailCD_stOfsTstMon RailCD_uOfsAftRun RailCD_uOfsStrt /end OUT_MEASUREMENT /end FUNCTION
/begin FUNCTION railcd_offstst_uic ""
 /begin OUT_MEASUREMENT RailCD_stEngStrtMov_mp RailCD_stMon_mp RailCD_tClntLstCyc_mp RailCD_tiOfsTstDel_mp /end OUT_MEASUREMENT
/end FUNCTION
/begin FUNCTION railcd_pmonstrt "Start phase rail pressure monitoring" /begin DEF_CHARACTERISTIC RailCD_nStrtLim_C RailCD_pStrtLim_C RailCD_tiPMonStrtLim_C /end DEF_CHARACTERISTIC /end FUNCTION
/begin FUNCTION railcd_pmonstrt_uic "" /begin OUT_MEASUREMENT RailCD_ctPMonStrt_mp /end OUT_MEASUREMENT /end FUNCTION
/begin FUNCTION rail_adcget_uic "" /end FUNCTION
/begin FUNCTION rail_cpctlloop "" /end FUNCTION
/begin FUNCTION rail_cpctlloop_msg "" /end FUNCTION
/begin FUNCTION rail_cpctlloop_uic "" /end FUNCTION
/begin FUNCTION rail_ctlloop "Raildruckregler Regelkreis"
 /begin DEF_CHARACTERISTIC Rail_nCloseCtl_C Rail_nThresStrt_C Rail_numRevPlaus_C Rail_pCloseCtl_C Rail_pDiffCloseCtl_C Rail_pOpnCtl_C Rail_swtCtlModeAdjVal_C Rail_tiDebDefMeUnDiag_C Rail_tiDebOkMeUnDiag_C Rail_tiDebDefPCVDiag_C Rail_tiDebOkPCVDiag_C /end DEF_CHARACTERISTIC
/end FUNCTION
/begin FUNCTION rail_ctllooplib ""
 /begin DEF_CHARACTERISTIC Rail_dvolOff_C Rail_dvolStrt_C Rail_numRevDel_C Rail_pSetMin_C Rail_stCtlLoopSel_C Rail_tiDeflate_C Rail_tiMeUnRmpDur_CUR Rail_tiSwtToMeUnCtl_C /end DEF_CHARACTERISTIC
 /begin IN_MEASUREMENT Eng_nAvrg /end IN_MEASUREMENT
/end FUNCTION
/begin FUNCTION rail_ctllooplib_uic "" /begin OUT_MEASUREMENT Rail_facMeUnTiRmpVal_mp Rail_tiMeUnRmpDur_mp /end OUT_MEASUREMENT /end FUNCTION
/begin FUNCTION rail_ctllooplimmeun "Begrenzungen für die Druckregelung ueber Zumesseinheit" /begin DEF_CHARACTERISTIC Rail_dvolMeUnCtlLoLim_C Rail_dvolMeUnCtlUpLim_CUR /end DEF_CHARACTERISTIC /begin IN_MEASUREMENT Eng_nAvrg /end IN_MEASUREMENT /end FUNCTION
/begin FUNCTION rail_ctllooplimmeun_uic "" /end FUNCTION
/begin FUNCTION rail_ctllooplimpcv "Begrenzungen für die Druckregelung ueber Druckregelventil"
 /begin DEF_CHARACTERISTIC Rail_pPCVCtlLoLimStrt_C Rail_pPCVCtlLoLim_C Rail_pPCVCtlUpLimStrt_C Rail_pPCVCtlUpLim_C /end DEF_CHARACTERISTIC
/end FUNCTION
/begin FUNCTION rail_ctllooplimpcv_uic "" /begin OUT_MEASUREMENT Rail_pPCVCtlLoLim_mp Rail_pPCVCtlUpLim_mp /end OUT_MEASUREMENT /end FUNCTION
/begin FUNCTION rail_ctlloopmeun_msg "" /begin OUT_MEASUREMENT Rail_dvolMeUnCtlI Rail_dvolMeUnSet Rail_pMeUnDvt /end OUT_MEASUREMENT /end FUNCTION
/begin FUNCTION rail_ctlloopparameun "Parameter für die Druckregelung ueber Zumesseinheit"
 /begin DEF_CHARACTERISTIC Rail_facOvrMeUnNegIncr_C Rail_MeUnCtlDKd_CUR Rail_MeUnCtlIKiNeg_CUR Rail_MeUnCtlIKiPos_CUR Rail_MeUnCtlIKi_CUR Rail_MeUnCtlPKpNeg_CUR Rail_MeUnCtlPKpPos_CUR Rail_MeUnCtlPKp_CUR Rail_pMeUnCtlIWinNeg_C Rail_pMeUnCtlIWinPos_C Rail_pMeUnCtlPWinNeg_C Rail_pMeUnCtlPWinPos_C Rail_pOvrMeUnThresHigh_C Rail_pOvrMeUnThresLow_C Rail_tiMeUnCtlDT1_CUR Rail_tiMeUnCtlPT1_CUR /end DEF_CHARACTERISTIC
 /begin IN_MEASUREMENT Eng_nAvrg /end IN_MEASUREMENT
/end FUNCTION
/begin FUNCTION rail_ctlloopparameun_uic ""
 /begin OUT_MEASUREMENT Rail_MeUnCtlDKd_mp Rail_MeUnCtlIKiNeg_mp Rail_MeUnCtlIKiPos_mp Rail_MeUnCtlIKi_mp Rail_MeUnCtlPKpNeg_mp Rail_MeUnCtlPKpPos_mp Rail_MeUnCtlPKp_mp Rail_tiMeUnCtlDT1_mp Rail_tiMeUnCtlPT1_mp /end OUT_MEASUREMENT
/end FUNCTION
/begin FUNCTION rail_ctlloopparapcv "Parameter für die Druckregelung ueber Druckregelventil"
 /begin DEF_CHARACTERISTIC Rail_facOvrPCVNegIncr_C Rail_PCVCtlDKd_CUR Rail_PCVCtlIKiNeg_CUR Rail_PCVCtlIKiPos_CUR Rail_PCVCtlIKi_CUR Rail_PCVCtlPKpNeg_CUR Rail_PCVCtlPKpPos_CUR Rail_PCVCtlPKp_CUR Rail_pOvrPCVThresHigh_C Rail_pOvrPCVThresLow_C Rail_pPCVCtlIWinNeg_C Rail_pPCVCtlIWinPos_C Rail_pPCVCtlPWinNeg_C Rail_pPCVCtlPWinPos_C Rail_tiPCVCtlDT1_CUR /end DEF_CHARACTERISTIC
 /begin IN_MEASUREMENT Eng_nAvrg /end IN_MEASUREMENT
/end FUNCTION
/begin FUNCTION rail_ctlloopparapcv_uic ""
 /begin OUT_MEASUREMENT Rail_PCVCtlDKd_mp Rail_PCVCtlIKiNeg_mp Rail_PCVCtlIKiPos_mp Rail_PCVCtlIKi_mp Rail_PCVCtlPKpNeg_mp Rail_PCVCtlPKpPos_mp Rail_PCVCtlPKp_mp Rail_tiPCVCtlDT1_mp /end OUT_MEASUREMENT
/end FUNCTION
/begin FUNCTION rail_ctllooppcv_msg "" /begin OUT_MEASUREMENT Rail_pPCVDvt Rail_pPCVSet Rail_stPCVWindUp /end OUT_MEASUREMENT /end FUNCTION
/begin FUNCTION rail_ctlloop_msg ""
 /begin OUT_MEASUREMENT Rail_dvolEstAged Rail_dvolMeUnCtlUpLim Rail_dvolPreCtlCor Rail_pDvt Rail_pPreCtlCor Rail_stCtlLoop Rail_stShOffTstAck /end OUT_MEASUREMENT
/end FUNCTION
/begin FUNCTION rail_ctlloop_uic ""
 /begin DEF_CHARACTERISTIC Rail_dvolMeUnSet_Vector Rail_dvolMeUnSet_Channel Rail_dvolPreCtlCor_Vector Rail_dvolPreCtlCor_Channel Rail_pPCVSet_Vector Rail_pPCVSet_Channel Rail_pPreCtlCor_Vector Rail_pPreCtlCor_Channel /end DEF_CHARACTERISTIC
/end FUNCTION
/begin FUNCTION rail_ctlmeun ""
 /begin DEF_CHARACTERISTIC Rail_dvolMeUnCtlInitI_CUR Rail_nMeUnFrzI_C Rail_pDvtFltMin_C Rail_tiFrzIDel_C /end DEF_CHARACTERISTIC
 /begin IN_MEASUREMENT FlSys_t /end IN_MEASUREMENT
/end FUNCTION
/begin FUNCTION rail_ctlmeun_uic ""
 /begin OUT_MEASUREMENT Rail_dvolMeUnCtlDT1_mp Rail_dvolMeUnCtlP_mp Rail_pDvtFltLim_mp Rail_pPeakFlt_mp Rail_stMeUnFrzI_mp /end OUT_MEASUREMENT
/end FUNCTION
/begin FUNCTION rail_ctlpcv "" /begin DEF_CHARACTERISTIC Rail_pPCVInitI_MAP Rail_swtPCVInitI_C /end DEF_CHARACTERISTIC /begin IN_MEASUREMENT Eng_nAvrg Rail_pSetPoint /end IN_MEASUREMENT /end FUNCTION
/begin FUNCTION rail_ctlpcv_uic ""
 /begin OUT_MEASUREMENT Rail_pPCVCtlDT1_mp Rail_pPCVCtlI_mp Rail_pPCVCtlPILim_mp Rail_pPCVCtlP_mp Rail_pPCVInitI_mp Rail_pWindUp_mp /end OUT_MEASUREMENT
/end FUNCTION
/begin FUNCTION rail_ctltypeswt "Umschaltbedingungen für das 2-Reglerkonzept"
 /begin DEF_CHARACTERISTIC Rail_tiEGTMskHiLo_C Rail_tiEGTMskLoHi_C Rail_qMeUnCtlType_CUR Rail_qPCVCtlType_CUR Rail_stCondRgnMsk_C Rail_tFlSysRgnMin_C Rail_tFlSysRgnMax_C Rail_stFlSysRgnLow_C Rail_stFlSysRgnHigh_C Rail_tiDRMin_C Rail_tiMeUnCtlTypeDel_C Rail_tiSwtCtlTypeDel_C Rail_tMeUnCtlType_CUR Rail_tOvrRunThres_C Rail_tPCVCtlType_CUR Rail_tSwtCtlTypeHi_C Rail_tSwtCtlTypeLo_C Rail_vMaxDR_C /end DEF_CHARACTERISTIC
 /begin IN_MEASUREMENT Eng_nAvrg /end IN_MEASUREMENT
/end FUNCTION
/begin FUNCTION rail_ctltypeswt_uic ""
 /begin OUT_MEASUREMENT Rail_qMeUnCtlType_mp Rail_qPCVCtlType_mp Rail_stSwtConRgn_mp Rail_stSwtCon_mp Rail_tMeUnCtlType_mp Rail_tPCVCtlType_mp /end OUT_MEASUREMENT
/end FUNCTION
/begin FUNCTION rail_igovcalc "" /end FUNCTION
/begin FUNCTION rail_igovcalc_uic "" /end FUNCTION
/begin FUNCTION rail_moncpc "Raildruckueberwachung für die gekoppelte Drucküberwachung (CPC)" /end FUNCTION
/begin FUNCTION rail_moncpc_msg "" /end FUNCTION
/begin FUNCTION rail_moncpc_uic "" /end FUNCTION
/begin FUNCTION rail_monmeun "Raildruckueberwachung für die Druckregelung ueber Zumesseinheit"
 /begin DEF_CHARACTERISTIC Rail_DebMeUn0MaxDef_C Rail_DebMeUn0MaxOk_C Rail_DebMeUn1MaxDef_C Rail_DebMeUn1MaxOk_C Rail_DebMeUn2MaxDef_C Rail_DebMeUn2MaxOk_C Rail_DebMeUn3MaxDef_C Rail_DebMeUn3MaxOk_C Rail_DebMeUn4MaxDef_C Rail_DebMeUn4MaxOk_C Rail_dvolMeUnSetMin_C Rail_pMeUnPeakMax_C Rail_pMeUnDvtMax_C Rail_qMeUnLoIdle_C Rail_stMonMeUnRls_C Rail_tMeUnLoIdle_C Rail_pMeUnDvtMax_CUR Rail_pMeUnDvtMin_CUR Rail_pMeUnPeakMin_CUR /end DEF_CHARACTERISTIC
 /begin IN_MEASUREMENT Eng_nAvrg /end IN_MEASUREMENT
/end FUNCTION
/begin FUNCTION rail_monmeun_msg "" /end FUNCTION
/begin FUNCTION rail_monmeun_uic ""
 /begin OUT_MEASUREMENT Rail_pMeUnDvtMax_mp Rail_pMeUnDvtMin_mp Rail_pMeUnPeakMin_mp Rail_stMeUnMon0_mp Rail_stMeUnMon1_mp Rail_stMeUnMon2_mp Rail_stMeUnMon3_mp Rail_stMeUnMon4_mp Rail_tiMeUn0Deb_mp Rail_tiMeUn1Deb_mp Rail_tiMeUn2Deb_mp Rail_tiMeUn3Deb_mp Rail_tiMeUn4Deb_mp /end OUT_MEASUREMENT
/end FUNCTION
/begin FUNCTION rail_monpcv "Raildruckueberwachung für die Druckregelung ueber Druckregelventil"
 /begin DEF_CHARACTERISTIC Rail_DebPCV0MaxDef_C Rail_DebPCV0MaxOk_C Rail_DebPCV1MaxDef_C Rail_DebPCV1MaxOk_C Rail_DebPCV2MaxDef_C Rail_DebPCV2MaxOk_C Rail_DebPCV3MaxDef_C Rail_DebPCV3MaxOk_C Rail_DebPCV4MaxDef_C Rail_DebPCV4MaxOk_C Rail_DebPCV5MaxDef_C Rail_DebPCV5MaxOk_C Rail_pPCVDvtMax_C Rail_pPCVDvtMin_C Rail_pPCVSetMin_C Rail_pAbsDvtMax_C Rail_tiThresMonEna_C Rail_qMonEnaMax_C Rail_nMonEnaMin_C Rail_nMonEnaMax_C Rail_pPCVPeakMax_C Rail_stMonPCVRls_C Rail_pNIPCVMax_MAP Rail_pNIPCVMin_MAP Rail_pPCVDvtMax_CUR Rail_pPCVPeakMin_CUR Rail_pPCVSetMax_CUR /end DEF_CHARACTERISTIC
 /begin IN_MEASUREMENT Eng_nAvrg PCVCD_iActVal Rail_pSetPoint /end IN_MEASUREMENT
/end FUNCTION
/begin FUNCTION rail_monpcv_msg "" /begin OUT_MEASUREMENT Rail_tiThresMonEna /end OUT_MEASUREMENT /end FUNCTION
/begin COMPU_METHOD AirMassPerTime "Luftmasse pro Zeit" RAT_FUNC "%6.3" "Kg/h" COEFFS 0 10 0 0 0 1 /end COMPU_METHOD
/begin COMPU_METHOD B_TRUE "Umrechnung   ----> FALSE;    TRUE = TRUE" TAB_VERB "%6.3" "-" COMPU_TAB_REF B_TRUE /end COMPU_METHOD
/begin COMPU_VTAB B_TRUE "Umrechnung   ----> FALSE;    TRUE = TRUE" TAB_VERB 2 0 "FALSE" 1 "TRUE" /end COMPU_VTAB
/begin COMPU_METHOD CubMtrPerHr "Volumsstrom in m^3/h" RAT_FUNC "%6.3" "m^3/h" COEFFS 0 10 0 0 0 1 /end COMPU_METHOD
/begin COMPU_METHOD CubMtrPerHrPerSec "Volumenstromdifferenz pro Sekunde" RAT_FUNC "%6.3" "m^3/h/s" COEFFS 0 10 0 0 0 1 /end COMPU_METHOD
/begin COMPU_METHOD Curr "Strom" RAT_FUNC "%6.2" "mA" COEFFS 0 1 0 0 0 1 /end COMPU_METHOD
/begin COMPU_METHOD DEZ "K3 Umwandlungen" RAT_FUNC "%6.2" "-" COEFFS 0 1 0 0 0 1 /end COMPU_METHOD
/begin COMPU_METHOD dmSoot_mg_p_s "differenzielle Rußmasse mg/s" RAT_FUNC "%6.4" "mg/s" COEFFS 0 100 0 0 0 1 /end COMPU_METHOD
/begin COMPU_METHOD DtyCyc "Tastverhaeltnis" RAT_FUNC "%6.4" "%" COEFFS 0 100 0 0 0 1 /end COMPU_METHOD
/begin COMPU_METHOD EngN "Motordrehzahl" RAT_FUNC "%6.2" "rpm" COEFFS 0 1 0 0 0 1 /end COMPU_METHOD
/begin COMPU_METHOD EngTempFldSel "Verbale Umrechnung für Auswahl aus dem Motortemperatur-Feld Eng_tFld" TAB_VERB "%6.3" "-" COMPU_TAB_REF EngTempFldSel /end COMPU_METHOD
/begin COMPU_VTAB EngTempFldSel "Verbale Umrechnung für Auswahl aus dem Motortemperatur-Feld Eng_tFld" TAB_VERB 3 0 "Coolant_Temperature" 1 "Oil_Temperature" 2 "Eng_tEng" /end COMPU_VTAB
/begin COMPU_METHOD Fact "Faktor mit Auflösung 1 / 8192, hauptsächlich für einen Faktorenbereich 0...1 verwendet" RAT_FUNC "%6.5" "-" COEFFS 0 8192 0 0 0 1 /end COMPU_METHOD
/begin COMPU_METHOD Fact1 "Faktor mit Auflösung 0,01 (100 mal höherer Bereich als Fact)" RAT_FUNC "%6.4" "-" COEFFS 0 128 0 0 0 1 /end COMPU_METHOD
/begin COMPU_METHOD FactLow "Faktor mit Auflösung 1/1024, hauptsächlich für einen Faktorenbereich 1...50 verwendet" RAT_FUNC "%6.5" "-" COEFFS 0 1024 0 0 0 1 /end COMPU_METHOD
/begin COMPU_METHOD FlConsum_l_h "Kraftstoffverbrauch" RAT_FUNC "%6.4" "l/h" COEFFS 0 100 0 0 0 1 /end COMPU_METHOD
/begin COMPU_METHOD hPaPerSec "Differenzdruck pro Sekunde" RAT_FUNC "%6.3" "hPa/s" COEFFS 0 10 0 0 0 1 /end COMPU_METHOD
/begin COMPU_METHOD InjMass "Einspritzmenge" RAT_FUNC "%6.4" "mg/hub" COEFFS 0 100 0 0 0 1 /end COMPU_METHOD
/begin COMPU_METHOD InjMassCyc "Einspritzmenge pro Zyklus (mg/Zyklus)" RAT_FUNC "%6.4" "mg/cyc" COEFFS 0 100 0 0 0 1 /end COMPU_METHOD
/begin COMPU_METHOD InjMassInj "Einspritzmenge pro Einspritzung (mg/Einspritzung)" RAT_FUNC "%6.4" "mg/inj" COEFFS 0 100 0 0 0 1 /end COMPU_METHOD
/begin COMPU_METHOD InjTime_us "Zeit in Microsekunden für das Einspritztiming" RAT_FUNC "%6.2" "us" COEFFS 0 1 0 0 0 1 /end COMPU_METHOD
/begin COMPU_METHOD Kd "Differentialverstärkung Kd (gleiche Einheit/Umrechnungsformel an Ein- und Ausgang)" RAT_FUNC "%7.6" "1/1" COEFFS 0 65536 0 0 0 1 /end COMPU_METHOD
/begin COMPU_METHOD Kd_1 "Differentialverstärkung Kd (gleiche Einheit/Umrechnungsregel an Ein- und Ausgang; Umrechnung für sint16-Werte)" RAT_FUNC "%6.4" "1/1" COEFFS 0 512 0 0 0 1 /end COMPU_METHOD
/begin COMPU_METHOD Kd_pRail2Q "Differentialverstärkung (Raildruck zu Menge)" RAT_FUNC "%11.4" "mm^3/s/bar" COEFFS 0 655.360000 0 0 0 1 /end COMPU_METHOD
/begin COMPU_METHOD Kd_pRail2Q_1 "Differentialverstärkung mit Normexponent (Raildruck zu Menge)" RAT_FUNC "%10.3" "mm^3/s/bar" COEFFS 0 40.960000 0 0 0 1 /end COMPU_METHOD
/begin COMPU_METHOD Ki "Integrale Verstärkung Ki (gleiche Einheit/Umrechnungsregel an Ein- und Ausgang)" RAT_FUNC "%6.5" "1/s" COEFFS 0 4294.967296 0 0 0 1 /end COMPU_METHOD
/begin COMPU_METHOD Ki_1 "Integrale Verstärkung Ki (gleiche Einheit/Umrechnungsregel an Ein- und Ausgang; Umrechnung für sint16-Werte)" RAT_FUNC "%6.4" "1/s" COEFFS 0 67.108864 0 0 0 1 /end COMPU_METHOD
/begin COMPU_METHOD Ki_pRail2Q "Integralverstärkung (Raildruck zu Menge)" RAT_FUNC "%10.3" "mm^3/s^2/bar" COEFFS 0 42.949673 0 0 0 1 /end COMPU_METHOD
/begin COMPU_METHOD Ki_pRail2Q_1 "Intgralverstärkung mit Normexponent (Raildruck zu Menge)" RAT_FUNC "%10.3" "mm^3/s^2/bar" COEFFS 0 10.737418 0 0 0 1 /end COMPU_METHOD
/begin COMPU_METHOD Ki_Vel2TrqPrp "Integralverstärkung (Fahrgeschwindigkeit zu Vortriebsmoment)" RAT_FUNC "%6.4" "Nm/(km/h)/s" COEFFS 0 214.7483648 0 0 0 1 /end COMPU_METHOD
/begin COMPU_METHOD Kp "proportionale Verstärkung Kp (gleiche Einheit/Umrechnungsregel an Ein- und Ausgang)" RAT_FUNC "%7.6" "1/1" COEFFS 0 65536 0 0 0 1 /end COMPU_METHOD
/begin COMPU_METHOD Kp_1 "proportionale Verstärkung Kp (gleiche Einheit/Umrechnungsregel an Ein- und Ausgang; Umrechnung für sint16-Werte)" RAT_FUNC "%6.4" "1/1" COEFFS 0 64 0 0 0 1 /end COMPU_METHOD
/begin COMPU_METHOD Kp_pRail2Q "Proportionale Verstärkung Kp (Raildruck zu Menge)" RAT_FUNC "%11.4" "mm^3/s/bar" COEFFS 0 655.360000 0 0 0 1 /end COMPU_METHOD
/begin COMPU_METHOD Kp_pRail2Q_1 "Proportionale Verstärkung mit Normexponent (Raildruck zu Menge)" RAT_FUNC "%10.3" "mm^3/s/bar" COEFFS 0 81.920000 0 0 0 1 /end COMPU_METHOD
/begin COMPU_METHOD Kp_Vel2TrqPrp "Proportionalverstärkung (Fahrgeschwindigkeit zu Vortriebsmoment)" RAT_FUNC "%6.5" "Nm/(km/h)" COEFFS 0 3276.8 0 0 0 1 /end COMPU_METHOD
/begin COMPU_METHOD Length "Länge in Meter" RAT_FUNC "%6.2" "m" COEFFS 0 1 0 0 0 1 /end COMPU_METHOD
/begin COMPU_METHOD LengthKm "Länge in Kilometer" RAT_FUNC "%6.2" "km" COEFFS 0 1 0 0 0 1 /end COMPU_METHOD
/begin COMPU_METHOD mSoot_g "Rußmasse [g]" RAT_FUNC "%6.4" "g" COEFFS 0 100 0 0 0 1 /end COMPU_METHOD
/begin COMPU_METHOD NumPinAdc "verbale Umrechnung für ADC Signale" TAB_VERB "%6.3" "-" COMPU_TAB_REF NumPinAdc /end COMPU_METHOD
/begin COMPU_VTAB NumPinAdc "verbale Umrechnung für ADC Signale" TAB_VERB 27 0 "Water_Temperature_Sensor_182" 1 "Intake_Air_Temperature_Sensor_157" 2 "Charge_Air_Temperature_Sensor_183" 3 "Exhaust_Temperature_Sensor_2_134" 4 "Exhaust_Temperature_Sensor_1_158" 5 "1st_APP_Sensor_252" 6 "2nd_APP_Sensor_239" 7 "ADC_REF" 8 "Boost_Pressure_Sensor_154" 9 "Atmospheric_Pressure_Sensor" 10 "Battery_Voltage_Sensor" 11 "Rail_Pressure_Sensor_156" 12 "Rail_Pressure_Peak_Value_156" 13 "Booster_Voltage_Sensor" 14 "Current_MeUn_Sensor" 15 "Current_PCV_Sensor" 16 "Voltage_Bank_1" 17 "Voltage_Bank_2" 18 "Pressure_Upstream_Particle_Filter_159" 19 "Engine_Oil_Pressure_110" 20 "Temperature_ECU_PCB" 21 "Voltage_Lambda_Ua" 22 "Voltage_Lambda_Ri" 23 "EMCCD_Current_Governor1_124" 24 "EMCCD_Current_Governor2_121" 25 "ADC_DUMMY_NOT_USED" 26 "ADC_DUMMY_A_NOT_USED" /end COMPU_VTAB
/begin COMPU_METHOD NumPinDia "Verbale Umrechnung für Diagnose Signale" TAB_VERB "%6.3" "-" COMPU_TAB_REF NumPinDia /end COMPU_METHOD
/begin COMPU_VTAB NumPinDia "Verbale Umrechnung für Diagnose Signale" TAB_VERB 28 0 "CJ945_Diagnostic_Signal" 1 "AC_Compressor_DiaSig" 2 "Fuel_Pump_Diagnostic_Signal_232" 3 "Starter_234" 4 "Oil_Pressure_Lamp_Switch_245" 5 "EGRClg_Byp_Diagnostic_Signal_123" 6 "Ebox_Fan_Actuator_Diagnostic_Signal_219" 7 "Shuttr_Actuator_Diagnostic_Signal_231" 8 "Twostage_TurboLoading_SW_DiaSig" 9 "DIO_OUT_DIAGNOSTIC_DUMMY_NOT_USED" 10 "Alternator" 11 "Boost_Pressure_Actuator_Diagnostic_Signal_193" 12 "EGR_Actuator_Diagnostic_Signal_194" 13 "1st_Pressure_Control_Valve_Diagnostic_Signal_172" 14 "2nd_Pressure_Control_Valve_Diagnostic_Signal_172" 15 "1st_Metering_Unit_Diagnostic_Signal_171" 16 "2nd_Metering_Unit_Diagnostic_Signal_171" 17 "Variable_Swirl_Actuator_Diagnostic_Signal_195" 18 "FAN_240" 19 "Add_On_Heater_244" 20 "EngM_Bearing_Actuator_Diagnostic_Signal_124" 21 "EngM_Bearing_Actuator_Diagnostic_Signal_121" 22 "Throttle_Valve_Diagnostic_Signal_196" 23 "Low pressure stage BPA_Diagnostic_Signal_117" 24 "PWM_DIAGNOSTIC_DUMMY_NOT_USED" 25 "1st_Sensor_Supply_Voltage_DiaSig" 26 "2nd_Sensor_Supply_Voltage_DiaSig" 27 "3rd_Sensor_Supply_Voltage_DiaSig" /end COMPU_VTAB
/begin COMPU_METHOD NumPinDioOut "Verbale Umrechnung für Digitalausgang Signale" TAB_VERB "%6.3" "-" COMPU_TAB_REF NumPinDioOut /end COMPU_METHOD
/begin COMPU_VTAB NumPinDioOut "Verbale Umrechnung für Digitalausgang Signale" TAB_VERB 12 0 "Main_Relay_220(144)" 1 "AC_Compressor" 2 "Fuel_Pump_232" 3 "Starter_234" 4 "OPS_Lamp_245" 5 "EGRClg_Byp_123" 6 "Ebox_Fan_Actuator_219" 7 "Shuttr_Actuator_Digital_231" 8 "STATREG_PSOFF_Bit" 9 "Twostage_TurboLoading_120" 10 "TD_Signal_253" 11 "DIO_OUT_DUMMY_NOT_USED" /end COMPU_VTAB
/begin COMPU_METHOD OneToOne "eins zu eins (physikalischer Wert ist gleich dem internen Wert)" RAT_FUNC "%6.2" "-" COEFFS 0 1 0 0 0 1 /end COMPU_METHOD
/begin COMPU_METHOD Prc "Prozent, gleiche interne Auflösung wie Fact, aber Darstellung in Prozent (0...100%)" RAT_FUNC "%6.4" "%" COEFFS 0 81.92 0 0 0 1 /end COMPU_METHOD
/begin COMPU_METHOD Pres_hPa "Druck (angezeigt in [hPa])" RAT_FUNC "%6.2" "hPa" COEFFS 0 1 0 0 0 1 /end COMPU_METHOD
/begin COMPU_METHOD Pres_Rail "Raildruck in hPa" RAT_FUNC "%4.3" "bar" COEFFS 0 10.000000 0 0 0 1 /end COMPU_METHOD
/begin COMPU_METHOD QltDet "" TAB_VERB "%6.3" "-" COMPU_TAB_REF QltDet /end COMPU_METHOD
/begin COMPU_VTAB QltDet "" TAB_VERB 3 0 "Detection_Ready" 1 "Detection Init" 2 "Detection Diagnose" /end COMPU_VTAB
/begin COMPU_METHOD Qp_mm3_sec "Umrechnung für Volumenstrom" RAT_FUNC "%6.1" "mm3/s" COEFFS 0 0.1 0 0 0 1 /end COMPU_METHOD
/begin COMPU_METHOD Res_hPaHrPerCM "Strömungswiderstand [hPa h/m3]" RAT_FUNC "%6.5" "hPa/(m^3/h)" COEFFS 0 1000 0 0 0 1 /end COMPU_METHOD
/begin COMPU_METHOD RmpPres_hPa "Rampengradient für Druck angezeigt in [hPa/s]" RAT_FUNC "%6.4" "hPa/s" COEFFS 0 65.536 0 0 0 1 /end COMPU_METHOD
/begin COMPU_METHOD TempDiff_Cels "difference/offset temperature displayed in degree celcius" RAT_FUNC "%6.3" "deg C" COEFFS 0 10 0 0 0 1 /end COMPU_METHOD
/begin COMPU_METHOD Temp_Cels "Temperatur dargestellt in °C (gleiche interne Darstellung wie Temp_Kelv)" RAT_FUNC "%6.1" "deg C" COEFFS 0 10 2731.4 0 0 1 /end COMPU_METHOD
/begin COMPU_METHOD Thr_Cpty "Wärmekapazität" RAT_FUNC "%6.2" "J/K" COEFFS 0 1 0 0 0 1 /end COMPU_METHOD
/begin COMPU_METHOD Thr_Cpty_ExhGs "Wärmekapazität des Abgases" RAT_FUNC "%6.2" "J/kgK" COEFFS 0 0.1 0 0 0 1 /end COMPU_METHOD
/begin COMPU_METHOD TimeDeb "Entprellzeit in Millisekunden für Libraryfunktion Debounce" RAT_FUNC "%6.1" "ms" COEFFS 0 0.1 0 0 0 1 /end COMPU_METHOD
/begin COMPU_METHOD TimeDelay_s "Zeitkonstante T1 (in s) für PT1, DT1, etc." RAT_FUNC "%9.3" "s" COEFFS 0 0 1 0 0.00023283064365387 0 /end COMPU_METHOD
/begin COMPU_METHOD TimeDelay_s_2 "Zeitkonstante T1 (in s) für PT1, DT1, etc. normiert auf 16 bit" RAT_FUNC "%9.4" "s" COEFFS 0 0 1 0 0.0596046447753906 0 /end COMPU_METHOD
/begin COMPU_METHOD TimeDelay_s_Lin_16_2 "Umrechung für Verzögerungszeitapplikation" RAT_FUNC "%6.4" "s" COEFFS 0 16.3835 0 0 0 1 /end COMPU_METHOD
/begin COMPU_METHOD TimeDT_ms "sample time (DT) des Tasks ,verwendet fuer Regler, Filter etc. ... angezeigt in [ms]" RAT_FUNC "%6.5" "ms" COEFFS 0 1000 0 0 0 1 /end COMPU_METHOD
/begin COMPU_METHOD TimeEngOn "Motorbetriebszeit in Sekunden" RAT_FUNC "%6.2" "s" COEFFS 0 1 0 0 0 1 /end COMPU_METHOD
/begin COMPU_METHOD TimeRed "Zeit in Sekunden mit reduzierter Auflösung für Ein/Ausgänge von KL/KF (sint16)" RAT_FUNC "%6.3" "s" COEFFS 0 6.25 0 0 0 1 /end COMPU_METHOD
/begin COMPU_METHOD Time_ms "Zeit in ms für Fehlerentprellung (DSM) und SW-Timer" RAT_FUNC "%6.1" "ms" COEFFS 0 0.1 0 0 0 1 /end COMPU_METHOD
/begin COMPU_METHOD Time_s "Zeit in s für Fehlerentprellung (DSM) und SW-Timer" RAT_FUNC "%6.4" "s" COEFFS 0 100 0 0 0 1 /end COMPU_METHOD
/begin COMPU_METHOD Trq "Motormoment" RAT_FUNC "%6.3" "Nm" COEFFS 0 10 0 0 0 1 /end COMPU_METHOD
/begin COMPU_METHOD TrqPrp "Vortriebsmoment" RAT_FUNC "%6.3" "Nm" COEFFS 0 5 0 0 0 1 /end COMPU_METHOD
/begin COMPU_METHOD Vel "Fahrzeuggeschwindigkeit, gleiche interne Auflösung wie Vel_SI" RAT_FUNC "%6.4" "km/h" COEFFS 0 100 0 0 0 1 /end COMPU_METHOD
/begin COMPU_METHOD Vel_1 "Geschwindigkeit Umrechnung" RAT_FUNC "%6.3" "m/min" COEFFS 0 10 0 0 0 1 /end COMPU_METHOD
/begin COMPU_METHOD volAdd_ml2 "Umrechnung mit 1ml Auflösung für Additivmenge in AddPmp_AddMet" RAT_FUNC "%6.2" "ml" COEFFS 0 1 0 0 0 1 /end COMPU_METHOD
/begin COMPU_METHOD Volt "Spannung in V (von ADC)" RAT_FUNC "%6.2" "mV" COEFFS 0 0.2046 0 0 0 1 /end COMPU_METHOD
/begin COMPU_METHOD Volt_Batt "Batteriespannung" RAT_FUNC "%6.1" "mV" COEFFS 0 0.05115 0 0 0 1 /end COMPU_METHOD
/begin RECORD_LAYOUT Kf_Xs16_Ys16_Ws16 NO_AXIS_PTS_X 1 SWORD NO_AXIS_PTS_Y 2 SWORD AXIS_PTS_X 3 SWORD INDEX_INCR DIRECT AXIS_PTS_Y 4 SWORD INDEX_INCR DIRECT FNC_VALUES 5 SWORD COLUMN_DIR DIRECT /end RECORD_LAYOUT
/begin RECORD_LAYOUT Kl_Xs16_Ws16 NO_AXIS_PTS_X 1 SWORD AXIS_PTS_X 2 SWORD INDEX_INCR DIRECT FNC_VALUES 3 SWORD COLUMN_DIR DIRECT /end RECORD_LAYOUT
/begin RECORD_LAYOUT Kw_Ws16 FNC_VALUES 1 SWORD COLUMN_DIR DIRECT /end RECORD_LAYOUT
/begin RECORD_LAYOUT Kw_Ws32 FNC_VALUES 1 SLONG COLUMN_DIR DIRECT /end RECORD_LAYOUT
/begin RECORD_LAYOUT Kw_Ws8 FNC_VALUES 1 SBYTE COLUMN_DIR DIRECT /end RECORD_LAYOUT
/begin RECORD_LAYOUT Kw_Wu16 FNC_VALUES 1 UWORD COLUMN_DIR DIRECT /end RECORD_LAYOUT
/begin RECORD_LAYOUT Kw_Wu32 FNC_VALUES 1 ULONG COLUMN_DIR DIRECT /end RECORD_LAYOUT
/begin RECORD_LAYOUT Kw_Wu8 FNC_VALUES 1 UBYTE COLUMN_DIR DIRECT /end RECORD_LAYOUT
/end MODULE
/end PROJECT
