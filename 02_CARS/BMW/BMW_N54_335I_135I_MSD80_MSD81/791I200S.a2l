ASAP2_VERSION 1 41
/begin PROJECT MSD85 "Spray Guided DI-System with Piezo Injectors for 8-Cylinder"
/begin HEADER "_default_HeaderComment" PROJECT_NO _91 /end HEADER
/begin MODULE _default_ModuleName "_default_ModuleLongIdentifier"
/begin MOD_COMMON "_default_ModCommonComment" DEPOSIT ABSOLUTE BYTE_ORDER MSB_LAST ALIGNMENT_BYTE 1 ALIGNMENT_WORD 2 ALIGNMENT_LONG 2 ALIGNMENT_FLOAT32_IEEE 2 ALIGNMENT_FLOAT64_IEEE 4 /end MOD_COMMON
/begin MEASUREMENT Bank_eisy "EISY Bank" UBYTE _CNV_R_R_Def_dez_sl_551_CM 1 100. 0. 255. DISPLAY_IDENTIFIER BANK_EISY ECU_ADDRESS 0xd000d151 FORMAT "%3.0" /end MEASUREMENT
/begin MEASUREMENT Bnscounter "Counter Bordnetzspannungsplausibilisierung" UBYTE _CNV_R_R_Def_dez_sl_551_CM 1 100. 0. 255. DISPLAY_IDENTIFIER BNSCOUNTER ECU_ADDRESS 0xd000d924 FORMAT "%3.0" /end MEASUREMENT
/begin MEASUREMENT D_ubatt_vbmw "Abstand Batteriespannung zu thermischer Oberspannung" SWORD _CNV_R_R_Def_u_sw_b_581_CM 1 100. -128. 127.996 DISPLAY_IDENTIFIER D_UBATT_VBMW ECU_ADDRESS 0xc0000d0c FORMAT "%8.3" /end MEASUREMENT
/begin MEASUREMENT D_ubatt_vbmw2 "Zwischenvariable ob thermische Obergrenze erreicht" SLONG _CNV_R_R_Def_f_sl_q_582_CM 1 100. -16777216. 16777215.9921 DISPLAY_IDENTIFIER D_UBATT_VBMW2 ECU_ADDRESS 0xc0000d04 FORMAT "%10.3" /end MEASUREMENT
/begin MEASUREMENT D_ubatt_vbmwi "Zwischenvariable thermische Überlast" SLONG _CNV_R_R_Def_f_sl_q_582_CM 1 100. -16777216. 16777215.9921 DISPLAY_IDENTIFIER D_UBATT_VBMWI ECU_ADDRESS 0xc0000d08 FORMAT "%10.3" /end MEASUREMENT
/begin MEASUREMENT Dpbkv "Bremsunterdruck" SWORD _CNV_R_R_Def_p_sw_q_596_CM 1 100. -3276.8 3276.7 DISPLAY_IDENTIFIER DPBKV ECU_ADDRESS 0xc0004094 FORMAT "%7.2" /end MEASUREMENT
/begin MEASUREMENT Dpbkv_dif_f "Delta Bremsunterdruck gefiltert" SWORD _CNV_R_R_Def_p_sw_q_596_CM 1 100. -3276.8 3276.7 DISPLAY_IDENTIFIER DPBKV_DIF_F ECU_ADDRESS 0xc00006f4 FORMAT "%7.2" /end MEASUREMENT
/begin MEASUREMENT Dpbkv_dif_of "Delta Bremsunterdruck ungefiltert" SWORD _CNV_R_R_Def_p_sw_q_596_CM 1 100. -3276.8 3276.7 DISPLAY_IDENTIFIER DPBKV_DIF_OF ECU_ADDRESS 0xc00006f2 FORMAT "%7.2" /end MEASUREMENT
/begin MEASUREMENT Dpbkv_diff "Delta Bremsunterdruck" SWORD _CNV_R_R_Def_p_sw_q_596_CM 1 100. -3276.8 3276.7 DISPLAY_IDENTIFIER DPBKV_DIFF ECU_ADDRESS 0xc00006ec FORMAT "%7.2" /end MEASUREMENT
/begin MEASUREMENT Dpbkv_f "Bremsunterdruck gefiltert" SWORD _CNV_R_R_Def_p_sw_q_596_CM 1 100. -3276.8 3276.7 DISPLAY_IDENTIFIER DPBKV_F ECU_ADDRESS 0xc00006f0 FORMAT "%7.2" /end MEASUREMENT
/begin MEASUREMENT Dpbkv_of "Bremsunterdruck ungefiltert" SWORD _CNV_R_R_Def_p_sw_q_596_CM 1 100. -3276.8 3276.7 DISPLAY_IDENTIFIER DPBKV_OF ECU_ADDRESS 0xc00006ee FORMAT "%7.2" /end MEASUREMENT
/begin MEASUREMENT Eisy_segtoggle "" UBYTE _CNV_R_R_Def_dez_sl_551_CM 1 100. 0. 255. DISPLAY_IDENTIFIER EISY_SEGTOGGLE ECU_ADDRESS 0xd000d15e FORMAT "%3.0" /end MEASUREMENT
/begin MEASUREMENT Eisyagr_kor_fak_i "" UWORD _CNV_R_R_Def_f_uw_b_588_CM 1 100. 0. 31.9995 DISPLAY_IDENTIFIER EISYAGR_KOR_FAK_I ECU_ADDRESS 0xd000d1a4 FORMAT "%9.4" ARRAY_SIZE 2 MATRIX_DIM 2 1 1 /end MEASUREMENT
/begin MEASUREMENT Eisyagr_korfak_b_i "" UBYTE _CNV_R_R_Def_f_ub_b_612_CM 1 100. 0. 31.875 DISPLAY_IDENTIFIER EISYAGR_KORFAK_B_I ECU_ADDRESS 0xd000d154 FORMAT "%5.2" ARRAY_SIZE 2 MATRIX_DIM 2 1 1 /end MEASUREMENT
/begin MEASUREMENT Eisyagr_korfak_f "" UWORD _CNV_R_R_Def_f_uw_b_588_CM 1 100. 0. 31.9995 DISPLAY_IDENTIFIER EISYAGR_KORFAK_F ECU_ADDRESS 0xd000d1a8 FORMAT "%9.4" /end MEASUREMENT
/begin MEASUREMENT Eisyagr_korfak_f_i "" UWORD _CNV_R_R_Def_f_uw_b_588_CM 1 100. 0. 31.9995 DISPLAY_IDENTIFIER EISYAGR_KORFAK_F_I ECU_ADDRESS 0xd000d1aa FORMAT "%9.4" ARRAY_SIZE 2 MATRIX_DIM 2 1 1 /end MEASUREMENT
/begin MEASUREMENT Eisydk_kor_fak_i "Ms/Ps Reglerausgang, Faktor" UWORD _CNV_R_R_Def_f_uw_b_590_CM 1 100. 0. 1.9999 DISPLAY_IDENTIFIER EISYDK_KOR_FAK_I ECU_ADDRESS 0xd000d194 FORMAT "%14.5" ARRAY_SIZE 2 MATRIX_DIM 2 1 1 /end MEASUREMENT
/begin MEASUREMENT Eisydk_kor_off_i "Ms/Ps Reglerausgang, Offset" SWORD _CNV_R_R_Def_ms_uw__594_CM 1 100. -1024. 1023.9687 DISPLAY_IDENTIFIER EISYDK_KOR_OFF_I ECU_ADDRESS 0xd000d18c FORMAT "%8.3" ARRAY_SIZE 2 MATRIX_DIM 2 1 1 /end MEASUREMENT
/begin MEASUREMENT Eisydk_korfak_b_i "" UBYTE _CNV_R_R_Def_f_ub_b_613_CM 1 100. 0. 1.9921 DISPLAY_IDENTIFIER EISYDK_KORFAK_B_I ECU_ADDRESS 0xd000d15c ARRAY_SIZE 2 MATRIX_DIM 2 1 1 /end MEASUREMENT
/begin MEASUREMENT Eisydk_korfak_f_i "Ms/Ps Reglerausgang, Faktor" UWORD _CNV_R_R_Def_f_uw_b_590_CM 1 100. 0. 1.9999 DISPLAY_IDENTIFIER EISYDK_KORFAK_F_I ECU_ADDRESS 0xd000d198 FORMAT "%14.5" ARRAY_SIZE 2 MATRIX_DIM 2 1 1 /end MEASUREMENT
/begin MEASUREMENT Eisydk_koroff_b_i "" SBYTE _CNV_R_R_Def_ms_sb__614_CM 1 100. -1024. 1016. DISPLAY_IDENTIFIER EISYDK_KOROFF_B_I ECU_ADDRESS 0xd000d158 FORMAT "%5.2" ARRAY_SIZE 2 MATRIX_DIM 2 1 1 /end MEASUREMENT
/begin MEASUREMENT Eisydk_koroff_f_i "Gefilterter Ms/Ps Reglerausgang, Offset" SWORD _CNV_R_R_Def_ms_uw__594_CM 1 100. -1024. 1023.9687 DISPLAY_IDENTIFIER EISYDK_KOROFF_F_I ECU_ADDRESS 0xd000d190 FORMAT "%8.3" ARRAY_SIZE 2 MATRIX_DIM 2 1 1 /end MEASUREMENT
/begin MEASUREMENT Eisyev_kor_fak_i "" UWORD _CNV_R_R_Def_f_uw_b_590_CM 1 100. 0. 1.9999 DISPLAY_IDENTIFIER EISYEV_KOR_FAK_I ECU_ADDRESS 0xd000d19c FORMAT "%14.5" ARRAY_SIZE 2 MATRIX_DIM 2 1 1 /end MEASUREMENT
/begin MEASUREMENT Eisyev_kor_off_i "Offset" SWORD _CNV_R_R_Def_ms_uw__594_CM 1 100. -1024. 1023.9687 DISPLAY_IDENTIFIER EISYEV_KOR_OFF_I ECU_ADDRESS 0xd000d1a0 FORMAT "%8.3" ARRAY_SIZE 2 MATRIX_DIM 2 1 1 /end MEASUREMENT
/begin MEASUREMENT Eisyev_korfak_b_i "" UBYTE _CNV_R_R_Def_f_ub_b_613_CM 1 100. 0. 1.9921 DISPLAY_IDENTIFIER EISYEV_KORFAK_B_I ECU_ADDRESS 0xd000d15a ARRAY_SIZE 2 MATRIX_DIM 2 1 1 /end MEASUREMENT
/begin MEASUREMENT Eisyev_koroff_b_i "" SBYTE _CNV_R_R_Def_ms_sb__614_CM 1 100. -1024. 1016. DISPLAY_IDENTIFIER EISYEV_KOROFF_B_I ECU_ADDRESS 0xd000d156 FORMAT "%5.2" ARRAY_SIZE 2 MATRIX_DIM 2 1 1 /end MEASUREMENT
/begin MEASUREMENT El_last "" UWORD _CNV_R_R_Def_dez_sl_551_CM 1 100. 0. 65535. DISPLAY_IDENTIFIER EL_LAST ECU_ADDRESS 0xc0000cd0 FORMAT "%5.0" /end MEASUREMENT
/begin MEASUREMENT El_verb_entl "" UWORD _CNV_R_R_Def_dez_sl_551_CM 1 100. 0. 65535. DISPLAY_IDENTIFIER EL_VERB_ENTL ECU_ADDRESS 0xc0000cd2 FORMAT "%5.0" /end MEASUREMENT
/begin MEASUREMENT F_pvdkpn_i "Faktor Pvdk -> 1013" UWORD _CNV_R_R_Def_f_sw_b_616_CM 1 100. 0. 3.9999 DISPLAY_IDENTIFIER F_PVDKPN_I ECU_ADDRESS 0xc0000e6e FORMAT "%14.5" ARRAY_SIZE 2 MATRIX_DIM 2 1 1 /end MEASUREMENT
/begin MEASUREMENT F_quot_spuel "" UWORD _CNV_R_R_Def_f_uw_b_571_CM 1 100. 0. 0.9999 DISPLAY_IDENTIFIER F_QUOT_SPUEL ECU_ADDRESS 0xd000d16a FORMAT "%14.5" /end MEASUREMENT
/begin MEASUREMENT F_quot_spuel_i "" UWORD _CNV_R_R_Def_f_uw_b_571_CM 1 100. 0. 0.9999 DISPLAY_IDENTIFIER F_QUOT_SPUEL_I ECU_ADDRESS 0xd000d16c FORMAT "%14.5" ARRAY_SIZE 2 MATRIX_DIM 2 1 1 /end MEASUREMENT
/begin MEASUREMENT F_quot_uk_i "" UWORD _CNV_R_R_Def_f_uw_b_571_CM 1 100. 0. 0.9999 DISPLAY_IDENTIFIER F_QUOT_UK_I ECU_ADDRESS 0xd000d166 FORMAT "%14.5" ARRAY_SIZE 2 MATRIX_DIM 2 1 1 /end MEASUREMENT
/begin MEASUREMENT F_t_pvdkpn_i "Faktor F_tvdk * (Pvdkds/1013)" UWORD _CNV_R_R_Def_f_sw_b_616_CM 1 100. 0. 3.9999 DISPLAY_IDENTIFIER F_T_PVDKPN_I ECU_ADDRESS 0xc0000e72 FORMAT "%14.5" ARRAY_SIZE 2 MATRIX_DIM 2 1 1 /end MEASUREMENT
/begin MEASUREMENT F_tevpstnorm "Faktor Temperaturkorrektur, Pst. Bedingung" UWORD _CNV_R_R_Def_f_uw_b_590_CM 1 100. 0. 1.9999 DISPLAY_IDENTIFIER F_TEVPSTNORM ECU_ADDRESS 0xc0000e76 FORMAT "%14.5" /end MEASUREMENT
/begin MEASUREMENT F_tevpstnorm_bas_i "Faktor Temperaturkorrektur bas, Pst. Bedingung" UWORD _CNV_R_R_Def_f_uw_b_590_CM 1 100. 0. 1.9999 DISPLAY_IDENTIFIER F_TEVPSTNORM_BAS_I ECU_ADDRESS 0xc0000e94 FORMAT "%14.5" ARRAY_SIZE 2 MATRIX_DIM 2 1 1 /end MEASUREMENT
/begin MEASUREMENT F_tevpstnorm_i "Faktor Temperaturkorrektur, Pst. Bedingung" UWORD _CNV_R_R_Def_f_uw_b_590_CM 1 100. 0. 1.9999 DISPLAY_IDENTIFIER F_TEVPSTNORM_I ECU_ADDRESS 0xc0000e78 FORMAT "%14.5" ARRAY_SIZE 2 MATRIX_DIM 2 1 1 /end MEASUREMENT
/begin MEASUREMENT F_tevpstnorm_uf_i "Faktor Temperaturkorrektur ungefilterte, Pst. Bedingung" UWORD _CNV_R_R_Def_f_uw_b_590_CM 1 100. 0. 1.9999 DISPLAY_IDENTIFIER F_TEVPSTNORM_UF_I ECU_ADDRESS 0xc0000e98 FORMAT "%14.5" ARRAY_SIZE 2 MATRIX_DIM 2 1 1 /end MEASUREMENT
/begin MEASUREMENT F_tvdk "Faktor Temperaturkorrektur vor Drosselklappe" UBYTE _CNV_R_R_Def_f_ub_b_613_CM 1 100. 0. 1.9921 DISPLAY_IDENTIFIER F_TVDK ECU_ADDRESS 0xc0000e5e /end MEASUREMENT
/begin MEASUREMENT F_tvdk_i "Faktor Temperaturkorrektur vor Drosselklappe" UBYTE _CNV_R_R_Def_f_ub_b_613_CM 1 100. 0. 1.9921 DISPLAY_IDENTIFIER F_TVDK_I ECU_ADDRESS 0xc0000e5c ARRAY_SIZE 2 MATRIX_DIM 2 1 1 /end MEASUREMENT
/begin MEASUREMENT F_tvdkho "Faktor zur Höhen- und Temperaturkorrektur" UWORD _CNV_R_R_Def_f_sw_b_616_CM 1 100. 0. 3.9999 DISPLAY_IDENTIFIER F_TVDKHO ECU_ADDRESS 0xd000e6e8 FORMAT "%14.5" /end MEASUREMENT
/begin MEASUREMENT F_tvdkho_i "Faktor zur Höhen- und Temperaturkorrektur" UWORD _CNV_R_R_Def_f_sw_b_616_CM 1 100. 0. 3.9999 DISPLAY_IDENTIFIER F_TVDKHO_I ECU_ADDRESS 0xd000e6ea FORMAT "%14.5" ARRAY_SIZE 2 MATRIX_DIM 2 1 1 /end MEASUREMENT
/begin MEASUREMENT F_wftev_i "Wichtungsfaktor fuer Brennraum Temperaturmodell, TL-VL" UBYTE _CNV_R_R_Def_f_ub_b_553_CM 1 100. 0. 0.996 DISPLAY_IDENTIFIER F_WFTEV_I ECU_ADDRESS 0xc0000e92 ARRAY_SIZE 2 MATRIX_DIM 2 1 1 /end MEASUREMENT
/begin MEASUREMENT Ftbr_kor "Faktor-Brennraumtemperatur, korrigiert" UWORD _CNV_R_R_Def_f_uw_b_590_CM 1 100. 0. 1.9999 DISPLAY_IDENTIFIER FTBR_KOR ECU_ADDRESS 0xc0000e66 FORMAT "%14.5" /end MEASUREMENT
/begin MEASUREMENT Ftev "Faktor Temperaturkorrektur im Brennraum" UWORD _CNV_R_R_Def_f_uw_b_590_CM 1 100. 0. 1.9999 DISPLAY_IDENTIFIER FTEV ECU_ADDRESS 0xc0000e68 FORMAT "%14.5" /end MEASUREMENT
/begin MEASUREMENT Ftev_i "Faktor Temperaturkorrektur im Brennraum" UWORD _CNV_R_R_Def_f_uw_b_590_CM 1 100. 0. 1.9999 DISPLAY_IDENTIFIER FTEV_I ECU_ADDRESS 0xc0000e6a FORMAT "%14.5" ARRAY_SIZE 2 MATRIX_DIM 2 1 1 /end MEASUREMENT
/begin MEASUREMENT Ftev_kor "Faktor-Startkorrektur im Brennraum" UWORD _CNV_R_R_Def_f_uw_b_590_CM 1 100. 0. 1.9999 DISPLAY_IDENTIFIER FTEV_KOR ECU_ADDRESS 0xc0000e8c FORMAT "%14.5" /end MEASUREMENT
/begin MEASUREMENT Ftev_tl_i "Faktor Temperaturkorrektur im Brennraum, TL" UWORD _CNV_R_R_Def_f_uw_b_590_CM 1 100. 0. 1.9999 DISPLAY_IDENTIFIER FTEV_TL_I ECU_ADDRESS 0xc0000e84 FORMAT "%14.5" ARRAY_SIZE 2 MATRIX_DIM 2 1 1 /end MEASUREMENT
/begin MEASUREMENT Ftev_uf_i "Faktor Temperaturkorrektur, ungefiltert" UWORD _CNV_R_R_Def_f_uw_b_590_CM 1 100. 0. 1.9999 DISPLAY_IDENTIFIER FTEV_UF_I ECU_ADDRESS 0xc0000e80 FORMAT "%14.5" ARRAY_SIZE 2 MATRIX_DIM 2 1 1 /end MEASUREMENT
/begin MEASUREMENT Ftev_ukorf_i "Faktor Temperaturkorrektur, unkorrigiert, gefiltert" UWORD _CNV_R_R_Def_f_uw_b_590_CM 1 100. 0. 1.9999 DISPLAY_IDENTIFIER FTEV_UKORF_I ECU_ADDRESS 0xc0000e7c FORMAT "%14.5" ARRAY_SIZE 2 MATRIX_DIM 2 1 1 /end MEASUREMENT
/begin MEASUREMENT Ftev_vl_i "Faktor Temperaturkorrektur im Brennraum, VL" UWORD _CNV_R_R_Def_f_uw_b_590_CM 1 100. 0. 1.9999 DISPLAY_IDENTIFIER FTEV_VL_I ECU_ADDRESS 0xc0000e88 FORMAT "%14.5" ARRAY_SIZE 2 MATRIX_DIM 2 1 1 /end MEASUREMENT
/begin MEASUREMENT Ftsr_i "Faktor Temperaturkorrektur im Saugrohr" UBYTE _CNV_R_R_Def_f_ub_b_613_CM 1 100. 0. 1.9921 DISPLAY_IDENTIFIER FTSR_I ECU_ADDRESS 0xc0000e58 ARRAY_SIZE 2 MATRIX_DIM 2 1 1 /end MEASUREMENT
/begin MEASUREMENT Ftu_i "Faktor Temperatur Umgebung" UBYTE _CNV_R_R_Def_f_ub_b_613_CM 1 100. 0. 1.9921 DISPLAY_IDENTIFIER FTU_I ECU_ADDRESS 0xc0000e5a ARRAY_SIZE 2 MATRIX_DIM 2 1 1 /end MEASUREMENT
/begin MEASUREMENT Gang_mod "" UBYTE _CNV_R_R_Def_dez_sl_551_CM 1 100. 0. 255. DISPLAY_IDENTIFIER GANG_MOD ECU_ADDRESS 0xd000ca0a FORMAT "%3.0" /end MEASUREMENT
/begin MEASUREMENT I_soc0_komp "Zwischengröße Ruhestrom" SWORD _CNV_R_R_Def_i_sw_q_641_CM 1 100. -32.768 32.767 DISPLAY_IDENTIFIER I_SOC0_KOMP ECU_ADDRESS 0xc0000d80 FORMAT "%8.3" /end MEASUREMENT
/begin MEASUREMENT K_QVQ_ANZSTA "Maximale Standzeit des Fahrzeuges" UWORD _CNV_R_R_Def_td_ub__611_CM 1 100. 0. 65535. ECU_ADDRESS 0xc0004770 FORMAT "%5.0" /end MEASUREMENT
/begin MEASUREMENT Mrd_msfakkor_f_i "" UWORD _CNV_R_R_Def_f_uw_b_590_CM 1 100. 0. 1.9999 DISPLAY_IDENTIFIER MRD_MSFAKKOR_F_I ECU_ADDRESS 0xd000d1c8 FORMAT "%14.5" ARRAY_SIZE 2 MATRIX_DIM 2 1 1 /end MEASUREMENT
/begin MEASUREMENT Mrd_msoffkor_f_i "" SWORD _CNV_R_R_Def_ms_uw__594_CM 1 100. -1024. 1023.9687 DISPLAY_IDENTIFIER MRD_MSOFFKOR_F_I ECU_ADDRESS 0xd000d1cc FORMAT "%8.3" ARRAY_SIZE 2 MATRIX_DIM 2 1 1 /end MEASUREMENT
/begin MEASUREMENT Msbkv "Massenstrom Bremskraftverstärker" UWORD _CNV_R_R_Def_ml_uw__653_CM 1 100. 0. 6553.5 DISPLAY_IDENTIFIER MSBKV ECU_ADDRESS 0xc00006ea FORMAT "%6.1" /end MEASUREMENT
/begin MEASUREMENT Msbkv_f "Massenstrom Bremskraftverstärker gefiltert" UWORD _CNV_R_R_Def_ml_uw__653_CM 1 100. 0. 6553.5 DISPLAY_IDENTIFIER MSBKV_F ECU_ADDRESS 0xc00006f6 FORMAT "%6.1" /end MEASUREMENT
/begin MEASUREMENT Msdk "Massenstrom DK" UWORD _CNV_R_R_Def_ms_uw__594_CM 1 100. 0. 2047.9687 DISPLAY_IDENTIFIER MSDK ECU_ADDRESS 0xd000d160 FORMAT "%8.3" /end MEASUREMENT
/begin MEASUREMENT Msdk_i "Massenstrom DK" UWORD _CNV_R_R_Def_ms_uw__594_CM 1 100. 0. 2047.9687 DISPLAY_IDENTIFIER MSDK_I ECU_ADDRESS 0xd000d162 FORMAT "%8.3" ARRAY_SIZE 2 MATRIX_DIM 2 1 1 /end MEASUREMENT
/begin MEASUREMENT Mshfm_f "Gefilterter Massenstrom HFM" UWORD _CNV_R_R_Def_ms_uw__594_CM 1 100. 0. 2047.9687 DISPLAY_IDENTIFIER MSHFM_F ECU_ADDRESS 0xd000d186 FORMAT "%8.3" /end MEASUREMENT
/begin MEASUREMENT Mshfm_f_i "Gefilterter Massenstrom HFM" UWORD _CNV_R_R_Def_ms_uw__594_CM 1 100. 0. 2047.9687 DISPLAY_IDENTIFIER MSHFM_F_I ECU_ADDRESS 0xd000d182 FORMAT "%8.3" ARRAY_SIZE 2 MATRIX_DIM 2 1 1 /end MEASUREMENT
/begin MEASUREMENT Mszyl_f_i "Massenstrom Zylinder verzögert und gefiltert" UWORD _CNV_R_R_Def_ms_uw__594_CM 1 100. 0. 2047.9687 DISPLAY_IDENTIFIER MSZYL_F_I ECU_ADDRESS 0xd000d1ba FORMAT "%8.3" ARRAY_SIZE 2 MATRIX_DIM 2 1 1 /end MEASUREMENT
/begin MEASUREMENT Mszyl_td_i "Massenstrom Zylinder verzögert" UWORD _CNV_R_R_Def_ms_uw__594_CM 1 100. 0. 2047.9687 DISPLAY_IDENTIFIER MSZYL_TD_I ECU_ADDRESS 0xd000d1b6 FORMAT "%8.3" ARRAY_SIZE 2 MATRIX_DIM 2 1 1 /end MEASUREMENT
/begin MEASUREMENT Nkw_zu_v "" UWORD _CNV_R_R_Def_qnv_uw_662_CM 1 100. 0. 511.9921 DISPLAY_IDENTIFIER NKW_ZU_V ECU_ADDRESS 0xd000ca0c FORMAT "%8.3" /end MEASUREMENT
/begin MEASUREMENT Nsllbkv "Leerlaufsolldrehzahl für Bremskraftverstärker" SWORD _CNV_R_R_Def_n_sw_q_595_CM 1 100. -32768. 32767. DISPLAY_IDENTIFIER NSLLBKV ECU_ADDRESS 0xc00006e8 FORMAT "%5.0" /end MEASUREMENT
/begin MEASUREMENT Pr_bl_mn "Kein Langbezeichner vergeben" UBYTE _CNV_R_R_Def_dez_sl_551_CM 1 100. 0. 255. DISPLAY_IDENTIFIER PR_BL_MN ECU_ADDRESS 0xd000d900 FORMAT "%3.0" /end MEASUREMENT
/begin MEASUREMENT Pr_bn_soll "Soll Priorität" UBYTE _CNV_R_R_Def_dez_sl_551_CM 1 100. 0. 255. DISPLAY_IDENTIFIER PR_BN_SOLL ECU_ADDRESS 0xd000d93c FORMAT "%3.0" /end MEASUREMENT
/begin MEASUREMENT Pr_bns_soll "Sollpriorität Bordnetzstabilität" UBYTE _CNV_R_R_Def_dez_sl_551_CM 1 100. 0. 255. DISPLAY_IDENTIFIER PR_BNS_SOLL ECU_ADDRESS 0xd000d901 FORMAT "%3.0" /end MEASUREMENT
/begin MEASUREMENT Pr_crash_soll "Sollpriorität bei Crash" UBYTE _CNV_R_R_Def_dez_sl_551_CM 1 100. 0. 255. DISPLAY_IDENTIFIER PR_CRASH_SOLL ECU_ADDRESS 0xd000d902 FORMAT "%3.0" /end MEASUREMENT
/begin MEASUREMENT Pr_dnmax "Prio neg Gradient" UBYTE _CNV_R_R_Def_dez_sl_551_CM 1 100. 0. 255. DISPLAY_IDENTIFIER PR_DNMAX ECU_ADDRESS 0xd000d93d FORMAT "%3.0" /end MEASUREMENT
/begin MEASUREMENT Pr_dpmax "Prio pos Gradient" UBYTE _CNV_R_R_Def_dez_sl_551_CM 1 100. 0. 255. DISPLAY_IDENTIFIER PR_DPMAX ECU_ADDRESS 0xd000d93e FORMAT "%3.0" /end MEASUREMENT
/begin MEASUREMENT Pr_dsc_mn "Minimalpriorität DSC" UBYTE _CNV_R_R_Def_dez_sl_551_CM 1 100. 0. 255. DISPLAY_IDENTIFIER PR_DSC_MN ECU_ADDRESS 0xd000d903 FORMAT "%3.0" /end MEASUREMENT
/begin MEASUREMENT Pr_dsc_mx "Maximalpriorität DSC" UBYTE _CNV_R_R_Def_dez_sl_551_CM 1 100. 0. 255. DISPLAY_IDENTIFIER PR_DSC_MX ECU_ADDRESS 0xd000d904 FORMAT "%3.0" /end MEASUREMENT
/begin MEASUREMENT Pr_dyn "max Prio aus pos und neg Gradient (dyn Verbraucher)" UBYTE _CNV_R_R_Def_dez_sl_551_CM 1 100. 0. 255. DISPLAY_IDENTIFIER PR_DYN ECU_ADDRESS 0xd000d93f FORMAT "%3.0" /end MEASUREMENT
/begin MEASUREMENT Pr_elue_mn "Kein Langbezeichner vergeben" UBYTE _CNV_R_R_Def_dez_sl_551_CM 1 100. 0. 255. DISPLAY_IDENTIFIER PR_ELUE_MN ECU_ADDRESS 0xd000d905 FORMAT "%3.0" /end MEASUREMENT
/begin MEASUREMENT Pr_eps_mn "Kein Langbezeichner vergeben" UBYTE _CNV_R_R_Def_dez_sl_551_CM 1 100. 0. 255. DISPLAY_IDENTIFIER PR_EPS_MN ECU_ADDRESS 0xd000d906 FORMAT "%3.0" /end MEASUREMENT
/begin MEASUREMENT Pr_ewp_mn "Kein Langbezeichner vergeben" UBYTE _CNV_R_R_Def_dez_sl_551_CM 1 100. 0. 255. DISPLAY_IDENTIFIER PR_EWP_MN ECU_ADDRESS 0xd000d907 FORMAT "%3.0" /end MEASUREMENT
/begin MEASUREMENT Pr_geblaese_dn "Prio Gebläse neg Gradient" UBYTE _CNV_R_R_Def_dez_sl_551_CM 1 100. 0. 255. DISPLAY_IDENTIFIER PR_GEBLAESE_DN ECU_ADDRESS 0xc0000cdb FORMAT "%3.0" /end MEASUREMENT
/begin MEASUREMENT Pr_geblaese_dp "Prio Gebläse pos Gradient" UBYTE _CNV_R_R_Def_dez_sl_551_CM 1 100. 0. 255. DISPLAY_IDENTIFIER PR_GEBLAESE_DP ECU_ADDRESS 0xc0000cdc FORMAT "%3.0" /end MEASUREMENT
/begin MEASUREMENT Pr_geblaese_mn "Minimalpriorität Geblaese" UBYTE _CNV_R_R_Def_dez_sl_551_CM 1 100. 0. 255. DISPLAY_IDENTIFIER PR_GEBLAESE_MN ECU_ADDRESS 0xd000d908 FORMAT "%3.0" /end MEASUREMENT
/begin MEASUREMENT Pr_konf "maximal Priorität aller beteiligter Konfliktanforderungen" UBYTE _CNV_R_R_Def_dez_sl_551_CM 1 100. 0. 255. DISPLAY_IDENTIFIER PR_KONF ECU_ADDRESS 0xd000d940 FORMAT "%3.0" /end MEASUREMENT
/begin MEASUREMENT Pr_krapu_mn "Kein Langbezeichner vergeben" UBYTE _CNV_R_R_Def_dez_sl_551_CM 1 100. 0. 255. DISPLAY_IDENTIFIER PR_KRAPU_MN ECU_ADDRESS 0xd000d909 FORMAT "%3.0" /end MEASUREMENT
/begin MEASUREMENT Pr_licht_dn "Prio Licht neg Gradient" UBYTE _CNV_R_R_Def_dez_sl_551_CM 1 100. 0. 255. DISPLAY_IDENTIFIER PR_LICHT_DN ECU_ADDRESS 0xc0000cdd FORMAT "%3.0" /end MEASUREMENT
/begin MEASUREMENT Pr_licht_dp "Prio Licht pos Gradient" UBYTE _CNV_R_R_Def_dez_sl_551_CM 1 100. 0. 255. DISPLAY_IDENTIFIER PR_LICHT_DP ECU_ADDRESS 0xc0000cde FORMAT "%3.0" /end MEASUREMENT
/begin MEASUREMENT Pr_licht_mn "Minimalpriorität Licht" UBYTE _CNV_R_R_Def_dez_sl_551_CM 1 100. 0. 255. DISPLAY_IDENTIFIER PR_LICHT_MN ECU_ADDRESS 0xd000d90a FORMAT "%3.0" /end MEASUREMENT
/begin MEASUREMENT Pr_max "Prio von U_max" UBYTE _CNV_R_R_Def_dez_sl_551_CM 1 100. 0. 255. DISPLAY_IDENTIFIER PR_MAX ECU_ADDRESS 0xd000d941 FORMAT "%3.0" /end MEASUREMENT
/begin MEASUREMENT Pr_min "Prio von U_min" UBYTE _CNV_R_R_Def_dez_sl_551_CM 1 100. 0. 255. DISPLAY_IDENTIFIER PR_MIN ECU_ADDRESS 0xd000d942 FORMAT "%3.0" /end MEASUREMENT
/begin MEASUREMENT Pr_slp_mn "Minimalpriorität Sekundärluftpumpe" UBYTE _CNV_R_R_Def_dez_sl_551_CM 1 100. 0. 255. DISPLAY_IDENTIFIER PR_SLP_MN ECU_ADDRESS 0xd000d90b FORMAT "%3.0" /end MEASUREMENT
/begin MEASUREMENT Pr_soll "höchste Prio aller Sollspannungsanforderungen" UBYTE _CNV_R_R_Def_dez_sl_551_CM 1 100. 0. 255. DISPLAY_IDENTIFIER PR_SOLL ECU_ADDRESS 0xd000d943 FORMAT "%3.0" /end MEASUREMENT
/begin MEASUREMENT Pr_sollmn "minimale Sollprio" UBYTE _CNV_R_R_Def_dez_sl_551_CM 1 100. 0. 255. DISPLAY_IDENTIFIER PR_SOLLMN ECU_ADDRESS 0xd000d944 FORMAT "%3.0" /end MEASUREMENT
/begin MEASUREMENT Pr_sollmnk "minimale Sollprio bei Konflikt" UBYTE _CNV_R_R_Def_dez_sl_551_CM 1 100. 0. 255. DISPLAY_IDENTIFIER PR_SOLLMNK ECU_ADDRESS 0xd000d945 FORMAT "%3.0" /end MEASUREMENT
/begin MEASUREMENT Pr_spgw "Minimalpriorität" UBYTE _CNV_R_R_Def_dez_sl_551_CM 1 100. 0. 255. DISPLAY_IDENTIFIER PR_SPGW ECU_ADDRESS 0xd000d90c FORMAT "%3.0" /end MEASUREMENT
/begin MEASUREMENT Pr_vbres1_mn "Kein Langbezeichner vergeben" UBYTE _CNV_R_R_Def_dez_sl_551_CM 1 100. 0. 255. DISPLAY_IDENTIFIER PR_VBRES1_MN ECU_ADDRESS 0xc0000cac FORMAT "%3.0" /end MEASUREMENT
/begin MEASUREMENT Pr_vbres1_mx "Kein Langbezeichner vergeben" UBYTE _CNV_R_R_Def_dez_sl_551_CM 1 100. 0. 255. DISPLAY_IDENTIFIER PR_VBRES1_MX ECU_ADDRESS 0xc0000cad FORMAT "%3.0" /end MEASUREMENT
/begin MEASUREMENT Pr_vbres2_mn "Kein Langbezeichner vergeben" UBYTE _CNV_R_R_Def_dez_sl_551_CM 1 100. 0. 255. DISPLAY_IDENTIFIER PR_VBRES2_MN ECU_ADDRESS 0xc0000cae FORMAT "%3.0" /end MEASUREMENT
/begin MEASUREMENT Pr_vbres2_mx "Kein Langbezeichner vergeben" UBYTE _CNV_R_R_Def_dez_sl_551_CM 1 100. 0. 255. DISPLAY_IDENTIFIER PR_VBRES2_MX ECU_ADDRESS 0xc0000caf FORMAT "%3.0" /end MEASUREMENT
/begin MEASUREMENT Pr_vbres3_dn "Prio Reserveverbraucher 3 neg Gradient" UBYTE _CNV_R_R_Def_dez_sl_551_CM 1 100. 0. 255. DISPLAY_IDENTIFIER PR_VBRES3_DN ECU_ADDRESS 0xc0000cdf FORMAT "%3.0" /end MEASUREMENT
/begin MEASUREMENT Pr_vbres3_dp "Prio Reserveverbraucher 3 pos Gradient" UBYTE _CNV_R_R_Def_dez_sl_551_CM 1 100. 0. 255. DISPLAY_IDENTIFIER PR_VBRES3_DP ECU_ADDRESS 0xc0000ce0 FORMAT "%3.0" /end MEASUREMENT
/begin MEASUREMENT Pr_vbres3_mn "Kein Langbezeichner vergeben" UBYTE _CNV_R_R_Def_dez_sl_551_CM 1 100. 0. 255. DISPLAY_IDENTIFIER PR_VBRES3_MN ECU_ADDRESS 0xc0000cb0 FORMAT "%3.0" /end MEASUREMENT
/begin MEASUREMENT Pr_vbres3_mx "Kein Langbezeichner vergeben" UBYTE _CNV_R_R_Def_dez_sl_551_CM 1 100. 0. 255. DISPLAY_IDENTIFIER PR_VBRES3_MX ECU_ADDRESS 0xc0000cb1 FORMAT "%3.0" /end MEASUREMENT
/begin MEASUREMENT Pr_vbres4_dn "Prio Reserveverbraucher 4 neg Gradient" UBYTE _CNV_R_R_Def_dez_sl_551_CM 1 100. 0. 255. DISPLAY_IDENTIFIER PR_VBRES4_DN ECU_ADDRESS 0xc0000ce1 FORMAT "%3.0" /end MEASUREMENT
/begin MEASUREMENT Pr_vbres4_dp "Prio Reserveverbraucher 4 pos Gradient" UBYTE _CNV_R_R_Def_dez_sl_551_CM 1 100. 0. 255. DISPLAY_IDENTIFIER PR_VBRES4_DP ECU_ADDRESS 0xc0000ce2 FORMAT "%3.0" /end MEASUREMENT
/begin MEASUREMENT Pr_vbres4_mn "Kein Langbezeichner vergeben" UBYTE _CNV_R_R_Def_dez_sl_551_CM 1 100. 0. 255. DISPLAY_IDENTIFIER PR_VBRES4_MN ECU_ADDRESS 0xc0000cb2 FORMAT "%3.0" /end MEASUREMENT
/begin MEASUREMENT Pr_vbres4_mx "Kein Langbezeichner vergeben" UBYTE _CNV_R_R_Def_dez_sl_551_CM 1 100. 0. 255. DISPLAY_IDENTIFIER PR_VBRES4_MX ECU_ADDRESS 0xc0000cb3 FORMAT "%3.0" /end MEASUREMENT
/begin MEASUREMENT Pr_vbres5_mn "Kein Langbezeichner vergeben" UBYTE _CNV_R_R_Def_dez_sl_551_CM 1 100. 0. 255. DISPLAY_IDENTIFIER PR_VBRES5_MN ECU_ADDRESS 0xc0000cb4 FORMAT "%3.0" /end MEASUREMENT
/begin MEASUREMENT Pr_vbres5_mx "Kein Langbezeichner vergeben" UBYTE _CNV_R_R_Def_dez_sl_551_CM 1 100. 0. 255. DISPLAY_IDENTIFIER PR_VBRES5_MX ECU_ADDRESS 0xc0000cb5 FORMAT "%3.0" /end MEASUREMENT
/begin MEASUREMENT Pr_vbtherm_mx "Prio Max Thermische Überlastung" UBYTE _CNV_R_R_Def_dez_sl_551_CM 1 100. 0. 255. DISPLAY_IDENTIFIER PR_VBTHERM_MX ECU_ADDRESS 0xc0000ce3 FORMAT "%3.0" /end MEASUREMENT
/begin MEASUREMENT Pr_wischer_mn "Minimalpriorität Scheibenwischer" UBYTE _CNV_R_R_Def_dez_sl_551_CM 1 100. 0. 255. DISPLAY_IDENTIFIER PR_WISCHER_MN ECU_ADDRESS 0xd000d90d FORMAT "%3.0" /end MEASUREMENT
/begin MEASUREMENT Pr_wischer_mx "Maximalpriorität Scheibenwischer" UBYTE _CNV_R_R_Def_dez_sl_551_CM 1 100. 0. 255. DISPLAY_IDENTIFIER PR_WISCHER_MX ECU_ADDRESS 0xd000d90e FORMAT "%3.0" /end MEASUREMENT
/begin MEASUREMENT Pr_ziel "Prioergebnis Main Koor (vor Dynamik Berechnung)" UBYTE _CNV_R_R_Def_dez_sl_551_CM 1 100. 0. 255. DISPLAY_IDENTIFIER PR_ZIEL ECU_ADDRESS 0xd000d946 FORMAT "%3.0" /end MEASUREMENT
/begin MEASUREMENT Psev_i "Absolut Druck benutzt beim EISY_EV" UWORD _CNV_R_R_Def_p_sw_q_576_CM 1 100. 0. 2559.9609 DISPLAY_IDENTIFIER PSEV_I ECU_ADDRESS 0xd000d188 FORMAT "%7.2" ARRAY_SIZE 2 MATRIX_DIM 2 1 1 /end MEASUREMENT
/begin MEASUREMENT Pssol_pn "Druckverhaeltnis Pssol / 1013 hPa" UWORD _CNV_R_R_Def_f_uw_b_571_CM 1 100. 0. 0.9999 DISPLAY_IDENTIFIER PSSOL_PN ECU_ADDRESS 0xd000d1d4 FORMAT "%14.5" /end MEASUREMENT
/begin MEASUREMENT Pvdkds_f_i "Druck vor Drosselklappe v. Drucksensor gefiltert" UWORD _CNV_R_R_Def_p_sw_q_576_CM 1 100. 0. 2559.9609 DISPLAY_IDENTIFIER PVDKDS_F_I ECU_ADDRESS 0xd000d1be FORMAT "%7.2" ARRAY_SIZE 2 MATRIX_DIM 2 1 1 /end MEASUREMENT
/begin MEASUREMENT Pvdkds_stat_i "Druck vor Drosselklappe v. Drucksensor Stationär" UWORD _CNV_R_R_Def_p_sw_q_576_CM 1 100. 0. 2559.9609 DISPLAY_IDENTIFIER PVDKDS_STAT_I ECU_ADDRESS 0xd000d1c4 FORMAT "%7.2" ARRAY_SIZE 2 MATRIX_DIM 2 1 1 /end MEASUREMENT
/begin MEASUREMENT Quali_spg "Spannungsqualität" UWORD _CNV_R_R_Def_dez_sl_551_CM 1 100. 0. 65535. DISPLAY_IDENTIFIER QUALI_SPG ECU_ADDRESS 0xd000d8fe FORMAT "%5.0" /end MEASUREMENT
/begin MEASUREMENT Qv_Ub00_25grd "berechnete Ruhespannung, bezogen auf 25 grdC" SWORD _CNV_R_R_Def_f_sw_b_556_CM 1 100. -32. 31.999 DISPLAY_IDENTIFIER QV_UB00_25GRD ECU_ADDRESS 0xc0000d50 FORMAT "%9.4" /end MEASUREMENT
/begin MEASUREMENT Qv_aktuell "Aktueller Qv-Wert" SWORD _CNV_R_R_Def_f_sw_q_560_CM 1 100. -3276.8 3276.7 DISPLAY_IDENTIFIER QV_AKTUELL ECU_ADDRESS 0xc0000d98 FORMAT "%7.2" /end MEASUREMENT
/begin MEASUREMENT Qv_analyse "Internes Statusflag" SBYTE _CNV_R_R_Def_dez_sl_551_CM 1 100. -128. 127. DISPLAY_IDENTIFIER QV_ANALYSE ECU_ADDRESS 0xc0000daa FORMAT "%3.0" /end MEASUREMENT
/begin MEASUREMENT Qv_bfenster "Anzahl der Qv-Werte im Betrachtungsfenster" UBYTE _CNV_R_R_Def_dez_sl_551_CM 1 100. 0. 255. DISPLAY_IDENTIFIER QV_BFENSTER ECU_ADDRESS 0xc0004783 FORMAT "%3.0" /end MEASUREMENT
/begin MEASUREMENT Qv_cdri "Zwischengrösse" SLONG _CNV_R_R_Def_f_sb_b_647_CM 1 100. -1200. 1200. DISPLAY_IDENTIFIER QV_CDRI ECU_ADDRESS 0xc0000d70 FORMAT "%9.2" /end MEASUREMENT
/begin MEASUREMENT Qv_clr "Kontrollgrenze für Qvc_rm" UWORD _CNV_R_R_Def_f_uw_b_687_CM 1 100. 0. 8191.875 DISPLAY_IDENTIFIER QV_CLR ECU_ADDRESS 0xc0000da0 FORMAT "%7.2" /end MEASUREMENT
/begin MEASUREMENT Qv_codaus "Reduzierung der Qualität abhängig von der Anzahl der Ausreißer" ULONG _CNV_R_R_Def_dez_sl_551_CM 1 100. 0. 4294967295. DISPLAY_IDENTIFIER QV_CODAUS ECU_ADDRESS 0xc000476c FORMAT "%7.0" /end MEASUREMENT
/begin MEASUREMENT Qv_csc "current value of available storage capability" SLONG _CNV_R_R_Def_f_sb_b_647_CM 1 100. -32768. 32767. DISPLAY_IDENTIFIER QV_CSC ECU_ADDRESS 0xc0000d20 FORMAT "%9.2" /end MEASUREMENT
/begin MEASUREMENT Qv_cscn "filtered value of available storage capability" SLONG _CNV_R_R_Def_f_sb_b_647_CM 1 100. -32768. 32767. DISPLAY_IDENTIFIER QV_CSCN ECU_ADDRESS 0xc0000d24 FORMAT "%9.2" /end MEASUREMENT
/begin MEASUREMENT Qv_err "Fehler Ubatt Messung/ Modell" SLONG _CNV_R_R_Def_f_sl_b_688_CM 1 100. -0.9999999995343391 0.9999999995343391 DISPLAY_IDENTIFIER QV_ERR ECU_ADDRESS 0xc0000d28 FORMAT "%9.2" /end MEASUREMENT
/begin MEASUREMENT Qv_ez "error value of last hysteresis calculation" UWORD _CNV_R_R_Def_f_sw_b_616_CM 1 100. 0. 1.9999 DISPLAY_IDENTIFIER QV_EZ ECU_ADDRESS 0xc0000d60 FORMAT "%14.5" /end MEASUREMENT
/begin MEASUREMENT Qv_faktf "Zwischengröße Faktor Temperaturkompensation Ruhestrom" UWORD _CNV_R_R_Def_u_uw_b_689_CM 1 100. 0. 25.4996 DISPLAY_IDENTIFIER QV_FAKTF ECU_ADDRESS 0xc0000d82 FORMAT "%9.4" /end MEASUREMENT
/begin MEASUREMENT Qv_grad "Gradient des Kapazitätsverlustes" SWORD _CNV_R_R_Def_lf_ub__670_CM 1 100. -327.68 327.67 DISPLAY_IDENTIFIER QV_GRAD ECU_ADDRESS 0xc0000d9a FORMAT "%7.2" /end MEASUREMENT
/begin MEASUREMENT Qv_grad_m "Steigung des gemittelten Kapazitätsverlustes" UBYTE _CNV_R_R_Def_f_ub_b_586_CM 1 100. 0. 99.60930000000001 DISPLAY_IDENTIFIER QV_GRAD_M ECU_ADDRESS 0xc0004784 FORMAT "%5.2" /end MEASUREMENT
/begin MEASUREMENT Qv_h "hysteresis" SLONG _CNV_R_R_Def_u_sl_b_690_CM 1 100. -8192. 8191.9999 DISPLAY_IDENTIFIER QV_H ECU_ADDRESS 0xc0000d2c FORMAT "%9.2" /end MEASUREMENT
/begin MEASUREMENT Qv_h2o "Verbrauchtes Wasser pro CBattNenn" UWORD _CNV_R_R_Def_f_uw_b_617_CM 1 100. 0. 63.999 DISPLAY_IDENTIFIER QV_H2O ECU_ADDRESS 0xc0004766 FORMAT "%9.4" /end MEASUREMENT
/begin MEASUREMENT Qv_h2o_sum "Summiert für jeden Berechnungsschritt die Wasserverbrauchsrate, wird bei jedem Motorstart auf 0 zurückgesetzt." ULONG _CNV_R_R_Def_f_ul_q_691_CM 1 100. 0. 2013265.9195 DISPLAY_IDENTIFIER QV_H2O_SUM ECU_ADDRESS 0xc0007b28 FORMAT "%11.4" /end MEASUREMENT
/begin MEASUREMENT Qv_h2oquali "Gütewert der Berechnung Qv_h2o  (0 = sehr gut, 100 = sehr schlecht)" UBYTE _CNV_R_R_Def_f_ub_b_586_CM 1 100. 0. 99.60930000000001 DISPLAY_IDENTIFIER QV_H2OQUALI ECU_ADDRESS 0xc0004768 FORMAT "%5.2" /end MEASUREMENT
/begin MEASUREMENT Qv_h2ostatus "Status für Entwicklung Wasserverlust" UBYTE _CNV_R_R_Def_ql_ub__573_CM 1 100. 0. 255. DISPLAY_IDENTIFIER QV_H2OSTATUS ECU_ADDRESS 0xc0004769 FORMAT "%4.1" /end MEASUREMENT
/begin MEASUREMENT Qv_hyscount "Nummer Auswertearray" UBYTE _CNV_R_R_Def_dez_sl_551_CM 1 100. 0. 255. DISPLAY_IDENTIFIER QV_HYSCOUNT ECU_ADDRESS 0xc0000d6c FORMAT "%3.0" /end MEASUREMENT
/begin MEASUREMENT Qv_ibattn "Batteriestrom normiert" SLONG _CNV_R_R_Def_f_sb_b_647_CM 1 100. -512. 511.9843 DISPLAY_IDENTIFIER QV_IBATTN ECU_ADDRESS 0xc0000d30 FORMAT "%9.2" /end MEASUREMENT
/begin MEASUREMENT Qv_k20 "Nennkapazität" UBYTE _CNV_R_R_Def_ql_ub__573_CM 1 100. 0. 255. DISPLAY_IDENTIFIER QV_K20 ECU_ADDRESS 0xc0007b1a FORMAT "%4.1" /end MEASUREMENT
/begin MEASUREMENT Qv_k20ofs "Delta Kapazität aktuell - neue Batterie" UBYTE _CNV_R_R_Def_ql_ub__573_CM 1 100. 0. 255. DISPLAY_IDENTIFIER QV_K20OFS ECU_ADDRESS 0xc0007b1b FORMAT "%4.1" /end MEASUREMENT
/begin MEASUREMENT Qv_kri "Zwischengrösse" SLONG _CNV_R_R_Def_f_sl_b_692_CM 1 100. -6.25e-002 6.24999999708962e-002 DISPLAY_IDENTIFIER QV_KRI ECU_ADDRESS 0xc0000d34 FORMAT "%9.2" /end MEASUREMENT
/begin MEASUREMENT Qv_ku0l "Zwischengrösse" SLONG _CNV_R_R_Def_f_sl_b_693_CM 1 100. -1. 0.9999999995343391 DISPLAY_IDENTIFIER QV_KU0L ECU_ADDRESS 0xc0000d38 FORMAT "%9.2" /end MEASUREMENT
/begin MEASUREMENT Qv_lcl "Unteres Kontrollimit für Qv_out_m" SWORD _CNV_R_R_Def_f_sw_q_560_CM 1 100. -3276.8 3276.7 DISPLAY_IDENTIFIER QV_LCL ECU_ADDRESS 0xc0000d9c FORMAT "%7.2" /end MEASUREMENT
/begin MEASUREMENT Qv_m_in "Gemittelte Kapazitätsverlust zur internen Verarbeitung" UWORD _CNV_R_R_Def_td_ub__574_CM 1 100. 0. 6553.5 DISPLAY_IDENTIFIER QV_M_IN ECU_ADDRESS 0xc0000da2 FORMAT "%6.1" /end MEASUREMENT
/begin MEASUREMENT Qv_n_fehlmes "Anzahl fehlender Ruhespannungsmessungen" UBYTE _CNV_R_R_Def_f_ub_b_694_CM 1 100. 0. 7.9687 DISPLAY_IDENTIFIER QV_N_FEHLMES ECU_ADDRESS 0xc0000d8e FORMAT "%5.2" /end MEASUREMENT
/begin MEASUREMENT Qv_nv_ezm "mean error value of all hysteresis calculations" SWORD _CNV_R_R_Def_f_sw_b_556_CM 1 100. 0. 1. DISPLAY_IDENTIFIER QV_NV_EZM ECU_ADDRESS 0xc0004760 FORMAT "%9.4" /end MEASUREMENT
/begin MEASUREMENT Qv_nv_start "loss of capacity calculated from engine start" SBYTE _CNV_R_R_Def_ql_sb__695_CM 1 100. -128. 127. DISPLAY_IDENTIFIER QV_NV_START ECU_ADDRESS 0xc0004762 FORMAT "%3.0" /end MEASUREMENT
/begin MEASUREMENT Qv_nv_start_stat "status of Qv start" SBYTE _CNV_R_R_Def_dez_sl_551_CM 1 100. -128. 127. DISPLAY_IDENTIFIER QV_NV_START_STAT ECU_ADDRESS 0xc0004763 FORMAT "%3.0" /end MEASUREMENT
/begin MEASUREMENT Qv_nv_zh "Anzahl der Hystereseauswertungen" ULONG _CNV_R_R_Def_dez_sl_551_CM 1 100. 0. 4294967295. DISPLAY_IDENTIFIER QV_NV_ZH ECU_ADDRESS 0xc000475c FORMAT "%7.0" /end MEASUREMENT
/begin MEASUREMENT Qv_out_1 "Kapazitätsverlust letzter Start" SBYTE _CNV_R_R_Def_ql_sb__695_CM 1 100. -128. 127. DISPLAY_IDENTIFIER QV_OUT_1 ECU_ADDRESS 0xc000477c FORMAT "%3.0" /end MEASUREMENT
/begin MEASUREMENT Qv_out_2 "Kapazitätsverlust 2. letzter Start" SBYTE _CNV_R_R_Def_ql_sb__695_CM 1 100. -128. 127. DISPLAY_IDENTIFIER QV_OUT_2 ECU_ADDRESS 0xc000477d FORMAT "%3.0" /end MEASUREMENT
/begin MEASUREMENT Qv_out_3 "Kapazitätsverlust 3. letzter Start" SBYTE _CNV_R_R_Def_ql_sb__695_CM 1 100. -128. 127. DISPLAY_IDENTIFIER QV_OUT_3 ECU_ADDRESS 0xc000477e FORMAT "%3.0" /end MEASUREMENT
/begin MEASUREMENT Qv_out_4 "Kapazitätsverlust 4. letzter Start" SBYTE _CNV_R_R_Def_ql_sb__695_CM 1 100. -128. 127. DISPLAY_IDENTIFIER QV_OUT_4 ECU_ADDRESS 0xc000477f FORMAT "%3.0" /end MEASUREMENT
/begin MEASUREMENT Qv_out_5 "Kapazitätsverlust 5. letzter Start" SBYTE _CNV_R_R_Def_ql_sb__695_CM 1 100. -128. 127. DISPLAY_IDENTIFIER QV_OUT_5 ECU_ADDRESS 0xc0004780 FORMAT "%3.0" /end MEASUREMENT
/begin MEASUREMENT Qv_out_m "Gültiger gemittelter Kapazitätsverlust (Ausgabe)" UBYTE _CNV_R_R_Def_f_ub_b_586_CM 1 100. 0. 99.60930000000001 DISPLAY_IDENTIFIER QV_OUT_M ECU_ADDRESS 0xc0004785 FORMAT "%5.2" /end MEASUREMENT
/begin MEASUREMENT Qv_outm_int "Berechnete gemittelte Kapazitätsverlust" UWORD _CNV_R_R_Def_td_ub__574_CM 1 100. 0. 6553.5 DISPLAY_IDENTIFIER QV_OUTM_INT ECU_ADDRESS 0xc0000da4 FORMAT "%6.1" /end MEASUREMENT
/begin MEASUREMENT Qv_pri "Zwischengrösse" SWORD _CNV_R_R_Def_f_sl_b_693_CM 1 100. 0. 1.52583234012127e-005 DISPLAY_IDENTIFIER QV_PRI ECU_ADDRESS 0xc0000d52 FORMAT "%7.2" /end MEASUREMENT
/begin MEASUREMENT Qv_pri_1 "Zwischengrösse" SWORD _CNV_R_R_Def_f_sl_b_693_CM 1 100. 0. 1.52583234012127e-005 DISPLAY_IDENTIFIER QV_PRI_1 ECU_ADDRESS 0xc0000d54 FORMAT "%7.2" /end MEASUREMENT
/begin MEASUREMENT Qv_pu0l "Zwischengrösse" SWORD _CNV_R_R_Def_f_sw_b_696_CM 1 100. -1.9e-003 1.95306539535522e-003 DISPLAY_IDENTIFIER QV_PU0L ECU_ADDRESS 0xc0000d56 FORMAT "%7.2" /end MEASUREMENT
/begin MEASUREMENT Qv_pu0l_1 "Zwischengrösse" SWORD _CNV_R_R_Def_f_sw_b_696_CM 1 100. -1.9e-003 1.95306539535522e-003 DISPLAY_IDENTIFIER QV_PU0L_1 ECU_ADDRESS 0xc0000d58 FORMAT "%7.2" /end MEASUREMENT
/begin MEASUREMENT Qv_pu0lri "Zwischengrösse" UWORD _CNV_R_R_Def_f_sw_b_696_CM 1 100. 0. 2.00033187866211e-004 DISPLAY_IDENTIFIER QV_PU0LRI ECU_ADDRESS 0xc0000d62 FORMAT "%7.2" /end MEASUREMENT
/begin MEASUREMENT Qv_pu0lri_1 "Zwischengrösse" UWORD _CNV_R_R_Def_f_sw_b_696_CM 1 100. 0. 2.00033187866211e-004 DISPLAY_IDENTIFIER QV_PU0LRI_1 ECU_ADDRESS 0xc0000d64 FORMAT "%7.2" /end MEASUREMENT
/begin MEASUREMENT Qv_q_stat "Zustandsvariable" UWORD _CNV_R_R_Def_dez_sl_551_CM 1 100. 0. 65535. DISPLAY_IDENTIFIER QV_Q_STAT ECU_ADDRESS 0xc0000da6 FORMAT "%5.0" /end MEASUREMENT
/begin MEASUREMENT Qv_quali_1 "Qualitätsindex letzter Qv-Wert" UBYTE _CNV_R_R_Def_f_ub_b_586_CM 1 100. 0. 99.60930000000001 DISPLAY_IDENTIFIER QV_QUALI_1 ECU_ADDRESS 0xc0004786 FORMAT "%5.2" /end MEASUREMENT
/begin MEASUREMENT Qv_quali_2 "Qualitätsindex 2. letzter Qv-Wert" UBYTE _CNV_R_R_Def_f_ub_b_586_CM 1 100. 0. 99.60930000000001 DISPLAY_IDENTIFIER QV_QUALI_2 ECU_ADDRESS 0xc0004787 FORMAT "%5.2" /end MEASUREMENT
/begin MEASUREMENT Qv_quali_3 "Qualitätsindex 3. letzter Qv-Wert" UBYTE _CNV_R_R_Def_f_ub_b_586_CM 1 100. 0. 99.60930000000001 DISPLAY_IDENTIFIER QV_QUALI_3 ECU_ADDRESS 0xc0004788 FORMAT "%5.2" /end MEASUREMENT
/begin MEASUREMENT Qv_quali_4 "Qualitätsindex 4. letzter Qv-Wert" UBYTE _CNV_R_R_Def_f_ub_b_586_CM 1 100. 0. 99.60930000000001 DISPLAY_IDENTIFIER QV_QUALI_4 ECU_ADDRESS 0xc0004789 FORMAT "%5.2" /end MEASUREMENT
/begin MEASUREMENT Qv_quali_5 "Qualitätsindex 5. letzter Qv-Wert" UBYTE _CNV_R_R_Def_f_ub_b_586_CM 1 100. 0. 99.60930000000001 DISPLAY_IDENTIFIER QV_QUALI_5 ECU_ADDRESS 0xc000478a FORMAT "%5.2" /end MEASUREMENT
/begin MEASUREMENT Qv_quali_int "Qualität des gemittelten Kapazitätsverlustes" UBYTE _CNV_R_R_Def_f_ub_b_586_CM 1 100. 0. 99.60930000000001 DISPLAY_IDENTIFIER QV_QUALI_INT ECU_ADDRESS 0xc0000dab FORMAT "%5.2" /end MEASUREMENT
/begin MEASUREMENT Qv_quali_m "Qualitätsindex für gemittelten Qv-Wert" UBYTE _CNV_R_R_Def_f_ub_b_586_CM 1 100. 0. 99.60930000000001 DISPLAY_IDENTIFIER QV_QUALI_M ECU_ADDRESS 0xc000478b FORMAT "%5.2" /end MEASUREMENT
/begin MEASUREMENT Qv_r "Aktuelle Streuung" UBYTE _CNV_R_R_Def_ql_ub__573_CM 1 100. 0. 255. DISPLAY_IDENTIFIER QV_R ECU_ADDRESS 0xc0000dac FORMAT "%4.1" /end MEASUREMENT
/begin MEASUREMENT Qv_ra "Fit Parameter Batterie" SLONG _CNV_R_R_Def_u_sl_b_697_CM 1 100. -131072. 131071.9999 DISPLAY_IDENTIFIER QV_RA ECU_ADDRESS 0xc0007b1c FORMAT "%9.2" /end MEASUREMENT
/begin MEASUREMENT Qv_rb "Fit Parameter Batterie" SWORD _CNV_R_R_Def_f_sw_b_616_CM 1 100. -2. 1.9999 DISPLAY_IDENTIFIER QV_RB ECU_ADDRESS 0xc0007b24 FORMAT "%14.5" /end MEASUREMENT
/begin MEASUREMENT Qv_rc "Fit Parameter Batterie" SLONG _CNV_R_R_Def_u_sl_b_697_CM 1 100. -131072. 131071.9999 DISPLAY_IDENTIFIER QV_RC ECU_ADDRESS 0xc0007b20 FORMAT "%9.2" /end MEASUREMENT
/begin MEASUREMENT Qv_ri "normalized battery internal resistance" SLONG _CNV_R_R_Def_f_sl_b_688_CM 1 100. 0. 1. DISPLAY_IDENTIFIER QV_RI ECU_ADDRESS 0xc0000d3c FORMAT "%9.2" /end MEASUREMENT
/begin MEASUREMENT Qv_ri0 "QVC CalcHyst - Initialization value for Kalman filter u01" UWORD _CNV_R_R_Def_f_sw_b_616_CM 1 100. 0. 1.e-002 DISPLAY_IDENTIFIER QV_RI0 ECU_ADDRESS 0xc0007b14 FORMAT "%14.5" /end MEASUREMENT
/begin MEASUREMENT Qv_rm "Mittelwert der Streuung" UBYTE _CNV_R_R_Def_dez_sl_551_CM 1 100. 0. 255. DISPLAY_IDENTIFIER QV_RM ECU_ADDRESS 0xc000478c FORMAT "%3.0" /end MEASUREMENT
/begin MEASUREMENT Qv_rm_int "Mittelwert der Streuung" UWORD _CNV_R_R_Def_f_uw_b_555_CM 1 100. 0. 99.9984 DISPLAY_IDENTIFIER QV_RM_INT ECU_ADDRESS 0xc0000da8 FORMAT "%8.3" /end MEASUREMENT
/begin MEASUREMENT Qv_rn "Zwischengrösse" UWORD _CNV_R_R_Def_f_sw_b_616_CM 1 100. 0. 3.9999 DISPLAY_IDENTIFIER QV_RN ECU_ADDRESS 0xc0007b16 FORMAT "%14.5" /end MEASUREMENT
/begin MEASUREMENT Qv_rw_h "weighting of current hysteresis calculation" SWORD _CNV_R_R_Def_f_sw_b_556_CM 1 100. -32. 31.999 DISPLAY_IDENTIFIER QV_RW_H ECU_ADDRESS 0xc0000d5a FORMAT "%9.4" /end MEASUREMENT
/begin MEASUREMENT Qv_sfenster "Anzahl der Ausreißer im Betrachtungsfenster zur Sprungerkennung" UBYTE _CNV_R_R_Def_dez_sl_551_CM 1 100. 0. 255. DISPLAY_IDENTIFIER QV_SFENSTER ECU_ADDRESS 0xc000478d FORMAT "%3.0" /end MEASUREMENT
/begin MEASUREMENT Qv_soc_grob "QVC CalcHyst  - grob berechneter SoC zur Ruhephase" SLONG _CNV_R_R_Def_f_sl_b_698_CM 1 100. 0. 1. DISPLAY_IDENTIFIER QV_SOC_GROB ECU_ADDRESS 0xc0000d40 FORMAT "%9.2" /end MEASUREMENT
/begin MEASUREMENT Qv_stand "Statusflag Lange Standzeit" SBYTE _CNV_R_R_Def_dez_sl_551_CM 1 100. -128. 127. DISPLAY_IDENTIFIER QV_STAND ECU_ADDRESS 0xc0000dad FORMAT "%3.0" /end MEASUREMENT
/begin MEASUREMENT Qv_start_aktuell "loss of capacity calculated from engine start (currently)" UBYTE _CNV_R_R_Def_ql_ub__573_CM 1 100. 0. 255. DISPLAY_IDENTIFIER QV_START_AKTUELL ECU_ADDRESS 0xc0000d6d FORMAT "%4.1" /end MEASUREMENT
/begin MEASUREMENT Qv_stat "Zustandsvariable" UBYTE _CNV_R_R_Def_dez_sl_551_CM 1 100. 0. 255. DISPLAY_IDENTIFIER QV_STAT ECU_ADDRESS 0xc0000d6e FORMAT "%3.0" /end MEASUREMENT
/begin MEASUREMENT Qv_status "Prozessstatus / Trend für gemittelten Qv-Wert" SBYTE _CNV_R_R_Def_dez_sl_551_CM 1 100. -128. 127. DISPLAY_IDENTIFIER QV_STATUS ECU_ADDRESS 0xc0004781 FORMAT "%3.0" /end MEASUREMENT
/begin MEASUREMENT Qv_t_i "Einzelwert I aus Motorstartauswertung" SWORD _CNV_R_R_Def_i_uw_q_630_CM 1 100. -4096. 4095.875 DISPLAY_IDENTIFIER QV_T_I ECU_ADDRESS 0xc0000d5c FORMAT "%8.3" /end MEASUREMENT
/begin MEASUREMENT Qv_t_ruhzeit "Abstellzeit Fahrzeug" UWORD _CNV_R_R_Def_td_ub__611_CM 1 100. 0. 65535. DISPLAY_IDENTIFIER QV_T_RUHZEIT ECU_ADDRESS 0xc0007b18 FORMAT "%5.0" /end MEASUREMENT
/begin MEASUREMENT Qv_t_u "Einzelwert U aus Motorstartauswertung" SWORD _CNV_R_R_Def_f_sw_b_556_CM 1 100. 6. 16. DISPLAY_IDENTIFIER QV_T_U ECU_ADDRESS 0xc0000d5e FORMAT "%9.4" /end MEASUREMENT
/begin MEASUREMENT Qv_td1 "Zeitstempel des letzten gültigen Motorstarts (d.h. desjenigen vor dem aktuellen Motorstarts" UWORD _CNV_R_R_Def_th_uw__699_CM 1 100. 0. 65535. DISPLAY_IDENTIFIER QV_TD1 ECU_ADDRESS 0xc0004772 FORMAT "%5.0" /end MEASUREMENT
/begin MEASUREMENT Qv_td2 "Zeitstempel des zweitetzten gültigen Motorstarts" UWORD _CNV_R_R_Def_th_uw__699_CM 1 100. 0. 65535. DISPLAY_IDENTIFIER QV_TD2 ECU_ADDRESS 0xc0004774 FORMAT "%5.0" /end MEASUREMENT
/begin MEASUREMENT Qv_td3 "Zeitstempel des drittletzten gültigen Motorstarts" UWORD _CNV_R_R_Def_th_uw__699_CM 1 100. 0. 65535. DISPLAY_IDENTIFIER QV_TD3 ECU_ADDRESS 0xc0004776 FORMAT "%5.0" /end MEASUREMENT
/begin MEASUREMENT Qv_td4 "Zeitstempel des viertletzten gültigen Motorstarts" UWORD _CNV_R_R_Def_th_uw__699_CM 1 100. 0. 65535. DISPLAY_IDENTIFIER QV_TD4 ECU_ADDRESS 0xc0004778 FORMAT "%5.0" /end MEASUREMENT
/begin MEASUREMENT Qv_td5 "Zeitstempel des fünftletzten gültigen Motorstarts" UWORD _CNV_R_R_Def_th_uw__699_CM 1 100. 0. 65535. DISPLAY_IDENTIFIER QV_TD5 ECU_ADDRESS 0xc000477a FORMAT "%5.0" /end MEASUREMENT
/begin MEASUREMENT Qv_temp "Zwischengrösse" SLONG _CNV_R_R_Def_f_sw_b_696_CM 1 100. -128. 127.9999 DISPLAY_IDENTIFIER QV_TEMP ECU_ADDRESS 0xc0000d44 FORMAT "%9.2" /end MEASUREMENT
/begin MEASUREMENT Qv_timer "Timer - wird im QVC zur Zeit nicht verwendet" UWORD _CNV_R_R_Def_td_ub__574_CM 1 100. 0. 6553.5 DISPLAY_IDENTIFIER QV_TIMER ECU_ADDRESS 0xc0000d66 FORMAT "%6.1" /end MEASUREMENT
/begin MEASUREMENT Qv_u00 "U00 (Endergebnis aus Berechnung in QVC)" UWORD _CNV_R_R_Def_u_uw_b_689_CM 1 100. 0. 25.4996 DISPLAY_IDENTIFIER QV_U00 ECU_ADDRESS 0xc0000d84 FORMAT "%9.4" /end MEASUREMENT
/begin MEASUREMENT Qv_u0l "normalized lineare extrapolation of measured I,U couple in ascending slope engine start" UWORD _CNV_R_R_Def_f_sw_b_616_CM 1 100. 0. 1.2001 DISPLAY_IDENTIFIER QV_U0L ECU_ADDRESS 0xc0000d68 FORMAT "%14.5" /end MEASUREMENT
/begin MEASUREMENT Qv_u_0l "denormalized value of Qv_u0l" SLONG _CNV_R_R_Def_u_sl_b_690_CM 1 100. 0. 20. DISPLAY_IDENTIFIER QV_U_0L ECU_ADDRESS 0xc0000d48 FORMAT "%9.2" /end MEASUREMENT
/begin MEASUREMENT Qv_u_0u "Zwischengrösse" SLONG _CNV_R_R_Def_u_sl_b_690_CM 1 100. -6. 30. DISPLAY_IDENTIFIER QV_U_0U ECU_ADDRESS 0xc0000d4c FORMAT "%9.2" /end MEASUREMENT
/begin MEASUREMENT Qv_ubatt_ber "Klemmenspannung der Batterie, Implementierung ohne Offset" ULONG _CNV_R_R_Def_u_sl_b_697_CM 1 100. 6. 22.39 DISPLAY_IDENTIFIER QV_UBATT_BER ECU_ADDRESS 0xc0007b2c FORMAT "%14.5" /end MEASUREMENT
/begin MEASUREMENT Qv_ubattn "Batteriespannung normiert" UWORD _CNV_R_R_Def_f_sw_b_616_CM 1 100. 0. 1.9999 DISPLAY_IDENTIFIER QV_UBATTN ECU_ADDRESS 0xc0000d6a FORMAT "%14.5" /end MEASUREMENT
/begin MEASUREMENT Qv_ucl "Oberes Kontrolllimit für Qv_out_m" SWORD _CNV_R_R_Def_f_sw_q_560_CM 1 100. -3276.8 3276.7 DISPLAY_IDENTIFIER QV_UCL ECU_ADDRESS 0xc0000d9e FORMAT "%7.2" /end MEASUREMENT
/begin MEASUREMENT Qvc_status_1 "Ausgang für Schlüsselgröße 1" UBYTE _CNV_R_R_Def_f_ub_b_586_CM 1 100. 0. 99.60930000000001 DISPLAY_IDENTIFIER QVC_STATUS_1 ECU_ADDRESS 0xc000478e FORMAT "%5.2" /end MEASUREMENT
/begin MEASUREMENT Qvc_status_2 "Ausgang für Schlüsselgröße 2" UBYTE _CNV_R_R_Def_f_ub_b_586_CM 1 100. 0. 99.60930000000001 DISPLAY_IDENTIFIER QVC_STATUS_2 ECU_ADDRESS 0xc000478f FORMAT "%5.2" /end MEASUREMENT
/begin MEASUREMENT Qvc_status_3 "Ausgang für Schlüsselgröße 3" UBYTE _CNV_R_R_Def_ql_ub__573_CM 1 100. 0. 255. DISPLAY_IDENTIFIER QVC_STATUS_3 ECU_ADDRESS 0xc0004790 FORMAT "%4.1" /end MEASUREMENT
/begin MEASUREMENT Qvc_status_4 "Ausgang für Schlüsselgröße 4" SBYTE _CNV_R_R_Def_dez_sl_551_CM 1 100. -128. 127. DISPLAY_IDENTIFIER QVC_STATUS_4 ECU_ADDRESS 0xc0004782 FORMAT "%3.0" /end MEASUREMENT
/begin MEASUREMENT Qvh2o_btyp "Batterietyp: AGM = 1, Nass = 2" UBYTE _CNV_R_R_Def_dez_sl_551_CM 1 100. 0. 255. DISPLAY_IDENTIFIER QVH2O_BTYP ECU_ADDRESS 0xc0007b42 FORMAT "%3.0" /end MEASUREMENT
/begin MEASUREMENT Qvh2o_ft "Temperaturabhängige Zusatzrate" SWORD _CNV_R_R_Def_lf_ub__670_CM 1 100. -327.68 327.67 DISPLAY_IDENTIFIER QVH2O_FT ECU_ADDRESS 0xc0007b30 FORMAT "%7.2" /end MEASUREMENT
/begin MEASUREMENT Qvh2o_rate "Wasserverbrauchsrate" UWORD _CNV_R_R_Def_f_uw_q_701_CM 1 100. 0. 30.7195 DISPLAY_IDENTIFIER QVH2O_RATE ECU_ADDRESS 0xc0007b40 FORMAT "%9.4" /end MEASUREMENT
/begin MEASUREMENT Qvh2o_xh2o "Einflussfaktor bisheriger Wasserverbrauch" SWORD _CNV_R_R_Def_lf_ub__670_CM 1 100. -327.68 327.67 DISPLAY_IDENTIFIER QVH2O_XH2O ECU_ADDRESS 0xc0007b32 FORMAT "%7.2" /end MEASUREMENT
/begin MEASUREMENT Qvh2o_xhsum "Summe Verbrauch aus Verbrauchswert und Startwert" SWORD _CNV_R_R_Def_lf_ub__670_CM 1 100. -327.68 327.67 DISPLAY_IDENTIFIER QVH2O_XHSUM ECU_ADDRESS 0xc0007b34 FORMAT "%7.2" /end MEASUREMENT
/begin MEASUREMENT Qvh2o_xi "Einflussfaktor des Ladestroms" SWORD _CNV_R_R_Def_lf_ub__670_CM 1 100. -327.68 327.67 DISPLAY_IDENTIFIER QVH2O_XI ECU_ADDRESS 0xc0007b36 FORMAT "%7.2" /end MEASUREMENT
/begin MEASUREMENT Qvh2o_xi20 "Quotient aus Ladestrom und I20" SWORD _CNV_R_R_Def_lf_ub__670_CM 1 100. 0. 327.67 DISPLAY_IDENTIFIER QVH2O_XI20 ECU_ADDRESS 0xc0007b38 FORMAT "%7.2" /end MEASUREMENT
/begin MEASUREMENT Qvh2o_xsoc "Einflussfaktor des Ladezustands und der Kapazität" SWORD _CNV_R_R_Def_lf_ub__670_CM 1 100. -327.68 327.67 DISPLAY_IDENTIFIER QVH2O_XSOC ECU_ADDRESS 0xc0007b3a FORMAT "%7.2" /end MEASUREMENT
/begin MEASUREMENT Qvh2o_xt "Einflussfaktor der Temperatur" SWORD _CNV_R_R_Def_lf_ub__670_CM 1 100. -327.68 327.67 DISPLAY_IDENTIFIER QVH2O_XT ECU_ADDRESS 0xc0007b3c FORMAT "%7.2" /end MEASUREMENT
/begin MEASUREMENT Qvh2o_xu "Einflussfaktor der Spannung" SWORD _CNV_R_R_Def_lf_ub__670_CM 1 100. -327.68 327.67 DISPLAY_IDENTIFIER QVH2O_XU ECU_ADDRESS 0xc0007b3e FORMAT "%7.2" /end MEASUREMENT
/begin MEASUREMENT R_leitung "Berechneter Widerstand Ladeleitung" UWORD _CNV_R_R_Def_f_uw_b_590_CM 1 100. 0. 1.9999 DISPLAY_IDENTIFIER R_LEITUNG ECU_ADDRESS 0xc0000cc4 FORMAT "%14.5" /end MEASUREMENT
/begin MEASUREMENT R_leitung_f "Berechneter Widerstand Ladeleitung gefiltert" UWORD _CNV_R_R_Def_f_uw_b_590_CM 1 100. 0. 1.9999 DISPLAY_IDENTIFIER R_LEITUNG_F ECU_ADDRESS 0xc0004758 FORMAT "%14.5" /end MEASUREMENT
/begin MEASUREMENT Rf "Relative Luftfuellung" SWORD _CNV_R_R_Def_rf_sw__598_CM 1 100. -327.68 327.67 DISPLAY_IDENTIFIER RF ECU_ADDRESS 0xd000d170 FORMAT "%9.4" /end MEASUREMENT
/begin MEASUREMENT Rf_f_i "Relative Luftfuellung, Gefilterte aus Lambda-Modell" SWORD _CNV_R_R_Def_rf_sw__598_CM 1 100. -327.68 327.67 DISPLAY_IDENTIFIER RF_F_I ECU_ADDRESS 0xd000d1b2 FORMAT "%9.4" ARRAY_SIZE 2 MATRIX_DIM 2 1 1 /end MEASUREMENT
/begin MEASUREMENT Rf_ges_i "Relative Luftfuellung gesamt" SWORD _CNV_R_R_Def_rf_sw__598_CM 1 100. -327.68 327.67 DISPLAY_IDENTIFIER RF_GES_I ECU_ADDRESS 0xd000d17e FORMAT "%9.4" ARRAY_SIZE 2 MATRIX_DIM 2 1 1 /end MEASUREMENT
/begin MEASUREMENT Rf_hfm_f_i "Relative Luftfuellung über HFM gemessen" SWORD _CNV_R_R_Def_rf_sw__598_CM 1 100. -327.68 327.67 DISPLAY_IDENTIFIER RF_HFM_F_I ECU_ADDRESS 0xd000d176 FORMAT "%9.4" ARRAY_SIZE 2 MATRIX_DIM 2 1 1 /end MEASUREMENT
/begin MEASUREMENT Rf_i "Relative Luftfuellung" SWORD _CNV_R_R_Def_rf_sw__598_CM 1 100. -327.68 327.67 DISPLAY_IDENTIFIER RF_I ECU_ADDRESS 0xd000d172 FORMAT "%9.4" ARRAY_SIZE 2 MATRIX_DIM 2 1 1 /end MEASUREMENT
/begin MEASUREMENT Rf_start "Relative Luftfuellung, im Start" SWORD _CNV_R_R_Def_rf_sw__598_CM 1 100. -327.68 327.67 DISPLAY_IDENTIFIER RF_START ECU_ADDRESS 0xd000d17a FORMAT "%9.4" /end MEASUREMENT
/begin MEASUREMENT Rf_td_i "Relative Luftfuellung, Zeitversörgert aus Lambda-Modell" SWORD _CNV_R_R_Def_rf_sw__598_CM 1 100. -327.68 327.67 DISPLAY_IDENTIFIER RF_TD_I ECU_ADDRESS 0xd000d1ae FORMAT "%9.4" ARRAY_SIZE 2 MATRIX_DIM 2 1 1 /end MEASUREMENT
/begin MEASUREMENT Rf_ubeg_i "Rf Unbegrenzt" SWORD _CNV_R_R_Def_rf_sw__598_CM 1 100. -327.68 327.67 DISPLAY_IDENTIFIER RF_UBEG_I ECU_ADDRESS 0xd000d1d0 FORMAT "%9.4" ARRAY_SIZE 2 MATRIX_DIM 2 1 1 /end MEASUREMENT
/begin MEASUREMENT Rfvist_st "Relative Luftfuellung, im Start, Norm-Bedingingen" SWORD _CNV_R_R_Def_rf_sw__598_CM 1 100. -327.68 327.67 DISPLAY_IDENTIFIER RFVIST_ST ECU_ADDRESS 0xd000d17c FORMAT "%9.4" /end MEASUREMENT
/begin MEASUREMENT St_bank_eisy "Statusbyte EISY Bank" UBYTE _CNV_R_R_Def_dez_sl_551_CM 1 100. 0. 255. DISPLAY_IDENTIFIER ST_BANK_EISY ECU_ADDRESS 0xd000d150 FORMAT "%3.0" /end MEASUREMENT
/begin MEASUREMENT St_bank_eisy.B_bankselek_eisy "Bedingung EISY Bankweise berechnen" UBYTE _CNV_S_2_Def_bit_ub_563_CM 1 100. 0. 1. DISPLAY_IDENTIFIER B_BANKSELEK_EISY ECU_ADDRESS 0xd000d150 BIT_MASK 0x2 /end MEASUREMENT
/begin MEASUREMENT St_bgkuppl "Statuswort BGKUPPL" UBYTE _CNV_R_R_Def_dez_sl_551_CM 1 100. 0. 255. DISPLAY_IDENTIFIER ST_BGKUPPL ECU_ADDRESS 0xd000ca08 FORMAT "%3.0" /end MEASUREMENT
/begin MEASUREMENT St_bgkuppl.B_kupp "Bedingung Kupplungsbetätigung über Schalter oder Modell" UBYTE _CNV_S_2_Def_bit_ub_563_CM 1 100. 0. 1. DISPLAY_IDENTIFIER B_KUPP ECU_ADDRESS 0xd000ca08 BIT_MASK 0x1 /end MEASUREMENT
/begin MEASUREMENT St_bgkuppl.B_kupp1 "Bedingung Kupplung getreten 1" UBYTE _CNV_S_2_Def_bit_ub_563_CM 1 100. 0. 1. DISPLAY_IDENTIFIER B_KUPP1 ECU_ADDRESS 0xd000ca08 BIT_MASK 0x4 /end MEASUREMENT
/begin MEASUREMENT St_bgkuppl.B_kupp2 "Bedingung Kupplung getreten 2" UBYTE _CNV_S_2_Def_bit_ub_563_CM 1 100. 0. 1. DISPLAY_IDENTIFIER B_KUPP2 ECU_ADDRESS 0xd000ca08 BIT_MASK 0x8 /end MEASUREMENT
/begin MEASUREMENT St_bgkuppl.B_kupp_ext "Bedingung Kupplungsbetätigung über Schalter von extern" UBYTE _CNV_S_2_Def_bit_ub_563_CM 1 100. 0. 1. DISPLAY_IDENTIFIER B_KUPP_EXT ECU_ADDRESS 0xd000ca08 BIT_MASK 0x2 /end MEASUREMENT
/begin MEASUREMENT St_bgkuppl.B_kupp_mod "Bedingung Kupplungsbetätigung über Modell erkannt" UBYTE _CNV_S_2_Def_bit_ub_563_CM 1 100. 0. 1. DISPLAY_IDENTIFIER B_KUPP_MOD ECU_ADDRESS 0xd000ca08 BIT_MASK 0x10 /end MEASUREMENT
/begin MEASUREMENT St_bgkuppl1 "Statuswort BGKUPPL" UBYTE _CNV_R_R_Def_dez_sl_551_CM 1 100. 0. 255. DISPLAY_IDENTIFIER ST_BGKUPPL1 ECU_ADDRESS 0xd000ca09 FORMAT "%3.0" /end MEASUREMENT
/begin MEASUREMENT St_bgkuppl1.B_ll "Bedingung Leerlauf" UBYTE _CNV_S_2_Def_bit_ub_563_CM 1 100. 0. 1. DISPLAY_IDENTIFIER B_LL ECU_ADDRESS 0xd000ca09 BIT_MASK 0x1 /end MEASUREMENT
/begin MEASUREMENT St_bns "Statuswort" UBYTE _CNV_R_R_Def_dez_sl_551_CM 1 100. 0. 255. DISPLAY_IDENTIFIER ST_BNS ECU_ADDRESS 0xc0004754 FORMAT "%3.0" /end MEASUREMENT
/begin MEASUREMENT St_bns.B_bns "Kein Langbezeichner vergeben" UBYTE _CNV_S_2_Def_bit_ub_563_CM 1 100. 0. 1. DISPLAY_IDENTIFIER B_BNS ECU_ADDRESS 0xc0004754 BIT_MASK 0x1 /end MEASUREMENT
/begin MEASUREMENT St_eisy_hfm "Statusbyte eisy miscellaneous" UBYTE _CNV_R_R_Def_dez_sl_551_CM 1 100. 0. 255. DISPLAY_IDENTIFIER ST_EISY_HFM ECU_ADDRESS 0xd000d153 FORMAT "%3.0" /end MEASUREMENT
/begin MEASUREMENT St_eisy_hfm.B_mrmslam "Bedingung MS-Abgleich soll über Lambda passieren" UBYTE _CNV_S_2_Def_bit_ub_563_CM 1 100. 0. 1. DISPLAY_IDENTIFIER B_MRMSLAM ECU_ADDRESS 0xd000d153 BIT_MASK 0x1 /end MEASUREMENT
/begin MEASUREMENT St_eisy_segment "Statusbyte EISY Segment" UBYTE _CNV_R_R_Def_dez_sl_551_CM 1 100. 0. 255. DISPLAY_IDENTIFIER ST_EISY_SEGMENT ECU_ADDRESS 0xd000d152 FORMAT "%3.0" /end MEASUREMENT
/begin MEASUREMENT St_eisy_segment.B_eisy_dkseg "Bedingung eisy_dk, einmal durchgelaufen im Segmenttask" UBYTE _CNV_S_2_Def_bit_ub_563_CM 1 100. 0. 1. DISPLAY_IDENTIFIER B_EISY_DKSEG ECU_ADDRESS 0xd000d152 BIT_MASK 0x1 /end MEASUREMENT
/begin MEASUREMENT St_eisy_segment.B_eisy_evseg "Bedingung eisy_ev, einmal durchgelaufen im Segmenttask" UBYTE _CNV_S_2_Def_bit_ub_563_CM 1 100. 0. 1. DISPLAY_IDENTIFIER B_EISY_EVSEG ECU_ADDRESS 0xd000d152 BIT_MASK 0x2 /end MEASUREMENT
/begin MEASUREMENT St_pmspgw "Statuswort" UBYTE _CNV_R_R_Def_dez_sl_551_CM 1 100. 0. 255. DISPLAY_IDENTIFIER ST_PMSPGW ECU_ADDRESS 0xd000d8fc FORMAT "%3.0" /end MEASUREMENT
/begin MEASUREMENT St_pmspgw.B_bnqh "Bedingung höchste Prio für BN-Stabilität gesetzt" UBYTE _CNV_S_2_Def_bit_ub_563_CM 1 100. 0. 1. DISPLAY_IDENTIFIER B_BNQH ECU_ADDRESS 0xd000d8fc BIT_MASK 0x20 /end MEASUREMENT
/begin MEASUREMENT St_pmspgw.B_eps_ak "EPS aktiv" UBYTE _CNV_S_2_Def_bit_ub_563_CM 1 100. 0. 1. DISPLAY_IDENTIFIER B_EPS_AK ECU_ADDRESS 0xd000d8fc BIT_MASK 0x40 /end MEASUREMENT
/begin MEASUREMENT St_pmspgw.B_ldaeps_ak "Kein Langbezeichner vergeben" UBYTE _CNV_S_2_Def_bit_ub_563_CM 1 100. 0. 1. DISPLAY_IDENTIFIER B_LDAEPS_AK ECU_ADDRESS 0xd000d8fc BIT_MASK 0x80 /end MEASUREMENT
/begin MEASUREMENT St_pmspgw.B_pmspgwbns "Bedingung Bordnetzstabilität" UBYTE _CNV_S_2_Def_bit_ub_563_CM 1 100. 0. 1. DISPLAY_IDENTIFIER B_PMSPGWBNS ECU_ADDRESS 0xd000d8fc BIT_MASK 0x1 /end MEASUREMENT
/begin MEASUREMENT St_pmspgw.B_ubw_aktiv "Bedingung Spannungswächter aktiv" UBYTE _CNV_S_2_Def_bit_ub_563_CM 1 100. 0. 1. DISPLAY_IDENTIFIER B_UBW_AKTIV ECU_ADDRESS 0xd000d8fc BIT_MASK 0x2 /end MEASUREMENT
/begin MEASUREMENT St_pmspgw.B_ubw_ullow "Bedingung anhaltende Unterspannung" UBYTE _CNV_S_2_Def_bit_ub_563_CM 1 100. 0. 1. DISPLAY_IDENTIFIER B_UBW_ULLOW ECU_ADDRESS 0xd000d8fc BIT_MASK 0x8 /end MEASUREMENT
/begin MEASUREMENT St_pmspgw.B_ubw_ulowak "Bedingung instabiles Bordnetz" UBYTE _CNV_S_2_Def_bit_ub_563_CM 1 100. 0. 1. DISPLAY_IDENTIFIER B_UBW_ULOWAK ECU_ADDRESS 0xd000d8fc BIT_MASK 0x10 /end MEASUREMENT
/begin MEASUREMENT St_pmspgw.B_ubw_uslow "Bedingung anhaltende Unterspannung" UBYTE _CNV_S_2_Def_bit_ub_563_CM 1 100. 0. 1. DISPLAY_IDENTIFIER B_UBW_USLOW ECU_ADDRESS 0xd000d8fc BIT_MASK 0x4 /end MEASUREMENT
/begin MEASUREMENT St_pmspgw1 "Statuswort" UBYTE _CNV_R_R_Def_dez_sl_551_CM 1 100. 0. 255. DISPLAY_IDENTIFIER ST_PMSPGW1 ECU_ADDRESS 0xd000d8fd FORMAT "%3.0" /end MEASUREMENT
/begin MEASUREMENT St_pmspgw1.B_afs_da "Kein Langbezeichner vergeben" UBYTE _CNV_S_2_Def_bit_ub_563_CM 1 100. 0. 1. DISPLAY_IDENTIFIER B_AFS_DA ECU_ADDRESS 0xd000d8fd BIT_MASK 0x1 /end MEASUREMENT
/begin MEASUREMENT St_pmubnkor "Statuswort" UBYTE _CNV_R_R_Def_dez_sl_551_CM 1 100. 0. 255. DISPLAY_IDENTIFIER ST_PMUBNKOR ECU_ADDRESS 0xd000d938 FORMAT "%3.0" /end MEASUREMENT
/begin MEASUREMENT St_pmubnkor.B_konflikt_max "Konflikt vorhanden (bei Suche nach U_max ist mindestens eine Maxspannung kleiner als Minspannung) zugehörige Prio der Maxspg ist ebenfalls kleiner als Prio der Minspg" UBYTE _CNV_S_2_Def_bit_ub_563_CM 1 100. 0. 1. DISPLAY_IDENTIFIER B_KONFLIKT_MAX ECU_ADDRESS 0xd000d938 BIT_MASK 0x2 /end MEASUREMENT
/begin MEASUREMENT St_pmubnkor.B_konflikt_min "Konflikt vorhanden (bei Suche nach U_min ist mindestens eine Minspg größer als eine Maxspannung) zugehörige Prio der Minspg ist kleiner als Prio der Maxspg" UBYTE _CNV_S_2_Def_bit_ub_563_CM 1 100. 0. 1. DISPLAY_IDENTIFIER B_KONFLIKT_MIN ECU_ADDRESS 0xd000d938 BIT_MASK 0x1 /end MEASUREMENT
/begin MEASUREMENT St_pmukomp "Statuswort" UBYTE _CNV_R_R_Def_dez_sl_551_CM 1 100. 0. 255. DISPLAY_IDENTIFIER ST_PMUKOMP ECU_ADDRESS 0xc0000cc0 FORMAT "%3.0" /end MEASUREMENT
/begin MEASUREMENT St_pmukomp.B_genoffdiag "Generatordiagnose aus" UBYTE _CNV_S_2_Def_bit_ub_563_CM 1 100. 0. 1. DISPLAY_IDENTIFIER B_GENOFFDIAG ECU_ADDRESS 0xc0000cc0 BIT_MASK 0x4 /end MEASUREMENT
/begin MEASUREMENT St_pmukomp.B_rl_berok "Bedingung Berechnung Leitungswiderstand" UBYTE _CNV_S_2_Def_bit_ub_563_CM 1 100. 0. 1. DISPLAY_IDENTIFIER B_RL_BEROK ECU_ADDRESS 0xc0000cc0 BIT_MASK 0x8 /end MEASUREMENT
/begin MEASUREMENT St_pmukomp.B_udgenentpr "Stabilität U_gen entprellt" UBYTE _CNV_S_2_Def_bit_ub_563_CM 1 100. 0. 1. DISPLAY_IDENTIFIER B_UDGENENTPR ECU_ADDRESS 0xc0000cc0 BIT_MASK 0x10 /end MEASUREMENT
/begin MEASUREMENT St_pmukomp2 "Statuswort" UBYTE _CNV_R_R_Def_dez_sl_551_CM 1 100. 0. 255. DISPLAY_IDENTIFIER ST_PMUKOMP2 ECU_ADDRESS 0xc0000cc1 FORMAT "%3.0" /end MEASUREMENT
/begin MEASUREMENT St_pmukomp2.B_rltg_npl "Bedingung Leitungswiderstand nicht plausibel" UBYTE _CNV_S_2_Def_bit_ub_563_CM 1 100. 0. 1. DISPLAY_IDENTIFIER B_RLTG_NPL ECU_ADDRESS 0xc0000cc1 BIT_MASK 0x1 /end MEASUREMENT
/begin MEASUREMENT St_pmvbmng0 "Statuswort" UBYTE _CNV_R_R_Def_dez_sl_551_CM 1 100. 0. 255. DISPLAY_IDENTIFIER ST_PMVBMNG0 ECU_ADDRESS 0xc0000cd8 FORMAT "%3.0" /end MEASUREMENT
/begin MEASUREMENT St_pmvbmng0.B_geblakt "Bebläse aktiv" UBYTE _CNV_S_2_Def_bit_ub_563_CM 1 100. 0. 1. DISPLAY_IDENTIFIER B_GEBLAKT ECU_ADDRESS 0xc0000cd8 BIT_MASK 0x1 /end MEASUREMENT
/begin MEASUREMENT St_pmvbmng0.B_ilichtakt "Innenlicht aktiv" UBYTE _CNV_S_2_Def_bit_ub_563_CM 1 100. 0. 1. DISPLAY_IDENTIFIER B_ILICHTAKT ECU_ADDRESS 0xc0000cd8 BIT_MASK 0x2 /end MEASUREMENT
/begin MEASUREMENT St_pmvbmng0.B_lichtakt "Licht aktiv" UBYTE _CNV_S_2_Def_bit_ub_563_CM 1 100. 0. 1. DISPLAY_IDENTIFIER B_LICHTAKT ECU_ADDRESS 0xc0000cd8 BIT_MASK 0x4 /end MEASUREMENT
/begin MEASUREMENT St_pmvbmng0.B_slpakt "sekundär Luftpumpe aktiv" UBYTE _CNV_S_2_Def_bit_ub_563_CM 1 100. 0. 1. DISPLAY_IDENTIFIER B_SLPAKT ECU_ADDRESS 0xc0000cd8 BIT_MASK 0x10 /end MEASUREMENT
/begin MEASUREMENT St_pmvbmng0.B_wischerakt "Wischer aktiv" UBYTE _CNV_S_2_Def_bit_ub_563_CM 1 100. 0. 1. DISPLAY_IDENTIFIER B_WISCHERAKT ECU_ADDRESS 0xc0000cd8 BIT_MASK 0x20 /end MEASUREMENT
/begin MEASUREMENT St_pmvbmng1 "Statuswort" UBYTE _CNV_R_R_Def_dez_sl_551_CM 1 100. 0. 255. DISPLAY_IDENTIFIER ST_PMVBMNG1 ECU_ADDRESS 0xc0000cd9 FORMAT "%3.0" /end MEASUREMENT
/begin MEASUREMENT St_pmvbmng1.B_licht "Licht aktiv" UBYTE _CNV_S_2_Def_bit_ub_563_CM 1 100. 0. 1. DISPLAY_IDENTIFIER B_LICHT ECU_ADDRESS 0xc0000cd9 BIT_MASK 0x8 /end MEASUREMENT
/begin MEASUREMENT St_pmvbmng1.B_vb_timer "Thermische Überlast (bei false)" UBYTE _CNV_S_2_Def_bit_ub_563_CM 1 100. 0. 1. DISPLAY_IDENTIFIER B_VB_TIMER ECU_ADDRESS 0xc0000cd9 BIT_MASK 0x4 /end MEASUREMENT
/begin MEASUREMENT St_pmvbmng1.B_vbpau "Abweichung Batteriespannung und Batteriesollspannung" UBYTE _CNV_S_2_Def_bit_ub_563_CM 1 100. 0. 1. DISPLAY_IDENTIFIER B_VBPAU ECU_ADDRESS 0xc0000cd9 BIT_MASK 0x1 /end MEASUREMENT
/begin MEASUREMENT St_pmvbmng1.B_vbtherm_fr "Thermische Überlastung (bei false)" UBYTE _CNV_S_2_Def_bit_ub_563_CM 1 100. 0. 1. DISPLAY_IDENTIFIER B_VBTHERM_FR ECU_ADDRESS 0xc0000cd9 BIT_MASK 0x2 /end MEASUREMENT
/begin MEASUREMENT St_pmvbmng2 "Statuswort" UBYTE _CNV_R_R_Def_dez_sl_551_CM 1 100. 0. 255. DISPLAY_IDENTIFIER ST_PMVBMNG2 ECU_ADDRESS 0xc0000cda FORMAT "%3.0" /end MEASUREMENT
/begin MEASUREMENT St_pmvbmng2.B_vbres1_ak "Reserveverbraucher 1 aktiv" UBYTE _CNV_S_2_Def_bit_ub_563_CM 1 100. 0. 1. DISPLAY_IDENTIFIER B_VBRES1_AK ECU_ADDRESS 0xc0000cda BIT_MASK 0x1 /end MEASUREMENT
/begin MEASUREMENT St_pmvbmng2.B_vbres2_ak "Reserveverbraucher 2 aktiv" UBYTE _CNV_S_2_Def_bit_ub_563_CM 1 100. 0. 1. DISPLAY_IDENTIFIER B_VBRES2_AK ECU_ADDRESS 0xc0000cda BIT_MASK 0x2 /end MEASUREMENT
/begin MEASUREMENT St_pmvbmng2.B_vbres3_ak "Reserveverbraucher 3 aktiv" UBYTE _CNV_S_2_Def_bit_ub_563_CM 1 100. 0. 1. DISPLAY_IDENTIFIER B_VBRES3_AK ECU_ADDRESS 0xc0000cda BIT_MASK 0x4 /end MEASUREMENT
/begin MEASUREMENT St_pmvbmng2.B_vbres4_ak "Reserveverbraucher 4 aktiv" UBYTE _CNV_S_2_Def_bit_ub_563_CM 1 100. 0. 1. DISPLAY_IDENTIFIER B_VBRES4_AK ECU_ADDRESS 0xc0000cda BIT_MASK 0x8 /end MEASUREMENT
/begin MEASUREMENT St_pmvbmng2.B_vbres5_ak "Reserveverbraucher 5 aktiv" UBYTE _CNV_S_2_Def_bit_ub_563_CM 1 100. 0. 1. DISPLAY_IDENTIFIER B_VBRES5_AK ECU_ADDRESS 0xc0000cda BIT_MASK 0x10 /end MEASUREMENT
/begin MEASUREMENT St_pvdkds "Statusbyte" UBYTE _CNV_R_R_Def_dez_sl_551_CM 1 100. 0. 255. DISPLAY_IDENTIFIER ST_PVDKDS ECU_ADDRESS 0xd000d1c3 FORMAT "%3.0" /end MEASUREMENT
/begin MEASUREMENT St_pvdkds.B_pvdkds_stat "Pvdkds im Stationärbereich" UBYTE _CNV_S_2_Def_bit_ub_563_CM 1 100. 0. 1. DISPLAY_IDENTIFIER B_PVDKDS_STAT ECU_ADDRESS 0xd000d1c3 BIT_MASK 0x1 /end MEASUREMENT
/begin MEASUREMENT St_qvc1 "Statuswort" UBYTE _CNV_R_R_Def_dez_sl_551_CM 1 100. 0. 255. DISPLAY_IDENTIFIER ST_QVC1 ECU_ADDRESS 0xc0004764 FORMAT "%3.0" /end MEASUREMENT
/begin MEASUREMENT St_qvc1.B_qvch2o "Ausgangsgröße, die folgendes aussagt: Der Wasserverbrauch ist kritisch, Massnahmen im PM einleiten." UBYTE _CNV_S_2_Def_bit_ub_563_CM 1 100. 0. 1. DISPLAY_IDENTIFIER B_QVCH2O ECU_ADDRESS 0xc0004764 BIT_MASK 0x2 /end MEASUREMENT
/begin MEASUREMENT St_stend_verz "Statusbyte" UBYTE _CNV_R_R_Def_dez_sl_551_CM 1 100. 0. 255. DISPLAY_IDENTIFIER ST_STEND_VERZ ECU_ADDRESS 0xd000d1c2 FORMAT "%3.0" /end MEASUREMENT
/begin MEASUREMENT St_stend_verz.B_startende_rfvst "B_startende verzörgert" UBYTE _CNV_S_2_Def_bit_ub_563_CM 1 100. 0. 1. DISPLAY_IDENTIFIER B_STARTENDE_RFVST ECU_ADDRESS 0xd000d1c2 BIT_MASK 0x1 /end MEASUREMENT
/begin MEASUREMENT St_tdnvvaus "" UBYTE _CNV_R_R_Def_dez_sl_551_CM 1 100. 0. 255. DISPLAY_IDENTIFIER ST_TDNVVAUS ECU_ADDRESS 0xd000ca0f FORMAT "%3.0" /end MEASUREMENT
/begin MEASUREMENT St_tdnvvein "" UBYTE _CNV_R_R_Def_dez_sl_551_CM 1 100. 0. 255. DISPLAY_IDENTIFIER ST_TDNVVEIN ECU_ADDRESS 0xd000ca0e FORMAT "%3.0" /end MEASUREMENT
/begin MEASUREMENT Tevt_mdl "Temperatur am Einlassventil modelliert" SWORD _CNV_R_R_Def_t_sw_q_578_CM 1 100. -3276.8 3276.7 DISPLAY_IDENTIFIER TEVT_MDL ECU_ADDRESS 0xc0000e60 FORMAT "%6.1" /end MEASUREMENT
/begin MEASUREMENT Tevt_mdl_i "Temperatur am Einlassventil modelliert" SWORD _CNV_R_R_Def_t_sw_q_578_CM 1 100. -3276.8 3276.7 DISPLAY_IDENTIFIER TEVT_MDL_I ECU_ADDRESS 0xc0000e62 FORMAT "%6.1" ARRAY_SIZE 2 MATRIX_DIM 2 1 1 /end MEASUREMENT
/begin MEASUREMENT Tmot_fil_tempk "Motortemperatur gefiltert" SWORD _CNV_R_R_Def_t_sw_q_578_CM 1 100. -3276.8 3276.7 DISPLAY_IDENTIFIER TMOT_FIL_TEMPK ECU_ADDRESS 0xc00049d0 FORMAT "%6.1" /end MEASUREMENT
/begin MEASUREMENT Tmot_tempk_i "" SWORD _CNV_R_R_Def_t_sw_q_578_CM 1 100. -3276.8 3276.7 DISPLAY_IDENTIFIER TMOT_TEMPK_I ECU_ADDRESS 0xc0000ea8 FORMAT "%6.1" ARRAY_SIZE 2 MATRIX_DIM 2 1 1 /end MEASUREMENT
/begin MEASUREMENT Tsr_ges_i "Gesamttemperatur im Saugrohr (nach AGR-Einleitung)" SWORD _CNV_R_R_Def_t_sw_q_578_CM 1 100. -3276.8 3276.7 DISPLAY_IDENTIFIER TSR_GES_I ECU_ADDRESS 0xc0000e8e FORMAT "%6.1" ARRAY_SIZE 2 MATRIX_DIM 2 1 1 /end MEASUREMENT
/begin MEASUREMENT Tzyl_akt_i "" SWORD _CNV_R_R_Def_t_sw_q_578_CM 1 100. -3276.8 3276.7 DISPLAY_IDENTIFIER TZYL_AKT_I ECU_ADDRESS 0xc0000e9c FORMAT "%6.1" ARRAY_SIZE 2 MATRIX_DIM 2 1 1 /end MEASUREMENT
/begin MEASUREMENT Tzyl_akt_tans_i "" SWORD _CNV_R_R_Def_t_sw_q_578_CM 1 100. -3276.8 3276.7 DISPLAY_IDENTIFIER TZYL_AKT_TANS_I ECU_ADDRESS 0xc0000ea4 FORMAT "%6.1" ARRAY_SIZE 2 MATRIX_DIM 2 1 1 /end MEASUREMENT
/begin MEASUREMENT Tzyl_akt_tmot_i "" SWORD _CNV_R_R_Def_t_sw_q_578_CM 1 100. -3276.8 3276.7 DISPLAY_IDENTIFIER TZYL_AKT_TMOT_I ECU_ADDRESS 0xc0000ea0 FORMAT "%6.1" ARRAY_SIZE 2 MATRIX_DIM 2 1 1 /end MEASUREMENT
/begin MEASUREMENT U00_quali "Qualitätsindex U00" UBYTE _CNV_R_R_Def_f_ub_b_586_CM 1 100. 0. 99.60930000000001 DISPLAY_IDENTIFIER U00_QUALI ECU_ADDRESS 0xc0000d8f FORMAT "%5.2" /end MEASUREMENT
/begin MEASUREMENT U00_quali_1 "Qualitätsindex U00 Ruhestromeinfluss" UBYTE _CNV_R_R_Def_f_ub_b_586_CM 1 100. 0. 99.60930000000001 DISPLAY_IDENTIFIER U00_QUALI_1 ECU_ADDRESS 0xc0000d90 FORMAT "%5.2" /end MEASUREMENT
/begin MEASUREMENT U00_quali_2 "Qualitätsindex U00 Temperatureinfluss" UBYTE _CNV_R_R_Def_f_ub_b_586_CM 1 100. 0. 99.60930000000001 DISPLAY_IDENTIFIER U00_QUALI_2 ECU_ADDRESS 0xc0000d91 FORMAT "%5.2" /end MEASUREMENT
/begin MEASUREMENT U00_quali_3 "Qualitätsindex U00 Einfluss U00-Grössenordnung" UBYTE _CNV_R_R_Def_f_ub_b_586_CM 1 100. 0. 99.60930000000001 DISPLAY_IDENTIFIER U00_QUALI_3 ECU_ADDRESS 0xc0000d92 FORMAT "%5.2" /end MEASUREMENT
/begin MEASUREMENT U00_quali_4 "Qualitätsindex U00 Einfluss Spannungsgradient" UBYTE _CNV_R_R_Def_f_ub_b_586_CM 1 100. 0. 99.60930000000001 DISPLAY_IDENTIFIER U00_QUALI_4 ECU_ADDRESS 0xc0000d93 FORMAT "%5.2" /end MEASUREMENT
/begin MEASUREMENT U00_quali_5 "Qualitätsindex U00 Einfluss fehlende Messungen" UBYTE _CNV_R_R_Def_f_ub_b_586_CM 1 100. 0. 99.60930000000001 DISPLAY_IDENTIFIER U00_QUALI_5 ECU_ADDRESS 0xc0000d94 FORMAT "%5.2" /end MEASUREMENT
/begin MEASUREMENT U00_quali_6 "Qualitätsindex U00 Einfluss Ruhezeit" UBYTE _CNV_R_R_Def_f_ub_b_586_CM 1 100. 0. 99.60930000000001 DISPLAY_IDENTIFIER U00_QUALI_6 ECU_ADDRESS 0xc0000d95 FORMAT "%5.2" /end MEASUREMENT
/begin MEASUREMENT U0_batt "Im QVC berechnete Ruhespannung Batterie ohne I- und T- Kompensation" UWORD _CNV_R_R_Def_u_uw_b_689_CM 1 100. 0. 25.4996 DISPLAY_IDENTIFIER U0_BATT ECU_ADDRESS 0xc0000d86 FORMAT "%9.4" /end MEASUREMENT
/begin MEASUREMENT U_bl_min "Minspannung" UBYTE _CNV_R_R_Def_u_ub_q_631_CM 1 100. 0. 25.5 DISPLAY_IDENTIFIER U_BL_MIN ECU_ADDRESS 0xc0000ce4 FORMAT "%5.2" /end MEASUREMENT
/begin MEASUREMENT U_bl_mn "Kein Langbezeichner vergeben" UBYTE _CNV_R_R_Def_u_ub_q_631_CM 1 100. 0. 25.5 DISPLAY_IDENTIFIER U_BL_MN ECU_ADDRESS 0xd000d90f FORMAT "%5.2" /end MEASUREMENT
/begin MEASUREMENT U_bn_soll "Soll Bordnetzspg" UBYTE _CNV_R_R_Def_u_ub_q_631_CM 1 100. 0. 25.5 DISPLAY_IDENTIFIER U_BN_SOLL ECU_ADDRESS 0xd000d947 FORMAT "%5.2" /end MEASUREMENT
/begin MEASUREMENT U_bns_soll "Sollspannung Bordnetzstabilität" UBYTE _CNV_R_R_Def_u_ub_q_631_CM 1 100. 0. 25.5 DISPLAY_IDENTIFIER U_BNS_SOLL ECU_ADDRESS 0xd000d910 FORMAT "%5.2" /end MEASUREMENT
/begin MEASUREMENT U_crash_soll "Sollspannung bei Crash" UBYTE _CNV_R_R_Def_u_ub_q_631_CM 1 100. 0. 25.5 DISPLAY_IDENTIFIER U_CRASH_SOLL ECU_ADDRESS 0xd000d911 FORMAT "%5.2" /end MEASUREMENT
/begin MEASUREMENT U_dgen "Delta U_gen neu zu U_gen alt" UBYTE _CNV_R_R_Def_u_ub_q_631_CM 1 100. 0. 25.5 DISPLAY_IDENTIFIER U_DGEN ECU_ADDRESS 0xc0000cc8 FORMAT "%5.2" /end MEASUREMENT
/begin MEASUREMENT U_diff_12 "Differenz Spannungen (Zwischenergebnis)" SLONG _CNV_R_R_Def_u_sl_b_720_CM 1 100. -12. 12. DISPLAY_IDENTIFIER U_DIFF_12 ECU_ADDRESS 0xc0000d74 FORMAT "%9.2" /end MEASUREMENT
/begin MEASUREMENT U_diff_23 "Differenz Spannungen (Zwischenergebnis)" SLONG _CNV_R_R_Def_u_sl_b_720_CM 1 100. -12. 12. DISPLAY_IDENTIFIER U_DIFF_23 ECU_ADDRESS 0xc0000d78 FORMAT "%9.2" /end MEASUREMENT
/begin MEASUREMENT U_diff_32 "Differenz Spannungen (Zwischenergebnis)" SLONG _CNV_R_R_Def_u_sl_b_720_CM 1 100. -12. 12. DISPLAY_IDENTIFIER U_DIFF_32 ECU_ADDRESS 0xc0000d7c FORMAT "%9.2" /end MEASUREMENT
/begin MEASUREMENT U_dnmax "Spg neg Gradient" UBYTE _CNV_R_R_Def_u_ub_b_721_CM 1 100. 0. 0.498 DISPLAY_IDENTIFIER U_DNMAX ECU_ADDRESS 0xd000d948 FORMAT "%7.4" /end MEASUREMENT
/begin MEASUREMENT U_dpmax "Spg pos Gradient" UBYTE _CNV_R_R_Def_u_ub_b_721_CM 1 100. 0. 0.498 DISPLAY_IDENTIFIER U_DPMAX ECU_ADDRESS 0xd000d949 FORMAT "%7.4" /end MEASUREMENT
/begin MEASUREMENT U_dsc_max "DSC Maxspannung" UBYTE _CNV_R_R_Def_u_ub_q_631_CM 1 100. 0. 25.5 DISPLAY_IDENTIFIER U_DSC_MAX ECU_ADDRESS 0xc0000ce5 FORMAT "%5.2" /end MEASUREMENT
/begin MEASUREMENT U_dsc_min "DSC Minspannung" UBYTE _CNV_R_R_Def_u_ub_q_631_CM 1 100. 0. 25.5 DISPLAY_IDENTIFIER U_DSC_MIN ECU_ADDRESS 0xc0000ce6 FORMAT "%5.2" /end MEASUREMENT
/begin MEASUREMENT U_dsc_mn "Minimalspannung DSC" UBYTE _CNV_R_R_Def_u_ub_q_631_CM 1 100. 0. 25.5 DISPLAY_IDENTIFIER U_DSC_MN ECU_ADDRESS 0xd000d912 FORMAT "%5.2" /end MEASUREMENT
/begin MEASUREMENT U_dsc_mx "Maximalspannung DSC" UBYTE _CNV_R_R_Def_u_ub_q_631_CM 1 100. 0. 25.5 DISPLAY_IDENTIFIER U_DSC_MX ECU_ADDRESS 0xd000d913 FORMAT "%5.2" /end MEASUREMENT
/begin MEASUREMENT U_dyn_komp "über berechneten Widerstand ermittelter Spannungsabfall" UBYTE _CNV_R_R_Def_u_ub_q_631_CM 1 100. 0. 25.5 DISPLAY_IDENTIFIER U_DYN_KOMP ECU_ADDRESS 0xc0000cc9 FORMAT "%5.2" /end MEASUREMENT
/begin MEASUREMENT U_dynmax "max Spannung dyn Verbraucher" UBYTE _CNV_R_R_Def_u_ub_q_631_CM 1 100. 0. 25.5 DISPLAY_IDENTIFIER U_DYNMAX ECU_ADDRESS 0xd000d94a FORMAT "%5.2" /end MEASUREMENT
/begin MEASUREMENT U_dynmin "min Spg dyn Verbraucher" UBYTE _CNV_R_R_Def_u_ub_q_631_CM 1 100. 0. 25.5 DISPLAY_IDENTIFIER U_DYNMIN ECU_ADDRESS 0xd000d94b FORMAT "%5.2" /end MEASUREMENT
/begin MEASUREMENT U_e65komp "Generatorspannungsvorgabe für E65 kompensiert" UBYTE _CNV_R_R_Def_u_ub_q_631_CM 1 100. 0. 25.5 DISPLAY_IDENTIFIER U_E65KOMP ECU_ADDRESS 0xc0000cca FORMAT "%5.2" /end MEASUREMENT
/begin MEASUREMENT U_elue_min "Elektrischer Lüfter Minspannung" UBYTE _CNV_R_R_Def_u_ub_q_631_CM 1 100. 0. 25.5 DISPLAY_IDENTIFIER U_ELUE_MIN ECU_ADDRESS 0xc0000ce7 FORMAT "%5.2" /end MEASUREMENT
/begin MEASUREMENT U_elue_mn "Kein Langbezeichner vergeben" UBYTE _CNV_R_R_Def_u_ub_q_631_CM 1 100. 0. 25.5 DISPLAY_IDENTIFIER U_ELUE_MN ECU_ADDRESS 0xd000d914 FORMAT "%5.2" /end MEASUREMENT
/begin MEASUREMENT U_eps_min "Elektrische Lenkhilfe Minspannung" UBYTE _CNV_R_R_Def_u_ub_q_631_CM 1 100. 0. 25.5 DISPLAY_IDENTIFIER U_EPS_MIN ECU_ADDRESS 0xc0000ce8 FORMAT "%5.2" /end MEASUREMENT
/begin MEASUREMENT U_eps_mn "Kein Langbezeichner vergeben" UBYTE _CNV_R_R_Def_u_ub_q_631_CM 1 100. 0. 25.5 DISPLAY_IDENTIFIER U_EPS_MN ECU_ADDRESS 0xd000d915 FORMAT "%5.2" /end MEASUREMENT
/begin MEASUREMENT U_ewp_min "Elektrische Wasserpumpe Minspannung" UBYTE _CNV_R_R_Def_u_ub_q_631_CM 1 100. 0. 25.5 DISPLAY_IDENTIFIER U_EWP_MIN ECU_ADDRESS 0xc0000ce9 FORMAT "%5.2" /end MEASUREMENT
/begin MEASUREMENT U_ewp_mn "Kein Langbezeichner vergeben" UBYTE _CNV_R_R_Def_u_ub_q_631_CM 1 100. 0. 25.5 DISPLAY_IDENTIFIER U_EWP_MN ECU_ADDRESS 0xd000d916 FORMAT "%5.2" /end MEASUREMENT
/begin MEASUREMENT U_geblaese_dn "Spannung Gebläse neg Gradient" UBYTE _CNV_R_R_Def_u_ub_b_721_CM 1 100. 0. 0.498 DISPLAY_IDENTIFIER U_GEBLAESE_DN ECU_ADDRESS 0xc0000cea FORMAT "%7.4" /end MEASUREMENT
/begin MEASUREMENT U_geblaese_dp "Spannung Gebläse pos Grdient" UBYTE _CNV_R_R_Def_u_ub_b_721_CM 1 100. 0. 0.498 DISPLAY_IDENTIFIER U_GEBLAESE_DP ECU_ADDRESS 0xc0000ceb FORMAT "%7.4" /end MEASUREMENT
/begin MEASUREMENT U_geblaese_min "Minspannung Gebläse" UBYTE _CNV_R_R_Def_u_ub_q_631_CM 1 100. 0. 25.5 DISPLAY_IDENTIFIER U_GEBLAESE_MIN ECU_ADDRESS 0xc0000cec FORMAT "%5.2" /end MEASUREMENT
/begin MEASUREMENT U_geblaese_mn "Minimalspannung Geblaese" UBYTE _CNV_R_R_Def_u_ub_q_631_CM 1 100. 0. 25.5 DISPLAY_IDENTIFIER U_GEBLAESE_MN ECU_ADDRESS 0xd000d917 FORMAT "%5.2" /end MEASUREMENT
/begin MEASUREMENT U_gen "Vorgabe Generator-Sollspannung (Ausgabewert)" UWORD _CNV_R_R_Def_u_ub_q_631_CM 1 100. 0. 6553.5 DISPLAY_IDENTIFIER U_GEN ECU_ADDRESS 0xc0000cc2 FORMAT "%8.3" /end MEASUREMENT
/begin MEASUREMENT U_gen_old "Wert von U_gen für t-100ms" UWORD _CNV_R_R_Def_u_ub_q_631_CM 1 100. 0. 6553.5 DISPLAY_IDENTIFIER U_GEN_OLD ECU_ADDRESS 0xc0000cc6 FORMAT "%8.3" /end MEASUREMENT
/begin MEASUREMENT U_gsoll_tp3 "unklar" UWORD _CNV_R_R_Def_u_ub_q_631_CM 1 100. 0. 6553.5 DISPLAY_IDENTIFIER U_GSOLL_TP3 ECU_ADDRESS 0xd000d93a FORMAT "%8.3" /end MEASUREMENT
/begin MEASUREMENT U_konf "Spannung mit maximaler Priorität aller Konfliktanforderungen" UBYTE _CNV_R_R_Def_u_ub_q_631_CM 1 100. 0. 25.5 DISPLAY_IDENTIFIER U_KONF ECU_ADDRESS 0xd000d94c FORMAT "%5.2" /end MEASUREMENT
/begin MEASUREMENT U_krapu_min "Kraftstoffpumpe Minspannung" UBYTE _CNV_R_R_Def_u_ub_q_631_CM 1 100. 0. 25.5 DISPLAY_IDENTIFIER U_KRAPU_MIN ECU_ADDRESS 0xc0000ced FORMAT "%5.2" /end MEASUREMENT
/begin MEASUREMENT U_krapu_mn "Kein Langbezeichner vergeben" UBYTE _CNV_R_R_Def_u_ub_q_631_CM 1 100. 0. 25.5 DISPLAY_IDENTIFIER U_KRAPU_MN ECU_ADDRESS 0xd000d918 FORMAT "%5.2" /end MEASUREMENT
/begin MEASUREMENT U_lcpkomp "Generatorsollspannungsvorgabe für LCP kompensiert" UBYTE _CNV_R_R_Def_u_ub_q_631_CM 1 100. 0. 25.5 DISPLAY_IDENTIFIER U_LCPKOMP ECU_ADDRESS 0xc0000ccb FORMAT "%5.2" /end MEASUREMENT
/begin MEASUREMENT U_licht_dn "Spannung Licht neg Gradient" UBYTE _CNV_R_R_Def_u_ub_b_721_CM 1 100. 0. 0.498 DISPLAY_IDENTIFIER U_LICHT_DN ECU_ADDRESS 0xc0000cee FORMAT "%7.4" /end MEASUREMENT
/begin MEASUREMENT U_licht_dp "Spannung Licht pos Gradient" UBYTE _CNV_R_R_Def_u_ub_b_721_CM 1 100. 0. 0.498 DISPLAY_IDENTIFIER U_LICHT_DP ECU_ADDRESS 0xc0000cef FORMAT "%7.4" /end MEASUREMENT
/begin MEASUREMENT U_licht_min "Minspannung Licht" UBYTE _CNV_R_R_Def_u_ub_q_631_CM 1 100. 0. 25.5 DISPLAY_IDENTIFIER U_LICHT_MIN ECU_ADDRESS 0xc0000cf0 FORMAT "%5.2" /end MEASUREMENT
/begin MEASUREMENT U_licht_mn "Minimalspannung Licht" UBYTE _CNV_R_R_Def_u_ub_q_631_CM 1 100. 0. 25.5 DISPLAY_IDENTIFIER U_LICHT_MN ECU_ADDRESS 0xd000d919 FORMAT "%5.2" /end MEASUREMENT
/begin MEASUREMENT U_max "max Spannung" UBYTE _CNV_R_R_Def_u_ub_q_631_CM 1 100. 0. 25.5 DISPLAY_IDENTIFIER U_MAX ECU_ADDRESS 0xd000d94d FORMAT "%5.2" /end MEASUREMENT
/begin MEASUREMENT U_min "min Spannung" UBYTE _CNV_R_R_Def_u_ub_q_631_CM 1 100. 0. 25.5 DISPLAY_IDENTIFIER U_MIN ECU_ADDRESS 0xd000d94e FORMAT "%5.2" /end MEASUREMENT
/begin MEASUREMENT U_ruhe_1 "Ruhespannung Messung 1" UWORD _CNV_R_R_Def_u_uw_b_689_CM 1 100. 0. 25.4996 DISPLAY_IDENTIFIER U_RUHE_1 ECU_ADDRESS 0xc0000d88 FORMAT "%9.4" /end MEASUREMENT
/begin MEASUREMENT U_ruhe_2 "Ruhespannung Messung 2" UWORD _CNV_R_R_Def_u_uw_b_689_CM 1 100. 0. 25.4996 DISPLAY_IDENTIFIER U_RUHE_2 ECU_ADDRESS 0xc0000d8a FORMAT "%9.4" /end MEASUREMENT
/begin MEASUREMENT U_ruhe_3 "Ruhespannung Messung 3" UWORD _CNV_R_R_Def_u_uw_b_689_CM 1 100. 0. 25.4996 DISPLAY_IDENTIFIER U_RUHE_3 ECU_ADDRESS 0xc0000d8c FORMAT "%9.4" /end MEASUREMENT
/begin MEASUREMENT U_slp_min "Minspannung Sekundärluftpumpe" UBYTE _CNV_R_R_Def_u_ub_q_631_CM 1 100. 0. 25.5 DISPLAY_IDENTIFIER U_SLP_MIN ECU_ADDRESS 0xc0000cf1 FORMAT "%5.2" /end MEASUREMENT
/begin MEASUREMENT U_slp_mn "Minimalspannung Sekundärluftpumpe" UBYTE _CNV_R_R_Def_u_ub_q_631_CM 1 100. 0. 25.5 DISPLAY_IDENTIFIER U_SLP_MN ECU_ADDRESS 0xd000d91a FORMAT "%5.2" /end MEASUREMENT
/begin MEASUREMENT U_soll "Sollspannung" UBYTE _CNV_R_R_Def_u_ub_q_631_CM 1 100. 0. 25.5 DISPLAY_IDENTIFIER U_SOLL ECU_ADDRESS 0xd000d94f FORMAT "%5.2" /end MEASUREMENT
/begin MEASUREMENT U_ulcpkomp "Generatorspannungsvorgabe für ULCP kompensiert" UBYTE _CNV_R_R_Def_u_ub_q_631_CM 1 100. 0. 25.5 DISPLAY_IDENTIFIER U_ULCPKOMP ECU_ADDRESS 0xc0000ccc FORMAT "%5.2" /end MEASUREMENT
/begin MEASUREMENT U_vbres1_max "Maxspannung Reserveverbraucher 1" UBYTE _CNV_R_R_Def_u_ub_q_631_CM 1 100. 0. 25.5 DISPLAY_IDENTIFIER U_VBRES1_MAX ECU_ADDRESS 0xc0000cf2 FORMAT "%5.2" /end MEASUREMENT
/begin MEASUREMENT U_vbres1_min "Minspannung Reserveverbraucher 1" UBYTE _CNV_R_R_Def_u_ub_q_631_CM 1 100. 0. 25.5 DISPLAY_IDENTIFIER U_VBRES1_MIN ECU_ADDRESS 0xc0000cf3 FORMAT "%5.2" /end MEASUREMENT
/begin MEASUREMENT U_vbres1_mn "Kein Langbezeichner vergeben" UBYTE _CNV_R_R_Def_u_ub_q_631_CM 1 100. 0. 25.5 DISPLAY_IDENTIFIER U_VBRES1_MN ECU_ADDRESS 0xc0000cb6 FORMAT "%5.2" /end MEASUREMENT
/begin MEASUREMENT U_vbres1_mx "Kein Langbezeichner vergeben" UBYTE _CNV_R_R_Def_u_ub_q_631_CM 1 100. 0. 25.5 DISPLAY_IDENTIFIER U_VBRES1_MX ECU_ADDRESS 0xc0000cb7 FORMAT "%5.2" /end MEASUREMENT
/begin MEASUREMENT U_vbres2_max "Maxspannung Reserveverbraucher 2" UBYTE _CNV_R_R_Def_u_ub_q_631_CM 1 100. 0. 25.5 DISPLAY_IDENTIFIER U_VBRES2_MAX ECU_ADDRESS 0xc0000cf4 FORMAT "%5.2" /end MEASUREMENT
/begin MEASUREMENT U_vbres2_min "Minspannung Reserveverbraucher 2" UBYTE _CNV_R_R_Def_u_ub_q_631_CM 1 100. 0. 25.5 DISPLAY_IDENTIFIER U_VBRES2_MIN ECU_ADDRESS 0xc0000cf5 FORMAT "%5.2" /end MEASUREMENT
/begin MEASUREMENT U_vbres2_mn "Kein Langbezeichner vergeben" UBYTE _CNV_R_R_Def_u_ub_q_631_CM 1 100. 0. 25.5 DISPLAY_IDENTIFIER U_VBRES2_MN ECU_ADDRESS 0xc0000cb8 FORMAT "%5.2" /end MEASUREMENT
/begin MEASUREMENT U_vbres2_mx "Kein Langbezeichner vergeben" UBYTE _CNV_R_R_Def_u_ub_q_631_CM 1 100. 0. 25.5 DISPLAY_IDENTIFIER U_VBRES2_MX ECU_ADDRESS 0xc0000cb9 FORMAT "%5.2" /end MEASUREMENT
/begin MEASUREMENT U_vbres3_dn "spannung neg Gradient Reserveverbraucher 3" UBYTE _CNV_R_R_Def_u_ub_b_721_CM 1 100. 0. 0.498 DISPLAY_IDENTIFIER U_VBRES3_DN ECU_ADDRESS 0xc0000cf6 FORMAT "%7.4" /end MEASUREMENT
/begin MEASUREMENT U_vbres3_dp "Spannung pos Gradient Reserveverbraucher 3" UBYTE _CNV_R_R_Def_u_ub_b_721_CM 1 100. 0. 0.498 DISPLAY_IDENTIFIER U_VBRES3_DP ECU_ADDRESS 0xc0000cf7 FORMAT "%7.4" /end MEASUREMENT
/begin MEASUREMENT U_vbres3_max "Maxspannung Reserveverbraucher 3" UBYTE _CNV_R_R_Def_u_ub_q_631_CM 1 100. 0. 25.5 DISPLAY_IDENTIFIER U_VBRES3_MAX ECU_ADDRESS 0xc0000cf8 FORMAT "%5.2" /end MEASUREMENT
/begin MEASUREMENT U_vbres3_min "Minspannung Reserveverbraucher 3" UBYTE _CNV_R_R_Def_u_ub_q_631_CM 1 100. 0. 25.5 DISPLAY_IDENTIFIER U_VBRES3_MIN ECU_ADDRESS 0xc0000cf9 FORMAT "%5.2" /end MEASUREMENT
/begin MEASUREMENT U_vbres3_mn "Kein Langbezeichner vergeben" UBYTE _CNV_R_R_Def_u_ub_q_631_CM 1 100. 0. 25.5 DISPLAY_IDENTIFIER U_VBRES3_MN ECU_ADDRESS 0xc0000cba FORMAT "%5.2" /end MEASUREMENT
/begin MEASUREMENT U_vbres3_mx "Kein Langbezeichner vergeben" UBYTE _CNV_R_R_Def_u_ub_q_631_CM 1 100. 0. 25.5 DISPLAY_IDENTIFIER U_VBRES3_MX ECU_ADDRESS 0xc0000cbb FORMAT "%5.2" /end MEASUREMENT
/begin MEASUREMENT U_vbres4_dn "Spannung neg Gradient Reserveverbraucher 4" UBYTE _CNV_R_R_Def_u_ub_b_721_CM 1 100. 0. 0.498 DISPLAY_IDENTIFIER U_VBRES4_DN ECU_ADDRESS 0xc0000cfa FORMAT "%7.4" /end MEASUREMENT
/begin MEASUREMENT U_vbres4_dp "spannung pos Gradient Reserveverbraucher 4" UBYTE _CNV_R_R_Def_u_ub_b_721_CM 1 100. 0. 0.498 DISPLAY_IDENTIFIER U_VBRES4_DP ECU_ADDRESS 0xc0000cfb FORMAT "%7.4" /end MEASUREMENT
/begin MEASUREMENT U_vbres4_max "Maxspannung Reserveverbraucher 4" UBYTE _CNV_R_R_Def_u_ub_q_631_CM 1 100. 0. 25.5 DISPLAY_IDENTIFIER U_VBRES4_MAX ECU_ADDRESS 0xc0000cfc FORMAT "%5.2" /end MEASUREMENT
/begin MEASUREMENT U_vbres4_min "Minspannung Reserveverbraucher 4" UBYTE _CNV_R_R_Def_u_ub_q_631_CM 1 100. 0. 25.5 DISPLAY_IDENTIFIER U_VBRES4_MIN ECU_ADDRESS 0xc0000cfd FORMAT "%5.2" /end MEASUREMENT
/begin MEASUREMENT U_vbres4_mn "Kein Langbezeichner vergeben" UBYTE _CNV_R_R_Def_u_ub_q_631_CM 1 100. 0. 25.5 DISPLAY_IDENTIFIER U_VBRES4_MN ECU_ADDRESS 0xc0000cbc FORMAT "%5.2" /end MEASUREMENT
/begin MEASUREMENT U_vbres4_mx "Kein Langbezeichner vergeben" UBYTE _CNV_R_R_Def_u_ub_q_631_CM 1 100. 0. 25.5 DISPLAY_IDENTIFIER U_VBRES4_MX ECU_ADDRESS 0xc0000cbd FORMAT "%5.2" /end MEASUREMENT
/begin MEASUREMENT U_vbres5_max "Maxspannung Reserveverbraucher 5" UBYTE _CNV_R_R_Def_u_ub_q_631_CM 1 100. 0. 25.5 DISPLAY_IDENTIFIER U_VBRES5_MAX ECU_ADDRESS 0xc0000cfe FORMAT "%5.2" /end MEASUREMENT
/begin MEASUREMENT U_vbres5_min "Maxspannung Reserveverbraucher 5" UBYTE _CNV_R_R_Def_u_ub_q_631_CM 1 100. 0. 25.5 DISPLAY_IDENTIFIER U_VBRES5_MIN ECU_ADDRESS 0xc0000cff FORMAT "%5.2" /end MEASUREMENT
/begin MEASUREMENT U_vbres5_mn "Kein Langbezeichner vergeben" UBYTE _CNV_R_R_Def_u_ub_q_631_CM 1 100. 0. 25.5 DISPLAY_IDENTIFIER U_VBRES5_MN ECU_ADDRESS 0xc0000cbe FORMAT "%5.2" /end MEASUREMENT
/begin MEASUREMENT U_vbres5_mx "Kein Langbezeichner vergeben" UBYTE _CNV_R_R_Def_u_ub_q_631_CM 1 100. 0. 25.5 DISPLAY_IDENTIFIER U_VBRES5_MX ECU_ADDRESS 0xc0000cbf FORMAT "%5.2" /end MEASUREMENT
/begin MEASUREMENT U_vbtherm_mx "Maxspannung bei thermischer Überlast" UBYTE _CNV_R_R_Def_u_ub_q_631_CM 1 100. 0. 25.5 DISPLAY_IDENTIFIER U_VBTHERM_MX ECU_ADDRESS 0xc0000d00 FORMAT "%5.2" /end MEASUREMENT
/begin MEASUREMENT U_wischer_max "Maxspannung Wischer" UBYTE _CNV_R_R_Def_u_ub_q_631_CM 1 100. 0. 25.5 DISPLAY_IDENTIFIER U_WISCHER_MAX ECU_ADDRESS 0xc0000d01 FORMAT "%5.2" /end MEASUREMENT
/begin MEASUREMENT U_wischer_min "Minspannung Wischer" UBYTE _CNV_R_R_Def_u_ub_q_631_CM 1 100. 0. 25.5 DISPLAY_IDENTIFIER U_WISCHER_MIN ECU_ADDRESS 0xc0000d02 FORMAT "%5.2" /end MEASUREMENT
/begin MEASUREMENT U_wischer_mn "Minimalspannung Scheibenwischer" UBYTE _CNV_R_R_Def_u_ub_q_631_CM 1 100. 0. 25.5 DISPLAY_IDENTIFIER U_WISCHER_MN ECU_ADDRESS 0xd000d91b FORMAT "%5.2" /end MEASUREMENT
/begin MEASUREMENT U_wischer_mx "Maximalspannung Scheibenwischer" UBYTE _CNV_R_R_Def_u_ub_q_631_CM 1 100. 0. 25.5 DISPLAY_IDENTIFIER U_WISCHER_MX ECU_ADDRESS 0xd000d91c FORMAT "%5.2" /end MEASUREMENT
/begin MEASUREMENT U_ziel "Ergebnis der Spannungsermittlung (vor Dynamik Berechnung)" UBYTE _CNV_R_R_Def_u_ub_q_631_CM 1 100. 0. 25.5 DISPLAY_IDENTIFIER U_ZIEL ECU_ADDRESS 0xd000d950 FORMAT "%5.2" /end MEASUREMENT
/begin MEASUREMENT Ubw_uszr "Schwingungszähler Bordnetzspannung" UBYTE _CNV_R_R_Def_dez_sl_551_CM 1 100. 0. 255. DISPLAY_IDENTIFIER UBW_USZR ECU_ADDRESS 0xd000d925 FORMAT "%3.0" /end MEASUREMENT
/begin MEASUREMENT Ubw_zr "Zähler Bordnetzspannung instabil" UWORD _CNV_R_R_Def_dez_sl_551_CM 1 100. 0. 65535. DISPLAY_IDENTIFIER UBW_ZR ECU_ADDRESS 0xd000d91e FORMAT "%5.0" /end MEASUREMENT
/begin MEASUREMENT Ulzr "Zähler für Erkennung zyklischer Spannungseinbruch" UWORD _CNV_R_R_Def_dez_sl_551_CM 1 100. 0. 65535. DISPLAY_IDENTIFIER ULZR ECU_ADDRESS 0xd000d920 FORMAT "%5.0" /end MEASUREMENT
/begin MEASUREMENT Uszr "Zähler für Erkennung dauerhafter Spannungseinbruch" UWORD _CNV_R_R_Def_dez_sl_551_CM 1 100. 0. 65535. DISPLAY_IDENTIFIER USZR ECU_ADDRESS 0xd000d922 FORMAT "%5.0" /end MEASUREMENT
/begin MEASUREMENT Verbstat_0 "Zwischenvariable Licht" UBYTE _CNV_R_R_Def_dez_sl_551_CM 1 100. 0. 255. DISPLAY_IDENTIFIER VERBSTAT_0 ECU_ADDRESS 0xc0000d0e FORMAT "%3.0" /end MEASUREMENT
/begin CHARACTERISTIC CW_BGKUPPL "Codewort modellierter Kupplungsschalter aktiv" VALUE 0xa0817260 _REC_VAL_20_u1 99.45 _CNV_R_R_Def_dez_sl_551_CM 0. 255. FORMAT "%3.0" /end CHARACTERISTIC
/begin CHARACTERISTIC CW_EISY "Codeword Umschaltung EISY Modus" VALUE 0xa081e828 _REC_VAL_20_u1 99.45 _CNV_R_R_Def_dez_sl_551_CM 0. 255. FORMAT "%3.0" /end CHARACTERISTIC
/begin CHARACTERISTIC CW_EISY_TGLE "Codeword Umschaltung EISY-Laufzeit-Modus" VALUE 0xa081e829 _REC_VAL_20_u1 99.45 _CNV_R_R_Def_dez_sl_551_CM 0. 255. FORMAT "%3.0" /end CHARACTERISTIC
/begin CHARACTERISTIC CW_LLBITINT "Codewort Ll-Bit" VALUE 0xa0817261 _REC_VAL_20_u1 99.45 _CNV_R_R_Def_dez_sl_551_CM 0. 255. FORMAT "%3.0" /end CHARACTERISTIC
/begin CHARACTERISTIC CW_MPR_KOORD "Codeword Umschaltung PSREG MAREG zwischen DI/TURBO und VVT" VALUE 0xa081e82a _REC_VAL_20_u1 99.45 _CNV_R_R_Def_dez_sl_551_CM 0. 255. FORMAT "%3.0" /end CHARACTERISTIC
/begin CHARACTERISTIC KF_DPBKVDOWN "Kennfeld Bremsunterdruckabbau" MAP 0xa08193d8 _REC_MAP_52_UBYTE_s2_s2_u1 120. _CNV_R_R_Def_p_sw_q_596_CM -2000. 2000. FORMAT "%5.2"
 /begin AXIS_DESCR STD_AXIS Dpbkv _CNV_R_R_Def_p_sw_q_596_CM 6 -3276.8 3276.7 FORMAT "%5.2" /end AXIS_DESCR
 /begin AXIS_DESCR STD_AXIS Pbrems _CNV_R_R_Def_p_ub_q_677_CM 6 0. 99.60930000000001 FORMAT "%5.2" /end AXIS_DESCR
/end CHARACTERISTIC
/begin CHARACTERISTIC KF_DPBKVUP "Kennfeld Bremsunterdruckaufbau" MAP 0xa0819374 _REC_MAP_52_UBYTE_s2_s2_s2 120. _CNV_R_R_Def_p_sw_q_596_CM -2000. 2000. FORMAT "%5.2"
 /begin AXIS_DESCR STD_AXIS Dpbkv _CNV_R_R_Def_p_sw_q_596_CM 6 -3276.8 3276.7 FORMAT "%5.2" /end AXIS_DESCR
 /begin AXIS_DESCR STD_AXIS Nkw _CNV_R_R_Def_n_sw_q_595_CM 6 -32768. 32767. FORMAT "%5.0" /end AXIS_DESCR
/end CHARACTERISTIC
/begin CHARACTERISTIC KF_EFFTANS_FAK "" MAP 0xa08333c8 _REC_MAP_52_UBYTE_u2_s2_s2 1.9999 _CNV_R_R_Def_f_uw_b_590_CM 0. 1.9999 FORMAT "%14.5"
 /begin AXIS_DESCR STD_AXIS Nkw _CNV_R_R_Def_n_sw_q_595_CM 8 -32768. 32767. FORMAT "%5.0" /end AXIS_DESCR
 /begin AXIS_DESCR STD_AXIS Rf _CNV_R_R_Def_rf_sw__598_CM 8 -327.68 327.67 FORMAT "%7.4" /end AXIS_DESCR
/end CHARACTERISTIC
/begin CHARACTERISTIC KF_EFFTMOT_FAK "" MAP 0xa0833324 _REC_MAP_52_UBYTE_u2_s2_s2 1.9999 _CNV_R_R_Def_f_uw_b_590_CM 0. 1.9999 FORMAT "%14.5"
 /begin AXIS_DESCR STD_AXIS Nkw _CNV_R_R_Def_n_sw_q_595_CM 8 -32768. 32767. FORMAT "%5.0" /end AXIS_DESCR
 /begin AXIS_DESCR STD_AXIS Rf _CNV_R_R_Def_rf_sw__598_CM 8 -327.68 327.67 FORMAT "%7.4" /end AXIS_DESCR
/end CHARACTERISTIC
/begin CHARACTERISTIC KF_EKPRFNKW "Kennfeld Elektrische Kraftstoffpumpe Minspannungsbestimmung" MAP 0xa0825564 _REC_MAP_52_u1_s2_s2 25.5 _CNV_R_R_Def_u_ub_q_631_CM 0. 25.5 FORMAT "%5.2"
 /begin AXIS_DESCR STD_AXIS Nkw _CNV_R_R_Def_n_sw_q_595_CM 4 -32768. 32767. FORMAT "%5.0" /end AXIS_DESCR
 /begin AXIS_DESCR STD_AXIS Rf _CNV_R_R_Def_rf_sw__598_CM 4 -327.68 327.67 FORMAT "%7.4" /end AXIS_DESCR
/end CHARACTERISTIC
/begin CHARACTERISTIC KF_FW_TBR "Wichtungsfaktor fuer Brennraum Temperaturmodell" MAP 0xa08332ac _REC_MAP_52_u1_s2_s2 0.996 _CNV_R_R_Def_f_ub_b_553_CM 0. 0.996
 /begin AXIS_DESCR STD_AXIS Rf _CNV_R_R_Def_rf_sw__598_CM 10 -327.68 327.67 FORMAT "%7.4" /end AXIS_DESCR
 /begin AXIS_DESCR STD_AXIS Nkw _CNV_R_R_Def_n_sw_q_595_CM 8 -32768. 32767. FORMAT "%5.0" /end AXIS_DESCR
/end CHARACTERISTIC
/begin CHARACTERISTIC KF_QVH2O_FT "Berechnung der temperaturabhängigen Zusatzrate: f_T =aT_0 + aT_1 * (T - Tx) + aT_2 * (T - Tx)^2 + aT_3 * (T - Tx)^3 + aT_exp * exp(bT_exp * (T - Tx))" MAP 0xa0825880 _REC_MAP_52_UBYTE_s2_s2_u1 98.30250000000001 _CNV_R_R_Def_lf_ub__670_CM -327.68 327.67 FORMAT "%5.2"
 /begin AXIS_DESCR STD_AXIS T_batt _CNV_R_R_Def_t_sw_q_578_CM 12 -3276.8 3276.7 FORMAT "%4.1" /end AXIS_DESCR
 /begin AXIS_DESCR STD_AXIS Qvh2o_btyp _CNV_R_R_Def_dez_sl_551_CM 2 0. 255. FORMAT "%3.0" /end AXIS_DESCR
/end CHARACTERISTIC
/begin CHARACTERISTIC KF_QVH2O_XH "Berechnung der Abhängigkeit von der bisherigen Wasserverbrauchsrate: 1 + a_WL * EXP( (-1) * b_WL*xSum)" MAP 0xa08258cc _REC_MAP_52_UBYTE_s2_s2_u1 98.30250000000001 _CNV_R_R_Def_lf_ub__670_CM -327.68 327.67 FORMAT "%5.2"
 /begin AXIS_DESCR STD_AXIS Qvh2o_xhsum _CNV_R_R_Def_t_sw_q_578_CM 12 -3276.8 3276.7 FORMAT "%4.1" /end AXIS_DESCR
 /begin AXIS_DESCR STD_AXIS NO_INPUT_QUANTITY _CNV_R_R_Def_dez_sl_551_CM 2 0. 255. FORMAT "%3.0" /end AXIS_DESCR
/end CHARACTERISTIC
/begin CHARACTERISTIC KF_QVH2O_XI "Berechnung der Ladestromabhängigkeit: x_I =aI_0 + aI1 * xI_20 + aI2 * (xI_20)^2 + aI3 * (xI_20)^3 + aI_exp * exp(bI_exp * xI_20)" MAP 0xa0825834 _REC_MAP_52_UBYTE_s2_s2_u1 98.30250000000001 _CNV_R_R_Def_lf_ub__670_CM -327.68 327.67 FORMAT "%5.2"
 /begin AXIS_DESCR STD_AXIS Qvh2o_xi20 _CNV_R_R_Def_t_sw_q_578_CM 12 -3276.8 3276.7 FORMAT "%4.1" /end AXIS_DESCR
 /begin AXIS_DESCR STD_AXIS NO_INPUT_QUANTITY _CNV_R_R_Def_dez_sl_551_CM 2 0. 255. FORMAT "%3.0" /end AXIS_DESCR
/end CHARACTERISTIC
/begin CHARACTERISTIC KF_QVH2O_XT "Berechnung der Temperaturabhängigkeit: x_T = exp(-T0*(1/(T+273,15)-(1/298,15)))" MAP 0xa08257e8 _REC_MAP_52_UBYTE_s2_s2_u1 98.30250000000001 _CNV_R_R_Def_lf_ub__670_CM -327.68 327.67 FORMAT "%5.2"
 /begin AXIS_DESCR STD_AXIS T_batt _CNV_R_R_Def_t_sw_q_578_CM 12 -3276.8 3276.7 FORMAT "%4.1" /end AXIS_DESCR
 /begin AXIS_DESCR STD_AXIS Qvh2o_btyp _CNV_R_R_Def_dez_sl_551_CM 2 0. 255. FORMAT "%3.0" /end AXIS_DESCR
/end CHARACTERISTIC
/begin CHARACTERISTIC KF_QVH2O_XU "Berechnung der Spannungsabhängigkeit: x_U = exp((U-U_0)/(U_std - U_0)))" MAP 0xa0825918 _REC_MAP_52_UBYTE_s2_s2_u1 98.30250000000001 _CNV_R_R_Def_lf_ub__670_CM -327.68 327.67 FORMAT "%5.2"
 /begin AXIS_DESCR STD_AXIS Qv_ubatt_ber _CNV_R_R_Def_t_sw_q_578_CM 12 -3276.8 3276.7 FORMAT "%4.1" /end AXIS_DESCR
 /begin AXIS_DESCR STD_AXIS NO_INPUT_QUANTITY _CNV_R_R_Def_dez_sl_551_CM 2 0. 255. FORMAT "%3.0" /end AXIS_DESCR
/end CHARACTERISTIC
/begin CHARACTERISTIC KF_RFVIST_ST "Start Relativ-Fuellung" MAP 0xa081e8ac _REC_MAP_52_UBYTE_s2_u2_s2 98.30250000000001 _CNV_R_R_Def_rf_sw__598_CM -327.68 327.67 FORMAT "%7.4" /begin AXIS_DESCR STD_AXIS Hubev_soll _CNV_R_R_Def_hub_uw_589_CM 6 0. 65.535 /end AXIS_DESCR
 /begin AXIS_DESCR STD_AXIS Nkw _CNV_R_R_Def_n_sw_q_595_CM 6 -32768. 32767. FORMAT "%5.0" /end AXIS_DESCR
/end CHARACTERISTIC
/begin CHARACTERISTIC KF_TEVT_MDL_OFFSET "Offset fuer Tevt_mdl" MAP 0xa08334ac _REC_MAP_52_UBYTE_s2_s2_s2 131.07 _CNV_R_R_Def_t_sw_q_578_CM -3276.8 3276.7 FORMAT "%4.1"
 /begin AXIS_DESCR STD_AXIS Tmot_fil_tempk _CNV_R_R_Def_t_sw_q_578_CM 8 -3276.8 3276.7 FORMAT "%4.1" /end AXIS_DESCR
 /begin AXIS_DESCR STD_AXIS Tmot_start _CNV_R_R_Def_t_sw_q_579_CM 4 -327.68 327.67 FORMAT "%5.2" /end AXIS_DESCR
/end CHARACTERISTIC
/begin CHARACTERISTIC KF_U00 "QVC U00 - Kennfeld für Ruhestromkompensation" MAP 0xa08257a4 _REC_MAP_52_UBYTE_u2_u2_s2 25.4996 _CNV_R_R_Def_u_uw_b_689_CM 0. 25.4996 FORMAT "%7.4"
 /begin AXIS_DESCR STD_AXIS U0_batt _CNV_R_R_Def_u_uw_b_689_CM 3 0. 25.4996 FORMAT "%7.4" /end AXIS_DESCR
 /begin AXIS_DESCR STD_AXIS I_soc0_komp _CNV_R_R_Def_i_sw_q_640_CM 5 -655.36 655.34 /end AXIS_DESCR
/end CHARACTERISTIC
/begin CHARACTERISTIC KF_WDAFS "Kennfeld Bestimmung Minspannung Elektrische Lenkhilfe bei Active Front steering" MAP 0xa08255f4 _REC_MAP_52_u1_s2_s2 99.45 _CNV_R_R_Def_dez_sl_551_CM 0. 255. FORMAT "%3.0"
 /begin AXIS_DESCR STD_AXIS W_afs _CNV_R_R_Def_f_sw_q_560_CM 8 -3276.8 3276.7 FORMAT "%5.2" /end AXIS_DESCR
 /begin AXIS_DESCR STD_AXIS W_dafs _CNV_R_R_Def_f_sw_q_560_CM 8 -3276.8 3276.7 FORMAT "%5.2" /end AXIS_DESCR
/end CHARACTERISTIC
/begin CHARACTERISTIC KF_WFTEV "Wichtungsfaktor fuer Brennraum Temperaturmodell, TL-VL" MAP 0xa083346c _REC_MAP_52_u1_s2_s2 0.996 _CNV_R_R_Def_f_ub_b_553_CM 0. 0.996
 /begin AXIS_DESCR STD_AXIS Nkw _CNV_R_R_Def_n_sw_q_595_CM 6 -32768. 32767. FORMAT "%5.0" /end AXIS_DESCR
 /begin AXIS_DESCR STD_AXIS Rf _CNV_R_R_Def_rf_sw__598_CM 6 -327.68 327.67 FORMAT "%7.4" /end AXIS_DESCR
/end CHARACTERISTIC
/begin CHARACTERISTIC KL_BANK_EISY "Zuordnung Segakt zu Bank" CURVE 0xa081e860 _REC_CUR_TKL_UW_VV__u1_u1 99.45 _CNV_R_R_Def_dez_sl_551_CM 0. 255. FORMAT "%3.0"
 /begin AXIS_DESCR STD_AXIS Segakt _CNV_R_R_Def_dez_sl_551_CM 8 0. 255. FORMAT "%3.0" /end AXIS_DESCR
/end CHARACTERISTIC
/begin CHARACTERISTIC KL_ELUEFTER "Kennlinie Elektrischer Lüfter" CURVE 0xa0825554 _REC_CUR_TKL_UW_VV__u1_u1 25.5 _CNV_R_R_Def_u_ub_q_631_CM 0. 25.5 FORMAT "%5.2"
 /begin AXIS_DESCR STD_AXIS L_pwmout _CNV_R_R_Def_f_ub_b_586_CM 5 0. 99.60930000000001 FORMAT "%5.2" /end AXIS_DESCR
/end CHARACTERISTIC
/begin CHARACTERISTIC KL_ELU_L3 "Kennlinie Elektrischer Lüfter bei MINI" CURVE 0xa0825540 _REC_CUR_TKL_UW_VV__u1_s2 25.5 _CNV_R_R_Def_u_ub_q_631_CM 0. 25.5 FORMAT "%5.2"
 /begin AXIS_DESCR STD_AXIS Tmot _CNV_R_R_Def_t_sw_q_579_CM 5 -327.68 327.67 FORMAT "%5.2" /end AXIS_DESCR
/end CHARACTERISTIC
/begin CHARACTERISTIC KL_EWP "Kennline Minspannung Elektrische Wasserpumpe" CURVE 0xa08255e4 _REC_CUR_TKL_UW_VV__u1_u1 25.5 _CNV_R_R_Def_u_ub_q_631_CM 0. 25.5 FORMAT "%5.2"
 /begin AXIS_DESCR STD_AXIS Newp_soll _CNV_R_R_Def_dez_sl_551_CM 5 0. 255. FORMAT "%3.0" /end AXIS_DESCR
/end CHARACTERISTIC
/begin CHARACTERISTIC KL_FTEVST "Start Wichtungsfaktor fuer Fak_tbr abh." CURVE 0xa0833264 _REC_CUR_TKL_UW_VV__u2_s2 1.9999 _CNV_R_R_Def_f_uw_b_590_CM 0. 1.9999 FORMAT "%14.5"
 /begin AXIS_DESCR STD_AXIS Tmot _CNV_R_R_Def_t_sw_q_579_CM 8 -327.68 327.67 FORMAT "%5.2" /end AXIS_DESCR
/end CHARACTERISTIC
/begin CHARACTERISTIC KL_FTEV_TL "Wichtungsfaktor fuer Fak_tbr abh. TL" CURVE 0xa08331ec _REC_CUR_TKL_UW_VV__u2_s2 1.9999 _CNV_R_R_Def_f_uw_b_590_CM 0. 1.9999 FORMAT "%14.5"
 /begin AXIS_DESCR STD_AXIS NO_INPUT_QUANTITY _CNV_R_R_Def_t_sw_q_578_CM 14 -3276.8 3276.7 FORMAT "%4.1" /end AXIS_DESCR
/end CHARACTERISTIC
/begin CHARACTERISTIC KL_FTEV_VL "Wichtungsfaktor fuer Fak_tbr abh. VL" CURVE 0xa0833228 _REC_CUR_TKL_UW_VV__u2_s2 1.9999 _CNV_R_R_Def_f_uw_b_590_CM 0. 1.9999 FORMAT "%14.5"
 /begin AXIS_DESCR STD_AXIS NO_INPUT_QUANTITY _CNV_R_R_Def_t_sw_q_578_CM 14 -3276.8 3276.7 FORMAT "%4.1" /end AXIS_DESCR
/end CHARACTERISTIC
/begin CHARACTERISTIC KL_FTVDK "Temperaturfaktor fuer Drosselventil Durchfluss" CURVE 0xa08331d0 _REC_CUR_TKL_UW_VV__u1_s2 1.9921 _CNV_R_R_Def_f_ub_b_613_CM 0. 1.9921
 /begin AXIS_DESCR STD_AXIS Tans _CNV_R_R_Def_t_sw_q_578_CM 8 -3276.8 3276.7 FORMAT "%4.1" /end AXIS_DESCR
/end CHARACTERISTIC
/begin CHARACTERISTIC KL_MRD_EV "Gewichtung Eingang Pspvdk_soll" CURVE 0xa081e874 _REC_CUR_TKL_UW_VV__u2_u2 3.9999 _CNV_R_R_Def_f_sw_b_616_CM 0. 3.9999 FORMAT "%14.5"
 /begin AXIS_DESCR STD_AXIS Pspvdk_soll _CNV_R_R_Def_f_sw_b_616_CM 6 0. 3.9999 FORMAT "%14.5" /end AXIS_DESCR
/end CHARACTERISTIC
/begin CHARACTERISTIC KL_NSLLBKV "Kennlinie für Bremskraftverstärkerleerlaufdrehzahl" CURVE 0xa0819344 _REC_CUR_TKL_UW_VV__s2_s2 0. _CNV_R_R_Def_n_sw_q_595_CM -32768. 32767. FORMAT "%5.0"
 /begin AXIS_DESCR STD_AXIS Dpbkv _CNV_R_R_Def_p_sw_q_596_CM 6 -3276.8 3276.7 FORMAT "%5.2" /end AXIS_DESCR
/end CHARACTERISTIC
/begin CHARACTERISTIC KL_PSREGAGR_KOR "" CURVE 0xa081e890 _REC_CUR_TKL_UW_VV__u2_u2 15.9997 _CNV_R_R_Def_f_uw_b_559_CM 0. 15.9997 FORMAT "%7.4"
 /begin AXIS_DESCR STD_AXIS NO_INPUT_QUANTITY _CNV_R_R_Def_f_uw_b_571_CM 6 0. 0.9999 FORMAT "%14.5" /end AXIS_DESCR
/end CHARACTERISTIC
/begin CHARACTERISTIC KL_QUALIPRLI "Kein Langbezeichner vergeben" CURVE 0xa08254e8 _REC_CUR_TKL_UW_VV__u1_u2 99.60930000000001 _CNV_R_R_Def_f_ub_b_586_CM 0. 99.60930000000001 FORMAT "%5.2"
 /begin AXIS_DESCR STD_AXIS Quali_spg _CNV_R_R_Def_dez_sl_551_CM 4 0. 65535. FORMAT "%5.0" /end AXIS_DESCR
/end CHARACTERISTIC
/begin CHARACTERISTIC KL_QUALIULI "Kein Langbezeichner vergeben" CURVE 0xa08254cc _REC_CUR_TKL_UW_VV__u1_u2 3. _CNV_R_R_Def_f_ub_b_737_CM 0. 3. FORMAT "%5.2"
 /begin AXIS_DESCR STD_AXIS Quali_spg _CNV_R_R_Def_dez_sl_551_CM 8 0. 65535. FORMAT "%5.0" /end AXIS_DESCR
/end CHARACTERISTIC
/begin CHARACTERISTIC KL_QVQ_QWIN "Kennlinie zur Angabe der Qualität der Qvm-Werte im Betrachtungsfenster" CURVE 0xa0825978 _REC_CUR_TKL_UW_VV__u1_u1 99.45 _CNV_R_R_Def_dez_sl_551_CM 0. 255. FORMAT "%3.0"
 /begin AXIS_DESCR STD_AXIS Qv_bfenster _CNV_R_R_Def_dez_sl_551_CM 10 0. 255. FORMAT "%3.0" /end AXIS_DESCR
/end CHARACTERISTIC
/begin CHARACTERISTIC KL_SOC0TMP "QVC U00 - Temperaturabhängige Stromkorrektur für Ruhespannungsmessung" CURVE 0xa0825728 _REC_CUR_TKL_UW_VV__u1_s2 1.9921 _CNV_R_R_Def_f_ub_b_613_CM 0. 1.9921
 /begin AXIS_DESCR STD_AXIS T_battsoc0 _CNV_R_R_Def_t_sw_q_578_CM 5 -3276.8 3276.7 FORMAT "%4.1" /end AXIS_DESCR
/end CHARACTERISTIC
/begin CHARACTERISTIC KL_TAKORFAK_TMPK "" CURVE 0xa08331ac _REC_CUR_TKL_UW_VV__u2_s2 1.9999 _CNV_R_R_Def_f_uw_b_590_CM 0. 1.9999 FORMAT "%14.5"
 /begin AXIS_DESCR STD_AXIS Tans _CNV_R_R_Def_t_sw_q_578_CM 8 -3276.8 3276.7 FORMAT "%4.1" /end AXIS_DESCR
/end CHARACTERISTIC
/begin CHARACTERISTIC KL_TBKV "Kennlinie für Ansauglufttemperatur Bremskraftverstärker" CURVE 0xa0819360 _REC_CUR_TKL_UW_VV__u1_s2 9.900000000000001e-003 _CNV_R_R_Def_t_ub_b_752_CM 0. 9.900000000000001e-003 FORMAT "%14.5"
 /begin AXIS_DESCR STD_AXIS Tans _CNV_R_R_Def_t_sw_q_578_CM 6 -3276.8 3276.7 FORMAT "%4.1" /end AXIS_DESCR
/end CHARACTERISTIC
/begin CHARACTERISTIC KL_TEVT_MDL_AGR "Offset fuer Tevt_mdl bei hoher Tans d. AGR" CURVE 0xa0833288 _REC_CUR_TKL_UW_VV__s2_s2 131.07 _CNV_R_R_Def_t_sw_q_578_CM -3276.8 3276.7 FORMAT "%4.1"
 /begin AXIS_DESCR STD_AXIS NO_INPUT_QUANTITY _CNV_R_R_Def_t_sw_q_578_CM 8 -3276.8 3276.7 FORMAT "%4.1" /end AXIS_DESCR
/end CHARACTERISTIC
/begin CHARACTERISTIC KL_TMKORFAK_TMPK "" CURVE 0xa0833188 _REC_CUR_TKL_UW_VV__u2_s2 1.9999 _CNV_R_R_Def_f_uw_b_590_CM 0. 1.9999 FORMAT "%14.5"
 /begin AXIS_DESCR STD_AXIS NO_INPUT_QUANTITY _CNV_R_R_Def_t_sw_q_578_CM 8 -3276.8 3276.7 FORMAT "%4.1" /end AXIS_DESCR
/end CHARACTERISTIC
/begin CHARACTERISTIC KL_TMKORTMPK "" CURVE 0xa0833140 _REC_CUR_TKL_UW_VV__u2_u2 0.9999 _CNV_R_R_Def_f_uw_b_571_CM 0. 0.9999 FORMAT "%14.5" /begin AXIS_DESCR STD_AXIS Mszyl _CNV_R_R_Def_ms_uw__594_CM 8 0. 2047.9687 /end AXIS_DESCR /end CHARACTERISTIC
/begin CHARACTERISTIC KL_U00QUA_I "QVC U00 - Qualitätsindex U00 Ruhestromeinfluss" CURVE 0xa0825760 _REC_CUR_TKL_UW_VV__u2_s2 0.3906000000000001 _CNV_R_R_Def_f_uw_b_555_CM 0. 0.3906
 /begin AXIS_DESCR STD_AXIS I_soc0 _CNV_R_R_Def_i_sw_q_640_CM 4 -655.36 655.34 /end AXIS_DESCR
/end CHARACTERISTIC
/begin CHARACTERISTIC KL_U00QUA_NF "QVC U00 - Qualitätsindex U00 Einfluss fehlende Messungen" CURVE 0xa0825754 _REC_CUR_TKL_UW_VV__u1_u1 99.60930000000001 _CNV_R_R_Def_f_ub_b_586_CM 0. 99.60930000000001 FORMAT "%5.2"
 /begin AXIS_DESCR STD_AXIS Qv_n_fehlmes _CNV_R_R_Def_f_ub_b_694_CM 4 0. 7.9687 FORMAT "%5.2" /end AXIS_DESCR
/end CHARACTERISTIC
/begin CHARACTERISTIC KL_U00QUA_T "QVC U00 - Qualitätsindex U00 Temperatureinfluss" CURVE 0xa0825790 _REC_CUR_TKL_UW_VV__u1_s2 99.60930000000001 _CNV_R_R_Def_f_ub_b_586_CM 0. 99.60930000000001 FORMAT "%5.2"
 /begin AXIS_DESCR STD_AXIS T_battsoc0 _CNV_R_R_Def_t_sw_q_578_CM 6 -3276.8 3276.7 FORMAT "%4.1" /end AXIS_DESCR
/end CHARACTERISTIC
/begin CHARACTERISTIC KL_U00QUA_TR "QVC U00 - Qualitätsindex U00 Einfluss Ruhezeit" CURVE 0xa0825774 _REC_CUR_TKL_UW_VV__u2_u2 99.9984 _CNV_R_R_Def_f_uw_b_555_CM 0. 99.9984
 /begin AXIS_DESCR STD_AXIS NO_INPUT_QUANTITY _CNV_R_R_Def_f_uw_b_679_CM 6 0. 2047.9687 FORMAT "%5.2" /end AXIS_DESCR
/end CHARACTERISTIC
/begin CHARACTERISTIC KL_U00QUA_U1 "QVC U00 - Qualitätsindex U00 Einfluss U00-Grössenordnung" CURVE 0xa082570c _REC_CUR_TKL_UW_VV__u1_u2 99.60930000000001 _CNV_R_R_Def_f_ub_b_586_CM 0. 99.60930000000001 FORMAT "%5.2"
 /begin AXIS_DESCR STD_AXIS Qv_u00 _CNV_R_R_Def_u_uw_b_689_CM 8 0. 25.4996 FORMAT "%7.4" /end AXIS_DESCR
/end CHARACTERISTIC
/begin CHARACTERISTIC KL_U00QUA_U2 "QVC U00 - Qualitätsindex U00 Einfluss Spannungsgradient" CURVE 0xa082573c _REC_CUR_TKL_UW_VV__u2_s2 99.9984 _CNV_R_R_Def_f_uw_b_555_CM 0. 99.9984
 /begin AXIS_DESCR STD_AXIS U_diff_32 _CNV_R_R_Def_f_sw_b_556_CM 5 -32. 31.999 FORMAT "%7.4" /end AXIS_DESCR
/end CHARACTERISTIC
/begin CHARACTERISTIC KL_UKRAPU "Kennlinie Minspannung Kraftstoffpumpe (abh. V_krapu)" CURVE 0xa08255d8 _REC_CUR_TKL_UW_VV__u1_u1 25.5 _CNV_R_R_Def_u_ub_q_631_CM 0. 25.5 FORMAT "%5.2"
 /begin AXIS_DESCR STD_AXIS V_krapu _CNV_R_R_Def_dez_sl_551_CM 4 0. 255. FORMAT "%3.0" /end AXIS_DESCR
/end CHARACTERISTIC
/begin CHARACTERISTIC KL_ULABHV "Lichtspannung geschwindigkeitsabhängig" CURVE 0xa08254f8 _REC_CUR_TKL_UW_VV__s1_u2 3.9843 _CNV_R_R_Def_f_sb_b_669_CM -2. 1.9843 FORMAT "%5.2"
 /begin AXIS_DESCR STD_AXIS NO_INPUT_QUANTITY _CNV_R_R_Def_v_uw_q_726_CM 5 0. 360. FORMAT "%5.0" /end AXIS_DESCR
/end CHARACTERISTIC
/begin CHARACTERISTIC KL_VBUMTL "KEnnlinie thermische Oberspannung" CURVE 0xa08255c4 _REC_CUR_TKL_UW_VV__s2_s2 99.83843999999999 _CNV_R_R_Def_u_sw_b_581_CM -128. 127.996
 /begin AXIS_DESCR STD_AXIS Tumg _CNV_R_R_Def_t_sw_q_578_CM 4 -3276.8 3276.7 FORMAT "%4.1" /end AXIS_DESCR
/end CHARACTERISTIC
/begin CHARACTERISTIC KL_ZK_TZYLKOR "" CURVE 0xa0833164 _REC_CUR_TKL_UW_VV__u2_s2 0.9999 _CNV_R_R_Def_f_uw_b_571_CM 0. 0.9999 FORMAT "%14.5"
 /begin AXIS_DESCR STD_AXIS Nkw _CNV_R_R_Def_n_sw_q_595_CM 8 -32768. 32767. FORMAT "%5.0" /end AXIS_DESCR
/end CHARACTERISTIC
/begin CHARACTERISTIC K_BANKSELEK_EISY "Drehzahlschwelle für eisy bankweise zu berechnen." VALUE 0xa081e85a _REC_VAL_20_s2 0. _CNV_R_R_Def_n_sw_q_595_CM -32768. 32767. FORMAT "%5.0" /end CHARACTERISTIC
/begin CHARACTERISTIC K_BANKSELEK_EISYHYS "Hysterese für eisy bankweise zu berechnen." VALUE 0xa081e85c _REC_VAL_20_s2 0. _CNV_R_R_Def_n_sw_q_595_CM -32768. 32767. FORMAT "%5.0" /end CHARACTERISTIC
/begin CHARACTERISTIC K_BATTORT2_LOC "Batterieeinbauort für ULCP" VALUE 0xa082551c _REC_VAL_20_u1 99.45 _CNV_R_R_Def_dez_sl_551_CM 0. 255. FORMAT "%3.0" /end CHARACTERISTIC
/begin CHARACTERISTIC K_BKVVERZ "Verzögerung Bremsunterdruck" VALUE 0xa0819339 _REC_VAL_20_u1 7. _CNV_R_R_Def_dez_sl_551_CM 0. 7. FORMAT "%3.0" /end CHARACTERISTIC
/begin CHARACTERISTIC K_BLSVERZ "Verzögerungszeit Druckaufbau" VALUE 0xa0819338 _REC_VAL_20_u1 25.5 _CNV_R_R_Def_td_ub__574_CM 0. 25.5 FORMAT "%4.1" /end CHARACTERISTIC
/begin CHARACTERISTIC K_BNQ_1 "Konstante" VALUE 0xa082548a _REC_VAL_20_u1 99.45 _CNV_R_R_Def_dez_sl_551_CM 0. 255. FORMAT "%3.0" /end CHARACTERISTIC
/begin CHARACTERISTIC K_BNQ_2 "Konstante" VALUE 0xa082548b _REC_VAL_20_u1 99.45 _CNV_R_R_Def_dez_sl_551_CM 0. 255. FORMAT "%3.0" /end CHARACTERISTIC
/begin CHARACTERISTIC K_BNQ_3 "Konstante" VALUE 0xa082548c _REC_VAL_20_u1 99.45 _CNV_R_R_Def_dez_sl_551_CM 0. 255. FORMAT "%3.0" /end CHARACTERISTIC
/begin CHARACTERISTIC K_BNQ_4 "Konstante" VALUE 0xa082548d _REC_VAL_20_u1 99.45 _CNV_R_R_Def_dez_sl_551_CM 0. 255. FORMAT "%3.0" /end CHARACTERISTIC
/begin CHARACTERISTIC K_BNSCTRINC "Konstante Counter Bordnetzspannungsplausibilisierung" VALUE 0xa082548e _REC_VAL_20_u1 99.45 _CNV_R_R_Def_dez_sl_551_CM 0. 255. FORMAT "%3.0" /end CHARACTERISTIC
/begin CHARACTERISTIC K_BNSMX "Schwelle Bordnetz instabil" VALUE 0xa082548f _REC_VAL_20_u1 99.45 _CNV_R_R_Def_dez_sl_551_CM 0. 255. FORMAT "%3.0" /end CHARACTERISTIC
/begin CHARACTERISTIC K_BNSUBMAX "Konstante max. Bordnetzspannung" VALUE 0xa0825490 _REC_VAL_20_u1 24.021 _CNV_R_R_Def_u_sb_q_583_CM 0. 24.021 FORMAT "%7.4" /end CHARACTERISTIC
/begin CHARACTERISTIC K_BNSUBMIN "Konstante min. Bordnetzspannung" VALUE 0xa0825491 _REC_VAL_20_u1 24.021 _CNV_R_R_Def_u_sb_q_583_CM 0. 24.021 FORMAT "%7.4" /end CHARACTERISTIC
/begin CHARACTERISTIC K_BNSVFZG "Schwelle geschwindigkeit für BNS" VALUE 0xa0825448 _REC_VAL_20_u2 0. _CNV_R_R_Def_v_uw_q_726_CM 0. 65535. FORMAT "%5.0" /end CHARACTERISTIC
/begin CHARACTERISTIC K_DELAYDOWN "" VALUE 0xa0825530 _REC_VAL_20_u2 0. _CNV_R_R_Def_dez_sl_551_CM 1. 65535. FORMAT "%5.0" /end CHARACTERISTIC
/begin CHARACTERISTIC K_DELAYUP "" VALUE 0xa0825532 _REC_VAL_20_u2 0. _CNV_R_R_Def_dez_sl_551_CM 1. 65535. FORMAT "%5.0" /end CHARACTERISTIC
/begin CHARACTERISTIC K_DFFGEN_MX "Maximalwert DF für Berechnung Leitungswiderstand" VALUE 0xa082551d _REC_VAL_20_u1 99.60930000000001 _CNV_R_R_Def_f_ub_b_586_CM 0. 99.60930000000001 FORMAT "%5.2" /end CHARACTERISTIC
/begin CHARACTERISTIC K_DFGRENZSPGW "Kein Langbezeichner vergeben" VALUE 0xa0825492 _REC_VAL_20_u1 99.60930000000001 _CNV_R_R_Def_f_ub_b_586_CM 0. 99.60930000000001 FORMAT "%5.2" /end CHARACTERISTIC
/begin CHARACTERISTIC K_DLT_TMKOR "" VALUE 0xa083313e _REC_VAL_20_s2 98.30250000000001 _CNV_R_R_Def_t_sw_q_579_CM -327.68 327.67 FORMAT "%5.2" /end CHARACTERISTIC
/begin CHARACTERISTIC K_DPBKV_MN "minimaler Bremsunterdruck" VALUE 0xa0819342 _REC_VAL_20_u2 102.398436 _CNV_R_R_Def_p_sw_q_576_CM 0. 2559.9609 FORMAT "%5.2" /end CHARACTERISTIC
/begin CHARACTERISTIC K_DPVDKDS_MN "Pvdkds MIN Scwelle, Stionär Betrieb zu erkennen" VALUE 0xa081e838 _REC_VAL_20_s2 102.398436 _CNV_R_R_Def_p_sw_q_576_CM -1280. 1279.9609 FORMAT "%5.2" /end CHARACTERISTIC
/begin CHARACTERISTIC K_DPVDKDS_MX "Pvdkds MAX Scwelle, Stionär Betrieb zu erkennen" VALUE 0xa081e836 _REC_VAL_20_s2 102.398436 _CNV_R_R_Def_p_sw_q_576_CM -1280. 1279.9609 FORMAT "%5.2" /end CHARACTERISTIC
/begin CHARACTERISTIC K_DSCUMN "DSC Minspannung" VALUE 0xa0825588 _REC_VAL_20_u1 25.5 _CNV_R_R_Def_u_ub_q_631_CM 0. 25.5 FORMAT "%5.2" /end CHARACTERISTIC
/begin CHARACTERISTIC K_DSCUMX "DSC Maxspannung" VALUE 0xa0825589 _REC_VAL_20_u1 25.5 _CNV_R_R_Def_u_ub_q_631_CM 0. 25.5 FORMAT "%5.2" /end CHARACTERISTIC
/begin CHARACTERISTIC K_DTBL "Kein Langbezeichner vergeben" VALUE 0xa082544a _REC_VAL_20_u2 131.07 _CNV_R_R_Def_td_ub__574_CM 0. 6553.5 FORMAT "%4.1" /end CHARACTERISTIC
/begin CHARACTERISTIC K_DTELUE "Kein Langbezeichner vergeben" VALUE 0xa082544c _REC_VAL_20_u2 131.07 _CNV_R_R_Def_td_ub__574_CM 0. 6553.5 FORMAT "%4.1" /end CHARACTERISTIC
/begin CHARACTERISTIC K_DTEWP "Kein Langbezeichner vergeben" VALUE 0xa082544e _REC_VAL_20_u2 131.07 _CNV_R_R_Def_td_ub__574_CM 0. 6553.5 FORMAT "%4.1" /end CHARACTERISTIC
/begin CHARACTERISTIC K_DT_EPS "Kein Langbezeichner vergeben" VALUE 0xa0825450 _REC_VAL_20_u2 98.30250000000001 _CNV_R_R_Def_td_uw__673_CM 0. 655.35 FORMAT "%5.2" /end CHARACTERISTIC
/begin CHARACTERISTIC K_DT_GEBL "Kein Langbezeichner vergeben" VALUE 0xa0825452 _REC_VAL_20_u2 98.30250000000001 _CNV_R_R_Def_td_uw__673_CM 0. 655.35 FORMAT "%5.2" /end CHARACTERISTIC
/begin CHARACTERISTIC K_DT_KRAPU "Kein Langbezeichner vergeben" VALUE 0xa0825454 _REC_VAL_20_u2 98.30250000000001 _CNV_R_R_Def_td_uw__673_CM 0. 655.35 FORMAT "%5.2" /end CHARACTERISTIC
/begin CHARACTERISTIC K_DT_LICHT "Kein Langbezeichner vergeben" VALUE 0xa0825456 _REC_VAL_20_u2 98.30250000000001 _CNV_R_R_Def_td_uw__673_CM 0. 655.35 FORMAT "%5.2" /end CHARACTERISTIC
/begin CHARACTERISTIC K_DT_SLP "Kein Langbezeichner vergeben" VALUE 0xa0825458 _REC_VAL_20_u2 98.30250000000001 _CNV_R_R_Def_td_uw__673_CM 0. 655.35 FORMAT "%5.2" /end CHARACTERISTIC
/begin CHARACTERISTIC K_DT_VBRES1 "Kein Langbezeichner vergeben" VALUE 0xa082545a _REC_VAL_20_u2 131.07 _CNV_R_R_Def_td_ub__574_CM 0. 6553.5 FORMAT "%4.1" /end CHARACTERISTIC
/begin CHARACTERISTIC K_DT_VBRES2 "Kein Langbezeichner vergeben" VALUE 0xa082545c _REC_VAL_20_u2 131.07 _CNV_R_R_Def_td_ub__574_CM 0. 6553.5 FORMAT "%4.1" /end CHARACTERISTIC
/begin CHARACTERISTIC K_DT_VBRES3 "Kein Langbezeichner vergeben" VALUE 0xa082545e _REC_VAL_20_u2 131.07 _CNV_R_R_Def_td_ub__574_CM 0. 6553.5 FORMAT "%4.1" /end CHARACTERISTIC
/begin CHARACTERISTIC K_DT_VBRES4 "Kein Langbezeichner vergeben" VALUE 0xa0825460 _REC_VAL_20_u2 131.07 _CNV_R_R_Def_td_ub__574_CM 0. 6553.5 FORMAT "%4.1" /end CHARACTERISTIC
/begin CHARACTERISTIC K_DT_VBRES5 "Kein Langbezeichner vergeben" VALUE 0xa0825462 _REC_VAL_20_u2 131.07 _CNV_R_R_Def_td_ub__574_CM 0. 6553.5 FORMAT "%4.1" /end CHARACTERISTIC
/begin CHARACTERISTIC K_DT_WISCHER "Kein Langbezeichner vergeben" VALUE 0xa0825464 _REC_VAL_20_u2 98.30250000000001 _CNV_R_R_Def_td_uw__673_CM 0. 655.35 FORMAT "%5.2" /end CHARACTERISTIC
/begin CHARACTERISTIC K_D_SUMMAND "QVC U00 - Summand zur Ruhezeitberechnung" VALUE 0xa08256a0 _REC_VAL_20_u2 0. _CNV_R_R_Def_td_ub__611_CM 0. 65535. FORMAT "%5.0" /end CHARACTERISTIC
/begin CHARACTERISTIC K_D_URUHE "QVC U00 - Bewertung Ruhezeit" VALUE 0xa0825690 _REC_VAL_20_s2 98.30250000000001 _CNV_R_R_Def_lf_ub__670_CM -327.68 327.67 FORMAT "%5.2" /end CHARACTERISTIC
/begin CHARACTERISTIC K_EISY_SEG2SCHW "Zweite Drehzahlschwelle für eisy segment task laufzeit opt." VALUE 0xa081e848 _REC_VAL_20_s2 0. _CNV_R_R_Def_n_sw_q_595_CM -32768. 32767. FORMAT "%5.0" /end CHARACTERISTIC
/begin CHARACTERISTIC K_EISY_SEGSCHW "Drehzahlschwelle für eisy segment task laufzeit opt." VALUE 0xa081e846 _REC_VAL_20_s2 0. _CNV_R_R_Def_n_sw_q_595_CM -32768. 32767. FORMAT "%5.0" /end CHARACTERISTIC
/begin CHARACTERISTIC K_ENTLMAX "" VALUE 0xa0825534 _REC_VAL_20_u2 0. _CNV_R_R_Def_dez_sl_551_CM 0. 65535. FORMAT "%5.0" /end CHARACTERISTIC
/begin CHARACTERISTIC K_ENTLTEST "" VALUE 0xa082553a _REC_VAL_20_u1 99.45 _CNV_R_R_Def_dez_sl_551_CM 0. 255. FORMAT "%3.0" /end CHARACTERISTIC
/begin CHARACTERISTIC K_EPSUMN "EPS Minspannung" VALUE 0xa082558a _REC_VAL_20_u1 25.5 _CNV_R_R_Def_u_ub_q_631_CM 0. 25.5 FORMAT "%5.2" /end CHARACTERISTIC
/begin CHARACTERISTIC K_EPS_TRST "Kein Langbezeichner vergeben" VALUE 0xa0825466 _REC_VAL_20_u2 98.30250000000001 _CNV_R_R_Def_td_uw__673_CM 0. 655.35 FORMAT "%5.2" /end CHARACTERISTIC
/begin CHARACTERISTIC K_EPS_VMAX "Maximalschwelle V für Auswertung EPS Aktivität" VALUE 0xa0825586 _REC_VAL_20_u2 0. _CNV_R_R_Def_v_uw_q_726_CM 0. 65535. FORMAT "%5.0" /end CHARACTERISTIC
/begin CHARACTERISTIC K_EPS_VRST "Geschwindigkeitsschwelle zum Rücksetzen der EPS Bedingung" VALUE 0xa0825468 _REC_VAL_20_u2 0. _CNV_R_R_Def_v_uw_q_726_CM 0. 65535. FORMAT "%5.0" /end CHARACTERISTIC
/begin CHARACTERISTIC K_GEBLAKT " um Spannung und Prios zu testen" VALUE 0xa082558b _REC_VAL_20_u1 1. _CNV_R_R_Def_dez_sl_551_CM 0. 1. FORMAT "%3.0" /end CHARACTERISTIC
/begin CHARACTERISTIC K_GEBLDUNMX "Maxspannung neg Gradient Gebläse" VALUE 0xa082558c _REC_VAL_20_u1 0.498 _CNV_R_R_Def_u_ub_b_721_CM 0. 0.498 FORMAT "%7.4" /end CHARACTERISTIC
/begin CHARACTERISTIC K_GEBLDUPMX "Maxspannung pos Gradient Gebläse" VALUE 0xa082558d _REC_VAL_20_u1 0.498 _CNV_R_R_Def_u_ub_b_721_CM 0. 0.498 FORMAT "%7.4" /end CHARACTERISTIC
/begin CHARACTERISTIC K_GEBLUMN "Minspannung Gebläse" VALUE 0xa082558e _REC_VAL_20_u1 25.5 _CNV_R_R_Def_u_ub_q_631_CM 0. 25.5 FORMAT "%5.2" /end CHARACTERISTIC
/begin CHARACTERISTIC K_ID_VBRES1 "Applikationswert ID Reserveverbraucher 1" VALUE 0xa082558f _REC_VAL_20_u1 99.45 _CNV_R_R_Def_dez_sl_551_CM 0. 255. FORMAT "%3.0" /end CHARACTERISTIC
/begin CHARACTERISTIC K_ID_VBRES2 "Applikationswert ID Reserveverbraucher 2" VALUE 0xa0825590 _REC_VAL_20_u1 99.45 _CNV_R_R_Def_dez_sl_551_CM 0. 255. FORMAT "%3.0" /end CHARACTERISTIC
/begin CHARACTERISTIC K_ID_VBRES3 "Applikationswert ID Reserveverbraucher 3" VALUE 0xa0825591 _REC_VAL_20_u1 99.45 _CNV_R_R_Def_dez_sl_551_CM 0. 255. FORMAT "%3.0" /end CHARACTERISTIC
/begin CHARACTERISTIC K_ID_VBRES4 "Applikationswert ID Reserveverbraucher 4" VALUE 0xa0825592 _REC_VAL_20_u1 99.45 _CNV_R_R_Def_dez_sl_551_CM 0. 255. FORMAT "%3.0" /end CHARACTERISTIC
/begin CHARACTERISTIC K_IGEN_MN "Minwert Generatorstrom für Berechnung Leitungswiderstand" VALUE 0xa082551e _REC_VAL_20_u1 99.06 _CNV_R_R_Def_ql_ub__573_CM 1. 255. /end CHARACTERISTIC
/begin CHARACTERISTIC K_LASTDOWN "" VALUE 0xa0825536 _REC_VAL_20_u2 0. _CNV_R_R_Def_dez_sl_551_CM 2. 65535. FORMAT "%5.0" /end CHARACTERISTIC
/begin CHARACTERISTIC K_LASTUP "" VALUE 0xa0825538 _REC_VAL_20_u2 0. _CNV_R_R_Def_dez_sl_551_CM 2. 65535. FORMAT "%5.0" /end CHARACTERISTIC
/begin CHARACTERISTIC K_LICHTAKT " um Spannung und Prios zu testen" VALUE 0xa0825593 _REC_VAL_20_u1 1. _CNV_R_R_Def_dez_sl_551_CM 0. 1. FORMAT "%3.0" /end CHARACTERISTIC
/begin CHARACTERISTIC K_LICHTDUNMX "Maxspannung neg Gradient Licht" VALUE 0xa0825594 _REC_VAL_20_u1 0.498 _CNV_R_R_Def_u_ub_b_721_CM 0. 0.498 FORMAT "%7.4" /end CHARACTERISTIC
/begin CHARACTERISTIC K_LICHTDUPMX "Maxspannung pos Gradient Licht" VALUE 0xa0825595 _REC_VAL_20_u1 0.498 _CNV_R_R_Def_u_ub_b_721_CM 0. 0.498 FORMAT "%7.4" /end CHARACTERISTIC
/begin CHARACTERISTIC K_LICHTUMN "Minspannung Licht" VALUE 0xa0825596 _REC_VAL_20_u1 25.5 _CNV_R_R_Def_u_ub_q_631_CM 0. 25.5 FORMAT "%5.2" /end CHARACTERISTIC
/begin CHARACTERISTIC K_LTGPL_MN "Minimalwert plausibler Widerstandswert" VALUE 0xa0825510 _REC_VAL_20_u2 1.9999 _CNV_R_R_Def_f_uw_b_590_CM 0. 1.9999 FORMAT "%14.5" /end CHARACTERISTIC
/begin CHARACTERISTIC K_LTGPL_MX "Maximalwert plausibler Widerstandswert" VALUE 0xa0825512 _REC_VAL_20_u2 1.9999 _CNV_R_R_Def_f_uw_b_590_CM 0. 1.9999 FORMAT "%14.5" /end CHARACTERISTIC
/begin CHARACTERISTIC K_LWMIN "Mindestlenkwinkel für Reaktion auf Eps Aktivität" VALUE 0xa0825597 _REC_VAL_20_u1 99.45 _CNV_R_R_Def_dez_sl_551_CM 0. 255. FORMAT "%3.0" /end CHARACTERISTIC
/begin CHARACTERISTIC K_LZR_DOWN "Steigung für Zähler für langsame Mittelung der Bordnetzspannung" VALUE 0xa082546a _REC_VAL_20_u2 0. _CNV_R_R_Def_dez_sl_551_CM 0. 65535. FORMAT "%5.0" /end CHARACTERISTIC
/begin CHARACTERISTIC K_LZR_MAX "Grenzwert für Zähler für langsame Mittelung der Bordnetzspannung" VALUE 0xa082546c _REC_VAL_20_u2 0. _CNV_R_R_Def_dez_sl_551_CM 0. 65535. FORMAT "%5.0" /end CHARACTERISTIC
/begin CHARACTERISTIC K_LZR_UP "Kein Langbezeichner vergeben" VALUE 0xa082546e _REC_VAL_20_u2 0. _CNV_R_R_Def_dez_sl_551_CM 0. 65535. FORMAT "%5.0" /end CHARACTERISTIC
/begin CHARACTERISTIC K_MSBKV_MX "maximaler Massenstrom Bremskraftverstärker" VALUE 0xa0819340 _REC_VAL_20_u2 131.07 _CNV_R_R_Def_ml_uw__653_CM 0. 6553.5 FORMAT "%4.1" /end CHARACTERISTIC
/begin CHARACTERISTIC K_MU_ABFALL "QVC U00 - Faktor für Näherung aus Ladung" VALUE 0xa0825692 _REC_VAL_20_s2 98.30250000000001 _CNV_R_R_Def_lf_ub__670_CM -327.68 327.67 FORMAT "%5.2" /end CHARACTERISTIC
/begin CHARACTERISTIC K_MU_ANSTIEG "QVC U00 - Faktor für Näherung aus Entladung" VALUE 0xa0825694 _REC_VAL_20_s2 98.30250000000001 _CNV_R_R_Def_lf_ub__670_CM -327.68 327.67 FORMAT "%5.2" /end CHARACTERISTIC
/begin CHARACTERISTIC K_NV "" VAL_BLK 0xa0817294 _REC_VAL_2_u2 102.39842 _CNV_R_R_Def_qnv_uw_662_CM 0. 511.9921 NUMBER 7 /end CHARACTERISTIC
/begin CHARACTERISTIC K_NVGMN "" VAL_BLK 0xa0817262 _REC_VAL_2_s1 81.60000000000001 _CNV_R_R_Def_ngrd_s_661_CM -4096. 4064. FORMAT "%5.2" NUMBER 7 /end CHARACTERISTIC
/begin CHARACTERISTIC K_NVGMX "" VAL_BLK 0xa081726a _REC_VAL_2_s1 81.60000000000001 _CNV_R_R_Def_ngrd_s_661_CM -4096. 4064. FORMAT "%5.2" NUMBER 7 /end CHARACTERISTIC
/begin CHARACTERISTIC K_NVO "" VAL_BLK 0xa08172a4 _REC_VAL_2_u2 102.39842 _CNV_R_R_Def_qnv_uw_662_CM 0. 511.9921 NUMBER 7 /end CHARACTERISTIC
/begin CHARACTERISTIC K_NVV "Fz-Geschwindigkeit" VAL_BLK 0xa08172b4 _REC_VAL_2_u2 100.8 _CNV_R_R_Def_v_uw_q_726_CM 0. 360. FORMAT "%5.0" NUMBER 7 /end CHARACTERISTIC
/begin CHARACTERISTIC K_PBN_MINUS "Dekrement Spannungsqualität" VALUE 0xa0825470 _REC_VAL_20_u2 0. _CNV_R_R_Def_dez_sl_551_CM 0. 65535. FORMAT "%5.0" /end CHARACTERISTIC
/begin CHARACTERISTIC K_PBN_PLUS "Inkrement Spannungsqualität" VALUE 0xa0825472 _REC_VAL_20_u2 0. _CNV_R_R_Def_dez_sl_551_CM 0. 65535. FORMAT "%5.0" /end CHARACTERISTIC
/begin CHARACTERISTIC K_PR_BLMN "Kein Langbezeichner vergeben" VALUE 0xa0825493 _REC_VAL_20_u1 99.45 _CNV_R_R_Def_dez_sl_551_CM 0. 255. FORMAT "%3.0" /end CHARACTERISTIC
/begin CHARACTERISTIC K_PR_BNS "Konstante Sollpriorität für Bordnetzstabilität" VALUE 0xa0825494 _REC_VAL_20_u1 99.45 _CNV_R_R_Def_dez_sl_551_CM 0. 255. FORMAT "%3.0" /end CHARACTERISTIC
/begin CHARACTERISTIC K_PR_CRASHSOLL "Konstante Sollpriorität bei Crash" VALUE 0xa0825495 _REC_VAL_20_u1 99.45 _CNV_R_R_Def_dez_sl_551_CM 0. 255. FORMAT "%3.0" /end CHARACTERISTIC
/begin CHARACTERISTIC K_PR_DSCMN "Konstante Sollpriorität" VALUE 0xa0825496 _REC_VAL_20_u1 99.45 _CNV_R_R_Def_dez_sl_551_CM 0. 255. FORMAT "%3.0" /end CHARACTERISTIC
/begin CHARACTERISTIC K_PR_DSCMX "Konstante Sollpriorität" VALUE 0xa0825497 _REC_VAL_20_u1 99.45 _CNV_R_R_Def_dez_sl_551_CM 0. 255. FORMAT "%3.0" /end CHARACTERISTIC
/begin CHARACTERISTIC K_PR_ELUEMN "Kein Langbezeichner vergeben" VALUE 0xa0825498 _REC_VAL_20_u1 99.45 _CNV_R_R_Def_dez_sl_551_CM 0. 255. FORMAT "%3.0" /end CHARACTERISTIC
/begin CHARACTERISTIC K_PR_EPSUMN "Kein Langbezeichner vergeben" VALUE 0xa0825499 _REC_VAL_20_u1 99.45 _CNV_R_R_Def_dez_sl_551_CM 0. 255. FORMAT "%3.0" /end CHARACTERISTIC
/begin CHARACTERISTIC K_PR_EWPMN "Kein Langbezeichner vergeben" VALUE 0xa082549a _REC_VAL_20_u1 99.45 _CNV_R_R_Def_dez_sl_551_CM 0. 255. FORMAT "%3.0" /end CHARACTERISTIC
/begin CHARACTERISTIC K_PR_GEBLDUN "App.wert Prio Gebläse negativer Gradient, bei Gebläse aktiv" VALUE 0xa0825598 _REC_VAL_20_u1 99.45 _CNV_R_R_Def_dez_sl_551_CM 0. 255. FORMAT "%3.0" /end CHARACTERISTIC
/begin CHARACTERISTIC K_PR_GEBLDUP "App.wert Prio Gebläse positiver Gradient, bei Gebläse aktiv" VALUE 0xa0825599 _REC_VAL_20_u1 99.45 _CNV_R_R_Def_dez_sl_551_CM 0. 255. FORMAT "%3.0" /end CHARACTERISTIC
/begin CHARACTERISTIC K_PR_GEBMN "Konstante Sollpriorität" VALUE 0xa082549b _REC_VAL_20_u1 99.45 _CNV_R_R_Def_dez_sl_551_CM 0. 255. FORMAT "%3.0" /end CHARACTERISTIC
/begin CHARACTERISTIC K_PR_KRAPUMN "Kein Langbezeichner vergeben" VALUE 0xa082549c _REC_VAL_20_u1 99.45 _CNV_R_R_Def_dez_sl_551_CM 0. 255. FORMAT "%3.0" /end CHARACTERISTIC
/begin CHARACTERISTIC K_PR_LICHTDUN "Prio neg Gradient Licht" VALUE 0xa082559a _REC_VAL_20_u1 99.45 _CNV_R_R_Def_dez_sl_551_CM 0. 255. FORMAT "%3.0" /end CHARACTERISTIC
/begin CHARACTERISTIC K_PR_LICHTDUP "Prio pos Gradient Licht" VALUE 0xa082559b _REC_VAL_20_u1 99.45 _CNV_R_R_Def_dez_sl_551_CM 0. 255. FORMAT "%3.0" /end CHARACTERISTIC
/begin CHARACTERISTIC K_PR_SLPMN "Konstante Sollpriorität" VALUE 0xa082549d _REC_VAL_20_u1 99.45 _CNV_R_R_Def_dez_sl_551_CM 0. 255. FORMAT "%3.0" /end CHARACTERISTIC
/begin CHARACTERISTIC K_PR_UBNQH "Konstante Priorität" VALUE 0xa0825444 _REC_VAL_20_u1 99.45 _CNV_R_R_Def_dez_sl_551_CM 0. 255. FORMAT "%3.0" /end CHARACTERISTIC
/begin CHARACTERISTIC K_PR_UBNQL "Konstante Priorität" VALUE 0xa082549e _REC_VAL_20_u1 99.45 _CNV_R_R_Def_dez_sl_551_CM 0. 255. FORMAT "%3.0" /end CHARACTERISTIC
/begin CHARACTERISTIC K_PR_UBNQM "Konstante Priorität" VALUE 0xa082549f _REC_VAL_20_u1 99.45 _CNV_R_R_Def_dez_sl_551_CM 0. 255. FORMAT "%3.0" /end CHARACTERISTIC
/begin CHARACTERISTIC K_PR_VBRES1MN "Kein Langbezeichner vergeben" VALUE 0xa08254a0 _REC_VAL_20_u1 99.45 _CNV_R_R_Def_dez_sl_551_CM 0. 255. FORMAT "%3.0" /end CHARACTERISTIC
/begin CHARACTERISTIC K_PR_VBRES1MX "Kein Langbezeichner vergeben" VALUE 0xa08254a1 _REC_VAL_20_u1 99.45 _CNV_R_R_Def_dez_sl_551_CM 0. 255. FORMAT "%3.0" /end CHARACTERISTIC
/begin CHARACTERISTIC K_PR_VBRES2MN "Kein Langbezeichner vergeben" VALUE 0xa08254a2 _REC_VAL_20_u1 99.45 _CNV_R_R_Def_dez_sl_551_CM 0. 255. FORMAT "%3.0" /end CHARACTERISTIC
/begin CHARACTERISTIC K_PR_VBRES2MX "Kein Langbezeichner vergeben" VALUE 0xa08254a3 _REC_VAL_20_u1 99.45 _CNV_R_R_Def_dez_sl_551_CM 0. 255. FORMAT "%3.0" /end CHARACTERISTIC
/begin CHARACTERISTIC K_PR_VBRES3DUN "Prio neg Gradient Reserveverbraucher3" VALUE 0xa082559c _REC_VAL_20_u1 99.45 _CNV_R_R_Def_dez_sl_551_CM 0. 255. FORMAT "%3.0" /end CHARACTERISTIC
/begin CHARACTERISTIC K_PR_VBRES3DUP "Prio pos Gradient Reserveverbraucher3" VALUE 0xa082559d _REC_VAL_20_u1 99.45 _CNV_R_R_Def_dez_sl_551_CM 0. 255. FORMAT "%3.0" /end CHARACTERISTIC
/begin CHARACTERISTIC K_PR_VBRES3MN "Kein Langbezeichner vergeben" VALUE 0xa08254a4 _REC_VAL_20_u1 99.45 _CNV_R_R_Def_dez_sl_551_CM 0. 255. FORMAT "%3.0" /end CHARACTERISTIC
/begin CHARACTERISTIC K_PR_VBRES3MX "Kein Langbezeichner vergeben" VALUE 0xa08254a5 _REC_VAL_20_u1 99.45 _CNV_R_R_Def_dez_sl_551_CM 0. 255. FORMAT "%3.0" /end CHARACTERISTIC
/begin CHARACTERISTIC K_PR_VBRES4DUN "Prio neg Gradient Reserveverbraucher 4" VALUE 0xa082559e _REC_VAL_20_u1 99.45 _CNV_R_R_Def_dez_sl_551_CM 0. 255. FORMAT "%3.0" /end CHARACTERISTIC
/begin CHARACTERISTIC K_PR_VBRES4DUP "Prio pos Gradient Reserveverbraucher 4" VALUE 0xa082559f _REC_VAL_20_u1 99.45 _CNV_R_R_Def_dez_sl_551_CM 0. 255. FORMAT "%3.0" /end CHARACTERISTIC
/begin CHARACTERISTIC K_PR_VBRES4MN "Kein Langbezeichner vergeben" VALUE 0xa08254a6 _REC_VAL_20_u1 99.45 _CNV_R_R_Def_dez_sl_551_CM 0. 255. FORMAT "%3.0" /end CHARACTERISTIC
/begin CHARACTERISTIC K_PR_VBRES4MX "Kein Langbezeichner vergeben" VALUE 0xa08254a7 _REC_VAL_20_u1 99.45 _CNV_R_R_Def_dez_sl_551_CM 0. 255. FORMAT "%3.0" /end CHARACTERISTIC
/begin CHARACTERISTIC K_PR_VBRES5MN "Kein Langbezeichner vergeben" VALUE 0xa08254a8 _REC_VAL_20_u1 99.45 _CNV_R_R_Def_dez_sl_551_CM 0. 255. FORMAT "%3.0" /end CHARACTERISTIC
/begin CHARACTERISTIC K_PR_VBRES5MX "Kein Langbezeichner vergeben" VALUE 0xa08254a9 _REC_VAL_20_u1 99.45 _CNV_R_R_Def_dez_sl_551_CM 0. 255. FORMAT "%3.0" /end CHARACTERISTIC
/begin CHARACTERISTIC K_PR_VBTHERM "Prio-Applikationswert bei thermischer überspannung" VALUE 0xa08255a0 _REC_VAL_20_u1 99.45 _CNV_R_R_Def_dez_sl_551_CM 0. 255. FORMAT "%3.0" /end CHARACTERISTIC
/begin CHARACTERISTIC K_PR_WISMN "Konstante Sollpriorität" VALUE 0xa08254aa _REC_VAL_20_u1 99.45 _CNV_R_R_Def_dez_sl_551_CM 0. 255. FORMAT "%3.0" /end CHARACTERISTIC
/begin CHARACTERISTIC K_PR_WISMX "Konstante Sollpriorität" VALUE 0xa08254ab _REC_VAL_20_u1 99.45 _CNV_R_R_Def_dez_sl_551_CM 0. 255. FORMAT "%3.0" /end CHARACTERISTIC
/begin CHARACTERISTIC K_PT1RLTG_K "Filterzeitkonstante für PT1 Filter Widerstand" VALUE 0xa0825514 _REC_VAL_20_u2 0. _CNV_R_R_Def_dez_sl_551_CM 0. 65535. FORMAT "%5.0" /end CHARACTERISTIC
/begin CHARACTERISTIC K_QVCTIM1 "QVC MessdatenAkq - Zeitschwelle auf Start" VALUE 0xa0825672 _REC_VAL_20_u2 131.07 _CNV_R_R_Def_td_ub__574_CM 0. 6553.5 FORMAT "%4.1" /end CHARACTERISTIC
/begin CHARACTERISTIC K_QVCTIM2 "QVC MessdatenAkq - Timeout Startup Kommunikation" VALUE 0xa0825674 _REC_VAL_20_u2 131.07 _CNV_R_R_Def_td_ub__574_CM 0. 6553.5 FORMAT "%4.1" /end CHARACTERISTIC
/begin CHARACTERISTIC K_QVCTIM3 "QVC MessdatenAkq - Timeout Startwert Array übertragen" VALUE 0xa0825676 _REC_VAL_20_u2 131.07 _CNV_R_R_Def_td_ub__574_CM 0. 6553.5 FORMAT "%4.1" /end CHARACTERISTIC
/begin CHARACTERISTIC K_QVCTIM4 "QVC MessdatenAkq - Timeout Messwerte einlesen" VALUE 0xa0825678 _REC_VAL_20_u2 131.07 _CNV_R_R_Def_td_ub__574_CM 0. 6553.5 FORMAT "%4.1" /end CHARACTERISTIC
/begin CHARACTERISTIC K_QVH2OBAS "Grundrate Wasserverbrauch" VALUE 0xa08257d6 _REC_VAL_20_u2 30.7195 _CNV_R_R_Def_f_uw_q_701_CM 0. 30.7195 FORMAT "%7.4" /end CHARACTERISTIC
/begin CHARACTERISTIC K_QVH2OEM "Grenzwert, den der Wasserverbrauch überschreiten muss, damit B_qvch2o gesetzt wird." VALUE 0xa08257d8 _REC_VAL_20_u2 63.99900000000001 _CNV_R_R_Def_f_uw_b_617_CM 0. 63.999 FORMAT "%7.4" /end CHARACTERISTIC
/begin CHARACTERISTIC K_QVH2OQEM "Grenzwert, den Qv_h2oquali nicht überschreiten darf. Sonst wird B_qvch2o nicht gesetzt." VALUE 0xa08257db _REC_VAL_20_u1 99.60930000000001 _CNV_R_R_Def_f_ub_b_586_CM 0. 99.60930000000001 FORMAT "%5.2" /end CHARACTERISTIC
/begin CHARACTERISTIC K_QVH2OQVOS "Offset Qv (Kapazitätsverlust) - ohne Einheit" VALUE 0xa08257da _REC_VAL_20_s1 99.45 _CNV_R_R_Def_f_sb_b_584_CM -64. 63.5 FORMAT "%5.2" /end CHARACTERISTIC
/begin CHARACTERISTIC K_QVH2OSOCB "SoC_Base" VALUE 0xa08257dc _REC_VAL_20_u1 93.35930000000001 _CNV_R_R_Def_f_ub_b_586_CM 6.25 99.60930000000001 FORMAT "%5.2" /end CHARACTERISTIC
/begin CHARACTERISTIC K_QVH2O_BT "Ermittlung des Batterietyps aus der Variablen Batt_class" VAL_BLK 0xa08257e0 _REC_VAL_2_u1 99.45 _CNV_R_R_Def_dez_sl_551_CM 0. 255. FORMAT "%3.0" NUMBER 8 /end CHARACTERISTIC
/begin CHARACTERISTIC K_QVK20 "QVC Ini - Nennkapazitäten Batterien (Array)" VAL_BLK 0xa0825704 _REC_VAL_2_u1 99.45 _CNV_R_R_Def_ql_ub__573_CM 0. 255. FORMAT "%4.1" NUMBER 8 /end CHARACTERISTIC
/begin CHARACTERISTIC K_QVK20OFS "QVC Ini - Abweichung Nennkapazitäten Batterien (Array)" VAL_BLK 0xa08256fc _REC_VAL_2_u1 99.45 _CNV_R_R_Def_ql_ub__573_CM 0. 255. FORMAT "%4.1" NUMBER 8 /end CHARACTERISTIC
/begin CHARACTERISTIC K_QVMAXTGRD "QVC MessdatenAkq - Maximale Batterietemperatur Gradient" VALUE 0xa0825668 _REC_VAL_20_s2 131.07 _CNV_R_R_Def_t_sw_q_578_CM -3276.8 3276.7 FORMAT "%4.1" /end CHARACTERISTIC
/begin CHARACTERISTIC K_QVMINVAL "QVC MessdatenAkq - Minimale Zahl Start-Wertepaare" VALUE 0xa082567e _REC_VAL_20_u1 99.45 _CNV_R_R_Def_dez_sl_551_CM 0. 255. FORMAT "%3.0" /end CHARACTERISTIC
/begin CHARACTERISTIC K_QVOUTM_DEF "Parameter zum manuellen Setzen der Größe Qv_out_m" VALUE 0xa0825964 _REC_VAL_20_u2 131.07 _CNV_R_R_Def_td_ub__574_CM 0. 6553.5 FORMAT "%4.1" /end CHARACTERISTIC
/begin CHARACTERISTIC K_QVQM_DEF "Parameter zum manuellen Setzen der Größe Qv_quali_m" VALUE 0xa0825976 _REC_VAL_20_u1 99.60930000000001 _CNV_R_R_Def_f_ub_b_586_CM 0. 99.60930000000001 FORMAT "%5.2" /end CHARACTERISTIC
/begin CHARACTERISTIC K_QVQ_AUSMX "Maximale Anzahl von Ausreißern die zur Sprungerkennung nötig sind" VALUE 0xa082596a _REC_VAL_20_u1 6. _CNV_R_R_Def_dez_sl_551_CM 0. 6. FORMAT "%3.0" /end CHARACTERISTIC
/begin CHARACTERISTIC K_QVQ_BFMX "Maximale Größe des Betrachtungsfensters" VALUE 0xa082596b _REC_VAL_20_u1 99.45 _CNV_R_R_Def_dez_sl_551_CM 0. 255. FORMAT "%3.0" /end CHARACTERISTIC
/begin CHARACTERISTIC K_QVQ_CL "Faktor zur Berechnung der Qvm-Toleranzgrenzen" VALUE 0xa0825966 _REC_VAL_20_u2 65.535 _CNV_R_R_Def_td_uw__663_CM 0. 65.535 /end CHARACTERISTIC
/begin CHARACTERISTIC K_QVQ_CLR "Faktor zur Berechnung der Streugrenzen" VALUE 0xa0825968 _REC_VAL_20_u2 65.535 _CNV_R_R_Def_td_uw__663_CM 0. 65.535 /end CHARACTERISTIC
/begin CHARACTERISTIC K_QVQ_DELAY "Verzögerung, mit welcher Backup-Werte nach Flaschvorgang eingelesen werden." VALUE 0xa082596c _REC_VAL_20_u1 2.55 _CNV_R_R_Def_td_uw__673_CM 0. 2.55 FORMAT "%5.2" /end CHARACTERISTIC
/begin CHARACTERISTIC K_QVQ_QAUS "Faktor zur Anhebung der Qualität" VALUE 0xa082596d _REC_VAL_20_u1 15.9375 _CNV_R_R_Def_f_ub_b_743_CM 0. 15.9375 FORMAT "%5.2" /end CHARACTERISTIC
/begin CHARACTERISTIC K_QVQ_SFMX "Maximale Größe des Sprungfensters (Betrachtungsfenster zur Sprungerkennung)" VALUE 0xa082596e _REC_VAL_20_u1 99.45 _CNV_R_R_Def_dez_sl_551_CM 0. 255. FORMAT "%3.0" /end CHARACTERISTIC
/begin CHARACTERISTIC K_QVQ_SZE "Ab dieser Zeit hat die Reduzierung der Qualität aufgrund der langen Satndzeit ihr Maximum erreicht" VALUE 0xa0825970 _REC_VAL_20_u2 0. _CNV_R_R_Def_th_uw__699_CM 0. 65535. FORMAT "%5.0" /end CHARACTERISTIC
/begin CHARACTERISTIC K_QVQ_SZMX "Maximale Zeit nach der eine lange Standzeit dedektiert wird" VALUE 0xa0825972 _REC_VAL_20_u2 0. _CNV_R_R_Def_th_uw__699_CM 0. 65535. FORMAT "%5.0" /end CHARACTERISTIC
/begin CHARACTERISTIC K_QVQ_SZS "Ab dieser Zeit erfolgt die Reduzierung der Qualität aufgrund der langen Standzeit" VALUE 0xa0825974 _REC_VAL_20_u2 0. _CNV_R_R_Def_th_uw__699_CM 0. 65535. FORMAT "%5.0" /end CHARACTERISTIC
/begin CHARACTERISTIC K_QVQ_TEST1 "Parameter für manuelle Beeinflussung " VALUE 0xa082596f _REC_VAL_20_u1 99.45 _CNV_R_R_Def_dez_sl_551_CM 0. 255. FORMAT "%3.0" /end CHARACTERISTIC
/begin CHARACTERISTIC K_QVQ_TGMX "Maximale Aufweitung der Qvm-Toleranzgrenzen" VALUE 0xa0825977 _REC_VAL_20_u1 99.45 _CNV_R_R_Def_dez_sl_551_CM 0. 255. FORMAT "%3.0" /end CHARACTERISTIC
/begin CHARACTERISTIC K_QVRA "QVC Ini - Batterieparameter A (Array)" VAL_BLK 0xa08256ac _REC_VAL_2_s4 0. _CNV_R_R_Def_u_sl_b_697_CM -32768. 32767. FORMAT "%5.2" NUMBER 8 /end CHARACTERISTIC
/begin CHARACTERISTIC K_QVRB "QVC Ini - Batterieparameter B (Array)" VAL_BLK 0xa08256ec _REC_VAL_2_s2 3.9999 _CNV_R_R_Def_f_sw_b_616_CM -2. 1.9999 FORMAT "%14.5" NUMBER 8 /end CHARACTERISTIC
/begin CHARACTERISTIC K_QVRC "QVC Ini - Batterieparameter C (Array)" VAL_BLK 0xa08256cc _REC_VAL_2_s4 0. _CNV_R_R_Def_u_sl_b_697_CM -131072. 131071.9999 FORMAT "%5.2" NUMBER 8 /end CHARACTERISTIC
/begin CHARACTERISTIC K_QVTLIMHI "QVC MessdatenAkq - obere Temperaturschwelle" VALUE 0xa0825696 _REC_VAL_20_s2 131.07 _CNV_R_R_Def_t_sw_q_578_CM -3276.8 3276.7 FORMAT "%4.1" /end CHARACTERISTIC
/begin CHARACTERISTIC K_QVTLIMLO "QVC MessdatenAkq - untere Temperaturschwelle" VALUE 0xa0825698 _REC_VAL_20_s2 131.07 _CNV_R_R_Def_t_sw_q_578_CM -3276.8 3276.7 FORMAT "%4.1" /end CHARACTERISTIC
/begin CHARACTERISTIC K_QVVLIMHI "QVC MessdatenAkq - U00 Spannungsschwelle Hi" VALUE 0xa08256a2 _REC_VAL_20_u2 16.3837 _CNV_R_R_Def_u_uw_q_700_CM 6. 22.3837 FORMAT "%7.4" /end CHARACTERISTIC
/begin CHARACTERISTIC K_QVVLIMLO "QVC MessdatenAkq - U00 untere Spannungsschwelle (SOC = 30%)" VALUE 0xa08256a4 _REC_VAL_20_u2 16.3837 _CNV_R_R_Def_u_uw_q_700_CM 6. 22.3837 FORMAT "%7.4" /end CHARACTERISTIC
/begin CHARACTERISTIC K_QV_DELAY "Verzögerung, mit welcher Backup-Werte nach Flaschvorgang eingelesen werden." VALUE 0xa08257d4 _REC_VAL_20_u1 2.55 _CNV_R_R_Def_td_uw__673_CM 0. 2.55 FORMAT "%5.2" /end CHARACTERISTIC
/begin CHARACTERISTIC K_QV_DT "QVC CalcHyst - Filterfaktor" VALUE 0xa082567a _REC_VAL_20_u2 3.9998 _CNV_R_R_Def_td_uw__767_CM 1.e-004 3.9999 FORMAT "%14.5" /end CHARACTERISTIC
/begin CHARACTERISTIC K_QV_IN "QVC CalcHyst - battery current normalization value" VALUE 0xa082566a _REC_VAL_20_s2 95.92 _CNV_R_R_Def_i_sw_q_635_CM 1. 1200. /end CHARACTERISTIC
/begin CHARACTERISTIC K_QV_P0RI "QVC CalcHyst - normalized error variance of initial value of Kalman filter" VALUE 0xa082567c _REC_VAL_20_u2 9.98377799987793e-007 _CNV_R_R_Def_f_sl_b_688_CM 0. 9.98377799987793e-007 FORMAT "%5.2" /end CHARACTERISTIC
/begin CHARACTERISTIC K_QV_P0U0L "QVC CalcHyst - Initialization value for Kalman filter u01" VALUE 0xa0825658 _REC_VAL_20_s4 163.839999 _CNV_R_R_Def_f_sl_b_698_CM -8192. 8191.9999 FORMAT "%5.2" /end CHARACTERISTIC
/begin CHARACTERISTIC K_QV_RI0 "QVC CalcHyst - Initialization value for Kalman filter u01 (Array)" VAL_BLK 0xa0825680 _REC_VAL_2_u2 1.e-002 _CNV_R_R_Def_f_sw_b_616_CM 0. 1.e-002 FORMAT "%14.5" NUMBER 8 /end CHARACTERISTIC
/begin CHARACTERISTIC K_QV_RUBAT "QVC CalcHyst - normalized error variance of voltage measurement per step" VALUE 0xa082566c _REC_VAL_20_s2 1.00040435791016e-003 _CNV_R_R_Def_f_sw_b_768_CM 0. 1.00040435791016e-003 FORMAT "%5.2" /end CHARACTERISTIC
/begin CHARACTERISTIC K_QV_SCHWELLE "QVC U00 - Schwelle U_Ruhe für Fallunterscheidung ob Näherung aus Ladong oder Entladung" VALUE 0xa082569a _REC_VAL_20_s2 98.30250000000001 _CNV_R_R_Def_lf_ub__670_CM -327.68 327.67 FORMAT "%5.2" /end CHARACTERISTIC
/begin CHARACTERISTIC K_QV_TEST1 "Testgröße zum Einstellen, bedient 8 Schalter" VALUE 0xa082567f _REC_VAL_20_u1 99.45 _CNV_R_R_Def_dez_sl_551_CM 0. 255. FORMAT "%3.0" /end CHARACTERISTIC
/begin CHARACTERISTIC K_QV_TKU00 "QVC CalcHyst - temperature coefficient for offload voltage of a battery with 6 cells" VALUE 0xa082566e _REC_VAL_20_s2 0.249996185302734 _CNV_R_R_Def_f_sl_b_698_CM -0.125 0.124996185302734 FORMAT "%5.2" /end CHARACTERISTIC
/begin CHARACTERISTIC K_QV_TSTU00 "QVC CalcHyst - Test-AK Ruhespannung Ersatzwert" VALUE 0xa08256a6 _REC_VAL_20_u2 16.3837 _CNV_R_R_Def_u_uw_q_700_CM 6. 22.3837 FORMAT "%7.4" /end CHARACTERISTIC
/begin CHARACTERISTIC K_QV_U0L0 "QVC CalcHyst - normalized error varianceof initial value of Kalman filter" VALUE 0xa082565c _REC_VAL_20_s4 163.839999 _CNV_R_R_Def_f_sl_b_698_CM -8192. 8191.9999 FORMAT "%5.2" /end CHARACTERISTIC
/begin CHARACTERISTIC K_QV_UN "QVC CalcHyst - voltage normalization value" VALUE 0xa0825670 _REC_VAL_20_s2 10. _CNV_R_R_Def_f_sw_b_556_CM 6. 16. FORMAT "%7.4" /end CHARACTERISTIC
/begin CHARACTERISTIC K_RFMIN_EISY "MIN Rf aus EISY" VALUE 0xa081e840 _REC_VAL_20_s2 98.30250000000001 _CNV_R_R_Def_rf_sw__598_CM -327.68 327.67 FORMAT "%7.4" /end CHARACTERISTIC
/begin CHARACTERISTIC K_RFTDINI "Ini Wert für Rf verzögert" VALUE 0xa081e856 _REC_VAL_20_s2 98.30250000000001 _CNV_R_R_Def_rf_sw__598_CM -327.68 327.67 FORMAT "%7.4" /end CHARACTERISTIC
/begin CHARACTERISTIC K_RLEITUNGK "Widerstandswert Ladeleitung Batterie Kofferraum für ULCP" VALUE 0xa082551f _REC_VAL_20_u1 31.875 _CNV_R_R_Def_f_ub_b_612_CM 0. 31.875 FORMAT "%5.2" /end CHARACTERISTIC
/begin CHARACTERISTIC K_RLEITUNGM "Widerstandswert Ladeleitung Batterie Motorraum für ULCP" VALUE 0xa0825520 _REC_VAL_20_u1 31.875 _CNV_R_R_Def_f_ub_b_612_CM 0. 31.875 FORMAT "%5.2" /end CHARACTERISTIC
/begin CHARACTERISTIC K_RLTGPWE65 "Widerstandswert Ladeleitung für E65" VALUE 0xa0825521 _REC_VAL_20_u1 25.5 _CNV_R_R_Def_u_ub_q_631_CM 0. 25.5 FORMAT "%5.2" /end CHARACTERISTIC
/begin CHARACTERISTIC K_RLTG_KONST "Widerstandswert Ladeleitung konstant für LCP" VALUE 0xa0825516 _REC_VAL_20_u2 1.9999 _CNV_R_R_Def_f_uw_b_590_CM 0. 1.9999 FORMAT "%14.5" /end CHARACTERISTIC
/begin CHARACTERISTIC K_SLPAKT " um Spannung und Prios zu testen" VALUE 0xa08255a1 _REC_VAL_20_u1 1. _CNV_R_R_Def_dez_sl_551_CM 0. 1. FORMAT "%3.0" /end CHARACTERISTIC
/begin CHARACTERISTIC K_SLPUMN "Minspannung sekundärluftpumpe" VALUE 0xa08255a2 _REC_VAL_20_u1 25.5 _CNV_R_R_Def_u_ub_q_631_CM 0. 25.5 FORMAT "%5.2" /end CHARACTERISTIC
/begin CHARACTERISTIC K_SPGKMP12 "Kein Langbezeichner vergeben" VALUE 0xa08254ac _REC_VAL_20_u1 25.5 _CNV_R_R_Def_u_ub_q_631_CM 0. 25.5 FORMAT "%5.2" /end CHARACTERISTIC
/begin CHARACTERISTIC K_SPGKOMP1 "Konstante Spannungskompensation 1" VALUE 0xa08254ad _REC_VAL_20_u1 25.5 _CNV_R_R_Def_u_ub_q_631_CM 0. 25.5 FORMAT "%5.2" /end CHARACTERISTIC
/begin CHARACTERISTIC K_SPGKOMP10 "Konstante Spannungskompensation 10" VALUE 0xa08254ae _REC_VAL_20_u1 1.9921 _CNV_R_R_Def_f_ub_b_613_CM 0. 1.9921 /end CHARACTERISTIC
/begin CHARACTERISTIC K_SPGKOMP11 "Kein Langbezeichner vergeben" VALUE 0xa08254af _REC_VAL_20_u1 25.5 _CNV_R_R_Def_u_ub_q_631_CM 0. 25.5 FORMAT "%5.2" /end CHARACTERISTIC
/begin CHARACTERISTIC K_SPGKOMP13 "Kein Langbezeichner vergeben" VALUE 0xa08254b0 _REC_VAL_20_u1 25.5 _CNV_R_R_Def_u_ub_q_631_CM 0. 25.5 FORMAT "%5.2" /end CHARACTERISTIC
/begin CHARACTERISTIC K_SPGKOMP14 "Kein Langbezeichner vergeben" VALUE 0xa08254b1 _REC_VAL_20_u1 25.5 _CNV_R_R_Def_u_ub_q_631_CM 0. 25.5 FORMAT "%5.2" /end CHARACTERISTIC
/begin CHARACTERISTIC K_SPGKOMP15 "Kein Langbezeichner vergeben" VALUE 0xa08254b2 _REC_VAL_20_u1 25.5 _CNV_R_R_Def_u_ub_q_631_CM 0. 25.5 FORMAT "%5.2" /end CHARACTERISTIC
/begin CHARACTERISTIC K_SPGKOMP16 "Kein Langbezeichner vergeben" VALUE 0xa08254b3 _REC_VAL_20_u1 25.5 _CNV_R_R_Def_u_ub_q_631_CM 0. 25.5 FORMAT "%5.2" /end CHARACTERISTIC
/begin CHARACTERISTIC K_SPGKOMP17 "Kein Langbezeichner vergeben" VALUE 0xa08254b4 _REC_VAL_20_u1 25.5 _CNV_R_R_Def_u_ub_q_631_CM 0. 25.5 FORMAT "%5.2" /end CHARACTERISTIC
/begin CHARACTERISTIC K_SPGKOMP18 "Kein Langbezeichner vergeben" VALUE 0xa08254b5 _REC_VAL_20_u1 25.5 _CNV_R_R_Def_u_ub_q_631_CM 0. 25.5 FORMAT "%5.2" /end CHARACTERISTIC
/begin CHARACTERISTIC K_SPGKOMP19 "Kein Langbezeichner vergeben" VALUE 0xa08254b6 _REC_VAL_20_u1 25.5 _CNV_R_R_Def_u_ub_q_631_CM 0. 25.5 FORMAT "%5.2" /end CHARACTERISTIC
/begin CHARACTERISTIC K_SPGKOMP2 "Konstante Spannungskompensation 1" VALUE 0xa08254b7 _REC_VAL_20_u1 25.5 _CNV_R_R_Def_u_ub_q_631_CM 0. 25.5 FORMAT "%5.2" /end CHARACTERISTIC
/begin CHARACTERISTIC K_SPGKOMP20 "Kein Langbezeichner vergeben" VALUE 0xa08254b8 _REC_VAL_20_u1 25.5 _CNV_R_R_Def_u_ub_q_631_CM 0. 25.5 FORMAT "%5.2" /end CHARACTERISTIC
/begin CHARACTERISTIC K_SPGKOMP21 "Kein Langbezeichner vergeben" VALUE 0xa08254b9 _REC_VAL_20_u1 25.5 _CNV_R_R_Def_u_ub_q_631_CM 0. 25.5 FORMAT "%5.2" /end CHARACTERISTIC
/begin CHARACTERISTIC K_SPGKOMP22 "Kein Langbezeichner vergeben" VALUE 0xa08254ba _REC_VAL_20_u1 25.5 _CNV_R_R_Def_u_ub_q_631_CM 0. 25.5 FORMAT "%5.2" /end CHARACTERISTIC
/begin CHARACTERISTIC K_SPGKOMP23 "Kein Langbezeichner vergeben" VALUE 0xa0825445 _REC_VAL_20_u1 25.5 _CNV_R_R_Def_u_ub_q_631_CM 0. 25.5 FORMAT "%5.2" /end CHARACTERISTIC
/begin CHARACTERISTIC K_SPGKOMP24 "Kein Langbezeichner vergeben" VALUE 0xa0825446 _REC_VAL_20_u1 25.5 _CNV_R_R_Def_u_ub_q_631_CM 0. 25.5 FORMAT "%5.2" /end CHARACTERISTIC
/begin CHARACTERISTIC K_SPGKOMP25 "Kein Langbezeichner vergeben" VALUE 0xa0825447 _REC_VAL_20_u1 25.5 _CNV_R_R_Def_u_ub_q_631_CM 0. 25.5 FORMAT "%5.2" /end CHARACTERISTIC
/begin CHARACTERISTIC K_SPGKOMP4 "Konstante Spannungskompensation 1" VALUE 0xa08254bb _REC_VAL_20_u1 25.5 _CNV_R_R_Def_u_ub_q_631_CM 0. 25.5 FORMAT "%5.2" /end CHARACTERISTIC
/begin CHARACTERISTIC K_SPGKOMP5 "Konstante Spannungskompensation 1" VALUE 0xa08254bc _REC_VAL_20_u1 25.5 _CNV_R_R_Def_u_ub_q_631_CM 0. 25.5 FORMAT "%5.2" /end CHARACTERISTIC
/begin CHARACTERISTIC K_SPGKOMP6 "Konstante Spannungskompensation 1" VALUE 0xa08254bd _REC_VAL_20_u1 25.5 _CNV_R_R_Def_u_ub_q_631_CM 0. 25.5 FORMAT "%5.2" /end CHARACTERISTIC
/begin CHARACTERISTIC K_SPGKOMP8 "Konstante Spannungskompensation 1" VALUE 0xa08254be _REC_VAL_20_u1 25.5 _CNV_R_R_Def_u_ub_q_631_CM 0. 25.5 FORMAT "%5.2" /end CHARACTERISTIC
/begin CHARACTERISTIC K_SPGKOMP9 "Konstante Spannungskompensation 1" VALUE 0xa08254bf _REC_VAL_20_u1 25.5 _CNV_R_R_Def_u_ub_q_631_CM 0. 25.5 FORMAT "%5.2" /end CHARACTERISTIC
/begin CHARACTERISTIC K_SZR_DOWN "Steigung für Zähler für schnelle Mittelung der Bordnetzspannung" VALUE 0xa0825474 _REC_VAL_20_u2 0. _CNV_R_R_Def_dez_sl_551_CM 0. 65535. FORMAT "%5.0" /end CHARACTERISTIC
/begin CHARACTERISTIC K_SZR_MAX "Grenzwert für Zähler für schnelle Mittelung der Bordnetzspannung" VALUE 0xa0825476 _REC_VAL_20_u2 0. _CNV_R_R_Def_dez_sl_551_CM 0. 65535. FORMAT "%5.0" /end CHARACTERISTIC
/begin CHARACTERISTIC K_SZR_UP "Zählerinkrement für Batteriespannungswächter" VALUE 0xa0825478 _REC_VAL_20_u2 0. _CNV_R_R_Def_dez_sl_551_CM 0. 65535. FORMAT "%5.0" /end CHARACTERISTIC
/begin CHARACTERISTIC K_TANS_PST "" VALUE 0xa083313c _REC_VAL_20_s2 131.07 _CNV_R_R_Def_t_sw_q_578_CM -3276.8 3276.7 FORMAT "%4.1" /end CHARACTERISTIC
/begin CHARACTERISTIC K_TBNSDELAY "Delayzeit nach Motorstartende für BNS-Überwachung" VALUE 0xa082547a _REC_VAL_20_u2 98.30250000000001 _CNV_R_R_Def_td_uw__673_CM 0. 655.35 FORMAT "%5.2" /end CHARACTERISTIC
/begin CHARACTERISTIC K_TDGENOFFPM "Zeitverzögerung B_start für Spannung im Start Generator" VALUE 0xa0825522 _REC_VAL_20_u1 25.5 _CNV_R_R_Def_td_ub__574_CM 0. 25.5 FORMAT "%4.1" /end CHARACTERISTIC
/begin CHARACTERISTIC K_TDNVAUS "" VAL_BLK 0xa0817284 _REC_VAL_2_u2 98.30250000000001 _CNV_R_R_Def_td_uw__673_CM 0. 655.35 FORMAT "%5.2" NUMBER 7 /end CHARACTERISTIC
/begin CHARACTERISTIC K_TDNVEIN "" VAL_BLK 0xa0817274 _REC_VAL_2_u2 98.30250000000001 _CNV_R_R_Def_td_uw__673_CM 0. 655.35 FORMAT "%5.2" NUMBER 7 /end CHARACTERISTIC
/begin CHARACTERISTIC K_TD_RFSTART "" VALUE 0xa081e842 _REC_VAL_20_u2 0. _CNV_R_R_Def_dez_sl_551_CM 0. 65535. FORMAT "%5.0" /end CHARACTERISTIC
/begin CHARACTERISTIC K_TD_RFVST "" VALUE 0xa081e83a _REC_VAL_20_u2 0. _CNV_R_R_Def_dez_sl_551_CM 0. 65535. FORMAT "%5.0" /end CHARACTERISTIC
/begin CHARACTERISTIC K_TMOT_PST "" VALUE 0xa083313a _REC_VAL_20_s2 131.07 _CNV_R_R_Def_t_sw_q_578_CM -3276.8 3276.7 FORMAT "%4.1" /end CHARACTERISTIC
/begin CHARACTERISTIC K_TOL "Konstante Toleranz" VALUE 0xa08254c0 _REC_VAL_20_u1 25.5 _CNV_R_R_Def_u_ub_q_631_CM 0. 25.5 FORMAT "%5.2" /end CHARACTERISTIC
/begin CHARACTERISTIC K_TOL_LICHT1 "Konstante Toleranz Licht 1" VALUE 0xa08254c1 _REC_VAL_20_u1 25.5 _CNV_R_R_Def_u_ub_q_631_CM 0. 25.5 FORMAT "%5.2" /end CHARACTERISTIC
/begin CHARACTERISTIC K_TOL_LICHT2 "Konstante Toleranz Licht 2" VALUE 0xa08254c2 _REC_VAL_20_u1 25.5 _CNV_R_R_Def_u_ub_q_631_CM 0. 25.5 FORMAT "%5.2" /end CHARACTERISTIC
/begin CHARACTERISTIC K_TVBPAUMIN "Zeitkonstante thermische Überspannung erkannt" VALUE 0xa08255a3 _REC_VAL_20_u1 25.5 _CNV_R_R_Def_u_ub_q_631_CM 0. 25.5 FORMAT "%5.2" /end CHARACTERISTIC
/begin CHARACTERISTIC K_TVB_MX "Zeitkonstante Thermische Überspannungserkennung" VALUE 0xa08255a4 _REC_VAL_20_u1 25.5 _CNV_R_R_Def_u_ub_q_631_CM 0. 25.5 FORMAT "%5.2" /end CHARACTERISTIC
/begin CHARACTERISTIC K_TZYL_PST "" VALUE 0xa0833138 _REC_VAL_20_s2 131.07 _CNV_R_R_Def_t_sw_q_578_CM -3276.8 3276.7 FORMAT "%4.1" /end CHARACTERISTIC
/begin CHARACTERISTIC K_U00QSCHW "QVC MessdatenAkq - Schwelle fuer U00_quali" VALUE 0xa08256a8 _REC_VAL_20_u1 99.60930000000001 _CNV_R_R_Def_f_ub_b_586_CM 0. 99.60930000000001 FORMAT "%5.2" /end CHARACTERISTIC
/begin CHARACTERISTIC K_U00emptlim "QVC CalcHyst - Untergrenze U00 für SOC-Bestimmung" VALUE 0xa0825660 _REC_VAL_20_s4 163.839999 _CNV_R_R_Def_f_sl_b_698_CM -8192. 8191.9999 DISPLAY_IDENTIFIER K_U00EMPTLIM FORMAT "%5.2" /end CHARACTERISTIC
/begin CHARACTERISTIC K_U00fulloadlim "QVC CalcHyst - Obergrenze U00 für SOC-Bestimmung" VALUE 0xa0825664 _REC_VAL_20_s4 163.839999 _CNV_R_R_Def_f_sl_b_698_CM -8192. 8191.9999 DISPLAY_IDENTIFIER K_U00FULLOADLIM FORMAT "%5.2" /end CHARACTERISTIC
/begin CHARACTERISTIC K_UBDETU "Delta zwischen Batteriespannung und Batteriesollspannung ab er B_vbpau zurückgenommen wird" VALUE 0xa08255a5 _REC_VAL_20_u1 25.5 _CNV_R_R_Def_u_ub_q_631_CM 0. 25.5 FORMAT "%5.2" /end CHARACTERISTIC
/begin CHARACTERISTIC K_UBLMN "Appwert Minspanunng" VALUE 0xa082553c _REC_VAL_20_u1 25.5 _CNV_R_R_Def_u_ub_q_631_CM 0. 25.5 FORMAT "%5.2" /end CHARACTERISTIC
/begin CHARACTERISTIC K_UBNSSOLL "Konstante Sollspannung Bordnetzstabilität" VALUE 0xa08254c3 _REC_VAL_20_u1 25.5 _CNV_R_R_Def_u_ub_q_631_CM 0. 25.5 FORMAT "%5.2" /end CHARACTERISTIC
/begin CHARACTERISTIC K_UBTDETU "Zeitverzögerung Ausgabe thermische Überspannung erkannt" VALUE 0xa08255a6 _REC_VAL_20_u1 25.5 _CNV_R_R_Def_u_ub_q_631_CM 0. 25.5 FORMAT "%5.2" /end CHARACTERISTIC
/begin CHARACTERISTIC K_UBW_DELAY "Verzögerungszeit UBW" VALUE 0xa082547c _REC_VAL_20_u2 98.30250000000001 _CNV_R_R_Def_td_uw__673_CM 0. 655.35 FORMAT "%5.2" /end CHARACTERISTIC
/begin CHARACTERISTIC K_UBW_GRENZAKTUV "Grenze Spannungsqualität" VALUE 0xa082547e _REC_VAL_20_u2 0. _CNV_R_R_Def_dez_sl_551_CM 0. 65535. FORMAT "%5.0" /end CHARACTERISTIC
/begin CHARACTERISTIC K_UBW_TABL "Ablaufzeit (Reset) für Batteriespannungswächter" VALUE 0xa0825480 _REC_VAL_20_u2 0. _CNV_R_R_Def_dez_sl_551_CM 0. 65535. FORMAT "%5.0" /end CHARACTERISTIC
/begin CHARACTERISTIC K_UBW_USZRMX "Grenzwert Schwingungszähler Batteriespannungswächter" VALUE 0xa08254c4 _REC_VAL_20_u1 99.45 _CNV_R_R_Def_dez_sl_551_CM 0. 255. FORMAT "%3.0" /end CHARACTERISTIC
/begin CHARACTERISTIC K_UBW_ZKL "Schwelle für Erkennung dauerhafter Einbruch der Bordnetzspannung" VALUE 0xa0825482 _REC_VAL_20_u2 0. _CNV_R_R_Def_dez_sl_551_CM 0. 65535. FORMAT "%5.0" /end CHARACTERISTIC
/begin CHARACTERISTIC K_UBW_ZKSMN "Schwelle für Erkennung zyklischer Einbruch der Bordnetzspannung (Hysterese MN)" VALUE 0xa0825484 _REC_VAL_20_u2 0. _CNV_R_R_Def_dez_sl_551_CM 0. 65535. FORMAT "%5.0" /end CHARACTERISTIC
/begin CHARACTERISTIC K_UBW_ZKSMX "Schwelle für Erkennung zyklischer Einbruch der Bordnetzspannung (Hysterese MX)" VALUE 0xa0825486 _REC_VAL_20_u2 0. _CNV_R_R_Def_dez_sl_551_CM 0. 65535. FORMAT "%5.0" /end CHARACTERISTIC
/begin CHARACTERISTIC K_UCRASHSOLL "Konstante Sollspannung bei Crash" VALUE 0xa08254c5 _REC_VAL_20_u1 25.5 _CNV_R_R_Def_u_ub_q_631_CM 0. 25.5 FORMAT "%5.2" /end CHARACTERISTIC
/begin CHARACTERISTIC K_UDIFGENOFF "B_genoff wird gesetzt, wenn Differenz zwischen Batterie-  und Generatorspg größer diesem Wert" VALUE 0xa0825523 _REC_VAL_20_u1 4.998 _CNV_R_R_Def_u_ub_q_762_CM 0. 4.998 FORMAT "%7.4" /end CHARACTERISTIC
/begin CHARACTERISTIC K_UEPS_TOL "Toleranzschwelle Spannungseinbruch EPS" VALUE 0xa08254c6 _REC_VAL_20_u1 25.5 _CNV_R_R_Def_u_ub_q_631_CM 0. 25.5 FORMAT "%5.2" /end CHARACTERISTIC
/begin CHARACTERISTIC K_UGDELTA "Schwellwert Delta U_gen für Erkennung Stabilität" VALUE 0xa0825524 _REC_VAL_20_u1 25.5 _CNV_R_R_Def_u_ub_q_631_CM 0. 25.5 FORMAT "%5.2" /end CHARACTERISTIC
/begin CHARACTERISTIC K_UGENDELTA "Generatorspannungsdelta zwischen Master und Slave Generator" VALUE 0xa0825518 _REC_VAL_20_u2 131.07 _CNV_R_R_Def_u_ub_q_631_CM 0. 6553.5 /end CHARACTERISTIC
/begin CHARACTERISTIC K_UGENMAX "Maximalwert Ausgabe U_gen" VALUE 0xa0825525 _REC_VAL_20_u1 25.5 _CNV_R_R_Def_u_ub_q_631_CM 0. 25.5 FORMAT "%5.2" /end CHARACTERISTIC
/begin CHARACTERISTIC K_UGENMIN "Minimalwert Ausgabe U_gen" VALUE 0xa0825526 _REC_VAL_20_u1 25.5 _CNV_R_R_Def_u_ub_q_631_CM 0. 25.5 FORMAT "%5.2" /end CHARACTERISTIC
/begin CHARACTERISTIC K_UGENOFFPM "Spannung im Start Generator" VALUE 0xa082551a _REC_VAL_20_u2 131.07 _CNV_R_R_Def_u_ub_q_631_CM 0. 6553.5 /end CHARACTERISTIC
/begin CHARACTERISTIC K_UGTOD "Entprellzeit für Stabilität U_gen" VALUE 0xa0825527 _REC_VAL_20_u1 99.45 _CNV_R_R_Def_td_ub__777_CM 0. 127.5 /end CHARACTERISTIC
/begin CHARACTERISTIC K_UKOMPK "Konstantwert Spngsabfall Kofferr bei Generatorfehler für ULCP" VALUE 0xa0825528 _REC_VAL_20_u1 25.5 _CNV_R_R_Def_u_ub_q_631_CM 0. 25.5 FORMAT "%5.2" /end CHARACTERISTIC
/begin CHARACTERISTIC K_UKOMPM "Konstantwert Spngsabfall Motorr bei Generatorfehler für ULCP" VALUE 0xa0825529 _REC_VAL_20_u1 25.5 _CNV_R_R_Def_u_ub_q_631_CM 0. 25.5 FORMAT "%5.2" /end CHARACTERISTIC
/begin CHARACTERISTIC K_UKOMPUBGEN "Differenzwert von Ub unter U_gen ab der Generator aus" VALUE 0xa082552a _REC_VAL_20_u1 4.998 _CNV_R_R_Def_u_ub_q_762_CM 0. 4.998 FORMAT "%7.4" /end CHARACTERISTIC
/begin CHARACTERISTIC K_U_SINKEND "QVC U00 - Offset in U00-Berechnung für Näherung aus Ladung" VALUE 0xa082569c _REC_VAL_20_s2 98.30250000000001 _CNV_R_R_Def_lf_ub__670_CM -327.68 327.67 FORMAT "%5.2" /end CHARACTERISTIC
/begin CHARACTERISTIC K_U_STEIGEND "QVC U00 - Offset in U00-Berechnung für Näherung aus Entladung" VALUE 0xa082569e _REC_VAL_20_s2 98.30250000000001 _CNV_R_R_Def_lf_ub__670_CM -327.68 327.67 FORMAT "%5.2" /end CHARACTERISTIC
/begin CHARACTERISTIC K_VBI_POS "Faktor wenn U_batt größer als thermische Oberspannung" VALUE 0xa08255a7 _REC_VAL_20_u1 100. _CNV_R_R_Def_dez_sl_551_CM 0. 100. FORMAT "%3.0" /end CHARACTERISTIC
/begin CHARACTERISTIC K_VBKV "Volumen Bremskraftverstärker" VALUE 0xa081933a _REC_VAL_20_u1 7.8 _CNV_R_R_Def_niv_ub_671_CM 0. 7.8 FORMAT "%5.2" /end CHARACTERISTIC
/begin CHARACTERISTIC K_VBRES1UMN "Minspannung Reserveverbraucher 1" VALUE 0xa08255a8 _REC_VAL_20_u1 25.5 _CNV_R_R_Def_u_ub_q_631_CM 0. 25.5 FORMAT "%5.2" /end CHARACTERISTIC
/begin CHARACTERISTIC K_VBRES1UMX "Maxspannung Reserveverbraucher 1" VALUE 0xa08255a9 _REC_VAL_20_u1 25.5 _CNV_R_R_Def_u_ub_q_631_CM 0. 25.5 FORMAT "%5.2" /end CHARACTERISTIC
/begin CHARACTERISTIC K_VBRES2UMN "Minspannung Reserveverbraucher 2" VALUE 0xa08255aa _REC_VAL_20_u1 25.5 _CNV_R_R_Def_u_ub_q_631_CM 0. 25.5 FORMAT "%5.2" /end CHARACTERISTIC
/begin CHARACTERISTIC K_VBRES2UMX "Maxspannung Reserveverbraucher 2" VALUE 0xa08255ab _REC_VAL_20_u1 25.5 _CNV_R_R_Def_u_ub_q_631_CM 0. 25.5 FORMAT "%5.2" /end CHARACTERISTIC
/begin CHARACTERISTIC K_VBRES3DUNMX "Spannung neg Gradient Reserveverbraucher 3" VALUE 0xa08255ac _REC_VAL_20_u1 0.498 _CNV_R_R_Def_u_ub_b_721_CM 0. 0.498 FORMAT "%7.4" /end CHARACTERISTIC
/begin CHARACTERISTIC K_VBRES3DUPMX "Spannung pos Gradient Reserveverbraucher 3" VALUE 0xa08255ad _REC_VAL_20_u1 0.498 _CNV_R_R_Def_u_ub_b_721_CM 0. 0.498 FORMAT "%7.4" /end CHARACTERISTIC
/begin CHARACTERISTIC K_VBRES3UMN "Minspannung  Reserveverbraucher 3" VALUE 0xa08255ae _REC_VAL_20_u1 25.5 _CNV_R_R_Def_u_ub_q_631_CM 0. 25.5 FORMAT "%5.2" /end CHARACTERISTIC
/begin CHARACTERISTIC K_VBRES3UMX "Maxsspannung Reserveverbraucher 3" VALUE 0xa08255af _REC_VAL_20_u1 25.5 _CNV_R_R_Def_u_ub_q_631_CM 0. 25.5 FORMAT "%5.2" /end CHARACTERISTIC
/begin CHARACTERISTIC K_VBRES4DUNMX "Spannung neg Gradient Reserveverbraucher 4" VALUE 0xa08255b0 _REC_VAL_20_u1 0.498 _CNV_R_R_Def_u_ub_b_721_CM 0. 0.498 FORMAT "%7.4" /end CHARACTERISTIC
/begin CHARACTERISTIC K_VBRES4DUPMX "Spannung pos Gradient Reserveverbraucher 4" VALUE 0xa08255b1 _REC_VAL_20_u1 0.498 _CNV_R_R_Def_u_ub_b_721_CM 0. 0.498 FORMAT "%7.4" /end CHARACTERISTIC
/begin CHARACTERISTIC K_VBRES4UMN "Minspannung Reserveverbraucher 4" VALUE 0xa08255b2 _REC_VAL_20_u1 25.5 _CNV_R_R_Def_u_ub_q_631_CM 0. 25.5 FORMAT "%5.2" /end CHARACTERISTIC
/begin CHARACTERISTIC K_VBRES4UMX "Maxspannung Reserveverbraucher 4" VALUE 0xa08255b3 _REC_VAL_20_u1 25.5 _CNV_R_R_Def_u_ub_q_631_CM 0. 25.5 FORMAT "%5.2" /end CHARACTERISTIC
/begin CHARACTERISTIC K_VBRES5UMN "Minspannung Reserveverbraucher 5" VALUE 0xa08255b4 _REC_VAL_20_u1 25.5 _CNV_R_R_Def_u_ub_q_631_CM 0. 25.5 FORMAT "%5.2" /end CHARACTERISTIC
/begin CHARACTERISTIC K_VBRES5UMX "Maxspannung Reserveverbraucher 5" VALUE 0xa08255b5 _REC_VAL_20_u1 25.5 _CNV_R_R_Def_u_ub_q_631_CM 0. 25.5 FORMAT "%5.2" /end CHARACTERISTIC
/begin CHARACTERISTIC K_VBTHERMUMX "Spannungsapplikationswert bei Thermischer Überlastung" VALUE 0xa08255b6 _REC_VAL_20_u1 25.5 _CNV_R_R_Def_u_ub_q_631_CM 0. 25.5 FORMAT "%5.2" /end CHARACTERISTIC
/begin CHARACTERISTIC K_VB_ON "Verbraucher ein" VALUE 0xa08255b7 _REC_VAL_20_u1 1. _CNV_R_R_Def_dez_sl_551_CM 0. 1. FORMAT "%3.0" /end CHARACTERISTIC
/begin CHARACTERISTIC K_VB_STIM "Konstante zum Test" VALUE 0xa08255b8 _REC_VAL_20_u1 1. _CNV_R_R_Def_dez_sl_551_CM 0. 1. FORMAT "%3.0" /end CHARACTERISTIC
/begin CHARACTERISTIC K_VERB_CAN "Freischalten Verbraucher CAN" VALUE 0xa08255b9 _REC_VAL_20_u1 1. _CNV_R_R_Def_dez_sl_551_CM 0. 1. FORMAT "%3.0" /end CHARACTERISTIC
/begin CHARACTERISTIC K_VKBKV "Volumenkonstante Bremskraftverstärker" VALUE 0xa081933b _REC_VAL_20_u1 25.5 _CNV_R_R_Def_f_sw_q_560_CM 0. 25.5 FORMAT "%5.2" /end CHARACTERISTIC
/begin CHARACTERISTIC K_VMAXSPQ "Maximale Geschw. für Berechnung Spannungsquali" VALUE 0xa0825488 _REC_VAL_20_u2 0. _CNV_R_R_Def_dez_sl_551_CM 0. 65535. FORMAT "%5.0" /end CHARACTERISTIC
/begin CHARACTERISTIC K_WISCHERAKT " um Spannung und Prios zu testen" VALUE 0xa08255ba _REC_VAL_20_u1 1. _CNV_R_R_Def_dez_sl_551_CM 0. 1. FORMAT "%3.0" /end CHARACTERISTIC
/begin CHARACTERISTIC K_WISCHUMN "Minspannung Wischer" VALUE 0xa08255bb _REC_VAL_20_u1 25.5 _CNV_R_R_Def_u_ub_q_631_CM 0. 25.5 FORMAT "%5.2" /end CHARACTERISTIC
/begin CHARACTERISTIC K_WISCHUMX "Maxspannung Wischer" VALUE 0xa08255bc _REC_VAL_20_u1 25.5 _CNV_R_R_Def_u_ub_q_631_CM 0. 25.5 FORMAT "%5.2" /end CHARACTERISTIC
/begin CHARACTERISTIC K_ZKFTEV "Zeitkonstante fuer Ftev-Filter" VALUE 0xa0833136 _REC_VAL_20_u2 131.07 _CNV_R_R_Def_td_ub__574_CM 0. 6553.5 FORMAT "%4.1" /end CHARACTERISTIC
/begin CHARACTERISTIC K_ZKFTEVST "Zeitkonstante fuer Start-Filter" VALUE 0xa0833134 _REC_VAL_20_u2 131.07 _CNV_R_R_Def_td_ub__574_CM 0. 6553.5 FORMAT "%4.1" /end CHARACTERISTIC
/begin CHARACTERISTIC K_ZKLF "Zeitkonstante Filter pvdkds - Instationär" VALUE 0xa081e850 _REC_VAL_20_u2 655.35 _CNV_R_R_Def_zk10ms_715_CM 1.e-002 655.36 FORMAT "%7.4" /end CHARACTERISTIC
/begin CHARACTERISTIC K_ZKLF_STAT "Zeitkonstante Filter pvdkds - Stationär" VALUE 0xa081e852 _REC_VAL_20_u2 655.35 _CNV_R_R_Def_zk10ms_715_CM 1.e-002 655.36 FORMAT "%7.4" /end CHARACTERISTIC
/begin CHARACTERISTIC K_ZKMRDEV_IN "" VALUE 0xa081e858 _REC_VAL_20_u2 0.9999 _CNV_R_R_Def_f_uw_b_571_CM 0. 0.9999 FORMAT "%14.5" /end CHARACTERISTIC
/begin CHARACTERISTIC K_ZKTEMPK "Zeitkonstante fuer Filter" VALUE 0xa083312c _REC_VAL_20_u2 131.07 _CNV_R_R_Def_td_ub__574_CM 0. 6553.5 FORMAT "%4.1" /end CHARACTERISTIC
/begin CHARACTERISTIC K_ZKTMOT_TEMPK "Zeitkonstante fuer Filter" VALUE 0xa0833132 _REC_VAL_20_u2 131.07 _CNV_R_R_Def_td_ub__574_CM 0. 6553.5 FORMAT "%4.1" /end CHARACTERISTIC
/begin CHARACTERISTIC K_ZK_DPBKV "Zeitkonstante für Dpbkv-Filter" VALUE 0xa081933e _REC_VAL_20_u2 6553.5 _CNV_R_R_Def_zk100m_739_CM 0.1 6553.6 FORMAT "%4.1" /end CHARACTERISTIC
/begin CHARACTERISTIC K_ZK_MPRMSFAK "Zeitkonstante Filter " VALUE 0xa081e84c _REC_VAL_20_u2 655.35 _CNV_R_R_Def_zk10ms_715_CM 1.e-002 655.36 FORMAT "%7.4" /end CHARACTERISTIC
/begin CHARACTERISTIC K_ZK_MPRMSOFF "Zeitkonstante Filter " VALUE 0xa081e84e _REC_VAL_20_u2 655.35 _CNV_R_R_Def_zk10ms_715_CM 1.e-002 655.36 FORMAT "%7.4" /end CHARACTERISTIC
/begin CHARACTERISTIC K_ZK_MREVFAK "" VALUE 0xa081e83c _REC_VAL_20_u2 0.9999 _CNV_R_R_Def_f_uw_b_571_CM 0. 0.9999 FORMAT "%14.5" /end CHARACTERISTIC
/begin CHARACTERISTIC K_ZK_MREVOFF "" VALUE 0xa081e83e _REC_VAL_20_u2 0.9999 _CNV_R_R_Def_f_uw_b_571_CM 0. 0.9999 FORMAT "%14.5" /end CHARACTERISTIC
/begin CHARACTERISTIC K_ZK_MSHFM "Zeitkonstante Filter Mshfm_ist" VALUE 0xa081e84a _REC_VAL_20_u2 655.35 _CNV_R_R_Def_zk10ms_715_CM 1.e-002 655.36 FORMAT "%7.4" /end CHARACTERISTIC
/begin CHARACTERISTIC K_ZK_PBKV "Zeitkonstante für Pbkv-Filter" VALUE 0xa081933c _REC_VAL_20_u2 6553.5 _CNV_R_R_Def_zk100m_739_CM 0.1 6553.6 FORMAT "%4.1" /end CHARACTERISTIC
/begin CHARACTERISTIC K_ZK_PVDKDSSTAT "Zeitkonstante Threshold Filter pvdkds" VALUE 0xa081e854 _REC_VAL_20_u2 655.35 _CNV_R_R_Def_zk10ms_715_CM 1.e-002 655.36 FORMAT "%7.4" /end CHARACTERISTIC
/begin CHARACTERISTIC K_ZK_RFSTART "" VALUE 0xa081e844 _REC_VAL_20_u2 0.9999 _CNV_R_R_Def_f_uw_b_571_CM 0. 0.9999 FORMAT "%14.5" /end CHARACTERISTIC
/begin CHARACTERISTIC S_E89_AFS "Kein Langbezeichner vergeben" VALUE 0xa08254c7 _REC_VAL_20_u1 1. _CNV_R_R_Def_dez_sl_551_CM 0. 1. FORMAT "%3.0" /end CHARACTERISTIC
/begin CHARACTERISTIC S_ELU_L3 "Schalter Kennlinie E-Lufter Mini" VALUE 0xa08255bd _REC_VAL_20_u1 1. _CNV_R_R_Def_dez_sl_551_CM 0. 1. FORMAT "%3.0" /end CHARACTERISTIC
/begin CHARACTERISTIC S_ENGENTOGGL "Freigabe Generatortoggeln" VALUE 0xa082552b _REC_VAL_20_u1 1. _CNV_R_R_Def_dez_sl_551_CM 0. 1. FORMAT "%3.0" /end CHARACTERISTIC
/begin CHARACTERISTIC S_ENTLTEST "" VALUE 0xa082553b _REC_VAL_20_u1 1. _CNV_R_R_Def_dez_sl_551_CM 0. 1. FORMAT "%3.0" /end CHARACTERISTIC
/begin CHARACTERISTIC S_EPS_EN "Elektrische Lenkhilfe enable" VALUE 0xa082553d _REC_VAL_20_u1 1. _CNV_R_R_Def_dez_sl_551_CM 0. 1. FORMAT "%3.0" /end CHARACTERISTIC
/begin CHARACTERISTIC S_FTEV_TANS "Brennraumkorrektur mit Tans " VALUE 0xa083312e _REC_VAL_20_u1 1. _CNV_R_R_Def_dez_sl_551_CM 0. 1. FORMAT "%3.0" /end CHARACTERISTIC
/begin CHARACTERISTIC S_FTPVDKPN "" VALUE 0xa0833131 _REC_VAL_20_u1 1. _CNV_R_R_Def_dez_sl_551_CM 0. 1. FORMAT "%3.0" /end CHARACTERISTIC
/begin CHARACTERISTIC S_GENOFFSTPM "Schalter zum Freischalten Startausschaltspannung" VALUE 0xa082552c _REC_VAL_20_u1 1. _CNV_R_R_Def_dez_sl_551_CM 0. 1. FORMAT "%3.0" /end CHARACTERISTIC
/begin CHARACTERISTIC S_IGR_EPS "Berücksichtigung von igr med hi bei Auswertung EPS" VALUE 0xa08254c8 _REC_VAL_20_u1 1. _CNV_R_R_Def_dez_sl_551_CM 0. 1. FORMAT "%3.0" /end CHARACTERISTIC
/begin CHARACTERISTIC S_KEKP "Elektrische Kraftstoffpumpe" VALUE 0xa082553e _REC_VAL_20_u1 1. _CNV_R_R_Def_dez_sl_551_CM 0. 1. FORMAT "%3.0" /end CHARACTERISTIC
/begin CHARACTERISTIC S_KONFSTRAT2 "wenn true dann wird neue Konfliktstrategie verwendet" VALUE 0xa082550c _REC_VAL_20_u1 1. _CNV_R_R_Def_dez_sl_551_CM 0. 1. FORMAT "%3.0" /end CHARACTERISTIC
/begin CHARACTERISTIC S_LDABNQH_EN "LL- DZ Anhebung bei BNstab Prio High enable" VALUE 0xa08254c9 _REC_VAL_20_u1 1. _CNV_R_R_Def_dez_sl_551_CM 0. 1. FORMAT "%3.0" /end CHARACTERISTIC
/begin CHARACTERISTIC S_LDAEPS_EN "Kein Langbezeichner vergeben" VALUE 0xa08254ca _REC_VAL_20_u1 1. _CNV_R_R_Def_dez_sl_551_CM 0. 1. FORMAT "%3.0" /end CHARACTERISTIC
/begin CHARACTERISTIC S_MRDEVSOLL_OFF "" VALUE 0xa081e833 _REC_VAL_20_u1 99.45 _CNV_R_R_Def_dez_sl_551_CM 0. 255. FORMAT "%3.0" /end CHARACTERISTIC
/begin CHARACTERISTIC S_MRDEV_OFF "Bei Aktiv AGR, Berechnung von Mrd ausschalten" VALUE 0xa081e82e _REC_VAL_20_u1 99.45 _CNV_R_R_Def_dez_sl_551_CM 0. 255. FORMAT "%3.0" /end CHARACTERISTIC
/begin CHARACTERISTIC S_MRMSLAM_AUTO "Automatisch HFM Erkennung ein" VALUE 0xa081e82b _REC_VAL_20_u1 99.45 _CNV_R_R_Def_dez_sl_551_CM 0. 255. FORMAT "%3.0" /end CHARACTERISTIC
/begin CHARACTERISTIC S_PSPAGR_SOLL "" VALUE 0xa081e834 _REC_VAL_20_u1 99.45 _CNV_R_R_Def_dez_sl_551_CM 0. 255. FORMAT "%3.0" /end CHARACTERISTIC
/begin CHARACTERISTIC S_PVDKPN_F "" VALUE 0xa0833130 _REC_VAL_20_u1 1. _CNV_R_R_Def_dez_sl_551_CM 0. 1. FORMAT "%3.0" /end CHARACTERISTIC
/begin CHARACTERISTIC S_QVH2OSOC "Schalter zum Ausschalten des Einfluss des Ladezustands" VALUE 0xa08257dd _REC_VAL_20_u1 1. _CNV_R_R_Def_dez_sl_551_CM 0. 1. FORMAT "%3.0" /end CHARACTERISTIC
/begin CHARACTERISTIC S_QVH2O_UM "Umschalter: True = Rücksetzen von Qv_h2o bei  Batterietausch,  false = Qv_h2o bei  Batterieabklemmen" VALUE 0xa08257de _REC_VAL_20_u1 1. _CNV_R_R_Def_dez_sl_551_CM 0. 1. FORMAT "%3.0" /end CHARACTERISTIC
/begin CHARACTERISTIC S_RFGDST_OFF "Rf Berechnung im Gedrosselt-Start Aus" VALUE 0xa081e82f _REC_VAL_20_u1 99.45 _CNV_R_R_Def_dez_sl_551_CM 0. 255. FORMAT "%3.0" /end CHARACTERISTIC
/begin CHARACTERISTIC S_RFINTFG_PERM "Schalter Frischgasanteil in Restgas Permanent berechnen" VALUE 0xa081e82d _REC_VAL_20_u1 99.45 _CNV_R_R_Def_dez_sl_551_CM 0. 255. FORMAT "%3.0" /end CHARACTERISTIC
/begin CHARACTERISTIC S_RFINTFG_PIRG "Schalter Pirg_abgd oder Pirg_fho" VALUE 0xa081e82c _REC_VAL_20_u1 99.45 _CNV_R_R_Def_dez_sl_551_CM 0. 255. FORMAT "%3.0" /end CHARACTERISTIC
/begin CHARACTERISTIC S_RFST_ON "Umschaltung Rf Berechnung im Start" VALUE 0xa081e830 _REC_VAL_20_u1 99.45 _CNV_R_R_Def_dez_sl_551_CM 0. 255. FORMAT "%3.0" /end CHARACTERISTIC
/begin CHARACTERISTIC S_RLEITUNG "manuelles Umschalten auf konst Widerstandswert" VALUE 0xa082552d _REC_VAL_20_u1 1. _CNV_R_R_Def_dez_sl_551_CM 0. 1. FORMAT "%3.0" /end CHARACTERISTIC
/begin CHARACTERISTIC S_TD_MRDK "" VALUE 0xa081e832 _REC_VAL_20_u1 99.45 _CNV_R_R_Def_dez_sl_551_CM 0. 255. FORMAT "%3.0" /end CHARACTERISTIC
/begin CHARACTERISTIC S_TD_MREVOFF "" VALUE 0xa081e831 _REC_VAL_20_u1 99.45 _CNV_R_R_Def_dez_sl_551_CM 0. 255. FORMAT "%3.0" /end CHARACTERISTIC
/begin CHARACTERISTIC S_VBRES1_AK " um Spannung und Prios zu testen" VALUE 0xa08255be _REC_VAL_20_u1 1. _CNV_R_R_Def_dez_sl_551_CM 0. 1. FORMAT "%3.0" /end CHARACTERISTIC
/begin CHARACTERISTIC S_VBRES2_AK " um Spannung und Prios zu testen" VALUE 0xa08255bf _REC_VAL_20_u1 1. _CNV_R_R_Def_dez_sl_551_CM 0. 1. FORMAT "%3.0" /end CHARACTERISTIC
/begin CHARACTERISTIC S_VBRES3_AK " um Spannung und Prios zu testen" VALUE 0xa08255c0 _REC_VAL_20_u1 1. _CNV_R_R_Def_dez_sl_551_CM 0. 1. FORMAT "%3.0" /end CHARACTERISTIC
/begin CHARACTERISTIC S_VBRES4_AK " um Spannung und Prios zu testen" VALUE 0xa08255c1 _REC_VAL_20_u1 1. _CNV_R_R_Def_dez_sl_551_CM 0. 1. FORMAT "%3.0" /end CHARACTERISTIC
/begin CHARACTERISTIC S_VBRES5_AK " um Spannung und Prios zu testen" VALUE 0xa08255c2 _REC_VAL_20_u1 1. _CNV_R_R_Def_dez_sl_551_CM 0. 1. FORMAT "%3.0" /end CHARACTERISTIC
/begin CHARACTERISTIC S_WFTEV "Rfv_soll / Rfv_hub Schalter" VALUE 0xa083312f _REC_VAL_20_u1 1. _CNV_R_R_Def_dez_sl_551_CM 0. 1. FORMAT "%3.0" /end CHARACTERISTIC
/begin COMPU_METHOD _CNV_R_R_Def_dez_sl_551_CM "Def_dez_sl_q1" RAT_FUNC "%6.3" "-" COEFFS 0. 1. 0. 0. 0. 1. /end COMPU_METHOD
/begin COMPU_METHOD _CNV_R_R_Def_f_ub_b_553_CM "Def_f_ub_b1" RAT_FUNC "%6.3" "-" COEFFS 0. 256. 0. 0. 0. 1. /end COMPU_METHOD
/begin COMPU_METHOD _CNV_R_R_Def_f_uw_b_555_CM "Def_f_uw_b100" RAT_FUNC "%6.3" "%" COEFFS 0. 65536. 0. 0. 0. 100. /end COMPU_METHOD
/begin COMPU_METHOD _CNV_R_R_Def_f_sw_b_556_CM "Def_f_sw_b32" RAT_FUNC "%6.3" "-" COEFFS 0. 32768. 0. 0. 0. 32. /end COMPU_METHOD
/begin COMPU_METHOD _CNV_R_R_Def_f_uw_b_559_CM "Def_f_uw_b16" RAT_FUNC "%6.3" "-" COEFFS 0. 65536. 0. 0. 0. 16. /end COMPU_METHOD
/begin COMPU_METHOD _CNV_R_R_Def_f_sw_q_560_CM "Def_f_sw_q0p1" RAT_FUNC "%6.3" "-" COEFFS 0. 10. 0. 0. 0. 1. /end COMPU_METHOD
/begin COMPU_METHOD _CNV_S_2_Def_bit_ub_563_CM "Def_bit_ub_0" TAB_VERB "%6.3" "-" COMPU_TAB_REF _CNV_S_2_Def_bit_ub_563 /end COMPU_METHOD
/begin COMPU_VTAB _CNV_S_2_Def_bit_ub_563 "Def_bit_ub_0" TAB_VERB 2 0 "FALSE" 1 "TRUE" /end COMPU_VTAB
/begin COMPU_METHOD _CNV_R_R_Def_f_uw_b_571_CM "Def_f_uw_b1" RAT_FUNC "%6.3" "-" COEFFS 0. 65536. 0. 0. 0. 1. /end COMPU_METHOD
/begin COMPU_METHOD _CNV_R_R_Def_ql_ub__573_CM "Def_ql_ub_q1" RAT_FUNC "%6.3" "" COEFFS 0. 1. 0. 0. 0. 1. /end COMPU_METHOD
/begin COMPU_METHOD _CNV_R_R_Def_td_ub__574_CM "Def_td_ub_q0p1" RAT_FUNC "%6.3" "s" COEFFS 0. 10. 0. 0. 0. 1. /end COMPU_METHOD
/begin COMPU_METHOD _CNV_R_R_Def_p_sw_q_576_CM "Def_p_sw_q0p039" RAT_FUNC "%6.3" "hPa" COEFFS 0. 256. 0. 0. 0. 10. /end COMPU_METHOD
/begin COMPU_METHOD _CNV_R_R_Def_t_sw_q_578_CM "Def_t_sw_q0p1" RAT_FUNC "%6.3" "°C" COEFFS 0. 10. 0. 0. 0. 1. /end COMPU_METHOD
/begin COMPU_METHOD _CNV_R_R_Def_t_sw_q_579_CM "Def_t_sw_q0p01" RAT_FUNC "%6.3" "°C" COEFFS 0. 100. 0. 0. 0. 1. /end COMPU_METHOD
/begin COMPU_METHOD _CNV_R_R_Def_u_sw_b_581_CM "Def_u_sw_b128" RAT_FUNC "%6.3" "V" COEFFS 0. 256. 0. 0. 0. 1. /end COMPU_METHOD
/begin COMPU_METHOD _CNV_R_R_Def_f_sl_q_582_CM "Def_f_sl_q0p007" RAT_FUNC "%6.3" "" COEFFS 0. 65536. 0. 0. 0. 512. /end COMPU_METHOD
/begin COMPU_METHOD _CNV_R_R_Def_u_sb_q_583_CM "Def_u_sb_q0p0942" RAT_FUNC "%6.3" "V" COEFFS 0. 1. 0. 0. 0. 9.420000000000001e-002 /end COMPU_METHOD
/begin COMPU_METHOD _CNV_R_R_Def_f_sb_b_584_CM "Def_f_sb_b64" RAT_FUNC "%6.3" "-" COEFFS 0. 128. 0. 0. 0. 64. /end COMPU_METHOD
/begin COMPU_METHOD _CNV_R_R_Def_f_ub_b_586_CM "Def_f_ub_b100" RAT_FUNC "%6.3" "%" COEFFS 0. 256. 0. 0. 0. 100. /end COMPU_METHOD
/begin COMPU_METHOD _CNV_R_R_Def_f_uw_b_588_CM "Def_f_uw_b32" RAT_FUNC "%6.3" "-" COEFFS 0. 65536. 0. 0. 0. 32. /end COMPU_METHOD
/begin COMPU_METHOD _CNV_R_R_Def_hub_uw_589_CM "Def_hub_uw_q0p001" RAT_FUNC "%6.3" "mm" COEFFS 0. 1000. 0. 0. 0. 1. /end COMPU_METHOD
/begin COMPU_METHOD _CNV_R_R_Def_f_uw_b_590_CM "Def_f_uw_b2" RAT_FUNC "%6.3" "-" COEFFS 0. 65536. 0. 0. 0. 2. /end COMPU_METHOD
/begin COMPU_METHOD _CNV_R_R_Def_ms_uw__594_CM "Def_ms_uw_q0p03125" RAT_FUNC "%6.3" "kg/h" COEFFS 0. 32. 0. 0. 0. 1. /end COMPU_METHOD
/begin COMPU_METHOD _CNV_R_R_Def_n_sw_q_595_CM "Def_n_sw_q1p0" RAT_FUNC "%6.3" "Upm" COEFFS 0. 1. 0. 0. 0. 1. /end COMPU_METHOD
/begin COMPU_METHOD _CNV_R_R_Def_p_sw_q_596_CM "Def_p_sw_q0p1" RAT_FUNC "%6.3" "hPa" COEFFS 0. 10. 0. 0. 0. 1. /end COMPU_METHOD
/begin COMPU_METHOD _CNV_R_R_Def_rf_sw__598_CM "Def_rf_sw_q0p01" RAT_FUNC "%6.3" "%" COEFFS 0. 100. 0. 0. 0. 1. /end COMPU_METHOD
/begin COMPU_METHOD _CNV_R_R_Def_td_ub__611_CM "Def_td_ub_q1" RAT_FUNC "%6.3" "s" COEFFS 0. 1. 0. 0. 0. 1. /end COMPU_METHOD
/begin COMPU_METHOD _CNV_R_R_Def_f_ub_b_612_CM "Def_f_ub_b32" RAT_FUNC "%6.3" "-" COEFFS 0. 256. 0. 0. 0. 32. /end COMPU_METHOD
/begin COMPU_METHOD _CNV_R_R_Def_f_ub_b_613_CM "Def_f_ub_b2" RAT_FUNC "%6.3" "-" COEFFS 0. 256. 0. 0. 0. 2. /end COMPU_METHOD
/begin COMPU_METHOD _CNV_R_R_Def_ms_sb__614_CM "Def_ms_sb_q8" RAT_FUNC "%6.3" "kg/h" COEFFS 0. 1. 0. 0. 0. 8. /end COMPU_METHOD
/begin COMPU_METHOD _CNV_R_R_Def_f_sw_b_616_CM "Def_f_sw_b2" RAT_FUNC "%6.3" "-" COEFFS 0. 65536. 0. 0. 0. 4. /end COMPU_METHOD
/begin COMPU_METHOD _CNV_R_R_Def_f_uw_b_617_CM "Def_f_uw_b64" RAT_FUNC "%6.3" "-" COEFFS 0. 65536. 0. 0. 0. 64. /end COMPU_METHOD
/begin COMPU_METHOD _CNV_R_R_Def_i_uw_q_630_CM "Def_i_uw_q0p125" RAT_FUNC "%6.3" "A" COEFFS 0. 8. 0. 0. 0. 1. /end COMPU_METHOD
/begin COMPU_METHOD _CNV_R_R_Def_u_ub_q_631_CM "Def_u_ub_q0p1" RAT_FUNC "%6.3" "V" COEFFS 0. 10. 0. 0. 0. 1. /end COMPU_METHOD
/begin COMPU_METHOD _CNV_R_R_Def_i_sw_q_635_CM "Def_i_sw_q1" RAT_FUNC "%6.3" "A" COEFFS 0. 1. 0. 0. 0. 1. /end COMPU_METHOD
/begin COMPU_METHOD _CNV_R_R_Def_i_sw_q_640_CM "Def_i_sw_q0p02" RAT_FUNC "%6.3" "A" COEFFS 0. 50. 0. 0. 0. 1. /end COMPU_METHOD
/begin COMPU_METHOD _CNV_R_R_Def_i_sw_q_641_CM "Def_i_sw_q0p001" RAT_FUNC "%6.3" "A" COEFFS 0. 1000. 0. 0. 0. 1. /end COMPU_METHOD
/begin COMPU_METHOD _CNV_R_R_Def_f_sb_b_647_CM "Def_f_sb_b0p125" RAT_FUNC "%6.3" "-" COEFFS 0. 1024. 0. 0. 0. 1. /end COMPU_METHOD
/begin COMPU_METHOD _CNV_R_R_Def_ml_uw__653_CM "Def_ml_uw_q0p1" RAT_FUNC "%6.3" "kg/h" COEFFS 0. 10. 0. 0. 0. 1. /end COMPU_METHOD
/begin COMPU_METHOD _CNV_R_R_Def_ngrd_s_661_CM "Def_ngrd_sb_q32p0" RAT_FUNC "%6.3" "Upm/s" COEFFS 0. 1. 0. 0. 0. 32. /end COMPU_METHOD
/begin COMPU_METHOD _CNV_R_R_Def_qnv_uw_662_CM "Def_qnv_uw_b512" RAT_FUNC "%6.3" "Upm/kmh" COEFFS 0. 65536. 0. 0. 0. 512. /end COMPU_METHOD
/begin COMPU_METHOD _CNV_R_R_Def_td_uw__663_CM "Def_td_uw_q0p001" RAT_FUNC "%6.3" "ms" COEFFS 0. 1000. 0. 0. 0. 1. /end COMPU_METHOD
/begin COMPU_METHOD _CNV_R_R_Def_f_sb_b_669_CM "Def_f_sb_b2" RAT_FUNC "%6.3" "-" COEFFS 0. 128. 0. 0. 0. 2. /end COMPU_METHOD
/begin COMPU_METHOD _CNV_R_R_Def_lf_ub__670_CM "Def_lf_ub_q0p01" RAT_FUNC "%6.3" "-" COEFFS 0. 100. 0. 0. 0. 1. /end COMPU_METHOD
/begin COMPU_METHOD _CNV_R_R_Def_niv_ub_671_CM "Def_niv_ub_q0p1" RAT_FUNC "%6.3" "l" COEFFS 0. 10. 0. 0. 0. 1. /end COMPU_METHOD
/begin COMPU_METHOD _CNV_R_R_Def_td_uw__673_CM "Def_td_uw_q0p01" RAT_FUNC "%6.3" "s" COEFFS 0. 100. 0. 0. 0. 1. /end COMPU_METHOD
/begin COMPU_METHOD _CNV_R_R_Def_p_ub_q_677_CM "Def_p_ub_q0p39" RAT_FUNC "%6.3" "Bar" COEFFS 0. 256. 0. 0. 0. 100. /end COMPU_METHOD
/begin COMPU_METHOD _CNV_R_R_Def_f_uw_b_679_CM "Def_f_uw_b2048" RAT_FUNC "%6.3" "-" COEFFS 0. 65536. 0. 0. 0. 2048. /end COMPU_METHOD
/begin COMPU_METHOD _CNV_R_R_Def_f_uw_b_687_CM "Def_f_uw_b8192" RAT_FUNC "%6.3" "-" COEFFS 0. 65536. 0. 0. 0. 8192. /end COMPU_METHOD
/begin COMPU_METHOD _CNV_R_R_Def_f_sl_b_688_CM "Def_f_sl_b16" RAT_FUNC "%6.3" "-" COEFFS 0. 134217728. 0. 0. 0. 1. /end COMPU_METHOD
/begin COMPU_METHOD _CNV_R_R_Def_u_uw_b_689_CM "Def_u_uw_b25p5" RAT_FUNC "%6.3" "V" COEFFS 0. 65536. 0. 0. 0. 25.5 /end COMPU_METHOD
/begin COMPU_METHOD _CNV_R_R_Def_u_sl_b_690_CM "Def_u_sl_b8192" RAT_FUNC "%6.3" "V" COEFFS 0. 262144. 0. 0. 0. 1. /end COMPU_METHOD
/begin COMPU_METHOD _CNV_R_R_Def_f_ul_q_691_CM "Def_f_ul_q0p00047" RAT_FUNC "%6.3" "-" COEFFS 0. 6400. 0. 0. 0. 3. /end COMPU_METHOD
/begin COMPU_METHOD _CNV_R_R_Def_f_sl_b_692_CM "Def_f_sl_b0p0625" RAT_FUNC "%6.3" "-" COEFFS 0. 34359738368. 0. 0. 0. 1. /end COMPU_METHOD
/begin COMPU_METHOD _CNV_R_R_Def_f_sl_b_693_CM "Def_f_sl_b1" RAT_FUNC "%6.3" "-" COEFFS 0. 2147483648. 0. 0. 0. 1. /end COMPU_METHOD
/begin COMPU_METHOD _CNV_R_R_Def_f_ub_b_694_CM "Def_f_ub_b8" RAT_FUNC "%6.3" "-" COEFFS 0. 256. 0. 0. 0. 8. /end COMPU_METHOD
/begin COMPU_METHOD _CNV_R_R_Def_ql_sb__695_CM "Def_ql_sb_q1" RAT_FUNC "%6.3" "Ah" COEFFS 0. 1. 0. 0. 0. 1. /end COMPU_METHOD
/begin COMPU_METHOD _CNV_R_R_Def_f_sw_b_696_CM "Def_f_sw_b0p00195" RAT_FUNC "%6.3" "-" COEFFS 0. 16777216. 0. 0. 0. 1. /end COMPU_METHOD
/begin COMPU_METHOD _CNV_R_R_Def_u_sl_b_697_CM "Def_u_sl_b131072" RAT_FUNC "%6.3" "-" COEFFS 0. 16384. 0. 0. 0. 1. /end COMPU_METHOD
/begin COMPU_METHOD _CNV_R_R_Def_f_sl_b_698_CM "Def_f_sl_b8192" RAT_FUNC "%6.3" "-" COEFFS 0. 262144. 0. 0. 0. 1. /end COMPU_METHOD
/begin COMPU_METHOD _CNV_R_R_Def_th_uw__699_CM "Def_th_uw_q1" RAT_FUNC "%6.3" "h" COEFFS 0. 1. 0. 0. 0. 1. /end COMPU_METHOD
/begin COMPU_METHOD _CNV_R_R_Def_u_uw_q_700_CM "Def_u_uw_q0p25em3_o6" RAT_FUNC "%6.3" "" COEFFS 0. -4000. 24000. 0. 0. -1. /end COMPU_METHOD
/begin COMPU_METHOD _CNV_R_R_Def_f_uw_q_701_CM "Def_f_uw_q0p00047" RAT_FUNC "%6.3" "°KW/%" COEFFS 0. 1638400. 0. 0. 0. 768. /end COMPU_METHOD
/begin COMPU_METHOD _CNV_R_R_Def_zk10ms_715_CM "Def_zk10ms_uw_b655p36" RAT_FUNC "%6.3" "s" COEFFS 0. 0. 655.36 0. 1. 0. /end COMPU_METHOD
/begin COMPU_METHOD _CNV_R_R_Def_u_sl_b_720_CM "Def_u_sl_b2048" RAT_FUNC "%6.3" "V" COEFFS 0. 1048576. 0. 0. 0. 1. /end COMPU_METHOD
/begin COMPU_METHOD _CNV_R_R_Def_u_ub_b_721_CM "Def_u_ub_b0p5" RAT_FUNC "%6.3" "V" COEFFS 0. 256. 0. 0. 0. 0.5 /end COMPU_METHOD
/begin COMPU_METHOD _CNV_R_R_Def_v_uw_q_726_CM "Def_v_uw_q1p0" RAT_FUNC "%6.3" "km/h" COEFFS 0. 1. 0. 0. 0. 1. /end COMPU_METHOD
/begin COMPU_METHOD _CNV_R_R_Def_f_ub_b_737_CM "Def_f_ub_b3" RAT_FUNC "%6.3" "-" COEFFS 0. 255. 0. 0. 0. 3. /end COMPU_METHOD
/begin COMPU_METHOD _CNV_R_R_Def_zk100m_739_CM "Def_zk100ms_uw_b6553p6" RAT_FUNC "%6.3" "s" COEFFS 0. 0. 6553.6 0. 1. 0. /end COMPU_METHOD
/begin COMPU_METHOD _CNV_R_R_Def_f_ub_b_743_CM "Def_f_ub_b16" RAT_FUNC "%6.3" "-" COEFFS 0. 256. 0. 0. 0. 16. /end COMPU_METHOD
/begin COMPU_METHOD _CNV_R_R_Def_t_ub_b_752_CM "Def_t_ub_b0q01" RAT_FUNC "%6.3" "-" COEFFS 0. 25600. 0. 0. 0. 1. /end COMPU_METHOD
/begin COMPU_METHOD _CNV_R_R_Def_u_ub_q_762_CM "Def_u_ub_q0p0196" RAT_FUNC "%6.3" "V" COEFFS 0. 1. 0. 0. 0. 1.96e-002 /end COMPU_METHOD
/begin COMPU_METHOD _CNV_R_R_Def_td_uw__767_CM "Def_td_uw_b4" RAT_FUNC "%6.3" "ms" COEFFS 0. 16384. 0. 0. 0. 1. /end COMPU_METHOD
/begin COMPU_METHOD _CNV_R_R_Def_f_sw_b_768_CM "Def_f_sw_b0p03125" RAT_FUNC "%6.3" "-" COEFFS 0. 1048576. 0. 0. 0. 1. /end COMPU_METHOD
/begin COMPU_METHOD _CNV_R_R_Def_td_ub__777_CM "Def_td_ub_q0p5" RAT_FUNC "%6.3" "s" COEFFS 0. 2. 0. 0. 0. 1. /end COMPU_METHOD
/begin RECORD_LAYOUT _REC_VAL_20_u1 FNC_VALUES 1 UBYTE COLUMN_DIR DIRECT /end RECORD_LAYOUT
/begin RECORD_LAYOUT _REC_VAL_20_u2 FNC_VALUES 1 UWORD COLUMN_DIR DIRECT /end RECORD_LAYOUT
/begin RECORD_LAYOUT _REC_VAL_20_s2 FNC_VALUES 1 SWORD COLUMN_DIR DIRECT /end RECORD_LAYOUT
/begin RECORD_LAYOUT _REC_VAL_20_s1 FNC_VALUES 1 SBYTE COLUMN_DIR DIRECT /end RECORD_LAYOUT
/begin RECORD_LAYOUT _REC_MAP_52_u1_s2_s2 NO_AXIS_PTS_X 1 UBYTE NO_AXIS_PTS_Y 2 UBYTE AXIS_PTS_X 3 SWORD INDEX_INCR DIRECT AXIS_PTS_Y 4 SWORD INDEX_INCR DIRECT FNC_VALUES 5 UBYTE COLUMN_DIR DIRECT /end RECORD_LAYOUT
/begin RECORD_LAYOUT _REC_MAP_52_UBYTE_u2_s2_s2 NO_AXIS_PTS_X 1 UBYTE NO_AXIS_PTS_Y 2 UBYTE AXIS_PTS_X 3 SWORD INDEX_INCR DIRECT AXIS_PTS_Y 4 SWORD INDEX_INCR DIRECT FNC_VALUES 5 UWORD COLUMN_DIR DIRECT /end RECORD_LAYOUT
/begin RECORD_LAYOUT _REC_MAP_52_UBYTE_s2_s2_s2 NO_AXIS_PTS_X 1 UBYTE NO_AXIS_PTS_Y 2 UBYTE AXIS_PTS_X 3 SWORD INDEX_INCR DIRECT AXIS_PTS_Y 4 SWORD INDEX_INCR DIRECT FNC_VALUES 5 SWORD COLUMN_DIR DIRECT /end RECORD_LAYOUT
/begin RECORD_LAYOUT _REC_MAP_52_UBYTE_u2_u2_s2 NO_AXIS_PTS_X 1 UBYTE NO_AXIS_PTS_Y 2 UBYTE AXIS_PTS_X 3 UWORD INDEX_INCR DIRECT AXIS_PTS_Y 4 SWORD INDEX_INCR DIRECT FNC_VALUES 5 UWORD COLUMN_DIR DIRECT /end RECORD_LAYOUT
/begin RECORD_LAYOUT _REC_MAP_52_UBYTE_s2_s2_u1 NO_AXIS_PTS_X 1 UBYTE NO_AXIS_PTS_Y 2 UBYTE AXIS_PTS_X 3 SWORD INDEX_INCR DIRECT AXIS_PTS_Y 4 UBYTE INDEX_INCR DIRECT FNC_VALUES 5 SWORD COLUMN_DIR DIRECT /end RECORD_LAYOUT
/begin RECORD_LAYOUT _REC_MAP_52_UBYTE_s2_u2_s2 NO_AXIS_PTS_X 1 UBYTE NO_AXIS_PTS_Y 2 UBYTE AXIS_PTS_X 3 UWORD INDEX_INCR DIRECT AXIS_PTS_Y 4 SWORD INDEX_INCR DIRECT FNC_VALUES 5 SWORD COLUMN_DIR DIRECT /end RECORD_LAYOUT
/begin RECORD_LAYOUT _REC_CUR_TKL_UW_VV__u2_u2 NO_AXIS_PTS_X 1 UBYTE RESERVED 2 BYTE AXIS_PTS_X 3 UWORD INDEX_INCR DIRECT FNC_VALUES 4 UWORD COLUMN_DIR DIRECT /end RECORD_LAYOUT
/begin RECORD_LAYOUT _REC_CUR_TKL_UW_VV__u2_s2 NO_AXIS_PTS_X 1 UBYTE RESERVED 2 BYTE AXIS_PTS_X 3 SWORD INDEX_INCR DIRECT FNC_VALUES 4 UWORD COLUMN_DIR DIRECT /end RECORD_LAYOUT
/begin RECORD_LAYOUT _REC_CUR_TKL_UW_VV__u1_s2 NO_AXIS_PTS_X 1 UBYTE RESERVED 2 BYTE AXIS_PTS_X 3 SWORD INDEX_INCR DIRECT FNC_VALUES 4 UBYTE COLUMN_DIR DIRECT /end RECORD_LAYOUT
/begin RECORD_LAYOUT _REC_CUR_TKL_UW_VV__s2_s2 NO_AXIS_PTS_X 1 UBYTE RESERVED 2 BYTE AXIS_PTS_X 3 SWORD INDEX_INCR DIRECT FNC_VALUES 4 SWORD COLUMN_DIR DIRECT /end RECORD_LAYOUT
/begin RECORD_LAYOUT _REC_CUR_TKL_UW_VV__u1_u2 NO_AXIS_PTS_X 1 UBYTE RESERVED 2 BYTE AXIS_PTS_X 3 UWORD INDEX_INCR DIRECT FNC_VALUES 4 UBYTE COLUMN_DIR DIRECT /end RECORD_LAYOUT
/begin RECORD_LAYOUT _REC_CUR_TKL_UW_VV__u1_u1 NO_AXIS_PTS_X 1 UBYTE RESERVED 2 BYTE AXIS_PTS_X 3 UBYTE INDEX_INCR DIRECT FNC_VALUES 4 UBYTE COLUMN_DIR DIRECT /end RECORD_LAYOUT
/begin RECORD_LAYOUT _REC_CUR_TKL_UW_VV__s1_u2 NO_AXIS_PTS_X 1 UBYTE RESERVED 2 BYTE AXIS_PTS_X 3 UWORD INDEX_INCR DIRECT FNC_VALUES 4 SBYTE COLUMN_DIR DIRECT /end RECORD_LAYOUT
/begin RECORD_LAYOUT _REC_VAL_2_u1 FNC_VALUES 1 UBYTE COLUMN_DIR DIRECT /end RECORD_LAYOUT
/begin RECORD_LAYOUT _REC_VAL_2_s2 FNC_VALUES 1 SWORD COLUMN_DIR DIRECT /end RECORD_LAYOUT
/begin RECORD_LAYOUT _REC_VAL_2_u2 FNC_VALUES 1 UWORD COLUMN_DIR DIRECT /end RECORD_LAYOUT
/begin RECORD_LAYOUT _REC_VAL_2_s1 FNC_VALUES 1 SBYTE COLUMN_DIR DIRECT /end RECORD_LAYOUT
/begin RECORD_LAYOUT _REC_VAL_2_s4 FNC_VALUES 1 SLONG COLUMN_DIR DIRECT /end RECORD_LAYOUT
/begin RECORD_LAYOUT _REC_VAL_20_s4 FNC_VALUES 1 SLONG COLUMN_DIR DIRECT /end RECORD_LAYOUT
/begin FUNCTION PMSPGW ""
 /begin DEF_CHARACTERISTIC KL_QUALIPRLI KL_QUALIULI KL_ULABHV K_BNQ_1 K_BNQ_2 K_BNQ_3 K_BNQ_4 K_BNSCTRINC K_BNSMX K_BNSUBMAX K_BNSUBMIN K_BNSVFZG K_DFGRENZSPGW K_DTBL K_DTELUE K_DTEWP K_DT_EPS K_DT_GEBL K_DT_KRAPU K_DT_LICHT K_DT_SLP K_DT_VBRES1 K_DT_VBRES2 K_DT_VBRES3 K_DT_VBRES4 K_DT_VBRES5 K_DT_WISCHER K_EPS_TRST K_EPS_VRST K_LZR_DOWN K_LZR_MAX K_LZR_UP K_PBN_MINUS K_PBN_PLUS K_PR_BLMN K_PR_BNS K_PR_CRASHSOLL K_PR_DSCMN K_PR_DSCMX K_PR_ELUEMN K_PR_EPSUMN K_PR_EWPMN K_PR_GEBMN K_PR_KRAPUMN K_PR_SLPMN K_PR_UBNQH K_PR_UBNQL K_PR_UBNQM K_PR_VBRES1MN K_PR_VBRES1MX K_PR_VBRES2MN K_PR_VBRES2MX K_PR_VBRES3MN K_PR_VBRES3MX K_PR_VBRES4MN K_PR_VBRES4MX K_PR_VBRES5MN K_PR_VBRES5MX K_PR_WISMN K_PR_WISMX K_SPGKMP12 K_SPGKOMP1 K_SPGKOMP10 K_SPGKOMP11 K_SPGKOMP13 K_SPGKOMP14 K_SPGKOMP15 K_SPGKOMP16 K_SPGKOMP17 K_SPGKOMP18 K_SPGKOMP19 K_SPGKOMP2 K_SPGKOMP20 K_SPGKOMP21 K_SPGKOMP22 K_SPGKOMP23 K_SPGKOMP24 K_SPGKOMP25 K_SPGKOMP4 K_SPGKOMP5 K_SPGKOMP6 K_SPGKOMP8 K_SPGKOMP9 K_SZR_DOWN K_SZR_MAX K_SZR_UP K_TBNSDELAY K_TOL K_TOL_LICHT1 K_TOL_LICHT2 K_UBNSSOLL K_UBW_DELAY K_UBW_GRENZAKTUV K_UBW_TABL K_UBW_USZRMX K_UBW_ZKL K_UBW_ZKSMN K_UBW_ZKSMX K_UCRASHSOLL K_UEPS_TOL K_VMAXSPQ S_E89_AFS S_IGR_EPS S_LDABNQH_EN S_LDAEPS_EN /end DEF_CHARACTERISTIC
 /begin REF_CHARACTERISTIC S_EPS_EN /end REF_CHARACTERISTIC
 /begin OUT_MEASUREMENT Bnscounter Pr_bl_mn Pr_bns_soll Pr_crash_soll Pr_dsc_mn Pr_dsc_mx Pr_elue_mn Pr_eps_mn Pr_ewp_mn Pr_geblaese_mn Pr_krapu_mn Pr_licht_mn Pr_slp_mn Pr_spgw Pr_vbres1_mn Pr_vbres1_mx Pr_vbres2_mn Pr_vbres2_mx Pr_vbres3_mn Pr_vbres3_mx Pr_vbres4_mn Pr_vbres4_mx Pr_vbres5_mn Pr_vbres5_mx Pr_wischer_mn Pr_wischer_mx Quali_spg St_bns St_bns.B_bns St_pmspgw St_pmspgw.B_bnqh St_pmspgw.B_eps_ak St_pmspgw.B_ldaeps_ak St_pmspgw.B_pmspgwbns St_pmspgw.B_ubw_aktiv St_pmspgw.B_ubw_ullow St_pmspgw.B_ubw_ulowak St_pmspgw.B_ubw_uslow St_pmspgw1 St_pmspgw1.B_afs_da U_bl_mn U_bns_soll U_crash_soll U_dsc_mn U_dsc_mx U_elue_mn U_eps_mn U_ewp_mn U_geblaese_mn U_krapu_mn U_licht_mn U_slp_mn U_vbres1_mn U_vbres1_mx U_vbres2_mn U_vbres2_mx U_vbres3_mn U_vbres3_mx U_vbres4_mn U_vbres4_mx U_vbres5_mn U_vbres5_mx U_wischer_mn U_wischer_mx Ubw_uszr Ubw_zr Ulzr Uszr /end OUT_MEASUREMENT
 /begin IN_MEASUREMENT Dffgen Pr_batt_mx St_bns.B_bns St_co2mng St_co2mng.B_co2_igroff St_co2mng.B_co2_msaoff St_co2mng.B_igrhigh St_co2mng.B_igrmed St_co2mng.B_zykl_igrh St_co2mng.B_zykl_igrm St_co2mng.B_zykl_msaoff St_generator St_generator.B_crashgen St_generator.B_genactiv St_generator.B_genfbsd St_generator.B_genfel St_generator.B_genfht St_generator.B_genfme St_pmbattmng0 St_pmbattmng0.B_batt_entl St_pmbattmng0.B_bt_timer St_pmbattmng0.B_btmaxfrei St_pmbattmng0.B_btpau St_pmbattmng0.B_dly_tbi St_pmbattmng0.B_ibsok St_pmbattmng0.B_inibumg St_start St_start.B_jumpstart St_start.B_sta St_start.B_start St_start.B_startende St_start.B_wst U_bl_min U_dsc_max U_dsc_min U_elue_min U_eps_min U_ewp_min U_geblaese_min U_krapu_min U_licht_min U_slp_min U_vbres1_max U_vbres1_min U_vbres2_max U_vbres2_min U_vbres3_max U_vbres3_min U_vbres4_max U_vbres4_min U_vbres5_max U_vbres5_min U_wischer_max U_wischer_min Ub V Var_afs W_ub /end IN_MEASUREMENT
/end FUNCTION
/begin FUNCTION PMUBNKOR "" /begin DEF_CHARACTERISTIC S_KONFSTRAT2 /end DEF_CHARACTERISTIC
 /begin OUT_MEASUREMENT Pr_bn_soll Pr_dnmax Pr_dpmax Pr_dyn Pr_konf Pr_max Pr_min Pr_soll Pr_sollmn Pr_sollmnk Pr_ziel St_pmubnkor St_pmubnkor.B_konflikt_max St_pmubnkor.B_konflikt_min U_bn_soll U_dnmax U_dpmax U_dynmax U_dynmin U_gsoll_tp3 U_konf U_max U_min U_soll U_ziel /end OUT_MEASUREMENT
 /begin IN_MEASUREMENT Pr_batt_mx Pr_batt_soll Pr_bl_mn Pr_bns_soll Pr_crash_soll Pr_dsc_mn Pr_dsc_mx Pr_dynbatt_mn Pr_elue_mn Pr_entl_soll Pr_eps_mn Pr_ewp_mn Pr_geblaese_dn Pr_geblaese_dp Pr_geblaese_mn Pr_igr_dn Pr_igr_dp Pr_igr_soll Pr_krapu_mn Pr_licht_dn Pr_licht_dp Pr_licht_mn Pr_slp_mn Pr_stabatt_mn Pr_vbres1_mn Pr_vbres1_mx Pr_vbres2_mn Pr_vbres2_mx Pr_vbres3_dn Pr_vbres3_dp Pr_vbres3_mn Pr_vbres3_mx Pr_vbres4_dn Pr_vbres4_dp Pr_vbres4_mn Pr_vbres4_mx Pr_vbres5_mn Pr_vbres5_mx Pr_vbtherm_mx Pr_wischer_mn Pr_wischer_mx U_batt_mx U_batt_soll U_bl_mn U_bns_soll U_crash_soll U_dsc_mn U_dsc_mx U_dynbatt_mn U_elue_mn U_entl_soll U_eps_mn U_ewp_mn U_geblaese_dn U_geblaese_dp U_geblaese_mn U_igr_dn U_igr_dp U_igr_soll U_krapu_mn U_licht_dn U_licht_dp U_licht_mn U_slp_mn U_stabatt_mn U_vbres1_mn U_vbres1_mx U_vbres2_mn U_vbres2_mx U_vbres3_dn U_vbres3_dp U_vbres3_mn U_vbres3_mx U_vbres4_dn U_vbres4_dp U_vbres4_mn U_vbres4_mx U_vbres5_mn U_vbres5_mx U_vbtherm_mx U_wischer_mn U_wischer_mx /end IN_MEASUREMENT
/end FUNCTION
/begin FUNCTION PMUKOMP ""
 /begin DEF_CHARACTERISTIC K_BATTORT2_LOC K_DFFGEN_MX K_IGEN_MN K_LTGPL_MN K_LTGPL_MX K_PT1RLTG_K K_RLEITUNGK K_RLEITUNGM K_RLTGPWE65 K_RLTG_KONST K_TDGENOFFPM K_UDIFGENOFF K_UGDELTA K_UGENDELTA K_UGENMAX K_UGENMIN K_UGENOFFPM K_UGTOD K_UKOMPK K_UKOMPM K_UKOMPUBGEN S_ENGENTOGGL S_GENOFFSTPM S_RLEITUNG /end DEF_CHARACTERISTIC
 /begin OUT_MEASUREMENT R_leitung R_leitung_f St_pmukomp St_pmukomp.B_genoffdiag St_pmukomp.B_rl_berok St_pmukomp.B_udgenentpr St_pmukomp2 St_pmukomp2.B_rltg_npl U_dgen U_dyn_komp U_e65komp U_gen U_gen_old U_lcpkomp U_ulcpkomp /end OUT_MEASUREMENT
 /begin IN_MEASUREMENT Batt_ort Dffgen Fahrzeug I_gen St_dgen0 St_dgen0.B_1stbsder St_dgen0.B_genfprl St_dgen0.B_gfbsupak St_dgen0.B_gfelak St_dgen0.B_gfhtak St_dgen0.B_gfmeak St_dgen0.B_gfnobsak St_dgen0.B_kl61 St_gen_ext St_gen_ext.B_gen_ext St_gen_ext.B_ierr_ext St_gen_ext.B_loadre_ext St_gentester St_gentester.B_gentestanf St_loadresp0 St_loadresp0.B_genoffmd St_loadresp0.B_genoffst St_loadresp0.B_sulevvoff St_pmbattmng0 St_pmbattmng0.B_batt_entl St_pmbattmng0.B_bt_timer St_pmbattmng0.B_btmaxfrei St_pmbattmng0.B_btpau St_pmbattmng0.B_dly_tbi St_pmbattmng0.B_ibsok St_pmbattmng0.B_inibumg St_pwf St_pwf.B_pwf St_start St_start.B_jumpstart St_start.B_sta St_start.B_start St_start.B_startende St_start.B_wst St_ugenkor0 St_ugenkor0.B_genoff St_ugenkor0.B_verb_off St_ugenkor1 St_ugenkor1.B_gentoggl U_batt U_bn_soll U_gen2 U_gen_ext U_gentest Ub /end IN_MEASUREMENT
/end FUNCTION
/begin FUNCTION PMVERBENTL ""
 /begin DEF_CHARACTERISTIC K_DELAYDOWN K_DELAYUP K_ENTLMAX K_ENTLTEST K_LASTDOWN K_LASTUP S_ENTLTEST /end DEF_CHARACTERISTIC
 /begin OUT_MEASUREMENT El_last El_verb_entl /end OUT_MEASUREMENT
 /begin IN_MEASUREMENT Ctrpwrentl Ptc_entl St_ipmnaprae St_ipmnaprae.B_entlnkw St_ipmnaprae.B_fl_kk St_ipmnaprae.B_mdkwvoff St_ipmnaprae.B_notafu1 St_pmbattmng2 St_pmbattmng2.B_agmverbaut St_pmbattmng2.B_entladung St_pmbattmng2.B_entlfrei St_pmbattmng2.B_taerr_1 St_pmentl0 St_pmentl0.B_ent4frei St_pmentl0.B_pwrentl Stat_entl /end IN_MEASUREMENT
/end FUNCTION
/begin FUNCTION PMVERBMNG ""
 /begin DEF_CHARACTERISTIC KF_EKPRFNKW KF_WDAFS KL_ELUEFTER KL_ELU_L3 KL_EWP KL_UKRAPU KL_VBUMTL K_DSCUMN K_DSCUMX K_EPSUMN K_EPS_VMAX K_GEBLAKT K_GEBLDUNMX K_GEBLDUPMX K_GEBLUMN K_ID_VBRES1 K_ID_VBRES2 K_ID_VBRES3 K_ID_VBRES4 K_LICHTAKT K_LICHTDUNMX K_LICHTDUPMX K_LICHTUMN K_LWMIN K_PR_GEBLDUN K_PR_GEBLDUP K_PR_LICHTDUN K_PR_LICHTDUP K_PR_VBRES3DUN K_PR_VBRES3DUP K_PR_VBRES4DUN K_PR_VBRES4DUP K_PR_VBTHERM K_SLPAKT K_SLPUMN K_TVBPAUMIN K_TVB_MX K_UBDETU K_UBLMN K_UBTDETU K_VBI_POS K_VBRES1UMN K_VBRES1UMX K_VBRES2UMN K_VBRES2UMX K_VBRES3DUNMX K_VBRES3DUPMX K_VBRES3UMN K_VBRES3UMX K_VBRES4DUNMX K_VBRES4DUPMX K_VBRES4UMN K_VBRES4UMX K_VBRES5UMN K_VBRES5UMX K_VBTHERMUMX K_VB_ON K_VB_STIM K_VERB_CAN K_WISCHERAKT K_WISCHUMN K_WISCHUMX S_ELU_L3 S_EPS_EN S_KEKP S_VBRES1_AK S_VBRES2_AK S_VBRES3_AK S_VBRES4_AK S_VBRES5_AK /end DEF_CHARACTERISTIC
 /begin OUT_MEASUREMENT D_ubatt_vbmw D_ubatt_vbmw2 D_ubatt_vbmwi Pr_geblaese_dn Pr_geblaese_dp Pr_licht_dn Pr_licht_dp Pr_vbres3_dn Pr_vbres3_dp Pr_vbres4_dn Pr_vbres4_dp Pr_vbtherm_mx St_pmvbmng0 St_pmvbmng0.B_geblakt St_pmvbmng0.B_ilichtakt St_pmvbmng0.B_lichtakt St_pmvbmng0.B_slpakt St_pmvbmng0.B_wischerakt St_pmvbmng1 St_pmvbmng1.B_licht St_pmvbmng1.B_vb_timer St_pmvbmng1.B_vbpau St_pmvbmng1.B_vbtherm_fr St_pmvbmng2 St_pmvbmng2.B_vbres1_ak St_pmvbmng2.B_vbres2_ak St_pmvbmng2.B_vbres3_ak St_pmvbmng2.B_vbres4_ak St_pmvbmng2.B_vbres5_ak U_bl_min U_dsc_max U_dsc_min U_elue_min U_eps_min U_ewp_min U_geblaese_dn U_geblaese_dp U_geblaese_min U_krapu_min U_licht_dn U_licht_dp U_licht_min U_slp_min U_vbres1_max U_vbres1_min U_vbres2_max U_vbres2_min U_vbres3_dn U_vbres3_dp U_vbres3_max U_vbres3_min U_vbres4_dn U_vbres4_dp U_vbres4_max U_vbres4_min U_vbres5_max U_vbres5_min U_vbtherm_mx U_wischer_max U_wischer_min Verbstat_0 /end OUT_MEASUREMENT
 /begin IN_MEASUREMENT L_pwmout Newp_soll Nkw Rf St_bls St_bls.B_bls St_igrinnv St_igrinnv.B_cdigronw St_igrinnv.B_cdxenonw St_igrinnv.B_diagigr St_slp St_slp.B_fasls St_slp.B_genslp Tmot Tumg U_batt U_batt_soll V V_krapu Verbstatus W_afs W_dafs /end IN_MEASUREMENT
/end FUNCTION
/begin FUNCTION PM_SERVICES "" /end FUNCTION
/begin FUNCTION QVC ""
 /begin DEF_CHARACTERISTIC KF_U00 KL_SOC0TMP KL_U00QUA_I KL_U00QUA_NF KL_U00QUA_T KL_U00QUA_TR KL_U00QUA_U1 KL_U00QUA_U2 K_D_SUMMAND K_D_URUHE K_MU_ABFALL K_MU_ANSTIEG K_QVCTIM1 K_QVCTIM2 K_QVCTIM3 K_QVCTIM4 K_QVK20 K_QVK20OFS K_QVMAXTGRD K_QVMINVAL K_QVRA K_QVRB K_QVRC K_QVTLIMHI K_QVTLIMLO K_QVVLIMHI K_QVVLIMLO K_QV_DT K_QV_IN K_QV_P0RI K_QV_P0U0L K_QV_RI0 K_QV_RUBAT K_QV_SCHWELLE K_QV_TEST1 K_QV_TKU00 K_QV_TSTU00 K_QV_U0L0 K_QV_UN K_U00QSCHW K_U00emptlim K_U00fulloadlim K_U_SINKEND K_U_STEIGEND /end DEF_CHARACTERISTIC
 /begin OUT_MEASUREMENT I_soc0_komp Qv_Ub00_25grd Qv_cdri Qv_csc Qv_cscn Qv_err Qv_ez Qv_faktf Qv_h Qv_hyscount Qv_ibattn Qv_k20 Qv_k20ofs Qv_kri Qv_ku0l Qv_n_fehlmes Qv_nv_ezm Qv_nv_start Qv_nv_start_stat Qv_nv_zh Qv_pri Qv_pri_1 Qv_pu0l Qv_pu0l_1 Qv_pu0lri Qv_pu0lri_1 Qv_ra Qv_rb Qv_rc Qv_ri Qv_ri0 Qv_rn Qv_rw_h Qv_soc_grob Qv_start_aktuell Qv_stat Qv_t_i Qv_t_ruhzeit Qv_t_u Qv_temp Qv_timer Qv_u00 Qv_u0l Qv_u_0l Qv_u_0u Qv_ubattn U00_quali U00_quali_1 U00_quali_2 U00_quali_3 U00_quali_4 U00_quali_5 U00_quali_6 U0_batt U_diff_12 U_diff_23 U_diff_32 U_ruhe_1 U_ruhe_2 U_ruhe_3 /end OUT_MEASUREMENT
 /begin IN_MEASUREMENT Batt_class I_soc0 Ibs_msgind Ibs_msgsta Ibs_start Ibswchang Qv_cdherst_1 Qv_nstartval Qvary_i Qvary_u St_dibs1 St_dibs1.B_ifbsak St_dibs1.B_ifebsak St_dibs1.B_ifuplak St_ibebsd1 St_ibebsd1.B_eb_busy St_ibebsd1.B_eb_errdir St_ibebsd1.B_eb_txok St_ibebsd1.B_ibs_msgrdy St_ibebsd1.B_ibs_msgwri St_ibsreg4 St_ibsreg4.B_ibspwf St_ibsreg4.B_startfgk St_ibsreg4.B_strtaw St_ibsreg4.B_tiefset St_pwf St_pwf.B_pwf T_battgradi T_battsoc0 T_battsta Tn_abstellm U1soc0_q U2soc0_q U3soc0_q /end IN_MEASUREMENT
/end FUNCTION
/begin FUNCTION QVCH2O ""
 /begin DEF_CHARACTERISTIC KF_QVH2O_FT KF_QVH2O_XH KF_QVH2O_XI KF_QVH2O_XT KF_QVH2O_XU K_QVH2OBAS K_QVH2OEM K_QVH2OQEM K_QVH2OQVOS K_QVH2OSOCB K_QVH2O_BT K_QV_DELAY S_QVH2OSOC S_QVH2O_UM /end DEF_CHARACTERISTIC
 /begin OUT_MEASUREMENT Qv_h2o Qv_h2o_sum Qv_h2oquali Qv_h2ostatus Qv_ubatt_ber Qvh2o_btyp Qvh2o_ft Qvh2o_rate Qvh2o_xh2o Qvh2o_xhsum Qvh2o_xi Qvh2o_xi20 Qvh2o_xsoc Qvh2o_xt Qvh2o_xu St_qvc1 St_qvc1.B_qvch2o /end OUT_MEASUREMENT
 /begin IN_MEASUREMENT Batt_class C_battnenn I_batt Qv_out_m Qvcbackup3 Soc_rel St_pmi St_pmi.B_fabttreg St_pmi.B_fahisrst St_pmi.B_pmrestore St_pwf St_pwf.B_pwf T_batt U_batt /end IN_MEASUREMENT
/end FUNCTION
/begin FUNCTION QVCQUALI ""
 /begin DEF_CHARACTERISTIC KL_QVQ_QWIN K_QVOUTM_DEF K_QVQM_DEF K_QVQ_AUSMX K_QVQ_BFMX K_QVQ_CL K_QVQ_CLR K_QVQ_DELAY K_QVQ_QAUS K_QVQ_SFMX K_QVQ_SZE K_QVQ_SZMX K_QVQ_SZS K_QVQ_TEST1 K_QVQ_TGMX /end DEF_CHARACTERISTIC
 /begin OUT_MEASUREMENT K_QVQ_ANZSTA Qv_aktuell Qv_analyse Qv_bfenster Qv_clr Qv_codaus Qv_grad Qv_grad_m Qv_lcl Qv_m_in Qv_out_1 Qv_out_2 Qv_out_3 Qv_out_4 Qv_out_5 Qv_out_m Qv_outm_int Qv_q_stat Qv_quali_1 Qv_quali_2 Qv_quali_3 Qv_quali_4 Qv_quali_5 Qv_quali_int Qv_quali_m Qv_r Qv_rm Qv_rm_int Qv_sfenster Qv_stand Qv_status Qv_td1 Qv_td2 Qv_td3 Qv_td4 Qv_td5 Qv_ucl Qvc_status_1 Qvc_status_2 Qvc_status_3 Qvc_status_4 /end OUT_MEASUREMENT
 /begin IN_MEASUREMENT Qv_k20 Qv_nv_start Qv_stat Qv_t_ruhzeit Qv_td Qvcbackup1 Qvcbackup2 St_ibsreg4 St_ibsreg4.B_ibspwf St_ibsreg4.B_startfgk St_ibsreg4.B_strtaw St_ibsreg4.B_tiefset St_pmi St_pmi.B_fabttreg St_pmi.B_fahisrst St_pmi.B_pmrestore /end IN_MEASUREMENT
/end FUNCTION
/begin FUNCTION sens_30_32_ "" /begin SUB_FUNCTION BGKUPPL /end SUB_FUNCTION /end FUNCTION
/begin FUNCTION BGKUPPL ""
 /begin DEF_CHARACTERISTIC CW_BGKUPPL CW_LLBITINT K_NV K_NVGMN K_NVGMX K_NVO K_NVV K_TDNVAUS K_TDNVEIN /end DEF_CHARACTERISTIC
 /begin REF_CHARACTERISTIC S_IPM_04 /end REF_CHARACTERISTIC
 /begin OUT_MEASUREMENT Gang_mod Nkw_zu_v St_bgkuppl St_bgkuppl.B_kupp St_bgkuppl.B_kupp1 St_bgkuppl.B_kupp2 St_bgkuppl.B_kupp_ext St_bgkuppl.B_kupp_mod St_bgkuppl1 St_bgkuppl1.B_ll St_tdnvvaus St_tdnvvein /end OUT_MEASUREMENT
 /begin IN_MEASUREMENT Nkw St_anman St_anman.B_2fl_gangi St_anman.B_antieb St_anman.B_antieb_starr St_anman.B_kein_gang St_anman.B_kupp_int St_anman.B_ldm_mdrad St_bgkuppl.B_kupp St_bgkuppl.B_kupp1 St_bgkuppl.B_kupp2 St_bgkuppl.B_kupp_ext St_bgkuppl.B_kupp_mod St_mdk1 St_mdk1.B_md_dynman1 St_mdk1.B_mdzw_min1 St_mdk1.B_mdzw_min2 St_mdk1.B_mdzw_plus St_mdk1.B_zwe_ar St_mdk1.B_zwe_fzdyn St_mdk1.B_zwe_kh St_mdk1.B_zwe_kupp St_mdk1.B_zwe_llr St_mdk1.B_zwe_res St_mdk1.B_zwe_resa St_mdk1.B_zwe_sa St_mdk1.B_zwe_start St_mdk2 St_mdk2.B_accl_plus St_mdk2.B_accs_plus St_mdk2.B_asr_l St_mdk2.B_asr_s St_mdk2.B_gsl_minus St_mdk2.B_gsl_plus St_mdk2.B_gss_minus St_mdk2.B_gss_plus St_mdk2.B_mdres_wm St_mdk2.B_msr_l St_mdk2.B_msr_s St_mdk2.B_smgl_minus St_mdk2.B_smgl_plus St_mdk2.B_smgs_minus St_mdk2.B_smgs_plus St_start St_start.B_jumpstart St_start.B_sta St_start.B_start St_start.B_startende St_start.B_wst V /end IN_MEASUREMENT
/end FUNCTION
/begin FUNCTION eisy_51_65_1_ ""
 /begin SUB_FUNCTION BKV BLSTEMPK EISY EISY_DIAG EISY_DK EISY_EV EISY_LLK EISY_MR EISY_PSREG EISY_SR EISY_VERD MSLAM /end SUB_FUNCTION
/end FUNCTION
/begin FUNCTION BKV ""
 /begin DEF_CHARACTERISTIC KF_DPBKVDOWN KF_DPBKVUP KL_NSLLBKV KL_TBKV K_BKVVERZ K_BLSVERZ K_DPBKV_MN K_MSBKV_MX K_VBKV K_VKBKV K_ZK_DPBKV K_ZK_PBKV /end DEF_CHARACTERISTIC
 /begin OUT_MEASUREMENT Dpbkv Dpbkv_dif_f Dpbkv_dif_of Dpbkv_diff Dpbkv_f Dpbkv_of Msbkv Msbkv_f Nsllbkv /end OUT_MEASUREMENT
 /begin IN_MEASUREMENT Nkw Pu St_bls St_bls.B_bls St_mkwchn St_mkwchn.B_kwdreht St_pwf St_pwf.B_pwf Tans /end IN_MEASUREMENT
/end FUNCTION
/begin FUNCTION BLSTEMPK ""
 /begin DEF_CHARACTERISTIC KF_EFFTANS_FAK KF_EFFTMOT_FAK KF_FW_TBR KF_TEVT_MDL_OFFSET KF_WFTEV KL_FTEVST KL_FTEV_TL KL_FTEV_VL KL_FTVDK KL_TAKORFAK_TMPK KL_TEVT_MDL_AGR KL_TMKORFAK_TMPK KL_TMKORTMPK KL_ZK_TZYLKOR K_DLT_TMKOR K_TANS_PST K_TMOT_PST K_TZYL_PST K_ZKFTEV K_ZKFTEVST K_ZKTEMPK K_ZKTMOT_TEMPK S_FTEV_TANS S_FTPVDKPN S_PVDKPN_F S_WFTEV /end DEF_CHARACTERISTIC
 /begin OUT_MEASUREMENT F_pvdkpn_i F_t_pvdkpn_i F_tevpstnorm F_tevpstnorm_bas_i F_tevpstnorm_i F_tevpstnorm_uf_i F_tvdk F_tvdk_i F_tvdkho F_tvdkho_i F_wftev_i Ftbr_kor Ftev Ftev_i Ftev_kor Ftev_tl_i Ftev_uf_i Ftev_ukorf_i Ftev_vl_i Ftsr_i Ftu_i Tevt_mdl Tevt_mdl_i Tmot_fil_tempk Tmot_tempk_i Tsr_ges_i Tzyl_akt_i Tzyl_akt_tans_i Tzyl_akt_tmot_i /end OUT_MEASUREMENT
 /begin IN_MEASUREMENT Fho Mszyl_i Nkw Pvdkds_f_i Pvdkds_i Rf_i Rfv_hub Rfv_soll_i St_pwf St_pwf.B_pwf St_start St_start.B_jumpstart St_start.B_sta St_start.B_start St_start.B_startende St_start.B_wst Tans_i Tmot Tmot_start Toel /end IN_MEASUREMENT
/end FUNCTION
/begin FUNCTION EISY ""
 /begin DEF_CHARACTERISTIC CW_EISY CW_EISY_TGLE CW_MPR_KOORD KF_RFVIST_ST KL_BANK_EISY KL_MRD_EV KL_PSREGAGR_KOR K_BANKSELEK_EISY K_BANKSELEK_EISYHYS K_DPVDKDS_MN K_DPVDKDS_MX K_EISY_SEG2SCHW K_EISY_SEGSCHW K_RFMIN_EISY K_RFTDINI K_TD_RFSTART K_TD_RFVST K_ZKLF K_ZKLF_STAT K_ZKMRDEV_IN K_ZK_MPRMSFAK K_ZK_MPRMSOFF K_ZK_MREVFAK K_ZK_MREVOFF K_ZK_MSHFM K_ZK_PVDKDSSTAT K_ZK_RFSTART S_MRDEVSOLL_OFF S_MRDEV_OFF S_MRMSLAM_AUTO S_PSPAGR_SOLL S_RFGDST_OFF S_RFINTFG_PERM S_RFINTFG_PIRG S_RFST_ON S_TD_MRDK S_TD_MREVOFF /end DEF_CHARACTERISTIC
 /begin OUT_MEASUREMENT Bank_eisy Eisy_segtoggle Eisyagr_kor_fak_i Eisyagr_korfak_b_i Eisyagr_korfak_f Eisyagr_korfak_f_i Eisydk_kor_fak_i Eisydk_kor_off_i Eisydk_korfak_b_i Eisydk_korfak_f_i Eisydk_koroff_b_i Eisydk_koroff_f_i Eisyev_kor_fak_i Eisyev_kor_off_i Eisyev_korfak_b_i Eisyev_koroff_b_i F_quot_spuel F_quot_spuel_i F_quot_uk_i Mrd_msfakkor_f_i Mrd_msoffkor_f_i Msdk Msdk_i Mshfm_f Mshfm_f_i Mszyl_f_i Mszyl_td_i Psev_i Pssol_pn Pvdkds_f_i Pvdkds_stat_i Rf Rf_f_i Rf_ges_i Rf_hfm_f_i Rf_i Rf_start Rf_td_i Rf_ubeg_i Rfvist_st St_bank_eisy St_bank_eisy.B_bankselek_eisy St_eisy_hfm St_eisy_hfm.B_mrmslam St_eisy_segment St_eisy_segment.B_eisy_dkseg St_eisy_segment.B_eisy_evseg St_pvdkds St_pvdkds.B_pvdkds_stat St_stend_verz St_stend_verz.B_startende_rfvst /end OUT_MEASUREMENT
 /begin IN_MEASUREMENT Drf_spuel_i Drf_uk_i F_agrad F_tzylkor F_umsrfn Hubev_soll Mrd_ms_fak_i Mrd_ms_off_i Mszyl_i Nkw Pr_ms_fak_i Pr_ms_off_i Pspvdk_i Pspvdk_soll_i Pssol Pvdkds Pvdkds_i St_dps St_dps.B_dpsadp St_dps.B_gd St_dps.B_gdst St_dps.B_gdvhub St_eisy_psreg St_eisy_psreg.B_pddssmn St_eisy_psreg.B_pddssmx St_eisy_psreg.B_psreg_akt St_eisy_psreg.B_psreg_off St_start St_start.B_jumpstart St_start.B_sta St_start.B_start St_start.B_startende St_start.B_wst Td_mslampt1 Td_mszyl /end IN_MEASUREMENT
/end FUNCTION
/end MODULE
/end PROJECT
