ASAP2_VERSION 1 3
/begin PROJECT _725D601B "725D601B"
/begin HEADER "" VERSION "_725D601B" PROJECT_NO _725D601B /end HEADER
/begin MODULE DIM ""
/begin MOD_COMMON "" BYTE_ORDER MSB_FIRST ALIGNMENT_BYTE 1 ALIGNMENT_WORD 2 ALIGNMENT_LONG 2 ALIGNMENT_FLOAT32_IEEE 4 /end MOD_COMMON
/begin CHARACTERISTIC ADCC_MX_UM "Maximaler ADC-Wert bei nach low verzogenem ADC-Kanal bei der ADC-Pr¸fung" VALUE 0xFCED34 KwUb 2.490 spg_ub_q0p0098 0.00 2.490 FORMAT "%5.3" /end CHARACTERISTIC
/begin CHARACTERISTIC ADCC_T_UM "Fehlerzeit bei zueinander unplausiblen ADC-Werten f¸r sp1s" VALUE 0xFCED35 KwUb 5100.00 t20ms_ub_b5100 0.00 5100.00 /end CHARACTERISTIC
/begin CHARACTERISTIC ADCQ_T_UM "Fehlerzeit bei defekter ADC-Queue in der Queue¸berwachung" VALUE 0xFCED36 KwUb 2550.00 t10ms_ub_b2550 0.00 2550.00 /end CHARACTERISTIC
/begin CHARACTERISTIC ANWFOZA "Anzahl NW-Umdr. f¸r Z¸ndausblendung bei fuel-off Adaption" VALUE 0xFCDAC7 KwUb 255.0 dez 0.00 255.0 FORMAT "%5.1" /end CHARACTERISTIC
/begin CHARACTERISTIC AUSCH_T_UM "Maximale Anzahl von Antworten an das UM zur Heilung des FZ im Abschaltpfadtest" VALUE 0xFCF41A KwUb 255.0 dez 0.00 255.0 FORMAT "%5.1" /end CHARACTERISTIC
/begin CHARACTERISTIC AUSC_T_UM "zul‰ssige Anzahl von Pr¸fungen auf nicht angezogenes Hauptrelais in %UMAUSC" VALUE 0xFCF41B KwUb 255.0 dez 0.00 255.0 FORMAT "%5.1" /end CHARACTERISTIC
/begin CHARACTERISTIC AUSGH_T_UM "Heilungszeit f¸r Fehler in der zyklischen RAM-Pr¸fung der Funktions¸berwachung" VALUE 0xFCED40 KwUb 10200.0 t40ms_ub_b10200 0.00 10200.0 FORMAT "%7.1" /end CHARACTERISTIC
/begin CHARACTERISTIC AUSG_T_UM "Fehlertoleranzschwelle f¸r zyklische RAM-Pr¸fung in der Funktions¸berwachung" VALUE 0xFCED41 KwUb 255.0 dezsub1 1.000 256.0 FORMAT "%5.1" /end CHARACTERISTIC
/begin CHARACTERISTIC AUSZH_T_UM "Heilungszeit f¸r Fehler in der zyklischen ROM-Pr¸fung der Funktions¸berwachung" VALUE 0xFCED42 KwUb 10200.0 t40ms_ub_b10200 0.00 10200.0 FORMAT "%7.1" /end CHARACTERISTIC
/begin CHARACTERISTIC AUSZ_T_UM "Fehlertoleranzschwelle f¸r zyklische ROM-Pr¸fung in der Funktions¸berwachung" VALUE 0xFCED43 KwUb 255.0 dezsub1 1.000 256.0 FORMAT "%5.1" /end CHARACTERISTIC
/begin CHARACTERISTIC AVVTPERS "Periodendauer Enable-Signal" VALUE 0xFC5EFE KwWU8 8.000 txms_ub_q0p1 2.000 10.00 FORMAT "%5.2" /end CHARACTERISTIC
/begin CHARACTERISTIC AVVTSSTST "" VALUE 0xFC5EFF KwWU8 25.50 t100msxs_ub_b25p5 0.00 25.50 FORMAT "%5.2" /end CHARACTERISTIC
/begin CHARACTERISTIC AVVTTVNOT "Tastverhaeltnis fuer Notlaufanforderung ueber Enable-Signal" VALUE 0xFC5EF8 KwWS16 200.000 vnstv_q0p01 -100.000 100.000 FORMAT "%7.3" /end CHARACTERISTIC
/begin CHARACTERISTIC AVVTTVOFF "Tastverhaeltnis fuer Ruhezustand am Enable-Ausgang" VALUE 0xFC5EFA KwWS16 200.000 vnstv_q0p01 -100.000 100.000 FORMAT "%7.3" /end CHARACTERISTIC
/begin CHARACTERISTIC AVVTTVTST "Tastverhaeltnis fuer Testsignal am Enable-Ausgang" VALUE 0xFC5EFC KwWS16 200.000 vnstv_q0p01 -100.000 100.000 FORMAT "%7.3" /end CHARACTERISTIC
/begin CHARACTERISTIC B_APP_UGEN "Umschaltung auf manuelle Generatorspannungsvorgabe" VALUE 0xFCC66A KwWU8 255.0 dez 0.00 255.0 FORMAT "%5.1" /end CHARACTERISTIC
/begin CHARACTERISTIC CWDMTLEOL "Codewort f¸r Erkennung Bandendetest" VALUE 0xFD4F70 KwWU16 65535.00 dez 0.00 65535.00 FORMAT "%8.2" /end CHARACTERISTIC
/begin CHARACTERISTIC CWDMTLEXT "Codewort f¸r Erkennung externer Modus des Zustandsautomaten" VALUE 0xFD4F72 KwWU16 65535.00 dez 0.00 65535.00 FORMAT "%8.2" /end CHARACTERISTIC
/begin CHARACTERISTIC CWDMTLGL "Codewort f¸r Grobleckdiagnose" VALUE 0xFD4F74 KwWU16 65535.00 dez 0.00 65535.00 FORMAT "%8.2" /end CHARACTERISTIC
/begin CHARACTERISTIC CWDMTLKL "Codewort f¸r Erkennung Feinleckdiagnose" VALUE 0xFD4F76 KwWU16 65535.00 dez 0.00 65535.00 FORMAT "%8.2" /end CHARACTERISTIC
/begin CHARACTERISTIC CWDVMX "Codewort SW-Schalter f¸r Integratorinit. bei VMAX-Regelung" VALUE 0xFD3E74 KwUb 255.0 dez 0.00 255.0 FORMAT "%5.1" /end CHARACTERISTIC
/begin CHARACTERISTIC CWVMAXCOD "Codewort VMAX-Codierung aktiv" VALUE 0xFCA308 KwUb 255.0 dez 0.00 255.0 FORMAT "%5.1" /end CHARACTERISTIC
/begin CHARACTERISTIC CWVMAXIDX "Index der Vmax-Regelung" VALUE 0xFCA309 KwUb 255.0 dez 0.00 255.0 FORMAT "%5.1" /end CHARACTERISTIC
/begin CHARACTERISTIC CWVVTCHK "Activation VVTCHK functions" VALUE 0xFC5EF0 KwWU8 255.0 DEZ 0.00 255.0 FORMAT "%5.1" /end CHARACTERISTIC
/begin CHARACTERISTIC CWVVTLERN "Codewort Anschlaglernen VVT" VALUE 0xFC5EF1 KwWU8 255.0 DEZ 0.00 255.0 FORMAT "%5.1" /end CHARACTERISTIC
/begin CHARACTERISTIC CWVVTLERN2 "Codewort Anschlaglernen VVT Bank 2" VALUE 0xFC5EF2 KwWU8 255.0 DEZ 0.00 255.0 FORMAT "%5.1" /end CHARACTERISTIC
/begin CHARACTERISTIC CWZADMTL "Codewort ZADMTL-Funktion" VALUE 0xFD4F9A KwWU8 255.0 dez 0.00 255.0 FORMAT "%5.1" /end CHARACTERISTIC
/begin CHARACTERISTIC CW_BDE_UM "Codewort f¸r Benzindirekteinspritzung in Funktions¸berwachung" VALUE 0xFCF0DF KwUb 255.0 dez 0.00 255.0 FORMAT "%5.1" /end CHARACTERISTIC
/begin CHARACTERISTIC CW_BNSUMAX "" VALUE 0xFCC66B KwWU8 255.0 DEZ 0.00 255.0 FORMAT "%5.1" /end CHARACTERISTIC
/begin CHARACTERISTIC CW_NOCYCLROMCHK_UM "" VALUE 0xFCED44 KwUb 255.0 dez 0.00 255.0 FORMAT "%5.1" /end CHARACTERISTIC
/begin CHARACTERISTIC CW_NOROMCHKRESET "" VALUE 0xFC0990 KwUb 255.0 dez 0.00 255.0 FORMAT "%5.1" /end CHARACTERISTIC
/begin CHARACTERISTIC DBEGSMX_UM "Maximale Botschaftsz‰lerdifferenz bei ‹berwachung der EGS-Botschaft" VALUE 0xFCF0F4 KwUb 2550.00 t10ms_ub_b2550 0.00 2550.00 /end CHARACTERISTIC
/begin CHARACTERISTIC DBEGS_T_UM "Fehlerzeit bei Fehler in Botschaftsz‰hler der EGS-Botschaft" VALUE 0xFCF0F5 KwUb 2550.00 t10ms_ub_b2550 0.00 2550.00 /end CHARACTERISTIC
/begin CHARACTERISTIC DIPTGEOL "Mindest-Stromhub bei Bandendetest" VALUE 0xFD4F78 KwWU16 399.9939 i_q6p1035_uA 0.00 399.9939 FORMAT "%8.4" /end CHARACTERISTIC
/begin CHARACTERISTIC DIPTGFT "Mindeststromhub bei Feld-Test" VALUE 0xFD4F7A KwWU16 399.9939 i_q6p1035_uA 0.00 399.9939 FORMAT "%8.4" /end CHARACTERISTIC
/begin CHARACTERISTIC DIPTREF "Offset Referenzpumpenstrom" VALUE 0xFD4F7C KwWS16 399.9939 i_q6p1035_uA -200.0000 199.9939 FORMAT "%8.4" /end CHARACTERISTIC
/begin CHARACTERISTIC DIPTSTAB "delta Pumpenstrom fuer Pumpenstrom stabil" VALUE 0xFD4F7E KwWU16 399.9939 i_q6p1035_uA 0.00 399.9939 FORMAT "%8.4" /end CHARACTERISTIC
/begin CHARACTERISTIC DMTFGVT "Ersatzwert f¸r freies Gasvolumen im Tank" VALUE 0xFD4F80 KwWU16 6553.500 vol_q0p1_l 0.00 6553.500 FORMAT "%8.3" /end CHARACTERISTIC
/begin CHARACTERISTIC DPIPFIL_UM "Filter-Zeitkonstante f¸r verzˆgerte Druckinfo dpipf_um in d. Funktions¸berwachun" VALUE 0xFCEDD4 KwUb 10159.4 zk40ms_ub_b10200 40.6299 10200.0 FORMAT "%7.1" /end CHARACTERISTIC
/begin CHARACTERISTIC DPIPTV_UM "Verzugszeit f¸r Druckinfo dpipf_um in der Funktions¸berwachung" VALUE 0xFCEDD5 KwUb 320.000 t40ms_ub_b10200 0.00 320.000 FORMAT "%7.3" /end CHARACTERISTIC
/begin CHARACTERISTIC DPSRIMN "dps I-Regler minimal" VALUE 0xFD1434 KwUw 2559.96 p_q0p039s32768 -1280.00 1279.96 FORMAT "%7.2" /end CHARACTERISTIC
/begin CHARACTERISTIC DPSRIMX "dps I-Regler maximal" VALUE 0xFD1436 KwUw 2559.96 p_q0p039s32768 -1280.00 1279.96 FORMAT "%7.2" /end CHARACTERISTIC
/begin CHARACTERISTIC DPSRMN "dps Regler minimal" VALUE 0xFD1438 KwSw 2559.961 p_q0p039 -1280.000 1279.961 FORMAT "%8.3" /end CHARACTERISTIC
/begin CHARACTERISTIC DPSRMX "dps Regler maximal" VALUE 0xFD143A KwSw 2559.961 p_q0p039 -1280.000 1279.961 FORMAT "%8.3" /end CHARACTERISTIC
/begin CHARACTERISTIC DPS_T_UM "Fehlertoleranzzeit f¸r unplausible Druckinfo f.d. Funktions¸berwachung" VALUE 0xFCEDD6 KwUb 10200.0 t40ms_ub_b10200 0.00 10200.0 FORMAT "%7.1" /end CHARACTERISTIC
/begin CHARACTERISTIC DZWAML "Auf/Abregelgeschwindigkeit zwischen den Begrenzungskennfeldern" CURVE 0xFD52DE KlAUbSstUbWSb 191.3 zw_sb_q0p75 -96.00 95.25 FORMAT "%5.2"
 /begin AXIS_DESCR STD_AXIS ml m_ub_b1020 12 0.00 1020. FORMAT "%5.0" DEPOSIT ABSOLUTE /end AXIS_DESCR
/end CHARACTERISTIC
/begin CHARACTERISTIC DZWSPM "Delta sp‰tester Z¸ndwinkel abh‰ngig von Motortemperatur" CURVE 0xFD52D8 GklWSb 191.3 zw_sb_q0p75 -96.00 95.25 FORMAT "%5.2"
 /begin AXIS_DESCR COM_AXIS tmot temp_ub_q0p75_o48 6 -48.00 143.3 FORMAT "%5.1" AXIS_PTS_REF STM06__UB /end AXIS_DESCR
/end CHARACTERISTIC
/begin CHARACTERISTIC DZWSTTA "Delta Z¸ndwinkel im Start (VVT)" CURVE 0xFCEAC2 KlAxU8SstxU8WS8 191.3 zw_sb_q0p75 -96.00 95.25 FORMAT "%5.2"
 /begin AXIS_DESCR STD_AXIS tans temp_ub_q0p75_o48 4 -48.00 143.3 FORMAT "%5.1" DEPOSIT ABSOLUTE /end AXIS_DESCR
/end CHARACTERISTIC
/begin CHARACTERISTIC DZWSTTAT "Delta Z¸ndwinkel im Start (gd)" CURVE 0xFCEACB KlAxU8SstxU8WS8 191.3 zw_sb_q0p75 -96.00 95.25 FORMAT "%5.2"
 /begin AXIS_DESCR STD_AXIS tans temp_ub_q0p75_o48 4 -48.00 143.3 FORMAT "%5.1" DEPOSIT ABSOLUTE /end AXIS_DESCR
/end CHARACTERISTIC
/begin CHARACTERISTIC ENGENTOGGL "" VALUE 0xFCC66C KwWU8 255.0 DEZ 0.00 255.0 FORMAT "%5.1" /end CHARACTERISTIC
/begin CHARACTERISTIC EVHUBMX_UM "Maximalwert des plausibilisierbaren Ventilhubs" VALUE 0xFCEDD7 KwUb 16.32 hub_ub_q0p064 0.00 16.32 FORMAT "%5.2" /end CHARACTERISTIC
/begin CHARACTERISTIC FIP2STAB "Faktor Zeit f¸r 2 stabilisierung" VALUE 0xFD4F82 KwWU16 0.9999847 fak_uw_b1 0.00 0.9999847 FORMAT "%9.7" /end CHARACTERISTIC
/begin CHARACTERISTIC FIPTCF "Faktor delta Pumpenstrom fuer check filler cap" CURVE 0xFD4E90 KlAxU8SstxU16WU16 0.9999847 fak_uw_b1 0.00 0.9999847 FORMAT "%9.7"
 /begin AXIS_DESCR STD_AXIS iptgh_w i_q6p1035_uA 8 0.00 399.9939 FORMAT "%8.4" DEPOSIT ABSOLUTE /end AXIS_DESCR
/end CHARACTERISTIC
/begin CHARACTERISTIC FIPTEL "Faktor delta Pumpenstrom fuer Grobleckerkennung am Bandende" CURVE 0xFD4EB2 KlAxU8SstxU16WU16 0.9999847 fak_uw_b1 0.00 0.9999847 FORMAT "%9.7"
 /begin AXIS_DESCR STD_AXIS iptgh_w i_q6p1035_uA 8 0.00 399.9939 FORMAT "%8.4" DEPOSIT ABSOLUTE /end AXIS_DESCR
/end CHARACTERISTIC
/begin CHARACTERISTIC FIPTGL "Faktor delta Pumpenstrom fuer Grobleckerkennung" CURVE 0xFD4ED4 KlAxU8SstxU16WU16 0.9999847 fak_uw_b1 0.00 0.9999847 FORMAT "%9.7"
 /begin AXIS_DESCR STD_AXIS iptgh_w i_q6p1035_uA 8 0.00 399.9939 FORMAT "%8.4" DEPOSIT ABSOLUTE /end AXIS_DESCR
/end CHARACTERISTIC
/begin CHARACTERISTIC FIPTGLR "Faktor delta Pumpenstrom fuer Grobleckerkennung in Bezug auf Referenz" CURVE 0xFD4EF6 KlAxU8SstxU16WU16 0.9999847 fak_uw_b1 0.00 0.9999847 FORMAT "%9.7"
 /begin AXIS_DESCR STD_AXIS iptgh_w i_q6p1035_uA 8 0.00 399.9939 FORMAT "%8.4" DEPOSIT ABSOLUTE /end AXIS_DESCR
/end CHARACTERISTIC
/begin CHARACTERISTIC FZWKHMX "Normierung f¸r Faktor Momentenreserve Katheizen" VALUE 0xFCE700 KwUb 0.9961 fak_ub_b1 0.00 0.9961 /end CHARACTERISTIC
/begin CHARACTERISTIC GENOFFTIME "maximale Generatorauszeit" VALUE 0xFCC658 KwWU16 6553.500 t100msxs_uw_b6553p5 0.00 6553.500 FORMAT "%8.3" /end CHARACTERISTIC
/begin CHARACTERISTIC GENUMAX "maximale Generatorspannung" VALUE 0xFCC65A KwWU16 16.00000 spg_sw_q0p001 0.00 16.00000 FORMAT "%8.5" /end CHARACTERISTIC
/begin CHARACTERISTIC GENURAMP "Spannungs‰nderung ugen V/100ms" VALUE 0xFCC65C KwWU16 20.00000 spg_sw_q0p001 0.00 20.00000 FORMAT "%8.5" /end CHARACTERISTIC
/begin CHARACTERISTIC GENURAMPOF "Spannungsinkrement fuer Rampe, Generator ausschalten" VALUE 0xFCC65E KwWU16 20.00000 spg_sw_q0p001 0.00 20.00000 FORMAT "%8.5" /end CHARACTERISTIC
/begin CHARACTERISTIC GEN_APP_UG "Manuelle Generatorspannungsvorgabe" VALUE 0xFCC660 KwWU16 16.00000 spg_sw_q0p001 0.00 16.00000 FORMAT "%8.5" /end CHARACTERISTIC
/begin AXIS_PTS HUBV08_UM "" 0xFCEDD8 evhubi_um SstAUbSstUb 16.32 hub_ub_q0p064 8 0.00 16.32 FORMAT "%5.2" DEPOSIT ABSOLUTE /end AXIS_PTS
/begin CHARACTERISTIC IP1A_MX_UM "max. Spannung f¸r DK-Istwert-Poti 1 am unteren Anschlag f¸r die Funktions¸berw." VALUE 0xFCEDE1 KwUb 4.980 spg_ub_q0p019 0.00 4.980 FORMAT "%5.3" /end CHARACTERISTIC
/begin CHARACTERISTIC IP2A_MN_UM "min. Spannung f¸r DK-Istwert-Poti 2 am unteren Anschlag f¸r die Funktions¸berw." VALUE 0xFCEDE2 KwUb 4.980 spg_ub_q0p019 0.00 4.980 FORMAT "%5.3" /end CHARACTERISTIC
/begin CHARACTERISTIC IPA_T_UM "Fehlertoleranzzeit f¸r unteren DK-Anschlag im ung¸ltigen Bereich f. d. Fkt¸berw." VALUE 0xFCEDE3 KwUb 10200.0 t40ms_ub_b10200 0.00 10200.0 FORMAT "%7.1" /end CHARACTERISTIC
/begin AXIS_PTS IPSNV08_UM "St¸tzstellenverteilung DK-Ist-Wert-Poti" 0xFCEDE4 ipsn_um SstAUbSstUb 4.980 spg_ub_q0p019 8 0.00 4.980 FORMAT "%5.3" DEPOSIT ABSOLUTE /end AXIS_PTS
/begin CHARACTERISTIC IPTGHTOL "Toleranz bei DMTL-Stromhubpr¸fung" VALUE 0xFD4F84 KwWU16 399.9939 i_q6p1035_uA 0.00 399.9939 FORMAT "%8.4" /end CHARACTERISTIC
/begin CHARACTERISTIC IPTGMX "Maximaler Pumpstrom DM-TL (Initialisierungswert)" VALUE 0xFD4F86 KwWU16 399.9939 i_q6p1035_uA 0.00 399.9939 FORMAT "%8.4" READ_ONLY /end CHARACTERISTIC
/begin CHARACTERISTIC IPTREFO "obere Schwelle Pumpenstrom bei Referenzmessung" VALUE 0xFD4F88 KwWU16 399.9939 i_q6p1035_uA 0.00 399.9939 FORMAT "%8.4" /end CHARACTERISTIC
/begin CHARACTERISTIC IPTREFU "untere Schwelle Pumpenstrom bei Referenzmessung" VALUE 0xFD4F8A KwWU16 399.9939 i_q6p1035_uA 0.00 399.9939 FORMAT "%8.4" /end CHARACTERISTIC
/begin CHARACTERISTIC KFDMP0_UM "Kennfeld 0 f¸r pedalabh‰ngigen Teil der Verlustmomente" MAP 0xFCF20A GkfWUb 99.61 rel_ub_b99p6 0.00 99.61 FORMAT "%5.2"
 /begin AXIS_DESCR COM_AXIS spsn_um spg_ub_q0p019 8 0.00 4.980 FORMAT "%5.3" AXIS_PTS_REF SPSNV08_UM /end AXIS_DESCR
 /begin AXIS_DESCR COM_AXIS nmot_um nmot_ub_q40 8 0.00 10200. FORMAT "%5.0" AXIS_PTS_REF NMV08_UM /end AXIS_DESCR
/end CHARACTERISTIC
/begin CHARACTERISTIC KFDMP1_UM "Kennfeld 1 f¸r pedalabh‰ngigen Teil der Verlustmomente" MAP 0xFCF24A GkfWUb 99.61 rel_ub_b99p6 0.00 99.61 FORMAT "%5.2"
 /begin AXIS_DESCR COM_AXIS spsn_um spg_ub_q0p019 8 0.00 4.980 FORMAT "%5.3" AXIS_PTS_REF SPSNV08_UM /end AXIS_DESCR
 /begin AXIS_DESCR COM_AXIS nmot_um nmot_ub_q40 8 0.00 10200. FORMAT "%5.0" AXIS_PTS_REF NMV08_UM /end AXIS_DESCR
/end CHARACTERISTIC
/begin CHARACTERISTIC KFDMT0_UM "Kennfeld 0 zur Ber¸cksichtigung temperaturabh‰ngiger Momente" MAP 0xFCF28A GkfWUb 99.61 rel_ub_b99p6 0.00 99.61 FORMAT "%5.2"
 /begin AXIS_DESCR COM_AXIS tmotmn_um temp_ub_q0p75_o48 8 -48.00 143.3 FORMAT "%5.1" AXIS_PTS_REF TMOV08_UM /end AXIS_DESCR
 /begin AXIS_DESCR COM_AXIS nmot_um nmot_ub_q40 8 0.00 10200. FORMAT "%5.0" AXIS_PTS_REF NMV08_UM /end AXIS_DESCR
/end CHARACTERISTIC
/begin CHARACTERISTIC KFDMT1_UM "Kennfeld 1 zur Ber¸cksichtigung temperaturabh‰ngiger Momente" MAP 0xFCF2CA GkfWUb 99.61 rel_ub_b99p6 0.00 99.61 FORMAT "%5.2"
 /begin AXIS_DESCR COM_AXIS tmotmn_um temp_ub_q0p75_o48 8 -48.00 143.3 FORMAT "%5.1" AXIS_PTS_REF TMOV08_UM /end AXIS_DESCR
 /begin AXIS_DESCR COM_AXIS nmot_um nmot_ub_q40 8 0.00 10200. FORMAT "%5.0" AXIS_PTS_REF NMV08_UM /end AXIS_DESCR
/end CHARACTERISTIC
/begin CHARACTERISTIC KFDPIP_UM "Kennfeld f¸r Druck - Berechnung aus Drosselklappenwinkel in der Funktions¸berwac" MAP 0xFCEDED KfAxUbAyUbSstxUbSstyUbWUb 1275. p_q5 0.00 1275. FORMAT "%5.0"
 /begin AXIS_DESCR STD_AXIS ipsn_um spg_ub_q0p019 8 0.00 4.980 FORMAT "%5.3" DEPOSIT ABSOLUTE /end AXIS_DESCR
 /begin AXIS_DESCR STD_AXIS nmot_um nmot_ub_q40 8 0.00 10200. FORMAT "%5.0" DEPOSIT ABSOLUTE /end AXIS_DESCR
/end CHARACTERISTIC
/begin CHARACTERISTIC KFDZWLKH "Delta Z¸ndwinkel Katheizen im Warmlauf" MAP 0xFD52F7 KfAxUbAyUbSstxUbSstyUbWSb 191.3 zw_sb_q0p75 -96.00 95.25 FORMAT "%5.2"
 /begin AXIS_DESCR STD_AXIS nmot nmot_ub_q40 2 0.00 10200. FORMAT "%5.0" DEPOSIT ABSOLUTE /end AXIS_DESCR
 /begin AXIS_DESCR STD_AXIS rl rel_ub_q0p75 2 0.00 191.3 FORMAT "%5.1" DEPOSIT ABSOLUTE /end AXIS_DESCR
/end CHARACTERISTIC
/begin CHARACTERISTIC KFDZWLKHLL "Delta Z¸ndwinkel Katheizen im Warmlauf und Leerlauf" MAP 0xFD5301 KfAxUbAyUbSstxUbSstyUbWSb 191.3 zw_sb_q0p75 -96.00 95.25 FORMAT "%5.2"
 /begin AXIS_DESCR STD_AXIS nmot nmot_ub_q40 2 0.00 10200. FORMAT "%5.0" DEPOSIT ABSOLUTE /end AXIS_DESCR
 /begin AXIS_DESCR STD_AXIS rl rel_ub_q0p75 2 0.00 191.3 FORMAT "%5.1" DEPOSIT ABSOLUTE /end AXIS_DESCR
/end CHARACTERISTIC
/begin CHARACTERISTIC KFDZWTHFAK "" MAP 0xFCDC30 KfAxU8AyU8SstxU8SstyU8WU8 0.9961 fak_ub_b1 0.00 0.9961
 /begin AXIS_DESCR STD_AXIS nmot nmot_ub_q40 4 0.00 10200. FORMAT "%5.0" DEPOSIT ABSOLUTE /end AXIS_DESCR
 /begin AXIS_DESCR STD_AXIS tans temp_ub_q0p75_o48 3 -48.00 143.3 FORMAT "%5.1" DEPOSIT ABSOLUTE /end AXIS_DESCR
/end CHARACTERISTIC
/begin CHARACTERISTIC KFFWK "Faktoren - Kennfeld f¸r KFWK" MAP 0xFCE3DC GkfWSb 0.9922 fak_sb_b1 0.00 0.9922
 /begin AXIS_DESCR COM_AXIS nmot nmot_ub_q40 24 0.00 10200. FORMAT "%5.0" AXIS_PTS_REF SNM24ZUUB /end AXIS_DESCR
 /begin AXIS_DESCR COM_AXIS rl rel_ub_q0p75 16 0.00 191.3 FORMAT "%5.1" AXIS_PTS_REF SRL16ZUUB /end AXIS_DESCR
/end CHARACTERISTIC
/begin CHARACTERISTIC KFFWLTMKH "Wichtung Warmlauf-Z¸ndwinkel f¸r Katheizen" MAP 0xFCEAD4 KfAxU8AyU8SstxU16SstyU16WU16 0.9960938 fak_ub_b1 0.00 0.9960938 FORMAT "%9.7"
 /begin AXIS_DESCR STD_AXIS tmot temp_ub_q0p75_o48 2 -48.00 143.3 FORMAT "%5.1" DEPOSIT ABSOLUTE /end AXIS_DESCR
 /begin AXIS_DESCR STD_AXIS tnst_w t10msxs_uw_b655p35 2 0.00 655.3500 FORMAT "%8.4" DEPOSIT ABSOLUTE /end AXIS_DESCR
/end CHARACTERISTIC
/begin CHARACTERISTIC KFFWMXA "Kennfeld zur Wichtung Z¸ndwinkelkorrektur" MAP 0xFD5284 KfAxUbAyUbSstxUbSstyUbWUb 1.992 fak_ub_b2 0.00 1.992 FORMAT "%5.3"
 /begin AXIS_DESCR STD_AXIS nmot nmot_ub_q40 6 0.00 10200. FORMAT "%5.0" DEPOSIT ABSOLUTE /end AXIS_DESCR
 /begin AXIS_DESCR STD_AXIS rlkr rel_ub_q0p75 6 0.00 191.3 FORMAT "%5.1" DEPOSIT ABSOLUTE /end AXIS_DESCR
/end CHARACTERISTIC
/begin CHARACTERISTIC KFKSZW "Z¸ndwinkelkennfeld bei Klopfschutz" MAP 0xFCE55C GkfWSb 191.3 zw_sb_q0p75 -96.00 95.25 FORMAT "%5.2"
 /begin AXIS_DESCR COM_AXIS nmot nmot_ub_q40 24 0.00 10200. FORMAT "%5.0" AXIS_PTS_REF SNM24ZUUB /end AXIS_DESCR
 /begin AXIS_DESCR COM_AXIS rl rel_ub_q0p75 16 0.00 191.3 FORMAT "%5.1" AXIS_PTS_REF SRL16ZUUB /end AXIS_DESCR
/end CHARACTERISTIC
/begin CHARACTERISTIC KFLVVTM_UM "" MAP 0xFCEE3F KfAxUbAyUbSstxUbSstyUbWUb 191.3 rel_ub_q0p75 0.00 191.3 FORMAT "%5.1"
 /begin AXIS_DESCR STD_AXIS evhubim_um hub_ub_q0p064 8 0.00 16.32 FORMAT "%5.2" DEPOSIT ABSOLUTE /end AXIS_DESCR
 /begin AXIS_DESCR STD_AXIS nmot_um nmot_ub_q40 8 0.00 10200. FORMAT "%5.0" DEPOSIT ABSOLUTE /end AXIS_DESCR
/end CHARACTERISTIC
/begin CHARACTERISTIC KFLVVT_UM "Kennfeld f¸r rl-Berechnung aus der VVT-Stellung" MAP 0xFCEE91 KfAxUbAyUbSstxUbSstyUbWUb 191.3 rel_ub_q0p75 0.00 191.3 FORMAT "%5.1"
 /begin AXIS_DESCR STD_AXIS evhubi_um hub_ub_q0p064 8 0.00 16.32 FORMAT "%5.2" DEPOSIT ABSOLUTE /end AXIS_DESCR
 /begin AXIS_DESCR STD_AXIS nmot_um nmot_ub_q40 8 0.00 10200. FORMAT "%5.0" DEPOSIT ABSOLUTE /end AXIS_DESCR
/end CHARACTERISTIC
/begin CHARACTERISTIC KFMIRD "Kennfeld Abregelungsmoment f¸r VMAX-Regelung" MAP 0xFD3E75 GkfWUb 99.61 rel_ub_b99p6 0.00 99.61 FORMAT "%5.2"
 /begin AXIS_DESCR COM_AXIS bfzglf bfzg_sb_q0p217 4 -27.78 27.56 FORMAT "%5.2" AXIS_PTS_REF SBF02MFSB /end AXIS_DESCR
 /begin AXIS_DESCR COM_AXIS rl_w rel_uw_q0p0234 4 0.00 1535.977 FORMAT "%8.3" AXIS_PTS_REF SRL03MFUW /end AXIS_DESCR
/end CHARACTERISTIC
/begin CHARACTERISTIC KFMIRD1 "Kennfeld Abregelungsmoment f¸r VMAX-Regelung" MAP 0xFD3E85 GkfWUb 99.61 rel_ub_b99p6 0.00 99.61 FORMAT "%5.2"
 /begin AXIS_DESCR COM_AXIS bfzglf bfzg_sb_q0p217 4 -27.78 27.56 FORMAT "%5.2" AXIS_PTS_REF SBF02MFSB /end AXIS_DESCR
 /begin AXIS_DESCR COM_AXIS rl_w rel_uw_q0p0234 4 0.00 1535.977 FORMAT "%8.3" AXIS_PTS_REF SRL03MFUW /end AXIS_DESCR
/end CHARACTERISTIC
/begin CHARACTERISTIC KFMIRD2 "Kennfeld Abregelungsmoment f¸r VMAX-Regelung" MAP 0xFD3E95 GkfWUb 99.61 rel_ub_b99p6 0.00 99.61 FORMAT "%5.2"
 /begin AXIS_DESCR COM_AXIS bfzglf bfzg_sb_q0p217 4 -27.78 27.56 FORMAT "%5.2" AXIS_PTS_REF SBF02MFSB /end AXIS_DESCR
 /begin AXIS_DESCR COM_AXIS rl_w rel_uw_q0p0234 4 0.00 1535.977 FORMAT "%8.3" AXIS_PTS_REF SRL03MFUW /end AXIS_DESCR
/end CHARACTERISTIC
/begin CHARACTERISTIC KFMIRD3 "Kennfeld Abregelungsmoment f¸r VMAX-Regelung" MAP 0xFD3EA5 GkfWUb 99.61 rel_ub_b99p6 0.00 99.61 FORMAT "%5.2"
 /begin AXIS_DESCR COM_AXIS bfzglf bfzg_sb_q0p217 4 -27.78 27.56 FORMAT "%5.2" AXIS_PTS_REF SBF02MFSB /end AXIS_DESCR
 /begin AXIS_DESCR COM_AXIS rl_w rel_uw_q0p0234 4 0.00 1535.977 FORMAT "%8.3" AXIS_PTS_REF SRL03MFUW /end AXIS_DESCR
/end CHARACTERISTIC
/begin CHARACTERISTIC KFMIRD4 "Kennfeld Abregelungsmoment f¸r VMAX-Regelung" MAP 0xFD3EB5 GkfWUb 99.61 rel_ub_b99p6 0.00 99.61 FORMAT "%5.2"
 /begin AXIS_DESCR COM_AXIS bfzglf bfzg_sb_q0p217 4 -27.78 27.56 FORMAT "%5.2" AXIS_PTS_REF SBF02MFSB /end AXIS_DESCR
 /begin AXIS_DESCR COM_AXIS rl_w rel_uw_q0p0234 4 0.00 1535.977 FORMAT "%8.3" AXIS_PTS_REF SRL03MFUW /end AXIS_DESCR
/end CHARACTERISTIC
/begin CHARACTERISTIC KFMIRD5 "Kennfeld Abregelungsmoment f¸r VMAX-Regelung" MAP 0xFD3EC5 GkfWUb 99.61 rel_ub_b99p6 0.00 99.61 FORMAT "%5.2"
 /begin AXIS_DESCR COM_AXIS bfzglf bfzg_sb_q0p217 4 -27.78 27.56 FORMAT "%5.2" AXIS_PTS_REF SBF02MFSB /end AXIS_DESCR
 /begin AXIS_DESCR COM_AXIS rl_w rel_uw_q0p0234 4 0.00 1535.977 FORMAT "%8.3" AXIS_PTS_REF SRL03MFUW /end AXIS_DESCR
/end CHARACTERISTIC
/begin CHARACTERISTIC KFMIRD6 "Kennfeld Abregelungsmoment f¸r VMAX-Regelung" MAP 0xFD3ED5 GkfWUb 99.61 rel_ub_b99p6 0.00 99.61 FORMAT "%5.2"
 /begin AXIS_DESCR COM_AXIS bfzglf bfzg_sb_q0p217 4 -27.78 27.56 FORMAT "%5.2" AXIS_PTS_REF SBF02MFSB /end AXIS_DESCR
 /begin AXIS_DESCR COM_AXIS rl_w rel_uw_q0p0234 4 0.00 1535.977 FORMAT "%8.3" AXIS_PTS_REF SRL03MFUW /end AXIS_DESCR
/end CHARACTERISTIC
/begin CHARACTERISTIC KFMIRD7 "Kennfeld Abregelungsmoment f¸r VMAX-Regelung" MAP 0xFD3EE5 GkfWUb 99.61 rel_ub_b99p6 0.00 99.61 FORMAT "%5.2"
 /begin AXIS_DESCR COM_AXIS bfzglf bfzg_sb_q0p217 4 -27.78 27.56 FORMAT "%5.2" AXIS_PTS_REF SBF02MFSB /end AXIS_DESCR
 /begin AXIS_DESCR COM_AXIS rl_w rel_uw_q0p0234 4 0.00 1535.977 FORMAT "%8.3" AXIS_PTS_REF SRL03MFUW /end AXIS_DESCR
/end CHARACTERISTIC
/begin CHARACTERISTIC KFMIRDLR "Kennfeld Abregelungsmoment f¸r VMAX-Regelung bei Low-Range" MAP 0xFD3EF5 GkfWUb 99.61 rel_ub_b99p6 0.00 99.61 FORMAT "%5.2"
 /begin AXIS_DESCR COM_AXIS bfzglf bfzg_sb_q0p217 4 -27.78 27.56 FORMAT "%5.2" AXIS_PTS_REF SBF02MFLRSB /end AXIS_DESCR
 /begin AXIS_DESCR COM_AXIS rl_w rel_uw_q0p0234 4 0.00 1535.977 FORMAT "%8.3" AXIS_PTS_REF SRL03MFLRUW /end AXIS_DESCR
/end CHARACTERISTIC
/begin CHARACTERISTIC KFMIRDLR1 "Kennfeld Abregelungsmoment f¸r VMAX-Regelung bei Low-Range" MAP 0xFD3F05 GkfWUb 99.61 rel_ub_b99p6 0.00 99.61 FORMAT "%5.2"
 /begin AXIS_DESCR COM_AXIS bfzglf bfzg_sb_q0p217 4 -27.78 27.56 FORMAT "%5.2" AXIS_PTS_REF SBF02MFLRSB /end AXIS_DESCR
 /begin AXIS_DESCR COM_AXIS rl_w rel_uw_q0p0234 4 0.00 1535.977 FORMAT "%8.3" AXIS_PTS_REF SRL03MFLRUW /end AXIS_DESCR
/end CHARACTERISTIC
/begin CHARACTERISTIC KFMIRDLR2 "Kennfeld Abregelungsmoment f¸r VMAX-Regelung bei Low-Range" MAP 0xFD3F15 GkfWUb 99.61 rel_ub_b99p6 0.00 99.61 FORMAT "%5.2"
 /begin AXIS_DESCR COM_AXIS bfzglf bfzg_sb_q0p217 4 -27.78 27.56 FORMAT "%5.2" AXIS_PTS_REF SBF02MFLRSB /end AXIS_DESCR
 /begin AXIS_DESCR COM_AXIS rl_w rel_uw_q0p0234 4 0.00 1535.977 FORMAT "%8.3" AXIS_PTS_REF SRL03MFLRUW /end AXIS_DESCR
/end CHARACTERISTIC
/begin CHARACTERISTIC KFMIRDLR3 "Kennfeld Abregelungsmoment f¸r VMAX-Regelung bei Low-Range" MAP 0xFD3F25 GkfWUb 99.61 rel_ub_b99p6 0.00 99.61 FORMAT "%5.2"
 /begin AXIS_DESCR COM_AXIS bfzglf bfzg_sb_q0p217 4 -27.78 27.56 FORMAT "%5.2" AXIS_PTS_REF SBF02MFLRSB /end AXIS_DESCR
 /begin AXIS_DESCR COM_AXIS rl_w rel_uw_q0p0234 4 0.00 1535.977 FORMAT "%8.3" AXIS_PTS_REF SRL03MFLRUW /end AXIS_DESCR
/end CHARACTERISTIC
/begin CHARACTERISTIC KFMIRDLR4 "Kennfeld Abregelungsmoment f¸r VMAX-Regelung bei Low-Range" MAP 0xFD3F35 GkfWUb 99.61 rel_ub_b99p6 0.00 99.61 FORMAT "%5.2"
 /begin AXIS_DESCR COM_AXIS bfzglf bfzg_sb_q0p217 4 -27.78 27.56 FORMAT "%5.2" AXIS_PTS_REF SBF02MFLRSB /end AXIS_DESCR
 /begin AXIS_DESCR COM_AXIS rl_w rel_uw_q0p0234 4 0.00 1535.977 FORMAT "%8.3" AXIS_PTS_REF SRL03MFLRUW /end AXIS_DESCR
/end CHARACTERISTIC
/begin CHARACTERISTIC KFMIRDLR5 "Kennfeld Abregelungsmoment f¸r VMAX-Regelung bei Low-Range" MAP 0xFD3F45 GkfWUb 99.61 rel_ub_b99p6 0.00 99.61 FORMAT "%5.2"
 /begin AXIS_DESCR COM_AXIS bfzglf bfzg_sb_q0p217 4 -27.78 27.56 FORMAT "%5.2" AXIS_PTS_REF SBF02MFLRSB /end AXIS_DESCR
 /begin AXIS_DESCR COM_AXIS rl_w rel_uw_q0p0234 4 0.00 1535.977 FORMAT "%8.3" AXIS_PTS_REF SRL03MFLRUW /end AXIS_DESCR
/end CHARACTERISTIC
/begin CHARACTERISTIC KFMIRDLR6 "Kennfeld Abregelungsmoment f¸r VMAX-Regelung bei Low-Range" MAP 0xFD3F55 GkfWUb 99.61 rel_ub_b99p6 0.00 99.61 FORMAT "%5.2"
 /begin AXIS_DESCR COM_AXIS bfzglf bfzg_sb_q0p217 4 -27.78 27.56 FORMAT "%5.2" AXIS_PTS_REF SBF02MFLRSB /end AXIS_DESCR
 /begin AXIS_DESCR COM_AXIS rl_w rel_uw_q0p0234 4 0.00 1535.977 FORMAT "%8.3" AXIS_PTS_REF SRL03MFLRUW /end AXIS_DESCR
/end CHARACTERISTIC
/begin CHARACTERISTIC KFMIRDLR7 "Kennfeld Abregelungsmoment f¸r VMAX-Regelung bei Low-Range" MAP 0xFD3F65 GkfWUb 99.61 rel_ub_b99p6 0.00 99.61 FORMAT "%5.2"
 /begin AXIS_DESCR COM_AXIS bfzglf bfzg_sb_q0p217 4 -27.78 27.56 FORMAT "%5.2" AXIS_PTS_REF SBF02MFLRSB /end AXIS_DESCR
 /begin AXIS_DESCR COM_AXIS rl_w rel_uw_q0p0234 4 0.00 1535.977 FORMAT "%8.3" AXIS_PTS_REF SRL03MFLRUW /end AXIS_DESCR
/end CHARACTERISTIC
/begin CHARACTERISTIC KFMOF_UM "Kennfeld f¸r Offset-Toleranz in Abh‰ngigkeit vom zul‰ssigen Moment" MAP 0xFCF30A GkfWUb 99.61 rel_ub_b99p6 0.00 99.61 FORMAT "%5.2"
 /begin AXIS_DESCR COM_AXIS mz_um rel_ub_b99p6 8 0.00 99.61 FORMAT "%5.2" AXIS_PTS_REF MDV08_UM /end AXIS_DESCR
 /begin AXIS_DESCR COM_AXIS nmot_um nmot_ub_q40 8 0.00 10200. FORMAT "%5.0" AXIS_PTS_REF NMV08_UM /end AXIS_DESCR
/end CHARACTERISTIC
/begin CHARACTERISTIC KFPZU0_UM "Kennfeld 0 f¸r rel. zul. Moment aus der Pedalstellung in der Momenten¸berwachung" MAP 0xFCF34A GkfWUb 99.61 rel_ub_b99p6 0.00 99.61 FORMAT "%5.2"
 /begin AXIS_DESCR COM_AXIS spsn_um spg_ub_q0p019 8 0.00 4.980 FORMAT "%5.3" AXIS_PTS_REF SPSNV08_UM /end AXIS_DESCR
 /begin AXIS_DESCR COM_AXIS nmot_um nmot_ub_q40 8 0.00 10200. FORMAT "%5.0" AXIS_PTS_REF NMV08_UM /end AXIS_DESCR
/end CHARACTERISTIC
/begin CHARACTERISTIC KFPZU1_UM "Kennfeld 1 f¸r rel. zul. Moment aus der Pedalstellung in der Momenten¸berwachung" MAP 0xFCF38A GkfWUb 99.61 rel_ub_b99p6 0.00 99.61 FORMAT "%5.2"
 /begin AXIS_DESCR COM_AXIS spsn_um spg_ub_q0p019 8 0.00 4.980 FORMAT "%5.3" AXIS_PTS_REF SPSNV08_UM /end AXIS_DESCR
 /begin AXIS_DESCR COM_AXIS nmot_um nmot_ub_q40 8 0.00 10200. FORMAT "%5.0" AXIS_PTS_REF NMV08_UM /end AXIS_DESCR
/end CHARACTERISTIC
/begin CHARACTERISTIC KFRLDP_UM "Kennfeld f¸r rl-Berechnung aus Druck-Info und DK-Info" MAP 0xFCEEE3 KfAxUbAyUbSstxUbSstyUbWUb 1913. m_q7p5 0.00 1913. FORMAT "%5.0"
 /begin AXIS_DESCR STD_AXIS ipsn_um spg_ub_q0p019 8 0.00 4.980 FORMAT "%5.3" DEPOSIT ABSOLUTE /end AXIS_DESCR
 /begin AXIS_DESCR STD_AXIS dps_um p_q5 8 0.00 1275. FORMAT "%5.0" DEPOSIT ABSOLUTE /end AXIS_DESCR
/end CHARACTERISTIC
/begin CHARACTERISTIC KFRLNM1_UM "Kennfeld 1 f¸r Berechnung Nebenlast aus DK-Info und Ventilhub" MAP 0xFCEF35 GkfWUb 191.3 rel_ub_q0p75 0.00 191.3 FORMAT "%5.1"
 /begin AXIS_DESCR COM_AXIS ipsn_um spg_ub_q0p019 8 0.00 4.980 FORMAT "%5.3" AXIS_PTS_REF IPSNV08_UM /end AXIS_DESCR
 /begin AXIS_DESCR COM_AXIS evhubi_um hub_ub_q0p064 8 0.00 16.32 FORMAT "%5.2" AXIS_PTS_REF HUBV08_UM /end AXIS_DESCR
/end CHARACTERISTIC
/begin CHARACTERISTIC KFRLNM2_UM "Kennfeld 2 f¸r Berechnung Nebenlast aus DK-Info und Ventilhub" MAP 0xFCEF75 GkfWUb 191.3 rel_ub_q0p75 0.00 191.3 FORMAT "%5.1"
 /begin AXIS_DESCR COM_AXIS ipsn_um spg_ub_q0p019 8 0.00 4.980 FORMAT "%5.3" AXIS_PTS_REF IPSNV08_UM /end AXIS_DESCR
 /begin AXIS_DESCR COM_AXIS evhubi_um hub_ub_q0p064 8 0.00 16.32 FORMAT "%5.2" AXIS_PTS_REF HUBV08_UM /end AXIS_DESCR
/end CHARACTERISTIC
/begin CHARACTERISTIC KFRLNM3_UM "Kennfeld 3 f¸r Berechnung Nebenlast aus DK-Info und Ventilhub" MAP 0xFCEFB5 GkfWUb 191.3 rel_ub_q0p75 0.00 191.3 FORMAT "%5.1"
 /begin AXIS_DESCR COM_AXIS ipsn_um spg_ub_q0p019 8 0.00 4.980 FORMAT "%5.3" AXIS_PTS_REF IPSNV08_UM /end AXIS_DESCR
 /begin AXIS_DESCR COM_AXIS evhubi_um hub_ub_q0p064 8 0.00 16.32 FORMAT "%5.2" AXIS_PTS_REF HUBV08_UM /end AXIS_DESCR
/end CHARACTERISTIC
/begin CHARACTERISTIC KFRLNM4_UM "Kennfeld 4 f¸r Berechnung Nebenlast aus DK-Info und Ventilhub" MAP 0xFCEFF5 GkfWUb 191.3 rel_ub_q0p75 0.00 191.3 FORMAT "%5.1"
 /begin AXIS_DESCR COM_AXIS ipsn_um spg_ub_q0p019 8 0.00 4.980 FORMAT "%5.3" AXIS_PTS_REF IPSNV08_UM /end AXIS_DESCR
 /begin AXIS_DESCR COM_AXIS evhubi_um hub_ub_q0p064 8 0.00 16.32 FORMAT "%5.2" AXIS_PTS_REF HUBV08_UM /end AXIS_DESCR
/end CHARACTERISTIC
/begin CHARACTERISTIC KFRLNM5_UM "Kennfeld 5 f¸r Berechnung Nebenlast aus DK-Info und Ventilhub" MAP 0xFCF035 GkfWUb 191.3 rel_ub_q0p75 0.00 191.3 FORMAT "%5.1"
 /begin AXIS_DESCR COM_AXIS ipsn_um spg_ub_q0p019 8 0.00 4.980 FORMAT "%5.3" AXIS_PTS_REF IPSNV08_UM /end AXIS_DESCR
 /begin AXIS_DESCR COM_AXIS evhubi_um hub_ub_q0p064 8 0.00 16.32 FORMAT "%5.2" AXIS_PTS_REF HUBV08_UM /end AXIS_DESCR
/end CHARACTERISTIC
/begin CHARACTERISTIC KFRLNM6_UM "Kennfeld 6 f¸r Berechnung Nebenlast aus DK-Info und Ventilhub" MAP 0xFCF075 GkfWUb 191.3 rel_ub_q0p75 0.00 191.3 FORMAT "%5.1"
 /begin AXIS_DESCR COM_AXIS ipsn_um spg_ub_q0p019 8 0.00 4.980 FORMAT "%5.3" AXIS_PTS_REF IPSNV08_UM /end AXIS_DESCR
 /begin AXIS_DESCR COM_AXIS evhubi_um hub_ub_q0p064 8 0.00 16.32 FORMAT "%5.2" AXIS_PTS_REF HUBV08_UM /end AXIS_DESCR
/end CHARACTERISTIC
/begin CHARACTERISTIC KFTDSTAB "Zeit f¸r Pumpstrom stabil" MAP 0xFD4DEC KfAxU8AyU8SstxU16SstyU16WU16 6553.500 t_q0p1 0.00 6553.500 FORMAT "%8.3"
 /begin AXIS_DESCR STD_AXIS iptgh_w i_q6p1035_uA 8 0.00 399.9939 FORMAT "%8.4" DEPOSIT ABSOLUTE /end AXIS_DESCR
 /begin AXIS_DESCR STD_AXIS dmtfgvt_w vol_q0p1_l 8 0.00 6553.500 FORMAT "%8.3" DEPOSIT ABSOLUTE /end AXIS_DESCR
/end CHARACTERISTIC
/begin CHARACTERISTIC KFTRLSOLKR "Kennfeld Verzˆgerungszeit rlsol" MAP 0xFCDC45 KfAxU8AyU8SstxU8SstyU8WU8 15.00 dez 0.00 15.00 FORMAT "%5.2"
 /begin AXIS_DESCR STD_AXIS minhub_ub hub_ub_b1 6 0.00 0.9961 DEPOSIT ABSOLUTE /end AXIS_DESCR
 /begin AXIS_DESCR STD_AXIS dpssol_ub p_q10p0 6 0.00 2550. FORMAT "%5.0" DEPOSIT ABSOLUTE /end AXIS_DESCR
/end CHARACTERISTIC
/begin CHARACTERISTIC KFWK "Z¸ndwinkelkennfeld f¸r Klopfschutzfunktion" MAP 0xFCE6EA KfAxUbAyUbSstxUbSstyUbWSb 191.3 zw_sb_q0p75 -96.00 95.25 FORMAT "%5.2"
 /begin AXIS_DESCR STD_AXIS tmot temp_ub_q0p75_o48 3 -48.00 143.3 FORMAT "%5.1" DEPOSIT ABSOLUTE /end AXIS_DESCR
 /begin AXIS_DESCR STD_AXIS tans temp_ub_q0p75_o48 4 -48.00 143.3 FORMAT "%5.1" DEPOSIT ABSOLUTE /end AXIS_DESCR
/end CHARACTERISTIC
/begin CHARACTERISTIC KFWZWWL "Wichtung Warmlauf-Z¸ndwinkel ¸ber Drehzahl und Last" MAP 0xFCEAE8 KfAxUbAyUbSstxUbSstyUbWUb 0.9961 fak_ub_b1 0.00 0.9961
 /begin AXIS_DESCR STD_AXIS nmot nmot_ub_q40 8 0.00 10200. FORMAT "%5.0" DEPOSIT ABSOLUTE /end AXIS_DESCR
 /begin AXIS_DESCR STD_AXIS rl rel_ub_q0p75 8 0.00 191.3 FORMAT "%5.1" DEPOSIT ABSOLUTE /end AXIS_DESCR
/end CHARACTERISTIC
/begin CHARACTERISTIC KFWZWWLVT "Wichtung Warmlauf-Z¸ndwinkel ¸ber Drehzahl und Last VVT" MAP 0xFCEB3A KfAxUbAyUbSstxUbSstyUbWUb 0.9961 fak_ub_b1 0.00 0.9961
 /begin AXIS_DESCR STD_AXIS nmot nmot_ub_q40 8 0.00 10200. FORMAT "%5.0" DEPOSIT ABSOLUTE /end AXIS_DESCR
 /begin AXIS_DESCR STD_AXIS rl rel_ub_q0p75 8 0.00 191.3 FORMAT "%5.1" DEPOSIT ABSOLUTE /end AXIS_DESCR
/end CHARACTERISTIC
/begin CHARACTERISTIC KFZRLSOLKR "Kennfeld Filterzeitkonstante rlsol" MAP 0xFCDBCC KfAxUbAyUbSstxUwSstyUwWUw 655.34999985 zk10msxs_uw_b655 0.010000152590 655.36000000 FORMAT "%12.8"
 /begin AXIS_DESCR STD_AXIS minhub_w hub_uw_q0p001 6 0.00 65.53500 FORMAT "%8.5" DEPOSIT ABSOLUTE /end AXIS_DESCR
 /begin AXIS_DESCR STD_AXIS dpssol_uw p_q0p039 6 0.00 2559.961 FORMAT "%8.3" DEPOSIT ABSOLUTE /end AXIS_DESCR
/end CHARACTERISTIC
/begin CHARACTERISTIC KFZW1 "Z¸ndwinkelkennfeld Variante 1" MAP 0xFCDC77 KfAxU8AyU8SstxU8SstyU8WS8 191.3 zw_sb_q0p75 -96.00 95.25 FORMAT "%5.2"
 /begin AXIS_DESCR STD_AXIS nmot nmot_ub_q40 24 0.00 10200. FORMAT "%5.0" DEPOSIT ABSOLUTE /end AXIS_DESCR
 /begin AXIS_DESCR STD_AXIS rl rel_ub_q0p75 16 0.00 191.3 FORMAT "%5.1" DEPOSIT ABSOLUTE /end AXIS_DESCR
/end CHARACTERISTIC
/begin CHARACTERISTIC KFZW2 "Z¸ndwinkelkennfeld Variante 2" MAP 0xFCDE21 KfAxU8AyU8SstxU8SstyU8WS8 191.3 zw_sb_q0p75 -96.00 95.25 FORMAT "%5.2"
 /begin AXIS_DESCR STD_AXIS nmot nmot_ub_q40 24 0.00 10200. FORMAT "%5.0" DEPOSIT ABSOLUTE /end AXIS_DESCR
 /begin AXIS_DESCR STD_AXIS rl rel_ub_q0p75 16 0.00 191.3 FORMAT "%5.1" DEPOSIT ABSOLUTE /end AXIS_DESCR
/end CHARACTERISTIC
/begin CHARACTERISTIC KFZWLL "Z¸ndwinkelkennfeld im Leerlauf" MAP 0xFCDFCB KfAxU8AyU8SstxU8SstyU8WS8 191.3 zw_sb_q0p75 -96.00 95.25 FORMAT "%5.2"
 /begin AXIS_DESCR STD_AXIS nmot nmot_ub_q40 12 0.00 10200. FORMAT "%5.0" DEPOSIT ABSOLUTE /end AXIS_DESCR
 /begin AXIS_DESCR STD_AXIS rl rel_ub_q0p75 5 0.00 191.3 FORMAT "%5.1" DEPOSIT ABSOLUTE /end AXIS_DESCR
/end CHARACTERISTIC
/begin CHARACTERISTIC KFZWLLT "Z¸ndwinkelkennfeld im Leerlauf (VVT)" MAP 0xFCE01A KfAxU8AyU8SstxU8SstyU8WS8 191.3 zw_sb_q0p75 -96.00 95.25 FORMAT "%5.2"
 /begin AXIS_DESCR STD_AXIS nmot nmot_ub_q40 8 0.00 10200. FORMAT "%5.0" DEPOSIT ABSOLUTE /end AXIS_DESCR
 /begin AXIS_DESCR STD_AXIS rl rel_ub_q0p75 5 0.00 191.3 FORMAT "%5.1" DEPOSIT ABSOLUTE /end AXIS_DESCR
/end CHARACTERISTIC
/begin CHARACTERISTIC KFZWLLTDO "" MAP 0xFCE051 KfAxU8AyU8SstxU8SstyU8WS8 191.3 zw_sb_q0p75 -96.00 95.25 FORMAT "%5.2"
 /begin AXIS_DESCR STD_AXIS minhub_ub hub_ub_b1 8 0.00 0.9961 DEPOSIT ABSOLUTE /end AXIS_DESCR
 /begin AXIS_DESCR STD_AXIS dpssol_ub p_q10p0 8 0.00 2550. FORMAT "%5.0" DEPOSIT ABSOLUTE /end AXIS_DESCR
/end CHARACTERISTIC
/begin CHARACTERISTIC KFZWMN "Min-Z¸ndwinkel" MAP 0xFCE7C1 KfAxUbAyUbSstxUbSstyUbWSb 191.3 zw_sb_q0p75 -96.00 95.25 FORMAT "%5.2"
 /begin AXIS_DESCR STD_AXIS nmot nmot_ub_q40 16 0.00 10200. FORMAT "%5.0" DEPOSIT ABSOLUTE /end AXIS_DESCR
 /begin AXIS_DESCR STD_AXIS rl rel_ub_q0p75 12 0.00 191.3 FORMAT "%5.1" DEPOSIT ABSOLUTE /end AXIS_DESCR
/end CHARACTERISTIC
/begin CHARACTERISTIC KFZWMNKH "Min-Z¸ndwinkel Katheizen" MAP 0xFCE89F KfAxUbAyUbSstxUbSstyUbWSb 191.3 zw_sb_q0p75 -96.00 95.25 FORMAT "%5.2"
 /begin AXIS_DESCR STD_AXIS nmot nmot_ub_q40 16 0.00 10200. FORMAT "%5.0" DEPOSIT ABSOLUTE /end AXIS_DESCR
 /begin AXIS_DESCR STD_AXIS rl rel_ub_q0p75 12 0.00 191.3 FORMAT "%5.1" DEPOSIT ABSOLUTE /end AXIS_DESCR
/end CHARACTERISTIC
/begin CHARACTERISTIC KFZWMNST "Min-Z¸ndwinkel f¸r Start und Nachstart" MAP 0xFCE97D KfAxUbAyUbSstxUbSstyUbWSb 191.3 zw_sb_q0p75 -96.00 95.25 FORMAT "%5.2"
 /begin AXIS_DESCR STD_AXIS nmot nmot_ub_q40 16 0.00 10200. FORMAT "%5.0" DEPOSIT ABSOLUTE /end AXIS_DESCR
 /begin AXIS_DESCR STD_AXIS rl rel_ub_q0p75 12 0.00 191.3 FORMAT "%5.1" DEPOSIT ABSOLUTE /end AXIS_DESCR
/end CHARACTERISTIC
/begin CHARACTERISTIC KFZWMS "Kennfeld mit dauerhaft sp‰test mˆglichem Z¸ndwinkel" MAP 0xFCE701 GkfWSb 191.3 zw_sb_q0p75 -96.00 95.25 FORMAT "%5.2"
 /begin AXIS_DESCR COM_AXIS nmot nmot_ub_q40 16 0.00 10200. FORMAT "%5.0" AXIS_PTS_REF SNM16ZUUB /end AXIS_DESCR
 /begin AXIS_DESCR COM_AXIS rl rel_ub_q0p75 12 0.00 191.3 FORMAT "%5.1" AXIS_PTS_REF SRL12ZUUB /end AXIS_DESCR
/end CHARACTERISTIC
/begin CHARACTERISTIC KFZWNOTL "Z¸ndwinkelkennfeld VVT-Notlauf" MAP 0xFCE0A3 KfAxU8AyU8SstxU8SstyU8WS8 191.3 zw_sb_q0p75 -96.00 95.25 FORMAT "%5.2"
 /begin AXIS_DESCR STD_AXIS nmot nmot_ub_q40 24 0.00 10200. FORMAT "%5.0" DEPOSIT ABSOLUTE /end AXIS_DESCR
 /begin AXIS_DESCR STD_AXIS rl rel_ub_q0p75 16 0.00 191.3 FORMAT "%5.1" DEPOSIT ABSOLUTE /end AXIS_DESCR
/end CHARACTERISTIC
/begin CHARACTERISTIC KFZWST "Z¸ndwinkelkennfeld im Start." MAP 0xFCEA7A KfAxU8AyU8SstxU8SstyU8WS8 191.3 zw_sb_q0p75 -96.00 95.25 FORMAT "%5.2"
 /begin AXIS_DESCR STD_AXIS nmotz nmot_ub_q10 4 0.00 2550. FORMAT "%5.0" DEPOSIT ABSOLUTE /end AXIS_DESCR
 /begin AXIS_DESCR STD_AXIS tmst temp_ub_q0p75_o48 6 -48.00 143.3 FORMAT "%5.1" DEPOSIT ABSOLUTE /end AXIS_DESCR
/end CHARACTERISTIC
/begin CHARACTERISTIC KFZWSTT "Z¸ndwinkelkennfeld im Start (gd)" MAP 0xFCEA9E KfAxU8AyU8SstxU8SstyU8WS8 191.3 zw_sb_q0p75 -96.00 95.25 FORMAT "%5.2"
 /begin AXIS_DESCR STD_AXIS nmotz nmot_ub_q10 4 0.00 2550. FORMAT "%5.0" DEPOSIT ABSOLUTE /end AXIS_DESCR
 /begin AXIS_DESCR STD_AXIS tmst temp_ub_q0p75_o48 6 -48.00 143.3 FORMAT "%5.1" DEPOSIT ABSOLUTE /end AXIS_DESCR
/end CHARACTERISTIC
/begin CHARACTERISTIC KFZWTDO "" MAP 0xFCE24D KfAxU8AyU8SstxU8SstyU8WS8 191.3 zw_sb_q0p75 -96.00 95.25 FORMAT "%5.2"
 /begin AXIS_DESCR STD_AXIS minhub_ub hub_ub_b1 8 0.00 0.9961 DEPOSIT ABSOLUTE /end AXIS_DESCR
 /begin AXIS_DESCR STD_AXIS dpssol_ub p_q10p0 8 0.00 2550. FORMAT "%5.0" DEPOSIT ABSOLUTE /end AXIS_DESCR
/end CHARACTERISTIC
/begin CHARACTERISTIC KFZWVL "Vollast - Z¸ndkennfeld" MAP 0xFCE29F GkfWSb 191.3 zw_sb_q0p75 -96.00 95.25 FORMAT "%5.2"
 /begin AXIS_DESCR COM_AXIS nmot nmot_ub_q40 24 0.00 10200. FORMAT "%5.0" AXIS_PTS_REF SNM24ZUUB /end AXIS_DESCR
 /begin AXIS_DESCR COM_AXIS rl rel_ub_q0p75 6 0.00 191.3 FORMAT "%5.1" AXIS_PTS_REF SRL06ZUUB /end AXIS_DESCR
/end CHARACTERISTIC
/begin CHARACTERISTIC KFZWVLT "Vollast - Z¸ndkennfeld (VVT)" MAP 0xFCE32F GkfWSb 191.3 zw_sb_q0p75 -96.00 95.25 FORMAT "%5.2"
 /begin AXIS_DESCR COM_AXIS nmot nmot_ub_q40 24 0.00 10200. FORMAT "%5.0" AXIS_PTS_REF SNM24ZUUB /end AXIS_DESCR
 /begin AXIS_DESCR COM_AXIS rl rel_ub_q0p75 6 0.00 191.3 FORMAT "%5.1" AXIS_PTS_REF SRL06ZUUB /end AXIS_DESCR
/end CHARACTERISTIC
/begin CHARACTERISTIC KFZWWLTM "Delta Z¸ndwinkel im Warmlauf" MAP 0xFD530B KfAxUbAyUbSstxUbSstyUbWSb 191.3 zw_sb_q0p75 -96.00 95.25 FORMAT "%5.2"
 /begin AXIS_DESCR STD_AXIS tmot temp_ub_q0p75_o48 6 -48.00 143.3 FORMAT "%5.1" DEPOSIT ABSOLUTE /end AXIS_DESCR
 /begin AXIS_DESCR STD_AXIS tmst temp_ub_q0p75_o48 6 -48.00 143.3 FORMAT "%5.1" DEPOSIT ABSOLUTE /end AXIS_DESCR
/end CHARACTERISTIC
/begin CHARACTERISTIC KFZWWLTMVT "Delta Z¸ndwinkel im Warmlauf VVT" MAP 0xFD533D KfAxUbAyUbSstxUbSstyUbWSb 191.3 zw_sb_q0p75 -96.00 95.25 FORMAT "%5.2"
 /begin AXIS_DESCR STD_AXIS tmot temp_ub_q0p75_o48 6 -48.00 143.3 FORMAT "%5.1" DEPOSIT ABSOLUTE /end AXIS_DESCR
 /begin AXIS_DESCR STD_AXIS tmst temp_ub_q0p75_o48 6 -48.00 143.3 FORMAT "%5.1" DEPOSIT ABSOLUTE /end AXIS_DESCR
/end CHARACTERISTIC
/begin CHARACTERISTIC KLDRSOLKR "" CURVE 0xFD52B6 KlAUwSstUwWSw 1535.977 rel_sw_b768 -768.0000 767.9766 FORMAT "%8.4"
 /begin AXIS_DESCR STD_AXIS nmot_w nmot_uw_q0p25 8 0.00 16383.75 FORMAT "%8.2" DEPOSIT ABSOLUTE /end AXIS_DESCR
/end CHARACTERISTIC
/begin CHARACTERISTIC KLLLRZU_UM "Kennlinie zul‰ssiges Moment der Leerlaufregelung" CURVE 0xFCF3CA GklWUb 99.61 rel_ub_b99p6 0.00 99.61 FORMAT "%5.2"
 /begin AXIS_DESCR COM_AXIS nmot_um nmot_ub_q40 8 0.00 10200. FORMAT "%5.0" AXIS_PTS_REF NMV08_UM /end AXIS_DESCR
/end CHARACTERISTIC
/begin CHARACTERISTIC KLMIMAX_UM "Kennlinie maximales indiziertes Moment" CURVE 0xFCF3D2 GklWUb 99.61 rel_ub_b99p6 0.00 99.61 FORMAT "%5.2"
 /begin AXIS_DESCR COM_AXIS nmot_um nmot_ub_q40 8 0.00 10200. FORMAT "%5.0" AXIS_PTS_REF NMV08_UM /end AXIS_DESCR
/end CHARACTERISTIC
/begin CHARACTERISTIC KLMIMIN_UM "Kennlinie minimales indiziertes Moment" CURVE 0xFCF3DA GklWUb 99.61 rel_ub_b99p6 0.00 99.61 FORMAT "%5.2"
 /begin AXIS_DESCR COM_AXIS nmot_um nmot_ub_q40 8 0.00 10200. FORMAT "%5.0" AXIS_PTS_REF NMV08_UM /end AXIS_DESCR
/end CHARACTERISTIC
/begin CHARACTERISTIC KLMZUMN_UM "Kenlinie f¸r drehzahlabh‰ngiges zul. Moment" CURVE 0xFCF3E2 GklWUb 99.61 rel_ub_b99p6 0.00 99.61 FORMAT "%5.2"
 /begin AXIS_DESCR COM_AXIS nmot_um nmot_ub_q40 8 0.00 10200. FORMAT "%5.0" AXIS_PTS_REF NMV08_UM /end AXIS_DESCR
/end CHARACTERISTIC
/begin CHARACTERISTIC KLNPED_UM "pedalsollwertabh. Drehzahlbegrenzung in der DK-Antrieb-Ersatzfunktion, Fkts¸berw" CURVE 0xFCF0F7 KlAUbSstUbWUb 10200. nmot_ub_q40 0.00 10200. FORMAT "%5.0"
 /begin AXIS_DESCR STD_AXIS spsn_um spg_ub_q0p019 8 0.00 4.980 FORMAT "%5.3" DEPOSIT ABSOLUTE /end AXIS_DESCR
/end CHARACTERISTIC
/begin CHARACTERISTIC KLRDPSI "Kennlinie dps I-Regler" CURVE 0xFC5F04 KlAUwSstUwWUw 2559.96 p_q0p039s32768 -1280.00 1279.96 FORMAT "%7.2"
 /begin AXIS_DESCR STD_AXIS ddpskl p_q0p039s32768 16 -1280.00 1279.96 FORMAT "%7.2" DEPOSIT ABSOLUTE /end AXIS_DESCR
/end CHARACTERISTIC
/begin CHARACTERISTIC KLRDPSP "Kennlinie dps P-Regler" CURVE 0xFC5F46 KlAUwSstUwWUw 2559.96 p_q0p039s32768 -1280.00 1279.96 FORMAT "%7.2"
 /begin AXIS_DESCR STD_AXIS ddpskl p_q0p039s32768 16 -1280.00 1279.96 FORMAT "%7.2" DEPOSIT ABSOLUTE /end AXIS_DESCR
/end CHARACTERISTIC
/begin CHARACTERISTIC KLVABSCH "Kennlinie f¸r Vmax-Regler-Abschaltschwelle" CURVE 0xFD3FAA GklWUw 511.9922 vfzg_uw_q0p00781 0.00 511.9922 FORMAT "%8.4"
 /begin AXIS_DESCR COM_AXIS vmaxidx dez 8 0.00 255.0 FORMAT "%5.1" AXIS_PTS_REF SCO08VMUB /end AXIS_DESCR
/end CHARACTERISTIC
/begin CHARACTERISTIC KLVABSCHLR "Kennlinie f¸r Vmax-Regler-Abschaltschwelle bei Low-Range-Betrieb" CURVE 0xFD3FBA GklWUw 511.9922 vfzg_uw_q0p00781 0.00 511.9922 FORMAT "%8.4"
 /begin AXIS_DESCR COM_AXIS vmaxidx dez 8 0.00 255.0 FORMAT "%5.1" AXIS_PTS_REF SCO08VMUB /end AXIS_DESCR
/end CHARACTERISTIC
/begin CHARACTERISTIC KLVHYST "Kennlinie f¸r Vmax-Hystereseschwelle" CURVE 0xFD3FCA GklWUw 511.9922 vfzg_uw_q0p00781 0.00 511.9922 FORMAT "%8.4"
 /begin AXIS_DESCR COM_AXIS vmaxidx dez 8 0.00 255.0 FORMAT "%5.1" AXIS_PTS_REF SCO08VMUB /end AXIS_DESCR
/end CHARACTERISTIC
/begin CHARACTERISTIC KLVHYSTLR "Kennlinie f¸r Vmax-Hystereseschwelle bei Low-Range-Betrieb" CURVE 0xFD3FDA GklWUw 511.9922 vfzg_uw_q0p00781 0.00 511.9922 FORMAT "%8.4"
 /begin AXIS_DESCR COM_AXIS vmaxidx dez 8 0.00 255.0 FORMAT "%5.1" AXIS_PTS_REF SCO08VMUB /end AXIS_DESCR
/end CHARACTERISTIC
/begin CHARACTERISTIC KLVMAXO "Kennlinie f¸r Vmax-Begrenzungswert" CURVE 0xFD3FEA GklWUw 511.9922 vfzg_uw_q0p00781 0.00 511.9922 FORMAT "%8.4"
 /begin AXIS_DESCR COM_AXIS vmaxidx dez 8 0.00 255.0 FORMAT "%5.1" AXIS_PTS_REF SCO08VMUB /end AXIS_DESCR
/end CHARACTERISTIC
/begin CHARACTERISTIC KLVMAXOLR "Kennlinie f¸r Vmax-Begrenzungswert bei Low-Range-Betrieb" CURVE 0xFD3FFA GklWUw 511.9922 vfzg_uw_q0p00781 0.00 511.9922 FORMAT "%8.4"
 /begin AXIS_DESCR COM_AXIS vmaxidx dez 8 0.00 255.0 FORMAT "%5.1" AXIS_PTS_REF SCO08VMUB /end AXIS_DESCR
/end CHARACTERISTIC
/begin CHARACTERISTIC KLVMAXP "Kennlinie f¸r P-Gliedbei Vmax-Regelung" CURVE 0xFD3F75 GklWUb 99.70 rel_ub_q0p391 0.00 99.70 FORMAT "%5.2"
 /begin AXIS_DESCR COM_AXIS vmaxidx dez 8 0.00 255.0 FORMAT "%5.1" AXIS_PTS_REF SCO08VMUB /end AXIS_DESCR
/end CHARACTERISTIC
/begin CHARACTERISTIC KLVMAXPLR "Kennlinie f¸r P-Gliedbei Vmax-Regelung bei Low-Range-Betrieb" CURVE 0xFD3F7D GklWUb 99.70 rel_ub_q0p391 0.00 99.70 FORMAT "%5.2"
 /begin AXIS_DESCR COM_AXIS vmaxidx dez 8 0.00 255.0 FORMAT "%5.1" AXIS_PTS_REF SCO08VMUB /end AXIS_DESCR
/end CHARACTERISTIC
/begin CHARACTERISTIC KLVVORH "Kennlinie f¸r Vmax-Vorhaltschwelle" CURVE 0xFD400A GklWUw 511.9922 vfzg_uw_q0p00781 0.00 511.9922 FORMAT "%8.4"
 /begin AXIS_DESCR COM_AXIS vmaxidx dez 8 0.00 255.0 FORMAT "%5.1" AXIS_PTS_REF SCO08VMUB /end AXIS_DESCR
/end CHARACTERISTIC
/begin CHARACTERISTIC KLVVORHLR "Kennlinie f¸r Vmax-Vorhaltschwelle bei Low-Range-Betrieb" CURVE 0xFD401A GklWUw 511.9922 vfzg_uw_q0p00781 0.00 511.9922 FORMAT "%8.4"
 /begin AXIS_DESCR COM_AXIS vmaxidx dez 8 0.00 255.0 FORMAT "%5.1" AXIS_PTS_REF SCO08VMUB /end AXIS_DESCR
/end CHARACTERISTIC
/begin CHARACTERISTIC KLZIVMAX "Kennlinie f¸r I-Steigung der Vmax-Regelung" CURVE 0xFD3F85 GklWUb 25.4996 zk100msxs_ub_b25p5 0.100392 25.6000 FORMAT "%7.4"
 /begin AXIS_DESCR COM_AXIS vmaxidx dez 8 0.00 255.0 FORMAT "%5.1" AXIS_PTS_REF SCO08VMUB /end AXIS_DESCR
/end CHARACTERISTIC
/begin CHARACTERISTIC KLZIVMAXLR "Kennlinie f¸r I-Steigung der Vmax-Regelung bei Low-Range-Betrieb" CURVE 0xFD3F8D GklWUb 25.4996 zk100msxs_ub_b25p5 0.100392 25.6000 FORMAT "%7.4"
 /begin AXIS_DESCR COM_AXIS vmaxidx dez 8 0.00 255.0 FORMAT "%5.1" AXIS_PTS_REF SCO08VMUB /end AXIS_DESCR
/end CHARACTERISTIC
/begin CHARACTERISTIC KLZWKSNL "Kennlinie bei VVT-Notlauf" CURVE 0xFCE6DC KlAUbSstUbWSb 191.3 zw_sb_q0p75 -96.00 95.25 FORMAT "%5.2"
 /begin AXIS_DESCR STD_AXIS nmot nmot_ub_q40 6 0.00 10200. FORMAT "%5.0" DEPOSIT ABSOLUTE /end AXIS_DESCR
/end CHARACTERISTIC
/begin CHARACTERISTIC KLZZWMNST "KL Zeitkonstante f¸r Abregelung ZW-Begrenzung im Nachstart" CURVE 0xFCEA5C KlAUbSstUbWUw 655.34999985 zk10msxs_uw_b655 0.010000152590 655.36000000 FORMAT "%12.8"
 /begin AXIS_DESCR STD_AXIS tmst temp_ub_q0p75_o48 8 -48.00 143.3 FORMAT "%5.1" DEPOSIT ABSOLUTE /end AXIS_DESCR
/end CHARACTERISTIC
/begin CHARACTERISTIC KSZWE "Klopfschutzz¸ndwinkel Ersatzwert bei E_ta v E_tm" VALUE 0xFCE6E9 KwSb 191.3 zw_sb_q0p75 -96.00 95.25 FORMAT "%5.2" /end CHARACTERISTIC
/begin CHARACTERISTIC KUMSRL_UM "Umrechnungskonstante von Massenstrom in relative Luftf¸llung in der ‹berwachung" VALUE 0xFCF0B5 KwUb 0.00199218750 kumsrl_ub_b0p002 0.00 0.00199218750 FORMAT "%13.11" /end CHARACTERISTIC
/begin AXIS_PTS MDV08_UM "St¸tzstellenverteilung f¸r Moment in der Funktions¸berwachung" 0xFCF3EA mz_um SstAUbSstUb 99.61 rel_ub_b99p6 8 0.00 99.61 FORMAT "%5.2" DEPOSIT ABSOLUTE /end AXIS_PTS
/begin CHARACTERISTIC MLDPSAD_H "Luftmassen dps Adation Handbetrieb" VALUE 0xFD143C KwSw 6553.500 m_uw_b6553p5 -3276.800 3276.700 FORMAT "%8.3" /end CHARACTERISTIC
/begin CHARACTERISTIC NACHANZ "" VALUE 0xFCDAC8 KwUb 255.0 dez 0.00 255.0 FORMAT "%5.1" /end CHARACTERISTIC
/begin CHARACTERISTIC NC_T_UM "Fehlertoleranzzeit f¸r Motordrehzahl¸berwachung f¸r Funktions¸berwachung" VALUE 0xFCF3FE KwUb 10200.0 t40ms_ub_b10200 0.00 10200.0 FORMAT "%7.1" /end CHARACTERISTIC
/begin CHARACTERISTIC NDIFFO_UM "obere erlaubte Differenz zwischen nmot und nseg_um in der Funktions¸berwachung" VALUE 0xFCF3FF KwUb 10200. nmot_ub_q40 0.00 10200. FORMAT "%5.0" /end CHARACTERISTIC
/begin CHARACTERISTIC NDIFFU_UM "untere erlaubte Differenz zwischen nmot und nseg_um in der Funktions¸berwachung" VALUE 0xFCF400 KwUb 10200. nmot_ub_q40 0.00 10200. FORMAT "%5.0" /end CHARACTERISTIC
/begin CHARACTERISTIC NMINVMX "Minimale Drehzahlschwelle zur VMAX-Regelung" VALUE 0xFD3F95 KwUb 10200. nmot_ub_q40 0.00 10200. FORMAT "%5.0" /end CHARACTERISTIC
/begin CHARACTERISTIC NMIN_UM "minimale Drehzahl f¸r Motordrehzahl¸berwachung der Funktions¸berwachung" VALUE 0xFCF401 KwUb 10200. nmot_ub_q40 0.00 10200. FORMAT "%5.0" /end CHARACTERISTIC
/begin CHARACTERISTIC NMOT1_UM "Drehzahlschwelle 1 f¸r Nebenlastermittlung" VALUE 0xFCF0B6 KwUb 10200. nmot_ub_q40 0.00 10200. FORMAT "%5.0" /end CHARACTERISTIC
/begin CHARACTERISTIC NMOT2_UM "Drehzahlschwelle 2 f¸r Nebenlastermittlung" VALUE 0xFCF0B7 KwUb 10200. nmot_ub_q40 0.00 10200. FORMAT "%5.0" /end CHARACTERISTIC
/begin CHARACTERISTIC NMOT3_UM "Drehzahlschwelle 3 f¸r Nebenlasetermittlung" VALUE 0xFCF0B8 KwUb 10200. nmot_ub_q40 0.00 10200. FORMAT "%5.0" /end CHARACTERISTIC
/begin CHARACTERISTIC NMOT4_UM "Drehzahlschwelle 4 f¸r Nebenlastermittlung" VALUE 0xFCF0B9 KwUb 10200. nmot_ub_q40 0.00 10200. FORMAT "%5.0" /end CHARACTERISTIC
/begin CHARACTERISTIC NMOT5_UM "Drehzahlschwelle 5 f¸r Nebenlastermittlung" VALUE 0xFCF0BA KwUb 10200. nmot_ub_q40 0.00 10200. FORMAT "%5.0" /end CHARACTERISTIC
/begin CHARACTERISTIC NMOT6_UM "Drehzahlschwelle 6 f¸r Nebenlastermittlung" VALUE 0xFCF0BB KwUb 10200. nmot_ub_q40 0.00 10200. FORMAT "%5.0" /end CHARACTERISTIC
/begin AXIS_PTS NMV08_UM "St¸tzstellenverteilung f¸r Motordrehzahl in der Funktions¸berwachung" 0xFCF402 nmot_um SstAUbSstUb 10200. nmot_ub_q40 8 0.00 10200. FORMAT "%5.0" DEPOSIT ABSOLUTE /end AXIS_PTS
/begin CHARACTERISTIC NRFRPEOL "Anzahl durchgef¸hrter Wiederholungen der Referenzmessung bei Bandendetests" VALUE 0xFD4F8C KwWU16 65535.00 dez 0.00 65535.00 FORMAT "%8.2" /end CHARACTERISTIC
/begin CHARACTERISTIC NRFRPFT "Anzahl mˆglicher Wiederholungen der Referenzmessung im Feld" VALUE 0xFD4F8E KwWU16 65535.00 dez 0.00 65535.00 FORMAT "%8.2" /end CHARACTERISTIC
/begin CHARACTERISTIC NRLIP_UM "Motordrehzahl-Schwelle f¸r den rl/rlip-Vergleich in der Funktions¸berwachg" VALUE 0xFCF0BC KwUb 10200. nmot_ub_q40 0.00 10200. FORMAT "%5.0" /end CHARACTERISTIC
/begin CHARACTERISTIC NSC_T_UM "Nachstart¸berwachungszeit f¸r die Funktions¸berwachung" VALUE 0xFCF416 KwUw 2621.400 t40msxs_uw_q0p04 0.00 2621.400 FORMAT "%8.3" /end CHARACTERISTIC
/begin CHARACTERISTIC NSEGMAX_UM "Maximaldrehzahl in der Funktions¸berwachung" VALUE 0xFCF40B KwUb 10200. nmot_ub_q40 0.00 10200. FORMAT "%5.0" /end CHARACTERISTIC
/begin CHARACTERISTIC NSOF_T_UM "Entprellzeit f¸r Abschaltung der Nachstartaufweitung" VALUE 0xFCF410 KwUb 10200.0 t40ms_ub_b10200 0.00 10200.0 FORMAT "%7.1" /end CHARACTERISTIC
/begin CHARACTERISTIC NTSCHW_UM "Drehzahlschwelle zur Umschaltung der erlaubten Toleranz in %UFNC der FU" VALUE 0xFCF40C KwUb 10200. nmot_ub_q40 0.00 10200. FORMAT "%5.0" /end CHARACTERISTIC
/begin CHARACTERISTIC NZMAX_UM "Maximale Drehzahl aus Zahnz‰hlerberechnung bei fehlendem Synchro in der FU" VALUE 0xFCEDCA KwUb 10200. nmot_ub_q40 0.00 10200. FORMAT "%5.0" /end CHARACTERISTIC
/begin CHARACTERISTIC N_START_UM "Motordrehzahlschwelle f¸r Unterdrehzahl-Ausstieg f¸r die Fkt.-‹berwachung" VALUE 0xFCF411 KwUb 10200. nmot_ub_q40 0.00 10200. FORMAT "%5.0" /end CHARACTERISTIC
/begin CHARACTERISTIC N_STEND_UM "Motordrehzahlschwelle f¸r Startende in der Fkt.-‹berwachung" VALUE 0xFCF412 KwUb 10200. nmot_ub_q40 0.00 10200. FORMAT "%5.0" /end CHARACTERISTIC
/begin CHARACTERISTIC REAC_T1_UM "Fehlerzeit bei der Funktions-Fehlerreaktions¸berwachung in der Funktions¸berw." VALUE 0xFCF108 KwUb 10200.0 t40ms_ub_b10200 0.00 10200.0 FORMAT "%7.1" /end CHARACTERISTIC
/begin CHARACTERISTIC REAC_T2_UM "Fehlerzeit bei der Funktions¸berwachungs-Fehlerreaktions¸berwachung" VALUE 0xFCF109 KwUb 10200.0 t40ms_ub_b10200 0.00 10200.0 FORMAT "%7.1" /end CHARACTERISTIC
/begin CHARACTERISTIC RLC_T_UM "Fehlertoleranzzeit f¸r den rl-Vergleich mit der Funktion in der Funktions¸berw." VALUE 0xFCF0BD KwUb 10200.0 t40ms_ub_b10200 0.00 10200.0 FORMAT "%7.1" /end CHARACTERISTIC
/begin CHARACTERISTIC RLDFIL_UM "Filterzeitkonstanate f¸r verzˆgerte Lastinformation rldf_um" VALUE 0xFCF0BE KwUb 10159.4 zk40ms_ub_b10200 40.6299 10200.0 FORMAT "%7.1" /end CHARACTERISTIC
/begin CHARACTERISTIC RLDPFIL_UM "Filterzeitkonstante f¸r verzˆgerte Lastinfo rldp_um in der Funktions¸berwachung" VALUE 0xFCF0BF KwUb 10159.4 zk40ms_ub_b10200 40.6299 10200.0 FORMAT "%7.1" /end CHARACTERISTIC
/begin CHARACTERISTIC RLDPTV_UM "Verzugszeit f¸r Lastinformation rldp_um in der Funktions¸berwachung" VALUE 0xFCF0C0 KwUb 320.000 t40ms_ub_b10200 0.00 320.000 FORMAT "%7.3" /end CHARACTERISTIC
/begin CHARACTERISTIC RLDTV_UM "Verzugszeit f¸r Lastinformation rldf_um" VALUE 0xFCF0C1 KwUb 320.000 t40ms_ub_b10200 0.00 320.000 FORMAT "%7.3" /end CHARACTERISTIC
/begin CHARACTERISTIC RLIP_T_UM "Fehlertoleranzzeit f¸r den rl/rlip-Vergleich in der Funktions¸berwachg" VALUE 0xFCF0C2 KwUb 10200.0 t40ms_ub_b10200 0.00 10200.0 FORMAT "%7.1" /end CHARACTERISTIC
/begin AXIS_PTS RLV08_UM "Stutzstellenverteilung f¸r Lastinfo in der Funktions¸berwachung" 0xFCF0C3 rl_um SstAUbSstUb 191.3 rel_ub_q0p75 8 0.00 191.3 FORMAT "%5.1" DEPOSIT ABSOLUTE /end AXIS_PTS
/begin CHARACTERISTIC RLVT_BO_UM "Offset f¸r obere Toleranzgerade VVT" VALUE 0xFCF0CC KwUb 191.3 rel_ub_q0p75 0.00 191.3 FORMAT "%5.1" /end CHARACTERISTIC
/begin CHARACTERISTIC RLVT_MO_UM "Steigung f¸r obere Toleranzgerade VVT" VALUE 0xFCF0CD KwUb 255.0 dez 0.00 255.0 FORMAT "%5.1" /end CHARACTERISTIC
/begin CHARACTERISTIC RL_BO_UM "Offset f¸r Toleranzgerade f(rl_um) f¸r rlipf_um in der Funktions¸berwachung" VALUE 0xFCF0CE KwUb 191.3 rel_ub_q0p75 0.00 191.3 FORMAT "%5.1" /end CHARACTERISTIC
/begin CHARACTERISTIC RL_MO_UM "Steigung f¸r Toleranzgerade f(rl_um) f¸r rlipf_um in der Funktions¸berwachung" VALUE 0xFCF0CF KwUb 255.0 dez 0.00 255.0 FORMAT "%5.1" /end CHARACTERISTIC
/begin CHARACTERISTIC ROMRSTA_UM "maximale Anzahl Resets bei Fehlererkennung im ROM-Check in der Initialisierung" VALUE 0xFCEDC8 KwUb 255.0 dez 0.00 255.0 FORMAT "%5.1" /end CHARACTERISTIC
/begin CHARACTERISTIC RoutingAddrTable_cu8 "" VAL_BLK 0xFC088E KwbWU8 255.0 dez 0.00 255.0 FORMAT "%5.1" NUMBER 256 /end CHARACTERISTIC
/begin CHARACTERISTIC RoutingTableHeader_cu8 "" VAL_BLK 0xFC0870 KwbWU8 255.0 dez 0.00 255.0 FORMAT "%5.1" NUMBER 30 /end CHARACTERISTIC
/begin AXIS_PTS SBF02MFLRSB "" 0xFD3F96 bfzglf SstAUbSstSb 55.34 bfzg_sb_q0p217 4 -27.78 27.56 FORMAT "%5.2" DEPOSIT ABSOLUTE /end AXIS_PTS
/begin AXIS_PTS SBF02MFSB "" 0xFD3F9B bfzglf SstAUbSstSb 55.34 bfzg_sb_q0p217 4 -27.78 27.56 FORMAT "%5.2" DEPOSIT ABSOLUTE /end AXIS_PTS
/begin AXIS_PTS SCO08VMUB "Vmax-Index St¸tzstelle" 0xFD3FA0 vmaxidx SstAUbSstUb 255.0 dez 8 0.00 255.0 FORMAT "%5.1" DEPOSIT ABSOLUTE /end AXIS_PTS
/begin CHARACTERISTIC SGSC_T_UM "Fehlerzeit f¸r SGS-Eingriff-‹berwachung der Funktions¸berwachung" VALUE 0xFCF0F6 KwUb 2550.00 t10ms_ub_b2550 0.00 2550.00 /end CHARACTERISTIC
/begin CHARACTERISTIC SKADRHZ_UM "Motorgrenzdrehzahl f¸r komplette Einspritzausblendung bei SKA" VALUE 0xFCF10A KwUb 10200. nmot_ub_q40 0.00 10200. FORMAT "%5.0" /end CHARACTERISTIC
/begin AXIS_PTS SNM08__UB "St¸tzstellenverteilung Drehzahl, 8 Sst." 0xFC1394 nmot SstAUbSstUb 10200. nmot_ub_q40 8 0.00 10200. FORMAT "%5.0" DEPOSIT ABSOLUTE /end AXIS_PTS
/begin AXIS_PTS SNM16ZUUB "St¸tzstellenverteilung Drehzahl, 16 Sst." 0xFC13C2 nmot SstAUbSstUb 10200. nmot_ub_q40 16 0.00 10200. FORMAT "%5.0" DEPOSIT ABSOLUTE /end AXIS_PTS
/begin AXIS_PTS SNM24ZUUB "St¸tzstellenverteilung Drehzahl, 24 Sst." 0xFC13D3 nmot SstAUbSstUb 10200. nmot_ub_q40 24 0.00 10200. FORMAT "%5.0" DEPOSIT ABSOLUTE /end AXIS_PTS
/begin CHARACTERISTIC SP12LL_UM "maximale Differenz zwischen SP1S und SP2S unterhalb der Vollgas-Schwelle" VALUE 0xFCF0D1 KwUb 4.980 spg_ub_q0p019 0.00 4.980 FORMAT "%5.3" /end CHARACTERISTIC
/begin CHARACTERISTIC SP12VG_UM "maximale Differenz zwischen SP1S und SP2S oberhalb der Vollgas-Schwelle" VALUE 0xFCF0D2 KwUb 4.980 spg_ub_q0p019 0.00 4.980 FORMAT "%5.3" /end CHARACTERISTIC
/begin CHARACTERISTIC SPSC_MINUM "= SPSC_MIN_UM Pedal-Leergas-Grenze f¸r die Funktions¸berwachung" VALUE 0xFCF0D3 KwUb 4.980 spg_ub_q0p019 0.00 4.980 FORMAT "%5.3" /end CHARACTERISTIC
/begin CHARACTERISTIC SPSC_T_UM "Fehlerzeit bei zueinander unplausiblen Sollwerten in der Funktions¸berwachung" VALUE 0xFCF0D4 KwUb 10200.0 t40ms_ub_b10200 0.00 10200.0 FORMAT "%7.1" /end CHARACTERISTIC
/begin CHARACTERISTIC SPSNLL_UM "Maximale Spannung f¸r Leergas in Ebene II" VALUE 0xFCF3F3 KwUb 4.980 spg_ub_q0p019 0.00 4.980 FORMAT "%5.3" /end CHARACTERISTIC
/begin AXIS_PTS SPSNV08_UM "St¸tzstellenverteilung f¸r Pedalwert in der Funktions¸berwachung" 0xFCF0D5 spsn_um SstAUbSstUb 4.980 spg_ub_q0p019 8 0.00 4.980 FORMAT "%5.3" DEPOSIT ABSOLUTE /end AXIS_PTS
/begin CHARACTERISTIC SPSVG_UM "Vollgas-Sollwert-Schwelle zur Umschaltung der maximalen Differenz SP1S-SP2S" VALUE 0xFCF0DE KwUb 4.980 spg_ub_q0p019 0.00 4.980 FORMAT "%5.3" /end CHARACTERISTIC
/begin AXIS_PTS SRL03MFLRUW "" 0xFD402A rl_w SstAUwSstUw 1535.977 rel_uw_q0p0234 4 0.00 1535.977 FORMAT "%8.3" DEPOSIT ABSOLUTE /end AXIS_PTS
/begin AXIS_PTS SRL03MFUW "" 0xFD4034 rl_w SstAUwSstUw 1535.977 rel_uw_q0p0234 4 0.00 1535.977 FORMAT "%8.3" DEPOSIT ABSOLUTE /end AXIS_PTS
/begin AXIS_PTS SRL06ZUUB "" 0xFC13F2 rl SstAUbSstUb 191.3 rel_ub_q0p75 6 0.00 191.3 FORMAT "%5.1" DEPOSIT ABSOLUTE /end AXIS_PTS
/begin AXIS_PTS SRL12ZUUB "St¸tzstellenverteilung relative Luftf¸llung, 12 St." 0xFC1411 rl SstAUbSstUb 191.3 rel_ub_q0p75 12 0.00 191.3 FORMAT "%5.1" DEPOSIT ABSOLUTE /end AXIS_PTS
/begin AXIS_PTS SRL16ZUUB "St¸tzstellenverteilung relative F¸llung, 16 Sst." 0xFC141E rl SstAUbSstUb 191.3 rel_ub_q0p75 16 0.00 191.3 FORMAT "%5.1" DEPOSIT ABSOLUTE /end AXIS_PTS
/begin AXIS_PTS STM06__UB "St¸tzstellenverteilung Motortemperatur, 6 Sst." 0xFCF882 tmot SstAUbSstUb 191.3 temp_ub_q0p75_o48 6 -48.00 143.3 FORMAT "%5.1" DEPOSIT ABSOLUTE /end AXIS_PTS
/begin CHARACTERISTIC S_DPSADOF "Schalter Differenzdruck Saugrohr Adation ausgeschaltet" VALUE 0xFC5F00 KwWU8 1.000 dez 0.00 1.000 FORMAT "%5.3" /end CHARACTERISTIC
/begin CHARACTERISTIC S_GOFFRAMP "Schalter Sprung auf 10,6V unverzoegert" VALUE 0xFCC66D KwWU8 255.0 dez 0.00 255.0 FORMAT "%5.1" /end CHARACTERISTIC
/begin CHARACTERISTIC S_MLDPSADO "Schalter Luftmassen dps Adaption ausgeschaltet" VALUE 0xFC5F01 KwWU8 1.000 dez 0.00 1.000 FORMAT "%5.3" /end CHARACTERISTIC
/begin CHARACTERISTIC S_WDKADOF "Schalter Drosselklappenwinkel Adaption ausgeschaltet" VALUE 0xFC5F02 KwWU8 1.000 dez 0.00 1.000 FORMAT "%5.3" /end CHARACTERISTIC
/begin CHARACTERISTIC S_ZNDRLP "Umschaltung zwischen rl und rlp" VALUE 0xFCE3BF KwUb 255.0 dez 0.00 255.0 FORMAT "%5.1" /end CHARACTERISTIC
/begin CHARACTERISTIC TANSMN_UM "Ansauglufttemperaturschwelle zur Nachstartaufweitung in der Fkt.-‹berwachung" VALUE 0xFCF413 KwUb 191.3 temp_ub_q0p75_o48 -48.00 143.3 FORMAT "%5.1" /end CHARACTERISTIC
/begin CHARACTERISTIC TDIFMX_UM "Maximale Abweichung der Summe von Zeitdifferenzen zw. TPU u. CPU in der FU" VALUE 0xFCEDD2 KwUw 26.21400 txms_uw_q0p0004 0.00 26.21400 FORMAT "%8.5" /end CHARACTERISTIC
/begin CHARACTERISTIC TDMCFGTF "Zeit fuer check filler cap pruefung" CURVE 0xFD4F18 KlAxU8SstxU16WU16 6553.500 t_q0p1 0.00 6553.500 FORMAT "%8.3"
 /begin AXIS_DESCR STD_AXIS dmtfgvt_w vol_q0p1_l 5 0.00 6553.500 FORMAT "%8.3" DEPOSIT ABSOLUTE /end AXIS_DESCR
/end CHARACTERISTIC
/begin CHARACTERISTIC TDMELGTF "Zeit fuer Grobleckpruefung am Bandende" CURVE 0xFD4F2E KlAxU8SstxU16WU16 6553.500 t_q0p1 0.00 6553.500 FORMAT "%8.3"
 /begin AXIS_DESCR STD_AXIS dmtfgvt_w vol_q0p1_l 5 0.00 6553.500 FORMAT "%8.3" DEPOSIT ABSOLUTE /end AXIS_DESCR
/end CHARACTERISTIC
/begin CHARACTERISTIC TDMGLGTF "Zeit fuer Grobleckpruefung" CURVE 0xFD4F44 KlAxU8SstxU16WU16 6553.500 t_q0p1 0.00 6553.500 FORMAT "%8.3"
 /begin AXIS_DESCR STD_AXIS dmtfgvt_w vol_q0p1_l 5 0.00 6553.500 FORMAT "%8.3" DEPOSIT ABSOLUTE /end AXIS_DESCR
/end CHARACTERISTIC
/begin CHARACTERISTIC TDMKLGTF "Zeit fuer Feinleckpruefung" CURVE 0xFD4F5A KlAxU8SstxU16WU16 6553.500 t_q0p1 0.00 6553.500 FORMAT "%8.3"
 /begin AXIS_DESCR STD_AXIS dmtfgvt_w vol_q0p1_l 5 0.00 6553.500 FORMAT "%8.3" DEPOSIT ABSOLUTE /end AXIS_DESCR
/end CHARACTERISTIC
/begin CHARACTERISTIC TDMTREF "Zeit fuer Referenzleckmessung" VALUE 0xFD4F90 KwWU16 6553.500 t_q0p1 0.00 6553.500 FORMAT "%8.3" /end CHARACTERISTIC
/begin CHARACTERISTIC TDMTREFW "Zeit fuer Wiederholungs-Referenzleckmessung" VALUE 0xFD4F92 KwWU16 6553.500 t_q0p1 0.00 6553.500 FORMAT "%8.3" /end CHARACTERISTIC
/begin CHARACTERISTIC TDMTRSTA "Midestzeit zwischen zwei aufeinanderfolgenden DM-TL Tests" VALUE 0xFD4F94 KwWU16 6553.500 t_q0p1 0.00 6553.500 FORMAT "%8.3" /end CHARACTERISTIC
/begin CHARACTERISTIC TEFABE2 "Zeitdauer Diagnosen-Systemtest am Bandende" VALUE 0xFD4F96 KwWU16 393210.0 t6minxmin_q6 0.00 393210.0 FORMAT "%8.1" /end CHARACTERISTIC
/begin CHARACTERISTIC TMNSMN_UM "Motortemperaturschwelle f¸r die Nachstartaufweitung in der FKT.-‹berwachung" VALUE 0xFCF414 KwUb 191.3 temp_ub_q0p75_o48 -48.00 143.3 FORMAT "%5.1" /end CHARACTERISTIC
/begin CHARACTERISTIC TMOMIN_UM "Minimal plausible Motortemperatur" VALUE 0xFCF3F4 KwUb 191.3 temp_ub_q0p75_o48 -48.00 143.3 FORMAT "%5.1" /end CHARACTERISTIC
/begin AXIS_PTS TMOV08_UM "St¸tzstellenverteilung f¸r Motortemperatur" 0xFCF3F5 tmotmn_um SstAUbSstUb 191.3 temp_ub_q0p75_o48 8 -48.00 143.3 FORMAT "%5.1" DEPOSIT ABSOLUTE /end AXIS_PTS
/begin CHARACTERISTIC TMXRFMIN "Maximimale Zeit zur Erkennung des Leerlaufstroms" VALUE 0xFD4F98 KwWU16 6553.500 t_q0p1 0.00 6553.500 FORMAT "%8.3" /end CHARACTERISTIC
/begin CHARACTERISTIC TPUCA_T_UM "Zeitlicher Abstand der zyklischen Aktivierung der TPU-Pr¸fung in der FU" VALUE 0xFCEDCB KwUb 2550.00 t10ms_ub_b2550 0.00 2550.00 /end CHARACTERISTIC
/begin CHARACTERISTIC TPUCR_T_UM "Fehlerzeit des TPU-Code-RAM-Tests in der Funktions¸berwachung" VALUE 0xFCEDCC KwUb 255.0 dez 0.00 255.0 FORMAT "%5.1" /end CHARACTERISTIC
/begin CHARACTERISTIC TPURA_T_UM "Zeitlicher Abstand der zyklischen Aktivierung des TPU-Code-RAM-Tests in der FU" VALUE 0xFCEDCD KwUb 2550.00 t10ms_ub_b2550 0.00 2550.00 /end CHARACTERISTIC
/begin CHARACTERISTIC TPURSTA_UM "Maximale Anzahl von Resets aus der TPU-‹berwachung" VALUE 0xFCEDCE KwUb 255.0 dez 0.00 255.0 FORMAT "%5.1" /end CHARACTERISTIC
/begin CHARACTERISTIC TPUST_T_UM "Zeitverzˆgerung nach Synchro zur Aktivierung der TPU-‹berwachung" VALUE 0xFCEDCF KwUb 2550.00 t10ms_ub_b2550 0.00 2550.00 /end CHARACTERISTIC
/begin CHARACTERISTIC TPU_T_UM "Fehlerzeit der TPU-‹berwachung in der Funktions¸berwachung" VALUE 0xFCEDD0 KwUb 255.0 dez 0.00 255.0 FORMAT "%5.1" /end CHARACTERISTIC
/begin CHARACTERISTIC TRLSOLKRT "Verzˆgerungszeit rlsol gedrosselt" VALUE 0xFCE3C0 KwUb 15.00 dez 0.00 15.00 FORMAT "%5.2" /end CHARACTERISTIC
/begin CHARACTERISTIC TSEGMIN_UM "Minimale Segmentzeit in der Drehzahlberechnung mit Segmentzeiten in der FU" VALUE 0xFCF40E KwUw 26.21400 txms_uw_q0p0004 0.00 26.21400 FORMAT "%8.5" /end CHARACTERISTIC
/begin CHARACTERISTIC TSUB "Schliesszeit" CURVE 0xFCDACC FklWU16 65.53500 txms_uw_q0p001 0.00 65.53500 FORMAT "%8.5"
 /begin AXIS_DESCR FIX_AXIS ub spg_ubatt 128 0.00 23.93 FORMAT "%5.2" FIX_AXIS_PAR 0 1 128 /end AXIS_DESCR
/end CHARACTERISTIC
/begin CHARACTERISTIC TVDRLSOLKR "" CURVE 0xFCE3C1 KlAUbSstUbWUb 2.550 t10msxs_ub_b2p55 0.00 2.550 FORMAT "%5.3"
 /begin AXIS_DESCR STD_AXIS nmot nmot_ub_q40 8 0.00 10200. FORMAT "%5.0" DEPOSIT ABSOLUTE /end AXIS_DESCR
/end CHARACTERISTIC
/begin CHARACTERISTIC TVMXPR "Geschwindigkeit-Pr‰diktionshorizont f¸r VMAX-Regelung" VALUE 0xFD3FA9 KwUb 2.550 t10msxs_ub_b2p55 0.00 2.550 FORMAT "%5.3" /end CHARACTERISTIC
/begin CHARACTERISTIC TVVTCHKB2 "Verzoegerungszeit bis Bank 2 mit Lernen beginnt" VALUE 0xFC5EF3 KwWU8 2.550 t10msxs_ub_b2p55 0.00 2.550 FORMAT "%5.3" /end CHARACTERISTIC
/begin CHARACTERISTIC TVVTCHKEST "Abbruch fuer Ueberpruefung Abstellposition" VALUE 0xFC5EDE KwWU16 655.3500 t10msxs_uw_b655p35 0.00 655.3500 FORMAT "%8.4" /end CHARACTERISTIC
/begin CHARACTERISTIC TVVTCHKND "Zeitfenster fuer Ueberpruefung Nullhubanschlag" VALUE 0xFC5EE0 KwWU16 655.3500 t10msxs_uw_b655p35 0.00 655.3500 FORMAT "%8.4" /end CHARACTERISTIC
/begin CHARACTERISTIC TVVTCHKNST "Startzeit fuer Nullhubueberpruefung" VALUE 0xFC5EE2 KwWU16 655.3500 t10msxs_uw_b655p35 0.00 655.3500 FORMAT "%8.4" /end CHARACTERISTIC
/begin CHARACTERISTIC TVVTCHKPWR "Zeit bis Power off" VALUE 0xFC5EF4 KwWU8 2.550 t10msxs_ub_b2p55 0.00 2.550 FORMAT "%5.3" /end CHARACTERISTIC
/begin CHARACTERISTIC TVVTCHKSO "Verzoegerungszeit fuer lernen Abstellposition" VALUE 0xFC5EF5 KwWU8 2.550 t10msxs_ub_b2p55 0.00 2.550 FORMAT "%5.3" /end CHARACTERISTIC
/begin CHARACTERISTIC TVVTCHKUD "Zeitfenster fuer Anschlaglernen" VALUE 0xFC5EE4 KwWU16 655.3500 t10msxs_uw_b655p35 0.00 655.3500 FORMAT "%8.4" /end CHARACTERISTIC
/begin CHARACTERISTIC TVVTCHKUST "Startzeit fuer Nullhubueberpruefung" VALUE 0xFC5EE6 KwWU16 655.3500 t10msxs_uw_b655p35 0.00 655.3500 FORMAT "%8.4" /end CHARACTERISTIC
/begin CHARACTERISTIC TVZWMSA "Zeit bis zum ‹bergehen auf Dauersp‰tbegrenzung" VALUE 0xFCEA76 KwUw 655.3500 t10msxs_uw_b655p35 0.00 655.3500 FORMAT "%8.4" /end CHARACTERISTIC
/begin CHARACTERISTIC TVZWMSE "Zeit bis zum ‹bergehen auf Dynamiksp‰tbegrenzung" VALUE 0xFCEA78 KwUw 655.3500 t10msxs_uw_b655p35 0.00 655.3500 FORMAT "%8.4" /end CHARACTERISTIC
/begin CHARACTERISTIC T_VERB_ON "" VALUE 0xFCC66E KwWU8 25.50 t100msxs_ub_b25p5 0.00 25.50 FORMAT "%5.2" /end CHARACTERISTIC
/begin CHARACTERISTIC UBNS "Batteriespannungsschwelle f¸r NSOLL - Anhebung" VALUE 0xFCC662 KwWU16 16.00000 spg_sw_q0p001 0.00 16.00000 FORMAT "%8.5" /end CHARACTERISTIC
/begin CHARACTERISTIC UGENDELTA "Generatoroffsetdelta f¸r 2-Generatorregelung" VALUE 0xFCC664 KwWU16 16.00000 spg_sw_q0p001 0.00 16.00000 FORMAT "%8.5" /end CHARACTERISTIC
/begin CHARACTERISTIC UGENOFF "" VALUE 0xFCC666 KwWU16 16.00000 spg_sw_q0p001 0.00 16.00000 FORMAT "%8.5" /end CHARACTERISTIC
/begin CHARACTERISTIC UGENOFFV0 "" VALUE 0xFCC668 KwWU16 16.00000 spg_sw_q0p001 0.00 16.00000 FORMAT "%8.5" /end CHARACTERISTIC
/begin CHARACTERISTIC VVTCHKDIF1 "Maximaler Unterschied zur Abstellposition (Bereich 1)" VALUE 0xFC5EE8 KwWU16 99.99850 rel_b99p9985 0.00 99.99850 FORMAT "%8.5" /end CHARACTERISTIC
/begin CHARACTERISTIC VVTCHKDIF2 "Maximaler Unterschied zur Abstellposition (Bereich 2)" VALUE 0xFC5EEA KwWU16 99.99850 rel_b99p9985 0.00 99.99850 FORMAT "%8.5" /end CHARACTERISTIC
/begin CHARACTERISTIC VVTCHKDSPW "Maximaler Unterschied des Sollwerts fuer Bestromung" VALUE 0xFC5EEC KwWU16 99.99850 rel_b99p9985 0.00 99.99850 FORMAT "%8.5" /end CHARACTERISTIC
/begin CHARACTERISTIC VVTCHKTIAN "Betriebszeit nach der Anschl‰ge neu gerlernt werden" VALUE 0xFC5EEE KwWU16 393210.0 t6minxmin_q6 0.00 393210.0 FORMAT "%8.1" /end CHARACTERISTIC
/begin CHARACTERISTIC VVTCHKTO "Obere Temperaturschwelle fuer Lernvorgang" VALUE 0xFC5EF6 KwWU8 191.3 temp_ub_q0p75_o48 -48.00 143.3 FORMAT "%5.1" /end CHARACTERISTIC
/begin CHARACTERISTIC VVTCHKTU "Untere Temperaturschwelle fuer Lernvorgang" VALUE 0xFC5EF7 KwWU8 191.3 temp_ub_q0p75_o48 -48.00 143.3 FORMAT "%5.1" /end CHARACTERISTIC
/begin CHARACTERISTIC VVT_T_UM "Fehlertoleranzzeit f¸r unplausible VVT-Info f.d. Funktions¸berwachung" VALUE 0xFCF0D0 KwUb 10200.0 t40ms_ub_b10200 0.00 10200.0 FORMAT "%7.1" /end CHARACTERISTIC
/begin CHARACTERISTIC watch_acmode "" VALUE 0xFCF524 KwSw 65535.00 dez -32768.00 32767.00 FORMAT "%8.2" /end CHARACTERISTIC
/begin CHARACTERISTIC watch_addr0_h "" VALUE 0xFCF512 KwUw 65535.00 dez 0.00 65535.00 FORMAT "%8.2" /end CHARACTERISTIC
/begin CHARACTERISTIC watch_addr0_l "" VALUE 0xFCF514 KwUw 65535.00 dez 0.00 65535.00 FORMAT "%8.2" /end CHARACTERISTIC
/begin CHARACTERISTIC watch_addr1_h "" VALUE 0xFCF516 KwUw 65535.00 dez 0.00 65535.00 FORMAT "%8.2" /end CHARACTERISTIC
/begin CHARACTERISTIC watch_addr1_l "" VALUE 0xFCF518 KwUw 65535.00 dez 0.00 65535.00 FORMAT "%8.2" /end CHARACTERISTIC
/begin CHARACTERISTIC watch_addr2_h "" VALUE 0xFCF51A KwUw 65535.00 dez 0.00 65535.00 FORMAT "%8.2" /end CHARACTERISTIC
/begin CHARACTERISTIC watch_addr2_l "" VALUE 0xFCF51C KwUw 65535.00 dez 0.00 65535.00 FORMAT "%8.2" /end CHARACTERISTIC
/begin CHARACTERISTIC watch_addr3_h "" VALUE 0xFCF51E KwUw 65535.00 dez 0.00 65535.00 FORMAT "%8.2" /end CHARACTERISTIC
/begin CHARACTERISTIC watch_addr3_l "" VALUE 0xFCF520 KwUw 65535.00 dez 0.00 65535.00 FORMAT "%8.2" /end CHARACTERISTIC
/begin CHARACTERISTIC watch_addr4_h "" VALUE 0xFCF526 KwUw 65535.00 dez 0.00 65535.00 FORMAT "%8.2" /end CHARACTERISTIC
/begin CHARACTERISTIC watch_addr4_l "" VALUE 0xFCF528 KwUw 65535.00 dez 0.00 65535.00 FORMAT "%8.2" /end CHARACTERISTIC
/begin CHARACTERISTIC watch_addr5_h "" VALUE 0xFCF52A KwUw 65535.00 dez 0.00 65535.00 FORMAT "%8.2" /end CHARACTERISTIC
/begin CHARACTERISTIC watch_addr5_l "" VALUE 0xFCF52C KwUw 65535.00 dez 0.00 65535.00 FORMAT "%8.2" /end CHARACTERISTIC
/begin CHARACTERISTIC watch_cmode4 "" VALUE 0xFCF52E KwSw 65535.00 dez -32768.00 32767.00 FORMAT "%8.2" /end CHARACTERISTIC
/begin CHARACTERISTIC watch_cmode5 "" VALUE 0xFCF530 KwSw 65535.00 dez -32768.00 32767.00 FORMAT "%8.2" /end CHARACTERISTIC
/begin CHARACTERISTIC watch_dcmode "" VALUE 0xFCF532 KwSw 65535.00 dez -32768.00 32767.00 FORMAT "%8.2" /end CHARACTERISTIC
/begin CHARACTERISTIC watch_mode "" VALUE 0xFCF522 KwSb 255.0 dez -128.0 127.0 FORMAT "%5.1" /end CHARACTERISTIC
/begin CHARACTERISTIC watch_newdata "" VALUE 0xFCF510 KwSb 255.0 dez -128.0 127.0 FORMAT "%5.1" /end CHARACTERISTIC
/begin CHARACTERISTIC watch_on "" VALUE 0xFCF511 KwSb 255.0 dez -128.0 127.0 FORMAT "%5.1" /end CHARACTERISTIC
/begin CHARACTERISTIC watch_rw4 "" VALUE 0xFCF534 KwSw 65535.00 dez -32768.00 32767.00 FORMAT "%8.2" /end CHARACTERISTIC
/begin CHARACTERISTIC watch_rw5 "" VALUE 0xFCF536 KwSw 65535.00 dez -32768.00 32767.00 FORMAT "%8.2" /end CHARACTERISTIC
/begin CHARACTERISTIC watch_sign4 "" VALUE 0xFCF538 KwSw 65535.00 dez -32768.00 32767.00 FORMAT "%8.2" /end CHARACTERISTIC
/begin CHARACTERISTIC watch_sign5 "" VALUE 0xFCF53A KwSw 65535.00 dez -32768.00 32767.00 FORMAT "%8.2" /end CHARACTERISTIC
/begin CHARACTERISTIC watch_size_bits4 "" VALUE 0xFCF53C KwSw 65535.00 dez -32768.00 32767.00 FORMAT "%8.2" /end CHARACTERISTIC
/begin CHARACTERISTIC watch_size_bits5 "" VALUE 0xFCF53E KwSw 65535.00 dez -32768.00 32767.00 FORMAT "%8.2" /end CHARACTERISTIC
/begin CHARACTERISTIC watch_value4_h "" VALUE 0xFCF540 KwUw 65535.00 dez 0.00 65535.00 FORMAT "%8.2" /end CHARACTERISTIC
/begin CHARACTERISTIC watch_value4_l "" VALUE 0xFCF542 KwUw 65535.00 dez 0.00 65535.00 FORMAT "%8.2" /end CHARACTERISTIC
/begin CHARACTERISTIC watch_value5_h "" VALUE 0xFCF544 KwUw 65535.00 dez 0.00 65535.00 FORMAT "%8.2" /end CHARACTERISTIC
/begin CHARACTERISTIC watch_value5_l "" VALUE 0xFCF546 KwUw 65535.00 dez 0.00 65535.00 FORMAT "%8.2" /end CHARACTERISTIC
/begin CHARACTERISTIC WDKDPSAD_H "Drosselklappenwinkel dps Adaption Handbetrieb" VALUE 0xFD143E KwSw 99.99847 rel_sw_b50 -50.00000 49.99847 FORMAT "%8.5" /end CHARACTERISTIC
/begin CHARACTERISTIC WESNESPR "Kennlinie f¸r ƒnderung des Einlassventil-÷ffnungswinkels" CURVE 0xFC77AE KlAUwSstUwWUw 196605.0 kw_q3 0.00 196605.0 FORMAT "%8.1"
 /begin AXIS_DESCR STD_AXIS evhubs_w hub_uw_q0p001 8 0.00 65.53500 FORMAT "%8.5" DEPOSIT ABSOLUTE /end AXIS_DESCR
/end CHARACTERISTIC
/begin CHARACTERISTIC WMNDOPZ "Sp‰tester Z¸ndwinkel im DZA Betrieb (Phasengebernotlauf)" VALUE 0xFCDAC9 KwSb 191.3 zw_sb_q0p75 -96.00 95.25 FORMAT "%5.2" /end CHARACTERISTIC
/begin CHARACTERISTIC WMXTA "Ansaugluft Korrekturz¸ndwinkel" CURVE 0xFCE3D2 KlAUbSstUbWSb 191.3 zw_sb_q0p75 -96.00 95.25 FORMAT "%5.2"
 /begin AXIS_DESCR STD_AXIS tans temp_ub_q0p75_o48 3 -48.00 143.3 FORMAT "%5.1" DEPOSIT ABSOLUTE /end AXIS_DESCR
/end CHARACTERISTIC
/begin CHARACTERISTIC WPHN "Phasengang" CURVE 0xFD527C GklWSb 191.3 zw_sb_q0p75 -96.00 95.25 FORMAT "%5.2"
 /begin AXIS_DESCR COM_AXIS nmot nmot_ub_q40 8 0.00 10200. FORMAT "%5.0" AXIS_PTS_REF SNM08__UB /end AXIS_DESCR
/end CHARACTERISTIC
/begin CHARACTERISTIC ZBFIL "Zeitkonstante f¸r Beschleunigungsfilter" VALUE 0xFCA30A KwUb 2.54000 zk10msxs_ub_b2p55 0.0100000 2.55000 FORMAT "%7.5" /end CHARACTERISTIC
/begin CHARACTERISTIC ZKRLSOLKRT "Zeitkonstante rlsol-Tiefpaﬂfilter gedrosselt" VALUE 0xFCE3DA KwUw 655.34999985 zk10msxs_uw_b655 0.010000152590 655.36000000 FORMAT "%12.8" /end CHARACTERISTIC
/begin CHARACTERISTIC ZWAPPL "Applikationsschnittstelle Z¸ndwinkelverstellung" VALUE 0xFCDACA KwSb 191.3 zw_sb_q0p75 -96.00 95.25 FORMAT "%5.2" /end CHARACTERISTIC
/begin CHARACTERISTIC ZWC_T_UM "Fehlertoleranzzeit der Z¸ndwinkel¸berwachung in der Funktions¸berw." VALUE 0xFCF418 KwUb 255.0 dez 0.00 255.0 FORMAT "%5.1" /end CHARACTERISTIC
/begin CHARACTERISTIC ZYLANZ_UM "Zylinderzahl f¸r die Z¸ndwinkel¸berwachung in der Funktions¸berw." VALUE 0xFCF419 KwUb 23.00 dez 1.000 24.00 FORMAT "%5.2" /end CHARACTERISTIC
/begin MEASUREMENT abtres_um "Antwortbeitrag des Befehlstests in der Funktions¸berwachung" ULONG dez 1 100 0 4.29497e+009 FORMAT "%13.2" ECU_ADDRESS 0x404898 /end MEASUREMENT
/begin MEASUREMENT adcc_c_um "Fehlerz‰hler bei zueinander unplausiblen ADC-Werten f¸r sp1s" UBYTE t20ms_ub_b5100 1 100 0 5100 ECU_ADDRESS 0x3F981D /end MEASUREMENT
/begin MEASUREMENT adcc_c_ur "Doppelablage (DA) f¸r ADCC_C_UM" UBYTE dez 1 100 0 255 FORMAT "%5.1" ECU_ADDRESS 0x3F9940 /end MEASUREMENT
/begin MEASUREMENT adcq_c_um "Fehlerz‰hler  in der ADC-Queue-‹berwachung" UBYTE t10ms_ub_b2550 1 100 0 2550 ECU_ADDRESS 0x3F981E /end MEASUREMENT
/begin MEASUREMENT adcq_c_ur "Doppelablage (DA) f¸r ADCQ_C_UM" UBYTE dez 1 100 0 255 FORMAT "%5.1" ECU_ADDRESS 0x3F9941 /end MEASUREMENT
/begin MEASUREMENT adcq_um "Info aus dem ADC-Queue-Status Register" UBYTE dez 1 100 0 255 FORMAT "%5.1" ECU_ADDRESS 0x3F9942 /end MEASUREMENT
/begin MEASUREMENT aktend_w "beendete Tankleckdiagnosen" UWORD dez 1 100 0 65535 FORMAT "%8.2" ECU_ADDRESS 0x3FE2EC /end MEASUREMENT
/begin MEASUREMENT aktqu_uc "Aktuell im Befehlstest verwendete Frage" UBYTE dez 1 100 0 255 FORMAT "%5.1" ECU_ADDRESS 0x403A7E /end MEASUREMENT
/begin MEASUREMENT apakres_um "Antwortbeitrag der Programmablaufkontrolle in der Funktions¸berwachung" ULONG dez 1 100 0 4.29497e+009 FORMAT "%13.2" ECU_ADDRESS 0x404894 /end MEASUREMENT
/begin MEASUREMENT AS_wp "" UBYTE B_TRUE 1 100 0 1 BIT_MASK 0x1 FORMAT "%13.11" ECU_ADDRESS 0x3FC364 /end MEASUREMENT
/begin MEASUREMENT auscf_c_um "Fehlerz‰hler im DauerRAM f¸r nicht angezogenes Hauptrelais (Diagnose) in %UMAUSC" UBYTE dez 1 100 0 255 FORMAT "%5.1" ECU_ADDRESS 0x3FDED0 /end MEASUREMENT
/begin MEASUREMENT ausch_c_um "Timeoutz‰hler f¸r Anzahl von Antworten an das UM im Abschaltpfadtest" UBYTE dez 1 100 0 255 FORMAT "%5.1" ECU_ADDRESS 0x403ACC /end MEASUREMENT
/begin MEASUREMENT ausc_c_um "Pr¸fungsz‰hler im DauerRAM f¸r nicht angezogenes Hauptrelais im Abschaltpfadtest" UBYTE dez 1 100 0 255 FORMAT "%5.1" ECU_ADDRESS 0x3FDED1 /end MEASUREMENT
/begin MEASUREMENT ausc_ur "Doppelablage (DA) f¸r Bit B_AUSC_UM" UBYTE dez 1 100 0 255 FORMAT "%5.1" ECU_ADDRESS 0x3F9A20 /end MEASUREMENT
/begin MEASUREMENT ausgh_c_um "Heilungsz‰hler f¸r Fehler in der zyklischen RAM-Pr¸fung der Funktions¸berwachung" UBYTE t40ms_ub_b10200 1 100 0 10200 FORMAT "%7.1" ECU_ADDRESS 0x3F9820 /end MEASUREMENT
/begin MEASUREMENT ausgh_c_ur "Doppelablage (DA) f¸r AUSGH_C_UM" UBYTE dez 1 100 0 255 FORMAT "%5.1" ECU_ADDRESS 0x3F9946 /end MEASUREMENT
/begin MEASUREMENT ausg_c_um "Fehlerz‰hler f¸r zyklische RAM-Pr¸fung in der Funktions¸berwachung" UBYTE dezsub1 1 100 1 256 FORMAT "%5.1" ECU_ADDRESS 0x3F9821 /end MEASUREMENT
/begin MEASUREMENT ausg_c_ur "Doppelablage (DA) f¸r AUSG_C_UM" UBYTE dez 1 100 0 255 FORMAT "%5.1" ECU_ADDRESS 0x3F9947 /end MEASUREMENT
/begin MEASUREMENT auszh_c_um "Heilungsz‰hler f¸r Fehler in der zyklischen ROM-Pr¸fung der Funktions¸berwachung" UBYTE t40ms_ub_b10200 1 100 0 10200 FORMAT "%7.1" ECU_ADDRESS 0x3F9822 /end MEASUREMENT
/begin MEASUREMENT auszh_c_ur "Doppelablage (DA) f¸r AUSZH_C_UM" UBYTE dez 1 100 0 255 FORMAT "%5.1" ECU_ADDRESS 0x3F9948 /end MEASUREMENT
/begin MEASUREMENT ausz_c_um "Fehlerz‰hler f¸r zyklische ROM-Pr¸fung in der Funktions¸berwachung" UBYTE dezsub1 1 100 1 256 FORMAT "%5.1" ECU_ADDRESS 0x3F9823 /end MEASUREMENT
/begin MEASUREMENT ausz_c_ur "Doppelablage (DA) f¸r AUSZ_C_UM" UBYTE dez 1 100 0 255 FORMAT "%5.1" ECU_ADDRESS 0x3F9949 /end MEASUREMENT
/begin MEASUREMENT avvtloc_1 "" UBYTE B_TRUE 1 100 0 1 FORMAT "%13.11" ECU_ADDRESS 0x4037BD /end MEASUREMENT
/begin MEASUREMENT bfzglf "Fahrzeugl‰ngsbeschleunigung gefiltert" SBYTE bfzg_sb_q0p217 1 100 -27.776 27.559 FORMAT "%5.2" ECU_ADDRESS 0x4030E8 /end MEASUREMENT
/begin MEASUREMENT BsdControl "" UBYTE default 1 100 0 255 FORMAT "%5.1" ECU_ADDRESS 0x4034BA /end MEASUREMENT
/begin MEASUREMENT BsdData "" UBYTE default 1 100 0 255 FORMAT "%5.1" ECU_ADDRESS 0x4034BB /end MEASUREMENT
/begin MEASUREMENT BsdRegAdr "3Byte Schnittstelle f¸r kt_ibs" UBYTE default 1 100 0 255 FORMAT "%5.1" ECU_ADDRESS 0x4034BC /end MEASUREMENT
/begin MEASUREMENT bz_egsa_um "Botschaftsz‰hler (alter Wert) der EGS-CAN-Botschaft in der ‹berwachung" UBYTE dez 1 100 0 255 FORMAT "%5.1" ECU_ADDRESS 0x3F98F2 /end MEASUREMENT
/begin MEASUREMENT bz_egsa_ur "Doppelablage (DA) f¸r BZ_EGSA_UM" UBYTE dez 1 100 0 255 FORMAT "%5.1" ECU_ADDRESS 0x3F99D1 /end MEASUREMENT
/begin MEASUREMENT B_1stugen "Bedingung ctrgenutar noch nicht gueltig" UBYTE B_TRUE 1 100 0 1 FORMAT "%13.11" ECU_ADDRESS 0x4034A4 /end MEASUREMENT
/begin MEASUREMENT B_accmx_um "" UBYTE B_TRUE 1 100 0 1 BIT_MASK 0x1 FORMAT "%13.11" ECU_ADDRESS 0x3F9886 /end MEASUREMENT
/begin MEASUREMENT B_accpc_um "" UBYTE B_TRUE 1 100 0 1 BIT_MASK 0x8 FORMAT "%13.11" ECU_ADDRESS 0x3F9886 /end MEASUREMENT
/begin MEASUREMENT B_adcc_um "Bedingung ADC-Test aktiv" UBYTE B_TRUE 1 100 0 1 BIT_MASK 0x1 FORMAT "%13.11" ECU_ADDRESS 0x3F981A /end MEASUREMENT
/begin MEASUREMENT B_admtll "Bedingung DDMTL-Automat laeuft" UBYTE B_TRUE 1 100 0 1 BIT_MASK 0x1 FORMAT "%13.11" ECU_ADDRESS 0x3FE325 /end MEASUREMENT
/begin MEASUREMENT B_admtmv "Bedingung DMTL-Magnetventil an" UBYTE B_TRUE 1 100 0 1 BIT_MASK 0x2 FORMAT "%13.11" ECU_ADDRESS 0x3FE325 /end MEASUREMENT
/begin MEASUREMENT B_admtpm "Bedingung DMTL-Pumpenmotor an" UBYTE B_TRUE 1 100 0 1 BIT_MASK 0x4 FORMAT "%13.11" ECU_ADDRESS 0x3FE325 /end MEASUREMENT
/begin MEASUREMENT B_anlern "Bedingung Anschlaege lernen aufgrund Betriebszeit Bank1" UBYTE B_TRUE 1 100 0 1 FORMAT "%13.11" ECU_ADDRESS 0x4037B3 /end MEASUREMENT
/begin MEASUREMENT B_anlern2 "Bedingung Anschlaege lernen aufgrund Betriebszeit Bank2" UBYTE B_TRUE 1 100 0 1 FORMAT "%13.11" ECU_ADDRESS 0x4037B4 /end MEASUREMENT
/begin MEASUREMENT B_an_ok "Bedingung Anschlaege gelernt Bank1" UBYTE B_TRUE 1 100 0 1 FORMAT "%13.11" ECU_ADDRESS 0x4037B5 /end MEASUREMENT
/begin MEASUREMENT B_an_ok2 "Bedingung Anschlaege gelernt Bank2" UBYTE B_TRUE 1 100 0 1 FORMAT "%13.11" ECU_ADDRESS 0x4037B6 /end MEASUREMENT
/begin MEASUREMENT B_ausc_act "Bedingung f¸r Abschaltpfadtest aktiv" UBYTE B_TRUE 1 100 0 1 BIT_MASK 0x1 FORMAT "%13.11" ECU_ADDRESS 0x3FBED3 /end MEASUREMENT
/begin MEASUREMENT B_ausc_um "Bedingung f¸r Abschaltpfadtest abgeschlossen in der Funktions¸berwachung" UBYTE B_TRUE 1 100 0 1 BIT_MASK 0x1 FORMAT "%13.11" ECU_ADDRESS 0x3FBED4 /end MEASUREMENT
/begin MEASUREMENT B_ausc_wda "Bedingung Abschaltpfadtest aktiv f¸r WDA-Flankenauswertung" UBYTE B_TRUE 1 100 0 1 BIT_MASK 0x1 FORMAT "%13.11" ECU_ADDRESS 0x3FBED5 /end MEASUREMENT
/begin MEASUREMENT B_auswrt "" UBYTE B_TRUE 1 100 0 1 BIT_MASK 0x2 FORMAT "%13.11" ECU_ADDRESS 0x3FE93A /end MEASUREMENT
/begin MEASUREMENT B_blspc_um "" UBYTE B_TRUE 1 100 0 1 BIT_MASK 0x40 FORMAT "%13.11" ECU_ADDRESS 0x3F9886 /end MEASUREMENT
/begin MEASUREMENT B_brems_um "Bedingung Bremse getreten f¸r die Funktions¸berwachung" UBYTE B_TRUE 1 100 0 1 BIT_MASK 0x1 FORMAT "%13.11" ECU_ADDRESS 0x3F9889 /end MEASUREMENT
/begin MEASUREMENT B_brfgr_um "Bedingung Bremse getreten f¸r die Funktions¸berwachung" UBYTE B_TRUE 1 100 0 1 BIT_MASK 0x2 FORMAT "%13.11" ECU_ADDRESS 0x3F9889 /end MEASUREMENT
/begin MEASUREMENT B_bsl_um "erkannter Low-Pegel am FGR-Bedienhebelschalter Beschleunigen in Funktions¸berw." UBYTE B_TRUE 1 100 0 1 BIT_MASK 0x2 FORMAT "%13.11" ECU_ADDRESS 0x3F988A /end MEASUREMENT
/begin MEASUREMENT B_dcdis_um "Fehlerreaktions-Info der Funktions¸berwachung (Abschaltung der DK-Steller-ES)" UBYTE B_TRUE 1 100 0 1 BIT_MASK 0x1 FORMAT "%13.11" ECU_ADDRESS 0x3F9888 /end MEASUREMENT
/begin MEASUREMENT B_dmteol "Bedingung: DM-TL Bandendetest" UBYTE B_TRUE 1 100 0 1 BIT_MASK 0x1 FORMAT "%13.11" ECU_ADDRESS 0x3FE327 /end MEASUREMENT
/begin MEASUREMENT B_dmter "Bedingung DM-TL Fehler wegen Stromhub" UBYTE B_TRUE 1 100 0 1 BIT_MASK 0x2 FORMAT "%13.11" ECU_ADDRESS 0x3FE327 /end MEASUREMENT
/begin MEASUREMENT B_dmterft "Bedingung DM-TL Fehler wegen Stromhub im Feld-Test" UBYTE B_TRUE 1 100 0 1 BIT_MASK 0x4 FORMAT "%13.11" ECU_ADDRESS 0x3FE327 /end MEASUREMENT
/begin MEASUREMENT B_dmtexte "Bedinung" UBYTE B_TRUE 1 100 0 1 BIT_MASK 0x1 FORMAT "%13.11" ECU_ADDRESS 0x40368C /end MEASUREMENT
/begin MEASUREMENT B_dmtge "Bedingung Freigabe Grobleckmessung" UBYTE B_TRUE 1 100 0 1 BIT_MASK 0x10 FORMAT "%13.11" ECU_ADDRESS 0x3FE325 /end MEASUREMENT
/begin MEASUREMENT B_dmtglm "Bedingung Grobleckmessung aktiv" UBYTE B_TRUE 1 100 0 1 BIT_MASK 0x40 FORMAT "%13.11" ECU_ADDRESS 0x3FE325 /end MEASUREMENT
/begin MEASUREMENT B_dmtglmv "Bedingung Verl‰ngerung Grobleckmessung" UBYTE B_TRUE 1 100 0 1 BIT_MASK 0x20 FORMAT "%13.11" ECU_ADDRESS 0x3FE325 /end MEASUREMENT
/begin MEASUREMENT B_dmtgv "Tankentl¸ftungssystem Verdacht Grobleck" UBYTE B_TRUE 1 100 0 1 BIT_MASK 0x80 FORMAT "%13.11" ECU_ADDRESS 0x3FE325 /end MEASUREMENT
/begin MEASUREMENT B_dmtke "Bedingung Freigabe Kleinstleckmessung" UBYTE B_TRUE 1 100 0 1 BIT_MASK 0x1 FORMAT "%13.11" ECU_ADDRESS 0x40368B /end MEASUREMENT
/begin MEASUREMENT B_dmtklm "Bedingung Kleinstleckmessung aktiv" UBYTE B_TRUE 1 100 0 1 BIT_MASK 0x2 FORMAT "%13.11" ECU_ADDRESS 0x3FE326 /end MEASUREMENT
/begin MEASUREMENT B_dmtlpe "Pr¸fung Komponente auf Pumpstromschwellen g¸ltig" UBYTE B_TRUE 1 100 0 1 BIT_MASK 0x2 FORMAT "%13.11" ECU_ADDRESS 0x40368B /end MEASUREMENT
/begin MEASUREMENT B_dmtnge "Bedingung Freigabe nur Grobleckmessung" UBYTE B_TRUE 1 100 0 1 BIT_MASK 0x4 FORMAT "%13.11" ECU_ADDRESS 0x40368B /end MEASUREMENT
/begin MEASUREMENT B_dmtrest "Bedingung DMTL Neustart" UBYTE B_TRUE 1 100 0 1 BIT_MASK 0x8 FORMAT "%13.11" ECU_ADDRESS 0x3FE327 /end MEASUREMENT
/begin MEASUREMENT B_dmtrfm "Bedingung Referenzleckmessung aktiv" UBYTE B_TRUE 1 100 0 1 BIT_MASK 0x10 FORMAT "%13.11" ECU_ADDRESS 0x3FE326 /end MEASUREMENT
/begin MEASUREMENT B_eculock "Verriegelungsanforderung Wegfahrsperre" UBYTE B_TRUE 1 100 0 1 BIT_MASK 0x1 FORMAT "%13.11" ECU_ADDRESS 0x3FC365 /end MEASUREMENT
/begin MEASUREMENT B_edmtk "Tankentl¸ftungssystem Kleinstleck" UBYTE B_TRUE 1 100 0 1 BIT_MASK 0x20 FORMAT "%13.11" ECU_ADDRESS 0x3FE326 /end MEASUREMENT
/begin MEASUREMENT B_eep2err "" UBYTE B_TRUE 1 100 0 1 BIT_MASK 0x1 FORMAT "%13.11" ECU_ADDRESS 0x3FC366 /end MEASUREMENT
/begin MEASUREMENT B_eeperr "" UBYTE B_TRUE 1 100 0 1 BIT_MASK 0x1 FORMAT "%13.11" ECU_ADDRESS 0x3FC367 /end MEASUREMENT
/begin MEASUREMENT B_eolref "Bedingung: nur eine Referenzmessung w‰hrend BE-Test" UBYTE B_TRUE 1 100 0 1 BIT_MASK 0x2 FORMAT "%13.11" ECU_ADDRESS 0x40368C /end MEASUREMENT
/begin MEASUREMENT B_fgrea_um "FGR-/ACC-Einschaltung g¸ltig in der Funktions¸berwachung, zeitverzˆgert" UBYTE B_TRUE 1 100 0 1 BIT_MASK 0x80 FORMAT "%13.11" ECU_ADDRESS 0x3F988A /end MEASUREMENT
/begin MEASUREMENT B_fgrpc_um "" UBYTE B_TRUE 1 100 0 1 BIT_MASK 0x80 FORMAT "%13.11" ECU_ADDRESS 0x3F9886 /end MEASUREMENT
/begin MEASUREMENT B_fgr_umc "" UBYTE B_TRUE 1 100 0 1 BIT_MASK 0x2 FORMAT "%13.11" ECU_ADDRESS 0x3F988B /end MEASUREMENT
/begin MEASUREMENT b_flags_um "Flag f¸r Bitinformationen in der Funktions¸berwachung" UBYTE dez 1 100 0 255 FORMAT "%5.1" ECU_ADDRESS 0x3F9885 /end MEASUREMENT
/begin MEASUREMENT B_genoff "Bedingung Generator ausgeschaltet" UBYTE B_TRUE 1 100 0 1 FORMAT "%13.11" ECU_ADDRESS 0x403802 /end MEASUREMENT
/begin MEASUREMENT B_genoff2 "Bedingung Generator AUS" UBYTE B_TRUE 1 100 0 1 FORMAT "%13.11" ECU_ADDRESS 0x403803 /end MEASUREMENT
/begin MEASUREMENT B_genoffmd "Bedingung Generatus-off-Anforderung" UBYTE B_TRUE 1 100 0 1 FORMAT "%13.11" ECU_ADDRESS 0x403804 /end MEASUREMENT
/begin MEASUREMENT B_genoffok "Bedingung Generatorabschaltfreigabe Sicherheitstimer" UBYTE B_TRUE 1 100 0 1 FORMAT "%13.11" ECU_ADDRESS 0x403805 /end MEASUREMENT
/begin MEASUREMENT B_gentoggl "Bedindung Toggel Generatorauswahl" UBYTE B_TRUE 1 100 0 1 FORMAT "%13.11" ECU_ADDRESS 0x3FE27E /end MEASUREMENT
/begin MEASUREMENT B_ibsactiv "" UBYTE B_TRUE 1 100 0 1 BIT_MASK 0x1 FORMAT "%13.11" ECU_ADDRESS 0x4034B2 /end MEASUREMENT
/begin MEASUREMENT B_inistw "" UBYTE B_TRUE 1 100 0 1 BIT_MASK 0x1 FORMAT "%13.11" ECU_ADDRESS 0x3FC368 /end MEASUREMENT
/begin MEASUREMENT B_i_ska "Funktions-Fehlerreaktion irreversible SKA (Sicherheits-Kraftstoffabschaltung)" UBYTE B_TRUE 1 100 0 1 BIT_MASK 0x4 FORMAT "%13.11" ECU_ADDRESS 0x3F9888 /end MEASUREMENT
/begin MEASUREMENT B_i_ska_um "Fehlerreaktion irrev. SKA (Sicherheitskraftstoffabschaltung) aus Fkt-‹berwachung" UBYTE B_TRUE 1 100 0 1 BIT_MASK 0x1 FORMAT "%13.11" ECU_ADDRESS 0x3F9884 /end MEASUREMENT
/begin MEASUREMENT B_khls_um "" UBYTE B_TRUE 1 100 0 1 BIT_MASK 0x20 FORMAT "%13.11" ECU_ADDRESS 0x3F9885 /end MEASUREMENT
/begin MEASUREMENT B_kkl_um "erkannter Low-Pegel am FGR-Bedienhebelschalter Kontrollkontakt in Funktions¸berw" UBYTE B_TRUE 1 100 0 1 BIT_MASK 0x8 FORMAT "%13.11" ECU_ADDRESS 0x3F988A /end MEASUREMENT
/begin MEASUREMENT B_klmzu_um "Bedingung  KLMZUMN wird im Tempomatbetrieb ber¸cksichtigt" UBYTE B_TRUE 1 100 0 1 BIT_MASK 0x1 FORMAT "%13.11" ECU_ADDRESS 0x3F9910 /end MEASUREMENT
/begin MEASUREMENT B_kwperr "" UBYTE B_TRUE 1 100 0 1 BIT_MASK 0x1 FORMAT "%13.11" ECU_ADDRESS 0x3FC369 /end MEASUREMENT
/begin MEASUREMENT B_mdegs_um "Bedingung Momentenanforderung EGS ¸ber CAN" UBYTE B_TRUE 1 100 0 1 BIT_MASK 0x1 FORMAT "%13.11" ECU_ADDRESS 0x3F98ED /end MEASUREMENT
/begin MEASUREMENT B_motor "" UBYTE B_TRUE 1 100 0 1 BIT_MASK 0x20 FORMAT "%13.11" ECU_ADDRESS 0x3FE93A /end MEASUREMENT
/begin MEASUREMENT B_msrmx_um "Bedingung MSR MAX-Eingriff in der Funktions¸berwachung" UBYTE B_TRUE 1 100 0 1 BIT_MASK 0x2 FORMAT "%13.11" ECU_ADDRESS 0x3F9886 /end MEASUREMENT
/begin MEASUREMENT B_msrpc_um "" UBYTE B_TRUE 1 100 0 1 BIT_MASK 0x10 FORMAT "%13.11" ECU_ADDRESS 0x3F9886 /end MEASUREMENT
/begin MEASUREMENT B_msthw_um "Bedingung Master-SG gem‰ﬂ Codier-Pin f¸r die Funktions¸berwachung" UBYTE B_TRUE 1 100 0 1 BIT_MASK 0x80 FORMAT "%13.11" ECU_ADDRESS 0x3F988B /end MEASUREMENT
/begin MEASUREMENT B_mzns_um "Nachstartaufweitung des zul‰sigen Moments in der Funktons¸berwachung aktiv" UBYTE B_TRUE 1 100 0 1 BIT_MASK 0x1 FORMAT "%13.11" ECU_ADDRESS 0x3F9924 /end MEASUREMENT
/begin MEASUREMENT B_naccf_um "" UBYTE B_TRUE 1 100 0 1 BIT_MASK 0x40 FORMAT "%13.11" ECU_ADDRESS 0x3F988A /end MEASUREMENT
/begin MEASUREMENT B_nachlter "Bedingung Z¸ndung ein erkannt bei BE-Test im Nachlauf" UBYTE B_TRUE 1 100 0 1 BIT_MASK 0x8 FORMAT "%13.11" ECU_ADDRESS 0x40368C /end MEASUREMENT
/begin MEASUREMENT B_newqr_um "Bedingung f¸r neue Frage vom UM empfangen in der Funktions¸berwachung" UBYTE B_TRUE 1 100 0 1 BIT_MASK 0x1 FORMAT "%13.11" ECU_ADDRESS 0x3FBED7 /end MEASUREMENT
/begin MEASUREMENT B_nlhr_um "" UBYTE B_TRUE 1 100 0 1 BIT_MASK 0x40 FORMAT "%13.11" ECU_ADDRESS 0x3F9885 /end MEASUREMENT
/begin MEASUREMENT B_nlh_um "Anforderung Notlauf  mit Lambda 1 aus Funktions¸berwachung" UBYTE B_TRUE 1 100 0 1 BIT_MASK 0x1 FORMAT "%13.11" ECU_ADDRESS 0x3F9885 /end MEASUREMENT
/begin MEASUREMENT B_noctrgen "Bedingung Ladespannungvorgabe ignoriert" UBYTE B_TRUE 1 100 0 1 FORMAT "%13.11" ECU_ADDRESS 0x4034A5 /end MEASUREMENT
/begin MEASUREMENT B_nosgs_um "SGS-Momentenvorgabe in der Funktions¸berwachung nicht ¸bernommen" UBYTE B_TRUE 1 100 0 1 BIT_MASK 0x1 FORMAT "%13.11" ECU_ADDRESS 0x3F98EE /end MEASUREMENT
/begin MEASUREMENT B_notlu "Anforderung Notluftfahren aus der Funktion" UBYTE B_TRUE 1 100 0 1 BIT_MASK 0x8 FORMAT "%13.11" ECU_ADDRESS 0x3F9888 /end MEASUREMENT
/begin MEASUREMENT B_npegs_um "Bedingung EGS-SG Checksumme fehlerhaft" UBYTE B_TRUE 1 100 0 1 BIT_MASK 0x1 FORMAT "%13.11" ECU_ADDRESS 0x3F98EF /end MEASUREMENT
/begin MEASUREMENT B_nsakt_um "Nachstart aktiv f¸r die Fkt.-‹berwachung" UBYTE B_TRUE 1 100 0 1 BIT_MASK 0x4 FORMAT "%13.11" ECU_ADDRESS 0x3F9887 /end MEASUREMENT
/begin MEASUREMENT B_nsend_um "Nachstart¸berwachungszeit abgelaufen f¸r die Fkt.-‹berwachung" UBYTE B_TRUE 1 100 0 1 BIT_MASK 0x1 FORMAT "%13.11" ECU_ADDRESS 0x3F9887 /end MEASUREMENT
/begin MEASUREMENT B_nxptr_um "" UBYTE B_TRUE 1 100 0 1 BIT_MASK 0x1 FORMAT "%13.11" ECU_ADDRESS 0x3FBED6 /end MEASUREMENT
/begin MEASUREMENT B_nxtrp_um "Bedingung f¸r n‰chste Antwort korrekt an das UM ausgeben in der F‹" UBYTE B_TRUE 1 100 0 1 BIT_MASK 0x1 FORMAT "%13.11" ECU_ADDRESS 0x3FBED8 /end MEASUREMENT
/begin MEASUREMENT B_pddssmn "Bedingung Drucksensor hat untere Schwelle unterschritten" UBYTE B_TRUE 1 100 0 1 BIT_MASK 0x1 FORMAT "%13.11" ECU_ADDRESS 0x3FC079 /end MEASUREMENT
/begin MEASUREMENT B_pddssmx "Bedingung Drucksensor hat obere Schwelle ¸berschritten" UBYTE B_TRUE 1 100 0 1 BIT_MASK 0x1 FORMAT "%13.11" ECU_ADDRESS 0x3FC07A /end MEASUREMENT
/begin MEASUREMENT B_ptyerr "" UBYTE B_TRUE 1 100 0 1 BIT_MASK 0x1 FORMAT "%13.11" ECU_ADDRESS 0x3FC36A /end MEASUREMENT
/begin MEASUREMENT B_pwgnotum "= b_pwgnot_um Funktions¸berwachungs-Fehlerreaktion PWG-Leerlauf (= b_pwgnot_sr)" UBYTE B_TRUE 1 100 0 1 BIT_MASK 0x1 FORMAT "%13.11" ECU_ADDRESS 0x3F987C /end MEASUREMENT
/begin MEASUREMENT B_ramerr "" UBYTE B_TRUE 1 100 0 1 BIT_MASK 0x1 FORMAT "%13.11" ECU_ADDRESS 0x3FC36B /end MEASUREMENT
/begin MEASUREMENT B_reaci_um "" UBYTE B_TRUE 1 100 0 1 BIT_MASK 0x10 FORMAT "%13.11" ECU_ADDRESS 0x3F9888 /end MEASUREMENT
/begin MEASUREMENT B_read_active "" UBYTE B_TRUE 1 100 0 1 BIT_MASK 0x1 FORMAT "%13.11" ECU_ADDRESS 0x3FC36C /end MEASUREMENT
/begin MEASUREMENT B_recerr "" UBYTE B_TRUE 1 100 0 1 BIT_MASK 0x1 FORMAT "%13.11" ECU_ADDRESS 0x3FC36D /end MEASUREMENT
/begin MEASUREMENT B_refo "obere Schwelle Pumpstrom w‰hrend Referenzmessung erreicht" UBYTE B_TRUE 1 100 0 1 BIT_MASK 0x40 FORMAT "%13.11" ECU_ADDRESS 0x3FE326 /end MEASUREMENT
/begin MEASUREMENT B_refu "untere Schwelle Pumpstrom w‰hrend Referenzmessung erreicht" UBYTE B_TRUE 1 100 0 1 BIT_MASK 0x80 FORMAT "%13.11" ECU_ADDRESS 0x3FE326 /end MEASUREMENT
/begin MEASUREMENT B_resstw "" UBYTE B_TRUE 1 100 0 1 BIT_MASK 0x1 FORMAT "%13.11" ECU_ADDRESS 0x3FC36E /end MEASUREMENT
/begin MEASUREMENT B_rldif_um "Bedingung Last¸berwachung erkennt Fehler" UBYTE B_TRUE 1 100 0 1 BIT_MASK 0x1 FORMAT "%13.11" ECU_ADDRESS 0x3F9834 /end MEASUREMENT
/begin MEASUREMENT B_rlini_um "" UBYTE B_TRUE 1 100 0 1 BIT_MASK 0x2 FORMAT "%13.11" ECU_ADDRESS 0x3F9885 /end MEASUREMENT
/begin MEASUREMENT B_rluf_um "" UBYTE B_TRUE 1 100 0 1 BIT_MASK 0x4 FORMAT "%13.11" ECU_ADDRESS 0x3F9885 /end MEASUREMENT
/begin MEASUREMENT B_sgsmx_um "" UBYTE B_TRUE 1 100 0 1 BIT_MASK 0x4 FORMAT "%13.11" ECU_ADDRESS 0x3F9886 /end MEASUREMENT
/begin MEASUREMENT B_sgspc_um "" UBYTE B_TRUE 1 100 0 1 BIT_MASK 0x20 FORMAT "%13.11" ECU_ADDRESS 0x3F9886 /end MEASUREMENT
/begin MEASUREMENT B_siegs_um "Bedingung EGS-SG Alivecounter wird nicht korrekt inkrement. bzw. bleibt stehen" UBYTE B_TRUE 1 100 0 1 BIT_MASK 0x1 FORMAT "%13.11" ECU_ADDRESS 0x3F98F0 /end MEASUREMENT
/begin MEASUREMENT B_srstz_um "Software-Reset-Anforderung aus der zyklischen ROM-Absicherung der Fkt-‹berwach." UBYTE B_TRUE 1 100 0 1 BIT_MASK 0x80 FORMAT "%13.11" ECU_ADDRESS 0x3F9888 /end MEASUREMENT
/begin MEASUREMENT B_srst_um "Software-Reset-Anforderung aus der zyklischen RAM-Absicherung der Fkt-‹berwach." UBYTE B_TRUE 1 100 0 1 BIT_MASK 0x40 FORMAT "%13.11" ECU_ADDRESS 0x3F9888 /end MEASUREMENT
/begin MEASUREMENT B_sumv "Pumpenstrom-Schwelle bei DM-TL Ventilpruefung erreicht" UBYTE B_TRUE 1 100 0 1 BIT_MASK 0x8 FORMAT "%13.11" ECU_ADDRESS 0x3FE325 /end MEASUREMENT
/begin MEASUREMENT B_timerr "" UBYTE B_TRUE 1 100 0 1 BIT_MASK 0x1 FORMAT "%13.11" ECU_ADDRESS 0x3FC36F /end MEASUREMENT
/begin MEASUREMENT B_tpu_um "" UBYTE B_TRUE 1 100 0 1 BIT_MASK 0x20 FORMAT "%13.11" ECU_ADDRESS 0x3F9888 /end MEASUREMENT
/begin MEASUREMENT B_trigin "" UBYTE dez 1 100 0 255 FORMAT "%5.1" ECU_ADDRESS 0x403700 /end MEASUREMENT
/begin MEASUREMENT B_trigout "" UBYTE dez 1 100 0 255 FORMAT "%5.1" ECU_ADDRESS 0x403701 /end MEASUREMENT
/begin MEASUREMENT B_txdmtrf "Bedingung: Zeitdauer f¸r erste Referenzmessung erreicht" UBYTE B_TRUE 1 100 0 1 BIT_MASK 0x10 FORMAT "%13.11" ECU_ADDRESS 0x3FE327 /end MEASUREMENT
/begin MEASUREMENT B_txdmtrf2 "Bedingung: Zeitdauer f¸r zweite Referenzmessung erreicht" UBYTE B_TRUE 1 100 0 1 BIT_MASK 0x20 FORMAT "%13.11" ECU_ADDRESS 0x3FE327 /end MEASUREMENT
/begin MEASUREMENT B_txdmtrfm "Bedingung: Mindestzeit f¸r Pumpstrom-Minimumerkennung erreicht" UBYTE B_TRUE 1 100 0 1 BIT_MASK 0x40 FORMAT "%13.11" ECU_ADDRESS 0x3FE327 /end MEASUREMENT
/begin MEASUREMENT B_ub_ska "Batteriespannung nicht o.k., Unterspannungsabschaltung aktiv" UBYTE B_TRUE 1 100 0 1 BIT_MASK 0x2 FORMAT "%13.11" ECU_ADDRESS 0x3F9888 /end MEASUREMENT
/begin MEASUREMENT B_ufolv_um "" UBYTE B_TRUE 1 100 0 1 BIT_MASK 0x10 FORMAT "%13.11" ECU_ADDRESS 0x3F9885 /end MEASUREMENT
/begin MEASUREMENT B_ufol_um "" UBYTE B_TRUE 1 100 0 1 BIT_MASK 0x8 FORMAT "%13.11" ECU_ADDRESS 0x3F9885 /end MEASUREMENT
/begin MEASUREMENT B_verb_off "" UBYTE B_TRUE 1 100 0 1 FORMAT "%13.11" ECU_ADDRESS 0x4034A6 /end MEASUREMENT
/begin MEASUREMENT B_vmax "Bedingung VMAX-Regelung aktiv" UBYTE dez 1 100 0 1 BIT_MASK 0x1 FORMAT "%5.3" ECU_ADDRESS 0x3FC275 /end MEASUREMENT
/begin MEASUREMENT B_vmaxt "Flag VMAX-Begrenzung aktiv (temp)" UBYTE dez 1 100 0 1 BIT_MASK 0x1 FORMAT "%5.3" ECU_ADDRESS 0x3FC276 /end MEASUREMENT
/begin MEASUREMENT B_vvtchkde "Bedingung VVT-Anschlaglernen verzoegert" UBYTE B_TRUE 1 100 0 1 FORMAT "%13.11" ECU_ADDRESS 0x4037B7 /end MEASUREMENT
/begin MEASUREMENT B_vvtchkn "Bedingung Nullhub verifizieren" UBYTE B_TRUE 1 100 0 1 FORMAT "%13.11" ECU_ADDRESS 0x402D36 /end MEASUREMENT
/begin MEASUREMENT B_vvtchkoa "" UBYTE B_TRUE 1 100 0 1 FORMAT "%13.11" ECU_ADDRESS 0x402D37 /end MEASUREMENT
/begin MEASUREMENT B_vvtchkt "Bedingung Temp nmin" UBYTE B_TRUE 1 100 0 1 FORMAT "%13.11" ECU_ADDRESS 0x4037B8 /end MEASUREMENT
/begin MEASUREMENT B_vvtnhat "Bedingung Motor lief fuer Anschlagtest" UBYTE B_TRUE 1 100 0 1 FORMAT "%13.11" ECU_ADDRESS 0x4037B9 /end MEASUREMENT
/begin MEASUREMENT B_vvtno_an "Bedingung VVT-Notlauf aufgrund zu groﬂer Differenz zur Abstellposition" UBYTE B_TRUE 1 100 0 1 FORMAT "%13.11" ECU_ADDRESS 0x4037BA /end MEASUREMENT
/begin MEASUREMENT B_vvtpwr "Bedingung VVT Bestromung ein" UBYTE B_TRUE 1 100 0 1 FORMAT "%13.11" ECU_ADDRESS 0x4037BB /end MEASUREMENT
/begin MEASUREMENT B_vvtpwral "Bedingung Endstufe einschalten fuer Anschlaglernen" UBYTE B_TRUE 1 100 0 1 FORMAT "%13.11" ECU_ADDRESS 0x4037BC /end MEASUREMENT
/begin MEASUREMENT B_vzl_um "erkannter Low-Pegel am FGR-Bedienhebelschalter Verzˆgern in der Funktions¸berw." UBYTE B_TRUE 1 100 0 1 BIT_MASK 0x1 FORMAT "%13.11" ECU_ADDRESS 0x3F988A /end MEASUREMENT
/begin MEASUREMENT B_wal_um "erkannter Low-Pegel am FGR-Bedienhebelschalter Wiederaufnahme in Funktions¸berw." UBYTE B_TRUE 1 100 0 1 BIT_MASK 0x4 FORMAT "%13.11" ECU_ADDRESS 0x3F988A /end MEASUREMENT
/begin MEASUREMENT B_wcerr "" UBYTE B_TRUE 1 100 0 1 BIT_MASK 0x1 FORMAT "%13.11" ECU_ADDRESS 0x3FC370 /end MEASUREMENT
/begin MEASUREMENT B_wc_exa "" UBYTE B_TRUE 1 100 0 1 BIT_MASK 0x8 FORMAT "%13.11" ECU_ADDRESS 0x3FE93A /end MEASUREMENT
/begin MEASUREMENT B_wc_exn "" UBYTE B_TRUE 1 100 0 1 BIT_MASK 0x4 FORMAT "%13.11" ECU_ADDRESS 0x3FE93A /end MEASUREMENT
/begin MEASUREMENT B_write_active "" UBYTE B_TRUE 1 100 0 1 BIT_MASK 0x1 FORMAT "%13.11" ECU_ADDRESS 0x3FC371 /end MEASUREMENT
/begin MEASUREMENT B_wuerg "" UBYTE B_TRUE 1 100 0 1 BIT_MASK 0x10 FORMAT "%13.11" ECU_ADDRESS 0x3FE93A /end MEASUREMENT
/begin MEASUREMENT B_zdmtgv "Zyklusflag: Tankentl¸ftungssystem Grobleckverdacht" UBYTE B_TRUE 1 100 0 1 BIT_MASK 0x1 FORMAT "%13.11" ECU_ADDRESS 0x3FE326 /end MEASUREMENT
/begin MEASUREMENT B_zdmtk "Zyklusflag: Tankentl¸ftungssystem Kleinstleck" UBYTE B_TRUE 1 100 0 1 BIT_MASK 0x8 FORMAT "%13.11" ECU_ADDRESS 0x3FE326 /end MEASUREMENT
/begin MEASUREMENT B_zndaus "Bedingung Z¸ndungsausblendung aktiv" UBYTE B_TRUE 1 100 0 1 BIT_MASK 0x1 FORMAT "%13.11" ECU_ADDRESS 0x3FC375 /end MEASUREMENT
/begin MEASUREMENT B_zwdyn "Bed. Dynamik f¸r Modul ZWGRUND" UBYTE dez 1 100 0 255 FORMAT "%5.1" ECU_ADDRESS 0x403702 /end MEASUREMENT
/begin MEASUREMENT B_zwkra "Bedingung: Z¸ndwinkel der KR wird ausgegeben" UBYTE B_TRUE 1 100 0 1 BIT_MASK 0x1 FORMAT "%13.11" ECU_ADDRESS 0x3FC376 /end MEASUREMENT
/begin MEASUREMENT B_zwmnste "Bedingung Abregelung der Z¸ndwinkelsp‰tbegrenzung erf¸llt" UBYTE B_TRUE 1 100 0 1 BIT_MASK 0x1 FORMAT "%13.11" ECU_ADDRESS 0x3FC378 /end MEASUREMENT
/begin MEASUREMENT B_zwms "Bedingung Motorschutz-Z¸ndwinkelbegrenzung" UBYTE B_TRUE 1 100 0 1 BIT_MASK 0x1 FORMAT "%13.11" ECU_ADDRESS 0x3FC379 /end MEASUREMENT
/begin MEASUREMENT B_zwspae "Bedingung: Z¸ndwinkel zwspae bei Schubabschaltung wird ausgegeben" UBYTE B_TRUE 1 100 0 1 BIT_MASK 0x1 FORMAT "%13.11" ECU_ADDRESS 0x3FC377 /end MEASUREMENT
/begin MEASUREMENT c720alt_um "Zahnz‰hler720∞ des vorhergehenden Berechnungszeitpunkts im 10ms-Raster" UBYTE dez 1 100 0 255 FORMAT "%5.1" ECU_ADDRESS 0x3F9828 /end MEASUREMENT
/begin MEASUREMENT c720alt_ur "Doppelablage (DA) f¸r C720ALT_UM" UBYTE dez 1 100 0 255 FORMAT "%5.1" ECU_ADDRESS 0x3F994C /end MEASUREMENT
/begin MEASUREMENT can_id_um "Botschafts-Identifier" UBYTE dez 1 100 0 255 FORMAT "%5.1" ECU_ADDRESS 0x3FA3C6 /end MEASUREMENT
/begin MEASUREMENT c_flags_um "Flag f¸r CAN-Informationen in der Funktions¸berwachung" UBYTE dez 1 100 0 255 FORMAT "%5.1" ECU_ADDRESS 0x3F9886 /end MEASUREMENT
/begin MEASUREMENT dbegs_c_um "Fehlerz‰hler: Botschaftsabsicherung EGS-Botschaft (Alive)" UBYTE t10ms_ub_b2550 1 100 0 2550 ECU_ADDRESS 0x3F98F3 /end MEASUREMENT
/begin MEASUREMENT dbegs_c_ur "Doppelablage (DA) f¸r DBEGS_C_UM" UBYTE dez 1 100 0 255 FORMAT "%5.1" ECU_ADDRESS 0x3F99D2 /end MEASUREMENT
/begin MEASUREMENT ddpskl "Unsigned Wert f¸r ddps_w f¸r KL-Interpolation" UWORD p_q0p039s32768 1 100 -1280 1279.96 FORMAT "%7.2" ECU_ADDRESS 0x404634 /end MEASUREMENT
/begin MEASUREMENT diptgl_w "Differenz-Pumpenstrom" UWORD i_q6p1035_uA 1 100 0 399.994 FORMAT "%8.4" ECU_ADDRESS 0x3FE2EE /end MEASUREMENT
/begin MEASUREMENT dmtfgvt_w "freies Gasvolumen Kraftstofftank (DMTL)" UWORD vol_q0p1_l 1 100 0 6553.5 FORMAT "%8.3" ECU_ADDRESS 0x3FE2F0 /end MEASUREMENT
/begin MEASUREMENT dmtnrfrf_w "Anzahl wiederholter Referenzmessungen bei Diagnose im Feld" UWORD dez 1 100 0 65535 FORMAT "%8.2" ECU_ADDRESS 0x3FE2F2 /end MEASUREMENT
/begin MEASUREMENT dmtnrfrp_w "Anzahl verbleibender DM-TL-Referenzmessungen" UWORD dez 1 100 0 65535 FORMAT "%8.2" ECU_ADDRESS 0x3FE2F4 /end MEASUREMENT
/begin MEASUREMENT dmtnrfr_w "bei Wiederholung: Anzahl bisher durchgef¸hrter DM-TL-Referenzmessungen" UWORD dez 1 100 0 65535 FORMAT "%8.2" ECU_ADDRESS 0x3FE2F6 /end MEASUREMENT
/begin MEASUREMENT dpipf_l_um "Zul‰ssiger gefilterter Druck (LOW-Byte)" UBYTE p_q0p0195 1 100 0 4.98047 FORMAT "%5.3" ECU_ADDRESS 0x3F983A /end MEASUREMENT
/begin MEASUREMENT dpipf_l_ur "Doppelablage (DA) f¸r DPIPF_I_UM" UBYTE dez 1 100 0 255 FORMAT "%5.1" ECU_ADDRESS 0x3F996C /end MEASUREMENT
/begin MEASUREMENT dpipf_p_um "" UBYTE dez 1 100 0 255 FORMAT "%5.1" ECU_ADDRESS 0x3F983B /end MEASUREMENT
/begin MEASUREMENT dpipf_p_ur "" UBYTE dez 1 100 0 255 FORMAT "%5.1" ECU_ADDRESS 0x3F996D /end MEASUREMENT
/begin MEASUREMENT dpipf_r_um "" UBYTE p_q5 1 100 0 1275 FORMAT "%5.0" ARRAY_SIZE 8 ECU_ADDRESS 0x3F983C /end MEASUREMENT
/begin MEASUREMENT dpipf_r_ur "" UBYTE dez 1 100 0 255 FORMAT "%5.1" ARRAY_SIZE 8 ECU_ADDRESS 0x3F996E /end MEASUREMENT
/begin MEASUREMENT dpipf_um "Zul‰ssiger gefilterter Druck" UBYTE p_q5 1 100 0 1275 FORMAT "%5.0" ECU_ADDRESS 0x3F9844 /end MEASUREMENT
/begin MEASUREMENT dpipf_ur "Doppelablage (DA) f¸r DPIPF_UM" UBYTE dez 1 100 0 255 FORMAT "%5.1" ECU_ADDRESS 0x3F9976 /end MEASUREMENT
/begin MEASUREMENT dpip_um "Zul‰ssiger Druck (aus Istwertpoti und Motordrehzahl)" UBYTE p_q5 1 100 0 1275 FORMAT "%5.0" ECU_ADDRESS 0x3F9977 /end MEASUREMENT
/begin MEASUREMENT dpsdpsad_w "Differenzdruck Saugrohr aus Adaption" SWORD p_q0p039 1 100 -1280 1279.96 FORMAT "%8.3" ECU_ADDRESS 0x404636 /end MEASUREMENT
/begin MEASUREMENT dpsraus_i "Differenzdruck Saugrohr Adaption I-Anteil" UWORD p_q0p039s32768 1 100 -1280 1279.96 FORMAT "%7.2" ECU_ADDRESS 0x404638 /end MEASUREMENT
/begin MEASUREMENT dpsraus_p "Differenzdruck Saugrohr Adaption P-Anteil" UWORD p_q0p039s32768 1 100 -1280 1279.96 FORMAT "%7.2" ECU_ADDRESS 0x40463A /end MEASUREMENT
/begin MEASUREMENT dps_c_um "Entprellz‰hler zur Absicherung der Druckinformation" UBYTE t40ms_ub_b10200 1 100 0 10200 FORMAT "%7.1" ECU_ADDRESS 0x3F9845 /end MEASUREMENT
/begin MEASUREMENT dps_c_ur "Doppelablage (DA) f¸r DPC_C_UM" UBYTE dez 1 100 0 255 FORMAT "%5.1" ECU_ADDRESS 0x3F9978 /end MEASUREMENT
/begin MEASUREMENT dps_um "Druckinformation f¸r die Funktions¸berwachung" UBYTE p_q5 1 100 0 1275 FORMAT "%5.0" ECU_ADDRESS 0x3F9846 /end MEASUREMENT
/begin MEASUREMENT dps_ur "Doppelablage (DA) f¸r DPS_UM" UBYTE dez 1 100 0 255 FORMAT "%5.1" ECU_ADDRESS 0x3F9979 /end MEASUREMENT
/begin MEASUREMENT dvprae_w "Pr‰dizierter Geschwindigkeitsanteil" UWORD vfzg_uw_q0p00781 1 100 0 511.992 FORMAT "%8.4" ECU_ADDRESS 0x4030F0 /end MEASUREMENT
/begin MEASUREMENT dvsi_w "Abweichung zwischen Soll- und Istgeschwindigkeit der VMAX-Regelung" SWORD vfzg_sw_q0p00781 1 100 -256 255.992 FORMAT "%8.4" ECU_ADDRESS 0x4030F2 /end MEASUREMENT
/begin MEASUREMENT dzwks "delta Z¸ndwinkel Klopfschutz" SBYTE zw_sb_q0p75 1 100 -96 95.25 FORMAT "%5.2" ECU_ADDRESS 0x403D44 /end MEASUREMENT
/begin MEASUREMENT dzwmna "Min-Z¸ndwinkel ƒnderungsgeschwindigeit zw. Brenngrenze und Motorschutz" SBYTE zw_sb_q0p75 1 100 -96 95.25 FORMAT "%5.2" ECU_ADDRESS 0x403D46 /end MEASUREMENT
/begin MEASUREMENT dzwspae "Korrektur-Z¸ndwinkel f¸r den sp‰test erlaubten Z¸ndwinkel" SBYTE zw_sb_q0p75 1 100 -96 95.25 FORMAT "%5.2" ECU_ADDRESS 0x403D47 /end MEASUREMENT
/begin MEASUREMENT dzwth "" SBYTE zw_sb_q0p75 1 100 -96 95.25 FORMAT "%5.2" ECU_ADDRESS 0x403D3D /end MEASUREMENT
/begin MEASUREMENT dzwwl "Delta Zuendwinkel aus Warmlauf" SBYTE zw_sb_q0p75 1 100 -96 95.25 FORMAT "%5.2" ECU_ADDRESS 0x403D4E /end MEASUREMENT
/begin MEASUREMENT dzwwlkh "Delta Z¸ndwinkel Katheizen im Warmlauf" SBYTE zw_sb_q0p75 1 100 -96 95.25 FORMAT "%5.2" ECU_ADDRESS 0x403D4F /end MEASUREMENT
/begin MEASUREMENT egsstat_um "EGS-Anforderungs-Status (CAN) aus der Funktions¸berwachung" UBYTE dez 1 100 0 255 FORMAT "%5.1" ECU_ADDRESS 0x3FA3C7 /end MEASUREMENT
/begin MEASUREMENT egstemp_um "EGS-Status Getriebe-‹bertemperatur aus der ‹berwachung" UBYTE dez 1 100 0 255 FORMAT "%5.1" ECU_ADDRESS 0x3FA3C8 /end MEASUREMENT
/begin MEASUREMENT ei_adcc_um "irreversibles Fehlerbit bei der AD-Wandler-‹berwachung" UBYTE B_TRUE 1 100 0 1 BIT_MASK 0x1 FORMAT "%13.11" ECU_ADDRESS 0x3F981B /end MEASUREMENT
/begin MEASUREMENT ei_adcq_um "irreversibles Fehlerbit bei der AD-Wandler-Queue-‹berwachung" UBYTE B_TRUE 1 100 0 1 BIT_MASK 0x1 FORMAT "%13.11" ECU_ADDRESS 0x3F981C /end MEASUREMENT
/begin MEASUREMENT ei_dps_um "irreversibles Fehlerbit aus der Drucksensorplausibilisierung in der Funktions¸be" UBYTE B_TRUE 1 100 0 1 BIT_MASK 0x1 FORMAT "%13.11" ECU_ADDRESS 0x3F9835 /end MEASUREMENT
/begin MEASUREMENT ei_ipa_um "irrev. Fehlerbit f¸r unterer DK-Anschlag im ung¸ltigen Bereich in der Fkt-‹berw." UBYTE B_TRUE 1 100 0 1 BIT_MASK 0x1 FORMAT "%13.11" ECU_ADDRESS 0x3F9836 /end MEASUREMENT
/begin MEASUREMENT ei_nc_um "irreversibles Fehlerbit beim Drehzahlvergleich der Funktions¸berwachung" UBYTE B_TRUE 1 100 0 1 BIT_MASK 0x1 FORMAT "%13.11" ECU_ADDRESS 0x3F991C /end MEASUREMENT
/begin MEASUREMENT ei_reac_um "irreversibles Fehlerbit der Fehlerreaktions¸berwachung der Funktions¸berwachung" UBYTE B_TRUE 1 100 0 1 BIT_MASK 0x1 FORMAT "%13.11" ECU_ADDRESS 0x3F98F8 /end MEASUREMENT
/begin MEASUREMENT ei_rkc_um "irreversibles Fehlerbit der Lambda Plausibilisierung in der Funktions¸berwachung" UBYTE B_TRUE 1 100 0 1 BIT_MASK 0x1 FORMAT "%13.11" ECU_ADDRESS 0x3F9874 /end MEASUREMENT
/begin MEASUREMENT ei_rlc_um "irreversibles Fehlerbit beim rl-Vergleich mit der Funktion in der Funktions¸berw" UBYTE B_TRUE 1 100 0 1 BIT_MASK 0x1 FORMAT "%13.11" ECU_ADDRESS 0x3F9837 /end MEASUREMENT
/begin MEASUREMENT ei_rlip_um "irreversibles Fehlerbit beim rl/rlip-Vergleich der Funktions¸berwachung" UBYTE B_TRUE 1 100 0 1 BIT_MASK 0x1 FORMAT "%13.11" ECU_ADDRESS 0x3F9838 /end MEASUREMENT
/begin MEASUREMENT ei_sgsc_um "irreversibles Fehlerbit bei der SGS-‹berwachung der Funktions¸berwachung" UBYTE B_TRUE 1 100 0 1 BIT_MASK 0x1 FORMAT "%13.11" ECU_ADDRESS 0x3F98F1 /end MEASUREMENT
/begin MEASUREMENT ei_spsc_um "irreversibles Fehlerbit bei d. Sollwertplausibilisierung d. Funktions¸berwachung" UBYTE B_TRUE 1 100 0 1 BIT_MASK 0x1 FORMAT "%13.11" ECU_ADDRESS 0x3F987D /end MEASUREMENT
/begin MEASUREMENT ei_ubr_um "irrev. Fehlerbit zur Anforderung Fehlereintrag Hauptrelais-Diagnose aus %UMAUSC" UBYTE B_TRUE 1 100 0 1 BIT_MASK 0x1 FORMAT "%13.11" ECU_ADDRESS 0x3F9930 /end MEASUREMENT
/begin MEASUREMENT ei_varc_um "irreversibles Fehlerbit bei d. VarCodierungs¸berwachung d. Funktions¸berwachung" UBYTE B_TRUE 1 100 0 1 BIT_MASK 0x1 FORMAT "%13.11" ECU_ADDRESS 0x3F992A /end MEASUREMENT
/begin MEASUREMENT ei_vvt_um "Irreversibles Fehlerbit aus der VVT-Ventilhubplausibilisierung" UBYTE B_TRUE 1 100 0 1 BIT_MASK 0x1 FORMAT "%13.11" ECU_ADDRESS 0x3F9839 /end MEASUREMENT
/begin MEASUREMENT ei_zwc_um "irreversibles Fehlerbit bei der Z¸ndwinkel¸berwachung der Funktions¸berwachung" UBYTE B_TRUE 1 100 0 1 BIT_MASK 0x1 FORMAT "%13.11" ECU_ADDRESS 0x3F992C /end MEASUREMENT
/begin MEASUREMENT esst_sbf02mflrsb "" UWORD dez 1 100 0 65535 FORMAT "%8.2" ECU_ADDRESS 0x4030F4 /end MEASUREMENT
/begin MEASUREMENT esst_sbf02mfsb "" ULONG dez 1 100 0 4.29497e+009 FORMAT "%13.2" ECU_ADDRESS 0x404B00 /end MEASUREMENT
/begin MEASUREMENT esst_sco08vmub "" ULONG dez 1 100 0 4.29497e+009 FORMAT "%13.2" ECU_ADDRESS 0x404B04 /end MEASUREMENT
/begin MEASUREMENT esst_srl03mflruw "" UWORD dez 1 100 0 65535 FORMAT "%8.2" ECU_ADDRESS 0x4030F6 /end MEASUREMENT
/begin MEASUREMENT esst_srl03mfuw "" ULONG dez 1 100 0 4.29497e+009 FORMAT "%13.2" ECU_ADDRESS 0x404B08 /end MEASUREMENT
/begin MEASUREMENT etazwmn "Minimum-Z¸ndwinkelwirkungsgrad" UBYTE rel_ub_b127p5 1 100 0 127.5 FORMAT "%5.1" ECU_ADDRESS 0x3FC3E5 /end MEASUREMENT
/begin MEASUREMENT evhubim_um "Istwert Hubverstellung (Minimalwert) f¸r VVT-System in der Funktions¸berwachung" UBYTE hub_ub_q0p064 1 100 0 16.32 FORMAT "%5.2" ECU_ADDRESS 0x3F9847 /end MEASUREMENT
/begin MEASUREMENT evhubim_ur "Doppelablage (DA) f¸r EVHUBIM_UM" UBYTE dez 1 100 0 255 FORMAT "%5.1" ECU_ADDRESS 0x3F997A /end MEASUREMENT
/begin MEASUREMENT evhubi_um "Istwert Hubverstellung (Maximalwert) f¸r VVT-System in der Funktions¸berwachung" UBYTE hub_ub_q0p064 1 100 0 16.32 FORMAT "%5.2" ECU_ADDRESS 0x3F9848 /end MEASUREMENT
/begin MEASUREMENT evhubi_ur "Doppelablage (DA) f¸r EVHUBI_UM" UBYTE dez 1 100 0 255 FORMAT "%5.1" ECU_ADDRESS 0x3F997B /end MEASUREMENT
/begin MEASUREMENT EwsNvBits "" UBYTE dez 1 100 0 255 FORMAT "%5.1" ECU_ADDRESS 0x3FE93A /end MEASUREMENT
/begin MEASUREMENT e_mem_um "Errorflag im DauerRAM f¸r Fehler im zyklischen Speichertest in der FU" UBYTE B_TRUE 1 100 0 1 BIT_MASK 0x1 FORMAT "%13.11" ECU_ADDRESS 0x3FDEB2 /end MEASUREMENT
/begin MEASUREMENT e_ram_um "Errorflag im DauerRAM f¸r RAM-Fehler in der Funktions¸berwachung" UBYTE B_TRUE 1 100 0 1 BIT_MASK 0x1 FORMAT "%13.11" ECU_ADDRESS 0x3FDEBC /end MEASUREMENT
/begin MEASUREMENT e_rom1_um "Errorflag im DauerRAM f¸r Fehler nur in einer ROM-Page in der Fkt.¸berwachung" UBYTE B_TRUE 1 100 0 1 BIT_MASK 0x1 FORMAT "%13.11" ECU_ADDRESS 0x3FDEBE /end MEASUREMENT
/begin MEASUREMENT e_romx_um "Errorflag im DauerRAM f¸r Fehler in mehreren ROM-Pages in der Fkt.¸berwachung" UBYTE B_TRUE 1 100 0 1 BIT_MASK 0x1 FORMAT "%13.11" ECU_ADDRESS 0x3FDEBF /end MEASUREMENT
/begin MEASUREMENT e_tpu_um "Fehlerflag im DauerRAM f¸r TPU-Fehler in der Funktions¸berwachung" UBYTE B_TRUE 1 100 0 1 BIT_MASK 0x1 FORMAT "%13.11" ECU_ADDRESS 0x3FDEC6 /end MEASUREMENT
/begin MEASUREMENT fiptglr_w "aus jeweiliger Kennlinie ermittelter Wert der ersten Grobleckschwelle" UWORD fak_uw_b1 1 100 0 0.999985 FORMAT "%9.7" ECU_ADDRESS 0x403686 /end MEASUREMENT
/begin MEASUREMENT fiptgl_w "Wert der zweiten Grobleckschwelle" UWORD fak_uw_b1 1 100 0 0.999985 FORMAT "%9.7" ECU_ADDRESS 0x403688 /end MEASUREMENT
/begin MEASUREMENT frerr_c_um "FR-Fehlerz‰hler f¸r Differenz FZ-R¸ckmeldung/FZ-Erwartungswert in der Fkt.¸berw." UBYTE dez 1 100 0 255 FORMAT "%5.1" ECU_ADDRESS 0x3F9A21 /end MEASUREMENT
/begin MEASUREMENT frerr_c_ur "" UBYTE dez 1 100 0 255 FORMAT "%5.1" ECU_ADDRESS 0x3F9A22 /end MEASUREMENT
/begin MEASUREMENT frksch_um "rk Aufteilungsfaktor bei HOSP" UBYTE fak_ub_b1 1 100 0 0.996094 ECU_ADDRESS 0x3F9875 /end MEASUREMENT
/begin MEASUREMENT frksch_ur "Doppelablage (DA) f¸r FRKSCH_UM" UBYTE dez 1 100 0 255 FORMAT "%5.1" ECU_ADDRESS 0x3F99B4 /end MEASUREMENT
/begin MEASUREMENT frtar_c_um "Funktionsrechner Fehlerz‰hler-Erwartungswert der Funktions¸berwachung" UBYTE dez 1 100 0 255 FORMAT "%5.1" ECU_ADDRESS 0x403ACD /end MEASUREMENT
/begin MEASUREMENT fuel_co_um "Um ein Abarbeitungsraster verzˆgerte (alte) Einspritzzeit in der Funktions¸berw." ULONG dez 1 100 0 4.29497e+009 FORMAT "%13.2" ECU_ADDRESS 0x3F98FC /end MEASUREMENT
/begin MEASUREMENT fuel_co_ur "Doppelablage (DA) f¸r FUEL_CO_UM" ULONG dez 1 100 0 4.29497e+009 FORMAT "%13.2" ECU_ADDRESS 0x3F99DC /end MEASUREMENT
/begin MEASUREMENT fwkor_um "Wichtungsfaktor f¸r Ventilhub Abweichung in der Funktions¸berwachung" UBYTE fak_q0p00392 1 100 0 1 FORMAT "%5.3" ECU_ADDRESS 0x3F9849 /end MEASUREMENT
/begin MEASUREMENT fwltmkh "Wichtung Warmlauf-Z¸ndwinkel f¸r Katheizen" UBYTE fak_ub_b1 1 100 0 0.996094 ECU_ADDRESS 0x403D50 /end MEASUREMENT
/begin MEASUREMENT fwnm_um "Aktueller Normierungsfaktor fuer Drehzahl" UBYTE fak_q0p00781 1 100 0 1.99219 FORMAT "%5.3" ECU_ADDRESS 0x3F997C /end MEASUREMENT
/begin MEASUREMENT ht_IbsReadTimeOutCtr "" UWORD default 1 100 0 65535 FORMAT "%8.2" ECU_ADDRESS 0x4034B4 /end MEASUREMENT
/begin MEASUREMENT ht_IbsResetTimeOutCtr "" UWORD default 1 100 0 65535 FORMAT "%8.2" ECU_ADDRESS 0x4034B6 /end MEASUREMENT
/begin MEASUREMENT ht_IbsSendTimeOutCtr "" UWORD default 1 100 0 65535 FORMAT "%8.2" ECU_ADDRESS 0x4034B8 /end MEASUREMENT
/begin MEASUREMENT ht_IbsStatus "" UBYTE default 1 100 0 255 FORMAT "%5.1" ECU_ADDRESS 0x4034BD /end MEASUREMENT
/begin MEASUREMENT hubst08_um "" ULONG dez 1 100 0 4.29497e+009 FORMAT "%13.2" ECU_ADDRESS 0x3F9868 /end MEASUREMENT
/begin MEASUREMENT hubst08_ur "" ULONG dez 1 100 0 4.29497e+009 FORMAT "%13.2" ECU_ADDRESS 0x3F99A0 /end MEASUREMENT
/begin MEASUREMENT hwError_um "Fehler HW Zugriff aus CY310 Modulen" UBYTE dez 1 100 0 255 FORMAT "%5.1" ECU_ADDRESS 0x3FDED2 /end MEASUREMENT
/begin MEASUREMENT ipa_c_um "Fehlerz‰hler f¸r unterer DK-Anschlag im ung¸ltigen Bereich f. d. Funktions¸berw." UBYTE t40ms_ub_b10200 1 100 0 10200 FORMAT "%7.1" ECU_ADDRESS 0x3F984A /end MEASUREMENT
/begin MEASUREMENT ipa_c_ur "Doppelablage (DA) f¸r IPA_C_UM" UBYTE dez 1 100 0 255 FORMAT "%5.1" ECU_ADDRESS 0x3F997D /end MEASUREMENT
/begin MEASUREMENT ipnst08_um "St¸tzstelle f¸r aktive DK-Istwertpoti-Info (IPSN_UM)" ULONG dez 1 100 0 4.29497e+009 FORMAT "%13.2" ECU_ADDRESS 0x3F986C /end MEASUREMENT
/begin MEASUREMENT ipnst08_ur "" ULONG dez 1 100 0 4.29497e+009 FORMAT "%13.2" ECU_ADDRESS 0x3F99A4 /end MEASUREMENT
/begin MEASUREMENT ipsn_um "aktive DK-Istwertpoti-Info ohne unteren Anschlag f¸r die Funktions¸berwachung" UBYTE spg_ub_q0p019 1 100 0 4.98047 FORMAT "%5.3" ECU_ADDRESS 0x3F984B /end MEASUREMENT
/begin MEASUREMENT ipsn_ur "Doppelablage (DA) f¸r IPSN_UM" UBYTE dez 1 100 0 255 FORMAT "%5.1" ECU_ADDRESS 0x3F997E /end MEASUREMENT
/begin MEASUREMENT iptghmn_w "Mindest-Stromhub" UWORD i_q6p1035_uA 1 100 0 399.994 FORMAT "%8.4" ECU_ADDRESS 0x3FE2F8 /end MEASUREMENT
/begin MEASUREMENT iptghmx_w "Maximal-Stromhub" UWORD i_q6p1035_uA 1 100 0 399.994 FORMAT "%8.4" ECU_ADDRESS 0x3FE2FA /end MEASUREMENT
/begin MEASUREMENT iptgh_w "Differenz Pumpstrom zwischen Referenz und min. bei Grobleckmessung" UWORD i_q6p1035_uA 1 100 0 399.994 FORMAT "%8.4" ECU_ADDRESS 0x3FE2FC /end MEASUREMENT
/begin MEASUREMENT iptglmn_w "min. Pumpenstrom bei Grobleckmessung" UWORD i_q6p1035_uA 1 100 0 399.994 FORMAT "%8.4" ECU_ADDRESS 0x3FE2FE /end MEASUREMENT
/begin MEASUREMENT iptglv_w "Pumpenstrom am Ende der verl‰ngerter Grobleckmessung" UWORD i_q6p1035_uA 1 100 0 399.994 FORMAT "%8.4" ECU_ADDRESS 0x3FE300 /end MEASUREMENT
/begin MEASUREMENT iptgl_w "Pumpenstrom am Ende der Grobleckmessung" UWORD i_q6p1035_uA 1 100 0 399.994 FORMAT "%8.4" ECU_ADDRESS 0x3FE302 /end MEASUREMENT
/begin MEASUREMENT iptkl_w "Pumpenstrom am Ende der Feinstleckmessung" UWORD i_q6p1035_uA 1 100 0 399.994 FORMAT "%8.4" ECU_ADDRESS 0x3FE304 /end MEASUREMENT
/begin MEASUREMENT iptrefr_w "Pumpenstrom Referenzleck" UWORD i_q6p1035_uA 1 100 0 399.994 FORMAT "%8.4" ECU_ADDRESS 0x3FE306 /end MEASUREMENT
/begin MEASUREMENT iptref_w "Pumpenstrom Referenzleck" UWORD i_q6p1035_uA 1 100 0 399.994 FORMAT "%8.4" ECU_ADDRESS 0x3FE308 /end MEASUREMENT
/begin MEASUREMENT iptsglv_w "Pumpenstrom-Schwelle bei verl‰ngerter Grobleckmessung" UWORD i_q6p1035_uA 1 100 0 399.994 FORMAT "%8.4" ECU_ADDRESS 0x3FE30A /end MEASUREMENT
/begin MEASUREMENT iptsgl_w "Pumpenstrom-Schwelle bei Grobleckmessung" UWORD i_q6p1035_uA 1 100 0 399.994 FORMAT "%8.4" ECU_ADDRESS 0x3FE30C /end MEASUREMENT
/begin MEASUREMENT iptvglv_w "Pumpenstrom Vergleich bei  2 Kleinleckpruefung" UWORD i_q6p1035_uA 1 100 0 399.994 FORMAT "%8.4" ECU_ADDRESS 0x3FE30E /end MEASUREMENT
/begin MEASUREMENT iptvgl_w "Pumpenstrom Vergleich bei Grobleckpruefung" UWORD i_q6p1035_uA 1 100 0 399.994 FORMAT "%8.4" ECU_ADDRESS 0x3FE310 /end MEASUREMENT
/begin MEASUREMENT isadmtl "State Nr. DMTL-Automat" UBYTE dez 1 100 0 255 FORMAT "%5.1" ECU_ADDRESS 0x3FE324 /end MEASUREMENT
/begin MEASUREMENT isadmtold "vor Abbruch im Nachlauf ermittelter State Nr. DMTL-Automat" UBYTE dez 1 100 0 255 FORMAT "%5.1" ECU_ADDRESS 0x40368A /end MEASUREMENT
/begin MEASUREMENT ivmax "Initialisierungswert Integrator f¸r VMAX-Regelung" SBYTE rel_sb_q0p78 1 100 -99.84 99.06 FORMAT "%5.2" ECU_ADDRESS 0x4030E9 /end MEASUREMENT
/begin MEASUREMENT kfzwstat "" SBYTE zw_sb_q0p75 1 100 -96 95.25 FORMAT "%5.2" ECU_ADDRESS 0x403D3E /end MEASUREMENT
/begin MEASUREMENT lamb1_um "Lambdawert im Brennraum bei Lambdasplit (1.Bank) in der Funktions¸berwachung" UBYTE fak_ub_b8 1 100 0 7.96875 FORMAT "%5.3" ECU_ADDRESS 0x3F9876 /end MEASUREMENT
/begin MEASUREMENT lamb1_ur "Doppelablage (DA) f¸r LAMB1_UM" UBYTE dez 1 100 0 255 FORMAT "%5.1" ECU_ADDRESS 0x3F99B5 /end MEASUREMENT
/begin MEASUREMENT lamb2_um "Lambdawert im Brennraum bei Lambdasplit (2.Bank) in der Funktions¸berwachung" UBYTE fak_ub_b8 1 100 0 7.96875 FORMAT "%5.3" ECU_ADDRESS 0x3F9877 /end MEASUREMENT
/begin MEASUREMENT lamb2_ur "Doppelablage (DA) f¸r LAMB2_UM" UBYTE dez 1 100 0 255 FORMAT "%5.1" ECU_ADDRESS 0x3F99B6 /end MEASUREMENT
/begin MEASUREMENT last_test "Betriebszeit bei der zum letzten mal die Anschlaege gelernt wurden Bank1" UWORD t6minxmin_q6 1 100 0 393210 FORMAT "%8.1" ECU_ADDRESS 0x3FE150 /end MEASUREMENT
/begin MEASUREMENT last_test2 "Betriebszeit bei der zum letzten mal die Anschlaege gelernt wurden Bank2" UWORD t6minxmin_q6 1 100 0 393210 FORMAT "%8.1" ECU_ADDRESS 0x3FE152 /end MEASUREMENT
/begin MEASUREMENT mdst08_um "St¸tzstelle f¸r Momenten-Info (MZ_UM) zur Ermittlung des Momenten-Offsets in FU" ULONG dez 1 100 0 4.29497e+009 FORMAT "%13.2" ECU_ADDRESS 0x3F9914 /end MEASUREMENT
/begin MEASUREMENT mdst08_ur "Doppelablage (DA) f¸r MDST08_UM" ULONG dez 1 100 0 4.29497e+009 FORMAT "%13.2" ECU_ADDRESS 0x3F9A00 /end MEASUREMENT
/begin MEASUREMENT mem_ur "Doppelablage (DA) f¸r Bit E_MEM_UM (im DauerRAM )" UBYTE dez 1 100 0 255 FORMAT "%5.1" ECU_ADDRESS 0x3FDEB3 /end MEASUREMENT
/begin MEASUREMENT minhub_ub "" UBYTE hub_ub_b1 1 100 0 0.996094 ECU_ADDRESS 0x403A7C /end MEASUREMENT
/begin MEASUREMENT mired "indiziertes Reduktionsmoment zur VMAX-Regelung" UBYTE rel_ub_b99p6 1 100 0 99.6094 FORMAT "%5.2" ECU_ADDRESS 0x4030EA /end MEASUREMENT
/begin MEASUREMENT mivmx "indiziertes Soll-Moment f¸r VMAX-Begrenzung" SBYTE rel_sb_q0p78 1 100 -99.84 99.06 FORMAT "%5.2" ECU_ADDRESS 0x4030EB /end MEASUREMENT
/begin MEASUREMENT mivmxt_w "indiziertes Soll-Moment f¸r VMAX-Begrenzung (temp)" UWORD rel_uw_b100 1 100 0 99.9985 FORMAT "%8.5" ECU_ADDRESS 0x4030F8 /end MEASUREMENT
/begin MEASUREMENT mivmx_w "Indiziertes Sollmoment der VMAX-Regelung" UWORD rel_uw_b100 1 100 0 99.9985 FORMAT "%8.5" ECU_ADDRESS 0x4030FA /end MEASUREMENT
/begin MEASUREMENT mksges_um "SGS-Kupplungsmoment Getriebeschutz f¸r die ‹berwachung" SWORD md_q0p5 1 100 -16384 16383.5 FORMAT "%8.2" ECU_ADDRESS 0x3FA3CA /end MEASUREMENT
/begin MEASUREMENT mksgs_um "SGS-Kupplungsmoment f¸r die ‹berwachung" SWORD md_q0p5 1 100 -16384 16383.5 FORMAT "%8.2" ECU_ADDRESS 0x3FA3CC /end MEASUREMENT
/begin MEASUREMENT mkswand_um "SGS-Kupplungsmoment Aufnahmemoment des Wandlers,  f¸r die ‹berwachung" UBYTE md_q0p5 1 100 0 127.5 FORMAT "%5.1" ECU_ADDRESS 0x3FA3C9 /end MEASUREMENT
/begin MEASUREMENT mldpsad "Luftmassenstrom aus WDKADP" SWORD m_uw_b6553p5 1 100 -3276.8 3276.7 FORMAT "%8.3" ECU_ADDRESS 0x40463C /end MEASUREMENT
/begin MEASUREMENT modul_c_um "Modulaufrufz‰hler f¸r Programm-Ablauf-Kontrolle (%URPAK)in der FU" UWORD dez 1 100 0 65535 FORMAT "%8.2" ECU_ADDRESS 0x403D60 /end MEASUREMENT
/begin MEASUREMENT mped_um "zul‰ssiges indiziertes Moment aus Fahrpedal in der Funktions¸berwachung" UBYTE rel_ub_b99p6 1 100 0 99.6094 FORMAT "%5.2" ECU_ADDRESS 0x3F99FC /end MEASUREMENT
/begin MEASUREMENT mrlini_um "zul. Momentes bei Umschaltung der ‹berwachung auf Luftmasse zur Initialsierung" UBYTE rel_ub_b99p6 1 100 0 99.6094 FORMAT "%5.2" ECU_ADDRESS 0x3F9878 /end MEASUREMENT
/begin MEASUREMENT mrlini_ur "Doppelablage (DA) f¸r MRLINI_UM" UBYTE dez 1 100 0 255 FORMAT "%5.1" ECU_ADDRESS 0x3F99B7 /end MEASUREMENT
/begin MEASUREMENT msgs_um "Soll- Motormoment aus Getriebe¸berwachung in der Funktions¸berwachung" UBYTE rel_ub_b99p6 1 100 0 99.6094 FORMAT "%5.2" ECU_ADDRESS 0x3F98F4 /end MEASUREMENT
/begin MEASUREMENT msgs_ur "Doppelablage (DA) f¸r MSGS_UM" UBYTE dez 1 100 0 255 FORMAT "%5.1" ECU_ADDRESS 0x3F99D3 /end MEASUREMENT
/begin MEASUREMENT mzo_um "Toleranz-Offset f¸rs zul‰ssige Moment in der Funktions¸berwachung" UBYTE rel_ub_b99p6 1 100 0 99.6094 FORMAT "%5.2" ECU_ADDRESS 0x3F9911 /end MEASUREMENT
/begin MEASUREMENT mzo_ur "Doppelablage (DA) f¸r MZO_UM" UBYTE dez 1 100 0 255 FORMAT "%5.1" ECU_ADDRESS 0x3F99FD /end MEASUREMENT
/begin MEASUREMENT mz_um "resultierendes zul‰ssiges Moment aus der Koordination der Funktions¸berwachung" UBYTE rel_ub_b99p6 1 100 0 99.6094 FORMAT "%5.2" ECU_ADDRESS 0x3F9912 /end MEASUREMENT
/begin MEASUREMENT mz_ur "Doppelablage (DA) f¸r MZ_UM" UBYTE dez 1 100 0 255 FORMAT "%5.1" ECU_ADDRESS 0x3F99FE /end MEASUREMENT
/begin MEASUREMENT nc_c_um "Fehlerz‰hler f¸r Motordrehzahlvergleich f¸r die Funktions¸berwachung" UBYTE t40ms_ub_b10200 1 100 0 10200 FORMAT "%7.1" ECU_ADDRESS 0x3F991D /end MEASUREMENT
/begin MEASUREMENT nc_c_ur "Doppelablage (DA) f¸r NC_C_UM" UBYTE dez 1 100 0 255 FORMAT "%5.1" ECU_ADDRESS 0x3F9A08 /end MEASUREMENT
/begin MEASUREMENT newansw_um "Neue Antwort an das UM in der Funktions¸berwachung" ULONG dez 1 100 0 4.29497e+009 FORMAT "%13.2" ECU_ADDRESS 0x4048B8 /end MEASUREMENT
/begin MEASUREMENT newqr_ur "" UBYTE dez 1 100 0 255 FORMAT "%5.1" ECU_ADDRESS 0x3F9A23 /end MEASUREMENT
/begin MEASUREMENT newque_um "Neue Frage vom UM, expandiert in der Funktions¸berwachung" ULONG dez 1 100 0 4.29497e+009 FORMAT "%13.2" ECU_ADDRESS 0x4048BC /end MEASUREMENT
/begin MEASUREMENT newqu_um "Neue Frage vom UM in der Funktions¸berwachung" UBYTE dez 1 100 0 255 FORMAT "%5.1" ECU_ADDRESS 0x403ACE /end MEASUREMENT
/begin MEASUREMENT nmot_um "Motordrehzahl in der Funktions¸berwachung" UBYTE nmot_ub_q40 1 100 0 10200 FORMAT "%5.0" ECU_ADDRESS 0x3F991E /end MEASUREMENT
/begin MEASUREMENT nmot_ur "Doppelablage (DA) f¸r NMOT_UM" UBYTE dez 1 100 0 255 FORMAT "%5.1" ECU_ADDRESS 0x3F9A09 /end MEASUREMENT
/begin MEASUREMENT nmst08_um "St¸tzstelle f¸r Motordrehzahl in der Funktions¸berwachung (NMOT_UM)" ULONG dez 1 100 0 4.29497e+009 FORMAT "%13.2" ECU_ADDRESS 0x3F9920 /end MEASUREMENT
/begin MEASUREMENT nmst08_ur "Doppelablage (DA) f¸r NMST08_UM" ULONG dez 1 100 0 4.29497e+009 FORMAT "%13.2" ECU_ADDRESS 0x3F9A10 /end MEASUREMENT
/begin MEASUREMENT nsc_c_um "Zeit nach Start in der Funktions¸berwachung" UWORD t40msxs_uw_q0p04 1 100 0 2621.4 FORMAT "%8.3" ECU_ADDRESS 0x3F9928 /end MEASUREMENT
/begin MEASUREMENT nsc_c_ur "Doppelablage (DA) f¸r NSC_C_UM" UWORD dez 1 100 0 65535 FORMAT "%8.2" ECU_ADDRESS 0x3F9A1A /end MEASUREMENT
/begin MEASUREMENT nseg_um "Motordrehzahl aus Segmentzeit in der Funktions¸berwachung" UBYTE nmot_ub_q40 1 100 0 10200 FORMAT "%5.0" ECU_ADDRESS 0x3F9A0A /end MEASUREMENT
/begin MEASUREMENT nska_um "Grenzdrehzahl bei aktiver Fehlerreaktion in der Funktions¸berwachung" UBYTE nmot_ub_q40 1 100 0 10200 FORMAT "%5.0" ECU_ADDRESS 0x3F99D8 /end MEASUREMENT
/begin MEASUREMENT nsof_c_um "Z‰hler Entprellzeit f¸r Abschaltung der Nachstartaufweitung" UBYTE t40ms_ub_b10200 1 100 0 10200 FORMAT "%7.1" ECU_ADDRESS 0x3F9925 /end MEASUREMENT
/begin MEASUREMENT nsof_c_ur "Doppelablage (DA) f¸r NSOF_C_UM" UBYTE dez 1 100 0 255 FORMAT "%5.1" ECU_ADDRESS 0x3F9A18 /end MEASUREMENT
/begin MEASUREMENT nxtrp_ur "" UBYTE dez 1 100 0 255 FORMAT "%5.1" ECU_ADDRESS 0x3F9A24 /end MEASUREMENT
/begin MEASUREMENT nz_um "Motordrehzahl aus Zahnz‰hlerdifferenz pro Zeit in der Funktions¸berwachung" UBYTE nmot_ub_q40 1 100 0 10200 FORMAT "%5.0" ECU_ADDRESS 0x3F994D /end MEASUREMENT
/begin MEASUREMENT n_flags_um "Byte f¸r Nachstart-Bits der Funktions¸berwachung" UBYTE dez 1 100 0 255 FORMAT "%5.1" ECU_ADDRESS 0x3F9887 /end MEASUREMENT
/begin MEASUREMENT plstate_um "Zustand zur Plausibilisierung des UM in der Funktions¸berwachung" UBYTE dez 1 100 0 255 FORMAT "%5.1" ECU_ADDRESS 0x403ACF /end MEASUREMENT
/begin MEASUREMENT plstate_ur "" UBYTE dez 1 100 0 255 FORMAT "%5.1" ECU_ADDRESS 0x3F9A25 /end MEASUREMENT
/begin MEASUREMENT pm_akt "" UBYTE dez 1 100 0 255 FORMAT "%5.1" ECU_ADDRESS 0x40272C /end MEASUREMENT
/begin MEASUREMENT pm_fre "" UBYTE dez 1 100 0 255 FORMAT "%5.1" ECU_ADDRESS 0x40272D /end MEASUREMENT
/begin MEASUREMENT pm_mod "" UBYTE dez 1 100 0 255 FORMAT "%5.1" ECU_ADDRESS 0x40272E /end MEASUREMENT
/begin MEASUREMENT pm_ta "" UBYTE dez 1 100 0 255 FORMAT "%5.1" ECU_ADDRESS 0x40272F /end MEASUREMENT
/begin MEASUREMENT pm_td "" UBYTE dez 1 100 0 255 FORMAT "%5.1" ECU_ADDRESS 0x402730 /end MEASUREMENT
/begin MEASUREMENT pty_fctr "" UBYTE dez 1 100 0 255 FORMAT "%5.1" ECU_ADDRESS 0x4036F8 /end MEASUREMENT
/begin MEASUREMENT ram_c_um "Fehlerz‰hler im Dauer-RAM f¸r RAM-Konsistenz-Pr¸fung (Diagnose) in der Fkt-‹berw" UBYTE dez 1 100 0 255 FORMAT "%5.1" ECU_ADDRESS 0x3FDEC8 /end MEASUREMENT
/begin MEASUREMENT ram_ur "" UBYTE dez 1 100 0 255 FORMAT "%5.1" ECU_ADDRESS 0x3FDEBD /end MEASUREMENT
/begin MEASUREMENT reac_c1_um "Fehlerz‰hler 1 f¸r Fehlerreaktions¸berwachung in Funktions¸berwachung" UBYTE t40ms_ub_b10200 1 100 0 10200 FORMAT "%7.1" ECU_ADDRESS 0x3F98F9 /end MEASUREMENT
/begin MEASUREMENT reac_c1_ur "Doppelablage (DA) f¸r REAC_C1_UM" UBYTE dez 1 100 0 255 FORMAT "%5.1" ECU_ADDRESS 0x3F99D9 /end MEASUREMENT
/begin MEASUREMENT reac_c2_um "Fehlerz‰hler 2 f¸r Fehlerreaktions¸berwachung in Funktions¸berwachung" UBYTE t40ms_ub_b10200 1 100 0 10200 FORMAT "%7.1" ECU_ADDRESS 0x3F98FA /end MEASUREMENT
/begin MEASUREMENT reac_c2_ur "Doppelablage (DA) f¸r REAC_C2_UM" UBYTE dez 1 100 0 255 FORMAT "%5.1" ECU_ADDRESS 0x3F99DA /end MEASUREMENT
/begin MEASUREMENT reac_c_um "Fehlerz‰hler im Dauer-RAM f¸r Fehlerreaktions¸berwachung (Diagnose) in der FU" UBYTE dez 1 100 0 255 FORMAT "%5.1" ECU_ADDRESS 0x3FDEC9 /end MEASUREMENT
/begin MEASUREMENT rec_fctr "" UBYTE dez 1 100 0 255 FORMAT "%5.1" ECU_ADDRESS 0x4036F9 /end MEASUREMENT
/begin MEASUREMENT reset_indication_um "" UWORD dez 1 100 0 65535 FORMAT "%8.2" ECU_ADDRESS 0x3FDECE /end MEASUREMENT
/begin MEASUREMENT rlc_c_um "Fehlerz‰hler f¸r rl-Vergleich mit der Funktion in der Funktions¸berwachung" UBYTE t40ms_ub_b10200 1 100 0 10200 FORMAT "%7.1" ECU_ADDRESS 0x3F984C /end MEASUREMENT
/begin MEASUREMENT rlc_c_ur "Doppelablage (DA) f¸r RLC_C_UM" UBYTE dez 1 100 0 255 FORMAT "%5.1" ECU_ADDRESS 0x3F997F /end MEASUREMENT
/begin MEASUREMENT rldf_l_um "Nachkommastellen des rld-Filterwertes" UBYTE rel_ub_q0p0029 1 100 0 0.74707 ECU_ADDRESS 0x3F984D /end MEASUREMENT
/begin MEASUREMENT rldf_l_ur "Doppelablage (DA) f¸r RLDF_L_UM" UBYTE dez 1 100 0 255 FORMAT "%5.1" ECU_ADDRESS 0x3F9980 /end MEASUREMENT
/begin MEASUREMENT rldf_p_um "" UBYTE dez 1 100 0 255 FORMAT "%5.1" ECU_ADDRESS 0x3F984E /end MEASUREMENT
/begin MEASUREMENT rldf_p_ur "" UBYTE dez 1 100 0 255 FORMAT "%5.1" ECU_ADDRESS 0x3F9981 /end MEASUREMENT
/begin MEASUREMENT rldf_r_um "" UBYTE rel_ub_q0p75 1 100 0 191.25 FORMAT "%5.1" ARRAY_SIZE 8 ECU_ADDRESS 0x3F984F /end MEASUREMENT
/begin MEASUREMENT rldf_r_ur "" UBYTE dez 1 100 0 255 FORMAT "%5.1" ARRAY_SIZE 8 ECU_ADDRESS 0x3F9982 /end MEASUREMENT
/begin MEASUREMENT rldf_um "Relative Luftf¸llung aus Drosselinformation nach Tiefpaﬂfilter" UBYTE rel_ub_q0p75 1 100 0 191.25 FORMAT "%5.1" ECU_ADDRESS 0x3F9857 /end MEASUREMENT
/begin MEASUREMENT rldf_ur "Doppelablage (DA) f¸r RLDF_UM" UBYTE dez 1 100 0 255 FORMAT "%5.1" ECU_ADDRESS 0x3F998A /end MEASUREMENT
/begin MEASUREMENT rldif_um "Differenz zwischen zul‰ssigem rl und Ist-rl in der Funktions¸berwachung" SWORD rel_ub_q0p75 1 100 -24576 24575.3 FORMAT "%8.2" ECU_ADDRESS 0x3F99AC /end MEASUREMENT
/begin MEASUREMENT rldpf_l_um "rel. Luftf¸llung aus DK- und Druckinfo hinter Tiefpaﬂ (Low-Byte)" UBYTE rel_ub_q0p0029 1 100 0 0.74707 ECU_ADDRESS 0x3F9858 /end MEASUREMENT
/begin MEASUREMENT rldpf_l_ur "Doppelablage (DA) f¸r RLDPF_L_UM" UBYTE dez 1 100 0 255 FORMAT "%5.1" ECU_ADDRESS 0x3F998B /end MEASUREMENT
/begin MEASUREMENT rldpf_p_um "" UBYTE dez 1 100 0 255 FORMAT "%5.1" ECU_ADDRESS 0x3F9859 /end MEASUREMENT
/begin MEASUREMENT rldpf_p_ur "" UBYTE dez 1 100 0 255 FORMAT "%5.1" ECU_ADDRESS 0x3F998C /end MEASUREMENT
/begin MEASUREMENT rldpf_r_um "" UBYTE rel_ub_q0p75 1 100 0 191.25 FORMAT "%5.1" ARRAY_SIZE 8 ECU_ADDRESS 0x3F985A /end MEASUREMENT
/begin MEASUREMENT rldpf_r_ur "" UBYTE dez 1 100 0 255 FORMAT "%5.1" ARRAY_SIZE 8 ECU_ADDRESS 0x3F998D /end MEASUREMENT
/begin MEASUREMENT rldpf_um "rel. Luftf¸llung aus DK- und Druckinfo hinter Tiefpaﬂ" UBYTE rel_ub_q0p75 1 100 0 191.25 FORMAT "%5.1" ECU_ADDRESS 0x3F9862 /end MEASUREMENT
/begin MEASUREMENT rldpf_ur "Doppelablage (DA) f¸r RLDPF_UM" UBYTE dez 1 100 0 255 FORMAT "%5.1" ECU_ADDRESS 0x3F9995 /end MEASUREMENT
/begin MEASUREMENT rldpzo_um "" UBYTE rel_ub_q0p75 1 100 0 191.25 FORMAT "%5.1" ECU_ADDRESS 0x3F9996 /end MEASUREMENT
/begin MEASUREMENT rldp_um "rel. Luftf¸llung aus DK- und Druckinfo" UBYTE rel_ub_q0p75 1 100 0 191.25 FORMAT "%5.1" ECU_ADDRESS 0x3F9997 /end MEASUREMENT
/begin MEASUREMENT rld_um "Relative Luftf¸llung aus Drosselinformation in der Funktions¸berwachung" UBYTE rel_ub_q0p75 1 100 0 191.25 FORMAT "%5.1" ECU_ADDRESS 0x3F9998 /end MEASUREMENT
/begin MEASUREMENT rlip_c_um "Fehlerz‰hler f¸r rl/rlip-Vergleich in der Funktions¸berwachung" UBYTE t40ms_ub_b10200 1 100 0 10200 FORMAT "%7.1" ECU_ADDRESS 0x3F9863 /end MEASUREMENT
/begin MEASUREMENT rlip_c_ur "Doppelablage (DA) f¸r RLIP_C_UM" UBYTE dez 1 100 0 255 FORMAT "%5.1" ECU_ADDRESS 0x3F9999 /end MEASUREMENT
/begin MEASUREMENT rlkr "Auswahl RL oder RLP bei B_krldy" UBYTE rel_ub_q0p75 1 100 0 191.25 FORMAT "%5.1" ECU_ADDRESS 0x3FC3DE /end MEASUREMENT
/begin MEASUREMENT rlnmo_um "Gewichtete Last in Bezug auf obere Drehzahlschwelle" UWORD rel_uw_q0p75 1 100 0 49151.3 FORMAT "%8.2" ECU_ADDRESS 0x3F99AE /end MEASUREMENT
/begin MEASUREMENT rlnmu_um "Gewichtete Last in Bezug auf untere Drehzahlschwelle" UWORD rel_uw_q0p75 1 100 0 49151.3 FORMAT "%8.2" ECU_ADDRESS 0x3F99B0 /end MEASUREMENT
/begin MEASUREMENT rlsol "Soll-F¸llung" UBYTE rel_ub_q0p75 1 100 0 191.25 FORMAT "%5.1" ECU_ADDRESS 0x3FC3DF /end MEASUREMENT
/begin MEASUREMENT rlsolkrv "" UBYTE rel_ub_q0p75 1 100 0 191.25 FORMAT "%5.1" ECU_ADDRESS 0x3FC3E0 /end MEASUREMENT
/begin MEASUREMENT rlsolkrvf "" UBYTE rel_ub_q0p75 1 100 0 191.25 FORMAT "%5.1" ECU_ADDRESS 0x3FC3E1 /end MEASUREMENT
/begin MEASUREMENT rlsolkrvft "" UBYTE rel_ub_q0p75 1 100 0 191.25 FORMAT "%5.1" ECU_ADDRESS 0x3FC3E2 /end MEASUREMENT
/begin MEASUREMENT rlsolkrvt "" UBYTE rel_ub_q0p75 1 100 0 191.25 FORMAT "%5.1" ECU_ADDRESS 0x3FC3E3 /end MEASUREMENT
/begin MEASUREMENT rlst08_um "St¸tzstelle der SSV RLV08_UM" ULONG dez 1 100 0 4.29497e+009 FORMAT "%13.2" ECU_ADDRESS 0x3F9870 /end MEASUREMENT
/begin MEASUREMENT rlst08_ur "Doppelablage (DA) f¸r RLST08_UM" ULONG dez 1 100 0 4.29497e+009 FORMAT "%13.2" ECU_ADDRESS 0x3F99A8 /end MEASUREMENT
/begin MEASUREMENT rlvvtzo_um "Obere Toleranzgerade f¸r VVT" UBYTE rel_ub_q0p75 1 100 0 191.25 FORMAT "%5.1" ECU_ADDRESS 0x3F999A /end MEASUREMENT
/begin MEASUREMENT rlvvt_um "relative Luftf¸llung aus VVT-Stellung und Drehzahl" UBYTE rel_ub_q0p75 1 100 0 191.25 FORMAT "%5.1" ECU_ADDRESS 0x3F999B /end MEASUREMENT
/begin MEASUREMENT rlzo_um "obere Toleranzgrenze f¸r rl aus Nebenlastsignal in der Funktions¸berwachung" UBYTE rel_ub_q0p75 1 100 0 191.25 FORMAT "%5.1" ECU_ADDRESS 0x3F999C /end MEASUREMENT
/begin MEASUREMENT rl_um "relative Luftf¸llung in der Funktions¸berwachung" UBYTE rel_ub_q0p75 1 100 0 191.25 FORMAT "%5.1" ECU_ADDRESS 0x3F9864 /end MEASUREMENT
/begin MEASUREMENT rl_ur "Doppelablage (DA) f¸r RL_UM" UBYTE dez 1 100 0 255 FORMAT "%5.1" ECU_ADDRESS 0x3F999D /end MEASUREMENT
/begin MEASUREMENT rl_w_um "relative Luftf¸llung (Word) in der Funktions¸berwachung" UWORD rel_uw_q0p0234 1 100 0 1535.98 FORMAT "%8.3" ECU_ADDRESS 0x3F99B2 /end MEASUREMENT
/begin MEASUREMENT rom1_ur "" UBYTE dez 1 100 0 255 FORMAT "%5.1" ECU_ADDRESS 0x3FDEC0 /end MEASUREMENT
/begin MEASUREMENT rompage_um "Adresse im DauerRAM der einzelnen fehlerhaften ROM-Page  in der Fkt.¸berw." UBYTE dez 1 100 0 255 FORMAT "%5.1" ECU_ADDRESS 0x3FDEC1 /end MEASUREMENT
/begin MEASUREMENT rompage_ur "" UBYTE dez 1 100 0 255 FORMAT "%5.1" ECU_ADDRESS 0x3FDEC2 /end MEASUREMENT
/begin MEASUREMENT romrstc_um "Z‰hler im DauerRAM f¸r Resets bei ROM-Check-Fehler in der Init. in der FU" UBYTE dez 1 100 0 255 FORMAT "%5.1" ECU_ADDRESS 0x3FDEC3 /end MEASUREMENT
/begin MEASUREMENT romx_ur "" UBYTE dez 1 100 0 255 FORMAT "%5.1" ECU_ADDRESS 0x3FDEC4 /end MEASUREMENT
/begin MEASUREMENT romz_c_um "Fehlerz‰hler im Dauer-RAM f¸r ROM-Pr¸fung (Diagnose) in der Funktions¸berwachung" UBYTE dez 1 100 0 255 FORMAT "%5.1" ECU_ADDRESS 0x3FDECA /end MEASUREMENT
/begin MEASUREMENT r_flags_um "Byte f¸r Fehlerreaktions-Bits der Funktions¸berwachung" UBYTE dez 1 100 0 255 FORMAT "%5.1" ECU_ADDRESS 0x3F9888 /end MEASUREMENT
/begin MEASUREMENT sgsc_c_um "Fehlerz‰hler f¸r Getriebe¸berwachung der Funktions¸berwachung" UBYTE t10ms_ub_b2550 1 100 0 2550 ECU_ADDRESS 0x3F98F5 /end MEASUREMENT
/begin MEASUREMENT sgsc_c_ur "Doppelablage (DA) f¸r SGSC_C_UM" UBYTE dez 1 100 0 255 FORMAT "%5.1" ECU_ADDRESS 0x3F99D4 /end MEASUREMENT
/begin MEASUREMENT sp1s_um "aktueller Wert f¸r Sollwert-Poti 1 (PWG) f¸r die Funktions¸berwachung" UBYTE spg_ub_q0p019 1 100 0 4.98047 FORMAT "%5.3" ECU_ADDRESS 0x3F99B8 /end MEASUREMENT
/begin MEASUREMENT sp2s_um "aktueller Wert f¸r Sollwert-Poti 2 (PWG) f¸r die Funktions¸berwachung" UBYTE spg_ub_q0p0098 1 100 0 2.49023 FORMAT "%5.3" ECU_ADDRESS 0x3F99B9 /end MEASUREMENT
/begin MEASUREMENT spnst08_um "St¸tzstelle f¸r aktive Sollwertpoti-Info (SPSN_UM) in FU" ULONG dez 1 100 0 4.29497e+009 FORMAT "%13.2" ECU_ADDRESS 0x3F9880 /end MEASUREMENT
/begin MEASUREMENT spnst08_ur "Doppelablage (DA) f¸r SPNST08_UM" ULONG dez 1 100 0 4.29497e+009 FORMAT "%13.2" ECU_ADDRESS 0x3F99BC /end MEASUREMENT
/begin MEASUREMENT spsc_c_um "Fehlerz‰hler bei zueinander unplausiblen Sollwerten in der Funktions¸berwachung" UBYTE t40ms_ub_b10200 1 100 0 10200 FORMAT "%7.1" ECU_ADDRESS 0x3F987E /end MEASUREMENT
/begin MEASUREMENT spsc_c_ur "Doppelablage (DA) f¸r SPSC_C_UM" UBYTE dez 1 100 0 255 FORMAT "%5.1" ECU_ADDRESS 0x3F99BA /end MEASUREMENT
/begin MEASUREMENT spsn_um "Pedalsollwert (8 Bit) in der Funktions¸berwachung" UBYTE spg_ub_q0p019 1 100 0 4.98047 FORMAT "%5.3" ECU_ADDRESS 0x3F987F /end MEASUREMENT
/begin MEASUREMENT spsn_ur "Doppelablage (DA) f¸r SPSN_UM" UBYTE dez 1 100 0 255 FORMAT "%5.1" ECU_ADDRESS 0x3F99BB /end MEASUREMENT
/begin MEASUREMENT srst_c_um "Z‰hler im Dauer-RAM f¸r Software-Reset (Diagnose) aus der Funktions¸berwachung" UBYTE dez 1 100 0 255 FORMAT "%5.1" ECU_ADDRESS 0x3FDECB /end MEASUREMENT
/begin MEASUREMENT stw_prog_frei_mod "" UBYTE dez 1 100 0 255 FORMAT "%5.1" ECU_ADDRESS 0x4036FA /end MEASUREMENT
/begin MEASUREMENT stw_prog_frei_ta "" UBYTE dez 1 100 0 255 FORMAT "%5.1" ECU_ADDRESS 0x4036FB /end MEASUREMENT
/begin MEASUREMENT stw_prog_frei_td "" UBYTE dez 1 100 0 255 FORMAT "%5.1" ECU_ADDRESS 0x4036FC /end MEASUREMENT
/begin MEASUREMENT szout_w "Schlieﬂzeitausgabe" UWORD txms_uw_q0p001 1 100 0 65.535 FORMAT "%8.5" ECU_ADDRESS 0x40435C /end MEASUREMENT
/begin MEASUREMENT s_flags_um "Byte f¸r Status-Bits der Funktions¸berwachung" UBYTE dez 1 100 0 255 FORMAT "%5.1" ECU_ADDRESS 0x3F9889 /end MEASUREMENT
/begin MEASUREMENT tavvtout_w "ausgegebenes Tastverh‰ltnis f¸r VVT Enable" SWORD vnstv_q0p01 1 100 -100 100 FORMAT "%7.3" ECU_ADDRESS 0x404632 /end MEASUREMENT
/begin MEASUREMENT tc72alt_um "System-Timerwert zum vorhergehen Berechnungszeitpunkt des 720∞ Zahnz‰hlers in FU" ULONG txms_uw_q0p0004 1 100 0 1.71799e+006 FORMAT "%13.5" ECU_ADDRESS 0x3F9830 /end MEASUREMENT
/begin MEASUREMENT tc72alt_ur "Doppelablage (DA) f¸r TC72ALT_UM" ULONG dez 1 100 0 4.29497e+009 FORMAT "%13.2" ECU_ADDRESS 0x3F9958 /end MEASUREMENT
/begin MEASUREMENT tdifs1_um "Summe der Zeitdifferenzen zwischen der TPU- und der CPU-Segmentzeit in der FU" SLONG txms_uw_q0p0004 1 100 -858993 858993 FORMAT "%13.6" ECU_ADDRESS 0x3F995C /end MEASUREMENT
/begin MEASUREMENT tdifs1_ur "Doppelablage (DA) f¸r TDIFS1_UM" SLONG dez 1 100 -2.14748e+009 2.14748e+009 FORMAT "%13.2" ECU_ADDRESS 0x3F9960 /end MEASUREMENT
/begin MEASUREMENT tdmgl_w "Messzeit Grobleck" UWORD t_q0p1 1 100 0 6553.5 FORMAT "%8.3" ECU_ADDRESS 0x3FE312 /end MEASUREMENT
/begin MEASUREMENT tdmkl_w "Messzeit Feinleck" UWORD t_q0p1 1 100 0 6553.5 FORMAT "%8.3" ECU_ADDRESS 0x3FE314 /end MEASUREMENT
/begin MEASUREMENT tdmlka_w "aktuelle Zeit Leckmessung" UWORD t_q0p1 1 100 0 6553.5 FORMAT "%8.3" ECU_ADDRESS 0x3FE316 /end MEASUREMENT
/begin MEASUREMENT tdmstba_w "aktuelle Zeit Pumpenstrom stabil" UWORD t_q0p1 1 100 0 6553.5 FORMAT "%8.3" ECU_ADDRESS 0x3FE318 /end MEASUREMENT
/begin MEASUREMENT tdmstth_w "Schwelle aktuelle Zeit Pumpenstrom stabil" UWORD t_q0p1 1 100 0 6553.5 FORMAT "%8.3" ECU_ADDRESS 0x3FE31A /end MEASUREMENT
/begin MEASUREMENT tdmtrest "Wartezeit-Z‰hler vor n‰chster DM-TL Diagnose" UWORD t_q0p1 1 100 0 6553.5 FORMAT "%8.3" ECU_ADDRESS 0x3FE31C /end MEASUREMENT
/begin MEASUREMENT timrlsolvt "" UBYTE dez 1 100 0 255 FORMAT "%5.1" ECU_ADDRESS 0x3FC3E4 /end MEASUREMENT
/begin MEASUREMENT tmost08_um "St¸tzstelle f¸r Motortemperatur" ULONG dez 1 100 0 4.29497e+009 FORMAT "%13.2" ECU_ADDRESS 0x3F9918 /end MEASUREMENT
/begin MEASUREMENT tmost08_ur "Doppelablage (DA) f¸r TMOTST08_UM" ULONG dez 1 100 0 4.29497e+009 FORMAT "%13.2" ECU_ADDRESS 0x3F9A04 /end MEASUREMENT
/begin MEASUREMENT tmotmn_um "Minimal plausible Motortemperatur" UBYTE temp_ub_q0p75_o48 1 100 -48 143.25 FORMAT "%5.1" ECU_ADDRESS 0x3F9913 /end MEASUREMENT
/begin MEASUREMENT tmotmn_ur "Doppelablage (DA) f¸r TMOTMN_UM" UBYTE dez 1 100 0 255 FORMAT "%5.1" ECU_ADDRESS 0x3F99FF /end MEASUREMENT
/begin MEASUREMENT tmot_um "Motor-Temperatur in der Funktions¸berwachung" UBYTE temp_ub_q0p75_o48 1 100 -48 143.25 FORMAT "%5.1" ECU_ADDRESS 0x3F9926 /end MEASUREMENT
/begin MEASUREMENT tmot_ur "Doppelablage (DA) f¸r TMOT_UM" UBYTE dez 1 100 0 255 FORMAT "%5.1" ECU_ADDRESS 0x3F9A19 /end MEASUREMENT
/begin MEASUREMENT tpuca_c_um "Z‰hler f¸r TPU-Pr¸fung aktiv in der Funktions¸berwachung" UBYTE t10ms_ub_b2550 1 100 0 2550 ECU_ADDRESS 0x3F9829 /end MEASUREMENT
/begin MEASUREMENT tpuca_c_ur "Doppelablage (DA) f¸r TPUCA_C_UM" UBYTE dez 1 100 0 255 FORMAT "%5.1" ECU_ADDRESS 0x3F994E /end MEASUREMENT
/begin MEASUREMENT tpucr_c_um "Fehlerz‰hler des TPU-Code-RAM-Tests in der Funktions¸berwachung" UBYTE dez 1 100 0 255 FORMAT "%5.1" ECU_ADDRESS 0x3F982A /end MEASUREMENT
/begin MEASUREMENT tpucr_c_ur "Doppelablage (DA) f¸r TPUCR_C_UM" UBYTE dez 1 100 0 255 FORMAT "%5.1" ECU_ADDRESS 0x3F994F /end MEASUREMENT
/begin MEASUREMENT tpura_c_um "Z‰hler f¸r TPU-Code-RAM-Test aktiv in der Funktions¸berwachung" UBYTE t10ms_ub_b2550 1 100 0 2550 ECU_ADDRESS 0x3F982B /end MEASUREMENT
/begin MEASUREMENT tpura_c_ur "Doppelablage (DA) f¸r TPURA_C_UM" UBYTE dez 1 100 0 255 FORMAT "%5.1" ECU_ADDRESS 0x3F9950 /end MEASUREMENT
/begin MEASUREMENT tpurstc_um "Z‰hler im DauerRAM f¸r Resets aus der TPU-‹berwachung" UBYTE dez 1 100 0 255 FORMAT "%5.1" ECU_ADDRESS 0x3FDEC5 /end MEASUREMENT
/begin MEASUREMENT tpust_c_um "TPU-Start-Zeitz‰hler zur Aktivierung TPU-‹berwachung nach Synchronisation" UBYTE t10ms_ub_b2550 1 100 0 2550 ECU_ADDRESS 0x3F982C /end MEASUREMENT
/begin MEASUREMENT tpust_c_ur "Doppelablage (DA) f¸r TPUST_C_UM" UBYTE dez 1 100 0 255 FORMAT "%5.1" ECU_ADDRESS 0x3F9951 /end MEASUREMENT
/begin MEASUREMENT tpu_c_um "Fehlerz‰hler der TPU-‹berwachung in der Funktions¸berwachung" UBYTE dez 1 100 0 255 FORMAT "%5.1" ECU_ADDRESS 0x3F982D /end MEASUREMENT
/begin MEASUREMENT tpu_c_ur "Doppelablage (DA) f¸r TPU_C_UM" UBYTE dez 1 100 0 255 FORMAT "%5.1" ECU_ADDRESS 0x3F9952 /end MEASUREMENT
/begin MEASUREMENT tseg_um "Segmentzeit aus Differenz der Timerst‰nde aus dem Sync in der FU" ULONG txms_uw_q0p0004 1 100 0 1.71799e+006 FORMAT "%13.5" ECU_ADDRESS 0x3F9A14 /end MEASUREMENT
/begin MEASUREMENT tsm_alt_um "Timerwert des Sys.timers an vorhergeher Synchronmarke aus Sync-Raster in der FU" ULONG txms_uw_q0p0004 1 100 0 1.71799e+006 FORMAT "%13.5" ECU_ADDRESS 0x3F9964 /end MEASUREMENT
/begin MEASUREMENT tsm_um "Timerwert des Systemtimers an Synchronmarke aus Sync-Raster in der FU" ULONG txms_uw_q0p0004 1 100 0 1.71799e+006 FORMAT "%13.5" ECU_ADDRESS 0x3F9968 /end MEASUREMENT
/begin MEASUREMENT ttimout "" UWORD dez 1 100 0 65535 FORMAT "%8.2" ECU_ADDRESS 0x3FE934 /end MEASUREMENT
/begin MEASUREMENT tweiter "" UWORD dez 1 100 0 65535 FORMAT "%8.2" ECU_ADDRESS 0x3FE936 /end MEASUREMENT
/begin MEASUREMENT twuerg "" UWORD dez 1 100 0 65535 FORMAT "%8.2" ECU_ADDRESS 0x3FE938 /end MEASUREMENT
/begin MEASUREMENT txdmtrf "Zeit-Z‰hler f¸r erste Referenzmessung" UWORD t_q0p1 1 100 0 6553.5 FORMAT "%8.3" ECU_ADDRESS 0x3FE31E /end MEASUREMENT
/begin MEASUREMENT txdmtrf2 "Zeit-Z‰hler f¸r zweite Referenzmessung" UWORD t_q0p1 1 100 0 6553.5 FORMAT "%8.3" ECU_ADDRESS 0x3FE320 /end MEASUREMENT
/begin MEASUREMENT txdmtrfm "Zeit-Z‰hler f¸r Leerlaufstromerfassung (Strom-Minimum)" UWORD t_q0p1 1 100 0 6553.5 FORMAT "%8.3" ECU_ADDRESS 0x3FE322 /end MEASUREMENT
/begin MEASUREMENT t_flags_um "Byte f¸r Tempomat-Bits der Funktions¸berwachung" UBYTE dez 1 100 0 255 FORMAT "%5.1" ECU_ADDRESS 0x3F988A /end MEASUREMENT
/begin MEASUREMENT ugen "phys. Wert Generatorsollspannung (Volt) f¸r Komponententreiber Generator" UBYTE spg_ugen 1 100 10.6 36.1 FORMAT "%5.2" ECU_ADDRESS 0x4039AF /end MEASUREMENT
/begin MEASUREMENT ugen2 "Generatorsollspannung" UBYTE spg_ugen 1 100 10.6 36.1 FORMAT "%5.2" ECU_ADDRESS 0x4039B0 /end MEASUREMENT
/begin MEASUREMENT ugloc "" SWORD spg_sw_q0p001 1 100 0 30 FORMAT "%8.5" ECU_ADDRESS 0x4034A8 /end MEASUREMENT
/begin MEASUREMENT ugsoll "Generatorsollspannung Basis" UWORD spg_sw_q0p001 1 100 0 16 FORMAT "%8.5" ECU_ADDRESS 0x4034AA /end MEASUREMENT
/begin MEASUREMENT ugsollred "reduzierte Generatorsollspannung" UWORD spg_sw_q0p001 1 100 0 16 FORMAT "%8.5" ECU_ADDRESS 0x4034AC /end MEASUREMENT
/begin MEASUREMENT ugsolltmp "reduzierte Zwischengeneratorsollspannung" UWORD spg_sw_q0p001 1 100 0 16 FORMAT "%8.5" ECU_ADDRESS 0x4034AE /end MEASUREMENT
/begin MEASUREMENT umerr_c_um "Fehlerz‰hler-R¸ckmeldung des UM in der Funktions¸berwachung" UBYTE dez 1 100 0 255 FORMAT "%5.1" ECU_ADDRESS 0x403AD0 /end MEASUREMENT
/begin MEASUREMENT umrst_c_um "Z‰hler im Dauer-RAM f¸r Software-Reset (Diagnose) aus %UMKOM" UBYTE dez 1 100 0 255 FORMAT "%5.1" ECU_ADDRESS 0x3FDECC /end MEASUREMENT
/begin MEASUREMENT upwg2_um "Spannung PWG-Poti2 im ADC-Test in der Funktions¸berwachung" UWORD spg_q0p00977 1 100 0 639.99 FORMAT "%8.4" ECU_ADDRESS 0x3F9944 /end MEASUREMENT
/begin MEASUREMENT uramp "" SWORD spg_sw_q0p001 1 100 0 30 FORMAT "%8.5" ECU_ADDRESS 0x4034B0 /end MEASUREMENT
/begin MEASUREMENT urmcksco "Checksumme ¸ber Code der Funktions¸berwachung im zyklischen ROM-Test" UWORD dez 1 100 0 65535 FORMAT "%8.2" ARRAY_SIZE 2 ECU_ADDRESS 0x3FDEB4 /end MEASUREMENT
/begin MEASUREMENT urmcksda "Checksumme ¸ber Daten der Funktions¸berwachung im zyklischen ROM-Test" UWORD dez 1 100 0 65535 FORMAT "%8.2" ARRAY_SIZE 2 ECU_ADDRESS 0x3FDEB8 /end MEASUREMENT
/begin MEASUREMENT urmpatco "Patch-Adresse im Code der Funktions¸berwachung f¸r ‹berpr¸fung zykl. ROM-Test" UWORD dez 1 100 0 65535 FORMAT "%8.2" ARRAY_SIZE 2 ECU_ADDRESS 0x3F9824 /end MEASUREMENT
/begin MEASUREMENT vabsch_w "Vmax-Regler-Abschaltschwelle, variantencodiert" UWORD vfzg_uw_q0p00781 1 100 0 511.992 FORMAT "%8.4" ECU_ADDRESS 0x4030FC /end MEASUREMENT
/begin MEASUREMENT vfzgpr_w "Pr‰dizierte Fahrzeuggeschwindigkeit f¸r VMAX-Regelung" UWORD vfzg_uw_q0p00781 1 100 0 511.992 FORMAT "%8.4" ECU_ADDRESS 0x4030FE /end MEASUREMENT
/begin MEASUREMENT vhyst_w "Vmax-Hystereseschwelle, variantencodiert" UWORD vfzg_uw_q0p00781 1 100 0 511.992 FORMAT "%8.4" ECU_ADDRESS 0x403100 /end MEASUREMENT
/begin MEASUREMENT vkpedch_um "Variantenkriterium f¸r Pedal-Charakteristik in der Funktions¸berwachung" UBYTE dez 1 100 0 255 FORMAT "%5.1" ECU_ADDRESS 0x3F992B /end MEASUREMENT
/begin MEASUREMENT vkpedch_ur "Doppelablage (DA) f¸r VKPEDCH_UM" UBYTE dez 1 100 0 255 FORMAT "%5.1" ECU_ADDRESS 0x3F9A1C /end MEASUREMENT
/begin MEASUREMENT vmaxidx "VMAX-Index f¸r SST-Verteilung" UBYTE dez 1 100 0 255 FORMAT "%5.1" ECU_ADDRESS 0x4030EC /end MEASUREMENT
/begin MEASUREMENT vmaxo_w "Vmax-Begrenzungswert, variantencodiert" UWORD vfzg_uw_q0p00781 1 100 0 511.992 FORMAT "%8.4" ECU_ADDRESS 0x403102 /end MEASUREMENT
/begin MEASUREMENT vmaxpr "P-Glied f¸r Vmax-Regelung, variantencodiert" UBYTE rel_ub_q0p391 1 100 0 99.705 FORMAT "%5.2" ECU_ADDRESS 0x4030ED /end MEASUREMENT
/begin MEASUREMENT vvorh_w "Vmax-Vorhaltschwelle, variantencodiert" UWORD vfzg_uw_q0p00781 1 100 0 511.992 FORMAT "%8.4" ECU_ADDRESS 0x403104 /end MEASUREMENT
/begin MEASUREMENT vvtalern "VVT Anschlaglernen (Bank 1) unverzˆgert" UBYTE DEZ 1 100 0 255 FORMAT "%5.1" ECU_ADDRESS 0x4038E5 /end MEASUREMENT
/begin MEASUREMENT vvtalern2 "VVT Anschlaglernen (Bank 2) unverzˆgert" UBYTE DEZ 1 100 0 255 FORMAT "%5.1" ECU_ADDRESS 0x4038E6 /end MEASUREMENT
/begin MEASUREMENT vvtchkal "Anschlaege lernen aus Vergleich Abstellposition" UBYTE DEZ 1 100 0 255 FORMAT "%5.1" ECU_ADDRESS 0x3FE14E /end MEASUREMENT
/begin MEASUREMENT vvtchke "Abstellposition pruefen" UBYTE DEZ 1 100 0 255 FORMAT "%5.1" ECU_ADDRESS 0x4038E7 /end MEASUREMENT
/begin MEASUREMENT vvtchkem "Abgespeicherte Abstellposition" UWORD rel_b99p9985 1 100 0 99.9985 FORMAT "%8.5" ECU_ADDRESS 0x3FE146 /end MEASUREMENT
/begin MEASUREMENT vvtchkem2 "Abgespeicherte Abstellposition Bank 2" UWORD rel_b99p9985 1 100 0 99.9985 FORMAT "%8.5" ECU_ADDRESS 0x3FE148 /end MEASUREMENT
/begin MEASUREMENT vvtchkemok "Abgespeicherte Abstellposition okay" UBYTE DEZ 1 100 0 255 FORMAT "%5.1" ECU_ADDRESS 0x3FE14F /end MEASUREMENT
/begin MEASUREMENT vvtcntal "Anzahl der erforderlichen Anschlaglernvorgaenge" UWORD DEZ 1 100 0 65535 FORMAT "%8.2" ECU_ADDRESS 0x3FE14A /end MEASUREMENT
/begin MEASUREMENT vvtcntal2 "Anzahl der erforderlichen Anschlaglernvorgaenge Bank 2" UWORD DEZ 1 100 0 65535 FORMAT "%8.2" ECU_ADDRESS 0x3FE14C /end MEASUREMENT
/begin MEASUREMENT vvtfkt "VVT Basisfunktion" UBYTE DEZ 1 100 0 255 FORMAT "%5.1" ECU_ADDRESS 0x4038E8 /end MEASUREMENT
/begin MEASUREMENT vvtilern "VVT Anschlaglernen (Bank 1) intern" UBYTE DEZ 1 100 0 255 FORMAT "%5.1" ECU_ADDRESS 0x4038E9 /end MEASUREMENT
/begin MEASUREMENT vvtilern2 "VVT Anschlaglernen (Bank 2) intern" UBYTE DEZ 1 100 0 255 FORMAT "%5.1" ECU_ADDRESS 0x4038EA /end MEASUREMENT
/begin MEASUREMENT vvtlernan "VVT Anschlaege lernen" UBYTE DEZ 1 100 0 255 FORMAT "%5.1" ECU_ADDRESS 0x4038EB /end MEASUREMENT
/begin MEASUREMENT vvtlernan2 "VVT Anschlaege lernen Bank 2" UBYTE DEZ 1 100 0 255 FORMAT "%5.1" ECU_ADDRESS 0x4038EC /end MEASUREMENT
/begin MEASUREMENT vvtper_w "Periodendauer bei Ansteuerung VVT Enable" UBYTE txms_ub_q0p1 1 100 2 10 FORMAT "%5.2" ECU_ADDRESS 0x4038ED /end MEASUREMENT
/begin MEASUREMENT vvt_c_um "Entprellz‰hler zur Absicherung der VVT-Information" UBYTE t40ms_ub_b10200 1 100 0 10200 FORMAT "%7.1" ECU_ADDRESS 0x3F9865 /end MEASUREMENT
/begin MEASUREMENT vvt_c_ur "Doppelablage (DA) f¸r VVT_C_UM" UBYTE dez 1 100 0 255 FORMAT "%5.1" ECU_ADDRESS 0x3F999E /end MEASUREMENT
/begin MEASUREMENT vvt_sw2old "Sollwert (compare) Exzenterwinkel VVT Bank2" UWORD rel_b99p9985 1 100 0 99.9985 FORMAT "%8.5" ECU_ADDRESS 0x402D38 /end MEASUREMENT
/begin MEASUREMENT vvt_swold "Sollwert (compare) Exzenterwinkel VVT" UWORD rel_b99p9985 1 100 0 99.9985 FORMAT "%8.5" ECU_ADDRESS 0x402D3A /end MEASUREMENT
/begin MEASUREMENT watch_error "" SBYTE dez 1 100 -128 127 FORMAT "%5.1" ECU_ADDRESS 0x403821 /end MEASUREMENT
/begin MEASUREMENT watch_state "" SBYTE dez 1 100 -128 127 FORMAT "%5.1" ECU_ADDRESS 0x403822 /end MEASUREMENT
/begin MEASUREMENT wc_fctr "" UBYTE dez 1 100 0 255 FORMAT "%5.1" ECU_ADDRESS 0x4036FD /end MEASUREMENT
/begin MEASUREMENT wdkdpsad "Winkel Drosselklappe aus WDKADP" SWORD rel_uw_b100 1 100 -50 49.9985 FORMAT "%8.5" ECU_ADDRESS 0x40463E /end MEASUREMENT
/begin MEASUREMENT wes "Winkelmarke Einlass schliesst bezogen auf Z¸nd-OT Zylinder 1" UBYTE kw_q3 1 100 0 765 FORMAT "%5.1" ECU_ADDRESS 0x403909 /end MEASUREMENT
/begin MEASUREMENT wesnesprau "Ausgang aus Kennlinie WESNESPR" UWORD kw_q3 1 100 0 196605 FORMAT "%8.1" ECU_ADDRESS 0x40466A /end MEASUREMENT
/begin MEASUREMENT wphg "Z¸ndwinkel DG-Phasenkorrektur" SBYTE zw_sb_q0p75 1 100 -96 95.25 FORMAT "%5.2" ECU_ADDRESS 0x403D2A /end MEASUREMENT
/begin MEASUREMENT wri_c_um "Fehlerz‰hler im Dauer-RAM f¸r RAM-Beschreibbarkeits-Pr¸fung (Diagnose) in der FU" UBYTE dez 1 100 0 255 FORMAT "%5.1" ECU_ADDRESS 0x3FDECD /end MEASUREMENT
/begin MEASUREMENT zadmtlAusBits "" UBYTE dez 1 100 0 255 FORMAT "%5.1" ECU_ADDRESS 0x40368B /end MEASUREMENT
/begin MEASUREMENT zadmtlAusBitsNov "" UBYTE dez 1 100 0 255 FORMAT "%5.1" ECU_ADDRESS 0x3FE325 /end MEASUREMENT
/begin MEASUREMENT zadmtlAusBitsNov2 "" UBYTE dez 1 100 0 255 FORMAT "%5.1" ECU_ADDRESS 0x3FE326 /end MEASUREMENT
/begin MEASUREMENT zadmtlAusBitsNov3 "" UBYTE dez 1 100 0 255 FORMAT "%5.1" ECU_ADDRESS 0x3FE327 /end MEASUREMENT
/begin MEASUREMENT zadmtlLokBits "" UBYTE dez 1 100 0 255 FORMAT "%5.1" ECU_ADDRESS 0x40368C /end MEASUREMENT
/begin MEASUREMENT zivmaxr "I-Steigung f¸r Vmax-Regelung, variantencodiert" UBYTE zk100msxs_ub_b25p5 1 100 0.100392 25.6 FORMAT "%7.4" ECU_ADDRESS 0x4030EE /end MEASUREMENT
/begin MEASUREMENT znachanz "Anzahl der Z¸ndungen im Nachlauf" UBYTE dez 1 100 0 255 FORMAT "%5.1" ECU_ADDRESS 0x3FC3D9 /end MEASUREMENT
/begin MEASUREMENT zsync_um "Kennung f¸r Synchronisation in der Funktions¸berwachung" UBYTE dez 1 100 0 255 FORMAT "%5.1" ECU_ADDRESS 0x3F9A0B /end MEASUREMENT
/begin MEASUREMENT zsync_ur "1-er Komplement zur Kennung f¸r Synchronisation in der Funktions¸berwachung" UBYTE dez 1 100 0 255 FORMAT "%5.1" ECU_ADDRESS 0x3F9A0C /end MEASUREMENT
/begin MEASUREMENT zsytp1_um "Kennung1 f¸r fehlendes Synchro" UBYTE dez 1 100 0 255 FORMAT "%5.1" ECU_ADDRESS 0x3F9953 /end MEASUREMENT
/begin MEASUREMENT zsytp2_um "Kennung2 f¸r fehlendes Synchro" UBYTE dez 1 100 0 255 FORMAT "%5.1" ECU_ADDRESS 0x3F9954 /end MEASUREMENT
/begin MEASUREMENT zw1_um "Ausgabe-Z¸ndwinkel ohne Lambakorrekturen (1.Bank)  in der Funktions¸berwachung" SBYTE zw_sb_q0p75 1 100 -96 95.25 FORMAT "%5.2" ECU_ADDRESS 0x3F992D /end MEASUREMENT
/begin MEASUREMENT zw1_ur "Doppelablage (DA) f¸r ZW1_UM" SBYTE dez 1 100 -128 127 FORMAT "%5.1" ECU_ADDRESS 0x3F9A1D /end MEASUREMENT
/begin MEASUREMENT zw2_um "Ausgabe-Z¸ndwinkel (2.Bank) ohne Lambakorrekturen  in der Funktions¸berwachung" SBYTE zw_sb_q0p75 1 100 -96 95.25 FORMAT "%5.2" ECU_ADDRESS 0x3F992E /end MEASUREMENT
/begin MEASUREMENT zw2_ur "Doppelablage (DA) f¸r ZW2_UM" SBYTE dez 1 100 -128 127 FORMAT "%5.1" ECU_ADDRESS 0x3F9A1E /end MEASUREMENT
/begin MEASUREMENT zwbas "Basisz¸ndwinkel" SBYTE zw_sb_q0p75 1 100 -96 95.25 FORMAT "%5.2" ECU_ADDRESS 0x3FC3DA /end MEASUREMENT
/begin MEASUREMENT zwbasar "Basisz¸ndwinkelarray" SBYTE zw_sb_q0p75 1 100 -96 95.25 FORMAT "%5.2" ARRAY_SIZE 4 ECU_ADDRESS 0x403D2B /end MEASUREMENT
/begin MEASUREMENT zwc_c_um "Fehlerz‰hler f¸r Z¸ndwinkel¸berwachung in der Funktions¸berwachung" UBYTE dez 1 100 0 255 FORMAT "%5.1" ECU_ADDRESS 0x3F992F /end MEASUREMENT
/begin MEASUREMENT zwc_c_ur "Doppelablage (DA) f¸r ZWC_C_UM" UBYTE dez 1 100 0 255 FORMAT "%5.1" ECU_ADDRESS 0x3F9A1F /end MEASUREMENT
/begin MEASUREMENT zwdyn "Z¸ndwinkel Dynamikvorhalt" SBYTE zw_sb_q0p75 1 100 -96 95.25 FORMAT "%5.2" ECU_ADDRESS 0x403D3F /end MEASUREMENT
/begin MEASUREMENT zwgru "Grundz¸ndwinkel" SBYTE zw_sb_q0p75 1 100 -96 95.25 FORMAT "%5.2" ECU_ADDRESS 0x403D40 /end MEASUREMENT
/begin MEASUREMENT zwist "Ist-Z¸ndwinkel" SBYTE zw_sb_q0p75 1 100 -96 95.25 FORMAT "%5.2" ECU_ADDRESS 0x3FC3DB /end MEASUREMENT
/begin MEASUREMENT zwkrafld "Bitmuster des zyl.ind. abgelegten B_zwkra" UBYTE dez 1 100 0 255 FORMAT "%5.1" ECU_ADDRESS 0x3FC3DC /end MEASUREMENT
/begin MEASUREMENT zwkrdyn "" SBYTE zw_sb_q0p75 1 100 -96 95.25 FORMAT "%5.2" ECU_ADDRESS 0x403D41 /end MEASUREMENT
/begin MEASUREMENT zwks "abs. Z¸ndwinkel aus %KS_W bzw. %ZWKS" SBYTE zw_sb_q0p75 1 100 -96 95.25 FORMAT "%5.2" ECU_ADDRESS 0x403D45 /end MEASUREMENT
/begin MEASUREMENT zwll "" SBYTE zw_sb_q0p75 1 100 -96 95.25 FORMAT "%5.2" ECU_ADDRESS 0x403D42 /end MEASUREMENT
/begin MEASUREMENT zwmn "Sp‰tester Z¸ndwinkel" SBYTE zw_sb_q0p75 1 100 -96 95.25 FORMAT "%5.2" ECU_ADDRESS 0x403D48 /end MEASUREMENT
/begin MEASUREMENT zwmnd "dynamisch sp‰test zul‰ssiger Z¸ndwinkel" SBYTE zw_sb_q0p75 1 100 -96 95.25 FORMAT "%5.2" ECU_ADDRESS 0x403D49 /end MEASUREMENT
/begin MEASUREMENT zwmnms "dauerhaft sp‰test mˆglicher Z¸ndwinkel" SBYTE zw_sb_q0p75 1 100 -96 95.25 FORMAT "%5.2" ECU_ADDRESS 0x403D4A /end MEASUREMENT
/begin MEASUREMENT zwnst "" SBYTE zw_sb_q0p75 1 100 -96 95.25 FORMAT "%5.2" ECU_ADDRESS 0x403D4B /end MEASUREMENT
/begin MEASUREMENT zwout "Z¸ndwinkel-Ausgabe" SBYTE zw_sb_q0p75 1 100 -96 95.25 FORMAT "%5.2" ECU_ADDRESS 0x3FC3DD /end MEASUREMENT
/begin MEASUREMENT zwoutar "Z¸ndwinkel-Ausgabe Array" SBYTE zw_sb_q0p75 1 100 -96 95.25 FORMAT "%5.2" ARRAY_SIZE 4 ECU_ADDRESS 0x403D2F /end MEASUREMENT
/begin MEASUREMENT zwoutcpl "Einerkomplement des Z¸ndwinkels f¸r die Funktions¸berwachung" SBYTE zw_sb_q0p75 1 100 -96 95.25 FORMAT "%5.2" ECU_ADDRESS 0x403D33 /end MEASUREMENT
/begin MEASUREMENT zwoutzyl "Aktueller Z¸ndwinkel aller Zylinder" SBYTE zw_sb_q0p75 1 100 -96 95.25 FORMAT "%5.2" ARRAY_SIZE 8 ECU_ADDRESS 0x403D34 /end MEASUREMENT
/begin MEASUREMENT zwspae "Sp‰tester Z¸ndwinkel" SBYTE zw_sb_q0p75 1 100 -96 95.25 FORMAT "%5.2" ECU_ADDRESS 0x403D4C /end MEASUREMENT
/begin MEASUREMENT zwstt "Z¸ndwinkel im Start" SBYTE zw_sb_q0p75 1 100 -96 95.25 FORMAT "%5.2" ECU_ADDRESS 0x403D4D /end MEASUREMENT
/begin MEASUREMENT zwtdo_aus "" SBYTE zw_sb_q0p75 1 100 -96 95.25 FORMAT "%5.2" ECU_ADDRESS 0x403D43 /end MEASUREMENT
/begin MEASUREMENT zwzyl1 "Z¸ndwinkel Zylinder 1" SBYTE zw_sb_q0p75 1 100 -96 95.25 FORMAT "%5.2" ECU_ADDRESS 0x403D3C /end MEASUREMENT
/begin MEASUREMENT z_flags_um "Byte f¸r Status-Bits beim 2-SG-Konzept in der Funktions¸berwachung" UBYTE dez 1 100 0 255 FORMAT "%5.1" ECU_ADDRESS 0x3F988B /end MEASUREMENT
/begin FUNCTION UFMZUL "16.20     EGAS ‹berwachungskonzept: zul‰ssiges Moment der Funktions¸berwachung"
 /begin DEF_CHARACTERISTIC KFDMP0_UM KFDMP1_UM KFDMT0_UM KFDMT1_UM KFMOF_UM KFPZU0_UM KFPZU1_UM KLLLRZU_UM KLMIMAX_UM KLMIMIN_UM KLMZUMN_UM MDV08_UM SPSNLL_UM TMOMIN_UM TMOV08_UM /end DEF_CHARACTERISTIC
 /begin REF_CHARACTERISTIC NMV08_UM SPSNV08_UM /end REF_CHARACTERISTIC
 /begin IN_MEASUREMENT mfgr_um mmsr_um modul_c_um mrlini_um msgs_um nmot_um nmst08_um raster_um spnst08_um spsn_um tmot_um vkpedch_um /end IN_MEASUREMENT
 /begin OUT_MEASUREMENT B_klmzu_um mzo_um mz_um /end OUT_MEASUREMENT
 /begin LOC_MEASUREMENT mdst08_um mdst08_ur mped_um mzo_ur mz_ur tmost08_um tmost08_ur tmotmn_um tmotmn_ur /end LOC_MEASUREMENT
/end FUNCTION
/begin FUNCTION UFNC "4.40      EGAS ‹berwachungskonzept: N-‹berwachung f¸r die Funktions¸berwachung"
 /begin DEF_CHARACTERISTIC NC_T_UM NDIFFO_UM NDIFFU_UM NMIN_UM NMV08_UM NSEGMAX_UM NTSCHW_UM TSEGMIN_UM /end DEF_CHARACTERISTIC
 /begin REF_CHARACTERISTIC ZYLANZ_UM /end REF_CHARACTERISTIC
 /begin IN_MEASUREMENT B_i_ska_um modul_c_um nmot raster_um tsm_alt_um tsm_um /end IN_MEASUREMENT
 /begin OUT_MEASUREMENT ei_nc_um nmot_um nmst08_um zsync_um zsync_ur /end OUT_MEASUREMENT
 /begin LOC_MEASUREMENT nc_c_um nc_c_ur nmot_ur nmst08_ur nseg_um tseg_um /end LOC_MEASUREMENT
/end FUNCTION
/begin FUNCTION UFNSC "5.40      EGAS ‹berwachungskonzept: Nachstart¸berwachung f¸r die Funktions¸berwachung"
 /begin DEF_CHARACTERISTIC NSC_T_UM NSOF_T_UM N_START_UM N_STEND_UM TANSMN_UM TMNSMN_UM /end DEF_CHARACTERISTIC
 /begin IN_MEASUREMENT modul_c_um nmot_um raster_um tans tmot /end IN_MEASUREMENT
 /begin OUT_MEASUREMENT B_mzns_um nsc_c_um tmot_um /end OUT_MEASUREMENT
 /begin LOC_MEASUREMENT nsc_c_ur nsof_c_um nsof_c_ur tmot_ur /end LOC_MEASUREMENT
/end FUNCTION
/begin FUNCTION UFREAC "5.40      EGAS ‹berwachungskonzept: Fehlerreaktions¸berw.d.Funktions¸berwachung" /begin DEF_CHARACTERISTIC KLNPED_UM REAC_T1_UM REAC_T2_UM SKADRHZ_UM /end DEF_CHARACTERISTIC /begin IN_MEASUREMENT B_i_ska_um evz_austot modul_c_um nmot_um raster_um spsn_um /end IN_MEASUREMENT /begin OUT_MEASUREMENT ei_reac_um /end OUT_MEASUREMENT
 /begin LOC_MEASUREMENT fuel_co_um fuel_co_ur nska_um reac_c1_um reac_c1_ur reac_c2_um reac_c2_ur /end LOC_MEASUREMENT
/end FUNCTION
/begin FUNCTION UFRKC "5.10      Kraftstoffsignal¸berw. auf Basis Lambda f¸r Funktions¸berwachung" /begin IN_MEASUREMENT modul_c_um raster_um /end IN_MEASUREMENT /begin OUT_MEASUREMENT ei_rkc_um frksch_um lamb1_um lamb2_um mrlini_um /end OUT_MEASUREMENT /begin LOC_MEASUREMENT frksch_ur lamb1_ur lamb2_ur mrlini_ur /end LOC_MEASUREMENT /end FUNCTION
/begin FUNCTION UFRLC "7.60      EGAS ‹berwachungskonzept: Lastsignal¸berw. f¸r Funktions¸berwachung"
 /begin DEF_CHARACTERISTIC DPIPFIL_UM DPIPTV_UM DPS_T_UM EVHUBMX_UM HUBV08_UM IP1A_MX_UM IP2A_MN_UM IPA_T_UM IPSNV08_UM KFDPIP_UM KFLVVTM_UM KFLVVT_UM KFRLDP_UM KFRLNM1_UM KFRLNM2_UM KFRLNM3_UM KFRLNM4_UM KFRLNM5_UM KFRLNM6_UM KUMSRL_UM NMOT1_UM NMOT2_UM NMOT3_UM NMOT4_UM NMOT5_UM NMOT6_UM NRLIP_UM RLC_T_UM RLDFIL_UM RLDPFIL_UM RLDPTV_UM RLDTV_UM RLIP_T_UM RLV08_UM RLVT_BO_UM RLVT_MO_UM RL_BO_UM RL_MO_UM VVT_T_UM /end DEF_CHARACTERISTIC
 /begin IN_MEASUREMENT B_ehfs B_i_ska_um B_wdk2sel dps_w evhbi2_w evhbi_w modul_c_um nmot_um raster_um rl rl_w udkp1a udkp2a /end IN_MEASUREMENT
 /begin OUT_MEASUREMENT B_rldif_um ei_dps_um ei_ipa_um ei_rlc_um ei_rlip_um ei_vvt_um hubst08_um ipnst08_um rlst08_um rl_um /end OUT_MEASUREMENT
 /begin LOC_MEASUREMENT dpipf_l_um dpipf_l_ur dpipf_p_um dpipf_p_ur dpipf_r_um dpipf_r_ur dpipf_um dpipf_ur dpip_um dps_c_um dps_c_ur dps_um dps_ur evhubim_um evhubim_ur evhubi_um evhubi_ur fwkor_um fwnm_um hubst08_ur ipa_c_um ipa_c_ur ipnst08_ur ipsn_um ipsn_ur rlc_c_um rlc_c_ur rldf_l_um rldf_l_ur rldf_p_um rldf_p_ur rldf_r_um rldf_r_ur rldf_um rldf_ur rldif_um rldpf_l_um rldpf_l_ur rldpf_p_um rldpf_p_ur rldpf_r_um rldpf_r_ur rldpf_um rldpf_ur rldpzo_um rldp_um rld_um rlip_c_um rlip_c_ur rlnmo_um rlnmu_um rlst08_ur rlvvtzo_um rlvvt_um rlzo_um rl_ur rl_w_um vvt_c_um vvt_c_ur /end LOC_MEASUREMENT
/end FUNCTION
/begin FUNCTION UFSGSC "26.10     EGAS ‹berwachungskonzept: SGS-Eingriff-‹berwachung f¸r die Funktions¸bersicht" /begin DEF_CHARACTERISTIC DBEGSMX_UM DBEGS_T_UM SGSC_T_UM /end DEF_CHARACTERISTIC
 /begin IN_MEASUREMENT B_nosgs_fr codcan codcan_um codget misgs misgscpl modul_c_um raster_um /end IN_MEASUREMENT
 /begin OUT_MEASUREMENT B_mdegs_um B_nosgs_um B_npegs_um B_siegs_um can_id_um egsstat_um egstemp_um ei_sgsc_um mksges_um mksgs_um mkswand_um msgs_um /end OUT_MEASUREMENT
 /begin LOC_MEASUREMENT bz_egsa_um bz_egsa_ur dbegs_c_um dbegs_c_ur msgs_ur sgsc_c_um sgsc_c_ur /end LOC_MEASUREMENT
/end FUNCTION
/begin FUNCTION UFSPSC "6.20      EGAS ‹berwachungskonzept: Pedal-Sollwert-‹. f¸r Funktions¸berwachung"
 /begin DEF_CHARACTERISTIC SP12LL_UM SP12VG_UM SPSC_MINUM SPSC_T_UM SPSNV08_UM SPSVG_UM /end DEF_CHARACTERISTIC
 /begin IN_MEASUREMENT B_i_ska_um B_pwgnotfr B_sp1s B_sp2s B_spsmin modul_c_um raster_um /end IN_MEASUREMENT
 /begin OUT_MEASUREMENT B_pwgnotum ei_spsc_um spnst08_um spsn_um /end OUT_MEASUREMENT
 /begin LOC_MEASUREMENT sp1s_um sp2s_um spnst08_ur spsc_c_um spsc_c_ur spsn_ur /end LOC_MEASUREMENT
/end FUNCTION
/begin FUNCTION UFURAM "" /begin DEF_CHARACTERISTIC CW_BDE_UM /end DEF_CHARACTERISTIC
 /begin OUT_MEASUREMENT b_flags_um B_i_ska_um c_flags_um n_flags_um ram_c_um reac_c_um romz_c_um r_flags_um srst_c_um s_flags_um t_flags_um umrst_c_um wri_c_um z_flags_um /end OUT_MEASUREMENT
 /begin LOC_MEASUREMENT B_accmx_um B_accpc_um B_blspc_um B_brems_um B_brfgr_um B_bsl_um B_dcdis_um B_fgrea_um B_fgrpc_um B_fgr_umc B_i_ska B_khls_um B_kkl_um B_msrmx_um B_msrpc_um B_msthw_um B_naccf_um B_nlhr_um B_nlh_um B_notlu B_nsakt_um B_nsend_um B_reaci_um B_rlini_um B_rluf_um B_sgsmx_um B_sgspc_um B_srstz_um B_srst_um B_tpu_um B_ub_ska B_ufolv_um B_ufol_um B_vzl_um B_wal_um reset_indication_um /end LOC_MEASUREMENT
/end FUNCTION
/begin FUNCTION UFVARC "3.10      EGAS ‹berwachungskonzept: Variantencodierungs¸berwachung der Funktions¸berwachg." /begin IN_MEASUREMENT modul_c_um raster_um /end IN_MEASUREMENT /begin OUT_MEASUREMENT ei_varc_um vkpedch_um /end OUT_MEASUREMENT /begin LOC_MEASUREMENT vkpedch_ur /end LOC_MEASUREMENT /end FUNCTION
/begin FUNCTION UFZWC "11.10     EGAS ‹berwachungskonzept: ZW-‹berwachung f¸r Funktions¸berwachung" /begin DEF_CHARACTERISTIC ZWC_T_UM ZYLANZ_UM /end DEF_CHARACTERISTIC /begin IN_MEASUREMENT B_i_ska_um modul_c_um raster_um zwout zwoutcpl /end IN_MEASUREMENT /begin OUT_MEASUREMENT ei_zwc_um zw1_um zw2_um /end OUT_MEASUREMENT /begin LOC_MEASUREMENT zw1_ur zw2_ur zwc_c_um zwc_c_ur /end LOC_MEASUREMENT /end FUNCTION
/begin FUNCTION UGENKOR "1.110     Generator- Spannungsanhebung"
 /begin DEF_CHARACTERISTIC B_APP_UGEN CW_BNSUMAX ENGENTOGGL GENOFFTIME GENUMAX GENURAMP GENURAMPOF GEN_APP_UG S_GOFFRAMP T_VERB_ON UBNS UGENDELTA UGENOFF UGENOFFV0 /end DEF_CHARACTERISTIC
 /begin IN_MEASUREMENT B_bns B_crashgen B_genslp B_nmot B_ulcp ctrgenms ctrgenutar lv_var_bn lv_var_veh ugenslp uibs vfzg /end IN_MEASUREMENT
 /begin OUT_MEASUREMENT B_genoff B_genoff2 B_genoffmd B_genoffok B_gentoggl B_noctrgen B_verb_off ugen ugen2 ugsoll ugsollred ugsolltmp /end OUT_MEASUREMENT
 /begin LOC_MEASUREMENT B_1stugen ugloc uramp /end LOC_MEASUREMENT
/end FUNCTION
/begin FUNCTION UK2LNK "" /end FUNCTION
/begin FUNCTION UK2LNK_GTW "" /begin DEF_CHARACTERISTIC RoutingAddrTable_cu8 RoutingTableHeader_cu8 /end DEF_CHARACTERISTIC /end FUNCTION
/begin FUNCTION UMAUSC "2.20      EGAS ‹berwachungskonzept: Abschaltpfadtest ‹berwachungsmodul" /begin DEF_CHARACTERISTIC AUSCH_T_UM AUSC_T_UM /end DEF_CHARACTERISTIC
 /begin IN_MEASUREMENT B_i_ska_um B_norm B_nxtrp_um B_ubdve evz_austot e_mem_um frtar_c_um mem_ur newqu_um nxtrp_ur plstate_um plstate_ur umerr_c_um /end IN_MEASUREMENT
 /begin OUT_MEASUREMENT auscf_c_um ausch_c_um ausc_c_um ausc_ur B_ausc_act B_ausc_um B_ausc_wda B_nxptr_um ei_ubr_um /end OUT_MEASUREMENT
 /begin LOC_MEASUREMENT hwError_um /end LOC_MEASUREMENT
/end FUNCTION
/begin FUNCTION UMKOM "4.10      EGAS ‹berwachungskonzept: Frage/Antwort-Kommunikation zw. UM und FR" /begin REF_CHARACTERISTIC AUSCH_T_UM /end REF_CHARACTERISTIC
 /begin IN_MEASUREMENT abtres_um apakres_um ausc_ur B_ausc_act B_ausc_um e_mem_um mem_ur /end IN_MEASUREMENT
 /begin OUT_MEASUREMENT B_newqr_um B_nxtrp_um frerr_c_um frerr_c_ur frtar_c_um newansw_um newqr_ur newque_um newqu_um umerr_c_um /end OUT_MEASUREMENT
 /begin LOC_MEASUREMENT nxtrp_ur plstate_um plstate_ur /end LOC_MEASUREMENT
/end FUNCTION
/begin FUNCTION URADCC "16.30     EGAS ‹berwachungskonzept: AD-Wandler-Test" /begin DEF_CHARACTERISTIC ADCC_MX_UM ADCC_T_UM ADCQ_T_UM /end DEF_CHARACTERISTIC /begin IN_MEASUREMENT B_i_ska_um B_pwgnotum modul_c_um raster_um /end IN_MEASUREMENT /begin OUT_MEASUREMENT B_adcc_um ei_adcc_um ei_adcq_um /end OUT_MEASUREMENT /begin LOC_MEASUREMENT adcc_c_um adcc_c_ur adcq_c_um adcq_c_ur adcq_um upwg2_um /end LOC_MEASUREMENT /end FUNCTION
/begin FUNCTION URCPU "21.20     EGAS ‹berwachungskonzept: Befehlstest mit Ebene 2'"
 /begin IN_MEASUREMENT abfgrc_uc abmist_uc abmsrc_uc abmver_uc abmzf_uc abmzul_uc abreac_uc abrkc_uc absgsc_uc raster_um /end IN_MEASUREMENT
 /begin OUT_MEASUREMENT abtres_um /end OUT_MEASUREMENT
/end FUNCTION
/begin FUNCTION URMEM "4.20      EGAS ‹berwachungskonzept: Zyklischer Speichertest"
 /begin DEF_CHARACTERISTIC AUSGH_T_UM AUSG_T_UM AUSZH_T_UM AUSZ_T_UM CW_NOCYCLROMCHK_UM /end DEF_CHARACTERISTIC
 /begin IN_MEASUREMENT modul_c_um raster_um /end IN_MEASUREMENT
 /begin OUT_MEASUREMENT e_mem_um mem_ur urmcksco urmcksda urmpatco /end OUT_MEASUREMENT
 /begin LOC_MEASUREMENT ausgh_c_um ausgh_c_ur ausg_c_um ausg_c_ur auszh_c_um auszh_c_ur ausz_c_um ausz_c_ur /end LOC_MEASUREMENT
/end FUNCTION
/begin FUNCTION URPAK "2.20      EGAS ‹berwachungskonzept: Programmablaufkontrolle" /begin IN_MEASUREMENT B_newqr_um newqr_ur newque_um raster_um /end IN_MEASUREMENT /begin OUT_MEASUREMENT aktqu_uc apakres_um modul_c_um /end OUT_MEASUREMENT /end FUNCTION
/begin FUNCTION URRAM "4.10      EGAS ‹berwachungskonzept: RAM-Test"
 /begin IN_MEASUREMENT B_pwf e_mem_um e_rom1_um e_romx_um mem_ur nmot_um rom1_ur rompage_um rompage_ur romx_ur wri_c_um /end IN_MEASUREMENT
 /begin OUT_MEASUREMENT e_ram_um ram_ur /end OUT_MEASUREMENT
/end FUNCTION
/begin FUNCTION URROM "4.20      EGAS ‹berwachungskonzept: ROM-Test" /begin DEF_CHARACTERISTIC CW_NOROMCHKRESET ROMRSTA_UM /end DEF_CHARACTERISTIC /begin IN_MEASUREMENT B_nlsiko B_pwf e_mem_um e_ram_um mem_ur ram_ur swOffDlBits /end IN_MEASUREMENT
 /begin OUT_MEASUREMENT e_rom1_um e_romx_um rom1_ur rompage_um rompage_ur romrstc_um romx_ur /end OUT_MEASUREMENT
/end FUNCTION
/begin FUNCTION URTPU "1.60      EGAS ‹berwachungskonzept: TPU-‹berwachung f¸r Funktions¸berwachung"
 /begin DEF_CHARACTERISTIC NZMAX_UM TDIFMX_UM TPUCA_T_UM TPUCR_T_UM TPURA_T_UM TPURSTA_UM TPUST_T_UM TPU_T_UM /end DEF_CHARACTERISTIC
 /begin IN_MEASUREMENT e_mem_um mem_ur modul_c_um synstate /end IN_MEASUREMENT
 /begin OUT_MEASUREMENT c720alt_um c720alt_ur e_tpu_um nz_um tc72alt_um tc72alt_ur tdifs1_um tdifs1_ur tsm_alt_um tsm_um zsytp1_um zsytp2_um /end OUT_MEASUREMENT
 /begin LOC_MEASUREMENT tpuca_c_um tpuca_c_ur tpucr_c_um tpucr_c_ur tpura_c_um tpura_c_ur tpurstc_um tpust_c_um tpust_c_ur tpu_c_um tpu_c_ur /end LOC_MEASUREMENT
/end FUNCTION
/begin FUNCTION VMAXMD "3.60      Drehmomentanforderung von VMAX-Regelung"
 /begin DEF_CHARACTERISTIC CWDVMX CWVMAXCOD CWVMAXIDX KFMIRD KFMIRD1 KFMIRD2 KFMIRD3 KFMIRD4 KFMIRD5 KFMIRD6 KFMIRD7 KFMIRDLR KFMIRDLR1 KFMIRDLR2 KFMIRDLR3 KFMIRDLR4 KFMIRDLR5 KFMIRDLR6 KFMIRDLR7 KLVABSCH KLVABSCHLR KLVHYST KLVHYSTLR KLVMAXO KLVMAXOLR KLVMAXP KLVMAXPLR KLVVORH KLVVORHLR KLZIVMAX KLZIVMAXLR NMINVMX SBF02MFLRSB SBF02MFSB SCO08VMUB SRL03MFLRUW SRL03MFUW TVMXPR ZBFIL /end DEF_CHARACTERISTIC
 /begin REF_CHARACTERISTIC MDIMX /end REF_CHARACTERISTIC
 /begin IN_MEASUREMENT bfzgl_b B_lowra mifab_w miist_w nmot rl_w vfzgk_w vfzg_w /end IN_MEASUREMENT
 /begin OUT_MEASUREMENT bfzglf B_vmax B_vmaxt esst_sbf02mflrsb esst_sbf02mfsb esst_srl03mflruw esst_srl03mfuw mivmx mivmxt_w mivmx_w /end OUT_MEASUREMENT
 /begin LOC_MEASUREMENT dvprae_w dvsi_w esst_sco08vmub ivmax mired vabsch_w vfzgpr_w vhyst_w vmaxidx vmaxo_w vmaxpr vvorh_w zivmaxr /end LOC_MEASUREMENT
/end FUNCTION
/begin FUNCTION VVTCHK "1.60      Anschlagadaption VVT-System"
 /begin DEF_CHARACTERISTIC CWVVTCHK CWVVTLERN CWVVTLERN2 TVVTCHKB2 TVVTCHKEST TVVTCHKND TVVTCHKNST TVVTCHKPWR TVVTCHKSO TVVTCHKUD TVVTCHKUST VVTCHKDIF1 VVTCHKDIF2 VVTCHKDSPW VVTCHKTIAN VVTCHKTO VVTCHKTU /end DEF_CHARACTERISTIC
 /begin IN_MEASUREMENT B_fa B_favvtal B_iwfalse B_iwfalse2 B_kl15 B_nlvvtchk B_nmot B_stend tmot top_w vvtal vvt_alern vvt_alern2 vvt_ansio vvt_ansio2 vvt_iw vvt_iw2 vvt_sw vvt_sw2 /end IN_MEASUREMENT
 /begin OUT_MEASUREMENT B_vvtno_an vvtfkt vvtlernan vvtlernan2 /end OUT_MEASUREMENT
 /begin LOC_MEASUREMENT B_anlern B_anlern2 B_an_ok B_an_ok2 B_vvtchkde B_vvtchkn B_vvtchkoa B_vvtchkt B_vvtnhat B_vvtpwr B_vvtpwral last_test last_test2 vvtalern vvtalern2 vvtchkal vvtchke vvtchkem vvtchkem2 vvtchkemok vvtcntal vvtcntal2 vvtilern vvtilern2 vvt_sw2old vvt_swold /end LOC_MEASUREMENT
/end FUNCTION
/begin FUNCTION VVTNTPOS "1.20      VVT Notlaufposition" /begin DEF_CHARACTERISTIC AVVTPERS AVVTSSTST AVVTTVNOT AVVTTVOFF AVVTTVTST /end DEF_CHARACTERISTIC /begin IN_MEASUREMENT B_bt B_btvvte B_hr B_kl15 B_vvteet B_vvttvnot /end IN_MEASUREMENT /begin OUT_MEASUREMENT tavvtout_w vvtper_w /end OUT_MEASUREMENT /begin LOC_MEASUREMENT avvtloc_1 /end LOC_MEASUREMENT /end FUNCTION
/begin FUNCTION Watchpoint ""
 /begin DEF_CHARACTERISTIC watch_addr0_h watch_addr0_l watch_addr1_h watch_addr1_l watch_addr2_h watch_addr2_l watch_addr3_h watch_addr3_l watch_newdata watch_on /end DEF_CHARACTERISTIC
/end FUNCTION
/begin FUNCTION Watchpoint_Extended ""
 /begin DEF_CHARACTERISTIC watch_acmode watch_addr4_h watch_addr4_l watch_addr5_h watch_addr5_l watch_cmode4 watch_cmode5 watch_dcmode watch_mode watch_rw4 watch_rw5 watch_sign4 watch_sign5 watch_size_bits4 watch_size_bits5 watch_value4_h watch_value4_l watch_value5_h watch_value5_l /end DEF_CHARACTERISTIC
 /begin LOC_MEASUREMENT watch_error watch_state /end LOC_MEASUREMENT
/end FUNCTION
/begin FUNCTION WDKADP "1.40      Adaption (BMW)"
 /begin DEF_CHARACTERISTIC DPSRIMN DPSRIMX DPSRMN DPSRMX KLRDPSI KLRDPSP MLDPSAD_H S_DPSADOF S_MLDPSADO S_WDKADOF WDKDPSAD_H /end DEF_CHARACTERISTIC
 /begin IN_MEASUREMENT B_stend B_vl ddps_w /end IN_MEASUREMENT
 /begin OUT_MEASUREMENT B_pddssmn B_pddssmx ddpskl dpsdpsad_w dpsraus_i dpsraus_p mldpsad wdkdpsad /end OUT_MEASUREMENT
/end FUNCTION
/begin FUNCTION WES "1.20      Winkel Einlass Schliesst (BMW-Funktion)" /begin DEF_CHARACTERISTIC WESNESPR /end DEF_CHARACTERISTIC /begin IN_MEASUREMENT evhubs_w Vse_spri /end IN_MEASUREMENT /begin OUT_MEASUREMENT wes wesnesprau /end OUT_MEASUREMENT /end FUNCTION
/begin FUNCTION WFS "Wegfahrsperre" /begin IN_MEASUREMENT B_ez B_nmin B_zndaus /end IN_MEASUREMENT
 /begin OUT_MEASUREMENT AS_wp B_auswrt B_eculock B_eep2err B_eeperr B_inistw B_kwperr B_motor B_ptyerr B_ramerr B_read_active B_recerr B_resstw B_timerr B_wcerr B_wc_exa B_wc_exn B_write_active B_wuerg EwsNvBits pm_akt pm_fre pm_mod pm_ta pm_td pty_fctr rec_fctr stw_prog_frei_mod stw_prog_frei_ta stw_prog_frei_td ttimout tweiter twuerg wc_fctr /end OUT_MEASUREMENT
/end FUNCTION
/begin FUNCTION ZADMTL "1.60      Zustands Automat f¸r Tank Leck Diagnose (DMTL)"
 /begin DEF_CHARACTERISTIC CWDMTLEOL CWDMTLEXT CWDMTLGL CWDMTLKL CWZADMTL DIPTGEOL DIPTGFT DIPTREF DIPTSTAB DMTFGVT FIP2STAB FIPTCF FIPTEL FIPTGL FIPTGLR IPTGHTOL IPTGMX IPTREFO IPTREFU KFTDSTAB NRFRPEOL NRFRPFT TDMCFGTF TDMELGTF TDMGLGTF TDMKLGTF TDMTREF TDMTREFW TDMTRSTA TEFABE2 TMXRFMIN /end DEF_CHARACTERISTIC
 /begin REF_CHARACTERISTIC PRFADMTG /end REF_CHARACTERISTIC
 /begin IN_MEASUREMENT aktlauf_w B_dmtlrst B_dmtmve B_dmtpme B_fsttldv B_kl15 B_tldinfo gvtaf_w ipteskf_w msntetev_w tdmtlrf_w top_w /end IN_MEASUREMENT
 /begin OUT_MEASUREMENT aktend_w B_admtll B_admtmv B_admtpm B_dmteol B_dmter B_dmterft B_dmtge B_dmtglm B_dmtglmv B_dmtgv B_dmtke B_dmtklm B_dmtlpe B_dmtnge B_dmtrest B_dmtrfm B_edmtk B_refo B_refu B_sumv B_txdmtrf B_txdmtrf2 B_txdmtrfm B_zdmtgv B_zdmtk diptgl_w dmtnrfrf_w dmtnrfrp_w dmtnrfr_w iptghmn_w iptghmx_w iptgh_w iptglmn_w iptglv_w iptgl_w iptkl_w iptrefr_w iptref_w iptsglv_w iptsgl_w iptvglv_w iptvgl_w isadmtl tdmgl_w tdmkl_w tdmlka_w tdmstba_w tdmstth_w tdmtrest txdmtrf txdmtrf2 txdmtrfm zadmtlAusBits zadmtlAusBitsNov zadmtlAusBitsNov2 zadmtlAusBitsNov3 /end OUT_MEASUREMENT
 /begin LOC_MEASUREMENT B_dmtexte B_eolref B_nachlter dmtfgvt_w fiptglr_w fiptgl_w isadmtold zadmtlLokBits /end LOC_MEASUREMENT
/end FUNCTION
/begin FUNCTION ZNDAUS "8.20      Z¸ndung: Anforderungen f¸r Ausblendung" /begin DEF_CHARACTERISTIC ANWFOZA /end DEF_CHARACTERISTIC /begin IN_MEASUREMENT B_fofrun B_sa zzyl /end IN_MEASUREMENT /begin OUT_MEASUREMENT B_zndaus /end OUT_MEASUREMENT /end FUNCTION
/begin FUNCTION ZUE "313.30    Grundfunktion - Z¸ndung" /begin DEF_CHARACTERISTIC NACHANZ WMNDOPZ WPHN ZWAPPL /end DEF_CHARACTERISTIC /begin REF_CHARACTERISTIC SNM08__UB /end REF_CHARACTERISTIC
 /begin IN_MEASUREMENT B_llrein B_nozwe B_sa B_zwappl dwkrz dzwwl esst_snm08__ub nmot redist vszw wkrdy zwgru zwsol zwspae zwstt zzylzue /end IN_MEASUREMENT
 /begin OUT_MEASUREMENT B_zwkra B_zwspae znachanz zwbas zwbasar zwist zwkrafld zwout zwoutar zwoutcpl zwoutzyl zwzyl1 /end OUT_MEASUREMENT
 /begin LOC_MEASUREMENT wphg /end LOC_MEASUREMENT
/end FUNCTION
/begin FUNCTION ZUESZ "4.40      Z¸ndung, Berechnung Schlieﬂzeit" /begin DEF_CHARACTERISTIC TSUB /end DEF_CHARACTERISTIC /begin IN_MEASUREMENT B_stend ub /end IN_MEASUREMENT /begin OUT_MEASUREMENT szout_w /end OUT_MEASUREMENT /end FUNCTION
/begin FUNCTION ZWGRU "44.40     Grundz¸ndwinkel"
 /begin DEF_CHARACTERISTIC KFDZWTHFAK KFFWMXA KFTRLSOLKR KFZRLSOLKR KFZW1 KFZW2 KFZWLL KFZWLLT KFZWLLTDO KFZWNOTL KFZWTDO KFZWVL KFZWVLT KLDRSOLKR S_ZNDRLP TRLSOLKRT TVDRLSOLKR WMXTA ZKRLSOLKRT /end DEF_CHARACTERISTIC
 /begin REF_CHARACTERISTIC CWZWDYN SNM24ZUUB SRL06ZUUB /end REF_CHARACTERISTIC
 /begin IN_MEASUREMENT B_kr B_krdws B_ll B_stend B_vl dpsfak dpssol_ub dpssol_uw drlsol_w dzwoag dzwol esst_snm24zuub esst_srl06zuub E_vvt_zw fnwlleff minhub_w nmot nmot_w rl rlsol_w tans zwks /end IN_MEASUREMENT
 /begin OUT_MEASUREMENT minhub_ub rlsolkrvf rlsolkrvft zwgru /end OUT_MEASUREMENT
 /begin LOC_MEASUREMENT B_trigin B_trigout B_zwdyn dzwth kfzwstat rlkr rlsol rlsolkrv rlsolkrvt timrlsolvt zwdyn zwkrdyn zwll zwtdo_aus /end LOC_MEASUREMENT
/end FUNCTION
/begin FUNCTION ZWKS "1.20      Z¸ndwinkel Klopfschutz" /begin DEF_CHARACTERISTIC KFFWK KFKSZW KFWK KLZWKSNL KSZWE /end DEF_CHARACTERISTIC /begin REF_CHARACTERISTIC SNM24ZUUB SRL16ZUUB /end REF_CHARACTERISTIC /begin IN_MEASUREMENT esst_snm24zuub esst_srl16zuub nmot rl tans tmot /end IN_MEASUREMENT /begin OUT_MEASUREMENT dzwks zwks /end OUT_MEASUREMENT /end FUNCTION
/begin FUNCTION ZWKTIBS "1.20" /begin REF_CHARACTERISTIC ENABSDIBS /end REF_CHARACTERISTIC
 /begin OUT_MEASUREMENT BsdControl BsdData BsdRegAdr B_ibsactiv ht_IbsReadTimeOutCtr ht_IbsResetTimeOutCtr ht_IbsSendTimeOutCtr ht_IbsStatus /end OUT_MEASUREMENT
/end FUNCTION
/begin FUNCTION ZWMIN "10.20     Berechnung des sp‰test erlaubten Z¸ndwinkels"
 /begin DEF_CHARACTERISTIC DZWAML DZWSPM FZWKHMX KFZWMN KFZWMNKH KFZWMNST KFZWMS KLZZWMNST TVZWMSA TVZWMSE /end DEF_CHARACTERISTIC
 /begin REF_CHARACTERISTIC DZW2DZWQ SNM16ZUUB SRL12ZUUB STM06__UB /end REF_CHARACTERISTIC
 /begin IN_MEASUREMENT B_kh B_kw B_sa B_st dzwkoef esst_snm16zuub esst_srl12zuub esst_stm06__ub fmdkh migs_w misolv_w misol_w ml nmot rl tmot tmst zwist zwopt /end IN_MEASUREMENT
 /begin OUT_MEASUREMENT B_zwms dzwspae etazwmn zwspae /end OUT_MEASUREMENT
 /begin LOC_MEASUREMENT B_zwmnste dzwmna zwmn zwmnd zwmnms zwnst /end LOC_MEASUREMENT
/end FUNCTION
/begin FUNCTION ZWSTT "7.30      Z¸ndung im Start" /begin DEF_CHARACTERISTIC DZWSTTA DZWSTTAT KFZWST KFZWSTT /end DEF_CHARACTERISTIC /begin IN_MEASUREMENT B_gdst B_stend nmotz tans tmst /end IN_MEASUREMENT /begin OUT_MEASUREMENT zwstt /end OUT_MEASUREMENT /end FUNCTION
/begin FUNCTION ZWWL "10.30     Warmlauf Z¸ndwinkel"
 /begin DEF_CHARACTERISTIC KFDZWLKH KFDZWLKHLL KFFWLTMKH KFWZWWL KFWZWWLVT KFZWWLTM KFZWWLTMVT /end DEF_CHARACTERISTIC
 /begin IN_MEASUREMENT B_ll B_vvtnotl dpsfak nmot rl tmot tmst tnst_w /end IN_MEASUREMENT
 /begin OUT_MEASUREMENT dzwwl dzwwlkh fwltmkh /end OUT_MEASUREMENT
/end FUNCTION
/begin COMPU_METHOD bfzg_sb_q0p217 "" RAT_FUNC "%6.3" "m/s^2" COEFFS 0 1 0 0 0 0.217 /end COMPU_METHOD
/begin COMPU_METHOD B_TRUE "boolsche Zust‰nde, positive Logik" TAB_VERB "%6.3" "" COMPU_TAB_REF B_TRUE /end COMPU_METHOD
/begin COMPU_VTAB B_TRUE "boolsche Zust‰nde, positive Logik" TAB_VERB 2 0 "----" 1 "TRUE" /end COMPU_VTAB
/begin COMPU_METHOD DEZ "1 : 1 Umrechnug (dez/hex)" RAT_FUNC "%6.2" "" COEFFS 0 1 0 0 0 1 /end COMPU_METHOD
/begin COMPU_METHOD dez "1 : 1 Umrechnug (dez/hex)" RAT_FUNC "%6.2" "" COEFFS 0 1 0 0 0 1 /end COMPU_METHOD
/begin COMPU_METHOD dezsub1 "" RAT_FUNC "%6.2" "-" COEFFS 0 1 -1 0 0 1 /end COMPU_METHOD
/begin COMPU_METHOD fak_q0p00392 "" RAT_FUNC "%6.4" "-" COEFFS 0 255 0 0 0 1 /end COMPU_METHOD
/begin COMPU_METHOD fak_q0p00781 "" RAT_FUNC "%6.4" "-" COEFFS 0 128 0 0 0 1 /end COMPU_METHOD
/begin COMPU_METHOD fak_sb_b1 "" RAT_FUNC "%6.4" "-" COEFFS 0 256 0 0 0 2 /end COMPU_METHOD
/begin COMPU_METHOD fak_ub_b1 "" RAT_FUNC "%6.4" "-" COEFFS 0 256 0 0 0 1 /end COMPU_METHOD
/begin COMPU_METHOD fak_ub_b2 "" RAT_FUNC "%6.4" "-" COEFFS 0 256 0 0 0 2 /end COMPU_METHOD
/begin COMPU_METHOD fak_ub_b8 "" RAT_FUNC "%6.4" "-" COEFFS 0 256 0 0 0 8 /end COMPU_METHOD
/begin COMPU_METHOD fak_uw_b1 "" RAT_FUNC "%7.6" "-" COEFFS 0 65536 0 0 0 1 /end COMPU_METHOD
/begin COMPU_METHOD hub_ub_b1 "" RAT_FUNC "%6.4" "mm" COEFFS 0 256 0 0 0 1 /end COMPU_METHOD
/begin COMPU_METHOD hub_ub_q0p064 "" RAT_FUNC "%6.4" "mm" COEFFS 0 255 0 0 0 16.32 /end COMPU_METHOD
/begin COMPU_METHOD hub_uw_q0p001 "" RAT_FUNC "%6.5" "mm" COEFFS 0 1000 0 0 0 1 /end COMPU_METHOD
/begin COMPU_METHOD i_q6p1035_uA "" RAT_FUNC "%6.4" "mA" COEFFS 0 65536 0 0 0 400 /end COMPU_METHOD
/begin COMPU_METHOD kumsrl_ub_b0p002 "" RAT_FUNC "%10.9" "(kg/h)/((1/min)*%)" COEFFS 0 128000 0 0 0 1 /end COMPU_METHOD
/begin COMPU_METHOD kw_q3 "" RAT_FUNC "%6.2" "Grad KW" COEFFS 0 1 0 0 0 3 /end COMPU_METHOD
/begin COMPU_METHOD md_q0p5 "" RAT_FUNC "%6.3" "Nm" COEFFS 0 1 0 0 0 0.5 /end COMPU_METHOD
/begin COMPU_METHOD m_q7p5 "" RAT_FUNC "%6.2" "kg/h" COEFFS 0 1 0 0 0 7.5 /end COMPU_METHOD
/begin COMPU_METHOD m_ub_b1020 "" RAT_FUNC "%6.2" "kg/h" COEFFS 0 1 0 0 0 4 /end COMPU_METHOD
/begin COMPU_METHOD m_uw_b6553p5 "" RAT_FUNC "%6.3" "kg/h" COEFFS 0 1 0 0 0 0.1 /end COMPU_METHOD
/begin COMPU_METHOD nmot_ub_q10 "" RAT_FUNC "%6.1" "1/min" COEFFS 0 1 0 0 0 10 /end COMPU_METHOD
/begin COMPU_METHOD nmot_ub_q40 "" RAT_FUNC "%6.1" "1/min" COEFFS 0 1 0 0 0 40 /end COMPU_METHOD
/begin COMPU_METHOD nmot_uw_q0p25 "" RAT_FUNC "%6.3" "1/min" COEFFS 0 1 0 0 0 0.25 /end COMPU_METHOD
/begin COMPU_METHOD p_q0p0195 "" RAT_FUNC "%6.4" "HPa" COEFFS 0 256 0 0 0 5 /end COMPU_METHOD
/begin COMPU_METHOD p_q0p039 "" RAT_FUNC "%6.4" "hPa" COEFFS 0 256 0 0 0 10 /end COMPU_METHOD
/begin COMPU_METHOD p_q0p039s32768 "" RAT_FUNC "%7.1" "hPa" COEFFS 0 256 327680 0 0 10 /end COMPU_METHOD
/begin COMPU_METHOD p_q10p0 "" RAT_FUNC "%6.1" "hPa" COEFFS 0 1 0 0 0 10 /end COMPU_METHOD
/begin COMPU_METHOD p_q5 "" RAT_FUNC "%6.2" "HPa" COEFFS 0 1 0 0 0 5 /end COMPU_METHOD
/begin COMPU_METHOD rel_b99p9985 "" RAT_FUNC "%6.4" "%" COEFFS 0 65535 0 0 0 99.9985 /end COMPU_METHOD
/begin COMPU_METHOD rel_sb_q0p78 "" RAT_FUNC "%6.3" "%" COEFFS 0 1 0 0 0 0.78 /end COMPU_METHOD
/begin COMPU_METHOD rel_sw_b50 "" RAT_FUNC "%6.4" "%" COEFFS 0 65536 0 0 0 100 /end COMPU_METHOD
/begin COMPU_METHOD rel_sw_b768 "" RAT_FUNC "%6.4" "%" COEFFS 0 65536 0 0 0 1536 /end COMPU_METHOD
/begin COMPU_METHOD rel_ub_b127p5 "" RAT_FUNC "%6.3" "%" COEFFS 0 2 0 0 0 1 /end COMPU_METHOD
/begin COMPU_METHOD rel_ub_b99p6 "" RAT_FUNC "%6.3" "%" COEFFS 0 256 0 0 0 100 /end COMPU_METHOD
/begin COMPU_METHOD rel_ub_q0p0029 "" RAT_FUNC "%6.4" "%" COEFFS 0 256 0 0 0 0.75 /end COMPU_METHOD
/begin COMPU_METHOD rel_ub_q0p391 "" RAT_FUNC "%6.3" "%/km/h" COEFFS 0 1 0 0 0 0.391 /end COMPU_METHOD
/begin COMPU_METHOD rel_ub_q0p75 "" RAT_FUNC "%6.3" "%" COEFFS 0 1 0 0 0 0.75 /end COMPU_METHOD
/begin COMPU_METHOD rel_uw_b100 "" RAT_FUNC "%6.4" "%" COEFFS 0 65536 0 0 0 100 /end COMPU_METHOD
/begin COMPU_METHOD rel_uw_q0p0234 "" RAT_FUNC "%6.4" "%" COEFFS 0 32 0 0 0 0.75 /end COMPU_METHOD
/begin COMPU_METHOD rel_uw_q0p75 "" RAT_FUNC "%6.3" "%" COEFFS 0 1 0 0 0 0.75 /end COMPU_METHOD
/begin COMPU_METHOD spg_q0p00977 "" RAT_FUNC "%6.4" "V" COEFFS 0 256 0 0 0 2.5 /end COMPU_METHOD
/begin COMPU_METHOD spg_sw_q0p001 "" RAT_FUNC "%6.5" "V" COEFFS 0 1000 0 0 0 1 /end COMPU_METHOD
/begin COMPU_METHOD spg_ubatt "" RAT_FUNC "%6.3" "V" COEFFS 0 1 0 0 0 0.0942 /end COMPU_METHOD
/begin COMPU_METHOD spg_ub_q0p0098 "" RAT_FUNC "%6.4" "V" COEFFS 0 256 0 0 0 2.5 /end COMPU_METHOD
/begin COMPU_METHOD spg_ub_q0p019 "" RAT_FUNC "%6.4" "V" COEFFS 0 256 0 0 0 5 /end COMPU_METHOD
/begin COMPU_METHOD spg_ugen "" RAT_FUNC "%6.2" "V" COEFFS 0 10 -106 0 0 1 /end COMPU_METHOD
/begin COMPU_METHOD t100msxs_ub_b25p5 "" RAT_FUNC "%6.3" "s" COEFFS 0 1 0 0 0 0.1 /end COMPU_METHOD
/begin COMPU_METHOD t100msxs_uw_b6553p5 "" RAT_FUNC "%6.3" "s" COEFFS 0 1 0 0 0 0.1 /end COMPU_METHOD
/begin COMPU_METHOD t10msxs_ub_b2p55 "" RAT_FUNC "%6.4" "s" COEFFS 0 1 0 0 0 0.01 /end COMPU_METHOD
/begin COMPU_METHOD t10msxs_uw_b655p35 "" RAT_FUNC "%6.4" "s" COEFFS 0 1 0 0 0 0.01 /end COMPU_METHOD
/begin COMPU_METHOD t10ms_ub_b2550 "" RAT_FUNC "%7.2" "ms" COEFFS 0 1 0 0 0 10 /end COMPU_METHOD
/begin COMPU_METHOD t20ms_ub_b5100 "" RAT_FUNC "%7.2" "ms" COEFFS 0 1 0 0 0 20 /end COMPU_METHOD
/begin COMPU_METHOD t40msxs_uw_q0p04 "" RAT_FUNC "%6.4" "s" COEFFS 0 1 0 0 0 0.04 /end COMPU_METHOD
/begin COMPU_METHOD t40ms_ub_b10200 "" RAT_FUNC "%7.2" "ms" COEFFS 0 1 0 0 0 40 /end COMPU_METHOD
/begin COMPU_METHOD t6minxmin_q6 "" RAT_FUNC "%6.2" "min" COEFFS 0 1 0 0 0 6 /end COMPU_METHOD
/begin COMPU_METHOD temp_ub_q0p75_o48 "" RAT_FUNC "%6.2" "Grad C" COEFFS 0 1 48 0 0 0.75 /end COMPU_METHOD
/begin COMPU_METHOD txms_ub_q0p1 "" RAT_FUNC "%6.3" "ms" COEFFS 0 10 0 0 0 1 /end COMPU_METHOD
/begin COMPU_METHOD txms_uw_q0p0004 "" RAT_FUNC "%6.5" "ms" COEFFS 0 2500 0 0 0 1 /end COMPU_METHOD
/begin COMPU_METHOD txms_uw_q0p001 "" RAT_FUNC "%6.5" "ms" COEFFS 0 1000 0 0 0 1 /end COMPU_METHOD
/begin COMPU_METHOD t_q0p1 "" RAT_FUNC "%6.3" "s" COEFFS 0 10 0 0 0 1 /end COMPU_METHOD
/begin COMPU_METHOD vfzg_sw_q0p00781 "" RAT_FUNC "%6.4" "km/h" COEFFS 0 1 0 0 0 0.0078125 /end COMPU_METHOD
/begin COMPU_METHOD vfzg_uw_q0p00781 "" RAT_FUNC "%6.4" "km/h" COEFFS 0 1 0 0 0 0.0078125 /end COMPU_METHOD
/begin COMPU_METHOD vnstv_q0p01 "" RAT_FUNC "%7.5" "%" COEFFS 0 100 0 0 0 1 /end COMPU_METHOD
/begin COMPU_METHOD vol_q0p1_l "" RAT_FUNC "%6.3" "l" COEFFS 0 1 0 0 0 0.1 /end COMPU_METHOD
/begin COMPU_METHOD zk100msxs_ub_b25p5 "" RAT_FUNC "%6.3" "s" COEFFS 0 0 256 0 10 0 /end COMPU_METHOD
/begin COMPU_METHOD zk10msxs_ub_b2p55 "" RAT_FUNC "%6.4" "s" COEFFS 0 0 255 0 100 0 /end COMPU_METHOD
/begin COMPU_METHOD zk10msxs_uw_b655 "" RAT_FUNC "%6.2" "s" COEFFS 0 0 65536 0 100 0 /end COMPU_METHOD
/begin COMPU_METHOD zk40ms_ub_b10200 "" RAT_FUNC "%6.1" "ms" COEFFS 0 0 10240 0 1 40 /end COMPU_METHOD
/begin COMPU_METHOD zw_sb_q0p75 "" RAT_FUNC "%6.3" "Grad KW" COEFFS 0 255 0 0 0 191.25 /end COMPU_METHOD
/begin COMPU_METHOD default "" RAT_FUNC "%6.2" "" COEFFS 0 1 0 0 0 1 /end COMPU_METHOD
/begin COMPU_METHOD defaultAscii "" RAT_FUNC "%6.2" "" COEFFS 0 1 0 0 0 1 /end COMPU_METHOD
/begin RECORD_LAYOUT FklWU16 FNC_VALUES 1 UWORD COLUMN_DIR DIRECT /end RECORD_LAYOUT
/begin RECORD_LAYOUT GkfWSb FNC_VALUES 1 SBYTE COLUMN_DIR DIRECT /end RECORD_LAYOUT
/begin RECORD_LAYOUT GkfWUb FNC_VALUES 1 UBYTE COLUMN_DIR DIRECT /end RECORD_LAYOUT
/begin RECORD_LAYOUT GklWSb FNC_VALUES 1 SBYTE COLUMN_DIR DIRECT /end RECORD_LAYOUT
/begin RECORD_LAYOUT GklWUb FNC_VALUES 1 UBYTE COLUMN_DIR DIRECT /end RECORD_LAYOUT
/begin RECORD_LAYOUT GklWUw FNC_VALUES 1 UWORD COLUMN_DIR DIRECT /end RECORD_LAYOUT
/begin RECORD_LAYOUT KfAxU8AyU8SstxU16SstyU16WU16 NO_AXIS_PTS_X 1 UWORD NO_AXIS_PTS_Y 2 UWORD AXIS_PTS_X 3 UWORD INDEX_INCR DIRECT AXIS_PTS_Y 4 UWORD INDEX_INCR DIRECT FNC_VALUES 5 UWORD COLUMN_DIR DIRECT /end RECORD_LAYOUT
/begin RECORD_LAYOUT KfAxU8AyU8SstxU8SstyU8WS8 NO_AXIS_PTS_X 1 UBYTE NO_AXIS_PTS_Y 2 UBYTE AXIS_PTS_X 3 UBYTE INDEX_INCR DIRECT AXIS_PTS_Y 4 UBYTE INDEX_INCR DIRECT FNC_VALUES 5 SBYTE COLUMN_DIR DIRECT /end RECORD_LAYOUT
/begin RECORD_LAYOUT KfAxU8AyU8SstxU8SstyU8WU8 NO_AXIS_PTS_X 1 UBYTE NO_AXIS_PTS_Y 2 UBYTE AXIS_PTS_X 3 UBYTE INDEX_INCR DIRECT AXIS_PTS_Y 4 UBYTE INDEX_INCR DIRECT FNC_VALUES 5 UBYTE COLUMN_DIR DIRECT /end RECORD_LAYOUT
/begin RECORD_LAYOUT KfAxUbAyUbSstxUbSstyUbWSb NO_AXIS_PTS_X 1 UBYTE NO_AXIS_PTS_Y 2 UBYTE AXIS_PTS_X 3 UBYTE INDEX_INCR DIRECT AXIS_PTS_Y 4 UBYTE INDEX_INCR DIRECT FNC_VALUES 5 SBYTE COLUMN_DIR DIRECT /end RECORD_LAYOUT
/begin RECORD_LAYOUT KfAxUbAyUbSstxUbSstyUbWUb NO_AXIS_PTS_X 1 UBYTE NO_AXIS_PTS_Y 2 UBYTE AXIS_PTS_X 3 UBYTE INDEX_INCR DIRECT AXIS_PTS_Y 4 UBYTE INDEX_INCR DIRECT FNC_VALUES 5 UBYTE COLUMN_DIR DIRECT /end RECORD_LAYOUT
/begin RECORD_LAYOUT KfAxUbAyUbSstxUwSstyUwWUw NO_AXIS_PTS_X 1 UWORD NO_AXIS_PTS_Y 2 UWORD AXIS_PTS_X 3 UWORD INDEX_INCR DIRECT AXIS_PTS_Y 4 UWORD INDEX_INCR DIRECT FNC_VALUES 5 UWORD COLUMN_DIR DIRECT /end RECORD_LAYOUT
/begin RECORD_LAYOUT KlAUbSstUbWSb NO_AXIS_PTS_X 1 UBYTE AXIS_PTS_X 2 UBYTE INDEX_INCR DIRECT FNC_VALUES 3 SBYTE COLUMN_DIR DIRECT /end RECORD_LAYOUT
/begin RECORD_LAYOUT KlAUbSstUbWUb NO_AXIS_PTS_X 1 UBYTE AXIS_PTS_X 2 UBYTE INDEX_INCR DIRECT FNC_VALUES 3 UBYTE COLUMN_DIR DIRECT /end RECORD_LAYOUT
/begin RECORD_LAYOUT KlAUbSstUbWUw NO_AXIS_PTS_X 1 UBYTE AXIS_PTS_X 2 UBYTE INDEX_INCR DIRECT FNC_VALUES 3 UWORD COLUMN_DIR DIRECT /end RECORD_LAYOUT
/begin RECORD_LAYOUT KlAUwSstUwWSw NO_AXIS_PTS_X 1 UWORD AXIS_PTS_X 2 UWORD INDEX_INCR DIRECT FNC_VALUES 3 SWORD COLUMN_DIR DIRECT /end RECORD_LAYOUT
/begin RECORD_LAYOUT KlAUwSstUwWUw NO_AXIS_PTS_X 1 UWORD AXIS_PTS_X 2 UWORD INDEX_INCR DIRECT FNC_VALUES 3 UWORD COLUMN_DIR DIRECT /end RECORD_LAYOUT
/begin RECORD_LAYOUT KlAxU8SstxU16WU16 NO_AXIS_PTS_X 1 UWORD AXIS_PTS_X 2 UWORD INDEX_INCR DIRECT FNC_VALUES 3 UWORD COLUMN_DIR DIRECT /end RECORD_LAYOUT
/begin RECORD_LAYOUT KlAxU8SstxU8WS8 NO_AXIS_PTS_X 1 UBYTE AXIS_PTS_X 2 UBYTE INDEX_INCR DIRECT FNC_VALUES 3 SBYTE COLUMN_DIR DIRECT /end RECORD_LAYOUT
/begin RECORD_LAYOUT KwbWU8 FNC_VALUES 1 UBYTE COLUMN_DIR DIRECT /end RECORD_LAYOUT
/begin RECORD_LAYOUT KwSb FNC_VALUES 1 SBYTE COLUMN_DIR DIRECT /end RECORD_LAYOUT
/begin RECORD_LAYOUT KwSw FNC_VALUES 1 SWORD COLUMN_DIR DIRECT /end RECORD_LAYOUT
/begin RECORD_LAYOUT KwUb FNC_VALUES 1 UBYTE COLUMN_DIR DIRECT /end RECORD_LAYOUT
/begin RECORD_LAYOUT KwUw FNC_VALUES 1 UWORD COLUMN_DIR DIRECT /end RECORD_LAYOUT
/begin RECORD_LAYOUT KwWS16 FNC_VALUES 1 SWORD COLUMN_DIR DIRECT /end RECORD_LAYOUT
/begin RECORD_LAYOUT KwWU16 FNC_VALUES 1 UWORD COLUMN_DIR DIRECT /end RECORD_LAYOUT
/begin RECORD_LAYOUT KwWU8 FNC_VALUES 1 UBYTE COLUMN_DIR DIRECT /end RECORD_LAYOUT
/begin RECORD_LAYOUT SstAUbSstSb NO_AXIS_PTS_X 1 UBYTE AXIS_PTS_X 2 SBYTE INDEX_INCR DIRECT /end RECORD_LAYOUT
/begin RECORD_LAYOUT SstAUbSstUb NO_AXIS_PTS_X 1 UBYTE AXIS_PTS_X 2 UBYTE INDEX_INCR DIRECT /end RECORD_LAYOUT
/begin RECORD_LAYOUT SstAUwSstUw NO_AXIS_PTS_X 1 UWORD AXIS_PTS_X 2 UWORD INDEX_INCR DIRECT /end RECORD_LAYOUT
/end MODULE
/end PROJECT
