ASAP2_VERSION 1 41
/begin PROJECT MSD85 "Spray Guided DI-System with Piezo Injectors for 8-Cylinder"
/begin HEADER "_default_HeaderComment" PROJECT_NO _91 /end HEADER
/begin MODULE _default_ModuleName "_default_ModuleLongIdentifier"
/begin MOD_COMMON "_default_ModCommonComment" DEPOSIT ABSOLUTE BYTE_ORDER MSB_LAST ALIGNMENT_BYTE 1 ALIGNMENT_WORD 2 ALIGNMENT_LONG 2 ALIGNMENT_FLOAT32_IEEE 2 ALIGNMENT_FLOAT64_IEEE 4 /end MOD_COMMON
/begin AXIS_PTS ldp_amp_ip_crk_delta_amp "Cranking injection time correction upon ambient pressure" 0xa08084fc amp _REC_AXS_20_u2 5434. _CNV_A_R_LINEAR_____27_CM 6 0. 5434. FORMAT "%7.2" /end AXIS_PTS
/begin MEASUREMENT t_is_ast "\"Idle speed\" activation time since engine start" UWORD _CNV_A_R_LINEAR_____36_CM 1 100. 0. 65535. DISPLAY_IDENTIFIER T_IS_AST ECU_ADDRESS 0xd000267a FORMAT "%5.0" /end MEASUREMENT
/begin MEASUREMENT t_load_min_ast "Minimum load time since engine start" UWORD _CNV_A_R_LINEAR_____36_CM 1 100. 0. 65535. DISPLAY_IDENTIFIER T_LOAD_MIN_AST ECU_ADDRESS 0xd000267c FORMAT "%5.0" /end MEASUREMENT
/begin MEASUREMENT t_vs_max_ast "Maximum vehicule speed time since engine start" UWORD _CNV_A_R_LINEAR_____36_CM 1 100. 0. 65535. DISPLAY_IDENTIFIER T_VS_MAX_AST ECU_ADDRESS 0xd0002684 FORMAT "%5.0" /end MEASUREMENT
/begin MEASUREMENT t_vs_min_ast "Minimum vehicule speed time since engine start" UWORD _CNV_A_R_LINEAR_____36_CM 1 100. 0. 65535. DISPLAY_IDENTIFIER T_VS_MIN_AST ECU_ADDRESS 0xd0002686 FORMAT "%5.0" /end MEASUREMENT
/begin MEASUREMENT ratio_t_vs_max_ast "\"Maximum vehicle speed \" time in percent since engine start" UBYTE _CNV_A_R_LINEAR_____5_CM 1 100. 0. 99.609375 DISPLAY_IDENTIFIER RATIO_T_VS_MAX_AST ECU_ADDRESS 0xd000755a FORMAT "%9.6" /end MEASUREMENT
/begin MEASUREMENT ratio_t_vs_min_ast "\"Minimum vehicle speed \" time in percent since engine start" UBYTE _CNV_A_R_LINEAR_____5_CM 1 100. 0. 99.609375 DISPLAY_IDENTIFIER RATIO_T_VS_MIN_AST ECU_ADDRESS 0xd000755b FORMAT "%9.6" /end MEASUREMENT
/begin MEASUREMENT ratio_t_load_min_ast "\"Minimum load\" time in percent since engine start" UBYTE _CNV_A_R_LINEAR_____5_CM 1 100. 0. 99.609375 DISPLAY_IDENTIFIER RATIO_T_LOAD_MIN_AST ECU_ADDRESS 0xd0007558 FORMAT "%9.6" /end MEASUREMENT
/begin MEASUREMENT ratio_t_puc_ast "\"Trailing throttle fuel cut-off\" activation time in percent since engine start" UBYTE _CNV_A_R_LINEAR_____5_CM 1 100. 0. 99.609375 DISPLAY_IDENTIFIER RATIO_T_PUC_AST ECU_ADDRESS 0xd0007559 FORMAT "%9.6" /end MEASUREMENT
/begin MEASUREMENT ratio_t_is_ast "\"Idle speed\" activation time in percent since engine start" UBYTE _CNV_A_R_LINEAR_____5_CM 1 100. 0. 99.609375 DISPLAY_IDENTIFIER RATIO_T_IS_AST ECU_ADDRESS 0xd0007557 FORMAT "%9.6" /end MEASUREMENT
/begin MEASUREMENT t_puc_ast "\"Trailing throttle fuel cut-off\" activation time since engine start" UWORD _CNV_A_R_LINEAR_____36_CM 1 100. 0. 65535. DISPLAY_IDENTIFIER T_PUC_AST ECU_ADDRESS 0xd0002680 FORMAT "%5.0" /end MEASUREMENT
/begin MEASUREMENT t_diag_ast "Time after engine start for diagnosis functions" UWORD _CNV_A_R_LINEAR_____36_CM 1 100. 0. 65535. DISPLAY_IDENTIFIER T_DIAG_AST ECU_ADDRESS 0xd0006746 FORMAT "%5.0" /end MEASUREMENT
/begin AXIS_PTS ldp_tam_ip_maf_kgh_load_min_ast "" 0xa0802658 tam _REC_AXS_20_u1 190.5 _CNV_A_R_LINEAR_____17_CM 4 -48. 142.5 FORMAT "%6.2" /end AXIS_PTS
/begin CHARACTERISTIC ip_maf_kgh_load_min_ast "Ambient temperature dependent minimum engine load threshold for \"low load\" period calculation after start" CURVE 0xa08027d4 _REC_CUR_20_u2_u1 307.1953125 _CNV_A_R_LINEAR_____215_CM 0. 2047.96875 DISPLAY_IDENTIFIER IP_MAF_KGH_LOAD_MIN_AST FORMAT "%10.5"
 /begin AXIS_DESCR COM_AXIS tam _CNV_A_R_LINEAR_____17_CM 4 -48. 142.5 FORMAT "%6.2" AXIS_PTS_REF ldp_tam_ip_maf_kgh_load_min_ast /end AXIS_DESCR
/end CHARACTERISTIC
/begin CHARACTERISTIC c_vs_thd_vs_max_ast "Maximum vehicule speed threshold for high VS period calculation" VALUE 0xa08028cb _REC_VAL_20_u1 255. _CNV_A_R_LINEAR_____6_CM 0. 255. DISPLAY_IDENTIFIER C_VS_THD_VS_MAX_AST FORMAT "%3.0" /end CHARACTERISTIC
/begin CHARACTERISTIC c_vs_thd_vs_min_ast "Minimum vehicule speed threshold for low VS period calculation" VALUE 0xa08028cc _REC_VAL_20_u1 255. _CNV_A_R_LINEAR_____6_CM 0. 255. DISPLAY_IDENTIFIER C_VS_THD_VS_MIN_AST FORMAT "%3.0" /end CHARACTERISTIC
/begin MEASUREMENT lv_cdn_ena_ratio_t_ast "boolean for ratio time after engine start enable condition" UBYTE _CNV_S_2_RANGE__0___1_CM 1 100. 0. 1. DISPLAY_IDENTIFIER LV_CDN_ENA_RATIO_T_AST ECU_ADDRESS 0xd00026ac BIT_MASK 0x1 /end MEASUREMENT
/begin CHARACTERISTIC c_abc_max_ecf_el[0] "Debounce counter maximum" VALUE 0xa0802846 _REC_VAL_20_u1 255. _CNV_A_R_LINEAR_____0_CM 0. 255. DISPLAY_IDENTIFIER C_ABC_MAX_ECF_EL[0] FORMAT "%3.0" /end CHARACTERISTIC
/begin CHARACTERISTIC c_abc_max_ecf_el[1] "Debounce counter maximum" VALUE 0xa0802847 _REC_VAL_20_u1 255. _CNV_A_R_LINEAR_____0_CM 0. 255. DISPLAY_IDENTIFIER C_ABC_MAX_ECF_EL[1] FORMAT "%3.0" /end CHARACTERISTIC
/begin MEASUREMENT err_diag_ecfpwm[0] "Raw value of error symptom for ECFPWM detected on interface ECU and ECF control unit" UBYTE _CNV_A_R_LINEAR_____0_CM 1 100. 0. 7. DISPLAY_IDENTIFIER ERR_DIAG_ECFPWM[0] ECU_ADDRESS 0xd0007552 FORMAT "%1.0" /end MEASUREMENT
/begin MEASUREMENT err_diag_ecfpwm[1] "Raw value of error symptom for ECFPWM detected on interface ECU and ECF control unit" UBYTE _CNV_A_R_LINEAR_____0_CM 1 100. 0. 7. DISPLAY_IDENTIFIER ERR_DIAG_ECFPWM[1] ECU_ADDRESS 0xd0007553 FORMAT "%1.0" /end MEASUREMENT
/begin MEASUREMENT lv_ecfpwm_fb_vld[0] "If lv_ecfpwm_fb_vld = 1 the failure number err_ecfpwm_fb(01h) is valid" UBYTE _CNV_S_2_RANGE__0___1_CM 1 100. 0. 1. DISPLAY_IDENTIFIER LV_ECFPWM_FB_VLD[0] ECU_ADDRESS 0xd000756e BIT_MASK 0x1 /end MEASUREMENT
/begin MEASUREMENT lv_ecfpwm_fb_vld[1] "If lv_ecfpwm_fb_vld = 1 the failure number err_ecfpwm_fb(01h) is valid" UBYTE _CNV_S_2_RANGE__0___1_CM 1 100. 0. 1. DISPLAY_IDENTIFIER LV_ECFPWM_FB_VLD[1] ECU_ADDRESS 0xd000756f BIT_MASK 0x1 /end MEASUREMENT
/begin MEASUREMENT lv_err_ecfpwm_fb_1 "Error currently present, indicated by failure feedback from ECF control unit" UBYTE _CNV_S_2_RANGE__0___1_CM 1 100. 0. 1. DISPLAY_IDENTIFIER LV_ERR_ECFPWM_FB_1 ECU_ADDRESS 0xd0007f04 BIT_MASK 0x1 /end MEASUREMENT
/begin MEASUREMENT t_act_ecfpwm_fb[0] "Time with ecfpwm > c_ecfpwm_min_fb necessary to have failure feedback from ECF control unit" UWORD _CNV_A_R_LINEAR_____4_CM 1 100. 0. 6553.5 DISPLAY_IDENTIFIER T_ACT_ECFPWM_FB[0] ECU_ADDRESS 0xd000266a FORMAT "%5.1" /end MEASUREMENT
/begin MEASUREMENT t_act_ecfpwm_fb[1] "Time with ecfpwm > c_ecfpwm_min_fb necessary to have failure feedback from ECF control unit" UWORD _CNV_A_R_LINEAR_____4_CM 1 100. 0. 6553.5 DISPLAY_IDENTIFIER T_ACT_ECFPWM_FB[1] ECU_ADDRESS 0xd000266c FORMAT "%5.1" /end MEASUREMENT
/begin MEASUREMENT t_ecfpwm_fb[0] "Timer counting tlow for failure feedback recognition" UBYTE _CNV_A_R_LINEAR_____4_CM 1 100. 0. 25.5 DISPLAY_IDENTIFIER T_ECFPWM_FB[0] ECU_ADDRESS 0xd0002694 FORMAT "%4.1" /end MEASUREMENT
/begin MEASUREMENT t_ecfpwm_fb[1] "Timer counting tlow for failure feedback recognition" UBYTE _CNV_A_R_LINEAR_____4_CM 1 100. 0. 25.5 DISPLAY_IDENTIFIER T_ECFPWM_FB[1] ECU_ADDRESS 0xd0002695 FORMAT "%4.1" /end MEASUREMENT
/begin CHARACTERISTIC c_abc_ecfpwm_fb[0] "If c_abc_ecfpwm_fb times sequentially a failure feedback for the same failure is detected, the failure lv_err_ecfpwm_fb is set" VALUE 0xa080283c _REC_VAL_20_u1 254. _CNV_A_R_LINEAR_____0_CM 1. 255. DISPLAY_IDENTIFIER C_ABC_ECFPWM_FB[0] FORMAT "%3.0" /end CHARACTERISTIC
/begin CHARACTERISTIC c_abc_ecfpwm_fb[1] "If c_abc_ecfpwm_fb times sequentially a failure feedback for the same failure is detected, the failure lv_err_ecfpwm_fb is set" VALUE 0xa080283d _REC_VAL_20_u1 254. _CNV_A_R_LINEAR_____0_CM 1. 255. DISPLAY_IDENTIFIER C_ABC_ECFPWM_FB[1] FORMAT "%3.0" /end CHARACTERISTIC
/begin CHARACTERISTIC c_ecfpwm_diag_max[0] "Maximum duty cycle threshold of ECF EL for electrical ECF diagnosis" VALUE 0xa0802852 _REC_VAL_20_u1 99.609375 _CNV_A_R_LINEAR_____5_CM 0. 99.609375 DISPLAY_IDENTIFIER C_ECFPWM_DIAG_MAX[0] /end CHARACTERISTIC
/begin CHARACTERISTIC c_ecfpwm_diag_max[1] "Maximum duty cycle threshold of ECF EL for electrical ECF diagnosis" VALUE 0xa0802853 _REC_VAL_20_u1 99.609375 _CNV_A_R_LINEAR_____5_CM 0. 99.609375 DISPLAY_IDENTIFIER C_ECFPWM_DIAG_MAX[1] /end CHARACTERISTIC
/begin CHARACTERISTIC c_ecfpwm_diag_min[0] "Minimum duty cycle threshold of ECF EL for electrical ECF diagnosis" VALUE 0xa0802854 _REC_VAL_20_u1 99.609375 _CNV_A_R_LINEAR_____5_CM 0. 99.609375 DISPLAY_IDENTIFIER C_ECFPWM_DIAG_MIN[0] /end CHARACTERISTIC
/begin CHARACTERISTIC c_ecfpwm_diag_min[1] "Minimum duty cycle threshold of ECF EL for electrical ECF diagnosis" VALUE 0xa0802855 _REC_VAL_20_u1 99.609375 _CNV_A_R_LINEAR_____5_CM 0. 99.609375 DISPLAY_IDENTIFIER C_ECFPWM_DIAG_MIN[1] /end CHARACTERISTIC
/begin CHARACTERISTIC c_ecfpwm_min_fb[0] "Minimum duty cycle of ecfpwm to have a failure feedback from ECF control unit" VALUE 0xa080285a _REC_VAL_20_u1 99.609375 _CNV_A_R_LINEAR_____5_CM 0. 99.609375 DISPLAY_IDENTIFIER C_ECFPWM_MIN_FB[0] /end CHARACTERISTIC
/begin CHARACTERISTIC c_ecfpwm_min_fb[1] "Minimum duty cycle of ecfpwm to have a failure feedback from ECF control unit" VALUE 0xa080285b _REC_VAL_20_u1 99.609375 _CNV_A_R_LINEAR_____5_CM 0. 99.609375 DISPLAY_IDENTIFIER C_ECFPWM_MIN_FB[1] /end CHARACTERISTIC
/begin CHARACTERISTIC c_t_act_ecfpwm_fb[0] "Minimum time necessary to have failure feedback from ECF control unit" VALUE 0xa080287c _REC_VAL_20_u2 6553.5 _CNV_A_R_LINEAR_____4_CM 0. 6553.5 DISPLAY_IDENTIFIER C_T_ACT_ECFPWM_FB[0] FORMAT "%5.1" /end CHARACTERISTIC
/begin CHARACTERISTIC c_t_act_ecfpwm_fb[1] "Minimum time necessary to have failure feedback from ECF control unit" VALUE 0xa080287e _REC_VAL_20_u2 6553.5 _CNV_A_R_LINEAR_____4_CM 0. 6553.5 DISPLAY_IDENTIFIER C_T_ACT_ECFPWM_FB[1] FORMAT "%5.1" /end CHARACTERISTIC
/begin CHARACTERISTIC c_t_ecfpwm_fb_max[0] "Time range necessary for identification of failure feedback maximal value" VALUE 0xa0802894 _REC_VAL_20_u1 25.5 _CNV_A_R_LINEAR_____4_CM 0. 25.5 DISPLAY_IDENTIFIER C_T_ECFPWM_FB_MAX[0] FORMAT "%4.1" /end CHARACTERISTIC
/begin CHARACTERISTIC c_t_ecfpwm_fb_max[1] "Time range necessary for identification of failure feedback maximal value" VALUE 0xa0802895 _REC_VAL_20_u1 25.5 _CNV_A_R_LINEAR_____4_CM 0. 25.5 DISPLAY_IDENTIFIER C_T_ECFPWM_FB_MAX[1] FORMAT "%4.1" /end CHARACTERISTIC
/begin CHARACTERISTIC c_t_ecfpwm_fb_min[0] "Time range necessary for identification of failure feedback minimal value" VALUE 0xa0802896 _REC_VAL_20_u1 25.5 _CNV_A_R_LINEAR_____4_CM 0. 25.5 DISPLAY_IDENTIFIER C_T_ECFPWM_FB_MIN[0] FORMAT "%4.1" /end CHARACTERISTIC
/begin CHARACTERISTIC c_t_ecfpwm_fb_min[1] "Time range necessary for identification of failure feedback minimal value" VALUE 0xa0802897 _REC_VAL_20_u1 25.5 _CNV_A_R_LINEAR_____4_CM 0. 25.5 DISPLAY_IDENTIFIER C_T_ECFPWM_FB_MIN[1] FORMAT "%4.1" /end CHARACTERISTIC
/begin MEASUREMENT lv_err_ecf_el_1 "Boolean for error currently present on ECF command signal" UBYTE _CNV_S_2_RANGE__0___1_CM 1 100. 0. 1. DISPLAY_IDENTIFIER LV_ERR_ECF_EL_1 ECU_ADDRESS 0xd0007f02 BIT_MASK 0x1 /end MEASUREMENT
/begin CHARACTERISTIC c_abc_inc_ecf_el[0] "Debounce counter increment" VALUE 0xa080283e _REC_VAL_20_u1 255. _CNV_A_R_LINEAR_____0_CM 0. 255. DISPLAY_IDENTIFIER C_ABC_INC_ECF_EL[0] FORMAT "%3.0" /end CHARACTERISTIC
/begin CHARACTERISTIC c_abc_inc_ecf_el[1] "Debounce counter increment" VALUE 0xa080283f _REC_VAL_20_u1 255. _CNV_A_R_LINEAR_____0_CM 0. 255. DISPLAY_IDENTIFIER C_ABC_INC_ECF_EL[1] FORMAT "%3.0" /end CHARACTERISTIC
/begin MEASUREMENT err_ecfpwm_fb[0] "The failure status of the failure feedback coming from the ECF control unit" UBYTE _CNV_A_R_LINEAR_____0_CM 1 100. 0. 255. DISPLAY_IDENTIFIER ERR_ECFPWM_FB[0] ECU_ADDRESS 0xd0007554 FORMAT "%3.0" /end MEASUREMENT
/begin MEASUREMENT err_ecfpwm_fb[1] "The failure status of the failure feedback coming from the ECF control unit" UBYTE _CNV_A_R_LINEAR_____0_CM 1 100. 0. 255. DISPLAY_IDENTIFIER ERR_ECFPWM_FB[1] ECU_ADDRESS 0xd0007555 FORMAT "%3.0" /end MEASUREMENT
/begin MEASUREMENT abc_ecfpwm_fb[0] "The failure status of the failure feedback coming from the ECF control unit" UBYTE _CNV_A_R_LINEAR_____0_CM 1 100. 0. 255. DISPLAY_IDENTIFIER ABC_ECFPWM_FB[0] ECU_ADDRESS 0xd000268c FORMAT "%3.0" /end MEASUREMENT
/begin MEASUREMENT abc_ecfpwm_fb[1] "The failure status of the failure feedback coming from the ECF control unit" UBYTE _CNV_A_R_LINEAR_____0_CM 1 100. 0. 255. DISPLAY_IDENTIFIER ABC_ECFPWM_FB[1] ECU_ADDRESS 0xd000268d FORMAT "%3.0" /end MEASUREMENT
/begin MEASUREMENT cdn_diag_ecf_el[0] " Diagnosis condition for each symptom of ECF_EL " UBYTE _CNV_A_R_LINEAR_____0_CM 1 100. 0. 7. DISPLAY_IDENTIFIER CDN_DIAG_ECF_EL[0] ECU_ADDRESS 0xd000268e FORMAT "%1.0" /end MEASUREMENT
/begin MEASUREMENT cdn_diag_ecf_el[1] " Diagnosis condition for each symptom of ECF_EL " UBYTE _CNV_A_R_LINEAR_____0_CM 1 100. 0. 7. DISPLAY_IDENTIFIER CDN_DIAG_ECF_EL[1] ECU_ADDRESS 0xd000268f FORMAT "%1.0" /end MEASUREMENT
/begin MEASUREMENT cdn_diag_ecfpwm_bas[0] " Diagnosis condition for each symptom of ECF_EL " UBYTE _CNV_A_R_LINEAR_____0_CM 1 100. 0. 7. DISPLAY_IDENTIFIER CDN_DIAG_ECFPWM_BAS[0] ECU_ADDRESS 0xd000754c FORMAT "%1.0" /end MEASUREMENT
/begin MEASUREMENT cdn_diag_ecfpwm_bas[1] " Diagnosis condition for each symptom of ECF_EL " UBYTE _CNV_A_R_LINEAR_____0_CM 1 100. 0. 7. DISPLAY_IDENTIFIER CDN_DIAG_ECFPWM_BAS[1] ECU_ADDRESS 0xd000754d FORMAT "%1.0" /end MEASUREMENT
/begin CHARACTERISTIC c_tam_min_ecfpwm_fb_diag_th "Minimum TAM for enabling ECFPWM_FB-diagnosis" VALUE 0xa08028a3 _REC_VAL_20_u1 190.5 _CNV_A_R_LINEAR_____17_CM -48. 142.5 DISPLAY_IDENTIFIER C_TAM_MIN_ECFPWM_FB_DIAG_TH FORMAT "%6.2" /end CHARACTERISTIC
/begin MEASUREMENT lv_err_ecf_el_2 "Boolean for error currently present on ECF command signal" UBYTE _CNV_S_2_RANGE__0___1_CM 1 100. 0. 1. DISPLAY_IDENTIFIER LV_ERR_ECF_EL_2 ECU_ADDRESS 0xd0007f03 BIT_MASK 0x1 /end MEASUREMENT
/begin MEASUREMENT lv_err_ecfpwm_fb_2 "Error currently present, indicated by failure feedback from ECF control unit" UBYTE _CNV_S_2_RANGE__0___1_CM 1 100. 0. 1. DISPLAY_IDENTIFIER LV_ERR_ECFPWM_FB_2 ECU_ADDRESS 0xd0007f05 BIT_MASK 0x1 /end MEASUREMENT
/begin MEASUREMENT lv_err_ect "Boolean for electronic controlled thermostat error" UBYTE _CNV_S_2_RANGE__0___1_CM 1 100. 0. 1. DISPLAY_IDENTIFIER LV_ERR_ECT ECU_ADDRESS 0xd0007576 BIT_MASK 0x1 /end MEASUREMENT
/begin CHARACTERISTIC c_abc_inc_ect_el "Antibounce counter increment" VALUE 0xa0802840 _REC_VAL_20_u1 255. _CNV_A_R_LINEAR_____0_CM 0. 255. DISPLAY_IDENTIFIER C_ABC_INC_ECT_EL FORMAT "%3.0" /end CHARACTERISTIC
/begin CHARACTERISTIC c_abc_max_ect_el "Maximum value for antibounce counter" VALUE 0xa0802848 _REC_VAL_20_u1 254. _CNV_A_R_LINEAR_____0_CM 1. 255. DISPLAY_IDENTIFIER C_ABC_MAX_ECT_EL FORMAT "%3.0" /end CHARACTERISTIC
/begin CHARACTERISTIC c_ect_el_pwm_diag_max_scg "Maximum  threshold for SCG diagnosis window" VALUE 0xa080285c _REC_VAL_20_u1 99.609375 _CNV_A_R_LINEAR_____5_CM 0. 99.609375 DISPLAY_IDENTIFIER C_ECT_EL_PWM_DIAG_MAX_SCG FORMAT "%9.6" /end CHARACTERISTIC
/begin CHARACTERISTIC c_ect_el_pwm_diag_min_scp "Minimum threshold for SCP diagnosis window" VALUE 0xa080285e _REC_VAL_20_u1 99.609375 _CNV_A_R_LINEAR_____5_CM 0. 99.609375 DISPLAY_IDENTIFIER C_ECT_EL_PWM_DIAG_MIN_SCP FORMAT "%9.6" /end CHARACTERISTIC
/begin CHARACTERISTIC c_ect_el_pwm_diag_min_oc "Minimum threshold for OC diagnosis window" VALUE 0xa080285d _REC_VAL_20_u1 99.609375 _CNV_A_R_LINEAR_____5_CM 0. 99.609375 DISPLAY_IDENTIFIER C_ECT_EL_PWM_DIAG_MIN_OC FORMAT "%9.6" /end CHARACTERISTIC
/begin MEASUREMENT lv_inh_diag_ect_el "flag for ect electronical  signal range diagnosis inhibition" UBYTE _CNV_S_2_RANGE__0___1_CM 1 100. 0. 1. DISPLAY_IDENTIFIER LV_INH_DIAG_ECT_EL ECU_ADDRESS 0xd000757b BIT_MASK 0x1 /end MEASUREMENT
/begin MEASUREMENT state_rbm_tco_2_plaus "Interface of TCO_2 monitor with the Rate-Based Monitoring statistics" UBYTE _CNV_A_R_LINEAR_____0_CM 1 100. 0. 7. DISPLAY_IDENTIFIER STATE_RBM_TCO_2_PLAUS ECU_ADDRESS 0xd000755c FORMAT "%1.0" /end MEASUREMENT
/begin MEASUREMENT lv_inh_diag_tco_2_plaus "Boolean for coolant temperature (radiator outlet) signal plausibility diagnosis inhibit" UBYTE _CNV_S_2_RANGE__0___1_CM 1 100. 0. 1. DISPLAY_IDENTIFIER LV_INH_DIAG_TCO_2_PLAUS ECU_ADDRESS 0xd0007581 BIT_MASK 0x1 /end MEASUREMENT
/begin MEASUREMENT lv_inh_diag_rbm_tco_2_plaus "Boolean for coolant temperature (radiator outlet) signal plausibility diagnosis inhibit due to OBD error" UBYTE _CNV_S_2_RANGE__0___1_CM 1 100. 0. 1. DISPLAY_IDENTIFIER LV_INH_DIAG_RBM_TCO_2_PLAUS ECU_ADDRESS 0xd00026b8 BIT_MASK 0x1 /end MEASUREMENT
/begin MEASUREMENT lv_tco_2_plaus_ena_ext "Boolean for coolant temperature (radiator outlet) signal plausibility diagnosis external enable" UBYTE _CNV_S_2_RANGE__0___1_CM 1 100. 0. 1. DISPLAY_IDENTIFIER LV_TCO_2_PLAUS_ENA_EXT ECU_ADDRESS 0xd0007588 BIT_MASK 0x1 /end MEASUREMENT
/begin CHARACTERISTIC c_ectpwm_min_tco_2_plaus "Minimum ECTPWM to expect a change in TCO_2" VALUE 0xa0802866 _REC_VAL_20_u2 99.99847412109381 _CNV_A_R_LINEAR_____8_CM 0. 99.99847412109381 DISPLAY_IDENTIFIER C_ECTPWM_MIN_TCO_2_PLAUS /end CHARACTERISTIC
/begin CHARACTERISTIC c_abc_max_tco_el "Debounce counter maximum value - TCO diagnosis" VALUE 0xa080284b _REC_VAL_20_u1 254. _CNV_A_R_LINEAR_____0_CM 1. 255. DISPLAY_IDENTIFIER C_ABC_MAX_TCO_EL FORMAT "%3.0" /end CHARACTERISTIC
/begin CHARACTERISTIC c_abc_inc_tco_grd "Debounce counter increment - TCO Signal gradient diagnosis" VALUE 0xa0802844 _REC_VAL_20_u1 255. _CNV_A_R_LINEAR_____0_CM 0. 255. DISPLAY_IDENTIFIER C_ABC_INC_TCO_GRD FORMAT "%3.0" /end CHARACTERISTIC
/begin CHARACTERISTIC c_abc_max_tco_grd "Debounce counter maximum value - TCO Signal gradient diagnosis" VALUE 0xa080284c _REC_VAL_20_u1 254. _CNV_A_R_LINEAR_____0_CM 1. 255. DISPLAY_IDENTIFIER C_ABC_MAX_TCO_GRD FORMAT "%3.0" /end CHARACTERISTIC
/begin MEASUREMENT lv_inh_diag_tco_el "TCO Signal range diagnosis inhibition" UBYTE _CNV_S_2_RANGE__0___1_CM 1 100. 0. 1. DISPLAY_IDENTIFIER LV_INH_DIAG_TCO_EL ECU_ADDRESS 0xd0007582 BIT_MASK 0x1 /end MEASUREMENT
/begin CHARACTERISTIC c_abc_inc_tco_el "Debounce counter increment- TCO diagnosis" VALUE 0xa0802843 _REC_VAL_20_u1 255. _CNV_A_R_LINEAR_____0_CM 0. 255. DISPLAY_IDENTIFIER C_ABC_INC_TCO_EL FORMAT "%3.0" /end CHARACTERISTIC
/begin MEASUREMENT lv_inh_diag_tco_stuck "TCO Signal stuck diagnosis inhibition" UBYTE _CNV_S_2_RANGE__0___1_CM 1 100. 0. 1. DISPLAY_IDENTIFIER LV_INH_DIAG_TCO_STUCK ECU_ADDRESS 0xd0007585 BIT_MASK 0x1 /end MEASUREMENT
/begin MEASUREMENT lv_inh_diag_tco_grd "TCO Signal gradiant diagnosis inhibition" UBYTE _CNV_S_2_RANGE__0___1_CM 1 100. 0. 1. DISPLAY_IDENTIFIER LV_INH_DIAG_TCO_GRD ECU_ADDRESS 0xd0007583 BIT_MASK 0x1 /end MEASUREMENT
/begin MEASUREMENT state_rbm_tco_stuck "Interface of TCO_STUCK monitor with the Rate-Based Monitoring statistics" UBYTE _CNV_A_R_LINEAR_____0_CM 1 100. 0. 7. DISPLAY_IDENTIFIER STATE_RBM_TCO_STUCK ECU_ADDRESS 0xd000755e FORMAT "%1.0" /end MEASUREMENT
/begin MEASUREMENT lv_inh_diag_rbm_tco_stuck "Temperature stuck signal diagnosis inhibition due to OBD error" UBYTE _CNV_S_2_RANGE__0___1_CM 1 100. 0. 1. DISPLAY_IDENTIFIER LV_INH_DIAG_RBM_TCO_STUCK ECU_ADDRESS 0xd000757d BIT_MASK 0x1 /end MEASUREMENT
/begin MEASUREMENT lv_err_tco_2_el "Boolean for coolant temperature (radiator outlet) signal range error" UBYTE _CNV_S_2_RANGE__0___1_CM 1 100. 0. 1. DISPLAY_IDENTIFIER LV_ERR_TCO_2_EL ECU_ADDRESS 0xd0007efe BIT_MASK 0x1 /end MEASUREMENT
/begin MEASUREMENT lv_err_tco_2_grd "Boolean for coolant temperature (radiator outlet) signal gradient error" UBYTE _CNV_S_2_RANGE__0___1_CM 1 100. 0. 1. DISPLAY_IDENTIFIER LV_ERR_TCO_2_GRD ECU_ADDRESS 0xd0007eff BIT_MASK 0x1 /end MEASUREMENT
/begin CHARACTERISTIC c_tia_thr_min_diag_tco_2_el "Minimum intake air temperature value for the coolant temperature (radiator outlet) electrical diagnosis" VALUE 0xa08028bc _REC_VAL_20_u1 190.5 _CNV_A_R_LINEAR_____17_CM -48. 142.5 DISPLAY_IDENTIFIER C_TIA_THR_MIN_DIAG_TCO_2_EL FORMAT "%6.2" /end CHARACTERISTIC
/begin CHARACTERISTIC c_t_ast_min_diag_tco_2_el "Minimum time delay after start for the coolant temperature (radiator outlet) electrical diagnosis" VALUE 0xa0802880 _REC_VAL_20_u2 65535. _CNV_A_R_LINEAR_____36_CM 0. 65535. DISPLAY_IDENTIFIER C_T_AST_MIN_DIAG_TCO_2_EL FORMAT "%5.0" /end CHARACTERISTIC
/begin MEASUREMENT lv_err_tco_2_prel "Boolean for preliminary error currently present on coolant temperature (radiator outlet) acquisition" UBYTE _CNV_S_2_RANGE__0___1_CM 1 100. 0. 1. DISPLAY_IDENTIFIER LV_ERR_TCO_2_PREL ECU_ADDRESS 0xd0007579 BIT_MASK 0x1 /end MEASUREMENT
/begin MEASUREMENT lv_err_tco_2 "Boolean for error currently present on coolant temperature (radiator outlet) acquisition" UBYTE _CNV_S_2_RANGE__0___1_CM 1 100. 0. 1. DISPLAY_IDENTIFIER LV_ERR_TCO_2 ECU_ADDRESS 0xd0007578 BIT_MASK 0x1 /end MEASUREMENT
/begin MEASUREMENT lv_err_tco_2_prel_det "Boolean for preliminary error present on coolant temperature (radiator outlet) acquisition during driving cycle" UBYTE _CNV_S_2_RANGE__0___1_CM 1 100. 0. 1. DISPLAY_IDENTIFIER LV_ERR_TCO_2_PREL_DET ECU_ADDRESS 0xd00026b6 BIT_MASK 0x1 /end MEASUREMENT
/begin MEASUREMENT lv_cdn_ena_tco_2_prel "Boolean for preliminary coolant temperature (radiator outlet) error enable conditions" UBYTE _CNV_S_2_RANGE__0___1_CM 1 100. 0. 1. DISPLAY_IDENTIFIER LV_CDN_ENA_TCO_2_PREL ECU_ADDRESS 0xd00026ad BIT_MASK 0x1 /end MEASUREMENT
/begin CHARACTERISTIC c_ctr_abc_thd_tco_2_prel "Threshold for anti-bounce counter value for preliminary coolant temperature (radiator outlet) error detection" VALUE 0xa080284e _REC_VAL_20_u1 255. _CNV_A_R_LINEAR_____0_CM 0. 255. DISPLAY_IDENTIFIER C_CTR_ABC_THD_TCO_2_PREL FORMAT "%3.0" /end CHARACTERISTIC
/begin CHARACTERISTIC c_tco_2_mes_grd_max_diag_tco_2 "Maximum coolant temperature gradient for the coolant temperature (radiator outlet) gradient diagnosis" VALUE 0xa08028a8 _REC_VAL_20_u1 190.5 _CNV_A_R_LINEAR_____25_CM 0. 190.5 DISPLAY_IDENTIFIER C_TCO_2_MES_GRD_MAX_DIAG_TCO_2 FORMAT "%6.2" /end CHARACTERISTIC
/begin CHARACTERISTIC c_vp_tco_2_max_diag_tco_2_el "Maximum raw sensor signal voltage for the coolant temperature (radiator outlet) electrical diagnosis" VALUE 0xa08028c2 _REC_VAL_20_u2 4.999847 _CNV_A_R_LINEAR_____172_CM 0. 4.999847 DISPLAY_IDENTIFIER C_VP_TCO_2_MAX_DIAG_TCO_2_EL FORMAT "%6.4" /end CHARACTERISTIC
/begin CHARACTERISTIC c_vp_tco_2_min_diag_tco_2_el "Minimum raw sensor signal voltage for the coolant temperature (radiator outlet) electrical diagnosis" VALUE 0xa08028c4 _REC_VAL_20_u2 4.999847 _CNV_A_R_LINEAR_____172_CM 0. 4.999847 DISPLAY_IDENTIFIER C_VP_TCO_2_MIN_DIAG_TCO_2_EL FORMAT "%6.4" /end CHARACTERISTIC
/begin MEASUREMENT lv_inh_diag_tco_2_el "TCO Signal range diagnosis inhibition" UBYTE _CNV_S_2_RANGE__0___1_CM 1 100. 0. 1. DISPLAY_IDENTIFIER LV_INH_DIAG_TCO_2_EL ECU_ADDRESS 0xd000757f BIT_MASK 0x1 /end MEASUREMENT
/begin MEASUREMENT lv_inh_diag_tco_2_grd "TCO Signal range diagnosis inhibition" UBYTE _CNV_S_2_RANGE__0___1_CM 1 100. 0. 1. DISPLAY_IDENTIFIER LV_INH_DIAG_TCO_2_GRD ECU_ADDRESS 0xd0007580 BIT_MASK 0x1 /end MEASUREMENT
/begin CHARACTERISTIC c_abc_inc_tco_2_el "Debounce counter increment- TCO 2 diagnosis" VALUE 0xa0802841 _REC_VAL_20_u1 255. _CNV_A_R_LINEAR_____0_CM 0. 255. DISPLAY_IDENTIFIER C_ABC_INC_TCO_2_EL FORMAT "%3.0" /end CHARACTERISTIC
/begin CHARACTERISTIC c_abc_inc_tco_2_grd "Debounce counter increment- TCO 2 diagnosis" VALUE 0xa0802842 _REC_VAL_20_u1 255. _CNV_A_R_LINEAR_____0_CM 0. 255. DISPLAY_IDENTIFIER C_ABC_INC_TCO_2_GRD FORMAT "%3.0" /end CHARACTERISTIC
/begin CHARACTERISTIC c_abc_max_tco_2_grd "Debounce counter max- TCO 2 diagnosis" VALUE 0xa080284a _REC_VAL_20_u1 254. _CNV_A_R_LINEAR_____0_CM 1. 255. DISPLAY_IDENTIFIER C_ABC_MAX_TCO_2_GRD FORMAT "%3.0" /end CHARACTERISTIC
/begin CHARACTERISTIC c_abc_max_tco_2_el "Debounce counter max- TCO 2 diagnosis" VALUE 0xa0802849 _REC_VAL_20_u1 254. _CNV_A_R_LINEAR_____0_CM 1. 255. DISPLAY_IDENTIFIER C_ABC_MAX_TCO_2_EL FORMAT "%3.0" /end CHARACTERISTIC
/begin CHARACTERISTIC c_cpu_load_per "Time between two measurement session" VALUE 0xa080c658 _REC_VAL_20_u2 65535. _CNV_A_R_LINEAR_____0_CM 0. 65535. DISPLAY_IDENTIFIER C_CPU_LOAD_PER FORMAT "%5.0" /end CHARACTERISTIC
/begin CHARACTERISTIC c_cpu_load_ses_t_begin "Beginning of measurement session" VALUE 0xa080c65a _REC_VAL_20_u2 65535. _CNV_A_R_LINEAR_____0_CM 0. 65535. DISPLAY_IDENTIFIER C_CPU_LOAD_SES_T_BEGIN FORMAT "%5.0" /end CHARACTERISTIC
/begin CHARACTERISTIC c_cpu_load_ses_t_end "End of measurement session" VALUE 0xa080c65c _REC_VAL_20_u2 65535. _CNV_A_R_LINEAR_____0_CM 0. 65535. DISPLAY_IDENTIFIER C_CPU_LOAD_SES_T_END FORMAT "%5.0" /end CHARACTERISTIC
/begin CHARACTERISTIC c_cpu_load_tsk_mes_dly "Calibration for acting on measurement task period" VALUE 0xa080c65e _REC_VAL_20_u2 65535. _CNV_A_R_LINEAR_____0_CM 0. 65535. DISPLAY_IDENTIFIER C_CPU_LOAD_TSK_MES_DLY FORMAT "%5.0" /end CHARACTERISTIC
/begin CHARACTERISTIC lc_cpu_load_max_rst "Flag for reset of variable cpu_load_max" VALUE 0xa080c660 _REC_VAL_20_u1 1. _CNV_A_R_LINEAR_____0_CM 0. 1. DISPLAY_IDENTIFIER LC_CPU_LOAD_MAX_RST FORMAT "%1.0" /end CHARACTERISTIC
/begin CHARACTERISTIC lc_cpu_load_tsk_per_min_rst "Flag for reset variable cpu_load_tsk_per_min" VALUE 0xa080c661 _REC_VAL_20_u1 1. _CNV_A_R_LINEAR_____0_CM 0. 1. DISPLAY_IDENTIFIER LC_CPU_LOAD_TSK_PER_MIN_RST FORMAT "%1.0" /end CHARACTERISTIC
/begin CHARACTERISTIC lc_cpu_load_tsk_per_min_upd "Flag for authorizing update of cpu_load_tsk_per_min_save with cpu_load_tsk_per_min" VALUE 0xa080c662 _REC_VAL_20_u1 1. _CNV_A_R_LINEAR_____0_CM 0. 1. DISPLAY_IDENTIFIER LC_CPU_LOAD_TSK_PER_MIN_UPD FORMAT "%1.0" /end CHARACTERISTIC
/begin MEASUREMENT cpu_load_tsk_per_ctr "Counter of TASK_BG_MES instances" UWORD _CNV_A_R_LINEAR_____0_CM 1 100. 0. 65535. DISPLAY_IDENTIFIER CPU_LOAD_TSK_PER_CTR ECU_ADDRESS 0xd000ac44 FORMAT "%5.0" /end MEASUREMENT
/begin MEASUREMENT cpu_load "CPU load above measurement level" UWORD _CNV_A_R_CPULOAD__0_448_CM 1 100. 0. 100. DISPLAY_IDENTIFIER CPU_LOAD ECU_ADDRESS 0xd000ac40 FORMAT "%3.1" /end MEASUREMENT
/begin MEASUREMENT cpu_load_max "Maximum detected CPU load above measurement level" UWORD _CNV_A_R_CPULOAD__0_448_CM 1 100. 0. 100. DISPLAY_IDENTIFIER CPU_LOAD_MAX ECU_ADDRESS 0xd000ac42 FORMAT "%3.1" /end MEASUREMENT
/begin MEASUREMENT cpu_load_tsk_per "Time between2 instances of TASK_BG_MES" ULONG _CNV_A_R_CPULOAD____449_CM 1 100. 0. 4294967295. DISPLAY_IDENTIFIER CPU_LOAD_TSK_PER ECU_ADDRESS 0xd000be80 FORMAT "%10.0" /end MEASUREMENT
/begin MEASUREMENT cpu_load_tsk_per_min_save "Saved minimum time between 2 instances of TASK_BG_MES" ULONG _CNV_A_R_CPULOAD____449_CM 1 100. 0. 4294967295. DISPLAY_IDENTIFIER CPU_LOAD_TSK_PER_MIN_SAVE ECU_ADDRESS 0xd000e898 FORMAT "%10.0" /end MEASUREMENT
/begin MEASUREMENT cpu_load_tsk_per_min "Minimum time between 2 instances of TASK_BG_MES" ULONG _CNV_A_R_CPULOAD____449_CM 1 100. 0. 4294967295. DISPLAY_IDENTIFIER CPU_LOAD_TSK_PER_MIN ECU_ADDRESS 0xd000be7c FORMAT "%10.0" /end MEASUREMENT
/begin MEASUREMENT state_clc_red "Calculation reduction state for runtime optimization" UBYTE _CNV_A_R_LINEAR_____0_CM 1 100. 0. 255. DISPLAY_IDENTIFIER STATE_CLC_RED ECU_ADDRESS 0xd000760f FORMAT "%3.0" /end MEASUREMENT
/begin MEASUREMENT ctr_cyl_nr_st_clc "Number of first cylinder in calculation order " UBYTE _CNV_A_R_LINEAR_____0_CM 1 100. 0. 255. DISPLAY_IDENTIFIER CTR_CYL_NR_ST_CLC ECU_ADDRESS 0xd0007604 FORMAT "%3.0" /end MEASUREMENT
/begin MEASUREMENT ctr_cyl_nr_stop_clc "Number of last cylinder in calculation order" UBYTE _CNV_A_R_LINEAR_____0_CM 1 100. 0. 255. DISPLAY_IDENTIFIER CTR_CYL_NR_STOP_CLC ECU_ADDRESS 0xd0007605 FORMAT "%3.0" /end MEASUREMENT
/begin MEASUREMENT ctr_cbk_in_nr_st_clc "Start number of intake bank for calculations" UBYTE _CNV_A_R_LINEAR_____0_CM 1 100. 0. 255. DISPLAY_IDENTIFIER CTR_CBK_IN_NR_ST_CLC ECU_ADDRESS 0xd0007602 FORMAT "%3.0" /end MEASUREMENT
/begin MEASUREMENT ctr_cbk_in_nr_stop_clc "Stop number of intake bank for calculations" UBYTE _CNV_A_R_LINEAR_____0_CM 1 100. 0. 255. DISPLAY_IDENTIFIER CTR_CBK_IN_NR_STOP_CLC ECU_ADDRESS 0xd0007603 FORMAT "%3.0" /end MEASUREMENT
/begin MEASUREMENT ctr_cbk_ex_nr_st_clc "Start number of exhaust bank for calculations" UBYTE _CNV_A_R_LINEAR_____0_CM 1 100. 0. 255. DISPLAY_IDENTIFIER CTR_CBK_EX_NR_ST_CLC ECU_ADDRESS 0xd0007600 FORMAT "%3.0" /end MEASUREMENT
/begin MEASUREMENT ctr_cbk_ex_nr_stop_clc "Stop number of exhaust bank for calculations" UBYTE _CNV_A_R_LINEAR_____0_CM 1 100. 0. 255. DISPLAY_IDENTIFIER CTR_CBK_EX_NR_STOP_CLC ECU_ADDRESS 0xd0007601 FORMAT "%3.0" /end MEASUREMENT
/begin CHARACTERISTIC c_n_32_thd_clc_red "engine speed threshold for activation of runtime reaction" VALUE 0xa0805ff7 _REC_VAL_20_u1 8160. _CNV_A_R_LINEAR_____10_CM 0. 8160. DISPLAY_IDENTIFIER C_N_32_THD_CLC_RED FORMAT "%4.0" /end CHARACTERISTIC
/begin CHARACTERISTIC c_n_32_hys_clc_red "engine speed hysteresis for deactivation of runtime reaction" VALUE 0xa0805ff6 _REC_VAL_20_u1 2016. _CNV_A_R_LINEAR_____10_CM 0. 2016. DISPLAY_IDENTIFIER C_N_32_HYS_CLC_RED FORMAT "%4.0" /end CHARACTERISTIC
/begin CHARACTERISTIC c_seg_nr_st_clc_red "start segment number for runtime reduction activation" VALUE 0xa0805ff8 _REC_VAL_20_u1 7. _CNV_A_R_LINEAR_____0_CM 0. 7. DISPLAY_IDENTIFIER C_SEG_NR_ST_CLC_RED FORMAT "%1.0" /end CHARACTERISTIC
/begin CHARACTERISTIC id_ctr_cyl_nr_clc "cylinder and segment relation for runtime reduction" CURVE 0xa0805fe8 _REC_CUR_20_u1_u1 7. _CNV_A_R_LINEAR_____0_CM 0. 7. DISPLAY_IDENTIFIER ID_CTR_CYL_NR_CLC FORMAT "%1.0"
 /begin AXIS_DESCR COM_AXIS seg_nr _CNV_A_R_LINEAR_____0_CM 8 0. 7. FORMAT "%1.0" AXIS_PTS_REF ldp_seg_nr_id_ctr_cyl_nr_clc /end AXIS_DESCR
/end CHARACTERISTIC
/begin AXIS_PTS ldp_seg_nr_id_ctr_cyl_nr_clc "" 0xa0805fdc seg_nr _REC_AXS_20_u1 7. _CNV_A_R_LINEAR_____0_CM 8 0. 7. FORMAT "%1.0" /end AXIS_PTS
/begin MEASUREMENT fac_st_amp "Injection correction at start upon AMP" UBYTE _CNV_A_R_LINEAR_____103_CM 1 100. 0. 1.9921875 DISPLAY_IDENTIFIER FAC_ST_AMP ECU_ADDRESS 0xd0007609 FORMAT "%8.6" /end MEASUREMENT
/begin AXIS_PTS ldp_amp_ip_fac_st_amp "Cranking injection time correction upon ambient pressure" 0xa0805fcc amp _REC_AXS_20_u2 5434. _CNV_A_R_LINEAR_____27_CM 6 0. 5434. FORMAT "%7.2" /end AXIS_PTS
/begin CHARACTERISTIC ip_fac_st_amp "Cranking injection time correction upon ambient pressure" CURVE 0xa0805ff0 _REC_CUR_20_u1_u2 1.9921875 _CNV_A_R_LINEAR_____103_CM 0. 1.9921875 DISPLAY_IDENTIFIER IP_FAC_ST_AMP FORMAT "%8.6"
 /begin AXIS_DESCR COM_AXIS amp _CNV_A_R_LINEAR_____27_CM 6 0. 5434. FORMAT "%7.2" AXIS_PTS_REF ldp_amp_ip_fac_st_amp /end AXIS_DESCR
/end CHARACTERISTIC
/begin AXIS_PTS ldpm_prs_dec_inj_1_injr "" 0xa08062c8 prs_dec_inj_1_hom _REC_AXS_20_u2 347776. _CNV_A_R_LINEAR_____171_CM 6 0. 347776. FORMAT "%8.1" /end AXIS_PTS
/begin MEASUREMENT inh_iv_ext "Shut off pattern for cylinder shut off (cylinder allocated)" UBYTE _CNV_A_R_LINEAR_____0_CM 1 100. 0. 255. DISPLAY_IDENTIFIER INH_IV_EXT ECU_ADDRESS 0xd0007631 FORMAT "%3.0" /end MEASUREMENT
/begin MEASUREMENT lv_scc "even one cylinder bank is shut off" UBYTE _CNV_S_2_RANGE__0___1_CM 1 100. 0. 1. DISPLAY_IDENTIFIER LV_SCC ECU_ADDRESS 0xd000767e /end MEASUREMENT
/begin CHARACTERISTIC c_inh_iv_swi_man "Application constant for manual shut off request" VALUE 0xa080656b _REC_VAL_20_u1 255. _CNV_A_R_LINEAR_____0_CM 0. 255. DISPLAY_IDENTIFIER C_INH_IV_SWI_MAN FORMAT "%3.0" /end CHARACTERISTIC
/begin CHARACTERISTIC lc_inh_iv_diag_err_imdt_ena "Manual switch to activate cylinder shut off immediate after debouncing of an IV error without accordance to MISF" VALUE 0xa08065e4 _REC_VAL_20_u1 1. _CNV_A_R_LINEAR_____0_CM 0. 1. DISPLAY_IDENTIFIER LC_INH_IV_DIAG_ERR_IMDT_ENA FORMAT "%1.0" /end CHARACTERISTIC
/begin MEASUREMENT inh_iv_swi_man "Manual shut off request" UBYTE _CNV_A_R_LINEAR_____0_CM 1 100. 0. 255. DISPLAY_IDENTIFIER INH_IV_SWI_MAN ECU_ADDRESS 0xd0003369 FORMAT "%3.0" /end MEASUREMENT
/begin MEASUREMENT inh_iv_ign_inj_lock_req "Shut off request from ENSD due to backwards rotation detection" UBYTE _CNV_A_R_LINEAR_____0_CM 1 100. 0. 255. DISPLAY_IDENTIFIER INH_IV_IGN_INJ_LOCK_REQ ECU_ADDRESS 0xd0003365 FORMAT "%3.0" /end MEASUREMENT
/begin MEASUREMENT lv_ti_1_hom_min "Flag to indicate that minimum injection time is reached for homogeneous mode, first pulse" UBYTE _CNV_S_2_RANGE__0___1_CM 1 100. 0. 1. DISPLAY_IDENTIFIER LV_TI_1_HOM_MIN ECU_ADDRESS 0xd0007683 BIT_MASK 0x1 /end MEASUREMENT
/begin MEASUREMENT lv_auth_ti_min_afl "Logical variable to authorize homogeneous lean mode if injection time is not to less" UBYTE _CNV_S_2_RANGE__0___1_CM 1 100. 0. 1. DISPLAY_IDENTIFIER LV_AUTH_TI_MIN_AFL ECU_ADDRESS 0xd0007658 BIT_MASK 0x1 /end MEASUREMENT
/begin CHARACTERISTIC c_t_auth_ti_min_afl "Delay time after AFL mode was inhibited due to injection time limitation" VALUE 0xa080658a _REC_VAL_20_u2 655.34 _CNV_A_R_INJR_LINEA_455_CM 1.e-002 655.35 DISPLAY_IDENTIFIER C_T_AUTH_TI_MIN_AFL FORMAT "%6.2" /end CHARACTERISTIC
/begin MEASUREMENT lv_auth_ti_min_s "Logical variable to authorize stratified mode if injection time is not to less" UBYTE _CNV_S_2_RANGE__0___1_CM 1 100. 0. 1. DISPLAY_IDENTIFIER LV_AUTH_TI_MIN_S ECU_ADDRESS 0xd0007659 BIT_MASK 0x1 /end MEASUREMENT
/begin MEASUREMENT lv_ti_2_s_min "Flag to indicate that minimum injection time is reached for stratified mode, second pulse" UBYTE _CNV_S_2_RANGE__0___1_CM 1 100. 0. 1. DISPLAY_IDENTIFIER LV_TI_2_S_MIN ECU_ADDRESS 0xd0007686 BIT_MASK 0x1 /end MEASUREMENT
/begin MEASUREMENT lv_ti_1_s_min "Flag to indicate that minimum injection time is reached for stratified mode, first pulse" UBYTE _CNV_S_2_RANGE__0___1_CM 1 100. 0. 1. DISPLAY_IDENTIFIER LV_TI_1_S_MIN ECU_ADDRESS 0xd0007684 BIT_MASK 0x1 /end MEASUREMENT
/begin MEASUREMENT ti_1_hom_clc_min "Minimum injection time of first pulse, homogeneous mode" UWORD _CNV_A_R_LINEAR_____228_CM 1 100. 0. 65.535 DISPLAY_IDENTIFIER TI_1_HOM_CLC_MIN ECU_ADDRESS 0xd0003348 /end MEASUREMENT
/begin MEASUREMENT ti_1_hom_clc_max "Maximum injection time of first pulse, homogeneous mode" UWORD _CNV_A_R_LINEAR_____228_CM 1 100. 0. 65.535 DISPLAY_IDENTIFIER TI_1_HOM_CLC_MAX ECU_ADDRESS 0xd000708e /end MEASUREMENT
/begin MEASUREMENT ti_1_s_clc_min "Minimum injection time of first pulse, stratified mode" UWORD _CNV_A_R_LINEAR_____228_CM 1 100. 0. 65.535 DISPLAY_IDENTIFIER TI_1_S_CLC_MIN ECU_ADDRESS 0xd000334a /end MEASUREMENT
/begin MEASUREMENT ti_2_s_clc_min "Minimum injection time of second pulse, stratified mode" UWORD _CNV_A_R_LINEAR_____228_CM 1 100. 0. 65.535 DISPLAY_IDENTIFIER TI_2_S_CLC_MIN ECU_ADDRESS 0xd0003350 /end MEASUREMENT
/begin CHARACTERISTIC lc_ti_2_s_man_act "switch for manual setpoint for injection time in startified mode, 2. pulse" VALUE 0xa08065f1 _REC_VAL_20_u1 1. _CNV_A_R_LINEAR_____0_CM 0. 1. DISPLAY_IDENTIFIER LC_TI_2_S_MAN_ACT FORMAT "%1.0" /end CHARACTERISTIC
/begin CHARACTERISTIC lc_ti_1_s_man_act "switch for manual setpoint for injection time in startified mode, 1. pulse" VALUE 0xa08065ef _REC_VAL_20_u1 1. _CNV_A_R_LINEAR_____0_CM 0. 1. DISPLAY_IDENTIFIER LC_TI_1_S_MAN_ACT FORMAT "%1.0" /end CHARACTERISTIC
/begin CHARACTERISTIC c_ti_2_s_man "manual setpoint for injection time in stratified mode,  2. pulse " VALUE 0xa080659c _REC_VAL_20_u2 65.535 _CNV_A_R_LINEAR_____228_CM 0. 65.535 DISPLAY_IDENTIFIER C_TI_2_S_MAN /end CHARACTERISTIC
/begin CHARACTERISTIC lc_ti_1_hom_man_act "Manual switch for manual setpoint for injection time in homogeneous mode, 1. pulse" VALUE 0xa08065ee _REC_VAL_20_u1 1. _CNV_A_R_LINEAR_____0_CM 0. 1. DISPLAY_IDENTIFIER LC_TI_1_HOM_MAN_ACT FORMAT "%1.0" /end CHARACTERISTIC
/begin CHARACTERISTIC c_ti_1_hom_man "Manual setpoint for injection time in homogeneous mode, 1. pulse " VALUE 0xa0806596 _REC_VAL_20_u2 65.535 _CNV_A_R_LINEAR_____228_CM 0. 65.535 DISPLAY_IDENTIFIER C_TI_1_HOM_MAN /end CHARACTERISTIC
/begin CHARACTERISTIC ip_ti_min_hom "Minimum injection time limitation for homogeneous mode" CURVE 0xa08064f4 _REC_CUR_20_u2_u2 65.535 _CNV_A_R_LINEAR_____228_CM 0. 65.535 DISPLAY_IDENTIFIER IP_TI_MIN_HOM
 /begin AXIS_DESCR COM_AXIS prs_dec_inj_1_hom _CNV_A_R_LINEAR_____171_CM 6 0. 347776. FORMAT "%8.1" AXIS_PTS_REF ldpm_prs_dec_inj_1_injr /end AXIS_DESCR
/end CHARACTERISTIC
/begin CHARACTERISTIC ip_ti_min_s "Minimum injection time limitation for stratified mode" CURVE 0xa0806500 _REC_CUR_20_u2_u2 65.535 _CNV_A_R_LINEAR_____228_CM 0. 65.535 DISPLAY_IDENTIFIER IP_TI_MIN_S
 /begin AXIS_DESCR COM_AXIS prs_dec_inj_1_hom _CNV_A_R_LINEAR_____171_CM 6 0. 347776. FORMAT "%8.1" AXIS_PTS_REF ldpm_prs_dec_inj_1_injr /end AXIS_DESCR
/end CHARACTERISTIC
/begin CHARACTERISTIC ip_mff_ti_stnd_egy_h "Injector characteristic at standard conditions, for high energy range" CURVE 0xa0806460 _REC_CUR_20_u2_u2 65.535 _CNV_A_R_LINEAR_____228_CM 0. 65.535 DISPLAY_IDENTIFIER IP_MFF_TI_STND_EGY_H
 /begin AXIS_DESCR COM_AXIS online_dummy _CNV_A_R_LINEAR_____111_CM 16 0. 1389. FORMAT "%7.2" AXIS_PTS_REF ldpm_mff_sp_1_injr /end AXIS_DESCR
/end CHARACTERISTIC
/begin CHARACTERISTIC ip_mff_ti_stnd_egy_l "Injector characteristic at standard conditions, for low energy range" CURVE 0xa0806480 _REC_CUR_20_u2_u2 65.535 _CNV_A_R_LINEAR_____228_CM 0. 65.535 DISPLAY_IDENTIFIER IP_MFF_TI_STND_EGY_L
 /begin AXIS_DESCR COM_AXIS online_dummy _CNV_A_R_LINEAR_____111_CM 16 0. 1389. FORMAT "%7.2" AXIS_PTS_REF ldpm_mff_sp_1_injr /end AXIS_DESCR
/end CHARACTERISTIC
/begin MEASUREMENT ti_min_hom "Minimum injection time limitation for homogeneous mode" UWORD _CNV_A_R_LINEAR_____228_CM 1 100. 0. 65.535 DISPLAY_IDENTIFIER TI_MIN_HOM ECU_ADDRESS 0xd000709e /end MEASUREMENT
/begin MEASUREMENT ti_min_s "Minimum injection time limitation for stratified mode" UWORD _CNV_A_R_LINEAR_____228_CM 1 100. 0. 65.535 DISPLAY_IDENTIFIER TI_MIN_S ECU_ADDRESS 0xd00070a0 /end MEASUREMENT
/begin CHARACTERISTIC c_ti_1_s_man "manual setpoint for injection time in stratified mode,  1. pulse " VALUE 0xa0806598 _REC_VAL_20_u2 65.535 _CNV_A_R_LINEAR_____228_CM 0. 65.535 DISPLAY_IDENTIFIER C_TI_1_S_MAN /end CHARACTERISTIC
/begin CHARACTERISTIC c_ti_min_ofs "Offset to TI_MIN, (injection time limitation at AFL mode and stratified mode)" VALUE 0xa08065d5 _REC_VAL_20_u1 1.02 _CNV_A_R_LINEAR_____456_CM 0. 1.02 DISPLAY_IDENTIFIER C_TI_MIN_OFS FORMAT "%5.3" /end CHARACTERISTIC
/begin CHARACTERISTIC c_ti_min_hys_s "Hysteresis to TI_MIN, (injection time limitation at stratified mode)" VALUE 0xa08065d4 _REC_VAL_20_u1 1.02 _CNV_A_R_LINEAR_____456_CM 0. 1.02 DISPLAY_IDENTIFIER C_TI_MIN_HYS_S FORMAT "%5.3" /end CHARACTERISTIC
/begin AXIS_PTS ldpm_mff_sp_1_injr "" 0xa080627c online_dummy _REC_AXS_20_u2 1389. _CNV_A_R_LINEAR_____111_CM 16 0. 1389. FORMAT "%7.2" /end AXIS_PTS
/begin AXIS_PTS ldp_mff_sp_ip_fac_ti_2_s "" 0xa080611c mff_sp_1_s[0] _REC_AXS_20_u2 1389. _CNV_A_R_LINEAR_____111_CM 12 0. 1389. FORMAT "%7.2" /end AXIS_PTS
/begin MEASUREMENT fac_ti_2_s_dly_cor "Correction factor for mass flow difference at double injection" UWORD _CNV_A_R_LINEAR_____9_CM 1 100. 0. 1.99996948242188 DISPLAY_IDENTIFIER FAC_TI_2_S_DLY_COR ECU_ADDRESS 0xd0003336 FORMAT "%7.5" /end MEASUREMENT
/begin MEASUREMENT fac_ti_2_s_cor "Correction factor for mass flow difference at double injection, caused by duration of the second pulse." UWORD _CNV_A_R_LINEAR_____9_CM 1 100. 0. 1.99996948242188 DISPLAY_IDENTIFIER FAC_TI_2_S_COR ECU_ADDRESS 0xd0003334 FORMAT "%7.5" /end MEASUREMENT
/begin CHARACTERISTIC ip_fac_ti_2_s_dly_cor "correction of the mass flow difference between the mass flow sum of two pulses in comparison with the same requested mass for one pulse" MAP 0xa08115d4 _REC_MAP_20_u2_u2_u2 1.99996948242188 _CNV_A_R_LINEAR_____9_CM 0. 1.99996948242188 DISPLAY_IDENTIFIER IP_FAC_TI_2_S_DLY_COR FORMAT "%7.5"
 /begin AXIS_DESCR COM_AXIS t_dly_1_2_s_ext[0] _CNV_A_R_LINEAR_____228_CM 16 0. 65.535 AXIS_PTS_REF ldp_t_dly_1_2_s_ip_fac_ti_2_s /end AXIS_DESCR
 /begin AXIS_DESCR COM_AXIS mff_sp_1_s[0] _CNV_A_R_LINEAR_____111_CM 12 0. 1389. FORMAT "%7.2" AXIS_PTS_REF ldp_mff_sp_ip_fac_ti_2_s /end AXIS_DESCR
/end CHARACTERISTIC
/begin CHARACTERISTIC ip_fac_ti_2_s_cor "This correction compensate different second injection duration." CURVE 0xa08063e8 _REC_CUR_20_u2_u2 1.99996948242188 _CNV_A_R_LINEAR_____9_CM 0. 1.99996948242188 DISPLAY_IDENTIFIER IP_FAC_TI_2_S_COR FORMAT "%7.5"
 /begin AXIS_DESCR COM_AXIS NO_INPUT_QUANTITY _CNV_A_R_LINEAR_____228_CM 16 0. 65.535 AXIS_PTS_REF ldp_ti_2_s_ip_fac_ti_2_s_cor /end AXIS_DESCR
/end CHARACTERISTIC
/begin AXIS_PTS ldp_t_dly_1_2_s_ip_fac_ti_2_s "correction of the mass flow difference between the mass flow sum of two pulses in comparison with the same requested mass for one pulse" 0xa08061a8 t_dly_1_2_s_ext[0] _REC_AXS_20_u2 65.535 _CNV_A_R_LINEAR_____228_CM 16 0. 65.535 /end AXIS_PTS
/begin AXIS_PTS ldp_ti_2_s_ip_fac_ti_2_s_cor "This correction compensate different second injection duration." 0xa0806210 NO_INPUT_QUANTITY _REC_AXS_20_u2 65.535 _CNV_A_R_LINEAR_____228_CM 16 0. 65.535 /end AXIS_PTS
/begin MEASUREMENT lv_ti_2_hom_min "Flag to indicate that minimum injection time is reached for homogeneous mode, second pulse" UBYTE _CNV_S_2_RANGE__0___1_CM 1 100. 0. 1. DISPLAY_IDENTIFIER LV_TI_2_HOM_MIN ECU_ADDRESS 0xd0007685 BIT_MASK 0x1 /end MEASUREMENT
/begin MEASUREMENT lv_ti_3_hom_min "Flag to indicate that minimum injection time is reached for homogeneous mode, third pulse" UBYTE _CNV_S_2_RANGE__0___1_CM 1 100. 0. 1. DISPLAY_IDENTIFIER LV_TI_3_HOM_MIN ECU_ADDRESS 0xd0007687 BIT_MASK 0x1 /end MEASUREMENT
/begin MEASUREMENT ti_2_hom_clc_min "Minimum injection time of second pulse, homogeneous mode" UWORD _CNV_A_R_LINEAR_____228_CM 1 100. 0. 65.535 DISPLAY_IDENTIFIER TI_2_HOM_CLC_MIN ECU_ADDRESS 0xd000334e /end MEASUREMENT
/begin MEASUREMENT ti_3_hom_clc_min "Minimum injection time of third pulse, homogeneous mode" UWORD _CNV_A_R_LINEAR_____228_CM 1 100. 0. 65.535 DISPLAY_IDENTIFIER TI_3_HOM_CLC_MIN ECU_ADDRESS 0xd0003352 /end MEASUREMENT
/begin MEASUREMENT ti_2_hom_clc_max "Maximum injection time of second pulse, homogeneous mode" UWORD _CNV_A_R_LINEAR_____228_CM 1 100. 0. 65.535 DISPLAY_IDENTIFIER TI_2_HOM_CLC_MAX ECU_ADDRESS 0xd000334c /end MEASUREMENT
/begin MEASUREMENT ti_3_hom_clc_max "Maximum injection time of third pulse, homogeneous mode" UWORD _CNV_A_R_LINEAR_____228_CM 1 100. 0. 65.535 DISPLAY_IDENTIFIER TI_3_HOM_CLC_MAX ECU_ADDRESS 0xd000709a /end MEASUREMENT
/begin CHARACTERISTIC c_ti_2_hom_man "Manual setpoint for injection time in homogeneous mode, 2. pulse " VALUE 0xa080659a _REC_VAL_20_u2 65.535 _CNV_A_R_LINEAR_____228_CM 0. 65.535 DISPLAY_IDENTIFIER C_TI_2_HOM_MAN /end CHARACTERISTIC
/begin CHARACTERISTIC c_ti_3_hom_man "Manual setpoint for injection time in homogeneous mode, 3. pulse " VALUE 0xa080659e _REC_VAL_20_u2 65.535 _CNV_A_R_LINEAR_____228_CM 0. 65.535 DISPLAY_IDENTIFIER C_TI_3_HOM_MAN /end CHARACTERISTIC
/begin CHARACTERISTIC lc_ti_2_hom_man_act "Manual switch for manual setpoint for injection time in homogeneous mode, 2. pulse" VALUE 0xa08065f0 _REC_VAL_20_u1 1. _CNV_A_R_LINEAR_____0_CM 0. 1. DISPLAY_IDENTIFIER LC_TI_2_HOM_MAN_ACT FORMAT "%1.0" /end CHARACTERISTIC
/begin CHARACTERISTIC lc_ti_3_hom_man_act "Manual switch for manual setpoint for injection time in homogeneous mode, 3. pulse" VALUE 0xa08065f2 _REC_VAL_20_u1 1. _CNV_A_R_LINEAR_____0_CM 0. 1. DISPLAY_IDENTIFIER LC_TI_3_HOM_MAN_ACT FORMAT "%1.0" /end CHARACTERISTIC
/begin MEASUREMENT t_dly_1_2_s_ext[0] "Interval between first and second pulse of stratified injection - base value from MSD70 layer" UWORD _CNV_A_R_LINEAR_____228_CM 1 100. 0. 65.535 DISPLAY_IDENTIFIER T_DLY_1_2_S_EXT[0] ECU_ADDRESS 0xd0007078 /end MEASUREMENT
/begin MEASUREMENT t_dly_1_2_s_ext[1] "Interval between first and second pulse of stratified injection - base value from MSD70 layer" UWORD _CNV_A_R_LINEAR_____228_CM 1 100. 0. 65.535 DISPLAY_IDENTIFIER T_DLY_1_2_S_EXT[1] ECU_ADDRESS 0xd000707a /end MEASUREMENT
/begin MEASUREMENT t_dly_1_2_s_ext[2] "Interval between first and second pulse of stratified injection - base value from MSD70 layer" UWORD _CNV_A_R_LINEAR_____228_CM 1 100. 0. 65.535 DISPLAY_IDENTIFIER T_DLY_1_2_S_EXT[2] ECU_ADDRESS 0xd000707c /end MEASUREMENT
/begin MEASUREMENT t_dly_1_2_s_ext[3] "Interval between first and second pulse of stratified injection - base value from MSD70 layer" UWORD _CNV_A_R_LINEAR_____228_CM 1 100. 0. 65.535 DISPLAY_IDENTIFIER T_DLY_1_2_S_EXT[3] ECU_ADDRESS 0xd000707e /end MEASUREMENT
/begin MEASUREMENT t_dly_1_2_s_ext[4] "Interval between first and second pulse of stratified injection - base value from MSD70 layer" UWORD _CNV_A_R_LINEAR_____228_CM 1 100. 0. 65.535 DISPLAY_IDENTIFIER T_DLY_1_2_S_EXT[4] ECU_ADDRESS 0xd0007080 /end MEASUREMENT
/begin MEASUREMENT t_dly_1_2_s_ext[5] "Interval between first and second pulse of stratified injection - base value from MSD70 layer" UWORD _CNV_A_R_LINEAR_____228_CM 1 100. 0. 65.535 DISPLAY_IDENTIFIER T_DLY_1_2_S_EXT[5] ECU_ADDRESS 0xd0007082 /end MEASUREMENT
/begin MEASUREMENT t_dly_1_2_s_ext[6] "Interval between first and second pulse of stratified injection - base value from MSD70 layer" UWORD _CNV_A_R_LINEAR_____228_CM 1 100. 0. 65.535 DISPLAY_IDENTIFIER T_DLY_1_2_S_EXT[6] ECU_ADDRESS 0xd0007084 /end MEASUREMENT
/begin MEASUREMENT t_dly_1_2_s_ext[7] "Interval between first and second pulse of stratified injection - base value from MSD70 layer" UWORD _CNV_A_R_LINEAR_____228_CM 1 100. 0. 65.535 DISPLAY_IDENTIFIER T_DLY_1_2_S_EXT[7] ECU_ADDRESS 0xd0007086 /end MEASUREMENT
/begin CHARACTERISTIC c_t_dly_1_2_s_ext_man "Manual setpoint for time interval between first and second pulse of stratified injection" VALUE 0xa080658c _REC_VAL_20_u2 65.535 _CNV_A_R_LINEAR_____228_CM 0. 65.535 DISPLAY_IDENTIFIER C_T_DLY_1_2_S_EXT_MAN /end CHARACTERISTIC
/begin MEASUREMENT mff_add_reac[0] "Additive fuel amount at reactivation of fuel feed" UWORD _CNV_A_R_LINEAR_____111_CM 1 100. 0. 1389. DISPLAY_IDENTIFIER MFF_ADD_REAC[0] ECU_ADDRESS 0xd0007034 FORMAT "%7.2" /end MEASUREMENT
/begin MEASUREMENT mff_add_reac[1] "Additive fuel amount at reactivation of fuel feed" UWORD _CNV_A_R_LINEAR_____111_CM 1 100. 0. 1389. DISPLAY_IDENTIFIER MFF_ADD_REAC[1] ECU_ADDRESS 0xd0007036 FORMAT "%7.2" /end MEASUREMENT
/begin MEASUREMENT mff_add_reac[2] "Additive fuel amount at reactivation of fuel feed" UWORD _CNV_A_R_LINEAR_____111_CM 1 100. 0. 1389. DISPLAY_IDENTIFIER MFF_ADD_REAC[2] ECU_ADDRESS 0xd0007038 FORMAT "%7.2" /end MEASUREMENT
/begin MEASUREMENT mff_add_reac[3] "Additive fuel amount at reactivation of fuel feed" UWORD _CNV_A_R_LINEAR_____111_CM 1 100. 0. 1389. DISPLAY_IDENTIFIER MFF_ADD_REAC[3] ECU_ADDRESS 0xd000703a FORMAT "%7.2" /end MEASUREMENT
/begin MEASUREMENT mff_add_reac[4] "Additive fuel amount at reactivation of fuel feed" UWORD _CNV_A_R_LINEAR_____111_CM 1 100. 0. 1389. DISPLAY_IDENTIFIER MFF_ADD_REAC[4] ECU_ADDRESS 0xd000703c FORMAT "%7.2" /end MEASUREMENT
/begin MEASUREMENT mff_add_reac[5] "Additive fuel amount at reactivation of fuel feed" UWORD _CNV_A_R_LINEAR_____111_CM 1 100. 0. 1389. DISPLAY_IDENTIFIER MFF_ADD_REAC[5] ECU_ADDRESS 0xd000703e FORMAT "%7.2" /end MEASUREMENT
/begin MEASUREMENT mff_add_reac[6] "Additive fuel amount at reactivation of fuel feed" UWORD _CNV_A_R_LINEAR_____111_CM 1 100. 0. 1389. DISPLAY_IDENTIFIER MFF_ADD_REAC[6] ECU_ADDRESS 0xd0007040 FORMAT "%7.2" /end MEASUREMENT
/begin MEASUREMENT mff_add_reac[7] "Additive fuel amount at reactivation of fuel feed" UWORD _CNV_A_R_LINEAR_____111_CM 1 100. 0. 1389. DISPLAY_IDENTIFIER MFF_ADD_REAC[7] ECU_ADDRESS 0xd0007042 FORMAT "%7.2" /end MEASUREMENT
/begin AXIS_PTS ldp_mff_sp_hom_ip_mff_add_reac "Additive fuel amount at reactivation of fuel feed" 0xa0806108 mff_sp_1_hom[0] _REC_AXS_20_u2 1389. _CNV_A_R_LINEAR_____111_CM 8 0. 1389. FORMAT "%7.2" /end AXIS_PTS
/begin AXIS_PTS ldp_n_ip_mff_add_reac "Additive fuel amount at reactivation of fuel feed" 0xa0806158 n _REC_AXS_20_u2 8160. _CNV_A_R_LINEAR_____14_CM 8 0. 8160. FORMAT "%4.0" /end AXIS_PTS
/begin CHARACTERISTIC ip_mff_add_reac "Additive fuel amount at reactivation of fuel feed" MAP 0xa0811754 _REC_MAP_20_u2_u2_u2 1389. _CNV_A_R_LINEAR_____111_CM 0. 1389. DISPLAY_IDENTIFIER IP_MFF_ADD_REAC FORMAT "%7.2"
 /begin AXIS_DESCR COM_AXIS mff_sp_1_hom[0] _CNV_A_R_LINEAR_____111_CM 8 0. 1389. FORMAT "%7.2" AXIS_PTS_REF ldp_mff_sp_hom_ip_mff_add_reac /end AXIS_DESCR
 /begin AXIS_DESCR COM_AXIS n _CNV_A_R_LINEAR_____14_CM 8 0. 8160. FORMAT "%4.0" AXIS_PTS_REF ldp_n_ip_mff_add_reac /end AXIS_DESCR
/end CHARACTERISTIC
/begin MEASUREMENT fac_n "Factor for conversion of EOI to SOI or SOI to EOI" UWORD _CNV_A_R_INJR_LINEA_457_CM 1 100. 0. 48.96 DISPLAY_IDENTIFIER FAC_N ECU_ADDRESS 0xd000701c /end MEASUREMENT
/begin MEASUREMENT tfu_inj "Fuel temperature for injection system" UBYTE _CNV_A_R_LINEAR_____17_CM 1 100. -48. 142.5 DISPLAY_IDENTIFIER TFU_INJ ECU_ADDRESS 0xd0007656 FORMAT "%6.2" /end MEASUREMENT
/begin CHARACTERISTIC lc_t_dly_1_2_s_ext_man_ena "Switch to enable manual setpoint for time interval between first and second pulse of stratified injection" VALUE 0xa08065eb _REC_VAL_20_u1 1. _CNV_A_R_LINEAR_____0_CM 0. 1. DISPLAY_IDENTIFIER LC_T_DLY_1_2_S_EXT_MAN_ENA FORMAT "%1.0" /end CHARACTERISTIC
/begin MEASUREMENT lv_iv_test_mod_auth "Flag to authorize the injection valve actuator test" UBYTE _CNV_S_2_RANGE__0___1_CM 1 100. 0. 1. DISPLAY_IDENTIFIER LV_IV_TEST_MOD_AUTH ECU_ADDRESS 0xd000767b BIT_MASK 0x1 /end MEASUREMENT
/begin MEASUREMENT lv_n_tooth_end_act "Flag for  indication that engine speed is over N_TOOTH_END" UBYTE _CNV_S_2_RANGE__0___1_CM 1 100. 0. 1. DISPLAY_IDENTIFIER LV_N_TOOTH_END_ACT ECU_ADDRESS 0xd000767c BIT_MASK 0x1 /end MEASUREMENT
/begin MEASUREMENT nr_cyl_iv_test_mod "Logical cylinder number of that cylinder for which the actuator test is in progress" UBYTE _CNV_A_R_LINEAR_____0_CM 1 100. 0. 7. DISPLAY_IDENTIFIER NR_CYL_IV_TEST_MOD ECU_ADDRESS 0xd0007636 FORMAT "%3.0" /end MEASUREMENT
/begin CHARACTERISTIC c_inj_mod_sp_man "Injection mode set-point for manual selection" VALUE 0xa080656c _REC_VAL_20_u1 130. _CNV_S_7_INJR_RANGE_458_CM 1. 131. DISPLAY_IDENTIFIER C_INJ_MOD_SP_MAN /end CHARACTERISTIC
/begin CHARACTERISTIC lc_inj_mod_sp_man_ena "Logical constant to enable manual injection mode selection" VALUE 0xa08065e5 _REC_VAL_20_u1 1. _CNV_A_R_LINEAR_____0_CM 0. 1. DISPLAY_IDENTIFIER LC_INJ_MOD_SP_MAN_ENA FORMAT "%1.0" /end CHARACTERISTIC
/begin MEASUREMENT state_inj_mod_req "Injection mode request for all cylinders for requested combustion mode" UBYTE _CNV_S_7_INJR_RANGE_458_CM 1 100. 1. 131. DISPLAY_IDENTIFIER STATE_INJ_MOD_REQ ECU_ADDRESS 0xd0007649 /end MEASUREMENT
/begin MEASUREMENT state_inj_mod_hom_req "Injection mode request for all cylinders for homogeneous combustion mode" UBYTE _CNV_S_7_INJR_RANGE_458_CM 1 100. 1. 131. DISPLAY_IDENTIFIER STATE_INJ_MOD_HOM_REQ ECU_ADDRESS 0xd0007648 /end MEASUREMENT
/begin MEASUREMENT state_inj_mod_s_req "Injection mode request for all cylinders for stratified combustion mode" UBYTE _CNV_S_7_INJR_RANGE_458_CM 1 100. 1. 131. DISPLAY_IDENTIFIER STATE_INJ_MOD_S_REQ ECU_ADDRESS 0xd000764a /end MEASUREMENT
/begin MEASUREMENT lv_mff_sp_hom_vld "Flag which indicates a valid fuel amount of a t least one cylinder" UBYTE _CNV_S_2_RANGE__0___1_CM 1 100. 0. 1. DISPLAY_IDENTIFIER LV_MFF_SP_HOM_VLD ECU_ADDRESS 0xd00033aa BIT_MASK 0x1 /end MEASUREMENT
/begin MEASUREMENT lv_st_inj_req "Start request flag for the injection driver" UBYTE _CNV_S_2_RANGE__0___1_CM 1 100. 0. 1. DISPLAY_IDENTIFIER LV_ST_INJ_REQ ECU_ADDRESS 0xd0007680 BIT_MASK 0x1 /end MEASUREMENT
/begin CHARACTERISTIC ip_ti_add_dly_hpdi_egy_l "Injector dead time correction for low energy range of the injector" CURVE 0xa08064dc _REC_CUR_20_u2_u2 65535. _CNV_A_R_LINEAR_____413_CM -32768. 32767. DISPLAY_IDENTIFIER IP_TI_ADD_DLY_HPDI_EGY_L FORMAT "%6.0"
 /begin AXIS_DESCR COM_AXIS prs_dec_inj_1_hom _CNV_A_R_LINEAR_____171_CM 6 0. 347776. FORMAT "%8.1" AXIS_PTS_REF ldpm_prs_dec_inj_1_injr /end AXIS_DESCR
/end CHARACTERISTIC
/begin CHARACTERISTIC ip_ti_add_dly_hpdi_egy_h "Injector dead time correction for high energy range of the injector" CURVE 0xa08064d0 _REC_CUR_20_u2_u2 65535. _CNV_A_R_LINEAR_____413_CM -32768. 32767. DISPLAY_IDENTIFIER IP_TI_ADD_DLY_HPDI_EGY_H FORMAT "%6.0"
 /begin AXIS_DESCR COM_AXIS prs_dec_inj_1_hom _CNV_A_R_LINEAR_____171_CM 6 0. 347776. FORMAT "%8.1" AXIS_PTS_REF ldpm_prs_dec_inj_1_injr /end AXIS_DESCR
/end CHARACTERISTIC
/begin MEASUREMENT ti_1_add_dly_s "Injector dead time correction first pulse, stratified mode" SWORD _CNV_A_R_LINEAR_____410_CM 1 100. -32768. 32767. DISPLAY_IDENTIFIER TI_1_ADD_DLY_S ECU_ADDRESS 0xd000708c FORMAT "%6.0" /end MEASUREMENT
/begin MEASUREMENT ti_2_add_dly_s "Injector dead time correction second pulse, stratified mode" SWORD _CNV_A_R_LINEAR_____410_CM 1 100. -32768. 32767. DISPLAY_IDENTIFIER TI_2_ADD_DLY_S ECU_ADDRESS 0xd0007094 FORMAT "%6.0" /end MEASUREMENT
/begin MEASUREMENT ti_1_add_dly "Injector dead time correction first pulse for requested current injection mode" SWORD _CNV_A_R_LINEAR_____410_CM 1 100. -32768. 32767. DISPLAY_IDENTIFIER TI_1_ADD_DLY ECU_ADDRESS 0xd0007088 FORMAT "%6.0" /end MEASUREMENT
/begin MEASUREMENT ti_2_add_dly "Injector dead time correction second pulse for requested current injection mode" SWORD _CNV_A_R_LINEAR_____410_CM 1 100. -32768. 32767. DISPLAY_IDENTIFIER TI_2_ADD_DLY ECU_ADDRESS 0xd0007090 FORMAT "%6.0" /end MEASUREMENT
/begin MEASUREMENT ti_3_add_dly "Injector dead time correction third pulse for requested current injection mode" SWORD _CNV_A_R_LINEAR_____410_CM 1 100. -32768. 32767. DISPLAY_IDENTIFIER TI_3_ADD_DLY ECU_ADDRESS 0xd0007096 FORMAT "%6.0" /end MEASUREMENT
/begin MEASUREMENT ti_1_add_dly_hom "Injector dead time correction first pulse, homogeneous mode" SWORD _CNV_A_R_LINEAR_____410_CM 1 100. -32768. 32767. DISPLAY_IDENTIFIER TI_1_ADD_DLY_HOM ECU_ADDRESS 0xd000708a FORMAT "%6.0" /end MEASUREMENT
/begin MEASUREMENT ti_2_add_dly_hom "Injector dead time correction second pulse, homogeneous mode" SWORD _CNV_A_R_LINEAR_____410_CM 1 100. -32768. 32767. DISPLAY_IDENTIFIER TI_2_ADD_DLY_HOM ECU_ADDRESS 0xd0007092 FORMAT "%6.0" /end MEASUREMENT
/begin MEASUREMENT ti_3_add_dly_hom "Injector dead time correction third pulse, homogeneous mode" SWORD _CNV_A_R_LINEAR_____410_CM 1 100. -32768. 32767. DISPLAY_IDENTIFIER TI_3_ADD_DLY_HOM ECU_ADDRESS 0xd0007098 FORMAT "%6.0" /end MEASUREMENT
/begin MEASUREMENT ti_post_add_dly "Injector dead time correction post pulse" SWORD _CNV_A_R_LINEAR_____410_CM 1 100. -32768. 32767. DISPLAY_IDENTIFIER TI_POST_ADD_DLY ECU_ADDRESS 0xd00070a2 FORMAT "%6.0" /end MEASUREMENT
/begin AXIS_PTS ldp_prs_dec_inj_ip_fac_ti_prs "" 0xa080618c prs_dec_inj_1_hom _REC_AXS_20_u2 347776. _CNV_A_R_LINEAR_____171_CM 12 0. 347776. FORMAT "%8.1" /end AXIS_PTS
/begin CHARACTERISTIC ip_fac_ti_prs "correction factor to compensate the influence of the varying pressure difference at the injector" CURVE 0xa0806420 _REC_CUR_20_u2_u2 15.999755859375 _CNV_A_R_LINEAR_____119_CM 0. 15.999755859375 DISPLAY_IDENTIFIER IP_FAC_TI_PRS FORMAT "%7.4"
 /begin AXIS_DESCR COM_AXIS prs_dec_inj_1_hom _CNV_A_R_LINEAR_____171_CM 12 0. 347776. FORMAT "%8.1" AXIS_PTS_REF ldp_prs_dec_inj_ip_fac_ti_prs /end AXIS_DESCR
/end CHARACTERISTIC
/begin MEASUREMENT prs_dec_inj_1_hom "pressure difference at the injector, 1. pulse" UWORD _CNV_A_R_LINEAR_____171_CM 1 100. 0. 347776. DISPLAY_IDENTIFIER PRS_DEC_INJ_1_HOM ECU_ADDRESS 0xd0007048 FORMAT "%8.1" /end MEASUREMENT
/begin MEASUREMENT fac_ti_1_prs_hom "correction factor to compensate the influence of the varying pressure difference at the injector, 1. pulse" UWORD _CNV_A_R_LINEAR_____119_CM 1 100. 0. 15.999755859375 DISPLAY_IDENTIFIER FAC_TI_1_PRS_HOM ECU_ADDRESS 0xd000701e FORMAT "%7.4" /end MEASUREMENT
/begin MEASUREMENT injr.STR_INJR_ACCTLFINAL0.ti_1_hom[0] "Cylinder individual injection time, homogeneous mode, first pulse (intermediate value)" UWORD _CNV_A_R_LINEAR_____228_CM 1 100. 0. 65.535 DISPLAY_IDENTIFIER TI_1_HOM[0] ECU_ADDRESS 0xd00069dc /end MEASUREMENT
/begin MEASUREMENT injr.STR_INJR_ACCTLFINAL0.ti_1_hom[1] "Cylinder individual injection time, homogeneous mode, first pulse (intermediate value)" UWORD _CNV_A_R_LINEAR_____228_CM 1 100. 0. 65.535 DISPLAY_IDENTIFIER TI_1_HOM[1] ECU_ADDRESS 0xd00069de /end MEASUREMENT
/begin MEASUREMENT injr.STR_INJR_ACCTLFINAL0.ti_1_hom[2] "Cylinder individual injection time, homogeneous mode, first pulse (intermediate value)" UWORD _CNV_A_R_LINEAR_____228_CM 1 100. 0. 65.535 DISPLAY_IDENTIFIER TI_1_HOM[2] ECU_ADDRESS 0xd00069e0 /end MEASUREMENT
/begin MEASUREMENT injr.STR_INJR_ACCTLFINAL0.ti_1_hom[3] "Cylinder individual injection time, homogeneous mode, first pulse (intermediate value)" UWORD _CNV_A_R_LINEAR_____228_CM 1 100. 0. 65.535 DISPLAY_IDENTIFIER TI_1_HOM[3] ECU_ADDRESS 0xd00069e2 /end MEASUREMENT
/begin MEASUREMENT injr.STR_INJR_ACCTLFINAL0.ti_1_hom[4] "Cylinder individual injection time, homogeneous mode, first pulse (intermediate value)" UWORD _CNV_A_R_LINEAR_____228_CM 1 100. 0. 65.535 DISPLAY_IDENTIFIER TI_1_HOM[4] ECU_ADDRESS 0xd00069e4 /end MEASUREMENT
/begin MEASUREMENT injr.STR_INJR_ACCTLFINAL0.ti_1_hom[5] "Cylinder individual injection time, homogeneous mode, first pulse (intermediate value)" UWORD _CNV_A_R_LINEAR_____228_CM 1 100. 0. 65.535 DISPLAY_IDENTIFIER TI_1_HOM[5] ECU_ADDRESS 0xd00069e6 /end MEASUREMENT
/begin MEASUREMENT injr.STR_INJR_ACCTLFINAL0.ti_1_hom[6] "Cylinder individual injection time, homogeneous mode, first pulse (intermediate value)" UWORD _CNV_A_R_LINEAR_____228_CM 1 100. 0. 65.535 DISPLAY_IDENTIFIER TI_1_HOM[6] ECU_ADDRESS 0xd00069e8 /end MEASUREMENT
/begin MEASUREMENT injr.STR_INJR_ACCTLFINAL0.ti_1_hom[7] "Cylinder individual injection time, homogeneous mode, first pulse (intermediate value)" UWORD _CNV_A_R_LINEAR_____228_CM 1 100. 0. 65.535 DISPLAY_IDENTIFIER TI_1_HOM[7] ECU_ADDRESS 0xd00069ea /end MEASUREMENT
/begin MEASUREMENT injr.STR_INJR_ACCTLFINAL0.ti_1_hom_clc[0] "Cylinder individual injection time, homogeneous mode, first pulse (intermediate value)" UWORD _CNV_A_R_LINEAR_____228_CM 1 100. 0. 65.535 DISPLAY_IDENTIFIER TI_1_HOM_CLC[0] ECU_ADDRESS 0xd00069ec /end MEASUREMENT
/begin MEASUREMENT injr.STR_INJR_ACCTLFINAL0.ti_1_hom_clc[1] "Cylinder individual injection time, homogeneous mode, first pulse (intermediate value)" UWORD _CNV_A_R_LINEAR_____228_CM 1 100. 0. 65.535 DISPLAY_IDENTIFIER TI_1_HOM_CLC[1] ECU_ADDRESS 0xd00069ee /end MEASUREMENT
/begin MEASUREMENT injr.STR_INJR_ACCTLFINAL0.ti_1_hom_clc[2] "Cylinder individual injection time, homogeneous mode, first pulse (intermediate value)" UWORD _CNV_A_R_LINEAR_____228_CM 1 100. 0. 65.535 DISPLAY_IDENTIFIER TI_1_HOM_CLC[2] ECU_ADDRESS 0xd00069f0 /end MEASUREMENT
/begin MEASUREMENT injr.STR_INJR_ACCTLFINAL0.ti_1_hom_clc[3] "Cylinder individual injection time, homogeneous mode, first pulse (intermediate value)" UWORD _CNV_A_R_LINEAR_____228_CM 1 100. 0. 65.535 DISPLAY_IDENTIFIER TI_1_HOM_CLC[3] ECU_ADDRESS 0xd00069f2 /end MEASUREMENT
/begin MEASUREMENT injr.STR_INJR_ACCTLFINAL0.ti_1_hom_clc[4] "Cylinder individual injection time, homogeneous mode, first pulse (intermediate value)" UWORD _CNV_A_R_LINEAR_____228_CM 1 100. 0. 65.535 DISPLAY_IDENTIFIER TI_1_HOM_CLC[4] ECU_ADDRESS 0xd00069f4 /end MEASUREMENT
/begin MEASUREMENT injr.STR_INJR_ACCTLFINAL0.ti_1_hom_clc[5] "Cylinder individual injection time, homogeneous mode, first pulse (intermediate value)" UWORD _CNV_A_R_LINEAR_____228_CM 1 100. 0. 65.535 DISPLAY_IDENTIFIER TI_1_HOM_CLC[5] ECU_ADDRESS 0xd00069f6 /end MEASUREMENT
/begin MEASUREMENT injr.STR_INJR_ACCTLFINAL0.ti_1_hom_clc[6] "Cylinder individual injection time, homogeneous mode, first pulse (intermediate value)" UWORD _CNV_A_R_LINEAR_____228_CM 1 100. 0. 65.535 DISPLAY_IDENTIFIER TI_1_HOM_CLC[6] ECU_ADDRESS 0xd00069f8 /end MEASUREMENT
/begin MEASUREMENT injr.STR_INJR_ACCTLFINAL0.ti_1_hom_clc[7] "Cylinder individual injection time, homogeneous mode, first pulse (intermediate value)" UWORD _CNV_A_R_LINEAR_____228_CM 1 100. 0. 65.535 DISPLAY_IDENTIFIER TI_1_HOM_CLC[7] ECU_ADDRESS 0xd00069fa /end MEASUREMENT
/begin MEASUREMENT injr.STR_INJR_ACCTLFINAL0.ti_2_hom[0] "Cylinder individual injection time, homogeneous mode, second pulse (intermediate value)" UWORD _CNV_A_R_LINEAR_____228_CM 1 100. 0. 65.535 DISPLAY_IDENTIFIER TI_2_HOM[0] ECU_ADDRESS 0xd00069fc /end MEASUREMENT
/begin MEASUREMENT injr.STR_INJR_ACCTLFINAL0.ti_2_hom[1] "Cylinder individual injection time, homogeneous mode, second pulse (intermediate value)" UWORD _CNV_A_R_LINEAR_____228_CM 1 100. 0. 65.535 DISPLAY_IDENTIFIER TI_2_HOM[1] ECU_ADDRESS 0xd00069fe /end MEASUREMENT
/begin MEASUREMENT injr.STR_INJR_ACCTLFINAL0.ti_2_hom[2] "Cylinder individual injection time, homogeneous mode, second pulse (intermediate value)" UWORD _CNV_A_R_LINEAR_____228_CM 1 100. 0. 65.535 DISPLAY_IDENTIFIER TI_2_HOM[2] ECU_ADDRESS 0xd0006a00 /end MEASUREMENT
/begin MEASUREMENT injr.STR_INJR_ACCTLFINAL0.ti_2_hom[3] "Cylinder individual injection time, homogeneous mode, second pulse (intermediate value)" UWORD _CNV_A_R_LINEAR_____228_CM 1 100. 0. 65.535 DISPLAY_IDENTIFIER TI_2_HOM[3] ECU_ADDRESS 0xd0006a02 /end MEASUREMENT
/begin MEASUREMENT injr.STR_INJR_ACCTLFINAL0.ti_2_hom[4] "Cylinder individual injection time, homogeneous mode, second pulse (intermediate value)" UWORD _CNV_A_R_LINEAR_____228_CM 1 100. 0. 65.535 DISPLAY_IDENTIFIER TI_2_HOM[4] ECU_ADDRESS 0xd0006a04 /end MEASUREMENT
/begin MEASUREMENT injr.STR_INJR_ACCTLFINAL0.ti_2_hom[5] "Cylinder individual injection time, homogeneous mode, second pulse (intermediate value)" UWORD _CNV_A_R_LINEAR_____228_CM 1 100. 0. 65.535 DISPLAY_IDENTIFIER TI_2_HOM[5] ECU_ADDRESS 0xd0006a06 /end MEASUREMENT
/begin MEASUREMENT injr.STR_INJR_ACCTLFINAL0.ti_2_hom[6] "Cylinder individual injection time, homogeneous mode, second pulse (intermediate value)" UWORD _CNV_A_R_LINEAR_____228_CM 1 100. 0. 65.535 DISPLAY_IDENTIFIER TI_2_HOM[6] ECU_ADDRESS 0xd0006a08 /end MEASUREMENT
/begin MEASUREMENT injr.STR_INJR_ACCTLFINAL0.ti_2_hom[7] "Cylinder individual injection time, homogeneous mode, second pulse (intermediate value)" UWORD _CNV_A_R_LINEAR_____228_CM 1 100. 0. 65.535 DISPLAY_IDENTIFIER TI_2_HOM[7] ECU_ADDRESS 0xd0006a0a /end MEASUREMENT
/begin MEASUREMENT injr.STR_INJR_ACCTLFINAL0.ti_2_hom_clc[0] "Cylinder individual injection time, homogeneous mode, second pulse (intermediate value)" UWORD _CNV_A_R_LINEAR_____228_CM 1 100. 0. 65.535 DISPLAY_IDENTIFIER TI_2_HOM_CLC[0] ECU_ADDRESS 0xd0006a0c /end MEASUREMENT
/begin MEASUREMENT injr.STR_INJR_ACCTLFINAL0.ti_2_hom_clc[1] "Cylinder individual injection time, homogeneous mode, second pulse (intermediate value)" UWORD _CNV_A_R_LINEAR_____228_CM 1 100. 0. 65.535 DISPLAY_IDENTIFIER TI_2_HOM_CLC[1] ECU_ADDRESS 0xd0006a0e /end MEASUREMENT
/begin MEASUREMENT injr.STR_INJR_ACCTLFINAL0.ti_2_hom_clc[2] "Cylinder individual injection time, homogeneous mode, second pulse (intermediate value)" UWORD _CNV_A_R_LINEAR_____228_CM 1 100. 0. 65.535 DISPLAY_IDENTIFIER TI_2_HOM_CLC[2] ECU_ADDRESS 0xd0006a10 /end MEASUREMENT
/begin MEASUREMENT injr.STR_INJR_ACCTLFINAL0.ti_2_hom_clc[3] "Cylinder individual injection time, homogeneous mode, second pulse (intermediate value)" UWORD _CNV_A_R_LINEAR_____228_CM 1 100. 0. 65.535 DISPLAY_IDENTIFIER TI_2_HOM_CLC[3] ECU_ADDRESS 0xd0006a12 /end MEASUREMENT
/begin MEASUREMENT injr.STR_INJR_ACCTLFINAL0.ti_2_hom_clc[4] "Cylinder individual injection time, homogeneous mode, second pulse (intermediate value)" UWORD _CNV_A_R_LINEAR_____228_CM 1 100. 0. 65.535 DISPLAY_IDENTIFIER TI_2_HOM_CLC[4] ECU_ADDRESS 0xd0006a14 /end MEASUREMENT
/begin MEASUREMENT injr.STR_INJR_ACCTLFINAL0.ti_2_hom_clc[5] "Cylinder individual injection time, homogeneous mode, second pulse (intermediate value)" UWORD _CNV_A_R_LINEAR_____228_CM 1 100. 0. 65.535 DISPLAY_IDENTIFIER TI_2_HOM_CLC[5] ECU_ADDRESS 0xd0006a16 /end MEASUREMENT
/begin MEASUREMENT injr.STR_INJR_ACCTLFINAL0.ti_2_hom_clc[6] "Cylinder individual injection time, homogeneous mode, second pulse (intermediate value)" UWORD _CNV_A_R_LINEAR_____228_CM 1 100. 0. 65.535 DISPLAY_IDENTIFIER TI_2_HOM_CLC[6] ECU_ADDRESS 0xd0006a18 /end MEASUREMENT
/begin MEASUREMENT injr.STR_INJR_ACCTLFINAL0.ti_2_hom_clc[7] "Cylinder individual injection time, homogeneous mode, second pulse (intermediate value)" UWORD _CNV_A_R_LINEAR_____228_CM 1 100. 0. 65.535 DISPLAY_IDENTIFIER TI_2_HOM_CLC[7] ECU_ADDRESS 0xd0006a1a /end MEASUREMENT
/begin MEASUREMENT injr.STR_INJR_ACCTLFINAL0.ti_1_s[0] "Cylinder individual injection time, stratified mode, fist pulse (intermediate value)" UWORD _CNV_A_R_LINEAR_____228_CM 1 100. 0. 65.535 DISPLAY_IDENTIFIER TI_1_S[0] ECU_ADDRESS 0xd0006a1c /end MEASUREMENT
/begin MEASUREMENT injr.STR_INJR_ACCTLFINAL0.ti_1_s[1] "Cylinder individual injection time, stratified mode, fist pulse (intermediate value)" UWORD _CNV_A_R_LINEAR_____228_CM 1 100. 0. 65.535 DISPLAY_IDENTIFIER TI_1_S[1] ECU_ADDRESS 0xd0006a1e /end MEASUREMENT
/begin MEASUREMENT injr.STR_INJR_ACCTLFINAL0.ti_1_s[2] "Cylinder individual injection time, stratified mode, fist pulse (intermediate value)" UWORD _CNV_A_R_LINEAR_____228_CM 1 100. 0. 65.535 DISPLAY_IDENTIFIER TI_1_S[2] ECU_ADDRESS 0xd0006a20 /end MEASUREMENT
/begin MEASUREMENT injr.STR_INJR_ACCTLFINAL0.ti_1_s[3] "Cylinder individual injection time, stratified mode, fist pulse (intermediate value)" UWORD _CNV_A_R_LINEAR_____228_CM 1 100. 0. 65.535 DISPLAY_IDENTIFIER TI_1_S[3] ECU_ADDRESS 0xd0006a22 /end MEASUREMENT
/begin MEASUREMENT injr.STR_INJR_ACCTLFINAL0.ti_1_s[4] "Cylinder individual injection time, stratified mode, fist pulse (intermediate value)" UWORD _CNV_A_R_LINEAR_____228_CM 1 100. 0. 65.535 DISPLAY_IDENTIFIER TI_1_S[4] ECU_ADDRESS 0xd0006a24 /end MEASUREMENT
/begin MEASUREMENT injr.STR_INJR_ACCTLFINAL0.ti_1_s[5] "Cylinder individual injection time, stratified mode, fist pulse (intermediate value)" UWORD _CNV_A_R_LINEAR_____228_CM 1 100. 0. 65.535 DISPLAY_IDENTIFIER TI_1_S[5] ECU_ADDRESS 0xd0006a26 /end MEASUREMENT
/begin MEASUREMENT injr.STR_INJR_ACCTLFINAL0.ti_1_s[6] "Cylinder individual injection time, stratified mode, fist pulse (intermediate value)" UWORD _CNV_A_R_LINEAR_____228_CM 1 100. 0. 65.535 DISPLAY_IDENTIFIER TI_1_S[6] ECU_ADDRESS 0xd0006a28 /end MEASUREMENT
/begin MEASUREMENT injr.STR_INJR_ACCTLFINAL0.ti_1_s[7] "Cylinder individual injection time, stratified mode, fist pulse (intermediate value)" UWORD _CNV_A_R_LINEAR_____228_CM 1 100. 0. 65.535 DISPLAY_IDENTIFIER TI_1_S[7] ECU_ADDRESS 0xd0006a2a /end MEASUREMENT
/begin MEASUREMENT injr.STR_INJR_ACCTLFINAL0.ti_2_s[0] "Cylinder individual injection time, stratified mode, second pulse (intermediate value)" UWORD _CNV_A_R_LINEAR_____228_CM 1 100. 0. 65.535 DISPLAY_IDENTIFIER TI_2_S[0] ECU_ADDRESS 0xd0006a2c /end MEASUREMENT
/begin MEASUREMENT injr.STR_INJR_ACCTLFINAL0.ti_2_s[1] "Cylinder individual injection time, stratified mode, second pulse (intermediate value)" UWORD _CNV_A_R_LINEAR_____228_CM 1 100. 0. 65.535 DISPLAY_IDENTIFIER TI_2_S[1] ECU_ADDRESS 0xd0006a2e /end MEASUREMENT
/begin MEASUREMENT injr.STR_INJR_ACCTLFINAL0.ti_2_s[2] "Cylinder individual injection time, stratified mode, second pulse (intermediate value)" UWORD _CNV_A_R_LINEAR_____228_CM 1 100. 0. 65.535 DISPLAY_IDENTIFIER TI_2_S[2] ECU_ADDRESS 0xd0006a30 /end MEASUREMENT
/begin MEASUREMENT injr.STR_INJR_ACCTLFINAL0.ti_2_s[3] "Cylinder individual injection time, stratified mode, second pulse (intermediate value)" UWORD _CNV_A_R_LINEAR_____228_CM 1 100. 0. 65.535 DISPLAY_IDENTIFIER TI_2_S[3] ECU_ADDRESS 0xd0006a32 /end MEASUREMENT
/begin MEASUREMENT injr.STR_INJR_ACCTLFINAL0.ti_2_s[4] "Cylinder individual injection time, stratified mode, second pulse (intermediate value)" UWORD _CNV_A_R_LINEAR_____228_CM 1 100. 0. 65.535 DISPLAY_IDENTIFIER TI_2_S[4] ECU_ADDRESS 0xd0006a34 /end MEASUREMENT
/begin MEASUREMENT injr.STR_INJR_ACCTLFINAL0.ti_2_s[5] "Cylinder individual injection time, stratified mode, second pulse (intermediate value)" UWORD _CNV_A_R_LINEAR_____228_CM 1 100. 0. 65.535 DISPLAY_IDENTIFIER TI_2_S[5] ECU_ADDRESS 0xd0006a36 /end MEASUREMENT
/begin MEASUREMENT injr.STR_INJR_ACCTLFINAL0.ti_2_s[6] "Cylinder individual injection time, stratified mode, second pulse (intermediate value)" UWORD _CNV_A_R_LINEAR_____228_CM 1 100. 0. 65.535 DISPLAY_IDENTIFIER TI_2_S[6] ECU_ADDRESS 0xd0006a38 /end MEASUREMENT
/begin MEASUREMENT injr.STR_INJR_ACCTLFINAL0.ti_2_s[7] "Cylinder individual injection time, stratified mode, second pulse (intermediate value)" UWORD _CNV_A_R_LINEAR_____228_CM 1 100. 0. 65.535 DISPLAY_IDENTIFIER TI_2_S[7] ECU_ADDRESS 0xd0006a3a /end MEASUREMENT
/begin MEASUREMENT injr.STR_INJR_ACCTLFINAL0.ti_1_s_clc[0] "Cylinder individual injection time, stratified mode, fist pulse (intermediate value)" UWORD _CNV_A_R_LINEAR_____228_CM 1 100. 0. 65.535 DISPLAY_IDENTIFIER TI_1_S_CLC[0] ECU_ADDRESS 0xd0006a3c /end MEASUREMENT
/begin MEASUREMENT injr.STR_INJR_ACCTLFINAL0.ti_1_s_clc[1] "Cylinder individual injection time, stratified mode, fist pulse (intermediate value)" UWORD _CNV_A_R_LINEAR_____228_CM 1 100. 0. 65.535 DISPLAY_IDENTIFIER TI_1_S_CLC[1] ECU_ADDRESS 0xd0006a3e /end MEASUREMENT
/begin MEASUREMENT injr.STR_INJR_ACCTLFINAL0.ti_1_s_clc[2] "Cylinder individual injection time, stratified mode, fist pulse (intermediate value)" UWORD _CNV_A_R_LINEAR_____228_CM 1 100. 0. 65.535 DISPLAY_IDENTIFIER TI_1_S_CLC[2] ECU_ADDRESS 0xd0006a40 /end MEASUREMENT
/begin MEASUREMENT injr.STR_INJR_ACCTLFINAL0.ti_1_s_clc[3] "Cylinder individual injection time, stratified mode, fist pulse (intermediate value)" UWORD _CNV_A_R_LINEAR_____228_CM 1 100. 0. 65.535 DISPLAY_IDENTIFIER TI_1_S_CLC[3] ECU_ADDRESS 0xd0006a42 /end MEASUREMENT
/begin MEASUREMENT injr.STR_INJR_ACCTLFINAL0.ti_1_s_clc[4] "Cylinder individual injection time, stratified mode, fist pulse (intermediate value)" UWORD _CNV_A_R_LINEAR_____228_CM 1 100. 0. 65.535 DISPLAY_IDENTIFIER TI_1_S_CLC[4] ECU_ADDRESS 0xd0006a44 /end MEASUREMENT
/begin MEASUREMENT injr.STR_INJR_ACCTLFINAL0.ti_1_s_clc[5] "Cylinder individual injection time, stratified mode, fist pulse (intermediate value)" UWORD _CNV_A_R_LINEAR_____228_CM 1 100. 0. 65.535 DISPLAY_IDENTIFIER TI_1_S_CLC[5] ECU_ADDRESS 0xd0006a46 /end MEASUREMENT
/begin MEASUREMENT injr.STR_INJR_ACCTLFINAL0.ti_1_s_clc[6] "Cylinder individual injection time, stratified mode, fist pulse (intermediate value)" UWORD _CNV_A_R_LINEAR_____228_CM 1 100. 0. 65.535 DISPLAY_IDENTIFIER TI_1_S_CLC[6] ECU_ADDRESS 0xd0006a48 /end MEASUREMENT
/begin MEASUREMENT injr.STR_INJR_ACCTLFINAL0.ti_1_s_clc[7] "Cylinder individual injection time, stratified mode, fist pulse (intermediate value)" UWORD _CNV_A_R_LINEAR_____228_CM 1 100. 0. 65.535 DISPLAY_IDENTIFIER TI_1_S_CLC[7] ECU_ADDRESS 0xd0006a4a /end MEASUREMENT
/begin MEASUREMENT injr.STR_INJR_ACCTLFINAL0.ti_2_s_clc[0] "Cylinder individual injection time, stratified mode, second pulse (intermediate value)" UWORD _CNV_A_R_LINEAR_____228_CM 1 100. 0. 65.535 DISPLAY_IDENTIFIER TI_2_S_CLC[0] ECU_ADDRESS 0xd0006a4c /end MEASUREMENT
/begin MEASUREMENT injr.STR_INJR_ACCTLFINAL0.ti_2_s_clc[1] "Cylinder individual injection time, stratified mode, second pulse (intermediate value)" UWORD _CNV_A_R_LINEAR_____228_CM 1 100. 0. 65.535 DISPLAY_IDENTIFIER TI_2_S_CLC[1] ECU_ADDRESS 0xd0006a4e /end MEASUREMENT
/begin MEASUREMENT injr.STR_INJR_ACCTLFINAL0.ti_2_s_clc[2] "Cylinder individual injection time, stratified mode, second pulse (intermediate value)" UWORD _CNV_A_R_LINEAR_____228_CM 1 100. 0. 65.535 DISPLAY_IDENTIFIER TI_2_S_CLC[2] ECU_ADDRESS 0xd0006a50 /end MEASUREMENT
/begin MEASUREMENT injr.STR_INJR_ACCTLFINAL0.ti_2_s_clc[3] "Cylinder individual injection time, stratified mode, second pulse (intermediate value)" UWORD _CNV_A_R_LINEAR_____228_CM 1 100. 0. 65.535 DISPLAY_IDENTIFIER TI_2_S_CLC[3] ECU_ADDRESS 0xd0006a52 /end MEASUREMENT
/begin MEASUREMENT injr.STR_INJR_ACCTLFINAL0.ti_2_s_clc[4] "Cylinder individual injection time, stratified mode, second pulse (intermediate value)" UWORD _CNV_A_R_LINEAR_____228_CM 1 100. 0. 65.535 DISPLAY_IDENTIFIER TI_2_S_CLC[4] ECU_ADDRESS 0xd0006a54 /end MEASUREMENT
/begin MEASUREMENT injr.STR_INJR_ACCTLFINAL0.ti_2_s_clc[5] "Cylinder individual injection time, stratified mode, second pulse (intermediate value)" UWORD _CNV_A_R_LINEAR_____228_CM 1 100. 0. 65.535 DISPLAY_IDENTIFIER TI_2_S_CLC[5] ECU_ADDRESS 0xd0006a56 /end MEASUREMENT
/begin MEASUREMENT injr.STR_INJR_ACCTLFINAL0.ti_2_s_clc[6] "Cylinder individual injection time, stratified mode, second pulse (intermediate value)" UWORD _CNV_A_R_LINEAR_____228_CM 1 100. 0. 65.535 DISPLAY_IDENTIFIER TI_2_S_CLC[6] ECU_ADDRESS 0xd0006a58 /end MEASUREMENT
/begin MEASUREMENT injr.STR_INJR_ACCTLFINAL0.ti_2_s_clc[7] "Cylinder individual injection time, stratified mode, second pulse (intermediate value)" UWORD _CNV_A_R_LINEAR_____228_CM 1 100. 0. 65.535 DISPLAY_IDENTIFIER TI_2_S_CLC[7] ECU_ADDRESS 0xd0006a5a /end MEASUREMENT
/begin MEASUREMENT injr.STR_INJR_ACCTLFINAL0.ti_1_stnd_hom[0] "Mapped Injection time, homogeneous mode, 1. pulse" UWORD _CNV_A_R_LINEAR_____228_CM 1 100. 0. 65.535 DISPLAY_IDENTIFIER TI_1_STND_HOM[0] ECU_ADDRESS 0xd0006a5c /end MEASUREMENT
/begin MEASUREMENT injr.STR_INJR_ACCTLFINAL0.ti_1_stnd_hom[1] "Mapped Injection time, homogeneous mode, 1. pulse" UWORD _CNV_A_R_LINEAR_____228_CM 1 100. 0. 65.535 DISPLAY_IDENTIFIER TI_1_STND_HOM[1] ECU_ADDRESS 0xd0006a5e /end MEASUREMENT
/begin MEASUREMENT injr.STR_INJR_ACCTLFINAL0.ti_1_stnd_hom[2] "Mapped Injection time, homogeneous mode, 1. pulse" UWORD _CNV_A_R_LINEAR_____228_CM 1 100. 0. 65.535 DISPLAY_IDENTIFIER TI_1_STND_HOM[2] ECU_ADDRESS 0xd0006a60 /end MEASUREMENT
/begin MEASUREMENT injr.STR_INJR_ACCTLFINAL0.ti_1_stnd_hom[3] "Mapped Injection time, homogeneous mode, 1. pulse" UWORD _CNV_A_R_LINEAR_____228_CM 1 100. 0. 65.535 DISPLAY_IDENTIFIER TI_1_STND_HOM[3] ECU_ADDRESS 0xd0006a62 /end MEASUREMENT
/begin MEASUREMENT injr.STR_INJR_ACCTLFINAL0.ti_1_stnd_hom[4] "Mapped Injection time, homogeneous mode, 1. pulse" UWORD _CNV_A_R_LINEAR_____228_CM 1 100. 0. 65.535 DISPLAY_IDENTIFIER TI_1_STND_HOM[4] ECU_ADDRESS 0xd0006a64 /end MEASUREMENT
/begin MEASUREMENT injr.STR_INJR_ACCTLFINAL0.ti_1_stnd_hom[5] "Mapped Injection time, homogeneous mode, 1. pulse" UWORD _CNV_A_R_LINEAR_____228_CM 1 100. 0. 65.535 DISPLAY_IDENTIFIER TI_1_STND_HOM[5] ECU_ADDRESS 0xd0006a66 /end MEASUREMENT
/begin MEASUREMENT injr.STR_INJR_ACCTLFINAL0.ti_1_stnd_hom[6] "Mapped Injection time, homogeneous mode, 1. pulse" UWORD _CNV_A_R_LINEAR_____228_CM 1 100. 0. 65.535 DISPLAY_IDENTIFIER TI_1_STND_HOM[6] ECU_ADDRESS 0xd0006a68 /end MEASUREMENT
/begin MEASUREMENT injr.STR_INJR_ACCTLFINAL0.ti_1_stnd_hom[7] "Mapped Injection time, homogeneous mode, 1. pulse" UWORD _CNV_A_R_LINEAR_____228_CM 1 100. 0. 65.535 DISPLAY_IDENTIFIER TI_1_STND_HOM[7] ECU_ADDRESS 0xd0006a6a /end MEASUREMENT
/begin MEASUREMENT injr.STR_INJR_ACCTLFINAL0.ti_2_stnd_hom[0] "Mapped Injection time, homogeneous mode, 2. pulse" UWORD _CNV_A_R_LINEAR_____228_CM 1 100. 0. 65.535 DISPLAY_IDENTIFIER TI_2_STND_HOM[0] ECU_ADDRESS 0xd0006a6c /end MEASUREMENT
/begin MEASUREMENT injr.STR_INJR_ACCTLFINAL0.ti_2_stnd_hom[1] "Mapped Injection time, homogeneous mode, 2. pulse" UWORD _CNV_A_R_LINEAR_____228_CM 1 100. 0. 65.535 DISPLAY_IDENTIFIER TI_2_STND_HOM[1] ECU_ADDRESS 0xd0006a6e /end MEASUREMENT
/begin MEASUREMENT injr.STR_INJR_ACCTLFINAL0.ti_2_stnd_hom[2] "Mapped Injection time, homogeneous mode, 2. pulse" UWORD _CNV_A_R_LINEAR_____228_CM 1 100. 0. 65.535 DISPLAY_IDENTIFIER TI_2_STND_HOM[2] ECU_ADDRESS 0xd0006a70 /end MEASUREMENT
/begin MEASUREMENT injr.STR_INJR_ACCTLFINAL0.ti_2_stnd_hom[3] "Mapped Injection time, homogeneous mode, 2. pulse" UWORD _CNV_A_R_LINEAR_____228_CM 1 100. 0. 65.535 DISPLAY_IDENTIFIER TI_2_STND_HOM[3] ECU_ADDRESS 0xd0006a72 /end MEASUREMENT
/begin MEASUREMENT injr.STR_INJR_ACCTLFINAL0.ti_2_stnd_hom[4] "Mapped Injection time, homogeneous mode, 2. pulse" UWORD _CNV_A_R_LINEAR_____228_CM 1 100. 0. 65.535 DISPLAY_IDENTIFIER TI_2_STND_HOM[4] ECU_ADDRESS 0xd0006a74 /end MEASUREMENT
/begin MEASUREMENT injr.STR_INJR_ACCTLFINAL0.ti_2_stnd_hom[5] "Mapped Injection time, homogeneous mode, 2. pulse" UWORD _CNV_A_R_LINEAR_____228_CM 1 100. 0. 65.535 DISPLAY_IDENTIFIER TI_2_STND_HOM[5] ECU_ADDRESS 0xd0006a76 /end MEASUREMENT
/begin MEASUREMENT injr.STR_INJR_ACCTLFINAL0.ti_2_stnd_hom[6] "Mapped Injection time, homogeneous mode, 2. pulse" UWORD _CNV_A_R_LINEAR_____228_CM 1 100. 0. 65.535 DISPLAY_IDENTIFIER TI_2_STND_HOM[6] ECU_ADDRESS 0xd0006a78 /end MEASUREMENT
/begin MEASUREMENT injr.STR_INJR_ACCTLFINAL0.ti_2_stnd_hom[7] "Mapped Injection time, homogeneous mode, 2. pulse" UWORD _CNV_A_R_LINEAR_____228_CM 1 100. 0. 65.535 DISPLAY_IDENTIFIER TI_2_STND_HOM[7] ECU_ADDRESS 0xd0006a7a /end MEASUREMENT
/begin MEASUREMENT injr.STR_INJR_ACCTLFINAL0.mff_sp_1_hom_cor_inj[0] "Cylinder individual mass fuel flow set-point for homogeneous mode corrected by piezo energy carryover, first pulse" UWORD _CNV_A_R_LINEAR_____111_CM 1 100. 0. 1389. DISPLAY_IDENTIFIER MFF_SP_1_HOM_COR_INJ[0] ECU_ADDRESS 0xd0006a7c FORMAT "%7.2" /end MEASUREMENT
/begin MEASUREMENT injr.STR_INJR_ACCTLFINAL0.mff_sp_1_hom_cor_inj[1] "Cylinder individual mass fuel flow set-point for homogeneous mode corrected by piezo energy carryover, first pulse" UWORD _CNV_A_R_LINEAR_____111_CM 1 100. 0. 1389. DISPLAY_IDENTIFIER MFF_SP_1_HOM_COR_INJ[1] ECU_ADDRESS 0xd0006a7e FORMAT "%7.2" /end MEASUREMENT
/begin MEASUREMENT injr.STR_INJR_ACCTLFINAL0.mff_sp_1_hom_cor_inj[2] "Cylinder individual mass fuel flow set-point for homogeneous mode corrected by piezo energy carryover, first pulse" UWORD _CNV_A_R_LINEAR_____111_CM 1 100. 0. 1389. DISPLAY_IDENTIFIER MFF_SP_1_HOM_COR_INJ[2] ECU_ADDRESS 0xd0006a80 FORMAT "%7.2" /end MEASUREMENT
/begin MEASUREMENT injr.STR_INJR_ACCTLFINAL0.mff_sp_1_hom_cor_inj[3] "Cylinder individual mass fuel flow set-point for homogeneous mode corrected by piezo energy carryover, first pulse" UWORD _CNV_A_R_LINEAR_____111_CM 1 100. 0. 1389. DISPLAY_IDENTIFIER MFF_SP_1_HOM_COR_INJ[3] ECU_ADDRESS 0xd0006a82 FORMAT "%7.2" /end MEASUREMENT
/begin MEASUREMENT injr.STR_INJR_ACCTLFINAL0.mff_sp_1_hom_cor_inj[4] "Cylinder individual mass fuel flow set-point for homogeneous mode corrected by piezo energy carryover, first pulse" UWORD _CNV_A_R_LINEAR_____111_CM 1 100. 0. 1389. DISPLAY_IDENTIFIER MFF_SP_1_HOM_COR_INJ[4] ECU_ADDRESS 0xd0006a84 FORMAT "%7.2" /end MEASUREMENT
/begin MEASUREMENT injr.STR_INJR_ACCTLFINAL0.mff_sp_1_hom_cor_inj[5] "Cylinder individual mass fuel flow set-point for homogeneous mode corrected by piezo energy carryover, first pulse" UWORD _CNV_A_R_LINEAR_____111_CM 1 100. 0. 1389. DISPLAY_IDENTIFIER MFF_SP_1_HOM_COR_INJ[5] ECU_ADDRESS 0xd0006a86 FORMAT "%7.2" /end MEASUREMENT
/begin MEASUREMENT injr.STR_INJR_ACCTLFINAL0.mff_sp_1_hom_cor_inj[6] "Cylinder individual mass fuel flow set-point for homogeneous mode corrected by piezo energy carryover, first pulse" UWORD _CNV_A_R_LINEAR_____111_CM 1 100. 0. 1389. DISPLAY_IDENTIFIER MFF_SP_1_HOM_COR_INJ[6] ECU_ADDRESS 0xd0006a88 FORMAT "%7.2" /end MEASUREMENT
/begin MEASUREMENT injr.STR_INJR_ACCTLFINAL0.mff_sp_1_hom_cor_inj[7] "Cylinder individual mass fuel flow set-point for homogeneous mode corrected by piezo energy carryover, first pulse" UWORD _CNV_A_R_LINEAR_____111_CM 1 100. 0. 1389. DISPLAY_IDENTIFIER MFF_SP_1_HOM_COR_INJ[7] ECU_ADDRESS 0xd0006a8a FORMAT "%7.2" /end MEASUREMENT
/begin MEASUREMENT injr.STR_INJR_ACCTLFINAL0.mff_sp_2_hom_cor_inj[0] "Cylinder individual mass fuel flow set-point for homogeneous mode corrected by piezo energy carryover, second pulse" UWORD _CNV_A_R_LINEAR_____111_CM 1 100. 0. 1389. DISPLAY_IDENTIFIER MFF_SP_2_HOM_COR_INJ[0] ECU_ADDRESS 0xd0006a8c FORMAT "%7.2" /end MEASUREMENT
/begin MEASUREMENT injr.STR_INJR_ACCTLFINAL0.mff_sp_2_hom_cor_inj[1] "Cylinder individual mass fuel flow set-point for homogeneous mode corrected by piezo energy carryover, second pulse" UWORD _CNV_A_R_LINEAR_____111_CM 1 100. 0. 1389. DISPLAY_IDENTIFIER MFF_SP_2_HOM_COR_INJ[1] ECU_ADDRESS 0xd0006a8e FORMAT "%7.2" /end MEASUREMENT
/begin MEASUREMENT injr.STR_INJR_ACCTLFINAL0.mff_sp_2_hom_cor_inj[2] "Cylinder individual mass fuel flow set-point for homogeneous mode corrected by piezo energy carryover, second pulse" UWORD _CNV_A_R_LINEAR_____111_CM 1 100. 0. 1389. DISPLAY_IDENTIFIER MFF_SP_2_HOM_COR_INJ[2] ECU_ADDRESS 0xd0006a90 FORMAT "%7.2" /end MEASUREMENT
/begin MEASUREMENT injr.STR_INJR_ACCTLFINAL0.mff_sp_2_hom_cor_inj[3] "Cylinder individual mass fuel flow set-point for homogeneous mode corrected by piezo energy carryover, second pulse" UWORD _CNV_A_R_LINEAR_____111_CM 1 100. 0. 1389. DISPLAY_IDENTIFIER MFF_SP_2_HOM_COR_INJ[3] ECU_ADDRESS 0xd0006a92 FORMAT "%7.2" /end MEASUREMENT
/begin MEASUREMENT injr.STR_INJR_ACCTLFINAL0.mff_sp_2_hom_cor_inj[4] "Cylinder individual mass fuel flow set-point for homogeneous mode corrected by piezo energy carryover, second pulse" UWORD _CNV_A_R_LINEAR_____111_CM 1 100. 0. 1389. DISPLAY_IDENTIFIER MFF_SP_2_HOM_COR_INJ[4] ECU_ADDRESS 0xd0006a94 FORMAT "%7.2" /end MEASUREMENT
/begin MEASUREMENT injr.STR_INJR_ACCTLFINAL0.mff_sp_2_hom_cor_inj[5] "Cylinder individual mass fuel flow set-point for homogeneous mode corrected by piezo energy carryover, second pulse" UWORD _CNV_A_R_LINEAR_____111_CM 1 100. 0. 1389. DISPLAY_IDENTIFIER MFF_SP_2_HOM_COR_INJ[5] ECU_ADDRESS 0xd0006a96 FORMAT "%7.2" /end MEASUREMENT
/begin MEASUREMENT injr.STR_INJR_ACCTLFINAL0.mff_sp_2_hom_cor_inj[6] "Cylinder individual mass fuel flow set-point for homogeneous mode corrected by piezo energy carryover, second pulse" UWORD _CNV_A_R_LINEAR_____111_CM 1 100. 0. 1389. DISPLAY_IDENTIFIER MFF_SP_2_HOM_COR_INJ[6] ECU_ADDRESS 0xd0006a98 FORMAT "%7.2" /end MEASUREMENT
/begin MEASUREMENT injr.STR_INJR_ACCTLFINAL0.mff_sp_2_hom_cor_inj[7] "Cylinder individual mass fuel flow set-point for homogeneous mode corrected by piezo energy carryover, second pulse" UWORD _CNV_A_R_LINEAR_____111_CM 1 100. 0. 1389. DISPLAY_IDENTIFIER MFF_SP_2_HOM_COR_INJ[7] ECU_ADDRESS 0xd0006a9a FORMAT "%7.2" /end MEASUREMENT
/begin MEASUREMENT injr.STR_INJR_ACCTLFINAL0.ti_3_hom[0] "Cylinder individual injection time, homogeneous mode, third pulse" UWORD _CNV_A_R_LINEAR_____228_CM 1 100. 0. 65.535 DISPLAY_IDENTIFIER TI_3_HOM[0] ECU_ADDRESS 0xd0006a9c /end MEASUREMENT
/begin MEASUREMENT injr.STR_INJR_ACCTLFINAL0.ti_3_hom[1] "Cylinder individual injection time, homogeneous mode, third pulse" UWORD _CNV_A_R_LINEAR_____228_CM 1 100. 0. 65.535 DISPLAY_IDENTIFIER TI_3_HOM[1] ECU_ADDRESS 0xd0006a9e /end MEASUREMENT
/begin MEASUREMENT injr.STR_INJR_ACCTLFINAL0.ti_3_hom[2] "Cylinder individual injection time, homogeneous mode, third pulse" UWORD _CNV_A_R_LINEAR_____228_CM 1 100. 0. 65.535 DISPLAY_IDENTIFIER TI_3_HOM[2] ECU_ADDRESS 0xd0006aa0 /end MEASUREMENT
/begin MEASUREMENT injr.STR_INJR_ACCTLFINAL0.ti_3_hom[3] "Cylinder individual injection time, homogeneous mode, third pulse" UWORD _CNV_A_R_LINEAR_____228_CM 1 100. 0. 65.535 DISPLAY_IDENTIFIER TI_3_HOM[3] ECU_ADDRESS 0xd0006aa2 /end MEASUREMENT
/begin MEASUREMENT injr.STR_INJR_ACCTLFINAL0.ti_3_hom[4] "Cylinder individual injection time, homogeneous mode, third pulse" UWORD _CNV_A_R_LINEAR_____228_CM 1 100. 0. 65.535 DISPLAY_IDENTIFIER TI_3_HOM[4] ECU_ADDRESS 0xd0006aa4 /end MEASUREMENT
/begin MEASUREMENT injr.STR_INJR_ACCTLFINAL0.ti_3_hom[5] "Cylinder individual injection time, homogeneous mode, third pulse" UWORD _CNV_A_R_LINEAR_____228_CM 1 100. 0. 65.535 DISPLAY_IDENTIFIER TI_3_HOM[5] ECU_ADDRESS 0xd0006aa6 /end MEASUREMENT
/begin MEASUREMENT injr.STR_INJR_ACCTLFINAL0.ti_3_hom[6] "Cylinder individual injection time, homogeneous mode, third pulse" UWORD _CNV_A_R_LINEAR_____228_CM 1 100. 0. 65.535 DISPLAY_IDENTIFIER TI_3_HOM[6] ECU_ADDRESS 0xd0006aa8 /end MEASUREMENT
/begin MEASUREMENT injr.STR_INJR_ACCTLFINAL0.ti_3_hom[7] "Cylinder individual injection time, homogeneous mode, third pulse" UWORD _CNV_A_R_LINEAR_____228_CM 1 100. 0. 65.535 DISPLAY_IDENTIFIER TI_3_HOM[7] ECU_ADDRESS 0xd0006aaa /end MEASUREMENT
/begin MEASUREMENT injr.STR_INJR_ACCTLFINAL0.ti_3_hom_clc[0] "Cylinder individual injection time, homogeneous mode, third pulse (intermediate value)" UWORD _CNV_A_R_LINEAR_____228_CM 1 100. 0. 65.535 DISPLAY_IDENTIFIER TI_3_HOM_CLC[0] ECU_ADDRESS 0xd0006aac /end MEASUREMENT
/begin MEASUREMENT injr.STR_INJR_ACCTLFINAL0.ti_3_hom_clc[1] "Cylinder individual injection time, homogeneous mode, third pulse (intermediate value)" UWORD _CNV_A_R_LINEAR_____228_CM 1 100. 0. 65.535 DISPLAY_IDENTIFIER TI_3_HOM_CLC[1] ECU_ADDRESS 0xd0006aae /end MEASUREMENT
/begin MEASUREMENT injr.STR_INJR_ACCTLFINAL0.ti_3_hom_clc[2] "Cylinder individual injection time, homogeneous mode, third pulse (intermediate value)" UWORD _CNV_A_R_LINEAR_____228_CM 1 100. 0. 65.535 DISPLAY_IDENTIFIER TI_3_HOM_CLC[2] ECU_ADDRESS 0xd0006ab0 /end MEASUREMENT
/begin MEASUREMENT injr.STR_INJR_ACCTLFINAL0.ti_3_hom_clc[3] "Cylinder individual injection time, homogeneous mode, third pulse (intermediate value)" UWORD _CNV_A_R_LINEAR_____228_CM 1 100. 0. 65.535 DISPLAY_IDENTIFIER TI_3_HOM_CLC[3] ECU_ADDRESS 0xd0006ab2 /end MEASUREMENT
/begin MEASUREMENT injr.STR_INJR_ACCTLFINAL0.ti_3_hom_clc[4] "Cylinder individual injection time, homogeneous mode, third pulse (intermediate value)" UWORD _CNV_A_R_LINEAR_____228_CM 1 100. 0. 65.535 DISPLAY_IDENTIFIER TI_3_HOM_CLC[4] ECU_ADDRESS 0xd0006ab4 /end MEASUREMENT
/begin MEASUREMENT injr.STR_INJR_ACCTLFINAL0.ti_3_hom_clc[5] "Cylinder individual injection time, homogeneous mode, third pulse (intermediate value)" UWORD _CNV_A_R_LINEAR_____228_CM 1 100. 0. 65.535 DISPLAY_IDENTIFIER TI_3_HOM_CLC[5] ECU_ADDRESS 0xd0006ab6 /end MEASUREMENT
/begin MEASUREMENT injr.STR_INJR_ACCTLFINAL0.ti_3_hom_clc[6] "Cylinder individual injection time, homogeneous mode, third pulse (intermediate value)" UWORD _CNV_A_R_LINEAR_____228_CM 1 100. 0. 65.535 DISPLAY_IDENTIFIER TI_3_HOM_CLC[6] ECU_ADDRESS 0xd0006ab8 /end MEASUREMENT
/begin MEASUREMENT injr.STR_INJR_ACCTLFINAL0.ti_3_hom_clc[7] "Cylinder individual injection time, homogeneous mode, third pulse (intermediate value)" UWORD _CNV_A_R_LINEAR_____228_CM 1 100. 0. 65.535 DISPLAY_IDENTIFIER TI_3_HOM_CLC[7] ECU_ADDRESS 0xd0006aba /end MEASUREMENT
/begin MEASUREMENT injr.STR_INJR_ACCTLFINAL0.ti_3_stnd_hom[0] "Mapped Injection time, homogeneous mode, 3. pulse" UWORD _CNV_A_R_LINEAR_____228_CM 1 100. 0. 65.535 DISPLAY_IDENTIFIER TI_3_STND_HOM[0] ECU_ADDRESS 0xd0006abc /end MEASUREMENT
/begin MEASUREMENT injr.STR_INJR_ACCTLFINAL0.ti_3_stnd_hom[1] "Mapped Injection time, homogeneous mode, 3. pulse" UWORD _CNV_A_R_LINEAR_____228_CM 1 100. 0. 65.535 DISPLAY_IDENTIFIER TI_3_STND_HOM[1] ECU_ADDRESS 0xd0006abe /end MEASUREMENT
/begin MEASUREMENT injr.STR_INJR_ACCTLFINAL0.ti_3_stnd_hom[2] "Mapped Injection time, homogeneous mode, 3. pulse" UWORD _CNV_A_R_LINEAR_____228_CM 1 100. 0. 65.535 DISPLAY_IDENTIFIER TI_3_STND_HOM[2] ECU_ADDRESS 0xd0006ac0 /end MEASUREMENT
/begin MEASUREMENT injr.STR_INJR_ACCTLFINAL0.ti_3_stnd_hom[3] "Mapped Injection time, homogeneous mode, 3. pulse" UWORD _CNV_A_R_LINEAR_____228_CM 1 100. 0. 65.535 DISPLAY_IDENTIFIER TI_3_STND_HOM[3] ECU_ADDRESS 0xd0006ac2 /end MEASUREMENT
/begin MEASUREMENT injr.STR_INJR_ACCTLFINAL0.ti_3_stnd_hom[4] "Mapped Injection time, homogeneous mode, 3. pulse" UWORD _CNV_A_R_LINEAR_____228_CM 1 100. 0. 65.535 DISPLAY_IDENTIFIER TI_3_STND_HOM[4] ECU_ADDRESS 0xd0006ac4 /end MEASUREMENT
/begin MEASUREMENT injr.STR_INJR_ACCTLFINAL0.ti_3_stnd_hom[5] "Mapped Injection time, homogeneous mode, 3. pulse" UWORD _CNV_A_R_LINEAR_____228_CM 1 100. 0. 65.535 DISPLAY_IDENTIFIER TI_3_STND_HOM[5] ECU_ADDRESS 0xd0006ac6 /end MEASUREMENT
/begin MEASUREMENT injr.STR_INJR_ACCTLFINAL0.ti_3_stnd_hom[6] "Mapped Injection time, homogeneous mode, 3. pulse" UWORD _CNV_A_R_LINEAR_____228_CM 1 100. 0. 65.535 DISPLAY_IDENTIFIER TI_3_STND_HOM[6] ECU_ADDRESS 0xd0006ac8 /end MEASUREMENT
/begin MEASUREMENT injr.STR_INJR_ACCTLFINAL0.ti_3_stnd_hom[7] "Mapped Injection time, homogeneous mode, 3. pulse" UWORD _CNV_A_R_LINEAR_____228_CM 1 100. 0. 65.535 DISPLAY_IDENTIFIER TI_3_STND_HOM[7] ECU_ADDRESS 0xd0006aca /end MEASUREMENT
/begin MEASUREMENT injr.STR_INJR_ACCTLFINAL0.mff_sp_3_hom_cor_inj[0] "Cylinder individual mass fuel flow set-point for homogeneous mode corrected by piezo energy carryover, third pulse" UWORD _CNV_A_R_LINEAR_____111_CM 1 100. 0. 1389. DISPLAY_IDENTIFIER MFF_SP_3_HOM_COR_INJ[0] ECU_ADDRESS 0xd0006acc FORMAT "%7.2" /end MEASUREMENT
/begin MEASUREMENT injr.STR_INJR_ACCTLFINAL0.mff_sp_3_hom_cor_inj[1] "Cylinder individual mass fuel flow set-point for homogeneous mode corrected by piezo energy carryover, third pulse" UWORD _CNV_A_R_LINEAR_____111_CM 1 100. 0. 1389. DISPLAY_IDENTIFIER MFF_SP_3_HOM_COR_INJ[1] ECU_ADDRESS 0xd0006ace FORMAT "%7.2" /end MEASUREMENT
/begin MEASUREMENT injr.STR_INJR_ACCTLFINAL0.mff_sp_3_hom_cor_inj[2] "Cylinder individual mass fuel flow set-point for homogeneous mode corrected by piezo energy carryover, third pulse" UWORD _CNV_A_R_LINEAR_____111_CM 1 100. 0. 1389. DISPLAY_IDENTIFIER MFF_SP_3_HOM_COR_INJ[2] ECU_ADDRESS 0xd0006ad0 FORMAT "%7.2" /end MEASUREMENT
/begin MEASUREMENT injr.STR_INJR_ACCTLFINAL0.mff_sp_3_hom_cor_inj[3] "Cylinder individual mass fuel flow set-point for homogeneous mode corrected by piezo energy carryover, third pulse" UWORD _CNV_A_R_LINEAR_____111_CM 1 100. 0. 1389. DISPLAY_IDENTIFIER MFF_SP_3_HOM_COR_INJ[3] ECU_ADDRESS 0xd0006ad2 FORMAT "%7.2" /end MEASUREMENT
/begin MEASUREMENT injr.STR_INJR_ACCTLFINAL0.mff_sp_3_hom_cor_inj[4] "Cylinder individual mass fuel flow set-point for homogeneous mode corrected by piezo energy carryover, third pulse" UWORD _CNV_A_R_LINEAR_____111_CM 1 100. 0. 1389. DISPLAY_IDENTIFIER MFF_SP_3_HOM_COR_INJ[4] ECU_ADDRESS 0xd0006ad4 FORMAT "%7.2" /end MEASUREMENT
/begin MEASUREMENT injr.STR_INJR_ACCTLFINAL0.mff_sp_3_hom_cor_inj[5] "Cylinder individual mass fuel flow set-point for homogeneous mode corrected by piezo energy carryover, third pulse" UWORD _CNV_A_R_LINEAR_____111_CM 1 100. 0. 1389. DISPLAY_IDENTIFIER MFF_SP_3_HOM_COR_INJ[5] ECU_ADDRESS 0xd0006ad6 FORMAT "%7.2" /end MEASUREMENT
/begin MEASUREMENT injr.STR_INJR_ACCTLFINAL0.mff_sp_3_hom_cor_inj[6] "Cylinder individual mass fuel flow set-point for homogeneous mode corrected by piezo energy carryover, third pulse" UWORD _CNV_A_R_LINEAR_____111_CM 1 100. 0. 1389. DISPLAY_IDENTIFIER MFF_SP_3_HOM_COR_INJ[6] ECU_ADDRESS 0xd0006ad8 FORMAT "%7.2" /end MEASUREMENT
/begin MEASUREMENT injr.STR_INJR_ACCTLFINAL0.mff_sp_3_hom_cor_inj[7] "Cylinder individual mass fuel flow set-point for homogeneous mode corrected by piezo energy carryover, third pulse" UWORD _CNV_A_R_LINEAR_____111_CM 1 100. 0. 1389. DISPLAY_IDENTIFIER MFF_SP_3_HOM_COR_INJ[7] ECU_ADDRESS 0xd0006ada FORMAT "%7.2" /end MEASUREMENT
/begin MEASUREMENT injr.STR_INJR_REQGNS1P0.eoi_1_s[0] "End of the first injection for stratified mode" UWORD _CNV_A_R_LINEAR_____200_CM 1 100. 0. 720. DISPLAY_IDENTIFIER EOI_1_S[0] ECU_ADDRESS 0xd0006adc FORMAT "%7.3" /end MEASUREMENT
/begin MEASUREMENT injr.STR_INJR_REQGNS1P0.eoi_1_s[1] "End of the first injection for stratified mode" UWORD _CNV_A_R_LINEAR_____200_CM 1 100. 0. 720. DISPLAY_IDENTIFIER EOI_1_S[1] ECU_ADDRESS 0xd0006ade FORMAT "%7.3" /end MEASUREMENT
/begin MEASUREMENT injr.STR_INJR_REQGNS1P0.eoi_1_s[2] "End of the first injection for stratified mode" UWORD _CNV_A_R_LINEAR_____200_CM 1 100. 0. 720. DISPLAY_IDENTIFIER EOI_1_S[2] ECU_ADDRESS 0xd0006ae0 FORMAT "%7.3" /end MEASUREMENT
/begin MEASUREMENT injr.STR_INJR_REQGNS1P0.eoi_1_s[3] "End of the first injection for stratified mode" UWORD _CNV_A_R_LINEAR_____200_CM 1 100. 0. 720. DISPLAY_IDENTIFIER EOI_1_S[3] ECU_ADDRESS 0xd0006ae2 FORMAT "%7.3" /end MEASUREMENT
/begin MEASUREMENT injr.STR_INJR_REQGNS1P0.eoi_1_s[4] "End of the first injection for stratified mode" UWORD _CNV_A_R_LINEAR_____200_CM 1 100. 0. 720. DISPLAY_IDENTIFIER EOI_1_S[4] ECU_ADDRESS 0xd0006ae4 FORMAT "%7.3" /end MEASUREMENT
/begin MEASUREMENT injr.STR_INJR_REQGNS1P0.eoi_1_s[5] "End of the first injection for stratified mode" UWORD _CNV_A_R_LINEAR_____200_CM 1 100. 0. 720. DISPLAY_IDENTIFIER EOI_1_S[5] ECU_ADDRESS 0xd0006ae6 FORMAT "%7.3" /end MEASUREMENT
/begin MEASUREMENT injr.STR_INJR_REQGNS1P0.eoi_1_s[6] "End of the first injection for stratified mode" UWORD _CNV_A_R_LINEAR_____200_CM 1 100. 0. 720. DISPLAY_IDENTIFIER EOI_1_S[6] ECU_ADDRESS 0xd0006ae8 FORMAT "%7.3" /end MEASUREMENT
/begin MEASUREMENT injr.STR_INJR_REQGNS1P0.eoi_1_s[7] "End of the first injection for stratified mode" UWORD _CNV_A_R_LINEAR_____200_CM 1 100. 0. 720. DISPLAY_IDENTIFIER EOI_1_S[7] ECU_ADDRESS 0xd0006aea FORMAT "%7.3" /end MEASUREMENT
/begin MEASUREMENT injr.STR_INJR_REQGNS1P0.soi_1_s[0] "Start of the first injection for stratified mode" UWORD _CNV_A_R_LINEAR_____200_CM 1 100. 0. 720. DISPLAY_IDENTIFIER SOI_1_S[0] ECU_ADDRESS 0xd0006aec FORMAT "%7.3" /end MEASUREMENT
/begin MEASUREMENT injr.STR_INJR_REQGNS1P0.soi_1_s[1] "Start of the first injection for stratified mode" UWORD _CNV_A_R_LINEAR_____200_CM 1 100. 0. 720. DISPLAY_IDENTIFIER SOI_1_S[1] ECU_ADDRESS 0xd0006aee FORMAT "%7.3" /end MEASUREMENT
/begin MEASUREMENT injr.STR_INJR_REQGNS1P0.soi_1_s[2] "Start of the first injection for stratified mode" UWORD _CNV_A_R_LINEAR_____200_CM 1 100. 0. 720. DISPLAY_IDENTIFIER SOI_1_S[2] ECU_ADDRESS 0xd0006af0 FORMAT "%7.3" /end MEASUREMENT
/begin MEASUREMENT injr.STR_INJR_REQGNS1P0.soi_1_s[3] "Start of the first injection for stratified mode" UWORD _CNV_A_R_LINEAR_____200_CM 1 100. 0. 720. DISPLAY_IDENTIFIER SOI_1_S[3] ECU_ADDRESS 0xd0006af2 FORMAT "%7.3" /end MEASUREMENT
/begin MEASUREMENT injr.STR_INJR_REQGNS1P0.soi_1_s[4] "Start of the first injection for stratified mode" UWORD _CNV_A_R_LINEAR_____200_CM 1 100. 0. 720. DISPLAY_IDENTIFIER SOI_1_S[4] ECU_ADDRESS 0xd0006af4 FORMAT "%7.3" /end MEASUREMENT
/begin MEASUREMENT injr.STR_INJR_REQGNS1P0.soi_1_s[5] "Start of the first injection for stratified mode" UWORD _CNV_A_R_LINEAR_____200_CM 1 100. 0. 720. DISPLAY_IDENTIFIER SOI_1_S[5] ECU_ADDRESS 0xd0006af6 FORMAT "%7.3" /end MEASUREMENT
/begin MEASUREMENT injr.STR_INJR_REQGNS1P0.soi_1_s[6] "Start of the first injection for stratified mode" UWORD _CNV_A_R_LINEAR_____200_CM 1 100. 0. 720. DISPLAY_IDENTIFIER SOI_1_S[6] ECU_ADDRESS 0xd0006af8 FORMAT "%7.3" /end MEASUREMENT
/begin MEASUREMENT injr.STR_INJR_REQGNS1P0.soi_1_s[7] "Start of the first injection for stratified mode" UWORD _CNV_A_R_LINEAR_____200_CM 1 100. 0. 720. DISPLAY_IDENTIFIER SOI_1_S[7] ECU_ADDRESS 0xd0006afa FORMAT "%7.3" /end MEASUREMENT
/begin MEASUREMENT injr.STR_INJR_REQGNS2P0.eoi_2_s[0] "End of the second injection for stratified mode" UWORD _CNV_A_R_LINEAR_____200_CM 1 100. 0. 720. DISPLAY_IDENTIFIER EOI_2_S[0] ECU_ADDRESS 0xd0006afc FORMAT "%7.3" /end MEASUREMENT
/begin MEASUREMENT injr.STR_INJR_REQGNS2P0.eoi_2_s[1] "End of the second injection for stratified mode" UWORD _CNV_A_R_LINEAR_____200_CM 1 100. 0. 720. DISPLAY_IDENTIFIER EOI_2_S[1] ECU_ADDRESS 0xd0006afe FORMAT "%7.3" /end MEASUREMENT
/begin MEASUREMENT injr.STR_INJR_REQGNS2P0.eoi_2_s[2] "End of the second injection for stratified mode" UWORD _CNV_A_R_LINEAR_____200_CM 1 100. 0. 720. DISPLAY_IDENTIFIER EOI_2_S[2] ECU_ADDRESS 0xd0006b00 FORMAT "%7.3" /end MEASUREMENT
/begin MEASUREMENT injr.STR_INJR_REQGNS2P0.eoi_2_s[3] "End of the second injection for stratified mode" UWORD _CNV_A_R_LINEAR_____200_CM 1 100. 0. 720. DISPLAY_IDENTIFIER EOI_2_S[3] ECU_ADDRESS 0xd0006b02 FORMAT "%7.3" /end MEASUREMENT
/begin MEASUREMENT injr.STR_INJR_REQGNS2P0.eoi_2_s[4] "End of the second injection for stratified mode" UWORD _CNV_A_R_LINEAR_____200_CM 1 100. 0. 720. DISPLAY_IDENTIFIER EOI_2_S[4] ECU_ADDRESS 0xd0006b04 FORMAT "%7.3" /end MEASUREMENT
/begin MEASUREMENT injr.STR_INJR_REQGNS2P0.eoi_2_s[5] "End of the second injection for stratified mode" UWORD _CNV_A_R_LINEAR_____200_CM 1 100. 0. 720. DISPLAY_IDENTIFIER EOI_2_S[5] ECU_ADDRESS 0xd0006b06 FORMAT "%7.3" /end MEASUREMENT
/begin MEASUREMENT injr.STR_INJR_REQGNS2P0.eoi_2_s[6] "End of the second injection for stratified mode" UWORD _CNV_A_R_LINEAR_____200_CM 1 100. 0. 720. DISPLAY_IDENTIFIER EOI_2_S[6] ECU_ADDRESS 0xd0006b08 FORMAT "%7.3" /end MEASUREMENT
/begin MEASUREMENT injr.STR_INJR_REQGNS2P0.eoi_2_s[7] "End of the second injection for stratified mode" UWORD _CNV_A_R_LINEAR_____200_CM 1 100. 0. 720. DISPLAY_IDENTIFIER EOI_2_S[7] ECU_ADDRESS 0xd0006b0a FORMAT "%7.3" /end MEASUREMENT
/begin MEASUREMENT injr.STR_INJR_REQGNS2P0.soi_2_s[0] "Start of the second injection for stratified mode" UWORD _CNV_A_R_LINEAR_____200_CM 1 100. 0. 720. DISPLAY_IDENTIFIER SOI_2_S[0] ECU_ADDRESS 0xd0006b0c FORMAT "%7.3" /end MEASUREMENT
/begin MEASUREMENT injr.STR_INJR_REQGNS2P0.soi_2_s[1] "Start of the second injection for stratified mode" UWORD _CNV_A_R_LINEAR_____200_CM 1 100. 0. 720. DISPLAY_IDENTIFIER SOI_2_S[1] ECU_ADDRESS 0xd0006b0e FORMAT "%7.3" /end MEASUREMENT
/begin MEASUREMENT injr.STR_INJR_REQGNS2P0.soi_2_s[2] "Start of the second injection for stratified mode" UWORD _CNV_A_R_LINEAR_____200_CM 1 100. 0. 720. DISPLAY_IDENTIFIER SOI_2_S[2] ECU_ADDRESS 0xd0006b10 FORMAT "%7.3" /end MEASUREMENT
/begin MEASUREMENT injr.STR_INJR_REQGNS2P0.soi_2_s[3] "Start of the second injection for stratified mode" UWORD _CNV_A_R_LINEAR_____200_CM 1 100. 0. 720. DISPLAY_IDENTIFIER SOI_2_S[3] ECU_ADDRESS 0xd0006b12 FORMAT "%7.3" /end MEASUREMENT
/begin MEASUREMENT injr.STR_INJR_REQGNS2P0.soi_2_s[4] "Start of the second injection for stratified mode" UWORD _CNV_A_R_LINEAR_____200_CM 1 100. 0. 720. DISPLAY_IDENTIFIER SOI_2_S[4] ECU_ADDRESS 0xd0006b14 FORMAT "%7.3" /end MEASUREMENT
/begin MEASUREMENT injr.STR_INJR_REQGNS2P0.soi_2_s[5] "Start of the second injection for stratified mode" UWORD _CNV_A_R_LINEAR_____200_CM 1 100. 0. 720. DISPLAY_IDENTIFIER SOI_2_S[5] ECU_ADDRESS 0xd0006b16 FORMAT "%7.3" /end MEASUREMENT
/begin MEASUREMENT injr.STR_INJR_REQGNS2P0.soi_2_s[6] "Start of the second injection for stratified mode" UWORD _CNV_A_R_LINEAR_____200_CM 1 100. 0. 720. DISPLAY_IDENTIFIER SOI_2_S[6] ECU_ADDRESS 0xd0006b18 FORMAT "%7.3" /end MEASUREMENT
/begin MEASUREMENT injr.STR_INJR_REQGNS2P0.soi_2_s[7] "Start of the second injection for stratified mode" UWORD _CNV_A_R_LINEAR_____200_CM 1 100. 0. 720. DISPLAY_IDENTIFIER SOI_2_S[7] ECU_ADDRESS 0xd0006b1a FORMAT "%7.3" /end MEASUREMENT
/begin MEASUREMENT injr.STR_INJR_ISPCLEGYIV0.egy_add_ad[0] "Adaptive piezo energy correction depending on CYBL + CILC corrections" SWORD _CNV_A_R_INJR_LINEA_460_CM 1 100. -50. 50. DISPLAY_IDENTIFIER EGY_ADD_AD[0] ECU_ADDRESS 0xd0006e2c /end MEASUREMENT
/begin MEASUREMENT injr.STR_INJR_ISPCLEGYIV0.egy_add_ad[1] "Adaptive piezo energy correction depending on CYBL + CILC corrections" SWORD _CNV_A_R_INJR_LINEA_460_CM 1 100. -50. 50. DISPLAY_IDENTIFIER EGY_ADD_AD[1] ECU_ADDRESS 0xd0006e2e /end MEASUREMENT
/begin MEASUREMENT injr.STR_INJR_ISPCLEGYIV0.egy_add_ad[2] "Adaptive piezo energy correction depending on CYBL + CILC corrections" SWORD _CNV_A_R_INJR_LINEA_460_CM 1 100. -50. 50. DISPLAY_IDENTIFIER EGY_ADD_AD[2] ECU_ADDRESS 0xd0006e30 /end MEASUREMENT
/begin MEASUREMENT injr.STR_INJR_ISPCLEGYIV0.egy_add_ad[3] "Adaptive piezo energy correction depending on CYBL + CILC corrections" SWORD _CNV_A_R_INJR_LINEA_460_CM 1 100. -50. 50. DISPLAY_IDENTIFIER EGY_ADD_AD[3] ECU_ADDRESS 0xd0006e32 /end MEASUREMENT
/begin MEASUREMENT injr.STR_INJR_ISPCLEGYIV0.egy_add_ad[4] "Adaptive piezo energy correction depending on CYBL + CILC corrections" SWORD _CNV_A_R_INJR_LINEA_460_CM 1 100. -50. 50. DISPLAY_IDENTIFIER EGY_ADD_AD[4] ECU_ADDRESS 0xd0006e34 /end MEASUREMENT
/begin MEASUREMENT injr.STR_INJR_ISPCLEGYIV0.egy_add_ad[5] "Adaptive piezo energy correction depending on CYBL + CILC corrections" SWORD _CNV_A_R_INJR_LINEA_460_CM 1 100. -50. 50. DISPLAY_IDENTIFIER EGY_ADD_AD[5] ECU_ADDRESS 0xd0006e36 /end MEASUREMENT
/begin MEASUREMENT injr.STR_INJR_ISPCLEGYIV0.egy_add_ad[6] "Adaptive piezo energy correction depending on CYBL + CILC corrections" SWORD _CNV_A_R_INJR_LINEA_460_CM 1 100. -50. 50. DISPLAY_IDENTIFIER EGY_ADD_AD[6] ECU_ADDRESS 0xd0006e38 /end MEASUREMENT
/begin MEASUREMENT injr.STR_INJR_ISPCLEGYIV0.egy_add_ad[7] "Adaptive piezo energy correction depending on CYBL + CILC corrections" SWORD _CNV_A_R_INJR_LINEA_460_CM 1 100. -50. 50. DISPLAY_IDENTIFIER EGY_ADD_AD[7] ECU_ADDRESS 0xd0006e3a /end MEASUREMENT
/begin MEASUREMENT cam_shift_ex "Shift of the exhaust camshaft relative to passiv position" SWORD _CNV_A_R_LINEAR_____200_CM 1 100. -360. 360. DISPLAY_IDENTIFIER CAM_SHIFT_EX ECU_ADDRESS 0xd0006f30 FORMAT "%7.3" /end MEASUREMENT
/begin MEASUREMENT cam_shift_in "Shift of the inlet camshaft relative to passiv position" SWORD _CNV_A_R_LINEAR_____200_CM 1 100. -360. 360. DISPLAY_IDENTIFIER CAM_SHIFT_IN ECU_ADDRESS 0xd0006f32 FORMAT "%7.3" /end MEASUREMENT
/begin MEASUREMENT soi_1_hom_ext[0] "Start of injection for homogeneous mode, 1.pulse - base value from MSD70 layer" UWORD _CNV_A_R_LINEAR_____200_CM 1 100. 0. 720. DISPLAY_IDENTIFIER SOI_1_HOM_EXT[0] ECU_ADDRESS 0xd0007054 FORMAT "%7.3" /end MEASUREMENT
/begin MEASUREMENT soi_1_hom_ext[1] "Start of injection for homogeneous mode, 1.pulse - base value from MSD70 layer" UWORD _CNV_A_R_LINEAR_____200_CM 1 100. 0. 720. DISPLAY_IDENTIFIER SOI_1_HOM_EXT[1] ECU_ADDRESS 0xd0007056 FORMAT "%7.3" /end MEASUREMENT
/begin MEASUREMENT soi_1_hom_ext[2] "Start of injection for homogeneous mode, 1.pulse - base value from MSD70 layer" UWORD _CNV_A_R_LINEAR_____200_CM 1 100. 0. 720. DISPLAY_IDENTIFIER SOI_1_HOM_EXT[2] ECU_ADDRESS 0xd0007058 FORMAT "%7.3" /end MEASUREMENT
/begin MEASUREMENT soi_1_hom_ext[3] "Start of injection for homogeneous mode, 1.pulse - base value from MSD70 layer" UWORD _CNV_A_R_LINEAR_____200_CM 1 100. 0. 720. DISPLAY_IDENTIFIER SOI_1_HOM_EXT[3] ECU_ADDRESS 0xd000705a FORMAT "%7.3" /end MEASUREMENT
/begin MEASUREMENT soi_1_hom_ext[4] "Start of injection for homogeneous mode, 1.pulse - base value from MSD70 layer" UWORD _CNV_A_R_LINEAR_____200_CM 1 100. 0. 720. DISPLAY_IDENTIFIER SOI_1_HOM_EXT[4] ECU_ADDRESS 0xd000705c FORMAT "%7.3" /end MEASUREMENT
/begin MEASUREMENT soi_1_hom_ext[5] "Start of injection for homogeneous mode, 1.pulse - base value from MSD70 layer" UWORD _CNV_A_R_LINEAR_____200_CM 1 100. 0. 720. DISPLAY_IDENTIFIER SOI_1_HOM_EXT[5] ECU_ADDRESS 0xd000705e FORMAT "%7.3" /end MEASUREMENT
/begin MEASUREMENT soi_1_hom_ext[6] "Start of injection for homogeneous mode, 1.pulse - base value from MSD70 layer" UWORD _CNV_A_R_LINEAR_____200_CM 1 100. 0. 720. DISPLAY_IDENTIFIER SOI_1_HOM_EXT[6] ECU_ADDRESS 0xd0007060 FORMAT "%7.3" /end MEASUREMENT
/begin MEASUREMENT soi_1_hom_ext[7] "Start of injection for homogeneous mode, 1.pulse - base value from MSD70 layer" UWORD _CNV_A_R_LINEAR_____200_CM 1 100. 0. 720. DISPLAY_IDENTIFIER SOI_1_HOM_EXT[7] ECU_ADDRESS 0xd0007062 FORMAT "%7.3" /end MEASUREMENT
/begin MEASUREMENT eoi_1_s_ext[0] "End of injection for stratified mode, 1.pulse - base value from MSD70 layer" UWORD _CNV_A_R_LINEAR_____200_CM 1 100. 0. 720. DISPLAY_IDENTIFIER EOI_1_S_EXT[0] ECU_ADDRESS 0xd0006fb8 FORMAT "%7.3" /end MEASUREMENT
/begin MEASUREMENT eoi_1_s_ext[1] "End of injection for stratified mode, 1.pulse - base value from MSD70 layer" UWORD _CNV_A_R_LINEAR_____200_CM 1 100. 0. 720. DISPLAY_IDENTIFIER EOI_1_S_EXT[1] ECU_ADDRESS 0xd0006fba FORMAT "%7.3" /end MEASUREMENT
/begin MEASUREMENT eoi_1_s_ext[2] "End of injection for stratified mode, 1.pulse - base value from MSD70 layer" UWORD _CNV_A_R_LINEAR_____200_CM 1 100. 0. 720. DISPLAY_IDENTIFIER EOI_1_S_EXT[2] ECU_ADDRESS 0xd0006fbc FORMAT "%7.3" /end MEASUREMENT
/begin MEASUREMENT eoi_1_s_ext[3] "End of injection for stratified mode, 1.pulse - base value from MSD70 layer" UWORD _CNV_A_R_LINEAR_____200_CM 1 100. 0. 720. DISPLAY_IDENTIFIER EOI_1_S_EXT[3] ECU_ADDRESS 0xd0006fbe FORMAT "%7.3" /end MEASUREMENT
/begin MEASUREMENT eoi_1_s_ext[4] "End of injection for stratified mode, 1.pulse - base value from MSD70 layer" UWORD _CNV_A_R_LINEAR_____200_CM 1 100. 0. 720. DISPLAY_IDENTIFIER EOI_1_S_EXT[4] ECU_ADDRESS 0xd0006fc0 FORMAT "%7.3" /end MEASUREMENT
/begin MEASUREMENT eoi_1_s_ext[5] "End of injection for stratified mode, 1.pulse - base value from MSD70 layer" UWORD _CNV_A_R_LINEAR_____200_CM 1 100. 0. 720. DISPLAY_IDENTIFIER EOI_1_S_EXT[5] ECU_ADDRESS 0xd0006fc2 FORMAT "%7.3" /end MEASUREMENT
/begin MEASUREMENT eoi_1_s_ext[6] "End of injection for stratified mode, 1.pulse - base value from MSD70 layer" UWORD _CNV_A_R_LINEAR_____200_CM 1 100. 0. 720. DISPLAY_IDENTIFIER EOI_1_S_EXT[6] ECU_ADDRESS 0xd0006fc4 FORMAT "%7.3" /end MEASUREMENT
/begin MEASUREMENT eoi_1_s_ext[7] "End of injection for stratified mode, 1.pulse - base value from MSD70 layer" UWORD _CNV_A_R_LINEAR_____200_CM 1 100. 0. 720. DISPLAY_IDENTIFIER EOI_1_S_EXT[7] ECU_ADDRESS 0xd0006fc6 FORMAT "%7.3" /end MEASUREMENT
/begin MEASUREMENT eoi_2_s_ext[0] "End of injection for stratified mode, 2.pulse - base value from MSD70 layer" UWORD _CNV_A_R_LINEAR_____200_CM 1 100. 0. 720. DISPLAY_IDENTIFIER EOI_2_S_EXT[0] ECU_ADDRESS 0xd0006fe8 FORMAT "%7.3" /end MEASUREMENT
/begin MEASUREMENT eoi_2_s_ext[1] "End of injection for stratified mode, 2.pulse - base value from MSD70 layer" UWORD _CNV_A_R_LINEAR_____200_CM 1 100. 0. 720. DISPLAY_IDENTIFIER EOI_2_S_EXT[1] ECU_ADDRESS 0xd0006fea FORMAT "%7.3" /end MEASUREMENT
/begin MEASUREMENT eoi_2_s_ext[2] "End of injection for stratified mode, 2.pulse - base value from MSD70 layer" UWORD _CNV_A_R_LINEAR_____200_CM 1 100. 0. 720. DISPLAY_IDENTIFIER EOI_2_S_EXT[2] ECU_ADDRESS 0xd0006fec FORMAT "%7.3" /end MEASUREMENT
/begin MEASUREMENT eoi_2_s_ext[3] "End of injection for stratified mode, 2.pulse - base value from MSD70 layer" UWORD _CNV_A_R_LINEAR_____200_CM 1 100. 0. 720. DISPLAY_IDENTIFIER EOI_2_S_EXT[3] ECU_ADDRESS 0xd0006fee FORMAT "%7.3" /end MEASUREMENT
/begin MEASUREMENT eoi_2_s_ext[4] "End of injection for stratified mode, 2.pulse - base value from MSD70 layer" UWORD _CNV_A_R_LINEAR_____200_CM 1 100. 0. 720. DISPLAY_IDENTIFIER EOI_2_S_EXT[4] ECU_ADDRESS 0xd0006ff0 FORMAT "%7.3" /end MEASUREMENT
/begin MEASUREMENT eoi_2_s_ext[5] "End of injection for stratified mode, 2.pulse - base value from MSD70 layer" UWORD _CNV_A_R_LINEAR_____200_CM 1 100. 0. 720. DISPLAY_IDENTIFIER EOI_2_S_EXT[5] ECU_ADDRESS 0xd0006ff2 FORMAT "%7.3" /end MEASUREMENT
/begin MEASUREMENT eoi_2_s_ext[6] "End of injection for stratified mode, 2.pulse - base value from MSD70 layer" UWORD _CNV_A_R_LINEAR_____200_CM 1 100. 0. 720. DISPLAY_IDENTIFIER EOI_2_S_EXT[6] ECU_ADDRESS 0xd0006ff4 FORMAT "%7.3" /end MEASUREMENT
/begin MEASUREMENT eoi_2_s_ext[7] "End of injection for stratified mode, 2.pulse - base value from MSD70 layer" UWORD _CNV_A_R_LINEAR_____200_CM 1 100. 0. 720. DISPLAY_IDENTIFIER EOI_2_S_EXT[7] ECU_ADDRESS 0xd0006ff6 FORMAT "%7.3" /end MEASUREMENT
/begin MEASUREMENT soi_1_homs_ext[0] "Start of injection for homogeneous mode, 1.pulse - base value from MSD70 layer" UWORD _CNV_A_R_LINEAR_____200_CM 1 100. 0. 720. DISPLAY_IDENTIFIER SOI_1_HOMS_EXT[0] ECU_ADDRESS 0xd0007064 FORMAT "%7.3" /end MEASUREMENT
/begin MEASUREMENT soi_1_homs_ext[1] "Start of injection for homogeneous mode, 1.pulse - base value from MSD70 layer" UWORD _CNV_A_R_LINEAR_____200_CM 1 100. 0. 720. DISPLAY_IDENTIFIER SOI_1_HOMS_EXT[1] ECU_ADDRESS 0xd0007066 FORMAT "%7.3" /end MEASUREMENT
/begin MEASUREMENT soi_1_homs_ext[2] "Start of injection for homogeneous mode, 1.pulse - base value from MSD70 layer" UWORD _CNV_A_R_LINEAR_____200_CM 1 100. 0. 720. DISPLAY_IDENTIFIER SOI_1_HOMS_EXT[2] ECU_ADDRESS 0xd0007068 FORMAT "%7.3" /end MEASUREMENT
/begin MEASUREMENT soi_1_homs_ext[3] "Start of injection for homogeneous mode, 1.pulse - base value from MSD70 layer" UWORD _CNV_A_R_LINEAR_____200_CM 1 100. 0. 720. DISPLAY_IDENTIFIER SOI_1_HOMS_EXT[3] ECU_ADDRESS 0xd000706a FORMAT "%7.3" /end MEASUREMENT
/begin MEASUREMENT soi_1_homs_ext[4] "Start of injection for homogeneous mode, 1.pulse - base value from MSD70 layer" UWORD _CNV_A_R_LINEAR_____200_CM 1 100. 0. 720. DISPLAY_IDENTIFIER SOI_1_HOMS_EXT[4] ECU_ADDRESS 0xd000706c FORMAT "%7.3" /end MEASUREMENT
/begin MEASUREMENT soi_1_homs_ext[5] "Start of injection for homogeneous mode, 1.pulse - base value from MSD70 layer" UWORD _CNV_A_R_LINEAR_____200_CM 1 100. 0. 720. DISPLAY_IDENTIFIER SOI_1_HOMS_EXT[5] ECU_ADDRESS 0xd000706e FORMAT "%7.3" /end MEASUREMENT
/begin MEASUREMENT soi_1_homs_ext[6] "Start of injection for homogeneous mode, 1.pulse - base value from MSD70 layer" UWORD _CNV_A_R_LINEAR_____200_CM 1 100. 0. 720. DISPLAY_IDENTIFIER SOI_1_HOMS_EXT[6] ECU_ADDRESS 0xd0007070 FORMAT "%7.3" /end MEASUREMENT
/begin MEASUREMENT soi_1_homs_ext[7] "Start of injection for homogeneous mode, 1.pulse - base value from MSD70 layer" UWORD _CNV_A_R_LINEAR_____200_CM 1 100. 0. 720. DISPLAY_IDENTIFIER SOI_1_HOMS_EXT[7] ECU_ADDRESS 0xd0007072 FORMAT "%7.3" /end MEASUREMENT
/begin MEASUREMENT eoi_2_homs_ext[0] "End of injection for homogeneous mode, 2.pulse - base value from MSD70 layer" UWORD _CNV_A_R_LINEAR_____200_CM 1 100. 0. 720. DISPLAY_IDENTIFIER EOI_2_HOMS_EXT[0] ECU_ADDRESS 0xd0006fd8 FORMAT "%7.3" /end MEASUREMENT
/begin MEASUREMENT eoi_2_homs_ext[1] "End of injection for homogeneous mode, 2.pulse - base value from MSD70 layer" UWORD _CNV_A_R_LINEAR_____200_CM 1 100. 0. 720. DISPLAY_IDENTIFIER EOI_2_HOMS_EXT[1] ECU_ADDRESS 0xd0006fda FORMAT "%7.3" /end MEASUREMENT
/begin MEASUREMENT eoi_2_homs_ext[2] "End of injection for homogeneous mode, 2.pulse - base value from MSD70 layer" UWORD _CNV_A_R_LINEAR_____200_CM 1 100. 0. 720. DISPLAY_IDENTIFIER EOI_2_HOMS_EXT[2] ECU_ADDRESS 0xd0006fdc FORMAT "%7.3" /end MEASUREMENT
/begin MEASUREMENT eoi_2_homs_ext[3] "End of injection for homogeneous mode, 2.pulse - base value from MSD70 layer" UWORD _CNV_A_R_LINEAR_____200_CM 1 100. 0. 720. DISPLAY_IDENTIFIER EOI_2_HOMS_EXT[3] ECU_ADDRESS 0xd0006fde FORMAT "%7.3" /end MEASUREMENT
/begin MEASUREMENT eoi_2_homs_ext[4] "End of injection for homogeneous mode, 2.pulse - base value from MSD70 layer" UWORD _CNV_A_R_LINEAR_____200_CM 1 100. 0. 720. DISPLAY_IDENTIFIER EOI_2_HOMS_EXT[4] ECU_ADDRESS 0xd0006fe0 FORMAT "%7.3" /end MEASUREMENT
/begin MEASUREMENT eoi_2_homs_ext[5] "End of injection for homogeneous mode, 2.pulse - base value from MSD70 layer" UWORD _CNV_A_R_LINEAR_____200_CM 1 100. 0. 720. DISPLAY_IDENTIFIER EOI_2_HOMS_EXT[5] ECU_ADDRESS 0xd0006fe2 FORMAT "%7.3" /end MEASUREMENT
/begin MEASUREMENT eoi_2_homs_ext[6] "End of injection for homogeneous mode, 2.pulse - base value from MSD70 layer" UWORD _CNV_A_R_LINEAR_____200_CM 1 100. 0. 720. DISPLAY_IDENTIFIER EOI_2_HOMS_EXT[6] ECU_ADDRESS 0xd0006fe4 FORMAT "%7.3" /end MEASUREMENT
/begin MEASUREMENT eoi_2_homs_ext[7] "End of injection for homogeneous mode, 2.pulse - base value from MSD70 layer" UWORD _CNV_A_R_LINEAR_____200_CM 1 100. 0. 720. DISPLAY_IDENTIFIER EOI_2_HOMS_EXT[7] ECU_ADDRESS 0xd0006fe6 FORMAT "%7.3" /end MEASUREMENT
/begin MEASUREMENT eoi_2_hom_ext[0] "End of injection for homogeneous mode, 2.pulse - base value from MSD70 layer" UWORD _CNV_A_R_LINEAR_____200_CM 1 100. 0. 720. DISPLAY_IDENTIFIER EOI_2_HOM_EXT[0] ECU_ADDRESS 0xd0006fc8 FORMAT "%7.3" /end MEASUREMENT
/begin MEASUREMENT eoi_2_hom_ext[1] "End of injection for homogeneous mode, 2.pulse - base value from MSD70 layer" UWORD _CNV_A_R_LINEAR_____200_CM 1 100. 0. 720. DISPLAY_IDENTIFIER EOI_2_HOM_EXT[1] ECU_ADDRESS 0xd0006fca FORMAT "%7.3" /end MEASUREMENT
/begin MEASUREMENT eoi_2_hom_ext[2] "End of injection for homogeneous mode, 2.pulse - base value from MSD70 layer" UWORD _CNV_A_R_LINEAR_____200_CM 1 100. 0. 720. DISPLAY_IDENTIFIER EOI_2_HOM_EXT[2] ECU_ADDRESS 0xd0006fcc FORMAT "%7.3" /end MEASUREMENT
/begin MEASUREMENT eoi_2_hom_ext[3] "End of injection for homogeneous mode, 2.pulse - base value from MSD70 layer" UWORD _CNV_A_R_LINEAR_____200_CM 1 100. 0. 720. DISPLAY_IDENTIFIER EOI_2_HOM_EXT[3] ECU_ADDRESS 0xd0006fce FORMAT "%7.3" /end MEASUREMENT
/begin MEASUREMENT eoi_2_hom_ext[4] "End of injection for homogeneous mode, 2.pulse - base value from MSD70 layer" UWORD _CNV_A_R_LINEAR_____200_CM 1 100. 0. 720. DISPLAY_IDENTIFIER EOI_2_HOM_EXT[4] ECU_ADDRESS 0xd0006fd0 FORMAT "%7.3" /end MEASUREMENT
/begin MEASUREMENT eoi_2_hom_ext[5] "End of injection for homogeneous mode, 2.pulse - base value from MSD70 layer" UWORD _CNV_A_R_LINEAR_____200_CM 1 100. 0. 720. DISPLAY_IDENTIFIER EOI_2_HOM_EXT[5] ECU_ADDRESS 0xd0006fd2 FORMAT "%7.3" /end MEASUREMENT
/begin MEASUREMENT eoi_2_hom_ext[6] "End of injection for homogeneous mode, 2.pulse - base value from MSD70 layer" UWORD _CNV_A_R_LINEAR_____200_CM 1 100. 0. 720. DISPLAY_IDENTIFIER EOI_2_HOM_EXT[6] ECU_ADDRESS 0xd0006fd4 FORMAT "%7.3" /end MEASUREMENT
/begin MEASUREMENT eoi_2_hom_ext[7] "End of injection for homogeneous mode, 2.pulse - base value from MSD70 layer" UWORD _CNV_A_R_LINEAR_____200_CM 1 100. 0. 720. DISPLAY_IDENTIFIER EOI_2_HOM_EXT[7] ECU_ADDRESS 0xd0006fd6 FORMAT "%7.3" /end MEASUREMENT
/begin MEASUREMENT eoi_3_hom_ext[0] "End of injection for homogeneous mode, 3.pulse - base value from customer layer" UWORD _CNV_A_R_LINEAR_____200_CM 1 100. 0. 720. DISPLAY_IDENTIFIER EOI_3_HOM_EXT[0] ECU_ADDRESS 0xd0006ff8 FORMAT "%7.3" /end MEASUREMENT
/begin MEASUREMENT eoi_3_hom_ext[1] "End of injection for homogeneous mode, 3.pulse - base value from customer layer" UWORD _CNV_A_R_LINEAR_____200_CM 1 100. 0. 720. DISPLAY_IDENTIFIER EOI_3_HOM_EXT[1] ECU_ADDRESS 0xd0006ffa FORMAT "%7.3" /end MEASUREMENT
/begin MEASUREMENT eoi_3_hom_ext[2] "End of injection for homogeneous mode, 3.pulse - base value from customer layer" UWORD _CNV_A_R_LINEAR_____200_CM 1 100. 0. 720. DISPLAY_IDENTIFIER EOI_3_HOM_EXT[2] ECU_ADDRESS 0xd0006ffc FORMAT "%7.3" /end MEASUREMENT
/begin MEASUREMENT eoi_3_hom_ext[3] "End of injection for homogeneous mode, 3.pulse - base value from customer layer" UWORD _CNV_A_R_LINEAR_____200_CM 1 100. 0. 720. DISPLAY_IDENTIFIER EOI_3_HOM_EXT[3] ECU_ADDRESS 0xd0006ffe FORMAT "%7.3" /end MEASUREMENT
/begin MEASUREMENT eoi_3_hom_ext[4] "End of injection for homogeneous mode, 3.pulse - base value from customer layer" UWORD _CNV_A_R_LINEAR_____200_CM 1 100. 0. 720. DISPLAY_IDENTIFIER EOI_3_HOM_EXT[4] ECU_ADDRESS 0xd0007000 FORMAT "%7.3" /end MEASUREMENT
/begin MEASUREMENT eoi_3_hom_ext[5] "End of injection for homogeneous mode, 3.pulse - base value from customer layer" UWORD _CNV_A_R_LINEAR_____200_CM 1 100. 0. 720. DISPLAY_IDENTIFIER EOI_3_HOM_EXT[5] ECU_ADDRESS 0xd0007002 FORMAT "%7.3" /end MEASUREMENT
/begin MEASUREMENT eoi_3_hom_ext[6] "End of injection for homogeneous mode, 3.pulse - base value from customer layer" UWORD _CNV_A_R_LINEAR_____200_CM 1 100. 0. 720. DISPLAY_IDENTIFIER EOI_3_HOM_EXT[6] ECU_ADDRESS 0xd0007004 FORMAT "%7.3" /end MEASUREMENT
/begin MEASUREMENT eoi_3_hom_ext[7] "End of injection for homogeneous mode, 3.pulse - base value from customer layer" UWORD _CNV_A_R_LINEAR_____200_CM 1 100. 0. 720. DISPLAY_IDENTIFIER EOI_3_HOM_EXT[7] ECU_ADDRESS 0xd0007006 FORMAT "%7.3" /end MEASUREMENT
/begin CHARACTERISTIC lc_eoi_2_s_man "Global application assistance switch passive/active for the second injection" VALUE 0xa08065e1 _REC_VAL_20_u1 1. _CNV_A_R_LINEAR_____0_CM 0. 1. DISPLAY_IDENTIFIER LC_EOI_2_S_MAN FORMAT "%1.0" /end CHARACTERISTIC
/begin CHARACTERISTIC c_eoi_2_s_man "Global application assistance for the second injection" VALUE 0xa080654a _REC_VAL_20_u2 720. _CNV_A_R_LINEAR_____200_CM 0. 720. DISPLAY_IDENTIFIER C_EOI_2_S_MAN FORMAT "%7.3" /end CHARACTERISTIC
/begin MEASUREMENT fac_ti_2_prs_hom "correction factor to compensate the influence of the varying pressure difference at the injector, 2. Pulse" UWORD _CNV_A_R_LINEAR_____119_CM 1 100. 0. 15.999755859375 DISPLAY_IDENTIFIER FAC_TI_2_PRS_HOM ECU_ADDRESS 0xd0007022 FORMAT "%7.4" /end MEASUREMENT
/begin MEASUREMENT prs_inj_mv_2_hom "mean cylinder pressure during injection, 2. Pulse" UWORD _CNV_A_R_LINEAR_____171_CM 1 100. 0. 347776. DISPLAY_IDENTIFIER PRS_INJ_MV_2_HOM ECU_ADDRESS 0xd000333a FORMAT "%8.1" /end MEASUREMENT
/begin MEASUREMENT crk_inj_2_hom "rough value for injection angle (EOI-SOI), 2. pulse " UWORD _CNV_A_R_LINEAR_____200_CM 1 100. 0. 720. DISPLAY_IDENTIFIER CRK_INJ_2_HOM ECU_ADDRESS 0xd0003292 FORMAT "%7.3" /end MEASUREMENT
/begin MEASUREMENT prs_dec_inj_2_hom "pressure difference at the injector, 2. pulse " UWORD _CNV_A_R_LINEAR_____171_CM 1 100. 0. 347776. DISPLAY_IDENTIFIER PRS_DEC_INJ_2_HOM ECU_ADDRESS 0xd000704c FORMAT "%8.1" /end MEASUREMENT
/begin AXIS_PTS ldp_eoi_ip_prs_inc_cmp "" 0xa0806094 injr.STR_INJR_REQGNHOM2P0.eoi_2_hom[0] _REC_AXS_20_u2 720. _CNV_A_R_LINEAR_____200_CM 12 0. 720. FORMAT "%7.3" /end AXIS_PTS
/begin AXIS_PTS ldp_crk_inj_ip_prs_inc_cmp "" 0xa0806034 crk_inj_2_hom _REC_AXS_20_u2 720. _CNV_A_R_LINEAR_____200_CM 16 0. 720. FORMAT "%7.3" /end AXIS_PTS
/begin CHARACTERISTIC ip_prs_inc_cmp "Mean pressure increase in cylinder due to compression" MAP 0xa08117d4 _REC_MAP_20_u2_u2_u2 31.99951171875 _CNV_A_R_LINEAR_____241_CM 0. 31.99951171875 DISPLAY_IDENTIFIER IP_PRS_INC_CMP FORMAT "%9.6"
 /begin AXIS_DESCR COM_AXIS injr.STR_INJR_REQGNHOM2P0.eoi_2_hom[0] _CNV_A_R_LINEAR_____200_CM 12 0. 720. FORMAT "%7.3" AXIS_PTS_REF ldp_eoi_ip_prs_inc_cmp /end AXIS_DESCR
 /begin AXIS_DESCR COM_AXIS crk_inj_2_hom _CNV_A_R_LINEAR_____200_CM 16 0. 720. FORMAT "%7.3" AXIS_PTS_REF ldp_crk_inj_ip_prs_inc_cmp /end AXIS_DESCR
/end CHARACTERISTIC
/begin MEASUREMENT fac_ti_3_prs_hom "correction factor to compensate the influence of the varying pressure difference at the injector, 3. Pulse" UWORD _CNV_A_R_LINEAR_____119_CM 1 100. 0. 15.999755859375 DISPLAY_IDENTIFIER FAC_TI_3_PRS_HOM ECU_ADDRESS 0xd0007026 FORMAT "%7.4" /end MEASUREMENT
/begin MEASUREMENT prs_inj_mv_3_hom "mean cylinder pressure during injection, 3. Pulse" UWORD _CNV_A_R_LINEAR_____171_CM 1 100. 0. 347776. DISPLAY_IDENTIFIER PRS_INJ_MV_3_HOM ECU_ADDRESS 0xd000333e FORMAT "%8.1" /end MEASUREMENT
/begin MEASUREMENT crk_inj_3_hom "rough value for injection angle (EOI-SOI), 3. pulse " UWORD _CNV_A_R_LINEAR_____200_CM 1 100. 0. 720. DISPLAY_IDENTIFIER CRK_INJ_3_HOM ECU_ADDRESS 0xd0003296 FORMAT "%7.3" /end MEASUREMENT
/begin MEASUREMENT prs_dec_inj_3_hom "pressure difference at the injector, 3. pulse " UWORD _CNV_A_R_LINEAR_____171_CM 1 100. 0. 347776. DISPLAY_IDENTIFIER PRS_DEC_INJ_3_HOM ECU_ADDRESS 0xd0007050 FORMAT "%8.1" /end MEASUREMENT
/begin MEASUREMENT prs_dec_inj_1_s "pressure decrease at the injector, stratified mode 1. pulse " UWORD _CNV_A_R_LINEAR_____171_CM 1 100. 0. 347776. DISPLAY_IDENTIFIER PRS_DEC_INJ_1_S ECU_ADDRESS 0xd000704a FORMAT "%8.1" /end MEASUREMENT
/begin MEASUREMENT fac_ti_1_prs_s "factor  for correction of fuel injection time due to a change of press. decrease at the injector, strat. mode 1. pulse" UWORD _CNV_A_R_LINEAR_____119_CM 1 100. 0. 15.999755859375 DISPLAY_IDENTIFIER FAC_TI_1_PRS_S ECU_ADDRESS 0xd0007020 FORMAT "%7.4" /end MEASUREMENT
/begin MEASUREMENT prs_inj_mv_1_s "mean cylinder pressure during injection, stratified mode 1. pulse" UWORD _CNV_A_R_LINEAR_____171_CM 1 100. 0. 347776. DISPLAY_IDENTIFIER PRS_INJ_MV_1_S ECU_ADDRESS 0xd0003338 FORMAT "%8.1" /end MEASUREMENT
/begin MEASUREMENT crk_inj_1_s "rough value for injection angle (EOI-SOI), stratified mode 1. pulse" UWORD _CNV_A_R_LINEAR_____200_CM 1 100. 0. 720. DISPLAY_IDENTIFIER CRK_INJ_1_S ECU_ADDRESS 0xd0003290 FORMAT "%7.3" /end MEASUREMENT
/begin CHARACTERISTIC ip_prs_inc_cmp_s "Mean pressure increase in cylinder due to compression" MAP 0xa0811954 _REC_MAP_20_u2_u2_u2 31.99951171875 _CNV_A_R_LINEAR_____241_CM 0. 31.99951171875 DISPLAY_IDENTIFIER IP_PRS_INC_CMP_S FORMAT "%9.6"
 /begin AXIS_DESCR COM_AXIS injr.STR_INJR_REQGNS1P0.eoi_1_s[0] _CNV_A_R_LINEAR_____200_CM 12 0. 720. FORMAT "%7.3" AXIS_PTS_REF ldp_eoi_1_s_0_ip_prs_inc_cmp_s /end AXIS_DESCR
 /begin AXIS_DESCR COM_AXIS crk_inj_1_s _CNV_A_R_LINEAR_____200_CM 16 0. 720. FORMAT "%7.3" AXIS_PTS_REF ldp_crk_inj_1_s_ip_prs_inc_cmp /end AXIS_DESCR
/end CHARACTERISTIC
/begin AXIS_PTS ldp_crk_inj_1_s_ip_prs_inc_cmp "" 0xa0806010 crk_inj_1_s _REC_AXS_20_u2 720. _CNV_A_R_LINEAR_____200_CM 16 0. 720. FORMAT "%7.3" /end AXIS_PTS
/begin AXIS_PTS ldp_eoi_1_s_0_ip_prs_inc_cmp_s "" 0xa0806078 injr.STR_INJR_REQGNS1P0.eoi_1_s[0] _REC_AXS_20_u2 720. _CNV_A_R_LINEAR_____200_CM 12 0. 720. FORMAT "%7.3" /end AXIS_PTS
/begin MEASUREMENT fac_ti_2_prs_s "factor  for correction of fuel injection time due to a change of press. decrease at the injector, strat. mode 2. pulse" UWORD _CNV_A_R_LINEAR_____119_CM 1 100. 0. 15.999755859375 DISPLAY_IDENTIFIER FAC_TI_2_PRS_S ECU_ADDRESS 0xd0007024 FORMAT "%7.4" /end MEASUREMENT
/begin MEASUREMENT prs_inj_mv_2_s "mean cylinder pressure during injection, stratified mode 2. pulse" UWORD _CNV_A_R_LINEAR_____171_CM 1 100. 0. 347776. DISPLAY_IDENTIFIER PRS_INJ_MV_2_S ECU_ADDRESS 0xd000333c FORMAT "%8.1" /end MEASUREMENT
/begin MEASUREMENT crk_inj_2_s "rough value for injection angle (EOI-SOI), stratified mode 2. pulse " UWORD _CNV_A_R_LINEAR_____200_CM 1 100. 0. 720. DISPLAY_IDENTIFIER CRK_INJ_2_S ECU_ADDRESS 0xd0003294 FORMAT "%7.3" /end MEASUREMENT
/begin MEASUREMENT prs_dec_inj_2_s "pressure decrease at the injector, stratified mode 2. pulse " UWORD _CNV_A_R_LINEAR_____171_CM 1 100. 0. 347776. DISPLAY_IDENTIFIER PRS_DEC_INJ_2_S ECU_ADDRESS 0xd000704e FORMAT "%8.1" /end MEASUREMENT
/begin CHARACTERISTIC lc_eoi_1_s_man "Global application assistance switch passive/active for the first injection" VALUE 0xa08065de _REC_VAL_20_u1 1. _CNV_A_R_LINEAR_____0_CM 0. 1. DISPLAY_IDENTIFIER LC_EOI_1_S_MAN FORMAT "%1.0" /end CHARACTERISTIC
/begin CHARACTERISTIC c_eoi_1_s_man "Global application assistance for the first injection " VALUE 0xa0806544 _REC_VAL_20_u2 720. _CNV_A_R_LINEAR_____200_CM 0. 720. DISPLAY_IDENTIFIER C_EOI_1_S_MAN FORMAT "%7.3" /end CHARACTERISTIC
/begin COMPU_METHOD _CNV_A_R_LINEAR_____0_CM "" RAT_FUNC "%6.3" "-" COEFFS 0 1. 0. 0 0 1 /end COMPU_METHOD
/begin COMPU_METHOD _CNV_S_2_RANGE__0___1_CM "" TAB_VERB "%6.3" "-" COMPU_TAB_REF _CNV_S_2_RANGE__0___1 /end COMPU_METHOD
/begin COMPU_VTAB _CNV_S_2_RANGE__0___1 "" TAB_VERB 2 0 "0" 1 "1" /end COMPU_VTAB
/begin COMPU_METHOD _CNV_A_R_LINEAR_____4_CM "" RAT_FUNC "%6.3" "s" COEFFS 0 10. 0. 0 0 1 /end COMPU_METHOD
/begin COMPU_METHOD _CNV_A_R_LINEAR_____5_CM "" RAT_FUNC "%6.3" "%" COEFFS 0 2.56 0. 0 0 1 /end COMPU_METHOD
/begin COMPU_METHOD _CNV_A_R_LINEAR_____6_CM "" RAT_FUNC "%6.3" "km/h" COEFFS 0 1. 0. 0 0 1 /end COMPU_METHOD
/begin COMPU_METHOD _CNV_A_R_LINEAR_____8_CM "" RAT_FUNC "%6.3" "%" COEFFS 0 655.3599999999997 0. 0 0 1 /end COMPU_METHOD
/begin COMPU_METHOD _CNV_A_R_LINEAR_____9_CM "" RAT_FUNC "%6.3" "-" COEFFS 0 32767.99999999992 0. 0 0 1 /end COMPU_METHOD
/begin COMPU_METHOD _CNV_A_R_LINEAR_____10_CM "" RAT_FUNC "%6.3" "rpm" COEFFS 0 3.125e-002 0. 0 0 1 /end COMPU_METHOD
/begin COMPU_METHOD _CNV_A_R_LINEAR_____14_CM "" RAT_FUNC "%6.3" "rpm" COEFFS 0 1. 0. 0 0 1 /end COMPU_METHOD
/begin COMPU_METHOD _CNV_A_R_LINEAR_____17_CM "" RAT_FUNC "%6.3" "°C" COEFFS 0 1.333333333333333 64. 0 0 1 /end COMPU_METHOD
/begin COMPU_METHOD _CNV_A_R_LINEAR_____25_CM "" RAT_FUNC "%6.3" "°C" COEFFS 0 1.333333333333333 0. 0 0 1 /end COMPU_METHOD
/begin COMPU_METHOD _CNV_A_R_LINEAR_____27_CM "" RAT_FUNC "%6.3" "hPa" COEFFS 0 12.06017666543982 0. 0 0 1 /end COMPU_METHOD
/begin COMPU_METHOD _CNV_A_R_LINEAR_____36_CM "" RAT_FUNC "%6.3" "s" COEFFS 0 1. 0. 0 0 1 /end COMPU_METHOD
/begin COMPU_METHOD _CNV_A_R_LINEAR_____103_CM "" RAT_FUNC "%6.3" "-" COEFFS 0 128. 0. 0 0 1 /end COMPU_METHOD
/begin COMPU_METHOD _CNV_A_R_LINEAR_____111_CM "" RAT_FUNC "%6.3" "mg/stk" COEFFS 0 47.18142548596112 0. 0 0 1 /end COMPU_METHOD
/begin COMPU_METHOD _CNV_A_R_LINEAR_____119_CM "" RAT_FUNC "%6.3" "-" COEFFS 0 4096. 0. 0 0 1 /end COMPU_METHOD
/begin COMPU_METHOD _CNV_A_R_LINEAR_____171_CM "" RAT_FUNC "%6.3" "hPa" COEFFS 0 0.1884402603974972 0. 0 0 1 /end COMPU_METHOD
/begin COMPU_METHOD _CNV_A_R_LINEAR_____172_CM "" RAT_FUNC "%6.3" "V" COEFFS 0 6553.60054017653 0. 0 0 1 /end COMPU_METHOD
/begin COMPU_METHOD _CNV_A_R_LINEAR_____200_CM "" RAT_FUNC "%6.3" "°CRK" COEFFS 0 2.666666666666667 0. 0 0 1 /end COMPU_METHOD
/begin COMPU_METHOD _CNV_A_R_LINEAR_____215_CM "" RAT_FUNC "%6.3" "kg/h" COEFFS 0 32. 0. 0 0 1 /end COMPU_METHOD
/begin COMPU_METHOD _CNV_A_R_LINEAR_____228_CM "" RAT_FUNC "%6.3" "ms" COEFFS 0 1000. 0. 0 0 1 /end COMPU_METHOD
/begin COMPU_METHOD _CNV_A_R_LINEAR_____241_CM "" RAT_FUNC "%6.3" "-" COEFFS 0 2048. 0. 0 0 1 /end COMPU_METHOD
/begin COMPU_METHOD _CNV_A_R_LINEAR_____410_CM "" RAT_FUNC "%6.3" "µs" COEFFS 0 1. 0. 0 0 1 /end COMPU_METHOD
/begin COMPU_METHOD _CNV_A_R_LINEAR_____413_CM "" RAT_FUNC "%6.3" "µs" COEFFS 0 1. 32768. 0 0 1 /end COMPU_METHOD
/begin COMPU_METHOD _CNV_A_R_CPULOAD__0_448_CM "" RAT_FUNC "%6.3" "%" COEFFS 0 10.24 0. 0 0 1 /end COMPU_METHOD
/begin COMPU_METHOD _CNV_A_R_CPULOAD____449_CM "" RAT_FUNC "%6.3" "ticks" COEFFS 0 1. 0. 0 0 1 /end COMPU_METHOD
/begin COMPU_METHOD _CNV_A_R_INJR_LINEA_455_CM "" RAT_FUNC "%6.3" "s" COEFFS 0 100. -1. 0 0 1 /end COMPU_METHOD
/begin COMPU_METHOD _CNV_A_R_LINEAR_____456_CM "" RAT_FUNC "%6.3" "ms" COEFFS 0 250. 0. 0 0 1 /end COMPU_METHOD
/begin COMPU_METHOD _CNV_A_R_INJR_LINEA_457_CM "" RAT_FUNC "%6.3" "°CRK/ms" COEFFS 0 166.6666666666667 0. 0 0 1 /end COMPU_METHOD
/begin COMPU_METHOD _CNV_S_7_INJR_RANGE_458_CM "" TAB_VERB "%6.3" "-" COMPU_TAB_REF _CNV_S_7_INJR_RANGE_458 /end COMPU_METHOD
/begin COMPU_VTAB _CNV_S_7_INJR_RANGE_458 "" TAB_VERB 7 1 "SNGS" 2 "MPLS" 66 "HOMS" 128 "DISABLE" 129 "SNGH" 130 "MPLH" 131 "MPLH+PLS3" /end COMPU_VTAB
/begin COMPU_METHOD _CNV_A_R_INJR_LINEA_460_CM "" RAT_FUNC "%6.3" "%" COEFFS 0 163.84 0. 0 0 1 /end COMPU_METHOD
/begin RECORD_LAYOUT _REC_VAL_20_u1 FNC_VALUES 1 UBYTE COLUMN_DIR DIRECT /end RECORD_LAYOUT
/begin RECORD_LAYOUT _REC_VAL_20_u2 FNC_VALUES 1 UWORD COLUMN_DIR DIRECT /end RECORD_LAYOUT
/begin RECORD_LAYOUT _REC_AXS_20_u1 NO_AXIS_PTS_X 1 UBYTE AXIS_PTS_X 2 UBYTE INDEX_INCR DIRECT /end RECORD_LAYOUT
/begin RECORD_LAYOUT _REC_CUR_20_u1_u1 FNC_VALUES 1 UBYTE COLUMN_DIR DIRECT /end RECORD_LAYOUT
/begin RECORD_LAYOUT _REC_AXS_20_u2 NO_AXIS_PTS_X 1 UWORD AXIS_PTS_X 2 UWORD INDEX_INCR DIRECT /end RECORD_LAYOUT
/begin RECORD_LAYOUT _REC_CUR_20_u2_u1 FNC_VALUES 1 UWORD COLUMN_DIR DIRECT /end RECORD_LAYOUT
/begin RECORD_LAYOUT _REC_CUR_20_u2_u2 FNC_VALUES 1 UWORD COLUMN_DIR DIRECT /end RECORD_LAYOUT
/begin RECORD_LAYOUT _REC_CUR_20_u1_u2 FNC_VALUES 1 UBYTE COLUMN_DIR DIRECT /end RECORD_LAYOUT
/begin RECORD_LAYOUT _REC_MAP_20_u2_u2_u2 FNC_VALUES 1 UWORD COLUMN_DIR DIRECT /end RECORD_LAYOUT
/begin FUNCTION ENTE_coolant_temp_radiator_diag "coolant_temp_radiator_diag"
 /begin DEF_CHARACTERISTIC c_tia_thr_min_diag_tco_2_el c_t_ast_min_diag_tco_2_el c_ctr_abc_thd_tco_2_prel c_tco_2_mes_grd_max_diag_tco_2 c_vp_tco_2_max_diag_tco_2_el c_vp_tco_2_min_diag_tco_2_el /end DEF_CHARACTERISTIC
 /begin OUT_MEASUREMENT lv_err_tco_2_el lv_err_tco_2_grd lv_err_tco_2_prel lv_err_tco_2 lv_err_tco_2_prel_det lv_cdn_ena_tco_2_prel /end OUT_MEASUREMENT
/end FUNCTION
/begin FUNCTION ENTE_elect_ctrl_therm_diag "elect_ctrl_therm_diag"
 /begin DEF_CHARACTERISTIC c_abc_inc_ect_el c_abc_max_ect_el c_ect_el_pwm_diag_max_scg c_ect_el_pwm_diag_min_scp c_ect_el_pwm_diag_min_oc /end DEF_CHARACTERISTIC
 /begin OUT_MEASUREMENT lv_err_ect /end OUT_MEASUREMENT
/end FUNCTION
/begin FUNCTION ENTE_coolant_temp_diag_interface "coolant_temp_diag_interface"
 /begin DEF_CHARACTERISTIC ldp_tam_ip_maf_kgh_load_min_ast ip_maf_kgh_load_min_ast c_vs_thd_vs_max_ast c_vs_thd_vs_min_ast /end DEF_CHARACTERISTIC
 /begin OUT_MEASUREMENT t_is_ast t_load_min_ast t_vs_max_ast t_vs_min_ast ratio_t_vs_max_ast ratio_t_vs_min_ast ratio_t_load_min_ast ratio_t_puc_ast ratio_t_is_ast t_puc_ast t_diag_ast lv_cdn_ena_ratio_t_ast /end OUT_MEASUREMENT
/end FUNCTION
/begin FUNCTION ENTE_coolant_temp_sensor_diag_AI "coolant_temp_sensor_diag_AI"
 /begin DEF_CHARACTERISTIC c_ectpwm_min_tco_2_plaus c_abc_max_tco_el c_abc_inc_tco_grd c_abc_max_tco_grd c_abc_inc_tco_el /end DEF_CHARACTERISTIC
 /begin OUT_MEASUREMENT state_rbm_tco_2_plaus lv_inh_diag_tco_2_plaus lv_inh_diag_rbm_tco_2_plaus lv_tco_2_plaus_ena_ext lv_inh_diag_tco_el lv_inh_diag_tco_stuck lv_inh_diag_tco_grd state_rbm_tco_stuck lv_inh_diag_rbm_tco_stuck /end OUT_MEASUREMENT
/end FUNCTION
/begin FUNCTION ENTE_coolant_temp_radiator_dg_AI "coolant_temp_radiator_dg_AI"
 /begin DEF_CHARACTERISTIC c_abc_inc_tco_2_el c_abc_inc_tco_2_grd c_abc_max_tco_2_grd c_abc_max_tco_2_el /end DEF_CHARACTERISTIC
 /begin OUT_MEASUREMENT lv_inh_diag_tco_2_el lv_inh_diag_tco_2_grd /end OUT_MEASUREMENT
/end FUNCTION
/begin FUNCTION ENTE_elect_ctrl_therm_diag_AI "elect_ctrl_therm_diag_AI" /begin OUT_MEASUREMENT lv_inh_diag_ect_el /end OUT_MEASUREMENT /end FUNCTION
/begin FUNCTION ENTE_cooling_fan_diag "cooling_fan_diag"
 /begin DEF_CHARACTERISTIC c_abc_max_ecf_el[0] c_abc_max_ecf_el[1] c_abc_ecfpwm_fb[0] c_abc_ecfpwm_fb[1] c_ecfpwm_diag_max[0] c_ecfpwm_diag_max[1] c_ecfpwm_diag_min[0] c_ecfpwm_diag_min[1] c_ecfpwm_min_fb[0] c_ecfpwm_min_fb[1] c_t_act_ecfpwm_fb[0] c_t_act_ecfpwm_fb[1] c_t_ecfpwm_fb_max[0] c_t_ecfpwm_fb_max[1] c_t_ecfpwm_fb_min[0] c_t_ecfpwm_fb_min[1] c_abc_inc_ecf_el[0] c_abc_inc_ecf_el[1] c_tam_min_ecfpwm_fb_diag_th /end DEF_CHARACTERISTIC
 /begin OUT_MEASUREMENT err_diag_ecfpwm[0] err_diag_ecfpwm[1] lv_ecfpwm_fb_vld[0] lv_ecfpwm_fb_vld[1] lv_err_ecfpwm_fb_1 t_act_ecfpwm_fb[0] t_act_ecfpwm_fb[1] t_ecfpwm_fb[0] t_ecfpwm_fb[1] lv_err_ecf_el_1 err_ecfpwm_fb[0] err_ecfpwm_fb[1] abc_ecfpwm_fb[0] abc_ecfpwm_fb[1] cdn_diag_ecf_el[0] cdn_diag_ecf_el[1] cdn_diag_ecfpwm_bas[0] cdn_diag_ecfpwm_bas[1] lv_err_ecf_el_2 lv_err_ecfpwm_fb_2 /end OUT_MEASUREMENT
/end FUNCTION
/begin FUNCTION ENTE_cooling_fan_diag_AI "cooling_fan_diag_AI" /end FUNCTION
/begin FUNCTION CPULOAD ""
 /begin DEF_CHARACTERISTIC c_cpu_load_per c_cpu_load_ses_t_begin c_cpu_load_ses_t_end c_cpu_load_tsk_mes_dly lc_cpu_load_max_rst lc_cpu_load_tsk_per_min_rst lc_cpu_load_tsk_per_min_upd /end DEF_CHARACTERISTIC
 /begin OUT_MEASUREMENT cpu_load_tsk_per_ctr cpu_load cpu_load_max cpu_load_tsk_per cpu_load_tsk_per_min_save cpu_load_tsk_per_min /end OUT_MEASUREMENT
/end FUNCTION
/begin FUNCTION C_5_FMSP "" /begin SUB_FUNCTION FMSP_Admin_of_Calc_Opt /end SUB_FUNCTION /end FUNCTION
/begin FUNCTION FMSP_Admin_of_Calc_Opt ""
 /begin DEF_CHARACTERISTIC c_n_32_thd_clc_red c_n_32_hys_clc_red c_seg_nr_st_clc_red id_ctr_cyl_nr_clc ldp_seg_nr_id_ctr_cyl_nr_clc /end DEF_CHARACTERISTIC
 /begin OUT_MEASUREMENT state_clc_red ctr_cyl_nr_st_clc ctr_cyl_nr_stop_clc ctr_cbk_in_nr_st_clc ctr_cbk_in_nr_stop_clc ctr_cbk_ex_nr_st_clc ctr_cbk_ex_nr_stop_clc /end OUT_MEASUREMENT
/end FUNCTION
/begin FUNCTION C_7_FMSP ""
 /begin SUB_FUNCTION FMSP_Manag FMSP_Configuration_Data FMSP_Combustion_Chamber FMSP_Ambient_Pressure_Cor FMSP_Warm_Up_Correction FMSP_Basic_Injection FMSP_Cold_Post_Start_Cor FMSP_Restart_Function FMSP_Restart_Function_Appl_Inc FMSP_Start_Injection_Time FMSP_Conversion_MFF_to_TI FMSP_Wall_Film_Compensation FMSP_Conversion_TI_to_MFF FMSP_Injection_Time_At_Restart FMSP_Predef_for_Single_Inj FMSP_Inj_Setpoint_Hom_Mode FMSP_Cal_of_MFF_Setpoint FMSP_Cal_of_Cyl_Indiv_Mff_Setp FMSP_Application_Incidences FMSP_FQA_Appl_Inc FMSP_Fuel_Quality_Adapt_at_ES /end SUB_FUNCTION
/end FUNCTION
/begin FUNCTION FMSP_Manag "" /end FUNCTION
/begin FUNCTION FMSP_Configuration_Data "" /end FUNCTION
/begin FUNCTION FMSP_Combustion_Chamber "" /end FUNCTION
/begin FUNCTION FMSP_Ambient_Pressure_Cor ""
 /begin DEF_CHARACTERISTIC ldp_amp_ip_crk_delta_amp ldp_amp_ip_fac_st_amp ip_fac_st_amp /end DEF_CHARACTERISTIC
 /begin OUT_MEASUREMENT fac_st_amp /end OUT_MEASUREMENT
/end FUNCTION
/begin FUNCTION FMSP_Warm_Up_Correction "" /end FUNCTION
/begin FUNCTION FMSP_Basic_Injection "" /end FUNCTION
/begin FUNCTION FMSP_Cold_Post_Start_Cor "" /end FUNCTION
/begin FUNCTION FMSP_Restart_Function "" /end FUNCTION
/begin FUNCTION FMSP_Restart_Function_Appl_Inc "" /end FUNCTION
/begin FUNCTION FMSP_Start_Injection_Time "" /end FUNCTION
/begin FUNCTION FMSP_Conversion_MFF_to_TI "" /end FUNCTION
/begin FUNCTION FMSP_Wall_Film_Compensation "" /end FUNCTION
/begin FUNCTION FMSP_Conversion_TI_to_MFF "" /end FUNCTION
/begin FUNCTION FMSP_Injection_Time_At_Restart "" /end FUNCTION
/begin FUNCTION FMSP_Predef_for_Single_Inj "" /end FUNCTION
/begin FUNCTION FMSP_Inj_Setpoint_Hom_Mode "" /end FUNCTION
/begin FUNCTION FMSP_Cal_of_MFF_Setpoint "" /end FUNCTION
/begin FUNCTION FMSP_Cal_of_Cyl_Indiv_Mff_Setp "" /end FUNCTION
/begin FUNCTION FMSP_Application_Incidences "" /end FUNCTION
/begin FUNCTION FMSP_FQA_Appl_Inc "" /end FUNCTION
/begin FUNCTION FMSP_Fuel_Quality_Adapt_at_ES "" /end FUNCTION
/begin FUNCTION C_7_INJR "" /begin DEF_CHARACTERISTIC ldpm_mff_sp_1_injr ldp_mff_sp_ip_fac_ti_2_s /end DEF_CHARACTERISTIC
 /begin OUT_MEASUREMENT injr.STR_INJR_ISPCLEGYIV0.egy_add_ad[0] injr.STR_INJR_ISPCLEGYIV0.egy_add_ad[1] injr.STR_INJR_ISPCLEGYIV0.egy_add_ad[2] injr.STR_INJR_ISPCLEGYIV0.egy_add_ad[3] injr.STR_INJR_ISPCLEGYIV0.egy_add_ad[4] injr.STR_INJR_ISPCLEGYIV0.egy_add_ad[5] injr.STR_INJR_ISPCLEGYIV0.egy_add_ad[6] injr.STR_INJR_ISPCLEGYIV0.egy_add_ad[7] /end OUT_MEASUREMENT
 /begin SUB_FUNCTION INJR_Pressure_Corr_strat_2nd_pulse INJR_Application_Incidences INJR_Pressure_Corr_hom_1st_pulse INJR_Pressure_Corr_hom_2nd_pulse INJR_Pressure_Corr_hom_3d_pulse INJR_Pressure_Corr_strat_1st_pulse INJR_Injector_dead_time_correction INJR_Cylinder_Shut_Off_Appl_Inc INJR_Final_Injection_Timing INJR_Injection_phase_Appl_Inc INJR_Injection_phase_strat_1st_pulse INJR_Injection_phase_strat_2nd_pulse INJR_Transfer_to_basic_sw INJR_Injection_phase_1st_pulse INJR_Fuel_temperature_correction INJR_Correction_via_Appl_System INJR_Cylinder_Shut_Off INJR_Injection_phase_2nd_pulse INJR_Injection_phase_3d_pulse INJR_Comp_of_temp_influence INJR_Injector_needle_lift_adj INJR_Injector_needle_lift_control INJR_Comp_of_fuel_pres_influence INJR_Inj_phase_hom_strat_mode INJR_Piezo_capa_temp_det INJR_Comp_of_inj_duty_cycle INJR_Inj_needle_lift_co_Appl_Inc /end SUB_FUNCTION
/end FUNCTION
/begin FUNCTION INJR_Pressure_Corr_strat_2nd_pulse "" /begin OUT_MEASUREMENT fac_ti_2_prs_s prs_inj_mv_2_s crk_inj_2_s prs_dec_inj_2_s /end OUT_MEASUREMENT /end FUNCTION
/begin FUNCTION INJR_Application_Incidences ""
 /begin DEF_CHARACTERISTIC c_t_dly_1_2_s_ext_man ldp_mff_sp_hom_ip_mff_add_reac ldp_n_ip_mff_add_reac ip_mff_add_reac lc_t_dly_1_2_s_ext_man_ena c_inj_mod_sp_man lc_inj_mod_sp_man_ena /end DEF_CHARACTERISTIC
 /begin OUT_MEASUREMENT t_dly_1_2_s_ext[0] t_dly_1_2_s_ext[1] t_dly_1_2_s_ext[2] t_dly_1_2_s_ext[3] t_dly_1_2_s_ext[4] t_dly_1_2_s_ext[5] t_dly_1_2_s_ext[6] t_dly_1_2_s_ext[7] mff_add_reac[0] mff_add_reac[1] mff_add_reac[2] mff_add_reac[3] mff_add_reac[4] mff_add_reac[5] mff_add_reac[6] mff_add_reac[7] fac_n tfu_inj lv_iv_test_mod_auth lv_n_tooth_end_act nr_cyl_iv_test_mod state_inj_mod_req state_inj_mod_hom_req state_inj_mod_s_req lv_mff_sp_hom_vld lv_st_inj_req /end OUT_MEASUREMENT
/end FUNCTION
/begin FUNCTION INJR_Pressure_Corr_hom_1st_pulse "" /begin DEF_CHARACTERISTIC ldp_prs_dec_inj_ip_fac_ti_prs ip_fac_ti_prs /end DEF_CHARACTERISTIC /begin OUT_MEASUREMENT prs_dec_inj_1_hom fac_ti_1_prs_hom /end OUT_MEASUREMENT /end FUNCTION
/begin FUNCTION INJR_Pressure_Corr_hom_2nd_pulse ""
 /begin DEF_CHARACTERISTIC ldp_eoi_ip_prs_inc_cmp ldp_crk_inj_ip_prs_inc_cmp ip_prs_inc_cmp /end DEF_CHARACTERISTIC
 /begin OUT_MEASUREMENT fac_ti_2_prs_hom prs_inj_mv_2_hom crk_inj_2_hom prs_dec_inj_2_hom /end OUT_MEASUREMENT
/end FUNCTION
/begin FUNCTION INJR_Pressure_Corr_hom_3d_pulse ""
 /begin OUT_MEASUREMENT fac_ti_3_prs_hom prs_inj_mv_3_hom crk_inj_3_hom prs_dec_inj_3_hom /end OUT_MEASUREMENT
/end FUNCTION
/begin FUNCTION INJR_Pressure_Corr_strat_1st_pulse ""
 /begin DEF_CHARACTERISTIC ip_prs_inc_cmp_s ldp_crk_inj_1_s_ip_prs_inc_cmp ldp_eoi_1_s_0_ip_prs_inc_cmp_s /end DEF_CHARACTERISTIC
 /begin OUT_MEASUREMENT prs_dec_inj_1_s fac_ti_1_prs_s prs_inj_mv_1_s crk_inj_1_s /end OUT_MEASUREMENT
/end FUNCTION
/begin FUNCTION INJR_Injector_dead_time_correction ""
 /begin DEF_CHARACTERISTIC ldpm_prs_dec_inj_1_injr ip_ti_add_dly_hpdi_egy_l ip_ti_add_dly_hpdi_egy_h /end DEF_CHARACTERISTIC
 /begin OUT_MEASUREMENT ti_1_add_dly_s ti_2_add_dly_s ti_1_add_dly ti_2_add_dly ti_3_add_dly ti_1_add_dly_hom ti_2_add_dly_hom ti_3_add_dly_hom ti_post_add_dly /end OUT_MEASUREMENT
/end FUNCTION
/begin FUNCTION INJR_Cylinder_Shut_Off_Appl_Inc "" /begin DEF_CHARACTERISTIC c_inh_iv_swi_man lc_inh_iv_diag_err_imdt_ena /end DEF_CHARACTERISTIC /begin OUT_MEASUREMENT inh_iv_ext lv_scc inh_iv_swi_man inh_iv_ign_inj_lock_req /end OUT_MEASUREMENT /end FUNCTION
/begin FUNCTION INJR_Final_Injection_Timing ""
 /begin DEF_CHARACTERISTIC c_t_auth_ti_min_afl lc_ti_2_s_man_act lc_ti_1_s_man_act c_ti_2_s_man lc_ti_1_hom_man_act c_ti_1_hom_man ip_ti_min_hom ip_ti_min_s ip_mff_ti_stnd_egy_h ip_mff_ti_stnd_egy_l c_ti_1_s_man c_ti_min_ofs c_ti_min_hys_s ip_fac_ti_2_s_dly_cor ip_fac_ti_2_s_cor ldp_t_dly_1_2_s_ip_fac_ti_2_s ldp_ti_2_s_ip_fac_ti_2_s_cor c_ti_2_hom_man c_ti_3_hom_man lc_ti_2_hom_man_act lc_ti_3_hom_man_act /end DEF_CHARACTERISTIC
 /begin OUT_MEASUREMENT lv_ti_1_hom_min lv_auth_ti_min_afl lv_auth_ti_min_s lv_ti_2_s_min lv_ti_1_s_min ti_1_hom_clc_min ti_1_hom_clc_max ti_1_s_clc_min ti_2_s_clc_min ti_min_hom ti_min_s fac_ti_2_s_dly_cor fac_ti_2_s_cor lv_ti_2_hom_min lv_ti_3_hom_min ti_2_hom_clc_min ti_3_hom_clc_min ti_2_hom_clc_max ti_3_hom_clc_max injr.STR_INJR_ACCTLFINAL0.ti_1_hom[0] injr.STR_INJR_ACCTLFINAL0.ti_1_hom[1] injr.STR_INJR_ACCTLFINAL0.ti_1_hom[2] injr.STR_INJR_ACCTLFINAL0.ti_1_hom[3] injr.STR_INJR_ACCTLFINAL0.ti_1_hom[4] injr.STR_INJR_ACCTLFINAL0.ti_1_hom[5] injr.STR_INJR_ACCTLFINAL0.ti_1_hom[6] injr.STR_INJR_ACCTLFINAL0.ti_1_hom[7] injr.STR_INJR_ACCTLFINAL0.ti_1_hom_clc[0] injr.STR_INJR_ACCTLFINAL0.ti_1_hom_clc[1] injr.STR_INJR_ACCTLFINAL0.ti_1_hom_clc[2] injr.STR_INJR_ACCTLFINAL0.ti_1_hom_clc[3] injr.STR_INJR_ACCTLFINAL0.ti_1_hom_clc[4] injr.STR_INJR_ACCTLFINAL0.ti_1_hom_clc[5] injr.STR_INJR_ACCTLFINAL0.ti_1_hom_clc[6] injr.STR_INJR_ACCTLFINAL0.ti_1_hom_clc[7] injr.STR_INJR_ACCTLFINAL0.ti_2_hom[0] injr.STR_INJR_ACCTLFINAL0.ti_2_hom[1] injr.STR_INJR_ACCTLFINAL0.ti_2_hom[2] injr.STR_INJR_ACCTLFINAL0.ti_2_hom[3] injr.STR_INJR_ACCTLFINAL0.ti_2_hom[4] injr.STR_INJR_ACCTLFINAL0.ti_2_hom[5] injr.STR_INJR_ACCTLFINAL0.ti_2_hom[6] injr.STR_INJR_ACCTLFINAL0.ti_2_hom[7] injr.STR_INJR_ACCTLFINAL0.ti_2_hom_clc[0] injr.STR_INJR_ACCTLFINAL0.ti_2_hom_clc[1] injr.STR_INJR_ACCTLFINAL0.ti_2_hom_clc[2] injr.STR_INJR_ACCTLFINAL0.ti_2_hom_clc[3] injr.STR_INJR_ACCTLFINAL0.ti_2_hom_clc[4] injr.STR_INJR_ACCTLFINAL0.ti_2_hom_clc[5] injr.STR_INJR_ACCTLFINAL0.ti_2_hom_clc[6] injr.STR_INJR_ACCTLFINAL0.ti_2_hom_clc[7] injr.STR_INJR_ACCTLFINAL0.ti_1_s[0] injr.STR_INJR_ACCTLFINAL0.ti_1_s[1] injr.STR_INJR_ACCTLFINAL0.ti_1_s[2] injr.STR_INJR_ACCTLFINAL0.ti_1_s[3] injr.STR_INJR_ACCTLFINAL0.ti_1_s[4] injr.STR_INJR_ACCTLFINAL0.ti_1_s[5] injr.STR_INJR_ACCTLFINAL0.ti_1_s[6] injr.STR_INJR_ACCTLFINAL0.ti_1_s[7] injr.STR_INJR_ACCTLFINAL0.ti_2_s[0] injr.STR_INJR_ACCTLFINAL0.ti_2_s[1] injr.STR_INJR_ACCTLFINAL0.ti_2_s[2] injr.STR_INJR_ACCTLFINAL0.ti_2_s[3] injr.STR_INJR_ACCTLFINAL0.ti_2_s[4] injr.STR_INJR_ACCTLFINAL0.ti_2_s[5] injr.STR_INJR_ACCTLFINAL0.ti_2_s[6] injr.STR_INJR_ACCTLFINAL0.ti_2_s[7] injr.STR_INJR_ACCTLFINAL0.ti_1_s_clc[0] injr.STR_INJR_ACCTLFINAL0.ti_1_s_clc[1] injr.STR_INJR_ACCTLFINAL0.ti_1_s_clc[2] injr.STR_INJR_ACCTLFINAL0.ti_1_s_clc[3] injr.STR_INJR_ACCTLFINAL0.ti_1_s_clc[4] injr.STR_INJR_ACCTLFINAL0.ti_1_s_clc[5] injr.STR_INJR_ACCTLFINAL0.ti_1_s_clc[6] injr.STR_INJR_ACCTLFINAL0.ti_1_s_clc[7] injr.STR_INJR_ACCTLFINAL0.ti_2_s_clc[0] injr.STR_INJR_ACCTLFINAL0.ti_2_s_clc[1] injr.STR_INJR_ACCTLFINAL0.ti_2_s_clc[2] injr.STR_INJR_ACCTLFINAL0.ti_2_s_clc[3] injr.STR_INJR_ACCTLFINAL0.ti_2_s_clc[4] injr.STR_INJR_ACCTLFINAL0.ti_2_s_clc[5] injr.STR_INJR_ACCTLFINAL0.ti_2_s_clc[6] injr.STR_INJR_ACCTLFINAL0.ti_2_s_clc[7] injr.STR_INJR_ACCTLFINAL0.ti_1_stnd_hom[0] injr.STR_INJR_ACCTLFINAL0.ti_1_stnd_hom[1] injr.STR_INJR_ACCTLFINAL0.ti_1_stnd_hom[2] injr.STR_INJR_ACCTLFINAL0.ti_1_stnd_hom[3] injr.STR_INJR_ACCTLFINAL0.ti_1_stnd_hom[4] injr.STR_INJR_ACCTLFINAL0.ti_1_stnd_hom[5] injr.STR_INJR_ACCTLFINAL0.ti_1_stnd_hom[6] injr.STR_INJR_ACCTLFINAL0.ti_1_stnd_hom[7] injr.STR_INJR_ACCTLFINAL0.ti_2_stnd_hom[0] injr.STR_INJR_ACCTLFINAL0.ti_2_stnd_hom[1] injr.STR_INJR_ACCTLFINAL0.ti_2_stnd_hom[2] injr.STR_INJR_ACCTLFINAL0.ti_2_stnd_hom[3] injr.STR_INJR_ACCTLFINAL0.ti_2_stnd_hom[4] injr.STR_INJR_ACCTLFINAL0.ti_2_stnd_hom[5] injr.STR_INJR_ACCTLFINAL0.ti_2_stnd_hom[6] injr.STR_INJR_ACCTLFINAL0.ti_2_stnd_hom[7] injr.STR_INJR_ACCTLFINAL0.mff_sp_1_hom_cor_inj[0] injr.STR_INJR_ACCTLFINAL0.mff_sp_1_hom_cor_inj[1] injr.STR_INJR_ACCTLFINAL0.mff_sp_1_hom_cor_inj[2] injr.STR_INJR_ACCTLFINAL0.mff_sp_1_hom_cor_inj[3] injr.STR_INJR_ACCTLFINAL0.mff_sp_1_hom_cor_inj[4] injr.STR_INJR_ACCTLFINAL0.mff_sp_1_hom_cor_inj[5] injr.STR_INJR_ACCTLFINAL0.mff_sp_1_hom_cor_inj[6] injr.STR_INJR_ACCTLFINAL0.mff_sp_1_hom_cor_inj[7] injr.STR_INJR_ACCTLFINAL0.mff_sp_2_hom_cor_inj[0] injr.STR_INJR_ACCTLFINAL0.mff_sp_2_hom_cor_inj[1] injr.STR_INJR_ACCTLFINAL0.mff_sp_2_hom_cor_inj[2] injr.STR_INJR_ACCTLFINAL0.mff_sp_2_hom_cor_inj[3] injr.STR_INJR_ACCTLFINAL0.mff_sp_2_hom_cor_inj[4] injr.STR_INJR_ACCTLFINAL0.mff_sp_2_hom_cor_inj[5] injr.STR_INJR_ACCTLFINAL0.mff_sp_2_hom_cor_inj[6] injr.STR_INJR_ACCTLFINAL0.mff_sp_2_hom_cor_inj[7] injr.STR_INJR_ACCTLFINAL0.ti_3_hom[0] injr.STR_INJR_ACCTLFINAL0.ti_3_hom[1] injr.STR_INJR_ACCTLFINAL0.ti_3_hom[2] injr.STR_INJR_ACCTLFINAL0.ti_3_hom[3] injr.STR_INJR_ACCTLFINAL0.ti_3_hom[4] injr.STR_INJR_ACCTLFINAL0.ti_3_hom[5] injr.STR_INJR_ACCTLFINAL0.ti_3_hom[6] injr.STR_INJR_ACCTLFINAL0.ti_3_hom[7] injr.STR_INJR_ACCTLFINAL0.ti_3_hom_clc[0] injr.STR_INJR_ACCTLFINAL0.ti_3_hom_clc[1] injr.STR_INJR_ACCTLFINAL0.ti_3_hom_clc[2] injr.STR_INJR_ACCTLFINAL0.ti_3_hom_clc[3] injr.STR_INJR_ACCTLFINAL0.ti_3_hom_clc[4] injr.STR_INJR_ACCTLFINAL0.ti_3_hom_clc[5] injr.STR_INJR_ACCTLFINAL0.ti_3_hom_clc[6] injr.STR_INJR_ACCTLFINAL0.ti_3_hom_clc[7] injr.STR_INJR_ACCTLFINAL0.ti_3_stnd_hom[0] injr.STR_INJR_ACCTLFINAL0.ti_3_stnd_hom[1] injr.STR_INJR_ACCTLFINAL0.ti_3_stnd_hom[2] injr.STR_INJR_ACCTLFINAL0.ti_3_stnd_hom[3] injr.STR_INJR_ACCTLFINAL0.ti_3_stnd_hom[4] injr.STR_INJR_ACCTLFINAL0.ti_3_stnd_hom[5] injr.STR_INJR_ACCTLFINAL0.ti_3_stnd_hom[6] injr.STR_INJR_ACCTLFINAL0.ti_3_stnd_hom[7] injr.STR_INJR_ACCTLFINAL0.mff_sp_3_hom_cor_inj[0] injr.STR_INJR_ACCTLFINAL0.mff_sp_3_hom_cor_inj[1] injr.STR_INJR_ACCTLFINAL0.mff_sp_3_hom_cor_inj[2] injr.STR_INJR_ACCTLFINAL0.mff_sp_3_hom_cor_inj[3] injr.STR_INJR_ACCTLFINAL0.mff_sp_3_hom_cor_inj[4] injr.STR_INJR_ACCTLFINAL0.mff_sp_3_hom_cor_inj[5] injr.STR_INJR_ACCTLFINAL0.mff_sp_3_hom_cor_inj[6] injr.STR_INJR_ACCTLFINAL0.mff_sp_3_hom_cor_inj[7] /end OUT_MEASUREMENT
/end FUNCTION
/begin FUNCTION INJR_Injection_phase_Appl_Inc ""
 /begin OUT_MEASUREMENT cam_shift_ex cam_shift_in soi_1_hom_ext[0] soi_1_hom_ext[1] soi_1_hom_ext[2] soi_1_hom_ext[3] soi_1_hom_ext[4] soi_1_hom_ext[5] soi_1_hom_ext[6] soi_1_hom_ext[7] eoi_1_s_ext[0] eoi_1_s_ext[1] eoi_1_s_ext[2] eoi_1_s_ext[3] eoi_1_s_ext[4] eoi_1_s_ext[5] eoi_1_s_ext[6] eoi_1_s_ext[7] eoi_2_s_ext[0] eoi_2_s_ext[1] eoi_2_s_ext[2] eoi_2_s_ext[3] eoi_2_s_ext[4] eoi_2_s_ext[5] eoi_2_s_ext[6] eoi_2_s_ext[7] soi_1_homs_ext[0] soi_1_homs_ext[1] soi_1_homs_ext[2] soi_1_homs_ext[3] soi_1_homs_ext[4] soi_1_homs_ext[5] soi_1_homs_ext[6] soi_1_homs_ext[7] eoi_2_homs_ext[0] eoi_2_homs_ext[1] eoi_2_homs_ext[2] eoi_2_homs_ext[3] eoi_2_homs_ext[4] eoi_2_homs_ext[5] eoi_2_homs_ext[6] eoi_2_homs_ext[7] eoi_2_hom_ext[0] eoi_2_hom_ext[1] eoi_2_hom_ext[2] eoi_2_hom_ext[3] eoi_2_hom_ext[4] eoi_2_hom_ext[5] eoi_2_hom_ext[6] eoi_2_hom_ext[7] eoi_3_hom_ext[0] eoi_3_hom_ext[1] eoi_3_hom_ext[2] eoi_3_hom_ext[3] eoi_3_hom_ext[4] eoi_3_hom_ext[5] eoi_3_hom_ext[6] eoi_3_hom_ext[7] /end OUT_MEASUREMENT
/end FUNCTION
/begin FUNCTION INJR_Injection_phase_strat_1st_pulse "" /begin DEF_CHARACTERISTIC lc_eoi_1_s_man c_eoi_1_s_man /end DEF_CHARACTERISTIC
 /begin OUT_MEASUREMENT injr.STR_INJR_REQGNS1P0.eoi_1_s[0] injr.STR_INJR_REQGNS1P0.eoi_1_s[1] injr.STR_INJR_REQGNS1P0.eoi_1_s[2] injr.STR_INJR_REQGNS1P0.eoi_1_s[3] injr.STR_INJR_REQGNS1P0.eoi_1_s[4] injr.STR_INJR_REQGNS1P0.eoi_1_s[5] injr.STR_INJR_REQGNS1P0.eoi_1_s[6] injr.STR_INJR_REQGNS1P0.eoi_1_s[7] injr.STR_INJR_REQGNS1P0.soi_1_s[0] injr.STR_INJR_REQGNS1P0.soi_1_s[1] injr.STR_INJR_REQGNS1P0.soi_1_s[2] injr.STR_INJR_REQGNS1P0.soi_1_s[3] injr.STR_INJR_REQGNS1P0.soi_1_s[4] injr.STR_INJR_REQGNS1P0.soi_1_s[5] injr.STR_INJR_REQGNS1P0.soi_1_s[6] injr.STR_INJR_REQGNS1P0.soi_1_s[7] /end OUT_MEASUREMENT
/end FUNCTION
/begin FUNCTION INJR_Injection_phase_strat_2nd_pulse "" /begin DEF_CHARACTERISTIC lc_eoi_2_s_man c_eoi_2_s_man /end DEF_CHARACTERISTIC
 /begin OUT_MEASUREMENT injr.STR_INJR_REQGNS2P0.eoi_2_s[0] injr.STR_INJR_REQGNS2P0.eoi_2_s[1] injr.STR_INJR_REQGNS2P0.eoi_2_s[2] injr.STR_INJR_REQGNS2P0.eoi_2_s[3] injr.STR_INJR_REQGNS2P0.eoi_2_s[4] injr.STR_INJR_REQGNS2P0.eoi_2_s[5] injr.STR_INJR_REQGNS2P0.eoi_2_s[6] injr.STR_INJR_REQGNS2P0.eoi_2_s[7] injr.STR_INJR_REQGNS2P0.soi_2_s[0] injr.STR_INJR_REQGNS2P0.soi_2_s[1] injr.STR_INJR_REQGNS2P0.soi_2_s[2] injr.STR_INJR_REQGNS2P0.soi_2_s[3] injr.STR_INJR_REQGNS2P0.soi_2_s[4] injr.STR_INJR_REQGNS2P0.soi_2_s[5] injr.STR_INJR_REQGNS2P0.soi_2_s[6] injr.STR_INJR_REQGNS2P0.soi_2_s[7] /end OUT_MEASUREMENT
/end FUNCTION
/end MODULE
/end PROJECT
