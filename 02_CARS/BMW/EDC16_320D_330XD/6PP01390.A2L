ASAP2_VERSION 1 3
/begin PROJECT P390 "BMW DDE6.2 6-Zylinder VP0.1 11.11.2003 CAN12H"
/begin HEADER "" VERSION "VP01_6Z_CAN12H" PROJECT_NO P390 /end HEADER
/begin MODULE DIM ""
/begin MOD_COMMON "" BYTE_ORDER MSB_FIRST ALIGNMENT_BYTE 1 ALIGNMENT_WORD 2 ALIGNMENT_LONG 4 ALIGNMENT_FLOAT32_IEEE 4 /end MOD_COMMON
/begin CHARACTERISTIC Signals_adFreeApplic1_C "adresse eines frei applizierbaren Signals" VALUE 0xC0538 Kw_Wu32 4294967295.00 OneToOne 0.00 4294967295.00 FORMAT "%13.2" /end CHARACTERISTIC
/begin CHARACTERISTIC Signals_numTypFreeApplic1_C "Datentyp eines frei applizierbaren Signals" VALUE 0xC053C Kw_Wu8 5.00000000000 SigDatatyp 0.00 5.00000000000 FORMAT "%13.11" /end CHARACTERISTIC
/begin CHARACTERISTIC Signals_adFreeApplic2_C "adresse eines frei applizierbaren Signals" VALUE 0xC0540 Kw_Wu32 4294967295.00 OneToOne 0.00 4294967295.00 FORMAT "%13.2" /end CHARACTERISTIC
/begin CHARACTERISTIC Signals_numTypFreeApplic2_C "Datentyp eines frei applizierbaren Signals" VALUE 0xC0544 Kw_Wu8 5.00000000000 SigDatatyp 0.00 5.00000000000 FORMAT "%13.11" /end CHARACTERISTIC
/begin CHARACTERISTIC Signals_adFreeApplic3_C "adresse eines frei applizierbaren Signals" VALUE 0xC0548 Kw_Wu32 4294967295.00 OneToOne 0.00 4294967295.00 FORMAT "%13.2" /end CHARACTERISTIC
/begin CHARACTERISTIC Signals_numTypFreeApplic3_C "Datentyp eines frei applizierbaren Signals" VALUE 0xC054C Kw_Wu8 5.00000000000 SigDatatyp 0.00 5.00000000000 FORMAT "%13.11" /end CHARACTERISTIC
/begin CHARACTERISTIC Rail_dpSetPointDec_C "#SSD maximaler Raildruck-Sollwertabfall pro Sekunde" VALUE 0xEA2C8 Kw_Ws16 26214.000 PresRail_sec -13107.200 13106.800 FORMAT "%5.3" /end CHARACTERISTIC
/begin CHARACTERISTIC Rail_dpSetPointIncFDC_MAP " Inc. value correction map of rail pressure setpoint" MAP 0xEA2CA Kf_Xs16_Ys16_Ws16 13000.000 PresRail_sec 0.00 13000.000 FORMAT "%5.3" EXTENDED_LIMITS -13107.200 13106.800
 /begin AXIS_DESCR STD_AXIS Eng_nAvrg EngN 12 0.00 6000.000 FORMAT "%8.3" EXTENDED_LIMITS -32768.00 32767.00 DEPOSIT ABSOLUTE /end AXIS_DESCR
 /begin AXIS_DESCR STD_AXIS InjCtl_qSetUnBal InjMassCyc 8 0.00 327.6700 FORMAT "%8.4" EXTENDED_LIMITS -327.6800 327.6700 DEPOSIT ABSOLUTE /end AXIS_DESCR
/end CHARACTERISTIC
/begin CHARACTERISTIC Rail_dpSetPointInc_MAP "#SSD maximaler Raildruck-Sollwertanstieg pro Sekunde, abhängig von der Motordrehzahl und der Einspritzmenge" MAP 0xEA3B6 Kf_Xs16_Ys16_Ws16 13000.000 PresRail_sec 0.00 13000.000 FORMAT "%5.3" EXTENDED_LIMITS -13107.200 13106.800
 /begin AXIS_DESCR STD_AXIS Eng_nAvrg EngN 12 0.00 6000.000 FORMAT "%8.3" EXTENDED_LIMITS -32768.00 32767.00 DEPOSIT ABSOLUTE /end AXIS_DESCR
 /begin AXIS_DESCR STD_AXIS InjCtl_qSetUnBal InjMassCyc 8 0.00 327.6700 FORMAT "%8.4" EXTENDED_LIMITS -327.6800 327.6700 DEPOSIT ABSOLUTE /end AXIS_DESCR
/end CHARACTERISTIC
/begin CHARACTERISTIC Rail_dtiRgnRmpUp_C "positive Rampensteigung zur Umschaltung auf Regenerationswert Raildrucksollwert" VALUE 0xEA2BC Kw_Wu32 65535999.9847 Rmp 0.00 65535999.9847 FORMAT "%13.4" /end CHARACTERISTIC
/begin CHARACTERISTIC Rail_dtiRgnRmpDwn_C "negative Rampensteigung zur Umschaltung auf Regenerationswert Raildrucksollwert" VALUE 0xEA2C0 Kw_Wu32 65535999.9847 Rmp 0.00 65535999.9847 FORMAT "%13.4" /end CHARACTERISTIC
/begin CHARACTERISTIC Rail_dvolLeak_MAP "Leckage-Kennfled für Druckregelung über Zumesseinheit" MAP 0xE9B18 Kf_Xs16_Ys16_Ws16 150000.0 Qp_mm3_sec 0.00 150000.0 FORMAT "%8.1" EXTENDED_LIMITS -327680.0 327670.0
 /begin AXIS_DESCR STD_AXIS Rail_pSetPoint Pres_Rail 10 0.00 2000.000 FORMAT "%5.3" EXTENDED_LIMITS -3276.800 3276.700 DEPOSIT ABSOLUTE /end AXIS_DESCR
 /begin AXIS_DESCR STD_AXIS FlSys_t Temp_Cels 10 -50.14000 199.8600 FORMAT "%8.4" EXTENDED_LIMITS -3549.940 3003.560 DEPOSIT ABSOLUTE /end AXIS_DESCR
/end CHARACTERISTIC
/begin CHARACTERISTIC Rail_dvolPreCtlBas_MAP "Basisvorsteuerkennfeld für Druckregelung über Zumesseinheit" MAP 0xE9C0C Kf_Xs16_Ys16_Ws16 150000.0 Qp_mm3_sec 0.00 150000.0 FORMAT "%8.1" EXTENDED_LIMITS -327680.0 327670.0
 /begin AXIS_DESCR STD_AXIS Eng_nAvrg EngN 16 0.00 6000.000 FORMAT "%8.3" EXTENDED_LIMITS -32768.00 32767.00 DEPOSIT ABSOLUTE /end AXIS_DESCR
 /begin AXIS_DESCR STD_AXIS Rail_qPreCtlBas_mp InjMassCyc 16 0.00 327.6700 FORMAT "%8.4" EXTENDED_LIMITS -327.6800 327.6700 DEPOSIT ABSOLUTE /end AXIS_DESCR
/end CHARACTERISTIC
/begin CHARACTERISTIC Rail_dvolPreCtlOfs_MAP "Offset Kennlinie des Vorsteuerwerts (Regelung über Zumesseinheit)" MAP 0xE9E50 Kf_Xs16_Ys16_Ws16 150000.0 Qp_mm3_sec 0.00 150000.0 FORMAT "%8.1" EXTENDED_LIMITS -327680.0 327670.0
 /begin AXIS_DESCR STD_AXIS Eng_nAvrg EngN 8 0.00 6000.000 FORMAT "%8.3" EXTENDED_LIMITS -32768.00 32767.00 DEPOSIT ABSOLUTE /end AXIS_DESCR
 /begin AXIS_DESCR STD_AXIS InjCtl_qSetUnBal InjMassCyc 8 0.00 327.6700 FORMAT "%8.4" EXTENDED_LIMITS -327.6800 327.6700 DEPOSIT ABSOLUTE /end AXIS_DESCR
/end CHARACTERISTIC
/begin CHARACTERISTIC Rail_dvolPreCtlPoI1_MAP "#SSD Vorsteuerkennfeld abhängig von der Nacheinspritzmenge 1 für die Druckregelung über Zumesseinheit" MAP 0xE9EF4 Kf_Xs16_Ys16_Ws16 150000.0 Qp_mm3_sec 0.00 150000.0 FORMAT "%8.1" EXTENDED_LIMITS -327680.0 327670.0
 /begin AXIS_DESCR STD_AXIS Eng_nAvrg EngN 2 0.00 6000.000 FORMAT "%8.3" EXTENDED_LIMITS -32768.00 32767.00 DEPOSIT ABSOLUTE /end AXIS_DESCR
 /begin AXIS_DESCR STD_AXIS InjCrv_qPoI1Des_mp InjMassInj 4 0.00 327.6700 FORMAT "%8.4" EXTENDED_LIMITS -327.6800 327.6700 DEPOSIT ABSOLUTE /end AXIS_DESCR
/end CHARACTERISTIC
/begin CHARACTERISTIC Rail_dvolPreCtlPoI2_MAP "#SSD Vorsteuerkennfeld abhängig von der Nacheinspritzmenge 2 für die Druckregelung über Zumesseinheit" MAP 0xE9F14 Kf_Xs16_Ys16_Ws16 150000.0 Qp_mm3_sec 0.00 150000.0 FORMAT "%8.1" EXTENDED_LIMITS -327680.0 327670.0
 /begin AXIS_DESCR STD_AXIS Eng_nAvrg EngN 2 0.00 6000.000 FORMAT "%8.3" EXTENDED_LIMITS -32768.00 32767.00 DEPOSIT ABSOLUTE /end AXIS_DESCR
 /begin AXIS_DESCR STD_AXIS InjCrv_qPoI2Des_mp InjMassInj 4 0.00 327.6700 FORMAT "%8.4" EXTENDED_LIMITS -327.6800 327.6700 DEPOSIT ABSOLUTE /end AXIS_DESCR
/end CHARACTERISTIC
/begin CHARACTERISTIC Rail_dvolRedOfsLim_C "#SSD Schwelle fuer Kraftstoffmenge  zur Verringerung  des Offsetwertes fuer PCV" VALUE 0xE9F3A Kw_Ws16 655350.0 Qp_mm3_sec -327680.0 327670.0 FORMAT "%8.1" /end CHARACTERISTIC
/begin CHARACTERISTIC Rail_facAPSetPDynCor_CUR "Gewichtungsfaktor, abhängig vom Atmosphärendruck" CURVE 0xEAB8C Kl_Xs16_Ws16 2.000000 Fact 0.00 2.000000 FORMAT "%8.6" EXTENDED_LIMITS -4.000000 3.999878
 /begin AXIS_DESCR STD_AXIS APSCD_pVal Pres_hPa 6 0.00 3500.000 FORMAT "%8.3" EXTENDED_LIMITS -32768.00 32767.00 DEPOSIT ABSOLUTE /end AXIS_DESCR
/end CHARACTERISTIC
/begin CHARACTERISTIC Rail_facDQSetPDynCor_CUR "Gewichtungsfaktor, abhängig vom Einspritzmengengradient" CURVE 0xEABA6 Kl_Xs16_Ws16 4.000000 Fact -2.000000 2.000000 FORMAT "%8.6" EXTENDED_LIMITS -4.000000 3.999878
 /begin AXIS_DESCR STD_AXIS InjCrv_dqSetUnBalFltLim InjMassPerSec_20ms 6 -16384.00 16383.50 FORMAT "%8.2" DEPOSIT ABSOLUTE /end AXIS_DESCR
/end CHARACTERISTIC
/begin CHARACTERISTIC Rail_facETSetPDynCor_CUR "Gewichtungsfaktor, abhängig von der Motortemperatur" CURVE 0xEABC0 Kl_Xs16_Ws16 2.000000 Fact 0.00 2.000000 FORMAT "%8.6" EXTENDED_LIMITS -4.000000 3.999878
 /begin AXIS_DESCR STD_AXIS InjCrv_tEng Temp_Cels 6 -50.14000 199.8600 FORMAT "%8.4" EXTENDED_LIMITS -3549.940 3003.560 DEPOSIT ABSOLUTE /end AXIS_DESCR
/end CHARACTERISTIC
/begin CHARACTERISTIC Rail_facIASetPDynCor_CUR "weighting factor by atmospheric pressure for rail pressure setpoint correction" CURVE 0xEABDA Kl_Xs16_Ws16 2.000000 Fact 0.00 2.000000 FORMAT "%8.6" EXTENDED_LIMITS -4.000000 3.999878
 /begin AXIS_DESCR STD_AXIS IATSCD_tAir Temp_Cels 6 -50.14000 199.8600 FORMAT "%8.4" EXTENDED_LIMITS -3549.940 3003.560 DEPOSIT ABSOLUTE /end AXIS_DESCR
/end CHARACTERISTIC
/begin CHARACTERISTIC Rail_facLeakAged_C "#SSD Faktor zur Bestimmung des maximal möglichen Volumenstroms bei einem gealterten System" VALUE 0xE9F34 Kw_Ws16 1.000000 Fact 0.00 1.000000 FORMAT "%8.6" EXTENDED_LIMITS -4.000000 3.999878 /end CHARACTERISTIC
/begin CHARACTERISTIC Rail_facSetPointAPSCor_CUR "Gewichtungsfaktor, abhängig vom Atmosphärendruck für die Sollwertkorrektur des Raildrucks" CURVE 0xEB57A Kl_Xs16_Ws16 1.000000 Fact 0.00 1.000000 FORMAT "%8.6" EXTENDED_LIMITS -4.000000 3.999878
 /begin AXIS_DESCR STD_AXIS APSCD_pVal Pres_hPa 8 0.00 3500.000 FORMAT "%8.3" EXTENDED_LIMITS -32768.00 32767.00 DEPOSIT ABSOLUTE /end AXIS_DESCR
/end CHARACTERISTIC
/begin CHARACTERISTIC Rail_facSetPointAPSCStrt_CUR "Gewichtungsfaktor, abhängig vom Atmosphärendruck für die Sollwertkorrektur des Raildrucks beim Start" CURVE 0xEB59C Kl_Xs16_Ws16 1.000000 Fact 0.00 1.000000 FORMAT "%8.6" EXTENDED_LIMITS -4.000000 3.999878
 /begin AXIS_DESCR STD_AXIS APSCD_pVal Pres_hPa 8 0.00 3500.000 FORMAT "%8.3" EXTENDED_LIMITS -32768.00 32767.00 DEPOSIT ABSOLUTE /end AXIS_DESCR
/end CHARACTERISTIC
/begin CHARACTERISTIC Rail_facSetPointATSCor_CUR "Gewichtungsfaktor, abhängig von der Ansauglufttemperatur für die Sollwertkorrektur des Raildrucks" CURVE 0xEB5BE Kl_Xs16_Ws16 1.000000 Fact 0.00 1.000000 FORMAT "%8.6" EXTENDED_LIMITS -4.000000 3.999878
 /begin AXIS_DESCR STD_AXIS IATSCD_tAir Temp_Cels 8 -50.14000 199.8600 FORMAT "%8.4" EXTENDED_LIMITS -3549.940 3003.560 DEPOSIT ABSOLUTE /end AXIS_DESCR
/end CHARACTERISTIC
/begin CHARACTERISTIC Rail_facSetPointATSCStrt_CUR "Gewichtungsfaktor, abhängig von der Ansauglufttemperatur für die Sollwertkorrektur des Raildrucks beim Start" CURVE 0xEB5E0 Kl_Xs16_Ws16 1.000000 Fact 0.00 1.000000 FORMAT "%8.6" EXTENDED_LIMITS -4.000000 3.999878
 /begin AXIS_DESCR STD_AXIS IATSCD_tAir Temp_Cels 8 -50.14000 199.8600 FORMAT "%8.4" EXTENDED_LIMITS -3549.940 3003.560 DEPOSIT ABSOLUTE /end AXIS_DESCR
/end CHARACTERISTIC
/begin CHARACTERISTIC Rail_facSetPointETSCor1_CUR "weighting factor of engine temperature for rail pressure setpoint correction" CURVE 0xEB602 Kl_Xs16_Ws16 1.000000 Fact 0.00 1.000000 FORMAT "%8.6" EXTENDED_LIMITS -4.000000 3.999878
 /begin AXIS_DESCR STD_AXIS InjCrv_tEng Temp_Cels 8 -50.14000 199.8600 FORMAT "%8.4" EXTENDED_LIMITS -3549.940 3003.560 DEPOSIT ABSOLUTE /end AXIS_DESCR
/end CHARACTERISTIC
/begin CHARACTERISTIC Rail_facSetPointETSCor_CUR "Gewichtungsfaktor, abhängig von der Motortemperatur für die Sollwertkorrektur des Raildrucks" CURVE 0xEB624 Kl_Xs16_Ws16 1.000000 Fact 0.00 1.000000 FORMAT "%8.6" EXTENDED_LIMITS -4.000000 3.999878
 /begin AXIS_DESCR STD_AXIS InjCrv_tEng Temp_Cels 8 -50.14000 199.8600 FORMAT "%8.4" EXTENDED_LIMITS -3549.940 3003.560 DEPOSIT ABSOLUTE /end AXIS_DESCR
/end CHARACTERISTIC
/begin CHARACTERISTIC Rail_facSetPointETSCStrt_CUR "weighting factor of engine temperature for rail pressure setpoint correction start" CURVE 0xEB646 Kl_Xs16_Ws16 1.000000 Fact 0.00 1.000000 FORMAT "%8.6" EXTENDED_LIMITS -4.000000 3.999878
 /begin AXIS_DESCR STD_AXIS InjCrv_tEng Temp_Cels 8 -50.14000 199.8600 FORMAT "%8.4" EXTENDED_LIMITS -3549.940 3003.560 DEPOSIT ABSOLUTE /end AXIS_DESCR
/end CHARACTERISTIC
/begin CHARACTERISTIC Rail_facSetPointFTSCor_CUR "Gewichtungsfaktor, abhängig von der Kraftstofftemperatur für Raildruck-Sollwertkorrektur" CURVE 0xEABF4 Kl_Xs16_Ws16 1.000000 Fact 0.00 1.000000 FORMAT "%8.6" EXTENDED_LIMITS -4.000000 3.999878
 /begin AXIS_DESCR STD_AXIS FTSCD_tFuel Temp_Cels 6 -50.14000 199.8600 FORMAT "%8.4" EXTENDED_LIMITS -3549.940 3003.560 DEPOSIT ABSOLUTE /end AXIS_DESCR
/end CHARACTERISTIC
/begin CHARACTERISTIC Rail_pPCVCloseOfs_CUR "#SSD Vorsteuer Offset um das Druckregelventil geschlossen zu halten" CURVE 0xE9F3C Kl_Xs16_Ws16 6553.500 Pres_Rail -3276.800 3276.700 FORMAT "%5.3"
 /begin AXIS_DESCR STD_AXIS Rail_pSetPoint Pres_Rail 4 0.00 2000.000 FORMAT "%5.3" EXTENDED_LIMITS -3276.800 3276.700 DEPOSIT ABSOLUTE /end AXIS_DESCR
/end CHARACTERISTIC
/begin CHARACTERISTIC Rail_pPCVRedOfs_CUR "#SSD Vorsteuerreduzierung für schnelleren Druckabbau über das Druckregelventil" CURVE 0xE9F4E Kl_Xs16_Ws16 6553.500 Pres_Rail -3276.800 3276.700 FORMAT "%5.3"
 /begin AXIS_DESCR STD_AXIS Rail_pSetPoint Pres_Rail 4 0.00 2000.000 FORMAT "%5.3" EXTENDED_LIMITS -3276.800 3276.700 DEPOSIT ABSOLUTE /end AXIS_DESCR
/end CHARACTERISTIC
/begin CHARACTERISTIC Rail_pPeakMinZFC_C "Minimaler Raildruck für die Überwachung bei aktiver ZFC" VALUE 0xEB668 Kw_Ws16 2000.000 Pres_Rail 0.00 2000.000 FORMAT "%5.3" EXTENDED_LIMITS -3276.800 3276.700 /end CHARACTERISTIC
/begin CHARACTERISTIC Rail_pPreCtl_MAP "Vorsteuerkennfeld für die Druckregelung über Druckregelventil" MAP 0xE9F60 Kf_Xs16_Ys16_Ws16 2000.000 Pres_Rail 0.00 2000.000 FORMAT "%5.3" EXTENDED_LIMITS -3276.800 3276.700
 /begin AXIS_DESCR STD_AXIS Eng_nAvrg EngN 8 0.00 6000.000 FORMAT "%8.3" EXTENDED_LIMITS -32768.00 32767.00 DEPOSIT ABSOLUTE /end AXIS_DESCR
 /begin AXIS_DESCR STD_AXIS Rail_pSetPoint Pres_Rail 12 0.00 2000.000 FORMAT "%5.3" EXTENDED_LIMITS -3276.800 3276.700 DEPOSIT ABSOLUTE /end AXIS_DESCR
/end CHARACTERISTIC
/begin CHARACTERISTIC Rail_pRedOfsLim_C "Raildruckschwelle zur Reduzierung des Vorsteueroffsets des Druckregelventils" VALUE 0xEA04C Kw_Ws16 6553.500 Pres_Rail -3276.800 3276.700 FORMAT "%5.3" /end CHARACTERISTIC
/begin CHARACTERISTIC Rail_pSetPDynCor_MAP "Basiswert der dynamischen Raildruck-Sollwertkorrektur" MAP 0xEAC0E Kf_Xs16_Ys16_Ws16 2000.000 Pres_Rail 0.00 2000.000 FORMAT "%5.3" EXTENDED_LIMITS -3276.800 3276.700
 /begin AXIS_DESCR STD_AXIS Eng_nAvrg EngN 16 0.00 6000.000 FORMAT "%8.3" EXTENDED_LIMITS -32768.00 32767.00 DEPOSIT ABSOLUTE /end AXIS_DESCR
 /begin AXIS_DESCR STD_AXIS InjCtl_qSetUnBal InjMassCyc 8 0.00 327.6700 FORMAT "%8.4" EXTENDED_LIMITS -327.6800 327.6700 DEPOSIT ABSOLUTE /end AXIS_DESCR
/end CHARACTERISTIC
/begin CHARACTERISTIC Rail_pSetPointAPSCor_MAP "atmosphärendruckabhängiger Sollwertkorrektur des Raildrucks" MAP 0xEAF06 Kf_Xs16_Ys16_Ws16 2000.000 Pres_Rail 0.00 2000.000 FORMAT "%5.3" EXTENDED_LIMITS -3276.800 3276.700
 /begin AXIS_DESCR STD_AXIS Eng_nAvrg EngN 12 0.00 6000.000 FORMAT "%8.3" EXTENDED_LIMITS -32768.00 32767.00 DEPOSIT ABSOLUTE /end AXIS_DESCR
 /begin AXIS_DESCR STD_AXIS InjCtl_qCurr InjMassCyc 8 0.00 327.6700 FORMAT "%8.4" EXTENDED_LIMITS -327.6800 327.6700 DEPOSIT ABSOLUTE /end AXIS_DESCR
/end CHARACTERISTIC
/begin CHARACTERISTIC Rail_pSetPointAPSCStrt_MAP "atmosphärendruckabhängigen Sollwertkorrektur des Raildrucks beim Start" MAP 0xEAFF2 Kf_Xs16_Ys16_Ws16 2000.000 Pres_Rail 0.00 2000.000 FORMAT "%5.3" EXTENDED_LIMITS -3276.800 3276.700
 /begin AXIS_DESCR STD_AXIS Eng_nAvrg EngN 12 0.00 6000.000 FORMAT "%8.3" EXTENDED_LIMITS -32768.00 32767.00 DEPOSIT ABSOLUTE /end AXIS_DESCR
 /begin AXIS_DESCR STD_AXIS InjCtl_qCurr InjMassCyc 8 0.00 327.6700 FORMAT "%8.4" EXTENDED_LIMITS -327.6800 327.6700 DEPOSIT ABSOLUTE /end AXIS_DESCR
/end CHARACTERISTIC
/begin CHARACTERISTIC Rail_pSetPointATSCor_MAP "ansauglufttemperaturabhängige Sollwertkorrektur des Raildrucks" MAP 0xEB0DE Kf_Xs16_Ys16_Ws16 2000.000 Pres_Rail 0.00 2000.000 FORMAT "%5.3" EXTENDED_LIMITS -3276.800 3276.700
 /begin AXIS_DESCR STD_AXIS Eng_nAvrg EngN 12 0.00 6000.000 FORMAT "%8.3" EXTENDED_LIMITS -32768.00 32767.00 DEPOSIT ABSOLUTE /end AXIS_DESCR
 /begin AXIS_DESCR STD_AXIS InjCtl_qCurr InjMassCyc 8 0.00 327.6700 FORMAT "%8.4" EXTENDED_LIMITS -327.6800 327.6700 DEPOSIT ABSOLUTE /end AXIS_DESCR
/end CHARACTERISTIC
/begin CHARACTERISTIC Rail_pSetPointATSCStrt_MAP "ansauglufttemperaturabhängige Sollwertkorrektur des Raildrucks beim Start" MAP 0xEB1CA Kf_Xs16_Ys16_Ws16 2000.000 Pres_Rail 0.00 2000.000 FORMAT "%5.3" EXTENDED_LIMITS -3276.800 3276.700
 /begin AXIS_DESCR STD_AXIS Eng_nAvrg EngN 12 0.00 6000.000 FORMAT "%8.3" EXTENDED_LIMITS -32768.00 32767.00 DEPOSIT ABSOLUTE /end AXIS_DESCR
 /begin AXIS_DESCR STD_AXIS InjCtl_qCurr InjMassCyc 8 0.00 327.6700 FORMAT "%8.4" EXTENDED_LIMITS -327.6800 327.6700 DEPOSIT ABSOLUTE /end AXIS_DESCR
/end CHARACTERISTIC
/begin CHARACTERISTIC Rail_pSetPointBaseFDC_MAP "base map of rail pressure setpoint" MAP 0xEA4A2 Kf_Xs16_Ys16_Ws16 2000.000 Pres_Rail 0.00 2000.000 FORMAT "%5.3" EXTENDED_LIMITS -3276.800 3276.700
 /begin AXIS_DESCR STD_AXIS Eng_nAvrg EngN 16 0.00 6000.000 FORMAT "%8.3" EXTENDED_LIMITS -32768.00 32767.00 DEPOSIT ABSOLUTE /end AXIS_DESCR
 /begin AXIS_DESCR STD_AXIS InjCtl_qCurr InjMassCyc 16 0.00 327.6700 FORMAT "%8.4" EXTENDED_LIMITS -327.6800 327.6700 DEPOSIT ABSOLUTE /end AXIS_DESCR
/end CHARACTERISTIC
/begin CHARACTERISTIC Rail_pSetPointBaseStrt_MAP "Basiskennfeld für den Raildruck-Sollwert beim Start" MAP 0xEA6E6 Kf_Xs16_Ys16_Ws16 2000.000 Pres_Rail 0.00 2000.000 FORMAT "%5.3" EXTENDED_LIMITS -3276.800 3276.700
 /begin AXIS_DESCR STD_AXIS Eng_nAvrg EngN 16 0.00 6000.000 FORMAT "%8.3" EXTENDED_LIMITS -32768.00 32767.00 DEPOSIT ABSOLUTE /end AXIS_DESCR
 /begin AXIS_DESCR STD_AXIS InjCtl_qCurr InjMassCyc 16 0.00 327.6700 FORMAT "%8.4" EXTENDED_LIMITS -327.6800 327.6700 DEPOSIT ABSOLUTE /end AXIS_DESCR
/end CHARACTERISTIC
/begin CHARACTERISTIC Rail_pSetPointBase_MAP "Basiskennfeld für den Raildruck-Sollwert" MAP 0xEA92A Kf_Xs16_Ys16_Ws16 2000.000 Pres_Rail 0.00 2000.000 FORMAT "%5.3" EXTENDED_LIMITS -3276.800 3276.700
 /begin AXIS_DESCR STD_AXIS Eng_nAvrg EngN 16 0.00 6000.000 FORMAT "%8.3" EXTENDED_LIMITS -32768.00 32767.00 DEPOSIT ABSOLUTE /end AXIS_DESCR
 /begin AXIS_DESCR STD_AXIS InjCtl_qCurr InjMassCyc 16 0.00 327.6700 FORMAT "%8.4" EXTENDED_LIMITS -327.6800 327.6700 DEPOSIT ABSOLUTE /end AXIS_DESCR
/end CHARACTERISTIC
/begin CHARACTERISTIC Rail_pSetPointBattMin_CUR "batteriespannungsabhängige Kennlinie für den Raildruck-Sollwert" CURVE 0xEAB6E Kl_Xs16_Ws16 2000.000 Pres_Rail 0.00 2000.000 FORMAT "%5.3" EXTENDED_LIMITS -3276.800 3276.700
 /begin AXIS_DESCR STD_AXIS BattCD_u Volt_Batt 4 0.00 24007.82 FORMAT "%8.2" EXTENDED_LIMITS -640625.6 640606.1 DEPOSIT ABSOLUTE /end AXIS_DESCR
/end CHARACTERISTIC
/begin CHARACTERISTIC Rail_pSetPointETSCor1_MAP "ETS correction map of rail pressure setpoint as function of engine speed & current injection quantity" MAP 0xEB2B6 Kf_Xs16_Ys16_Ws16 2000.000 Pres_Rail 0.00 2000.000 FORMAT "%5.3" EXTENDED_LIMITS -3276.800 3276.700
 /begin AXIS_DESCR STD_AXIS Eng_nAvrg EngN 12 0.00 6000.000 FORMAT "%8.3" EXTENDED_LIMITS -32768.00 32767.00 DEPOSIT ABSOLUTE /end AXIS_DESCR
 /begin AXIS_DESCR STD_AXIS InjCtl_qCurr InjMassCyc 8 0.00 327.6700 FORMAT "%8.4" EXTENDED_LIMITS -327.6800 327.6700 DEPOSIT ABSOLUTE /end AXIS_DESCR
/end CHARACTERISTIC
/begin CHARACTERISTIC Rail_pSetPointETSCor_MAP "motortemperaturabhängige Sollwertkorrektur des Raildrucks" MAP 0xEB3A2 Kf_Xs16_Ys16_Ws16 2000.000 Pres_Rail 0.00 2000.000 FORMAT "%5.3" EXTENDED_LIMITS -3276.800 3276.700
 /begin AXIS_DESCR STD_AXIS Eng_nAvrg EngN 12 0.00 6000.000 FORMAT "%8.3" EXTENDED_LIMITS -32768.00 32767.00 DEPOSIT ABSOLUTE /end AXIS_DESCR
 /begin AXIS_DESCR STD_AXIS InjCtl_qCurr InjMassCyc 8 0.00 327.6700 FORMAT "%8.4" EXTENDED_LIMITS -327.6800 327.6700 DEPOSIT ABSOLUTE /end AXIS_DESCR
/end CHARACTERISTIC
/begin CHARACTERISTIC Rail_pSetPointETSCStrt_MAP "CTS correction map of rail pressure setpoint as function of Eng_nAvrg and InjCtl_qCurr start" MAP 0xEB48E Kf_Xs16_Ys16_Ws16 2000.000 Pres_Rail 0.00 2000.000 FORMAT "%5.3" EXTENDED_LIMITS -3276.800 3276.700
 /begin AXIS_DESCR STD_AXIS Eng_nAvrg EngN 12 0.00 6000.000 FORMAT "%8.3" EXTENDED_LIMITS -32768.00 32767.00 DEPOSIT ABSOLUTE /end AXIS_DESCR
 /begin AXIS_DESCR STD_AXIS InjCtl_qCurr InjMassCyc 8 0.00 327.6700 FORMAT "%8.4" EXTENDED_LIMITS -327.6800 327.6700 DEPOSIT ABSOLUTE /end AXIS_DESCR
/end CHARACTERISTIC
/begin CHARACTERISTIC Rail_pSetPointFTSCor_MAP "Basiswert der kraftstofftemperaturabhängigen Raildruck-Sollwertkorrektur" MAP 0xEAD42 Kf_Xs16_Ys16_Ws16 2000.000 Pres_Rail 0.00 2000.000 FORMAT "%5.3" EXTENDED_LIMITS -3276.800 3276.700
 /begin AXIS_DESCR STD_AXIS Eng_nAvrg EngN 8 0.00 6000.000 FORMAT "%8.3" EXTENDED_LIMITS -32768.00 32767.00 DEPOSIT ABSOLUTE /end AXIS_DESCR
 /begin AXIS_DESCR STD_AXIS InjCtl_qCurr InjMassCyc 8 0.00 327.6700 FORMAT "%8.4" EXTENDED_LIMITS -327.6800 327.6700 DEPOSIT ABSOLUTE /end AXIS_DESCR
/end CHARACTERISTIC
/begin CHARACTERISTIC Rail_pSetPointInit_C "Initialwert des Raildrucksollwert" VALUE 0xEAB80 Kw_Ws16 6553.500 Pres_Rail -3276.800 3276.700 FORMAT "%5.3" /end CHARACTERISTIC
/begin CHARACTERISTIC Rail_pSetPointLimNFlTemp_C "#SSD maximaler Raildrucksollwert, abhängig von der Motordrehzahl und der Kraftstofftemperatur" VALUE 0xEADE6 Kw_Ws16 2000.000 Pres_Rail 0.00 2000.000 FORMAT "%5.3" EXTENDED_LIMITS -3276.800 3276.700 /end CHARACTERISTIC
/begin CHARACTERISTIC Rail_pSetPointMaxDef_CUR "Kennlinie für den Vorgabewert des maximalen Raildruck Sollwert" CURVE 0xEADE8 Kl_Xs16_Ws16 2000.000 Pres_Rail 0.00 2000.000 FORMAT "%5.3" EXTENDED_LIMITS -3276.800 3276.700
 /begin AXIS_DESCR STD_AXIS Eng_nAvrg EngN 6 0.00 6000.000 FORMAT "%8.3" EXTENDED_LIMITS -32768.00 32767.00 DEPOSIT ABSOLUTE /end AXIS_DESCR
/end CHARACTERISTIC
/begin CHARACTERISTIC Rail_pSetPointMaxDef_MAP "Kennfeld für den Vorgabewert des maximalen Raildruck Sollwert" MAP 0xEAE02 Kf_Xs16_Ys16_Ws16 2000.000 Pres_Rail 0.00 2000.000 FORMAT "%5.3" EXTENDED_LIMITS -3276.800 3276.700
 /begin AXIS_DESCR STD_AXIS Eng_nAvrg EngN 6 0.00 6000.000 FORMAT "%8.3" EXTENDED_LIMITS -32768.00 32767.00 DEPOSIT ABSOLUTE /end AXIS_DESCR
 /begin AXIS_DESCR STD_AXIS FTSCD_tFuel Temp_Cels 5 -50.14000 199.8600 FORMAT "%8.4" EXTENDED_LIMITS -3549.940 3003.560 DEPOSIT ABSOLUTE /end AXIS_DESCR
/end CHARACTERISTIC
/begin CHARACTERISTIC Rail_pSetPointMax_MAP "#SSD maximaler Raildruck Sollwert, abhängig von der Motordrehzahl und der Einspritzmenge" MAP 0xEAE58 Kf_Xs16_Ys16_Ws16 2000.000 Pres_Rail 0.00 2000.000 FORMAT "%5.3" EXTENDED_LIMITS -3276.800 3276.700
 /begin AXIS_DESCR STD_AXIS Eng_nAvrg EngN 5 0.00 6000.000 FORMAT "%8.3" EXTENDED_LIMITS -32768.00 32767.00 DEPOSIT ABSOLUTE /end AXIS_DESCR
 /begin AXIS_DESCR STD_AXIS InjCrv_qTot InjMassCyc 6 0.00 327.6700 FORMAT "%8.4" EXTENDED_LIMITS -327.6800 327.6700 DEPOSIT ABSOLUTE /end AXIS_DESCR
/end CHARACTERISTIC
/begin CHARACTERISTIC Rail_pSetPointMinDef_C "#SSD minimaler Raildruck-Sollwert im Fehlerfall" VALUE 0xEAEAE Kw_Ws16 2000.000 Pres_Rail 0.00 2000.000 FORMAT "%5.3" EXTENDED_LIMITS -3276.800 3276.700 /end CHARACTERISTIC
/begin CHARACTERISTIC Rail_pSetPointMin_MAP "#SSD minimaler Raildruck-Sollwert, abhängig von der Motordrehzahl und der Einspritzmenge" MAP 0xEAEB0 Kf_Xs16_Ys16_Ws16 2000.000 Pres_Rail 0.00 2000.000 FORMAT "%5.3" EXTENDED_LIMITS -3276.800 3276.700
 /begin AXIS_DESCR STD_AXIS Eng_nAvrg EngN 5 0.00 6000.000 FORMAT "%8.3" EXTENDED_LIMITS -32768.00 32767.00 DEPOSIT ABSOLUTE /end AXIS_DESCR
 /begin AXIS_DESCR STD_AXIS InjCrv_qTot InjMassCyc 6 0.00 327.6700 FORMAT "%8.4" EXTENDED_LIMITS -327.6800 327.6700 DEPOSIT ABSOLUTE /end AXIS_DESCR
/end CHARACTERISTIC
/begin CHARACTERISTIC Rail_pSetPointRed_C "#SSD Offset zur Absenkung des Raildrucksollwert im Systemfehlerfall" VALUE 0xEAB82 Kw_Ws16 6553.500 Pres_Rail -3276.800 3276.700 FORMAT "%5.3" /end CHARACTERISTIC
/begin CHARACTERISTIC Rail_pSetPointRgn_MAP "Rail-pressure-setpoint-Map for regeneration mode" MAP 0xEA076 Kf_Xs16_Ys16_Ws16 2000.000 Pres_Rail 0.00 2000.000 FORMAT "%5.3" EXTENDED_LIMITS -3276.800 3276.700
 /begin AXIS_DESCR STD_AXIS Eng_nAvrg EngN 16 0.00 6000.000 FORMAT "%8.3" EXTENDED_LIMITS -32768.00 32767.00 DEPOSIT ABSOLUTE /end AXIS_DESCR
 /begin AXIS_DESCR STD_AXIS InjCtl_qCurr InjMassCyc 16 0.00 327.6700 FORMAT "%8.4" EXTENDED_LIMITS -327.6800 327.6700 DEPOSIT ABSOLUTE /end AXIS_DESCR
/end CHARACTERISTIC
/begin CHARACTERISTIC Rail_pSetPointRgn_Vector "#SSD Bypass-Label, nicht editieren !" VALUE 0xC2E18 Kw_Wu8 255.0 OneToOne 0.00 255.0 FORMAT "%5.1" /end CHARACTERISTIC
/begin CHARACTERISTIC Rail_pSetPointRgn_Channel "#SSD Bypass-Label, nicht editieren !" VALUE 0xC2E19 Kw_Wu8 255.0 OneToOne 0.00 255.0 FORMAT "%5.1" /end CHARACTERISTIC
/begin CHARACTERISTIC Rail_pSetPointZFCMax_C "Maximaler Raildrucksollwert bei aktiver Nullmengenkalibrierung" VALUE 0xEB66A Kw_Ws16 2000.000 Pres_Rail 0.00 2000.000 FORMAT "%5.3" EXTENDED_LIMITS -3276.800 3276.700 /end CHARACTERISTIC
/begin CHARACTERISTIC Rail_pSetPointZFCMin_C "Minimaler Raildrucksollwert bei aktiver Nullmengenkalibrierung" VALUE 0xEB66C Kw_Ws16 2000.000 Pres_Rail 0.00 2000.000 FORMAT "%5.3" EXTENDED_LIMITS -3276.800 3276.700 /end CHARACTERISTIC
/begin CHARACTERISTIC Rail_pSetPoint_Vector "#SSD Bypass-Label für Rail_pSetPoint (Nicht verstellen!)" VALUE 0xC2E1A Kw_Wu8 255.0 OneToOne 0.00 255.0 FORMAT "%5.1" /end CHARACTERISTIC
/begin CHARACTERISTIC Rail_pSetPoint_Channel "#SSD Bypass-Label für Rail_pSetPoint (Nicht verstellen!)" VALUE 0xC2E1B Kw_Wu8 255.0 OneToOne 0.00 255.0 FORMAT "%5.1" /end CHARACTERISTIC
/begin CHARACTERISTIC Rail_qRedOfsLim_C "Schwelle fuer Einspritzmenge zur Verringerung des Offsetwertes fuer PCV" VALUE 0xEA04E Kw_Ws16 655.3500 InjMassInj -327.6800 327.6700 FORMAT "%8.4" /end CHARACTERISTIC
/begin CHARACTERISTIC Rail_rPeakMinSlpZFC_C "Rampensteigung bei minimalem Raildruck nach Kalibrierung der ZFC" VALUE 0xEB66E Kw_Ws16 100.0000 Prc 0.00 100.0000 FORMAT "%8.4" EXTENDED_LIMITS -400.0000 399.9878 /end CHARACTERISTIC
/begin CHARACTERISTIC Rail_rZFCInitDwn_CUR "Faktor für anfänglichen Raildrucksollwert des PT1 FIlters abwärts" CURVE 0xEB670 Kl_Xs16_Ws16 100.0000 Prc 0.00 100.0000 FORMAT "%8.4" EXTENDED_LIMITS -400.0000 399.9878
 /begin AXIS_DESCR STD_AXIS ZFC_pRailSetPoint_mp Pres_Rail 3 0.00 2000.000 FORMAT "%5.3" EXTENDED_LIMITS -3276.800 3276.700 DEPOSIT ABSOLUTE /end AXIS_DESCR
/end CHARACTERISTIC
/begin CHARACTERISTIC Rail_rZFCInitUp_CUR "Faktor für anfänglichen Raildrucksollwert des PT1 Filters (aufwärts)" CURVE 0xEB67E Kl_Xs16_Ws16 100.0000 Prc 0.00 100.0000 FORMAT "%8.4" EXTENDED_LIMITS -400.0000 399.9878
 /begin AXIS_DESCR STD_AXIS ZFC_pRailSetPoint_mp Pres_Rail 3 0.00 2000.000 FORMAT "%5.3" EXTENDED_LIMITS -3276.800 3276.700 DEPOSIT ABSOLUTE /end AXIS_DESCR
/end CHARACTERISTIC
/begin CHARACTERISTIC Rail_stPreCtlMeUnSel_C "#SSD Schalter-Auswahl für die Vorsteuerung der Zumesseinheit" VALUE 0xE9F36 Kw_Wu8 255.0 OneToOne 0.00 255.0 FORMAT "%5.1" /end CHARACTERISTIC
/begin CHARACTERISTIC Rail_stRgnDelMsk_C "Maske für die Deaktivierung der Raildrucksollwerteberechnung im Regenerationsbetrieb" VALUE 0xEAB84 Kw_Wu32 4294967295.00 OneToOne 0.00 4294967295.00 FORMAT "%13.2" /end CHARACTERISTIC
/begin CHARACTERISTIC Rail_stRgnMsk_C "Bitmaske für Aktivierung  des Raildrucksollwert Regenerationsmodes" VALUE 0xEA2C4 Kw_Wu32 4294967295.00 OneToOne 0.00 4294967295.00 FORMAT "%13.2" /end CHARACTERISTIC
/begin CHARACTERISTIC Rail_stSetPointSel_C "#SSD Schalterauswahl für die Raildruck-Sollwertberechnung" VALUE 0xEAB88 Kw_Wu8 255.0 OneToOne 0.00 255.0 FORMAT "%5.1" /end CHARACTERISTIC
/begin CHARACTERISTIC Rail_tiPCVRmpDur_CUR "Laufzeit der Rampe um vom aktuellen Sollwert auf den neuen PCVClose-Wert zu rampen" CURVE 0xEA050 Kl_Xs16_Ws16 655350.0 Time_ms -327680.0 327670.0 FORMAT "%8.1"
 /begin AXIS_DESCR STD_AXIS Eng_nAvrg EngN 8 0.00 6000.000 FORMAT "%8.3" EXTENDED_LIMITS -32768.00 32767.00 DEPOSIT ABSOLUTE /end AXIS_DESCR
/end CHARACTERISTIC
/begin CHARACTERISTIC Rail_tiPCVRmpToOfs_C "Laufzeit der Rampe um vom reduzierten Offsetwert auf den Offsetwert zu rampen" VALUE 0xEA072 Kw_Ws16 300.0000 Time_ms 0.00 300.0000 FORMAT "%8.4" EXTENDED_LIMITS -327680.0 327670.0 /end CHARACTERISTIC
/begin CHARACTERISTIC Rail_tiPCVRmpToRedOfs_C "Laufzeit der Rampe um vom Offsetwert auf den reduzierten Offsetwert zu rampen" VALUE 0xEA074 Kw_Ws16 300.0000 Time_ms 0.00 300.0000 FORMAT "%8.4" EXTENDED_LIMITS -327680.0 327670.0 /end CHARACTERISTIC
/begin CHARACTERISTIC Rail_tiSetPointRedMin_C "#SSD Raildrucküberwachung - Mindestzeit im Fehlerfall" VALUE 0xEAB8A Kw_Wu16 10000.00 Time_ms 0.00 10000.00 FORMAT "%8.2" EXTENDED_LIMITS 0.00 655350.0 /end CHARACTERISTIC
/begin CHARACTERISTIC Rail_tiZFCDemDel_C "Verzögerungszeit für Umschaltung auf geschlossenes Druckregelventil bei aktiver Lernphase der ZFC" VALUE 0xEB68C Kw_Wu16 655350.0 Time_ms 0.00 655350.0 FORMAT "%8.1" /end CHARACTERISTIC
/begin CHARACTERISTIC Rail_tiZFCPT1_C "Parameter für ZFC Raildrucksollwert PT1 filter" VALUE 0xEB690 Kw_Wu32 1073.7408 TimeDelay_s 0.0010000001 1073.7418 FORMAT "%9.4" EXTENDED_LIMITS 0.0000010000000 4294.9673 /end CHARACTERISTIC
/begin CHARACTERISTIC Rail_volInjVlvCtl_C "#SSD Steuervolumen der Injektoren" VALUE 0xE9F38 Kw_Ws16 10.00000 InjQntInj 0.00 10.00000 FORMAT "%8.5" EXTENDED_LIMITS -327.6800 327.6700 /end CHARACTERISTIC
/begin CHARACTERISTIC RTMMon_dMaxCheckDef_C "#SSD Applikationsparameter für RTMMon_MaxCheck endgültig defekt" VALUE 0xEB718 Kw_Wu16 65535.00 OneToOne 0.00 65535.00 FORMAT "%8.2" /end CHARACTERISTIC
/begin CHARACTERISTIC RTMMon_dMaxCheckOk_C "#SSD Applikationsparameter für RTMMon_MaxCheck endgültig geheilt" VALUE 0xEB71A Kw_Wu16 0.00 OneToOne 0.00 0.00 FORMAT "%8.2" EXTENDED_LIMITS 0.00 65535.00 /end CHARACTERISTIC
/begin CHARACTERISTIC RTMMon_dPlausCheckDef_C "#SSD Applikationsparameter für RTMMon_PlausCheck endgültig defekt" VALUE 0xEB71C Kw_Wu16 65535.00 OneToOne 0.00 65535.00 FORMAT "%8.2" /end CHARACTERISTIC
/begin CHARACTERISTIC RTMMon_dPlausCheckOk_C "#SSD Applikationsparameter für RTMMon_PlausCheck endgültig geheilt" VALUE 0xEB71E Kw_Wu16 0.00 OneToOne 0.00 0.00 FORMAT "%8.2" EXTENDED_LIMITS 0.00 65535.00 /end CHARACTERISTIC
/begin CHARACTERISTIC RTMMon_tiNoPlausCheck_C "#SSD Während dieser Zeit isr RTMMon_PlausCheck deaktiviert." VALUE 0xEB720 Kw_Wu16 655350.0 Time_ms 0.00 655350.0 FORMAT "%8.1" /end CHARACTERISTIC
/begin CHARACTERISTIC Rtmo_adCallingBegin_cu32 "Beginn des Adressbereiches der aufrufenden Funktion zum Messen der aufgerufenen Funktion" VALUE 0xEB724 Kw_Wu32 4294967295.00 OneToOne 0.00 4294967295.00 FORMAT "%13.2" /end CHARACTERISTIC
/begin CHARACTERISTIC Rtmo_adCallingEnd_cu32 "Ende des Adressbereiches der aufrufenden Funktion zum Messen der aufgerufenen Funktion" VALUE 0xEB728 Kw_Wu32 4294967295.00 OneToOne 0.00 4294967295.00 FORMAT "%13.2" /end CHARACTERISTIC
/begin CHARACTERISTIC Rtmo_adStart_cu32 "#SSD Startadresse der zu messenden Funktion" VALUE 0xEB72C Kw_Wu32 4294967295.00 OneToOne 0.00 4294967295.00 FORMAT "%13.2" /end CHARACTERISTIC
/begin CHARACTERISTIC Rtmo_stIntOverhead_cu8 "gemessener/vermuteter Interrupt Overhead, als Korrekturfaktor für Laufzeitmessung" VALUE 0xEB730 Kw_Wu8 255.0 OneToOne 0.00 255.0 FORMAT "%5.1" /end CHARACTERISTIC
/begin CHARACTERISTIC Rtmo_stSampleTime_cu8 "#SSD Messzykluszeit: 0: keine Messung; 1-253: 100 ms Raster für jeden 1-253 Durchgang; 254: 10/20ms; 255: segment sync." VALUE 0xEB731 Kw_Wu8 255.0 OneToOne 0.00 255.0 FORMAT "%5.1" /end CHARACTERISTIC
/begin CHARACTERISTIC Rtmo_swLoadMode_cu8 "bit 1:Messung ein/aus bit 2: Maximum zurücksetzen" VALUE 0xEB732 Kw_Wu8 255.0 OneToOne 0.00 255.0 FORMAT "%5.1" /end CHARACTERISTIC
/begin CHARACTERISTIC Rtmo_swMode_cu8 "rtmo Konfig: bit0: reset of Min/Max, bit1: function/task, bit2: depend. of Funct/Tasks, bit3: Netto/Brutto" VALUE 0xEB733 Kw_Wu8 13.00 OneToOne 0.00 13.00 FORMAT "%5.2" EXTENDED_LIMITS 0.00 255.0 /end CHARACTERISTIC
/begin CHARACTERISTIC ShutCD_numDia_C "#SSD Parameter für Hardware Diagnose-Pin Auswahl Kühlerjalousie" VALUE 0xEB734 Kw_Wu8 34.0000000000 NumPinDia 0.00 34.0000000000 FORMAT "%13.10" /end CHARACTERISTIC
/begin CHARACTERISTIC ShutCD_numDioOut_C "#SSD Parameter für Hardware Digitalausgang-Pin Auswahl" VALUE 0xEB735 Kw_Wu8 10.0000000000 NumPinDioOut 0.00 10.0000000000 FORMAT "%13.10" /end CHARACTERISTIC
/begin CHARACTERISTIC ShutCD_stInvOut_C "Invertierungsparameter für das Signal der Kühlerjalousie" VALUE 0xEB736 Kw_Wu8 1.000 OneToOne 0.00 1.000 FORMAT "%5.3" EXTENDED_LIMITS 0.00 255.0 /end CHARACTERISTIC
/begin CHARACTERISTIC ShutCD_stPwrStgActv_C "Aktivierung der Abschaltbedingungen der Endstufe" VALUE 0xEB737 Kw_Wu8 10.00 OneToOne 0.00 10.00 FORMAT "%5.2" EXTENDED_LIMITS 0.00 255.0 /end CHARACTERISTIC
/begin CHARACTERISTIC ShutCD_stPwrStgDia_C "Aktivierung der Abschaltbedingungen der Endstufendiagnose" VALUE 0xEB738 Kw_Wu8 255.0 OneToOne 0.00 255.0 FORMAT "%5.1" /end CHARACTERISTIC
/begin CHARACTERISTIC ShutCD_tiDebExcTempDef_C "Fehlerentprellzeit Übertemperatur" VALUE 0xEB73A Kw_Wu16 655350.0 Time_ms 0.00 655350.0 FORMAT "%8.1" /end CHARACTERISTIC
/begin CHARACTERISTIC ShutCD_tiDebExcTempOk_C "Heilungsentprellzeit Übertemperatur" VALUE 0xEB73C Kw_Wu16 655350.0 Time_ms 0.00 655350.0 FORMAT "%8.1" /end CHARACTERISTIC
/begin CHARACTERISTIC ShutCD_tiDebNoLoadDef_C "Fehlerentprellzeit keine Last" VALUE 0xEB73E Kw_Wu16 655350.0 Time_ms 0.00 655350.0 FORMAT "%8.1" /end CHARACTERISTIC
/begin CHARACTERISTIC ShutCD_tiDebNoLoadOk_C "Heilungsentprellzeit keine Last" VALUE 0xEB740 Kw_Wu16 655350.0 Time_ms 0.00 655350.0 FORMAT "%8.1" /end CHARACTERISTIC
/begin CHARACTERISTIC ShutCD_tiDebShortCircBatDef_C "Fehlerentprellzzeit Kurzschluß nach UBatt" VALUE 0xEB742 Kw_Wu16 655350.0 Time_ms 0.00 655350.0 FORMAT "%8.1" /end CHARACTERISTIC
/begin CHARACTERISTIC ShutCD_tiDebShortCircBatOk_C "Fehlerentprellzeit Kurzschluß nach Masse" VALUE 0xEB744 Kw_Wu16 655350.0 Time_ms 0.00 655350.0 FORMAT "%8.1" /end CHARACTERISTIC
/begin CHARACTERISTIC ShutCD_tiDebShortCircGndDef_C "Fehlerentprellzeit Kurzschluß nach Masse" VALUE 0xEB746 Kw_Wu16 655350.0 Time_ms 0.00 655350.0 FORMAT "%8.1" /end CHARACTERISTIC
/begin CHARACTERISTIC ShutCD_tiDebShortCircGndOk_C "Heilungsentprellzeit Kurzschluß nach Masse" VALUE 0xEB748 Kw_Wu16 655350.0 Time_ms 0.00 655350.0 FORMAT "%8.1" /end CHARACTERISTIC
/begin CHARACTERISTIC Shuttr_nFanXHi_C "oberer Hysterese-Grenzwert für FrmMng_numFan" VALUE 0xEB74A Kw_Ws16 3000.000 FanSpd 0.00 3000.000 FORMAT "%8.3" EXTENDED_LIMITS -3000.092 3000.000 /end CHARACTERISTIC
/begin CHARACTERISTIC Shuttr_nFanXLo_C "unterer Hysterese-Grenzwert für FrmMng_numFan" VALUE 0xEB74C Kw_Ws16 3000.000 FanSpd 0.00 3000.000 FORMAT "%8.3" EXTENDED_LIMITS -3000.092 3000.000 /end CHARACTERISTIC
/begin CHARACTERISTIC Shuttr_tEngXHi_C "oberer Hysterese-Grenzwert für Eng_tEng" VALUE 0xEB74E Kw_Ws16 250.0000 Temp_Cels -50.14000 199.8600 FORMAT "%8.4" EXTENDED_LIMITS -3549.940 3003.560 /end CHARACTERISTIC
/begin CHARACTERISTIC Shuttr_tEngXLo_C "unterer Hysterese-Grenzwert für Eng_tEng" VALUE 0xEB750 Kw_Ws16 250.0000 Temp_Cels -50.14000 199.8600 FORMAT "%8.4" EXTENDED_LIMITS -3549.940 3003.560 /end CHARACTERISTIC
/begin CHARACTERISTIC Shuttr_tGbxOilXHi_C "oberer Hysterese-Grenzwert für Gearbx_tOil" VALUE 0xEB752 Kw_Ws16 250.0000 Temp_Cels -50.14000 199.8600 FORMAT "%8.4" EXTENDED_LIMITS -3549.940 3003.560 /end CHARACTERISTIC
/begin CHARACTERISTIC Shuttr_tGbxOilXLo_C "unterer Hysterese-Grenzwert für Gearbx_tOil" VALUE 0xEB754 Kw_Ws16 250.0000 Temp_Cels -50.14000 199.8600 FORMAT "%8.4" EXTENDED_LIMITS -3549.940 3003.560 /end CHARACTERISTIC
/begin CHARACTERISTIC Shuttr_tiDebOff_C "Ausschalt-Entprellzeit" VALUE 0xEB756 Kw_Wu16 655350.0 TimeDeb 0.00 655350.0 FORMAT "%8.1" /end CHARACTERISTIC
/begin CHARACTERISTIC Shuttr_tiDebOn_C "Einschalt-Entprellzeit" VALUE 0xEB758 Kw_Wu16 655350.0 TimeDeb 0.00 655350.0 FORMAT "%8.1" /end CHARACTERISTIC
/begin CHARACTERISTIC Shuttr_vXHi_C "oberer Hysterese-Grenzwert für VSSCD_v" VALUE 0xEB75A Kw_Ws16 200.0000 Vel 0.00 200.0000 FORMAT "%8.4" EXTENDED_LIMITS -327.6800 327.6700 /end CHARACTERISTIC
/begin CHARACTERISTIC Shuttr_vXLo_C "unterer Hysterese-Grenzwert für VSSCD_v" VALUE 0xEB75C Kw_Ws16 200.0000 Vel 0.00 200.0000 FORMAT "%8.4" EXTENDED_LIMITS -327.6800 327.6700 /end CHARACTERISTIC
/begin CHARACTERISTIC Sig_LimLowDigital_C "Unterer Grenzwert für Stellertests mit digitaler Stellgröße" VALUE 0xC08B2 Kw_Ws16 65535.00 OneToOne -32768.00 32767.00 FORMAT "%8.2" /end CHARACTERISTIC
/begin CHARACTERISTIC Sig_LimUpDigital_C "Oberer Grenzwert für Stellertests mit digitaler Stellgröße" VALUE 0xC08B4 Kw_Ws16 65535.00 OneToOne -32768.00 32767.00 FORMAT "%8.2" /end CHARACTERISTIC
/begin CHARACTERISTIC Sig_LimLowFlCon_C "Unterer Grenzwert für Stellertests mit Kraftstoffverbrauch Stellgröße" VALUE 0xC08B6 Kw_Ws16 655.3500 FlConsum_l_h -327.6800 327.6700 FORMAT "%8.4" /end CHARACTERISTIC
/begin CHARACTERISTIC Sig_LimUpFlCon_C "Oberer Grenzwert für Stellertests mit Kraftstoffverbrauch Stellgröße" VALUE 0xC08B8 Kw_Ws16 655.3500 FlConsum_l_h -327.6800 327.6700 FORMAT "%8.4" /end CHARACTERISTIC
/begin CHARACTERISTIC Sig_LimLown_C "Unterer Grenzwert für Stellertests mit Drehzahl Stellgröße" VALUE 0xC08BA Kw_Ws16 65535.00 EngN -32768.00 32767.00 FORMAT "%8.2" /end CHARACTERISTIC
/begin CHARACTERISTIC Sig_LimUpn_C "Oberer Grenzwert für Stellertests mit Drehzahl Stellgröße" VALUE 0xC08BC Kw_Ws16 65535.00 EngN -32768.00 32767.00 FORMAT "%8.2" /end CHARACTERISTIC
/begin CHARACTERISTIC Sig_LimLowPwm_C "Unterer Grenzwert für Stellertests mit PWM Stellgröße" VALUE 0xC08BE Kw_Ws16 655.3500 DtyCyc -327.6800 327.6700 FORMAT "%8.4" /end CHARACTERISTIC
/begin CHARACTERISTIC Sig_LimUpPwm_C "Oberer Grenzwert für Stellertests mit PWM Stellgröße" VALUE 0xC08C0 Kw_Ws16 655.3500 DtyCyc -327.6800 327.6700 FORMAT "%8.4" /end CHARACTERISTIC
/begin CHARACTERISTIC Sig_LimLowtrq_C "lower limit of  AC tester torque test input" VALUE 0xC08C2 Kw_Ws16 6553.500 Trq -3276.800 3276.700 FORMAT "%8.3" /end CHARACTERISTIC
/begin CHARACTERISTIC Sig_LimUptrq_C "upper limit of  AC tester torque test input" VALUE 0xC08C4 Kw_Ws16 6553.500 Trq -3276.800 3276.700 FORMAT "%8.3" /end CHARACTERISTIC
/begin CHARACTERISTIC Signals_PID0x1C_C "Info für Generic Scan Tool (OBD-Tester) für welche Vorschrift das Fahrzeug appliziert wurde" VALUE 0xC08B0 Kw_Wu8 8.00000000000 SigSupLeg 1.00000000000 9.00000000000 FORMAT "%13.11" /end CHARACTERISTIC
/begin CHARACTERISTIC signals_tiTstDemHeal_C "Minimale Zeit ohne Stellertestanforderung nach Verriegelung wegen Zeitüberschreitung." VALUE 0xEB75E Kw_Wu16 655350.0 Time_ms 0.00 655350.0 FORMAT "%8.1" /end CHARACTERISTIC
/begin CHARACTERISTIC signals_tiTstDemMax_C "Maximale zulässige Testzeit für Stellertest über Diagnosetester" VALUE 0xEB760 Kw_Wu16 655350.0 Time_ms 0.00 655350.0 FORMAT "%8.1" /end CHARACTERISTIC
/begin CHARACTERISTIC signals_TmrBehaviour_C "Verhalten der Zeitbegrenzung für Stellertest" VALUE 0xEB762 Kw_Wu8 255.0 OneToOne 0.00 255.0 FORMAT "%5.1" /end CHARACTERISTIC
/begin CHARACTERISTIC signals_TstDemMaxEngN_C "Maximale Drehzahl für Stellertest über Diagnosetester" VALUE 0xEB764 Kw_Ws16 65535.00 EngN -32768.00 32767.00 FORMAT "%8.2" /end CHARACTERISTIC
/begin CHARACTERISTIC signals_TstDemMaxVSSCDV_C "Maximale Geschwindigkeit für Stellertest über Diagnosetester" VALUE 0xEB766 Kw_Ws16 655.3500 Vel -327.6800 327.6700 FORMAT "%8.4" /end CHARACTERISTIC
/begin CHARACTERISTIC SigTst_ACEn_C "Stellertestüberwachung Freigabemaske für Klimaanlage Ausgang" VALUE 0xEB768 Kw_Wu8 7.000 OneToOne 0.00 7.000 FORMAT "%5.3" EXTENDED_LIMITS 0.00 255.0 /end CHARACTERISTIC
/begin CHARACTERISTIC SigTst_AOHtEn_C "Stellertestüberwachung Freigabemaske für Zusatzheizersteller" VALUE 0xEB769 Kw_Wu8 7.000 OneToOne 0.00 7.000 FORMAT "%5.3" EXTENDED_LIMITS 0.00 255.0 /end CHARACTERISTIC
/begin CHARACTERISTIC SigTst_BPAEn_C "Stellertestüberwachung Freigabemaske für Ladedrucksteller" VALUE 0xEB76A Kw_Wu8 7.000 OneToOne 0.00 7.000 FORMAT "%5.3" EXTENDED_LIMITS 0.00 255.0 /end CHARACTERISTIC
/begin CHARACTERISTIC SigTst_CpBVlvEn_C "Switch to enable tester" VALUE 0xEB76B Kw_Wu8 7.000 OneToOne 0.00 7.000 FORMAT "%5.3" EXTENDED_LIMITS 0.00 255.0 /end CHARACTERISTIC
/begin CHARACTERISTIC SigTst_EBAFEn_C "Stellertestüberwachung Freigabemaske für EBAfCD" VALUE 0xEB76C Kw_Wu8 7.000 OneToOne 0.00 7.000 FORMAT "%5.3" EXTENDED_LIMITS 0.00 255.0 /end CHARACTERISTIC
/begin CHARACTERISTIC SigTst_EBFEn_C "Freigabemaske für Stellertestüberwachung für E-Box Lüfter" VALUE 0xEB76D Kw_Wu8 7.000 OneToOne 0.00 7.000 FORMAT "%5.3" EXTENDED_LIMITS 0.00 255.0 /end CHARACTERISTIC
/begin CHARACTERISTIC SigTst_EGPpEn_C "Tester demand monitoring enable mask for EGPp" VALUE 0xEB76E Kw_Wu8 7.000 OneToOne 0.00 7.000 FORMAT "%5.3" EXTENDED_LIMITS 0.00 255.0 /end CHARACTERISTIC
/begin CHARACTERISTIC SigTst_EGREn_C "Stellertestüberwachung Freigabemaske für Abgasrückführpositionssteller" VALUE 0xEB76F Kw_Wu8 7.000 OneToOne 0.00 7.000 FORMAT "%5.3" EXTENDED_LIMITS 0.00 255.0 /end CHARACTERISTIC
/begin CHARACTERISTIC SigTst_ETClbCorOffEn_C "Tester Anforderung Überwachung Enable Maske für die Ansteuerdauerkorrektur der Nullmengenkalibrierung" VALUE 0xEB770 Kw_Wu8 7.000 OneToOne 0.00 7.000 FORMAT "%5.3" EXTENDED_LIMITS 0.00 255.0 /end CHARACTERISTIC
/begin CHARACTERISTIC SigTst_FANEn_C "Stellertest für Kühlerlüfter" VALUE 0xEB771 Kw_Wu8 7.000 OneToOne 0.00 7.000 FORMAT "%5.3" EXTENDED_LIMITS 0.00 255.0 /end CHARACTERISTIC
/begin CHARACTERISTIC SigTst_GLWRLYEn_C "Stellertestüberwachung Freigabemaske für Glüh Relay" VALUE 0xEB772 Kw_Wu8 7.000 OneToOne 0.00 7.000 FORMAT "%5.3" EXTENDED_LIMITS 0.00 255.0 /end CHARACTERISTIC
/begin CHARACTERISTIC SigTst_LPAEn_C "Switch to enable tester" VALUE 0xEB773 Kw_Wu8 7.000 OneToOne 0.00 7.000 FORMAT "%5.3" EXTENDED_LIMITS 0.00 255.0 /end CHARACTERISTIC
/begin CHARACTERISTIC SigTst_LSUCDHt0En_C "Auswahlmake für Überwachungsbedingungen des Lambda Sensor Stellertests" VALUE 0xEB774 Kw_Wu8 7.000 OneToOne 0.00 7.000 FORMAT "%5.3" EXTENDED_LIMITS 0.00 255.0 /end CHARACTERISTIC
/begin CHARACTERISTIC SigTst_MILLAMPEn_C "Stellertestüberwachung Freigabemaske für MIL (OBD-Lampe)" VALUE 0xEB775 Kw_Wu8 7.000 OneToOne 0.00 7.000 FORMAT "%5.3" EXTENDED_LIMITS 0.00 255.0 /end CHARACTERISTIC
/begin CHARACTERISTIC SigTst_MNTCTLEn_C "Tester demand monitoring enable mask for MNTCTL" VALUE 0xEB776 Kw_Wu8 7.000 OneToOne 0.00 7.000 FORMAT "%5.3" EXTENDED_LIMITS 0.00 255.0 /end CHARACTERISTIC
/begin CHARACTERISTIC SigTst_MeUnEn_C "Stellertestüberwachung Freigabemaske für Zumesseinheit" VALUE 0xEB777 Kw_Wu8 7.000 OneToOne 0.00 7.000 FORMAT "%5.3" EXTENDED_LIMITS 0.00 255.0 /end CHARACTERISTIC
/begin CHARACTERISTIC SigTst_PCVEn_C "Stellertestüberwachung Freigabemaske für Druckregelventil" VALUE 0xEB778 Kw_Wu8 7.000 OneToOne 0.00 7.000 FORMAT "%5.3" EXTENDED_LIMITS 0.00 255.0 /end CHARACTERISTIC
/begin CHARACTERISTIC SigTst_PSPEn_C "Stellertestüberwachung Freigabemaske für Vorförderpumpen  Ausgang" VALUE 0xEB779 Kw_Wu8 7.000 OneToOne 0.00 7.000 FORMAT "%5.3" EXTENDED_LIMITS 0.00 255.0 /end CHARACTERISTIC
/begin CHARACTERISTIC SigTst_SYSLAMPEn_C "Stellertestüberwachung Freigabemaske für Systemlampe" VALUE 0xEB77A Kw_Wu8 7.000 OneToOne 0.00 7.000 FORMAT "%5.3" EXTENDED_LIMITS 0.00 255.0 /end CHARACTERISTIC
/begin CHARACTERISTIC SigTst_ShuttrEn_C "Stellertestüberwachung Freigabemaske für Kühlerjalousie" VALUE 0xEB77B Kw_Wu8 7.000 OneToOne 0.00 7.000 FORMAT "%5.3" EXTENDED_LIMITS 0.00 255.0 /end CHARACTERISTIC
/begin CHARACTERISTIC SigTst_TVAEn_C "Stellertestüberwachung Freigabemaske für Drosselklappensteller" VALUE 0xEB77C Kw_Wu8 7.000 OneToOne 0.00 7.000 FORMAT "%5.3" EXTENDED_LIMITS 0.00 255.0 /end CHARACTERISTIC
/begin CHARACTERISTIC SigTst_VSAEn_C "Stellertestüberwachung Freigabemaske für Drallniveausteller" VALUE 0xEB77D Kw_Wu8 7.000 OneToOne 0.00 7.000 FORMAT "%5.3" EXTENDED_LIMITS 0.00 255.0 /end CHARACTERISTIC
/begin CHARACTERISTIC Sig_aiDSMOffset_C "Offset für Umrechnung ecu -> dsm" VALUE 0xC0550 Kw_Ws16 65535.00 OneToOne -32768.00 32767.00 FORMAT "%8.2" /end CHARACTERISTIC
/begin CHARACTERISTIC Sig_aiDSMScale_C "Skalierung für Umrechnung ecu -> dsm" VALUE 0xC0552 Kw_Wu16 7.999878 Fact 0.00 7.999878 FORMAT "%8.6" /end CHARACTERISTIC
/begin CHARACTERISTIC Sig_aiCANOffset_C "Offset für Umrechnung ecu -> can" VALUE 0xC0554 Kw_Ws16 65535.00 OneToOne -32768.00 32767.00 FORMAT "%8.2" /end CHARACTERISTIC
/begin CHARACTERISTIC Sig_aiCANScale_C "Skalierung für Umrechnung ecu -> can" VALUE 0xC0556 Kw_Wu16 7.999878 Fact 0.00 7.999878 FORMAT "%8.6" /end CHARACTERISTIC
/begin CHARACTERISTIC Sig_aiDIAOffset_C "Offset für Umrechnung  ecu -> dia" VALUE 0xC0558 Kw_Ws16 65535.00 OneToOne -32768.00 32767.00 FORMAT "%8.2" /end CHARACTERISTIC
/begin CHARACTERISTIC Sig_aiDIAScale_C "Skalierung für Umrechnung ecu -> dia" VALUE 0xC055A Kw_Wu16 7.999878 Fact 0.00 7.999878 FORMAT "%8.6" /end CHARACTERISTIC
/begin CHARACTERISTIC Sig_AngCrSDSMOffset_C "Umrechnung des Kurbelwellenwinkels: dsm offset" VALUE 0xC055C Kw_Ws16 65535.00 OneToOne -32768.00 32767.00 FORMAT "%8.2" /end CHARACTERISTIC
/begin CHARACTERISTIC Sig_AngCrSDSMScale_C "Umrechnung des Kurbelwellenwinkels: dsm scale factor" VALUE 0xC055E Kw_Wu16 7.999878 Fact 0.00 7.999878 FORMAT "%8.6" /end CHARACTERISTIC
/begin CHARACTERISTIC Sig_AngCrSCANOffset_C "Umrechnung des Kurbelwellenwinkels: can Offset" VALUE 0xC0560 Kw_Ws16 65535.00 OneToOne -32768.00 32767.00 FORMAT "%8.2" /end CHARACTERISTIC
/begin CHARACTERISTIC Sig_AngCrSCANScale_C "Umrechnung Kurbelwellenwinkels: can scale factor" VALUE 0xC0562 Kw_Wu16 7.999878 Fact 0.00 7.999878 FORMAT "%8.6" /end CHARACTERISTIC
/begin CHARACTERISTIC Sig_AngCrSDIAOffset_C "Umrechnung des Kurbelwellenwinkels: dia offset" VALUE 0xC0564 Kw_Ws16 65535.00 OneToOne -32768.00 32767.00 FORMAT "%8.2" /end CHARACTERISTIC
/begin CHARACTERISTIC Sig_AngCrSDIAScale_C "Umrechnung des Kurbelwellenwinkels: dia scale factor" VALUE 0xC0566 Kw_Wu16 7.999878 Fact 0.00 7.999878 FORMAT "%8.6" /end CHARACTERISTIC
/begin CHARACTERISTIC Sig_aDSMOffset_C "Offset fuer Umrechung SG->DSM fuer Beschleunigung" VALUE 0xC0568 Kw_Ws16 65535.00 OneToOne -32768.00 32767.00 FORMAT "%8.2" /end CHARACTERISTIC
/begin CHARACTERISTIC Sig_aDSMScale_C "Skalierung Umrechungs Faktor SG->DSM fuer Beschleunigung" VALUE 0xC056A Kw_Wu16 7.999878 Fact 0.00 7.999878 FORMAT "%8.6" /end CHARACTERISTIC
/begin CHARACTERISTIC Sig_aCANOffset_C "Offset fuer Umrechung SG->CAN fuer Beschleunigung" VALUE 0xC056C Kw_Ws16 65535.00 OneToOne -32768.00 32767.00 FORMAT "%8.2" /end CHARACTERISTIC
/begin CHARACTERISTIC Sig_aCANScale_C "Skalierung Umrechungs Faktor SG->CAN fuer Beschleunigung" VALUE 0xC056E Kw_Wu16 7.999878 Fact 0.00 7.999878 FORMAT "%8.6" /end CHARACTERISTIC
/begin CHARACTERISTIC Sig_aDIAOffset_C "Offset fuer Umrechung SG->DIA fuer Beschleunigung" VALUE 0xC0570 Kw_Ws16 65535.00 OneToOne -32768.00 32767.00 FORMAT "%8.2" /end CHARACTERISTIC
/begin CHARACTERISTIC Sig_aDIAScale_C "Skalierung Umrechungs Faktor SG->DIA fuer Beschleunigung" VALUE 0xC0572 Kw_Wu16 7.999878 Fact 0.00 7.999878 FORMAT "%8.6" /end CHARACTERISTIC
/begin CHARACTERISTIC Sig_Carb_dtDSMOffset_C "Signals Offset für Umrechung  Temperaturdifferenz Intern nach DSM mit CARB Normierung" VALUE 0xC0574 Kw_Ws16 65535.00 OneToOne -32768.00 32767.00 FORMAT "%8.2" /end CHARACTERISTIC
/begin CHARACTERISTIC Sig_Carb_dtDSMScale_C "Signals Skalierungsfaktor für Umrechung  Temperaturdifferenz Intern nach DSM mit CARB Normierung" VALUE 0xC0576 Kw_Wu16 7.999878 Fact 0.00 7.999878 FORMAT "%8.6" /end CHARACTERISTIC
/begin CHARACTERISTIC Sig_Carb_dtCANOffset_C "Signals Offset für Umrechung  Temperaturdifferenz Intern nach CAN mit CARB Normierung" VALUE 0xC0578 Kw_Ws16 65535.00 OneToOne -32768.00 32767.00 FORMAT "%8.2" /end CHARACTERISTIC
/begin CHARACTERISTIC Sig_Carb_dtCANScale_C "Signals Skalierungsfaktor für Umrechung  Temperaturdifferenz Intern nach CAN mit CARB Normierung" VALUE 0xC057A Kw_Wu16 7.999878 Fact 0.00 7.999878 FORMAT "%8.6" /end CHARACTERISTIC
/begin CHARACTERISTIC Sig_Carb_dtDIAOffset_C "Signals Offset für Umrechung  Temperaturdifferenz Intern nach Diagnose mit CARB Normierung" VALUE 0xC057C Kw_Ws16 65535.00 OneToOne -32768.00 32767.00 FORMAT "%8.2" /end CHARACTERISTIC
/begin CHARACTERISTIC Sig_Carb_dtDIAScale_C "Signals Skalierungsfaktor für Umrechung  Temperaturdifferenz Intern nach Diagnose mit CARB Normierung" VALUE 0xC057E Kw_Wu16 7.999878 Fact 0.00 7.999878 FORMAT "%8.6" /end CHARACTERISTIC
/begin CHARACTERISTIC Sig_Carb_lDSMOffset_C "Signals Offset für Umrechung  Fahrstrecke Intern nach DSM mit CARB Normierung" VALUE 0xC0580 Kw_Ws16 65535.00 OneToOne -32768.00 32767.00 FORMAT "%8.2" /end CHARACTERISTIC
/begin CHARACTERISTIC Sig_Carb_lDSMScale_C "Signals Skalierungsfaktor für Umrechung  Fahrstrecke Intern nach DSM mit CARB Normierung" VALUE 0xC0582 Kw_Wu16 7.999878 Fact 0.00 7.999878 FORMAT "%8.6" /end CHARACTERISTIC
/begin CHARACTERISTIC Sig_Carb_lCANOffset_C "Signals Offset für Umrechung  Fahrstrecke Intern nach CAN mit CARB Normierung" VALUE 0xC0584 Kw_Ws16 65535.00 OneToOne -32768.00 32767.00 FORMAT "%8.2" /end CHARACTERISTIC
/begin CHARACTERISTIC Sig_Carb_lCANScale_C "Signals Skalierungsfaktor für Umrechung  Fahrstrecke Intern nach CAN mit CARB Normierung" VALUE 0xC0586 Kw_Wu16 7.999878 Fact 0.00 7.999878 FORMAT "%8.6" /end CHARACTERISTIC
/begin CHARACTERISTIC Sig_Carb_lDIAOffset_C "Signals Offset für Umrechung  Fahrstrecke Intern nach Diagnoseschnittstelle mit CARB Normierung" VALUE 0xC0588 Kw_Ws16 65535.00 OneToOne -32768.00 32767.00 FORMAT "%8.2" /end CHARACTERISTIC
/begin CHARACTERISTIC Sig_Carb_lDIAScale_C "Signals Skalierungsfaktor für Umrechung  Fahrstrecke Intern nach Diagnoseschnittstelle mit CARB Normierung" VALUE 0xC058A Kw_Wu16 7.999878 Fact 0.00 7.999878 FORMAT "%8.6" /end CHARACTERISTIC
/begin CHARACTERISTIC Sig_Carb_mAirTimDSMOffset_C "Offset fuer Umrechung SG->DSM fuer Luftmasse pro Zeit (OBD)" VALUE 0xC058C Kw_Ws16 65535.00 OneToOne -32768.00 32767.00 FORMAT "%8.2" /end CHARACTERISTIC
/begin CHARACTERISTIC Sig_Carb_mAirTimDSMScale_C "Skalierung Umrechungs Faktor SG->DSM fuer Luftmasse pro Zeit (OBD)" VALUE 0xC058E Kw_Wu16 7.999878 Fact 0.00 7.999878 FORMAT "%8.6" /end CHARACTERISTIC
/begin CHARACTERISTIC Sig_Carb_mAirTimCANOffset_C "Offset fuer Umrechung SG->CAN fuer Luftmasse pro Zeit (OBD)" VALUE 0xC0590 Kw_Ws16 65535.00 OneToOne -32768.00 32767.00 FORMAT "%8.2" /end CHARACTERISTIC
/begin CHARACTERISTIC Sig_Carb_mAirTimCANScale_C "Skalierung Umrechungs Faktor SG->CAN fuer Luftmasse pro Zeit (OBD)" VALUE 0xC0592 Kw_Wu16 7.999878 Fact 0.00 7.999878 FORMAT "%8.6" /end CHARACTERISTIC
/begin CHARACTERISTIC Sig_Carb_mAirTimDIAOffset_C "Offset fuer Umrechung SG->DIA fuer Luftmasse pro Zeit (OBD)" VALUE 0xC0594 Kw_Ws16 65535.00 OneToOne -32768.00 32767.00 FORMAT "%8.2" /end CHARACTERISTIC
/begin CHARACTERISTIC Sig_Carb_mAirTimDIAScale_C "Skalierung Umrechungs Faktor SG->DIA fuer Luftmasse pro Zeit (OBD)" VALUE 0xC0596 Kw_Wu16 7.999878 Fact 0.00 7.999878 FORMAT "%8.6" /end CHARACTERISTIC
/begin CHARACTERISTIC Sig_Carb_nDSMOffset_C "Offset fuer Umrechung SG->DSM fuer Drehzahl (OBD)" VALUE 0xC0598 Kw_Ws16 65535.00 OneToOne -32768.00 32767.00 FORMAT "%8.2" /end CHARACTERISTIC
/begin CHARACTERISTIC Sig_Carb_nDSMScale_C "Skalierung Umrechungs Faktor SG->DSM fuer Drehzahl (OBD)" VALUE 0xC059A Kw_Wu16 7.999878 Fact 0.00 7.999878 FORMAT "%8.6" /end CHARACTERISTIC
/begin CHARACTERISTIC Sig_Carb_nCANOffset_C "Offset fuer Umrechung SG->CAN fuer Drehzahl (OBD)" VALUE 0xC059C Kw_Ws16 65535.00 OneToOne -32768.00 32767.00 FORMAT "%8.2" /end CHARACTERISTIC
/begin CHARACTERISTIC Sig_Carb_nCANScale_C "Skalierung Umrechungs Faktor SG->CAN fuer Drehzahl (OBD)" VALUE 0xC059E Kw_Wu16 7.999878 Fact 0.00 7.999878 FORMAT "%8.6" /end CHARACTERISTIC
/begin CHARACTERISTIC Sig_Carb_nDIAOffset_C "Offset fuer Umrechung SG->DIA fuer Drehzahl (OBD)" VALUE 0xC05A0 Kw_Ws16 65535.00 OneToOne -32768.00 32767.00 FORMAT "%8.2" /end CHARACTERISTIC
/begin CHARACTERISTIC Sig_Carb_nDIAScale_C "Skalierung Umrechungs Faktor SG->DIA fuer Drehzahl (OBD)" VALUE 0xC05A2 Kw_Wu16 7.999878 Fact 0.00 7.999878 FORMAT "%8.6" /end CHARACTERISTIC
/begin CHARACTERISTIC Sig_Carb_pDSMOffset_C "Offset fuer Umrechung SG->DSM fuer Druck (OBD)" VALUE 0xC05A4 Kw_Ws16 65535.00 OneToOne -32768.00 32767.00 FORMAT "%8.2" /end CHARACTERISTIC
/begin CHARACTERISTIC Sig_Carb_pDSMScale_C "Skalierung Umrechungs Faktor SG->DSM fuer Druck (OBD)" VALUE 0xC05A6 Kw_Wu16 7.999878 Fact 0.00 7.999878 FORMAT "%8.6" /end CHARACTERISTIC
/begin CHARACTERISTIC Sig_Carb_pCANOffset_C "Offset fuer Umrechung SG->CAN fuer Druck (OBD)" VALUE 0xC05A8 Kw_Ws16 65535.00 OneToOne -32768.00 32767.00 FORMAT "%8.2" /end CHARACTERISTIC
/begin CHARACTERISTIC Sig_Carb_pCANScale_C "Skalierung Umrechungs Faktor SG->CAN fuer Druck (OBD)" VALUE 0xC05AA Kw_Wu16 7.999878 Fact 0.00 7.999878 FORMAT "%8.6" /end CHARACTERISTIC
/begin CHARACTERISTIC Sig_Carb_pDIAOffset_C "Offset fuer Umrechung SG->DIA fuer Druck (OBD)" VALUE 0xC05AC Kw_Ws16 65535.00 OneToOne -32768.00 32767.00 FORMAT "%8.2" /end CHARACTERISTIC
/begin CHARACTERISTIC Sig_Carb_pDIAScale_C "Skalierung Umrechungs Faktor SG->DIA fuer Druck (OBD)" VALUE 0xC05AE Kw_Wu16 7.999878 Fact 0.00 7.999878 FORMAT "%8.6" /end CHARACTERISTIC
/begin CHARACTERISTIC Sig_Carb_rDSMOffset_C "Offset fuer Umrechung SG->DSM fuer Verhältnis (OBD)" VALUE 0xC05B0 Kw_Ws16 65535.00 OneToOne -32768.00 32767.00 FORMAT "%8.2" /end CHARACTERISTIC
/begin CHARACTERISTIC Sig_Carb_rDSMScale_C "Skalierung Umrechungs Faktor SG->DSM fuer Verhältnis (OBD)" VALUE 0xC05B2 Kw_Wu16 7.999878 Fact 0.00 7.999878 FORMAT "%8.6" /end CHARACTERISTIC
/begin CHARACTERISTIC Sig_Carb_rCANOffset_C "Offset fuer Umrechung SG->CAN fuer Verhältnis (OBD)" VALUE 0xC05B4 Kw_Ws16 65535.00 OneToOne -32768.00 32767.00 FORMAT "%8.2" /end CHARACTERISTIC
/begin CHARACTERISTIC Sig_Carb_rCANScale_C "Skalierung Umrechungs Faktor SG->CAN fuer Verhältnis (OBD)" VALUE 0xC05B6 Kw_Wu16 7.999878 Fact 0.00 7.999878 FORMAT "%8.6" /end CHARACTERISTIC
/begin CHARACTERISTIC Sig_Carb_rDIAOffset_C "Offset fuer Umrechung SG->DIA fuer Verhältnis (OBD)" VALUE 0xC05B8 Kw_Ws16 65535.00 OneToOne -32768.00 32767.00 FORMAT "%8.2" /end CHARACTERISTIC
/begin CHARACTERISTIC Sig_Carb_rDIAScale_C "Skalierung Umrechungs Faktor SG->DIA fuer Verhältnis (OBD)" VALUE 0xC05BA Kw_Wu16 7.999878 Fact 0.00 7.999878 FORMAT "%8.6" /end CHARACTERISTIC
/begin CHARACTERISTIC Sig_Carb_tiDSMOffset_C "Offset fuer Umrechung SG->DSM fuer Zeit (OBD)" VALUE 0xC05BC Kw_Ws16 65535.00 OneToOne -32768.00 32767.00 FORMAT "%8.2" /end CHARACTERISTIC
/begin CHARACTERISTIC Sig_Carb_tiDSMScale_C "Skalierung Umrechungs Faktor SG->DSM fuer Zeit (OBD)" VALUE 0xC05BE Kw_Wu16 7.999878 Fact 0.00 7.999878 FORMAT "%8.6" /end CHARACTERISTIC
/begin CHARACTERISTIC Sig_Carb_tiCANOffset_C "Offset fuer Umrechung SG->CAN fuer Zeit (OBD)" VALUE 0xC05C0 Kw_Ws16 65535.00 OneToOne -32768.00 32767.00 FORMAT "%8.2" /end CHARACTERISTIC
/begin CHARACTERISTIC Sig_Carb_tiCANScale_C "Skalierung Umrechungs Faktor SG->CAN fuer Zeit (OBD)" VALUE 0xC05C2 Kw_Wu16 7.999878 Fact 0.00 7.999878 FORMAT "%8.6" /end CHARACTERISTIC
/begin CHARACTERISTIC Sig_Carb_tiDIAOffset_C "Offset fuer Umrechung SG->DIA fuer Zeit (OBD)" VALUE 0xC05C4 Kw_Ws16 65535.00 OneToOne -32768.00 32767.00 FORMAT "%8.2" /end CHARACTERISTIC
/begin CHARACTERISTIC Sig_Carb_tiDIAScale_C "Skalierung Umrechungs Faktor SG->DIA fuer Zeit (OBD)" VALUE 0xC05C6 Kw_Wu16 7.999878 Fact 0.00 7.999878 FORMAT "%8.6" /end CHARACTERISTIC
/begin CHARACTERISTIC Sig_Carb_tDSMOffset_C "Offset fuer Umrechung SG->DSM fuer Temperatur (OBD)" VALUE 0xC05C8 Kw_Ws16 65535.00 OneToOne -32768.00 32767.00 FORMAT "%8.2" /end CHARACTERISTIC
/begin CHARACTERISTIC Sig_Carb_tDSMScale_C "Skalierung Umrechungs Faktor SG->DSM fuer Temperatur (OBD)" VALUE 0xC05CA Kw_Wu16 7.999878 Fact 0.00 7.999878 FORMAT "%8.6" /end CHARACTERISTIC
/begin CHARACTERISTIC Sig_Carb_tCANOffset_C "Offset fuer Umrechung SG->CAN fuer Temperatur (OBD)" VALUE 0xC05CC Kw_Ws16 65535.00 OneToOne -32768.00 32767.00 FORMAT "%8.2" /end CHARACTERISTIC
/begin CHARACTERISTIC Sig_Carb_tCANScale_C "Skalierung Umrechungs Faktor SG->CAN fuer Temperatur (OBD)" VALUE 0xC05CE Kw_Wu16 7.999878 Fact 0.00 7.999878 FORMAT "%8.6" /end CHARACTERISTIC
/begin CHARACTERISTIC Sig_Carb_tDIAOffset_C "Offset fuer Umrechung SG->DIA fuer Temperatur (OBD)" VALUE 0xC05D0 Kw_Ws16 65535.00 OneToOne -32768.00 32767.00 FORMAT "%8.2" /end CHARACTERISTIC
/begin CHARACTERISTIC Sig_Carb_tDIAScale_C "Skalierung Umrechungs Faktor SG->DIA fuer Temperatur (OBD)" VALUE 0xC05D2 Kw_Wu16 7.999878 Fact 0.00 7.999878 FORMAT "%8.6" /end CHARACTERISTIC
/begin CHARACTERISTIC Sig_Carb_vDSMOffset_C "Offset fuer Umrechung SG->DSM fuer Geschwindigkeit (OBD)" VALUE 0xC05D4 Kw_Ws16 65535.00 OneToOne -32768.00 32767.00 FORMAT "%8.2" /end CHARACTERISTIC
/begin CHARACTERISTIC Sig_Carb_vDSMScale_C "Skalierung Umrechungs Faktor SG->DSM fuer Geschwindigkeit (OBD)" VALUE 0xC05D6 Kw_Wu16 7.999878 Fact 0.00 7.999878 FORMAT "%8.6" /end CHARACTERISTIC
/begin CHARACTERISTIC Sig_Carb_vCANOffset_C "Offset fuer Umrechung SG->CAN fuer Geschwindigkeit (OBD)" VALUE 0xC05D8 Kw_Ws16 65535.00 OneToOne -32768.00 32767.00 FORMAT "%8.2" /end CHARACTERISTIC
/begin CHARACTERISTIC Sig_Carb_vCANScale_C "Skalierung Umrechungs Faktor SG->CAN fuer Geschwindigkeit (OBD)" VALUE 0xC05DA Kw_Wu16 7.999878 Fact 0.00 7.999878 FORMAT "%8.6" /end CHARACTERISTIC
/begin CHARACTERISTIC Sig_Carb_vDIAOffset_C "Offset fuer Umrechung SG->DIA fuer Geschwindigkeit (OBD)" VALUE 0xC05DC Kw_Ws16 65535.00 OneToOne -32768.00 32767.00 FORMAT "%8.2" /end CHARACTERISTIC
/begin CHARACTERISTIC Sig_Carb_vDIAScale_C "Skalierung Umrechungs Faktor SG->DIA fuer Geschwindigkeit (OBD)" VALUE 0xC05DE Kw_Wu16 7.999878 Fact 0.00 7.999878 FORMAT "%8.6" /end CHARACTERISTIC
/begin CHARACTERISTIC Sig_dcycDSMOffset_C "Offset Umrechung SG->DSM für Tastverhältnisse" VALUE 0xC05E0 Kw_Ws16 65535.00 OneToOne -32768.00 32767.00 FORMAT "%8.2" /end CHARACTERISTIC
/begin CHARACTERISTIC Sig_dcycDSMScale_C "Skalierung Umrechung SG->DSM für Tastverhältnisse" VALUE 0xC05E2 Kw_Wu16 7.999878 Fact 0.00 7.999878 FORMAT "%8.6" /end CHARACTERISTIC
/begin CHARACTERISTIC Sig_dcycCANOffset_C "Offset Umrechung SG->CAN für Tastverhältnisse" VALUE 0xC05E4 Kw_Ws16 65535.00 OneToOne -32768.00 32767.00 FORMAT "%8.2" /end CHARACTERISTIC
/begin CHARACTERISTIC Sig_dcycCANScale_C "Skalierung Umrechung SG->CAN für Tastverhältnisse" VALUE 0xC05E6 Kw_Wu16 7.999878 Fact 0.00 7.999878 FORMAT "%8.6" /end CHARACTERISTIC
/begin CHARACTERISTIC Sig_dcycDIAOffset_C "Offset Umrechung SG->Diagnoseschnittstelle für Tastverhältnisse" VALUE 0xC05E8 Kw_Ws16 65535.00 OneToOne -32768.00 32767.00 FORMAT "%8.2" /end CHARACTERISTIC
/begin CHARACTERISTIC Sig_dcycDIAScale_C "Skalierung Umrechung SG->Diagnoseschnittstelle für Tastverhältnisse" VALUE 0xC05EA Kw_Wu16 7.999878 Fact 0.00 7.999878 FORMAT "%8.6" /end CHARACTERISTIC
/begin CHARACTERISTIC Sig_ddmAirTimeDSMOffset_C "Offset für die Umrechnung ECU -> DSM fuer Luftmassenstromgradient" VALUE 0xC05EC Kw_Ws16 65535.00 OneToOne -32768.00 32767.00 FORMAT "%8.2" /end CHARACTERISTIC
/begin CHARACTERISTIC Sig_ddmAirTimeDSMScale_C "Skalierung für die Umrechnung ECU -> DSM fuer Luftmassenstromgradient" VALUE 0xC05EE Kw_Wu16 7.999878 Fact 0.00 7.999878 FORMAT "%8.6" /end CHARACTERISTIC
/begin CHARACTERISTIC Sig_ddmAirTimeCANOffset_C "Offset fuer Umrechung SG->CAN fuer Luftmassenstromgradient" VALUE 0xC05F0 Kw_Ws16 65535.00 OneToOne -32768.00 32767.00 FORMAT "%8.2" /end CHARACTERISTIC
/begin CHARACTERISTIC Sig_ddmAirTimeCANScale_C "Skalierung fuer Umrechung SG->CAN fuer Luftmassenstromgradient" VALUE 0xC05F2 Kw_Wu16 7.999878 Fact 0.00 7.999878 FORMAT "%8.6" /end CHARACTERISTIC
/begin CHARACTERISTIC Sig_ddmAirTimeDIAOffset_C "Offset für die Umrechnung ecu -> DIA fuer Luftmassenstromgradient" VALUE 0xC05F4 Kw_Ws16 65535.00 OneToOne -32768.00 32767.00 FORMAT "%8.2" /end CHARACTERISTIC
/begin CHARACTERISTIC Sig_ddmAirTimeDIAScale_C "Skalierung für die Umrechnung ECU -> DIA fuer Luftmassenstromgradient" VALUE 0xC05F6 Kw_Wu16 7.999878 Fact 0.00 7.999878 FORMAT "%8.6" /end CHARACTERISTIC
/begin CHARACTERISTIC Sig_dnDSMOffset_C "Offset für die Umrechnung ecu -> DSM mittlere Motorbeschleunigung" VALUE 0xC05F8 Kw_Ws16 65535.00 OneToOne -32768.00 32767.00 FORMAT "%8.2" /end CHARACTERISTIC
/begin CHARACTERISTIC Sig_dnDSMScale_C "Skalierung fuer Umrechung SG-> DSM mittlere Motorbeschleunigung" VALUE 0xC05FA Kw_Wu16 7.999878 Fact 0.00 7.999878 FORMAT "%8.6" /end CHARACTERISTIC
/begin CHARACTERISTIC Sig_dnCANOffset_C "Offset für die Umrechnung ecu -> CAN mittlere Motorbeschleunigung" VALUE 0xC05FC Kw_Ws16 65535.00 OneToOne -32768.00 32767.00 FORMAT "%8.2" /end CHARACTERISTIC
/begin CHARACTERISTIC Sig_dnCANScale_C "Skalierung fuer Umrechung SG->CAN mittlere Motorbeschleunigung" VALUE 0xC05FE Kw_Wu16 7.999878 Fact 0.00 7.999878 FORMAT "%8.6" /end CHARACTERISTIC
/begin CHARACTERISTIC Sig_dnDIAOffset_C "Offset für die Umrechnung ecu -> DIA mittlere Motorbeschleunigung" VALUE 0xC0600 Kw_Ws16 65535.00 OneToOne -32768.00 32767.00 FORMAT "%8.2" /end CHARACTERISTIC
/begin CHARACTERISTIC Sig_dnDIAScale_C "Skalierung fuer Umrechung SG->DIA mittlere Motorbeschleunigung" VALUE 0xC0602 Kw_Wu16 7.999878 Fact 0.00 7.999878 FORMAT "%8.6" /end CHARACTERISTIC
/begin CHARACTERISTIC Sig_dpDSMOffset_C "Offset für die Umrechnung ecu -> DSM Ladedruckgradient" VALUE 0xC0604 Kw_Ws16 65535.00 OneToOne -32768.00 32767.00 FORMAT "%8.2" /end CHARACTERISTIC
/begin CHARACTERISTIC Sig_dpDSMScale_C "Skalierung fuer Umrechung SG->DSM fuer Ladedruckgradient" VALUE 0xC0606 Kw_Wu16 7.999878 Fact 0.00 7.999878 FORMAT "%8.6" /end CHARACTERISTIC
/begin CHARACTERISTIC Sig_dpCANOffset_C "Offset fuer Umrechung SG->CAN fuer Ladedruckgradient" VALUE 0xC0608 Kw_Ws16 65535.00 OneToOne -32768.00 32767.00 FORMAT "%8.2" /end CHARACTERISTIC
/begin CHARACTERISTIC Sig_dpCANScale_C "Skalierung fuer Umrechung SG->CAN fuer Ladedruckgradient" VALUE 0xC060A Kw_Wu16 7.999878 Fact 0.00 7.999878 FORMAT "%8.6" /end CHARACTERISTIC
/begin CHARACTERISTIC Sig_dpDIAOffset_C "Offset für die Umrechnung ecu -> DIA Ladedruckgradient" VALUE 0xC060C Kw_Ws16 65535.00 OneToOne -32768.00 32767.00 FORMAT "%8.2" /end CHARACTERISTIC
/begin CHARACTERISTIC Sig_dpDIAScale_C "Skalierung fuer Umrechung SG->DIA fuer Ladedruckgradient" VALUE 0xC060E Kw_Wu16 7.999878 Fact 0.00 7.999878 FORMAT "%8.6" /end CHARACTERISTIC
/begin CHARACTERISTIC Sig_dqCurrInjDSMOffset_C "Offset fuer Umrechung SG->DSM fuer Kraftstoffmassengradient ohne FBC" VALUE 0xC0610 Kw_Ws16 65535.00 OneToOne -32768.00 32767.00 FORMAT "%8.2" /end CHARACTERISTIC
/begin CHARACTERISTIC Sig_dqCurrInjDSMScale_C "Skalierung fuer Umrechung SG->DSM fuer Kraftstoffmassengradient ohne FBC" VALUE 0xC0612 Kw_Wu16 7.999878 Fact 0.00 7.999878 FORMAT "%8.6" /end CHARACTERISTIC
/begin CHARACTERISTIC Sig_dqCurrInjCANOffset_C "Offset fuer Umrechung SG->CAN fuer Kraftstoffmassengradient ohne FBC" VALUE 0xC0614 Kw_Ws16 65535.00 OneToOne -32768.00 32767.00 FORMAT "%8.2" /end CHARACTERISTIC
/begin CHARACTERISTIC Sig_dqCurrInjCANScale_C "Skalierung fuer Umrechung SG->CAN fuer Kraftstoffmassengradient ohne FBC" VALUE 0xC0616 Kw_Wu16 7.999878 Fact 0.00 7.999878 FORMAT "%8.6" /end CHARACTERISTIC
/begin CHARACTERISTIC Sig_dqCurrInjDIAOffset_C "Offset fuer Umrechung SG->DIA fuer Kraftstoffmassengradient ohne FBC" VALUE 0xC0618 Kw_Ws16 65535.00 OneToOne -32768.00 32767.00 FORMAT "%8.2" /end CHARACTERISTIC
/begin CHARACTERISTIC Sig_dqCurrInjDIAScale_C "Skalierung fuer Umrechung SG->DIA fuer Kraftstoffmassengradient ohne FBC" VALUE 0xC061A Kw_Wu16 7.999878 Fact 0.00 7.999878 FORMAT "%8.6" /end CHARACTERISTIC
/begin CHARACTERISTIC Sig_drAPPUnFltDSMOffset_C "Offset fuer Umrechung SG->DSM fuer differenziertes Signal der ungefilterten Fahrpedalstellung" VALUE 0xC061C Kw_Ws16 65535.00 OneToOne -32768.00 32767.00 FORMAT "%8.2" /end CHARACTERISTIC
/begin CHARACTERISTIC Sig_drAPPUnFltDSMScale_C "Skalierung fuer Umrechung SG->DSM fuer differenziertes Signal der ungefilterten Fahrpedalstellung" VALUE 0xC061E Kw_Wu16 7.999878 Fact 0.00 7.999878 FORMAT "%8.6" /end CHARACTERISTIC
/begin CHARACTERISTIC Sig_drAPPUnFltCANOffset_C "Offset fuer Umrechung SG->CAN fuer differenziertes Signal der ungefilterten Fahrpedalstellung" VALUE 0xC0620 Kw_Ws16 65535.00 OneToOne -32768.00 32767.00 FORMAT "%8.2" /end CHARACTERISTIC
/begin CHARACTERISTIC Sig_drAPPUnFltCANScale_C "Skalierung fuer Umrechung SG->CAN fuer differenziertes Signal der ungefilterten Fahrpedalstellung" VALUE 0xC0622 Kw_Wu16 7.999878 Fact 0.00 7.999878 FORMAT "%8.6" /end CHARACTERISTIC
/begin CHARACTERISTIC Sig_drAPPUnFltDIAOffset_C "Offset fuer Umrechung SG->DIA fuer differenziertes Signal der ungefilterten Fahrpedalstellung" VALUE 0xC0624 Kw_Ws16 65535.00 OneToOne -32768.00 32767.00 FORMAT "%8.2" /end CHARACTERISTIC
/begin CHARACTERISTIC Sig_drAPPUnFltDIAScale_C "Skalierung fuer Umrechung SG->DIA fuer differenziertes Signal der ungefilterten Fahrpedalstellung" VALUE 0xC0626 Kw_Wu16 7.999878 Fact 0.00 7.999878 FORMAT "%8.6" /end CHARACTERISTIC
/begin CHARACTERISTIC Sig_ertmTimDSMOffset_C "Offset für Umrechnung SG->DSM für Laufzeitmessung" VALUE 0xC0628 Kw_Ws16 65535.00 OneToOne -32768.00 32767.00 FORMAT "%8.2" /end CHARACTERISTIC
/begin CHARACTERISTIC Sig_ertmTimDSMScale_C "Skalierung Umrechung SG->DSM für Laufzeitmessung" VALUE 0xC062A Kw_Wu16 7.999878 Fact 0.00 7.999878 FORMAT "%8.6" /end CHARACTERISTIC
/begin CHARACTERISTIC Sig_ertmTimCANOffset_C "Offset für Umrechnung SG->CAN für Laufzeitmessung" VALUE 0xC062C Kw_Ws16 65535.00 OneToOne -32768.00 32767.00 FORMAT "%8.2" /end CHARACTERISTIC
/begin CHARACTERISTIC Sig_ertmTimCANScale_C "Skalierung Umrechung SG->CAN für Laufzeitmessung" VALUE 0xC062E Kw_Wu16 7.999878 Fact 0.00 7.999878 FORMAT "%8.6" /end CHARACTERISTIC
/begin CHARACTERISTIC Sig_ertmTimDIAOffset_C "Offset für Umrechnung SG->Diagnoseschnittstelle für Laufzeitmessung" VALUE 0xC0630 Kw_Ws16 65535.00 OneToOne -32768.00 32767.00 FORMAT "%8.2" /end CHARACTERISTIC
/begin CHARACTERISTIC Sig_ertmTimDIAScale_C "Skalierung Umrechung SG->Diagnoseschnittstelle für Laufzeitmessung" VALUE 0xC0632 Kw_Wu16 7.999878 Fact 0.00 7.999878 FORMAT "%8.6" /end CHARACTERISTIC
/begin CHARACTERISTIC Sig_factDSMOffset_C "Offset Umrechnungsfaktor SG -> DSM fuer Faktoren" VALUE 0xC0634 Kw_Ws16 65535.00 OneToOne -32768.00 32767.00 FORMAT "%8.2" /end CHARACTERISTIC
/begin CHARACTERISTIC Sig_factDSMScale_C "Skalierung Umrechnungsfaktor SG -> DSM fuer Faktoren" VALUE 0xC0636 Kw_Wu16 7.999878 Fact 0.00 7.999878 FORMAT "%8.6" /end CHARACTERISTIC
/begin CHARACTERISTIC Sig_factCANOffset_C "Offset fuer Umrechnung SG -> CAN für Faktoren" VALUE 0xC0638 Kw_Ws16 65535.00 OneToOne -32768.00 32767.00 FORMAT "%8.2" /end CHARACTERISTIC
/begin CHARACTERISTIC Sig_factCANScale_C "Skalierung Umrechnungsfaktor SG -> CAN fuer Faktoren" VALUE 0xC063A Kw_Wu16 7.999878 Fact 0.00 7.999878 FORMAT "%8.6" /end CHARACTERISTIC
/begin CHARACTERISTIC Sig_factDIAOffset_C "Offset Umrechnungsfaktor SG -> DIA für Faktoren" VALUE 0xC063C Kw_Ws16 65535.00 OneToOne -32768.00 32767.00 FORMAT "%8.2" /end CHARACTERISTIC
/begin CHARACTERISTIC Sig_factDIAScale_C "Skalierung Umrechnungsfaktor SG -> DIA fuer Faktoren" VALUE 0xC063E Kw_Wu16 7.999878 Fact 0.00 7.999878 FORMAT "%8.6" /end CHARACTERISTIC
/begin CHARACTERISTIC Sig_FlConPFltDSMOffset_C "Offset für Umrechnung SG->DSM für Kraftstoffverbrauch (Partikelfilter)" VALUE 0xC0640 Kw_Ws16 65535.00 OneToOne -32768.00 32767.00 FORMAT "%8.2" /end CHARACTERISTIC
/begin CHARACTERISTIC Sig_FlConPFltDSMScale_C "Skalierung Umrechung SG->DSM für Kraftstoffverbrauch (Partikelfilter)" VALUE 0xC0642 Kw_Wu16 7.999878 Fact 0.00 7.999878 FORMAT "%8.6" /end CHARACTERISTIC
/begin CHARACTERISTIC Sig_FlConPFltCANOffset_C "Offset für Umrechnung SG->CAN für Kraftstoffverbrauch (Partikelfilter)" VALUE 0xC0644 Kw_Ws16 65535.00 OneToOne -32768.00 32767.00 FORMAT "%8.2" /end CHARACTERISTIC
/begin CHARACTERISTIC Sig_FlConPFltCANScale_C "Skalierung Umrechung SG->CAN für Kraftstoffverbrauch (Partikelfilter)" VALUE 0xC0646 Kw_Wu16 7.999878 Fact 0.00 7.999878 FORMAT "%8.6" /end CHARACTERISTIC
/begin CHARACTERISTIC Sig_FlConPFltDIAOffset_C "Offset für Umrechnung SG->Diagnoseschnittstelle für Kraftstoffverbrauch (Partikelfilter)" VALUE 0xC0648 Kw_Ws16 65535.00 OneToOne -32768.00 32767.00 FORMAT "%8.2" /end CHARACTERISTIC
/begin CHARACTERISTIC Sig_FlConPFltDIAScale_C "Skalierung Umrechung SG->Diagnoseschnittstelle für Kraftstoffverbrauch (Partikelfilter)" VALUE 0xC064A Kw_Wu16 7.999878 Fact 0.00 7.999878 FORMAT "%8.6" /end CHARACTERISTIC
/begin CHARACTERISTIC Sig_FlConDSMOffset_C "Offset für Umrechnung ecu -> dsm" VALUE 0xC064C Kw_Ws16 65535.00 OneToOne -32768.00 32767.00 FORMAT "%8.2" /end CHARACTERISTIC
/begin CHARACTERISTIC Sig_FlConDSMScale_C "Skalierung für Umrechnung ecu -> dsm" VALUE 0xC064E Kw_Wu16 7.999878 Fact 0.00 7.999878 FORMAT "%8.6" /end CHARACTERISTIC
/begin CHARACTERISTIC Sig_FlConCANOffset_C "Offset für Umrechnung ecu -> can" VALUE 0xC0650 Kw_Ws16 65535.00 OneToOne -32768.00 32767.00 FORMAT "%8.2" /end CHARACTERISTIC
/begin CHARACTERISTIC Sig_FlConCANScale_C "Skalierung für Umrechnung ecu -> can" VALUE 0xC0652 Kw_Wu16 7.999878 Fact 0.00 7.999878 FORMAT "%8.6" /end CHARACTERISTIC
/begin CHARACTERISTIC Sig_FlConDIAOffset_C "Offset für Umrechnung ecu -> dia" VALUE 0xC0654 Kw_Ws16 65535.00 OneToOne -32768.00 32767.00 FORMAT "%8.2" /end CHARACTERISTIC
/begin CHARACTERISTIC Sig_FlConDIAScale_C "Skalierung für Umrechnung ecu -> dia" VALUE 0xC0656 Kw_Wu16 7.999878 Fact 0.00 7.999878 FORMAT "%8.6" /end CHARACTERISTIC
/begin CHARACTERISTIC Sig_fas1DSMOffset_C "Offset fuer Umrechung SG->DSM fuer ein frei applizierbares Signal" VALUE 0xC0658 Kw_Ws16 65535.00 OneToOne -32768.00 32767.00 FORMAT "%8.2" /end CHARACTERISTIC
/begin CHARACTERISTIC Sig_fas1DSMScale_C "Skalierung Umrechungs Faktor SG->DSM fuer ein frei applizierbares Signal" VALUE 0xC065A Kw_Wu16 7.999878 Fact 0.00 7.999878 FORMAT "%8.6" /end CHARACTERISTIC
/begin CHARACTERISTIC Sig_fas1CANOffset_C "Offset fuer Umrechung SG->CAN fuer ein frei applizierbares Signal" VALUE 0xC065C Kw_Ws16 65535.00 OneToOne -32768.00 32767.00 FORMAT "%8.2" /end CHARACTERISTIC
/begin CHARACTERISTIC Sig_fas1CANScale_C "Skalierung Umrechungs Faktor SG->CAN fuer ein frei applizierbares Signal" VALUE 0xC065E Kw_Wu16 7.999878 Fact 0.00 7.999878 FORMAT "%8.6" /end CHARACTERISTIC
/begin CHARACTERISTIC Sig_fas1DIAOffset_C "Offset fuer Umrechung SG->DIA fuer ein frei applizierbares Signal" VALUE 0xC0660 Kw_Ws16 65535.00 OneToOne -32768.00 32767.00 FORMAT "%8.2" /end CHARACTERISTIC
/begin CHARACTERISTIC Sig_fas1DIAScale_C "Skalierung Umrechungs Faktor SG->DIA fuer ein frei applizierbares Signal" VALUE 0xC0662 Kw_Wu16 7.999878 Fact 0.00 7.999878 FORMAT "%8.6" /end CHARACTERISTIC
/begin CHARACTERISTIC Sig_fas2DSMOffset_C "Offset fuer Umrechung SG->DSM fuer ein frei applizierbares Signal" VALUE 0xC0664 Kw_Ws16 65535.00 OneToOne -32768.00 32767.00 FORMAT "%8.2" /end CHARACTERISTIC
/begin CHARACTERISTIC Sig_fas2DSMScale_C "Skalierung Umrechungs Faktor SG->DSM fuer ein frei applizierbares Signal" VALUE 0xC0666 Kw_Wu16 7.999878 Fact 0.00 7.999878 FORMAT "%8.6" /end CHARACTERISTIC
/begin CHARACTERISTIC Sig_fas2CANOffset_C "Offset fuer Umrechung SG->CAN fuer ein frei applizierbares Signal" VALUE 0xC0668 Kw_Ws16 65535.00 OneToOne -32768.00 32767.00 FORMAT "%8.2" /end CHARACTERISTIC
/begin CHARACTERISTIC Sig_fas2CANScale_C "Skalierung Umrechungs Faktor SG->CAN fuer ein frei applizierbares Signal" VALUE 0xC066A Kw_Wu16 7.999878 Fact 0.00 7.999878 FORMAT "%8.6" /end CHARACTERISTIC
/begin CHARACTERISTIC Sig_fas2DIAOffset_C "Offset fuer Umrechung SG->DIA fuer ein frei applizierbares Signal" VALUE 0xC066C Kw_Ws16 65535.00 OneToOne -32768.00 32767.00 FORMAT "%8.2" /end CHARACTERISTIC
/begin CHARACTERISTIC Sig_fas2DIAScale_C "Skalierung Umrechungs Faktor SG->DIA fuer ein frei applizierbares Signal" VALUE 0xC066E Kw_Wu16 7.999878 Fact 0.00 7.999878 FORMAT "%8.6" /end CHARACTERISTIC
/begin CHARACTERISTIC Sig_fas3DSMOffset_C "Offset fuer Umrechung SG->DSM fuer ein frei applizierbares Signal" VALUE 0xC0670 Kw_Ws16 65535.00 OneToOne -32768.00 32767.00 FORMAT "%8.2" /end CHARACTERISTIC
/begin CHARACTERISTIC Sig_fas3DSMScale_C "Skalierung Umrechungs Faktor SG->DSM fuer ein frei applizierbares Signal" VALUE 0xC0672 Kw_Wu16 7.999878 Fact 0.00 7.999878 FORMAT "%8.6" /end CHARACTERISTIC
/begin CHARACTERISTIC Sig_fas3CANOffset_C "Offset fuer Umrechung SG->CAN fuer ein frei applizierbares Signal" VALUE 0xC0674 Kw_Ws16 65535.00 OneToOne -32768.00 32767.00 FORMAT "%8.2" /end CHARACTERISTIC
/begin CHARACTERISTIC Sig_fas3CANScale_C "Skalierung Umrechungs Faktor SG->CAN fuer ein frei applizierbares Signal" VALUE 0xC0676 Kw_Wu16 7.999878 Fact 0.00 7.999878 FORMAT "%8.6" /end CHARACTERISTIC
/begin CHARACTERISTIC Sig_fas3DIAOffset_C "Offset fuer Umrechung SG->DIA fuer ein frei applizierbares Signal" VALUE 0xC0678 Kw_Ws16 65535.00 OneToOne -32768.00 32767.00 FORMAT "%8.2" /end CHARACTERISTIC
/begin CHARACTERISTIC Sig_fas3DIAScale_C "Skalierung Umrechungs Faktor SG->DIA fuer ein frei applizierbares Signal" VALUE 0xC067A Kw_Wu16 7.999878 Fact 0.00 7.999878 FORMAT "%8.6" /end CHARACTERISTIC
/begin CHARACTERISTIC Sig_InjTimDSMOffset_C "Offset für Umrechnung -> dsm" VALUE 0xC067C Kw_Ws16 65535.00 OneToOne -32768.00 32767.00 FORMAT "%8.2" /end CHARACTERISTIC
/begin CHARACTERISTIC Sig_InjTimDSMScale_C "Skalierung für Umrechnung ecu -> dsm" VALUE 0xC067E Kw_Wu16 7.999878 Fact 0.00 7.999878 FORMAT "%8.6" /end CHARACTERISTIC
/begin CHARACTERISTIC Sig_InjTimCANOffset_C "Offset für Umrechnung ecu -> can" VALUE 0xC0680 Kw_Ws16 65535.00 OneToOne -32768.00 32767.00 FORMAT "%8.2" /end CHARACTERISTIC
/begin CHARACTERISTIC Sig_InjTimCANScale_C "Skalierung für Umrechnung ecu -> can" VALUE 0xC0682 Kw_Wu16 7.999878 Fact 0.00 7.999878 FORMAT "%8.6" /end CHARACTERISTIC
/begin CHARACTERISTIC Sig_InjTimDIAOffset_C "Offset für Umrechnung ecu -> dia" VALUE 0xC0684 Kw_Ws16 65535.00 OneToOne -32768.00 32767.00 FORMAT "%8.2" /end CHARACTERISTIC
/begin CHARACTERISTIC Sig_InjTimDIAScale_C "Skalierung für Umrechnung ecu -> dia" VALUE 0xC0686 Kw_Wu16 7.999878 Fact 0.00 7.999878 FORMAT "%8.6" /end CHARACTERISTIC
/begin CHARACTERISTIC Sig_km_sw_q10DSMOffset_C "offset for conversion ecu -> dsm" VALUE 0xC0688 Kw_Ws16 65535.00 OneToOne -32768.00 32767.00 FORMAT "%8.2" /end CHARACTERISTIC
/begin CHARACTERISTIC Sig_km_sw_q10DSMScale_C "scale factor for conversion ecu -> dsm" VALUE 0xC068A Kw_Wu16 7.999878 Fact 0.00 7.999878 FORMAT "%8.6" /end CHARACTERISTIC
/begin CHARACTERISTIC Sig_km_sw_q10CANOffset_C "offset for conversion ecu -> can" VALUE 0xC068C Kw_Ws16 65535.00 OneToOne -32768.00 32767.00 FORMAT "%8.2" /end CHARACTERISTIC
/begin CHARACTERISTIC Sig_km_sw_q10CANScale_C "scale factor for conversion ecu -> can" VALUE 0xC068E Kw_Wu16 7.999878 Fact 0.00 7.999878 FORMAT "%8.6" /end CHARACTERISTIC
/begin CHARACTERISTIC Sig_km_sw_q10DIAOffset_C "offset for conversion ecu -> dia" VALUE 0xC0690 Kw_Ws16 65535.00 OneToOne -32768.00 32767.00 FORMAT "%8.2" /end CHARACTERISTIC
/begin CHARACTERISTIC Sig_km_sw_q10DIAScale_C "scale factor for conversion ecu -> dia" VALUE 0xC0692 Kw_Wu16 7.999878 Fact 0.00 7.999878 FORMAT "%8.6" /end CHARACTERISTIC
/begin CHARACTERISTIC Sig_lenPFltDSMOffset_C "Offset für Umrechnung SG->DSM für km-Stand (Partikelfilter)" VALUE 0xC0694 Kw_Ws16 65535.00 OneToOne -32768.00 32767.00 FORMAT "%8.2" /end CHARACTERISTIC
/begin CHARACTERISTIC Sig_lenPFltDSMScale_C "Skalierung Umrechung SG->DSM für km-Stand (Partikelfilter)" VALUE 0xC0696 Kw_Wu16 7.999878 Fact 0.00 7.999878 FORMAT "%8.6" /end CHARACTERISTIC
/begin CHARACTERISTIC Sig_lenPFltCANOffset_C "Offset für Umrechnung SG->CAN für km-Stand (Partikelfilter)" VALUE 0xC0698 Kw_Ws16 65535.00 OneToOne -32768.00 32767.00 FORMAT "%8.2" /end CHARACTERISTIC
/begin CHARACTERISTIC Sig_lenPFltCANScale_C "Skalierung Umrechung SG->CAN für km-Stand (Partikelfilter)" VALUE 0xC069A Kw_Wu16 7.999878 Fact 0.00 7.999878 FORMAT "%8.6" /end CHARACTERISTIC
/begin CHARACTERISTIC Sig_lenPFltDIAOffset_C "Offset für Umrechnung SG->Diagnoseschnittstelle für km-Stand (Partikelfilter)" VALUE 0xC069C Kw_Ws16 65535.00 OneToOne -32768.00 32767.00 FORMAT "%8.2" /end CHARACTERISTIC
/begin CHARACTERISTIC Sig_lenPFltDIAScale_C "Skalierung Umrechung SG->Diagnoseschnittstelle für km-Stand (Partikelfilter)" VALUE 0xC069E Kw_Wu16 7.999878 Fact 0.00 7.999878 FORMAT "%8.6" /end CHARACTERISTIC
/begin CHARACTERISTIC Sig_lenrgnu16PFltDSMOffset_C "Offset Umrechnumg SG->DSM" VALUE 0xC06A0 Kw_Ws16 65535.00 OneToOne -32768.00 32767.00 FORMAT "%8.2" /end CHARACTERISTIC
/begin CHARACTERISTIC Sig_lenrgnu16PFltDSMScale_C "Skalierung Umrechnung SG->DSM" VALUE 0xC06A2 Kw_Wu16 7.999878 Fact 0.00 7.999878 FORMAT "%8.6" /end CHARACTERISTIC
/begin CHARACTERISTIC Sig_lenrgnu16PFltCANOffset_C "Offset Umrechnumg SG->CAN" VALUE 0xC06A4 Kw_Ws16 65535.00 OneToOne -32768.00 32767.00 FORMAT "%8.2" /end CHARACTERISTIC
/begin CHARACTERISTIC Sig_lenrgnu16PFltCANScale_C "Skalierung Umrechnung SG->CAN" VALUE 0xC06A6 Kw_Wu16 7.999878 Fact 0.00 7.999878 FORMAT "%8.6" /end CHARACTERISTIC
/begin CHARACTERISTIC Sig_lenrgnu16PFltDIAOffset_C "Offset Umrechnumg SG->DIA" VALUE 0xC06A8 Kw_Ws16 65535.00 OneToOne -32768.00 32767.00 FORMAT "%8.2" /end CHARACTERISTIC
/begin CHARACTERISTIC Sig_lenrgnu16PFltDIAScale_C "Skalierung Umrechnung SG->DIA" VALUE 0xC06AA Kw_Wu16 7.999878 Fact 0.00 7.999878 FORMAT "%8.6" /end CHARACTERISTIC
/begin CHARACTERISTIC Sig_lenu16PFltDSMOffset_C "Offset Umrechnumg SG->DSM" VALUE 0xC06AC Kw_Ws16 65535.00 OneToOne -32768.00 32767.00 FORMAT "%8.2" /end CHARACTERISTIC
/begin CHARACTERISTIC Sig_lenu16PFltDSMScale_C "Skalierung Umrechnung SG->DSM" VALUE 0xC06AE Kw_Wu16 7.999878 Fact 0.00 7.999878 FORMAT "%8.6" /end CHARACTERISTIC
/begin CHARACTERISTIC Sig_lenu16PFltCANOffset_C "Offset Umrechnumg SG->CAN" VALUE 0xC06B0 Kw_Ws16 65535.00 OneToOne -32768.00 32767.00 FORMAT "%8.2" /end CHARACTERISTIC
/begin CHARACTERISTIC Sig_lenu16PFltCANScale_C "Skalierung Umrechnung SG->CAN" VALUE 0xC06B2 Kw_Wu16 7.999878 Fact 0.00 7.999878 FORMAT "%8.6" /end CHARACTERISTIC
/begin CHARACTERISTIC Sig_lenu16PFltDIAOffset_C "Offset Umrechnumg SG->DIA" VALUE 0xC06B4 Kw_Ws16 65535.00 OneToOne -32768.00 32767.00 FORMAT "%8.2" /end CHARACTERISTIC
/begin CHARACTERISTIC Sig_lenu16PFltDIAScale_C "Skalierung Umrechnung SG->DIA" VALUE 0xC06B6 Kw_Wu16 7.999878 Fact 0.00 7.999878 FORMAT "%8.6" /end CHARACTERISTIC
/begin CHARACTERISTIC Sig_lenDSMOffset_C "Offset für Umrechnung ecu -> dsm" VALUE 0xC06B8 Kw_Ws16 65535.00 OneToOne -32768.00 32767.00 FORMAT "%8.2" /end CHARACTERISTIC
/begin CHARACTERISTIC Sig_lenDSMScale_C "Skalierung für Umrechnung -> dsm" VALUE 0xC06BA Kw_Wu16 7.999878 Fact 0.00 7.999878 FORMAT "%8.6" /end CHARACTERISTIC
/begin CHARACTERISTIC Sig_lenCANOffset_C "Offset für Umrechnung ecu -> can" VALUE 0xC06BC Kw_Ws16 65535.00 OneToOne -32768.00 32767.00 FORMAT "%8.2" /end CHARACTERISTIC
/begin CHARACTERISTIC Sig_lenCANScale_C "Skalierung für Umrechnung ecu -> can" VALUE 0xC06BE Kw_Wu16 7.999878 Fact 0.00 7.999878 FORMAT "%8.6" /end CHARACTERISTIC
/begin CHARACTERISTIC Sig_lenDIAOffset_C "Offset für Umrechnung ecu -> dia" VALUE 0xC06C0 Kw_Ws16 65535.00 OneToOne -32768.00 32767.00 FORMAT "%8.2" /end CHARACTERISTIC
/begin CHARACTERISTIC Sig_lenDIAScale_C "Skalierung für Umrechnung ecu -> dia" VALUE 0xC06C2 Kw_Wu16 7.999878 Fact 0.00 7.999878 FORMAT "%8.6" /end CHARACTERISTIC
/begin CHARACTERISTIC Sig_lDSMOffset_C "Offset Umrechnung SG -> DSM" VALUE 0xC06C4 Kw_Ws16 65535.00 OneToOne -32768.00 32767.00 FORMAT "%8.2" /end CHARACTERISTIC
/begin CHARACTERISTIC Sig_lDSMScale_C "Skalierung Umrechnung SG -> DSM" VALUE 0xC06C6 Kw_Wu16 7.999878 Fact 0.00 7.999878 FORMAT "%8.6" /end CHARACTERISTIC
/begin CHARACTERISTIC Sig_lCANOffset_C "Offset Umrechnung SG -> CAN" VALUE 0xC06C8 Kw_Ws16 65535.00 OneToOne -32768.00 32767.00 FORMAT "%8.2" /end CHARACTERISTIC
/begin CHARACTERISTIC Sig_lCANScale_C "Skalierung Umrechnung SG -> CAN" VALUE 0xC06CA Kw_Wu16 7.999878 Fact 0.00 7.999878 FORMAT "%8.6" /end CHARACTERISTIC
/begin CHARACTERISTIC Sig_lDIAOffset_C "Offset Umrechnung SG -> DIA" VALUE 0xC06CC Kw_Ws16 65535.00 OneToOne -32768.00 32767.00 FORMAT "%8.2" /end CHARACTERISTIC
/begin CHARACTERISTIC Sig_lDIAScale_C "Skalierung Umrechnung SG -> DIA" VALUE 0xC06CE Kw_Wu16 7.999878 Fact 0.00 7.999878 FORMAT "%8.6" /end CHARACTERISTIC
/begin CHARACTERISTIC Sig_mAirCylDSMOffset_C "Offset Umrechung SG->DSM für Luftmasse pro Zylinder" VALUE 0xC06D0 Kw_Ws16 65535.00 OneToOne -32768.00 32767.00 FORMAT "%8.2" /end CHARACTERISTIC
/begin CHARACTERISTIC Sig_mAirCylDSMScale_C "Skalierung Umrechung SG->DSM für Luftmasse pro Zylinder" VALUE 0xC06D2 Kw_Wu16 7.999878 Fact 0.00 7.999878 FORMAT "%8.6" /end CHARACTERISTIC
/begin CHARACTERISTIC Sig_mAirCylCANOffset_C "Offset Umrechung SG->CAN für Luftmasse pro Zylinder" VALUE 0xC06D4 Kw_Ws16 65535.00 OneToOne -32768.00 32767.00 FORMAT "%8.2" /end CHARACTERISTIC
/begin CHARACTERISTIC Sig_mAirCylCANScale_C "Skalierung Umrechung SG->CAN für Luftmasse pro Zylinder" VALUE 0xC06D6 Kw_Wu16 7.999878 Fact 0.00 7.999878 FORMAT "%8.6" /end CHARACTERISTIC
/begin CHARACTERISTIC Sig_mAirCylDIAOffset_C "Offset Umrechung SG->Diagnoseschnittstelle für Luftmasse pro Zylinder" VALUE 0xC06D8 Kw_Ws16 65535.00 OneToOne -32768.00 32767.00 FORMAT "%8.2" /end CHARACTERISTIC
/begin CHARACTERISTIC Sig_mAirCylDIAScale_C "Skalierung Umrechung SG->Diagnoseschnittstelle für Luftmasse pro Zylinder" VALUE 0xC06DA Kw_Wu16 7.999878 Fact 0.00 7.999878 FORMAT "%8.6" /end CHARACTERISTIC
/begin CHARACTERISTIC Sig_mAirTimDSMOffset_C "Offset Umrechung SG->DSM für Luftmasse pro Zeiteinheit" VALUE 0xC06DC Kw_Ws16 65535.00 OneToOne -32768.00 32767.00 FORMAT "%8.2" /end CHARACTERISTIC
/begin CHARACTERISTIC Sig_mAirTimDSMScale_C "Skalierung Umrechung SG->DSM für Luftmasse pro Zeiteinheit" VALUE 0xC06DE Kw_Wu16 7.999878 Fact 0.00 7.999878 FORMAT "%8.6" /end CHARACTERISTIC
/begin CHARACTERISTIC Sig_mAirTimCANOffset_C "Offset Umrechung SG->CAN für Luftmasse pro Zeiteinheit" VALUE 0xC06E0 Kw_Ws16 65535.00 OneToOne -32768.00 32767.00 FORMAT "%8.2" /end CHARACTERISTIC
/begin CHARACTERISTIC Sig_mAirTimCANScale_C "Skalierung Umrechung SG->CAN für Luftmasse pro Zeiteinheit" VALUE 0xC06E2 Kw_Wu16 7.999878 Fact 0.00 7.999878 FORMAT "%8.6" /end CHARACTERISTIC
/begin CHARACTERISTIC Sig_mAirTimDIAOffset_C "Offset Umrechung SG->Diagnoseschnittstelle für Luftmasse pro Zeiteinheit" VALUE 0xC06E4 Kw_Ws16 65535.00 OneToOne -32768.00 32767.00 FORMAT "%8.2" /end CHARACTERISTIC
/begin CHARACTERISTIC Sig_mAirTimDIAScale_C "Skalierung Umrechung SG->Diagnoseschnittstelle für Luftmasse pro Zeiteinheit" VALUE 0xC06E6 Kw_Wu16 7.999878 Fact 0.00 7.999878 FORMAT "%8.6" /end CHARACTERISTIC
/begin CHARACTERISTIC Sig_mSootTimDSMOffset_C "Offset Umrechnung SG -> DSM für Partikelmassenstrom" VALUE 0xC06E8 Kw_Ws16 65535.00 OneToOne -32768.00 32767.00 FORMAT "%8.2" /end CHARACTERISTIC
/begin CHARACTERISTIC Sig_mSootTimDSMScale_C "Skalierung Umrechnung SG -> DSM für Partikelmassenstrom" VALUE 0xC06EA Kw_Wu16 7.999878 Fact 0.00 7.999878 FORMAT "%8.6" /end CHARACTERISTIC
/begin CHARACTERISTIC Sig_mSootTimCANOffset_C "Offset Umrechnung SG -> CAN für Partikelmassenstrom" VALUE 0xC06EC Kw_Ws16 65535.00 OneToOne -32768.00 32767.00 FORMAT "%8.2" /end CHARACTERISTIC
/begin CHARACTERISTIC Sig_mSootTimCANScale_C "Skalierung Umrechnung SG -> CAN für Partikelmassenstrom" VALUE 0xC06EE Kw_Wu16 7.999878 Fact 0.00 7.999878 FORMAT "%8.6" /end CHARACTERISTIC
/begin CHARACTERISTIC Sig_mSootTimDIAOffset_C "Offset Umrechnung SG -> Diagnoseschnittstelle für Partikelmassenstrom" VALUE 0xC06F0 Kw_Ws16 65535.00 OneToOne -32768.00 32767.00 FORMAT "%8.2" /end CHARACTERISTIC
/begin CHARACTERISTIC Sig_mSootTimDIAScale_C "Skalierung Umrechnung SG -> Diagnoseschnittstelle für Partikelmassenstrom" VALUE 0xC06F2 Kw_Wu16 7.999878 Fact 0.00 7.999878 FORMAT "%8.6" /end CHARACTERISTIC
/begin CHARACTERISTIC Sig_mSootDSMOffset_C "Offset Umrechung SG->DSM für Masse (Partikelfilter)" VALUE 0xC06F4 Kw_Ws16 65535.00 OneToOne -32768.00 32767.00 FORMAT "%8.2" /end CHARACTERISTIC
/begin CHARACTERISTIC Sig_mSootDSMScale_C "Skalierung Umrechung SG->DSM für Masse (Partikelfilter)" VALUE 0xC06F6 Kw_Wu16 7.999878 Fact 0.00 7.999878 FORMAT "%8.6" /end CHARACTERISTIC
/begin CHARACTERISTIC Sig_mSootCANOffset_C "Offset Umrechung SG->CAN für Masse (Partikelfilter)" VALUE 0xC06F8 Kw_Ws16 65535.00 OneToOne -32768.00 32767.00 FORMAT "%8.2" /end CHARACTERISTIC
/begin CHARACTERISTIC Sig_mSootCANScale_C "Skalierung Umrechung SG->CAN für Masse (Partikelfilter)" VALUE 0xC06FA Kw_Wu16 7.999878 Fact 0.00 7.999878 FORMAT "%8.6" /end CHARACTERISTIC
/begin CHARACTERISTIC Sig_mSootDIAOffset_C "Offset Umrechung SG->Diagnoseschnittstelle für Masse (Partikelfilter)" VALUE 0xC06FC Kw_Ws16 65535.00 OneToOne -32768.00 32767.00 FORMAT "%8.2" /end CHARACTERISTIC
/begin CHARACTERISTIC Sig_mSootDIAScale_C "Skalierung Umrechung SG->Diagnoseschnittstelle für Masse (Partikelfilter)" VALUE 0xC06FE Kw_Wu16 7.999878 Fact 0.00 7.999878 FORMAT "%8.6" /end CHARACTERISTIC
/begin CHARACTERISTIC Sig_nPSPDSMOffset_C "Offset Umrechnung SG <-> DSM für PSP Drehzahl" VALUE 0xC0700 Kw_Ws16 65535.00 OneToOne -32768.00 32767.00 FORMAT "%8.2" /end CHARACTERISTIC
/begin CHARACTERISTIC Sig_nPSPDSMScale_C "Skalierung Umrechnung SG <-> DSM für PSP Drehzahl" VALUE 0xC0702 Kw_Wu16 7.999878 Fact 0.00 7.999878 FORMAT "%8.6" /end CHARACTERISTIC
/begin CHARACTERISTIC Sig_nPSPCANOffset_C "offset for conversion ecu <-> can for PSP speed values" VALUE 0xC0704 Kw_Ws16 65535.00 OneToOne -32768.00 32767.00 FORMAT "%8.2" /end CHARACTERISTIC
/begin CHARACTERISTIC Sig_nPSPCANScale_C "Skalierung Umrechnung SG <-> CAN für PSP-Drehzahl" VALUE 0xC0706 Kw_Wu16 7.999878 Fact 0.00 7.999878 FORMAT "%8.6" /end CHARACTERISTIC
/begin CHARACTERISTIC Sig_nPSPDIAOffset_C "Offset Umrechnung SG <-> Diagnose für PSP Drehzahl" VALUE 0xC0708 Kw_Ws16 65535.00 OneToOne -32768.00 32767.00 FORMAT "%8.2" /end CHARACTERISTIC
/begin CHARACTERISTIC Sig_nPSPDIAScale_C "Skalierung Umrechnung SG <-> Diagnose für PSP-Drehzahl" VALUE 0xC070A Kw_Wu16 7.999878 Fact 0.00 7.999878 FORMAT "%8.6" /end CHARACTERISTIC
/begin CHARACTERISTIC Sig_nDSMOffset_C "Offset Umrechung SG->DSM für Drehzahlsignale" VALUE 0xC070C Kw_Ws16 65535.00 OneToOne -32768.00 32767.00 FORMAT "%8.2" /end CHARACTERISTIC
/begin CHARACTERISTIC Sig_nDSMScale_C "Skalierung Umrechung SG->DSM für Drehzahlsignale" VALUE 0xC070E Kw_Wu16 7.999878 Fact 0.00 7.999878 FORMAT "%8.6" /end CHARACTERISTIC
/begin CHARACTERISTIC Sig_nCANOffset_C "Offset Umrechung SG<->CAN für Drehzahlsignale" VALUE 0xC0710 Kw_Ws16 65535.00 OneToOne -32768.00 32767.00 FORMAT "%8.2" /end CHARACTERISTIC
/begin CHARACTERISTIC Sig_nCANScale_C "Skalierung Umrechung SG->CAN für Drehzahlsignale" VALUE 0xC0712 Kw_Wu16 7.999878 Fact 0.00 7.999878 FORMAT "%8.6" /end CHARACTERISTIC
/begin CHARACTERISTIC Sig_nDIAOffset_C "Offset Umrechung SG->DIA für Drehzahlsignale" VALUE 0xC0714 Kw_Ws16 65535.00 OneToOne -32768.00 32767.00 FORMAT "%8.2" /end CHARACTERISTIC
/begin CHARACTERISTIC Sig_nDIAScale_C "Skalierung Umrechung SG->DIA für Drehzahlsignale" VALUE 0xC0716 Kw_Wu16 7.999878 Fact 0.00 7.999878 FORMAT "%8.6" /end CHARACTERISTIC
/begin CHARACTERISTIC Sig_OneToOneDSMOffset_C "Offset Umrechung SG->DSM" VALUE 0xC0718 Kw_Ws16 65535.00 OneToOne -32768.00 32767.00 FORMAT "%8.2" /end CHARACTERISTIC
/begin CHARACTERISTIC Sig_OneToOneDSMScale_C "Skalierung Umrechung SG->DSM" VALUE 0xC071A Kw_Wu16 7.999878 Fact 0.00 7.999878 FORMAT "%8.6" /end CHARACTERISTIC
/begin CHARACTERISTIC Sig_OneToOneCANOffset_C "Offset Umrechung SG->CAN" VALUE 0xC071C Kw_Ws16 65535.00 OneToOne -32768.00 32767.00 FORMAT "%8.2" /end CHARACTERISTIC
/begin CHARACTERISTIC Sig_OneToOneCANScale_C "Skalierung Umrechung SG->CAN" VALUE 0xC071E Kw_Wu16 7.999878 Fact 0.00 7.999878 FORMAT "%8.6" /end CHARACTERISTIC
/begin CHARACTERISTIC Sig_OneToOneDIAOffset_C "Offset Umrechung SG->DIA" VALUE 0xC0720 Kw_Ws16 65535.00 OneToOne -32768.00 32767.00 FORMAT "%8.2" /end CHARACTERISTIC
/begin CHARACTERISTIC Sig_OneToOneDIAScale_C "Skalierung Umrechung SG->DIA" VALUE 0xC0722 Kw_Wu16 7.999878 Fact 0.00 7.999878 FORMAT "%8.6" /end CHARACTERISTIC
/begin CHARACTERISTIC Sig_OnOffDSMOffset_C "Offset Umrechung SG->DSM für Digitalsignale" VALUE 0xC0724 Kw_Ws16 65535.00 OneToOne -32768.00 32767.00 FORMAT "%8.2" /end CHARACTERISTIC
/begin CHARACTERISTIC Sig_OnOffDSMScale_C "Skalierung Umrechung SG->DSM für Digitalsignale" VALUE 0xC0726 Kw_Wu16 7.999878 Fact 0.00 7.999878 FORMAT "%8.6" /end CHARACTERISTIC
/begin CHARACTERISTIC Sig_OnOffCANOffset_C "Offset Umrechung SG->CAN für Digitalsignale" VALUE 0xC0728 Kw_Ws16 65535.00 OneToOne -32768.00 32767.00 FORMAT "%8.2" /end CHARACTERISTIC
/begin CHARACTERISTIC Sig_OnOffCANScale_C "Skalierung Umrechung SG->CAN für Digitalsignale" VALUE 0xC072A Kw_Wu16 7.999878 Fact 0.00 7.999878 FORMAT "%8.6" /end CHARACTERISTIC
/begin CHARACTERISTIC Sig_OnOffDIAOffset_C "Offset Umrechung SG->DIA für Digitalsignale" VALUE 0xC072C Kw_Ws16 65535.00 OneToOne -32768.00 32767.00 FORMAT "%8.2" /end CHARACTERISTIC
/begin CHARACTERISTIC Sig_OnOffDIAScale_C "Skalierung Umrechung SG->DIA für Digitalsignale" VALUE 0xC072E Kw_Wu16 7.999878 Fact 0.00 7.999878 FORMAT "%8.6" /end CHARACTERISTIC
/begin CHARACTERISTIC Sig_pkPaDSMOffset_C "Offset Umrechnung SG -> DSM für Druck in kPa" VALUE 0xC0730 Kw_Ws16 65535.00 OneToOne -32768.00 32767.00 FORMAT "%8.2" /end CHARACTERISTIC
/begin CHARACTERISTIC Sig_pkPaDSMScale_C "Skalierung Umrechnung SG -> DSM für Druck in kPa" VALUE 0xC0732 Kw_Wu16 7.999878 Fact 0.00 7.999878 FORMAT "%8.6" /end CHARACTERISTIC
/begin CHARACTERISTIC Sig_pkPaCANOffset_C "Offset Umrechnung SG -> CAN für Druck in kPa" VALUE 0xC0734 Kw_Ws16 65535.00 OneToOne -32768.00 32767.00 FORMAT "%8.2" /end CHARACTERISTIC
/begin CHARACTERISTIC Sig_pkPaCANScale_C "Skalierung Umrechnung SG -> CAN für Druck in kPa" VALUE 0xC0736 Kw_Wu16 7.999878 Fact 0.00 7.999878 FORMAT "%8.6" /end CHARACTERISTIC
/begin CHARACTERISTIC Sig_pkPaDIAOffset_C "Offset Umrechnung SG -> Diagnoseschnittstelle für Druck in kPa" VALUE 0xC0738 Kw_Ws16 65535.00 OneToOne -32768.00 32767.00 FORMAT "%8.2" /end CHARACTERISTIC
/begin CHARACTERISTIC Sig_pkPaDIAScale_C "Skalierung Umrechnung SG -> Diagnoseschnittstelle für Druck in kPa" VALUE 0xC073A Kw_Wu16 7.999878 Fact 0.00 7.999878 FORMAT "%8.6" /end CHARACTERISTIC
/begin CHARACTERISTIC Sig_pRailDSMOffset_C "offset für Umrechnung ecu -> dsm" VALUE 0xC073C Kw_Ws16 65535.00 OneToOne -32768.00 32767.00 FORMAT "%8.2" /end CHARACTERISTIC
/begin CHARACTERISTIC Sig_pRailDSMScale_C "Skalierung für Umrechnung ecu -> dsm" VALUE 0xC073E Kw_Wu16 7.999878 Fact 0.00 7.999878 FORMAT "%8.6" /end CHARACTERISTIC
/begin CHARACTERISTIC Sig_pRailCANOffset_C "Offset für Umrechnung ecu -> can" VALUE 0xC0740 Kw_Ws16 65535.00 OneToOne -32768.00 32767.00 FORMAT "%8.2" /end CHARACTERISTIC
/begin CHARACTERISTIC Sig_pRailCANScale_C "Skalierung für Umrechnung ecu -> can" VALUE 0xC0742 Kw_Wu16 7.999878 Fact 0.00 7.999878 FORMAT "%8.6" /end CHARACTERISTIC
/begin CHARACTERISTIC Sig_pRailDIAOffset_C "Offset für Umrechnung ecu -> dia" VALUE 0xC0744 Kw_Ws16 65535.00 OneToOne -32768.00 32767.00 FORMAT "%8.2" /end CHARACTERISTIC
/begin CHARACTERISTIC Sig_pRailDIAScale_C "Skalierung für Umrechnung ecu -> dia" VALUE 0xC0746 Kw_Wu16 7.999878 Fact 0.00 7.999878 FORMAT "%8.6" /end CHARACTERISTIC
/begin CHARACTERISTIC Sig_pDSMOffset_C "Offset Umrechung SG->DSM für Druck" VALUE 0xC0748 Kw_Ws16 65535.00 OneToOne -32768.00 32767.00 FORMAT "%8.2" /end CHARACTERISTIC
/begin CHARACTERISTIC Sig_pDSMScale_C "Skalierung Umrechung SG->DSM für Druck" VALUE 0xC074A Kw_Wu16 7.999878 Fact 0.00 7.999878 FORMAT "%8.6" /end CHARACTERISTIC
/begin CHARACTERISTIC Sig_pCANOffset_C "Offset Umrechung SG->CAN für Druck" VALUE 0xC074C Kw_Ws16 65535.00 OneToOne -32768.00 32767.00 FORMAT "%8.2" /end CHARACTERISTIC
/begin CHARACTERISTIC Sig_pCANScale_C "Skalierung Umrechung SG->CAN für Druck" VALUE 0xC074E Kw_Wu16 7.999878 Fact 0.00 7.999878 FORMAT "%8.6" /end CHARACTERISTIC
/begin CHARACTERISTIC Sig_pDIAOffset_C "Offset Umrechung SG->Diagnoseschnittstelle für Druck" VALUE 0xC0750 Kw_Ws16 65535.00 OneToOne -32768.00 32767.00 FORMAT "%8.2" /end CHARACTERISTIC
/begin CHARACTERISTIC Sig_pDIAScale_C "Skalierung Umrechung SG->Diagnoseschnittstelle für Druck" VALUE 0xC0752 Kw_Wu16 7.999878 Fact 0.00 7.999878 FORMAT "%8.6" /end CHARACTERISTIC
/begin CHARACTERISTIC Sig_qAvFineDSMOffset_C "Offset für Umrechnung SG->DSM für Additivvolumen" VALUE 0xC0754 Kw_Ws16 65535.00 OneToOne -32768.00 32767.00 FORMAT "%8.2" /end CHARACTERISTIC
/begin CHARACTERISTIC Sig_qAvFineDSMScale_C "Skalierung Umrechung SG->DSM für Additivvolumen" VALUE 0xC0756 Kw_Wu16 7.999878 Fact 0.00 7.999878 FORMAT "%8.6" /end CHARACTERISTIC
/begin CHARACTERISTIC Sig_qAvFineCANOffset_C "Offset für Umrechnung SG->CAN für Additivvolumen" VALUE 0xC0758 Kw_Ws16 65535.00 OneToOne -32768.00 32767.00 FORMAT "%8.2" /end CHARACTERISTIC
/begin CHARACTERISTIC Sig_qAvFineCANScale_C "Skalierung Umrechung SG->CAN für Additivvolumen" VALUE 0xC075A Kw_Wu16 7.999878 Fact 0.00 7.999878 FORMAT "%8.6" /end CHARACTERISTIC
/begin CHARACTERISTIC Sig_qAvFineDIAOffset_C "Offset für Umrechnung SG->Diagnoseschnittstelle für Additivvolumen" VALUE 0xC075C Kw_Ws16 65535.00 OneToOne -32768.00 32767.00 FORMAT "%8.2" /end CHARACTERISTIC
/begin CHARACTERISTIC Sig_qAvFineDIAScale_C "Skalierung Umrechung SG->Diagnoseschnittstelle für Additivvolumen" VALUE 0xC075E Kw_Wu16 7.999878 Fact 0.00 7.999878 FORMAT "%8.6" /end CHARACTERISTIC
/begin CHARACTERISTIC Sig_qAvDSMOffset_C "Offset für Umrechnung ecu -> dsm" VALUE 0xC0760 Kw_Ws16 65535.00 OneToOne -32768.00 32767.00 FORMAT "%8.2" /end CHARACTERISTIC
/begin CHARACTERISTIC Sig_qAvDSMScale_C "Skalierung für Umrechnung ecu -> dsm" VALUE 0xC0762 Kw_Wu16 7.999878 Fact 0.00 7.999878 FORMAT "%8.6" /end CHARACTERISTIC
/begin CHARACTERISTIC Sig_qAvCANOffset_C "Offset für Umrechnung ecu -> can" VALUE 0xC0764 Kw_Ws16 65535.00 OneToOne -32768.00 32767.00 FORMAT "%8.2" /end CHARACTERISTIC
/begin CHARACTERISTIC Sig_qAvCANScale_C "Skalierung für Umrechnung ecu -> can" VALUE 0xC0766 Kw_Wu16 7.999878 Fact 0.00 7.999878 FORMAT "%8.6" /end CHARACTERISTIC
/begin CHARACTERISTIC Sig_qAvDIAOffset_C "Offset für Umrechnung ecu -> dia" VALUE 0xC0768 Kw_Ws16 65535.00 OneToOne -32768.00 32767.00 FORMAT "%8.2" /end CHARACTERISTIC
/begin CHARACTERISTIC Sig_qAvDIAScale_C "Skalierung für Umrechnung ecu -> dia" VALUE 0xC076A Kw_Wu16 7.999878 Fact 0.00 7.999878 FORMAT "%8.6" /end CHARACTERISTIC
/begin CHARACTERISTIC Sig_qInjMassDSMOffset_C "Offset für Umrechnung ecu -> dsm" VALUE 0xC076C Kw_Ws16 65535.00 OneToOne -32768.00 32767.00 FORMAT "%8.2" /end CHARACTERISTIC
/begin CHARACTERISTIC Sig_qInjMassDSMScale_C "Skalierung für Umrechnung ecu -> dsm" VALUE 0xC076E Kw_Wu16 7.999878 Fact 0.00 7.999878 FORMAT "%8.6" /end CHARACTERISTIC
/begin CHARACTERISTIC Sig_qInjMassCANOffset_C "Offset für Umrechnung ecu -> can" VALUE 0xC0770 Kw_Ws16 65535.00 OneToOne -32768.00 32767.00 FORMAT "%8.2" /end CHARACTERISTIC
/begin CHARACTERISTIC Sig_qInjMassCANScale_C "Skalierung für Umrechnung ecu -> can" VALUE 0xC0772 Kw_Wu16 7.999878 Fact 0.00 7.999878 FORMAT "%8.6" /end CHARACTERISTIC
/begin CHARACTERISTIC Sig_qInjMassDIAOffset_C "Offset für Umrechnung ecu -> dia" VALUE 0xC0774 Kw_Ws16 65535.00 OneToOne -32768.00 32767.00 FORMAT "%8.2" /end CHARACTERISTIC
/begin CHARACTERISTIC Sig_qInjMassDIAScale_C "Skalierung für Umrechnung ecu -> dia" VALUE 0xC0776 Kw_Wu16 7.999878 Fact 0.00 7.999878 FORMAT "%8.6" /end CHARACTERISTIC
/begin CHARACTERISTIC Sig_qDSMOffset_C "Offset fuer Umrechung SG->DSM fuer Menge" VALUE 0xC0778 Kw_Ws16 65535.00 OneToOne -32768.00 32767.00 FORMAT "%8.2" /end CHARACTERISTIC
/begin CHARACTERISTIC Sig_qDSMScale_C "Skalierung Umrechungs Faktor SG->DSM fuer Menge" VALUE 0xC077A Kw_Wu16 7.999878 Fact 0.00 7.999878 FORMAT "%8.6" /end CHARACTERISTIC
/begin CHARACTERISTIC Sig_qCANOffset_C "Offset fuer Umrechung SG->CAN fuer Menge" VALUE 0xC077C Kw_Ws16 65535.00 OneToOne -32768.00 32767.00 FORMAT "%8.2" /end CHARACTERISTIC
/begin CHARACTERISTIC Sig_qCANScale_C "Skalierung Umrechungs Faktor SG->CAN fuer Menge" VALUE 0xC077E Kw_Wu16 7.999878 Fact 0.00 7.999878 FORMAT "%8.6" /end CHARACTERISTIC
/begin CHARACTERISTIC Sig_qDIAOffset_C "Offset fuer Umrechung SG->DIA fuer Menge" VALUE 0xC0780 Kw_Ws16 65535.00 OneToOne -32768.00 32767.00 FORMAT "%8.2" /end CHARACTERISTIC
/begin CHARACTERISTIC Sig_qDIAScale_C "Skalierung Umrechungs Faktor SG->DIA fuer Menge" VALUE 0xC0782 Kw_Wu16 7.999878 Fact 0.00 7.999878 FORMAT "%8.6" /end CHARACTERISTIC
/begin CHARACTERISTIC Sig_resFlowDSMOffset_C "Offset Umrechung SG->DSM für Strömungswiderstand" VALUE 0xC0784 Kw_Ws16 65535.00 OneToOne -32768.00 32767.00 FORMAT "%8.2" /end CHARACTERISTIC
/begin CHARACTERISTIC Sig_resFlowDSMScale_C "Skalierung Umrechung SG->DSM für Strömungswiderstand" VALUE 0xC0786 Kw_Wu16 7.999878 Fact 0.00 7.999878 FORMAT "%8.6" /end CHARACTERISTIC
/begin CHARACTERISTIC Sig_resFlowCANOffset_C "Offset Umrechung SG->CAN für Strömungswiderstand" VALUE 0xC0788 Kw_Ws16 65535.00 OneToOne -32768.00 32767.00 FORMAT "%8.2" /end CHARACTERISTIC
/begin CHARACTERISTIC Sig_resFlowCANScale_C "Skalierung Umrechung SG->CAN für Strömungswiderstand" VALUE 0xC078A Kw_Wu16 7.999878 Fact 0.00 7.999878 FORMAT "%8.6" /end CHARACTERISTIC
/begin CHARACTERISTIC Sig_resFlowDIAOffset_C "Offset Umrechung SG->Diagnoseschnittstelle für Strömungswiderstand" VALUE 0xC078C Kw_Ws16 65535.00 OneToOne -32768.00 32767.00 FORMAT "%8.2" /end CHARACTERISTIC
/begin CHARACTERISTIC Sig_resFlowDIAScale_C "Skalierung Umrechung SG->Diagnoseschnittstelle für Strömungswiderstand" VALUE 0xC078E Kw_Wu16 7.999878 Fact 0.00 7.999878 FORMAT "%8.6" /end CHARACTERISTIC
/begin CHARACTERISTIC Sig_rVnDSMOffset_C "Offset für Umrechnung ecu -> dsm" VALUE 0xC0790 Kw_Ws16 65535.00 OneToOne -32768.00 32767.00 FORMAT "%8.2" /end CHARACTERISTIC
/begin CHARACTERISTIC Sig_rVnDSMScale_C "Skalierung für Umrechnung ecu -> dsm" VALUE 0xC0792 Kw_Wu16 7.999878 Fact 0.00 7.999878 FORMAT "%8.6" /end CHARACTERISTIC
/begin CHARACTERISTIC Sig_rVnCANOffset_C "Offset für Umrechnung ecu -> can" VALUE 0xC0794 Kw_Ws16 65535.00 OneToOne -32768.00 32767.00 FORMAT "%8.2" /end CHARACTERISTIC
/begin CHARACTERISTIC Sig_rVnCANScale_C "Skalierung für Umrechnung ecu -> can" VALUE 0xC0796 Kw_Wu16 7.999878 Fact 0.00 7.999878 FORMAT "%8.6" /end CHARACTERISTIC
/begin CHARACTERISTIC Sig_rVnDIAOffset_C "Offset für Umrechnung ecu -> dia" VALUE 0xC0798 Kw_Ws16 65535.00 OneToOne -32768.00 32767.00 FORMAT "%8.2" /end CHARACTERISTIC
/begin CHARACTERISTIC Sig_rVnDIAScale_C "Skalierung für Umrechnung ecu -> dia" VALUE 0xC079A Kw_Wu16 7.999878 Fact 0.00 7.999878 FORMAT "%8.6" /end CHARACTERISTIC
/begin CHARACTERISTIC Sig_rDSMOffset_C "Offset Umrechung SG->DSM für Verhältnisse" VALUE 0xC079C Kw_Ws16 65535.00 OneToOne -32768.00 32767.00 FORMAT "%8.2" /end CHARACTERISTIC
/begin CHARACTERISTIC Sig_rDSMScale_C "Skalierung Umrechung SG->DSM für Verhältnisse" VALUE 0xC079E Kw_Wu16 7.999878 Fact 0.00 7.999878 FORMAT "%8.6" /end CHARACTERISTIC
/begin CHARACTERISTIC Sig_rCANOffset_C "Offset Umrechung SG->CAN für Verhältnisse" VALUE 0xC07A0 Kw_Ws16 65535.00 OneToOne -32768.00 32767.00 FORMAT "%8.2" /end CHARACTERISTIC
/begin CHARACTERISTIC Sig_rCANScale_C "Skalierung Umrechung SG->CAN für Verhältnisse" VALUE 0xC07A2 Kw_Wu16 7.999878 Fact 0.00 7.999878 FORMAT "%8.6" /end CHARACTERISTIC
/begin CHARACTERISTIC Sig_rDIAOffset_C "Offset Umrechung SG->Diagnoseschnittstelle für Verhältnisse" VALUE 0xC07A4 Kw_Ws16 65535.00 OneToOne -32768.00 32767.00 FORMAT "%8.2" /end CHARACTERISTIC
/begin CHARACTERISTIC Sig_rDIAScale_C "Skalierung Umrechung SG->Diagnoseschnittstelle für Verhältnisse" VALUE 0xC07A6 Kw_Wu16 7.999878 Fact 0.00 7.999878 FORMAT "%8.6" /end CHARACTERISTIC
/begin CHARACTERISTIC Sig_stHH16DSMOffset_C "DSM High-Byte Offset" VALUE 0xC07A8 Kw_Ws16 65535.00 OneToOne -32768.00 32767.00 FORMAT "%8.2" /end CHARACTERISTIC
/begin CHARACTERISTIC Sig_stHH16DSMScale_C "DSM High-Byte Scale" VALUE 0xC07AA Kw_Wu16 7.999878 Fact 0.00 7.999878 FORMAT "%8.6" /end CHARACTERISTIC
/begin CHARACTERISTIC Sig_stHH16CANOffset_C "CAN High-Byte Offset" VALUE 0xC07AC Kw_Ws16 65535.00 OneToOne -32768.00 32767.00 FORMAT "%8.2" /end CHARACTERISTIC
/begin CHARACTERISTIC Sig_stHH16CANScale_C "CAN High-Byte Scale" VALUE 0xC07AE Kw_Wu16 7.999878 Fact 0.00 7.999878 FORMAT "%8.6" /end CHARACTERISTIC
/begin CHARACTERISTIC Sig_stHH16DIAOffset_C "DIA High-Byte Offset" VALUE 0xC07B0 Kw_Ws16 65535.00 OneToOne -32768.00 32767.00 FORMAT "%8.2" /end CHARACTERISTIC
/begin CHARACTERISTIC Sig_stHH16DIAScale_C "DIA High-Byte Scale" VALUE 0xC07B2 Kw_Wu16 7.999878 Fact 0.00 7.999878 FORMAT "%8.6" /end CHARACTERISTIC
/begin CHARACTERISTIC Sig_stLL16DSMOffset_C "DSM LOW-Byte Offset" VALUE 0xC07B4 Kw_Ws16 65535.00 OneToOne -32768.00 32767.00 FORMAT "%8.2" /end CHARACTERISTIC
/begin CHARACTERISTIC Sig_stLL16DSMScale_C "DSM Low-Byte Scale" VALUE 0xC07B6 Kw_Wu16 7.999878 Fact 0.00 7.999878 FORMAT "%8.6" /end CHARACTERISTIC
/begin CHARACTERISTIC Sig_stLL16CANOffset_C "CAN Low-Byte Offset" VALUE 0xC07B8 Kw_Ws16 65535.00 OneToOne -32768.00 32767.00 FORMAT "%8.2" /end CHARACTERISTIC
/begin CHARACTERISTIC Sig_stLL16CANScale_C "CAN Low-Byte Scale" VALUE 0xC07BA Kw_Wu16 7.999878 Fact 0.00 7.999878 FORMAT "%8.6" /end CHARACTERISTIC
/begin CHARACTERISTIC Sig_stLL16DIAOffset_C "DIA Low-Byte Offset" VALUE 0xC07BC Kw_Ws16 65535.00 OneToOne -32768.00 32767.00 FORMAT "%8.2" /end CHARACTERISTIC
/begin CHARACTERISTIC Sig_stLL16DIAScale_C "DIA Low-Byte Scale" VALUE 0xC07BE Kw_Wu16 7.999878 Fact 0.00 7.999878 FORMAT "%8.6" /end CHARACTERISTIC
/begin CHARACTERISTIC Sig_tExhaustgasDSMOffset_C "" VALUE 0xC07C0 Kw_Ws16 65535.00 OneToOne -32768.00 32767.00 FORMAT "%8.2" /end CHARACTERISTIC
/begin CHARACTERISTIC Sig_tExhaustgasDSMScale_C "" VALUE 0xC07C2 Kw_Wu16 7.999878 Fact 0.00 7.999878 FORMAT "%8.6" /end CHARACTERISTIC
/begin CHARACTERISTIC Sig_tExhaustgasCANOffset_C "" VALUE 0xC07C4 Kw_Ws16 65535.00 OneToOne -32768.00 32767.00 FORMAT "%8.2" /end CHARACTERISTIC
/begin CHARACTERISTIC Sig_tExhaustgasCANScale_C "" VALUE 0xC07C6 Kw_Wu16 7.999878 Fact 0.00 7.999878 FORMAT "%8.6" /end CHARACTERISTIC
/begin CHARACTERISTIC Sig_tExhaustgasDIAOffset_C "" VALUE 0xC07C8 Kw_Ws16 65535.00 OneToOne -32768.00 32767.00 FORMAT "%8.2" /end CHARACTERISTIC
/begin CHARACTERISTIC Sig_tExhaustgasDIAScale_C "" VALUE 0xC07CA Kw_Wu16 7.999878 Fact 0.00 7.999878 FORMAT "%8.6" /end CHARACTERISTIC
/begin CHARACTERISTIC Sig_timEngDSMOffset_C "Offset für Umrechnung ecu -> dsm" VALUE 0xC07CC Kw_Ws16 65535.00 OneToOne -32768.00 32767.00 FORMAT "%8.2" /end CHARACTERISTIC
/begin CHARACTERISTIC Sig_timEngDSMScale_C "Skalierung für Umrechnung ecu -> dsm" VALUE 0xC07CE Kw_Wu16 7.999878 Fact 0.00 7.999878 FORMAT "%8.6" /end CHARACTERISTIC
/begin CHARACTERISTIC Sig_timEngCANOffset_C "Offset für Umrechnung ecu -> can" VALUE 0xC07D0 Kw_Ws16 65535.00 OneToOne -32768.00 32767.00 FORMAT "%8.2" /end CHARACTERISTIC
/begin CHARACTERISTIC Sig_timEngCANScale_C "Skalierung für Umrechnung ecu -> can" VALUE 0xC07D2 Kw_Wu16 7.999878 Fact 0.00 7.999878 FORMAT "%8.6" /end CHARACTERISTIC
/begin CHARACTERISTIC Sig_timEngDIAOffset_C "Offset für Umrechnung ecu -> dia" VALUE 0xC07D4 Kw_Ws16 65535.00 OneToOne -32768.00 32767.00 FORMAT "%8.2" /end CHARACTERISTIC
/begin CHARACTERISTIC Sig_timEngDIAScale_C "Skalierung für Umrechnung ecu -> dia" VALUE 0xC07D6 Kw_Wu16 7.999878 Fact 0.00 7.999878 FORMAT "%8.6" /end CHARACTERISTIC
/begin CHARACTERISTIC Sig_Time_PwmHighDSMOffset_C "Offset für Umrechnung SG -> DSM" VALUE 0xC07D8 Kw_Ws16 65535.00 OneToOne -32768.00 32767.00 FORMAT "%8.2" /end CHARACTERISTIC
/begin CHARACTERISTIC Sig_Time_PwmHighDSMScale_C "Offset für Umrechnung SG -> DSM" VALUE 0xC07DA Kw_Wu16 7.999878 Fact 0.00 7.999878 FORMAT "%8.6" /end CHARACTERISTIC
/begin CHARACTERISTIC Sig_Time_PwmHighCANOffset_C "Offset für Umrechnung SG -> CAN" VALUE 0xC07DC Kw_Ws16 65535.00 OneToOne -32768.00 32767.00 FORMAT "%8.2" /end CHARACTERISTIC
/begin CHARACTERISTIC Sig_Time_PwmHighCANScale_C "Skalierung Umrechnungsfaktor SG -> CAN" VALUE 0xC07DE Kw_Wu16 7.999878 Fact 0.00 7.999878 FORMAT "%8.6" /end CHARACTERISTIC
/begin CHARACTERISTIC Sig_Time_PwmHighDIAOffset_C "Offset für Umrechnung SG -> Diagnoseschnittstelle" VALUE 0xC07E0 Kw_Ws16 65535.00 OneToOne -32768.00 32767.00 FORMAT "%8.2" /end CHARACTERISTIC
/begin CHARACTERISTIC Sig_Time_PwmHighDIAScale_C "Skalierung Umrechnungsfaktor SG -> Diagnoseschnittstelle" VALUE 0xC07E2 Kw_Wu16 7.999878 Fact 0.00 7.999878 FORMAT "%8.6" /end CHARACTERISTIC
/begin CHARACTERISTIC Sig_timsDSMOffset_C "offset for conversion ecu -> dsm" VALUE 0xC07E4 Kw_Ws16 65535.00 OneToOne -32768.00 32767.00 FORMAT "%8.2" /end CHARACTERISTIC
/begin CHARACTERISTIC Sig_timsDSMScale_C "scale factor for conversion from ecu -> dsm" VALUE 0xC07E6 Kw_Wu16 7.999878 Fact 0.00 7.999878 FORMAT "%8.6" /end CHARACTERISTIC
/begin CHARACTERISTIC Sig_timsCANOffset_C "offset for conversion from ecu -> can" VALUE 0xC07E8 Kw_Ws16 65535.00 OneToOne -32768.00 32767.00 FORMAT "%8.2" /end CHARACTERISTIC
/begin CHARACTERISTIC Sig_timsCANScale_C "scale factor for conversion from ecu -> can" VALUE 0xC07EA Kw_Wu16 7.999878 Fact 0.00 7.999878 FORMAT "%8.6" /end CHARACTERISTIC
/begin CHARACTERISTIC Sig_timsDIAOffset_C "offset for conversion from ecu -> dia" VALUE 0xC07EC Kw_Ws16 65535.00 OneToOne -32768.00 32767.00 FORMAT "%8.2" /end CHARACTERISTIC
/begin CHARACTERISTIC Sig_timsDIAScale_C "scale factor for conversion from ecu -> dia" VALUE 0xC07EE Kw_Wu16 7.999878 Fact 0.00 7.999878 FORMAT "%8.6" /end CHARACTERISTIC
/begin CHARACTERISTIC Sig_tiOprgnu16PFltDSMOffset_C "" VALUE 0xC07F0 Kw_Ws16 65535.00 OneToOne -32768.00 32767.00 FORMAT "%8.2" /end CHARACTERISTIC
/begin CHARACTERISTIC Sig_tiOprgnu16PFltDSMScale_C "Skalierung Umrechnung SG->DSM" VALUE 0xC07F2 Kw_Wu16 7.999878 Fact 0.00 7.999878 FORMAT "%8.6" /end CHARACTERISTIC
/begin CHARACTERISTIC Sig_tiOprgnu16PFltCANOffset_C "" VALUE 0xC07F4 Kw_Ws16 65535.00 OneToOne -32768.00 32767.00 FORMAT "%8.2" /end CHARACTERISTIC
/begin CHARACTERISTIC Sig_tiOprgnu16PFltCANScale_C "Skalierung Umrechnung SG->CAN" VALUE 0xC07F6 Kw_Wu16 7.999878 Fact 0.00 7.999878 FORMAT "%8.6" /end CHARACTERISTIC
/begin CHARACTERISTIC Sig_tiOprgnu16PFltDIAOffset_C "" VALUE 0xC07F8 Kw_Ws16 65535.00 OneToOne -32768.00 32767.00 FORMAT "%8.2" /end CHARACTERISTIC
/begin CHARACTERISTIC Sig_tiOprgnu16PFltDIAScale_C "Skalierung Umrechnung SG->DIA" VALUE 0xC07FA Kw_Wu16 7.999878 Fact 0.00 7.999878 FORMAT "%8.6" /end CHARACTERISTIC
/begin CHARACTERISTIC Sig_tiOpu16PFltDSMOffset_C "Offset Umrechnumg SG->DSM" VALUE 0xC07FC Kw_Ws16 65535.00 OneToOne -32768.00 32767.00 FORMAT "%8.2" /end CHARACTERISTIC
/begin CHARACTERISTIC Sig_tiOpu16PFltDSMScale_C "Skalierung Umrechnung SG->DSM" VALUE 0xC07FE Kw_Wu16 7.999878 Fact 0.00 7.999878 FORMAT "%8.6" /end CHARACTERISTIC
/begin CHARACTERISTIC Sig_tiOpu16PFltCANOffset_C "Offset Umrechnumg SG->CAN" VALUE 0xC0800 Kw_Ws16 65535.00 OneToOne -32768.00 32767.00 FORMAT "%8.2" /end CHARACTERISTIC
/begin CHARACTERISTIC Sig_tiOpu16PFltCANScale_C "Skalierung Umrechnung SG->CAN" VALUE 0xC0802 Kw_Wu16 7.999878 Fact 0.00 7.999878 FORMAT "%8.6" /end CHARACTERISTIC
/begin CHARACTERISTIC Sig_tiOpu16PFltDIAOffset_C "Offset Umrechnumg SG->DIA" VALUE 0xC0804 Kw_Ws16 65535.00 OneToOne -32768.00 32767.00 FORMAT "%8.2" /end CHARACTERISTIC
/begin CHARACTERISTIC Sig_tiOpu16PFltDIAScale_C "Skalierung Umrechnung SG->DIA" VALUE 0xC0806 Kw_Wu16 7.999878 Fact 0.00 7.999878 FORMAT "%8.6" /end CHARACTERISTIC
/begin CHARACTERISTIC Sig_tisDSMOffset_C "offset for conversion from ecu -> dsm" VALUE 0xC0808 Kw_Ws16 65535.00 OneToOne -32768.00 32767.00 FORMAT "%8.2" /end CHARACTERISTIC
/begin CHARACTERISTIC Sig_tisDSMScale_C " scale factor for conversion from ecu -> dsm" VALUE 0xC080A Kw_Wu16 7.999878 Fact 0.00 7.999878 FORMAT "%8.6" /end CHARACTERISTIC
/begin CHARACTERISTIC Sig_tisCANOffset_C "offset for conversion from ecu -> can" VALUE 0xC080C Kw_Ws16 65535.00 OneToOne -32768.00 32767.00 FORMAT "%8.2" /end CHARACTERISTIC
/begin CHARACTERISTIC Sig_tisCANScale_C "scale factor for conversion from ecu -> can" VALUE 0xC080E Kw_Wu16 7.999878 Fact 0.00 7.999878 FORMAT "%8.6" /end CHARACTERISTIC
/begin CHARACTERISTIC Sig_tisDIAOffset_C "offset for conversion from ecu -> dia" VALUE 0xC0810 Kw_Ws16 65535.00 OneToOne -32768.00 32767.00 FORMAT "%8.2" /end CHARACTERISTIC
/begin CHARACTERISTIC Sig_tisDIAScale_C "scale factor for conversion from ecu -> dia" VALUE 0xC0812 Kw_Wu16 7.999878 Fact 0.00 7.999878 FORMAT "%8.6" /end CHARACTERISTIC
/begin CHARACTERISTIC Sig_tiDSMOffset_C "Offset für Umrechnung SG -> DSM für Zeit" VALUE 0xC0814 Kw_Ws16 65535.00 OneToOne -32768.00 32767.00 FORMAT "%8.2" /end CHARACTERISTIC
/begin CHARACTERISTIC Sig_tiDSMScale_C "Skalierung für Umrechnung SG -> DSM für Zeit" VALUE 0xC0816 Kw_Wu16 7.999878 Fact 0.00 7.999878 FORMAT "%8.6" /end CHARACTERISTIC
/begin CHARACTERISTIC Sig_tiCANOffset_C "Offset für Umrechnung SG -> CAN für Zeit" VALUE 0xC0818 Kw_Ws16 65535.00 OneToOne -32768.00 32767.00 FORMAT "%8.2" /end CHARACTERISTIC
/begin CHARACTERISTIC Sig_tiCANScale_C "Skalierung für Umrechnung SG -> CAN für Zeit" VALUE 0xC081A Kw_Wu16 7.999878 Fact 0.00 7.999878 FORMAT "%8.6" /end CHARACTERISTIC
/begin CHARACTERISTIC Sig_tiDIAOffset_C "Offset für Umrechnung SG -> Diagnoseschnittstelle für Zeit" VALUE 0xC081C Kw_Ws16 65535.00 OneToOne -32768.00 32767.00 FORMAT "%8.2" /end CHARACTERISTIC
/begin CHARACTERISTIC Sig_tiDIAScale_C "Skalierung für Umrechnung SG -> Diagnoseschnittstelle für Zeit" VALUE 0xC081E Kw_Wu16 7.999878 Fact 0.00 7.999878 FORMAT "%8.6" /end CHARACTERISTIC
/begin CHARACTERISTIC Sig_Tn_abstellDSMOffset_C "" VALUE 0xC0820 Kw_Ws16 65535.00 OneToOne -32768.00 32767.00 FORMAT "%8.2" /end CHARACTERISTIC
/begin CHARACTERISTIC Sig_Tn_abstellDSMScale_C "" VALUE 0xC0822 Kw_Wu16 7.999878 Fact 0.00 7.999878 FORMAT "%8.6" /end CHARACTERISTIC
/begin CHARACTERISTIC Sig_Tn_abstellCANOffset_C "" VALUE 0xC0824 Kw_Ws16 65535.00 OneToOne -32768.00 32767.00 FORMAT "%8.2" /end CHARACTERISTIC
/begin CHARACTERISTIC Sig_Tn_abstellCANScale_C "" VALUE 0xC0826 Kw_Wu16 7.999878 Fact 0.00 7.999878 FORMAT "%8.6" /end CHARACTERISTIC
/begin CHARACTERISTIC Sig_Tn_abstellDIAOffset_C "" VALUE 0xC0828 Kw_Ws16 65535.00 OneToOne -32768.00 32767.00 FORMAT "%8.2" /end CHARACTERISTIC
/begin CHARACTERISTIC Sig_Tn_abstellDIAScale_C "" VALUE 0xC082A Kw_Wu16 7.999878 Fact 0.00 7.999878 FORMAT "%8.6" /end CHARACTERISTIC
/begin CHARACTERISTIC Sig_trqPrpDSMOffset_C "Offset für Umrechnung SG->DSM für Antriebsmoment" VALUE 0xC082C Kw_Ws16 65535.00 OneToOne -32768.00 32767.00 FORMAT "%8.2" /end CHARACTERISTIC
/begin CHARACTERISTIC Sig_trqPrpDSMScale_C "Skalierung für Umrechnung SG->DSM für Antriebsmoment" VALUE 0xC082E Kw_Wu16 7.999878 Fact 0.00 7.999878 FORMAT "%8.6" /end CHARACTERISTIC
/begin CHARACTERISTIC Sig_trqPrpCANOffset_C "Offset für Umrechnung SG->CAN für Antriebsmoment" VALUE 0xC0830 Kw_Ws16 65535.00 OneToOne -32768.00 32767.00 FORMAT "%8.2" /end CHARACTERISTIC
/begin CHARACTERISTIC Sig_trqPrpCANScale_C "Skalierung für Umrechnung SG->CAN für Antriebsmoment" VALUE 0xC0832 Kw_Wu16 7.999878 Fact 0.00 7.999878 FORMAT "%8.6" /end CHARACTERISTIC
/begin CHARACTERISTIC Sig_trqPrpDIAOffset_C "Offset für Umrechnung SG->DIA für Antriebsmoment" VALUE 0xC0834 Kw_Ws16 65535.00 OneToOne -32768.00 32767.00 FORMAT "%8.2" /end CHARACTERISTIC
/begin CHARACTERISTIC Sig_trqPrpDIAScale_C "Skalierung für Umrechnung SG->DIA für Antriebsmoment" VALUE 0xC0836 Kw_Wu16 7.999878 Fact 0.00 7.999878 FORMAT "%8.6" /end CHARACTERISTIC
/begin CHARACTERISTIC Sig_trqDSMOffset_C "Offset Umrechung SG->DSM für Drehmoment" VALUE 0xC0838 Kw_Ws16 65535.00 OneToOne -32768.00 32767.00 FORMAT "%8.2" /end CHARACTERISTIC
/begin CHARACTERISTIC Sig_trqDSMScale_C "Skalierung Umrechung SG->DSM für Drehmoment" VALUE 0xC083A Kw_Wu16 7.999878 Fact 0.00 7.999878 FORMAT "%8.6" /end CHARACTERISTIC
/begin CHARACTERISTIC Sig_trqCANOffset_C "Offset Umrechung SG->CAN für Drehmoment" VALUE 0xC083C Kw_Ws16 65535.00 OneToOne -32768.00 32767.00 FORMAT "%8.2" /end CHARACTERISTIC
/begin CHARACTERISTIC Sig_trqCANScale_C "Skalierung Umrechung SG->CAN für Drehmoment" VALUE 0xC083E Kw_Wu16 7.999878 Fact 0.00 7.999878 FORMAT "%8.6" /end CHARACTERISTIC
/begin CHARACTERISTIC Sig_trqDIAOffset_C "Offset Umrechung SG->Diagnoseschnittstelle für Drehmoment" VALUE 0xC0840 Kw_Ws16 65535.00 OneToOne -32768.00 32767.00 FORMAT "%8.2" /end CHARACTERISTIC
/begin CHARACTERISTIC Sig_trqDIAScale_C "Skalierung Umrechung SG->Diagnoseschnittstelle für Drehmoment" VALUE 0xC0842 Kw_Wu16 7.999878 Fact 0.00 7.999878 FORMAT "%8.6" /end CHARACTERISTIC
/begin CHARACTERISTIC Sig_tDSMOffset_C "Offset Umrechung SG->DSM für Temperatur" VALUE 0xC0844 Kw_Ws16 65535.00 OneToOne -32768.00 32767.00 FORMAT "%8.2" /end CHARACTERISTIC
/begin CHARACTERISTIC Sig_tDSMScale_C "Skalierung Umrechung SG->DSM für Temperatur" VALUE 0xC0846 Kw_Wu16 7.999878 Fact 0.00 7.999878 FORMAT "%8.6" /end CHARACTERISTIC
/begin CHARACTERISTIC Sig_tCANOffset_C "Offset Umrechung SG->CAN für Temperatur" VALUE 0xC0848 Kw_Ws16 65535.00 OneToOne -32768.00 32767.00 FORMAT "%8.2" /end CHARACTERISTIC
/begin CHARACTERISTIC Sig_tCANScale_C "Skalierung Umrechung SG->CAN für Temperatur" VALUE 0xC084A Kw_Wu16 7.999878 Fact 0.00 7.999878 FORMAT "%8.6" /end CHARACTERISTIC
/begin CHARACTERISTIC Sig_tDIAOffset_C "Offset Umrechung SG->Diagnoseschnittstelle für Temperatur" VALUE 0xC084C Kw_Ws16 65535.00 OneToOne -32768.00 32767.00 FORMAT "%8.2" /end CHARACTERISTIC
/begin CHARACTERISTIC Sig_tDIAScale_C "Skalierung Umrechung SG->Diagnoseschnittstelle für Temperatur" VALUE 0xC084E Kw_Wu16 7.999878 Fact 0.00 7.999878 FORMAT "%8.6" /end CHARACTERISTIC
/begin CHARACTERISTIC Sig_uBattDSMOffset_C "Offset fuer Umrechung SG->DSM fuer Batteriespannung" VALUE 0xC0850 Kw_Ws16 65535.00 OneToOne -32768.00 32767.00 FORMAT "%8.2" /end CHARACTERISTIC
/begin CHARACTERISTIC Sig_uBattDSMScale_C "Skalierung Umrechungs Faktor SG->DSM fuer Batteriespannung" VALUE 0xC0852 Kw_Wu16 7.999878 Fact 0.00 7.999878 FORMAT "%8.6" /end CHARACTERISTIC
/begin CHARACTERISTIC Sig_uBattCANOffset_C "Offset fuer Umrechung SG->CAN fuer Batteriespannung" VALUE 0xC0854 Kw_Ws16 65535.00 OneToOne -32768.00 32767.00 FORMAT "%8.2" /end CHARACTERISTIC
/begin CHARACTERISTIC Sig_uBattCANScale_C "Skalierung Umrechungs Faktor SG->CAN fuer Batteriespannung" VALUE 0xC0856 Kw_Wu16 7.999878 Fact 0.00 7.999878 FORMAT "%8.6" /end CHARACTERISTIC
/begin CHARACTERISTIC Sig_uBattDIAOffset_C "Offset fuer Umrechung SG->DIA fuer Batteriespannung" VALUE 0xC0858 Kw_Ws16 65535.00 OneToOne -32768.00 32767.00 FORMAT "%8.2" /end CHARACTERISTIC
/begin CHARACTERISTIC Sig_uBattDIAScale_C "Skalierung Umrechungs Faktor SG->DIA fuer Batteriespannung" VALUE 0xC085A Kw_Wu16 7.999878 Fact 0.00 7.999878 FORMAT "%8.6" /end CHARACTERISTIC
/begin CHARACTERISTIC Sig_U_battDSMOffset_C "" VALUE 0xC085C Kw_Ws16 65535.00 OneToOne -32768.00 32767.00 FORMAT "%8.2" /end CHARACTERISTIC
/begin CHARACTERISTIC Sig_U_battDSMScale_C "" VALUE 0xC085E Kw_Wu16 7.999878 Fact 0.00 7.999878 FORMAT "%8.6" /end CHARACTERISTIC
/begin CHARACTERISTIC Sig_U_battCANOffset_C "" VALUE 0xC0860 Kw_Ws16 65535.00 OneToOne -32768.00 32767.00 FORMAT "%8.2" /end CHARACTERISTIC
/begin CHARACTERISTIC Sig_U_battCANScale_C "" VALUE 0xC0862 Kw_Wu16 7.999878 Fact 0.00 7.999878 FORMAT "%8.6" /end CHARACTERISTIC
/begin CHARACTERISTIC Sig_U_battDIAOffset_C "" VALUE 0xC0864 Kw_Ws16 65535.00 OneToOne -32768.00 32767.00 FORMAT "%8.2" /end CHARACTERISTIC
/begin CHARACTERISTIC Sig_U_battDIAScale_C "" VALUE 0xC0866 Kw_Wu16 7.999878 Fact 0.00 7.999878 FORMAT "%8.6" /end CHARACTERISTIC
/begin CHARACTERISTIC Sig_uDSMOffset_C "Offset Umrechung SG->DSM für Spannung" VALUE 0xC0868 Kw_Ws16 65535.00 OneToOne -32768.00 32767.00 FORMAT "%8.2" /end CHARACTERISTIC
/begin CHARACTERISTIC Sig_uDSMScale_C "Skalierung Umrechung SG->DSM für Spannungen" VALUE 0xC086A Kw_Wu16 7.999878 Fact 0.00 7.999878 FORMAT "%8.6" /end CHARACTERISTIC
/begin CHARACTERISTIC Sig_uCANOffset_C "Offset Umrechung SG->CAN für Spannung" VALUE 0xC086C Kw_Ws16 65535.00 OneToOne -32768.00 32767.00 FORMAT "%8.2" /end CHARACTERISTIC
/begin CHARACTERISTIC Sig_uCANScale_C "Skalierung Umrechung SG->CAN für Spannung" VALUE 0xC086E Kw_Wu16 7.999878 Fact 0.00 7.999878 FORMAT "%8.6" /end CHARACTERISTIC
/begin CHARACTERISTIC Sig_uDIAOffset_C "Offset Umrechung SG->Diagnoseschnittstelle für Spannung" VALUE 0xC0870 Kw_Ws16 65535.00 OneToOne -32768.00 32767.00 FORMAT "%8.2" /end CHARACTERISTIC
/begin CHARACTERISTIC Sig_uDIAScale_C "Skalierung Umrechung SG->Diagnoseschnittstelle für Spannung" VALUE 0xC0872 Kw_Wu16 7.999878 Fact 0.00 7.999878 FORMAT "%8.6" /end CHARACTERISTIC
/begin CHARACTERISTIC Sig_U_genDSMOffset_C "" VALUE 0xC0874 Kw_Ws16 65535.00 OneToOne -32768.00 32767.00 FORMAT "%8.2" /end CHARACTERISTIC
/begin CHARACTERISTIC Sig_U_genDSMScale_C "" VALUE 0xC0876 Kw_Wu16 7.999878 Fact 0.00 7.999878 FORMAT "%8.6" /end CHARACTERISTIC
/begin CHARACTERISTIC Sig_U_genCANOffset_C "" VALUE 0xC0878 Kw_Ws16 65535.00 OneToOne -32768.00 32767.00 FORMAT "%8.2" /end CHARACTERISTIC
/begin CHARACTERISTIC Sig_U_genCANScale_C "" VALUE 0xC087A Kw_Wu16 7.999878 Fact 0.00 7.999878 FORMAT "%8.6" /end CHARACTERISTIC
/begin CHARACTERISTIC Sig_U_genDIAOffset_C "" VALUE 0xC087C Kw_Ws16 65535.00 OneToOne -32768.00 32767.00 FORMAT "%8.2" /end CHARACTERISTIC
/begin CHARACTERISTIC Sig_U_genDIAScale_C "" VALUE 0xC087E Kw_Wu16 7.999878 Fact 0.00 7.999878 FORMAT "%8.6" /end CHARACTERISTIC
/begin CHARACTERISTIC Sig_volFlDSMOffset_C "Offset für Umrechnung SG->DSM für Kraftstoffvolumen" VALUE 0xC0880 Kw_Ws16 65535.00 OneToOne -32768.00 32767.00 FORMAT "%8.2" /end CHARACTERISTIC
/begin CHARACTERISTIC Sig_volFlDSMScale_C "Skalierung Umrechung SG->DSM für Kraftstoffvolumen" VALUE 0xC0882 Kw_Wu16 7.999878 Fact 0.00 7.999878 FORMAT "%8.6" /end CHARACTERISTIC
/begin CHARACTERISTIC Sig_volFlCANOffset_C "Offset für Umrechnung SG->CAN für Kraftstoffvolumen" VALUE 0xC0884 Kw_Ws16 65535.00 OneToOne -32768.00 32767.00 FORMAT "%8.2" /end CHARACTERISTIC
/begin CHARACTERISTIC Sig_volFlCANScale_C "Skalierung Umrechung SG->CAN für Kraftstoffvolumen" VALUE 0xC0886 Kw_Wu16 7.999878 Fact 0.00 7.999878 FORMAT "%8.6" /end CHARACTERISTIC
/begin CHARACTERISTIC Sig_volFlDIAOffset_C "Offset für Umrechnung SG->Diagnoseschnittstelle für Kraftstoffvolumen" VALUE 0xC0888 Kw_Ws16 65535.00 OneToOne -32768.00 32767.00 FORMAT "%8.2" /end CHARACTERISTIC
/begin CHARACTERISTIC Sig_volFlDIAScale_C "Skalierung Umrechung SG->Diagnoseschnittstelle für Kraftstoffvolumen" VALUE 0xC088A Kw_Wu16 7.999878 Fact 0.00 7.999878 FORMAT "%8.6" /end CHARACTERISTIC
/begin CHARACTERISTIC Sig_volphDSMOffset_C "Offset für Umrechnung SG->DSM für Kubikmeter pro Stunde" VALUE 0xC088C Kw_Ws16 65535.00 OneToOne -32768.00 32767.00 FORMAT "%8.2" /end CHARACTERISTIC
/begin CHARACTERISTIC Sig_volphDSMScale_C "Skalierung Umrechung SG->DSM für Kubikmeter pro Stunde" VALUE 0xC088E Kw_Wu16 7.999878 Fact 0.00 7.999878 FORMAT "%8.6" /end CHARACTERISTIC
/begin CHARACTERISTIC Sig_volphCANOffset_C "Offset für Umrechnung SG->CAN für Kubikmeter pro Stunde" VALUE 0xC0890 Kw_Ws16 65535.00 OneToOne -32768.00 32767.00 FORMAT "%8.2" /end CHARACTERISTIC
/begin CHARACTERISTIC Sig_volphCANScale_C "Skalierung Umrechung SG->CAN für Kubikmeter pro Stunde" VALUE 0xC0892 Kw_Wu16 7.999878 Fact 0.00 7.999878 FORMAT "%8.6" /end CHARACTERISTIC
/begin CHARACTERISTIC Sig_volphDIAOffset_C "Offset für Umrechnung SG->Diagnoseschnittstelle für Kubikmeter pro Stunde" VALUE 0xC0894 Kw_Ws16 65535.00 OneToOne -32768.00 32767.00 FORMAT "%8.2" /end CHARACTERISTIC
/begin CHARACTERISTIC Sig_volphDIAScale_C "Skalierung Umrechung SG->Diagnoseschnittstelle für Kubikmeter pro Stunde" VALUE 0xC0896 Kw_Wu16 7.999878 Fact 0.00 7.999878 FORMAT "%8.6" /end CHARACTERISTIC
/begin CHARACTERISTIC Sig_volRailDSMOffset_C "Offset für Umrechnung SG->DSM für Volumen (Rail)" VALUE 0xC0898 Kw_Ws16 65535.00 OneToOne -32768.00 32767.00 FORMAT "%8.2" /end CHARACTERISTIC
/begin CHARACTERISTIC Sig_volRailDSMScale_C "Skalierung Umrechung SG->DSM für Volumen (Rail)" VALUE 0xC089A Kw_Wu16 7.999878 Fact 0.00 7.999878 FORMAT "%8.6" /end CHARACTERISTIC
/begin CHARACTERISTIC Sig_volRailCANOffset_C "Offset für Umrechnung SG->CAN für Volumen (Rail)" VALUE 0xC089C Kw_Ws16 65535.00 OneToOne -32768.00 32767.00 FORMAT "%8.2" /end CHARACTERISTIC
/begin CHARACTERISTIC Sig_volRailCANScale_C "Skalierung Umrechung SG->CAN für Volumen (Rail)" VALUE 0xC089E Kw_Wu16 7.999878 Fact 0.00 7.999878 FORMAT "%8.6" /end CHARACTERISTIC
/begin CHARACTERISTIC Sig_volRailDIAOffset_C "Offset für Umrechnung SG->Diagnoseschnittstelle für Volumen (Rail)" VALUE 0xC08A0 Kw_Ws16 65535.00 OneToOne -32768.00 32767.00 FORMAT "%8.2" /end CHARACTERISTIC
/begin CHARACTERISTIC Sig_volRailDIAScale_C "Skalierung Umrechung SG->Diagnoseschnittstelle für Volumen (Rail)" VALUE 0xC08A2 Kw_Wu16 7.999878 Fact 0.00 7.999878 FORMAT "%8.6" /end CHARACTERISTIC
/begin CHARACTERISTIC Sig_vDSMOffset_C "Offset Umrechung SG->DSM für Fahrgeschwindigkeit" VALUE 0xC08A4 Kw_Ws16 65535.00 OneToOne -32768.00 32767.00 FORMAT "%8.2" /end CHARACTERISTIC
/begin CHARACTERISTIC Sig_vDSMScale_C "Skalierung Umrechung SG->DSM für Fahrgeschwindigkeit" VALUE 0xC08A6 Kw_Wu16 7.999878 Fact 0.00 7.999878 FORMAT "%8.6" /end CHARACTERISTIC
/begin CHARACTERISTIC Sig_vCANOffset_C "Offset Umrechung SG->CAN für Fahrgeschwindigkeit" VALUE 0xC08A8 Kw_Ws16 65535.00 OneToOne -32768.00 32767.00 FORMAT "%8.2" /end CHARACTERISTIC
/begin CHARACTERISTIC Sig_vCANScale_C "Skalierung Umrechung SG->CAN für Fahrgeschwindigkeit" VALUE 0xC08AA Kw_Wu16 7.999878 Fact 0.00 7.999878 FORMAT "%8.6" /end CHARACTERISTIC
/begin CHARACTERISTIC Sig_vDIAOffset_C "Offset Umrechung SG->Diagnoseschnittstelle für Fahrgeschwindigkeit" VALUE 0xC08AC Kw_Ws16 65535.00 OneToOne -32768.00 32767.00 FORMAT "%8.2" /end CHARACTERISTIC
/begin CHARACTERISTIC Sig_vDIAScale_C "Skalierung Umrechung SG->Diagnoseschnittstelle für Fahrgeschwindigkeit" VALUE 0xC08AE Kw_Wu16 7.999878 Fact 0.00 7.999878 FORMAT "%8.6" /end CHARACTERISTIC
/begin CHARACTERISTIC SOPTst_stRcyDem_C "#SSD Applizierbares Label, ob Recovery bei fehlerhaftem Abschaltpfadtest ausgelöst werden soll" VALUE 0xEB77E Kw_Wu8 1.000 OneToOne 0.00 1.000 FORMAT "%5.3" EXTENDED_LIMITS 0.00 255.0 /end CHARACTERISTIC
/begin CHARACTERISTIC SOPTst_stShOffPathActv_C "#SSD aktive Abschaltpfade während der Initialisierung" VALUE 0xEB77F Kw_Wu8 255.0 OneToOne 0.00 255.0 FORMAT "%5.1" /end CHARACTERISTIC
/begin CHARACTERISTIC SPMon_swtRstStackMon_C "Schalter zum Rücksetzen der Überwachung des maximal benötigten Stacks" VALUE 0xEB780 Kw_Wu8 1.000 OneToOne 0.00 1.000 FORMAT "%5.3" EXTENDED_LIMITS 0.00 255.0 /end CHARACTERISTIC
/begin CHARACTERISTIC SrvPmp_facSTWAV_CUR "Korrekturkennlinie (Geschwindigkeit Lenkradwinkel) für den Momentenwunsch der Servopumpe" CURVE 0xEB782 Kl_Xs16_Ws16 10.00000 Fact 0.00 10.00000 FORMAT "%8.5" EXTENDED_LIMITS -4.000000 3.999878
 /begin AXIS_DESCR STD_AXIS SrvPmp_dphiStrg_mp AngleGradPerSec 7 -180.0192 180.0192 FORMAT "%8.4" EXTENDED_LIMITS -1440.154 1440.110 DEPOSIT ABSOLUTE /end AXIS_DESCR
/end CHARACTERISTIC
/begin CHARACTERISTIC SrvPmp_facVS_CUR "Korrekturkennlinie (Geschwindigkeit) für den Momentenwunsch der Servopumpe" CURVE 0xEB7A0 Kl_Xs16_Ws16 10.00000 Fact 0.00 10.00000 FORMAT "%8.5" EXTENDED_LIMITS -4.000000 3.999878
 /begin AXIS_DESCR STD_AXIS VSSCD_v Vel 7 0.00 300.0000 FORMAT "%8.4" EXTENDED_LIMITS -327.6800 327.6700 DEPOSIT ABSOLUTE /end AXIS_DESCR
/end CHARACTERISTIC
/begin CHARACTERISTIC SrvPmp_rTrans_C "Transmission ratio of SrvPmp" VALUE 0xEB7BE Kw_Ws16 200.0000 TransR 0.00 200.0000 FORMAT "%8.4" EXTENDED_LIMITS -327.6800 327.6700 /end CHARACTERISTIC
/begin CHARACTERISTIC SrvPmp_trqSTWABase_CUR "Basiskennlinie für dem Momentenwunsch der Servopumpe" CURVE 0xEB7C0 Kl_Xs16_Ws16 1500.000 Trq -500.0000 1000.000 FORMAT "%8.3" EXTENDED_LIMITS -3276.800 3276.700
 /begin AXIS_DESCR STD_AXIS FrmMng_phiStrg AngleGrad 7 -180.0192 180.0192 FORMAT "%8.4" EXTENDED_LIMITS -1440.154 1440.110 DEPOSIT ABSOLUTE /end AXIS_DESCR
/end CHARACTERISTIC
/begin CHARACTERISTIC SSpMon_DebSRCHighSplyVltgDef1_C "#SSD Fehlerentprellung SRC High für Sensorversorgungsspannung 1" VALUE 0xEB7DE Kw_Wu16 655350.0 Time_ms 0.00 655350.0 FORMAT "%8.1" /end CHARACTERISTIC
/begin CHARACTERISTIC SSpMon_DebSRCHighSplyVltgOk1_C "#SSD Heilungsentprellung SRC High für Sensorversorgungsspannung 1" VALUE 0xEB7E0 Kw_Wu16 655350.0 Time_ms 0.00 655350.0 FORMAT "%8.1" /end CHARACTERISTIC
/begin CHARACTERISTIC SSpMon_DebSRCHighSplyVltgDef2_C "#SSD Fehlerentprellung SRC High für Sensorversorgungsspannung 2" VALUE 0xEB7E2 Kw_Wu16 655350.0 Time_ms 0.00 655350.0 FORMAT "%8.1" /end CHARACTERISTIC
/begin CHARACTERISTIC SSpMon_DebSRCHighSplyVltgOk2_C "#SSD Heilungsentprellung SRC High für Sensorversorgungsspannung 2" VALUE 0xEB7E4 Kw_Wu16 655350.0 Time_ms 0.00 655350.0 FORMAT "%8.1" /end CHARACTERISTIC
/begin CHARACTERISTIC SSpMon_DebSRCHighSplyVltgDef3_C "#SSD Fehlerentprellung SRC High für Sensorversorgungsspannung 3" VALUE 0xEB7E6 Kw_Wu16 655350.0 Time_ms 0.00 655350.0 FORMAT "%8.1" /end CHARACTERISTIC
/begin CHARACTERISTIC SSpMon_DebSRCHighSplyVltgOk3_C "#SSD Heilungsentprellung SRC High für Sensorversorgungsspannung 3" VALUE 0xEB7E8 Kw_Wu16 655350.0 Time_ms 0.00 655350.0 FORMAT "%8.1" /end CHARACTERISTIC
/begin CHARACTERISTIC SSpMon_DebSRCLowSplyVltgDef1_C "#SSD Defektentprellung SRC Low für Sensorversorgungsspannung 1" VALUE 0xEB7EA Kw_Wu16 655350.0 Time_ms 0.00 655350.0 FORMAT "%8.1" /end CHARACTERISTIC
/begin CHARACTERISTIC SSpMon_DebSRCLowSplyVltgOk1_C "#SSD Heilungsentprellung SRC Low für Sensorversorgungsspannung 1" VALUE 0xEB7EC Kw_Wu16 655350.0 Time_ms 0.00 655350.0 FORMAT "%8.1" /end CHARACTERISTIC
/begin CHARACTERISTIC SSpMon_DebSRCLowSplyVltgDef2_C "#SSD Defektentprellung SRC Low für Sensorversorgungsspannung 2" VALUE 0xEB7EE Kw_Wu16 655350.0 Time_ms 0.00 655350.0 FORMAT "%8.1" /end CHARACTERISTIC
/begin CHARACTERISTIC SSpMon_DebSRCLowSplyVltgOk2_C "#SSD Heilungsentprellung SRC Low für Sensorversorgungsspannung 2" VALUE 0xEB7F0 Kw_Wu16 655350.0 Time_ms 0.00 655350.0 FORMAT "%8.1" /end CHARACTERISTIC
/begin CHARACTERISTIC SSpMon_DebSRCLowSplyVltgDef3_C "#SSD Defektentprellung SRC Low für Sensorversorgungsspannung 3" VALUE 0xEB7F2 Kw_Wu16 655350.0 Time_ms 0.00 655350.0 FORMAT "%8.1" /end CHARACTERISTIC
/begin CHARACTERISTIC SSpMon_DebSRCLowSplyVltgOk3_C "#SSD Heilungsentprellung SRC Low für Sensorversorgungsspannung 3" VALUE 0xEB7F4 Kw_Wu16 655350.0 Time_ms 0.00 655350.0 FORMAT "%8.1" /end CHARACTERISTIC
/begin CHARACTERISTIC SSpMon_numDiaVltg1_C "#SSD Applikationsparameter für diagnose Signal von Sensorversorgungsspannung 1" VALUE 0xEB7F6 Kw_Wu8 34.0000000000 NumPinDia 0.00 34.0000000000 FORMAT "%13.10" /end CHARACTERISTIC
/begin CHARACTERISTIC SSpMon_numDiaVltg2_C "#SSD Applikationsparameter für diagnose Signal von Sensorversorgungsspannung 2" VALUE 0xEB7F7 Kw_Wu8 34.0000000000 NumPinDia 0.00 34.0000000000 FORMAT "%13.10" /end CHARACTERISTIC
/begin CHARACTERISTIC SSpMon_numDiaVltg3_C "#SSD Applikationsparameter für diagnose Signal von Sensorversorgungsspannung 3" VALUE 0xEB7F8 Kw_Wu8 34.0000000000 NumPinDia 0.00 34.0000000000 FORMAT "%13.10" /end CHARACTERISTIC
/begin CHARACTERISTIC StrtCD_ActrDebExcTempDef_C "Fehlerentprellzeit für Übertemperatur" VALUE 0xEB7FA Kw_Wu16 655350.0 Time_ms 0.00 655350.0 FORMAT "%8.1" /end CHARACTERISTIC
/begin CHARACTERISTIC StrtCD_ActrDebExcTempOk_C "Fehlerheilzeit für Übertemperatur" VALUE 0xEB7FC Kw_Wu16 655350.0 Time_ms 0.00 655350.0 FORMAT "%8.1" /end CHARACTERISTIC
/begin CHARACTERISTIC StrtCD_ActrDebNoLoadDef_C "Fehlerentprellzeit für Drahtbruch" VALUE 0xEB7FE Kw_Wu16 655350.0 Time_ms 0.00 655350.0 FORMAT "%8.1" /end CHARACTERISTIC
/begin CHARACTERISTIC StrtCD_ActrDebNoLoadOk_C "Fehlerheilzeit für Drahtbruch" VALUE 0xEB800 Kw_Wu16 655350.0 Time_ms 0.00 655350.0 FORMAT "%8.1" /end CHARACTERISTIC
/begin CHARACTERISTIC StrtCD_ActrDebShrtCBatDef_C "Fehlerentprellzeit KS nach U_Batt" VALUE 0xEB802 Kw_Wu16 655350.0 Time_ms 0.00 655350.0 FORMAT "%8.1" /end CHARACTERISTIC
/begin CHARACTERISTIC StrtCD_ActrDebShrtCBatOk_C "Fehlerheilzeit KS nach U_Batt" VALUE 0xEB804 Kw_Wu16 655350.0 Time_ms 0.00 655350.0 FORMAT "%8.1" /end CHARACTERISTIC
/begin CHARACTERISTIC StrtCD_ActrDebShrtCGndDef_C "Fehlerentprellzeit KS nach Gnd" VALUE 0xEB806 Kw_Wu16 655350.0 Time_ms 0.00 655350.0 FORMAT "%8.1" /end CHARACTERISTIC
/begin CHARACTERISTIC StrtCD_ActrDebShrtCGndOk_C "Fehlerheilzeit KS nach Gnd" VALUE 0xEB808 Kw_Wu16 655350.0 Time_ms 0.00 655350.0 FORMAT "%8.1" /end CHARACTERISTIC
/begin CHARACTERISTIC STRTCD_numDia_C "Auswahl des Diagnosesignals der Startrelayendstufe" VALUE 0xEB80A Kw_Wu8 34.0000000000 NumPinDia 0.00 34.0000000000 FORMAT "%13.10" /end CHARACTERISTIC
/begin CHARACTERISTIC STRTCD_numDioOut_C "Auswahl des Digitalausgangspins für Starterrelay" VALUE 0xEB80B Kw_Wu8 10.0000000000 NumPinDioOut 0.00 10.0000000000 FORMAT "%13.10" /end CHARACTERISTIC
/begin CHARACTERISTIC StrtCD_stActrInvOut_C "invertiere Starter Relais Steller Ausgang" VALUE 0xEB80C Kw_Wu8 1.000 OneToOne 0.00 1.000 FORMAT "%5.3" EXTENDED_LIMITS 0.00 255.0 /end CHARACTERISTIC
/begin CHARACTERISTIC StrtCD_stPwrStgActrActv_C "Statuswort für Endstufenabschaltung durch den Motorkoordinator" VALUE 0xEB80D Kw_Wu8 255.0 OneToOne 0.00 255.0 FORMAT "%5.1" /end CHARACTERISTIC
/begin CHARACTERISTIC StrtCD_stPwrStgActrDia_C "Statuswort für Endstufendiagnoseabschaltung durch den Motorkoordinator" VALUE 0xEB80E Kw_Wu8 254.0 OneToOne 1.000 255.0 FORMAT "%5.1" EXTENDED_LIMITS 0.00 255.0 /end CHARACTERISTIC
/begin CHARACTERISTIC StSys_facAPSCor_CUR "atmospheric pressure correction factor" CURVE 0xEB814 Kl_Xs16_Ws16 4.000000 Fact 0.00 4.000000 FORMAT "%8.6" EXTENDED_LIMITS -4.000000 3.999878
 /begin AXIS_DESCR STD_AXIS APSCD_pVal Pres_hPa 8 0.00 4000.000 FORMAT "%8.3" EXTENDED_LIMITS -32768.00 32767.00 DEPOSIT ABSOLUTE /end AXIS_DESCR
/end CHARACTERISTIC
/begin CHARACTERISTIC StSys_nAdjMax_C "#SSD Abgleichende-Drehzahl" VALUE 0xEB90A Kw_Ws16 65535.00 EngN -32768.00 32767.00 FORMAT "%8.2" /end CHARACTERISTIC
/begin CHARACTERISTIC StSys_nDiseng_C "Anlasserabwurfdrehzahlschwelle" VALUE 0xEB9D8 Kw_Ws16 6000.000 EngN 0.00 6000.000 FORMAT "%8.3" EXTENDED_LIMITS -32768.00 32767.00 /end CHARACTERISTIC
/begin CHARACTERISTIC StSys_nEngage_C "Anlassereinspurdrehzahlschwelle" VALUE 0xEB9DA Kw_Ws16 0.00 EngN 0.00 0.00 FORMAT "%8.2" EXTENDED_LIMITS -32768.00 32767.00 /end CHARACTERISTIC
/begin CHARACTERISTIC StSys_nFreezeTrqRmp_C "Rampenbegrenzungsdrehzahl" VALUE 0xEB9E0 Kw_Ws16 65535.00 EngN -32768.00 32767.00 FORMAT "%8.2" /end CHARACTERISTIC
/begin CHARACTERISTIC StSys_nReleaseTrqRmp_C "Rampenfreigabedrehzahl" VALUE 0xEB9E2 Kw_Ws16 65535.00 EngN -32768.00 32767.00 FORMAT "%8.2" /end CHARACTERISTIC
/begin CHARACTERISTIC StSys_nStrtCutOut_CUR "Startabwurf-Drehzahl" CURVE 0xEB8DC Kl_Xs16_Ws16 6000.000 EngN 0.00 6000.000 FORMAT "%8.3" EXTENDED_LIMITS -32768.00 32767.00
 /begin AXIS_DESCR STD_AXIS StSys_tStrt_mp Temp_Cels 10 -50.14000 199.8600 FORMAT "%8.4" EXTENDED_LIMITS -3549.940 3003.560 DEPOSIT ABSOLUTE /end AXIS_DESCR
/end CHARACTERISTIC
/begin CHARACTERISTIC StSys_nStrtTipMax_CUR "Kennfeld für max. Drehzahl = f (Motortemp.)" CURVE 0xEBA04 Kl_Xs16_Ws16 6000.000 EngN 0.00 6000.000 FORMAT "%8.3" EXTENDED_LIMITS -32768.00 32767.00
 /begin AXIS_DESCR STD_AXIS Eng_tEng Temp_Cels 10 -50.1400 899.8600 FORMAT "%8.4" EXTENDED_LIMITS -3549.940 3003.560 DEPOSIT ABSOLUTE /end AXIS_DESCR
/end CHARACTERISTIC
/begin CHARACTERISTIC StSys_nStrtTipProtCaS_C "Schwellenwert für Nockenwellensignal für Aktivierung des Blockierschutzes" VALUE 0xEBA2E Kw_Ws16 6000.000 EngN 0.00 6000.000 FORMAT "%8.3" EXTENDED_LIMITS -32768.00 32767.00 /end CHARACTERISTIC
/begin CHARACTERISTIC StSys_nStrtTipProt_C "Drehzahlschwelle für Blockierschutz" VALUE 0xEBA30 Kw_Ws16 6000.000 EngN 0.00 6000.000 FORMAT "%8.3" EXTENDED_LIMITS -32768.00 32767.00 /end CHARACTERISTIC
/begin CHARACTERISTIC StSys_numStrtAddCor_C "Selection of used engine temperature (e.g. CTSCD_tClnt, etc.)" VALUE 0xEB836 Kw_Wu8 2.00000000000 EngTempFldSel 0.00 2.00000000000 FORMAT "%13.11" /end CHARACTERISTIC
/begin CHARACTERISTIC StSys_numStrtRmp_C "Parameter um die gewünschte Motortemperatur aus dem Motortemperatur-Feld Eng_tFld  zu selektieren" VALUE 0xEB9E4 Kw_Wu8 2.00000000000 EngTempFldSel 0.00 2.00000000000 FORMAT "%13.11" /end CHARACTERISTIC
/begin CHARACTERISTIC StSys_numStrt_C "Parameter um die Motortemperatur für den Startabwurf aus dem Motortemperatur-Feld Eng_tFld  zu selektieren" VALUE 0xEB906 Kw_Wu8 2.00000000000 EngTempFldSel 0.00 2.00000000000 FORMAT "%13.11" /end CHARACTERISTIC
/begin CHARACTERISTIC Stsys_swtGlwLamp_C "Switch to select glow lamp" VALUE 0xEB9DC Kw_Wu8 1.000 OneToOne 0.00 1.000 FORMAT "%5.3" EXTENDED_LIMITS 0.00 255.0 /end CHARACTERISTIC
/begin CHARACTERISTIC StSys_swtShOffGearbxRec_C "Schalter für Aktivierung und Deaktivierung der P/N Erkennung" VALUE 0xEBA32 Kw_Wu8 1.000 OneToOne 0.00 1.000 FORMAT "%5.3" EXTENDED_LIMITS 0.00 255.0 /end CHARACTERISTIC
/begin CHARACTERISTIC StSys_swtStrtTipActv_C "Schalter für Tip-Start Funktion aktiviert" VALUE 0xEBA33 Kw_Wu8 1.000 OneToOne 0.00 1.000 FORMAT "%5.3" EXTENDED_LIMITS 0.00 255.0 /end CHARACTERISTIC
/begin CHARACTERISTIC StSys_tClntHi_C "Temperaturschwelle Motor warm -> heiß" VALUE 0xEB9E6 Kw_Ws16 950.000 Temp_Cels -50.14000 899.860 FORMAT "%8.3" EXTENDED_LIMITS -3549.940 3003.560 /end CHARACTERISTIC
/begin CHARACTERISTIC StSys_tClntLo_C "Temperaturschwelle Motor kalt -> warm" VALUE 0xEB9E8 Kw_Ws16 950.000 Temp_Cels -50.14000 899.860 FORMAT "%8.3" EXTENDED_LIMITS -3549.940 3003.560 /end CHARACTERISTIC
/begin CHARACTERISTIC StSys_tiEngTempValid_C "Verzögerungszeit bis Motortemperatur gueltig" VALUE 0xEB9EA Kw_Wu16 655350.0 Time_ms 0.00 655350.0 FORMAT "%8.1" /end CHARACTERISTIC
/begin CHARACTERISTIC StSys_tiLckCutOut_C "ausblendzeit nEng ueberwachung bei start" VALUE 0xEB9DE Kw_Wu16 655350.0 Time_ms 0.00 655350.0 FORMAT "%8.1" /end CHARACTERISTIC
/begin CHARACTERISTIC StSys_tiStrtCutOut_C "Startabwurf-Sperrzeit" VALUE 0xEB908 Kw_Wu16 655350.0 Time_ms 0.00 655350.0 FORMAT "%8.1" /end CHARACTERISTIC
/begin CHARACTERISTIC StSys_tiStrtLck_C "Anlassersperrzeit nach startabbruch" VALUE 0xEB810 Kw_Wu16 655350.0 Time_ms 0.00 655350.0 FORMAT "%8.1" /end CHARACTERISTIC
/begin CHARACTERISTIC StSys_tiStrtMax_C "max. Starterbetaetigungszeit" VALUE 0xEB812 Kw_Wu16 655350.0 Time_ms 0.00 655350.0 FORMAT "%8.1" /end CHARACTERISTIC
/begin CHARACTERISTIC StSys_tiStrtTipMin_C "min. Zeit für gedrueckten Startknopf" VALUE 0xEBA34 Kw_Wu16 655350.0 Time_ms 0.00 655350.0 FORMAT "%8.1" /end CHARACTERISTIC
/begin CHARACTERISTIC StSys_tiStrtTipNoMonitor_C "Zeitschwelle für nicht überwachte Drehzahl" VALUE 0xEBA36 Kw_Wu16 655350.0 Time_ms 0.00 655350.0 FORMAT "%8.1" /end CHARACTERISTIC
/begin CHARACTERISTIC StSys_tiStrtTipProt_C "Zeitschwelle für Drehzahl-Blockierschutz" VALUE 0xEBA38 Kw_Wu16 655350.0 Time_ms 0.00 655350.0 FORMAT "%8.1" /end CHARACTERISTIC
/begin CHARACTERISTIC StSys_trqAdjMax_C "maximales Moment fuer den Startabgleich" VALUE 0xEB90C Kw_Ws16 6553.500 Trq -3276.800 3276.700 FORMAT "%8.3" /end CHARACTERISTIC
/begin CHARACTERISTIC StSys_trqAdjVal_C "Abgleichwert fuer das Startmoment" VALUE 0xEB90E Kw_Ws16 6553.500 Trq -3276.800 3276.700 FORMAT "%8.3" /end CHARACTERISTIC
/begin CHARACTERISTIC StSys_dtrqColdInc_C "Momentinkrement fuer kalten Motor" VALUE 0xEB9EC Kw_Wu32 6553599.99847 RmpTrq 0.00 6553599.99847 FORMAT "%13.5" /end CHARACTERISTIC
/begin CHARACTERISTIC StSys_tiColdRmpLck_C "Rampensperrzeit fur kalten Motor" VALUE 0xEB9F0 Kw_Wu16 655350.0 Time_ms 0.00 655350.0 FORMAT "%8.1" /end CHARACTERISTIC
/begin CHARACTERISTIC StSys_trqColdLim_C "Grenzmoment fuer kalten Motor" VALUE 0xEB9F2 Kw_Ws16 3276.700 Trq 0.00 3276.700 FORMAT "%8.3" EXTENDED_LIMITS -3276.800 3276.700 /end CHARACTERISTIC
/begin CHARACTERISTIC StSys_dtrqHotInc_C "Momentinkrement fuer heißen Motor" VALUE 0xEB9F4 Kw_Wu32 6553599.99847 RmpTrq 0.00 6553599.99847 FORMAT "%13.5" /end CHARACTERISTIC
/begin CHARACTERISTIC StSys_tiHotRmpLck_C "Rampensperrzeit fur heißen Motor" VALUE 0xEB9F8 Kw_Wu16 655350.0 Time_ms 0.00 655350.0 FORMAT "%8.1" /end CHARACTERISTIC
/begin CHARACTERISTIC StSys_trqHotLim_C "Grenzmoment fuer heißen Motor" VALUE 0xEB9FA Kw_Ws16 3276.700 Trq 0.00 3276.700 FORMAT "%8.3" EXTENDED_LIMITS -3276.800 3276.700 /end CHARACTERISTIC
/begin CHARACTERISTIC StSys_trqStrtAPSCor_MAP " Base map for correction for starting torque" MAP 0xEB838 Kf_Xs16_Ys16_Ws16 240.0000 Trq -40.10000 199.9000 FORMAT "%8.4" EXTENDED_LIMITS -3276.800 3276.700
 /begin AXIS_DESCR STD_AXIS Eng_nAvrg EngN 8 0.00 6000.000 FORMAT "%8.3" EXTENDED_LIMITS -32768.00 32767.00 DEPOSIT ABSOLUTE /end AXIS_DESCR
 /begin AXIS_DESCR STD_AXIS StSys_tStrtBas_mp Temp_Cels 8 -50.140 899.860 FORMAT "%8.3" EXTENDED_LIMITS -3549.940 3003.560 DEPOSIT ABSOLUTE /end AXIS_DESCR
/end CHARACTERISTIC
/begin CHARACTERISTIC StSys_trqStrtBas_MAP "Basismoment fuer den Start" MAP 0xEB910 Kf_Xs16_Ys16_Ws16 3276.700 Trq 0.00 3276.700 FORMAT "%8.3" EXTENDED_LIMITS -3276.800 3276.700
 /begin AXIS_DESCR STD_AXIS Eng_nAvrg EngN 8 0.00 6000.000 FORMAT "%8.3" EXTENDED_LIMITS -32768.00 32767.00 DEPOSIT ABSOLUTE /end AXIS_DESCR
 /begin AXIS_DESCR STD_AXIS StSys_tStrtBas_mp Temp_Cels 10 -50.14000 199.8600 FORMAT "%8.4" EXTENDED_LIMITS -3549.940 3003.560 DEPOSIT ABSOLUTE /end AXIS_DESCR
/end CHARACTERISTIC
/begin CHARACTERISTIC StSys_dtrqWarmInc_C "Momentinkrement fuer warmen Motor" VALUE 0xEB9FC Kw_Wu32 6553599.99847 RmpTrq 0.00 6553599.99847 FORMAT "%13.5" /end CHARACTERISTIC
/begin CHARACTERISTIC StSys_tiWarmRmpLck_C "Rampensperrzeit fur warmen Motor" VALUE 0xEBA00 Kw_Wu16 655350.0 Time_ms 0.00 655350.0 FORMAT "%8.1" /end CHARACTERISTIC
/begin CHARACTERISTIC StSys_trqWarmLim_C "Grenzmoment fuer warmen Motor" VALUE 0xEBA02 Kw_Ws16 3276.700 Trq 0.00 3276.700 FORMAT "%8.3" EXTENDED_LIMITS -3276.800 3276.700 /end CHARACTERISTIC
/begin MEASUREMENT Rail_dpSetPointInc "maximaler Raildruck-Sollwertanstieg pro Sekunde" SWORD PresRail_sec 1 100 -13107.200 13106.800 FORMAT "%5.3" ECU_ADDRESS 0x7F900E /end MEASUREMENT
/begin MEASUREMENT Rail_dvolInjVlvCtl_mp "Korrekturwert der Vorsteuerung unter Berücksichtigung der Steuermengen für die Injektoren" SWORD Qp_mm3_sec 1 100 -327680.0 327670.0 FORMAT "%8.1" ECU_ADDRESS 0x8FFC58 /end MEASUREMENT
/begin MEASUREMENT Rail_dvolLeak_mp "Leckage des Hochdrucksystems" SWORD Qp_mm3_sec 1 100 -327680.0 327670.0 FORMAT "%8.1" ECU_ADDRESS 0x8FFC5A /end MEASUREMENT
/begin MEASUREMENT Rail_dvolPreCtlBas_mp "Basisvorsteuerwert aus Kennfeld für die Druckregelung über Zumesseinheit" SWORD Qp_mm3_sec 1 100 -327680.0 327670.0 FORMAT "%8.1" ECU_ADDRESS 0x8FFC5C /end MEASUREMENT
/begin MEASUREMENT Rail_dvolPreCtlInit_mp "Initialisierungswert der Vorsteuerung für die Druckregelung über Zumesseinheit" SWORD Qp_mm3_sec 1 100 -327680.0 327670.0 FORMAT "%8.1" ECU_ADDRESS 0x8FFC5E /end MEASUREMENT
/begin MEASUREMENT Rail_dvolPreCtlOfs_mp "Offset aus Kennfeld für die Vorsteuerung der Druckregelung über Zumesseinheit" SWORD Qp_mm3_sec 1 100 -327680.0 327670.0 FORMAT "%8.1" ECU_ADDRESS 0x8FFC60 /end MEASUREMENT
/begin MEASUREMENT Rail_dvolPreCtlPoI1_mp "Vorsteuerwert abhängig von der Nacheinspritzmenge 1 für die Druckregelung über Zumesseinheit" SWORD Qp_mm3_sec 1 100 -327680.0 327670.0 FORMAT "%8.1" ECU_ADDRESS 0x8FFC62 /end MEASUREMENT
/begin MEASUREMENT Rail_dvolPreCtlPoI2_mp "Vorsteuerwert abhängig von der Nacheinspritzmenge 2 für die Druckregelung über Zumesseinheit" SWORD Qp_mm3_sec 1 100 -327680.0 327670.0 FORMAT "%8.1" ECU_ADDRESS 0x8FFC64 /end MEASUREMENT
/begin MEASUREMENT Rail_dvolPreCtl_mp "Vorsteuerwert für die Druckregelung über Zumesseinheit" SWORD Qp_mm3_sec 1 100 -327680.0 327670.0 FORMAT "%8.1" ECU_ADDRESS 0x8FFC66 /end MEASUREMENT
/begin MEASUREMENT Rail_facAPSetPDynCor_mp "Gewichtungsfaktor - Atmosphärendruck-abhängiger Korrekturwert" SWORD Fact 1 100 -4.000000 3.999878 FORMAT "%8.6" ECU_ADDRESS 0x8FFC90 /end MEASUREMENT
/begin MEASUREMENT Rail_facDQSetPDynCor_mp "Gewichtungsfaktor - Einspritzmengengradient-abhängiger Korrekturwert" SWORD Fact 1 100 -4.000000 3.999878 FORMAT "%8.6" ECU_ADDRESS 0x8FFC92 /end MEASUREMENT
/begin MEASUREMENT Rail_facETSetPDynCor_mp "Gewichtungsfaktor - Motortemperatur-anhängiger Korrekturwert" SWORD Fact 1 100 -4.000000 3.999878 FORMAT "%8.6" ECU_ADDRESS 0x8FFC94 /end MEASUREMENT
/begin MEASUREMENT Rail_facIASetPDynCor_mp "lufttemperatursollwertabhängiger Korrekturfaktor" SWORD Fact 1 100 -4.000000 3.999878 FORMAT "%8.6" ECU_ADDRESS 0x8FFC96 /end MEASUREMENT
/begin MEASUREMENT Rail_facPCVTiRmpVal_mp "aktueller Rampenwert der Rampe bei Umschaltung von Regelung über Druckregelventil auf Regelung über Zumesseinheit" SWORD Fact 1 100 -4.000000 3.999878 FORMAT "%8.6" ECU_ADDRESS 0x8FFC6A /end MEASUREMENT
/begin MEASUREMENT Rail_facSetPointAPSCor "Gewichtungsfaktor für atmosphärendruckabhängige Sollwertkorrektur des Raildrucks" SWORD Fact 1 100 -4.000000 3.999878 FORMAT "%8.6" ECU_ADDRESS 0x7F901A /end MEASUREMENT
/begin MEASUREMENT Rail_facSetPointAPSCStrt "Gewichtungsfaktor für atmosphärendruckabhängige Sollwertkorrektur des Raildrucks beim Start" SWORD Fact 1 100 -4.000000 3.999878 FORMAT "%8.6" ECU_ADDRESS 0x7F9018 /end MEASUREMENT
/begin MEASUREMENT Rail_facSetPointATSCor "Gewichtungsfaktor für ansauglufttemperaturabhängige Sollwertkorrektur des Raildrucks" SWORD Fact 1 100 -4.000000 3.999878 FORMAT "%8.6" ECU_ADDRESS 0x7F901E /end MEASUREMENT
/begin MEASUREMENT Rail_facSetPointATSCStrt "Gewichtungsfaktor für ansauglufttemperaturabhängige Sollwertkorrektur des Raildrucks beim Start" SWORD Fact 1 100 -4.000000 3.999878 FORMAT "%8.6" ECU_ADDRESS 0x7F901C /end MEASUREMENT
/begin MEASUREMENT Rail_facSetPointETSCor "Gewichtungsfaktor für motortemperaturabhängige Sollwertkorrektur des Raildrucks" SWORD Fact 1 100 -4.000000 3.999878 FORMAT "%8.6" ECU_ADDRESS 0x7F9022 /end MEASUREMENT
/begin MEASUREMENT Rail_facSetPointETSCor1 "correction factor of rail pressure setpoint depending on coolant temperature" SWORD Fact 1 100 -4.000000 3.999878 FORMAT "%8.6" ECU_ADDRESS 0x7F9024 /end MEASUREMENT
/begin MEASUREMENT Rail_facSetPointETSCStrt "correction factor of rail pressure setpoint depending on engine temperature" SWORD Fact 1 100 -4.000000 3.999878 FORMAT "%8.6" ECU_ADDRESS 0x7F9020 /end MEASUREMENT
/begin MEASUREMENT Rail_facSetPointFTSCor_mp "Gewichtungsfaktor für kraftstofftemperaturabhängige Sollwertkorrektur des Raildruckreglers" SWORD Fact 1 100 -4.000000 3.999878 FORMAT "%8.6" ECU_ADDRESS 0x8FFC98 /end MEASUREMENT
/begin MEASUREMENT Rail_facTiRmpVal_mp "aktueller Rampenwert wenn von Offset-Kennlinie auf Reduzierter Offset-Kennlinie und andersherum gerampt wird" SWORD Fact 1 100 -4.000000 3.999878 FORMAT "%8.6" ECU_ADDRESS 0x8FFC6C /end MEASUREMENT
/begin MEASUREMENT Rail_pPCVClose_mp "Steuergröße um das Druckregelventil geschlossen zu halten" SWORD Pres_Rail 1 100 -3276.800 3276.700 FORMAT "%5.3" ECU_ADDRESS 0x8FFC6E /end MEASUREMENT
/begin MEASUREMENT Rail_pPCVOfs_mp "Rampenschalterausgang für die Steuergröße um das Druckregelventil geschlossen zu halten" SWORD Pres_Rail 1 100 -3276.800 3276.700 FORMAT "%5.3" ECU_ADDRESS 0x8FFC70 /end MEASUREMENT
/begin MEASUREMENT Rail_pPreCtl_mp "Vorsteuerwert für die Druckregelung über Druckregelventil" SWORD Pres_Rail 1 100 -3276.800 3276.700 FORMAT "%5.3" ECU_ADDRESS 0x8FFC72 /end MEASUREMENT
/begin MEASUREMENT Rail_pSetPDynCor_mp "dynamischer, additiver Korrekturwert" SWORD Pres_Rail 1 100 -3276.800 3276.700 FORMAT "%5.3" ECU_ADDRESS 0x8FFC9A /end MEASUREMENT
/begin MEASUREMENT Rail_pSetPoint "Raildruck-sollwert" SWORD Pres_Rail 1 100 -3276.800 3276.700 FORMAT "%5.3" ECU_ADDRESS 0x7F902C /end MEASUREMENT
/begin MEASUREMENT Rail_pSetPointAddCor "Schnittstelle für Erweiterungen der Korrekturen für den Raildrucksollwert" SWORD Pres_Rail 1 100 -3276.800 3276.700 FORMAT "%5.3" ECU_ADDRESS 0x7F902E /end MEASUREMENT
/begin MEASUREMENT Rail_pSetPointAPSCor_mp "Raildruck-Korrekturwert, abhängig vom Atmosphärendruck" SWORD Pres_Rail 1 100 -3276.800 3276.700 FORMAT "%5.3" ECU_ADDRESS 0x8FFC9E /end MEASUREMENT
/begin MEASUREMENT Rail_pSetPointAPSCStrt_mp "Raildruck-Korrekturwert, abhängig vom Atmosphärendruck beim Start" SWORD Pres_Rail 1 100 -3276.800 3276.700 FORMAT "%5.3" ECU_ADDRESS 0x8FFCA0 /end MEASUREMENT
/begin MEASUREMENT Rail_pSetPointATSCor_mp "Raildruck-Korrekturwert, abhängig von der Ansauglufttemperatur" SWORD Pres_Rail 1 100 -3276.800 3276.700 FORMAT "%5.3" ECU_ADDRESS 0x8FFCA2 /end MEASUREMENT
/begin MEASUREMENT Rail_pSetPointATSCStrt_mp "Raildruck-Korrekturwert, abhängig von der Ansauglufttemperatur beim Start" SWORD Pres_Rail 1 100 -3276.800 3276.700 FORMAT "%5.3" ECU_ADDRESS 0x8FFCA4 /end MEASUREMENT
/begin MEASUREMENT Rail_pSetPointBase_mp "Basissollwert des Raildrucks" SWORD Pres_Rail 1 100 -3276.800 3276.700 FORMAT "%5.3" ECU_ADDRESS 0x8FFC7C /end MEASUREMENT
/begin MEASUREMENT Rail_pSetPointBattMin_mp "batteriespannungsabhängig korrigierter Raildruck-Sollwert" SWORD Pres_Rail 1 100 -3276.800 3276.700 FORMAT "%5.3" ECU_ADDRESS 0x8FFC7E /end MEASUREMENT
/begin MEASUREMENT Rail_pSetPointCor_mp "korrigierter Raildruck Sollwert, abhängig vom projektspezifischen Eingriff und von Umgebungsbedingungen" SWORD Pres_Rail 1 100 -3276.800 3276.700 FORMAT "%5.3" ECU_ADDRESS 0x8FFC80 /end MEASUREMENT
/begin MEASUREMENT Rail_pSetPointDec_mp "maximaler Raildruck-Sollwertabfall pro Schedulesequenz" SWORD Pres_Rail 1 100 -3276.800 3276.700 FORMAT "%5.3" ECU_ADDRESS 0x8FFC82 /end MEASUREMENT
/begin MEASUREMENT Rail_pSetPointDynLim_mp "Raildruck Sollwert mir dynamischer Begrenzung" SWORD Pres_Rail 1 100 -3276.800 3276.700 FORMAT "%5.3" ECU_ADDRESS 0x8FFC84 /end MEASUREMENT
/begin MEASUREMENT Rail_pSetPointEnvCor "Raildruck-Korrekturwert, abhängig von den Umgebungsbedingungen" SWORD Pres_Rail 1 100 -3276.800 3276.700 FORMAT "%5.3" ECU_ADDRESS 0x7F9030 /end MEASUREMENT
/begin MEASUREMENT Rail_pSetPointEnvCorStrt "Raildruck-Korrekturwert, abhängig von den Umgebungsbedingungen beim Start" SWORD Pres_Rail 1 100 -3276.800 3276.700 FORMAT "%5.3" ECU_ADDRESS 0x7F9032 /end MEASUREMENT
/begin MEASUREMENT Rail_pSetPointETSCor1_mp "correction value of rail pressure setpoint depending on ETS" SWORD Pres_Rail 1 100 -3276.800 3276.700 FORMAT "%5.3" ECU_ADDRESS 0x8FFCA6 /end MEASUREMENT
/begin MEASUREMENT Rail_pSetPointETSCor_mp "Raildruck-Korrekturwert, abhängig von der Motortemperatur" SWORD Pres_Rail 1 100 -3276.800 3276.700 FORMAT "%5.3" ECU_ADDRESS 0x8FFCA8 /end MEASUREMENT
/begin MEASUREMENT Rail_pSetPointETSCStrt_mp "correction value of rail pressure setpoint depending on ETS start" SWORD Pres_Rail 1 100 -3276.800 3276.700 FORMAT "%5.3" ECU_ADDRESS 0x8FFCAA /end MEASUREMENT
/begin MEASUREMENT Rail_pSetPointFlTempCor "Raildruck-Korrekturwert, abhängig von der Kraftstofftemperatur" SWORD Pres_Rail 1 100 -3276.800 3276.700 FORMAT "%5.3" ECU_ADDRESS 0x7F9034 /end MEASUREMENT
/begin MEASUREMENT Rail_pSetPointFlTempLim "Begrenzter Raildruck-Sollwert unter Berücksichtigung der Kraftstofftemperatur-Korrektur" SWORD Pres_Rail 1 100 -3276.800 3276.700 FORMAT "%5.3" ECU_ADDRESS 0x7F9036 /end MEASUREMENT
/begin MEASUREMENT Rail_pSetPointFlTempLim_mp "Begrenzter Raildruck-Sollwert unter Berücksichtigung der Kraftstofftemperatur-Korrektur" SWORD Pres_Rail 1 100 -3276.800 3276.700 FORMAT "%5.3" ECU_ADDRESS 0x8FFC86 /end MEASUREMENT
/begin MEASUREMENT Rail_pSetPointFlTempUnlim "unbegrenzter Raildruck-Sollwert unter Berücksichtigung der Kraftstofftemperatur-Korrektur" SWORD Pres_Rail 1 100 -3276.800 3276.700 FORMAT "%5.3" ECU_ADDRESS 0x7F9038 /end MEASUREMENT
/begin MEASUREMENT Rail_pSetPointInc_mp "maximaler Raildruck-Sollwertanstieg pro Schedulesequenz" SWORD Pres_Rail 1 100 -3276.800 3276.700 FORMAT "%5.3" ECU_ADDRESS 0x8FFC88 /end MEASUREMENT
/begin MEASUREMENT Rail_pSetPointLimNFlTemp "maximaler Raildrucksollwert, abhängig von der Kraftstofftemperatur und der Motordrehzahl" SWORD Pres_Rail 1 100 -3276.800 3276.700 FORMAT "%5.3" ECU_ADDRESS 0x7F903A /end MEASUREMENT
/begin MEASUREMENT Rail_pSetPointLim_mp "Raildrucksollwert nach Bereichsbegrenzung im Normalbetrieb" SWORD Pres_Rail 1 100 -3276.800 3276.700 FORMAT "%5.3" ECU_ADDRESS 0x8FFC8A /end MEASUREMENT
/begin MEASUREMENT Rail_pSetPointMax "maximaler Raildrucksollwert" SWORD Pres_Rail 1 100 -3276.800 3276.700 FORMAT "%5.3" ECU_ADDRESS 0x7F903C /end MEASUREMENT
/begin MEASUREMENT Rail_pSetPointMaxDef_mp "maximaler Raildruck-Sollwert im Fehlerfall" SWORD Pres_Rail 1 100 -3276.800 3276.700 FORMAT "%5.3" ECU_ADDRESS 0x8FFC9C /end MEASUREMENT
/begin MEASUREMENT Rail_pSetPointMin "minimaler Raildrucksollwert" SWORD Pres_Rail 1 100 -3276.800 3276.700 FORMAT "%5.3" ECU_ADDRESS 0x7F903E /end MEASUREMENT
/begin MEASUREMENT Rail_pSetPointOut_mp "Raildruck-Sollwert nach Eingriff der Regeneration" SWORD Pres_Rail 1 100 -3276.800 3276.700 FORMAT "%5.3" ECU_ADDRESS 0x8FFC8C /end MEASUREMENT
/begin MEASUREMENT Rail_pSetPointRgn "Raildruck-Sollwert im Regenerationsbetrieb" SWORD Pres_Rail 1 100 -3276.800 3276.700 FORMAT "%5.3" ECU_ADDRESS 0x7F9040 /end MEASUREMENT
/begin MEASUREMENT Rail_pSetPointSubst "Externe Anforderung für den Raildruck-Sollwert" SWORD Pres_Rail 1 100 -3276.800 3276.700 FORMAT "%5.3" ECU_ADDRESS 0x7F9042 /end MEASUREMENT
/begin MEASUREMENT Rail_pSetPointZFC_mp "Raildrucksollwert nach Eingriff der Nullmengenkalibrierung" SWORD Pres_Rail 1 100 -3276.800 3276.700 FORMAT "%5.3" ECU_ADDRESS 0x6F8188 /end MEASUREMENT
/begin MEASUREMENT Rail_pZFCInit_mp "anfänglicher ZFC Raildrucksollwert für PT1 Filter" SWORD Pres_Rail 1 100 -3276.800 3276.700 FORMAT "%5.3" ECU_ADDRESS 0x8FFCAC /end MEASUREMENT
/begin MEASUREMENT Rail_qPreCtlBas_mp "ausgewählte Einspritzmenge für die Vorsteuerung" SWORD InjMassCyc 1 100 -327.6800 327.6700 FORMAT "%8.4" ECU_ADDRESS 0x8FFC68 /end MEASUREMENT
/begin MEASUREMENT Rail_RgnVal_mp "Wert für Regenerationsstatus der Raildrucksollwertes" ULONG EGTSwt 1 100 0.00 262.143999939 FORMAT "%13.9" ECU_ADDRESS 0x8FFC78 /end MEASUREMENT
/begin MEASUREMENT Rail_SetPointRed_mp "increase minimum time if Fid_RailSetPointRed is active" UBYTE OneToOne 1 100 0.00 255.0 FORMAT "%5.1" ECU_ADDRESS 0x8FFC8E /end MEASUREMENT
/begin MEASUREMENT Rail_stPeakMinZFC_mp "Zustand des Automaten ""Bestimmung der Mindestschwelle des Raildrucks""" UBYTE OneToOne 1 100 0.00 255.0 FORMAT "%5.1" ECU_ADDRESS 0x8FFCAE /end MEASUREMENT
/begin MEASUREMENT Rail_stZFCDem_mp "Status für geschlossenes Druckregelventil bei aktiver Lernphase der ZFC" UBYTE OneToOne 1 100 0.00 255.0 FORMAT "%5.1" ECU_ADDRESS 0x8FFC74 /end MEASUREMENT
/begin MEASUREMENT Rail_tiPCVRmpDur_mp "Laufzeit der Rampe um vom aktuellen Sollwert auf den neuen PCVClose-Wert zu rampen" SWORD Time_ms 1 100 -327680.0 327670.0 FORMAT "%8.1" ECU_ADDRESS 0x8FFC76 /end MEASUREMENT
/begin MEASUREMENT RTMMon_dTaskIDLimitNOK "Task ID, der letzten Task, die ihre applizierte Laufzeit überschritten hat." SWORD OneToOne 1 100 -32768.00 32767.00 FORMAT "%8.2" ECU_ADDRESS 0x7F8FFC /end MEASUREMENT
/begin MEASUREMENT RTMMon_tiTaskActiveLimit_mp "Maximal zulässige Laufzeit des aktiven Tasks." UWORD Time_ms 1 100 0.00 655350.0 FORMAT "%8.1" ECU_ADDRESS 0x8FFCC4 /end MEASUREMENT
/begin MEASUREMENT RTMMon_tiTaskActive_mp "Laufzeit des aktuellen Tasks" UWORD Time_ms 1 100 0.00 655350.0 FORMAT "%8.1" ECU_ADDRESS 0x8FFCC6 /end MEASUREMENT
/begin MEASUREMENT Rtmo_ctInterrupt_u32 "Anzahl der Unterbrechungen der zu messenden Funktion innerhalb des letzten Messzyklus (keine reentranten Interrupts)" ULONG OneToOne 1 100 0.00 4294967295.00 FORMAT "%13.2" ECU_ADDRESS 0x7FC968 /end MEASUREMENT
/begin MEASUREMENT Rtmo_ctReentrantSample_u32 "Aufrufanzahl der zu messenden Funktion innerhalb des letzten Messzyklus, wobei Funktion bereits aktiv war (reentranter Aufruf)" ULONG OneToOne 1 100 0.00 4294967295.00 FORMAT "%13.2" ECU_ADDRESS 0x7FC970 /end MEASUREMENT
/begin MEASUREMENT Rtmo_ctSampleProc_u8 "Zähler wird nach jeder Messwertermittlung inkrementiert" UBYTE OneToOne 1 100 0.00 255.0 FORMAT "%5.1" ECU_ADDRESS 0x7FC984 /end MEASUREMENT
/begin MEASUREMENT Rtmo_ctSample_u32 "Anzahl der Aufrufe der zu messenden Funktion innerhalb des letzten Messzyklus (keine reentranten Aufrufe)" ULONG OneToOne 1 100 0.00 4294967295.00 FORMAT "%13.2" ECU_ADDRESS 0x7FC96C /end MEASUREMENT
/begin MEASUREMENT Rtmo_tiAbsMax_u32 "Maximale Laufzeit der zu messenden Funktion seit letztem Rücksetzen (Rtmo_swMinMaxReset_cu8)" ULONG TimeSys_us 1 100 0.00 1228361874.73 FORMAT "%13.2" ECU_ADDRESS 0x7FC964 /end MEASUREMENT
/begin MEASUREMENT Rtmo_tiAbsMin_u32 "Minimale Laufzeit der zu messenden Funktion seit letztem Rücksetzen (Rtmo_swMinMaxReset_cu8)" ULONG TimeSys_us 1 100 0.00 1228361874.73 FORMAT "%13.2" ECU_ADDRESS 0x7FC960 /end MEASUREMENT
/begin MEASUREMENT Rtmo_tiAvrg_u32 "durchschnittliche Laufzeit der zu messenden Funktion innerhalb des letzten Messzyklus" ULONG TimeSys_us 1 100 0.00 1228361874.73 FORMAT "%13.2" ECU_ADDRESS 0x7FC954 /end MEASUREMENT
/begin MEASUREMENT Rtmo_tiLoad_u32 "aktuelle Laufzeit" ULONG RtmoTicksToPercent 1 100 -122736.187473 100.000000000 FORMAT "%13.6" ECU_ADDRESS 0x7FC980 /end MEASUREMENT
/begin MEASUREMENT Rtmo_tiMaxCallDist_u32 "Maximaler Zeitabstand zwischen zwei Funktions/Task-Aufrufen" ULONG TimeSys_us 1 100 0.00 1228361874.73 FORMAT "%13.2" ECU_ADDRESS 0x7FC978 /end MEASUREMENT
/begin MEASUREMENT Rtmo_tiMaxLoad_u32 "Maximale Laufzeit" ULONG RtmoTicksToPercent 1 100 -122736.187473 100.000000000 FORMAT "%13.6" ECU_ADDRESS 0x7FC97C /end MEASUREMENT
/begin MEASUREMENT Rtmo_tiMax_u32 "Maximale Laufzeit der zu messenden Funktion innerhalb des letzten Messzyklus" ULONG TimeSys_us 1 100 0.00 1228361874.73 FORMAT "%13.2" ECU_ADDRESS 0x7FC95C /end MEASUREMENT
/begin MEASUREMENT Rtmo_tiMinCallDist_u32 "Minimaler Zeitabstand zwischen zwei Funktions/Task-Aufrufen" ULONG TimeSys_us 1 100 0.00 1228361874.73 FORMAT "%13.2" ECU_ADDRESS 0x7FC974 /end MEASUREMENT
/begin MEASUREMENT Rtmo_tiMin_u32 "Minimale Laufzeit der zu messenden Funktion innerhalb des letzten Messzyklus" ULONG TimeSys_us 1 100 0.00 1228361874.73 FORMAT "%13.2" ECU_ADDRESS 0x7FC958 /end MEASUREMENT
/begin MEASUREMENT ShutCD_stActrOut_mp "Luftklappensteuerung  Ansteuersignal" UBYTE OneToOne 1 100 0.00 255.0 FORMAT "%5.1" ECU_ADDRESS 0x8FFCC8 /end MEASUREMENT
/begin MEASUREMENT Shuttr_stLogicOut "Ansteuerzustand der Zuluftklappe" UBYTE OneToOne 1 100 0.00 255.0 FORMAT "%5.1" ECU_ADDRESS 0x7F897F /end MEASUREMENT
/begin MEASUREMENT Shuttr_stLogic_mp "Bitdisplay - Ansteuerbedingungen der Zuluftklappe" UBYTE OneToOne 1 100 0.00 255.0 FORMAT "%5.1" ECU_ADDRESS 0x8FFCC9 /end MEASUREMENT
/begin MEASUREMENT signals_stTestNLim_mp "Meßpunkt für Status Drehzahlbegrenzung von Stellertests" UBYTE OneToOne 1 100 0.00 255.0 FORMAT "%5.1" ECU_ADDRESS 0x8FFCCC /end MEASUREMENT
/begin MEASUREMENT signals_stTest_mp "Meßpunkt für Status Stellertest" ULONG OneToOne 1 100 0.00 4294967295.00 FORMAT "%13.2" ECU_ADDRESS 0x8FFCD0 /end MEASUREMENT
/begin MEASUREMENT signals_tiTstRemain_mp "Meßpunkt für verbleibende Zeit bis zur Abschaltung Stellertest über Zeitgrenze" UWORD Time_ms 1 100 0.00 655350.0 FORMAT "%8.1" ECU_ADDRESS 0x8FFCD4 /end MEASUREMENT
/begin MEASUREMENT SOPTst_stCyl "Endstufen die sich trotz redundanter Abschaltung aktivieren ließen" UBYTE OneToOne 1 100 0.00 255.0 FORMAT "%5.1" ECU_ADDRESS 0x7F897E /end MEASUREMENT
/begin MEASUREMENT SPMon_numFreeErcosekStack_mp "Freier Ercosek Stack (Schleppzeiger im eeprom)" UWORD OneToOne 1 100 0.00 65535.00 FORMAT "%8.2" ECU_ADDRESS 0x6F818C /end MEASUREMENT
/begin MEASUREMENT SPMon_numFreeUserStack_mp "Meßpunkt für freien Userstackbereich" UWORD OneToOne 1 100 0.00 65535.00 FORMAT "%8.2" ECU_ADDRESS 0x6F818E /end MEASUREMENT
/begin MEASUREMENT SrvPmp_dphiStrg_mp "Streeing Angle derivative" SWORD AngleGradPerSec 1 100 -1440.154 1440.110 FORMAT "%8.3" ECU_ADDRESS 0x8FFCD6 /end MEASUREMENT
/begin MEASUREMENT SrvPmp_pwrDes "Leistungsbedarf der Servopumpe" SWORD Pwr 1 100 -308831.1 308821.7 FORMAT "%8.1" ECU_ADDRESS 0x7F9048 /end MEASUREMENT
/begin MEASUREMENT SrvPmp_pwrLead "Leistungsvorhalt der Servopumpe" SWORD Pwr 1 100 -308831.1 308821.7 FORMAT "%8.1" ECU_ADDRESS 0x7F904A /end MEASUREMENT
/begin MEASUREMENT SrvPmp_trqDes_mp "Momentenbedarf der Servopumpe" SWORD Trq 1 100 -3276.800 3276.700 FORMAT "%8.3" ECU_ADDRESS 0x8FFCD8 /end MEASUREMENT
/begin MEASUREMENT SSpMon_stRaw_1_mp "Rohwert der Defekterkennung der Sensorversorgungsspannung 1" SWORD OneToOne 1 100 -32768.00 32767.00 FORMAT "%8.2" ECU_ADDRESS 0x8FFCDA /end MEASUREMENT
/begin MEASUREMENT SSpMon_stRaw_2_mp "Rohwert der Defekterkennung der Sensorversorgungsspannung 2" SWORD OneToOne 1 100 -32768.00 32767.00 FORMAT "%8.2" ECU_ADDRESS 0x8FFCDC /end MEASUREMENT
/begin MEASUREMENT SSpMon_stRaw_3_mp "Rohwert der Defekterkennung der Sensorversorgungsspannung 3" SWORD OneToOne 1 100 -32768.00 32767.00 FORMAT "%8.2" ECU_ADDRESS 0x8FFCDE /end MEASUREMENT
/begin MEASUREMENT SSpMon_stSSpErr "Fehlerstatus der Sensorversorgungsspannungen" UWORD OneToOne 1 100 0.00 65535.00 FORMAT "%8.2" ECU_ADDRESS 0x7F9046 /end MEASUREMENT
/begin MEASUREMENT StrtCD_stHWE_mp "zu stellender Zustand an der Digitalendstufe nach der Fehlerbehandlung" UBYTE OneToOne 1 100 0.00 255.0 FORMAT "%5.1" ECU_ADDRESS 0x8FFCE0 /end MEASUREMENT
/begin MEASUREMENT StSys_facAPSCor_mp "factor for starting torque correction value" SWORD Fact 1 100 -4.000000 3.999878 FORMAT "%8.6" ECU_ADDRESS 0x8FFCE2 /end MEASUREMENT
/begin MEASUREMENT StSys_stActrLck_mp "Statusregister Ausspurbedingungen" UWORD OneToOne 1 100 0.00 65535.00 FORMAT "%8.2" ECU_ADDRESS 0x8FFCF4 /end MEASUREMENT
/begin MEASUREMENT StSys_stActrOut "Anlasserzustand" UBYTE OneToOne 1 100 0.00 255.0 FORMAT "%5.1" ECU_ADDRESS 0x7F8981 /end MEASUREMENT
/begin MEASUREMENT StSys_stActrRls_mp "Statusregister Einspurbedingungen" UBYTE OneToOne 1 100 0.00 255.0 FORMAT "%5.1" ECU_ADDRESS 0x8FFCF6 /end MEASUREMENT
/begin MEASUREMENT StSys_stRmpMon "Zustand der Startmomenterhoehung" UBYTE OneToOne 1 100 0.00 255.0 FORMAT "%5.1" ECU_ADDRESS 0x7F8983 /end MEASUREMENT
/begin MEASUREMENT StSys_trqAddCor "zusaetzliches Korrekturmoment f. Startmoment" SWORD Trq 1 100 -3276.800 3276.700 FORMAT "%8.3" ECU_ADDRESS 0x7F9050 /end MEASUREMENT
/begin MEASUREMENT StSys_trqAdj_mp "Startmomentkorrektur" SWORD Trq 1 100 -3276.800 3276.700 FORMAT "%8.3" ECU_ADDRESS 0x8FFCEE /end MEASUREMENT
/begin MEASUREMENT StSys_trqBas "Startbasismoment" SWORD Trq 1 100 -3276.800 3276.700 FORMAT "%8.3" ECU_ADDRESS 0x7F9052 /end MEASUREMENT
/begin MEASUREMENT StSys_trqRmpState "Moment der Startrampe" SWORD Trq 1 100 -3276.800 3276.700 FORMAT "%8.3" ECU_ADDRESS 0x7F9054 /end MEASUREMENT
/begin MEASUREMENT StSys_trqSetAdjVal_mp "EEPROM Abgleichwert Startmoment-Korrektur" SWORD Trq 1 100 -3276.800 3276.700 FORMAT "%8.3" ECU_ADDRESS 0x8FFCF0 /end MEASUREMENT
/begin MEASUREMENT StSys_trqStrt "inneres Moment Startwert" SWORD Trq 1 100 -3276.800 3276.700 FORMAT "%8.3" ECU_ADDRESS 0x7F9056 /end MEASUREMENT
/begin MEASUREMENT StSys_trqStrtAPSCor_mp " starting torque correction" SWORD Trq 1 100 -3276.800 3276.700 FORMAT "%8.3" ECU_ADDRESS 0x8FFCE4 /end MEASUREMENT
/begin MEASUREMENT StSys_trqStrtAPS_mp "starting torque correction" SWORD Trq 1 100 -3276.800 3276.700 FORMAT "%8.3" ECU_ADDRESS 0x8FFCE6 /end MEASUREMENT
/begin MEASUREMENT StSys_trqStrtBas_mp "Basismoment fuer Start" SWORD Trq 1 100 -3276.800 3276.700 FORMAT "%8.3" ECU_ADDRESS 0x8FFCF2 /end MEASUREMENT
/begin MEASUREMENT StSys_tStrtBas_mp "Aus dem Motortemperaturfeld Eng_tFld ausgewählte Temperatur" SWORD Temp_Cels 1 100 -50.140 899.860 FORMAT "%8.3" ECU_ADDRESS 0x8FFCE8 /end MEASUREMENT
/begin MEASUREMENT StSys_tStrtRmp_mp "Aus dem Motortemperaturfeld Eng_tFld ausgewählte Temperatur" SWORD Temp_Cels 1 100 -50.140 899.860 FORMAT "%8.3" ECU_ADDRESS 0x8FFCF8 /end MEASUREMENT
/begin FUNCTION rail_prectlmeun "Vorsteuerung für die Hochdruckregelung ueber Zumesseinheit"
 /begin DEF_CHARACTERISTIC Rail_dvolLeak_MAP Rail_dvolPreCtlBas_MAP Rail_dvolPreCtlOfs_MAP Rail_dvolPreCtlPoI1_MAP Rail_dvolPreCtlPoI2_MAP Rail_facLeakAged_C Rail_stPreCtlMeUnSel_C Rail_volInjVlvCtl_C /end DEF_CHARACTERISTIC
 /begin IN_MEASUREMENT Eng_nAvrg FlSys_t InjCrv_qPoI1Des_mp InjCrv_qPoI2Des_mp InjCtl_qSetUnBal Rail_pSetPoint Rail_qPreCtlBas_mp /end IN_MEASUREMENT
/end FUNCTION
/begin FUNCTION rail_prectlmeunrmtctl_uic "" /end FUNCTION
/begin FUNCTION rail_prectlmeun_uic ""
 /begin OUT_MEASUREMENT Rail_dvolInjVlvCtl_mp Rail_dvolLeak_mp Rail_dvolPreCtlBas_mp Rail_dvolPreCtlInit_mp Rail_dvolPreCtlOfs_mp Rail_dvolPreCtlPoI1_mp Rail_dvolPreCtlPoI2_mp Rail_dvolPreCtl_mp Rail_qPreCtlBas_mp /end OUT_MEASUREMENT
/end FUNCTION
/begin FUNCTION rail_prectlpcv "Vorsteuerung für die Hochdruckregelung ueber Druckregelventil"
 /begin DEF_CHARACTERISTIC Rail_dvolRedOfsLim_C Rail_pPCVCloseOfs_CUR Rail_pPCVRedOfs_CUR Rail_pPreCtl_MAP Rail_pRedOfsLim_C Rail_qRedOfsLim_C Rail_tiPCVRmpDur_CUR Rail_tiPCVRmpToOfs_C Rail_tiPCVRmpToRedOfs_C /end DEF_CHARACTERISTIC
 /begin IN_MEASUREMENT Eng_nAvrg Rail_pSetPoint /end IN_MEASUREMENT
/end FUNCTION
/begin FUNCTION rail_prectlpcvrmtctl_uic "" /end FUNCTION
/begin FUNCTION rail_prectlpcv_uic ""
 /begin OUT_MEASUREMENT Rail_facPCVTiRmpVal_mp Rail_facTiRmpVal_mp Rail_pPCVClose_mp Rail_pPCVOfs_mp Rail_pPreCtl_mp Rail_stZFCDem_mp Rail_tiPCVRmpDur_mp /end OUT_MEASUREMENT
/end FUNCTION
/begin FUNCTION rail_rgn "Raildrucksollwert Regenerationswertberechnung" /begin DEF_CHARACTERISTIC Rail_pSetPointRgn_MAP /end DEF_CHARACTERISTIC /begin IN_MEASUREMENT Eng_nAvrg InjCtl_qCurr /end IN_MEASUREMENT /end FUNCTION
/begin FUNCTION rail_rgnlib "Funktionsbibliothek für die Regenerationsumschaltung des Raildrucksollwertes" /begin DEF_CHARACTERISTIC Rail_dtiRgnRmpUp_C Rail_dtiRgnRmpDwn_C Rail_stRgnMsk_C /end DEF_CHARACTERISTIC /end FUNCTION
/begin FUNCTION rail_rgn_msg "" /begin OUT_MEASUREMENT Rail_pSetPointRgn /end OUT_MEASUREMENT /end FUNCTION
/begin FUNCTION rail_rgn_uic "" /begin DEF_CHARACTERISTIC Rail_pSetPointRgn_Vector Rail_pSetPointRgn_Channel /end DEF_CHARACTERISTIC /end FUNCTION
/begin FUNCTION rail_setpoint "Raildruckregler Sollwertberechnung"
 /begin DEF_CHARACTERISTIC Rail_dpSetPointDec_C Rail_dpSetPointIncFDC_MAP Rail_dpSetPointInc_MAP Rail_pSetPointBaseFDC_MAP Rail_pSetPointBaseStrt_MAP Rail_pSetPointBase_MAP Rail_pSetPointBattMin_CUR Rail_pSetPointInit_C Rail_pSetPointRed_C Rail_stRgnDelMsk_C Rail_stSetPointSel_C Rail_tiSetPointRedMin_C /end DEF_CHARACTERISTIC
 /begin IN_MEASUREMENT BattCD_u Eng_nAvrg InjCtl_qCurr InjCtl_qSetUnBal /end IN_MEASUREMENT
 /begin OUT_MEASUREMENT Rail_RgnVal_mp /end OUT_MEASUREMENT
/end FUNCTION
/begin FUNCTION rail_setpointaddcor "Berechnung projektspezifischer Korrekturen für Raildruck-Sollwert"
 /begin DEF_CHARACTERISTIC Rail_facAPSetPDynCor_CUR Rail_facDQSetPDynCor_CUR Rail_facETSetPDynCor_CUR Rail_facIASetPDynCor_CUR Rail_facSetPointFTSCor_CUR Rail_pSetPDynCor_MAP Rail_pSetPointFTSCor_MAP Rail_pSetPointLimNFlTemp_C Rail_pSetPointMaxDef_CUR Rail_pSetPointMaxDef_MAP Rail_pSetPointMax_MAP Rail_pSetPointMinDef_C Rail_pSetPointMin_MAP /end DEF_CHARACTERISTIC
 /begin IN_MEASUREMENT APSCD_pVal Eng_nAvrg FTSCD_tFuel IATSCD_tAir InjCrv_dqSetUnBalFltLim InjCrv_qTot InjCrv_tEng InjCtl_qCurr InjCtl_qSetUnBal /end IN_MEASUREMENT
/end FUNCTION
/begin FUNCTION rail_setpointaddcorrgn "Berechnung projektspezifischer Korrekturen für Raildruck-Sollwert für den Regenerationsbetrieb" /end FUNCTION
/begin FUNCTION rail_setpointaddcorrgn_msg "" /end FUNCTION
/begin FUNCTION rail_setpointaddcorrgn_uic "" /end FUNCTION
/begin FUNCTION rail_setpointaddcor_msg ""
 /begin OUT_MEASUREMENT Rail_pSetPointAddCor Rail_pSetPointFlTempCor Rail_pSetPointLimNFlTemp Rail_pSetPointMax Rail_pSetPointMin /end OUT_MEASUREMENT
/end FUNCTION
/begin FUNCTION rail_setpointaddcor_uic ""
 /begin OUT_MEASUREMENT Rail_facAPSetPDynCor_mp Rail_facDQSetPDynCor_mp Rail_facETSetPDynCor_mp Rail_facIASetPDynCor_mp Rail_facSetPointFTSCor_mp Rail_pSetPDynCor_mp Rail_pSetPointMaxDef_mp /end OUT_MEASUREMENT
/end FUNCTION
/begin FUNCTION rail_setpointenvcor "Berechnung der Korrekturen für Raildruck-Sollwert"
 /begin DEF_CHARACTERISTIC Rail_pSetPointAPSCor_MAP Rail_pSetPointAPSCStrt_MAP Rail_pSetPointATSCor_MAP Rail_pSetPointATSCStrt_MAP Rail_pSetPointETSCor1_MAP Rail_pSetPointETSCor_MAP Rail_pSetPointETSCStrt_MAP /end DEF_CHARACTERISTIC
 /begin IN_MEASUREMENT Eng_nAvrg InjCtl_qCurr /end IN_MEASUREMENT
/end FUNCTION
/begin FUNCTION rail_setpointenvcorrgn "Berechnung der Korrekturen für Raildruck-Sollwert für den Regenerationsbetrieb" /end FUNCTION
/begin FUNCTION rail_setpointenvcorrgn_msg "" /end FUNCTION
/begin FUNCTION rail_setpointenvcorrgn_uic "" /end FUNCTION
/begin FUNCTION rail_setpointenvcorslow "Gewichtungsfaktoren für die Raildruck-Sollwertkorrekturen"
 /begin DEF_CHARACTERISTIC Rail_facSetPointAPSCor_CUR Rail_facSetPointAPSCStrt_CUR Rail_facSetPointATSCor_CUR Rail_facSetPointATSCStrt_CUR Rail_facSetPointETSCor1_CUR Rail_facSetPointETSCor_CUR Rail_facSetPointETSCStrt_CUR /end DEF_CHARACTERISTIC
 /begin IN_MEASUREMENT APSCD_pVal IATSCD_tAir InjCrv_tEng /end IN_MEASUREMENT
/end FUNCTION
/begin FUNCTION rail_setpointenvcorslowrgn "Gewichtungsfaktoren für die Raildruck-Sollwertkorrekturen für den Regenerationsbetrieb" /end FUNCTION
/begin FUNCTION rail_setpointenvcorslowrgn_msg "" /end FUNCTION
/begin FUNCTION rail_setpointenvcorslowrgn_uic "" /end FUNCTION
/begin FUNCTION rail_setpointenvcorslow_msg ""
 /begin OUT_MEASUREMENT Rail_facSetPointAPSCor Rail_facSetPointAPSCStrt Rail_facSetPointATSCor Rail_facSetPointATSCStrt Rail_facSetPointETSCor Rail_facSetPointETSCor1 Rail_facSetPointETSCStrt /end OUT_MEASUREMENT
/end FUNCTION
/begin FUNCTION rail_setpointenvcorslow_uic "" /end FUNCTION
/begin FUNCTION rail_setpointenvcor_msg "" /begin OUT_MEASUREMENT Rail_pSetPointEnvCor Rail_pSetPointEnvCorStrt /end OUT_MEASUREMENT /end FUNCTION
/begin FUNCTION rail_setpointenvcor_uic ""
 /begin OUT_MEASUREMENT Rail_pSetPointAPSCor_mp Rail_pSetPointAPSCStrt_mp Rail_pSetPointATSCor_mp Rail_pSetPointATSCStrt_mp Rail_pSetPointETSCor1_mp Rail_pSetPointETSCor_mp Rail_pSetPointETSCStrt_mp /end OUT_MEASUREMENT
/end FUNCTION
/begin FUNCTION rail_setpointrmtctl_uic "" /end FUNCTION
/begin FUNCTION rail_setpoint_msg ""
 /begin OUT_MEASUREMENT Rail_dpSetPointInc Rail_pSetPoint Rail_pSetPointFlTempLim Rail_pSetPointFlTempUnlim /end OUT_MEASUREMENT
/end FUNCTION
/begin FUNCTION rail_setpoint_uic "" /begin DEF_CHARACTERISTIC Rail_pSetPoint_Vector Rail_pSetPoint_Channel /end DEF_CHARACTERISTIC
 /begin OUT_MEASUREMENT Rail_pSetPointBase_mp Rail_pSetPointBattMin_mp Rail_pSetPointCor_mp Rail_pSetPointDec_mp Rail_pSetPointDynLim_mp Rail_pSetPointFlTempLim_mp Rail_pSetPointInc_mp Rail_pSetPointLim_mp Rail_pSetPointOut_mp Rail_pSetPointZFC_mp Rail_SetPointRed_mp /end OUT_MEASUREMENT
/end FUNCTION
/begin FUNCTION rail_setsubst "" /end FUNCTION
/begin FUNCTION rail_setsubst_msg "" /begin OUT_MEASUREMENT Rail_pSetPointSubst /end OUT_MEASUREMENT /end FUNCTION
/begin FUNCTION rail_setsubst_uic "" /end FUNCTION
/begin FUNCTION rail_zfclib "Funktionsbibliothek für den Eingriff der Nullmengenkallibrierung im Raildruckregler"
 /begin DEF_CHARACTERISTIC Rail_pPeakMinZFC_C Rail_pSetPointZFCMax_C Rail_pSetPointZFCMin_C Rail_rPeakMinSlpZFC_C Rail_rZFCInitDwn_CUR Rail_rZFCInitUp_CUR Rail_tiZFCDemDel_C Rail_tiZFCPT1_C /end DEF_CHARACTERISTIC
 /begin IN_MEASUREMENT ZFC_pRailSetPoint_mp /end IN_MEASUREMENT
/end FUNCTION
/begin FUNCTION rail_zfclib_uic "" /begin OUT_MEASUREMENT Rail_pZFCInit_mp Rail_stPeakMinZFC_mp /end OUT_MEASUREMENT /end FUNCTION
/begin FUNCTION rtmmon "Laufzeitmessungen"
 /begin DEF_CHARACTERISTIC RTMMon_dMaxCheckDef_C RTMMon_dMaxCheckOk_C RTMMon_dPlausCheckDef_C RTMMon_dPlausCheckOk_C RTMMon_tiNoPlausCheck_C /end DEF_CHARACTERISTIC
/end FUNCTION
/begin FUNCTION rtmmon_msg "" /begin OUT_MEASUREMENT RTMMon_dTaskIDLimitNOK /end OUT_MEASUREMENT /end FUNCTION
/begin FUNCTION rtmmon_uic "" /begin OUT_MEASUREMENT RTMMon_tiTaskActiveLimit_mp RTMMon_tiTaskActive_mp /end OUT_MEASUREMENT /end FUNCTION
/begin FUNCTION rtmo "run time measurement online"
 /begin DEF_CHARACTERISTIC Rtmo_adCallingBegin_cu32 Rtmo_adCallingEnd_cu32 Rtmo_adStart_cu32 Rtmo_stIntOverhead_cu8 Rtmo_stSampleTime_cu8 Rtmo_swLoadMode_cu8 Rtmo_swMode_cu8 /end DEF_CHARACTERISTIC
/end FUNCTION
/begin FUNCTION rtmo_msg ""
 /begin OUT_MEASUREMENT Rtmo_ctInterrupt_u32 Rtmo_ctReentrantSample_u32 Rtmo_ctSampleProc_u8 Rtmo_ctSample_u32 Rtmo_tiAbsMax_u32 Rtmo_tiAbsMin_u32 Rtmo_tiAvrg_u32 Rtmo_tiLoad_u32 Rtmo_tiMaxCallDist_u32 Rtmo_tiMaxLoad_u32 Rtmo_tiMax_u32 Rtmo_tiMinCallDist_u32 Rtmo_tiMin_u32 /end OUT_MEASUREMENT
/end FUNCTION
/begin FUNCTION sched "" /end FUNCTION
/begin FUNCTION sched_msg "" /end FUNCTION
/begin FUNCTION shutcd_actrout ""
 /begin DEF_CHARACTERISTIC ShutCD_numDia_C ShutCD_numDioOut_C ShutCD_stInvOut_C ShutCD_stPwrStgActv_C ShutCD_stPwrStgDia_C ShutCD_tiDebExcTempDef_C ShutCD_tiDebExcTempOk_C ShutCD_tiDebNoLoadDef_C ShutCD_tiDebNoLoadOk_C ShutCD_tiDebShortCircBatDef_C ShutCD_tiDebShortCircBatOk_C ShutCD_tiDebShortCircGndDef_C ShutCD_tiDebShortCircGndOk_C /end DEF_CHARACTERISTIC
/end FUNCTION
/begin FUNCTION shutcd_actrout_uic "" /begin OUT_MEASUREMENT ShutCD_stActrOut_mp /end OUT_MEASUREMENT /end FUNCTION
/begin FUNCTION shuttr_logic ""
 /begin DEF_CHARACTERISTIC Shuttr_nFanXHi_C Shuttr_nFanXLo_C Shuttr_tEngXHi_C Shuttr_tEngXLo_C Shuttr_tGbxOilXHi_C Shuttr_tGbxOilXLo_C Shuttr_tiDebOff_C Shuttr_tiDebOn_C Shuttr_vXHi_C Shuttr_vXLo_C /end DEF_CHARACTERISTIC
/end FUNCTION
/begin FUNCTION shuttr_logic_msg "" /begin OUT_MEASUREMENT Shuttr_stLogicOut /end OUT_MEASUREMENT /end FUNCTION
/begin FUNCTION shuttr_logic_uic "" /begin OUT_MEASUREMENT Shuttr_stLogic_mp /end OUT_MEASUREMENT /end FUNCTION
/begin FUNCTION signals "Bereitstellung von applizierbaren Signalen und ihrer Umrechnung" /begin DEF_CHARACTERISTIC Signals_PID0x1C_C /end DEF_CHARACTERISTIC /end FUNCTION
/begin FUNCTION signals_base ""
 /begin DEF_CHARACTERISTIC Signals_adFreeApplic1_C Signals_numTypFreeApplic1_C Signals_adFreeApplic2_C Signals_numTypFreeApplic2_C Signals_adFreeApplic3_C Signals_numTypFreeApplic3_C Sig_aiDSMOffset_C Sig_aiDSMScale_C Sig_aiCANOffset_C Sig_aiCANScale_C Sig_aiDIAOffset_C Sig_aiDIAScale_C Sig_AngCrSDSMOffset_C Sig_AngCrSDSMScale_C Sig_AngCrSCANOffset_C Sig_AngCrSCANScale_C Sig_AngCrSDIAOffset_C Sig_AngCrSDIAScale_C Sig_aDSMOffset_C Sig_aDSMScale_C Sig_aCANOffset_C Sig_aCANScale_C Sig_aDIAOffset_C Sig_aDIAScale_C Sig_Carb_dtDSMOffset_C Sig_Carb_dtDSMScale_C Sig_Carb_dtCANOffset_C Sig_Carb_dtCANScale_C Sig_Carb_dtDIAOffset_C Sig_Carb_dtDIAScale_C Sig_Carb_lDSMOffset_C Sig_Carb_lDSMScale_C Sig_Carb_lCANOffset_C Sig_Carb_lCANScale_C Sig_Carb_lDIAOffset_C Sig_Carb_lDIAScale_C Sig_Carb_mAirTimDSMOffset_C Sig_Carb_mAirTimDSMScale_C Sig_Carb_mAirTimCANOffset_C Sig_Carb_mAirTimCANScale_C Sig_Carb_mAirTimDIAOffset_C Sig_Carb_mAirTimDIAScale_C Sig_Carb_nDSMOffset_C Sig_Carb_nDSMScale_C Sig_Carb_nCANOffset_C Sig_Carb_nCANScale_C Sig_Carb_nDIAOffset_C Sig_Carb_nDIAScale_C Sig_Carb_pDSMOffset_C Sig_Carb_pDSMScale_C Sig_Carb_pCANOffset_C Sig_Carb_pCANScale_C Sig_Carb_pDIAOffset_C Sig_Carb_pDIAScale_C Sig_Carb_rDSMOffset_C Sig_Carb_rDSMScale_C Sig_Carb_rCANOffset_C Sig_Carb_rCANScale_C Sig_Carb_rDIAOffset_C Sig_Carb_rDIAScale_C Sig_Carb_tiDSMOffset_C Sig_Carb_tiDSMScale_C Sig_Carb_tiCANOffset_C Sig_Carb_tiCANScale_C Sig_Carb_tiDIAOffset_C Sig_Carb_tiDIAScale_C Sig_Carb_tDSMOffset_C Sig_Carb_tDSMScale_C Sig_Carb_tCANOffset_C Sig_Carb_tCANScale_C Sig_Carb_tDIAOffset_C Sig_Carb_tDIAScale_C Sig_Carb_vDSMOffset_C Sig_Carb_vDSMScale_C Sig_Carb_vCANOffset_C Sig_Carb_vCANScale_C Sig_Carb_vDIAOffset_C Sig_Carb_vDIAScale_C Sig_dcycDSMOffset_C Sig_dcycDSMScale_C Sig_dcycCANOffset_C Sig_dcycCANScale_C Sig_dcycDIAOffset_C Sig_dcycDIAScale_C Sig_ddmAirTimeDSMOffset_C Sig_ddmAirTimeDSMScale_C Sig_ddmAirTimeCANOffset_C Sig_ddmAirTimeCANScale_C Sig_ddmAirTimeDIAOffset_C Sig_ddmAirTimeDIAScale_C Sig_dnDSMOffset_C Sig_dnDSMScale_C Sig_dnCANOffset_C Sig_dnCANScale_C Sig_dnDIAOffset_C Sig_dnDIAScale_C Sig_dpDSMOffset_C Sig_dpDSMScale_C Sig_dpCANOffset_C Sig_dpCANScale_C Sig_dpDIAOffset_C Sig_dpDIAScale_C Sig_dqCurrInjDSMOffset_C Sig_dqCurrInjDSMScale_C Sig_dqCurrInjCANOffset_C Sig_dqCurrInjCANScale_C Sig_dqCurrInjDIAOffset_C Sig_dqCurrInjDIAScale_C Sig_drAPPUnFltDSMOffset_C Sig_drAPPUnFltDSMScale_C Sig_drAPPUnFltCANOffset_C Sig_drAPPUnFltCANScale_C Sig_drAPPUnFltDIAOffset_C Sig_drAPPUnFltDIAScale_C Sig_ertmTimDSMOffset_C Sig_ertmTimDSMScale_C Sig_ertmTimCANOffset_C Sig_ertmTimCANScale_C Sig_ertmTimDIAOffset_C Sig_ertmTimDIAScale_C Sig_factDSMOffset_C Sig_factDSMScale_C Sig_factCANOffset_C Sig_factCANScale_C Sig_factDIAOffset_C Sig_factDIAScale_C Sig_FlConPFltDSMOffset_C Sig_FlConPFltDSMScale_C Sig_FlConPFltCANOffset_C Sig_FlConPFltCANScale_C Sig_FlConPFltDIAOffset_C Sig_FlConPFltDIAScale_C Sig_FlConDSMOffset_C Sig_FlConDSMScale_C Sig_FlConCANOffset_C Sig_FlConCANScale_C Sig_FlConDIAOffset_C Sig_FlConDIAScale_C Sig_fas1DSMOffset_C Sig_fas1DSMScale_C Sig_fas1CANOffset_C Sig_fas1CANScale_C Sig_fas1DIAOffset_C Sig_fas1DIAScale_C Sig_fas2DSMOffset_C Sig_fas2DSMScale_C Sig_fas2CANOffset_C Sig_fas2CANScale_C Sig_fas2DIAOffset_C Sig_fas2DIAScale_C Sig_fas3DSMOffset_C Sig_fas3DSMScale_C Sig_fas3CANOffset_C Sig_fas3CANScale_C Sig_fas3DIAOffset_C Sig_fas3DIAScale_C Sig_InjTimDSMOffset_C Sig_InjTimDSMScale_C Sig_InjTimCANOffset_C Sig_InjTimCANScale_C Sig_InjTimDIAOffset_C Sig_InjTimDIAScale_C Sig_km_sw_q10DSMOffset_C Sig_km_sw_q10DSMScale_C Sig_km_sw_q10CANOffset_C Sig_km_sw_q10CANScale_C Sig_km_sw_q10DIAOffset_C Sig_km_sw_q10DIAScale_C Sig_lenPFltDSMOffset_C Sig_lenPFltDSMScale_C Sig_lenPFltCANOffset_C Sig_lenPFltCANScale_C Sig_lenPFltDIAOffset_C Sig_lenPFltDIAScale_C Sig_lenrgnu16PFltDSMOffset_C Sig_lenrgnu16PFltDSMScale_C Sig_lenrgnu16PFltCANOffset_C Sig_lenrgnu16PFltCANScale_C Sig_lenrgnu16PFltDIAOffset_C Sig_lenrgnu16PFltDIAScale_C Sig_lenu16PFltDSMOffset_C Sig_lenu16PFltDSMScale_C Sig_lenu16PFltCANOffset_C Sig_lenu16PFltCANScale_C Sig_lenu16PFltDIAOffset_C Sig_lenu16PFltDIAScale_C Sig_lenDSMOffset_C Sig_lenDSMScale_C Sig_lenCANOffset_C Sig_lenCANScale_C Sig_lenDIAOffset_C Sig_lenDIAScale_C Sig_lDSMOffset_C Sig_lDSMScale_C Sig_lCANOffset_C Sig_lCANScale_C Sig_lDIAOffset_C Sig_lDIAScale_C Sig_mAirCylDSMOffset_C Sig_mAirCylDSMScale_C Sig_mAirCylCANOffset_C Sig_mAirCylCANScale_C Sig_mAirCylDIAOffset_C Sig_mAirCylDIAScale_C Sig_mAirTimDSMOffset_C Sig_mAirTimDSMScale_C Sig_mAirTimCANOffset_C Sig_mAirTimCANScale_C Sig_mAirTimDIAOffset_C Sig_mAirTimDIAScale_C Sig_mSootTimDSMOffset_C Sig_mSootTimDSMScale_C Sig_mSootTimCANOffset_C Sig_mSootTimCANScale_C Sig_mSootTimDIAOffset_C Sig_mSootTimDIAScale_C Sig_mSootDSMOffset_C Sig_mSootDSMScale_C Sig_mSootCANOffset_C Sig_mSootCANScale_C Sig_mSootDIAOffset_C Sig_mSootDIAScale_C Sig_nPSPDSMOffset_C Sig_nPSPDSMScale_C Sig_nPSPCANOffset_C Sig_nPSPCANScale_C Sig_nPSPDIAOffset_C Sig_nPSPDIAScale_C Sig_nDSMOffset_C Sig_nDSMScale_C Sig_nCANOffset_C Sig_nCANScale_C Sig_nDIAOffset_C Sig_nDIAScale_C Sig_OneToOneDSMOffset_C Sig_OneToOneDSMScale_C Sig_OneToOneCANOffset_C Sig_OneToOneCANScale_C Sig_OneToOneDIAOffset_C Sig_OneToOneDIAScale_C Sig_OnOffDSMOffset_C Sig_OnOffDSMScale_C Sig_OnOffCANOffset_C Sig_OnOffCANScale_C Sig_OnOffDIAOffset_C Sig_OnOffDIAScale_C Sig_pkPaDSMOffset_C Sig_pkPaDSMScale_C Sig_pkPaCANOffset_C Sig_pkPaCANScale_C Sig_pkPaDIAOffset_C Sig_pkPaDIAScale_C Sig_pRailDSMOffset_C Sig_pRailDSMScale_C Sig_pRailCANOffset_C Sig_pRailCANScale_C Sig_pRailDIAOffset_C Sig_pRailDIAScale_C Sig_pDSMOffset_C Sig_pDSMScale_C Sig_pCANOffset_C Sig_pCANScale_C Sig_pDIAOffset_C Sig_pDIAScale_C Sig_qAvFineDSMOffset_C Sig_qAvFineDSMScale_C Sig_qAvFineCANOffset_C Sig_qAvFineCANScale_C Sig_qAvFineDIAOffset_C Sig_qAvFineDIAScale_C Sig_qAvDSMOffset_C Sig_qAvDSMScale_C Sig_qAvCANOffset_C Sig_qAvCANScale_C Sig_qAvDIAOffset_C Sig_qAvDIAScale_C Sig_qInjMassDSMOffset_C Sig_qInjMassDSMScale_C Sig_qInjMassCANOffset_C Sig_qInjMassCANScale_C Sig_qInjMassDIAOffset_C Sig_qInjMassDIAScale_C Sig_qDSMOffset_C Sig_qDSMScale_C Sig_qCANOffset_C Sig_qCANScale_C Sig_qDIAOffset_C Sig_qDIAScale_C Sig_resFlowDSMOffset_C Sig_resFlowDSMScale_C Sig_resFlowCANOffset_C Sig_resFlowCANScale_C Sig_resFlowDIAOffset_C Sig_resFlowDIAScale_C Sig_rVnDSMOffset_C Sig_rVnDSMScale_C Sig_rVnCANOffset_C Sig_rVnCANScale_C Sig_rVnDIAOffset_C Sig_rVnDIAScale_C Sig_rDSMOffset_C Sig_rDSMScale_C Sig_rCANOffset_C Sig_rCANScale_C Sig_rDIAOffset_C Sig_rDIAScale_C Sig_stHH16DSMOffset_C Sig_stHH16DSMScale_C Sig_stHH16CANOffset_C Sig_stHH16CANScale_C Sig_stHH16DIAOffset_C Sig_stHH16DIAScale_C Sig_stLL16DSMOffset_C Sig_stLL16DSMScale_C Sig_stLL16CANOffset_C Sig_stLL16CANScale_C Sig_stLL16DIAOffset_C Sig_stLL16DIAScale_C Sig_tExhaustgasDSMOffset_C Sig_tExhaustgasDSMScale_C Sig_tExhaustgasCANOffset_C Sig_tExhaustgasCANScale_C Sig_tExhaustgasDIAOffset_C Sig_tExhaustgasDIAScale_C Sig_timEngDSMOffset_C Sig_timEngDSMScale_C Sig_timEngCANOffset_C Sig_timEngCANScale_C Sig_timEngDIAOffset_C Sig_timEngDIAScale_C Sig_Time_PwmHighDSMOffset_C Sig_Time_PwmHighDSMScale_C Sig_Time_PwmHighCANOffset_C Sig_Time_PwmHighCANScale_C Sig_Time_PwmHighDIAOffset_C Sig_Time_PwmHighDIAScale_C Sig_timsDSMOffset_C Sig_timsDSMScale_C Sig_timsCANOffset_C Sig_timsCANScale_C Sig_timsDIAOffset_C Sig_timsDIAScale_C Sig_tiOprgnu16PFltDSMOffset_C Sig_tiOprgnu16PFltDSMScale_C Sig_tiOprgnu16PFltCANOffset_C Sig_tiOprgnu16PFltCANScale_C Sig_tiOprgnu16PFltDIAOffset_C Sig_tiOprgnu16PFltDIAScale_C Sig_tiOpu16PFltDSMOffset_C Sig_tiOpu16PFltDSMScale_C Sig_tiOpu16PFltCANOffset_C Sig_tiOpu16PFltCANScale_C Sig_tiOpu16PFltDIAOffset_C Sig_tiOpu16PFltDIAScale_C Sig_tisDSMOffset_C Sig_tisDSMScale_C Sig_tisCANOffset_C Sig_tisCANScale_C Sig_tisDIAOffset_C Sig_tisDIAScale_C Sig_tiDSMOffset_C Sig_tiDSMScale_C Sig_tiCANOffset_C Sig_tiCANScale_C Sig_tiDIAOffset_C Sig_tiDIAScale_C Sig_Tn_abstellDSMOffset_C Sig_Tn_abstellDSMScale_C Sig_Tn_abstellCANOffset_C Sig_Tn_abstellCANScale_C Sig_Tn_abstellDIAOffset_C Sig_Tn_abstellDIAScale_C Sig_trqPrpDSMOffset_C Sig_trqPrpDSMScale_C Sig_trqPrpCANOffset_C Sig_trqPrpCANScale_C Sig_trqPrpDIAOffset_C Sig_trqPrpDIAScale_C Sig_trqDSMOffset_C Sig_trqDSMScale_C Sig_trqCANOffset_C Sig_trqCANScale_C Sig_trqDIAOffset_C Sig_trqDIAScale_C Sig_tDSMOffset_C Sig_tDSMScale_C Sig_tCANOffset_C Sig_tCANScale_C Sig_tDIAOffset_C Sig_tDIAScale_C Sig_uBattDSMOffset_C Sig_uBattDSMScale_C Sig_uBattCANOffset_C Sig_uBattCANScale_C Sig_uBattDIAOffset_C Sig_uBattDIAScale_C Sig_U_battDSMOffset_C Sig_U_battDSMScale_C Sig_U_battCANOffset_C Sig_U_battCANScale_C Sig_U_battDIAOffset_C Sig_U_battDIAScale_C Sig_uDSMOffset_C Sig_uDSMScale_C Sig_uCANOffset_C Sig_uCANScale_C Sig_uDIAOffset_C Sig_uDIAScale_C Sig_U_genDSMOffset_C Sig_U_genDSMScale_C Sig_U_genCANOffset_C Sig_U_genCANScale_C Sig_U_genDIAOffset_C Sig_U_genDIAScale_C Sig_volFlDSMOffset_C Sig_volFlDSMScale_C Sig_volFlCANOffset_C Sig_volFlCANScale_C Sig_volFlDIAOffset_C Sig_volFlDIAScale_C Sig_volphDSMOffset_C Sig_volphDSMScale_C Sig_volphCANOffset_C Sig_volphCANScale_C Sig_volphDIAOffset_C Sig_volphDIAScale_C Sig_volRailDSMOffset_C Sig_volRailDSMScale_C Sig_volRailCANOffset_C Sig_volRailCANScale_C Sig_volRailDIAOffset_C Sig_volRailDIAScale_C Sig_vDSMOffset_C Sig_vDSMScale_C Sig_vCANOffset_C Sig_vCANScale_C Sig_vDIAOffset_C Sig_vDIAScale_C /end DEF_CHARACTERISTIC
/end FUNCTION
/begin FUNCTION signals_limits ""
 /begin DEF_CHARACTERISTIC Sig_LimLowDigital_C Sig_LimUpDigital_C Sig_LimLowFlCon_C Sig_LimUpFlCon_C Sig_LimLown_C Sig_LimUpn_C Sig_LimLowPwm_C Sig_LimUpPwm_C Sig_LimLowtrq_C Sig_LimUptrq_C /end DEF_CHARACTERISTIC
/end FUNCTION
/begin FUNCTION signals_model "" /end FUNCTION
/begin FUNCTION signals_mon ""
 /begin DEF_CHARACTERISTIC signals_tiTstDemHeal_C signals_tiTstDemMax_C signals_TmrBehaviour_C signals_TstDemMaxEngN_C signals_TstDemMaxVSSCDV_C /end DEF_CHARACTERISTIC
/end FUNCTION
/begin FUNCTION signals_project "" /end FUNCTION
/begin FUNCTION signals_uic ""
 /begin OUT_MEASUREMENT signals_stTestNLim_mp signals_stTest_mp signals_tiTstRemain_mp /end OUT_MEASUREMENT
/end FUNCTION
/begin FUNCTION sigtst_auto ""
 /begin DEF_CHARACTERISTIC SigTst_ACEn_C SigTst_AOHtEn_C SigTst_BPAEn_C SigTst_CpBVlvEn_C SigTst_EBAFEn_C SigTst_EBFEn_C SigTst_EGPpEn_C SigTst_EGREn_C SigTst_ETClbCorOffEn_C SigTst_FANEn_C SigTst_GLWRLYEn_C SigTst_LPAEn_C SigTst_LSUCDHt0En_C SigTst_MILLAMPEn_C SigTst_MNTCTLEn_C SigTst_MeUnEn_C SigTst_PCVEn_C SigTst_PSPEn_C SigTst_SYSLAMPEn_C SigTst_ShuttrEn_C SigTst_TVAEn_C SigTst_VSAEn_C /end DEF_CHARACTERISTIC
/end FUNCTION
/begin FUNCTION soptst "Power-Up-Function test of disabling security pathes" /begin DEF_CHARACTERISTIC SOPTst_stRcyDem_C SOPTst_stShOffPathActv_C /end DEF_CHARACTERISTIC /end FUNCTION
/begin FUNCTION soptst_msg "" /begin OUT_MEASUREMENT SOPTst_stCyl /end OUT_MEASUREMENT /end FUNCTION
/begin FUNCTION spmon "Stack pointer Überwachung" /begin DEF_CHARACTERISTIC SPMon_swtRstStackMon_C /end DEF_CHARACTERISTIC /begin OUT_MEASUREMENT SPMon_numFreeErcosekStack_mp SPMon_numFreeUserStack_mp /end OUT_MEASUREMENT /end FUNCTION
/begin FUNCTION srvpmp "Servopumpe"
 /begin DEF_CHARACTERISTIC SrvPmp_facSTWAV_CUR SrvPmp_facVS_CUR SrvPmp_rTrans_C SrvPmp_trqSTWABase_CUR /end DEF_CHARACTERISTIC
 /begin IN_MEASUREMENT FrmMng_phiStrg SrvPmp_dphiStrg_mp VSSCD_v /end IN_MEASUREMENT
/end FUNCTION
/begin FUNCTION srvpmp_msg "" /begin OUT_MEASUREMENT SrvPmp_pwrDes SrvPmp_pwrLead /end OUT_MEASUREMENT /end FUNCTION
/begin FUNCTION srvpmp_uic "" /begin OUT_MEASUREMENT SrvPmp_dphiStrg_mp SrvPmp_trqDes_mp /end OUT_MEASUREMENT /end FUNCTION
/begin FUNCTION sspmon "Versorgungsspannungsüberwachung"
 /begin DEF_CHARACTERISTIC SSpMon_DebSRCHighSplyVltgDef1_C SSpMon_DebSRCHighSplyVltgOk1_C SSpMon_DebSRCHighSplyVltgDef2_C SSpMon_DebSRCHighSplyVltgOk2_C SSpMon_DebSRCHighSplyVltgDef3_C SSpMon_DebSRCHighSplyVltgOk3_C SSpMon_DebSRCLowSplyVltgDef1_C SSpMon_DebSRCLowSplyVltgOk1_C SSpMon_DebSRCLowSplyVltgDef2_C SSpMon_DebSRCLowSplyVltgOk2_C SSpMon_DebSRCLowSplyVltgDef3_C SSpMon_DebSRCLowSplyVltgOk3_C SSpMon_numDiaVltg1_C SSpMon_numDiaVltg2_C SSpMon_numDiaVltg3_C /end DEF_CHARACTERISTIC
/end FUNCTION
/begin FUNCTION sspmon_msg "" /begin OUT_MEASUREMENT SSpMon_stSSpErr /end OUT_MEASUREMENT /end FUNCTION
/begin FUNCTION sspmon_uic "" /begin OUT_MEASUREMENT SSpMon_stRaw_1_mp SSpMon_stRaw_2_mp SSpMon_stRaw_3_mp /end OUT_MEASUREMENT /end FUNCTION
/begin FUNCTION stdpwm_pwrstg "" /end FUNCTION
/begin FUNCTION strtcd_actrout "Starterrelais Steller"
 /begin DEF_CHARACTERISTIC StrtCD_ActrDebExcTempDef_C StrtCD_ActrDebExcTempOk_C StrtCD_ActrDebNoLoadDef_C StrtCD_ActrDebNoLoadOk_C StrtCD_ActrDebShrtCBatDef_C StrtCD_ActrDebShrtCBatOk_C StrtCD_ActrDebShrtCGndDef_C StrtCD_ActrDebShrtCGndOk_C STRTCD_numDia_C STRTCD_numDioOut_C StrtCD_stActrInvOut_C StrtCD_stPwrStgActrActv_C StrtCD_stPwrStgActrDia_C /end DEF_CHARACTERISTIC
/end FUNCTION
/begin FUNCTION strtcd_actrout_uic "" /begin OUT_MEASUREMENT StrtCD_stHWE_mp /end OUT_MEASUREMENT /end FUNCTION
/begin FUNCTION stsys "Startsystem" /begin DEF_CHARACTERISTIC StSys_tiStrtLck_C StSys_tiStrtMax_C /end DEF_CHARACTERISTIC /end FUNCTION
/begin FUNCTION stsys_addcor "Startmomentenkorrektur"
 /begin DEF_CHARACTERISTIC StSys_facAPSCor_CUR StSys_numStrtAddCor_C StSys_trqStrtAPSCor_MAP /end DEF_CHARACTERISTIC
 /begin IN_MEASUREMENT APSCD_pVal Eng_nAvrg StSys_tStrtBas_mp /end IN_MEASUREMENT
/end FUNCTION
/begin FUNCTION stsys_addcor_msg "" /begin OUT_MEASUREMENT StSys_trqAddCor /end OUT_MEASUREMENT /end FUNCTION
/begin FUNCTION stsys_addcor_uic ""
 /begin OUT_MEASUREMENT StSys_facAPSCor_mp StSys_trqStrtAPSCor_mp StSys_trqStrtAPS_mp StSys_tStrtBas_mp /end OUT_MEASUREMENT
/end FUNCTION
/begin FUNCTION stsys_strt "Startabwurf" /begin DEF_CHARACTERISTIC StSys_nStrtCutOut_CUR StSys_numStrt_C StSys_tiStrtCutOut_C /end DEF_CHARACTERISTIC /begin IN_MEASUREMENT StSys_tStrt_mp /end IN_MEASUREMENT /end FUNCTION
/begin FUNCTION stsys_strtbas "Startbasismoment"
 /begin DEF_CHARACTERISTIC StSys_nAdjMax_C StSys_trqAdjMax_C StSys_trqAdjVal_C StSys_trqStrtBas_MAP /end DEF_CHARACTERISTIC
 /begin IN_MEASUREMENT Eng_nAvrg StSys_tStrtBas_mp /end IN_MEASUREMENT
/end FUNCTION
/begin FUNCTION stsys_strtbas_msg "" /begin OUT_MEASUREMENT StSys_trqBas /end OUT_MEASUREMENT /end FUNCTION
/begin FUNCTION stsys_strtbas_uic "" /begin OUT_MEASUREMENT StSys_trqAdj_mp StSys_trqSetAdjVal_mp StSys_trqStrtBas_mp /end OUT_MEASUREMENT /end FUNCTION
/begin FUNCTION stsys_strtctl "Startsystem Anlassersteuerung"
 /begin DEF_CHARACTERISTIC StSys_nDiseng_C StSys_nEngage_C Stsys_swtGlwLamp_C StSys_tiLckCutOut_C /end DEF_CHARACTERISTIC
/end FUNCTION
/begin FUNCTION stsys_strtctl_msg "" /begin OUT_MEASUREMENT StSys_stActrOut /end OUT_MEASUREMENT /end FUNCTION
/begin FUNCTION stsys_strtctl_uic "" /begin OUT_MEASUREMENT StSys_stActrLck_mp StSys_stActrRls_mp /end OUT_MEASUREMENT /end FUNCTION
/begin FUNCTION stsys_strtrmp "Startrampe"
 /begin DEF_CHARACTERISTIC StSys_nFreezeTrqRmp_C StSys_nReleaseTrqRmp_C StSys_numStrtRmp_C StSys_tClntHi_C StSys_tClntLo_C StSys_tiEngTempValid_C StSys_dtrqColdInc_C StSys_tiColdRmpLck_C StSys_trqColdLim_C StSys_dtrqHotInc_C StSys_tiHotRmpLck_C StSys_trqHotLim_C StSys_dtrqWarmInc_C StSys_tiWarmRmpLck_C StSys_trqWarmLim_C /end DEF_CHARACTERISTIC
/end FUNCTION
/begin FUNCTION stsys_strtrmp_msg "" /begin OUT_MEASUREMENT StSys_stRmpMon StSys_trqRmpState StSys_trqStrt /end OUT_MEASUREMENT /end FUNCTION
/begin FUNCTION stsys_strtrmp_uic "" /begin OUT_MEASUREMENT StSys_tStrtRmp_mp /end OUT_MEASUREMENT /end FUNCTION
/begin FUNCTION stsys_strttip "Tip Start (Automatik Start)"
 /begin DEF_CHARACTERISTIC StSys_nStrtTipMax_CUR StSys_nStrtTipProtCaS_C StSys_nStrtTipProt_C StSys_swtShOffGearbxRec_C StSys_swtStrtTipActv_C StSys_tiStrtTipMin_C StSys_tiStrtTipNoMonitor_C StSys_tiStrtTipProt_C /end DEF_CHARACTERISTIC
 /begin IN_MEASUREMENT Eng_tEng /end IN_MEASUREMENT
/end FUNCTION
/begin COMPU_METHOD AngleGrad "Winkelanzeige in Grad" RAT_FUNC "%6.4" "Grad" COEFFS 0 22.7531285551763 0 0 0 1 /end COMPU_METHOD
/begin COMPU_METHOD AngleGradPerSec "Winkelanzeige in Grad pro Sekunde" RAT_FUNC "%6.4" "Grad/s" COEFFS 0 22.7531285551763 0 0 0 1 /end COMPU_METHOD
/begin COMPU_METHOD DtyCyc "Tastverhaeltnis" RAT_FUNC "%6.4" "%" COEFFS 0 100 0 0 0 1 /end COMPU_METHOD
/begin COMPU_METHOD EGTSwt "Umrechnung für EGT Rampenschalter (1 / 1000*2^14 )" RAT_FUNC "%10.9" "-" COEFFS 0 16384000 0 0 0 1 /end COMPU_METHOD
/begin COMPU_METHOD EngN "Motordrehzahl" RAT_FUNC "%6.2" "rpm" COEFFS 0 1 0 0 0 1 /end COMPU_METHOD
/begin COMPU_METHOD EngTempFldSel "Verbale Umrechnung für Auswahl aus dem Motortemperatur-Feld Eng_tFld" TAB_VERB "%6.3" "-" COMPU_TAB_REF EngTempFldSel /end COMPU_METHOD
/begin COMPU_VTAB EngTempFldSel "Verbale Umrechnung für Auswahl aus dem Motortemperatur-Feld Eng_tFld" TAB_VERB 3 0 "Coolant_Temperature" 1 "Oil_Temperature" 2 "Eng_tEng" /end COMPU_VTAB
/begin COMPU_METHOD Fact "Faktor mit Auflösung 1 / 8192, hauptsächlich für einen Faktorenbereich 0...1 verwendet" RAT_FUNC "%6.5" "-" COEFFS 0 8192 0 0 0 1 /end COMPU_METHOD
/begin COMPU_METHOD FanSpd "(MAXSINT16 / FANSPD_MAX) * phys" RAT_FUNC "%6.3" "1/min" COEFFS 0 10.9223333333333 0 0 0 1 /end COMPU_METHOD
/begin COMPU_METHOD FlConsum_l_h "Kraftstoffverbrauch" RAT_FUNC "%6.4" "l/h" COEFFS 0 100 0 0 0 1 /end COMPU_METHOD
/begin COMPU_METHOD InjMassCyc "Einspritzmenge pro Zyklus (mg/Zyklus)" RAT_FUNC "%6.4" "mg/cyc" COEFFS 0 100 0 0 0 1 /end COMPU_METHOD
/begin COMPU_METHOD InjMassInj "Einspritzmenge pro Einspritzung (mg/Einspritzung)" RAT_FUNC "%6.4" "mg/inj" COEFFS 0 100 0 0 0 1 /end COMPU_METHOD
/begin COMPU_METHOD InjMassPerSec_20ms "Einspritzmengenänderung pro Sekunde für 20ms-Tasks" RAT_FUNC "%6.3" "mg/hub/s" COEFFS 0 2 0 0 0 1 /end COMPU_METHOD
/begin COMPU_METHOD InjQntInj "Einspritzmenge der einzelnen Einspritzung" RAT_FUNC "%6.4" "mm^3/inj" COEFFS 0 100 0 0 0 1 /end COMPU_METHOD
/begin COMPU_METHOD NumPinDia "Verbale Umrechnung für Diagnose Signale" TAB_VERB "%6.3" "-" COMPU_TAB_REF NumPinDia /end COMPU_METHOD
/begin COMPU_VTAB NumPinDia "Verbale Umrechnung für Diagnose Signale" TAB_VERB 35 0 "CJ945_Diagnostic_Signal" 1 "AC_Compressor_DiaSig" 2 "Fuel_Pump_DiaSig" 3 "Starter_234" 4 "Oil_Pressure_Lamp_Switch_245" 5 "Engine_Bay_Air_Flaps_123" 6 "Glow_Relay_Diagnostic_Signal1" 7 "reserved Glow_Relay_Diagnostic_Signal2" 8 "Ebox_Fan_Actuator_Diagnostic_Signal_219" 9 "Shuttr_Actuator_Diagnostic_Signal_231" 10 "Twostage_TurboLoading_SW_DiaSig" 11 "DIO_OUT_DIAGNOSTIC_DUMMY_NOT_USED" 12 "1st_Pressure_Control_Valve_Diagnostic_Signal_172" 13 "2nd_Pressure_Control_Valve_Diagnostic_Signal_172" 14 "1st_Metering_Unit_Diagnostic_Signal_171" 15 "2nd_Metering_Unit_Diagnostic_Signal_171" 16 "Boost_Pressure_Actuator_Diagnostic_Signal_193" 17 "Boost_Pressure_Actuator_Diagnostic_Signal_193_2" 18 "EGR_Actuator_Diagnostic_Signal_194" 19 "EGR_Actuator_Diagnostic_Signal2" 20 "Variable_Swirl_Actuator_Diagnostic_Signal_195" 21 "Throttle_Valve_Diagnostic_Signal_196" 22 "Throttle_Valve2_Diagnostic_Signal_196" 23 "FAN_240" 24 "Add_On_Heater_244" 25 "EngM_Bearing_Actuator_Diagnostic_Signal_124" 26 "EngM_Bearing_Actuator_Diagnostic_Signal_121" 27 "Low pressure stage BPA_Diagnostic_Signal_117" 28 "PWM_DIAGNOSTIC_DUMMY_NOT_USED" 29 "1st_Sensor_Supply_Voltage_DiaSig" 30 "2nd_Sensor_Supply_Voltage_DiaSig" 31 "3rd_Sensor_Supply_Voltage_DiaSig" 32 "4th_Sensor_Supply_Voltage_DiaSig" 33 "5th_Sensor_Supply_Voltage_DiaSig" 34 "6th_Sensor_Supply_Voltage_DiaSig" /end COMPU_VTAB
/begin COMPU_METHOD NumPinDioOut "Verbale Umrechnung für Digitalausgang Signale" TAB_VERB "%6.3" "-" COMPU_TAB_REF NumPinDioOut /end COMPU_METHOD
/begin COMPU_VTAB NumPinDioOut "Verbale Umrechnung für Digitalausgang Signale" TAB_VERB 11 0 "Main_Relay_220(144)" 1 "AC_Compressor" 2 "Fuel_Pump_232" 3 "Starter_234" 4 "OPS_Lamp_245" 5 "EBAF_123" 6 "Ebox_Fan_Actuator_219" 7 "Shuttr_Actuator_231" 8 "STATREG_PSOFF_Bit" 9 "Twostage_TurboLoading_120" 10 "DIO_OUT_DUMMY_NOT_USED" /end COMPU_VTAB
/begin COMPU_METHOD OneToOne "eins zu eins (physikalischer Wert ist gleich dem internen Wert)" RAT_FUNC "%6.2" "-" COEFFS 0 1 0 0 0 1 /end COMPU_METHOD
/begin COMPU_METHOD Prc "Prozent, gleiche interne Auflösung wie Fact, aber Darstellung in Prozent (0...100%)" RAT_FUNC "%6.4" "%" COEFFS 0 81.92 0 0 0 1 /end COMPU_METHOD
/begin COMPU_METHOD PresRail_sec "Raildruckerhöhung/absenkung in hPa/s" RAT_FUNC "%4.3" "bar/s" COEFFS 0 2.500000 0 0 0 1 /end COMPU_METHOD
/begin COMPU_METHOD Pres_hPa "Druck (angezeigt in [hPa])" RAT_FUNC "%6.2" "hPa" COEFFS 0 1 0 0 0 1 /end COMPU_METHOD
/begin COMPU_METHOD Pres_Rail "Raildruck in hPa" RAT_FUNC "%4.3" "bar" COEFFS 0 10.000000 0 0 0 1 /end COMPU_METHOD
/begin COMPU_METHOD Pwr "Leistung" RAT_FUNC "%6.2" "W" COEFFS 0 0.10610329539459 0 0 0 1 /end COMPU_METHOD
/begin COMPU_METHOD Qp_mm3_sec "Umrechnung für Volumenstrom" RAT_FUNC "%6.1" "mm3/s" COEFFS 0 0.1 0 0 0 1 /end COMPU_METHOD
/begin COMPU_METHOD Rmp "einheitenloser Rampengradient (für Library Ramp, etc.)" RAT_FUNC "%6.4" "1/s" COEFFS 0 65.536 0 0 0 1 /end COMPU_METHOD
/begin COMPU_METHOD RmpTrq "Rampengradient für Motormoment" RAT_FUNC "%6.4" "Nm/s" COEFFS 0 655.36 0 0 0 1 /end COMPU_METHOD
/begin COMPU_METHOD RtmoTicksToPercent "Rtmo_tiMaxLoad_u32 in Prozent konvertieren" RAT_FUNC "%6.2" "%" COEFFS 0 -34965 3496500 0 0 1 /end COMPU_METHOD
/begin COMPU_METHOD SigDatatyp "verbale Umrechnung für die auswahl eines Datentyps eines frei applizierbaren Signals" TAB_VERB "%6.3" "-" COMPU_TAB_REF SigDatatyp /end COMPU_METHOD
/begin COMPU_VTAB SigDatatyp "verbale Umrechnung für die auswahl eines Datentyps eines frei applizierbaren Signals" TAB_VERB 6 0 "SIG_SINT16" 1 "SIG_UINT16" 2 "SIG_SINT8" 3 "SIG_UINT8 or SIG_BOOL" 4 "SIG_SINT32" 5 "SIG_UINT32" /end COMPU_VTAB
/begin COMPU_METHOD SigSupLeg "verbale umrechung für unterstützte Gesetztesvorschrift (OBD) gemäß SAE J1979" TAB_VERB "%6.3" "-" COMPU_TAB_REF SigSupLeg /end COMPU_METHOD
/begin COMPU_VTAB SigSupLeg "verbale umrechung für unterstützte Gesetztesvorschrift (OBD) gemäß SAE J1979" TAB_VERB 9 1 "OBDII_USA_CARB" 2 "OBD_USA_EPA" 3 "OBD_and_OBDII_USA" 4 "OBDI_USA" 5 "no_use_for_OBD" 6 "EOBD(Europe)" 7 "EOBD and OBD II" 8 "EOBD and OBD" 9 "EOBD, OBD and OBD II" /end COMPU_VTAB
/begin COMPU_METHOD Temp_Cels "Temperatur dargestellt in °C (gleiche interne Darstellung wie Temp_Kelv)" RAT_FUNC "%6.1" "deg C" COEFFS 0 10 2731.4 0 0 1 /end COMPU_METHOD
/begin COMPU_METHOD TimeDeb "Entprellzeit in Millisekunden für Libraryfunktion Debounce" RAT_FUNC "%6.1" "ms" COEFFS 0 0.1 0 0 0 1 /end COMPU_METHOD
/begin COMPU_METHOD TimeDelay_s "Zeitkonstante T1 (in s) für PT1, DT1, etc." RAT_FUNC "%9.3" "s" COEFFS 0 0 1 0 0.00023283064365387 0 /end COMPU_METHOD
/begin COMPU_METHOD TimeDelay_s_1 "Zeitkonstante T1 (in s) für PT1, DT1, etc. normiert auf 16 bit" RAT_FUNC "%9.6" "s" COEFFS 0 0 1 0 0.95367431640625 0 /end COMPU_METHOD
/begin COMPU_METHOD TimeDT_ms "sample time (DT) des Tasks ,verwendet fuer Regler, Filter etc. ... angezeigt in [ms]" RAT_FUNC "%6.5" "ms" COEFFS 0 1000 0 0 0 1 /end COMPU_METHOD
/begin COMPU_METHOD TimeSys_us "Zeit in [us] mit Systemzeit-Auflösung" RAT_FUNC "%6.3" "us" COEFFS 0 3.4965 0 0 0 1 /end COMPU_METHOD
/begin COMPU_METHOD Time_ms "Zeit in ms für Fehlerentprellung (DSM) und SW-Timer" RAT_FUNC "%6.1" "ms" COEFFS 0 0.1 0 0 0 1 /end COMPU_METHOD
/begin COMPU_METHOD TransR "Übersetzungsverhältnis (Getriebe etc.)" RAT_FUNC "%6.4" "-" COEFFS 0 100 0 0 0 1 /end COMPU_METHOD
/begin COMPU_METHOD Trq "Motormoment" RAT_FUNC "%6.3" "Nm" COEFFS 0 10 0 0 0 1 /end COMPU_METHOD
/begin COMPU_METHOD Vel "Fahrzeuggeschwindigkeit, gleiche interne Auflösung wie Vel_SI" RAT_FUNC "%6.4" "km/h" COEFFS 0 100 0 0 0 1 /end COMPU_METHOD
/begin COMPU_METHOD Vel_SI "Fahrzeuggeschwindigkeit (in m/s)" RAT_FUNC "%6.4" "m/s" COEFFS 0 360 0 0 0 1 /end COMPU_METHOD
/begin COMPU_METHOD Volt_Batt "Batteriespannung" RAT_FUNC "%6.1" "mV" COEFFS 0 0.05115 0 0 0 1 /end COMPU_METHOD
/begin RECORD_LAYOUT Kf_Xs16_Ys16_Ws16 NO_AXIS_PTS_X 1 SWORD NO_AXIS_PTS_Y 2 SWORD AXIS_PTS_X 3 SWORD INDEX_INCR DIRECT AXIS_PTS_Y 4 SWORD INDEX_INCR DIRECT FNC_VALUES 5 SWORD COLUMN_DIR DIRECT /end RECORD_LAYOUT
/begin RECORD_LAYOUT Kl_Xs16_Ws16 NO_AXIS_PTS_X 1 SWORD AXIS_PTS_X 2 SWORD INDEX_INCR DIRECT FNC_VALUES 3 SWORD COLUMN_DIR DIRECT /end RECORD_LAYOUT
/begin RECORD_LAYOUT Kw_Ws16 FNC_VALUES 1 SWORD COLUMN_DIR DIRECT /end RECORD_LAYOUT
/begin RECORD_LAYOUT Kw_Wu16 FNC_VALUES 1 UWORD COLUMN_DIR DIRECT /end RECORD_LAYOUT
/begin RECORD_LAYOUT Kw_Wu32 FNC_VALUES 1 ULONG COLUMN_DIR DIRECT /end RECORD_LAYOUT
/begin RECORD_LAYOUT Kw_Wu8 FNC_VALUES 1 UBYTE COLUMN_DIR DIRECT /end RECORD_LAYOUT
/end MODULE
/end PROJECT
