ASAP2_VERSION 1 3
/begin PROJECT P390 "BMW DDE6.2 6-Zylinder VP0.1 11.11.2003 CAN12H"
/begin HEADER "" VERSION "VP01_6Z_CAN12H" PROJECT_NO P390 /end HEADER
/begin MODULE DIM ""
/begin MOD_COMMON "" BYTE_ORDER MSB_FIRST ALIGNMENT_BYTE 1 ALIGNMENT_WORD 2 ALIGNMENT_LONG 4 ALIGNMENT_FLOAT32_IEEE 4 /end MOD_COMMON
/begin CHARACTERISTIC AFSCD_DebPlHiSetyDrftDef_C "Defektentprellzeit für Plausibilisierung der oberen Luftmassnesensor-Empfindlichkeitsdriftgrenze" VALUE 0xC3A28 Kw_Wu16 655350.0 Time_ms 0.00 655350.0 FORMAT "%8.1" /end CHARACTERISTIC
/begin CHARACTERISTIC AFSCD_DebPlHiSetyDrftOk_C "Heilungsentprellzeit für Plausibilisierung der oberen Luftmassensensor-Empfindlichkeitsdriftgrenze" VALUE 0xC3A2A Kw_Wu16 655350.0 Time_ms 0.00 655350.0 FORMAT "%8.1" /end CHARACTERISTIC
/begin CHARACTERISTIC AFSCD_DebPlLoSetyDrftDef_C "Defektentprellzeit für Plausibilisierung der unteren Luftmassensensor-Empfindlichkeitsdriftgrenze" VALUE 0xC3A2C Kw_Wu16 655350.0 Time_ms 0.00 655350.0 FORMAT "%8.1" /end CHARACTERISTIC
/begin CHARACTERISTIC AFSCD_DebPlLoSetyDrftOk_C "Heilungsentprellzeit für Plausibilisierung der unteren Luftmassensensor-Empfindlichkeitsdriftgrenze" VALUE 0xC3A2E Kw_Wu16 655350.0 Time_ms 0.00 655350.0 FORMAT "%8.1" /end CHARACTERISTIC
/begin CHARACTERISTIC AFSCD_tiAirPerTimeDT1_C "Totzeit für  Luftmassenstrom DT1 filter" VALUE 0xC3A30 Kw_Wu32 4294.9673 TimeDelay_s 0.0000010000000 4294.9673 FORMAT "%9.4" /end CHARACTERISTIC
/begin CHARACTERISTIC AFSCD_dDT1KdAirPerTime_C "Verstärkungskonstante des DT1 filters für  Luftmassenstrom" VALUE 0xC3A34 Kw_Ws32 32767.9999847 Kd 0.00 32767.9999847 FORMAT "%13.7" EXTENDED_LIMITS -32768.0000000 32767.9999847 /end CHARACTERISTIC
/begin CHARACTERISTIC AFSCD_dmAirSubsVal_MAP "Ersatzwert für Luftmassenstrom" MAP 0xC3A38 Kf_Xs16_Ys16_Ws16 1000.000 AirMassPerTime 0.00 1000.000 FORMAT "%8.3" EXTENDED_LIMITS -3276.800 3276.700
 /begin AXIS_DESCR STD_AXIS Eng_nAvrg EngN 16 0.00 6000.000 FORMAT "%8.3" EXTENDED_LIMITS -32768.00 32767.00 DEPOSIT ABSOLUTE /end AXIS_DESCR
 /begin AXIS_DESCR STD_AXIS InjCtl_qRaw InjMassCyc 16 0.00 327.6700 FORMAT "%8.4" EXTENDED_LIMITS -327.6800 327.6700 DEPOSIT ABSOLUTE /end AXIS_DESCR
/end CHARACTERISTIC
/begin CHARACTERISTIC AFSCD_dmIdlAirMsLim_C "Luftmassenstromgrenze im Leerlauf für Korrekturfaktorkennlinie" VALUE 0xC39A8 Kw_Ws16 1000.000 AirMassPerTime 0.00 1000.000 FORMAT "%8.3" EXTENDED_LIMITS -3276.800 3276.700 /end CHARACTERISTIC
/begin CHARACTERISTIC AFSCD_dmLdAirMsLim_C "Luftmassenstromgrenze im Lastbereich für Korrekturfaktorkennlinie" VALUE 0xC39AA Kw_Ws16 1000.000 AirMassPerTime 0.00 1000.000 FORMAT "%8.3" EXTENDED_LIMITS -3276.800 3276.700 /end CHARACTERISTIC
/begin CHARACTERISTIC AFSCD_dpLdAdjThresHi_C "Maximaler Ladedruckgradient zur Freigabe der Driftkompensation im Lastbereich" VALUE 0xC39AC Kw_Ws16 3500.000 RmpPres_hPa 0.00 3500.000 FORMAT "%8.3" EXTENDED_LIMITS -500.0000 499.9847 /end CHARACTERISTIC
/begin CHARACTERISTIC AFSCD_dqLdAdjThresHi_C "Maximaler Mengengradient zur Freigabe der Driftkompensation im Lastbereich" VALUE 0xC39AE Kw_Ws16 327.6700 RmpInjMass 0.00 327.6700 FORMAT "%8.4" EXTENDED_LIMITS -5.000000 4.999847 /end CHARACTERISTIC
/begin CHARACTERISTIC AFSCD_drWtPenDetThresHi_C "Oberer Faktor-Schwellwert bei Wassereintragserkennung" VALUE 0xC39B0 Kw_Ws16 3.000000 Rmp_1 0.00 3.000000 FORMAT "%8.6" EXTENDED_LIMITS -32.76800 32.76700 /end CHARACTERISTIC
/begin CHARACTERISTIC AFSCD_facHiThresIdlAdjVal_C "Maximale Driftgrenze für Korrekturfaktor im Leerlauf" VALUE 0xC39B2 Kw_Ws16 3.000000 Fact 0.00 3.000000 FORMAT "%8.6" EXTENDED_LIMITS -4.000000 3.999878 /end CHARACTERISTIC
/begin CHARACTERISTIC AFSCD_facHiThresLdAdjVal_C "Maximale Driftgrenze für Korrekturfaktor im Lastbereich" VALUE 0xC39B4 Kw_Ws16 3.000000 Fact 0.00 3.000000 FORMAT "%8.6" EXTENDED_LIMITS -4.000000 3.999878 /end CHARACTERISTIC
/begin CHARACTERISTIC AFSCD_facIdlAdjValStepLim_C "Schrittweitengrenze für Korrekturfaktor im Leerlauf" VALUE 0xC39B6 Kw_Ws16 3.000000 Fact 0.00 3.000000 FORMAT "%8.6" EXTENDED_LIMITS -4.000000 3.999878 /end CHARACTERISTIC
/begin CHARACTERISTIC AFSCD_facLdAdjValStepLim_C "Schrittweitengrenze für Korrekturfaktor im Lastbereich" VALUE 0xC39B8 Kw_Ws16 3.000000 Fact 0.00 3.000000 FORMAT "%8.6" EXTENDED_LIMITS -4.000000 3.999878 /end CHARACTERISTIC
/begin CHARACTERISTIC AFSCD_facLoThresIdlAdjVal_C "Minimale Driftgrenze für Korrekturfaktor im Leerlauf" VALUE 0xC39BA Kw_Ws16 2.000000 Fact 0.00 2.000000 FORMAT "%8.6" EXTENDED_LIMITS -4.000000 3.999878 /end CHARACTERISTIC
/begin CHARACTERISTIC AFSCD_facLoThresLdAdjVal_C "Minimale Driftgrenze für Korrekturfaktor im Lastbereich" VALUE 0xC39BC Kw_Ws16 2.000000 Fact 0.00 2.000000 FORMAT "%8.6" EXTENDED_LIMITS -4.000000 3.999878 /end CHARACTERISTIC
/begin CHARACTERISTIC AFSCD_nAvrgIdlAdjThresHi_C "Obere Motordrehzahlschwelle zur Freigabe der Driftkompensation im Leerlauf" VALUE 0xC39BE Kw_Ws16 5960.000 EngN 40.00000 6000.000 FORMAT "%8.3" EXTENDED_LIMITS -32768.00 32767.00 /end CHARACTERISTIC
/begin CHARACTERISTIC AFSCD_nAvrgIdlAdjThresLo_C "Untere Motordrehzahlschwelle zur Freigabe der Driftkompensation im Leerlauf" VALUE 0xC39C0 Kw_Ws16 5960.000 EngN 40.00000 6000.000 FORMAT "%8.3" EXTENDED_LIMITS -32768.00 32767.00 /end CHARACTERISTIC
/begin CHARACTERISTIC AFSCD_pBstAtmDiffLim_C "Maximaler Differenzbetrag zwischen Atmosphäre und Ladedruck zur Leerlauffreigabe" VALUE 0xC39C2 Kw_Ws16 3500.000 Pres_hPa 0.00 3500.000 FORMAT "%8.3" EXTENDED_LIMITS -32768.00 32767.00 /end CHARACTERISTIC
/begin CHARACTERISTIC AFSCD_pBstLdAdjThresHi_C "Obere Ladedruckschwelle zur Freigabe der Driftkompensation im Lastbereich" VALUE 0xC39C4 Kw_Ws16 3500.000 Pres_hPa 0.00 3500.000 FORMAT "%8.3" EXTENDED_LIMITS -32768.00 32767.00 /end CHARACTERISTIC
/begin CHARACTERISTIC AFSCD_pBstLdAdjThresLo_C "Untere Ladedruckschwelle zur Freigabe der Driftkompensation im Lastbereich" VALUE 0xC39C6 Kw_Ws16 3500.000 Pres_hPa 0.00 3500.000 FORMAT "%8.3" EXTENDED_LIMITS -32768.00 32767.00 /end CHARACTERISTIC
/begin CHARACTERISTIC AFSCD_tClntThrLo_C "Untere Kühlwassertemperaturschwelle für die Plausibilitätsprüfung der Driftempfindlichkeit des Luftmassenmessers" VALUE 0xC3C7C Kw_Ws16 250.0000 Temp_Cels -50.14000 199.8600 FORMAT "%8.4" EXTENDED_LIMITS -3549.940 3003.560 /end CHARACTERISTIC
/begin CHARACTERISTIC AFSCD_tClntThrHi_C "Obere Kühlmitteltemperaturschwelle für Plausibilisierungsfreigabe der Luftmassensensor-Empfindlichkeitsdrift" VALUE 0xC3C7E Kw_Ws16 250.0000 Temp_Cels -50.14000 199.8600 FORMAT "%8.4" EXTENDED_LIMITS -3549.940 3003.560 /end CHARACTERISTIC
/begin CHARACTERISTIC AFSCD_rSwirlThrLo_C "Minimale Sollposition der Einlasskanalabschaltung für Plausibilisierungsfreigabe der Luftmassensensor-Empfindlichkeitsdrift" VALUE 0xC3C80 Kw_Ws16 100.0000 DtyCyc 0.00 100.0000 FORMAT "%8.4" EXTENDED_LIMITS -327.6800 327.6700 /end CHARACTERISTIC
/begin CHARACTERISTIC AFSCD_rSwirlThrHi_C "Maximale Sollpossition der Einlasskanalabschaltung für Plausibilisierungsfreigabe der  Luftmassensensor-Empfindlichkeitsdrift" VALUE 0xC3C82 Kw_Ws16 100.0000 DtyCyc 0.00 100.0000 FORMAT "%8.4" EXTENDED_LIMITS -327.6800 327.6700 /end CHARACTERISTIC
/begin CHARACTERISTIC AFSCD_rTVAThrLo_C "Minimale Sollposition des Drosselklappenstellers für Plausibilisierungsfreigabe der Luftmassensensor-Empfindlichkeitsdrift" VALUE 0xC3C84 Kw_Ws16 100.0000 Prc 0.00 100.0000 FORMAT "%8.4" EXTENDED_LIMITS -400.0000 399.9878 /end CHARACTERISTIC
/begin CHARACTERISTIC AFSCD_rTVAThrHi_C "Maximale Sollposition des Drosselklappenstellers für Plausibilisierungsfreigabe der Luftmassensensor-Empfindlichkeitsdrift" VALUE 0xC3C86 Kw_Ws16 100.0000 Prc 0.00 100.0000 FORMAT "%8.4" EXTENDED_LIMITS -400.0000 399.9878 /end CHARACTERISTIC
/begin CHARACTERISTIC AFSCD_pAirThrLo_C "untere Atmosphärendruckschwelle für die Plausibilitätsprüfung der Luftmassensensor-Empfindlichkeit" VALUE 0xC3C88 Kw_Ws16 3000.000 Pres_hPa 500.0000 3500.000 FORMAT "%8.3" EXTENDED_LIMITS -32768.00 32767.00 /end CHARACTERISTIC
/begin CHARACTERISTIC AFSCD_qRawThrHi_C "Maximale Einspritzmenge für Plausibilisierungsfreigabe der Luftmassensensor-Empfindlichkeitsdrift" VALUE 0xC3C8A Kw_Ws16 327.6700 RmpInjMass 0.00 327.6700 FORMAT "%8.4" EXTENDED_LIMITS -5.000000 4.999847 /end CHARACTERISTIC
/begin CHARACTERISTIC AFSCD_nAvrgThrLoPlHi_C "Untere Drehzahlschwelle für Plausibilisierung der oberen Luftmassensensor-Driftgrenze" VALUE 0xC3C8C Kw_Ws16 6000.000 EngN 0.00 6000.000 FORMAT "%8.3" EXTENDED_LIMITS -32768.00 32767.00 /end CHARACTERISTIC
/begin CHARACTERISTIC AFSCD_nAvrgThrHiPlHi_C "Obere Drehzahlschwelle für Plausibilisierung der oberen Luftmassensensor-Driftgrenze" VALUE 0xC3C8E Kw_Ws16 6000.000 EngN 0.00 6000.000 FORMAT "%8.3" EXTENDED_LIMITS -32768.00 32767.00 /end CHARACTERISTIC
/begin CHARACTERISTIC AFSCD_pBstThrHiPlHi_C "Obere Ladedruckschwelle für Plausibilisierung der oberen Luftmassensensor-Driftgrenze" VALUE 0xC3C90 Kw_Ws16 3500.000 RmpPres_hPa 0.00 3500.000 FORMAT "%8.3" EXTENDED_LIMITS -500.0000 499.9847 /end CHARACTERISTIC
/begin CHARACTERISTIC AFSCD_rAirThrHiPlHi_C "Obere Normverhältnisschwelle für Plausibilisierung der oberen Luftmassensensor-Driftgrenze" VALUE 0xC3C92 Kw_Ws16 7.999878 Fact -4.000000 3.999878 FORMAT "%8.6" /end CHARACTERISTIC
/begin CHARACTERISTIC AFSCD_nAvrgThrLoPlLo_C "Untere Drehzahlschwelle für Plausibilisierung der unteren Luftmassensensor-Driftgrenze" VALUE 0xC3C94 Kw_Ws16 6000.000 EngN 0.00 6000.000 FORMAT "%8.3" EXTENDED_LIMITS -32768.00 32767.00 /end CHARACTERISTIC
/begin CHARACTERISTIC AFSCD_nAvrgThrHiPlLo_C "Obere Drehzahlschwelle für Plausibilisierung der unteren Luftmassensensor-Driftgrenze" VALUE 0xC3C96 Kw_Ws16 6000.000 EngN 0.00 6000.000 FORMAT "%8.3" EXTENDED_LIMITS -32768.00 32767.00 /end CHARACTERISTIC
/begin CHARACTERISTIC AFSCD_pBstThrLoPlLo_C "Untere Ladedruckschwelle für Plausibilisierung der unteren Luftmassensensor-Driftgrenze" VALUE 0xC3C98 Kw_Ws16 3500.000 Pres_hPa 0.00 3500.000 FORMAT "%8.3" EXTENDED_LIMITS -32768.00 32767.00 /end CHARACTERISTIC
/begin CHARACTERISTIC AFSCD_rAirThrLoPlLo_C "Untere Normverhältnisschwelle für Plausibilisierung der unteren Luftmassensensor-Driftgrenze" VALUE 0xC3C9A Kw_Ws16 7.999878 Fact -4.000000 3.999878 FORMAT "%8.6" /end CHARACTERISTIC
/begin CHARACTERISTIC AFSCD_rEGRPThrHi_C "Obere Schwelle der Stellgröße des AGR-Ventils für Plausibilisierungsfreigabe der Luftmassensensor-Empfindlichkeitsdrift" VALUE 0xC3C9C Kw_Ws16 400.0000 Prc -200.0000 200.0000 FORMAT "%8.4" EXTENDED_LIMITS -400.0000 399.9878 /end CHARACTERISTIC
/begin CHARACTERISTIC AFSCD_tiDlyEGRPPlSetyDrft_C "Verzögerungszeit nach Veränderung der Abgasrückführung für Plausibilisierungsfreigabe der Luftmassensensor-Empfindlichkeitsdrift" VALUE 0xC3C9E Kw_Wu16 65540.00 Time_ms 0.00 65540.00 FORMAT "%8.2" EXTENDED_LIMITS 0.00 655350.0 /end CHARACTERISTIC
/begin CHARACTERISTIC AFSCD_tiDlyStrPlSetyDrft_C "Verzögerungszeit nach Motorstart für Plausibilisierungsfreigabe der Luftmassensensor-Empfindlichkeitsdrift" VALUE 0xC3CA0 Kw_Wu16 65540.00 Time_ms 0.00 65540.00 FORMAT "%8.2" EXTENDED_LIMITS 0.00 655350.0 /end CHARACTERISTIC
/begin CHARACTERISTIC AFSCD_dtAirThres_C "Schwelle für Änderungsrate der Ladelufttemperatur" VALUE 0xC3CA2 Kw_Ws16 65535.00 TempCels_100ms -32768.00 32767.00 FORMAT "%8.2" /end CHARACTERISTIC
/begin CHARACTERISTIC AFSCD_stInhRls_C "Bitmaske zur Unterdrückung der Plausibilisierung der Luftmassensensor-Empfindlichkeitsdrift bei Stellertest" VALUE 0xC3CA4 Kw_Wu16 65535.00 OneToOne 0.00 65535.00 FORMAT "%8.2" /end CHARACTERISTIC
/begin CHARACTERISTIC AFSCD_tiAirMsPT1_C "Zeitkonstante zur Filterung des Luftmassenstroms" VALUE 0xC39C8 Kw_Wu32 4294967.3 TimeDelay_ms 0.0010000000 4294967.3 FORMAT "%9.1" /end CHARACTERISTIC
/begin CHARACTERISTIC AFSCD_tiCorFacPT1_C "Zeitkonstante zur Filterung des Korrekturfaktors" VALUE 0xC39CC Kw_Wu32 4294967.3 TimeDelay_ms 0.0010000000 4294967.3 FORMAT "%9.1" /end CHARACTERISTIC
/begin CHARACTERISTIC AFSCD_tiBstPresPT1_C "Zeitkonstante zur Filterung des Ladedruckgradientens" VALUE 0xC39D0 Kw_Wu32 4294967.3 TimeDelay_ms 0.0010000000 4294967.3 FORMAT "%9.1" /end CHARACTERISTIC
/begin CHARACTERISTIC AFSCD_tiQntCurrPT1_C "Zeitkonstante zur Filterung des Mengengradientens" VALUE 0xC39D4 Kw_Wu32 4294967.3 TimeDelay_ms 0.0010000000 4294967.3 FORMAT "%9.1" /end CHARACTERISTIC
/begin CHARACTERISTIC AFSCD_tiWtPenDetPT1_C "Zeitkonstante zur Filterung der Gradientendifferenz bei Wassereintragerkennung" VALUE 0xC39D8 Kw_Wu32 4294967.3 TimeDelay_ms 0.0010000000 4294967.3 FORMAT "%9.1" /end CHARACTERISTIC
/begin CHARACTERISTIC AFSCD_qCurrIdlAdjThresHi_C "Obere Einspritzmengenschwelle zur Freigabe der Driftkompensation im Leerlauf" VALUE 0xC39DC Kw_Ws16 327.6700 InjMass 0.00 327.6700 FORMAT "%8.4" EXTENDED_LIMITS -327.6800 327.6700 /end CHARACTERISTIC
/begin CHARACTERISTIC AFSCD_qCurrIdlAdjThresLo_C "Untere Einspritzmengenschwelle zur Freigabe der Driftkompensation im Leerlauf" VALUE 0xC39DE Kw_Ws16 327.6700 InjMass 0.00 327.6700 FORMAT "%8.4" EXTENDED_LIMITS -327.6800 327.6700 /end CHARACTERISTIC
/begin CHARACTERISTIC AFSCD_qWinLdAdjThresHi_CUR "Obere drehzahlabhängige Mengenschwelle zur Freigabe der Driftkompensation im Lastbereich" CURVE 0xC39E0 Kl_Xs16_Ws16 327.6700 InjMass 0.00 327.6700 FORMAT "%8.4" EXTENDED_LIMITS -327.6800 327.6700
 /begin AXIS_DESCR STD_AXIS Eng_nAvrg EngN 4 40.00000 6000.000 FORMAT "%8.3" EXTENDED_LIMITS -32768.00 32767.00 DEPOSIT ABSOLUTE /end AXIS_DESCR
/end CHARACTERISTIC
/begin CHARACTERISTIC AFSCD_qWinLdAdjThresLo_CUR "Untere drehzahlabhängige Mengenschwelle zur Freigabe der Driftkompensation im Lastbereich" CURVE 0xC39F2 Kl_Xs16_Ws16 327.6700 InjMass 0.00 327.6700 FORMAT "%8.4" EXTENDED_LIMITS -327.6800 327.6700
 /begin AXIS_DESCR STD_AXIS Eng_nAvrg EngN 5 40.00000 6000.000 FORMAT "%8.3" EXTENDED_LIMITS -32768.00 32767.00 DEPOSIT ABSOLUTE /end AXIS_DESCR
/end CHARACTERISTIC
/begin CHARACTERISTIC AFSCD_swtActvEEPLoThres_C "Switch, sets the deactivation status of the minimum drift limits stored in the EEPROM to 0" VALUE 0xC3A08 Kw_Wu8 1.000 OneToOne 0.00 1.000 FORMAT "%5.3" EXTENDED_LIMITS 0.00 255.0 /end CHARACTERISTIC
/begin CHARACTERISTIC AFSCD_swtClrEEPAdjVal_C "Softwareschalter, setzt die im EEPROM gespeicherten Korrekturwerte auf 0" VALUE 0xC3A09 Kw_Wu8 1.000 OneToOne 0.00 1.000 FORMAT "%5.3" EXTENDED_LIMITS 0.00 255.0 /end CHARACTERISTIC
/begin CHARACTERISTIC AFSCD_swtCurrAdjRls_C "Softwareschalter zur Freigabe der Driftkompensation" VALUE 0xC3A0A Kw_Wu8 1.000 OneToOne 0.00 1.000 FORMAT "%5.3" EXTENDED_LIMITS 0.00 255.0 /end CHARACTERISTIC
/begin CHARACTERISTIC AFSCD_swtSensInstVal_C "Schalter zur Bestimmung, ob der Luftmassensensor vorhanden ist oder nicht" VALUE 0xC3CA6 Kw_Wu8 1.000 OneToOne 0.00 1.000 FORMAT "%5.3" EXTENDED_LIMITS 0.00 255.0 /end CHARACTERISTIC
/begin CHARACTERISTIC AFSCD_swtSensInstType_C "Definition des SW-Schaltertyps (0=Datensatzwert, nicht applizierbar/1=EEPROM-Wert/2=Datensatzwert)" VALUE 0xC3CA7 Kw_Wu8 1.000 OneToOne 1.000 2.000 FORMAT "%5.3" EXTENDED_LIMITS 0.00 255.0 /end CHARACTERISTIC
/begin CHARACTERISTIC AFSCD_swtWtPenMon_C "Softwareschalter zur permanenten Aktivierung der Wassereintragerkennung" VALUE 0xC3A0B Kw_Wu8 1.000 OneToOne 0.00 1.000 FORMAT "%5.3" EXTENDED_LIMITS 0.00 255.0 /end CHARACTERISTIC
/begin CHARACTERISTIC AFSCD_tAirAdjRlsThresHi_C "Obere Ansauglufttemperaturschwelle zur Erfüllung der Umgebungsbedingungen" VALUE 0xC3A0C Kw_Ws16 250.0000 Temp_Cels -50.14000 199.8600 FORMAT "%8.4" EXTENDED_LIMITS -3549.940 3003.560 /end CHARACTERISTIC
/begin CHARACTERISTIC AFSCD_tAirAdjRlsThresLo_C "Untere Ansauglufttemperaturschwelle zur Erfüllung der Umgebungsbedingungen" VALUE 0xC3A0E Kw_Ws16 250.0000 Temp_Cels -50.14000 199.8600 FORMAT "%8.4" EXTENDED_LIMITS -3549.940 3003.560 /end CHARACTERISTIC
/begin CHARACTERISTIC AFSCD_tEnvAdjRlsThresHi_C "Obere Umgebungstemperaturschwelle zur Erfüllung der Umgebungsbedingungen" VALUE 0xC3A10 Kw_Ws16 250.0000 Temp_Cels -50.14000 199.8600 FORMAT "%8.4" EXTENDED_LIMITS -3549.940 3003.560 /end CHARACTERISTIC
/begin CHARACTERISTIC AFSCD_tEnvAdjRlsThresLo_C "Untere Umgebungstemperaturschwelle zur Erfüllung der Umgebungsbedingungen" VALUE 0xC3A12 Kw_Ws16 250.0000 Temp_Cels -50.14000 199.8600 FORMAT "%8.4" EXTENDED_LIMITS -3549.940 3003.560 /end CHARACTERISTIC
/begin CHARACTERISTIC AFSCD_tiAdjRlsDel_C "Verzögerungszeit nach Stellereingriff bis zur Freigabe der Driftkompensation im Leerlauf und Lastbereich" VALUE 0xC3A14 Kw_Wu16 655350.0 Time_ms 0.00 655350.0 FORMAT "%8.1" /end CHARACTERISTIC
/begin CHARACTERISTIC AFSCD_tiMinIdlAdjRls_C "Zeitdauer der Korrekturwertberechnung im Leerlauf" VALUE 0xC3A16 Kw_Wu16 655350.0 TimeDeb 0.00 655350.0 FORMAT "%8.1" /end CHARACTERISTIC
/begin CHARACTERISTIC AFSCD_tiMinLdAdjRls_C "Zeitdauer der Korrekturwertberechnung im Lastbereich" VALUE 0xC3A18 Kw_Wu16 655350.0 TimeDeb 0.00 655350.0 FORMAT "%8.1" /end CHARACTERISTIC
/begin CHARACTERISTIC AFSCD_tiStrtDelAdjRls_C "Startverzögerung nach Erreichen Motorzustand NORMAL zur Erfüllung der Umgebungsfreigabebedingungen" VALUE 0xC3A1C Kw_Wu32 3600.00000000 Time_s 0.00 3600.00000000 FORMAT "%13.8" EXTENDED_LIMITS 0.00 42949672.9500 /end CHARACTERISTIC
/begin CHARACTERISTIC AFSCD_tiWtPenDetDebLoHi_C "Zeitkonstante zur Entprellung der Wassereintragserkennung" VALUE 0xC3A20 Kw_Wu16 655350.0 TimeDeb 0.00 655350.0 FORMAT "%8.1" /end CHARACTERISTIC
/begin CHARACTERISTIC AFSCD_vVehLdAdjThresHi_C "Obere Fahrzeuggeschwindigkeitsschwelle zur Freigabe der Driftkompensation im Lastbereich" VALUE 0xC3A22 Kw_Ws16 300.0000 Vel 0.00 300.0000 FORMAT "%8.4" EXTENDED_LIMITS -327.6800 327.6700 /end CHARACTERISTIC
/begin CHARACTERISTIC AFSCD_vVehLdAdjThresLo_C "Untere Fahrzeuggeschwindigkeitsschwelle zur Freigabe der Driftkompensation im Lastbereich" VALUE 0xC3A24 Kw_Ws16 300.0000 Vel 0.00 300.0000 FORMAT "%8.4" EXTENDED_LIMITS -327.6800 327.6700 /end CHARACTERISTIC
/begin CHARACTERISTIC AFS_tidphiStrgDT1_C "time for DT1 filter" VALUE 0xC34F8 Kw_Wu32 4294.9673 TimeDelay_s 0.0000010000000 4294.9673 FORMAT "%9.4" /end CHARACTERISTIC
/begin CHARACTERISTIC AFS_kddphiStrg_C "Kd for the DT1 filter" VALUE 0xC34FC Kw_Ws32 32767.9999847 Kd 0.00 32767.9999847 FORMAT "%13.7" EXTENDED_LIMITS -32768.0000000 32767.9999847 /end CHARACTERISTIC
/begin CHARACTERISTIC AFS_facDynCorr1_CUR "curve to calculate factor for dynamic torque correction depending upon engine speed" CURVE 0xC3500 Kl_Xs16_Ws16 10.00000 Fact 0.00 10.00000 FORMAT "%8.5" EXTENDED_LIMITS -4.000000 3.999878
 /begin AXIS_DESCR STD_AXIS Eng_nAvrg EngN 7 40.00000 6000.000 FORMAT "%8.3" EXTENDED_LIMITS -32768.00 32767.00 DEPOSIT ABSOLUTE /end AXIS_DESCR
/end CHARACTERISTIC
/begin CHARACTERISTIC AFS_facDynCorr1_MAP "map to calculate dynamic torque depending upon steering angle and rate of change of steering angle" MAP 0xC351E Kf_Xs16_Ys16_Ws16 10.00000 Fact 0.00 10.00000 FORMAT "%8.5" EXTENDED_LIMITS -4.000000 3.999878
 /begin AXIS_DESCR STD_AXIS AFS_dphiStrg_mp AngleGradPerSec 7 -1439.934 1439.934 FORMAT "%8.3" EXTENDED_LIMITS -1440.154 1440.110 DEPOSIT ABSOLUTE /end AXIS_DESCR
 /begin AXIS_DESCR STD_AXIS FrmMng_phiStrg AngleGrad 7 -180.0192 180.0192 FORMAT "%8.4" EXTENDED_LIMITS -1440.154 1440.110 DEPOSIT ABSOLUTE /end AXIS_DESCR
/end CHARACTERISTIC
/begin CHARACTERISTIC AFS_facNEngDynCorr_MAP "map to calculate factor for dynamic torque correction depending upon engine speed and vehicle speed" MAP 0xC35A0 Kf_Xs16_Ys16_Ws16 10.00000 Fact 0.00 10.00000 FORMAT "%8.5" EXTENDED_LIMITS -4.000000 3.999878
 /begin AXIS_DESCR STD_AXIS Eng_nAvrg EngN 7 40.00000 6000.000 FORMAT "%8.3" EXTENDED_LIMITS -32768.00 32767.00 DEPOSIT ABSOLUTE /end AXIS_DESCR
 /begin AXIS_DESCR STD_AXIS VSSCD_v Vel 7 0.00 300.0000 FORMAT "%8.4" EXTENDED_LIMITS -327.6800 327.6700 DEPOSIT ABSOLUTE /end AXIS_DESCR
/end CHARACTERISTIC
/begin CHARACTERISTIC AFS_facVehSpd_MAP "map to calculate factor for static torque correction depending upon vehicle speed" MAP 0xC3622 Kf_Xs16_Ys16_Ws16 10.00000 Fact 0.00 10.00000 FORMAT "%8.5" EXTENDED_LIMITS -4.000000 3.999878
 /begin AXIS_DESCR STD_AXIS Eng_nAvrg EngN 3 40.00000 6000.000 FORMAT "%8.3" EXTENDED_LIMITS -32768.00 32767.00 DEPOSIT ABSOLUTE /end AXIS_DESCR
 /begin AXIS_DESCR STD_AXIS VSSCD_v Vel 3 0.00 300.0000 FORMAT "%8.4" EXTENDED_LIMITS -327.6800 327.6700 DEPOSIT ABSOLUTE /end AXIS_DESCR
/end CHARACTERISTIC
/begin CHARACTERISTIC AFS_rTrans_C "Transmission ratio of AFS" VALUE 0xC3644 Kw_Ws16 200.0000 TransR 0.00 200.0000 FORMAT "%8.4" EXTENDED_LIMITS -327.6800 327.6700 /end CHARACTERISTIC
/begin CHARACTERISTIC AFS_swtChkDM_ANF_AFS_C "#SSD Switch value for DREHMOMENT_ANF_AFS" VALUE 0xC3646 Kw_Wu8 1.000 Trq 0.00 1.000 FORMAT "%5.3" EXTENDED_LIMITS 0.00 25.50 /end CHARACTERISTIC
/begin CHARACTERISTIC AFS_swtChkSTWA_C "#SSD Switch value for LENKRADWINKEL" VALUE 0xC3647 Kw_Wu8 1.000 Trq 0.00 1.000 FORMAT "%5.3" EXTENDED_LIMITS 0.00 25.50 /end CHARACTERISTIC
/begin CHARACTERISTIC AFS_swtdphiStrgGenSel_C "#SSD switch value for general selection" VALUE 0xC3648 Kw_Wu8 1.000 OneToOne 0.00 1.000 FORMAT "%5.3" EXTENDED_LIMITS 0.00 255.0 /end CHARACTERISTIC
/begin CHARACTERISTIC AFS_swtdphiStrgSourceSel_C "switch value for source selection" VALUE 0xC3649 Kw_Wu8 1.000 OneToOne 0.00 1.000 FORMAT "%5.3" EXTENDED_LIMITS 0.00 255.0 /end CHARACTERISTIC
/begin CHARACTERISTIC AFS_swtErrAFS_C "Switch value to enable bits in case of AFS error, so as to disable AFS torque" VALUE 0xC364A Kw_Wu8 31.00 OneToOne 0.00 31.00 FORMAT "%5.2" EXTENDED_LIMITS 0.00 255.0 /end CHARACTERISTIC
/begin CHARACTERISTIC AFS_swtErrStrg_C "Switch value for enabling bits in case of steering error, so as to disable AFS torque" VALUE 0xC364B Kw_Wu8 15.00 OneToOne 0.00 15.00 FORMAT "%5.2" EXTENDED_LIMITS 0.00 255.0 /end CHARACTERISTIC
/begin CHARACTERISTIC AFS_swtVAR_C "switch value of AFS" VALUE 0xC364C Kw_Wu8 1.000 OneToOne 0.00 1.000 FORMAT "%5.3" EXTENDED_LIMITS 0.00 255.0 /end CHARACTERISTIC
/begin CHARACTERISTIC AFS_trqBaseDynCorr_MAP "Basiskennfeld für den Dynamikanteil des AFS Moments" MAP 0xC364E Kf_Xs16_Ys16_Ws16 1500.000 Trq -500.0000 1000.000 FORMAT "%8.3" EXTENDED_LIMITS -3276.800 3276.700
 /begin AXIS_DESCR STD_AXIS AFS_trqTar_mp Trq 7 -500.0000 1000.000 FORMAT "%8.3" EXTENDED_LIMITS -3276.800 3276.700 DEPOSIT ABSOLUTE /end AXIS_DESCR
 /begin AXIS_DESCR STD_AXIS AFS_dphiStrg_mp AngleGradPerSec 7 -1439.934 1439.934 FORMAT "%8.3" EXTENDED_LIMITS -1440.154 1440.110 DEPOSIT ABSOLUTE /end AXIS_DESCR
/end CHARACTERISTIC
/begin CHARACTERISTIC AFS_trqBaseStatCorr_MAP "Basiskennfeld für den Stationäranteil des AFS-Moments" MAP 0xC36D0 Kf_Xs16_Ys16_Ws16 1500.000 Trq -500.0000 1000.000 FORMAT "%8.3" EXTENDED_LIMITS -3276.800 3276.700
 /begin AXIS_DESCR STD_AXIS FrmMng_phiStrg AngleGrad 9 -180.0192 180.0192 FORMAT "%8.4" EXTENDED_LIMITS -1440.154 1440.110 DEPOSIT ABSOLUTE /end AXIS_DESCR
 /begin AXIS_DESCR STD_AXIS AFS_dphiStrg_mp AngleGradPerSec 7 -180.0192 180.0192 FORMAT "%8.4" EXTENDED_LIMITS -1440.154 1440.110 DEPOSIT ABSOLUTE /end AXIS_DESCR
/end CHARACTERISTIC
/begin CHARACTERISTIC AFS_trqDesMax_C "#SSD Oberer Grenzwert für AFS Wunschmoment" VALUE 0xC3772 Kw_Ws16 600.0000 Trq 0.00 600.0000 FORMAT "%8.4" EXTENDED_LIMITS -3276.800 3276.700 /end CHARACTERISTIC
/begin CHARACTERISTIC AFS_trqDesMin_C "#SSD Unterer Grenzwert für AFS Wunschmoment" VALUE 0xC3774 Kw_Ws16 600.0000 Trq 0.00 600.0000 FORMAT "%8.4" EXTENDED_LIMITS -3276.800 3276.700 /end CHARACTERISTIC
/begin CHARACTERISTIC AFS_trqDisable_MAP "map to calculate disable torque depending upon steering angle and Vehicle Speed" MAP 0xC3776 Kf_Xs16_Ys16_Ws16 1500.000 Trq -500.0000 1000.000 FORMAT "%8.3" EXTENDED_LIMITS -3276.800 3276.700
 /begin AXIS_DESCR STD_AXIS FrmMng_phiStrg AngleGrad 2 -180.0192 180.0192 FORMAT "%8.4" EXTENDED_LIMITS -1440.154 1440.110 DEPOSIT ABSOLUTE /end AXIS_DESCR
 /begin AXIS_DESCR STD_AXIS VSSCD_v Vel 2 0.00 300.0000 FORMAT "%8.4" EXTENDED_LIMITS -327.6800 327.6700 DEPOSIT ABSOLUTE /end AXIS_DESCR
/end CHARACTERISTIC
/begin CHARACTERISTIC AFS_uBattMin_C "minimum battery voltage required" VALUE 0xC378A Kw_Ws16 28602.15 Volt_Batt 0.00 28602.15 FORMAT "%8.2" EXTENDED_LIMITS -640625.6 640606.1 /end CHARACTERISTIC
/begin CHARACTERISTIC AirCtl_APCorRgn_CUR "Kennlinie für Atmosphärendruckkorrekturwert Regenerations-betrieb" CURVE 0xC4134 Kl_Xs16_Ws16 3000.000 AirMassPerCyl -1500.000 1500.000 FORMAT "%8.3" EXTENDED_LIMITS -3276.800 3276.700
 /begin AXIS_DESCR STD_AXIS APSCD_pVal Pres_hPa 6 0.00 4000.000 FORMAT "%8.3" EXTENDED_LIMITS -32768.00 32767.00 DEPOSIT ABSOLUTE /end AXIS_DESCR
/end CHARACTERISTIC
/begin CHARACTERISTIC AirCtl_APSCor_CUR "Kennlinie für Atmosphärendruckkorrektur" CURVE 0xC414E Kl_Xs16_Ws16 3000.000 AirMassPerCyl -1500.000 1500.000 FORMAT "%8.3" EXTENDED_LIMITS -3276.800 3276.700
 /begin AXIS_DESCR STD_AXIS APSCD_pVal Pres_hPa 8 0.00 4000.000 FORMAT "%8.3" EXTENDED_LIMITS -32768.00 32767.00 DEPOSIT ABSOLUTE /end AXIS_DESCR
/end CHARACTERISTIC
/begin CHARACTERISTIC AirCtl_ATCorRgn_CUR "Kennlinie für Lufttemperaturkorrekturwert Regenerations betrieb" CURVE 0xC4170 Kl_Xs16_Ws16 5.000000 Fact 0.00 5.000000 FORMAT "%8.6" EXTENDED_LIMITS -4.000000 3.999878
 /begin AXIS_DESCR STD_AXIS IATSCD_tAir Temp_Cels 6 -50.1400 199.8600 FORMAT "%8.4" EXTENDED_LIMITS -3549.940 3003.560 DEPOSIT ABSOLUTE /end AXIS_DESCR
/end CHARACTERISTIC
/begin CHARACTERISTIC AirCtl_dmDesBasUp_C "positie rampensteigung für den luftmassensollgrundwert" VALUE 0xC418C Kw_Wu32 6553599.99847 RmpAirMassPerCyl 0.00 6553599.99847 FORMAT "%13.5" /end CHARACTERISTIC
/begin CHARACTERISTIC AirCtl_dmDesBasDwn_C "Negative Rampensteigung für den Luftmassensollgrundwert" VALUE 0xC4190 Kw_Wu32 6553599.99847 RmpAirMassPerCyl 0.00 6553599.99847 FORMAT "%13.5" /end CHARACTERISTIC
/begin CHARACTERISTIC AirCtl_dnSurgeHigh_CUR "Obergenze für Drehzahlgradienten Hysterese gegen Laderpumpen" CURVE 0xC6314 Kl_Xs16_Ws16 3000.000 dn_dZ20 0.00 3000.000 FORMAT "%8.3" EXTENDED_LIMITS -327680.0 327670.0
 /begin AXIS_DESCR STD_AXIS Eng_nAvrg EngN 5 0.00 6000.000 FORMAT "%8.3" EXTENDED_LIMITS -32768.00 32767.00 DEPOSIT ABSOLUTE /end AXIS_DESCR
/end CHARACTERISTIC
/begin CHARACTERISTIC AirCtl_dnSurgeLow_CUR "Untergrenze für Drehzahlgradienten Hysterese gegen Laderpumpen" CURVE 0xC632A Kl_Xs16_Ws16 3000.000 dn_dZ20 0.00 3000.000 FORMAT "%8.3" EXTENDED_LIMITS -327680.0 327670.0
 /begin AXIS_DESCR STD_AXIS Eng_nAvrg EngN 5 0.00 6000.000 FORMAT "%8.3" EXTENDED_LIMITS -32768.00 32767.00 DEPOSIT ABSOLUTE /end AXIS_DESCR
/end CHARACTERISTIC
/begin CHARACTERISTIC AirCtl_dqCurrRmpUp_C "Rampensteigung für ungefilterte Einspritzmenge" VALUE 0xC6340 Kw_Wu32 655359.999847 RmpInjMass 0.00 655359.999847 FORMAT "%13.6" /end CHARACTERISTIC
/begin CHARACTERISTIC AirCtl_dqCurrRmpDwn_C "Rampensenkung für ungefilterte Einspritzmenge" VALUE 0xC6344 Kw_Wu32 655359.999847 RmpInjMass 0.00 655359.999847 FORMAT "%13.6" /end CHARACTERISTIC
/begin CHARACTERISTIC AirCtl_dqRawInjMass_C "threshold for injection mass" VALUE 0xC6348 Kw_Ws16 16384.00 InjMassPerSec_20ms -16384.00 0.00 FORMAT "%8.2" EXTENDED_LIMITS -16384.00 16383.50 /end CHARACTERISTIC
/begin CHARACTERISTIC AirCtl_drBrkRmpUp_C "Positive Rampensteigung  für Bremssignal Auswertung" VALUE 0xC634C Kw_Wu32 799999.999814 RmpPrc 0.00 799999.999814 FORMAT "%13.6" /end CHARACTERISTIC
/begin CHARACTERISTIC AirCtl_drBrkRmpDwn_C "Negative Rampensteigung  für Bremssignal Auswertung" VALUE 0xC6350 Kw_Wu32 799999.999814 RmpPrc 0.00 799999.999814 FORMAT "%13.6" /end CHARACTERISTIC
/begin CHARACTERISTIC AirCtl_tiqRawDT1_C "Reciprocal of time delay" VALUE 0xC6354 Kw_Wu32 4294.9663 TimeDelay_s 0.0010000001 4294.9673 FORMAT "%9.4" EXTENDED_LIMITS 0.0000010000000 4294.9673 /end CHARACTERISTIC
/begin CHARACTERISTIC AirCtl_kdDT1qRaw_C "Differential factor" VALUE 0xC6358 Kw_Ws32 32767.9999847 Kd 0.00 32767.9999847 FORMAT "%13.7" EXTENDED_LIMITS -32768.0000000 32767.9999847 /end CHARACTERISTIC
/begin CHARACTERISTIC AirCtl_tiDT1_C "Zeitkonstante des DT1-Gliedes" VALUE 0xC56E0 Kw_Wu32 4294.9663 TimeDelay_s 0.0010000001 4294.9673 FORMAT "%9.4" EXTENDED_LIMITS 0.0000010000000 4294.9673 /end CHARACTERISTIC
/begin CHARACTERISTIC AirCtl_DKd_C "Grundwert der Verstärkung des DT1-Glieds bei Kleinsignalen" VALUE 0xC56E4 Kw_Ws32 100.000016391 Kd_InjMass2Prc -50.0000081956 50.0000081956 FORMAT "%13.10" EXTENDED_LIMITS -40000.0000000 39999.9999814 /end CHARACTERISTIC
/begin CHARACTERISTIC AirCtl_DKdPos_C "Grundwert der Verstärkung des DT1-Glieds bei positiven Großsignalen" VALUE 0xC56E8 Kw_Ws32 100.000016391 Kd_InjMass2Prc -50.0000081956 50.0000081956 FORMAT "%13.10" EXTENDED_LIMITS -40000.0000000 39999.9999814 /end CHARACTERISTIC
/begin CHARACTERISTIC AirCtl_DKdNeg_C "Grundwert der Verstärkung des DT1-Glieds bei negativen Großsignalen" VALUE 0xC56EC Kw_Ws32 100.000016391 Kd_InjMass2Prc -50.0000081956 50.0000081956 FORMAT "%13.10" EXTENDED_LIMITS -40000.0000000 39999.9999814 /end CHARACTERISTIC
/begin CHARACTERISTIC AirCtl_dqDWinPos_C "obere Kleinsignalgrenze für das DT1- Glied" VALUE 0xC56F0 Kw_Ws16 16383.50 InjMassPerSec_20ms 0.00 16383.50 FORMAT "%8.2" EXTENDED_LIMITS -16384.00 16383.50 /end CHARACTERISTIC
/begin CHARACTERISTIC AirCtl_dqDWinNeg_C "untere Kleinsignalgrenze für das DT1- Glied" VALUE 0xC56F2 Kw_Ws16 16384.00 InjMassPerSec_20ms -16384.00 0.00 FORMAT "%8.2" EXTENDED_LIMITS -16384.00 16383.50 /end CHARACTERISTIC
/begin CHARACTERISTIC AirCtl_tiDT1Rgn_C "DT1-element time constant in regeneration operation" VALUE 0xC56F4 Kw_Wu32 4294.9663 TimeDelay_s 0.0010000001 4294.9673 FORMAT "%9.4" EXTENDED_LIMITS 0.0000010000000 4294.9673 /end CHARACTERISTIC
/begin CHARACTERISTIC AirCtl_DKdRgn_C "Basic value of DT1 element gain for small signals in regeneration operation" VALUE 0xC56F8 Kw_Ws32 100.000016391 Kd_InjMass2Prc -50.0000081956 50.0000081956 FORMAT "%13.10" EXTENDED_LIMITS -40000.0000000 39999.9999814 /end CHARACTERISTIC
/begin CHARACTERISTIC AirCtl_DKdPosRgn_C "Basic value of DT1 element gain for positive large signals in regeneration operation" VALUE 0xC56FC Kw_Ws32 100.000016391 Kd_InjMass2Prc -50.0000081956 50.0000081956 FORMAT "%13.10" EXTENDED_LIMITS -40000.0000000 39999.9999814 /end CHARACTERISTIC
/begin CHARACTERISTIC AirCtl_DKdNegRgn_C "Basic value of DT1 element gain for negative large signals in regeneration operation" VALUE 0xC5700 Kw_Ws32 100.000016391 Kd_InjMass2Prc -50.0000081956 50.0000081956 FORMAT "%13.10" EXTENDED_LIMITS -40000.0000000 39999.9999814 /end CHARACTERISTIC
/begin CHARACTERISTIC AirCtl_dqDWinPosRgn_C "Upper small-signal limit for the DT1-element in regeneration operation" VALUE 0xC5704 Kw_Ws16 327.6700 InjMass 0.00 327.6700 FORMAT "%8.4" EXTENDED_LIMITS -327.6800 327.6700 /end CHARACTERISTIC
/begin CHARACTERISTIC AirCtl_dqDWinNegRgn_C "Lower small-signal limit for the DT1-element in regeneration operation" VALUE 0xC5706 Kw_Ws16 327.6800 InjMass -327.6800 0.00 FORMAT "%8.4" EXTENDED_LIMITS -327.6800 327.6700 /end CHARACTERISTIC
/begin CHARACTERISTIC AirCtl_tiDT1DesCld_C "Zeitkonstante des DT1-Gliedes für kalten Motor" VALUE 0xC4194 Kw_Wu32 4294.9663 TimeDelay_s 0.0010000001 4294.9673 FORMAT "%9.4" EXTENDED_LIMITS 0.0000010000000 4294.9673 /end CHARACTERISTIC
/begin CHARACTERISTIC AirCtl_DKdDesCld_C "Kleinsignalverstärkung der dynamischen Sollwertbildung bei kaltem Motor" VALUE 0xC4198 Kw_Ws32 655359.999847 Kd_InjMass2Ampc -327680.000000 327679.999847 FORMAT "%13.6" /end CHARACTERISTIC
/begin CHARACTERISTIC AirCtl_DKdPosDesCld_C "positive Großsignalverstärkung der dynamischen Sollwertbildung für kalten Motor" VALUE 0xC419C Kw_Ws32 655359.999847 Kd_InjMass2Ampc -327680.000000 327679.999847 FORMAT "%13.6" /end CHARACTERISTIC
/begin CHARACTERISTIC AirCtl_DKdNegDesCld_C "negative Großsignalverstärkung der dynamischen Sollwertbildung für kalten Motor" VALUE 0xC41A0 Kw_Ws32 655359.999847 Kd_InjMass2Ampc -327680.000000 327679.999847 FORMAT "%13.6" /end CHARACTERISTIC
/begin CHARACTERISTIC AirCtl_dqDWinPosDesCld_C "positive Kleinsignalgrenze für kalten Motor" VALUE 0xC41A4 Kw_Ws16 16383.50 InjMassPerSec_20ms 0.00 16383.50 FORMAT "%8.2" EXTENDED_LIMITS -16384.00 16383.50 /end CHARACTERISTIC
/begin CHARACTERISTIC AirCtl_dqDWinNegDesCld_C "negative Kleinsignalgrenze für kalten Motor" VALUE 0xC41A6 Kw_Ws16 16384.00 InjMassPerSec_20ms -16384.00 0.00 FORMAT "%8.2" EXTENDED_LIMITS -16384.00 16383.50 /end CHARACTERISTIC
/begin CHARACTERISTIC AirCtl_tiDT1DesWrm_C "Zeitkonstante des DT1-Gliedes für warmen Motor" VALUE 0xC41A8 Kw_Wu32 4294.9663 TimeDelay_s 0.0010000001 4294.9673 FORMAT "%9.4" EXTENDED_LIMITS 0.0000010000000 4294.9673 /end CHARACTERISTIC
/begin CHARACTERISTIC AirCtl_DKdDesWrm_C "Kleinsignalverstärkung der dynamischen Sollwertbildung bei warmem Motor" VALUE 0xC41AC Kw_Ws32 655359.999847 Kd_InjMass2Ampc -327680.000000 327679.999847 FORMAT "%13.6" /end CHARACTERISTIC
/begin CHARACTERISTIC AirCtl_DKdPosDesWrm_C "positive Großsignalverstärkung der dynamischen Sollwertbildung für warmen Motor" VALUE 0xC41B0 Kw_Ws32 655359.999847 Kd_InjMass2Ampc -327680.000000 327679.999847 FORMAT "%13.6" /end CHARACTERISTIC
/begin CHARACTERISTIC AirCtl_DKdNegDesWrm_C "negative Großsignalverstärkung der dynamischen Sollwertbildung für warmen Motor" VALUE 0xC41B4 Kw_Ws32 655359.999847 Kd_InjMass2Ampc -327680.000000 327679.999847 FORMAT "%13.6" /end CHARACTERISTIC
/begin CHARACTERISTIC AirCtl_dqDWinPosDesWrm_C "positive Kleinsignalgrenze für warmen Motor" VALUE 0xC41B8 Kw_Ws16 16383.50 InjMassPerSec_20ms 0.00 16383.50 FORMAT "%8.2" EXTENDED_LIMITS -16384.00 16383.50 /end CHARACTERISTIC
/begin CHARACTERISTIC AirCtl_dqDWinNegDesWrm_C "negative Kleinsignalgrenze für warmen Motor" VALUE 0xC41BA Kw_Ws16 16384.00 InjMassPerSec_20ms -16384.00 0.00 FORMAT "%8.2" EXTENDED_LIMITS -16384.00 16383.50 /end CHARACTERISTIC
/begin CHARACTERISTIC AirCtl_facATParAdDKd_CUR "Parameter adaption of D governor based on air temperature" CURVE 0xC5708 Kl_Xs16_Ws16 5.000000 Fact1 0.00 5.000000 FORMAT "%8.6" EXTENDED_LIMITS -256.0000 255.9922
 /begin AXIS_DESCR STD_AXIS IATSCD_tAir Temp_Cels 8 -50.14000 199.86000 FORMAT "%8.5" EXTENDED_LIMITS -3549.940 3003.560 DEPOSIT ABSOLUTE /end AXIS_DESCR
/end CHARACTERISTIC
/begin CHARACTERISTIC AirCtl_facATParAdIKi_CUR "Parameter adaption  of I governor based on air temperature" CURVE 0xC572A Kl_Xs16_Ws16 5.000000 Fact1 0.00 5.000000 FORMAT "%8.6" EXTENDED_LIMITS -256.0000 255.9922
 /begin AXIS_DESCR STD_AXIS IATSCD_tAir Temp_Cels 8 -50.14000 199.86000 FORMAT "%8.5" EXTENDED_LIMITS -3549.940 3003.560 DEPOSIT ABSOLUTE /end AXIS_DESCR
/end CHARACTERISTIC
/begin CHARACTERISTIC AirCtl_facATParAdPKp_CUR "Parameter adaption  of P governor based on air temperature" CURVE 0xC574C Kl_Xs16_Ws16 5.000000 Fact1 0.00 5.000000 FORMAT "%8.6" EXTENDED_LIMITS -256.0000 255.9922
 /begin AXIS_DESCR STD_AXIS IATSCD_tAir Temp_Cels 8 -50.14000 199.86000 FORMAT "%8.5" EXTENDED_LIMITS -3549.940 3003.560 DEPOSIT ABSOLUTE /end AXIS_DESCR
/end CHARACTERISTIC
/begin CHARACTERISTIC AirCtl_facCTSCor1_CUR "Kennlinie für Kühlmitteltemperaturkorrekturwert" CURVE 0xC41BC Kl_Xs16_Ws16 4.000000 Fact 0.00 4.000000 FORMAT "%8.6" EXTENDED_LIMITS -4.000000 3.999878
 /begin AXIS_DESCR STD_AXIS CTSCD_tClnt Temp_Cels 10 -50.1400 199.8600 FORMAT "%8.4" EXTENDED_LIMITS -3549.940 3003.560 DEPOSIT ABSOLUTE /end AXIS_DESCR
/end CHARACTERISTIC
/begin CHARACTERISTIC AirCtl_facCTSCor2_CUR "Kennlinie für Kühlmitteltemperaturkorrekturwert" CURVE 0xC41E6 Kl_Xs16_Ws16 4.000000 Fact 0.00 4.000000 FORMAT "%8.6" EXTENDED_LIMITS -4.000000 3.999878
 /begin AXIS_DESCR STD_AXIS CTSCD_tClnt Temp_Cels 8 -50.1400 199.8600 FORMAT "%8.4" EXTENDED_LIMITS -3549.940 3003.560 DEPOSIT ABSOLUTE /end AXIS_DESCR
/end CHARACTERISTIC
/begin CHARACTERISTIC AirCtl_facEGRCtlATCor_CUR "Ansauglufttemperatur-Korrekturfaktor des Tastverhältnisses für EGR" CURVE 0xC576E Kl_Xs16_Ws16 5.000000 Fact1 0.00 5.000000 FORMAT "%8.6" EXTENDED_LIMITS -256.0000 255.9922
 /begin AXIS_DESCR STD_AXIS IATSCD_tAir Temp_Cels 6 -50.14000 199.86000 FORMAT "%8.5" EXTENDED_LIMITS -3549.940 3003.560 DEPOSIT ABSOLUTE /end AXIS_DESCR
/end CHARACTERISTIC
/begin CHARACTERISTIC AirCtl_facEGRCtlCTCor_CUR "Kühlmitteltemperatur-Korrekturfaktor des Tastverhältnisses   für EGR" CURVE 0xC5788 Kl_Xs16_Ws16 5.000000 Fact1 0.00 5.000000 FORMAT "%8.6" EXTENDED_LIMITS -256.0000 255.9922
 /begin AXIS_DESCR STD_AXIS CTSCD_tClnt Temp_Cels 6 -50.14000 199.86000 FORMAT "%8.5" EXTENDED_LIMITS -3549.940 3003.560 DEPOSIT ABSOLUTE /end AXIS_DESCR
/end CHARACTERISTIC
/begin CHARACTERISTIC AirCtl_facIATSCor_CUR "Kennlinie für Lufttemperaturkorrekturfaktor für ARF" CURVE 0xC4208 Kl_Xs16_Ws16 4.000000 Fact 0.00 4.000000 FORMAT "%8.6" EXTENDED_LIMITS -4.000000 3.999878
 /begin AXIS_DESCR STD_AXIS IATSCD_tAir Temp_Cels 10 -50.1400 199.8600 FORMAT "%8.4" EXTENDED_LIMITS -3549.940 3003.560 DEPOSIT ABSOLUTE /end AXIS_DESCR
/end CHARACTERISTIC
/begin CHARACTERISTIC AirCtl_facNQParAdDKd_MAP "Parameter adaption of D governor based on engine speed and injection quantity" MAP 0xC57A2 Kf_Xs16_Ys16_Ws16 5.000000 Fact1 0.00 5.000000 FORMAT "%8.6" EXTENDED_LIMITS -256.0000 255.9922
 /begin AXIS_DESCR STD_AXIS Eng_nAvrg EngN 8 0.00 8000.000 FORMAT "%8.3" EXTENDED_LIMITS -32768.00 32767.00 DEPOSIT ABSOLUTE /end AXIS_DESCR
 /begin AXIS_DESCR STD_AXIS InjCtl_qCurrCor InjMassCyc 8 0.00 100.0000 FORMAT "%8.4" EXTENDED_LIMITS -327.6800 327.6700 DEPOSIT ABSOLUTE /end AXIS_DESCR
/end CHARACTERISTIC
/begin CHARACTERISTIC AirCtl_facNQParAdIKi_MAP "Parameter adaption  of I governor based on engine speed and injection quantity" MAP 0xC5846 Kf_Xs16_Ys16_Ws16 5.000000 Fact1 0.00 5.000000 FORMAT "%8.6" EXTENDED_LIMITS -256.0000 255.9922
 /begin AXIS_DESCR STD_AXIS Eng_nAvrg EngN 8 0.00 8000.000 FORMAT "%8.3" EXTENDED_LIMITS -32768.00 32767.00 DEPOSIT ABSOLUTE /end AXIS_DESCR
 /begin AXIS_DESCR STD_AXIS InjCtl_qCurrCor InjMassCyc 8 0.00 100.0000 FORMAT "%8.4" EXTENDED_LIMITS -327.6800 327.6700 DEPOSIT ABSOLUTE /end AXIS_DESCR
/end CHARACTERISTIC
/begin CHARACTERISTIC AirCtl_facNQParAdPKp_MAP "Parameter adaption of P governor based on engine speed and injection quantity" MAP 0xC58EA Kf_Xs16_Ys16_Ws16 5.000000 Fact1 0.00 5.000000 FORMAT "%8.6" EXTENDED_LIMITS -256.0000 255.9922
 /begin AXIS_DESCR STD_AXIS Eng_nAvrg EngN 8 0.00 8000.000 FORMAT "%8.3" EXTENDED_LIMITS -32768.00 32767.00 DEPOSIT ABSOLUTE /end AXIS_DESCR
 /begin AXIS_DESCR STD_AXIS InjCtl_qCurrCor InjMassCyc 8 0.00 100.0000 FORMAT "%8.4" EXTENDED_LIMITS -327.6800 327.6700 DEPOSIT ABSOLUTE /end AXIS_DESCR
/end CHARACTERISTIC
/begin CHARACTERISTIC AirCtl_facNQParRgnAdDKd_MAP "Auf Parameteranpassung des d-Reglers, im Regenerationsmodus, basiert Motordrehzahl und Einspritzungquantität" MAP 0xC598E Kf_Xs16_Ys16_Ws16 5.000000 Fact1 0.00 5.000000 FORMAT "%8.6" EXTENDED_LIMITS -256.0000 255.9922
 /begin AXIS_DESCR STD_AXIS Eng_nAvrg EngN 8 0.00 8000.000 FORMAT "%8.3" EXTENDED_LIMITS -32768.00 32767.00 DEPOSIT ABSOLUTE /end AXIS_DESCR
 /begin AXIS_DESCR STD_AXIS InjCtl_qCurrCor InjMassCyc 8 0.00 100.0000 FORMAT "%8.4" EXTENDED_LIMITS -327.6800 327.6700 DEPOSIT ABSOLUTE /end AXIS_DESCR
/end CHARACTERISTIC
/begin CHARACTERISTIC AirCtl_facNQParRgnAdIKi_MAP "Kennfeld für Parameteradaption in Abhängigkeit von Drehzahl und Einspritzmoment, im Regenerationsmodus" MAP 0xC5A32 Kf_Xs16_Ys16_Ws16 5.000000 Fact1 0.00 5.000000 FORMAT "%8.6" EXTENDED_LIMITS -256.0000 255.9922
 /begin AXIS_DESCR STD_AXIS Eng_nAvrg EngN 8 0.00 8000.000 FORMAT "%8.3" EXTENDED_LIMITS -32768.00 32767.00 DEPOSIT ABSOLUTE /end AXIS_DESCR
 /begin AXIS_DESCR STD_AXIS InjCtl_qCurrCor InjMassCyc 8 0.00 100.0000 FORMAT "%8.4" EXTENDED_LIMITS -327.6800 327.6700 DEPOSIT ABSOLUTE /end AXIS_DESCR
/end CHARACTERISTIC
/begin CHARACTERISTIC AirCtl_facNQParRgnAdPKp_MAP "Kennfeld für Parameteradaption in Abhängigkeit von Drehzahl und Einspritzmenge, im Regenerationsmodus" MAP 0xC5AD6 Kf_Xs16_Ys16_Ws16 5.000000 Fact1 0.00 5.000000 FORMAT "%8.6" EXTENDED_LIMITS -256.0000 255.9922
 /begin AXIS_DESCR STD_AXIS Eng_nAvrg EngN 8 0.00 8000.000 FORMAT "%8.3" EXTENDED_LIMITS -32768.00 32767.00 DEPOSIT ABSOLUTE /end AXIS_DESCR
 /begin AXIS_DESCR STD_AXIS InjCtl_qCurrCor InjMassCyc 8 0.00 100.0000 FORMAT "%8.4" EXTENDED_LIMITS -327.6800 327.6700 DEPOSIT ABSOLUTE /end AXIS_DESCR
/end CHARACTERISTIC
/begin CHARACTERISTIC AirCtl_facTVACtlATCor_CUR "Ansauglufttemperatur-Korrekturfaktor des Tastverhältnisses für TVA" CURVE 0xC5F80 Kl_Xs16_Ws16 5.000000 Fact1 0.00 5.000000 FORMAT "%8.6" EXTENDED_LIMITS -256.0000 255.9922
 /begin AXIS_DESCR STD_AXIS IATSCD_tAir Temp_Cels 6 -50.14000 199.86000 FORMAT "%8.5" EXTENDED_LIMITS -3549.940 3003.560 DEPOSIT ABSOLUTE /end AXIS_DESCR
/end CHARACTERISTIC
/begin CHARACTERISTIC AirCtl_facTVACtlCTCor_CUR "Kühlmitteltemperatur-Korrekturfaktor des Tastverhältnisses für TVA" CURVE 0xC5F9A Kl_Xs16_Ws16 5.000000 Fact1 0.00 5.000000 FORMAT "%8.6" EXTENDED_LIMITS -256.0000 255.9922
 /begin AXIS_DESCR STD_AXIS CTSCD_tClnt Temp_Cels 6 -50.14000 199.86000 FORMAT "%8.5" EXTENDED_LIMITS -3549.940 3003.560 DEPOSIT ABSOLUTE /end AXIS_DESCR
/end CHARACTERISTIC
/begin CHARACTERISTIC AirCtl_IKi2_C "Grundwert 2 der I-Verstärkung des PI-Reglers bei Kleinsignalen" VALUE 0xC5B7C Kw_Wu32 5.00000396642 Ki_Ampc2Prc 0.00 5.00000396642 FORMAT "%13.11" EXTENDED_LIMITS 0.00 122070.312472 /end CHARACTERISTIC
/begin CHARACTERISTIC AirCtl_IKiPos2_C "Grundwert 2 der I-Verstärkung des PI-Reglers bei positiven Großsignalen" VALUE 0xC5B80 Kw_Wu32 5.00000396642 Ki_Ampc2Prc 0.00 5.00000396642 FORMAT "%13.11" EXTENDED_LIMITS 0.00 122070.312472 /end CHARACTERISTIC
/begin CHARACTERISTIC AirCtl_IKiNeg2_C "Grundwert 2 der I-Verstärkung des PI-Reglers bei negativen Großsignalen" VALUE 0xC5B84 Kw_Wu32 5.00000396642 Ki_Ampc2Prc 0.00 5.00000396642 FORMAT "%13.11" EXTENDED_LIMITS 0.00 122070.312472 /end CHARACTERISTIC
/begin CHARACTERISTIC AirCtl_mIWinPos2_C "obere Kleinsignalgrenze für den I-Kanal des PI-Reglers 2" VALUE 0xC5B88 Kw_Ws16 1500.000 AirMassPerCyl 0.00 1500.000 FORMAT "%8.3" EXTENDED_LIMITS -3276.800 3276.700 /end CHARACTERISTIC
/begin CHARACTERISTIC AirCtl_mIWinNeg2_C "untere Kleinsignalgrenze für den I-Kanal des PI-Reglers 2" VALUE 0xC5B8A Kw_Ws16 1500.000 AirMassPerCyl -1500.000 0.00 FORMAT "%8.3" EXTENDED_LIMITS -3276.800 3276.700 /end CHARACTERISTIC
/begin CHARACTERISTIC AirCtl_IKiRgn2_C "I2-governor gain, deviation is within small signal bounds" VALUE 0xC5B8C Kw_Wu32 5.00000396642 Ki_Ampc2Prc 0.00 5.00000396642 FORMAT "%13.11" EXTENDED_LIMITS 0.00 122070.312472 /end CHARACTERISTIC
/begin CHARACTERISTIC AirCtl_IKiPosRgn2_C "I2-governor gain, deviation is greater than small signal bound" VALUE 0xC5B90 Kw_Wu32 5.00000396642 Ki_Ampc2Prc 0.00 5.00000396642 FORMAT "%13.11" EXTENDED_LIMITS 0.00 122070.312472 /end CHARACTERISTIC
/begin CHARACTERISTIC AirCtl_IKiNegRgn2_C "I2-governor gain, deviation is less than small signal bound" VALUE 0xC5B94 Kw_Wu32 5.00000396642 Ki_Ampc2Prc 0.00 5.00000396642 FORMAT "%13.11" EXTENDED_LIMITS 0.00 122070.312472 /end CHARACTERISTIC
/begin CHARACTERISTIC AirCtl_mIWinPosRgn2_C "I2-governor positive window border" VALUE 0xC5B98 Kw_Ws16 1500.000 AirMassPerCyl 0.00 1500.000 FORMAT "%8.3" EXTENDED_LIMITS -3276.800 3276.700 /end CHARACTERISTIC
/begin CHARACTERISTIC AirCtl_mIWinNegRgn2_C "I2-governor negative window border" VALUE 0xC5B9A Kw_Ws16 1500.000 AirMassPerCyl -1500.000 0.00 FORMAT "%8.3" EXTENDED_LIMITS -3276.800 3276.700 /end CHARACTERISTIC
/begin CHARACTERISTIC AirCtl_IKi_C "Grundwert der I-Verstärkung des PI-Reglers bei Kleinsignalen" VALUE 0xC5B9C Kw_Wu32 5.00000396642 Ki_Ampc2Prc 0.00 5.00000396642 FORMAT "%13.11" EXTENDED_LIMITS 0.00 122070.312472 /end CHARACTERISTIC
/begin CHARACTERISTIC AirCtl_IKiPos_C "Grundwert der I-Verstärkung des PI-Reglers bei positiven Großsignalen" VALUE 0xC5BA0 Kw_Wu32 5.00000396642 Ki_Ampc2Prc 0.00 5.00000396642 FORMAT "%13.11" EXTENDED_LIMITS 0.00 122070.312472 /end CHARACTERISTIC
/begin CHARACTERISTIC AirCtl_IKiNeg_C "Grundwert der I-Verstärkung des PI-Reglers bei negativen Großsignalen" VALUE 0xC5BA4 Kw_Wu32 5.00000396642 Ki_Ampc2Prc 0.00 5.00000396642 FORMAT "%13.11" EXTENDED_LIMITS 0.00 122070.312472 /end CHARACTERISTIC
/begin CHARACTERISTIC AirCtl_mIWinPos_C "obere Kleinsignalgrenze für den I-Kanal des PI-Reglers" VALUE 0xC5BA8 Kw_Ws16 1500.000 AirMassPerCyl 0.00 1500.000 FORMAT "%8.3" EXTENDED_LIMITS -3276.800 3276.700 /end CHARACTERISTIC
/begin CHARACTERISTIC AirCtl_mIWinNeg_C "untere Kleinsignalgrenze für den I-Kanal des PI-Reglers" VALUE 0xC5BAA Kw_Ws16 1500.000 AirMassPerCyl -1500.000 0.00 FORMAT "%8.3" EXTENDED_LIMITS -3276.800 3276.700 /end CHARACTERISTIC
/begin CHARACTERISTIC AirCtl_IKiRgn_C "Basic value of the PI-controller I-gain for small signals in regeneration operation" VALUE 0xC5BAC Kw_Wu32 5.00000396642 Ki_Ampc2Prc 0.00 5.00000396642 FORMAT "%13.11" EXTENDED_LIMITS 0.00 122070.312472 /end CHARACTERISTIC
/begin CHARACTERISTIC AirCtl_IKiPosRgn_C "Basic value of the PI-controller I-gain for positive large signals in regeneration operation" VALUE 0xC5BB0 Kw_Wu32 5.00000396642 Ki_Ampc2Prc 0.00 5.00000396642 FORMAT "%13.11" EXTENDED_LIMITS 0.00 122070.312472 /end CHARACTERISTIC
/begin CHARACTERISTIC AirCtl_IKiNegRgn_C "Basic value of the PI-controller I-gain for negative large signals in regeneration operation" VALUE 0xC5BB4 Kw_Wu32 5.00000396642 Ki_Ampc2Prc 0.00 5.00000396642 FORMAT "%13.11" EXTENDED_LIMITS 0.00 122070.312472 /end CHARACTERISTIC
/begin CHARACTERISTIC AirCtl_mIWinPosRgn_C "Upper small-signal limit for the PI-controller I-channel in regeneration operation" VALUE 0xC5BB8 Kw_Ws16 1500.000 AirMassPerCyl 0.00 1500.000 FORMAT "%8.3" EXTENDED_LIMITS -3276.800 3276.700 /end CHARACTERISTIC
/begin CHARACTERISTIC AirCtl_mIWinNegRgn_C "Lower small-signal limit for the PI-controller I-channel in regeneration operation" VALUE 0xC5BBA Kw_Ws16 1500.000 AirMassPerCyl -1500.000 0.00 FORMAT "%8.3" EXTENDED_LIMITS -3276.800 3276.700 /end CHARACTERISTIC
/begin CHARACTERISTIC AirCtl_MaxTrmVal_C "maximaler ARF-Abgleichwert" VALUE 0xC4232 Kw_Ws16 3000.000 AirMassPerCyl -1500.000 1500.000 FORMAT "%8.3" EXTENDED_LIMITS -3276.800 3276.700 /end CHARACTERISTIC
/begin CHARACTERISTIC AirCtl_mDesBasDef_MAP "Kennfeld zur fehler Ermittlung des stationären Basissollwerts" MAP 0xC4234 Kf_Xs16_Ys16_Ws16 3000.000 AirMassPerCyl -1500.000 1500.000 FORMAT "%8.3" EXTENDED_LIMITS -3276.800 3276.700
 /begin AXIS_DESCR STD_AXIS Eng_nAvrg EngN 16 0.00 8000.000 FORMAT "%8.3" EXTENDED_LIMITS -32768.00 32767.00 DEPOSIT ABSOLUTE /end AXIS_DESCR
 /begin AXIS_DESCR STD_AXIS InjCtl_qRawCor InjMassCyc 16 0.00 100.0000 FORMAT "%8.4" EXTENDED_LIMITS -327.6800 327.6700 DEPOSIT ABSOLUTE /end AXIS_DESCR
/end CHARACTERISTIC
/begin CHARACTERISTIC AirCtl_mDesBasFDC_MAP " Base value of desired air mass for sport mode" MAP 0xC4478 Kf_Xs16_Ys16_Ws16 3000.000 AirMassPerCyl -1500.000 1500.000 FORMAT "%8.3" EXTENDED_LIMITS -3276.800 3276.700
 /begin AXIS_DESCR STD_AXIS Eng_nAvrg EngN 16 0.00 8000.000 FORMAT "%8.3" EXTENDED_LIMITS -32768.00 32767.00 DEPOSIT ABSOLUTE /end AXIS_DESCR
 /begin AXIS_DESCR STD_AXIS InjCtl_qRaw InjMassCyc 16 0.00 100.0000 FORMAT "%8.4" EXTENDED_LIMITS -327.6800 327.6700 DEPOSIT ABSOLUTE /end AXIS_DESCR
/end CHARACTERISTIC
/begin CHARACTERISTIC AirCtl_mDesBas_MAP "Kennfeld zur Ermittlung des stationären Basissollwerts für ARF ohne VE" MAP 0xC46BC Kf_Xs16_Ys16_Ws16 3000.000 AirMassPerCyl -1500.000 1500.000 FORMAT "%8.3" EXTENDED_LIMITS -3276.800 3276.700
 /begin AXIS_DESCR STD_AXIS Eng_nAvrg EngN 16 0.00 8000.000 FORMAT "%8.3" EXTENDED_LIMITS -32768.00 32767.00 DEPOSIT ABSOLUTE /end AXIS_DESCR
 /begin AXIS_DESCR STD_AXIS InjCtl_qRawCor InjMassCyc 16 0.00 100.0000 FORMAT "%8.4" EXTENDED_LIMITS -327.6800 327.6700 DEPOSIT ABSOLUTE /end AXIS_DESCR
/end CHARACTERISTIC
/begin CHARACTERISTIC AirCtl_mDesConv_C "Kupplung Korrekturwert" VALUE 0xC4900 Kw_Ws16 1500.000 AirMassPerCyl 0.00 1500.000 FORMAT "%8.3" EXTENDED_LIMITS -3276.800 3276.700 /end CHARACTERISTIC
/begin CHARACTERISTIC AirCtl_mDesCorBypass_Vector "Konfigurationslabel für Bypass Freischnitt" VALUE 0xC2D2A Kw_Wu8 255.0 OneToOne 0.00 255.0 FORMAT "%5.1" /end CHARACTERISTIC
/begin CHARACTERISTIC AirCtl_mDesCorBypass_Channel "Konfigurationslabel für Bypass Freischnitt" VALUE 0xC2D2B Kw_Wu8 255.0 OneToOne 0.00 255.0 FORMAT "%5.1" /end CHARACTERISTIC
/begin CHARACTERISTIC AirCtl_mDesLim_MAP "Kennfeld für die Begrenzung von AirCtl_mDesStat_mp" MAP 0xC4902 Kf_Xs16_Ys16_Ws16 3000.000 AirMassPerCyl -1500.000 1500.000 FORMAT "%8.3" EXTENDED_LIMITS -3276.800 3276.700
 /begin AXIS_DESCR STD_AXIS Eng_nAvrg EngN 16 0.00 6000.000 FORMAT "%8.3" EXTENDED_LIMITS -32768.00 32767.00 DEPOSIT ABSOLUTE /end AXIS_DESCR
 /begin AXIS_DESCR STD_AXIS AirCtl_qDesLim_mp InjMassCyc 16 0.00 100.0000 FORMAT "%8.4" EXTENDED_LIMITS -327.6800 327.6700 DEPOSIT ABSOLUTE /end AXIS_DESCR
/end CHARACTERISTIC
/begin CHARACTERISTIC AirCtl_mDesRgn1_MAP "Erstes Regenerationskennfeld fuer den stationaeren Basissollwert" MAP 0xC4B46 Kf_Xs16_Ys16_Ws16 3000.000 AirMassPerCyl -1500.000 1500.000 FORMAT "%8.3" EXTENDED_LIMITS -3276.800 3276.700
 /begin AXIS_DESCR STD_AXIS Eng_nAvrg EngN 16 0.00 8000.000 FORMAT "%8.3" EXTENDED_LIMITS -32768.00 32767.00 DEPOSIT ABSOLUTE /end AXIS_DESCR
 /begin AXIS_DESCR STD_AXIS InjCtl_qRawCor InjMassCyc 16 0.00 100.0000 FORMAT "%8.4" EXTENDED_LIMITS -327.6800 327.6700 DEPOSIT ABSOLUTE /end AXIS_DESCR
/end CHARACTERISTIC
/begin CHARACTERISTIC AirCtl_mDesRgn2_MAP "Zweites Regeneratiomnskennfeld fuer den sationaeren Basissollwert" MAP 0xC4D8A Kf_Xs16_Ys16_Ws16 3000.000 AirMassPerCyl -1500.000 1500.000 FORMAT "%8.3" EXTENDED_LIMITS -3276.800 3276.700
 /begin AXIS_DESCR STD_AXIS Eng_nAvrg EngN 16 0.00 8000.000 FORMAT "%8.3" EXTENDED_LIMITS -32768.00 32767.00 DEPOSIT ABSOLUTE /end AXIS_DESCR
 /begin AXIS_DESCR STD_AXIS InjCtl_qRawCor InjMassCyc 16 0.00 100.0000 FORMAT "%8.4" EXTENDED_LIMITS -327.6800 327.6700 DEPOSIT ABSOLUTE /end AXIS_DESCR
/end CHARACTERISTIC
/begin CHARACTERISTIC AirCtl_mDesValAdd_Vector "#SSD Bypass-Label für additiven Bypass von AirCtl_mDesVal (Nicht verstellen!)" VALUE 0xC2D2C Kw_Wu8 255.0 OneToOne 0.00 255.0 FORMAT "%5.1" /end CHARACTERISTIC
/begin CHARACTERISTIC AirCtl_mDesValAdd_Channel "#SSD Bypass-Label für additiven Bypass von AirCtl_mDesVal (Nicht verstellen!)" VALUE 0xC2D2D Kw_Wu8 255.0 OneToOne 0.00 255.0 FORMAT "%5.1" /end CHARACTERISTIC
/begin CHARACTERISTIC AirCtl_mDesVal_Vector "#SSD Bypass-Label für AirCtl_mDesVal (Nicht verstellen!)" VALUE 0xC2D2E Kw_Wu8 255.0 OneToOne 0.00 255.0 FORMAT "%5.1" /end CHARACTERISTIC
/begin CHARACTERISTIC AirCtl_mDesVal_Channel "#SSD Bypass-Label für AirCtl_mDesVal (Nicht verstellen!)" VALUE 0xC2D2F Kw_Wu8 255.0 OneToOne 0.00 255.0 FORMAT "%5.1" /end CHARACTERISTIC
/begin CHARACTERISTIC AirCtl_mDiff_C "Air mass threshold" VALUE 0xC635C Kw_Ws16 100.0000 AirMassPerCyl 0.00 100.0000 FORMAT "%8.4" EXTENDED_LIMITS -3276.800 3276.700 /end CHARACTERISTIC
/begin CHARACTERISTIC AirCtl_MinTrmVal_C "minimaler ARF-Abgleichwert" VALUE 0xC4FCE Kw_Ws16 3000.000 AirMassPerCyl -1500.000 1500.000 FORMAT "%8.3" EXTENDED_LIMITS -3276.800 3276.700 /end CHARACTERISTIC
/begin CHARACTERISTIC AirCtl_mLiCor_C "Menge für Drehzahlkorrektur" VALUE 0xC4FD0 Kw_Ws16 6000.000 AirMassPerCyl 0.00 6000.000 FORMAT "%8.3" EXTENDED_LIMITS -3276.800 3276.700 /end CHARACTERISTIC
/begin CHARACTERISTIC AirCtl_mMaxDesVal_C "maximaler Luftmassensollwert" VALUE 0xC4FD2 Kw_Ws16 1500.000 AirMassPerCyl 0.00 1500.000 FORMAT "%8.3" EXTENDED_LIMITS -3276.800 3276.700 /end CHARACTERISTIC
/begin CHARACTERISTIC AirCtl_mMaxDvt_MAP "Kennfeld der oberen Grenzen für Erkennung bleibender Regelabweichung" MAP 0xC6544 Kf_Xs16_Ys16_Ws16 3276.700 AirMassPerCyl 0.00 3276.700 FORMAT "%8.3" EXTENDED_LIMITS -3276.800 3276.700
 /begin AXIS_DESCR STD_AXIS Eng_nAvrg EngN 16 0.00 8000.000 FORMAT "%8.3" EXTENDED_LIMITS -32768.00 32767.00 DEPOSIT ABSOLUTE /end AXIS_DESCR
 /begin AXIS_DESCR STD_AXIS InjCtl_qCurrCor InjMassCyc 16 0.00 200.0000 FORMAT "%8.4" EXTENDED_LIMITS -327.6800 327.6700 DEPOSIT ABSOLUTE /end AXIS_DESCR
/end CHARACTERISTIC
/begin CHARACTERISTIC AirCtl_mMinDesVal_C "minimaler Luftmassensollwert" VALUE 0xC4FD4 Kw_Ws16 1500.000 AirMassPerCyl 0.00 1500.000 FORMAT "%8.3" EXTENDED_LIMITS -3276.800 3276.700 /end CHARACTERISTIC
/begin CHARACTERISTIC AirCtl_mMinDvt_MAP "Kennfeld der unteren Grenzen für Erkennung bleibender Regelabweichung" MAP 0xC6788 Kf_Xs16_Ys16_Ws16 3276.800 AirMassPerCyl -3276.800 0.00 FORMAT "%8.3" EXTENDED_LIMITS -3276.800 3276.700
 /begin AXIS_DESCR STD_AXIS Eng_nAvrg EngN 16 0.00 8000.000 FORMAT "%8.3" EXTENDED_LIMITS -32768.00 32767.00 DEPOSIT ABSOLUTE /end AXIS_DESCR
 /begin AXIS_DESCR STD_AXIS InjCtl_qCurrCor InjMassCyc 16 0.00 200.0000 FORMAT "%8.4" EXTENDED_LIMITS -327.6800 327.6700 DEPOSIT ABSOLUTE /end AXIS_DESCR
/end CHARACTERISTIC
/begin CHARACTERISTIC AirCtl_mNQCTSCor1_MAP "Kennfeld für drehzahl- und mengenabhängige Kühlmitteltemperaturkorrektur" MAP 0xC4FD6 Kf_Xs16_Ys16_Ws16 3000.000 AirMassPerCyl -1500.000 1500.000 FORMAT "%8.3" EXTENDED_LIMITS -3276.800 3276.700
 /begin AXIS_DESCR STD_AXIS Eng_nAvrg EngN 16 0.00 8000.000 FORMAT "%8.3" EXTENDED_LIMITS -32768.00 32767.00 DEPOSIT ABSOLUTE /end AXIS_DESCR
 /begin AXIS_DESCR STD_AXIS InjCtl_qRawCor InjMassCyc 16 0.00 200.0000 FORMAT "%8.4" EXTENDED_LIMITS -327.6800 327.6700 DEPOSIT ABSOLUTE /end AXIS_DESCR
/end CHARACTERISTIC
/begin CHARACTERISTIC AirCtl_mNQCTSCor2_MAP "Kennfeld für drehzahl- und mengenabhängige Kühlmitteltemperaturkorrektur" MAP 0xC521A Kf_Xs16_Ys16_Ws16 3000.000 AirMassPerCyl -1500.000 1500.000 FORMAT "%8.3" EXTENDED_LIMITS -3276.800 3276.700
 /begin AXIS_DESCR STD_AXIS Eng_nAvrg EngN 12 0.00 8000.000 FORMAT "%8.3" EXTENDED_LIMITS -32768.00 32767.00 DEPOSIT ABSOLUTE /end AXIS_DESCR
 /begin AXIS_DESCR STD_AXIS InjCtl_qRawCor InjMassCyc 16 0.00 200.0000 FORMAT "%8.4" EXTENDED_LIMITS -327.6800 327.6700 DEPOSIT ABSOLUTE /end AXIS_DESCR
/end CHARACTERISTIC
/begin CHARACTERISTIC AirCtl_mPiI2Cor_C "Correction value for airmass for PiI2 injection" VALUE 0xC53D6 Kw_Ws16 3000.000 AirMassPerCyl -1500.000 1500.000 FORMAT "%8.3" EXTENDED_LIMITS -3276.800 3276.700 /end CHARACTERISTIC
/begin CHARACTERISTIC AirCtl_nAvrgHHi_C "obere Hysteresegrenze für Überwachung hoher Motordrehzahl" VALUE 0xC635E Kw_Ws16 5960.000 EngN 40.00000 6000.000 FORMAT "%8.3" EXTENDED_LIMITS -32768.00 32767.00 /end CHARACTERISTIC
/begin CHARACTERISTIC AirCtl_nAvrgHLo_C "untere Hysteresegrenze für Überwachung hoher Motordrehzahl" VALUE 0xC6360 Kw_Ws16 5960.000 EngN 40.00000 6000.000 FORMAT "%8.3" EXTENDED_LIMITS -32768.00 32767.00 /end CHARACTERISTIC
/begin CHARACTERISTIC AirCtl_nAvrgLHi_C "obere Hysteresegrenze für Überwachung niedriger Motordrehzahl" VALUE 0xC6362 Kw_Ws16 5960.000 EngN 40.00000 6000.000 FORMAT "%8.3" EXTENDED_LIMITS -32768.00 32767.00 /end CHARACTERISTIC
/begin CHARACTERISTIC AirCtl_nAvrgLLo_C "untere Hysteresegrenze für Überwachung niedriger Motordrehzahl" VALUE 0xC6364 Kw_Ws16 5960.000 EngN 40.00000 6000.000 FORMAT "%8.3" EXTENDED_LIMITS -32768.00 32767.00 /end CHARACTERISTIC
/begin CHARACTERISTIC AirCtl_nHealHi_C "obere Drehzahlgrenze des Heilungsbereichs" VALUE 0xC6366 Kw_Ws16 8000.000 EngN 0.00 8000.000 FORMAT "%8.3" EXTENDED_LIMITS -32768.00 32767.00 /end CHARACTERISTIC
/begin CHARACTERISTIC AirCtl_nHealLo_C "untere Drehzahlgrenze des Heilungsbereichs" VALUE 0xC6368 Kw_Ws16 8000.000 EngN 0.00 8000.000 FORMAT "%8.3" EXTENDED_LIMITS -32768.00 32767.00 /end CHARACTERISTIC
/begin CHARACTERISTIC AirCtl_nLiEGR_C "Drehzahlschwelle für Drehzahlkorrektur" VALUE 0xC53D8 Kw_Ws16 6000.000 EngN 0.00 6000.000 FORMAT "%8.3" EXTENDED_LIMITS -32768.00 32767.00 /end CHARACTERISTIC
/begin CHARACTERISTIC AirCtl_nLim_C "Eng speed threshold" VALUE 0xC636A Kw_Ws16 8000.000 EngN 0.00 8000.000 FORMAT "%8.3" EXTENDED_LIMITS -32768.00 32767.00 /end CHARACTERISTIC
/begin CHARACTERISTIC AirCtl_nLoIdl_C "Drehzahlgrenze für Leerlauferkennung" VALUE 0xC636C Kw_Ws16 8000.000 EngN 0.00 8000.000 FORMAT "%8.3" EXTENDED_LIMITS -32768.00 32767.00 /end CHARACTERISTIC
/begin CHARACTERISTIC AirCtl_nOvrRun_C "untere Drehzahlgrenze für Schubabschaltung" VALUE 0xC636E Kw_Ws16 8000.000 EngN 0.00 8000.000 FORMAT "%8.3" EXTENDED_LIMITS -32768.00 32767.00 /end CHARACTERISTIC
/begin CHARACTERISTIC AirCtl_NQATCorRgn_MAP "Kennfeld für drehzahl und megenabhaengige Lufttemperaturkorrektur" MAP 0xC53DA Kf_Xs16_Ys16_Ws16 3000.000 AirMassPerCyl -1500.000 1500.000 FORMAT "%8.3" EXTENDED_LIMITS -3276.800 3276.700
 /begin AXIS_DESCR STD_AXIS Eng_nAvrg EngN 8 0.00 8000.000 FORMAT "%8.3" EXTENDED_LIMITS -32768.00 32767.00 DEPOSIT ABSOLUTE /end AXIS_DESCR
 /begin AXIS_DESCR STD_AXIS InjCtl_qRawCor InjMassCyc 8 0.00 200.0000 FORMAT "%8.4" EXTENDED_LIMITS -327.6800 327.6700 DEPOSIT ABSOLUTE /end AXIS_DESCR
/end CHARACTERISTIC
/begin CHARACTERISTIC AirCtl_NQIATSCor_MAP "Kennfeld für drehzahl- und mengenabhängige Lufttemperaturkorrektur" MAP 0xC547E Kf_Xs16_Ys16_Ws16 3000.000 AirMassPerCyl -1500.000 1500.000 FORMAT "%8.3" EXTENDED_LIMITS -3276.800 3276.700
 /begin AXIS_DESCR STD_AXIS Eng_nAvrg EngN 16 0.00 8000.000 FORMAT "%8.3" EXTENDED_LIMITS -32768.00 32767.00 DEPOSIT ABSOLUTE /end AXIS_DESCR
 /begin AXIS_DESCR STD_AXIS InjCtl_qRawCor InjMassCyc 16 0.00 200.0000 FORMAT "%8.4" EXTENDED_LIMITS -327.6800 327.6700 DEPOSIT ABSOLUTE /end AXIS_DESCR
/end CHARACTERISTIC
/begin CHARACTERISTIC AirCtl_PKp2_C "Grundwert 2 der P-Verstärkung des PI-Reglers bei Kleinsignalen" VALUE 0xC5BBC Kw_Wu32 9.99999977648 Kp_Ampc2Prc 0.00 9.99999977648 FORMAT "%13.10" EXTENDED_LIMITS 0.00 7999.99999814 /end CHARACTERISTIC
/begin CHARACTERISTIC AirCtl_PKpPos2_C "Grundwert 2 der P-Verstärkung des PI-Reglers bei positiven Großsignalen" VALUE 0xC5BC0 Kw_Wu32 9.99999977648 Kp_Ampc2Prc 0.00 9.99999977648 FORMAT "%13.10" EXTENDED_LIMITS 0.00 7999.99999814 /end CHARACTERISTIC
/begin CHARACTERISTIC AirCtl_PKpNeg2_C "Grundwert 2 der P-Verstärkung des PI-Reglers bei negativen Großsignalen" VALUE 0xC5BC4 Kw_Wu32 9.99999977648 Kp_Ampc2Prc 0.00 9.99999977648 FORMAT "%13.10" EXTENDED_LIMITS 0.00 7999.99999814 /end CHARACTERISTIC
/begin CHARACTERISTIC AirCtl_mPWinPos2_C "obere Kleinsignalgrenze für den P-Kanal des PI-Reglers 2" VALUE 0xC5BC8 Kw_Ws16 1500.000 AirMassPerCyl 0.00 1500.000 FORMAT "%8.3" EXTENDED_LIMITS -3276.800 3276.700 /end CHARACTERISTIC
/begin CHARACTERISTIC AirCtl_mPWinNeg2_C "untere Kleinsignalgrenze für den P-Kanal des PI-Reglers 2" VALUE 0xC5BCA Kw_Ws16 1500.000 AirMassPerCyl -1500.000 0.00 FORMAT "%8.3" EXTENDED_LIMITS -3276.800 3276.700 /end CHARACTERISTIC
/begin CHARACTERISTIC AirCtl_PKpRgn2_C "P2-governor gain, deviation is within small signal bounds" VALUE 0xC5BCC Kw_Wu32 9.99999977648 Kp_Ampc2Prc 0.00 9.99999977648 FORMAT "%13.10" EXTENDED_LIMITS 0.00 7999.99999814 /end CHARACTERISTIC
/begin CHARACTERISTIC AirCtl_PKpPosRgn2_C "P2-governor gain, deviation is greater than small signal bound" VALUE 0xC5BD0 Kw_Wu32 9.99999977648 Kp_Ampc2Prc 0.00 9.99999977648 FORMAT "%13.10" EXTENDED_LIMITS 0.00 7999.99999814 /end CHARACTERISTIC
/begin CHARACTERISTIC AirCtl_PKpNegRgn2_C "P2-governor gain, deviation is less than small signal bound" VALUE 0xC5BD4 Kw_Wu32 9.99999977648 Kp_Ampc2Prc 0.00 9.99999977648 FORMAT "%13.10" EXTENDED_LIMITS 0.00 7999.99999814 /end CHARACTERISTIC
/begin CHARACTERISTIC AirCtl_mPWinPosRgn2_C "I2-governor positive window border" VALUE 0xC5BD8 Kw_Ws16 1500.000 AirMassPerCyl 0.00 1500.000 FORMAT "%8.3" EXTENDED_LIMITS -3276.800 3276.700 /end CHARACTERISTIC
/begin CHARACTERISTIC AirCtl_mPWinNegRgn2_C "I2-governor negative window border" VALUE 0xC5BDA Kw_Ws16 1500.000 AirMassPerCyl -1500.000 0.00 FORMAT "%8.3" EXTENDED_LIMITS -3276.800 3276.700 /end CHARACTERISTIC
/begin CHARACTERISTIC AirCtl_pAirHi_C "obere Hysteresegrenze für Atmosphärendrucküberwachung" VALUE 0xC6370 Kw_Ws16 65535.00 Pres_hPa -32768.00 32767.00 FORMAT "%8.2" /end CHARACTERISTIC
/begin CHARACTERISTIC AirCtl_pAirLo_C "untere Hysteresegrenze für Atmosphärendrucküberwachung" VALUE 0xC6372 Kw_Ws16 65535.00 Pres_hPa -32768.00 32767.00 FORMAT "%8.2" /end CHARACTERISTIC
/begin CHARACTERISTIC AirCtl_PKp_C "Grundwert der P-Verstärkung des PI-Reglers bei Kleinsignalen" VALUE 0xC5BDC Kw_Wu32 9.99999977648 Kp_Ampc2Prc 0.00 9.99999977648 FORMAT "%13.10" EXTENDED_LIMITS 0.00 7999.99999814 /end CHARACTERISTIC
/begin CHARACTERISTIC AirCtl_PKpPos_C "Grundwert der P-Verstärkung des PI-Reglers bei positiven Großsignalen" VALUE 0xC5BE0 Kw_Wu32 9.99999977648 Kp_Ampc2Prc 0.00 9.99999977648 FORMAT "%13.10" EXTENDED_LIMITS 0.00 7999.99999814 /end CHARACTERISTIC
/begin CHARACTERISTIC AirCtl_PKpNeg_C "Grundwert der P-Verstärkung des PI-Reglers bei negativen Großsignalen" VALUE 0xC5BE4 Kw_Wu32 9.99999977648 Kp_Ampc2Prc 0.00 9.99999977648 FORMAT "%13.10" EXTENDED_LIMITS 0.00 7999.99999814 /end CHARACTERISTIC
/begin CHARACTERISTIC AirCtl_mPWinPos_C "obere Kleinsignalgrenze für den P-Kanal des PI-Reglers" VALUE 0xC5BE8 Kw_Ws16 1500.000 AirMassPerCyl 0.00 1500.000 FORMAT "%8.3" EXTENDED_LIMITS -3276.800 3276.700 /end CHARACTERISTIC
/begin CHARACTERISTIC AirCtl_mPWinNeg_C "untere Kleinsignalgrenze für den P-Kanal des PI-Reglers" VALUE 0xC5BEA Kw_Ws16 1500.000 AirMassPerCyl -1500.000 0.00 FORMAT "%8.3" EXTENDED_LIMITS -3276.800 3276.700 /end CHARACTERISTIC
/begin CHARACTERISTIC AirCtl_PKpRgn_C "Basic value of the PI-controller P-gain for small signals in regeneration operation" VALUE 0xC5BEC Kw_Wu32 9.99999977648 Kp_Ampc2Prc 0.00 9.99999977648 FORMAT "%13.10" EXTENDED_LIMITS 0.00 7999.99999814 /end CHARACTERISTIC
/begin CHARACTERISTIC AirCtl_PKpPosRgn_C "Basic value of the PI-controller P-gain for positive large signals in regeneration operation" VALUE 0xC5BF0 Kw_Wu32 9.99999977648 Kp_Ampc2Prc 0.00 9.99999977648 FORMAT "%13.10" EXTENDED_LIMITS 0.00 7999.99999814 /end CHARACTERISTIC
/begin CHARACTERISTIC AirCtl_PKpNegRgn_C "Basic value of the PI-controller P-gain for negative large signals in regeneration operation" VALUE 0xC5BF4 Kw_Wu32 9.99999977648 Kp_Ampc2Prc 0.00 9.99999977648 FORMAT "%13.10" EXTENDED_LIMITS 0.00 7999.99999814 /end CHARACTERISTIC
/begin CHARACTERISTIC AirCtl_mPWinPosRgn_C "Upper small-signal limit for the PI-controller P-channel in regeneration operation" VALUE 0xC5BF8 Kw_Ws16 1500.000 AirMassPerCyl 0.00 1500.000 FORMAT "%8.3" EXTENDED_LIMITS -3276.800 3276.700 /end CHARACTERISTIC
/begin CHARACTERISTIC AirCtl_mPWinNegRgn_C "Lower small-signal limit for the PI-controller P-channel in regeneration operation" VALUE 0xC5BFA Kw_Ws16 1500.000 AirMassPerCyl -1500.000 0.00 FORMAT "%8.3" EXTENDED_LIMITS -3276.800 3276.700 /end CHARACTERISTIC
/begin CHARACTERISTIC AirCtl_qDiff_C "Injection mass threshold" VALUE 0xC6374 Kw_Ws16 100.0000 InjMassCyc 0.00 100.0000 FORMAT "%8.4" EXTENDED_LIMITS -327.6800 327.6700 /end CHARACTERISTIC
/begin CHARACTERISTIC AirCtl_qGear_C "Threshold value of the current injection quantity for the current gear" VALUE 0xC6376 Kw_Ws16 100.0000 InjMass 0.00 100.0000 FORMAT "%8.4" EXTENDED_LIMITS -327.6800 327.6700 /end CHARACTERISTIC
/begin CHARACTERISTIC AirCtl_qHealHi_C "obere Mengengrenze des Heilungsbereichs" VALUE 0xC6378 Kw_Ws16 200.0000 InjMass 0.00 200.0000 FORMAT "%8.4" EXTENDED_LIMITS -327.6800 327.6700 /end CHARACTERISTIC
/begin CHARACTERISTIC AirCtl_qHealLo_C "untere Mengengrenze des Heilungsbereichs" VALUE 0xC637A Kw_Ws16 200.0000 InjMass 0.00 200.0000 FORMAT "%8.4" EXTENDED_LIMITS -327.6800 327.6700 /end CHARACTERISTIC
/begin CHARACTERISTIC AirCtl_qHiRgn_CUR "Kennlinie fuer obere Hysteresegrenze fuer Abschaltung bei grosser Einspritzmenge Regenerationsbetrieb" CURVE 0xC637C Kl_Xs16_Ws16 200.0000 InjMass 0.00 200.0000 FORMAT "%8.4" EXTENDED_LIMITS -327.6800 327.6700
 /begin AXIS_DESCR STD_AXIS Eng_nAvrg EngN 6 0.00 8000.000 FORMAT "%8.3" EXTENDED_LIMITS -32768.00 32767.00 DEPOSIT ABSOLUTE /end AXIS_DESCR
/end CHARACTERISTIC
/begin CHARACTERISTIC AirCtl_qHi_CUR "Kennlinie fuer obere Hysteresegrenze fuer Abschaltung bei grosser Einspritzmenge" CURVE 0xC6396 Kl_Xs16_Ws16 200.0000 InjMass 0.00 200.0000 FORMAT "%8.4" EXTENDED_LIMITS -327.6800 327.6700
 /begin AXIS_DESCR STD_AXIS Eng_nAvrg EngN 25 0.00 8000.000 FORMAT "%8.3" EXTENDED_LIMITS -32768.00 32767.00 DEPOSIT ABSOLUTE /end AXIS_DESCR
/end CHARACTERISTIC
/begin CHARACTERISTIC AirCtl_qLoRgn_CUR "Kennlinie fuer Hysteresegrenze fuer Abschaltung bei grosser Einspritzmenge Regenerationsbetrieb" CURVE 0xC63FC Kl_Xs16_Ws16 200.0000 InjMass 0.00 200.0000 FORMAT "%8.4" EXTENDED_LIMITS -327.6800 327.6700
 /begin AXIS_DESCR STD_AXIS Eng_nAvrg EngN 6 0.00 8000.000 FORMAT "%8.3" EXTENDED_LIMITS -32768.00 32767.00 DEPOSIT ABSOLUTE /end AXIS_DESCR
/end CHARACTERISTIC
/begin CHARACTERISTIC AirCtl_qLo_CUR "Kennlinie fuer Hysteresegrenze fuer Abschaltung bei grosser Einspritzmenge" CURVE 0xC6416 Kl_Xs16_Ws16 200.0000 InjMass 0.00 200.0000 FORMAT "%8.4" EXTENDED_LIMITS -327.6800 327.6700
 /begin AXIS_DESCR STD_AXIS Eng_nAvrg EngN 25 0.00 8000.000 FORMAT "%8.3" EXTENDED_LIMITS -32768.00 32767.00 DEPOSIT ABSOLUTE /end AXIS_DESCR
/end CHARACTERISTIC
/begin CHARACTERISTIC AirCtl_qOvrRun_C "untere Mengengrenze für Schubabschaltung" VALUE 0xC647C Kw_Ws16 200.0000 InjMass 0.00 200.0000 FORMAT "%8.4" EXTENDED_LIMITS -327.6800 327.6700 /end CHARACTERISTIC
/begin CHARACTERISTIC AirCtl_qSurgeHigh_CUR "Obergrenze für Mengenhysterese gegen Laderpumpen" CURVE 0xC647E Kl_Xs16_Ws16 100.0000 InjMass 0.00 100.0000 FORMAT "%8.4" EXTENDED_LIMITS -327.6800 327.6700
 /begin AXIS_DESCR STD_AXIS Eng_nAvrg EngN 5 0.00 6000.000 FORMAT "%8.3" EXTENDED_LIMITS -32768.00 32767.00 DEPOSIT ABSOLUTE /end AXIS_DESCR
/end CHARACTERISTIC
/begin CHARACTERISTIC AirCtl_qSurgeLow_CUR "Untergrenze für Mengenhysterese gegen Laderpumpen" CURVE 0xC6494 Kl_Xs16_Ws16 100.0000 InjMass 0.00 100.0000 FORMAT "%8.4" EXTENDED_LIMITS -327.6800 327.6700
 /begin AXIS_DESCR STD_AXIS Eng_nAvrg EngN 5 0.00 6000.000 FORMAT "%8.3" EXTENDED_LIMITS -32768.00 32767.00 DEPOSIT ABSOLUTE /end AXIS_DESCR
/end CHARACTERISTIC
/begin CHARACTERISTIC AirCtl_qUnBalLim_C "injection mass threshold" VALUE 0xC64AA Kw_Ws16 200.0000 InjMassCyc 0.00 200.0000 FORMAT "%8.4" EXTENDED_LIMITS -327.6800 327.6700 /end CHARACTERISTIC
/begin CHARACTERISTIC AirCtl_rbrkDelta_C "Sprunghöhe bei Bremssignal Auswertung" VALUE 0xC64AC Kw_Ws16 100.0000 Prc 0.00 100.0000 FORMAT "%8.4" EXTENDED_LIMITS -400.0000 399.9878 /end CHARACTERISTIC
/begin CHARACTERISTIC AirCtl_rBrkXHigh_C "Obere Hystereseschwelle bei Bremssignal Auswertung" VALUE 0xC64AE Kw_Ws16 100.0000 Prc 0.00 100.0000 FORMAT "%8.4" EXTENDED_LIMITS -400.0000 399.9878 /end CHARACTERISTIC
/begin CHARACTERISTIC AirCtl_rBrkXLow_C "Untere Hystereseschwelle bei Bremssignal Auswertung" VALUE 0xC64B0 Kw_Ws16 100.0000 Prc 0.00 100.0000 FORMAT "%8.4" EXTENDED_LIMITS -400.0000 399.9878 /end CHARACTERISTIC
/begin CHARACTERISTIC AirCtl_rCtlValRgn_MAP "Vorsteuerkennfeld Luftmassenregelung im Regenerationsbetrieb über Drosselklappe" MAP 0xC3CA8 Kf_Xs16_Ys16_Ws16 100.0000 Prc 0.00 100.0000 FORMAT "%8.4" EXTENDED_LIMITS -400.0000 399.9878
 /begin AXIS_DESCR STD_AXIS Eng_nAvrg EngN 16 0.00 8000.000 FORMAT "%8.3" EXTENDED_LIMITS -32768.00 32767.00 DEPOSIT ABSOLUTE /end AXIS_DESCR
 /begin AXIS_DESCR STD_AXIS InjCtl_qCurr InjMassCyc 16 0.00 327.6700 FORMAT "%8.4" EXTENDED_LIMITS -327.6800 327.6700 DEPOSIT ABSOLUTE /end AXIS_DESCR
/end CHARACTERISTIC
/begin CHARACTERISTIC AirCtl_rCtlVal_MAP "Kennfeld zur Steuerungswertberechnung" MAP 0xC3EEC Kf_Xs16_Ys16_Ws16 100.0000 Prc 0.00 100.0000 FORMAT "%8.4" EXTENDED_LIMITS -400.0000 399.9878
 /begin AXIS_DESCR STD_AXIS Eng_nAvrg EngN 16 0.00 8000.000 FORMAT "%8.3" EXTENDED_LIMITS -32768.00 32767.00 DEPOSIT ABSOLUTE /end AXIS_DESCR
 /begin AXIS_DESCR STD_AXIS InjCtl_qCurr InjMassCyc 16 0.00 327.6700 FORMAT "%8.4" EXTENDED_LIMITS -327.6800 327.6700 DEPOSIT ABSOLUTE /end AXIS_DESCR
/end CHARACTERISTIC
/begin CHARACTERISTIC AirCtl_rEGRAdd_Vector "#SSD Bypass-Label für additiven Bypass von AirCtl_rEGR (Nicht verstellen!)" VALUE 0xC2D30 Kw_Wu8 255.0 OneToOne 0.00 255.0 FORMAT "%5.1" /end CHARACTERISTIC
/begin CHARACTERISTIC AirCtl_rEGRAdd_Channel "#SSD Bypass-Label für additiven Bypass von AirCtl_rEGR (Nicht verstellen!)" VALUE 0xC2D31 Kw_Wu8 255.0 OneToOne 0.00 255.0 FORMAT "%5.1" /end CHARACTERISTIC
/begin CHARACTERISTIC AirCtl_rEGRBas_MAP "Kennfeld fuer Abgasrueckfuehrstellgroesse" MAP 0xC5BFC Kf_Xs16_Ys16_Ws16 300.0000 Prc -100.0000 200.0000 FORMAT "%8.4" EXTENDED_LIMITS -400.0000 399.9878
 /begin AXIS_DESCR STD_AXIS Eng_nAvrg EngN 8 0.00 8000.000 FORMAT "%8.3" EXTENDED_LIMITS -32768.00 32767.00 DEPOSIT ABSOLUTE /end AXIS_DESCR
 /begin AXIS_DESCR STD_AXIS AirCtl_rOutGvnr_mp Prc 8 -400.0000 399.9878 FORMAT "%8.4" DEPOSIT ABSOLUTE /end AXIS_DESCR
/end CHARACTERISTIC
/begin CHARACTERISTIC AirCtl_rEGRCtlAPSCor_CUR "Atmosphärendruck-Korrekturfaktor des Tastverhältnisses für EGR" CURVE 0xC5CA0 Kl_Xs16_Ws16 400.0000 Prc 0.00 400.0000 FORMAT "%8.4" EXTENDED_LIMITS -400.0000 399.9878
 /begin AXIS_DESCR STD_AXIS APSCD_pVal Pres_hPa 6 0.00 3500.000 FORMAT "%8.3" EXTENDED_LIMITS -32768.00 32767.00 DEPOSIT ABSOLUTE /end AXIS_DESCR
/end CHARACTERISTIC
/begin CHARACTERISTIC AirCtl_rEGRCtlATCor_MAP "Ansauglufttemperatur-Korrekturwert des Tastverhältnisses für EGR" MAP 0xC5CBA Kf_Xs16_Ys16_Ws16 200.0000 Prc 0.00 200.0000 FORMAT "%8.4" EXTENDED_LIMITS -400.0000 399.9878
 /begin AXIS_DESCR STD_AXIS Eng_nAvrg EngN 8 0.00 6000.000 FORMAT "%8.3" EXTENDED_LIMITS -32768.00 32767.00 DEPOSIT ABSOLUTE /end AXIS_DESCR
 /begin AXIS_DESCR STD_AXIS InjCtl_qRaw InjMassCyc 8 -327.6800 327.6700 FORMAT "%8.4" DEPOSIT ABSOLUTE /end AXIS_DESCR
/end CHARACTERISTIC
/begin CHARACTERISTIC AirCtl_rEGRCtlBas_MAP "Grundwert des Tastverhältnisses für EGR" MAP 0xC5D5E Kf_Xs16_Ys16_Ws16 200.0000 Prc 0.00 200.0000 FORMAT "%8.4" EXTENDED_LIMITS -400.0000 399.9878
 /begin AXIS_DESCR STD_AXIS Eng_nAvrg EngN 10 0.00 6000.000 FORMAT "%8.3" EXTENDED_LIMITS -32768.00 32767.00 DEPOSIT ABSOLUTE /end AXIS_DESCR
 /begin AXIS_DESCR STD_AXIS InjCtl_qRaw InjMassCyc 10 -327.6800 327.6700 FORMAT "%8.4" DEPOSIT ABSOLUTE /end AXIS_DESCR
/end CHARACTERISTIC
/begin CHARACTERISTIC AirCtl_rEGRCtlCTCor_MAP "Kühlmitteltemperatur-Korrekturwert des Tastverhältnisses für EGR" MAP 0xC5E52 Kf_Xs16_Ys16_Ws16 200.0000 Prc 0.00 200.0000 FORMAT "%8.4" EXTENDED_LIMITS -400.0000 399.9878
 /begin AXIS_DESCR STD_AXIS Eng_nAvrg EngN 8 0.00 6000.000 FORMAT "%8.3" EXTENDED_LIMITS -32768.00 32767.00 DEPOSIT ABSOLUTE /end AXIS_DESCR
 /begin AXIS_DESCR STD_AXIS InjCtl_qRaw InjMassCyc 8 -327.6800 327.6700 FORMAT "%8.4" DEPOSIT ABSOLUTE /end AXIS_DESCR
/end CHARACTERISTIC
/begin CHARACTERISTIC AirCtl_rEGRDflVal12_C "Vorgabewert 12 für Stellgröße des ARF-Ventils" VALUE 0xC64B2 Kw_Ws16 300.0000 Prc -100.0000 200.0000 FORMAT "%8.4" EXTENDED_LIMITS -400.0000 399.9878 /end CHARACTERISTIC
/begin CHARACTERISTIC AirCtl_rEGRDflVal1_C "Vorgabewert für Tastverhältnis des EGR m Fall zu niedriger Lufttemperatur" VALUE 0xC64B4 Kw_Ws16 300.0000 Prc -100.0000 200.0000 FORMAT "%8.4" EXTENDED_LIMITS -400.0000 399.9878 /end CHARACTERISTIC
/begin CHARACTERISTIC AirCtl_rEGRDflVal4_C "Vorgabewert 4 für Stellgröße des ARF-Ventils" VALUE 0xC64B6 Kw_Ws16 300.0000 Prc -100.0000 200.0000 FORMAT "%8.4" EXTENDED_LIMITS -400.0000 399.9878 /end CHARACTERISTIC
/begin CHARACTERISTIC AirCtl_rEGRDflVal5_C "Vorgabewert 5 für Stellgröße des ARF-Ventils" VALUE 0xC64B8 Kw_Ws16 300.0000 Prc -100.0000 200.0000 FORMAT "%8.4" EXTENDED_LIMITS -400.0000 399.9878 /end CHARACTERISTIC
/begin CHARACTERISTIC AirCtl_rEGRDflVal7_C "Vorgabewert 7 fuer Stellgroesse des ARF-Ventils (Regeneration)" VALUE 0xC64BA Kw_Ws16 300.0000 Prc -100.0000 200.0000 FORMAT "%8.4" EXTENDED_LIMITS -400.0000 399.9878 /end CHARACTERISTIC
/begin CHARACTERISTIC AirCtl_rEGRDflVal8_C "Vorgabewert 8 für Stellgröße des ARF-Ventils" VALUE 0xC64BC Kw_Ws16 300.0000 Prc -100.0000 200.0000 FORMAT "%8.4" EXTENDED_LIMITS -400.0000 399.9878 /end CHARACTERISTIC
/begin CHARACTERISTIC AirCtl_rEGRRgn_MAP "Kennfeld fuer Abgasrueckfuehrstellgroesse Regeneration" MAP 0xC5EF6 Kf_Xs16_Ys16_Ws16 300.0000 Prc -100.0000 200.0000 FORMAT "%8.4" EXTENDED_LIMITS -400.0000 399.9878
 /begin AXIS_DESCR STD_AXIS Eng_nAvrg EngN 4 0.00 8000.000 FORMAT "%8.3" EXTENDED_LIMITS -32768.00 32767.00 DEPOSIT ABSOLUTE /end AXIS_DESCR
 /begin AXIS_DESCR STD_AXIS AirCtl_rOutGvnr_mp Prc 8 -400.0000 399.9878 FORMAT "%8.4" DEPOSIT ABSOLUTE /end AXIS_DESCR
/end CHARACTERISTIC
/begin CHARACTERISTIC AirCtl_rEGR_Vector "#SSD Bypass-Label für AirCtl_rEGR (Nicht verstellen!)" VALUE 0xC2D32 Kw_Wu8 255.0 OneToOne 0.00 255.0 FORMAT "%5.1" /end CHARACTERISTIC
/begin CHARACTERISTIC AirCtl_rEGR_Channel "#SSD Bypass-Label für AirCtl_rEGR (Nicht verstellen!)" VALUE 0xC2D33 Kw_Wu8 255.0 OneToOne 0.00 255.0 FORMAT "%5.1" /end CHARACTERISTIC
/begin CHARACTERISTIC AirCtl_rGovEGRMax_C "maximal zulässige Abgasrückführventilstellgröße" VALUE 0xC5F52 Kw_Ws16 300.0000 Prc -100.0000 200.0000 FORMAT "%8.4" EXTENDED_LIMITS -400.0000 399.9878 /end CHARACTERISTIC
/begin CHARACTERISTIC AirCtl_rGovEGRMin_C "minimal zulässige Abgasrückführventilstellgröße" VALUE 0xC5F54 Kw_Ws16 300.0000 Prc -100.0000 200.0000 FORMAT "%8.4" EXTENDED_LIMITS -400.0000 399.9878 /end CHARACTERISTIC
/begin CHARACTERISTIC AirCtl_rGvnrMax_C "maximal zulässige Reglerstellgröße" VALUE 0xC5F56 Kw_Ws16 300.0000 Prc -100.0000 200.0000 FORMAT "%8.4" EXTENDED_LIMITS -400.0000 399.9878 /end CHARACTERISTIC
/begin CHARACTERISTIC AirCtl_rGvnrMin_C "minimal zulässige Reglerstellgröße" VALUE 0xC5F58 Kw_Ws16 300.0000 Prc -100.0000 200.0000 FORMAT "%8.4" EXTENDED_LIMITS -400.0000 399.9878 /end CHARACTERISTIC
/begin CHARACTERISTIC AirCtl_rGvnrTVAMax_C "maximal zulässiger Reglerkorrekturwert für Drosselklappe" VALUE 0xC5FB4 Kw_Ws16 300.0000 Prc -100.0000 200.0000 FORMAT "%8.4" EXTENDED_LIMITS -400.0000 399.9878 /end CHARACTERISTIC
/begin CHARACTERISTIC AirCtl_rGvnrTVAMin_C "minimal zulässiger Reglerkorrekturwert für Drosselklappe" VALUE 0xC5FB6 Kw_Ws16 300.0000 Prc -100.0000 200.0000 FORMAT "%8.4" EXTENDED_LIMITS -400.0000 399.9878 /end CHARACTERISTIC
/begin CHARACTERISTIC AirCtl_rIDflVal12_C "Initialisierungswert für Regler-I-Kanal bei Abschaltfall 12" VALUE 0xC5F5A Kw_Ws16 300.0000 Prc -100.0000 200.0000 FORMAT "%8.4" EXTENDED_LIMITS -400.0000 399.9878 /end CHARACTERISTIC
/begin CHARACTERISTIC AirCtl_rIDflVal4_C "PI-Element-Initialisierungswert im Abschaltfall AirCtl_stMonitor=4: Schubbetrieb" VALUE 0xC5F5C Kw_Ws16 300.0000 Prc -100.0000 200.0000 FORMAT "%8.4" EXTENDED_LIMITS -400.0000 399.9878 /end CHARACTERISTIC
/begin CHARACTERISTIC AirCtl_rIDflVal5_C "PI-Element-Initialisierungswert im Abschaltfall AirCtl_stMonitor=5: Gangwechsel" VALUE 0xC5F5E Kw_Ws16 300.0000 Prc -100.0000 200.0000 FORMAT "%8.4" EXTENDED_LIMITS -400.0000 399.9878 /end CHARACTERISTIC
/begin CHARACTERISTIC AirCtl_rIDflVal7_C "Vorgabewert 7 fuer Stellgroesse der Drosselklappe (Regeneration)" VALUE 0xC5F60 Kw_Ws16 300.0000 Prc -100.0000 200.0000 FORMAT "%8.4" EXTENDED_LIMITS -400.0000 399.9878 /end CHARACTERISTIC
/begin CHARACTERISTIC AirCtl_rIDflVal8Surge_C "PI Initialisierungswert im Falle von Laderpumpenerkennung" VALUE 0xC5F62 Kw_Ws16 300.0000 Prc -100.0000 200.0000 FORMAT "%8.4" EXTENDED_LIMITS -400.0000 399.9878 /end CHARACTERISTIC
/begin CHARACTERISTIC AirCtl_rIDflVal8_C "PI-Element-Initialisierungswert im Abschaltfall AirCtl_stMonitor=8: positive  Diagnose d. Systüberwach. od. bleibende Regelabw." VALUE 0xC5F64 Kw_Ws16 300.0000 Prc -100.0000 200.0000 FORMAT "%8.4" EXTENDED_LIMITS -400.0000 399.9878 /end CHARACTERISTIC
/begin CHARACTERISTIC AirCtl_rIDflValCtl_C "Initialisierungswert für Regler-I-Kanal bei Umschaltung vom gesteuerten auf geregelten Betrieb bei Regeneration" VALUE 0xC5F66 Kw_Ws16 300.0000 Prc -100.0000 200.0000 FORMAT "%8.4" EXTENDED_LIMITS -400.0000 399.9878 /end CHARACTERISTIC
/begin CHARACTERISTIC AirCtl_rTVAAdd_Vector "#SSD Bypass-Label für additiven Bypass von AirCtl_rTVA (Nicht verstellen!)" VALUE 0xC2D34 Kw_Wu8 255.0 OneToOne 0.00 255.0 FORMAT "%5.1" /end CHARACTERISTIC
/begin CHARACTERISTIC AirCtl_rTVAAdd_Channel "#SSD Bypass-Label für additiven Bypass von AirCtl_rTVA (Nicht verstellen!)" VALUE 0xC2D35 Kw_Wu8 255.0 OneToOne 0.00 255.0 FORMAT "%5.1" /end CHARACTERISTIC
/begin CHARACTERISTIC AirCtl_rTVABas_MAP "Kennfeld fuer Drosselklappenstellgroesse" MAP 0xC5FB8 Kf_Xs16_Ys16_Ws16 300.0000 Prc -100.0000 200.0000 FORMAT "%8.4" EXTENDED_LIMITS -400.0000 399.9878
 /begin AXIS_DESCR STD_AXIS Eng_nAvrg EngN 8 0.00 8000.000 FORMAT "%8.3" EXTENDED_LIMITS -32768.00 32767.00 DEPOSIT ABSOLUTE /end AXIS_DESCR
 /begin AXIS_DESCR STD_AXIS AirCtl_rOutGvnr_mp Prc 8 -400.0000 399.9878 FORMAT "%8.4" DEPOSIT ABSOLUTE /end AXIS_DESCR
/end CHARACTERISTIC
/begin CHARACTERISTIC AirCtl_rTVACtlAPSCor_CUR "Atmosphärendruck-Korrekturfaktor des Tastverhältnisses für TVA" CURVE 0xC605C Kl_Xs16_Ws16 200.0000 Prc 0.00 200.0000 FORMAT "%8.4" EXTENDED_LIMITS -400.0000 399.9878
 /begin AXIS_DESCR STD_AXIS APSCD_pVal Pres_hPa 6 0.00 3500.000 FORMAT "%8.3" EXTENDED_LIMITS -32768.00 32767.00 DEPOSIT ABSOLUTE /end AXIS_DESCR
/end CHARACTERISTIC
/begin CHARACTERISTIC AirCtl_rTVACtlATCor_MAP "Ansauglufttemperatur-Korrekturwert des Tastverhältnisses für TVA" MAP 0xC6076 Kf_Xs16_Ys16_Ws16 200.0000 Prc 0.00 200.0000 FORMAT "%8.4" EXTENDED_LIMITS -400.0000 399.9878
 /begin AXIS_DESCR STD_AXIS Eng_nAvrg EngN 8 0.00 6000.000 FORMAT "%8.3" EXTENDED_LIMITS -32768.00 32767.00 DEPOSIT ABSOLUTE /end AXIS_DESCR
 /begin AXIS_DESCR STD_AXIS InjCtl_qRaw InjMassCyc 8 -327.6800 327.6700 FORMAT "%8.4" DEPOSIT ABSOLUTE /end AXIS_DESCR
/end CHARACTERISTIC
/begin CHARACTERISTIC AirCtl_rTVACtlBas_MAP "Grundwert des Tastverhältnisses für TVA" MAP 0xC611A Kf_Xs16_Ys16_Ws16 200.0000 Prc 0.00 200.0000 FORMAT "%8.4" EXTENDED_LIMITS -400.0000 399.9878
 /begin AXIS_DESCR STD_AXIS Eng_nAvrg EngN 10 0.00 6000.000 FORMAT "%8.3" EXTENDED_LIMITS -32768.00 32767.00 DEPOSIT ABSOLUTE /end AXIS_DESCR
 /begin AXIS_DESCR STD_AXIS InjCtl_qRaw InjMassCyc 10 -327.6800 327.6700 FORMAT "%8.4" DEPOSIT ABSOLUTE /end AXIS_DESCR
/end CHARACTERISTIC
/begin CHARACTERISTIC AirCtl_rTVACtlCTCor_MAP "Kühlmitteltemperatur-Korrekturwert des Tastverhältnisses für TVA" MAP 0xC620E Kf_Xs16_Ys16_Ws16 200.0000 Prc 0.00 200.0000 FORMAT "%8.4" EXTENDED_LIMITS -400.0000 399.9878
 /begin AXIS_DESCR STD_AXIS Eng_nAvrg EngN 8 0.00 6000.000 FORMAT "%8.3" EXTENDED_LIMITS -32768.00 32767.00 DEPOSIT ABSOLUTE /end AXIS_DESCR
 /begin AXIS_DESCR STD_AXIS InjCtl_qRaw InjMassCyc 8 -327.6800 327.6700 FORMAT "%8.4" DEPOSIT ABSOLUTE /end AXIS_DESCR
/end CHARACTERISTIC
/begin CHARACTERISTIC AirCtl_rTVADflVal12_C "Vorgabewert 12 für Stellgröße der Drosselklappe" VALUE 0xC69CC Kw_Ws16 300.0000 Prc -100.0000 200.0000 FORMAT "%8.4" EXTENDED_LIMITS -400.0000 399.9878 /end CHARACTERISTIC
/begin CHARACTERISTIC AirCtl_rTVADflVal1_C "Default value for throttle valve ratio when shut off due to Drift Compensation occurs." VALUE 0xC69CE Kw_Ws16 300.0000 Prc -100.0000 200.0000 FORMAT "%8.4" EXTENDED_LIMITS -400.0000 399.9878 /end CHARACTERISTIC
/begin CHARACTERISTIC AirCtl_rTVADflVal4_C "Vorgabewert 4 für Stellgröße der Drosselklappe" VALUE 0xC69D0 Kw_Ws16 300.0000 Prc -100.0000 200.0000 FORMAT "%8.4" EXTENDED_LIMITS -400.0000 399.9878 /end CHARACTERISTIC
/begin CHARACTERISTIC AirCtl_rTVADflVal5_C "Vorgabewert 5 für Stellgröße der Drosselklappe" VALUE 0xC69D2 Kw_Ws16 300.0000 Prc -100.0000 200.0000 FORMAT "%8.4" EXTENDED_LIMITS -400.0000 399.9878 /end CHARACTERISTIC
/begin CHARACTERISTIC AirCtl_rTVADflVal7_C "Vorgabewert 7 fuer Stellgroesse der Drosselklappe (Regeneration)" VALUE 0xC69D4 Kw_Ws16 300.0000 Prc -100.0000 200.0000 FORMAT "%8.4" EXTENDED_LIMITS -400.0000 399.9878 /end CHARACTERISTIC
/begin CHARACTERISTIC AirCtl_rTVADflVal8_C "Vorgabewert 8 für Stellgröße der Drosselklappe" VALUE 0xC69D6 Kw_Ws16 300.0000 Prc -100.0000 200.0000 FORMAT "%8.4" EXTENDED_LIMITS -400.0000 399.9878 /end CHARACTERISTIC
/begin CHARACTERISTIC AirCtl_rTVARgn_MAP "Kennfeld fuer Drosselklappenstellgroesse Regeneration" MAP 0xC62B2 Kf_Xs16_Ys16_Ws16 300.0000 Prc -100.0000 200.0000 FORMAT "%8.4" EXTENDED_LIMITS -400.0000 399.9878
 /begin AXIS_DESCR STD_AXIS Eng_nAvrg EngN 4 0.00 8000.000 FORMAT "%8.3" EXTENDED_LIMITS -32768.00 32767.00 DEPOSIT ABSOLUTE /end AXIS_DESCR
 /begin AXIS_DESCR STD_AXIS AirCtl_rOutGvnr_mp Prc 8 -400.0000 399.9878 FORMAT "%8.4" DEPOSIT ABSOLUTE /end AXIS_DESCR
/end CHARACTERISTIC
/begin CHARACTERISTIC AirCtl_rTVA_Vector "#SSD Bypass-Label für AirCtl_rTVA (Nicht verstellen!)" VALUE 0xC2D36 Kw_Wu8 255.0 OneToOne 0.00 255.0 FORMAT "%5.1" /end CHARACTERISTIC
/begin CHARACTERISTIC AirCtl_rTVA_Channel "#SSD Bypass-Label für AirCtl_rTVA (Nicht verstellen!)" VALUE 0xC2D37 Kw_Wu8 255.0 OneToOne 0.00 255.0 FORMAT "%5.1" /end CHARACTERISTIC
/begin CHARACTERISTIC AirCtl_stEGRDel_C "TV des AGR-Ventils beim Wechsel in Regenerationsbetrieb einfrieren" VALUE 0xC5F68 Kw_Wu8 255.0 OneToOne 0.00 255.0 FORMAT "%5.1" /end CHARACTERISTIC
/begin CHARACTERISTIC AirCtl_stInhGvnrDvt_C "status word to inhibit the monitoring of the governor deviation in case of actuator tests" VALUE 0xC64BE Kw_Wu16 65535.00 OneToOne 0.00 65535.00 FORMAT "%8.2" /end CHARACTERISTIC
/begin CHARACTERISTIC AirCtl_stMskCtlValRgn_C "Maskierung zur Umschaltung des Vorsteuerwertes im Regenerationsbetrieb" VALUE 0xC4130 Kw_Wu32 2147483647.00 OneToOne 0.00 2147483647.00 FORMAT "%13.2" EXTENDED_LIMITS 0.00 4294967295.00 /end CHARACTERISTIC
/begin CHARACTERISTIC AirCtl_stMskLoIdl_C "Maskierung zur Verhinderung der Abschaltung der Luftmassenregelung im Leerlauf bei Regenerationsbetrieb" VALUE 0xC64C0 Kw_Wu32 4294967295.00 OneToOne 0.00 4294967295.00 FORMAT "%13.2" /end CHARACTERISTIC
/begin CHARACTERISTIC AirCtl_stMskOvrRun_C "Maskierung zur Verhinderung der Abschaltung der Luftmassenregelung im Regenerationsbetrieb" VALUE 0xC64C4 Kw_Wu32 4294967295.00 OneToOne 0.00 4294967295.00 FORMAT "%13.2" /end CHARACTERISTIC
/begin CHARACTERISTIC AirCtl_stMskParRgn_C "Mask for parameter switchover for regeneration operation" VALUE 0xC5F6C Kw_Wu32 2147483647.00 OneToOne 0.00 2147483647.00 FORMAT "%13.2" EXTENDED_LIMITS 0.00 4294967295.00 /end CHARACTERISTIC
/begin CHARACTERISTIC AirCtl_stRgnAirCtlshOff_C "Mask for EGT status word for AGR shut off in case of regeneration" VALUE 0xC64C8 Kw_Wu32 4294967295.00 OneToOne 0.00 4294967295.00 FORMAT "%13.2" /end CHARACTERISTIC
/begin CHARACTERISTIC AirCtl_stRgnCur_C "Maske fuer EGT_st zur Umschaltung auf zweite Mengenkurve" VALUE 0xC64CC Kw_Wu32 4294967295.00 OneToOne 0.00 4294967295.00 FORMAT "%13.2" /end CHARACTERISTIC
/begin CHARACTERISTIC AirCtl_stRgnMsk1_C "applizierbare Bitmaske für erstes Regenerationskennfeld" VALUE 0xC56C4 Kw_Wu32 2147483647.00 OneToOne 0.00 2147483647.00 FORMAT "%13.2" EXTENDED_LIMITS 0.00 4294967295.00 /end CHARACTERISTIC
/begin CHARACTERISTIC AirCtl_stRgnMsk2_C "applizierbare Bitmaske für zweites Regenerationskennfeld" VALUE 0xC56C8 Kw_Wu32 2147483647.00 OneToOne 0.00 2147483647.00 FORMAT "%13.2" EXTENDED_LIMITS 0.00 4294967295.00 /end CHARACTERISTIC
/begin CHARACTERISTIC AirCtl_stRgnMskGov_C "Maske zur Umschaltung der aufteilung der Stellgroessen" VALUE 0xC5F70 Kw_Wu32 4294967295.00 OneToOne 0.00 4294967295.00 FORMAT "%13.2" /end CHARACTERISTIC
/begin CHARACTERISTIC AirCtl_stRgnShOff_C "Maske fuer EGT_st zur Reglerabschaltung" VALUE 0xC64D0 Kw_Wu32 4294967295.00 OneToOne 0.00 4294967295.00 FORMAT "%13.2" /end CHARACTERISTIC
/begin CHARACTERISTIC AirCtl_stTVADel_C "TV der Drosselklappe beim Wechsel aus dem Regenerationsbetrieb einfrieren" VALUE 0xC630E Kw_Wu8 255.0 OneToOne 0.00 255.0 FORMAT "%5.1" /end CHARACTERISTIC
/begin CHARACTERISTIC AirCtl_tiSurgePT1_C "Filterzeit für Drehzahlgradienten aus Drehzahlbeschleunigung" VALUE 0xC64D4 Kw_Wu32 4294.8273 TimeDelay_s 0.14000154 4294.9673 FORMAT "%9.4" EXTENDED_LIMITS 0.0000010000000 4294.9673 /end CHARACTERISTIC
/begin CHARACTERISTIC AirCtl_swtAPSCorVal_C "Schalter für add. / mult. Atmosphärendruckkorrektur" VALUE 0xC56CC Kw_Wu8 0.00 OneToOne 0.00 0.00 FORMAT "%5.2" EXTENDED_LIMITS 0.00 255.0 /end CHARACTERISTIC
/begin CHARACTERISTIC AirCtl_swtAPSCorType_C "EEPROM-Wert des Schalters der Luftdruckkorrektur" VALUE 0xC56CD Kw_Wu8 0.00 OneToOne 0.00 0.00 FORMAT "%5.2" EXTENDED_LIMITS 0.00 255.0 /end CHARACTERISTIC
/begin CHARACTERISTIC AirCtl_swtEGRCtl_C "Umschalten zwischen geregelten und gesteuerten Betrieb  EGR" VALUE 0xC5F74 Kw_Wu8 1.000 OneToOne 0.00 1.000 FORMAT "%5.3" EXTENDED_LIMITS 0.00 255.0 /end CHARACTERISTIC
/begin CHARACTERISTIC AirCtl_swtGvnrVal_C "Schalter für Reglerabschaltung" VALUE 0xC5F75 Kw_Wu8 1.000 OneToOne 0.00 1.000 FORMAT "%5.3" EXTENDED_LIMITS 0.00 255.0 /end CHARACTERISTIC
/begin CHARACTERISTIC AirCtl_swtGvnrType_C "EEPROM-Wert des Schalters für Reglerabschaltung" VALUE 0xC5F76 Kw_Wu8 1.000 OneToOne 1.000 2.000 FORMAT "%5.3" EXTENDED_LIMITS 0.00 255.0 /end CHARACTERISTIC
/begin CHARACTERISTIC AirCtl_swtHighLoadCond_C "Switch to change in highload condition" VALUE 0xC64D8 Kw_Wu8 255.0 OneToOne 0.00 255.0 FORMAT "%5.1" /end CHARACTERISTIC
/begin CHARACTERISTIC AirCtl_swtHighOvrRunCond_C "switch for High OverRun condition" VALUE 0xC64D9 Kw_Wu8 255.0 OneToOne 0.00 255.0 FORMAT "%5.1" /end CHARACTERISTIC
/begin CHARACTERISTIC AirCtl_swtIATSCorVal_C "Schalter für add. / mult. Lufttemperaturkorrektur" VALUE 0xC56CE Kw_Wu8 0.00 OneToOne 0.00 0.00 FORMAT "%5.2" EXTENDED_LIMITS 0.00 255.0 /end CHARACTERISTIC
/begin CHARACTERISTIC AirCtl_swtIATSCorType_C "EEPROM-Wert des Schalters der Lufttemperaturkorrektur" VALUE 0xC56CF Kw_Wu8 0.00 OneToOne 0.00 0.00 FORMAT "%5.2" EXTENDED_LIMITS 0.00 255.0 /end CHARACTERISTIC
/begin CHARACTERISTIC AirCtl_swtTrmVal_C "Schalterwert für add./mult. Abgleichkorrektur" VALUE 0xC56D0 Kw_Wu8 0.00 OneToOne 0.00 0.00 FORMAT "%5.2" EXTENDED_LIMITS 0.00 255.0 /end CHARACTERISTIC
/begin CHARACTERISTIC AirCtl_swtTrmType_C "Schaltertyp für add./mult. Abgleichkorrektur" VALUE 0xC56D1 Kw_Wu8 0.00 OneToOne 0.00 0.00 FORMAT "%5.2" EXTENDED_LIMITS 0.00 255.0 /end CHARACTERISTIC
/begin CHARACTERISTIC AirCtl_swtTVACtl_C "Umschalten zwischen geregelten und gesteuerten Betrieb TVA" VALUE 0xC630F Kw_Wu8 1.000 OneToOne 0.00 1.000 FORMAT "%5.3" EXTENDED_LIMITS 0.00 255.0 /end CHARACTERISTIC
/begin CHARACTERISTIC AirCtl_tAirHHi_C "obere Hysteresegrenze für Überwachung hoher Lufttemperatur" VALUE 0xC64DA Kw_Ws16 250.0000 Temp_Cels -50.1400 199.8600 FORMAT "%8.4" EXTENDED_LIMITS -3549.940 3003.560 /end CHARACTERISTIC
/begin CHARACTERISTIC AirCtl_tAirHLo_C "untere Hysteresegrenze für Überwachung hoher Lufttemperatur" VALUE 0xC64DC Kw_Ws16 250.0000 Temp_Cels -50.1400 199.8600 FORMAT "%8.4" EXTENDED_LIMITS -3549.940 3003.560 /end CHARACTERISTIC
/begin CHARACTERISTIC AirCtl_tAirLHi_C "obere Hysteresegrenze für Überwachung niedriger Lufttemperatur" VALUE 0xC64DE Kw_Ws16 250.0000 Temp_Cels -50.1400 199.8600 FORMAT "%8.4" EXTENDED_LIMITS -3549.940 3003.560 /end CHARACTERISTIC
/begin CHARACTERISTIC AirCtl_tAirLLo_C "untere Hysteresegrenze für Überwachung niedriger Lufttemperatur" VALUE 0xC64E0 Kw_Ws16 250.0000 Temp_Cels -50.1400 199.8600 FORMAT "%8.4" EXTENDED_LIMITS -3549.940 3003.560 /end CHARACTERISTIC
/begin CHARACTERISTIC AirCtl_tClntCldHi_C "obere Hysteresegrenze für Überwachung niedriger Kühlwassertemperatur" VALUE 0xC64E2 Kw_Ws16 250.0000 Temp_Cels -50.1400 199.8600 FORMAT "%8.4" EXTENDED_LIMITS -3549.940 3003.560 /end CHARACTERISTIC
/begin CHARACTERISTIC AirCtl_tClntCldLo_C "untere Hysteresegrenze für Überwachung niedriger Kühlwassertemperatur" VALUE 0xC64E4 Kw_Ws16 250.0000 Temp_Cels -50.1400 199.8600 FORMAT "%8.4" EXTENDED_LIMITS -3549.940 3003.560 /end CHARACTERISTIC
/begin CHARACTERISTIC AirCtl_tClntThres_C "Kühlwassertemperaturschwelle zur Parametersatzumschaltung bei der Berechnung des dyn. Anteils" VALUE 0xC56D2 Kw_Ws16 950.000 Temp_Cels -50.140 899.860 FORMAT "%8.3" EXTENDED_LIMITS -3549.940 3003.560 /end CHARACTERISTIC
/begin CHARACTERISTIC AirCtl_tClntWrmHi_C "obere Hysteresegrenze für Überwachung hoher Kühlwassertemperatur" VALUE 0xC64E6 Kw_Ws16 250.0000 Temp_Cels -50.1400 199.8600 FORMAT "%8.4" EXTENDED_LIMITS -3549.940 3003.560 /end CHARACTERISTIC
/begin CHARACTERISTIC AirCtl_tClntWrmLo_C "untere Hysteresegrenze für Überwachung hoher Kühlwassertemperatur" VALUE 0xC64E8 Kw_Ws16 250.0000 Temp_Cels -50.1400 199.8600 FORMAT "%8.4" EXTENDED_LIMITS -3549.940 3003.560 /end CHARACTERISTIC
/begin CHARACTERISTIC AirCtl_tiCldStrt_CUR "Kennlinie für Zeit, in der die Regelung nach Startabwurf abgeschaltet bleibt" CURVE 0xC64EA Kl_Xs16_Ws16 33000.00 Time_ms 0.00 33000.00 FORMAT "%8.2" EXTENDED_LIMITS -327680.0 327670.0
 /begin AXIS_DESCR STD_AXIS CTSCD_tClnt Temp_Cels 8 -50.1400 199.8600 FORMAT "%8.4" EXTENDED_LIMITS -3549.940 3003.560 DEPOSIT ABSOLUTE /end AXIS_DESCR
/end CHARACTERISTIC
/begin CHARACTERISTIC AirCtl_tiClth_C "maximale Zeit für Schaltvorgangerkennung" VALUE 0xC650C Kw_Wu16 655350.0 TimeDeb 0.00 655350.0 FORMAT "%8.1" /end CHARACTERISTIC
/begin CHARACTERISTIC AirCtl_tiMaxDef2_C "Fehlerentprellzeit 2" VALUE 0xC650E Kw_Wu16 65540.00 Time_ms 0.00 65540.00 FORMAT "%8.2" EXTENDED_LIMITS 0.00 655350.0 /end CHARACTERISTIC
/begin CHARACTERISTIC AirCtl_tiMaxOk2_C "Fehlerheilungszeit 2" VALUE 0xC6510 Kw_Wu16 65540.00 Time_ms 0.00 65540.00 FORMAT "%8.2" EXTENDED_LIMITS 0.00 655350.0 /end CHARACTERISTIC
/begin CHARACTERISTIC AirCtl_DebGvnrDvtMaxDef_C "Vorentprellzeit für Erkennung positiver bleibender Regelabweichung" VALUE 0xC6512 Kw_Wu16 65540.00 TimeDeb 0.00 65540.00 FORMAT "%8.2" EXTENDED_LIMITS 0.00 655350.0 /end CHARACTERISTIC
/begin CHARACTERISTIC AirCtl_DebGvnrDvtMaxOk_C "Vorentprellzeit für Heilung positiver bleibender Regelabweichung" VALUE 0xC6514 Kw_Wu16 65540.00 TimeDeb 0.00 65540.00 FORMAT "%8.2" EXTENDED_LIMITS 0.00 655350.0 /end CHARACTERISTIC
/begin CHARACTERISTIC AirCtl_tiMinDef2_C "Fehlerentprellzeit 2" VALUE 0xC6516 Kw_Wu16 65540.00 Time_ms 0.00 65540.00 FORMAT "%8.2" EXTENDED_LIMITS 0.00 655350.0 /end CHARACTERISTIC
/begin CHARACTERISTIC AirCtl_tiMinOk2_C "Fehlerheilungszeit 2" VALUE 0xC6518 Kw_Wu16 65540.00 Time_ms 0.00 65540.00 FORMAT "%8.2" EXTENDED_LIMITS 0.00 655350.0 /end CHARACTERISTIC
/begin CHARACTERISTIC AirCtl_DebGvnrDvtMinDef_C "Vorentprellzeit für Erkennung negativer bleibender Regelabweichung" VALUE 0xC651A Kw_Wu16 65540.00 TimeDeb 0.00 65540.00 FORMAT "%8.2" EXTENDED_LIMITS 0.00 655350.0 /end CHARACTERISTIC
/begin CHARACTERISTIC AirCtl_DebGvnrDvtMinOk_C "Vorentprellzeit für Heilung negativer bleibender Regelabweichung" VALUE 0xC651C Kw_Wu16 65540.00 TimeDeb 0.00 65540.00 FORMAT "%8.2" EXTENDED_LIMITS 0.00 655350.0 /end CHARACTERISTIC
/begin CHARACTERISTIC AirCtl_tiDebPlateBrkDef_C "Heilzeit für Bremse defekt" VALUE 0xC651E Kw_Ws16 65540.00 Time_ms 0.00 65540.00 FORMAT "%8.2" EXTENDED_LIMITS -327680.0 327670.0 /end CHARACTERISTIC
/begin CHARACTERISTIC AirCtl_tiDebPlateBrkOk_C "Heilzeit für Bremse ok" VALUE 0xC6520 Kw_Ws16 65540.00 Time_ms 0.00 65540.00 FORMAT "%8.2" EXTENDED_LIMITS -327680.0 327670.0 /end CHARACTERISTIC
/begin CHARACTERISTIC AirCtl_tidqRawOn_C "Timer für Einspritzungquantitat wechsel" VALUE 0xC6524 Kw_Wu32 655140.000000 Time_s 0.00 655140.000000 FORMAT "%13.6" EXTENDED_LIMITS 0.00 42949672.9500 /end CHARACTERISTIC
/begin CHARACTERISTIC AirCtl_tiEGRDel_C "Zeit die das AGR-Ventil beim Wechsel in den Regenerationsbetrieb eingefroren wird" VALUE 0xC5F78 Kw_Wu16 655.3500 Time_s 0.00 655.3500 FORMAT "%8.4" /end CHARACTERISTIC
/begin CHARACTERISTIC AirCtl_tiLiEGR_C "SW-Timer Zeit für Drehzahlkorrektur" VALUE 0xC56D4 Kw_Wu32 21474836.4700 Time_s 0.00 21474836.4700 FORMAT "%13.4" EXTENDED_LIMITS 0.00 42949672.9500 /end CHARACTERISTIC
/begin CHARACTERISTIC AirCtl_tiLoIdl_C "Grenzzeit für Leerlaufabschaltung" VALUE 0xC6528 Kw_Wu32 42949672.9500 Time_s 0.00 42949672.9500 FORMAT "%13.4" /end CHARACTERISTIC
/begin CHARACTERISTIC AirCtl_tiOvrRun_C "Debounce time for OverRun Condition" VALUE 0xC652C Kw_Wu16 600000.0 TimeDeb 0.00 600000.0 FORMAT "%8.1" EXTENDED_LIMITS 0.00 655350.0 /end CHARACTERISTIC
/begin CHARACTERISTIC AirCtl_tiRmpSlpDes_C "Ramplaufzeit fuer Mehrfachumschaltung" VALUE 0xC56D8 Kw_Wu32 40.0000000000 Time_s 0.00 40.0000000000 FORMAT "%13.10" EXTENDED_LIMITS 0.00 42949672.9500 /end CHARACTERISTIC
/begin CHARACTERISTIC AirCtl_tiRmpSlpGov_C "Rampzeit zur Umschaltung zwischen Standard- und Regenerationswert" VALUE 0xC5F7C Kw_Wu32 40.0000000000 Time_s 0.00 40.0000000000 FORMAT "%13.10" EXTENDED_LIMITS 0.00 42949672.9500 /end CHARACTERISTIC
/begin CHARACTERISTIC AirCtl_tiTVADel_C "Zeit die die Drosselklappe beim Wechsel aus dem Regenerationsbetrieb eingefroren wird" VALUE 0xC6310 Kw_Wu16 655.3500 Time_s 0.00 655.3500 FORMAT "%8.4" /end CHARACTERISTIC
/begin CHARACTERISTIC AirCtl_TrmVal_C "ARF-Abgleichwert" VALUE 0xC56DC Kw_Ws16 3000.000 AirMassPerCyl -1500.000 1500.000 FORMAT "%8.3" EXTENDED_LIMITS -3276.800 3276.700 /end CHARACTERISTIC
/begin CHARACTERISTIC AirCtl_drTVA2SlpLimUp_C "Slope limitation for increase of the throttle valve controller  2 variable" VALUE 0xC6530 Kw_Wu32 799999.999814 RmpPrc 0.00 799999.999814 FORMAT "%13.6" /end CHARACTERISTIC
/begin CHARACTERISTIC AirCtl_drTVA2SlpLimDown_C "Slope limitation for decrease of the throttle valve controller  2 variable" VALUE 0xC6534 Kw_Wu32 799999.999814 RmpPrc 0.00 799999.999814 FORMAT "%13.6" /end CHARACTERISTIC
/begin CHARACTERISTIC AirCtl_drTVASlpLimUp_C "Steigungsbegrenzung Anstieg für Stellergröße Drosselklappe" VALUE 0xC6538 Kw_Wu32 799999.999814 RmpPrc 0.00 799999.999814 FORMAT "%13.6" /end CHARACTERISTIC
/begin CHARACTERISTIC AirCtl_drTVASlpLimDown_C "Steigungsbegrenzung Abfall für Stellergröße Drosselklappe" VALUE 0xC653C Kw_Wu32 799999.999814 RmpPrc 0.00 799999.999814 FORMAT "%13.6" /end CHARACTERISTIC
/begin CHARACTERISTIC AirCtl_uBattThres_C "Grenze für Batteriespannungsüberwachung" VALUE 0xC6540 Kw_Ws16 1281232. Volt_Batt -640625.6 640606.1 FORMAT "%8.1" /end CHARACTERISTIC
/begin CHARACTERISTIC AirCtl_vLim_C "threshold for vehicle speed" VALUE 0xC6542 Kw_Ws16 20.00000 Vel 0.00 20.00000 FORMAT "%8.5" EXTENDED_LIMITS -327.6800 327.6700 /end CHARACTERISTIC
/begin CHARACTERISTIC AltCD_swtGenTyp_C "" VALUE 0xC69EC Kw_Wu8 1.000 dez 0.00 1.000 FORMAT "%5.3" EXTENDED_LIMITS 0.00 255.0 /end CHARACTERISTIC
/begin CHARACTERISTIC AltCD_swtLROff_C "maximum load response time to be written to the alternator controller" VALUE 0xC69ED Kw_Wu8 1.000 OneToOne 0.00 1.000 FORMAT "%5.3" EXTENDED_LIMITS 0.00 255.0 /end CHARACTERISTIC
/begin CHARACTERISTIC AltCD_tiDebDefect_C "Fehlerentprellzeit, Kommunikationsfehler - BSD Schnittstelle" VALUE 0xC69EE Kw_Wu16 655350.0 Time_ms 0.00 655350.0 FORMAT "%8.1" /end CHARACTERISTIC
/begin CHARACTERISTIC AltCD_tiDebOk_C "Heilungsentprellzeit, Kommunikationsfehler - BSD Schnittstelle" VALUE 0xC69F0 Kw_Wu16 655350.0 Time_ms 0.00 655350.0 FORMAT "%8.1" /end CHARACTERISTIC
/begin CHARACTERISTIC AltCD_tiLRMax_C "Load Response Time, Maximumwert für SRC" VALUE 0xC69F2 Kw_Wu16 9.000000 Time_s 0.00 9.000000 FORMAT "%8.6" EXTENDED_LIMITS 0.00 655.3500 /end CHARACTERISTIC
/begin CHARACTERISTIC AltCD_tiLRMin_C "Load Response Time, Mimimumwert für SRC" VALUE 0xC69F4 Kw_Wu16 9.000000 Time_s 0.00 9.000000 FORMAT "%8.6" EXTENDED_LIMITS 0.00 655.3500 /end CHARACTERISTIC
/begin CHARACTERISTIC AltCD_tiOutput_C "Zeit zwischen 2 Ausgaben zum Generator mit BSD Schnittstelle" VALUE 0xC69F6 Kw_Wu16 480.0000 Time_ms 20.00000 500.0000 FORMAT "%8.4" EXTENDED_LIMITS 0.00 655350.0 /end CHARACTERISTIC
/begin CHARACTERISTIC AltCD_tiReset_C "Regenerierzeit der BSD Schnittstelle nach einem Kommunikationsfehler mit dem Generator" VALUE 0xC69F8 Kw_Wu16 1980.000 Time_ms 20.00000 2000.000 FORMAT "%8.3" EXTENDED_LIMITS 0.00 655350.0 /end CHARACTERISTIC
/begin CHARACTERISTIC AltCD_uAltMax_C "Maximalwert für Generatorspannungs-Sollwerts" VALUE 0xC69FA Kw_Ws16 6197.458 Volt_Batt 10694.04 16891.50 FORMAT "%8.2" EXTENDED_LIMITS -640625.6 640606.1 /end CHARACTERISTIC
/begin CHARACTERISTIC AltCD_uAltMin_C "Minimalwert für Generatorspannungs-Sollwerts" VALUE 0xC69FC Kw_Ws16 6197.458 Volt_Batt 10694.04 16891.50 FORMAT "%8.2" EXTENDED_LIMITS -640625.6 640606.1 /end CHARACTERISTIC
/begin CHARACTERISTIC Alt_facTrans_C "Faktor fuer Kennlinieneingang Berechnung Leistungsbedarf" VALUE 0xC69D8 Kw_Ws16 5.461182 Fact2 0.00 5.461182 FORMAT "%8.6" EXTENDED_LIMITS -2.000000 1.999939 /end CHARACTERISTIC
/begin CHARACTERISTIC Alt_pwrBas_CUR "Kennlinie Leistungsbedarfberechnung" CURVE 0xC69DA Kl_Xs16_Ws16 300000.1 Pwr 0.00 300000.1 FORMAT "%8.1" EXTENDED_LIMITS -308831.1 308821.7
 /begin AXIS_DESCR STD_AXIS Alt_n_mp EngN 2 0.00 32767.00 FORMAT "%8.2" EXTENDED_LIMITS -32768.00 32767.00 DEPOSIT ABSOLUTE /end AXIS_DESCR
/end CHARACTERISTIC
/begin CHARACTERISTIC Alt_pwrDes_Vector "#SSD Bypass Label, nicht ändern!" VALUE 0xC2D38 Kw_Wu8 255.0 OneToOne 0.00 255.0 FORMAT "%5.1" /end CHARACTERISTIC
/begin CHARACTERISTIC Alt_pwrDes_Channel "#SSD Bypass Label, nicht ändern!" VALUE 0xC2D39 Kw_Wu8 255.0 OneToOne 0.00 255.0 FORMAT "%5.1" /end CHARACTERISTIC
/begin CHARACTERISTIC Alt_pwrOffs_C "Offset fuer Leistungsbedarf Generator" VALUE 0xC69E4 Kw_Ws16 300000.1 Pwr 0.00 300000.1 FORMAT "%8.1" EXTENDED_LIMITS -308831.1 308821.7 /end CHARACTERISTIC
/begin CHARACTERISTIC Alt_rAdjValDef_C "Standardwert für Abgleich Leistungsanforderung Generator" VALUE 0xC69E6 Kw_Ws16 0.00 Fact 1.000000 1.000000 FORMAT "%8.6" EXTENDED_LIMITS -4.000000 3.999878 /end CHARACTERISTIC
/begin CHARACTERISTIC Alt_rAdjValMax_C "Maximalwert für Abgleich Leistungsanforderung Generator" VALUE 0xC69E8 Kw_Ws16 3.199951 Fact 0.00 3.199951 FORMAT "%8.6" EXTENDED_LIMITS -4.000000 3.999878 /end CHARACTERISTIC
/begin CHARACTERISTIC Alt_rAdjValMin_C "Minimalwert für Abgleich Leistungsanforderung Generator" VALUE 0xC69EA Kw_Ws16 3.199951 Fact 0.00 3.199951 FORMAT "%8.6" EXTENDED_LIMITS -4.000000 3.999878 /end CHARACTERISTIC
/begin CHARACTERISTIC AOHtCD_tiDebAOHtDia1Def_C "Fehlerentprellzeit für Kühlwasserheizungs Diagnose erstes Zeitfenster" VALUE 0xC6A1E Kw_Wu16 655350.0 Time_ms 0.00 655350.0 FORMAT "%8.1" /end CHARACTERISTIC
/begin CHARACTERISTIC AOHtCD_tiDebAOHtDia1Ok_C "Fehlerheilzeit für Kühlwasserheizungs Diagnose erstes Zeitfenster" VALUE 0xC6A20 Kw_Wu16 655350.0 Time_ms 0.00 655350.0 FORMAT "%8.1" /end CHARACTERISTIC
/begin CHARACTERISTIC AOHtCD_tiDebAOHtDia2Def_C "Fehlerentprellzeit für Kühlwasserheizungs Diagnose zweites Zeitfenster" VALUE 0xC6A22 Kw_Wu16 655350.0 Time_ms 0.00 655350.0 FORMAT "%8.1" /end CHARACTERISTIC
/begin CHARACTERISTIC AOHtCD_tiDebAOHtDia2Ok_C "Fehlerheilzeit für Kühlwasserheizungs Diagnose zweites Zeitfenster" VALUE 0xC6A24 Kw_Wu16 655350.0 Time_ms 0.00 655350.0 FORMAT "%8.1" /end CHARACTERISTIC
/begin CHARACTERISTIC AOHtCD_tiDebAOHtDia3Def_C "Fehlerentprellzeit für Kühlwasserheizungs Diagnose drittes Zeitfenster" VALUE 0xC6A26 Kw_Wu16 655350.0 Time_ms 0.00 655350.0 FORMAT "%8.1" /end CHARACTERISTIC
/begin CHARACTERISTIC AOHtCD_tiDebAOHtDia3Ok_C "Fehlerheilzeit für Kühlwasserheizungs Diagnose drittes Zeitfenster" VALUE 0xC6A28 Kw_Wu16 655350.0 Time_ms 0.00 655350.0 FORMAT "%8.1" /end CHARACTERISTIC
/begin CHARACTERISTIC AOHtCD_tiDebExcTempDef_C "Fehlerentprellzeit, Übertemperaturfehler" VALUE 0xC6A2A Kw_Wu16 655350.0 Time_ms 0.00 655350.0 FORMAT "%8.1" /end CHARACTERISTIC
/begin CHARACTERISTIC AOHtCD_tiDebExcTempOk_C "Heilungsentprellzeit, Übertemperaturfehler" VALUE 0xC6A2C Kw_Wu16 655350.0 Time_ms 0.00 655350.0 FORMAT "%8.1" /end CHARACTERISTIC
/begin CHARACTERISTIC AOHtCD_tiDebNoLoadDef_C "Fehlerentprellzeit, Lastabfall" VALUE 0xC6A2E Kw_Wu16 655350.0 Time_ms 0.00 655350.0 FORMAT "%8.1" /end CHARACTERISTIC
/begin CHARACTERISTIC AOHtCD_tiDebNoLoadOk_C "Heilungsentprellzeit, Lastabfall" VALUE 0xC6A30 Kw_Wu16 655350.0 Time_ms 0.00 655350.0 FORMAT "%8.1" /end CHARACTERISTIC
/begin CHARACTERISTIC AOHtCD_tiDebPos_C "Entprellzeit für positive Flanke Eingangssignal 'Zuheizer Aus'" VALUE 0xC6A32 Kw_Wu16 2000.000 TimeDeb 0.00 2000.000 FORMAT "%8.3" EXTENDED_LIMITS 0.00 655350.0 /end CHARACTERISTIC
/begin CHARACTERISTIC AOHtCD_tiDebNeg_C "Entprellzeit für negative Flanke Eingangssignal 'Zuheizer Aus'" VALUE 0xC6A34 Kw_Wu16 2000.000 TimeDeb 0.00 2000.000 FORMAT "%8.3" EXTENDED_LIMITS 0.00 655350.0 /end CHARACTERISTIC
/begin CHARACTERISTIC AOHtCD_tiDebShortCircBatDef_C "Fehlerentprellzeit, Kurzschluß Batterie" VALUE 0xC6A36 Kw_Wu16 655350.0 Time_ms 0.00 655350.0 FORMAT "%8.1" /end CHARACTERISTIC
/begin CHARACTERISTIC AOHtCD_tiDebShortCircBatOk_C "Heilungsentprellzeit, Kurzschluß Batterie" VALUE 0xC6A38 Kw_Wu16 655350.0 Time_ms 0.00 655350.0 FORMAT "%8.1" /end CHARACTERISTIC
/begin CHARACTERISTIC AOHtCD_tiDebShortCircGndDef_C "Fehlerentprellzeit, Kurzschluß nach Masse" VALUE 0xC6A3A Kw_Wu16 655350.0 Time_ms 0.00 655350.0 FORMAT "%8.1" /end CHARACTERISTIC
/begin CHARACTERISTIC AOHtCD_tiDebShortCircGndOk_C "Heilungsentprellzeit, Kurzschluß nach Masse" VALUE 0xC6A3C Kw_Wu16 655350.0 Time_ms 0.00 655350.0 FORMAT "%8.1" /end CHARACTERISTIC
/begin CHARACTERISTIC AOHtCD_numDia_C "#SSD Parameter für Hardware Diagnose-Pin Auswahl" VALUE 0xC6A3E Kw_Wu8 34.0000000000 NumPinDia 0.00 34.0000000000 FORMAT "%13.10" /end CHARACTERISTIC
/begin CHARACTERISTIC AOHtCD_numDioIn_C "#SSD Applikationsparameter fuer hardware-Pin Auswahl Eingangssignal 'Zuheizer Aus'" VALUE 0xC6A3F Kw_Wu8 14.0000000000 NumPinDioIn 0.00 14.0000000000 FORMAT "%13.10" /end CHARACTERISTIC
/begin CHARACTERISTIC AOHtCD_numPwmOut_C "#SSD Parameter für Hardware Endstufen-Pin Auswahl" VALUE 0xC6A40 Kw_Wu8 12.0000000000 NumPinPwmOut 0.00 12.0000000000 FORMAT "%13.10" /end CHARACTERISTIC
/begin CHARACTERISTIC AOHtCD_stInvOut_C "Invertierungsparameter der PWM-Endstufe" VALUE 0xC6A42 Kw_Wu8 1.000 OneToOne 0.00 1.000 FORMAT "%5.3" EXTENDED_LIMITS 0.00 255.0 /end CHARACTERISTIC
/begin CHARACTERISTIC AOHtCD_tiPer_C "Periodendauer der PWM-Endstufe" VALUE 0xC6A44 Kw_Ws16 6553.500 Period -3276.800 3276.700 FORMAT "%8.3" /end CHARACTERISTIC
/begin CHARACTERISTIC AOHtCD_rOutMax_C "Maximum-Wert, Ausgangstastverhältnis" VALUE 0xC6A46 Kw_Ws16 655.3500 DtyCyc -327.6800 327.6700 FORMAT "%8.4" /end CHARACTERISTIC
/begin CHARACTERISTIC AOHtCD_rOutMin_C "Minimumwert des Ausgangstastverhältnisses" VALUE 0xC6A48 Kw_Ws16 655.3500 DtyCyc -327.6800 327.6700 FORMAT "%8.4" /end CHARACTERISTIC
/begin CHARACTERISTIC AOHtCD_rTst_C "Tastverhältnis das im Fehlerfall ausgegeben wird" VALUE 0xC6A4A Kw_Ws16 100.0000 DtyCyc 0.00 100.0000 FORMAT "%8.4" EXTENDED_LIMITS -327.6800 327.6700 /end CHARACTERISTIC
/begin CHARACTERISTIC AOHtCD_stPwrStgActv_C "Statuswort zur Aktivierung der Abschaltbedingung für die Zuheizer Endstufe" VALUE 0xC6A4C Kw_Wu8 255.0 OneToOne 0.00 255.0 FORMAT "%5.1" /end CHARACTERISTIC
/begin CHARACTERISTIC AOHtCD_stPwrStgDia_C "Statuswort zur Aktivierung der Abschaltbedingung der Endstufendiagnose für Zuheizer1" VALUE 0xC6A4D Kw_Wu8 255.0 OneToOne 0.00 255.0 FORMAT "%5.1" /end CHARACTERISTIC
/begin CHARACTERISTIC AOHtCD_swtBattCorr_C "Zuschaltung der Batteriespannungskorrektur" VALUE 0xC6A4E Kw_Wu8 255.0 OneToOne 0.00 255.0 FORMAT "%5.1" /end CHARACTERISTIC
/begin CHARACTERISTIC AOHtCD_swtInv_C "Invertierungsparamter des Digitaleingangs (Heizleistungsanforderung)" VALUE 0xC6A4F Kw_Wu8 1.000 OneToOne 0.00 1.000 FORMAT "%5.3" EXTENDED_LIMITS 0.00 255.0 /end CHARACTERISTIC
/begin CHARACTERISTIC AOHtCD_tiBtwTst_C "Zeitabstand, in dem die Endstufe im Fehlerfall getestet wird" VALUE 0xC6A50 Kw_Wu16 29980.00 Time_ms 20.00000 30000.00 FORMAT "%8.2" EXTENDED_LIMITS 0.00 655350.0 /end CHARACTERISTIC
/begin CHARACTERISTIC AOHtCD_tiDiag1Max_C "Maximum des ersten Signalfensters für Fehlersignale des Kühlwasserheizung-SG" VALUE 0xC6A52 Kw_Wu16 655350.0 Time_ms 0.00 655350.0 FORMAT "%8.1" /end CHARACTERISTIC
/begin CHARACTERISTIC AOHtCD_tiDiag1Min_C "Minimum des ersten Signalfensters für Fehlersignale des Kühlwasserheizung-SG" VALUE 0xC6A54 Kw_Wu16 655350.0 Time_ms 0.00 655350.0 FORMAT "%8.1" /end CHARACTERISTIC
/begin CHARACTERISTIC AOHtCD_tiDiag2Max_C "Maximum des zweiten Signalfensters für Fehlersignale des Kühlwasserheizung-SG" VALUE 0xC6A56 Kw_Wu16 655350.0 Time_ms 0.00 655350.0 FORMAT "%8.1" /end CHARACTERISTIC
/begin CHARACTERISTIC AOHtCD_tiDiag2Min_C "Minimum des zweiten Signalfensters für Fehlersignale des Kühlwasserheizung-SG" VALUE 0xC6A58 Kw_Wu16 655350.0 Time_ms 0.00 655350.0 FORMAT "%8.1" /end CHARACTERISTIC
/begin CHARACTERISTIC AOHtCD_tiDiag3Max_C "Maximum des dritten Signalfensters für Fehlersignale des Kühlwasserheizung-SG" VALUE 0xC6A5A Kw_Wu16 655350.0 Time_ms 0.00 655350.0 FORMAT "%8.1" /end CHARACTERISTIC
/begin CHARACTERISTIC AOHtCD_tiDiag3Min_C "Minimum des dritten Signalfensters für Fehlersignale des Kühlwasserheizung-SG" VALUE 0xC6A5C Kw_Wu16 655350.0 Time_ms 0.00 655350.0 FORMAT "%8.1" /end CHARACTERISTIC
/begin CHARACTERISTIC AOHt_nACEngXHigh_C "oberer Grenzwert für Motordrehzahl" VALUE 0xC69FE Kw_Ws16 6000.000 EngN 0.00 6000.000 FORMAT "%8.3" EXTENDED_LIMITS -32768.00 32767.00 /end CHARACTERISTIC
/begin CHARACTERISTIC AOHt_nACEngXLow_C "unterer Grenzwert für Motordrehzahl" VALUE 0xC6A00 Kw_Ws16 6000.000 EngN 0.00 6000.000 FORMAT "%8.3" EXTENDED_LIMITS -32768.00 32767.00 /end CHARACTERISTIC
/begin CHARACTERISTIC AOHt_nDAEng_C "Engine speed threshold for drive away condition" VALUE 0xC6A02 Kw_Ws16 6000.000 EngN 0.00 6000.000 FORMAT "%8.3" EXTENDED_LIMITS -32768.00 32767.00 /end CHARACTERISTIC
/begin CHARACTERISTIC AOHt_nMin_C "#SSD Leerlaufanhebung bei Zuheizung" VALUE 0xC6A04 Kw_Ws16 500.0000 EngN 0.00 500.0000 FORMAT "%8.4" EXTENDED_LIMITS -32768.00 32767.00 /end CHARACTERISTIC
/begin CHARACTERISTIC AOHt_rHtgOut_Vector "#SSD Bypass label for additive bypass of AOHt_rHtgOut" VALUE 0xC2D3A Kw_Wu8 255.0 OneToOne 0.00 255.0 FORMAT "%5.1" /end CHARACTERISTIC
/begin CHARACTERISTIC AOHt_rHtgOut_Channel "#SSD Bypass label for additive bypass of AOHt_rHtgOut" VALUE 0xC2D3B Kw_Wu8 255.0 OneToOne 0.00 255.0 FORMAT "%5.1" /end CHARACTERISTIC
/begin CHARACTERISTIC AOHt_swtHtgUp_C "switch to change heating-up state of engine" VALUE 0xC6A06 Kw_Wu8 2.000 OneToOne 0.00 2.000 FORMAT "%5.3" EXTENDED_LIMITS 0.00 255.0 /end CHARACTERISTIC
/begin CHARACTERISTIC AOHt_tEnvHysDelta_C "Delta-Wert für Kühlmitteltemperaturhysterese" VALUE 0xC6A08 Kw_Ws16 100.0000 TempDiff_Cels 0.00 100.0000 FORMAT "%8.4" EXTENDED_LIMITS -3276.800 3276.700 /end CHARACTERISTIC
/begin CHARACTERISTIC AOHt_tEnv_CUR "Umgebungstemperatur Umrechnungskennlinie" CURVE 0xC6A0A Kl_Xs16_Ws16 250.0000 Temp_Cels -50.1400 199.8600 FORMAT "%8.4" EXTENDED_LIMITS -3549.940 3003.560
 /begin AXIS_DESCR STD_AXIS FrmMng_tEnv Temp_Cels 2 -50.1400 199.8600 FORMAT "%8.4" EXTENDED_LIMITS -3549.940 3003.560 DEPOSIT ABSOLUTE /end AXIS_DESCR
/end CHARACTERISTIC
/begin CHARACTERISTIC AOHt_tiACMin_C "Timer für den Beschleunigungs-Fall" VALUE 0xC6A14 Kw_Wu16 60000.00 Time_ms 0.00 60000.00 FORMAT "%8.2" EXTENDED_LIMITS 0.00 655350.0 /end CHARACTERISTIC
/begin CHARACTERISTIC AOHt_tiDAMin_C "Timer im Wegfahr-Fall" VALUE 0xC6A16 Kw_Wu16 60000.00 Time_ms 0.00 60000.00 FORMAT "%8.2" EXTENDED_LIMITS 0.00 655350.0 /end CHARACTERISTIC
/begin CHARACTERISTIC AOHt_tiStrt_C "Startverzoegerung fuer die Heizleistungssteigerung" VALUE 0xC6A18 Kw_Wu16 2000.000 Time_ms 0.00 2000.000 FORMAT "%8.3" EXTENDED_LIMITS 0.00 655350.0 /end CHARACTERISTIC
/begin CHARACTERISTIC AOHt_trqInrLimDelta_C "Delta Torque" VALUE 0xC6A1A Kw_Ws16 1500.000 Trq -500.0000 1000.000 FORMAT "%8.3" EXTENDED_LIMITS -3276.800 3276.700 /end CHARACTERISTIC
/begin CHARACTERISTIC AOHt_vDAVeh_C "Vehicle speed threshold for drive away condition" VALUE 0xC6A1C Kw_Ws16 300.0000 Vel 0.00 300.0000 FORMAT "%8.4" EXTENDED_LIMITS -327.6800 327.6700 /end CHARACTERISTIC
/begin CHARACTERISTIC APPCD_uAPP1_SRCMin_C "#SSD Spannung SRC-low" VALUE 0xC6A60 Kw_Ws16 5200.391 Volt 0.00 5200.391 FORMAT "%8.3" EXTENDED_LIMITS -160156.4 160151.5 /end CHARACTERISTIC
/begin CHARACTERISTIC APPCD_uAPP1_SRCMax_C "#SSD Spannung SRC-high" VALUE 0xC6A62 Kw_Ws16 5200.391 Volt 0.00 5200.391 FORMAT "%8.3" EXTENDED_LIMITS -160156.4 160151.5 /end CHARACTERISTIC
/begin CHARACTERISTIC APPCD_rLinAPP1_CUR "#SSD Linerisierungs-Kennlinie APP1" CURVE 0xC6A64 Kl_Xs16_Ws16 100.0000 Prc 0.00 100.0000 FORMAT "%8.4" EXTENDED_LIMITS -400.0000 399.9878
 /begin AXIS_DESCR STD_AXIS APPCD_uRawAPP1 Volt 2 0.00 5200.391 FORMAT "%8.3" EXTENDED_LIMITS -160156.4 160151.5 DEPOSIT ABSOLUTE /end AXIS_DESCR
/end CHARACTERISTIC
/begin CHARACTERISTIC APPCD_uAPP2_SRCMin_C "#SSD Spannung SRC-low" VALUE 0xC6A6E Kw_Ws16 5200.391 Volt 0.00 5200.391 FORMAT "%8.3" EXTENDED_LIMITS -160156.4 160151.5 /end CHARACTERISTIC
/begin CHARACTERISTIC APPCD_uAPP2_SRCMax_C "#SSD Spannung SRC-high" VALUE 0xC6A70 Kw_Ws16 5200.391 Volt 0.00 5200.391 FORMAT "%8.3" EXTENDED_LIMITS -160156.4 160151.5 /end CHARACTERISTIC
/begin CHARACTERISTIC APPCD_rLinAPP2_CUR "#SSD Linerisierungs-Kennlinie APP2" CURVE 0xC6A72 Kl_Xs16_Ws16 100.0000 Prc 0.00 100.0000 FORMAT "%8.4" EXTENDED_LIMITS -400.0000 399.9878
 /begin AXIS_DESCR STD_AXIS APPCD_uRawAPP2 Volt 2 0.00 2600.196 FORMAT "%8.3" EXTENDED_LIMITS -160156.4 160151.5 DEPOSIT ABSOLUTE /end AXIS_DESCR
/end CHARACTERISTIC
/begin CHARACTERISTIC APPCD_DebPlaDef_C "#SSD Defektzeit Plausibilitätsfehler" VALUE 0xC6A7C Kw_Wu16 655350.0 Time_ms 0.00 655350.0 FORMAT "%8.1" /end CHARACTERISTIC
/begin CHARACTERISTIC APPCD_DebPlaOk_C "#SSD Heilungszeit Plausibilitätsfehler" VALUE 0xC6A7E Kw_Wu16 655350.0 Time_ms 0.00 655350.0 FORMAT "%8.1" /end CHARACTERISTIC
/begin CHARACTERISTIC APPCD_DebSRCHighDef_C "#SSD Defektzeit SRC-high" VALUE 0xC6A80 Kw_Wu16 655350.0 Time_ms 0.00 655350.0 FORMAT "%8.1" /end CHARACTERISTIC
/begin CHARACTERISTIC APPCD_DebSRCHighOk_C "#SSD Heilungszeit SRC-high" VALUE 0xC6A82 Kw_Wu16 655350.0 Time_ms 0.00 655350.0 FORMAT "%8.1" /end CHARACTERISTIC
/begin CHARACTERISTIC APPCD_DebSRCLowDef_C "#SSD Defektzeit SRC-low" VALUE 0xC6A84 Kw_Wu16 655350.0 Time_ms 0.00 655350.0 FORMAT "%8.1" /end CHARACTERISTIC
/begin CHARACTERISTIC APPCD_DebSRCLowOk_C "#SSD Heilungszeit SRC-low" VALUE 0xC6A86 Kw_Wu16 655350.0 Time_ms 0.00 655350.0 FORMAT "%8.1" /end CHARACTERISTIC
/begin CHARACTERISTIC APPCD_rThrFltFDCLowPos_C "upper threshold for filter parameter ""low_pos""" VALUE 0xC6A88 Kw_Ws16 100.0000 Prc 0.00 100.0000 FORMAT "%8.4" EXTENDED_LIMITS -400.0000 399.9878 /end CHARACTERISTIC
/begin CHARACTERISTIC APPCD_rThrFltFDCMidPos_C "upper threshold for filter parameter ""mid_neg""" VALUE 0xC6A8A Kw_Ws16 100.0000 Prc 0.00 100.0000 FORMAT "%8.4" EXTENDED_LIMITS -400.0000 399.9878 /end CHARACTERISTIC
/begin CHARACTERISTIC APPCD_rThrFltFDCLowNeg_C "upper threshold for filter parameter ""low_neg""" VALUE 0xC6A8C Kw_Ws16 100.0000 Prc 0.00 100.0000 FORMAT "%8.4" EXTENDED_LIMITS -400.0000 399.9878 /end CHARACTERISTIC
/begin CHARACTERISTIC APPCD_rThrFltFDCMidNeg_C "upper threshold for filter parameter ""mid_neg""" VALUE 0xC6A8E Kw_Ws16 100.0000 Prc 0.00 100.0000 FORMAT "%8.4" EXTENDED_LIMITS -400.0000 399.9878 /end CHARACTERISTIC
/begin CHARACTERISTIC APPCD_tiLowNegFDCPT1_C "APP filter time constant neg. slope low range" VALUE 0xC6A90 Kw_Wu32 4294.9673 TimeDelay_s 0.0000010000000 4294.9673 FORMAT "%9.4" /end CHARACTERISTIC
/begin CHARACTERISTIC APPCD_tiLowNegPT1_C "Filterzeit low position, neg. Steig" VALUE 0xC6A94 Kw_Wu32 4294.9673 TimeDelay_s 0.0000010000000 4294.9673 FORMAT "%9.4" /end CHARACTERISTIC
/begin CHARACTERISTIC APPCD_tiLowPosFDCPT1_C "APP filter time constant pos. slope low range" VALUE 0xC6A98 Kw_Wu32 4294.9673 TimeDelay_s 0.0000010000000 4294.9673 FORMAT "%9.4" /end CHARACTERISTIC
/begin CHARACTERISTIC APPCD_tiLowPosPT1_C "Filterzeit low position, pos. Steig." VALUE 0xC6A9C Kw_Wu32 4294.9673 TimeDelay_s 0.0000010000000 4294.9673 FORMAT "%9.4" /end CHARACTERISTIC
/begin CHARACTERISTIC APPCD_tiMidNegFDCPT1_C "APP filter time constant neg. slope mid. range" VALUE 0xC6AA0 Kw_Wu32 4294.9673 TimeDelay_s 0.0000010000000 4294.9673 FORMAT "%9.4" /end CHARACTERISTIC
/begin CHARACTERISTIC APPCD_tiMidNegPT1_C "Filterzeit mid. position, neg. Steig." VALUE 0xC6AA4 Kw_Wu32 4294.9673 TimeDelay_s 0.0000010000000 4294.9673 FORMAT "%9.4" /end CHARACTERISTIC
/begin CHARACTERISTIC APPCD_tiMidPosFDCPT1_C "APP filter time constant pos. slope mid. range" VALUE 0xC6AA8 Kw_Wu32 4294.9673 TimeDelay_s 0.0000010000000 4294.9673 FORMAT "%9.4" /end CHARACTERISTIC
/begin CHARACTERISTIC APPCD_tiMidPosPT1_C "Filterzeit mid. position, pos. Steig." VALUE 0xC6AAC Kw_Wu32 4294.9673 TimeDelay_s 0.0000010000000 4294.9673 FORMAT "%9.4" /end CHARACTERISTIC
/begin CHARACTERISTIC APPCD_tiUppNegFDCPT1_C "APP filter time constant neg. slope upp. range" VALUE 0xC6AB0 Kw_Wu32 4294.9673 TimeDelay_s 0.0000010000000 4294.9673 FORMAT "%9.4" /end CHARACTERISTIC
/begin CHARACTERISTIC APPCD_tiUppNegPT1_C "Filterzeit upper position, neg. Steig." VALUE 0xC6AB4 Kw_Wu32 4294.9673 TimeDelay_s 0.0000010000000 4294.9673 FORMAT "%9.4" /end CHARACTERISTIC
/begin CHARACTERISTIC APPCD_tiUppPosFDCPT1_C "APP filter time constant pos. slope upp. range" VALUE 0xC6AB8 Kw_Wu32 4294.9673 TimeDelay_s 0.0000010000000 4294.9673 FORMAT "%9.4" /end CHARACTERISTIC
/begin CHARACTERISTIC APPCD_tiUppPosPT1_C "Filterzeit upper position, pos. Steig.:" VALUE 0xC6ABC Kw_Wu32 4294.9673 TimeDelay_s 0.0000010000000 4294.9673 FORMAT "%9.4" /end CHARACTERISTIC
/begin CHARACTERISTIC APPCD_swtNoFlt_C "Schalter für Filter AUS bei betätigter Kupplung (0 = Filter ein bei betätigter Kupplung, 1 = Filter aus bei betätigter Kupplung)" VALUE 0xC6AC0 Kw_Wu8 1.000 OneToOne 0.00 1.000 FORMAT "%5.3" EXTENDED_LIMITS 0.00 255.0 /end CHARACTERISTIC
/begin CHARACTERISTIC APPCD_rThrFltLowPos_C "Schwelle Filterzeit low position, pos. Steig." VALUE 0xC6AC2 Kw_Ws16 100.0000 Prc 0.00 100.0000 FORMAT "%8.4" EXTENDED_LIMITS -400.0000 399.9878 /end CHARACTERISTIC
/begin CHARACTERISTIC APPCD_rThrFltMidPos_C "APPSchwelle Filterzeit mid. position, pos. Steig." VALUE 0xC6AC4 Kw_Ws16 100.0000 Prc 0.00 100.0000 FORMAT "%8.4" EXTENDED_LIMITS -400.0000 399.9878 /end CHARACTERISTIC
/begin CHARACTERISTIC APPCD_rThrFltLowNeg_C "Schwelle Filterzeit low position, neg. Steig." VALUE 0xC6AC6 Kw_Ws16 100.0000 Prc 0.00 100.0000 FORMAT "%8.4" EXTENDED_LIMITS -400.0000 399.9878 /end CHARACTERISTIC
/begin CHARACTERISTIC APPCD_rThrFltMidNeg_C "Schwelle Filterzeit mid position, neg. Steig." VALUE 0xC6AC8 Kw_Ws16 100.0000 Prc 0.00 100.0000 FORMAT "%8.4" EXTENDED_LIMITS -400.0000 399.9878 /end CHARACTERISTIC
/begin CHARACTERISTIC APPCD_drHealRmpUp_C "#SSD Heilung pos. Rampe" VALUE 0xC6ACC Kw_Wu32 799999.999814 RmpPrc 0.00 799999.999814 FORMAT "%13.6" /end CHARACTERISTIC
/begin CHARACTERISTIC APPCD_drHealRmpDwn_C "Heilung neg. Rampe" VALUE 0xC6AD0 Kw_Wu32 799999.999814 RmpPrc 0.00 799999.999814 FORMAT "%13.6" READ_ONLY /end CHARACTERISTIC
/begin CHARACTERISTIC APPCD_numAdcAPP1_C "#SSD Applikationsparameter  fuer den Fahrpedal 1 position -Fuehler" VALUE 0xC6AD4 Kw_Wu8 44.0000000000 NumPinAdc 0.00 44.0000000000 FORMAT "%13.10" /end CHARACTERISTIC
/begin CHARACTERISTIC APPCD_numAdcAPP2_C "#SSD Applikationsparameter  fuer den Fahrpedal 2 position -Fuehler" VALUE 0xC6AD5 Kw_Wu8 44.0000000000 NumPinAdc 0.00 44.0000000000 FORMAT "%13.10" /end CHARACTERISTIC
/begin CHARACTERISTIC APPCD_uPlaWinIdle_C "#SSD Plaus.-Window Leerlauf" VALUE 0xC6AD6 Kw_Ws16 5200.391 Volt 0.00 5200.391 FORMAT "%8.3" EXTENDED_LIMITS -160156.4 160151.5 /end CHARACTERISTIC
/begin CHARACTERISTIC APPCD_uPlaWinPar_C "#SSD Plaus.-Window Teillast" VALUE 0xC6AD8 Kw_Ws16 5200.391 Volt 0.00 5200.391 FORMAT "%8.3" EXTENDED_LIMITS -160156.4 160151.5 /end CHARACTERISTIC
/begin CHARACTERISTIC APPCD_uPlaWinFull_C "#SSD Plaus.-Window Vollast" VALUE 0xC6ADA Kw_Ws16 5200.391 Volt 0.00 5200.391 FORMAT "%8.3" EXTENDED_LIMITS -160156.4 160151.5 /end CHARACTERISTIC
/begin CHARACTERISTIC APPCD_rPlaWinLowIdleXHigh_C "#SSD obere Hys.-Schwelle Plaus-Win. (Leerlauf)" VALUE 0xC6ADC Kw_Ws16 100.0000 Prc 0.00 100.0000 FORMAT "%8.4" EXTENDED_LIMITS -400.0000 399.9878 /end CHARACTERISTIC
/begin CHARACTERISTIC APPCD_rPlaWinLowIdleXLow_C "#SSD untere Hys.-Schwelle Plaus-Win. (Leerlauf):" VALUE 0xC6ADE Kw_Ws16 100.0000 Prc 0.00 100.0000 FORMAT "%8.4" EXTENDED_LIMITS -400.0000 399.9878 /end CHARACTERISTIC
/begin CHARACTERISTIC APPCD_rPlaWinParLoadXHigh_C "#SSD obere Hys.-Schwelle Plaus-Win. (Teillast)" VALUE 0xC6AE0 Kw_Ws16 100.0000 Prc 0.00 100.0000 FORMAT "%8.4" EXTENDED_LIMITS -400.0000 399.9878 /end CHARACTERISTIC
/begin CHARACTERISTIC APPCD_rPlaWinParLoadXLow_C "#SSD untere Hys.-Schwelle Plaus-Win. (Teillast)" VALUE 0xC6AE2 Kw_Ws16 100.0000 Prc 0.00 100.0000 FORMAT "%8.4" EXTENDED_LIMITS -400.0000 399.9878 /end CHARACTERISTIC
/begin CHARACTERISTIC APPCD_SSpMonAPP1_C "#SSD Auswahl der Sensor-Versorgungs-Spannung für APP1" VALUE 0xC6AE4 Kw_Wu8 2.000 OneToOne 1.000 3.000 FORMAT "%5.3" EXTENDED_LIMITS 0.00 255.0 /end CHARACTERISTIC
/begin CHARACTERISTIC APPCD_SSpMonAPP2_C "#SSD Auswahl der Sensor-Versorgungs-Spannung für APP2" VALUE 0xC6AE5 Kw_Wu8 2.000 OneToOne 1.000 3.000 FORMAT "%5.3" EXTENDED_LIMITS 0.00 255.0 /end CHARACTERISTIC
/begin CHARACTERISTIC APPCD_stCfgAccPed_C "#SSD Pedalwertgeberkonfiguration (Bit 0: 0 = Potentiometertechnik, 1 = Berührunglose Technik)" VALUE 0xC6AE6 Kw_Wu8 1.000 OneToOne 0.00 1.000 FORMAT "%5.3" EXTENDED_LIMITS 0.00 255.0 /end CHARACTERISTIC
/begin CHARACTERISTIC APPCD_uKickDownHighAPP1_C "#SSD obere Hys.-Kick-Down-Spg.-Schwelle für APP1" VALUE 0xC6AE8 Kw_Ws16 5200.391 Volt 0.00 5200.391 FORMAT "%8.3" EXTENDED_LIMITS -160156.4 160151.5 /end CHARACTERISTIC
/begin CHARACTERISTIC APPCD_uKickDownHighAPP2_C "#SSD obere Hys.-Kick-Down-Spg.-Schwelle für APP2" VALUE 0xC6AEA Kw_Ws16 5200.391 Volt 0.00 5200.391 FORMAT "%8.3" EXTENDED_LIMITS -160156.4 160151.5 /end CHARACTERISTIC
/begin CHARACTERISTIC APPCD_uKickDownLowAPP1_C "#SSD untere Hys.-Kick-Down-Spg.-Schwelle für APP1" VALUE 0xC6AEC Kw_Ws16 5200.391 Volt 0.00 5200.391 FORMAT "%8.3" EXTENDED_LIMITS -160156.4 160151.5 /end CHARACTERISTIC
/begin CHARACTERISTIC APPCD_uKickDownLowAPP2_C "#SSD untere Hys.-Kick-Down-Spg.-Schwelle für APP2" VALUE 0xC6AEE Kw_Ws16 5200.391 Volt 0.00 5200.391 FORMAT "%8.3" EXTENDED_LIMITS -160156.4 160151.5 /end CHARACTERISTIC
/begin CHARACTERISTIC APSCD_uSRCMin_C "#SSD Atmosphaerendruckfuehler SRC-Min Fehlerschwelle" VALUE 0xC6AF0 Kw_Ws16 5200.391 Volt 0.00 5200.391 FORMAT "%8.3" EXTENDED_LIMITS -160156.4 160151.5 /end CHARACTERISTIC
/begin CHARACTERISTIC APSCD_uSRCMax_C "#SSD Atmosphaerendruckfuehler SRC-Max Fehlerschwelle" VALUE 0xC6AF2 Kw_Ws16 5200.391 Volt 0.00 5200.391 FORMAT "%8.3" EXTENDED_LIMITS -160156.4 160151.5 /end CHARACTERISTIC
/begin CHARACTERISTIC APSCD_pLin_CUR "#SSD Atmosphaerendruck Liniarisierungskennlinie" CURVE 0xC6AF4 Kl_Xs16_Ws16 3500.000 Pres_hPa 0.00 3500.000 FORMAT "%8.3" EXTENDED_LIMITS -32768.00 32767.00
 /begin AXIS_DESCR STD_AXIS APSCD_uRaw Volt 2 0.00 5000.000 FORMAT "%8.3" EXTENDED_LIMITS -160156.4 160151.5 DEPOSIT ABSOLUTE /end AXIS_DESCR
/end CHARACTERISTIC
/begin CHARACTERISTIC APSCD_DebNplDef_C "Defektentprellung zur Plausibilitaetsfehler Erkennung ( zur Zeit nicht applizierbar )" VALUE 0xC6AFE Kw_Wu16 65535.00 OneToOne 0.00 65535.00 FORMAT "%8.2" /end CHARACTERISTIC
/begin CHARACTERISTIC APSCD_DebNplOk_C "Heilungsentprellung fuer Plausibilitaetsfehler ( zur Zeit nicht applizierbar )" VALUE 0xC6B00 Kw_Wu16 65535.00 OneToOne 0.00 65535.00 FORMAT "%8.2" /end CHARACTERISTIC
/begin CHARACTERISTIC APSCD_DebSigDef_C "Entprellzeit defekt für ungültiges CAN-Signal für Atmosphärendruck" VALUE 0xC6B02 Kw_Wu16 655350.0 Time_ms 0.00 655350.0 FORMAT "%8.1" /end CHARACTERISTIC
/begin CHARACTERISTIC APSCD_DebSigOk_C "Heilungsentprellzeit für ungültiges CAN-Signal Atmosphärendruck" VALUE 0xC6B04 Kw_Wu16 655350.0 Time_ms 0.00 655350.0 FORMAT "%8.1" /end CHARACTERISTIC
/begin CHARACTERISTIC APSCD_DebSRCDef_C "Entprellzeit fuer SRC Defektzeit" VALUE 0xC6B06 Kw_Wu16 655350.0 Time_ms 0.00 655350.0 FORMAT "%8.1" /end CHARACTERISTIC
/begin CHARACTERISTIC APSCD_DebSRCOk_C "Entprellzeit fuer SRC-Heilzeit" VALUE 0xC6B08 Kw_Wu16 655350.0 Time_ms 0.00 655350.0 FORMAT "%8.1" /end CHARACTERISTIC
/begin CHARACTERISTIC APSCD_nLimHigh_C "obere Drehzahlgrenze zur Berechnung des Luftdrucks aus dem Ladedruck" VALUE 0xC6B0A Kw_Ws16 6000.000 EngN 0.00 6000.000 FORMAT "%8.3" EXTENDED_LIMITS -32768.00 32767.00 /end CHARACTERISTIC
/begin CHARACTERISTIC APSCD_numAdc_C "#SSD Applikationsparameter fuer Atmosphaerdruck-Fuehler" VALUE 0xC6B0C Kw_Wu8 44.0000000000 NumPinAdc 0.00 44.0000000000 FORMAT "%13.10" /end CHARACTERISTIC
/begin CHARACTERISTIC APSCD_pCor_MAP "Atmosphaerendruck Korrekturkennfeld (Drehzahlabhaengig)" MAP 0xC6B0E Kf_Xs16_Ys16_Ws16 3850.000 Pres_hPa -350.0000 3500.000 FORMAT "%8.3" EXTENDED_LIMITS -32768.00 32767.00
 /begin AXIS_DESCR STD_AXIS Eng_nAvrg EngN 1 0.00 6000.000 FORMAT "%8.3" EXTENDED_LIMITS -32768.00 32767.00 DEPOSIT ABSOLUTE /end AXIS_DESCR
 /begin AXIS_DESCR STD_AXIS Eng_dnAvrg dn_dZ20 1 -6000.000 6000.000 FORMAT "%8.3" EXTENDED_LIMITS -327680.0 327670.0 DEPOSIT ABSOLUTE /end AXIS_DESCR
/end CHARACTERISTIC
/begin CHARACTERISTIC APSCD_dpRmpSlpUp_C "positive Atmosphaerendruck - Rampensteigung" VALUE 0xC6B18 Kw_Wu32 65535949.9817 RmpPres_hPa 50.0030517578 65535999.9847 FORMAT "%13.4" EXTENDED_LIMITS 0.00 65535999.9847 /end CHARACTERISTIC
/begin CHARACTERISTIC APSCD_dpRmpSlpDwn_C "negative Atmosphaerendruck - Rampensteigung" VALUE 0xC6B1C Kw_Wu32 65535949.9817 RmpPres_hPa 50.0030517578 65535999.9847 FORMAT "%13.4" EXTENDED_LIMITS 0.00 65535999.9847 /end CHARACTERISTIC
/begin CHARACTERISTIC APSCD_swtInst_C "Atmosphaerendruck Funktionsschalter (verbaut? -  ja/nein)" VALUE 0xC6B20 Kw_Wu8 1.000 OneToOne 0.00 1.000 FORMAT "%5.3" EXTENDED_LIMITS 0.00 255.0 /end CHARACTERISTIC
/begin CHARACTERISTIC APSCD_swtSigVal_C "Schalter zur Umschaltung der Signalquelle ADC/CAN" VALUE 0xC6B21 Kw_Wu8 1.000 OneToOne 0.00 1.000 FORMAT "%5.3" EXTENDED_LIMITS 0.00 255.0 /end CHARACTERISTIC
/begin CHARACTERISTIC APSCD_swtSrcpVal_C "Schalter ob APSCD_pVal aus Ladedruck berechnet wird (1) oder nicht (0)" VALUE 0xC6B22 Kw_Wu8 1.000 OneToOne 0.00 1.000 FORMAT "%5.3" EXTENDED_LIMITS 0.00 255.0 /end CHARACTERISTIC
/begin CHARACTERISTIC APSCD_tiDel_C "Atmosphaerendruck Verzögerungszeit bis Berechnung von Ladedruck beginnt" VALUE 0xC6B24 Kw_Wu16 655350.0 Time_ms 0.00 655350.0 FORMAT "%8.1" /end CHARACTERISTIC
/begin CHARACTERISTIC APSCD_stSensIDWord_C "Atmosphaerendruck Geberkennwort" VALUE 0xC6B26 Kw_Wu16 65535.00 OneToOne 0.00 65535.00 FORMAT "%8.2" /end CHARACTERISTIC
/begin CHARACTERISTIC APSCD_pDfl_C "#SSD Atmosphaerendruck Vorgabewert" VALUE 0xC6B28 Kw_Ws16 3500.000 Pres_hPa 0.00 3500.000 FORMAT "%8.3" EXTENDED_LIMITS -32768.00 32767.00 /end CHARACTERISTIC
/begin MEASUREMENT AFSCD_ddmAirPerTime "Luftmassenstromgradient" SWORD dm_dZ20 1 100 -32768.00 32767.00 FORMAT "%8.2" ECU_ADDRESS 0x7F89B2 /end MEASUREMENT
/begin MEASUREMENT AFSCD_dmAirMsFlt_mp "Luftmassenstrom nach PT1-Filterung" SWORD AirMassPerTime 1 100 -3276.800 3276.700 FORMAT "%8.3" ECU_ADDRESS 0x8FE284 /end MEASUREMENT
/begin MEASUREMENT AFSCD_dmAirNorm "Normalisierte Luftmasse" SWORD AirMassPerTime 1 100 -3276.800 3276.700 FORMAT "%8.3" ECU_ADDRESS 0x7F89B6 /end MEASUREMENT
/begin MEASUREMENT AFSCD_dmAirPerTime "HFM Luftmassenstrom" SWORD AirMassPerTime 1 100 -3276.800 3276.700 FORMAT "%8.3" ECU_ADDRESS 0x7F89B8 /end MEASUREMENT
/begin MEASUREMENT AFSCD_dmAirPerTimeHold "letzter gueltiger Wert der Luftmasse pro Zeiteinheit" SWORD AirMassPerTime 1 100 -3276.800 3276.700 FORMAT "%8.3" ECU_ADDRESS 0x7F89BA /end MEASUREMENT
/begin MEASUREMENT AFSCD_dmAirRawPerTime "Rohwert der Luftmasse vom HFM" SWORD AirMassPerTime 1 100 -3276.800 3276.700 FORMAT "%8.3" ECU_ADDRESS 0x7F89BC /end MEASUREMENT
/begin MEASUREMENT AFSCD_dmAirSens "Luftmassenstrom des Luftmassensensors" SWORD AirMassPerTime 1 100 -3276.800 3276.700 FORMAT "%8.3" ECU_ADDRESS 0x7F89BE /end MEASUREMENT
/begin MEASUREMENT AFSCD_dmAirSensCorr_mp "Korrigierte angesaugte Luftmasse pro Zeit" SWORD AirMassPerTime 1 100 -3276.800 3276.700 FORMAT "%8.3" ECU_ADDRESS 0x8FE2AC /end MEASUREMENT
/begin MEASUREMENT AFSCD_dmAirSensRaw_mp "Value of airmass per unit time before error correction." SWORD AirMassPerTime 1 100 -3276.800 3276.700 FORMAT "%8.3" ECU_ADDRESS 0x8FE2B6 /end MEASUREMENT
/begin MEASUREMENT AFSCD_dmAirSubsVal_mp "Ersatzwert für Luftmassenstrom aus Kennfeld" SWORD AirMassPerTime 1 100 -3276.800 3276.700 FORMAT "%8.3" ECU_ADDRESS 0x8FE2AE /end MEASUREMENT
/begin MEASUREMENT AFSCD_dmIdlAirMs_mp "Luftmassenstrom im Leerlaufbereich" SWORD AirMassPerTime 1 100 -3276.800 3276.700 FORMAT "%8.3" ECU_ADDRESS 0x8FE286 /end MEASUREMENT
/begin MEASUREMENT AFSCD_dmLdAirMs_mp "Luftmassenstrom im Lastbereich" SWORD AirMassPerTime 1 100 -3276.800 3276.700 FORMAT "%8.3" ECU_ADDRESS 0x8FE288 /end MEASUREMENT
/begin MEASUREMENT AFSCD_dpIntValAbsFlt "Gradient zum ladedruck" SWORD RmpPres_hPa 1 100 -500.0000 499.9847 FORMAT "%8.4" ECU_ADDRESS 0x7F89C0 /end MEASUREMENT
/begin MEASUREMENT AFSCD_dpIntValAbs_mp "Zeitlicher Änderungsbetrag des Ladedrucks" SWORD RmpPres_hPa 1 100 -500.0000 499.9847 FORMAT "%8.4" ECU_ADDRESS 0x8FE28A /end MEASUREMENT
/begin MEASUREMENT AFSCD_dqCurrAbsFlt "Gradient der Einspritzmenge" SWORD RmpInjMass 1 100 -5.000000 4.999847 FORMAT "%8.6" ECU_ADDRESS 0x7F89C2 /end MEASUREMENT
/begin MEASUREMENT AFSCD_drWtPenDetFlt_mp "Gefilterte relative Signaländerungsdifferenz zur Wassereintragserkennung" SWORD Rmp_1 1 100 -32.76800 32.76700 FORMAT "%8.5" ECU_ADDRESS 0x8FE28C /end MEASUREMENT
/begin MEASUREMENT AFSCD_drWtPenDet_mp "Relative Signaländerungsdifferenz zur Wassereintragerkennung" SWORD Rmp_1 1 100 -32.76800 32.76700 FORMAT "%8.5" ECU_ADDRESS 0x8FE28E /end MEASUREMENT
/begin MEASUREMENT AFSCD_facCalcIdlAdjVal_mp "Berechneter Luftmassenkorrekturfaktor im Leerlauf" SWORD Fact 1 100 -4.000000 3.999878 FORMAT "%8.6" ECU_ADDRESS 0x8FE290 /end MEASUREMENT
/begin MEASUREMENT AFSCD_facCalcLdAdjVal_mp "Berechneter Luftmassenstrom im Lastbereich" SWORD Fact 1 100 -4.000000 3.999878 FORMAT "%8.6" ECU_ADDRESS 0x8FE292 /end MEASUREMENT
/begin MEASUREMENT AFSCD_facCalcValFlt_mp "Berechneter Luftmassenkorrekturfaktor nach PT1-Filterung" SWORD Fact 1 100 -4.000000 3.999878 FORMAT "%8.6" ECU_ADDRESS 0x8FE294 /end MEASUREMENT
/begin MEASUREMENT AFSCD_facCalcVal_mp "Berechneter Luftmassenkorrekturfaktor" SWORD Fact 1 100 -4.000000 3.999878 FORMAT "%8.6" ECU_ADDRESS 0x8FE296 /end MEASUREMENT
/begin MEASUREMENT AFSCD_facIdlAdjValUnLim_mp "Luftmassenkorrekturfaktor im Leerlauf vor Schrittbegrenzung" SWORD Fact 1 100 -4.000000 3.999878 FORMAT "%8.6" ECU_ADDRESS 0x8FE298 /end MEASUREMENT
/begin MEASUREMENT AFSCD_facIdlAdjVal_mp "Leerlaufkorrekturfaktor der Driftkompensation" SWORD Fact 1 100 -4.000000 3.999878 FORMAT "%8.6" ECU_ADDRESS 0x8FE29A /end MEASUREMENT
/begin MEASUREMENT AFSCD_facLdAdjValUnLim_mp "Luftmassenkorrekturfaktor im Lastbereich vor Schrittbegrenzung" SWORD Fact 1 100 -4.000000 3.999878 FORMAT "%8.6" ECU_ADDRESS 0x8FE29C /end MEASUREMENT
/begin MEASUREMENT AFSCD_facLdAdjVal_mp "Lastkorrekturfaktor der Driftkompensation" SWORD Fact 1 100 -4.000000 3.999878 FORMAT "%8.6" ECU_ADDRESS 0x8FE29E /end MEASUREMENT
/begin MEASUREMENT AFSCD_facPlsCor_mp "Pulsationskorrekturfaktor" SWORD Fact 1 100 -4.000000 3.999878 FORMAT "%8.6" ECU_ADDRESS 0x8FE2B8 /end MEASUREMENT
/begin MEASUREMENT AFSCD_facSwtOnCor_mp "Faktor der Einschaltkorrektur" SWORD Fact 1 100 -4.000000 3.999878 FORMAT "%8.6" ECU_ADDRESS 0x8FE2BA /end MEASUREMENT
/begin MEASUREMENT AFSCD_mAirPerCyl "angesaugte Luftmasse pro Zylinder" SWORD AirMassPerCyl 1 100 -3276.800 3276.700 FORMAT "%8.3" ECU_ADDRESS 0x7F89C4 /end MEASUREMENT
/begin MEASUREMENT AFSCD_mAirPerCylFlt "PT1 gefilterte Luftmasse pro Zylinder" SWORD AirMassPerCyl 1 100 -3276.800 3276.700 FORMAT "%8.3" ECU_ADDRESS 0x7F89CA /end MEASUREMENT
/begin MEASUREMENT AFSCD_mAirPerCyl_mp "Berechnete Luftmasse pro Zylinder" SWORD AirMassPerCyl 1 100 -3276.800 3276.700 FORMAT "%8.3" ECU_ADDRESS 0x8FE2B0 /end MEASUREMENT
/begin MEASUREMENT AFSCD_qAirmThrSRCHiActv_mp "Mengenschwelle zur Unterdrueckung SRC HIGH(HFM5 1ms) Schwelle = f(n)" SWORD InjMass 1 100 -327.6800 327.6700 FORMAT "%8.4" ECU_ADDRESS 0x8FE2BC /end MEASUREMENT
/begin MEASUREMENT AFSCD_qWinLdAdjThresHi_mp "Meßpunkt für den oberen Schwellwert der Einspritzmengen-Fensters im Lastbereich" SWORD InjMass 1 100 -327.6800 327.6700 FORMAT "%8.4" ECU_ADDRESS 0x8FE2A0 /end MEASUREMENT
/begin MEASUREMENT AFSCD_qWinLdAdjThresLo_mp "Meßpunkt für den unteren Schwellwert des Einspritzmengen-Fensters im Lastbereich" SWORD InjMass 1 100 -327.6800 327.6700 FORMAT "%8.4" ECU_ADDRESS 0x8FE2A2 /end MEASUREMENT
/begin MEASUREMENT AFSCD_rAirNorm "Verhältnis von normalisiertem Luftmassenstrom zu Sensorluftmassenstrom" SWORD Fact 1 100 -4.000000 3.999878 FORMAT "%8.6" ECU_ADDRESS 0x7F89CE /end MEASUREMENT
/begin MEASUREMENT AFSCD_stAdjRlsDel_mp "Status der Freigabeverzögerung für Korrekturwertberechnung" UBYTE OneToOne 1 100 0.00 255.0 FORMAT "%5.1" ECU_ADDRESS 0x8FE2A4 /end MEASUREMENT
/begin MEASUREMENT AFSCD_stDebSRCAirm_mp "Meßpunkt um den Wert des SRC vom Luftmassemesser sichtbar zu machen" UBYTE OneToOne 1 100 0.00 255.0 FORMAT "%5.1" ECU_ADDRESS 0x8FE2BE /end MEASUREMENT
/begin MEASUREMENT AFSCD_stDrftComp "Statuswort der Driftkompensation" UBYTE OneToOne 1 100 0.00 255.0 FORMAT "%5.1" ECU_ADDRESS 0x7F8781 /end MEASUREMENT
/begin MEASUREMENT AFSCD_stDrftMonRls "Teilfreigabe der Empfindlichkeitsdriftüberwachung" UBYTE OneToOne 1 100 0.00 255.0 FORMAT "%5.1" ECU_ADDRESS 0x7F8782 /end MEASUREMENT
/begin MEASUREMENT AFSCD_stDrftMonRls_mp "Freigabestatus der Empfindlichkeitsdriftüberwachung" UBYTE OneToOne 1 100 0.00 255.0 FORMAT "%5.1" ECU_ADDRESS 0x8FE2B2 /end MEASUREMENT
/begin MEASUREMENT AFSCD_stEnvCon_mp "Zustand der Umgebungsbedingungen für Freigabe der Korrekturwertberechnung" UBYTE OneToOne 1 100 0.00 255.0 FORMAT "%5.1" ECU_ADDRESS 0x8FE2A5 /end MEASUREMENT
/begin MEASUREMENT AFSCD_stErrAirm "Fehlerstatus des Sensorsignals (HFM6)" UWORD OneToOne 1 100 0.00 65535.00 FORMAT "%8.2" ECU_ADDRESS 0x7F89D2 /end MEASUREMENT
/begin MEASUREMENT AFSCD_stIdlAdjRlsCon_mp "Zustand der Freigabebedingungen für Korrekturwertberechnung im Leerlauf" UBYTE OneToOne 1 100 0.00 255.0 FORMAT "%5.1" ECU_ADDRESS 0x8FE2A6 /end MEASUREMENT
/begin MEASUREMENT AFSCD_stLdAdjRlsCon_mp "Zustand der Freigabebedingungen für Korrekturwertberechnung im Lastbereich" UBYTE OneToOne 1 100 0.00 255.0 FORMAT "%5.1" ECU_ADDRESS 0x8FE2A7 /end MEASUREMENT
/begin MEASUREMENT AFSCD_stOffsTst "Status 'Test beendet' der Plausibilitätsprüfung der Offsetdrift" UBYTE OneToOne 1 100 0.00 255.0 FORMAT "%5.1" ECU_ADDRESS 0x7F8783 /end MEASUREMENT
/begin MEASUREMENT AFSCD_stPlSetyDrftRls_mp "Freigabestatus der Plausibilitätsprüfung der Empfindlichkeitsdrift" UBYTE OneToOne 1 100 0.00 255.0 FORMAT "%5.1" ECU_ADDRESS 0x8FE2B3 /end MEASUREMENT
/begin MEASUREMENT AFSCD_stPlSetyDrft_mp "Freigabestatus der Plausibilitätsprüfung der Empfindlichkeitsdrift" UBYTE OneToOne 1 100 0.00 255.0 FORMAT "%5.1" ECU_ADDRESS 0x8FE2B4 /end MEASUREMENT
/begin MEASUREMENT AFSCD_stRstLoDrftThres_mp "Deaktivierungszustand der minimalen Driftgrenzen" UBYTE OneToOne 1 100 0.00 255.0 FORMAT "%5.1" ECU_ADDRESS 0x8FE2A8 /end MEASUREMENT
/begin MEASUREMENT AFSCD_stSRCHiTstRls_mp "Freigabestatus des SRC High des Sensorsignals" UBYTE OneToOne 1 100 0.00 255.0 FORMAT "%5.1" ECU_ADDRESS 0x8FE2BF /end MEASUREMENT
/begin MEASUREMENT AFSCD_stSRCLoTstRls_mp "Freigabestatus des SRC Low des Sensorsignals" UBYTE OneToOne 1 100 0.00 255.0 FORMAT "%5.1" ECU_ADDRESS 0x8FE2C0 /end MEASUREMENT
/begin MEASUREMENT AFSCD_stWtPenDetDeb_mp "Status der Wassereintragserkennung nach Entprellung" UBYTE OneToOne 1 100 0.00 255.0 FORMAT "%5.1" ECU_ADDRESS 0x8FE2A9 /end MEASUREMENT
/begin MEASUREMENT AFSCD_stWtPenDet_mp "Status der Wassereintragserkennung" UBYTE OneToOne 1 100 0.00 255.0 FORMAT "%5.1" ECU_ADDRESS 0x8FE2AA /end MEASUREMENT
/begin MEASUREMENT AFSCD_swtSensInst "Schalter zur Anzeige, ob der Luftmassensensor vorhanden ist oder nicht" UBYTE OneToOne 1 100 0.00 255.0 FORMAT "%5.1" ECU_ADDRESS 0x7F8785 /end MEASUREMENT
/begin MEASUREMENT AFSCD_tiRaw "Periodendauerrohwert des Luftmassensensors" SWORD Time_PwmHigh 1 100 -3276.800 3276.700 FORMAT "%8.3" ECU_ADDRESS 0x7F89D6 /end MEASUREMENT
/begin MEASUREMENT AFSCD_tiRawAvrgVal_mp "Mittelwert des aktuellen und letzten Periodendauerrohwerts des Luftmassensensors" SWORD Time_PwmHigh 1 100 -3276.800 3276.700 FORMAT "%8.3" ECU_ADDRESS 0x8FE2C2 /end MEASUREMENT
/begin MEASUREMENT AFSCD_tiRawLast "last value of the raw air mass signal" SWORD Time_PwmHigh 1 100 -3276.800 3276.700 FORMAT "%8.3" ECU_ADDRESS 0x7F89D8 /end MEASUREMENT
/begin MEASUREMENT AFSCD_tiSwtOnCor_mp "Timerwert der ""Einschaltkorrektur""" UWORD Time_ms 1 100 0.00 655350.0 FORMAT "%8.1" ECU_ADDRESS 0x8FE2C4 /end MEASUREMENT
/begin MEASUREMENT AFS_dphiStrg1_mp "rate of change of steering angle" SWORD AngleGradPerSec 1 100 -1440.154 1440.110 FORMAT "%8.3" ECU_ADDRESS 0x8FE262 /end MEASUREMENT
/begin MEASUREMENT AFS_dphiStrg2_mp "measuring point for output of DT1 filter" SWORD AngleGradPerSec 1 100 -1440.154 1440.110 FORMAT "%8.3" ECU_ADDRESS 0x8FE264 /end MEASUREMENT
/begin MEASUREMENT AFS_dphiStrg_mp "rate of change of steering angle" SWORD AngleGradPerSec 1 100 -1440.154 1440.110 FORMAT "%8.3" ECU_ADDRESS 0x8FE266 /end MEASUREMENT
/begin MEASUREMENT AFS_pwrDes "Leistungsbedarf des AFS" SWORD Pwr 1 100 -308831.1 308821.7 FORMAT "%8.1" ECU_ADDRESS 0x7F89DA /end MEASUREMENT
/begin MEASUREMENT AFS_pwrLead "Leistungsvorhalt des AFS" SWORD Pwr 1 100 -308831.1 308821.7 FORMAT "%8.1" ECU_ADDRESS 0x7F89DC /end MEASUREMENT
/begin MEASUREMENT AFS_stErrAFS_mp "Error Status of Active Front Steering" UBYTE OneToOne 1 100 0.00 255.0 FORMAT "%5.1" ECU_ADDRESS 0x8FE268 /end MEASUREMENT
/begin MEASUREMENT AFS_stErrStrg_mp "Error status of Steering" UBYTE OneToOne 1 100 0.00 255.0 FORMAT "%5.1" ECU_ADDRESS 0x8FE269 /end MEASUREMENT
/begin MEASUREMENT AFS_stRecAFS "Status für Eigenerkennung AFS" UBYTE OneToOne 1 100 0.00 255.0 FORMAT "%5.1" ECU_ADDRESS 0x7F8786 /end MEASUREMENT
/begin MEASUREMENT AFS_stTrqDISA_mp "Status für Umsetzung der Momentenanforderung AFS" UBYTE OneToOne 1 100 0.00 255.0 FORMAT "%5.1" ECU_ADDRESS 0x8FE26A /end MEASUREMENT
/begin MEASUREMENT AFS_stTrqENA_mp "Status für Umsetzung der Momentenanforderung AFS" UBYTE OneToOne 1 100 0.00 255.0 FORMAT "%5.1" ECU_ADDRESS 0x8FE26B /end MEASUREMENT
/begin MEASUREMENT AFS_stTrqLogic_mp "Zustand für Umsetzung der Momentenanforderung AFS" UWORD OneToOne 1 100 0.00 65535.00 FORMAT "%8.2" ECU_ADDRESS 0x8FE26C /end MEASUREMENT
/begin MEASUREMENT AFS_trqDesLim_mp "AFS Wunschmoment nach Limitierung" SWORD Trq 1 100 -3276.800 3276.700 FORMAT "%8.3" ECU_ADDRESS 0x8FE26E /end MEASUREMENT
/begin MEASUREMENT AFS_trqDes_mp "AFS Moment" SWORD Trq 1 100 -3276.800 3276.700 FORMAT "%8.3" ECU_ADDRESS 0x8FE270 /end MEASUREMENT
/begin MEASUREMENT AFS_trqDisable_mp "AFS Moment im Fehlerfall" SWORD Trq 1 100 -3276.800 3276.700 FORMAT "%8.3" ECU_ADDRESS 0x8FE272 /end MEASUREMENT
/begin MEASUREMENT AFS_trqDyn1_mp "Dynamikanteil des AFS Momentes" SWORD Trq 1 100 -3276.800 3276.700 FORMAT "%8.3" ECU_ADDRESS 0x8FE274 /end MEASUREMENT
/begin MEASUREMENT AFS_trqDyn_mp "Dynamikanteil des AFS Momentes" SWORD Trq 1 100 -3276.800 3276.700 FORMAT "%8.3" ECU_ADDRESS 0x8FE276 /end MEASUREMENT
/begin MEASUREMENT AFS_trqStat_mp "Stationäranteil des AFS Momentes" SWORD Trq 1 100 -3276.800 3276.700 FORMAT "%8.3" ECU_ADDRESS 0x8FE278 /end MEASUREMENT
/begin MEASUREMENT AFS_trqTar_mp "Eingang zum kennfeld" SWORD Trq 1 100 -3276.800 3276.700 FORMAT "%8.3" ECU_ADDRESS 0x8FE27A /end MEASUREMENT
/begin MEASUREMENT AirbCD_st "Abschaltanforderungen für Airbag/Überrollbügel" UBYTE OneToOne 1 100 0.00 255.0 FORMAT "%5.1" ECU_ADDRESS 0x7F8799 /end MEASUREMENT
/begin MEASUREMENT AirCtl_dnAvrg_mp "Drehzahlgradient der gefilterten Drehzahlbeschleunigung gegen Laderpumpen" SWORD dn_dZ20 1 100 -327680.0 327670.0 FORMAT "%8.1" ECU_ADDRESS 0x8FE352 /end MEASUREMENT
/begin MEASUREMENT AirCtl_dnSurgeHigh_mp "Aktuelle obere Grenze für Drehzahlgradienten Hysterese" SWORD dn_dZ20 1 100 -327680.0 327670.0 FORMAT "%8.1" ECU_ADDRESS 0x8FE354 /end MEASUREMENT
/begin MEASUREMENT AirCtl_dnSurgeLow_mp "aktuelle untere Grenze für Drehzahlgradienten Hysterese gegen Laderpumpen" SWORD dn_dZ20 1 100 -327680.0 327670.0 FORMAT "%8.1" ECU_ADDRESS 0x8FE356 /end MEASUREMENT
/begin MEASUREMENT AirCtl_dqRaw_mp "Value after getting filtered(DT1 Filter) for message InjCtl_qRaw" SWORD InjMassPerSec_20ms 1 100 -16384.00 16383.50 FORMAT "%8.2" ECU_ADDRESS 0x8FE358 /end MEASUREMENT
/begin MEASUREMENT AirCtl_facATParAdDKd_mp "Air temperature correction factor for DT1 governor" SWORD Fact1 1 100 -256.0000 255.9922 FORMAT "%8.4" ECU_ADDRESS 0x8FE2F8 /end MEASUREMENT
/begin MEASUREMENT AirCtl_facATParAdIKi_mp "Air temperature correction factor for I" SWORD Fact1 1 100 -256.0000 255.9922 FORMAT "%8.4" ECU_ADDRESS 0x8FE2FA /end MEASUREMENT
/begin MEASUREMENT AirCtl_facATParAdPKp_mp "Air temperature correction factor for P governor" SWORD Fact1 1 100 -256.0000 255.9922 FORMAT "%8.4" ECU_ADDRESS 0x8FE2FC /end MEASUREMENT
/begin MEASUREMENT AirCtl_facNQParAdDKd_mp "Base factor for parameter adaptation of DT1 governor" SWORD Fact1 1 100 -256.0000 255.9922 FORMAT "%8.4" ECU_ADDRESS 0x8FE2FE /end MEASUREMENT
/begin MEASUREMENT AirCtl_facNQParAdIKi_mp "Base factor for parameter adaptation of I governor" SWORD Fact1 1 100 -256.0000 255.9922 FORMAT "%8.4" ECU_ADDRESS 0x8FE300 /end MEASUREMENT
/begin MEASUREMENT AirCtl_facNQParAdPKp_mp "Base factor for parameter adaptation of P governor" SWORD Fact1 1 100 -256.0000 255.9922 FORMAT "%8.4" ECU_ADDRESS 0x8FE302 /end MEASUREMENT
/begin MEASUREMENT AirCtl_facNQParRgnAdDKd_mp "Faktor für Parameteradaption in Abhängigkeit von Drehzahl und Einspritzmenge (D-Teil), im regeneartion modus" SWORD Fact1 1 100 -256.0000 255.9922 FORMAT "%8.4" ECU_ADDRESS 0x8FE304 /end MEASUREMENT
/begin MEASUREMENT AirCtl_facNQParRgnAdIKi_mp "Faktor für Parameteradaption in Abhängigkeit von Drehzahl und Einspritsmenge ( I-Teil ), im Regenerationmodus" SWORD Fact1 1 100 -256.0000 255.9922 FORMAT "%8.4" ECU_ADDRESS 0x8FE306 /end MEASUREMENT
/begin MEASUREMENT AirCtl_facNQParRgnAdPKp_mp "Faktor für Parameteradaption in Abhängigkeit von Drehzahl und Einspritzmenge ( P-Teil )" SWORD Fact1 1 100 -256.0000 255.9922 FORMAT "%8.4" ECU_ADDRESS 0x8FE308 /end MEASUREMENT
/begin MEASUREMENT AirCtl_facParAdDKd_mp "Factor for parameter adaptation of DT1 governor" SWORD Fact1 1 100 -256.0000 255.9922 FORMAT "%8.4" ECU_ADDRESS 0x8FE30A /end MEASUREMENT
/begin MEASUREMENT AirCtl_facParAdIKi_mp "Factor for parameter adaptation of I governor" SWORD Fact1 1 100 -256.0000 255.9922 FORMAT "%8.4" ECU_ADDRESS 0x8FE30C /end MEASUREMENT
/begin MEASUREMENT AirCtl_facParAdPKp_mp "Factor for parameter adaptation of P governor" SWORD Fact1 1 100 -256.0000 255.9922 FORMAT "%8.4" ECU_ADDRESS 0x8FE30E /end MEASUREMENT
/begin MEASUREMENT AirCtl_facParAd_mp "Gesamtfaktor für Parameteradaption für ARF" SWORD Fact1 1 100 -256.0000 255.9922 FORMAT "%8.4" ECU_ADDRESS 0x8FE310 /end MEASUREMENT
/begin MEASUREMENT AirCtl_mDesBas "ststionärer Basissollwert für ARF" SWORD AirMassPerCyl 1 100 -3276.800 3276.700 FORMAT "%8.3" ECU_ADDRESS 0x7F8A40 /end MEASUREMENT
/begin MEASUREMENT AirCtl_mDesBasCor_mp "stationaerer Sollwert mit Kuehlwassertemperaturkorrektur Basiskennfeld" SWORD AirMassPerCyl 1 100 -3276.800 3276.700 FORMAT "%8.3" ECU_ADDRESS 0x8FE2CC /end MEASUREMENT
/begin MEASUREMENT AirCtl_mDesBasC_mp "stationärer Sollwert mit Kühlwassertemperaturkorrektur und Drehzahlkorrektur" SWORD AirMassPerCyl 1 100 -3276.800 3276.700 FORMAT "%8.3" ECU_ADDRESS 0x8FE2CE /end MEASUREMENT
/begin MEASUREMENT AirCtl_mDesBasDef_mp "stationärer Sollwert fehlerBasiskennfeld" SWORD AirMassPerCyl 1 100 -3276.800 3276.700 FORMAT "%8.3" ECU_ADDRESS 0x8FE2D0 /end MEASUREMENT
/begin MEASUREMENT AirCtl_mDesBasP_mp "stationaerer Sollwert mit Atmosphaerendruckkompensation" SWORD AirMassPerCyl 1 100 -3276.800 3276.700 FORMAT "%8.3" ECU_ADDRESS 0x8FE2D2 /end MEASUREMENT
/begin MEASUREMENT AirCtl_mDesBasT_mp "stationaerer Sollwert mit Lufttemperaturkorectur Basiskennfeld" SWORD AirMassPerCyl 1 100 -3276.800 3276.700 FORMAT "%8.3" ECU_ADDRESS 0x8FE2D4 /end MEASUREMENT
/begin MEASUREMENT AirCtl_mDesBas_mp "gewählter stationärer Basissollwert für ARF" SWORD AirMassPerCyl 1 100 -3276.800 3276.700 FORMAT "%8.3" ECU_ADDRESS 0x8FE2D6 /end MEASUREMENT
/begin MEASUREMENT AirCtl_mDesConv_mp "Kupplungs Korrekturwert" SWORD AirMassPerCyl 1 100 -3276.800 3276.700 FORMAT "%8.3" ECU_ADDRESS 0x8FE2D8 /end MEASUREMENT
/begin MEASUREMENT AirCtl_mDesCor "korrigierter Luftmassensollwert nach Rampenschalter" SWORD AirMassPerCyl 1 100 -3276.800 3276.700 FORMAT "%8.3" ECU_ADDRESS 0x7F8A42 /end MEASUREMENT
/begin MEASUREMENT AirCtl_mDesDyn_mp "dynamischer Anteil des Luftmassensollwerts für Abgasrückführung" SWORD AirMassPerCyl 1 100 -3276.800 3276.700 FORMAT "%8.3" ECU_ADDRESS 0x8FE2DA /end MEASUREMENT
/begin MEASUREMENT AirCtl_mDesLim_mp "Messpunkt für den Ausgangswert des Kennfeldes AirCtl_mDesLim_MAP" SWORD AirMassPerCyl 1 100 -3276.800 3276.700 FORMAT "%8.3" ECU_ADDRESS 0x8FE2DC /end MEASUREMENT
/begin MEASUREMENT AirCtl_mDesRgn1Cor "stationärer Sollwert mit Lufttemperaturkorrektur Regenerationskennfeld 1" SWORD AirMassPerCyl 1 100 -3276.800 3276.700 FORMAT "%8.3" ECU_ADDRESS 0x7F8A44 /end MEASUREMENT
/begin MEASUREMENT AirCtl_mDesRgn1Cor_mp "stationaerer Sollwert mit Lufttemperaturkorrectur Regenerationskennfeld-1" SWORD AirMassPerCyl 1 100 -3276.800 3276.700 FORMAT "%8.3" ECU_ADDRESS 0x8FE2DE /end MEASUREMENT
/begin MEASUREMENT AirCtl_mDesRgn1P_mp "stationaerer Sollwert mit Atmosphaerendruckkorrectur Regenerationskennfeld-1" SWORD AirMassPerCyl 1 100 -3276.800 3276.700 FORMAT "%8.3" ECU_ADDRESS 0x8FE2E0 /end MEASUREMENT
/begin MEASUREMENT AirCtl_mDesRgn1_mp "stationaerer Sollwert aus Regenerationskennfeld-1" SWORD AirMassPerCyl 1 100 -3276.800 3276.700 FORMAT "%8.3" ECU_ADDRESS 0x8FE2E2 /end MEASUREMENT
/begin MEASUREMENT AirCtl_mDesRgn2Cor "stationrer Sollwert mit Lufttemperaturkorrektur Regenerationskennfeld2" SWORD AirMassPerCyl 1 100 -3276.800 3276.700 FORMAT "%8.3" ECU_ADDRESS 0x7F8A46 /end MEASUREMENT
/begin MEASUREMENT AirCtl_mDesRgn2Cor_mp "stationaerer Solwert mit Lufttemperaturkorrectur Regenerationskennfeld-2" SWORD AirMassPerCyl 1 100 -3276.800 3276.700 FORMAT "%8.3" ECU_ADDRESS 0x8FE2E4 /end MEASUREMENT
/begin MEASUREMENT AirCtl_mDesRgn2P_mp "stationaerer sollwert mit Atmosphaendruckkorrektur regenerationskennfeld-2" SWORD AirMassPerCyl 1 100 -3276.800 3276.700 FORMAT "%8.3" ECU_ADDRESS 0x8FE2E6 /end MEASUREMENT
/begin MEASUREMENT AirCtl_mDesRgn2_mp "stationaerer Sollwert aus Regenerationskennfeld-2" SWORD AirMassPerCyl 1 100 -3276.800 3276.700 FORMAT "%8.3" ECU_ADDRESS 0x8FE2E8 /end MEASUREMENT
/begin MEASUREMENT AirCtl_mDesStat_mp "stationärer Luftmassensollwert" SWORD AirMassPerCyl 1 100 -3276.800 3276.700 FORMAT "%8.3" ECU_ADDRESS 0x8FE2EA /end MEASUREMENT
/begin MEASUREMENT AirCtl_mDesTrm_mp "stationaerer Sollwert mit Abgleich" SWORD AirMassPerCyl 1 100 -3276.800 3276.700 FORMAT "%8.3" ECU_ADDRESS 0x8FE2EC /end MEASUREMENT
/begin MEASUREMENT AirCtl_mDesVal "Luftmassensollwert" SWORD AirMassPerCyl 1 100 -3276.800 3276.700 FORMAT "%8.3" ECU_ADDRESS 0x7F8A48 /end MEASUREMENT
/begin MEASUREMENT AirCtl_mDesValByp_mp "Bypass-Label, Kopie von AirCtl_mDesVal" SWORD AirMassPerCyl 1 100 -3276.800 3276.700 FORMAT "%8.3" ECU_ADDRESS 0x8FE2EE /end MEASUREMENT
/begin MEASUREMENT AirCtl_mDesVal_mp "Ausgang Rampenschalter" SWORD AirMassPerCyl 1 100 -3276.800 3276.700 FORMAT "%8.3" ECU_ADDRESS 0x8FE2F0 /end MEASUREMENT
/begin MEASUREMENT AirCtl_mGvnrDvt "Regelabweichung" SWORD AirMassPerCyl 1 100 -3276.800 3276.700 FORMAT "%8.3" ECU_ADDRESS 0x7F8A4A /end MEASUREMENT
/begin MEASUREMENT AirCtl_mGvnrDvt1_mp "Meßpunkt von der Regelabweichung" SWORD AirMassPerCyl 1 100 -3276.800 3276.700 FORMAT "%8.3" ECU_ADDRESS 0x8FE312 /end MEASUREMENT
/begin MEASUREMENT AirCtl_mGvnrDvt2 "Regelabweichung 2" SWORD AirMassPerCyl 1 100 -3276.800 3276.700 FORMAT "%8.3" ECU_ADDRESS 0x7F8A4C /end MEASUREMENT
/begin MEASUREMENT AirCtl_mGvnrDvtBase_mp "Governer deviation base" SWORD AirMassPerCyl 1 100 -3276.800 3276.700 FORMAT "%8.3" ECU_ADDRESS 0x8FE314 /end MEASUREMENT
/begin MEASUREMENT AirCtl_mLi_mp "Meßpunkt nach Timer" SWORD AirMassPerCyl 1 100 -3276.800 3276.700 FORMAT "%8.3" ECU_ADDRESS 0x8FE2F2 /end MEASUREMENT
/begin MEASUREMENT AirCtl_mMaxDvt_mp "Obergrenze für Erkennung einer bleibenden Regelabweichung" SWORD AirMassPerCyl 1 100 -3276.800 3276.700 FORMAT "%8.3" ECU_ADDRESS 0x8FE35A /end MEASUREMENT
/begin MEASUREMENT AirCtl_mMinDvt_mp "Untergrenze für Erkennung einer bleibenden Regelabweichung" SWORD AirMassPerCyl 1 100 -3276.800 3276.700 FORMAT "%8.3" ECU_ADDRESS 0x8FE35C /end MEASUREMENT
/begin MEASUREMENT AirCtl_qCurrRmp_mp "Meßpunkt nach Rampung der ungefilterten Einspritzmenge" SWORD InjMass 1 100 -327.6800 327.6700 FORMAT "%8.4" ECU_ADDRESS 0x8FE35E /end MEASUREMENT
/begin MEASUREMENT AirCtl_qDesLim_mp "Eingang des Luftmassenbegrenzungskennfeldes" SWORD InjMassCyc 1 100 -327.6800 327.6700 FORMAT "%8.4" ECU_ADDRESS 0x8FE2F4 /end MEASUREMENT
/begin MEASUREMENT AirCtl_qSurgeHigh_mp "aktuelle obere Grenze für Mengen Hysterese gegen Laderpumpen" SWORD InjMass 1 100 -327.6800 327.6700 FORMAT "%8.4" ECU_ADDRESS 0x8FE360 /end MEASUREMENT
/begin MEASUREMENT AirCtl_qSurgeLow_mp "aktuelle untere Grenze für Mengen Hysterese gegen Laderpumpen" SWORD InjMass 1 100 -327.6800 327.6700 FORMAT "%8.4" ECU_ADDRESS 0x8FE362 /end MEASUREMENT
/begin MEASUREMENT AirCtl_rBrkRmp_mp "Rampen Ausgang bei Bremssignal Auswertung" SWORD Prc 1 100 -400.0000 399.9878 FORMAT "%8.4" ECU_ADDRESS 0x8FE364 /end MEASUREMENT
/begin MEASUREMENT AirCtl_rCtlVal "stationärer Steueranteil der Stellgröße" SWORD Prc 1 100 -400.0000 399.9878 FORMAT "%8.4" ECU_ADDRESS 0x7F8A4E /end MEASUREMENT
/begin MEASUREMENT AirCtl_rCtlValRgn_mp "Vorsteuerwert Luftmassenregler im Regenerationsbetrieb Drosselklappe" SWORD Prc 1 100 -400.0000 399.9878 FORMAT "%8.4" ECU_ADDRESS 0x8FE2C6 /end MEASUREMENT
/begin MEASUREMENT AirCtl_rCtlVal_mp "Ausgang Rampenschalter" SWORD Prc 1 100 -400.0000 399.9878 FORMAT "%8.4" ECU_ADDRESS 0x8FE2C8 /end MEASUREMENT
/begin MEASUREMENT AirCtl_rCtl_mp "Tastverhältnis aus Airctl Steuerung, Vorsteuerwert für PI-Regler" SWORD Prc 1 100 -400.0000 399.9878 FORMAT "%8.4" ECU_ADDRESS 0x8FE316 /end MEASUREMENT
/begin MEASUREMENT AirCtl_rEGR "Stellgröße für das ARF-Ventil" SWORD Prc 1 100 -400.0000 399.9878 FORMAT "%8.4" ECU_ADDRESS 0x7F8A50 /end MEASUREMENT
/begin MEASUREMENT AirCtl_rEGR2 "Stellwert 2 für Abgasregelung" SWORD Prc 1 100 -400.0000 399.9878 FORMAT "%8.4" ECU_ADDRESS 0x7F8A52 /end MEASUREMENT
/begin MEASUREMENT AirCtl_rEGRByp_mp "Bypass-Label, Kopie von AirCtl_rEGR" SWORD Prc 1 100 -400.0000 399.9878 FORMAT "%8.4" ECU_ADDRESS 0x8FE366 /end MEASUREMENT
/begin MEASUREMENT AirCtl_rEGRCtlAPSCor_mp "Atmosphärendruck-Korrekturwert des Tastverhältnisses für EGR" SWORD Prc 1 100 -400.0000 399.9878 FORMAT "%8.4" ECU_ADDRESS 0x8FE318 /end MEASUREMENT
/begin MEASUREMENT AirCtl_rEGRCtlATCor_mp "Ansauglufttemperatur-Korrekturwert des Tastverhältnisses für EGR" SWORD Prc 1 100 -400.0000 399.9878 FORMAT "%8.4" ECU_ADDRESS 0x8FE31A /end MEASUREMENT
/begin MEASUREMENT AirCtl_rEGRCtlBas_mp "Grundwert des Tastverhältnisses für EGR" SWORD Prc 1 100 -400.0000 399.9878 FORMAT "%8.4" ECU_ADDRESS 0x8FE31C /end MEASUREMENT
/begin MEASUREMENT AirCtl_rEGRCtlCTCor_mp "Kühlmitteltemperatur-Korrekturwert des Tastverhältnisses für EGR" SWORD Prc 1 100 -400.0000 399.9878 FORMAT "%8.4" ECU_ADDRESS 0x8FE31E /end MEASUREMENT
/begin MEASUREMENT AirCtl_rEGRCtl_mp "Tastverhältnis EGR im gesteuerten Betrieb" SWORD Prc 1 100 -400.0000 399.9878 FORMAT "%8.4" ECU_ADDRESS 0x8FE320 /end MEASUREMENT
/begin MEASUREMENT AirCtl_rGovEGRBas2_mp "EGR2 split Basis" SWORD Prc 1 100 -400.0000 399.9878 FORMAT "%8.4" ECU_ADDRESS 0x8FE322 /end MEASUREMENT
/begin MEASUREMENT AirCtl_rGovEGRBas_mp "EGR split Basis" SWORD Prc 1 100 -400.0000 399.9878 FORMAT "%8.4" ECU_ADDRESS 0x8FE324 /end MEASUREMENT
/begin MEASUREMENT AirCtl_rGovEGRRgn2_mp "EGR2 split Regeneration" SWORD Prc 1 100 -400.0000 399.9878 FORMAT "%8.4" ECU_ADDRESS 0x8FE326 /end MEASUREMENT
/begin MEASUREMENT AirCtl_rGovEGRRgn_mp "EGR split Regeneration" SWORD Prc 1 100 -400.0000 399.9878 FORMAT "%8.4" ECU_ADDRESS 0x8FE328 /end MEASUREMENT
/begin MEASUREMENT AirCtl_rGovTVABas2_mp "TVA 2 split Basis" SWORD Prc 1 100 -400.0000 399.9878 FORMAT "%8.4" ECU_ADDRESS 0x8FE340 /end MEASUREMENT
/begin MEASUREMENT AirCtl_rGovTVABas_mp "TVA split Basis" SWORD Prc 1 100 -400.0000 399.9878 FORMAT "%8.4" ECU_ADDRESS 0x8FE342 /end MEASUREMENT
/begin MEASUREMENT AirCtl_rGovTVARgn2_mp "TVA 2 split Regeneration" SWORD Prc 1 100 -400.0000 399.9878 FORMAT "%8.4" ECU_ADDRESS 0x8FE344 /end MEASUREMENT
/begin MEASUREMENT AirCtl_rGovTVARgn_mp "TVA split Regeneration" SWORD Prc 1 100 -400.0000 399.9878 FORMAT "%8.4" ECU_ADDRESS 0x8FE346 /end MEASUREMENT
/begin MEASUREMENT AirCtl_rGvnrEGR "Reglerstellgröße für Abgasrückführventil (Positionssollwert)" SWORD Prc 1 100 -400.0000 399.9878 FORMAT "%8.4" ECU_ADDRESS 0x7F8A54 /end MEASUREMENT
/begin MEASUREMENT AirCtl_rGvnrEGR2 "Governor output2 of EGR ratio" SWORD Prc 1 100 -400.0000 399.9878 FORMAT "%8.4" ECU_ADDRESS 0x7F8A56 /end MEASUREMENT
/begin MEASUREMENT AirCtl_rGvnrTVA "Reglerstellgröße für Drosselklappe (Positionssollwert)" SWORD Prc 1 100 -400.0000 399.9878 FORMAT "%8.4" ECU_ADDRESS 0x7F8A58 /end MEASUREMENT
/begin MEASUREMENT AirCtl_rGvnrTVA2 "Governor output2 of TVA ratio" SWORD Prc 1 100 -400.0000 399.9878 FORMAT "%8.4" ECU_ADDRESS 0x7F8A5A /end MEASUREMENT
/begin MEASUREMENT AirCtl_rOut2_mp "Reglerausgang 2" SWORD Prc 1 100 -400.0000 399.9878 FORMAT "%8.4" ECU_ADDRESS 0x8FE32A /end MEASUREMENT
/begin MEASUREMENT AirCtl_rOutD_mp "dynamisches Steuersignal - Ausgang DT1-Glied" SWORD Prc 1 100 -400.0000 399.9878 FORMAT "%8.4" ECU_ADDRESS 0x8FE32C /end MEASUREMENT
/begin MEASUREMENT AirCtl_rOutGvnr2_mp "zweiter Reglerausgang (Regler Korrektur Variable)" SWORD Prc 1 100 -400.0000 399.9878 FORMAT "%8.4" ECU_ADDRESS 0x8FE32E /end MEASUREMENT
/begin MEASUREMENT AirCtl_rOutGvnr_mp "Reglerausgang (Regler Korrektur Variable)" SWORD Prc 1 100 -400.0000 399.9878 FORMAT "%8.4" ECU_ADDRESS 0x8FE330 /end MEASUREMENT
/begin MEASUREMENT AirCtl_rOutI2_mp "Ausgang I-Regler2" SWORD Prc 1 100 -400.0000 399.9878 FORMAT "%8.4" ECU_ADDRESS 0x8FE332 /end MEASUREMENT
/begin MEASUREMENT AirCtl_rOutI_mp "Ausgang des Regler-I-Kanals bei der ARF" SWORD Prc 1 100 -400.0000 399.9878 FORMAT "%8.4" ECU_ADDRESS 0x8FE334 /end MEASUREMENT
/begin MEASUREMENT AirCtl_rOutP2_mp "Ausgang P-Regler 2" SWORD Prc 1 100 -400.0000 399.9878 FORMAT "%8.4" ECU_ADDRESS 0x8FE336 /end MEASUREMENT
/begin MEASUREMENT AirCtl_rOutP_mp "Ausgang des Regler-P-Kanals bei der ARF" SWORD Prc 1 100 -400.0000 399.9878 FORMAT "%8.4" ECU_ADDRESS 0x8FE338 /end MEASUREMENT
/begin MEASUREMENT AirCtl_rOut_mp "Reglerausgang" SWORD Prc 1 100 -400.0000 399.9878 FORMAT "%8.4" ECU_ADDRESS 0x8FE33A /end MEASUREMENT
/begin MEASUREMENT AirCtl_rTVA "Sollposition des Regelklappen-Stellers" SWORD Prc 1 100 -400.0000 399.9878 FORMAT "%8.4" ECU_ADDRESS 0x7F8A5C /end MEASUREMENT
/begin MEASUREMENT AirCtl_rTVA2 "Verhältnis von TVA2" SWORD Prc 1 100 -400.0000 399.9878 FORMAT "%8.4" ECU_ADDRESS 0x7F8A5E /end MEASUREMENT
/begin MEASUREMENT AirCtl_rTVA2UnLim_mp "measuring point for the not slope-limited controller variable throttle valve 2" SWORD Prc 1 100 -400.0000 399.9878 FORMAT "%8.4" ECU_ADDRESS 0x8FE368 /end MEASUREMENT
/begin MEASUREMENT AirCtl_rTVAByp_mp "Bypass-Label, Kopie von AirCtl_rTVA" SWORD Prc 1 100 -400.0000 399.9878 FORMAT "%8.4" ECU_ADDRESS 0x8FE36A /end MEASUREMENT
/begin MEASUREMENT AirCtl_rTVACtlAPSCor_mp "Atmosphärendruck-Korrekturwert des Tastverhältnisses für TVA" SWORD Prc 1 100 -400.0000 399.9878 FORMAT "%8.4" ECU_ADDRESS 0x8FE348 /end MEASUREMENT
/begin MEASUREMENT AirCtl_rTVACtlATCor_mp "Ansauglufttemperatur-Korrekturwert des Tastverhältnisses für TVA" SWORD Prc 1 100 -400.0000 399.9878 FORMAT "%8.4" ECU_ADDRESS 0x8FE34A /end MEASUREMENT
/begin MEASUREMENT AirCtl_rTVACtlBas_mp "Grundwert des Tastverhältnisses für TVA" SWORD Prc 1 100 -400.0000 399.9878 FORMAT "%8.4" ECU_ADDRESS 0x8FE34C /end MEASUREMENT
/begin MEASUREMENT AirCtl_rTVACtlCTCor_mp "Kühlmitteltemperatur-Korrekturwert des Tastverhältnisses für TVA" SWORD Prc 1 100 -400.0000 399.9878 FORMAT "%8.4" ECU_ADDRESS 0x8FE34E /end MEASUREMENT
/begin MEASUREMENT AirCtl_rTVACtl_mp "Tastverhältnis TVA im gesteuerten Betrieb" SWORD Prc 1 100 -400.0000 399.9878 FORMAT "%8.4" ECU_ADDRESS 0x8FE350 /end MEASUREMENT
/begin MEASUREMENT AirCtl_rTVAUnLim_mp "Messpunkt für die nicht-steigungsbegrenzte Stellergröße Drosselklappe" SWORD Prc 1 100 -400.0000 399.9878 FORMAT "%8.4" ECU_ADDRESS 0x8FE36C /end MEASUREMENT
/begin MEASUREMENT AirCtl_stAirCtl "Anzeige der Abschaltursache in der ARF-Überwachung" UBYTE OneToOne 1 100 0.00 255.0 FORMAT "%5.1" ECU_ADDRESS 0x7F8792 /end MEASUREMENT
/begin MEASUREMENT AirCtl_stAirCtlBits "Bitorientierte Anzeige aller Abschaltursachen" ULONG OneToOne 1 100 0.00 4294967295.00 FORMAT "%13.2" ECU_ADDRESS 0x7F90B0 /end MEASUREMENT
/begin MEASUREMENT AirCtl_stAirCtlBits1_mp "AirCtl_stAirCtlBits_mp LowByte (->Signals)" UWORD OneToOne 1 100 0.00 65535.00 FORMAT "%8.2" ECU_ADDRESS 0x6F8002 /end MEASUREMENT
/begin MEASUREMENT AirCtl_stAirCtlBits2_mp "AirCtl_stAirCtlBits_mp HighByte (->Signals)" UWORD OneToOne 1 100 0.00 65535.00 FORMAT "%8.2" ECU_ADDRESS 0x6F8004 /end MEASUREMENT
/begin MEASUREMENT AirCtl_stDebBrkpressed_mp "Deaktivierung der Überwachung der negativen Regelabweichung bei mehrmals betätigter Bremse" UBYTE OneToOne 1 100 0.00 255.0 FORMAT "%5.1" ECU_ADDRESS 0x8FE36E /end MEASUREMENT
/begin MEASUREMENT AirCtl_stDebDef_mp "Statusangabe, ob Regelabweichung überwacht wird" UBYTE OneToOne 1 100 0.00 255.0 FORMAT "%5.1" ECU_ADDRESS 0x8FE36F /end MEASUREMENT
/begin MEASUREMENT AirCtl_stEGT "Statusbyte des Regenerationseingriffes" UBYTE OneToOne 1 100 0.00 255.0 FORMAT "%5.1" ECU_ADDRESS 0x7F8793 /end MEASUREMENT
/begin MEASUREMENT AirCtl_stEGT_mp "Statusbyte des Regenerationseingriffs" UBYTE OneToOne 1 100 0.00 255.0 FORMAT "%5.1" ECU_ADDRESS 0x8FE2F6 /end MEASUREMENT
/begin MEASUREMENT AirCtl_stGearShiftHighLoad_mp "status of gear control" UBYTE OneToOne 1 100 0.00 255.0 FORMAT "%5.1" ECU_ADDRESS 0x8FE370 /end MEASUREMENT
/begin MEASUREMENT AirCtl_stHealDef_mp "Status, ob Heilung von erkannter bleibender Regelabweichung zulässig" UBYTE OneToOne 1 100 0.00 255.0 FORMAT "%5.1" ECU_ADDRESS 0x8FE371 /end MEASUREMENT
/begin MEASUREMENT AirCtl_stMonitor "Status: Abschaltfall der Regelung" UBYTE OneToOne 1 100 0.00 255.0 FORMAT "%5.1" ECU_ADDRESS 0x7F8794 /end MEASUREMENT
/begin MEASUREMENT AirCtl_stPlateBreak_mp "State for plate break" UBYTE OneToOne 1 100 0.00 255.0 FORMAT "%5.1" ECU_ADDRESS 0x8FE372 /end MEASUREMENT
/begin MEASUREMENT AirCtl_stRgnSwt_mp "Statusschalter für EGT_RgnSwt vom Ausgang der Funktion EGR_RgnRmpSwt." ULONG OneToOne 1 100 0.00 4294967295.00 FORMAT "%13.2" ECU_ADDRESS 0x8FE33C /end MEASUREMENT
/begin MEASUREMENT AirCtl_swtAPSCor "Schalter für add./mult. Atmosphärendruckkorrektur" UBYTE OneToOne 1 100 0.00 255.0 FORMAT "%5.1" ECU_ADDRESS 0x7F8795 /end MEASUREMENT
/begin MEASUREMENT AirCtl_swtGvnr "Schalter für Reglerabschaltung" UBYTE OneToOne 1 100 0.00 255.0 FORMAT "%5.1" ECU_ADDRESS 0x7F8796 /end MEASUREMENT
/begin MEASUREMENT AirCtl_swtIATSCor "Schalter für add. / mult. Lufttemperaturkorrektur" UBYTE OneToOne 1 100 0.00 255.0 FORMAT "%5.1" ECU_ADDRESS 0x7F8797 /end MEASUREMENT
/begin MEASUREMENT AirCtl_swtTrm "Schalter für add./mult. Abgleichkorrektur" UBYTE OneToOne 1 100 0.00 255.0 FORMAT "%5.1" ECU_ADDRESS 0x7F8798 /end MEASUREMENT
/begin MEASUREMENT AirCtl_tiStrtDel_mp "Zeit, in der die Regelung nach Startabwurf abgeschaltet bleibt" UWORD Time_ms 1 100 0.00 655350.0 FORMAT "%8.1" ECU_ADDRESS 0x8FE374 /end MEASUREMENT
/begin MEASUREMENT AirCtl_TrmVal_mp "Abgleichwert für ARF" SWORD AirMassPerCyl 1 100 -3276.800 3276.700 FORMAT "%8.3" ECU_ADDRESS 0x8FE2CA /end MEASUREMENT
/begin MEASUREMENT AirSys_stTstDem "Statusvariable für Stellertest bei Diagnoseeingriff" UWORD OneToOne 1 100 0.00 65535.00 FORMAT "%8.2" ECU_ADDRESS 0x7F8A60 /end MEASUREMENT
/begin MEASUREMENT AltCD_rAltLoad "Linearisiertes und fehlerentprelltes Generatorlastsignals" SWORD Prc 1 100 -400.0000 399.9878 FORMAT "%8.4" ECU_ADDRESS 0x7F8A62 /end MEASUREMENT
/begin MEASUREMENT AltCD_stAltCtl_mp "Spannungsregelung - Status" UBYTE OneToOne 1 100 0.00 255.0 FORMAT "%5.1" ECU_ADDRESS 0x8FE37E /end MEASUREMENT
/begin MEASUREMENT AltCD_stErrAlt "Generator Fehlerbits" UBYTE OneToOne 1 100 0.00 255.0 FORMAT "%5.1" ECU_ADDRESS 0x7F879B /end MEASUREMENT
/begin MEASUREMENT AltCD_stGenManuFak "message manufacturer of alternator" UBYTE OneToOne 1 100 0.00 255.0 FORMAT "%5.1" ECU_ADDRESS 0x7F879C /end MEASUREMENT
/begin MEASUREMENT AltCD_stGenTypKenn "message alternator type" UBYTE OneToOne 1 100 0.00 255.0 FORMAT "%5.1" ECU_ADDRESS 0x7F879D /end MEASUREMENT
/begin MEASUREMENT AltCD_stLROff_mp "status of load response switch off" UBYTE OneToOne 1 100 0.00 255.0 FORMAT "%5.1" ECU_ADDRESS 0x8FE37F /end MEASUREMENT
/begin MEASUREMENT AltCD_tiLR_mp "Load Response Time, vom Generator zurückgelesener Wert" UWORD Time_s 1 100 0.00 655.3500 FORMAT "%8.4" ECU_ADDRESS 0x8FE380 /end MEASUREMENT
/begin MEASUREMENT AltCD_uAlt "Generatorspannungs-Sollwert, vom Generator zurückgelesener Wert" SWORD Volt_Batt 1 100 -640625.6 640606.1 FORMAT "%8.1" ECU_ADDRESS 0x7F8A64 /end MEASUREMENT
/begin MEASUREMENT AltCD_uAlt_mp "Generatorspannungs-Sollwert, vom Generator zurückgelesener Wert" SWORD Volt_Batt 1 100 -640625.6 640606.1 FORMAT "%8.1" ECU_ADDRESS 0x8FE382 /end MEASUREMENT
/begin MEASUREMENT Alt_n_mp "Drehzahl für Leistungsbedarfberechnung Generator" SWORD EngN 1 100 -32768.00 32767.00 FORMAT "%8.2" ECU_ADDRESS 0x8FE376 /end MEASUREMENT
/begin MEASUREMENT Alt_pwrDes "mechanischer Leistungsbedarf des Generators" SWORD Pwr 1 100 -308831.1 308821.7 FORMAT "%8.1" ECU_ADDRESS 0x7F8A66 /end MEASUREMENT
/begin MEASUREMENT Alt_pwrLead "Vorhaltleistung des Generators" SWORD Pwr 1 100 -308831.1 308821.7 FORMAT "%8.1" ECU_ADDRESS 0x7F8A68 /end MEASUREMENT
/begin MEASUREMENT Alt_pwrUnCor_mp "Generator Leistungsbedarf vor Korrektur" SWORD Pwr 1 100 -308831.1 308821.7 FORMAT "%8.1" ECU_ADDRESS 0x8FE378 /end MEASUREMENT
/begin MEASUREMENT Alt_rAdjVal_mp "Abgleichwert" SWORD Fact 1 100 -4.000000 3.999878 FORMAT "%8.6" ECU_ADDRESS 0x8FE37A /end MEASUREMENT
/begin MEASUREMENT Alt_trqDes_mp "Wunschmoment vom Generator" SWORD OneToOne 1 100 -32768.00 32767.00 FORMAT "%8.2" ECU_ADDRESS 0x8FE37C /end MEASUREMENT
/begin MEASUREMENT AOHtCD_rOut_mp "Meßpunkt fuer korrigiertes Tastverhaeltnis der Zuheizeransteuerung" SWORD DtyCyc 1 100 -327.6800 327.6700 FORMAT "%8.4" ECU_ADDRESS 0x6F8008 /end MEASUREMENT
/begin MEASUREMENT AOHtCD_stHtgReq "Heizleistungsanforderung von Hardware-Pin (Heizungssteuerung)" UBYTE OneToOne 1 100 0.00 255.0 FORMAT "%5.1" ECU_ADDRESS 0x7F8787 /end MEASUREMENT
/begin MEASUREMENT AOHt_nMin "Minimum Leerlaufsolldrehzahlanforderung durch Zuheizer" SWORD EngN 1 100 -32768.00 32767.00 FORMAT "%8.2" ECU_ADDRESS 0x7F89DE /end MEASUREMENT
/begin MEASUREMENT AOHt_rHtgOut "Heizleitungsanforderung, Zuheizer (Tastverhältnis)" SWORD DtyCyc 1 100 -327.6800 327.6700 FORMAT "%8.4" ECU_ADDRESS 0x7F89E0 /end MEASUREMENT
/begin MEASUREMENT AOHt_stHtgUp "Warmlaufzustand des Motors" UBYTE OneToOne 1 100 0.00 255.0 FORMAT "%5.1" ECU_ADDRESS 0x7F8788 /end MEASUREMENT
/begin MEASUREMENT AOHt_stShutOff_mp "Überblick auf alle Abschaltbedingungen" UWORD OneToOne 1 100 0.00 65535.00 FORMAT "%8.2" ECU_ADDRESS 0x6F8006 /end MEASUREMENT
/begin MEASUREMENT AOHt_tEnvLin_mp "Umgebungstemperatur nach Kennlinie" SWORD Temp_Cels 1 100 -50.140 899.860 FORMAT "%8.3" ECU_ADDRESS 0x8FE384 /end MEASUREMENT
/begin MEASUREMENT APPCD_drAPP1UnFlt "Differenz der Fahrpedal 1 Position ungefilterter Wert" SWORD PrcPerSec 1 100 -20000.00 19999.39 FORMAT "%8.2" ECU_ADDRESS 0x7F89E2 /end MEASUREMENT
/begin MEASUREMENT APPCD_rAPP1 "Ungefilterter APP1, wird während Testimpuls aktualisiert" SWORD Prc 1 100 -400.0000 399.9878 FORMAT "%8.4" ECU_ADDRESS 0x7F89E4 /end MEASUREMENT
/begin MEASUREMENT APPCD_rAPP1UnFlt "Fahrpedal 1 position ungefilterter Rohwert" SWORD Prc 1 100 -400.0000 399.9878 FORMAT "%8.4" ECU_ADDRESS 0x7F89E6 /end MEASUREMENT
/begin MEASUREMENT APPCD_rFlt "gefiltertes Pedalwertgebersignal" SWORD Prc 1 100 -400.0000 399.9878 FORMAT "%8.4" ECU_ADDRESS 0x7F89E8 /end MEASUREMENT
/begin MEASUREMENT APPCD_rLinAPP1 "linearisierter APP1" SWORD Prc 1 100 -400.0000 399.9878 FORMAT "%8.4" ECU_ADDRESS 0x7F89EA /end MEASUREMENT
/begin MEASUREMENT APPCD_rLinAPP2 "Linearisierter APP2" SWORD Prc 1 100 -400.0000 399.9878 FORMAT "%8.4" ECU_ADDRESS 0x7F89EC /end MEASUREMENT
/begin MEASUREMENT APPCD_SRCErrInfo_mp "Status der SRC-Fehler für APP1 und APP2" UBYTE OneToOne 1 100 0.00 255.0 FORMAT "%5.1" ECU_ADDRESS 0x8FE386 /end MEASUREMENT
/begin MEASUREMENT APPCD_stADCMonbit15RE_mp "the status of rising edge on the test impulse" UBYTE OneToOne 1 100 0.00 255.0 FORMAT "%5.1" ECU_ADDRESS 0x8FE387 /end MEASUREMENT
/begin MEASUREMENT APPCD_stErr1_mp "Fehlerzustand von APP1/2 Signal" UWORD OneToOne 1 100 0.00 65535.00 FORMAT "%8.2" ECU_ADDRESS 0x8FE388 /end MEASUREMENT
/begin MEASUREMENT APPCD_stKickDown "Kick Down Zustand des Fahrpedals" UBYTE OneToOne 1 100 0.00 255.0 FORMAT "%5.1" ECU_ADDRESS 0x7F8789 /end MEASUREMENT
/begin MEASUREMENT APPCD_u0PrcAPP1_mp "Ermittelte Spannung bei 0% APP1" SWORD Volt 1 100 -160156.4 160151.5 FORMAT "%8.1" ECU_ADDRESS 0x8FE38A /end MEASUREMENT
/begin MEASUREMENT APPCD_u0PrcAPP2_mp "Ermittelte Spannung bei 0% APP2" SWORD Volt 1 100 -160156.4 160151.5 FORMAT "%8.1" ECU_ADDRESS 0x8FE38C /end MEASUREMENT
/begin MEASUREMENT APPCD_uDiffMax_mp "Maximal zulässige Differenz der Rohspannungen" SWORD Volt 1 100 -160156.4 160151.5 FORMAT "%8.1" ECU_ADDRESS 0x8FE38E /end MEASUREMENT
/begin MEASUREMENT APPCD_uRawAPP1 "Fahrpedal 1 Position Rohwert" SWORD Volt 1 100 -160156.4 160151.5 FORMAT "%8.1" ECU_ADDRESS 0x7F89EE /end MEASUREMENT
/begin MEASUREMENT APPCD_uRawAPP2 "Fahrpedal 2 Position Rohwert" SWORD Volt 1 100 -160156.4 160151.5 FORMAT "%8.1" ECU_ADDRESS 0x7F89F0 /end MEASUREMENT
/begin MEASUREMENT APPCD_uRawDiff_mp "Betrag der Differenz der Rohspannungen von APP1 und APP2" SWORD Volt 1 100 -160156.4 160151.5 FORMAT "%8.1" ECU_ADDRESS 0x8FE390 /end MEASUREMENT
/begin FUNCTION afscd_drftcomp "Driftkompensation"
 /begin DEF_CHARACTERISTIC AFSCD_dmIdlAirMsLim_C AFSCD_dmLdAirMsLim_C AFSCD_dpLdAdjThresHi_C AFSCD_dqLdAdjThresHi_C AFSCD_drWtPenDetThresHi_C AFSCD_facHiThresIdlAdjVal_C AFSCD_facHiThresLdAdjVal_C AFSCD_facIdlAdjValStepLim_C AFSCD_facLdAdjValStepLim_C AFSCD_facLoThresIdlAdjVal_C AFSCD_facLoThresLdAdjVal_C AFSCD_nAvrgIdlAdjThresHi_C AFSCD_nAvrgIdlAdjThresLo_C AFSCD_pBstAtmDiffLim_C AFSCD_pBstLdAdjThresHi_C AFSCD_pBstLdAdjThresLo_C AFSCD_tiAirMsPT1_C AFSCD_tiCorFacPT1_C AFSCD_tiBstPresPT1_C AFSCD_tiQntCurrPT1_C AFSCD_tiWtPenDetPT1_C AFSCD_qCurrIdlAdjThresHi_C AFSCD_qCurrIdlAdjThresLo_C AFSCD_qWinLdAdjThresHi_CUR AFSCD_qWinLdAdjThresLo_CUR AFSCD_swtActvEEPLoThres_C AFSCD_swtClrEEPAdjVal_C AFSCD_swtCurrAdjRls_C AFSCD_swtWtPenMon_C AFSCD_tAirAdjRlsThresHi_C AFSCD_tAirAdjRlsThresLo_C AFSCD_tEnvAdjRlsThresHi_C AFSCD_tEnvAdjRlsThresLo_C AFSCD_tiAdjRlsDel_C AFSCD_tiMinIdlAdjRls_C AFSCD_tiMinLdAdjRls_C AFSCD_tiStrtDelAdjRls_C AFSCD_tiWtPenDetDebLoHi_C AFSCD_vVehLdAdjThresHi_C AFSCD_vVehLdAdjThresLo_C /end DEF_CHARACTERISTIC
 /begin IN_MEASUREMENT Eng_nAvrg /end IN_MEASUREMENT
/end FUNCTION
/begin FUNCTION afscd_drftcomp_msg "" /begin OUT_MEASUREMENT AFSCD_dpIntValAbsFlt AFSCD_dqCurrAbsFlt AFSCD_stDrftComp /end OUT_MEASUREMENT /end FUNCTION
/begin FUNCTION afscd_drftcomp_uic ""
 /begin OUT_MEASUREMENT AFSCD_dmAirMsFlt_mp AFSCD_dmIdlAirMs_mp AFSCD_dmLdAirMs_mp AFSCD_dpIntValAbs_mp AFSCD_drWtPenDetFlt_mp AFSCD_drWtPenDet_mp AFSCD_facCalcIdlAdjVal_mp AFSCD_facCalcLdAdjVal_mp AFSCD_facCalcValFlt_mp AFSCD_facCalcVal_mp AFSCD_facIdlAdjValUnLim_mp AFSCD_facIdlAdjVal_mp AFSCD_facLdAdjValUnLim_mp AFSCD_facLdAdjVal_mp AFSCD_qWinLdAdjThresHi_mp AFSCD_qWinLdAdjThresLo_mp AFSCD_stAdjRlsDel_mp AFSCD_stEnvCon_mp AFSCD_stIdlAdjRlsCon_mp AFSCD_stLdAdjRlsCon_mp AFSCD_stRstLoDrftThres_mp AFSCD_stWtPenDetDeb_mp AFSCD_stWtPenDet_mp /end OUT_MEASUREMENT
/end FUNCTION
/begin FUNCTION afscd_flt "Luftmassenfilterung" /end FUNCTION
/begin FUNCTION afscd_flt_msg "" /begin OUT_MEASUREMENT AFSCD_mAirPerCylFlt /end OUT_MEASUREMENT /end FUNCTION
/begin FUNCTION afscd_flt_uic "" /end FUNCTION
/begin FUNCTION afscd_mon "AFSCD Monitoring fucntion"
 /begin DEF_CHARACTERISTIC AFSCD_DebPlHiSetyDrftDef_C AFSCD_DebPlHiSetyDrftOk_C AFSCD_DebPlLoSetyDrftDef_C AFSCD_DebPlLoSetyDrftOk_C AFSCD_tiAirPerTimeDT1_C AFSCD_dDT1KdAirPerTime_C AFSCD_dmAirSubsVal_MAP AFSCD_tClntThrLo_C AFSCD_tClntThrHi_C AFSCD_rSwirlThrLo_C AFSCD_rSwirlThrHi_C AFSCD_rTVAThrLo_C AFSCD_rTVAThrHi_C AFSCD_pAirThrLo_C AFSCD_qRawThrHi_C AFSCD_nAvrgThrLoPlHi_C AFSCD_nAvrgThrHiPlHi_C AFSCD_pBstThrHiPlHi_C AFSCD_rAirThrHiPlHi_C AFSCD_nAvrgThrLoPlLo_C AFSCD_nAvrgThrHiPlLo_C AFSCD_pBstThrLoPlLo_C AFSCD_rAirThrLoPlLo_C AFSCD_rEGRPThrHi_C AFSCD_tiDlyEGRPPlSetyDrft_C AFSCD_tiDlyStrPlSetyDrft_C AFSCD_dtAirThres_C AFSCD_stInhRls_C AFSCD_swtSensInstVal_C AFSCD_swtSensInstType_C /end DEF_CHARACTERISTIC
 /begin IN_MEASUREMENT Eng_nAvrg InjCtl_qRaw /end IN_MEASUREMENT
/end FUNCTION
/begin FUNCTION afscd_mon_msg ""
 /begin OUT_MEASUREMENT AFSCD_ddmAirPerTime AFSCD_dmAirNorm AFSCD_dmAirPerTime AFSCD_mAirPerCyl AFSCD_rAirNorm AFSCD_stDrftMonRls AFSCD_swtSensInst /end OUT_MEASUREMENT
/end FUNCTION
/begin FUNCTION afscd_mon_uic ""
 /begin OUT_MEASUREMENT AFSCD_dmAirSensCorr_mp AFSCD_dmAirSubsVal_mp AFSCD_mAirPerCyl_mp AFSCD_stDrftMonRls_mp AFSCD_stPlSetyDrftRls_mp AFSCD_stPlSetyDrft_mp /end OUT_MEASUREMENT
/end FUNCTION
/begin FUNCTION afscd_msg ""
 /begin OUT_MEASUREMENT AFSCD_dmAirPerTimeHold AFSCD_dmAirRawPerTime AFSCD_dmAirSens AFSCD_stErrAirm AFSCD_stOffsTst AFSCD_tiRaw AFSCD_tiRawLast /end OUT_MEASUREMENT
/end FUNCTION
/begin FUNCTION afscd_uic ""
 /begin OUT_MEASUREMENT AFSCD_dmAirSensRaw_mp AFSCD_facPlsCor_mp AFSCD_facSwtOnCor_mp AFSCD_qAirmThrSRCHiActv_mp AFSCD_stDebSRCAirm_mp AFSCD_stSRCHiTstRls_mp AFSCD_stSRCLoTstRls_mp AFSCD_tiRawAvrgVal_mp AFSCD_tiSwtOnCor_mp /end OUT_MEASUREMENT
/end FUNCTION
/begin FUNCTION afs_detafspwr "Process to update the power required by active front steering"
 /begin DEF_CHARACTERISTIC AFS_tidphiStrgDT1_C AFS_kddphiStrg_C AFS_facDynCorr1_CUR AFS_facDynCorr1_MAP AFS_facNEngDynCorr_MAP AFS_facVehSpd_MAP AFS_rTrans_C AFS_swtChkDM_ANF_AFS_C AFS_swtChkSTWA_C AFS_swtdphiStrgGenSel_C AFS_swtdphiStrgSourceSel_C AFS_swtErrAFS_C AFS_swtErrStrg_C AFS_swtVAR_C AFS_trqBaseDynCorr_MAP AFS_trqBaseStatCorr_MAP AFS_trqDesMax_C AFS_trqDesMin_C AFS_trqDisable_MAP AFS_uBattMin_C /end DEF_CHARACTERISTIC
 /begin IN_MEASUREMENT AFS_dphiStrg_mp AFS_trqTar_mp Eng_nAvrg FrmMng_phiStrg VSSCD_v /end IN_MEASUREMENT
/end FUNCTION
/begin FUNCTION afs_detafspwr_msg "" /begin OUT_MEASUREMENT AFS_pwrDes AFS_pwrLead AFS_stRecAFS /end OUT_MEASUREMENT /end FUNCTION
/begin FUNCTION afs_detafspwr_uic ""
 /begin OUT_MEASUREMENT AFS_dphiStrg1_mp AFS_dphiStrg2_mp AFS_dphiStrg_mp AFS_stErrAFS_mp AFS_stErrStrg_mp AFS_stTrqDISA_mp AFS_stTrqENA_mp AFS_stTrqLogic_mp AFS_trqDesLim_mp AFS_trqDes_mp AFS_trqDisable_mp AFS_trqDyn1_mp AFS_trqDyn_mp AFS_trqStat_mp AFS_trqTar_mp /end OUT_MEASUREMENT
/end FUNCTION
/begin FUNCTION airbcd "Komponententreiber Airbagsignalerfassung" /end FUNCTION
/begin FUNCTION airbcd_msg "" /begin OUT_MEASUREMENT AirbCD_st /end OUT_MEASUREMENT /end FUNCTION
/begin FUNCTION airbcd_uic "" /end FUNCTION
/begin FUNCTION airctl_ctlvalcalc "Abgasrückführung - Steuerung"
 /begin DEF_CHARACTERISTIC AirCtl_rCtlValRgn_MAP AirCtl_rCtlVal_MAP AirCtl_stMskCtlValRgn_C /end DEF_CHARACTERISTIC
 /begin IN_MEASUREMENT Eng_nAvrg InjCtl_qCurr /end IN_MEASUREMENT
/end FUNCTION
/begin FUNCTION airctl_ctlvalcalc_msg "" /begin OUT_MEASUREMENT AirCtl_rCtlVal /end OUT_MEASUREMENT /end FUNCTION
/begin FUNCTION airctl_ctlvalcalc_uic "" /begin OUT_MEASUREMENT AirCtl_rCtlValRgn_mp AirCtl_rCtlVal_mp /end OUT_MEASUREMENT /end FUNCTION
/begin FUNCTION airctl_desvalcalc "Abgasrückführung - Sollwertbildung"
 /begin DEF_CHARACTERISTIC AirCtl_APCorRgn_CUR AirCtl_APSCor_CUR AirCtl_ATCorRgn_CUR AirCtl_dmDesBasUp_C AirCtl_dmDesBasDwn_C AirCtl_tiDT1DesCld_C AirCtl_DKdDesCld_C AirCtl_DKdPosDesCld_C AirCtl_DKdNegDesCld_C AirCtl_dqDWinPosDesCld_C AirCtl_dqDWinNegDesCld_C AirCtl_tiDT1DesWrm_C AirCtl_DKdDesWrm_C AirCtl_DKdPosDesWrm_C AirCtl_DKdNegDesWrm_C AirCtl_dqDWinPosDesWrm_C AirCtl_dqDWinNegDesWrm_C AirCtl_facCTSCor1_CUR AirCtl_facCTSCor2_CUR AirCtl_facIATSCor_CUR AirCtl_MaxTrmVal_C AirCtl_mDesBasDef_MAP AirCtl_mDesBasFDC_MAP AirCtl_mDesBas_MAP AirCtl_mDesConv_C AirCtl_mDesLim_MAP AirCtl_mDesRgn1_MAP AirCtl_mDesRgn2_MAP AirCtl_MinTrmVal_C AirCtl_mLiCor_C AirCtl_mMaxDesVal_C AirCtl_mMinDesVal_C AirCtl_mNQCTSCor1_MAP AirCtl_mNQCTSCor2_MAP AirCtl_mPiI2Cor_C AirCtl_nLiEGR_C AirCtl_NQATCorRgn_MAP AirCtl_NQIATSCor_MAP AirCtl_stRgnMsk1_C AirCtl_stRgnMsk2_C AirCtl_swtAPSCorVal_C AirCtl_swtAPSCorType_C AirCtl_swtIATSCorVal_C AirCtl_swtIATSCorType_C AirCtl_swtTrmVal_C AirCtl_swtTrmType_C AirCtl_tClntThres_C AirCtl_tiLiEGR_C AirCtl_tiRmpSlpDes_C AirCtl_TrmVal_C /end DEF_CHARACTERISTIC
 /begin IN_MEASUREMENT AirCtl_qDesLim_mp APSCD_pVal CTSCD_tClnt Eng_nAvrg IATSCD_tAir InjCtl_qRaw InjCtl_qRawCor /end IN_MEASUREMENT
 /begin OUT_MEASUREMENT AirCtl_TrmVal_mp /end OUT_MEASUREMENT
/end FUNCTION
/begin FUNCTION airctl_desvalcalc_msg ""
 /begin OUT_MEASUREMENT AirCtl_mDesBas AirCtl_mDesCor AirCtl_mDesRgn1Cor AirCtl_mDesRgn2Cor AirCtl_mDesVal AirCtl_swtAPSCor AirCtl_swtIATSCor AirCtl_swtTrm /end OUT_MEASUREMENT
/end FUNCTION
/begin FUNCTION airctl_desvalcalc_uic ""
 /begin DEF_CHARACTERISTIC AirCtl_mDesCorBypass_Vector AirCtl_mDesCorBypass_Channel AirCtl_mDesValAdd_Vector AirCtl_mDesValAdd_Channel AirCtl_mDesVal_Vector AirCtl_mDesVal_Channel /end DEF_CHARACTERISTIC
 /begin OUT_MEASUREMENT AirCtl_mDesBasCor_mp AirCtl_mDesBasC_mp AirCtl_mDesBasDef_mp AirCtl_mDesBasP_mp AirCtl_mDesBasT_mp AirCtl_mDesBas_mp AirCtl_mDesConv_mp AirCtl_mDesDyn_mp AirCtl_mDesLim_mp AirCtl_mDesRgn1Cor_mp AirCtl_mDesRgn1P_mp AirCtl_mDesRgn1_mp AirCtl_mDesRgn2Cor_mp AirCtl_mDesRgn2P_mp AirCtl_mDesRgn2_mp AirCtl_mDesStat_mp AirCtl_mDesTrm_mp AirCtl_mDesValByp_mp AirCtl_mDesVal_mp AirCtl_mLi_mp AirCtl_qDesLim_mp AirCtl_stEGT_mp /end OUT_MEASUREMENT
/end FUNCTION
/begin FUNCTION airctl_governor "Adaptiver Abgasrückführregler"
 /begin DEF_CHARACTERISTIC AirCtl_tiDT1_C AirCtl_DKd_C AirCtl_DKdPos_C AirCtl_DKdNeg_C AirCtl_dqDWinPos_C AirCtl_dqDWinNeg_C AirCtl_tiDT1Rgn_C AirCtl_DKdRgn_C AirCtl_DKdPosRgn_C AirCtl_DKdNegRgn_C AirCtl_dqDWinPosRgn_C AirCtl_dqDWinNegRgn_C AirCtl_facATParAdDKd_CUR AirCtl_facATParAdIKi_CUR AirCtl_facATParAdPKp_CUR AirCtl_facEGRCtlATCor_CUR AirCtl_facEGRCtlCTCor_CUR AirCtl_facNQParAdDKd_MAP AirCtl_facNQParAdIKi_MAP AirCtl_facNQParAdPKp_MAP AirCtl_facNQParRgnAdDKd_MAP AirCtl_facNQParRgnAdIKi_MAP AirCtl_facNQParRgnAdPKp_MAP AirCtl_IKi2_C AirCtl_IKiPos2_C AirCtl_IKiNeg2_C AirCtl_mIWinPos2_C AirCtl_mIWinNeg2_C AirCtl_IKiRgn2_C AirCtl_IKiPosRgn2_C AirCtl_IKiNegRgn2_C AirCtl_mIWinPosRgn2_C AirCtl_mIWinNegRgn2_C AirCtl_IKi_C AirCtl_IKiPos_C AirCtl_IKiNeg_C AirCtl_mIWinPos_C AirCtl_mIWinNeg_C AirCtl_IKiRgn_C AirCtl_IKiPosRgn_C AirCtl_IKiNegRgn_C AirCtl_mIWinPosRgn_C AirCtl_mIWinNegRgn_C AirCtl_PKp2_C AirCtl_PKpPos2_C AirCtl_PKpNeg2_C AirCtl_mPWinPos2_C AirCtl_mPWinNeg2_C AirCtl_PKpRgn2_C AirCtl_PKpPosRgn2_C AirCtl_PKpNegRgn2_C AirCtl_mPWinPosRgn2_C AirCtl_mPWinNegRgn2_C AirCtl_PKp_C AirCtl_PKpPos_C AirCtl_PKpNeg_C AirCtl_mPWinPos_C AirCtl_mPWinNeg_C AirCtl_PKpRgn_C AirCtl_PKpPosRgn_C AirCtl_PKpNegRgn_C AirCtl_mPWinPosRgn_C AirCtl_mPWinNegRgn_C AirCtl_rEGRBas_MAP AirCtl_rEGRCtlAPSCor_CUR AirCtl_rEGRCtlATCor_MAP AirCtl_rEGRCtlBas_MAP AirCtl_rEGRCtlCTCor_MAP AirCtl_rEGRRgn_MAP AirCtl_rGovEGRMax_C AirCtl_rGovEGRMin_C AirCtl_rGvnrMax_C AirCtl_rGvnrMin_C AirCtl_rIDflVal12_C AirCtl_rIDflVal4_C AirCtl_rIDflVal5_C AirCtl_rIDflVal7_C AirCtl_rIDflVal8Surge_C AirCtl_rIDflVal8_C AirCtl_rIDflValCtl_C AirCtl_stEGRDel_C AirCtl_stMskParRgn_C AirCtl_stRgnMskGov_C AirCtl_swtEGRCtl_C AirCtl_swtGvnrVal_C AirCtl_swtGvnrType_C AirCtl_tiEGRDel_C AirCtl_tiRmpSlpGov_C /end DEF_CHARACTERISTIC
 /begin IN_MEASUREMENT AirCtl_rOutGvnr_mp APSCD_pVal CTSCD_tClnt Eng_nAvrg IATSCD_tAir InjCtl_qCurrCor InjCtl_qRaw /end IN_MEASUREMENT
/end FUNCTION
/begin FUNCTION airctl_governor_msg ""
 /begin OUT_MEASUREMENT AirCtl_mGvnrDvt AirCtl_mGvnrDvt2 AirCtl_rGvnrEGR AirCtl_rGvnrEGR2 AirCtl_rGvnrTVA AirCtl_rGvnrTVA2 AirCtl_stEGT AirCtl_swtGvnr /end OUT_MEASUREMENT
/end FUNCTION
/begin FUNCTION airctl_governor_uic ""
 /begin OUT_MEASUREMENT AirCtl_facATParAdDKd_mp AirCtl_facATParAdIKi_mp AirCtl_facATParAdPKp_mp AirCtl_facNQParAdDKd_mp AirCtl_facNQParAdIKi_mp AirCtl_facNQParAdPKp_mp AirCtl_facNQParRgnAdDKd_mp AirCtl_facNQParRgnAdIKi_mp AirCtl_facNQParRgnAdPKp_mp AirCtl_facParAdDKd_mp AirCtl_facParAdIKi_mp AirCtl_facParAdPKp_mp AirCtl_facParAd_mp AirCtl_mGvnrDvt1_mp AirCtl_mGvnrDvtBase_mp AirCtl_rCtl_mp AirCtl_rEGRCtlAPSCor_mp AirCtl_rEGRCtlATCor_mp AirCtl_rEGRCtlBas_mp AirCtl_rEGRCtlCTCor_mp AirCtl_rEGRCtl_mp AirCtl_rGovEGRBas2_mp AirCtl_rGovEGRBas_mp AirCtl_rGovEGRRgn2_mp AirCtl_rGovEGRRgn_mp AirCtl_rOut2_mp AirCtl_rOutD_mp AirCtl_rOutGvnr2_mp AirCtl_rOutGvnr_mp AirCtl_rOutI2_mp AirCtl_rOutI_mp AirCtl_rOutP2_mp AirCtl_rOutP_mp AirCtl_rOut_mp AirCtl_stRgnSwt_mp /end OUT_MEASUREMENT
/end FUNCTION
/begin FUNCTION airctl_governor_var ""
 /begin DEF_CHARACTERISTIC AirCtl_facTVACtlATCor_CUR AirCtl_facTVACtlCTCor_CUR AirCtl_rGvnrTVAMax_C AirCtl_rGvnrTVAMin_C AirCtl_rTVABas_MAP AirCtl_rTVACtlAPSCor_CUR AirCtl_rTVACtlATCor_MAP AirCtl_rTVACtlBas_MAP AirCtl_rTVACtlCTCor_MAP AirCtl_rTVARgn_MAP AirCtl_stTVADel_C AirCtl_swtTVACtl_C AirCtl_tiTVADel_C /end DEF_CHARACTERISTIC
 /begin IN_MEASUREMENT AirCtl_rOutGvnr_mp APSCD_pVal CTSCD_tClnt Eng_nAvrg IATSCD_tAir InjCtl_qRaw /end IN_MEASUREMENT
/end FUNCTION
/begin FUNCTION airctl_governor_var_msg "" /end FUNCTION
/begin FUNCTION airctl_governor_var_uic ""
 /begin OUT_MEASUREMENT AirCtl_rGovTVABas2_mp AirCtl_rGovTVABas_mp AirCtl_rGovTVARgn2_mp AirCtl_rGovTVARgn_mp AirCtl_rTVACtlAPSCor_mp AirCtl_rTVACtlATCor_mp AirCtl_rTVACtlBas_mp AirCtl_rTVACtlCTCor_mp AirCtl_rTVACtl_mp /end OUT_MEASUREMENT
/end FUNCTION
/begin FUNCTION airctl_monitor "Abgasrückführregelung - Überwachung und Abschaltung"
 /begin DEF_CHARACTERISTIC AirCtl_dnSurgeHigh_CUR AirCtl_dnSurgeLow_CUR AirCtl_dqCurrRmpUp_C AirCtl_dqCurrRmpDwn_C AirCtl_dqRawInjMass_C AirCtl_drBrkRmpUp_C AirCtl_drBrkRmpDwn_C AirCtl_tiqRawDT1_C AirCtl_kdDT1qRaw_C AirCtl_mDiff_C AirCtl_nAvrgHHi_C AirCtl_nAvrgHLo_C AirCtl_nAvrgLHi_C AirCtl_nAvrgLLo_C AirCtl_nHealHi_C AirCtl_nHealLo_C AirCtl_nLim_C AirCtl_nLoIdl_C AirCtl_nOvrRun_C AirCtl_pAirHi_C AirCtl_pAirLo_C AirCtl_qDiff_C AirCtl_qGear_C AirCtl_qHealHi_C AirCtl_qHealLo_C AirCtl_qHiRgn_CUR AirCtl_qHi_CUR AirCtl_qLoRgn_CUR AirCtl_qLo_CUR AirCtl_qOvrRun_C AirCtl_qSurgeHigh_CUR AirCtl_qSurgeLow_CUR AirCtl_qUnBalLim_C AirCtl_rbrkDelta_C AirCtl_rBrkXHigh_C AirCtl_rBrkXLow_C AirCtl_rEGRDflVal12_C AirCtl_rEGRDflVal1_C AirCtl_rEGRDflVal4_C AirCtl_rEGRDflVal5_C AirCtl_rEGRDflVal7_C AirCtl_rEGRDflVal8_C AirCtl_stInhGvnrDvt_C AirCtl_stMskLoIdl_C AirCtl_stMskOvrRun_C AirCtl_stRgnAirCtlshOff_C AirCtl_stRgnCur_C AirCtl_stRgnShOff_C AirCtl_tiSurgePT1_C AirCtl_swtHighLoadCond_C AirCtl_swtHighOvrRunCond_C AirCtl_tAirHHi_C AirCtl_tAirHLo_C AirCtl_tAirLHi_C AirCtl_tAirLLo_C AirCtl_tClntCldHi_C AirCtl_tClntCldLo_C AirCtl_tClntWrmHi_C AirCtl_tClntWrmLo_C AirCtl_tiCldStrt_CUR AirCtl_tiClth_C AirCtl_tiMaxDef2_C AirCtl_tiMaxOk2_C AirCtl_DebGvnrDvtMaxDef_C AirCtl_DebGvnrDvtMaxOk_C AirCtl_tiMinDef2_C AirCtl_tiMinOk2_C AirCtl_DebGvnrDvtMinDef_C AirCtl_DebGvnrDvtMinOk_C AirCtl_tiDebPlateBrkDef_C AirCtl_tiDebPlateBrkOk_C AirCtl_tidqRawOn_C AirCtl_tiLoIdl_C AirCtl_tiOvrRun_C AirCtl_drTVA2SlpLimUp_C AirCtl_drTVA2SlpLimDown_C AirCtl_drTVASlpLimUp_C AirCtl_drTVASlpLimDown_C AirCtl_uBattThres_C AirCtl_vLim_C /end DEF_CHARACTERISTIC
 /begin IN_MEASUREMENT CTSCD_tClnt Eng_nAvrg /end IN_MEASUREMENT
/end FUNCTION
/begin FUNCTION airctl_monitor_msg ""
 /begin OUT_MEASUREMENT AirCtl_rEGR AirCtl_rEGR2 AirCtl_rTVA AirCtl_rTVA2 AirCtl_stAirCtl AirCtl_stAirCtlBits AirCtl_stMonitor /end OUT_MEASUREMENT
/end FUNCTION
/begin FUNCTION airctl_monitor_uic ""
 /begin DEF_CHARACTERISTIC AirCtl_rEGRAdd_Vector AirCtl_rEGRAdd_Channel AirCtl_rEGR_Vector AirCtl_rEGR_Channel AirCtl_rTVAAdd_Vector AirCtl_rTVAAdd_Channel AirCtl_rTVA_Vector AirCtl_rTVA_Channel /end DEF_CHARACTERISTIC
 /begin OUT_MEASUREMENT AirCtl_dnAvrg_mp AirCtl_dnSurgeHigh_mp AirCtl_dnSurgeLow_mp AirCtl_dqRaw_mp AirCtl_mMaxDvt_mp AirCtl_mMinDvt_mp AirCtl_qCurrRmp_mp AirCtl_qSurgeHigh_mp AirCtl_qSurgeLow_mp AirCtl_rBrkRmp_mp AirCtl_rEGRByp_mp AirCtl_rTVA2UnLim_mp AirCtl_rTVAByp_mp AirCtl_rTVAUnLim_mp AirCtl_stAirCtlBits1_mp AirCtl_stAirCtlBits2_mp AirCtl_stDebBrkpressed_mp AirCtl_stDebDef_mp AirCtl_stGearShiftHighLoad_mp AirCtl_stHealDef_mp AirCtl_stPlateBreak_mp AirCtl_tiStrtDel_mp /end OUT_MEASUREMENT
/end FUNCTION
/begin FUNCTION airctl_monitor_var ""
 /begin DEF_CHARACTERISTIC AirCtl_mMaxDvt_MAP AirCtl_mMinDvt_MAP AirCtl_rTVADflVal12_C AirCtl_rTVADflVal1_C AirCtl_rTVADflVal4_C AirCtl_rTVADflVal5_C AirCtl_rTVADflVal7_C AirCtl_rTVADflVal8_C /end DEF_CHARACTERISTIC
 /begin IN_MEASUREMENT Eng_nAvrg InjCtl_qCurrCor /end IN_MEASUREMENT
/end FUNCTION
/begin FUNCTION airctl_monitor_var_msg "" /end FUNCTION
/begin FUNCTION airctl_monitor_var_uic "" /end FUNCTION
/begin FUNCTION airsys_cotstdem_msg "" /begin OUT_MEASUREMENT AirSys_stTstDem /end OUT_MEASUREMENT /end FUNCTION
/begin FUNCTION alt "Generator"
 /begin DEF_CHARACTERISTIC Alt_facTrans_C Alt_pwrBas_CUR Alt_pwrOffs_C Alt_rAdjValDef_C Alt_rAdjValMax_C Alt_rAdjValMin_C /end DEF_CHARACTERISTIC
 /begin IN_MEASUREMENT Alt_n_mp /end IN_MEASUREMENT
/end FUNCTION
/begin FUNCTION altcd "Komponententreiber Generator"
 /begin DEF_CHARACTERISTIC AltCD_swtGenTyp_C AltCD_swtLROff_C AltCD_tiDebDefect_C AltCD_tiDebOk_C AltCD_tiLRMax_C AltCD_tiLRMin_C AltCD_tiOutput_C AltCD_tiReset_C AltCD_uAltMax_C AltCD_uAltMin_C /end DEF_CHARACTERISTIC
/end FUNCTION
/begin FUNCTION altcd_msg ""
 /begin OUT_MEASUREMENT AltCD_rAltLoad AltCD_stErrAlt AltCD_stGenManuFak AltCD_stGenTypKenn AltCD_uAlt /end OUT_MEASUREMENT
/end FUNCTION
/begin FUNCTION altcd_uic ""
 /begin OUT_MEASUREMENT AltCD_stAltCtl_mp AltCD_stLROff_mp AltCD_tiLR_mp AltCD_uAlt_mp /end OUT_MEASUREMENT
/end FUNCTION
/begin FUNCTION alt_msg "" /begin OUT_MEASUREMENT Alt_pwrDes Alt_pwrLead /end OUT_MEASUREMENT /end FUNCTION
/begin FUNCTION alt_uic "" /begin DEF_CHARACTERISTIC Alt_pwrDes_Vector Alt_pwrDes_Channel /end DEF_CHARACTERISTIC /begin OUT_MEASUREMENT Alt_n_mp Alt_pwrUnCor_mp Alt_rAdjVal_mp Alt_trqDes_mp /end OUT_MEASUREMENT /end FUNCTION
/begin FUNCTION alt_var "" /end FUNCTION
/begin FUNCTION alt_var_uic "" /end FUNCTION
/begin FUNCTION aoht "Zuheizer"
 /begin DEF_CHARACTERISTIC AOHt_nACEngXHigh_C AOHt_nACEngXLow_C AOHt_nDAEng_C AOHt_nMin_C AOHt_swtHtgUp_C AOHt_tEnvHysDelta_C AOHt_tEnv_CUR AOHt_tiACMin_C AOHt_tiDAMin_C AOHt_tiStrt_C AOHt_trqInrLimDelta_C AOHt_vDAVeh_C /end DEF_CHARACTERISTIC
 /begin IN_MEASUREMENT FrmMng_tEnv /end IN_MEASUREMENT
/end FUNCTION
/begin FUNCTION aohtcd "Zuheizer Komponententreiber"
 /begin DEF_CHARACTERISTIC AOHtCD_tiDebAOHtDia1Def_C AOHtCD_tiDebAOHtDia1Ok_C AOHtCD_tiDebAOHtDia2Def_C AOHtCD_tiDebAOHtDia2Ok_C AOHtCD_tiDebAOHtDia3Def_C AOHtCD_tiDebAOHtDia3Ok_C AOHtCD_tiDebExcTempDef_C AOHtCD_tiDebExcTempOk_C AOHtCD_tiDebNoLoadDef_C AOHtCD_tiDebNoLoadOk_C AOHtCD_tiDebPos_C AOHtCD_tiDebNeg_C AOHtCD_tiDebShortCircBatDef_C AOHtCD_tiDebShortCircBatOk_C AOHtCD_tiDebShortCircGndDef_C AOHtCD_tiDebShortCircGndOk_C AOHtCD_numDia_C AOHtCD_numDioIn_C AOHtCD_numPwmOut_C AOHtCD_stInvOut_C AOHtCD_tiPer_C AOHtCD_rOutMax_C AOHtCD_rOutMin_C AOHtCD_rTst_C AOHtCD_stPwrStgActv_C AOHtCD_stPwrStgDia_C AOHtCD_swtBattCorr_C AOHtCD_swtInv_C AOHtCD_tiBtwTst_C AOHtCD_tiDiag1Max_C AOHtCD_tiDiag1Min_C AOHtCD_tiDiag2Max_C AOHtCD_tiDiag2Min_C AOHtCD_tiDiag3Max_C AOHtCD_tiDiag3Min_C /end DEF_CHARACTERISTIC
/end FUNCTION
/begin FUNCTION aohtcd_msg "" /begin OUT_MEASUREMENT AOHtCD_stHtgReq /end OUT_MEASUREMENT /end FUNCTION
/begin FUNCTION aohtcd_uic "" /begin OUT_MEASUREMENT AOHtCD_rOut_mp /end OUT_MEASUREMENT /end FUNCTION
/begin FUNCTION aoht_msg "" /begin OUT_MEASUREMENT AOHt_nMin AOHt_rHtgOut AOHt_stHtgUp /end OUT_MEASUREMENT /end FUNCTION
/begin FUNCTION aoht_uic "" /begin DEF_CHARACTERISTIC AOHt_rHtgOut_Vector AOHt_rHtgOut_Channel /end DEF_CHARACTERISTIC /begin OUT_MEASUREMENT AOHt_stShutOff_mp AOHt_tEnvLin_mp /end OUT_MEASUREMENT /end FUNCTION
/begin FUNCTION appcd "Fahrpedal Komponententreiber"
 /begin DEF_CHARACTERISTIC APPCD_uAPP1_SRCMin_C APPCD_uAPP1_SRCMax_C APPCD_rLinAPP1_CUR APPCD_uAPP2_SRCMin_C APPCD_uAPP2_SRCMax_C APPCD_rLinAPP2_CUR APPCD_DebPlaDef_C APPCD_DebPlaOk_C APPCD_DebSRCHighDef_C APPCD_DebSRCHighOk_C APPCD_DebSRCLowDef_C APPCD_DebSRCLowOk_C APPCD_rThrFltFDCLowPos_C APPCD_rThrFltFDCMidPos_C APPCD_rThrFltFDCLowNeg_C APPCD_rThrFltFDCMidNeg_C APPCD_tiLowNegFDCPT1_C APPCD_tiLowNegPT1_C APPCD_tiLowPosFDCPT1_C APPCD_tiLowPosPT1_C APPCD_tiMidNegFDCPT1_C APPCD_tiMidNegPT1_C APPCD_tiMidPosFDCPT1_C APPCD_tiMidPosPT1_C APPCD_tiUppNegFDCPT1_C APPCD_tiUppNegPT1_C APPCD_tiUppPosFDCPT1_C APPCD_tiUppPosPT1_C APPCD_swtNoFlt_C APPCD_rThrFltLowPos_C APPCD_rThrFltMidPos_C APPCD_rThrFltLowNeg_C APPCD_rThrFltMidNeg_C APPCD_drHealRmpUp_C APPCD_drHealRmpDwn_C APPCD_numAdcAPP1_C APPCD_numAdcAPP2_C APPCD_uPlaWinIdle_C APPCD_uPlaWinPar_C APPCD_uPlaWinFull_C APPCD_rPlaWinLowIdleXHigh_C APPCD_rPlaWinLowIdleXLow_C APPCD_rPlaWinParLoadXHigh_C APPCD_rPlaWinParLoadXLow_C APPCD_SSpMonAPP1_C APPCD_SSpMonAPP2_C APPCD_stCfgAccPed_C APPCD_uKickDownHighAPP1_C APPCD_uKickDownHighAPP2_C APPCD_uKickDownLowAPP1_C APPCD_uKickDownLowAPP2_C /end DEF_CHARACTERISTIC
 /begin IN_MEASUREMENT APPCD_uRawAPP1 APPCD_uRawAPP2 /end IN_MEASUREMENT
/end FUNCTION
/begin FUNCTION appcd_msg ""
 /begin OUT_MEASUREMENT APPCD_drAPP1UnFlt APPCD_rAPP1 APPCD_rAPP1UnFlt APPCD_rFlt APPCD_rLinAPP1 APPCD_rLinAPP2 APPCD_stKickDown APPCD_uRawAPP1 APPCD_uRawAPP2 /end OUT_MEASUREMENT
/end FUNCTION
/begin FUNCTION appcd_uic ""
 /begin OUT_MEASUREMENT APPCD_SRCErrInfo_mp APPCD_stADCMonbit15RE_mp APPCD_stErr1_mp APPCD_u0PrcAPP1_mp APPCD_u0PrcAPP2_mp APPCD_uDiffMax_mp APPCD_uRawDiff_mp /end OUT_MEASUREMENT
/end FUNCTION
/begin FUNCTION applib "" /end FUNCTION
/begin FUNCTION apscd "Atmosphärendruckfühler Komponententreiber"
 /begin DEF_CHARACTERISTIC APSCD_uSRCMin_C APSCD_uSRCMax_C APSCD_pLin_CUR APSCD_DebNplDef_C APSCD_DebNplOk_C APSCD_DebSigDef_C APSCD_DebSigOk_C APSCD_DebSRCDef_C APSCD_DebSRCOk_C APSCD_nLimHigh_C APSCD_numAdc_C APSCD_pCor_MAP APSCD_dpRmpSlpUp_C APSCD_dpRmpSlpDwn_C APSCD_swtInst_C APSCD_swtSigVal_C APSCD_swtSrcpVal_C APSCD_tiDel_C APSCD_stSensIDWord_C APSCD_pDfl_C /end DEF_CHARACTERISTIC
 /begin IN_MEASUREMENT APSCD_uRaw Eng_dnAvrg Eng_nAvrg /end IN_MEASUREMENT
/end FUNCTION
/begin COMPU_METHOD AirMassPerCyl "Luftmasse pro Zylinder" RAT_FUNC "%6.3" "mg/Hub" COEFFS 0 10 0 0 0 1 /end COMPU_METHOD
/begin COMPU_METHOD AirMassPerTime "Luftmasse pro Zeit" RAT_FUNC "%6.3" "Kg/h" COEFFS 0 10 0 0 0 1 /end COMPU_METHOD
/begin COMPU_METHOD AngleGrad "Winkelanzeige in Grad" RAT_FUNC "%6.4" "Grad" COEFFS 0 22.7531285551763 0 0 0 1 /end COMPU_METHOD
/begin COMPU_METHOD AngleGradPerSec "Winkelanzeige in Grad pro Sekunde" RAT_FUNC "%6.4" "Grad/s" COEFFS 0 22.7531285551763 0 0 0 1 /end COMPU_METHOD
/begin COMPU_METHOD Can "Umrechnungsfaktor für CAN-bezogene Größen" RAT_FUNC "%6.5" "-" COEFFS 0 1000 0 0 0 1 /end COMPU_METHOD
/begin COMPU_METHOD dez "K3 Umwandlungen" RAT_FUNC "%6.2" "-" COEFFS 0 1 0 0 0 1 /end COMPU_METHOD
/begin COMPU_METHOD dm_dZ20 "air mass per time (dm/dt) every 20ms" RAT_FUNC "%6.2" "(Kg/h)/s" COEFFS 0 1 0 0 0 1 /end COMPU_METHOD
/begin COMPU_METHOD dn_dZ20 "Motorbeschleunigung pro Zeit (dn/dt) (im 20 ms Raster)" RAT_FUNC "%6.1" "rmp/s" COEFFS 0 0.1 0 0 0 1 /end COMPU_METHOD
/begin COMPU_METHOD DtyCyc "Tastverhaeltnis" RAT_FUNC "%6.4" "%" COEFFS 0 100 0 0 0 1 /end COMPU_METHOD
/begin COMPU_METHOD EngN "Motordrehzahl" RAT_FUNC "%6.2" "rpm" COEFFS 0 1 0 0 0 1 /end COMPU_METHOD
/begin COMPU_METHOD Fact "Faktor mit Auflösung 1 / 8192, hauptsächlich für einen Faktorenbereich 0...1 verwendet" RAT_FUNC "%6.5" "-" COEFFS 0 8192 0 0 0 1 /end COMPU_METHOD
/begin COMPU_METHOD Fact1 "Faktor mit Auflösung 0,01 (100 mal höherer Bereich als Fact)" RAT_FUNC "%6.4" "-" COEFFS 0 128 0 0 0 1 /end COMPU_METHOD
/begin COMPU_METHOD Fact2 "Faktor mit Auflösung 0.001, für einen Faktorenbereich 0...5,46117 verwendet" RAT_FUNC "%7.6" "-" COEFFS 0 16384 0 0 0 1 /end COMPU_METHOD
/begin COMPU_METHOD InjMass "Einspritzmenge" RAT_FUNC "%6.4" "mg/hub" COEFFS 0 100 0 0 0 1 /end COMPU_METHOD
/begin COMPU_METHOD InjMassCyc "Einspritzmenge pro Zyklus (mg/Zyklus)" RAT_FUNC "%6.4" "mg/cyc" COEFFS 0 100 0 0 0 1 /end COMPU_METHOD
/begin COMPU_METHOD InjMassPerSec_20ms "Einspritzmengenänderung pro Sekunde für 20ms-Tasks" RAT_FUNC "%6.3" "mg/hub/s" COEFFS 0 2 0 0 0 1 /end COMPU_METHOD
/begin COMPU_METHOD Kd "Differentialverstärkung Kd (gleiche Einheit/Umrechnungsformel an Ein- und Ausgang)" RAT_FUNC "%7.6" "1/1" COEFFS 0 65536 0 0 0 1 /end COMPU_METHOD
/begin COMPU_METHOD Kd_InjMass2Ampc "Differentialverstärkung Kd (Einspritzmenge InjMass zu Luftmasse pro Zyl. AirMassPerCyl)" RAT_FUNC "%6.5" "(mg/Hub Luft)/(mg/Hub)" COEFFS 0 6553.6 0 0 0 1 /end COMPU_METHOD
/begin COMPU_METHOD Kd_InjMass2Prc "Differentialverstärkung (Einspritzmasse zu Prozent)" RAT_FUNC "%7.6" "%/(mg/Hub)" COEFFS 0 53687.0912 0 0 0 1 /end COMPU_METHOD
/begin COMPU_METHOD Ki_Ampc2Prc "Integralverstärkung (Luftmasse pro Zyl. AirMassPerCyl zu Prozent Prc)" RAT_FUNC "%7.6" "%/(mg/Hub Luft)/s" COEFFS 0 35184.372088832 0 0 0 1 /end COMPU_METHOD
/begin COMPU_METHOD Kp_Ampc2Prc "Proportionalverstärkung (Luftmasse zu Prozent)" RAT_FUNC "%8.7" "%/(mg/Hub Luft)" COEFFS 0 536870.912 0 0 0 1 /end COMPU_METHOD
/begin COMPU_METHOD NumPinAdc "verbale Umrechnung für ADC Signale" TAB_VERB "%6.3" "-" COMPU_TAB_REF NumPinAdc /end COMPU_METHOD
/begin COMPU_VTAB NumPinAdc "verbale Umrechnung für ADC Signale" TAB_VERB 45 0 "Water_Temperature_Sensor_182" 1 "Intake_Air_Temperature_Sensor_157" 2 "Charge_Air_Temperature_Sensor_183" 3 "Exhaust_Temperature_Sensor_2_134" 4 "Exhaust_Temperature_Sensor_1_158" 5 "1st_APP_Sensor_252" 6 "2nd_APP_Sensor_239" 7 "ADC_REF" 8 "Boost_Pressure_Sensor_154" 9 "Atmospheric_Pressure_Sensor" 10 "Battery_Voltage_Sensor" 11 "Rail_Pressure_Sensor_156" 12 "Rail_Pressure_Peak_Value_156" 13 "Booster_Voltage_Sensor" 14 "Current_MeUn_Sensor" 15 "Current_PCV_Sensor" 16 "Voltage_Bank_1" 17 "Voltage_Bank_2" 18 "Pressure_Upstream_Particle_Filter_159" 19 "Engine_Oil_Pressure_110" 20 "Temperature_ECU_PCB" 21 "Voltage_Lambda_Ua" 22 "Voltage_Lambda_Ri" 23 "ADC_DUMMY_A_NOT_USED" 24 "ADC_DUMMY_NOT_USED" 25 "Charge_Actuator_Event_0" 26 "Voltage_Piezo_Actuator_Bank_2_Event_0" 27 "Voltage_Piezo_Actuator_Bank_1_Event_0" 28 "Charge_Actuator_Event_1" 29 "Voltage_Piezo_Actuator_Bank_2_Event_1" 30 "Voltage_Piezo_Actuator_Bank_1_Event_1" 31 "Charge_Actuator_Event_2" 32 "Voltage_Piezo_Actuator_Bank_2_Event_2" 33 "Voltage_Piezo_Actuator_Bank_1_Event_2" 34 "Charge_Actuator_Event_3" 35 "Voltage_Piezo_Actuator_Bank_2_Event_3" 36 "Voltage_Piezo_Actuator_Bank_1_Event_3" 37 "Charge_Actuator_Event_4" 38 "Voltage_Piezo_Actuator_Bank_2_Event_4" 39 "Voltage_Piezo_Actuator_Bank_1_Event_4" 40 "Charge_Actuator_Event_5" 41 "Voltage_Piezo_Actuator_Bank_2_Event_5" 42 "Voltage_Piezo_Actuator_Bank_1_Event_5" 43 "Booster_Voltage_Piezo" 44 "Piezo_Voltage" /end COMPU_VTAB
/begin COMPU_METHOD NumPinDia "Verbale Umrechnung für Diagnose Signale" TAB_VERB "%6.3" "-" COMPU_TAB_REF NumPinDia /end COMPU_METHOD
/begin COMPU_VTAB NumPinDia "Verbale Umrechnung für Diagnose Signale" TAB_VERB 35 0 "CJ945_Diagnostic_Signal" 1 "AC_Compressor_DiaSig" 2 "Fuel_Pump_DiaSig" 3 "Starter_234" 4 "Oil_Pressure_Lamp_Switch_245" 5 "Engine_Bay_Air_Flaps_123" 6 "Glow_Relay_Diagnostic_Signal1" 7 "reserved Glow_Relay_Diagnostic_Signal2" 8 "Ebox_Fan_Actuator_Diagnostic_Signal_219" 9 "Shuttr_Actuator_Diagnostic_Signal_231" 10 "Twostage_TurboLoading_SW_DiaSig" 11 "DIO_OUT_DIAGNOSTIC_DUMMY_NOT_USED" 12 "1st_Pressure_Control_Valve_Diagnostic_Signal_172" 13 "2nd_Pressure_Control_Valve_Diagnostic_Signal_172" 14 "1st_Metering_Unit_Diagnostic_Signal_171" 15 "2nd_Metering_Unit_Diagnostic_Signal_171" 16 "Boost_Pressure_Actuator_Diagnostic_Signal_193" 17 "Boost_Pressure_Actuator_Diagnostic_Signal_193_2" 18 "EGR_Actuator_Diagnostic_Signal_194" 19 "EGR_Actuator_Diagnostic_Signal2" 20 "Variable_Swirl_Actuator_Diagnostic_Signal_195" 21 "Throttle_Valve_Diagnostic_Signal_196" 22 "Throttle_Valve2_Diagnostic_Signal_196" 23 "FAN_240" 24 "Add_On_Heater_244" 25 "EngM_Bearing_Actuator_Diagnostic_Signal_124" 26 "EngM_Bearing_Actuator_Diagnostic_Signal_121" 27 "Low pressure stage BPA_Diagnostic_Signal_117" 28 "PWM_DIAGNOSTIC_DUMMY_NOT_USED" 29 "1st_Sensor_Supply_Voltage_DiaSig" 30 "2nd_Sensor_Supply_Voltage_DiaSig" 31 "3rd_Sensor_Supply_Voltage_DiaSig" 32 "4th_Sensor_Supply_Voltage_DiaSig" 33 "5th_Sensor_Supply_Voltage_DiaSig" 34 "6th_Sensor_Supply_Voltage_DiaSig" /end COMPU_VTAB
/begin COMPU_METHOD NumPinDioIn "Verbale Umrechnung für Digitaleingang Signale" TAB_VERB "%6.3" "-" COMPU_TAB_REF NumPinDioIn /end COMPU_METHOD
/begin COMPU_VTAB NumPinDioIn "Verbale Umrechnung für Digitaleingang Signale" TAB_VERB 15 0 "Terminal_15_207" 1 "Main_Brake_Switch_236" 2 "Redundant_Brake_Switch_223" 3 "Clutch_Switch" 4 "Terminal_50_224" 5 "ECU_selection_Switch_251" 6 "FlFlt_Switch_211" 7 "Coolant-heater_212" 8 "Redundant_Terminal_15_209(118)" 9 "AC-compressor_overboost_213" 10 "Additive_tank_level_switch_235" 11 "Terminal_61_113" 12 "Lambda_Regeneration" 13 "OilLevelSensor_138" 14 "DIO_IN_DUMMY_NOT_USED" /end COMPU_VTAB
/begin COMPU_METHOD NumPinPwmOut "Verbale Umrechnung für PWM-Ausgang Signale" TAB_VERB "%6.3" "-" COMPU_TAB_REF NumPinPwmOut /end COMPU_METHOD
/begin COMPU_VTAB NumPinPwmOut "Verbale Umrechnung für PWM-Ausgang Signale" TAB_VERB 13 0 "Boost_Pressure_Actuator_193" 1 "EGR_Actuator_194" 2 "PCV_Actuator_172" 3 "MeUn_Actuator_171" 4 "Variable_Swirl_Actuator_195" 5 "Fan_Actuator_240" 6 "Add_On_Heater_244" 7 "EngM_Bearing_Actuator_124" 8 "EngM_Bearing_Actuator_121" 9 "Throttle Valve" 10 "LSU_Heater_PWMOutput" 11 "Low pressure stage BPA_117" 12 "PWM_DUMMY_NOT_USED" /end COMPU_VTAB
/begin COMPU_METHOD OneToOne "eins zu eins (physikalischer Wert ist gleich dem internen Wert)" RAT_FUNC "%6.2" "-" COEFFS 0 1 0 0 0 1 /end COMPU_METHOD
/begin COMPU_METHOD Period "Periodendauer" RAT_FUNC "%6.3" "ms" COEFFS 0 10 0 0 0 1 /end COMPU_METHOD
/begin COMPU_METHOD Prc "Prozent, gleiche interne Auflösung wie Fact, aber Darstellung in Prozent (0...100%)" RAT_FUNC "%6.4" "%" COEFFS 0 81.92 0 0 0 1 /end COMPU_METHOD
/begin COMPU_METHOD PrcPerSec "Prozentänderung pro Sekunde für 20ms-Tasks" RAT_FUNC "%6.3" "%/s" COEFFS 0 1.6384 0 0 0 1 /end COMPU_METHOD
/begin COMPU_METHOD Pres_hPa "Druck (angezeigt in [hPa])" RAT_FUNC "%6.2" "hPa" COEFFS 0 1 0 0 0 1 /end COMPU_METHOD
/begin COMPU_METHOD Pwr "Leistung" RAT_FUNC "%6.2" "W" COEFFS 0 0.10610329539459 0 0 0 1 /end COMPU_METHOD
/begin COMPU_METHOD RmpAirMassPerCyl "Rampengradient für Luftmasse pro Zylinder" RAT_FUNC "%6.4" "(mg/Hub)/s" COEFFS 0 655.36 0 0 0 1 /end COMPU_METHOD
/begin COMPU_METHOD RmpInjMass "Rampengradient für Einspritzmenge" RAT_FUNC "%6.5" "(mg/stroke)/s" COEFFS 0 6553.6 0 0 0 1 /end COMPU_METHOD
/begin COMPU_METHOD RmpPrc "Prozent Rampengradient" RAT_FUNC "%6.5" "%/s" COEFFS 0 5368.70912 0 0 0 1 /end COMPU_METHOD
/begin COMPU_METHOD RmpPres_hPa "Rampengradient für Druck angezeigt in [hPa/s]" RAT_FUNC "%6.4" "hPa/s" COEFFS 0 65.536 0 0 0 1 /end COMPU_METHOD
/begin COMPU_METHOD Rmp_1 "Rampe für EGT" RAT_FUNC "%6.5" "1/s" COEFFS 0 1000 0 0 0 1 /end COMPU_METHOD
/begin COMPU_METHOD TempCels_100ms "Temperatur Differenz in Grad C/sec (bezgl. 100ms task)" RAT_FUNC "%6.2" "deg C/s" COEFFS 0 1 0 0 0 1 /end COMPU_METHOD
/begin COMPU_METHOD TempDiff_Cels "difference/offset temperature displayed in degree celcius" RAT_FUNC "%6.3" "deg C" COEFFS 0 10 0 0 0 1 /end COMPU_METHOD
/begin COMPU_METHOD Temp_Cels "Temperatur dargestellt in °C (gleiche interne Darstellung wie Temp_Kelv)" RAT_FUNC "%6.1" "deg C" COEFFS 0 10 2731.4 0 0 1 /end COMPU_METHOD
/begin COMPU_METHOD TimeDeb "Entprellzeit in Millisekunden für Libraryfunktion Debounce" RAT_FUNC "%6.1" "ms" COEFFS 0 0.1 0 0 0 1 /end COMPU_METHOD
/begin COMPU_METHOD TimeDelay_ms "Zeitkonstante T1 fuer die Bibliotheksfunktionen PT1, DT1, etc.,  in ms angegeben" RAT_FUNC "%9.0" "ms" COEFFS 0 0 1 0 2.3283064365387e-07 0 /end COMPU_METHOD
/begin COMPU_METHOD TimeDelay_s "Zeitkonstante T1 (in s) für PT1, DT1, etc." RAT_FUNC "%9.3" "s" COEFFS 0 0 1 0 0.00023283064365387 0 /end COMPU_METHOD
/begin COMPU_METHOD Time_ms "Zeit in ms für Fehlerentprellung (DSM) und SW-Timer" RAT_FUNC "%6.1" "ms" COEFFS 0 0.1 0 0 0 1 /end COMPU_METHOD
/begin COMPU_METHOD Time_PwmHigh "Periodenzeit von der HWE (Tio_PwmGetAvrg)" RAT_FUNC "%6.3" "us" COEFFS 0 10 0 0 0 1 /end COMPU_METHOD
/begin COMPU_METHOD Time_s "Zeit in s für Fehlerentprellung (DSM) und SW-Timer" RAT_FUNC "%6.4" "s" COEFFS 0 100 0 0 0 1 /end COMPU_METHOD
/begin COMPU_METHOD TransR "Übersetzungsverhältnis (Getriebe etc.)" RAT_FUNC "%6.4" "-" COEFFS 0 100 0 0 0 1 /end COMPU_METHOD
/begin COMPU_METHOD Trq "Motormoment" RAT_FUNC "%6.3" "Nm" COEFFS 0 10 0 0 0 1 /end COMPU_METHOD
/begin COMPU_METHOD Vel "Fahrzeuggeschwindigkeit, gleiche interne Auflösung wie Vel_SI" RAT_FUNC "%6.4" "km/h" COEFFS 0 100 0 0 0 1 /end COMPU_METHOD
/begin COMPU_METHOD Volt "Spannung in V (von ADC)" RAT_FUNC "%6.2" "mV" COEFFS 0 0.2046 0 0 0 1 /end COMPU_METHOD
/begin COMPU_METHOD Volt_Batt "Batteriespannung" RAT_FUNC "%6.1" "mV" COEFFS 0 0.05115 0 0 0 1 /end COMPU_METHOD
/begin RECORD_LAYOUT Kf_Xs16_Ys16_Ws16 NO_AXIS_PTS_X 1 SWORD NO_AXIS_PTS_Y 2 SWORD AXIS_PTS_X 3 SWORD INDEX_INCR DIRECT AXIS_PTS_Y 4 SWORD INDEX_INCR DIRECT FNC_VALUES 5 SWORD COLUMN_DIR DIRECT /end RECORD_LAYOUT
/begin RECORD_LAYOUT Kl_Xs16_Ws16 NO_AXIS_PTS_X 1 SWORD AXIS_PTS_X 2 SWORD INDEX_INCR DIRECT FNC_VALUES 3 SWORD COLUMN_DIR DIRECT /end RECORD_LAYOUT
/begin RECORD_LAYOUT Kw_Ws16 FNC_VALUES 1 SWORD COLUMN_DIR DIRECT /end RECORD_LAYOUT
/begin RECORD_LAYOUT Kw_Ws32 FNC_VALUES 1 SLONG COLUMN_DIR DIRECT /end RECORD_LAYOUT
/begin RECORD_LAYOUT Kw_Wu16 FNC_VALUES 1 UWORD COLUMN_DIR DIRECT /end RECORD_LAYOUT
/begin RECORD_LAYOUT Kw_Wu32 FNC_VALUES 1 ULONG COLUMN_DIR DIRECT /end RECORD_LAYOUT
/begin RECORD_LAYOUT Kw_Wu8 FNC_VALUES 1 UBYTE COLUMN_DIR DIRECT /end RECORD_LAYOUT
/end MODULE
/end PROJECT
