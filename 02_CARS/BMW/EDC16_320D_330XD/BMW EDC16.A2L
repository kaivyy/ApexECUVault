ASAP2_VERSION 1 3
/begin PROJECT P383 "BMW DDE6.3 8-Zylinder V9E.3 11.10.2004 CAN12H"
/begin HEADER "" VERSION "V9E.3_8Z_CAN12H" PROJECT_NO P383 /end HEADER
/begin MODULE DIM ""
/begin MOD_COMMON "" BYTE_ORDER MSB_FIRST ALIGNMENT_BYTE 1 ALIGNMENT_WORD 2 ALIGNMENT_LONG 4 ALIGNMENT_FLOAT32_IEEE 4 /end MOD_COMMON
/begin CHARACTERISTIC DSM_CDCDfp_Layer_TANS_C "CARB spezifischer Fehlercode fuer Fehlerpfad Dfp_Layer_TANS" VAL_BLK 0xCB404 Kwb_Wu16 65535.00 OneToOne 0.00 65535.00 FORMAT "%8.2" NUMBER 4 /end CHARACTERISTIC
/begin CHARACTERISTIC DSM_CDCDfp_ACCDSwtin_C "CARB spezifischer Fehlercode fuer Fehlerpfad Dfp_ACCDSwtin" VAL_BLK 0xCB40C Kwb_Wu16 65535.00 OneToOne 0.00 65535.00 FORMAT "%8.2" NUMBER 4 /end CHARACTERISTIC
/begin CHARACTERISTIC DSM_CDCDfp_ACC_PlausTrqDes_C "CARB spezifischer Fehlercode fuer Fehlerpfad Dfp_ACC_PlausTrqDes" VAL_BLK 0xCB414 Kwb_Wu16 65535.00 OneToOne 0.00 65535.00 FORMAT "%8.2" NUMBER 4 /end CHARACTERISTIC
/begin CHARACTERISTIC DSM_CDCDfp_ACC_trqInr_C "CARB spezifischer Fehlercode fuer Fehlerpfad Dfp_ACC_trqInr" VAL_BLK 0xCB41C Kwb_Wu16 65535.00 OneToOne 0.00 65535.00 FORMAT "%8.2" NUMBER 4 /end CHARACTERISTIC
/begin CHARACTERISTIC DSM_CDCDfp_ACTrq_C "CARB spezifischer Fehlercode fuer Fehlerpfad Dfp_ACTrq" VAL_BLK 0xCB424 Kwb_Wu16 65535.00 OneToOne 0.00 65535.00 FORMAT "%8.2" NUMBER 4 /end CHARACTERISTIC
/begin CHARACTERISTIC DSM_CDCDfp_ADCMon_C "CARB spezifischer Fehlercode fuer Fehlerpfad Dfp_ADCMon" VAL_BLK 0xCB42C Kwb_Wu16 65535.00 OneToOne 0.00 65535.00 FORMAT "%8.2" NUMBER 4 /end CHARACTERISTIC
/begin CHARACTERISTIC DSM_CDCDfp_AFSCDIdlAdjVal_C "CARB spezifischer Fehlercode fuer Fehlerpfad Dfp_AFSCDIdlAdjVal" VAL_BLK 0xCB434 Kwb_Wu16 65535.00 OneToOne 0.00 65535.00 FORMAT "%8.2" NUMBER 4 /end CHARACTERISTIC
/begin CHARACTERISTIC DSM_CDCDfp_AFSCDLdAdjVal_C "CARB spezifischer Fehlercode fuer Fehlerpfad Dfp_AFSCDLdAdjVal" VAL_BLK 0xCB43C Kwb_Wu16 65535.00 OneToOne 0.00 65535.00 FORMAT "%8.2" NUMBER 4 /end CHARACTERISTIC
/begin CHARACTERISTIC DSM_CDCDfp_AFSCDPlAirPerCylDif_C "CARB spezifischer Fehlercode fuer Fehlerpfad Dfp_AFSCDPlAirPerCylDif" VAL_BLK 0xCB444 Kwb_Wu16 65535.00 OneToOne 0.00 65535.00 FORMAT "%8.2" NUMBER 4 /end CHARACTERISTIC
/begin CHARACTERISTIC DSM_CDCDfp_AFSCD_AirTempDcyc_C "CARB spezifischer Fehlercode fuer Fehlerpfad Dfp_AFSCD_AirTempDcyc" VAL_BLK 0xCB44C Kwb_Wu16 65535.00 OneToOne 0.00 65535.00 FORMAT "%8.2" NUMBER 4 /end CHARACTERISTIC
/begin CHARACTERISTIC DSM_CDCDfp_AFSCD_AirTempDcyc2_C "CARB spezifischer Fehlercode fuer Fehlerpfad Dfp_AFSCD_AirTempDcyc2" VAL_BLK 0xCB454 Kwb_Wu16 65535.00 OneToOne 0.00 65535.00 FORMAT "%8.2" NUMBER 4 /end CHARACTERISTIC
/begin CHARACTERISTIC DSM_CDCDfp_AFSCD_PlOffsDrft_C "CARB spezifischer Fehlercode fuer Fehlerpfad Dfp_AFSCD_PlOffsDrft" VAL_BLK 0xCB45C Kwb_Wu16 65535.00 OneToOne 0.00 65535.00 FORMAT "%8.2" NUMBER 4 /end CHARACTERISTIC
/begin CHARACTERISTIC DSM_CDCDfp_AFSCD_PlOffsDrft2_C "CARB spezifischer Fehlercode fuer Fehlerpfad Dfp_AFSCD_PlOffsDrft2" VAL_BLK 0xCB464 Kwb_Wu16 65535.00 OneToOne 0.00 65535.00 FORMAT "%8.2" NUMBER 4 /end CHARACTERISTIC
/begin CHARACTERISTIC DSM_CDCDfp_AFSCD_PlSetyDrft_C "CARB spezifischer Fehlercode fuer Fehlerpfad Dfp_AFSCD_PlSetyDrft" VAL_BLK 0xCB46C Kwb_Wu16 65535.00 OneToOne 0.00 65535.00 FORMAT "%8.2" NUMBER 4 /end CHARACTERISTIC
/begin CHARACTERISTIC DSM_CDCDfp_AFSCD_SRCAirTemp_C "CARB spezifischer Fehlercode fuer Fehlerpfad Dfp_AFSCD_SRCAirTemp" VAL_BLK 0xCB474 Kwb_Wu16 65535.00 OneToOne 0.00 65535.00 FORMAT "%8.2" NUMBER 4 /end CHARACTERISTIC
/begin CHARACTERISTIC DSM_CDCDfp_AFSCD_SRCAirTemp2_C "CARB spezifischer Fehlercode fuer Fehlerpfad Dfp_AFSCD_SRCAirTemp2" VAL_BLK 0xCB47C Kwb_Wu16 65535.00 OneToOne 0.00 65535.00 FORMAT "%8.2" NUMBER 4 /end CHARACTERISTIC
/begin CHARACTERISTIC DSM_CDCDfp_AFSCD_SRCBatt_C "CARB spezifischer Fehlercode fuer Fehlerpfad Dfp_AFSCD_SRCBatt" VAL_BLK 0xCB484 Kwb_Wu16 65535.00 OneToOne 0.00 65535.00 FORMAT "%8.2" NUMBER 4 /end CHARACTERISTIC
/begin CHARACTERISTIC DSM_CDCDfp_AFSCD_SRCBatt2_C "CARB spezifischer Fehlercode fuer Fehlerpfad Dfp_AFSCD_SRCBatt2" VAL_BLK 0xCB48C Kwb_Wu16 65535.00 OneToOne 0.00 65535.00 FORMAT "%8.2" NUMBER 4 /end CHARACTERISTIC
/begin CHARACTERISTIC DSM_CDCDfp_AFSCD_SRCCorrAirm_C "CARB spezifischer Fehlercode fuer Fehlerpfad Dfp_AFSCD_SRCCorrAirm" VAL_BLK 0xCB494 Kwb_Wu16 65535.00 OneToOne 0.00 65535.00 FORMAT "%8.2" NUMBER 4 /end CHARACTERISTIC
/begin CHARACTERISTIC DSM_CDCDfp_Layer_TUMG_C "CARB spezifischer Fehlercode fuer Fehlerpfad Dfp_Layer_TUMG" VAL_BLK 0xCB49C Kwb_Wu16 65535.00 OneToOne 0.00 65535.00 FORMAT "%8.2" NUMBER 4 /end CHARACTERISTIC
/begin CHARACTERISTIC DSM_CDCDfp_AFSCD_SRCCorrAirm2_C "CARB spezifischer Fehlercode fuer Fehlerpfad Dfp_AFSCD_SRCCorrAirm2" VAL_BLK 0xCB4A4 Kwb_Wu16 65535.00 OneToOne 0.00 65535.00 FORMAT "%8.2" NUMBER 4 /end CHARACTERISTIC
/begin CHARACTERISTIC DSM_CDCDfp_AFSCD_SRCRawAirm_C "CARB spezifischer Fehlercode fuer Fehlerpfad Dfp_AFSCD_SRCRawAirm" VAL_BLK 0xCB4AC Kwb_Wu16 65535.00 OneToOne 0.00 65535.00 FORMAT "%8.2" NUMBER 4 /end CHARACTERISTIC
/begin CHARACTERISTIC DSM_CDCDfp_Layer_GEN_C "CARB spezifischer Fehlercode fuer Fehlerpfad Dfp_Layer_GEN" VAL_BLK 0xCB4B4 Kwb_Wu16 65535.00 OneToOne 0.00 65535.00 FORMAT "%8.2" NUMBER 4 /end CHARACTERISTIC
/begin CHARACTERISTIC DSM_CDCDfp_Layer_BSD_C "CARB spezifischer Fehlercode fuer Fehlerpfad Dfp_Layer_BSD" VAL_BLK 0xCB4BC Kwb_Wu16 65535.00 OneToOne 0.00 65535.00 FORMAT "%8.2" NUMBER 4 /end CHARACTERISTIC
/begin CHARACTERISTIC DSM_CDCDfp_AFSCD_SRCRawAirm2_C "CARB spezifischer Fehlercode fuer Fehlerpfad Dfp_AFSCD_SRCRawAirm2" VAL_BLK 0xCB4C4 Kwb_Wu16 65535.00 OneToOne 0.00 65535.00 FORMAT "%8.2" NUMBER 4 /end CHARACTERISTIC
/begin CHARACTERISTIC DSM_CDCDfp_AFSCD_SRCRefSigPer_C "CARB spezifischer Fehlercode fuer Fehlerpfad Dfp_AFSCD_SRCRefSigPer" VAL_BLK 0xCB4CC Kwb_Wu16 65535.00 OneToOne 0.00 65535.00 FORMAT "%8.2" NUMBER 4 /end CHARACTERISTIC
/begin CHARACTERISTIC DSM_CDCDfp_AFSCD_SRCRefSigPer2_C "CARB spezifischer Fehlercode fuer Fehlerpfad Dfp_AFSCD_SRCRefSigPer2" VAL_BLK 0xCB4D4 Kwb_Wu16 65535.00 OneToOne 0.00 65535.00 FORMAT "%8.2" NUMBER 4 /end CHARACTERISTIC
/begin CHARACTERISTIC DSM_CDCDfp_AOHtCD_C "CARB spezifischer Fehlercode fuer Fehlerpfad Dfp_AOHtCD" VAL_BLK 0xCB4DC Kwb_Wu16 65535.00 OneToOne 0.00 65535.00 FORMAT "%8.2" NUMBER 4 /end CHARACTERISTIC
/begin CHARACTERISTIC DSM_CDCDfp_AOHtCD_AOHtDia1_C "CARB spezifischer Fehlercode fuer Fehlerpfad Dfp_AOHtCD_AOHtDia1" VAL_BLK 0xCB4E4 Kwb_Wu16 65535.00 OneToOne 0.00 65535.00 FORMAT "%8.2" NUMBER 4 /end CHARACTERISTIC
/begin CHARACTERISTIC DSM_CDCDfp_AOHtCD_AOHtDia2_C "CARB spezifischer Fehlercode fuer Fehlerpfad Dfp_AOHtCD_AOHtDia2" VAL_BLK 0xCB4EC Kwb_Wu16 65535.00 OneToOne 0.00 65535.00 FORMAT "%8.2" NUMBER 4 /end CHARACTERISTIC
/begin CHARACTERISTIC DSM_CDCDfp_AOHtCD_AOHtDia3_C "CARB spezifischer Fehlercode fuer Fehlerpfad Dfp_AOHtCD_AOHtDia3" VAL_BLK 0xCB4F4 Kwb_Wu16 65535.00 OneToOne 0.00 65535.00 FORMAT "%8.2" NUMBER 4 /end CHARACTERISTIC
/begin CHARACTERISTIC DSM_CDCDfp_APP1_C "CARB spezifischer Fehlercode fuer Fehlerpfad Dfp_APP1" VAL_BLK 0xCB4FC Kwb_Wu16 65535.00 OneToOne 0.00 65535.00 FORMAT "%8.2" NUMBER 4 /end CHARACTERISTIC
/begin CHARACTERISTIC DSM_CDCDfp_APP2_C "CARB spezifischer Fehlercode fuer Fehlerpfad Dfp_APP2" VAL_BLK 0xCB504 Kwb_Wu16 65535.00 OneToOne 0.00 65535.00 FORMAT "%8.2" NUMBER 4 /end CHARACTERISTIC
/begin CHARACTERISTIC DSM_CDCDfp_APPCDCmpd_C "CARB spezifischer Fehlercode fuer Fehlerpfad Dfp_APPCDCmpd" VAL_BLK 0xCB50C Kwb_Wu16 65535.00 OneToOne 0.00 65535.00 FORMAT "%8.2" NUMBER 4 /end CHARACTERISTIC
/begin CHARACTERISTIC DSM_CDCDfp_Layer_QLT_C "CARB spezifischer Fehlercode fuer Fehlerpfad Dfp_Layer_QLT" VAL_BLK 0xCB514 Kwb_Wu16 65535.00 OneToOne 0.00 65535.00 FORMAT "%8.2" NUMBER 4 /end CHARACTERISTIC
/begin CHARACTERISTIC DSM_CDCDfp_APPSync_C "CARB spezifischer Fehlercode fuer Fehlerpfad Dfp_APPSync" VAL_BLK 0xCB51C Kwb_Wu16 65535.00 OneToOne 0.00 65535.00 FORMAT "%8.2" NUMBER 4 /end CHARACTERISTIC
/begin CHARACTERISTIC DSM_CDCDfp_Layer_IBS1_C "CARB spezifischer Fehlercode fuer Fehlerpfad Dfp_Layer_IBS1" VAL_BLK 0xCB524 Kwb_Wu16 65535.00 OneToOne 0.00 65535.00 FORMAT "%8.2" NUMBER 4 /end CHARACTERISTIC
/begin CHARACTERISTIC DSM_CDCDfp_Layer_IBS2_C "CARB spezifischer Fehlercode fuer Fehlerpfad Dfp_Layer_IBS2" VAL_BLK 0xCB52C Kwb_Wu16 65535.00 OneToOne 0.00 65535.00 FORMAT "%8.2" NUMBER 4 /end CHARACTERISTIC
/begin CHARACTERISTIC DSM_CDCDfp_Layer_IBS3_C "CARB spezifischer Fehlercode fuer Fehlerpfad Dfp_Layer_IBS3" VAL_BLK 0xCB534 Kwb_Wu16 65535.00 OneToOne 0.00 65535.00 FORMAT "%8.2" NUMBER 4 /end CHARACTERISTIC
/begin CHARACTERISTIC DSM_CDCDfp_Layer_PMBN_C "CARB spezifischer Fehlercode fuer Fehlerpfad Dfp_Layer_PMBN" VAL_BLK 0xCB53C Kwb_Wu16 65535.00 OneToOne 0.00 65535.00 FORMAT "%8.2" NUMBER 4 /end CHARACTERISTIC
/begin CHARACTERISTIC DSM_CDCDfp_Layer_PMBATT_C "CARB spezifischer Fehlercode fuer Fehlerpfad Dfp_Layer_PMBATT" VAL_BLK 0xCB544 Kwb_Wu16 65535.00 OneToOne 0.00 65535.00 FORMAT "%8.2" NUMBER 4 /end CHARACTERISTIC
/begin CHARACTERISTIC DSM_CDCDfp_APSCD_C "CARB spezifischer Fehlercode fuer Fehlerpfad Dfp_APSCD" VAL_BLK 0xCB54C Kwb_Wu16 65535.00 OneToOne 0.00 65535.00 FORMAT "%8.2" NUMBER 4 /end CHARACTERISTIC
/begin CHARACTERISTIC DSM_CDCDfp_ARS_C "CARB spezifischer Fehlercode fuer Fehlerpfad Dfp_ARS" VAL_BLK 0xCB554 Kwb_Wu16 65535.00 OneToOne 0.00 65535.00 FORMAT "%8.2" NUMBER 4 /end CHARACTERISTIC
/begin CHARACTERISTIC DSM_CDCDfp_AccPedPlausBrk_C "CARB spezifischer Fehlercode fuer Fehlerpfad Dfp_AccPedPlausBrk" VAL_BLK 0xCB55C Kwb_Wu16 65535.00 OneToOne 0.00 65535.00 FORMAT "%8.2" NUMBER 4 /end CHARACTERISTIC
/begin CHARACTERISTIC DSM_CDCDfp_AddPCDTnkLvl_C "CARB spezifischer Fehlercode fuer Fehlerpfad Dfp_AddPCDTnkLvl" VAL_BLK 0xCB564 Kwb_Wu16 65535.00 OneToOne 0.00 65535.00 FORMAT "%8.2" NUMBER 4 /end CHARACTERISTIC
/begin CHARACTERISTIC DSM_CDCDfp_AirCtlGvnrDvtRgnMax_C "CARB spezifischer Fehlercode fuer Fehlerpfad Dfp_AirCtlGvnrDvtRgnMax" VAL_BLK 0xCB56C Kwb_Wu16 65535.00 OneToOne 0.00 65535.00 FORMAT "%8.2" NUMBER 4 /end CHARACTERISTIC
/begin CHARACTERISTIC DSM_CDCDfp_AirCtlGvnrDvtRgnMin_C "CARB spezifischer Fehlercode fuer Fehlerpfad Dfp_AirCtlGvnrDvtRgnMin" VAL_BLK 0xCB574 Kwb_Wu16 65535.00 OneToOne 0.00 65535.00 FORMAT "%8.2" NUMBER 4 /end CHARACTERISTIC
/begin CHARACTERISTIC DSM_CDCDfp_AirCtlGvnrDvtRgnMn2_C "CARB spezifischer Fehlercode fuer Fehlerpfad Dfp_AirCtlGvnrDvtRgnMn2" VAL_BLK 0xCB57C Kwb_Wu16 65535.00 OneToOne 0.00 65535.00 FORMAT "%8.2" NUMBER 4 /end CHARACTERISTIC
/begin CHARACTERISTIC DSM_CDCDfp_AirCtlGvnrDvtRgnMx2_C "CARB spezifischer Fehlercode fuer Fehlerpfad Dfp_AirCtlGvnrDvtRgnMx2" VAL_BLK 0xCB584 Kwb_Wu16 65535.00 OneToOne 0.00 65535.00 FORMAT "%8.2" NUMBER 4 /end CHARACTERISTIC
/begin CHARACTERISTIC DSM_CDCDfp_AirCtlPlateBreak_C "DSM variable for Dfp_AirCtlPlateBreak_mp" VAL_BLK 0xCB58C Kwb_Wu16 65535.00 OneToOne 0.00 65535.00 FORMAT "%8.2" NUMBER 4 /end CHARACTERISTIC
/begin CHARACTERISTIC DSM_CDCDfp_AirCtlRmpTO_C "CARB spezifischer Fehlercode fuer Fehlerpfad Dfp_AirCtlRmpTO" VAL_BLK 0xCB594 Kwb_Wu16 65535.00 OneToOne 0.00 65535.00 FORMAT "%8.2" NUMBER 4 /end CHARACTERISTIC
/begin CHARACTERISTIC DSM_CDCDfp_AirCtl_GovNegDev_C "CARB spezifischer Fehlercode fuer Fehlerpfad Dfp_AirCtl_GovNegDev" VAL_BLK 0xCB59C Kwb_Wu16 65535.00 OneToOne 0.00 65535.00 FORMAT "%8.2" NUMBER 4 /end CHARACTERISTIC
/begin CHARACTERISTIC DSM_CDCDfp_AirCtl_GovNegDev2_C "CARB spezifischer Fehlercode fuer Fehlerpfad Dfp_AirCtl_GovNegDev2" VAL_BLK 0xCB5A4 Kwb_Wu16 65535.00 OneToOne 0.00 65535.00 FORMAT "%8.2" NUMBER 4 /end CHARACTERISTIC
/begin CHARACTERISTIC DSM_CDCDfp_AirCtl_GovPosDev_C "CARB spezifischer Fehlercode fuer Fehlerpfad Dfp_AirCtl_GovPosDev" VAL_BLK 0xCB5AC Kwb_Wu16 65535.00 OneToOne 0.00 65535.00 FORMAT "%8.2" NUMBER 4 /end CHARACTERISTIC
/begin CHARACTERISTIC DSM_CDCDfp_AirCtl_GovPosDev2_C "CARB spezifischer Fehlercode fuer Fehlerpfad Dfp_AirCtl_GovPosDev2" VAL_BLK 0xCB5B4 Kwb_Wu16 65535.00 OneToOne 0.00 65535.00 FORMAT "%8.2" NUMBER 4 /end CHARACTERISTIC
/begin CHARACTERISTIC DSM_CDCDfp_AltCD_C "CARB spezifischer Fehlercode fuer Fehlerpfad Dfp_AltCD" VAL_BLK 0xCB5BC Kwb_Wu16 65535.00 OneToOne 0.00 65535.00 FORMAT "%8.2" NUMBER 4 /end CHARACTERISTIC
/begin CHARACTERISTIC DSM_CDCDfp_BPACD_BPADia1_C "CARB spezifischer Fehlercode fuer Fehlerpfad Dfp_BPACD_BPADia1" VAL_BLK 0xCB5C4 Kwb_Wu16 65535.00 OneToOne 0.00 65535.00 FORMAT "%8.2" NUMBER 4 /end CHARACTERISTIC
/begin CHARACTERISTIC DSM_CDCDfp_BPACD_BPADia1v2_C "CARB spezifischer Fehlercode fuer Fehlerpfad Dfp_BPACD_BPADia1v2" VAL_BLK 0xCB5CC Kwb_Wu16 65535.00 OneToOne 0.00 65535.00 FORMAT "%8.2" NUMBER 4 /end CHARACTERISTIC
/begin CHARACTERISTIC DSM_CDCDfp_BPACD_BPADia2_C "CARB spezifischer Fehlercode fuer Fehlerpfad Dfp_BPACD_BPADia2" VAL_BLK 0xCB5D4 Kwb_Wu16 65535.00 OneToOne 0.00 65535.00 FORMAT "%8.2" NUMBER 4 /end CHARACTERISTIC
/begin CHARACTERISTIC DSM_CDCDfp_BPACD_BPADia2v2_C "CARB spezifischer Fehlercode fuer Fehlerpfad Dfp_BPACD_BPADia2v2" VAL_BLK 0xCB5DC Kwb_Wu16 65535.00 OneToOne 0.00 65535.00 FORMAT "%8.2" NUMBER 4 /end CHARACTERISTIC
/begin CHARACTERISTIC DSM_CDCDfp_BPACD_BPADia3_C "CARB spezifischer Fehlercode fuer Fehlerpfad Dfp_BPACD_BPADia3" VAL_BLK 0xCB5E4 Kwb_Wu16 65535.00 OneToOne 0.00 65535.00 FORMAT "%8.2" NUMBER 4 /end CHARACTERISTIC
/begin CHARACTERISTIC DSM_CDCDfp_BPACD_BPADia3v2_C "CARB spezifischer Fehlercode fuer Fehlerpfad Dfp_BPACD_BPADia3v2" VAL_BLK 0xCB5EC Kwb_Wu16 65535.00 OneToOne 0.00 65535.00 FORMAT "%8.2" NUMBER 4 /end CHARACTERISTIC
/begin CHARACTERISTIC DSM_CDCDfp_BPACD_BPADia4_C "CARB spezifischer Fehlercode fuer Fehlerpfad Dfp_BPACD_BPADia4" VAL_BLK 0xCB5F4 Kwb_Wu16 65535.00 OneToOne 0.00 65535.00 FORMAT "%8.2" NUMBER 4 /end CHARACTERISTIC
/begin CHARACTERISTIC DSM_CDCDfp_BPACD_BPADia4v2_C "CARB spezifischer Fehlercode fuer Fehlerpfad Dfp_BPACD_BPADia4" VAL_BLK 0xCB5FC Kwb_Wu16 65535.00 OneToOne 0.00 65535.00 FORMAT "%8.2" NUMBER 4 /end CHARACTERISTIC
/begin CHARACTERISTIC DSM_CDCDfp_BPACD_Max_C "CARB spezifischer Fehlercode fuer Fehlerpfad Dfp_BPACD_Max" VAL_BLK 0xCB604 Kwb_Wu16 65535.00 OneToOne 0.00 65535.00 FORMAT "%8.2" NUMBER 4 /end CHARACTERISTIC
/begin CHARACTERISTIC DSM_CDCDfp_BPACD_Max2_C "CARB spezifischer Fehlercode fuer Fehlerpfad Dfp_BPACD_Max2" VAL_BLK 0xCB60C Kwb_Wu16 65535.00 OneToOne 0.00 65535.00 FORMAT "%8.2" NUMBER 4 /end CHARACTERISTIC
/begin CHARACTERISTIC DSM_CDCDfp_BPACD_Min_C "CARB spezifischer Fehlercode fuer Fehlerpfad Dfp_BPACD_Min" VAL_BLK 0xCB614 Kwb_Wu16 65535.00 OneToOne 0.00 65535.00 FORMAT "%8.2" NUMBER 4 /end CHARACTERISTIC
/begin CHARACTERISTIC DSM_CDCDfp_BPACD_Min2_C "CARB spezifischer Fehlercode fuer Fehlerpfad Dfp_BPACD_Min2" VAL_BLK 0xCB61C Kwb_Wu16 65535.00 OneToOne 0.00 65535.00 FORMAT "%8.2" NUMBER 4 /end CHARACTERISTIC
/begin CHARACTERISTIC DSM_CDCDfp_BPACD_SigNpl_C "CARB spezifischer Fehlercode fuer Fehlerpfad Dfp_BPACD_SigNpl" VAL_BLK 0xCB624 Kwb_Wu16 65535.00 OneToOne 0.00 65535.00 FORMAT "%8.2" NUMBER 4 /end CHARACTERISTIC
/begin CHARACTERISTIC DSM_CDCDfp_BPACD_SigNpl2_C "CARB spezifischer Fehlercode fuer Fehlerpfad Dfp_BPACD_SigNpl2" VAL_BLK 0xCB62C Kwb_Wu16 65535.00 OneToOne 0.00 65535.00 FORMAT "%8.2" NUMBER 4 /end CHARACTERISTIC
/begin CHARACTERISTIC DSM_CDCDfp_BPSCD_C "CARB spezifischer Fehlercode fuer Fehlerpfad Dfp_BPSCD" VAL_BLK 0xCB634 Kwb_Wu16 65535.00 OneToOne 0.00 65535.00 FORMAT "%8.2" NUMBER 4 /end CHARACTERISTIC
/begin CHARACTERISTIC DSM_CDCDfp_BattCD_C "CARB spezifischer Fehlercode fuer Fehlerpfad Dfp_BattCD" VAL_BLK 0xCB63C Kwb_Wu16 65535.00 OneToOne 0.00 65535.00 FORMAT "%8.2" NUMBER 4 /end CHARACTERISTIC
/begin CHARACTERISTIC DSM_CDCDfp_BrkCD_C "CARB spezifischer Fehlercode fuer Fehlerpfad Dfp_BrkCD" VAL_BLK 0xCB644 Kwb_Wu16 65535.00 OneToOne 0.00 65535.00 FORMAT "%8.2" NUMBER 4 /end CHARACTERISTIC
/begin CHARACTERISTIC DSM_CDCDfp_Layer_PMRUHVERL_C "CARB spezifischer Fehlercode fuer Fehlerpfad Dfp_Layer_PMRUHVERL" VAL_BLK 0xCB64C Kwb_Wu16 65535.00 OneToOne 0.00 65535.00 FORMAT "%8.2" NUMBER 4 /end CHARACTERISTIC
/begin CHARACTERISTIC DSM_CDCDfp_Bss_C "CARB spezifischer Fehlercode fuer Fehlerpfad Dfp_Bss" VAL_BLK 0xCB654 Kwb_Wu16 65535.00 OneToOne 0.00 65535.00 FORMAT "%8.2" NUMBER 4 /end CHARACTERISTIC
/begin CHARACTERISTIC DSM_CDCDfp_CBACD_C "CARB spezifischer Fehlercode fuer Fehlerpfad Dfp_CBACD" VAL_BLK 0xCB65C Kwb_Wu16 65535.00 OneToOne 0.00 65535.00 FORMAT "%8.2" NUMBER 4 /end CHARACTERISTIC
/begin CHARACTERISTIC DSM_CDCDfp_CTSCD_C "CARB spezifischer Fehlercode fuer Fehlerpfad Dfp_CTSCD" VAL_BLK 0xCB664 Kwb_Wu16 65535.00 OneToOne 0.00 65535.00 FORMAT "%8.2" NUMBER 4 /end CHARACTERISTIC
/begin CHARACTERISTIC DSM_CDCDfp_Clg_DynTst_C "CARB spezifischer Fehlercode fuer Fehlerpfad Dfp_Clg_DynTst" VAL_BLK 0xCB66C Kwb_Wu16 65535.00 OneToOne 0.00 65535.00 FORMAT "%8.2" NUMBER 4 /end CHARACTERISTIC
/begin CHARACTERISTIC DSM_CDCDfp_Layer_TOENS_C "CARB spezifischer Fehlercode fuer Fehlerpfad Dfp_Layer_TOENS" VAL_BLK 0xCB674 Kwb_Wu16 65535.00 OneToOne 0.00 65535.00 FORMAT "%8.2" NUMBER 4 /end CHARACTERISTIC
/begin CHARACTERISTIC DSM_CDCDfp_Layer_MANHYDR_C "CARB spezifischer Fehlercode fuer Fehlerpfad Dfp_Layer_MANHYDR" VAL_BLK 0xCB67C Kwb_Wu16 65535.00 OneToOne 0.00 65535.00 FORMAT "%8.2" NUMBER 4 /end CHARACTERISTIC
/begin CHARACTERISTIC DSM_CDCDfp_Layer_MANLUFT_C "CARB spezifischer Fehlercode fuer Fehlerpfad Dfp_Layer_MANLUFT" VAL_BLK 0xCB684 Kwb_Wu16 65535.00 OneToOne 0.00 65535.00 FORMAT "%8.2" NUMBER 4 /end CHARACTERISTIC
/begin CHARACTERISTIC DSM_CDCDfp_CmbChbMisfire1_C "CARB spezifischer Fehlercode fuer Fehlerpfad Dfp_CmbChbMisfire1" VAL_BLK 0xCB68C Kwb_Wu16 65535.00 OneToOne 0.00 65535.00 FORMAT "%8.2" NUMBER 4 /end CHARACTERISTIC
/begin CHARACTERISTIC DSM_CDCDfp_CmbChbMisfire2_C "CARB spezifischer Fehlercode fuer Fehlerpfad Dfp_CmbChbMisfire2" VAL_BLK 0xCB694 Kwb_Wu16 65535.00 OneToOne 0.00 65535.00 FORMAT "%8.2" NUMBER 4 /end CHARACTERISTIC
/begin CHARACTERISTIC DSM_CDCDfp_CmbChbMisfire3_C "CARB spezifischer Fehlercode fuer Fehlerpfad Dfp_CmbChbMisfire3" VAL_BLK 0xCB69C Kwb_Wu16 65535.00 OneToOne 0.00 65535.00 FORMAT "%8.2" NUMBER 4 /end CHARACTERISTIC
/begin CHARACTERISTIC DSM_CDCDfp_CmbChbMisfire4_C "CARB spezifischer Fehlercode fuer Fehlerpfad Dfp_CmbChbMisfire4" VAL_BLK 0xCB6A4 Kwb_Wu16 65535.00 OneToOne 0.00 65535.00 FORMAT "%8.2" NUMBER 4 /end CHARACTERISTIC
/begin CHARACTERISTIC DSM_CDCDfp_CmbChbMisfire5_C "CARB spezifischer Fehlercode fuer Fehlerpfad Dfp_CmbChbMisfire5" VAL_BLK 0xCB6AC Kwb_Wu16 65535.00 OneToOne 0.00 65535.00 FORMAT "%8.2" NUMBER 4 /end CHARACTERISTIC
/begin CHARACTERISTIC DSM_CDCDfp_CmbChbMisfire6_C "CARB spezifischer Fehlercode fuer Fehlerpfad Dfp_CmbChbMisfire6" VAL_BLK 0xCB6B4 Kwb_Wu16 65535.00 OneToOne 0.00 65535.00 FORMAT "%8.2" NUMBER 4 /end CHARACTERISTIC
/begin CHARACTERISTIC DSM_CDCDfp_CmbChbMisfire7_C "CARB spezifischer Fehlercode fuer Fehlerpfad Dfp_CmbChbMisfire7" VAL_BLK 0xCB6BC Kwb_Wu16 65535.00 OneToOne 0.00 65535.00 FORMAT "%8.2" NUMBER 4 /end CHARACTERISTIC
/begin CHARACTERISTIC DSM_CDCDfp_CmbChbMisfire8_C "CARB spezifischer Fehlercode fuer Fehlerpfad Dfp_CmbChbMisfire8" VAL_BLK 0xCB6C4 Kwb_Wu16 65535.00 OneToOne 0.00 65535.00 FORMAT "%8.2" NUMBER 4 /end CHARACTERISTIC
/begin CHARACTERISTIC DSM_CDCDfp_CmbChbMisfireMul_C "CARB spezifischer Fehlercode fuer Fehlerpfad Dfp_CmbChbMisfireMul" VAL_BLK 0xCB6CC Kwb_Wu16 65535.00 OneToOne 0.00 65535.00 FORMAT "%8.2" NUMBER 4 /end CHARACTERISTIC
/begin CHARACTERISTIC DSM_CDCDfp_CoDT_TRQ_Des_C "CARB spezifischer Fehlercode fuer Fehlerpfad Dfp_CoDT_TRQ_Des" VAL_BLK 0xCB6D4 Kwb_Wu16 65535.00 OneToOne 0.00 65535.00 FORMAT "%8.2" NUMBER 4 /end CHARACTERISTIC
/begin CHARACTERISTIC DSM_CDCDfp_CoDT_TRQ_Lead_C "CARB spezifischer Fehlercode fuer Fehlerpfad Dfp_CoDT_TRQ_Lead" VAL_BLK 0xCB6DC Kwb_Wu16 65535.00 OneToOne 0.00 65535.00 FORMAT "%8.2" NUMBER 4 /end CHARACTERISTIC
/begin CHARACTERISTIC DSM_CDCDfp_CoEng_GbxRpmRduc_C "CARB spezifischer Fehlercode fuer Fehlerpfad Dfp_CoEng_GbxRpmRduc" VAL_BLK 0xCB6E4 Kwb_Wu16 65535.00 OneToOne 0.00 65535.00 FORMAT "%8.2" NUMBER 4 /end CHARACTERISTIC
/begin CHARACTERISTIC DSM_CDCDfp_CoVMDCSh_C "CARB spezifischer Fehlercode fuer Fehlerpfad Dfp_CoVMDCSh" VAL_BLK 0xCB6EC Kwb_Wu16 65535.00 OneToOne 0.00 65535.00 FORMAT "%8.2" NUMBER 4 /end CHARACTERISTIC
/begin CHARACTERISTIC DSM_CDCDfp_ConvCD_C "CARB spezifischer Fehlercode fuer Fehlerpfad Dfp_ConvCD" VAL_BLK 0xCB6F4 Kwb_Wu16 65535.00 OneToOne 0.00 65535.00 FORMAT "%8.2" NUMBER 4 /end CHARACTERISTIC
/begin CHARACTERISTIC DSM_CDCDfp_CrCCDMFL_C "CARB spezifischer Fehlercode fuer Fehlerpfad Dfp_CrCCDMFL" VAL_BLK 0xCB6FC Kwb_Wu16 65535.00 OneToOne 0.00 65535.00 FORMAT "%8.2" NUMBER 4 /end CHARACTERISTIC
/begin CHARACTERISTIC DSM_CDCDfp_CrCtl_vCrCtl_C "CARB spezifischer Fehlercode fuer Fehlerpfad Dfp_CrCtl_vCrCtl" VAL_BLK 0xCB704 Kwb_Wu16 65535.00 OneToOne 0.00 65535.00 FORMAT "%8.2" NUMBER 4 /end CHARACTERISTIC
/begin CHARACTERISTIC DSM_CDCDfp_EATSCD_C "CARB spezifischer Fehlercode fuer Fehlerpfad Dfp_EATSCD" VAL_BLK 0xCB70C Kwb_Wu16 65535.00 OneToOne 0.00 65535.00 FORMAT "%8.2" NUMBER 4 /end CHARACTERISTIC
/begin CHARACTERISTIC DSM_CDCDfp_EBAFCD_C "CARB spezifischer Fehlercode fuer Fehlerpfad Dfp_EBAFCD" VAL_BLK 0xCB714 Kwb_Wu16 65535.00 OneToOne 0.00 65535.00 FORMAT "%8.2" NUMBER 4 /end CHARACTERISTIC
/begin CHARACTERISTIC DSM_CDCDfp_EBFCD_C "CARB spezifischer Fehlercode fuer Fehlerpfad Dfp_EBFCD" VAL_BLK 0xCB71C Kwb_Wu16 65535.00 OneToOne 0.00 65535.00 FORMAT "%8.2" NUMBER 4 /end CHARACTERISTIC
/begin CHARACTERISTIC DSM_CDCDfp_EBTSCD_C "CARB spezifischer Fehlercode fuer Fehlerpfad Dfp_EBTSCD" VAL_BLK 0xCB724 Kwb_Wu16 65535.00 OneToOne 0.00 65535.00 FORMAT "%8.2" NUMBER 4 /end CHARACTERISTIC
/begin CHARACTERISTIC DSM_CDCDfp_EBTSCD_OvrTemp_C "CARB spezifischer Fehlercode fuer Fehlerpfad Dfp_EBTSCD_OvrTemp" VAL_BLK 0xCB72C Kwb_Wu16 65535.00 OneToOne 0.00 65535.00 FORMAT "%8.2" NUMBER 4 /end CHARACTERISTIC
/begin CHARACTERISTIC DSM_CDCDfp_EEPCDVarMng_C "CARB spezifischer Fehlercode fuer Fehlerpfad Dfp_EEPCDVarMng" VAL_BLK 0xCB734 Kwb_Wu16 65535.00 OneToOne 0.00 65535.00 FORMAT "%8.2" NUMBER 4 /end CHARACTERISTIC
/begin CHARACTERISTIC DSM_CDCDfp_EGPpCD_C "CARB spezifischer Fehlercode fuer Fehlerpfad Dfp_EGPpCD" VAL_BLK 0xCB73C Kwb_Wu16 65535.00 OneToOne 0.00 65535.00 FORMAT "%8.2" NUMBER 4 /end CHARACTERISTIC
/begin CHARACTERISTIC DSM_CDCDfp_EGRCD_Max_C "CARB spezifischer Fehlercode fuer Fehlerpfad Dfp_EGRCD_Max" VAL_BLK 0xCB744 Kwb_Wu16 65535.00 OneToOne 0.00 65535.00 FORMAT "%8.2" NUMBER 4 /end CHARACTERISTIC
/begin CHARACTERISTIC DSM_CDCDfp_EGRCD_Max2_C "CARB spezifischer Fehlercode fuer Fehlerpfad Dfp_EGRCD_Max2" VAL_BLK 0xCB74C Kwb_Wu16 65535.00 OneToOne 0.00 65535.00 FORMAT "%8.2" NUMBER 4 /end CHARACTERISTIC
/begin CHARACTERISTIC DSM_CDCDfp_EGRCD_Min_C "CARB spezifischer Fehlercode fuer Fehlerpfad Dfp_EGRCD_Min" VAL_BLK 0xCB754 Kwb_Wu16 65535.00 OneToOne 0.00 65535.00 FORMAT "%8.2" NUMBER 4 /end CHARACTERISTIC
/begin CHARACTERISTIC DSM_CDCDfp_EGRCD_Min2_C "CARB spezifischer Fehlercode fuer Fehlerpfad Dfp_EGRCD_Min2" VAL_BLK 0xCB75C Kwb_Wu16 65535.00 OneToOne 0.00 65535.00 FORMAT "%8.2" NUMBER 4 /end CHARACTERISTIC
/begin CHARACTERISTIC DSM_CDCDfp_EGRCD_PWMInDia1_C "CARB spezifischer Fehlercode fuer Fehlerpfad Dfp_EGRCD_PWMInDia1" VAL_BLK 0xCB764 Kwb_Wu16 65535.00 OneToOne 0.00 65535.00 FORMAT "%8.2" NUMBER 4 /end CHARACTERISTIC
/begin CHARACTERISTIC DSM_CDCDfp_EGRCD_PWMInDia2_C "CARB spezifischer Fehlercode fuer Fehlerpfad Dfp_EGRCD_PWMInDia2" VAL_BLK 0xCB76C Kwb_Wu16 65535.00 OneToOne 0.00 65535.00 FORMAT "%8.2" NUMBER 4 /end CHARACTERISTIC
/begin CHARACTERISTIC DSM_CDCDfp_EGRCD_PWMInDia21_C "CARB spezifischer Fehlercode fuer Fehlerpfad Dfp_EGRCD_PWMInDia21" VAL_BLK 0xCB774 Kwb_Wu16 65535.00 OneToOne 0.00 65535.00 FORMAT "%8.2" NUMBER 4 /end CHARACTERISTIC
/begin CHARACTERISTIC DSM_CDCDfp_EGRCD_PWMInDia22_C "CARB spezifischer Fehlercode fuer Fehlerpfad Dfp_EGRCD_PWMInDia22" VAL_BLK 0xCB77C Kwb_Wu16 65535.00 OneToOne 0.00 65535.00 FORMAT "%8.2" NUMBER 4 /end CHARACTERISTIC
/begin CHARACTERISTIC DSM_CDCDfp_EGRCD_PWMInDia23_C "CARB spezifischer Fehlercode fuer Fehlerpfad Dfp_EGRCD_PWMInDia23" VAL_BLK 0xCB784 Kwb_Wu16 65535.00 OneToOne 0.00 65535.00 FORMAT "%8.2" NUMBER 4 /end CHARACTERISTIC
/begin CHARACTERISTIC DSM_CDCDfp_EGRCD_PWMInDia24_C "CARB spezifischer Fehlercode fuer Fehlerpfad Dfp_EGRCD_PWMInDia24" VAL_BLK 0xCB78C Kwb_Wu16 65535.00 OneToOne 0.00 65535.00 FORMAT "%8.2" NUMBER 4 /end CHARACTERISTIC
/begin CHARACTERISTIC DSM_CDCDfp_EGRCD_PWMInDia3_C "CARB spezifischer Fehlercode fuer Fehlerpfad Dfp_EGRCD_PWMInDia3" VAL_BLK 0xCB794 Kwb_Wu16 65535.00 OneToOne 0.00 65535.00 FORMAT "%8.2" NUMBER 4 /end CHARACTERISTIC
/begin CHARACTERISTIC DSM_CDCDfp_EGRCD_PWMInDia4_C "CARB spezifischer Fehlercode fuer Fehlerpfad Dfp_EGRCD_PWMInDia4" VAL_BLK 0xCB79C Kwb_Wu16 65535.00 OneToOne 0.00 65535.00 FORMAT "%8.2" NUMBER 4 /end CHARACTERISTIC
/begin CHARACTERISTIC DSM_CDCDfp_EGRCD_SigDia_C "CARB spezifischer Fehlercode fuer Fehlerpfad Dfp_EGRCD_SigDia" VAL_BLK 0xCB7A4 Kwb_Wu16 65535.00 OneToOne 0.00 65535.00 FORMAT "%8.2" NUMBER 4 /end CHARACTERISTIC
/begin CHARACTERISTIC DSM_CDCDfp_EGRCD_SigDia2_C "CARB spezifischer Fehlercode fuer Fehlerpfad Dfp_EGRCD_SigDia2" VAL_BLK 0xCB7AC Kwb_Wu16 65535.00 OneToOne 0.00 65535.00 FORMAT "%8.2" NUMBER 4 /end CHARACTERISTIC
/begin CHARACTERISTIC DSM_CDCDfp_EGRCD_SigNpl_C "CARB spezifischer Fehlercode fuer Fehlerpfad Dfp_EGRCD_SigNpl" VAL_BLK 0xCB7B4 Kwb_Wu16 65535.00 OneToOne 0.00 65535.00 FORMAT "%8.2" NUMBER 4 /end CHARACTERISTIC
/begin CHARACTERISTIC DSM_CDCDfp_EGRCD_SigNpl2_C "CARB spezifischer Fehlercode fuer Fehlerpfad Dfp_EGRCD_SigNpl2" VAL_BLK 0xCB7BC Kwb_Wu16 65535.00 OneToOne 0.00 65535.00 FORMAT "%8.2" NUMBER 4 /end CHARACTERISTIC
/begin CHARACTERISTIC DSM_CDCDfp_EGTOilLvlCrit_C "CARB spezifischer Fehlercode fuer Fehlerpfad Dfp_EGTOilLvlCrit" VAL_BLK 0xCB7C4 Kwb_Wu16 65535.00 OneToOne 0.00 65535.00 FORMAT "%8.2" NUMBER 4 /end CHARACTERISTIC
/begin CHARACTERISTIC DSM_CDCDfp_EGTOilVscCrit_C "CARB spezifischer Fehlercode fuer Fehlerpfad Dfp_EGTOilVscCrit" VAL_BLK 0xCB7CC Kwb_Wu16 65535.00 OneToOne 0.00 65535.00 FORMAT "%8.2" NUMBER 4 /end CHARACTERISTIC
/begin CHARACTERISTIC DSM_CDCDfp_EGTRgnOilDil_C "CARB spezifischer Fehlercode fuer Fehlerpfad Dfp_EGTRgnOilDil" VAL_BLK 0xCB7D4 Kwb_Wu16 65535.00 OneToOne 0.00 65535.00 FORMAT "%8.2" NUMBER 4 /end CHARACTERISTIC
/begin CHARACTERISTIC DSM_CDCDfp_EGTTempGvnrInrB1_C "CARB spezifischer Fehlercode fuer Fehlerpfad Dfp_EGTTempGvnrInrB1" VAL_BLK 0xCB7DC Kwb_Wu16 65535.00 OneToOne 0.00 65535.00 FORMAT "%8.2" NUMBER 4 /end CHARACTERISTIC
/begin CHARACTERISTIC DSM_CDCDfp_EGTTempGvnrInrB2_C "CARB spezifischer Fehlercode fuer Fehlerpfad Dfp_EGTTempGvnrInrB2" VAL_BLK 0xCB7E4 Kwb_Wu16 65535.00 OneToOne 0.00 65535.00 FORMAT "%8.2" NUMBER 4 /end CHARACTERISTIC
/begin CHARACTERISTIC DSM_CDCDfp_EGTTempGvnrOutrB1_C "CARB spezifischer Fehlercode fuer Fehlerpfad Dfp_EGTTempGvnrOutrB1" VAL_BLK 0xCB7EC Kwb_Wu16 65535.00 OneToOne 0.00 65535.00 FORMAT "%8.2" NUMBER 4 /end CHARACTERISTIC
/begin CHARACTERISTIC DSM_CDCDfp_EGTTempGvnrOutrB2_C "CARB spezifischer Fehlercode fuer Fehlerpfad Dfp_EGTTempGvnrOutrB2" VAL_BLK 0xCB7F4 Kwb_Wu16 65535.00 OneToOne 0.00 65535.00 FORMAT "%8.2" NUMBER 4 /end CHARACTERISTIC
/begin CHARACTERISTIC DSM_CDCDfp_ETClbETFltInj1_C "CARB spezifischer Fehlercode fuer Fehlerpfad Dfp_ETClbETFltInj1" VAL_BLK 0xCB7FC Kwb_Wu16 65535.00 OneToOne 0.00 65535.00 FORMAT "%8.2" NUMBER 4 /end CHARACTERISTIC
/begin CHARACTERISTIC DSM_CDCDfp_ETClbETFltInj2_C "CARB spezifischer Fehlercode fuer Fehlerpfad Dfp_ETClbETFltInj2" VAL_BLK 0xCB804 Kwb_Wu16 65535.00 OneToOne 0.00 65535.00 FORMAT "%8.2" NUMBER 4 /end CHARACTERISTIC
/begin CHARACTERISTIC DSM_CDCDfp_ETClbETFltInj3_C "CARB spezifischer Fehlercode fuer Fehlerpfad Dfp_ETClbETFltInj3" VAL_BLK 0xCB80C Kwb_Wu16 65535.00 OneToOne 0.00 65535.00 FORMAT "%8.2" NUMBER 4 /end CHARACTERISTIC
/begin CHARACTERISTIC DSM_CDCDfp_ETClbETFltInj4_C "CARB spezifischer Fehlercode fuer Fehlerpfad Dfp_ETClbETFltInj4" VAL_BLK 0xCB814 Kwb_Wu16 65535.00 OneToOne 0.00 65535.00 FORMAT "%8.2" NUMBER 4 /end CHARACTERISTIC
/begin CHARACTERISTIC DSM_CDCDfp_ETClbETFltInj5_C "CARB spezifischer Fehlercode fuer Fehlerpfad Dfp_ETClbETFltInj5" VAL_BLK 0xCB81C Kwb_Wu16 65535.00 OneToOne 0.00 65535.00 FORMAT "%8.2" NUMBER 4 /end CHARACTERISTIC
/begin CHARACTERISTIC DSM_CDCDfp_ETClbETFltInj6_C "CARB spezifischer Fehlercode fuer Fehlerpfad Dfp_ETClbETFltInj6" VAL_BLK 0xCB824 Kwb_Wu16 65535.00 OneToOne 0.00 65535.00 FORMAT "%8.2" NUMBER 4 /end CHARACTERISTIC
/begin CHARACTERISTIC DSM_CDCDfp_ETClbETFltInj7_C "CARB spezifischer Fehlercode fuer Fehlerpfad Dfp_ETClbETFltInj7" VAL_BLK 0xCB82C Kwb_Wu16 65535.00 OneToOne 0.00 65535.00 FORMAT "%8.2" NUMBER 4 /end CHARACTERISTIC
/begin CHARACTERISTIC DSM_CDCDfp_ETClbETFltInj8_C "CARB spezifischer Fehlercode fuer Fehlerpfad Dfp_ETClbETFltInj8" VAL_BLK 0xCB834 Kwb_Wu16 65535.00 OneToOne 0.00 65535.00 FORMAT "%8.2" NUMBER 4 /end CHARACTERISTIC
/begin CHARACTERISTIC DSM_CDCDfp_ETClbInj1_C "CARB spezifischer Fehlercode fuer Fehlerpfad Dfp_ETClbInj1" VAL_BLK 0xCB83C Kwb_Wu16 65535.00 OneToOne 0.00 65535.00 FORMAT "%8.2" NUMBER 4 /end CHARACTERISTIC
/begin CHARACTERISTIC DSM_CDCDfp_ETClbInj2_C "CARB spezifischer Fehlercode fuer Fehlerpfad Dfp_ETClbInj2" VAL_BLK 0xCB844 Kwb_Wu16 65535.00 OneToOne 0.00 65535.00 FORMAT "%8.2" NUMBER 4 /end CHARACTERISTIC
/begin CHARACTERISTIC DSM_CDCDfp_ETClbInj3_C "CARB spezifischer Fehlercode fuer Fehlerpfad Dfp_ETClbInj3" VAL_BLK 0xCB84C Kwb_Wu16 65535.00 OneToOne 0.00 65535.00 FORMAT "%8.2" NUMBER 4 /end CHARACTERISTIC
/begin CHARACTERISTIC DSM_CDCDfp_ETClbInj4_C "CARB spezifischer Fehlercode fuer Fehlerpfad Dfp_ETClbInj4" VAL_BLK 0xCB854 Kwb_Wu16 65535.00 OneToOne 0.00 65535.00 FORMAT "%8.2" NUMBER 4 /end CHARACTERISTIC
/begin CHARACTERISTIC DSM_CDCDfp_ETClbInj5_C "CARB spezifischer Fehlercode fuer Fehlerpfad Dfp_ETClbInj5" VAL_BLK 0xCB85C Kwb_Wu16 65535.00 OneToOne 0.00 65535.00 FORMAT "%8.2" NUMBER 4 /end CHARACTERISTIC
/begin CHARACTERISTIC DSM_CDCDfp_ETClbInj6_C "CARB spezifischer Fehlercode fuer Fehlerpfad Dfp_ETClbInj6" VAL_BLK 0xCB864 Kwb_Wu16 65535.00 OneToOne 0.00 65535.00 FORMAT "%8.2" NUMBER 4 /end CHARACTERISTIC
/begin CHARACTERISTIC DSM_CDCDfp_ETClbInj7_C "CARB spezifischer Fehlercode fuer Fehlerpfad Dfp_ETClbInj7" VAL_BLK 0xCB86C Kwb_Wu16 65535.00 OneToOne 0.00 65535.00 FORMAT "%8.2" NUMBER 4 /end CHARACTERISTIC
/begin CHARACTERISTIC DSM_CDCDfp_ETClbInj8_C "CARB spezifischer Fehlercode fuer Fehlerpfad Dfp_ETClbInj8" VAL_BLK 0xCB874 Kwb_Wu16 65535.00 OneToOne 0.00 65535.00 FORMAT "%8.2" NUMBER 4 /end CHARACTERISTIC
/begin CHARACTERISTIC DSM_CDCDfp_EngMCaS1_C "CARB spezifischer Fehlercode fuer Fehlerpfad Dfp_EngMCaS1" VAL_BLK 0xCB87C Kwb_Wu16 65535.00 OneToOne 0.00 65535.00 FORMAT "%8.2" NUMBER 4 /end CHARACTERISTIC
/begin CHARACTERISTIC DSM_CDCDfp_EngMCrS1_C "CARB spezifischer Fehlercode fuer Fehlerpfad Dfp_EngMCrS1" VAL_BLK 0xCB884 Kwb_Wu16 65535.00 OneToOne 0.00 65535.00 FORMAT "%8.2" NUMBER 4 /end CHARACTERISTIC
/begin CHARACTERISTIC DSM_CDCDfp_EngMOfsCaSCrS_C "CARB spezifischer Fehlercode fuer Fehlerpfad Dfp_EngMOfsCaSCrS" VAL_BLK 0xCB88C Kwb_Wu16 65535.00 OneToOne 0.00 65535.00 FORMAT "%8.2" NUMBER 4 /end CHARACTERISTIC
/begin CHARACTERISTIC DSM_CDCDfp_EngMntCtlCD_C "CARB spezifischer Fehlercode fuer Fehlerpfad Dfp_EngMntCtlCD" VAL_BLK 0xCB894 Kwb_Wu16 65535.00 OneToOne 0.00 65535.00 FORMAT "%8.2" NUMBER 4 /end CHARACTERISTIC
/begin CHARACTERISTIC DSM_CDCDfp_FBCqDvt_C "CARB spezifischer Fehlercode fuer Fehlerpfad Dfp_FBCqDvt" VAL_BLK 0xCB89C Kwb_Wu16 65535.00 OneToOne 0.00 65535.00 FORMAT "%8.2" NUMBER 4 /end CHARACTERISTIC
/begin CHARACTERISTIC DSM_CDCDfp_FMAErrMod_C "CARB spezifischer Fehlercode fuer Fehlerpfad Dfp_FMAErrMod" VAL_BLK 0xCB8A4 Kwb_Wu16 65535.00 OneToOne 0.00 65535.00 FORMAT "%8.2" NUMBER 4 /end CHARACTERISTIC
/begin CHARACTERISTIC DSM_CDCDfp_FMTC_NonMonotonMap_C "CARB spezifischer Fehlercode fuer Fehlerpfad Dfp_FMTC_NonMonotonMap" VAL_BLK 0xCB8AC Kwb_Wu16 65535.00 OneToOne 0.00 65535.00 FORMAT "%8.2" NUMBER 4 /end CHARACTERISTIC
/begin CHARACTERISTIC DSM_CDCDfp_FTSCD_C "CARB spezifischer Fehlercode fuer Fehlerpfad Dfp_FTSCD" VAL_BLK 0xCB8B4 Kwb_Wu16 65535.00 OneToOne 0.00 65535.00 FORMAT "%8.2" NUMBER 4 /end CHARACTERISTIC
/begin CHARACTERISTIC DSM_CDCDfp_FanCD_C "CARB spezifischer Fehlercode fuer Fehlerpfad Dfp_FanCD" VAL_BLK 0xCB8BC Kwb_Wu16 65535.00 OneToOne 0.00 65535.00 FORMAT "%8.2" NUMBER 4 /end CHARACTERISTIC
/begin CHARACTERISTIC DSM_CDCDfp_FanCD_FanCtlr1_C "CARB spezifischer Fehlercode fuer Fehlerpfad Dfp_FanCD_FanCtlr1" VAL_BLK 0xCB8C4 Kwb_Wu16 65535.00 OneToOne 0.00 65535.00 FORMAT "%8.2" NUMBER 4 /end CHARACTERISTIC
/begin CHARACTERISTIC DSM_CDCDfp_FanCD_FanCtlr2_C "CARB spezifischer Fehlercode fuer Fehlerpfad Dfp_FanCD_FanCtlr2" VAL_BLK 0xCB8CC Kwb_Wu16 65535.00 OneToOne 0.00 65535.00 FORMAT "%8.2" NUMBER 4 /end CHARACTERISTIC
/begin CHARACTERISTIC DSM_CDCDfp_FanCD_FanCtlr3_C "CARB spezifischer Fehlercode fuer Fehlerpfad Dfp_FanCD_FanCtlr3" VAL_BLK 0xCB8D4 Kwb_Wu16 65535.00 OneToOne 0.00 65535.00 FORMAT "%8.2" NUMBER 4 /end CHARACTERISTIC
/begin CHARACTERISTIC DSM_CDCDfp_FlFCD_C "CARB spezifischer Fehlercode fuer Fehlerpfad Dfp_FlFCD" VAL_BLK 0xCB8DC Kwb_Wu16 65535.00 OneToOne 0.00 65535.00 FORMAT "%8.2" NUMBER 4 /end CHARACTERISTIC
/begin CHARACTERISTIC DSM_CDCDfp_FlMngSmkDefect_C "CARB spezifischer Fehlercode fuer Fehlerpfad Dfp_FlMngSmkDefect" VAL_BLK 0xCB8E4 Kwb_Wu16 65535.00 OneToOne 0.00 65535.00 FORMAT "%8.2" NUMBER 4 /end CHARACTERISTIC
/begin CHARACTERISTIC DSM_CDCDfp_FlSCDT1_C "CARB spezifischer Fehlercode fuer Fehlerpfad Dfp_FlSCDT1" VAL_BLK 0xCB8EC Kwb_Wu16 65535.00 OneToOne 0.00 65535.00 FORMAT "%8.2" NUMBER 4 /end CHARACTERISTIC
/begin CHARACTERISTIC DSM_CDCDfp_FrmMngANFRADMOMPT_C "CARB spezifischer Fehlercode fuer Fehlerpfad Dfp_FrmMngANFRADMOMPT" VAL_BLK 0xCB8F4 Kwb_Wu16 65535.00 OneToOne 0.00 65535.00 FORMAT "%8.2" NUMBER 4 /end CHARACTERISTIC
/begin CHARACTERISTIC DSM_CDCDfp_FrmMngASC1_C "CARB spezifischer Fehlercode fuer Fehlerpfad Dfp_FrmMngASC1" VAL_BLK 0xCB8FC Kwb_Wu16 65535.00 OneToOne 0.00 65535.00 FORMAT "%8.2" NUMBER 4 /end CHARACTERISTIC
/begin CHARACTERISTIC DSM_CDCDfp_FrmMngASC2_C "CARB spezifischer Fehlercode fuer Fehlerpfad Dfp_FrmMngASC2" VAL_BLK 0xCB904 Kwb_Wu16 65535.00 OneToOne 0.00 65535.00 FORMAT "%8.2" NUMBER 4 /end CHARACTERISTIC
/begin CHARACTERISTIC DSM_CDCDfp_FrmMngASC3_C "CARB spezifischer Fehlercode fuer Fehlerpfad Dfp_FrmMngASC3" VAL_BLK 0xCB90C Kwb_Wu16 65535.00 OneToOne 0.00 65535.00 FORMAT "%8.2" NUMBER 4 /end CHARACTERISTIC
/begin CHARACTERISTIC DSM_CDCDfp_FrmMngASC4_C "CARB spezifischer Fehlercode fuer Fehlerpfad Dfp_FrmMngASC4" VAL_BLK 0xCB914 Kwb_Wu16 65535.00 OneToOne 0.00 65535.00 FORMAT "%8.2" NUMBER 4 /end CHARACTERISTIC
/begin CHARACTERISTIC DSM_CDCDfp_FrmMngBOS_RESET_C "CARB spezifischer Fehlercode fuer Fehlerpfad Dfp_FrmMngBOS_RESET" VAL_BLK 0xCB91C Kwb_Wu16 65535.00 OneToOne 0.00 65535.00 FORMAT "%8.2" NUMBER 4 /end CHARACTERISTIC
/begin CHARACTERISTIC DSM_CDCDfp_FrmMngBOS_RESET2_C "CARB spezifischer Fehlercode fuer Fehlerpfad Dfp_FrmMngBOS_RESET2" VAL_BLK 0xCB924 Kwb_Wu16 65535.00 OneToOne 0.00 65535.00 FORMAT "%8.2" NUMBER 4 /end CHARACTERISTIC
/begin CHARACTERISTIC DSM_CDCDfp_FrmMngDMANFAFS_C "CARB spezifischer Fehlercode fuer Fehlerpfad Dfp_FrmMngDMANFAFS" VAL_BLK 0xCB92C Kwb_Wu16 65535.00 OneToOne 0.00 65535.00 FORMAT "%8.2" NUMBER 4 /end CHARACTERISTIC
/begin CHARACTERISTIC DSM_CDCDfp_FrmMngDRMANFSSG_C "CARB spezifischer Fehlercode fuer Fehlerpfad Dfp_FrmMngDRMANFSSG" VAL_BLK 0xCB934 Kwb_Wu16 65535.00 OneToOne 0.00 65535.00 FORMAT "%8.2" NUMBER 4 /end CHARACTERISTIC
/begin CHARACTERISTIC DSM_CDCDfp_FrmMngEGS1_C "CARB spezifischer Fehlercode fuer Fehlerpfad Dfp_FrmMngEGS1" VAL_BLK 0xCB93C Kwb_Wu16 65535.00 OneToOne 0.00 65535.00 FORMAT "%8.2" NUMBER 4 /end CHARACTERISTIC
/begin CHARACTERISTIC DSM_CDCDfp_FrmMngEGS2_C "CARB spezifischer Fehlercode fuer Fehlerpfad Dfp_FrmMngEGS2" VAL_BLK 0xCB944 Kwb_Wu16 65535.00 OneToOne 0.00 65535.00 FORMAT "%8.2" NUMBER 4 /end CHARACTERISTIC
/begin CHARACTERISTIC DSM_CDCDfp_FrmMngGEARBX_DATA_C "P-Code (CARB) for faults in path" VAL_BLK 0xCB94C Kwb_Wu16 65535.00 OneToOne 0.00 65535.00 FORMAT "%8.2" NUMBER 4 /end CHARACTERISTIC
/begin CHARACTERISTIC DSM_CDCDfp_FrmMngGEARBX_DATA2_C "CARB spezifischer Fehlercode fuer Fehlerpfad Dfp_FrmMngGEARBX_DATA2" VAL_BLK 0xCB954 Kwb_Wu16 65535.00 OneToOne 0.00 65535.00 FORMAT "%8.2" NUMBER 4 /end CHARACTERISTIC
/begin CHARACTERISTIC DSM_CDCDfp_FrmMngHEAT_AC_C "P-Code (CARB) for faults in path" VAL_BLK 0xCB95C Kwb_Wu16 65535.00 OneToOne 0.00 65535.00 FORMAT "%8.2" NUMBER 4 /end CHARACTERISTIC
/begin CHARACTERISTIC DSM_CDCDfp_FrmMngINSTR2_C "CARB spezifischer Fehlercode fuer Fehlerpfad Dfp_FrmMngINSTR2" VAL_BLK 0xCB964 Kwb_Wu16 65535.00 OneToOne 0.00 65535.00 FORMAT "%8.2" NUMBER 4 /end CHARACTERISTIC
/begin CHARACTERISTIC DSM_CDCDfp_FrmMngINSTR3_C "CARB spezifischer Fehlercode fuer Fehlerpfad Dfp_FrmMngINSTR3" VAL_BLK 0xCB96C Kwb_Wu16 65535.00 OneToOne 0.00 65535.00 FORMAT "%8.2" NUMBER 4 /end CHARACTERISTIC
/begin CHARACTERISTIC DSM_CDCDfp_FrmMngLENKRADWINKEL_C "CARB spezifischer Fehlercode fuer Fehlerpfad Dfp_FrmMngLENKRADWINKEL" VAL_BLK 0xCB974 Kwb_Wu16 65535.00 OneToOne 0.00 65535.00 FORMAT "%8.2" NUMBER 4 /end CHARACTERISTIC
/begin CHARACTERISTIC DSM_CDCDfp_FrmMngMILEAGE_RANGE_C "CARB spezifischer Fehlercode fuer Fehlerpfad Dfp_FrmMngMILEAGE_RANGE" VAL_BLK 0xCB97C Kwb_Wu16 65535.00 OneToOne 0.00 65535.00 FORMAT "%8.2" NUMBER 4 /end CHARACTERISTIC
/begin CHARACTERISTIC DSM_CDCDfp_FrmMngMSPHISYNC_C "CARB spezifischer Fehlercode fuer Fehlerpfad Dfp_FrmMngMSPHISYNC" VAL_BLK 0xCB984 Kwb_Wu16 65535.00 OneToOne 0.00 65535.00 FORMAT "%8.2" NUMBER 4 /end CHARACTERISTIC
/begin CHARACTERISTIC DSM_CDCDfp_FrmMngMST4_C "CARB spezifischer Fehlercode fuer Fehlerpfad Dfp_FrmMngMST4" VAL_BLK 0xCB98C Kwb_Wu16 65535.00 OneToOne 0.00 65535.00 FORMAT "%8.2" NUMBER 4 /end CHARACTERISTIC
/begin CHARACTERISTIC DSM_CDCDfp_FrmMngMST5_C "CARB spezifischer Fehlercode fuer Fehlerpfad Dfp_FrmMngMST5" VAL_BLK 0xCB994 Kwb_Wu16 65535.00 OneToOne 0.00 65535.00 FORMAT "%8.2" NUMBER 4 /end CHARACTERISTIC
/begin CHARACTERISTIC DSM_CDCDfp_FrmMngOPCRCTLACC_C "CARB spezifischer Fehlercode fuer Fehlerpfad Dfp_FrmMngOPCRCTLACC" VAL_BLK 0xCB99C Kwb_Wu16 65535.00 OneToOne 0.00 65535.00 FORMAT "%8.2" NUMBER 4 /end CHARACTERISTIC
/begin CHARACTERISTIC DSM_CDCDfp_FrmMngPRGG_CCTR_C "CARB spezifischer Fehlercode fuer Fehlerpfad Dfp_FrmMngPRGG_CCTR" VAL_BLK 0xCB9A4 Kwb_Wu16 65535.00 OneToOne 0.00 65535.00 FORMAT "%8.2" NUMBER 4 /end CHARACTERISTIC
/begin CHARACTERISTIC DSM_CDCDfp_FrmMngPWRMNG_LOADV_C "CARB spezifischer Fehlercode fuer Fehlerpfad Dfp_FrmMngPWRMNG_LOADV" VAL_BLK 0xCB9AC Kwb_Wu16 65535.00 OneToOne 0.00 65535.00 FORMAT "%8.2" NUMBER 4 /end CHARACTERISTIC
/begin CHARACTERISTIC DSM_CDCDfp_FrmMngParkConsumer_C "CARB spezifischer Fehlercode fuer Fehlerpfad Dfp_FrmMngParkConsumer" VAL_BLK 0xCB9B4 Kwb_Wu16 65535.00 OneToOne 0.00 65535.00 FORMAT "%8.2" NUMBER 4 /end CHARACTERISTIC
/begin CHARACTERISTIC DSM_CDCDfp_FrmMngRQSTGEFAN_C "CARB spezifischer Fehlercode fuer Fehlerpfad Dfp_FrmMngRQSTGEFAN_C" VAL_BLK 0xCB9BC Kwb_Wu16 65535.00 OneToOne 0.00 65535.00 FORMAT "%8.2" NUMBER 4 /end CHARACTERISTIC
/begin CHARACTERISTIC DSM_CDCDfp_FrmMngSLV4_C "CARB spezifischer Fehlercode fuer Fehlerpfad Dfp_FrmMngSLV4" VAL_BLK 0xCB9C4 Kwb_Wu16 65535.00 OneToOne 0.00 65535.00 FORMAT "%8.2" NUMBER 4 /end CHARACTERISTIC
/begin CHARACTERISTIC DSM_CDCDfp_FrmMngSLV5_C "CARB spezifischer Fehlercode fuer Fehlerpfad Dfp_FrmMngSLV5" VAL_BLK 0xCB9CC Kwb_Wu16 65535.00 OneToOne 0.00 65535.00 FORMAT "%8.2" NUMBER 4 /end CHARACTERISTIC
/begin CHARACTERISTIC DSM_CDCDfp_FrmMngSSGErr_C "CARB spezifischer Fehlercode fuer Fehlerpfad Dfp_FrmMngSSGErr" VAL_BLK 0xCB9D4 Kwb_Wu16 65535.00 OneToOne 0.00 65535.00 FORMAT "%8.2" NUMBER 4 /end CHARACTERISTIC
/begin CHARACTERISTIC DSM_CDCDfp_FrmMngSSGShOff_C "CARB spezifischer Fehlercode fuer Fehlerpfad Dfp_FrmMngSSGShOff" VAL_BLK 0xCB9DC Kwb_Wu16 65535.00 OneToOne 0.00 65535.00 FORMAT "%8.2" NUMBER 4 /end CHARACTERISTIC
/begin CHARACTERISTIC DSM_CDCDfp_FrmMngSTAT_ANH_C "CARB spezifischer Fehlercode fuer Fehlerpfad Dfp_FrmMngSTAT_ANH" VAL_BLK 0xCB9E4 Kwb_Wu16 65535.00 OneToOne 0.00 65535.00 FORMAT "%8.2" NUMBER 4 /end CHARACTERISTIC
/begin CHARACTERISTIC DSM_CDCDfp_FrmMngSTAT_ARS_C "P-Code (CARB) for faults in path" VAL_BLK 0xCB9EC Kwb_Wu16 65535.00 OneToOne 0.00 65535.00 FORMAT "%8.2" NUMBER 4 /end CHARACTERISTIC
/begin CHARACTERISTIC DSM_CDCDfp_FrmMngSTAT_DSC_C "P-Code (CARB) for faults in path" VAL_BLK 0xCB9F4 Kwb_Wu16 65535.00 OneToOne 0.00 65535.00 FORMAT "%8.2" NUMBER 4 /end CHARACTERISTIC
/begin CHARACTERISTIC DSM_CDCDfp_FrmMngSTAT_EKP_C "CARB spezifischer Fehlercode fuer Fehlerpfad Dfp_FrmMngSTAT_EKP" VAL_BLK 0xCB9FC Kwb_Wu16 65535.00 OneToOne 0.00 65535.00 FORMAT "%8.2" NUMBER 4 /end CHARACTERISTIC
/begin CHARACTERISTIC DSM_CDCDfp_FrmMngSTAT_KOMBI_C "CARB spezifischer Fehlercode fuer Fehlerpfad Dfp_FrmMngSTAT_KOMBI" VAL_BLK 0xCBA04 Kwb_Wu16 65535.00 OneToOne 0.00 65535.00 FORMAT "%8.2" NUMBER 4 /end CHARACTERISTIC
/begin CHARACTERISTIC DSM_CDCDfp_FrmMngSTAT_SITZ_C "CARB spezifischer Fehlercode fuer Fehlerpfad Dfp_FrmMngSTAT_SITZ" VAL_BLK 0xCBA0C Kwb_Wu16 65535.00 OneToOne 0.00 65535.00 FORMAT "%8.2" NUMBER 4 /end CHARACTERISTIC
/begin CHARACTERISTIC DSM_CDCDfp_FrmMngStOBDGbxMilOf_C "CARB spezifischer Fehlercode fuer Fehlerpfad Dfp_FrmMngStOBDGbxMilOf" VAL_BLK 0xCBA14 Kwb_Wu16 65535.00 OneToOne 0.00 65535.00 FORMAT "%8.2" NUMBER 4 /end CHARACTERISTIC
/begin CHARACTERISTIC DSM_CDCDfp_FrmMngStOBDGbxMilOn_C "CARB spezifischer Fehlercode fuer Fehlerpfad Dfp_FrmMngStOBDGbxMilOn" VAL_BLK 0xCBA1C Kwb_Wu16 65535.00 OneToOne 0.00 65535.00 FORMAT "%8.2" NUMBER 4 /end CHARACTERISTIC
/begin CHARACTERISTIC DSM_CDCDfp_FrmMngTEMPRELTIME_C "CARB spezifischer Fehlercode fuer Fehlerpfad Dfp_FrmMngTEMPRELTIME" VAL_BLK 0xCBA24 Kwb_Wu16 65535.00 OneToOne 0.00 65535.00 FORMAT "%8.2" NUMBER 4 /end CHARACTERISTIC
/begin CHARACTERISTIC DSM_CDCDfp_FrmMngTERMINAL_C "P-Code (CARB) for faults in path" VAL_BLK 0xCBA2C Kwb_Wu16 65535.00 OneToOne 0.00 65535.00 FORMAT "%8.2" NUMBER 4 /end CHARACTERISTIC
/begin CHARACTERISTIC DSM_CDCDfp_FrmMngTIME_DATE_C "CARB spezifischer Fehlercode fuer Fehlerpfad Dfp_FrmMngTIME_DATE" VAL_BLK 0xCBA34 Kwb_Wu16 65535.00 OneToOne 0.00 65535.00 FORMAT "%8.2" NUMBER 4 /end CHARACTERISTIC
/begin CHARACTERISTIC DSM_CDCDfp_FrmMngTORQUE_DSC_C "P-Code (CARB) for faults in path" VAL_BLK 0xCBA3C Kwb_Wu16 65535.00 OneToOne 0.00 65535.00 FORMAT "%8.2" NUMBER 4 /end CHARACTERISTIC
/begin CHARACTERISTIC DSM_CDCDfp_FrmMngTORQUE_GEARBX_C "P-Code (CARB) for faults in path" VAL_BLK 0xCBA44 Kwb_Wu16 65535.00 OneToOne 0.00 65535.00 FORMAT "%8.2" NUMBER 4 /end CHARACTERISTIC
/begin CHARACTERISTIC DSM_CDCDfp_FrmMngTrq_ReqACC_C "CARB spezifischer Fehlercode fuer Fehlerpfad Dfp_FrmMngTrq_ReqACC" VAL_BLK 0xCBA4C Kwb_Wu16 65535.00 OneToOne 0.00 65535.00 FORMAT "%8.2" NUMBER 4 /end CHARACTERISTIC
/begin CHARACTERISTIC DSM_CDCDfp_FrmMngVEH_MOD_C "CARB spezifischer Fehlercode fuer Fehlerpfad Dfp_FrmMngVEH_MOD_C" VAL_BLK 0xCBA54 Kwb_Wu16 65535.00 OneToOne 0.00 65535.00 FORMAT "%8.2" NUMBER 4 /end CHARACTERISTIC
/begin CHARACTERISTIC DSM_CDCDfp_FrmMngVELOCITY_C "P-Code (CARB) for faults in path" VAL_BLK 0xCBA5C Kwb_Wu16 65535.00 OneToOne 0.00 65535.00 FORMAT "%8.2" NUMBER 4 /end CHARACTERISTIC
/begin CHARACTERISTIC DSM_CDCDfp_FrmMngWHEEL_SPEED_C "CARB spezifischer Fehlercode fuer Fehlerpfad Dfp_FrmMngWHEEL_SPEED" VAL_BLK 0xCBA64 Kwb_Wu16 65535.00 OneToOne 0.00 65535.00 FORMAT "%8.2" NUMBER 4 /end CHARACTERISTIC
/begin CHARACTERISTIC DSM_CDCDfp_FrmMngstCurr_C "Fehlercode Feld für Dfp_FrmMngstCurr" VAL_BLK 0xCBA6C Kwb_Wu16 65535.00 OneToOne 0.00 65535.00 FORMAT "%8.2" NUMBER 4 /end CHARACTERISTIC
/begin CHARACTERISTIC DSM_CDCDfp_FrmMngswtPSPOff_C "Fehlercode Feld für Dfp_FrmMngswtPSP" VAL_BLK 0xCBA74 Kwb_Wu16 65535.00 OneToOne 0.00 65535.00 FORMAT "%8.2" NUMBER 4 /end CHARACTERISTIC
/begin CHARACTERISTIC DSM_CDCDfp_GearbxIncMax_C "CARB spezifischer Fehlercode fuer Fehlerpfad Dfp_GearbxIncMax" VAL_BLK 0xCBA7C Kwb_Wu16 65535.00 OneToOne 0.00 65535.00 FORMAT "%8.2" NUMBER 4 /end CHARACTERISTIC
/begin CHARACTERISTIC DSM_CDCDfp_GlwCD_C "CARB spezifischer Fehlercode fuer Fehlerpfad Dfp_GlwCD" VAL_BLK 0xCBA84 Kwb_Wu16 65535.00 OneToOne 0.00 65535.00 FORMAT "%8.2" NUMBER 4 /end CHARACTERISTIC
/begin CHARACTERISTIC DSM_CDCDfp_GlwCDGlwCirc1_C "CARB spezifischer Fehlercode fuer Fehlerpfad Dfp_GlwCDGlwCirc1" VAL_BLK 0xCBA8C Kwb_Wu16 65535.00 OneToOne 0.00 65535.00 FORMAT "%8.2" NUMBER 4 /end CHARACTERISTIC
/begin CHARACTERISTIC DSM_CDCDfp_GlwCDGlwCirc2_C "CARB spezifischer Fehlercode fuer Fehlerpfad Dfp_GlwCDGlwCirc2" VAL_BLK 0xCBA94 Kwb_Wu16 65535.00 OneToOne 0.00 65535.00 FORMAT "%8.2" NUMBER 4 /end CHARACTERISTIC
/begin CHARACTERISTIC DSM_CDCDfp_GlwCDGlwCirc3_C "CARB spezifischer Fehlercode fuer Fehlerpfad Dfp_GlwCDGlwCirc3" VAL_BLK 0xCBA9C Kwb_Wu16 65535.00 OneToOne 0.00 65535.00 FORMAT "%8.2" NUMBER 4 /end CHARACTERISTIC
/begin CHARACTERISTIC DSM_CDCDfp_GlwCDGlwCirc4_C "CARB spezifischer Fehlercode fuer Fehlerpfad Dfp_GlwCDGlwCirc4" VAL_BLK 0xCBAA4 Kwb_Wu16 65535.00 OneToOne 0.00 65535.00 FORMAT "%8.2" NUMBER 4 /end CHARACTERISTIC
/begin CHARACTERISTIC DSM_CDCDfp_GlwCDGlwCirc5_C "CARB spezifischer Fehlercode fuer Fehlerpfad Dfp_GlwCDGlwCirc5" VAL_BLK 0xCBAAC Kwb_Wu16 65535.00 OneToOne 0.00 65535.00 FORMAT "%8.2" NUMBER 4 /end CHARACTERISTIC
/begin CHARACTERISTIC DSM_CDCDfp_GlwCDGlwCirc6_C "CARB spezifischer Fehlercode fuer Fehlerpfad Dfp_GlwCDGlwCirc6" VAL_BLK 0xCBAB4 Kwb_Wu16 65535.00 OneToOne 0.00 65535.00 FORMAT "%8.2" NUMBER 4 /end CHARACTERISTIC
/begin CHARACTERISTIC DSM_CDCDfp_GlwCDGlwCirc7_C "CARB spezifischer Fehlercode fuer Fehlerpfad Dfp_GlwCDGlwCirc7" VAL_BLK 0xCBABC Kwb_Wu16 65535.00 OneToOne 0.00 65535.00 FORMAT "%8.2" NUMBER 4 /end CHARACTERISTIC
/begin CHARACTERISTIC DSM_CDCDfp_GlwCDGlwCirc8_C "CARB spezifischer Fehlercode fuer Fehlerpfad Dfp_GlwCDGlwCirc8" VAL_BLK 0xCBAC4 Kwb_Wu16 65535.00 OneToOne 0.00 65535.00 FORMAT "%8.2" NUMBER 4 /end CHARACTERISTIC
/begin CHARACTERISTIC DSM_CDCDfp_GlwCtl_C "CARB spezifischer Fehlercode fuer Fehlerpfad Dfp_GlwCtl" VAL_BLK 0xCBACC Kwb_Wu16 65535.00 OneToOne 0.00 65535.00 FORMAT "%8.2" NUMBER 4 /end CHARACTERISTIC
/begin CHARACTERISTIC DSM_CDCDfp_HWEMonCom_C "CARB spezifischer Fehlercode fuer Fehlerpfad Dfp_HWEMonCom" VAL_BLK 0xCBAD4 Kwb_Wu16 65535.00 OneToOne 0.00 65535.00 FORMAT "%8.2" NUMBER 4 /end CHARACTERISTIC
/begin CHARACTERISTIC DSM_CDCDfp_HWEMonEEPROM_C "CARB spezifischer Fehlercode fuer Fehlerpfad Dfp_HWEMonEEPROM" VAL_BLK 0xCBADC Kwb_Wu16 65535.00 OneToOne 0.00 65535.00 FORMAT "%8.2" NUMBER 4 /end CHARACTERISTIC
/begin CHARACTERISTIC DSM_CDCDfp_HWEMonRcyLocked_C "CARB spezifischer Fehlercode fuer Fehlerpfad Dfp_HWEMonRcyLocked" VAL_BLK 0xCBAE4 Kwb_Wu16 65535.00 OneToOne 0.00 65535.00 FORMAT "%8.2" NUMBER 4 /end CHARACTERISTIC
/begin CHARACTERISTIC DSM_CDCDfp_HWEMonRcySuppressed_C "CARB spezifischer Fehlercode fuer Fehlerpfad Dfp_HWEMonRcySuppressed" VAL_BLK 0xCBAEC Kwb_Wu16 65535.00 OneToOne 0.00 65535.00 FORMAT "%8.2" NUMBER 4 /end CHARACTERISTIC
/begin CHARACTERISTIC DSM_CDCDfp_HWEMonRcyVisible_C "CARB spezifischer Fehlercode fuer Fehlerpfad Dfp_HWEMonRcyVisible" VAL_BLK 0xCBAF4 Kwb_Wu16 65535.00 OneToOne 0.00 65535.00 FORMAT "%8.2" NUMBER 4 /end CHARACTERISTIC
/begin CHARACTERISTIC DSM_CDCDfp_HWEMonUMaxSupply_C "CARB spezifischer Fehlercode fuer Fehlerpfad Dfp_HWEMonUMaxSupply" VAL_BLK 0xCBAFC Kwb_Wu16 65535.00 OneToOne 0.00 65535.00 FORMAT "%8.2" NUMBER 4 /end CHARACTERISTIC
/begin CHARACTERISTIC DSM_CDCDfp_HWEMonUMinSupply_C "CARB spezifischer Fehlercode fuer Fehlerpfad Dfp_HWEMonUMinSupply" VAL_BLK 0xCBB04 Kwb_Wu16 65535.00 OneToOne 0.00 65535.00 FORMAT "%8.2" NUMBER 4 /end CHARACTERISTIC
/begin CHARACTERISTIC DSM_CDCDfp_IATSCD_C "CARB spezifischer Fehlercode fuer Fehlerpfad Dfp_IATSCD" VAL_BLK 0xCBB0C Kwb_Wu16 65535.00 OneToOne 0.00 65535.00 FORMAT "%8.2" NUMBER 4 /end CHARACTERISTIC
/begin CHARACTERISTIC DSM_CDCDfp_IATSCD_CATS_C "CARB spezifischer Fehlercode fuer Fehlerpfad Dfp_IATSCD_CATS" VAL_BLK 0xCBB14 Kwb_Wu16 65535.00 OneToOne 0.00 65535.00 FORMAT "%8.2" NUMBER 4 /end CHARACTERISTIC
/begin CHARACTERISTIC DSM_CDCDfp_IATSCD_CATSSec_C "CARB spezifischer Fehlercode fuer Fehlerpfad Dfp_IATSCD_CATSSec" VAL_BLK 0xCBB1C Kwb_Wu16 65535.00 OneToOne 0.00 65535.00 FORMAT "%8.2" NUMBER 4 /end CHARACTERISTIC
/begin CHARACTERISTIC DSM_CDCDfp_ImmCtlImmCD_C "CARB spezifischer Fehlercode fuer Fehlerpfad Dfp_ImmCtlImmCD" VAL_BLK 0xCBB24 Kwb_Wu16 65535.00 OneToOne 0.00 65535.00 FORMAT "%8.2" NUMBER 4 /end CHARACTERISTIC
/begin CHARACTERISTIC DSM_CDCDfp_ImmCtlImmEep_C "CARB spezifischer Fehlercode fuer Fehlerpfad Dfp_ImmCtlImmEep" VAL_BLK 0xCBB2C Kwb_Wu16 65535.00 OneToOne 0.00 65535.00 FORMAT "%8.2" NUMBER 4 /end CHARACTERISTIC
/begin CHARACTERISTIC DSM_CDCDfp_ImmCtlMpl_C "CARB spezifischer Fehlercode fuer Fehlerpfad Dfp_ImmCtlMpl" VAL_BLK 0xCBB34 Kwb_Wu16 65535.00 OneToOne 0.00 65535.00 FORMAT "%8.2" NUMBER 4 /end CHARACTERISTIC
/begin CHARACTERISTIC DSM_CDCDfp_IndSys1_C "CARB spezifischer Fehlercode fuer Fehlerpfad Dfp_IndSys1" VAL_BLK 0xCBB3C Kwb_Wu16 65535.00 OneToOne 0.00 65535.00 FORMAT "%8.2" NUMBER 4 /end CHARACTERISTIC
/begin CHARACTERISTIC DSM_CDCDfp_IndSys2_C "CARB spezifischer Fehlercode fuer Fehlerpfad Dfp_IndSys2" VAL_BLK 0xCBB44 Kwb_Wu16 65535.00 OneToOne 0.00 65535.00 FORMAT "%8.2" NUMBER 4 /end CHARACTERISTIC
/begin CHARACTERISTIC DSM_CDCDfp_InjCrv_InjLim_C "CARB spezifischer Fehlercode fuer Fehlerpfad Dfp_InjCrv_InjLim" VAL_BLK 0xCBB4C Kwb_Wu16 65535.00 OneToOne 0.00 65535.00 FORMAT "%8.2" NUMBER 4 /end CHARACTERISTIC
/begin CHARACTERISTIC DSM_CDCDfp_InjCtlAdjQnt_C "CARB spezifischer Fehlercode fuer Fehlerpfad Dfp_InjCtlAdjQnt" VAL_BLK 0xCBB54 Kwb_Wu16 65535.00 OneToOne 0.00 65535.00 FORMAT "%8.2" NUMBER 4 /end CHARACTERISTIC
/begin CHARACTERISTIC DSM_CDCDfp_InjCtlDrift_C "CARB spezifischer Fehlercode fuer Fehlerpfad Dfp_InjCtlDrift" VAL_BLK 0xCBB5C Kwb_Wu16 65535.00 OneToOne 0.00 65535.00 FORMAT "%8.2" NUMBER 4 /end CHARACTERISTIC
/begin CHARACTERISTIC DSM_CDCDfp_InjVCDActrChrg_C "CARB spezifischer Fehlercode fuer Fehlerpfad Dfp_InjVCDActrChrg" VAL_BLK 0xCBB64 Kwb_Wu16 65535.00 OneToOne 0.00 65535.00 FORMAT "%8.2" NUMBER 4 /end CHARACTERISTIC
/begin CHARACTERISTIC DSM_CDCDfp_InjVCDActrEnrg1_C "CARB spezifischer Fehlercode fuer Fehlerpfad Dfp_InjVCDActrEnrg1" VAL_BLK 0xCBB6C Kwb_Wu16 65535.00 OneToOne 0.00 65535.00 FORMAT "%8.2" NUMBER 4 /end CHARACTERISTIC
/begin CHARACTERISTIC DSM_CDCDfp_InjVCDActrEnrg2_C "CARB spezifischer Fehlercode fuer Fehlerpfad Dfp_InjVCDActrEnrg2" VAL_BLK 0xCBB74 Kwb_Wu16 65535.00 OneToOne 0.00 65535.00 FORMAT "%8.2" NUMBER 4 /end CHARACTERISTIC
/begin CHARACTERISTIC DSM_CDCDfp_InjVCDActrEnrg3_C "CARB spezifischer Fehlercode fuer Fehlerpfad Dfp_InjVCDActrEnrg3" VAL_BLK 0xCBB7C Kwb_Wu16 65535.00 OneToOne 0.00 65535.00 FORMAT "%8.2" NUMBER 4 /end CHARACTERISTIC
/begin CHARACTERISTIC DSM_CDCDfp_InjVCDActrEnrg4_C "CARB spezifischer Fehlercode fuer Fehlerpfad Dfp_InjVCDActrEnrg4" VAL_BLK 0xCBB84 Kwb_Wu16 65535.00 OneToOne 0.00 65535.00 FORMAT "%8.2" NUMBER 4 /end CHARACTERISTIC
/begin CHARACTERISTIC DSM_CDCDfp_InjVCDActrEnrg5_C "CARB spezifischer Fehlercode fuer Fehlerpfad Dfp_InjVCDActrEnrg5" VAL_BLK 0xCBB8C Kwb_Wu16 65535.00 OneToOne 0.00 65535.00 FORMAT "%8.2" NUMBER 4 /end CHARACTERISTIC
/begin CHARACTERISTIC DSM_CDCDfp_InjVCDActrEnrg6_C "CARB spezifischer Fehlercode fuer Fehlerpfad Dfp_InjVCDActrEnrg6" VAL_BLK 0xCBB94 Kwb_Wu16 65535.00 OneToOne 0.00 65535.00 FORMAT "%8.2" NUMBER 4 /end CHARACTERISTIC
/begin CHARACTERISTIC DSM_CDCDfp_InjVCDActrEnrg7_C "CARB spezifischer Fehlercode fuer Fehlerpfad Dfp_InjVCDActrEnrg7" VAL_BLK 0xCBB9C Kwb_Wu16 65535.00 OneToOne 0.00 65535.00 FORMAT "%8.2" NUMBER 4 /end CHARACTERISTIC
/begin CHARACTERISTIC DSM_CDCDfp_InjVCDActrEnrg8_C "CARB spezifischer Fehlercode fuer Fehlerpfad Dfp_InjVCDActrEnrg8" VAL_BLK 0xCBBA4 Kwb_Wu16 65535.00 OneToOne 0.00 65535.00 FORMAT "%8.2" NUMBER 4 /end CHARACTERISTIC
/begin CHARACTERISTIC DSM_CDCDfp_InjVCDActrVolt_C "CARB spezifischer Fehlercode fuer Fehlerpfad Dfp_InjVCDActrVolt" VAL_BLK 0xCBBAC Kwb_Wu16 65535.00 OneToOne 0.00 65535.00 FORMAT "%8.2" NUMBER 4 /end CHARACTERISTIC
/begin CHARACTERISTIC DSM_CDCDfp_InjVCDClsBank1_C "CARB spezifischer Fehlercode fuer Fehlerpfad Dfp_InjVCDClsBank1" VAL_BLK 0xCBBB4 Kwb_Wu16 65535.00 OneToOne 0.00 65535.00 FORMAT "%8.2" NUMBER 4 /end CHARACTERISTIC
/begin CHARACTERISTIC DSM_CDCDfp_InjVCDClsBank2_C "CARB spezifischer Fehlercode fuer Fehlerpfad Dfp_InjVCDClsBank2" VAL_BLK 0xCBBBC Kwb_Wu16 65535.00 OneToOne 0.00 65535.00 FORMAT "%8.2" NUMBER 4 /end CHARACTERISTIC
/begin CHARACTERISTIC DSM_CDCDfp_InjVCDMonCab_C "CARB spezifischer Fehlercode fuer Fehlerpfad Dfp_InjVCDMonCab" VAL_BLK 0xCBBC4 Kwb_Wu16 65535.00 OneToOne 0.00 65535.00 FORMAT "%8.2" NUMBER 4 /end CHARACTERISTIC
/begin CHARACTERISTIC DSM_CDCDfp_InjVCDMonSwt_C "CARB spezifischer Fehlercode fuer Fehlerpfad Dfp_InjVCDMonSwt" VAL_BLK 0xCBBCC Kwb_Wu16 65535.00 OneToOne 0.00 65535.00 FORMAT "%8.2" NUMBER 4 /end CHARACTERISTIC
/begin CHARACTERISTIC DSM_CDCDfp_InjVCDShOffDCDC_C "CARB spezifischer Fehlercode fuer Fehlerpfad Dfp_InjVCDShOffDCDC" VAL_BLK 0xCBBD4 Kwb_Wu16 65535.00 OneToOne 0.00 65535.00 FORMAT "%8.2" NUMBER 4 /end CHARACTERISTIC
/begin CHARACTERISTIC DSM_CDCDfp_InjVCDUBuf1_C "CARB spezifischer Fehlercode fuer Fehlerpfad Dfp_InjVCDUBuf1" VAL_BLK 0xCBBDC Kwb_Wu16 65535.00 OneToOne 0.00 65535.00 FORMAT "%8.2" NUMBER 4 /end CHARACTERISTIC
/begin CHARACTERISTIC DSM_CDCDfp_InjVCDUBuf2_C "CARB spezifischer Fehlercode fuer Fehlerpfad Dfp_InjVCDUBuf2" VAL_BLK 0xCBBE4 Kwb_Wu16 65535.00 OneToOne 0.00 65535.00 FORMAT "%8.2" NUMBER 4 /end CHARACTERISTIC
/begin CHARACTERISTIC DSM_CDCDfp_InjVCD_CY370Ampl_C "CARB spezifischer Fehlercode fuer Fehlerpfad Dfp_InjVCD_CY370Ampl" VAL_BLK 0xCBBEC Kwb_Wu16 65535.00 OneToOne 0.00 65535.00 FORMAT "%8.2" NUMBER 4 /end CHARACTERISTIC
/begin CHARACTERISTIC DSM_CDCDfp_InjVCD_DrvTime_C "CARB spezifischer Fehlercode fuer Fehlerpfad Dfp_InjVCD_DrvTime" VAL_BLK 0xCBBF4 Kwb_Wu16 65535.00 OneToOne 0.00 65535.00 FORMAT "%8.2" NUMBER 4 /end CHARACTERISTIC
/begin CHARACTERISTIC DSM_CDCDfp_InjVCD_DrvTimeRcy_C "CARB spezifischer Fehlercode fuer Fehlerpfad Dfp_InjVCD_DrvTimeRcy" VAL_BLK 0xCBBFC Kwb_Wu16 65535.00 OneToOne 0.00 65535.00 FORMAT "%8.2" NUMBER 4 /end CHARACTERISTIC
/begin CHARACTERISTIC DSM_CDCDfp_InjVCD_TPUErr_C "CARB spezifischer Fehlercode fuer Fehlerpfad Dfp_InjVCDTpuErr" VAL_BLK 0xCBC04 Kwb_Wu16 65535.00 OneToOne 0.00 65535.00 FORMAT "%8.2" NUMBER 4 /end CHARACTERISTIC
/begin CHARACTERISTIC DSM_CDCDfp_InjVlvBnk1A_C "CARB spezifischer Fehlercode fuer Fehlerpfad Dfp_InjVlvBnk1A" VAL_BLK 0xCBC0C Kwb_Wu16 65535.00 OneToOne 0.00 65535.00 FORMAT "%8.2" NUMBER 4 /end CHARACTERISTIC
/begin CHARACTERISTIC DSM_CDCDfp_InjVlvBnk1B_C "CARB spezifischer Fehlercode fuer Fehlerpfad Dfp_InjVlvBnk1B" VAL_BLK 0xCBC14 Kwb_Wu16 65535.00 OneToOne 0.00 65535.00 FORMAT "%8.2" NUMBER 4 /end CHARACTERISTIC
/begin CHARACTERISTIC DSM_CDCDfp_InjVlvBnk2A_C "CARB spezifischer Fehlercode fuer Fehlerpfad Dfp_InjVlvBnk2A" VAL_BLK 0xCBC1C Kwb_Wu16 65535.00 OneToOne 0.00 65535.00 FORMAT "%8.2" NUMBER 4 /end CHARACTERISTIC
/begin CHARACTERISTIC DSM_CDCDfp_InjVlvBnk2B_C "CARB spezifischer Fehlercode fuer Fehlerpfad Dfp_InjVlvBnk2B" VAL_BLK 0xCBC24 Kwb_Wu16 65535.00 OneToOne 0.00 65535.00 FORMAT "%8.2" NUMBER 4 /end CHARACTERISTIC
/begin CHARACTERISTIC DSM_CDCDfp_InjVlvChipA_C "CARB spezifischer Fehlercode fuer Fehlerpfad Dfp_InjVlvChipA" VAL_BLK 0xCBC2C Kwb_Wu16 65535.00 OneToOne 0.00 65535.00 FORMAT "%8.2" NUMBER 4 /end CHARACTERISTIC
/begin CHARACTERISTIC DSM_CDCDfp_InjVlvChipB_C "CARB spezifischer Fehlercode fuer Fehlerpfad Dfp_InjVlvChipB" VAL_BLK 0xCBC34 Kwb_Wu16 65535.00 OneToOne 0.00 65535.00 FORMAT "%8.2" NUMBER 4 /end CHARACTERISTIC
/begin CHARACTERISTIC DSM_CDCDfp_InjVlvCyl1A_C "CARB spezifischer Fehlercode fuer Fehlerpfad Dfp_InjVlvCyl1A" VAL_BLK 0xCBC3C Kwb_Wu16 65535.00 OneToOne 0.00 65535.00 FORMAT "%8.2" NUMBER 4 /end CHARACTERISTIC
/begin CHARACTERISTIC DSM_CDCDfp_InjVlvCyl1B_C "CARB spezifischer Fehlercode fuer Fehlerpfad Dfp_InjVlvCyl1B" VAL_BLK 0xCBC44 Kwb_Wu16 65535.00 OneToOne 0.00 65535.00 FORMAT "%8.2" NUMBER 4 /end CHARACTERISTIC
/begin CHARACTERISTIC DSM_CDCDfp_InjVlvCyl1C_C "CARB spezifischer Fehlercode fuer Fehlerpfad Dfp_InjVlvCyl1C" VAL_BLK 0xCBC4C Kwb_Wu16 65535.00 OneToOne 0.00 65535.00 FORMAT "%8.2" NUMBER 4 /end CHARACTERISTIC
/begin CHARACTERISTIC DSM_CDCDfp_InjVlvCyl2A_C "CARB spezifischer Fehlercode fuer Fehlerpfad Dfp_InjVlvCyl2A" VAL_BLK 0xCBC54 Kwb_Wu16 65535.00 OneToOne 0.00 65535.00 FORMAT "%8.2" NUMBER 4 /end CHARACTERISTIC
/begin CHARACTERISTIC DSM_CDCDfp_InjVlvCyl2B_C "CARB spezifischer Fehlercode fuer Fehlerpfad Dfp_InjVlvCyl2B" VAL_BLK 0xCBC5C Kwb_Wu16 65535.00 OneToOne 0.00 65535.00 FORMAT "%8.2" NUMBER 4 /end CHARACTERISTIC
/begin CHARACTERISTIC DSM_CDCDfp_InjVlvCyl2C_C "CARB spezifischer Fehlercode fuer Fehlerpfad Dfp_InjVlvCyl2C" VAL_BLK 0xCBC64 Kwb_Wu16 65535.00 OneToOne 0.00 65535.00 FORMAT "%8.2" NUMBER 4 /end CHARACTERISTIC
/begin CHARACTERISTIC DSM_CDCDfp_InjVlvCyl3A_C "CARB spezifischer Fehlercode fuer Fehlerpfad Dfp_InjVlvCyl3A" VAL_BLK 0xCBC6C Kwb_Wu16 65535.00 OneToOne 0.00 65535.00 FORMAT "%8.2" NUMBER 4 /end CHARACTERISTIC
/begin CHARACTERISTIC DSM_CDCDfp_InjVlvCyl3B_C "CARB spezifischer Fehlercode fuer Fehlerpfad Dfp_InjVlvCyl3B" VAL_BLK 0xCBC74 Kwb_Wu16 65535.00 OneToOne 0.00 65535.00 FORMAT "%8.2" NUMBER 4 /end CHARACTERISTIC
/begin CHARACTERISTIC DSM_CDCDfp_InjVlvCyl3C_C "CARB spezifischer Fehlercode fuer Fehlerpfad Dfp_InjVlvCyl3C" VAL_BLK 0xCBC7C Kwb_Wu16 65535.00 OneToOne 0.00 65535.00 FORMAT "%8.2" NUMBER 4 /end CHARACTERISTIC
/begin CHARACTERISTIC DSM_CDCDfp_InjVlvCyl4A_C "CARB spezifischer Fehlercode fuer Fehlerpfad Dfp_InjVlvCyl4A" VAL_BLK 0xCBC84 Kwb_Wu16 65535.00 OneToOne 0.00 65535.00 FORMAT "%8.2" NUMBER 4 /end CHARACTERISTIC
/begin CHARACTERISTIC DSM_CDCDfp_InjVlvCyl4B_C "CARB spezifischer Fehlercode fuer Fehlerpfad Dfp_InjVlvCyl4B" VAL_BLK 0xCBC8C Kwb_Wu16 65535.00 OneToOne 0.00 65535.00 FORMAT "%8.2" NUMBER 4 /end CHARACTERISTIC
/begin CHARACTERISTIC DSM_CDCDfp_InjVlvCyl4C_C "CARB spezifischer Fehlercode fuer Fehlerpfad Dfp_InjVlvCyl4C" VAL_BLK 0xCBC94 Kwb_Wu16 65535.00 OneToOne 0.00 65535.00 FORMAT "%8.2" NUMBER 4 /end CHARACTERISTIC
/begin CHARACTERISTIC DSM_CDCDfp_InjVlvCyl5A_C "CARB spezifischer Fehlercode fuer Fehlerpfad Dfp_InjVlvCyl5A" VAL_BLK 0xCBC9C Kwb_Wu16 65535.00 OneToOne 0.00 65535.00 FORMAT "%8.2" NUMBER 4 /end CHARACTERISTIC
/begin CHARACTERISTIC DSM_CDCDfp_InjVlvCyl5B_C "CARB spezifischer Fehlercode fuer Fehlerpfad Dfp_InjVlvCyl5B" VAL_BLK 0xCBCA4 Kwb_Wu16 65535.00 OneToOne 0.00 65535.00 FORMAT "%8.2" NUMBER 4 /end CHARACTERISTIC
/begin CHARACTERISTIC DSM_CDCDfp_InjVlvCyl5C_C "CARB spezifischer Fehlercode fuer Fehlerpfad Dfp_InjVlvCyl5C" VAL_BLK 0xCBCAC Kwb_Wu16 65535.00 OneToOne 0.00 65535.00 FORMAT "%8.2" NUMBER 4 /end CHARACTERISTIC
/begin CHARACTERISTIC DSM_CDCDfp_InjVlvCyl6A_C "CARB spezifischer Fehlercode fuer Fehlerpfad Dfp_InjVlvCyl6A" VAL_BLK 0xCBCB4 Kwb_Wu16 65535.00 OneToOne 0.00 65535.00 FORMAT "%8.2" NUMBER 4 /end CHARACTERISTIC
/begin CHARACTERISTIC DSM_CDCDfp_InjVlvCyl6B_C "CARB spezifischer Fehlercode fuer Fehlerpfad Dfp_InjVlvCyl6B" VAL_BLK 0xCBCBC Kwb_Wu16 65535.00 OneToOne 0.00 65535.00 FORMAT "%8.2" NUMBER 4 /end CHARACTERISTIC
/begin CHARACTERISTIC DSM_CDCDfp_InjVlvCyl6C_C "CARB spezifischer Fehlercode fuer Fehlerpfad Dfp_InjVlvCyl6C" VAL_BLK 0xCBCC4 Kwb_Wu16 65535.00 OneToOne 0.00 65535.00 FORMAT "%8.2" NUMBER 4 /end CHARACTERISTIC
/begin CHARACTERISTIC DSM_CDCDfp_InjVlvCyl7A_C "CARB spezifischer Fehlercode fuer Fehlerpfad Dfp_InjVlvCyl7A" VAL_BLK 0xCBCCC Kwb_Wu16 65535.00 OneToOne 0.00 65535.00 FORMAT "%8.2" NUMBER 4 /end CHARACTERISTIC
/begin CHARACTERISTIC DSM_CDCDfp_InjVlvCyl7B_C "CARB spezifischer Fehlercode fuer Fehlerpfad Dfp_InjVlvCyl7B" VAL_BLK 0xCBCD4 Kwb_Wu16 65535.00 OneToOne 0.00 65535.00 FORMAT "%8.2" NUMBER 4 /end CHARACTERISTIC
/begin CHARACTERISTIC DSM_CDCDfp_InjVlvCyl7C_C "CARB spezifischer Fehlercode fuer Fehlerpfad Dfp_InjVlvCyl7C" VAL_BLK 0xCBCDC Kwb_Wu16 65535.00 OneToOne 0.00 65535.00 FORMAT "%8.2" NUMBER 4 /end CHARACTERISTIC
/begin CHARACTERISTIC DSM_CDCDfp_InjVlvCyl8A_C "CARB spezifischer Fehlercode fuer Fehlerpfad Dfp_InjVlvCyl8A" VAL_BLK 0xCBCE4 Kwb_Wu16 65535.00 OneToOne 0.00 65535.00 FORMAT "%8.2" NUMBER 4 /end CHARACTERISTIC
/begin CHARACTERISTIC DSM_CDCDfp_InjVlvCyl8B_C "CARB spezifischer Fehlercode fuer Fehlerpfad Dfp_InjVlvCyl8B" VAL_BLK 0xCBCEC Kwb_Wu16 65535.00 OneToOne 0.00 65535.00 FORMAT "%8.2" NUMBER 4 /end CHARACTERISTIC
/begin CHARACTERISTIC DSM_CDCDfp_InjVlvCyl8C_C "CARB spezifischer Fehlercode fuer Fehlerpfad Dfp_InjVlvCyl8C" VAL_BLK 0xCBCF4 Kwb_Wu16 65535.00 OneToOne 0.00 65535.00 FORMAT "%8.2" NUMBER 4 /end CHARACTERISTIC
/begin CHARACTERISTIC DSM_CDCDfp_InjVlvNVC1_C "CARB spezifischer Fehlercode fuer Fehlerpfad Dfp_InjVlvNVC1" VAL_BLK 0xCBCFC Kwb_Wu16 65535.00 OneToOne 0.00 65535.00 FORMAT "%8.2" NUMBER 4 /end CHARACTERISTIC
/begin CHARACTERISTIC DSM_CDCDfp_InjVlvNVC2_C "CARB spezifischer Fehlercode fuer Fehlerpfad Dfp_InjVlvNVC2" VAL_BLK 0xCBD04 Kwb_Wu16 65535.00 OneToOne 0.00 65535.00 FORMAT "%8.2" NUMBER 4 /end CHARACTERISTIC
/begin CHARACTERISTIC DSM_CDCDfp_InjVlvNVC3_C "CARB spezifischer Fehlercode fuer Fehlerpfad Dfp_InjVlvNVC3" VAL_BLK 0xCBD0C Kwb_Wu16 65535.00 OneToOne 0.00 65535.00 FORMAT "%8.2" NUMBER 4 /end CHARACTERISTIC
/begin CHARACTERISTIC DSM_CDCDfp_InjVlvNVC4_C "CARB spezifischer Fehlercode fuer Fehlerpfad Dfp_InjVlvNVC4" VAL_BLK 0xCBD14 Kwb_Wu16 65535.00 OneToOne 0.00 65535.00 FORMAT "%8.2" NUMBER 4 /end CHARACTERISTIC
/begin CHARACTERISTIC DSM_CDCDfp_InjVlvNVC5_C "CARB spezifischer Fehlercode fuer Fehlerpfad Dfp_InjVlvNVC5" VAL_BLK 0xCBD1C Kwb_Wu16 65535.00 OneToOne 0.00 65535.00 FORMAT "%8.2" NUMBER 4 /end CHARACTERISTIC
/begin CHARACTERISTIC DSM_CDCDfp_InjVlvNVC6_C "CARB spezifischer Fehlercode fuer Fehlerpfad Dfp_InjVlvNVC6" VAL_BLK 0xCBD24 Kwb_Wu16 65535.00 OneToOne 0.00 65535.00 FORMAT "%8.2" NUMBER 4 /end CHARACTERISTIC
/begin CHARACTERISTIC DSM_CDCDfp_InjVlvNVC7_C "CARB spezifischer Fehlercode fuer Fehlerpfad Dfp_InjVlvNVC7" VAL_BLK 0xCBD2C Kwb_Wu16 65535.00 OneToOne 0.00 65535.00 FORMAT "%8.2" NUMBER 4 /end CHARACTERISTIC
/begin CHARACTERISTIC DSM_CDCDfp_InjVlvNVC8_C "CARB spezifischer Fehlercode fuer Fehlerpfad Dfp_InjVlvNVC8" VAL_BLK 0xCBD34 Kwb_Wu16 65535.00 OneToOne 0.00 65535.00 FORMAT "%8.2" NUMBER 4 /end CHARACTERISTIC
/begin CHARACTERISTIC DSM_CDCDfp_KeyCheck_C "CARB spezifischer Fehlercode fuer Fehlerpfad Dfp_KeyCheck" VAL_BLK 0xCBD3C Kwb_Wu16 65535.00 OneToOne 0.00 65535.00 FORMAT "%8.2" NUMBER 4 /end CHARACTERISTIC
/begin CHARACTERISTIC DSM_CDCDfp_LIGovECUTransMode_C "CARB spezifischer Fehlercode fuer Fehlerpfad Dfp_LIGovECUTransMode" VAL_BLK 0xCBD44 Kwb_Wu16 65535.00 OneToOne 0.00 65535.00 FORMAT "%8.2" NUMBER 4 /end CHARACTERISTIC
/begin CHARACTERISTIC DSM_CDCDfp_LPACD_Max_C "CARB spezifischer Fehlercode fuer Fehlerpfad Dfp_LPACD_Max" VAL_BLK 0xCBD4C Kwb_Wu16 65535.00 OneToOne 0.00 65535.00 FORMAT "%8.2" NUMBER 4 /end CHARACTERISTIC
/begin CHARACTERISTIC DSM_CDCDfp_LPACD_Min_C "CARB spezifischer Fehlercode fuer Fehlerpfad Dfp_LPACD_Min" VAL_BLK 0xCBD54 Kwb_Wu16 65535.00 OneToOne 0.00 65535.00 FORMAT "%8.2" NUMBER 4 /end CHARACTERISTIC
/begin CHARACTERISTIC DSM_CDCDfp_LPACD_SigNpl_C "CARB spezifischer Fehlercode fuer Fehlerpfad Dfp_LPACD_SigNpl" VAL_BLK 0xCBD5C Kwb_Wu16 65535.00 OneToOne 0.00 65535.00 FORMAT "%8.2" NUMBER 4 /end CHARACTERISTIC
/begin CHARACTERISTIC DSM_CDCDfp_LSUCDCircNernst0B1_C "CARB spezifischer Fehlercode fuer Fehlerpfad Dfp_LSUCDCircNernst0B1" VAL_BLK 0xCBD64 Kwb_Wu16 65535.00 OneToOne 0.00 65535.00 FORMAT "%8.2" NUMBER 4 /end CHARACTERISTIC
/begin CHARACTERISTIC DSM_CDCDfp_LSUCDCircNernst0B2_C "CARB spezifischer Fehlercode fuer Fehlerpfad Dfp_LSUCDCircNernst0B2" VAL_BLK 0xCBD6C Kwb_Wu16 65535.00 OneToOne 0.00 65535.00 FORMAT "%8.2" NUMBER 4 /end CHARACTERISTIC
/begin CHARACTERISTIC DSM_CDCDfp_LSUCDCircPumpCur0B1_C "CARB spezifischer Fehlercode fuer Fehlerpfad Dfp_LSUCDCircPumpCur0B1" VAL_BLK 0xCBD74 Kwb_Wu16 65535.00 OneToOne 0.00 65535.00 FORMAT "%8.2" NUMBER 4 /end CHARACTERISTIC
/begin CHARACTERISTIC DSM_CDCDfp_LSUCDCircPumpCur0B2_C "CARB spezifischer Fehlercode fuer Fehlerpfad Dfp_LSUCDCircPumpCur0B2" VAL_BLK 0xCBD7C Kwb_Wu16 65535.00 OneToOne 0.00 65535.00 FORMAT "%8.2" NUMBER 4 /end CHARACTERISTIC
/begin CHARACTERISTIC DSM_CDCDfp_LSUCDCircVirtGnd0B1_C "CARB spezifischer Fehlercode fuer Fehlerpfad Dfp_LSUCDCircVirtGnd0B1" VAL_BLK 0xCBD84 Kwb_Wu16 65535.00 OneToOne 0.00 65535.00 FORMAT "%8.2" NUMBER 4 /end CHARACTERISTIC
/begin CHARACTERISTIC DSM_CDCDfp_LSUCDCircVirtGnd0B2_C "CARB spezifischer Fehlercode fuer Fehlerpfad Dfp_LSUCDCircVirtGnd0B2" VAL_BLK 0xCBD8C Kwb_Wu16 65535.00 OneToOne 0.00 65535.00 FORMAT "%8.2" NUMBER 4 /end CHARACTERISTIC
/begin CHARACTERISTIC DSM_CDCDfp_LSUCDHeater0B1_C "CARB spezifischer Fehlercode fuer Fehlerpfad Dfp_LSUCDHeater0B1" VAL_BLK 0xCBD94 Kwb_Wu16 65535.00 OneToOne 0.00 65535.00 FORMAT "%8.2" NUMBER 4 /end CHARACTERISTIC
/begin CHARACTERISTIC DSM_CDCDfp_LSUCDHeater0B2_C "CARB spezifischer Fehlercode fuer Fehlerpfad Dfp_LSUCDHeater0B2" VAL_BLK 0xCBD9C Kwb_Wu16 65535.00 OneToOne 0.00 65535.00 FORMAT "%8.2" NUMBER 4 /end CHARACTERISTIC
/begin CHARACTERISTIC DSM_CDCDfp_LSUCDHtCoup0B1_C "CARB spezifischer Fehlercode fuer Fehlerpfad Dfp_LSUCDHtCoup0B1" VAL_BLK 0xCBDA4 Kwb_Wu16 65535.00 OneToOne 0.00 65535.00 FORMAT "%8.2" NUMBER 4 /end CHARACTERISTIC
/begin CHARACTERISTIC DSM_CDCDfp_LSUCDHtCoup0B2_C "CARB spezifischer Fehlercode fuer Fehlerpfad Dfp_LSUCDHtCoup0B2" VAL_BLK 0xCBDAC Kwb_Wu16 65535.00 OneToOne 0.00 65535.00 FORMAT "%8.2" NUMBER 4 /end CHARACTERISTIC
/begin CHARACTERISTIC DSM_CDCDfp_LSUCDO20B1_C "CARB spezifischer Fehlercode fuer Fehlerpfad Dfp_LSUCDO20B1" VAL_BLK 0xCBDB4 Kwb_Wu16 65535.00 OneToOne 0.00 65535.00 FORMAT "%8.2" NUMBER 4 /end CHARACTERISTIC
/begin CHARACTERISTIC DSM_CDCDfp_LSUCDO20B2_C "CARB spezifischer Fehlercode fuer Fehlerpfad Dfp_LSUCDO20B2" VAL_BLK 0xCBDBC Kwb_Wu16 65535.00 OneToOne 0.00 65535.00 FORMAT "%8.2" NUMBER 4 /end CHARACTERISTIC
/begin CHARACTERISTIC DSM_CDCDfp_LSUCDO2Clb0B1_C "CARB spezifischer Fehlercode fuer Fehlerpfad Dfp_LSUCDO2Clb0B1" VAL_BLK 0xCBDC4 Kwb_Wu16 65535.00 OneToOne 0.00 65535.00 FORMAT "%8.2" NUMBER 4 /end CHARACTERISTIC
/begin CHARACTERISTIC DSM_CDCDfp_LSUCDO2Clb0B2_C "CARB spezifischer Fehlercode fuer Fehlerpfad Dfp_LSUCDO2Clb0B2" VAL_BLK 0xCBDCC Kwb_Wu16 65535.00 OneToOne 0.00 65535.00 FORMAT "%8.2" NUMBER 4 /end CHARACTERISTIC
/begin CHARACTERISTIC DSM_CDCDfp_LSUCDRiClb0B1_C "CARB spezifischer Fehlercode fuer Fehlerpfad Dfp_LSUCDRiClb0B1" VAL_BLK 0xCBDD4 Kwb_Wu16 65535.00 OneToOne 0.00 65535.00 FORMAT "%8.2" NUMBER 4 /end CHARACTERISTIC
/begin CHARACTERISTIC DSM_CDCDfp_LSUCDRiClb0B2_C "CARB spezifischer Fehlercode fuer Fehlerpfad Dfp_LSUCDRiClb0B2" VAL_BLK 0xCBDDC Kwb_Wu16 65535.00 OneToOne 0.00 65535.00 FORMAT "%8.2" NUMBER 4 /end CHARACTERISTIC
/begin CHARACTERISTIC DSM_CDCDfp_LSUCDSPI0B1_C "CARB spezifischer Fehlercode fuer Fehlerpfad Dfp_LSUCDSPI0B1" VAL_BLK 0xCBDE4 Kwb_Wu16 65535.00 OneToOne 0.00 65535.00 FORMAT "%8.2" NUMBER 4 /end CHARACTERISTIC
/begin CHARACTERISTIC DSM_CDCDfp_LSUCDSPI0B2_C "CARB spezifischer Fehlercode fuer Fehlerpfad Dfp_LSUCDSPI0B2" VAL_BLK 0xCBDEC Kwb_Wu16 65535.00 OneToOne 0.00 65535.00 FORMAT "%8.2" NUMBER 4 /end CHARACTERISTIC
/begin CHARACTERISTIC DSM_CDCDfp_LSUCDSPIBattLow0B1_C "CARB spezifischer Fehlercode fuer Fehlerpfad Dfp_LSUCDSPIBattLow0B1" VAL_BLK 0xCBDF4 Kwb_Wu16 65535.00 OneToOne 0.00 65535.00 FORMAT "%8.2" NUMBER 4 /end CHARACTERISTIC
/begin CHARACTERISTIC DSM_CDCDfp_LSUCDSPIBattLow0B2_C "CARB spezifischer Fehlercode fuer Fehlerpfad Dfp_LSUCDSPIBattLow0B2" VAL_BLK 0xCBDFC Kwb_Wu16 65535.00 OneToOne 0.00 65535.00 FORMAT "%8.2" NUMBER 4 /end CHARACTERISTIC
/begin CHARACTERISTIC DSM_CDCDfp_LSUCDWireIP0B1_C "CARB spezifischer Fehlercode fuer Fehlerpfad Dfp_LSUCDWireIP0B1" VAL_BLK 0xCBE04 Kwb_Wu16 65535.00 OneToOne 0.00 65535.00 FORMAT "%8.2" NUMBER 4 /end CHARACTERISTIC
/begin CHARACTERISTIC DSM_CDCDfp_LSUCDWireIP0B2_C "CARB spezifischer Fehlercode fuer Fehlerpfad Dfp_LSUCDWireIP0B2" VAL_BLK 0xCBE0C Kwb_Wu16 65535.00 OneToOne 0.00 65535.00 FORMAT "%8.2" NUMBER 4 /end CHARACTERISTIC
/begin CHARACTERISTIC DSM_CDCDfp_LSUCtlRiExc0B1_C "CARB spezifischer Fehlercode fuer Fehlerpfad Dfp_LSUCtlRiExc0B1" VAL_BLK 0xCBE14 Kwb_Wu16 65535.00 OneToOne 0.00 65535.00 FORMAT "%8.2" NUMBER 4 /end CHARACTERISTIC
/begin CHARACTERISTIC DSM_CDCDfp_LSUCtlRiExc0B2_C "CARB spezifischer Fehlercode fuer Fehlerpfad Dfp_LSUCtlRiExc0B2" VAL_BLK 0xCBE1C Kwb_Wu16 65535.00 OneToOne 0.00 65535.00 FORMAT "%8.2" NUMBER 4 /end CHARACTERISTIC
/begin CHARACTERISTIC DSM_CDCDfp_LSUMon1SensB1_C "CARB spezifischer Fehlercode fuer Fehlerpfad Dfp_LSUMon1SensB1" VAL_BLK 0xCBE24 Kwb_Wu16 65535.00 OneToOne 0.00 65535.00 FORMAT "%8.2" NUMBER 4 /end CHARACTERISTIC
/begin CHARACTERISTIC DSM_CDCDfp_LSUMon1SensB2_C "CARB spezifischer Fehlercode fuer Fehlerpfad Dfp_LSUMon1SensB2" VAL_BLK 0xCBE2C Kwb_Wu16 65535.00 OneToOne 0.00 65535.00 FORMAT "%8.2" NUMBER 4 /end CHARACTERISTIC
/begin CHARACTERISTIC DSM_CDCDfp_LSUMon2SensB1_C "CARB spezifischer Fehlercode fuer Fehlerpfad Dfp_LSUMon2SensB1" VAL_BLK 0xCBE34 Kwb_Wu16 65535.00 OneToOne 0.00 65535.00 FORMAT "%8.2" NUMBER 4 /end CHARACTERISTIC
/begin CHARACTERISTIC DSM_CDCDfp_LSUMon2SensB2_C "CARB spezifischer Fehlercode fuer Fehlerpfad Dfp_LSUMon2SensB2" VAL_BLK 0xCBE3C Kwb_Wu16 65535.00 OneToOne 0.00 65535.00 FORMAT "%8.2" NUMBER 4 /end CHARACTERISTIC
/begin CHARACTERISTIC DSM_CDCDfp_MIL_C "CARB spezifischer Fehlercode fuer Fehlerpfad Dfp_MIL" VAL_BLK 0xCBE44 Kwb_Wu16 65535.00 OneToOne 0.00 65535.00 FORMAT "%8.2" NUMBER 4 /end CHARACTERISTIC
/begin CHARACTERISTIC DSM_CDCDfp_MRlyCD_C "CARB spezifischer Fehlercode fuer Fehlerpfad Dfp_MRlyCD" VAL_BLK 0xCBE4C Kwb_Wu16 65535.00 OneToOne 0.00 65535.00 FORMAT "%8.2" NUMBER 4 /end CHARACTERISTIC
/begin CHARACTERISTIC DSM_CDCDfp_MSMon_C "CARB spezifischer Fehlercode fuer Fehlerpfad Dfp_MSMon" VAL_BLK 0xCBE54 Kwb_Wu16 65535.00 OneToOne 0.00 65535.00 FORMAT "%8.2" NUMBER 4 /end CHARACTERISTIC
/begin CHARACTERISTIC DSM_CDCDfp_MSMonConsist_C "CARB spezifischer Fehlercode fuer Fehlerpfad Dfp_MSMonConsist" VAL_BLK 0xCBE5C Kwb_Wu16 65535.00 OneToOne 0.00 65535.00 FORMAT "%8.2" NUMBER 4 /end CHARACTERISTIC
/begin CHARACTERISTIC DSM_CDCDfp_MSMonPFlt1_C "CARB spezifischer Fehlercode fuer Fehlerpfad Dfp_MSMonPFlt1" VAL_BLK 0xCBE64 Kwb_Wu16 65535.00 OneToOne 0.00 65535.00 FORMAT "%8.2" NUMBER 4 /end CHARACTERISTIC
/begin CHARACTERISTIC DSM_CDCDfp_MSMonPFlt2_C "CARB spezifischer Fehlercode fuer Fehlerpfad Dfp_MSMonPFlt2" VAL_BLK 0xCBE6C Kwb_Wu16 65535.00 OneToOne 0.00 65535.00 FORMAT "%8.2" NUMBER 4 /end CHARACTERISTIC
/begin CHARACTERISTIC DSM_CDCDfp_MSMonPFlt3_C "CARB spezifischer Fehlercode fuer Fehlerpfad Dfp_MSMonPFlt3" VAL_BLK 0xCBE74 Kwb_Wu16 65535.00 OneToOne 0.00 65535.00 FORMAT "%8.2" NUMBER 4 /end CHARACTERISTIC
/begin CHARACTERISTIC DSM_CDCDfp_MSMonPFlt4_C "CARB spezifischer Fehlercode fuer Fehlerpfad Dfp_MSMonPFlt4" VAL_BLK 0xCBE7C Kwb_Wu16 65535.00 OneToOne 0.00 65535.00 FORMAT "%8.2" NUMBER 4 /end CHARACTERISTIC
/begin CHARACTERISTIC DSM_CDCDfp_MSMon_ARS_TO_C "CARB spezifischer Fehlercode fuer Fehlerpfad Dfp_MSMon_ARS_TO" VAL_BLK 0xCBE84 Kwb_Wu16 65535.00 OneToOne 0.00 65535.00 FORMAT "%8.2" NUMBER 4 /end CHARACTERISTIC
/begin CHARACTERISTIC DSM_CDCDfp_MSMon_AirCtl_C "CARB spezifischer Fehlercode fuer Fehlerpfad Dfp_MSMon_AirCtl" VAL_BLK 0xCBE8C Kwb_Wu16 65535.00 OneToOne 0.00 65535.00 FORMAT "%8.2" NUMBER 4 /end CHARACTERISTIC
/begin CHARACTERISTIC DSM_CDCDfp_MSMon_AirSys0_C "CARB spezifischer Fehlercode fuer Fehlerpfad Dfp_MSMon_AirSys0" VAL_BLK 0xCBE94 Kwb_Wu16 65535.00 OneToOne 0.00 65535.00 FORMAT "%8.2" NUMBER 4 /end CHARACTERISTIC
/begin CHARACTERISTIC DSM_CDCDfp_MSMon_AirSys1_C "CARB spezifischer Fehlercode fuer Fehlerpfad Dfp_MSMon_AirSys1" VAL_BLK 0xCBE9C Kwb_Wu16 65535.00 OneToOne 0.00 65535.00 FORMAT "%8.2" NUMBER 4 /end CHARACTERISTIC
/begin CHARACTERISTIC DSM_CDCDfp_MSMon_AirSys2_C "CARB spezifischer Fehlercode fuer Fehlerpfad Dfp_MSMon_AirSys2" VAL_BLK 0xCBEA4 Kwb_Wu16 65535.00 OneToOne 0.00 65535.00 FORMAT "%8.2" NUMBER 4 /end CHARACTERISTIC
/begin CHARACTERISTIC DSM_CDCDfp_MSMon_AirSys3_C "CARB spezifischer Fehlercode fuer Fehlerpfad Dfp_MSMon_AirSys3" VAL_BLK 0xCBEAC Kwb_Wu16 65535.00 OneToOne 0.00 65535.00 FORMAT "%8.2" NUMBER 4 /end CHARACTERISTIC
/begin CHARACTERISTIC DSM_CDCDfp_MSMon_AirSys4_C "CARB spezifischer Fehlercode fuer Fehlerpfad Dfp_MSMon_AirSys4" VAL_BLK 0xCBEB4 Kwb_Wu16 65535.00 OneToOne 0.00 65535.00 FORMAT "%8.2" NUMBER 4 /end CHARACTERISTIC
/begin CHARACTERISTIC DSM_CDCDfp_MSMon_AirSys7_C "CARB spezifischer Fehlercode fuer Fehlerpfad Dfp_MSMon_AirSys7" VAL_BLK 0xCBEBC Kwb_Wu16 65535.00 OneToOne 0.00 65535.00 FORMAT "%8.2" NUMBER 4 /end CHARACTERISTIC
/begin CHARACTERISTIC DSM_CDCDfp_MSMon_CanDef_C "CARB spezifischer Fehlercode fuer Fehlerpfad Dfp_MSMon_CanDef" VAL_BLK 0xCBEC4 Kwb_Wu16 65535.00 OneToOne 0.00 65535.00 FORMAT "%8.2" NUMBER 4 /end CHARACTERISTIC
/begin CHARACTERISTIC DSM_CDCDfp_MSMon_CoEng_OffVeh_C "CARB spezifischer Fehlercode fuer Fehlerpfad Dfp_MSMon_CoEng_OffVeh_C" VAL_BLK 0xCBECC Kwb_Wu16 65535.00 OneToOne 0.00 65535.00 FORMAT "%8.2" NUMBER 4 /end CHARACTERISTIC
/begin CHARACTERISTIC DSM_CDCDfp_MSMon_CoEng_Rev1_C "CARB spezifischer Fehlercode fuer Fehlerpfad Dfp_MSMon_CoEng_Rev1_C" VAL_BLK 0xCBED4 Kwb_Wu16 65535.00 OneToOne 0.00 65535.00 FORMAT "%8.2" NUMBER 4 /end CHARACTERISTIC
/begin CHARACTERISTIC DSM_CDCDfp_MSMon_CoEng_Rev2_C "CARB spezifischer Fehlercode fuer Fehlerpfad Dfp_MSMon_CoEng_Rev2_C" VAL_BLK 0xCBEDC Kwb_Wu16 65535.00 OneToOne 0.00 65535.00 FORMAT "%8.2" NUMBER 4 /end CHARACTERISTIC
/begin CHARACTERISTIC DSM_CDCDfp_MSMon_CoEng_RevMS_C "CARB spezifischer Fehlercode fuer Fehlerpfad Dfp_MSMon_CoEng_RevMS_C" VAL_BLK 0xCBEE4 Kwb_Wu16 65535.00 OneToOne 0.00 65535.00 FORMAT "%8.2" NUMBER 4 /end CHARACTERISTIC
/begin CHARACTERISTIC DSM_CDCDfp_MSMon_DSC_TO_C "CARB spezifischer Fehlercode fuer Fehlerpfad Dfp_MSMon_DSC_TO" VAL_BLK 0xCBEEC Kwb_Wu16 65535.00 OneToOne 0.00 65535.00 FORMAT "%8.2" NUMBER 4 /end CHARACTERISTIC
/begin CHARACTERISTIC DSM_CDCDfp_MSMon_EGS_TO_C "CARB spezifischer Fehlercode fuer Fehlerpfad Dfp_MSMon_EGS_TO" VAL_BLK 0xCBEF4 Kwb_Wu16 65535.00 OneToOne 0.00 65535.00 FORMAT "%8.2" NUMBER 4 /end CHARACTERISTIC
/begin CHARACTERISTIC DSM_CDCDfp_MSMon_FrmMngCoEng_C "CARB spezifischer Fehlercode fuer Fehlerpfad Dfp_MSMon_FrmMngCoEng" VAL_BLK 0xCBEFC Kwb_Wu16 65535.00 OneToOne 0.00 65535.00 FORMAT "%8.2" NUMBER 4 /end CHARACTERISTIC
/begin CHARACTERISTIC DSM_CDCDfp_MSMon_FrmMngPT_C "CARB spezifischer Fehlercode fuer Fehlerpfad Dfp_MSMon_FrmMngPT_C" VAL_BLK 0xCBF04 Kwb_Wu16 65535.00 OneToOne 0.00 65535.00 FORMAT "%8.2" NUMBER 4 /end CHARACTERISTIC
/begin CHARACTERISTIC DSM_CDCDfp_MSMon_FrmMngPT2_C "CARB spezifischer Fehlercode fuer Fehlerpfad Dfp_MSMon_FrmMngPT2" VAL_BLK 0xCBF0C Kwb_Wu16 65535.00 OneToOne 0.00 65535.00 FORMAT "%8.2" NUMBER 4 /end CHARACTERISTIC
/begin CHARACTERISTIC DSM_CDCDfp_MSMon_Mil_C "CARB spezifischer Fehlercode fuer Fehlerpfad Dfp_MSMon_Mil_C" VAL_BLK 0xCBF14 Kwb_Wu16 65535.00 OneToOne 0.00 65535.00 FORMAT "%8.2" NUMBER 4 /end CHARACTERISTIC
/begin CHARACTERISTIC DSM_CDCDfp_MSMon_NetMngPtCan_C "CARB spezifischer Fehlercode fuer Fehlerpfad Dfp_MSMon_NetMngPtCan" VAL_BLK 0xCBF1C Kwb_Wu16 65535.00 OneToOne 0.00 65535.00 FORMAT "%8.2" NUMBER 4 /end CHARACTERISTIC
/begin CHARACTERISTIC DSM_CDCDfp_MSMon_RailCDPMon_C "CARB spezifischer Fehlercode fuer Fehlerpfad Dfp_MSMon_RailCDPMon" VAL_BLK 0xCBF24 Kwb_Wu16 65535.00 OneToOne 0.00 65535.00 FORMAT "%8.2" NUMBER 4 /end CHARACTERISTIC
/begin CHARACTERISTIC DSM_CDCDfp_MSMon_StEGS_C "CARB spezifischer Fehlercode fuer Fehlerpfad Dfp_MSMon_StEGS" VAL_BLK 0xCBF2C Kwb_Wu16 65535.00 OneToOne 0.00 65535.00 FORMAT "%8.2" NUMBER 4 /end CHARACTERISTIC
/begin CHARACTERISTIC DSM_CDCDfp_MSMon_SysLamp_C "CARB spezifischer Fehlercode fuer Fehlerpfad Dfp_MSMon_SysLamp_C" VAL_BLK 0xCBF34 Kwb_Wu16 65535.00 OneToOne 0.00 65535.00 FORMAT "%8.2" NUMBER 4 /end CHARACTERISTIC
/begin CHARACTERISTIC DSM_CDCDfp_MSMon_ZFCClbActv_C "CARB spezifischer Fehlercode fuer Fehlerpfad Dfp_MSMon_ZFCClbActv" VAL_BLK 0xCBF3C Kwb_Wu16 65535.00 OneToOne 0.00 65535.00 FORMAT "%8.2" NUMBER 4 /end CHARACTERISTIC
/begin CHARACTERISTIC DSM_CDCDfp_MSMon_qLimErr_C "CARB spezifischer Fehlercode fuer Fehlerpfad Dfp_MSMon_qLimErr_C" VAL_BLK 0xCBF44 Kwb_Wu16 65535.00 OneToOne 0.00 65535.00 FORMAT "%8.2" NUMBER 4 /end CHARACTERISTIC
/begin CHARACTERISTIC DSM_CDCDfp_MSMon_trqCoDT_C "CARB spezifischer Fehlercode fuer Fehlerpfad Dfp_MSMon_trqCoDT_C" VAL_BLK 0xCBF4C Kwb_Wu16 65535.00 OneToOne 0.00 65535.00 FORMAT "%8.2" NUMBER 4 /end CHARACTERISTIC
/begin CHARACTERISTIC DSM_CDCDfp_MSMon_trqCoVeh_C "CARB spezifischer Fehlercode fuer Fehlerpfad Dfp_MSMon_trqCoVeh_C" VAL_BLK 0xCBF54 Kwb_Wu16 65535.00 OneToOne 0.00 65535.00 FORMAT "%8.2" NUMBER 4 /end CHARACTERISTIC
/begin CHARACTERISTIC DSM_CDCDfp_MSMon_trqCoVehLim_C "CARB spezifischer Fehlercode fuer Fehlerpfad Dfp_MSMon_trqCoVehLim_C" VAL_BLK 0xCBF5C Kwb_Wu16 65535.00 OneToOne 0.00 65535.00 FORMAT "%8.2" NUMBER 4 /end CHARACTERISTIC
/begin CHARACTERISTIC DSM_CDCDfp_MSMon_trqDesExt_C "CARB spezifischer Fehlercode fuer Fehlerpfad Dfp_MSMon_trqDesExt_C" VAL_BLK 0xCBF64 Kwb_Wu16 65535.00 OneToOne 0.00 65535.00 FORMAT "%8.2" NUMBER 4 /end CHARACTERISTIC
/begin CHARACTERISTIC DSM_CDCDfp_MSMon_trqDesExtRev_C "CARB spezifischer Fehlercode fuer Fehlerpfad Dfp_MSMon_trqDesExtRev_C" VAL_BLK 0xCBF6C Kwb_Wu16 65535.00 OneToOne 0.00 65535.00 FORMAT "%8.2" NUMBER 4 /end CHARACTERISTIC
/begin CHARACTERISTIC DSM_CDCDfp_MSMon_trqLimErr_C "CARB spezifischer Fehlercode fuer Fehlerpfad Dfp_MSMon_trqLimErr_C" VAL_BLK 0xCBF74 Kwb_Wu16 65535.00 OneToOne 0.00 65535.00 FORMAT "%8.2" NUMBER 4 /end CHARACTERISTIC
/begin CHARACTERISTIC DSM_CDCDfp_MSMon_trqLimErr1_C "CARB spezifischer Fehlercode fuer Fehlerpfad Dfp_MSMon_trqLimErr1_C" VAL_BLK 0xCBF7C Kwb_Wu16 65535.00 OneToOne 0.00 65535.00 FORMAT "%8.2" NUMBER 4 /end CHARACTERISTIC
/begin CHARACTERISTIC DSM_CDCDfp_MSMon_trqLimErr2_C "CARB spezifischer Fehlercode fuer Fehlerpfad Dfp_MSMon_trqLimErr2_C" VAL_BLK 0xCBF84 Kwb_Wu16 65535.00 OneToOne 0.00 65535.00 FORMAT "%8.2" NUMBER 4 /end CHARACTERISTIC
/begin CHARACTERISTIC DSM_CDCDfp_MSMon_trqLimErr3_C "CARB spezifischer Fehlercode fuer Fehlerpfad Dfp_MSMon_trqLimErr3" VAL_BLK 0xCBF8C Kwb_Wu16 65535.00 OneToOne 0.00 65535.00 FORMAT "%8.2" NUMBER 4 /end CHARACTERISTIC
/begin CHARACTERISTIC DSM_CDCDfp_MSMon_trqLimErr4_C "CARB spezifischer Fehlercode fuer Fehlerpfad Dfp_MSMon_trqLimErr4" VAL_BLK 0xCBF94 Kwb_Wu16 65535.00 OneToOne 0.00 65535.00 FORMAT "%8.2" NUMBER 4 /end CHARACTERISTIC
/begin CHARACTERISTIC DSM_CDCDfp_MSidCD_Comm_C "CARB spezifischer Fehlercode fuer Fehlerpfad Dfp_MSidCD_Comm" VAL_BLK 0xCBF9C Kwb_Wu16 65535.00 OneToOne 0.00 65535.00 FORMAT "%8.2" NUMBER 4 /end CHARACTERISTIC
/begin CHARACTERISTIC DSM_CDCDfp_MSidCD_EcuMixed_C "CARB spezifischer Fehlercode fuer Fehlerpfad Dfp_MSidCD_EcuMixed" VAL_BLK 0xCBFA4 Kwb_Wu16 65535.00 OneToOne 0.00 65535.00 FORMAT "%8.2" NUMBER 4 /end CHARACTERISTIC
/begin CHARACTERISTIC DSM_CDCDfp_MSidCD_Pin_C "CARB spezifischer Fehlercode fuer Fehlerpfad Dfp_MSidCD_Pin" VAL_BLK 0xCBFAC Kwb_Wu16 65535.00 OneToOne 0.00 65535.00 FORMAT "%8.2" NUMBER 4 /end CHARACTERISTIC
/begin CHARACTERISTIC DSM_CDCDfp_MSidCD_Sel_INI_C "CARB spezifischer Fehlercode fuer Fehlerpfad Dfp_MSidCD_Sel_INI" VAL_BLK 0xCBFB4 Kwb_Wu16 65535.00 OneToOne 0.00 65535.00 FORMAT "%8.2" NUMBER 4 /end CHARACTERISTIC
/begin CHARACTERISTIC DSM_CDCDfp_MSidCD_Select_C "CARB spezifischer Fehlercode fuer Fehlerpfad Dfp_MSidCD_Select" VAL_BLK 0xCBFBC Kwb_Wu16 65535.00 OneToOne 0.00 65535.00 FORMAT "%8.2" NUMBER 4 /end CHARACTERISTIC
/begin CHARACTERISTIC DSM_CDCDfp_MSid_SwCmp_C "CARB spezifischer Fehlercode fuer Fehlerpfad Dfp_MSid_SwCmp" VAL_BLK 0xCBFC4 Kwb_Wu16 65535.00 OneToOne 0.00 65535.00 FORMAT "%8.2" NUMBER 4 /end CHARACTERISTIC
/begin CHARACTERISTIC DSM_CDCDfp_MSid_regEEPDiff_C "CARB spezifischer Fehlercode fuer Fehlerpfad Dfp_MSid_regEEPDiff" VAL_BLK 0xCBFCC Kwb_Wu16 65535.00 OneToOne 0.00 65535.00 FORMAT "%8.2" NUMBER 4 /end CHARACTERISTIC
/begin CHARACTERISTIC DSM_CDCDfp_MeUnCDNoLoad_C "CARB spezifischer Fehlercode fuer Fehlerpfad Dfp_MeUnCDNoLoad" VAL_BLK 0xCBFD4 Kwb_Wu16 65535.00 OneToOne 0.00 65535.00 FORMAT "%8.2" NUMBER 4 /end CHARACTERISTIC
/begin CHARACTERISTIC DSM_CDCDfp_MeUnCDSCBat_C "CARB spezifischer Fehlercode fuer Fehlerpfad Dfp_MeUnCDSCBat" VAL_BLK 0xCBFDC Kwb_Wu16 65535.00 OneToOne 0.00 65535.00 FORMAT "%8.2" NUMBER 4 /end CHARACTERISTIC
/begin CHARACTERISTIC DSM_CDCDfp_MeUnCDSCGnd_C "CARB spezifischer Fehlercode fuer Fehlerpfad Dfp_MeUnCDSCGnd" VAL_BLK 0xCBFE4 Kwb_Wu16 65535.00 OneToOne 0.00 65535.00 FORMAT "%8.2" NUMBER 4 /end CHARACTERISTIC
/begin CHARACTERISTIC DSM_CDCDfp_MeUnCD_ADC_C "CARB spezifischer Fehlercode fuer Fehlerpfad Dfp_MeUnCD_ADC" VAL_BLK 0xCBFEC Kwb_Wu16 65535.00 OneToOne 0.00 65535.00 FORMAT "%8.2" NUMBER 4 /end CHARACTERISTIC
/begin CHARACTERISTIC DSM_CDCDfp_MeUnCD_SigTst_C "CARB spezifischer Fehlercode fuer Fehlerpfad Dfp_MeUnCD_SigTst" VAL_BLK 0xCBFF4 Kwb_Wu16 65535.00 OneToOne 0.00 65535.00 FORMAT "%8.2" NUMBER 4 /end CHARACTERISTIC
/begin CHARACTERISTIC DSM_CDCDfp_Montr_C "CARB spezifischer Fehlercode fuer Fehlerpfad Dfp_Montr" VAL_BLK 0xCBFFC Kwb_Wu16 65535.00 OneToOne 0.00 65535.00 FORMAT "%8.2" NUMBER 4 /end CHARACTERISTIC
/begin CHARACTERISTIC DSM_CDCDfp_NetMngDeviceA_C "CARB spezifischer Fehlercode fuer Fehlerpfad Dfp_NetMngDeviceA" VAL_BLK 0xCC004 Kwb_Wu16 65535.00 OneToOne 0.00 65535.00 FORMAT "%8.2" NUMBER 4 /end CHARACTERISTIC
/begin CHARACTERISTIC DSM_CDCDfp_NetMngDeviceB_C "CARB spezifischer Fehlercode fuer Fehlerpfad Dfp_NetMngDeviceB" VAL_BLK 0xCC00C Kwb_Wu16 65535.00 OneToOne 0.00 65535.00 FORMAT "%8.2" NUMBER 4 /end CHARACTERISTIC
/begin CHARACTERISTIC DSM_CDCDfp_NetMngDeviceC_C "CARB spezifischer Fehlercode fuer Fehlerpfad Dfp_NetMngDeviceC" VAL_BLK 0xCC014 Kwb_Wu16 65535.00 OneToOne 0.00 65535.00 FORMAT "%8.2" NUMBER 4 /end CHARACTERISTIC
/begin CHARACTERISTIC DSM_CDCDfp_NetMngPrvCan_C "CARB spezifischer Fehlercode fuer Fehlerpfad Dfp_NetMngPrvCan" VAL_BLK 0xCC01C Kwb_Wu16 65535.00 OneToOne 0.00 65535.00 FORMAT "%8.2" NUMBER 4 /end CHARACTERISTIC
/begin CHARACTERISTIC DSM_CDCDfp_NetMngPrvCanSlave_C "CARB spezifischer Fehlercode fuer Fehlerpfad Dfp_NetMngPrvCanSlave" VAL_BLK 0xCC024 Kwb_Wu16 65535.00 OneToOne 0.00 65535.00 FORMAT "%8.2" NUMBER 4 /end CHARACTERISTIC
/begin CHARACTERISTIC DSM_CDCDfp_NetMngPtCan_C "CARB spezifischer Fehlercode fuer Fehlerpfad Dfp_NetMngPtCan" VAL_BLK 0xCC02C Kwb_Wu16 65535.00 OneToOne 0.00 65535.00 FORMAT "%8.2" NUMBER 4 /end CHARACTERISTIC
/begin CHARACTERISTIC DSM_CDCDfp_NetMngPtCanSlave_C "CARB spezifischer Fehlercode fuer Fehlerpfad Dfp_NetMngPtCanSlave" VAL_BLK 0xCC034 Kwb_Wu16 65535.00 OneToOne 0.00 65535.00 FORMAT "%8.2" NUMBER 4 /end CHARACTERISTIC
/begin CHARACTERISTIC DSM_CDCDfp_OPSCD_Lamp_C "CARB spezifischer Fehlercode fuer Fehlerpfad Dfp_OPSCD_Lamp" VAL_BLK 0xCC03C Kwb_Wu16 65535.00 OneToOne 0.00 65535.00 FORMAT "%8.2" NUMBER 4 /end CHARACTERISTIC
/begin CHARACTERISTIC DSM_CDCDfp_OPSCD_anain_C "CARB spezifischer Fehlercode fuer Fehlerpfad Dfp_OPSCD_anain" VAL_BLK 0xCC044 Kwb_Wu16 65535.00 OneToOne 0.00 65535.00 FORMAT "%8.2" NUMBER 4 /end CHARACTERISTIC
/begin CHARACTERISTIC DSM_CDCDfp_OTSCD_C "CARB spezifischer Fehlercode fuer Fehlerpfad Dfp_OTSCD" VAL_BLK 0xCC04C Kwb_Wu16 65535.00 OneToOne 0.00 65535.00 FORMAT "%8.2" NUMBER 4 /end CHARACTERISTIC
/begin CHARACTERISTIC DSM_CDCDfp_OvRMon_C "CARB spezifischer Fehlercode fuer Fehlerpfad Dfp_OvRMon" VAL_BLK 0xCC054 Kwb_Wu16 65535.00 OneToOne 0.00 65535.00 FORMAT "%8.2" NUMBER 4 /end CHARACTERISTIC
/begin CHARACTERISTIC DSM_CDCDfp_OvRMonSigA_C "CARB spezifischer Fehlercode fuer Fehlerpfad Dfp_OvRMonSigA" VAL_BLK 0xCC05C Kwb_Wu16 65535.00 OneToOne 0.00 65535.00 FORMAT "%8.2" NUMBER 4 /end CHARACTERISTIC
/begin CHARACTERISTIC DSM_CDCDfp_OxiCCDTPreB1_C "CARB spezifischer Fehlercode fuer Fehlerpfad Dfp_OxiCCDTPreB1" VAL_BLK 0xCC064 Kwb_Wu16 65535.00 OneToOne 0.00 65535.00 FORMAT "%8.2" NUMBER 4 /end CHARACTERISTIC
/begin CHARACTERISTIC DSM_CDCDfp_OxiCCDTPreB2_C "CARB spezifischer Fehlercode fuer Fehlerpfad Dfp_OxiCCDTPreB2" VAL_BLK 0xCC06C Kwb_Wu16 65535.00 OneToOne 0.00 65535.00 FORMAT "%8.2" NUMBER 4 /end CHARACTERISTIC
/begin CHARACTERISTIC DSM_CDCDfp_PCBS_C "CARB spezifischer Fehlercode fuer Fehlerpfad Dfp_PCBS" VAL_BLK 0xCC074 Kwb_Wu16 65535.00 OneToOne 0.00 65535.00 FORMAT "%8.2" NUMBER 4 /end CHARACTERISTIC
/begin CHARACTERISTIC DSM_CDCDfp_PCR_BalGvnr_C "CARB spezifischer Fehlercode fuer Fehlerpfad Dfp_PCR_BalGvnr" VAL_BLK 0xCC07C Kwb_Wu16 65535.00 OneToOne 0.00 65535.00 FORMAT "%8.2" NUMBER 4 /end CHARACTERISTIC
/begin CHARACTERISTIC DSM_CDCDfp_PCR_GovDevNeg_C "CARB spezifischer Fehlercode fuer Fehlerpfad Dfp_PCR_GovDevNeg" VAL_BLK 0xCC084 Kwb_Wu16 65535.00 OneToOne 0.00 65535.00 FORMAT "%8.2" NUMBER 4 /end CHARACTERISTIC
/begin CHARACTERISTIC DSM_CDCDfp_PCR_GovDevPos_C "CARB spezifischer Fehlercode fuer Fehlerpfad Dfp_PCR_GovDevPos" VAL_BLK 0xCC08C Kwb_Wu16 65535.00 OneToOne 0.00 65535.00 FORMAT "%8.2" NUMBER 4 /end CHARACTERISTIC
/begin CHARACTERISTIC DSM_CDCDfp_PCR_LPGvnrDvtNeg_C "CARB spezifischer Fehlercode fuer Fehlerpfad Dfp_PCR_LPGvnrDvtNeg" VAL_BLK 0xCC094 Kwb_Wu16 65535.00 OneToOne 0.00 65535.00 FORMAT "%8.2" NUMBER 4 /end CHARACTERISTIC
/begin CHARACTERISTIC DSM_CDCDfp_PCR_LPGvnrDvtPos_C "CARB spezifischer Fehlercode fuer Fehlerpfad Dfp_PCR_LPGvnrDvtPos" VAL_BLK 0xCC09C Kwb_Wu16 65535.00 OneToOne 0.00 65535.00 FORMAT "%8.2" NUMBER 4 /end CHARACTERISTIC
/begin CHARACTERISTIC DSM_CDCDfp_PCVCDNoLoad_C "CARB spezifischer Fehlercode fuer Fehlerpfad Dfp_PCVCDNoLoad" VAL_BLK 0xCC0A4 Kwb_Wu16 65535.00 OneToOne 0.00 65535.00 FORMAT "%8.2" NUMBER 4 /end CHARACTERISTIC
/begin CHARACTERISTIC DSM_CDCDfp_PCVCDSCBat_C "CARB spezifischer Fehlercode fuer Fehlerpfad Dfp_PCVCDSCBat" VAL_BLK 0xCC0AC Kwb_Wu16 65535.00 OneToOne 0.00 65535.00 FORMAT "%8.2" NUMBER 4 /end CHARACTERISTIC
/begin CHARACTERISTIC DSM_CDCDfp_PCVCDSCGnd_C "CARB spezifischer Fehlercode fuer Fehlerpfad Dfp_PCVCDSCGnd" VAL_BLK 0xCC0B4 Kwb_Wu16 65535.00 OneToOne 0.00 65535.00 FORMAT "%8.2" NUMBER 4 /end CHARACTERISTIC
/begin CHARACTERISTIC DSM_CDCDfp_PCVCD_ADC_C "CARB spezifischer Fehlercode fuer Fehlerpfad Dfp_PCVCD_ADC" VAL_BLK 0xCC0BC Kwb_Wu16 65535.00 OneToOne 0.00 65535.00 FORMAT "%8.2" NUMBER 4 /end CHARACTERISTIC
/begin CHARACTERISTIC DSM_CDCDfp_PCVCD_SigTst_C "CARB spezifischer Fehlercode fuer Fehlerpfad Dfp_PCVCD_SigTst" VAL_BLK 0xCC0C4 Kwb_Wu16 65535.00 OneToOne 0.00 65535.00 FORMAT "%8.2" NUMBER 4 /end CHARACTERISTIC
/begin CHARACTERISTIC DSM_CDCDfp_PFltAPSPlaus_C "CARB spezifischer Fehlercode fuer Fehlerpfad Dfp_PFltAPSPlaus" VAL_BLK 0xCC0CC Kwb_Wu16 65535.00 OneToOne 0.00 65535.00 FORMAT "%8.2" NUMBER 4 /end CHARACTERISTIC
/begin CHARACTERISTIC DSM_CDCDfp_PFltAPSensB1_C "CARB spezifischer Fehlercode fuer Fehlerpfad Dfp_PFltAPSensB1" VAL_BLK 0xCC0D4 Kwb_Wu16 65535.00 OneToOne 0.00 65535.00 FORMAT "%8.2" NUMBER 4 /end CHARACTERISTIC
/begin CHARACTERISTIC DSM_CDCDfp_PFltAPSensB2_C "CARB spezifischer Fehlercode fuer Fehlerpfad Dfp_PFltAPSensB2" VAL_BLK 0xCC0DC Kwb_Wu16 65535.00 OneToOne 0.00 65535.00 FORMAT "%8.2" NUMBER 4 /end CHARACTERISTIC
/begin CHARACTERISTIC DSM_CDCDfp_PFltBPSPlaus_C "CARB spezifischer Fehlercode fuer Fehlerpfad Dfp_PFltBPSPlaus" VAL_BLK 0xCC0E4 Kwb_Wu16 65535.00 OneToOne 0.00 65535.00 FORMAT "%8.2" NUMBER 4 /end CHARACTERISTIC
/begin CHARACTERISTIC DSM_CDCDfp_PFltCDPPreB1_C "CARB spezifischer Fehlercode fuer Fehlerpfad Dfp_PFltCDPPreB1" VAL_BLK 0xCC0EC Kwb_Wu16 65535.00 OneToOne 0.00 65535.00 FORMAT "%8.2" NUMBER 4 /end CHARACTERISTIC
/begin CHARACTERISTIC DSM_CDCDfp_PFltCDPPreB2_C "CARB spezifischer Fehlercode fuer Fehlerpfad Dfp_PFltCDPPreB2" VAL_BLK 0xCC0F4 Kwb_Wu16 65535.00 OneToOne 0.00 65535.00 FORMAT "%8.2" NUMBER 4 /end CHARACTERISTIC
/begin CHARACTERISTIC DSM_CDCDfp_PFltCDTPreB1_C "CARB spezifischer Fehlercode fuer Fehlerpfad Dfp_PFltCDTPreB1" VAL_BLK 0xCC0FC Kwb_Wu16 65535.00 OneToOne 0.00 65535.00 FORMAT "%8.2" NUMBER 4 /end CHARACTERISTIC
/begin CHARACTERISTIC DSM_CDCDfp_PFltCDTPreB2_C "CARB specific fault code for fault path Dfp_PFltCDTPreB2" VAL_BLK 0xCC104 Kwb_Wu16 65535.00 OneToOne 0.00 65535.00 FORMAT "%8.2" NUMBER 4 /end CHARACTERISTIC
/begin CHARACTERISTIC DSM_CDCDfp_PFltCharB1_C "CARB spezifischer Fehlercode fuer Fehlerpfad Dfp_PFltCharB1" VAL_BLK 0xCC10C Kwb_Wu16 65535.00 OneToOne 0.00 65535.00 FORMAT "%8.2" NUMBER 4 /end CHARACTERISTIC
/begin CHARACTERISTIC DSM_CDCDfp_PFltCharB2_C "CARB spezifischer Fehlercode fuer Fehlerpfad Dfp_PFltCharB2" VAL_BLK 0xCC114 Kwb_Wu16 65535.00 OneToOne 0.00 65535.00 FORMAT "%8.2" NUMBER 4 /end CHARACTERISTIC
/begin CHARACTERISTIC DSM_CDCDfp_PFltDltOxiPreTwFlw_C "Temperaturabweichungsfehlerpfad vor Oxi Cat Behandlung" VAL_BLK 0xCC11C Kwb_Wu16 65535.00 OneToOne 0.00 65535.00 FORMAT "%8.2" NUMBER 4 /end CHARACTERISTIC
/begin CHARACTERISTIC DSM_CDCDfp_PFltDltPreTwFlw_C "Temperaturabweichungsfehlerpfad vor DPF - Behandlung" VAL_BLK 0xCC124 Kwb_Wu16 65535.00 OneToOne 0.00 65535.00 FORMAT "%8.2" NUMBER 4 /end CHARACTERISTIC
/begin CHARACTERISTIC DSM_CDCDfp_PFltEngPrtB1_C "CARB spezifischer Fehlercode fuer Fehlerpfad Dfp_PFltEngPrtB1" VAL_BLK 0xCC12C Kwb_Wu16 65535.00 OneToOne 0.00 65535.00 FORMAT "%8.2" NUMBER 4 /end CHARACTERISTIC
/begin CHARACTERISTIC DSM_CDCDfp_PFltEngPrtB2_C "CARB spezifischer Fehlercode fuer Fehlerpfad Dfp_PFltEngPrtB2" VAL_BLK 0xCC134 Kwb_Wu16 65535.00 OneToOne 0.00 65535.00 FORMAT "%8.2" NUMBER 4 /end CHARACTERISTIC
/begin CHARACTERISTIC DSM_CDCDfp_PFltOvldInhRgnB1_C "CARB spezifischer Fehlercode fuer Fehlerpfad Dfp_PFltOvldInhRgnB1" VAL_BLK 0xCC13C Kwb_Wu16 65535.00 OneToOne 0.00 65535.00 FORMAT "%8.2" NUMBER 4 /end CHARACTERISTIC
/begin CHARACTERISTIC DSM_CDCDfp_PFltOvldInhRgnB2_C "CARB spezifischer Fehlercode fuer Fehlerpfad Dfp_PFltOvldInhRgnB2" VAL_BLK 0xCC144 Kwb_Wu16 65535.00 OneToOne 0.00 65535.00 FORMAT "%8.2" NUMBER 4 /end CHARACTERISTIC
/begin CHARACTERISTIC DSM_CDCDfp_PFltOvldTrqLimB1_C "CARB spezifischer Fehlercode fuer Fehlerpfad Dfp_PFltOvldTrqLimB1" VAL_BLK 0xCC14C Kwb_Wu16 65535.00 OneToOne 0.00 65535.00 FORMAT "%8.2" NUMBER 4 /end CHARACTERISTIC
/begin CHARACTERISTIC DSM_CDCDfp_PFltOvldTrqLimB2_C "CARB spezifischer Fehlercode fuer Fehlerpfad Dfp_PFltOvldTrqLimB2" VAL_BLK 0xCC154 Kwb_Wu16 65535.00 OneToOne 0.00 65535.00 FORMAT "%8.2" NUMBER 4 /end CHARACTERISTIC
/begin CHARACTERISTIC DSM_CDCDfp_PFltPresDynPlausB1_C "CARB spezifischer Fehlercode fuer Fehlerpfad Dfp_PFltPresDynPlausB1" VAL_BLK 0xCC15C Kwb_Wu16 65535.00 OneToOne 0.00 65535.00 FORMAT "%8.2" NUMBER 4 /end CHARACTERISTIC
/begin CHARACTERISTIC DSM_CDCDfp_PFltPresDynPlausB2_C "CARB spezifischer Fehlercode fuer Fehlerpfad Dfp_PFltPresDynPlausB2" VAL_BLK 0xCC164 Kwb_Wu16 65535.00 OneToOne 0.00 65535.00 FORMAT "%8.2" NUMBER 4 /end CHARACTERISTIC
/begin CHARACTERISTIC DSM_CDCDfp_PFltPresPlausB1_C "CARB spezifischer Fehlercode fuer Fehlerpfad Dfp_PFltPresPlausB1" VAL_BLK 0xCC16C Kwb_Wu16 65535.00 OneToOne 0.00 65535.00 FORMAT "%8.2" NUMBER 4 /end CHARACTERISTIC
/begin CHARACTERISTIC DSM_CDCDfp_PFltPresPlausB2_C "CARB spezifischer Fehlercode fuer Fehlerpfad Dfp_PFltPresPlausB2" VAL_BLK 0xCC174 Kwb_Wu16 65535.00 OneToOne 0.00 65535.00 FORMAT "%8.2" NUMBER 4 /end CHARACTERISTIC
/begin CHARACTERISTIC DSM_CDCDfp_PFltPresSensB1_C "CARB spezifischer Fehlercode fuer Fehlerpfad Dfp_PFltPresSensB1" VAL_BLK 0xCC17C Kwb_Wu16 65535.00 OneToOne 0.00 65535.00 FORMAT "%8.2" NUMBER 4 /end CHARACTERISTIC
/begin CHARACTERISTIC DSM_CDCDfp_PFltPresSensB2_C "CARB spezifischer Fehlercode fuer Fehlerpfad Dfp_PFltPresSensB2" VAL_BLK 0xCC184 Kwb_Wu16 65535.00 OneToOne 0.00 65535.00 FORMAT "%8.2" NUMBER 4 /end CHARACTERISTIC
/begin CHARACTERISTIC DSM_CDCDfp_PFltPresSensFrz_C "CARB spezifischer Fehlercode fuer Fehlerpfad Dfp_PFltPresSensFrz" VAL_BLK 0xCC18C Kwb_Wu16 65535.00 OneToOne 0.00 65535.00 FORMAT "%8.2" NUMBER 4 /end CHARACTERISTIC
/begin CHARACTERISTIC DSM_CDCDfp_PFltPresSensHsLnB1_C "CARB spezifischer Fehlercode fuer Fehlerpfad Dfp_PFltPresSensHsLnB1" VAL_BLK 0xCC194 Kwb_Wu16 65535.00 OneToOne 0.00 65535.00 FORMAT "%8.2" NUMBER 4 /end CHARACTERISTIC
/begin CHARACTERISTIC DSM_CDCDfp_PFltPresSensHsLnB2_C "CARB spezifischer Fehlercode fuer Fehlerpfad Dfp_PFltPresSensHsLnB2" VAL_BLK 0xCC19C Kwb_Wu16 65535.00 OneToOne 0.00 65535.00 FORMAT "%8.2" NUMBER 4 /end CHARACTERISTIC
/begin CHARACTERISTIC DSM_CDCDfp_PFltPresSensSotB1_C "CARB spezifischer Fehlercode fuer Fehlerpfad Dfp_PFltPresSensSotB1" VAL_BLK 0xCC1A4 Kwb_Wu16 65535.00 OneToOne 0.00 65535.00 FORMAT "%8.2" NUMBER 4 /end CHARACTERISTIC
/begin CHARACTERISTIC DSM_CDCDfp_PFltPresSensSotB2_C "CARB spezifischer Fehlercode fuer Fehlerpfad Dfp_PFltPresSensSotB2" VAL_BLK 0xCC1AC Kwb_Wu16 65535.00 OneToOne 0.00 65535.00 FORMAT "%8.2" NUMBER 4 /end CHARACTERISTIC
/begin CHARACTERISTIC DSM_CDCDfp_PFltRgnPerm_C "CARB spezifischer Fehlercode fuer Fehlerpfad Dfp_PFltRgnPerm" VAL_BLK 0xCC1B4 Kwb_Wu16 65535.00 OneToOne 0.00 65535.00 FORMAT "%8.2" NUMBER 4 /end CHARACTERISTIC
/begin CHARACTERISTIC DSM_CDCDfp_PFltTempDwnStrmB1_C "CARB spezifischer Fehlercode fuer Fehlerpfad Dfp_PFltTempDwnStrmB1" VAL_BLK 0xCC1BC Kwb_Wu16 65535.00 OneToOne 0.00 65535.00 FORMAT "%8.2" NUMBER 4 /end CHARACTERISTIC
/begin CHARACTERISTIC DSM_CDCDfp_PFltTempDwnStrmB2_C "CARB spezifischer Fehlercode fuer Fehlerpfad Dfp_PFltTempDwnStrmB2" VAL_BLK 0xCC1C4 Kwb_Wu16 65535.00 OneToOne 0.00 65535.00 FORMAT "%8.2" NUMBER 4 /end CHARACTERISTIC
/begin CHARACTERISTIC DSM_CDCDfp_PFltTempSensB1_C "CARB spezifischer Fehlercode fuer Fehlerpfad Dfp_PFltTempSensB1" VAL_BLK 0xCC1CC Kwb_Wu16 65535.00 OneToOne 0.00 65535.00 FORMAT "%8.2" NUMBER 4 /end CHARACTERISTIC
/begin CHARACTERISTIC DSM_CDCDfp_PFltTempSensB2_C "CARB spezifischer Fehlercode fuer Fehlerpfad Dfp_PFltTempSensB2" VAL_BLK 0xCC1D4 Kwb_Wu16 65535.00 OneToOne 0.00 65535.00 FORMAT "%8.2" NUMBER 4 /end CHARACTERISTIC
/begin CHARACTERISTIC DSM_CDCDfp_PFltTempUpStrmB1_C "CARB spezifischer Fehlercode fuer Fehlerpfad Dfp_PFltTempUpStrmB1" VAL_BLK 0xCC1DC Kwb_Wu16 65535.00 OneToOne 0.00 65535.00 FORMAT "%8.2" NUMBER 4 /end CHARACTERISTIC
/begin CHARACTERISTIC DSM_CDCDfp_PFltTempUpStrmB2_C "CARB spezifischer Fehlercode fuer Fehlerpfad Dfp_PFltTempUpStrmB2" VAL_BLK 0xCC1E4 Kwb_Wu16 65535.00 OneToOne 0.00 65535.00 FORMAT "%8.2" NUMBER 4 /end CHARACTERISTIC
/begin CHARACTERISTIC DSM_CDCDfp_PFlt_tOxiPreMaxB1_C "CARB spezifischer Fehlercode fuer Fehlerpfad Dfp_PFlt_tOxiPreMaxB1" VAL_BLK 0xCC1EC Kwb_Wu16 65535.00 OneToOne 0.00 65535.00 FORMAT "%8.2" NUMBER 4 /end CHARACTERISTIC
/begin CHARACTERISTIC DSM_CDCDfp_PFlt_tOxiPreMaxB2_C "CARB spezifischer Fehlercode fuer Fehlerpfad Dfp_PFlt_tOxiPreMaxB2" VAL_BLK 0xCC1F4 Kwb_Wu16 65535.00 OneToOne 0.00 65535.00 FORMAT "%8.2" NUMBER 4 /end CHARACTERISTIC
/begin CHARACTERISTIC DSM_CDCDfp_PFlt_tOxiPreMxRgnB1_C "CARB spezifischer Fehlercode fuer Fehlerpfad Dfp_PFlt_tOxiPreMxRgnB1" VAL_BLK 0xCC1FC Kwb_Wu16 65535.00 OneToOne 0.00 65535.00 FORMAT "%8.2" NUMBER 4 /end CHARACTERISTIC
/begin CHARACTERISTIC DSM_CDCDfp_PFlt_tOxiPreMxRgnB2_C "CARB spezifischer Fehlercode fuer Fehlerpfad Dfp_PFlt_tOxiPreMxRgnB2" VAL_BLK 0xCC204 Kwb_Wu16 65535.00 OneToOne 0.00 65535.00 FORMAT "%8.2" NUMBER 4 /end CHARACTERISTIC
/begin CHARACTERISTIC DSM_CDCDfp_PFlt_tPreMaxB1_C "CARB spezifischer Fehlercode fuer Fehlerpfad Dfp_PFlt_tPreMaxB1" VAL_BLK 0xCC20C Kwb_Wu16 65535.00 OneToOne 0.00 65535.00 FORMAT "%8.2" NUMBER 4 /end CHARACTERISTIC
/begin CHARACTERISTIC DSM_CDCDfp_PFlt_tPreMaxB2_C "CARB spezifischer Fehlercode fuer Fehlerpfad Dfp_PFlt_tPreMaxB2" VAL_BLK 0xCC214 Kwb_Wu16 65535.00 OneToOne 0.00 65535.00 FORMAT "%8.2" NUMBER 4 /end CHARACTERISTIC
/begin CHARACTERISTIC DSM_CDCDfp_PFlt_tPreMaxRgnB1_C "CARB spezifischer Fehlercode fuer Fehlerpfad Dfp_PFlt_tPreMaxRgnB1" VAL_BLK 0xCC21C Kwb_Wu16 65535.00 OneToOne 0.00 65535.00 FORMAT "%8.2" NUMBER 4 /end CHARACTERISTIC
/begin CHARACTERISTIC DSM_CDCDfp_PFlt_tPreMaxRgnB2_C "CARB spezifischer Fehlercode fuer Fehlerpfad Dfp_PFlt_tPreMaxRgnB2" VAL_BLK 0xCC224 Kwb_Wu16 65535.00 OneToOne 0.00 65535.00 FORMAT "%8.2" NUMBER 4 /end CHARACTERISTIC
/begin CHARACTERISTIC DSM_CDCDfp_PFltmSotDiffMaxB1_C "CARB spezifischer Fehlercode fuer Fehlerpfad Dfp_PFltmSotDiffMaxB1" VAL_BLK 0xCC22C Kwb_Wu16 65535.00 OneToOne 0.00 65535.00 FORMAT "%8.2" NUMBER 4 /end CHARACTERISTIC
/begin CHARACTERISTIC DSM_CDCDfp_PFltmSotDiffMaxB2_C "CARB spezifischer Fehlercode fuer Fehlerpfad Dfp_PFltmSotDiffMaxB2" VAL_BLK 0xCC234 Kwb_Wu16 65535.00 OneToOne 0.00 65535.00 FORMAT "%8.2" NUMBER 4 /end CHARACTERISTIC
/begin CHARACTERISTIC DSM_CDCDfp_PresPlausDblDef_C "CARB spezifischer Fehlercode fuer Fehlerpfad Dfp_PresPlausDblDef" VAL_BLK 0xCC23C Kwb_Wu16 65535.00 OneToOne 0.00 65535.00 FORMAT "%8.2" NUMBER 4 /end CHARACTERISTIC
/begin CHARACTERISTIC DSM_CDCDfp_QLTCD_C "CARB spezifischer Fehlercode fuer Fehlerpfad Dfp_QLTCD" VAL_BLK 0xCC244 Kwb_Wu16 65535.00 OneToOne 0.00 65535.00 FORMAT "%8.2" NUMBER 4 /end CHARACTERISTIC
/begin CHARACTERISTIC DSM_CDCDfp_RailCD_C "CARB spezifischer Fehlercode fuer Fehlerpfad Dfp_RailCD" VAL_BLK 0xCC24C Kwb_Wu16 65535.00 OneToOne 0.00 65535.00 FORMAT "%8.2" NUMBER 4 /end CHARACTERISTIC
/begin CHARACTERISTIC DSM_CDCDfp_RailCDOfsTst_C "CARB spezifischer Fehlercode fuer Fehlerpfad Dfp_RailCDOfsTst" VAL_BLK 0xCC254 Kwb_Wu16 65535.00 OneToOne 0.00 65535.00 FORMAT "%8.2" NUMBER 4 /end CHARACTERISTIC
/begin CHARACTERISTIC DSM_CDCDfp_RailCD_PMonStrt_C "CARB spezifischer Fehlercode fuer Fehlerpfad Dfp_RailCD_PMonStrt" VAL_BLK 0xCC25C Kwb_Wu16 65535.00 OneToOne 0.00 65535.00 FORMAT "%8.2" NUMBER 4 /end CHARACTERISTIC
/begin CHARACTERISTIC DSM_CDCDfp_RailCPC1_C "CARB spezifischer Fehlercode fuer Fehlerpfad Dfp_RailCPC1" VAL_BLK 0xCC264 Kwb_Wu16 65535.00 OneToOne 0.00 65535.00 FORMAT "%8.2" NUMBER 4 /end CHARACTERISTIC
/begin CHARACTERISTIC DSM_CDCDfp_RailCPC3_C "CARB spezifischer Fehlercode fuer Fehlerpfad Dfp_RailCPC3" VAL_BLK 0xCC26C Kwb_Wu16 65535.00 OneToOne 0.00 65535.00 FORMAT "%8.2" NUMBER 4 /end CHARACTERISTIC
/begin CHARACTERISTIC DSM_CDCDfp_RailCPC4_C "CARB spezifischer Fehlercode fuer Fehlerpfad Dfp_RailCPC4" VAL_BLK 0xCC274 Kwb_Wu16 65535.00 OneToOne 0.00 65535.00 FORMAT "%8.2" NUMBER 4 /end CHARACTERISTIC
/begin CHARACTERISTIC DSM_CDCDfp_RailCtlModeMeUnDiag_C "CARB spezifischer Fehlercode fuer Fehlerpfad Dfp_RailCtlModeMeUnDiag" VAL_BLK 0xCC27C Kwb_Wu16 65535.00 OneToOne 0.00 65535.00 FORMAT "%8.2" NUMBER 4 /end CHARACTERISTIC
/begin CHARACTERISTIC DSM_CDCDfp_RailCtlModePCVDiag_C "CARB spezifischer Fehlercode fuer Fehlerpfad Dfp_RailCtlModePCVDiag" VAL_BLK 0xCC284 Kwb_Wu16 65535.00 OneToOne 0.00 65535.00 FORMAT "%8.2" NUMBER 4 /end CHARACTERISTIC
/begin CHARACTERISTIC DSM_CDCDfp_RailMeUn0_C "CARB spezifischer Fehlercode fuer Fehlerpfad Dfp_RailMeUn0" VAL_BLK 0xCC28C Kwb_Wu16 65535.00 OneToOne 0.00 65535.00 FORMAT "%8.2" NUMBER 4 /end CHARACTERISTIC
/begin CHARACTERISTIC DSM_CDCDfp_RailMeUn1_C "CARB spezifischer Fehlercode fuer Fehlerpfad Dfp_RailMeUn1" VAL_BLK 0xCC294 Kwb_Wu16 65535.00 OneToOne 0.00 65535.00 FORMAT "%8.2" NUMBER 4 /end CHARACTERISTIC
/begin CHARACTERISTIC DSM_CDCDfp_RailMeUn2_C "CARB spezifischer Fehlercode fuer Fehlerpfad Dfp_RailMeUn2" VAL_BLK 0xCC29C Kwb_Wu16 65535.00 OneToOne 0.00 65535.00 FORMAT "%8.2" NUMBER 4 /end CHARACTERISTIC
/begin CHARACTERISTIC DSM_CDCDfp_RailMeUn3_C "CARB spezifischer Fehlercode fuer Fehlerpfad Dfp_RailMeUn3" VAL_BLK 0xCC2A4 Kwb_Wu16 65535.00 OneToOne 0.00 65535.00 FORMAT "%8.2" NUMBER 4 /end CHARACTERISTIC
/begin CHARACTERISTIC DSM_CDCDfp_RailMeUn4_C "CARB spezifischer Fehlercode fuer Fehlerpfad Dfp_RailMeUn4" VAL_BLK 0xCC2AC Kwb_Wu16 65535.00 OneToOne 0.00 65535.00 FORMAT "%8.2" NUMBER 4 /end CHARACTERISTIC
/begin CHARACTERISTIC DSM_CDCDfp_RailPCV0_C "CARB spezifischer Fehlercode fuer Fehlerpfad Dfp_RailPCV0" VAL_BLK 0xCC2B4 Kwb_Wu16 65535.00 OneToOne 0.00 65535.00 FORMAT "%8.2" NUMBER 4 /end CHARACTERISTIC
/begin CHARACTERISTIC DSM_CDCDfp_RailPCV1_C "CARB spezifischer Fehlercode fuer Fehlerpfad Dfp_RailPCV1" VAL_BLK 0xCC2BC Kwb_Wu16 65535.00 OneToOne 0.00 65535.00 FORMAT "%8.2" NUMBER 4 /end CHARACTERISTIC
/begin CHARACTERISTIC DSM_CDCDfp_RailPCV2_C "CARB spezifischer Fehlercode fuer Fehlerpfad Dfp_RailPCV2" VAL_BLK 0xCC2C4 Kwb_Wu16 65535.00 OneToOne 0.00 65535.00 FORMAT "%8.2" NUMBER 4 /end CHARACTERISTIC
/begin CHARACTERISTIC DSM_CDCDfp_RailPCV3_C "CARB spezifischer Fehlercode fuer Fehlerpfad Dfp_RailPCV3" VAL_BLK 0xCC2CC Kwb_Wu16 65535.00 OneToOne 0.00 65535.00 FORMAT "%8.2" NUMBER 4 /end CHARACTERISTIC
/begin CHARACTERISTIC DSM_CDCDfp_RailPCV4_C "CARB spezifischer Fehlercode fuer Fehlerpfad Dfp_RailPCV4" VAL_BLK 0xCC2D4 Kwb_Wu16 65535.00 OneToOne 0.00 65535.00 FORMAT "%8.2" NUMBER 4 /end CHARACTERISTIC
/begin CHARACTERISTIC DSM_CDCDfp_RailPCV5_C "CARB spezifischer Fehlercode fuer Fehlerpfad Dfp_RailPCV5" VAL_BLK 0xCC2DC Kwb_Wu16 65535.00 OneToOne 0.00 65535.00 FORMAT "%8.2" NUMBER 4 /end CHARACTERISTIC
/begin CHARACTERISTIC DSM_CDCDfp_SOPTst_C "CARB spezifischer Fehlercode fuer Fehlerpfad Dfp_SOPTst" VAL_BLK 0xCC2E4 Kwb_Wu16 65535.00 OneToOne 0.00 65535.00 FORMAT "%8.2" NUMBER 4 /end CHARACTERISTIC
/begin CHARACTERISTIC DSM_CDCDfp_SSpMon1_C "CARB spezifischer Fehlercode fuer Fehlerpfad Dfp_SSpMon1" VAL_BLK 0xCC2EC Kwb_Wu16 65535.00 OneToOne 0.00 65535.00 FORMAT "%8.2" NUMBER 4 /end CHARACTERISTIC
/begin CHARACTERISTIC DSM_CDCDfp_SSpMon2_C "CARB spezifischer Fehlercode fuer Fehlerpfad Dfp_SSpMon2" VAL_BLK 0xCC2F4 Kwb_Wu16 65535.00 OneToOne 0.00 65535.00 FORMAT "%8.2" NUMBER 4 /end CHARACTERISTIC
/begin CHARACTERISTIC DSM_CDCDfp_SSpMon3_C "CARB spezifischer Fehlercode fuer Fehlerpfad Dfp_SSpMon3" VAL_BLK 0xCC2FC Kwb_Wu16 65535.00 OneToOne 0.00 65535.00 FORMAT "%8.2" NUMBER 4 /end CHARACTERISTIC
/begin CHARACTERISTIC DSM_CDCDfp_SSpMon4_C "CARB spezifischer Fehlercode fuer Fehlerpfad Dfp_SSpMon4" VAL_BLK 0xCC304 Kwb_Wu16 65535.00 OneToOne 0.00 65535.00 FORMAT "%8.2" NUMBER 4 /end CHARACTERISTIC
/begin CHARACTERISTIC DSM_CDCDfp_SSpMon5_C "CARB spezifischer Fehlercode fuer Fehlerpfad Dfp_SSpMon5" VAL_BLK 0xCC30C Kwb_Wu16 65535.00 OneToOne 0.00 65535.00 FORMAT "%8.2" NUMBER 4 /end CHARACTERISTIC
/begin CHARACTERISTIC DSM_CDCDfp_SSpMon6_C "CARB spezifischer Fehlercode fuer Fehlerpfad Dfp_SSpMon6" VAL_BLK 0xCC314 Kwb_Wu16 65535.00 OneToOne 0.00 65535.00 FORMAT "%8.2" NUMBER 4 /end CHARACTERISTIC
/begin CHARACTERISTIC DSM_CDCDfp_SWChk_CycSigChkDat_C "CARB spezifischer Fehlercode fuer Fehlerpfad Dfp_SWChk_CycSigChkDat" VAL_BLK 0xCC31C Kwb_Wu16 65535.00 OneToOne 0.00 65535.00 FORMAT "%8.2" NUMBER 4 /end CHARACTERISTIC
/begin CHARACTERISTIC DSM_CDCDfp_SWChk_CycSigChkPrg_C "CARB spezifischer Fehlercode fuer Fehlerpfad Dfp_SWChk_CycSigChkPrg" VAL_BLK 0xCC324 Kwb_Wu16 65535.00 OneToOne 0.00 65535.00 FORMAT "%8.2" NUMBER 4 /end CHARACTERISTIC
/begin CHARACTERISTIC DSM_CDCDfp_StSysTrqShutOff_C "CARB spezifischer Fehlercode fuer Fehlerpfad Dfp_StSysTrqShutOff" VAL_BLK 0xCC32C Kwb_Wu16 65535.00 OneToOne 0.00 65535.00 FORMAT "%8.2" NUMBER 4 /end CHARACTERISTIC
/begin CHARACTERISTIC DSM_CDCDfp_StrtCD_Actr_C "CARB spezifischer Fehlercode fuer Fehlerpfad Dfp_StrtCD_Actr" VAL_BLK 0xCC334 Kwb_Wu16 65535.00 OneToOne 0.00 65535.00 FORMAT "%8.2" NUMBER 4 /end CHARACTERISTIC
/begin CHARACTERISTIC DSM_CDCDfp_SysLamp_C "CARB spezifischer Fehlercode fuer Fehlerpfad Dfp_SysLamp" VAL_BLK 0xCC33C Kwb_Wu16 65535.00 OneToOne 0.00 65535.00 FORMAT "%8.2" NUMBER 4 /end CHARACTERISTIC
/begin CHARACTERISTIC DSM_CDCDfp_T15CD_C "CARB spezifischer Fehlercode fuer Fehlerpfad Dfp_T15CD" VAL_BLK 0xCC344 Kwb_Wu16 65535.00 OneToOne 0.00 65535.00 FORMAT "%8.2" NUMBER 4 /end CHARACTERISTIC
/begin CHARACTERISTIC DSM_CDCDfp_TGearbx_C "CARB spezifischer Fehlercode fuer Fehlerpfad Dfp_TGearbx" VAL_BLK 0xCC34C Kwb_Wu16 65535.00 OneToOne 0.00 65535.00 FORMAT "%8.2" NUMBER 4 /end CHARACTERISTIC
/begin CHARACTERISTIC DSM_CDCDfp_TPUMon_C "CARB spezifischer Fehlercode fuer Fehlerpfad Dfp_TPUMon" VAL_BLK 0xCC354 Kwb_Wu16 65535.00 OneToOne 0.00 65535.00 FORMAT "%8.2" NUMBER 4 /end CHARACTERISTIC
/begin CHARACTERISTIC DSM_CDCDfp_TVACD_AirMon1_C "CARB spezifischer Fehlercode fuer Fehlerpfad Dfp_TVACD_AirMon1" VAL_BLK 0xCC35C Kwb_Wu16 65535.00 OneToOne 0.00 65535.00 FORMAT "%8.2" NUMBER 4 /end CHARACTERISTIC
/begin CHARACTERISTIC DSM_CDCDfp_TVACD_AirMon2_C "CARB spezifischer Fehlercode fuer Fehlerpfad Dfp_TVACD_AirMon2" VAL_BLK 0xCC364 Kwb_Wu16 65535.00 OneToOne 0.00 65535.00 FORMAT "%8.2" NUMBER 4 /end CHARACTERISTIC
/begin CHARACTERISTIC DSM_CDCDfp_TVACD_Max_C "CARB spezifischer Fehlercode fuer Fehlerpfad Dfp_TVACD_Max" VAL_BLK 0xCC36C Kwb_Wu16 65535.00 OneToOne 0.00 65535.00 FORMAT "%8.2" NUMBER 4 /end CHARACTERISTIC
/begin CHARACTERISTIC DSM_CDCDfp_TVACD_Max2_C "CARB spezifischer Fehlercode fuer Fehlerpfad Dfp_TVACD_Max2" VAL_BLK 0xCC374 Kwb_Wu16 65535.00 OneToOne 0.00 65535.00 FORMAT "%8.2" NUMBER 4 /end CHARACTERISTIC
/begin CHARACTERISTIC DSM_CDCDfp_TVACD_Min_C "CARB spezifischer Fehlercode fuer Fehlerpfad Dfp_TVACD_Min" VAL_BLK 0xCC37C Kwb_Wu16 65535.00 OneToOne 0.00 65535.00 FORMAT "%8.2" NUMBER 4 /end CHARACTERISTIC
/begin CHARACTERISTIC DSM_CDCDfp_TVACD_Min2_C "CARB spezifischer Fehlercode fuer Fehlerpfad Dfp_TVACD_Min2" VAL_BLK 0xCC384 Kwb_Wu16 65535.00 OneToOne 0.00 65535.00 FORMAT "%8.2" NUMBER 4 /end CHARACTERISTIC
/begin CHARACTERISTIC DSM_CDCDfp_TVACD_SigNpl_C "CARB spezifischer Fehlercode fuer Fehlerpfad Dfp_TVACD_SigNpl" VAL_BLK 0xCC38C Kwb_Wu16 65535.00 OneToOne 0.00 65535.00 FORMAT "%8.2" NUMBER 4 /end CHARACTERISTIC
/begin CHARACTERISTIC DSM_CDCDfp_TVACD_SigNpl2_C "CARB spezifischer Fehlercode fuer Fehlerpfad Dfp_TVACD_SigNpl2" VAL_BLK 0xCC394 Kwb_Wu16 65535.00 OneToOne 0.00 65535.00 FORMAT "%8.2" NUMBER 4 /end CHARACTERISTIC
/begin CHARACTERISTIC DSM_CDCDfp_TVACD_TVADia1_C "CARB spezifischer Fehlercode fuer Fehlerpfad Dfp_TVACD_TVADia1" VAL_BLK 0xCC39C Kwb_Wu16 65535.00 OneToOne 0.00 65535.00 FORMAT "%8.2" NUMBER 4 /end CHARACTERISTIC
/begin CHARACTERISTIC DSM_CDCDfp_TVACD_TVADia2_C "CARB spezifischer Fehlercode fuer Fehlerpfad Dfp_TVACD_TVADia2" VAL_BLK 0xCC3A4 Kwb_Wu16 65535.00 OneToOne 0.00 65535.00 FORMAT "%8.2" NUMBER 4 /end CHARACTERISTIC
/begin CHARACTERISTIC DSM_CDCDfp_TVACD_TVADia21_C "CARB spezifischer Fehlercode fuer Fehlerpfad Dfp_TVACD_TVADia21" VAL_BLK 0xCC3AC Kwb_Wu16 65535.00 OneToOne 0.00 65535.00 FORMAT "%8.2" NUMBER 4 /end CHARACTERISTIC
/begin CHARACTERISTIC DSM_CDCDfp_TVACD_TVADia22_C "CARB spezifischer Fehlercode fuer Fehlerpfad Dfp_TVACD_TVADia22" VAL_BLK 0xCC3B4 Kwb_Wu16 65535.00 OneToOne 0.00 65535.00 FORMAT "%8.2" NUMBER 4 /end CHARACTERISTIC
/begin CHARACTERISTIC DSM_CDCDfp_TVACD_TVADia23_C "CARB spezifischer Fehlercode fuer Fehlerpfad Dfp_TVACD_TVADia23" VAL_BLK 0xCC3BC Kwb_Wu16 65535.00 OneToOne 0.00 65535.00 FORMAT "%8.2" NUMBER 4 /end CHARACTERISTIC
/begin CHARACTERISTIC DSM_CDCDfp_TVACD_TVADia24_C "CARB spezifischer Fehlercode fuer Fehlerpfad Dfp_TVACD_TVADia24" VAL_BLK 0xCC3C4 Kwb_Wu16 65535.00 OneToOne 0.00 65535.00 FORMAT "%8.2" NUMBER 4 /end CHARACTERISTIC
/begin CHARACTERISTIC DSM_CDCDfp_TVACD_TVADia3_C "CARB spezifischer Fehlercode fuer Fehlerpfad Dfp_TVACD_TVADia3" VAL_BLK 0xCC3CC Kwb_Wu16 65535.00 OneToOne 0.00 65535.00 FORMAT "%8.2" NUMBER 4 /end CHARACTERISTIC
/begin CHARACTERISTIC DSM_CDCDfp_TVACD_TVADia4_C "CARB spezifischer Fehlercode fuer Fehlerpfad Dfp_TVACD_TVADia4" VAL_BLK 0xCC3D4 Kwb_Wu16 65535.00 OneToOne 0.00 65535.00 FORMAT "%8.2" NUMBER 4 /end CHARACTERISTIC
/begin CHARACTERISTIC DSM_CDCDfp_ThrVlvMon_C "CARB spezifischer Fehlercode fuer Fehlerpfad Dfp_ThrVlvMon" VAL_BLK 0xCC3DC Kwb_Wu16 65535.00 OneToOne 0.00 65535.00 FORMAT "%8.2" NUMBER 4 /end CHARACTERISTIC
/begin CHARACTERISTIC DSM_CDCDfp_VSACD_DiaDet_C "CARB spezifischer Fehlercode fuer Fehlerpfad Dfp_VSACD_DiaDet" VAL_BLK 0xCC3E4 Kwb_Wu16 65535.00 OneToOne 0.00 65535.00 FORMAT "%8.2" NUMBER 4 /end CHARACTERISTIC
/begin CHARACTERISTIC DSM_CDCDfp_VSACD_DioInDia1_C "CARB spezifischer Fehlercode fuer Fehlerpfad Dfp_VSACD_DioInDia1" VAL_BLK 0xCC3EC Kwb_Wu16 65535.00 OneToOne 0.00 65535.00 FORMAT "%8.2" NUMBER 4 /end CHARACTERISTIC
/begin CHARACTERISTIC DSM_CDCDfp_VSACD_DioInDia2_C "CARB spezifischer Fehlercode fuer Fehlerpfad Dfp_VSACD_DioInDia2" VAL_BLK 0xCC3F4 Kwb_Wu16 65535.00 OneToOne 0.00 65535.00 FORMAT "%8.2" NUMBER 4 /end CHARACTERISTIC
/begin CHARACTERISTIC DSM_CDCDfp_VSACD_DioInDia3_C "CARB spezifischer Fehlercode fuer Fehlerpfad Dfp_VSACD_DioInDia3" VAL_BLK 0xCC3FC Kwb_Wu16 65535.00 OneToOne 0.00 65535.00 FORMAT "%8.2" NUMBER 4 /end CHARACTERISTIC
/begin CHARACTERISTIC DSM_CDCDfp_VSACD_DioInDia4_C "CARB spezifischer Fehlercode fuer Fehlerpfad Dfp_VSACD_DioInDia4" VAL_BLK 0xCC404 Kwb_Wu16 65535.00 OneToOne 0.00 65535.00 FORMAT "%8.2" NUMBER 4 /end CHARACTERISTIC
/begin CHARACTERISTIC DSM_CDCDfp_VSACD_DioInMin_C "CARB spezifischer Fehlercode fuer Fehlerpfad Dfp_VSACD_DioInMin" VAL_BLK 0xCC40C Kwb_Wu16 65535.00 OneToOne 0.00 65535.00 FORMAT "%8.2" NUMBER 4 /end CHARACTERISTIC
/begin CHARACTERISTIC DSM_CDCDfp_VSACD_Max_C "CARB spezifischer Fehlercode fuer Fehlerpfad Dfp_VSACD_Max" VAL_BLK 0xCC414 Kwb_Wu16 65535.00 OneToOne 0.00 65535.00 FORMAT "%8.2" NUMBER 4 /end CHARACTERISTIC
/begin CHARACTERISTIC DSM_CDCDfp_VSACD_Min_C "CARB spezifischer Fehlercode fuer Fehlerpfad Dfp_VSACD_Min" VAL_BLK 0xCC41C Kwb_Wu16 65535.00 OneToOne 0.00 65535.00 FORMAT "%8.2" NUMBER 4 /end CHARACTERISTIC
/begin CHARACTERISTIC DSM_CDCDfp_VSACD_SigNpl_C "CARB spezifischer Fehlercode fuer Fehlerpfad Dfp_VSACD_SigNpl" VAL_BLK 0xCC424 Kwb_Wu16 65535.00 OneToOne 0.00 65535.00 FORMAT "%8.2" NUMBER 4 /end CHARACTERISTIC
/begin CHARACTERISTIC DSM_CDCDfp_VSACD_VSADia1_C "CARB spezifischer Fehlercode fuer Fehlerpfad Dfp_VSACD_VSADia1" VAL_BLK 0xCC42C Kwb_Wu16 65535.00 OneToOne 0.00 65535.00 FORMAT "%8.2" NUMBER 4 /end CHARACTERISTIC
/begin CHARACTERISTIC DSM_CDCDfp_VSACD_VSADia2_C "CARB spezifischer Fehlercode fuer Fehlerpfad Dfp_VSACD_VSADia2" VAL_BLK 0xCC434 Kwb_Wu16 65535.00 OneToOne 0.00 65535.00 FORMAT "%8.2" NUMBER 4 /end CHARACTERISTIC
/begin CHARACTERISTIC DSM_CDCDfp_VSACD_VSADia3_C "CARB spezifischer Fehlercode fuer Fehlerpfad Dfp_VSACD_VSADia3" VAL_BLK 0xCC43C Kwb_Wu16 65535.00 OneToOne 0.00 65535.00 FORMAT "%8.2" NUMBER 4 /end CHARACTERISTIC
/begin CHARACTERISTIC DSM_CDCDfp_VSACD_VSADia4_C "CARB spezifischer Fehlercode fuer Fehlerpfad Dfp_VSACD_VSADia4" VAL_BLK 0xCC444 Kwb_Wu16 65535.00 OneToOne 0.00 65535.00 FORMAT "%8.2" NUMBER 4 /end CHARACTERISTIC
/begin CHARACTERISTIC DSM_CDCDfp_VSSCD1_C "CARB spezifischer Fehlercode fuer Fehlerpfad Dfp_VSSCD1" VAL_BLK 0xCC44C Kwb_Wu16 65535.00 OneToOne 0.00 65535.00 FORMAT "%8.2" NUMBER 4 /end CHARACTERISTIC
/begin CHARACTERISTIC DSM_CDCDfp_VSSCD2_C "CARB spezifischer Fehlercode fuer Fehlerpfad Dfp_VSSCD2" VAL_BLK 0xCC454 Kwb_Wu16 65535.00 OneToOne 0.00 65535.00 FORMAT "%8.2" NUMBER 4 /end CHARACTERISTIC
/begin CHARACTERISTIC DSM_CDCDfp_WdCom_C "CARB spezifischer Fehlercode fuer Fehlerpfad Dfp_WdCom" VAL_BLK 0xCC45C Kwb_Wu16 65535.00 OneToOne 0.00 65535.00 FORMAT "%8.2" NUMBER 4 /end CHARACTERISTIC
/begin FUNCTION dsm_auto_cdc ""
 /begin DEF_CHARACTERISTIC DSM_CDCDfp_Layer_TANS_C DSM_CDCDfp_ACCDSwtin_C DSM_CDCDfp_ACC_PlausTrqDes_C DSM_CDCDfp_ACC_trqInr_C DSM_CDCDfp_ACTrq_C DSM_CDCDfp_ADCMon_C DSM_CDCDfp_AFSCDIdlAdjVal_C DSM_CDCDfp_AFSCDLdAdjVal_C DSM_CDCDfp_AFSCDPlAirPerCylDif_C DSM_CDCDfp_AFSCD_AirTempDcyc_C DSM_CDCDfp_AFSCD_AirTempDcyc2_C DSM_CDCDfp_AFSCD_PlOffsDrft_C DSM_CDCDfp_AFSCD_PlOffsDrft2_C DSM_CDCDfp_AFSCD_PlSetyDrft_C DSM_CDCDfp_AFSCD_SRCAirTemp_C DSM_CDCDfp_AFSCD_SRCAirTemp2_C DSM_CDCDfp_AFSCD_SRCBatt_C DSM_CDCDfp_AFSCD_SRCBatt2_C DSM_CDCDfp_AFSCD_SRCCorrAirm_C DSM_CDCDfp_Layer_TUMG_C DSM_CDCDfp_AFSCD_SRCCorrAirm2_C DSM_CDCDfp_AFSCD_SRCRawAirm_C DSM_CDCDfp_Layer_GEN_C DSM_CDCDfp_Layer_BSD_C DSM_CDCDfp_AFSCD_SRCRawAirm2_C DSM_CDCDfp_AFSCD_SRCRefSigPer_C DSM_CDCDfp_AFSCD_SRCRefSigPer2_C DSM_CDCDfp_AOHtCD_C DSM_CDCDfp_AOHtCD_AOHtDia1_C DSM_CDCDfp_AOHtCD_AOHtDia2_C DSM_CDCDfp_AOHtCD_AOHtDia3_C DSM_CDCDfp_APP1_C DSM_CDCDfp_APP2_C DSM_CDCDfp_APPCDCmpd_C DSM_CDCDfp_Layer_QLT_C DSM_CDCDfp_APPSync_C DSM_CDCDfp_Layer_IBS1_C DSM_CDCDfp_Layer_IBS2_C DSM_CDCDfp_Layer_IBS3_C DSM_CDCDfp_Layer_PMBN_C DSM_CDCDfp_Layer_PMBATT_C DSM_CDCDfp_APSCD_C DSM_CDCDfp_ARS_C DSM_CDCDfp_AccPedPlausBrk_C DSM_CDCDfp_AddPCDTnkLvl_C DSM_CDCDfp_AirCtlGvnrDvtRgnMax_C DSM_CDCDfp_AirCtlGvnrDvtRgnMin_C DSM_CDCDfp_AirCtlGvnrDvtRgnMn2_C DSM_CDCDfp_AirCtlGvnrDvtRgnMx2_C DSM_CDCDfp_AirCtlPlateBreak_C DSM_CDCDfp_AirCtlRmpTO_C DSM_CDCDfp_AirCtl_GovNegDev_C DSM_CDCDfp_AirCtl_GovNegDev2_C DSM_CDCDfp_AirCtl_GovPosDev_C DSM_CDCDfp_AirCtl_GovPosDev2_C DSM_CDCDfp_AltCD_C DSM_CDCDfp_BPACD_BPADia1_C DSM_CDCDfp_BPACD_BPADia1v2_C DSM_CDCDfp_BPACD_BPADia2_C DSM_CDCDfp_BPACD_BPADia2v2_C DSM_CDCDfp_BPACD_BPADia3_C DSM_CDCDfp_BPACD_BPADia3v2_C DSM_CDCDfp_BPACD_BPADia4_C DSM_CDCDfp_BPACD_BPADia4v2_C DSM_CDCDfp_BPACD_Max_C DSM_CDCDfp_BPACD_Max2_C DSM_CDCDfp_BPACD_Min_C DSM_CDCDfp_BPACD_Min2_C DSM_CDCDfp_BPACD_SigNpl_C DSM_CDCDfp_BPACD_SigNpl2_C DSM_CDCDfp_BPSCD_C DSM_CDCDfp_BattCD_C DSM_CDCDfp_BrkCD_C DSM_CDCDfp_Layer_PMRUHVERL_C DSM_CDCDfp_Bss_C DSM_CDCDfp_CBACD_C DSM_CDCDfp_CTSCD_C DSM_CDCDfp_Clg_DynTst_C DSM_CDCDfp_Layer_TOENS_C DSM_CDCDfp_Layer_MANHYDR_C DSM_CDCDfp_Layer_MANLUFT_C DSM_CDCDfp_CmbChbMisfire1_C DSM_CDCDfp_CmbChbMisfire2_C DSM_CDCDfp_CmbChbMisfire3_C DSM_CDCDfp_CmbChbMisfire4_C DSM_CDCDfp_CmbChbMisfire5_C DSM_CDCDfp_CmbChbMisfire6_C DSM_CDCDfp_CmbChbMisfire7_C DSM_CDCDfp_CmbChbMisfire8_C DSM_CDCDfp_CmbChbMisfireMul_C DSM_CDCDfp_CoDT_TRQ_Des_C DSM_CDCDfp_CoDT_TRQ_Lead_C DSM_CDCDfp_CoEng_GbxRpmRduc_C DSM_CDCDfp_CoVMDCSh_C DSM_CDCDfp_ConvCD_C DSM_CDCDfp_CrCCDMFL_C DSM_CDCDfp_CrCtl_vCrCtl_C DSM_CDCDfp_EATSCD_C DSM_CDCDfp_EBAFCD_C DSM_CDCDfp_EBFCD_C DSM_CDCDfp_EBTSCD_C DSM_CDCDfp_EBTSCD_OvrTemp_C DSM_CDCDfp_EEPCDVarMng_C DSM_CDCDfp_EGPpCD_C DSM_CDCDfp_EGRCD_Max_C DSM_CDCDfp_EGRCD_Max2_C DSM_CDCDfp_EGRCD_Min_C DSM_CDCDfp_EGRCD_Min2_C DSM_CDCDfp_EGRCD_PWMInDia1_C DSM_CDCDfp_EGRCD_PWMInDia2_C DSM_CDCDfp_EGRCD_PWMInDia21_C DSM_CDCDfp_EGRCD_PWMInDia22_C DSM_CDCDfp_EGRCD_PWMInDia23_C DSM_CDCDfp_EGRCD_PWMInDia24_C DSM_CDCDfp_EGRCD_PWMInDia3_C DSM_CDCDfp_EGRCD_PWMInDia4_C DSM_CDCDfp_EGRCD_SigDia_C DSM_CDCDfp_EGRCD_SigDia2_C DSM_CDCDfp_EGRCD_SigNpl_C DSM_CDCDfp_EGRCD_SigNpl2_C DSM_CDCDfp_EGTOilLvlCrit_C DSM_CDCDfp_EGTOilVscCrit_C DSM_CDCDfp_EGTRgnOilDil_C DSM_CDCDfp_EGTTempGvnrInrB1_C DSM_CDCDfp_EGTTempGvnrInrB2_C DSM_CDCDfp_EGTTempGvnrOutrB1_C DSM_CDCDfp_EGTTempGvnrOutrB2_C DSM_CDCDfp_ETClbETFltInj1_C DSM_CDCDfp_ETClbETFltInj2_C DSM_CDCDfp_ETClbETFltInj3_C DSM_CDCDfp_ETClbETFltInj4_C DSM_CDCDfp_ETClbETFltInj5_C DSM_CDCDfp_ETClbETFltInj6_C DSM_CDCDfp_ETClbETFltInj7_C DSM_CDCDfp_ETClbETFltInj8_C DSM_CDCDfp_ETClbInj1_C DSM_CDCDfp_ETClbInj2_C DSM_CDCDfp_ETClbInj3_C DSM_CDCDfp_ETClbInj4_C DSM_CDCDfp_ETClbInj5_C DSM_CDCDfp_ETClbInj6_C DSM_CDCDfp_ETClbInj7_C DSM_CDCDfp_ETClbInj8_C DSM_CDCDfp_EngMCaS1_C DSM_CDCDfp_EngMCrS1_C DSM_CDCDfp_EngMOfsCaSCrS_C DSM_CDCDfp_EngMntCtlCD_C DSM_CDCDfp_FBCqDvt_C DSM_CDCDfp_FMAErrMod_C DSM_CDCDfp_FMTC_NonMonotonMap_C DSM_CDCDfp_FTSCD_C DSM_CDCDfp_FanCD_C DSM_CDCDfp_FanCD_FanCtlr1_C DSM_CDCDfp_FanCD_FanCtlr2_C DSM_CDCDfp_FanCD_FanCtlr3_C DSM_CDCDfp_FlFCD_C DSM_CDCDfp_FlMngSmkDefect_C DSM_CDCDfp_FlSCDT1_C DSM_CDCDfp_FrmMngANFRADMOMPT_C DSM_CDCDfp_FrmMngASC1_C DSM_CDCDfp_FrmMngASC2_C DSM_CDCDfp_FrmMngASC3_C DSM_CDCDfp_FrmMngASC4_C DSM_CDCDfp_FrmMngBOS_RESET_C DSM_CDCDfp_FrmMngBOS_RESET2_C DSM_CDCDfp_FrmMngDMANFAFS_C DSM_CDCDfp_FrmMngDRMANFSSG_C DSM_CDCDfp_FrmMngEGS1_C DSM_CDCDfp_FrmMngEGS2_C DSM_CDCDfp_FrmMngGEARBX_DATA_C DSM_CDCDfp_FrmMngGEARBX_DATA2_C DSM_CDCDfp_FrmMngHEAT_AC_C DSM_CDCDfp_FrmMngINSTR2_C DSM_CDCDfp_FrmMngINSTR3_C DSM_CDCDfp_FrmMngLENKRADWINKEL_C DSM_CDCDfp_FrmMngMILEAGE_RANGE_C DSM_CDCDfp_FrmMngMSPHISYNC_C DSM_CDCDfp_FrmMngMST4_C DSM_CDCDfp_FrmMngMST5_C DSM_CDCDfp_FrmMngOPCRCTLACC_C DSM_CDCDfp_FrmMngPRGG_CCTR_C DSM_CDCDfp_FrmMngPWRMNG_LOADV_C DSM_CDCDfp_FrmMngParkConsumer_C DSM_CDCDfp_FrmMngRQSTGEFAN_C DSM_CDCDfp_FrmMngSLV4_C DSM_CDCDfp_FrmMngSLV5_C DSM_CDCDfp_FrmMngSSGErr_C DSM_CDCDfp_FrmMngSSGShOff_C DSM_CDCDfp_FrmMngSTAT_ANH_C DSM_CDCDfp_FrmMngSTAT_ARS_C DSM_CDCDfp_FrmMngSTAT_DSC_C DSM_CDCDfp_FrmMngSTAT_EKP_C DSM_CDCDfp_FrmMngSTAT_KOMBI_C DSM_CDCDfp_FrmMngSTAT_SITZ_C DSM_CDCDfp_FrmMngStOBDGbxMilOf_C DSM_CDCDfp_FrmMngStOBDGbxMilOn_C DSM_CDCDfp_FrmMngTEMPRELTIME_C DSM_CDCDfp_FrmMngTERMINAL_C DSM_CDCDfp_FrmMngTIME_DATE_C DSM_CDCDfp_FrmMngTORQUE_DSC_C DSM_CDCDfp_FrmMngTORQUE_GEARBX_C DSM_CDCDfp_FrmMngTrq_ReqACC_C DSM_CDCDfp_FrmMngVEH_MOD_C DSM_CDCDfp_FrmMngVELOCITY_C DSM_CDCDfp_FrmMngWHEEL_SPEED_C DSM_CDCDfp_FrmMngstCurr_C DSM_CDCDfp_FrmMngswtPSPOff_C DSM_CDCDfp_GearbxIncMax_C DSM_CDCDfp_GlwCD_C DSM_CDCDfp_GlwCDGlwCirc1_C DSM_CDCDfp_GlwCDGlwCirc2_C DSM_CDCDfp_GlwCDGlwCirc3_C DSM_CDCDfp_GlwCDGlwCirc4_C DSM_CDCDfp_GlwCDGlwCirc5_C DSM_CDCDfp_GlwCDGlwCirc6_C DSM_CDCDfp_GlwCDGlwCirc7_C DSM_CDCDfp_GlwCDGlwCirc8_C DSM_CDCDfp_GlwCtl_C DSM_CDCDfp_HWEMonCom_C DSM_CDCDfp_HWEMonEEPROM_C DSM_CDCDfp_HWEMonRcyLocked_C DSM_CDCDfp_HWEMonRcySuppressed_C DSM_CDCDfp_HWEMonRcyVisible_C DSM_CDCDfp_HWEMonUMaxSupply_C DSM_CDCDfp_HWEMonUMinSupply_C DSM_CDCDfp_IATSCD_C DSM_CDCDfp_IATSCD_CATS_C DSM_CDCDfp_IATSCD_CATSSec_C DSM_CDCDfp_ImmCtlImmCD_C DSM_CDCDfp_ImmCtlImmEep_C DSM_CDCDfp_ImmCtlMpl_C DSM_CDCDfp_IndSys1_C DSM_CDCDfp_IndSys2_C DSM_CDCDfp_InjCrv_InjLim_C DSM_CDCDfp_InjCtlAdjQnt_C DSM_CDCDfp_InjCtlDrift_C DSM_CDCDfp_InjVCDActrChrg_C DSM_CDCDfp_InjVCDActrEnrg1_C DSM_CDCDfp_InjVCDActrEnrg2_C DSM_CDCDfp_InjVCDActrEnrg3_C DSM_CDCDfp_InjVCDActrEnrg4_C DSM_CDCDfp_InjVCDActrEnrg5_C DSM_CDCDfp_InjVCDActrEnrg6_C DSM_CDCDfp_InjVCDActrEnrg7_C DSM_CDCDfp_InjVCDActrEnrg8_C DSM_CDCDfp_InjVCDActrVolt_C DSM_CDCDfp_InjVCDClsBank1_C DSM_CDCDfp_InjVCDClsBank2_C DSM_CDCDfp_InjVCDMonCab_C DSM_CDCDfp_InjVCDMonSwt_C DSM_CDCDfp_InjVCDShOffDCDC_C DSM_CDCDfp_InjVCDUBuf1_C DSM_CDCDfp_InjVCDUBuf2_C DSM_CDCDfp_InjVCD_CY370Ampl_C DSM_CDCDfp_InjVCD_DrvTime_C DSM_CDCDfp_InjVCD_DrvTimeRcy_C DSM_CDCDfp_InjVCD_TPUErr_C DSM_CDCDfp_InjVlvBnk1A_C DSM_CDCDfp_InjVlvBnk1B_C DSM_CDCDfp_InjVlvBnk2A_C DSM_CDCDfp_InjVlvBnk2B_C DSM_CDCDfp_InjVlvChipA_C DSM_CDCDfp_InjVlvChipB_C DSM_CDCDfp_InjVlvCyl1A_C DSM_CDCDfp_InjVlvCyl1B_C DSM_CDCDfp_InjVlvCyl1C_C DSM_CDCDfp_InjVlvCyl2A_C DSM_CDCDfp_InjVlvCyl2B_C DSM_CDCDfp_InjVlvCyl2C_C DSM_CDCDfp_InjVlvCyl3A_C DSM_CDCDfp_InjVlvCyl3B_C DSM_CDCDfp_InjVlvCyl3C_C DSM_CDCDfp_InjVlvCyl4A_C DSM_CDCDfp_InjVlvCyl4B_C DSM_CDCDfp_InjVlvCyl4C_C DSM_CDCDfp_InjVlvCyl5A_C DSM_CDCDfp_InjVlvCyl5B_C DSM_CDCDfp_InjVlvCyl5C_C DSM_CDCDfp_InjVlvCyl6A_C DSM_CDCDfp_InjVlvCyl6B_C DSM_CDCDfp_InjVlvCyl6C_C DSM_CDCDfp_InjVlvCyl7A_C DSM_CDCDfp_InjVlvCyl7B_C DSM_CDCDfp_InjVlvCyl7C_C DSM_CDCDfp_InjVlvCyl8A_C DSM_CDCDfp_InjVlvCyl8B_C DSM_CDCDfp_InjVlvCyl8C_C DSM_CDCDfp_InjVlvNVC1_C DSM_CDCDfp_InjVlvNVC2_C DSM_CDCDfp_InjVlvNVC3_C DSM_CDCDfp_InjVlvNVC4_C DSM_CDCDfp_InjVlvNVC5_C DSM_CDCDfp_InjVlvNVC6_C DSM_CDCDfp_InjVlvNVC7_C DSM_CDCDfp_InjVlvNVC8_C DSM_CDCDfp_KeyCheck_C DSM_CDCDfp_LIGovECUTransMode_C DSM_CDCDfp_LPACD_Max_C DSM_CDCDfp_LPACD_Min_C DSM_CDCDfp_LPACD_SigNpl_C DSM_CDCDfp_LSUCDCircNernst0B1_C DSM_CDCDfp_LSUCDCircNernst0B2_C DSM_CDCDfp_LSUCDCircPumpCur0B1_C DSM_CDCDfp_LSUCDCircPumpCur0B2_C DSM_CDCDfp_LSUCDCircVirtGnd0B1_C DSM_CDCDfp_LSUCDCircVirtGnd0B2_C DSM_CDCDfp_LSUCDHeater0B1_C DSM_CDCDfp_LSUCDHeater0B2_C DSM_CDCDfp_LSUCDHtCoup0B1_C DSM_CDCDfp_LSUCDHtCoup0B2_C DSM_CDCDfp_LSUCDO20B1_C DSM_CDCDfp_LSUCDO20B2_C DSM_CDCDfp_LSUCDO2Clb0B1_C DSM_CDCDfp_LSUCDO2Clb0B2_C DSM_CDCDfp_LSUCDRiClb0B1_C DSM_CDCDfp_LSUCDRiClb0B2_C DSM_CDCDfp_LSUCDSPI0B1_C DSM_CDCDfp_LSUCDSPI0B2_C DSM_CDCDfp_LSUCDSPIBattLow0B1_C DSM_CDCDfp_LSUCDSPIBattLow0B2_C DSM_CDCDfp_LSUCDWireIP0B1_C DSM_CDCDfp_LSUCDWireIP0B2_C DSM_CDCDfp_LSUCtlRiExc0B1_C DSM_CDCDfp_LSUCtlRiExc0B2_C DSM_CDCDfp_LSUMon1SensB1_C DSM_CDCDfp_LSUMon1SensB2_C DSM_CDCDfp_LSUMon2SensB1_C DSM_CDCDfp_LSUMon2SensB2_C DSM_CDCDfp_MIL_C DSM_CDCDfp_MRlyCD_C DSM_CDCDfp_MSMon_C DSM_CDCDfp_MSMonConsist_C DSM_CDCDfp_MSMonPFlt1_C DSM_CDCDfp_MSMonPFlt2_C DSM_CDCDfp_MSMonPFlt3_C DSM_CDCDfp_MSMonPFlt4_C DSM_CDCDfp_MSMon_ARS_TO_C DSM_CDCDfp_MSMon_AirCtl_C DSM_CDCDfp_MSMon_AirSys0_C DSM_CDCDfp_MSMon_AirSys1_C DSM_CDCDfp_MSMon_AirSys2_C DSM_CDCDfp_MSMon_AirSys3_C DSM_CDCDfp_MSMon_AirSys4_C DSM_CDCDfp_MSMon_AirSys7_C DSM_CDCDfp_MSMon_CanDef_C DSM_CDCDfp_MSMon_CoEng_OffVeh_C DSM_CDCDfp_MSMon_CoEng_Rev1_C DSM_CDCDfp_MSMon_CoEng_Rev2_C DSM_CDCDfp_MSMon_CoEng_RevMS_C DSM_CDCDfp_MSMon_DSC_TO_C DSM_CDCDfp_MSMon_EGS_TO_C DSM_CDCDfp_MSMon_FrmMngCoEng_C DSM_CDCDfp_MSMon_FrmMngPT_C DSM_CDCDfp_MSMon_FrmMngPT2_C DSM_CDCDfp_MSMon_Mil_C DSM_CDCDfp_MSMon_NetMngPtCan_C DSM_CDCDfp_MSMon_RailCDPMon_C DSM_CDCDfp_MSMon_StEGS_C DSM_CDCDfp_MSMon_SysLamp_C DSM_CDCDfp_MSMon_ZFCClbActv_C DSM_CDCDfp_MSMon_qLimErr_C DSM_CDCDfp_MSMon_trqCoDT_C DSM_CDCDfp_MSMon_trqCoVeh_C DSM_CDCDfp_MSMon_trqCoVehLim_C DSM_CDCDfp_MSMon_trqDesExt_C DSM_CDCDfp_MSMon_trqDesExtRev_C DSM_CDCDfp_MSMon_trqLimErr_C DSM_CDCDfp_MSMon_trqLimErr1_C DSM_CDCDfp_MSMon_trqLimErr2_C DSM_CDCDfp_MSMon_trqLimErr3_C DSM_CDCDfp_MSMon_trqLimErr4_C DSM_CDCDfp_MSidCD_Comm_C DSM_CDCDfp_MSidCD_EcuMixed_C DSM_CDCDfp_MSidCD_Pin_C DSM_CDCDfp_MSidCD_Sel_INI_C DSM_CDCDfp_MSidCD_Select_C DSM_CDCDfp_MSid_SwCmp_C DSM_CDCDfp_MSid_regEEPDiff_C DSM_CDCDfp_MeUnCDNoLoad_C DSM_CDCDfp_MeUnCDSCBat_C DSM_CDCDfp_MeUnCDSCGnd_C DSM_CDCDfp_MeUnCD_ADC_C DSM_CDCDfp_MeUnCD_SigTst_C DSM_CDCDfp_Montr_C DSM_CDCDfp_NetMngDeviceA_C DSM_CDCDfp_NetMngDeviceB_C DSM_CDCDfp_NetMngDeviceC_C DSM_CDCDfp_NetMngPrvCan_C DSM_CDCDfp_NetMngPrvCanSlave_C DSM_CDCDfp_NetMngPtCan_C DSM_CDCDfp_NetMngPtCanSlave_C DSM_CDCDfp_OPSCD_Lamp_C DSM_CDCDfp_OPSCD_anain_C DSM_CDCDfp_OTSCD_C DSM_CDCDfp_OvRMon_C DSM_CDCDfp_OvRMonSigA_C DSM_CDCDfp_OxiCCDTPreB1_C DSM_CDCDfp_OxiCCDTPreB2_C DSM_CDCDfp_PCBS_C DSM_CDCDfp_PCR_BalGvnr_C DSM_CDCDfp_PCR_GovDevNeg_C DSM_CDCDfp_PCR_GovDevPos_C DSM_CDCDfp_PCR_LPGvnrDvtNeg_C DSM_CDCDfp_PCR_LPGvnrDvtPos_C DSM_CDCDfp_PCVCDNoLoad_C DSM_CDCDfp_PCVCDSCBat_C DSM_CDCDfp_PCVCDSCGnd_C DSM_CDCDfp_PCVCD_ADC_C DSM_CDCDfp_PCVCD_SigTst_C DSM_CDCDfp_PFltAPSPlaus_C DSM_CDCDfp_PFltAPSensB1_C DSM_CDCDfp_PFltAPSensB2_C DSM_CDCDfp_PFltBPSPlaus_C DSM_CDCDfp_PFltCDPPreB1_C DSM_CDCDfp_PFltCDPPreB2_C DSM_CDCDfp_PFltCDTPreB1_C DSM_CDCDfp_PFltCDTPreB2_C DSM_CDCDfp_PFltCharB1_C DSM_CDCDfp_PFltCharB2_C DSM_CDCDfp_PFltDltOxiPreTwFlw_C DSM_CDCDfp_PFltDltPreTwFlw_C DSM_CDCDfp_PFltEngPrtB1_C DSM_CDCDfp_PFltEngPrtB2_C DSM_CDCDfp_PFltOvldInhRgnB1_C DSM_CDCDfp_PFltOvldInhRgnB2_C DSM_CDCDfp_PFltOvldTrqLimB1_C DSM_CDCDfp_PFltOvldTrqLimB2_C DSM_CDCDfp_PFltPresDynPlausB1_C DSM_CDCDfp_PFltPresDynPlausB2_C DSM_CDCDfp_PFltPresPlausB1_C DSM_CDCDfp_PFltPresPlausB2_C DSM_CDCDfp_PFltPresSensB1_C DSM_CDCDfp_PFltPresSensB2_C DSM_CDCDfp_PFltPresSensFrz_C DSM_CDCDfp_PFltPresSensHsLnB1_C DSM_CDCDfp_PFltPresSensHsLnB2_C DSM_CDCDfp_PFltPresSensSotB1_C DSM_CDCDfp_PFltPresSensSotB2_C DSM_CDCDfp_PFltRgnPerm_C DSM_CDCDfp_PFltTempDwnStrmB1_C DSM_CDCDfp_PFltTempDwnStrmB2_C DSM_CDCDfp_PFltTempSensB1_C DSM_CDCDfp_PFltTempSensB2_C DSM_CDCDfp_PFltTempUpStrmB1_C DSM_CDCDfp_PFltTempUpStrmB2_C DSM_CDCDfp_PFlt_tOxiPreMaxB1_C DSM_CDCDfp_PFlt_tOxiPreMaxB2_C DSM_CDCDfp_PFlt_tOxiPreMxRgnB1_C DSM_CDCDfp_PFlt_tOxiPreMxRgnB2_C DSM_CDCDfp_PFlt_tPreMaxB1_C DSM_CDCDfp_PFlt_tPreMaxB2_C DSM_CDCDfp_PFlt_tPreMaxRgnB1_C DSM_CDCDfp_PFlt_tPreMaxRgnB2_C DSM_CDCDfp_PFltmSotDiffMaxB1_C DSM_CDCDfp_PFltmSotDiffMaxB2_C DSM_CDCDfp_PresPlausDblDef_C DSM_CDCDfp_QLTCD_C DSM_CDCDfp_RailCD_C DSM_CDCDfp_RailCDOfsTst_C DSM_CDCDfp_RailCD_PMonStrt_C DSM_CDCDfp_RailCPC1_C DSM_CDCDfp_RailCPC3_C DSM_CDCDfp_RailCPC4_C DSM_CDCDfp_RailCtlModeMeUnDiag_C DSM_CDCDfp_RailCtlModePCVDiag_C DSM_CDCDfp_RailMeUn0_C DSM_CDCDfp_RailMeUn1_C DSM_CDCDfp_RailMeUn2_C DSM_CDCDfp_RailMeUn3_C DSM_CDCDfp_RailMeUn4_C DSM_CDCDfp_RailPCV0_C DSM_CDCDfp_RailPCV1_C DSM_CDCDfp_RailPCV2_C DSM_CDCDfp_RailPCV3_C DSM_CDCDfp_RailPCV4_C DSM_CDCDfp_RailPCV5_C DSM_CDCDfp_SOPTst_C DSM_CDCDfp_SSpMon1_C DSM_CDCDfp_SSpMon2_C DSM_CDCDfp_SSpMon3_C DSM_CDCDfp_SSpMon4_C DSM_CDCDfp_SSpMon5_C DSM_CDCDfp_SSpMon6_C DSM_CDCDfp_SWChk_CycSigChkDat_C DSM_CDCDfp_SWChk_CycSigChkPrg_C DSM_CDCDfp_StSysTrqShutOff_C DSM_CDCDfp_StrtCD_Actr_C DSM_CDCDfp_SysLamp_C DSM_CDCDfp_T15CD_C DSM_CDCDfp_TGearbx_C DSM_CDCDfp_TPUMon_C DSM_CDCDfp_TVACD_AirMon1_C DSM_CDCDfp_TVACD_AirMon2_C DSM_CDCDfp_TVACD_Max_C DSM_CDCDfp_TVACD_Max2_C DSM_CDCDfp_TVACD_Min_C DSM_CDCDfp_TVACD_Min2_C DSM_CDCDfp_TVACD_SigNpl_C DSM_CDCDfp_TVACD_SigNpl2_C DSM_CDCDfp_TVACD_TVADia1_C DSM_CDCDfp_TVACD_TVADia2_C DSM_CDCDfp_TVACD_TVADia21_C DSM_CDCDfp_TVACD_TVADia22_C DSM_CDCDfp_TVACD_TVADia23_C DSM_CDCDfp_TVACD_TVADia24_C DSM_CDCDfp_TVACD_TVADia3_C DSM_CDCDfp_TVACD_TVADia4_C DSM_CDCDfp_ThrVlvMon_C DSM_CDCDfp_VSACD_DiaDet_C DSM_CDCDfp_VSACD_DioInDia1_C DSM_CDCDfp_VSACD_DioInDia2_C DSM_CDCDfp_VSACD_DioInDia3_C DSM_CDCDfp_VSACD_DioInDia4_C DSM_CDCDfp_VSACD_DioInMin_C DSM_CDCDfp_VSACD_Max_C DSM_CDCDfp_VSACD_Min_C DSM_CDCDfp_VSACD_SigNpl_C DSM_CDCDfp_VSACD_VSADia1_C DSM_CDCDfp_VSACD_VSADia2_C DSM_CDCDfp_VSACD_VSADia3_C DSM_CDCDfp_VSACD_VSADia4_C DSM_CDCDfp_VSSCD1_C DSM_CDCDfp_VSSCD2_C DSM_CDCDfp_WdCom_C /end DEF_CHARACTERISTIC
/end FUNCTION
/begin COMPU_METHOD OneToOne "eins zu eins (physikalischer Wert ist gleich dem internen Wert)" RAT_FUNC "%6.2" "-" COEFFS 0 1 0 0 0 1 /end COMPU_METHOD
/begin RECORD_LAYOUT Kwb_Wu16 FNC_VALUES 1 UWORD COLUMN_DIR DIRECT /end RECORD_LAYOUT
/end MODULE
/end PROJECT
