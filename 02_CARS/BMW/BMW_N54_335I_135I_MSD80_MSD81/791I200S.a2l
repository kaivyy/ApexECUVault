ASAP2_VERSION 1 41
/begin PROJECT MSD85 "Spray Guided DI-System with Piezo Injectors for 8-Cylinder"
/begin HEADER "_default_HeaderComment" PROJECT_NO _91 /end HEADER
/begin MODULE _default_ModuleName "_default_ModuleLongIdentifier"
/begin MOD_COMMON "_default_ModCommonComment" DEPOSIT ABSOLUTE BYTE_ORDER MSB_LAST ALIGNMENT_BYTE 1 ALIGNMENT_WORD 2 ALIGNMENT_LONG 2 ALIGNMENT_FLOAT32_IEEE 2 ALIGNMENT_FLOAT64_IEEE 4 /end MOD_COMMON
/begin MEASUREMENT map_mes "Intake manifold pressure mean value " UWORD _CNV_A_R_LINEAR_____27_CM 1 100. 0. 5434. DISPLAY_IDENTIFIER MAP_MES ECU_ADDRESS 0xd000a488 FORMAT "%7.2" /end MEASUREMENT
/begin MEASUREMENT map_mes_bas[0] "Intake manifold pressure per segment measured" UWORD _CNV_A_R_LINEAR_____27_CM 1 100. 0. 5434. DISPLAY_IDENTIFIER MAP_MES_BAS[1] ECU_ADDRESS 0xd000a48a FORMAT "%7.2" /end MEASUREMENT
/begin MEASUREMENT map_mes_bas[1] "Intake manifold pressure per segment measured" UWORD _CNV_A_R_LINEAR_____27_CM 1 100. 0. 5434. DISPLAY_IDENTIFIER MAP_MES_BAS[2] ECU_ADDRESS 0xd000a48c FORMAT "%7.2" /end MEASUREMENT
/begin MEASUREMENT map_mes_bas_2seg[0] "Intake manifold pressure per second segment measured" UWORD _CNV_A_R_LINEAR_____27_CM 1 100. 0. 5434. DISPLAY_IDENTIFIER MAP_MES_BAS_2SEG[1] ECU_ADDRESS 0xd000a48e FORMAT "%7.2" /end MEASUREMENT
/begin MEASUREMENT map_mes_bas_2seg[1] "Intake manifold pressure per second segment measured" UWORD _CNV_A_R_LINEAR_____27_CM 1 100. 0. 5434. DISPLAY_IDENTIFIER MAP_MES_BAS_2SEG[2] ECU_ADDRESS 0xd000a490 FORMAT "%7.2" /end MEASUREMENT
/begin CHARACTERISTIC c_mis_rate "Misfire rate for regular misfire generator mode" VALUE 0xa08079e9 _REC_VAL_20_u1 255. _CNV_A_R_LINEAR_____0_CM 0. 255. DISPLAY_IDENTIFIER C_MIS_RATE FORMAT "%3.0" /end CHARACTERISTIC
/begin MEASUREMENT inh_iv_mis_gen "Idendification of cylinders shut off by injection misifre generator" UBYTE _CNV_A_R_LINEAR_____0_CM 1 100. 0. 255. DISPLAY_IDENTIFIER INH_IV_MIS_GEN ECU_ADDRESS 0xd00076c4 FORMAT "%3.0" /end MEASUREMENT
/begin MEASUREMENT inh_igc_mis_gen "Idendification of cylinders shut off by ignition misifre generator" UBYTE _CNV_A_R_LINEAR_____0_CM 1 100. 0. 255. DISPLAY_IDENTIFIER INH_IGC_MIS_GEN ECU_ADDRESS 0xd00076c2 FORMAT "%3.0" /end MEASUREMENT
/begin MEASUREMENT lv_mis_gen "Flag to indicate the missing ignition and/or injection (current segment)" UBYTE _CNV_S_2_RANGE__0___1_CM 1 100. 0. 1. DISPLAY_IDENTIFIER LV_MIS_GEN ECU_ADDRESS 0xd000770c BIT_MASK 0x1 /end MEASUREMENT
/begin CHARACTERISTIC lc_req_mis_gen "Misfire software generator request" VALUE 0xa0807a04 _REC_VAL_20_u1 1. _CNV_S_2_RANGE__0___1_CM 0. 1. DISPLAY_IDENTIFIER LC_REQ_MIS_GEN BIT_MASK 0x1 /end CHARACTERISTIC
/begin CHARACTERISTIC lc_ign_off_mis_gen "Boolean for misfire genration with ignition cut-off (=1)" VALUE 0xa08079f7 _REC_VAL_20_u1 1. _CNV_S_2_RANGE__0___1_CM 0. 1. DISPLAY_IDENTIFIER LC_IGN_OFF_MIS_GEN BIT_MASK 0x1 /end CHARACTERISTIC
/begin CHARACTERISTIC lc_inj_off_mis_gen "Boolean for misfire generation with injection cut-off (=1)" VALUE 0xa08079f8 _REC_VAL_20_u1 1. _CNV_S_2_RANGE__0___1_CM 0. 1. DISPLAY_IDENTIFIER LC_INJ_OFF_MIS_GEN BIT_MASK 0x1 /end CHARACTERISTIC
/begin CHARACTERISTIC c_seg_st_mis_gen "Start segment for misfire software generator triggering" VALUE 0xa08079f6 _REC_VAL_20_u1 7. _CNV_A_R_LINEAR_____0_CM 0. 7. DISPLAY_IDENTIFIER C_SEG_ST_MIS_GEN FORMAT "%3.0" /end CHARACTERISTIC
/begin MEASUREMENT lv_mis_gen_det "Flag to indicate the missing ignition and/or injection, delayed to be synchronized with misfire detection flags" UBYTE _CNV_S_2_RANGE__0___1_CM 1 100. 0. 1. DISPLAY_IDENTIFIER LV_MIS_GEN_DET ECU_ADDRESS 0xd00035b0 BIT_MASK 0x1 /end MEASUREMENT
/begin CHARACTERISTIC c_mod_mis_gen "Misfire software generator function mode" VALUE 0xa08079f4 _REC_VAL_20_u1 2. _CNV_A_R_LINEAR_____0_CM 0. 2. DISPLAY_IDENTIFIER C_MOD_MIS_GEN FORMAT "%3.0" /end CHARACTERISTIC
/begin CHARACTERISTIC c_mis_rate_cyl[0] "Misfire rate for cylinder regular misfire generator mode" VALUE 0xa08079ec _REC_VAL_20_u1 255. _CNV_A_R_LINEAR_____0_CM 0. 255. DISPLAY_IDENTIFIER C_MIS_RATE_CYL[0] FORMAT "%3.0" /end CHARACTERISTIC
/begin CHARACTERISTIC c_mis_rate_cyl[1] "Misfire rate for cylinder regular misfire generator mode" VALUE 0xa08079ed _REC_VAL_20_u1 255. _CNV_A_R_LINEAR_____0_CM 0. 255. DISPLAY_IDENTIFIER C_MIS_RATE_CYL[1] FORMAT "%3.0" /end CHARACTERISTIC
/begin CHARACTERISTIC c_mis_rate_cyl[2] "Misfire rate for cylinder regular misfire generator mode" VALUE 0xa08079ee _REC_VAL_20_u1 255. _CNV_A_R_LINEAR_____0_CM 0. 255. DISPLAY_IDENTIFIER C_MIS_RATE_CYL[2] FORMAT "%3.0" /end CHARACTERISTIC
/begin CHARACTERISTIC c_mis_rate_cyl[3] "Misfire rate for cylinder regular misfire generator mode" VALUE 0xa08079ef _REC_VAL_20_u1 255. _CNV_A_R_LINEAR_____0_CM 0. 255. DISPLAY_IDENTIFIER C_MIS_RATE_CYL[3] FORMAT "%3.0" /end CHARACTERISTIC
/begin CHARACTERISTIC c_mis_rate_cyl[4] "Misfire rate for cylinder regular misfire generator mode" VALUE 0xa08079f0 _REC_VAL_20_u1 255. _CNV_A_R_LINEAR_____0_CM 0. 255. DISPLAY_IDENTIFIER C_MIS_RATE_CYL[4] FORMAT "%3.0" /end CHARACTERISTIC
/begin CHARACTERISTIC c_mis_rate_cyl[5] "Misfire rate for cylinder regular misfire generator mode" VALUE 0xa08079f1 _REC_VAL_20_u1 255. _CNV_A_R_LINEAR_____0_CM 0. 255. DISPLAY_IDENTIFIER C_MIS_RATE_CYL[5] FORMAT "%3.0" /end CHARACTERISTIC
/begin CHARACTERISTIC c_mis_rate_cyl[6] "Misfire rate for cylinder regular misfire generator mode" VALUE 0xa08079f2 _REC_VAL_20_u1 255. _CNV_A_R_LINEAR_____0_CM 0. 255. DISPLAY_IDENTIFIER C_MIS_RATE_CYL[6] FORMAT "%3.0" /end CHARACTERISTIC
/begin CHARACTERISTIC c_mis_rate_cyl[7] "Misfire rate for cylinder regular misfire generator mode" VALUE 0xa08079f3 _REC_VAL_20_u1 255. _CNV_A_R_LINEAR_____0_CM 0. 255. DISPLAY_IDENTIFIER C_MIS_RATE_CYL[7] FORMAT "%3.0" /end CHARACTERISTIC
/begin CHARACTERISTIC c_nr_tdc_dly_mis_gen "Delay to synchronize LV_MIS_GEN_DET with misfire detection flags" VALUE 0xa08079f5 _REC_VAL_20_u1 15. _CNV_A_R_LINEAR_____0_CM 0. 15. DISPLAY_IDENTIFIER C_NR_TDC_DLY_MIS_GEN FORMAT "%3.0" /end CHARACTERISTIC
/begin CHARACTERISTIC lc_mis_rate_ena_cyl[0] "Boolean to activate cylinder regular misfire generator mode per cylinder" VALUE 0xa08079fc _REC_VAL_20_u1 1. _CNV_S_2_RANGE__0___1_CM 0. 1. DISPLAY_IDENTIFIER LC_MIS_RATE_ENA_CYL[0] BIT_MASK 0x1 /end CHARACTERISTIC
/begin CHARACTERISTIC lc_mis_rate_ena_cyl[1] "Boolean to activate cylinder regular misfire generator mode per cylinder" VALUE 0xa08079fd _REC_VAL_20_u1 1. _CNV_S_2_RANGE__0___1_CM 0. 1. DISPLAY_IDENTIFIER LC_MIS_RATE_ENA_CYL[1] BIT_MASK 0x1 /end CHARACTERISTIC
/begin CHARACTERISTIC lc_mis_rate_ena_cyl[2] "Boolean to activate cylinder regular misfire generator mode per cylinder" VALUE 0xa08079fe _REC_VAL_20_u1 1. _CNV_S_2_RANGE__0___1_CM 0. 1. DISPLAY_IDENTIFIER LC_MIS_RATE_ENA_CYL[2] BIT_MASK 0x1 /end CHARACTERISTIC
/begin CHARACTERISTIC lc_mis_rate_ena_cyl[3] "Boolean to activate cylinder regular misfire generator mode per cylinder" VALUE 0xa08079ff _REC_VAL_20_u1 1. _CNV_S_2_RANGE__0___1_CM 0. 1. DISPLAY_IDENTIFIER LC_MIS_RATE_ENA_CYL[3] BIT_MASK 0x1 /end CHARACTERISTIC
/begin CHARACTERISTIC lc_mis_rate_ena_cyl[4] "Boolean to activate cylinder regular misfire generator mode per cylinder" VALUE 0xa0807a00 _REC_VAL_20_u1 1. _CNV_S_2_RANGE__0___1_CM 0. 1. DISPLAY_IDENTIFIER LC_MIS_RATE_ENA_CYL[4] BIT_MASK 0x1 /end CHARACTERISTIC
/begin CHARACTERISTIC lc_mis_rate_ena_cyl[5] "Boolean to activate cylinder regular misfire generator mode per cylinder" VALUE 0xa0807a01 _REC_VAL_20_u1 1. _CNV_S_2_RANGE__0___1_CM 0. 1. DISPLAY_IDENTIFIER LC_MIS_RATE_ENA_CYL[5] BIT_MASK 0x1 /end CHARACTERISTIC
/begin CHARACTERISTIC lc_mis_rate_ena_cyl[6] "Boolean to activate cylinder regular misfire generator mode per cylinder" VALUE 0xa0807a02 _REC_VAL_20_u1 1. _CNV_S_2_RANGE__0___1_CM 0. 1. DISPLAY_IDENTIFIER LC_MIS_RATE_ENA_CYL[6] BIT_MASK 0x1 /end CHARACTERISTIC
/begin CHARACTERISTIC lc_mis_rate_ena_cyl[7] "Boolean to activate cylinder regular misfire generator mode per cylinder" VALUE 0xa0807a03 _REC_VAL_20_u1 1. _CNV_S_2_RANGE__0___1_CM 0. 1. DISPLAY_IDENTIFIER LC_MIS_RATE_ENA_CYL[7] BIT_MASK 0x1 /end CHARACTERISTIC
/begin AXIS_PTS ldp_x__id_rnd_pat_mis_gen "" 0xa08079c4 NO_INPUT_QUANTITY _REC_AXS_20_u1 255. _CNV_A_R_LINEAR_____0_CM 16 0. 255. FORMAT "%3.0" /end AXIS_PTS
/begin AXIS_PTS ldp_y__id_rnd_pat_mis_gen "" 0xa08079d8 NO_INPUT_QUANTITY _REC_AXS_20_u1 255. _CNV_A_R_LINEAR_____0_CM 16 0. 255. FORMAT "%3.0" /end AXIS_PTS
/begin CHARACTERISTIC id_rnd_pat_mis_gen "Table of Boolean to define the pseudo random misfire sequence" MAP 0xa0812dec _REC_MAP_20_u1_u1_u1 1. _CNV_A_R_LINEAR_____0_CM 0. 1. DISPLAY_IDENTIFIER ID_RND_PAT_MIS_GEN FORMAT "%1.0"
 /begin AXIS_DESCR COM_AXIS NO_INPUT_QUANTITY _CNV_A_R_LINEAR_____0_CM 16 0. 255. FORMAT "%3.0" AXIS_PTS_REF ldp_x__id_rnd_pat_mis_gen /end AXIS_DESCR
 /begin AXIS_DESCR COM_AXIS NO_INPUT_QUANTITY _CNV_A_R_LINEAR_____0_CM 16 0. 255. FORMAT "%3.0" AXIS_PTS_REF ldp_y__id_rnd_pat_mis_gen /end AXIS_DESCR
/end CHARACTERISTIC
/begin MEASUREMENT inh_iv_mis_gen_16 "Identification of cylinders shut off by injection misfire generator" UWORD _CNV_A_R_LINEAR_____0_CM 1 100. 0. 4095. DISPLAY_IDENTIFIER INH_IV_MIS_GEN_16 ECU_ADDRESS 0xd000714c FORMAT "%5.0" /end MEASUREMENT
/begin MEASUREMENT inh_igc_mis_gen_16 "Identification of cylinders shut off by ignition misfire generator" UWORD _CNV_A_R_LINEAR_____0_CM 1 100. 0. 4095. DISPLAY_IDENTIFIER INH_IGC_MIS_GEN_16 ECU_ADDRESS 0xd000714a FORMAT "%5.0" /end MEASUREMENT
/begin MEASUREMENT load_mis "Normalised engine load for misfire detection - sampled at current misfire segment" UWORD _CNV_A_R_LINEAR_____212_CM 1 100. 0. 99.9969482421875 DISPLAY_IDENTIFIER LOAD_MIS ECU_ADDRESS 0xd00070f8 FORMAT "%7.3" /end MEASUREMENT
/begin MEASUREMENT load_mis_1 "Normalised engine load for misfire detection - 1 misfire segment before" UWORD _CNV_A_R_LINEAR_____212_CM 1 100. 0. 99.9969482421875 DISPLAY_IDENTIFIER LOAD_MIS_1 ECU_ADDRESS 0xd00070fa FORMAT "%7.3" /end MEASUREMENT
/begin MEASUREMENT load_mis_2 "Normalised engine load for misfire detection - 2 misfire segment before" UWORD _CNV_A_R_LINEAR_____212_CM 1 100. 0. 99.9969482421875 DISPLAY_IDENTIFIER LOAD_MIS_2 ECU_ADDRESS 0xd00070fc FORMAT "%7.3" /end MEASUREMENT
/begin MEASUREMENT load_mis_3 "Normalised engine load for misfire detection - 3 misfire segment before" UWORD _CNV_A_R_LINEAR_____212_CM 1 100. 0. 99.9969482421875 DISPLAY_IDENTIFIER LOAD_MIS_3 ECU_ADDRESS 0xd00070fe FORMAT "%7.3" /end MEASUREMENT
/begin MEASUREMENT load_grd_mis "Normalised engine load gradient for misfire detection " UWORD _CNV_A_R_LINEAR_____212_CM 1 100. 0. 99.9969482421875 DISPLAY_IDENTIFIER LOAD_GRD_MIS ECU_ADDRESS 0xd00070f4 FORMAT "%7.3" /end MEASUREMENT
/begin AXIS_PTS ldp_n_32_ip_tqi_av_max_mis "" 0xa0806e1c n_32 _REC_AXS_20_u1 8160. _CNV_A_R_LINEAR_____10_CM 8 0. 8160. FORMAT "%4.0" /end AXIS_PTS
/begin MEASUREMENT mis_det_cdn_app_inh "Misfiring APP INC detection fade out requests carrier word (before masking)" UWORD _CNV_A_R_LINEAR_____0_CM 1 100. 0. 65535. DISPLAY_IDENTIFIER MIS_DET_CDN_APP_INH ECU_ADDRESS 0xd0007124 FORMAT "%5.0" /end MEASUREMENT
/begin MEASUREMENT mis_det_cdn_app_inh.lv_inh_map_dif_det_mis "Misfire detection fade out request flag due to MAP_DIF condition" UWORD _CNV_A_R_LINEAR_____0_CM 1 100. 0. 65535. DISPLAY_IDENTIFIER LV_INH_MAP_DIF_DET_MIS ECU_ADDRESS 0xd0007124 FORMAT "%5.0" BIT_MASK 0x1 /end MEASUREMENT
/begin MEASUREMENT mis_det_cdn_app_inh.lv_inh_tps_grd_det_mis "Misfire detection fade out request flag due to TPS gradient condition" UWORD _CNV_A_R_LINEAR_____0_CM 1 100. 0. 65535. DISPLAY_IDENTIFIER LV_INH_TPS_GRD_DET_MIS ECU_ADDRESS 0xd0007124 FORMAT "%5.0" BIT_MASK 0x2 /end MEASUREMENT
/begin MEASUREMENT mis_det_cdn_app_inh.lv_inh_load_grd_det_mis "Misfire detection fade out request flag due to LOAD_GRD_MIS condition" UWORD _CNV_A_R_LINEAR_____0_CM 1 100. 0. 65535. DISPLAY_IDENTIFIER LV_INH_LOAD_GRD_DET_MIS ECU_ADDRESS 0xd0007124 FORMAT "%5.0" BIT_MASK 0x4 /end MEASUREMENT
/begin MEASUREMENT mis_det_cdn_app_inh.lv_inh_iga_dif_det_mis "Misfire detection fade out request flag due to IGA_DIF condition" UWORD _CNV_A_R_LINEAR_____0_CM 1 100. 0. 65535. DISPLAY_IDENTIFIER LV_INH_IGA_DIF_DET_MIS ECU_ADDRESS 0xd0007124 FORMAT "%5.0" BIT_MASK 0x8 /end MEASUREMENT
/begin MEASUREMENT mis_det_cdn_app_inh.lv_inh_cmb_tra_mis "Misfire detection fade out request flag due to combustion mode transients" UWORD _CNV_A_R_LINEAR_____0_CM 1 100. 0. 65535. DISPLAY_IDENTIFIER LV_INH_CMB_TRA_MIS ECU_ADDRESS 0xd0007124 FORMAT "%5.0" BIT_MASK 0x10 /end MEASUREMENT
/begin MEASUREMENT mis_det_cdn_app_inh.lv_inh_acc_det_mis "Misfire detection fade out request flag due to Air conditionner transient condition" UWORD _CNV_A_R_LINEAR_____0_CM 1 100. 0. 65535. DISPLAY_IDENTIFIER LV_INH_ACC_DET_MIS ECU_ADDRESS 0xd0007124 FORMAT "%5.0" BIT_MASK 0x20 /end MEASUREMENT
/begin MEASUREMENT mis_det_cdn_app_inh_nr "Misfiring APP INC detection fade out requests number  (after masking)" UBYTE _CNV_A_R_LINEAR_____0_CM 1 100. 0. 255. DISPLAY_IDENTIFIER MIS_DET_CDN_APP_INH_NR ECU_ADDRESS 0xd00076aa FORMAT "%3.0" /end MEASUREMENT
/begin MEASUREMENT map_dif_mis "Manifold air pressure difference between 2 misfire segment tasks" UWORD _CNV_A_R_LINEAR_____27_CM 1 100. 0. 5434. DISPLAY_IDENTIFIER MAP_DIF_MIS ECU_ADDRESS 0xd0007100 FORMAT "%7.2" /end MEASUREMENT
/begin MEASUREMENT iga_dif_mis "Absolute Ignition angle difference between 2 misfire segment tasks" UBYTE _CNV_A_R_LINEAR_____200_CM 1 100. 0. 95.625 DISPLAY_IDENTIFIER IGA_DIF_MIS ECU_ADDRESS 0xd000769d /end MEASUREMENT
/begin MEASUREMENT iga_mis_2 "Ignition angle 2 misfire segment before" UBYTE _CNV_A_R_LINEAR_____190_CM 1 100. -35.625 60. DISPLAY_IDENTIFIER IGA_MIS_2 ECU_ADDRESS 0xd00076a0 FORMAT "%7.3" /end MEASUREMENT
/begin MEASUREMENT iga_mis_1 "Ignition angle 1 misfire segment before" UBYTE _CNV_A_R_LINEAR_____190_CM 1 100. -35.625 60. DISPLAY_IDENTIFIER IGA_MIS_1 ECU_ADDRESS 0xd000769f FORMAT "%7.3" /end MEASUREMENT
/begin MEASUREMENT iga_mis "Ignition angle at current misfire segment" UBYTE _CNV_A_R_LINEAR_____190_CM 1 100. -35.625 60. DISPLAY_IDENTIFIER IGA_MIS ECU_ADDRESS 0xd000769e FORMAT "%7.3" /end MEASUREMENT
/begin MEASUREMENT lv_req_app_inh_mis "Misfire detection APP INC fade out request flag" UBYTE _CNV_S_2_RANGE__0___1_CM 1 100. 0. 1. DISPLAY_IDENTIFIER LV_REQ_APP_INH_MIS ECU_ADDRESS 0xd00076f0 BIT_MASK 0x1 /end MEASUREMENT
/begin CHARACTERISTIC c_mask_app_inh_det_zdly_mis "MIS_DET_CDN_APP_INH carrier structure fade out configuration mask (misfire detection in zero delay phase)" VALUE 0xa08070d8 _REC_VAL_20_u2 65535. _CNV_A_R_LINEAR_____0_CM 0. 65535. DISPLAY_IDENTIFIER C_MASK_APP_INH_DET_ZDLY_MIS FORMAT "%5.0" /end CHARACTERISTIC
/begin CHARACTERISTIC c_t_map_dif_dly_mis "Fade out duration when manifold air pressure gradient has been detected" VALUE 0xa0807124 _REC_VAL_20_u2 655.35 _CNV_A_R_LINEAR_____3_CM 0. 655.35 DISPLAY_IDENTIFIER C_T_MAP_DIF_DLY_MIS FORMAT "%6.2" /end CHARACTERISTIC
/begin CHARACTERISTIC c_t_tps_grd_dly_mis "Fade out duration when maximum throttle gradient has been detected" VALUE 0xa0807128 _REC_VAL_20_u2 655.35 _CNV_A_R_LINEAR_____3_CM 0. 655.35 DISPLAY_IDENTIFIER C_T_TPS_GRD_DLY_MIS FORMAT "%6.2" /end CHARACTERISTIC
/begin CHARACTERISTIC c_t_tps_grd_dly_zdly_mis "Fade out duration when maximum throttle gradient has been detected during zero delay starting phase" VALUE 0xa080712a _REC_VAL_20_u2 655.35 _CNV_A_R_LINEAR_____3_CM 0. 655.35 DISPLAY_IDENTIFIER C_T_TPS_GRD_DLY_ZDLY_MIS FORMAT "%6.2" /end CHARACTERISTIC
/begin CHARACTERISTIC c_nr_tdc_iga_dif_mis "Fade out duration when IGA difference per TDC has been detected" VALUE 0xa0807110 _REC_VAL_20_u1 255. _CNV_A_R_LINEAR_____0_CM 0. 255. DISPLAY_IDENTIFIER C_NR_TDC_IGA_DIF_MIS FORMAT "%3.0" /end CHARACTERISTIC
/begin CHARACTERISTIC c_t_load_grd_hom_dly_mis "Fade out duration when maximum LOAD_GRD_MIS has been detected in homogeneous combustion  modes" VALUE 0xa0807122 _REC_VAL_20_u2 655.35 _CNV_A_R_LINEAR_____3_CM 0. 655.35 DISPLAY_IDENTIFIER C_T_LOAD_GRD_HOM_DLY_MIS FORMAT "%6.2" /end CHARACTERISTIC
/begin CHARACTERISTIC c_t_accout_dly_mis "Fade out duration when air-conditioning compressor has been switched on" VALUE 0xa080711a _REC_VAL_20_u2 655.35 _CNV_A_R_LINEAR_____3_CM 0. 655.35 DISPLAY_IDENTIFIER C_T_ACCOUT_DLY_MIS FORMAT "%6.2" /end CHARACTERISTIC
/begin AXIS_PTS ldp_tps_av_ip_tps_grd_max_mis "" 0xa0806ea8 tps_av_mv _REC_AXS_20_u2 119.5 _CNV_A_R_LINEAR_____227_CM 10 0. 119.5 FORMAT "%7.3" /end AXIS_PTS
/begin AXIS_PTS ldp_tps_av_ip_tps_grd_zdly_er "" 0xa0806ec0 tps_av_mv _REC_AXS_20_u2 119.5 _CNV_A_R_LINEAR_____227_CM 6 0. 119.5 FORMAT "%7.3" /end AXIS_PTS
/begin AXIS_PTS ldp_load_mis_ip_load_grd_mis "" 0xa0806da4 load_mis _REC_AXS_20_u2 99.9969482421875 _CNV_A_R_LINEAR_____212_CM 12 0. 99.9969482421875 FORMAT "%7.3" /end AXIS_PTS
/begin AXIS_PTS ldp_map_ip_map_dif_max_mis "" 0xa0806dc0 map _REC_AXS_20_u2 5434. _CNV_A_R_LINEAR_____27_CM 12 0. 5434. FORMAT "%7.2" /end AXIS_PTS
/begin AXIS_PTS ldp_n_32_ip_delta_iga_mis "" 0xa0806de8 n_32 _REC_AXS_20_u1 8160. _CNV_A_R_LINEAR_____10_CM 8 0. 8160. FORMAT "%4.0" /end AXIS_PTS
/begin AXIS_PTS ldp_load_mis_ip_delta_iga_mis "" 0xa0806d70 load_mis _REC_AXS_20_u2 99.9969482421875 _CNV_A_R_LINEAR_____212_CM 8 0. 99.9969482421875 FORMAT "%7.3" /end AXIS_PTS
/begin AXIS_PTS ldp_load_mis_ip_load_grd_s_mis "" 0xa080725c load_mis _REC_AXS_20_u2 99.9969482421875 _CNV_A_R_LINEAR_____212_CM 12 0. 99.9969482421875 FORMAT "%7.3" /end AXIS_PTS
/begin CHARACTERISTIC c_t_load_grd_s_dly_mis "Fade out duration when maximum LOAD_GRD_MIS has been detected in stratified combustion  mode" VALUE 0xa0807336 _REC_VAL_20_u2 655.35 _CNV_A_R_LINEAR_____3_CM 0. 655.35 DISPLAY_IDENTIFIER C_T_LOAD_GRD_S_DLY_MIS FORMAT "%6.2" /end CHARACTERISTIC
/begin CHARACTERISTIC c_map_max_mis "Maximum manifold air pressure value to determine engine load ratio scale for misfire detection" VALUE 0xa08070d2 _REC_VAL_20_u2 5434. _CNV_A_R_LINEAR_____27_CM 0. 5434. DISPLAY_IDENTIFIER C_MAP_MAX_MIS FORMAT "%7.2" /end CHARACTERISTIC
/begin CHARACTERISTIC c_conf_load_mis "LOAD_MIS switch configuration versus engine combustion mode : " VALUE 0xa08070cc _REC_VAL_20_u1 2. _CNV_A_R_LINEAR_____0_CM 0. 2. DISPLAY_IDENTIFIER C_CONF_LOAD_MIS FORMAT "%3.0" /end CHARACTERISTIC
/begin CHARACTERISTIC ip_maf_max_mis "Maximum air mass value to determine engine load ratio scale for misfire detection" CURVE 0xa080703c _REC_CUR_20_u2_u1 1389. _CNV_A_R_LINEAR_____111_CM 0. 1389. DISPLAY_IDENTIFIER IP_MAF_MAX_MIS FORMAT "%7.2"
 /begin AXIS_DESCR COM_AXIS n_32 _CNV_A_R_LINEAR_____10_CM 6 0. 8160. FORMAT "%4.0" AXIS_PTS_REF ldp_n_32_ip_maf_max_mis /end AXIS_DESCR
/end CHARACTERISTIC
/begin CHARACTERISTIC ip_tps_grd_max_mis "Maximum throttle gradient threshold for fade out condition" CURVE 0xa0807084 _REC_CUR_20_u1_u2 2987.5 _CNV_A_R_LINEAR_____386_CM 0. 2987.5 DISPLAY_IDENTIFIER IP_TPS_GRD_MAX_MIS FORMAT "%6.1"
 /begin AXIS_DESCR COM_AXIS tps_av_mv _CNV_A_R_LINEAR_____227_CM 10 0. 119.5 FORMAT "%7.3" AXIS_PTS_REF ldp_tps_av_ip_tps_grd_max_mis /end AXIS_DESCR
/end CHARACTERISTIC
/begin CHARACTERISTIC ip_tps_grd_zdly_mis "Maximum throttle gradient threshold for fade out condition during zero delay misfire monitoring activation" CURVE 0xa080708e _REC_CUR_20_u1_u2 2987.5 _CNV_A_R_LINEAR_____386_CM 0. 2987.5 DISPLAY_IDENTIFIER IP_TPS_GRD_ZDLY_MIS FORMAT "%6.1"
 /begin AXIS_DESCR COM_AXIS tps_av_mv _CNV_A_R_LINEAR_____227_CM 6 0. 119.5 FORMAT "%7.3" AXIS_PTS_REF ldp_tps_av_ip_tps_grd_zdly_er /end AXIS_DESCR
/end CHARACTERISTIC
/begin CHARACTERISTIC ip_load_grd_mis "Maximum LOAD_MIS gradient for fade out condition in homogeneous combustion modes" CURVE 0xa0807024 _REC_CUR_20_u2_u2 99.9969482421875 _CNV_A_R_LINEAR_____212_CM 0. 99.9969482421875 DISPLAY_IDENTIFIER IP_LOAD_GRD_MIS FORMAT "%7.3"
 /begin AXIS_DESCR COM_AXIS load_mis _CNV_A_R_LINEAR_____212_CM 12 0. 99.9969482421875 FORMAT "%7.3" AXIS_PTS_REF ldp_load_mis_ip_load_grd_mis /end AXIS_DESCR
/end CHARACTERISTIC
/begin CHARACTERISTIC ip_map_dif_max_mis "Maximum MAP gradient for fade out condition" CURVE 0xa0807048 _REC_CUR_20_u2_u2 5434. _CNV_A_R_LINEAR_____27_CM 0. 5434. DISPLAY_IDENTIFIER IP_MAP_DIF_MAX_MIS FORMAT "%7.2"
 /begin AXIS_DESCR COM_AXIS map _CNV_A_R_LINEAR_____27_CM 12 0. 5434. FORMAT "%7.2" AXIS_PTS_REF ldp_map_ip_map_dif_max_mis /end AXIS_DESCR
/end CHARACTERISTIC
/begin CHARACTERISTIC ip_delta_iga_mis "Spark advance angle difference at part load for misfire inhibition" MAP 0xa0806f54 _REC_MAP_20_u1_u1_u2 95.625 _CNV_A_R_LINEAR_____200_CM 0. 95.625 DISPLAY_IDENTIFIER IP_DELTA_IGA_MIS
 /begin AXIS_DESCR COM_AXIS n_32 _CNV_A_R_LINEAR_____10_CM 8 0. 8160. FORMAT "%4.0" AXIS_PTS_REF ldp_n_32_ip_delta_iga_mis /end AXIS_DESCR
 /begin AXIS_DESCR COM_AXIS load_mis _CNV_A_R_LINEAR_____212_CM 8 0. 99.9969482421875 FORMAT "%7.3" AXIS_PTS_REF ldp_load_mis_ip_delta_iga_mis /end AXIS_DESCR
/end CHARACTERISTIC
/begin CHARACTERISTIC ip_load_grd_s_mis "Maximum LOAD_MIS gradient for fade out condition in stratified combustion mode" CURVE 0xa08072f8 _REC_CUR_20_u2_u2 99.9969482421875 _CNV_A_R_LINEAR_____212_CM 0. 99.9969482421875 DISPLAY_IDENTIFIER IP_LOAD_GRD_S_MIS FORMAT "%7.3"
 /begin AXIS_DESCR COM_AXIS load_mis _CNV_A_R_LINEAR_____212_CM 12 0. 99.9969482421875 FORMAT "%7.3" AXIS_PTS_REF ldp_load_mis_ip_load_grd_s_mis /end AXIS_DESCR
/end CHARACTERISTIC
/begin CHARACTERISTIC c_nr_tdc_cmb_tra_s_mis "Fade out TDC's duration when engine combustion manager enter in stratified combustion mode" VALUE 0xa0807334 _REC_VAL_20_u1 255. _CNV_A_R_LINEAR_____408_CM 0. 255. DISPLAY_IDENTIFIER C_NR_TDC_CMB_TRA_S_MIS FORMAT "%3.0" /end CHARACTERISTIC
/begin CHARACTERISTIC c_nr_tdc_cmb_tra_afl_mis "Fade out TDC's duration when engine combustion manager enter  air/fuel lean combustion mode" VALUE 0xa0807408 _REC_VAL_20_u1 255. _CNV_A_R_LINEAR_____408_CM 0. 255. DISPLAY_IDENTIFIER C_NR_TDC_CMB_TRA_AFL_MIS FORMAT "%3.0" /end CHARACTERISTIC
/begin CHARACTERISTIC c_nr_tdc_cmb_tra_hom_mis "Fade out TDC's duration when engine combustion manager enter  homogen combustion mode" VALUE 0xa0807409 _REC_VAL_20_u1 255. _CNV_A_R_LINEAR_____408_CM 0. 255. DISPLAY_IDENTIFIER C_NR_TDC_CMB_TRA_HOM_MIS FORMAT "%3.0" /end CHARACTERISTIC
/begin CHARACTERISTIC ip_tqi_av_max_mis "Maximum torque value to determine engine load ratio scale for misfire detection" CURVE 0xa0807094 _REC_CUR_20_u2_u1 1023.96875 _CNV_A_R_LINEAR_____31_CM 0. 1023.96875 DISPLAY_IDENTIFIER IP_TQI_AV_MAX_MIS FORMAT "%7.2"
 /begin AXIS_DESCR COM_AXIS n_32 _CNV_A_R_LINEAR_____10_CM 8 0. 8160. FORMAT "%4.0" AXIS_PTS_REF ldp_n_32_ip_tqi_av_max_mis /end AXIS_DESCR
/end CHARACTERISTIC
/begin CHARACTERISTIC c_mask_app_inh_det_mis "MIS_DET_CDN_APP_INH carrier structure fade out configuration mask (detection in nominal phase out of IS)" VALUE 0xa08070d4 _REC_VAL_20_u2 65535. _CNV_A_R_LINEAR_____0_CM 0. 65535. DISPLAY_IDENTIFIER C_MASK_APP_INH_DET_MIS FORMAT "%5.0" /end CHARACTERISTIC
/begin CHARACTERISTIC c_mask_app_inh_det_mis_is "MIS_DET_CDN_APP_INH carrier structure fade out configuration mask (detection in nominal phase & in IS)" VALUE 0xa08070d6 _REC_VAL_20_u2 65535. _CNV_A_R_LINEAR_____0_CM 0. 65535. DISPLAY_IDENTIFIER C_MASK_APP_INH_DET_MIS_IS FORMAT "%5.0" /end CHARACTERISTIC
/begin AXIS_PTS ldp_n_32_ip_maf_max_mis "" 0xa0806e12 n_32 _REC_AXS_20_u1 8160. _CNV_A_R_LINEAR_____10_CM 6 0. 8160. FORMAT "%4.0" /end AXIS_PTS
/begin MEASUREMENT iga_bas_dif_mis "Ignition angle difference between IGA_BAS_COR_MV and IGA_AV, segment sample" UBYTE _CNV_A_R_LINEAR_____190_CM 1 100. -35.625 60. DISPLAY_IDENTIFIER IGA_BAS_DIF_MIS ECU_ADDRESS 0xd000769c FORMAT "%7.3" /end MEASUREMENT
/begin CHARACTERISTIC c_nr_tdc_iga_dif_is_mis "Fade out duration when relative IGA criterion in idle speed has been detected" VALUE 0xa080710f _REC_VAL_20_u1 255. _CNV_A_R_LINEAR_____0_CM 0. 255. DISPLAY_IDENTIFIER C_NR_TDC_IGA_DIF_IS_MIS FORMAT "%3.0" /end CHARACTERISTIC
/begin CHARACTERISTIC c_nr_tdc_iga_bas_dif_mis "Fade out duration when absolute IGA criterion has been detected" VALUE 0xa080710e _REC_VAL_20_u1 255. _CNV_A_R_LINEAR_____0_CM 0. 255. DISPLAY_IDENTIFIER C_NR_TDC_IGA_BAS_DIF_MIS FORMAT "%3.0" /end CHARACTERISTIC
/begin AXIS_PTS ldp_tco_ip_delta_iga_is_mis "" 0xa0806e86 tco _REC_AXS_20_u1 190.5 _CNV_A_R_LINEAR_____17_CM 4 -48. 142.5 FORMAT "%6.2" /end AXIS_PTS
/begin AXIS_PTS ldp_n_32_ip_delta_iga_bas_mis "" 0xa0806ddc n_32 _REC_AXS_20_u1 8160. _CNV_A_R_LINEAR_____10_CM 8 0. 8160. FORMAT "%4.0" /end AXIS_PTS
/begin AXIS_PTS ldp_load_ip_delta_iga_is_mis "" 0xa0806d44 load_mis _REC_AXS_20_u2 99.9969482421875 _CNV_A_R_LINEAR_____212_CM 4 0. 99.9969482421875 FORMAT "%7.3" /end AXIS_PTS
/begin AXIS_PTS ldp_load_ip_delta_iga_bas_mis "" 0xa0806d30 load_mis _REC_AXS_20_u2 99.9969482421875 _CNV_A_R_LINEAR_____212_CM 8 0. 99.9969482421875 FORMAT "%7.3" /end AXIS_PTS
/begin CHARACTERISTIC ip_delta_iga_is_mis "Spark advance angle difference in idle speed for misfire inhibition" MAP 0xa0806f44 _REC_MAP_20_u1_u1_u2 95.625 _CNV_A_R_LINEAR_____200_CM 0. 95.625 DISPLAY_IDENTIFIER IP_DELTA_IGA_IS_MIS
 /begin AXIS_DESCR COM_AXIS tco _CNV_A_R_LINEAR_____17_CM 4 -48. 142.5 FORMAT "%6.2" AXIS_PTS_REF ldp_tco_ip_delta_iga_is_mis /end AXIS_DESCR
 /begin AXIS_DESCR COM_AXIS load_mis _CNV_A_R_LINEAR_____212_CM 4 0. 99.9969482421875 FORMAT "%7.3" AXIS_PTS_REF ldp_load_ip_delta_iga_is_mis /end AXIS_DESCR
/end CHARACTERISTIC
/begin CHARACTERISTIC ip_delta_iga_bas_mis "Absolut spark advance angle difference for misfire inhibition" MAP 0xa0806f04 _REC_MAP_20_u1_u1_u2 95.625 _CNV_A_R_LINEAR_____190_CM -35.625 60. DISPLAY_IDENTIFIER IP_DELTA_IGA_BAS_MIS FORMAT "%7.3"
 /begin AXIS_DESCR COM_AXIS n_32 _CNV_A_R_LINEAR_____10_CM 8 0. 8160. FORMAT "%4.0" AXIS_PTS_REF ldp_n_32_ip_delta_iga_bas_mis /end AXIS_DESCR
 /begin AXIS_DESCR COM_AXIS load_mis _CNV_A_R_LINEAR_____212_CM 8 0. 99.9969482421875 FORMAT "%7.3" AXIS_PTS_REF ldp_load_ip_delta_iga_bas_mis /end AXIS_DESCR
/end CHARACTERISTIC
/begin MEASUREMENT ctr_t_zdly_mis "10 ms decounter for diagnostic fade out (general purpose)" UWORD _CNV_A_R_LINEAR_____3_CM 1 100. 0. 655.35 DISPLAY_IDENTIFIER CTR_T_ZDLY_MIS ECU_ADDRESS 0xd0007148 FORMAT "%6.2" /end MEASUREMENT
/begin MEASUREMENT lv_diag_mis "Nominal Misfire Monitoring Phase" UBYTE _CNV_S_2_RANGE__0___1_CM 1 100. 0. 1. DISPLAY_IDENTIFIER LV_DIAG_MIS ECU_ADDRESS 0xd00076d9 BIT_MASK 0x1 /end MEASUREMENT
/begin MEASUREMENT lv_zdly_diag_mis "Zero delay misfire monitoring phase" UBYTE _CNV_S_2_RANGE__0___1_CM 1 100. 0. 1. DISPLAY_IDENTIFIER LV_ZDLY_DIAG_MIS ECU_ADDRESS 0xd00076f4 BIT_MASK 0x1 /end MEASUREMENT
/begin CHARACTERISTIC lc_req_zdly_mis "Activation of CARB required 0 delay monitoring" VALUE 0xa0807146 _REC_VAL_20_u1 1. _CNV_S_2_RANGE__0___1_CM 0. 1. DISPLAY_IDENTIFIER LC_REQ_ZDLY_MIS BIT_MASK 0x1 /end CHARACTERISTIC
/begin CHARACTERISTIC c_n_min_zdly_mis "Minimum monitoring engine speed for engine start monitoring phase" VALUE 0xa0807104 _REC_VAL_20_u2 8160. _CNV_A_R_LINEAR_____14_CM 0. 8160. DISPLAY_IDENTIFIER C_N_MIN_ZDLY_MIS FORMAT "%4.0" /end CHARACTERISTIC
/begin CHARACTERISTIC c_t_zdly_mis "Duration for engine start specific misfire monitoring (5s according CARB)" VALUE 0xa080712c _REC_VAL_20_u2 655.35 _CNV_A_R_LINEAR_____3_CM 0. 655.35 DISPLAY_IDENTIFIER C_T_ZDLY_MIS FORMAT "%6.2" /end CHARACTERISTIC
/begin MEASUREMENT mis_det_cdn_inh "Misfiring detection fade out requests carrier byte (before masking)" UBYTE _CNV_A_R_LINEAR_____0_CM 1 100. 0. 255. DISPLAY_IDENTIFIER MIS_DET_CDN_INH ECU_ADDRESS 0xd00076ab FORMAT "%3.0" /end MEASUREMENT
/begin MEASUREMENT mis_det_cdn_inh.lv_inh_n_max_det_mis "Misfire detection fade out request flag due to maximum engine speed condition" UBYTE _CNV_A_R_LINEAR_____0_CM 1 100. 0. 255. DISPLAY_IDENTIFIER LV_INH_N_MAX_DET_MIS ECU_ADDRESS 0xd00076ab FORMAT "%3.0" BIT_MASK 0x1 /end MEASUREMENT
/begin MEASUREMENT mis_det_cdn_inh.lv_inh_n_min_det_mis "Misfire detection fade out request flag due to minimum engine speed condition" UBYTE _CNV_A_R_LINEAR_____0_CM 1 100. 0. 255. DISPLAY_IDENTIFIER LV_INH_N_MIN_DET_MIS ECU_ADDRESS 0xd00076ab FORMAT "%3.0" BIT_MASK 0x2 /end MEASUREMENT
/begin MEASUREMENT mis_det_cdn_inh.lv_inh_load_min_det_mis "Misfire detection fade out request flag due to zero load line condition" UBYTE _CNV_A_R_LINEAR_____0_CM 1 100. 0. 255. DISPLAY_IDENTIFIER LV_INH_LOAD_MIN_DET_MIS ECU_ADDRESS 0xd00076ab FORMAT "%3.0" BIT_MASK 0x4 /end MEASUREMENT
/begin MEASUREMENT mis_det_cdn_inh.lv_inh_tco_min_det_mis "Misfire detection fade out request flagdue to minimum temperature condition" UBYTE _CNV_A_R_LINEAR_____0_CM 1 100. 0. 255. DISPLAY_IDENTIFIER LV_INH_TCO_MIN_DET_MIS ECU_ADDRESS 0xd00076ab FORMAT "%3.0" BIT_MASK 0x8 /end MEASUREMENT
/begin MEASUREMENT mis_det_cdn_inh.lv_inh_amp_min_det_mis "Misfire detection fade out request flagdue to minimum atmospheric pressure  condition" UBYTE _CNV_A_R_LINEAR_____0_CM 1 100. 0. 255. DISPLAY_IDENTIFIER LV_INH_AMP_MIN_DET_MIS ECU_ADDRESS 0xd00076ab FORMAT "%3.0" BIT_MASK 0x10 /end MEASUREMENT
/begin MEASUREMENT mis_det_cdn_inh.lv_inh_st_det_mis "Misfire detection fade out request flag due to engine start condition" UBYTE _CNV_A_R_LINEAR_____0_CM 1 100. 0. 255. DISPLAY_IDENTIFIER LV_INH_ST_DET_MIS ECU_ADDRESS 0xd00076ab FORMAT "%3.0" BIT_MASK 0x20 /end MEASUREMENT
/begin MEASUREMENT mis_det_cdn_inh.lv_inh_iv_off_det_mis "Misfire detection fade out request flag due to cylinder shut-off condition" UBYTE _CNV_A_R_LINEAR_____0_CM 1 100. 0. 255. DISPLAY_IDENTIFIER LV_INH_IV_OFF_DET_MIS ECU_ADDRESS 0xd00076ab FORMAT "%3.0" BIT_MASK 0x40 /end MEASUREMENT
/begin MEASUREMENT mis_det_cdn_inh_nr "Misfiring detection fade out requests number (after masking)" UBYTE _CNV_A_R_LINEAR_____0_CM 1 100. 0. 255. DISPLAY_IDENTIFIER MIS_DET_CDN_INH_NR ECU_ADDRESS 0xd00076ac FORMAT "%3.0" /end MEASUREMENT
/begin MEASUREMENT lv_req_inh_mis "Misfire detection fade out request flag" UBYTE _CNV_S_2_RANGE__0___1_CM 1 100. 0. 1. DISPLAY_IDENTIFIER LV_REQ_INH_MIS ECU_ADDRESS 0xd00076f1 BIT_MASK 0x1 /end MEASUREMENT
/begin CHARACTERISTIC c_mask_inh_det_zdly_mis "MIS_DET_CDN_INH carrier structure fade out configuration mask (misfire detection zero delay phase)" VALUE 0xa08070db _REC_VAL_20_u1 255. _CNV_A_R_LINEAR_____0_CM 0. 255. DISPLAY_IDENTIFIER C_MASK_INH_DET_ZDLY_MIS FORMAT "%3.0" /end CHARACTERISTIC
/begin CHARACTERISTIC c_mask_inh_det_mis "MIS_DET_CDN_INH carrier structure fade out configuration mask (misfire detection nominal phase)" VALUE 0xa08070da _REC_VAL_20_u1 255. _CNV_A_R_LINEAR_____0_CM 0. 255. DISPLAY_IDENTIFIER C_MASK_INH_DET_MIS FORMAT "%3.0" /end CHARACTERISTIC
/begin CHARACTERISTIC c_amp_min_mis "Minimum atmospheric pressure for misfire detection" VALUE 0xa08070ca _REC_VAL_20_u2 5434. _CNV_A_R_LINEAR_____27_CM 0. 5434. DISPLAY_IDENTIFIER C_AMP_MIN_MIS FORMAT "%7.2" /end CHARACTERISTIC
/begin CHARACTERISTIC c_n_min_mis "Minimum engine speed for misfire detection" VALUE 0xa0807102 _REC_VAL_20_u2 8160. _CNV_A_R_LINEAR_____14_CM 0. 8160. DISPLAY_IDENTIFIER C_N_MIN_MIS FORMAT "%4.0" /end CHARACTERISTIC
/begin CHARACTERISTIC c_n_max_mis_at "Maximum engine speed for misfire detection / automatic transmission" VALUE 0xa08070fe _REC_VAL_20_u2 8160. _CNV_A_R_LINEAR_____14_CM 0. 8160. DISPLAY_IDENTIFIER C_N_MAX_MIS_AT FORMAT "%4.0" /end CHARACTERISTIC
/begin CHARACTERISTIC c_n_max_mis_mt "Maximum engine speed for misfire detection / manual transmission" VALUE 0xa0807100 _REC_VAL_20_u2 8160. _CNV_A_R_LINEAR_____14_CM 0. 8160. DISPLAY_IDENTIFIER C_N_MAX_MIS_MT FORMAT "%4.0" /end CHARACTERISTIC
/begin CHARACTERISTIC c_t_dly_st_mis "Fade out duration when engine operating state start LV_ST has been exited" VALUE 0xa0807120 _REC_VAL_20_u2 655.35 _CNV_A_R_LINEAR_____3_CM 0. 655.35 DISPLAY_IDENTIFIER C_T_DLY_ST_MIS FORMAT "%6.2" /end CHARACTERISTIC
/begin CHARACTERISTIC c_t_dly_iv_off_mis "Fade out duration after injection is back on" VALUE 0xa080711e _REC_VAL_20_u2 655.35 _CNV_A_R_LINEAR_____3_CM 0. 655.35 DISPLAY_IDENTIFIER C_T_DLY_IV_OFF_MIS FORMAT "%6.2" /end CHARACTERISTIC
/begin CHARACTERISTIC c_sum_inh_iv_max_mis "Maximum number of cylinders in shut-off to fade-out" VALUE 0xa0807118 _REC_VAL_20_u1 8. _CNV_A_R_LINEAR_____0_CM 0. 8. DISPLAY_IDENTIFIER C_SUM_INH_IV_MAX_MIS FORMAT "%3.0" /end CHARACTERISTIC
/begin CHARACTERISTIC c_tco_min_mis "Minimum coolant temperature for misfire detection" VALUE 0xa080712e _REC_VAL_20_u1 190.5 _CNV_A_R_LINEAR_____17_CM -48. 142.5 DISPLAY_IDENTIFIER C_TCO_MIN_MIS FORMAT "%6.2" /end CHARACTERISTIC
/begin CHARACTERISTIC c_tco_wup_min_mis "Minimum warm up coolant temperature for misfire detection" VALUE 0xa080712f _REC_VAL_20_u1 190.5 _CNV_A_R_LINEAR_____17_CM -48. 142.5 DISPLAY_IDENTIFIER C_TCO_WUP_MIN_MIS FORMAT "%6.2" /end CHARACTERISTIC
/begin MEASUREMENT ctr_tdc_zdly_mis "TDC decounter for disabled diagnostic" UWORD _CNV_A_R_LINEAR_____408_CM 1 100. 0. 65535. DISPLAY_IDENTIFIER CTR_TDC_ZDLY_MIS ECU_ADDRESS 0xd00070e8 FORMAT "%5.0" /end MEASUREMENT
/begin MEASUREMENT state_diag_mis "Misfire detection phase state machine" UBYTE _CNV_S_5_MISF_RANGE_409_CM 1 100. 0. 4. DISPLAY_IDENTIFIER STATE_DIAG_MIS ECU_ADDRESS 0xd00076ae /end MEASUREMENT
/begin CHARACTERISTIC c_nr_tdc_zdly_mis "Standard TDC count disablement tdc number before monitoring (engine start phase)" VALUE 0xa0807113 _REC_VAL_20_u1 255. _CNV_A_R_LINEAR_____408_CM 0. 255. DISPLAY_IDENTIFIER C_NR_TDC_ZDLY_MIS FORMAT "%3.0" /end CHARACTERISTIC
/begin CHARACTERISTIC c_nr_tdc_inh_mis "Fade out duration in TDC when engine speed rise up to C_N_MIN_ZDLY_MIS" VALUE 0xa0807111 _REC_VAL_20_u1 255. _CNV_A_R_LINEAR_____408_CM 0. 255. DISPLAY_IDENTIFIER C_NR_TDC_INH_MIS FORMAT "%3.0" /end CHARACTERISTIC
/begin MEASUREMENT lv_iv_off_det_mis "Misfire detection fade out flag due to cylinder shut-off, phased with misfire detection index" UBYTE _CNV_S_2_RANGE__0___1_CM 1 100. 0. 1. DISPLAY_IDENTIFIER LV_IV_OFF_DET_MIS ECU_ADDRESS 0xd00076ea BIT_MASK 0x1 /end MEASUREMENT
/begin CHARACTERISTIC c_nr_tdc_iv_off_det_mis "TDC delay to synchronise cylinder shut-off information with the misfire detection index" VALUE 0xa0807112 _REC_VAL_20_u1 7. _CNV_A_R_LINEAR_____0_CM 0. 7. DISPLAY_IDENTIFIER C_NR_TDC_IV_OFF_DET_MIS FORMAT "%3.0" /end CHARACTERISTIC
/begin CHARACTERISTIC c_n_max_mis "Maximum engine speed for misfire detection" VALUE 0xa08070fc _REC_VAL_20_u2 8160. _CNV_A_R_LINEAR_____14_CM 0. 8160. DISPLAY_IDENTIFIER C_N_MAX_MIS FORMAT "%4.0" /end CHARACTERISTIC
/begin AXIS_PTS ldp_n_ip_load_amp_mis_afs_mt "" 0xa0806e4c n _REC_AXS_20_u2 8160. _CNV_A_R_LINEAR_____14_CM 8 0. 8160. FORMAT "%4.0" /end AXIS_PTS
/begin CHARACTERISTIC c_mis_max_nr_off_iv "Maximum number of allowed cylinder to be shut-off after detection of the misfire status CARB A." VALUE 0xa08070e3 _REC_VAL_20_u1 4. _CNV_A_R_LINEAR_____0_CM 0. 4. DISPLAY_IDENTIFIER C_MIS_MAX_NR_OFF_IV FORMAT "%3.0" /end CHARACTERISTIC
/begin MEASUREMENT fac_er_diag_mis "Reliability weighting factor for detection based on misfire detection index (ER)" UBYTE _CNV_A_R_LINEAR_____103_CM 1 100. 0. 1.9921875 DISPLAY_IDENTIFIER FAC_ER_DIAG_MIS ECU_ADDRESS 0xd0007698 FORMAT "%8.6" /end MEASUREMENT
/begin MEASUREMENT fac_igc_diag_mis "Reliability weighting factor for ignition diagnosis (ignition failure detected)" UBYTE _CNV_A_R_LINEAR_____103_CM 1 100. 0. 1.9921875 DISPLAY_IDENTIFIER FAC_IGC_DIAG_MIS ECU_ADDRESS 0xd0007699 FORMAT "%8.6" /end MEASUREMENT
/begin MEASUREMENT fac_iv_diag_mis "Reliability weighting factor for injection valve (injection valve failure detected)" UBYTE _CNV_A_R_LINEAR_____103_CM 1 100. 0. 1.9921875 DISPLAY_IDENTIFIER FAC_IV_DIAG_MIS ECU_ADDRESS 0xd000769a FORMAT "%8.6" /end MEASUREMENT
/begin MEASUREMENT lv_det_cfm_mis "Flag for individual confirmed misfire detection after crossed diagnosis" UBYTE _CNV_S_2_RANGE__0___1_CM 1 100. 0. 1. DISPLAY_IDENTIFIER LV_DET_CFM_MIS ECU_ADDRESS 0xd00076f9 BIT_MASK 0x1 /end MEASUREMENT
/begin CHARACTERISTIC c_mis_nr_off_iv_igcfb "Threshold for number of cylinders shut off due to misfire" VALUE 0xa08070e5 _REC_VAL_20_u1 8. _CNV_A_R_LINEAR_____0_CM 0. 8. DISPLAY_IDENTIFIER C_MIS_NR_OFF_IV_IGCFB FORMAT "%3.0" /end CHARACTERISTIC
/begin AXIS_PTS ldp_n_32_ip_fac_igc_diag_mis "" 0xa0806dfa n_32 _REC_AXS_20_u1 8160. _CNV_A_R_LINEAR_____10_CM 6 0. 8160. FORMAT "%4.0" /end AXIS_PTS
/begin AXIS_PTS ldp_load_mis_ip_fac_igc_diag_mis "" 0xa0806d84 load_mis _REC_AXS_20_u2 99.9969482421875 _CNV_A_R_LINEAR_____212_CM 6 0. 99.9969482421875 FORMAT "%7.3" /end AXIS_PTS
/begin AXIS_PTS ldp_n_32_ip_fac_iv_diag_mis "" 0xa0806e02 n_32 _REC_AXS_20_u1 8160. _CNV_A_R_LINEAR_____10_CM 6 0. 8160. FORMAT "%4.0" /end AXIS_PTS
/begin AXIS_PTS ldp_load_mis_ip_fac_iv_diag_mis "" 0xa0806d94 load_mis _REC_AXS_20_u2 99.9969482421875 _CNV_A_R_LINEAR_____212_CM 6 0. 99.9969482421875 FORMAT "%7.3" /end AXIS_PTS
/begin AXIS_PTS ldp_n_32_ip_fac_er_s_diag_mis "" 0xa0807276 n_32 _REC_AXS_20_u1 8160. _CNV_A_R_LINEAR_____10_CM 6 0. 8160. FORMAT "%4.0" /end AXIS_PTS
/begin MEASUREMENT lv_det_mis_a "CARB A misfire criteria detected in actual 200 rev. window (not debounced)" UBYTE _CNV_S_2_RANGE__0___1_CM 1 100. 0. 1. DISPLAY_IDENTIFIER LV_DET_MIS_A ECU_ADDRESS 0xd00076d6 BIT_MASK 0x1 /end MEASUREMENT
/begin MEASUREMENT lv_mis_state_a "CARB A misfire criterion confirmed (debounced)" UBYTE _CNV_S_2_RANGE__0___1_CM 1 100. 0. 1. DISPLAY_IDENTIFIER LV_MIS_STATE_A ECU_ADDRESS 0xd00076ff BIT_MASK 0x1 /end MEASUREMENT
/begin MEASUREMENT mis_a_fac "Catalyst damage weighting factor to increment cylinder specific counters when misfire is detected" UBYTE _CNV_A_R_LINEAR_____0_CM 1 100. 0. 255. DISPLAY_IDENTIFIER MIS_A_FAC ECU_ADDRESS 0xd00076a2 FORMAT "%3.0" /end MEASUREMENT
/begin MEASUREMENT mis_a_fac_buf[0] "Catalyst damage weighting factor buffer" UBYTE _CNV_A_R_LINEAR_____0_CM 1 100. 0. 255. DISPLAY_IDENTIFIER MIS_A_FAC_BUF[0] ECU_ADDRESS 0xd00076a4 FORMAT "%3.0" /end MEASUREMENT
/begin MEASUREMENT mis_a_fac_buf[1] "Catalyst damage weighting factor buffer" UBYTE _CNV_A_R_LINEAR_____0_CM 1 100. 0. 255. DISPLAY_IDENTIFIER MIS_A_FAC_BUF[1] ECU_ADDRESS 0xd00076a5 FORMAT "%3.0" /end MEASUREMENT
/begin MEASUREMENT mis_a_fac_buf[2] "Catalyst damage weighting factor buffer" UBYTE _CNV_A_R_LINEAR_____0_CM 1 100. 0. 255. DISPLAY_IDENTIFIER MIS_A_FAC_BUF[2] ECU_ADDRESS 0xd00076a6 FORMAT "%3.0" /end MEASUREMENT
/begin MEASUREMENT mis_a_fac_buf[3] "Catalyst damage weighting factor buffer" UBYTE _CNV_A_R_LINEAR_____0_CM 1 100. 0. 255. DISPLAY_IDENTIFIER MIS_A_FAC_BUF[3] ECU_ADDRESS 0xd00076a7 FORMAT "%3.0" /end MEASUREMENT
/begin MEASUREMENT mis_a_fac_buf[4] "Catalyst damage weighting factor buffer" UBYTE _CNV_A_R_LINEAR_____0_CM 1 100. 0. 255. DISPLAY_IDENTIFIER MIS_A_FAC_BUF[4] ECU_ADDRESS 0xd00076a8 FORMAT "%3.0" /end MEASUREMENT
/begin MEASUREMENT mis_a_fac_buf[5] "Catalyst damage weighting factor buffer" UBYTE _CNV_A_R_LINEAR_____0_CM 1 100. 0. 255. DISPLAY_IDENTIFIER MIS_A_FAC_BUF[5] ECU_ADDRESS 0xd00076a9 FORMAT "%3.0" /end MEASUREMENT
/begin MEASUREMENT inh_iv_mis "Idendification of cylinders shut off by misifre CARB A" UBYTE _CNV_A_R_LINEAR_____0_CM 1 100. 0. 255. DISPLAY_IDENTIFIER INH_IV_MIS ECU_ADDRESS 0xd00076c3 FORMAT "%3.0" /end MEASUREMENT
/begin MEASUREMENT mis_ctr_a[0] "Misfire sums (cylinder individual) after combination and weighting in CARB A window." UWORD _CNV_A_R_LINEAR_____0_CM 1 100. 0. 65535. DISPLAY_IDENTIFIER MIS_CTR_A[0] ECU_ADDRESS 0xd0007104 FORMAT "%5.0" /end MEASUREMENT
/begin MEASUREMENT mis_ctr_a[1] "Misfire sums (cylinder individual) after combination and weighting in CARB A window." UWORD _CNV_A_R_LINEAR_____0_CM 1 100. 0. 65535. DISPLAY_IDENTIFIER MIS_CTR_A[1] ECU_ADDRESS 0xd0007106 FORMAT "%5.0" /end MEASUREMENT
/begin MEASUREMENT mis_ctr_a[2] "Misfire sums (cylinder individual) after combination and weighting in CARB A window." UWORD _CNV_A_R_LINEAR_____0_CM 1 100. 0. 65535. DISPLAY_IDENTIFIER MIS_CTR_A[2] ECU_ADDRESS 0xd0007108 FORMAT "%5.0" /end MEASUREMENT
/begin MEASUREMENT mis_ctr_a[3] "Misfire sums (cylinder individual) after combination and weighting in CARB A window." UWORD _CNV_A_R_LINEAR_____0_CM 1 100. 0. 65535. DISPLAY_IDENTIFIER MIS_CTR_A[3] ECU_ADDRESS 0xd000710a FORMAT "%5.0" /end MEASUREMENT
/begin MEASUREMENT mis_ctr_a[4] "Misfire sums (cylinder individual) after combination and weighting in CARB A window." UWORD _CNV_A_R_LINEAR_____0_CM 1 100. 0. 65535. DISPLAY_IDENTIFIER MIS_CTR_A[4] ECU_ADDRESS 0xd000710c FORMAT "%5.0" /end MEASUREMENT
/begin MEASUREMENT mis_ctr_a[5] "Misfire sums (cylinder individual) after combination and weighting in CARB A window." UWORD _CNV_A_R_LINEAR_____0_CM 1 100. 0. 65535. DISPLAY_IDENTIFIER MIS_CTR_A[5] ECU_ADDRESS 0xd000710e FORMAT "%5.0" /end MEASUREMENT
/begin MEASUREMENT mis_ctr_a[6] "Misfire sums (cylinder individual) after combination and weighting in CARB A window." UWORD _CNV_A_R_LINEAR_____0_CM 1 100. 0. 65535. DISPLAY_IDENTIFIER MIS_CTR_A[6] ECU_ADDRESS 0xd0007110 FORMAT "%5.0" /end MEASUREMENT
/begin MEASUREMENT mis_ctr_a[7] "Misfire sums (cylinder individual) after combination and weighting in CARB A window." UWORD _CNV_A_R_LINEAR_____0_CM 1 100. 0. 65535. DISPLAY_IDENTIFIER MIS_CTR_A[7] ECU_ADDRESS 0xd0007112 FORMAT "%5.0" /end MEASUREMENT
/begin MEASUREMENT mis_nr_tdc_a "TDC counter CARB A window (200 crankshaft revolutions)." UWORD _CNV_A_R_LINEAR_____0_CM 1 100. 0. 65535. DISPLAY_IDENTIFIER MIS_NR_TDC_A ECU_ADDRESS 0xd0007126 FORMAT "%5.0" /end MEASUREMENT
/begin MEASUREMENT mis_sum_a "CARB A misfire weighted sum (global)" UWORD _CNV_A_R_LINEAR_____0_CM 1 100. 0. 65535. DISPLAY_IDENTIFIER MIS_SUM_A ECU_ADDRESS 0xd000712a FORMAT "%5.0" /end MEASUREMENT
/begin MEASUREMENT mis_sum_a_cbk[0] "CARB A misfire weighted sum (dedicated to cylinder bank)" UWORD _CNV_A_R_LINEAR_____0_CM 1 100. 0. 65535. DISPLAY_IDENTIFIER MIS_SUM_A_CBK[0] ECU_ADDRESS 0xd000712c FORMAT "%5.0" /end MEASUREMENT
/begin MEASUREMENT mis_sum_a_cbk[1] "CARB A misfire weighted sum (dedicated to cylinder bank)" UWORD _CNV_A_R_LINEAR_____0_CM 1 100. 0. 65535. DISPLAY_IDENTIFIER MIS_SUM_A_CBK[1] ECU_ADDRESS 0xd000712e FORMAT "%5.0" /end MEASUREMENT
/begin MEASUREMENT ctr_chk_mis_a "CARB A windows occurrence counter" UBYTE _CNV_A_R_LINEAR_____0_CM 1 100. 0. 255. DISPLAY_IDENTIFIER CTR_CHK_MIS_A ECU_ADDRESS 0xd0007694 FORMAT "%3.0" /end MEASUREMENT
/begin MEASUREMENT ctr_ftp_cdn_mis_a "TDC counter for FTP condition detection" UWORD _CNV_A_R_LINEAR_____0_CM 1 100. 0. 65535. DISPLAY_IDENTIFIER CTR_FTP_CDN_MIS_A ECU_ADDRESS 0xd00070b0 FORMAT "%5.0" /end MEASUREMENT
/begin MEASUREMENT ctr_det_mis_a "CARB A misfire criteria detected counter" UBYTE _CNV_A_R_LINEAR_____0_CM 1 100. 0. 255. DISPLAY_IDENTIFIER CTR_DET_MIS_A ECU_ADDRESS 0xd0007696 FORMAT "%3.0" /end MEASUREMENT
/begin MEASUREMENT lv_ftp_mis_a "Boolean for FTP emission cycle condition status at the end of CARB A window" UBYTE _CNV_S_2_RANGE__0___1_CM 1 100. 0. 1. DISPLAY_IDENTIFIER LV_FTP_MIS_A ECU_ADDRESS 0xd00076e2 BIT_MASK 0x1 /end MEASUREMENT
/begin MEASUREMENT sym_cyl_mis_a "CARB A misfire criteria symptoms" UWORD _CNV_A_R_LINEAR_____0_CM 1 100. 0. 65535. DISPLAY_IDENTIFIER SYM_CYL_MIS_A ECU_ADDRESS 0xd000713e FORMAT "%5.0" /end MEASUREMENT
/begin CHARACTERISTIC c_n_mis_ftp "FTP cycle engine speed threshold" VALUE 0xa0807106 _REC_VAL_20_u2 8160. _CNV_A_R_LINEAR_____14_CM 0. 8160. DISPLAY_IDENTIFIER C_N_MIS_FTP FORMAT "%4.0" /end CHARACTERISTIC
/begin CHARACTERISTIC c_load_mis_ftp "FTP cycle engine load threshold" VALUE 0xa08070d0 _REC_VAL_20_u2 99.9969482421875 _CNV_A_R_LINEAR_____212_CM 0. 99.9969482421875 DISPLAY_IDENTIFIER C_LOAD_MIS_FTP FORMAT "%7.3" /end CHARACTERISTIC
/begin CHARACTERISTIC c_mis_a_min_nr "Cylinder indentification ratio for CARB A criteria detection" VALUE 0xa08070e0 _REC_VAL_20_u1 99.609375 _CNV_A_R_LINEAR_____5_CM 0. 99.609375 DISPLAY_IDENTIFIER C_MIS_A_MIN_NR FORMAT "%9.6" /end CHARACTERISTIC
/begin CHARACTERISTIC c_nr_det_max_mis_a "Maximum value to confirm misfire CARB A status detection (typical: 3) for long term protection" VALUE 0xa080710b _REC_VAL_20_u1 255. _CNV_A_R_LINEAR_____0_CM 0. 255. DISPLAY_IDENTIFIER C_NR_DET_MAX_MIS_A FORMAT "%3.0" /end CHARACTERISTIC
/begin CHARACTERISTIC c_mis_min_nr_puc "Minimum number of trailing throttle fuel cut-off phases LV_PUC before cancelling cylinder(s) shut-off. " VALUE 0xa08070e4 _REC_VAL_20_u1 254. _CNV_A_R_LINEAR_____0_CM 1. 255. DISPLAY_IDENTIFIER C_MIS_MIN_NR_PUC FORMAT "%3.0" /end CHARACTERISTIC
/begin CHARACTERISTIC lc_conf_inh_iv_mis "Cylinder switch back on configuration mode" VALUE 0xa0807138 _REC_VAL_20_u1 1. _CNV_S_2_RANGE__0___1_CM 0. 1. DISPLAY_IDENTIFIER LC_CONF_INH_IV_MIS BIT_MASK 0x1 /end CHARACTERISTIC
/begin CHARACTERISTIC lc_conf_rnd_det_mis_a "Configuration for random cylinder detection " VALUE 0xa080713d _REC_VAL_20_u1 1. _CNV_S_2_RANGE__0___1_CM 0. 1. DISPLAY_IDENTIFIER LC_CONF_RND_DET_MIS_A BIT_MASK 0x1 /end CHARACTERISTIC
/begin CHARACTERISTIC lc_conf_mpl_det_mis_a "Configuration for multiple cylinder status set in SYM_CYL_MIS_A (multiple misfire pattern Pcode saved) (=1)" VALUE 0xa080713b _REC_VAL_20_u1 1. _CNV_S_2_RANGE__0___1_CM 0. 1. DISPLAY_IDENTIFIER LC_CONF_MPL_DET_MIS_A BIT_MASK 0x1 /end CHARACTERISTIC
/begin MEASUREMENT lv_mis_state_b1 "CARB B1 misfire criterion confirmed" UBYTE _CNV_S_2_RANGE__0___1_CM 1 100. 0. 1. DISPLAY_IDENTIFIER LV_MIS_STATE_B1 ECU_ADDRESS 0xd0007700 BIT_MASK 0x1 /end MEASUREMENT
/begin MEASUREMENT lv_mis_state_b4 "CARB B4 misfire criterion confirmed (debounced)" UBYTE _CNV_S_2_RANGE__0___1_CM 1 100. 0. 1. DISPLAY_IDENTIFIER LV_MIS_STATE_B4 ECU_ADDRESS 0xd0007701 BIT_MASK 0x1 /end MEASUREMENT
/begin MEASUREMENT lv_det_mis_b4 "CARB B4 misfire criteria detected in actual 1000 rev. window, (not debounced)" UBYTE _CNV_S_2_RANGE__0___1_CM 1 100. 0. 1. DISPLAY_IDENTIFIER LV_DET_MIS_B4 ECU_ADDRESS 0xd00076d7 BIT_MASK 0x1 /end MEASUREMENT
/begin MEASUREMENT mis_nr_tdc_b "TDC counter CARB B window (1000 crankshaft revolutions)." UWORD _CNV_A_R_LINEAR_____0_CM 1 100. 0. 65535. DISPLAY_IDENTIFIER MIS_NR_TDC_B ECU_ADDRESS 0xd0007128 FORMAT "%5.0" /end MEASUREMENT
/begin MEASUREMENT mis_sum_b "CARB B misfire sum (global)" UWORD _CNV_A_R_LINEAR_____0_CM 1 100. 0. 65535. DISPLAY_IDENTIFIER MIS_SUM_B ECU_ADDRESS 0xd00035ac FORMAT "%5.0" /end MEASUREMENT
/begin MEASUREMENT mis_sum_b_cbk[0] "CARB B misfire sum (cylinder bank dedicated)" UWORD _CNV_A_R_LINEAR_____0_CM 1 100. 0. 65535. DISPLAY_IDENTIFIER MIS_SUM_B_CBK[0] ECU_ADDRESS 0xd0007130 FORMAT "%5.0" /end MEASUREMENT
/begin MEASUREMENT mis_sum_b_cbk[1] "CARB B misfire sum (cylinder bank dedicated)" UWORD _CNV_A_R_LINEAR_____0_CM 1 100. 0. 65535. DISPLAY_IDENTIFIER MIS_SUM_B_CBK[1] ECU_ADDRESS 0xd0007132 FORMAT "%5.0" /end MEASUREMENT
/begin MEASUREMENT ctr_chk_mis_b4 "CARB B4 diagnosis occurence counter" UBYTE _CNV_A_R_LINEAR_____0_CM 1 100. 0. 255. DISPLAY_IDENTIFIER CTR_CHK_MIS_B4 ECU_ADDRESS 0xd0007695 FORMAT "%3.0" /end MEASUREMENT
/begin MEASUREMENT ctr_det_mis_b4 "CARB B4 misfire criterion detected counter" UBYTE _CNV_A_R_LINEAR_____0_CM 1 100. 0. 255. DISPLAY_IDENTIFIER CTR_DET_MIS_B4 ECU_ADDRESS 0xd0007697 FORMAT "%3.0" /end MEASUREMENT
/begin MEASUREMENT lv_end_mis_b1 "CARB B1 misfire criterion determination end" UBYTE _CNV_S_2_RANGE__0___1_CM 1 100. 0. 1. DISPLAY_IDENTIFIER LV_END_MIS_B1 ECU_ADDRESS 0xd00076db BIT_MASK 0x1 /end MEASUREMENT
/begin MEASUREMENT lv_end_mis_a "CARB A misfire criterion determination end" UBYTE _CNV_S_2_RANGE__0___1_CM 1 100. 0. 1. DISPLAY_IDENTIFIER LV_END_MIS_A ECU_ADDRESS 0xd00076da BIT_MASK 0x1 /end MEASUREMENT
/begin MEASUREMENT lv_end_mis_b4 "CARB B4 misfire criterion determination end" UBYTE _CNV_S_2_RANGE__0___1_CM 1 100. 0. 1. DISPLAY_IDENTIFIER LV_END_MIS_B4 ECU_ADDRESS 0xd00076dc BIT_MASK 0x1 /end MEASUREMENT
/begin MEASUREMENT lv_end_win_mis_b1 "End of CARB B1 window for similar condition" UBYTE _CNV_S_2_RANGE__0___1_CM 1 100. 0. 1. DISPLAY_IDENTIFIER LV_END_WIN_MIS_B1 ECU_ADDRESS 0xd00076fb BIT_MASK 0x1 /end MEASUREMENT
/begin MEASUREMENT lv_end_win_mis_b4 "End of CARB B4 window for similar condition" UBYTE _CNV_S_2_RANGE__0___1_CM 1 100. 0. 1. DISPLAY_IDENTIFIER LV_END_WIN_MIS_B4 ECU_ADDRESS 0xd00076fc BIT_MASK 0x1 /end MEASUREMENT
/begin MEASUREMENT sym_cyl_mis_b1 "CARB B1 misfire criterion symptoms" UWORD _CNV_A_R_LINEAR_____0_CM 1 100. 0. 65535. DISPLAY_IDENTIFIER SYM_CYL_MIS_B1 ECU_ADDRESS 0xd0007140 FORMAT "%5.0" /end MEASUREMENT
/begin MEASUREMENT sym_cyl_mis_b4 "CARB B4 misfire criteria symptoms" UWORD _CNV_A_R_LINEAR_____0_CM 1 100. 0. 65535. DISPLAY_IDENTIFIER SYM_CYL_MIS_B4 ECU_ADDRESS 0xd0007142 FORMAT "%5.0" /end MEASUREMENT
/begin CHARACTERISTIC c_mis_sum_b1_thd_mt "Global threshold for CARB B1 misfire criteria detection, LV_AT = 0" VALUE 0xa08070f2 _REC_VAL_20_u2 65535. _CNV_A_R_LINEAR_____0_CM 0. 65535. DISPLAY_IDENTIFIER C_MIS_SUM_B1_THD_MT FORMAT "%5.0" /end CHARACTERISTIC
/begin CHARACTERISTIC c_mis_sum_b1_thd_at "Global threshold for  CARB B1 misfire criteria detection, LV_AT = 1" VALUE 0xa08070f0 _REC_VAL_20_u2 65535. _CNV_A_R_LINEAR_____0_CM 0. 65535. DISPLAY_IDENTIFIER C_MIS_SUM_B1_THD_AT FORMAT "%5.0" /end CHARACTERISTIC
/begin CHARACTERISTIC c_mis_sum_b4_thd_mt "Global threshold for CARB B4 misfire criteria detection, LV_AT = 0" VALUE 0xa08070f8 _REC_VAL_20_u2 65535. _CNV_A_R_LINEAR_____0_CM 0. 65535. DISPLAY_IDENTIFIER C_MIS_SUM_B4_THD_MT FORMAT "%5.0" /end CHARACTERISTIC
/begin CHARACTERISTIC c_mis_sum_b4_thd_at "Global threshold for CARB B4 misfire criterion detection, LV_AT = 1" VALUE 0xa08070f6 _REC_VAL_20_u2 65535. _CNV_A_R_LINEAR_____0_CM 0. 65535. DISPLAY_IDENTIFIER C_MIS_SUM_B4_THD_AT FORMAT "%5.0" /end CHARACTERISTIC
/begin CHARACTERISTIC c_mis_b1_min_nr "Cylinder indentification ratio for CARB B1 criteria detection" VALUE 0xa08070e1 _REC_VAL_20_u1 99.609375 _CNV_A_R_LINEAR_____5_CM 0. 99.609375 DISPLAY_IDENTIFIER C_MIS_B1_MIN_NR FORMAT "%9.6" /end CHARACTERISTIC
/begin CHARACTERISTIC c_mis_b4_min_nr "Cylinder indentification ratio for CARB B4 criteria detection" VALUE 0xa08070e2 _REC_VAL_20_u1 99.609375 _CNV_A_R_LINEAR_____5_CM 0. 99.609375 DISPLAY_IDENTIFIER C_MIS_B4_MIN_NR FORMAT "%9.6" /end CHARACTERISTIC
/begin CHARACTERISTIC c_mis_sum_b1_cbk_thd "Cylinder bank threshold for CARB B1 misfire criterion detection" VALUE 0xa08070ee _REC_VAL_20_u2 65535. _CNV_A_R_LINEAR_____0_CM 0. 65535. DISPLAY_IDENTIFIER C_MIS_SUM_B1_CBK_THD FORMAT "%5.0" /end CHARACTERISTIC
/begin CHARACTERISTIC c_mis_sum_b4_cbk_thd "Cylinder bank threshold for CARB B4 misfire criteria detection" VALUE 0xa08070f4 _REC_VAL_20_u2 65535. _CNV_A_R_LINEAR_____0_CM 0. 65535. DISPLAY_IDENTIFIER C_MIS_SUM_B4_CBK_THD FORMAT "%5.0" /end CHARACTERISTIC
/begin CHARACTERISTIC c_nr_cyl_mpl_mis_b "Number of cylinder in MIS_Bx to set the multiple misfire CARB Bx status (typical: 2)" VALUE 0xa080710a _REC_VAL_20_u1 255. _CNV_A_R_LINEAR_____0_CM 0. 255. DISPLAY_IDENTIFIER C_NR_CYL_MPL_MIS_B FORMAT "%3.0" /end CHARACTERISTIC
/begin CHARACTERISTIC c_nr_det_max_mis_b4 "Maximum value of CTR_ERR_DET_MIS_B4 for misfire CARB B4 status detection (typical: 4)" VALUE 0xa080710c _REC_VAL_20_u1 255. _CNV_A_R_LINEAR_____0_CM 0. 255. DISPLAY_IDENTIFIER C_NR_DET_MAX_MIS_B4 FORMAT "%3.0" /end CHARACTERISTIC
/begin CHARACTERISTIC lc_conf_rnd_det_mis_b "Configuration for random cylinder detection " VALUE 0xa080713e _REC_VAL_20_u1 1. _CNV_S_2_RANGE__0___1_CM 0. 1. DISPLAY_IDENTIFIER LC_CONF_RND_DET_MIS_B BIT_MASK 0x1 /end CHARACTERISTIC
/begin MEASUREMENT lv_inh_iv_mis_a "At least one cylinder is shut-off by a CARB A misfire criterion confirmed" UBYTE _CNV_S_2_RANGE__0___1_CM 1 100. 0. 1. DISPLAY_IDENTIFIER LV_INH_IV_MIS_A ECU_ADDRESS 0xd00076fe BIT_MASK 0x1 /end MEASUREMENT
/begin AXIS_PTS ldp_n_32_ip_fac_er_afs_diag_mis "" 0xa0806df2 n_32 _REC_AXS_20_u1 8160. _CNV_A_R_LINEAR_____10_CM 6 0. 8160. FORMAT "%4.0" /end AXIS_PTS
/begin AXIS_PTS ldp_n__mis_a_fac_hom_s "" 0xa08073a0 n _REC_AXS_20_u2 8160. _CNV_A_R_LINEAR_____14_CM 6 0. 8160. FORMAT "%4.0" /end AXIS_PTS
/begin AXIS_PTS ldp_n__mis_a_fac_afs "" 0xa0806e28 n _REC_AXS_20_u2 8160. _CNV_A_R_LINEAR_____14_CM 6 0. 8160. FORMAT "%4.0" /end AXIS_PTS
/begin AXIS_PTS ldp_n__mis_a_fac_s "" 0xa08072a8 n _REC_AXS_20_u2 8160. _CNV_A_R_LINEAR_____14_CM 6 0. 8160. FORMAT "%4.0" /end AXIS_PTS
/begin MEASUREMENT lv_end_win_mis_a "End of CARB A window for similar condition" UBYTE _CNV_S_2_RANGE__0___1_CM 1 100. 0. 1. DISPLAY_IDENTIFIER LV_END_WIN_MIS_A ECU_ADDRESS 0xd00076fa BIT_MASK 0x1 /end MEASUREMENT
/begin MEASUREMENT lv_mis_state_b "CARB B (B1 or B4) misfire criterion confirmed (debounced )" UBYTE _CNV_S_2_RANGE__0___1_CM 1 100. 0. 1. DISPLAY_IDENTIFIER LV_MIS_STATE_B ECU_ADDRESS 0xd00076ed BIT_MASK 0x1 /end MEASUREMENT
/begin AXIS_PTS ldp_n_32_ip_fac_er_hom_s_mis "" 0xa0807376 n_32 _REC_AXS_20_u1 8160. _CNV_A_R_LINEAR_____10_CM 6 0. 8160. FORMAT "%4.0" /end AXIS_PTS
/begin CHARACTERISTIC ip_fac_igc_diag_mis "Weighting factor for ignition diagnosis (ignition failure detected)" MAP 0xa0806fb8 _REC_MAP_20_u1_u1_u2 1.9921875 _CNV_A_R_LINEAR_____103_CM 0. 1.9921875 DISPLAY_IDENTIFIER IP_FAC_IGC_DIAG_MIS FORMAT "%8.6"
 /begin AXIS_DESCR COM_AXIS n_32 _CNV_A_R_LINEAR_____10_CM 6 0. 8160. FORMAT "%4.0" AXIS_PTS_REF ldp_n_32_ip_fac_igc_diag_mis /end AXIS_DESCR
 /begin AXIS_DESCR COM_AXIS load_mis _CNV_A_R_LINEAR_____212_CM 6 0. 99.9969482421875 FORMAT "%7.3" AXIS_PTS_REF ldp_load_mis_ip_fac_igc_diag_mis /end AXIS_DESCR
/end CHARACTERISTIC
/begin CHARACTERISTIC ip_fac_iv_diag_mis "Weighting factor for injection valve diagnosis (injection valve failure detected)" MAP 0xa0806fdc _REC_MAP_20_u1_u1_u2 1.9921875 _CNV_A_R_LINEAR_____103_CM 0. 1.9921875 DISPLAY_IDENTIFIER IP_FAC_IV_DIAG_MIS FORMAT "%8.6"
 /begin AXIS_DESCR COM_AXIS n_32 _CNV_A_R_LINEAR_____10_CM 6 0. 8160. FORMAT "%4.0" AXIS_PTS_REF ldp_n_32_ip_fac_iv_diag_mis /end AXIS_DESCR
 /begin AXIS_DESCR COM_AXIS load_mis _CNV_A_R_LINEAR_____212_CM 6 0. 99.9969482421875 FORMAT "%7.3" AXIS_PTS_REF ldp_load_mis_ip_fac_iv_diag_mis /end AXIS_DESCR
/end CHARACTERISTIC
/begin CHARACTERISTIC lc_conf_mpl_det_mis_b "Configuration for multiple cylinder status set in SYM_CYL_MIS_Bx (multiple misfire pattern Pcode saved) (=1)" VALUE 0xa080713c _REC_VAL_20_u1 1. _CNV_S_2_RANGE__0___1_CM 0. 1. DISPLAY_IDENTIFIER LC_CONF_MPL_DET_MIS_B BIT_MASK 0x1 /end CHARACTERISTIC
/begin CHARACTERISTIC lc_conf_mis_state_b "Configuration for LV_MIS_STATE_B setting" VALUE 0xa080713a _REC_VAL_20_u1 1. _CNV_S_2_RANGE__0___1_CM 0. 1. DISPLAY_IDENTIFIER LC_CONF_MIS_STATE_B BIT_MASK 0x1 /end CHARACTERISTIC
/begin MEASUREMENT sum_fac_diag_mis "Sum of the weighting factor from diagnosis combinations for final misfire decision" UWORD _CNV_A_R_MISF_LINEA_416_CM 1 100. 0. 5.976 DISPLAY_IDENTIFIER SUM_FAC_DIAG_MIS ECU_ADDRESS 0xd000713c FORMAT "%6.4" /end MEASUREMENT
/begin CHARACTERISTIC c_t_mis_min_puc "Minimum duration of trailing throttle fuel cut-off phase to be validated like this." VALUE 0xa0807126 _REC_VAL_20_u2 99.90000000000001 _CNV_A_R_MISF_LINEA_417_CM 0.1 100. DISPLAY_IDENTIFIER C_T_MIS_MIN_PUC FORMAT "%5.1" /end CHARACTERISTIC
/begin AXIS_PTS ldp_load_ip_fac_er_hom_s_mis "" 0xa0807358 load_mis _REC_AXS_20_u2 99.9969482421875 _CNV_A_R_LINEAR_____212_CM 6 0. 99.9969482421875 FORMAT "%7.3" /end AXIS_PTS
/begin AXIS_PTS ldp_load_ip_fac_er_s_diag_mis "" 0xa080723c load_mis _REC_AXS_20_u2 99.9969482421875 _CNV_A_R_LINEAR_____212_CM 6 0. 99.9969482421875 FORMAT "%7.3" /end AXIS_PTS
/begin AXIS_PTS ldp_load_ip_fac_er_afs_diag_mis "" 0xa0806d50 load_mis _REC_AXS_20_u2 99.9969482421875 _CNV_A_R_LINEAR_____212_CM 6 0. 99.9969482421875 FORMAT "%7.3" /end AXIS_PTS
/begin MEASUREMENT mis_ctr_b[0] "Misfire sums (cylinder individual) after combination in CARB B window" UWORD _CNV_A_R_LINEAR_____0_CM 1 100. 0. 65535. DISPLAY_IDENTIFIER MIS_CTR_B[0] ECU_ADDRESS 0xd0007114 FORMAT "%5.0" /end MEASUREMENT
/begin MEASUREMENT mis_ctr_b[1] "Misfire sums (cylinder individual) after combination in CARB B window" UWORD _CNV_A_R_LINEAR_____0_CM 1 100. 0. 65535. DISPLAY_IDENTIFIER MIS_CTR_B[1] ECU_ADDRESS 0xd0007116 FORMAT "%5.0" /end MEASUREMENT
/begin MEASUREMENT mis_ctr_b[2] "Misfire sums (cylinder individual) after combination in CARB B window" UWORD _CNV_A_R_LINEAR_____0_CM 1 100. 0. 65535. DISPLAY_IDENTIFIER MIS_CTR_B[2] ECU_ADDRESS 0xd0007118 FORMAT "%5.0" /end MEASUREMENT
/begin MEASUREMENT mis_ctr_b[3] "Misfire sums (cylinder individual) after combination in CARB B window" UWORD _CNV_A_R_LINEAR_____0_CM 1 100. 0. 65535. DISPLAY_IDENTIFIER MIS_CTR_B[3] ECU_ADDRESS 0xd000711a FORMAT "%5.0" /end MEASUREMENT
/begin MEASUREMENT mis_ctr_b[4] "Misfire sums (cylinder individual) after combination in CARB B window" UWORD _CNV_A_R_LINEAR_____0_CM 1 100. 0. 65535. DISPLAY_IDENTIFIER MIS_CTR_B[4] ECU_ADDRESS 0xd000711c FORMAT "%5.0" /end MEASUREMENT
/begin MEASUREMENT mis_ctr_b[5] "Misfire sums (cylinder individual) after combination in CARB B window" UWORD _CNV_A_R_LINEAR_____0_CM 1 100. 0. 65535. DISPLAY_IDENTIFIER MIS_CTR_B[5] ECU_ADDRESS 0xd000711e FORMAT "%5.0" /end MEASUREMENT
/begin MEASUREMENT mis_ctr_b[6] "Misfire sums (cylinder individual) after combination in CARB B window" UWORD _CNV_A_R_LINEAR_____0_CM 1 100. 0. 65535. DISPLAY_IDENTIFIER MIS_CTR_B[6] ECU_ADDRESS 0xd0007120 FORMAT "%5.0" /end MEASUREMENT
/begin MEASUREMENT mis_ctr_b[7] "Misfire sums (cylinder individual) after combination in CARB B window" UWORD _CNV_A_R_LINEAR_____0_CM 1 100. 0. 65535. DISPLAY_IDENTIFIER MIS_CTR_B[7] ECU_ADDRESS 0xd0007122 FORMAT "%5.0" /end MEASUREMENT
/begin MEASUREMENT ctr_mis_a_lih_cyl[0] "Cylinder dedicated counters for CARB A Limp-home phases on current DC" UBYTE _CNV_A_R_LINEAR_____0_CM 1 100. 0. 255. DISPLAY_IDENTIFIER CTR_MIS_A_LIH_CYL[0] ECU_ADDRESS 0xd00070b4 FORMAT "%3.0" /end MEASUREMENT
/begin MEASUREMENT ctr_mis_a_lih_cyl[1] "Cylinder dedicated counters for CARB A Limp-home phases on current DC" UBYTE _CNV_A_R_LINEAR_____0_CM 1 100. 0. 255. DISPLAY_IDENTIFIER CTR_MIS_A_LIH_CYL[1] ECU_ADDRESS 0xd00070b5 FORMAT "%3.0" /end MEASUREMENT
/begin MEASUREMENT ctr_mis_a_lih_cyl[2] "Cylinder dedicated counters for CARB A Limp-home phases on current DC" UBYTE _CNV_A_R_LINEAR_____0_CM 1 100. 0. 255. DISPLAY_IDENTIFIER CTR_MIS_A_LIH_CYL[2] ECU_ADDRESS 0xd00070b6 FORMAT "%3.0" /end MEASUREMENT
/begin MEASUREMENT ctr_mis_a_lih_cyl[3] "Cylinder dedicated counters for CARB A Limp-home phases on current DC" UBYTE _CNV_A_R_LINEAR_____0_CM 1 100. 0. 255. DISPLAY_IDENTIFIER CTR_MIS_A_LIH_CYL[3] ECU_ADDRESS 0xd00070b7 FORMAT "%3.0" /end MEASUREMENT
/begin MEASUREMENT ctr_mis_a_lih_cyl[4] "Cylinder dedicated counters for CARB A Limp-home phases on current DC" UBYTE _CNV_A_R_LINEAR_____0_CM 1 100. 0. 255. DISPLAY_IDENTIFIER CTR_MIS_A_LIH_CYL[4] ECU_ADDRESS 0xd00070b8 FORMAT "%3.0" /end MEASUREMENT
/begin MEASUREMENT ctr_mis_a_lih_cyl[5] "Cylinder dedicated counters for CARB A Limp-home phases on current DC" UBYTE _CNV_A_R_LINEAR_____0_CM 1 100. 0. 255. DISPLAY_IDENTIFIER CTR_MIS_A_LIH_CYL[5] ECU_ADDRESS 0xd00070b9 FORMAT "%3.0" /end MEASUREMENT
/begin MEASUREMENT ctr_mis_a_lih_cyl[6] "Cylinder dedicated counters for CARB A Limp-home phases on current DC" UBYTE _CNV_A_R_LINEAR_____0_CM 1 100. 0. 255. DISPLAY_IDENTIFIER CTR_MIS_A_LIH_CYL[6] ECU_ADDRESS 0xd00070ba FORMAT "%3.0" /end MEASUREMENT
/begin MEASUREMENT ctr_mis_a_lih_cyl[7] "Cylinder dedicated counters for CARB A Limp-home phases on current DC" UBYTE _CNV_A_R_LINEAR_____0_CM 1 100. 0. 255. DISPLAY_IDENTIFIER CTR_MIS_A_LIH_CYL[7] ECU_ADDRESS 0xd00070bb FORMAT "%3.0" /end MEASUREMENT
/begin CHARACTERISTIC c_mis_a_ind_thd_mt "Cylinder individual threshold used for cylinder shut-off during CARB A criterion window with MT" VALUE 0xa08070de _REC_VAL_20_u2 65535. _CNV_A_R_LINEAR_____0_CM 0. 65535. DISPLAY_IDENTIFIER C_MIS_A_IND_THD_MT FORMAT "%5.0" /end CHARACTERISTIC
/begin CHARACTERISTIC c_mis_a_ind_thd_at "Cylinder individual threshold used for cylinder shut-off during CARB A criterion window with AT" VALUE 0xa08070dc _REC_VAL_20_u2 65535. _CNV_A_R_LINEAR_____0_CM 0. 65535. DISPLAY_IDENTIFIER C_MIS_A_IND_THD_AT FORMAT "%5.0" /end CHARACTERISTIC
/begin CHARACTERISTIC c_mis_sum_a_thd_mt "Cylinder global threshold for misfire status CARB A detection with MT" VALUE 0xa08070ec _REC_VAL_20_u2 65535. _CNV_A_R_LINEAR_____0_CM 0. 65535. DISPLAY_IDENTIFIER C_MIS_SUM_A_THD_MT FORMAT "%5.0" /end CHARACTERISTIC
/begin CHARACTERISTIC c_mis_sum_a_thd_at "Cylinder global threshold for misfire status CARB A detection with AT" VALUE 0xa08070ea _REC_VAL_20_u2 65535. _CNV_A_R_LINEAR_____0_CM 0. 65535. DISPLAY_IDENTIFIER C_MIS_SUM_A_THD_AT FORMAT "%5.0" /end CHARACTERISTIC
/begin CHARACTERISTIC c_mis_sum_a_cbk_thd_mt "Cylinder bank threshold for misfire status CARB A detection with MT" VALUE 0xa08070e8 _REC_VAL_20_u2 65535. _CNV_A_R_LINEAR_____0_CM 0. 65535. DISPLAY_IDENTIFIER C_MIS_SUM_A_CBK_THD_MT FORMAT "%5.0" /end CHARACTERISTIC
/begin CHARACTERISTIC c_mis_sum_a_cbk_thd_at "Cylinder bank threshold for misfire status CARB A detection with AT" VALUE 0xa08070e6 _REC_VAL_20_u2 65535. _CNV_A_R_LINEAR_____0_CM 0. 65535. DISPLAY_IDENTIFIER C_MIS_SUM_A_CBK_THD_AT FORMAT "%5.0" /end CHARACTERISTIC
/begin CHARACTERISTIC c_nr_cyl_mpl_mis_a "Number of cylinder in MIS_A to set the multiple misfire CARB A status (typical: 2)" VALUE 0xa0807109 _REC_VAL_20_u1 255. _CNV_A_R_LINEAR_____0_CM 0. 255. DISPLAY_IDENTIFIER C_NR_CYL_MPL_MIS_A FORMAT "%3.0" /end CHARACTERISTIC
/begin CHARACTERISTIC c_nr_max_mis_a_lih_cyl "Maximum number of MIS_A cylinder limp-home cycle to disable fuel reactivation during current DC" VALUE 0xa080710d _REC_VAL_20_u1 255. _CNV_A_R_LINEAR_____0_CM 0. 255. DISPLAY_IDENTIFIER C_NR_MAX_MIS_A_LIH_CYL FORMAT "%3.0" /end CHARACTERISTIC
/begin CHARACTERISTIC lc_conf_mis_a_lih "Configuration to select MIL mode" VALUE 0xa0807139 _REC_VAL_20_u1 1. _CNV_S_2_RANGE__0___1_CM 0. 1. DISPLAY_IDENTIFIER LC_CONF_MIS_A_LIH BIT_MASK 0x1 /end CHARACTERISTIC
/begin CHARACTERISTIC lc_ena_mis_a_ind_lih "Enable the misfire cylinder limp home process during the CARB A window (short term catalyst protection) (1 = active)" VALUE 0xa0807141 _REC_VAL_20_u1 1. _CNV_S_2_RANGE__0___1_CM 0. 1. DISPLAY_IDENTIFIER LC_ENA_MIS_A_IND_LIH BIT_MASK 0x1 /end CHARACTERISTIC
/begin CHARACTERISTIC lc_ena_mis_a_lih "Enable the misfire cylinder limp home process at the end of the CARB A window (long term catalyst protection) (1 = active)" VALUE 0xa0807142 _REC_VAL_20_u1 1. _CNV_S_2_RANGE__0___1_CM 0. 1. DISPLAY_IDENTIFIER LC_ENA_MIS_A_LIH BIT_MASK 0x1 /end CHARACTERISTIC
/begin AXIS_PTS ldpm_n_32_1_misf "" 0xa0806edc n_32 _REC_AXS_20_u1 8160. _CNV_A_R_LINEAR_____10_CM 8 0. 8160. FORMAT "%4.0" /end AXIS_PTS
/begin CHARACTERISTIC id_nr_det_ena_mis_a_lih_mt "Number of CARB A detections to enable MIS_A cylinder switch-off limp-home for MT" CURVE 0xa0806efc _REC_CUR_20_u1_u1 255. _CNV_A_R_LINEAR_____0_CM 0. 255. DISPLAY_IDENTIFIER ID_NR_DET_ENA_MIS_A_LIH_MT FORMAT "%3.0"
 /begin AXIS_DESCR COM_AXIS n_32 _CNV_A_R_LINEAR_____10_CM 8 0. 8160. FORMAT "%4.0" AXIS_PTS_REF ldpm_n_32_1_misf /end AXIS_DESCR
/end CHARACTERISTIC
/begin CHARACTERISTIC id_nr_det_ena_mis_a_lih_at "Number of CARB A detections to enable MIS_A cylinder switch-off limp-home for AT" CURVE 0xa0806ef4 _REC_CUR_20_u1_u1 255. _CNV_A_R_LINEAR_____0_CM 0. 255. DISPLAY_IDENTIFIER ID_NR_DET_ENA_MIS_A_LIH_AT FORMAT "%3.0"
 /begin AXIS_DESCR COM_AXIS n_32 _CNV_A_R_LINEAR_____10_CM 8 0. 8160. FORMAT "%4.0" AXIS_PTS_REF ldpm_n_32_1_misf /end AXIS_DESCR
/end CHARACTERISTIC
/begin CHARACTERISTIC c_ratio_ftp_cdn_mis_at "Covering ratio to detect FTP conditions for long term protection with AT vehicle" VALUE 0xa0807116 _REC_VAL_20_u1 99.609375 _CNV_A_R_LINEAR_____5_CM 0. 99.609375 DISPLAY_IDENTIFIER C_RATIO_FTP_CDN_MIS_AT FORMAT "%9.6" /end CHARACTERISTIC
/begin CHARACTERISTIC c_ratio_ftp_cdn_mis_mt "Covering ratio to detect FTP conditions for long term protection with MT vehicle" VALUE 0xa0807117 _REC_VAL_20_u1 99.609375 _CNV_A_R_LINEAR_____5_CM 0. 99.609375 DISPLAY_IDENTIFIER C_RATIO_FTP_CDN_MIS_MT FORMAT "%9.6" /end CHARACTERISTIC
/begin CHARACTERISTIC c_ratio_ftp_cdn_ind_mis_at "Covering ratio to detect FTP conditions for short term protection with AT vehicle" VALUE 0xa0807114 _REC_VAL_20_u1 99.609375 _CNV_A_R_LINEAR_____5_CM 0. 99.609375 DISPLAY_IDENTIFIER C_RATIO_FTP_CDN_IND_MIS_AT FORMAT "%9.6" /end CHARACTERISTIC
/begin CHARACTERISTIC c_ratio_ftp_cdn_ind_mis_mt "Covering ratio to detect FTP conditions for short term protection with MT vehicle" VALUE 0xa0807115 _REC_VAL_20_u1 99.609375 _CNV_A_R_LINEAR_____5_CM 0. 99.609375 DISPLAY_IDENTIFIER C_RATIO_FTP_CDN_IND_MIS_MT FORMAT "%9.6" /end CHARACTERISTIC
/begin AXIS_PTS ldp_load_mis__mis_a_fac_hom_s "" 0xa0807368 load_mis _REC_AXS_20_u2 99.9969482421875 _CNV_A_R_LINEAR_____212_CM 6 0. 99.9969482421875 FORMAT "%7.3" /end AXIS_PTS
/begin AXIS_PTS ldp_load_mis__mis_a_fac_s "" 0xa080724c load_mis _REC_AXS_20_u2 99.9969482421875 _CNV_A_R_LINEAR_____212_CM 6 0. 99.9969482421875 FORMAT "%7.3" /end AXIS_PTS
/begin AXIS_PTS ldp_load_mis__mis_a_fac_afs "" 0xa0806d60 load_mis _REC_AXS_20_u2 99.9969482421875 _CNV_A_R_LINEAR_____212_CM 6 0. 99.9969482421875 FORMAT "%7.3" /end AXIS_PTS
/begin CHARACTERISTIC ip_mis_a_fac_s "Catalyst damage weighting factor used for MIS_A counters increment (Stratified combustion mode)" MAP 0xa0807310 _REC_MAP_20_u1_u2_u2 100. _CNV_A_R_LINEAR_____0_CM 0. 100. DISPLAY_IDENTIFIER IP_MIS_A_FAC_S FORMAT "%3.0"
 /begin AXIS_DESCR COM_AXIS n _CNV_A_R_LINEAR_____14_CM 6 0. 8160. FORMAT "%4.0" AXIS_PTS_REF ldp_n__mis_a_fac_s /end AXIS_DESCR
 /begin AXIS_DESCR COM_AXIS load_mis _CNV_A_R_LINEAR_____212_CM 6 0. 99.9969482421875 FORMAT "%7.3" AXIS_PTS_REF ldp_load_mis__mis_a_fac_s /end AXIS_DESCR
/end CHARACTERISTIC
/begin CHARACTERISTIC ip_fac_er_afs_diag_mis "Weighting factor for irregular engine operation (engine speed analysis) in AFS combustion mode" MAP 0xa0806f94 _REC_MAP_20_u1_u1_u2 1.9921875 _CNV_A_R_LINEAR_____103_CM 0. 1.9921875 DISPLAY_IDENTIFIER IP_FAC_ER_AFS_DIAG_MIS FORMAT "%8.6"
 /begin AXIS_DESCR COM_AXIS n_32 _CNV_A_R_LINEAR_____10_CM 6 0. 8160. FORMAT "%4.0" AXIS_PTS_REF ldp_n_32_ip_fac_er_afs_diag_mis /end AXIS_DESCR
 /begin AXIS_DESCR COM_AXIS load_mis _CNV_A_R_LINEAR_____212_CM 6 0. 99.9969482421875 FORMAT "%7.3" AXIS_PTS_REF ldp_load_ip_fac_er_afs_diag_mis /end AXIS_DESCR
/end CHARACTERISTIC
/begin CHARACTERISTIC ip_fac_er_hom_s_diag_mis "Weighting factor for irregular engine operation (engine speed analysis) in AFL combustion mode" MAP 0xa08073c0 _REC_MAP_20_u1_u1_u2 1.9921875 _CNV_A_R_LINEAR_____103_CM 0. 1.9921875 DISPLAY_IDENTIFIER IP_FAC_ER_HOM_S_DIAG_MIS FORMAT "%8.6"
 /begin AXIS_DESCR COM_AXIS n_32 _CNV_A_R_LINEAR_____10_CM 6 0. 8160. FORMAT "%4.0" AXIS_PTS_REF ldp_n_32_ip_fac_er_hom_s_mis /end AXIS_DESCR
 /begin AXIS_DESCR COM_AXIS load_mis _CNV_A_R_LINEAR_____212_CM 6 0. 99.9969482421875 FORMAT "%7.3" AXIS_PTS_REF ldp_load_ip_fac_er_hom_s_mis /end AXIS_DESCR
/end CHARACTERISTIC
/begin CHARACTERISTIC ip_fac_er_s_diag_mis "Weighting factor for irregular engine operation (engine speed analysis) in S combustion mode" MAP 0xa08072c8 _REC_MAP_20_u1_u1_u2 1.9921875 _CNV_A_R_LINEAR_____103_CM 0. 1.9921875 DISPLAY_IDENTIFIER IP_FAC_ER_S_DIAG_MIS FORMAT "%8.6"
 /begin AXIS_DESCR COM_AXIS n_32 _CNV_A_R_LINEAR_____10_CM 6 0. 8160. FORMAT "%4.0" AXIS_PTS_REF ldp_n_32_ip_fac_er_s_diag_mis /end AXIS_DESCR
 /begin AXIS_DESCR COM_AXIS load_mis _CNV_A_R_LINEAR_____212_CM 6 0. 99.9969482421875 FORMAT "%7.3" AXIS_PTS_REF ldp_load_ip_fac_er_s_diag_mis /end AXIS_DESCR
/end CHARACTERISTIC
/begin CHARACTERISTIC ip_mis_a_fac_afs "Catalyst damage weighting factor used for MIS_A counters increment (AFS combustion mode)" MAP 0xa0807060 _REC_MAP_20_u1_u2_u2 100. _CNV_A_R_LINEAR_____0_CM 0. 100. DISPLAY_IDENTIFIER IP_MIS_A_FAC_AFS FORMAT "%3.0"
 /begin AXIS_DESCR COM_AXIS n _CNV_A_R_LINEAR_____14_CM 6 0. 8160. FORMAT "%4.0" AXIS_PTS_REF ldp_n__mis_a_fac_afs /end AXIS_DESCR
 /begin AXIS_DESCR COM_AXIS load_mis _CNV_A_R_LINEAR_____212_CM 6 0. 99.9969482421875 FORMAT "%7.3" AXIS_PTS_REF ldp_load_mis__mis_a_fac_afs /end AXIS_DESCR
/end CHARACTERISTIC
/begin CHARACTERISTIC ip_mis_a_fac_hom_s "Catalyst damage weighting factor used for MIS_A counters increment (AFL combustion mode)" MAP 0xa08073e4 _REC_MAP_20_u1_u2_u2 100. _CNV_A_R_LINEAR_____0_CM 0. 100. DISPLAY_IDENTIFIER IP_MIS_A_FAC_HOM_S FORMAT "%3.0"
 /begin AXIS_DESCR COM_AXIS n _CNV_A_R_LINEAR_____14_CM 6 0. 8160. FORMAT "%4.0" AXIS_PTS_REF ldp_n__mis_a_fac_hom_s /end AXIS_DESCR
 /begin AXIS_DESCR COM_AXIS load_mis _CNV_A_R_LINEAR_____212_CM 6 0. 99.9969482421875 FORMAT "%7.3" AXIS_PTS_REF ldp_load_mis__mis_a_fac_hom_s /end AXIS_DESCR
/end CHARACTERISTIC
/begin MEASUREMENT lv_err_in_win_mis_b4 "End of CARB B1 window for similar condition" UBYTE _CNV_S_2_RANGE__0___1_CM 1 100. 0. 1. DISPLAY_IDENTIFIER LV_ERR_IN_WIN_MIS_B4 ECU_ADDRESS 0xd00076df BIT_MASK 0x1 /end MEASUREMENT
/begin MEASUREMENT lv_err_in_win_mis_b1 "End of CARB B1 window for similar condition" UBYTE _CNV_S_2_RANGE__0___1_CM 1 100. 0. 1. DISPLAY_IDENTIFIER LV_ERR_IN_WIN_MIS_B1 ECU_ADDRESS 0xd00076de BIT_MASK 0x1 /end MEASUREMENT
/begin MEASUREMENT lv_err_in_win_mis_a "End during CARB A window for similar condition" UBYTE _CNV_S_2_RANGE__0___1_CM 1 100. 0. 1. DISPLAY_IDENTIFIER LV_ERR_IN_WIN_MIS_A ECU_ADDRESS 0xd00076dd BIT_MASK 0x1 /end MEASUREMENT
/begin MEASUREMENT lv_err_mis_a_in_win_b "Error MIS_A during CARB B1/B4 window for similar condition" UBYTE _CNV_S_2_RANGE__0___1_CM 1 100. 0. 1. DISPLAY_IDENTIFIER LV_ERR_MIS_A_IN_WIN_B ECU_ADDRESS 0xd00076e0 BIT_MASK 0x1 /end MEASUREMENT
/begin MEASUREMENT lv_mis_a_diag_req_app "Specific request to evaluate CARB A criterion with project specific calibration set according external conditions (bad fuel quality...)" UBYTE _CNV_S_2_RANGE__0___1_CM 1 100. 0. 1. DISPLAY_IDENTIFIER LV_MIS_A_DIAG_REQ_APP ECU_ADDRESS 0xd00076eb BIT_MASK 0x1 /end MEASUREMENT
/begin MEASUREMENT lv_mis_b_diag_req_app "Specific request to evaluate CARB B1 & B4 criterions" UBYTE _CNV_S_2_RANGE__0___1_CM 1 100. 0. 1. DISPLAY_IDENTIFIER LV_MIS_B_DIAG_REQ_APP ECU_ADDRESS 0xd00076ec BIT_MASK 0x1 /end MEASUREMENT
/begin MEASUREMENT fac_mis_a_app "Catalyst damage weighting factor used to increment counters for MIS_A criterion pending application specific conditions" UBYTE _CNV_A_R_LINEAR_____0_CM 1 100. 0. 100. DISPLAY_IDENTIFIER FAC_MIS_A_APP ECU_ADDRESS 0xd00076c8 FORMAT "%3.0" /end MEASUREMENT
/begin MEASUREMENT fac_mis_a_thd_ind_app "Cylinder individual threshold used for cylinder shut-off during CARB A criterion window pending application specific conditions" UWORD _CNV_A_R_LINEAR_____28_CM 1 100. 0. 100. DISPLAY_IDENTIFIER FAC_MIS_A_THD_IND_APP ECU_ADDRESS 0xd00076ca FORMAT "%5.3" /end MEASUREMENT
/begin MEASUREMENT fac_mis_sum_a_thd_app "Global threshold used for CARB A criterion pending application specific conditions" UWORD _CNV_A_R_LINEAR_____28_CM 1 100. 0. 100. DISPLAY_IDENTIFIER FAC_MIS_SUM_A_THD_APP ECU_ADDRESS 0xd00076cc FORMAT "%5.3" /end MEASUREMENT
/begin MEASUREMENT fac_mis_sum_b1_thd_app "Global threshold used for CARB B1 criterion pending application specific conditions" UWORD _CNV_A_R_LINEAR_____28_CM 1 100. 0. 100. DISPLAY_IDENTIFIER FAC_MIS_SUM_B1_THD_APP ECU_ADDRESS 0xd00076ce FORMAT "%5.3" /end MEASUREMENT
/begin MEASUREMENT fac_mis_sum_b4_thd_app "Global threshold used for CARB B4 criterion pending application specific conditions" UWORD _CNV_A_R_LINEAR_____28_CM 1 100. 0. 100. DISPLAY_IDENTIFIER FAC_MIS_SUM_B4_THD_APP ECU_ADDRESS 0xd00076d0 FORMAT "%5.3" /end MEASUREMENT
/begin MEASUREMENT lv_inh_igc_diag_mis "Inhibition of misfire crossed diagnosis with IGC OBD I errors" UBYTE _CNV_S_2_RANGE__0___1_CM 1 100. 0. 1. DISPLAY_IDENTIFIER LV_INH_IGC_DIAG_MIS ECU_ADDRESS 0xd00076e7 BIT_MASK 0x1 /end MEASUREMENT
/begin MEASUREMENT lv_req_app_ctr_mis_a "Specific request to allow out of FTP counting mode even if we are within FTP area" UBYTE _CNV_S_2_RANGE__0___1_CM 1 100. 0. 1. DISPLAY_IDENTIFIER LV_REQ_APP_CTR_MIS_A ECU_ADDRESS 0xd00076ef BIT_MASK 0x1 /end MEASUREMENT
/begin MEASUREMENT seg_nr_cbk_er "Cylinder bank phasing reference defined according delay introduced by engine roughness index" UBYTE _CNV_A_R_LINEAR_____0_CM 1 100. 0. 255. DISPLAY_IDENTIFIER SEG_NR_CBK_ER ECU_ADDRESS 0xd00076ad FORMAT "%3.0" /end MEASUREMENT
/begin MEASUREMENT lv_inh_iv_diag_mis "Inhibition of misfire crossed diagnosis with IV OBD I errors" UBYTE _CNV_S_2_RANGE__0___1_CM 1 100. 0. 1. DISPLAY_IDENTIFIER LV_INH_IV_DIAG_MIS ECU_ADDRESS 0xd00076e8 BIT_MASK 0x1 /end MEASUREMENT
/begin MEASUREMENT lv_cdn_mis_b1 "CARB B1 misfire criterion monitoring condition" UBYTE _CNV_S_2_RANGE__0___1_CM 1 100. 0. 1. DISPLAY_IDENTIFIER LV_CDN_MIS_B1 ECU_ADDRESS 0xd00076d3 BIT_MASK 0x1 /end MEASUREMENT
/begin MEASUREMENT lv_cdn_mis_a "CARB A misfire criterion monitoring condition" UBYTE _CNV_S_2_RANGE__0___1_CM 1 100. 0. 1. DISPLAY_IDENTIFIER LV_CDN_MIS_A ECU_ADDRESS 0xd00076d2 BIT_MASK 0x1 /end MEASUREMENT
/begin MEASUREMENT lv_cdn_mis_b4 "CARB B4 misfire criterion monitoring condition" UBYTE _CNV_S_2_RANGE__0___1_CM 1 100. 0. 1. DISPLAY_IDENTIFIER LV_CDN_MIS_B4 ECU_ADDRESS 0xd00076d4 BIT_MASK 0x1 /end MEASUREMENT
/begin MEASUREMENT lv_err_mis_mpl "Present error flag multiple cylinder misfire" UBYTE _CNV_S_2_RANGE__0___1_CM 1 100. 0. 1. DISPLAY_IDENTIFIER LV_ERR_MIS_MPL ECU_ADDRESS 0xd0007f78 BIT_MASK 0x1 /end MEASUREMENT
/begin MEASUREMENT lv_err_mis_ftl_l "Present error flag misfire with low fuel tank level" UBYTE _CNV_S_2_RANGE__0___1_CM 1 100. 0. 1. DISPLAY_IDENTIFIER LV_ERR_MIS_FTL_L ECU_ADDRESS 0xd0007f79 BIT_MASK 0x1 /end MEASUREMENT
/begin MEASUREMENT lv_err_mis_1 "Present error flag for Cylinder specific misfire failure" UBYTE _CNV_S_2_RANGE__0___1_CM 1 100. 0. 1. DISPLAY_IDENTIFIER LV_ERR_MIS_1 ECU_ADDRESS 0xd0007f71 BIT_MASK 0x1 /end MEASUREMENT
/begin MEASUREMENT lv_err_mis_2 "Present error flag for Cylinder specific misfire failure" UBYTE _CNV_S_2_RANGE__0___1_CM 1 100. 0. 1. DISPLAY_IDENTIFIER LV_ERR_MIS_2 ECU_ADDRESS 0xd0007f72 BIT_MASK 0x1 /end MEASUREMENT
/begin MEASUREMENT lv_err_mis_3 "Present error flag for Cylinder specific misfire failure" UBYTE _CNV_S_2_RANGE__0___1_CM 1 100. 0. 1. DISPLAY_IDENTIFIER LV_ERR_MIS_3 ECU_ADDRESS 0xd0007f73 BIT_MASK 0x1 /end MEASUREMENT
/begin MEASUREMENT lv_err_mis_4 "Present error flag for Cylinder specific misfire failure" UBYTE _CNV_S_2_RANGE__0___1_CM 1 100. 0. 1. DISPLAY_IDENTIFIER LV_ERR_MIS_4 ECU_ADDRESS 0xd0007f74 BIT_MASK 0x1 /end MEASUREMENT
/begin MEASUREMENT lv_err_mis_5 "Present error flag for Cylinder specific misfire failure" UBYTE _CNV_S_2_RANGE__0___1_CM 1 100. 0. 1. DISPLAY_IDENTIFIER LV_ERR_MIS_5 ECU_ADDRESS 0xd0007f75 BIT_MASK 0x1 /end MEASUREMENT
/begin CHARACTERISTIC c_teg_cat_up_mis_a_max "TEG Threshold for misfire A counter management" VALUE 0xa0807130 _REC_VAL_20_u2 2047. _CNV_A_R_LINEAR_____130_CM 0. 2047. DISPLAY_IDENTIFIER C_TEG_CAT_UP_MIS_A_MAX FORMAT "%9.4" /end CHARACTERISTIC
/begin MEASUREMENT lv_err_mis_0 "Present error flag for Cylinder specific misfire failure" UBYTE _CNV_S_2_RANGE__0___1_CM 1 100. 0. 1. DISPLAY_IDENTIFIER LV_ERR_MIS_0 ECU_ADDRESS 0xd0007f70 BIT_MASK 0x1 /end MEASUREMENT
/begin MEASUREMENT ctr_mis_det "Number of misfire events of all cylinders in one DC" UWORD _CNV_A_R_LINEAR_____0_CM 1 100. 0. 65535. DISPLAY_IDENTIFIER CTR_MIS_DET ECU_ADDRESS 0xd00070dc FORMAT "%5.0" /end MEASUREMENT
/begin MEASUREMENT ctr_seg_mis_act "Number of segments with active misfire detection" ULONG _CNV_A_R_LINEAR_____50_CM 1 100. 0. 4294967295. DISPLAY_IDENTIFIER CTR_SEG_MIS_ACT ECU_ADDRESS 0xd00070e4 FORMAT "%11.0" /end MEASUREMENT
/begin CHARACTERISTIC lc_ctr_conf_diag_mis "Diagnosis TDC counting mode : counting all TDCs (=0) or only diagnosed TDC's (=1)" VALUE 0xa080713f _REC_VAL_20_u1 1. _CNV_S_2_RANGE__0___1_CM 0. 1. DISPLAY_IDENTIFIER LC_CTR_CONF_DIAG_MIS BIT_MASK 0x1 /end CHARACTERISTIC
/begin CHARACTERISTIC lc_ctr_conf_osc_mis "Diagnosis TDC counting mode when crankshaft oscillations occurs: stop counting TDC's (=0) or counting allowed TDC's (=1)" VALUE 0xa0807140 _REC_VAL_20_u1 1. _CNV_S_2_RANGE__0___1_CM 0. 1. DISPLAY_IDENTIFIER LC_CTR_CONF_OSC_MIS BIT_MASK 0x1 /end CHARACTERISTIC
/begin MEASUREMENT lv_state_crk_osc "Status of crankshaft oscillation condition" UBYTE _CNV_S_2_RANGE__0___1_CM 1 100. 0. 1. DISPLAY_IDENTIFIER LV_STATE_CRK_OSC ECU_ADDRESS 0xd00076f2 BIT_MASK 0x1 /end MEASUREMENT
/begin MEASUREMENT drv0_er_sum_osc "Integrated DRV0_ER value for amplitude criterion reseted evey sign change or DRV0" UWORD _CNV_A_R_LINEAR_____410_CM 1 100. 0. 65535. DISPLAY_IDENTIFIER DRV0_ER_SUM_OSC ECU_ADDRESS 0xd0007178 FORMAT "%5.0" /end MEASUREMENT
/begin MEASUREMENT drv0_er_sum_thd_osc "Threshold for DRV0_ER_SUM_OSC to fulfill amplitude criteria" UWORD _CNV_A_R_LINEAR_____410_CM 1 100. 0. 65535. DISPLAY_IDENTIFIER DRV0_ER_SUM_THD_OSC ECU_ADDRESS 0xd000717a FORMAT "%5.0" /end MEASUREMENT
/begin MEASUREMENT ctr_tdc_crk_osc_act "TDC counter to enable crankshaft oscillation detection after misfiring detection" UBYTE _CNV_A_R_LINEAR_____0_CM 1 100. 0. 255. DISPLAY_IDENTIFIER CTR_TDC_CRK_OSC_ACT ECU_ADDRESS 0xd0007704 FORMAT "%3.0" /end MEASUREMENT
/begin MEASUREMENT seg_sum_frq_crk_osc "Segment counter for frequency criterion reseted every sign change or DRV0" UBYTE _CNV_A_R_LINEAR_____0_CM 1 100. 0. 255. DISPLAY_IDENTIFIER SEG_SUM_FRQ_CRK_OSC ECU_ADDRESS 0xd0007706 FORMAT "%3.0" /end MEASUREMENT
/begin MEASUREMENT lv_crk_osc_det_act "Crankshaft oscillation detection active" UBYTE _CNV_S_2_RANGE__0___1_CM 1 100. 0. 1. DISPLAY_IDENTIFIER LV_CRK_OSC_DET_ACT ECU_ADDRESS 0xd0007709 BIT_MASK 0x1 /end MEASUREMENT
/begin MEASUREMENT lv_frq_crit_crk_osc "Critical crankshaft oscillation frequency detected" UBYTE _CNV_S_2_RANGE__0___1_CM 1 100. 0. 1. DISPLAY_IDENTIFIER LV_FRQ_CRIT_CRK_OSC ECU_ADDRESS 0xd000770a BIT_MASK 0x1 /end MEASUREMENT
/begin MEASUREMENT lv_ampl_crit_crk_osc "Critical crankshaft oscillation amplitude detected" UBYTE _CNV_S_2_RANGE__0___1_CM 1 100. 0. 1. DISPLAY_IDENTIFIER LV_AMPL_CRIT_CRK_OSC ECU_ADDRESS 0xd0007708 BIT_MASK 0x1 /end MEASUREMENT
/begin CHARACTERISTIC c_dly_tdc_crk_osc "Active TDC of crankshaft oscillation status after detection triggering" VALUE 0xa080742c _REC_VAL_20_u1 255. _CNV_A_R_LINEAR_____0_CM 0. 255. DISPLAY_IDENTIFIER C_DLY_TDC_CRK_OSC FORMAT "%3.0" /end CHARACTERISTIC
/begin CHARACTERISTIC c_n_max_crk_osc "Maximum speed for crankshaft oscillation calculation" VALUE 0xa080742d _REC_VAL_20_u1 8160. _CNV_A_R_LINEAR_____10_CM 0. 8160. DISPLAY_IDENTIFIER C_N_MAX_CRK_OSC FORMAT "%4.0" /end CHARACTERISTIC
/begin CHARACTERISTIC c_nr_tdc_max_crk_osc "Maximum TDC after detected misfire to activate crankshaft osc. detect. process" VALUE 0xa080742e _REC_VAL_20_u1 255. _CNV_A_R_LINEAR_____0_CM 0. 255. DISPLAY_IDENTIFIER C_NR_TDC_MAX_CRK_OSC FORMAT "%3.0" /end CHARACTERISTIC
/begin AXIS_PTS ldp_n_32_ip_seg_min_frq_crk_osc "" 0xa0807422 n_32 _REC_AXS_20_u1 8160. _CNV_A_R_LINEAR_____10_CM 4 0. 8160. FORMAT "%4.0" /end AXIS_PTS
/begin AXIS_PTS ldp_n_32_ip_drv0_er_thd_osc "" 0xa080741a n_32 _REC_AXS_20_u1 8160. _CNV_A_R_LINEAR_____10_CM 6 0. 8160. FORMAT "%4.0" /end AXIS_PTS
/begin AXIS_PTS ldp_load_mis_ip_drv0_er_thd_osc "" 0xa080740c load_mis _REC_AXS_20_u2 99.9969482421875 _CNV_A_R_LINEAR_____212_CM 6 0. 99.9969482421875 FORMAT "%7.3" /end AXIS_PTS
/begin CHARACTERISTIC ip_seg_min_frq_crk_osc "Minimum number of segment after turn of speed direction for detecting critical high freq" CURVE 0xa0807428 _REC_CUR_20_u1_u1 255. _CNV_A_R_LINEAR_____0_CM 0. 255. DISPLAY_IDENTIFIER IP_SEG_MIN_FRQ_CRK_OSC FORMAT "%3.0"
 /begin AXIS_DESCR COM_AXIS n_32 _CNV_A_R_LINEAR_____10_CM 4 0. 8160. FORMAT "%4.0" AXIS_PTS_REF ldp_n_32_ip_seg_min_frq_crk_osc /end AXIS_DESCR
/end CHARACTERISTIC
/begin CHARACTERISTIC ip_drv0_er_thd_osc "DRV0 amplitude threshold to detect critical crankshaft oscillation amplitude" MAP 0xa0812744 _REC_MAP_20_u2_u1_u2 65535. _CNV_A_R_LINEAR_____410_CM 0. 65535. DISPLAY_IDENTIFIER IP_DRV0_ER_THD_OSC FORMAT "%5.0"
 /begin AXIS_DESCR COM_AXIS n_32 _CNV_A_R_LINEAR_____10_CM 6 0. 8160. FORMAT "%4.0" AXIS_PTS_REF ldp_n_32_ip_drv0_er_thd_osc /end AXIS_DESCR
 /begin AXIS_DESCR COM_AXIS load_mis _CNV_A_R_LINEAR_____212_CM 6 0. 99.9969482421875 FORMAT "%7.3" AXIS_PTS_REF ldp_load_mis_ip_drv0_er_thd_osc /end AXIS_DESCR
/end CHARACTERISTIC
/begin MEASUREMENT ratio_vs_n_crk_osc "Ratio VS / N for gear area determination" UBYTE _CNV_A_R_MISF_LINEA_418_CM 1 100. 0. 5.e-002 DISPLAY_IDENTIFIER RATIO_VS_N_CRK_OSC ECU_ADDRESS 0xd0007705 FORMAT "%6.4" /end MEASUREMENT
/begin CHARACTERISTIC c_ratio_vs_n_min_crk_osc "minimum vs/n ratio to active crankshaft oscillation detection" VALUE 0xa080742f _REC_VAL_20_u1 5.e-002 _CNV_A_R_MISF_LINEA_418_CM 0. 5.e-002 DISPLAY_IDENTIFIER C_RATIO_VS_N_MIN_CRK_OSC FORMAT "%6.4" /end CHARACTERISTIC
/begin MEASUREMENT lv_state_rr "Boolean for state of rough road detection (No : Yes)." UBYTE _CNV_S_2_RANGE__0___1_CM 1 100. 0. 1. DISPLAY_IDENTIFIER LV_STATE_RR ECU_ADDRESS 0xd00076f3 BIT_MASK 0x1 /end MEASUREMENT
/begin MEASUREMENT seg_t_mes_0_rr "Actual segment time measurement from the wheel speed signal." ULONG _CNV_A_R_LINEAR_____419_CM 1 100. 0. 4294967288. DISPLAY_IDENTIFIER SEG_T_MES_0_RR ECU_ADDRESS 0xd0007134 FORMAT "%10.0" /end MEASUREMENT
/begin MEASUREMENT seg_t_mes_1_rr "Previous segment time measurement from the wheel speed signal." ULONG _CNV_A_R_LINEAR_____419_CM 1 100. 0. 4294967288. DISPLAY_IDENTIFIER SEG_T_MES_1_RR ECU_ADDRESS 0xd0007138 FORMAT "%10.0" /end MEASUREMENT
/begin MEASUREMENT wheel_grd_mmv "Rough road value." UWORD _CNV_A_R_LINEAR_____420_CM 1 100. 0. 999.93896 DISPLAY_IDENTIFIER WHEEL_GRD_MMV ECU_ADDRESS 0xd0007144 FORMAT "%6.2" /end MEASUREMENT
/begin MEASUREMENT wheel_grd_mmv_thd "Threshold for rough road value" UWORD _CNV_A_R_LINEAR_____420_CM 1 100. 0. 999.93896 DISPLAY_IDENTIFIER WHEEL_GRD_MMV_THD ECU_ADDRESS 0xd0007146 FORMAT "%6.2" /end MEASUREMENT
/begin MEASUREMENT sum_rr "Counter of rough road detection events." UBYTE _CNV_A_R_LINEAR_____0_CM 1 100. 0. 255. DISPLAY_IDENTIFIER SUM_RR ECU_ADDRESS 0xd00076af FORMAT "%3.0" /end MEASUREMENT
/begin CHARACTERISTIC c_vs_min_rr "Minimum vehicle speed for rough road detection." VALUE 0xa0807135 _REC_VAL_20_u1 255. _CNV_A_R_LINEAR_____6_CM 0. 255. DISPLAY_IDENTIFIER C_VS_MIN_RR FORMAT "%3.0" /end CHARACTERISTIC
/begin CHARACTERISTIC c_vs_max_rr "Maximum vehicle speed for rough road detection." VALUE 0xa0807134 _REC_VAL_20_u1 255. _CNV_A_R_LINEAR_____6_CM 0. 255. DISPLAY_IDENTIFIER C_VS_MAX_RR FORMAT "%3.0" /end CHARACTERISTIC
/begin CHARACTERISTIC c_wheel_grd_crlc_rr "Correlation factor for floating averaging of the rough road raw values" VALUE 0xa0807136 _REC_VAL_20_u2 0.9999847412109381 _CNV_A_R_LINEAR_____89_CM 0. 0.9999847412109381 DISPLAY_IDENTIFIER C_WHEEL_GRD_CRLC_RR FORMAT "%7.5" /end CHARACTERISTIC
/begin CHARACTERISTIC c_dly_er_rr "Fade out time for engine roughness after rough road detection" VALUE 0xa08070ce _REC_VAL_20_u2 655350. _CNV_A_R_LINEAR_____20_CM 0. 655350. DISPLAY_IDENTIFIER C_DLY_ER_RR FORMAT "%6.0" /end CHARACTERISTIC
/begin CHARACTERISTIC ip_wheel_grd_mmv_thd_at__vs "Threshold versus vehicle speed for rough road detection, automatic tzransmission" CURVE 0xa08070a4 _REC_CUR_20_u2_u1 255. _CNV_A_R_LINEAR_____421_CM 0. 255. DISPLAY_IDENTIFIER IP_WHEEL_GRD_MMV_THD_AT__VS FORMAT "%6.2"
 /begin AXIS_DESCR COM_AXIS vs _CNV_A_R_LINEAR_____6_CM 9 0. 255. FORMAT "%3.0" AXIS_PTS_REF ldpm_vs_wheel_grd_mmv_thd /end AXIS_DESCR
/end CHARACTERISTIC
/begin CHARACTERISTIC ip_wheel_grd_mmv_thd_mt__vs "Threshold versus vehicle speed for rough road detection, manual transmission" CURVE 0xa08070b8 _REC_CUR_20_u2_u1 255. _CNV_A_R_LINEAR_____421_CM 0. 255. DISPLAY_IDENTIFIER IP_WHEEL_GRD_MMV_THD_MT__VS FORMAT "%6.2"
 /begin AXIS_DESCR COM_AXIS vs _CNV_A_R_LINEAR_____6_CM 9 0. 255. FORMAT "%3.0" AXIS_PTS_REF ldpm_vs_wheel_grd_mmv_thd /end AXIS_DESCR
/end CHARACTERISTIC
/begin AXIS_PTS ldpm_vs_wheel_grd_mmv_thd "" 0xa0806ee8 vs _REC_AXS_20_u1 255. _CNV_A_R_LINEAR_____6_CM 9 0. 255. FORMAT "%3.0" /end AXIS_PTS
/begin MEASUREMENT vs_rr_edge_av.edge_ctr "" UWORD _CNV_A_R_LINEAR_____0_CM 1 100. 0. 65535. DISPLAY_IDENTIFIER VS_RR_EDGE_CTR_AV ECU_ADDRESS 0xd0003638 FORMAT "%5.0" /end MEASUREMENT
/begin MEASUREMENT vs_rr_edge_av.edge_t "" ULONG _CNV_A_R_LINEAR_____273_CM 1 100. 0. 34359738.36 DISPLAY_IDENTIFIER VS_RR_EDGE_T_AV ECU_ADDRESS 0xd000363a FORMAT "%12.3" /end MEASUREMENT
/begin AXIS_PTS ldp_opm_av_tqlo "" 0xa0807f80 opm_av _REC_AXS_20_u1 8. _CNV_A_R_LINEAR_____0_CM 8 0. 8. FORMAT "%1.0" /end AXIS_PTS
/begin MEASUREMENT ang_rel_sp_ecu_vvl "" UWORD _CNV_A_R_LINEAR_____436_CM 1 100. 0. 100. DISPLAY_IDENTIFIER ANG_REL_SP_ECU_VVL ECU_ADDRESS 0xd0003a2c FORMAT "%6.2" /end MEASUREMENT
/begin MEASUREMENT lv_tco_ad_cdn_is "Logical bit \"Coolant temperature in operating range\"" UBYTE _CNV_S_2_RANGE__0___1_CM 1 100. 0. 1. DISPLAY_IDENTIFIER LV_TCO_AD_CDN_IS ECU_ADDRESS 0xd000640c BIT_MASK 0x1 /end MEASUREMENT
/begin MEASUREMENT lv_ad_cdn_is "Adaptation condition" UBYTE _CNV_S_2_RANGE__0___1_CM 1 100. 0. 1. DISPLAY_IDENTIFIER LV_AD_CDN_IS ECU_ADDRESS 0xd0006408 BIT_MASK 0x1 /end MEASUREMENT
/begin MEASUREMENT lv_dly_ad_is "Logical bit \"Idle speed has settled for a given time delay\"" UBYTE _CNV_S_2_RANGE__0___1_CM 1 100. 0. 1. DISPLAY_IDENTIFIER LV_DLY_AD_IS ECU_ADDRESS 0xd0006409 BIT_MASK 0x1 /end MEASUREMENT
/begin CHARACTERISTIC c_tco_ad_max_is "temperature top limit for ISC Adaptation" VALUE 0xa0807ffa _REC_VAL_20_u1 28.575 _CNV_A_R_LINEAR_____17_CM -48. 142.5 DISPLAY_IDENTIFIER C_TCO_AD_MAX_IS FORMAT "%6.2" /end CHARACTERISTIC
/begin CHARACTERISTIC c_tco_ad_min_is "temperature bottom limit for ISC Adaptation" VALUE 0xa0807ffb _REC_VAL_20_u1 28.575 _CNV_A_R_LINEAR_____17_CM -48. 142.5 DISPLAY_IDENTIFIER C_TCO_AD_MIN_IS FORMAT "%6.2" /end CHARACTERISTIC
/begin CHARACTERISTIC c_n_delta "engine speed threshold for ISC Adaptation" VALUE 0xa0807ff8 _REC_VAL_20_u2 8160. _CNV_A_R_LINEAR_____14_CM 0. 8160. DISPLAY_IDENTIFIER C_N_DELTA FORMAT "%4.0" /end CHARACTERISTIC
/begin CHARACTERISTIC c_dly_ad_is "time delay for ISC Adaptation" VALUE 0xa0807fee _REC_VAL_20_u1 255. _CNV_A_R_LINEAR_____437_CM 0. 255. DISPLAY_IDENTIFIER C_DLY_AD_IS FORMAT "%3.0" /end CHARACTERISTIC
/begin CHARACTERISTIC c_tq_dif_is_ad_conv_min "" VALUE 0xa0808006 _REC_VAL_20_s2 2047.96875 _CNV_A_R_LINEAR_____31_CM -1024. 1023.96875 DISPLAY_IDENTIFIER C_TQ_DIF_IS_AD_CONV_MIN FORMAT "%11.5" /end CHARACTERISTIC
/begin CHARACTERISTIC c_tq_dif_is_ad_acc_max "" VALUE 0xa0808000 _REC_VAL_20_s2 2047.96875 _CNV_A_R_LINEAR_____31_CM -1024. 1023.96875 DISPLAY_IDENTIFIER C_TQ_DIF_IS_AD_ACC_MAX FORMAT "%11.5" /end CHARACTERISTIC
/begin CHARACTERISTIC c_tq_dif_is_ad_acc_min "" VALUE 0xa0808002 _REC_VAL_20_s2 2047.96875 _CNV_A_R_LINEAR_____31_CM -1024. 1023.96875 DISPLAY_IDENTIFIER C_TQ_DIF_IS_AD_ACC_MIN FORMAT "%11.5" /end CHARACTERISTIC
/begin CHARACTERISTIC c_tq_dif_is_ad_max "" VALUE 0xa0808008 _REC_VAL_20_s2 2047.96875 _CNV_A_R_LINEAR_____31_CM -1024. 1023.96875 DISPLAY_IDENTIFIER C_TQ_DIF_IS_AD_MAX FORMAT "%11.5" /end CHARACTERISTIC
/begin CHARACTERISTIC c_tq_dif_is_ad_min "" VALUE 0xa080800a _REC_VAL_20_s2 2047.96875 _CNV_A_R_LINEAR_____31_CM -1024. 1023.96875 DISPLAY_IDENTIFIER C_TQ_DIF_IS_AD_MIN FORMAT "%11.5" /end CHARACTERISTIC
/begin CHARACTERISTIC c_tq_dif_is_ad_acc_conv_max "" VALUE 0xa0807ffc _REC_VAL_20_s2 2047.96875 _CNV_A_R_LINEAR_____31_CM -1024. 1023.96875 DISPLAY_IDENTIFIER C_TQ_DIF_IS_AD_ACC_CONV_MAX FORMAT "%11.5" /end CHARACTERISTIC
/begin CHARACTERISTIC c_tq_dif_is_ad_conv_max "" VALUE 0xa0808004 _REC_VAL_20_s2 2047.96875 _CNV_A_R_LINEAR_____31_CM -1024. 1023.96875 DISPLAY_IDENTIFIER C_TQ_DIF_IS_AD_CONV_MAX FORMAT "%11.5" /end CHARACTERISTIC
/begin CHARACTERISTIC c_tq_dif_is_ad_acc_conv_min "" VALUE 0xa0807ffe _REC_VAL_20_s2 2047.96875 _CNV_A_R_LINEAR_____31_CM -1024. 1023.96875 DISPLAY_IDENTIFIER C_TQ_DIF_IS_AD_ACC_CONV_MIN FORMAT "%11.5" /end CHARACTERISTIC
/begin CHARACTERISTIC c_fac_tq_dif_is_ad_acc "" VALUE 0xa0807ff2 _REC_VAL_20_u2 0.9999847412109381 _CNV_A_R_LINEAR_____89_CM 0. 0.9999847412109381 DISPLAY_IDENTIFIER C_FAC_TQ_DIF_IS_AD_ACC FORMAT "%7.5" /end CHARACTERISTIC
/begin CHARACTERISTIC c_fac_tq_dif_is_ad_conv "" VALUE 0xa0807ff6 _REC_VAL_20_u2 0.9999847412109381 _CNV_A_R_LINEAR_____89_CM 0. 0.9999847412109381 DISPLAY_IDENTIFIER C_FAC_TQ_DIF_IS_AD_CONV FORMAT "%7.5" /end CHARACTERISTIC
/begin CHARACTERISTIC c_fac_tq_dif_is_ad_acc_conv "" VALUE 0xa0807ff4 _REC_VAL_20_u2 0.9999847412109381 _CNV_A_R_LINEAR_____89_CM 0. 0.9999847412109381 DISPLAY_IDENTIFIER C_FAC_TQ_DIF_IS_AD_ACC_CONV FORMAT "%7.5" /end CHARACTERISTIC
/begin CHARACTERISTIC c_fac_tq_dif_is_ad "" VALUE 0xa0807ff0 _REC_VAL_20_u2 0.9999847412109381 _CNV_A_R_LINEAR_____89_CM 0. 0.9999847412109381 DISPLAY_IDENTIFIER C_FAC_TQ_DIF_IS_AD FORMAT "%7.5" /end CHARACTERISTIC
/begin MEASUREMENT lv_opm_sel_tq_is_ad_2 "Requested value active" UBYTE _CNV_S_2_RANGE__0___1_CM 1 100. 0. 1. DISPLAY_IDENTIFIER LV_OPM_SEL_TQ_IS_AD_2 ECU_ADDRESS 0xd00063ee BIT_MASK 0x1 /end MEASUREMENT
/begin CHARACTERISTIC id_tq_dif_is_ad_opm_av "Table of index OPM_AV" CURVE 0xa0809ee0 _REC_CUR_20_u1_u1 7. _CNV_A_R_LINEAR_____0_CM 1. 8. DISPLAY_IDENTIFIER ID_TQ_DIF_IS_AD_OPM_AV FORMAT "%1.0"
 /begin AXIS_DESCR COM_AXIS opm_av _CNV_A_R_LINEAR_____0_CM 8 0. 8. FORMAT "%1.0" AXIS_PTS_REF ldp_opm_av_tqlo /end AXIS_DESCR
/end CHARACTERISTIC
/begin CHARACTERISTIC id_tq_dif_is_ad_opm_req "Table of index OPM_REQ" CURVE 0xa0809ee8 _REC_CUR_20_u1_u1 7. _CNV_A_R_LINEAR_____0_CM 1. 8. DISPLAY_IDENTIFIER ID_TQ_DIF_IS_AD_OPM_REQ FORMAT "%1.0"
 /begin AXIS_DESCR COM_AXIS opm_av _CNV_A_R_LINEAR_____0_CM 8 0. 8. FORMAT "%1.0" AXIS_PTS_REF ldp_opm_av_tqlo /end AXIS_DESCR
/end CHARACTERISTIC
/begin MEASUREMENT lv_opm_tq_is_add_rls "Last operation mode calculation active" UBYTE _CNV_S_2_RANGE__0___1_CM 1 100. 0. 1. DISPLAY_IDENTIFIER LV_OPM_TQ_IS_ADD_RLS ECU_ADDRESS 0xd00063ef BIT_MASK 0x1 /end MEASUREMENT
/begin CHARACTERISTIC c_crlc_tq_dif_is_ad_acc "Filter constant for LOW_PASS_1" VALUE 0xa0807fec _REC_VAL_20_u1 0.99609375 _CNV_A_R_LINEAR_____28_CM 0. 0.99609375 DISPLAY_IDENTIFIER C_CRLC_TQ_DIF_IS_AD_ACC FORMAT "%5.3" /end CHARACTERISTIC
/begin CHARACTERISTIC c_crlc_tq_dif_is_ad_conv "Filter constant for converter torque" VALUE 0xa0807fed _REC_VAL_20_u1 0.99609375 _CNV_A_R_LINEAR_____28_CM 0. 0.99609375 DISPLAY_IDENTIFIER C_CRLC_TQ_DIF_IS_AD_CONV FORMAT "%5.3" /end CHARACTERISTIC
/begin MEASUREMENT lv_opm_sel_tq_is_ad_1 "Last operation mode calculation active" UBYTE _CNV_S_2_RANGE__0___1_CM 1 100. 0. 1. DISPLAY_IDENTIFIER LV_OPM_SEL_TQ_IS_AD_1 ECU_ADDRESS 0xd00063ed BIT_MASK 0x1 /end MEASUREMENT
/begin MEASUREMENT lv_at_neut_ctl "neutral control active/passive" UBYTE _CNV_S_2_RANGE__0___1_CM 1 100. 0. 1. DISPLAY_IDENTIFIER LV_AT_NEUT_CTL ECU_ADDRESS 0xd00063ec BIT_MASK 0x1 /end MEASUREMENT
/begin MEASUREMENT tq_dif_is_ad_inter "Basic ISC adaptation, intermediate value with high resolution (long signed word)" SLONG _CNV_A_R_LINEAR_____235_CM 1 100. -1024. 1023.99999952 DISPLAY_IDENTIFIER TQ_DIF_IS_AD_INTER ECU_ADDRESS 0xd0006404 FORMAT "%12.7" /end MEASUREMENT
/begin MEASUREMENT tq_dif_is_ad_acc_1_inter "ACC torque adaptation, intermediate value with high resolution (long signed word)" SLONG _CNV_A_R_LINEAR_____235_CM 1 100. -1024. 1023.99999952 DISPLAY_IDENTIFIER TQ_DIF_IS_AD_ACC_1_INTER ECU_ADDRESS 0xd00063f0 FORMAT "%12.7" /end MEASUREMENT
/begin MEASUREMENT tq_dif_is_ad_acc_neut_inter "acc torque adaptation, with neutral control" SLONG _CNV_A_R_LINEAR_____235_CM 1 100. -1024. 1023.99999952 DISPLAY_IDENTIFIER TQ_DIF_IS_AD_ACC_NEUT_INTER ECU_ADDRESS 0xd00063f8 FORMAT "%12.7" /end MEASUREMENT
/begin MEASUREMENT tq_dif_is_ad_acc_conv_inter "Hydraulic converter adaptation torque, intermediate value with high resolution (long signed word)" SLONG _CNV_A_R_LINEAR_____235_CM 1 100. -1024. 1023.99999952 DISPLAY_IDENTIFIER TQ_DIF_IS_AD_ACC_CONV_INTER ECU_ADDRESS 0xd00063f4 FORMAT "%12.7" /end MEASUREMENT
/begin MEASUREMENT tq_dif_is_ad_conv_neut_inter "hydraulic converter adaptation" SLONG _CNV_A_R_LINEAR_____235_CM 1 100. -1024. 1023.99999952 DISPLAY_IDENTIFIER TQ_DIF_IS_AD_CONV_NEUT_INTER ECU_ADDRESS 0xd0006400 FORMAT "%12.7" /end MEASUREMENT
/begin MEASUREMENT tq_dif_is_ad_conv_1_inter "hydraulic converter adaptation" SLONG _CNV_A_R_LINEAR_____235_CM 1 100. -1024. 1023.99999952 DISPLAY_IDENTIFIER TQ_DIF_IS_AD_CONV_1_INTER ECU_ADDRESS 0xd00063fc FORMAT "%12.7" /end MEASUREMENT
/begin MEASUREMENT lv_is_ad_inh "Application incidence value (additional adaptation conditions, project specific)" UBYTE _CNV_S_2_RANGE__0___1_CM 1 100. 0. 1. DISPLAY_IDENTIFIER LV_IS_AD_INH ECU_ADDRESS 0xd000640a BIT_MASK 0x1 /end MEASUREMENT
/begin MEASUREMENT lv_is_ad_inh_obd "Application incidence value" UBYTE _CNV_S_2_RANGE__0___1_CM 1 100. 0. 1. DISPLAY_IDENTIFIER LV_IS_AD_INH_OBD ECU_ADDRESS 0xd000640b BIT_MASK 0x1 /end MEASUREMENT
/begin AXIS_PTS ldpm_n_100 "" 0xa0807fa0 n _REC_AXS_20_u2 8160. _CNV_A_R_LINEAR_____14_CM 16 0. 8160. FORMAT "%4.0" /end AXIS_PTS
/begin AXIS_PTS ldpm_maf_cyl_stk__tqfr "" 0xa0807f8c maf _REC_AXS_20_u2 1389. _CNV_A_R_LINEAR_____111_CM 8 0. 1389. FORMAT "%7.2" /end AXIS_PTS
/begin MEASUREMENT nvmy_tqlo.nvmy_dtsysisad.tq_dif_is_ad "Basic ISC adaptation" SWORD _CNV_A_R_LINEAR_____31_CM 1 100. -1024. 1023.96875 DISPLAY_IDENTIFIER TQ_DIF_IS_AD ECU_ADDRESS 0xd00063ac FORMAT "%11.5" /end MEASUREMENT
/begin MEASUREMENT nvmy_tqlo.nvmy_dtsysisad.tq_dif_is_ad_conv "Hydraulic converter adaptation torque" SWORD _CNV_A_R_LINEAR_____31_CM 1 100. -1024. 1023.96875 DISPLAY_IDENTIFIER TQ_DIF_IS_AD_CONV ECU_ADDRESS 0xd00063ae FORMAT "%11.5" /end MEASUREMENT
/begin MEASUREMENT nvmy_tqlo.nvmy_dtsysisad.tq_dif_is_ad_acc "Low pass filtered ACC torque adaptation or ACC and Hydraulic converter torque adaptation" SWORD _CNV_A_R_LINEAR_____31_CM 1 100. -1024. 1023.96875 DISPLAY_IDENTIFIER TQ_DIF_IS_AD_ACC ECU_ADDRESS 0xd00063b0 FORMAT "%11.5" /end MEASUREMENT
/begin MEASUREMENT nvmy_tqlo.nvmy_dtsysisad.tq_dif_is_ad_opm_1 "Basic ISC adaptation, intermediate value with high resolution (long signed word) OPM1" SLONG _CNV_A_R_LINEAR_____235_CM 1 100. -1024. 1023.99999952 DISPLAY_IDENTIFIER TQ_DIF_IS_AD_OPM_1 ECU_ADDRESS 0xd00063b2 FORMAT "%12.7" /end MEASUREMENT
/begin MEASUREMENT nvmy_tqlo.nvmy_dtsysisad.tq_dif_is_ad_opm_2 "Basic ISC adaptation, intermediate value with high resolution (long signed word) OPM2" SLONG _CNV_A_R_LINEAR_____235_CM 1 100. -1024. 1023.99999952 DISPLAY_IDENTIFIER TQ_DIF_IS_AD_OPM_2 ECU_ADDRESS 0xd00063b6 FORMAT "%12.7" /end MEASUREMENT
/begin MEASUREMENT nvmy_tqlo.nvmy_dtsysisad.tq_dif_is_ad_acc_1_opm_1 "ACC torque adaptation, intermediate value with high resolution (long signed word) OPM1" SLONG _CNV_A_R_LINEAR_____235_CM 1 100. -1024. 1023.99999952 DISPLAY_IDENTIFIER TQ_DIF_IS_AD_ACC_1_OPM_1 ECU_ADDRESS 0xd00063ba FORMAT "%12.7" /end MEASUREMENT
/begin MEASUREMENT nvmy_tqlo.nvmy_dtsysisad.tq_dif_is_ad_acc_1_opm_2 "ACC torque adaptation, intermediate value with high resolution (long signed word) OPM2" SLONG _CNV_A_R_LINEAR_____235_CM 1 100. -1024. 1023.99999952 DISPLAY_IDENTIFIER TQ_DIF_IS_AD_ACC_1_OPM_2 ECU_ADDRESS 0xd00063be FORMAT "%12.7" /end MEASUREMENT
/begin MEASUREMENT nvmy_tqlo.nvmy_dtsysisad.tq_dif_is_ad_conv_neut "Hydraulic converter adaptation torque, with neutral control active" SWORD _CNV_A_R_LINEAR_____31_CM 1 100. -1024. 1023.96875 DISPLAY_IDENTIFIER TQ_DIF_IS_AD_CONV_NEUT ECU_ADDRESS 0xd00063c2 FORMAT "%11.5" /end MEASUREMENT
/begin MEASUREMENT nvmy_tqlo.nvmy_dtsysisad.tq_dif_is_ad_conv_1_opm_1 "Hydraulic converter adaptation torque, intermediate value with high resolution (long signed word) OPM1" SLONG _CNV_A_R_LINEAR_____235_CM 1 100. -1024. 1023.99999952 DISPLAY_IDENTIFIER TQ_DIF_IS_AD_CONV_1_OPM_1 ECU_ADDRESS 0xd00063c4 FORMAT "%12.7" /end MEASUREMENT
/begin MEASUREMENT nvmy_tqlo.nvmy_dtsysisad.tq_dif_is_ad_conv_1_opm_2 "Hydraulic converter adaptation torque, intermediate value with high resolution (long signed word) OPM2" SLONG _CNV_A_R_LINEAR_____235_CM 1 100. -1024. 1023.99999952 DISPLAY_IDENTIFIER TQ_DIF_IS_AD_CONV_1_OPM_2 ECU_ADDRESS 0xd00063c8 FORMAT "%12.7" /end MEASUREMENT
/begin MEASUREMENT nvmy_tqlo.nvmy_dtsysisad.tq_dif_is_ad_acc_conv_opm_1 "ACC and Hydraulic converter torque adaptation, intermediate value with high resolution (long signed word) OPM1" SLONG _CNV_A_R_LINEAR_____235_CM 1 100. -1024. 1023.99999952 DISPLAY_IDENTIFIER TQ_DIF_IS_AD_ACC_CONV_OPM_1 ECU_ADDRESS 0xd00063cc FORMAT "%12.7" /end MEASUREMENT
/begin MEASUREMENT nvmy_tqlo.nvmy_dtsysisad.tq_dif_is_ad_acc_conv_opm_2 "ACC and Hydraulic converter torque adaptation, intermediate value with high resolution (long signed word) OPM2" SLONG _CNV_A_R_LINEAR_____235_CM 1 100. -1024. 1023.99999952 DISPLAY_IDENTIFIER TQ_DIF_IS_AD_ACC_CONV_OPM_2 ECU_ADDRESS 0xd00063d0 FORMAT "%12.7" /end MEASUREMENT
/begin MEASUREMENT nvmy_tqlo.nvmy_dtsysisad.tq_dif_is_ad_conv_1 "Hydraulic converter adaptation torque, with neutralcontrol passive" SWORD _CNV_A_R_LINEAR_____31_CM 1 100. -1024. 1023.96875 DISPLAY_IDENTIFIER TQ_DIF_IS_AD_CONV_1 ECU_ADDRESS 0xd00063d4 FORMAT "%11.5" /end MEASUREMENT
/begin MEASUREMENT nvmy_tqlo.nvmy_dtsysisad.tq_dif_is_ad_acc_neut "ACC and Hydraulic converter adaptation torque, with neutral control active" SWORD _CNV_A_R_LINEAR_____31_CM 1 100. -1024. 1023.96875 DISPLAY_IDENTIFIER TQ_DIF_IS_AD_ACC_NEUT ECU_ADDRESS 0xd00063d6 FORMAT "%11.5" /end MEASUREMENT
/begin MEASUREMENT nvmy_tqlo.nvmy_dtsysisad.tq_dif_is_ad_acc_conv "ACC and Hydraulic converter torque adaptation" SWORD _CNV_A_R_LINEAR_____31_CM 1 100. -1024. 1023.96875 DISPLAY_IDENTIFIER TQ_DIF_IS_AD_ACC_CONV ECU_ADDRESS 0xd00063d8 FORMAT "%11.5" /end MEASUREMENT
/begin MEASUREMENT nvmy_tqlo.nvmy_dtsysisad.tq_dif_is_ad_acc_1 "ACC torque adaptation" SWORD _CNV_A_R_LINEAR_____31_CM 1 100. -1024. 1023.96875 DISPLAY_IDENTIFIER TQ_DIF_IS_AD_ACC_1 ECU_ADDRESS 0xd00063da FORMAT "%11.5" /end MEASUREMENT
/begin MEASUREMENT nvmy_tqlo.nvmy_dtsysisad.tq_dif_is_ad_acc_neut_opm_1 "ACC and Hydraulic converter torque adaptation, with neutral control active, intermediate value with high resolution (long signed word) OPM1" SLONG _CNV_A_R_LINEAR_____235_CM 1 100. -1024. 1023.99999952 DISPLAY_IDENTIFIER TQ_DIF_IS_AD_ACC_NEUT_OPM_1 ECU_ADDRESS 0xd00063dc FORMAT "%12.7" /end MEASUREMENT
/begin MEASUREMENT nvmy_tqlo.nvmy_dtsysisad.tq_dif_is_ad_acc_neut_opm_2 "ACC and Hydraulic converter torque adaptation, with neutral control active, intermediate value with high resolution (long signed word) OPM2" SLONG _CNV_A_R_LINEAR_____235_CM 1 100. -1024. 1023.99999952 DISPLAY_IDENTIFIER TQ_DIF_IS_AD_ACC_NEUT_OPM_2 ECU_ADDRESS 0xd00063e0 FORMAT "%12.7" /end MEASUREMENT
/begin MEASUREMENT nvmy_tqlo.nvmy_dtsysisad.tq_dif_is_ad_conv_neut_opm_1 "Hydraulic converter adaptation torque, with neutral control active, intermediate value with high resolution (long signed word) OPM1" SLONG _CNV_A_R_LINEAR_____235_CM 1 100. -1024. 1023.99999952 DISPLAY_IDENTIFIER TQ_DIF_IS_AD_CONV_NEUT_OPM_1 ECU_ADDRESS 0xd00063e4 FORMAT "%12.7" /end MEASUREMENT
/begin MEASUREMENT nvmy_tqlo.nvmy_dtsysisad.tq_dif_is_ad_conv_neut_opm_2 "Hydraulic converter adaptation torque, with neutral control active, intermediate value with high resolution (long signed word) OPM2" SLONG _CNV_A_R_LINEAR_____235_CM 1 100. -1024. 1023.99999952 DISPLAY_IDENTIFIER TQ_DIF_IS_AD_CONV_NEUT_OPM_2 ECU_ADDRESS 0xd00063e8 FORMAT "%12.7" /end MEASUREMENT
/begin MEASUREMENT tco_mes "measured coolant temperature" UBYTE _CNV_A_R_LINEAR_____17_CM 1 100. -48. 142.5 DISPLAY_IDENTIFIER TCO_MES ECU_ADDRESS 0xd0007566 FORMAT "%6.2" /end MEASUREMENT
/begin MEASUREMENT tco_st "coolant temperature at start" UBYTE _CNV_A_R_LINEAR_____17_CM 1 100. -48. 142.5 DISPLAY_IDENTIFIER TCO_ST ECU_ADDRESS 0xd0007567 FORMAT "%6.2" /end MEASUREMENT
/begin MEASUREMENT tco "coolant temperature" UBYTE _CNV_A_R_LINEAR_____17_CM 1 100. -48. 142.5 DISPLAY_IDENTIFIER TCO ECU_ADDRESS 0xd0007561 FORMAT "%6.2" /end MEASUREMENT
/begin MEASUREMENT lv_cdn_ini_tco "Boolean for coolant temperature initialisation conditions" UBYTE _CNV_S_2_RANGE__0___1_CM 1 100. 0. 1. DISPLAY_IDENTIFIER LV_CDN_INI_TCO ECU_ADDRESS 0xd00026b0 BIT_MASK 0x1 /end MEASUREMENT
/begin CHARACTERISTIC ip_tco_mes "Linearization of the coolant temperature sensor voltage for temperature acquisition " CURVE 0xa08027fc _REC_CUR_20_u1_u2 28.575 _CNV_A_R_LINEAR_____17_CM -48. 142.5 DISPLAY_IDENTIFIER IP_TCO_MES FORMAT "%6.2"
 /begin AXIS_DESCR COM_AXIS vp_tco[0] _CNV_A_R_LINEAR_____172_CM 16 0. 4.999847 FORMAT "%6.4" AXIS_PTS_REF ldp_vp_tco_ip_tco_mes /end AXIS_DESCR
/end CHARACTERISTIC
/begin CHARACTERISTIC c_tco_mes_grd_max "Maximum permissible temperature gradient for coolant temperature gradient monitoring" VALUE 0xa08028ad _REC_VAL_20_u1 190.5 _CNV_A_R_LINEAR_____25_CM 0. 190.5 DISPLAY_IDENTIFIER C_TCO_MES_GRD_MAX FORMAT "%6.2" /end CHARACTERISTIC
/begin CHARACTERISTIC c_tco_ini_tia_im "Coolant temperature initialization value in case of a coolant- and intake air- temperature failure" VALUE 0xa08028ac _REC_VAL_20_u1 190.5 _CNV_A_R_LINEAR_____17_CM -48. 142.5 DISPLAY_IDENTIFIER C_TCO_INI_TIA_IM FORMAT "%6.2" /end CHARACTERISTIC
/begin MEASUREMENT tco_stop "Coolant temperature at transition to engine stop ( ES )" UBYTE _CNV_A_R_LINEAR_____17_CM 1 100. -48. 142.5 DISPLAY_IDENTIFIER TCO_STOP ECU_ADDRESS 0xd0007568 FORMAT "%6.2" /end MEASUREMENT
/begin AXIS_PTS ldp_tia_im_ip_tco_ini_tia_im "" 0xa08026ba tia_im _REC_AXS_20_u1 190.5 _CNV_A_R_LINEAR_____17_CM 6 -48. 142.5 FORMAT "%6.2" /end AXIS_PTS
/begin CHARACTERISTIC ip_tco_ini_tia_im "Coolant temperature initialization value in case of a coolant temperature failure" CURVE 0xa08027f4 _REC_CUR_20_u1_u1 28.575 _CNV_A_R_LINEAR_____17_CM -48. 142.5 DISPLAY_IDENTIFIER IP_TCO_INI_TIA_IM FORMAT "%6.2"
 /begin AXIS_DESCR COM_AXIS tia_im _CNV_A_R_LINEAR_____17_CM 6 -48. 142.5 FORMAT "%6.2" AXIS_PTS_REF ldp_tia_im_ip_tco_ini_tia_im /end AXIS_DESCR
/end CHARACTERISTIC
/begin AXIS_PTS ldp_vp_tco_ip_tco_mes "" 0xa0802700 vp_tco[0] _REC_AXS_20_u2 4.4998623 _CNV_A_R_LINEAR_____172_CM 16 0. 4.999847 FORMAT "%6.4" /end AXIS_PTS
/begin MEASUREMENT vp_tco[0] "Coolant temperature sensor raw acquisition." UWORD _CNV_A_R_LINEAR_____172_CM 1 100. 0. 4.999847 DISPLAY_IDENTIFIER VP_TCO[1] ECU_ADDRESS 0xd000674c FORMAT "%6.4" /end MEASUREMENT
/begin MEASUREMENT vp_tco[1] "Coolant temperature sensor (radiator outlet) raw acquisition." UWORD _CNV_A_R_LINEAR_____172_CM 1 100. 0. 4.999847 DISPLAY_IDENTIFIER VP_TCO[2] ECU_ADDRESS 0xd000674e FORMAT "%6.4" /end MEASUREMENT
/begin CHARACTERISTIC c_t_n_perc_ecf_act "Time condition for electric fan during self diagnostic" VALUE 0xa080289e _REC_VAL_20_u1 51. _CNV_A_R_LINEAR_____438_CM 0. 51. DISPLAY_IDENTIFIER C_T_N_PERC_ECF_ACT FORMAT "%4.1" /end CHARACTERISTIC
/begin CHARACTERISTIC c_n_perc_act_ecf "Set value for N_PERC_ECF" VALUE 0xa0802874 _REC_VAL_20_u1 99.609375 _CNV_A_R_LINEAR_____5_CM 0. 99.609375 DISPLAY_IDENTIFIER C_N_PERC_ACT_ECF FORMAT "%9.6" /end CHARACTERISTIC
/begin CHARACTERISTIC c_ecfpwm_ecf_man "Manual ECFPWM_ECF" VALUE 0xa0802856 _REC_VAL_20_u1 99.609375 _CNV_A_R_LINEAR_____5_CM 0. 99.609375 DISPLAY_IDENTIFIER C_ECFPWM_ECF_MAN FORMAT "%9.6" /end CHARACTERISTIC
/begin CHARACTERISTIC lc_ecfpwm_ecf_man "constant switch to manual ECFPWM_ECF activation" VALUE 0xa08028cd _REC_VAL_20_u1 1. _CNV_A_R_LINEAR_____0_CM 0. 1. DISPLAY_IDENTIFIER LC_ECFPWM_ECF_MAN FORMAT "%2.0" /end CHARACTERISTIC
/begin MEASUREMENT ecfpwm_igk_off "Electric fan pulse width modulation in the self-holding phase" UBYTE _CNV_A_R_LINEAR_____5_CM 1 100. 0. 99.609375 DISPLAY_IDENTIFIER ECFPWM_IGK_OFF ECU_ADDRESS 0xd0007550 FORMAT "%9.6" /end MEASUREMENT
/begin MEASUREMENT ecfpwm[0] "Pulse width modulated output signal for the electric controlled cooling fans" UBYTE _CNV_A_R_LINEAR_____5_CM 1 100. 0. 99.609375 DISPLAY_IDENTIFIER ECFPWM[0] ECU_ADDRESS 0xd000754e FORMAT "%9.6" /end MEASUREMENT
/begin MEASUREMENT ecfpwm[1] "Pulse width modulated output signal for the electric controlled cooling fans" UBYTE _CNV_A_R_LINEAR_____5_CM 1 100. 0. 99.609375 DISPLAY_IDENTIFIER ECFPWM[1] ECU_ADDRESS 0xd000754f FORMAT "%9.6" /end MEASUREMENT
/begin MEASUREMENT t_n_perc_ecf_act "Delay for setting ecfpwm in PWL" UBYTE _CNV_A_R_LINEAR_____438_CM 1 100. 0. 51. DISPLAY_IDENTIFIER T_N_PERC_ECF_ACT ECU_ADDRESS 0xd0002658 FORMAT "%4.1" /end MEASUREMENT
/begin CHARACTERISTIC lc_ectpwm_man "Configuration bit for activation of manual PWM output signal adjustment" VALUE 0xa08028ce _REC_VAL_20_u1 1. _CNV_A_R_LINEAR_____0_CM 0. 1. DISPLAY_IDENTIFIER LC_ECTPWM_MAN FORMAT "%1.0" /end CHARACTERISTIC
/begin MEASUREMENT ectpwm "Pulse width modulated output signal for the electronic controlled thermostat" UWORD _CNV_A_R_LINEAR_____8_CM 1 100. 0. 99.99847412109381 DISPLAY_IDENTIFIER ECTPWM ECU_ADDRESS 0xd0006744 /end MEASUREMENT
/begin CHARACTERISTIC c_ectpwm_man "Manual adjustable PWM output signal for the electronic controlled thermostat" VALUE 0xa0802864 _REC_VAL_20_u2 99.99847412109381 _CNV_A_R_LINEAR_____8_CM 0. 99.99847412109381 DISPLAY_IDENTIFIER C_ECTPWM_MAN /end CHARACTERISTIC
/begin CHARACTERISTIC c_ectpwm_ast "calibratable ECTPWM after start" VALUE 0xa0802860 _REC_VAL_20_u2 99.99847412109381 _CNV_A_R_LINEAR_____8_CM 0. 99.99847412109381 DISPLAY_IDENTIFIER C_ECTPWM_AST /end CHARACTERISTIC
/begin CHARACTERISTIC c_t_ectpwm_ast "time for ECTPWM-calculation after start" VALUE 0xa0802899 _REC_VAL_20_u1 255. _CNV_A_R_LINEAR_____36_CM 0. 255. DISPLAY_IDENTIFIER C_T_ECTPWM_AST FORMAT "%3.0" /end CHARACTERISTIC
/begin CHARACTERISTIC c_tco_ectpwm "calibratable TCO-threshold for ECTPWM after start" VALUE 0xa08028ab _REC_VAL_20_u1 190.5 _CNV_A_R_LINEAR_____17_CM -48. 142.5 DISPLAY_IDENTIFIER C_TCO_ECTPWM FORMAT "%6.2" /end CHARACTERISTIC
/begin MEASUREMENT lv_err_th "Boolean for coolant thermostat error" UBYTE _CNV_S_2_RANGE__0___1_CM 1 100. 0. 1. DISPLAY_IDENTIFIER LV_ERR_TH ECU_ADDRESS 0xd0007f06 BIT_MASK 0x1 /end MEASUREMENT
/begin MEASUREMENT tia_min_diag_th "Minimum Intake air temperature value during coolant thermostat diagnosis" UBYTE _CNV_A_R_LINEAR_____17_CM 1 100. -48. 142.5 DISPLAY_IDENTIFIER TIA_MIN_DIAG_TH ECU_ADDRESS 0xd00026a9 FORMAT "%6.2" /end MEASUREMENT
/begin MEASUREMENT t_tco_de_diag_th "Timer for coolant temperature deviation for coolant thermostat diagnosis" UWORD _CNV_A_R_LINEAR_____36_CM 1 100. 0. 65535. DISPLAY_IDENTIFIER T_TCO_DE_DIAG_TH ECU_ADDRESS 0xd0002682 FORMAT "%5.0" /end MEASUREMENT
/begin MEASUREMENT tia_de_diag_th "Intake air temperature deviation value for coolant thermostat diagnosis" UBYTE _CNV_A_R_LINEAR_____17_CM 1 100. -48. 142.5 DISPLAY_IDENTIFIER TIA_DE_DIAG_TH ECU_ADDRESS 0xd00026a7 FORMAT "%6.2" /end MEASUREMENT
/begin MEASUREMENT tco_de_ini_diag_th "Initialization value for coolant temperature deviation for coolant thermostat diagnosis" UBYTE _CNV_A_R_LINEAR_____17_CM 1 100. -48. 142.5 DISPLAY_IDENTIFIER TCO_DE_INI_DIAG_TH ECU_ADDRESS 0xd000269d FORMAT "%6.2" /end MEASUREMENT
/begin MEASUREMENT lv_tco_de_max_diag_th "Boolean for high coolant temperature deviation for coolant thermostat diagnosis" UBYTE _CNV_S_2_RANGE__0___1_CM 1 100. 0. 1. DISPLAY_IDENTIFIER LV_TCO_DE_MAX_DIAG_TH ECU_ADDRESS 0xd00026bb BIT_MASK 0x1 /end MEASUREMENT
/begin MEASUREMENT tco_de_diag_th "Coolant temperature deviation value for coolant thermostat diagnosis" UBYTE _CNV_A_R_LINEAR_____17_CM 1 100. -48. 142.5 DISPLAY_IDENTIFIER TCO_DE_DIAG_TH ECU_ADDRESS 0xd000269c FORMAT "%6.2" /end MEASUREMENT
/begin MEASUREMENT tco_diag_th "Coolant temperature of the performed coolant thermostat diagnosis" UBYTE _CNV_A_R_LINEAR_____17_CM 1 100. -48. 142.5 DISPLAY_IDENTIFIER TCO_DIAG_TH ECU_ADDRESS 0xd000269e FORMAT "%6.2" /end MEASUREMENT
/begin CHARACTERISTIC c_tia_st_min_diag_th "Minimum intake air temperature at start for coolant thermostat diagnosis" VALUE 0xa08028ba _REC_VAL_20_u1 190.5 _CNV_A_R_LINEAR_____17_CM -48. 142.5 DISPLAY_IDENTIFIER C_TIA_ST_MIN_DIAG_TH FORMAT "%6.2" /end CHARACTERISTIC
/begin CHARACTERISTIC c_ratio_t_puc_thd_diag_th "\"Pull fuel cut off\" ratio threshold in per cent for coolant thermostat diagnosis" VALUE 0xa0802878 _REC_VAL_20_u1 99.609375 _CNV_A_R_LINEAR_____5_CM 0. 99.609375 DISPLAY_IDENTIFIER C_RATIO_T_PUC_THD_DIAG_TH FORMAT "%9.6" /end CHARACTERISTIC
/begin CHARACTERISTIC c_ratio_t_vs_max_thd_diag_th "\"Vehicle speed maximum\" ratio threshold in per cent for coolant thermostat diagnosis" VALUE 0xa0802879 _REC_VAL_20_u1 99.609375 _CNV_A_R_LINEAR_____5_CM 0. 99.609375 DISPLAY_IDENTIFIER C_RATIO_T_VS_MAX_THD_DIAG_TH FORMAT "%9.6" /end CHARACTERISTIC
/begin CHARACTERISTIC c_ratio_t_vs_min_thd_diag_th "\"Vehicle speed minimum\" ratio threshold in per cent for coolant thermostat diagnosis" VALUE 0xa080287a _REC_VAL_20_u1 99.609375 _CNV_A_R_LINEAR_____5_CM 0. 99.609375 DISPLAY_IDENTIFIER C_RATIO_T_VS_MIN_THD_DIAG_TH FORMAT "%9.6" /end CHARACTERISTIC
/begin CHARACTERISTIC c_ratio_t_load_min_thd_diag_th " \"Engine load minimum\" ratio threshold in per cent for coolant thermostat diagnosis" VALUE 0xa0802877 _REC_VAL_20_u1 99.609375 _CNV_A_R_LINEAR_____5_CM 0. 99.609375 DISPLAY_IDENTIFIER C_RATIO_T_LOAD_MIN_THD_DIAG_TH FORMAT "%9.6" /end CHARACTERISTIC
/begin CHARACTERISTIC c_n_max_diag_th "Maximum engine speed for high coolant temperature deviation detection for coolant thermostat diagnosis" VALUE 0xa0802870 _REC_VAL_20_u2 8160. _CNV_A_R_LINEAR_____14_CM 0. 8160. DISPLAY_IDENTIFIER C_N_MAX_DIAG_TH FORMAT "%4.0" /end CHARACTERISTIC
/begin CHARACTERISTIC c_t_tco_de_diag_th "Time for high coolant temperature deviation detection for coolant thermostat diagnosis" VALUE 0xa08028a0 _REC_VAL_20_u2 65535. _CNV_A_R_LINEAR_____36_CM 0. 65535. DISPLAY_IDENTIFIER C_T_TCO_DE_DIAG_TH FORMAT "%5.0" /end CHARACTERISTIC
/begin CHARACTERISTIC c_tco_st_max_diag_th "Maximum coolant temperature at start for coolant thermostat diagnosis" VALUE 0xa08028b1 _REC_VAL_20_u1 190.5 _CNV_A_R_LINEAR_____17_CM -48. 142.5 DISPLAY_IDENTIFIER C_TCO_ST_MAX_DIAG_TH FORMAT "%6.2" /end CHARACTERISTIC
/begin CHARACTERISTIC c_tia_de_max_diag_th "Maximum intake air temperature deviation for coolant thermostat diagnosis" VALUE 0xa08028b8 _REC_VAL_20_u1 190.5 _CNV_A_R_LINEAR_____17_CM -48. 142.5 DISPLAY_IDENTIFIER C_TIA_DE_MAX_DIAG_TH FORMAT "%6.2" /end CHARACTERISTIC
/begin CHARACTERISTIC c_tco_de_max_diag_th "Maximum coolant temperature deviation for coolant thermostat diagnosis" VALUE 0xa08028aa _REC_VAL_20_u1 190.5 _CNV_A_R_LINEAR_____17_CM -48. 142.5 DISPLAY_IDENTIFIER C_TCO_DE_MAX_DIAG_TH FORMAT "%6.2" /end CHARACTERISTIC
/begin CHARACTERISTIC c_tco_th_open_diag_th "Regulation temperature for coolant thermostat opening" VALUE 0xa08028b6 _REC_VAL_20_u1 190.5 _CNV_A_R_LINEAR_____17_CM -48. 142.5 DISPLAY_IDENTIFIER C_TCO_TH_OPEN_DIAG_TH FORMAT "%6.2" /end CHARACTERISTIC
/begin CHARACTERISTIC c_tco_st_min_diag_th "Minimum coolant temperature at start for coolant thermostat diagnosis" VALUE 0xa08028b3 _REC_VAL_20_u1 190.5 _CNV_A_R_LINEAR_____17_CM -48. 142.5 DISPLAY_IDENTIFIER C_TCO_ST_MIN_DIAG_TH FORMAT "%6.2" /end CHARACTERISTIC
/begin CHARACTERISTIC c_tco_wup_min_diag_th "Minimum coolant warm up temperature for coolant thermostat diagnosis" VALUE 0xa08028b7 _REC_VAL_20_u1 190.5 _CNV_A_R_LINEAR_____17_CM -48. 142.5 DISPLAY_IDENTIFIER C_TCO_WUP_MIN_DIAG_TH FORMAT "%6.2" /end CHARACTERISTIC
/begin MEASUREMENT lv_end_diag_rbm_th "Boolean for end of coolant thermostat diagnosis for RBM" UBYTE _CNV_S_2_RANGE__0___1_CM 1 100. 0. 1. DISPLAY_IDENTIFIER LV_END_DIAG_RBM_TH ECU_ADDRESS 0xd0007572 BIT_MASK 0x1 /end MEASUREMENT
/begin MEASUREMENT lv_act_diag_th "Boolean for coolant thermostat diagnosis activated" UBYTE _CNV_S_2_RANGE__0___1_CM 1 100. 0. 1. DISPLAY_IDENTIFIER LV_ACT_DIAG_TH ECU_ADDRESS 0xd000756d BIT_MASK 0x1 /end MEASUREMENT
/begin MEASUREMENT lv_act_diag_rbm_th "Boolean for coolant thermostat diagnosis activated for RBM" UBYTE _CNV_S_2_RANGE__0___1_CM 1 100. 0. 1. DISPLAY_IDENTIFIER LV_ACT_DIAG_RBM_TH ECU_ADDRESS 0xd000756c BIT_MASK 0x1 /end MEASUREMENT
/begin MEASUREMENT lv_cnl_diag_th "Boolean for coolant thermostat diagnosis cancelled" UBYTE _CNV_S_2_RANGE__0___1_CM 1 100. 0. 1. DISPLAY_IDENTIFIER LV_CNL_DIAG_TH ECU_ADDRESS 0xd00026b3 BIT_MASK 0x1 /end MEASUREMENT
/begin MEASUREMENT lv_cdn_temp_diag_th "Boolean for coolant thermostat diagnosis cancelled" UBYTE _CNV_S_2_RANGE__0___1_CM 1 100. 0. 1. DISPLAY_IDENTIFIER LV_CDN_TEMP_DIAG_TH ECU_ADDRESS 0xd00026b2 BIT_MASK 0x1 /end MEASUREMENT
/begin CHARACTERISTIC c_abc_inc_th "Debounce counter increment - Thermostat heating mechanical diagnosis" VALUE 0xa0802845 _REC_VAL_20_u1 255. _CNV_A_R_LINEAR_____0_CM 0. 255. DISPLAY_IDENTIFIER C_ABC_INC_TH FORMAT "%3.0" /end CHARACTERISTIC
/begin CHARACTERISTIC c_abc_max_th "Debounce counter maximum value - Thermostat heating mechanical diagnosis" VALUE 0xa080284d _REC_VAL_20_u1 254. _CNV_A_R_LINEAR_____0_CM 1. 255. DISPLAY_IDENTIFIER C_ABC_MAX_TH FORMAT "%3.0" /end CHARACTERISTIC
/begin MEASUREMENT state_rbm_th "Interface of thermostat monitoring with the Rate-Based Monitoring statistics" UBYTE _CNV_A_R_LINEAR_____0_CM 1 100. 0. 7. DISPLAY_IDENTIFIER STATE_RBM_TH ECU_ADDRESS 0xd0007560 FORMAT "%1.0" /end MEASUREMENT
/begin MEASUREMENT lv_inh_diag_th "Boolean for coolant thermostat diagnosis inhibit" UBYTE _CNV_S_2_RANGE__0___1_CM 1 100. 0. 1. DISPLAY_IDENTIFIER LV_INH_DIAG_TH ECU_ADDRESS 0xd0007587 BIT_MASK 0x1 /end MEASUREMENT
/begin MEASUREMENT lv_inh_diag_rbm_th "Boolean for coolant thermostat diagnosis inhibit due to OBD error" UBYTE _CNV_S_2_RANGE__0___1_CM 1 100. 0. 1. DISPLAY_IDENTIFIER LV_INH_DIAG_RBM_TH ECU_ADDRESS 0xd000757e BIT_MASK 0x1 /end MEASUREMENT
/begin MEASUREMENT lv_n_rel_cwp_inh_diag_th "Boolean for coolant thermostat diagnosis inhibit due high cooling water pump speed" UBYTE _CNV_S_2_RANGE__0___1_CM 1 100. 0. 1. DISPLAY_IDENTIFIER LV_N_REL_CWP_INH_DIAG_TH ECU_ADDRESS 0xd00026b9 BIT_MASK 0x1 /end MEASUREMENT
/begin MEASUREMENT lv_tia_de_inh_diag_th "Boolean for coolant thermostat diagnosis inhibit due high intake air temperature deviation" UBYTE _CNV_S_2_RANGE__0___1_CM 1 100. 0. 1. DISPLAY_IDENTIFIER LV_TIA_DE_INH_DIAG_TH ECU_ADDRESS 0xd00026bc BIT_MASK 0x1 /end MEASUREMENT
/begin MEASUREMENT mass_vol_cwp_diag_th "Cooling water pump effected coolant mass volume for coolant thermostat diagnosis" UWORD _CNV_A_R_LINEAR_____0_CM 1 100. 0. 65535. DISPLAY_IDENTIFIER MASS_VOL_CWP_DIAG_TH ECU_ADDRESS 0xd0002666 FORMAT "%5.0" /end MEASUREMENT
/begin MEASUREMENT tia_min_inh_diag_th "Minimum Intake air temperature value during coolant thermostat diagnosis for inhibition" UBYTE _CNV_A_R_LINEAR_____17_CM 1 100. -48. 142.5 DISPLAY_IDENTIFIER TIA_MIN_INH_DIAG_TH ECU_ADDRESS 0xd00026aa FORMAT "%6.2" /end MEASUREMENT
/begin MEASUREMENT tia_de_inh_diag_th "Intake air temperature deviation value for coolant thermostat diagnosis inhibition" UBYTE _CNV_A_R_LINEAR_____17_CM 1 100. -48. 142.5 DISPLAY_IDENTIFIER TIA_DE_INH_DIAG_TH ECU_ADDRESS 0xd00026a8 FORMAT "%6.2" /end MEASUREMENT
/begin CHARACTERISTIC c_tia_de_max_inh_diag_th "Maximum intake air temperature deviation for coolant thermostat diagnosis inhibition" VALUE 0xa08028b9 _REC_VAL_20_u1 190.5 _CNV_A_R_LINEAR_____17_CM -48. 142.5 DISPLAY_IDENTIFIER C_TIA_DE_MAX_INH_DIAG_TH FORMAT "%6.2" /end CHARACTERISTIC
/begin CHARACTERISTIC c_tam_min_diag_th "Minimum TAM for coolant thermostat diagnosis" VALUE 0xa08028a2 _REC_VAL_20_u1 190.5 _CNV_A_R_LINEAR_____17_CM -48. 142.5 DISPLAY_IDENTIFIER C_TAM_MIN_DIAG_TH FORMAT "%6.2" /end CHARACTERISTIC
/begin CHARACTERISTIC c_n_rel_cwp_min_diag_th "Minimum cooling water pump speed for coolant thermostat diagnosis" VALUE 0xa0802875 _REC_VAL_20_u1 255. _CNV_A_R_LINEAR_____0_CM 0. 255. DISPLAY_IDENTIFIER C_N_REL_CWP_MIN_DIAG_TH FORMAT "%3.0" /end CHARACTERISTIC
/begin CHARACTERISTIC c_mass_vol_cwp_min_diag_th "Minimum cooling water pump effected coolant mass volume for coolant thermostat diagnosis" VALUE 0xa080286e _REC_VAL_20_u2 65535. _CNV_A_R_LINEAR_____0_CM 0. 65535. DISPLAY_IDENTIFIER C_MASS_VOL_CWP_MIN_DIAG_TH FORMAT "%5.0" /end CHARACTERISTIC
/begin CHARACTERISTIC c_mass_vol_cwp_max "Cooling water pump effected coolant mass volume increment for coolant thermostat diagnosis" VALUE 0xa080286c _REC_VAL_20_u2 65535. _CNV_A_R_LINEAR_____0_CM 0. 65535. DISPLAY_IDENTIFIER C_MASS_VOL_CWP_MAX FORMAT "%5.0" /end CHARACTERISTIC
/begin MEASUREMENT mass_vol_cwp_diag_th_tmp "Cooling water pump effected coolant mass volume for coolant thermostat diagnosis" UWORD _CNV_A_R_LINEAR_____0_CM 1 100. 0. 65535. DISPLAY_IDENTIFIER MASS_VOL_CWP_DIAG_TH_TMP ECU_ADDRESS 0xd0002668 FORMAT "%5.0" /end MEASUREMENT
/begin MEASUREMENT t_ectpwm_inh_diag_th "Max.time for ECTPWM exceeding threshold - for coolant thermostat diagnosis" UBYTE _CNV_A_R_LINEAR_____36_CM 1 100. 0. 255. DISPLAY_IDENTIFIER T_ECTPWM_INH_DIAG_TH ECU_ADDRESS 0xd0002697 FORMAT "%3.0" /end MEASUREMENT
/begin MEASUREMENT t_ecfpwm_inh_diag_th "Max.time for ECFPWM exceeding threshold - for coolant fan diagnosis" UBYTE _CNV_A_R_LINEAR_____36_CM 1 100. 0. 255. DISPLAY_IDENTIFIER T_ECFPWM_INH_DIAG_TH ECU_ADDRESS 0xd0002696 FORMAT "%3.0" /end MEASUREMENT
/begin MEASUREMENT lv_ectpwm_inh_diag_th "Condition for ECTPWM exceeding threshold - for coolant thermostat diagnosis" UBYTE _CNV_S_2_RANGE__0___1_CM 1 100. 0. 1. DISPLAY_IDENTIFIER LV_ECTPWM_INH_DIAG_TH ECU_ADDRESS 0xd00026b5 BIT_MASK 0x1 /end MEASUREMENT
/begin MEASUREMENT lv_ecfpwm_inh_diag_th "Condition for ECFPWM exceeding threshold - for coolant fan diagnosis" UBYTE _CNV_S_2_RANGE__0___1_CM 1 100. 0. 1. DISPLAY_IDENTIFIER LV_ECFPWM_INH_DIAG_TH ECU_ADDRESS 0xd00026b4 BIT_MASK 0x1 /end MEASUREMENT
/begin CHARACTERISTIC c_t_ectpwm_inh_diag_th "Max.time for ECTPWM exceeding threshold - for coolant thermostat diagnosis" VALUE 0xa080289a _REC_VAL_20_u1 255. _CNV_A_R_LINEAR_____36_CM 0. 255. DISPLAY_IDENTIFIER C_T_ECTPWM_INH_DIAG_TH FORMAT "%3.0" /end CHARACTERISTIC
/begin CHARACTERISTIC c_t_ecfpwm_inh_diag_th "Max.time for ECFPWM exceeding threshold - for coolant fan diagnosis" VALUE 0xa0802898 _REC_VAL_20_u1 255. _CNV_A_R_LINEAR_____36_CM 0. 255. DISPLAY_IDENTIFIER C_T_ECFPWM_INH_DIAG_TH FORMAT "%3.0" /end CHARACTERISTIC
/begin CHARACTERISTIC c_ectpwm_inh_diag_th "Max. ECTPWM to deactivate coolant thermostat diagnosis" VALUE 0xa0802862 _REC_VAL_20_u2 99.99847412109381 _CNV_A_R_LINEAR_____8_CM 0. 99.99847412109381 DISPLAY_IDENTIFIER C_ECTPWM_INH_DIAG_TH /end CHARACTERISTIC
/begin CHARACTERISTIC c_ecfpwm_inh_diag_th[0] "Max. ECFPWM to deactivate coolant fan diagnosis" VALUE 0xa0802858 _REC_VAL_20_u1 99.609375 _CNV_A_R_LINEAR_____5_CM 0. 99.609375 DISPLAY_IDENTIFIER C_ECFPWM_INH_DIAG_TH[0] /end CHARACTERISTIC
/begin CHARACTERISTIC c_ecfpwm_inh_diag_th[1] "Max. ECFPWM to deactivate coolant fan diagnosis" VALUE 0xa0802859 _REC_VAL_20_u1 99.609375 _CNV_A_R_LINEAR_____5_CM 0. 99.609375 DISPLAY_IDENTIFIER C_ECFPWM_INH_DIAG_TH[1] /end CHARACTERISTIC
/begin AXIS_PTS ldp_tco_sub_id_n_rel_cwp_max "" 0xa080268c tco_sub _REC_AXS_20_u2 190.5 _CNV_A_R_LINEAR_____439_CM 6 -48. 142.5 FORMAT "%7.3" /end AXIS_PTS
/begin CHARACTERISTIC id_n_rel_cwp_max_diag_th "Maximum cooling water pump speed for coolant thermostat diagnosis" CURVE 0xa080273e _REC_CUR_20_u1_u2 255. _CNV_A_R_LINEAR_____0_CM 0. 255. DISPLAY_IDENTIFIER ID_N_REL_CWP_MAX_DIAG_TH FORMAT "%3.0"
 /begin AXIS_DESCR COM_AXIS tco_sub _CNV_A_R_LINEAR_____439_CM 6 -48. 142.5 FORMAT "%7.3" AXIS_PTS_REF ldp_tco_sub_id_n_rel_cwp_max /end AXIS_DESCR
/end CHARACTERISTIC
/begin CHARACTERISTIC c_t_n_rel_cwp_max_diag_th "Max. time for CWP speed exceeding threshold before coolant thermostat diagnosis inhibition" VALUE 0xa080289f _REC_VAL_20_u1 255. _CNV_A_R_LINEAR_____36_CM 0. 255. DISPLAY_IDENTIFIER C_T_N_REL_CWP_MAX_DIAG_TH FORMAT "%3.0" /end CHARACTERISTIC
/begin MEASUREMENT t_n_rel_cwp_max_diag_th "Max. time for CWP speed exceeding threshold before coolant thermostat diagnosis inhibition" UBYTE _CNV_A_R_LINEAR_____36_CM 1 100. 0. 255. DISPLAY_IDENTIFIER T_N_REL_CWP_MAX_DIAG_TH ECU_ADDRESS 0xd0002698 FORMAT "%3.0" /end MEASUREMENT
/begin CHARACTERISTIC c_t_dly_tco_sub_is_2 "Delay time after idle speed to activate the coolant temperature substitute value calculation" VALUE 0xa080288c _REC_VAL_20_u2 65535. _CNV_A_R_LINEAR_____36_CM 0. 65535. DISPLAY_IDENTIFIER C_T_DLY_TCO_SUB_IS_2 FORMAT "%5.0" /end CHARACTERISTIC
/begin CHARACTERISTIC c_t_dly_tco_sub_puc "Delay time after pull fuel cutoff to activate the coolant temperature substitute value calculation" VALUE 0xa080288e _REC_VAL_20_u2 65535. _CNV_A_R_LINEAR_____36_CM 0. 65535. DISPLAY_IDENTIFIER C_T_DLY_TCO_SUB_PUC FORMAT "%5.0" /end CHARACTERISTIC
/begin MEASUREMENT lv_cdn_ena_tco_sub "Boolean for coolant temperature substitute model initialisation condition" UBYTE _CNV_S_2_RANGE__0___1_CM 1 100. 0. 1. DISPLAY_IDENTIFIER LV_CDN_ENA_TCO_SUB ECU_ADDRESS 0xd00026af BIT_MASK 0x1 /end MEASUREMENT
/begin MEASUREMENT tco_sub "Coolant temperature substitute value" UWORD _CNV_A_R_LINEAR_____439_CM 1 100. -48. 142.5 DISPLAY_IDENTIFIER TCO_SUB ECU_ADDRESS 0xd0006748 FORMAT "%7.3" /end MEASUREMENT
/begin MEASUREMENT tco_sub_inc "Coolant temperature substitute increment value" UWORD _CNV_A_R_LINEAR_____439_CM 1 100. -48. 142.5 DISPLAY_IDENTIFIER TCO_SUB_INC ECU_ADDRESS 0xd0002688 FORMAT "%7.3" /end MEASUREMENT
/begin AXIS_PTS ldp_maf_kgh_ip_tco_sub_inc "" 0xa080263c maf_kgh _REC_AXS_20_u2 2047.96875 _CNV_A_R_LINEAR_____215_CM 6 0. 2047.96875 FORMAT "%10.5" /end AXIS_PTS
/begin CHARACTERISTIC ip_tco_sub_dec "Decrement value for the coolant temperature substitute value calculation" MAP 0xa080f2e8 _REC_MAP_20_u2_u2_u1 38.1 _CNV_A_R_ENTE_LINEA_440_CM 0. 190.5 DISPLAY_IDENTIFIER IP_TCO_SUB_DEC FORMAT "%7.3"
 /begin AXIS_DESCR COM_AXIS tco_sub _CNV_A_R_LINEAR_____439_CM 6 -48. 142.5 FORMAT "%7.3" AXIS_PTS_REF ldp_tco_sub_ip_tco_sub_dec /end AXIS_DESCR
 /begin AXIS_DESCR COM_AXIS tam _CNV_A_R_LINEAR_____17_CM 6 -48. 142.5 FORMAT "%6.2" AXIS_PTS_REF ldp_tam_ip_tco_sub_dec /end AXIS_DESCR
/end CHARACTERISTIC
/begin AXIS_PTS ldp_tco_sub_ip_fac_tco_sub_inc "" 0xa080269c tco_sub _REC_AXS_20_u2 190.5 _CNV_A_R_LINEAR_____439_CM 6 -48. 142.5 FORMAT "%7.3" /end AXIS_PTS
/begin AXIS_PTS ldp_tam_ip_tco_sub_dec "" 0xa080265e tam _REC_AXS_20_u1 190.5 _CNV_A_R_LINEAR_____17_CM 6 -48. 142.5 FORMAT "%6.2" /end AXIS_PTS
/begin CHARACTERISTIC c_fac_tco_sub_cor "Multiple Coolant temperature substitute value correction factor" VALUE 0xa0802868 _REC_VAL_20_u1 1.9921875 _CNV_A_R_LINEAR_____103_CM 0. 1.9921875 DISPLAY_IDENTIFIER C_FAC_TCO_SUB_COR FORMAT "%8.6" /end CHARACTERISTIC
/begin MEASUREMENT fac_tco_sub_cor_n_rel_cwp "Coolant temperature substitute value correction factor for CWP functionality" UWORD _CNV_A_R_LINEAR_____28_CM 1 100. 0. 255.99609375 DISPLAY_IDENTIFIER FAC_TCO_SUB_COR_N_REL_CWP ECU_ADDRESS 0xd0002662 FORMAT "%10.6" /end MEASUREMENT
/begin MEASUREMENT fac_tco_sub_cor_state_coc "Coolant temperature substitute value correction factor after warm-up" UBYTE _CNV_A_R_LINEAR_____441_CM 1 100. 0. 51. DISPLAY_IDENTIFIER FAC_TCO_SUB_COR_STATE_COC ECU_ADDRESS 0xd0002692 FORMAT "%4.1" /end MEASUREMENT
/begin MEASUREMENT t_dly_tco_sub "Delay time counter for coolant temperature substitute value calculation during pull fuel cutoff or idle speed" UWORD _CNV_A_R_LINEAR_____36_CM 1 100. 0. 65535. DISPLAY_IDENTIFIER T_DLY_TCO_SUB ECU_ADDRESS 0xd0002674 FORMAT "%5.0" /end MEASUREMENT
/begin MEASUREMENT t_dly_tco_sub_cor_state_coc "Delay time counter for coolant temperature substitute value calculation after warm-up" UWORD _CNV_A_R_LINEAR_____36_CM 1 100. 0. 65535. DISPLAY_IDENTIFIER T_DLY_TCO_SUB_COR_STATE_COC ECU_ADDRESS 0xd0002676 FORMAT "%5.0" /end MEASUREMENT
/begin CHARACTERISTIC ip_fac_tco_sub_inc "Increment factor for the coolant temperature substitute value calculation" MAP 0xa0802780 _REC_MAP_20_u1_u2_u2 0.19921875 _CNV_A_R_LINEAR_____28_CM 0. 0.99609375 DISPLAY_IDENTIFIER IP_FAC_TCO_SUB_INC FORMAT "%5.3"
 /begin AXIS_DESCR COM_AXIS maf_kgh _CNV_A_R_LINEAR_____215_CM 6 0. 2047.96875 FORMAT "%10.5" AXIS_PTS_REF ldp_maf_kgh_ip_fac_tco_sub_inc /end AXIS_DESCR
 /begin AXIS_DESCR COM_AXIS tco_sub _CNV_A_R_LINEAR_____439_CM 6 -48. 142.5 FORMAT "%7.3" AXIS_PTS_REF ldp_tco_sub_ip_fac_tco_sub_inc /end AXIS_DESCR
/end CHARACTERISTIC
/begin AXIS_PTS ldp_tco_sub_ip_tco_sub_dec "" 0xa08026ac tco_sub _REC_AXS_20_u2 190.5 _CNV_A_R_LINEAR_____439_CM 6 -48. 142.5 FORMAT "%7.3" /end AXIS_PTS
/begin AXIS_PTS ldp_n_rel_cwp_ip_fac_tco_sub "" 0xa080264a n_rel_cwp _REC_AXS_20_u1 255. _CNV_A_R_LINEAR_____0_CM 4 0. 255. FORMAT "%3.0" /end AXIS_PTS
/begin CHARACTERISTIC ip_fac_tco_sub_cor_n_rel_cwp "Coolant temperature substitute value correction factor dependend on CWP speed" CURVE 0xa080277c _REC_CUR_20_u1_u1 4.98046 _CNV_A_R_LINEAR_____442_CM 0. 4.98046 DISPLAY_IDENTIFIER IP_FAC_TCO_SUB_COR_N_REL_CWP FORMAT "%5.3"
 /begin AXIS_DESCR COM_AXIS n_rel_cwp _CNV_A_R_LINEAR_____0_CM 4 0. 255. FORMAT "%3.0" AXIS_PTS_REF ldp_n_rel_cwp_ip_fac_tco_sub /end AXIS_DESCR
/end CHARACTERISTIC
/begin CHARACTERISTIC c_t_dly_tco_sub_is_1 "Delay time after idle speed to stop the coolant temperature substitute value calculation" VALUE 0xa080288a _REC_VAL_20_u2 65535. _CNV_A_R_LINEAR_____36_CM 0. 65535. DISPLAY_IDENTIFIER C_T_DLY_TCO_SUB_IS_1 FORMAT "%5.0" /end CHARACTERISTIC
/begin CHARACTERISTIC c_fac_tco_sub_cor_state_coc "Coolant temperature substitute value calculation factor after warm-up" VALUE 0xa0802869 _REC_VAL_20_u1 51. _CNV_A_R_LINEAR_____441_CM 0. 51. DISPLAY_IDENTIFIER C_FAC_TCO_SUB_COR_STATE_COC FORMAT "%4.1" /end CHARACTERISTIC
/begin CHARACTERISTIC c_t_dly_tco_sub_cor_state_coc "Delay time after warm-up for coolant temperature substitute value calculation factor" VALUE 0xa0802888 _REC_VAL_20_u2 65535. _CNV_A_R_LINEAR_____36_CM 0. 65535. DISPLAY_IDENTIFIER C_T_DLY_TCO_SUB_COR_STATE_COC FORMAT "%5.0" /end CHARACTERISTIC
/begin CHARACTERISTIC c_t_dly_tco_sub_st_cwp_off "Delay time after start to activate the coolant temperature substitute value calculation for stopped CWP" VALUE 0xa0802890 _REC_VAL_20_u2 6553.5 _CNV_A_R_LINEAR_____4_CM 0. 6553.5 DISPLAY_IDENTIFIER C_T_DLY_TCO_SUB_ST_CWP_OFF FORMAT "%6.1" /end CHARACTERISTIC
/begin CHARACTERISTIC c_t_dly_tco_sub_st_cwp_on "Delay time after start to activate the coolant temperature substitute value calculation for running CWP" VALUE 0xa0802892 _REC_VAL_20_u2 6553.5 _CNV_A_R_LINEAR_____4_CM 0. 6553.5 DISPLAY_IDENTIFIER C_T_DLY_TCO_SUB_ST_CWP_ON FORMAT "%6.1" /end CHARACTERISTIC
/begin CHARACTERISTIC c_n_rel_cwp_thd_coc "CWP speed threshold for detecting running or stopped CWP" VALUE 0xa0802876 _REC_VAL_20_u1 255. _CNV_A_R_LINEAR_____0_CM 0. 255. DISPLAY_IDENTIFIER C_N_REL_CWP_THD_COC FORMAT "%3.0" /end CHARACTERISTIC
/begin MEASUREMENT t_dly_thd_tco_sub_st "Delay time threshold for coolant temperature substitute value depending on CWP speed" UWORD _CNV_A_R_LINEAR_____4_CM 1 100. 0. 6553.5 DISPLAY_IDENTIFIER T_DLY_THD_TCO_SUB_ST ECU_ADDRESS 0xd0002678 FORMAT "%6.1" /end MEASUREMENT
/begin MEASUREMENT fac_tco_sub_cor "Coolant temperature substitute value correction factor" UBYTE _CNV_A_R_LINEAR_____103_CM 1 100. 0. 1.9921875 DISPLAY_IDENTIFIER FAC_TCO_SUB_COR ECU_ADDRESS 0xd0002691 FORMAT "%5.3" /end MEASUREMENT
/begin MEASUREMENT fac_tco_sub_vs "Coolant temperature substitute value vehicle speed correction factor" UWORD _CNV_A_R_CYBL_LINEA_124_CM 1 100. -8. 7.999756 DISPLAY_IDENTIFIER FAC_TCO_SUB_VS ECU_ADDRESS 0xd0002664 FORMAT "%7.5" /end MEASUREMENT
/begin AXIS_PTS ldp_tam_ip_tco_sub_inc "" 0xa0802666 tam _REC_AXS_20_u1 190.5 _CNV_A_R_LINEAR_____17_CM 6 -48. 142.5 FORMAT "%6.2" /end AXIS_PTS
/begin AXIS_PTS ldp_tam_ip_tco_sub_max_tam "" 0xa080266e tam _REC_AXS_20_u1 190.5 _CNV_A_R_LINEAR_____17_CM 6 -48. 142.5 FORMAT "%6.2" /end AXIS_PTS
/begin AXIS_PTS ldp_maf_kgh_ip_fac_tco_sub_inc "" 0xa0802620 maf_kgh _REC_AXS_20_u2 2047.96875 _CNV_A_R_LINEAR_____215_CM 6 0. 2047.96875 FORMAT "%10.5" /end AXIS_PTS
/begin AXIS_PTS ldp_maf_kgh_ip_fac_tco_sub_vs "" 0xa0802630 maf_kgh _REC_AXS_20_u2 2047.96875 _CNV_A_R_LINEAR_____215_CM 4 0. 2047.96875 FORMAT "%10.5" /end AXIS_PTS
/begin AXIS_PTS ldp_vs_ip_fac_tco_sub_vs "" 0xa0802722 vs _REC_AXS_20_u1 255. _CNV_A_R_LINEAR_____6_CM 6 0. 255. FORMAT "%3.0" /end AXIS_PTS
/begin CHARACTERISTIC ip_tco_sub_inc "Increment value for the coolant temperature substitute value calculation" MAP 0xa080f330 _REC_MAP_20_u2_u2_u1 38.1 _CNV_A_R_ENTE_LINEA_440_CM 0. 190.5 DISPLAY_IDENTIFIER IP_TCO_SUB_INC FORMAT "%7.3"
 /begin AXIS_DESCR COM_AXIS maf_kgh _CNV_A_R_LINEAR_____215_CM 6 0. 2047.96875 FORMAT "%10.5" AXIS_PTS_REF ldp_maf_kgh_ip_tco_sub_inc /end AXIS_DESCR
 /begin AXIS_DESCR COM_AXIS tam _CNV_A_R_LINEAR_____17_CM 6 -48. 142.5 FORMAT "%6.2" AXIS_PTS_REF ldp_tam_ip_tco_sub_inc /end AXIS_DESCR
/end CHARACTERISTIC
/begin CHARACTERISTIC ip_tco_sub_max_tam "Coolant temperature substitute maximum value dependend on ambient air temperature" CURVE 0xa0802836 _REC_CUR_20_u1_u1 38.1 _CNV_A_R_LINEAR_____17_CM -48. 142.5 DISPLAY_IDENTIFIER IP_TCO_SUB_MAX_TAM FORMAT "%5.1"
 /begin AXIS_DESCR COM_AXIS tam _CNV_A_R_LINEAR_____17_CM 6 -48. 142.5 FORMAT "%6.2" AXIS_PTS_REF ldp_tam_ip_tco_sub_max_tam /end AXIS_DESCR
/end CHARACTERISTIC
/begin CHARACTERISTIC ip_fac_tco_sub_vs "Coolant temperature substitute value correction factor dependend on vehicle speed and engine load" MAP 0xa08027a4 _REC_MAP_20_u2_u1_u2 3.1999512 _CNV_A_R_CYBL_LINEA_124_CM -8. 7.999756 DISPLAY_IDENTIFIER IP_FAC_TCO_SUB_VS FORMAT "%7.5"
 /begin AXIS_DESCR COM_AXIS vs _CNV_A_R_LINEAR_____6_CM 6 0. 255. FORMAT "%3.0" AXIS_PTS_REF ldp_vs_ip_fac_tco_sub_vs /end AXIS_DESCR
 /begin AXIS_DESCR COM_AXIS maf_kgh _CNV_A_R_LINEAR_____215_CM 4 0. 2047.96875 FORMAT "%10.5" AXIS_PTS_REF ldp_maf_kgh_ip_fac_tco_sub_vs /end AXIS_DESCR
/end CHARACTERISTIC
/begin MEASUREMENT tco_mes_min_diag_tco_stuck "Measured coolant temperature minimum value for coolant temperature stuck signal diagnosis" UBYTE _CNV_A_R_LINEAR_____17_CM 1 100. -48. 142.5 DISPLAY_IDENTIFIER TCO_MES_MIN_DIAG_TCO_STUCK ECU_ADDRESS 0xd00026a2 FORMAT "%6.2" /end MEASUREMENT
/begin MEASUREMENT tco_sub_dif_diag_tco_stuck "Difference of substitute coolant temperature values for coolant temperature stuck signal diagnosis" UBYTE _CNV_A_R_LINEAR_____25_CM 1 100. 0. 190.5 DISPLAY_IDENTIFIER TCO_SUB_DIF_DIAG_TCO_STUCK ECU_ADDRESS 0xd00026a4 FORMAT "%6.2" /end MEASUREMENT
/begin MEASUREMENT tco_sub_max_diag_tco_stuck "Substitute coolant temperature maximum value for coolant temperature stuck signal diagnosis" UBYTE _CNV_A_R_LINEAR_____17_CM 1 100. -48. 142.5 DISPLAY_IDENTIFIER TCO_SUB_MAX_DIAG_TCO_STUCK ECU_ADDRESS 0xd00026a5 FORMAT "%6.2" /end MEASUREMENT
/begin MEASUREMENT tco_sub_min_diag_tco_stuck "Substitute coolant temperature minimum value for coolant temperature stuck signal diagnosis" UBYTE _CNV_A_R_LINEAR_____17_CM 1 100. -48. 142.5 DISPLAY_IDENTIFIER TCO_SUB_MIN_DIAG_TCO_STUCK ECU_ADDRESS 0xd00026a6 FORMAT "%6.2" /end MEASUREMENT
/begin CHARACTERISTIC ip_tco_sub_dif_diag_tco_stuck "Minimum increase of the TCO_SUB value for the coolant temperature stuck signal diagnosis" CURVE 0xa0802830 _REC_CUR_20_u1_u1 190.5 _CNV_A_R_LINEAR_____25_CM 0. 190.5 DISPLAY_IDENTIFIER IP_TCO_SUB_DIF_DIAG_TCO_STUCK FORMAT "%6.2"
 /begin AXIS_DESCR COM_AXIS tco_st _CNV_A_R_LINEAR_____17_CM 6 -48. 142.5 FORMAT "%6.2" AXIS_PTS_REF ldpm_tco_st_1_ente /end AXIS_DESCR
/end CHARACTERISTIC
/begin MEASUREMENT lv_err_tco_stuck "TCO stuck signal detected" UBYTE _CNV_S_2_RANGE__0___1_CM 1 100. 0. 1. DISPLAY_IDENTIFIER LV_ERR_TCO_STUCK ECU_ADDRESS 0xd0007efb BIT_MASK 0x1 /end MEASUREMENT
/begin MEASUREMENT tco_mes_max_diag_tco_stuck "Measured coolant temperature maximum value for coolant temperature stuck signal diagnosis" UBYTE _CNV_A_R_LINEAR_____17_CM 1 100. -48. 142.5 DISPLAY_IDENTIFIER TCO_MES_MAX_DIAG_TCO_STUCK ECU_ADDRESS 0xd00026a1 FORMAT "%6.2" /end MEASUREMENT
/begin MEASUREMENT tco_mes_dif_diag_tco_stuck "Difference of measured coolant temperature values for coolant temperature stuck signal diagnosis" UBYTE _CNV_A_R_LINEAR_____25_CM 1 100. 0. 190.5 DISPLAY_IDENTIFIER TCO_MES_DIF_DIAG_TCO_STUCK ECU_ADDRESS 0xd00026a0 FORMAT "%6.2" /end MEASUREMENT
/begin CHARACTERISTIC ip_tco_mes_dif_diag_tco_stuck "Minimum increase of the TCO value for the coolant temperature stuck signal diagnosis" CURVE 0xa080280c _REC_CUR_20_u1_u1 190.5 _CNV_A_R_LINEAR_____25_CM 0. 190.5 DISPLAY_IDENTIFIER IP_TCO_MES_DIF_DIAG_TCO_STUCK FORMAT "%6.2"
 /begin AXIS_DESCR COM_AXIS tco_st _CNV_A_R_LINEAR_____17_CM 6 -48. 142.5 FORMAT "%6.2" AXIS_PTS_REF ldpm_tco_st_1_ente /end AXIS_DESCR
/end CHARACTERISTIC
/begin MEASUREMENT lv_err_tco_stuck_rng "Boolean for coolant temperature signal stuck in range detected" UBYTE _CNV_S_2_RANGE__0___1_CM 1 100. 0. 1. DISPLAY_IDENTIFIER LV_ERR_TCO_STUCK_RNG ECU_ADDRESS 0xd0007efc BIT_MASK 0x1 /end MEASUREMENT
/begin MEASUREMENT tco_st_stuck_rng "Measured coolant temperature at start" UBYTE _CNV_A_R_LINEAR_____17_CM 1 100. -48. 142.5 DISPLAY_IDENTIFIER TCO_ST_STUCK_RNG ECU_ADDRESS 0xd00026a3 FORMAT "%6.2" /end MEASUREMENT
/begin CHARACTERISTIC ip_tco_st_tco_stuck_rng "Interpolation table for expected coolant temperature value depending on TIA_THR_ST and T_ES" MAP 0xa0802818 _REC_MAP_20_u1_u2_u1 190.5 _CNV_A_R_LINEAR_____17_CM -48. 142.5 DISPLAY_IDENTIFIER IP_TCO_ST_TCO_STUCK_RNG FORMAT "%6.2"
 /begin AXIS_DESCR COM_AXIS t_es _CNV_A_R_LINEAR_____84_CM 4 0. 65535. FORMAT "%5.0" AXIS_PTS_REF ldpm_t_es_tco_stuck_rng /end AXIS_DESCR
 /begin AXIS_DESCR COM_AXIS tia_thr_st _CNV_A_R_LINEAR_____17_CM 6 -48. 142.5 FORMAT "%6.2" AXIS_PTS_REF ldp_tia_thr_st_ip_tco_st /end AXIS_DESCR
/end CHARACTERISTIC
/begin CHARACTERISTIC c_t_es_min_tco_stuck_rng "Constant for minimum required engine off time for diagnosis" VALUE 0xa080289c _REC_VAL_20_u2 65535. _CNV_A_R_LINEAR_____84_CM 0. 65535. DISPLAY_IDENTIFIER C_T_ES_MIN_TCO_STUCK_RNG FORMAT "%5.0" /end CHARACTERISTIC
/begin CHARACTERISTIC c_tia_thr_st_max_tco_stuck_rng "Constant for maximum intake air temperature at throttle at start" VALUE 0xa08028bf _REC_VAL_20_u1 190.5 _CNV_A_R_LINEAR_____17_CM -48. 142.5 DISPLAY_IDENTIFIER C_TIA_THR_ST_MAX_TCO_STUCK_RNG FORMAT "%6.2" /end CHARACTERISTIC
/begin CHARACTERISTIC c_tia_thr_st_min_tco_stuck_rng "Constant for minimum intake air temperature at throttle at start" VALUE 0xa08028c1 _REC_VAL_20_u1 190.5 _CNV_A_R_LINEAR_____17_CM -48. 142.5 DISPLAY_IDENTIFIER C_TIA_THR_ST_MIN_TCO_STUCK_RNG FORMAT "%6.2" /end CHARACTERISTIC
/begin AXIS_PTS ldp_tia_thr_st_ip_tco_st "" 0xa08026d2 tia_thr_st _REC_AXS_20_u1 190.5 _CNV_A_R_LINEAR_____17_CM 6 -48. 142.5 FORMAT "%6.2" /end AXIS_PTS
/begin CHARACTERISTIC ip_tco_st_dif_tia_thr_st "Interpolation table for difference between coolant temperature and intake air temperature at start." CURVE 0xa0802812 _REC_CUR_20_u1_u2 190.5 _CNV_A_R_LINEAR_____25_CM 0. 190.5 DISPLAY_IDENTIFIER IP_TCO_ST_DIF_TIA_THR_ST FORMAT "%6.2"
 /begin AXIS_DESCR COM_AXIS t_es _CNV_A_R_LINEAR_____84_CM 4 0. 65535. FORMAT "%5.0" AXIS_PTS_REF ldpm_t_es_tco_stuck_rng /end AXIS_DESCR
/end CHARACTERISTIC
/begin AXIS_PTS ldpm_t_es_tco_stuck_rng "" 0xa080272c t_es _REC_AXS_20_u2 65535. _CNV_A_R_LINEAR_____84_CM 4 0. 65535. FORMAT "%5.0" /end AXIS_PTS
/begin CHARACTERISTIC c_tia_tam_dif_max_tco_stuck_rng "Constant for difference between ambient temperature and intake air temperature at start" VALUE 0xa08028bb _REC_VAL_20_u1 190.5 _CNV_A_R_LINEAR_____25_CM 0. 190.5 DISPLAY_IDENTIFIER C_TIA_TAM_DIF_MAX_TCO_STUCK_RNG FORMAT "%6.2" /end CHARACTERISTIC
/begin CHARACTERISTIC c_tam_st_min_tco_stuck_rng "constant for minimum ambient temperature at start." VALUE 0xa08028a4 _REC_VAL_20_u1 190.5 _CNV_A_R_LINEAR_____17_CM -48. 142.5 DISPLAY_IDENTIFIER C_TAM_ST_MIN_TCO_STUCK_RNG FORMAT "%6.2" /end CHARACTERISTIC
/begin CHARACTERISTIC c_t_ast_min_tco_stuck_rng "Maximum time after start to enable diagnosis" VALUE 0xa0802884 _REC_VAL_20_u2 6553.5 _CNV_A_R_LINEAR_____4_CM 0. 6553.5 DISPLAY_IDENTIFIER C_T_AST_MIN_TCO_STUCK_RNG FORMAT "%6.1" /end CHARACTERISTIC
/begin MEASUREMENT lv_inh_diag_tco_stuck_rng "Boolean for inhibition of coolant temperature signal stuck in range diagnosis" UBYTE _CNV_S_2_RANGE__0___1_CM 1 100. 0. 1. DISPLAY_IDENTIFIER LV_INH_DIAG_TCO_STUCK_RNG ECU_ADDRESS 0xd0007586 BIT_MASK 0x1 /end MEASUREMENT
/begin MEASUREMENT state_rbm_tco_stuck_rng "Interface of TCO_STUCK_RNG monitor with the Rate-Based Monitoring statistics" UBYTE _CNV_A_R_LINEAR_____0_CM 1 100. 0. 255. DISPLAY_IDENTIFIER STATE_RBM_TCO_STUCK_RNG ECU_ADDRESS 0xd000755f FORMAT "%3.0" /end MEASUREMENT
/begin MEASUREMENT lv_err_tco_plaus "Boolean for coolant temperature plausibility error" UBYTE _CNV_S_2_RANGE__0___1_CM 1 100. 0. 1. DISPLAY_IDENTIFIER LV_ERR_TCO_PLAUS ECU_ADDRESS 0xd0007efd BIT_MASK 0x1 /end MEASUREMENT
/begin MEASUREMENT t_min_diag_tco_plaus "Minimum time to activate the coolant temperature plausibility diagnosis" UWORD _CNV_A_R_LINEAR_____36_CM 1 100. 0. 65535. DISPLAY_IDENTIFIER T_MIN_DIAG_TCO_PLAUS ECU_ADDRESS 0xd000267e FORMAT "%5.0" /end MEASUREMENT
/begin CHARACTERISTIC id_tco_min_diag_tco_plaus "Minimum coolant temperature threshold for coolant temperature plausibility diagnosis" MAP 0xa0802758 _REC_MAP_20_u1_u1_u1 190.5 _CNV_A_R_LINEAR_____17_CM -48. 142.5 DISPLAY_IDENTIFIER ID_TCO_MIN_DIAG_TCO_PLAUS FORMAT "%6.2"
 /begin AXIS_DESCR COM_AXIS tco_st _CNV_A_R_LINEAR_____17_CM 6 -48. 142.5 FORMAT "%6.2" AXIS_PTS_REF ldp_tco_st_id_tco_min_diag_plaus /end AXIS_DESCR
 /begin AXIS_DESCR COM_AXIS ratio_t_is_ast _CNV_A_R_LINEAR_____5_CM 6 0. 99.609375 FORMAT "%9.6" AXIS_PTS_REF ldp_ratio_t_is_ast_id_tco_diag /end AXIS_DESCR
/end CHARACTERISTIC
/begin AXIS_PTS ldp_tia_thr_st_id_t_tco_plaus "" 0xa08026c2 tia_thr_st _REC_AXS_20_u1 190.5 _CNV_A_R_LINEAR_____17_CM 6 -48. 142.5 FORMAT "%6.2" /end AXIS_PTS
/begin MEASUREMENT lv_end_diag_rbm_tco_plaus "Boolean for end of coolant temperature plausibility diagnosis for RBM" UBYTE _CNV_S_2_RANGE__0___1_CM 1 100. 0. 1. DISPLAY_IDENTIFIER LV_END_DIAG_RBM_TCO_PLAUS ECU_ADDRESS 0xd0007571 BIT_MASK 0x1 /end MEASUREMENT
/begin AXIS_PTS ldp_ratio_t_is_ast_id_tco_diag "" 0xa0802650 ratio_t_is_ast _REC_AXS_20_u1 99.609375 _CNV_A_R_LINEAR_____5_CM 6 0. 99.609375 FORMAT "%9.6" /end AXIS_PTS
/begin MEASUREMENT tco_dif_diag_tco_plaus "Difference between closed-loop enable- and coolant temperature at start for coolant plausibility diagnosis" SBYTE _CNV_A_R_LINEAR_____25_CM 1 100. -96. 95.25 DISPLAY_IDENTIFIER TCO_DIF_DIAG_TCO_PLAUS ECU_ADDRESS 0xd000269f FORMAT "%6.2" /end MEASUREMENT
/begin MEASUREMENT t_ast_max_diag_tco_plaus "Maximum time after start to reach closed-loop enable temperature for coolant temperature plausibility diagnosis" UWORD _CNV_A_R_LINEAR_____36_CM 1 100. 0. 65535. DISPLAY_IDENTIFIER T_AST_MAX_DIAG_TCO_PLAUS ECU_ADDRESS 0xd0002670 FORMAT "%5.0" /end MEASUREMENT
/begin MEASUREMENT t_ast_diag_tco_plaus "Time after start of the performed coolant temperature plausibility diagnosis" UWORD _CNV_A_R_LINEAR_____36_CM 1 100. 0. 65535. DISPLAY_IDENTIFIER T_AST_DIAG_TCO_PLAUS ECU_ADDRESS 0xd000266e FORMAT "%5.0" /end MEASUREMENT
/begin AXIS_PTS ldp_tco_st_id_tco_min_diag_plaus "" 0xa080267c tco_st _REC_AXS_20_u1 190.5 _CNV_A_R_LINEAR_____17_CM 6 -48. 142.5 FORMAT "%6.2" /end AXIS_PTS
/begin AXIS_PTS ldp_tco_dif_diag_tco_plaus_id_t "" 0xa0802676 tco_dif_diag_tco_plaus _REC_AXS_20_u1 191.25 _CNV_A_R_ENTE_LINEA_443_CM 4 -96. 95.25 FORMAT "%5.2" /end AXIS_PTS
/begin CHARACTERISTIC id_t_min_diag_tco_plaus "Minimum time for coolant temperature plausibility diagnosis activation" CURVE 0xa080274c _REC_CUR_20_u2_u1 65534. _CNV_A_R_LINEAR_____36_CM 1. 65535. DISPLAY_IDENTIFIER ID_T_MIN_DIAG_TCO_PLAUS FORMAT "%5.0"
 /begin AXIS_DESCR COM_AXIS tia_thr_st _CNV_A_R_LINEAR_____17_CM 6 -48. 142.5 FORMAT "%6.2" AXIS_PTS_REF ldp_tia_thr_st_id_t_tco_plaus /end AXIS_DESCR
/end CHARACTERISTIC
/begin CHARACTERISTIC id_t_max_diag_tco_plaus "Time interval to reach closed-loop enable temperature for coolant temperature plausibility diagnosis" CURVE 0xa0802744 _REC_CUR_20_u2_u1 65534. _CNV_A_R_LINEAR_____36_CM 1. 65535. DISPLAY_IDENTIFIER ID_T_MAX_DIAG_TCO_PLAUS FORMAT "%5.0"
 /begin AXIS_DESCR COM_AXIS tco_dif_diag_tco_plaus _CNV_A_R_ENTE_LINEA_443_CM 4 -96. 95.25 FORMAT "%5.2" AXIS_PTS_REF ldp_tco_dif_diag_tco_plaus_id_t /end AXIS_DESCR
/end CHARACTERISTIC
/begin CHARACTERISTIC lc_tco_plaus_tco_sub_diag_inh "to inhibit the use of TCO_SUB condition for error detection" VALUE 0xa08028d1 _REC_VAL_20_u1 1. _CNV_A_R_LINEAR_____0_CM 0. 1. DISPLAY_IDENTIFIER LC_TCO_PLAUS_TCO_SUB_DIAG_INH FORMAT "%1.0" /end CHARACTERISTIC
/begin CHARACTERISTIC lc_t_dly_tco_plaus "to switch between delay timer based on absolute or relative temperature at start" VALUE 0xa08028d0 _REC_VAL_20_u1 1. _CNV_A_R_LINEAR_____0_CM 0. 1. DISPLAY_IDENTIFIER LC_T_DLY_TCO_PLAUS FORMAT "%1.0" /end CHARACTERISTIC
/begin MEASUREMENT lv_inh_diag_tco_plaus "TCO plausibility diagnosis inhibition" UBYTE _CNV_S_2_RANGE__0___1_CM 1 100. 0. 1. DISPLAY_IDENTIFIER LV_INH_DIAG_TCO_PLAUS ECU_ADDRESS 0xd0007584 BIT_MASK 0x1 /end MEASUREMENT
/begin MEASUREMENT lv_inh_diag_rbm_tco_plaus "Boolean for coolant temperature plausibility diagnosis inhibit due to OBD error" UBYTE _CNV_S_2_RANGE__0___1_CM 1 100. 0. 1. DISPLAY_IDENTIFIER LV_INH_DIAG_RBM_TCO_PLAUS ECU_ADDRESS 0xd000757c BIT_MASK 0x1 /end MEASUREMENT
/begin MEASUREMENT state_rbm_tco_plaus "Interface of TCO_PLAUS monitor with the Rate-Based Monitoring statistics" UBYTE _CNV_A_R_LINEAR_____0_CM 1 100. 0. 7. DISPLAY_IDENTIFIER STATE_RBM_TCO_PLAUS ECU_ADDRESS 0xd000755d FORMAT "%1.0" /end MEASUREMENT
/begin MEASUREMENT lv_err_tco_2_plaus "Boolean for coolant temperature (radiator outlet) plausibility error" UBYTE _CNV_S_2_RANGE__0___1_CM 1 100. 0. 1. DISPLAY_IDENTIFIER LV_ERR_TCO_2_PLAUS ECU_ADDRESS 0xd0007f00 BIT_MASK 0x1 /end MEASUREMENT
/begin MEASUREMENT lv_end_diag_rbm_tco_2_plaus "Boolean for end of coolant temperature (radiator outlet) plausibility diagnosis for RBM" UBYTE _CNV_S_2_RANGE__0___1_CM 1 100. 0. 1. DISPLAY_IDENTIFIER LV_END_DIAG_RBM_TCO_2_PLAUS ECU_ADDRESS 0xd0007570 BIT_MASK 0x1 /end MEASUREMENT
/begin MEASUREMENT lv_tco_2_plaus_ena "Coolant temperature (radiator outlet) plausibility (long) enabled" UBYTE _CNV_S_2_RANGE__0___1_CM 1 100. 0. 1. DISPLAY_IDENTIFIER LV_TCO_2_PLAUS_ENA ECU_ADDRESS 0xd00026ba BIT_MASK 0x1 /end MEASUREMENT
/begin MEASUREMENT tco_2_dif_tco_2_plaus "Maximum coolant temperature (radiator outlet) gap in diagnosis window" UBYTE _CNV_A_R_LINEAR_____25_CM 1 100. 0. 190.5 DISPLAY_IDENTIFIER TCO_2_DIF_TCO_2_PLAUS ECU_ADDRESS 0xd0002699 FORMAT "%6.2" /end MEASUREMENT
/begin MEASUREMENT ctr_dly_tco_2_plaus "Delay counter before coolant temperature (radiator outlet) change is expected" UWORD _CNV_A_R_LINEAR_____0_CM 1 100. 0. 65535. DISPLAY_IDENTIFIER CTR_DLY_TCO_2_PLAUS ECU_ADDRESS 0xd0002660 FORMAT "%5.0" /end MEASUREMENT
/begin MEASUREMENT t_dly_tco_2_plaus "Coolant temperature (radiator outlet) plausibility diagnosis diagnostic window time" UWORD _CNV_A_R_LINEAR_____36_CM 1 100. 0. 65535. DISPLAY_IDENTIFIER T_DLY_TCO_2_PLAUS ECU_ADDRESS 0xd0002672 FORMAT "%5.0" /end MEASUREMENT
/begin MEASUREMENT tco_2_plaus_h "Maximum latched coolant temperature (radiator outlet) value " UBYTE _CNV_A_R_LINEAR_____17_CM 1 100. -48. 142.5 DISPLAY_IDENTIFIER TCO_2_PLAUS_H ECU_ADDRESS 0xd000269a FORMAT "%6.2" /end MEASUREMENT
/begin MEASUREMENT tco_2_plaus_l "Minimum latched coolant temperature (radiator outlet) value " UBYTE _CNV_A_R_LINEAR_____17_CM 1 100. -48. 142.5 DISPLAY_IDENTIFIER TCO_2_PLAUS_L ECU_ADDRESS 0xd000269b FORMAT "%6.2" /end MEASUREMENT
/begin AXIS_PTS ldp_tco_st_ip_ctr_tco_2_plaus "" 0xa0802684 tco_st _REC_AXS_20_u1 190.5 _CNV_A_R_LINEAR_____17_CM 6 -48. 142.5 FORMAT "%6.2" /end AXIS_PTS
/begin CHARACTERISTIC c_t_dly_tco_2_plaus "Diagnostic window" VALUE 0xa0802886 _REC_VAL_20_u2 65535. _CNV_A_R_LINEAR_____36_CM 0. 65535. DISPLAY_IDENTIFIER C_T_DLY_TCO_2_PLAUS FORMAT "%5.0" /end CHARACTERISTIC
/begin CHARACTERISTIC c_tco_2_dif_min_tco_2_plaus "Min. delta TCO_2 for plausibility" VALUE 0xa08028a5 _REC_VAL_20_u1 190.5 _CNV_A_R_LINEAR_____25_CM 0. 190.5 DISPLAY_IDENTIFIER C_TCO_2_DIF_MIN_TCO_2_PLAUS FORMAT "%6.2" /end CHARACTERISTIC
/begin CHARACTERISTIC c_vs_min_tco_2_plaus "Min. vehicle speed needed to open thermostat relief valve" VALUE 0xa08028ca _REC_VAL_20_u1 255. _CNV_A_R_LINEAR_____6_CM 0. 255. DISPLAY_IDENTIFIER C_VS_MIN_TCO_2_PLAUS FORMAT "%3.0" /end CHARACTERISTIC
/begin CHARACTERISTIC c_n_min_tco_2_plaus "Min. engine speed needed to open thermostat relief valve" VALUE 0xa0802872 _REC_VAL_20_u2 8160. _CNV_A_R_LINEAR_____14_CM 0. 8160. DISPLAY_IDENTIFIER C_N_MIN_TCO_2_PLAUS FORMAT "%4.0" /end CHARACTERISTIC
/begin CHARACTERISTIC c_tco_min_tco_2_plaus "Opening temperature of coolant thermostat" VALUE 0xa08028af _REC_VAL_20_u1 190.5 _CNV_A_R_LINEAR_____17_CM -48. 142.5 DISPLAY_IDENTIFIER C_TCO_MIN_TCO_2_PLAUS FORMAT "%6.2" /end CHARACTERISTIC
/begin CHARACTERISTIC c_tco_st_max_tco_2_plaus "Max. TCO_ST for TCO_2 plausibility check" VALUE 0xa08028b2 _REC_VAL_20_u1 190.5 _CNV_A_R_LINEAR_____17_CM -48. 142.5 DISPLAY_IDENTIFIER C_TCO_ST_MAX_TCO_2_PLAUS FORMAT "%6.2" /end CHARACTERISTIC
/begin CHARACTERISTIC c_tco_st_min_tco_2_plaus "Min. TCO_ST for TCO_2 plausibility check" VALUE 0xa08028b4 _REC_VAL_20_u1 190.5 _CNV_A_R_LINEAR_____17_CM -48. 142.5 DISPLAY_IDENTIFIER C_TCO_ST_MIN_TCO_2_PLAUS FORMAT "%6.2" /end CHARACTERISTIC
/begin CHARACTERISTIC c_tia_thr_st_max_tco_2_plaus "Max. TIA_THR_ST for TCO_2 plausibility check" VALUE 0xa08028be _REC_VAL_20_u1 190.5 _CNV_A_R_LINEAR_____17_CM -48. 142.5 DISPLAY_IDENTIFIER C_TIA_THR_ST_MAX_TCO_2_PLAUS FORMAT "%6.2" /end CHARACTERISTIC
/begin CHARACTERISTIC c_tia_thr_st_min_tco_2_plaus "Min. TIA_THR_ST for TCO_2 plausibility check" VALUE 0xa08028c0 _REC_VAL_20_u1 190.5 _CNV_A_R_LINEAR_____17_CM -48. 142.5 DISPLAY_IDENTIFIER C_TIA_THR_ST_MIN_TCO_2_PLAUS FORMAT "%6.2" /end CHARACTERISTIC
/begin CHARACTERISTIC c_tco_st_thd_tco_2_plaus "Max. TCO_ST for additional rationality check" VALUE 0xa08028b5 _REC_VAL_20_u1 190.5 _CNV_A_R_LINEAR_____17_CM -48. 142.5 DISPLAY_IDENTIFIER C_TCO_ST_THD_TCO_2_PLAUS FORMAT "%6.2" /end CHARACTERISTIC
/begin CHARACTERISTIC c_tco_st_dif_min_tco_2_plaus "Min. difference between TCO_ST and TCO_2_ST to diagnose fault at engine start" VALUE 0xa08028b0 _REC_VAL_20_u1 191.25 _CNV_A_R_ENTE_LINEA_443_CM -96. 95.25 DISPLAY_IDENTIFIER C_TCO_ST_DIF_MIN_TCO_2_PLAUS FORMAT "%6.2" /end CHARACTERISTIC
/begin CHARACTERISTIC c_ctr_dly_inc_tco_2_plaus "Increment for counter if drop out of diagnostic conditions" VALUE 0xa0802850 _REC_VAL_20_u2 65535. _CNV_A_R_LINEAR_____0_CM 0. 65535. DISPLAY_IDENTIFIER C_CTR_DLY_INC_TCO_2_PLAUS FORMAT "%5.0" /end CHARACTERISTIC
/begin AXIS_PTS ldp_tia_thr_st_ip_ctr_tco_plaus "" 0xa08026ca tia_thr_st _REC_AXS_20_u1 190.5 _CNV_A_R_LINEAR_____17_CM 6 -48. 142.5 FORMAT "%6.2" /end AXIS_PTS
/begin CHARACTERISTIC ip_ctr_dly_tco_2_plaus "Coolant system lag time before change in TCO_2 is expected" MAP 0xa080f2a0 _REC_MAP_20_u2_u1_u1 65535. _CNV_A_R_LINEAR_____0_CM 0. 65535. DISPLAY_IDENTIFIER IP_CTR_DLY_TCO_2_PLAUS FORMAT "%5.0"
 /begin AXIS_DESCR COM_AXIS tco_st _CNV_A_R_LINEAR_____17_CM 6 -48. 142.5 FORMAT "%6.2" AXIS_PTS_REF ldp_tco_st_ip_ctr_tco_2_plaus /end AXIS_DESCR
 /begin AXIS_DESCR COM_AXIS tia_thr_st _CNV_A_R_LINEAR_____17_CM 6 -48. 142.5 FORMAT "%6.2" AXIS_PTS_REF ldp_tia_thr_st_ip_ctr_tco_plaus /end AXIS_DESCR
/end CHARACTERISTIC
/begin MEASUREMENT tq_loss_ecf "Engine torque losses electric cooling fan" SWORD _CNV_A_R_LINEAR_____31_CM 1 100. -1024. 1023.96875 DISPLAY_IDENTIFIER TQ_LOSS_ECF ECU_ADDRESS 0xd000674a FORMAT "%6.2" /end MEASUREMENT
/begin CHARACTERISTIC ip_pow_loss_ecf "" CURVE 0xa08027dc _REC_CUR_20_u1_u1 -5100. _CNV_A_R_LINEAR_____444_CM 0. -5100. DISPLAY_IDENTIFIER IP_POW_LOSS_ECF FORMAT "%5.0"
 /begin AXIS_DESCR COM_AXIS ecfpwm[0] _CNV_A_R_LINEAR_____5_CM 8 0. 99.609375 FORMAT "%9.6" AXIS_PTS_REF ldp_ecfpwm /end AXIS_DESCR
/end CHARACTERISTIC
/begin CHARACTERISTIC c_lgrd_tq_loss_ecf "ECF-torque loss limitation gradient" VALUE 0xa080286a _REC_VAL_20_u2 1023.96875 _CNV_A_R_LINEAR_____31_CM 0. 1023.96875 DISPLAY_IDENTIFIER C_LGRD_TQ_LOSS_ECF FORMAT "%10.5" /end CHARACTERISTIC
/begin AXIS_PTS ldp_ecfpwm "" 0xa0802614 ecfpwm[0] _REC_AXS_20_u1 99.609375 _CNV_A_R_LINEAR_____5_CM 8 0. 99.609375 FORMAT "%9.6" /end AXIS_PTS
/begin MEASUREMENT tco_2_mes "Measured coolant temperature (radiator outlet)" UBYTE _CNV_A_R_LINEAR_____17_CM 1 100. -48. 142.5 DISPLAY_IDENTIFIER TCO_2_MES ECU_ADDRESS 0xd0007564 FORMAT "%6.2" /end MEASUREMENT
/begin MEASUREMENT tco_2_st "Coolant temperature (radiator outlet) at start" UBYTE _CNV_A_R_LINEAR_____17_CM 1 100. -48. 142.5 DISPLAY_IDENTIFIER TCO_2_ST ECU_ADDRESS 0xd0007565 FORMAT "%6.2" /end MEASUREMENT
/begin MEASUREMENT tco_2 "Coolant temperature (radiator outlet)" UBYTE _CNV_A_R_LINEAR_____17_CM 1 100. -48. 142.5 DISPLAY_IDENTIFIER TCO_2 ECU_ADDRESS 0xd0007563 FORMAT "%6.2" /end MEASUREMENT
/begin MEASUREMENT tco_1_2 "Coolant temperature difference between the TCO- and the TCO_2 sensor" SBYTE _CNV_A_R_LINEAR_____25_CM 1 100. -96. 95.25 DISPLAY_IDENTIFIER TCO_1_2 ECU_ADDRESS 0xd0007562 FORMAT "%6.2" /end MEASUREMENT
/begin MEASUREMENT lv_cdn_ini_tco_2 "Boolean for coolant temperature (radiator outlet) initialisation conditions" UBYTE _CNV_S_2_RANGE__0___1_CM 1 100. 0. 1. DISPLAY_IDENTIFIER LV_CDN_INI_TCO_2 ECU_ADDRESS 0xd00026b1 BIT_MASK 0x1 /end MEASUREMENT
/begin CHARACTERISTIC ip_tco_2_mes "Linearization of the coolant temperature (radiator outlet) sensor voltage for temperature acquisition " CURVE 0xa08027e4 _REC_CUR_20_u1_u2 28.575 _CNV_A_R_LINEAR_____17_CM -48. 142.5 DISPLAY_IDENTIFIER IP_TCO_2_MES FORMAT "%6.2"
 /begin AXIS_DESCR COM_AXIS vp_tco[1] _CNV_A_R_LINEAR_____172_CM 16 0. 4.999847 FORMAT "%6.4" AXIS_PTS_REF ldp_vp_tco_2_ip_tco_2_mes /end AXIS_DESCR
/end CHARACTERISTIC
/begin CHARACTERISTIC c_tco_2_mes_grd_max "Maximum permissible temperature gradient for coolant temperature (radiator outlet) gradient monitoring" VALUE 0xa08028a7 _REC_VAL_20_u1 38.1 _CNV_A_R_LINEAR_____25_CM 0. 190.5 DISPLAY_IDENTIFIER C_TCO_2_MES_GRD_MAX FORMAT "%6.2" /end CHARACTERISTIC
/begin CHARACTERISTIC c_tco_2_dif_tco "Temperature difference to the TCO-value in case of a coolant temperature (radiator outlet) failure" VALUE 0xa08028a6 _REC_VAL_20_s1 191.25 _CNV_A_R_LINEAR_____25_CM -96. 95.25 DISPLAY_IDENTIFIER C_TCO_2_DIF_TCO FORMAT "%6.2" /end CHARACTERISTIC
/begin AXIS_PTS ldp_vp_tco_2_ip_tco_2_mes "" 0xa08026dc vp_tco[1] _REC_AXS_20_u2 4.4998623 _CNV_A_R_LINEAR_____172_CM 16 0. 4.999847 FORMAT "%6.4" /end AXIS_PTS
/begin CHARACTERISTIC c_tco_2_sub "Substitute value for TCO_2 in case of no sensor is available" VALUE 0xa08028a9 _REC_VAL_20_u1 190.5 _CNV_A_R_LINEAR_____17_CM -48. 142.5 DISPLAY_IDENTIFIER C_TCO_2_SUB FORMAT "%6.2" /end CHARACTERISTIC
/begin MEASUREMENT lv_err_tco_grd "Boolean for coolant temperature signal gradient error" UBYTE _CNV_S_2_RANGE__0___1_CM 1 100. 0. 1. DISPLAY_IDENTIFIER LV_ERR_TCO_GRD ECU_ADDRESS 0xd0007efa BIT_MASK 0x1 /end MEASUREMENT
/begin CHARACTERISTIC c_tia_thr_min_diag_tco_el "Minimum intake air temperature value for the coolant temperature electrical diagnosis" VALUE 0xa08028bd _REC_VAL_20_u1 190.5 _CNV_A_R_LINEAR_____17_CM -48. 142.5 DISPLAY_IDENTIFIER C_TIA_THR_MIN_DIAG_TCO_EL FORMAT "%6.2" /end CHARACTERISTIC
/begin MEASUREMENT lv_err_tco_el "Boolean for coolant temperature signal range error" UBYTE _CNV_S_2_RANGE__0___1_CM 1 100. 0. 1. DISPLAY_IDENTIFIER LV_ERR_TCO_EL ECU_ADDRESS 0xd0007ef9 BIT_MASK 0x1 /end MEASUREMENT
/begin MEASUREMENT lv_err_tco "Boolean for error currently present on coolant temperature acquisition" UBYTE _CNV_S_2_RANGE__0___1_CM 1 100. 0. 1. DISPLAY_IDENTIFIER LV_ERR_TCO ECU_ADDRESS 0xd0007577 BIT_MASK 0x1 /end MEASUREMENT
/begin MEASUREMENT lv_err_tco_prel "Boolean for preliminary error currently present on coolant temperature acquisition" UBYTE _CNV_S_2_RANGE__0___1_CM 1 100. 0. 1. DISPLAY_IDENTIFIER LV_ERR_TCO_PREL ECU_ADDRESS 0xd000757a BIT_MASK 0x1 /end MEASUREMENT
/begin MEASUREMENT lv_cdn_ena_tco_prel "Boolean for preliminary coolant temperature error enable conditions" UBYTE _CNV_S_2_RANGE__0___1_CM 1 100. 0. 1. DISPLAY_IDENTIFIER LV_CDN_ENA_TCO_PREL ECU_ADDRESS 0xd00026ae BIT_MASK 0x1 /end MEASUREMENT
/begin CHARACTERISTIC c_t_ast_min_diag_tco_el "Minimum time delay after start for the coolant temperature electrical diagnosis" VALUE 0xa0802882 _REC_VAL_20_u2 65535. _CNV_A_R_LINEAR_____36_CM 0. 65535. DISPLAY_IDENTIFIER C_T_AST_MIN_DIAG_TCO_EL FORMAT "%5.0" /end CHARACTERISTIC
/begin CHARACTERISTIC c_ctr_abc_thd_tco_prel "Threshold for anti-bounce counter value for preliminary coolant temperature error detection" VALUE 0xa080284f _REC_VAL_20_u1 255. _CNV_A_R_LINEAR_____0_CM 0. 255. DISPLAY_IDENTIFIER C_CTR_ABC_THD_TCO_PREL FORMAT "%3.0" /end CHARACTERISTIC
/begin CHARACTERISTIC c_tco_mes_grd_max_diag_tco_grd "Maximum coolant temperature gradient for the coolant temperature gradient diagnosis" VALUE 0xa08028ae _REC_VAL_20_u1 190.5 _CNV_A_R_LINEAR_____25_CM 0. 190.5 DISPLAY_IDENTIFIER C_TCO_MES_GRD_MAX_DIAG_TCO_GRD FORMAT "%6.2" /end CHARACTERISTIC
/begin MEASUREMENT lv_err_tco_prel_det "Boolean for preliminary error present on coolant temperature acquisition during driving cycle" UBYTE _CNV_S_2_RANGE__0___1_CM 1 100. 0. 1. DISPLAY_IDENTIFIER LV_ERR_TCO_PREL_DET ECU_ADDRESS 0xd00026b7 BIT_MASK 0x1 /end MEASUREMENT
/begin CHARACTERISTIC c_vp_tco_max_diag_tco_el "Maximum raw sensor signal voltage  for the coolant temperature electrical diagnosis" VALUE 0xa08028c6 _REC_VAL_20_u2 4.999847 _CNV_A_R_LINEAR_____172_CM 0. 4.999847 DISPLAY_IDENTIFIER C_VP_TCO_MAX_DIAG_TCO_EL FORMAT "%6.4" /end CHARACTERISTIC
/begin CHARACTERISTIC c_vp_tco_min_diag_tco_el "Minimum raw sensor signal voltage  for the coolant temperature electrical diagnosis" VALUE 0xa08028c8 _REC_VAL_20_u2 4.999847 _CNV_A_R_LINEAR_____172_CM 0. 4.999847 DISPLAY_IDENTIFIER C_VP_TCO_MIN_DIAG_TCO_EL FORMAT "%6.4" /end CHARACTERISTIC
/begin AXIS_PTS ldpm_tco_st_1_ente "" 0xa0802736 tco_st _REC_AXS_20_u1 190.5 _CNV_A_R_LINEAR_____17_CM 6 -48. 142.5 FORMAT "%6.2" /end AXIS_PTS
/begin MEASUREMENT tq_loss_req_clu "Overall torque losses (filtered value)" SWORD _CNV_A_R_LINEAR_____31_CM 1 100. -1024. 1023.96875 DISPLAY_IDENTIFIER TQ_LOSS_REQ_CLU ECU_ADDRESS 0xd000a1fe FORMAT "%11.5" /end MEASUREMENT
/begin MEASUREMENT tq_loss "Overall torque losses (unfiltered value)" SWORD _CNV_A_R_LINEAR_____31_CM 1 100. -1024. 1023.96875 DISPLAY_IDENTIFIER TQ_LOSS ECU_ADDRESS 0xd000a1fc FORMAT "%11.5" /end MEASUREMENT
/begin MEASUREMENT tq_loss_add "total torque losses for additive engine devices" SWORD _CNV_A_R_LINEAR_____31_CM 1 100. -1024. 1023.96875 DISPLAY_IDENTIFIER TQ_LOSS_ADD ECU_ADDRESS 0xd000a200 FORMAT "%11.5" /end MEASUREMENT
/begin MEASUREMENT lv_ti_lim_act "1: injection time limited by cycle time (720°crk)" UBYTE _CNV_S_2_RANGE__0___1_CM 1 100. 0. 1. DISPLAY_IDENTIFIER LV_TI_LIM_ACT ECU_ADDRESS 0xd00086a5 BIT_MASK 0x1 /end MEASUREMENT
/begin MEASUREMENT fac_eoi_opm_sel "injection phasing correction interpolation factor for operation switch manager" UBYTE _CNV_A_R_LINEAR_____28_CM 1 100. 0. 0.99609375 DISPLAY_IDENTIFIER FAC_EOI_OPM_SEL ECU_ADDRESS 0xd00086a4 FORMAT "%5.3" /end MEASUREMENT
/begin MEASUREMENT lv_eoi_2_delta_hom_cus "Switch between EOI_2_HOM_CUS (LV... = 0) or EOI_2_DELTA_HOM_CUS (LV = 1) for phasing of second hom. Injection pulse" UBYTE _CNV_S_2_RANGE__0___1_CM 1 100. 0. 1. DISPLAY_IDENTIFIER LV_EOI_2_DELTA_HOM_CUS ECU_ADDRESS 0xd00086aa BIT_MASK 0x1 /end MEASUREMENT
/begin MEASUREMENT lv_mplp_ena "Enable post injection " UBYTE _CNV_S_2_RANGE__0___1_CM 1 100. 0. 1. DISPLAY_IDENTIFIER LV_MPLP_ENA ECU_ADDRESS 0xd00086a6 BIT_MASK 0x1 /end MEASUREMENT
/begin MEASUREMENT lv_homs_act "Indicates if  HOMS is active" UBYTE _CNV_S_2_RANGE__0___1_CM 1 100. 0. 1. DISPLAY_IDENTIFIER LV_HOMS_ACT ECU_ADDRESS 0xd00086a7 BIT_MASK 0x1 /end MEASUREMENT
/begin MEASUREMENT lv_mplh_act "Indicates if homogeneous mode with split injection is active" UBYTE _CNV_S_2_RANGE__0___1_CM 1 100. 0. 1. DISPLAY_IDENTIFIER LV_MPLH_ACT ECU_ADDRESS 0xd00086a8 BIT_MASK 0x1 /end MEASUREMENT
/begin MEASUREMENT lv_mplp_act "Indicates if stratified mode with post injection is active" UBYTE _CNV_S_2_RANGE__0___1_CM 1 100. 0. 1. DISPLAY_IDENTIFIER LV_MPLP_ACT ECU_ADDRESS 0xd00086a9 BIT_MASK 0x1 /end MEASUREMENT
/begin MEASUREMENT maf_egr "" UWORD _CNV_A_R_LINEAR_____215_CM 1 100. 0. 2047.96875 DISPLAY_IDENTIFIER MAF_EGR ECU_ADDRESS 0xd00072d4 FORMAT "%7.2" /end MEASUREMENT
/begin MEASUREMENT maf_mdl_mv "" UWORD _CNV_A_R_LINEAR_____215_CM 1 100. 0. 2047.96875 DISPLAY_IDENTIFIER MAF_MDL_MV ECU_ADDRESS 0xd00072d8 FORMAT "%7.2" /end MEASUREMENT
/begin MEASUREMENT maf_cyl_stk "air mass flow to cylinder" UWORD _CNV_A_R_LINEAR_____111_CM 1 100. 0. 1389. DISPLAY_IDENTIFIER MAF_CYL_STK ECU_ADDRESS 0xd00072dc FORMAT "%7.2" /end MEASUREMENT
/begin MEASUREMENT pq "" UWORD _CNV_A_R_LINEAR_____126_CM 1 100. 0. 0.9999847 DISPLAY_IDENTIFIER PQ ECU_ADDRESS 0xd00072e0 FORMAT "%7.5" /end MEASUREMENT
/begin MEASUREMENT maf_max_cor "" UWORD _CNV_A_R_LINEAR_____111_CM 1 100. 0. 1389. DISPLAY_IDENTIFIER MAF_MAX_COR ECU_ADDRESS 0xd00072e4 FORMAT "%7.2" /end MEASUREMENT
/begin MEASUREMENT maf_kgh_fg_pred "" UWORD _CNV_A_R_LINEAR_____215_CM 1 100. 0. 2047.96875 DISPLAY_IDENTIFIER MAF_KGH_FG_PRED ECU_ADDRESS 0xd00072d6 FORMAT "%7.2" /end MEASUREMENT
/begin MEASUREMENT pq_sp "PQ-setpoint" UWORD _CNV_A_R_LINEAR_____126_CM 1 100. 0. 0.9999847 DISPLAY_IDENTIFIER PQ_SP ECU_ADDRESS 0xd00072f6 FORMAT "%7.5" /end MEASUREMENT
/begin MEASUREMENT tq_loss_alter "Torque losses by alternator" SWORD _CNV_A_R_LINEAR_____31_CM 1 100. -1024. 1023.96875 DISPLAY_IDENTIFIER TQ_LOSS_ALTER ECU_ADDRESS 0xd000a030 FORMAT "%8.2" /end MEASUREMENT
/begin CHARACTERISTIC ip_tq_loss_alter "Corrected TQ_LOSS_ALTER of power management request" MAP 0xa081367c _REC_MAP_20_u2_u2_u1 2047.96875 _CNV_A_R_LINEAR_____87_CM -1024. 1023.96875 DISPLAY_IDENTIFIER IP_TQ_LOSS_ALTER FORMAT "%6.2"
 /begin AXIS_DESCR COM_AXIS tq_loss_alter_1 _CNV_A_R_LINEAR_____87_CM 6 -1024. 1023.96875 FORMAT "%6.2" AXIS_PTS_REF ldp_tq_loss_alter_1__tq_alter /end AXIS_DESCR
 /begin AXIS_DESCR COM_AXIS n_32 _CNV_A_R_LINEAR_____10_CM 6 0. 8160. FORMAT "%4.0" AXIS_PTS_REF ldp_n_32__tq_alter /end AXIS_DESCR
/end CHARACTERISTIC
/begin AXIS_PTS ldp_tq_loss_alter_1__tq_alter "" 0xa0807fd4 tq_loss_alter_1 _REC_AXS_20_u2 2047.96875 _CNV_A_R_LINEAR_____87_CM 6 -1024. 1023.96875 FORMAT "%6.2" /end AXIS_PTS
/begin AXIS_PTS ldp_n_32__tq_alter "" 0xa0807fc4 n_32 _REC_AXS_20_u1 816. _CNV_A_R_LINEAR_____10_CM 6 0. 8160. FORMAT "%4.0" /end AXIS_PTS
/begin CHARACTERISTIC c_tq_loss_alter_lih "Default-value in case of generator-error" VALUE 0xa080800c _REC_VAL_20_s2 2047.96875 _CNV_A_R_LINEAR_____31_CM -1024. 1023.96875 DISPLAY_IDENTIFIER C_TQ_LOSS_ALTER_LIH FORMAT "%7.1" /end CHARACTERISTIC
/begin MEASUREMENT tps_sub_diag[0] "Substitute TPS_AV value calculated out of IMM" UWORD _CNV_A_R_LINEAR_____227_CM 1 100. 0. 119.5 DISPLAY_IDENTIFIER TPS_SUB_DIAG[0] ECU_ADDRESS 0xd000a1f4 FORMAT "%7.3" /end MEASUREMENT
/begin MEASUREMENT tps_sub_diag[1] "Substitute TPS_AV value calculated out of IMM" UWORD _CNV_A_R_LINEAR_____227_CM 1 100. 0. 119.5 DISPLAY_IDENTIFIER TPS_SUB_DIAG[1] ECU_ADDRESS 0xd000a1f6 FORMAT "%7.3" /end MEASUREMENT
/begin MEASUREMENT tps_sp_mdl[0] "setpoint throttle position" UWORD _CNV_A_R_LINEAR_____227_CM 1 100. 0. 119.5 DISPLAY_IDENTIFIER TPS_SP_MDL[1] ECU_ADDRESS 0xd000a1f0 FORMAT "%7.3" /end MEASUREMENT
/begin MEASUREMENT tps_sp_mdl[1] "setpoint throttle position" UWORD _CNV_A_R_LINEAR_____227_CM 1 100. 0. 119.5 DISPLAY_IDENTIFIER TPS_SP_MDL[2] ECU_ADDRESS 0xd000a1f2 FORMAT "%7.3" /end MEASUREMENT
/begin MEASUREMENT map_ctr[0] "" UBYTE _CNV_A_R_LINEAR_____0_CM 1 100. 0. 255. DISPLAY_IDENTIFIER MAP_CTR[1] ECU_ADDRESS 0xd0008ae0 FORMAT "%3.0" /end MEASUREMENT
/begin MEASUREMENT map_ctr[1] "" UBYTE _CNV_A_R_LINEAR_____0_CM 1 100. 0. 255. DISPLAY_IDENTIFIER MAP_CTR[2] ECU_ADDRESS 0xd0008ae1 FORMAT "%3.0" /end MEASUREMENT
/begin MEASUREMENT map_ctr_1[0] "" UBYTE _CNV_A_R_LINEAR_____0_CM 1 100. 0. 255. DISPLAY_IDENTIFIER MAP_CTR_1[1] ECU_ADDRESS 0xd0008ae2 FORMAT "%3.0" /end MEASUREMENT
/begin MEASUREMENT map_ctr_1[1] "" UBYTE _CNV_A_R_LINEAR_____0_CM 1 100. 0. 255. DISPLAY_IDENTIFIER MAP_CTR_1[2] ECU_ADDRESS 0xd0008ae3 FORMAT "%3.0" /end MEASUREMENT
/begin MEASUREMENT map_sum[0] "" ULONG _CNV_A_R_LINEAR_____50_CM 1 100. 0. 4294967295. DISPLAY_IDENTIFIER MAP_SUM[1] ECU_ADDRESS 0xd000b9dc FORMAT "%11.0" /end MEASUREMENT
/begin MEASUREMENT map_sum[1] "" ULONG _CNV_A_R_LINEAR_____50_CM 1 100. 0. 4294967295. DISPLAY_IDENTIFIER MAP_SUM[2] ECU_ADDRESS 0xd000b9e0 FORMAT "%11.0" /end MEASUREMENT
/begin MEASUREMENT map_sum_1[0] "" ULONG _CNV_A_R_LINEAR_____50_CM 1 100. 0. 4294967295. DISPLAY_IDENTIFIER MAP_SUM_1[1] ECU_ADDRESS 0xd000b9e4 FORMAT "%11.0" /end MEASUREMENT
/begin MEASUREMENT map_sum_1[1] "" ULONG _CNV_A_R_LINEAR_____50_CM 1 100. 0. 4294967295. DISPLAY_IDENTIFIER MAP_SUM_1[2] ECU_ADDRESS 0xd000b9e8 FORMAT "%11.0" /end MEASUREMENT
/begin MEASUREMENT lv_map_seg "" UBYTE _CNV_S_2_RANGE__0___1_CM 1 100. 0. 1. DISPLAY_IDENTIFIER LV_MAP_SEG ECU_ADDRESS 0xd0008ae4 BIT_MASK 0x1 /end MEASUREMENT
/begin MEASUREMENT map_bas[0] "manifold air pressure" UWORD _CNV_A_R_LINEAR_____473_CM 1 100. 0. 28.7055 DISPLAY_IDENTIFIER MAP_BAS[1] ECU_ADDRESS 0xd000a6ac FORMAT "%5.2" /end MEASUREMENT
/begin MEASUREMENT map_bas[1] "manifold air pressure" UWORD _CNV_A_R_LINEAR_____473_CM 1 100. 0. 28.7055 DISPLAY_IDENTIFIER MAP_BAS[2] ECU_ADDRESS 0xd000a6ae FORMAT "%5.2" /end MEASUREMENT
/begin MEASUREMENT put_sum[0] "Acquisition sum pressure up throttle, buffer " ULONG _CNV_A_R_LINEAR_____50_CM 1 100. 0. 4294967295. DISPLAY_IDENTIFIER PUT_SUM[1] ECU_ADDRESS 0xd000b9fc FORMAT "%11.0" /end MEASUREMENT
/begin MEASUREMENT put_sum[1] "Acquisition sum pressure up throttle, buffer " ULONG _CNV_A_R_LINEAR_____50_CM 1 100. 0. 4294967295. DISPLAY_IDENTIFIER PUT_SUM[2] ECU_ADDRESS 0xd000ba00 FORMAT "%11.0" /end MEASUREMENT
/begin MEASUREMENT put_sum_1[0] "Acquisition sum pressure up throttle, buffer 1" ULONG _CNV_A_R_LINEAR_____50_CM 1 100. 0. 4294967295. DISPLAY_IDENTIFIER PUT_SUM_1[1] ECU_ADDRESS 0xd000ba04 FORMAT "%11.0" /end MEASUREMENT
/begin MEASUREMENT put_sum_1[1] "Acquisition sum pressure up throttle, buffer 1" ULONG _CNV_A_R_LINEAR_____50_CM 1 100. 0. 4294967295. DISPLAY_IDENTIFIER PUT_SUM_1[2] ECU_ADDRESS 0xd000ba08 FORMAT "%11.0" /end MEASUREMENT
/begin MEASUREMENT put_ctr[0] "Number of PUT samples in buffer" UWORD _CNV_A_R_LINEAR_____0_CM 1 100. 0. 65535. DISPLAY_IDENTIFIER PUT_CTR[1] ECU_ADDRESS 0xd000a6ec FORMAT "%5.0" /end MEASUREMENT
/begin MEASUREMENT put_ctr[1] "Number of PUT samples in buffer" UWORD _CNV_A_R_LINEAR_____0_CM 1 100. 0. 65535. DISPLAY_IDENTIFIER PUT_CTR[2] ECU_ADDRESS 0xd000a6ee FORMAT "%5.0" /end MEASUREMENT
/begin MEASUREMENT put_ctr_1[0] "Number of PUT samples in buffer 1" UWORD _CNV_A_R_LINEAR_____0_CM 1 100. 0. 65535. DISPLAY_IDENTIFIER PUT_CTR_1[1] ECU_ADDRESS 0xd000a6f0 FORMAT "%5.0" /end MEASUREMENT
/begin MEASUREMENT put_ctr_1[1] "Number of PUT samples in buffer 1" UWORD _CNV_A_R_LINEAR_____0_CM 1 100. 0. 65535. DISPLAY_IDENTIFIER PUT_CTR_1[2] ECU_ADDRESS 0xd000a6f2 FORMAT "%5.0" /end MEASUREMENT
/begin MEASUREMENT prs_cha_up_sum[0] "Acquisition sum pressure up charger 1, buffer" ULONG _CNV_A_R_LINEAR_____50_CM 1 100. 0. 4294967295. DISPLAY_IDENTIFIER PRS_CHA_UP_SUM[1] ECU_ADDRESS 0xd000ba0c FORMAT "%11.0" /end MEASUREMENT
/begin MEASUREMENT prs_cha_up_sum[1] "Acquisition sum pressure up charger 1, buffer" ULONG _CNV_A_R_LINEAR_____50_CM 1 100. 0. 4294967295. DISPLAY_IDENTIFIER PRS_CHA_UP_SUM[2] ECU_ADDRESS 0xd000ba10 FORMAT "%11.0" /end MEASUREMENT
/begin MEASUREMENT prs_cha_up_sum_1[0] "Acquisition sum pressure up charger 1, buffer1" ULONG _CNV_A_R_LINEAR_____50_CM 1 100. 0. 4294967295. DISPLAY_IDENTIFIER PRS_CHA_UP_SUM_1[1] ECU_ADDRESS 0xd000ba14 FORMAT "%11.0" /end MEASUREMENT
/begin MEASUREMENT prs_cha_up_sum_1[1] "Acquisition sum pressure up charger 1, buffer1" ULONG _CNV_A_R_LINEAR_____50_CM 1 100. 0. 4294967295. DISPLAY_IDENTIFIER PRS_CHA_UP_SUM_1[2] ECU_ADDRESS 0xd000ba18 FORMAT "%11.0" /end MEASUREMENT
/begin MEASUREMENT prs_cha_up_ctr[0] "Number of PTCHA_1 samples in buffer" UWORD _CNV_A_R_LINEAR_____0_CM 1 100. 0. 65535. DISPLAY_IDENTIFIER PRS_CHA_UP_CTR[1] ECU_ADDRESS 0xd000a6f4 FORMAT "%5.0" /end MEASUREMENT
/begin MEASUREMENT prs_cha_up_ctr[1] "Number of PTCHA_1 samples in buffer" UWORD _CNV_A_R_LINEAR_____0_CM 1 100. 0. 65535. DISPLAY_IDENTIFIER PRS_CHA_UP_CTR[2] ECU_ADDRESS 0xd000a6f6 FORMAT "%5.0" /end MEASUREMENT
/begin MEASUREMENT prs_cha_up_ctr_1[0] "Number of PTCHA_1 samples in buffer 1" UWORD _CNV_A_R_LINEAR_____0_CM 1 100. 0. 65535. DISPLAY_IDENTIFIER PRS_CHA_UP_CTR_1[1] ECU_ADDRESS 0xd000a6f8 FORMAT "%5.0" /end MEASUREMENT
/begin MEASUREMENT prs_cha_up_ctr_1[1] "Number of PTCHA_1 samples in buffer 1" UWORD _CNV_A_R_LINEAR_____0_CM 1 100. 0. 65535. DISPLAY_IDENTIFIER PRS_CHA_UP_CTR_1[2] ECU_ADDRESS 0xd000a6fa FORMAT "%5.0" /end MEASUREMENT
/begin MEASUREMENT prs_cha_up_bas[0] "Voltage for pressure up turbo" UWORD _CNV_A_R_LINEAR_____473_CM 1 100. 0. 28.7055 DISPLAY_IDENTIFIER PRS_CHA_UP_BAS[1] ECU_ADDRESS 0xd000a6e8 FORMAT "%5.2" /end MEASUREMENT
/begin MEASUREMENT prs_cha_up_bas[1] "Voltage for pressure up turbo" UWORD _CNV_A_R_LINEAR_____473_CM 1 100. 0. 28.7055 DISPLAY_IDENTIFIER PRS_CHA_UP_BAS[2] ECU_ADDRESS 0xd000a6ea FORMAT "%5.2" /end MEASUREMENT
/begin MEASUREMENT put_bas[0] "manifold air pressure up throttle" UWORD _CNV_A_R_LINEAR_____473_CM 1 100. 0. 28.7055 DISPLAY_IDENTIFIER PUT_BAS[1] ECU_ADDRESS 0xd000a6e4 FORMAT "%5.2" /end MEASUREMENT
/begin MEASUREMENT put_bas[1] "manifold air pressure up throttle" UWORD _CNV_A_R_LINEAR_____473_CM 1 100. 0. 28.7055 DISPLAY_IDENTIFIER PUT_BAS[2] ECU_ADDRESS 0xd000a6e6 FORMAT "%5.2" /end MEASUREMENT
/begin COMPU_METHOD _CNV_A_R_LINEAR_____0_CM "" RAT_FUNC "%6.3" "-" COEFFS 0 1. 0. 0 0 1 /end COMPU_METHOD
/begin COMPU_METHOD _CNV_S_2_RANGE__0___1_CM "" TAB_VERB "%6.3" "-" COMPU_TAB_REF _CNV_S_2_RANGE__0___1 /end COMPU_METHOD
/begin COMPU_VTAB _CNV_S_2_RANGE__0___1 "" TAB_VERB 2 0 "0" 1 "1" /end COMPU_VTAB
/begin COMPU_METHOD _CNV_A_R_LINEAR_____3_CM "" RAT_FUNC "%6.3" "s" COEFFS 0 100. 0. 0 0 1 /end COMPU_METHOD
/begin COMPU_METHOD _CNV_A_R_LINEAR_____4_CM "" RAT_FUNC "%6.3" "s" COEFFS 0 10. 0. 0 0 1 /end COMPU_METHOD
/begin COMPU_METHOD _CNV_A_R_LINEAR_____5_CM "" RAT_FUNC "%6.3" "%" COEFFS 0 2.56 0. 0 0 1 /end COMPU_METHOD
/begin COMPU_METHOD _CNV_A_R_LINEAR_____6_CM "" RAT_FUNC "%6.3" "km/h" COEFFS 0 1. 0. 0 0 1 /end COMPU_METHOD
/begin COMPU_METHOD _CNV_A_R_LINEAR_____8_CM "" RAT_FUNC "%6.3" "%" COEFFS 0 655.3599999999997 0. 0 0 1 /end COMPU_METHOD
/begin COMPU_METHOD _CNV_A_R_LINEAR_____10_CM "" RAT_FUNC "%6.3" "rpm" COEFFS 0 3.125e-002 0. 0 0 1 /end COMPU_METHOD
/begin COMPU_METHOD _CNV_A_R_LINEAR_____14_CM "" RAT_FUNC "%6.3" "rpm" COEFFS 0 1. 0. 0 0 1 /end COMPU_METHOD
/begin COMPU_METHOD _CNV_A_R_LINEAR_____17_CM "" RAT_FUNC "%6.3" "°C" COEFFS 0 1.333333333333333 64. 0 0 1 /end COMPU_METHOD
/begin COMPU_METHOD _CNV_A_R_LINEAR_____20_CM "" RAT_FUNC "%6.3" "ms" COEFFS 0 0.1 0. 0 0 1 /end COMPU_METHOD
/begin COMPU_METHOD _CNV_A_R_LINEAR_____25_CM "" RAT_FUNC "%6.3" "°C" COEFFS 0 1.333333333333333 0. 0 0 1 /end COMPU_METHOD
/begin COMPU_METHOD _CNV_A_R_LINEAR_____27_CM "" RAT_FUNC "%6.3" "hPa" COEFFS 0 12.06017666543982 0. 0 0 1 /end COMPU_METHOD
/begin COMPU_METHOD _CNV_A_R_LINEAR_____28_CM "" RAT_FUNC "%6.3" "-" COEFFS 0 256. 0. 0 0 1 /end COMPU_METHOD
/begin COMPU_METHOD _CNV_A_R_LINEAR_____31_CM "" RAT_FUNC "%6.3" "Nm" COEFFS 0 32. 0. 0 0 1 /end COMPU_METHOD
/begin COMPU_METHOD _CNV_A_R_LINEAR_____36_CM "" RAT_FUNC "%6.3" "s" COEFFS 0 1. 0. 0 0 1 /end COMPU_METHOD
/begin COMPU_METHOD _CNV_A_R_LINEAR_____50_CM "" RAT_FUNC "%6.3" "" COEFFS 0 1. 0. 0 0 1 /end COMPU_METHOD
/begin COMPU_METHOD _CNV_A_R_LINEAR_____84_CM "" RAT_FUNC "%6.3" "min" COEFFS 0 1. 0. 0 0 1 /end COMPU_METHOD
/begin COMPU_METHOD _CNV_A_R_LINEAR_____87_CM "" RAT_FUNC "%6.3" "Nm" COEFFS 0 32. 32768. 0 0 1 /end COMPU_METHOD
/begin COMPU_METHOD _CNV_A_R_LINEAR_____89_CM "" RAT_FUNC "%6.3" "-" COEFFS 0 65535.99999999996 0. 0 0 1 /end COMPU_METHOD
/begin COMPU_METHOD _CNV_A_R_LINEAR_____103_CM "" RAT_FUNC "%6.3" "-" COEFFS 0 128. 0. 0 0 1 /end COMPU_METHOD
/begin COMPU_METHOD _CNV_A_R_LINEAR_____111_CM "" RAT_FUNC "%6.3" "mg/stk" COEFFS 0 47.18142548596112 0. 0 0 1 /end COMPU_METHOD
/begin COMPU_METHOD _CNV_A_R_CYBL_LINEA_124_CM "" RAT_FUNC "%6.3" "-" COEFFS 0 4095.999963999451 32767.99971199561 0 0 1 /end COMPU_METHOD
/begin COMPU_METHOD _CNV_A_R_LINEAR_____126_CM "" RAT_FUNC "%6.3" "-" COEFFS 0 65536.00270084133 0. 0 0 1 /end COMPU_METHOD
/begin COMPU_METHOD _CNV_A_R_LINEAR_____130_CM "" RAT_FUNC "%6.3" "°C" COEFFS 0 16. 0. 0 0 1 /end COMPU_METHOD
/begin COMPU_METHOD _CNV_A_R_LINEAR_____172_CM "" RAT_FUNC "%6.3" "V" COEFFS 0 6553.60054017653 0. 0 0 1 /end COMPU_METHOD
/begin COMPU_METHOD _CNV_A_R_LINEAR_____190_CM "" RAT_FUNC "%6.3" "°CRK" COEFFS 0 2.666666666666667 95. 0 0 1 /end COMPU_METHOD
/begin COMPU_METHOD _CNV_A_R_LINEAR_____200_CM "" RAT_FUNC "%6.3" "°CRK" COEFFS 0 2.666666666666667 0. 0 0 1 /end COMPU_METHOD
/begin COMPU_METHOD _CNV_A_R_LINEAR_____212_CM "" RAT_FUNC "%6.3" "%" COEFFS 0 327.68 0. 0 0 1 /end COMPU_METHOD
/begin COMPU_METHOD _CNV_A_R_LINEAR_____215_CM "" RAT_FUNC "%6.3" "kg/h" COEFFS 0 32. 0. 0 0 1 /end COMPU_METHOD
/begin COMPU_METHOD _CNV_A_R_LINEAR_____227_CM "" RAT_FUNC "%6.3" "°TPS" COEFFS 0 137.0962343096234 0. 0 0 1 /end COMPU_METHOD
/begin COMPU_METHOD _CNV_A_R_LINEAR_____235_CM "" RAT_FUNC "%6.3" "Nm" COEFFS 0 2097152.000003239 3.316402435302734e-003 0 0 1 /end COMPU_METHOD
/begin COMPU_METHOD _CNV_A_R_LINEAR_____273_CM "" RAT_FUNC "%6.3" "ms" COEFFS 0 125. 0. 0 0 1 /end COMPU_METHOD
/begin COMPU_METHOD _CNV_A_R_LINEAR_____386_CM "" RAT_FUNC "%6.3" "°TPS/s" COEFFS 0 8.535564853556485e-002 0. 0 0 1 /end COMPU_METHOD
/begin COMPU_METHOD _CNV_A_R_LINEAR_____408_CM "" RAT_FUNC "%6.3" "tdc" COEFFS 0 1. 0. 0 0 1 /end COMPU_METHOD
/begin COMPU_METHOD _CNV_S_5_MISF_RANGE_409_CM "" TAB_VERB "%6.3" "-" COMPU_TAB_REF _CNV_S_5_MISF_RANGE_409 /end COMPU_METHOD
/begin COMPU_VTAB _CNV_S_5_MISF_RANGE_409 "" TAB_VERB 5 0 "Init Phase" 1 "Prepa. 0 delay" 2 "0 delay monit." 3 "Prepa nominal" 4 "Nominal monit." /end COMPU_VTAB
/begin COMPU_METHOD _CNV_A_R_LINEAR_____410_CM "" RAT_FUNC "%6.3" "µs" COEFFS 0 1. 0. 0 0 1 /end COMPU_METHOD
/begin COMPU_METHOD _CNV_A_R_MISF_LINEA_416_CM "" RAT_FUNC "%6.3" "-" COEFFS 0 128.0120481927711 0. 0 0 1 /end COMPU_METHOD
/begin COMPU_METHOD _CNV_A_R_MISF_LINEA_417_CM "" RAT_FUNC "%6.3" "-" COEFFS 0 10. 0. 0 0 1 /end COMPU_METHOD
/begin COMPU_METHOD _CNV_A_R_MISF_LINEA_418_CM "" RAT_FUNC "%6.3" "km/h/rpm" COEFFS 0 5100. 0. 0 0 1 /end COMPU_METHOD
/begin COMPU_METHOD _CNV_A_R_LINEAR_____419_CM "" RAT_FUNC "%6.3" "µs" COEFFS 0 0.125 0. 0 0 1 /end COMPU_METHOD
/begin COMPU_METHOD _CNV_A_R_LINEAR_____420_CM "" RAT_FUNC "%6.3" "%." COEFFS 0 16.38400007936485 0. 0 0 1 /end COMPU_METHOD
/begin COMPU_METHOD _CNV_A_R_LINEAR_____421_CM "" RAT_FUNC "%6.3" "%." COEFFS 0 65.77254901960784 0. 0 0 1 /end COMPU_METHOD
/begin COMPU_METHOD _CNV_A_R_LINEAR_____436_CM "" RAT_FUNC "%6.3" "%" COEFFS 0 81.92 0. 0 0 1 /end COMPU_METHOD
/begin COMPU_METHOD _CNV_A_R_LINEAR_____437_CM "" RAT_FUNC "%6.3" "*100ms" COEFFS 0 1. 0. 0 0 1 /end COMPU_METHOD
/begin COMPU_METHOD _CNV_A_R_LINEAR_____438_CM "" RAT_FUNC "%6.3" "s" COEFFS 0 5. 0. 0 0 1 /end COMPU_METHOD
/begin COMPU_METHOD _CNV_A_R_LINEAR_____439_CM "" RAT_FUNC "%6.3" "°C" COEFFS 0 341.3333333333333 16384. 0 0 1 /end COMPU_METHOD
/begin COMPU_METHOD _CNV_A_R_ENTE_LINEA_440_CM "" RAT_FUNC "%6.3" "°C" COEFFS 0 341.3333333333333 0. 0 0 1 /end COMPU_METHOD
/begin COMPU_METHOD _CNV_A_R_LINEAR_____441_CM "" RAT_FUNC "%6.3" "-" COEFFS 0 5. 0. 0 0 1 /end COMPU_METHOD
/begin COMPU_METHOD _CNV_A_R_LINEAR_____442_CM "" RAT_FUNC "%6.3" "-" COEFFS 0 51.20008995153059 0. 0 0 1 /end COMPU_METHOD
/begin COMPU_METHOD _CNV_A_R_ENTE_LINEA_443_CM "" RAT_FUNC "%6.3" "°C" COEFFS 0 1.333333333333333 128. 0 0 1 /end COMPU_METHOD
/begin COMPU_METHOD _CNV_A_R_LINEAR_____444_CM "" RAT_FUNC "%6.3" "W" COEFFS 0 -5.e-002 0. 0 0 1 /end COMPU_METHOD
/begin COMPU_METHOD _CNV_A_R_LINEAR_____473_CM "" RAT_FUNC "%6.3" "V" COEFFS 0 35.63776976537597 0. 0 0 1 /end COMPU_METHOD
/begin RECORD_LAYOUT _REC_VAL_20_u1 FNC_VALUES 1 UBYTE COLUMN_DIR DIRECT /end RECORD_LAYOUT
/begin RECORD_LAYOUT _REC_VAL_20_u2 FNC_VALUES 1 UWORD COLUMN_DIR DIRECT /end RECORD_LAYOUT
/begin RECORD_LAYOUT _REC_AXS_20_u1 NO_AXIS_PTS_X 1 UBYTE AXIS_PTS_X 2 UBYTE INDEX_INCR DIRECT /end RECORD_LAYOUT
/begin RECORD_LAYOUT _REC_MAP_20_u2_u1_u1 FNC_VALUES 1 UWORD COLUMN_DIR DIRECT /end RECORD_LAYOUT
/begin RECORD_LAYOUT _REC_CUR_20_u1_u1 FNC_VALUES 1 UBYTE COLUMN_DIR DIRECT /end RECORD_LAYOUT
/begin RECORD_LAYOUT _REC_VAL_20_s2 FNC_VALUES 1 SWORD COLUMN_DIR DIRECT /end RECORD_LAYOUT
/begin RECORD_LAYOUT _REC_MAP_20_u2_u2_u1 FNC_VALUES 1 UWORD COLUMN_DIR DIRECT /end RECORD_LAYOUT
/begin RECORD_LAYOUT _REC_AXS_20_u2 NO_AXIS_PTS_X 1 UWORD AXIS_PTS_X 2 UWORD INDEX_INCR DIRECT /end RECORD_LAYOUT
/begin RECORD_LAYOUT _REC_CUR_20_u2_u1 FNC_VALUES 1 UWORD COLUMN_DIR DIRECT /end RECORD_LAYOUT
/begin RECORD_LAYOUT _REC_CUR_20_u2_u2 FNC_VALUES 1 UWORD COLUMN_DIR DIRECT /end RECORD_LAYOUT
/begin RECORD_LAYOUT _REC_VAL_20_s1 FNC_VALUES 1 SBYTE COLUMN_DIR DIRECT /end RECORD_LAYOUT
/begin RECORD_LAYOUT _REC_CUR_20_u1_u2 FNC_VALUES 1 UBYTE COLUMN_DIR DIRECT /end RECORD_LAYOUT
/begin RECORD_LAYOUT _REC_MAP_20_u2_u1_u2 FNC_VALUES 1 UWORD COLUMN_DIR DIRECT /end RECORD_LAYOUT
/begin RECORD_LAYOUT _REC_MAP_20_u1_u2_u2 FNC_VALUES 1 UBYTE COLUMN_DIR DIRECT /end RECORD_LAYOUT
/begin RECORD_LAYOUT _REC_MAP_20_u1_u1_u1 FNC_VALUES 1 UBYTE COLUMN_DIR DIRECT /end RECORD_LAYOUT
/begin RECORD_LAYOUT _REC_MAP_20_u1_u2_u1 FNC_VALUES 1 UBYTE COLUMN_DIR DIRECT /end RECORD_LAYOUT
/begin RECORD_LAYOUT _REC_MAP_20_u1_u1_u2 FNC_VALUES 1 UBYTE COLUMN_DIR DIRECT /end RECORD_LAYOUT
/begin FUNCTION MISF__Gen_Misf_Param_Fdout_Cnd ""
 /begin DEF_CHARACTERISTIC ldp_n_32_ip_tqi_av_max_mis c_mask_app_inh_det_zdly_mis c_t_map_dif_dly_mis c_t_tps_grd_dly_mis c_t_tps_grd_dly_zdly_mis c_nr_tdc_iga_dif_mis c_t_load_grd_hom_dly_mis c_t_accout_dly_mis ldp_tps_av_ip_tps_grd_max_mis ldp_tps_av_ip_tps_grd_zdly_er ldp_load_mis_ip_load_grd_mis ldp_map_ip_map_dif_max_mis ldp_n_32_ip_delta_iga_mis ldp_load_mis_ip_delta_iga_mis ldp_load_mis_ip_load_grd_s_mis c_t_load_grd_s_dly_mis c_map_max_mis c_conf_load_mis ip_maf_max_mis ip_tps_grd_max_mis ip_tps_grd_zdly_mis ip_load_grd_mis ip_map_dif_max_mis ip_delta_iga_mis ip_load_grd_s_mis c_nr_tdc_cmb_tra_s_mis c_nr_tdc_cmb_tra_afl_mis c_nr_tdc_cmb_tra_hom_mis ip_tqi_av_max_mis c_mask_app_inh_det_mis c_mask_app_inh_det_mis_is ldp_n_32_ip_maf_max_mis c_nr_tdc_iga_dif_is_mis c_nr_tdc_iga_bas_dif_mis ldp_tco_ip_delta_iga_is_mis ldp_n_32_ip_delta_iga_bas_mis ldp_load_ip_delta_iga_is_mis ldp_load_ip_delta_iga_bas_mis ip_delta_iga_is_mis ip_delta_iga_bas_mis ldp_n_ip_load_amp_mis_afs_mt /end DEF_CHARACTERISTIC
 /begin OUT_MEASUREMENT load_mis load_mis_1 load_mis_2 load_mis_3 load_grd_mis mis_det_cdn_app_inh mis_det_cdn_app_inh.lv_inh_map_dif_det_mis mis_det_cdn_app_inh.lv_inh_tps_grd_det_mis mis_det_cdn_app_inh.lv_inh_load_grd_det_mis mis_det_cdn_app_inh.lv_inh_iga_dif_det_mis mis_det_cdn_app_inh.lv_inh_cmb_tra_mis mis_det_cdn_app_inh.lv_inh_acc_det_mis mis_det_cdn_app_inh_nr map_dif_mis iga_dif_mis iga_mis_2 iga_mis_1 iga_mis lv_req_app_inh_mis iga_bas_dif_mis /end OUT_MEASUREMENT
/end FUNCTION
/begin FUNCTION MISF__Lgal_Misf_Detect_Fdout_Cnd ""
 /begin DEF_CHARACTERISTIC lc_req_zdly_mis c_n_min_zdly_mis c_t_zdly_mis c_mask_inh_det_zdly_mis c_mask_inh_det_mis c_amp_min_mis c_n_min_mis c_n_max_mis_at c_n_max_mis_mt c_t_dly_st_mis c_t_dly_iv_off_mis c_sum_inh_iv_max_mis c_tco_min_mis c_tco_wup_min_mis c_nr_tdc_zdly_mis c_nr_tdc_inh_mis c_nr_tdc_iv_off_det_mis c_n_max_mis /end DEF_CHARACTERISTIC
 /begin OUT_MEASUREMENT ctr_t_zdly_mis lv_diag_mis lv_zdly_diag_mis mis_det_cdn_inh mis_det_cdn_inh.lv_inh_n_max_det_mis mis_det_cdn_inh.lv_inh_n_min_det_mis mis_det_cdn_inh.lv_inh_load_min_det_mis mis_det_cdn_inh.lv_inh_tco_min_det_mis mis_det_cdn_inh.lv_inh_amp_min_det_mis mis_det_cdn_inh.lv_inh_st_det_mis mis_det_cdn_inh.lv_inh_iv_off_det_mis mis_det_cdn_inh_nr lv_req_inh_mis ctr_tdc_zdly_mis state_diag_mis lv_iv_off_det_mis /end OUT_MEASUREMENT
/end FUNCTION
/begin FUNCTION MISF__Misf_Rate_Det_ERRM ""
 /begin DEF_CHARACTERISTIC c_mis_max_nr_off_iv c_mis_nr_off_iv_igcfb ldp_n_32_ip_fac_igc_diag_mis ldp_load_mis_ip_fac_igc_diag_mis ldp_n_32_ip_fac_iv_diag_mis ldp_load_mis_ip_fac_iv_diag_mis ldp_n_32_ip_fac_er_s_diag_mis c_n_mis_ftp c_load_mis_ftp c_mis_a_min_nr c_nr_det_max_mis_a c_mis_min_nr_puc lc_conf_inh_iv_mis lc_conf_rnd_det_mis_a lc_conf_mpl_det_mis_a c_mis_sum_b1_thd_mt c_mis_sum_b1_thd_at c_mis_sum_b4_thd_mt c_mis_sum_b4_thd_at c_mis_b1_min_nr c_mis_b4_min_nr c_mis_sum_b1_cbk_thd c_mis_sum_b4_cbk_thd c_nr_cyl_mpl_mis_b c_nr_det_max_mis_b4 lc_conf_rnd_det_mis_b ldp_n_32_ip_fac_er_afs_diag_mis ldp_n__mis_a_fac_hom_s ldp_n__mis_a_fac_afs ldp_n__mis_a_fac_s ldp_n_32_ip_fac_er_hom_s_mis ip_fac_igc_diag_mis ip_fac_iv_diag_mis lc_conf_mpl_det_mis_b lc_conf_mis_state_b c_t_mis_min_puc ldp_load_ip_fac_er_hom_s_mis ldp_load_ip_fac_er_s_diag_mis ldp_load_ip_fac_er_afs_diag_mis c_mis_a_ind_thd_mt c_mis_a_ind_thd_at c_mis_sum_a_thd_mt c_mis_sum_a_thd_at c_mis_sum_a_cbk_thd_mt c_mis_sum_a_cbk_thd_at c_nr_cyl_mpl_mis_a c_nr_max_mis_a_lih_cyl lc_conf_mis_a_lih lc_ena_mis_a_ind_lih lc_ena_mis_a_lih ldpm_n_32_1_misf id_nr_det_ena_mis_a_lih_mt id_nr_det_ena_mis_a_lih_at c_ratio_ftp_cdn_mis_at c_ratio_ftp_cdn_mis_mt c_ratio_ftp_cdn_ind_mis_at c_ratio_ftp_cdn_ind_mis_mt ldp_load_mis__mis_a_fac_hom_s ldp_load_mis__mis_a_fac_s ldp_load_mis__mis_a_fac_afs ip_mis_a_fac_s ip_fac_er_afs_diag_mis ip_fac_er_hom_s_diag_mis ip_fac_er_s_diag_mis ip_mis_a_fac_afs ip_mis_a_fac_hom_s /end DEF_CHARACTERISTIC
 /begin OUT_MEASUREMENT fac_er_diag_mis fac_igc_diag_mis fac_iv_diag_mis lv_det_cfm_mis lv_det_mis_a lv_mis_state_a mis_a_fac mis_a_fac_buf[0] mis_a_fac_buf[1] mis_a_fac_buf[2] mis_a_fac_buf[3] mis_a_fac_buf[4] mis_a_fac_buf[5] inh_iv_mis mis_ctr_a[0] mis_ctr_a[1] mis_ctr_a[2] mis_ctr_a[3] mis_ctr_a[4] mis_ctr_a[5] mis_ctr_a[6] mis_ctr_a[7] mis_nr_tdc_a mis_sum_a mis_sum_a_cbk[0] mis_sum_a_cbk[1] ctr_chk_mis_a ctr_ftp_cdn_mis_a ctr_det_mis_a lv_ftp_mis_a sym_cyl_mis_a lv_mis_state_b1 lv_mis_state_b4 lv_det_mis_b4 mis_nr_tdc_b mis_sum_b mis_sum_b_cbk[0] mis_sum_b_cbk[1] ctr_chk_mis_b4 ctr_det_mis_b4 lv_end_mis_b1 lv_end_mis_a lv_end_mis_b4 lv_end_win_mis_b1 lv_end_win_mis_b4 sym_cyl_mis_b1 sym_cyl_mis_b4 lv_inh_iv_mis_a lv_end_win_mis_a lv_mis_state_b sum_fac_diag_mis mis_ctr_b[0] mis_ctr_b[1] mis_ctr_b[2] mis_ctr_b[3] mis_ctr_b[4] mis_ctr_b[5] mis_ctr_b[6] mis_ctr_b[7] ctr_mis_a_lih_cyl[0] ctr_mis_a_lih_cyl[1] ctr_mis_a_lih_cyl[2] ctr_mis_a_lih_cyl[3] ctr_mis_a_lih_cyl[4] ctr_mis_a_lih_cyl[5] ctr_mis_a_lih_cyl[6] ctr_mis_a_lih_cyl[7] lv_err_in_win_mis_b4 lv_err_in_win_mis_b1 lv_err_in_win_mis_a lv_err_mis_a_in_win_b /end OUT_MEASUREMENT
/end FUNCTION
/begin FUNCTION MISF__Misf_Rate_Det_ERRM_Inci ""
 /begin DEF_CHARACTERISTIC c_teg_cat_up_mis_a_max lc_ctr_conf_diag_mis lc_ctr_conf_osc_mis /end DEF_CHARACTERISTIC
 /begin OUT_MEASUREMENT lv_mis_a_diag_req_app lv_mis_b_diag_req_app fac_mis_a_app fac_mis_a_thd_ind_app fac_mis_sum_a_thd_app fac_mis_sum_b1_thd_app fac_mis_sum_b4_thd_app lv_inh_igc_diag_mis lv_req_app_ctr_mis_a seg_nr_cbk_er lv_inh_iv_diag_mis lv_cdn_mis_b1 lv_cdn_mis_a lv_cdn_mis_b4 lv_err_mis_mpl lv_err_mis_ftl_l lv_err_mis_1 lv_err_mis_2 lv_err_mis_3 lv_err_mis_4 lv_err_mis_5 lv_err_mis_0 ctr_mis_det ctr_seg_mis_act /end OUT_MEASUREMENT
/end FUNCTION
/begin FUNCTION MISF__Crankshaft_Oscil_Detect ""
 /begin DEF_CHARACTERISTIC c_dly_tdc_crk_osc c_n_max_crk_osc c_nr_tdc_max_crk_osc ldp_n_32_ip_seg_min_frq_crk_osc ldp_n_32_ip_drv0_er_thd_osc ldp_load_mis_ip_drv0_er_thd_osc ip_seg_min_frq_crk_osc ip_drv0_er_thd_osc c_ratio_vs_n_min_crk_osc /end DEF_CHARACTERISTIC
 /begin OUT_MEASUREMENT lv_state_crk_osc drv0_er_sum_osc drv0_er_sum_thd_osc ctr_tdc_crk_osc_act seg_sum_frq_crk_osc lv_crk_osc_det_act lv_frq_crit_crk_osc lv_ampl_crit_crk_osc ratio_vs_n_crk_osc /end OUT_MEASUREMENT
/end FUNCTION
/begin FUNCTION MISF__Rough_Road_Inter_For_Misf ""
 /begin DEF_CHARACTERISTIC c_vs_min_rr c_vs_max_rr c_wheel_grd_crlc_rr c_dly_er_rr ip_wheel_grd_mmv_thd_at__vs ip_wheel_grd_mmv_thd_mt__vs /end DEF_CHARACTERISTIC
 /begin OUT_MEASUREMENT lv_state_rr seg_t_mes_0_rr seg_t_mes_1_rr wheel_grd_mmv wheel_grd_mmv_thd sum_rr vs_rr_edge_av.edge_ctr vs_rr_edge_av.edge_t /end OUT_MEASUREMENT
/end FUNCTION
/begin FUNCTION C_F_MISF "" /begin SUB_FUNCTION MISF__Misfire_Tuning_Functions /end SUB_FUNCTION /end FUNCTION
/begin FUNCTION MISF__Misfire_Tuning_Functions ""
 /begin DEF_CHARACTERISTIC c_mis_rate lc_req_mis_gen lc_ign_off_mis_gen lc_inj_off_mis_gen c_seg_st_mis_gen c_mod_mis_gen c_mis_rate_cyl[0] c_mis_rate_cyl[1] c_mis_rate_cyl[2] c_mis_rate_cyl[3] c_mis_rate_cyl[4] c_mis_rate_cyl[5] c_mis_rate_cyl[6] c_mis_rate_cyl[7] c_nr_tdc_dly_mis_gen lc_mis_rate_ena_cyl[0] lc_mis_rate_ena_cyl[1] lc_mis_rate_ena_cyl[2] lc_mis_rate_ena_cyl[3] lc_mis_rate_ena_cyl[4] lc_mis_rate_ena_cyl[5] lc_mis_rate_ena_cyl[6] lc_mis_rate_ena_cyl[7] ldp_x__id_rnd_pat_mis_gen ldp_y__id_rnd_pat_mis_gen id_rnd_pat_mis_gen /end DEF_CHARACTERISTIC
 /begin OUT_MEASUREMENT inh_iv_mis_gen inh_igc_mis_gen lv_mis_gen lv_mis_gen_det inh_iv_mis_gen_16 inh_igc_mis_gen_16 /end OUT_MEASUREMENT
/end FUNCTION
/begin FUNCTION VVTLAYER ""
 /begin OUT_MEASUREMENT map_mes map_mes_bas[0] map_mes_bas[1] map_mes_bas_2seg[0] map_mes_bas_2seg[1] ang_rel_sp_ecu_vvl lv_ti_lim_act fac_eoi_opm_sel lv_eoi_2_delta_hom_cus lv_mplp_ena lv_homs_act lv_mplh_act lv_mplp_act maf_egr maf_mdl_mv maf_cyl_stk pq maf_max_cor maf_kgh_fg_pred pq_sp tps_sub_diag[0] tps_sub_diag[1] tps_sp_mdl[0] tps_sp_mdl[1] map_ctr[0] map_ctr[1] map_ctr_1[0] map_ctr_1[1] map_sum[0] map_sum[1] map_sum_1[0] map_sum_1[1] lv_map_seg map_bas[0] map_bas[1] put_sum[0] put_sum[1] put_sum_1[0] put_sum_1[1] put_ctr[0] put_ctr[1] put_ctr_1[0] put_ctr_1[1] prs_cha_up_sum[0] prs_cha_up_sum[1] prs_cha_up_sum_1[0] prs_cha_up_sum_1[1] prs_cha_up_ctr[0] prs_cha_up_ctr[1] prs_cha_up_ctr_1[0] prs_cha_up_ctr_1[1] prs_cha_up_bas[0] prs_cha_up_bas[1] put_bas[0] put_bas[1] /end OUT_MEASUREMENT
/end FUNCTION
/begin FUNCTION C_D_TQLO "C_D_TQLO" /begin DEF_CHARACTERISTIC ldpm_n_100 ldpm_maf_cyl_stk__tqfr /end DEF_CHARACTERISTIC
 /begin SUB_FUNCTION TQLO_Coordination_of_additional_torque_losses TQLO_Torque_Losses /end SUB_FUNCTION
/end FUNCTION
/begin FUNCTION TQLO_Coordination_of_additional_torque_losses "_Coordination_of_additional_torque_losses" /begin OUT_MEASUREMENT tq_loss_req_clu tq_loss tq_loss_add /end OUT_MEASUREMENT /end FUNCTION
/begin FUNCTION TQLO_Torque_Losses "_Torque_Losses" /begin DEF_CHARACTERISTIC ldp_opm_av_tqlo ip_tq_loss_alter c_tq_loss_alter_lih /end DEF_CHARACTERISTIC /begin OUT_MEASUREMENT tq_loss_alter /end OUT_MEASUREMENT /end FUNCTION
/begin FUNCTION C_8_TQLO "C_8_TQLO"
 /begin SUB_FUNCTION TQLO_Adaptation_Algorithm TQLO_Adaption_Condition TQLO_Application_Incidence /end SUB_FUNCTION
/end FUNCTION
/begin FUNCTION TQLO_Adaptation_Algorithm "_Adaptation_Algorithm"
 /begin DEF_CHARACTERISTIC c_tq_dif_is_ad_conv_min c_tq_dif_is_ad_acc_max c_tq_dif_is_ad_acc_min c_tq_dif_is_ad_max c_tq_dif_is_ad_min c_tq_dif_is_ad_acc_conv_max c_tq_dif_is_ad_conv_max c_tq_dif_is_ad_acc_conv_min c_fac_tq_dif_is_ad_acc c_fac_tq_dif_is_ad_conv c_fac_tq_dif_is_ad_acc_conv c_fac_tq_dif_is_ad id_tq_dif_is_ad_opm_av id_tq_dif_is_ad_opm_req c_crlc_tq_dif_is_ad_acc c_crlc_tq_dif_is_ad_conv /end DEF_CHARACTERISTIC
 /begin OUT_MEASUREMENT lv_opm_sel_tq_is_ad_2 lv_opm_tq_is_add_rls lv_opm_sel_tq_is_ad_1 lv_at_neut_ctl tq_dif_is_ad_inter tq_dif_is_ad_acc_1_inter tq_dif_is_ad_acc_neut_inter tq_dif_is_ad_acc_conv_inter tq_dif_is_ad_conv_neut_inter tq_dif_is_ad_conv_1_inter nvmy_tqlo.nvmy_dtsysisad.tq_dif_is_ad nvmy_tqlo.nvmy_dtsysisad.tq_dif_is_ad_conv nvmy_tqlo.nvmy_dtsysisad.tq_dif_is_ad_acc nvmy_tqlo.nvmy_dtsysisad.tq_dif_is_ad_opm_1 nvmy_tqlo.nvmy_dtsysisad.tq_dif_is_ad_opm_2 nvmy_tqlo.nvmy_dtsysisad.tq_dif_is_ad_acc_1_opm_1 nvmy_tqlo.nvmy_dtsysisad.tq_dif_is_ad_acc_1_opm_2 nvmy_tqlo.nvmy_dtsysisad.tq_dif_is_ad_conv_neut nvmy_tqlo.nvmy_dtsysisad.tq_dif_is_ad_conv_1_opm_1 nvmy_tqlo.nvmy_dtsysisad.tq_dif_is_ad_conv_1_opm_2 nvmy_tqlo.nvmy_dtsysisad.tq_dif_is_ad_acc_conv_opm_1 nvmy_tqlo.nvmy_dtsysisad.tq_dif_is_ad_acc_conv_opm_2 nvmy_tqlo.nvmy_dtsysisad.tq_dif_is_ad_conv_1 nvmy_tqlo.nvmy_dtsysisad.tq_dif_is_ad_acc_neut nvmy_tqlo.nvmy_dtsysisad.tq_dif_is_ad_acc_conv nvmy_tqlo.nvmy_dtsysisad.tq_dif_is_ad_acc_1 nvmy_tqlo.nvmy_dtsysisad.tq_dif_is_ad_acc_neut_opm_1 nvmy_tqlo.nvmy_dtsysisad.tq_dif_is_ad_acc_neut_opm_2 nvmy_tqlo.nvmy_dtsysisad.tq_dif_is_ad_conv_neut_opm_1 nvmy_tqlo.nvmy_dtsysisad.tq_dif_is_ad_conv_neut_opm_2 /end OUT_MEASUREMENT
/end FUNCTION
/begin FUNCTION TQLO_Adaption_Condition "_Adaption_Condition" /begin DEF_CHARACTERISTIC c_tco_ad_max_is c_tco_ad_min_is c_n_delta c_dly_ad_is /end DEF_CHARACTERISTIC /begin OUT_MEASUREMENT lv_tco_ad_cdn_is lv_ad_cdn_is lv_dly_ad_is /end OUT_MEASUREMENT /end FUNCTION
/begin FUNCTION TQLO_Application_Incidence "_Application_Incidence" /begin OUT_MEASUREMENT lv_is_ad_inh lv_is_ad_inh_obd /end OUT_MEASUREMENT /end FUNCTION
/begin FUNCTION C_4_ENTE ""
 /begin SUB_FUNCTION ENTE_coolant_temp ENTE_coolant_temp_radiat_outlet ENTE_coolant_temp_subs_model /end SUB_FUNCTION
/end FUNCTION
/begin FUNCTION ENTE_coolant_temp "coolant_temp"
 /begin DEF_CHARACTERISTIC ip_tco_mes c_tco_mes_grd_max c_tco_ini_tia_im ldp_tia_im_ip_tco_ini_tia_im ip_tco_ini_tia_im ldp_vp_tco_ip_tco_mes /end DEF_CHARACTERISTIC
 /begin OUT_MEASUREMENT tco_mes tco_st tco lv_cdn_ini_tco tco_stop vp_tco[0] vp_tco[1] /end OUT_MEASUREMENT
/end FUNCTION
/begin FUNCTION ENTE_coolant_temp_radiat_outlet "coolant_temp_radiat_outlet"
 /begin DEF_CHARACTERISTIC ip_tco_2_mes c_tco_2_mes_grd_max c_tco_2_dif_tco ldp_vp_tco_2_ip_tco_2_mes c_tco_2_sub /end DEF_CHARACTERISTIC
 /begin OUT_MEASUREMENT tco_2_mes tco_2_st tco_2 tco_1_2 lv_cdn_ini_tco_2 /end OUT_MEASUREMENT
/end FUNCTION
/begin FUNCTION ENTE_coolant_temp_subs_model "coolant_temp_subs_model"
 /begin DEF_CHARACTERISTIC c_t_dly_tco_sub_is_2 c_t_dly_tco_sub_puc ldp_maf_kgh_ip_tco_sub_inc ip_tco_sub_dec ldp_tco_sub_ip_fac_tco_sub_inc ldp_tam_ip_tco_sub_dec c_fac_tco_sub_cor ip_fac_tco_sub_inc ldp_tco_sub_ip_tco_sub_dec ldp_n_rel_cwp_ip_fac_tco_sub ip_fac_tco_sub_cor_n_rel_cwp c_t_dly_tco_sub_is_1 c_fac_tco_sub_cor_state_coc c_t_dly_tco_sub_cor_state_coc c_t_dly_tco_sub_st_cwp_off c_t_dly_tco_sub_st_cwp_on c_n_rel_cwp_thd_coc ldp_tam_ip_tco_sub_inc ldp_tam_ip_tco_sub_max_tam ldp_maf_kgh_ip_fac_tco_sub_inc ldp_maf_kgh_ip_fac_tco_sub_vs ldp_vs_ip_fac_tco_sub_vs ip_tco_sub_inc ip_tco_sub_max_tam ip_fac_tco_sub_vs /end DEF_CHARACTERISTIC
 /begin OUT_MEASUREMENT lv_cdn_ena_tco_sub tco_sub tco_sub_inc fac_tco_sub_cor_n_rel_cwp fac_tco_sub_cor_state_coc t_dly_tco_sub t_dly_tco_sub_cor_state_coc t_dly_thd_tco_sub_st fac_tco_sub_cor fac_tco_sub_vs /end OUT_MEASUREMENT
/end FUNCTION
/begin FUNCTION C_9_ENTE "" /begin DEF_CHARACTERISTIC ldpm_tco_st_1_ente /end DEF_CHARACTERISTIC
 /begin SUB_FUNCTION ENTE_cooling_fan_control ENTE_coolant_temp_setpoint ENTE_coolant_temp_setpoint_AI ENTE_coolant_temp_gradient ENTE_elect_ctrl_therm ENTE_elect_ctrl_therm_AI /end SUB_FUNCTION
/end FUNCTION
/begin FUNCTION ENTE_cooling_fan_control "cooling_fan_control"
 /begin DEF_CHARACTERISTIC c_t_n_perc_ecf_act c_n_perc_act_ecf c_ecfpwm_ecf_man lc_ecfpwm_ecf_man /end DEF_CHARACTERISTIC
 /begin OUT_MEASUREMENT ecfpwm_igk_off ecfpwm[0] ecfpwm[1] t_n_perc_ecf_act /end OUT_MEASUREMENT
/end FUNCTION
/begin FUNCTION ENTE_coolant_temp_setpoint "coolant_temp_setpoint" /end FUNCTION
/begin FUNCTION ENTE_coolant_temp_setpoint_AI "coolant_temp_setpoint_AI" /end FUNCTION
/begin FUNCTION ENTE_coolant_temp_gradient "coolant_temp_gradient" /end FUNCTION
/begin FUNCTION ENTE_elect_ctrl_therm "elect_ctrl_therm"
 /begin DEF_CHARACTERISTIC lc_ectpwm_man c_ectpwm_man c_ectpwm_ast c_t_ectpwm_ast c_tco_ectpwm /end DEF_CHARACTERISTIC
 /begin OUT_MEASUREMENT ectpwm /end OUT_MEASUREMENT
/end FUNCTION
/begin FUNCTION ENTE_elect_ctrl_therm_AI "elect_ctrl_therm_AI" /end FUNCTION
/begin FUNCTION C_B_ENTE "C_B_ENTE"
 /begin SUB_FUNCTION ENTE_coolant_temp_plaus_diag ENTE_coolant_therm_monitoring ENTE_elec_ctl_therm_ratio_chk ENTE_coolant_temp_plaus_diag_AI ENTE_coolant_therm_monitoring_AI ENTE_elec_ctl_therm_ratio_chk_AI ENTE_TCO_sensor_plaus_diag ENTE_TCO_sensor_plaus_diag_AI ENTE_coolant_temp_low_rat_chk ENTE_TCO_sensor_stuck_in_range_diag /end SUB_FUNCTION
/end FUNCTION
/begin FUNCTION ENTE_coolant_temp_plaus_diag "coolant_temp_plaus_diag"
 /begin DEF_CHARACTERISTIC id_tco_min_diag_tco_plaus ldp_tia_thr_st_id_t_tco_plaus ldp_ratio_t_is_ast_id_tco_diag ldp_tco_st_id_tco_min_diag_plaus ldp_tco_dif_diag_tco_plaus_id_t id_t_min_diag_tco_plaus id_t_max_diag_tco_plaus lc_tco_plaus_tco_sub_diag_inh lc_t_dly_tco_plaus /end DEF_CHARACTERISTIC
 /begin OUT_MEASUREMENT lv_err_tco_plaus t_min_diag_tco_plaus lv_end_diag_rbm_tco_plaus tco_dif_diag_tco_plaus t_ast_max_diag_tco_plaus t_ast_diag_tco_plaus lv_inh_diag_tco_plaus lv_inh_diag_rbm_tco_plaus state_rbm_tco_plaus /end OUT_MEASUREMENT
/end FUNCTION
/begin FUNCTION ENTE_coolant_therm_monitoring "coolant_therm_monitoring"
 /begin DEF_CHARACTERISTIC c_tia_st_min_diag_th c_ratio_t_puc_thd_diag_th c_ratio_t_vs_max_thd_diag_th c_ratio_t_vs_min_thd_diag_th c_ratio_t_load_min_thd_diag_th c_n_max_diag_th c_t_tco_de_diag_th c_tco_st_max_diag_th c_tia_de_max_diag_th c_tco_de_max_diag_th c_tco_th_open_diag_th c_tco_st_min_diag_th c_tco_wup_min_diag_th /end DEF_CHARACTERISTIC
 /begin OUT_MEASUREMENT lv_err_th tia_min_diag_th t_tco_de_diag_th tia_de_diag_th tco_de_ini_diag_th lv_tco_de_max_diag_th tco_de_diag_th tco_diag_th lv_end_diag_rbm_th lv_act_diag_th lv_act_diag_rbm_th lv_cnl_diag_th lv_cdn_temp_diag_th /end OUT_MEASUREMENT
/end FUNCTION
/begin FUNCTION ENTE_elec_ctl_therm_ratio_chk "elec_ctl_therm_ratio_chk" /end FUNCTION
/begin FUNCTION ENTE_coolant_temp_plaus_diag_AI "coolant_temp_plaus_diag_AI" /end FUNCTION
/begin FUNCTION ENTE_coolant_therm_monitoring_AI "coolant_therm_monitoring_AI" /end FUNCTION
/begin FUNCTION ENTE_elec_ctl_therm_ratio_chk_AI "elec_ctl_therm_ratio_chk_AI"
 /begin DEF_CHARACTERISTIC c_abc_inc_th c_abc_max_th c_tia_de_max_inh_diag_th c_tam_min_diag_th c_n_rel_cwp_min_diag_th c_mass_vol_cwp_min_diag_th c_mass_vol_cwp_max c_t_ectpwm_inh_diag_th c_t_ecfpwm_inh_diag_th c_ectpwm_inh_diag_th c_ecfpwm_inh_diag_th[0] c_ecfpwm_inh_diag_th[1] ldp_tco_sub_id_n_rel_cwp_max id_n_rel_cwp_max_diag_th c_t_n_rel_cwp_max_diag_th /end DEF_CHARACTERISTIC
 /begin OUT_MEASUREMENT state_rbm_th lv_inh_diag_th lv_inh_diag_rbm_th lv_n_rel_cwp_inh_diag_th lv_tia_de_inh_diag_th mass_vol_cwp_diag_th tia_min_inh_diag_th tia_de_inh_diag_th mass_vol_cwp_diag_th_tmp t_ectpwm_inh_diag_th t_ecfpwm_inh_diag_th lv_ectpwm_inh_diag_th lv_ecfpwm_inh_diag_th t_n_rel_cwp_max_diag_th /end OUT_MEASUREMENT
/end FUNCTION
/begin FUNCTION ENTE_TCO_sensor_plaus_diag "TCO_sensor_plaus_diag"
 /begin DEF_CHARACTERISTIC ldp_tco_st_ip_ctr_tco_2_plaus c_t_dly_tco_2_plaus c_tco_2_dif_min_tco_2_plaus c_vs_min_tco_2_plaus c_n_min_tco_2_plaus c_tco_min_tco_2_plaus c_tco_st_max_tco_2_plaus c_tco_st_min_tco_2_plaus c_tia_thr_st_max_tco_2_plaus c_tia_thr_st_min_tco_2_plaus c_tco_st_thd_tco_2_plaus c_tco_st_dif_min_tco_2_plaus c_ctr_dly_inc_tco_2_plaus ldp_tia_thr_st_ip_ctr_tco_plaus ip_ctr_dly_tco_2_plaus /end DEF_CHARACTERISTIC
 /begin OUT_MEASUREMENT lv_err_tco_2_plaus lv_end_diag_rbm_tco_2_plaus lv_tco_2_plaus_ena tco_2_dif_tco_2_plaus ctr_dly_tco_2_plaus t_dly_tco_2_plaus tco_2_plaus_h tco_2_plaus_l /end OUT_MEASUREMENT
/end FUNCTION
/begin FUNCTION ENTE_TCO_sensor_plaus_diag_AI "TCO_sensor_plaus_diag_AI" /end FUNCTION
/begin FUNCTION ENTE_coolant_temp_low_rat_chk "coolant_temp_low_rat_chk"
 /begin DEF_CHARACTERISTIC ip_tco_sub_dif_diag_tco_stuck ip_tco_mes_dif_diag_tco_stuck /end DEF_CHARACTERISTIC
 /begin OUT_MEASUREMENT tco_mes_min_diag_tco_stuck tco_sub_dif_diag_tco_stuck tco_sub_max_diag_tco_stuck tco_sub_min_diag_tco_stuck lv_err_tco_stuck tco_mes_max_diag_tco_stuck tco_mes_dif_diag_tco_stuck /end OUT_MEASUREMENT
/end FUNCTION
/begin FUNCTION ENTE_TCO_sensor_stuck_in_range_diag "ENTE_TCO_sensor_stuck_in_range_diag"
 /begin DEF_CHARACTERISTIC ip_tco_st_tco_stuck_rng c_t_es_min_tco_stuck_rng c_tia_thr_st_max_tco_stuck_rng c_tia_thr_st_min_tco_stuck_rng ldp_tia_thr_st_ip_tco_st ip_tco_st_dif_tia_thr_st ldpm_t_es_tco_stuck_rng c_tia_tam_dif_max_tco_stuck_rng c_tam_st_min_tco_stuck_rng c_t_ast_min_tco_stuck_rng /end DEF_CHARACTERISTIC
 /begin OUT_MEASUREMENT lv_err_tco_stuck_rng tco_st_stuck_rng lv_inh_diag_tco_stuck_rng state_rbm_tco_stuck_rng /end OUT_MEASUREMENT
/end FUNCTION
/begin FUNCTION C_2_ENTE "" /begin SUB_FUNCTION ENTE_require_to_infra_interf /end SUB_FUNCTION /end FUNCTION
/begin FUNCTION ENTE_require_to_infra_interf "require_to_infra_interf" /end FUNCTION
/begin FUNCTION C_D_ENTE "" /begin SUB_FUNCTION ENTE_torque_loss /end SUB_FUNCTION /end FUNCTION
/begin FUNCTION ENTE_torque_loss "torque_loss" /begin DEF_CHARACTERISTIC ip_pow_loss_ecf c_lgrd_tq_loss_ecf /end DEF_CHARACTERISTIC /begin OUT_MEASUREMENT tq_loss_ecf /end OUT_MEASUREMENT /end FUNCTION
/begin FUNCTION C_A_ENTE ""
 /begin SUB_FUNCTION ENTE_coolant_temp_sensor_diag ENTE_coolant_temp_radiator_diag ENTE_elect_ctrl_therm_diag ENTE_coolant_temp_diag_interface ENTE_coolant_temp_sensor_diag_AI ENTE_coolant_temp_radiator_dg_AI ENTE_elect_ctrl_therm_diag_AI ENTE_cooling_fan_diag ENTE_cooling_fan_diag_AI /end SUB_FUNCTION
/end FUNCTION
/begin FUNCTION ENTE_coolant_temp_sensor_diag "coolant_temp_sensor_diag"
 /begin DEF_CHARACTERISTIC c_tia_thr_min_diag_tco_el c_t_ast_min_diag_tco_el c_ctr_abc_thd_tco_prel c_tco_mes_grd_max_diag_tco_grd c_vp_tco_max_diag_tco_el c_vp_tco_min_diag_tco_el /end DEF_CHARACTERISTIC
 /begin OUT_MEASUREMENT lv_err_tco_grd lv_err_tco_el lv_err_tco lv_err_tco_prel lv_cdn_ena_tco_prel lv_err_tco_prel_det /end OUT_MEASUREMENT
/end FUNCTION
/end MODULE
/end PROJECT
