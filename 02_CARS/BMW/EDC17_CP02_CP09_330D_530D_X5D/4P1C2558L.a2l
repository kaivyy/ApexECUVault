ASAP2_VERSION 1 4
/begin PROJECT P_558 "EDC17_CP02"
/begin HEADER "" VERSION "V1C1" PROJECT_NO P_558 /end HEADER
/begin MODULE DIM ""
/begin MOD_COMMON "" BYTE_ORDER MSB_LAST ALIGNMENT_BYTE 1 ALIGNMENT_WORD 2 ALIGNMENT_LONG 4 ALIGNMENT_FLOAT32_IEEE 4 /end MOD_COMMON
/begin CHARACTERISTIC DFC_CtlMsk.DFC_AirCtlGovDvtEOMMax_C "/" VALUE 0x80071580 Val_Wu16 65535.00 DFES_OneToOne 0.00 65535.00 FORMAT "%8.2" /end CHARACTERISTIC
/begin CHARACTERISTIC DFC_CtlMsk.DFC_AirCtlGovDvtEOMMin_C "/" VALUE 0x80071582 Val_Wu16 65535.00 DFES_OneToOne 0.00 65535.00 FORMAT "%8.2" /end CHARACTERISTIC
/begin CHARACTERISTIC DFC_CtlMsk.DFC_AirCtlGovDvtMax_C "/" VALUE 0x80071584 Val_Wu16 65535.00 DFES_OneToOne 0.00 65535.00 FORMAT "%8.2" /end CHARACTERISTIC
/begin CHARACTERISTIC DFC_CtlMsk.DFC_AirCtlGovDvtMin_C "/" VALUE 0x80071586 Val_Wu16 65535.00 DFES_OneToOne 0.00 65535.00 FORMAT "%8.2" /end CHARACTERISTIC
/begin CHARACTERISTIC DFC_CtlMsk.DFC_Cj945SpiCom1_C "/" VALUE 0x80071588 Val_Wu16 65535.00 DFES_OneToOne 0.00 65535.00 FORMAT "%8.2" /end CHARACTERISTIC
/begin CHARACTERISTIC DFC_CtlMsk.DFC_ComButtonMSASig_C "/" VALUE 0x8007158A Val_Wu16 65535.00 DFES_OneToOne 0.00 65535.00 FORMAT "%8.2" /end CHARACTERISTIC
/begin CHARACTERISTIC DFC_CtlMsk.DFC_ComButtonMSATo_C "/" VALUE 0x8007158C Val_Wu16 65535.00 DFES_OneToOne 0.00 65535.00 FORMAT "%8.2" /end CHARACTERISTIC
/begin CHARACTERISTIC DFC_CtlMsk.DFC_ComGearboxData2Sig_C "/" VALUE 0x8007158E Val_Wu16 65535.00 DFES_OneToOne 0.00 65535.00 FORMAT "%8.2" /end CHARACTERISTIC
/begin CHARACTERISTIC DFC_CtlMsk.DFC_ComGearboxData2To_C "/" VALUE 0x80071590 Val_Wu16 65535.00 DFES_OneToOne 0.00 65535.00 FORMAT "%8.2" /end CHARACTERISTIC
/begin CHARACTERISTIC DFC_CtlMsk.DFC_ComGearboxDataSig_C "/" VALUE 0x80071592 Val_Wu16 65535.00 DFES_OneToOne 0.00 65535.00 FORMAT "%8.2" /end CHARACTERISTIC
/begin CHARACTERISTIC DFC_CtlMsk.DFC_ComGearboxDataTo_C "/" VALUE 0x80071594 Val_Wu16 65535.00 DFES_OneToOne 0.00 65535.00 FORMAT "%8.2" /end CHARACTERISTIC
/begin CHARACTERISTIC DFC_CtlMsk.DFC_ComHeatACSig_C "/" VALUE 0x80071596 Val_Wu16 65535.00 DFES_OneToOne 0.00 65535.00 FORMAT "%8.2" /end CHARACTERISTIC
/begin CHARACTERISTIC DFC_CtlMsk.DFC_ComHeatACTo_C "/" VALUE 0x80071598 Val_Wu16 65535.00 DFES_OneToOne 0.00 65535.00 FORMAT "%8.2" /end CHARACTERISTIC
/begin CHARACTERISTIC DFC_CtlMsk.DFC_ComLenkradwinkelSig_C "/" VALUE 0x8007159A Val_Wu16 65535.00 DFES_OneToOne 0.00 65535.00 FORMAT "%8.2" /end CHARACTERISTIC
/begin CHARACTERISTIC DFC_CtlMsk.DFC_ComLenkradwinkelTo_C "/" VALUE 0x8007159C Val_Wu16 65535.00 DFES_OneToOne 0.00 65535.00 FORMAT "%8.2" /end CHARACTERISTIC
/begin CHARACTERISTIC DFC_CtlMsk.DFC_ComMileageRangeSig_C "/" VALUE 0x8007159E Val_Wu16 65535.00 DFES_OneToOne 0.00 65535.00 FORMAT "%8.2" /end CHARACTERISTIC
/begin CHARACTERISTIC DFC_CtlMsk.DFC_ComMileageRangeTo_C "/" VALUE 0x800715A0 Val_Wu16 65535.00 DFES_OneToOne 0.00 65535.00 FORMAT "%8.2" /end CHARACTERISTIC
/begin CHARACTERISTIC DFC_CtlMsk.DFC_ComPspSig_C "/" VALUE 0x800715A2 Val_Wu16 65535.00 DFES_OneToOne 0.00 65535.00 FORMAT "%8.2" /end CHARACTERISTIC
/begin CHARACTERISTIC DFC_CtlMsk.DFC_ComPspTo_C "/" VALUE 0x800715A4 Val_Wu16 65535.00 DFES_OneToOne 0.00 65535.00 FORMAT "%8.2" /end CHARACTERISTIC
/begin CHARACTERISTIC DFC_CtlMsk.DFC_ComShutOffPSPSig_C "/" VALUE 0x800715A6 Val_Wu16 65535.00 DFES_OneToOne 0.00 65535.00 FORMAT "%8.2" /end CHARACTERISTIC
/begin CHARACTERISTIC DFC_CtlMsk.DFC_ComShutOffPSPTo_C "/" VALUE 0x800715A8 Val_Wu16 65535.00 DFES_OneToOne 0.00 65535.00 FORMAT "%8.2" /end CHARACTERISTIC
/begin CHARACTERISTIC DFC_CtlMsk.DFC_ComStKombiCtr_C "/" VALUE 0x800715AA Val_Wu16 65535.00 DFES_OneToOne 0.00 65535.00 FORMAT "%8.2" /end CHARACTERISTIC
/begin CHARACTERISTIC DFC_CtlMsk.DFC_ComStKombiSig_C "/" VALUE 0x800715AC Val_Wu16 65535.00 DFES_OneToOne 0.00 65535.00 FORMAT "%8.2" /end CHARACTERISTIC
/begin CHARACTERISTIC DFC_CtlMsk.DFC_ComStKombiTo_C "/" VALUE 0x800715AE Val_Wu16 65535.00 DFES_OneToOne 0.00 65535.00 FORMAT "%8.2" /end CHARACTERISTIC
/begin CHARACTERISTIC DFC_CtlMsk.DFC_ComStateARSCtr_C "/" VALUE 0x800715B0 Val_Wu16 65535.00 DFES_OneToOne 0.00 65535.00 FORMAT "%8.2" /end CHARACTERISTIC
/begin CHARACTERISTIC DFC_CtlMsk.DFC_ComStateARSSig_C "/" VALUE 0x800715B2 Val_Wu16 65535.00 DFES_OneToOne 0.00 65535.00 FORMAT "%8.2" /end CHARACTERISTIC
/begin CHARACTERISTIC DFC_CtlMsk.DFC_ComStateARSTo_C "/" VALUE 0x800715B4 Val_Wu16 65535.00 DFES_OneToOne 0.00 65535.00 FORMAT "%8.2" /end CHARACTERISTIC
/begin CHARACTERISTIC DFC_CtlMsk.DFC_ComStateDscSig_C "/" VALUE 0x800715B6 Val_Wu16 65535.00 DFES_OneToOne 0.00 65535.00 FORMAT "%8.2" /end CHARACTERISTIC
/begin CHARACTERISTIC DFC_CtlMsk.DFC_ComStateDscTo_C "/" VALUE 0x800715B8 Val_Wu16 65535.00 DFES_OneToOne 0.00 65535.00 FORMAT "%8.2" /end CHARACTERISTIC
/begin CHARACTERISTIC DFC_CtlMsk.DFC_ComStateSeatSig_C "/" VALUE 0x800715BA Val_Wu16 65535.00 DFES_OneToOne 0.00 65535.00 FORMAT "%8.2" /end CHARACTERISTIC
/begin CHARACTERISTIC DFC_CtlMsk.DFC_ComStateSeatTo_C "/" VALUE 0x800715BC Val_Wu16 65535.00 DFES_OneToOne 0.00 65535.00 FORMAT "%8.2" /end CHARACTERISTIC
/begin CHARACTERISTIC DFC_CtlMsk.DFC_ComTempRelTimeSig_C "/" VALUE 0x800715BE Val_Wu16 65535.00 DFES_OneToOne 0.00 65535.00 FORMAT "%8.2" /end CHARACTERISTIC
/begin CHARACTERISTIC DFC_CtlMsk.DFC_ComTempRelTimeTo_C "/" VALUE 0x800715C0 Val_Wu16 65535.00 DFES_OneToOne 0.00 65535.00 FORMAT "%8.2" /end CHARACTERISTIC
/begin CHARACTERISTIC DFC_CtlMsk.DFC_ComTerminalChk_C "/" VALUE 0x800715C2 Val_Wu16 65535.00 DFES_OneToOne 0.00 65535.00 FORMAT "%8.2" /end CHARACTERISTIC
/begin CHARACTERISTIC DFC_CtlMsk.DFC_ComTerminalCtr_C "/" VALUE 0x800715C4 Val_Wu16 65535.00 DFES_OneToOne 0.00 65535.00 FORMAT "%8.2" /end CHARACTERISTIC
/begin CHARACTERISTIC DFC_CtlMsk.DFC_ComTerminalSig_C "/" VALUE 0x800715C6 Val_Wu16 65535.00 DFES_OneToOne 0.00 65535.00 FORMAT "%8.2" /end CHARACTERISTIC
/begin CHARACTERISTIC DFC_CtlMsk.DFC_ComTerminalTo_C "/" VALUE 0x800715C8 Val_Wu16 65535.00 DFES_OneToOne 0.00 65535.00 FORMAT "%8.2" /end CHARACTERISTIC
/begin CHARACTERISTIC DFC_CtlMsk.DFC_ComTimeDateSig_C "/" VALUE 0x800715CA Val_Wu16 65535.00 DFES_OneToOne 0.00 65535.00 FORMAT "%8.2" /end CHARACTERISTIC
/begin CHARACTERISTIC DFC_CtlMsk.DFC_ComTimeDateTo_C "/" VALUE 0x800715CC Val_Wu16 65535.00 DFES_OneToOne 0.00 65535.00 FORMAT "%8.2" /end CHARACTERISTIC
/begin CHARACTERISTIC DFC_CtlMsk.DFC_ComTrailerSig_C "/" VALUE 0x800715CE Val_Wu16 65535.00 DFES_OneToOne 0.00 65535.00 FORMAT "%8.2" /end CHARACTERISTIC
/begin CHARACTERISTIC DFC_CtlMsk.DFC_ComTrailerTo_C "/" VALUE 0x800715D0 Val_Wu16 65535.00 DFES_OneToOne 0.00 65535.00 FORMAT "%8.2" /end CHARACTERISTIC
/begin CHARACTERISTIC DFC_CtlMsk.DFC_ComTrqDemandAfsChk_C "/" VALUE 0x800715D2 Val_Wu16 65535.00 DFES_OneToOne 0.00 65535.00 FORMAT "%8.2" /end CHARACTERISTIC
/begin CHARACTERISTIC DFC_CtlMsk.DFC_ComTrqDemandAfsCtr_C "/" VALUE 0x800715D4 Val_Wu16 65535.00 DFES_OneToOne 0.00 65535.00 FORMAT "%8.2" /end CHARACTERISTIC
/begin CHARACTERISTIC DFC_CtlMsk.DFC_ComTrqDemandAfsSig_C "/" VALUE 0x800715D6 Val_Wu16 65535.00 DFES_OneToOne 0.00 65535.00 FORMAT "%8.2" /end CHARACTERISTIC
/begin CHARACTERISTIC DFC_CtlMsk.DFC_ComTrqDemandAfsTo_C "/" VALUE 0x800715D8 Val_Wu16 65535.00 DFES_OneToOne 0.00 65535.00 FORMAT "%8.2" /end CHARACTERISTIC
/begin CHARACTERISTIC DFC_CtlMsk.DFC_ComTrqDemandDscChk_C "/" VALUE 0x800715DA Val_Wu16 65535.00 DFES_OneToOne 0.00 65535.00 FORMAT "%8.2" /end CHARACTERISTIC
/begin CHARACTERISTIC DFC_CtlMsk.DFC_ComTrqDemandDscCtr_C "/" VALUE 0x800715DC Val_Wu16 65535.00 DFES_OneToOne 0.00 65535.00 FORMAT "%8.2" /end CHARACTERISTIC
/begin CHARACTERISTIC DFC_CtlMsk.DFC_ComTrqDemandDscSig_C "/" VALUE 0x800715DE Val_Wu16 65535.00 DFES_OneToOne 0.00 65535.00 FORMAT "%8.2" /end CHARACTERISTIC
/begin CHARACTERISTIC DFC_CtlMsk.DFC_ComTrqDemandDscTo_C "/" VALUE 0x800715E0 Val_Wu16 65535.00 DFES_OneToOne 0.00 65535.00 FORMAT "%8.2" /end CHARACTERISTIC
/begin CHARACTERISTIC DFC_CtlMsk.DFC_ComTrqDemandGbxChk_C "/" VALUE 0x800715E2 Val_Wu16 65535.00 DFES_OneToOne 0.00 65535.00 FORMAT "%8.2" /end CHARACTERISTIC
/begin CHARACTERISTIC DFC_CtlMsk.DFC_ComTrqDemandGbxCtr_C "/" VALUE 0x800715E4 Val_Wu16 65535.00 DFES_OneToOne 0.00 65535.00 FORMAT "%8.2" /end CHARACTERISTIC
/begin CHARACTERISTIC DFC_CtlMsk.DFC_ComTrqDemandGbxSig_C "/" VALUE 0x800715E6 Val_Wu16 65535.00 DFES_OneToOne 0.00 65535.00 FORMAT "%8.2" /end CHARACTERISTIC
/begin CHARACTERISTIC DFC_CtlMsk.DFC_ComTrqDemandGbxTo_C "/" VALUE 0x800715E8 Val_Wu16 65535.00 DFES_OneToOne 0.00 65535.00 FORMAT "%8.2" /end CHARACTERISTIC
/begin CHARACTERISTIC DFC_CtlMsk.DFC_ComVelocitySig_C "/" VALUE 0x800715EA Val_Wu16 65535.00 DFES_OneToOne 0.00 65535.00 FORMAT "%8.2" /end CHARACTERISTIC
/begin CHARACTERISTIC DFC_CtlMsk.DFC_ComVelocityTo_C "/" VALUE 0x800715EC Val_Wu16 65535.00 DFES_OneToOne 0.00 65535.00 FORMAT "%8.2" /end CHARACTERISTIC
/begin CHARACTERISTIC DFC_CtlMsk.DFC_ComWheelSpeedSig_C "/" VALUE 0x800715EE Val_Wu16 65535.00 DFES_OneToOne 0.00 65535.00 FORMAT "%8.2" /end CHARACTERISTIC
/begin CHARACTERISTIC DFC_CtlMsk.DFC_ComWheelSpeedTo_C "/" VALUE 0x800715F0 Val_Wu16 65535.00 DFES_OneToOne 0.00 65535.00 FORMAT "%8.2" /end CHARACTERISTIC
/begin CHARACTERISTIC DFC_CtlMsk.DFC_ComZvKlappenSig_C "/" VALUE 0x800715F2 Val_Wu16 65535.00 DFES_OneToOne 0.00 65535.00 FORMAT "%8.2" /end CHARACTERISTIC
/begin CHARACTERISTIC DFC_CtlMsk.DFC_ComZvKlappenTo_C "/" VALUE 0x800715F4 Val_Wu16 65535.00 DFES_OneToOne 0.00 65535.00 FORMAT "%8.2" /end CHARACTERISTIC
/begin CHARACTERISTIC DFC_CtlMsk.DFC_Cy150SpiCom_C "/" VALUE 0x800715F6 Val_Wu16 65535.00 DFES_OneToOne 0.00 65535.00 FORMAT "%8.2" /end CHARACTERISTIC
/begin CHARACTERISTIC DFC_CtlMsk.DFC_Cy320SpiCom_C "/" VALUE 0x800715F8 Val_Wu16 65535.00 DFES_OneToOne 0.00 65535.00 FORMAT "%8.2" /end CHARACTERISTIC
/begin CHARACTERISTIC DFC_CtlMsk.DFC_ETCtlDvtInrMax_C "/" VALUE 0x800715FA Val_Wu16 65535.00 DFES_OneToOne 0.00 65535.00 FORMAT "%8.2" /end CHARACTERISTIC
/begin CHARACTERISTIC DFC_CtlMsk.DFC_ETCtlDvtInrMin_C "/" VALUE 0x800715FC Val_Wu16 65535.00 DFES_OneToOne 0.00 65535.00 FORMAT "%8.2" /end CHARACTERISTIC
/begin CHARACTERISTIC DFC_CtlMsk.DFC_ETCtlDvtOutrMax_C "/" VALUE 0x800715FE Val_Wu16 65535.00 DFES_OneToOne 0.00 65535.00 FORMAT "%8.2" /end CHARACTERISTIC
/begin CHARACTERISTIC DFC_CtlMsk.DFC_ETCtlDvtOutrMin_C "/" VALUE 0x80071600 Val_Wu16 65535.00 DFES_OneToOne 0.00 65535.00 FORMAT "%8.2" /end CHARACTERISTIC
/begin CHARACTERISTIC DFC_CtlMsk.DFC_Fan4WinErr1_C "/" VALUE 0x80071602 Val_Wu16 65535.00 DFES_OneToOne 0.00 65535.00 FORMAT "%8.2" /end CHARACTERISTIC
/begin CHARACTERISTIC DFC_CtlMsk.DFC_Fan4WinErr2_C "/" VALUE 0x80071604 Val_Wu16 65535.00 DFES_OneToOne 0.00 65535.00 FORMAT "%8.2" /end CHARACTERISTIC
/begin CHARACTERISTIC DFC_CtlMsk.DFC_Fan4WinErr3_C "/" VALUE 0x80071606 Val_Wu16 65535.00 DFES_OneToOne 0.00 65535.00 FORMAT "%8.2" /end CHARACTERISTIC
/begin CHARACTERISTIC DFC_CtlMsk.DFC_Fan4WinErr4_C "/" VALUE 0x80071608 Val_Wu16 65535.00 DFES_OneToOne 0.00 65535.00 FORMAT "%8.2" /end CHARACTERISTIC
/begin CHARACTERISTIC DFC_CtlMsk.DFC_FanSCG_C "/" VALUE 0x8007160A Val_Wu16 65535.00 DFES_OneToOne 0.00 65535.00 FORMAT "%8.2" /end CHARACTERISTIC
/begin CHARACTERISTIC DFC_CtlMsk.DFC_PCRGovDvtLPMax_C "/" VALUE 0x8007160C Val_Wu16 65535.00 DFES_OneToOne 0.00 65535.00 FORMAT "%8.2" /end CHARACTERISTIC
/begin CHARACTERISTIC DFC_CtlMsk.DFC_PCRGovDvtLPMin_C "/" VALUE 0x8007160E Val_Wu16 65535.00 DFES_OneToOne 0.00 65535.00 FORMAT "%8.2" /end CHARACTERISTIC
/begin CHARACTERISTIC DFC_CtlMsk.DFC_PCRGovDvtMax_C "/" VALUE 0x80071610 Val_Wu16 65535.00 DFES_OneToOne 0.00 65535.00 FORMAT "%8.2" /end CHARACTERISTIC
/begin CHARACTERISTIC DFC_CtlMsk.DFC_PCRGovDvtMin_C "/" VALUE 0x80071612 Val_Wu16 65535.00 DFES_OneToOne 0.00 65535.00 FORMAT "%8.2" /end CHARACTERISTIC
/begin CHARACTERISTIC DFC_CtlMsk.DFC_RailCPC1_C "/" VALUE 0x80071614 Val_Wu16 65535.00 DFES_OneToOne 0.00 65535.00 FORMAT "%8.2" /end CHARACTERISTIC
/begin CHARACTERISTIC DFC_CtlMsk.DFC_RailCPC3_C "/" VALUE 0x80071616 Val_Wu16 65535.00 DFES_OneToOne 0.00 65535.00 FORMAT "%8.2" /end CHARACTERISTIC
/begin CHARACTERISTIC DFC_CtlMsk.DFC_RailCPC4_C "/" VALUE 0x80071618 Val_Wu16 65535.00 DFES_OneToOne 0.00 65535.00 FORMAT "%8.2" /end CHARACTERISTIC
/begin CHARACTERISTIC DFC_CtlMsk.DFC_RailMeUn0_C "/" VALUE 0x8007161A Val_Wu16 65535.00 DFES_OneToOne 0.00 65535.00 FORMAT "%8.2" /end CHARACTERISTIC
/begin CHARACTERISTIC DFC_CtlMsk.DFC_RailMeUn1_C "/" VALUE 0x8007161C Val_Wu16 65535.00 DFES_OneToOne 0.00 65535.00 FORMAT "%8.2" /end CHARACTERISTIC
/begin CHARACTERISTIC DFC_CtlMsk.DFC_RailMeUn2_C "/" VALUE 0x8007161E Val_Wu16 65535.00 DFES_OneToOne 0.00 65535.00 FORMAT "%8.2" /end CHARACTERISTIC
/begin CHARACTERISTIC DFC_CtlMsk.DFC_RailMeUn3_C "/" VALUE 0x80071620 Val_Wu16 65535.00 DFES_OneToOne 0.00 65535.00 FORMAT "%8.2" /end CHARACTERISTIC
/begin CHARACTERISTIC DFC_CtlMsk.DFC_RailMeUn4_C "/" VALUE 0x80071622 Val_Wu16 65535.00 DFES_OneToOne 0.00 65535.00 FORMAT "%8.2" /end CHARACTERISTIC
/begin CHARACTERISTIC DFC_CtlMsk.DFC_RailPCV0_C "/" VALUE 0x80071624 Val_Wu16 65535.00 DFES_OneToOne 0.00 65535.00 FORMAT "%8.2" /end CHARACTERISTIC
/begin CHARACTERISTIC DFC_CtlMsk.DFC_RailPCV1_C "/" VALUE 0x80071626 Val_Wu16 65535.00 DFES_OneToOne 0.00 65535.00 FORMAT "%8.2" /end CHARACTERISTIC
/begin CHARACTERISTIC DFC_CtlMsk.DFC_RailPCV2_C "/" VALUE 0x80071628 Val_Wu16 65535.00 DFES_OneToOne 0.00 65535.00 FORMAT "%8.2" /end CHARACTERISTIC
/begin CHARACTERISTIC DFC_CtlMsk.DFC_RailPCV3_C "/" VALUE 0x8007162A Val_Wu16 65535.00 DFES_OneToOne 0.00 65535.00 FORMAT "%8.2" /end CHARACTERISTIC
/begin CHARACTERISTIC DFC_CtlMsk.DFC_RailPCV4_C "/" VALUE 0x8007162C Val_Wu16 65535.00 DFES_OneToOne 0.00 65535.00 FORMAT "%8.2" /end CHARACTERISTIC
/begin CHARACTERISTIC DFC_CtlMsk.DFC_RailPMonStrt_C "/" VALUE 0x8007162E Val_Wu16 65535.00 DFES_OneToOne 0.00 65535.00 FORMAT "%8.2" /end CHARACTERISTIC
/begin CHARACTERISTIC DFC_CtlMsk.DFC_SSpMon1_C "/" VALUE 0x80071630 Val_Wu16 65535.00 DFES_OneToOne 0.00 65535.00 FORMAT "%8.2" /end CHARACTERISTIC
/begin CHARACTERISTIC DFC_CtlMsk.DFC_SSpMon2_C "/" VALUE 0x80071632 Val_Wu16 65535.00 DFES_OneToOne 0.00 65535.00 FORMAT "%8.2" /end CHARACTERISTIC
/begin CHARACTERISTIC DFC_CtlMsk.DFC_SSpMon3_C "/" VALUE 0x80071634 Val_Wu16 65535.00 DFES_OneToOne 0.00 65535.00 FORMAT "%8.2" /end CHARACTERISTIC
/begin CHARACTERISTIC DFC_CtlMsk.DFC_Sia_E1_C "/" VALUE 0x80071636 Val_Wu16 65535.00 DFES_OneToOne 0.00 65535.00 FORMAT "%8.2" /end CHARACTERISTIC
/begin CHARACTERISTIC DFC_CtlMsk.DFC_Sia_E10_C "/" VALUE 0x80071638 Val_Wu16 65535.00 DFES_OneToOne 0.00 65535.00 FORMAT "%8.2" /end CHARACTERISTIC
/begin CHARACTERISTIC DFC_CtlMsk.DFC_Sia_E11_C "/" VALUE 0x8007163A Val_Wu16 65535.00 DFES_OneToOne 0.00 65535.00 FORMAT "%8.2" /end CHARACTERISTIC
/begin CHARACTERISTIC DFC_CtlMsk.DFC_Sia_E12_C "/" VALUE 0x8007163C Val_Wu16 65535.00 DFES_OneToOne 0.00 65535.00 FORMAT "%8.2" /end CHARACTERISTIC
/begin CHARACTERISTIC DFC_CtlMsk.DFC_Sia_E13_C "/" VALUE 0x8007163E Val_Wu16 65535.00 DFES_OneToOne 0.00 65535.00 FORMAT "%8.2" /end CHARACTERISTIC
/begin CHARACTERISTIC DFC_CtlMsk.DFC_Sia_E14_C "/" VALUE 0x80071640 Val_Wu16 65535.00 DFES_OneToOne 0.00 65535.00 FORMAT "%8.2" /end CHARACTERISTIC
/begin CHARACTERISTIC DFC_CtlMsk.DFC_Sia_E15_C "/" VALUE 0x80071642 Val_Wu16 65535.00 DFES_OneToOne 0.00 65535.00 FORMAT "%8.2" /end CHARACTERISTIC
/begin CHARACTERISTIC DFC_CtlMsk.DFC_Sia_E2_C "/" VALUE 0x80071644 Val_Wu16 65535.00 DFES_OneToOne 0.00 65535.00 FORMAT "%8.2" /end CHARACTERISTIC
/begin CHARACTERISTIC DFC_CtlMsk.DFC_Sia_E3_C "/" VALUE 0x80071646 Val_Wu16 65535.00 DFES_OneToOne 0.00 65535.00 FORMAT "%8.2" /end CHARACTERISTIC
/begin CHARACTERISTIC DFC_CtlMsk.DFC_Sia_E4_C "/" VALUE 0x80071648 Val_Wu16 65535.00 DFES_OneToOne 0.00 65535.00 FORMAT "%8.2" /end CHARACTERISTIC
/begin CHARACTERISTIC DFC_CtlMsk.DFC_Sia_E5_C "/" VALUE 0x8007164A Val_Wu16 65535.00 DFES_OneToOne 0.00 65535.00 FORMAT "%8.2" /end CHARACTERISTIC
/begin CHARACTERISTIC DFC_CtlMsk.DFC_Sia_E6_C "/" VALUE 0x8007164C Val_Wu16 65535.00 DFES_OneToOne 0.00 65535.00 FORMAT "%8.2" /end CHARACTERISTIC
/begin CHARACTERISTIC DFC_CtlMsk.DFC_Sia_E7_C "/" VALUE 0x8007164E Val_Wu16 65535.00 DFES_OneToOne 0.00 65535.00 FORMAT "%8.2" /end CHARACTERISTIC
/begin CHARACTERISTIC DFC_CtlMsk.DFC_Sia_E8_C "/" VALUE 0x80071650 Val_Wu16 65535.00 DFES_OneToOne 0.00 65535.00 FORMAT "%8.2" /end CHARACTERISTIC
/begin CHARACTERISTIC DFC_CtlMsk.DFC_Sia_E9_C "/" VALUE 0x80071652 Val_Wu16 65535.00 DFES_OneToOne 0.00 65535.00 FORMAT "%8.2" /end CHARACTERISTIC
/begin CHARACTERISTIC DFC_CtlMsk.DFC_ThrVlv4WinErr1_C "/" VALUE 0x80071654 Val_Wu16 65535.00 DFES_OneToOne 0.00 65535.00 FORMAT "%8.2" /end CHARACTERISTIC
/begin CHARACTERISTIC DFC_CtlMsk.DFC_ThrVlv4WinErr2_C "/" VALUE 0x80071656 Val_Wu16 65535.00 DFES_OneToOne 0.00 65535.00 FORMAT "%8.2" /end CHARACTERISTIC
/begin CHARACTERISTIC DFC_CtlMsk.DFC_ThrVlv4WinErr3_C "/" VALUE 0x80071658 Val_Wu16 65535.00 DFES_OneToOne 0.00 65535.00 FORMAT "%8.2" /end CHARACTERISTIC
/begin CHARACTERISTIC DFC_CtlMsk.DFC_ThrVlv4WinErr4_C "/" VALUE 0x8007165A Val_Wu16 65535.00 DFES_OneToOne 0.00 65535.00 FORMAT "%8.2" /end CHARACTERISTIC
/begin CHARACTERISTIC DFC_CtlMsk.DFC_ThrVlvSCG_C "/" VALUE 0x8007165C Val_Wu16 65535.00 DFES_OneToOne 0.00 65535.00 FORMAT "%8.2" /end CHARACTERISTIC
/begin CHARACTERISTIC DFC_CtlMsk.DFC_TrbCh4WinErr1_C "/" VALUE 0x8007165E Val_Wu16 65535.00 DFES_OneToOne 0.00 65535.00 FORMAT "%8.2" /end CHARACTERISTIC
/begin CHARACTERISTIC DFC_CtlMsk.DFC_TrbCh4WinErr2_C "/" VALUE 0x80071660 Val_Wu16 65535.00 DFES_OneToOne 0.00 65535.00 FORMAT "%8.2" /end CHARACTERISTIC
/begin CHARACTERISTIC DFC_CtlMsk.DFC_TrbCh4WinErr3_C "/" VALUE 0x80071662 Val_Wu16 65535.00 DFES_OneToOne 0.00 65535.00 FORMAT "%8.2" /end CHARACTERISTIC
/begin CHARACTERISTIC DFC_CtlMsk.DFC_TrbCh4WinErr4_C "/" VALUE 0x80071664 Val_Wu16 65535.00 DFES_OneToOne 0.00 65535.00 FORMAT "%8.2" /end CHARACTERISTIC
/begin CHARACTERISTIC DFC_CtlMsk.DFC_TrbChSCG_C "/" VALUE 0x80071666 Val_Wu16 65535.00 DFES_OneToOne 0.00 65535.00 FORMAT "%8.2" /end CHARACTERISTIC
/begin CHARACTERISTIC DFC_CtlMsk.DFC_TrbChSRCMax_C "/" VALUE 0x80071668 Val_Wu16 65535.00 DFES_OneToOne 0.00 65535.00 FORMAT "%8.2" /end CHARACTERISTIC
/begin CHARACTERISTIC DFC_CtlMsk.DFC_TrbChSRCMin_C "/" VALUE 0x8007166A Val_Wu16 65535.00 DFES_OneToOne 0.00 65535.00 FORMAT "%8.2" /end CHARACTERISTIC
/begin CHARACTERISTIC DFC_CtlMsk.DFC_WaHtEl4WinErr1_C "/" VALUE 0x8007166C Val_Wu16 65535.00 DFES_OneToOne 0.00 65535.00 FORMAT "%8.2" /end CHARACTERISTIC
/begin CHARACTERISTIC DFC_CtlMsk.DFC_WaHtEl4WinErr2_C "/" VALUE 0x8007166E Val_Wu16 65535.00 DFES_OneToOne 0.00 65535.00 FORMAT "%8.2" /end CHARACTERISTIC
/begin CHARACTERISTIC DFC_CtlMsk.DFC_WaHtEl4WinErr3_C "/" VALUE 0x80071670 Val_Wu16 65535.00 DFES_OneToOne 0.00 65535.00 FORMAT "%8.2" /end CHARACTERISTIC
/begin CHARACTERISTIC DFC_CtlMsk.DFC_WaHtEl4WinErr4_C "/" VALUE 0x80071672 Val_Wu16 65535.00 DFES_OneToOne 0.00 65535.00 FORMAT "%8.2" /end CHARACTERISTIC
/begin CHARACTERISTIC DFC_CtlMsk.DFC_WaHtElSCG_C "/" VALUE 0x80071674 Val_Wu16 65535.00 DFES_OneToOne 0.00 65535.00 FORMAT "%8.2" /end CHARACTERISTIC
/begin CHARACTERISTIC DFC_CtlMsk.DFC_ETClbETFltMax_C "/" VALUE 0x80071676 Val_Wu16 65535.00 DFES_OneToOne 0.00 65535.00 FORMAT "%8.2" /end CHARACTERISTIC
/begin CHARACTERISTIC DFC_CtlMsk.DFC_ETClbETFltMin_C "/" VALUE 0x80071678 Val_Wu16 65535.00 DFES_OneToOne 0.00 65535.00 FORMAT "%8.2" /end CHARACTERISTIC
/begin CHARACTERISTIC DFC_CtlMsk.DFC_InjCrvInjLimChrgBal_C "/" VALUE 0x8007167A Val_Wu16 65535.00 DFES_OneToOne 0.00 65535.00 FORMAT "%8.2" /end CHARACTERISTIC
/begin CHARACTERISTIC DFC_CtlMsk.DFC_InjCrvInjLimQntBal_C "/" VALUE 0x8007167C Val_Wu16 65535.00 DFES_OneToOne 0.00 65535.00 FORMAT "%8.2" /end CHARACTERISTIC
/begin CHARACTERISTIC DFC_CtlMsk.DFC_InjCrvInjLimSys_C "/" VALUE 0x8007167E Val_Wu16 65535.00 DFES_OneToOne 0.00 65535.00 FORMAT "%8.2" /end CHARACTERISTIC
/begin CHARACTERISTIC DFC_CtlMsk.DFC_InjCrvNumInjRtmLim_C "/" VALUE 0x80071680 Val_Wu16 65535.00 DFES_OneToOne 0.00 65535.00 FORMAT "%8.2" /end CHARACTERISTIC
/begin CHARACTERISTIC DFC_CtlMsk.DFC_LSUHtCoupSig_0_C "/" VALUE 0x80071682 Val_Wu16 65535.00 DFES_OneToOne 0.00 65535.00 FORMAT "%8.2" /end CHARACTERISTIC
/begin CHARACTERISTIC DFC_CtlMsk.DFC_LSUHtCoupSig_1_C "/" VALUE 0x80071684 Val_Wu16 65535.00 DFES_OneToOne 0.00 65535.00 FORMAT "%8.2" /end CHARACTERISTIC
/begin CHARACTERISTIC DFC_CtlMsk.DFC_LSUHtCoupSig_2_C "/" VALUE 0x80071686 Val_Wu16 65535.00 DFES_OneToOne 0.00 65535.00 FORMAT "%8.2" /end CHARACTERISTIC
/begin CHARACTERISTIC DFC_CtlMsk.DFC_LSUHtCoupSig_3_C "/" VALUE 0x80071688 Val_Wu16 65535.00 DFES_OneToOne 0.00 65535.00 FORMAT "%8.2" /end CHARACTERISTIC
/begin CHARACTERISTIC DFC_CtlMsk.DFC_CtT_C "/" VALUE 0x8007168A Val_Wu16 65535.00 DFES_OneToOne 0.00 65535.00 FORMAT "%8.2" /end CHARACTERISTIC
/begin CHARACTERISTIC DFC_CtlMsk.DFC_DSMDummy_C "/" VALUE 0x8007168C Val_Wu16 65535.00 DFES_OneToOne 0.00 65535.00 FORMAT "%8.2" /end CHARACTERISTIC
/begin CHARACTERISTIC DFC_CtlMsk.DFC_MeUnOL_C "/" VALUE 0x8007168E Val_Wu16 65535.00 DFES_OneToOne 0.00 65535.00 FORMAT "%8.2" /end CHARACTERISTIC
/begin CHARACTERISTIC DFC_CtlMsk.DFC_MeUnSCB_C "/" VALUE 0x80071690 Val_Wu16 65535.00 DFES_OneToOne 0.00 65535.00 FORMAT "%8.2" /end CHARACTERISTIC
/begin CHARACTERISTIC DFC_CtlMsk.DFC_MeUnSRCMax_C "/" VALUE 0x80071692 Val_Wu16 65535.00 DFES_OneToOne 0.00 65535.00 FORMAT "%8.2" /end CHARACTERISTIC
/begin CHARACTERISTIC DFC_CtlMsk.DFC_MeUnSRCMin_C "/" VALUE 0x80071694 Val_Wu16 65535.00 DFES_OneToOne 0.00 65535.00 FORMAT "%8.2" /end CHARACTERISTIC
/begin CHARACTERISTIC DFC_CtlMsk.DFC_PCVOL_C "/" VALUE 0x80071696 Val_Wu16 65535.00 DFES_OneToOne 0.00 65535.00 FORMAT "%8.2" /end CHARACTERISTIC
/begin CHARACTERISTIC DFC_CtlMsk.DFC_PCVSCB_C "/" VALUE 0x80071698 Val_Wu16 65535.00 DFES_OneToOne 0.00 65535.00 FORMAT "%8.2" /end CHARACTERISTIC
/begin CHARACTERISTIC DFC_CtlMsk.DFC_PCVSRCMax_C "/" VALUE 0x8007169A Val_Wu16 65535.00 DFES_OneToOne 0.00 65535.00 FORMAT "%8.2" /end CHARACTERISTIC
/begin CHARACTERISTIC DFC_CtlMsk.DFC_PCVSRCMin_C "/" VALUE 0x8007169C Val_Wu16 65535.00 DFES_OneToOne 0.00 65535.00 FORMAT "%8.2" /end CHARACTERISTIC
/begin CHARACTERISTIC DFC_CtlMsk.DFC_RailPSRCMax_C "/" VALUE 0x8007169E Val_Wu16 65535.00 DFES_OneToOne 0.00 65535.00 FORMAT "%8.2" /end CHARACTERISTIC
/begin CHARACTERISTIC DFC_CtlMsk.DFC_RailPSRCMin_C "/" VALUE 0x800716A0 Val_Wu16 65535.00 DFES_OneToOne 0.00 65535.00 FORMAT "%8.2" /end CHARACTERISTIC
/begin CHARACTERISTIC DFC_CtlMsk.DFC_IVActrVltgSRCMax_C "/" VALUE 0x800716A2 Val_Wu16 65535.00 DFES_OneToOne 0.00 65535.00 FORMAT "%8.2" /end CHARACTERISTIC
/begin CHARACTERISTIC DFC_CtlMsk.DFC_IVActrVltgSRCMin_C "/" VALUE 0x800716A4 Val_Wu16 65535.00 DFES_OneToOne 0.00 65535.00 FORMAT "%8.2" /end CHARACTERISTIC
/begin CHARACTERISTIC DFC_CtlMsk.DFC_IVPSplyDCDC_C "/" VALUE 0x800716A6 Val_Wu16 65535.00 DFES_OneToOne 0.00 65535.00 FORMAT "%8.2" /end CHARACTERISTIC
/begin CHARACTERISTIC DFC_CtlMsk.DFC_IVPSplyVltgSRCMax_C "/" VALUE 0x800716A8 Val_Wu16 65535.00 DFES_OneToOne 0.00 65535.00 FORMAT "%8.2" /end CHARACTERISTIC
/begin CHARACTERISTIC DFC_CtlMsk.DFC_IVPSplyVltgSRCMin_C "/" VALUE 0x800716AA Val_Wu16 65535.00 DFES_OneToOne 0.00 65535.00 FORMAT "%8.2" /end CHARACTERISTIC
/begin CHARACTERISTIC DFC_CtlMsk.DFC_AFSOffsDrftMax_C "/" VALUE 0x800716AC Val_Wu16 65535.00 DFES_OneToOne 0.00 65535.00 FORMAT "%8.2" /end CHARACTERISTIC
/begin CHARACTERISTIC DFC_CtlMsk.DFC_AFSOffsDrftMin_C "/" VALUE 0x800716AE Val_Wu16 65535.00 DFES_OneToOne 0.00 65535.00 FORMAT "%8.2" /end CHARACTERISTIC
/begin CHARACTERISTIC DFC_CtlMsk.DFC_AFSSRCCorMax_C "/" VALUE 0x800716B0 Val_Wu16 65535.00 DFES_OneToOne 0.00 65535.00 FORMAT "%8.2" /end CHARACTERISTIC
/begin CHARACTERISTIC DFC_CtlMsk.DFC_AFSSRCCorMin_C "/" VALUE 0x800716B2 Val_Wu16 65535.00 DFES_OneToOne 0.00 65535.00 FORMAT "%8.2" /end CHARACTERISTIC
/begin CHARACTERISTIC DFC_CtlMsk.DFC_AFSSRCRawMax_C "/" VALUE 0x800716B4 Val_Wu16 65535.00 DFES_OneToOne 0.00 65535.00 FORMAT "%8.2" /end CHARACTERISTIC
/begin CHARACTERISTIC DFC_CtlMsk.DFC_AFSSRCRawMin_C "/" VALUE 0x800716B6 Val_Wu16 65535.00 DFES_OneToOne 0.00 65535.00 FORMAT "%8.2" /end CHARACTERISTIC
/begin CHARACTERISTIC DFC_CtlMsk.DFC_AFSSetyDrftMax_C "/" VALUE 0x800716B8 Val_Wu16 65535.00 DFES_OneToOne 0.00 65535.00 FORMAT "%8.2" /end CHARACTERISTIC
/begin CHARACTERISTIC DFC_CtlMsk.DFC_AFSSetyDrftMin_C "/" VALUE 0x800716BA Val_Wu16 65535.00 DFES_OneToOne 0.00 65535.00 FORMAT "%8.2" /end CHARACTERISTIC
/begin CHARACTERISTIC DFC_CtlMsk.DFC_AirCClntPAnaSRCMax_C "/" VALUE 0x800716BC Val_Wu16 65535.00 DFES_OneToOne 0.00 65535.00 FORMAT "%8.2" /end CHARACTERISTIC
/begin CHARACTERISTIC DFC_CtlMsk.DFC_AirCClntPAnaSRCMin_C "/" VALUE 0x800716BE Val_Wu16 65535.00 DFES_OneToOne 0.00 65535.00 FORMAT "%8.2" /end CHARACTERISTIC
/begin CHARACTERISTIC DFC_CtlMsk.DFC_AirCClntPPerSRCMax_C "/" VALUE 0x800716C0 Val_Wu16 65535.00 DFES_OneToOne 0.00 65535.00 FORMAT "%8.2" /end CHARACTERISTIC
/begin CHARACTERISTIC DFC_CtlMsk.DFC_AirCClntPPerSRCMin_C "/" VALUE 0x800716C2 Val_Wu16 65535.00 DFES_OneToOne 0.00 65535.00 FORMAT "%8.2" /end CHARACTERISTIC
/begin CHARACTERISTIC DFC_CtlMsk.DFC_AirCClntPdcycSRCMax_C "/" VALUE 0x800716C4 Val_Wu16 65535.00 DFES_OneToOne 0.00 65535.00 FORMAT "%8.2" /end CHARACTERISTIC
/begin CHARACTERISTIC DFC_CtlMsk.DFC_AirCClntPdcycSRCMin_C "/" VALUE 0x800716C6 Val_Wu16 65535.00 DFES_OneToOne 0.00 65535.00 FORMAT "%8.2" /end CHARACTERISTIC
/begin CHARACTERISTIC DFC_CtlMsk.DFC_AirCCmprOL_C "/" VALUE 0x800716C8 Val_Wu16 65535.00 DFES_OneToOne 0.00 65535.00 FORMAT "%8.2" /end CHARACTERISTIC
/begin CHARACTERISTIC DFC_CtlMsk.DFC_AirCCmprRedTrqOL_C "/" VALUE 0x800716CA Val_Wu16 65535.00 DFES_OneToOne 0.00 65535.00 FORMAT "%8.2" /end CHARACTERISTIC
/begin CHARACTERISTIC DFC_CtlMsk.DFC_AirCCmprRedTrqSCB_C "/" VALUE 0x800716CC Val_Wu16 65535.00 DFES_OneToOne 0.00 65535.00 FORMAT "%8.2" /end CHARACTERISTIC
/begin CHARACTERISTIC DFC_CtlMsk.DFC_AirCCmprRedTrqSCG_C "/" VALUE 0x800716CE Val_Wu16 65535.00 DFES_OneToOne 0.00 65535.00 FORMAT "%8.2" /end CHARACTERISTIC
/begin CHARACTERISTIC DFC_CtlMsk.DFC_AirCCmprSCB_C "/" VALUE 0x800716D0 Val_Wu16 65535.00 DFES_OneToOne 0.00 65535.00 FORMAT "%8.2" /end CHARACTERISTIC
/begin CHARACTERISTIC DFC_CtlMsk.DFC_AirCCmprSCG_C "/" VALUE 0x800716D2 Val_Wu16 65535.00 DFES_OneToOne 0.00 65535.00 FORMAT "%8.2" /end CHARACTERISTIC
/begin CHARACTERISTIC DFC_CtlMsk.DFC_AirCSwtNpl_C "/" VALUE 0x800716D4 Val_Wu16 65535.00 DFES_OneToOne 0.00 65535.00 FORMAT "%8.2" /end CHARACTERISTIC
/begin CHARACTERISTIC DFC_CtlMsk.DFC_AirCSwtSig_C "/" VALUE 0x800716D6 Val_Wu16 65535.00 DFES_OneToOne 0.00 65535.00 FORMAT "%8.2" /end CHARACTERISTIC
/begin CHARACTERISTIC DFC_CtlMsk.DFC_BattUSRCMax_C "/" VALUE 0x800716D8 Val_Wu16 65535.00 DFES_OneToOne 0.00 65535.00 FORMAT "%8.2" /end CHARACTERISTIC
/begin CHARACTERISTIC DFC_CtlMsk.DFC_BattUSRCMin_C "/" VALUE 0x800716DA Val_Wu16 65535.00 DFES_OneToOne 0.00 65535.00 FORMAT "%8.2" /end CHARACTERISTIC
/begin CHARACTERISTIC DFC_CtlMsk.DFC_BrkNpl_C "/" VALUE 0x800716DC Val_Wu16 65535.00 DFES_OneToOne 0.00 65535.00 FORMAT "%8.2" /end CHARACTERISTIC
/begin CHARACTERISTIC DFC_CtlMsk.DFC_BrkPSRCMax_C "/" VALUE 0x800716DE Val_Wu16 65535.00 DFES_OneToOne 0.00 65535.00 FORMAT "%8.2" /end CHARACTERISTIC
/begin CHARACTERISTIC DFC_CtlMsk.DFC_BrkPSRCMin_C "/" VALUE 0x800716E0 Val_Wu16 65535.00 DFES_OneToOne 0.00 65535.00 FORMAT "%8.2" /end CHARACTERISTIC
/begin CHARACTERISTIC DFC_CtlMsk.DFC_BrkSig_C "/" VALUE 0x800716E2 Val_Wu16 65535.00 DFES_OneToOne 0.00 65535.00 FORMAT "%8.2" /end CHARACTERISTIC
/begin CHARACTERISTIC DFC_CtlMsk.DFC_CByVlvOL_C "/" VALUE 0x800716E4 Val_Wu16 65535.00 DFES_OneToOne 0.00 65535.00 FORMAT "%8.2" /end CHARACTERISTIC
/begin CHARACTERISTIC DFC_CtlMsk.DFC_CByVlvSCB_C "/" VALUE 0x800716E6 Val_Wu16 65535.00 DFES_OneToOne 0.00 65535.00 FORMAT "%8.2" /end CHARACTERISTIC
/begin CHARACTERISTIC DFC_CtlMsk.DFC_CByVlvSCG_C "/" VALUE 0x800716E8 Val_Wu16 65535.00 DFES_OneToOne 0.00 65535.00 FORMAT "%8.2" /end CHARACTERISTIC
/begin CHARACTERISTIC DFC_CtlMsk.DFC_CEngDsTSRCMax_C "/" VALUE 0x800716EA Val_Wu16 65535.00 DFES_OneToOne 0.00 65535.00 FORMAT "%8.2" /end CHARACTERISTIC
/begin CHARACTERISTIC DFC_CtlMsk.DFC_CEngDsTSRCMin_C "/" VALUE 0x800716EC Val_Wu16 65535.00 DFES_OneToOne 0.00 65535.00 FORMAT "%8.2" /end CHARACTERISTIC
/begin CHARACTERISTIC DFC_CtlMsk.DFC_CEngDsTSig_C "/" VALUE 0x800716EE Val_Wu16 65535.00 DFES_OneToOne 0.00 65535.00 FORMAT "%8.2" /end CHARACTERISTIC
/begin CHARACTERISTIC DFC_CtlMsk.DFC_CEngUsTSRCMax_C "/" VALUE 0x800716F0 Val_Wu16 65535.00 DFES_OneToOne 0.00 65535.00 FORMAT "%8.2" /end CHARACTERISTIC
/begin CHARACTERISTIC DFC_CtlMsk.DFC_CEngUsTSRCMin_C "/" VALUE 0x800716F2 Val_Wu16 65535.00 DFES_OneToOne 0.00 65535.00 FORMAT "%8.2" /end CHARACTERISTIC
/begin CHARACTERISTIC DFC_CtlMsk.DFC_CThmstOL_C "/" VALUE 0x800716F4 Val_Wu16 65535.00 DFES_OneToOne 0.00 65535.00 FORMAT "%8.2" /end CHARACTERISTIC
/begin CHARACTERISTIC DFC_CtlMsk.DFC_CThmstSCB_C "/" VALUE 0x800716F6 Val_Wu16 65535.00 DFES_OneToOne 0.00 65535.00 FORMAT "%8.2" /end CHARACTERISTIC
/begin CHARACTERISTIC DFC_CtlMsk.DFC_CThmstSCG_C "/" VALUE 0x800716F8 Val_Wu16 65535.00 DFES_OneToOne 0.00 65535.00 FORMAT "%8.2" /end CHARACTERISTIC
/begin CHARACTERISTIC DFC_CtlMsk.DFC_ClthSig_C "/" VALUE 0x800716FA Val_Wu16 65535.00 DFES_OneToOne 0.00 65535.00 FORMAT "%8.2" /end CHARACTERISTIC
/begin CHARACTERISTIC DFC_CtlMsk.DFC_ECBVlvOL_C "/" VALUE 0x800716FC Val_Wu16 65535.00 DFES_OneToOne 0.00 65535.00 FORMAT "%8.2" /end CHARACTERISTIC
/begin CHARACTERISTIC DFC_CtlMsk.DFC_ECBVlvSCB_C "/" VALUE 0x800716FE Val_Wu16 65535.00 DFES_OneToOne 0.00 65535.00 FORMAT "%8.2" /end CHARACTERISTIC
/begin CHARACTERISTIC DFC_CtlMsk.DFC_ECBVlvSCG_C "/" VALUE 0x80071700 Val_Wu16 65535.00 DFES_OneToOne 0.00 65535.00 FORMAT "%8.2" /end CHARACTERISTIC
/begin CHARACTERISTIC DFC_CtlMsk.DFC_ECBVlvSRCMax_C "/" VALUE 0x80071702 Val_Wu16 65535.00 DFES_OneToOne 0.00 65535.00 FORMAT "%8.2" /end CHARACTERISTIC
/begin CHARACTERISTIC DFC_CtlMsk.DFC_ECBVlvSRCMin_C "/" VALUE 0x80071704 Val_Wu16 65535.00 DFES_OneToOne 0.00 65535.00 FORMAT "%8.2" /end CHARACTERISTIC
/begin CHARACTERISTIC DFC_CtlMsk.DFC_EGRVlvGovDvtMax_C "/" VALUE 0x80071706 Val_Wu16 65535.00 DFES_OneToOne 0.00 65535.00 FORMAT "%8.2" /end CHARACTERISTIC
/begin CHARACTERISTIC DFC_CtlMsk.DFC_EGRVlvGovDvtMin_C "/" VALUE 0x80071708 Val_Wu16 65535.00 DFES_OneToOne 0.00 65535.00 FORMAT "%8.2" /end CHARACTERISTIC
/begin CHARACTERISTIC DFC_CtlMsk.DFC_EGRVlvOL_C "/" VALUE 0x8007170A Val_Wu16 65535.00 DFES_OneToOne 0.00 65535.00 FORMAT "%8.2" /end CHARACTERISTIC
/begin CHARACTERISTIC DFC_CtlMsk.DFC_EGRVlvSCB_C "/" VALUE 0x8007170C Val_Wu16 65535.00 DFES_OneToOne 0.00 65535.00 FORMAT "%8.2" /end CHARACTERISTIC
/begin CHARACTERISTIC DFC_CtlMsk.DFC_EGRVlvSCG_C "/" VALUE 0x8007170E Val_Wu16 65535.00 DFES_OneToOne 0.00 65535.00 FORMAT "%8.2" /end CHARACTERISTIC
/begin CHARACTERISTIC DFC_CtlMsk.DFC_EGRVlvSRCMax_C "/" VALUE 0x80071710 Val_Wu16 65535.00 DFES_OneToOne 0.00 65535.00 FORMAT "%8.2" /end CHARACTERISTIC
/begin CHARACTERISTIC DFC_CtlMsk.DFC_EGRVlvSRCMin_C "/" VALUE 0x80071712 Val_Wu16 65535.00 DFES_OneToOne 0.00 65535.00 FORMAT "%8.2" /end CHARACTERISTIC
/begin CHARACTERISTIC DFC_CtlMsk.DFC_EMDmpOL_0_C "/" VALUE 0x80071714 Val_Wu16 65535.00 DFES_OneToOne 0.00 65535.00 FORMAT "%8.2" /end CHARACTERISTIC
/begin CHARACTERISTIC DFC_CtlMsk.DFC_EMDmpOL_1_C "/" VALUE 0x80071716 Val_Wu16 65535.00 DFES_OneToOne 0.00 65535.00 FORMAT "%8.2" /end CHARACTERISTIC
/begin CHARACTERISTIC DFC_CtlMsk.DFC_EMDmpSCB_0_C "/" VALUE 0x80071718 Val_Wu16 65535.00 DFES_OneToOne 0.00 65535.00 FORMAT "%8.2" /end CHARACTERISTIC
/begin CHARACTERISTIC DFC_CtlMsk.DFC_EMDmpSCB_1_C "/" VALUE 0x8007171A Val_Wu16 65535.00 DFES_OneToOne 0.00 65535.00 FORMAT "%8.2" /end CHARACTERISTIC
/begin CHARACTERISTIC DFC_CtlMsk.DFC_EMDmpSCG_0_C "/" VALUE 0x8007171C Val_Wu16 65535.00 DFES_OneToOne 0.00 65535.00 FORMAT "%8.2" /end CHARACTERISTIC
/begin CHARACTERISTIC DFC_CtlMsk.DFC_EMDmpSCG_1_C "/" VALUE 0x8007171E Val_Wu16 65535.00 DFES_OneToOne 0.00 65535.00 FORMAT "%8.2" /end CHARACTERISTIC
/begin CHARACTERISTIC DFC_CtlMsk.DFC_EngStAOL_C "/" VALUE 0x80071720 Val_Wu16 65535.00 DFES_OneToOne 0.00 65535.00 FORMAT "%8.2" /end CHARACTERISTIC
/begin CHARACTERISTIC DFC_CtlMsk.DFC_EngStASCB_C "/" VALUE 0x80071722 Val_Wu16 65535.00 DFES_OneToOne 0.00 65535.00 FORMAT "%8.2" /end CHARACTERISTIC
/begin CHARACTERISTIC DFC_CtlMsk.DFC_EngStASCG_C "/" VALUE 0x80071724 Val_Wu16 65535.00 DFES_OneToOne 0.00 65535.00 FORMAT "%8.2" /end CHARACTERISTIC
/begin CHARACTERISTIC DFC_CtlMsk.DFC_EnvPSRCMax_C "/" VALUE 0x80071726 Val_Wu16 65535.00 DFES_OneToOne 0.00 65535.00 FORMAT "%8.2" /end CHARACTERISTIC
/begin CHARACTERISTIC DFC_CtlMsk.DFC_EnvPSRCMin_C "/" VALUE 0x80071728 Val_Wu16 65535.00 DFES_OneToOne 0.00 65535.00 FORMAT "%8.2" /end CHARACTERISTIC
/begin CHARACTERISTIC DFC_CtlMsk.DFC_EnvPSig_C "/" VALUE 0x8007172A Val_Wu16 65535.00 DFES_OneToOne 0.00 65535.00 FORMAT "%8.2" /end CHARACTERISTIC
/begin CHARACTERISTIC DFC_CtlMsk.DFC_EnvTSRCMax_C "/" VALUE 0x8007172C Val_Wu16 65535.00 DFES_OneToOne 0.00 65535.00 FORMAT "%8.2" /end CHARACTERISTIC
/begin CHARACTERISTIC DFC_CtlMsk.DFC_EnvTSRCMin_C "/" VALUE 0x8007172E Val_Wu16 65535.00 DFES_OneToOne 0.00 65535.00 FORMAT "%8.2" /end CHARACTERISTIC
/begin CHARACTERISTIC DFC_CtlMsk.DFC_FanOL_C "/" VALUE 0x80071730 Val_Wu16 65535.00 DFES_OneToOne 0.00 65535.00 FORMAT "%8.2" /end CHARACTERISTIC
/begin CHARACTERISTIC DFC_CtlMsk.DFC_FanSCB_C "/" VALUE 0x80071732 Val_Wu16 65535.00 DFES_OneToOne 0.00 65535.00 FORMAT "%8.2" /end CHARACTERISTIC
/begin CHARACTERISTIC DFC_CtlMsk.DFC_FlFltSig_C "/" VALUE 0x80071734 Val_Wu16 65535.00 DFES_OneToOne 0.00 65535.00 FORMAT "%8.2" /end CHARACTERISTIC
/begin CHARACTERISTIC DFC_CtlMsk.DFC_FuelTSRCMax_C "/" VALUE 0x80071736 Val_Wu16 65535.00 DFES_OneToOne 0.00 65535.00 FORMAT "%8.2" /end CHARACTERISTIC
/begin CHARACTERISTIC DFC_CtlMsk.DFC_FuelTSRCMin_C "/" VALUE 0x80071738 Val_Wu16 65535.00 DFES_OneToOne 0.00 65535.00 FORMAT "%8.2" /end CHARACTERISTIC
/begin CHARACTERISTIC DFC_CtlMsk.DFC_GbxNPosPPerSRCMax_C "/" VALUE 0x8007173A Val_Wu16 65535.00 DFES_OneToOne 0.00 65535.00 FORMAT "%8.2" /end CHARACTERISTIC
/begin CHARACTERISTIC DFC_CtlMsk.DFC_GbxNPosPPerSRCMin_C "/" VALUE 0x8007173C Val_Wu16 65535.00 DFES_OneToOne 0.00 65535.00 FORMAT "%8.2" /end CHARACTERISTIC
/begin CHARACTERISTIC DFC_CtlMsk.DFC_GbxNPosPdcycSRCMax_C "/" VALUE 0x8007173E Val_Wu16 65535.00 DFES_OneToOne 0.00 65535.00 FORMAT "%8.2" /end CHARACTERISTIC
/begin CHARACTERISTIC DFC_CtlMsk.DFC_GbxNPosPdcycSRCMin_C "/" VALUE 0x80071740 Val_Wu16 65535.00 DFES_OneToOne 0.00 65535.00 FORMAT "%8.2" /end CHARACTERISTIC
/begin CHARACTERISTIC DFC_CtlMsk.DFC_GbxNPosSig_C "/" VALUE 0x80071742 Val_Wu16 65535.00 DFES_OneToOne 0.00 65535.00 FORMAT "%8.2" /end CHARACTERISTIC
/begin CHARACTERISTIC DFC_CtlMsk.DFC_GlwPlgBSDOL_0_C "/" VALUE 0x80071744 Val_Wu16 65535.00 DFES_OneToOne 0.00 65535.00 FORMAT "%8.2" /end CHARACTERISTIC
/begin CHARACTERISTIC DFC_CtlMsk.DFC_GlwPlgBSDOL_1_C "/" VALUE 0x80071746 Val_Wu16 65535.00 DFES_OneToOne 0.00 65535.00 FORMAT "%8.2" /end CHARACTERISTIC
/begin CHARACTERISTIC DFC_CtlMsk.DFC_GlwPlgBSDOL_2_C "/" VALUE 0x80071748 Val_Wu16 65535.00 DFES_OneToOne 0.00 65535.00 FORMAT "%8.2" /end CHARACTERISTIC
/begin CHARACTERISTIC DFC_CtlMsk.DFC_GlwPlgBSDOL_3_C "/" VALUE 0x8007174A Val_Wu16 65535.00 DFES_OneToOne 0.00 65535.00 FORMAT "%8.2" /end CHARACTERISTIC
/begin CHARACTERISTIC DFC_CtlMsk.DFC_GlwPlgBSDOL_4_C "/" VALUE 0x8007174C Val_Wu16 65535.00 DFES_OneToOne 0.00 65535.00 FORMAT "%8.2" /end CHARACTERISTIC
/begin CHARACTERISTIC DFC_CtlMsk.DFC_GlwPlgBSDOL_5_C "/" VALUE 0x8007174E Val_Wu16 65535.00 DFES_OneToOne 0.00 65535.00 FORMAT "%8.2" /end CHARACTERISTIC
/begin CHARACTERISTIC DFC_CtlMsk.DFC_GlwPlgBSDOL_6_C "/" VALUE 0x80071750 Val_Wu16 65535.00 DFES_OneToOne 0.00 65535.00 FORMAT "%8.2" /end CHARACTERISTIC
/begin CHARACTERISTIC DFC_CtlMsk.DFC_GlwPlgBSDOL_7_C "/" VALUE 0x80071752 Val_Wu16 65535.00 DFES_OneToOne 0.00 65535.00 FORMAT "%8.2" /end CHARACTERISTIC
/begin CHARACTERISTIC DFC_CtlMsk.DFC_GlwPlgBSDOT_0_C "/" VALUE 0x80071754 Val_Wu16 65535.00 DFES_OneToOne 0.00 65535.00 FORMAT "%8.2" /end CHARACTERISTIC
/begin CHARACTERISTIC DFC_CtlMsk.DFC_GlwPlgBSDOT_1_C "/" VALUE 0x80071756 Val_Wu16 65535.00 DFES_OneToOne 0.00 65535.00 FORMAT "%8.2" /end CHARACTERISTIC
/begin CHARACTERISTIC DFC_CtlMsk.DFC_GlwPlgBSDOT_2_C "/" VALUE 0x80071758 Val_Wu16 65535.00 DFES_OneToOne 0.00 65535.00 FORMAT "%8.2" /end CHARACTERISTIC
/begin CHARACTERISTIC DFC_CtlMsk.DFC_GlwPlgBSDOT_3_C "/" VALUE 0x8007175A Val_Wu16 65535.00 DFES_OneToOne 0.00 65535.00 FORMAT "%8.2" /end CHARACTERISTIC
/begin CHARACTERISTIC DFC_CtlMsk.DFC_GlwPlgBSDOT_4_C "/" VALUE 0x8007175C Val_Wu16 65535.00 DFES_OneToOne 0.00 65535.00 FORMAT "%8.2" /end CHARACTERISTIC
/begin CHARACTERISTIC DFC_CtlMsk.DFC_GlwPlgBSDOT_5_C "/" VALUE 0x8007175E Val_Wu16 65535.00 DFES_OneToOne 0.00 65535.00 FORMAT "%8.2" /end CHARACTERISTIC
/begin CHARACTERISTIC DFC_CtlMsk.DFC_GlwPlgBSDOT_6_C "/" VALUE 0x80071760 Val_Wu16 65535.00 DFES_OneToOne 0.00 65535.00 FORMAT "%8.2" /end CHARACTERISTIC
/begin CHARACTERISTIC DFC_CtlMsk.DFC_GlwPlgBSDOT_7_C "/" VALUE 0x80071762 Val_Wu16 65535.00 DFES_OneToOne 0.00 65535.00 FORMAT "%8.2" /end CHARACTERISTIC
/begin CHARACTERISTIC DFC_CtlMsk.DFC_GlwPlgBSDSC_0_C "/" VALUE 0x80071764 Val_Wu16 65535.00 DFES_OneToOne 0.00 65535.00 FORMAT "%8.2" /end CHARACTERISTIC
/begin CHARACTERISTIC DFC_CtlMsk.DFC_GlwPlgBSDSC_1_C "/" VALUE 0x80071766 Val_Wu16 65535.00 DFES_OneToOne 0.00 65535.00 FORMAT "%8.2" /end CHARACTERISTIC
/begin CHARACTERISTIC DFC_CtlMsk.DFC_GlwPlgBSDSC_2_C "/" VALUE 0x80071768 Val_Wu16 65535.00 DFES_OneToOne 0.00 65535.00 FORMAT "%8.2" /end CHARACTERISTIC
/begin CHARACTERISTIC DFC_CtlMsk.DFC_GlwPlgBSDSC_3_C "/" VALUE 0x8007176A Val_Wu16 65535.00 DFES_OneToOne 0.00 65535.00 FORMAT "%8.2" /end CHARACTERISTIC
/begin CHARACTERISTIC DFC_CtlMsk.DFC_GlwPlgBSDSC_4_C "/" VALUE 0x8007176C Val_Wu16 65535.00 DFES_OneToOne 0.00 65535.00 FORMAT "%8.2" /end CHARACTERISTIC
/begin CHARACTERISTIC DFC_CtlMsk.DFC_GlwPlgBSDSC_5_C "/" VALUE 0x8007176E Val_Wu16 65535.00 DFES_OneToOne 0.00 65535.00 FORMAT "%8.2" /end CHARACTERISTIC
/begin CHARACTERISTIC DFC_CtlMsk.DFC_GlwPlgBSDSC_6_C "/" VALUE 0x80071770 Val_Wu16 65535.00 DFES_OneToOne 0.00 65535.00 FORMAT "%8.2" /end CHARACTERISTIC
/begin CHARACTERISTIC DFC_CtlMsk.DFC_GlwPlgBSDSC_7_C "/" VALUE 0x80071772 Val_Wu16 65535.00 DFES_OneToOne 0.00 65535.00 FORMAT "%8.2" /end CHARACTERISTIC
/begin CHARACTERISTIC DFC_CtlMsk.DFC_GlwPlgComErr_C "/" VALUE 0x80071774 Val_Wu16 65535.00 DFES_OneToOne 0.00 65535.00 FORMAT "%8.2" /end CHARACTERISTIC
/begin CHARACTERISTIC DFC_CtlMsk.DFC_InjVlvPresMin_C "/" VALUE 0x80071776 Val_Wu16 65535.00 DFES_OneToOne 0.00 65535.00 FORMAT "%8.2" /end CHARACTERISTIC
/begin CHARACTERISTIC DFC_CtlMsk.DFC_LSUCircNernstMax_0_C "/" VALUE 0x80071778 Val_Wu16 65535.00 DFES_OneToOne 0.00 65535.00 FORMAT "%8.2" /end CHARACTERISTIC
/begin CHARACTERISTIC DFC_CtlMsk.DFC_LSUCircNernstMax_1_C "/" VALUE 0x8007177A Val_Wu16 65535.00 DFES_OneToOne 0.00 65535.00 FORMAT "%8.2" /end CHARACTERISTIC
/begin CHARACTERISTIC DFC_CtlMsk.DFC_LSUCircNernstMax_2_C "/" VALUE 0x8007177C Val_Wu16 65535.00 DFES_OneToOne 0.00 65535.00 FORMAT "%8.2" /end CHARACTERISTIC
/begin CHARACTERISTIC DFC_CtlMsk.DFC_LSUCircNernstMax_3_C "/" VALUE 0x8007177E Val_Wu16 65535.00 DFES_OneToOne 0.00 65535.00 FORMAT "%8.2" /end CHARACTERISTIC
/begin CHARACTERISTIC DFC_CtlMsk.DFC_LSUCircNernstMin_0_C "/" VALUE 0x80071780 Val_Wu16 65535.00 DFES_OneToOne 0.00 65535.00 FORMAT "%8.2" /end CHARACTERISTIC
/begin CHARACTERISTIC DFC_CtlMsk.DFC_LSUCircNernstMin_1_C "/" VALUE 0x80071782 Val_Wu16 65535.00 DFES_OneToOne 0.00 65535.00 FORMAT "%8.2" /end CHARACTERISTIC
/begin CHARACTERISTIC DFC_CtlMsk.DFC_LSUCircNernstMin_2_C "/" VALUE 0x80071784 Val_Wu16 65535.00 DFES_OneToOne 0.00 65535.00 FORMAT "%8.2" /end CHARACTERISTIC
/begin CHARACTERISTIC DFC_CtlMsk.DFC_LSUCircNernstMin_3_C "/" VALUE 0x80071786 Val_Wu16 65535.00 DFES_OneToOne 0.00 65535.00 FORMAT "%8.2" /end CHARACTERISTIC
/begin CHARACTERISTIC DFC_CtlMsk.DFC_LSUCircNernstSig_0_C "/" VALUE 0x80071788 Val_Wu16 65535.00 DFES_OneToOne 0.00 65535.00 FORMAT "%8.2" /end CHARACTERISTIC
/begin CHARACTERISTIC DFC_CtlMsk.DFC_LSUCircNernstSig_1_C "/" VALUE 0x8007178A Val_Wu16 65535.00 DFES_OneToOne 0.00 65535.00 FORMAT "%8.2" /end CHARACTERISTIC
/begin CHARACTERISTIC DFC_CtlMsk.DFC_LSUCircNernstSig_2_C "/" VALUE 0x8007178C Val_Wu16 65535.00 DFES_OneToOne 0.00 65535.00 FORMAT "%8.2" /end CHARACTERISTIC
/begin CHARACTERISTIC DFC_CtlMsk.DFC_LSUCircNernstSig_3_C "/" VALUE 0x8007178E Val_Wu16 65535.00 DFES_OneToOne 0.00 65535.00 FORMAT "%8.2" /end CHARACTERISTIC
/begin CHARACTERISTIC DFC_CtlMsk.DFC_LSUCircPmpCurMax_0_C "/" VALUE 0x80071790 Val_Wu16 65535.00 DFES_OneToOne 0.00 65535.00 FORMAT "%8.2" /end CHARACTERISTIC
/begin CHARACTERISTIC DFC_CtlMsk.DFC_LSUCircPmpCurMax_1_C "/" VALUE 0x80071792 Val_Wu16 65535.00 DFES_OneToOne 0.00 65535.00 FORMAT "%8.2" /end CHARACTERISTIC
/begin CHARACTERISTIC DFC_CtlMsk.DFC_LSUCircPmpCurMax_2_C "/" VALUE 0x80071794 Val_Wu16 65535.00 DFES_OneToOne 0.00 65535.00 FORMAT "%8.2" /end CHARACTERISTIC
/begin CHARACTERISTIC DFC_CtlMsk.DFC_LSUCircPmpCurMax_3_C "/" VALUE 0x80071796 Val_Wu16 65535.00 DFES_OneToOne 0.00 65535.00 FORMAT "%8.2" /end CHARACTERISTIC
/begin CHARACTERISTIC DFC_CtlMsk.DFC_LSUCircPmpCurMin_0_C "/" VALUE 0x80071798 Val_Wu16 65535.00 DFES_OneToOne 0.00 65535.00 FORMAT "%8.2" /end CHARACTERISTIC
/begin CHARACTERISTIC DFC_CtlMsk.DFC_LSUCircPmpCurMin_1_C "/" VALUE 0x8007179A Val_Wu16 65535.00 DFES_OneToOne 0.00 65535.00 FORMAT "%8.2" /end CHARACTERISTIC
/begin CHARACTERISTIC DFC_CtlMsk.DFC_LSUCircPmpCurMin_2_C "/" VALUE 0x8007179C Val_Wu16 65535.00 DFES_OneToOne 0.00 65535.00 FORMAT "%8.2" /end CHARACTERISTIC
/begin CHARACTERISTIC DFC_CtlMsk.DFC_LSUCircPmpCurMin_3_C "/" VALUE 0x8007179E Val_Wu16 65535.00 DFES_OneToOne 0.00 65535.00 FORMAT "%8.2" /end CHARACTERISTIC
/begin CHARACTERISTIC DFC_CtlMsk.DFC_LSUCircPmpCurSig_0_C "/" VALUE 0x800717A0 Val_Wu16 65535.00 DFES_OneToOne 0.00 65535.00 FORMAT "%8.2" /end CHARACTERISTIC
/begin CHARACTERISTIC DFC_CtlMsk.DFC_LSUCircPmpCurSig_1_C "/" VALUE 0x800717A2 Val_Wu16 65535.00 DFES_OneToOne 0.00 65535.00 FORMAT "%8.2" /end CHARACTERISTIC
/begin CHARACTERISTIC DFC_CtlMsk.DFC_LSUCircPmpCurSig_2_C "/" VALUE 0x800717A4 Val_Wu16 65535.00 DFES_OneToOne 0.00 65535.00 FORMAT "%8.2" /end CHARACTERISTIC
/begin CHARACTERISTIC DFC_CtlMsk.DFC_LSUCircPmpCurSig_3_C "/" VALUE 0x800717A6 Val_Wu16 65535.00 DFES_OneToOne 0.00 65535.00 FORMAT "%8.2" /end CHARACTERISTIC
/begin CHARACTERISTIC DFC_CtlMsk.DFC_LSUCircVirtGndMax_0_C "/" VALUE 0x800717A8 Val_Wu16 65535.00 DFES_OneToOne 0.00 65535.00 FORMAT "%8.2" /end CHARACTERISTIC
/begin CHARACTERISTIC DFC_CtlMsk.DFC_LSUCircVirtGndMax_1_C "/" VALUE 0x800717AA Val_Wu16 65535.00 DFES_OneToOne 0.00 65535.00 FORMAT "%8.2" /end CHARACTERISTIC
/begin CHARACTERISTIC DFC_CtlMsk.DFC_LSUCircVirtGndMax_2_C "/" VALUE 0x800717AC Val_Wu16 65535.00 DFES_OneToOne 0.00 65535.00 FORMAT "%8.2" /end CHARACTERISTIC
/begin CHARACTERISTIC DFC_CtlMsk.DFC_LSUCircVirtGndMax_3_C "/" VALUE 0x800717AE Val_Wu16 65535.00 DFES_OneToOne 0.00 65535.00 FORMAT "%8.2" /end CHARACTERISTIC
/begin CHARACTERISTIC DFC_CtlMsk.DFC_LSUCircVirtGndMin_0_C "/" VALUE 0x800717B0 Val_Wu16 65535.00 DFES_OneToOne 0.00 65535.00 FORMAT "%8.2" /end CHARACTERISTIC
/begin CHARACTERISTIC DFC_CtlMsk.DFC_LSUCircVirtGndMin_1_C "/" VALUE 0x800717B2 Val_Wu16 65535.00 DFES_OneToOne 0.00 65535.00 FORMAT "%8.2" /end CHARACTERISTIC
/begin CHARACTERISTIC DFC_CtlMsk.DFC_LSUCircVirtGndMin_2_C "/" VALUE 0x800717B4 Val_Wu16 65535.00 DFES_OneToOne 0.00 65535.00 FORMAT "%8.2" /end CHARACTERISTIC
/begin CHARACTERISTIC DFC_CtlMsk.DFC_LSUCircVirtGndMin_3_C "/" VALUE 0x800717B6 Val_Wu16 65535.00 DFES_OneToOne 0.00 65535.00 FORMAT "%8.2" /end CHARACTERISTIC
/begin CHARACTERISTIC DFC_CtlMsk.DFC_LSUCircVirtGndSig_0_C "/" VALUE 0x800717B8 Val_Wu16 65535.00 DFES_OneToOne 0.00 65535.00 FORMAT "%8.2" /end CHARACTERISTIC
/begin CHARACTERISTIC DFC_CtlMsk.DFC_LSUCircVirtGndSig_1_C "/" VALUE 0x800717BA Val_Wu16 65535.00 DFES_OneToOne 0.00 65535.00 FORMAT "%8.2" /end CHARACTERISTIC
/begin CHARACTERISTIC DFC_CtlMsk.DFC_LSUCircVirtGndSig_2_C "/" VALUE 0x800717BC Val_Wu16 65535.00 DFES_OneToOne 0.00 65535.00 FORMAT "%8.2" /end CHARACTERISTIC
/begin CHARACTERISTIC DFC_CtlMsk.DFC_LSUCircVirtGndSig_3_C "/" VALUE 0x800717BE Val_Wu16 65535.00 DFES_OneToOne 0.00 65535.00 FORMAT "%8.2" /end CHARACTERISTIC
/begin CHARACTERISTIC DFC_CtlMsk.DFC_LSUHtrMax_0_C "/" VALUE 0x800717C0 Val_Wu16 65535.00 DFES_OneToOne 0.00 65535.00 FORMAT "%8.2" /end CHARACTERISTIC
/begin CHARACTERISTIC DFC_CtlMsk.DFC_LSUHtrMax_1_C "/" VALUE 0x800717C2 Val_Wu16 65535.00 DFES_OneToOne 0.00 65535.00 FORMAT "%8.2" /end CHARACTERISTIC
/begin CHARACTERISTIC DFC_CtlMsk.DFC_LSUHtrMax_2_C "/" VALUE 0x800717C4 Val_Wu16 65535.00 DFES_OneToOne 0.00 65535.00 FORMAT "%8.2" /end CHARACTERISTIC
/begin CHARACTERISTIC DFC_CtlMsk.DFC_LSUHtrMax_3_C "/" VALUE 0x800717C6 Val_Wu16 65535.00 DFES_OneToOne 0.00 65535.00 FORMAT "%8.2" /end CHARACTERISTIC
/begin CHARACTERISTIC DFC_CtlMsk.DFC_LSUHtrMin_0_C "/" VALUE 0x800717C8 Val_Wu16 65535.00 DFES_OneToOne 0.00 65535.00 FORMAT "%8.2" /end CHARACTERISTIC
/begin CHARACTERISTIC DFC_CtlMsk.DFC_LSUHtrMin_1_C "/" VALUE 0x800717CA Val_Wu16 65535.00 DFES_OneToOne 0.00 65535.00 FORMAT "%8.2" /end CHARACTERISTIC
/begin CHARACTERISTIC DFC_CtlMsk.DFC_LSUHtrMin_2_C "/" VALUE 0x800717CC Val_Wu16 65535.00 DFES_OneToOne 0.00 65535.00 FORMAT "%8.2" /end CHARACTERISTIC
/begin CHARACTERISTIC DFC_CtlMsk.DFC_LSUHtrMin_3_C "/" VALUE 0x800717CE Val_Wu16 65535.00 DFES_OneToOne 0.00 65535.00 FORMAT "%8.2" /end CHARACTERISTIC
/begin CHARACTERISTIC DFC_CtlMsk.DFC_LSUHtrSig_0_C "/" VALUE 0x800717D0 Val_Wu16 65535.00 DFES_OneToOne 0.00 65535.00 FORMAT "%8.2" /end CHARACTERISTIC
/begin CHARACTERISTIC DFC_CtlMsk.DFC_LSUHtrSig_1_C "/" VALUE 0x800717D2 Val_Wu16 65535.00 DFES_OneToOne 0.00 65535.00 FORMAT "%8.2" /end CHARACTERISTIC
/begin CHARACTERISTIC DFC_CtlMsk.DFC_LSUHtrSig_2_C "/" VALUE 0x800717D4 Val_Wu16 65535.00 DFES_OneToOne 0.00 65535.00 FORMAT "%8.2" /end CHARACTERISTIC
/begin CHARACTERISTIC DFC_CtlMsk.DFC_LSUHtrSig_3_C "/" VALUE 0x800717D6 Val_Wu16 65535.00 DFES_OneToOne 0.00 65535.00 FORMAT "%8.2" /end CHARACTERISTIC
/begin CHARACTERISTIC DFC_CtlMsk.DFC_LSUO2Max_0_C "/" VALUE 0x800717D8 Val_Wu16 65535.00 DFES_OneToOne 0.00 65535.00 FORMAT "%8.2" /end CHARACTERISTIC
/begin CHARACTERISTIC DFC_CtlMsk.DFC_LSUO2Max_1_C "/" VALUE 0x800717DA Val_Wu16 65535.00 DFES_OneToOne 0.00 65535.00 FORMAT "%8.2" /end CHARACTERISTIC
/begin CHARACTERISTIC DFC_CtlMsk.DFC_LSUO2Max_2_C "/" VALUE 0x800717DC Val_Wu16 65535.00 DFES_OneToOne 0.00 65535.00 FORMAT "%8.2" /end CHARACTERISTIC
/begin CHARACTERISTIC DFC_CtlMsk.DFC_LSUO2Max_3_C "/" VALUE 0x800717DE Val_Wu16 65535.00 DFES_OneToOne 0.00 65535.00 FORMAT "%8.2" /end CHARACTERISTIC
/begin CHARACTERISTIC DFC_CtlMsk.DFC_LSUO2Min_0_C "/" VALUE 0x800717E0 Val_Wu16 65535.00 DFES_OneToOne 0.00 65535.00 FORMAT "%8.2" /end CHARACTERISTIC
/begin CHARACTERISTIC DFC_CtlMsk.DFC_LSUO2Min_1_C "/" VALUE 0x800717E2 Val_Wu16 65535.00 DFES_OneToOne 0.00 65535.00 FORMAT "%8.2" /end CHARACTERISTIC
/begin CHARACTERISTIC DFC_CtlMsk.DFC_LSUO2Min_2_C "/" VALUE 0x800717E4 Val_Wu16 65535.00 DFES_OneToOne 0.00 65535.00 FORMAT "%8.2" /end CHARACTERISTIC
/begin CHARACTERISTIC DFC_CtlMsk.DFC_LSUO2Min_3_C "/" VALUE 0x800717E6 Val_Wu16 65535.00 DFES_OneToOne 0.00 65535.00 FORMAT "%8.2" /end CHARACTERISTIC
/begin CHARACTERISTIC DFC_CtlMsk.DFC_LSUSPIBattLowMin_0_C "/" VALUE 0x800717E8 Val_Wu16 65535.00 DFES_OneToOne 0.00 65535.00 FORMAT "%8.2" /end CHARACTERISTIC
/begin CHARACTERISTIC DFC_CtlMsk.DFC_LSUSPIBattLowMin_1_C "/" VALUE 0x800717EA Val_Wu16 65535.00 DFES_OneToOne 0.00 65535.00 FORMAT "%8.2" /end CHARACTERISTIC
/begin CHARACTERISTIC DFC_CtlMsk.DFC_LSUSPIBattLowMin_2_C "/" VALUE 0x800717EC Val_Wu16 65535.00 DFES_OneToOne 0.00 65535.00 FORMAT "%8.2" /end CHARACTERISTIC
/begin CHARACTERISTIC DFC_CtlMsk.DFC_LSUSPIBattLowMin_3_C "/" VALUE 0x800717EE Val_Wu16 65535.00 DFES_OneToOne 0.00 65535.00 FORMAT "%8.2" /end CHARACTERISTIC
/begin CHARACTERISTIC DFC_CtlMsk.DFC_LSUSPISig_0_C "/" VALUE 0x800717F0 Val_Wu16 65535.00 DFES_OneToOne 0.00 65535.00 FORMAT "%8.2" /end CHARACTERISTIC
/begin CHARACTERISTIC DFC_CtlMsk.DFC_LSUSPISig_1_C "/" VALUE 0x800717F2 Val_Wu16 65535.00 DFES_OneToOne 0.00 65535.00 FORMAT "%8.2" /end CHARACTERISTIC
/begin CHARACTERISTIC DFC_CtlMsk.DFC_LSUSPISig_2_C "/" VALUE 0x800717F4 Val_Wu16 65535.00 DFES_OneToOne 0.00 65535.00 FORMAT "%8.2" /end CHARACTERISTIC
/begin CHARACTERISTIC DFC_CtlMsk.DFC_LSUSPISig_3_C "/" VALUE 0x800717F6 Val_Wu16 65535.00 DFES_OneToOne 0.00 65535.00 FORMAT "%8.2" /end CHARACTERISTIC
/begin CHARACTERISTIC DFC_CtlMsk.DFC_LSUtExcMax_0_C "/" VALUE 0x800717F8 Val_Wu16 65535.00 DFES_OneToOne 0.00 65535.00 FORMAT "%8.2" /end CHARACTERISTIC
/begin CHARACTERISTIC DFC_CtlMsk.DFC_LSUtExcMax_1_C "/" VALUE 0x800717FA Val_Wu16 65535.00 DFES_OneToOne 0.00 65535.00 FORMAT "%8.2" /end CHARACTERISTIC
/begin CHARACTERISTIC DFC_CtlMsk.DFC_LSUtExcMax_2_C "/" VALUE 0x800717FC Val_Wu16 65535.00 DFES_OneToOne 0.00 65535.00 FORMAT "%8.2" /end CHARACTERISTIC
/begin CHARACTERISTIC DFC_CtlMsk.DFC_LSUtExcMax_3_C "/" VALUE 0x800717FE Val_Wu16 65535.00 DFES_OneToOne 0.00 65535.00 FORMAT "%8.2" /end CHARACTERISTIC
/begin CHARACTERISTIC DFC_CtlMsk.DFC_LSUtExcMin_0_C "/" VALUE 0x80071800 Val_Wu16 65535.00 DFES_OneToOne 0.00 65535.00 FORMAT "%8.2" /end CHARACTERISTIC
/begin CHARACTERISTIC DFC_CtlMsk.DFC_LSUtExcMin_1_C "/" VALUE 0x80071802 Val_Wu16 65535.00 DFES_OneToOne 0.00 65535.00 FORMAT "%8.2" /end CHARACTERISTIC
/begin CHARACTERISTIC DFC_CtlMsk.DFC_LSUtExcMin_2_C "/" VALUE 0x80071804 Val_Wu16 65535.00 DFES_OneToOne 0.00 65535.00 FORMAT "%8.2" /end CHARACTERISTIC
/begin CHARACTERISTIC DFC_CtlMsk.DFC_LSUtExcMin_3_C "/" VALUE 0x80071806 Val_Wu16 65535.00 DFES_OneToOne 0.00 65535.00 FORMAT "%8.2" /end CHARACTERISTIC
/begin CHARACTERISTIC DFC_CtlMsk.DFC_MILOL_C "/" VALUE 0x80071808 Val_Wu16 65535.00 DFES_OneToOne 0.00 65535.00 FORMAT "%8.2" /end CHARACTERISTIC
/begin CHARACTERISTIC DFC_CtlMsk.DFC_MILSCB_C "/" VALUE 0x8007180A Val_Wu16 65535.00 DFES_OneToOne 0.00 65535.00 FORMAT "%8.2" /end CHARACTERISTIC
/begin CHARACTERISTIC DFC_CtlMsk.DFC_MILSCG_C "/" VALUE 0x8007180C Val_Wu16 65535.00 DFES_OneToOne 0.00 65535.00 FORMAT "%8.2" /end CHARACTERISTIC
/begin CHARACTERISTIC DFC_CtlMsk.DFC_MeUnSCG_C "/" VALUE 0x8007180E Val_Wu16 65535.00 DFES_OneToOne 0.00 65535.00 FORMAT "%8.2" /end CHARACTERISTIC
/begin CHARACTERISTIC DFC_CtlMsk.DFC_NplHsChngPPFltDiff_C "/" VALUE 0x80071810 Val_Wu16 65535.00 DFES_OneToOne 0.00 65535.00 FORMAT "%8.2" /end CHARACTERISTIC
/begin CHARACTERISTIC DFC_CtlMsk.DFC_NplPAirFltDs_C "/" VALUE 0x80071812 Val_Wu16 65535.00 DFES_OneToOne 0.00 65535.00 FORMAT "%8.2" /end CHARACTERISTIC
/begin CHARACTERISTIC DFC_CtlMsk.DFC_NplTPFltUs_C "/" VALUE 0x80071814 Val_Wu16 65535.00 DFES_OneToOne 0.00 65535.00 FORMAT "%8.2" /end CHARACTERISTIC
/begin CHARACTERISTIC DFC_CtlMsk.DFC_OilComErr_C "/" VALUE 0x80071816 Val_Wu16 65535.00 DFES_OneToOne 0.00 65535.00 FORMAT "%8.2" /end CHARACTERISTIC
/begin CHARACTERISTIC DFC_CtlMsk.DFC_OilPLmpOL_C "/" VALUE 0x80071818 Val_Wu16 65535.00 DFES_OneToOne 0.00 65535.00 FORMAT "%8.2" /end CHARACTERISTIC
/begin CHARACTERISTIC DFC_CtlMsk.DFC_OilPLmpSCB_C "/" VALUE 0x8007181A Val_Wu16 65535.00 DFES_OneToOne 0.00 65535.00 FORMAT "%8.2" /end CHARACTERISTIC
/begin CHARACTERISTIC DFC_CtlMsk.DFC_OilPLmpSCG_C "/" VALUE 0x8007181C Val_Wu16 65535.00 DFES_OneToOne 0.00 65535.00 FORMAT "%8.2" /end CHARACTERISTIC
/begin CHARACTERISTIC DFC_CtlMsk.DFC_OilPNpl_C "/" VALUE 0x8007181E Val_Wu16 65535.00 DFES_OneToOne 0.00 65535.00 FORMAT "%8.2" /end CHARACTERISTIC
/begin CHARACTERISTIC DFC_CtlMsk.DFC_OilTNpl_C "/" VALUE 0x80071820 Val_Wu16 65535.00 DFES_OneToOne 0.00 65535.00 FORMAT "%8.2" /end CHARACTERISTIC
/begin CHARACTERISTIC DFC_CtlMsk.DFC_OilTSRCMax_C "/" VALUE 0x80071822 Val_Wu16 65535.00 DFES_OneToOne 0.00 65535.00 FORMAT "%8.2" /end CHARACTERISTIC
/begin CHARACTERISTIC DFC_CtlMsk.DFC_OilTSRCMin_C "/" VALUE 0x80071824 Val_Wu16 65535.00 DFES_OneToOne 0.00 65535.00 FORMAT "%8.2" /end CHARACTERISTIC
/begin CHARACTERISTIC DFC_CtlMsk.DFC_PCACDsEnvPPls_C "/" VALUE 0x80071826 Val_Wu16 65535.00 DFES_OneToOne 0.00 65535.00 FORMAT "%8.2" /end CHARACTERISTIC
/begin CHARACTERISTIC DFC_CtlMsk.DFC_PCACDsSRCMax_C "/" VALUE 0x80071828 Val_Wu16 65535.00 DFES_OneToOne 0.00 65535.00 FORMAT "%8.2" /end CHARACTERISTIC
/begin CHARACTERISTIC DFC_CtlMsk.DFC_PCACDsSRCMin_C "/" VALUE 0x8007182A Val_Wu16 65535.00 DFES_OneToOne 0.00 65535.00 FORMAT "%8.2" /end CHARACTERISTIC
/begin CHARACTERISTIC DFC_CtlMsk.DFC_PCVSCG_C "/" VALUE 0x8007182C Val_Wu16 65535.00 DFES_OneToOne 0.00 65535.00 FORMAT "%8.2" /end CHARACTERISTIC
/begin CHARACTERISTIC DFC_CtlMsk.DFC_PFltCharPDiffMin_C "/" VALUE 0x8007182E Val_Wu16 65535.00 DFES_OneToOne 0.00 65535.00 FORMAT "%8.2" /end CHARACTERISTIC
/begin CHARACTERISTIC DFC_CtlMsk.DFC_PFltDstrMin_C "/" VALUE 0x80071830 Val_Wu16 65535.00 DFES_OneToOne 0.00 65535.00 FORMAT "%8.2" /end CHARACTERISTIC
/begin CHARACTERISTIC DFC_CtlMsk.DFC_PFltEngPrt_C "/" VALUE 0x80071832 Val_Wu16 65535.00 DFES_OneToOne 0.00 65535.00 FORMAT "%8.2" /end CHARACTERISTIC
/begin CHARACTERISTIC DFC_CtlMsk.DFC_PFltLmpOL_C "/" VALUE 0x80071834 Val_Wu16 65535.00 DFES_OneToOne 0.00 65535.00 FORMAT "%8.2" /end CHARACTERISTIC
/begin CHARACTERISTIC DFC_CtlMsk.DFC_PFltLmpSCB_C "/" VALUE 0x80071836 Val_Wu16 65535.00 DFES_OneToOne 0.00 65535.00 FORMAT "%8.2" /end CHARACTERISTIC
/begin CHARACTERISTIC DFC_CtlMsk.DFC_PFltLmpSCG_C "/" VALUE 0x80071838 Val_Wu16 65535.00 DFES_OneToOne 0.00 65535.00 FORMAT "%8.2" /end CHARACTERISTIC
/begin CHARACTERISTIC DFC_CtlMsk.DFC_PFltRgnPerm_C "/" VALUE 0x8007183A Val_Wu16 65535.00 DFES_OneToOne 0.00 65535.00 FORMAT "%8.2" /end CHARACTERISTIC
/begin CHARACTERISTIC DFC_CtlMsk.DFC_PFltSRCMaxFlwRstn_C "/" VALUE 0x8007183C Val_Wu16 65535.00 DFES_OneToOne 0.00 65535.00 FORMAT "%8.2" /end CHARACTERISTIC
/begin CHARACTERISTIC DFC_CtlMsk.DFC_PFltSRCMinFlwRstn_C "/" VALUE 0x8007183E Val_Wu16 65535.00 DFES_OneToOne 0.00 65535.00 FORMAT "%8.2" /end CHARACTERISTIC
/begin CHARACTERISTIC DFC_CtlMsk.DFC_PFltSotMsDvtMax_C "/" VALUE 0x80071840 Val_Wu16 65535.00 DFES_OneToOne 0.00 65535.00 FORMAT "%8.2" /end CHARACTERISTIC
/begin CHARACTERISTIC DFC_CtlMsk.DFC_PFltSotMsDvtMin_C "/" VALUE 0x80071842 Val_Wu16 65535.00 DFES_OneToOne 0.00 65535.00 FORMAT "%8.2" /end CHARACTERISTIC
/begin CHARACTERISTIC DFC_CtlMsk.DFC_PFltSotMsMax_C "/" VALUE 0x80071844 Val_Wu16 65535.00 DFES_OneToOne 0.00 65535.00 FORMAT "%8.2" /end CHARACTERISTIC
/begin CHARACTERISTIC DFC_CtlMsk.DFC_PSPOL_C "/" VALUE 0x80071846 Val_Wu16 65535.00 DFES_OneToOne 0.00 65535.00 FORMAT "%8.2" /end CHARACTERISTIC
/begin CHARACTERISTIC DFC_CtlMsk.DFC_PSPSCB_C "/" VALUE 0x80071848 Val_Wu16 65535.00 DFES_OneToOne 0.00 65535.00 FORMAT "%8.2" /end CHARACTERISTIC
/begin CHARACTERISTIC DFC_CtlMsk.DFC_PSPSCG_C "/" VALUE 0x8007184A Val_Wu16 65535.00 DFES_OneToOne 0.00 65535.00 FORMAT "%8.2" /end CHARACTERISTIC
/begin CHARACTERISTIC DFC_CtlMsk.DFC_SRCHighAPP1_C "/" VALUE 0x8007184C Val_Wu16 65535.00 DFES_OneToOne 0.00 65535.00 FORMAT "%8.2" /end CHARACTERISTIC
/begin CHARACTERISTIC DFC_CtlMsk.DFC_SRCHighAPP2_C "/" VALUE 0x8007184E Val_Wu16 65535.00 DFES_OneToOne 0.00 65535.00 FORMAT "%8.2" /end CHARACTERISTIC
/begin CHARACTERISTIC DFC_CtlMsk.DFC_SRCLowAPP1_C "/" VALUE 0x80071850 Val_Wu16 65535.00 DFES_OneToOne 0.00 65535.00 FORMAT "%8.2" /end CHARACTERISTIC
/begin CHARACTERISTIC DFC_CtlMsk.DFC_SRCLowAPP2_C "/" VALUE 0x80071852 Val_Wu16 65535.00 DFES_OneToOne 0.00 65535.00 FORMAT "%8.2" /end CHARACTERISTIC
/begin CHARACTERISTIC DFC_CtlMsk.DFC_SRCMaxPAirFltDs_C "/" VALUE 0x80071854 Val_Wu16 65535.00 DFES_OneToOne 0.00 65535.00 FORMAT "%8.2" /end CHARACTERISTIC
/begin CHARACTERISTIC DFC_CtlMsk.DFC_SRCMaxPPFltUs_C "/" VALUE 0x80071856 Val_Wu16 65535.00 DFES_OneToOne 0.00 65535.00 FORMAT "%8.2" /end CHARACTERISTIC
/begin CHARACTERISTIC DFC_CtlMsk.DFC_SRCMaxTECU_C "/" VALUE 0x80071858 Val_Wu16 65535.00 DFES_OneToOne 0.00 65535.00 FORMAT "%8.2" /end CHARACTERISTIC
/begin CHARACTERISTIC DFC_CtlMsk.DFC_SRCMaxTOxiCatUs_C "/" VALUE 0x8007185A Val_Wu16 65535.00 DFES_OneToOne 0.00 65535.00 FORMAT "%8.2" /end CHARACTERISTIC
/begin CHARACTERISTIC DFC_CtlMsk.DFC_SRCMaxTPFltUs_C "/" VALUE 0x8007185C Val_Wu16 65535.00 DFES_OneToOne 0.00 65535.00 FORMAT "%8.2" /end CHARACTERISTIC
/begin CHARACTERISTIC DFC_CtlMsk.DFC_SRCMinPAirFltDs_C "/" VALUE 0x8007185E Val_Wu16 65535.00 DFES_OneToOne 0.00 65535.00 FORMAT "%8.2" /end CHARACTERISTIC
/begin CHARACTERISTIC DFC_CtlMsk.DFC_SRCMinPPFltUs_C "/" VALUE 0x80071860 Val_Wu16 65535.00 DFES_OneToOne 0.00 65535.00 FORMAT "%8.2" /end CHARACTERISTIC
/begin CHARACTERISTIC DFC_CtlMsk.DFC_SRCMinTECU_C "/" VALUE 0x80071862 Val_Wu16 65535.00 DFES_OneToOne 0.00 65535.00 FORMAT "%8.2" /end CHARACTERISTIC
/begin CHARACTERISTIC DFC_CtlMsk.DFC_SRCMinTOxiCatUs_C "/" VALUE 0x80071864 Val_Wu16 65535.00 DFES_OneToOne 0.00 65535.00 FORMAT "%8.2" /end CHARACTERISTIC
/begin CHARACTERISTIC DFC_CtlMsk.DFC_SRCMinTPFltUs_C "/" VALUE 0x80071866 Val_Wu16 65535.00 DFES_OneToOne 0.00 65535.00 FORMAT "%8.2" /end CHARACTERISTIC
/begin CHARACTERISTIC DFC_CtlMsk.DFC_SVSOL_C "/" VALUE 0x80071868 Val_Wu16 65535.00 DFES_OneToOne 0.00 65535.00 FORMAT "%8.2" /end CHARACTERISTIC
/begin CHARACTERISTIC DFC_CtlMsk.DFC_SVSSCB_C "/" VALUE 0x8007186A Val_Wu16 65535.00 DFES_OneToOne 0.00 65535.00 FORMAT "%8.2" /end CHARACTERISTIC
/begin CHARACTERISTIC DFC_CtlMsk.DFC_SVSSCG_C "/" VALUE 0x8007186C Val_Wu16 65535.00 DFES_OneToOne 0.00 65535.00 FORMAT "%8.2" /end CHARACTERISTIC
/begin CHARACTERISTIC DFC_CtlMsk.DFC_StrtOL_C "/" VALUE 0x8007186E Val_Wu16 65535.00 DFES_OneToOne 0.00 65535.00 FORMAT "%8.2" /end CHARACTERISTIC
/begin CHARACTERISTIC DFC_CtlMsk.DFC_StrtSCB_C "/" VALUE 0x80071870 Val_Wu16 65535.00 DFES_OneToOne 0.00 65535.00 FORMAT "%8.2" /end CHARACTERISTIC
/begin CHARACTERISTIC DFC_CtlMsk.DFC_StrtSCG_C "/" VALUE 0x80071872 Val_Wu16 65535.00 DFES_OneToOne 0.00 65535.00 FORMAT "%8.2" /end CHARACTERISTIC
/begin CHARACTERISTIC DFC_CtlMsk.DFC_SyncAPP_C "/" VALUE 0x80071874 Val_Wu16 65535.00 DFES_OneToOne 0.00 65535.00 FORMAT "%8.2" /end CHARACTERISTIC
/begin CHARACTERISTIC DFC_CtlMsk.DFC_T15Npl_C "/" VALUE 0x80071876 Val_Wu16 65535.00 DFES_OneToOne 0.00 65535.00 FORMAT "%8.2" /end CHARACTERISTIC
/begin CHARACTERISTIC DFC_CtlMsk.DFC_TAFSDtyCycHi_C "/" VALUE 0x80071878 Val_Wu16 65535.00 DFES_OneToOne 0.00 65535.00 FORMAT "%8.2" /end CHARACTERISTIC
/begin CHARACTERISTIC DFC_CtlMsk.DFC_TAFSDtyCycLo_C "/" VALUE 0x8007187A Val_Wu16 65535.00 DFES_OneToOne 0.00 65535.00 FORMAT "%8.2" /end CHARACTERISTIC
/begin CHARACTERISTIC DFC_CtlMsk.DFC_TAFSPerHi_C "/" VALUE 0x8007187C Val_Wu16 65535.00 DFES_OneToOne 0.00 65535.00 FORMAT "%8.2" /end CHARACTERISTIC
/begin CHARACTERISTIC DFC_CtlMsk.DFC_TAFSPerLo_C "/" VALUE 0x8007187E Val_Wu16 65535.00 DFES_OneToOne 0.00 65535.00 FORMAT "%8.2" /end CHARACTERISTIC
/begin CHARACTERISTIC DFC_CtlMsk.DFC_TCACDsSRCMax_C "/" VALUE 0x80071880 Val_Wu16 65535.00 DFES_OneToOne 0.00 65535.00 FORMAT "%8.2" /end CHARACTERISTIC
/begin CHARACTERISTIC DFC_CtlMsk.DFC_TCACDsSRCMin_C "/" VALUE 0x80071882 Val_Wu16 65535.00 DFES_OneToOne 0.00 65535.00 FORMAT "%8.2" /end CHARACTERISTIC
/begin CHARACTERISTIC DFC_CtlMsk.DFC_ThrVlvOL_C "/" VALUE 0x80071884 Val_Wu16 65535.00 DFES_OneToOne 0.00 65535.00 FORMAT "%8.2" /end CHARACTERISTIC
/begin CHARACTERISTIC DFC_CtlMsk.DFC_ThrVlvSCB_C "/" VALUE 0x80071886 Val_Wu16 65535.00 DFES_OneToOne 0.00 65535.00 FORMAT "%8.2" /end CHARACTERISTIC
/begin CHARACTERISTIC DFC_CtlMsk.DFC_ThrVlvSRCMax_C "/" VALUE 0x80071888 Val_Wu16 65535.00 DFES_OneToOne 0.00 65535.00 FORMAT "%8.2" /end CHARACTERISTIC
/begin CHARACTERISTIC DFC_CtlMsk.DFC_ThrVlvSRCMin_C "/" VALUE 0x8007188A Val_Wu16 65535.00 DFES_OneToOne 0.00 65535.00 FORMAT "%8.2" /end CHARACTERISTIC
/begin CHARACTERISTIC DFC_CtlMsk.DFC_TrbChLPOL_C "/" VALUE 0x8007188C Val_Wu16 65535.00 DFES_OneToOne 0.00 65535.00 FORMAT "%8.2" /end CHARACTERISTIC
/begin CHARACTERISTIC DFC_CtlMsk.DFC_TrbChLPSCB_C "/" VALUE 0x8007188E Val_Wu16 65535.00 DFES_OneToOne 0.00 65535.00 FORMAT "%8.2" /end CHARACTERISTIC
/begin CHARACTERISTIC DFC_CtlMsk.DFC_TrbChLPSCG_C "/" VALUE 0x80071890 Val_Wu16 65535.00 DFES_OneToOne 0.00 65535.00 FORMAT "%8.2" /end CHARACTERISTIC
/begin CHARACTERISTIC DFC_CtlMsk.DFC_TrbChOL_C "/" VALUE 0x80071892 Val_Wu16 65535.00 DFES_OneToOne 0.00 65535.00 FORMAT "%8.2" /end CHARACTERISTIC
/begin CHARACTERISTIC DFC_CtlMsk.DFC_TrbChSCB_C "/" VALUE 0x80071894 Val_Wu16 65535.00 DFES_OneToOne 0.00 65535.00 FORMAT "%8.2" /end CHARACTERISTIC
/begin CHARACTERISTIC DFC_CtlMsk.DFC_VSwVlvGovDvtMax_C "/" VALUE 0x80071896 Val_Wu16 65535.00 DFES_OneToOne 0.00 65535.00 FORMAT "%8.2" /end CHARACTERISTIC
/begin CHARACTERISTIC DFC_CtlMsk.DFC_VSwVlvGovDvtMin_C "/" VALUE 0x80071898 Val_Wu16 65535.00 DFES_OneToOne 0.00 65535.00 FORMAT "%8.2" /end CHARACTERISTIC
/begin CHARACTERISTIC DFC_CtlMsk.DFC_VSwVlvOL_C "/" VALUE 0x8007189A Val_Wu16 65535.00 DFES_OneToOne 0.00 65535.00 FORMAT "%8.2" /end CHARACTERISTIC
/begin CHARACTERISTIC DFC_CtlMsk.DFC_VSwVlvSCB_C "/" VALUE 0x8007189C Val_Wu16 65535.00 DFES_OneToOne 0.00 65535.00 FORMAT "%8.2" /end CHARACTERISTIC
/begin CHARACTERISTIC DFC_CtlMsk.DFC_VSwVlvSCG_C "/" VALUE 0x8007189E Val_Wu16 65535.00 DFES_OneToOne 0.00 65535.00 FORMAT "%8.2" /end CHARACTERISTIC
/begin CHARACTERISTIC DFC_CtlMsk.DFC_VSwVlvSRCMax_C "/" VALUE 0x800718A0 Val_Wu16 65535.00 DFES_OneToOne 0.00 65535.00 FORMAT "%8.2" /end CHARACTERISTIC
/begin CHARACTERISTIC DFC_CtlMsk.DFC_VSwVlvSRCMin_C "/" VALUE 0x800718A2 Val_Wu16 65535.00 DFES_OneToOne 0.00 65535.00 FORMAT "%8.2" /end CHARACTERISTIC
/begin CHARACTERISTIC DFC_CtlMsk.DFC_VehVHW_C "/" VALUE 0x800718A4 Val_Wu16 65535.00 DFES_OneToOne 0.00 65535.00 FORMAT "%8.2" /end CHARACTERISTIC
/begin CHARACTERISTIC DFC_CtlMsk.DFC_VehVMax_C "/" VALUE 0x800718A6 Val_Wu16 65535.00 DFES_OneToOne 0.00 65535.00 FORMAT "%8.2" /end CHARACTERISTIC
/begin CHARACTERISTIC DFC_CtlMsk.DFC_VehVPlaus_C "/" VALUE 0x800718A8 Val_Wu16 65535.00 DFES_OneToOne 0.00 65535.00 FORMAT "%8.2" /end CHARACTERISTIC
/begin CHARACTERISTIC DFC_CtlMsk.DFC_VehVSig_C "/" VALUE 0x800718AA Val_Wu16 65535.00 DFES_OneToOne 0.00 65535.00 FORMAT "%8.2" /end CHARACTERISTIC
/begin CHARACTERISTIC DFC_CtlMsk.DFC_WaHtElOL_C "/" VALUE 0x800718AC Val_Wu16 65535.00 DFES_OneToOne 0.00 65535.00 FORMAT "%8.2" /end CHARACTERISTIC
/begin CHARACTERISTIC DFC_CtlMsk.DFC_WaHtElSCB_C "/" VALUE 0x800718AE Val_Wu16 65535.00 DFES_OneToOne 0.00 65535.00 FORMAT "%8.2" /end CHARACTERISTIC
/begin CHARACTERISTIC DFC_CtlMsk.DFC_ClthNpl_C "/" VALUE 0x800718B0 Val_Wu16 65535.00 DFES_OneToOne 0.00 65535.00 FORMAT "%8.2" /end CHARACTERISTIC
/begin CHARACTERISTIC DFC_CtlMsk.DFC_ETClbETMax_0_C "/" VALUE 0x800718B2 Val_Wu16 65535.00 DFES_OneToOne 0.00 65535.00 FORMAT "%8.2" /end CHARACTERISTIC
/begin CHARACTERISTIC DFC_CtlMsk.DFC_ETClbETMax_1_C "/" VALUE 0x800718B4 Val_Wu16 65535.00 DFES_OneToOne 0.00 65535.00 FORMAT "%8.2" /end CHARACTERISTIC
/begin CHARACTERISTIC DFC_CtlMsk.DFC_ETClbETMax_2_C "/" VALUE 0x800718B6 Val_Wu16 65535.00 DFES_OneToOne 0.00 65535.00 FORMAT "%8.2" /end CHARACTERISTIC
/begin CHARACTERISTIC DFC_CtlMsk.DFC_ETClbETMax_3_C "/" VALUE 0x800718B8 Val_Wu16 65535.00 DFES_OneToOne 0.00 65535.00 FORMAT "%8.2" /end CHARACTERISTIC
/begin CHARACTERISTIC DFC_CtlMsk.DFC_ETClbETMax_4_C "/" VALUE 0x800718BA Val_Wu16 65535.00 DFES_OneToOne 0.00 65535.00 FORMAT "%8.2" /end CHARACTERISTIC
/begin CHARACTERISTIC DFC_CtlMsk.DFC_ETClbETMax_5_C "/" VALUE 0x800718BC Val_Wu16 65535.00 DFES_OneToOne 0.00 65535.00 FORMAT "%8.2" /end CHARACTERISTIC
/begin CHARACTERISTIC DFC_CtlMsk.DFC_ETClbETMin_0_C "/" VALUE 0x800718BE Val_Wu16 65535.00 DFES_OneToOne 0.00 65535.00 FORMAT "%8.2" /end CHARACTERISTIC
/begin CHARACTERISTIC DFC_CtlMsk.DFC_ETClbETMin_1_C "/" VALUE 0x800718C0 Val_Wu16 65535.00 DFES_OneToOne 0.00 65535.00 FORMAT "%8.2" /end CHARACTERISTIC
/begin CHARACTERISTIC DFC_CtlMsk.DFC_ETClbETMin_2_C "/" VALUE 0x800718C2 Val_Wu16 65535.00 DFES_OneToOne 0.00 65535.00 FORMAT "%8.2" /end CHARACTERISTIC
/begin CHARACTERISTIC DFC_CtlMsk.DFC_ETClbETMin_3_C "/" VALUE 0x800718C4 Val_Wu16 65535.00 DFES_OneToOne 0.00 65535.00 FORMAT "%8.2" /end CHARACTERISTIC
/begin CHARACTERISTIC DFC_CtlMsk.DFC_ETClbETMin_4_C "/" VALUE 0x800718C6 Val_Wu16 65535.00 DFES_OneToOne 0.00 65535.00 FORMAT "%8.2" /end CHARACTERISTIC
/begin CHARACTERISTIC DFC_CtlMsk.DFC_ETClbETMin_5_C "/" VALUE 0x800718C8 Val_Wu16 65535.00 DFES_OneToOne 0.00 65535.00 FORMAT "%8.2" /end CHARACTERISTIC
/begin CHARACTERISTIC DFC_CtlMsk.DFC_IVDiaBnkShCirBSH_0_C "/" VALUE 0x800718CA Val_Wu16 65535.00 DFES_OneToOne 0.00 65535.00 FORMAT "%8.2" /end CHARACTERISTIC
/begin CHARACTERISTIC DFC_CtlMsk.DFC_IVDiaBnkShCirBSH_1_C "/" VALUE 0x800718CC Val_Wu16 65535.00 DFES_OneToOne 0.00 65535.00 FORMAT "%8.2" /end CHARACTERISTIC
/begin CHARACTERISTIC DFC_CtlMsk.DFC_IVDiaBnkShCirChSwt_0_C "/" VALUE 0x800718CE Val_Wu16 65535.00 DFES_OneToOne 0.00 65535.00 FORMAT "%8.2" /end CHARACTERISTIC
/begin CHARACTERISTIC DFC_CtlMsk.DFC_IVDiaBnkShCirChSwt_1_C "/" VALUE 0x800718D0 Val_Wu16 65535.00 DFES_OneToOne 0.00 65535.00 FORMAT "%8.2" /end CHARACTERISTIC
/begin CHARACTERISTIC DFC_CtlMsk.DFC_IVDiaBnkShCirHSBatt_0_C "/" VALUE 0x800718D2 Val_Wu16 65535.00 DFES_OneToOne 0.00 65535.00 FORMAT "%8.2" /end CHARACTERISTIC
/begin CHARACTERISTIC DFC_CtlMsk.DFC_IVDiaBnkShCirHSBatt_1_C "/" VALUE 0x800718D4 Val_Wu16 65535.00 DFES_OneToOne 0.00 65535.00 FORMAT "%8.2" /end CHARACTERISTIC
/begin CHARACTERISTIC DFC_CtlMsk.DFC_IVDiaBnkShCirHiRstnc_0_C "/" VALUE 0x800718D6 Val_Wu16 65535.00 DFES_OneToOne 0.00 65535.00 FORMAT "%8.2" /end CHARACTERISTIC
/begin CHARACTERISTIC DFC_CtlMsk.DFC_IVDiaBnkShCirHiRstnc_1_C "/" VALUE 0x800718D8 Val_Wu16 65535.00 DFES_OneToOne 0.00 65535.00 FORMAT "%8.2" /end CHARACTERISTIC
/begin CHARACTERISTIC DFC_CtlMsk.DFC_IVDiaBnkShCirLSHSGnd_0_C "/" VALUE 0x800718DA Val_Wu16 65535.00 DFES_OneToOne 0.00 65535.00 FORMAT "%8.2" /end CHARACTERISTIC
/begin CHARACTERISTIC DFC_CtlMsk.DFC_IVDiaBnkShCirLSHSGnd_1_C "/" VALUE 0x800718DC Val_Wu16 65535.00 DFES_OneToOne 0.00 65535.00 FORMAT "%8.2" /end CHARACTERISTIC
/begin CHARACTERISTIC DFC_CtlMsk.DFC_IVDiaBnkShCirTransfer_0_C "/" VALUE 0x800718DE Val_Wu16 65535.00 DFES_OneToOne 0.00 65535.00 FORMAT "%8.2" /end CHARACTERISTIC
/begin CHARACTERISTIC DFC_CtlMsk.DFC_IVDiaBnkShCirTransfer_1_C "/" VALUE 0x800718E0 Val_Wu16 65535.00 DFES_OneToOne 0.00 65535.00 FORMAT "%8.2" /end CHARACTERISTIC
/begin CHARACTERISTIC DFC_CtlMsk.DFC_IVDiaCylNoCls_0_C "/" VALUE 0x800718E2 Val_Wu16 65535.00 DFES_OneToOne 0.00 65535.00 FORMAT "%8.2" /end CHARACTERISTIC
/begin CHARACTERISTIC DFC_CtlMsk.DFC_IVDiaCylNoCls_1_C "/" VALUE 0x800718E4 Val_Wu16 65535.00 DFES_OneToOne 0.00 65535.00 FORMAT "%8.2" /end CHARACTERISTIC
/begin CHARACTERISTIC DFC_CtlMsk.DFC_IVDiaCylNoCls_2_C "/" VALUE 0x800718E6 Val_Wu16 65535.00 DFES_OneToOne 0.00 65535.00 FORMAT "%8.2" /end CHARACTERISTIC
/begin CHARACTERISTIC DFC_CtlMsk.DFC_IVDiaCylNoCls_3_C "/" VALUE 0x800718E8 Val_Wu16 65535.00 DFES_OneToOne 0.00 65535.00 FORMAT "%8.2" /end CHARACTERISTIC
/begin CHARACTERISTIC DFC_CtlMsk.DFC_IVDiaCylNoCls_4_C "/" VALUE 0x800718EA Val_Wu16 65535.00 DFES_OneToOne 0.00 65535.00 FORMAT "%8.2" /end CHARACTERISTIC
/begin CHARACTERISTIC DFC_CtlMsk.DFC_IVDiaCylNoCls_5_C "/" VALUE 0x800718EC Val_Wu16 65535.00 DFES_OneToOne 0.00 65535.00 FORMAT "%8.2" /end CHARACTERISTIC
/begin CHARACTERISTIC DFC_CtlMsk.DFC_IVDiaCylNoLd_0_C "/" VALUE 0x800718EE Val_Wu16 65535.00 DFES_OneToOne 0.00 65535.00 FORMAT "%8.2" /end CHARACTERISTIC
/begin CHARACTERISTIC DFC_CtlMsk.DFC_IVDiaCylNoLd_1_C "/" VALUE 0x800718F0 Val_Wu16 65535.00 DFES_OneToOne 0.00 65535.00 FORMAT "%8.2" /end CHARACTERISTIC
/begin CHARACTERISTIC DFC_CtlMsk.DFC_IVDiaCylNoLd_2_C "/" VALUE 0x800718F2 Val_Wu16 65535.00 DFES_OneToOne 0.00 65535.00 FORMAT "%8.2" /end CHARACTERISTIC
/begin CHARACTERISTIC DFC_CtlMsk.DFC_IVDiaCylNoLd_3_C "/" VALUE 0x800718F4 Val_Wu16 65535.00 DFES_OneToOne 0.00 65535.00 FORMAT "%8.2" /end CHARACTERISTIC
/begin CHARACTERISTIC DFC_CtlMsk.DFC_IVDiaCylNoLd_4_C "/" VALUE 0x800718F6 Val_Wu16 65535.00 DFES_OneToOne 0.00 65535.00 FORMAT "%8.2" /end CHARACTERISTIC
/begin CHARACTERISTIC DFC_CtlMsk.DFC_IVDiaCylNoLd_5_C "/" VALUE 0x800718F8 Val_Wu16 65535.00 DFES_OneToOne 0.00 65535.00 FORMAT "%8.2" /end CHARACTERISTIC
/begin CHARACTERISTIC DFC_CtlMsk.DFC_IVDiaCylShCirHiRstnc_0_C "/" VALUE 0x800718FA Val_Wu16 65535.00 DFES_OneToOne 0.00 65535.00 FORMAT "%8.2" /end CHARACTERISTIC
/begin CHARACTERISTIC DFC_CtlMsk.DFC_IVDiaCylShCirHiRstnc_1_C "/" VALUE 0x800718FC Val_Wu16 65535.00 DFES_OneToOne 0.00 65535.00 FORMAT "%8.2" /end CHARACTERISTIC
/begin CHARACTERISTIC DFC_CtlMsk.DFC_IVDiaCylShCirHiRstnc_2_C "/" VALUE 0x800718FE Val_Wu16 65535.00 DFES_OneToOne 0.00 65535.00 FORMAT "%8.2" /end CHARACTERISTIC
/begin CHARACTERISTIC DFC_CtlMsk.DFC_IVDiaCylShCirHiRstnc_3_C "/" VALUE 0x80071900 Val_Wu16 65535.00 DFES_OneToOne 0.00 65535.00 FORMAT "%8.2" /end CHARACTERISTIC
/begin CHARACTERISTIC DFC_CtlMsk.DFC_IVDiaCylShCirHiRstnc_4_C "/" VALUE 0x80071902 Val_Wu16 65535.00 DFES_OneToOne 0.00 65535.00 FORMAT "%8.2" /end CHARACTERISTIC
/begin CHARACTERISTIC DFC_CtlMsk.DFC_IVDiaCylShCirHiRstnc_5_C "/" VALUE 0x80071904 Val_Wu16 65535.00 DFES_OneToOne 0.00 65535.00 FORMAT "%8.2" /end CHARACTERISTIC
/begin CHARACTERISTIC DFC_CtlMsk.DFC_IVDiaCylShCirLSBatt_0_C "/" VALUE 0x80071906 Val_Wu16 65535.00 DFES_OneToOne 0.00 65535.00 FORMAT "%8.2" /end CHARACTERISTIC
/begin CHARACTERISTIC DFC_CtlMsk.DFC_IVDiaCylShCirLSBatt_1_C "/" VALUE 0x80071908 Val_Wu16 65535.00 DFES_OneToOne 0.00 65535.00 FORMAT "%8.2" /end CHARACTERISTIC
/begin CHARACTERISTIC DFC_CtlMsk.DFC_IVDiaCylShCirLSBatt_2_C "/" VALUE 0x8007190A Val_Wu16 65535.00 DFES_OneToOne 0.00 65535.00 FORMAT "%8.2" /end CHARACTERISTIC
/begin CHARACTERISTIC DFC_CtlMsk.DFC_IVDiaCylShCirLSBatt_3_C "/" VALUE 0x8007190C Val_Wu16 65535.00 DFES_OneToOne 0.00 65535.00 FORMAT "%8.2" /end CHARACTERISTIC
/begin CHARACTERISTIC DFC_CtlMsk.DFC_IVDiaCylShCirLSBatt_4_C "/" VALUE 0x8007190E Val_Wu16 65535.00 DFES_OneToOne 0.00 65535.00 FORMAT "%8.2" /end CHARACTERISTIC
/begin CHARACTERISTIC DFC_CtlMsk.DFC_IVDiaCylShCirLSBatt_5_C "/" VALUE 0x80071910 Val_Wu16 65535.00 DFES_OneToOne 0.00 65535.00 FORMAT "%8.2" /end CHARACTERISTIC
/begin CHARACTERISTIC DFC_CtlMsk.DFC_IVDiaCylShCirLSHS_0_C "/" VALUE 0x80071912 Val_Wu16 65535.00 DFES_OneToOne 0.00 65535.00 FORMAT "%8.2" /end CHARACTERISTIC
/begin CHARACTERISTIC DFC_CtlMsk.DFC_IVDiaCylShCirLSHS_1_C "/" VALUE 0x80071914 Val_Wu16 65535.00 DFES_OneToOne 0.00 65535.00 FORMAT "%8.2" /end CHARACTERISTIC
/begin CHARACTERISTIC DFC_CtlMsk.DFC_IVDiaCylShCirLSHS_2_C "/" VALUE 0x80071916 Val_Wu16 65535.00 DFES_OneToOne 0.00 65535.00 FORMAT "%8.2" /end CHARACTERISTIC
/begin CHARACTERISTIC DFC_CtlMsk.DFC_IVDiaCylShCirLSHS_3_C "/" VALUE 0x80071918 Val_Wu16 65535.00 DFES_OneToOne 0.00 65535.00 FORMAT "%8.2" /end CHARACTERISTIC
/begin CHARACTERISTIC DFC_CtlMsk.DFC_IVDiaCylShCirLSHS_4_C "/" VALUE 0x8007191A Val_Wu16 65535.00 DFES_OneToOne 0.00 65535.00 FORMAT "%8.2" /end CHARACTERISTIC
/begin CHARACTERISTIC DFC_CtlMsk.DFC_IVDiaCylShCirLSHS_5_C "/" VALUE 0x8007191C Val_Wu16 65535.00 DFES_OneToOne 0.00 65535.00 FORMAT "%8.2" /end CHARACTERISTIC
/begin CHARACTERISTIC DFC_CtlMsk.DFC_IVDiaCylShCirLsLs_0_C "/" VALUE 0x8007191E Val_Wu16 65535.00 DFES_OneToOne 0.00 65535.00 FORMAT "%8.2" /end CHARACTERISTIC
/begin CHARACTERISTIC DFC_CtlMsk.DFC_IVDiaCylShCirLsLs_1_C "/" VALUE 0x80071920 Val_Wu16 65535.00 DFES_OneToOne 0.00 65535.00 FORMAT "%8.2" /end CHARACTERISTIC
/begin CHARACTERISTIC DFC_CtlMsk.DFC_IVDiaCylShCirLsLs_2_C "/" VALUE 0x80071922 Val_Wu16 65535.00 DFES_OneToOne 0.00 65535.00 FORMAT "%8.2" /end CHARACTERISTIC
/begin CHARACTERISTIC DFC_CtlMsk.DFC_IVDiaCylShCirLsLs_3_C "/" VALUE 0x80071924 Val_Wu16 65535.00 DFES_OneToOne 0.00 65535.00 FORMAT "%8.2" /end CHARACTERISTIC
/begin CHARACTERISTIC DFC_CtlMsk.DFC_IVDiaCylShCirLsLs_4_C "/" VALUE 0x80071926 Val_Wu16 65535.00 DFES_OneToOne 0.00 65535.00 FORMAT "%8.2" /end CHARACTERISTIC
/begin CHARACTERISTIC DFC_CtlMsk.DFC_IVDiaCylShCirLsLs_5_C "/" VALUE 0x80071928 Val_Wu16 65535.00 DFES_OneToOne 0.00 65535.00 FORMAT "%8.2" /end CHARACTERISTIC
/begin CHARACTERISTIC DFC_CtlMsk.DFC_IVDiaSPICfg_C "/" VALUE 0x8007192A Val_Wu16 65535.00 DFES_OneToOne 0.00 65535.00 FORMAT "%8.2" /end CHARACTERISTIC
/begin CHARACTERISTIC DFC_CtlMsk.DFC_IVDiaSPIColl_C "/" VALUE 0x8007192C Val_Wu16 65535.00 DFES_OneToOne 0.00 65535.00 FORMAT "%8.2" /end CHARACTERISTIC
/begin CHARACTERISTIC DFC_CtlMsk.DFC_IVDiaSPICtrl_C "/" VALUE 0x8007192E Val_Wu16 65535.00 DFES_OneToOne 0.00 65535.00 FORMAT "%8.2" /end CHARACTERISTIC
/begin CHARACTERISTIC DFC_CtlMsk.DFC_IVDiaSPIRam_C "/" VALUE 0x80071930 Val_Wu16 65535.00 DFES_OneToOne 0.00 65535.00 FORMAT "%8.2" /end CHARACTERISTIC
/begin CHARACTERISTIC DFC_CtlMsk.DFC_IVDiaSPITrans_C "/" VALUE 0x80071932 Val_Wu16 65535.00 DFES_OneToOne 0.00 65535.00 FORMAT "%8.2" /end CHARACTERISTIC
/begin CHARACTERISTIC DFC_CtlMsk.DFC_LSUCmpChk_0_C "/" VALUE 0x80071934 Val_Wu16 65535.00 DFES_OneToOne 0.00 65535.00 FORMAT "%8.2" /end CHARACTERISTIC
/begin CHARACTERISTIC DFC_CtlMsk.DFC_LSUCmpChk_1_C "/" VALUE 0x80071936 Val_Wu16 65535.00 DFES_OneToOne 0.00 65535.00 FORMAT "%8.2" /end CHARACTERISTIC
/begin CHARACTERISTIC DFC_CtlMsk.DFC_LSUCmpChk_2_C "/" VALUE 0x80071938 Val_Wu16 65535.00 DFES_OneToOne 0.00 65535.00 FORMAT "%8.2" /end CHARACTERISTIC
/begin CHARACTERISTIC DFC_CtlMsk.DFC_LSUCmpChk_3_C "/" VALUE 0x8007193A Val_Wu16 65535.00 DFES_OneToOne 0.00 65535.00 FORMAT "%8.2" /end CHARACTERISTIC
/begin CHARACTERISTIC DFC_CtlMsk.DFC_LSUCmpChk_4_C "/" VALUE 0x8007193C Val_Wu16 65535.00 DFES_OneToOne 0.00 65535.00 FORMAT "%8.2" /end CHARACTERISTIC
/begin CHARACTERISTIC DFC_CtlMsk.DFC_LSUCmpChk_5_C "/" VALUE 0x8007193E Val_Wu16 65535.00 DFES_OneToOne 0.00 65535.00 FORMAT "%8.2" /end CHARACTERISTIC
/begin CHARACTERISTIC DFC_CtlMsk.DFC_LSUDynChk_0_C "/" VALUE 0x80071940 Val_Wu16 65535.00 DFES_OneToOne 0.00 65535.00 FORMAT "%8.2" /end CHARACTERISTIC
/begin CHARACTERISTIC DFC_CtlMsk.DFC_LSUDynChk_1_C "/" VALUE 0x80071942 Val_Wu16 65535.00 DFES_OneToOne 0.00 65535.00 FORMAT "%8.2" /end CHARACTERISTIC
/begin CHARACTERISTIC DFC_CtlMsk.DFC_LSUDynChk_2_C "/" VALUE 0x80071944 Val_Wu16 65535.00 DFES_OneToOne 0.00 65535.00 FORMAT "%8.2" /end CHARACTERISTIC
/begin CHARACTERISTIC DFC_CtlMsk.DFC_LSUDynChk_3_C "/" VALUE 0x80071946 Val_Wu16 65535.00 DFES_OneToOne 0.00 65535.00 FORMAT "%8.2" /end CHARACTERISTIC
/begin CHARACTERISTIC DFC_CtlMsk.DFC_LSUO2ClbMax_0_C "/" VALUE 0x80071948 Val_Wu16 65535.00 DFES_OneToOne 0.00 65535.00 FORMAT "%8.2" /end CHARACTERISTIC
/begin CHARACTERISTIC DFC_CtlMsk.DFC_LSUO2ClbMax_1_C "/" VALUE 0x8007194A Val_Wu16 65535.00 DFES_OneToOne 0.00 65535.00 FORMAT "%8.2" /end CHARACTERISTIC
/begin CHARACTERISTIC DFC_CtlMsk.DFC_LSUO2ClbMax_2_C "/" VALUE 0x8007194C Val_Wu16 65535.00 DFES_OneToOne 0.00 65535.00 FORMAT "%8.2" /end CHARACTERISTIC
/begin CHARACTERISTIC DFC_CtlMsk.DFC_LSUO2ClbMax_3_C "/" VALUE 0x8007194E Val_Wu16 65535.00 DFES_OneToOne 0.00 65535.00 FORMAT "%8.2" /end CHARACTERISTIC
/begin CHARACTERISTIC DFC_CtlMsk.DFC_LSUO2ClbMin_0_C "/" VALUE 0x80071950 Val_Wu16 65535.00 DFES_OneToOne 0.00 65535.00 FORMAT "%8.2" /end CHARACTERISTIC
/begin CHARACTERISTIC DFC_CtlMsk.DFC_LSUO2ClbMin_1_C "/" VALUE 0x80071952 Val_Wu16 65535.00 DFES_OneToOne 0.00 65535.00 FORMAT "%8.2" /end CHARACTERISTIC
/begin CHARACTERISTIC DFC_CtlMsk.DFC_LSUO2ClbMin_2_C "/" VALUE 0x80071954 Val_Wu16 65535.00 DFES_OneToOne 0.00 65535.00 FORMAT "%8.2" /end CHARACTERISTIC
/begin CHARACTERISTIC DFC_CtlMsk.DFC_LSUO2ClbMin_3_C "/" VALUE 0x80071956 Val_Wu16 65535.00 DFES_OneToOne 0.00 65535.00 FORMAT "%8.2" /end CHARACTERISTIC
/begin CHARACTERISTIC DFC_CtlMsk.DFC_LSUO2PlausMax_0_C "/" VALUE 0x80071958 Val_Wu16 65535.00 DFES_OneToOne 0.00 65535.00 FORMAT "%8.2" /end CHARACTERISTIC
/begin CHARACTERISTIC DFC_CtlMsk.DFC_LSUO2PlausMax_1_C "/" VALUE 0x8007195A Val_Wu16 65535.00 DFES_OneToOne 0.00 65535.00 FORMAT "%8.2" /end CHARACTERISTIC
/begin CHARACTERISTIC DFC_CtlMsk.DFC_LSUO2PlausMax_2_C "/" VALUE 0x8007195C Val_Wu16 65535.00 DFES_OneToOne 0.00 65535.00 FORMAT "%8.2" /end CHARACTERISTIC
/begin CHARACTERISTIC DFC_CtlMsk.DFC_LSUO2PlausMax_3_C "/" VALUE 0x8007195E Val_Wu16 65535.00 DFES_OneToOne 0.00 65535.00 FORMAT "%8.2" /end CHARACTERISTIC
/begin CHARACTERISTIC DFC_CtlMsk.DFC_LSUO2PlausMin_0_C "/" VALUE 0x80071960 Val_Wu16 65535.00 DFES_OneToOne 0.00 65535.00 FORMAT "%8.2" /end CHARACTERISTIC
/begin CHARACTERISTIC DFC_CtlMsk.DFC_LSUO2PlausMin_1_C "/" VALUE 0x80071962 Val_Wu16 65535.00 DFES_OneToOne 0.00 65535.00 FORMAT "%8.2" /end CHARACTERISTIC
/begin CHARACTERISTIC DFC_CtlMsk.DFC_LSUO2PlausMin_2_C "/" VALUE 0x80071964 Val_Wu16 65535.00 DFES_OneToOne 0.00 65535.00 FORMAT "%8.2" /end CHARACTERISTIC
/begin CHARACTERISTIC DFC_CtlMsk.DFC_LSUO2PlausMin_3_C "/" VALUE 0x80071966 Val_Wu16 65535.00 DFES_OneToOne 0.00 65535.00 FORMAT "%8.2" /end CHARACTERISTIC
/begin CHARACTERISTIC DFC_CtlMsk.DFC_LSURiClbMax_0_C "/" VALUE 0x80071968 Val_Wu16 65535.00 DFES_OneToOne 0.00 65535.00 FORMAT "%8.2" /end CHARACTERISTIC
/begin CHARACTERISTIC DFC_CtlMsk.DFC_LSURiClbMax_1_C "/" VALUE 0x8007196A Val_Wu16 65535.00 DFES_OneToOne 0.00 65535.00 FORMAT "%8.2" /end CHARACTERISTIC
/begin CHARACTERISTIC DFC_CtlMsk.DFC_LSURiClbMax_2_C "/" VALUE 0x8007196C Val_Wu16 65535.00 DFES_OneToOne 0.00 65535.00 FORMAT "%8.2" /end CHARACTERISTIC
/begin CHARACTERISTIC DFC_CtlMsk.DFC_LSURiClbMax_3_C "/" VALUE 0x8007196E Val_Wu16 65535.00 DFES_OneToOne 0.00 65535.00 FORMAT "%8.2" /end CHARACTERISTIC
/begin CHARACTERISTIC DFC_CtlMsk.DFC_LSURiClbMin_0_C "/" VALUE 0x80071970 Val_Wu16 65535.00 DFES_OneToOne 0.00 65535.00 FORMAT "%8.2" /end CHARACTERISTIC
/begin CHARACTERISTIC DFC_CtlMsk.DFC_LSURiClbMin_1_C "/" VALUE 0x80071972 Val_Wu16 65535.00 DFES_OneToOne 0.00 65535.00 FORMAT "%8.2" /end CHARACTERISTIC
/begin CHARACTERISTIC DFC_CtlMsk.DFC_LSURiClbMin_2_C "/" VALUE 0x80071974 Val_Wu16 65535.00 DFES_OneToOne 0.00 65535.00 FORMAT "%8.2" /end CHARACTERISTIC
/begin CHARACTERISTIC DFC_CtlMsk.DFC_LSURiClbMin_3_C "/" VALUE 0x80071976 Val_Wu16 65535.00 DFES_OneToOne 0.00 65535.00 FORMAT "%8.2" /end CHARACTERISTIC
/begin CHARACTERISTIC DFC_CtlMsk.DFC_LSUWireIPSig_0_C "/" VALUE 0x80071978 Val_Wu16 65535.00 DFES_OneToOne 0.00 65535.00 FORMAT "%8.2" /end CHARACTERISTIC
/begin CHARACTERISTIC DFC_CtlMsk.DFC_LSUWireIPSig_1_C "/" VALUE 0x8007197A Val_Wu16 65535.00 DFES_OneToOne 0.00 65535.00 FORMAT "%8.2" /end CHARACTERISTIC
/begin CHARACTERISTIC DFC_CtlMsk.DFC_LSUWireIPSig_2_C "/" VALUE 0x8007197C Val_Wu16 65535.00 DFES_OneToOne 0.00 65535.00 FORMAT "%8.2" /end CHARACTERISTIC
/begin CHARACTERISTIC DFC_CtlMsk.DFC_LSUWireIPSig_3_C "/" VALUE 0x8007197E Val_Wu16 65535.00 DFES_OneToOne 0.00 65535.00 FORMAT "%8.2" /end CHARACTERISTIC
/begin CHARACTERISTIC DFC_CtlMsk.DFC_AFSDrftIdlAdjVal_C "/" VALUE 0x80071980 Val_Wu16 65535.00 DFES_OneToOne 0.00 65535.00 FORMAT "%8.2" /end CHARACTERISTIC
/begin CHARACTERISTIC DFC_CtlMsk.DFC_AFSDrftLdAdjVal_C "/" VALUE 0x80071982 Val_Wu16 65535.00 DFES_OneToOne 0.00 65535.00 FORMAT "%8.2" /end CHARACTERISTIC
/begin CHARACTERISTIC DFC_CtlMsk.DFC_AdcI_ADC0_Cal_C "/" VALUE 0x80071984 Val_Wu16 65535.00 DFES_OneToOne 0.00 65535.00 FORMAT "%8.2" /end CHARACTERISTIC
/begin CHARACTERISTIC DFC_CtlMsk.DFC_AdcI_ADC0_Conv_C "/" VALUE 0x80071986 Val_Wu16 65535.00 DFES_OneToOne 0.00 65535.00 FORMAT "%8.2" /end CHARACTERISTIC
/begin CHARACTERISTIC DFC_CtlMsk.DFC_CmbChbMisfireMax_0_C "/" VALUE 0x80071988 Val_Wu16 65535.00 DFES_OneToOne 0.00 65535.00 FORMAT "%8.2" /end CHARACTERISTIC
/begin CHARACTERISTIC DFC_CtlMsk.DFC_CmbChbMisfireMax_1_C "/" VALUE 0x8007198A Val_Wu16 65535.00 DFES_OneToOne 0.00 65535.00 FORMAT "%8.2" /end CHARACTERISTIC
/begin CHARACTERISTIC DFC_CtlMsk.DFC_CmbChbMisfireMax_2_C "/" VALUE 0x8007198C Val_Wu16 65535.00 DFES_OneToOne 0.00 65535.00 FORMAT "%8.2" /end CHARACTERISTIC
/begin CHARACTERISTIC DFC_CtlMsk.DFC_CmbChbMisfireMax_3_C "/" VALUE 0x8007198E Val_Wu16 65535.00 DFES_OneToOne 0.00 65535.00 FORMAT "%8.2" /end CHARACTERISTIC
/begin CHARACTERISTIC DFC_CtlMsk.DFC_CmbChbMisfireMax_4_C "/" VALUE 0x80071990 Val_Wu16 65535.00 DFES_OneToOne 0.00 65535.00 FORMAT "%8.2" /end CHARACTERISTIC
/begin CHARACTERISTIC DFC_CtlMsk.DFC_CmbChbMisfireMax_5_C "/" VALUE 0x80071992 Val_Wu16 65535.00 DFES_OneToOne 0.00 65535.00 FORMAT "%8.2" /end CHARACTERISTIC
/begin CHARACTERISTIC DFC_CtlMsk.DFC_CmbChbMisfireMul_C "/" VALUE 0x80071994 Val_Wu16 65535.00 DFES_OneToOne 0.00 65535.00 FORMAT "%8.2" /end CHARACTERISTIC
/begin CHARACTERISTIC DFC_CtlMsk.DFC_INJVLVBUSY_C "/" VALUE 0x80071996 Val_Wu16 65535.00 DFES_OneToOne 0.00 65535.00 FORMAT "%8.2" /end CHARACTERISTIC
/begin CHARACTERISTIC DFC_CtlMsk.DFC_IVAdjIVA_0_C "/" VALUE 0x80071998 Val_Wu16 65535.00 DFES_OneToOne 0.00 65535.00 FORMAT "%8.2" /end CHARACTERISTIC
/begin CHARACTERISTIC DFC_CtlMsk.DFC_IVAdjIVA_1_C "/" VALUE 0x8007199A Val_Wu16 65535.00 DFES_OneToOne 0.00 65535.00 FORMAT "%8.2" /end CHARACTERISTIC
/begin CHARACTERISTIC DFC_CtlMsk.DFC_IVAdjIVA_2_C "/" VALUE 0x8007199C Val_Wu16 65535.00 DFES_OneToOne 0.00 65535.00 FORMAT "%8.2" /end CHARACTERISTIC
/begin CHARACTERISTIC DFC_CtlMsk.DFC_IVAdjIVA_3_C "/" VALUE 0x8007199E Val_Wu16 65535.00 DFES_OneToOne 0.00 65535.00 FORMAT "%8.2" /end CHARACTERISTIC
/begin CHARACTERISTIC DFC_CtlMsk.DFC_IVAdjIVA_4_C "/" VALUE 0x800719A0 Val_Wu16 65535.00 DFES_OneToOne 0.00 65535.00 FORMAT "%8.2" /end CHARACTERISTIC
/begin CHARACTERISTIC DFC_CtlMsk.DFC_IVAdjIVA_5_C "/" VALUE 0x800719A2 Val_Wu16 65535.00 DFES_OneToOne 0.00 65535.00 FORMAT "%8.2" /end CHARACTERISTIC
/begin CHARACTERISTIC DFC_CtlMsk.DFC_InjCtlAdjQntEEPCS_C "/" VALUE 0x800719A4 Val_Wu16 65535.00 DFES_OneToOne 0.00 65535.00 FORMAT "%8.2" /end CHARACTERISTIC
/begin CHARACTERISTIC DFC_CtlMsk.DFC_InjCtlDriftEEPCS_C "/" VALUE 0x800719A6 Val_Wu16 65535.00 DFES_OneToOne 0.00 65535.00 FORMAT "%8.2" /end CHARACTERISTIC
/begin CHARACTERISTIC DFC_CtlMsk.DFC_MRlyErlyOpng_C "/" VALUE 0x800719A8 Val_Wu16 65535.00 DFES_OneToOne 0.00 65535.00 FORMAT "%8.2" /end CHARACTERISTIC
/begin CHARACTERISTIC DFC_CtlMsk.DFC_MRlyStk_C "/" VALUE 0x800719AA Val_Wu16 65535.00 DFES_OneToOne 0.00 65535.00 FORMAT "%8.2" /end CHARACTERISTIC
/begin CHARACTERISTIC DFC_CtlMsk.DFC_SensFrzPPFltUs_C "/" VALUE 0x800719AC Val_Wu16 65535.00 DFES_OneToOne 0.00 65535.00 FORMAT "%8.2" /end CHARACTERISTIC
/begin CHARACTERISTIC DFC_CtlMsk.DFC_T15Sig_C "/" VALUE 0x800719AE Val_Wu16 65535.00 DFES_OneToOne 0.00 65535.00 FORMAT "%8.2" /end CHARACTERISTIC
/begin CHARACTERISTIC DFC_CtlMsk.DFC_AirCtlRmpTOut_C "/" VALUE 0x800719B0 Val_Wu16 65535.00 DFES_OneToOne 0.00 65535.00 FORMAT "%8.2" /end CHARACTERISTIC
/begin CHARACTERISTIC DFC_CtlMsk.DFC_CEngDsTDynTst_C "/" VALUE 0x800719B2 Val_Wu16 65535.00 DFES_OneToOne 0.00 65535.00 FORMAT "%8.2" /end CHARACTERISTIC
/begin CHARACTERISTIC DFC_CtlMsk.DFC_EGRVlvJamVlvClsd_C "/" VALUE 0x800719B4 Val_Wu16 65535.00 DFES_OneToOne 0.00 65535.00 FORMAT "%8.2" /end CHARACTERISTIC
/begin CHARACTERISTIC DFC_CtlMsk.DFC_EGRVlvJamVlvOpn_C "/" VALUE 0x800719B6 Val_Wu16 65535.00 DFES_OneToOne 0.00 65535.00 FORMAT "%8.2" /end CHARACTERISTIC
/begin CHARACTERISTIC DFC_CtlMsk.DFC_EGRVlvLgTDrft_C "/" VALUE 0x800719B8 Val_Wu16 65535.00 DFES_OneToOne 0.00 65535.00 FORMAT "%8.2" /end CHARACTERISTIC
/begin CHARACTERISTIC DFC_CtlMsk.DFC_EGRVlvOfsLrnJamVlv_C "/" VALUE 0x800719BA Val_Wu16 65535.00 DFES_OneToOne 0.00 65535.00 FORMAT "%8.2" /end CHARACTERISTIC
/begin CHARACTERISTIC DFC_CtlMsk.DFC_EGRVlvShTDrft_C "/" VALUE 0x800719BC Val_Wu16 65535.00 DFES_OneToOne 0.00 65535.00 FORMAT "%8.2" /end CHARACTERISTIC
/begin CHARACTERISTIC DFC_CtlMsk.DFC_EGTRgnOilDilMax_C "/" VALUE 0x800719BE Val_Wu16 65535.00 DFES_OneToOne 0.00 65535.00 FORMAT "%8.2" /end CHARACTERISTIC
/begin CHARACTERISTIC DFC_CtlMsk.DFC_EngICO_C "/" VALUE 0x800719C0 Val_Wu16 65535.00 DFES_OneToOne 0.00 65535.00 FORMAT "%8.2" /end CHARACTERISTIC
/begin CHARACTERISTIC DFC_CtlMsk.DFC_EpmCaSI1ErrSig_C "/" VALUE 0x800719C2 Val_Wu16 65535.00 DFES_OneToOne 0.00 65535.00 FORMAT "%8.2" /end CHARACTERISTIC
/begin CHARACTERISTIC DFC_CtlMsk.DFC_EpmCaSI1NoSig_C "/" VALUE 0x800719C4 Val_Wu16 65535.00 DFES_OneToOne 0.00 65535.00 FORMAT "%8.2" /end CHARACTERISTIC
/begin CHARACTERISTIC DFC_CtlMsk.DFC_EpmCaSI1OfsErr_C "/" VALUE 0x800719C6 Val_Wu16 65535.00 DFES_OneToOne 0.00 65535.00 FORMAT "%8.2" /end CHARACTERISTIC
/begin CHARACTERISTIC DFC_CtlMsk.DFC_EpmCrSErrSig_C "/" VALUE 0x800719C8 Val_Wu16 65535.00 DFES_OneToOne 0.00 65535.00 FORMAT "%8.2" /end CHARACTERISTIC
/begin CHARACTERISTIC DFC_CtlMsk.DFC_EpmCrSNoSig_C "/" VALUE 0x800719CA Val_Wu16 65535.00 DFES_OneToOne 0.00 65535.00 FORMAT "%8.2" /end CHARACTERISTIC
/begin CHARACTERISTIC DFC_CtlMsk.DFC_MoCADCCmp_C "/" VALUE 0x800719CC Val_Wu16 65535.00 DFES_OneToOne 0.00 65535.00 FORMAT "%8.2" /end CHARACTERISTIC
/begin CHARACTERISTIC DFC_CtlMsk.DFC_MoCADCTst_C "/" VALUE 0x800719CE Val_Wu16 65535.00 DFES_OneToOne 0.00 65535.00 FORMAT "%8.2" /end CHARACTERISTIC
/begin CHARACTERISTIC DFC_CtlMsk.DFC_MoCADCVltgRatio_C "/" VALUE 0x800719D0 Val_Wu16 65535.00 DFES_OneToOne 0.00 65535.00 FORMAT "%8.2" /end CHARACTERISTIC
/begin CHARACTERISTIC DFC_CtlMsk.DFC_MoCSOPLoLi_C "/" VALUE 0x800719D2 Val_Wu16 65535.00 DFES_OneToOne 0.00 65535.00 FORMAT "%8.2" /end CHARACTERISTIC
/begin CHARACTERISTIC DFC_CtlMsk.DFC_MoCSOPMM_C "/" VALUE 0x800719D4 Val_Wu16 65535.00 DFES_OneToOne 0.00 65535.00 FORMAT "%8.2" /end CHARACTERISTIC
/begin CHARACTERISTIC DFC_CtlMsk.DFC_MoCSOPTimeOut_C "/" VALUE 0x800719D6 Val_Wu16 65535.00 DFES_OneToOne 0.00 65535.00 FORMAT "%8.2" /end CHARACTERISTIC
/begin CHARACTERISTIC DFC_CtlMsk.DFC_MoCSOPUpLi_C "/" VALUE 0x800719D8 Val_Wu16 65535.00 DFES_OneToOne 0.00 65535.00 FORMAT "%8.2" /end CHARACTERISTIC
/begin CHARACTERISTIC DFC_CtlMsk.DFC_MoFAPP_C "/" VALUE 0x800719DA Val_Wu16 65535.00 DFES_OneToOne 0.00 65535.00 FORMAT "%8.2" /end CHARACTERISTIC
/begin CHARACTERISTIC DFC_CtlMsk.DFC_MoFESpd_C "/" VALUE 0x800719DC Val_Wu16 65535.00 DFES_OneToOne 0.00 65535.00 FORMAT "%8.2" /end CHARACTERISTIC
/begin CHARACTERISTIC DFC_CtlMsk.DFC_MoFInjDatPhi_C "/" VALUE 0x800719DE Val_Wu16 65535.00 DFES_OneToOne 0.00 65535.00 FORMAT "%8.2" /end CHARACTERISTIC
/begin CHARACTERISTIC DFC_CtlMsk.DFC_MoFInjDatQnt_C "/" VALUE 0x800719E0 Val_Wu16 65535.00 DFES_OneToOne 0.00 65535.00 FORMAT "%8.2" /end CHARACTERISTIC
/begin CHARACTERISTIC DFC_CtlMsk.DFC_MoFInjQnt_C "/" VALUE 0x800719E2 Val_Wu16 65535.00 DFES_OneToOne 0.00 65535.00 FORMAT "%8.2" /end CHARACTERISTIC
/begin CHARACTERISTIC DFC_CtlMsk.DFC_MoFOvR_C "/" VALUE 0x800719E4 Val_Wu16 65535.00 DFES_OneToOne 0.00 65535.00 FORMAT "%8.2" /end CHARACTERISTIC
/begin CHARACTERISTIC DFC_CtlMsk.DFC_MoFQntCor_C "/" VALUE 0x800719E6 Val_Wu16 65535.00 DFES_OneToOne 0.00 65535.00 FORMAT "%8.2" /end CHARACTERISTIC
/begin CHARACTERISTIC DFC_CtlMsk.DFC_MoFTrqCmp_C "/" VALUE 0x800719E8 Val_Wu16 65535.00 DFES_OneToOne 0.00 65535.00 FORMAT "%8.2" /end CHARACTERISTIC
/begin CHARACTERISTIC DFC_CtlMsk.DFC_NplTOxiCatUs_C "/" VALUE 0x800719EA Val_Wu16 65535.00 DFES_OneToOne 0.00 65535.00 FORMAT "%8.2" /end CHARACTERISTIC
/begin CHARACTERISTIC DFC_CtlMsk.DFC_PhyModNonMonMapNpl_C "/" VALUE 0x800719EC Val_Wu16 65535.00 DFES_OneToOne 0.00 65535.00 FORMAT "%8.2" /end CHARACTERISTIC
/begin CHARACTERISTIC DFC_CtlMsk.DFC_RailPOfsTstMax_C "/" VALUE 0x800719EE Val_Wu16 65535.00 DFES_OneToOne 0.00 65535.00 FORMAT "%8.2" /end CHARACTERISTIC
/begin CHARACTERISTIC DFC_CtlMsk.DFC_RailPOfsTstMin_C "/" VALUE 0x800719F0 Val_Wu16 65535.00 DFES_OneToOne 0.00 65535.00 FORMAT "%8.2" /end CHARACTERISTIC
/begin CHARACTERISTIC DFC_CtlMsk.DFC_SWReset_0_C "/" VALUE 0x800719F2 Val_Wu16 65535.00 DFES_OneToOne 0.00 65535.00 FORMAT "%8.2" /end CHARACTERISTIC
/begin CHARACTERISTIC DFC_CtlMsk.DFC_SWReset_1_C "/" VALUE 0x800719F4 Val_Wu16 65535.00 DFES_OneToOne 0.00 65535.00 FORMAT "%8.2" /end CHARACTERISTIC
/begin CHARACTERISTIC DFC_CtlMsk.DFC_SWReset_2_C "/" VALUE 0x800719F6 Val_Wu16 65535.00 DFES_OneToOne 0.00 65535.00 FORMAT "%8.2" /end CHARACTERISTIC
/begin CHARACTERISTIC DFC_CtlMsk.DFC_VSwVlvJamVlv_C "/" VALUE 0x800719F8 Val_Wu16 65535.00 DFES_OneToOne 0.00 65535.00 FORMAT "%8.2" /end CHARACTERISTIC
/begin CHARACTERISTIC DFC_CtlMsk.DFC_VSwVlvLgTDrft_C "/" VALUE 0x800719FA Val_Wu16 65535.00 DFES_OneToOne 0.00 65535.00 FORMAT "%8.2" /end CHARACTERISTIC
/begin CHARACTERISTIC DFC_CtlMsk.DFC_VSwVlvOfsLrnJamVlv_C "/" VALUE 0x800719FC Val_Wu16 65535.00 DFES_OneToOne 0.00 65535.00 FORMAT "%8.2" /end CHARACTERISTIC
/begin CHARACTERISTIC DFC_CtlMsk.DFC_VSwVlvShTDrft_C "/" VALUE 0x800719FE Val_Wu16 65535.00 DFES_OneToOne 0.00 65535.00 FORMAT "%8.2" /end CHARACTERISTIC
/begin FUNCTION dfc_ctl_msk_auto ""
 /begin DEF_CHARACTERISTIC DFC_CtlMsk.DFC_AirCtlGovDvtEOMMax_C DFC_CtlMsk.DFC_AirCtlGovDvtEOMMin_C DFC_CtlMsk.DFC_AirCtlGovDvtMax_C DFC_CtlMsk.DFC_AirCtlGovDvtMin_C DFC_CtlMsk.DFC_Cj945SpiCom1_C DFC_CtlMsk.DFC_ComButtonMSASig_C DFC_CtlMsk.DFC_ComButtonMSATo_C DFC_CtlMsk.DFC_ComGearboxData2Sig_C DFC_CtlMsk.DFC_ComGearboxData2To_C DFC_CtlMsk.DFC_ComGearboxDataSig_C DFC_CtlMsk.DFC_ComGearboxDataTo_C DFC_CtlMsk.DFC_ComHeatACSig_C DFC_CtlMsk.DFC_ComHeatACTo_C DFC_CtlMsk.DFC_ComLenkradwinkelSig_C DFC_CtlMsk.DFC_ComLenkradwinkelTo_C DFC_CtlMsk.DFC_ComMileageRangeSig_C DFC_CtlMsk.DFC_ComMileageRangeTo_C DFC_CtlMsk.DFC_ComPspSig_C DFC_CtlMsk.DFC_ComPspTo_C DFC_CtlMsk.DFC_ComShutOffPSPSig_C DFC_CtlMsk.DFC_ComShutOffPSPTo_C DFC_CtlMsk.DFC_ComStKombiCtr_C DFC_CtlMsk.DFC_ComStKombiSig_C DFC_CtlMsk.DFC_ComStKombiTo_C DFC_CtlMsk.DFC_ComStateARSCtr_C DFC_CtlMsk.DFC_ComStateARSSig_C DFC_CtlMsk.DFC_ComStateARSTo_C DFC_CtlMsk.DFC_ComStateDscSig_C DFC_CtlMsk.DFC_ComStateDscTo_C DFC_CtlMsk.DFC_ComStateSeatSig_C DFC_CtlMsk.DFC_ComStateSeatTo_C DFC_CtlMsk.DFC_ComTempRelTimeSig_C DFC_CtlMsk.DFC_ComTempRelTimeTo_C DFC_CtlMsk.DFC_ComTerminalChk_C DFC_CtlMsk.DFC_ComTerminalCtr_C DFC_CtlMsk.DFC_ComTerminalSig_C DFC_CtlMsk.DFC_ComTerminalTo_C DFC_CtlMsk.DFC_ComTimeDateSig_C DFC_CtlMsk.DFC_ComTimeDateTo_C DFC_CtlMsk.DFC_ComTrailerSig_C DFC_CtlMsk.DFC_ComTrailerTo_C DFC_CtlMsk.DFC_ComTrqDemandAfsChk_C DFC_CtlMsk.DFC_ComTrqDemandAfsCtr_C DFC_CtlMsk.DFC_ComTrqDemandAfsSig_C DFC_CtlMsk.DFC_ComTrqDemandAfsTo_C DFC_CtlMsk.DFC_ComTrqDemandDscChk_C DFC_CtlMsk.DFC_ComTrqDemandDscCtr_C DFC_CtlMsk.DFC_ComTrqDemandDscSig_C DFC_CtlMsk.DFC_ComTrqDemandDscTo_C DFC_CtlMsk.DFC_ComTrqDemandGbxChk_C DFC_CtlMsk.DFC_ComTrqDemandGbxCtr_C DFC_CtlMsk.DFC_ComTrqDemandGbxSig_C DFC_CtlMsk.DFC_ComTrqDemandGbxTo_C DFC_CtlMsk.DFC_ComVelocitySig_C DFC_CtlMsk.DFC_ComVelocityTo_C DFC_CtlMsk.DFC_ComWheelSpeedSig_C DFC_CtlMsk.DFC_ComWheelSpeedTo_C DFC_CtlMsk.DFC_ComZvKlappenSig_C DFC_CtlMsk.DFC_ComZvKlappenTo_C DFC_CtlMsk.DFC_Cy150SpiCom_C DFC_CtlMsk.DFC_Cy320SpiCom_C DFC_CtlMsk.DFC_ETCtlDvtInrMax_C DFC_CtlMsk.DFC_ETCtlDvtInrMin_C DFC_CtlMsk.DFC_ETCtlDvtOutrMax_C DFC_CtlMsk.DFC_ETCtlDvtOutrMin_C DFC_CtlMsk.DFC_Fan4WinErr1_C DFC_CtlMsk.DFC_Fan4WinErr2_C DFC_CtlMsk.DFC_Fan4WinErr3_C DFC_CtlMsk.DFC_Fan4WinErr4_C DFC_CtlMsk.DFC_FanSCG_C DFC_CtlMsk.DFC_PCRGovDvtLPMax_C DFC_CtlMsk.DFC_PCRGovDvtLPMin_C DFC_CtlMsk.DFC_PCRGovDvtMax_C DFC_CtlMsk.DFC_PCRGovDvtMin_C DFC_CtlMsk.DFC_RailCPC1_C DFC_CtlMsk.DFC_RailCPC3_C DFC_CtlMsk.DFC_RailCPC4_C DFC_CtlMsk.DFC_RailMeUn0_C DFC_CtlMsk.DFC_RailMeUn1_C DFC_CtlMsk.DFC_RailMeUn2_C DFC_CtlMsk.DFC_RailMeUn3_C DFC_CtlMsk.DFC_RailMeUn4_C DFC_CtlMsk.DFC_RailPCV0_C DFC_CtlMsk.DFC_RailPCV1_C DFC_CtlMsk.DFC_RailPCV2_C DFC_CtlMsk.DFC_RailPCV3_C DFC_CtlMsk.DFC_RailPCV4_C DFC_CtlMsk.DFC_RailPMonStrt_C DFC_CtlMsk.DFC_SSpMon1_C DFC_CtlMsk.DFC_SSpMon2_C DFC_CtlMsk.DFC_SSpMon3_C DFC_CtlMsk.DFC_Sia_E1_C DFC_CtlMsk.DFC_Sia_E10_C DFC_CtlMsk.DFC_Sia_E11_C DFC_CtlMsk.DFC_Sia_E12_C DFC_CtlMsk.DFC_Sia_E13_C DFC_CtlMsk.DFC_Sia_E14_C DFC_CtlMsk.DFC_Sia_E15_C DFC_CtlMsk.DFC_Sia_E2_C DFC_CtlMsk.DFC_Sia_E3_C DFC_CtlMsk.DFC_Sia_E4_C DFC_CtlMsk.DFC_Sia_E5_C DFC_CtlMsk.DFC_Sia_E6_C DFC_CtlMsk.DFC_Sia_E7_C DFC_CtlMsk.DFC_Sia_E8_C DFC_CtlMsk.DFC_Sia_E9_C DFC_CtlMsk.DFC_ThrVlv4WinErr1_C DFC_CtlMsk.DFC_ThrVlv4WinErr2_C DFC_CtlMsk.DFC_ThrVlv4WinErr3_C DFC_CtlMsk.DFC_ThrVlv4WinErr4_C DFC_CtlMsk.DFC_ThrVlvSCG_C DFC_CtlMsk.DFC_TrbCh4WinErr1_C DFC_CtlMsk.DFC_TrbCh4WinErr2_C DFC_CtlMsk.DFC_TrbCh4WinErr3_C DFC_CtlMsk.DFC_TrbCh4WinErr4_C DFC_CtlMsk.DFC_TrbChSCG_C DFC_CtlMsk.DFC_TrbChSRCMax_C DFC_CtlMsk.DFC_TrbChSRCMin_C DFC_CtlMsk.DFC_WaHtEl4WinErr1_C DFC_CtlMsk.DFC_WaHtEl4WinErr2_C DFC_CtlMsk.DFC_WaHtEl4WinErr3_C DFC_CtlMsk.DFC_WaHtEl4WinErr4_C DFC_CtlMsk.DFC_WaHtElSCG_C DFC_CtlMsk.DFC_ETClbETFltMax_C DFC_CtlMsk.DFC_ETClbETFltMin_C DFC_CtlMsk.DFC_InjCrvInjLimChrgBal_C DFC_CtlMsk.DFC_InjCrvInjLimQntBal_C DFC_CtlMsk.DFC_InjCrvInjLimSys_C DFC_CtlMsk.DFC_InjCrvNumInjRtmLim_C DFC_CtlMsk.DFC_LSUHtCoupSig_0_C DFC_CtlMsk.DFC_LSUHtCoupSig_1_C DFC_CtlMsk.DFC_LSUHtCoupSig_2_C DFC_CtlMsk.DFC_LSUHtCoupSig_3_C DFC_CtlMsk.DFC_CtT_C DFC_CtlMsk.DFC_DSMDummy_C DFC_CtlMsk.DFC_MeUnOL_C DFC_CtlMsk.DFC_MeUnSCB_C DFC_CtlMsk.DFC_MeUnSRCMax_C DFC_CtlMsk.DFC_MeUnSRCMin_C DFC_CtlMsk.DFC_PCVOL_C DFC_CtlMsk.DFC_PCVSCB_C DFC_CtlMsk.DFC_PCVSRCMax_C DFC_CtlMsk.DFC_PCVSRCMin_C DFC_CtlMsk.DFC_RailPSRCMax_C DFC_CtlMsk.DFC_RailPSRCMin_C DFC_CtlMsk.DFC_IVActrVltgSRCMax_C DFC_CtlMsk.DFC_IVActrVltgSRCMin_C DFC_CtlMsk.DFC_IVPSplyDCDC_C DFC_CtlMsk.DFC_IVPSplyVltgSRCMax_C DFC_CtlMsk.DFC_IVPSplyVltgSRCMin_C DFC_CtlMsk.DFC_AFSOffsDrftMax_C DFC_CtlMsk.DFC_AFSOffsDrftMin_C DFC_CtlMsk.DFC_AFSSRCCorMax_C DFC_CtlMsk.DFC_AFSSRCCorMin_C DFC_CtlMsk.DFC_AFSSRCRawMax_C DFC_CtlMsk.DFC_AFSSRCRawMin_C DFC_CtlMsk.DFC_AFSSetyDrftMax_C DFC_CtlMsk.DFC_AFSSetyDrftMin_C DFC_CtlMsk.DFC_AirCClntPAnaSRCMax_C DFC_CtlMsk.DFC_AirCClntPAnaSRCMin_C DFC_CtlMsk.DFC_AirCClntPPerSRCMax_C DFC_CtlMsk.DFC_AirCClntPPerSRCMin_C DFC_CtlMsk.DFC_AirCClntPdcycSRCMax_C DFC_CtlMsk.DFC_AirCClntPdcycSRCMin_C DFC_CtlMsk.DFC_AirCCmprOL_C DFC_CtlMsk.DFC_AirCCmprRedTrqOL_C DFC_CtlMsk.DFC_AirCCmprRedTrqSCB_C DFC_CtlMsk.DFC_AirCCmprRedTrqSCG_C DFC_CtlMsk.DFC_AirCCmprSCB_C DFC_CtlMsk.DFC_AirCCmprSCG_C DFC_CtlMsk.DFC_AirCSwtNpl_C DFC_CtlMsk.DFC_AirCSwtSig_C DFC_CtlMsk.DFC_BattUSRCMax_C DFC_CtlMsk.DFC_BattUSRCMin_C DFC_CtlMsk.DFC_BrkNpl_C DFC_CtlMsk.DFC_BrkPSRCMax_C DFC_CtlMsk.DFC_BrkPSRCMin_C DFC_CtlMsk.DFC_BrkSig_C DFC_CtlMsk.DFC_CByVlvOL_C DFC_CtlMsk.DFC_CByVlvSCB_C DFC_CtlMsk.DFC_CByVlvSCG_C DFC_CtlMsk.DFC_CEngDsTSRCMax_C DFC_CtlMsk.DFC_CEngDsTSRCMin_C DFC_CtlMsk.DFC_CEngDsTSig_C DFC_CtlMsk.DFC_CEngUsTSRCMax_C DFC_CtlMsk.DFC_CEngUsTSRCMin_C DFC_CtlMsk.DFC_CThmstOL_C DFC_CtlMsk.DFC_CThmstSCB_C DFC_CtlMsk.DFC_CThmstSCG_C DFC_CtlMsk.DFC_ClthSig_C DFC_CtlMsk.DFC_ECBVlvOL_C DFC_CtlMsk.DFC_ECBVlvSCB_C DFC_CtlMsk.DFC_ECBVlvSCG_C DFC_CtlMsk.DFC_ECBVlvSRCMax_C DFC_CtlMsk.DFC_ECBVlvSRCMin_C DFC_CtlMsk.DFC_EGRVlvGovDvtMax_C DFC_CtlMsk.DFC_EGRVlvGovDvtMin_C DFC_CtlMsk.DFC_EGRVlvOL_C DFC_CtlMsk.DFC_EGRVlvSCB_C DFC_CtlMsk.DFC_EGRVlvSCG_C DFC_CtlMsk.DFC_EGRVlvSRCMax_C DFC_CtlMsk.DFC_EGRVlvSRCMin_C DFC_CtlMsk.DFC_EMDmpOL_0_C DFC_CtlMsk.DFC_EMDmpOL_1_C DFC_CtlMsk.DFC_EMDmpSCB_0_C DFC_CtlMsk.DFC_EMDmpSCB_1_C DFC_CtlMsk.DFC_EMDmpSCG_0_C DFC_CtlMsk.DFC_EMDmpSCG_1_C DFC_CtlMsk.DFC_EngStAOL_C DFC_CtlMsk.DFC_EngStASCB_C DFC_CtlMsk.DFC_EngStASCG_C DFC_CtlMsk.DFC_EnvPSRCMax_C DFC_CtlMsk.DFC_EnvPSRCMin_C DFC_CtlMsk.DFC_EnvPSig_C DFC_CtlMsk.DFC_EnvTSRCMax_C DFC_CtlMsk.DFC_EnvTSRCMin_C DFC_CtlMsk.DFC_FanOL_C DFC_CtlMsk.DFC_FanSCB_C DFC_CtlMsk.DFC_FlFltSig_C DFC_CtlMsk.DFC_FuelTSRCMax_C DFC_CtlMsk.DFC_FuelTSRCMin_C DFC_CtlMsk.DFC_GbxNPosPPerSRCMax_C DFC_CtlMsk.DFC_GbxNPosPPerSRCMin_C DFC_CtlMsk.DFC_GbxNPosPdcycSRCMax_C DFC_CtlMsk.DFC_GbxNPosPdcycSRCMin_C DFC_CtlMsk.DFC_GbxNPosSig_C DFC_CtlMsk.DFC_GlwPlgBSDOL_0_C DFC_CtlMsk.DFC_GlwPlgBSDOL_1_C DFC_CtlMsk.DFC_GlwPlgBSDOL_2_C DFC_CtlMsk.DFC_GlwPlgBSDOL_3_C DFC_CtlMsk.DFC_GlwPlgBSDOL_4_C DFC_CtlMsk.DFC_GlwPlgBSDOL_5_C DFC_CtlMsk.DFC_GlwPlgBSDOL_6_C DFC_CtlMsk.DFC_GlwPlgBSDOL_7_C DFC_CtlMsk.DFC_GlwPlgBSDOT_0_C DFC_CtlMsk.DFC_GlwPlgBSDOT_1_C DFC_CtlMsk.DFC_GlwPlgBSDOT_2_C DFC_CtlMsk.DFC_GlwPlgBSDOT_3_C DFC_CtlMsk.DFC_GlwPlgBSDOT_4_C DFC_CtlMsk.DFC_GlwPlgBSDOT_5_C DFC_CtlMsk.DFC_GlwPlgBSDOT_6_C DFC_CtlMsk.DFC_GlwPlgBSDOT_7_C DFC_CtlMsk.DFC_GlwPlgBSDSC_0_C DFC_CtlMsk.DFC_GlwPlgBSDSC_1_C DFC_CtlMsk.DFC_GlwPlgBSDSC_2_C DFC_CtlMsk.DFC_GlwPlgBSDSC_3_C DFC_CtlMsk.DFC_GlwPlgBSDSC_4_C DFC_CtlMsk.DFC_GlwPlgBSDSC_5_C DFC_CtlMsk.DFC_GlwPlgBSDSC_6_C DFC_CtlMsk.DFC_GlwPlgBSDSC_7_C DFC_CtlMsk.DFC_GlwPlgComErr_C DFC_CtlMsk.DFC_InjVlvPresMin_C DFC_CtlMsk.DFC_LSUCircNernstMax_0_C DFC_CtlMsk.DFC_LSUCircNernstMax_1_C DFC_CtlMsk.DFC_LSUCircNernstMax_2_C DFC_CtlMsk.DFC_LSUCircNernstMax_3_C DFC_CtlMsk.DFC_LSUCircNernstMin_0_C DFC_CtlMsk.DFC_LSUCircNernstMin_1_C DFC_CtlMsk.DFC_LSUCircNernstMin_2_C DFC_CtlMsk.DFC_LSUCircNernstMin_3_C DFC_CtlMsk.DFC_LSUCircNernstSig_0_C DFC_CtlMsk.DFC_LSUCircNernstSig_1_C DFC_CtlMsk.DFC_LSUCircNernstSig_2_C DFC_CtlMsk.DFC_LSUCircNernstSig_3_C DFC_CtlMsk.DFC_LSUCircPmpCurMax_0_C DFC_CtlMsk.DFC_LSUCircPmpCurMax_1_C DFC_CtlMsk.DFC_LSUCircPmpCurMax_2_C DFC_CtlMsk.DFC_LSUCircPmpCurMax_3_C DFC_CtlMsk.DFC_LSUCircPmpCurMin_0_C DFC_CtlMsk.DFC_LSUCircPmpCurMin_1_C DFC_CtlMsk.DFC_LSUCircPmpCurMin_2_C DFC_CtlMsk.DFC_LSUCircPmpCurMin_3_C DFC_CtlMsk.DFC_LSUCircPmpCurSig_0_C DFC_CtlMsk.DFC_LSUCircPmpCurSig_1_C DFC_CtlMsk.DFC_LSUCircPmpCurSig_2_C DFC_CtlMsk.DFC_LSUCircPmpCurSig_3_C DFC_CtlMsk.DFC_LSUCircVirtGndMax_0_C DFC_CtlMsk.DFC_LSUCircVirtGndMax_1_C DFC_CtlMsk.DFC_LSUCircVirtGndMax_2_C DFC_CtlMsk.DFC_LSUCircVirtGndMax_3_C DFC_CtlMsk.DFC_LSUCircVirtGndMin_0_C DFC_CtlMsk.DFC_LSUCircVirtGndMin_1_C DFC_CtlMsk.DFC_LSUCircVirtGndMin_2_C DFC_CtlMsk.DFC_LSUCircVirtGndMin_3_C DFC_CtlMsk.DFC_LSUCircVirtGndSig_0_C DFC_CtlMsk.DFC_LSUCircVirtGndSig_1_C DFC_CtlMsk.DFC_LSUCircVirtGndSig_2_C DFC_CtlMsk.DFC_LSUCircVirtGndSig_3_C DFC_CtlMsk.DFC_LSUHtrMax_0_C DFC_CtlMsk.DFC_LSUHtrMax_1_C DFC_CtlMsk.DFC_LSUHtrMax_2_C DFC_CtlMsk.DFC_LSUHtrMax_3_C DFC_CtlMsk.DFC_LSUHtrMin_0_C DFC_CtlMsk.DFC_LSUHtrMin_1_C DFC_CtlMsk.DFC_LSUHtrMin_2_C DFC_CtlMsk.DFC_LSUHtrMin_3_C DFC_CtlMsk.DFC_LSUHtrSig_0_C DFC_CtlMsk.DFC_LSUHtrSig_1_C DFC_CtlMsk.DFC_LSUHtrSig_2_C DFC_CtlMsk.DFC_LSUHtrSig_3_C DFC_CtlMsk.DFC_LSUO2Max_0_C DFC_CtlMsk.DFC_LSUO2Max_1_C DFC_CtlMsk.DFC_LSUO2Max_2_C DFC_CtlMsk.DFC_LSUO2Max_3_C DFC_CtlMsk.DFC_LSUO2Min_0_C DFC_CtlMsk.DFC_LSUO2Min_1_C DFC_CtlMsk.DFC_LSUO2Min_2_C DFC_CtlMsk.DFC_LSUO2Min_3_C DFC_CtlMsk.DFC_LSUSPIBattLowMin_0_C DFC_CtlMsk.DFC_LSUSPIBattLowMin_1_C DFC_CtlMsk.DFC_LSUSPIBattLowMin_2_C DFC_CtlMsk.DFC_LSUSPIBattLowMin_3_C DFC_CtlMsk.DFC_LSUSPISig_0_C DFC_CtlMsk.DFC_LSUSPISig_1_C DFC_CtlMsk.DFC_LSUSPISig_2_C DFC_CtlMsk.DFC_LSUSPISig_3_C DFC_CtlMsk.DFC_LSUtExcMax_0_C DFC_CtlMsk.DFC_LSUtExcMax_1_C DFC_CtlMsk.DFC_LSUtExcMax_2_C DFC_CtlMsk.DFC_LSUtExcMax_3_C DFC_CtlMsk.DFC_LSUtExcMin_0_C DFC_CtlMsk.DFC_LSUtExcMin_1_C DFC_CtlMsk.DFC_LSUtExcMin_2_C DFC_CtlMsk.DFC_LSUtExcMin_3_C DFC_CtlMsk.DFC_MILOL_C DFC_CtlMsk.DFC_MILSCB_C DFC_CtlMsk.DFC_MILSCG_C DFC_CtlMsk.DFC_MeUnSCG_C DFC_CtlMsk.DFC_NplHsChngPPFltDiff_C DFC_CtlMsk.DFC_NplPAirFltDs_C DFC_CtlMsk.DFC_NplTPFltUs_C DFC_CtlMsk.DFC_OilComErr_C DFC_CtlMsk.DFC_OilPLmpOL_C DFC_CtlMsk.DFC_OilPLmpSCB_C DFC_CtlMsk.DFC_OilPLmpSCG_C DFC_CtlMsk.DFC_OilPNpl_C DFC_CtlMsk.DFC_OilTNpl_C DFC_CtlMsk.DFC_OilTSRCMax_C DFC_CtlMsk.DFC_OilTSRCMin_C DFC_CtlMsk.DFC_PCACDsEnvPPls_C DFC_CtlMsk.DFC_PCACDsSRCMax_C DFC_CtlMsk.DFC_PCACDsSRCMin_C DFC_CtlMsk.DFC_PCVSCG_C DFC_CtlMsk.DFC_PFltCharPDiffMin_C DFC_CtlMsk.DFC_PFltDstrMin_C DFC_CtlMsk.DFC_PFltEngPrt_C DFC_CtlMsk.DFC_PFltLmpOL_C DFC_CtlMsk.DFC_PFltLmpSCB_C DFC_CtlMsk.DFC_PFltLmpSCG_C DFC_CtlMsk.DFC_PFltRgnPerm_C DFC_CtlMsk.DFC_PFltSRCMaxFlwRstn_C DFC_CtlMsk.DFC_PFltSRCMinFlwRstn_C DFC_CtlMsk.DFC_PFltSotMsDvtMax_C DFC_CtlMsk.DFC_PFltSotMsDvtMin_C DFC_CtlMsk.DFC_PFltSotMsMax_C DFC_CtlMsk.DFC_PSPOL_C DFC_CtlMsk.DFC_PSPSCB_C DFC_CtlMsk.DFC_PSPSCG_C DFC_CtlMsk.DFC_SRCHighAPP1_C DFC_CtlMsk.DFC_SRCHighAPP2_C DFC_CtlMsk.DFC_SRCLowAPP1_C DFC_CtlMsk.DFC_SRCLowAPP2_C DFC_CtlMsk.DFC_SRCMaxPAirFltDs_C DFC_CtlMsk.DFC_SRCMaxPPFltUs_C DFC_CtlMsk.DFC_SRCMaxTECU_C DFC_CtlMsk.DFC_SRCMaxTOxiCatUs_C DFC_CtlMsk.DFC_SRCMaxTPFltUs_C DFC_CtlMsk.DFC_SRCMinPAirFltDs_C DFC_CtlMsk.DFC_SRCMinPPFltUs_C DFC_CtlMsk.DFC_SRCMinTECU_C DFC_CtlMsk.DFC_SRCMinTOxiCatUs_C DFC_CtlMsk.DFC_SRCMinTPFltUs_C DFC_CtlMsk.DFC_SVSOL_C DFC_CtlMsk.DFC_SVSSCB_C DFC_CtlMsk.DFC_SVSSCG_C DFC_CtlMsk.DFC_StrtOL_C DFC_CtlMsk.DFC_StrtSCB_C DFC_CtlMsk.DFC_StrtSCG_C DFC_CtlMsk.DFC_SyncAPP_C DFC_CtlMsk.DFC_T15Npl_C DFC_CtlMsk.DFC_TAFSDtyCycHi_C DFC_CtlMsk.DFC_TAFSDtyCycLo_C DFC_CtlMsk.DFC_TAFSPerHi_C DFC_CtlMsk.DFC_TAFSPerLo_C DFC_CtlMsk.DFC_TCACDsSRCMax_C DFC_CtlMsk.DFC_TCACDsSRCMin_C DFC_CtlMsk.DFC_ThrVlvOL_C DFC_CtlMsk.DFC_ThrVlvSCB_C DFC_CtlMsk.DFC_ThrVlvSRCMax_C DFC_CtlMsk.DFC_ThrVlvSRCMin_C DFC_CtlMsk.DFC_TrbChLPOL_C DFC_CtlMsk.DFC_TrbChLPSCB_C DFC_CtlMsk.DFC_TrbChLPSCG_C DFC_CtlMsk.DFC_TrbChOL_C DFC_CtlMsk.DFC_TrbChSCB_C DFC_CtlMsk.DFC_VSwVlvGovDvtMax_C DFC_CtlMsk.DFC_VSwVlvGovDvtMin_C DFC_CtlMsk.DFC_VSwVlvOL_C DFC_CtlMsk.DFC_VSwVlvSCB_C DFC_CtlMsk.DFC_VSwVlvSCG_C DFC_CtlMsk.DFC_VSwVlvSRCMax_C DFC_CtlMsk.DFC_VSwVlvSRCMin_C DFC_CtlMsk.DFC_VehVHW_C DFC_CtlMsk.DFC_VehVMax_C DFC_CtlMsk.DFC_VehVPlaus_C DFC_CtlMsk.DFC_VehVSig_C DFC_CtlMsk.DFC_WaHtElOL_C DFC_CtlMsk.DFC_WaHtElSCB_C DFC_CtlMsk.DFC_ClthNpl_C DFC_CtlMsk.DFC_ETClbETMax_0_C DFC_CtlMsk.DFC_ETClbETMax_1_C DFC_CtlMsk.DFC_ETClbETMax_2_C DFC_CtlMsk.DFC_ETClbETMax_3_C DFC_CtlMsk.DFC_ETClbETMax_4_C DFC_CtlMsk.DFC_ETClbETMax_5_C DFC_CtlMsk.DFC_ETClbETMin_0_C DFC_CtlMsk.DFC_ETClbETMin_1_C DFC_CtlMsk.DFC_ETClbETMin_2_C DFC_CtlMsk.DFC_ETClbETMin_3_C DFC_CtlMsk.DFC_ETClbETMin_4_C DFC_CtlMsk.DFC_ETClbETMin_5_C DFC_CtlMsk.DFC_IVDiaBnkShCirBSH_0_C DFC_CtlMsk.DFC_IVDiaBnkShCirBSH_1_C DFC_CtlMsk.DFC_IVDiaBnkShCirChSwt_0_C DFC_CtlMsk.DFC_IVDiaBnkShCirChSwt_1_C DFC_CtlMsk.DFC_IVDiaBnkShCirHSBatt_0_C DFC_CtlMsk.DFC_IVDiaBnkShCirHSBatt_1_C DFC_CtlMsk.DFC_IVDiaBnkShCirHiRstnc_0_C DFC_CtlMsk.DFC_IVDiaBnkShCirHiRstnc_1_C DFC_CtlMsk.DFC_IVDiaBnkShCirLSHSGnd_0_C DFC_CtlMsk.DFC_IVDiaBnkShCirLSHSGnd_1_C DFC_CtlMsk.DFC_IVDiaBnkShCirTransfer_0_C DFC_CtlMsk.DFC_IVDiaBnkShCirTransfer_1_C DFC_CtlMsk.DFC_IVDiaCylNoCls_0_C DFC_CtlMsk.DFC_IVDiaCylNoCls_1_C DFC_CtlMsk.DFC_IVDiaCylNoCls_2_C DFC_CtlMsk.DFC_IVDiaCylNoCls_3_C DFC_CtlMsk.DFC_IVDiaCylNoCls_4_C DFC_CtlMsk.DFC_IVDiaCylNoCls_5_C DFC_CtlMsk.DFC_IVDiaCylNoLd_0_C DFC_CtlMsk.DFC_IVDiaCylNoLd_1_C DFC_CtlMsk.DFC_IVDiaCylNoLd_2_C DFC_CtlMsk.DFC_IVDiaCylNoLd_3_C DFC_CtlMsk.DFC_IVDiaCylNoLd_4_C DFC_CtlMsk.DFC_IVDiaCylNoLd_5_C DFC_CtlMsk.DFC_IVDiaCylShCirHiRstnc_0_C DFC_CtlMsk.DFC_IVDiaCylShCirHiRstnc_1_C DFC_CtlMsk.DFC_IVDiaCylShCirHiRstnc_2_C DFC_CtlMsk.DFC_IVDiaCylShCirHiRstnc_3_C DFC_CtlMsk.DFC_IVDiaCylShCirHiRstnc_4_C DFC_CtlMsk.DFC_IVDiaCylShCirHiRstnc_5_C DFC_CtlMsk.DFC_IVDiaCylShCirLSBatt_0_C DFC_CtlMsk.DFC_IVDiaCylShCirLSBatt_1_C DFC_CtlMsk.DFC_IVDiaCylShCirLSBatt_2_C DFC_CtlMsk.DFC_IVDiaCylShCirLSBatt_3_C DFC_CtlMsk.DFC_IVDiaCylShCirLSBatt_4_C DFC_CtlMsk.DFC_IVDiaCylShCirLSBatt_5_C DFC_CtlMsk.DFC_IVDiaCylShCirLSHS_0_C DFC_CtlMsk.DFC_IVDiaCylShCirLSHS_1_C DFC_CtlMsk.DFC_IVDiaCylShCirLSHS_2_C DFC_CtlMsk.DFC_IVDiaCylShCirLSHS_3_C DFC_CtlMsk.DFC_IVDiaCylShCirLSHS_4_C DFC_CtlMsk.DFC_IVDiaCylShCirLSHS_5_C DFC_CtlMsk.DFC_IVDiaCylShCirLsLs_0_C DFC_CtlMsk.DFC_IVDiaCylShCirLsLs_1_C DFC_CtlMsk.DFC_IVDiaCylShCirLsLs_2_C DFC_CtlMsk.DFC_IVDiaCylShCirLsLs_3_C DFC_CtlMsk.DFC_IVDiaCylShCirLsLs_4_C DFC_CtlMsk.DFC_IVDiaCylShCirLsLs_5_C DFC_CtlMsk.DFC_IVDiaSPICfg_C DFC_CtlMsk.DFC_IVDiaSPIColl_C DFC_CtlMsk.DFC_IVDiaSPICtrl_C DFC_CtlMsk.DFC_IVDiaSPIRam_C DFC_CtlMsk.DFC_IVDiaSPITrans_C DFC_CtlMsk.DFC_LSUCmpChk_0_C DFC_CtlMsk.DFC_LSUCmpChk_1_C DFC_CtlMsk.DFC_LSUCmpChk_2_C DFC_CtlMsk.DFC_LSUCmpChk_3_C DFC_CtlMsk.DFC_LSUCmpChk_4_C DFC_CtlMsk.DFC_LSUCmpChk_5_C DFC_CtlMsk.DFC_LSUDynChk_0_C DFC_CtlMsk.DFC_LSUDynChk_1_C DFC_CtlMsk.DFC_LSUDynChk_2_C DFC_CtlMsk.DFC_LSUDynChk_3_C DFC_CtlMsk.DFC_LSUO2ClbMax_0_C DFC_CtlMsk.DFC_LSUO2ClbMax_1_C DFC_CtlMsk.DFC_LSUO2ClbMax_2_C DFC_CtlMsk.DFC_LSUO2ClbMax_3_C DFC_CtlMsk.DFC_LSUO2ClbMin_0_C DFC_CtlMsk.DFC_LSUO2ClbMin_1_C DFC_CtlMsk.DFC_LSUO2ClbMin_2_C DFC_CtlMsk.DFC_LSUO2ClbMin_3_C DFC_CtlMsk.DFC_LSUO2PlausMax_0_C DFC_CtlMsk.DFC_LSUO2PlausMax_1_C DFC_CtlMsk.DFC_LSUO2PlausMax_2_C DFC_CtlMsk.DFC_LSUO2PlausMax_3_C DFC_CtlMsk.DFC_LSUO2PlausMin_0_C DFC_CtlMsk.DFC_LSUO2PlausMin_1_C DFC_CtlMsk.DFC_LSUO2PlausMin_2_C DFC_CtlMsk.DFC_LSUO2PlausMin_3_C DFC_CtlMsk.DFC_LSURiClbMax_0_C DFC_CtlMsk.DFC_LSURiClbMax_1_C DFC_CtlMsk.DFC_LSURiClbMax_2_C DFC_CtlMsk.DFC_LSURiClbMax_3_C DFC_CtlMsk.DFC_LSURiClbMin_0_C DFC_CtlMsk.DFC_LSURiClbMin_1_C DFC_CtlMsk.DFC_LSURiClbMin_2_C DFC_CtlMsk.DFC_LSURiClbMin_3_C DFC_CtlMsk.DFC_LSUWireIPSig_0_C DFC_CtlMsk.DFC_LSUWireIPSig_1_C DFC_CtlMsk.DFC_LSUWireIPSig_2_C DFC_CtlMsk.DFC_LSUWireIPSig_3_C DFC_CtlMsk.DFC_AFSDrftIdlAdjVal_C DFC_CtlMsk.DFC_AFSDrftLdAdjVal_C DFC_CtlMsk.DFC_AdcI_ADC0_Cal_C DFC_CtlMsk.DFC_AdcI_ADC0_Conv_C DFC_CtlMsk.DFC_CmbChbMisfireMax_0_C DFC_CtlMsk.DFC_CmbChbMisfireMax_1_C DFC_CtlMsk.DFC_CmbChbMisfireMax_2_C DFC_CtlMsk.DFC_CmbChbMisfireMax_3_C DFC_CtlMsk.DFC_CmbChbMisfireMax_4_C DFC_CtlMsk.DFC_CmbChbMisfireMax_5_C DFC_CtlMsk.DFC_CmbChbMisfireMul_C DFC_CtlMsk.DFC_INJVLVBUSY_C DFC_CtlMsk.DFC_IVAdjIVA_0_C DFC_CtlMsk.DFC_IVAdjIVA_1_C DFC_CtlMsk.DFC_IVAdjIVA_2_C DFC_CtlMsk.DFC_IVAdjIVA_3_C DFC_CtlMsk.DFC_IVAdjIVA_4_C DFC_CtlMsk.DFC_IVAdjIVA_5_C DFC_CtlMsk.DFC_InjCtlAdjQntEEPCS_C DFC_CtlMsk.DFC_InjCtlDriftEEPCS_C DFC_CtlMsk.DFC_MRlyErlyOpng_C DFC_CtlMsk.DFC_MRlyStk_C DFC_CtlMsk.DFC_SensFrzPPFltUs_C DFC_CtlMsk.DFC_T15Sig_C DFC_CtlMsk.DFC_AirCtlRmpTOut_C DFC_CtlMsk.DFC_CEngDsTDynTst_C DFC_CtlMsk.DFC_EGRVlvJamVlvClsd_C DFC_CtlMsk.DFC_EGRVlvJamVlvOpn_C DFC_CtlMsk.DFC_EGRVlvLgTDrft_C DFC_CtlMsk.DFC_EGRVlvOfsLrnJamVlv_C DFC_CtlMsk.DFC_EGRVlvShTDrft_C DFC_CtlMsk.DFC_EGTRgnOilDilMax_C DFC_CtlMsk.DFC_EngICO_C DFC_CtlMsk.DFC_EpmCaSI1ErrSig_C DFC_CtlMsk.DFC_EpmCaSI1NoSig_C DFC_CtlMsk.DFC_EpmCaSI1OfsErr_C DFC_CtlMsk.DFC_EpmCrSErrSig_C DFC_CtlMsk.DFC_EpmCrSNoSig_C DFC_CtlMsk.DFC_MoCADCCmp_C DFC_CtlMsk.DFC_MoCADCTst_C DFC_CtlMsk.DFC_MoCADCVltgRatio_C DFC_CtlMsk.DFC_MoCSOPLoLi_C DFC_CtlMsk.DFC_MoCSOPMM_C DFC_CtlMsk.DFC_MoCSOPTimeOut_C DFC_CtlMsk.DFC_MoCSOPUpLi_C DFC_CtlMsk.DFC_MoFAPP_C DFC_CtlMsk.DFC_MoFESpd_C DFC_CtlMsk.DFC_MoFInjDatPhi_C DFC_CtlMsk.DFC_MoFInjDatQnt_C DFC_CtlMsk.DFC_MoFInjQnt_C DFC_CtlMsk.DFC_MoFOvR_C DFC_CtlMsk.DFC_MoFQntCor_C DFC_CtlMsk.DFC_MoFTrqCmp_C DFC_CtlMsk.DFC_NplTOxiCatUs_C DFC_CtlMsk.DFC_PhyModNonMonMapNpl_C DFC_CtlMsk.DFC_RailPOfsTstMax_C DFC_CtlMsk.DFC_RailPOfsTstMin_C DFC_CtlMsk.DFC_SWReset_0_C DFC_CtlMsk.DFC_SWReset_1_C DFC_CtlMsk.DFC_SWReset_2_C DFC_CtlMsk.DFC_VSwVlvJamVlv_C DFC_CtlMsk.DFC_VSwVlvLgTDrft_C DFC_CtlMsk.DFC_VSwVlvOfsLrnJamVlv_C DFC_CtlMsk.DFC_VSwVlvShTDrft_C /end DEF_CHARACTERISTIC
/end FUNCTION
/begin COMPU_METHOD DFES_OneToOne "" RAT_FUNC "%6.2" "-" COEFFS 0 1 0 0 0 1 /end COMPU_METHOD
/begin RECORD_LAYOUT Val_Wu16 FNC_VALUES 1 UWORD COLUMN_DIR DIRECT /end RECORD_LAYOUT
/end MODULE
/end PROJECT
