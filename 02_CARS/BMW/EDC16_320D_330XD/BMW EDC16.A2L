ASAP2_VERSION 1 3
/begin PROJECT P383 "BMW DDE6.3 8-Zylinder V9E.3 11.10.2004 CAN12H"
/begin HEADER "" VERSION "V9E.3_8Z_CAN12H" PROJECT_NO P383 /end HEADER
/begin MODULE DIM ""
/begin MOD_COMMON "" BYTE_ORDER MSB_FIRST ALIGNMENT_BYTE 1 ALIGNMENT_WORD 2 ALIGNMENT_LONG 4 ALIGNMENT_FLOAT32_IEEE 4 /end MOD_COMMON
/begin CHARACTERISTIC PFlt_aVehFltAshCorMax_C "maximal zulässiger Wert Fahrzeugbeschleunigung" VALUE 0xF2A4C Kw_Ws16 10.00000 Acc 0.00 10.00000 FORMAT "%8.5" EXTENDED_LIMITS -32.76800 32.76700 /end CHARACTERISTIC
/begin CHARACTERISTIC PFlt_aVehFltAshCorMin_C "minimal zulässiger Wert Fahrzeugbeschleunigung" VALUE 0xF2A4E Kw_Ws16 20.00000 Acc -10.00000 10.00000 FORMAT "%8.5" EXTENDED_LIMITS -32.76800 32.76700 /end CHARACTERISTIC
/begin CHARACTERISTIC PFlt_t1DT1Pres_C "Totzeit für Druckdifferenz DT1 filter" VALUE 0xF3A34 Kw_Wu32 4294.9673 TimeDelay_s 0.0000010000000 4294.9673 FORMAT "%9.4" /end CHARACTERISTIC
/begin CHARACTERISTIC PFlt_kdDT1Pres_C "kd für Druckdifferenz DT1 Filter" VALUE 0xF3A38 Kw_Ws32 32767.9999847 Kd 0.00 32767.9999847 FORMAT "%13.7" EXTENDED_LIMITS -32768.0000000 32767.9999847 /end CHARACTERISTIC
/begin CHARACTERISTIC PFlt_t1DT1Sim_C "Totzeit für q_inj DT1 Filter" VALUE 0xF3A3C Kw_Wu32 4294.9673 TimeDelay_s 0.0000010000000 4294.9673 FORMAT "%9.4" /end CHARACTERISTIC
/begin CHARACTERISTIC PFlt_kdDT1Sim_C "kd für q_inj DT1 Filter" VALUE 0xF3A40 Kw_Ws32 32767.9999847 Kd 0.00 32767.9999847 FORMAT "%13.7" EXTENDED_LIMITS -32768.0000000 32767.9999847 /end CHARACTERISTIC
/begin CHARACTERISTIC PFlt_ctAshCorRgnMax_C "Counteranzahl für Maximumzähler der AshCor Regeneration" VALUE 0xF2A50 Kw_Wu16 65535.00 OneToOne 0.00 65535.00 FORMAT "%8.2" /end CHARACTERISTIC
/begin CHARACTERISTIC PFlt_ctAshCorRgn_C "Counterzahl für gültige AshCor Regeneration" VALUE 0xF2A52 Kw_Wu16 65535.00 OneToOne 0.00 65535.00 FORMAT "%8.2" /end CHARACTERISTIC
/begin CHARACTERISTIC PFlt_dmNOxEngBas_MAP "Emissionskennfeld NOx-Massenstrom" MAP 0xF3A44 Kf_Xs16_Ys16_Ws16 100.0000 dmSoot_mg_p_s 0.00 100.0000 FORMAT "%8.4" EXTENDED_LIMITS -327.6800 327.6700
 /begin AXIS_DESCR STD_AXIS Eng_nAvrg EngN 8 40.00000 6000.000 FORMAT "%8.3" EXTENDED_LIMITS -32768.00 32767.00 DEPOSIT ABSOLUTE /end AXIS_DESCR
 /begin AXIS_DESCR STD_AXIS InjCtl_qSetUnBal InjMassCyc 8 0.00 327.6700 FORMAT "%8.4" EXTENDED_LIMITS -327.6800 327.6700 DEPOSIT ABSOLUTE /end AXIS_DESCR
/end CHARACTERISTIC
/begin CHARACTERISTIC PFlt_dmNOxEngEGROff_MAP "Emissionskennfeld NOx-Masenstrom bei abgeschalteter und geschlossener Abgasrückführung" MAP 0xF3AE8 Kf_Xs16_Ys16_Ws16 100.0000 dmSoot_mg_p_s 0.00 100.0000 FORMAT "%8.4" EXTENDED_LIMITS -327.6800 327.6700
 /begin AXIS_DESCR STD_AXIS Eng_nAvrg EngN 8 40.00000 6000.000 FORMAT "%8.3" EXTENDED_LIMITS -32768.00 32767.00 DEPOSIT ABSOLUTE /end AXIS_DESCR
 /begin AXIS_DESCR STD_AXIS InjCtl_qSetUnBal InjMassCyc 8 0.00 327.6700 FORMAT "%8.4" EXTENDED_LIMITS -327.6800 327.6700 DEPOSIT ABSOLUTE /end AXIS_DESCR
/end CHARACTERISTIC
/begin CHARACTERISTIC PFlt_dmSotSimBas_MAP "statische Partikelemission f(q,n)" MAP 0xF3B8C Kf_Xs16_Ys16_Ws16 100.0000 dmSoot_mg_p_s 0.00 100.0000 FORMAT "%8.4" EXTENDED_LIMITS -327.6800 327.6700
 /begin AXIS_DESCR STD_AXIS Eng_nAvrg EngN 9 40.00000 6000.000 FORMAT "%8.3" EXTENDED_LIMITS -32768.00 32767.00 DEPOSIT ABSOLUTE /end AXIS_DESCR
 /begin AXIS_DESCR STD_AXIS InjCtl_qSetUnBal InjMassCyc 8 0.00 327.6700 FORMAT "%8.4" EXTENDED_LIMITS -327.6800 327.6700 DEPOSIT ABSOLUTE /end AXIS_DESCR
/end CHARACTERISTIC
/begin CHARACTERISTIC PFlt_dmSotSimDyn_CUR "dynamischer Anteil der Partikelemission = f(dq/dt)" CURVE 0xF3C42 Kl_Xs16_Ws16 100.0000 dmSoot_mg_p_s 0.00 100.0000 FORMAT "%8.4" EXTENDED_LIMITS -327.6800 327.6700
 /begin AXIS_DESCR STD_AXIS PFlt_dqSetUnBal_mp InjMassPerSec_20ms 8 -16384.00 16383.50 FORMAT "%8.2" DEPOSIT ABSOLUTE /end AXIS_DESCR
/end CHARACTERISTIC
/begin CHARACTERISTIC PFlt_dmSotSimEGRoff_MAP "Emissionsgrundkennfeld Partikelmassenstrom stationär bei abgeschalteter Abgasrückführung" MAP 0xF3C64 Kf_Xs16_Ys16_Ws16 100.0000 dmSoot_mg_p_s 0.00 100.0000 FORMAT "%8.4" EXTENDED_LIMITS -327.6800 327.6700
 /begin AXIS_DESCR STD_AXIS Eng_nAvrg EngN 8 40.00000 6000.000 FORMAT "%8.3" EXTENDED_LIMITS -32768.00 32767.00 DEPOSIT ABSOLUTE /end AXIS_DESCR
 /begin AXIS_DESCR STD_AXIS InjCtl_qSetUnBal InjMassCyc 8 0.00 327.6700 FORMAT "%8.4" EXTENDED_LIMITS -327.6800 327.6700 DEPOSIT ABSOLUTE /end AXIS_DESCR
/end CHARACTERISTIC
/begin CHARACTERISTIC PFlt_dmSotSimInit_C "Steigung für init der simulierten Partikelmasse" VALUE 0xF5244 Kw_Wu32 655359.999847 RmpMSoot 0.00 655359.999847 FORMAT "%13.6" /end CHARACTERISTIC
/begin CHARACTERISTIC PFlt_dmSotSimLmbd_MAP "statischer Teil der Partikelmasse als Funktion von n und Lamda" MAP 0xF3D08 Kf_Xs16_Ys16_Ws16 100.0000 dmSoot_mg_p_s 0.00 100.0000 FORMAT "%8.4" EXTENDED_LIMITS -327.6800 327.6700
 /begin AXIS_DESCR STD_AXIS PFlt_rLmbdDynMapIn_mp lambda 8 -32.00000 30.00000 FORMAT "%8.5" EXTENDED_LIMITS -32.76800 32.76700 DEPOSIT ABSOLUTE /end AXIS_DESCR
 /begin AXIS_DESCR STD_AXIS PFlt_rLmbdMapIn_mp lambda 8 0.00 30.00000 FORMAT "%8.5" EXTENDED_LIMITS -32.76800 32.76700 DEPOSIT ABSOLUTE /end AXIS_DESCR
/end CHARACTERISTIC
/begin CHARACTERISTIC PFlt_dmSotSimRgnBas_CUR "Basiswert für regenerierte Partikelmasse = f(m_Soot)" CURVE 0xF3DAC Kl_Xs16_Ws16 100.0000 dmSoot_mg_p_s 0.00 100.0000 FORMAT "%8.4" EXTENDED_LIMITS -327.6800 327.6700
 /begin AXIS_DESCR STD_AXIS PFlt_mSotSimIn_mp mSoot_g 8 0.00 300.0000 FORMAT "%8.4" EXTENDED_LIMITS -327.6800 327.6700 DEPOSIT ABSOLUTE /end AXIS_DESCR
/end CHARACTERISTIC
/begin CHARACTERISTIC PFlt_dpDiffMax_C "Schwelle für Druckdifferenzänderung über der auf Simulation geschaltet wird" VALUE 0xF3DCE Kw_Ws16 65535.00 Pres_hPa -32768.00 32767.00 FORMAT "%8.2" /end CHARACTERISTIC
/begin CHARACTERISTIC PFlt_dvolB1_Vector "Konfigurationslabel für Bypass bank 1" VALUE 0xC39A4 Kw_Wu8 255.0 OneToOne 0.00 255.0 FORMAT "%5.1" /end CHARACTERISTIC
/begin CHARACTERISTIC PFlt_dvolB1_Channel "Konfigurationslabel für Bypass bank 1" VALUE 0xC39A5 Kw_Wu8 255.0 OneToOne 0.00 255.0 FORMAT "%5.1" /end CHARACTERISTIC
/begin CHARACTERISTIC PFlt_dvolB2_Vector "Konfigurationslabel für Bypass bank 2" VALUE 0xC39A6 Kw_Wu8 255.0 OneToOne 0.00 255.0 FORMAT "%5.1" /end CHARACTERISTIC
/begin CHARACTERISTIC PFlt_dvolB2_Channel "Konfigurationslabel für Bypass bank 2" VALUE 0xC39A7 Kw_Wu8 255.0 OneToOne 0.00 255.0 FORMAT "%5.1" /end CHARACTERISTIC
/begin CHARACTERISTIC PFlt_dvolMeasMin_C "Schwelle für Abgasstrom unter der auf Simulation geschaltet wird" VALUE 0xF3DD0 Kw_Ws16 3000.000 CubMtrPerHr 0.00 3000.000 FORMAT "%8.3" EXTENDED_LIMITS -3276.800 3276.700 /end CHARACTERISTIC
/begin CHARACTERISTIC PFlt_dvolPrivCanSubs_C "Ersatzwert bei ungültigem Abgasvolumenstrom" VALUE 0xF3A2A Kw_Ws16 3000.000 CubMtrPerHr 0.00 3000.000 FORMAT "%8.3" EXTENDED_LIMITS -3276.800 3276.700 /end CHARACTERISTIC
/begin CHARACTERISTIC PFlt_facAshCorOld_C "Faktor für den alten Aschekorrekturwert" VALUE 0xF2A54 Kw_Ws16 65535.00 OneToOne -32768.00 32767.00 FORMAT "%8.2" /end CHARACTERISTIC
/begin CHARACTERISTIC PFlt_facAshOil_C "Faktor für Aschenöl" VALUE 0xF2A56 Kw_Ws16 65535.00 OneToOne -32768.00 32767.00 FORMAT "%8.2" /end CHARACTERISTIC
/begin CHARACTERISTIC PFlt_facAshVolCor_MAP "Aschevolumen-abhängiger Korrekturfaktor des Differenzdrukkes" MAP 0xF3DD2 Kf_Xs16_Ys16_Ws16 1500.000 Fact4 0.00 1500.000 FORMAT "%8.3" EXTENDED_LIMITS -1638.400 1638.350
 /begin AXIS_DESCR STD_AXIS PFlt_dvol_mp CubMtrPerHr 16 0.00 3000.000 FORMAT "%8.3" EXTENDED_LIMITS -3276.800 3276.700 DEPOSIT ABSOLUTE /end AXIS_DESCR
 /begin AXIS_DESCR STD_AXIS PFlt_volAsh_mp Vol 16 0.01000000 100.0000 FORMAT "%8.4" EXTENDED_LIMITS -327.6800 327.6700 DEPOSIT ABSOLUTE /end AXIS_DESCR
/end CHARACTERISTIC
/begin CHARACTERISTIC PFlt_facCnvCatNO2_CUR "Faktor Temperaturabhängigkeit der Konvertierung von O zu NO2 des Oxi-Katalysators" CURVE 0xF4016 Kl_Xs16_Ws16 1.000000 Fact 0.00 1.000000 FORMAT "%8.6" EXTENDED_LIMITS -4.000000 3.999878
 /begin AXIS_DESCR STD_AXIS PFlt_tOxiPreCrvIn_mp Temp_Cels 8 -50.1400 899.8600 FORMAT "%8.4" EXTENDED_LIMITS -3549.940 3003.560 DEPOSIT ABSOLUTE /end AXIS_DESCR
/end CHARACTERISTIC
/begin CHARACTERISTIC PFlt_facDvolNO2_CUR "Korrekturfaktor der NOx/ NO2-Umwandlung in Abhängigkeit der Verweildauer des Abgases im Oxidationskatalysator" CURVE 0xF4038 Kl_Xs16_Ws16 1.000000 Fact 0.00 1.000000 FORMAT "%8.6" EXTENDED_LIMITS -4.000000 3.999878
 /begin AXIS_DESCR STD_AXIS PFlt_dvol_mp CubMtrPerHr 8 0.00 3000.000 FORMAT "%8.3" EXTENDED_LIMITS -3276.800 3276.700 DEPOSIT ABSOLUTE /end AXIS_DESCR
/end CHARACTERISTIC
/begin CHARACTERISTIC PFlt_facDynVisc_CUR "Kennlinie zur Berücksichtigung der dynamischen Viskosität" CURVE 0xF405A Kl_Xs16_Ws16 1.000000 Fact 0.00 1.000000 FORMAT "%8.6" EXTENDED_LIMITS -4.000000 3.999878
 /begin AXIS_DESCR STD_AXIS PFlt_tSurfCrvIn_mp Temp_Cels 8 -50.1400 899.8600 FORMAT "%8.4" EXTENDED_LIMITS -3549.940 3003.560 DEPOSIT ABSOLUTE /end AXIS_DESCR
/end CHARACTERISTIC
/begin CHARACTERISTIC PFlt_facEGRNOx_CUR "Korrekturfaktor der stationären simulierten NOx-Emission in Abhängigkeit der AGR-Korrekturrate" CURVE 0xF407C Kl_Xs16_Ws16 5.000000 Fact3 0.00 5.000000 FORMAT "%8.6" EXTENDED_LIMITS -8.000000 7.999756
 /begin AXIS_DESCR STD_AXIS PFlt_facEGRCorRat_mp FactLow 8 0.00 31.00000 FORMAT "%8.5" EXTENDED_LIMITS -32.00000 31.99902 DEPOSIT ABSOLUTE /end AXIS_DESCR
/end CHARACTERISTIC
/begin CHARACTERISTIC PFlt_facEGRSotSimBas_CUR "Korrekturfaktor der stationären simulierten Rußemission in Abhängigkeit der AGR-Korrekturrate" CURVE 0xF409E Kl_Xs16_Ws16 5.000000 Fact3 0.00 5.000000 FORMAT "%8.6" EXTENDED_LIMITS -8.000000 7.999756
 /begin AXIS_DESCR STD_AXIS PFlt_facEGRCorRat_mp FactLow 8 0.00 31.00000 FORMAT "%8.5" EXTENDED_LIMITS -32.00000 31.99902 DEPOSIT ABSOLUTE /end AXIS_DESCR
/end CHARACTERISTIC
/begin CHARACTERISTIC PFlt_facFlHighTrm_C "Upper border for adjustment size" VALUE 0xF2C84 Kw_Ws16 7.999878 Fact -4.000000 3.999878 FORMAT "%8.6" /end CHARACTERISTIC
/begin CHARACTERISTIC PFlt_facFlLowTrm_C "Lower border for adjustment size" VALUE 0xF2C86 Kw_Ws16 7.999878 Fact -4.000000 3.999878 FORMAT "%8.6" /end CHARACTERISTIC
/begin CHARACTERISTIC PFlt_facFlTotCor_C "Gesamtmenge Kraftstoffkorrekturfaktor" VALUE 0xF2A58 Kw_Ws16 1.000000 Fact 0.00 1.000000 FORMAT "%8.6" EXTENDED_LIMITS -4.000000 3.999878 /end CHARACTERISTIC
/begin CHARACTERISTIC PFlt_faclAshCor_C "Aschenkorrekturfaktor." VALUE 0xF2A5A Kw_Wu16 65535.00 OneToOne 0.00 65535.00 FORMAT "%8.2" /end CHARACTERISTIC
/begin CHARACTERISTIC PFlt_facMflO2SimRgn_CUR "Kennlinie für den Einfluß des Oxygenmassenstromes auf Regeneration" CURVE 0xF40C0 Kl_Xs16_Ws16 1.000000 Fact 0.00 1.000000 FORMAT "%8.6" EXTENDED_LIMITS -4.000000 3.999878
 /begin AXIS_DESCR STD_AXIS PFlt_dmO2AprxCrvIn_mp AirMassPerTime 8 0.00 50.00000 FORMAT "%8.5" EXTENDED_LIMITS -3276.800 3276.700 DEPOSIT ABSOLUTE /end AXIS_DESCR
/end CHARACTERISTIC
/begin CHARACTERISTIC PFlt_facMltCor_CUR "Kennlinie zur Berücksichtigung der Additivaschenkorrektur" CURVE 0xF40E2 Kl_Xs16_Ws16 1.000000 Fact 0.00 1.000000 FORMAT "%8.6" EXTENDED_LIMITS -4.000000 3.999878
 /begin AXIS_DESCR STD_AXIS PFlt_volAsh_mp Vol 8 0.00 100.0000 FORMAT "%8.4" EXTENDED_LIMITS -327.6800 327.6700 DEPOSIT ABSOLUTE /end AXIS_DESCR
/end CHARACTERISTIC
/begin CHARACTERISTIC PFlt_facNO2RgnPrtMax_CUR "" CURVE 0xF2C88 Kl_Xs16_Ws16 7.999878 Fact -4.000000 3.999878 FORMAT "%8.6"
 /begin AXIS_DESCR STD_AXIS PFlt_facNO2RgnTmp_mp Fact 10 0.00 1.000000 FORMAT "%8.6" EXTENDED_LIMITS -4.000000 3.999878 DEPOSIT ABSOLUTE /end AXIS_DESCR
/end CHARACTERISTIC
/begin CHARACTERISTIC PFlt_facNO2Sot_C "stöchiometrisches NO2/Ruß-Verhältnis" VALUE 0xF4104 Kw_Ws16 15.00000 Fact1 0.00 15.00000 FORMAT "%8.5" EXTENDED_LIMITS -256.0000 255.9922 /end CHARACTERISTIC
/begin CHARACTERISTIC PFlt_facPOpOilAsh_MAP "Korrekturfaktor für Ölascheeintrag in den Partikelfilter" MAP 0xF4106 Kf_Xs16_Ys16_Ws16 1.000000 Fact4 0.00 1.000000 FORMAT "%8.6" EXTENDED_LIMITS -1638.400 1638.350
 /begin AXIS_DESCR STD_AXIS Eng_nAvrg EngN 16 40.00000 6000.000 FORMAT "%8.3" EXTENDED_LIMITS -32768.00 32767.00 DEPOSIT ABSOLUTE /end AXIS_DESCR
 /begin AXIS_DESCR STD_AXIS InjCtl_qSetUnBal InjMassCyc 16 0.00 327.6700 FORMAT "%8.4" EXTENDED_LIMITS -327.6800 327.6700 DEPOSIT ABSOLUTE /end AXIS_DESCR
/end CHARACTERISTIC
/begin CHARACTERISTIC PFlt_facSotHighTrm_C "Upper border for adjustment size" VALUE 0xF2CB2 Kw_Ws16 7.999878 Fact -4.000000 3.999878 FORMAT "%8.6" /end CHARACTERISTIC
/begin CHARACTERISTIC PFlt_facSotLowTrm_C "Lower limit for adjustment size" VALUE 0xF2CB4 Kw_Ws16 7.999878 Fact -4.000000 3.999878 FORMAT "%8.6" /end CHARACTERISTIC
/begin CHARACTERISTIC PFlt_facSotSimRgnNO2_CUR "Faktor für Beladungsabhängigkeit des NO2-Effektes" CURVE 0xF434A Kl_Xs16_Ws16 1.000000 Fact 0.00 1.000000 FORMAT "%8.6" EXTENDED_LIMITS -4.000000 3.999878
 /begin AXIS_DESCR STD_AXIS PFlt_mSotCrvIn_mp mSoot_g 8 0.00 300.0000 FORMAT "%8.4" EXTENDED_LIMITS -327.6800 327.6700 DEPOSIT ABSOLUTE /end AXIS_DESCR
/end CHARACTERISTIC
/begin CHARACTERISTIC PFlt_facSumAdjMax_C "Maximale Ölaschenladefaktorsumme, die bei der Diagnose gesetzt werden kann" VALUE 0xF436C Kw_Wu32 214748364.000 Fact4 0.00 214748364.000 FORMAT "%13.3" EXTENDED_LIMITS 0.00 214748364.750 /end CHARACTERISTIC
/begin CHARACTERISTIC PFlt_facSumHighTrm_C "Upper border for adjustment size max. Run performance" VALUE 0xF2CB6 Kw_Ws16 7.999878 Fact -4.000000 3.999878 FORMAT "%8.6" /end CHARACTERISTIC
/begin CHARACTERISTIC PFlt_facSumLowTrm_C "Lower limit for adjustment size max. Run performance" VALUE 0xF2CB8 Kw_Ws16 7.999878 Fact -4.000000 3.999878 FORMAT "%8.6" /end CHARACTERISTIC
/begin CHARACTERISTIC PFlt_facTempNO2_CUR "Faktor für Temperaturabhängigkeit NO2-Effekt" CURVE 0xF4370 Kl_Xs16_Ws16 1.000000 Fact 0.00 1.000000 FORMAT "%8.6" EXTENDED_LIMITS -4.000000 3.999878
 /begin AXIS_DESCR STD_AXIS PFlt_tSurfCrvIn_mp Temp_Cels 8 -50.1400 899.8600 FORMAT "%8.4" EXTENDED_LIMITS -3549.940 3003.560 DEPOSIT ABSOLUTE /end AXIS_DESCR
/end CHARACTERISTIC
/begin CHARACTERISTIC PFlt_facTempSimRgn_CUR "Einfluß der Temperatur auf regenerierte Partikelmasse" CURVE 0xF4392 Kl_Xs16_Ws16 1.000000 Fact 0.00 1.000000 FORMAT "%8.6" EXTENDED_LIMITS -4.000000 3.999878
 /begin AXIS_DESCR STD_AXIS PFlt_tSurfCrvIn_mp Temp_Cels 8 -50.140 899.860 FORMAT "%8.3" EXTENDED_LIMITS -3549.940 3003.560 DEPOSIT ABSOLUTE /end AXIS_DESCR
/end CHARACTERISTIC
/begin CHARACTERISTIC PFlt_IKiFac_C "" VALUE 0xF5248 Kw_Wu32 999999.999767 Ki 0.00 999999.999767 FORMAT "%13.6" /end CHARACTERISTIC
/begin CHARACTERISTIC PFlt_IKiPosFac_C "" VALUE 0xF524C Kw_Wu32 999999.999767 Ki 0.00 999999.999767 FORMAT "%13.6" /end CHARACTERISTIC
/begin CHARACTERISTIC PFlt_IKiNegFac_C "" VALUE 0xF5250 Kw_Wu32 999999.999767 Ki 0.00 999999.999767 FORMAT "%13.6" /end CHARACTERISTIC
/begin CHARACTERISTIC PFlt_facWinPos_C "" VALUE 0xF5254 Kw_Ws16 1.000000 Fact 0.00 1.000000 FORMAT "%8.6" EXTENDED_LIMITS -4.000000 3.999878 /end CHARACTERISTIC
/begin CHARACTERISTIC PFlt_facWinNeg_C "" VALUE 0xF5256 Kw_Ws16 1.000000 Fact 0.00 1.000000 FORMAT "%8.6" EXTENDED_LIMITS -4.000000 3.999878 /end CHARACTERISTIC
/begin CHARACTERISTIC PFlt_kiMSotRes_C "Integrationsfaktor für Abschätzung der Restrußmasse im Partikelfilter nach erfolgreicher Regeneration" VALUE 0xF43B4 Kw_Wu16 80.01832 Ki_mSoot 0.00 80.01832 FORMAT "%8.5" /end CHARACTERISTIC
/begin CHARACTERISTIC PFlt_lAshCorMax_C "Maximaler Kilometerstand" VALUE 0xF2A5C Kw_Ws16 32767.00 LengthKm 0.00 32767.00 FORMAT "%8.2" EXTENDED_LIMITS -32768.00 32767.00 /end CHARACTERISTIC
/begin CHARACTERISTIC PFlt_lAshCorNextDef_C "Lesen des Wertes aus dem Eeprom nicht erfolgreich; diesen Wert verwenden" VALUE 0xF2A60 Kw_Wu32 4294967295.00 LengthKm 0.00 4294967295.00 FORMAT "%13.2" /end CHARACTERISTIC
/begin CHARACTERISTIC PFlt_lAshCorNplAbsRel_C "Kilometerzahl, welche bei erkanntem relativen und absoluten Fehler addiert wird" VALUE 0xF2A64 Kw_Ws16 32767.00 LengthKm 0.00 32767.00 FORMAT "%8.2" EXTENDED_LIMITS -32768.00 32767.00 /end CHARACTERISTIC
/begin CHARACTERISTIC PFlt_lAshCorNplAbs_C "plausibler Wert für den absoluten Kilometerstand" VALUE 0xF2A66 Kw_Ws16 32767.00 LengthKm 0.00 32767.00 FORMAT "%8.2" EXTENDED_LIMITS -32768.00 32767.00 /end CHARACTERISTIC
/begin CHARACTERISTIC PFlt_lAshCorNplRel_C "plausibler Wert für den relativen Kilometerstand" VALUE 0xF2A68 Kw_Ws16 32767.00 LengthKm 0.00 32767.00 FORMAT "%8.2" EXTENDED_LIMITS -32768.00 32767.00 /end CHARACTERISTIC
/begin CHARACTERISTIC PFlt_lAshCorRegIntr_C "Regenerationsunterbrechung Kilometerstand" VALUE 0xF2A6A Kw_Ws16 32767.00 LengthKm 0.00 32767.00 FORMAT "%8.2" EXTENDED_LIMITS -32768.00 32767.00 /end CHARACTERISTIC
/begin CHARACTERISTIC PFlt_lMinSnceRgn_C "Minimaler Abstand seit letzter Regeneration." VALUE 0xF2A6C Kw_Wu32 2147483647.00 Length 0.00 2147483647.00 FORMAT "%13.2" EXTENDED_LIMITS 0.00 4294967295.00 /end CHARACTERISTIC
/begin CHARACTERISTIC PFlt_lSnceRgnIntr_CA "Gefahrene Abstandsschwelle für sperren Regenerationsunterbrechung" VAL_BLK 0xF2CBC Kwb_Wu32 4294967295.00 Length 0.00 4294967295.00 FORMAT "%13.2" NUMBER 11 /end CHARACTERISTIC
/begin CHARACTERISTIC PFlt_lSumMaxDef_C "gefahrene Strecke Schwelle für Regeneration im Fehlerfall" VALUE 0xF2CE8 Kw_Wu32 4294967295.00 Length 0.00 4294967295.00 FORMAT "%13.2" /end CHARACTERISTIC
/begin CHARACTERISTIC PFlt_lSumMaxHCCond_MAP "Lastkollektivkennfeld für HC Conditionierintervall Berechneung" MAP 0xF2B78 Kf_Xs16_Ys16_Ws16 4194176. lSnceRgnRes 0.00 4194176. FORMAT "%8.0" EXTENDED_LIMITS -4194304. 4194176.
 /begin AXIS_DESCR STD_AXIS PFlt_vAvrgSnceHCCond_mp Vel_kmh 10 0.00 1179.612 FORMAT "%8.3" EXTENDED_LIMITS -1179.648 1179.612 DEPOSIT ABSOLUTE /end AXIS_DESCR
 /begin AXIS_DESCR STD_AXIS PFlt_lAvrgSnceHCCond_mp lSnceRgnRes 10 0.00 4194176. FORMAT "%8.0" EXTENDED_LIMITS -4194304. 4194176. DEPOSIT ABSOLUTE /end AXIS_DESCR
/end CHARACTERISTIC
/begin CHARACTERISTIC PFlt_lSumMaxOptHCCond_C "Schwelle für optionale HC conditionierung" VALUE 0xF2C6C Kw_Ws16 4194176. lSnceRgnRes 0.00 4194176. FORMAT "%8.0" EXTENDED_LIMITS -4194304. 4194176. /end CHARACTERISTIC
/begin CHARACTERISTIC PFlt_lSumMax_MAP "map fuer maximale Strecke seit letzter erfolgreicher regeneration" MAP 0xF2CEC Kf_Xs16_Ys16_Ws16 4194176. lSnceRgnRes 0.00 4194176. FORMAT "%8.0" EXTENDED_LIMITS -4194304. 4194176.
 /begin AXIS_DESCR STD_AXIS PFlt_vAvrgSnceRgn_mp Vel_kmh 10 0.00 1179.612 FORMAT "%8.3" EXTENDED_LIMITS -1179.648 1179.612 DEPOSIT ABSOLUTE /end AXIS_DESCR
 /begin AXIS_DESCR STD_AXIS PFlt_lAvrgSnceRgn_mp lSnceRgnRes 10 0.00 4194176. FORMAT "%8.0" EXTENDED_LIMITS -4194304. 4194176. DEPOSIT ABSOLUTE /end AXIS_DESCR
/end CHARACTERISTIC
/begin CHARACTERISTIC PFlt_lSumOptHCCond_C "Minimale Strecke seit letzter HC conditionierung über der wieder optionale HC conditionierung angefordert werden kann" VALUE 0xF2C6E Kw_Ws16 4194176. lSnceRgnRes 0.00 4194176. FORMAT "%8.0" EXTENDED_LIMITS -4194304. 4194176. /end CHARACTERISTIC
/begin CHARACTERISTIC PFlt_lSumSubs_C "Ersatzwert für gefahrene Strecke im Fall eines Eeprom lese Fehlers" VALUE 0xF2DE0 Kw_Wu32 4294967295.00 Length 0.00 4294967295.00 FORMAT "%13.2" /end CHARACTERISTIC
/begin CHARACTERISTIC PFlt_mAshCor_MAP "Map für Ascheabweichung vom Sollwert" MAP 0xF2A70 Kf_Xs16_Ys16_Ws16 400.0000 mSoot_g -100.0000 300.0000 FORMAT "%8.4" EXTENDED_LIMITS -327.6800 327.6700
 /begin AXIS_DESCR STD_AXIS PFlt_dVolFltAshCor_mp CubMtrPerHr 8 0.00 3000.000 FORMAT "%8.3" EXTENDED_LIMITS -3276.800 3276.700 DEPOSIT ABSOLUTE /end AXIS_DESCR
 /begin AXIS_DESCR STD_AXIS PFlt_resFlowFltAshCor_mp Res_hPaHrPerCM 8 0.00 25.00000 FORMAT "%8.5" EXTENDED_LIMITS -32.76800 32.76700 DEPOSIT ABSOLUTE /end AXIS_DESCR
/end CHARACTERISTIC
/begin CHARACTERISTIC PFlt_mAshOil_CUR "Kennlinie zur Umrechnung des verbrauchten Kraftstoffes in Ölaschenmasse" CURVE 0xF43B6 Kl_Xs16_Ws16 300.0000 mSoot_g 0.00 300.0000 FORMAT "%8.4" EXTENDED_LIMITS -327.6800 327.6700
 /begin AXIS_DESCR STD_AXIS PFlt_qFlTotCrvIn_mp Fl_2 8 0.00 330.0000 FORMAT "%8.4" EXTENDED_LIMITS -327680.0 327670.0 DEPOSIT ABSOLUTE /end AXIS_DESCR
/end CHARACTERISTIC
/begin CHARACTERISTIC PFlt_mAshTolcAbs_C "maximal absoluter zulässiger Wert für Aschenmassentoleranz" VALUE 0xF2B14 Kw_Ws16 300.0000 mSoot_g 0.00 300.0000 FORMAT "%8.4" EXTENDED_LIMITS -327.6800 327.6700 /end CHARACTERISTIC
/begin CHARACTERISTIC PFlt_mAshTolcMaxAbs_C "maximal erlaubte absolute Abweichung des neu berechneten Aschewertes" VALUE 0xF2B16 Kw_Ws16 300.0000 mSoot_g 0.00 300.0000 FORMAT "%8.4" EXTENDED_LIMITS -327.6800 327.6700 /end CHARACTERISTIC
/begin CHARACTERISTIC PFlt_mAshTolcMaxRel_C "maximal erlaubte relative Abweichung der neu berechneten Aschemenge" VALUE 0xF2B18 Kw_Ws16 300.0000 mSoot_g 0.00 300.0000 FORMAT "%8.4" EXTENDED_LIMITS -327.6800 327.6700 /end CHARACTERISTIC
/begin CHARACTERISTIC PFlt_mSotAdjMax_C "Maximum value of the particle mass which can be set via diagnosis" VALUE 0xF43D8 Kw_Ws16 300.0000 mSoot_g 0.00 300.0000 FORMAT "%8.4" EXTENDED_LIMITS -327.6800 327.6700 /end CHARACTERISTIC
/begin CHARACTERISTIC PFlt_mSotB1_Vector "Konfigurationslabels für Bypass(Bank1)" VALUE 0xC39A8 Kw_Wu8 255.0 OneToOne 0.00 255.0 FORMAT "%5.1" /end CHARACTERISTIC
/begin CHARACTERISTIC PFlt_mSotB1_Channel "Konfigurationslabels für Bypass(Bank1)" VALUE 0xC39A9 Kw_Wu8 255.0 OneToOne 0.00 255.0 FORMAT "%5.1" /end CHARACTERISTIC
/begin CHARACTERISTIC PFlt_mSotB2_Vector "Konfigurationslabels für Bypass(Bank2)" VALUE 0xC39AA Kw_Wu8 255.0 OneToOne 0.00 255.0 FORMAT "%5.1" /end CHARACTERISTIC
/begin CHARACTERISTIC PFlt_mSotB2_Channel "Konfigurationslabels für Bypass(Bank2)" VALUE 0xC39AB Kw_Wu8 255.0 OneToOne 0.00 255.0 FORMAT "%5.1" /end CHARACTERISTIC
/begin CHARACTERISTIC PFlt_mSotMeas_CUR "Umrechnung Strömungswiderstand Partikelmasse" CURVE 0xF2DE4 Kl_Xs16_Ws16 300.0000 mSoot_g 0.00 300.0000 FORMAT "%8.4" EXTENDED_LIMITS -327.6800 327.6700
 /begin AXIS_DESCR STD_AXIS PFlt_resFlowOfs_mp Res_hPaHrPerCM 8 0.00 25.00000 FORMAT "%8.5" EXTENDED_LIMITS -32.76800 32.76700 DEPOSIT ABSOLUTE /end AXIS_DESCR
/end CHARACTERISTIC
/begin CHARACTERISTIC PFlt_mSotMeas_MAP "Umrechnung Strömungswiderstand Partikelmasse" MAP 0xF43DA Kf_Xs16_Ys16_Ws16 300.0000 mSoot_g 0.00 300.0000 FORMAT "%8.4" EXTENDED_LIMITS -327.6800 327.6700
 /begin AXIS_DESCR STD_AXIS PFlt_resFlowFlt_mp Res_hPaHrPerCM 16 0.00 25.00000 FORMAT "%8.5" EXTENDED_LIMITS -32.76800 32.76700 DEPOSIT ABSOLUTE /end AXIS_DESCR
 /begin AXIS_DESCR STD_AXIS PFlt_dvolMassFltIn_mp CubMtrPerHr 16 0.00 3000.000 FORMAT "%8.3" EXTENDED_LIMITS -3276.800 3276.700 DEPOSIT ABSOLUTE /end AXIS_DESCR
/end CHARACTERISTIC
/begin CHARACTERISTIC PFlt_mSotNewRng1_C "Schwelle Regeneriert -> Regenerationsstate 1" VALUE 0xF2E06 Kw_Ws16 300.0000 mSoot_g 0.00 300.0000 FORMAT "%8.4" EXTENDED_LIMITS -327.6800 327.6700 /end CHARACTERISTIC
/begin CHARACTERISTIC PFlt_mSotResAftRgn_CUR "Restrussmasse im Partikelfilter" CURVE 0xF461E Kl_Xs16_Ws16 300.0000 mSoot_g 0.00 300.0000 FORMAT "%8.4" EXTENDED_LIMITS -327.6800 327.6700
 /begin AXIS_DESCR STD_AXIS PFlt_stEngPOpTmp_mp OneToOne 12 0.00 12.00000 FORMAT "%8.5" EXTENDED_LIMITS -32768.00 32767.00 DEPOSIT ABSOLUTE /end AXIS_DESCR
/end CHARACTERISTIC
/begin CHARACTERISTIC PFlt_mSotResAftRgn_MAP "Restrussmasse im Partikelfilter" MAP 0xF4650 Kf_Xs16_Ys16_Ws16 300.0000 mSoot_g 0.00 300.0000 FORMAT "%8.4" EXTENDED_LIMITS -327.6800 327.6700
 /begin AXIS_DESCR STD_AXIS Eng_nAvrg EngN 16 40.00000 6000.000 FORMAT "%8.3" EXTENDED_LIMITS -32768.00 32767.00 DEPOSIT ABSOLUTE /end AXIS_DESCR
 /begin AXIS_DESCR STD_AXIS InjCtl_qSetUnBal InjMassCyc 16 0.00 327.6700 FORMAT "%8.4" EXTENDED_LIMITS -327.6800 327.6700 DEPOSIT ABSOLUTE /end AXIS_DESCR
/end CHARACTERISTIC
/begin CHARACTERISTIC PFlt_mSotRng1New_C "Schwelle Regenerationsstate 1 -> regeneriert" VALUE 0xF2E08 Kw_Ws16 300.0000 mSoot_g 0.00 300.0000 FORMAT "%8.4" EXTENDED_LIMITS -327.6800 327.6700 /end CHARACTERISTIC
/begin CHARACTERISTIC PFlt_mSotRng1Rng2_C "Schwelle Regenerationsstate 1 -> Regenerationsstate 2" VALUE 0xF2E0A Kw_Ws16 300.0000 mSoot_g 0.00 300.0000 FORMAT "%8.4" EXTENDED_LIMITS -327.6800 327.6700 /end CHARACTERISTIC
/begin CHARACTERISTIC PFlt_mSotRng2Rng1_C "Schwelle Regenerationsstate 2 -> Regenerationsstate 1" VALUE 0xF2E0C Kw_Ws16 300.0000 mSoot_g 0.00 300.0000 FORMAT "%8.4" EXTENDED_LIMITS -327.6800 327.6700 /end CHARACTERISTIC
/begin CHARACTERISTIC PFlt_mSotRng2Rng3_C "Schwelle Regenerationstate 2 -> 3" VALUE 0xF2E0E Kw_Ws16 300.0000 mSoot_g 0.00 300.0000 FORMAT "%8.4" EXTENDED_LIMITS -327.6800 327.6700 /end CHARACTERISTIC
/begin CHARACTERISTIC PFlt_mSotRng3Rng2_C "Schwelle Regenerationsstate 3 -> 2" VALUE 0xF2E10 Kw_Ws16 300.0000 mSoot_g 0.00 300.0000 FORMAT "%8.4" EXTENDED_LIMITS -327.6800 327.6700 /end CHARACTERISTIC
/begin CHARACTERISTIC PFlt_mSotRng3Rng4_C "Schwelle Regeneratiosstate 3 -> 4" VALUE 0xF2E12 Kw_Ws16 300.0000 mSoot_g 0.00 300.0000 FORMAT "%8.4" EXTENDED_LIMITS -327.6800 327.6700 /end CHARACTERISTIC
/begin CHARACTERISTIC PFlt_mSotRng4Rng3_C "Schwelle Regenerationsstate 4 -> 3" VALUE 0xF2E14 Kw_Ws16 300.0000 mSoot_g 0.00 300.0000 FORMAT "%8.4" EXTENDED_LIMITS -327.6800 327.6700 /end CHARACTERISTIC
/begin CHARACTERISTIC PFlt_mSotRng4Rng5_C "Schwelle Regenerationsstate 4 -> 5" VALUE 0xF2E16 Kw_Ws16 300.0000 mSoot_g 0.00 300.0000 FORMAT "%8.4" EXTENDED_LIMITS -327.6800 327.6700 /end CHARACTERISTIC
/begin CHARACTERISTIC PFlt_mSotRng5Rng4_C "Schwelle Regeneratiosstate 5 -> 4" VALUE 0xF2E18 Kw_Ws16 300.0000 mSoot_g 0.00 300.0000 FORMAT "%8.4" EXTENDED_LIMITS -327.6800 327.6700 /end CHARACTERISTIC
/begin CHARACTERISTIC PFlt_mSotSimInit_C "init Wert simulierte Partikelmasse" VALUE 0xF5258 Kw_Ws16 300.0000 mSoot_g 0.00 300.0000 FORMAT "%8.4" EXTENDED_LIMITS -327.6800 327.6700 /end CHARACTERISTIC
/begin CHARACTERISTIC PFlt_mSotSimMax_C "Maximum value for a simulated particle mass" VALUE 0xF4894 Kw_Ws16 300.0000 mSoot_g 0.00 300.0000 FORMAT "%8.4" EXTENDED_LIMITS -327.6800 327.6700 /end CHARACTERISTIC
/begin CHARACTERISTIC PFlt_mSotSubs_C "Ersatzwert für Partikelmasse im Fall von Eeprom lese Fehler" VALUE 0xF4896 Kw_Ws16 300.0000 mSoot_g 0.00 300.0000 FORMAT "%8.4" EXTENDED_LIMITS -327.6800 327.6700 /end CHARACTERISTIC
/begin CHARACTERISTIC PFlt_nAvrgFltAshCorMax_C "maximal zulässiger Wert Drehzahl" VALUE 0xF2B1A Kw_Ws16 6000.000 EngN 0.00 6000.000 FORMAT "%8.3" EXTENDED_LIMITS -32768.00 32767.00 /end CHARACTERISTIC
/begin CHARACTERISTIC PFlt_nAvrgFltAshCorMin_C "minimal zulässiger Wert Drehzahl" VALUE 0xF2B1C Kw_Ws16 6000.000 EngN 0.00 6000.000 FORMAT "%8.3" EXTENDED_LIMITS -32768.00 32767.00 /end CHARACTERISTIC
/begin CHARACTERISTIC PFlt_nAvrgMinMax_CA "Matrix zur Bestimmung der Bereichsgrenzen für die gefilterte mittlere Drehzahl" MAP 0xF34F8 Kf_Xs16_Ys16_Ws16 5960.000 EngN 40.00000 6000.000 FORMAT "%8.3" EXTENDED_LIMITS -32768.00 32767.00
 /begin AXIS_DESCR STD_AXIS PFlt_RngIdx_X_mp OneToOne 11 0.00 10.00 FORMAT "%5.2" EXTENDED_LIMITS 0.00 255.0 DEPOSIT ABSOLUTE /end AXIS_DESCR
 /begin AXIS_DESCR STD_AXIS PFlt_RngIdx_Y_mp OneToOne 2 0.00 1.000 FORMAT "%5.3" EXTENDED_LIMITS 0.00 255.0 DEPOSIT ABSOLUTE /end AXIS_DESCR
/end CHARACTERISTIC
/begin CHARACTERISTIC PFlt_nHCCondPrtHeal_C "Drehzahlgrenze zum rücksetzen des HC Überkonditionierungs Schutzes" VALUE 0xF2C70 Kw_Ws16 5000.000 EngN 0.00 5000.000 FORMAT "%8.3" EXTENDED_LIMITS -32768.00 32767.00 /end CHARACTERISTIC
/begin CHARACTERISTIC PFlt_nResFlowSim_C "Umschaltschwelle auf resFlow Simulation" VALUE 0xF4898 Kw_Ws16 1500.000 EngN 0.00 1500.000 FORMAT "%8.3" EXTENDED_LIMITS -32768.00 32767.00 /end CHARACTERISTIC
/begin CHARACTERISTIC PFlt_numAshCorMsk_C "Maske für gültige AshCor Regeneration, Eingang ist der Status PFlt_stEngPOp" VALUE 0xF2B1E Kw_Wu16 65535.00 OneToOne 0.00 65535.00 FORMAT "%8.2" /end CHARACTERISTIC
/begin CHARACTERISTIC PFlt_numAshCor_C "AshCor-Schalterwert" VALUE 0xF2B20 Kw_Wu8 11.00 OneToOne 0.00 11.00 FORMAT "%5.2" EXTENDED_LIMITS 0.00 255.0 /end CHARACTERISTIC
/begin CHARACTERISTIC PFlt_numEGSys_C "Menge der Abgas- oder Ansugfluten des Motorenluftsystems" VALUE 0xF2E1A Kw_Wu8 1.000 OneToOne 1.000 2.000 FORMAT "%5.3" EXTENDED_LIMITS 0.00 255.0 /end CHARACTERISTIC
/begin CHARACTERISTIC PFlt_numEngPOpDel_CA "verzögert wirksame Matrix zur Berücksichtigung des Motorbetriebszustandes bei der Regeneration" MAP 0xF2E1B Kf_Xu8_Yu8_Wu8 6.000 OneToOne 0.00 6.000 FORMAT "%5.3" EXTENDED_LIMITS 0.00 255.0
 /begin AXIS_DESCR STD_AXIS PFlt_stEngPOp OneToOne 12 0.00 11.00 FORMAT "%5.2" EXTENDED_LIMITS 0.00 255.0 DEPOSIT ABSOLUTE /end AXIS_DESCR
 /begin AXIS_DESCR STD_AXIS PFlt_numRgn_mp OneToOne 10 0.00 9.000 FORMAT "%5.3" EXTENDED_LIMITS 0.00 255.0 DEPOSIT ABSOLUTE /end AXIS_DESCR
/end CHARACTERISTIC
/begin CHARACTERISTIC PFlt_numEngPOpIntr_CA "Motorbetriebskennfeld für abgebrochene Regeneration" MAP 0xF2EAB Kf_Xu8_Yu8_Wu8 6.000 OneToOne 0.00 6.000 FORMAT "%5.3" EXTENDED_LIMITS 0.00 255.0
 /begin AXIS_DESCR STD_AXIS PFlt_stEngPOp OneToOne 12 0.00 11.00 FORMAT "%5.2" EXTENDED_LIMITS 0.00 255.0 DEPOSIT ABSOLUTE /end AXIS_DESCR
 /begin AXIS_DESCR STD_AXIS PFlt_numRgn_mp OneToOne 10 0.00 9.000 FORMAT "%5.3" EXTENDED_LIMITS 0.00 255.0 DEPOSIT ABSOLUTE /end AXIS_DESCR
/end CHARACTERISTIC
/begin CHARACTERISTIC PFlt_numEngPOp_CA "Partikelfilterstatus vs. Motorstatus Matrix" MAP 0xF2F3B Kf_Xu8_Yu8_Wu8 6.000 OneToOne 0.00 6.000 FORMAT "%5.3" EXTENDED_LIMITS 0.00 255.0
 /begin AXIS_DESCR STD_AXIS PFlt_stEngPOp OneToOne 12 0.00 11.00 FORMAT "%5.2" EXTENDED_LIMITS 0.00 255.0 DEPOSIT ABSOLUTE /end AXIS_DESCR
 /begin AXIS_DESCR STD_AXIS PFlt_numRgn_mp OneToOne 10 0.00 9.000 FORMAT "%5.3" EXTENDED_LIMITS 0.00 255.0 DEPOSIT ABSOLUTE /end AXIS_DESCR
/end CHARACTERISTIC
/begin CHARACTERISTIC PFlt_numHCCondActvMsk_C "Maske zur Überprüfung, ob gerade eine HC Konditionierung stattfindet" VALUE 0xF2C72 Kw_Wu16 65535.00 OneToOne 0.00 65535.00 FORMAT "%8.2" /end CHARACTERISTIC
/begin CHARACTERISTIC PFlt_numHCCond_C "HC Regenerationsanforderungszahl" VALUE 0xF2FCB Kw_Wu8 255.0 OneToOne 0.00 255.0 FORMAT "%5.1" /end CHARACTERISTIC
/begin CHARACTERISTIC PFlt_numLst_C "Regenerationsanforderung aufgrund von gefahrener Strecke, Betriebszeit oder Verbrauch" VALUE 0xF2FCC Kw_Wu8 255.0 OneToOne 0.00 255.0 FORMAT "%5.1" /end CHARACTERISTIC
/begin CHARACTERISTIC PFlt_numLSUB1_C "Array Index für Lambdasensorkonfiguration bank 2" VALUE 0xF3A2C Kw_Wu8 16.00 OneToOne 0.00 16.00 FORMAT "%5.2" EXTENDED_LIMITS 0.00 255.0 /end CHARACTERISTIC
/begin CHARACTERISTIC PFlt_numLSUB2_C "Array Index für Lambdasensorknofiguration Bank 2" VALUE 0xF3A2D Kw_Wu8 16.00 OneToOne 0.00 16.00 FORMAT "%5.2" EXTENDED_LIMITS 0.00 255.0 /end CHARACTERISTIC
/begin CHARACTERISTIC PFlt_numLSU_C "Array - Index für die Lambdasensor Konfiguration" VALUE 0xF3A2E Kw_Wu8 16.00 OneToOne 0.00 16.00 FORMAT "%5.2" EXTENDED_LIMITS 0.00 255.0 /end CHARACTERISTIC
/begin CHARACTERISTIC PFlt_numPFltErrRgnIntr_C "Fehlerwert für AshCor" VALUE 0xF2B21 Kw_Wu8 9.000 OneToOne 0.00 9.000 FORMAT "%5.3" EXTENDED_LIMITS 0.00 255.0 /end CHARACTERISTIC
/begin CHARACTERISTIC PFlt_numPFltErr_C "Konstante für den CSF-Notfahrbetrieb" VALUE 0xF2B22 Kw_Wu8 9.000 OneToOne 0.00 9.000 FORMAT "%5.3" EXTENDED_LIMITS 0.00 255.0 /end CHARACTERISTIC
/begin CHARACTERISTIC PFlt_numPOpAir_C "Zeiger auf das Motortemperaturfeld" VALUE 0xF3542 Kw_Wu8 2.00000000000 IndSysTempFldSel 0.00 2.00000000000 FORMAT "%13.11" /end CHARACTERISTIC
/begin CHARACTERISTIC PFlt_numPOpClnt_C "Zeiger auf das Temperaturfeld des Ansaugsystems" VALUE 0xF3543 Kw_Wu8 2.00000000000 EngTempFldSel 0.00 2.00000000000 FORMAT "%13.11" /end CHARACTERISTIC
/begin CHARACTERISTIC PFlt_numPrioRgnStg1_C "Priorität für Regenerationstate 1" VALUE 0xF2FCE Kw_Wu16 65535.00 OneToOne 0.00 65535.00 FORMAT "%8.2" /end CHARACTERISTIC
/begin CHARACTERISTIC PFlt_numPrioRgnStg2_C "Priorität für Regenerationstate 2" VALUE 0xF2FD0 Kw_Wu16 65535.00 OneToOne 0.00 65535.00 FORMAT "%8.2" /end CHARACTERISTIC
/begin CHARACTERISTIC PFlt_numPrioRgnStg3_C "Priorität für Regenerationstate 3" VALUE 0xF2FD2 Kw_Wu16 65535.00 OneToOne 0.00 65535.00 FORMAT "%8.2" /end CHARACTERISTIC
/begin CHARACTERISTIC PFlt_numPrioRgnStg4_C "Priorität für Regenerationstate 4" VALUE 0xF2FD4 Kw_Wu16 65535.00 OneToOne 0.00 65535.00 FORMAT "%8.2" /end CHARACTERISTIC
/begin CHARACTERISTIC PFlt_numPrioRgnStg5_C "Priorität für Regenerationstate 5" VALUE 0xF2FD6 Kw_Wu16 65535.00 OneToOne 0.00 65535.00 FORMAT "%8.2" /end CHARACTERISTIC
/begin CHARACTERISTIC PFlt_numPrioRgnStg6_C "Prioritätszahl für Regenerationsstufe 6" VALUE 0xF2FD8 Kw_Wu16 65535.00 OneToOne 0.00 65535.00 FORMAT "%8.2" /end CHARACTERISTIC
/begin CHARACTERISTIC PFlt_numPrioRgnStgDiag_C "Regenerationspriorität des angeforderten Zustands bei aktiver PFlt-Testeranforderung" VALUE 0xF2FDA Kw_Wu16 65535.00 OneToOne 0.00 65535.00 FORMAT "%8.2" /end CHARACTERISTIC
/begin CHARACTERISTIC PFlt_numPrt_C "Regenerationsanforderung aufgrund v. Motorschutz" VALUE 0xF2FDC Kw_Wu8 255.0 OneToOne 0.00 255.0 FORMAT "%5.1" /end CHARACTERISTIC
/begin CHARACTERISTIC PFlt_numRgnSuc_C "größte Regenerationsanforderungszahl ab der eine erfolgreiche Regeneration detektiert wird" VALUE 0xF2FDD Kw_Wu8 100.0 OneToOne 0.00 100.0 FORMAT "%5.1" EXTENDED_LIMITS 0.00 255.0 /end CHARACTERISTIC
/begin CHARACTERISTIC PFlt_pDiffPFlt_MAP "Kennfeld für Differenzdruck des leeren Partikelfilters" MAP 0xF489A Kf_Xs16_Ys16_Ws16 3500.000 Pres_hPa 0.00 3500.000 FORMAT "%8.3" EXTENDED_LIMITS -32768.00 32767.00
 /begin AXIS_DESCR STD_AXIS PFlt_tSurfCrvIn_mp Temp_Cels 16 -50.140 899.860 FORMAT "%8.3" EXTENDED_LIMITS -3549.940 3003.560 DEPOSIT ABSOLUTE /end AXIS_DESCR
 /begin AXIS_DESCR STD_AXIS PFlt_dvol_mp CubMtrPerHr 16 50.00000 2500.000 FORMAT "%8.3" EXTENDED_LIMITS -3276.800 3276.700 DEPOSIT ABSOLUTE /end AXIS_DESCR
/end CHARACTERISTIC
/begin CHARACTERISTIC PFlt_pEngPrtAshCor_MAP "Kennfeld fuer Aschedruckoffset" MAP 0xF2FDE Kf_Xs16_Ys16_Ws16 5000.000 Pres_hPa -1500.000 3500.000 FORMAT "%8.3" EXTENDED_LIMITS -32768.00 32767.00
 /begin AXIS_DESCR STD_AXIS Eng_nAvrg EngN 8 40.00000 6000.000 FORMAT "%8.3" EXTENDED_LIMITS -32768.00 32767.00 DEPOSIT ABSOLUTE /end AXIS_DESCR
 /begin AXIS_DESCR STD_AXIS InjCtl_qSetUnBal InjMassCyc 8 0.00 327.6700 FORMAT "%8.4" EXTENDED_LIMITS -327.6800 327.6700 DEPOSIT ABSOLUTE /end AXIS_DESCR
/end CHARACTERISTIC
/begin CHARACTERISTIC PFlt_pEngPrtMaxInit_C "Inititialisierungswert des PT1-Filters für den Maximalwert im Motorschutz" VALUE 0xF3082 Kw_Ws16 32767.00 Pres_hPa 0.00 32767.00 FORMAT "%8.2" EXTENDED_LIMITS -32768.00 32767.00 /end CHARACTERISTIC
/begin CHARACTERISTIC PFlt_pEngPrtMax_MAP "Kennfeld obere Druckschwelle Motorschutz" MAP 0xF3084 Kf_Xs16_Ys16_Ws16 3500.000 Pres_hPa 0.00 3500.000 FORMAT "%8.3" EXTENDED_LIMITS -32768.00 32767.00
 /begin AXIS_DESCR STD_AXIS Eng_nAvrg EngN 8 40.00000 6000.000 FORMAT "%8.3" EXTENDED_LIMITS -32768.00 32767.00 DEPOSIT ABSOLUTE /end AXIS_DESCR
 /begin AXIS_DESCR STD_AXIS InjCtl_qSetUnBal InjMassCyc 8 0.00 327.6700 FORMAT "%8.4" EXTENDED_LIMITS -327.6800 327.6700 DEPOSIT ABSOLUTE /end AXIS_DESCR
/end CHARACTERISTIC
/begin CHARACTERISTIC PFlt_pEngPrtMin_MAP "untere Druckschwelle Motorschutz" MAP 0xF3128 Kf_Xs16_Ys16_Ws16 3500.000 Pres_hPa 0.00 3500.000 FORMAT "%8.3" EXTENDED_LIMITS -32768.00 32767.00
 /begin AXIS_DESCR STD_AXIS Eng_nAvrg EngN 8 40.00000 6000.000 FORMAT "%8.3" EXTENDED_LIMITS -32768.00 32767.00 DEPOSIT ABSOLUTE /end AXIS_DESCR
 /begin AXIS_DESCR STD_AXIS InjCtl_qSetUnBal InjMassCyc 8 0.00 327.6700 FORMAT "%8.4" EXTENDED_LIMITS -327.6800 327.6700 DEPOSIT ABSOLUTE /end AXIS_DESCR
/end CHARACTERISTIC
/begin CHARACTERISTIC PFlt_qFlMaxDef_C "Regenerationsschwelle für Treibstoffverbrauch im Fehlerfall" VALUE 0xF31CC Kw_Ws16 320.0000 Fl_L 0.00 320.0000 FORMAT "%8.4" EXTENDED_LIMITS -327.6800 327.6700 /end CHARACTERISTIC
/begin CHARACTERISTIC PFlt_qFlMax_CUR "Umrechnung Strömungswiderstand in die Partikelmasse" CURVE 0xF31CE Kl_Xs16_Ws16 320.0000 Fl_L 0.00 320.0000 FORMAT "%8.4" EXTENDED_LIMITS -327.6800 327.6700
 /begin AXIS_DESCR STD_AXIS PFlt_mAshOil_mp mSoot_g 8 -327.6800 327.6700 FORMAT "%8.4" DEPOSIT ABSOLUTE /end AXIS_DESCR
/end CHARACTERISTIC
/begin CHARACTERISTIC PFlt_qFlSubs_C "Treibstoffverbrauch Ersatzwert für den Fall eines Eeprom lese Fehlers" VALUE 0xF31F0 Kw_Ws16 320.0000 Fl_L 0.00 320.0000 FORMAT "%8.4" EXTENDED_LIMITS -327.6800 327.6700 /end CHARACTERISTIC
/begin CHARACTERISTIC PFlt_qFlTotAdjMax_C "Maximalwert des gesamten Kraftstoffverbrauchs" VALUE 0xF31F4 Kw_Ws32 42949672.9500 Fl_L -21474836.4800 21474836.4700 FORMAT "%13.4" /end CHARACTERISTIC
/begin CHARACTERISTIC PFlt_qFlTotMax_C "Maximalwert des gesamten Kraftstoffverbrauchs" VALUE 0xF31F8 Kw_Ws16 327670.0 Fl_2 0.00 327670.0 FORMAT "%8.1" EXTENDED_LIMITS -327680.0 327670.0 /end CHARACTERISTIC
/begin CHARACTERISTIC PFlt_qFlTotMin_C "Unterere Grenze für Gesamtmenge Kraftstoffquantität" VALUE 0xF2B24 Kw_Ws16 320.0000 Fl_2 0.00 320.0000 FORMAT "%8.4" EXTENDED_LIMITS -327680.0 327670.0 /end CHARACTERISTIC
/begin CHARACTERISTIC PFlt_qHCCondPrtHeal_C "Mengenschwellwert zum rücksetzen des HC Überkonditionierungsschutzes" VALUE 0xF2C74 Kw_Ws16 327.6700 InjMassInj 0.00 327.6700 FORMAT "%8.4" EXTENDED_LIMITS -327.6800 327.6700 /end CHARACTERISTIC
/begin CHARACTERISTIC PFlt_qSetUnBalFltAshCorMax_C "maximal zulässiger Wert aktuelle Einspritzmenge" VALUE 0xF2B26 Kw_Ws16 327.6700 InjMassCyc 0.00 327.6700 FORMAT "%8.4" EXTENDED_LIMITS -327.6800 327.6700 /end CHARACTERISTIC
/begin CHARACTERISTIC PFlt_qSetUnBalFltAshCorMin_C "minimal zulässiger Wert aktuelle Einspritzmenge" VALUE 0xF2B28 Kw_Ws16 327.6700 InjMassCyc 0.00 327.6700 FORMAT "%8.4" EXTENDED_LIMITS -327.6800 327.6700 /end CHARACTERISTIC
/begin CHARACTERISTIC PFlt_qSetUnBalRng10Max_GCUR "Maximalwert Einspritzmassensollwert Bereich 10" CURVE 0xF3544 Gkl_Ws16 327.6700 InjMass 0.00 327.6700 FORMAT "%8.4" EXTENDED_LIMITS -327.6800 327.6700
 /begin AXIS_DESCR COM_AXIS PFlt_nAvrgFlt_mp EngN 8 40.00000 6000.000 FORMAT "%8.3" EXTENDED_LIMITS -32768.00 32767.00 AXIS_PTS_REF PFlt_qSetUnBal_AXIS /end AXIS_DESCR
/end CHARACTERISTIC
/begin CHARACTERISTIC PFlt_qSetUnBalRng10Min_GCUR "Minimalwert Einspritzmassensollwert Bereich 10" CURVE 0xF3554 Gkl_Ws16 327.6700 InjMass 0.00 327.6700 FORMAT "%8.4" EXTENDED_LIMITS -327.6800 327.6700
 /begin AXIS_DESCR COM_AXIS PFlt_nAvrgFlt_mp EngN 8 40.00000 6000.000 FORMAT "%8.3" EXTENDED_LIMITS -32768.00 32767.00 AXIS_PTS_REF PFlt_qSetUnBal_AXIS /end AXIS_DESCR
/end CHARACTERISTIC
/begin CHARACTERISTIC PFlt_qSetUnBalRng1Max_GCUR "Maximalwert Einspritzmassensollwert Bereich 1" CURVE 0xF3564 Gkl_Ws16 327.6700 InjMass 0.00 327.6700 FORMAT "%8.4" EXTENDED_LIMITS -327.6800 327.6700
 /begin AXIS_DESCR COM_AXIS PFlt_nAvrgFlt_mp EngN 8 40.00000 6000.000 FORMAT "%8.3" EXTENDED_LIMITS -32768.00 32767.00 AXIS_PTS_REF PFlt_qSetUnBal_AXIS /end AXIS_DESCR
/end CHARACTERISTIC
/begin CHARACTERISTIC PFlt_qSetUnBalRng1Min_GCUR "Minimalwert Einspritzmassensollwert Bereich 1" CURVE 0xF3574 Gkl_Ws16 327.6700 InjMass 0.00 327.6700 FORMAT "%8.4" EXTENDED_LIMITS -327.6800 327.6700
 /begin AXIS_DESCR COM_AXIS PFlt_nAvrgFlt_mp EngN 8 40.00000 6000.000 FORMAT "%8.3" EXTENDED_LIMITS -32768.00 32767.00 AXIS_PTS_REF PFlt_qSetUnBal_AXIS /end AXIS_DESCR
/end CHARACTERISTIC
/begin CHARACTERISTIC PFlt_qSetUnBalRng2Max_GCUR "Maximalwert Einspritzmassensollwert Bereich 2" CURVE 0xF3584 Gkl_Ws16 327.6700 InjMass 0.00 327.6700 FORMAT "%8.4" EXTENDED_LIMITS -327.6800 327.6700
 /begin AXIS_DESCR COM_AXIS PFlt_nAvrgFlt_mp EngN 8 40.00000 6000.000 FORMAT "%8.3" EXTENDED_LIMITS -32768.00 32767.00 AXIS_PTS_REF PFlt_qSetUnBal_AXIS /end AXIS_DESCR
/end CHARACTERISTIC
/begin CHARACTERISTIC PFlt_qSetUnBalRng2Min_GCUR "Minimalwert Einspritzmassensollwert Bereich 2" CURVE 0xF3594 Gkl_Ws16 327.6700 InjMass 0.00 327.6700 FORMAT "%8.4" EXTENDED_LIMITS -327.6800 327.6700
 /begin AXIS_DESCR COM_AXIS PFlt_nAvrgFlt_mp EngN 8 40.00000 6000.000 FORMAT "%8.3" EXTENDED_LIMITS -32768.00 32767.00 AXIS_PTS_REF PFlt_qSetUnBal_AXIS /end AXIS_DESCR
/end CHARACTERISTIC
/begin CHARACTERISTIC PFlt_qSetUnBalRng3Max_GCUR "Maximalwert Einspritzmassensollwert Bereich 3" CURVE 0xF35A4 Gkl_Ws16 327.6700 InjMass 0.00 327.6700 FORMAT "%8.4" EXTENDED_LIMITS -327.6800 327.6700
 /begin AXIS_DESCR COM_AXIS PFlt_nAvrgFlt_mp EngN 8 40.00000 6000.000 FORMAT "%8.3" EXTENDED_LIMITS -32768.00 32767.00 AXIS_PTS_REF PFlt_qSetUnBal_AXIS /end AXIS_DESCR
/end CHARACTERISTIC
/begin CHARACTERISTIC PFlt_qSetUnBalRng3Min_GCUR "Minimalwert Einspritzmassensollwert Bereich 3" CURVE 0xF35B4 Gkl_Ws16 327.6700 InjMass 0.00 327.6700 FORMAT "%8.4" EXTENDED_LIMITS -327.6800 327.6700
 /begin AXIS_DESCR COM_AXIS PFlt_nAvrgFlt_mp EngN 8 40.00000 6000.000 FORMAT "%8.3" EXTENDED_LIMITS -32768.00 32767.00 AXIS_PTS_REF PFlt_qSetUnBal_AXIS /end AXIS_DESCR
/end CHARACTERISTIC
/begin CHARACTERISTIC PFlt_qSetUnBalRng4Max_GCUR "Maximalwert Einspritzmassensollwert Bereich 4" CURVE 0xF35C4 Gkl_Ws16 327.6700 InjMass 0.00 327.6700 FORMAT "%8.4" EXTENDED_LIMITS -327.6800 327.6700
 /begin AXIS_DESCR COM_AXIS PFlt_nAvrgFlt_mp EngN 8 40.00000 6000.000 FORMAT "%8.3" EXTENDED_LIMITS -32768.00 32767.00 AXIS_PTS_REF PFlt_qSetUnBal_AXIS /end AXIS_DESCR
/end CHARACTERISTIC
/begin CHARACTERISTIC PFlt_qSetUnBalRng4Min_GCUR "Minimalwert Einspritzmassensollwert Bereich 4" CURVE 0xF35D4 Gkl_Ws16 327.6700 InjMass 0.00 327.6700 FORMAT "%8.4" EXTENDED_LIMITS -327.6800 327.6700
 /begin AXIS_DESCR COM_AXIS PFlt_nAvrgFlt_mp EngN 8 40.00000 6000.000 FORMAT "%8.3" EXTENDED_LIMITS -32768.00 32767.00 AXIS_PTS_REF PFlt_qSetUnBal_AXIS /end AXIS_DESCR
/end CHARACTERISTIC
/begin CHARACTERISTIC PFlt_qSetUnBalRng5Max_GCUR "Maximalwert Einspritzmassensollwert Bereich 5" CURVE 0xF35E4 Gkl_Ws16 327.6700 InjMass 0.00 327.6700 FORMAT "%8.4" EXTENDED_LIMITS -327.6800 327.6700
 /begin AXIS_DESCR COM_AXIS PFlt_nAvrgFlt_mp EngN 8 40.00000 6000.000 FORMAT "%8.3" EXTENDED_LIMITS -32768.00 32767.00 AXIS_PTS_REF PFlt_qSetUnBal_AXIS /end AXIS_DESCR
/end CHARACTERISTIC
/begin CHARACTERISTIC PFlt_qSetUnBalRng5Min_GCUR "Minimalwert Einspritzmassensollwert Bereich 5" CURVE 0xF35F4 Gkl_Ws16 327.6700 InjMass 0.00 327.6700 FORMAT "%8.4" EXTENDED_LIMITS -327.6800 327.6700
 /begin AXIS_DESCR COM_AXIS PFlt_nAvrgFlt_mp EngN 8 40.00000 6000.000 FORMAT "%8.3" EXTENDED_LIMITS -32768.00 32767.00 AXIS_PTS_REF PFlt_qSetUnBal_AXIS /end AXIS_DESCR
/end CHARACTERISTIC
/begin CHARACTERISTIC PFlt_qSetUnBalRng6Max_GCUR "Maximalwert Einspritzmassensollwert Bereich 6" CURVE 0xF3604 Gkl_Ws16 327.6700 InjMass 0.00 327.6700 FORMAT "%8.4" EXTENDED_LIMITS -327.6800 327.6700
 /begin AXIS_DESCR COM_AXIS PFlt_nAvrgFlt_mp EngN 8 40.00000 6000.000 FORMAT "%8.3" EXTENDED_LIMITS -32768.00 32767.00 AXIS_PTS_REF PFlt_qSetUnBal_AXIS /end AXIS_DESCR
/end CHARACTERISTIC
/begin CHARACTERISTIC PFlt_qSetUnBalRng6Min_GCUR "Minimalwert Einspritzmassensollwert Bereich 6" CURVE 0xF3614 Gkl_Ws16 327.6700 InjMass 0.00 327.6700 FORMAT "%8.4" EXTENDED_LIMITS -327.6800 327.6700
 /begin AXIS_DESCR COM_AXIS PFlt_nAvrgFlt_mp EngN 8 40.00000 6000.000 FORMAT "%8.3" EXTENDED_LIMITS -32768.00 32767.00 AXIS_PTS_REF PFlt_qSetUnBal_AXIS /end AXIS_DESCR
/end CHARACTERISTIC
/begin CHARACTERISTIC PFlt_qSetUnBalRng7Max_GCUR "Maximalwert Einspritzmassensollwert Bereich 7" CURVE 0xF3624 Gkl_Ws16 327.6700 InjMass 0.00 327.6700 FORMAT "%8.4" EXTENDED_LIMITS -327.6800 327.6700
 /begin AXIS_DESCR COM_AXIS PFlt_nAvrgFlt_mp EngN 8 40.00000 6000.000 FORMAT "%8.3" EXTENDED_LIMITS -32768.00 32767.00 AXIS_PTS_REF PFlt_qSetUnBal_AXIS /end AXIS_DESCR
/end CHARACTERISTIC
/begin CHARACTERISTIC PFlt_qSetUnBalRng7Min_GCUR "Minimalwert Einspritzmassensollwert Bereich 7" CURVE 0xF3634 Gkl_Ws16 327.6700 InjMass 0.00 327.6700 FORMAT "%8.4" EXTENDED_LIMITS -327.6800 327.6700
 /begin AXIS_DESCR COM_AXIS PFlt_nAvrgFlt_mp EngN 8 40.00000 6000.000 FORMAT "%8.3" EXTENDED_LIMITS -32768.00 32767.00 AXIS_PTS_REF PFlt_qSetUnBal_AXIS /end AXIS_DESCR
/end CHARACTERISTIC
/begin CHARACTERISTIC PFlt_qSetUnBalRng8Max_GCUR "Maximalwert Einspritzmassensollwert Bereich 8" CURVE 0xF3644 Gkl_Ws16 327.6700 InjMass 0.00 327.6700 FORMAT "%8.4" EXTENDED_LIMITS -327.6800 327.6700
 /begin AXIS_DESCR COM_AXIS PFlt_nAvrgFlt_mp EngN 8 40.00000 6000.000 FORMAT "%8.3" EXTENDED_LIMITS -32768.00 32767.00 AXIS_PTS_REF PFlt_qSetUnBal_AXIS /end AXIS_DESCR
/end CHARACTERISTIC
/begin CHARACTERISTIC PFlt_qSetUnBalRng8Min_GCUR "Minimalwert Einspritzmassensollwert Bereich 8" CURVE 0xF3654 Gkl_Ws16 327.6700 InjMass 0.00 327.6700 FORMAT "%8.4" EXTENDED_LIMITS -327.6800 327.6700
 /begin AXIS_DESCR COM_AXIS PFlt_nAvrgFlt_mp EngN 8 40.00000 6000.000 FORMAT "%8.3" EXTENDED_LIMITS -32768.00 32767.00 AXIS_PTS_REF PFlt_qSetUnBal_AXIS /end AXIS_DESCR
/end CHARACTERISTIC
/begin CHARACTERISTIC PFlt_qSetUnBalRng9Max_GCUR "Maximalwert Einspritzmassensollwert Bereich 9" CURVE 0xF3664 Gkl_Ws16 327.6700 InjMass 0.00 327.6700 FORMAT "%8.4" EXTENDED_LIMITS -327.6800 327.6700
 /begin AXIS_DESCR COM_AXIS PFlt_nAvrgFlt_mp EngN 8 40.00000 6000.000 FORMAT "%8.3" EXTENDED_LIMITS -32768.00 32767.00 AXIS_PTS_REF PFlt_qSetUnBal_AXIS /end AXIS_DESCR
/end CHARACTERISTIC
/begin CHARACTERISTIC PFlt_qSetUnBalRng9Min_GCUR "Minimalwert Einspritzmassensollwert Bereich 9" CURVE 0xF3674 Gkl_Ws16 327.6700 InjMass 0.00 327.6700 FORMAT "%8.4" EXTENDED_LIMITS -327.6800 327.6700
 /begin AXIS_DESCR COM_AXIS PFlt_nAvrgFlt_mp EngN 8 40.00000 6000.000 FORMAT "%8.3" EXTENDED_LIMITS -32768.00 32767.00 AXIS_PTS_REF PFlt_qSetUnBal_AXIS /end AXIS_DESCR
/end CHARACTERISTIC
/begin CHARACTERISTIC PFlt_qSetUnBalRngSpoMax_GCUR "Maximalwert Einspritzmassensollwert Bereich Spontane Regeneration" CURVE 0xF3684 Gkl_Ws16 327.6700 InjMass 0.00 327.6700 FORMAT "%8.4" EXTENDED_LIMITS -327.6800 327.6700
 /begin AXIS_DESCR COM_AXIS PFlt_nAvrgFlt_mp EngN 8 40.00000 6000.000 FORMAT "%8.3" EXTENDED_LIMITS -32768.00 32767.00 AXIS_PTS_REF PFlt_qSetUnBal_AXIS /end AXIS_DESCR
/end CHARACTERISTIC
/begin CHARACTERISTIC PFlt_qSetUnBalRngSpoMin_GCUR "Minimalwert Einspritzmassensollwert Bereich Spontane Regeneration" CURVE 0xF3694 Gkl_Ws16 327.6700 InjMass 0.00 327.6700 FORMAT "%8.4" EXTENDED_LIMITS -327.6800 327.6700
 /begin AXIS_DESCR COM_AXIS PFlt_nAvrgFlt_mp EngN 8 40.00000 6000.000 FORMAT "%8.3" EXTENDED_LIMITS -32768.00 32767.00 AXIS_PTS_REF PFlt_qSetUnBal_AXIS /end AXIS_DESCR
/end CHARACTERISTIC
/begin AXIS_PTS PFlt_qSetUnBal_AXIS "Breakpoints for the group curves which calculate the unbalanced fuel quantity thresholds" 0xF36A4 PFlt_nAvrgFlt_mp GSst_Xs16 5960.000 EngN 8 40.00000 6000.000 FORMAT "%8.3" EXTENDED_LIMITS -32768.00 32767.00 DEPOSIT ABSOLUTE /end AXIS_PTS
/begin CHARACTERISTIC PFlt_rAccPedMinMax_CA "Matrix zur Bestimmung der Bereichsgrenzen für das gefilterte Pedalwertgebersignal" MAP 0xF36B6 Kf_Xs16_Ys16_Ws16 100.0000 Prc 0.00 100.0000 FORMAT "%8.4" EXTENDED_LIMITS -400.0000 399.9878
 /begin AXIS_DESCR STD_AXIS PFlt_RngIdx_X_mp OneToOne 11 0.00 10.00 FORMAT "%5.2" EXTENDED_LIMITS 0.00 255.0 DEPOSIT ABSOLUTE /end AXIS_DESCR
 /begin AXIS_DESCR STD_AXIS PFlt_RngIdx_Y_mp OneToOne 2 0.00 1.000 FORMAT "%5.3" EXTENDED_LIMITS 0.00 255.0 DEPOSIT ABSOLUTE /end AXIS_DESCR
/end CHARACTERISTIC
/begin CHARACTERISTIC PFlt_rEGRSimMax_C "obere Grenze für Abschalterkennung ARF" VALUE 0xF4ADE Kw_Ws16 300.0000 Prc -100.0000 200.0000 FORMAT "%8.4" EXTENDED_LIMITS -400.0000 399.9878 /end CHARACTERISTIC
/begin CHARACTERISTIC PFlt_rEGRSimMin_C "untere Grenze für Abschalterkennung ARF" VALUE 0xF4AE0 Kw_Ws16 300.0000 Prc -100.0000 200.0000 FORMAT "%8.4" EXTENDED_LIMITS -400.0000 399.9878 /end CHARACTERISTIC
/begin CHARACTERISTIC PFlt_resFlowB1_Vector "Konfigurationslabels für Bypass(Bank1)" VALUE 0xC39AC Kw_Wu8 255.0 OneToOne 0.00 255.0 FORMAT "%5.1" /end CHARACTERISTIC
/begin CHARACTERISTIC PFlt_resFlowB1_Channel "Konfigurationslabels für Bypass(Bank1)" VALUE 0xC39AD Kw_Wu8 255.0 OneToOne 0.00 255.0 FORMAT "%5.1" /end CHARACTERISTIC
/begin CHARACTERISTIC PFlt_resFlowB2_Vector "Konfigurationslabels für Bypass(Bank2)" VALUE 0xC39AE Kw_Wu8 255.0 OneToOne 0.00 255.0 FORMAT "%5.1" /end CHARACTERISTIC
/begin CHARACTERISTIC PFlt_resFlowB2_Channel "Konfigurationslabels für Bypass(Bank2)" VALUE 0xC39AF Kw_Wu8 255.0 OneToOne 0.00 255.0 FORMAT "%5.1" /end CHARACTERISTIC
/begin CHARACTERISTIC PFlt_resFlowEngPrtCor_MAP "" MAP 0xF31FA Kf_Xs16_Ys16_Ws16 25.00000 Res_hPaHrPerCM 0.00 25.00000 FORMAT "%8.5" EXTENDED_LIMITS -32.76800 32.76700
 /begin AXIS_DESCR STD_AXIS Eng_nAvrg EngN 8 40.00000 6000.000 FORMAT "%8.3" EXTENDED_LIMITS -32768.00 32767.00 DEPOSIT ABSOLUTE /end AXIS_DESCR
 /begin AXIS_DESCR STD_AXIS InjCtl_qSetUnBal InjMassCyc 8 0.00 327.6700 FORMAT "%8.4" EXTENDED_LIMITS -327.6800 327.6700 DEPOSIT ABSOLUTE /end AXIS_DESCR
/end CHARACTERISTIC
/begin CHARACTERISTIC PFlt_resFlowEngPrtMaxInit_C "" VALUE 0xF329E Kw_Ws16 25.00000 Res_hPaHrPerCM 0.00 25.00000 FORMAT "%8.5" EXTENDED_LIMITS -32.76800 32.76700 /end CHARACTERISTIC
/begin CHARACTERISTIC PFlt_resFlowEngPrtMax_MAP "" MAP 0xF32A0 Kf_Xs16_Ys16_Ws16 25.00000 Res_hPaHrPerCM 0.00 25.00000 FORMAT "%8.5" EXTENDED_LIMITS -32.76800 32.76700
 /begin AXIS_DESCR STD_AXIS Eng_nAvrg EngN 8 40.00000 6000.000 FORMAT "%8.3" EXTENDED_LIMITS -32768.00 32767.00 DEPOSIT ABSOLUTE /end AXIS_DESCR
 /begin AXIS_DESCR STD_AXIS InjCtl_qSetUnBal InjMassCyc 8 0.00 327.6700 FORMAT "%8.4" EXTENDED_LIMITS -327.6800 327.6700 DEPOSIT ABSOLUTE /end AXIS_DESCR
/end CHARACTERISTIC
/begin CHARACTERISTIC PFlt_resFlowEngPrtMin_MAP "" MAP 0xF3344 Kf_Xs16_Ys16_Ws16 25.00000 Res_hPaHrPerCM 0.00 25.00000 FORMAT "%8.5" EXTENDED_LIMITS -32.76800 32.76700
 /begin AXIS_DESCR STD_AXIS Eng_nAvrg EngN 8 40.00000 6000.000 FORMAT "%8.3" EXTENDED_LIMITS -32768.00 32767.00 DEPOSIT ABSOLUTE /end AXIS_DESCR
 /begin AXIS_DESCR STD_AXIS InjCtl_qSetUnBal InjMassCyc 8 0.00 327.6700 FORMAT "%8.4" EXTENDED_LIMITS -327.6800 327.6700 DEPOSIT ABSOLUTE /end AXIS_DESCR
/end CHARACTERISTIC
/begin CHARACTERISTIC PFlt_resFlowMeasInv_MAP "Inverse Strömungswiderstandskennfeld" MAP 0xF4AE2 Kf_Xs16_Ys16_Ws16 25.00000 Res_hPaHrPerCM 0.00 25.00000 FORMAT "%8.5" EXTENDED_LIMITS -32.76800 32.76700
 /begin AXIS_DESCR STD_AXIS PFlt_mSotCrvIn_mp mSoot_g 16 0.00 300.0000 FORMAT "%8.4" EXTENDED_LIMITS -327.6800 327.6700 DEPOSIT ABSOLUTE /end AXIS_DESCR
 /begin AXIS_DESCR STD_AXIS PFlt_dvolMassFltIn_mp CubMtrPerHr 16 0.00 3000.000 FORMAT "%8.3" EXTENDED_LIMITS -3276.800 3276.700 DEPOSIT ABSOLUTE /end AXIS_DESCR
/end CHARACTERISTIC
/begin CHARACTERISTIC PFlt_resFlowOfs_MAP "Kennfeld Partikelmassenoffset durch Additiv" MAP 0xF4D26 Kf_Xs16_Ys16_Ws16 25.00000 Res_hPaHrPerCM 0.00 25.00000 FORMAT "%8.5" EXTENDED_LIMITS -32.76800 32.76700
 /begin AXIS_DESCR STD_AXIS PFlt_tSurfCrvIn_mp Temp_Cels 8 -50.140 899.860 FORMAT "%8.3" EXTENDED_LIMITS -3549.940 3003.560 DEPOSIT ABSOLUTE /end AXIS_DESCR
 /begin AXIS_DESCR STD_AXIS PFlt_volAsh_mp Vol 8 0.00 100.0000 FORMAT "%8.4" EXTENDED_LIMITS -327.6800 327.6700 DEPOSIT ABSOLUTE /end AXIS_DESCR
/end CHARACTERISTIC
/begin CHARACTERISTIC PFlt_resFlowPhysMax_C "Partikelfiltervolumen" VALUE 0xF4DCA Kw_Ws16 25.00000 Res_hPaHrPerCM 0.00 25.00000 FORMAT "%8.5" EXTENDED_LIMITS -32.76800 32.76700 /end CHARACTERISTIC
/begin CHARACTERISTIC PFlt_resFlowPrivCanSubs_C "Ersatzwert bei ungültigem Strömungswiderstand" VALUE 0xF4DCC Kw_Ws16 25.00000 Res_hPaHrPerCM 0.00 25.00000 FORMAT "%8.5" EXTENDED_LIMITS -32.76800 32.76700 /end CHARACTERISTIC
/begin CHARACTERISTIC PFlt_resFlowRawInit_C "" VALUE 0xF4DCE Kw_Ws16 25.00000 Res_hPaHrPerCM 0.00 25.00000 FORMAT "%8.5" EXTENDED_LIMITS -32.76800 32.76700 /end CHARACTERISTIC
/begin CHARACTERISTIC PFlt_resFlow_MAP "Strömungswiderstand als Funktion von Abgasvolumsstrom und Differenzdruck" MAP 0xF4DD0 Kf_Xs16_Ys16_Ws16 25.00000 Res_hPaHrPerCM 0.00 25.00000 FORMAT "%8.5" EXTENDED_LIMITS -32.76800 32.76700
 /begin AXIS_DESCR STD_AXIS PFlt_dvol_mp CubMtrPerHr 8 0.00 3000.000 FORMAT "%8.3" EXTENDED_LIMITS -3276.800 3276.700 DEPOSIT ABSOLUTE /end AXIS_DESCR
 /begin AXIS_DESCR STD_AXIS PFlt_pDiffSot_mp Pres_hPa 8 0.00 3500.000 FORMAT "%8.3" EXTENDED_LIMITS -32768.00 32767.00 DEPOSIT ABSOLUTE /end AXIS_DESCR
/end CHARACTERISTIC
/begin CHARACTERISTIC PFlt_resFlow_Vector "Konfigurationslabel für Bypass" VALUE 0xC39B0 Kw_Wu8 255.0 OneToOne 0.00 255.0 FORMAT "%5.1" /end CHARACTERISTIC
/begin CHARACTERISTIC PFlt_resFlow_Channel "Konfigurationslabels für Bypass" VALUE 0xC39B1 Kw_Wu8 255.0 OneToOne 0.00 255.0 FORMAT "%5.1" /end CHARACTERISTIC
/begin CHARACTERISTIC PFlt_rHCCondMax_C "Schwellwert für das Verhältnis zwischen HC Konditionierungszeit und der MOtorbetriebszeit seit der ersten HC Regeneration" VALUE 0xF2C76 Kw_Ws16 799.9878 Prc -400.0000 399.9878 FORMAT "%8.4" /end CHARACTERISTIC
/begin CHARACTERISTIC PFlt_rLmbdStat_MAP "Stationäter Lambdawert in Abhängigkeit des Motorbetriebspunktes" MAP 0xF4E74 Kf_Xs16_Ys16_Ws16 30.00000 lambda 0.00 30.00000 FORMAT "%8.5" EXTENDED_LIMITS -32.76800 32.76700
 /begin AXIS_DESCR STD_AXIS Eng_nAvrg EngN 16 40.00000 6000.000 FORMAT "%8.3" EXTENDED_LIMITS -32768.00 32767.00 DEPOSIT ABSOLUTE /end AXIS_DESCR
 /begin AXIS_DESCR STD_AXIS InjCtl_qSetUnBal InjMassCyc 16 0.00 327.6700 FORMAT "%8.4" EXTENDED_LIMITS -327.6800 327.6700 DEPOSIT ABSOLUTE /end AXIS_DESCR
/end CHARACTERISTIC
/begin CHARACTERISTIC PFlt_stDiagOn_C "Applikation konstant Regeneration manuell beginnen" VALUE 0xF33E8 Kw_Wu8 255.0 OneToOne 0.00 255.0 FORMAT "%5.1" /end CHARACTERISTIC
/begin CHARACTERISTIC PFlt_stEngPOp_Vector "Konfigurationslabel für Bypass" VALUE 0xC39A2 Kw_Wu8 255.0 OneToOne 0.00 255.0 FORMAT "%5.1" /end CHARACTERISTIC
/begin CHARACTERISTIC PFlt_stEngPOp_Channel "Konfigurationslabel für Bypass" VALUE 0xC39A3 Kw_Wu8 255.0 OneToOne 0.00 255.0 FORMAT "%5.1" /end CHARACTERISTIC
/begin CHARACTERISTIC PFlt_stGearDebValMax_C "Maximaler Gang für Entprellfunktion" VALUE 0xF3700 Kw_Ws8 7.000 OneToOne -1.000 6.000 FORMAT "%5.3" EXTENDED_LIMITS -128.0 127.0 /end CHARACTERISTIC
/begin CHARACTERISTIC PFlt_stGearDebValMin_C "Minimaler Gang der Entprellfunktion" VALUE 0xF3701 Kw_Ws8 7.000 OneToOne -1.000 6.000 FORMAT "%5.3" EXTENDED_LIMITS -128.0 127.0 /end CHARACTERISTIC
/begin CHARACTERISTIC PFlt_stGearMinMax_CA "Matrix zur Bestimmung der Bereichsgrenzen für den eingelegten Gang" MAP 0xF3702 Kf_Xs16_Ys16_Ws16 7.000000 OneToOne -1.000000 6.000000 FORMAT "%8.6" EXTENDED_LIMITS -32768.00 32767.00
 /begin AXIS_DESCR STD_AXIS PFlt_RngIdx_X_mp OneToOne 11 0.00 10.00 FORMAT "%5.2" EXTENDED_LIMITS 0.00 255.0 DEPOSIT ABSOLUTE /end AXIS_DESCR
 /begin AXIS_DESCR STD_AXIS PFlt_RngIdx_Y_mp OneToOne 2 0.00 1.000 FORMAT "%5.3" EXTENDED_LIMITS 0.00 255.0 DEPOSIT ABSOLUTE /end AXIS_DESCR
/end CHARACTERISTIC
/begin CHARACTERISTIC PFlt_stHCCondPrt_C "Wert der Message PFlt_numHCCond der verwendet wird, wenn das Verhältnis die Grenze überschreitet." VALUE 0xF2C78 Kw_Wu8 255.0 OneToOne 0.00 255.0 FORMAT "%5.1" /end CHARACTERISTIC
/begin CHARACTERISTIC PFlt_stLckFuelMsk_C "Maske Für EGT_st" VALUE 0xF33EA Kw_Wu16 65535.00 OneToOne 0.00 65535.00 FORMAT "%8.2" /end CHARACTERISTIC
/begin CHARACTERISTIC PFlt_stLckRgnMsk_C "Maske für Blockierung und Freigabe der Regeneration" VALUE 0xF33EC Kw_Wu32 4294967295.00 OneToOne 0.00 4294967295.00 FORMAT "%13.2" /end CHARACTERISTIC
/begin CHARACTERISTIC PFlt_stMinDistRgn_C "Maske zur Aktivierung des Regenerationsabbruchs bei niedrigen Anforderungen" VALUE 0xF33F0 Kw_Wu16 65535.00 OneToOne 0.00 65535.00 FORMAT "%8.2" /end CHARACTERISTIC
/begin CHARACTERISTIC PFlt_stMSotResRgnMskB1_C "Maske zur Definition relevanter Regenerationszustände  Bank 1" VALUE 0xF50B8 Kw_Wu32 4294967295.00 OneToOne 0.00 4294967295.00 FORMAT "%13.2" /end CHARACTERISTIC
/begin CHARACTERISTIC PFlt_stMSotResRgnMskB2_C "Maske zur Definition relevanter Regenerationszustände  Bank 2" VALUE 0xF50BC Kw_Wu32 4294967295.00 OneToOne 0.00 4294967295.00 FORMAT "%13.2" /end CHARACTERISTIC
/begin CHARACTERISTIC PFlt_stPrivCanSubs_C "" VALUE 0xF33F2 Kw_Wu16 65535.00 OneToOne 0.00 65535.00 FORMAT "%8.2" /end CHARACTERISTIC
/begin CHARACTERISTIC PFlt_stResFlowPT1RgnMskB1_C "Mask für Bestimmung Regenerationsrelevante Zustand(Bank1)" VALUE 0xF50C0 Kw_Wu32 4294967295.00 OneToOne 0.00 4294967295.00 FORMAT "%13.2" /end CHARACTERISTIC
/begin CHARACTERISTIC PFlt_stResFlowPT1RgnMskB2_C "Mask für Bestimmung Regenerationsrelevante Zustand(Bank2)" VALUE 0xF50C4 Kw_Wu32 4294967295.00 OneToOne 0.00 4294967295.00 FORMAT "%13.2" /end CHARACTERISTIC
/begin CHARACTERISTIC PFlt_stRgnActvMskB1_C "Regenerationsmask für Bank1" VALUE 0xF33F4 Kw_Wu32 4294967295.00 OneToOne 0.00 4294967295.00 FORMAT "%13.2" /end CHARACTERISTIC
/begin CHARACTERISTIC PFlt_stRgnActvMskB2_C "Regenerationsmask für Bank2" VALUE 0xF33F8 Kw_Wu32 4294967295.00 OneToOne 0.00 4294967295.00 FORMAT "%13.2" /end CHARACTERISTIC
/begin CHARACTERISTIC PFlt_stRgnNoComplSubs_C "Ersatzwert für nicht vollständige regeneration" VALUE 0xF33FC Kw_Wu8 255.0 OneToOne 0.00 255.0 FORMAT "%5.1" /end CHARACTERISTIC
/begin CHARACTERISTIC PFlt_stRgnStg1_C "PFlt_st im Fall Regenerationsstate 1" VALUE 0xF3400 Kw_Wu32 4294967295.00 OneToOne 0.00 4294967295.00 FORMAT "%13.2" /end CHARACTERISTIC
/begin CHARACTERISTIC PFlt_stRgnStg2_C "PFlt_st im Fall Regenerationsstate 2" VALUE 0xF3404 Kw_Wu32 4294967295.00 OneToOne 0.00 4294967295.00 FORMAT "%13.2" /end CHARACTERISTIC
/begin CHARACTERISTIC PFlt_stRgnStg3_C "PFlt_st im Fall Regenerationsstate 3" VALUE 0xF3408 Kw_Wu32 4294967295.00 OneToOne 0.00 4294967295.00 FORMAT "%13.2" /end CHARACTERISTIC
/begin CHARACTERISTIC PFlt_stRgnStg4_C "PFlt_st im Fall Regenerationsstate 4" VALUE 0xF340C Kw_Wu32 4294967295.00 OneToOne 0.00 4294967295.00 FORMAT "%13.2" /end CHARACTERISTIC
/begin CHARACTERISTIC PFlt_stRgnStg5_C "PFlt_st im Fall Regenerationsstate 5" VALUE 0xF3410 Kw_Wu32 4294967295.00 OneToOne 0.00 4294967295.00 FORMAT "%13.2" /end CHARACTERISTIC
/begin CHARACTERISTIC PFlt_stRgnStg6_C "Maßnahmenbitwort Regenerationsstufe 6" VALUE 0xF3414 Kw_Wu32 4294967295.00 OneToOne 0.00 4294967295.00 FORMAT "%13.2" /end CHARACTERISTIC
/begin CHARACTERISTIC PFlt_stRgnSucMsk_C "Maske zur Deaktivierung der erfolgreichen Regenerationserkennung" VALUE 0xF3418 Kw_Wu16 65535.00 OneToOne 0.00 65535.00 FORMAT "%8.2" /end CHARACTERISTIC
/begin CHARACTERISTIC PFlt_stSimRgnMskB1_C "Maske zur Deaktivierung der Partikelmassen-Berechnung in definierten Regenerationszuständen(Bank1)" VALUE 0xF50C8 Kw_Wu32 4294967295.00 OneToOne 0.00 4294967295.00 FORMAT "%13.2" /end CHARACTERISTIC
/begin CHARACTERISTIC PFlt_stSimRgnMskB2_C "Maske zur Deaktivierung der Partikelmassen-Berechnung in definierten Regenerationszuständen(Bank2)" VALUE 0xF50CC Kw_Wu32 4294967295.00 OneToOne 0.00 4294967295.00 FORMAT "%13.2" /end CHARACTERISTIC
/begin CHARACTERISTIC PFlt_stSotSimInitEngPMsk_C "mask to select desired PFlt_numEngPOp numbers" VALUE 0xF525A Kw_Wu16 65535.00 OneToOne 0.00 65535.00 FORMAT "%8.2" /end CHARACTERISTIC
/begin CHARACTERISTIC PFlt_stSotSimInitRgnMsk_C "Schablone zum Vorwählen gewünschte PFlt_numRgn Zahlen" VALUE 0xF525C Kw_Wu16 65535.00 OneToOne 0.00 65535.00 FORMAT "%8.2" /end CHARACTERISTIC
/begin CHARACTERISTIC PFlt_stSotSimInitTotMsk_C "Schablone zum Vorwählen gewünschte PFlt_numTot Zahlen" VALUE 0xF525E Kw_Wu16 65535.00 OneToOne 0.00 65535.00 FORMAT "%8.2" /end CHARACTERISTIC
/begin CHARACTERISTIC PFlt_stWaitForOvrRun_C "Regenerationsanforderungszahl fur PFlt_numTot_mp FREEZE" VALUE 0xF341A Kw_Wu16 65535.00 OneToOne 0.00 65535.00 FORMAT "%8.2" /end CHARACTERISTIC
/begin CHARACTERISTIC PFlt_st_Vector "Konfigurationslabel für Bypass" VALUE 0xC39A0 Kw_Wu8 255.0 OneToOne 0.00 255.0 FORMAT "%5.1" /end CHARACTERISTIC
/begin CHARACTERISTIC PFlt_st_Channel "Konfigurationslabels für Bypass" VALUE 0xC39A1 Kw_Wu8 255.0 OneToOne 0.00 255.0 FORMAT "%5.1" /end CHARACTERISTIC
/begin CHARACTERISTIC PFlt_swtAshCorActive_C "generelle Aktivierung der Ascheabgleich-Funktion (1=Funktion aktiv, 0=Inaktiev)" VALUE 0xF2B2A Kw_Wu8 1.000 OneToOne 0.00 1.000 FORMAT "%5.3" EXTENDED_LIMITS 0.00 255.0 /end CHARACTERISTIC
/begin CHARACTERISTIC PFlt_swtAshCorOn_C "Statusschwelle Aschekorrektur (1: Regneration erkannt, Ascheabgleichtimer gestrted; 0: keine Regeneration erkannt)" VALUE 0xF2B2B Kw_Wu8 4.000 OneToOne 0.00 4.000 FORMAT "%5.3" EXTENDED_LIMITS 0.00 255.0 /end CHARACTERISTIC
/begin CHARACTERISTIC PFlt_swtAshCor_C "Schalter für Beladungsmodellgrenzen-Korrektion" VALUE 0xF341C Kw_Wu8 1.000 OneToOne 0.00 1.000 FORMAT "%5.3" EXTENDED_LIMITS 0.00 255.0 /end CHARACTERISTIC
/begin CHARACTERISTIC PFlt_swtASModOn_C "Schalter für Luftmassenstromsignal (0: HFM oder 1: ASMod)" VALUE 0xF3A2F Kw_Wu8 1.000 OneToOne 0.00 1.000 FORMAT "%5.3" EXTENDED_LIMITS 0.00 255.0 /end CHARACTERISTIC
/begin CHARACTERISTIC PFlt_swtBrkRng_CA "Zur Bestimmung der Bereichswerte für das entprellte Bremssignal (0: normales, 1: invertiertes Signal, 2: Signal nicht verwendet)" VAL_BLK 0xF374C Kwb_Wu8 2.000 OneToOne 0.00 2.000 FORMAT "%5.3" EXTENDED_LIMITS 0.00 255.0 NUMBER 11 /end CHARACTERISTIC
/begin CHARACTERISTIC PFlt_swtClthRng_CA "Zur Bestimmung der Bereichswerte für das entprellte Kupplungssignal (0: normales, 1: invertiertes, 2: kein Signal verwendet)" VAL_BLK 0xF3757 Kwb_Wu8 2.000 OneToOne 0.00 2.000 FORMAT "%5.3" EXTENDED_LIMITS 0.00 255.0 NUMBER 11 /end CHARACTERISTIC
/begin CHARACTERISTIC PFlt_swtDiagOn_C "Schalten Regeneration manuell beginnen (1: manuell gestarted, 0: nicht manuell gestarted)" VALUE 0xF341D Kw_Wu8 255.0 OneToOne 0.00 255.0 FORMAT "%5.1" /end CHARACTERISTIC
/begin CHARACTERISTIC PFlt_swtEngPrtAshCor_C "" VALUE 0xF341E Kw_Wu8 1.000 OneToOne 0.00 1.000 FORMAT "%5.3" EXTENDED_LIMITS 0.00 255.0 /end CHARACTERISTIC
/begin CHARACTERISTIC PFlt_swtFlowVal_C "Auswahlschalter für Abgasstrom zur Differenzdruckermittlung des leeren Partikelfilters" VALUE 0xF50D0 Kw_Wu8 1.000 OneToOne 0.00 1.000 FORMAT "%5.3" EXTENDED_LIMITS 0.00 255.0 /end CHARACTERISTIC
/begin CHARACTERISTIC PFlt_swtLmbdAprx_C "Mess- oder Simulationssignal für Lambda-Messung (1: Simulation, 0: Messsignal)" VALUE 0xF3A30 Kw_Wu8 1.000 OneToOne 0.00 1.000 FORMAT "%5.3" EXTENDED_LIMITS 0.00 255.0 /end CHARACTERISTIC
/begin CHARACTERISTIC PFlt_swtMSotRes_C "Schalter zur Auswahl der Abschätzung der Restrussmasse im Partikelfilter nach erfolgreicher Regeneration" VALUE 0xF50D1 Kw_Wu8 1.000 OneToOne 0.00 1.000 FORMAT "%5.3" EXTENDED_LIMITS 0.00 255.0 /end CHARACTERISTIC
/begin CHARACTERISTIC PFlt_swtNeutrResFlow_C "Schalter zur Berechnung des neutralen Wertes durch EGT_CoordSwt()" VALUE 0xF50D2 Kw_Wu8 255.0 OneToOne 0.00 255.0 FORMAT "%5.1" /end CHARACTERISTIC
/begin CHARACTERISTIC PFlt_swtOfsCor_C "Schalter zur Abschaltung der Offsetkorrektur im Zustandautomat (1: aus, 0: ein)" VALUE 0xF341F Kw_Wu8 1.000 OneToOne 0.00 1.000 FORMAT "%5.3" EXTENDED_LIMITS 0.00 255.0 /end CHARACTERISTIC
/begin CHARACTERISTIC PFlt_swtOilAsh_C "Auswahlschalter für Korrelationsmethode des Ölasche-Eintrages in den Partikelfilter" VALUE 0xF50D3 Kw_Wu8 1.000 OneToOne 0.00 1.000 FORMAT "%5.3" EXTENDED_LIMITS 0.00 255.0 /end CHARACTERISTIC
/begin CHARACTERISTIC PFlt_swtPresResFlowSel_C "" VALUE 0xF3420 Kw_Wu8 1.000 OneToOne 0.00 1.000 FORMAT "%5.3" EXTENDED_LIMITS 0.00 255.0 /end CHARACTERISTIC
/begin CHARACTERISTIC PFlt_swtSensEvalSel_C "SW-Schalter Strömungswdst aus 1: Division oder 0: Kennfeld" VALUE 0xF50D4 Kw_Wu8 1.000 OneToOne 0.00 1.000 FORMAT "%5.3" EXTENDED_LIMITS 0.00 255.0 /end CHARACTERISTIC
/begin CHARACTERISTIC PFlt_swtServiceValB1_C "Serviceschalter zum Zurücksetzen nach Partikelfilteraustausch bank 1" VALUE 0xF50D5 Kw_Wu8 255.0 OneToOne 0.00 255.0 FORMAT "%5.1" /end CHARACTERISTIC
/begin CHARACTERISTIC PFlt_swtServiceValB2_C "Serviceschalter zum Zurücksetzen nach Partikelfilteraustausch bank 2" VALUE 0xF50D6 Kw_Wu8 255.0 OneToOne 0.00 255.0 FORMAT "%5.1" /end CHARACTERISTIC
/begin CHARACTERISTIC PFlt_swtServiceVal_C "Serviceschalter zum Zurücksetzen nach Partikelfilteraustausch (1: Reset, 0: liest Werte aus EEPROM)" VALUE 0xF3421 Kw_Wu8 255.0 OneToOne 0.00 255.0 FORMAT "%5.1" /end CHARACTERISTIC
/begin CHARACTERISTIC Pflt_swtShOffSuc_C "Regenerationsabschaltung" VALUE 0xF3422 Kw_Wu8 255.0 OneToOne 0.00 255.0 FORMAT "%5.1" /end CHARACTERISTIC
/begin CHARACTERISTIC PFlt_swtSimInitOn_C "Schalter zur Initialisierung des Russpartikelmassenintegrators (1...initialisierung, 0...keine initialisierung)" VALUE 0xF50D7 Kw_Wu8 1.000 OneToOne 0.00 1.000 FORMAT "%5.3" EXTENDED_LIMITS 0.00 255.0 /end CHARACTERISTIC
/begin CHARACTERISTIC PFlt_swtSotCalcInitOff_C "Schalter zur Deaktivierung der Initialisierung des PT1-Filters für den Strömungswiderstand" VALUE 0xF50D8 Kw_Wu8 1.000 OneToOne 0.00 1.000 FORMAT "%5.3" EXTENDED_LIMITS 0.00 255.0 /end CHARACTERISTIC
/begin CHARACTERISTIC PFlt_swtSotSimContOn_C "Schalter zur Auswahl der simulierte Russmasse für Russmassenberechnung im Partikelfilter" VALUE 0xF50D9 Kw_Wu8 1.000 OneToOne 0.00 1.000 FORMAT "%5.3" EXTENDED_LIMITS 0.00 255.0 /end CHARACTERISTIC
/begin CHARACTERISTIC PFlt_swtSotSimInit_C "Switch für Umschaltung Restrußberechnung/Initialsierung." VALUE 0xF5260 Kw_Wu8 255.0 OneToOne 0.00 255.0 FORMAT "%5.1" /end CHARACTERISTIC
/begin CHARACTERISTIC PFlt_swtTmrLckRst_C "Schalter zum Rücksetzen des EEPROM Wertes der Sperrzeit (1: Reset, 0: kein Reset)" VALUE 0xF3423 Kw_Wu8 255.0 OneToOne 0.00 255.0 FORMAT "%5.1" /end CHARACTERISTIC
/begin CHARACTERISTIC PFlt_tAirFltAshCorMax_C "maximal zulässiger Wert Lufttemperatur" VALUE 0xF2B2C Kw_Ws16 250.0000 Temp_Cels -50.14000 199.8600 FORMAT "%8.4" EXTENDED_LIMITS -3549.940 3003.560 /end CHARACTERISTIC
/begin CHARACTERISTIC PFlt_tAirFltAshCorMin_C "minimal zulässiger Wert Lufttemperatur" VALUE 0xF2B2E Kw_Ws16 250.0000 Temp_Cels -50.14000 199.8600 FORMAT "%8.4" EXTENDED_LIMITS -3549.940 3003.560 /end CHARACTERISTIC
/begin CHARACTERISTIC PFlt_tAirMinMax_CA "Matrix zur Bestimmung der Bereichsgrenzen für die Ansauglufttemperatur" MAP 0xF3762 Kf_Xs16_Ys16_Ws16 250.0000 Temp_Cels -50.14000 199.8600 FORMAT "%8.4" EXTENDED_LIMITS -3549.940 3003.560
 /begin AXIS_DESCR STD_AXIS PFlt_RngIdx_X_mp OneToOne 11 0.00 10.00 FORMAT "%5.2" EXTENDED_LIMITS 0.00 255.0 DEPOSIT ABSOLUTE /end AXIS_DESCR
 /begin AXIS_DESCR STD_AXIS PFlt_RngIdx_Y_mp OneToOne 2 0.00 1.000 FORMAT "%5.3" EXTENDED_LIMITS 0.00 255.0 DEPOSIT ABSOLUTE /end AXIS_DESCR
/end CHARACTERISTIC
/begin CHARACTERISTIC PFlt_tCIntAshCorMax_C "maximal zulässiger Wert Kühlmitteltemperatur" VALUE 0xF2B30 Kw_Ws16 250.0000 Temp_Cels -50.14000 199.8600 FORMAT "%8.4" EXTENDED_LIMITS -3549.940 3003.560 /end CHARACTERISTIC
/begin CHARACTERISTIC PFlt_tCIntAshCorMin_C "minimal zulässiger Wert Kühlmitteltemperatur" VALUE 0xF2B32 Kw_Ws16 250.0000 Temp_Cels -50.14000 199.8600 FORMAT "%8.4" EXTENDED_LIMITS -3549.940 3003.560 /end CHARACTERISTIC
/begin CHARACTERISTIC PFlt_tClntMinMax_CA "Matrix zur Bestimmung der Bereichsgrenzen für die gefilterte Temperatur der Kühlflüssigkeit" MAP 0xF37AC Kf_Xs16_Ys16_Ws16 250.0000 Temp_Cels -50.14000 199.8600 FORMAT "%8.4" EXTENDED_LIMITS -3549.940 3003.560
 /begin AXIS_DESCR STD_AXIS PFlt_RngIdx_X_mp OneToOne 11 0.00 10.00 FORMAT "%5.2" EXTENDED_LIMITS 0.00 255.0 DEPOSIT ABSOLUTE /end AXIS_DESCR
 /begin AXIS_DESCR STD_AXIS PFlt_RngIdx_Y_mp OneToOne 2 0.00 1.000 FORMAT "%5.3" EXTENDED_LIMITS 0.00 255.0 DEPOSIT ABSOLUTE /end AXIS_DESCR
/end CHARACTERISTIC
/begin CHARACTERISTIC PFlt_tDltTempOxiPreTwFlw_C "Maximale Temperaturdifferenz zwischen den Abgasfluten vor Oxi-Katalysator" VALUE 0xF3424 Kw_Ws16 100.0000 TempDiff_Cels 0.00 100.0000 FORMAT "%8.4" EXTENDED_LIMITS -3276.800 3276.700 /end CHARACTERISTIC
/begin CHARACTERISTIC PFlt_tDltTempPreTwFlw_C "Maximale Temperaturdifferenz zwischen den Abgasfluten vor DPF" VALUE 0xF3426 Kw_Ws16 100.0000 TempDiff_Cels 0.00 100.0000 FORMAT "%8.4" EXTENDED_LIMITS -3276.800 3276.700 /end CHARACTERISTIC
/begin CHARACTERISTIC PFlt_tiAccPedPT1_C "Filterzeitkonst. für Pedalwertgeber PT1 Filter" VALUE 0xF37F8 Kw_Wu32 4294.9673 TimeDelay_s 0.0000010000000 4294.9673 FORMAT "%9.4" /end CHARACTERISTIC
/begin CHARACTERISTIC PFlt_tiAshCorAirTempPT1_C "Zeitkonstante Lufttemperatur" VALUE 0xF2B34 Kw_Wu32 4294.8273 TimeDelay_s 0.14000154 4294.9673 FORMAT "%9.4" EXTENDED_LIMITS 0.0000010000000 4294.9673 /end CHARACTERISTIC
/begin CHARACTERISTIC PFlt_tiAshCorCIntTempPT1_C "Zeitkonstante Kühlmitteltemperatur" VALUE 0xF2B38 Kw_Wu32 4294.8273 TimeDelay_s 0.14000154 4294.9673 FORMAT "%9.4" EXTENDED_LIMITS 0.0000010000000 4294.9673 /end CHARACTERISTIC
/begin CHARACTERISTIC PFlt_tiAshCorDVolPT1_C "Zeitkonstante Abgasvolumenstrom vor PFlt" VALUE 0xF2B3C Kw_Wu32 4294.8273 TimeDelay_s 0.14000154 4294.9673 FORMAT "%9.4" EXTENDED_LIMITS 0.0000010000000 4294.9673 /end CHARACTERISTIC
/begin CHARACTERISTIC PFlt_tiAshCorEngSpdPT1_C "Zeitkonstante Drehzahl" VALUE 0xF2B40 Kw_Wu32 4294.8273 TimeDelay_s 0.14000154 4294.9673 FORMAT "%9.4" EXTENDED_LIMITS 0.0000010000000 4294.9673 /end CHARACTERISTIC
/begin CHARACTERISTIC PFlt_tiAshCorInjMsPT1_C "Zeitkonstante aktuelle Einspritzmasse" VALUE 0xF2B44 Kw_Wu32 4294.8273 TimeDelay_s 0.14000154 4294.9673 FORMAT "%9.4" EXTENDED_LIMITS 0.0000010000000 4294.9673 /end CHARACTERISTIC
/begin CHARACTERISTIC PFlt_tiAshCorOxiTempPT1_C "Zeitkonstante OxiKat-Temperatur" VALUE 0xF2B48 Kw_Wu32 4294.8273 TimeDelay_s 0.14000154 4294.9673 FORMAT "%9.4" EXTENDED_LIMITS 0.0000010000000 4294.9673 /end CHARACTERISTIC
/begin CHARACTERISTIC PFlt_tiAshCorPreTempPT1_C "Zeitkonstante Vortemperatur Partikelfilter" VALUE 0xF2B4C Kw_Wu32 4294.8273 TimeDelay_s 0.14000154 4294.9673 FORMAT "%9.4" EXTENDED_LIMITS 0.0000010000000 4294.9673 /end CHARACTERISTIC
/begin CHARACTERISTIC PFlt_tiAshCorResFlowPT1_C "Zeitkonstante gefilterter Stromwiderstand" VALUE 0xF2B50 Kw_Wu32 4294.8273 TimeDelay_s 0.14000154 4294.9673 FORMAT "%9.4" EXTENDED_LIMITS 0.0000010000000 4294.9673 /end CHARACTERISTIC
/begin CHARACTERISTIC PFlt_tiAshCorRlsOn_C "Entprellzeit Simulation EIN" VALUE 0xF2B54 Kw_Wu16 655140.0 Time_ms 0.00 655140.0 FORMAT "%8.1" EXTENDED_LIMITS 0.00 655350.0 /end CHARACTERISTIC
/begin CHARACTERISTIC PFlt_tiAshCorStSucB1B2_C "Maximale Zeit zwischen erfolgreichen Regenerationen in zwei Bänken" VALUE 0xF2B58 Kw_Wu32 42949672.9500 Time_s 0.00 42949672.9500 FORMAT "%13.4" /end CHARACTERISTIC
/begin CHARACTERISTIC PFlt_tiAshCorVehAccPT1_C "Zeitkonstante Fahrzeugbeschleunigung" VALUE 0xF2B5C Kw_Wu32 4294.8273 TimeDelay_s 0.14000154 4294.9673 FORMAT "%9.4" EXTENDED_LIMITS 0.0000010000000 4294.9673 /end CHARACTERISTIC
/begin CHARACTERISTIC PFlt_tiAshCorVehSpdPT1_C "Zeitkonstante Fahrzeuggeschwindigkeit" VALUE 0xF2B60 Kw_Wu32 4294.8273 TimeDelay_s 0.14000154 4294.9673 FORMAT "%9.4" EXTENDED_LIMITS 0.0000010000000 4294.9673 /end CHARACTERISTIC
/begin CHARACTERISTIC PFlt_tiAshCorWaitMax_C "Regenerationsdauer" VALUE 0xF2B64 Kw_Wu32 655140.000000 Time_s 0.00 655140.000000 FORMAT "%13.6" EXTENDED_LIMITS 0.00 42949672.9500 /end CHARACTERISTIC
/begin CHARACTERISTIC PFlt_tiBattCDPT1_C "Zeitkonstante für Batteriespannung" VALUE 0xF37FC Kw_Wu32 4294.9673 TimeDelay_s 0.0000010000000 4294.9673 FORMAT "%9.4" /end CHARACTERISTIC
/begin CHARACTERISTIC PFlt_tiDebBrkOff_C "Entprellzeit Bremse aus" VALUE 0xF3800 Kw_Wu16 3000.000 TimeDeb 0.00 3000.000 FORMAT "%8.3" EXTENDED_LIMITS 0.00 655350.0 /end CHARACTERISTIC
/begin CHARACTERISTIC PFlt_tiDebBrkOn_C "Entprellzeit Bremse an" VALUE 0xF3802 Kw_Wu16 3000.000 TimeDeb 0.00 3000.000 FORMAT "%8.3" EXTENDED_LIMITS 0.00 655350.0 /end CHARACTERISTIC
/begin CHARACTERISTIC PFlt_tiDebConvOff_C "Entprellzeit Kupplung aus" VALUE 0xF3804 Kw_Wu16 3000.000 TimeDeb 0.00 3000.000 FORMAT "%8.3" EXTENDED_LIMITS 0.00 655350.0 /end CHARACTERISTIC
/begin CHARACTERISTIC PFlt_tiDebConvOn_C "Entprellzeit Kupplung an" VALUE 0xF3806 Kw_Wu16 3000.000 TimeDeb 0.00 3000.000 FORMAT "%8.3" EXTENDED_LIMITS 0.00 655350.0 /end CHARACTERISTIC
/begin CHARACTERISTIC PFlt_tiDebDVol_C "Entprellzeit bei Empfang ungültigem Abgasvolumenstrom" VALUE 0xF3A32 Kw_Wu16 655.3500 Time_s 0.00 655.3500 FORMAT "%8.4" /end CHARACTERISTIC
/begin CHARACTERISTIC PFlt_tiDebFuelMin_C "Entprellzeit Regenerationsunterbrechung Tankfüllstand" VALUE 0xF3428 Kw_Wu16 655350.0 TimeDeb 0.00 655350.0 FORMAT "%8.1" /end CHARACTERISTIC
/begin CHARACTERISTIC PFlt_tiDebGearOff_C "Entprellungszeit für die Freigabe des Gangsignales" VALUE 0xF3808 Kw_Wu16 3000.000 TimeDeb 0.00 3000.000 FORMAT "%8.3" EXTENDED_LIMITS 0.00 655350.0 /end CHARACTERISTIC
/begin CHARACTERISTIC PFlt_tiDebGearOn_C "Entprellungszeit für Setzen des Gangsignals" VALUE 0xF380A Kw_Wu16 3000.000 TimeDeb 0.00 3000.000 FORMAT "%8.3" EXTENDED_LIMITS 0.00 655350.0 /end CHARACTERISTIC
/begin CHARACTERISTIC PFlt_tiDebHCCondPrtHeal_C "Entprellzeit zur erkennung hoher MOtorlast" VALUE 0xF2C7A Kw_Wu16 10000.00 Time_ms 0.00 10000.00 FORMAT "%8.2" EXTENDED_LIMITS 0.00 655350.0 /end CHARACTERISTIC
/begin CHARACTERISTIC PFlt_tiDebLck_C "Entprellzeit für Timer der maximalen Regenerationszeit" VALUE 0xF342A Kw_Wu16 120.0000 TimeDeb 0.00 120.0000 FORMAT "%8.4" EXTENDED_LIMITS 0.00 655350.0 /end CHARACTERISTIC
/begin CHARACTERISTIC PFlt_tiDebQLimErrIntr_C "Entprellzeit für Regenerationsunterbrechung wegen Mengenbegrenzung" VALUE 0xF342C Kw_Wu16 655350.0 TimeDeb 0.00 655350.0 FORMAT "%8.1" /end CHARACTERISTIC
/begin CHARACTERISTIC PFlt_tiDebResFlow_C "Entprellzeit bei Empfang ungültigem Strömungswiderstand" VALUE 0xF50DA Kw_Wu16 655.3500 Time_s 0.00 655.3500 FORMAT "%8.4" /end CHARACTERISTIC
/begin CHARACTERISTIC PFlt_tiDebSimOff_C "Entprellzeit Umschaltung Simulation/Messung" VALUE 0xF50DC Kw_Wu16 20.00000 TimeDeb 0.00 20.00000 FORMAT "%8.5" EXTENDED_LIMITS 0.00 655350.0 /end CHARACTERISTIC
/begin CHARACTERISTIC PFlt_tiDebSimOn_C "Entprellzeit Umschaltung Messung/ Simulation" VALUE 0xF50DE Kw_Wu16 20.00000 TimeDeb 0.00 20.00000 FORMAT "%8.5" EXTENDED_LIMITS 0.00 655350.0 /end CHARACTERISTIC
/begin CHARACTERISTIC PFlt_tiDebst_C "Entprellzeit bei Empfang ungültigem Regenerationsstatus" VALUE 0xF342E Kw_Wu16 655.3500 Time_s 0.00 655.3500 FORMAT "%8.4" /end CHARACTERISTIC
/begin CHARACTERISTIC PFlt_DebDltOxiPreMaxDef_C "Entprellzeit für Temperaturdifferenz Fehlerbehandlung der Temperaturen vor Oxidationskatalisator" VALUE 0xF3430 Kw_Wu16 1000.000 Time_ms 0.00 1000.000 FORMAT "%8.3" EXTENDED_LIMITS 0.00 655350.0 /end CHARACTERISTIC
/begin CHARACTERISTIC PFlt_DebDltOxiPreMaxOk_C "Entprellzeit für Abgastemperatur-Abweichungsfehler" VALUE 0xF3432 Kw_Wu16 1000.000 Time_ms 0.00 1000.000 FORMAT "%8.3" EXTENDED_LIMITS 0.00 655350.0 /end CHARACTERISTIC
/begin CHARACTERISTIC PFlt_DebDltPreMaxDef_C "Entprellzeit für Abgastemperatur-Abweichungsfehler" VALUE 0xF3434 Kw_Wu16 1000.000 Time_ms 0.00 1000.000 FORMAT "%8.3" EXTENDED_LIMITS 0.00 655350.0 /end CHARACTERISTIC
/begin CHARACTERISTIC PFlt_DebDltPreMaxOk_C "Entprellzeit für Abgastemperatur-Abweichungsfehler" VALUE 0xF3436 Kw_Wu16 1000.000 Time_ms 0.00 1000.000 FORMAT "%8.3" EXTENDED_LIMITS 0.00 655350.0 /end CHARACTERISTIC
/begin CHARACTERISTIC PFlt_tiDebTrqOvhtIntr_C "Entprellzeit für Regenerationsunterbrechung wegen Überhitzungsschutz" VALUE 0xF3438 Kw_Wu16 655350.0 TimeDeb 0.00 655350.0 FORMAT "%8.1" /end CHARACTERISTIC
/begin CHARACTERISTIC PFlt_tiEngOnMaxDef_C "maximale Motorbetriebszeit für Regeneration im Fehlerfall" VALUE 0xF343C Kw_Wu32 4294967295.00 TimeEngOn 0.00 4294967295.00 FORMAT "%13.2" /end CHARACTERISTIC
/begin CHARACTERISTIC PFlt_tiEngOnMax_C "maximale Motorbetriebszeit für Regeneration" VALUE 0xF3440 Kw_Wu32 4294967295.00 TimeEngOn 0.00 4294967295.00 FORMAT "%13.2" /end CHARACTERISTIC
/begin CHARACTERISTIC PFlt_tiEngPrtDeb_C "" VALUE 0xF3444 Kw_Wu16 655350.0 TimeDeb 0.00 655350.0 FORMAT "%8.1" /end CHARACTERISTIC
/begin CHARACTERISTIC PFlt_tiEngPrtPT1_C "Zeitkonstante des PT1-Gliedes für den Motorschutz" VALUE 0xF3448 Kw_Wu32 4294.9673 TimeDelay_s 0.0000010000000 4294.9673 FORMAT "%9.4" /end CHARACTERISTIC
/begin CHARACTERISTIC PFlt_tiEngPrt_C "Regenerationsdauer aufgrund von Motorschutz" VALUE 0xF344C Kw_Wu32 21474836.4700 Time_s 0.00 21474836.4700 FORMAT "%13.4" EXTENDED_LIMITS 0.00 42949672.9500 /end CHARACTERISTIC
/begin CHARACTERISTIC PFlt_tiEngSpdPT1_C "Filterzeitkonst. für Eng_nAvrg PT1 filter" VALUE 0xF380C Kw_Wu32 4294.9673 TimeDelay_s 0.0000010000000 4294.9673 FORMAT "%9.4" /end CHARACTERISTIC
/begin CHARACTERISTIC PFlt_tiHCCondMax_C "Grenze des HC Regenerationscounters" VALUE 0xF2C7C Kw_Wu32 4294967295.00 OneToOne 0.00 4294967295.00 FORMAT "%13.2" /end CHARACTERISTIC
/begin CHARACTERISTIC PFlt_tiHCCond_C "HC conditionierdauer" VALUE 0xF3450 Kw_Wu32 21474836.4700 Time_s 0.00 21474836.4700 FORMAT "%13.4" EXTENDED_LIMITS 0.00 42949672.9500 /end CHARACTERISTIC
/begin CHARACTERISTIC PFlt_tiInjMsPT1_C "Filterzeitkonst. für InjCtl_qSet PT1 filter" VALUE 0xF3810 Kw_Wu32 4294.9673 TimeDelay_s 0.0000010000000 4294.9673 FORMAT "%9.4" /end CHARACTERISTIC
/begin CHARACTERISTIC PFlt_tiKpRgnOvrRun_C "Zeit für Regeneration-Aufrechterhaltung im Schubbetrieb" VALUE 0xF3454 Kw_Wu32 42949672.9500 Time_s 0.00 42949672.9500 FORMAT "%13.2" /end CHARACTERISTIC
/begin CHARACTERISTIC PFlt_tiLckRgnErr_CA "Sperrzeit  im Fehlerfall nach der maximalen Regenerationdauer erreicht wurden" VAL_BLK 0xF3458 Kwb_Wu32 42949672.9500 Time_s 0.00 42949672.9500 FORMAT "%13.4" NUMBER 11 /end CHARACTERISTIC
/begin CHARACTERISTIC PFlt_tiLckRgn_CA "Sperrzeit  nach der maximalen Regenerationdauer erreicht wurden" VAL_BLK 0xF3484 Kwb_Wu32 42949672.9500 Time_s 0.00 42949672.9500 FORMAT "%13.4" NUMBER 11 /end CHARACTERISTIC
/begin CHARACTERISTIC PFlt_tiLckSubs_C "Ersatzwert für Sperrzeit" VALUE 0xF34B0 Kw_Wu32 42949672.9500 Time_s 0.00 42949672.9500 FORMAT "%13.4" /end CHARACTERISTIC
/begin CHARACTERISTIC PFlt_tiMaxRgn_C "Maximale regenerationsdauer nach Strecke, Kraftstoff..." VALUE 0xF34B4 Kw_Wu32 21474836.4700 Time_s 0.00 21474836.4700 FORMAT "%13.4" EXTENDED_LIMITS 0.00 42949672.9500 /end CHARACTERISTIC
/begin CHARACTERISTIC PFlt_tiNO2RgnDel_MAP "Verzugszeit der NO2-Regeneration" MAP 0xF50E0 Kf_Xs16_Ys16_Ws16 32767.00 Time_s 0.00 32767.00 FORMAT "%8.2" EXTENDED_LIMITS -327.6800 327.6700
 /begin AXIS_DESCR STD_AXIS Eng_nAvrg EngN 8 40.00000 6000.000 FORMAT "%8.3" EXTENDED_LIMITS -32768.00 32767.00 DEPOSIT ABSOLUTE /end AXIS_DESCR
 /begin AXIS_DESCR STD_AXIS InjCtl_qSetUnBal InjMassCyc 8 0.00 327.6700 FORMAT "%8.4" EXTENDED_LIMITS -327.6800 327.6700 DEPOSIT ABSOLUTE /end AXIS_DESCR
/end CHARACTERISTIC
/begin CHARACTERISTIC PFlt_tiOpAdjMax_C "Maximale Partikelfilterlebensdauer, die bei der Diagnose gesetzt werden kann" VALUE 0xF5184 Kw_Wu32 4294967295.00 TimeEngOn 0.00 4294967295.00 FORMAT "%13.2" /end CHARACTERISTIC
/begin CHARACTERISTIC PFlt_tiOpSubs_C "Ersatzwert für Motorbetriebszeit im Fall Eeprom lese Fehler" VALUE 0xF34B8 Kw_Wu32 4294967295.00 TimeEngOn 0.00 4294967295.00 FORMAT "%13.2" /end CHARACTERISTIC
/begin CHARACTERISTIC PFlt_tiPFltErrPer_C "Periode des pflt-Notfahrbetriebs" VALUE 0xF2B68 Kw_Wu16 655350.0 TimePFltLimpHome 0.00 655350.0 FORMAT "%8.1" /end CHARACTERISTIC
/begin CHARACTERISTIC PFlt_tiPFltErrRgn_C "Regenerationszeit des pflt-Notfahrbetriebs" VALUE 0xF2B6A Kw_Wu16 655350.0 TimePFltLimpHome 0.00 655350.0 FORMAT "%8.1" /end CHARACTERISTIC
/begin CHARACTERISTIC PFlt_tiResFlowPT1_C "Zeitkonstante für Strömungswiderstand" VALUE 0xF5188 Kw_Wu32 4294.9673 TimeDelay_s 0.0000010000000 4294.9673 FORMAT "%9.4" /end CHARACTERISTIC
/begin CHARACTERISTIC PFlt_tiResFlowRawPT1_C "" VALUE 0xF518C Kw_Wu32 4294.8273 TimeDelay_s 0.14000154 4294.9673 FORMAT "%9.4" EXTENDED_LIMITS 0.0000010000000 4294.9673 /end CHARACTERISTIC
/begin CHARACTERISTIC PFlt_tiResFlowRgnPT1_C "Zeitkonstant des PT1-Filters für den Stömungswiederstand in Regenerationsbetrieb" VALUE 0xF5190 Kw_Wu32 4294.9673 TimeDelay_s 0.0000010000000 4294.9673 FORMAT "%9.4" /end CHARACTERISTIC
/begin CHARACTERISTIC PFlt_tiRgnMax_CA "Array für Maximalwert Regenerationsdauer" VAL_BLK 0xF34BC Kwb_Wu32 42949672.9500 Time_s 0.00 42949672.9500 FORMAT "%13.4" NUMBER 7 /end CHARACTERISTIC
/begin CHARACTERISTIC PFlt_tiRgnMin_C "Minimale Regenerationszeit" VALUE 0xF34D8 Kw_Ws32 42949672.9500 Time_s -21474836.4800 21474836.4700 FORMAT "%13.4" /end CHARACTERISTIC
/begin CHARACTERISTIC PFlt_tiRgnSpo_C "Regenerationszeit zur Detektierung einer spontanen Regeneration" VALUE 0xF34DC Kw_Wu16 655.3500 Time_s 0.00 655.3500 FORMAT "%8.4" /end CHARACTERISTIC
/begin CHARACTERISTIC PFlt_tiSpdVehPT1_C "Filterzeitkonst. für VSSCD_v PT1 filter" VALUE 0xF3814 Kw_Wu32 4294.9673 TimeDelay_s 0.0000010000000 4294.9673 FORMAT "%9.4" /end CHARACTERISTIC
/begin CHARACTERISTIC PFlt_tiTempClntPT1_C "Filterzeitkonst. für CTSCD_tClntPT1 filter" VALUE 0xF3818 Kw_Wu32 4294.9673 TimeDelay_s 0.0000010000000 4294.9673 FORMAT "%9.4" /end CHARACTERISTIC
/begin CHARACTERISTIC PFlt_tiTempOxiPrePT1_C "Filterzeitkonst. für OxiCCD_tPre  PT1 filter" VALUE 0xF381C Kw_Wu32 4294.9673 TimeDelay_s 0.0000010000000 4294.9673 FORMAT "%9.4" /end CHARACTERISTIC
/begin CHARACTERISTIC PFlt_tiTempPrePT1_C "Filterzeitkonst. für PFlt_tPre PT1 filter" VALUE 0xF3820 Kw_Wu32 4294.9673 TimeDelay_s 0.0000010000000 4294.9673 FORMAT "%9.4" /end CHARACTERISTIC
/begin CHARACTERISTIC PFlt_tiVolFlowPT1_C "Zeitkonstant des PT1-Filers für Abgasvolumenstom" VALUE 0xF5194 Kw_Wu32 4294.9673 TimeDelay_s 0.0000010000000 4294.9673 FORMAT "%9.4" /end CHARACTERISTIC
/begin CHARACTERISTIC PFlt_tiVolFlowRgnPT1_C "Zeitkonstant des PT1-Filers für Abgasvolumenstom in Regeneration" VALUE 0xF5198 Kw_Wu32 4294.9673 TimeDelay_s 0.0000010000000 4294.9673 FORMAT "%9.4" /end CHARACTERISTIC
/begin CHARACTERISTIC PFlt_tiWaitForOvrRun_C "Wartezeit fur Schubbetrieb" VALUE 0xF34E0 Kw_Wu32 42949672.9500 Time_s 0.00 42949672.9500 FORMAT "%13.4" /end CHARACTERISTIC
/begin CHARACTERISTIC PFlt_tOxiPreFltAshCorMax_C "maximal zulässiger Wert Temperatur vor dem OxiKat" VALUE 0xF2B6C Kw_Ws16 950.000 Temp_Cels -50.140 899.860 FORMAT "%8.3" EXTENDED_LIMITS -3549.940 3003.560 /end CHARACTERISTIC
/begin CHARACTERISTIC PFlt_tOxiPreFltAshCorMin_C "minimal zulässiger Wert Temperatur vor dem OxiKat" VALUE 0xF2B6E Kw_Ws16 950.000 Temp_Cels -50.140 899.860 FORMAT "%8.3" EXTENDED_LIMITS -3549.940 3003.560 /end CHARACTERISTIC
/begin CHARACTERISTIC PFlt_tOxiPreMaxHi_C "maximal erlaubter Wert für Temperatur vor Oxidationskatalysator (oberer Schwellenwert)" VALUE 0xF34E4 Kw_Ws16 950.0000 Temp_Cels -50.1400 899.8600 FORMAT "%8.4" EXTENDED_LIMITS -3549.940 3003.560 /end CHARACTERISTIC
/begin CHARACTERISTIC PFlt_tOxiPreMaxLo_C "maximal erlaubter Wert für Temperatur vor Oxidationskatalysator (unterer Schwellenwert)" VALUE 0xF34E6 Kw_Ws16 950.0000 Temp_Cels -50.1400 899.8600 FORMAT "%8.4" EXTENDED_LIMITS -3549.940 3003.560 /end CHARACTERISTIC
/begin CHARACTERISTIC PFlt_tOxiPreOffMinMax_CA "Matrix zur Bestimmung der Bereichsgrenzen für die gefilterte Abgastemperatur vor Oxidationskatalysator bei inaktivem Bereich" MAP 0xF3824 Kf_Xs16_Ys16_Ws16 950.000 Temp_Cels -50.140 899.860 FORMAT "%8.3" EXTENDED_LIMITS -3549.940 3003.560
 /begin AXIS_DESCR STD_AXIS PFlt_RngIdx_X_mp OneToOne 11 0.00 10.00 FORMAT "%5.2" EXTENDED_LIMITS 0.00 255.0 DEPOSIT ABSOLUTE /end AXIS_DESCR
 /begin AXIS_DESCR STD_AXIS PFlt_RngIdx_Y_mp OneToOne 2 0.00 1.000 FORMAT "%5.3" EXTENDED_LIMITS 0.00 255.0 DEPOSIT ABSOLUTE /end AXIS_DESCR
/end CHARACTERISTIC
/begin CHARACTERISTIC PFlt_tOxiPreOnMinMax_CA "Matrix zur Bestimmung der Bereichsgrenzen für die gefilterte Abgastemperatur vor Oxidationskatalysator bei aktivem Bereich" MAP 0xF386E Kf_Xs16_Ys16_Ws16 950.000 Temp_Cels -50.140 899.860 FORMAT "%8.3" EXTENDED_LIMITS -3549.940 3003.560
 /begin AXIS_DESCR STD_AXIS PFlt_RngIdx_X_mp OneToOne 11 0.00 10.00 FORMAT "%5.2" EXTENDED_LIMITS 0.00 255.0 DEPOSIT ABSOLUTE /end AXIS_DESCR
 /begin AXIS_DESCR STD_AXIS PFlt_RngIdx_Y_mp OneToOne 2 0.00 1.000 FORMAT "%5.3" EXTENDED_LIMITS 0.00 255.0 DEPOSIT ABSOLUTE /end AXIS_DESCR
/end CHARACTERISTIC
/begin CHARACTERISTIC PFlt_tPreFltAshCorMax_C "maximal zulässiger Wert Vortemperatur Partikelfilter" VALUE 0xF2B70 Kw_Ws16 950.000 Temp_Cels -50.140 899.860 FORMAT "%8.3" EXTENDED_LIMITS -3549.940 3003.560 /end CHARACTERISTIC
/begin CHARACTERISTIC PFlt_tPreFltAshCorMin_C "minimal zulässiger Wert Vortemperatur Partikelfilter" VALUE 0xF2B72 Kw_Ws16 950.000 Temp_Cels -50.140 899.860 FORMAT "%8.3" EXTENDED_LIMITS -3549.940 3003.560 /end CHARACTERISTIC
/begin CHARACTERISTIC PFlt_tPreMaxHi_C "maximal erlaubter Wert für Temperatur vor Partikelfilter (oberer Schwellenwert)" VALUE 0xF34E8 Kw_Ws16 950.0000 Temp_Cels -50.1400 899.8600 FORMAT "%8.4" EXTENDED_LIMITS -3549.940 3003.560 /end CHARACTERISTIC
/begin CHARACTERISTIC PFlt_tPreMaxLo_C "maximal erlaubter Wert für Temperatur vor Partikelfilter (unterer Schwellenwert)" VALUE 0xF34EA Kw_Ws16 950.0000 Temp_Cels -50.1400 899.8600 FORMAT "%8.4" EXTENDED_LIMITS -3549.940 3003.560 /end CHARACTERISTIC
/begin CHARACTERISTIC PFlt_tPreMinOvrRun_C "Minimale Abgastemperatur vor Diesel Partikelfilter für Aufrechterhaltung einer Regeneration im Schubbetrieb" VALUE 0xF34EC Kw_Ws16 950.0000 Temp_Cels -50.1400 899.8600 FORMAT "%8.4" EXTENDED_LIMITS -3549.940 3003.560 /end CHARACTERISTIC
/begin CHARACTERISTIC PFlt_tPreOffMinMax_CA "Matrix zur Bestimmung der Bereichsgrenzen für die gefilterte Abgastemperatur vor Partikelfilter bei inaktivem Bereich" MAP 0xF38B8 Kf_Xs16_Ys16_Ws16 950.000 Temp_Cels -50.140 899.860 FORMAT "%8.3" EXTENDED_LIMITS -3549.940 3003.560
 /begin AXIS_DESCR STD_AXIS PFlt_RngIdx_X_mp OneToOne 11 0.00 10.00 FORMAT "%5.2" EXTENDED_LIMITS 0.00 255.0 DEPOSIT ABSOLUTE /end AXIS_DESCR
 /begin AXIS_DESCR STD_AXIS PFlt_RngIdx_Y_mp OneToOne 2 0.00 1.000 FORMAT "%5.3" EXTENDED_LIMITS 0.00 255.0 DEPOSIT ABSOLUTE /end AXIS_DESCR
/end CHARACTERISTIC
/begin CHARACTERISTIC PFlt_tPreOnMinMax_CA "Matrix zur Bestimmung der Bereichsgrenzen für die gefilterte Abgastemperatur vor Partikelfilter bei aktivem Bereich" MAP 0xF3902 Kf_Xs16_Ys16_Ws16 950.000 Temp_Cels -50.140 899.860 FORMAT "%8.3" EXTENDED_LIMITS -3549.940 3003.560
 /begin AXIS_DESCR STD_AXIS PFlt_RngIdx_X_mp OneToOne 11 0.00 10.00 FORMAT "%5.2" EXTENDED_LIMITS 0.00 255.0 DEPOSIT ABSOLUTE /end AXIS_DESCR
 /begin AXIS_DESCR STD_AXIS PFlt_RngIdx_Y_mp OneToOne 2 0.00 1.000 FORMAT "%5.3" EXTENDED_LIMITS 0.00 255.0 DEPOSIT ABSOLUTE /end AXIS_DESCR
/end CHARACTERISTIC
/begin CHARACTERISTIC PFlt_tRgnMin_C "minimale Rregenerationstemperatur" VALUE 0xF34EE Kw_Ws16 950.0000 Temp_Cels -50.1400 899.8600 FORMAT "%8.4" EXTENDED_LIMITS -3549.940 3003.560 /end CHARACTERISTIC
/begin CHARACTERISTIC PFlt_uBattMinMax_CA "Matrix zur Bestimmung der Bereichsgrenzen für das gefilterte Batteriespannungssignal" MAP 0xF394C Kf_Xs16_Ys16_Ws16 28602.15 Volt_Batt 0.00 28602.15 FORMAT "%8.2" EXTENDED_LIMITS -640625.6 640606.1
 /begin AXIS_DESCR STD_AXIS PFlt_RngIdx_X_mp OneToOne 11 0.00 10.00 FORMAT "%5.2" EXTENDED_LIMITS 0.00 255.0 DEPOSIT ABSOLUTE /end AXIS_DESCR
 /begin AXIS_DESCR STD_AXIS PFlt_RngIdx_Y_mp OneToOne 2 0.00 1.000 FORMAT "%5.3" EXTENDED_LIMITS 0.00 255.0 DEPOSIT ABSOLUTE /end AXIS_DESCR
/end CHARACTERISTIC
/begin CHARACTERISTIC PFlt_vHCCondPrtHeal_C "Fahrgeschwindigkeitsgrenzwert zur Erkennung hoher Motorlast" VALUE 0xF2C80 Kw_Ws16 655.3500 Vel -327.6800 327.6700 FORMAT "%8.4" /end CHARACTERISTIC
/begin CHARACTERISTIC PFlt_volAdiAsh_CUR "Volumen der Additivasche im Partikelfilter" CURVE 0xF519C Kl_Xs16_Ws16 3276.700 Vol 0.00 3276.700 FORMAT "%8.3" EXTENDED_LIMITS -327.6800 327.6700
 /begin AXIS_DESCR STD_AXIS PFlt_volAddTot_mp volAdd_ml2 16 0.00 3277.000 FORMAT "%8.3" EXTENDED_LIMITS -32768.00 32767.00 DEPOSIT ABSOLUTE /end AXIS_DESCR
/end CHARACTERISTIC
/begin CHARACTERISTIC PFlt_volFlConsumSubs_C "Ersatzwert für insgesamt verbrauchten Kraftstoff" VALUE 0xF34F0 Kw_Wu16 65.50000 Fl_Vol 0.00 65.50000 FORMAT "%8.5" EXTENDED_LIMITS 0.00 65.53500 /end CHARACTERISTIC
/begin CHARACTERISTIC PFlt_volFuelFilMinHi_C "Obere Hystereseschwelle für Aufhebung der Sperre" VALUE 0xF34F2 Kw_Wu16 300.0000 Fl_Half_L 0.00 300.0000 FORMAT "%8.4" EXTENDED_LIMITS 0.00 3276.750 /end CHARACTERISTIC
/begin CHARACTERISTIC PFlt_volFuelFilMinLo_C "Untere Hystereseschwelle für Sperre der Regen." VALUE 0xF34F4 Kw_Wu16 300.0000 Fl_Half_L 0.00 300.0000 FORMAT "%8.4" EXTENDED_LIMITS 0.00 3276.750 /end CHARACTERISTIC
/begin CHARACTERISTIC PFlt_volOilAshFl_CUR "Kennlinie zur Umrechung der verbrauchten Kraftstoffmasse in Ölaschenvolumen im Parikelfilter" CURVE 0xF51DE Kl_Xs16_Ws16 100.0000 Vol 0.00 100.0000 FORMAT "%8.4" EXTENDED_LIMITS -327.6800 327.6700
 /begin AXIS_DESCR STD_AXIS PFlt_qFlTotCrvIn_mp Fl_2 8 0.00 7000.000 FORMAT "%8.3" EXTENDED_LIMITS -327680.0 327670.0 DEPOSIT ABSOLUTE /end AXIS_DESCR
/end CHARACTERISTIC
/begin CHARACTERISTIC PFlt_volOilAshTiEngOn_CUR "Kennlinie zur Umrechnung der Betriebsdauer in Ölaschenvolumen im Partikelfilter" CURVE 0xF5200 Kl_Xs16_Ws16 100.0000 Vol 0.00 100.0000 FORMAT "%8.4" EXTENDED_LIMITS -327.6800 327.6700
 /begin AXIS_DESCR STD_AXIS PFlt_tiOpPFltCrvIn_mp Time_Hr 16 0.00 16383.00 FORMAT "%8.2" EXTENDED_LIMITS -16384.00 16383.50 DEPOSIT ABSOLUTE /end AXIS_DESCR
/end CHARACTERISTIC
/begin CHARACTERISTIC PFlt_volPFlt_C "Volumen des Partikel Filters" VALUE 0xF5242 Kw_Wu16 99.99000 Vol 0.01000000 100.0000 FORMAT "%8.4" EXTENDED_LIMITS 0.00 655.3500 /end CHARACTERISTIC
/begin CHARACTERISTIC PFlt_vVehFltAshCorMax_C "maximal zulässiger Wert Fahrzeuggeschwindigkeit" VALUE 0xF2B74 Kw_Ws16 300.0000 Vel 0.00 300.0000 FORMAT "%8.4" EXTENDED_LIMITS -327.6800 327.6700 /end CHARACTERISTIC
/begin CHARACTERISTIC PFlt_vVehFltAshCorMin_C "minimal zulässiger Wert Fahrzeuggeschwindigkeit" VALUE 0xF2B76 Kw_Ws16 300.0000 Vel 0.00 300.0000 FORMAT "%8.4" EXTENDED_LIMITS -327.6800 327.6700 /end CHARACTERISTIC
/begin CHARACTERISTIC PFlt_vVehMinMax_CA "Matrix zur Bestimmung der Bereichsgrenzen für die gefilterte Fahrgeschwindigkeit" MAP 0xF3996 Kf_Xs16_Ys16_Ws16 300.0000 Vel 0.00 300.0000 FORMAT "%8.4" EXTENDED_LIMITS -327.6800 327.6700
 /begin AXIS_DESCR STD_AXIS PFlt_RngIdx_X_mp OneToOne 11 0.00 10.00 FORMAT "%5.2" EXTENDED_LIMITS 0.00 255.0 DEPOSIT ABSOLUTE /end AXIS_DESCR
 /begin AXIS_DESCR STD_AXIS PFlt_RngIdx_Y_mp OneToOne 2 0.00 1.000 FORMAT "%5.3" EXTENDED_LIMITS 0.00 255.0 DEPOSIT ABSOLUTE /end AXIS_DESCR
/end CHARACTERISTIC
/begin CHARACTERISTIC PFlt_vVehUnFltMinMax_CA "Matrix (min/max Grenzen)für ungefilterte Fahrgeschwindigkeit" MAP 0xF39E0 Kf_Xs16_Ys16_Ws16 300.0000 Vel 0.00 300.0000 FORMAT "%8.4" EXTENDED_LIMITS -327.6800 327.6700
 /begin AXIS_DESCR STD_AXIS PFlt_RngIdxPrj_X_mp OneToOne 11 0.00 10.00 FORMAT "%5.2" EXTENDED_LIMITS 0.00 255.0 DEPOSIT ABSOLUTE /end AXIS_DESCR
 /begin AXIS_DESCR STD_AXIS PFlt_RngIdxPrj_Y_mp OneToOne 2 0.00 1.000 FORMAT "%5.3" EXTENDED_LIMITS 0.00 255.0 DEPOSIT ABSOLUTE /end AXIS_DESCR
/end CHARACTERISTIC
/begin MEASUREMENT PFlt_aVehFltAshCor_mp "gefilterter Wert Fahrzeugbeschleunigung" SWORD Acc 1 100 -32.76800 32.76700 FORMAT "%8.5" ECU_ADDRESS 0x8FEFFA /end MEASUREMENT
/begin MEASUREMENT PFlt_ctNumAshCorMax_mp "aktueller Zählerwert des Maximumzählers für AshCor Regeneration" UWORD OneToOne 1 100 0.00 65535.00 FORMAT "%8.2" ECU_ADDRESS 0x8FEFFC /end MEASUREMENT
/begin MEASUREMENT PFlt_ctNumAshCor_mp "aktueller Zählerwert für erfolgreiche Regeneration" UWORD OneToOne 1 100 0.00 65535.00 FORMAT "%8.2" ECU_ADDRESS 0x8FEFFE /end MEASUREMENT
/begin MEASUREMENT PFlt_ctStartSnceHCCondB1_mp "Motorstarts seit letzter HC Conditionierung" UWORD OneToOne 1 100 0.00 65535.00 FORMAT "%8.2" ECU_ADDRESS 0x8FF05E /end MEASUREMENT
/begin MEASUREMENT PFlt_ctStartSnceHCCondB2_mp "Motorstarts seit letzter HC Conditionierung für Bank1" UWORD OneToOne 1 100 0.00 65535.00 FORMAT "%8.2" ECU_ADDRESS 0x8FF060 /end MEASUREMENT
/begin MEASUREMENT PFlt_ctStartSnceRgnB1_mp "Zahl von Anfängen seit letzter erfolgreicher Regeneration" UWORD OneToOne 1 100 0.00 65535.00 FORMAT "%8.2" ECU_ADDRESS 0x8FF0A2 /end MEASUREMENT
/begin MEASUREMENT PFlt_ctStartSnceRgnB2_mp "Zahl von Anfängen seit letzter erfolgreicher Regeneration" UWORD OneToOne 1 100 0.00 65535.00 FORMAT "%8.2" ECU_ADDRESS 0x8FF0A4 /end MEASUREMENT
/begin MEASUREMENT PFlt_dmEGB1 "Abgasmassenstrom Bank1" SWORD AirMassPerTime 1 100 -3276.800 3276.700 FORMAT "%8.3" ECU_ADDRESS 0x7F9178 /end MEASUREMENT
/begin MEASUREMENT PFlt_dmEGB2 "Abgasmassenstrom Bank1" SWORD AirMassPerTime 1 100 -3276.800 3276.700 FORMAT "%8.3" ECU_ADDRESS 0x7F917A /end MEASUREMENT
/begin MEASUREMENT PFlt_dmNO2TotB1_mp "insgesamt zur Verfügung stehender NO2-Massenstrom(Bank1)." SWORD dmSoot_mg_p_s 1 100 -327.6800 327.6700 FORMAT "%8.4" ECU_ADDRESS 0x8FF172 /end MEASUREMENT
/begin MEASUREMENT PFlt_dmNO2TotB2_mp "insgesamt zur Verfügung stehender NO2-Massenstrom(Bank2)." SWORD dmSoot_mg_p_s 1 100 -327.6800 327.6700 FORMAT "%8.4" ECU_ADDRESS 0x8FF174 /end MEASUREMENT
/begin MEASUREMENT PFlt_dmNOxRaw_mp "simulierte NOx-Basisemission" SWORD dmSoot_mg_p_s 1 100 -327.6800 327.6700 FORMAT "%8.4" ECU_ADDRESS 0x8FF176 /end MEASUREMENT
/begin MEASUREMENT PFlt_dmO2AprxB1 "geschätzter Sauerstoffmassenstrom vor dem Partikelfilter Bank1" SWORD AirMassPerTime 1 100 -3276.800 3276.700 FORMAT "%8.3" ECU_ADDRESS 0x7F917C /end MEASUREMENT
/begin MEASUREMENT PFlt_dmO2AprxB2 "geschätzter Sauerstoffmassenstrom vor dem Partikelfilter Bank2" SWORD AirMassPerTime 1 100 -3276.800 3276.700 FORMAT "%8.3" ECU_ADDRESS 0x7F917E /end MEASUREMENT
/begin MEASUREMENT PFlt_dmO2AprxCrvIn_mp "geschätzte Oxygenmassenstrom vor Partikel Filter" SWORD AirMassPerTime 1 100 -3276.800 3276.700 FORMAT "%8.3" ECU_ADDRESS 0x8FF178 /end MEASUREMENT
/begin MEASUREMENT PFlt_dmSotSimB1_mp "gesamt produzierte Partikelmasse(Bank1)." SWORD dmSoot_mg_p_s 1 100 -327.6800 327.6700 FORMAT "%8.4" ECU_ADDRESS 0x8FF17A /end MEASUREMENT
/begin MEASUREMENT PFlt_dmSotSimB2_mp "gesamt produzierte Partikelmasse(Bank2)." SWORD dmSoot_mg_p_s 1 100 -327.6800 327.6700 FORMAT "%8.4" ECU_ADDRESS 0x8FF17C /end MEASUREMENT
/begin MEASUREMENT PFlt_dmSotSimDynB1_mp "Partikelmassenstrom aus Dynamik in Simulation Bank 1" SWORD dmSoot_mg_p_s 1 100 -327.6800 327.6700 FORMAT "%8.4" ECU_ADDRESS 0x8FF17E /end MEASUREMENT
/begin MEASUREMENT PFlt_dmSotSimDynB2_mp "Partikelmassenstrom aus Dynamik in Simulation Bank 2" SWORD dmSoot_mg_p_s 1 100 -327.6800 327.6700 FORMAT "%8.4" ECU_ADDRESS 0x8FF180 /end MEASUREMENT
/begin MEASUREMENT PFlt_dmSotSimDynInjMs_mp "simulierter Rußmassenstrom aus Ableitung der Einspritzmasse" SWORD dmSoot_mg_p_s 1 100 -327.6800 327.6700 FORMAT "%8.4" ECU_ADDRESS 0x8FF182 /end MEASUREMENT
/begin MEASUREMENT PFlt_dmSotSimDynLmbdB1_mp "simulierter Rußmassenstrom aus Lambda Bank 1" SWORD dmSoot_mg_p_s 1 100 -327.6800 327.6700 FORMAT "%8.4" ECU_ADDRESS 0x8FF184 /end MEASUREMENT
/begin MEASUREMENT PFlt_dmSotSimDynLmbdB2_mp "simulierter Rußmassenstrom aus Lambda Bank 2" SWORD dmSoot_mg_p_s 1 100 -327.6800 327.6700 FORMAT "%8.4" ECU_ADDRESS 0x8FF186 /end MEASUREMENT
/begin MEASUREMENT PFlt_dmSotSimEmiB1_mp "Partikelmassenstrom Emission in Simulation Bank 1" SWORD dmSoot_mg_p_s 1 100 -327.6800 327.6700 FORMAT "%8.4" ECU_ADDRESS 0x6F82C6 /end MEASUREMENT
/begin MEASUREMENT PFlt_dmSotSimEmiB2_mp "Partikelmassenstrom Emission in Simulation Bank 2" SWORD dmSoot_mg_p_s 1 100 -327.6800 327.6700 FORMAT "%8.4" ECU_ADDRESS 0x6F82C8 /end MEASUREMENT
/begin MEASUREMENT PFlt_dmSotSimRgnB1_mp "regenerierte Partikelmasse(Bank1)." SWORD dmSoot_mg_p_s 1 100 -327.6800 327.6700 FORMAT "%8.4" ECU_ADDRESS 0x6F82CA /end MEASUREMENT
/begin MEASUREMENT PFlt_dmSotSimRgnB2_mp "regenerierte Partikelmasse(Bank2)." SWORD dmSoot_mg_p_s 1 100 -327.6800 327.6700 FORMAT "%8.4" ECU_ADDRESS 0x6F82CC /end MEASUREMENT
/begin MEASUREMENT PFlt_dmSotSimRgnNO2B1_mp "durch NO2-Effekt regenerierter Rußmassenstrom Bank 1" SWORD dmSoot_mg_p_s 1 100 -327.6800 327.6700 FORMAT "%8.4" ECU_ADDRESS 0x6F82CE /end MEASUREMENT
/begin MEASUREMENT PFlt_dmSotSimRgnNO2B2_mp "durch NO2-Effekt regenerierter Rußmassenstrom Bank 2" SWORD dmSoot_mg_p_s 1 100 -327.6800 327.6700 FORMAT "%8.4" ECU_ADDRESS 0x6F82D0 /end MEASUREMENT
/begin MEASUREMENT PFlt_dmSotSimRgnNO2RawB1_mp "durch NO2-Effekt regenerierter Rußmassenstrom ohne Berücksichtigung der Verzugszeit Bank 1" SWORD dmSoot_mg_p_s 1 100 -327.6800 327.6700 FORMAT "%8.4" ECU_ADDRESS 0x8FF188 /end MEASUREMENT
/begin MEASUREMENT PFlt_dmSotSimRgnNO2RawB2_mp "durch NO2-Effekt regenerierter Rußmassenstrom ohne Berücksichtigung der Verzugszeit Bank 2" SWORD dmSoot_mg_p_s 1 100 -327.6800 327.6700 FORMAT "%8.4" ECU_ADDRESS 0x8FF18A /end MEASUREMENT
/begin MEASUREMENT PFlt_dmSotSimRgnThrB1_mp "abgebauter Partikelmassenstrom in Simulation durch thermische Regeneration(Bank1)." SWORD dmSoot_mg_p_s 1 100 -327.6800 327.6700 FORMAT "%8.4" ECU_ADDRESS 0x6F82D2 /end MEASUREMENT
/begin MEASUREMENT PFlt_dmSotSimRgnThrB2_mp "abgebauter Partikelmassenstrom in Simulation durch thermische Regeneration(Bank2)." SWORD dmSoot_mg_p_s 1 100 -327.6800 327.6700 FORMAT "%8.4" ECU_ADDRESS 0x6F82D4 /end MEASUREMENT
/begin MEASUREMENT PFlt_dmSotSimSty_mp "stationärer Partikelmassenstrom in Simulation" SWORD dmSoot_mg_p_s 1 100 -327.6800 327.6700 FORMAT "%8.4" ECU_ADDRESS 0x8FF18C /end MEASUREMENT
/begin MEASUREMENT PFlt_dpDiffB1_mp "PFlt_pDiff DT1 gefiltert für Bank1" SWORD Pres_hPa 1 100 -32768.00 32767.00 FORMAT "%8.2" ECU_ADDRESS 0x8FF18E /end MEASUREMENT
/begin MEASUREMENT PFlt_dpDiffB2_mp "PFlt_pDiff DT1 gefiltert für Bank2" SWORD Pres_hPa 1 100 -32768.00 32767.00 FORMAT "%8.2" ECU_ADDRESS 0x8FF190 /end MEASUREMENT
/begin MEASUREMENT PFlt_dqFlTotActB1_mp "qFlTot Korrekturwert" SWORD Fl_2 1 100 -327680.0 327670.0 FORMAT "%8.1" ECU_ADDRESS 0x8FF000 /end MEASUREMENT
/begin MEASUREMENT PFlt_dqFlTotActB2_mp "qFlTot Korrekturwert" SWORD Fl_2 1 100 -327680.0 327670.0 FORMAT "%8.1" ECU_ADDRESS 0x8FF002 /end MEASUREMENT
/begin MEASUREMENT PFlt_dqFlTotEndB1_mp "qFlTot Korrekturendwert" SWORD Fl_2 1 100 -327680.0 327670.0 FORMAT "%8.1" ECU_ADDRESS 0x8FF004 /end MEASUREMENT
/begin MEASUREMENT PFlt_dqFlTotEndB2_mp "qFlTot Korrekturendwert" SWORD Fl_2 1 100 -327680.0 327670.0 FORMAT "%8.1" ECU_ADDRESS 0x8FF006 /end MEASUREMENT
/begin MEASUREMENT PFlt_dqSetUnBal_mp "DT1-gefilterte Einspritzmasse" SWORD InjMassPerSec_20ms 1 100 -16384.00 16383.50 FORMAT "%8.2" ECU_ADDRESS 0x8FF192 /end MEASUREMENT
/begin MEASUREMENT PFlt_dvol "berechneter Abgasvolumenstrom im Partikelfilter" SWORD CubMtrPerHr 1 100 -3276.800 3276.700 FORMAT "%8.3" ECU_ADDRESS 0x7F9180 /end MEASUREMENT
/begin MEASUREMENT PFlt_dvolB1 "berechneter Abgasvolumenstrom im Partikelfilter für Bank1" SWORD CubMtrPerHr 1 100 -3276.800 3276.700 FORMAT "%8.3" ECU_ADDRESS 0x7F9182 /end MEASUREMENT
/begin MEASUREMENT PFlt_dvolB2 "berechneter Abgasvolumenstrom im Partikelfilter für Bank2" SWORD CubMtrPerHr 1 100 -3276.800 3276.700 FORMAT "%8.3" ECU_ADDRESS 0x7F9184 /end MEASUREMENT
/begin MEASUREMENT PFlt_dVolFltAshCorB1_mp "für erfolgreiche Regenerationstotalabfragung" SWORD CubMtrPerHr 1 100 -3276.800 3276.700 FORMAT "%8.3" ECU_ADDRESS 0x8FF008 /end MEASUREMENT
/begin MEASUREMENT PFlt_dVolFltAshCorB2_mp "PT1-gefilterter Wert für PFlt_dvol" SWORD CubMtrPerHr 1 100 -3276.800 3276.700 FORMAT "%8.3" ECU_ADDRESS 0x8FF00A /end MEASUREMENT
/begin MEASUREMENT PFlt_dVolFltAshCorRawB1_mp "dVol-Rohwert" SWORD CubMtrPerHr 1 100 -3276.800 3276.700 FORMAT "%8.3" ECU_ADDRESS 0x8FF00C /end MEASUREMENT
/begin MEASUREMENT PFlt_dVolFltAshCorRawB2_mp "dVol-Rohwert" SWORD CubMtrPerHr 1 100 -3276.800 3276.700 FORMAT "%8.3" ECU_ADDRESS 0x8FF00E /end MEASUREMENT
/begin MEASUREMENT PFlt_dVolFltAshCor_mp "PT1-gefilterter Wert für PFlt_dvol" SWORD CubMtrPerHr 1 100 -3276.800 3276.700 FORMAT "%8.3" ECU_ADDRESS 0x8FF010 /end MEASUREMENT
/begin MEASUREMENT PFlt_dvolMassFltB1_mp "gefillterter Abgasvolumenstrom(Bank1)." SWORD CubMtrPerHr 1 100 -3276.800 3276.700 FORMAT "%8.3" ECU_ADDRESS 0x8FF194 /end MEASUREMENT
/begin MEASUREMENT PFlt_dvolMassFltB2_mp "gefillterter Abgasvolumenstrom(Bank2)." SWORD CubMtrPerHr 1 100 -3276.800 3276.700 FORMAT "%8.3" ECU_ADDRESS 0x8FF196 /end MEASUREMENT
/begin MEASUREMENT PFlt_dvolMassFltIn_mp "Kopie von gefiltertem Abgasvolumen (PFlt_dvolMassFltIn_mp), die als Eingang für Kennlinien und Kennfelde gegeben wird." SWORD CubMtrPerHr 1 100 -3276.800 3276.700 FORMAT "%8.3" ECU_ADDRESS 0x8FF198 /end MEASUREMENT
/begin MEASUREMENT PFlt_dvol_mp "Copy der Message PFlt_dvol% für Ansicht des korrekten Prozesspunktes während des Testens" SWORD CubMtrPerHr 1 100 -3276.800 3276.700 FORMAT "%8.3" ECU_ADDRESS 0x8FF19A /end MEASUREMENT
/begin MEASUREMENT PFlt_facAshB1_mp "Multiplikativer Faktor der Asche Korrektur für PFlt_pEngPrtAshCorB1" SWORD Fact 1 100 -4.000000 3.999878 FORMAT "%8.6" ECU_ADDRESS 0x8FF0A6 /end MEASUREMENT
/begin MEASUREMENT PFlt_facAshB2_mp "Multiplikativer Faktor der Asche Korrektur für PFlt_pEngPrtAshCorB2" SWORD Fact 1 100 -4.000000 3.999878 FORMAT "%8.6" ECU_ADDRESS 0x8FF0A8 /end MEASUREMENT
/begin MEASUREMENT PFlt_facAshCorB1 "Asche-korrekturfaktor für Abgasflut 1" SWORD Fact 1 100 -4.000000 3.999878 FORMAT "%8.6" ECU_ADDRESS 0x7F9186 /end MEASUREMENT
/begin MEASUREMENT PFlt_facAshCorB2 "Asche-korrekturfaktor für Abgasflut Zwei" SWORD Fact 1 100 -4.000000 3.999878 FORMAT "%8.6" ECU_ADDRESS 0x7F9188 /end MEASUREMENT
/begin MEASUREMENT PFlt_facAshCorDiffB1_mp "Korrekturfaktor" SWORD Fact 1 100 -4.000000 3.999878 FORMAT "%8.6" ECU_ADDRESS 0x8FF012 /end MEASUREMENT
/begin MEASUREMENT PFlt_facAshCorDiffB2_mp "Korrekturfaktor" SWORD Fact 1 100 -4.000000 3.999878 FORMAT "%8.6" ECU_ADDRESS 0x8FF014 /end MEASUREMENT
/begin MEASUREMENT PFlt_facAshVolCorB1_mp "Aschevolumen-abhängiger Korrekturfaktor des Differenzdrukkes Bank 1" SWORD Fact4 1 100 -1638.400 1638.350 FORMAT "%8.3" ECU_ADDRESS 0x8FF19C /end MEASUREMENT
/begin MEASUREMENT PFlt_facAshVolCorB2_mp "Aschevolumen-abhängiger Korrekturfaktor des Differenzdrukkes Bank 2" SWORD Fact4 1 100 -1638.400 1638.350 FORMAT "%8.3" ECU_ADDRESS 0x8FF19E /end MEASUREMENT
/begin MEASUREMENT PFlt_facDvolNO2B1_mp "Korrekturfaktor der NOx/ NO2-Umwandlung in Abhängigkeit der Verweildauer des Abgases im Oxidationskatalysator Bank 1" SWORD Fact 1 100 -4.000000 3.999878 FORMAT "%8.6" ECU_ADDRESS 0x8FF1A0 /end MEASUREMENT
/begin MEASUREMENT PFlt_facDvolNO2B2_mp "Korrekturfaktor der NOx/ NO2-Umwandlung in Abhängigkeit der Verweildauer des Abgases im Oxidationskatalysator Bank 2" SWORD Fact 1 100 -4.000000 3.999878 FORMAT "%8.6" ECU_ADDRESS 0x8FF1A2 /end MEASUREMENT
/begin MEASUREMENT PFlt_facEGRCorRat_mp "ARF-Korrekturrate" SWORD FactLow 1 100 -32.00000 31.99902 FORMAT "%8.5" ECU_ADDRESS 0x8FF1A4 /end MEASUREMENT
/begin MEASUREMENT PFlt_facEGRNOx_mp "Korrekturfaktor der stationären simulierten NOx-Emission in Abhängigkeit der AGR-Korrekturrate" SWORD Fact3 1 100 -8.000000 7.999756 FORMAT "%8.6" ECU_ADDRESS 0x8FF1A6 /end MEASUREMENT
/begin MEASUREMENT PFlt_facEGRSotSimBas_mp "Korrekturfaktor der stationären simulierten Rußemission in Abhängigkeit der AGR-Korrekturrate" SWORD Fact3 1 100 -8.000000 7.999756 FORMAT "%8.6" ECU_ADDRESS 0x8FF1A8 /end MEASUREMENT
/begin MEASUREMENT PFlt_facFlTrmUnlim_mp "Adjustment size put down in the EEPROM" SWORD Fact 1 100 -4.000000 3.999878 FORMAT "%8.6" ECU_ADDRESS 0x8FF0AA /end MEASUREMENT
/begin MEASUREMENT PFlt_facFlTrm_mp "limited adjustment size" SWORD Fact 1 100 -4.000000 3.999878 FORMAT "%8.6" ECU_ADDRESS 0x8FF0AC /end MEASUREMENT
/begin MEASUREMENT PFlt_facMltCorB1_mp "Korrekturfaktor Additivasche(Bank1)." SWORD Fact 1 100 -4.000000 3.999878 FORMAT "%8.6" ECU_ADDRESS 0x6F82D6 /end MEASUREMENT
/begin MEASUREMENT PFlt_facMltCorB2_mp "Korrekturfaktor Additivasche(Bank2)." SWORD Fact 1 100 -4.000000 3.999878 FORMAT "%8.6" ECU_ADDRESS 0x6F82D8 /end MEASUREMENT
/begin MEASUREMENT PFlt_facNO2RgnB1 "" SWORD Fact 1 100 -4.000000 3.999878 FORMAT "%8.6" ECU_ADDRESS 0x7F918A /end MEASUREMENT
/begin MEASUREMENT PFlt_facNO2RgnB2 "" SWORD Fact 1 100 -4.000000 3.999878 FORMAT "%8.6" ECU_ADDRESS 0x7F918C /end MEASUREMENT
/begin MEASUREMENT PFlt_facNO2RgnTmp_mp "" SWORD Fact 1 100 -4.000000 3.999878 FORMAT "%8.6" ECU_ADDRESS 0x8FF0AE /end MEASUREMENT
/begin MEASUREMENT PFlt_facPOpOilAshAvrgB1_mp "gemittelter Korrekturfaktor für Ölascheeintrag in den Partikelfilter Bank 1" SWORD Fact 1 100 -4.000000 3.999878 FORMAT "%8.6" ECU_ADDRESS 0x8FF1AA /end MEASUREMENT
/begin MEASUREMENT PFlt_facPOpOilAshAvrgB2_mp "gemittelter Korrekturfaktor für Ölascheeintrag in den Partikelfilter Bank 2" SWORD Fact 1 100 -4.000000 3.999878 FORMAT "%8.6" ECU_ADDRESS 0x8FF1AC /end MEASUREMENT
/begin MEASUREMENT PFlt_facPOpOilAshSumB1_mp "Summe der Korrekturfaktoren für Ölascheeintrag in den Partikelfilter - Bank1" ULONG Fact4 1 100 0.00 214748364.750 FORMAT "%13.3" ECU_ADDRESS 0x8FF1B0 /end MEASUREMENT
/begin MEASUREMENT PFlt_facPOpOilAshSumB2_mp "Summe der Korrekturfaktoren für Ölascheeintrag in den Partikelfilter - Bank2" ULONG Fact4 1 100 0.00 214748364.750 FORMAT "%13.3" ECU_ADDRESS 0x8FF1B4 /end MEASUREMENT
/begin MEASUREMENT PFlt_facPOpOilAsh_mp "aktueller Korrekturfaktor für Ölascheeintrag in den Partikelfil" SWORD Fact4 1 100 -1638.400 1638.350 FORMAT "%8.3" ECU_ADDRESS 0x8FF1B8 /end MEASUREMENT
/begin MEASUREMENT PFlt_facSotSimRgnNO2B1_mp "Faktor für Beladungsabhängigkeit des NO2-Effektes - Bank 1" SWORD Fact 1 100 -4.000000 3.999878 FORMAT "%8.6" ECU_ADDRESS 0x8FF1BA /end MEASUREMENT
/begin MEASUREMENT PFlt_facSotSimRgnNO2B2_mp "Faktor für Beladungsabhängigkeit des NO2-Effektes - Bank 2" SWORD Fact 1 100 -4.000000 3.999878 FORMAT "%8.6" ECU_ADDRESS 0x8FF1BC /end MEASUREMENT
/begin MEASUREMENT PFlt_facSumTrmUnlim_mp "Adjustment size put down in the EEPROM" SWORD Fact 1 100 -4.000000 3.999878 FORMAT "%8.6" ECU_ADDRESS 0x8FF0B0 /end MEASUREMENT
/begin MEASUREMENT PFlt_facSumTrm_mp "limited adjustment size" SWORD Fact 1 100 -4.000000 3.999878 FORMAT "%8.6" ECU_ADDRESS 0x8FF0B2 /end MEASUREMENT
/begin MEASUREMENT PFlt_facTempCRTB1 "" SWORD Fact 1 100 -4.000000 3.999878 FORMAT "%8.6" ECU_ADDRESS 0x7F918E /end MEASUREMENT
/begin MEASUREMENT PFlt_facTempCRTB2 "" SWORD Fact 1 100 -4.000000 3.999878 FORMAT "%8.6" ECU_ADDRESS 0x7F9190 /end MEASUREMENT
/begin MEASUREMENT PFlt_facTempIB1_mp "" SWORD Fact 1 100 -4.000000 3.999878 FORMAT "%8.6" ECU_ADDRESS 0x8FF22A /end MEASUREMENT
/begin MEASUREMENT PFlt_facTempIB2_mp "" SWORD Fact 1 100 -4.000000 3.999878 FORMAT "%8.6" ECU_ADDRESS 0x8FF22C /end MEASUREMENT
/begin MEASUREMENT PFlt_facTempSnceRgnB1_mp "" SWORD Fact 1 100 -4.000000 3.999878 FORMAT "%8.6" ECU_ADDRESS 0x8FF22E /end MEASUREMENT
/begin MEASUREMENT PFlt_facTempSnceRgnB2_mp "" SWORD Fact 1 100 -4.000000 3.999878 FORMAT "%8.6" ECU_ADDRESS 0x8FF230 /end MEASUREMENT
/begin MEASUREMENT PFlt_lAshCorAct_mp "Zwischenwert Kilometerstand" UWORD LengthKm 1 100 0.00 65535.00 FORMAT "%8.2" ECU_ADDRESS 0x8FF016 /end MEASUREMENT
/begin MEASUREMENT PFlt_lAshCorNext "Kilometer für die nächste(folgende) Abgleichung" ULONG LengthKm 1 100 0.00 4294967295.00 FORMAT "%13.2" ECU_ADDRESS 0x7F9474 /end MEASUREMENT
/begin MEASUREMENT PFlt_lAshCorNextEEProm_mp "nächster Kilometerstand für Ascheabgelichregeneration, gelesen vom EEPROM bei Motorstart" ULONG LengthKm 1 100 0.00 4294967295.00 FORMAT "%13.2" ECU_ADDRESS 0x8FF018 /end MEASUREMENT
/begin MEASUREMENT PFlt_lAshCorNextMax_mp "Messender Punkt für folgende maximale Aschenkorrektur" ULONG LengthKm 1 100 0.00 4294967295.00 FORMAT "%13.2" ECU_ADDRESS 0x8FF01C /end MEASUREMENT
/begin MEASUREMENT PFlt_lAshCorNextOilCor_mp "Messender Punkt für folgendes maximales Aschen ölen Korrektur." ULONG LengthKm 1 100 0.00 4294967295.00 FORMAT "%13.2" ECU_ADDRESS 0x8FF020 /end MEASUREMENT
/begin MEASUREMENT PFlt_lAshCorOldCalc_mp "Messender Punkt für alten Aschenkorrekturwert." ULONG LengthKm 1 100 0.00 4294967295.00 FORMAT "%13.2" ECU_ADDRESS 0x8FF024 /end MEASUREMENT
/begin MEASUREMENT PFlt_lAshCorStep_mp "Schrittgröße für Aschenkorrektur." UWORD LengthKm 1 100 0.00 65535.00 FORMAT "%8.2" ECU_ADDRESS 0x8FF028 /end MEASUREMENT
/begin MEASUREMENT PFlt_lAvrgSnceHCCondB1_mp "Strecke pro Fahrzyklus seit HC Conditionierung für Bank1" SWORD lSnceRgnRes 1 100 -4194304. 4194176. FORMAT "%8.0" ECU_ADDRESS 0x8FF062 /end MEASUREMENT
/begin MEASUREMENT PFlt_lAvrgSnceHCCondB2_mp "Strecke pro Fahrzyklus seit HC Conditionierung für bank2" SWORD lSnceRgnRes 1 100 -4194304. 4194176. FORMAT "%8.0" ECU_ADDRESS 0x8FF064 /end MEASUREMENT
/begin MEASUREMENT PFlt_lAvrgSnceHCCond_mp "Strecke pro Fahrzyklus seit HC Conditionierung" SWORD lSnceRgnRes 1 100 -4194304. 4194176. FORMAT "%8.0" ECU_ADDRESS 0x8FF066 /end MEASUREMENT
/begin MEASUREMENT PFlt_lAvrgSnceRgnB1_mp "Durchschnittlicher Abstand reiste seit letzter Regeneration" SWORD lSnceRgnRes 1 100 -4194304. 4194176. FORMAT "%8.0" ECU_ADDRESS 0x8FF0B4 /end MEASUREMENT
/begin MEASUREMENT PFlt_lAvrgSnceRgnB2_mp "Durchschnittlicher Abstand reiste seit letzter Regeneration" SWORD lSnceRgnRes 1 100 -4194304. 4194176. FORMAT "%8.0" ECU_ADDRESS 0x8FF0B6 /end MEASUREMENT
/begin MEASUREMENT PFlt_lAvrgSnceRgn_mp "Durchschnittlicher Abstand reiste seit letzter Regeneration" SWORD lSnceRgnRes 1 100 -4194304. 4194176. FORMAT "%8.0" ECU_ADDRESS 0x8FF0B8 /end MEASUREMENT
/begin MEASUREMENT PFlt_lSnceHCCondB1_mp "Strecke seit HC Conditionierung für bank1" SWORD lSnceRgnRes 1 100 -4194304. 4194176. FORMAT "%8.0" ECU_ADDRESS 0x8FF068 /end MEASUREMENT
/begin MEASUREMENT PFlt_lSnceHCCondB2_mp "Strecke seit HC Conditionierung für bank2" SWORD lSnceRgnRes 1 100 -4194304. 4194176. FORMAT "%8.0" ECU_ADDRESS 0x8FF06A /end MEASUREMENT
/begin MEASUREMENT PFlt_lSnceRgnB1 "Gefahrener Abstand seit letzter erfolgreicher Regeneration für Partikel filter(Bank 1)" ULONG Length 1 100 0.00 4294967295.00 FORMAT "%13.2" ECU_ADDRESS 0x7F9478 /end MEASUREMENT
/begin MEASUREMENT PFlt_lSnceRgnB1_mp "Gefahrene Strecke seit der letzten erfolgreichen Regeneration für Bank1" ULONG Length 1 100 0.00 4294967295.00 FORMAT "%13.2" ECU_ADDRESS 0x8FF0BC /end MEASUREMENT
/begin MEASUREMENT PFlt_lSnceRgnB2 "Gefahrener Abstand seit letzter erfolgreicher Regeneration für Partikel filter(Bank 2)" ULONG Length 1 100 0.00 4294967295.00 FORMAT "%13.2" ECU_ADDRESS 0x7F947C /end MEASUREMENT
/begin MEASUREMENT PFlt_lSnceRgnB2_mp "Gefahrene Strecke seit der letzten erfolgreichen Regeneration für Bank2" ULONG Length 1 100 0.00 4294967295.00 FORMAT "%13.2" ECU_ADDRESS 0x8FF0C0 /end MEASUREMENT
/begin MEASUREMENT PFlt_lSnceRgnu16B1_mp "Gefahrener Abstand, seit letzte erfolgreiche Regeneration mit verringerter Auflösung" UWORD lSnceRgnRes 1 100 0.00 8388480. FORMAT "%8.0" ECU_ADDRESS 0x6F8298 /end MEASUREMENT
/begin MEASUREMENT PFlt_lSnceRgnu16B2_mp "Gefahrener Abstand, seit letzte erfolgreiche Regeneration mit verringerter Auflösung (Bank 2)" UWORD lSnceRgnRes 1 100 0.00 8388480. FORMAT "%8.0" ECU_ADDRESS 0x6F829A /end MEASUREMENT
/begin MEASUREMENT PFlt_lSumB1_mp "Insgesamt gefahrene Strecke bei der letzten erfolgreichen Regeneration für Bank1" ULONG Length 1 100 0.00 4294967295.00 FORMAT "%13.2" ECU_ADDRESS 0x6F829C /end MEASUREMENT
/begin MEASUREMENT PFlt_lSumB2_mp "Insgesamt gefahrene Strecke bei der letzten erfolgreichen Regeneration für Bank2" ULONG Length 1 100 0.00 4294967295.00 FORMAT "%13.2" ECU_ADDRESS 0x6F82A0 /end MEASUREMENT
/begin MEASUREMENT PFlt_lSumHCCondB1_mp " km Stand bei der letzten HC Conditionierung für Bank1" UWORD lSumRes 1 100 0.00 1073725440. ECU_ADDRESS 0x8FF06C /end MEASUREMENT
/begin MEASUREMENT PFlt_lSumHCCondB2_mp " km Stand bei der letzten HC Conditionierung für Bank2" UWORD lSumRes 1 100 0.00 1073725440. ECU_ADDRESS 0x8FF06E /end MEASUREMENT
/begin MEASUREMENT PFlt_lSumMaxB1_mp "Maximale Strecke seit letzter erfolgreicher regeneration" ULONG Length 1 100 0.00 4294967295.00 FORMAT "%13.2" ECU_ADDRESS 0x8FF0C4 /end MEASUREMENT
/begin MEASUREMENT PFlt_lSumMaxB2_mp "Maximale Strecke seit letzter erfolgreicher regeneration" ULONG Length 1 100 0.00 4294967295.00 FORMAT "%13.2" ECU_ADDRESS 0x8FF0C8 /end MEASUREMENT
/begin MEASUREMENT PFlt_lSumMaxHCCondB1_mp "Lastkollektivabhängiges HC Conditionier intervall für Bank1" SWORD lSnceRgnRes 1 100 -4194304. 4194176. FORMAT "%8.0" ECU_ADDRESS 0x8FF070 /end MEASUREMENT
/begin MEASUREMENT PFlt_lSumMaxHCCondB2_mp "" SWORD lSnceRgnRes 1 100 -4194304. 4194176. FORMAT "%8.0" ECU_ADDRESS 0x8FF072 /end MEASUREMENT
/begin MEASUREMENT PFlt_lSumu16B1_mp "Zählen Sie gefahrenen Abstand mit verringerter Auflösung für Bank1 zusammen" UWORD lSumRes 1 100 0.00 1073725440. ECU_ADDRESS 0x8FF0CC /end MEASUREMENT
/begin MEASUREMENT PFlt_lSumu16B2_mp "Zählen Sie gefahrenen Abstand mit verringerter Auflösung für Bank2 zusammen" UWORD lSumRes 1 100 0.00 1073725440. ECU_ADDRESS 0x8FF0CE /end MEASUREMENT
/begin MEASUREMENT PFlt_mAshCorActB1 "aktuelle Aschemenge für Bank 1" SWORD mSoot_g 1 100 -327.6800 327.6700 FORMAT "%8.4" ECU_ADDRESS 0x7F9194 /end MEASUREMENT
/begin MEASUREMENT PFlt_mAshCorActB2 "aktuelle Aschemenge für Bank 2" SWORD mSoot_g 1 100 -327.6800 327.6700 FORMAT "%8.4" ECU_ADDRESS 0x7F9196 /end MEASUREMENT
/begin MEASUREMENT PFlt_mAshCorActRelB1_mp "aktuell relative Abweichung der neu berechneten Aschemenge" SWORD mSoot_g 1 100 -327.6800 327.6700 FORMAT "%8.4" ECU_ADDRESS 0x8FF02A /end MEASUREMENT
/begin MEASUREMENT PFlt_mAshCorActRelB2_mp "aktuell relative Abweichung der neu berechneten Aschemenge" SWORD mSoot_g 1 100 -327.6800 327.6700 FORMAT "%8.4" ECU_ADDRESS 0x8FF02C /end MEASUREMENT
/begin MEASUREMENT PFlt_mAshCorDiff1B1_mp "Absolutbetrag von PFlt_mAshCorDiff_mp" SWORD mSoot_g 1 100 -327.6800 327.6700 FORMAT "%8.4" ECU_ADDRESS 0x8FF02E /end MEASUREMENT
/begin MEASUREMENT PFlt_mAshCorDiff1B2_mp "Absolutbetrag von PFlt_mAshCorDiff_mp" SWORD mSoot_g 1 100 -327.6800 327.6700 FORMAT "%8.4" ECU_ADDRESS 0x8FF030 /end MEASUREMENT
/begin MEASUREMENT PFlt_mAshCorDiff2B1_mp "absoluter Zwischenwert für die Aschenmasse" SWORD mSoot_g 1 100 -327.6800 327.6700 FORMAT "%8.4" ECU_ADDRESS 0x8FF032 /end MEASUREMENT
/begin MEASUREMENT PFlt_mAshCorDiff2B2_mp "absoluter Zwischenwert für die Aschenmasse" SWORD mSoot_g 1 100 -327.6800 327.6700 FORMAT "%8.4" ECU_ADDRESS 0x8FF034 /end MEASUREMENT
/begin MEASUREMENT PFlt_mAshCorDiffB1_mp "output of PFlt_mAshCor_MAP" SWORD mSoot_g 1 100 -327.6800 327.6700 FORMAT "%8.4" ECU_ADDRESS 0x8FF036 /end MEASUREMENT
/begin MEASUREMENT PFlt_mAshCorDiffB2_mp "output of PFlt_mAshCor_MAP" SWORD mSoot_g 1 100 -327.6800 327.6700 FORMAT "%8.4" ECU_ADDRESS 0x8FF038 /end MEASUREMENT
/begin MEASUREMENT PFlt_mAshCorNewB1 "neu berechnete Aschemenge für Bank 1" SWORD mSoot_g 1 100 -327.6800 327.6700 FORMAT "%8.4" ECU_ADDRESS 0x7F9198 /end MEASUREMENT
/begin MEASUREMENT PFlt_mAshCorNewB2 "neu berechnete Aschemenge für Bank 2" SWORD mSoot_g 1 100 -327.6800 327.6700 FORMAT "%8.4" ECU_ADDRESS 0x7F919A /end MEASUREMENT
/begin MEASUREMENT PFlt_mAshCorOldB1 "alte Aschemenge für Bank 1" SWORD mSoot_g 1 100 -327.6800 327.6700 FORMAT "%8.4" ECU_ADDRESS 0x7F919C /end MEASUREMENT
/begin MEASUREMENT PFlt_mAshCorOldB2 "alte Aschemenge für Bank 2" SWORD mSoot_g 1 100 -327.6800 327.6700 FORMAT "%8.4" ECU_ADDRESS 0x7F919E /end MEASUREMENT
/begin MEASUREMENT PFlt_mAshOil "particle filter Oil ash mass" SWORD mSoot_g 1 100 -327.6800 327.6700 FORMAT "%8.4" ECU_ADDRESS 0x7F91A0 /end MEASUREMENT
/begin MEASUREMENT PFlt_mAshOilB1 "particle filter Oil ash mass for Bank1" SWORD mSoot_g 1 100 -327.6800 327.6700 FORMAT "%8.4" ECU_ADDRESS 0x7F91A2 /end MEASUREMENT
/begin MEASUREMENT PFlt_mAshOilB2 "particle filter Oil ash mass for Bank2" SWORD mSoot_g 1 100 -327.6800 327.6700 FORMAT "%8.4" ECU_ADDRESS 0x7F91A4 /end MEASUREMENT
/begin MEASUREMENT PFlt_mAshOil_mp "Ölaschenmasse" SWORD mSoot_g 1 100 -327.6800 327.6700 FORMAT "%8.4" ECU_ADDRESS 0x8FF0D0 /end MEASUREMENT
/begin MEASUREMENT PFlt_mSotB1 "Rußmasse im Partikelfilter(Bank1)." SWORD mSoot_g 1 100 -327.6800 327.6700 FORMAT "%8.4" ECU_ADDRESS 0x7F91AA /end MEASUREMENT
/begin MEASUREMENT PFlt_mSotB2 "Rußmasse im Partikelfilter(Bank2)." SWORD mSoot_g 1 100 -327.6800 327.6700 FORMAT "%8.4" ECU_ADDRESS 0x7F91AC /end MEASUREMENT
/begin MEASUREMENT PFlt_mSotCrvB1_mp "Partikelmasse zur Berücksichtung des Korrekturfaktors(Bank1)." SWORD mSoot_g 1 100 -327.6800 327.6700 FORMAT "%8.4" ECU_ADDRESS 0x8FF1BE /end MEASUREMENT
/begin MEASUREMENT PFlt_mSotCrvB2_mp "Partikelmasse zur Berücksichtung des Korrekturfaktors(Bank2)." SWORD mSoot_g 1 100 -327.6800 327.6700 FORMAT "%8.4" ECU_ADDRESS 0x8FF1C0 /end MEASUREMENT
/begin MEASUREMENT PFlt_mSotCrvIn_mp "Kopie von PFlt_mSotCrv%_mp, die als Eingang für Kennlinien und Kennfelde gegeben wird." SWORD mSoot_g 1 100 -327.6800 327.6700 FORMAT "%8.4" ECU_ADDRESS 0x8FF1C2 /end MEASUREMENT
/begin MEASUREMENT PFlt_mSotEEPROMB1_mp "Partikelmasse in DPF auf Bank1 abgespeichert im EEPROM" SWORD mSoot_g 1 100 -327.6800 327.6700 FORMAT "%8.4" ECU_ADDRESS 0x8FF1C4 /end MEASUREMENT
/begin MEASUREMENT PFlt_mSotEEPROMB2_mp "Partikelmasse in DPF auf Bank2 abgespeichert im EEPROM" SWORD mSoot_g 1 100 -327.6800 327.6700 FORMAT "%8.4" ECU_ADDRESS 0x8FF1C6 /end MEASUREMENT
/begin MEASUREMENT PFlt_mSotMeasB1 "uncorrected soot mass of physical model for Bank1" SWORD mSoot_g 1 100 -327.6800 327.6700 FORMAT "%8.4" ECU_ADDRESS 0x7F91AE /end MEASUREMENT
/begin MEASUREMENT PFlt_mSotMeasB2 "uncorrected soot mass of physical model for Bank2" SWORD mSoot_g 1 100 -327.6800 327.6700 FORMAT "%8.4" ECU_ADDRESS 0x7F91B0 /end MEASUREMENT
/begin MEASUREMENT PFlt_mSotMeasRawB1_mp "Strömungswdst. in Partikelmasse umgerechnet(Bank1)." SWORD mSoot_g 1 100 -327.6800 327.6700 FORMAT "%8.4" ECU_ADDRESS 0x6F82DA /end MEASUREMENT
/begin MEASUREMENT PFlt_mSotMeasRawB2_mp "Strömungswdst. in Partikelmasse umgerechnet(Bank2)." SWORD mSoot_g 1 100 -327.6800 327.6700 FORMAT "%8.4" ECU_ADDRESS 0x6F82DC /end MEASUREMENT
/begin MEASUREMENT PFlt_mSotOfsB1_mp "Korrekturwert äquivalenter Massenoffset auf Bank2" SWORD mSoot_g 1 100 -327.6800 327.6700 FORMAT "%8.4" ECU_ADDRESS 0x8FF0D2 /end MEASUREMENT
/begin MEASUREMENT PFlt_mSotOfsB2_mp "Korrekturwert äquivalenter Massenoffset auf Bank2" SWORD mSoot_g 1 100 -327.6800 327.6700 FORMAT "%8.4" ECU_ADDRESS 0x8FF0D4 /end MEASUREMENT
/begin MEASUREMENT PFlt_mSotResActB1_mp "aktuelle betriebspunktabhängige Restrussmasse im Partikelfilter nach erflogreicher Regeneration - Bank 1" SWORD mSoot_g 1 100 -327.6800 327.6700 FORMAT "%8.4" ECU_ADDRESS 0x8FF1C8 /end MEASUREMENT
/begin MEASUREMENT PFlt_mSotResActB2_mp "aktuelle betriebspunktabhängige Restrussmasse im Partikelfilter nach erflogreicher Regeneration - Bank 2" SWORD mSoot_g 1 100 -327.6800 327.6700 FORMAT "%8.4" ECU_ADDRESS 0x8FF1CA /end MEASUREMENT
/begin MEASUREMENT PFlt_mSotResB1_mp "Restrussmasse im Partikelfilter nach erfolgreicher Regeneration  - Bank 1" SWORD mSoot_g 1 100 -327.6800 327.6700 FORMAT "%8.4" ECU_ADDRESS 0x8FF1CC /end MEASUREMENT
/begin MEASUREMENT PFlt_mSotResB2_mp "Restrussmasse im Partikelfilter nach erfolgreicher Regeneration  - Bank 2" SWORD mSoot_g 1 100 -327.6800 327.6700 FORMAT "%8.4" ECU_ADDRESS 0x8FF1CE /end MEASUREMENT
/begin MEASUREMENT PFlt_mSotSimB1 "Simulierte Rußmasse im Partikel Filter für Bank1" SWORD mSoot_g 1 100 -327.6800 327.6700 FORMAT "%8.4" ECU_ADDRESS 0x7F91B2 /end MEASUREMENT
/begin MEASUREMENT PFlt_mSotSimB2 "Simulierte Rußmasse im Partikel Filter für Bank2" SWORD mSoot_g 1 100 -327.6800 327.6700 FORMAT "%8.4" ECU_ADDRESS 0x7F91B4 /end MEASUREMENT
/begin MEASUREMENT PFlt_mSotSimContB1 "kontinuierlich simulierte Rußmasse im Partikelfilter Bank 1" SWORD mSoot_g 1 100 -327.6800 327.6700 FORMAT "%8.4" ECU_ADDRESS 0x7F91B6 /end MEASUREMENT
/begin MEASUREMENT PFlt_mSotSimContB2 "kontinuierlich simulierte Rußmasse im Partikelfilter Bank 2" SWORD mSoot_g 1 100 -327.6800 327.6700 FORMAT "%8.4" ECU_ADDRESS 0x7F91B8 /end MEASUREMENT
/begin MEASUREMENT PFlt_mSotSimInitB1 "Initialisierungswert des Simulationsintegrators von der Rußmasse   - Bank1" SWORD mSoot_g 1 100 -327.6800 327.6700 FORMAT "%8.4" ECU_ADDRESS 0x7F91BA /end MEASUREMENT
/begin MEASUREMENT PFlt_mSotSimInitB2 "Initialisierungswert des Simulationsintegrators von der Rußmasse   - Bank2" SWORD mSoot_g 1 100 -327.6800 327.6700 FORMAT "%8.4" ECU_ADDRESS 0x7F91BC /end MEASUREMENT
/begin MEASUREMENT PFlt_mSotSimIn_mp "Kopie von PFlt_mSotSim%_mp, die als Eingang für Kennlinien und Kennfelde gegeben wird." SWORD mSoot_g 1 100 -327.6800 327.6700 FORMAT "%8.4" ECU_ADDRESS 0x8FF1D0 /end MEASUREMENT
/begin MEASUREMENT PFlt_mSotSimNoContB1_mp "Nicht kontinuierlich simulierte Russmasse im Partikelfilter - Bank 1" SWORD mSoot_g 1 100 -327.6800 327.6700 FORMAT "%8.4" ECU_ADDRESS 0x8FF1D2 /end MEASUREMENT
/begin MEASUREMENT PFlt_mSotSimNoContB2_mp "Nicht kontinuierlich simulierte Russmasse im Partikelfilter - Bank 2" SWORD mSoot_g 1 100 -327.6800 327.6700 FORMAT "%8.4" ECU_ADDRESS 0x8FF1D4 /end MEASUREMENT
/begin MEASUREMENT PFlt_nAvrgFltAshCor_mp "gefilterter Wert Drehzahl" SWORD EngN 1 100 -32768.00 32767.00 FORMAT "%8.2" ECU_ADDRESS 0x8FF03A /end MEASUREMENT
/begin MEASUREMENT PFlt_nAvrgFlt_mp "Eng_nAvrg PT1 gefiltert" SWORD EngN 1 100 -32768.00 32767.00 FORMAT "%8.2" ECU_ADDRESS 0x8FF13A /end MEASUREMENT
/begin MEASUREMENT PFlt_numEngPOp "Regenerationsnummer nach Berücksichtigung des Fahrzeugzustandes" UBYTE OneToOne 1 100 0.00 255.0 FORMAT "%5.1" ECU_ADDRESS 0x7F89D6 /end MEASUREMENT
/begin MEASUREMENT PFlt_numEngPOp_mp "Regeneationsmaßnahme nach Berücksichtigung des Motorbetriebspunktes" UBYTE OneToOne 1 100 0.00 255.0 FORMAT "%5.1" ECU_ADDRESS 0x6F82A4 /end MEASUREMENT
/begin MEASUREMENT PFlt_numHCCondPrtB1 "HC Überconditioniererkennungs Regenerationsanforderungszahl für Bank1" UBYTE OneToOne 1 100 0.00 255.0 FORMAT "%5.1" ECU_ADDRESS 0x7F89D7 /end MEASUREMENT
/begin MEASUREMENT PFlt_numHCCondPrtB2 "HC Überconditioniererkennungs Regenerationsanforderungszahl für Bank2" UBYTE OneToOne 1 100 0.00 255.0 FORMAT "%5.1" ECU_ADDRESS 0x7F89D8 /end MEASUREMENT
/begin MEASUREMENT PFlt_numLstB1_mp "Regenerationsanforderung aufgrund verbr. Treibstoff, Betriebszeit oder Strecke auf Bank1" UBYTE OneToOne 1 100 0.00 255.0 FORMAT "%5.1" ECU_ADDRESS 0x8FF0D6 /end MEASUREMENT
/begin MEASUREMENT PFlt_numLstB2_mp "Regenerationsanforderung aufgrund verbr. Treibstoff, Betriebszeit oder Strecke auf Bank2" UBYTE OneToOne 1 100 0.00 255.0 FORMAT "%5.1" ECU_ADDRESS 0x8FF0D7 /end MEASUREMENT
/begin MEASUREMENT PFlt_numPrio "Priorität für angeforderten Regenerationszustand" UWORD OneToOne 1 100 0.00 65535.00 FORMAT "%8.2" ECU_ADDRESS 0x7F91BE /end MEASUREMENT
/begin MEASUREMENT PFlt_numPrj "Regenerationsanforderungszahl" UBYTE OneToOne 1 100 0.00 255.0 FORMAT "%5.1" ECU_ADDRESS 0x7F89D9 /end MEASUREMENT
/begin MEASUREMENT PFlt_numPrtB1_mp "Regenerationsanforderung aufgrund Motorschutz für Bank 1" UBYTE OneToOne 1 100 0.00 255.0 FORMAT "%5.1" ECU_ADDRESS 0x8FF0D8 /end MEASUREMENT
/begin MEASUREMENT PFlt_numPrtB2_mp "Regenerationsanforderung aufgrund Motorschutz für Bank2" UBYTE OneToOne 1 100 0.00 255.0 FORMAT "%5.1" ECU_ADDRESS 0x8FF0D9 /end MEASUREMENT
/begin MEASUREMENT PFlt_numRgn "Regenerationsanforderungszahl" UBYTE OneToOne 1 100 0.00 255.0 FORMAT "%5.1" ECU_ADDRESS 0x7F89DA /end MEASUREMENT
/begin MEASUREMENT PFlt_numRgnB1 "Regenerationsnachfragezahl für Bank1" UBYTE OneToOne 1 100 0.00 255.0 FORMAT "%5.1" ECU_ADDRESS 0x7F89DB /end MEASUREMENT
/begin MEASUREMENT PFlt_numRgnB1_mp "gesamte Regenerationsanforderung Bank1" UBYTE OneToOne 1 100 0.00 255.0 FORMAT "%5.1" ECU_ADDRESS 0x6F82A5 /end MEASUREMENT
/begin MEASUREMENT PFlt_numRgnB2 "Regenerationsnachfragezahl für Bank2" UBYTE OneToOne 1 100 0.00 255.0 FORMAT "%5.1" ECU_ADDRESS 0x7F89DC /end MEASUREMENT
/begin MEASUREMENT PFlt_numRgnB2_mp "gesamte Regenerationsanforderung Bank2" UBYTE OneToOne 1 100 0.00 255.0 FORMAT "%5.1" ECU_ADDRESS 0x6F82A6 /end MEASUREMENT
/begin MEASUREMENT PFlt_numRgn_mp "gesamte Regenerationsanforderung" UBYTE OneToOne 1 100 0.00 255.0 FORMAT "%5.1" ECU_ADDRESS 0x6F82A7 /end MEASUREMENT
/begin MEASUREMENT PFlt_numSotB1_mp "Beladungszustand des DPF Bank1" UBYTE OneToOne 1 100 0.00 255.0 FORMAT "%5.1" ECU_ADDRESS 0x8FF0DA /end MEASUREMENT
/begin MEASUREMENT PFlt_numSotB2_mp "Beladungszustand des DPF Bank2" UBYTE OneToOne 1 100 0.00 255.0 FORMAT "%5.1" ECU_ADDRESS 0x8FF0DB /end MEASUREMENT
/begin MEASUREMENT PFlt_numTot "Regenerationsanforderung nach engpopcalc" UBYTE OneToOne 1 100 0.00 255.0 FORMAT "%5.1" ECU_ADDRESS 0x7F89DD /end MEASUREMENT
/begin MEASUREMENT PFlt_numTot_mp "Regeneationsmaßnahme nach Berücksichtigung des Motorbetriebspunktes" UBYTE OneToOne 1 100 0.00 255.0 FORMAT "%5.1" ECU_ADDRESS 0x8FF0DC /end MEASUREMENT
/begin MEASUREMENT PFlt_pDiffAshVolCorB1_mp "Differenzdruck des aschebeladenen Partikelfilters - Bank 1" SWORD Pres_hPa 1 100 -32768.00 32767.00 FORMAT "%8.2" ECU_ADDRESS 0x8FF1D6 /end MEASUREMENT
/begin MEASUREMENT PFlt_pDiffAshVolCorB2_mp "Differenzdruck des aschebeladenen Partikelfilters - Bank 2" SWORD Pres_hPa 1 100 -32768.00 32767.00 FORMAT "%8.2" ECU_ADDRESS 0x8FF1D8 /end MEASUREMENT
/begin MEASUREMENT PFlt_pDiffPFltB1_mp "Differenzdruck des leeren Partikelfilters Bank 1" SWORD Pres_hPa 1 100 -32768.00 32767.00 FORMAT "%8.2" ECU_ADDRESS 0x8FF1DA /end MEASUREMENT
/begin MEASUREMENT PFlt_pDiffPFltB2_mp "Differenzdruck des leeren Partikelfilters Bank 2" SWORD Pres_hPa 1 100 -32768.00 32767.00 FORMAT "%8.2" ECU_ADDRESS 0x8FF1DC /end MEASUREMENT
/begin MEASUREMENT PFlt_pDiffSotB1_mp "Differenzdruckanteil des Rußes im Partikelfilter Bank 1" SWORD Pres_hPa 1 100 -32768.00 32767.00 FORMAT "%8.2" ECU_ADDRESS 0x8FF1DE /end MEASUREMENT
/begin MEASUREMENT PFlt_pDiffSotB2_mp "Differenzdruckanteil des Rußes im Partikelfilter Bank 2" SWORD Pres_hPa 1 100 -32768.00 32767.00 FORMAT "%8.2" ECU_ADDRESS 0x8FF1E0 /end MEASUREMENT
/begin MEASUREMENT PFlt_pDiffSot_mp "Differenzdruckanteil des Rußes im Partikelfilter" SWORD Pres_hPa 1 100 -32768.00 32767.00 FORMAT "%8.2" ECU_ADDRESS 0x8FF1E2 /end MEASUREMENT
/begin MEASUREMENT PFlt_pDiff_mp "Kopie des Differenzdrucks über Partikelfilter" SWORD Pres_hPa 1 100 -32768.00 32767.00 FORMAT "%8.2" ECU_ADDRESS 0x8FF1E4 /end MEASUREMENT
/begin MEASUREMENT PFlt_pEngPrtAshCorB1 "Ashedruckoffset (Ausgang von PFlt_pEngPrtAshCor_MAP korrigiert mit facAsh)" SWORD Pres_hPa 1 100 -32768.00 32767.00 FORMAT "%8.2" ECU_ADDRESS 0x7F91CA /end MEASUREMENT
/begin MEASUREMENT PFlt_pEngPrtAshCorB2 "Ashedruckoffset(Ausgang von PFlt_pEngPrtAshCor_MAP behoben mit facAsh)" SWORD Pres_hPa 1 100 -32768.00 32767.00 FORMAT "%8.2" ECU_ADDRESS 0x7F91CC /end MEASUREMENT
/begin MEASUREMENT PFlt_pEngPrtMaxB1_mp "Maximaldruck Motorschutz" SWORD Pres_hPa 1 100 -32768.00 32767.00 FORMAT "%8.2" ECU_ADDRESS 0x6F82A8 /end MEASUREMENT
/begin MEASUREMENT PFlt_pEngPrtMaxB2_mp "Maximaldruck Motorschutz" SWORD Pres_hPa 1 100 -32768.00 32767.00 FORMAT "%8.2" ECU_ADDRESS 0x6F82AA /end MEASUREMENT
/begin MEASUREMENT PFlt_pEngPrtMinB1_mp "" SWORD Pres_hPa 1 100 -32768.00 32767.00 FORMAT "%8.2" ECU_ADDRESS 0x8FF0DE /end MEASUREMENT
/begin MEASUREMENT PFlt_pEngPrtMinB2_mp "" SWORD Pres_hPa 1 100 -32768.00 32767.00 FORMAT "%8.2" ECU_ADDRESS 0x8FF0E0 /end MEASUREMENT
/begin MEASUREMENT PFlt_qFlB1_mp "verbrauchter Treibstoff seit der letzten erfolgreichen Regeneration Bank1" SWORD Fl_L 1 100 -327.6800 327.6700 FORMAT "%8.4" ECU_ADDRESS 0x6F82AC /end MEASUREMENT
/begin MEASUREMENT PFlt_qFlB2_mp "verbrauchter Treibstoff seit der letzten erfolgreichen Regeneration Bank2" SWORD Fl_L 1 100 -327.6800 327.6700 FORMAT "%8.4" ECU_ADDRESS 0x6F82AE /end MEASUREMENT
/begin MEASUREMENT PFlt_qFlMaxB1_mp "" SWORD Fl_L 1 100 -327.6800 327.6700 FORMAT "%8.4" ECU_ADDRESS 0x8FF0E2 /end MEASUREMENT
/begin MEASUREMENT PFlt_qFlMaxB2_mp "" SWORD Fl_L 1 100 -327.6800 327.6700 FORMAT "%8.4" ECU_ADDRESS 0x8FF0E4 /end MEASUREMENT
/begin MEASUREMENT PFlt_qFlTotB1 "nach der letzten Filterreinigung verbrauchte gesamte Krafstoffmenge Bank 1" SWORD Fl_2 1 100 -327680.0 327670.0 FORMAT "%8.1" ECU_ADDRESS 0x7F91E2 /end MEASUREMENT
/begin MEASUREMENT PFlt_qFlTotB2 "nach der letzten Filterreinigung verbrauchte gesamte Krafstoffmenge Bank 2" SWORD Fl_2 1 100 -327680.0 327670.0 FORMAT "%8.1" ECU_ADDRESS 0x7F91E4 /end MEASUREMENT
/begin MEASUREMENT PFlt_qFlTotCorB1 "Gesamtmenge Kraftstoffquantitätskorrektur" SWORD Fl_2 1 100 -327680.0 327670.0 FORMAT "%8.1" ECU_ADDRESS 0x7F91E6 /end MEASUREMENT
/begin MEASUREMENT PFlt_qFlTotCorB2 "Gesamtmenge Kraftstoffquantitätskorrektur" SWORD Fl_2 1 100 -327680.0 327670.0 FORMAT "%8.1" ECU_ADDRESS 0x7F91E8 /end MEASUREMENT
/begin MEASUREMENT PFlt_qFlTotCrvIn_mp "insgesamt verbrauchte Kraftstoffmenge" SWORD Fl_2 1 100 -327680.0 327670.0 FORMAT "%8.1" ECU_ADDRESS 0x8FF1E6 /end MEASUREMENT
/begin MEASUREMENT PFlt_qFlTotEEPROMB1_mp "in EEPROM abgespeicherter Wert des Gesamtkraftstoffverbrauches für das DPF Bank1" SLONG Fl_L 1 100 -21474836.4800 21474836.4700 FORMAT "%13.4" ECU_ADDRESS 0x8FF0E8 /end MEASUREMENT
/begin MEASUREMENT PFlt_qFlTotEEPROMB2_mp "in EEPROM abgespeicherter Wert des Gesamtkraftstoffverbrauches für das DPF auf Bank2" SLONG Fl_L 1 100 -21474836.4800 21474836.4700 FORMAT "%13.4" ECU_ADDRESS 0x8FF0EC /end MEASUREMENT
/begin MEASUREMENT PFlt_qPoI2NonEffB1 "Nicht effektive PoI2-Einspritzmenge für Bank1" SWORD InjMassCyc 1 100 -327.6800 327.6700 FORMAT "%8.4" ECU_ADDRESS 0x7F91EA /end MEASUREMENT
/begin MEASUREMENT PFlt_qPoI2NonEffB2 "Nicht effektive PoI2-Einspritzmenge für Bank2" SWORD InjMassCyc 1 100 -327.6800 327.6700 FORMAT "%8.4" ECU_ADDRESS 0x7F91EC /end MEASUREMENT
/begin MEASUREMENT PFlt_qSetUnBalFltAshCor_mp "gefilterter Wert Einspritzmasse" SWORD InjMassCyc 1 100 -327.6800 327.6700 FORMAT "%8.4" ECU_ADDRESS 0x8FF03C /end MEASUREMENT
/begin MEASUREMENT PFlt_qSetUnBalFlt_mp "gefilterter Wert der Einspritzmenge" SWORD InjMass 1 100 -327.6800 327.6700 FORMAT "%8.4" ECU_ADDRESS 0x8FF13C /end MEASUREMENT
/begin MEASUREMENT PFlt_rAccPedFlt_mp "gefiltertes Pedalwertgebersignal" SWORD Prc 1 100 -400.0000 399.9878 FORMAT "%8.4" ECU_ADDRESS 0x8FF13E /end MEASUREMENT
/begin MEASUREMENT PFlt_resFlow "Strömungswiderstand" SWORD Res_hPaHrPerCM 1 100 -32.76800 32.76700 FORMAT "%8.5" ECU_ADDRESS 0x7F91FA /end MEASUREMENT
/begin MEASUREMENT PFlt_resFlowB1 "Strömungswiderstand(Bank1)." SWORD Res_hPaHrPerCM 1 100 -32.76800 32.76700 FORMAT "%8.5" ECU_ADDRESS 0x7F91FC /end MEASUREMENT
/begin MEASUREMENT PFlt_resFlowB2 "Strömungswiderstand(Bank2)." SWORD Res_hPaHrPerCM 1 100 -32.76800 32.76700 FORMAT "%8.5" ECU_ADDRESS 0x7F91FE /end MEASUREMENT
/begin MEASUREMENT PFlt_resFlowEngPrtCorB1 "" SWORD Res_hPaHrPerCM 1 100 -32.76800 32.76700 FORMAT "%8.5" ECU_ADDRESS 0x7F9200 /end MEASUREMENT
/begin MEASUREMENT PFlt_resFlowEngPrtCorB2 "" SWORD Res_hPaHrPerCM 1 100 -32.76800 32.76700 FORMAT "%8.5" ECU_ADDRESS 0x7F9202 /end MEASUREMENT
/begin MEASUREMENT PFlt_resFlowEngPrtMaxB1_mp "" SWORD Res_hPaHrPerCM 1 100 -32.76800 32.76700 FORMAT "%8.5" ECU_ADDRESS 0x8FF0F0 /end MEASUREMENT
/begin MEASUREMENT PFlt_resFlowEngPrtMaxB2_mp "" SWORD Res_hPaHrPerCM 1 100 -32.76800 32.76700 FORMAT "%8.5" ECU_ADDRESS 0x8FF0F2 /end MEASUREMENT
/begin MEASUREMENT PFlt_resFlowEngPrtMinB1_mp "" SWORD Res_hPaHrPerCM 1 100 -32.76800 32.76700 FORMAT "%8.5" ECU_ADDRESS 0x8FF0F4 /end MEASUREMENT
/begin MEASUREMENT PFlt_resFlowEngPrtMinB2_mp "" SWORD Res_hPaHrPerCM 1 100 -32.76800 32.76700 FORMAT "%8.5" ECU_ADDRESS 0x8FF0F6 /end MEASUREMENT
/begin MEASUREMENT PFlt_resFlowFltAshCorB1_mp "PT1-gefilterter Wert für for PFlt_resFlow" SWORD Res_hPaHrPerCM 1 100 -32.76800 32.76700 FORMAT "%8.5" ECU_ADDRESS 0x8FF03E /end MEASUREMENT
/begin MEASUREMENT PFlt_resFlowFltAshCorB2_mp "PT1-gefilterter Wert für for PFlt_resFlow" SWORD Res_hPaHrPerCM 1 100 -32.76800 32.76700 FORMAT "%8.5" ECU_ADDRESS 0x8FF040 /end MEASUREMENT
/begin MEASUREMENT PFlt_resFlowFltAshCorRawB1_mp "Resflow-Rohwert" SWORD Res_hPaHrPerCM 1 100 -32.76800 32.76700 FORMAT "%8.5" ECU_ADDRESS 0x8FF042 /end MEASUREMENT
/begin MEASUREMENT PFlt_resFlowFltAshCorRawB2_mp "Resflow-Rohwert" SWORD Res_hPaHrPerCM 1 100 -32.76800 32.76700 FORMAT "%8.5" ECU_ADDRESS 0x8FF044 /end MEASUREMENT
/begin MEASUREMENT PFlt_resFlowFltAshCor_mp "PT1-gefilterter Wert für for PFlt_resFlow" SWORD Res_hPaHrPerCM 1 100 -32.76800 32.76700 FORMAT "%8.5" ECU_ADDRESS 0x8FF046 /end MEASUREMENT
/begin MEASUREMENT PFlt_resFlowFltB1 "gefilterter Strömungswiderstand für Bank1" SWORD Res_hPaHrPerCM 1 100 -32.76800 32.76700 FORMAT "%8.5" ECU_ADDRESS 0x7F9204 /end MEASUREMENT
/begin MEASUREMENT PFlt_resFlowFltB2 "gefilterter Strömungswiderstand für Bank2" SWORD Res_hPaHrPerCM 1 100 -32.76800 32.76700 FORMAT "%8.5" ECU_ADDRESS 0x7F9206 /end MEASUREMENT
/begin MEASUREMENT PFlt_resFlowFlt_mp "Strömungswiderstand PT1 gefiltert" SWORD Res_hPaHrPerCM 1 100 -32.76800 32.76700 FORMAT "%8.5" ECU_ADDRESS 0x8FF1E8 /end MEASUREMENT
/begin MEASUREMENT PFlt_resFlowInvB1_mp "Ausgang von PFlt_resFlowMeasInv_MAP für Bank 1" SWORD Res_hPaHrPerCM 1 100 -32.76800 32.76700 FORMAT "%8.5" ECU_ADDRESS 0x8FF1EA /end MEASUREMENT
/begin MEASUREMENT PFlt_resFlowInvB2_mp "Ausgang von PFlt_resFlowMeasInv_MAP für Bank 2" SWORD Res_hPaHrPerCM 1 100 -32.76800 32.76700 FORMAT "%8.5" ECU_ADDRESS 0x8FF1EC /end MEASUREMENT
/begin MEASUREMENT PFlt_resFlowOfsB1 "Strömungswiderstandoffset für Bank1" SWORD Res_hPaHrPerCM 1 100 -32.76800 32.76700 FORMAT "%8.5" ECU_ADDRESS 0x7F9208 /end MEASUREMENT
/begin MEASUREMENT PFlt_resFlowOfsB2 "Strömungswiderstandoffset für Bank2" SWORD Res_hPaHrPerCM 1 100 -32.76800 32.76700 FORMAT "%8.5" ECU_ADDRESS 0x7F920A /end MEASUREMENT
/begin MEASUREMENT PFlt_resFlowOfs_mp "Luftstromwiderstandsoffset" SWORD Res_hPaHrPerCM 1 100 -32.76800 32.76700 FORMAT "%8.5" ECU_ADDRESS 0x8FF0F8 /end MEASUREMENT
/begin MEASUREMENT PFlt_resFlowRaw "Strömungswiderstand Rohwert" SWORD Res_hPaHrPerCM 1 100 -32.76800 32.76700 FORMAT "%8.5" ECU_ADDRESS 0x7F920C /end MEASUREMENT
/begin MEASUREMENT PFlt_resFlowRawB1 "Strömungswiderstand Rohwert Bank 1" SWORD Res_hPaHrPerCM 1 100 -32.76800 32.76700 FORMAT "%8.5" ECU_ADDRESS 0x7F920E /end MEASUREMENT
/begin MEASUREMENT PFlt_resFlowRawB1_mp "Strömungswiderstand Rohwert(Bank1)." SWORD Res_hPaHrPerCM 1 100 -32.76800 32.76700 FORMAT "%8.5" ECU_ADDRESS 0x6F82DE /end MEASUREMENT
/begin MEASUREMENT PFlt_resFlowRawB2 "Strömungswiderstand Rohwert Bank 2" SWORD Res_hPaHrPerCM 1 100 -32.76800 32.76700 FORMAT "%8.5" ECU_ADDRESS 0x7F9210 /end MEASUREMENT
/begin MEASUREMENT PFlt_resFlowRawB2_mp "Strömungswiderstand Rohwert(Bank2)." SWORD Res_hPaHrPerCM 1 100 -32.76800 32.76700 FORMAT "%8.5" ECU_ADDRESS 0x6F82E0 /end MEASUREMENT
/begin MEASUREMENT PFlt_rHCCondB1_mp "HC Conditionierzeit Dichte für Bank1" SWORD Prc 1 100 -400.0000 399.9878 FORMAT "%8.4" ECU_ADDRESS 0x8FF074 /end MEASUREMENT
/begin MEASUREMENT PFlt_rHCCondB2_mp "HC Conditionierzeit Dichte für Bank2" SWORD Prc 1 100 -400.0000 399.9878 FORMAT "%8.4" ECU_ADDRESS 0x8FF076 /end MEASUREMENT
/begin MEASUREMENT PFlt_rLmbdAprxB1 "Lambda berechnet aus q_inj und dm_air Bank1" SWORD lambda 1 100 -32.76800 32.76700 FORMAT "%8.5" ECU_ADDRESS 0x7F91EE /end MEASUREMENT
/begin MEASUREMENT PFlt_rLmbdAprxB2 "Lambda berechnet aus q_inj und dm_air Bank2" SWORD lambda 1 100 -32.76800 32.76700 FORMAT "%8.5" ECU_ADDRESS 0x7F91F0 /end MEASUREMENT
/begin MEASUREMENT PFlt_rLmbdB1 "Lambdawert Bank1" SWORD lambda 1 100 -32.76800 32.76700 FORMAT "%8.5" ECU_ADDRESS 0x7F91F2 /end MEASUREMENT
/begin MEASUREMENT PFlt_rLmbdB2 "Lambdawert Bank2" SWORD lambda 1 100 -32.76800 32.76700 FORMAT "%8.5" ECU_ADDRESS 0x7F91F4 /end MEASUREMENT
/begin MEASUREMENT PFlt_rLmbdDynB1_mp "Dynamischer Anteils des Lambdawerts  - Bank 1" SWORD lambda 1 100 -32.76800 32.76700 FORMAT "%8.5" ECU_ADDRESS 0x8FF1EE /end MEASUREMENT
/begin MEASUREMENT PFlt_rLmbdDynB2_mp "Dynamischer Anteils des Lambdawerts -  Bank 2" SWORD lambda 1 100 -32.76800 32.76700 FORMAT "%8.5" ECU_ADDRESS 0x8FF1F0 /end MEASUREMENT
/begin MEASUREMENT PFlt_rLmbdDynMapIn_mp "Dynamischer Anteils des Lambdawerts" SWORD lambda 1 100 -32.76800 32.76700 FORMAT "%8.5" ECU_ADDRESS 0x8FF1F2 /end MEASUREMENT
/begin MEASUREMENT PFlt_rLmbdMapIn_mp "Lambdawert" SWORD lambda 1 100 -32.76800 32.76700 FORMAT "%8.5" ECU_ADDRESS 0x8FF1F4 /end MEASUREMENT
/begin MEASUREMENT PFlt_RngIdxPrj_X_mp "Matrixeingang zur Ermittlung der Bereichsgrenzen für die gefilterte Fahrzeuggeschwindigkeit" UBYTE OneToOne 1 100 0.00 255.0 FORMAT "%5.1" ECU_ADDRESS 0x8FF16C /end MEASUREMENT
/begin MEASUREMENT PFlt_RngIdxPrj_Y_mp "Matrixeingang zur Ermittlung der Bereichsgrenzen für die gefilterte Fahrzeuggeschwindigkeit" UBYTE OneToOne 1 100 0.00 255.0 FORMAT "%5.1" ECU_ADDRESS 0x8FF16D /end MEASUREMENT
/begin MEASUREMENT PFlt_RngIdx_X_mp "Range Index for coloumn nos of matrices" UBYTE OneToOne 1 100 0.00 255.0 FORMAT "%5.1" ECU_ADDRESS 0x8FF140 /end MEASUREMENT
/begin MEASUREMENT PFlt_RngIdx_Y_mp "Range Index for row nos of matrices" UBYTE OneToOne 1 100 0.00 255.0 FORMAT "%5.1" ECU_ADDRESS 0x8FF141 /end MEASUREMENT
/begin MEASUREMENT PFlt_rSotB1 "Asschemasse im Filter pro Filtervolumen(Bank1)." SWORD Soot_gPerLtr 1 100 -327.6800 327.6700 FORMAT "%8.4" ECU_ADDRESS 0x7F91F6 /end MEASUREMENT
/begin MEASUREMENT PFlt_rSotB2 "Asschemasse im Filter pro Filtervolumen(Bank2)." SWORD Soot_gPerLtr 1 100 -327.6800 327.6700 FORMAT "%8.4" ECU_ADDRESS 0x7F91F8 /end MEASUREMENT
/begin MEASUREMENT PFlt_st "von Partikelfilter angeforderter Regenerationsstatus" ULONG OneToOne 1 100 0.00 4294967295.00 FORMAT "%13.2" ECU_ADDRESS 0x7F9480 /end MEASUREMENT
/begin MEASUREMENT PFlt_st1_mp "Status des Partikelfilters  LowByte (->Signals)" UWORD OneToOne 1 100 0.00 65535.00 FORMAT "%8.2" ECU_ADDRESS 0x6F82B0 /end MEASUREMENT
/begin MEASUREMENT PFlt_st2_mp "Status des Partikelfilters  HighByte (->Signals)" UWORD OneToOne 1 100 0.00 65535.00 FORMAT "%8.2" ECU_ADDRESS 0x6F82B2 /end MEASUREMENT
/begin MEASUREMENT PFlt_stAshCorCalcB1_mp "Berechnungsstatus Aschekorrektur" UBYTE OneToOne 1 100 0.00 255.0 FORMAT "%5.1" ECU_ADDRESS 0x8FF048 /end MEASUREMENT
/begin MEASUREMENT PFlt_stAshCorCalcB2_mp "Berechnungsstatus Aschekorrektur" UBYTE OneToOne 1 100 0.00 255.0 FORMAT "%5.1" ECU_ADDRESS 0x8FF049 /end MEASUREMENT
/begin MEASUREMENT PFlt_stAshCorDist_mp "Status Ashekorrekturdistanz" UBYTE OneToOne 1 100 0.00 255.0 FORMAT "%5.1" ECU_ADDRESS 0x8FF04A /end MEASUREMENT
/begin MEASUREMENT PFlt_stAshCorRgnMax "Maximumzähler für AshCor Regeneration abgelaufen, keine gültige Regeneration stattgefunden" UBYTE OneToOne 1 100 0.00 255.0 FORMAT "%5.1" ECU_ADDRESS 0x7F89E1 /end MEASUREMENT
/begin MEASUREMENT PFlt_stAshCorRgn_mp "bitweise Aufschlüsselung der aktuellen Regenerationsanforderung" UBYTE OneToOne 1 100 0.00 255.0 FORMAT "%5.1" ECU_ADDRESS 0x8FF04B /end MEASUREMENT
/begin MEASUREMENT PFlt_stAshCorRlsOn_mp "Status Aschekorrektur-Freigabe am" UBYTE OneToOne 1 100 0.00 255.0 FORMAT "%5.1" ECU_ADDRESS 0x8FF04C /end MEASUREMENT
/begin MEASUREMENT PFlt_stAshCorRls_mp "Status Aschekorrektur-Freigabe" UBYTE OneToOne 1 100 0.00 255.0 FORMAT "%5.1" ECU_ADDRESS 0x8FF04D /end MEASUREMENT
/begin MEASUREMENT PFlt_stAshCor_mp "Status Aschekorrektur" UBYTE OneToOne 1 100 0.00 255.0 FORMAT "%5.1" ECU_ADDRESS 0x8FF04E /end MEASUREMENT
/begin MEASUREMENT PFlt_stBrkDeb_mp "Entprelltes Bremssignal" UBYTE OneToOne 1 100 0.00 255.0 FORMAT "%5.1" ECU_ADDRESS 0x8FF142 /end MEASUREMENT
/begin MEASUREMENT PFlt_stClthDeb_mp "Entprelltes Kupplungssignal" UBYTE OneToOne 1 100 0.00 255.0 FORMAT "%5.1" ECU_ADDRESS 0x8FF143 /end MEASUREMENT
/begin MEASUREMENT PFlt_stCntB1_mp "Statuswort für  Regnerationsanf. nach Kraftstoffverbrauch, Betriebsstunden oder gefahrener Strecke Bank1" UBYTE OneToOne 1 100 0.00 255.0 FORMAT "%5.1" ECU_ADDRESS 0x8FF0FA /end MEASUREMENT
/begin MEASUREMENT PFlt_stCntB2_mp "Statuswort für  Regnerationsanf. nach Kraftstoffverbrauch, Betriebsstunden oder gefahrener Strecke Bank2" UBYTE OneToOne 1 100 0.00 255.0 FORMAT "%5.1" ECU_ADDRESS 0x8FF0FB /end MEASUREMENT
/begin MEASUREMENT PFlt_stCntHCCondB1_mp "Status HC Überconditioniererkennung für Bank1" UBYTE OneToOne 1 100 0.00 255.0 FORMAT "%5.1" ECU_ADDRESS 0x8FF078 /end MEASUREMENT
/begin MEASUREMENT PFlt_stCntHCCondB2_mp "Status HC Überconditioniererkennung für Bank2" UBYTE OneToOne 1 100 0.00 255.0 FORMAT "%5.1" ECU_ADDRESS 0x8FF079 /end MEASUREMENT
/begin MEASUREMENT PFlt_stEGROff_mp "Status ARF abgeschaltet und abgeschlossen" UBYTE OneToOne 1 100 0.00 255.0 FORMAT "%5.1" ECU_ADDRESS 0x8FF1F6 /end MEASUREMENT
/begin MEASUREMENT PFlt_stEngPOp "Motorbetriebspunkt" UBYTE OneToOne 1 100 0.00 255.0 FORMAT "%5.1" ECU_ADDRESS 0x7F89E2 /end MEASUREMENT
/begin MEASUREMENT PFlt_stEngPOp10_mp "Motorbetriebspunkt berechnet in Check Range 10" UBYTE OneToOne 1 100 0.00 255.0 FORMAT "%5.1" ECU_ADDRESS 0x8FF144 /end MEASUREMENT
/begin MEASUREMENT PFlt_stEngPOp1_mp "Motorbetriebspunkt berechnet in Check Range 1" UBYTE OneToOne 1 100 0.00 255.0 FORMAT "%5.1" ECU_ADDRESS 0x6F82BC /end MEASUREMENT
/begin MEASUREMENT PFlt_stEngPOp2_mp "Motorbetriebspunkt berechnet in Check Range 2" UBYTE OneToOne 1 100 0.00 255.0 FORMAT "%5.1" ECU_ADDRESS 0x6F82BD /end MEASUREMENT
/begin MEASUREMENT PFlt_stEngPOp3_mp "Motorbetriebspunkt berechnet in Check Range 3" UBYTE OneToOne 1 100 0.00 255.0 FORMAT "%5.1" ECU_ADDRESS 0x6F82BE /end MEASUREMENT
/begin MEASUREMENT PFlt_stEngPOp4_mp "Motorbetriebspunkt berechnet in Check Range 4" UBYTE OneToOne 1 100 0.00 255.0 FORMAT "%5.1" ECU_ADDRESS 0x6F82BF /end MEASUREMENT
/begin MEASUREMENT PFlt_stEngPOp5_mp "Motorbetriebspunkt berechnet in Check Range 5" UBYTE OneToOne 1 100 0.00 255.0 FORMAT "%5.1" ECU_ADDRESS 0x6F82C0 /end MEASUREMENT
/begin MEASUREMENT PFlt_stEngPOp6_mp "Motorbetriebspunkt berechnet in Check Range 6" UBYTE OneToOne 1 100 0.00 255.0 FORMAT "%5.1" ECU_ADDRESS 0x8FF145 /end MEASUREMENT
/begin MEASUREMENT PFlt_stEngPOp7_mp "Motorbetriebspunkt berechnet in Check Range 7" UBYTE OneToOne 1 100 0.00 255.0 FORMAT "%5.1" ECU_ADDRESS 0x8FF146 /end MEASUREMENT
/begin MEASUREMENT PFlt_stEngPOp8_mp "Motorbetriebspunkt berechnet in Check Range 8" UBYTE OneToOne 1 100 0.00 255.0 FORMAT "%5.1" ECU_ADDRESS 0x8FF147 /end MEASUREMENT
/begin MEASUREMENT PFlt_stEngPOp9_mp "Motorbetriebspunkt berechnet in Check Range 9" UBYTE OneToOne 1 100 0.00 255.0 FORMAT "%5.1" ECU_ADDRESS 0x8FF148 /end MEASUREMENT
/begin MEASUREMENT PFlt_stEngPOpPrj "Projektspezifischer Ausgabewert für Betriebszustandsberechnung" UWORD OneToOne 1 100 0.00 65535.00 FORMAT "%8.2" ECU_ADDRESS 0x7F9212 /end MEASUREMENT
/begin MEASUREMENT PFlt_stEngPOpSpo_mp "Statuswert Betriebspunkt ""Spontante Regeneration""" UBYTE OneToOne 1 100 0.00 255.0 FORMAT "%5.1" ECU_ADDRESS 0x8FF149 /end MEASUREMENT
/begin MEASUREMENT PFlt_stEngPOpTmp_mp "Motorbetriebspunkt" SWORD OneToOne 1 100 -32768.00 32767.00 FORMAT "%8.2" ECU_ADDRESS 0x8FF1F8 /end MEASUREMENT
/begin MEASUREMENT PFlt_stEngPrtActvB1 "Status Motorschutz aktiv für Bank1" UBYTE OneToOne 1 100 0.00 255.0 FORMAT "%5.1" ECU_ADDRESS 0x7F89E3 /end MEASUREMENT
/begin MEASUREMENT PFlt_stEngPrtActvB2 "Status Motorschutz aktiv für Bank2" UBYTE OneToOne 1 100 0.00 255.0 FORMAT "%5.1" ECU_ADDRESS 0x7F89E4 /end MEASUREMENT
/begin MEASUREMENT PFlt_stFFLstB1_mp "" UBYTE OneToOne 1 100 0.00 255.0 FORMAT "%5.1" ECU_ADDRESS 0x8FF0FC /end MEASUREMENT
/begin MEASUREMENT PFlt_stFFLstB2_mp "" UBYTE OneToOne 1 100 0.00 255.0 FORMAT "%5.1" ECU_ADDRESS 0x8FF0FD /end MEASUREMENT
/begin MEASUREMENT PFlt_stFFPrtB1_mp "" UBYTE OneToOne 1 100 0.00 255.0 FORMAT "%5.1" ECU_ADDRESS 0x8FF0FE /end MEASUREMENT
/begin MEASUREMENT PFlt_stFFPrtB2_mp "" UBYTE OneToOne 1 100 0.00 255.0 FORMAT "%5.1" ECU_ADDRESS 0x8FF0FF /end MEASUREMENT
/begin MEASUREMENT PFlt_stFlTotCorOn_mp "Status für Gesamtmenge Kraftstoffkorrektur ON." UBYTE OneToOne 1 100 0.00 255.0 FORMAT "%5.1" ECU_ADDRESS 0x8FF04F /end MEASUREMENT
/begin MEASUREMENT PFlt_stFlTotCor_mp "Status für Gesamtmenge Kraftstoffkorrektur" UBYTE OneToOne 1 100 0.00 255.0 FORMAT "%5.1" ECU_ADDRESS 0x8FF050 /end MEASUREMENT
/begin MEASUREMENT PFlt_stGearDeb_mp "Entprelltes Gangsignal" SBYTE OneToOne 1 100 -128.0 127.0 FORMAT "%5.1" ECU_ADDRESS 0x8FF14A /end MEASUREMENT
/begin MEASUREMENT PFlt_stHCCondActvB1 "" UBYTE OneToOne 1 100 0.00 255.0 FORMAT "%5.1" ECU_ADDRESS 0x7F89E5 /end MEASUREMENT
/begin MEASUREMENT PFlt_stHCCondActvB2 "" UBYTE OneToOne 1 100 0.00 255.0 FORMAT "%5.1" ECU_ADDRESS 0x7F89E6 /end MEASUREMENT
/begin MEASUREMENT PFlt_stHCCondB1 "HC-Conditonieranforderung für Bank1" UBYTE OneToOne 1 100 0.00 255.0 FORMAT "%5.1" ECU_ADDRESS 0x7F89E7 /end MEASUREMENT
/begin MEASUREMENT PFlt_stHCCondB2 "HC-Conditonieranforderung für Bank2" UBYTE OneToOne 1 100 0.00 255.0 FORMAT "%5.1" ECU_ADDRESS 0x7F89E8 /end MEASUREMENT
/begin MEASUREMENT PFlt_stHCCondEndB1 "" UBYTE OneToOne 1 100 0.00 255.0 FORMAT "%5.1" ECU_ADDRESS 0x7F89E9 /end MEASUREMENT
/begin MEASUREMENT PFlt_stHCCondEndB2 "" UBYTE OneToOne 1 100 0.00 255.0 FORMAT "%5.1" ECU_ADDRESS 0x7F89EA /end MEASUREMENT
/begin MEASUREMENT PFlt_stIntrB1_mp "Statuswort Regeneration unterbrochen Bank 1" UBYTE OneToOne 1 100 0.00 255.0 FORMAT "%5.1" ECU_ADDRESS 0x6F82B4 /end MEASUREMENT
/begin MEASUREMENT PFlt_stIntrB2_mp "Statuswort Regeneration unterbrochen Bank 2" UBYTE OneToOne 1 100 0.00 255.0 FORMAT "%5.1" ECU_ADDRESS 0x6F82B5 /end MEASUREMENT
/begin MEASUREMENT PFlt_stLck "Statusbit Lock Partikelfilterregeneration" UBYTE OneToOne 1 100 0.00 255.0 FORMAT "%5.1" ECU_ADDRESS 0x7F89EB /end MEASUREMENT
/begin MEASUREMENT PFlt_stLckFuel_mp "Messender Punkt für Status der Kraftstoffverriegelung" UBYTE OneToOne 1 100 0.00 255.0 FORMAT "%5.1" ECU_ADDRESS 0x8FF100 /end MEASUREMENT
/begin MEASUREMENT PFlt_stLck_mp "Regeneration Blockierung und Freigabe" UBYTE OneToOne 1 100 0.00 255.0 FORMAT "%5.1" ECU_ADDRESS 0x6F82B6 /end MEASUREMENT
/begin MEASUREMENT PFlt_stLstRgnB1_mp "Regeneartionsanforderung wegen Betriebszeit, gefahrene Strecke oder Zeit auf Abgasflut Eins" UBYTE OneToOne 1 100 0.00 255.0 FORMAT "%5.1" ECU_ADDRESS 0x8FF101 /end MEASUREMENT
/begin MEASUREMENT PFlt_stLstRgnB2_mp "Regeneartionsanforderung wegen Betriebszeit, gefahrene Strecke oder Zeit auf Abgasflut Zwei" UBYTE OneToOne 1 100 0.00 255.0 FORMAT "%5.1" ECU_ADDRESS 0x8FF102 /end MEASUREMENT
/begin MEASUREMENT PFlt_stLstRgnEndB1_mp " Status detektiert Ende des Timers für Regeneration aus Zählerblöcken Bank 1" UBYTE OneToOne 1 100 0.00 255.0 FORMAT "%5.1" ECU_ADDRESS 0x8FF103 /end MEASUREMENT
/begin MEASUREMENT PFlt_stLstRgnEndB2_mp "Status detektiert Ende des Timers für Regeneration aus Zählerblöcken Bank 2" UBYTE OneToOne 1 100 0.00 255.0 FORMAT "%5.1" ECU_ADDRESS 0x8FF104 /end MEASUREMENT
/begin MEASUREMENT PFlt_stLstRgnStrtB1_mp "" UBYTE OneToOne 1 100 0.00 255.0 FORMAT "%5.1" ECU_ADDRESS 0x8FF105 /end MEASUREMENT
/begin MEASUREMENT PFlt_stLstRgnStrtB2_mp "" UBYTE OneToOne 1 100 0.00 255.0 FORMAT "%5.1" ECU_ADDRESS 0x8FF106 /end MEASUREMENT
/begin MEASUREMENT PFlt_stNO2ActvB1_mp "Status NO2-Effekt aktiv -  Bank 1" UBYTE OneToOne 1 100 0.00 255.0 FORMAT "%5.1" ECU_ADDRESS 0x8FF1FA /end MEASUREMENT
/begin MEASUREMENT PFlt_stNO2ActvB2_mp "Status NO2-Effekt aktiv -  Bank 2" UBYTE OneToOne 1 100 0.00 255.0 FORMAT "%5.1" ECU_ADDRESS 0x8FF1FB /end MEASUREMENT
/begin MEASUREMENT PFlt_stNoRgnEffB1_mp "" UBYTE OneToOne 1 100 0.00 255.0 FORMAT "%5.1" ECU_ADDRESS 0x8FF107 /end MEASUREMENT
/begin MEASUREMENT PFlt_stNoRgnEffB2_mp "" UBYTE OneToOne 1 100 0.00 255.0 FORMAT "%5.1" ECU_ADDRESS 0x8FF108 /end MEASUREMENT
/begin MEASUREMENT PFlt_stNumEngPOpDelOn_mp "Statusbit verzögert wirksame Matrix zur Berücksichtigung des Motorbetriebszustandes bei der Regeneration" UBYTE OneToOne 1 100 0.00 255.0 FORMAT "%5.1" ECU_ADDRESS 0x8FF109 /end MEASUREMENT
/begin MEASUREMENT PFlt_stOptHCCondB1 "Optionale Vorschaltung einer HC-Cond. einer Regeneration für Bank1" UBYTE OneToOne 1 100 0.00 255.0 FORMAT "%5.1" ECU_ADDRESS 0x7F89EC /end MEASUREMENT
/begin MEASUREMENT PFlt_stOptHCCondB2 "Optionale Vorschaltung einer HC-Cond. einer Regeneration für Bank2" UBYTE OneToOne 1 100 0.00 255.0 FORMAT "%5.1" ECU_ADDRESS 0x7F89ED /end MEASUREMENT
/begin MEASUREMENT PFlt_stPFltErr_mp "Zustände von sot sim init logig" UBYTE OneToOne 1 100 0.00 255.0 FORMAT "%5.1" ECU_ADDRESS 0x8FF051 /end MEASUREMENT
/begin MEASUREMENT PFlt_stRgnNoCompl_mp "Messpunkt für nicht vollständig duchgefürte Regeneration" UBYTE OneToOne 1 100 0.00 255.0 FORMAT "%5.1" ECU_ADDRESS 0x8FF10A /end MEASUREMENT
/begin MEASUREMENT PFlt_stRng10_mp "Statuswort Bereich 10" UWORD OneToOne 1 100 0.00 65535.00 FORMAT "%8.2" ECU_ADDRESS 0x8FF14C /end MEASUREMENT
/begin MEASUREMENT PFlt_stRng1_mp "Statuswort Bereich 1" UWORD OneToOne 1 100 0.00 65535.00 FORMAT "%8.2" ECU_ADDRESS 0x8FF14E /end MEASUREMENT
/begin MEASUREMENT PFlt_stRng2_mp "Statuswort Bereich 2" UWORD OneToOne 1 100 0.00 65535.00 FORMAT "%8.2" ECU_ADDRESS 0x8FF150 /end MEASUREMENT
/begin MEASUREMENT PFlt_stRng3_mp "Statuswort Bereich 3" UWORD OneToOne 1 100 0.00 65535.00 FORMAT "%8.2" ECU_ADDRESS 0x8FF152 /end MEASUREMENT
/begin MEASUREMENT PFlt_stRng4_mp "Statuswort Bereich 4" UWORD OneToOne 1 100 0.00 65535.00 FORMAT "%8.2" ECU_ADDRESS 0x8FF154 /end MEASUREMENT
/begin MEASUREMENT PFlt_stRng5_mp "Statuswort Bereich 5" UWORD OneToOne 1 100 0.00 65535.00 FORMAT "%8.2" ECU_ADDRESS 0x8FF156 /end MEASUREMENT
/begin MEASUREMENT PFlt_stRng6_mp "Statuswort Bereich 6" UWORD OneToOne 1 100 0.00 65535.00 FORMAT "%8.2" ECU_ADDRESS 0x8FF158 /end MEASUREMENT
/begin MEASUREMENT PFlt_stRng7_mp "Statuswort Bereich 7" UWORD OneToOne 1 100 0.00 65535.00 FORMAT "%8.2" ECU_ADDRESS 0x8FF15A /end MEASUREMENT
/begin MEASUREMENT PFlt_stRng8_mp "Statuswort Bereich 8" UWORD OneToOne 1 100 0.00 65535.00 FORMAT "%8.2" ECU_ADDRESS 0x8FF15C /end MEASUREMENT
/begin MEASUREMENT PFlt_stRng9_mp "Statuswort Bereich 9" UWORD OneToOne 1 100 0.00 65535.00 FORMAT "%8.2" ECU_ADDRESS 0x8FF15E /end MEASUREMENT
/begin MEASUREMENT PFlt_stRngSpo_mp "Statuswort Bereich ""Spontane Regeneration""" UWORD OneToOne 1 100 0.00 65535.00 FORMAT "%8.2" ECU_ADDRESS 0x8FF160 /end MEASUREMENT
/begin MEASUREMENT PFlt_stRstHCCondB1_mp "Rücksetzten HC Überconditionierfunktion für Bank1" UBYTE OneToOne 1 100 0.00 255.0 FORMAT "%5.1" ECU_ADDRESS 0x8FF07A /end MEASUREMENT
/begin MEASUREMENT PFlt_stRstHCCondB2_mp "Rücksetzten HC Überconditionierfunktion für Bank2" UBYTE OneToOne 1 100 0.00 255.0 FORMAT "%5.1" ECU_ADDRESS 0x8FF07B /end MEASUREMENT
/begin MEASUREMENT PFlt_stSimOnB1 "Statusbit Simulation aktiv für Bank1" UBYTE OneToOne 1 100 0.00 255.0 FORMAT "%5.1" ECU_ADDRESS 0x7F89EE /end MEASUREMENT
/begin MEASUREMENT PFlt_stSimOnB1_mp "Statuswort Simulation aktiv(Bank1)." UBYTE OneToOne 1 100 0.00 255.0 FORMAT "%5.1" ECU_ADDRESS 0x8FF1FC /end MEASUREMENT
/begin MEASUREMENT PFlt_stSimOnB2 "Statusbit Simulation aktiv für Bank2" UBYTE OneToOne 1 100 0.00 255.0 FORMAT "%5.1" ECU_ADDRESS 0x7F89EF /end MEASUREMENT
/begin MEASUREMENT PFlt_stSimOnB2_mp "Statuswort Simulation aktiv(Bank2)." UBYTE OneToOne 1 100 0.00 255.0 FORMAT "%5.1" ECU_ADDRESS 0x8FF1FD /end MEASUREMENT
/begin MEASUREMENT PFlt_stSotSimInitB1 "Status der Simulationsinitialisierung von Rußmasse  - Bank1" UBYTE OneToOne 1 100 0.00 255.0 FORMAT "%5.1" ECU_ADDRESS 0x7F89F0 /end MEASUREMENT
/begin MEASUREMENT PFlt_stSotSimInitB2 "Status der Simulationsinitialisierung von Rußmasse - Bank2" UBYTE OneToOne 1 100 0.00 255.0 FORMAT "%5.1" ECU_ADDRESS 0x7F89F1 /end MEASUREMENT
/begin MEASUREMENT PFlt_stSotSimInitLogB1_mp "Zustände von Rußmassensimulation init loging für Bank1" UBYTE OneToOne 1 100 0.00 255.0 FORMAT "%5.1" ECU_ADDRESS 0x8FF232 /end MEASUREMENT
/begin MEASUREMENT PFlt_stSotSimInitLogB2_mp "Zustände von Rußmassensimulation init loging für Bank2" UBYTE OneToOne 1 100 0.00 255.0 FORMAT "%5.1" ECU_ADDRESS 0x8FF233 /end MEASUREMENT
/begin MEASUREMENT PFlt_stSucB1 "Statuswort erfolgreiche Regeneration Bank1" UBYTE OneToOne 1 100 0.00 255.0 FORMAT "%5.1" ECU_ADDRESS 0x7F89F2 /end MEASUREMENT
/begin MEASUREMENT PFlt_stSucB1_mp "Statuswort erfolgreiche Regeneration Bank 1" UBYTE OneToOne 1 100 0.00 255.0 FORMAT "%5.1" ECU_ADDRESS 0x8FF10B /end MEASUREMENT
/begin MEASUREMENT PFlt_stSucB2 "Statuswort erfolgreiche Regeneration Bank2" UBYTE OneToOne 1 100 0.00 255.0 FORMAT "%5.1" ECU_ADDRESS 0x7F89F3 /end MEASUREMENT
/begin MEASUREMENT PFlt_stSucB2_mp "Statuswort erfolgreiche Regeneration Bank 2" UBYTE OneToOne 1 100 0.00 255.0 FORMAT "%5.1" ECU_ADDRESS 0x8FF10C /end MEASUREMENT
/begin MEASUREMENT PFlt_stSuc_mp "erfolgreiche Regeneration" UBYTE OneToOne 1 100 0.00 255.0 FORMAT "%5.1" ECU_ADDRESS 0x8FF10D /end MEASUREMENT
/begin MEASUREMENT PFlt_tAirFltAshCor_mp "gefilterter Wert Ansauglufttemperatur" SWORD Temp_Cels 1 100 -50.140 899.860 FORMAT "%8.3" ECU_ADDRESS 0x8FF052 /end MEASUREMENT
/begin MEASUREMENT PFlt_tCIntFltAshCor_mp "gefilterter Wert Kühlmitteltemperatur" SWORD Temp_Cels 1 100 -50.140 899.860 FORMAT "%8.3" ECU_ADDRESS 0x8FF054 /end MEASUREMENT
/begin MEASUREMENT PFlt_tClntFlt_mp "CTSCD_tClnt PT1 gefiltert" SWORD Temp_Cels 1 100 -50.140 899.860 FORMAT "%8.3" ECU_ADDRESS 0x8FF162 /end MEASUREMENT
/begin MEASUREMENT PFlt_tiActRgnB1_mp "Dauer der aktuellen Partikelfilter-Regeneration - Bank 1" ULONG Time_s 1 100 0.00 42949672.9500 FORMAT "%13.4" ECU_ADDRESS 0x8FF200 /end MEASUREMENT
/begin MEASUREMENT PFlt_tiActRgnB2_mp "Dauer der aktuellen Partikelfilter-Regeneration - Bank 2" ULONG Time_s 1 100 0.00 42949672.9500 FORMAT "%13.4" ECU_ADDRESS 0x8FF204 /end MEASUREMENT
/begin MEASUREMENT PFlt_tiHCCondB1_mp "" ULONG Time_s 1 100 0.00 42949672.9500 FORMAT "%13.4" ECU_ADDRESS 0x8FF110 /end MEASUREMENT
/begin MEASUREMENT PFlt_tiHCCondB2_mp "" ULONG Time_s 1 100 0.00 42949672.9500 FORMAT "%13.4" ECU_ADDRESS 0x8FF114 /end MEASUREMENT
/begin MEASUREMENT PFlt_tiLckRls_mp " In EEPROM abgespeicherte Zeit für Sperren die Regeneration" ULONG Time_s 1 100 0.00 42949672.9500 FORMAT "%13.4" ECU_ADDRESS 0x8FF118 /end MEASUREMENT
/begin MEASUREMENT PFlt_tiLstRgnB1_mp "" ULONG Time_s 1 100 0.00 42949672.9500 FORMAT "%13.4" ECU_ADDRESS 0x8FF11C /end MEASUREMENT
/begin MEASUREMENT PFlt_tiLstRgnB2_mp "" ULONG Time_s 1 100 0.00 42949672.9500 FORMAT "%13.4" ECU_ADDRESS 0x8FF120 /end MEASUREMENT
/begin MEASUREMENT PFlt_tiNO2RgnDel_mp "Verzugszeit des Beginns der NO2-Regeneration" SWORD Time_s 1 100 -327.6800 327.6700 FORMAT "%8.4" ECU_ADDRESS 0x8FF208 /end MEASUREMENT
/begin MEASUREMENT PFlt_tiOpB1 "Motorbetriebszeit bei der letzten erfolgr. Regeneration Bank 1" ULONG TimeEngOn 1 100 0.00 4294967295.00 FORMAT "%13.2" ECU_ADDRESS 0x7F9484 /end MEASUREMENT
/begin MEASUREMENT PFlt_tiOpB2 "Motorbetriebszeit bei der letzten erfolgr. Regeneration Bank2" ULONG TimeEngOn 1 100 0.00 4294967295.00 FORMAT "%13.2" ECU_ADDRESS 0x7F9488 /end MEASUREMENT
/begin MEASUREMENT PFlt_tiOpFstHCCondB1_mp "Zeitpunkt der ersten HC-Conditionierung für Bank1" ULONG TimeDsmDC 1 100 0.00 4294967295.00 FORMAT "%13.2" ECU_ADDRESS 0x8FF07C /end MEASUREMENT
/begin MEASUREMENT PFlt_tiOpFstHCCondB2_mp "Zeitpunkt der ersten HC-Conditionierung für Bank2" ULONG TimeDsmDC 1 100 0.00 4294967295.00 FORMAT "%13.2" ECU_ADDRESS 0x8FF080 /end MEASUREMENT
/begin MEASUREMENT PFlt_tiOpHCCondB1_mp "Zeitpunkt der letzten HC-Conditionierung für Bank1" UWORD tiOpRes 1 100 0.00 4194240. FORMAT "%8.0" ECU_ADDRESS 0x8FF084 /end MEASUREMENT
/begin MEASUREMENT PFlt_tiOpHCCondB2_mp "Zeitpunkt der letzten HC-Conditionierung für Bank2" UWORD tiOpRes 1 100 0.00 4194240. FORMAT "%8.0" ECU_ADDRESS 0x8FF086 /end MEASUREMENT
/begin MEASUREMENT PFlt_tiOpPFltB1_mp "Betriebsdauer des Partikelfilters - Bank 1" SWORD Time_Hr 1 100 -16384.00 16383.50 FORMAT "%8.2" ECU_ADDRESS 0x8FF20A /end MEASUREMENT
/begin MEASUREMENT PFlt_tiOpPFltB2_mp "Betriebsdauer des Partikelfilters - Bank 2" SWORD Time_Hr 1 100 -16384.00 16383.50 FORMAT "%8.2" ECU_ADDRESS 0x8FF20C /end MEASUREMENT
/begin MEASUREMENT PFlt_tiOpPFltCrvIn_mp "Betriebsdauer des Partikelfilters" SWORD Time_Hr 1 100 -16384.00 16383.50 FORMAT "%8.2" ECU_ADDRESS 0x8FF20E /end MEASUREMENT
/begin MEASUREMENT PFlt_tiOpPFltEEPROMB1_mp "Betriebsdauer des Partikelfilters zum Zeitpunkt des letzten Nachlaufes - Bank 1" ULONG TimeEngOn 1 100 0.00 4294967295.00 FORMAT "%13.2" ECU_ADDRESS 0x8FF210 /end MEASUREMENT
/begin MEASUREMENT PFlt_tiOpPFltEEPROMB2_mp "Betriebsdauer des Partikelfilters zum Zeitpunkt des letzten Nachlaufes - Bank 2" ULONG TimeEngOn 1 100 0.00 4294967295.00 FORMAT "%13.2" ECU_ADDRESS 0x8FF214 /end MEASUREMENT
/begin MEASUREMENT PFlt_tiOpu16B1_mp "Motorbetriebsszeit mit reduzierter Auflösung für Bank1" UWORD tiOpRes 1 100 0.00 4194240. FORMAT "%8.0" ECU_ADDRESS 0x8FF124 /end MEASUREMENT
/begin MEASUREMENT PFlt_tiOpu16B2_mp "Motorbetriebsszeit mit reduzierter Auflösung für Bank2" UWORD tiOpRes 1 100 0.00 4194240. FORMAT "%8.0" ECU_ADDRESS 0x8FF126 /end MEASUREMENT
/begin MEASUREMENT PFlt_tiPFltErr_mp "Zeitzustand von CSF-Notfahrbetrieb" UWORD TimePFltLimpHome 1 100 0.00 655350.0 FORMAT "%8.1" ECU_ADDRESS 0x8FF056 /end MEASUREMENT
/begin MEASUREMENT PFlt_tiRgnMax_mp "Wert für die maximale Regenerierungsdauer" ULONG Time_s 1 100 0.00 42949672.9500 FORMAT "%13.4" ECU_ADDRESS 0x8FF128 /end MEASUREMENT
/begin MEASUREMENT PFlt_tiRgnMinB1_mp "" ULONG Time_s 1 100 0.00 42949672.9500 FORMAT "%13.4" ECU_ADDRESS 0x8FF12C /end MEASUREMENT
/begin MEASUREMENT PFlt_tiRgnMinB2_mp "" ULONG Time_s 1 100 0.00 42949672.9500 FORMAT "%13.4" ECU_ADDRESS 0x8FF130 /end MEASUREMENT
/begin MEASUREMENT PFlt_tiSnceFstHCCondB1_mp "Zeit seit der ersten HC conditionierung für Bank1" ULONG TimeDsmDC 1 100 0.00 4294967295.00 FORMAT "%13.2" ECU_ADDRESS 0x8FF088 /end MEASUREMENT
/begin MEASUREMENT PFlt_tiSnceFstHCCondB2_mp "Zeit seit der ersten HC conditionierung für Bank2" ULONG TimeDsmDC 1 100 0.00 4294967295.00 FORMAT "%13.2" ECU_ADDRESS 0x8FF08C /end MEASUREMENT
/begin MEASUREMENT PFlt_tiSnceHCCondB1_mp "Zeit seit der letzten HC conditionierung für Bank1" UWORD tiSncergnRes 1 100 0.00 16776960. FORMAT "%8.0" ECU_ADDRESS 0x8FF090 /end MEASUREMENT
/begin MEASUREMENT PFlt_tiSnceHCCondB2_mp "Zeit seit der letzten HC conditionierung für Bank2" UWORD tiSncergnRes 1 100 0.00 16776960. FORMAT "%8.0" ECU_ADDRESS 0x8FF092 /end MEASUREMENT
/begin MEASUREMENT PFlt_tiSnceRgnB1 "Zeit seit letzter erfolgreicher Partikelfilterregeneration Bank 1" ULONG TimeEngOn 1 100 0.00 4294967295.00 FORMAT "%13.2" ECU_ADDRESS 0x7F948C /end MEASUREMENT
/begin MEASUREMENT PFlt_tiSnceRgnB2 "Zeit seit letzter erfolgreicher Partikelfilterregeneration Bank 2" ULONG TimeEngOn 1 100 0.00 4294967295.00 FORMAT "%13.2" ECU_ADDRESS 0x7F9490 /end MEASUREMENT
/begin MEASUREMENT PFlt_tiSnceRgnu16B1_mp "Motorbetriebsszeit seit der letzten erfolgreichen Regeneration mit reduzierter Auflösung für Bank1" UWORD tiSncergnRes 1 100 0.00 16776960. FORMAT "%8.0" ECU_ADDRESS 0x6F82B8 /end MEASUREMENT
/begin MEASUREMENT PFlt_tiSnceRgnu16B2_mp "Motorbetriebsszeit seit der letzten erfolgreichen Regeneration mit reduzierter Auflösung für Bank2" UWORD tiSncergnRes 1 100 0.00 16776960. FORMAT "%8.0" ECU_ADDRESS 0x6F82BA /end MEASUREMENT
/begin MEASUREMENT PFlt_tiSumHCCondB1_mp "Summe aller HC Conditionierungen für Bank1" ULONG TimeDsmDC 1 100 0.00 4294967295.00 FORMAT "%13.2" ECU_ADDRESS 0x8FF094 /end MEASUREMENT
/begin MEASUREMENT PFlt_tiSumHCCondB2_mp "Summe aller HC Conditionierungen für Bank2" ULONG TimeDsmDC 1 100 0.00 4294967295.00 FORMAT "%13.2" ECU_ADDRESS 0x8FF098 /end MEASUREMENT
/begin MEASUREMENT PFlt_tOxiPreCrvIn_mp "Temperatur vor Oxidationskatalysator" SWORD Temp_Cels 1 100 -50.140 899.860 FORMAT "%8.3" ECU_ADDRESS 0x8FF218 /end MEASUREMENT
/begin MEASUREMENT PFlt_tOxiPreFltAshCor_mp "gefilterter Wert OxiKat-Temperatur" SWORD Temp_Cels 1 100 -50.140 899.860 FORMAT "%8.3" ECU_ADDRESS 0x8FF058 /end MEASUREMENT
/begin MEASUREMENT PFlt_tOxiPreFlt_mp "OxiCCD_tPre PT1 gefiltert" SWORD Temp_Cels 1 100 -50.140 899.860 FORMAT "%8.3" ECU_ADDRESS 0x8FF164 /end MEASUREMENT
/begin MEASUREMENT PFlt_tPOpAir_mp "Ansauglufttemperatur aus Kennfeld" SWORD Temp_Cels 1 100 -50.140 899.860 FORMAT "%8.3" ECU_ADDRESS 0x8FF166 /end MEASUREMENT
/begin MEASUREMENT PFlt_tPOpClnt_mp "Kühlflüssigkeitstemperatur aus Kennfeld" SWORD Temp_Cels 1 100 -50.140 899.860 FORMAT "%8.3" ECU_ADDRESS 0x8FF168 /end MEASUREMENT
/begin MEASUREMENT PFlt_tPreFltAshCor_mp "gefilterter Wert Aufwärtstemperatur Partikelfilter" SWORD Temp_Cels 1 100 -50.140 899.860 FORMAT "%8.3" ECU_ADDRESS 0x8FF05A /end MEASUREMENT
/begin MEASUREMENT PFlt_tPreFlt_mp "PFlt_tPre PT1 gefiltert" SWORD Temp_Cels 1 100 -50.140 899.860 FORMAT "%8.3" ECU_ADDRESS 0x6F82C2 /end MEASUREMENT
/begin MEASUREMENT PFlt_tSurfCrvIn_mp "Modellierte Partikelfilteroberflächentemperatur" SWORD Temp_Cels 1 100 -50.140 899.860 FORMAT "%8.3" ECU_ADDRESS 0x8FF21A /end MEASUREMENT
/begin MEASUREMENT PFlt_uBattCDFlt_mp "gefilterte Batteriespannung" SWORD Volt_Batt 1 100 -640625.6 640606.1 FORMAT "%8.1" ECU_ADDRESS 0x8FF16A /end MEASUREMENT
/begin MEASUREMENT PFlt_vAvrgSnceHCCondB1_mp "Durchschnittsgeschwindigkeit seit der letzten HC conditionierung für Bank1" SWORD Vel_kmh 1 100 -1179.648 1179.612 FORMAT "%8.3" ECU_ADDRESS 0x8FF09C /end MEASUREMENT
/begin MEASUREMENT PFlt_vAvrgSnceHCCondB2_mp "Durchschnittsgeschwindigkeit seit der letzten HC conditionierung für Bank2" SWORD Vel_kmh 1 100 -1179.648 1179.612 FORMAT "%8.3" ECU_ADDRESS 0x8FF09E /end MEASUREMENT
/begin MEASUREMENT PFlt_vAvrgSnceHCCond_mp "Durchschnittsgeschwindigkeit seit der letzten HC conditionierung" SWORD Vel_kmh 1 100 -1179.648 1179.612 FORMAT "%8.3" ECU_ADDRESS 0x8FF0A0 /end MEASUREMENT
/begin MEASUREMENT PFlt_vAvrgSnceRgnB1_mp "" SWORD Vel_kmh 1 100 -1179.648 1179.612 FORMAT "%8.3" ECU_ADDRESS 0x8FF134 /end MEASUREMENT
/begin MEASUREMENT PFlt_vAvrgSnceRgnB2_mp "" SWORD Vel_kmh 1 100 -1179.648 1179.612 FORMAT "%8.3" ECU_ADDRESS 0x8FF136 /end MEASUREMENT
/begin MEASUREMENT PFlt_vAvrgSnceRgn_mp "" SWORD Vel_kmh 1 100 -1179.648 1179.612 FORMAT "%8.3" ECU_ADDRESS 0x8FF138 /end MEASUREMENT
/begin MEASUREMENT PFlt_volAddTot_mp "Gesamt eingespritzte Additivvolumen (grob Auflösung)" SWORD volAdd_ml2 1 100 -32768.00 32767.00 FORMAT "%8.2" ECU_ADDRESS 0x8FF21C /end MEASUREMENT
/begin MEASUREMENT PFlt_volAdiAsh_mp "Volumen der Additivasche im Partikelfilter" SWORD Vol 1 100 -327.6800 327.6700 FORMAT "%8.4" ECU_ADDRESS 0x8FF21E /end MEASUREMENT
/begin MEASUREMENT PFlt_volAshB1_mp "Volumen der Asche im Partikelfilter - Bank 1" SWORD Vol 1 100 -327.6800 327.6700 FORMAT "%8.4" ECU_ADDRESS 0x6F82E2 /end MEASUREMENT
/begin MEASUREMENT PFlt_volAshB2_mp "Volumen der Asche im Partikelfilter -  Bank 2" SWORD Vol 1 100 -327.6800 327.6700 FORMAT "%8.4" ECU_ADDRESS 0x6F82E4 /end MEASUREMENT
/begin MEASUREMENT PFlt_volAsh_mp "Volumen der Asche im Partikelfilter" SWORD Vol 1 100 -327.6800 327.6700 FORMAT "%8.4" ECU_ADDRESS 0x8FF220 /end MEASUREMENT
/begin MEASUREMENT PFlt_volOilAshB1 "" SWORD Vol 1 100 -327.6800 327.6700 FORMAT "%8.4" ECU_ADDRESS 0x7F923A /end MEASUREMENT
/begin MEASUREMENT PFlt_volOilAshB2 "" SWORD Vol 1 100 -327.6800 327.6700 FORMAT "%8.4" ECU_ADDRESS 0x7F923C /end MEASUREMENT
/begin MEASUREMENT PFlt_volOilAshFlB1_mp "Aschevolumen im Partikelfilter, korreliert aus dem Kraftstoffverbrauch - Bank 1" SWORD Vol 1 100 -327.6800 327.6700 FORMAT "%8.4" ECU_ADDRESS 0x8FF222 /end MEASUREMENT
/begin MEASUREMENT PFlt_volOilAshFlB2_mp "Aschevolumen im Partikelfilter, korreliert aus dem Kraftstoffverbrauch - Bank 2" SWORD Vol 1 100 -327.6800 327.6700 FORMAT "%8.4" ECU_ADDRESS 0x8FF224 /end MEASUREMENT
/begin MEASUREMENT PFlt_volOilAshTEngB1_mp "Aschevolumen im Partikelfilter, korreliert aus der Betriebsdauer - Bank 1" SWORD Vol 1 100 -327.6800 327.6700 FORMAT "%8.4" ECU_ADDRESS 0x8FF226 /end MEASUREMENT
/begin MEASUREMENT PFlt_volOilAshTEngB2_mp "Aschevolumen im Partikelfilter, korreliert aus der Betriebsdauer - Bank 2" SWORD Vol 1 100 -327.6800 327.6700 FORMAT "%8.4" ECU_ADDRESS 0x8FF228 /end MEASUREMENT
/begin MEASUREMENT PFlt_vVehFltAshCor_mp "gefilterter Wert Fahrzeuggeschwindigkeit" SWORD Vel 1 100 -327.6800 327.6700 FORMAT "%8.4" ECU_ADDRESS 0x8FF05C /end MEASUREMENT
/begin MEASUREMENT PFlt_vVehFlt_mp "VSSCD_v PT1 gefiltert" SWORD Vel 1 100 -327.6800 327.6700 FORMAT "%8.4" ECU_ADDRESS 0x6F82C4 /end MEASUREMENT
/begin MEASUREMENT PFlt_vVehUnFltMax_mp "Maximum value of unfiltered vehicle speed" SWORD Vel 1 100 -327.6800 327.6700 FORMAT "%8.4" ECU_ADDRESS 0x8FF16E /end MEASUREMENT
/begin MEASUREMENT PFlt_vVehUnFltMin_mp "Minimum Grenzen für ungefilterte Fahrgeschwindigkeit" SWORD Vel 1 100 -327.6800 327.6700 FORMAT "%8.4" ECU_ADDRESS 0x8FF170 /end MEASUREMENT
/begin FUNCTION pflt_ashcor ""
 /begin DEF_CHARACTERISTIC PFlt_aVehFltAshCorMax_C PFlt_aVehFltAshCorMin_C PFlt_ctAshCorRgnMax_C PFlt_ctAshCorRgn_C PFlt_facAshCorOld_C PFlt_facAshOil_C PFlt_facFlTotCor_C PFlt_faclAshCor_C PFlt_lAshCorMax_C PFlt_lAshCorNextDef_C PFlt_lAshCorNplAbsRel_C PFlt_lAshCorNplAbs_C PFlt_lAshCorNplRel_C PFlt_lAshCorRegIntr_C PFlt_lMinSnceRgn_C PFlt_mAshCor_MAP PFlt_mAshTolcAbs_C PFlt_mAshTolcMaxAbs_C PFlt_mAshTolcMaxRel_C PFlt_nAvrgFltAshCorMax_C PFlt_nAvrgFltAshCorMin_C PFlt_numAshCorMsk_C PFlt_numAshCor_C PFlt_numPFltErrRgnIntr_C PFlt_numPFltErr_C PFlt_qFlTotMin_C PFlt_qSetUnBalFltAshCorMax_C PFlt_qSetUnBalFltAshCorMin_C PFlt_swtAshCorActive_C PFlt_swtAshCorOn_C PFlt_tAirFltAshCorMax_C PFlt_tAirFltAshCorMin_C PFlt_tCIntAshCorMax_C PFlt_tCIntAshCorMin_C PFlt_tiAshCorAirTempPT1_C PFlt_tiAshCorCIntTempPT1_C PFlt_tiAshCorDVolPT1_C PFlt_tiAshCorEngSpdPT1_C PFlt_tiAshCorInjMsPT1_C PFlt_tiAshCorOxiTempPT1_C PFlt_tiAshCorPreTempPT1_C PFlt_tiAshCorResFlowPT1_C PFlt_tiAshCorRlsOn_C PFlt_tiAshCorStSucB1B2_C PFlt_tiAshCorVehAccPT1_C PFlt_tiAshCorVehSpdPT1_C PFlt_tiAshCorWaitMax_C PFlt_tiPFltErrPer_C PFlt_tiPFltErrRgn_C PFlt_tOxiPreFltAshCorMax_C PFlt_tOxiPreFltAshCorMin_C PFlt_tPreFltAshCorMax_C PFlt_tPreFltAshCorMin_C PFlt_vVehFltAshCorMax_C PFlt_vVehFltAshCorMin_C /end DEF_CHARACTERISTIC
 /begin IN_MEASUREMENT PFlt_dVolFltAshCor_mp PFlt_resFlowFltAshCor_mp /end IN_MEASUREMENT
/end FUNCTION
/begin FUNCTION pflt_ashcor_msg ""
 /begin OUT_MEASUREMENT PFlt_lAshCorNext PFlt_mAshCorActB1 PFlt_mAshCorActB2 PFlt_mAshCorNewB1 PFlt_mAshCorNewB2 PFlt_mAshCorOldB1 PFlt_mAshCorOldB2 PFlt_numPrj PFlt_qFlTotCorB1 PFlt_qFlTotCorB2 PFlt_stAshCorRgnMax /end OUT_MEASUREMENT
/end FUNCTION
/begin FUNCTION pflt_ashcor_uic ""
 /begin OUT_MEASUREMENT PFlt_aVehFltAshCor_mp PFlt_ctNumAshCorMax_mp PFlt_ctNumAshCor_mp PFlt_dqFlTotActB1_mp PFlt_dqFlTotActB2_mp PFlt_dqFlTotEndB1_mp PFlt_dqFlTotEndB2_mp PFlt_dVolFltAshCorB1_mp PFlt_dVolFltAshCorB2_mp PFlt_dVolFltAshCorRawB1_mp PFlt_dVolFltAshCorRawB2_mp PFlt_dVolFltAshCor_mp PFlt_facAshCorDiffB1_mp PFlt_facAshCorDiffB2_mp PFlt_lAshCorAct_mp PFlt_lAshCorNextEEProm_mp PFlt_lAshCorNextMax_mp PFlt_lAshCorNextOilCor_mp PFlt_lAshCorOldCalc_mp PFlt_lAshCorStep_mp PFlt_mAshCorActRelB1_mp PFlt_mAshCorActRelB2_mp PFlt_mAshCorDiff1B1_mp PFlt_mAshCorDiff1B2_mp PFlt_mAshCorDiff2B1_mp PFlt_mAshCorDiff2B2_mp PFlt_mAshCorDiffB1_mp PFlt_mAshCorDiffB2_mp PFlt_nAvrgFltAshCor_mp PFlt_qSetUnBalFltAshCor_mp PFlt_resFlowFltAshCorB1_mp PFlt_resFlowFltAshCorB2_mp PFlt_resFlowFltAshCorRawB1_mp PFlt_resFlowFltAshCorRawB2_mp PFlt_resFlowFltAshCor_mp PFlt_stAshCorCalcB1_mp PFlt_stAshCorCalcB2_mp PFlt_stAshCorDist_mp PFlt_stAshCorRgn_mp PFlt_stAshCorRlsOn_mp PFlt_stAshCorRls_mp PFlt_stAshCor_mp PFlt_stFlTotCorOn_mp PFlt_stFlTotCor_mp PFlt_stPFltErr_mp PFlt_tAirFltAshCor_mp PFlt_tCIntFltAshCor_mp PFlt_tiPFltErr_mp PFlt_tOxiPreFltAshCor_mp PFlt_tPreFltAshCor_mp PFlt_vVehFltAshCor_mp /end OUT_MEASUREMENT
/end FUNCTION
/begin FUNCTION pflt_condpflt "Berechnung der Bedingungen zur Regeneration des Partikelfilters"
 /begin DEF_CHARACTERISTIC PFlt_lSumMaxHCCond_MAP PFlt_lSumMaxOptHCCond_C PFlt_lSumOptHCCond_C PFlt_nHCCondPrtHeal_C PFlt_numHCCondActvMsk_C PFlt_qHCCondPrtHeal_C PFlt_rHCCondMax_C PFlt_stHCCondPrt_C PFlt_tiDebHCCondPrtHeal_C PFlt_tiHCCondMax_C PFlt_vHCCondPrtHeal_C /end DEF_CHARACTERISTIC
 /begin IN_MEASUREMENT PFlt_lAvrgSnceHCCond_mp PFlt_vAvrgSnceHCCond_mp /end IN_MEASUREMENT
/end FUNCTION
/begin FUNCTION pflt_condpflt_msg ""
 /begin OUT_MEASUREMENT PFlt_numHCCondPrtB1 PFlt_numHCCondPrtB2 PFlt_stHCCondB1 PFlt_stHCCondB2 PFlt_stOptHCCondB1 PFlt_stOptHCCondB2 /end OUT_MEASUREMENT
/end FUNCTION
/begin FUNCTION pflt_condpflt_uic ""
 /begin OUT_MEASUREMENT PFlt_ctStartSnceHCCondB1_mp PFlt_ctStartSnceHCCondB2_mp PFlt_lAvrgSnceHCCondB1_mp PFlt_lAvrgSnceHCCondB2_mp PFlt_lAvrgSnceHCCond_mp PFlt_lSnceHCCondB1_mp PFlt_lSnceHCCondB2_mp PFlt_lSumHCCondB1_mp PFlt_lSumHCCondB2_mp PFlt_lSumMaxHCCondB1_mp PFlt_lSumMaxHCCondB2_mp PFlt_rHCCondB1_mp PFlt_rHCCondB2_mp PFlt_stCntHCCondB1_mp PFlt_stCntHCCondB2_mp PFlt_stRstHCCondB1_mp PFlt_stRstHCCondB2_mp PFlt_tiOpFstHCCondB1_mp PFlt_tiOpFstHCCondB2_mp PFlt_tiOpHCCondB1_mp PFlt_tiOpHCCondB2_mp PFlt_tiSnceFstHCCondB1_mp PFlt_tiSnceFstHCCondB2_mp PFlt_tiSnceHCCondB1_mp PFlt_tiSnceHCCondB2_mp PFlt_tiSumHCCondB1_mp PFlt_tiSumHCCondB2_mp PFlt_vAvrgSnceHCCondB1_mp PFlt_vAvrgSnceHCCondB2_mp PFlt_vAvrgSnceHCCond_mp /end OUT_MEASUREMENT
/end FUNCTION
/begin FUNCTION pflt_corgn "Partikelfilterregenerationskoordinator"
 /begin DEF_CHARACTERISTIC PFlt_facFlHighTrm_C PFlt_facFlLowTrm_C PFlt_facNO2RgnPrtMax_CUR PFlt_facSotHighTrm_C PFlt_facSotLowTrm_C PFlt_facSumHighTrm_C PFlt_facSumLowTrm_C PFlt_lSnceRgnIntr_CA PFlt_lSumMaxDef_C PFlt_lSumMax_MAP PFlt_lSumSubs_C PFlt_mSotMeas_CUR PFlt_mSotNewRng1_C PFlt_mSotRng1New_C PFlt_mSotRng1Rng2_C PFlt_mSotRng2Rng1_C PFlt_mSotRng2Rng3_C PFlt_mSotRng3Rng2_C PFlt_mSotRng3Rng4_C PFlt_mSotRng4Rng3_C PFlt_mSotRng4Rng5_C PFlt_mSotRng5Rng4_C PFlt_numEGSys_C PFlt_numEngPOpDel_CA PFlt_numEngPOpIntr_CA PFlt_numEngPOp_CA PFlt_numHCCond_C PFlt_numLst_C PFlt_numPrioRgnStg1_C PFlt_numPrioRgnStg2_C PFlt_numPrioRgnStg3_C PFlt_numPrioRgnStg4_C PFlt_numPrioRgnStg5_C PFlt_numPrioRgnStg6_C PFlt_numPrioRgnStgDiag_C PFlt_numPrt_C PFlt_numRgnSuc_C PFlt_pEngPrtAshCor_MAP PFlt_pEngPrtMaxInit_C PFlt_pEngPrtMax_MAP PFlt_pEngPrtMin_MAP PFlt_qFlMaxDef_C PFlt_qFlMax_CUR PFlt_qFlSubs_C PFlt_qFlTotAdjMax_C PFlt_qFlTotMax_C PFlt_resFlowEngPrtCor_MAP PFlt_resFlowEngPrtMaxInit_C PFlt_resFlowEngPrtMax_MAP PFlt_resFlowEngPrtMin_MAP PFlt_stDiagOn_C PFlt_stLckFuelMsk_C PFlt_stLckRgnMsk_C PFlt_stMinDistRgn_C PFlt_stPrivCanSubs_C PFlt_stRgnActvMskB1_C PFlt_stRgnActvMskB2_C PFlt_stRgnNoComplSubs_C PFlt_stRgnStg1_C PFlt_stRgnStg2_C PFlt_stRgnStg3_C PFlt_stRgnStg4_C PFlt_stRgnStg5_C PFlt_stRgnStg6_C PFlt_stRgnSucMsk_C PFlt_stWaitForOvrRun_C PFlt_swtAshCor_C PFlt_swtDiagOn_C PFlt_swtEngPrtAshCor_C PFlt_swtOfsCor_C PFlt_swtPresResFlowSel_C PFlt_swtServiceVal_C Pflt_swtShOffSuc_C PFlt_swtTmrLckRst_C PFlt_tDltTempOxiPreTwFlw_C PFlt_tDltTempPreTwFlw_C PFlt_tiDebFuelMin_C PFlt_tiDebLck_C PFlt_tiDebQLimErrIntr_C PFlt_tiDebst_C PFlt_DebDltOxiPreMaxDef_C PFlt_DebDltOxiPreMaxOk_C PFlt_DebDltPreMaxDef_C PFlt_DebDltPreMaxOk_C PFlt_tiDebTrqOvhtIntr_C PFlt_tiEngOnMaxDef_C PFlt_tiEngOnMax_C PFlt_tiEngPrtDeb_C PFlt_tiEngPrtPT1_C PFlt_tiEngPrt_C PFlt_tiHCCond_C PFlt_tiKpRgnOvrRun_C PFlt_tiLckRgnErr_CA PFlt_tiLckRgn_CA PFlt_tiLckSubs_C PFlt_tiMaxRgn_C PFlt_tiOpSubs_C PFlt_tiRgnMax_CA PFlt_tiRgnMin_C PFlt_tiRgnSpo_C PFlt_tiWaitForOvrRun_C PFlt_tOxiPreMaxHi_C PFlt_tOxiPreMaxLo_C PFlt_tPreMaxHi_C PFlt_tPreMaxLo_C PFlt_tPreMinOvrRun_C PFlt_tRgnMin_C PFlt_volFlConsumSubs_C PFlt_volFuelFilMinHi_C PFlt_volFuelFilMinLo_C /end DEF_CHARACTERISTIC
 /begin IN_MEASUREMENT Eng_nAvrg InjCtl_qSetUnBal PFlt_facNO2RgnTmp_mp PFlt_lAvrgSnceRgn_mp PFlt_mAshOil_mp PFlt_numRgn_mp PFlt_resFlowOfs_mp PFlt_stEngPOp PFlt_vAvrgSnceRgn_mp /end IN_MEASUREMENT
/end FUNCTION
/begin FUNCTION pflt_corgn_msg ""
 /begin OUT_MEASUREMENT PFlt_lSnceRgnB1 PFlt_lSnceRgnB2 PFlt_numEngPOp PFlt_numPrio PFlt_numRgn PFlt_numRgnB1 PFlt_numRgnB2 PFlt_numTot PFlt_pEngPrtAshCorB1 PFlt_pEngPrtAshCorB2 PFlt_qFlTotB1 PFlt_qFlTotB2 PFlt_resFlowEngPrtCorB1 PFlt_resFlowEngPrtCorB2 PFlt_st PFlt_stEngPrtActvB1 PFlt_stEngPrtActvB2 PFlt_stHCCondActvB1 PFlt_stHCCondActvB2 PFlt_stHCCondEndB1 PFlt_stHCCondEndB2 PFlt_stLck PFlt_stSucB1 PFlt_stSucB2 PFlt_tiOpB1 PFlt_tiOpB2 PFlt_tiSnceRgnB1 PFlt_tiSnceRgnB2 /end OUT_MEASUREMENT
/end FUNCTION
/begin FUNCTION pflt_corgn_uic "" /begin DEF_CHARACTERISTIC PFlt_st_Vector PFlt_st_Channel /end DEF_CHARACTERISTIC
 /begin OUT_MEASUREMENT PFlt_ctStartSnceRgnB1_mp PFlt_ctStartSnceRgnB2_mp PFlt_facAshB1_mp PFlt_facAshB2_mp PFlt_facFlTrmUnlim_mp PFlt_facFlTrm_mp PFlt_facNO2RgnTmp_mp PFlt_facSumTrmUnlim_mp PFlt_facSumTrm_mp PFlt_lAvrgSnceRgnB1_mp PFlt_lAvrgSnceRgnB2_mp PFlt_lAvrgSnceRgn_mp PFlt_lSnceRgnB1_mp PFlt_lSnceRgnB2_mp PFlt_lSnceRgnu16B1_mp PFlt_lSnceRgnu16B2_mp PFlt_lSumB1_mp PFlt_lSumB2_mp PFlt_lSumMaxB1_mp PFlt_lSumMaxB2_mp PFlt_lSumu16B1_mp PFlt_lSumu16B2_mp PFlt_mAshOil_mp PFlt_mSotOfsB1_mp PFlt_mSotOfsB2_mp PFlt_numEngPOp_mp PFlt_numLstB1_mp PFlt_numLstB2_mp PFlt_numPrtB1_mp PFlt_numPrtB2_mp PFlt_numRgnB1_mp PFlt_numRgnB2_mp PFlt_numRgn_mp PFlt_numSotB1_mp PFlt_numSotB2_mp PFlt_numTot_mp PFlt_pEngPrtMaxB1_mp PFlt_pEngPrtMaxB2_mp PFlt_pEngPrtMinB1_mp PFlt_pEngPrtMinB2_mp PFlt_qFlB1_mp PFlt_qFlB2_mp PFlt_qFlMaxB1_mp PFlt_qFlMaxB2_mp PFlt_qFlTotEEPROMB1_mp PFlt_qFlTotEEPROMB2_mp PFlt_resFlowEngPrtMaxB1_mp PFlt_resFlowEngPrtMaxB2_mp PFlt_resFlowEngPrtMinB1_mp PFlt_resFlowEngPrtMinB2_mp PFlt_resFlowOfs_mp PFlt_st1_mp PFlt_st2_mp PFlt_stCntB1_mp PFlt_stCntB2_mp PFlt_stFFLstB1_mp PFlt_stFFLstB2_mp PFlt_stFFPrtB1_mp PFlt_stFFPrtB2_mp PFlt_stIntrB1_mp PFlt_stIntrB2_mp PFlt_stLckFuel_mp PFlt_stLck_mp PFlt_stLstRgnB1_mp PFlt_stLstRgnB2_mp PFlt_stLstRgnEndB1_mp PFlt_stLstRgnEndB2_mp PFlt_stLstRgnStrtB1_mp PFlt_stLstRgnStrtB2_mp PFlt_stNoRgnEffB1_mp PFlt_stNoRgnEffB2_mp PFlt_stNumEngPOpDelOn_mp PFlt_stRgnNoCompl_mp PFlt_stSucB1_mp PFlt_stSucB2_mp PFlt_stSuc_mp PFlt_tiHCCondB1_mp PFlt_tiHCCondB2_mp PFlt_tiLckRls_mp PFlt_tiLstRgnB1_mp PFlt_tiLstRgnB2_mp PFlt_tiOpu16B1_mp PFlt_tiOpu16B2_mp PFlt_tiRgnMax_mp PFlt_tiRgnMinB1_mp PFlt_tiRgnMinB2_mp PFlt_tiSnceRgnu16B1_mp PFlt_tiSnceRgnu16B2_mp PFlt_vAvrgSnceRgnB1_mp PFlt_vAvrgSnceRgnB2_mp PFlt_vAvrgSnceRgn_mp /end OUT_MEASUREMENT
/end FUNCTION
/begin FUNCTION pflt_engpopcalc "Betriebszustandsberechnung für Partikelfilter"
 /begin DEF_CHARACTERISTIC PFlt_nAvrgMinMax_CA PFlt_numPOpAir_C PFlt_numPOpClnt_C PFlt_qSetUnBalRng10Max_GCUR PFlt_qSetUnBalRng10Min_GCUR PFlt_qSetUnBalRng1Max_GCUR PFlt_qSetUnBalRng1Min_GCUR PFlt_qSetUnBalRng2Max_GCUR PFlt_qSetUnBalRng2Min_GCUR PFlt_qSetUnBalRng3Max_GCUR PFlt_qSetUnBalRng3Min_GCUR PFlt_qSetUnBalRng4Max_GCUR PFlt_qSetUnBalRng4Min_GCUR PFlt_qSetUnBalRng5Max_GCUR PFlt_qSetUnBalRng5Min_GCUR PFlt_qSetUnBalRng6Max_GCUR PFlt_qSetUnBalRng6Min_GCUR PFlt_qSetUnBalRng7Max_GCUR PFlt_qSetUnBalRng7Min_GCUR PFlt_qSetUnBalRng8Max_GCUR PFlt_qSetUnBalRng8Min_GCUR PFlt_qSetUnBalRng9Max_GCUR PFlt_qSetUnBalRng9Min_GCUR PFlt_qSetUnBalRngSpoMax_GCUR PFlt_qSetUnBalRngSpoMin_GCUR PFlt_qSetUnBal_AXIS PFlt_rAccPedMinMax_CA PFlt_stGearDebValMax_C PFlt_stGearDebValMin_C PFlt_stGearMinMax_CA PFlt_swtBrkRng_CA PFlt_swtClthRng_CA PFlt_tAirMinMax_CA PFlt_tClntMinMax_CA PFlt_tiAccPedPT1_C PFlt_tiBattCDPT1_C PFlt_tiDebBrkOff_C PFlt_tiDebBrkOn_C PFlt_tiDebConvOff_C PFlt_tiDebConvOn_C PFlt_tiDebGearOff_C PFlt_tiDebGearOn_C PFlt_tiEngSpdPT1_C PFlt_tiInjMsPT1_C PFlt_tiSpdVehPT1_C PFlt_tiTempClntPT1_C PFlt_tiTempOxiPrePT1_C PFlt_tiTempPrePT1_C PFlt_tOxiPreOffMinMax_CA PFlt_tOxiPreOnMinMax_CA PFlt_tPreOffMinMax_CA PFlt_tPreOnMinMax_CA PFlt_uBattMinMax_CA PFlt_vVehMinMax_CA /end DEF_CHARACTERISTIC
 /begin IN_MEASUREMENT PFlt_nAvrgFlt_mp PFlt_RngIdx_X_mp PFlt_RngIdx_Y_mp /end IN_MEASUREMENT
/end FUNCTION
/begin FUNCTION pflt_engpopcalc_msg "" /begin OUT_MEASUREMENT PFlt_stEngPOp /end OUT_MEASUREMENT /end FUNCTION
/begin FUNCTION pflt_engpopcalc_uic "" /begin DEF_CHARACTERISTIC PFlt_stEngPOp_Vector PFlt_stEngPOp_Channel /end DEF_CHARACTERISTIC
 /begin OUT_MEASUREMENT PFlt_nAvrgFlt_mp PFlt_qSetUnBalFlt_mp PFlt_rAccPedFlt_mp PFlt_RngIdx_X_mp PFlt_RngIdx_Y_mp PFlt_stBrkDeb_mp PFlt_stClthDeb_mp PFlt_stEngPOp10_mp PFlt_stEngPOp1_mp PFlt_stEngPOp2_mp PFlt_stEngPOp3_mp PFlt_stEngPOp4_mp PFlt_stEngPOp5_mp PFlt_stEngPOp6_mp PFlt_stEngPOp7_mp PFlt_stEngPOp8_mp PFlt_stEngPOp9_mp PFlt_stEngPOpSpo_mp PFlt_stGearDeb_mp PFlt_stRng10_mp PFlt_stRng1_mp PFlt_stRng2_mp PFlt_stRng3_mp PFlt_stRng4_mp PFlt_stRng5_mp PFlt_stRng6_mp PFlt_stRng7_mp PFlt_stRng8_mp PFlt_stRng9_mp PFlt_stRngSpo_mp PFlt_tClntFlt_mp PFlt_tOxiPreFlt_mp PFlt_tPOpAir_mp PFlt_tPOpClnt_mp PFlt_tPreFlt_mp PFlt_uBattCDFlt_mp PFlt_vVehFlt_mp /end OUT_MEASUREMENT
/end FUNCTION
/begin FUNCTION pflt_engpopprj "Erweiterung für Betriebszustandsberechnung" /begin DEF_CHARACTERISTIC PFlt_vVehUnFltMinMax_CA /end DEF_CHARACTERISTIC /begin IN_MEASUREMENT PFlt_RngIdxPrj_X_mp PFlt_RngIdxPrj_Y_mp /end IN_MEASUREMENT /end FUNCTION
/begin FUNCTION pflt_engpopprj_msg "" /begin OUT_MEASUREMENT PFlt_stEngPOpPrj /end OUT_MEASUREMENT /end FUNCTION
/begin FUNCTION pflt_engpopprj_uic ""
 /begin OUT_MEASUREMENT PFlt_RngIdxPrj_X_mp PFlt_RngIdxPrj_Y_mp PFlt_vVehUnFltMax_mp PFlt_vVehUnFltMin_mp /end OUT_MEASUREMENT
/end FUNCTION
/begin FUNCTION pflt_exhgsppty "dvol + Lambda"
 /begin DEF_CHARACTERISTIC PFlt_dvolPrivCanSubs_C PFlt_numLSUB1_C PFlt_numLSUB2_C PFlt_numLSU_C PFlt_swtASModOn_C PFlt_swtLmbdAprx_C PFlt_tiDebDVol_C /end DEF_CHARACTERISTIC
/end FUNCTION
/begin FUNCTION pflt_exhgsppty_msg ""
 /begin OUT_MEASUREMENT PFlt_dmEGB1 PFlt_dmEGB2 PFlt_dmO2AprxB1 PFlt_dmO2AprxB2 PFlt_dvol PFlt_dvolB1 PFlt_dvolB2 PFlt_qPoI2NonEffB1 PFlt_qPoI2NonEffB2 PFlt_rLmbdAprxB1 PFlt_rLmbdAprxB2 PFlt_rLmbdB1 PFlt_rLmbdB2 /end OUT_MEASUREMENT
/end FUNCTION
/begin FUNCTION pflt_exhgsppty_uic ""
 /begin DEF_CHARACTERISTIC PFlt_dvolB1_Vector PFlt_dvolB1_Channel PFlt_dvolB2_Vector PFlt_dvolB2_Channel /end DEF_CHARACTERISTIC
/end FUNCTION
/begin FUNCTION pflt_masscalc "Berechnung der Rußmasse im Partikefilter"
 /begin DEF_CHARACTERISTIC PFlt_t1DT1Pres_C PFlt_kdDT1Pres_C PFlt_t1DT1Sim_C PFlt_kdDT1Sim_C PFlt_dmNOxEngBas_MAP PFlt_dmNOxEngEGROff_MAP PFlt_dmSotSimBas_MAP PFlt_dmSotSimDyn_CUR PFlt_dmSotSimEGRoff_MAP PFlt_dmSotSimLmbd_MAP PFlt_dmSotSimRgnBas_CUR PFlt_dpDiffMax_C PFlt_dvolMeasMin_C PFlt_facAshVolCor_MAP PFlt_facCnvCatNO2_CUR PFlt_facDvolNO2_CUR PFlt_facDynVisc_CUR PFlt_facEGRNOx_CUR PFlt_facEGRSotSimBas_CUR PFlt_facMflO2SimRgn_CUR PFlt_facMltCor_CUR PFlt_facNO2Sot_C PFlt_facPOpOilAsh_MAP PFlt_facSotSimRgnNO2_CUR PFlt_facSumAdjMax_C PFlt_facTempNO2_CUR PFlt_facTempSimRgn_CUR PFlt_kiMSotRes_C PFlt_mAshOil_CUR PFlt_mSotAdjMax_C PFlt_mSotMeas_MAP PFlt_mSotResAftRgn_CUR PFlt_mSotResAftRgn_MAP PFlt_mSotSimMax_C PFlt_mSotSubs_C PFlt_nResFlowSim_C PFlt_pDiffPFlt_MAP PFlt_rEGRSimMax_C PFlt_rEGRSimMin_C PFlt_resFlowMeasInv_MAP PFlt_resFlowOfs_MAP PFlt_resFlowPhysMax_C PFlt_resFlowPrivCanSubs_C PFlt_resFlowRawInit_C PFlt_resFlow_MAP PFlt_rLmbdStat_MAP PFlt_stMSotResRgnMskB1_C PFlt_stMSotResRgnMskB2_C PFlt_stResFlowPT1RgnMskB1_C PFlt_stResFlowPT1RgnMskB2_C PFlt_stSimRgnMskB1_C PFlt_stSimRgnMskB2_C PFlt_swtFlowVal_C PFlt_swtMSotRes_C PFlt_swtNeutrResFlow_C PFlt_swtOilAsh_C PFlt_swtSensEvalSel_C PFlt_swtServiceValB1_C PFlt_swtServiceValB2_C PFlt_swtSimInitOn_C PFlt_swtSotCalcInitOff_C PFlt_swtSotSimContOn_C PFlt_tiDebResFlow_C PFlt_tiDebSimOff_C PFlt_tiDebSimOn_C PFlt_tiNO2RgnDel_MAP PFlt_tiOpAdjMax_C PFlt_tiResFlowPT1_C PFlt_tiResFlowRawPT1_C PFlt_tiResFlowRgnPT1_C PFlt_tiVolFlowPT1_C PFlt_tiVolFlowRgnPT1_C PFlt_volAdiAsh_CUR PFlt_volOilAshFl_CUR PFlt_volOilAshTiEngOn_CUR PFlt_volPFlt_C /end DEF_CHARACTERISTIC
 /begin IN_MEASUREMENT Eng_nAvrg InjCtl_qSetUnBal PFlt_dmO2AprxCrvIn_mp PFlt_dqSetUnBal_mp PFlt_dvolMassFltIn_mp PFlt_dvol_mp PFlt_facEGRCorRat_mp PFlt_mSotCrvIn_mp PFlt_mSotSimIn_mp PFlt_pDiffSot_mp PFlt_qFlTotCrvIn_mp PFlt_resFlowFlt_mp PFlt_rLmbdDynMapIn_mp PFlt_rLmbdMapIn_mp PFlt_stEngPOpTmp_mp PFlt_tiOpPFltCrvIn_mp PFlt_tOxiPreCrvIn_mp PFlt_tSurfCrvIn_mp PFlt_volAddTot_mp PFlt_volAsh_mp /end IN_MEASUREMENT
/end FUNCTION
/begin FUNCTION pflt_masscalcprj ""
 /begin DEF_CHARACTERISTIC PFlt_dmSotSimInit_C PFlt_IKiFac_C PFlt_IKiPosFac_C PFlt_IKiNegFac_C PFlt_facWinPos_C PFlt_facWinNeg_C PFlt_mSotSimInit_C PFlt_stSotSimInitEngPMsk_C PFlt_stSotSimInitRgnMsk_C PFlt_stSotSimInitTotMsk_C PFlt_swtSotSimInit_C /end DEF_CHARACTERISTIC
/end FUNCTION
/begin FUNCTION pflt_masscalcprj_msg ""
 /begin OUT_MEASUREMENT PFlt_facNO2RgnB1 PFlt_facNO2RgnB2 PFlt_mSotSimInitB1 PFlt_mSotSimInitB2 PFlt_stSotSimInitB1 PFlt_stSotSimInitB2 /end OUT_MEASUREMENT
/end FUNCTION
/begin FUNCTION pflt_masscalcprj_uic ""
 /begin OUT_MEASUREMENT PFlt_facTempIB1_mp PFlt_facTempIB2_mp PFlt_facTempSnceRgnB1_mp PFlt_facTempSnceRgnB2_mp PFlt_stSotSimInitLogB1_mp PFlt_stSotSimInitLogB2_mp /end OUT_MEASUREMENT
/end FUNCTION
/begin FUNCTION pflt_masscalc_msg ""
 /begin OUT_MEASUREMENT PFlt_facAshCorB1 PFlt_facAshCorB2 PFlt_facTempCRTB1 PFlt_facTempCRTB2 PFlt_mAshOil PFlt_mAshOilB1 PFlt_mAshOilB2 PFlt_mSotB1 PFlt_mSotB2 PFlt_mSotMeasB1 PFlt_mSotMeasB2 PFlt_mSotSimB1 PFlt_mSotSimB2 PFlt_mSotSimContB1 PFlt_mSotSimContB2 PFlt_resFlow PFlt_resFlowB1 PFlt_resFlowB2 PFlt_resFlowFltB1 PFlt_resFlowFltB2 PFlt_resFlowOfsB1 PFlt_resFlowOfsB2 PFlt_resFlowRaw PFlt_resFlowRawB1 PFlt_resFlowRawB2 PFlt_rSotB1 PFlt_rSotB2 PFlt_stSimOnB1 PFlt_stSimOnB2 PFlt_volOilAshB1 PFlt_volOilAshB2 /end OUT_MEASUREMENT
/end FUNCTION
/begin FUNCTION pflt_masscalc_uic ""
 /begin DEF_CHARACTERISTIC PFlt_mSotB1_Vector PFlt_mSotB1_Channel PFlt_mSotB2_Vector PFlt_mSotB2_Channel PFlt_resFlowB1_Vector PFlt_resFlowB1_Channel PFlt_resFlowB2_Vector PFlt_resFlowB2_Channel PFlt_resFlow_Vector PFlt_resFlow_Channel /end DEF_CHARACTERISTIC
 /begin OUT_MEASUREMENT PFlt_dmNO2TotB1_mp PFlt_dmNO2TotB2_mp PFlt_dmNOxRaw_mp PFlt_dmO2AprxCrvIn_mp PFlt_dmSotSimB1_mp PFlt_dmSotSimB2_mp PFlt_dmSotSimDynB1_mp PFlt_dmSotSimDynB2_mp PFlt_dmSotSimDynInjMs_mp PFlt_dmSotSimDynLmbdB1_mp PFlt_dmSotSimDynLmbdB2_mp PFlt_dmSotSimEmiB1_mp PFlt_dmSotSimEmiB2_mp PFlt_dmSotSimRgnB1_mp PFlt_dmSotSimRgnB2_mp PFlt_dmSotSimRgnNO2B1_mp PFlt_dmSotSimRgnNO2B2_mp PFlt_dmSotSimRgnNO2RawB1_mp PFlt_dmSotSimRgnNO2RawB2_mp PFlt_dmSotSimRgnThrB1_mp PFlt_dmSotSimRgnThrB2_mp PFlt_dmSotSimSty_mp PFlt_dpDiffB1_mp PFlt_dpDiffB2_mp PFlt_dqSetUnBal_mp PFlt_dvolMassFltB1_mp PFlt_dvolMassFltB2_mp PFlt_dvolMassFltIn_mp PFlt_dvol_mp PFlt_facAshVolCorB1_mp PFlt_facAshVolCorB2_mp PFlt_facDvolNO2B1_mp PFlt_facDvolNO2B2_mp PFlt_facEGRCorRat_mp PFlt_facEGRNOx_mp PFlt_facEGRSotSimBas_mp PFlt_facMltCorB1_mp PFlt_facMltCorB2_mp PFlt_facPOpOilAshAvrgB1_mp PFlt_facPOpOilAshAvrgB2_mp PFlt_facPOpOilAshSumB1_mp PFlt_facPOpOilAshSumB2_mp PFlt_facPOpOilAsh_mp PFlt_facSotSimRgnNO2B1_mp PFlt_facSotSimRgnNO2B2_mp PFlt_mSotCrvB1_mp PFlt_mSotCrvB2_mp PFlt_mSotCrvIn_mp PFlt_mSotEEPROMB1_mp PFlt_mSotEEPROMB2_mp PFlt_mSotMeasRawB1_mp PFlt_mSotMeasRawB2_mp PFlt_mSotResActB1_mp PFlt_mSotResActB2_mp PFlt_mSotResB1_mp PFlt_mSotResB2_mp PFlt_mSotSimIn_mp PFlt_mSotSimNoContB1_mp PFlt_mSotSimNoContB2_mp PFlt_pDiffAshVolCorB1_mp PFlt_pDiffAshVolCorB2_mp PFlt_pDiffPFltB1_mp PFlt_pDiffPFltB2_mp PFlt_pDiffSotB1_mp PFlt_pDiffSotB2_mp PFlt_pDiffSot_mp PFlt_pDiff_mp PFlt_qFlTotCrvIn_mp PFlt_resFlowFlt_mp PFlt_resFlowInvB1_mp PFlt_resFlowInvB2_mp PFlt_resFlowRawB1_mp PFlt_resFlowRawB2_mp PFlt_rLmbdDynB1_mp PFlt_rLmbdDynB2_mp PFlt_rLmbdDynMapIn_mp PFlt_rLmbdMapIn_mp PFlt_stEGROff_mp PFlt_stEngPOpTmp_mp PFlt_stNO2ActvB1_mp PFlt_stNO2ActvB2_mp PFlt_stSimOnB1_mp PFlt_stSimOnB2_mp PFlt_tiActRgnB1_mp PFlt_tiActRgnB2_mp PFlt_tiNO2RgnDel_mp PFlt_tiOpPFltB1_mp PFlt_tiOpPFltB2_mp PFlt_tiOpPFltCrvIn_mp PFlt_tiOpPFltEEPROMB1_mp PFlt_tiOpPFltEEPROMB2_mp PFlt_tOxiPreCrvIn_mp PFlt_tSurfCrvIn_mp PFlt_volAddTot_mp PFlt_volAdiAsh_mp PFlt_volAshB1_mp PFlt_volAshB2_mp PFlt_volAsh_mp PFlt_volOilAshFlB1_mp PFlt_volOilAshFlB2_mp PFlt_volOilAshTEngB1_mp PFlt_volOilAshTEngB2_mp /end OUT_MEASUREMENT
/end FUNCTION
/begin COMPU_METHOD Acc "Fahrzeugbeschleunigung" RAT_FUNC "%6.5" "m/s^2" COEFFS 0 1000 0 0 0 1 /end COMPU_METHOD
/begin COMPU_METHOD AirMassPerTime "Luftmasse pro Zeit" RAT_FUNC "%6.3" "Kg/h" COEFFS 0 10 0 0 0 1 /end COMPU_METHOD
/begin COMPU_METHOD CubMtrPerHr "Volumsstrom in m^3/h" RAT_FUNC "%6.3" "m^3/h" COEFFS 0 10 0 0 0 1 /end COMPU_METHOD
/begin COMPU_METHOD dmSoot_mg_p_s "differenzielle Rußmasse mg/s" RAT_FUNC "%6.4" "mg/s" COEFFS 0 100 0 0 0 1 /end COMPU_METHOD
/begin COMPU_METHOD EngN "Motordrehzahl" RAT_FUNC "%6.2" "rpm" COEFFS 0 1 0 0 0 1 /end COMPU_METHOD
/begin COMPU_METHOD EngTempFldSel "Verbale Umrechnung für Auswahl aus dem Motortemperatur-Feld Eng_tFld" TAB_VERB "%6.3" "-" COMPU_TAB_REF EngTempFldSel /end COMPU_METHOD
/begin COMPU_VTAB EngTempFldSel "Verbale Umrechnung für Auswahl aus dem Motortemperatur-Feld Eng_tFld" TAB_VERB 3 0 "Coolant_Temperature" 1 "Oil_Temperature" 2 "Eng_tEng" /end COMPU_VTAB
/begin COMPU_METHOD Fact "Faktor mit Auflösung 1 / 8192, hauptsächlich für einen Faktorenbereich 0...1 verwendet" RAT_FUNC "%6.5" "-" COEFFS 0 8192 0 0 0 1 /end COMPU_METHOD
/begin COMPU_METHOD Fact1 "Faktor mit Auflösung 0,01 (100 mal höherer Bereich als Fact)" RAT_FUNC "%6.4" "-" COEFFS 0 128 0 0 0 1 /end COMPU_METHOD
/begin COMPU_METHOD Fact3 "Faktor fuer Carb Signale" RAT_FUNC "%6.5" "-" COEFFS 0 4096 0 0 0 1 /end COMPU_METHOD
/begin COMPU_METHOD Fact4 "Umrechnungsformel fuer Masse pro Zyklus auf Druck" RAT_FUNC "%6.4" "-" COEFFS 0 20 0 0 0 1 /end COMPU_METHOD
/begin COMPU_METHOD FactLow "Faktor mit Auflösung 1/1024, hauptsächlich für einen Faktorenbereich 1...50 verwendet" RAT_FUNC "%6.5" "-" COEFFS 0 1024 0 0 0 1 /end COMPU_METHOD
/begin COMPU_METHOD Fl_2 "Umrechnung for getting 16 bit  total fuel consumption" RAT_FUNC "%6.1" "l" COEFFS 0 0.1 0 0 0 1 /end COMPU_METHOD
/begin COMPU_METHOD Fl_Half_L "Kraftstoffverbrauchsintegral" RAT_FUNC "%6.4" "l" COEFFS 0 20 0 0 0 1 /end COMPU_METHOD
/begin COMPU_METHOD Fl_L "Treibstoffmenge [l]" RAT_FUNC "%6.4" "l" COEFFS 0 100 0 0 0 1 /end COMPU_METHOD
/begin COMPU_METHOD Fl_Vol "Kraftstoffverbrauch pro 100 km" RAT_FUNC "%6.5" "l/100km" COEFFS 0 1000 0 0 0 1 /end COMPU_METHOD
/begin COMPU_METHOD IndSysTempFldSel "Auswahl für Lufttemperaturfeld" TAB_VERB "%6.3" "-" COMPU_TAB_REF IndSysTempFldSel /end COMPU_METHOD
/begin COMPU_VTAB IndSysTempFldSel "Auswahl für Lufttemperaturfeld" TAB_VERB 3 0 "IATSCD_tAir" 1 "AFSCD_tAir" 2 "EATSCD_tAir" /end COMPU_VTAB
/begin COMPU_METHOD InjMass "Einspritzmenge" RAT_FUNC "%6.4" "mg/hub" COEFFS 0 100 0 0 0 1 /end COMPU_METHOD
/begin COMPU_METHOD InjMassCyc "Einspritzmenge pro Zyklus (mg/Zyklus)" RAT_FUNC "%6.4" "mg/cyc" COEFFS 0 100 0 0 0 1 /end COMPU_METHOD
/begin COMPU_METHOD InjMassInj "Einspritzmenge pro Einspritzung (mg/Einspritzung)" RAT_FUNC "%6.4" "mg/inj" COEFFS 0 100 0 0 0 1 /end COMPU_METHOD
/begin COMPU_METHOD InjMassPerSec_20ms "Einspritzmengenänderung pro Sekunde für 20ms-Tasks" RAT_FUNC "%6.3" "mg/hub/s" COEFFS 0 2 0 0 0 1 /end COMPU_METHOD
/begin COMPU_METHOD Kd "Differentialverstärkung Kd (gleiche Einheit/Umrechnungsformel an Ein- und Ausgang)" RAT_FUNC "%7.6" "1/1" COEFFS 0 65536 0 0 0 1 /end COMPU_METHOD
/begin COMPU_METHOD Ki "Integrale Verstärkung Ki (gleiche Einheit/Umrechnungsregel an Ein- und Ausgang)" RAT_FUNC "%6.5" "1/s" COEFFS 0 4294.967296 0 0 0 1 /end COMPU_METHOD
/begin COMPU_METHOD Ki_mSoot "Integratorverstaerkung" RAT_FUNC "%6.4" "1/s" COEFFS 0 819 0 0 0 1 /end COMPU_METHOD
/begin COMPU_METHOD lambda "Lambda" RAT_FUNC "%6.5" "-" COEFFS 0 1000 0 0 0 1 /end COMPU_METHOD
/begin COMPU_METHOD Length "Länge in Meter" RAT_FUNC "%6.2" "m" COEFFS 0 1 0 0 0 1 /end COMPU_METHOD
/begin COMPU_METHOD LengthKm "Länge in Kilometer" RAT_FUNC "%6.2" "km" COEFFS 0 1 0 0 0 1 /end COMPU_METHOD
/begin COMPU_METHOD lSnceRgnRes "gefahrene Strecke seit der letzten erfolgreichen Regeneration" RAT_FUNC "%6.0" "m" COEFFS 0 0.0078125 0 0 0 1 /end COMPU_METHOD
/begin COMPU_METHOD lSumRes "Gesamte gefahrene Strecke" RAT_FUNC "%8.0" "m" COEFFS 0 6.103515625e-05 0 0 0 1 /end COMPU_METHOD
/begin COMPU_METHOD mSoot_g "Rußmasse [g]" RAT_FUNC "%6.4" "g" COEFFS 0 100 0 0 0 1 /end COMPU_METHOD
/begin COMPU_METHOD OneToOne "eins zu eins (physikalischer Wert ist gleich dem internen Wert)" RAT_FUNC "%6.2" "-" COEFFS 0 1 0 0 0 1 /end COMPU_METHOD
/begin COMPU_METHOD Prc "Prozent, gleiche interne Auflösung wie Fact, aber Darstellung in Prozent (0...100%)" RAT_FUNC "%6.4" "%" COEFFS 0 81.92 0 0 0 1 /end COMPU_METHOD
/begin COMPU_METHOD Pres_hPa "Druck (angezeigt in [hPa])" RAT_FUNC "%6.2" "hPa" COEFFS 0 1 0 0 0 1 /end COMPU_METHOD
/begin COMPU_METHOD Res_hPaHrPerCM "Strömungswiderstand [hPa h/m3]" RAT_FUNC "%6.5" "hPa/(m^3/h)" COEFFS 0 1000 0 0 0 1 /end COMPU_METHOD
/begin COMPU_METHOD RmpMSoot "" RAT_FUNC "%6.5" "g/s" COEFFS 0 6553.6 0 0 0 1 /end COMPU_METHOD
/begin COMPU_METHOD Soot_gPerLtr "Partikelmasse pro Filtervolumen" RAT_FUNC "%6.4" "g/l" COEFFS 0 100 0 0 0 1 /end COMPU_METHOD
/begin COMPU_METHOD TempDiff_Cels "difference/offset temperature displayed in degree celcius" RAT_FUNC "%6.3" "deg C" COEFFS 0 10 0 0 0 1 /end COMPU_METHOD
/begin COMPU_METHOD Temp_Cels "Temperatur dargestellt in °C (gleiche interne Darstellung wie Temp_Kelv)" RAT_FUNC "%6.1" "deg C" COEFFS 0 10 2731.4 0 0 1 /end COMPU_METHOD
/begin COMPU_METHOD Temp_Fahr "Temperatur dargestellt in Fahrenheit (gleiche interne Darstellung wie Temp_Kelv)" RAT_FUNC "%6.1" "deg F" COEFFS 0 5.55555555555556 2553.62222222222 0 0 1 /end COMPU_METHOD
/begin COMPU_METHOD TimeDeb "Entprellzeit in Millisekunden für Libraryfunktion Debounce" RAT_FUNC "%6.1" "ms" COEFFS 0 0.1 0 0 0 1 /end COMPU_METHOD
/begin COMPU_METHOD TimeDelay_s "Zeitkonstante T1 (in s) für PT1, DT1, etc." RAT_FUNC "%9.3" "s" COEFFS 0 0 1 0 0.00023283064365387 0 /end COMPU_METHOD
/begin COMPU_METHOD TimeDsmDC "Skalierung Zeit DSM Driving cycle Verzögerung" RAT_FUNC "%6.2" "s" COEFFS 0 1 0 0 0 1 /end COMPU_METHOD
/begin COMPU_METHOD TimeEngOn "Motorbetriebszeit in Sekunden" RAT_FUNC "%6.2" "s" COEFFS 0 1 0 0 0 1 /end COMPU_METHOD
/begin COMPU_METHOD TimePFltLimpHome "" RAT_FUNC "%6.1" "s" COEFFS 0 0.1 0 0 0 1 /end COMPU_METHOD
/begin COMPU_METHOD Time_Hr "Umrechnung fuer die Dauer des Partikelfilterbetriebes" RAT_FUNC "%6.3" "h" COEFFS 0 2 0 0 0 1 /end COMPU_METHOD
/begin COMPU_METHOD Time_ms "Zeit in ms für Fehlerentprellung (DSM) und SW-Timer" RAT_FUNC "%6.1" "ms" COEFFS 0 0.1 0 0 0 1 /end COMPU_METHOD
/begin COMPU_METHOD Time_s "Zeit in s für Fehlerentprellung (DSM) und SW-Timer" RAT_FUNC "%6.4" "s" COEFFS 0 100 0 0 0 1 /end COMPU_METHOD
/begin COMPU_METHOD tiOpRes "Motorbetriebszeit" RAT_FUNC "%6.1" "s" COEFFS 0 0.015625 0 0 0 1 /end COMPU_METHOD
/begin COMPU_METHOD tiSncergnRes "Motorbetriebsszeit seit der letzten erfolgreichen Regeneration" RAT_FUNC "%6.0" "s" COEFFS 0 0.00390625 0 0 0 1 /end COMPU_METHOD
/begin COMPU_METHOD Vel "Fahrzeuggeschwindigkeit, gleiche interne Auflösung wie Vel_SI" RAT_FUNC "%6.4" "km/h" COEFFS 0 100 0 0 0 1 /end COMPU_METHOD
/begin COMPU_METHOD Vel_kmh "" RAT_FUNC "%6.4" "km/h" COEFFS 0 27.7777777777778 0 0 0 1 /end COMPU_METHOD
/begin COMPU_METHOD Vol "Volumen" RAT_FUNC "%6.4" "l" COEFFS 0 100 0 0 0 1 /end COMPU_METHOD
/begin COMPU_METHOD volAdd_ml2 "Umrechnung mit 1ml Auflösung für Additivmenge in AddPmp_AddMet" RAT_FUNC "%6.2" "ml" COEFFS 0 1 0 0 0 1 /end COMPU_METHOD
/begin COMPU_METHOD Volt_Batt "Batteriespannung" RAT_FUNC "%6.1" "mV" COEFFS 0 0.05115 0 0 0 1 /end COMPU_METHOD
/begin RECORD_LAYOUT Gkl_Ws16 FNC_VALUES 1 SWORD COLUMN_DIR DIRECT /end RECORD_LAYOUT
/begin RECORD_LAYOUT GSst_Xs16 NO_AXIS_PTS_X 1 SWORD AXIS_PTS_X 2 SWORD INDEX_INCR DIRECT /end RECORD_LAYOUT
/begin RECORD_LAYOUT Kf_Xs16_Ys16_Ws16 NO_AXIS_PTS_X 1 SWORD NO_AXIS_PTS_Y 2 SWORD AXIS_PTS_X 3 SWORD INDEX_INCR DIRECT AXIS_PTS_Y 4 SWORD INDEX_INCR DIRECT FNC_VALUES 5 SWORD COLUMN_DIR DIRECT /end RECORD_LAYOUT
/begin RECORD_LAYOUT Kf_Xu8_Yu8_Wu8 NO_AXIS_PTS_X 1 UBYTE NO_AXIS_PTS_Y 2 UBYTE AXIS_PTS_X 3 UBYTE INDEX_INCR DIRECT AXIS_PTS_Y 4 UBYTE INDEX_INCR DIRECT FNC_VALUES 5 UBYTE COLUMN_DIR DIRECT /end RECORD_LAYOUT
/begin RECORD_LAYOUT Kl_Xs16_Ws16 NO_AXIS_PTS_X 1 SWORD AXIS_PTS_X 2 SWORD INDEX_INCR DIRECT FNC_VALUES 3 SWORD COLUMN_DIR DIRECT /end RECORD_LAYOUT
/begin RECORD_LAYOUT Kwb_Wu32 FNC_VALUES 1 ULONG COLUMN_DIR DIRECT /end RECORD_LAYOUT
/begin RECORD_LAYOUT Kwb_Wu8 FNC_VALUES 1 UBYTE COLUMN_DIR DIRECT /end RECORD_LAYOUT
/begin RECORD_LAYOUT Kw_Ws16 FNC_VALUES 1 SWORD COLUMN_DIR DIRECT /end RECORD_LAYOUT
/begin RECORD_LAYOUT Kw_Ws32 FNC_VALUES 1 SLONG COLUMN_DIR DIRECT /end RECORD_LAYOUT
/begin RECORD_LAYOUT Kw_Ws8 FNC_VALUES 1 SBYTE COLUMN_DIR DIRECT /end RECORD_LAYOUT
/begin RECORD_LAYOUT Kw_Wu16 FNC_VALUES 1 UWORD COLUMN_DIR DIRECT /end RECORD_LAYOUT
/begin RECORD_LAYOUT Kw_Wu32 FNC_VALUES 1 ULONG COLUMN_DIR DIRECT /end RECORD_LAYOUT
/begin RECORD_LAYOUT Kw_Wu8 FNC_VALUES 1 UBYTE COLUMN_DIR DIRECT /end RECORD_LAYOUT
/end MODULE
/end PROJECT
