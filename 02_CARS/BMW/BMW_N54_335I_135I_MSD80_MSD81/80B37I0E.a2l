ASAP2_VERSION 1 41
/begin PROJECT MSD70 "Spray Guided DI-System with Piezo Injectors for 6-Cylinder"
/begin HEADER "_default_HeaderComment" PROJECT_NO _0B /end HEADER
/begin MODULE _default_ModuleName "_default_ModuleLongIdentifier"
/begin MOD_COMMON "_default_ModCommonComment" DEPOSIT ABSOLUTE BYTE_ORDER MSB_LAST ALIGNMENT_BYTE 1 ALIGNMENT_WORD 2 ALIGNMENT_LONG 2 ALIGNMENT_FLOAT32_IEEE 2 ALIGNMENT_FLOAT64_IEEE 4 /end MOD_COMMON
/begin MEASUREMENT Agrpos_soll "AGR-Ventil Sollposition" UWORD _CNV_R_R_Def_f_uw_b_576_CM 1 100. 0. 99.9984 DISPLAY_IDENTIFIER AGRPOS_SOLL ECU_ADDRESS 0xd0007b3c FORMAT "%8.3" /end MEASUREMENT
/begin MEASUREMENT Atlr "Stellgröße aus ATL-Regler" UWORD _CNV_R_R_Def_f_uw_b_576_CM 1 100. 0. 99.9984 DISPLAY_IDENTIFIER ATLR ECU_ADDRESS 0xd00069e8 FORMAT "%8.3" /end MEASUREMENT
/begin MEASUREMENT Atlr_d "Stellgröße - D Anteil" SWORD _CNV_R_R_Def_rel_sw_584_CM 1 100. -100. 99.9969 DISPLAY_IDENTIFIER ATLR_D ECU_ADDRESS 0xd00069fe FORMAT "%8.3" /end MEASUREMENT
/begin MEASUREMENT Atlr_i "Stellgöße - I Anteil" SWORD _CNV_R_R_Def_rel_sw_584_CM 1 100. -100. 99.9969 DISPLAY_IDENTIFIER ATLR_I ECU_ADDRESS 0xd00069ea FORMAT "%8.3" /end MEASUREMENT
/begin MEASUREMENT Atlr_oad "Wastegateansteuerung ohne Adaption" UWORD _CNV_R_R_Def_f_uw_b_576_CM 1 100. 0. 99.9984 DISPLAY_IDENTIFIER ATLR_OAD ECU_ADDRESS 0xd0007070 FORMAT "%8.3" /end MEASUREMENT
/begin MEASUREMENT Atlr_p "Stellgröße - P Anteil" SWORD _CNV_R_R_Def_rel_sw_584_CM 1 100. -100. 99.9969 DISPLAY_IDENTIFIER ATLR_P ECU_ADDRESS 0xd00069fa FORMAT "%8.3" /end MEASUREMENT
/begin MEASUREMENT Atlr_pi "Stellgröße - Summe P und I Anteil" SWORD _CNV_R_R_Def_rel_sw_584_CM 1 100. -100. 99.9969 DISPLAY_IDENTIFIER ATLR_PI ECU_ADDRESS 0xd00069fc FORMAT "%8.3" /end MEASUREMENT
/begin MEASUREMENT Atlvst "Stellgöße Anteil durch Vorsteuerung" UWORD _CNV_R_R_Def_f_uw_b_576_CM 1 100. 0. 99.9984 DISPLAY_IDENTIFIER ATLVST ECU_ADDRESS 0xd00069ec FORMAT "%8.3" /end MEASUREMENT
/begin MEASUREMENT Atlvst_dyn "Dynamic der Stellgröße Anteil durch Vorsteuerung" SWORD _CNV_R_R_Def_rel_sw_584_CM 1 100. -100. 99.9969 DISPLAY_IDENTIFIER ATLVST_DYN ECU_ADDRESS 0xd00069f4 FORMAT "%8.3" /end MEASUREMENT
/begin MEASUREMENT Atlvst_f "Gefilterter Stellgröße Anteil durch Vorsteuerung" UWORD _CNV_R_R_Def_f_uw_b_576_CM 1 100. 0. 99.9984 DISPLAY_IDENTIFIER ATLVST_F ECU_ADDRESS 0xd00069f2 FORMAT "%8.3" /end MEASUREMENT
/begin MEASUREMENT Atlvst_tmp "Stellgröße Anteil durch Vorsteuerung" UWORD _CNV_R_R_Def_f_uw_b_576_CM 1 100. 0. 99.9984 DISPLAY_IDENTIFIER ATLVST_TMP ECU_ADDRESS 0xd00069f0 FORMAT "%8.3" /end MEASUREMENT
/begin MEASUREMENT Ddpste "Delta-Differenzdruck Saugrohr bei TE" SWORD _CNV_R_R_Def_p_sw_q_578_CM 1 100. -1280. 1279.9609 DISPLAY_IDENTIFIER DDPSTE ECU_ADDRESS 0xd0007a08 FORMAT "%7.2" /end MEASUREMENT
/begin MEASUREMENT Ddpstevf "Delta-Differenzdruck Saugrohr bei TE ungefiltert" SWORD _CNV_R_R_Def_p_sw_q_578_CM 1 100. -1280. 1279.9609 DISPLAY_IDENTIFIER DDPSTEVF ECU_ADDRESS 0xd0007a0a FORMAT "%7.2" /end MEASUREMENT
/begin MEASUREMENT Dexwkor_ist "Ist-Excenterwinkeländerung" UWORD _CNV_R_R_Def_exwink_601_CM 1 100. 0. 180. DISPLAY_IDENTIFIER DEXWKOR_IST ECU_ADDRESS 0xd0007b14 FORMAT "%7.2" /end MEASUREMENT
/begin MEASUREMENT Dexwkor_soll "Soll-Excenterwinkeländerung" UWORD _CNV_R_R_Def_exwink_601_CM 1 100. 0. 180. DISPLAY_IDENTIFIER DEXWKOR_SOLL ECU_ADDRESS 0xd0007b16 FORMAT "%7.2" /end MEASUREMENT
/begin MEASUREMENT Dhubra "Einlassventilhubrampe fuer Uebergang UGD-GD" UWORD _CNV_R_R_Def_hub_uw_605_CM 1 100. 0. 65.535 DISPLAY_IDENTIFIER DHUBRA ECU_ADDRESS 0xd0007ae4 FORMAT "%8.3" /end MEASUREMENT
/begin MEASUREMENT Dhubtm "Huboffset" SWORD _CNV_R_R_Def_hub_uw_605_CM 1 100. -32.768 32.767 DISPLAY_IDENTIFIER DHUBTM ECU_ADDRESS 0xd0007ade FORMAT "%8.3" /end MEASUREMENT
/begin MEASUREMENT Disa_ist_vz "" UWORD _CNV_R_R_Def_f_uw_b_576_CM 1 100. 0. 99.9984 DISPLAY_IDENTIFIER DISA_IST_VZ ECU_ADDRESS 0xd0007b62 FORMAT "%8.3" /end MEASUREMENT
/begin MEASUREMENT Disa_soll "" UWORD _CNV_R_R_Def_f_uw_b_576_CM 1 100. 0. 99.9984 DISPLAY_IDENTIFIER DISA_SOLL ECU_ADDRESS 0xd0007b64 FORMAT "%8.3" /end MEASUREMENT
/begin MEASUREMENT Disa_stufe "" UBYTE _CNV_R_R_Def_dez_sl_575_CM 1 100. 0. 255. DISPLAY_IDENTIFIER DISA_STUFE ECU_ADDRESS 0xd0007b66 FORMAT "%3.0" /end MEASUREMENT
/begin MEASUREMENT Dn_disadynk "" SWORD _CNV_R_R_Def_n_sw_q_612_CM 1 100. -32768. 32767. DISPLAY_IDENTIFIER DN_DISADYNK ECU_ADDRESS 0xd0007b6e FORMAT "%5.0" /end MEASUREMENT
/begin MEASUREMENT Dnwoto_mn "" UWORD _CNV_R_R_Def_spr_sw_583_CM 1 100. 0. 6553.5 DISPLAY_IDENTIFIER DNWOTO_MN ECU_ADDRESS 0xd000798c FORMAT "%7.2" ARRAY_SIZE 2 MATRIX_DIM 2 1 1 /end MEASUREMENT
/begin MEASUREMENT Dnwoto_mx "" UWORD _CNV_R_R_Def_spr_sw_583_CM 1 100. 0. 6553.5 DISPLAY_IDENTIFIER DNWOTO_MX ECU_ADDRESS 0xd0007990 FORMAT "%7.2" ARRAY_SIZE 2 MATRIX_DIM 2 1 1 /end MEASUREMENT
/begin MEASUREMENT Dpbkv "Bremsunterdruck" SWORD _CNV_R_R_Def_p_sw_q_613_CM 1 100. -3276.8 3276.7 DISPLAY_IDENTIFIER DPBKV ECU_ADDRESS 0xc0004038 FORMAT "%7.2" /end MEASUREMENT
/begin MEASUREMENT Dpbkv_dif_f "Delta Bremsunterdruck gefiltert" SWORD _CNV_R_R_Def_p_sw_q_613_CM 1 100. -3276.8 3276.7 DISPLAY_IDENTIFIER DPBKV_DIF_F ECU_ADDRESS 0xc0000f64 FORMAT "%7.2" /end MEASUREMENT
/begin MEASUREMENT Dpbkv_dif_of "Delta Bremsunterdruck ungefiltert" SWORD _CNV_R_R_Def_p_sw_q_613_CM 1 100. -3276.8 3276.7 DISPLAY_IDENTIFIER DPBKV_DIF_OF ECU_ADDRESS 0xc0000f62 FORMAT "%7.2" /end MEASUREMENT
/begin MEASUREMENT Dpbkv_diff "Delta Bremsunterdruck" SWORD _CNV_R_R_Def_p_sw_q_613_CM 1 100. -3276.8 3276.7 DISPLAY_IDENTIFIER DPBKV_DIFF ECU_ADDRESS 0xc0000f5c FORMAT "%7.2" /end MEASUREMENT
/begin MEASUREMENT Dpbkv_f "Bremsunterdruck gefiltert" SWORD _CNV_R_R_Def_p_sw_q_613_CM 1 100. -3276.8 3276.7 DISPLAY_IDENTIFIER DPBKV_F ECU_ADDRESS 0xc0000f60 FORMAT "%7.2" /end MEASUREMENT
/begin MEASUREMENT Dpbkv_of "Bremsunterdruck ungefiltert" SWORD _CNV_R_R_Def_p_sw_q_613_CM 1 100. -3276.8 3276.7 DISPLAY_IDENTIFIER DPBKV_OF ECU_ADDRESS 0xc0000f5e FORMAT "%7.2" /end MEASUREMENT
/begin MEASUREMENT Dpld_grd_mem "Zwischenspeicher Regeldifferenz Gradienten" SWORD _CNV_R_R_Def_p_sw_q_614_CM 1 100. -2560. 2559.9218 DISPLAY_IDENTIFIER DPLD_GRD_MEM ECU_ADDRESS 0xd0006a3c FORMAT "%7.2" ARRAY_SIZE 16 MATRIX_DIM 16 1 1 /end MEASUREMENT
/begin MEASUREMENT Dps_hub "Soll-Differenzdruck Vvt" SWORD _CNV_R_R_Def_p_sw_q_578_CM 1 100. -1280. 1279.9609 DISPLAY_IDENTIFIER DPS_HUB ECU_ADDRESS 0xd0007a3e FORMAT "%7.2" /end MEASUREMENT
/begin MEASUREMENT Dps_hubtd_mx "" SWORD _CNV_R_R_Def_p_sw_q_578_CM 1 100. -1280. 1279.9609 DISPLAY_IDENTIFIER DPS_HUBTD_MX ECU_ADDRESS 0xd00079e2 FORMAT "%7.2" /end MEASUREMENT
/begin MEASUREMENT Dpsfak "-" UBYTE _CNV_R_R_Def_f_ub_b_573_CM 1 100. 0. 0.996 DISPLAY_IDENTIFIER DPSFAK ECU_ADDRESS 0xd00079c2 /end MEASUREMENT
/begin MEASUREMENT Dpsfak_1 "-" UBYTE _CNV_R_R_Def_f_ub_b_573_CM 1 100. 0. 0.996 DISPLAY_IDENTIFIER DPSFAK_1 ECU_ADDRESS 0xd00079f8 /end MEASUREMENT
/begin MEASUREMENT Dpsfak_2 "-" UBYTE _CNV_R_R_Def_f_ub_b_573_CM 1 100. 0. 0.996 DISPLAY_IDENTIFIER DPSFAK_2 ECU_ADDRESS 0xd00079f9 /end MEASUREMENT
/begin MEASUREMENT Dpsrampe "führt Dps_hub an den Soll-Vvt-Diffdruck über eine Rampe" SWORD _CNV_R_R_Def_p_sw_q_578_CM 1 100. -1280. 1279.9609 DISPLAY_IDENTIFIER DPSRAMPE ECU_ADDRESS 0xd0007a40 FORMAT "%7.2" /end MEASUREMENT
/begin MEASUREMENT Dpssol "Soll-Differenzdruck Saugrohr" SWORD _CNV_R_R_Def_p_sw_q_578_CM 1 100. -1280. 1279.9609 DISPLAY_IDENTIFIER DPSSOL ECU_ADDRESS 0xd00079cc FORMAT "%7.2" /end MEASUREMENT
/begin MEASUREMENT Dpssol_mem "Speichervar für Dpssol-Filterung" SLONG _CNV_R_R_Def_dez_sl_575_CM 1 100. -2147483648. 2147483647. DISPLAY_IDENTIFIER DPSSOL_MEM ECU_ADDRESS 0xd0007a4c FORMAT "%7.0" /end MEASUREMENT
/begin MEASUREMENT Dpssolfilt "Soll-Differenzdruck gefiltert" SWORD _CNV_R_R_Def_p_sw_q_578_CM 1 100. -1280. 1279.9609 DISPLAY_IDENTIFIER DPSSOLFILT ECU_ADDRESS 0xd00079d2 FORMAT "%7.2" /end MEASUREMENT
/begin MEASUREMENT Dpssolgd "Soll-Differenzdruck gedrosselt" SWORD _CNV_R_R_Def_p_sw_q_578_CM 1 100. -1280. 1279.9609 DISPLAY_IDENTIFIER DPSSOLGD ECU_ADDRESS 0xd00079ea FORMAT "%7.2" /end MEASUREMENT
/begin MEASUREMENT Dpssolps "" SWORD _CNV_R_R_Def_p_sw_q_578_CM 1 100. -1280. 1279.9609 DISPLAY_IDENTIFIER DPSSOLPS ECU_ADDRESS 0xd0007a9c FORMAT "%7.2" /end MEASUREMENT
/begin MEASUREMENT Dpssoltd "" SWORD _CNV_R_R_Def_p_sw_q_578_CM 1 100. -1280. 1279.9609 DISPLAY_IDENTIFIER DPSSOLTD ECU_ADDRESS 0xd00079e0 FORMAT "%7.2" /end MEASUREMENT
/begin MEASUREMENT Dpssoltdr "" SWORD _CNV_R_R_Def_p_sw_q_578_CM 1 100. -1280. 1279.9609 DISPLAY_IDENTIFIER DPSSOLTDR ECU_ADDRESS 0xd00079de FORMAT "%7.2" /end MEASUREMENT
/begin MEASUREMENT Dpste "Differenzdruck Saugrohr bei TE" SWORD _CNV_R_R_Def_p_sw_q_578_CM 1 100. -1280. 1279.9609 DISPLAY_IDENTIFIER DPSTE ECU_ADDRESS 0xd0007a0c FORMAT "%7.2" /end MEASUREMENT
/begin MEASUREMENT Dpsvvtte "Differenzdruck Saugrohr bei TE" SWORD _CNV_R_R_Def_p_sw_q_578_CM 1 100. -1280. 1279.9609 DISPLAY_IDENTIFIER DPSVVTTE ECU_ADDRESS 0xd00079ec FORMAT "%7.2" /end MEASUREMENT
/begin MEASUREMENT Drf_spuel_f "Rf Anteil ueberspuel (gefiltert)" SWORD _CNV_R_R_Def_rf_sw__616_CM 1 100. -327.68 327.67 DISPLAY_IDENTIFIER DRF_SPUEL_F ECU_ADDRESS 0xd0007a48 FORMAT "%9.4" /end MEASUREMENT
/begin MEASUREMENT Drf_uk_f "Rf Anteil unkritisch (gefiltert)" SWORD _CNV_R_R_Def_rf_sw__616_CM 1 100. -327.68 327.67 DISPLAY_IDENTIFIER DRF_UK_F ECU_ADDRESS 0xd0007a4a FORMAT "%9.4" /end MEASUREMENT
/begin MEASUREMENT Drft "" SWORD _CNV_R_R_Def_rf_sw__616_CM 1 100. -327.68 327.67 DISPLAY_IDENTIFIER DRFT ECU_ADDRESS 0xd0007a1c FORMAT "%9.4" /end MEASUREMENT
/begin MEASUREMENT Drft_uk "" SWORD _CNV_R_R_Def_rf_sw__616_CM 1 100. -327.68 327.67 DISPLAY_IDENTIFIER DRFT_UK ECU_ADDRESS 0xd0007a24 FORMAT "%9.4" /end MEASUREMENT
/begin MEASUREMENT Dvse_spr "" SWORD _CNV_R_R_Def_spr_sw_583_CM 1 100. -3276.8 3276.7 DISPLAY_IDENTIFIER DVSE_SPR ECU_ADDRESS 0xd0007afe FORMAT "%7.2" /end MEASUREMENT
/begin MEASUREMENT Exwdifll "Excenterwinkelabweichung Exwink_ist - Exwink_soll" SWORD _CNV_R_R_Def_exwink_601_CM 1 100. -720. 180. DISPLAY_IDENTIFIER EXWDIFLL ECU_ADDRESS 0xd0007b0e FORMAT "%7.2" /end MEASUREMENT
/begin MEASUREMENT Exwdifll_alt "Excenterwinkelabweichung Exwink_ist - Exwink_soll" SWORD _CNV_R_R_Def_exwink_601_CM 1 100. -720. 180. DISPLAY_IDENTIFIER EXWDIFLL_ALT ECU_ADDRESS 0xd0007b10 FORMAT "%7.2" /end MEASUREMENT
/begin MEASUREMENT Exwink_nokor "Sollwert Exzenterwellenwinkel vor Hubkorrektur" UWORD _CNV_R_R_Def_exwink_601_CM 1 100. 0. 180. DISPLAY_IDENTIFIER EXWINK_NOKOR ECU_ADDRESS 0xd0007aee FORMAT "%7.2" /end MEASUREMENT
/begin MEASUREMENT Exwink_soll "Sollwert Exzenterwellenwinkel" UWORD _CNV_R_R_Def_exwink_601_CM 1 100. 0. 180. DISPLAY_IDENTIFIER EXWINK_SOLL ECU_ADDRESS 0xd0007ad6 FORMAT "%7.2" /end MEASUREMENT
/begin MEASUREMENT Exwinkmx "Excenterwinkelbegrenzung über Drehzahl" UWORD _CNV_R_R_Def_exwink_601_CM 1 100. 0. 180. DISPLAY_IDENTIFIER EXWINKMX ECU_ADDRESS 0xd0007b18 FORMAT "%7.2" /end MEASUREMENT
/begin MEASUREMENT Exwinkmx_vz "Excenterwinkelbegrenzung über Drehzahl (Schleppzeiger)" UWORD _CNV_R_R_Def_exwink_601_CM 1 100. 0. 180. DISPLAY_IDENTIFIER EXWINKMX_VZ ECU_ADDRESS 0xd0007b1a FORMAT "%7.2" /end MEASUREMENT
/begin MEASUREMENT Exwkor_ll "Excenterwinkel zur Hubkorrektur" SWORD _CNV_R_R_Def_exwink_601_CM 1 100. -720. 180. DISPLAY_IDENTIFIER EXWKOR_LL ECU_ADDRESS 0xd0007aea FORMAT "%7.2" /end MEASUREMENT
/begin MEASUREMENT F_dagr "Faktor Androsselung für AGR" SWORD _CNV_R_R_Def_f_uw_b_579_CM 1 100. -1. 0.9999 DISPLAY_IDENTIFIER F_DAGR ECU_ADDRESS 0xd0007b48 FORMAT "%14.5" /end MEASUREMENT
/begin MEASUREMENT F_dps2dpms_turb "Umrechnung Delta Moment auf Delta Druck" SWORD _CNV_R_R_Def_f_sw_b_608_CM 1 100. -2. 1.9999 DISPLAY_IDENTIFIER F_DPS2DPMS_TURB ECU_ADDRESS 0xd0007056 FORMAT "%14.5" /end MEASUREMENT
/begin MEASUREMENT F_dpsdkm "Faktor Ueberblendung DK-Modelle" UWORD _CNV_R_R_Def_f_uw_b_579_CM 1 100. 0. 1.9999 DISPLAY_IDENTIFIER F_DPSDKM ECU_ADDRESS 0xd0007aa4 FORMAT "%14.5" /end MEASUREMENT
/begin MEASUREMENT F_dpsrampe "Faktor Rampe für Kennfelddruck" UWORD _CNV_R_R_Def_f_uw_b_591_CM 1 100. 0. 0.9999 DISPLAY_IDENTIFIER F_DPSRAMPE ECU_ADDRESS 0xd0007a06 FORMAT "%14.5" /end MEASUREMENT
/begin MEASUREMENT F_exwkor_ll "Faktor aus Lernroutine für Hubkorrektur" UWORD _CNV_R_R_Def_f_uw_b_579_CM 1 100. 0. 1.9999 DISPLAY_IDENTIFIER F_EXWKOR_LL ECU_ADDRESS 0xd0007b12 FORMAT "%14.5" /end MEASUREMENT
/begin MEASUREMENT F_hubdpsfak "Kennlinie Überblendung Fhubvnsi abhängig von Dpsfak" UBYTE _CNV_R_R_Def_f_ub_b_573_CM 1 100. 0. 0.996 DISPLAY_IDENTIFIER F_HUBDPSFAK ECU_ADDRESS 0xd0007aed /end MEASUREMENT
/begin MEASUREMENT F_hubnst "Kennlinie Überblendung Fhubvnsi abhängig von Tn_start_10" UBYTE _CNV_R_R_Def_f_ub_b_573_CM 1 100. 0. 0.996 DISPLAY_IDENTIFIER F_HUBNST ECU_ADDRESS 0xd0007aec /end MEASUREMENT
/begin MEASUREMENT F_int_pssolber "" UWORD _CNV_R_R_Def_f_uw_b_604_CM 1 100. 0. 31.9995 DISPLAY_IDENTIFIER F_INT_PSSOLBER ECU_ADDRESS 0xd0007a2c FORMAT "%9.4" /end MEASUREMENT
/begin MEASUREMENT F_kfdisa "" UWORD _CNV_R_R_Def_f_uw_b_579_CM 1 100. 0. 1.9999 DISPLAY_IDENTIFIER F_KFDISA ECU_ADDRESS 0xd0007b6c FORMAT "%14.5" /end MEASUREMENT
/begin MEASUREMENT F_klaf "" UWORD _CNV_R_R_Def_f_uw_b_591_CM 1 100. 0. 0.9999 DISPLAY_IDENTIFIER F_KLAF ECU_ADDRESS 0xd0007b54 FORMAT "%14.5" /end MEASUREMENT
/begin MEASUREMENT F_mnhubte "Beladungsgrad AKF modelliert" SWORD _CNV_R_R_Def_f_uw_b_579_CM 1 100. -1. 0.9999 DISPLAY_IDENTIFIER F_MNHUBTE ECU_ADDRESS 0xd00079ee FORMAT "%14.5" /end MEASUREMENT
/begin MEASUREMENT F_mssdyn_kor "" UWORD _CNV_R_R_Def_f_uw_b_631_CM 1 100. 0. 7.9998 DISPLAY_IDENTIFIER F_MSSDYN_KOR ECU_ADDRESS 0xd0007aa6 FORMAT "%9.4" /end MEASUREMENT
/begin MEASUREMENT F_pldpu "Faktor Ladedruck zu Umgebungsdruck" UWORD _CNV_R_R_Def_f_sw_b_608_CM 1 100. 0. 3.9999 DISPLAY_IDENTIFIER F_PLDPU ECU_ADDRESS 0xd0006a2e FORMAT "%14.5" /end MEASUREMENT
/begin MEASUREMENT F_pldsvld_f "Faktor Ladedruck Sollwert zu Druck v. Verdichter - Höhe berücksichtigt -gefiltert" UWORD _CNV_R_R_Def_f_sw_b_608_CM 1 100. 0. 3.9999 DISPLAY_IDENTIFIER F_PLDSVLD_F ECU_ADDRESS 0xd0006a30 FORMAT "%14.5" /end MEASUREMENT
/begin MEASUREMENT F_pspld_soll "" UBYTE _CNV_R_R_Def_f_ub_b_573_CM 1 100. 0. 0.996 DISPLAY_IDENTIFIER F_PSPLD_SOLL ECU_ADDRESS 0xc0000f8a /end MEASUREMENT
/begin MEASUREMENT F_psspu "Faktor Saugrohr-Solldruck zu Umgebungsdruck" UWORD _CNV_R_R_Def_f_uw_b_579_CM 1 100. 0. 1.9999 DISPLAY_IDENTIFIER F_PSSPU ECU_ADDRESS 0xd00069f6 FORMAT "%14.5" /end MEASUREMENT
/begin MEASUREMENT F_pvdkpn "Faktor Pvdk -> 1013" UWORD _CNV_R_R_Def_f_sw_b_608_CM 1 100. 0. 3.9999 DISPLAY_IDENTIFIER F_PVDKPN ECU_ADDRESS 0xc0000f9e FORMAT "%14.5" /end MEASUREMENT
/begin MEASUREMENT F_pvdkpnvns "Korrekturfaktor vns" UWORD _CNV_R_R_Def_f_uw_b_579_CM 1 100. 0. 1.9999 DISPLAY_IDENTIFIER F_PVDKPNVNS ECU_ADDRESS 0xd00079fc FORMAT "%14.5" /end MEASUREMENT
/begin MEASUREMENT F_pwstgdse "Faktor Druckbeaufschlagung Wastegatedose in Abh. vom Drucksteuerventil" UWORD _CNV_R_R_Def_f_uw_b_591_CM 1 100. 0. 0.9999847412109381 DISPLAY_IDENTIFIER F_PWSTGDSE ECU_ADDRESS 0xd0007080 FORMAT "%14.5" /end MEASUREMENT
/begin MEASUREMENT F_rfsoll_vl "" UWORD _CNV_R_R_Def_f_uw_b_579_CM 1 100. 0. 1.9999 DISPLAY_IDENTIFIER F_RFSOLL_VL ECU_ADDRESS 0xd0007b6a FORMAT "%14.5" /end MEASUREMENT
/begin MEASUREMENT F_t_pvdkpn "Faktor F_tvdk * (Pvdkds/1013)" UWORD _CNV_R_R_Def_f_sw_b_608_CM 1 100. 0. 3.9999 DISPLAY_IDENTIFIER F_T_PVDKPN ECU_ADDRESS 0xc0000fa0 FORMAT "%14.5" /end MEASUREMENT
/begin MEASUREMENT F_tdisa "" UWORD _CNV_R_R_Def_f_uw_b_579_CM 1 100. 0. 1.9999 DISPLAY_IDENTIFIER F_TDISA ECU_ADDRESS 0xd0007b68 FORMAT "%14.5" /end MEASUREMENT
/begin MEASUREMENT F_teblgmod "Beladungsgrad AKF modelliert" SWORD _CNV_R_R_Def_f_sw_b_634_CM 1 100. -64. 63.998 DISPLAY_IDENTIFIER F_TEBLGMOD ECU_ADDRESS 0xd00079f0 FORMAT "%8.3" /end MEASUREMENT
/begin MEASUREMENT F_tnzyl "Faktor Abgastemperatur" UWORD _CNV_R_R_Def_f_uw_b_631_CM 1 100. 0. 7.9998 DISPLAY_IDENTIFIER F_TNZYL ECU_ADDRESS 0xd0007072 FORMAT "%9.4" /end MEASUREMENT
/begin MEASUREMENT F_transvl "" UWORD _CNV_R_R_Def_f_uw_b_591_CM 1 100. 0. 0.9999 DISPLAY_IDENTIFIER F_TRANSVL ECU_ADDRESS 0xd0007a90 FORMAT "%14.5" /end MEASUREMENT
/begin MEASUREMENT F_transvl_bas "" UWORD _CNV_R_R_Def_f_uw_b_591_CM 1 100. 0. 0.9999 DISPLAY_IDENTIFIER F_TRANSVL_BAS ECU_ADDRESS 0xd0007a92 FORMAT "%14.5" /end MEASUREMENT
/begin MEASUREMENT F_tvdk "Faktor Temperaturkorrektur vor Drosselklappe" UBYTE _CNV_R_R_Def_f_ub_b_625_CM 1 100. 0. 1.9921 DISPLAY_IDENTIFIER F_TVDK ECU_ADDRESS 0xc0000f96 /end MEASUREMENT
/begin MEASUREMENT F_tvdkho "Faktor zur Höhen- und Temperaturkorrektur" UWORD _CNV_R_R_Def_f_sw_b_608_CM 1 100. 0. 3.9999 DISPLAY_IDENTIFIER F_TVDKHO ECU_ADDRESS 0xd0007b5c FORMAT "%14.5" /end MEASUREMENT
/begin MEASUREMENT F_vakinv_tabg "Faktor Abgaskrümmervolumen" SWORD _CNV_R_R_Def_f_sw_b_608_CM 1 100. -2. 1.9999 DISPLAY_IDENTIFIER F_VAKINV_TABG ECU_ADDRESS 0xd0007058 FORMAT "%14.5" /end MEASUREMENT
/begin MEASUREMENT F_vnsdynkor "Korrekturfaktor VANOS Dynamik" UWORD _CNV_R_R_Def_f_uw_b_594_CM 1 100. 0. 15.9997 DISPLAY_IDENTIFIER F_VNSDYNKOR ECU_ADDRESS 0xd0007a04 FORMAT "%9.4" /end MEASUREMENT
/begin MEASUREMENT F_wftev "Wichtungsfaktor fuer Brennraum Temperaturmodell, TL-VL" UBYTE _CNV_R_R_Def_f_ub_b_573_CM 1 100. 0. 0.996 DISPLAY_IDENTIFIER F_WFTEV ECU_ADDRESS 0xc0000fae /end MEASUREMENT
/begin MEASUREMENT Fak_ttansel "Ansaugluftfaktor E-Lüfterstrom" UWORD _CNV_R_R_Def_f_uw_b_636_CM 1 100. 0. 511.9921 DISPLAY_IDENTIFIER FAK_TTANSEL ECU_ADDRESS 0xc0000eda FORMAT "%8.3" /end MEASUREMENT
/begin MEASUREMENT Fak_tubel "Faktor Lüfterstrom aus Geschwindigkeit" UWORD _CNV_R_R_Def_f_uw_b_636_CM 1 100. 0. 511.9921 DISPLAY_IDENTIFIER FAK_TUBEL ECU_ADDRESS 0xc0000edc FORMAT "%8.3" /end MEASUREMENT
/begin MEASUREMENT Fhubvnsf "Vanoskorrekturfaktor vor Filter" UWORD _CNV_R_R_Def_f_uw_b_579_CM 1 100. 0. 1.9999 DISPLAY_IDENTIFIER FHUBVNSF ECU_ADDRESS 0xd0007b08 FORMAT "%14.5" /end MEASUREMENT
/begin MEASUREMENT Fhubvnsi "Vanoskorrekturfaktor Istwert" UWORD _CNV_R_R_Def_f_uw_b_579_CM 1 100. 0. 1.9999 DISPLAY_IDENTIFIER FHUBVNSI ECU_ADDRESS 0xd0007ae8 FORMAT "%14.5" /end MEASUREMENT
/begin MEASUREMENT Fhubvnss "Vanoskorrekturfaktor Sollwert" UWORD _CNV_R_R_Def_f_uw_b_579_CM 1 100. 0. 1.9999 DISPLAY_IDENTIFIER FHUBVNSS ECU_ADDRESS 0xd0007b0a FORMAT "%14.5" /end MEASUREMENT
/begin MEASUREMENT Ftbr_kor "Faktor-Brennraumtemperatur, korrigiert" UWORD _CNV_R_R_Def_f_uw_b_579_CM 1 100. 0. 1.9999 DISPLAY_IDENTIFIER FTBR_KOR ECU_ADDRESS 0xc0000f9a FORMAT "%14.5" /end MEASUREMENT
/begin MEASUREMENT Ftev "Faktor Temperaturkorrektur im Brennraum" UWORD _CNV_R_R_Def_f_uw_b_579_CM 1 100. 0. 1.9999 DISPLAY_IDENTIFIER FTEV ECU_ADDRESS 0xc0000f9c FORMAT "%14.5" /end MEASUREMENT
/begin MEASUREMENT Ftev_kor "Faktor-Startkorrektur im Brennraum" UWORD _CNV_R_R_Def_f_uw_b_579_CM 1 100. 0. 1.9999 DISPLAY_IDENTIFIER FTEV_KOR ECU_ADDRESS 0xc0000faa FORMAT "%14.5" /end MEASUREMENT
/begin MEASUREMENT Ftev_tl "Faktor Temperaturkorrektur im Brennraum, TL" UWORD _CNV_R_R_Def_f_uw_b_579_CM 1 100. 0. 1.9999 DISPLAY_IDENTIFIER FTEV_TL ECU_ADDRESS 0xc0000fa6 FORMAT "%14.5" /end MEASUREMENT
/begin MEASUREMENT Ftev_uf "Faktor Temperaturkorrektur, ungefiltert" UWORD _CNV_R_R_Def_f_uw_b_579_CM 1 100. 0. 1.9999 DISPLAY_IDENTIFIER FTEV_UF ECU_ADDRESS 0xc0000fa4 FORMAT "%14.5" /end MEASUREMENT
/begin MEASUREMENT Ftev_ukorf "Faktor Temperaturkorrektur, unkorrigiert, gefiltert" UWORD _CNV_R_R_Def_f_uw_b_579_CM 1 100. 0. 1.9999 DISPLAY_IDENTIFIER FTEV_UKORF ECU_ADDRESS 0xc0000fa2 FORMAT "%14.5" /end MEASUREMENT
/begin MEASUREMENT Ftev_vl "Faktor Temperaturkorrektur im Brennraum, VL" UWORD _CNV_R_R_Def_f_uw_b_579_CM 1 100. 0. 1.9999 DISPLAY_IDENTIFIER FTEV_VL ECU_ADDRESS 0xc0000fa8 FORMAT "%14.5" /end MEASUREMENT
/begin MEASUREMENT Ftsr "Faktor Temperaturkorrektur im Saugrohr" UBYTE _CNV_R_R_Def_f_ub_b_625_CM 1 100. 0. 1.9921 DISPLAY_IDENTIFIER FTSR ECU_ADDRESS 0xc0000f94 /end MEASUREMENT
/begin MEASUREMENT Ftu "Faktor Temperatur Umgebung" UBYTE _CNV_R_R_Def_f_ub_b_625_CM 1 100. 0. 1.9921 DISPLAY_IDENTIFIER FTU ECU_ADDRESS 0xc0000f95 /end MEASUREMENT
/begin MEASUREMENT Fupsmssol "Faktor systembezogene Umrechung Druck auf Luftmasse (sol)" UWORD _CNV_R_R_Def_f_uw_b_591_CM 1 100. 0. 0.9999 DISPLAY_IDENTIFIER FUPSMSSOL ECU_ADDRESS 0xd0007a3a FORMAT "%14.5" /end MEASUREMENT
/begin MEASUREMENT Fupsrf_kor "Faktor systembezogene Umrechung Druck auf Füllung, GD/UG" UWORD _CNV_R_R_Def_f_uw_b_639_CM 1 100. 0. 0.2999 DISPLAY_IDENTIFIER FUPSRF_KOR ECU_ADDRESS 0xd00079f6 FORMAT "%14.6" /end MEASUREMENT
/begin MEASUREMENT Gang_mod "" UBYTE _CNV_R_R_Def_dez_sl_575_CM 1 100. 0. 255. DISPLAY_IDENTIFIER GANG_MOD ECU_ADDRESS 0xd00069aa FORMAT "%3.0" /end MEASUREMENT
/begin MEASUREMENT Gen_dfvorhs "DF-Signal Vorhersage" UBYTE _CNV_R_R_Def_f_ub_b_602_CM 1 100. 0. 99.60930000000001 DISPLAY_IDENTIFIER GEN_DFVORHS ECU_ADDRESS 0xc0000ef4 FORMAT "%5.2" /end MEASUREMENT
/begin MEASUREMENT Gen_dfvorhsnofil "DF-Signal Vorhersage ungefiltert" UBYTE _CNV_R_R_Def_f_ub_b_602_CM 1 100. 0. 99.60930000000001 DISPLAY_IDENTIFIER GEN_DFVORHSNOFIL ECU_ADDRESS 0xc0000ef5 FORMAT "%5.2" /end MEASUREMENT
/begin MEASUREMENT Gen_fbsak "BSD Uebertragungsfehler kodiert fuer FSPVDGEN" UBYTE _CNV_R_R_Def_dez_sl_575_CM 1 100. 0. 255. DISPLAY_IDENTIFIER GEN_FBSAK ECU_ADDRESS 0xc0001376 FORMAT "%3.0" /end MEASUREMENT
/begin MEASUREMENT Gen_statroh "Generatorfehler kodiert fuer FSPVDGEN" UBYTE _CNV_R_R_Def_dez_sl_575_CM 1 100. 0. 255. DISPLAY_IDENTIFIER GEN_STATROH ECU_ADDRESS 0xc0001377 FORMAT "%3.0" /end MEASUREMENT
/begin MEASUREMENT Hubev_ist "Istwert Einlassventilhub" UWORD _CNV_R_R_Def_hub_uw_605_CM 1 100. 0. 65.535 DISPLAY_IDENTIFIER HUBEV_IST ECU_ADDRESS 0xd0007adc FORMAT "%8.3" /end MEASUREMENT
/begin MEASUREMENT Hubev_soll "Sollwert Einlassventilhub gefiltert" UWORD _CNV_R_R_Def_hub_uw_605_CM 1 100. 0. 65.535 DISPLAY_IDENTIFIER HUBEV_SOLL ECU_ADDRESS 0xd0007ad8 FORMAT "%8.3" /end MEASUREMENT
/begin MEASUREMENT Hubev_soll_b "Sollwert Einlassventilhub bei Momentenstellung ueber Hub" UWORD _CNV_R_R_Def_hub_uw_605_CM 1 100. 0. 65.535 DISPLAY_IDENTIFIER HUBEV_SOLL_B ECU_ADDRESS 0xd0007ae6 FORMAT "%8.3" /end MEASUREMENT
/begin MEASUREMENT Hubev_soll_kf "Sollwert Einlassventilhub aus Hubkennfeldern" UWORD _CNV_R_R_Def_hub_uw_605_CM 1 100. 0. 65.535 DISPLAY_IDENTIFIER HUBEV_SOLL_KF ECU_ADDRESS 0xd0007ae0 FORMAT "%8.3" /end MEASUREMENT
/begin MEASUREMENT Hubev_soll_vh "Sollwert Einlassventilhub bei B_gdvhub" UWORD _CNV_R_R_Def_hub_uw_605_CM 1 100. 0. 65.535 DISPLAY_IDENTIFIER HUBEV_SOLL_VH ECU_ADDRESS 0xd0007af0 FORMAT "%8.3" /end MEASUREMENT
/begin MEASUREMENT Hubev_vh "Vollasthub" UWORD _CNV_R_R_Def_hub_uw_605_CM 1 100. 0. 65.535 DISPLAY_IDENTIFIER HUBEV_VH ECU_ADDRESS 0xd0007ae2 FORMAT "%8.3" /end MEASUREMENT
/begin MEASUREMENT Hubevkor_soll "Sollwert Einlassventilhub temperaturkorriegiert" UWORD _CNV_R_R_Def_hub_uw_605_CM 1 100. 0. 65.535 DISPLAY_IDENTIFIER HUBEVKOR_SOLL ECU_ADDRESS 0xd0007ada FORMAT "%8.3" /end MEASUREMENT
/begin MEASUREMENT I_craweng "Strombedarf Motor" SWORD _CNV_R_R_Def_i_sw_q_638_CM 1 100. -10. 254. DISPLAY_IDENTIFIER I_CRAWENG ECU_ADDRESS 0xc0000ed8 FORMAT "%8.3" /end MEASUREMENT
/begin MEASUREMENT I_elu_vvt "Strom E-Lüfter und VVT-System" UWORD _CNV_R_R_Def_i_uw_q_644_CM 1 100. 0. 4095.9375 DISPLAY_IDENTIFIER I_ELU_VVT ECU_ADDRESS 0xc0000ede FORMAT "%8.3" /end MEASUREMENT
/begin MEASUREMENT I_eluefter "E-Lüfter Stromaufnahme" UWORD _CNV_R_R_Def_i_uw_q_644_CM 1 100. 0. 4095.9375 DISPLAY_IDENTIFIER I_ELUEFTER ECU_ADDRESS 0xc0000ee0 FORMAT "%8.3" /end MEASUREMENT
/begin MEASUREMENT I_elupwm "Lüfterstrom ohne Temperatur- und Geschwindigkeitseinfluss" UWORD _CNV_R_R_Def_i_uw_q_644_CM 1 100. 0. 64. DISPLAY_IDENTIFIER I_ELUPWM ECU_ADDRESS 0xc0000ee2 FORMAT "%8.3" /end MEASUREMENT
/begin MEASUREMENT I_eluvfzg "Lüfterstrom ohne Geschwindigkeitseinfluss" UWORD _CNV_R_R_Def_i_uw_q_644_CM 1 100. 0. 128. DISPLAY_IDENTIFIER I_ELUVFZG ECU_ADDRESS 0xc0000ee4 FORMAT "%8.3" /end MEASUREMENT
/begin MEASUREMENT I_erripol1 "Ergebnis inverse Interpolation1" UBYTE _CNV_R_R_Def_i_ub_q_645_CM 1 100. 0. 31.875 DISPLAY_IDENTIFIER I_ERRIPOL1 ECU_ADDRESS 0xc0000ef6 /end MEASUREMENT
/begin MEASUREMENT I_erripol2 "Ergebnis inverse Interpolation2" UBYTE _CNV_R_R_Def_i_ub_q_645_CM 1 100. 0. 31.875 DISPLAY_IDENTIFIER I_ERRIPOL2 ECU_ADDRESS 0xc0000ef7 /end MEASUREMENT
/begin MEASUREMENT I_erripol3 "Ergebnis inverse Interpolation3" UBYTE _CNV_R_R_Def_i_ub_q_645_CM 1 100. 0. 31.875 DISPLAY_IDENTIFIER I_ERRIPOL3 ECU_ADDRESS 0xc0000ef8 /end MEASUREMENT
/begin MEASUREMENT I_gle "Glühstrom" UWORD _CNV_R_R_Def_i_uw_q_644_CM 1 100. 0. 4095.9375 DISPLAY_IDENTIFIER I_GLE ECU_ADDRESS 0xc0000ee6 FORMAT "%8.3" /end MEASUREMENT
/begin MEASUREMENT I_sls "berechnete Groesse Strombedarf Sekundärluftpumpe" UWORD _CNV_R_R_Def_i_uw_q_644_CM 1 100. 0. 255. DISPLAY_IDENTIFIER I_SLS ECU_ADDRESS 0xc0000ee8 FORMAT "%8.3" /end MEASUREMENT
/begin MEASUREMENT Ibs1_errstat "" UWORD _CNV_R_R_Def_dez_sl_575_CM 1 100. 0. 65535. DISPLAY_IDENTIFIER IBS1_ERRSTAT ECU_ADDRESS 0xc0001378 FORMAT "%5.0" /end MEASUREMENT
/begin MEASUREMENT Ibs2_errstat "" UWORD _CNV_R_R_Def_dez_sl_575_CM 1 100. 0. 65535. DISPLAY_IDENTIFIER IBS2_ERRSTAT ECU_ADDRESS 0xc000137a FORMAT "%5.0" /end MEASUREMENT
/begin MEASUREMENT Ibs3_errstat "" UWORD _CNV_R_R_Def_dez_sl_575_CM 1 100. 0. 65535. DISPLAY_IDENTIFIER IBS3_ERRSTAT ECU_ADDRESS 0xc000137c FORMAT "%5.0" /end MEASUREMENT
/begin MEASUREMENT Ibsderrs1 "Fehlerzähler IBS BSD Kommunikation" UBYTE _CNV_R_R_Def_dez_sl_575_CM 1 100. 0. 255. DISPLAY_IDENTIFIER IBSDERRS1 ECU_ADDRESS 0xc0004560 FORMAT "%3.0" /end MEASUREMENT
/begin MEASUREMENT Ibsderrs2 "Fehlerzähler IBS EBSD Kommunikation" UWORD _CNV_R_R_Def_dez_sl_575_CM 1 100. 0. 65535. DISPLAY_IDENTIFIER IBSDERRS2 ECU_ADDRESS 0xc000455e FORMAT "%5.0" /end MEASUREMENT
/begin MEASUREMENT Ibspreco2 "Vorteiler /10 fuer Ibsderrs2" UBYTE _CNV_R_R_Def_dez_sl_575_CM 1 100. 0. 255. DISPLAY_IDENTIFIER IBSPRECO2 ECU_ADDRESS 0xc0004561 FORMAT "%3.0" /end MEASUREMENT
/begin MEASUREMENT Ierr_vorhs "Vorhergesagter Erregerstrom bei LL Anhebung" UBYTE _CNV_R_R_Def_i_ub_q_645_CM 1 100. 0. 31.875 DISPLAY_IDENTIFIER IERR_VORHS ECU_ADDRESS 0xc0000ef9 /end MEASUREMENT
/begin MEASUREMENT Kf_mszsvns_aus "Wichtung" UBYTE _CNV_R_R_Def_f_ub_b_573_CM 1 100. 0. 0.996 DISPLAY_IDENTIFIER KF_MSZSVNS_AUS ECU_ADDRESS 0xd00079fa /end MEASUREMENT
/begin MEASUREMENT Kf_mszsvnst_aus "Wichtung" UBYTE _CNV_R_R_Def_f_ub_b_573_CM 1 100. 0. 0.996 DISPLAY_IDENTIFIER KF_MSZSVNST_AUS ECU_ADDRESS 0xd00079fb /end MEASUREMENT
/begin MEASUREMENT Kf_tdvnsfil_aus "Zeitkonstante Filterung Rfv_vns_hub" UWORD _CNV_R_R_Def_f_uw_b_576_CM 1 100. 0. 99.9984 DISPLAY_IDENTIFIER KF_TDVNSFIL_AUS ECU_ADDRESS 0xd0007a44 FORMAT "%8.3" /end MEASUREMENT
/begin MEASUREMENT Kfdps_aus "Soll-Differenzdruck Vvt" SWORD _CNV_R_R_Def_p_sw_q_578_CM 1 100. -1280. 1279.9609 DISPLAY_IDENTIFIER KFDPS_AUS ECU_ADDRESS 0xd00079e8 FORMAT "%7.2" /end MEASUREMENT
/begin MEASUREMENT Kffl_ausi "" UWORD _CNV_R_R_Def_flae_u_654_CM 1 100. 0. 1048.56 DISPLAY_IDENTIFIER KFFL_AUSI ECU_ADDRESS 0xd0007b02 FORMAT "%7.2" /end MEASUREMENT
/begin MEASUREMENT Kffl_ausn "" UWORD _CNV_R_R_Def_flae_u_654_CM 1 100. 0. 1048.56 DISPLAY_IDENTIFIER KFFL_AUSN ECU_ADDRESS 0xd0007b00 FORMAT "%7.2" /end MEASUREMENT
/begin MEASUREMENT Kl_gdvnsfil_aus "Zeitkonstante Filterung Rfv_vns_dk" UWORD _CNV_R_R_Def_f_uw_b_576_CM 1 100. 0. 99.9984 DISPLAY_IDENTIFIER KL_GDVNSFIL_AUS ECU_ADDRESS 0xd0007a46 FORMAT "%8.3" /end MEASUREMENT
/begin MEASUREMENT Klafaus "Ausgang Ausflusskennlinie" UWORD _CNV_R_R_Def_f_uw_b_591_CM 1 100. 0. 0.9999 DISPLAY_IDENTIFIER KLAFAUS ECU_ADDRESS 0xd0007aa2 FORMAT "%14.5" /end MEASUREMENT
/begin MEASUREMENT La_ber "" UWORD _CNV_R_R_Def_f_uw_b_594_CM 1 100. 0. 15.9997 DISPLAY_IDENTIFIER LA_BER ECU_ADDRESS 0xd0007b46 FORMAT "%9.4" /end MEASUREMENT
/begin MEASUREMENT Mk_ausy "Kraftstoffmassenstrom" UWORD _CNV_R_R_Def_ms_uw__611_CM 1 100. 0. 2047.9687 DISPLAY_IDENTIFIER MK_AUSY ECU_ADDRESS 0xd0007064 FORMAT "%8.3" /end MEASUREMENT
/begin MEASUREMENT Ms_agrfg_soll "Frischgasmassenstrom über AGR" UWORD _CNV_R_R_Def_ms_uw__611_CM 1 100. 0. 2047.9687 DISPLAY_IDENTIFIER MS_AGRFG_SOLL ECU_ADDRESS 0xd0007b3e FORMAT "%8.3" /end MEASUREMENT
/begin MEASUREMENT Msagr_sol "Soll-Luftmassenstrom" UWORD _CNV_R_R_Def_ms_uw__611_CM 1 100. 0. 2047.9687 DISPLAY_IDENTIFIER MSAGR_SOL ECU_ADDRESS 0xd0007b4c FORMAT "%8.3" /end MEASUREMENT
/begin MEASUREMENT Msak_diff "Delta Massenstrom Abgaskrümmer" SWORD _CNV_R_R_Def_ms_uw__611_CM 1 100. -1024. 1023.9687 DISPLAY_IDENTIFIER MSAK_DIFF ECU_ADDRESS 0xd000705a FORMAT "%8.3" /end MEASUREMENT
/begin MEASUREMENT Msbkv "Massenstrom Bremskraftverstärker" UWORD _CNV_R_R_Def_ml_uw__662_CM 1 100. 0. 6553.5 DISPLAY_IDENTIFIER MSBKV ECU_ADDRESS 0xc0000f5a FORMAT "%6.1" /end MEASUREMENT
/begin MEASUREMENT Msbkv_f "Massenstrom Bremskraftverstärker gefiltert" UWORD _CNV_R_R_Def_ml_uw__662_CM 1 100. 0. 6553.5 DISPLAY_IDENTIFIER MSBKV_F ECU_ADDRESS 0xc0000f66 FORMAT "%6.1" /end MEASUREMENT
/begin MEASUREMENT Msn_pspvdk_smx "" UWORD _CNV_R_R_Def_ms_uw__611_CM 1 100. 0. 2047.9687 DISPLAY_IDENTIFIER MSN_PSPVDK_SMX ECU_ADDRESS 0xd0007a9e FORMAT "%8.3" /end MEASUREMENT
/begin MEASUREMENT Msnagr_rosol "Soll-Luftmassenstrom" UWORD _CNV_R_R_Def_ms_uw__611_CM 1 100. 0. 2047.9687 DISPLAY_IDENTIFIER MSNAGR_ROSOL ECU_ADDRESS 0xd0007b52 FORMAT "%8.3" /end MEASUREMENT
/begin MEASUREMENT Msnagr_sol "Soll-Luftmassenstrom" UWORD _CNV_R_R_Def_ms_uw__611_CM 1 100. 0. 2047.9687 DISPLAY_IDENTIFIER MSNAGR_SOL ECU_ADDRESS 0xd0007b50 FORMAT "%8.3" /end MEASUREMENT
/begin MEASUREMENT Msnsol "höhenkorrigierter Soll-Luftmassenstrom" UWORD _CNV_R_R_Def_ms_uw__611_CM 1 100. 0. 2047.9687 DISPLAY_IDENTIFIER MSNSOL ECU_ADDRESS 0xd0007a42 FORMAT "%8.3" /end MEASUREMENT
/begin MEASUREMENT Msnsolps "höhenkorrigierter Soll-Luftmassenstrom mit Massenstromabgleich" UWORD _CNV_R_R_Def_ms_uw__611_CM 1 100. 0. 2047.9687 DISPLAY_IDENTIFIER MSNSOLPS ECU_ADDRESS 0xd00079d0 FORMAT "%8.3" /end MEASUREMENT
/begin MEASUREMENT Msnwdk_soll "normierter Luftmassenstrom fuer Sollwinkelbestimmung DK" UWORD _CNV_R_R_Def_ms_uw__664_CM 1 100. 0. 8191.875 DISPLAY_IDENTIFIER MSNWDK_SOLL ECU_ADDRESS 0xd0007ab0 FORMAT "%7.2" /end MEASUREMENT
/begin MEASUREMENT Msnzylsol_k "Massenstrom Zylinder Sollwert" UWORD _CNV_R_R_Def_ms_uw__611_CM 1 100. 0. 2047.9687 DISPLAY_IDENTIFIER MSNZYLSOL_K ECU_ADDRESS 0xd00079ce FORMAT "%8.3" /end MEASUREMENT
/begin MEASUREMENT Mssol "Soll-Luftmassenstrom" UWORD _CNV_R_R_Def_ms_uw__611_CM 1 100. 0. 2047.9687 DISPLAY_IDENTIFIER MSSOL ECU_ADDRESS 0xd00079d4 FORMAT "%8.3" /end MEASUREMENT
/begin MEASUREMENT Mssol_mr "Soll-Luftmassenstrom mit Massenstromabgleich" UWORD _CNV_R_R_Def_ms_uw__611_CM 1 100. 0. 2047.9687 DISPLAY_IDENTIFIER MSSOL_MR ECU_ADDRESS 0xd0007a3c FORMAT "%8.3" /end MEASUREMENT
/begin MEASUREMENT Mssoldk "Solluftmassenstrom inkl. Adaption und Tankentlueftung" UWORD _CNV_R_R_Def_ms_uw__611_CM 1 100. 0. 2047.9687 DISPLAY_IDENTIFIER MSSOLDK ECU_ADDRESS 0xd0007aac FORMAT "%8.3" /end MEASUREMENT
/begin MEASUREMENT Mssoldk_dyn "" SWORD _CNV_R_R_Def_ms_uw__611_CM 1 100. -1024. 1023.9687 DISPLAY_IDENTIFIER MSSOLDK_DYN ECU_ADDRESS 0xd0007aa8 FORMAT "%8.3" /end MEASUREMENT
/begin MEASUREMENT Mssoldk_kor "Solluftmassenstrom inkl. Adaption und Tankentlueftung, korr." UWORD _CNV_R_R_Def_ms_uw__611_CM 1 100. 0. 2047.9687 DISPLAY_IDENTIFIER MSSOLDK_KOR ECU_ADDRESS 0xd0007aae FORMAT "%8.3" /end MEASUREMENT
/begin MEASUREMENT Mssoldkdyn_roh "" SWORD _CNV_R_R_Def_ms_uw__611_CM 1 100. -1024. 1023.9687 DISPLAY_IDENTIFIER MSSOLDKDYN_ROH ECU_ADDRESS 0xd0007aaa FORMAT "%8.3" /end MEASUREMENT
/begin MEASUREMENT Msturb "Turbinenmassenstrom" UWORD _CNV_R_R_Def_ms_uw__611_CM 1 100. 0. 2047.9687 DISPLAY_IDENTIFIER MSTURB ECU_ADDRESS 0xd0007074 FORMAT "%8.3" /end MEASUREMENT
/begin MEASUREMENT Msturb_diff "Delta Turbinenmassenstrom" SWORD _CNV_R_R_Def_f_sw_b_597_CM 1 100. -100. 99.9969 DISPLAY_IDENTIFIER MSTURB_DIFF ECU_ADDRESS 0xd000706c FORMAT "%8.3" /end MEASUREMENT
/begin MEASUREMENT Msturb_diff_tseg "Turbinenmassenstromänderung pro Segment" SWORD _CNV_R_R_Def_f_sw_b_608_CM 1 100. -2. 1.9999 DISPLAY_IDENTIFIER MSTURB_DIFF_TSEG ECU_ADDRESS 0xd000705c FORMAT "%14.5" /end MEASUREMENT
/begin MEASUREMENT Msturbdiff_tgkor "Delta Turbinenmassenstrom temperaturkorrigiert" SWORD _CNV_R_R_Def_f_sw_b_597_CM 1 100. -100. 99.9969 DISPLAY_IDENTIFIER MSTURBDIFF_TGKOR ECU_ADDRESS 0xd000707c FORMAT "%8.3" /end MEASUREMENT
/begin MEASUREMENT Msturbdiff_ukor "Delta Turbinenmassenstrom unkorrigiert" SWORD _CNV_R_R_Def_f_sw_p_581_CM 1 100. -8192. 8191.75 DISPLAY_IDENTIFIER MSTURBDIFF_UKOR ECU_ADDRESS 0xd000707e FORMAT "%7.2" /end MEASUREMENT
/begin MEASUREMENT Msturbine "" UWORD _CNV_R_R_Def_ms_uw__611_CM 1 100. 0. 2047.9687 DISPLAY_IDENTIFIER MSTURBINE ECU_ADDRESS 0xd0007076 FORMAT "%8.3" /end MEASUREMENT
/begin MEASUREMENT Msvld "Massenstrom v. Verdichter" UWORD _CNV_R_R_Def_ms_uw__611_CM 1 100. 0. 2047.9687 DISPLAY_IDENTIFIER MSVLD ECU_ADDRESS 0xd0006a32 FORMAT "%8.3" /end MEASUREMENT
/begin MEASUREMENT Msvld_dyn "Massenstrom v. Verdichter - dynamisch" SWORD _CNV_R_R_Def_ms_uw__611_CM 1 100. -1024. 1023.9687 DISPLAY_IDENTIFIER MSVLD_DYN ECU_ADDRESS 0xd0006a1e FORMAT "%8.3" /end MEASUREMENT
/begin MEASUREMENT Mswg "" UWORD _CNV_R_R_Def_ms_uw__611_CM 1 100. 0. 2047.9687 DISPLAY_IDENTIFIER MSWG ECU_ADDRESS 0xd0007078 FORMAT "%8.3" /end MEASUREMENT
/begin MEASUREMENT N_genll "Drehzahl Generator bei LL Anhebung" SWORD _CNV_R_R_Def_n_sw_q_612_CM 1 100. -32768. 32767. DISPLAY_IDENTIFIER N_GENLL ECU_ADDRESS 0xc0000ef2 FORMAT "%5.0" /end MEASUREMENT
/begin MEASUREMENT N_hys_down "" SWORD _CNV_R_R_Def_n_sw_q_612_CM 1 100. -32768. 32767. DISPLAY_IDENTIFIER N_HYS_DOWN ECU_ADDRESS 0xd0007b74 FORMAT "%5.0" /end MEASUREMENT
/begin MEASUREMENT N_hys_up "" SWORD _CNV_R_R_Def_n_sw_q_612_CM 1 100. -32768. 32767. DISPLAY_IDENTIFIER N_HYS_UP ECU_ADDRESS 0xd0007b76 FORMAT "%5.0" /end MEASUREMENT
/begin MEASUREMENT N_idlgspec "Anforderung LL-Anhebung" UBYTE _CNV_R_R_Def_dez_sl_575_CM 1 100. 0. 255. DISPLAY_IDENTIFIER N_IDLGSPEC ECU_ADDRESS 0xc0000ef0 FORMAT "%3.0" /end MEASUREMENT
/begin MEASUREMENT N_switch_down "" SWORD _CNV_R_R_Def_n_sw_q_612_CM 1 100. -32768. 32767. DISPLAY_IDENTIFIER N_SWITCH_DOWN ECU_ADDRESS 0xd0007b72 FORMAT "%5.0" /end MEASUREMENT
/begin MEASUREMENT N_switch_up "" SWORD _CNV_R_R_Def_n_sw_q_612_CM 1 100. -32768. 32767. DISPLAY_IDENTIFIER N_SWITCH_UP ECU_ADDRESS 0xd0007b70 FORMAT "%5.0" /end MEASUREMENT
/begin MEASUREMENT Nkw_dyn "Dynamikerkennung für Motordrehzahl" SWORD _CNV_R_R_Def_n_sw_q_612_CM 1 100. -32768. 32767. DISPLAY_IDENTIFIER NKW_DYN ECU_ADDRESS 0xd00069f8 FORMAT "%5.0" /end MEASUREMENT
/begin MEASUREMENT Nkw_zu_v "" UWORD _CNV_R_R_Def_qnv_uw_669_CM 1 100. 0. 511.9921 DISPLAY_IDENTIFIER NKW_ZU_V ECU_ADDRESS 0xd00069ac FORMAT "%8.3" /end MEASUREMENT
/begin MEASUREMENT Nsllbkv "Leerlaufsolldrehzahl für Bremskraftverstärker" SWORD _CNV_R_R_Def_n_sw_q_612_CM 1 100. -32768. 32767. DISPLAY_IDENTIFIER NSLLBKV ECU_ADDRESS 0xc0000f58 FORMAT "%5.0" /end MEASUREMENT
/begin MEASUREMENT Oz_diagtoens "Töns Diagnose Byte" UWORD _CNV_R_R_Def_dez_sl_575_CM 1 100. 0. 65535. DISPLAY_IDENTIFIER OZ_DIAGTOENS ECU_ADDRESS 0xc0004fe8 FORMAT "%5.0" /end MEASUREMENT
/begin MEASUREMENT Oz_permerrz "" UBYTE _CNV_R_R_Def_dez_sl_575_CM 1 100. 0. 255. DISPLAY_IDENTIFIER OZ_PERMERRZ ECU_ADDRESS 0xc0004050 FORMAT "%3.0" /end MEASUREMENT
/begin MEASUREMENT Oz_tempplz "Anzahl der unplausibel Sprünge QLT Temperatur" UBYTE _CNV_R_R_Def_dez_sl_575_CM 1 100. 0. 255. DISPLAY_IDENTIFIER OZ_TEMPPLZ ECU_ADDRESS 0xc0004fea FORMAT "%3.0" /end MEASUREMENT
/begin MEASUREMENT Oz_temprold "Alte QLT Temperatur für die Plausibilisierung" UBYTE _CNV_R_R_Def_dez_sl_575_CM 1 100. 0. 255. DISPLAY_IDENTIFIER OZ_TEMPROLD ECU_ADDRESS 0xc0004feb FORMAT "%3.0" /end MEASUREMENT
/begin MEASUREMENT Pak "Abgaskrümmerdruck" UWORD _CNV_R_R_Def_p_sw_q_578_CM 1 100. 0. 2559.9609 DISPLAY_IDENTIFIER PAK ECU_ADDRESS 0xd000704c FORMAT "%8.3" /end MEASUREMENT
/begin MEASUREMENT Pak_diff "Delta Abgaskrümmerdruck" SWORD _CNV_R_R_Def_p_sw_q_578_CM 1 100. -1280. 1279.9609 DISPLAY_IDENTIFIER PAK_DIFF ECU_ADDRESS 0xd000705e FORMAT "%7.2" /end MEASUREMENT
/begin MEASUREMENT Pak_diff_2 "Delta Abgaskrümmerdruck (bei alternativer Stabilisierung)" SWORD _CNV_R_R_Def_p_sw_q_578_CM 1 100. -1280. 1279.9609 DISPLAY_IDENTIFIER PAK_DIFF_2 ECU_ADDRESS 0xd0007060 FORMAT "%7.2" /end MEASUREMENT
/begin MEASUREMENT Pak_diff_tseg "Delta Abgaskrümmerdruck pro Segment" SWORD _CNV_R_R_Def_p_sw_q_578_CM 1 100. -1280. 1279.9609 DISPLAY_IDENTIFIER PAK_DIFF_TSEG ECU_ADDRESS 0xd0007062 FORMAT "%7.2" /end MEASUREMENT
/begin MEASUREMENT Pakpn "Normierter Abgaskrümmerdruck" UWORD _CNV_R_R_Def_f_sw_b_608_CM 1 100. 0. 3.9999 DISPLAY_IDENTIFIER PAKPN ECU_ADDRESS 0xd000704e FORMAT "%14.5" /end MEASUREMENT
/begin MEASUREMENT Pakps "Verhältnis Abgaskrümmer- zu Saugrohrdruck" UWORD _CNV_R_R_Def_f_uw_b_579_CM 1 100. 0. 1.9999 DISPLAY_IDENTIFIER PAKPS ECU_ADDRESS 0xd0007050 FORMAT "%14.5" /end MEASUREMENT
/begin MEASUREMENT Pakps_soll "" UWORD _CNV_R_R_Def_f_uw_b_579_CM 1 100. 0. 1.9999 DISPLAY_IDENTIFIER PAKPS_SOLL ECU_ADDRESS 0xd0007a2e FORMAT "%14.5" /end MEASUREMENT
/begin MEASUREMENT Pirg_kor "Partialdruck Restgas internes AGR, GD/UG" UWORD _CNV_R_R_Def_p_sw_q_578_CM 1 100. 0. 2559.9609 DISPLAY_IDENTIFIER PIRG_KOR ECU_ADDRESS 0xd00079f4 FORMAT "%7.2" /end MEASUREMENT
/begin MEASUREMENT Pkat "Druck vor Kat" UWORD _CNV_R_R_Def_p_sw_q_578_CM 1 100. 0. 2559.9609 DISPLAY_IDENTIFIER PKAT ECU_ADDRESS 0xd0007068 FORMAT "%7.2" /end MEASUREMENT
/begin MEASUREMENT Pkat_rel "Relativer Druck vor Kat" UWORD _CNV_R_R_Def_p_sw_q_578_CM 1 100. 0. 2559.9609 DISPLAY_IDENTIFIER PKAT_REL ECU_ADDRESS 0xd000706a FORMAT "%7.2" /end MEASUREMENT
/begin MEASUREMENT Pld_dgrd "Gradient der Regeldifferenz" SWORD _CNV_R_R_Def_p_sw_q_614_CM 1 100. -2560. 2559.9218 DISPLAY_IDENTIFIER PLD_DGRD ECU_ADDRESS 0xd0006a5c FORMAT "%7.2" /end MEASUREMENT
/begin MEASUREMENT Pld_diff "Regeldifferenz" SWORD _CNV_R_R_Def_p_sw_q_614_CM 1 100. -2560. 2559.9218 DISPLAY_IDENTIFIER PLD_DIFF ECU_ADDRESS 0xd0006a20 FORMAT "%7.2" /end MEASUREMENT
/begin MEASUREMENT Pld_diff_fil "Regeldifferenz mit gef. Ladedruck" SWORD _CNV_R_R_Def_p_sw_q_614_CM 1 100. -2560. 2559.9218 DISPLAY_IDENTIFIER PLD_DIFF_FIL ECU_ADDRESS 0xd0006a22 FORMAT "%7.2" /end MEASUREMENT
/begin MEASUREMENT Pld_diff_grd "Gradient der Regeldifferenz normiert" SWORD _CNV_R_R_Def_p_sw_q_614_CM 1 100. -2560. 2559.9218 DISPLAY_IDENTIFIER PLD_DIFF_GRD ECU_ADDRESS 0xd0006a24 FORMAT "%7.2" /end MEASUREMENT
/begin MEASUREMENT Pld_soll "Soll -Ladedruck" UWORD _CNV_R_R_Def_p_sw_q_578_CM 1 100. 0. 2559.9609 DISPLAY_IDENTIFIER PLD_SOLL ECU_ADDRESS 0xc0000f84 FORMAT "%7.2" /end MEASUREMENT
/begin MEASUREMENT Pldr_soll "Ladedruck - Sollwert für Regler" UWORD _CNV_R_R_Def_p_sw_q_578_CM 1 100. 0. 2559.9609 DISPLAY_IDENTIFIER PLDR_SOLL ECU_ADDRESS 0xd0006a34 FORMAT "%7.2" /end MEASUREMENT
/begin MEASUREMENT Pldrsoll_dyn "Ladedruck - dyn. Sollwert für Regler" SWORD _CNV_R_R_Def_p_sw_q_578_CM 1 100. -1280. 1279.9609 DISPLAY_IDENTIFIER PLDRSOLL_DYN ECU_ADDRESS 0xd0006a26 FORMAT "%7.2" /end MEASUREMENT
/begin MEASUREMENT Pldsoll_mx "Max. Sollwert für Ladedruck" UWORD _CNV_R_R_Def_p_sw_q_578_CM 1 100. 0. 2559.9609 DISPLAY_IDENTIFIER PLDSOLL_MX ECU_ADDRESS 0xd0006a5e FORMAT "%7.2" /end MEASUREMENT
/begin MEASUREMENT Ppump_mx "Pumpgrenze für ATL" UWORD _CNV_R_R_Def_p_sw_q_578_CM 1 100. 0. 2559.9609 DISPLAY_IDENTIFIER PPUMP_MX ECU_ADDRESS 0xd0006a60 FORMAT "%7.2" /end MEASUREMENT
/begin MEASUREMENT Prat_turb "Delta Turbinenmassenstrom unkorrigiert" UWORD _CNV_R_R_Def_f_sw_b_608_CM 1 100. 0. 3.9999 DISPLAY_IDENTIFIER PRAT_TURB ECU_ADDRESS 0xd000707a FORMAT "%14.5" /end MEASUREMENT
/begin MEASUREMENT Ps_soll_gd "Soll-Saugrohrdruck, Gedrosselt" UWORD _CNV_R_R_Def_p_sw_q_578_CM 1 100. 0. 2559.9609 DISPLAY_IDENTIFIER PS_SOLL_GD ECU_ADDRESS 0xd00079fe FORMAT "%7.2" /end MEASUREMENT
/begin MEASUREMENT Ps_sollgd_lin "Soll-Saugrohrdruck, Linear" UWORD _CNV_R_R_Def_p_sw_q_578_CM 1 100. 0. 2559.9609 DISPLAY_IDENTIFIER PS_SOLLGD_LIN ECU_ADDRESS 0xd0007a00 FORMAT "%7.2" /end MEASUREMENT
/begin MEASUREMENT Ps_sollgd_nl "Soll-Saugrohrdruck, Non-Linear" UWORD _CNV_R_R_Def_p_sw_q_578_CM 1 100. 0. 2559.9609 DISPLAY_IDENTIFIER PS_SOLLGD_NL ECU_ADDRESS 0xd0007a02 FORMAT "%7.2" /end MEASUREMENT
/begin MEASUREMENT Ps_sollgd_nl2 "" UWORD _CNV_R_R_Def_p_sw_q_578_CM 1 100. 0. 2559.9609 DISPLAY_IDENTIFIER PS_SOLLGD_NL2 ECU_ADDRESS 0xd0007a28 FORMAT "%7.2" /end MEASUREMENT
/begin MEASUREMENT Psoll_nlbas "" UWORD _CNV_R_R_Def_p_sw_q_578_CM 1 100. 0. 2559.9609 DISPLAY_IDENTIFIER PSOLL_NLBAS ECU_ADDRESS 0xd0007a2a FORMAT "%7.2" /end MEASUREMENT
/begin MEASUREMENT Pspak "Verhältnis Saugrohrdruck- zu Abgaskrümmerdruck" UWORD _CNV_R_R_Def_f_uw_b_579_CM 1 100. 0. 1.9999 DISPLAY_IDENTIFIER PSPAK ECU_ADDRESS 0xd0007052 FORMAT "%14.5" /end MEASUREMENT
/begin MEASUREMENT Pspld_soll "Soll Druckverhältnis an DK" UWORD _CNV_R_R_Def_f_uw_b_579_CM 1 100. 0. 1.9999 DISPLAY_IDENTIFIER PSPLD_SOLL ECU_ADDRESS 0xc0000f86 FORMAT "%14.5" /end MEASUREMENT
/begin MEASUREMENT Pspn "Normierter Saugrohrdruck" UWORD _CNV_R_R_Def_f_sw_b_608_CM 1 100. 0. 3.9999 DISPLAY_IDENTIFIER PSPN ECU_ADDRESS 0xd0007054 FORMAT "%14.5" /end MEASUREMENT
/begin MEASUREMENT Pspvagr_soll "" UWORD _CNV_R_R_Def_f_uw_b_591_CM 1 100. 0. 0.9999 DISPLAY_IDENTIFIER PSPVAGR_SOLL ECU_ADDRESS 0xd0007b4e FORMAT "%14.5" /end MEASUREMENT
/begin MEASUREMENT Pspvdk_soll "Faktor Umgebung zu Saugrohrdruck" UWORD _CNV_R_R_Def_f_sw_b_608_CM 1 100. 0. 3.9999 DISPLAY_IDENTIFIER PSPVDK_SOLL ECU_ADDRESS 0xd00079c8 FORMAT "%14.5" /end MEASUREMENT
/begin MEASUREMENT Pspvdk_soll_ur "Faktor Umgebung zu Saugrohrdruck, Unbegrenzt" UWORD _CNV_R_R_Def_f_sw_b_608_CM 1 100. 0. 3.9999 DISPLAY_IDENTIFIER PSPVDK_SOLL_UR ECU_ADDRESS 0xd00079ca FORMAT "%14.5" /end MEASUREMENT
/begin MEASUREMENT Pssol "Soll-Saugrohrdruck" UWORD _CNV_R_R_Def_p_sw_q_578_CM 1 100. 0. 2559.9609 DISPLAY_IDENTIFIER PSSOL ECU_ADDRESS 0xd00079d6 FORMAT "%7.2" /end MEASUREMENT
/begin MEASUREMENT Pssol_pspvdk_smx "" UWORD _CNV_R_R_Def_p_sw_q_578_CM 1 100. 0. 2559.9609 DISPLAY_IDENTIFIER PSSOL_PSPVDK_SMX ECU_ADDRESS 0xd0007a9a FORMAT "%7.2" /end MEASUREMENT
/begin MEASUREMENT Pssol_ugd "Soll-Saugrohrdruck ungedrosselt" UWORD _CNV_R_R_Def_p_sw_q_578_CM 1 100. 0. 2559.9609 DISPLAY_IDENTIFIER PSSOL_UGD ECU_ADDRESS 0xd00079dc FORMAT "%7.2" /end MEASUREMENT
/begin MEASUREMENT Pssolhub "Soll-Saugrohrdruck" UWORD _CNV_R_R_Def_p_sw_q_578_CM 1 100. 0. 2559.9609 DISPLAY_IDENTIFIER PSSOLHUB ECU_ADDRESS 0xd00079d8 FORMAT "%7.2" /end MEASUREMENT
/begin MEASUREMENT Pssoll_g "" UWORD _CNV_R_R_Def_p_sw_q_578_CM 1 100. 0. 2559.9609 DISPLAY_IDENTIFIER PSSOLL_G ECU_ADDRESS 0xd0007a18 FORMAT "%7.2" /end MEASUREMENT
/begin MEASUREMENT Pssoll_offs "" SWORD _CNV_R_R_Def_p_sw_q_578_CM 1 100. -1280. 1279.9609 DISPLAY_IDENTIFIER PSSOLL_OFFS ECU_ADDRESS 0xd0007a1a FORMAT "%7.2" /end MEASUREMENT
/begin MEASUREMENT Pssolpu "Soll-Druckverhältnis im SR" UWORD _CNV_R_R_Def_f_sw_b_608_CM 1 100. 0. 3.9999 DISPLAY_IDENTIFIER PSSOLPU ECU_ADDRESS 0xc0000f88 FORMAT "%14.5" /end MEASUREMENT
/begin MEASUREMENT Pssoltd "Soll-Saugrohrdruck Teildrosselung" UWORD _CNV_R_R_Def_p_sw_q_578_CM 1 100. 0. 2559.9609 DISPLAY_IDENTIFIER PSSOLTD ECU_ADDRESS 0xd00079da FORMAT "%7.2" /end MEASUREMENT
/begin MEASUREMENT Pturb "Korrigierter Turbinendurchfluss" UWORD _CNV_R_R_Def_p_sw_q_578_CM 1 100. 0. 2559.9609 DISPLAY_IDENTIFIER PTURB ECU_ADDRESS 0xd0007082 FORMAT "%8.3" /end MEASUREMENT
/begin MEASUREMENT Pvdkds_dyn "Ladedruck dyn. Istwert" SWORD _CNV_R_R_Def_p_sw_q_578_CM 1 100. -1280. 1279.9609 DISPLAY_IDENTIFIER PVDKDS_DYN ECU_ADDRESS 0xd0006a28 FORMAT "%7.2" /end MEASUREMENT
/begin MEASUREMENT Pvdkdsf "Druck vor Drosselklappe gefiltert" UWORD _CNV_R_R_Def_p_sw_q_578_CM 1 100. 0. 2559.9609 DISPLAY_IDENTIFIER PVDKDSF ECU_ADDRESS 0xd00079f2 FORMAT "%7.2" /end MEASUREMENT
/begin MEASUREMENT Pvld "Druck vor Verdichter" UWORD _CNV_R_R_Def_p_sw_q_578_CM 1 100. 3.91e-002 2559.9609 DISPLAY_IDENTIFIER PVLD ECU_ADDRESS 0xd0006a36 FORMAT "%7.2" /end MEASUREMENT
/begin MEASUREMENT Pwg "" UWORD _CNV_R_R_Def_p_sw_q_578_CM 1 100. 0. 2559.9609 DISPLAY_IDENTIFIER PWG ECU_ADDRESS 0xd0007084 FORMAT "%7.2" /end MEASUREMENT
/begin MEASUREMENT Pwstgdse "Modell Druck in der Wastegatedose" UWORD _CNV_R_R_Def_p_sw_q_578_CM 1 100. 0. 2559.9609 DISPLAY_IDENTIFIER PWSTGDSE ECU_ADDRESS 0xd0007086 FORMAT "%8.3" /end MEASUREMENT
/begin MEASUREMENT Pwstgtpu "Verhältnis Wastegatedosendruck / Umgebungsdruck" UWORD _CNV_R_R_Def_f_sw_b_608_CM 1 100. 0. 3.9999 DISPLAY_IDENTIFIER PWSTGTPU ECU_ADDRESS 0xd0007088 FORMAT "%14.5" /end MEASUREMENT
/begin MEASUREMENT Q_msnagr_mx "" UWORD _CNV_R_R_Def_f_uw_b_579_CM 1 100. 0. 1.9999 DISPLAY_IDENTIFIER Q_MSNAGR_MX ECU_ADDRESS 0xd0007b58 FORMAT "%14.5" /end MEASUREMENT
/begin MEASUREMENT Rf_agr_soll "Relative Füllung über AGR" SWORD _CNV_R_R_Def_rf_sw__616_CM 1 100. -327.68 327.67 DISPLAY_IDENTIFIER RF_AGR_SOLL ECU_ADDRESS 0xd0007b40 FORMAT "%9.4" /end MEASUREMENT
/begin MEASUREMENT Rf_agrfg_soll "Relative Füllung Frischgas über AGR" SWORD _CNV_R_R_Def_rf_sw__616_CM 1 100. -327.68 327.67 DISPLAY_IDENTIFIER RF_AGRFG_SOLL ECU_ADDRESS 0xd0007b44 FORMAT "%9.4" /end MEASUREMENT
/begin MEASUREMENT Rf_agrig_soll "Relative Füllung Inertgas über AGR" SWORD _CNV_R_R_Def_rf_sw__616_CM 1 100. -327.68 327.67 DISPLAY_IDENTIFIER RF_AGRIG_SOLL ECU_ADDRESS 0xd0007b42 FORMAT "%9.4" /end MEASUREMENT
/begin MEASUREMENT Rf_f_vns "relative Füllung DK, gefiltert" SWORD _CNV_R_R_Def_rf_sw__616_CM 1 100. -327.68 327.67 DISPLAY_IDENTIFIER RF_F_VNS ECU_ADDRESS 0xd0007a30 FORMAT "%9.4" /end MEASUREMENT
/begin MEASUREMENT Rf_fvns_k "relative Füllung Vanos, korr" SWORD _CNV_R_R_Def_rf_sw__616_CM 1 100. -327.68 327.67 DISPLAY_IDENTIFIER RF_FVNS_K ECU_ADDRESS 0xd0007a34 FORMAT "%9.4" /end MEASUREMENT
/begin MEASUREMENT Rf_fvns_tkor "relative Füllung Vanos, temp. korr" SWORD _CNV_R_R_Def_rf_sw__616_CM 1 100. -327.68 327.67 DISPLAY_IDENTIFIER RF_FVNS_TKOR ECU_ADDRESS 0xd0007a32 FORMAT "%9.4" /end MEASUREMENT
/begin MEASUREMENT Rf_ig_ist "Relative Luftfuellung inert Gas von AGR" SWORD _CNV_R_R_Def_rf_sw__616_CM 1 100. -327.68 327.67 DISPLAY_IDENTIFIER RF_IG_IST ECU_ADDRESS 0xd0007b4a FORMAT "%9.4" /end MEASUREMENT
/begin MEASUREMENT Rf_soll_g "" SWORD _CNV_R_R_Def_rf_sw__616_CM 1 100. -327.68 327.67 DISPLAY_IDENTIFIER RF_SOLL_G ECU_ADDRESS 0xd0007a26 FORMAT "%9.4" /end MEASUREMENT
/begin MEASUREMENT Rft "" SWORD _CNV_R_R_Def_rf_sw__616_CM 1 100. -327.68 327.67 DISPLAY_IDENTIFIER RFT ECU_ADDRESS 0xd0007a1e FORMAT "%9.4" /end MEASUREMENT
/begin MEASUREMENT Rft_lin "" SWORD _CNV_R_R_Def_rf_sw__616_CM 1 100. -327.68 327.67 DISPLAY_IDENTIFIER RFT_LIN ECU_ADDRESS 0xd0007a20 FORMAT "%9.4" /end MEASUREMENT
/begin MEASUREMENT Rft_nl "" SWORD _CNV_R_R_Def_rf_sw__616_CM 1 100. -327.68 327.67 DISPLAY_IDENTIFIER RFT_NL ECU_ADDRESS 0xd0007a22 FORMAT "%9.4" /end MEASUREMENT
/begin MEASUREMENT Rfv_fvns_mem "Speichervar für Rfv_vnsdk_gew-Filterung" SLONG _CNV_R_R_Def_dez_sl_575_CM 1 100. -2147483648. 2147483647. DISPLAY_IDENTIFIER RFV_FVNS_MEM ECU_ADDRESS 0xd0007a58 FORMAT "%7.0" /end MEASUREMENT
/begin MEASUREMENT Rfv_hub "relative Füllung für Vvt" SWORD _CNV_R_R_Def_rf_sw__616_CM 1 100. -327.68 327.67 DISPLAY_IDENTIFIER RFV_HUB ECU_ADDRESS 0xd00079e4 FORMAT "%9.4" /end MEASUREMENT
/begin MEASUREMENT Rfv_mpr "relative Füllung für Vvt" SWORD _CNV_R_R_Def_rf_sw__616_CM 1 100. -327.68 327.67 DISPLAY_IDENTIFIER RFV_MPR ECU_ADDRESS 0xd0007a38 FORMAT "%9.4" /end MEASUREMENT
/begin MEASUREMENT Rfv_mxdk "" SWORD _CNV_R_R_Def_rf_sw__616_CM 1 100. -327.68 327.67 DISPLAY_IDENTIFIER RFV_MXDK ECU_ADDRESS 0xd0007a94 FORMAT "%9.4" /end MEASUREMENT
/begin MEASUREMENT Rfv_pspvdk_smx "" SWORD _CNV_R_R_Def_rf_sw__616_CM 1 100. -327.68 327.67 DISPLAY_IDENTIFIER RFV_PSPVDK_SMX ECU_ADDRESS 0xd0007a96 FORMAT "%9.4" /end MEASUREMENT
/begin MEASUREMENT Rfv_soll "relative Luftfüllung - druck- und temperaturkorrigiert" SWORD _CNV_R_R_Def_rf_sw__616_CM 1 100. -327.68 327.67 DISPLAY_IDENTIFIER RFV_SOLL ECU_ADDRESS 0xd00079c4 FORMAT "%9.4" /end MEASUREMENT
/begin MEASUREMENT Rfv_soll_k "Korrigierterrelative Luftfüllung aus Msnzylsol_k" SWORD _CNV_R_R_Def_rf_sw__616_CM 1 100. -327.68 327.67 DISPLAY_IDENTIFIER RFV_SOLL_K ECU_ADDRESS 0xd0007a0e FORMAT "%9.4" /end MEASUREMENT
/begin MEASUREMENT Rfv_soll_vns "relative Luftfüllung VNS- druck- und temperaturkorrigiert" SWORD _CNV_R_R_Def_rf_sw__616_CM 1 100. -327.68 327.67 DISPLAY_IDENTIFIER RFV_SOLL_VNS ECU_ADDRESS 0xd00079c6 FORMAT "%9.4" /end MEASUREMENT
/begin MEASUREMENT Rfv_solldk "" SWORD _CNV_R_R_Def_rf_sw__616_CM 1 100. -327.68 327.67 DISPLAY_IDENTIFIER RFV_SOLLDK ECU_ADDRESS 0xd0007a98 FORMAT "%9.4" /end MEASUREMENT
/begin MEASUREMENT Rfv_vns "relative Füllung für Vanos" SWORD _CNV_R_R_Def_rf_sw__616_CM 1 100. -327.68 327.67 DISPLAY_IDENTIFIER RFV_VNS ECU_ADDRESS 0xd00079e6 FORMAT "%9.4" /end MEASUREMENT
/begin MEASUREMENT Rfv_vns_dk "relative Füllung für Dk gedrosselt" SWORD _CNV_R_R_Def_rf_sw__616_CM 1 100. -327.68 327.67 DISPLAY_IDENTIFIER RFV_VNS_DK ECU_ADDRESS 0xd0007a14 FORMAT "%9.4" /end MEASUREMENT
/begin MEASUREMENT Rfv_vns_hub "relative Füllung für Vanos ungedrosselt" SWORD _CNV_R_R_Def_rf_sw__616_CM 1 100. -327.68 327.67 DISPLAY_IDENTIFIER RFV_VNS_HUB ECU_ADDRESS 0xd0007a12 FORMAT "%9.4" /end MEASUREMENT
/begin MEASUREMENT Rfv_vnsdk_mem "Speichervar für Rfv_vnsdk_gew-Filterung" SLONG _CNV_R_R_Def_dez_sl_575_CM 1 100. -2147483648. 2147483647. DISPLAY_IDENTIFIER RFV_VNSDK_MEM ECU_ADDRESS 0xd0007a54 FORMAT "%7.0" /end MEASUREMENT
/begin MEASUREMENT Rfv_vnsdk_roh "relative Füllung für Vvt" SWORD _CNV_R_R_Def_rf_sw__616_CM 1 100. -327.68 327.67 DISPLAY_IDENTIFIER RFV_VNSDK_ROH ECU_ADDRESS 0xd0007a36 FORMAT "%9.4" /end MEASUREMENT
/begin MEASUREMENT Rfv_vnsdk_ubeg "relative Füllung für Vanos, unbegrenzt" SWORD _CNV_R_R_Def_rf_sw__616_CM 1 100. -327.68 327.67 DISPLAY_IDENTIFIER RFV_VNSDK_UBEG ECU_ADDRESS 0xd0007a16 FORMAT "%9.4" /end MEASUREMENT
/begin MEASUREMENT Rfv_vnshub_mem "Speichervar für Rfv_vns_gew-Filterung" SLONG _CNV_R_R_Def_dez_sl_575_CM 1 100. -2147483648. 2147483647. DISPLAY_IDENTIFIER RFV_VNSHUB_MEM ECU_ADDRESS 0xd0007a50 FORMAT "%7.0" /end MEASUREMENT
/begin MEASUREMENT Rfv_vnshub_roh "relative Füllung für Vanos ungedrosselt" SWORD _CNV_R_R_Def_rf_sw__616_CM 1 100. -327.68 327.67 DISPLAY_IDENTIFIER RFV_VNSHUB_ROH ECU_ADDRESS 0xd0007a10 FORMAT "%9.4" /end MEASUREMENT
/begin MEASUREMENT Rk_soll_konv "Relative Luftfuellung" SWORD _CNV_R_R_Def_rf_sw__616_CM 1 100. -327.68 327.67 DISPLAY_IDENTIFIER RK_SOLL_KONV ECU_ADDRESS 0xd0007b56 FORMAT "%9.4" /end MEASUREMENT
/begin MEASUREMENT St_atlreg "Statuswort f. ATL-Regler" UBYTE _CNV_R_R_Def_dez_sl_575_CM 1 100. 0. 255. DISPLAY_IDENTIFIER ST_ATLREG ECU_ADDRESS 0xd00069ee FORMAT "%3.0" /end MEASUREMENT
/begin MEASUREMENT St_atlreg.B_atlvst_neg "Vorsteuerungsgradient negativ" UBYTE _CNV_S_1_Def_bit_ub_700_CM 1 100. 0. 0. DISPLAY_IDENTIFIER B_ATLVST_NEG ECU_ADDRESS 0xd00069ee BIT_MASK 0x1 /end MEASUREMENT
/begin MEASUREMENT St_atlreg.B_atlvst_tr "Transition gedämpft f. Vorsteuerungswert" UBYTE _CNV_S_1_Def_bit_ub_700_CM 1 100. 0. 0. DISPLAY_IDENTIFIER B_ATLVST_TR ECU_ADDRESS 0xd00069ee BIT_MASK 0x2 /end MEASUREMENT
/begin MEASUREMENT St_atlstat "Statuswort" UBYTE _CNV_R_R_Def_dez_sl_575_CM 1 100. 0. 255. DISPLAY_IDENTIFIER ST_ATLSTAT ECU_ADDRESS 0xd0006a1c FORMAT "%3.0" /end MEASUREMENT
/begin MEASUREMENT St_atlstat.B_atlr "Regler Wastegate aktiv" UBYTE _CNV_S_1_Def_bit_ub_700_CM 1 100. 0. 0. DISPLAY_IDENTIFIER B_ATLR ECU_ADDRESS 0xd0006a1c BIT_MASK 0x1 /end MEASUREMENT
/begin MEASUREMENT St_atlstat.B_ulvdyn "Umluftventil aktiv f. schnellen Ladedruckabbau" UBYTE _CNV_S_1_Def_bit_ub_700_CM 1 100. 0. 0. DISPLAY_IDENTIFIER B_ULVDYN ECU_ADDRESS 0xd0006a1c BIT_MASK 0x4 /end MEASUREMENT
/begin MEASUREMENT St_atlstat.B_ulvr "Regler Umluftventil aktiv" UBYTE _CNV_S_1_Def_bit_ub_700_CM 1 100. 0. 0. DISPLAY_IDENTIFIER B_ULVR ECU_ADDRESS 0xd0006a1c BIT_MASK 0x2 /end MEASUREMENT
/begin MEASUREMENT St_bgkuppl "Statuswort BGKUPPL" UBYTE _CNV_R_R_Def_dez_sl_575_CM 1 100. 0. 255. DISPLAY_IDENTIFIER ST_BGKUPPL ECU_ADDRESS 0xd00069a8 FORMAT "%3.0" /end MEASUREMENT
/begin MEASUREMENT St_bgkuppl.B_kupp "Bedingung Kupplungsbetätigung über Schalter oder Modell" UBYTE _CNV_S_1_Def_bit_ub_700_CM 1 100. 0. 0. DISPLAY_IDENTIFIER B_KUPP ECU_ADDRESS 0xd00069a8 BIT_MASK 0x1 /end MEASUREMENT
/begin MEASUREMENT St_bgkuppl.B_kupp_ext "Bedingung Kupplungsbetätigung über Schalter von extern" UBYTE _CNV_S_1_Def_bit_ub_700_CM 1 100. 0. 0. DISPLAY_IDENTIFIER B_KUPP_EXT ECU_ADDRESS 0xd00069a8 BIT_MASK 0x2 /end MEASUREMENT
/begin MEASUREMENT St_bgkuppl.B_kupp_mod "Bedingung Kupplungsbetätigung über Modell erkannt" UBYTE _CNV_S_1_Def_bit_ub_700_CM 1 100. 0. 0. DISPLAY_IDENTIFIER B_KUPP_MOD ECU_ADDRESS 0xd00069a8 BIT_MASK 0x4 /end MEASUREMENT
/begin MEASUREMENT St_bgkuppl1 "Statuswort BGKUPPL" UBYTE _CNV_R_R_Def_dez_sl_575_CM 1 100. 0. 255. DISPLAY_IDENTIFIER ST_BGKUPPL1 ECU_ADDRESS 0xd00069a9 FORMAT "%3.0" /end MEASUREMENT
/begin MEASUREMENT St_bgkuppl1.B_ll "Bedingung Leerlauf" UBYTE _CNV_S_1_Def_bit_ub_700_CM 1 100. 0. 0. DISPLAY_IDENTIFIER B_LL ECU_ADDRESS 0xd00069a9 BIT_MASK 0x1 /end MEASUREMENT
/begin MEASUREMENT St_bgllgen0 "Statuswort" UBYTE _CNV_R_R_Def_dez_sl_575_CM 1 100. 0. 255. DISPLAY_IDENTIFIER ST_BGLLGEN0 ECU_ADDRESS 0xd00071b0 FORMAT "%3.0" /end MEASUREMENT
/begin MEASUREMENT St_bgllgen0.B_hysllrah "Hysterese LL Anhebung" UBYTE _CNV_S_1_Def_bit_ub_700_CM 1 100. 0. 0. DISPLAY_IDENTIFIER B_HYSLLRAH ECU_ADDRESS 0xd00071b0 BIT_MASK 0x1 /end MEASUREMENT
/begin MEASUREMENT St_blsagr "Statuswort BLSAGR" UBYTE _CNV_R_R_Def_dez_sl_575_CM 1 100. 0. 255. DISPLAY_IDENTIFIER ST_BLSAGR ECU_ADDRESS 0xd0007b5a FORMAT "%3.0" /end MEASUREMENT
/begin MEASUREMENT St_blsagr.B_laber_unend "Bedingung B_laber_unend" UBYTE _CNV_S_1_Def_bit_ub_700_CM 1 100. 0. 0. DISPLAY_IDENTIFIER B_LABER_UNEND ECU_ADDRESS 0xd0007b5a BIT_MASK 0x1 /end MEASUREMENT
/begin MEASUREMENT St_blsdisa2 "Statuswort BLSDISA" UBYTE _CNV_R_R_Def_dez_sl_575_CM 1 100. 0. 255. DISPLAY_IDENTIFIER ST_BLSDISA2 ECU_ADDRESS 0xd0007b60 FORMAT "%3.0" /end MEASUREMENT
/begin MEASUREMENT St_blsdisa2.B_disa1_auf "Anforderung Disa 1 öffnen aus BMW-Modul" UBYTE _CNV_S_1_Def_bit_ub_700_CM 1 100. 0. 0. DISPLAY_IDENTIFIER B_DISA1_AUF ECU_ADDRESS 0xd0007b60 BIT_MASK 0x1 /end MEASUREMENT
/begin MEASUREMENT St_blsdisa2.B_disa2_auf "Anforderung Disa 2 öffnen aus BMW-Modul" UBYTE _CNV_S_1_Def_bit_ub_700_CM 1 100. 0. 0. DISPLAY_IDENTIFIER B_DISA2_AUF ECU_ADDRESS 0xd0007b60 BIT_MASK 0x2 /end MEASUREMENT
/begin MEASUREMENT St_blsdisa2.B_disa_hys "Statuswort BLSDISA" UBYTE _CNV_S_1_Def_bit_ub_700_CM 1 100. 0. 0. DISPLAY_IDENTIFIER B_DISA_HYS ECU_ADDRESS 0xd0007b60 BIT_MASK 0x4 /end MEASUREMENT
/begin MEASUREMENT St_blshub "Statuswort BLSHUB" UBYTE _CNV_R_R_Def_dez_sl_575_CM 1 100. 0. 255. DISPLAY_IDENTIFIER ST_BLSHUB ECU_ADDRESS 0xd0007ad4 FORMAT "%3.0" /end MEASUREMENT
/begin MEASUREMENT St_blshub.B_fhubvnsi_ini "Bedingung Initialisierung B_fhubvnsi_ini" UBYTE _CNV_S_1_Def_bit_ub_700_CM 1 100. 0. 0. DISPLAY_IDENTIFIER B_FHUBVNSI_INI ECU_ADDRESS 0xd0007ad4 BIT_MASK 0x80 /end MEASUREMENT
/begin MEASUREMENT St_blshub.B_hubst "Bedingung Einlassventilhubvorsteuerung im Start" UBYTE _CNV_S_1_Def_bit_ub_700_CM 1 100. 0. 0. DISPLAY_IDENTIFIER B_HUBST ECU_ADDRESS 0xd0007ad4 BIT_MASK 0x8 /end MEASUREMENT
/begin MEASUREMENT St_blshub.B_llk "Bedingung nwe unterschritten (hysteresebehaftet)" UBYTE _CNV_S_1_Def_bit_ub_700_CM 1 100. 0. 0. DISPLAY_IDENTIFIER B_LLK ECU_ADDRESS 0xd0007ad4 BIT_MASK 0x2 /end MEASUREMENT
/begin MEASUREMENT St_blshub.B_nwe "Bedingung Nockenwellenendstufe angesteuert" UBYTE _CNV_S_1_Def_bit_ub_700_CM 1 100. 0. 0. DISPLAY_IDENTIFIER B_NWE ECU_ADDRESS 0xd0007ad4 BIT_MASK 0x1 /end MEASUREMENT
/begin MEASUREMENT St_blshub.B_vns_spron "Bedingung Berechnung Fhubvnsi mit Sollspreizungen" UBYTE _CNV_S_1_Def_bit_ub_700_CM 1 100. 0. 0. DISPLAY_IDENTIFIER B_VNS_SPRON ECU_ADDRESS 0xd0007ad4 BIT_MASK 0x40 /end MEASUREMENT
/begin MEASUREMENT St_blshub.B_vsean_loc "Bedingung EVANOS im Anschlag beim letzten Abstellen" UBYTE _CNV_S_1_Def_bit_ub_700_CM 1 100. 0. 0. DISPLAY_IDENTIFIER B_VSEAN_LOC ECU_ADDRESS 0xd0007ad4 BIT_MASK 0x20 /end MEASUREMENT
/begin MEASUREMENT St_blshub.B_vvtclose "Bedingung Einlassventilhub herunterfahren" UBYTE _CNV_S_1_Def_bit_ub_700_CM 1 100. 0. 0. DISPLAY_IDENTIFIER B_VVTCLOSE ECU_ADDRESS 0xd0007ad4 BIT_MASK 0x4 /end MEASUREMENT
/begin MEASUREMENT St_blshub2 "Statuswort BLSHUB 2" UBYTE _CNV_R_R_Def_dez_sl_575_CM 1 100. 0. 255. DISPLAY_IDENTIFIER ST_BLSHUB2 ECU_ADDRESS 0xd0007ad5 FORMAT "%3.0" /end MEASUREMENT
/begin MEASUREMENT St_blshub2.B_hkll "Bedingung Hubkorrektur wird gestartet" UBYTE _CNV_S_1_Def_bit_ub_700_CM 1 100. 0. 0. DISPLAY_IDENTIFIER B_HKLL ECU_ADDRESS 0xd0007ad5 BIT_MASK 0x4 /end MEASUREMENT
/begin MEASUREMENT St_blshub2.B_hkll_edge1 "-" UBYTE _CNV_S_1_Def_bit_ub_700_CM 1 100. 0. 0. DISPLAY_IDENTIFIER B_HKLL_EDGE1 ECU_ADDRESS 0xd0007ad5 BIT_MASK 0x10 /end MEASUREMENT
/begin MEASUREMENT St_blshub2.B_hkll_edge2 "-" UBYTE _CNV_S_1_Def_bit_ub_700_CM 1 100. 0. 0. DISPLAY_IDENTIFIER B_HKLL_EDGE2 ECU_ADDRESS 0xd0007ad5 BIT_MASK 0x20 /end MEASUREMENT
/begin MEASUREMENT St_blshub2.B_hkll_edge3 "-" UBYTE _CNV_S_1_Def_bit_ub_700_CM 1 100. 0. 0. DISPLAY_IDENTIFIER B_HKLL_EDGE3 ECU_ADDRESS 0xd0007ad5 BIT_MASK 0x40 /end MEASUREMENT
/begin MEASUREMENT St_blshub2.B_hkll_pre "Bedingung Hubkorrektur wird angefordert" UBYTE _CNV_S_1_Def_bit_ub_700_CM 1 100. 0. 0. DISPLAY_IDENTIFIER B_HKLL_PRE ECU_ADDRESS 0xd0007ad5 BIT_MASK 0x1 /end MEASUREMENT
/begin MEASUREMENT St_blshub2.B_hkll_vz "Bedingung Verstellung nach Hubkorrektur abwarten" UBYTE _CNV_S_1_Def_bit_ub_700_CM 1 100. 0. 0. DISPLAY_IDENTIFIER B_HKLL_VZ ECU_ADDRESS 0xd0007ad5 BIT_MASK 0x2 /end MEASUREMENT
/begin MEASUREMENT St_blshub2.B_hubsolldif "Bedingung Sollhub bewegt sich" UBYTE _CNV_S_1_Def_bit_ub_700_CM 1 100. 0. 0. DISPLAY_IDENTIFIER B_HUBSOLLDIF ECU_ADDRESS 0xd0007ad5 BIT_MASK 0x8 /end MEASUREMENT
/begin MEASUREMENT St_blstd "Status BLS Teildrosselung" UBYTE _CNV_R_R_Def_dez_sl_575_CM 1 100. 0. 255. DISPLAY_IDENTIFIER ST_BLSTD ECU_ADDRESS 0xd00079c1 FORMAT "%3.0" /end MEASUREMENT
/begin MEASUREMENT St_blstd.B_lltd "Status BLS Teildrosselung" UBYTE _CNV_S_1_Def_bit_ub_700_CM 1 100. 0. 0. DISPLAY_IDENTIFIER B_LLTD ECU_ADDRESS 0xd00079c1 BIT_MASK 0x1 /end MEASUREMENT
/begin MEASUREMENT St_blstd.B_lltd_old "Status BLS Teildrosselung" UBYTE _CNV_S_1_Def_bit_ub_700_CM 1 100. 0. 0. DISPLAY_IDENTIFIER B_LLTD_OLD ECU_ADDRESS 0xd00079c1 BIT_MASK 0x4 /end MEASUREMENT
/begin MEASUREMENT St_blstd.B_lltd_vz "Status BLS Teildrosselung" UBYTE _CNV_S_1_Def_bit_ub_700_CM 1 100. 0. 0. DISPLAY_IDENTIFIER B_LLTD_VZ ECU_ADDRESS 0xd00079c1 BIT_MASK 0x2 /end MEASUREMENT
/begin MEASUREMENT St_blstd.B_pssolnl_akt "Status BLS Teildrosselung" UBYTE _CNV_S_1_Def_bit_ub_700_CM 1 100. 0. 0. DISPLAY_IDENTIFIER B_PSSOLNL_AKT ECU_ADDRESS 0xd00079c1 BIT_MASK 0x10 /end MEASUREMENT
/begin MEASUREMENT St_deavns "Statuswort DEAVANOS" UBYTE _CNV_R_R_Def_dez_sl_575_CM 1 100. 0. 255. DISPLAY_IDENTIFIER ST_DEAVNS ECU_ADDRESS 0xc000525c FORMAT "%3.0" /end MEASUREMENT
/begin MEASUREMENT St_deavns.B_anwmn "Fehler Anschlagadaption Auslass Bank 1" UBYTE _CNV_S_1_Def_bit_ub_700_CM 1 100. 0. 0. DISPLAY_IDENTIFIER B_ANWMN ECU_ADDRESS 0xc000525c BIT_MASK 0x20 /end MEASUREMENT
/begin MEASUREMENT St_deavns.B_anwpnp "Fehler Lagereglerüberwachung Auslass Bank 1" UBYTE _CNV_S_1_Def_bit_ub_700_CM 1 100. 0. 0. DISPLAY_IDENTIFIER B_ANWPNP ECU_ADDRESS 0xc000525c BIT_MASK 0x2 /end MEASUREMENT
/begin MEASUREMENT St_deavns.B_enwmn "Fehler Anschlagadaption Einlass Bank 1" UBYTE _CNV_S_1_Def_bit_ub_700_CM 1 100. 0. 0. DISPLAY_IDENTIFIER B_ENWMN ECU_ADDRESS 0xc000525c BIT_MASK 0x10 /end MEASUREMENT
/begin MEASUREMENT St_deavns.B_enwpnp "Fehler Lagereglerüberwachung Einlass Bank 1" UBYTE _CNV_S_1_Def_bit_ub_700_CM 1 100. 0. 0. DISPLAY_IDENTIFIER B_ENWPNP ECU_ADDRESS 0xc000525c BIT_MASK 0x1 /end MEASUREMENT
/begin MEASUREMENT St_deavns2 "Statuswort DEAVANOS2" UBYTE _CNV_R_R_Def_dez_sl_575_CM 1 100. 0. 255. DISPLAY_IDENTIFIER ST_DEAVNS2 ECU_ADDRESS 0xc0004690 FORMAT "%3.0" /end MEASUREMENT
/begin MEASUREMENT St_deavns2.B_anwoto "Bedingung Vanos Auslass Bank1 One-Tooth-Off" UBYTE _CNV_S_1_Def_bit_ub_700_CM 1 100. 0. 0. DISPLAY_IDENTIFIER B_ANWOTO ECU_ADDRESS 0xc0004690 BIT_MASK 0x20 /end MEASUREMENT
/begin MEASUREMENT St_deavns2.B_enwoto "Bedingung Vanos Einlass Bank1 One-Tooth-Off" UBYTE _CNV_S_1_Def_bit_ub_700_CM 1 100. 0. 0. DISPLAY_IDENTIFIER B_ENWOTO ECU_ADDRESS 0xc0004690 BIT_MASK 0x10 /end MEASUREMENT
/begin MEASUREMENT St_deavns2.B_vsa_an "Bedingung Vanos Auslass Bank1 im Anschlag" UBYTE _CNV_S_1_Def_bit_ub_700_CM 1 100. 0. 0. DISPLAY_IDENTIFIER B_VSA_AN ECU_ADDRESS 0xc0004690 BIT_MASK 0x2 /end MEASUREMENT
/begin MEASUREMENT St_deavns2.B_vse_an "Bedingung Vanos Einlass Bank1 im Anschlag" UBYTE _CNV_S_1_Def_bit_ub_700_CM 1 100. 0. 0. DISPLAY_IDENTIFIER B_VSE_AN ECU_ADDRESS 0xc0004690 BIT_MASK 0x1 /end MEASUREMENT
/begin MEASUREMENT St_deavns3 "Statuswort DEAVANOS3" UBYTE _CNV_R_R_Def_dez_sl_575_CM 1 100. 0. 255. DISPLAY_IDENTIFIER ST_DEAVNS3 ECU_ADDRESS 0xd0007984 FORMAT "%3.0" /end MEASUREMENT
/begin MEASUREMENT St_deavns3.B_anwmn_dis "Bedingung Anschlagadaptionsfehler Auslass Bank 1 gesperrt" UBYTE _CNV_S_1_Def_bit_ub_700_CM 1 100. 0. 0. DISPLAY_IDENTIFIER B_ANWMN_DIS ECU_ADDRESS 0xd0007984 BIT_MASK 0x20 /end MEASUREMENT
/begin MEASUREMENT St_deavns3.B_anwpnp_dis "Bedingung Lagereglerüberwachung Auslass Bank 1 gesperrt" UBYTE _CNV_S_1_Def_bit_ub_700_CM 1 100. 0. 0. DISPLAY_IDENTIFIER B_ANWPNP_DIS ECU_ADDRESS 0xd0007984 BIT_MASK 0x2 /end MEASUREMENT
/begin MEASUREMENT St_deavns3.B_enwmn_dis "Bedingung Anschlagadaptionsfehler Einlass Bank 1 gesperrt" UBYTE _CNV_S_1_Def_bit_ub_700_CM 1 100. 0. 0. DISPLAY_IDENTIFIER B_ENWMN_DIS ECU_ADDRESS 0xd0007984 BIT_MASK 0x10 /end MEASUREMENT
/begin MEASUREMENT St_deavns3.B_enwpnp_dis "Bedingung Lagereglerüberwachung Einlass Bank 1 gesperrt" UBYTE _CNV_S_1_Def_bit_ub_700_CM 1 100. 0. 0. DISPLAY_IDENTIFIER B_ENWPNP_DIS ECU_ADDRESS 0xd0007984 BIT_MASK 0x1 /end MEASUREMENT
/begin MEASUREMENT St_deavns4 "Statuswort DEAVANOS4" UBYTE _CNV_R_R_Def_dez_sl_575_CM 1 100. 0. 255. DISPLAY_IDENTIFIER ST_DEAVNS4 ECU_ADDRESS 0xd0007985 FORMAT "%3.0" /end MEASUREMENT
/begin MEASUREMENT St_deavns4.B_anwoto_dis "Bedingung One-Tooth-Off-Diagnose Auslass Bank 1 gesperrt" UBYTE _CNV_S_1_Def_bit_ub_700_CM 1 100. 0. 0. DISPLAY_IDENTIFIER B_ANWOTO_DIS ECU_ADDRESS 0xd0007985 BIT_MASK 0x2 /end MEASUREMENT
/begin MEASUREMENT St_deavns4.B_enwoto_dis "Bedingung One-Tooth-Off-Diagnose Einlass Bank 1 gesperrt" UBYTE _CNV_S_1_Def_bit_ub_700_CM 1 100. 0. 0. DISPLAY_IDENTIFIER B_ENWOTO_DIS ECU_ADDRESS 0xd0007985 BIT_MASK 0x1 /end MEASUREMENT
/begin MEASUREMENT St_deavns5 "Statuswort DEAVANOS5" UBYTE _CNV_R_R_Def_dez_sl_575_CM 1 100. 0. 255. DISPLAY_IDENTIFIER ST_DEAVNS5 ECU_ADDRESS 0xd0007986 FORMAT "%3.0" /end MEASUREMENT
/begin MEASUREMENT St_deavns5.B_anwmn_rbmc "Bedingung Anschlagadaptionsüberwachung Auslass Bank 1 RBM completed" UBYTE _CNV_S_1_Def_bit_ub_700_CM 1 100. 0. 0. DISPLAY_IDENTIFIER B_ANWMN_RBMC ECU_ADDRESS 0xd0007986 BIT_MASK 0x20 /end MEASUREMENT
/begin MEASUREMENT St_deavns5.B_anwpnp_rbmc "Bedingung Lagereglerüberwachung Auslass Bank 1 RBM completed" UBYTE _CNV_S_1_Def_bit_ub_700_CM 1 100. 0. 0. DISPLAY_IDENTIFIER B_ANWPNP_RBMC ECU_ADDRESS 0xd0007986 BIT_MASK 0x2 /end MEASUREMENT
/begin MEASUREMENT St_deavns5.B_enwmn_rbmc "Bedingung Anschlagadaptionsüberwachung Einlass Bank 1 RBM completed" UBYTE _CNV_S_1_Def_bit_ub_700_CM 1 100. 0. 0. DISPLAY_IDENTIFIER B_ENWMN_RBMC ECU_ADDRESS 0xd0007986 BIT_MASK 0x10 /end MEASUREMENT
/begin MEASUREMENT St_deavns5.B_enwpnp_rbmc "Bedingung Lagereglerüberwachung Einlass Bank 1 RBM completed" UBYTE _CNV_S_1_Def_bit_ub_700_CM 1 100. 0. 0. DISPLAY_IDENTIFIER B_ENWPNP_RBMC ECU_ADDRESS 0xd0007986 BIT_MASK 0x1 /end MEASUREMENT
/begin MEASUREMENT St_deavns6 "Statuswort DEAVANOS6" UBYTE _CNV_R_R_Def_dez_sl_575_CM 1 100. 0. 255. DISPLAY_IDENTIFIER ST_DEAVNS6 ECU_ADDRESS 0xd0007987 FORMAT "%3.0" /end MEASUREMENT
/begin MEASUREMENT St_deavns6.B_anwmn_rbmd "Bedingung Anschlagadaptionsüberwachung Auslass Bank 1 RBM disabled" UBYTE _CNV_S_1_Def_bit_ub_700_CM 1 100. 0. 0. DISPLAY_IDENTIFIER B_ANWMN_RBMD ECU_ADDRESS 0xd0007987 BIT_MASK 0x20 /end MEASUREMENT
/begin MEASUREMENT St_deavns6.B_anwpnp_rbmd "Bedingung Lagereglerüberwachung Auslass Bank 1 RBM disabled" UBYTE _CNV_S_1_Def_bit_ub_700_CM 1 100. 0. 0. DISPLAY_IDENTIFIER B_ANWPNP_RBMD ECU_ADDRESS 0xd0007987 BIT_MASK 0x2 /end MEASUREMENT
/begin MEASUREMENT St_deavns6.B_enwmn_rbmd "Bedingung Anschlagadaptionsüberwachung Einlass Bank 1 RBM disabled" UBYTE _CNV_S_1_Def_bit_ub_700_CM 1 100. 0. 0. DISPLAY_IDENTIFIER B_ENWMN_RBMD ECU_ADDRESS 0xd0007987 BIT_MASK 0x10 /end MEASUREMENT
/begin MEASUREMENT St_deavns6.B_enwpnp_rbmd "Bedingung Lagereglerüberwachung Einlass Bank 1 RBM disabled" UBYTE _CNV_S_1_Def_bit_ub_700_CM 1 100. 0. 0. DISPLAY_IDENTIFIER B_ENWPNP_RBMD ECU_ADDRESS 0xd0007987 BIT_MASK 0x1 /end MEASUREMENT
/begin MEASUREMENT St_dgen0 "Statuswort" UBYTE _CNV_R_R_Def_dez_sl_575_CM 1 100. 0. 255. DISPLAY_IDENTIFIER ST_DGEN0 ECU_ADDRESS 0xd00071b4 FORMAT "%3.0" /end MEASUREMENT
/begin MEASUREMENT St_dgen0.B_1stbsder "Statuswort" UBYTE _CNV_S_1_Def_bit_ub_700_CM 1 100. 0. 0. DISPLAY_IDENTIFIER B_1STBSDER ECU_ADDRESS 0xd00071b4 BIT_MASK 0x1 /end MEASUREMENT
/begin MEASUREMENT St_dgen0.B_genfprl "Bedingung Generatorfehler entprellt" UBYTE _CNV_S_1_Def_bit_ub_700_CM 1 100. 0. 0. DISPLAY_IDENTIFIER B_GENFPRL ECU_ADDRESS 0xd00071b4 BIT_MASK 0x4 /end MEASUREMENT
/begin MEASUREMENT St_dgen0.B_gfbsupak "Generator Typ unplausibel^aus Fehlerspeicher" UBYTE _CNV_S_1_Def_bit_ub_700_CM 1 100. 0. 0. DISPLAY_IDENTIFIER B_GFBSUPAK ECU_ADDRESS 0xd00071b4 BIT_MASK 0x8 /end MEASUREMENT
/begin MEASUREMENT St_dgen0.B_gfelak "Generatorfehler elektrisch aus Fehlerspeicher" UBYTE _CNV_S_1_Def_bit_ub_700_CM 1 100. 0. 0. DISPLAY_IDENTIFIER B_GFELAK ECU_ADDRESS 0xd00071b4 BIT_MASK 0x10 /end MEASUREMENT
/begin MEASUREMENT St_dgen0.B_gfhtak "Generatorfehler Uebertemperatur aus Fehlerspeicher" UBYTE _CNV_S_1_Def_bit_ub_700_CM 1 100. 0. 0. DISPLAY_IDENTIFIER B_GFHTAK ECU_ADDRESS 0xd00071b4 BIT_MASK 0x20 /end MEASUREMENT
/begin MEASUREMENT St_dgen0.B_gfmeak "Generatorfehler mechanisch aus Fehlerspeicher" UBYTE _CNV_S_1_Def_bit_ub_700_CM 1 100. 0. 0. DISPLAY_IDENTIFIER B_GFMEAK ECU_ADDRESS 0xd00071b4 BIT_MASK 0x40 /end MEASUREMENT
/begin MEASUREMENT St_dgen0.B_gfnobsak "Generator BSD Kommunikationsverlust aus Fehlerspeicher" UBYTE _CNV_S_1_Def_bit_ub_700_CM 1 100. 0. 0. DISPLAY_IDENTIFIER B_GFNOBSAK ECU_ADDRESS 0xd00071b4 BIT_MASK 0x80 /end MEASUREMENT
/begin MEASUREMENT St_dgen0.B_kl61 "Bedingung Ladekontroll Laempchen an" UBYTE _CNV_S_1_Def_bit_ub_700_CM 1 100. 0. 0. DISPLAY_IDENTIFIER B_KL61 ECU_ADDRESS 0xd00071b4 BIT_MASK 0x2 /end MEASUREMENT
/begin MEASUREMENT St_dgen1 "Statuswort" UBYTE _CNV_R_R_Def_dez_sl_575_CM 1 100. 0. 255. DISPLAY_IDENTIFIER ST_DGEN1 ECU_ADDRESS 0xd00071b5 FORMAT "%3.0" /end MEASUREMENT
/begin MEASUREMENT St_dgen1.B_genudiag "Bedingung Unterspannung Generator" UBYTE _CNV_S_1_Def_bit_ub_700_CM 1 100. 0. 0. DISPLAY_IDENTIFIER B_GENUDIAG ECU_ADDRESS 0xd00071b5 BIT_MASK 0x1 /end MEASUREMENT
/begin MEASUREMENT St_dibs0 "Statuswort" UBYTE _CNV_R_R_Def_dez_sl_575_CM 1 100. 0. 255. DISPLAY_IDENTIFIER ST_DIBS0 ECU_ADDRESS 0xc000455c FORMAT "%3.0" /end MEASUREMENT
/begin MEASUREMENT St_dibs0.B_dibloc1 "Signal nv lave loc zur Flankenerkennung" UBYTE _CNV_S_1_Def_bit_ub_700_CM 1 100. 0. 0. DISPLAY_IDENTIFIER B_DIBLOC1 ECU_ADDRESS 0xc000455c BIT_MASK 0x1 /end MEASUREMENT
/begin MEASUREMENT St_dibs0.B_dibloc2 "Signal nv lave loc zur Flankenerkennung" UBYTE _CNV_S_1_Def_bit_ub_700_CM 1 100. 0. 0. DISPLAY_IDENTIFIER B_DIBLOC2 ECU_ADDRESS 0xc000455c BIT_MASK 0x2 /end MEASUREMENT
/begin MEASUREMENT St_dibs1 "Statuswort" UBYTE _CNV_R_R_Def_dez_sl_575_CM 1 100. 0. 255. DISPLAY_IDENTIFIER ST_DIBS1 ECU_ADDRESS 0xd00071b8 FORMAT "%3.0" /end MEASUREMENT
/begin MEASUREMENT St_dibs1.B_ifbsak "BSD Kommunikation zum IBS gestoert" UBYTE _CNV_S_1_Def_bit_ub_700_CM 1 100. 0. 0. DISPLAY_IDENTIFIER B_IFBSAK ECU_ADDRESS 0xd00071b8 BIT_MASK 0x4 /end MEASUREMENT
/begin MEASUREMENT St_dibs1.B_ifebsak "Fehler erweiterte BSD Kommunikation zum IBS" UBYTE _CNV_S_1_Def_bit_ub_700_CM 1 100. 0. 0. DISPLAY_IDENTIFIER B_IFEBSAK ECU_ADDRESS 0xd00071b8 BIT_MASK 0x8 /end MEASUREMENT
/begin MEASUREMENT St_dibs1.B_ifuplak "Fehler IBS Version unplausibel" UBYTE _CNV_S_1_Def_bit_ub_700_CM 1 100. 0. 0. DISPLAY_IDENTIFIER B_IFUPLAK ECU_ADDRESS 0xd00071b8 BIT_MASK 0x10 /end MEASUREMENT
/begin MEASUREMENT St_dibs2 "Statuswort" UBYTE _CNV_R_R_Def_dez_sl_575_CM 1 100. 0. 255. DISPLAY_IDENTIFIER ST_DIBS2 ECU_ADDRESS 0xd00071b9 FORMAT "%3.0" /end MEASUREMENT
/begin MEASUREMENT St_dibs2.B_ifisak "IBS Stromfehler" UBYTE _CNV_S_1_Def_bit_ub_700_CM 1 100. 0. 0. DISPLAY_IDENTIFIER B_IFISAK ECU_ADDRESS 0xd00071b9 BIT_MASK 0x1 /end MEASUREMENT
/begin MEASUREMENT St_dibs2.B_ifsysak "Statuswort" UBYTE _CNV_S_1_Def_bit_ub_700_CM 1 100. 0. 0. DISPLAY_IDENTIFIER B_IFSYSAK ECU_ADDRESS 0xd00071b9 BIT_MASK 0x20 /end MEASUREMENT
/begin MEASUREMENT St_dibs2.B_iftempak "IBS Temperaturfehler" UBYTE _CNV_S_1_Def_bit_ub_700_CM 1 100. 0. 0. DISPLAY_IDENTIFIER B_IFTEMPAK ECU_ADDRESS 0xd00071b9 BIT_MASK 0x4 /end MEASUREMENT
/begin MEASUREMENT St_dibs2.B_ifusak "IBS Spannungsfehler" UBYTE _CNV_S_1_Def_bit_ub_700_CM 1 100. 0. 0. DISPLAY_IDENTIFIER B_IFUSAK ECU_ADDRESS 0xd00071b9 BIT_MASK 0x2 /end MEASUREMENT
/begin MEASUREMENT St_dibs2.B_ifwugdak "IBS KL15 Masseschluss" UBYTE _CNV_S_1_Def_bit_ub_700_CM 1 100. 0. 0. DISPLAY_IDENTIFIER B_IFWUGDAK ECU_ADDRESS 0xd00071b9 BIT_MASK 0x8 /end MEASUREMENT
/begin MEASUREMENT St_dibs2.B_ifwuplak "Statuswort" UBYTE _CNV_S_1_Def_bit_ub_700_CM 1 100. 0. 0. DISPLAY_IDENTIFIER B_IFWUPLAK ECU_ADDRESS 0xd00071b9 BIT_MASK 0x10 /end MEASUREMENT
/begin MEASUREMENT St_dqlt0 "Statuswort" UBYTE _CNV_R_R_Def_dez_sl_575_CM 1 100. 0. 255. DISPLAY_IDENTIFIER ST_DQLT0 ECU_ADDRESS 0xd0006b14 FORMAT "%3.0" /end MEASUREMENT
/begin MEASUREMENT St_dqlt0.B_ozdiagnmotok "Motordrehzahl ok für die Diagnose" UBYTE _CNV_S_1_Def_bit_ub_700_CM 1 100. 0. 0. DISPLAY_IDENTIFIER B_OZDIAGNMOTOK ECU_ADDRESS 0xd0006b14 BIT_MASK 0x80 /end MEASUREMENT
/begin MEASUREMENT St_dqlt0.B_ozerrbsd "BSD global Fehler" UBYTE _CNV_S_1_Def_bit_ub_700_CM 1 100. 0. 0. DISPLAY_IDENTIFIER B_OZERRBSD ECU_ADDRESS 0xd0006b14 BIT_MASK 0x40 /end MEASUREMENT
/begin MEASUREMENT St_dqlt0.B_ozkttoens "Töns-Sensor verbaut" UBYTE _CNV_S_1_Def_bit_ub_700_CM 1 100. 0. 0. DISPLAY_IDENTIFIER B_OZKTTOENS ECU_ADDRESS 0xd0006b14 BIT_MASK 0x20 /end MEASUREMENT
/begin MEASUREMENT St_dqlt0.B_ozlerr "Messfehler Ölniveau" UBYTE _CNV_S_1_Def_bit_ub_700_CM 1 100. 0. 0. DISPLAY_IDENTIFIER B_OZLERR ECU_ADDRESS 0xd0006b14 BIT_MASK 0x1 /end MEASUREMENT
/begin MEASUREMENT St_dqlt0.B_ozqerr "Messfehler Ölzustand" UBYTE _CNV_S_1_Def_bit_ub_700_CM 1 100. 0. 0. DISPLAY_IDENTIFIER B_OZQERR ECU_ADDRESS 0xd0006b14 BIT_MASK 0x2 /end MEASUREMENT
/begin MEASUREMENT St_dqlt0.B_ozterr "Messfehler Öltemperatur" UBYTE _CNV_S_1_Def_bit_ub_700_CM 1 100. 0. 0. DISPLAY_IDENTIFIER B_OZTERR ECU_ADDRESS 0xd0006b14 BIT_MASK 0x4 /end MEASUREMENT
/begin MEASUREMENT St_dqlt0.B_td_ogerr "Statuswort" UBYTE _CNV_S_1_Def_bit_ub_700_CM 1 100. 0. 0. DISPLAY_IDENTIFIER B_TD_OGERR ECU_ADDRESS 0xd0006b14 BIT_MASK 0x8 /end MEASUREMENT
/begin MEASUREMENT St_dqlt0.B_td_ogupl "Statuswort" UBYTE _CNV_S_1_Def_bit_ub_700_CM 1 100. 0. 0. DISPLAY_IDENTIFIER B_TD_OGUPL ECU_ADDRESS 0xd0006b14 BIT_MASK 0x10 /end MEASUREMENT
/begin MEASUREMENT St_dqlt1 "Statuswort" UBYTE _CNV_R_R_Def_dez_sl_575_CM 1 100. 0. 255. DISPLAY_IDENTIFIER ST_DQLT1 ECU_ADDRESS 0xd0006b15 FORMAT "%3.0" /end MEASUREMENT
/begin MEASUREMENT St_dqlt1.B_ozerr "Sensorfehler in FS eingetragen" UBYTE _CNV_S_1_Def_bit_ub_700_CM 1 100. 0. 0. DISPLAY_IDENTIFIER B_OZERR ECU_ADDRESS 0xd0006b15 BIT_MASK 0x1 /end MEASUREMENT
/begin MEASUREMENT St_dqlt1.B_ozfbsd2 "BSD Sensor Fehler von FI_BSD_4" UBYTE _CNV_S_1_Def_bit_ub_700_CM 1 100. 0. 0. DISPLAY_IDENTIFIER B_OZFBSD2 ECU_ADDRESS 0xd0006b15 BIT_MASK 0x2 /end MEASUREMENT
/begin MEASUREMENT St_dqlt1.B_oztemppl "QLT Temperatur unplausibel" UBYTE _CNV_S_1_Def_bit_ub_700_CM 1 100. 0. 0. DISPLAY_IDENTIFIER B_OZTEMPPL ECU_ADDRESS 0xd0006b15 BIT_MASK 0x4 /end MEASUREMENT
/begin MEASUREMENT St_fe "Status Fe" UBYTE _CNV_R_R_Def_dez_sl_575_CM 1 100. 0. 255. DISPLAY_IDENTIFIER ST_FE ECU_ADDRESS 0xd00079c0 FORMAT "%3.0" /end MEASUREMENT
/begin MEASUREMENT St_fe.B_tvdpsrfvw "Fehler bei Fuellungerfassung" UBYTE _CNV_S_1_Def_bit_ub_700_CM 1 100. 0. 0. DISPLAY_IDENTIFIER B_TVDPSRFVW ECU_ADDRESS 0xd00079c0 BIT_MASK 0x1 /end MEASUREMENT
/begin MEASUREMENT St_gen "Generatorstatus" UBYTE _CNV_R_R_Def_dez_sl_575_CM 1 100. 0. 255. DISPLAY_IDENTIFIER ST_GEN ECU_ADDRESS 0xc0001370 FORMAT "%3.0" /end MEASUREMENT
/begin MEASUREMENT St_genbsd "" UWORD _CNV_R_R_Def_dez_sl_575_CM 1 100. 0. 65535. DISPLAY_IDENTIFIER ST_GENBSD ECU_ADDRESS 0xc0001372 FORMAT "%5.0" /end MEASUREMENT
/begin MEASUREMENT St_gengen "" UWORD _CNV_R_R_Def_dez_sl_575_CM 1 100. 0. 65535. DISPLAY_IDENTIFIER ST_GENGEN ECU_ADDRESS 0xc0001374 FORMAT "%5.0" /end MEASUREMENT
/begin MEASUREMENT St_oz_o "Statuswort" UBYTE _CNV_R_R_Def_dez_sl_575_CM 1 100. 0. 255. DISPLAY_IDENTIFIER ST_OZ_O ECU_ADDRESS 0xd0006b16 FORMAT "%3.0" /end MEASUREMENT
/begin MEASUREMENT St_oz_o.B_mol_sf "Sensorfehler in FS eingetragen für CC-Meldung" UBYTE _CNV_S_1_Def_bit_ub_700_CM 1 100. 0. 0. DISPLAY_IDENTIFIER B_MOL_SF ECU_ADDRESS 0xd0006b16 BIT_MASK 0x2 /end MEASUREMENT
/begin MEASUREMENT St_oz_o.B_oztemic "QLT-Temic verbaut" UBYTE _CNV_S_1_Def_bit_ub_700_CM 1 100. 0. 0. DISPLAY_IDENTIFIER B_OZTEMIC ECU_ADDRESS 0xd0006b16 BIT_MASK 0x1 /end MEASUREMENT
/begin MEASUREMENT St_tdnvvaus "" UBYTE _CNV_R_R_Def_dez_sl_575_CM 1 100. 0. 255. DISPLAY_IDENTIFIER ST_TDNVVAUS ECU_ADDRESS 0xd00069af FORMAT "%3.0" /end MEASUREMENT
/begin MEASUREMENT St_tdnvvein "" UBYTE _CNV_R_R_Def_dez_sl_575_CM 1 100. 0. 255. DISPLAY_IDENTIFIER ST_TDNVVEIN ECU_ADDRESS 0xd00069ae FORMAT "%3.0" /end MEASUREMENT
/begin MEASUREMENT T_count_dibs1 "" UBYTE _CNV_R_R_DEZ_436_CM 1 100. 0. 255. DISPLAY_IDENTIFIER T_COUNT_DIBS1 ECU_ADDRESS 0xc000137e /end MEASUREMENT
/begin MEASUREMENT T_count_dibs2 "" UBYTE _CNV_R_R_DEZ_436_CM 1 100. 0. 255. DISPLAY_IDENTIFIER T_COUNT_DIBS2 ECU_ADDRESS 0xc000137f /end MEASUREMENT
/begin MEASUREMENT T_count_dibs3 "" UBYTE _CNV_R_R_Def_dez_sl_575_CM 1 100. 0. 255. DISPLAY_IDENTIFIER T_COUNT_DIBS3 ECU_ADDRESS 0xc0001380 FORMAT "%3.0" /end MEASUREMENT
/begin MEASUREMENT T_count_dibs4 "" UBYTE _CNV_R_R_Def_dez_sl_575_CM 1 100. 0. 255. DISPLAY_IDENTIFIER T_COUNT_DIBS4 ECU_ADDRESS 0xc0001381 FORMAT "%3.0" /end MEASUREMENT
/begin MEASUREMENT T_zkvnsi "Zeitkonstante fuer 10ms Filterzyklus" UWORD _CNV_R_R_Def_zk10ms_709_CM 1 100. 1.e-002 655.36 DISPLAY_IDENTIFIER T_ZKVNSI ECU_ADDRESS 0xd0007b0c FORMAT "%9.4" /end MEASUREMENT
/begin MEASUREMENT Tabg2tabg_wzinv "" UWORD _CNV_R_R_Def_f_uw_b_710_CM 1 100. 0. 0.499992370605469 DISPLAY_IDENTIFIER TABG2TABG_WZINV ECU_ADDRESS 0xd000708a FORMAT "%14.6" /end MEASUREMENT
/begin MEASUREMENT Tabg_mw "Mittelwert Abgastemperatur" SWORD _CNV_R_R_Def_t_sw_q_618_CM 1 100. -3276.8 3276.7 DISPLAY_IDENTIFIER TABG_MW ECU_ADDRESS 0xd000706e FORMAT "%6.1" /end MEASUREMENT
/begin MEASUREMENT Tevt_mdl "Temperatur am Einlassventil modelliert" SWORD _CNV_R_R_Def_t_sw_q_618_CM 1 100. -3276.8 3276.7 DISPLAY_IDENTIFIER TEVT_MDL ECU_ADDRESS 0xc0000f98 FORMAT "%6.1" /end MEASUREMENT
/begin MEASUREMENT Tmot_fil_tempk "Motortemperatur gefiltert" SWORD _CNV_R_R_Def_t_sw_q_618_CM 1 100. -3276.8 3276.7 DISPLAY_IDENTIFIER TMOT_FIL_TEMPK ECU_ADDRESS 0xc00046a4 FORMAT "%6.1" /end MEASUREMENT
/begin MEASUREMENT Tseg_sec "Segmentzeit" UWORD _CNV_R_R_Def_f_uw_b_713_CM 1 100. 0. 0.124998092651367 DISPLAY_IDENTIFIER TSEG_SEC ECU_ADDRESS 0xd0007066 FORMAT "%14.6" /end MEASUREMENT
/begin MEASUREMENT Tsr_ges "Gesamttemperatur im Saugrohr (nach AGR-Einleitung)" SWORD _CNV_R_R_Def_t_sw_q_618_CM 1 100. -3276.8 3276.7 DISPLAY_IDENTIFIER TSR_GES ECU_ADDRESS 0xc0000fac FORMAT "%6.1" /end MEASUREMENT
/begin MEASUREMENT Twdk "Zeitkonstante Drosseklappesollwertfilter" UWORD _CNV_R_R_Def_zk10ms_709_CM 1 100. 1.e-002 655.36 DISPLAY_IDENTIFIER TWDK ECU_ADDRESS 0xd0007aa0 FORMAT "%9.4" /end MEASUREMENT
/begin MEASUREMENT Vnscnt "Fehlerzähler Vanosistposition ausserhalb Fenster" UBYTE _CNV_R_R_Def_dez_sl_575_CM 1 100. 0. 255. DISPLAY_IDENTIFIER VNSCNT ECU_ADDRESS 0xd0007988 FORMAT "%3.0" ARRAY_SIZE 2 MATRIX_DIM 2 1 1 /end MEASUREMENT
/begin MEASUREMENT Vnscnt_nio "Fehlerzähler RBM completed für Reglerüberwachung" UBYTE _CNV_R_R_Def_dez_sl_575_CM 1 100. 0. 255. DISPLAY_IDENTIFIER VNSCNT_NIO ECU_ADDRESS 0xd000798a FORMAT "%3.0" ARRAY_SIZE 2 MATRIX_DIM 2 1 1 /end MEASUREMENT
/begin MEASUREMENT Vol_verh_a "Volumen Verhältnis Auslaß" SWORD _CNV_R_R_Def_f_sw_b_608_CM 1 100. -2. 1.9999 DISPLAY_IDENTIFIER VOL_VERH_A ECU_ADDRESS 0xd0007b06 FORMAT "%14.5" /end MEASUREMENT
/begin MEASUREMENT Vol_verh_e "Volumen Verhältnis Einlaß" UWORD _CNV_R_R_Def_f_sw_b_608_CM 1 100. 0. 3.9999 DISPLAY_IDENTIFIER VOL_VERH_E ECU_ADDRESS 0xd0007b04 FORMAT "%14.5" /end MEASUREMENT
/begin MEASUREMENT Vsa_spr "" UWORD _CNV_R_R_Def_spr_sw_583_CM 1 100. 0. 6553.5 DISPLAY_IDENTIFIER VSA_SPR ECU_ADDRESS 0xd0007afa FORMAT "%7.2" /end MEASUREMENT
/begin MEASUREMENT Vsa_spris "" UWORD _CNV_R_R_Def_spr_sw_583_CM 1 100. 0. 6553.5 DISPLAY_IDENTIFIER VSA_SPRIS ECU_ADDRESS 0xd0007af8 FORMAT "%7.2" /end MEASUREMENT
/begin MEASUREMENT Vsasprn "" UWORD _CNV_R_R_Def_spr_sw_583_CM 1 100. 0. 6553.5 DISPLAY_IDENTIFIER VSASPRN ECU_ADDRESS 0xd0007af4 FORMAT "%7.2" /end MEASUREMENT
/begin MEASUREMENT Vse_spr "" UWORD _CNV_R_R_Def_spr_sw_583_CM 1 100. 0. 6553.5 DISPLAY_IDENTIFIER VSE_SPR ECU_ADDRESS 0xd0007afc FORMAT "%7.2" /end MEASUREMENT
/begin MEASUREMENT Vse_spris "" UWORD _CNV_R_R_Def_spr_sw_583_CM 1 100. 0. 6553.5 DISPLAY_IDENTIFIER VSE_SPRIS ECU_ADDRESS 0xd0007af6 FORMAT "%7.2" /end MEASUREMENT
/begin MEASUREMENT Vsesprn "" UWORD _CNV_R_R_Def_spr_sw_583_CM 1 100. 0. 6553.5 DISPLAY_IDENTIFIER VSESPRN ECU_ADDRESS 0xd0007af2 FORMAT "%7.2" /end MEASUREMENT
/begin MEASUREMENT Vsldn "Normierter Volumenstrom ueber den ATL" UWORD _CNV_R_R_Def_vs_uw__731_CM 1 100. 0. 1279.9804 DISPLAY_IDENTIFIER VSLDN ECU_ADDRESS 0xd0006a62 FORMAT "%7.2" /end MEASUREMENT
/begin MEASUREMENT Vsvld "Volumenstrom vor Verdichter" UWORD _CNV_R_R_Def_vs_uw__731_CM 1 100. 0. 1279.9804 DISPLAY_IDENTIFIER VSVLD ECU_ADDRESS 0xd0006a64 FORMAT "%7.2" /end MEASUREMENT
/begin MEASUREMENT Vsvld_f "Volumenstrom vor Verdichter - gefiltert" UWORD _CNV_R_R_Def_vs_uw__731_CM 1 100. 0. 1279.9804 DISPLAY_IDENTIFIER VSVLD_F ECU_ADDRESS 0xd0006a38 FORMAT "%7.2" /end MEASUREMENT
/begin MEASUREMENT Vvt_ib1_2 "Gesamtstrom VVT Bank1 bzw 4Zyl. und Bank2" UWORD _CNV_R_R_Def_i_uw_q_644_CM 1 100. 0. 4095.9375 DISPLAY_IDENTIFIER VVT_IB1_2 ECU_ADDRESS 0xc0000eea FORMAT "%8.3" /end MEASUREMENT
/begin MEASUREMENT Vvt_iges "Strombedarf des gesamten VVT-Systems" UWORD _CNV_R_R_Def_i_uw_q_644_CM 1 100. 0. 192. DISPLAY_IDENTIFIER VVT_IGES ECU_ADDRESS 0xc0000eec FORMAT "%8.3" /end MEASUREMENT
/begin MEASUREMENT Wdk_soll "Sollwert DK-Winkel, bezogen auf unteren Anschlag gefiltert" UWORD _CNV_R_R_Def_wdk_sw_691_CM 1 100. 0. 1599.9755 DISPLAY_IDENTIFIER WDK_SOLL ECU_ADDRESS 0xd0007a88 FORMAT "%7.2" /end MEASUREMENT
/begin MEASUREMENT Wdk_soll_gd "Sollwert DK-Winkel, bezogen auf unteren Anschlag GD" UWORD _CNV_R_R_Def_wdk_sw_691_CM 1 100. 0. 1599.9755 DISPLAY_IDENTIFIER WDK_SOLL_GD ECU_ADDRESS 0xd0007ab6 FORMAT "%7.2" /end MEASUREMENT
/begin MEASUREMENT Wdk_soll_transvl "" UWORD _CNV_R_R_Def_wdk_sw_691_CM 1 100. 0. 1599.9755 DISPLAY_IDENTIFIER WDK_SOLL_TRANSVL ECU_ADDRESS 0xd0007abc FORMAT "%7.2" /end MEASUREMENT
/begin MEASUREMENT Wdk_soll_trvlbas "" UWORD _CNV_R_R_Def_wdk_sw_691_CM 1 100. 0. 1599.9755 DISPLAY_IDENTIFIER WDK_SOLL_TRVLBAS ECU_ADDRESS 0xd0007a8e FORMAT "%7.2" /end MEASUREMENT
/begin MEASUREMENT Wdk_soll_uebl "Sollwert DK-Winkel übergeblendet GD-UGD" UWORD _CNV_R_R_Def_wdk_sw_691_CM 1 100. 0. 1599.9755 DISPLAY_IDENTIFIER WDK_SOLL_UEBL ECU_ADDRESS 0xd0007a8c FORMAT "%7.2" /end MEASUREMENT
/begin MEASUREMENT Wdk_soll_uf "Sollwert DK-Winkel, bezogen auf unteren Anschlag vor Filter" UWORD _CNV_R_R_Def_wdk_sw_691_CM 1 100. 0. 1599.9755 DISPLAY_IDENTIFIER WDK_SOLL_UF ECU_ADDRESS 0xd0007a8a FORMAT "%7.2" /end MEASUREMENT
/begin MEASUREMENT Wdk_soll_ug "Sollwert DK-Winkel, bezogen auf unteren Anschlag UGD" UWORD _CNV_R_R_Def_wdk_sw_691_CM 1 100. 0. 1599.9755 DISPLAY_IDENTIFIER WDK_SOLL_UG ECU_ADDRESS 0xd0007ab4 FORMAT "%7.2" /end MEASUREMENT
/begin MEASUREMENT Wdk_soll_uverz "Sollwert DK-Winkel, unverzögert" UWORD _CNV_R_R_Def_wdk_sw_691_CM 1 100. 0. 1599.9755 DISPLAY_IDENTIFIER WDK_SOLL_UVERZ ECU_ADDRESS 0xd0007ab2 FORMAT "%7.2" /end MEASUREMENT
/begin MEASUREMENT Wdk_som "Sollwert DK-Winkel bei KL15 aus" UWORD _CNV_R_R_Def_wdk_sw_691_CM 1 100. 0. 1599.9755 DISPLAY_IDENTIFIER WDK_SOM ECU_ADDRESS 0xd0007ab8 FORMAT "%7.2" /end MEASUREMENT
/begin MEASUREMENT Wdks_vl "Sollwert DK-Winkel bei Volllast" UWORD _CNV_R_R_Def_wdk_sw_691_CM 1 100. 0. 1599.9755 DISPLAY_IDENTIFIER WDKS_VL ECU_ADDRESS 0xd0007aba FORMAT "%7.2" /end MEASUREMENT
/begin MEASUREMENT Wstg_s "Modell Druckstangenweg der Wastegatebetätigung" UWORD _CNV_R_R_Def_f_uw_b_576_CM 1 100. 0. 99.9984 DISPLAY_IDENTIFIER WSTG_S ECU_ADDRESS 0xd000708c FORMAT "%8.3" /end MEASUREMENT
/begin MEASUREMENT Wstg_s_vf "Modell Druckstangenweg der Wastegatebetätigung vor Filter" UWORD _CNV_R_R_Def_f_uw_b_576_CM 1 100. 0. 99.9984 DISPLAY_IDENTIFIER WSTG_S_VF ECU_ADDRESS 0xd000708e FORMAT "%8.3" /end MEASUREMENT
/begin MEASUREMENT Zgsplddgrd "Schreibzeiger für Druckgrad. Zwischenspeicher" UBYTE _CNV_R_R_Def_dez_sl_575_CM 1 100. 0. 255. DISPLAY_IDENTIFIER ZGSPLDDGRD ECU_ADDRESS 0xd0006a66 FORMAT "%3.0" /end MEASUREMENT
/begin MEASUREMENT Zw_mw1 "Zündwinkel Mittelwert Bank1" SWORD _CNV_R_R_Def_zw_sw__599_CM 1 100. -3276.8 3276.7 DISPLAY_IDENTIFIER ZW_MW1 ECU_ADDRESS 0xd0006a2a FORMAT "%6.1" /end MEASUREMENT
/begin MEASUREMENT Zw_mw2 "Zündwinkel Mittelwert Bank2" SWORD _CNV_R_R_Def_zw_sw__599_CM 1 100. -3276.8 3276.7 DISPLAY_IDENTIFIER ZW_MW2 ECU_ADDRESS 0xd0006a2c FORMAT "%6.1" /end MEASUREMENT
/begin CHARACTERISTIC CW_BGKUPPL "Codewort modellierter Kupplungsschalter aktiv" VALUE 0xa100b19c _REC_VAL_20_u1 99.45 _CNV_R_R_Def_dez_sl_575_CM 0. 255. FORMAT "%3.0" /end CHARACTERISTIC
/begin CHARACTERISTIC CW_DEAVANOS "Codewort Vanosdiagnose" VALUE 0xa101e82c _REC_VAL_20_u1 99.45 _CNV_R_R_Def_dez_sl_575_CM 0. 255. FORMAT "%3.0" /end CHARACTERISTIC
/begin CHARACTERISTIC CW_DKAPP "Codewort Applikation ohne Drehmomentfunktion" VALUE 0xa101ee06 _REC_VAL_20_u1 99.45 _CNV_R_R_Def_dez_sl_575_CM 0. 255. FORMAT "%3.0" /end CHARACTERISTIC
/begin CHARACTERISTIC CW_HUBAPP "Codewort Applikation ohne Drehmomentfunktion" VALUE 0xa101f7a0 _REC_VAL_20_u1 2. _CNV_R_R_Def_dez_sl_575_CM 0. 2. FORMAT "%3.0" /end CHARACTERISTIC
/begin CHARACTERISTIC CW_LLBITINT "Codewort Ll-Bit" VALUE 0xa100b19d _REC_VAL_20_u1 99.45 _CNV_R_R_Def_dez_sl_575_CM 0. 255. FORMAT "%3.0" /end CHARACTERISTIC
/begin CHARACTERISTIC CW_MS_AK_MAN "Auswahl zufließender Massenstrom" VALUE 0xa1012f96 _REC_VAL_20_u1 2. _CNV_R_R_Def_dez_sl_575_CM 0. 2. FORMAT "%3.0" /end CHARACTERISTIC
/begin CHARACTERISTIC CW_MS_TURB_MAN "Auswahl Turbinenmassenstrom" VALUE 0xa101300a _REC_VAL_20_u1 2. _CNV_R_R_Def_dez_sl_575_CM 0. 2. FORMAT "%3.0" /end CHARACTERISTIC
/begin CHARACTERISTIC KF_ANFLVNS "Wichtung Flächenanteil" MAP 0xa101fcfc _REC_MAP_52_UBYTE_u2_s2_s2 3.9999 _CNV_R_R_Def_f_sw_b_608_CM 0. 3.9999 FORMAT "%14.5"
 /begin AXIS_DESCR STD_AXIS Nkw _CNV_R_R_Def_n_sw_q_612_CM 12 -32768. 32767. FORMAT "%5.0" /end AXIS_DESCR
 /begin AXIS_DESCR STD_AXIS Rfv_soll _CNV_R_R_Def_rf_sw__616_CM 12 -327.68 327.67 FORMAT "%7.4" /end AXIS_DESCR
/end CHARACTERISTIC
/begin CHARACTERISTIC KF_ASVNS "Wichtung AS-Volumen" MAP 0xa101fe50 _REC_MAP_52_UBYTE_s2_s2_s2 7.999800000000001 _CNV_R_R_Def_f_sw_b_606_CM -4. 3.9998 FORMAT "%7.4"
 /begin AXIS_DESCR STD_AXIS Nkw _CNV_R_R_Def_n_sw_q_612_CM 6 -32768. 32767. FORMAT "%5.0" /end AXIS_DESCR
 /begin AXIS_DESCR STD_AXIS Rfv_soll _CNV_R_R_Def_rf_sw__616_CM 6 -327.68 327.67 FORMAT "%7.4" /end AXIS_DESCR
/end CHARACTERISTIC
/begin CHARACTERISTIC KF_ATLRI_MN "Min Limit I Anteil" MAP 0xa100be90 _REC_MAP_52_UBYTE_s2_s2_s2 99.99844999999999 _CNV_R_R_Def_rel_sw_584_CM -100. 99.9969
 /begin AXIS_DESCR STD_AXIS Nkw_dyn _CNV_R_R_Def_n_sw_q_612_CM 8 -32768. 32767. FORMAT "%5.0" /end AXIS_DESCR
 /begin AXIS_DESCR STD_AXIS Pldrsoll_dyn _CNV_R_R_Def_p_sw_q_578_CM 8 -1280. 1279.9609 FORMAT "%5.2" /end AXIS_DESCR
/end CHARACTERISTIC
/begin CHARACTERISTIC KF_ATLRI_MX "Max Limit I Anteil" MAP 0xa100bf34 _REC_MAP_52_UBYTE_s2_s2_s2 99.99844999999999 _CNV_R_R_Def_rel_sw_584_CM -100. 99.9969
 /begin AXIS_DESCR STD_AXIS Nkw_dyn _CNV_R_R_Def_n_sw_q_612_CM 8 -32768. 32767. FORMAT "%5.0" /end AXIS_DESCR
 /begin AXIS_DESCR STD_AXIS Pldrsoll_dyn _CNV_R_R_Def_p_sw_q_578_CM 8 -1280. 1279.9609 FORMAT "%5.2" /end AXIS_DESCR
/end CHARACTERISTIC
/begin CHARACTERISTIC KF_ATLR_P "ATL-Regler - P Anteil ohne Vorsteuergröße" MAP 0xa100ba94 _REC_MAP_52_UBYTE_s2_s2_s2 99.99844999999999 _CNV_R_R_Def_rel_sw_584_CM -100. 99.9969
 /begin AXIS_DESCR STD_AXIS Nkw _CNV_R_R_Def_n_sw_q_612_CM 12 -32768. 32767. FORMAT "%5.0" /end AXIS_DESCR
 /begin AXIS_DESCR STD_AXIS Pld_diff_fil _CNV_R_R_Def_p_sw_q_614_CM 12 -2560. 2559.9218 FORMAT "%5.2" /end AXIS_DESCR
/end CHARACTERISTIC
/begin CHARACTERISTIC KF_ATLVST "ATL-Regler - Vorsteuerung" MAP 0xa100b60c _REC_MAP_52_UBYTE_u2_u2_u2 99.9984 _CNV_R_R_Def_f_uw_b_576_CM 0. 99.9984
 /begin AXIS_DESCR STD_AXIS F_pldsvld_f _CNV_R_R_Def_f_sw_b_608_CM 16 0. 3.9999 FORMAT "%14.5" /end AXIS_DESCR
 /begin AXIS_DESCR STD_AXIS Vsvld_f _CNV_R_R_Def_vs_uw__731_CM 16 0. 1279.9804 FORMAT "%5.2" /end AXIS_DESCR
/end CHARACTERISTIC
/begin CHARACTERISTIC KF_ATLVST_GD "ATL-Regler - Vorsteuerung - gedrosselter Betrieb" MAP 0xa100b568 _REC_MAP_52_UBYTE_u2_u2_u2 99.9984 _CNV_R_R_Def_f_uw_b_576_CM 0. 99.9984
 /begin AXIS_DESCR STD_AXIS F_psspu _CNV_R_R_Def_f_uw_b_579_CM 8 0. 1.9999 FORMAT "%14.5" /end AXIS_DESCR
 /begin AXIS_DESCR STD_AXIS Vsvld_f _CNV_R_R_Def_vs_uw__731_CM 8 0. 1279.9804 FORMAT "%5.2" /end AXIS_DESCR
/end CHARACTERISTIC
/begin CHARACTERISTIC KF_ATLVST_NKW "ATL-Regler - Vorsteuerung ohne Höheneinfluss" MAP 0xa100b850 _REC_MAP_52_UBYTE_u2_u2_s2 99.9984 _CNV_R_R_Def_f_uw_b_576_CM 0. 99.9984
 /begin AXIS_DESCR STD_AXIS F_pldsvld_f _CNV_R_R_Def_f_sw_b_608_CM 16 0. 3.9999 FORMAT "%14.5" /end AXIS_DESCR
 /begin AXIS_DESCR STD_AXIS Nkw _CNV_R_R_Def_n_sw_q_612_CM 16 -32768. 32767. FORMAT "%5.0" /end AXIS_DESCR
/end CHARACTERISTIC
/begin CHARACTERISTIC KF_AUSY_TURB "Durchflusskennlinie Turbine" MAP 0xa1013150 _REC_MAP_52_UBYTE_u2_u2_u2 0.9999847412109381 _CNV_R_R_Def_f_uw_b_591_CM 0. 0.9999847412109381 FORMAT "%14.5"
 /begin AXIS_DESCR STD_AXIS Prat_turb _CNV_R_R_Def_f_sw_b_608_CM 9 0. 3.9999 FORMAT "%14.5" /end AXIS_DESCR
 /begin AXIS_DESCR STD_AXIS NO_INPUT_QUANTITY _CNV_R_R_Def_f_uw_b_576_CM 8 0. 99.9984 /end AXIS_DESCR
/end CHARACTERISTIC
/begin CHARACTERISTIC KF_AUSY_TURB_DIFF "Ableitung der Durchflusskennlinie Turbine" MAP 0xa1013204 _REC_MAP_52_UBYTE_s2_u2_u2 3.9999 _CNV_R_R_Def_f_sw_b_608_CM -2. 1.9999 FORMAT "%14.5"
 /begin AXIS_DESCR STD_AXIS Prat_turb _CNV_R_R_Def_f_sw_b_608_CM 8 0. 3.9999 FORMAT "%14.5" /end AXIS_DESCR
 /begin AXIS_DESCR STD_AXIS NO_INPUT_QUANTITY _CNV_R_R_Def_f_uw_b_576_CM 8 0. 99.9984 /end AXIS_DESCR
/end CHARACTERISTIC
/begin CHARACTERISTIC KF_DISA "" MAP 0xa10203bc _REC_MAP_52_UBYTE_u2_s2_u2 1.9999 _CNV_R_R_Def_f_uw_b_579_CM 0. 1.9999 FORMAT "%14.5"
 /begin AXIS_DESCR STD_AXIS Nkw _CNV_R_R_Def_n_sw_q_612_CM 8 -32768. 32767. FORMAT "%5.0" /end AXIS_DESCR
 /begin AXIS_DESCR STD_AXIS F_rfsoll_vl _CNV_R_R_Def_f_uw_b_579_CM 6 0. 1.9999 FORMAT "%14.5" /end AXIS_DESCR
/end CHARACTERISTIC
/begin CHARACTERISTIC KF_DKST "Kennfeld Drosselklappensollwinkel" MAP 0xa101f0b4 _REC_MAP_52_UBYTE_u2_s2_s2 95.99852999999999 _CNV_R_R_Def_wdk_sw_691_CM 0. 1599.9755 FORMAT "%5.2"
 /begin AXIS_DESCR STD_AXIS Nkw _CNV_R_R_Def_n_sw_q_612_CM 10 -32768. 32767. FORMAT "%5.0" /end AXIS_DESCR
 /begin AXIS_DESCR STD_AXIS Tmot _CNV_R_R_Def_t_sw_q_620_CM 10 -327.68 327.67 FORMAT "%5.2" /end AXIS_DESCR
/end CHARACTERISTIC
/begin CHARACTERISTIC KF_DPBKVDOWN "Kennfeld Bremsunterdruckabbau" MAP 0xa100cc9c _REC_MAP_52_UBYTE_s2_s2_u1 120. _CNV_R_R_Def_p_sw_q_613_CM -2000. 2000. FORMAT "%5.2"
 /begin AXIS_DESCR STD_AXIS Dpbkv _CNV_R_R_Def_p_sw_q_613_CM 6 -3276.8 3276.7 FORMAT "%5.2" /end AXIS_DESCR
 /begin AXIS_DESCR STD_AXIS Pbrems _CNV_R_R_Def_p_ub_q_686_CM 6 0. 99.60930000000001 FORMAT "%5.2" /end AXIS_DESCR
/end CHARACTERISTIC
/begin CHARACTERISTIC KF_DPBKVUP "Kennfeld Bremsunterdruckaufbau" MAP 0xa100cc38 _REC_MAP_52_UBYTE_s2_s2_s2 120. _CNV_R_R_Def_p_sw_q_613_CM -2000. 2000. FORMAT "%5.2"
 /begin AXIS_DESCR STD_AXIS Dpbkv _CNV_R_R_Def_p_sw_q_613_CM 6 -3276.8 3276.7 FORMAT "%5.2" /end AXIS_DESCR
 /begin AXIS_DESCR STD_AXIS Nkw _CNV_R_R_Def_n_sw_q_612_CM 6 -32768. 32767. FORMAT "%5.0" /end AXIS_DESCR
/end CHARACTERISTIC
/begin CHARACTERISTIC KF_DPS "Diffdruck Vvt" MAP 0xa101eaf8 _REC_MAP_52_UBYTE_s2_s2_s2 102.398436 _CNV_R_R_Def_p_sw_q_578_CM -1280. 1279.9609 FORMAT "%5.2"
 /begin AXIS_DESCR STD_AXIS Nkw _CNV_R_R_Def_n_sw_q_612_CM 8 -32768. 32767. FORMAT "%5.0" /end AXIS_DESCR
 /begin AXIS_DESCR STD_AXIS Rfv_soll _CNV_R_R_Def_rf_sw__616_CM 8 -327.68 327.67 FORMAT "%7.4" /end AXIS_DESCR
/end CHARACTERISTIC
/begin CHARACTERISTIC KF_DPSST "Diffdruck Vvt" MAP 0xa101eb9c _REC_MAP_52_UBYTE_s2_s2_s2 102.398436 _CNV_R_R_Def_p_sw_q_578_CM -1280. 1279.9609 FORMAT "%5.2"
 /begin AXIS_DESCR STD_AXIS Nkw _CNV_R_R_Def_n_sw_q_612_CM 8 -32768. 32767. FORMAT "%5.0" /end AXIS_DESCR
 /begin AXIS_DESCR STD_AXIS Tmot _CNV_R_R_Def_t_sw_q_620_CM 8 -327.68 327.67 FORMAT "%5.2" /end AXIS_DESCR
/end CHARACTERISTIC
/begin CHARACTERISTIC KF_DPSTE "Diffdruck Vvt" MAP 0xa101ece4 _REC_MAP_52_UBYTE_s2_u2_s2 102.398436 _CNV_R_R_Def_p_sw_q_578_CM -1280. 1279.9609 FORMAT "%5.2" /begin AXIS_DESCR STD_AXIS Msdk _CNV_R_R_Def_ms_uw__611_CM 4 0. 2047.9687 /end AXIS_DESCR
 /begin AXIS_DESCR STD_AXIS F_teblgmod _CNV_R_R_Def_f_sw_b_634_CM 4 -64. 63.998 /end AXIS_DESCR
/end CHARACTERISTIC
/begin CHARACTERISTIC KF_ELUPWM39 "Strom E-Lüfter über pwm und ub" MAP 0xa1014a40 _REC_MAP_52_UBYTE_u2_u1_u2 64. _CNV_R_R_Def_i_uw_q_644_CM 0. 64.
 /begin AXIS_DESCR STD_AXIS L_pwmout _CNV_R_R_Def_f_ub_b_602_CM 8 0. 99.60930000000001 FORMAT "%5.2" /end AXIS_DESCR
 /begin AXIS_DESCR STD_AXIS NO_INPUT_QUANTITY _CNV_R_R_Def_v_uw_q_723_CM 8 0. 360. FORMAT "%5.0" /end AXIS_DESCR
/end CHARACTERISTIC
/begin CHARACTERISTIC KF_ELUPWM60 "Strom E-Lüfter über pwm und ub" MAP 0xa10149a4 _REC_MAP_52_UBYTE_u2_u1_u2 64. _CNV_R_R_Def_i_uw_q_644_CM 0. 64.
 /begin AXIS_DESCR STD_AXIS L_pwmout _CNV_R_R_Def_f_ub_b_602_CM 8 0. 99.60930000000001 FORMAT "%5.2" /end AXIS_DESCR
 /begin AXIS_DESCR STD_AXIS NO_INPUT_QUANTITY _CNV_R_R_Def_v_uw_q_723_CM 8 0. 360. FORMAT "%5.0" /end AXIS_DESCR
/end CHARACTERISTIC
/begin CHARACTERISTIC KF_ESVNS "Wichtung ES-Volumen" MAP 0xa101feb4 _REC_MAP_52_UBYTE_u2_s2_s2 3.9999 _CNV_R_R_Def_f_sw_b_608_CM 0. 3.9999 FORMAT "%14.5"
 /begin AXIS_DESCR STD_AXIS Nkw _CNV_R_R_Def_n_sw_q_612_CM 6 -32768. 32767. FORMAT "%5.0" /end AXIS_DESCR
 /begin AXIS_DESCR STD_AXIS Rfv_soll _CNV_R_R_Def_rf_sw__616_CM 6 -327.68 327.67 FORMAT "%7.4" /end AXIS_DESCR
/end CHARACTERISTIC
/begin CHARACTERISTIC KF_FATLRD "Faktor D-Anteil - Gradient d. Regelabweichung" MAP 0xa100bfd8 _REC_MAP_52_UBYTE_s2_s2_s2 99.83843999999999 _CNV_R_R_Def_f_sw_b_634_CM -64. 63.998
 /begin AXIS_DESCR STD_AXIS Pld_diff _CNV_R_R_Def_p_sw_q_614_CM 14 -2560. 2559.9218 FORMAT "%5.2" /end AXIS_DESCR
 /begin AXIS_DESCR STD_AXIS Pld_diff_grd _CNV_R_R_Def_p_sw_q_614_CM 14 -2560. 2559.9218 FORMAT "%5.2" /end AXIS_DESCR
/end CHARACTERISTIC
/begin CHARACTERISTIC KF_FATLR_I "Verstärkung Regeldifferenz - I Anteil" MAP 0xa100bd3c _REC_MAP_52_UBYTE_u2_s2_s2 0.9999 _CNV_R_R_Def_f_uw_b_591_CM 0. 0.9999 FORMAT "%14.5"
 /begin AXIS_DESCR STD_AXIS Nkw _CNV_R_R_Def_n_sw_q_612_CM 12 -32768. 32767. FORMAT "%5.0" /end AXIS_DESCR
 /begin AXIS_DESCR STD_AXIS Pld_diff_fil _CNV_R_R_Def_p_sw_q_614_CM 12 -2560. 2559.9218 FORMAT "%5.2" /end AXIS_DESCR
/end CHARACTERISTIC
/begin CHARACTERISTIC KF_FATLR_P "Faktor Verstärkung der Vorsteuergröße" MAP 0xa100bbe8 _REC_MAP_52_UBYTE_s2_s2_s2 63.999 _CNV_R_R_Def_f_sw_b_577_CM -32. 31.999 FORMAT "%7.4"
 /begin AXIS_DESCR STD_AXIS Nkw _CNV_R_R_Def_n_sw_q_612_CM 12 -32768. 32767. FORMAT "%5.0" /end AXIS_DESCR
 /begin AXIS_DESCR STD_AXIS Pld_diff_fil _CNV_R_R_Def_p_sw_q_614_CM 12 -2560. 2559.9218 FORMAT "%5.2" /end AXIS_DESCR
/end CHARACTERISTIC
/begin CHARACTERISTIC KF_FLAEAN "Kennfeld konstante Ansaugfläche" MAP 0xa101fab8 _REC_MAP_52_UBYTE_u2_u2_u2 104.856 _CNV_R_R_Def_flae_u_654_CM 0. 1048.56 FORMAT "%5.2"
 /begin AXIS_DESCR STD_AXIS Hubev_soll_kf _CNV_R_R_Def_hub_uw_605_CM 16 0. 65.535 /end AXIS_DESCR
 /begin AXIS_DESCR STD_AXIS Vse_sprn _CNV_R_R_Def_spr_sw_583_CM 16 0. 6553.5 FORMAT "%5.2" /end AXIS_DESCR
/end CHARACTERISTIC
/begin CHARACTERISTIC KF_FPWSTGDSE "Kennfeld Faktor Druckbeaufschlagung Wastegatedose in Abh. der Drucksteuerventilansteuerung" MAP 0xa10130ac _REC_MAP_52_UBYTE_u2_u2_u2 0.9999847412109381 _CNV_R_R_Def_f_uw_b_591_CM 0. 0.9999847412109381 FORMAT "%14.5"
 /begin AXIS_DESCR STD_AXIS NO_INPUT_QUANTITY _CNV_R_R_Def_p_sw_q_578_CM 8 0. 2559.9609 FORMAT "%5.2" /end AXIS_DESCR
 /begin AXIS_DESCR STD_AXIS Atlr_oad _CNV_R_R_Def_f_uw_b_576_CM 8 0. 99.9984 /end AXIS_DESCR
/end CHARACTERISTIC
/begin CHARACTERISTIC KF_FTRANSVL "" MAP 0xa101f1a8 _REC_MAP_52_UBYTE_u2_s2_u2 0.9999 _CNV_R_R_Def_f_uw_b_591_CM 0. 0.9999 FORMAT "%14.5"
 /begin AXIS_DESCR STD_AXIS Nkw _CNV_R_R_Def_n_sw_q_612_CM 8 -32768. 32767. FORMAT "%5.0" /end AXIS_DESCR
 /begin AXIS_DESCR STD_AXIS F_transvl_bas _CNV_R_R_Def_f_uw_b_591_CM 8 0. 0.9999 FORMAT "%14.5" /end AXIS_DESCR
/end CHARACTERISTIC
/begin CHARACTERISTIC KF_FW_TBR "Wichtungsfaktor fuer Brennraum Temperaturmodell" MAP 0xa1020124 _REC_MAP_52_u1_s2_s2 0.996 _CNV_R_R_Def_f_ub_b_573_CM 0. 0.996
 /begin AXIS_DESCR STD_AXIS Rf _CNV_R_R_Def_rf_sw__616_CM 10 -327.68 327.67 FORMAT "%7.4" /end AXIS_DESCR
 /begin AXIS_DESCR STD_AXIS Nkw _CNV_R_R_Def_n_sw_q_612_CM 8 -32768. 32767. FORMAT "%5.0" /end AXIS_DESCR
/end CHARACTERISTIC
/begin CHARACTERISTIC KF_FW_TBR_AGR "Wichtungsfaktor fuer Brennraum Temperaturmodell" MAP 0xa10201dc _REC_MAP_52_u1_s2_s2 0.996 _CNV_R_R_Def_f_ub_b_573_CM 0. 0.996
 /begin AXIS_DESCR STD_AXIS Rf _CNV_R_R_Def_rf_sw__616_CM 10 -327.68 327.67 FORMAT "%7.4" /end AXIS_DESCR
 /begin AXIS_DESCR STD_AXIS Nkw _CNV_R_R_Def_n_sw_q_612_CM 8 -32768. 32767. FORMAT "%5.0" /end AXIS_DESCR
/end CHARACTERISTIC
/begin CHARACTERISTIC KF_HUBE "Sollwert Einlassventilhub UGD" MAP 0xa101f2f8 _REC_MAP_52_UBYTE_u2_s2_s2 12. _CNV_R_R_Def_hub_uw_605_CM 0. 12.
 /begin AXIS_DESCR STD_AXIS Nkw _CNV_R_R_Def_n_sw_q_612_CM 20 -32768. 32767. FORMAT "%5.0" /end AXIS_DESCR
 /begin AXIS_DESCR STD_AXIS Rfv_hub _CNV_R_R_Def_rf_sw__616_CM 20 -327.68 327.67 FORMAT "%7.4" /end AXIS_DESCR
/end CHARACTERISTIC
/begin CHARACTERISTIC KF_HUBELL "Sollwert Einlassventilhub im Leerlauf" MAP 0xa101f66c _REC_MAP_52_UBYTE_u2_u2_s2 12. _CNV_R_R_Def_hub_uw_605_CM 0. 12.
 /begin AXIS_DESCR STD_AXIS Msnsolps _CNV_R_R_Def_ms_uw__611_CM 21 0. 2047.9687 /end AXIS_DESCR
 /begin AXIS_DESCR STD_AXIS Nkw _CNV_R_R_Def_n_sw_q_612_CM 6 -32768. 32767. FORMAT "%5.0" /end AXIS_DESCR
/end CHARACTERISTIC
/begin CHARACTERISTIC KF_HUBEST "Sollwert Einlassventilhub im Start" MAP 0xa101f970 _REC_MAP_52_UBYTE_u2_s2_s2 12. _CNV_R_R_Def_hub_uw_605_CM 0. 12.
 /begin AXIS_DESCR STD_AXIS Nkw _CNV_R_R_Def_n_sw_q_612_CM 8 -32768. 32767. FORMAT "%5.0" /end AXIS_DESCR
 /begin AXIS_DESCR STD_AXIS Rfv_soll _CNV_R_R_Def_rf_sw__616_CM 8 -327.68 327.67 FORMAT "%7.4" /end AXIS_DESCR
/end CHARACTERISTIC
/begin CHARACTERISTIC KF_HUBESTM "Sollwert Einlassventilhub im Start (Abh. von Tmot_start)" MAP 0xa101fa14 _REC_MAP_52_UBYTE_u2_s2_s2 12. _CNV_R_R_Def_hub_uw_605_CM 0. 12.
 /begin AXIS_DESCR STD_AXIS Nkw _CNV_R_R_Def_n_sw_q_612_CM 8 -32768. 32767. FORMAT "%5.0" /end AXIS_DESCR
 /begin AXIS_DESCR STD_AXIS Tmot_start _CNV_R_R_Def_t_sw_q_620_CM 8 -327.68 327.67 FORMAT "%5.2" /end AXIS_DESCR
/end CHARACTERISTIC
/begin CHARACTERISTIC KF_MSSDYN_KOR "" MAP 0xa101f24c _REC_MAP_52_UBYTE_u2_s2_u2 3.9999 _CNV_R_R_Def_f_sw_b_608_CM 0. 3.9999 FORMAT "%14.5"
 /begin AXIS_DESCR STD_AXIS Nkw _CNV_R_R_Def_n_sw_q_612_CM 6 -32768. 32767. FORMAT "%5.0" /end AXIS_DESCR
 /begin AXIS_DESCR STD_AXIS Pspvdk_soll _CNV_R_R_Def_f_sw_b_608_CM 6 0. 3.9999 FORMAT "%14.5" /end AXIS_DESCR
/end CHARACTERISTIC
/begin CHARACTERISTIC KF_MSZSVNS "Wichtungsfaktor" MAP 0xa101ed18 _REC_MAP_52_u1_s2_s2 0.996 _CNV_R_R_Def_f_ub_b_573_CM 0. 0.996
 /begin AXIS_DESCR STD_AXIS Nkw _CNV_R_R_Def_n_sw_q_612_CM 8 -32768. 32767. FORMAT "%5.0" /end AXIS_DESCR
 /begin AXIS_DESCR STD_AXIS Rfv_soll _CNV_R_R_Def_rf_sw__616_CM 8 -327.68 327.67 FORMAT "%7.4" /end AXIS_DESCR
/end CHARACTERISTIC
/begin CHARACTERISTIC KF_MSZSVNST "Wichtungsfaktor" MAP 0xa101ed7c _REC_MAP_52_u1_s2_s2 0.996 _CNV_R_R_Def_f_ub_b_573_CM 0. 0.996
 /begin AXIS_DESCR STD_AXIS Nkw _CNV_R_R_Def_n_sw_q_612_CM 4 -32768. 32767. FORMAT "%5.0" /end AXIS_DESCR
 /begin AXIS_DESCR STD_AXIS Rfv_soll _CNV_R_R_Def_rf_sw__616_CM 4 -327.68 327.67 FORMAT "%7.4" /end AXIS_DESCR
/end CHARACTERISTIC
/begin CHARACTERISTIC KF_NDDPSTE "" MAP 0xa101ec40 _REC_MAP_52_UBYTE_s2_s2_s2 102.398436 _CNV_R_R_Def_p_sw_q_578_CM -1280. 1279.9609 FORMAT "%5.2"
 /begin AXIS_DESCR STD_AXIS Nkw _CNV_R_R_Def_n_sw_q_612_CM 8 -32768. 32767. FORMAT "%5.0" /end AXIS_DESCR
 /begin AXIS_DESCR STD_AXIS NO_INPUT_QUANTITY _CNV_R_R_Def_p_sw_q_578_CM 8 -1280. 1279.9609 FORMAT "%5.2" /end AXIS_DESCR
/end CHARACTERISTIC
/begin CHARACTERISTIC KF_PLD_SPORT "Grundladedruck im Sportmodus" MAP 0xa100c368 _REC_MAP_52_UBYTE_u2_s2_u2 102.398436 _CNV_R_R_Def_p_sw_q_578_CM 0. 2559.9609 FORMAT "%5.2"
 /begin AXIS_DESCR STD_AXIS Nkw _CNV_R_R_Def_n_sw_q_612_CM 8 -32768. 32767. FORMAT "%5.0" /end AXIS_DESCR
 /begin AXIS_DESCR STD_AXIS Pssol _CNV_R_R_Def_p_sw_q_578_CM 8 0. 2559.9609 FORMAT "%5.2" /end AXIS_DESCR
/end CHARACTERISTIC
/begin CHARACTERISTIC KF_PSPLD_DYN "Soll-Druckverh. im Turbobetrieb" MAP 0xa10202b8 _REC_MAP_52_UBYTE_u2_s2_u2 1.9999 _CNV_R_R_Def_f_uw_b_579_CM 0. 1.9999 FORMAT "%14.5"
 /begin AXIS_DESCR STD_AXIS Nkw _CNV_R_R_Def_n_sw_q_612_CM 6 -32768. 32767. FORMAT "%5.0" /end AXIS_DESCR
 /begin AXIS_DESCR STD_AXIS Pssolpu _CNV_R_R_Def_f_sw_b_608_CM 6 0. 3.9999 FORMAT "%14.5" /end AXIS_DESCR
/end CHARACTERISTIC
/begin CHARACTERISTIC KF_PSPLD_ECO "Soll-Druckverh. im Normalbetrieb" MAP 0xa102031c _REC_MAP_52_UBYTE_u2_s2_u2 1.9999 _CNV_R_R_Def_f_uw_b_579_CM 0. 1.9999 FORMAT "%14.5"
 /begin AXIS_DESCR STD_AXIS Nkw _CNV_R_R_Def_n_sw_q_612_CM 6 -32768. 32767. FORMAT "%5.0" /end AXIS_DESCR
 /begin AXIS_DESCR STD_AXIS Pssolpu _CNV_R_R_Def_f_sw_b_608_CM 6 0. 3.9999 FORMAT "%14.5" /end AXIS_DESCR
/end CHARACTERISTIC
/begin CHARACTERISTIC KF_SRKOR_SPUEL "" MAP 0xa101ea0c _REC_MAP_52_UBYTE_s2_u2_u2 1.9999 _CNV_R_R_Def_f_uw_b_579_CM -1. 0.9999 FORMAT "%14.5"
 /begin AXIS_DESCR STD_AXIS Pak _CNV_R_R_Def_f_uw_b_579_CM 3 0. 1.9999 FORMAT "%14.5" /end AXIS_DESCR
 /begin AXIS_DESCR STD_AXIS Pssol _CNV_R_R_Def_p_sw_q_578_CM 8 0. 2559.9609 FORMAT "%5.2" /end AXIS_DESCR
/end CHARACTERISTIC
/begin CHARACTERISTIC KF_TDVNSFIL "Filterzeitkonstante Filterung Rfv_vns_hub" MAP 0xa101eda0 _REC_MAP_52_UBYTE_u2_s2_u2 99.9984 _CNV_R_R_Def_f_uw_b_576_CM 0. 99.9984
 /begin AXIS_DESCR STD_AXIS Dpssolfilt _CNV_R_R_Def_p_sw_q_578_CM 6 -1280. 1279.9609 FORMAT "%5.2" /end AXIS_DESCR
 /begin AXIS_DESCR STD_AXIS Minhub _CNV_R_R_Def_hub_uw_605_CM 6 0. 65.535 /end AXIS_DESCR
/end CHARACTERISTIC
/begin CHARACTERISTIC KF_TEVT_MDL_OFFSET "Offset fuer Tevt_mdl" MAP 0xa1020254 _REC_MAP_52_UBYTE_s2_s2_s2 131.07 _CNV_R_R_Def_t_sw_q_618_CM -3276.8 3276.7 FORMAT "%4.1"
 /begin AXIS_DESCR STD_AXIS Tmot_fil_tempk _CNV_R_R_Def_t_sw_q_618_CM 8 -3276.8 3276.7 FORMAT "%4.1" /end AXIS_DESCR
 /begin AXIS_DESCR STD_AXIS Tmot_start _CNV_R_R_Def_t_sw_q_620_CM 4 -327.68 327.67 FORMAT "%5.2" /end AXIS_DESCR
/end CHARACTERISTIC
/begin CHARACTERISTIC KF_VNSDYNKOR "" MAP 0xa101ea54 _REC_MAP_52_UBYTE_s2_s2_s2 98.30250000000001 _CNV_R_R_Def_rf_sw__616_CM -327.68 327.67 FORMAT "%7.4"
 /begin AXIS_DESCR STD_AXIS Rf_fvns_k _CNV_R_R_Def_rf_sw__616_CM 8 -327.68 327.67 FORMAT "%7.4" /end AXIS_DESCR
 /begin AXIS_DESCR STD_AXIS Nkw _CNV_R_R_Def_n_sw_q_612_CM 8 -32768. 32767. FORMAT "%5.0" /end AXIS_DESCR
/end CHARACTERISTIC
/begin CHARACTERISTIC KF_WDKDPS "Kennfeld Drosselklappensollwinkel" MAP 0xa101ef28 _REC_MAP_52_UBYTE_u2_u2_u2 95.99852999999999 _CNV_R_R_Def_wdk_sw_691_CM 0. 1599.9755 FORMAT "%5.2"
 /begin AXIS_DESCR STD_AXIS Mssoldk_kor _CNV_R_R_Def_ms_uw__611_CM 21 0. 2047.9687 /end AXIS_DESCR
 /begin AXIS_DESCR STD_AXIS Pspvdk_soll _CNV_R_R_Def_f_sw_b_608_CM 8 0. 3.9999 FORMAT "%14.5" /end AXIS_DESCR
/end CHARACTERISTIC
/begin CHARACTERISTIC KF_WFTEV "Wichtungsfaktor fuer Brennraum Temperaturmodell, TL-VL" MAP 0xa102019c _REC_MAP_52_u1_s2_s2 0.996 _CNV_R_R_Def_f_ub_b_573_CM 0. 0.996
 /begin AXIS_DESCR STD_AXIS Nkw _CNV_R_R_Def_n_sw_q_612_CM 6 -32768. 32767. FORMAT "%5.0" /end AXIS_DESCR
 /begin AXIS_DESCR STD_AXIS Rf _CNV_R_R_Def_rf_sw__616_CM 6 -327.68 327.67 FORMAT "%7.4" /end AXIS_DESCR
/end CHARACTERISTIC
/begin CHARACTERISTIC KF_WSTG_S "Kennfeld Modell Druckstangenweg der Wastegate-betätigung" MAP 0xa10132a8 _REC_MAP_52_UBYTE_u2_u2_u2 99.9984 _CNV_R_R_Def_f_uw_b_576_CM 0. 99.9984
 /begin AXIS_DESCR STD_AXIS Pwstgtpu _CNV_R_R_Def_f_sw_b_608_CM 8 0. 3.9999 FORMAT "%14.5" /end AXIS_DESCR
 /begin AXIS_DESCR STD_AXIS Prat_turb _CNV_R_R_Def_f_sw_b_608_CM 8 0. 3.9999 FORMAT "%14.5" /end AXIS_DESCR
/end CHARACTERISTIC
/begin CHARACTERISTIC KF_ZKVNSI "" MAP 0xa101ff18 _REC_MAP_52_UBYTE_u2_s2_s2 655.35 _CNV_R_R_Def_zk10ms_709_CM 1.e-002 655.36 FORMAT "%7.4"
 /begin AXIS_DESCR STD_AXIS Dvse_spr _CNV_R_R_Def_spr_sw_583_CM 8 -3276.8 3276.7 FORMAT "%5.2" /end AXIS_DESCR
 /begin AXIS_DESCR STD_AXIS Nkw _CNV_R_R_Def_n_sw_q_612_CM 8 -32768. 32767. FORMAT "%5.0" /end AXIS_DESCR
/end CHARACTERISTIC
/begin CHARACTERISTIC KL_AGRPOS_N "" CURVE 0xa101ffec _REC_CUR_TKL_UW_VV__u2_u2 99.9984 _CNV_R_R_Def_f_uw_b_576_CM 0. 99.9984
 /begin AXIS_DESCR STD_AXIS Msnagr_rosol _CNV_R_R_Def_ms_uw__611_CM 12 0. 2047.9687 /end AXIS_DESCR
/end CHARACTERISTIC
/begin CHARACTERISTIC KL_ATLVST_P "Korrektur f. ATL-Vorsteuerung" CURVE 0xa100b52c _REC_CUR_TKL_UW_VV__u1_u2 1.9921 _CNV_R_R_Def_f_ub_b_625_CM 0. 1.9921
 /begin AXIS_DESCR STD_AXIS Pu _CNV_R_R_Def_p_sw_q_578_CM 6 0. 2559.9609 FORMAT "%5.2" /end AXIS_DESCR
/end CHARACTERISTIC
/begin CHARACTERISTIC KL_ATLVST_T "Korrektur f. ATL-Vorsteuerung" CURVE 0xa100b510 _REC_CUR_TKL_UW_VV__u1_s2 1.9921 _CNV_R_R_Def_f_ub_b_625_CM 0. 1.9921
 /begin AXIS_DESCR STD_AXIS Tvld _CNV_R_R_Def_t_sw_q_618_CM 8 -3276.8 3276.7 FORMAT "%4.1" /end AXIS_DESCR
/end CHARACTERISTIC
/begin CHARACTERISTIC KL_AUSY_KAT "Druckverlust Kat über Durchfluss" CURVE 0xa1013010 _REC_CUR_TKL_UW_VV__u2_u2 102.398436 _CNV_R_R_Def_p_sw_q_578_CM 0. 2559.9609 FORMAT "%5.2"
 /begin AXIS_DESCR STD_AXIS NO_INPUT_QUANTITY _CNV_R_R_Def_ms_uw__611_CM 8 0. 2047.9687 /end AXIS_DESCR
/end CHARACTERISTIC
/begin CHARACTERISTIC KL_AUSY_KAT_N "Druckverlust Kat über Drehzahl" CURVE 0xa1013034 _REC_CUR_TKL_UW_VV__u2_s2 102.398436 _CNV_R_R_Def_p_sw_q_578_CM 0. 2559.9609 FORMAT "%5.2"
 /begin AXIS_DESCR STD_AXIS Nkw _CNV_R_R_Def_n_sw_q_612_CM 8 -32768. 32767. FORMAT "%5.0" /end AXIS_DESCR
/end CHARACTERISTIC
/begin CHARACTERISTIC KL_AUSY_TURB "" CURVE 0xa1013088 _REC_CUR_TKL_UW_VV__u2_u2 0.9999847412109381 _CNV_R_R_Def_f_uw_b_591_CM 0. 0.9999847412109381 FORMAT "%14.5"
 /begin AXIS_DESCR STD_AXIS Prat_turb _CNV_R_R_Def_f_sw_b_608_CM 8 0. 3.9999 FORMAT "%14.5" /end AXIS_DESCR
/end CHARACTERISTIC
/begin CHARACTERISTIC KL_DHUBTM "Huboffset temperaturabhängig " CURVE 0xa101f92c _REC_CUR_TKL_UW_VV__s2_s2 65.535 _CNV_R_R_Def_hub_uw_605_CM -32.768 32.767
 /begin AXIS_DESCR STD_AXIS Tmot _CNV_R_R_Def_t_sw_q_620_CM 6 -327.68 327.67 FORMAT "%5.2" /end AXIS_DESCR
/end CHARACTERISTIC
/begin CHARACTERISTIC KL_DKVL "Vollast-Kennlinie fuer Drosselklappensollwinkel" CURVE 0xa101ee20 _REC_CUR_TKL_UW_VV__u2_s2 95.99852999999999 _CNV_R_R_Def_wdk_sw_691_CM 0. 1599.9755 FORMAT "%5.2"
 /begin AXIS_DESCR STD_AXIS Nkw _CNV_R_R_Def_n_sw_q_612_CM 8 -32768. 32767. FORMAT "%5.0" /end AXIS_DESCR
/end CHARACTERISTIC
/begin CHARACTERISTIC KL_DNWELLK "" CURVE 0xa101f95c _REC_CUR_TKL_UW_VV__s2_u2 0. _CNV_R_R_Def_n_sw_q_612_CM -32768. 32767. FORMAT "%5.0"
 /begin AXIS_DESCR STD_AXIS Tn_start_10 _CNV_R_R_Def_td_uw__679_CM 4 0. 655.35 FORMAT "%5.2" /end AXIS_DESCR
/end CHARACTERISTIC
/begin CHARACTERISTIC KL_DPSDKM "Ueberblendung zwischen Ansteuerung DK" CURVE 0xa101eec4 _REC_CUR_TKL_UW_VV__u2_u2 1.9999 _CNV_R_R_Def_f_uw_b_579_CM 0. 1.9999 FORMAT "%14.5"
 /begin AXIS_DESCR STD_AXIS Pspvdk_soll _CNV_R_R_Def_f_sw_b_608_CM 6 0. 3.9999 FORMAT "%14.5" /end AXIS_DESCR
/end CHARACTERISTIC
/begin CHARACTERISTIC KL_ELSLS "Kennlinie E-Lüfter Strom" CURVE 0xa1014980 _REC_CUR_TKL_UW_VV__u2_u2 99.45 _CNV_R_R_Def_i_uw_q_644_CM 0. 255.
 /begin AXIS_DESCR STD_AXIS Ub _CNV_R_R_Def_u_sb_q_598_CM 3 0. 6173.397 FORMAT "%4.1" /end AXIS_DESCR
/end CHARACTERISTIC
/begin CHARACTERISTIC KL_ELTEMP39 "Temperaturfaktor Elüfter" CURVE 0xa10148f0 _REC_CUR_TKL_UW_VV__u2_s2 102.39842 _CNV_R_R_Def_f_uw_b_636_CM 0. 511.9921
 /begin AXIS_DESCR STD_AXIS Tans _CNV_R_R_Def_t_sw_q_618_CM 6 -3276.8 3276.7 FORMAT "%4.1" /end AXIS_DESCR
/end CHARACTERISTIC
/begin CHARACTERISTIC KL_ELTEMP60 "Temperaturfaktor Elüfter" CURVE 0xa1014964 _REC_CUR_TKL_UW_VV__u2_s2 102.39842 _CNV_R_R_Def_f_uw_b_636_CM 0. 511.9921
 /begin AXIS_DESCR STD_AXIS Tans _CNV_R_R_Def_t_sw_q_618_CM 6 -3276.8 3276.7 FORMAT "%4.1" /end AXIS_DESCR
/end CHARACTERISTIC
/begin CHARACTERISTIC KL_ELUB39 "" CURVE 0xa101494c _REC_CUR_TKL_UW_VV__u2_u2 102.39842 _CNV_R_R_Def_f_uw_b_636_CM 0. 511.9921
 /begin AXIS_DESCR STD_AXIS Ub _CNV_R_R_Def_u_sb_q_598_CM 5 0. 6173.397 FORMAT "%4.1" /end AXIS_DESCR
/end CHARACTERISTIC
/begin CHARACTERISTIC KL_ELUB60 "" CURVE 0xa101490c _REC_CUR_TKL_UW_VV__u2_u2 102.39842 _CNV_R_R_Def_f_uw_b_636_CM 0. 511.9921
 /begin AXIS_DESCR STD_AXIS Ub _CNV_R_R_Def_u_sb_q_598_CM 5 0. 6173.397 FORMAT "%4.1" /end AXIS_DESCR
/end CHARACTERISTIC
/begin CHARACTERISTIC KL_EXWHKLL "Korrekturexzenterwinkel für Hubkorrektur im LL" CURVE 0xa101f804 _REC_CUR_TKL_UW_VV__s2_s2 99. _CNV_R_R_Def_exwink_601_CM -720. 180. FORMAT "%5.2"
 /begin AXIS_DESCR STD_AXIS Exwdifll _CNV_R_R_Def_exwink_601_CM 4 -720. 180. FORMAT "%5.2" /end AXIS_DESCR
/end CHARACTERISTIC
/begin CHARACTERISTIC KL_EXWMX_N "Begrenzung Exzenterwinkel drehzahlabhängig" CURVE 0xa101f818 _REC_CUR_TKL_UW_VV__u2_s2 100.8 _CNV_R_R_Def_exwink_601_CM 0. 180. FORMAT "%5.2"
 /begin AXIS_DESCR STD_AXIS Nkw _CNV_R_R_Def_n_sw_q_612_CM 6 -32768. 32767. FORMAT "%5.0" /end AXIS_DESCR
/end CHARACTERISTIC
/begin CHARACTERISTIC KL_FATLRD_N "Faktor D-Anteil" CURVE 0xa100b540 _REC_CUR_TKL_UW_VV__u1_s2 1.9921 _CNV_R_R_Def_f_ub_b_625_CM 0. 1.9921
 /begin AXIS_DESCR STD_AXIS Nkw _CNV_R_R_Def_n_sw_q_612_CM 12 -32768. 32767. FORMAT "%5.0" /end AXIS_DESCR
/end CHARACTERISTIC
/begin CHARACTERISTIC KL_FGRPLD "Faktor f. Grundladedruck" CURVE 0xa100c1bc _REC_CUR_TKL_UW_VV__u2_s2 1.9999 _CNV_R_R_Def_f_uw_b_579_CM 0. 1.9999 FORMAT "%14.5"
 /begin AXIS_DESCR STD_AXIS Nkw _CNV_R_R_Def_n_sw_q_612_CM 8 -32768. 32767. FORMAT "%5.0" /end AXIS_DESCR
/end CHARACTERISTIC
/begin CHARACTERISTIC KL_FHTMOT "Wichtungsfaktor Sollwert Einlassventilhub ueber Tmot" CURVE 0xa101f918 _REC_CUR_TKL_UW_VV__u1_s2 0.996 _CNV_R_R_Def_f_ub_b_573_CM 0. 0.996
 /begin AXIS_DESCR STD_AXIS Tmot _CNV_R_R_Def_t_sw_q_620_CM 6 -327.68 327.67 FORMAT "%5.2" /end AXIS_DESCR
/end CHARACTERISTIC
/begin CHARACTERISTIC KL_FHUB_DPSFAK "Kennlinie Überblendung Fhubvnsi von Dpsfak" CURVE 0xa101f8e0 _REC_CUR_TKL_UW_VV__u1_u1 0.996 _CNV_R_R_Def_f_ub_b_573_CM 0. 0.996 /begin AXIS_DESCR STD_AXIS Dpsfak _CNV_R_R_Def_f_ub_b_573_CM 4 0. 0.996 /end AXIS_DESCR /end CHARACTERISTIC
/begin CHARACTERISTIC KL_FHUB_NST "Kennlinie Überblendung Fhubvnsi abhängig von Tn_start_10" CURVE 0xa101f8d0 _REC_CUR_TKL_UW_VV__u1_u2 0.996 _CNV_R_R_Def_f_ub_b_573_CM 0. 0.996
 /begin AXIS_DESCR STD_AXIS Tn_start_10 _CNV_R_R_Def_td_uw__679_CM 4 0. 655.35 FORMAT "%5.2" /end AXIS_DESCR
/end CHARACTERISTIC
/begin CHARACTERISTIC KL_FKPLDSVLD "Filterkonstante f. Solldruck-Verhältnis" CURVE 0xa100c244 _REC_CUR_TKL_UW_VV__u2_u2 0.9999847412109381 _CNV_R_R_Def_f_uw_b_591_CM 0. 0.9999847412109381 FORMAT "%14.5"
 /begin AXIS_DESCR STD_AXIS Vsvld _CNV_R_R_Def_vs_uw__731_CM 8 0. 1279.9804 FORMAT "%5.2" /end AXIS_DESCR
/end CHARACTERISTIC
/begin CHARACTERISTIC KL_FKVSVLD "Filterkonstante f. Volumenstrom" CURVE 0xa100c220 _REC_CUR_TKL_UW_VV__u2_u2 0.9999847412109381 _CNV_R_R_Def_f_uw_b_591_CM 0. 0.9999847412109381 FORMAT "%14.5"
 /begin AXIS_DESCR STD_AXIS Vsvld _CNV_R_R_Def_vs_uw__731_CM 8 0. 1279.9804 FORMAT "%5.2" /end AXIS_DESCR
/end CHARACTERISTIC
/begin CHARACTERISTIC KL_FPWDKAPP "DK-Winkel abh. von Fahrpedal, nur fuer Applikation" CURVE 0xa101ee44 _REC_CUR_TKL_UW_VV__u2_s2 95.99852999999999 _CNV_R_R_Def_wdk_sw_691_CM 0. 1599.9755 FORMAT "%5.2"
 /begin AXIS_DESCR STD_AXIS Pwg_ist _CNV_R_R_Def_wdk_sw_691_CM 4 -800. 799.9755 FORMAT "%5.2" /end AXIS_DESCR
/end CHARACTERISTIC
/begin CHARACTERISTIC KL_FSEG_DPLD "Faktor Korrekturfaktor durch Segment-Einfluß" CURVE 0xa100c314 _REC_CUR_TKL_UW_VV__u1_s2 1.9921 _CNV_R_R_Def_f_ub_b_625_CM 0. 1.9921
 /begin AXIS_DESCR STD_AXIS Nkw _CNV_R_R_Def_n_sw_q_612_CM 8 -32768. 32767. FORMAT "%5.0" /end AXIS_DESCR
/end CHARACTERISTIC
/begin CHARACTERISTIC KL_FTDISA "" CURVE 0xa1020398 _REC_CUR_TKL_UW_VV__u2_s2 1.9999 _CNV_R_R_Def_f_uw_b_579_CM 0. 1.9999 FORMAT "%14.5"
 /begin AXIS_DESCR STD_AXIS Tans _CNV_R_R_Def_t_sw_q_618_CM 8 -3276.8 3276.7 FORMAT "%4.1" /end AXIS_DESCR
/end CHARACTERISTIC
/begin CHARACTERISTIC KL_FTEVST "Start Wichtungsfaktor fuer Fak_tbr abh." CURVE 0xa10200dc _REC_CUR_TKL_UW_VV__u2_s2 1.9999 _CNV_R_R_Def_f_uw_b_579_CM 0. 1.9999 FORMAT "%14.5"
 /begin AXIS_DESCR STD_AXIS Tmot _CNV_R_R_Def_t_sw_q_620_CM 8 -327.68 327.67 FORMAT "%5.2" /end AXIS_DESCR
/end CHARACTERISTIC
/begin CHARACTERISTIC KL_FTEV_TL "Wichtungsfaktor fuer Fak_tbr abh. TL" CURVE 0xa1020064 _REC_CUR_TKL_UW_VV__u2_s2 1.9999 _CNV_R_R_Def_f_uw_b_579_CM 0. 1.9999 FORMAT "%14.5"
 /begin AXIS_DESCR STD_AXIS NO_INPUT_QUANTITY _CNV_R_R_Def_t_sw_q_618_CM 14 -3276.8 3276.7 FORMAT "%4.1" /end AXIS_DESCR
/end CHARACTERISTIC
/begin CHARACTERISTIC KL_FTEV_VL "Wichtungsfaktor fuer Fak_tbr abh. VL" CURVE 0xa10200a0 _REC_CUR_TKL_UW_VV__u2_s2 1.9999 _CNV_R_R_Def_f_uw_b_579_CM 0. 1.9999 FORMAT "%14.5"
 /begin AXIS_DESCR STD_AXIS NO_INPUT_QUANTITY _CNV_R_R_Def_t_sw_q_618_CM 14 -3276.8 3276.7 FORMAT "%4.1" /end AXIS_DESCR
/end CHARACTERISTIC
/begin CHARACTERISTIC KL_FTVDK "Temperaturfaktor fuer Drosselventil Durchfluss" CURVE 0xa1020048 _REC_CUR_TKL_UW_VV__u1_s2 1.9921 _CNV_R_R_Def_f_ub_b_625_CM 0. 1.9921
 /begin AXIS_DESCR STD_AXIS Tans _CNV_R_R_Def_t_sw_q_618_CM 8 -3276.8 3276.7 FORMAT "%4.1" /end AXIS_DESCR
/end CHARACTERISTIC
/begin CHARACTERISTIC KL_FUPSRF_TRANS "Fupsrf, GD (vereinfachte N.N.)" CURVE 0xa101e93c _REC_CUR_TKL_UW_VV__u2_s2 0.2999 _CNV_R_R_Def_f_uw_b_639_CM 0. 0.2999 FORMAT "%14.6"
 /begin AXIS_DESCR STD_AXIS Nkw _CNV_R_R_Def_n_sw_q_612_CM 8 -32768. 32767. FORMAT "%5.0" /end AXIS_DESCR
/end CHARACTERISTIC
/begin CHARACTERISTIC KL_F_DAGR "Kennfeld Androsselung für AGR" CURVE 0xa1020020 _REC_CUR_TKL_UW_VV__s2_u2 1.9999 _CNV_R_R_Def_f_uw_b_579_CM -1. 0.9999 FORMAT "%14.5"
 /begin AXIS_DESCR STD_AXIS Q_msnagr_mx _CNV_R_R_Def_f_uw_b_579_CM 6 0. 1.9999 FORMAT "%14.5" /end AXIS_DESCR
/end CHARACTERISTIC
/begin CHARACTERISTIC KL_GDVNSFIL "Zeitkonstante Filterung Rfv_vns_dk" CURVE 0xa101e8f4 _REC_CUR_TKL_UW_VV__u2_s2 99.9984 _CNV_R_R_Def_f_uw_b_576_CM 0. 99.9984
 /begin AXIS_DESCR STD_AXIS Rfv_soll _CNV_R_R_Def_rf_sw__616_CM 8 -327.68 327.67 FORMAT "%7.4" /end AXIS_DESCR
/end CHARACTERISTIC
/begin CHARACTERISTIC KL_HUBAPP "Sollwert Einlassventilhub fuer Applikation ueber Wped" CURVE 0xa101f888 _REC_CUR_TKL_UW_VV__u2_s2 12. _CNV_R_R_Def_hub_uw_605_CM 0. 12.
 /begin AXIS_DESCR STD_AXIS Pwg_ist _CNV_R_R_Def_wdk_sw_691_CM 4 -800. 799.9755 FORMAT "%5.2" /end AXIS_DESCR
/end CHARACTERISTIC
/begin CHARACTERISTIC KL_HUBEVL "Sollwert Einlassventilhub bei Vollast" CURVE 0xa101f2b4 _REC_CUR_TKL_UW_VV__u2_s2 12. _CNV_R_R_Def_hub_uw_605_CM 0. 12.
 /begin AXIS_DESCR STD_AXIS Nkw _CNV_R_R_Def_n_sw_q_612_CM 16 -32768. 32767. FORMAT "%5.0" /end AXIS_DESCR
/end CHARACTERISTIC
/begin CHARACTERISTIC KL_HUBEX "Kennlinie Huberverstellung -> Exzenterwellenwinkel" CURVE 0xa101f89c _REC_CUR_TKL_UW_VV__u2_u2 100.78768 _CNV_R_R_Def_exwink_601_CM 0. 179.978 FORMAT "%5.2" /begin AXIS_DESCR STD_AXIS Hubev_ist _CNV_R_R_Def_hub_uw_605_CM 12 0. 12. /end AXIS_DESCR /end CHARACTERISTIC
/begin CHARACTERISTIC KL_HUBV "Sollwert Einlassventilhub bei B_gdvhub" CURVE 0xa101f834 _REC_CUR_TKL_UW_VV__u2_s2 12. _CNV_R_R_Def_hub_uw_605_CM 0. 12.
 /begin AXIS_DESCR STD_AXIS Nkw _CNV_R_R_Def_n_sw_q_612_CM 8 -32768. 32767. FORMAT "%5.0" /end AXIS_DESCR
/end CHARACTERISTIC
/begin CHARACTERISTIC KL_IABGLMOT "Abgleichstrom Motor" CURVE 0xa1014938 _REC_CUR_TKL_UW_VV__u1_u2 7.9687 _CNV_R_R_Def_f_ub_b_739_CM 0. 7.9687 FORMAT "%5.2"
 /begin AXIS_DESCR STD_AXIS Ub _CNV_R_R_Def_u_sb_q_598_CM 5 0. 6173.397 FORMAT "%4.1" /end AXIS_DESCR
/end CHARACTERISTIC
/begin CHARACTERISTIC KL_IABGLNL "Abgleichstrom Kl. 15" CURVE 0xa1014990 _REC_CUR_TKL_UW_VV__u1_u2 7.9687 _CNV_R_R_Def_f_ub_b_739_CM 0. 7.9687 FORMAT "%5.2"
 /begin AXIS_DESCR STD_AXIS Ub _CNV_R_R_Def_u_sb_q_598_CM 5 0. 6173.397 FORMAT "%4.1" /end AXIS_DESCR
/end CHARACTERISTIC
/begin CHARACTERISTIC KL_IABGLST "Abgleichstrom Start" CURVE 0xa1014924 _REC_CUR_TKL_UW_VV__u1_u2 7.9687 _CNV_R_R_Def_f_ub_b_739_CM 0. 7.9687 FORMAT "%5.2"
 /begin AXIS_DESCR STD_AXIS Ub _CNV_R_R_Def_u_sb_q_598_CM 5 0. 6173.397 FORMAT "%4.1" /end AXIS_DESCR
/end CHARACTERISTIC
/begin CHARACTERISTIC KL_MSSDYN_KOR "" CURVE 0xa101ef04 _REC_CUR_TKL_UW_VV__u2_s2 1.9999 _CNV_R_R_Def_f_uw_b_579_CM 0. 1.9999 FORMAT "%14.5"
 /begin AXIS_DESCR STD_AXIS Dpssolps _CNV_R_R_Def_p_sw_q_578_CM 8 -1280. 1279.9609 FORMAT "%5.2" /end AXIS_DESCR
/end CHARACTERISTIC
/begin CHARACTERISTIC KL_NSLLBKV "Kennlinie für Bremskraftverstärkerleerlaufdrehzahl" CURVE 0xa100cc08 _REC_CUR_TKL_UW_VV__s2_s2 0. _CNV_R_R_Def_n_sw_q_612_CM -32768. 32767. FORMAT "%5.0"
 /begin AXIS_DESCR STD_AXIS Dpbkv _CNV_R_R_Def_p_sw_q_613_CM 6 -3276.8 3276.7 FORMAT "%5.2" /end AXIS_DESCR
/end CHARACTERISTIC
/begin CHARACTERISTIC KL_PAKOFFS_SPUEL "Offset Abgaskrümmerdruck im Spülbereich" CURVE 0xa1012fe4 _REC_CUR_TKL_UW_VV__s2_s2 102.396872 _CNV_R_R_Def_p_sw_q_578_CM 0. 1279.9609 FORMAT "%5.2"
 /begin AXIS_DESCR STD_AXIS Nkw _CNV_R_R_Def_n_sw_q_612_CM 8 -32768. 32767. FORMAT "%5.0" /end AXIS_DESCR
/end CHARACTERISTIC
/begin CHARACTERISTIC KL_PAKOFFS_UK "Offset Abgaskrümmerdruck im unterkritischen Bereich" CURVE 0xa1012f9c _REC_CUR_TKL_UW_VV__s2_s2 102.396872 _CNV_R_R_Def_p_sw_q_578_CM 0. 1279.9609 FORMAT "%5.2"
 /begin AXIS_DESCR STD_AXIS Nkw _CNV_R_R_Def_n_sw_q_612_CM 8 -32768. 32767. FORMAT "%5.0" /end AXIS_DESCR
/end CHARACTERISTIC
/begin CHARACTERISTIC KL_PGRD_PRD "Schwelle für dyn. Umluftbetrieb" CURVE 0xa100c330 _REC_CUR_TKL_UW_VV__s2_u2 102.396872 _CNV_R_R_Def_p_sw_q_614_CM 0. 2559.9218 FORMAT "%5.2"
 /begin AXIS_DESCR STD_AXIS Pldr_soll _CNV_R_R_Def_p_sw_q_578_CM 4 0. 2559.9609 FORMAT "%5.2" /end AXIS_DESCR
/end CHARACTERISTIC
/begin CHARACTERISTIC KL_PIRG_TRANS "Pirg, GD (vereinfachte N.N.)" CURVE 0xa101e918 _REC_CUR_TKL_UW_VV__u2_s2 102.398436 _CNV_R_R_Def_p_sw_q_578_CM 0. 2559.9609 FORMAT "%5.2"
 /begin AXIS_DESCR STD_AXIS Nkw _CNV_R_R_Def_n_sw_q_612_CM 8 -32768. 32767. FORMAT "%5.0" /end AXIS_DESCR
/end CHARACTERISTIC
/begin CHARACTERISTIC KL_PU2PLD "Pumpgrenze des Laders" CURVE 0xa100c268 _REC_CUR_TKL_UW_VV__u2_u2 3.9999 _CNV_R_R_Def_f_sw_b_608_CM 0. 3.9999 FORMAT "%14.5"
 /begin AXIS_DESCR STD_AXIS Vsldn _CNV_R_R_Def_vs_uw__731_CM 16 0. 1279.9804 FORMAT "%5.2" /end AXIS_DESCR
/end CHARACTERISTIC
/begin CHARACTERISTIC KL_PUPVLD "Differenzdruck Pu - Pvld" CURVE 0xa100c344 _REC_CUR_TKL_UW_VV__u2_u2 102.398436 _CNV_R_R_Def_p_sw_q_578_CM 0. 2559.9609 FORMAT "%5.2" /begin AXIS_DESCR STD_AXIS Mssol _CNV_R_R_Def_ms_uw__611_CM 8 0. 2047.9687 /end AXIS_DESCR /end CHARACTERISTIC
/begin CHARACTERISTIC KL_SRKOR_SPUEL "" CURVE 0xa101e9b8 _REC_CUR_TKL_UW_VV__S4_S4 0. _CNV_R_R_Def_dez_sl_575_CM -1000000000000. 10000000000000. FORMAT "%14.7"
 /begin AXIS_DESCR STD_AXIS NO_INPUT_QUANTITY _CNV_R_R_Def_dez_sl_575_CM 10 -1000000000000. 10000000000000. FORMAT "%14.7" /end AXIS_DESCR
/end CHARACTERISTIC
/begin CHARACTERISTIC KL_TABG2TABG_WZINV "Wurzel Abgastemperatur" CURVE 0xa1013064 _REC_CUR_TKL_UW_VV__u2_u2 0.4999847412109378 _CNV_R_R_Def_f_uw_b_710_CM 7.62939453125e-006 0.499992370605469 FORMAT "%14.6"
 /begin AXIS_DESCR STD_AXIS NO_INPUT_QUANTITY _CNV_R_R_Def_tkelvi_747_CM 8 0. 6553.5 FORMAT "%4.1" /end AXIS_DESCR
/end CHARACTERISTIC
/begin CHARACTERISTIC KL_TBKV "Kennlinie für Ansauglufttemperatur Bremskraftverstärker" CURVE 0xa100cc24 _REC_CUR_TKL_UW_VV__u1_s2 9.900000000000001e-003 _CNV_R_R_Def_t_ub_b_748_CM 0. 9.900000000000001e-003 FORMAT "%14.5"
 /begin AXIS_DESCR STD_AXIS Tans _CNV_R_R_Def_t_sw_q_618_CM 6 -3276.8 3276.7 FORMAT "%4.1" /end AXIS_DESCR
/end CHARACTERISTIC
/begin CHARACTERISTIC KL_TEVT_MDL_AGR "Offset fuer Tevt_mdl bei hoher Tans d. AGR" CURVE 0xa1020100 _REC_CUR_TKL_UW_VV__s2_s2 131.07 _CNV_R_R_Def_t_sw_q_618_CM -3276.8 3276.7 FORMAT "%4.1"
 /begin AXIS_DESCR STD_AXIS Tsr_ges _CNV_R_R_Def_t_sw_q_618_CM 8 -3276.8 3276.7 FORMAT "%4.1" /end AXIS_DESCR
/end CHARACTERISTIC
/begin CHARACTERISTIC KL_TSEG "Bestimmung aktuelle Segmentzeit" CURVE 0xa1012fc0 _REC_CUR_TKL_UW_VV__u2_s2 0.124998092651367 _CNV_R_R_Def_f_uw_b_713_CM 0. 0.124998092651367 FORMAT "%14.6"
 /begin AXIS_DESCR STD_AXIS Nkw _CNV_R_R_Def_n_sw_q_612_CM 8 -32768. 32767. FORMAT "%5.0" /end AXIS_DESCR
/end CHARACTERISTIC
/begin CHARACTERISTIC KL_TWDKNVN "Zeitkonstante Filter Drosselklappensollwert, UG" CURVE 0xa101eea0 _REC_CUR_TKL_UW_VV__u2_s2 655.35 _CNV_R_R_Def_zk10ms_709_CM 1.e-002 655.36 FORMAT "%7.4"
 /begin AXIS_DESCR STD_AXIS Nkw _CNV_R_R_Def_n_sw_q_612_CM 8 -32768. 32767. FORMAT "%5.0" /end AXIS_DESCR
/end CHARACTERISTIC
/begin CHARACTERISTIC KL_TWDKNVP "Zeitkonstante Filter Drosselklappensollwert, UG" CURVE 0xa101ee7c _REC_CUR_TKL_UW_VV__u2_s2 655.35 _CNV_R_R_Def_zk10ms_709_CM 1.e-002 655.36 FORMAT "%7.4"
 /begin AXIS_DESCR STD_AXIS Nkw _CNV_R_R_Def_n_sw_q_612_CM 8 -32768. 32767. FORMAT "%5.0" /end AXIS_DESCR
/end CHARACTERISTIC
/begin CHARACTERISTIC KL_TWDKSV "Zeitkonstante Filter Drosselklappensollwert, GD/TG" CURVE 0xa101ee58 _REC_CUR_TKL_UW_VV__u2_u2 655.35 _CNV_R_R_Def_zk10ms_709_CM 1.e-002 655.36 FORMAT "%7.4"
 /begin AXIS_DESCR STD_AXIS Pspvdk_soll _CNV_R_R_Def_f_sw_b_608_CM 8 0. 3.9999 FORMAT "%14.5" /end AXIS_DESCR
/end CHARACTERISTIC
/begin CHARACTERISTIC KL_ULVR "Voluemstrom für ULV Regler" CURVE 0xa100c1e0 _REC_CUR_TKL_UW_VV__u2_s2 102.398432 _CNV_R_R_Def_vs_uw__731_CM 0. 1279.9804 FORMAT "%5.2"
 /begin AXIS_DESCR STD_AXIS Nkw _CNV_R_R_Def_n_sw_q_612_CM 8 -32768. 32767. FORMAT "%5.0" /end AXIS_DESCR
/end CHARACTERISTIC
/begin CHARACTERISTIC KL_ULVRHYS "Hysterese Volumenstrom für ULV - Regler" CURVE 0xa100c2ac _REC_CUR_TKL_UW_VV__u2_s2 102.398432 _CNV_R_R_Def_vs_uw__731_CM 0. 1279.9804 FORMAT "%5.2"
 /begin AXIS_DESCR STD_AXIS Nkw _CNV_R_R_Def_n_sw_q_612_CM 8 -32768. 32767. FORMAT "%5.0" /end AXIS_DESCR
/end CHARACTERISTIC
/begin CHARACTERISTIC KL_VNSD_TOEL "Kennlinie Toel-Schwelle für Diagnose" CURVE 0xa101e848 _REC_CUR_TKL_UW_VV__s2_s2 131.07 _CNV_R_R_Def_t_sw_q_618_CM -3276.8 3276.7 FORMAT "%4.1"
 /begin AXIS_DESCR STD_AXIS Nkw _CNV_R_R_Def_n_sw_q_612_CM 6 -32768. 32767. FORMAT "%5.0" /end AXIS_DESCR
/end CHARACTERISTIC
/begin CHARACTERISTIC KL_VVTCLOSE "Sollwert Einlassventilhub fuer zufahren im Nachlauf" CURVE 0xa101f858 _REC_CUR_TKL_UW_VV__u2_s2 100.78768 _CNV_R_R_Def_exwink_601_CM 0. 179.978 FORMAT "%5.2"
 /begin AXIS_DESCR STD_AXIS Nkw _CNV_R_R_Def_n_sw_q_612_CM 5 -32768. 32767. FORMAT "%5.0" /end AXIS_DESCR
/end CHARACTERISTIC
/begin CHARACTERISTIC KL_VVTCLOSE_AT "Sollwert Einlassventilhub fuer zufahren im Nachlauf (ATG)" CURVE 0xa101f870 _REC_CUR_TKL_UW_VV__u2_s2 100.78768 _CNV_R_R_Def_exwink_601_CM 0. 179.978 FORMAT "%5.2"
 /begin AXIS_DESCR STD_AXIS Nkw _CNV_R_R_Def_n_sw_q_612_CM 5 -32768. 32767. FORMAT "%5.0" /end AXIS_DESCR
/end CHARACTERISTIC
/begin CHARACTERISTIC KL_WDKSNLN "Drosselklappenwinkel bei KL15 aus" CURVE 0xa101eee0 _REC_CUR_TKL_UW_VV__u2_s2 95.99852999999999 _CNV_R_R_Def_wdk_sw_691_CM 0. 1599.9755 FORMAT "%5.2"
 /begin AXIS_DESCR STD_AXIS Nkw _CNV_R_R_Def_n_sw_q_612_CM 8 -32768. 32767. FORMAT "%5.0" /end AXIS_DESCR
/end CHARACTERISTIC
/begin CHARACTERISTIC KL_WURZEL_ATL "Wurzelfunktion" CURVE 0xa100c2d0 _REC_CUR_TKL_UW_VV__u2_u2 1.9999 _CNV_R_R_Def_f_uw_b_579_CM 0. 1.9999 FORMAT "%14.5"
 /begin AXIS_DESCR STD_AXIS NO_INPUT_QUANTITY _CNV_R_R_Def_f_uw_b_579_CM 16 0. 1.9999 FORMAT "%14.5" /end AXIS_DESCR
/end CHARACTERISTIC
/begin CHARACTERISTIC KL_ZKPVDKDS "Zeitkonstante f. Druck vor DK" CURVE 0xa101e960 _REC_CUR_TKL_UW_VV__u1_s2 2.55 _CNV_R_R_Def_zk10ms_751_CM 1.e-002 2.56 FORMAT "%4.1"
 /begin AXIS_DESCR STD_AXIS Nkw _CNV_R_R_Def_n_sw_q_612_CM 8 -32768. 32767. FORMAT "%5.0" /end AXIS_DESCR
/end CHARACTERISTIC
/begin CHARACTERISTIC KL_ZKVNSI_LL "Huboffset temperaturabhängig " CURVE 0xa101f948 _REC_CUR_TKL_UW_VV__u2_s2 655.35 _CNV_R_R_Def_zk10ms_709_CM 1.e-002 655.36 FORMAT "%7.4"
 /begin AXIS_DESCR STD_AXIS Tmot _CNV_R_R_Def_t_sw_q_620_CM 4 -327.68 327.67 FORMAT "%5.2" /end AXIS_DESCR
/end CHARACTERISTIC
/begin CHARACTERISTIC KL_ZK_DRFSPUEL "Zeitkonstante f. Drf_spuel" CURVE 0xa101e97c _REC_CUR_TKL_UW_VV__u2_s2 6553.5 _CNV_R_R_Def_zk100m_735_CM 0.1 6553.6 FORMAT "%4.1"
 /begin AXIS_DESCR STD_AXIS Nkw _CNV_R_R_Def_n_sw_q_612_CM 4 -32768. 32767. FORMAT "%5.0" /end AXIS_DESCR
/end CHARACTERISTIC
/begin CHARACTERISTIC KL_ZK_DRFUK "Zeitkonstante f. Drf_uk" CURVE 0xa101e990 _REC_CUR_TKL_UW_VV__u2_s2 6553.5 _CNV_R_R_Def_zk100m_735_CM 0.1 6553.6 FORMAT "%4.1"
 /begin AXIS_DESCR STD_AXIS Nkw _CNV_R_R_Def_n_sw_q_612_CM 4 -32768. 32767. FORMAT "%5.0" /end AXIS_DESCR
/end CHARACTERISTIC
/begin CHARACTERISTIC KL_ZK_VNSDYNKOR "Zeitkonstante f. VNSDYNKOR" CURVE 0xa101e9a4 _REC_CUR_TKL_UW_VV__u2_s2 0.9999 _CNV_R_R_Def_f_uw_b_591_CM 0. 0.9999 FORMAT "%14.5"
 /begin AXIS_DESCR STD_AXIS Nkw _CNV_R_R_Def_n_sw_q_612_CM 4 -32768. 32767. FORMAT "%5.0" /end AXIS_DESCR
/end CHARACTERISTIC
/begin CHARACTERISTIC KL_ZRDPLD_MX "Anzahl aufsummierter Gradientenwerte - Mittelwertbildung" CURVE 0xa100c204 _REC_CUR_TKL_UW_VV__u1_s2 99.06 _CNV_R_R_Def_dez_sl_575_CM 1. 255. FORMAT "%3.0"
 /begin AXIS_DESCR STD_AXIS Nkw _CNV_R_R_Def_n_sw_q_612_CM 8 -32768. 32767. FORMAT "%5.0" /end AXIS_DESCR
/end CHARACTERISTIC
/begin CHARACTERISTIC KL_ZYLN "normiertes Zylindervolumen ueber Kurbelwellenwinkel" CURVE 0xa101f8ec _REC_CUR_TKL_UW_VV__u2_u2 0.9999 _CNV_R_R_Def_f_uw_b_591_CM 0. 0.9999 FORMAT "%14.5"
 /begin AXIS_DESCR STD_AXIS Vse_spris _CNV_R_R_Def_spr_sw_583_CM 10 0. 6553.5 FORMAT "%5.2" /end AXIS_DESCR
/end CHARACTERISTIC
/begin CHARACTERISTIC K_AGRPOS_SOLL "" VALUE 0xa101ffe4 _REC_VAL_20_u2 99.9984 _CNV_R_R_Def_f_uw_b_576_CM 0. 99.9984 /end CHARACTERISTIC
/begin CHARACTERISTIC K_ANZAHL_TURBOS "Anzahl Turbolader" VALUE 0xa1013060 _REC_VAL_20_u1 2. _CNV_R_R_Def_dez_sl_575_CM 0. 2. FORMAT "%3.0" /end CHARACTERISTIC
/begin CHARACTERISTIC K_ATLRD_VST "Manuelle Regeledifferenz fuer D-Anteil" VALUE 0xa100b50c _REC_VAL_20_u2 99.9984 _CNV_R_R_Def_f_uw_b_576_CM 0. 99.9984 /end CHARACTERISTIC
/begin CHARACTERISTIC K_ATLRI_INI "Initialisierung I Anteil" VALUE 0xa100b502 _REC_VAL_20_s2 99.99844999999999 _CNV_R_R_Def_rel_sw_584_CM -100. 99.9969 /end CHARACTERISTIC
/begin CHARACTERISTIC K_ATLRI_MN "Min. Limit I Anteil" VALUE 0xa100b504 _REC_VAL_20_s2 99.99844999999999 _CNV_R_R_Def_rel_sw_584_CM -100. 99.9969 /end CHARACTERISTIC
/begin CHARACTERISTIC K_ATLRI_MX "Max Limit I Anteil" VALUE 0xa100b506 _REC_VAL_20_s2 99.99844999999999 _CNV_R_R_Def_rel_sw_584_CM -100. 99.9969 /end CHARACTERISTIC
/begin CHARACTERISTIC K_ATLR_D "Stellwert D Anteil" VALUE 0xa100b50e _REC_VAL_20_s2 99.99844999999999 _CNV_R_R_Def_rel_sw_584_CM -100. 99.9969 /end CHARACTERISTIC
/begin CHARACTERISTIC K_ATLR_I "Stellwert I Anteil " VALUE 0xa100b4fc _REC_VAL_20_s2 99.99844999999999 _CNV_R_R_Def_rel_sw_584_CM -100. 99.9969 /end CHARACTERISTIC
/begin CHARACTERISTIC K_ATLR_MN "Max. Limit für ATL-Stellwert" VALUE 0xa100b4f6 _REC_VAL_20_u2 99.9984 _CNV_R_R_Def_f_uw_b_576_CM 0. 99.9984 /end CHARACTERISTIC
/begin CHARACTERISTIC K_ATLR_MX "Max. Limit für ATL-Stellwert" VALUE 0xa100b4f8 _REC_VAL_20_u2 99.9984 _CNV_R_R_Def_f_uw_b_576_CM 0. 99.9984 /end CHARACTERISTIC
/begin CHARACTERISTIC K_ATLR_P "Stellwert P Anteil " VALUE 0xa100b4fa _REC_VAL_20_s2 99.99844999999999 _CNV_R_R_Def_rel_sw_584_CM -100. 99.9969 /end CHARACTERISTIC
/begin CHARACTERISTIC K_ATLVST "ATL-Regler - Vorsteuerung manuell" VALUE 0xa100b4e4 _REC_VAL_20_u2 99.9984 _CNV_R_R_Def_f_uw_b_576_CM 0. 99.9984 /end CHARACTERISTIC
/begin CHARACTERISTIC K_ATLVST_DYN "Schwelle Vorsteuerung-Dynamik" VALUE 0xa100b4ea _REC_VAL_20_s2 99.99844999999999 _CNV_R_R_Def_rel_sw_584_CM -100. 99.9969 /end CHARACTERISTIC
/begin CHARACTERISTIC K_ATLVST_MN "Min. Obergrenze der Vorsteuerung" VALUE 0xa100b500 _REC_VAL_20_u2 99.9984 _CNV_R_R_Def_f_uw_b_576_CM 0. 99.9984 /end CHARACTERISTIC
/begin CHARACTERISTIC K_ATLVST_MX "Max. Untergrenze der Vorsteuerung" VALUE 0xa100b4fe _REC_VAL_20_u2 99.9984 _CNV_R_R_Def_f_uw_b_576_CM 0. 99.9984 /end CHARACTERISTIC
/begin CHARACTERISTIC K_ATLVST_TR "Schwelle Vorsteuerungsgradient f. transient Vorsteuerung" VALUE 0xa100b4f0 _REC_VAL_20_s2 99.99844999999999 _CNV_R_R_Def_rel_sw_584_CM -100. 99.9969 /end CHARACTERISTIC
/begin CHARACTERISTIC K_AVZUNASPR "" VALUE 0xa101f7a8 _REC_VAL_20_u2 131.07 _CNV_R_R_Def_spr_sw_583_CM 0. 6553.5 FORMAT "%5.2" /end CHARACTERISTIC
/begin CHARACTERISTIC K_BKVVERZ "Verzögerung Bremsunterdruck" VALUE 0xa100cbfd _REC_VAL_20_u1 7. _CNV_R_R_Def_dez_sl_575_CM 0. 7. FORMAT "%3.0" /end CHARACTERISTIC
/begin CHARACTERISTIC K_BLSVERZ "Verzögerungszeit Druckaufbau" VALUE 0xa100cbfc _REC_VAL_20_u1 25.5 _CNV_R_R_Def_td_ub__593_CM 0. 25.5 FORMAT "%4.1" /end CHARACTERISTIC
/begin CHARACTERISTIC K_CRENGOF "" VALUE 0xa10148e8 _REC_VAL_20_u2 81.91875 _CNV_R_R_Def_i_uw_q_644_CM 0. 4095.9375 /end CHARACTERISTIC
/begin CHARACTERISTIC K_CRVVTNOT "Wert vvt_iges bei vvt_es Fehlersignal" VALUE 0xa10148ea _REC_VAL_20_u2 81.91875 _CNV_R_R_Def_i_uw_q_644_CM 0. 4095.9375 /end CHARACTERISTIC
/begin CHARACTERISTIC K_CRVVTOF "" VALUE 0xa10148ec _REC_VAL_20_u2 81.91875 _CNV_R_R_Def_i_uw_q_644_CM 0. 4095.9375 /end CHARACTERISTIC
/begin CHARACTERISTIC K_DDPSSOLTE "" VALUE 0xa101e8d8 _REC_VAL_20_u2 0.9999 _CNV_R_R_Def_f_uw_b_591_CM 0. 0.9999 FORMAT "%14.5" /end CHARACTERISTIC
/begin CHARACTERISTIC K_DFRUTYP "DF-Rückschaltungstyp für LLR-Anhebung" VALUE 0xa1014adc _REC_VAL_20_u1 99.45 _CNV_R_R_Def_dez_sl_575_CM 0. 255. FORMAT "%3.0" /end CHARACTERISTIC
/begin CHARACTERISTIC K_DHUBDKNOTL "Rampensteigung Einlassventilhub zufahren bei DK-Notlauf" VALUE 0xa101f7de _REC_VAL_20_s2 98.30400000000002 _CNV_R_R_Def_dhub10_755_CM -3276.8 0. /end CHARACTERISTIC
/begin CHARACTERISTIC K_DHUBMD "Rampensteigung Einlassventilhub zufahren" VALUE 0xa101f7e0 _REC_VAL_20_s2 98.30400000000002 _CNV_R_R_Def_dhub10_755_CM -3276.8 0. /end CHARACTERISTIC
/begin CHARACTERISTIC K_DHUBMX "Maximalwert Einlassventilhubrampe" VALUE 0xa101f2b0 _REC_VAL_20_u2 12. _CNV_R_R_Def_hub_uw_605_CM 0. 12. /end CHARACTERISTIC
/begin CHARACTERISTIC K_DHUBVH "Rampensteigung Einlassventilhub auffahren im Start" VALUE 0xa101f7d8 _REC_VAL_20_s2 98.30099999999999 _CNV_R_R_Def_dhub10_755_CM 0. 3276.7 /end CHARACTERISTIC
/begin CHARACTERISTIC K_DHUBVHN1 "1. Rampensteigung Einlassventilhub auffahren bei B_gdvhub" VALUE 0xa101f7da _REC_VAL_20_s2 98.30099999999999 _CNV_R_R_Def_dhub10_755_CM 0. 3276.7 /end CHARACTERISTIC
/begin CHARACTERISTIC K_DHUBVHN2 "2. Rampensteigung Einlassventilhub auffahren bei B_gdvhub" VALUE 0xa101f7dc _REC_VAL_20_s2 98.30099999999999 _CNV_R_R_Def_dhub10_755_CM 0. 3276.7 /end CHARACTERISTIC
/begin CHARACTERISTIC K_DISANGRDLMTN "" VALUE 0xa1020394 _REC_VAL_20_s2 0. _CNV_R_R_Def_n_sw_q_612_CM -32768. 32767. FORMAT "%5.0" /end CHARACTERISTIC
/begin CHARACTERISTIC K_DISANGRDLMTP "" VALUE 0xa1020392 _REC_VAL_20_s2 0. _CNV_R_R_Def_n_sw_q_612_CM -32768. 32767. FORMAT "%5.0" /end CHARACTERISTIC
/begin CHARACTERISTIC K_DISAVL_12 "" VALUE 0xa1020386 _REC_VAL_20_s2 0. _CNV_R_R_Def_n_sw_q_612_CM -32768. 32767. FORMAT "%5.0" /end CHARACTERISTIC
/begin CHARACTERISTIC K_DISAVL_23 "" VALUE 0xa1020388 _REC_VAL_20_s2 0. _CNV_R_R_Def_n_sw_q_612_CM -32768. 32767. FORMAT "%5.0" /end CHARACTERISTIC
/begin CHARACTERISTIC K_DISAVL_34 "" VALUE 0xa102038a _REC_VAL_20_s2 0. _CNV_R_R_Def_n_sw_q_612_CM -32768. 32767. FORMAT "%5.0" /end CHARACTERISTIC
/begin CHARACTERISTIC K_DNWE "-" VALUE 0xa101f7c8 _REC_VAL_20_s2 0. _CNV_R_R_Def_n_sw_q_612_CM -32768. 10000. FORMAT "%5.0" /end CHARACTERISTIC
/begin CHARACTERISTIC K_DPBKV_MN "minimaler Bremsunterdruck" VALUE 0xa100cc06 _REC_VAL_20_u2 102.398436 _CNV_R_R_Def_p_sw_q_578_CM 0. 2559.9609 FORMAT "%5.2" /end CHARACTERISTIC
/begin CHARACTERISTIC K_DPLLMX "Maximales Druckverhaeltnis im LL gedrosselt" VALUE 0xa101e8e2 _REC_VAL_20_u2 3.9999 _CNV_R_R_Def_f_sw_b_608_CM 0. 3.9999 FORMAT "%14.5" /end CHARACTERISTIC
/begin CHARACTERISTIC K_DPSGRADTD "" VALUE 0xa101e8ec _REC_VAL_20_u2 6553.5 _CNV_R_R_Def_zk100m_735_CM 0.1 6553.6 FORMAT "%4.1" /end CHARACTERISTIC
/begin CHARACTERISTIC K_DPSGRADUTD "" VALUE 0xa101e8ea _REC_VAL_20_u2 6553.5 _CNV_R_R_Def_zk100m_735_CM 0.1 6553.6 FORMAT "%4.1" /end CHARACTERISTIC
/begin CHARACTERISTIC K_DPSGRENDK "Grenze fuer Teilgedrosseltbetrieb" VALUE 0xa101ee1c _REC_VAL_20_s2 102.398436 _CNV_R_R_Def_p_sw_q_578_CM -1280. 1279.9609 FORMAT "%5.2" /end CHARACTERISTIC
/begin CHARACTERISTIC K_DPSMAX "" VALUE 0xa101e8c0 _REC_VAL_20_s2 102.398436 _CNV_R_R_Def_p_sw_q_578_CM -1280. 1279.9609 FORMAT "%5.2" /end CHARACTERISTIC
/begin CHARACTERISTIC K_DPSMIN "" VALUE 0xa101e8be _REC_VAL_20_s2 102.398436 _CNV_R_R_Def_p_sw_q_578_CM -1280. 1279.9609 FORMAT "%5.2" /end CHARACTERISTIC
/begin CHARACTERISTIC K_DPSPVAGRMX "Maximales Druckverhältnis vor AGR" VALUE 0xa101ffe2 _REC_VAL_20_u2 0.9999 _CNV_R_R_Def_f_uw_b_591_CM 0. 0.9999 FORMAT "%14.5" /end CHARACTERISTIC
/begin CHARACTERISTIC K_DPSRAMPE "Steigung Rampe Dps_hub nach Kfdps_aus" VALUE 0xa101e8e6 _REC_VAL_20_u2 0.9999 _CNV_R_R_Def_f_uw_b_591_CM 0. 0.9999 FORMAT "%14.5" /end CHARACTERISTIC
/begin CHARACTERISTIC K_DPSSOLAPPL "Vorgabe Dpssol als Applikationswert" VALUE 0xa101e8ce _REC_VAL_20_s2 102.398436 _CNV_R_R_Def_p_sw_q_578_CM -1280. 1279.9609 FORMAT "%5.2" /end CHARACTERISTIC
/begin CHARACTERISTIC K_DPSSOL_MN "Minimal Dpssol" VALUE 0xa101e8cc _REC_VAL_20_s2 102.398436 _CNV_R_R_Def_p_sw_q_578_CM -1280. 1279.9609 FORMAT "%5.2" /end CHARACTERISTIC
/begin CHARACTERISTIC K_DPSTDHYSL "Hysterese Dpssoltd unterer Schwellwert" VALUE 0xa101e8c4 _REC_VAL_20_s2 102.398436 _CNV_R_R_Def_p_sw_q_578_CM -1280. 1279.9609 FORMAT "%5.2" /end CHARACTERISTIC
/begin CHARACTERISTIC K_DPSTDHYSR "Hysterese Dpssoltd oberer Schwellwert" VALUE 0xa101e8c2 _REC_VAL_20_s2 102.398436 _CNV_R_R_Def_p_sw_q_578_CM -1280. 1279.9609 FORMAT "%5.2" /end CHARACTERISTIC
/begin CHARACTERISTIC K_DPS_DTEV "-" VALUE 0xa101e8ee _REC_VAL_20_s2 102.398436 _CNV_R_R_Def_p_sw_q_578_CM -1280. 1279.9609 FORMAT "%5.2" /end CHARACTERISTIC
/begin CHARACTERISTIC K_DPU_ATL "Delta zu Umgebungsdruck" VALUE 0xa100c19e _REC_VAL_20_s2 102.398436 _CNV_R_R_Def_p_sw_q_578_CM -1280. 1279.9609 FORMAT "%5.2" /end CHARACTERISTIC
/begin CHARACTERISTIC K_DRFS_DYN "Schwelle Füllungsgradient f. Laderdynamik" VALUE 0xa100c1a0 _REC_VAL_20_s2 98.30250000000001 _CNV_R_R_Def_rf_sw__616_CM -327.68 327.67 FORMAT "%7.4" /end CHARACTERISTIC
/begin CHARACTERISTIC K_DRFS_DYNR "Schwelle Füllungsgradient f. Laderdynamik - Rücksetzen" VALUE 0xa100c1a2 _REC_VAL_20_s2 98.30250000000001 _CNV_R_R_Def_rf_sw__616_CM -327.68 327.67 FORMAT "%7.4" /end CHARACTERISTIC
/begin CHARACTERISTIC K_DRFVMXDKMN "" VALUE 0xa101ee1e _REC_VAL_20_s2 98.30250000000001 _CNV_R_R_Def_rf_sw__616_CM -327.68 327.67 FORMAT "%7.4" /end CHARACTERISTIC
/begin CHARACTERISTIC K_DSPRZG_AN "Offset Anschlagposition nach Kl15 aus" VAL_BLK 0xa101e842 _REC_VAL_2_u2 131.07 _CNV_R_R_Def_spr_sw_583_CM 0. 6553.5 FORMAT "%5.2" NUMBER 2 /end CHARACTERISTIC
/begin CHARACTERISTIC K_DTOG_UBMIN "" VALUE 0xa100de46 _REC_VAL_20_u2 123.46794 _CNV_R_R_Def_u_sb_q_598_CM 0. 6173.397 FORMAT "%4.1" /end CHARACTERISTIC
/begin CHARACTERISTIC K_EXWDIFLL_MN "Excenterwinkeldifferenz zur Aktivierung der Hubkorrektur" VALUE 0xa101f7e8 _REC_VAL_20_s2 99. _CNV_R_R_Def_exwink_601_CM -720. 180. FORMAT "%5.2" /end CHARACTERISTIC
/begin CHARACTERISTIC K_EXWDIFLL_MX "Excenterwinkeldifferenz zur Aktivierung der Hubkorrektur" VALUE 0xa101f7ea _REC_VAL_20_s2 99. _CNV_R_R_Def_exwink_601_CM -720. 180. FORMAT "%5.2" /end CHARACTERISTIC
/begin CHARACTERISTIC K_EXWIST_DIF "Ist-Excenterwinkeländerungsschwelle zur Deaktivierung der Hubkorrektur" VALUE 0xa101f7f0 _REC_VAL_20_u2 100.8 _CNV_R_R_Def_exwink_601_CM 0. 180. FORMAT "%5.2" /end CHARACTERISTIC
/begin CHARACTERISTIC K_EXWKOR_MN "Minimaler Excenter-Korrekturwinkel" VALUE 0xa101f800 _REC_VAL_20_s2 99. _CNV_R_R_Def_exwink_601_CM -720. 180. FORMAT "%5.2" /end CHARACTERISTIC
/begin CHARACTERISTIC K_EXWKOR_MX "Maximaler Excenter-Korrekturwinkel" VALUE 0xa101f802 _REC_VAL_20_s2 99. _CNV_R_R_Def_exwink_601_CM -720. 180. FORMAT "%5.2" /end CHARACTERISTIC
/begin CHARACTERISTIC K_EXWSOLL_DIF "Soll-Excenterwinkeländerungsschwelle zur Deaktivierung der Lernadaption zur Hubkorrektur" VALUE 0xa101f7f2 _REC_VAL_20_u2 100.8 _CNV_R_R_Def_exwink_601_CM 0. 180. FORMAT "%5.2" /end CHARACTERISTIC
/begin CHARACTERISTIC K_FATLR_I "Verstärkungsfaktor I Anteil - manueller Wert" VALUE 0xa100b508 _REC_VAL_20_u2 0.9999 _CNV_R_R_Def_f_uw_b_591_CM 0. 0.9999 FORMAT "%14.5" /end CHARACTERISTIC
/begin CHARACTERISTIC K_FEXWHKLL_DEK "Änderung des Faktor der Lernadaption bei zu grosser Hubverstellung" VALUE 0xa101f7f8 _REC_VAL_20_u2 1.9999 _CNV_R_R_Def_f_uw_b_579_CM 0. 1.9999 FORMAT "%14.5" /end CHARACTERISTIC
/begin CHARACTERISTIC K_FEXWHKLL_INK "Änderung des Faktor der Lernadaption bei zu geringer Hubverstellung" VALUE 0xa101f7fa _REC_VAL_20_u2 1.9999 _CNV_R_R_Def_f_uw_b_579_CM 0. 1.9999 FORMAT "%14.5" /end CHARACTERISTIC
/begin CHARACTERISTIC K_FEXWKOR_MN "Minimaler Faktor der Lernadaption" VALUE 0xa101f7fc _REC_VAL_20_u2 1.9999 _CNV_R_R_Def_f_uw_b_579_CM 0. 1.9999 FORMAT "%14.5" /end CHARACTERISTIC
/begin CHARACTERISTIC K_FEXWKOR_MX "Maximaler Faktor der Lernadaption" VALUE 0xa101f7fe _REC_VAL_20_u2 1.9999 _CNV_R_R_Def_f_uw_b_579_CM 0. 1.9999 FORMAT "%14.5" /end CHARACTERISTIC
/begin CHARACTERISTIC K_FHUBVNSMN "Minimalwert Vanoskorrekturfaktor" VALUE 0xa101f7be _REC_VAL_20_u2 1.9999 _CNV_R_R_Def_f_uw_b_579_CM 0. 1.9999 FORMAT "%14.5" /end CHARACTERISTIC
/begin CHARACTERISTIC K_FHUBVNSMX "Maximalwert Vanoskorrekturfaktor" VALUE 0xa101f7c0 _REC_VAL_20_u2 1.9999 _CNV_R_R_Def_f_uw_b_579_CM 0. 1.9999 FORMAT "%14.5" /end CHARACTERISTIC
/begin CHARACTERISTIC K_FHUBVNS_HD "" VALUE 0xa101f7a4 _REC_VAL_20_u1 1. _CNV_R_R_Def_dez_sl_575_CM 0. 1. FORMAT "%3.0" /end CHARACTERISTIC
/begin CHARACTERISTIC K_FHUB_NMX "-" VALUE 0xa101f7ca _REC_VAL_20_s2 0. _CNV_R_R_Def_n_sw_q_612_CM -32768. 32767. FORMAT "%5.0" /end CHARACTERISTIC
/begin CHARACTERISTIC K_FHUB_ST "" VALUE 0xa101f7bc _REC_VAL_20_u2 1.9999 _CNV_R_R_Def_f_uw_b_579_CM 0. 1.9999 FORMAT "%14.5" /end CHARACTERISTIC
/begin CHARACTERISTIC K_FHUB_VSAMN "" VALUE 0xa101f7b4 _REC_VAL_20_u2 131.07 _CNV_R_R_Def_spr_sw_583_CM 0. 6553.5 FORMAT "%5.2" /end CHARACTERISTIC
/begin CHARACTERISTIC K_FHUB_VSAMX "" VALUE 0xa101f7b6 _REC_VAL_20_u2 131.07 _CNV_R_R_Def_spr_sw_583_CM 0. 6553.5 FORMAT "%5.2" /end CHARACTERISTIC
/begin CHARACTERISTIC K_FHUB_VSEMN "" VALUE 0xa101f7b8 _REC_VAL_20_u2 131.07 _CNV_R_R_Def_spr_sw_583_CM 0. 6553.5 FORMAT "%5.2" /end CHARACTERISTIC
/begin CHARACTERISTIC K_FHUB_VSEMX "" VALUE 0xa101f7ba _REC_VAL_20_u2 131.07 _CNV_R_R_Def_spr_sw_583_CM 0. 6553.5 FORMAT "%5.2" /end CHARACTERISTIC
/begin CHARACTERISTIC K_FPSSOLHUB_MN "" VALUE 0xa101e8ba _REC_VAL_20_u2 0.9999 _CNV_R_R_Def_f_uw_b_591_CM 0. 0.9999 FORMAT "%14.5" /end CHARACTERISTIC
/begin CHARACTERISTIC K_FTEADMOD "" VALUE 0xa101e8da _REC_VAL_20_u2 0.9999 _CNV_R_R_Def_f_uw_b_591_CM 0. 0.9999 FORMAT "%14.5" /end CHARACTERISTIC
/begin CHARACTERISTIC K_FTEBLGMX "" VALUE 0xa101e8dc _REC_VAL_20_s2 99.83843999999999 _CNV_R_R_Def_f_sw_b_634_CM -64. 63.998 /end CHARACTERISTIC
/begin CHARACTERISTIC K_F_RFVNSHUB "" VALUE 0xa101e8b7 _REC_VAL_20_u1 0.996 _CNV_R_R_Def_f_ub_b_573_CM 0. 0.996 /end CHARACTERISTIC
/begin CHARACTERISTIC K_GENDFVORHS "Zeitkonstante Filterung DF Vorhersage" VALUE 0xa1014add _REC_VAL_20_u1 0.996 _CNV_R_R_Def_f_ub_b_573_CM 0. 0.996 /end CHARACTERISTIC
/begin CHARACTERISTIC K_GENPDTIME "Predrivetime für Ladekontrollampe KL61" VALUE 0xa1014af2 _REC_VAL_20_u1 25.5 _CNV_R_R_Def_td_ub__593_CM 0. 25.5 FORMAT "%4.1" /end CHARACTERISTIC
/begin CHARACTERISTIC K_GEN_DNMIN "Motordrehzahlschwelle  für Auswertung der Generatorfehler" VALUE 0xa1014ae4 _REC_VAL_20_s2 0. _CNV_R_R_Def_n_sw_q_612_CM -32768. 32767. FORMAT "%5.0" /end CHARACTERISTIC
/begin CHARACTERISTIC K_HUBAPP "Applikationswert Einlassventilhub" VALUE 0xa101f7c4 _REC_VAL_20_u2 12. _CNV_R_R_Def_hub_uw_605_CM 0. 12. /end CHARACTERISTIC
/begin CHARACTERISTIC K_HUBSGNL "Sollwert Einlassventilhub fuer Beginn Steuergeraetenachlauf" VALUE 0xa101f7c6 _REC_VAL_20_u2 12. _CNV_R_R_Def_hub_uw_605_CM 0. 12. /end CHARACTERISTIC
/begin CHARACTERISTIC K_IABGLMOT "Konstante Abgleichstrom Motor" VALUE 0xa10148e0 _REC_VAL_20_s2 65.535 _CNV_R_R_Def_i_sw_q_650_CM -32.768 32.767 /end CHARACTERISTIC
/begin CHARACTERISTIC K_IABGLNL "Konstante Abgleichstrom Kl. 15" VALUE 0xa10148e2 _REC_VAL_20_s2 65.535 _CNV_R_R_Def_i_sw_q_650_CM -32.768 32.767 /end CHARACTERISTIC
/begin CHARACTERISTIC K_IABGLST "Konstante Abgleichstrom Start" VALUE 0xa10148e4 _REC_VAL_20_s2 65.535 _CNV_R_R_Def_i_sw_q_650_CM -32.768 32.767 /end CHARACTERISTIC
/begin CHARACTERISTIC K_IGENLLRANH "Generatorstromabstand für LL-Anhebung" VALUE 0xa1014ade _REC_VAL_20_u1 99.06 _CNV_R_R_DEZ_436_CM 0. 254. /end CHARACTERISTIC
/begin CHARACTERISTIC K_IKEINESA "Konstante Strom wenn keine SA" VALUE 0xa10148e6 _REC_VAL_20_s2 65.535 _CNV_R_R_Def_i_sw_q_650_CM -32.768 32.767 /end CHARACTERISTIC
/begin CHARACTERISTIC K_IVVTHKLL_MX "Stromschwelle zur Deaktivierung der Hubkorrektur" VALUE 0xa101f7ec _REC_VAL_20_s2 81.91875 _CNV_R_R_Def_i_sw_q_761_CM -2048. 2047.9375 /end CHARACTERISTIC
/begin CHARACTERISTIC K_LLRABS_DF "DF-Schwelle für LL-Absenkung" VALUE 0xa1014adf _REC_VAL_20_u1 99.60930000000001 _CNV_R_R_Def_f_ub_b_602_CM 0. 99.60930000000001 FORMAT "%5.2" /end CHARACTERISTIC
/begin CHARACTERISTIC K_LLRANH_DF "DF-Schwelle für LL-Anhebung" VALUE 0xa1014ae0 _REC_VAL_20_u1 99.60930000000001 _CNV_R_R_Def_f_ub_b_602_CM 0. 99.60930000000001 FORMAT "%5.2" /end CHARACTERISTIC
/begin CHARACTERISTIC K_MAT_DKVL "Zuordnung VL-Wdk abhängig von Ba_ist" VAL_BLK 0xa101ee0c _REC_VAL_2_u1 1. _CNV_R_R_Def_dez_sl_575_CM 0. 1. FORMAT "%3.0" NUMBER 8 /end CHARACTERISTIC
/begin CHARACTERISTIC K_MAT_DPS "Zuordnung Eingang Ba-Umschaltung zu Betriebsart" VAL_BLK 0xa101e8a4 _REC_VAL_2_u1 99.45 _CNV_R_R_Def_dez_sl_575_CM 0. 255. FORMAT "%3.0" NUMBER 8 /end CHARACTERISTIC
/begin CHARACTERISTIC K_MAT_DPSFAK "Zuordnung Eingang Ba-Umschaltung zu Betriebsart" VAL_BLK 0xa101e8ac _REC_VAL_2_u1 99.45 _CNV_R_R_Def_dez_sl_575_CM 0. 255. FORMAT "%3.0" NUMBER 8 /end CHARACTERISTIC
/begin CHARACTERISTIC K_MAT_RFVVNS "Zuordnung Eingang Ba-Umschaltung zu Betriebsart" VAL_BLK 0xa101e89c _REC_VAL_2_u1 99.45 _CNV_R_R_Def_dez_sl_575_CM 0. 255. FORMAT "%3.0" NUMBER 8 /end CHARACTERISTIC
/begin CHARACTERISTIC K_MAX_PSSOLBER "" VALUE 0xa101e8f0 _REC_VAL_20_s2 102.398436 _CNV_R_R_Def_p_sw_q_578_CM -1280. 1279.9609 FORMAT "%5.2" /end CHARACTERISTIC
/begin CHARACTERISTIC K_MNHBHYSL "Hysterese Minhub unterer Schwellwert" VALUE 0xa101e8c6 _REC_VAL_20_s2 65.535 _CNV_R_R_Def_hub_uw_605_CM -32.768 32.767 /end CHARACTERISTIC
/begin CHARACTERISTIC K_MNHBHYSR "Hysterese Minhub oberer Schwellwert" VALUE 0xa101e8c8 _REC_VAL_20_s2 65.535 _CNV_R_R_Def_hub_uw_605_CM -32.768 32.767 /end CHARACTERISTIC
/begin CHARACTERISTIC K_MNHUBFTEMN "" VALUE 0xa101e8de _REC_VAL_20_s2 1.9999 _CNV_R_R_Def_f_uw_b_579_CM -1. 0.9999 FORMAT "%14.5" /end CHARACTERISTIC
/begin CHARACTERISTIC K_MSBKV_MX "maximaler Massenstrom Bremskraftverstärker" VALUE 0xa100cc04 _REC_VAL_20_u2 131.07 _CNV_R_R_Def_ml_uw__662_CM 0. 6553.5 FORMAT "%4.1" /end CHARACTERISTIC
/begin CHARACTERISTIC K_MSKGENDFP "Bitmaske Generator Fehler-> DFP" VALUE 0xa1014af3 _REC_VAL_20_u1 99.45 _CNV_R_R_Def_dez_sl_575_CM 0. 255. FORMAT "%3.0" /end CHARACTERISTIC
/begin CHARACTERISTIC K_MSKGENKL61 "Bitmaske fuer Generatorfehler -> Ladekontrolle" VALUE 0xa1014af4 _REC_VAL_20_u1 99.45 _CNV_R_R_Def_dez_sl_575_CM 0. 255. FORMAT "%3.0" /end CHARACTERISTIC
/begin CHARACTERISTIC K_MSKIBSDFP "Bitmaske Generator Fehler-> DFP" VALUE 0xa1014af9 _REC_VAL_20_u1 99.45 _CNV_R_R_Def_dez_sl_575_CM 0. 255. FORMAT "%3.0" /end CHARACTERISTIC
/begin CHARACTERISTIC K_MSKIBSDFP2 "" VALUE 0xa1014afa _REC_VAL_20_u1 99.45 _CNV_R_R_Def_dez_sl_575_CM 0. 255. FORMAT "%3.0" /end CHARACTERISTIC
/begin CHARACTERISTIC K_MSKIBSDIAG "Test AK disable Diagnose" VALUE 0xa1014afb _REC_VAL_20_u1 99.45 _CNV_R_R_Def_dez_sl_575_CM 0. 255. FORMAT "%3.0" /end CHARACTERISTIC
/begin CHARACTERISTIC K_MSKIBSERR "" VALUE 0xa1014afc _REC_VAL_20_u1 99.45 _CNV_R_R_Def_dez_sl_575_CM 0. 255. FORMAT "%3.0" /end CHARACTERISTIC
/begin CHARACTERISTIC K_MSKIBSERR2 "" VALUE 0xa1014afd _REC_VAL_20_u1 99.45 _CNV_R_R_Def_dez_sl_575_CM 0. 255. FORMAT "%3.0" /end CHARACTERISTIC
/begin CHARACTERISTIC K_MSNAGRMX "Maximales Druckverhältnis vor AGR" VALUE 0xa101ffe6 _REC_VAL_20_u2 102.39687 _CNV_R_R_Def_ms_uw__611_CM 3.13e-002 2047.9687 /end CHARACTERISTIC
/begin CHARACTERISTIC K_MSNLG "Leckluft DK geschlossen" VALUE 0xa101ee04 _REC_VAL_20_u2 81.91875 _CNV_R_R_Def_ms_uw__664_CM 0. 8191.875 FORMAT "%5.2" /end CHARACTERISTIC
/begin CHARACTERISTIC K_NKWHKLL_MN "Drehzahlschwelle zur Deaktivierung der Hubkorrektur" VALUE 0xa101f7e6 _REC_VAL_20_s2 0. _CNV_R_R_Def_n_sw_q_612_CM -32768. 32767. FORMAT "%5.0" /end CHARACTERISTIC
/begin CHARACTERISTIC K_NKWHKLL_MX "Drehzahlschwelle zur Deaktivierung der Hubkorrektur" VALUE 0xa101f7e4 _REC_VAL_20_s2 0. _CNV_R_R_Def_n_sw_q_612_CM -32768. 32767. FORMAT "%5.0" /end CHARACTERISTIC
/begin CHARACTERISTIC K_NTWBGLLGEN "Notlaufwert Leerlaufanhebung bei Generatorfehler" VALUE 0xa1014ae1 _REC_VAL_20_u1 1. _CNV_R_R_Def_dez_sl_575_CM 0. 1. FORMAT "%3.0" /end CHARACTERISTIC
/begin CHARACTERISTIC K_NV "" VAL_BLK 0xa100b1d0 _REC_VAL_2_u2 102.39842 _CNV_R_R_Def_qnv_uw_669_CM 0. 511.9921 NUMBER 7 /end CHARACTERISTIC
/begin CHARACTERISTIC K_NVGMN "" VAL_BLK 0xa100b19e _REC_VAL_2_s1 81.60000000000001 _CNV_R_R_Def_ngrd_s_668_CM -4096. 4064. FORMAT "%5.2" NUMBER 7 /end CHARACTERISTIC
/begin CHARACTERISTIC K_NVGMX "" VAL_BLK 0xa100b1a6 _REC_VAL_2_s1 81.60000000000001 _CNV_R_R_Def_ngrd_s_668_CM -4096. 4064. FORMAT "%5.2" NUMBER 7 /end CHARACTERISTIC
/begin CHARACTERISTIC K_NVNSAN "Drehzahlschwelle Anschlagserkennung" VALUE 0xa101e846 _REC_VAL_20_s2 0. _CNV_R_R_Def_n_sw_q_612_CM -32768. 32767. FORMAT "%5.0" /end CHARACTERISTIC
/begin CHARACTERISTIC K_NVO "" VAL_BLK 0xa100b1e0 _REC_VAL_2_u2 102.39842 _CNV_R_R_Def_qnv_uw_669_CM 0. 511.9921 NUMBER 7 /end CHARACTERISTIC
/begin CHARACTERISTIC K_NVV "Fz-Geschwindigkeit" VAL_BLK 0xa100b1f0 _REC_VAL_2_u2 100.8 _CNV_R_R_Def_v_uw_q_723_CM 0. 360. FORMAT "%5.0" NUMBER 7 /end CHARACTERISTIC
/begin CHARACTERISTIC K_NWADPOTO_DMX "Delta auf Anschlagsadaption für One-Tooth-Off Erkennung" VAL_BLK 0xa101e83e _REC_VAL_2_u2 131.07 _CNV_R_R_Def_spr_sw_583_CM 0. 6553.5 FORMAT "%5.2" NUMBER 2 /end CHARACTERISTIC
/begin CHARACTERISTIC K_NWADP_MN "Minimalwert Anschlagadaption" VAL_BLK 0xa101e836 _REC_VAL_2_u2 131.07 _CNV_R_R_Def_spr_sw_583_CM 0. 6553.5 FORMAT "%5.2" NUMBER 2 /end CHARACTERISTIC
/begin CHARACTERISTIC K_NWADP_MX "Maximalwert Anschlagadaption" VAL_BLK 0xa101e83a _REC_VAL_2_u2 131.07 _CNV_R_R_Def_spr_sw_583_CM 0. 6553.5 FORMAT "%5.2" NUMBER 2 /end CHARACTERISTIC
/begin CHARACTERISTIC K_N_DISAHYS "" VALUE 0xa102038c _REC_VAL_20_s2 0. _CNV_R_R_Def_n_sw_q_612_CM -32768. 32767. FORMAT "%5.0" /end CHARACTERISTIC
/begin CHARACTERISTIC K_OFFHUB_VNSAN "Offset auf Starthub wenn EVANOS nicht im Anschlag" VALUE 0xa101f7c2 _REC_VAL_20_u2 12. _CNV_R_R_Def_hub_uw_605_CM 0. 12. /end CHARACTERISTIC
/begin CHARACTERISTIC K_OZDIAGNMOT "Mindestdrehzahl zur QLT-Diagnose" VALUE 0xa100de40 _REC_VAL_20_s2 0. _CNV_R_R_Def_n_sw_q_612_CM -32768. 32767. FORMAT "%5.0" /end CHARACTERISTIC
/begin CHARACTERISTIC K_OZDIAGNMOT2 "Max Drehzahl zur QLT-Diagnose" VALUE 0xa100de42 _REC_VAL_20_s2 0. _CNV_R_R_Def_n_sw_q_612_CM -32768. 32767. FORMAT "%5.0" /end CHARACTERISTIC
/begin CHARACTERISTIC K_OZDIAGSPG "Spannung, unterhalb der die Diagnose ausgeblendet wird" VALUE 0xa100de48 _REC_VAL_20_u2 123.46794 _CNV_R_R_Def_u_sb_q_598_CM 0. 6173.397 FORMAT "%4.1" /end CHARACTERISTIC
/begin CHARACTERISTIC K_OZERRD "Entprellzeit Sensor- und Kommunikationsfehler" VALUE 0xa100de4a _REC_VAL_20_u2 0. _CNV_R_R_Def_dez_sl_575_CM 0. 65535. FORMAT "%5.0" /end CHARACTERISTIC
/begin CHARACTERISTIC K_OZHEAL "Entprellzeit Fehler-Healing" VALUE 0xa100de4c _REC_VAL_20_u2 0. _CNV_R_R_Def_dez_sl_575_CM 0. 65535. FORMAT "%5.0" /end CHARACTERISTIC
/begin CHARACTERISTIC K_OZPLTEMP "Max Temperatursprung QLT (Plausibilisierung wegen ASIC-Pins Bruch)" VALUE 0xa100de50 _REC_VAL_20_u1 99.45 _CNV_R_R_Def_dez_sl_575_CM 0. 255. FORMAT "%3.0" /end CHARACTERISTIC
/begin CHARACTERISTIC K_OZPLZTEMP "Max unplausibel Sprünge (Plausibilisierung wegen ASIC-Pins Bruch)" VALUE 0xa100de51 _REC_VAL_20_u1 99.45 _CNV_R_R_Def_dez_sl_575_CM 0. 255. FORMAT "%3.0" /end CHARACTERISTIC
/begin CHARACTERISTIC K_OZTEMPQERR "Temperaturschwelle für den Permittivitätsfehler" VALUE 0xa100de44 _REC_VAL_20_s2 131.07 _CNV_R_R_Def_t_sw_q_618_CM -3276.8 3276.7 FORMAT "%4.1" /end CHARACTERISTIC
/begin CHARACTERISTIC K_OZZTEMP "Max Zeit mit dem selben Temperaturwert (Plausibilisierung wegen ASIC-Pins Bruch)" VALUE 0xa100de4e _REC_VAL_20_u2 0. _CNV_R_R_Def_dez_sl_575_CM 0. 65535. FORMAT "%5.0" /end CHARACTERISTIC
/begin CHARACTERISTIC K_PAKPSNL_MIN "" VALUE 0xa101e8ca _REC_VAL_20_u2 0.9999 _CNV_R_R_Def_f_uw_b_591_CM 0. 0.9999 FORMAT "%14.5" /end CHARACTERISTIC
/begin CHARACTERISTIC K_PAK_MAN "Manueller Abgaskrümmerdruck" VALUE 0xa1012f90 _REC_VAL_20_u2 102.398436 _CNV_R_R_Def_p_sw_q_578_CM 0. 2559.9609 FORMAT "%5.2" /end CHARACTERISTIC
/begin CHARACTERISTIC K_PAK_MX "Maximalwert Abgaskrümmerdruck" VALUE 0xa1012f92 _REC_VAL_20_u2 102.398436 _CNV_R_R_Def_p_sw_q_578_CM 0. 2559.9609 FORMAT "%5.2" /end CHARACTERISTIC
/begin CHARACTERISTIC K_PGRD_PRD "Prädiktionsintervall" VALUE 0xa100c1ac _REC_VAL_20_u1 99.45 _CNV_R_R_Def_dez_sl_575_CM 0. 255. FORMAT "%3.0" /end CHARACTERISTIC
/begin CHARACTERISTIC K_PKAT_MAN "Manuelle Abgasgegendruck" VALUE 0xa1013008 _REC_VAL_20_u2 102.398436 _CNV_R_R_Def_p_sw_q_578_CM 0. 2559.9609 /end CHARACTERISTIC
/begin CHARACTERISTIC K_PLAUSAUS "Zeitdauer Ausschaltentprellung Plausibilisierung Fehler" VALUE 0xa1014ae8 _REC_VAL_20_u2 131.07 _CNV_R_R_Def_td_ub__593_CM 0. 6553.5 FORMAT "%4.1" /end CHARACTERISTIC
/begin CHARACTERISTIC K_PLAUSEIN "Zeitdauer Einschaltentprellung Plausibilisierung Fehler" VALUE 0xa1014aea _REC_VAL_20_u2 131.07 _CNV_R_R_Def_td_ub__593_CM 0. 6553.5 FORMAT "%4.1" /end CHARACTERISTIC
/begin CHARACTERISTIC K_PLDSDVST "Schwelle Sollladedruck Dynamik f. transient Vorsteuerung" VALUE 0xa100b4f2 _REC_VAL_20_s2 102.398436 _CNV_R_R_Def_p_sw_q_578_CM -1280. 1279.9609 FORMAT "%5.2" /end CHARACTERISTIC
/begin CHARACTERISTIC K_PLD_SOLL "" VALUE 0xa10202b0 _REC_VAL_20_u2 102.398436 _CNV_R_R_Def_p_sw_q_578_CM 0. 2559.9609 FORMAT "%5.2" /end CHARACTERISTIC
/begin CHARACTERISTIC K_PRELLDFAH "Prellzeit für LLR-Anhebung" VALUE 0xa1014ae2 _REC_VAL_20_u1 25.5 _CNV_R_R_Def_td_ub__593_CM 0. 25.5 FORMAT "%4.1" /end CHARACTERISTIC
/begin CHARACTERISTIC K_PRELLDFRF "Prellzeit für LLR-Absenkung" VALUE 0xa1014ae3 _REC_VAL_20_u1 25.5 _CNV_R_R_Def_td_ub__593_CM 0. 25.5 FORMAT "%4.1" /end CHARACTERISTIC
/begin CHARACTERISTIC K_PSPVDK_BLS "Schwellwert für Umschaltung Rf Solwert auf Istwert" VALUE 0xa101ffe8 _REC_VAL_20_u2 3.9999 _CNV_R_R_Def_f_sw_b_608_CM 0. 3.9999 FORMAT "%14.5" /end CHARACTERISTIC
/begin CHARACTERISTIC K_PSPVDK_SOLMAX "Maxwert Pspvdk_soll" VALUE 0xa101e88e _REC_VAL_20_u2 3.9999 _CNV_R_R_Def_f_sw_b_608_CM 0. 3.9999 FORMAT "%14.5" /end CHARACTERISTIC
/begin CHARACTERISTIC K_PSPVDK_SOLMAXGD "Maxwert Pspvdk_soll gedrosselt" VALUE 0xa101e892 _REC_VAL_20_u2 3.9999 _CNV_R_R_Def_f_sw_b_608_CM 0. 3.9999 FORMAT "%14.5" /end CHARACTERISTIC
/begin CHARACTERISTIC K_PSPVDK_SOLMAXUG "Maxwert Pspvdk_soll ungedrosselt" VALUE 0xa101e890 _REC_VAL_20_u2 3.9999 _CNV_R_R_Def_f_sw_b_608_CM 0. 3.9999 FORMAT "%14.5" /end CHARACTERISTIC
/begin CHARACTERISTIC K_PSPVDK_SOLMIN "Maxwert Pspvdk_soll" VALUE 0xa101e8e8 _REC_VAL_20_u2 3.9999 _CNV_R_R_Def_f_sw_b_608_CM 0. 3.9999 FORMAT "%14.5" /end CHARACTERISTIC
/begin CHARACTERISTIC K_PUNT_WSTG "Druck im Unterdruckspeicher der Wastegate-ansteuerung mit Unterdruck" VALUE 0xa1013058 _REC_VAL_20_u2 102.398436 _CNV_R_R_Def_p_sw_q_578_CM 0. 2559.9609 /end CHARACTERISTIC
/begin CHARACTERISTIC K_PVDKPNRFV_MX "" VALUE 0xa101e8bc _REC_VAL_20_u2 3.9999 _CNV_R_R_Def_f_sw_b_608_CM 0. 3.9999 FORMAT "%14.5" /end CHARACTERISTIC
/begin CHARACTERISTIC K_RFVHUBAPPL "Vorgabe Rfv_hub als Applikationswert" VALUE 0xa101e8d0 _REC_VAL_20_s2 98.30250000000001 _CNV_R_R_Def_rf_sw__616_CM -327.68 327.67 FORMAT "%7.4" /end CHARACTERISTIC
/begin CHARACTERISTIC K_SNMBSDKL61 "" VALUE 0xa1014ae6 _REC_VAL_20_s2 0. _CNV_R_R_Def_n_sw_q_612_CM -32768. 32767. FORMAT "%5.0" /end CHARACTERISTIC
/begin CHARACTERISTIC K_TABG_MAN "Manuelle Abgastemperatur" VALUE 0xa101305a _REC_VAL_20_u2 131.07 _CNV_R_R_Def_tkelvi_747_CM 0. 6553.5 FORMAT "%4.1" /end CHARACTERISTIC
/begin CHARACTERISTIC K_TATL_REF "Referenztemperatur f. normierten Luftmassenstrom in Kelvin" VALUE 0xa100c1a4 _REC_VAL_20_u2 99.40000000000001 _CNV_R_R_Def_tkelvi_747_CM 230. 370. FORMAT "%4.1" /end CHARACTERISTIC
/begin CHARACTERISTIC K_TDATLVSTGD "Verzögerungszeit für akt. Vorsteuerung im Teillast-Betrieb" VALUE 0xa100b4e6 _REC_VAL_20_u2 98.30250000000001 _CNV_R_R_Def_td_uw__679_CM 0. 655.35 FORMAT "%5.2" /end CHARACTERISTIC
/begin CHARACTERISTIC K_TDATLVSTKO "Verzögerungszeit für gespeicherte Vorsteuerungsgroesse" VALUE 0xa100b4ee _REC_VAL_20_u2 98.30250000000001 _CNV_R_R_Def_td_uw__679_CM 0. 655.35 FORMAT "%5.2" /end CHARACTERISTIC
/begin CHARACTERISTIC K_TDATLVSTTR "Verzögerungszeit für Transition der  Vorsteuerungsgroesse" VALUE 0xa100b4ec _REC_VAL_20_u2 98.30250000000001 _CNV_R_R_Def_td_uw__679_CM 0. 655.35 FORMAT "%5.2" /end CHARACTERISTIC
/begin CHARACTERISTIC K_TDDISADYNK "" VALUE 0xa1020390 _REC_VAL_20_u2 0.9999 _CNV_R_R_Def_f_uw_b_591_CM 0. 0.9999 FORMAT "%14.5" /end CHARACTERISTIC
/begin CHARACTERISTIC K_TDDISAHYS "" VALUE 0xa102038e _REC_VAL_20_u2 98.30250000000001 _CNV_R_R_Def_td_uw__679_CM 0. 655.35 FORMAT "%5.2" /end CHARACTERISTIC
/begin CHARACTERISTIC K_TDDISAVZ "" VALUE 0xa1020384 _REC_VAL_20_u1 0.19 _CNV_R_R_Def_td_uw__679_CM 0. 0.19 FORMAT "%5.2" /end CHARACTERISTIC
/begin CHARACTERISTIC K_TDFPSPLD "Zeit f. Ueberblendung " VALUE 0xa10202b2 _REC_VAL_20_u2 65.485 _CNV_R_R_Def_td_uw__592_CM 5.e-002 65.535 /end CHARACTERISTIC
/begin CHARACTERISTIC K_TDHKNACHL "Dauer für Hubkorrektur im Nachlauf aktiv" VALUE 0xa101f7d2 _REC_VAL_20_u2 98.30250000000001 _CNV_R_R_Def_td_uw__679_CM 0. 655.35 FORMAT "%5.2" /end CHARACTERISTIC
/begin CHARACTERISTIC K_TDHUBVHN1 "Dauer 1. Einlassventilhubrampe" VALUE 0xa101f7cc _REC_VAL_20_u2 98.30250000000001 _CNV_R_R_Def_td_uw__679_CM 0. 655.35 FORMAT "%5.2" /end CHARACTERISTIC
/begin CHARACTERISTIC K_TDNKW "" VALUE 0xa1020383 _REC_VAL_20_u1 0.29 _CNV_R_R_Def_td_uw__679_CM 0. 0.29 FORMAT "%5.2" /end CHARACTERISTIC
/begin CHARACTERISTIC K_TDNVAUS "" VAL_BLK 0xa100b1c0 _REC_VAL_2_u2 98.30250000000001 _CNV_R_R_Def_td_uw__679_CM 0. 655.35 FORMAT "%5.2" NUMBER 7 /end CHARACTERISTIC
/begin CHARACTERISTIC K_TDNVEIN "" VAL_BLK 0xa100b1b0 _REC_VAL_2_u2 98.30250000000001 _CNV_R_R_Def_td_uw__679_CM 0. 655.35 FORMAT "%5.2" NUMBER 7 /end CHARACTERISTIC
/begin CHARACTERISTIC K_TDULVDYN "Verzögerung f. ULV aktiv bei schnellen Druckabbau" VALUE 0xa100c1ad _REC_VAL_20_u1 2.55 _CNV_R_R_Def_td_uw__679_CM 0. 2.55 FORMAT "%5.2" /end CHARACTERISTIC
/begin CHARACTERISTIC K_TDULVDYNR "Dauer f. aktives ULV bei Druckabbau" VALUE 0xa100c1ae _REC_VAL_20_u1 2.55 _CNV_R_R_Def_td_uw__679_CM 0. 2.55 FORMAT "%5.2" /end CHARACTERISTIC
/begin CHARACTERISTIC K_TDULVDY_STE "Verzögerung nach Startende f. Druckdynamik Bereitschaft" VALUE 0xa100c1af _REC_VAL_20_u1 2.55 _CNV_R_R_Def_td_uw__679_CM 0. 2.55 FORMAT "%5.2" /end CHARACTERISTIC
/begin CHARACTERISTIC K_TD_BLLTD "" VALUE 0xa101e8e0 _REC_VAL_20_u2 98.30250000000001 _CNV_R_R_Def_td_uw__679_CM 0. 655.35 FORMAT "%5.2" /end CHARACTERISTIC
/begin CHARACTERISTIC K_TD_FTEBLGMXL "" VALUE 0xa101e8d4 _REC_VAL_20_s2 99.83843999999999 _CNV_R_R_Def_f_sw_b_634_CM -64. 63.998 /end CHARACTERISTIC
/begin CHARACTERISTIC K_TD_FTEBLGMXR "" VALUE 0xa101e8d2 _REC_VAL_20_s2 99.83843999999999 _CNV_R_R_Def_f_sw_b_634_CM -64. 63.998 /end CHARACTERISTIC
/begin CHARACTERISTIC K_TD_SPRON "" VALUE 0xa101f7d0 _REC_VAL_20_u2 98.30250000000001 _CNV_R_R_Def_td_uw__679_CM 0. 655.35 FORMAT "%5.2" /end CHARACTERISTIC
/begin CHARACTERISTIC K_TD_SPRONMX "" VALUE 0xa101f7ce _REC_VAL_20_u2 98.30250000000001 _CNV_R_R_Def_td_uw__679_CM 0. 655.35 FORMAT "%5.2" /end CHARACTERISTIC
/begin CHARACTERISTIC K_TD_TEONOFF "" VALUE 0xa101e8d6 _REC_VAL_20_u2 0.9999 _CNV_R_R_Def_f_uw_b_591_CM 0. 0.9999 FORMAT "%14.5" /end CHARACTERISTIC
/begin CHARACTERISTIC K_TD_UGENDIAG "Entprellzeit Unterspannungsdiagnose Generator" VALUE 0xa1014aec _REC_VAL_20_u2 131.07 _CNV_R_R_Def_td_ub__593_CM 0. 6553.5 FORMAT "%4.1" /end CHARACTERISTIC
/begin CHARACTERISTIC K_TEXWMX "Dauer für Einfrieren der drehzahlabhängigen Excenterwinkelbegrenzung (Schleppzeiger)" VALUE 0xa101f7d4 _REC_VAL_20_u2 0. _CNV_R_R_Def_td_uw__769_CM 0. 327675. FORMAT "%4.1" /end CHARACTERISTIC
/begin CHARACTERISTIC K_TFWDKSOM "Filterkonstant fuer Drosselklappesollwert KL15 Aus" VALUE 0xa101ee18 _REC_VAL_20_u2 655.35 _CNV_R_R_Def_zk10ms_709_CM 1.e-002 655.36 FORMAT "%7.4" /end CHARACTERISTIC
/begin CHARACTERISTIC K_THKLL_MX "Dauer, die eine Hubkorrektur kontinuierlich angefordert sein muss, um ausgeführt zu werden" VALUE 0xa101f7f4 _REC_VAL_20_u2 0. _CNV_R_R_Def_td_uw__769_CM 0. 327675. FORMAT "%4.1" /end CHARACTERISTIC
/begin CHARACTERISTIC K_THKLL_VZ "Wartezeit nach freigegebener Hubkorrektur, um die Verstellung zu erkennen" VALUE 0xa101f7f6 _REC_VAL_20_u2 0. _CNV_R_R_Def_td_uw__769_CM 0. 327675. FORMAT "%4.1" /end CHARACTERISTIC
/begin CHARACTERISTIC K_TMOTHKLL_MN "Temperaturschwelle zur Deaktivierung der Hubkorrektur" VALUE 0xa101f7ee _REC_VAL_20_s2 98.30250000000001 _CNV_R_R_Def_t_sw_q_620_CM -327.68 327.67 FORMAT "%5.2" /end CHARACTERISTIC
/begin CHARACTERISTIC K_TMSTHUBSTM "Temperaturschwelle Hub im Start Tmot_start abhängig" VALUE 0xa101f7e2 _REC_VAL_20_s2 98.30250000000001 _CNV_R_R_Def_t_sw_q_620_CM -327.68 327.67 FORMAT "%5.2" /end CHARACTERISTIC
/begin CHARACTERISTIC K_TOGMAXUNPL "" VALUE 0xa100de38 _REC_VAL_20_u4 0. _CNV_R_R_Def_dez_sl_575_CM 0. 4294967295. FORMAT "%7.0" /end CHARACTERISTIC
/begin CHARACTERISTIC K_TOG_CNTMAX "" VALUE 0xa100de3c _REC_VAL_20_u4 0. _CNV_R_R_Def_dez_sl_575_CM 0. 4294967295. FORMAT "%7.0" /end CHARACTERISTIC
/begin CHARACTERISTIC K_TVVTCLOSE "Zeitdauer fuer Hub herunterfahren" VALUE 0xa101f7d6 _REC_VAL_20_u2 98.30250000000001 _CNV_R_R_Def_td_uw__679_CM 0. 655.35 FORMAT "%5.2" /end CHARACTERISTIC
/begin CHARACTERISTIC K_TVWDKS "Verzörgerungszeit Drosseklappesollwert" VALUE 0xa101ee1a _REC_VAL_20_u2 5.e-002 _CNV_R_R_Def_td_uw__679_CM 0. 5.e-002 FORMAT "%5.2" /end CHARACTERISTIC
/begin CHARACTERISTIC K_TWDKVST "Filterkonstant fuer Drosselklappesollwert waehrend Start" VALUE 0xa101ee16 _REC_VAL_20_u2 655.35 _CNV_R_R_Def_zk10ms_709_CM 1.e-002 655.36 FORMAT "%7.4" /end CHARACTERISTIC
/begin CHARACTERISTIC K_UGENDIAG "Diagoseschwelle Generatorunterspannung" VALUE 0xa1014aee _REC_VAL_20_u2 123.46794 _CNV_R_R_Def_u_sb_q_598_CM 0. 6173.397 FORMAT "%4.1" /end CHARACTERISTIC
/begin CHARACTERISTIC K_UGOFFSET "Offset zur Schwelle Generatorunterspannungs Diagnose" VALUE 0xa1014af0 _REC_VAL_20_u2 123.46794 _CNV_R_R_Def_u_sb_q_598_CM 0. 6173.397 FORMAT "%4.1" /end CHARACTERISTIC
/begin CHARACTERISTIC K_VAK_INV "" VALUE 0xa1012f94 _REC_VAL_20_u2 7.9998 _CNV_R_R_Def_f_uw_b_631_CM 0. 7.9998 FORMAT "%7.4" /end CHARACTERISTIC
/begin CHARACTERISTIC K_VBKV "Volumen Bremskraftverstärker" VALUE 0xa100cbfe _REC_VAL_20_u1 7.8 _CNV_R_R_Def_niv_ub_677_CM 0. 7.8 FORMAT "%5.2" /end CHARACTERISTIC
/begin CHARACTERISTIC K_VKBKV "Volumenkonstante Bremskraftverstärker" VALUE 0xa100cbff _REC_VAL_20_u1 25.5 _CNV_R_R_Def_f_sw_q_658_CM 0. 25.5 FORMAT "%5.2" /end CHARACTERISTIC
/begin CHARACTERISTIC K_VNS_DELTMX "maximale Regelabweichung" VAL_BLK 0xa101e832 _REC_VAL_2_u2 131.07 _CNV_R_R_Def_spr_sw_583_CM 0. 6553.5 FORMAT "%5.2" NUMBER 2 /end CHARACTERISTIC
/begin CHARACTERISTIC K_VNS_ERRCNT "Eintragschwelle Vanosistposition ausserhalb Schwelle" VALUE 0xa101e82d _REC_VAL_20_u1 99.45 _CNV_R_R_Def_dez_sl_575_CM 0. 255. FORMAT "%3.0" /end CHARACTERISTIC
/begin CHARACTERISTIC K_VNS_TMN "minimale Temperaturschwelle für Diagnose VANOS" VALUE 0xa101e82e _REC_VAL_20_s2 98.30250000000001 _CNV_R_R_Def_t_sw_q_620_CM -327.68 327.67 FORMAT "%5.2" /end CHARACTERISTIC
/begin CHARACTERISTIC K_VNS_TMX "maximale Temperaturschwelle für Diagnose VANOS" VALUE 0xa101e830 _REC_VAL_20_s2 98.30250000000001 _CNV_R_R_Def_t_sw_q_620_CM -327.68 327.67 FORMAT "%5.2" /end CHARACTERISTIC
/begin CHARACTERISTIC K_VSASPRON_DIFF "" VALUE 0xa101f7ae _REC_VAL_20_u2 131.07 _CNV_R_R_Def_spr_sw_583_CM 0. 6553.5 FORMAT "%5.2" /end CHARACTERISTIC
/begin CHARACTERISTIC K_VSASPRON_MOV "" VALUE 0xa101f7b2 _REC_VAL_20_u2 131.07 _CNV_R_R_Def_spr_sw_583_CM 0. 6553.5 FORMAT "%5.2" /end CHARACTERISTIC
/begin CHARACTERISTIC K_VSEDIFF_MXLL "" VALUE 0xa101f7aa _REC_VAL_20_s2 131.07 _CNV_R_R_Def_spr_sw_583_CM -3276.8 3276.7 FORMAT "%5.2" /end CHARACTERISTIC
/begin CHARACTERISTIC K_VSESPRON_DIFF "" VALUE 0xa101f7ac _REC_VAL_20_u2 131.07 _CNV_R_R_Def_spr_sw_583_CM 0. 6553.5 FORMAT "%5.2" /end CHARACTERISTIC
/begin CHARACTERISTIC K_VSESPRON_MOV "" VALUE 0xa101f7b0 _REC_VAL_20_u2 131.07 _CNV_R_R_Def_spr_sw_583_CM 0. 6553.5 FORMAT "%5.2" /end CHARACTERISTIC
/begin CHARACTERISTIC K_WDKSAPP "Drosselklappensollwert für Applikationszwecke" VALUE 0xa101ee14 _REC_VAL_20_u2 95.99852999999999 _CNV_R_R_Def_wdk_sw_691_CM 0. 1599.9755 FORMAT "%5.2" /end CHARACTERISTIC
/begin CHARACTERISTIC K_ZKATLVST "Zeitkonstante f. transiente Vorsteuerung" VALUE 0xa100b4f4 _REC_VAL_20_u2 655.35 _CNV_R_R_Def_zk10ms_709_CM 1.e-002 655.36 FORMAT "%7.4" /end CHARACTERISTIC
/begin CHARACTERISTIC K_ZKATLVSTDYN "Zeitkonstante f. Erkennung Vorsteuerung-Dynamik" VALUE 0xa100b4e8 _REC_VAL_20_u2 655.35 _CNV_R_R_Def_zk10ms_709_CM 1.e-002 655.36 FORMAT "%7.4" /end CHARACTERISTIC
/begin CHARACTERISTIC K_ZKFTEV "Zeitkonstante fuer Ftev-Filter" VALUE 0xa1020046 _REC_VAL_20_u2 131.07 _CNV_R_R_Def_td_ub__593_CM 0. 6553.5 FORMAT "%4.1" /end CHARACTERISTIC
/begin CHARACTERISTIC K_ZKFTEVST "Zeitkonstante fuer Start-Filter" VALUE 0xa1020044 _REC_VAL_20_u2 131.07 _CNV_R_R_Def_td_ub__593_CM 0. 6553.5 FORMAT "%4.1" /end CHARACTERISTIC
/begin CHARACTERISTIC K_ZKMSVLD_DYN "Zeitkonstante für Massenstrom v. Verdichter" VALUE 0xa100c1a6 _REC_VAL_20_u2 65.52499999999999 _CNV_R_R_Def_td_uw__592_CM 1.e-002 65.535 /end CHARACTERISTIC
/begin CHARACTERISTIC K_ZKNKW_DYN "Zeitkonstante f. Motordrehzahl-Filterung" VALUE 0xa100b50a _REC_VAL_20_u2 655.35 _CNV_R_R_Def_zk10ms_709_CM 1.e-002 655.36 FORMAT "%7.4" /end CHARACTERISTIC
/begin CHARACTERISTIC K_ZKPLDR_DYN "Zeitkonstante für dyn. Ladedrucksollwert" VALUE 0xa100c1a8 _REC_VAL_20_u2 65.52499999999999 _CNV_R_R_Def_td_uw__592_CM 1.e-002 65.535 /end CHARACTERISTIC
/begin CHARACTERISTIC K_ZKPVDK_DYN "Zeitkonstante für Ladedruckistwert" VALUE 0xa100c1aa _REC_VAL_20_u2 65.52499999999999 _CNV_R_R_Def_td_uw__592_CM 1.e-002 65.535 /end CHARACTERISTIC
/begin CHARACTERISTIC K_ZKTEMPK "Zeitkonstante fuer Filter" VALUE 0xa102003c _REC_VAL_20_u2 131.07 _CNV_R_R_Def_td_ub__593_CM 0. 6553.5 FORMAT "%4.1" /end CHARACTERISTIC
/begin CHARACTERISTIC K_ZKTMOT_TEMPK "Zeitkonstante fuer Filter" VALUE 0xa1020042 _REC_VAL_20_u2 131.07 _CNV_R_R_Def_td_ub__593_CM 0. 6553.5 FORMAT "%4.1" /end CHARACTERISTIC
/begin CHARACTERISTIC K_ZK_DPBKV "Zeitkonstante für Dpbkv-Filter" VALUE 0xa100cc02 _REC_VAL_20_u2 6553.5 _CNV_R_R_Def_zk100m_735_CM 0.1 6553.6 FORMAT "%4.1" /end CHARACTERISTIC
/begin CHARACTERISTIC K_ZK_PBKV "Zeitkonstante für Pbkv-Filter" VALUE 0xa100cc00 _REC_VAL_20_u2 6553.5 _CNV_R_R_Def_zk100m_735_CM 0.1 6553.6 FORMAT "%4.1" /end CHARACTERISTIC
/begin CHARACTERISTIC K_ZK_PSSOLHUB "Zeitkonstante fuer 10ms Filterzyklus" VALUE 0xa101e8b8 _REC_VAL_20_u2 655.35 _CNV_R_R_Def_zk10ms_709_CM 1.e-002 655.36 FORMAT "%7.4" /end CHARACTERISTIC
/begin CHARACTERISTIC K_ZK_TABGAUSYT "Filterkonstante Abgastemperatur" VALUE 0xa101305c _REC_VAL_20_u2 0.9999847412109381 _CNV_R_R_Def_f_uw_b_591_CM 0. 0.9999847412109381 FORMAT "%14.5" /end CHARACTERISTIC
/begin CHARACTERISTIC K_ZK_WSTGS "Filterkonstante für Wastegatebetätigungsweg" VALUE 0xa101305e _REC_VAL_20_u2 0.9999847412109381 _CNV_R_R_Def_f_uw_b_591_CM 0. 0.9999847412109381 FORMAT "%14.5" /end CHARACTERISTIC
/begin CHARACTERISTIC K_ZTDDPS "Filterkonstante Soll-Differenzdruck Saugrohr" VALUE 0xa101e8e4 _REC_VAL_20_u2 99.9984 _CNV_R_R_Def_f_uw_b_576_CM 0. 99.9984 /end CHARACTERISTIC
/begin CHARACTERISTIC K_ZUE2BANK "Zuordnung Zündung zu Bank" VAL_BLK 0xa100c1b4 _REC_VAL_2_u1 1. _CNV_R_R_Def_dez_sl_575_CM 1. 2. FORMAT "%3.0" NUMBER 8 /end CHARACTERISTIC
/begin CHARACTERISTIC S_AGRPOS_SOLL "" VALUE 0xa101ffea _REC_VAL_20_u1 99.45 _CNV_R_R_Def_dez_sl_575_CM 0. 255. FORMAT "%3.0" /end CHARACTERISTIC
/begin CHARACTERISTIC S_ATLRD_MAN "D Anteil manuell bestimmt" VALUE 0xa100b4e1 _REC_VAL_20_u1 1. _CNV_R_R_Def_dez_sl_575_CM 0. 1. FORMAT "%3.0" /end CHARACTERISTIC
/begin CHARACTERISTIC S_ATLRD_VST "Regeldifferenz f. D Anteil manuell bestimmt" VALUE 0xa100b4e2 _REC_VAL_20_u1 1. _CNV_R_R_Def_dez_sl_575_CM 0. 1. FORMAT "%3.0" /end CHARACTERISTIC
/begin CHARACTERISTIC S_ATLRI_INI "I Anteil zurücksetzen" VALUE 0xa100b4df _REC_VAL_20_u1 1. _CNV_R_R_Def_dez_sl_575_CM 0. 1. FORMAT "%3.0" /end CHARACTERISTIC
/begin CHARACTERISTIC S_ATLRI_MAN "I Anteil manuell bestimmt" VALUE 0xa100b4dd _REC_VAL_20_u1 1. _CNV_R_R_Def_dez_sl_575_CM 0. 1. FORMAT "%3.0" /end CHARACTERISTIC
/begin CHARACTERISTIC S_ATLRI_PLD "Grenzwerte für I Anteil druckabhängig bestimmt" VALUE 0xa100b4e0 _REC_VAL_20_u1 1. _CNV_R_R_Def_dez_sl_575_CM 0. 1. FORMAT "%3.0" /end CHARACTERISTIC
/begin CHARACTERISTIC S_ATLRP_MAN "P Anteil manuell bestimmt" VALUE 0xa100b4dc _REC_VAL_20_u1 1. _CNV_R_R_Def_dez_sl_575_CM 0. 1. FORMAT "%3.0" /end CHARACTERISTIC
/begin CHARACTERISTIC S_ATLR_P "P Anteil bestimmt ohne Vorsteuergröße" VALUE 0xa100b4db _REC_VAL_20_u1 1. _CNV_R_R_Def_dez_sl_575_CM 0. 1. FORMAT "%3.0" /end CHARACTERISTIC
/begin CHARACTERISTIC S_ATLR_PI "Eingang D-Regler mit Summe P und I" VALUE 0xa100b4da _REC_VAL_20_u1 1. _CNV_R_R_Def_dez_sl_575_CM 0. 1. FORMAT "%3.0" /end CHARACTERISTIC
/begin CHARACTERISTIC S_ATLVST_MAN "Vorsteuerung manuell einstellbar" VALUE 0xa100b4d9 _REC_VAL_20_u1 1. _CNV_R_R_Def_dez_sl_575_CM 0. 1. FORMAT "%3.0" /end CHARACTERISTIC
/begin CHARACTERISTIC S_ATLVST_NKW "Ladedruck Vorsteuerung ohne Höheneinfluss" VALUE 0xa100b4e3 _REC_VAL_20_u1 1. _CNV_R_R_Def_dez_sl_575_CM 0. 1. FORMAT "%3.0" /end CHARACTERISTIC
/begin CHARACTERISTIC S_ATLVST_OFF "Summe Stellgrößen P und I Anteil ohne Vosteuerung" VALUE 0xa100b4d8 _REC_VAL_20_u1 1. _CNV_R_R_Def_dez_sl_575_CM 0. 1. FORMAT "%3.0" /end CHARACTERISTIC
/begin CHARACTERISTIC S_AUSY_KAT "Auswahl Druck vor Kat" VALUE 0xa101300b _REC_VAL_20_u1 1. _CNV_R_R_Def_dez_sl_575_CM 0. 1. FORMAT "%3.0" /end CHARACTERISTIC
/begin CHARACTERISTIC S_BSDKOORD "" VALUE 0xa1014af8 _REC_VAL_20_u1 1. _CNV_R_R_Def_dez_sl_575_CM 0. 1. FORMAT "%3.0" /end CHARACTERISTIC
/begin CHARACTERISTIC S_DISAAKT_ENA "" VALUE 0xa1020382 _REC_VAL_20_u1 99.45 _CNV_R_R_Def_dez_sl_575_CM 0. 255. FORMAT "%3.0" /end CHARACTERISTIC
/begin CHARACTERISTIC S_DISAAKT_ON "" VALUE 0xa1020381 _REC_VAL_20_u1 99.45 _CNV_R_R_Def_dez_sl_575_CM 0. 255. FORMAT "%3.0" /end CHARACTERISTIC
/begin CHARACTERISTIC S_DISADYNK_ON "" VALUE 0xa1020380 _REC_VAL_20_u1 99.45 _CNV_R_R_Def_dez_sl_575_CM 0. 255. FORMAT "%3.0" /end CHARACTERISTIC
/begin CHARACTERISTIC S_DPSSOLAPPL "Schalter Vorgabe Dpssol als Applikationswert" VALUE 0xa101e895 _REC_VAL_20_u1 99.45 _CNV_R_R_Def_dez_sl_575_CM 0. 255. FORMAT "%3.0" /end CHARACTERISTIC
/begin CHARACTERISTIC S_DPSTDO "gesetzt Dpssolfilt = Dps" VALUE 0xa101e8b4 _REC_VAL_20_u1 99.45 _CNV_R_R_Def_dez_sl_575_CM 0. 255. FORMAT "%3.0" /end CHARACTERISTIC
/begin CHARACTERISTIC S_ENUGDIAG "Freigabe Unterspannungsdiagnose Generator" VALUE 0xa1014af5 _REC_VAL_20_u1 1. _CNV_R_R_Def_dez_sl_575_CM 0. 1. FORMAT "%3.0" /end CHARACTERISTIC
/begin CHARACTERISTIC S_FATLRI_MAN "Verstärkung I Anteil manuell bestimmt" VALUE 0xa100b4de _REC_VAL_20_u1 1. _CNV_R_R_Def_dez_sl_575_CM 0. 1. FORMAT "%3.0" /end CHARACTERISTIC
/begin CHARACTERISTIC S_FHUBVNS_HD "" VALUE 0xa101f7a3 _REC_VAL_20_u1 1. _CNV_R_R_Def_dez_sl_575_CM 0. 1. FORMAT "%3.0" /end CHARACTERISTIC
/begin CHARACTERISTIC S_FTEV_TANS "Brennraumkorrektur mit Tans " VALUE 0xa102003e _REC_VAL_20_u1 1. _CNV_R_R_Def_dez_sl_575_CM 0. 1. FORMAT "%3.0" /end CHARACTERISTIC
/begin CHARACTERISTIC S_FTPVDKPN "" VALUE 0xa1020041 _REC_VAL_20_u1 1. _CNV_R_R_Def_dez_sl_575_CM 0. 1. FORMAT "%3.0" /end CHARACTERISTIC
/begin CHARACTERISTIC S_HFM_VG2 "Lage des Diagnose-HFM bei Verdichtergruppe 2" VALUE 0xa100c19c _REC_VAL_20_u1 1. _CNV_R_R_Def_dez_sl_575_CM 0. 1. FORMAT "%3.0" /end CHARACTERISTIC
/begin CHARACTERISTIC S_HKLL_TL "Schalter um die Hubkorrektur auch in der Teillast durchzuführen" VALUE 0xa101f7a5 _REC_VAL_20_u1 1. _CNV_R_R_Def_dez_sl_575_CM 0. 1. FORMAT "%3.0" /end CHARACTERISTIC
/begin CHARACTERISTIC S_HKLL_ZKOR "Schalter um die Hubkorrektur auch bei zylinderselektiver Hubkorrektur zu aktivieren" VALUE 0xa101f7a6 _REC_VAL_20_u1 1. _CNV_R_R_Def_dez_sl_575_CM 0. 1. FORMAT "%3.0" /end CHARACTERISTIC
/begin CHARACTERISTIC S_HUBEVSIM "Schalter Simulation Ventilhub Hubev_ist gleich Hubev_soll" VALUE 0xa101f7a2 _REC_VAL_20_u1 1. _CNV_R_R_Def_dez_sl_575_CM 0. 1. FORMAT "%3.0" /end CHARACTERISTIC
/begin CHARACTERISTIC S_HUBST "Schalter fuer Einlassventilhubvorsteuerung im Start" VALUE 0xa101f7a1 _REC_VAL_20_u1 1. _CNV_R_R_Def_dez_sl_575_CM 0. 1. FORMAT "%3.0" /end CHARACTERISTIC
/begin CHARACTERISTIC S_LABER_IST "Umschaltung La_ber von Soll auf Ist Wert" VALUE 0xa101ffe0 _REC_VAL_20_u1 99.45 _CNV_R_R_Def_dez_sl_575_CM 0. 255. FORMAT "%3.0" /end CHARACTERISTIC
/begin CHARACTERISTIC S_LLTD "" VALUE 0xa101e88c _REC_VAL_20_u1 99.45 _CNV_R_R_Def_dez_sl_575_CM 0. 255. FORMAT "%3.0" /end CHARACTERISTIC
/begin CHARACTERISTIC S_MSHFMVLD "Umschaltung auf gemessenen Massenstrom" VALUE 0xa100c1b0 _REC_VAL_20_u1 1. _CNV_R_R_Def_dez_sl_575_CM 0. 1. FORMAT "%3.0" /end CHARACTERISTIC
/begin CHARACTERISTIC S_OZBSDKOORD "BSD Koordinator aktiv" VALUE 0xa100de52 _REC_VAL_20_u1 99.45 _CNV_R_R_Def_dez_sl_575_CM 0. 255. FORMAT "%3.0" /end CHARACTERISTIC
/begin CHARACTERISTIC S_PAK_MAN "Schalter Vorgabe manueller Abgaskrümmerdruck" VALUE 0xa1012f97 _REC_VAL_20_u1 1. _CNV_R_R_Def_dez_sl_575_CM 0. 1. FORMAT "%3.0" /end CHARACTERISTIC
/begin CHARACTERISTIC S_PKAT_MAN "Auswahl manuelle Druck vor Kat" VALUE 0xa101300c _REC_VAL_20_u1 1. _CNV_R_R_Def_dez_sl_575_CM 0. 1. FORMAT "%3.0" /end CHARACTERISTIC
/begin CHARACTERISTIC S_PLDDGRD_MW "Gradient der Regelabweichung über Mittelwert-Bildung" VALUE 0xa100c1b1 _REC_VAL_20_u1 1. _CNV_R_R_Def_dez_sl_575_CM 0. 1. FORMAT "%3.0" /end CHARACTERISTIC
/begin CHARACTERISTIC S_PLDSOLL_APP "Ladedruck über Applikation" VALUE 0xa10202b4 _REC_VAL_20_u1 1. _CNV_R_R_Def_dez_sl_575_CM 0. 1. FORMAT "%3.0" /end CHARACTERISTIC
/begin CHARACTERISTIC S_PSIST_AUSYAK "Schalter Auswahl Saugrohrdrucdk" VALUE 0xa1012f98 _REC_VAL_20_u1 1. _CNV_R_R_Def_dez_sl_575_CM 0. 1. FORMAT "%3.0" /end CHARACTERISTIC
/begin CHARACTERISTIC S_PSIST_BLSAGR "Umschaltung von Soll auf Ist Wert PS für AGR" VALUE 0xa101ffeb _REC_VAL_20_u1 99.45 _CNV_R_R_Def_dez_sl_575_CM 0. 255. FORMAT "%3.0" /end CHARACTERISTIC
/begin CHARACTERISTIC S_PSPVDK_SOL "Freigabe Berechnung Pspvdk_soll" VALUE 0xa101e8b5 _REC_VAL_20_u1 99.45 _CNV_R_R_Def_dez_sl_575_CM 0. 255. FORMAT "%3.0" /end CHARACTERISTIC
/begin CHARACTERISTIC S_PSR_SGAPP "Schalter zum Auswählen ob Mssol(S=0) oder Mshfm_f in Berechnung Mssoldk eingehen soll" VALUE 0xa101ee09 _REC_VAL_20_u1 1. _CNV_R_R_Def_dez_sl_575_CM 0. 1. FORMAT "%3.0" /end CHARACTERISTIC
/begin CHARACTERISTIC S_PSSOLNL_KOR "" VALUE 0xa101e899 _REC_VAL_20_u1 99.45 _CNV_R_R_Def_dez_sl_575_CM 0. 255. FORMAT "%3.0" /end CHARACTERISTIC
/begin CHARACTERISTIC S_PSSOLNL_KOR2 "" VALUE 0xa101e894 _REC_VAL_20_u1 99.45 _CNV_R_R_Def_dez_sl_575_CM 0. 255. FORMAT "%3.0" /end CHARACTERISTIC
/begin CHARACTERISTIC S_PSSOL_UBEG "" VALUE 0xa101e8b6 _REC_VAL_20_u1 99.45 _CNV_R_R_Def_dez_sl_575_CM 0. 255. FORMAT "%3.0" /end CHARACTERISTIC
/begin CHARACTERISTIC S_PUEB_WSTG "Schalter Wastegateansteuerung mit Ladedruck (Üeberdruck)" VALUE 0xa1013061 _REC_VAL_20_u1 1. _CNV_R_R_Def_dez_sl_575_CM 0. 1. FORMAT "%3.0" /end CHARACTERISTIC
/begin CHARACTERISTIC S_PVDKPN_F "" VALUE 0xa1020040 _REC_VAL_20_u1 1. _CNV_R_R_Def_dez_sl_575_CM 0. 1. FORMAT "%3.0" /end CHARACTERISTIC
/begin CHARACTERISTIC S_RFVHUBAPPL "Schalter Vorgabe Rfv_hub als Applikationswert" VALUE 0xa101e896 _REC_VAL_20_u1 99.45 _CNV_R_R_Def_dez_sl_575_CM 0. 255. FORMAT "%3.0" /end CHARACTERISTIC
/begin CHARACTERISTIC S_RFVNS "Umschaltung zwischen Rfv_soll, Rfv_soll_vns" VALUE 0xa101e898 _REC_VAL_20_u1 99.45 _CNV_R_R_Def_dez_sl_575_CM 0. 255. FORMAT "%3.0" /end CHARACTERISTIC
/begin CHARACTERISTIC S_TABG_MAN "Schalter manuelle Abgastemperatur" VALUE 0xa1013062 _REC_VAL_20_u1 1. _CNV_R_R_Def_dez_sl_575_CM 0. 1. FORMAT "%3.0" /end CHARACTERISTIC
/begin CHARACTERISTIC S_TEDPS "" VALUE 0xa101e897 _REC_VAL_20_u1 99.45 _CNV_R_R_Def_dez_sl_575_CM 0. 255. FORMAT "%3.0" /end CHARACTERISTIC
/begin CHARACTERISTIC S_WDKSGD_OFF "Schalter zum Ausschalten Einfluss B_gd bei Wdk_soll im Start über Kennfeld" VALUE 0xa101ee08 _REC_VAL_20_u1 1. _CNV_R_R_Def_dez_sl_575_CM 0. 1. FORMAT "%3.0" /end CHARACTERISTIC
/begin CHARACTERISTIC S_WDK_START "Schalter, Wdk_soll im Start über Kennfeld" VALUE 0xa101ee07 _REC_VAL_20_u1 2. _CNV_R_R_Def_dez_sl_575_CM 0. 2. FORMAT "%3.0" /end CHARACTERISTIC
/begin CHARACTERISTIC S_WFTEV "Rfv_soll / Rfv_hub Schalter" VALUE 0xa102003f _REC_VAL_20_u1 1. _CNV_R_R_Def_dez_sl_575_CM 0. 1. FORMAT "%3.0" /end CHARACTERISTIC
/begin CHARACTERISTIC S_WG_MOD "Schalter Wastegate-Modell" VALUE 0xa1013063 _REC_VAL_20_u1 1. _CNV_R_R_Def_dez_sl_575_CM 0. 1. FORMAT "%3.0" /end CHARACTERISTIC
/begin COMPU_METHOD _CNV_R_R_DEZ_436_CM "" RAT_FUNC "%6.3" "" COEFFS 0. 1. 0. 0. 0. 1. /end COMPU_METHOD
/begin COMPU_METHOD _CNV_R_R_Def_f_ub_b_573_CM "Def_f_ub_b1" RAT_FUNC "%6.3" "-" COEFFS 0. 256. 0. 0. 0. 1. /end COMPU_METHOD
/begin COMPU_METHOD _CNV_R_R_Def_dez_sl_575_CM "Def_dez_sl_q1" RAT_FUNC "%6.3" "-" COEFFS 0. 1. 0. 0. 0. 1. /end COMPU_METHOD
/begin COMPU_METHOD _CNV_R_R_Def_f_uw_b_576_CM "Def_f_uw_b100" RAT_FUNC "%6.3" "%" COEFFS 0. 65536. 0. 0. 0. 100. /end COMPU_METHOD
/begin COMPU_METHOD _CNV_R_R_Def_f_sw_b_577_CM "Def_f_sw_b32" RAT_FUNC "%6.3" "-" COEFFS 0. 32768. 0. 0. 0. 32. /end COMPU_METHOD
/begin COMPU_METHOD _CNV_R_R_Def_p_sw_q_578_CM "Def_p_sw_q0p039" RAT_FUNC "%6.3" "hPa" COEFFS 0. 256. 0. 0. 0. 10. /end COMPU_METHOD
/begin COMPU_METHOD _CNV_R_R_Def_f_uw_b_579_CM "Def_f_uw_b2" RAT_FUNC "%6.3" "-" COEFFS 0. 65536. 0. 0. 0. 2. /end COMPU_METHOD
/begin COMPU_METHOD _CNV_R_R_Def_f_sw_p_581_CM "Def_f_sw_p0q25" RAT_FUNC "%6.3" "" COEFFS 0. 4. 0. 0. 0. 1. /end COMPU_METHOD
/begin COMPU_METHOD _CNV_R_R_Def_spr_sw_583_CM "Def_spr_sw_q0p1" RAT_FUNC "%6.3" "° KW" COEFFS 0. 10. 0. 0. 0. 1. /end COMPU_METHOD
/begin COMPU_METHOD _CNV_R_R_Def_rel_sw_584_CM "Def_rel_sw_b100" RAT_FUNC "%6.3" "%" COEFFS 0. 32768. 0. 0. 0. 100. /end COMPU_METHOD
/begin COMPU_METHOD _CNV_R_R_Def_f_uw_b_591_CM "Def_f_uw_b1" RAT_FUNC "%6.3" "-" COEFFS 0. 65536. 0. 0. 0. 1. /end COMPU_METHOD
/begin COMPU_METHOD _CNV_R_R_Def_td_uw__592_CM "Def_td_uw_q0p001" RAT_FUNC "%6.3" "ms" COEFFS 0. 1000. 0. 0. 0. 1. /end COMPU_METHOD
/begin COMPU_METHOD _CNV_R_R_Def_td_ub__593_CM "Def_td_ub_q0p1" RAT_FUNC "%6.3" "s" COEFFS 0. 10. 0. 0. 0. 1. /end COMPU_METHOD
/begin COMPU_METHOD _CNV_R_R_Def_f_uw_b_594_CM "Def_f_uw_b16" RAT_FUNC "%6.3" "-" COEFFS 0. 65536. 0. 0. 0. 16. /end COMPU_METHOD
/begin COMPU_METHOD _CNV_R_R_Def_f_sw_b_597_CM "Def_f_sw_b100" RAT_FUNC "%6.3" "-" COEFFS 0. 32768. 0. 0. 0. 100. /end COMPU_METHOD
/begin COMPU_METHOD _CNV_R_R_Def_u_sb_q_598_CM "Def_u_sb_q0p0942" RAT_FUNC "%6.3" "V" COEFFS 0. 1. 0. 0. 0. 9.420000000000001e-002 /end COMPU_METHOD
/begin COMPU_METHOD _CNV_R_R_Def_zw_sw__599_CM "Def_zw_sw_q0p1" RAT_FUNC "%6.3" "°" COEFFS 0. 10. 0. 0. 0. 1. /end COMPU_METHOD
/begin COMPU_METHOD _CNV_R_R_Def_exwink_601_CM "Def_exwink_uw_q0p022" RAT_FUNC "%6.3" "°" COEFFS 0. 8192. 0. 0. 0. 180. /end COMPU_METHOD
/begin COMPU_METHOD _CNV_R_R_Def_f_ub_b_602_CM "Def_f_ub_b100" RAT_FUNC "%6.3" "%" COEFFS 0. 256. 0. 0. 0. 100. /end COMPU_METHOD
/begin COMPU_METHOD _CNV_R_R_Def_f_uw_b_604_CM "Def_f_uw_b32" RAT_FUNC "%6.3" "-" COEFFS 0. 65536. 0. 0. 0. 32. /end COMPU_METHOD
/begin COMPU_METHOD _CNV_R_R_Def_hub_uw_605_CM "Def_hub_uw_q0p001" RAT_FUNC "%6.3" "mm" COEFFS 0. 1000. 0. 0. 0. 1. /end COMPU_METHOD
/begin COMPU_METHOD _CNV_R_R_Def_f_sw_b_606_CM "Def_f_sw_b4" RAT_FUNC "%6.3" "-" COEFFS 0. 32768. 0. 0. 0. 4. /end COMPU_METHOD
/begin COMPU_METHOD _CNV_R_R_Def_f_sw_b_608_CM "Def_f_sw_b2" RAT_FUNC "%6.3" "-" COEFFS 0. 65536. 0. 0. 0. 4. /end COMPU_METHOD
/begin COMPU_METHOD _CNV_R_R_Def_ms_uw__611_CM "Def_ms_uw_q0p03125" RAT_FUNC "%6.3" "kg/h" COEFFS 0. 32. 0. 0. 0. 1. /end COMPU_METHOD
/begin COMPU_METHOD _CNV_R_R_Def_n_sw_q_612_CM "Def_n_sw_q1p0" RAT_FUNC "%6.3" "Upm" COEFFS 0. 1. 0. 0. 0. 1. /end COMPU_METHOD
/begin COMPU_METHOD _CNV_R_R_Def_p_sw_q_613_CM "Def_p_sw_q0p1" RAT_FUNC "%6.3" "hPa" COEFFS 0. 10. 0. 0. 0. 1. /end COMPU_METHOD
/begin COMPU_METHOD _CNV_R_R_Def_p_sw_q_614_CM "Def_p_sw_q0p078" RAT_FUNC "%6.3" "hPa" COEFFS 0. 256. 0. 0. 0. 20. /end COMPU_METHOD
/begin COMPU_METHOD _CNV_R_R_Def_rf_sw__616_CM "Def_rf_sw_q0p01" RAT_FUNC "%6.3" "%" COEFFS 0. 100. 0. 0. 0. 1. /end COMPU_METHOD
/begin COMPU_METHOD _CNV_R_R_Def_t_sw_q_618_CM "Def_t_sw_q0p1" RAT_FUNC "%6.3" "°C" COEFFS 0. 10. 0. 0. 0. 1. /end COMPU_METHOD
/begin COMPU_METHOD _CNV_R_R_Def_t_sw_q_620_CM "Def_t_sw_q0p01" RAT_FUNC "%6.3" "°C" COEFFS 0. 100. 0. 0. 0. 1. /end COMPU_METHOD
/begin COMPU_METHOD _CNV_R_R_Def_f_ub_b_625_CM "Def_f_ub_b2" RAT_FUNC "%6.3" "-" COEFFS 0. 256. 0. 0. 0. 2. /end COMPU_METHOD
/begin COMPU_METHOD _CNV_R_R_Def_f_uw_b_631_CM "Def_f_uw_b8" RAT_FUNC "%6.3" "-" COEFFS 0. 65536. 0. 0. 0. 8. /end COMPU_METHOD
/begin COMPU_METHOD _CNV_R_R_Def_f_sw_b_634_CM "Def_f_sw_b64" RAT_FUNC "%6.3" "-" COEFFS 0. 65536. 0. 0. 0. 128. /end COMPU_METHOD
/begin COMPU_METHOD _CNV_R_R_Def_f_uw_b_636_CM "Def_f_uw_b512" RAT_FUNC "%6.3" "-" COEFFS 0. 65536. 0. 0. 0. 512. /end COMPU_METHOD
/begin COMPU_METHOD _CNV_R_R_Def_i_sw_q_638_CM "Def_i_sw_q1" RAT_FUNC "%6.3" "A" COEFFS 0. 1. 0. 0. 0. 1. /end COMPU_METHOD
/begin COMPU_METHOD _CNV_R_R_Def_f_uw_b_639_CM "Def_f_uw_b0p3" RAT_FUNC "%6.3" "%/hPa" COEFFS 0. 65536. 0. 0. 0. 0.3 /end COMPU_METHOD
/begin COMPU_METHOD _CNV_R_R_Def_i_uw_q_644_CM "Def_i_uw_q0p0635" RAT_FUNC "%6.3" "A" COEFFS 0. 65536. 0. 0. 0. 4096. /end COMPU_METHOD
/begin COMPU_METHOD _CNV_R_R_Def_i_ub_q_645_CM "Def_i_ub_q0p125" RAT_FUNC "%6.3" "A" COEFFS 0. 8. 0. 0. 0. 1. /end COMPU_METHOD
/begin COMPU_METHOD _CNV_R_R_Def_i_sw_q_650_CM "Def_i_sw_q0p001" RAT_FUNC "%6.3" "A" COEFFS 0. 1000. 0. 0. 0. 1. /end COMPU_METHOD
/begin COMPU_METHOD _CNV_R_R_Def_flae_u_654_CM "Def_flae_uw_q0p016" RAT_FUNC "%6.3" "mm*KW°" COEFFS 0. 1. 0. 0. 0. 1.6e-002 /end COMPU_METHOD
/begin COMPU_METHOD _CNV_R_R_Def_f_sw_q_658_CM "Def_f_sw_q0p1" RAT_FUNC "%6.3" "-" COEFFS 0. 10. 0. 0. 0. 1. /end COMPU_METHOD
/begin COMPU_METHOD _CNV_R_R_Def_ml_uw__662_CM "Def_ml_uw_q0p1" RAT_FUNC "%6.3" "kg/h" COEFFS 0. 10. 0. 0. 0. 1. /end COMPU_METHOD
/begin COMPU_METHOD _CNV_R_R_Def_ms_uw__664_CM "Def_ms_uw_b8192" RAT_FUNC "%6.3" "kg/h" COEFFS 0. 8. 0. 0. 0. 1. /end COMPU_METHOD
/begin COMPU_METHOD _CNV_R_R_Def_ngrd_s_668_CM "Def_ngrd_sb_q32p0" RAT_FUNC "%6.3" "Upm/s" COEFFS 0. 1. 0. 0. 0. 32. /end COMPU_METHOD
/begin COMPU_METHOD _CNV_R_R_Def_qnv_uw_669_CM "Def_qnv_uw_b512" RAT_FUNC "%6.3" "Upm/kmh" COEFFS 0. 65536. 0. 0. 0. 512. /end COMPU_METHOD
/begin COMPU_METHOD _CNV_R_R_Def_niv_ub_677_CM "Def_niv_ub_q0p1" RAT_FUNC "%6.3" "l" COEFFS 0. 10. 0. 0. 0. 1. /end COMPU_METHOD
/begin COMPU_METHOD _CNV_R_R_Def_td_uw__679_CM "Def_td_uw_q0p01" RAT_FUNC "%6.3" "s" COEFFS 0. 100. 0. 0. 0. 1. /end COMPU_METHOD
/begin COMPU_METHOD _CNV_R_R_Def_p_ub_q_686_CM "Def_p_ub_q0p39" RAT_FUNC "%6.3" "Bar" COEFFS 0. 256. 0. 0. 0. 100. /end COMPU_METHOD
/begin COMPU_METHOD _CNV_R_R_Def_wdk_sw_691_CM "Def_wdk_sw_q0p0244" RAT_FUNC "%6.3" "%" COEFFS 0. 4096. 0. 0. 0. 100. /end COMPU_METHOD
/begin COMPU_METHOD _CNV_S_1_Def_bit_ub_700_CM "Def_bit_ub_0" TAB_VERB "%6.3" "-" COMPU_TAB_REF _CNV_S_1_Def_bit_ub_700 /end COMPU_METHOD
/begin COMPU_VTAB _CNV_S_1_Def_bit_ub_700 "Def_bit_ub_0" TAB_VERB 1 0 "FALSE" /end COMPU_VTAB
/begin COMPU_METHOD _CNV_R_R_Def_zk10ms_709_CM "Def_zk10ms_uw_b655p36" RAT_FUNC "%6.3" "s" COEFFS 0. 0. 655.36 0. 1. 0. /end COMPU_METHOD
/begin COMPU_METHOD _CNV_R_R_Def_f_uw_b_710_CM "Def_f_uw_b0p5" RAT_FUNC "%6.3" "-" COEFFS 0. 65536. 0. 0. 0. 0.5 /end COMPU_METHOD
/begin COMPU_METHOD _CNV_R_R_Def_f_uw_b_713_CM "Def_f_uw_b0p125" RAT_FUNC "%6.3" "-" COEFFS 0. 65536. 0. 0. 0. 0.125 /end COMPU_METHOD
/begin COMPU_METHOD _CNV_R_R_Def_v_uw_q_723_CM "Def_v_uw_q1p0" RAT_FUNC "%6.3" "km/h" COEFFS 0. 1. 0. 0. 0. 1. /end COMPU_METHOD
/begin COMPU_METHOD _CNV_R_R_Def_vs_uw__731_CM "Def_vs_uw_b1280" RAT_FUNC "%6.3" "m^3/h" COEFFS 0. 65536. 0. 0. 0. 1280. /end COMPU_METHOD
/begin COMPU_METHOD _CNV_R_R_Def_zk100m_735_CM "Def_zk100ms_uw_b6553p6" RAT_FUNC "%6.3" "s" COEFFS 0. 0. 6553.6 0. 1. 0. /end COMPU_METHOD
/begin COMPU_METHOD _CNV_R_R_Def_f_ub_b_739_CM "Def_f_ub_b8" RAT_FUNC "%6.3" "-" COEFFS 0. 256. 0. 0. 0. 8. /end COMPU_METHOD
/begin COMPU_METHOD _CNV_R_R_Def_tkelvi_747_CM "Def_tkelvin_uw_q0p1" RAT_FUNC "%6.3" "K" COEFFS 0. 10. 0. 0. 0. 1. /end COMPU_METHOD
/begin COMPU_METHOD _CNV_R_R_Def_t_ub_b_748_CM "Def_t_ub_b0q01" RAT_FUNC "%6.3" "-" COEFFS 0. 25600. 0. 0. 0. 1. /end COMPU_METHOD
/begin COMPU_METHOD _CNV_R_R_Def_zk10ms_751_CM "Def_zk10ms_ub_b2p56" RAT_FUNC "%6.3" "s" COEFFS 0. 0. 2.56 0. 1. 0. /end COMPU_METHOD
/begin COMPU_METHOD _CNV_R_R_Def_dhub10_755_CM "Def_dhub10ms_sw_q0p1" RAT_FUNC "%6.3" "mm/s" COEFFS 0. 10. 0. 0. 0. 1. /end COMPU_METHOD
/begin COMPU_METHOD _CNV_R_R_Def_i_sw_q_761_CM "Def_i_sw_q0p0625" RAT_FUNC "%6.3" "A" COEFFS 0. 1000. 0. 0. 0. 62.5 /end COMPU_METHOD
/begin COMPU_METHOD _CNV_R_R_Def_td_uw__769_CM "Def_td_uw_q5p0" RAT_FUNC "%6.3" "ms" COEFFS 0. 1. 0. 0. 0. 5. /end COMPU_METHOD
/begin RECORD_LAYOUT _REC_VAL_20_u1 FNC_VALUES 1 UBYTE COLUMN_DIR DIRECT /end RECORD_LAYOUT
/begin RECORD_LAYOUT _REC_VAL_20_u2 FNC_VALUES 1 UWORD COLUMN_DIR DIRECT /end RECORD_LAYOUT
/begin RECORD_LAYOUT _REC_VAL_20_s2 FNC_VALUES 1 SWORD COLUMN_DIR DIRECT /end RECORD_LAYOUT
/begin RECORD_LAYOUT _REC_VAL_20_u4 FNC_VALUES 1 ULONG COLUMN_DIR DIRECT /end RECORD_LAYOUT
/begin RECORD_LAYOUT _REC_MAP_52_UBYTE_u2_s2_s2 NO_AXIS_PTS_X 1 UBYTE NO_AXIS_PTS_Y 2 UBYTE AXIS_PTS_X 3 SWORD INDEX_INCR DIRECT AXIS_PTS_Y 4 SWORD INDEX_INCR DIRECT FNC_VALUES 5 UWORD COLUMN_DIR DIRECT /end RECORD_LAYOUT
/begin RECORD_LAYOUT _REC_MAP_52_UBYTE_u2_s2_u2 NO_AXIS_PTS_X 1 UBYTE NO_AXIS_PTS_Y 2 UBYTE AXIS_PTS_X 3 SWORD INDEX_INCR DIRECT AXIS_PTS_Y 4 UWORD INDEX_INCR DIRECT FNC_VALUES 5 UWORD COLUMN_DIR DIRECT /end RECORD_LAYOUT
/begin RECORD_LAYOUT _REC_MAP_52_UBYTE_u2_u2_u2 NO_AXIS_PTS_X 1 UBYTE NO_AXIS_PTS_Y 2 UBYTE AXIS_PTS_X 3 UWORD INDEX_INCR DIRECT AXIS_PTS_Y 4 UWORD INDEX_INCR DIRECT FNC_VALUES 5 UWORD COLUMN_DIR DIRECT /end RECORD_LAYOUT
/begin RECORD_LAYOUT _REC_MAP_52_u1_s2_s2 NO_AXIS_PTS_X 1 UBYTE NO_AXIS_PTS_Y 2 UBYTE AXIS_PTS_X 3 SWORD INDEX_INCR DIRECT AXIS_PTS_Y 4 SWORD INDEX_INCR DIRECT FNC_VALUES 5 UBYTE COLUMN_DIR DIRECT /end RECORD_LAYOUT
/begin RECORD_LAYOUT _REC_MAP_52_UBYTE_s2_s2_s2 NO_AXIS_PTS_X 1 UBYTE NO_AXIS_PTS_Y 2 UBYTE AXIS_PTS_X 3 SWORD INDEX_INCR DIRECT AXIS_PTS_Y 4 SWORD INDEX_INCR DIRECT FNC_VALUES 5 SWORD COLUMN_DIR DIRECT /end RECORD_LAYOUT
/begin RECORD_LAYOUT _REC_MAP_52_UBYTE_u2_u2_s2 NO_AXIS_PTS_X 1 UBYTE NO_AXIS_PTS_Y 2 UBYTE AXIS_PTS_X 3 UWORD INDEX_INCR DIRECT AXIS_PTS_Y 4 SWORD INDEX_INCR DIRECT FNC_VALUES 5 UWORD COLUMN_DIR DIRECT /end RECORD_LAYOUT
/begin RECORD_LAYOUT _REC_MAP_52_UBYTE_s2_u2_u2 NO_AXIS_PTS_X 1 UBYTE NO_AXIS_PTS_Y 2 UBYTE AXIS_PTS_X 3 UWORD INDEX_INCR DIRECT AXIS_PTS_Y 4 UWORD INDEX_INCR DIRECT FNC_VALUES 5 SWORD COLUMN_DIR DIRECT /end RECORD_LAYOUT
/begin RECORD_LAYOUT _REC_MAP_52_UBYTE_s2_s2_u1 NO_AXIS_PTS_X 1 UBYTE NO_AXIS_PTS_Y 2 UBYTE AXIS_PTS_X 3 SWORD INDEX_INCR DIRECT AXIS_PTS_Y 4 UBYTE INDEX_INCR DIRECT FNC_VALUES 5 SWORD COLUMN_DIR DIRECT /end RECORD_LAYOUT
/begin RECORD_LAYOUT _REC_MAP_52_UBYTE_s2_u2_s2 NO_AXIS_PTS_X 1 UBYTE NO_AXIS_PTS_Y 2 UBYTE AXIS_PTS_X 3 UWORD INDEX_INCR DIRECT AXIS_PTS_Y 4 SWORD INDEX_INCR DIRECT FNC_VALUES 5 SWORD COLUMN_DIR DIRECT /end RECORD_LAYOUT
/begin RECORD_LAYOUT _REC_MAP_52_UBYTE_u2_u1_u2 NO_AXIS_PTS_X 1 UBYTE NO_AXIS_PTS_Y 2 UBYTE AXIS_PTS_X 3 UBYTE INDEX_INCR DIRECT AXIS_PTS_Y 4 UWORD INDEX_INCR DIRECT FNC_VALUES 5 UWORD COLUMN_DIR DIRECT /end RECORD_LAYOUT
/begin RECORD_LAYOUT _REC_CUR_TKL_UW_VV__u2_u2 NO_AXIS_PTS_X 1 UBYTE RESERVED 2 BYTE AXIS_PTS_X 3 UWORD INDEX_INCR DIRECT FNC_VALUES 4 UWORD COLUMN_DIR DIRECT /end RECORD_LAYOUT
/begin RECORD_LAYOUT _REC_CUR_TKL_UW_VV__u2_s2 NO_AXIS_PTS_X 1 UBYTE RESERVED 2 BYTE AXIS_PTS_X 3 SWORD INDEX_INCR DIRECT FNC_VALUES 4 UWORD COLUMN_DIR DIRECT /end RECORD_LAYOUT
/begin RECORD_LAYOUT _REC_CUR_TKL_UW_VV__u1_s2 NO_AXIS_PTS_X 1 UBYTE RESERVED 2 BYTE AXIS_PTS_X 3 SWORD INDEX_INCR DIRECT FNC_VALUES 4 UBYTE COLUMN_DIR DIRECT /end RECORD_LAYOUT
/begin RECORD_LAYOUT _REC_CUR_TKL_UW_VV__u1_u2 NO_AXIS_PTS_X 1 UBYTE RESERVED 2 BYTE AXIS_PTS_X 3 UWORD INDEX_INCR DIRECT FNC_VALUES 4 UBYTE COLUMN_DIR DIRECT /end RECORD_LAYOUT
/begin RECORD_LAYOUT _REC_CUR_TKL_UW_VV__s2_u2 NO_AXIS_PTS_X 1 UBYTE RESERVED 2 BYTE AXIS_PTS_X 3 UWORD INDEX_INCR DIRECT FNC_VALUES 4 SWORD COLUMN_DIR DIRECT /end RECORD_LAYOUT
/begin RECORD_LAYOUT _REC_CUR_TKL_UW_VV__s2_s2 NO_AXIS_PTS_X 1 UBYTE RESERVED 2 BYTE AXIS_PTS_X 3 SWORD INDEX_INCR DIRECT FNC_VALUES 4 SWORD COLUMN_DIR DIRECT /end RECORD_LAYOUT
/begin RECORD_LAYOUT _REC_CUR_TKL_UW_VV__u1_u1 NO_AXIS_PTS_X 1 UBYTE RESERVED 2 BYTE AXIS_PTS_X 3 UBYTE INDEX_INCR DIRECT FNC_VALUES 4 UBYTE COLUMN_DIR DIRECT /end RECORD_LAYOUT
/begin RECORD_LAYOUT _REC_CUR_TKL_UW_VV__S4_S4 NO_AXIS_PTS_X 1 UBYTE RESERVED 2 BYTE AXIS_PTS_X 3 FLOAT32_IEEE INDEX_INCR DIRECT FNC_VALUES 4 FLOAT32_IEEE COLUMN_DIR DIRECT /end RECORD_LAYOUT
/begin RECORD_LAYOUT _REC_VAL_2_u1 FNC_VALUES 1 UBYTE COLUMN_DIR DIRECT /end RECORD_LAYOUT
/begin RECORD_LAYOUT _REC_VAL_2_u2 FNC_VALUES 1 UWORD COLUMN_DIR DIRECT /end RECORD_LAYOUT
/begin RECORD_LAYOUT _REC_VAL_2_s1 FNC_VALUES 1 SBYTE COLUMN_DIR DIRECT /end RECORD_LAYOUT
/begin FUNCTION ATLREG ""
 /begin DEF_CHARACTERISTIC KF_ATLRI_MN KF_ATLRI_MX KF_ATLR_P KF_ATLVST KF_ATLVST_GD KF_ATLVST_NKW KF_FATLRD KF_FATLR_I KF_FATLR_P KL_ATLVST_P KL_ATLVST_T KL_FATLRD_N K_ATLRD_VST K_ATLRI_INI K_ATLRI_MN K_ATLRI_MX K_ATLR_D K_ATLR_I K_ATLR_MN K_ATLR_MX K_ATLR_P K_ATLVST K_ATLVST_DYN K_ATLVST_MN K_ATLVST_MX K_ATLVST_TR K_FATLR_I K_PLDSDVST K_TDATLVSTGD K_TDATLVSTKO K_TDATLVSTTR K_ZKATLVST K_ZKATLVSTDYN K_ZKNKW_DYN S_ATLRD_MAN S_ATLRD_VST S_ATLRI_INI S_ATLRI_MAN S_ATLRI_PLD S_ATLRP_MAN S_ATLR_P S_ATLR_PI S_ATLVST_MAN S_ATLVST_NKW S_ATLVST_OFF S_FATLRI_MAN /end DEF_CHARACTERISTIC
 /begin OUT_MEASUREMENT Atlr Atlr_d Atlr_i Atlr_p Atlr_pi Atlvst Atlvst_dyn Atlvst_f Atlvst_tmp F_psspu Nkw_dyn St_atlreg St_atlreg.B_atlvst_neg St_atlreg.B_atlvst_tr /end OUT_MEASUREMENT
/end FUNCTION
/begin FUNCTION ATLSTAT ""
 /begin DEF_CHARACTERISTIC KF_PLD_SPORT KL_FGRPLD KL_FKPLDSVLD KL_FKVSVLD KL_FSEG_DPLD KL_PGRD_PRD KL_PU2PLD KL_PUPVLD KL_ULVR KL_ULVRHYS KL_WURZEL_ATL KL_ZRDPLD_MX K_DPU_ATL K_DRFS_DYN K_DRFS_DYNR K_PGRD_PRD K_TATL_REF K_TDULVDYN K_TDULVDYNR K_TDULVDY_STE K_ZKMSVLD_DYN K_ZKPLDR_DYN K_ZKPVDK_DYN K_ZUE2BANK S_HFM_VG2 S_MSHFMVLD S_PLDDGRD_MW /end DEF_CHARACTERISTIC
 /begin OUT_MEASUREMENT Dpld_grd_mem F_pldpu F_pldsvld_f Msvld Msvld_dyn Pld_dgrd Pld_diff Pld_diff_fil Pld_diff_grd Pldr_soll Pldrsoll_dyn Pldsoll_mx Ppump_mx Pvdkds_dyn Pvld St_atlstat St_atlstat.B_atlr St_atlstat.B_ulvdyn St_atlstat.B_ulvr Vsldn Vsvld Vsvld_f Zgsplddgrd Zw_mw1 Zw_mw2 /end OUT_MEASUREMENT
/end FUNCTION
/begin FUNCTION AUSY_AK ""
 /begin DEF_CHARACTERISTIC CW_MS_AK_MAN KL_PAKOFFS_SPUEL KL_PAKOFFS_UK KL_TSEG K_PAK_MAN K_PAK_MX K_VAK_INV S_PAK_MAN S_PSIST_AUSYAK /end DEF_CHARACTERISTIC
 /begin OUT_MEASUREMENT F_dps2dpms_turb F_vakinv_tabg Mk_ausy Msak_diff Msturb_diff_tseg Pak Pak_diff Pak_diff_2 Pak_diff_tseg Pakpn Pakps Pspak Pspn Tseg_sec /end OUT_MEASUREMENT
/end FUNCTION
/begin FUNCTION AUSY_KAT ""
 /begin DEF_CHARACTERISTIC CW_MS_TURB_MAN KL_AUSY_KAT KL_AUSY_KAT_N K_PKAT_MAN S_AUSY_KAT S_PKAT_MAN /end DEF_CHARACTERISTIC
 /begin OUT_MEASUREMENT Pkat Pkat_rel /end OUT_MEASUREMENT
/end FUNCTION
/begin FUNCTION AUSY_TURB ""
 /begin DEF_CHARACTERISTIC KF_AUSY_TURB KF_AUSY_TURB_DIFF KF_FPWSTGDSE KF_WSTG_S KL_AUSY_TURB KL_TABG2TABG_WZINV K_ANZAHL_TURBOS K_PUNT_WSTG K_TABG_MAN K_ZK_TABGAUSYT K_ZK_WSTGS S_PUEB_WSTG S_TABG_MAN S_WG_MOD /end DEF_CHARACTERISTIC
 /begin OUT_MEASUREMENT Atlr_oad F_pwstgdse F_tnzyl Msturb Msturb_diff Msturbdiff_tgkor Msturbdiff_ukor Msturbine Mswg Prat_turb Pturb Pwg Pwstgdse Pwstgtpu Tabg2tabg_wzinv Tabg_mw Wstg_s Wstg_s_vf /end OUT_MEASUREMENT
/end FUNCTION
/begin FUNCTION BGCRENG ""
 /begin DEF_CHARACTERISTIC KF_ELUPWM39 KF_ELUPWM60 KL_ELSLS KL_ELTEMP39 KL_ELTEMP60 KL_ELUB39 KL_ELUB60 KL_IABGLMOT KL_IABGLNL KL_IABGLST K_CRENGOF K_CRVVTNOT K_CRVVTOF K_IABGLMOT K_IABGLNL K_IABGLST K_IKEINESA /end DEF_CHARACTERISTIC
 /begin OUT_MEASUREMENT Fak_ttansel Fak_tubel I_craweng I_elu_vvt I_eluefter I_elupwm I_eluvfzg I_gle I_sls Vvt_ib1_2 Vvt_iges /end OUT_MEASUREMENT
/end FUNCTION
/begin FUNCTION BGKUPPL ""
 /begin DEF_CHARACTERISTIC CW_BGKUPPL CW_LLBITINT K_NV K_NVGMN K_NVGMX K_NVO K_NVV K_TDNVAUS K_TDNVEIN /end DEF_CHARACTERISTIC
 /begin OUT_MEASUREMENT Gang_mod Nkw_zu_v St_bgkuppl St_bgkuppl.B_kupp St_bgkuppl.B_kupp_ext St_bgkuppl.B_kupp_mod St_bgkuppl1 St_bgkuppl1.B_ll St_tdnvvaus St_tdnvvein /end OUT_MEASUREMENT
/end FUNCTION
/begin FUNCTION BGLLGEN ""
 /begin DEF_CHARACTERISTIC K_DFRUTYP K_GENDFVORHS K_IGENLLRANH K_LLRABS_DF K_LLRANH_DF K_NTWBGLLGEN K_PRELLDFAH K_PRELLDFRF /end DEF_CHARACTERISTIC
 /begin OUT_MEASUREMENT Gen_dfvorhs Gen_dfvorhsnofil I_erripol1 I_erripol2 I_erripol3 Ierr_vorhs N_genll N_idlgspec St_bgllgen0 St_bgllgen0.B_hysllrah /end OUT_MEASUREMENT
/end FUNCTION
/begin FUNCTION BKV ""
 /begin DEF_CHARACTERISTIC KF_DPBKVDOWN KF_DPBKVUP KL_NSLLBKV KL_TBKV K_BKVVERZ K_BLSVERZ K_DPBKV_MN K_MSBKV_MX K_VBKV K_VKBKV K_ZK_DPBKV K_ZK_PBKV /end DEF_CHARACTERISTIC
 /begin OUT_MEASUREMENT Dpbkv Dpbkv_dif_f Dpbkv_dif_of Dpbkv_diff Dpbkv_f Dpbkv_of Msbkv Msbkv_f Nsllbkv /end OUT_MEASUREMENT
/end FUNCTION
/begin FUNCTION BLS ""
 /begin DEF_CHARACTERISTIC KF_DPS KF_DPSST KF_DPSTE KF_MSZSVNS KF_MSZSVNST KF_NDDPSTE KF_SRKOR_SPUEL KF_TDVNSFIL KF_VNSDYNKOR KL_FUPSRF_TRANS KL_GDVNSFIL KL_PIRG_TRANS KL_SRKOR_SPUEL KL_ZKPVDKDS KL_ZK_DRFSPUEL KL_ZK_DRFUK KL_ZK_VNSDYNKOR K_DDPSSOLTE K_DPLLMX K_DPSGRADTD K_DPSGRADUTD K_DPSMAX K_DPSMIN K_DPSRAMPE K_DPSSOLAPPL K_DPSSOL_MN K_DPSTDHYSL K_DPSTDHYSR K_DPS_DTEV K_FPSSOLHUB_MN K_FTEADMOD K_FTEBLGMX K_F_RFVNSHUB K_MAT_DPS K_MAT_DPSFAK K_MAT_RFVVNS K_MAX_PSSOLBER K_MNHBHYSL K_MNHBHYSR K_MNHUBFTEMN K_PAKPSNL_MIN K_PSPVDK_SOLMAX K_PSPVDK_SOLMAXGD K_PSPVDK_SOLMAXUG K_PSPVDK_SOLMIN K_PVDKPNRFV_MX K_RFVHUBAPPL K_TD_BLLTD K_TD_FTEBLGMXL K_TD_FTEBLGMXR K_TD_TEONOFF K_ZK_PSSOLHUB K_ZTDDPS S_DPSSOLAPPL S_DPSTDO S_LLTD S_PSPVDK_SOL S_PSSOLNL_KOR S_PSSOLNL_KOR2 S_PSSOL_UBEG S_RFVHUBAPPL S_RFVNS S_TEDPS /end DEF_CHARACTERISTIC
 /begin OUT_MEASUREMENT Ddpste Ddpstevf Dps_hub Dps_hubtd_mx Dpsfak Dpsfak_1 Dpsfak_2 Dpsrampe Dpssol Dpssol_mem Dpssolfilt Dpssolgd Dpssoltd Dpssoltdr Dpste Dpsvvtte Drf_spuel_f Drf_uk_f Drft Drft_uk F_dpsrampe F_int_pssolber F_mnhubte F_pvdkpnvns F_teblgmod F_vnsdynkor Fupsmssol Fupsrf_kor Kf_mszsvns_aus Kf_mszsvnst_aus Kf_tdvnsfil_aus Kfdps_aus Kl_gdvnsfil_aus Msnsol Msnsolps Msnzylsol_k Mssol Mssol_mr Pakps_soll Pirg_kor Ps_soll_gd Ps_sollgd_lin Ps_sollgd_nl Ps_sollgd_nl2 Psoll_nlbas Pspvdk_soll Pspvdk_soll_ur Pssol Pssol_ugd Pssolhub Pssoll_g Pssoll_offs Pssoltd Pvdkdsf Rf_f_vns Rf_fvns_k Rf_fvns_tkor Rf_soll_g Rft Rft_lin Rft_nl Rfv_fvns_mem Rfv_hub Rfv_mpr Rfv_soll Rfv_soll_k Rfv_soll_vns Rfv_vns Rfv_vns_dk Rfv_vns_hub Rfv_vnsdk_mem Rfv_vnsdk_roh Rfv_vnsdk_ubeg Rfv_vnshub_mem Rfv_vnshub_roh St_blstd St_blstd.B_lltd St_blstd.B_lltd_old St_blstd.B_lltd_vz St_blstd.B_pssolnl_akt St_fe St_fe.B_tvdpsrfvw /end OUT_MEASUREMENT
/end FUNCTION
/begin FUNCTION BLSAGR ""
 /begin DEF_CHARACTERISTIC KL_AGRPOS_N KL_F_DAGR K_AGRPOS_SOLL K_DPSPVAGRMX K_MSNAGRMX K_PSPVDK_BLS S_AGRPOS_SOLL S_LABER_IST S_PSIST_BLSAGR /end DEF_CHARACTERISTIC
 /begin OUT_MEASUREMENT Agrpos_soll F_dagr F_klaf La_ber Ms_agrfg_soll Msagr_sol Msnagr_rosol Msnagr_sol Pspvagr_soll Q_msnagr_mx Rf_agr_soll Rf_agrfg_soll Rf_agrig_soll Rf_ig_ist Rk_soll_konv St_blsagr St_blsagr.B_laber_unend /end OUT_MEASUREMENT
/end FUNCTION
/begin FUNCTION BLSATL ""
 /begin DEF_CHARACTERISTIC KF_PSPLD_DYN KF_PSPLD_ECO K_PLD_SOLL K_TDFPSPLD S_PLDSOLL_APP /end DEF_CHARACTERISTIC
 /begin OUT_MEASUREMENT F_pspld_soll Pld_soll Pspld_soll Pssolpu /end OUT_MEASUREMENT
/end FUNCTION
/begin FUNCTION BLSDISA ""
 /begin DEF_CHARACTERISTIC KF_DISA KL_FTDISA K_DISANGRDLMTN K_DISANGRDLMTP K_DISAVL_12 K_DISAVL_23 K_DISAVL_34 K_N_DISAHYS K_TDDISADYNK K_TDDISAHYS K_TDDISAVZ K_TDNKW S_DISAAKT_ENA S_DISAAKT_ON S_DISADYNK_ON /end DEF_CHARACTERISTIC
 /begin OUT_MEASUREMENT Disa_ist_vz Disa_soll Disa_stufe Dn_disadynk F_kfdisa F_rfsoll_vl F_tdisa N_hys_down N_hys_up N_switch_down N_switch_up St_blsdisa2 St_blsdisa2.B_disa1_auf St_blsdisa2.B_disa2_auf St_blsdisa2.B_disa_hys /end OUT_MEASUREMENT
/end FUNCTION
/begin FUNCTION BLSDK ""
 /begin DEF_CHARACTERISTIC CW_DKAPP KF_DKST KF_FTRANSVL KF_MSSDYN_KOR KF_WDKDPS KL_DKVL KL_DPSDKM KL_FPWDKAPP KL_MSSDYN_KOR KL_TWDKNVN KL_TWDKNVP KL_TWDKSV KL_WDKSNLN K_DPSGRENDK K_DRFVMXDKMN K_MAT_DKVL K_MSNLG K_TFWDKSOM K_TVWDKS K_TWDKVST K_WDKSAPP S_PSR_SGAPP S_WDKSGD_OFF S_WDK_START /end DEF_CHARACTERISTIC
 /begin OUT_MEASUREMENT Dpssolps F_dpsdkm F_mssdyn_kor F_transvl F_transvl_bas Klafaus Msn_pspvdk_smx Msnwdk_soll Mssoldk Mssoldk_dyn Mssoldk_kor Mssoldkdyn_roh Pssol_pspvdk_smx Rfv_mxdk Rfv_pspvdk_smx Rfv_solldk Twdk Wdk_soll Wdk_soll_gd Wdk_soll_transvl Wdk_soll_trvlbas Wdk_soll_uebl Wdk_soll_uf Wdk_soll_ug Wdk_soll_uverz Wdk_som Wdks_vl /end OUT_MEASUREMENT
/end FUNCTION
/begin FUNCTION BLSHUB ""
 /begin DEF_CHARACTERISTIC CW_HUBAPP KF_ANFLVNS KF_ASVNS KF_ESVNS KF_FLAEAN KF_HUBE KF_HUBELL KF_HUBEST KF_HUBESTM KF_ZKVNSI KL_DHUBTM KL_DNWELLK KL_EXWHKLL KL_EXWMX_N KL_FHTMOT KL_FHUB_DPSFAK KL_FHUB_NST KL_HUBAPP KL_HUBEVL KL_HUBEX KL_HUBV KL_VVTCLOSE KL_VVTCLOSE_AT KL_ZKVNSI_LL KL_ZYLN K_AVZUNASPR K_DHUBDKNOTL K_DHUBMD K_DHUBMX K_DHUBVH K_DHUBVHN1 K_DHUBVHN2 K_DNWE K_EXWDIFLL_MN K_EXWDIFLL_MX K_EXWIST_DIF K_EXWKOR_MN K_EXWKOR_MX K_EXWSOLL_DIF K_FEXWHKLL_DEK K_FEXWHKLL_INK K_FEXWKOR_MN K_FEXWKOR_MX K_FHUBVNSMN K_FHUBVNSMX K_FHUBVNS_HD K_FHUB_NMX K_FHUB_ST K_FHUB_VSAMN K_FHUB_VSAMX K_FHUB_VSEMN K_FHUB_VSEMX K_HUBAPP K_HUBSGNL K_IVVTHKLL_MX K_NKWHKLL_MN K_NKWHKLL_MX K_OFFHUB_VNSAN K_TDHKNACHL K_TDHUBVHN1 K_TD_SPRON K_TD_SPRONMX K_TEXWMX K_THKLL_MX K_THKLL_VZ K_TMOTHKLL_MN K_TMSTHUBSTM K_TVVTCLOSE K_VSASPRON_DIFF K_VSASPRON_MOV K_VSEDIFF_MXLL K_VSESPRON_DIFF K_VSESPRON_MOV S_FHUBVNS_HD S_HKLL_TL S_HKLL_ZKOR S_HUBEVSIM S_HUBST /end DEF_CHARACTERISTIC
 /begin OUT_MEASUREMENT Dexwkor_ist Dexwkor_soll Dhubra Dhubtm Dvse_spr Exwdifll Exwdifll_alt Exwink_nokor Exwink_soll Exwinkmx Exwinkmx_vz Exwkor_ll F_exwkor_ll F_hubdpsfak F_hubnst Fhubvnsf Fhubvnsi Fhubvnss Hubev_ist Hubev_soll Hubev_soll_b Hubev_soll_kf Hubev_soll_vh Hubev_vh Hubevkor_soll Kffl_ausi Kffl_ausn St_blshub St_blshub.B_fhubvnsi_ini St_blshub.B_hubst St_blshub.B_llk St_blshub.B_nwe St_blshub.B_vns_spron St_blshub.B_vsean_loc St_blshub.B_vvtclose St_blshub2 St_blshub2.B_hkll St_blshub2.B_hkll_edge1 St_blshub2.B_hkll_edge2 St_blshub2.B_hkll_edge3 St_blshub2.B_hkll_pre St_blshub2.B_hkll_vz St_blshub2.B_hubsolldif T_zkvnsi Vol_verh_a Vol_verh_e Vsa_spr Vsa_spris Vsasprn Vse_spr Vse_spris Vsesprn /end OUT_MEASUREMENT
/end FUNCTION
/begin FUNCTION BLSTEMPK ""
 /begin DEF_CHARACTERISTIC KF_FW_TBR KF_FW_TBR_AGR KF_TEVT_MDL_OFFSET KF_WFTEV KL_FTEVST KL_FTEV_TL KL_FTEV_VL KL_FTVDK KL_TEVT_MDL_AGR K_ZKFTEV K_ZKFTEVST K_ZKTEMPK K_ZKTMOT_TEMPK S_FTEV_TANS S_FTPVDKPN S_PVDKPN_F S_WFTEV /end DEF_CHARACTERISTIC
 /begin OUT_MEASUREMENT F_pvdkpn F_t_pvdkpn F_tvdk F_tvdkho F_wftev Ftbr_kor Ftev Ftev_kor Ftev_tl Ftev_uf Ftev_ukorf Ftev_vl Ftsr Ftu Tevt_mdl Tmot_fil_tempk Tsr_ges /end OUT_MEASUREMENT
/end FUNCTION
/begin FUNCTION DEAVANOS ""
 /begin DEF_CHARACTERISTIC CW_DEAVANOS KL_VNSD_TOEL K_DSPRZG_AN K_NVNSAN K_NWADPOTO_DMX K_NWADP_MN K_NWADP_MX K_VNS_DELTMX K_VNS_ERRCNT K_VNS_TMN K_VNS_TMX /end DEF_CHARACTERISTIC
 /begin OUT_MEASUREMENT Dnwoto_mn Dnwoto_mx St_deavns St_deavns.B_anwmn St_deavns.B_anwpnp St_deavns.B_enwmn St_deavns.B_enwpnp St_deavns2 St_deavns2.B_anwoto St_deavns2.B_enwoto St_deavns2.B_vsa_an St_deavns2.B_vse_an St_deavns3 St_deavns3.B_anwmn_dis St_deavns3.B_anwpnp_dis St_deavns3.B_enwmn_dis St_deavns3.B_enwpnp_dis St_deavns4 St_deavns4.B_anwoto_dis St_deavns4.B_enwoto_dis St_deavns5 St_deavns5.B_anwmn_rbmc St_deavns5.B_anwpnp_rbmc St_deavns5.B_enwmn_rbmc St_deavns5.B_enwpnp_rbmc St_deavns6 St_deavns6.B_anwmn_rbmd St_deavns6.B_anwpnp_rbmd St_deavns6.B_enwmn_rbmd St_deavns6.B_enwpnp_rbmd Vnscnt Vnscnt_nio /end OUT_MEASUREMENT
/end FUNCTION
/begin FUNCTION DGEN ""
 /begin DEF_CHARACTERISTIC K_GENPDTIME K_GEN_DNMIN K_MSKGENDFP K_MSKGENKL61 K_PLAUSAUS K_PLAUSEIN K_SNMBSDKL61 K_TD_UGENDIAG K_UGENDIAG K_UGOFFSET S_ENUGDIAG /end DEF_CHARACTERISTIC
 /begin OUT_MEASUREMENT Gen_fbsak Gen_statroh St_dgen0 St_dgen0.B_1stbsder St_dgen0.B_genfprl St_dgen0.B_gfbsupak St_dgen0.B_gfelak St_dgen0.B_gfhtak St_dgen0.B_gfmeak St_dgen0.B_gfnobsak St_dgen0.B_kl61 St_dgen1 St_dgen1.B_genudiag St_gen St_genbsd St_gengen /end OUT_MEASUREMENT
/end FUNCTION
/begin FUNCTION DIBS ""
 /begin DEF_CHARACTERISTIC K_MSKIBSDFP K_MSKIBSDFP2 K_MSKIBSDIAG K_MSKIBSERR K_MSKIBSERR2 S_BSDKOORD /end DEF_CHARACTERISTIC
 /begin OUT_MEASUREMENT Ibs1_errstat Ibs2_errstat Ibs3_errstat Ibsderrs1 Ibsderrs2 Ibspreco2 St_dibs0 St_dibs0.B_dibloc1 St_dibs0.B_dibloc2 St_dibs1 St_dibs1.B_ifbsak St_dibs1.B_ifebsak St_dibs1.B_ifuplak St_dibs2 St_dibs2.B_ifisak St_dibs2.B_ifsysak St_dibs2.B_iftempak St_dibs2.B_ifusak St_dibs2.B_ifwugdak St_dibs2.B_ifwuplak T_count_dibs1 T_count_dibs2 T_count_dibs3 T_count_dibs4 /end OUT_MEASUREMENT
/end FUNCTION
/begin FUNCTION DQLT ""
 /begin DEF_CHARACTERISTIC K_DTOG_UBMIN K_OZDIAGNMOT K_OZDIAGNMOT2 K_OZDIAGSPG K_OZERRD K_OZHEAL K_OZPLTEMP K_OZPLZTEMP K_OZTEMPQERR K_OZZTEMP K_TOGMAXUNPL K_TOG_CNTMAX S_OZBSDKOORD /end DEF_CHARACTERISTIC
 /begin OUT_MEASUREMENT Oz_diagtoens Oz_permerrz Oz_tempplz Oz_temprold St_dqlt0 St_dqlt0.B_ozdiagnmotok St_dqlt0.B_ozerrbsd St_dqlt0.B_ozkttoens St_dqlt0.B_ozlerr St_dqlt0.B_ozqerr St_dqlt0.B_ozterr St_dqlt0.B_td_ogerr St_dqlt0.B_td_ogupl St_dqlt1 St_dqlt1.B_ozerr St_dqlt1.B_ozfbsd2 St_dqlt1.B_oztemppl St_oz_o St_oz_o.B_mol_sf St_oz_o.B_oztemic /end OUT_MEASUREMENT
/end FUNCTION
/end MODULE
/end PROJECT
