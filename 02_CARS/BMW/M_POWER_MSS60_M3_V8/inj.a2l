ASAP2_VERSION 1 30
/begin PROJECT MSS65-inj "Generiert am 14.10.05 um 11:34:36"
/begin HEADER "" VERSION "R341" /end HEADER
/begin MODULE _MSS65-inj "Generiert am 14.10.05 um 11:34:36"
/begin MOD_COMMON "" BYTE_ORDER MSB_FIRST ALIGNMENT_BYTE 1 ALIGNMENT_WORD 2 ALIGNMENT_LONG 4 ALIGNMENT_FLOAT32_IEEE 4 ALIGNMENT_FLOAT64_IEEE 8 /end MOD_COMMON
/begin MEASUREMENT tpu_inj_start_time_high_zyl3 "TPU INJ start time high." UWORD FORMULA_INJ11 0 0.0 0.0 2396.7451171875 READ_WRITE BIT_MASK 0xFF00 ECU_ADDRESS 0x304146 /end MEASUREMENT
/begin MEASUREMENT tpu_inj_start_time_high_zyl4 "TPU INJ start time high." UWORD FORMULA_INJ11 0 0.0 0.0 2396.7451171875 READ_WRITE BIT_MASK 0xFF00 ECU_ADDRESS 0x304156 /end MEASUREMENT
/begin MEASUREMENT tpu_inj_start_time_high_zyl5 "TPU INJ start time high." UWORD FORMULA_INJ11 0 0.0 0.0 2396.7451171875 READ_WRITE BIT_MASK 0xFF00 ECU_ADDRESS 0x304166 /end MEASUREMENT
/begin MEASUREMENT tpu_inj_start_time_high_zyl6 "TPU INJ start time high." UWORD FORMULA_INJ11 0 0.0 0.0 2396.7451171875 READ_WRITE BIT_MASK 0xFF00 ECU_ADDRESS 0x304176 /end MEASUREMENT
/begin MEASUREMENT tpu_inj_start_time_high_zyl7 "TPU INJ start time high." UWORD FORMULA_INJ11 0 0.0 0.0 2396.7451171875 READ_WRITE BIT_MASK 0xFF00 ECU_ADDRESS 0x304186 /end MEASUREMENT
/begin MEASUREMENT tpu_inj_start_time_high_zyl8 "TPU INJ start time high." UWORD FORMULA_INJ11 0 0.0 0.0 2396.7451171875 READ_WRITE BIT_MASK 0xFF00 ECU_ADDRESS 0x304196 /end MEASUREMENT
/begin MEASUREMENT tpu_inj_start_time_high_zyl9 "TPU INJ start time high." UWORD FORMULA_INJ11 0 0.0 0.0 2396.7451171875 READ_WRITE BIT_MASK 0xFF00 ECU_ADDRESS 0x3041A6 /end MEASUREMENT
/begin MEASUREMENT tpu_inj_start_time_low_zyl1 "TPU INJ start time low." UWORD FORMULA_INJ2 0 0.0 0.0 9.362099647521973 READ_WRITE ECU_ADDRESS 0x304128 /end MEASUREMENT
/begin MEASUREMENT tpu_inj_start_time_low_zyl10 "TPU INJ start time low." UWORD FORMULA_INJ2 0 0.0 0.0 9.362099647521973 READ_WRITE ECU_ADDRESS 0x3041B8 /end MEASUREMENT
/begin MEASUREMENT tpu_inj_start_time_low_zyl2 "TPU INJ start time low." UWORD FORMULA_INJ2 0 0.0 0.0 9.362099647521973 READ_WRITE ECU_ADDRESS 0x304138 /end MEASUREMENT
/begin MEASUREMENT tpu_inj_start_time_low_zyl3 "TPU INJ start time low." UWORD FORMULA_INJ2 0 0.0 0.0 9.362099647521973 READ_WRITE ECU_ADDRESS 0x304148 /end MEASUREMENT
/begin MEASUREMENT tpu_inj_start_time_low_zyl4 "TPU INJ start time low." UWORD FORMULA_INJ2 0 0.0 0.0 9.362099647521973 READ_WRITE ECU_ADDRESS 0x304158 /end MEASUREMENT
/begin MEASUREMENT tpu_inj_start_time_low_zyl5 "TPU INJ start time low." UWORD FORMULA_INJ2 0 0.0 0.0 9.362099647521973 READ_WRITE ECU_ADDRESS 0x304168 /end MEASUREMENT
/begin MEASUREMENT tpu_inj_start_time_low_zyl6 "TPU INJ start time low." UWORD FORMULA_INJ2 0 0.0 0.0 9.362099647521973 READ_WRITE ECU_ADDRESS 0x304178 /end MEASUREMENT
/begin MEASUREMENT tpu_inj_start_time_low_zyl7 "TPU INJ start time low." UWORD FORMULA_INJ2 0 0.0 0.0 9.362099647521973 READ_WRITE ECU_ADDRESS 0x304188 /end MEASUREMENT
/begin MEASUREMENT tpu_inj_start_time_low_zyl8 "TPU INJ start time low." UWORD FORMULA_INJ2 0 0.0 0.0 9.362099647521973 READ_WRITE ECU_ADDRESS 0x304198 /end MEASUREMENT
/begin MEASUREMENT tpu_inj_start_time_low_zyl9 "TPU INJ start time low." UWORD FORMULA_INJ2 0 0.0 0.0 9.362099647521973 READ_WRITE ECU_ADDRESS 0x3041A8 /end MEASUREMENT
/begin MEASUREMENT tpu_inj_tdc_angle_high_zyl1 "TPU INJ MSB OT Lage." UWORD FORMULA_INJ1 0 0.0 0.0 719.989013671875 READ_WRITE BIT_MASK 0xFF00 ECU_ADDRESS 0x304120 /end MEASUREMENT
/begin MEASUREMENT tpu_inj_tdc_angle_high_zyl10 "TPU INJ MSB OT Lage." UWORD FORMULA_INJ1 0 0.0 0.0 719.989013671875 READ_WRITE BIT_MASK 0xFF00 ECU_ADDRESS 0x3041B0 /end MEASUREMENT
/begin MEASUREMENT tpu_inj_tdc_angle_high_zyl2 "TPU INJ MSB OT Lage." UWORD FORMULA_INJ1 0 0.0 0.0 719.989013671875 READ_WRITE BIT_MASK 0xFF00 ECU_ADDRESS 0x304130 /end MEASUREMENT
/begin MEASUREMENT tpu_inj_tdc_angle_high_zyl3 "TPU INJ MSB OT Lage." UWORD FORMULA_INJ1 0 0.0 0.0 719.989013671875 READ_WRITE BIT_MASK 0xFF00 ECU_ADDRESS 0x304140 /end MEASUREMENT
/begin MEASUREMENT tpu_inj_tdc_angle_high_zyl4 "TPU INJ MSB OT Lage." UWORD FORMULA_INJ1 0 0.0 0.0 719.989013671875 READ_WRITE BIT_MASK 0xFF00 ECU_ADDRESS 0x304150 /end MEASUREMENT
/begin MEASUREMENT tpu_inj_tdc_angle_high_zyl5 "TPU INJ MSB OT Lage." UWORD FORMULA_INJ1 0 0.0 0.0 719.989013671875 READ_WRITE BIT_MASK 0xFF00 ECU_ADDRESS 0x304160 /end MEASUREMENT
/begin MEASUREMENT tpu_inj_tdc_angle_high_zyl6 "TPU INJ MSB OT Lage." UWORD FORMULA_INJ1 0 0.0 0.0 719.989013671875 READ_WRITE BIT_MASK 0xFF00 ECU_ADDRESS 0x304170 /end MEASUREMENT
/begin MEASUREMENT tpu_inj_tdc_angle_high_zyl7 "TPU INJ MSB OT Lage." UWORD FORMULA_INJ1 0 0.0 0.0 719.989013671875 READ_WRITE BIT_MASK 0xFF00 ECU_ADDRESS 0x304180 /end MEASUREMENT
/begin MEASUREMENT tpu_inj_tdc_angle_high_zyl8 "TPU INJ MSB OT Lage." UWORD FORMULA_INJ1 0 0.0 0.0 719.989013671875 READ_WRITE BIT_MASK 0xFF00 ECU_ADDRESS 0x304190 /end MEASUREMENT
/begin MEASUREMENT tpu_inj_tdc_angle_high_zyl9 "TPU INJ MSB OT Lage." UWORD FORMULA_INJ1 0 0.0 0.0 719.989013671875 READ_WRITE BIT_MASK 0xFF00 ECU_ADDRESS 0x3041A0 /end MEASUREMENT
/begin MEASUREMENT tpu_inj_tdc_angle_low_zyl1 "TPU INJ LSB OT Lage." UWORD FORMULA_INJ1 0 0.0 0.0 719.989013671875 READ_WRITE BIT_MASK 0xFF ECU_ADDRESS 0x304126 /end MEASUREMENT
/begin MEASUREMENT tpu_inj_tdc_angle_low_zyl10 "TPU INJ LSB OT Lage." UWORD FORMULA_INJ1 0 0.0 0.0 719.989013671875 READ_WRITE BIT_MASK 0xFF ECU_ADDRESS 0x3041B6 /end MEASUREMENT
/begin MEASUREMENT tpu_inj_tdc_angle_low_zyl2 "TPU INJ LSB OT Lage." UWORD FORMULA_INJ1 0 0.0 0.0 719.989013671875 READ_WRITE BIT_MASK 0xFF ECU_ADDRESS 0x304136 /end MEASUREMENT
/begin MEASUREMENT tpu_inj_tdc_angle_low_zyl3 "TPU INJ LSB OT Lage." UWORD FORMULA_INJ1 0 0.0 0.0 719.989013671875 READ_WRITE BIT_MASK 0xFF ECU_ADDRESS 0x304146 /end MEASUREMENT
/begin MEASUREMENT tpu_inj_tdc_angle_low_zyl4 "TPU INJ LSB OT Lage." UWORD FORMULA_INJ1 0 0.0 0.0 719.989013671875 READ_WRITE BIT_MASK 0xFF ECU_ADDRESS 0x304156 /end MEASUREMENT
/begin MEASUREMENT tpu_inj_tdc_angle_low_zyl5 "TPU INJ LSB OT Lage." UWORD FORMULA_INJ1 0 0.0 0.0 719.989013671875 READ_WRITE BIT_MASK 0xFF ECU_ADDRESS 0x304166 /end MEASUREMENT
/begin MEASUREMENT tpu_inj_tdc_angle_low_zyl6 "TPU INJ LSB OT Lage." UWORD FORMULA_INJ1 0 0.0 0.0 719.989013671875 READ_WRITE BIT_MASK 0xFF ECU_ADDRESS 0x304176 /end MEASUREMENT
/begin MEASUREMENT tpu_inj_tdc_angle_low_zyl7 "TPU INJ LSB OT Lage." UWORD FORMULA_INJ1 0 0.0 0.0 719.989013671875 READ_WRITE BIT_MASK 0xFF ECU_ADDRESS 0x304186 /end MEASUREMENT
/begin MEASUREMENT tpu_inj_tdc_angle_low_zyl8 "TPU INJ LSB OT Lage." UWORD FORMULA_INJ1 0 0.0 0.0 719.989013671875 READ_WRITE BIT_MASK 0xFF ECU_ADDRESS 0x304196 /end MEASUREMENT
/begin MEASUREMENT tpu_inj_tdc_angle_low_zyl9 "TPU INJ LSB OT Lage." UWORD FORMULA_INJ1 0 0.0 0.0 719.989013671875 READ_WRITE BIT_MASK 0xFF ECU_ADDRESS 0x3041A6 /end MEASUREMENT
/begin MEASUREMENT tpu_inj_temp_zyl1 "TPU INJ temp." UWORD FORMULA_INJ4 0 0.0 0.0 65535.0 READ_WRITE ECU_ADDRESS 0x304128 /end MEASUREMENT
/begin MEASUREMENT tpu_inj_temp_zyl10 "TPU INJ temp." UWORD FORMULA_INJ4 0 0.0 0.0 65535.0 READ_WRITE ECU_ADDRESS 0x3041B8 /end MEASUREMENT
/begin MEASUREMENT tpu_inj_temp_zyl2 "TPU INJ temp." UWORD FORMULA_INJ4 0 0.0 0.0 65535.0 READ_WRITE ECU_ADDRESS 0x304138 /end MEASUREMENT
/begin MEASUREMENT tpu_inj_temp_zyl3 "TPU INJ temp." UWORD FORMULA_INJ4 0 0.0 0.0 65535.0 READ_WRITE ECU_ADDRESS 0x304148 /end MEASUREMENT
/begin MEASUREMENT tpu_inj_temp_zyl4 "TPU INJ temp." UWORD FORMULA_INJ4 0 0.0 0.0 65535.0 READ_WRITE ECU_ADDRESS 0x304158 /end MEASUREMENT
/begin MEASUREMENT tpu_inj_temp_zyl5 "TPU INJ temp." UWORD FORMULA_INJ4 0 0.0 0.0 65535.0 READ_WRITE ECU_ADDRESS 0x304168 /end MEASUREMENT
/begin MEASUREMENT tpu_inj_temp_zyl6 "TPU INJ temp." UWORD FORMULA_INJ4 0 0.0 0.0 65535.0 READ_WRITE ECU_ADDRESS 0x304178 /end MEASUREMENT
/begin MEASUREMENT tpu_inj_temp_zyl7 "TPU INJ temp." UWORD FORMULA_INJ4 0 0.0 0.0 65535.0 READ_WRITE ECU_ADDRESS 0x304188 /end MEASUREMENT
/begin MEASUREMENT tpu_inj_temp_zyl8 "TPU INJ temp." UWORD FORMULA_INJ4 0 0.0 0.0 65535.0 READ_WRITE ECU_ADDRESS 0x304198 /end MEASUREMENT
/begin MEASUREMENT tpu_inj_temp_zyl9 "TPU INJ temp." UWORD FORMULA_INJ4 0 0.0 0.0 65535.0 READ_WRITE ECU_ADDRESS 0x3041A8 /end MEASUREMENT
/begin MEASUREMENT tpu_nw_kw_cnt_720_a1 "720° Zahnzaehler der KW." UWORD FORMULA_NW3 0 0.0 0.0 119.0 READ_WRITE BIT_MASK 0x7F00 ECU_ADDRESS 0x304530 /end MEASUREMENT
/begin MEASUREMENT tpu_nw_kw_cnt_720_a2 "720° Zahnzaehler der KW." UWORD FORMULA_NW3 0 0.0 0.0 119.0 READ_WRITE BIT_MASK 0x7F00 ECU_ADDRESS 0x304550 /end MEASUREMENT
/begin MEASUREMENT tpu_nw_kw_cnt_720_e1 "720° Zahnzaehler der KW." UWORD FORMULA_NW3 0 0.0 0.0 119.0 READ_WRITE BIT_MASK 0x7F00 ECU_ADDRESS 0x304520 /end MEASUREMENT
/begin MEASUREMENT tpu_nw_kw_cnt_720_e2 "720° Zahnzaehler der KW." UWORD FORMULA_NW3 0 0.0 0.0 119.0 READ_WRITE BIT_MASK 0x7F00 ECU_ADDRESS 0x304540 /end MEASUREMENT
/begin MEASUREMENT tpu_nw_kw_last_trans_time_a1 "Zeitpunkt letzter Zahnflanke der KW." ULONG FORMULA_NW1 0 0.0 0.0 2396.745 READ_WRITE BIT_MASK 0xFFFFFF ECU_ADDRESS 0x304536 /end MEASUREMENT
/begin MEASUREMENT tpu_nw_kw_last_trans_time_a2 "Zeitpunkt letzter Zahnflanke der KW." ULONG FORMULA_NW1 0 0.0 0.0 2396.745 READ_WRITE BIT_MASK 0xFFFFFF ECU_ADDRESS 0x304556 /end MEASUREMENT
/begin MEASUREMENT tpu_nw_kw_last_trans_time_e1 "Zeitpunkt letzter Zahnflanke der KW." ULONG FORMULA_NW1 0 0.0 0.0 2396.745 READ_WRITE BIT_MASK 0xFFFFFF ECU_ADDRESS 0x304526 /end MEASUREMENT
/begin MEASUREMENT tpu_nw_kw_last_trans_time_e2 "Zeitpunkt letzter Zahnflanke der KW." ULONG FORMULA_NW1 0 0.0 0.0 2396.745 READ_WRITE BIT_MASK 0xFFFFFF ECU_ADDRESS 0x304546 /end MEASUREMENT
/begin MEASUREMENT tpu_nw_kw_norm_period_a1 "normierte Periode der KW." ULONG FORMULA_NW2 0 0.0 0.0 2396.745 READ_WRITE BIT_MASK 0xFFFFFF00 ECU_ADDRESS 0x304534 /end MEASUREMENT
/begin MEASUREMENT tpu_nw_kw_norm_period_a2 "normierte Periode der KW." ULONG FORMULA_NW2 0 0.0 0.0 2396.745 READ_WRITE BIT_MASK 0xFFFFFF00 ECU_ADDRESS 0x304554 /end MEASUREMENT
/begin MEASUREMENT tpu_nw_kw_norm_period_e1 "normierte Periode der KW." ULONG FORMULA_NW2 0 0.0 0.0 2396.745 READ_WRITE BIT_MASK 0xFFFFFF00 ECU_ADDRESS 0x304524 /end MEASUREMENT
/begin MEASUREMENT tpu_nw_kw_norm_period_e2 "normierte Periode der KW." ULONG FORMULA_NW2 0 0.0 0.0 2396.745 READ_WRITE BIT_MASK 0xFFFFFF00 ECU_ADDRESS 0x304544 /end MEASUREMENT
/begin MEASUREMENT tpu_nw_last_trans_time_a1 "Zeitpunkt letzter Zahnflanke der NW." ULONG FORMULA_NW1 0 0.0 0.0 2396.745 READ_WRITE BIT_MASK 0xFFFFFF ECU_ADDRESS 0x304530 /end MEASUREMENT
/begin MEASUREMENT tpu_nw_last_trans_time_a2 "Zeitpunkt letzter Zahnflanke der NW." ULONG FORMULA_NW1 0 0.0 0.0 2396.745 READ_WRITE BIT_MASK 0xFFFFFF ECU_ADDRESS 0x304550 /end MEASUREMENT
/begin MEASUREMENT tpu_nw_last_trans_time_e1 "Zeitpunkt letzter Zahnflanke der NW." ULONG FORMULA_NW1 0 0.0 0.0 2396.745 READ_WRITE BIT_MASK 0xFFFFFF ECU_ADDRESS 0x304520 /end MEASUREMENT
/begin MEASUREMENT tpu_nw_last_trans_time_e2 "Zeitpunkt letzter Zahnflanke der NW." ULONG FORMULA_NW1 0 0.0 0.0 2396.745 READ_WRITE BIT_MASK 0xFFFFFF ECU_ADDRESS 0x304540 /end MEASUREMENT
/begin MEASUREMENT tpu_nw_pin_level_a1 "TPU NW pin level." UWORD FORMULA_NW4 0 0 0.0 255.0 READ_WRITE BIT_MASK 0x8000 ECU_ADDRESS 0x304530 /end MEASUREMENT
/begin MEASUREMENT tpu_nw_pin_level_a2 "TPU NW pin level." UWORD FORMULA_NW4 0 0 0.0 255.0 READ_WRITE BIT_MASK 0x8000 ECU_ADDRESS 0x304550 /end MEASUREMENT
/begin MEASUREMENT tpu_nw_pin_level_e1 "TPU NW pin level." UWORD FORMULA_NW4 0 0 0.0 255.0 READ_WRITE BIT_MASK 0x8000 ECU_ADDRESS 0x304520 /end MEASUREMENT
/begin MEASUREMENT tpu_nw_pin_level_e2 "TPU NW pin level." UWORD FORMULA_NW4 0 0 0.0 255.0 READ_WRITE BIT_MASK 0x8000 ECU_ADDRESS 0x304540 /end MEASUREMENT
/begin MEASUREMENT tpu_pwm_active_time_elue "TPU PWM active time." UWORD FORMULA_PWM1 0 0.0 0.0 9.362099647521973 READ_WRITE ECU_ADDRESS 0x3045C0 /end MEASUREMENT
/begin MEASUREMENT tpu_pwm_active_time_tev1 "TPU PWM active time." UWORD FORMULA_PWM1 0 0.0 0.0 9.362099647521973 READ_WRITE ECU_ADDRESS 0x3045A0 /end MEASUREMENT
/begin MEASUREMENT tpu_pwm_active_time_tev2 "TPU PWM active time." UWORD FORMULA_PWM1 0 0.0 0.0 9.362099647521973 READ_WRITE ECU_ADDRESS 0x3045B0 /end MEASUREMENT
/begin MEASUREMENT tpu_pwm_passive_time_elue "TPU PWM passive time." UWORD FORMULA_PWM1 0 0.0 0.0 9.362099647521973 READ_WRITE ECU_ADDRESS 0x3045C4 /end MEASUREMENT
/begin MEASUREMENT tpu_pwm_passive_time_tev1 "TPU PWM passive time." UWORD FORMULA_PWM1 0 0.0 0.0 9.362099647521973 READ_WRITE ECU_ADDRESS 0x3045A4 /end MEASUREMENT
/begin MEASUREMENT tpu_pwm_passive_time_tev2 "TPU PWM passive time." UWORD FORMULA_PWM1 0 0.0 0.0 9.362099647521973 READ_WRITE ECU_ADDRESS 0x3045B4 /end MEASUREMENT
/begin MEASUREMENT tpu_pwm_period_elue "TPU PWM period." UWORD FORMULA_PWM1 0 0.0 0.0 9.362099647521973 READ_WRITE ECU_ADDRESS 0x3045C2 /end MEASUREMENT
/begin MEASUREMENT tpu_pwm_period_tev1 "TPU PWM period." UWORD FORMULA_PWM1 0 0.0 0.0 9.362099647521973 READ_WRITE ECU_ADDRESS 0x3045A2 /end MEASUREMENT
/begin MEASUREMENT tpu_pwm_period_tev2 "TPU PWM period." UWORD FORMULA_PWM1 0 0.0 0.0 9.362099647521973 READ_WRITE ECU_ADDRESS 0x3045B2 /end MEASUREMENT
/begin COMPU_METHOD DEFAULT_FORMULA "DEFAULT_FORMULA" RAT_FUNC "%7.0" "" COEFFS 0 1 0 0 0 1 /end COMPU_METHOD
/begin COMPU_METHOD FORMULA_INJ1 "FORMULA_INJ1" RAT_FUNC "%7.2" "°" COEFFS 0 91.0222066877656 0.0 0 0.0 1.0 /end COMPU_METHOD
/begin COMPU_METHOD FORMULA_INJ11 "FORMULA_INJ11" RAT_FUNC "%9.2" "ms" COEFFS 0 27.34375 0.0 0 0.0 1.0 /end COMPU_METHOD
/begin COMPU_METHOD FORMULA_INJ2 "FORMULA_INJ2" RAT_FUNC "%7.2" "ms" COEFFS 0 7000.0 0.0 0 0.0 1.0 /end COMPU_METHOD
/begin COMPU_METHOD FORMULA_INJ4 "FORMULA_INJ4" RAT_FUNC "%7.0" "-" COEFFS 0 1 0 0 0 1 /end COMPU_METHOD
/begin COMPU_METHOD FORMULA_NW1 "FORMULA_NW1" RAT_FUNC "%9.2" "ms" COEFFS 0 7000.0 0.0 0 0.0 1.0 /end COMPU_METHOD
/begin COMPU_METHOD FORMULA_NW2 "FORMULA_NW2" RAT_FUNC "%12.2" "ms" COEFFS 0 840000.0 0.0 0 0.0 1.0 /end COMPU_METHOD
/begin COMPU_METHOD FORMULA_NW3 "FORMULA_NW3" RAT_FUNC "%5.0" "-" COEFFS 0 256.0 128.0 0 0.0 1.0 /end COMPU_METHOD
/begin COMPU_METHOD FORMULA_NW4 "FORMULA_NW4" RAT_FUNC "%5.0" "-" COEFFS 0 32768.0 0.0 0 0.0 1.0 /end COMPU_METHOD
/begin COMPU_METHOD FORMULA_PWM1 "FORMULA_PWM1" RAT_FUNC "%7.2" "ms" COEFFS 0 7000.0 0.0 0 0.0 1.0 /end COMPU_METHOD
/end MODULE
/end PROJECT
