ASAP2_VERSION 1 3
/begin PROJECT P389 "BMW DDE6.0 4-Zylinder V70.2 30.03.2004"
/begin HEADER "" VERSION "V70.2_4Z" PROJECT_NO P389 /end HEADER
/begin MODULE DIM ""
/begin MOD_COMMON "" BYTE_ORDER MSB_FIRST ALIGNMENT_BYTE 1 ALIGNMENT_WORD 2 ALIGNMENT_LONG 4 ALIGNMENT_FLOAT32_IEEE 4 /end MOD_COMMON
/begin CHARACTERISTIC ANZMRKAUS "wie oft die anzeige ausgeschalten wird" VALUE 0xC05BC KwWU8 255.0 dez 0.00 255.0 FORMAT "%5.1" /end CHARACTERISTIC
/begin CHARACTERISTIC ANZMRKMX "max. zulässige anzahl von geschwindigkeits- marken beim stufentempomat" VALUE 0xC05BD KwWU8 255.0 dez 0.00 255.0 FORMAT "%5.1" /end CHARACTERISTIC
/begin CHARACTERISTIC CrCtl_aAccLim_C "Minimal erlaubte Fahrzeugbeschleunigung für Übergang von SET+ zu HOLD" VALUE 0xC8FBC Kw_Ws16 10.00000 Acc 0.00 10.00000 FORMAT "%8.5" EXTENDED_LIMITS -32.76800 32.76700 /end CHARACTERISTIC
/begin CHARACTERISTIC CrCtl_AccGear2PKp_C "P-Reglerparametersatz für Beschleunigung 2.Gang" VALUE 0xC8FC0 Kw_Wu32 1310719.99969 Kp_Vel2TrqPrp 0.00 1310719.99969 FORMAT "%13.5" /end CHARACTERISTIC
/begin CHARACTERISTIC CrCtl_AccGear2PKpPos_C "P-Reglerparametersatz für Beschleunigung 2.Gang" VALUE 0xC8FC4 Kw_Wu32 1310719.99969 Kp_Vel2TrqPrp 0.00 1310719.99969 FORMAT "%13.5" /end CHARACTERISTIC
/begin CHARACTERISTIC CrCtl_AccGear2PKpNeg_C "P-Reglerparametersatz für Beschleunigung 2.Gang" VALUE 0xC8FC8 Kw_Wu32 1310719.99969 Kp_Vel2TrqPrp 0.00 1310719.99969 FORMAT "%13.5" /end CHARACTERISTIC
/begin CHARACTERISTIC CrCtl_vAccGear2PWinPos_C "P-Reglerparametersatz für Beschleunigung 2.Gang" VALUE 0xC8FCC Kw_Ws16 300.0000 Vel 0.00 300.0000 FORMAT "%8.4" EXTENDED_LIMITS -327.6800 327.6700 /end CHARACTERISTIC
/begin CHARACTERISTIC CrCtl_vAccGear2PWinNeg_C "P-Reglerparametersatz für Beschleunigung 2.Gang" VALUE 0xC8FCE Kw_Ws16 300.0000 Vel -300.0000 0.00 FORMAT "%8.4" EXTENDED_LIMITS -327.6800 327.6700 /end CHARACTERISTIC
/begin CHARACTERISTIC CrCtl_AccGear3PKp_C "P-Reglerparametersatz für Beschleunigung 3.Gang" VALUE 0xC8FD0 Kw_Wu32 1310719.99969 Kp_Vel2TrqPrp 0.00 1310719.99969 FORMAT "%13.5" /end CHARACTERISTIC
/begin CHARACTERISTIC CrCtl_AccGear3PKpPos_C "P-Reglerparametersatz für Beschleunigung 3.Gang" VALUE 0xC8FD4 Kw_Wu32 1310719.99969 Kp_Vel2TrqPrp 0.00 1310719.99969 FORMAT "%13.5" /end CHARACTERISTIC
/begin CHARACTERISTIC CrCtl_AccGear3PKpNeg_C "P-Reglerparametersatz für Beschleunigung 3.Gang" VALUE 0xC8FD8 Kw_Wu32 1310719.99969 Kp_Vel2TrqPrp 0.00 1310719.99969 FORMAT "%13.5" /end CHARACTERISTIC
/begin CHARACTERISTIC CrCtl_vAccGear3PWinPos_C "P-Reglerparametersatz für Beschleunigung 3.Gang" VALUE 0xC8FDC Kw_Ws16 300.0000 Vel 0.00 300.0000 FORMAT "%8.4" EXTENDED_LIMITS -327.6800 327.6700 /end CHARACTERISTIC
/begin CHARACTERISTIC CrCtl_vAccGear3PWinNeg_C "P-Reglerparametersatz für Beschleunigung 3.Gang" VALUE 0xC8FDE Kw_Ws16 300.0000 Vel -300.0000 0.00 FORMAT "%8.4" EXTENDED_LIMITS -327.6800 327.6700 /end CHARACTERISTIC
/begin CHARACTERISTIC CrCtl_AccGear4PKp_C "P-Reglerparametersatz für Beschleunigung 4.Gang" VALUE 0xC8FE0 Kw_Wu32 1310719.99969 Kp_Vel2TrqPrp 0.00 1310719.99969 FORMAT "%13.5" /end CHARACTERISTIC
/begin CHARACTERISTIC CrCtl_AccGear4PKpPos_C "P-Reglerparametersatz für Beschleunigung 4.Gang" VALUE 0xC8FE4 Kw_Wu32 1310719.99969 Kp_Vel2TrqPrp 0.00 1310719.99969 FORMAT "%13.5" /end CHARACTERISTIC
/begin CHARACTERISTIC CrCtl_AccGear4PKpNeg_C "P-Reglerparametersatz für Beschleunigung 4.Gang" VALUE 0xC8FE8 Kw_Wu32 1310719.99969 Kp_Vel2TrqPrp 0.00 1310719.99969 FORMAT "%13.5" /end CHARACTERISTIC
/begin CHARACTERISTIC CrCtl_vAccGear4PWinPos_C "P-Reglerparametersatz für Beschleunigung 4.Gang" VALUE 0xC8FEC Kw_Ws16 300.0000 Vel 0.00 300.0000 FORMAT "%8.4" EXTENDED_LIMITS -327.6800 327.6700 /end CHARACTERISTIC
/begin CHARACTERISTIC CrCtl_vAccGear4PWinNeg_C "P-Reglerparametersatz für Beschleunigung 4.Gang" VALUE 0xC8FEE Kw_Ws16 300.0000 Vel -300.0000 0.00 FORMAT "%8.4" EXTENDED_LIMITS -327.6800 327.6700 /end CHARACTERISTIC
/begin CHARACTERISTIC CrCtl_AccGear5PKp_C "P-Reglerparametersatz für Beschleunigung 5.Gang" VALUE 0xC8FF0 Kw_Wu32 1310719.99969 Kp_Vel2TrqPrp 0.00 1310719.99969 FORMAT "%13.5" /end CHARACTERISTIC
/begin CHARACTERISTIC CrCtl_AccGear5PKpPos_C "P-Reglerparametersatz für Beschleunigung 5.Gang" VALUE 0xC8FF4 Kw_Wu32 1310719.99969 Kp_Vel2TrqPrp 0.00 1310719.99969 FORMAT "%13.5" /end CHARACTERISTIC
/begin CHARACTERISTIC CrCtl_AccGear5PKpNeg_C "P-Reglerparametersatz für Beschleunigung 5.Gang" VALUE 0xC8FF8 Kw_Wu32 1310719.99969 Kp_Vel2TrqPrp 0.00 1310719.99969 FORMAT "%13.5" /end CHARACTERISTIC
/begin CHARACTERISTIC CrCtl_vAccGear5PWinPos_C "P-Reglerparametersatz für Beschleunigung 5.Gang" VALUE 0xC8FFC Kw_Ws16 300.0000 Vel 0.00 300.0000 FORMAT "%8.4" EXTENDED_LIMITS -327.6800 327.6700 /end CHARACTERISTIC
/begin CHARACTERISTIC CrCtl_vAccGear5PWinNeg_C "P-Reglerparametersatz für Beschleunigung 5.Gang" VALUE 0xC8FFE Kw_Ws16 300.0000 Vel -300.0000 0.00 FORMAT "%8.4" EXTENDED_LIMITS -327.6800 327.6700 /end CHARACTERISTIC
/begin CHARACTERISTIC CrCtl_AccGear6PKp_C "P-Reglerparametersatz für Beschleunigung 6.Gang" VALUE 0xC9000 Kw_Wu32 1310719.99969 Kp_Vel2TrqPrp 0.00 1310719.99969 FORMAT "%13.5" /end CHARACTERISTIC
/begin CHARACTERISTIC CrCtl_AccGear6PKpPos_C "P-Reglerparametersatz für Beschleunigung 6.Gang" VALUE 0xC9004 Kw_Wu32 1310719.99969 Kp_Vel2TrqPrp 0.00 1310719.99969 FORMAT "%13.5" /end CHARACTERISTIC
/begin CHARACTERISTIC CrCtl_AccGear6PKpNeg_C "P-Reglerparametersatz für Beschleunigung 6.Gang" VALUE 0xC9008 Kw_Wu32 1310719.99969 Kp_Vel2TrqPrp 0.00 1310719.99969 FORMAT "%13.5" /end CHARACTERISTIC
/begin CHARACTERISTIC CrCtl_vAccGear6PWinPos_C "P-Reglerparametersatz für Beschleunigung 6.Gang" VALUE 0xC900C Kw_Ws16 300.0000 Vel 0.00 300.0000 FORMAT "%8.4" EXTENDED_LIMITS -327.6800 327.6700 /end CHARACTERISTIC
/begin CHARACTERISTIC CrCtl_vAccGear6PWinNeg_C "P-Reglerparametersatz für Beschleunigung 6.Gang" VALUE 0xC900E Kw_Ws16 300.0000 Vel -300.0000 0.00 FORMAT "%8.4" EXTENDED_LIMITS -327.6800 327.6700 /end CHARACTERISTIC
/begin CHARACTERISTIC CrCtl_aDeclLim_C "neg. Beschleunigungsschwelle Übergang EIN- zu HALTEN" VALUE 0xC9010 Kw_Ws16 10.00000 Acc -10.00000 0.00 FORMAT "%8.5" EXTENDED_LIMITS -32.76800 32.76700 /end CHARACTERISTIC
/begin CHARACTERISTIC CrCtl_ctMaxTip_C "Maximal erlaubte Tipanzahl ohne Erreichen der Sollgeschwindigkeit" VALUE 0xC9012 Kw_Wu8 100.0 OneToOne 0.00 100.0 FORMAT "%5.1" EXTENDED_LIMITS 0.00 255.0 /end CHARACTERISTIC
/begin CHARACTERISTIC CrCtl_DebToVCrCtlDef_C "dfhjdghkj" VALUE 0xC9514 Kw_Wu16 65535.00 OneToOne 0.00 65535.00 FORMAT "%8.2" /end CHARACTERISTIC
/begin CHARACTERISTIC CrCtl_DebToVCrCtlOk_C " Healing time for CrCtl_-messages Timeout" VALUE 0xC9516 Kw_Wu16 65535.00 OneToOne 0.00 65535.00 FORMAT "%8.2" /end CHARACTERISTIC
/begin CHARACTERISTIC CrCtl_DeclGear2PKp_C "P-Reglerparametersatz für Verzögerung 2.Gang" VALUE 0xC9014 Kw_Wu32 1310719.99969 Kp_Vel2TrqPrp 0.00 1310719.99969 FORMAT "%13.5" /end CHARACTERISTIC
/begin CHARACTERISTIC CrCtl_DeclGear2PKpPos_C "P-Reglerparametersatz für Verzögerung 2.Gang" VALUE 0xC9018 Kw_Wu32 1310719.99969 Kp_Vel2TrqPrp 0.00 1310719.99969 FORMAT "%13.5" /end CHARACTERISTIC
/begin CHARACTERISTIC CrCtl_DeclGear2PKpNeg_C "P-Reglerparametersatz für Verzögerung 2.Gang" VALUE 0xC901C Kw_Wu32 1310719.99969 Kp_Vel2TrqPrp 0.00 1310719.99969 FORMAT "%13.5" /end CHARACTERISTIC
/begin CHARACTERISTIC CrCtl_vDeclGear2PWinPos_C "P-Reglerparametersatz für Verzögerung 2.Gang" VALUE 0xC9020 Kw_Ws16 300.0000 Vel 0.00 300.0000 FORMAT "%8.4" EXTENDED_LIMITS -327.6800 327.6700 /end CHARACTERISTIC
/begin CHARACTERISTIC CrCtl_vDeclGear2PWinNeg_C "P-Reglerparametersatz für Verzögerung 2.Gang" VALUE 0xC9022 Kw_Ws16 300.0000 Vel -300.0000 0.00 FORMAT "%8.4" EXTENDED_LIMITS -327.6800 327.6700 /end CHARACTERISTIC
/begin CHARACTERISTIC CrCtl_DeclGear3PKp_C "P-Reglerparametersatz für Verzögerung 3.Gang" VALUE 0xC9024 Kw_Wu32 1310719.99969 Kp_Vel2TrqPrp 0.00 1310719.99969 FORMAT "%13.5" /end CHARACTERISTIC
/begin CHARACTERISTIC CrCtl_DeclGear3PKpPos_C "P-Reglerparametersatz für Verzögerung 3.Gang" VALUE 0xC9028 Kw_Wu32 1310719.99969 Kp_Vel2TrqPrp 0.00 1310719.99969 FORMAT "%13.5" /end CHARACTERISTIC
/begin CHARACTERISTIC CrCtl_DeclGear3PKpNeg_C "P-Reglerparametersatz für Verzögerung 3.Gang" VALUE 0xC902C Kw_Wu32 1310719.99969 Kp_Vel2TrqPrp 0.00 1310719.99969 FORMAT "%13.5" /end CHARACTERISTIC
/begin CHARACTERISTIC CrCtl_vDeclGear3PWinPos_C "P-Reglerparametersatz für Verzögerung 3.Gang" VALUE 0xC9030 Kw_Ws16 300.0000 Vel 0.00 300.0000 FORMAT "%8.4" EXTENDED_LIMITS -327.6800 327.6700 /end CHARACTERISTIC
/begin CHARACTERISTIC CrCtl_vDeclGear3PWinNeg_C "P-Reglerparametersatz für Verzögerung 3.Gang" VALUE 0xC9032 Kw_Ws16 300.0000 Vel -300.0000 0.00 FORMAT "%8.4" EXTENDED_LIMITS -327.6800 327.6700 /end CHARACTERISTIC
/begin CHARACTERISTIC CrCtl_DeclGear4PKp_C "P-Reglerparametersatz für Verzögerung 4.Gang" VALUE 0xC9034 Kw_Wu32 1310719.99969 Kp_Vel2TrqPrp 0.00 1310719.99969 FORMAT "%13.5" /end CHARACTERISTIC
/begin CHARACTERISTIC CrCtl_DeclGear4PKpPos_C "P-Reglerparametersatz für Verzögerung 4.Gang" VALUE 0xC9038 Kw_Wu32 1310719.99969 Kp_Vel2TrqPrp 0.00 1310719.99969 FORMAT "%13.5" /end CHARACTERISTIC
/begin CHARACTERISTIC CrCtl_DeclGear4PKpNeg_C "P-Reglerparametersatz für Verzögerung 4.Gang" VALUE 0xC903C Kw_Wu32 1310719.99969 Kp_Vel2TrqPrp 0.00 1310719.99969 FORMAT "%13.5" /end CHARACTERISTIC
/begin CHARACTERISTIC CrCtl_vDeclGear4PWinPos_C "P-Reglerparametersatz für Verzögerung 4.Gang" VALUE 0xC9040 Kw_Ws16 300.0000 Vel 0.00 300.0000 FORMAT "%8.4" EXTENDED_LIMITS -327.6800 327.6700 /end CHARACTERISTIC
/begin CHARACTERISTIC CrCtl_vDeclGear4PWinNeg_C "P-Reglerparametersatz für Verzögerung 4.Gang" VALUE 0xC9042 Kw_Ws16 300.0000 Vel -300.0000 0.00 FORMAT "%8.4" EXTENDED_LIMITS -327.6800 327.6700 /end CHARACTERISTIC
/begin CHARACTERISTIC CrCtl_DeclGear5PKp_C "P-Reglerparametersatz für Verzögerung 5.Gang" VALUE 0xC9044 Kw_Wu32 1310719.99969 Kp_Vel2TrqPrp 0.00 1310719.99969 FORMAT "%13.5" /end CHARACTERISTIC
/begin CHARACTERISTIC CrCtl_DeclGear5PKpPos_C "P-Reglerparametersatz für Verzögerung 5.Gang" VALUE 0xC9048 Kw_Wu32 1310719.99969 Kp_Vel2TrqPrp 0.00 1310719.99969 FORMAT "%13.5" /end CHARACTERISTIC
/begin CHARACTERISTIC CrCtl_DeclGear5PKpNeg_C "P-Reglerparametersatz für Verzögerung 5.Gang" VALUE 0xC904C Kw_Wu32 1310719.99969 Kp_Vel2TrqPrp 0.00 1310719.99969 FORMAT "%13.5" /end CHARACTERISTIC
/begin CHARACTERISTIC CrCtl_vDeclGear5PWinPos_C "P-Reglerparametersatz für Verzögerung 5.Gang" VALUE 0xC9050 Kw_Ws16 300.0000 Vel 0.00 300.0000 FORMAT "%8.4" EXTENDED_LIMITS -327.6800 327.6700 /end CHARACTERISTIC
/begin CHARACTERISTIC CrCtl_vDeclGear5PWinNeg_C "P-Reglerparametersatz für Verzögerung 5.Gang" VALUE 0xC9052 Kw_Ws16 300.0000 Vel -300.0000 0.00 FORMAT "%8.4" EXTENDED_LIMITS -327.6800 327.6700 /end CHARACTERISTIC
/begin CHARACTERISTIC CrCtl_DeclGear6PKp_C "P-Reglerparametersatz für Verzögerung 6.Gang" VALUE 0xC9054 Kw_Wu32 1310719.99969 Kp_Vel2TrqPrp 0.00 1310719.99969 FORMAT "%13.5" /end CHARACTERISTIC
/begin CHARACTERISTIC CrCtl_DeclGear6PKpPos_C "P-Reglerparametersatz für Verzögerung 6.Gang" VALUE 0xC9058 Kw_Wu32 1310719.99969 Kp_Vel2TrqPrp 0.00 1310719.99969 FORMAT "%13.5" /end CHARACTERISTIC
/begin CHARACTERISTIC CrCtl_DeclGear6PKpNeg_C "P-Reglerparametersatz für Verzögerung 6.Gang" VALUE 0xC905C Kw_Wu32 1310719.99969 Kp_Vel2TrqPrp 0.00 1310719.99969 FORMAT "%13.5" /end CHARACTERISTIC
/begin CHARACTERISTIC CrCtl_vDeclGear6PWinPos_C "P-Reglerparametersatz für Verzögerung 6.Gang" VALUE 0xC9060 Kw_Ws16 300.0000 Vel 0.00 300.0000 FORMAT "%8.4" EXTENDED_LIMITS -327.6800 327.6700 /end CHARACTERISTIC
/begin CHARACTERISTIC CrCtl_vDeclGear6PWinNeg_C "P-Reglerparametersatz für Verzögerung 6.Gang" VALUE 0xC9062 Kw_Ws16 300.0000 Vel -300.0000 0.00 FORMAT "%8.4" EXTENDED_LIMITS -327.6800 327.6700 /end CHARACTERISTIC
/begin CHARACTERISTIC CrCtl_dtrqAccDwn_C "FGR: EIN+: Anstieg Momentenverringerung nach Loslassen EIN+ Taste" VALUE 0xC9064 Kw_Ws16 327670.0 dTrqPrp_20ms 0.00 327670.0 FORMAT "%8.1" EXTENDED_LIMITS -327680.0 327670.0 /end CHARACTERISTIC
/begin CHARACTERISTIC CrCtl_dtrqDeclUp_C "FGR, EIN-: Momentenanstieg nach Loslassen EIN- Taste" VALUE 0xC9066 Kw_Ws16 327670.0 dTrqPrp_20ms 0.00 327670.0 FORMAT "%8.1" EXTENDED_LIMITS -327680.0 327670.0 /end CHARACTERISTIC
/begin CHARACTERISTIC CrCtl_dtrqOffComf1_C "Rampensteigung 1 Komfortabschaltung" VALUE 0xC9068 Kw_Ws16 327670.0 dTrqPrp_20ms 0.00 327670.0 FORMAT "%8.1" EXTENDED_LIMITS -327680.0 327670.0 /end CHARACTERISTIC
/begin CHARACTERISTIC CrCtl_dtrqOffComf2_C "Rampensteigung 2 Komfortabschaltung" VALUE 0xC906A Kw_Ws16 327670.0 dTrqPrp_20ms 0.00 327670.0 FORMAT "%8.1" EXTENDED_LIMITS -327680.0 327670.0 /end CHARACTERISTIC
/begin CHARACTERISTIC CrCtl_dtrqOffFast1_CUR "Kurve für erste Rampe bei Schnellabschaltung" CURVE 0xC906C Kl_Xs16_Ws16 327670.0 dTrqPrp_20ms 0.00 327670.0 FORMAT "%8.1" EXTENDED_LIMITS -327680.0 327670.0
 /begin AXIS_DESCR STD_AXIS Gearbx_stGear OneToOne 8 -1.000 6.000 FORMAT "%5.3" EXTENDED_LIMITS -128.0 127.0 DEPOSIT ABSOLUTE /end AXIS_DESCR
/end CHARACTERISTIC
/begin CHARACTERISTIC CrCtl_dtrqOffFast2_CUR "Kurve für zweite Rampe bei Schnellabschaltung" CURVE 0xC908E Kl_Xs16_Ws16 327670.0 dTrqPrp_20ms 0.00 327670.0 FORMAT "%8.1" EXTENDED_LIMITS -327680.0 327670.0
 /begin AXIS_DESCR STD_AXIS Gearbx_stGear OneToOne 8 -1.000 6.000 FORMAT "%5.3" EXTENDED_LIMITS -128.0 127.0 DEPOSIT ABSOLUTE /end AXIS_DESCR
/end CHARACTERISTIC
/begin CHARACTERISTIC CrCtl_dtrqOffFast3_CUR "Kennfled für dritte Rampe bei Schnellabschaltung" CURVE 0xC90B0 Kl_Xs16_Ws16 327670.0 dTrqPrp_20ms 0.00 327670.0 FORMAT "%8.1" EXTENDED_LIMITS -327680.0 327670.0
 /begin AXIS_DESCR STD_AXIS Gearbx_stGear OneToOne 8 -1.000 6.000 FORMAT "%5.3" EXTENDED_LIMITS -128.0 127.0 DEPOSIT ABSOLUTE /end AXIS_DESCR
/end CHARACTERISTIC
/begin CHARACTERISTIC CrCtl_dvAccFDCG3_CUR "Curve for slope of ramp speed in acceleration <= 3th gear" CURVE 0xC90D2 Kl_Xs16_Ws16 16383.50 dVel_20ms 0.00 16383.50 FORMAT "%8.2" EXTENDED_LIMITS -16384.00 16383.50
 /begin AXIS_DESCR STD_AXIS CrCtl_vBeg Vel 3 0.00 300.0000 FORMAT "%8.4" EXTENDED_LIMITS -327.6800 327.6700 DEPOSIT ABSOLUTE /end AXIS_DESCR
/end CHARACTERISTIC
/begin CHARACTERISTIC CrCtl_dvAccFDCG4_CUR "Curve for slope of ramp speed in acceleration (EIN+), 4th gear" CURVE 0xC90E0 Kl_Xs16_Ws16 16383.50 dVel_20ms 0.00 16383.50 FORMAT "%8.2" EXTENDED_LIMITS -16384.00 16383.50
 /begin AXIS_DESCR STD_AXIS CrCtl_vBeg Vel 3 0.00 300.0000 FORMAT "%8.4" EXTENDED_LIMITS -327.6800 327.6700 DEPOSIT ABSOLUTE /end AXIS_DESCR
/end CHARACTERISTIC
/begin CHARACTERISTIC CrCtl_dvAccFDCG5_CUR "Curve for slope of ramp speed in acceleration (EIN+), 5th gear" CURVE 0xC90EE Kl_Xs16_Ws16 16383.50 dVel_20ms 0.00 16383.50 FORMAT "%8.2" EXTENDED_LIMITS -16384.00 16383.50
 /begin AXIS_DESCR STD_AXIS CrCtl_vBeg Vel 3 0.00 300.0000 FORMAT "%8.4" EXTENDED_LIMITS -327.6800 327.6700 DEPOSIT ABSOLUTE /end AXIS_DESCR
/end CHARACTERISTIC
/begin CHARACTERISTIC CrCtl_dvAccFDCG6_CUR "Curve for slope of ramp speed in acceleration (EIN+), >= 6th gear" CURVE 0xC90FC Kl_Xs16_Ws16 16383.50 dVel_20ms 0.00 16383.50 FORMAT "%8.2" EXTENDED_LIMITS -16384.00 16383.50
 /begin AXIS_DESCR STD_AXIS CrCtl_vBeg Vel 3 0.00 300.0000 FORMAT "%8.4" EXTENDED_LIMITS -327.6800 327.6700 DEPOSIT ABSOLUTE /end AXIS_DESCR
/end CHARACTERISTIC
/begin CHARACTERISTIC CrCtl_dvAccG3_CUR "KL Anstieg FGR Rampengeschwindigkeit bei EIN+ für Gang <= 3" CURVE 0xC910A Kl_Xs16_Ws16 16383.50 dVel_20ms 0.00 16383.50 FORMAT "%8.2" EXTENDED_LIMITS -16384.00 16383.50
 /begin AXIS_DESCR STD_AXIS CrCtl_vBeg Vel 3 0.00 300.0000 FORMAT "%8.4" EXTENDED_LIMITS -327.6800 327.6700 DEPOSIT ABSOLUTE /end AXIS_DESCR
/end CHARACTERISTIC
/begin CHARACTERISTIC CrCtl_dvAccG4_CUR "KL Anstieg FGR Rampengeschwindigkeit bei EIN+ für 4. Gang" CURVE 0xC9118 Kl_Xs16_Ws16 16383.50 dVel_20ms 0.00 16383.50 FORMAT "%8.2" EXTENDED_LIMITS -16384.00 16383.50
 /begin AXIS_DESCR STD_AXIS CrCtl_vBeg Vel 3 0.00 300.0000 FORMAT "%8.4" EXTENDED_LIMITS -327.6800 327.6700 DEPOSIT ABSOLUTE /end AXIS_DESCR
/end CHARACTERISTIC
/begin CHARACTERISTIC CrCtl_dvAccG5_CUR "KL Anstieg FGR Rampengeschwindigkeit bei EIN+ für 5. Gang" CURVE 0xC9126 Kl_Xs16_Ws16 16383.50 dVel_20ms 0.00 16383.50 FORMAT "%8.2" EXTENDED_LIMITS -16384.00 16383.50
 /begin AXIS_DESCR STD_AXIS CrCtl_vBeg Vel 3 0.00 300.0000 FORMAT "%8.4" EXTENDED_LIMITS -327.6800 327.6700 DEPOSIT ABSOLUTE /end AXIS_DESCR
/end CHARACTERISTIC
/begin CHARACTERISTIC CrCtl_dvAccG6_CUR "KL Anstieg FGR Rampengeschwindigkeit bei EIN+ für 6. Gang" CURVE 0xC9134 Kl_Xs16_Ws16 16383.50 dVel_20ms 0.00 16383.50 FORMAT "%8.2" EXTENDED_LIMITS -16384.00 16383.50
 /begin AXIS_DESCR STD_AXIS CrCtl_vBeg Vel 3 0.00 300.0000 FORMAT "%8.4" EXTENDED_LIMITS -327.6800 327.6700 DEPOSIT ABSOLUTE /end AXIS_DESCR
/end CHARACTERISTIC
/begin CHARACTERISTIC CrCtl_dvDeclFDCG3_CUR "Curve for slope of ramp speed in acceleration (EIN+), >= 3rd gear" CURVE 0xC9142 Kl_Xs16_Ws16 16383.50 dVel_20ms 0.00 16383.50 FORMAT "%8.2" EXTENDED_LIMITS -16384.00 16383.50
 /begin AXIS_DESCR STD_AXIS CrCtl_vBeg Vel 3 0.00 300.0000 FORMAT "%8.4" EXTENDED_LIMITS -327.6800 327.6700 DEPOSIT ABSOLUTE /end AXIS_DESCR
/end CHARACTERISTIC
/begin CHARACTERISTIC CrCtl_dvDeclFDCG4_CUR "Curve for slope of ramp speed in deceleration (EIN-), 4th gear" CURVE 0xC9150 Kl_Xs16_Ws16 16383.50 dVel_20ms 0.00 16383.50 FORMAT "%8.2" EXTENDED_LIMITS -16384.00 16383.50
 /begin AXIS_DESCR STD_AXIS CrCtl_vBeg Vel 3 0.00 300.0000 FORMAT "%8.4" EXTENDED_LIMITS -327.6800 327.6700 DEPOSIT ABSOLUTE /end AXIS_DESCR
/end CHARACTERISTIC
/begin CHARACTERISTIC CrCtl_dvDeclFDCG5_CUR "curve for ramp slope SET+ 5th gear for sport mode" CURVE 0xC915E Kl_Xs16_Ws16 16383.50 dVel_20ms 0.00 16383.50 FORMAT "%8.2" EXTENDED_LIMITS -16384.00 16383.50
 /begin AXIS_DESCR STD_AXIS CrCtl_vBeg Vel 3 0.00 300.0000 FORMAT "%8.4" EXTENDED_LIMITS -327.6800 327.6700 DEPOSIT ABSOLUTE /end AXIS_DESCR
/end CHARACTERISTIC
/begin CHARACTERISTIC CrCtl_dvDeclFDCG6_CUR "Curve for slope of ramp speed in deceleration (EIN-), >= 6th gear" CURVE 0xC916C Kl_Xs16_Ws16 16383.50 dVel_20ms 0.00 16383.50 FORMAT "%8.2" EXTENDED_LIMITS -16384.00 16383.50
 /begin AXIS_DESCR STD_AXIS CrCtl_vBeg Vel 3 0.00 300.0000 FORMAT "%8.4" EXTENDED_LIMITS -327.6800 327.6700 DEPOSIT ABSOLUTE /end AXIS_DESCR
/end CHARACTERISTIC
/begin CHARACTERISTIC CrCtl_dvDeclG3_CUR "KL Abstieg FGR Rampengeschwindigkeit bei EIN- für Gang <= 3" CURVE 0xC917A Kl_Xs16_Ws16 16383.50 dVel_20ms 0.00 16383.50 FORMAT "%8.2" EXTENDED_LIMITS -16384.00 16383.50
 /begin AXIS_DESCR STD_AXIS CrCtl_vBeg Vel 3 0.00 300.0000 FORMAT "%8.4" EXTENDED_LIMITS -327.6800 327.6700 DEPOSIT ABSOLUTE /end AXIS_DESCR
/end CHARACTERISTIC
/begin CHARACTERISTIC CrCtl_dvDeclG4_CUR "KL Abstieg FGR Rampengeschwindigkeit bei EIN- für 4. Gang" CURVE 0xC9188 Kl_Xs16_Ws16 16383.50 dVel_20ms 0.00 16383.50 FORMAT "%8.2" EXTENDED_LIMITS -16384.00 16383.50
 /begin AXIS_DESCR STD_AXIS CrCtl_vBeg Vel 3 0.00 300.0000 FORMAT "%8.4" EXTENDED_LIMITS -327.6800 327.6700 DEPOSIT ABSOLUTE /end AXIS_DESCR
/end CHARACTERISTIC
/begin CHARACTERISTIC CrCtl_dvDeclG5_CUR "KL Abstieg FGR Rampengeschwindigkeit bei EIN- für 5. Gang" CURVE 0xC9196 Kl_Xs16_Ws16 16383.50 dVel_20ms 0.00 16383.50 FORMAT "%8.2" EXTENDED_LIMITS -16384.00 16383.50
 /begin AXIS_DESCR STD_AXIS CrCtl_vBeg Vel 3 0.00 300.0000 FORMAT "%8.4" EXTENDED_LIMITS -327.6800 327.6700 DEPOSIT ABSOLUTE /end AXIS_DESCR
/end CHARACTERISTIC
/begin CHARACTERISTIC CrCtl_dvDeclG6_CUR "KL Abstieg FGR Rampengeschwindigkeit bei EIN- für 6. Gang" CURVE 0xC91A4 Kl_Xs16_Ws16 16383.50 dVel_20ms 0.00 16383.50 FORMAT "%8.2" EXTENDED_LIMITS -16384.00 16383.50
 /begin AXIS_DESCR STD_AXIS CrCtl_vBeg Vel 3 0.00 300.0000 FORMAT "%8.4" EXTENDED_LIMITS -327.6800 327.6700 DEPOSIT ABSOLUTE /end AXIS_DESCR
/end CHARACTERISTIC
/begin CHARACTERISTIC CrCtl_dvResAbvFDCG3_CUR "Curve for slope of set speed ramp RESUME ABOVE, >=3th gear" CURVE 0xC91B2 Kl_Xs16_Ws16 16383.50 dVel_20ms 0.00 16383.50 FORMAT "%8.2" EXTENDED_LIMITS -16384.00 16383.50
 /begin AXIS_DESCR STD_AXIS CrCtl_vBeg Vel 3 0.00 300.0000 FORMAT "%8.4" EXTENDED_LIMITS -327.6800 327.6700 DEPOSIT ABSOLUTE /end AXIS_DESCR
/end CHARACTERISTIC
/begin CHARACTERISTIC CrCtl_dvResAbvFDCG4_CUR "Curve for slope of set speed ramp RESUME ABOVE, >=4th gear" CURVE 0xC91C0 Kl_Xs16_Ws16 16383.50 dVel_20ms 0.00 16383.50 FORMAT "%8.2" EXTENDED_LIMITS -16384.00 16383.50
 /begin AXIS_DESCR STD_AXIS CrCtl_vBeg Vel 3 0.00 300.0000 FORMAT "%8.4" EXTENDED_LIMITS -327.6800 327.6700 DEPOSIT ABSOLUTE /end AXIS_DESCR
/end CHARACTERISTIC
/begin CHARACTERISTIC CrCtl_dvResAbvFDCG5_CUR "Curve for slope of set speed ramp RESUME ABOVE, >=5th gear" CURVE 0xC91CE Kl_Xs16_Ws16 16383.50 dVel_20ms 0.00 16383.50 FORMAT "%8.2" EXTENDED_LIMITS -16384.00 16383.50
 /begin AXIS_DESCR STD_AXIS CrCtl_vBeg Vel 3 0.00 300.0000 FORMAT "%8.4" EXTENDED_LIMITS -327.6800 327.6700 DEPOSIT ABSOLUTE /end AXIS_DESCR
/end CHARACTERISTIC
/begin CHARACTERISTIC CrCtl_dvResAbvFDCG6_CUR "Curve for slope of set speed ramp RESUME ABOVE, >=6th gear" CURVE 0xC91DC Kl_Xs16_Ws16 16383.50 dVel_20ms 0.00 16383.50 FORMAT "%8.2" EXTENDED_LIMITS -16384.00 16383.50
 /begin AXIS_DESCR STD_AXIS CrCtl_vBeg Vel 3 0.00 300.0000 FORMAT "%8.4" EXTENDED_LIMITS -327.6800 327.6700 DEPOSIT ABSOLUTE /end AXIS_DESCR
/end CHARACTERISTIC
/begin CHARACTERISTIC CrCtl_dvResAbvG3_MAP "KF Abstieg FGR Rampengeschwindigkeit bei WA von oben für Gang <= 3" MAP 0xC91EA Kf_Xs16_Ys16_Ws16 16383.50 dVel_20ms 0.00 16383.50 FORMAT "%8.2" EXTENDED_LIMITS -16384.00 16383.50
 /begin AXIS_DESCR STD_AXIS CrCtl_vBeg Vel 3 0.00 300.0000 FORMAT "%8.4" EXTENDED_LIMITS -327.6800 327.6700 DEPOSIT ABSOLUTE /end AXIS_DESCR
 /begin AXIS_DESCR STD_AXIS CrCtl_vDiff_mp Vel 1 0.00 300.0000 FORMAT "%8.4" EXTENDED_LIMITS -327.6800 327.6700 DEPOSIT ABSOLUTE /end AXIS_DESCR
/end CHARACTERISTIC
/begin CHARACTERISTIC CrCtl_dvResAbvG4_MAP "KF Abstieg FGR Rampengeschwindigkeit bei WA von oben für 4. Gang" MAP 0xC91FC Kf_Xs16_Ys16_Ws16 16383.50 dVel_20ms 0.00 16383.50 FORMAT "%8.2" EXTENDED_LIMITS -16384.00 16383.50
 /begin AXIS_DESCR STD_AXIS CrCtl_vBeg Vel 3 0.00 300.0000 FORMAT "%8.4" EXTENDED_LIMITS -327.6800 327.6700 DEPOSIT ABSOLUTE /end AXIS_DESCR
 /begin AXIS_DESCR STD_AXIS CrCtl_vDiff_mp Vel 1 0.00 300.0000 FORMAT "%8.4" EXTENDED_LIMITS -327.6800 327.6700 DEPOSIT ABSOLUTE /end AXIS_DESCR
/end CHARACTERISTIC
/begin CHARACTERISTIC CrCtl_dvResAbvG5_MAP "KF Abstieg FGR Rampengeschwindigkeit bei WA von oben für 5. Gang" MAP 0xC920E Kf_Xs16_Ys16_Ws16 16383.50 dVel_20ms 0.00 16383.50 FORMAT "%8.2" EXTENDED_LIMITS -16384.00 16383.50
 /begin AXIS_DESCR STD_AXIS CrCtl_vBeg Vel 3 0.00 300.0000 FORMAT "%8.4" EXTENDED_LIMITS -327.6800 327.6700 DEPOSIT ABSOLUTE /end AXIS_DESCR
 /begin AXIS_DESCR STD_AXIS CrCtl_vDiff_mp Vel 1 0.00 300.0000 FORMAT "%8.4" EXTENDED_LIMITS -327.6800 327.6700 DEPOSIT ABSOLUTE /end AXIS_DESCR
/end CHARACTERISTIC
/begin CHARACTERISTIC CrCtl_dvResAbvG6_MAP "KF Abstieg FGR Rampengeschwindigkeit bei WA von oben für 6. Gang" MAP 0xC9220 Kf_Xs16_Ys16_Ws16 16383.50 dVel_20ms 0.00 16383.50 FORMAT "%8.2" EXTENDED_LIMITS -16384.00 16383.50
 /begin AXIS_DESCR STD_AXIS CrCtl_vBeg Vel 3 0.00 300.0000 FORMAT "%8.4" EXTENDED_LIMITS -327.6800 327.6700 DEPOSIT ABSOLUTE /end AXIS_DESCR
 /begin AXIS_DESCR STD_AXIS CrCtl_vDiff_mp Vel 1 0.00 300.0000 FORMAT "%8.4" EXTENDED_LIMITS -327.6800 327.6700 DEPOSIT ABSOLUTE /end AXIS_DESCR
/end CHARACTERISTIC
/begin CHARACTERISTIC CrCtl_dvResBlwFDCG3_CUR "Curve for slope of set speed ramp RESUME BELOW, <= 3th gear" CURVE 0xC9232 Kl_Xs16_Ws16 16383.50 dVel_20ms 0.00 16383.50 FORMAT "%8.2" EXTENDED_LIMITS -16384.00 16383.50
 /begin AXIS_DESCR STD_AXIS CrCtl_vBeg Vel 3 0.00 300.0000 FORMAT "%8.4" EXTENDED_LIMITS -327.6800 327.6700 DEPOSIT ABSOLUTE /end AXIS_DESCR
/end CHARACTERISTIC
/begin CHARACTERISTIC CrCtl_dvResBlwFDCG4_CUR "Curve for slope of set speed ramp RESUME BELOW, <= 4th gear" CURVE 0xC9240 Kl_Xs16_Ws16 16383.50 dVel_20ms 0.00 16383.50 FORMAT "%8.2" EXTENDED_LIMITS -16384.00 16383.50
 /begin AXIS_DESCR STD_AXIS CrCtl_vBeg Vel 3 0.00 300.0000 FORMAT "%8.4" EXTENDED_LIMITS -327.6800 327.6700 DEPOSIT ABSOLUTE /end AXIS_DESCR
/end CHARACTERISTIC
/begin CHARACTERISTIC CrCtl_dvResBlwFDCG5_CUR "Curve for slope of set speed ramp RESUME BELOW, <= 5th gear" CURVE 0xC924E Kl_Xs16_Ws16 16383.50 dVel_20ms 0.00 16383.50 FORMAT "%8.2" EXTENDED_LIMITS -16384.00 16383.50
 /begin AXIS_DESCR STD_AXIS CrCtl_vBeg Vel 3 0.00 300.0000 FORMAT "%8.4" EXTENDED_LIMITS -327.6800 327.6700 DEPOSIT ABSOLUTE /end AXIS_DESCR
/end CHARACTERISTIC
/begin CHARACTERISTIC CrCtl_dvResBlwFDCG6_CUR "Curve for slope of set speed ramp RESUME BELOW, >=6th gear" CURVE 0xC925C Kl_Xs16_Ws16 16383.50 dVel_20ms 0.00 16383.50 FORMAT "%8.2" EXTENDED_LIMITS -16384.00 16383.50
 /begin AXIS_DESCR STD_AXIS CrCtl_vBeg Vel 3 0.00 300.0000 FORMAT "%8.4" EXTENDED_LIMITS -327.6800 327.6700 DEPOSIT ABSOLUTE /end AXIS_DESCR
/end CHARACTERISTIC
/begin CHARACTERISTIC CrCtl_dvResBlwG3_MAP "KF Anstieg FGR Rampengeschwindigkeit bei WA von unten für Gang <= 3" MAP 0xC926A Kf_Xs16_Ys16_Ws16 16383.50 dVel_20ms 0.00 16383.50 FORMAT "%8.2" EXTENDED_LIMITS -16384.00 16383.50
 /begin AXIS_DESCR STD_AXIS CrCtl_vBeg Vel 3 0.00 300.0000 FORMAT "%8.4" EXTENDED_LIMITS -327.6800 327.6700 DEPOSIT ABSOLUTE /end AXIS_DESCR
 /begin AXIS_DESCR STD_AXIS CrCtl_vDiff_mp Vel 1 0.00 300.0000 FORMAT "%8.4" EXTENDED_LIMITS -327.6800 327.6700 DEPOSIT ABSOLUTE /end AXIS_DESCR
/end CHARACTERISTIC
/begin CHARACTERISTIC CrCtl_dvResBlwG4_MAP "KF Anstieg FGR Rampengeschwindigkeit bei WA von unten für 4. Gang" MAP 0xC927C Kf_Xs16_Ys16_Ws16 16383.50 dVel_20ms 0.00 16383.50 FORMAT "%8.2" EXTENDED_LIMITS -16384.00 16383.50
 /begin AXIS_DESCR STD_AXIS CrCtl_vBeg Vel 3 0.00 300.0000 FORMAT "%8.4" EXTENDED_LIMITS -327.6800 327.6700 DEPOSIT ABSOLUTE /end AXIS_DESCR
 /begin AXIS_DESCR STD_AXIS CrCtl_vDiff_mp Vel 1 0.00 300.0000 FORMAT "%8.4" EXTENDED_LIMITS -327.6800 327.6700 DEPOSIT ABSOLUTE /end AXIS_DESCR
/end CHARACTERISTIC
/begin CHARACTERISTIC CrCtl_dvResBlwG5_MAP "KF Anstieg FGR Rampengeschwindigkeit bei WA von unten für 5. Gang" MAP 0xC928E Kf_Xs16_Ys16_Ws16 16383.50 dVel_20ms 0.00 16383.50 FORMAT "%8.2" EXTENDED_LIMITS -16384.00 16383.50
 /begin AXIS_DESCR STD_AXIS CrCtl_vBeg Vel 3 0.00 300.0000 FORMAT "%8.4" EXTENDED_LIMITS -327.6800 327.6700 DEPOSIT ABSOLUTE /end AXIS_DESCR
 /begin AXIS_DESCR STD_AXIS CrCtl_vDiff_mp Vel 1 0.00 300.0000 FORMAT "%8.4" EXTENDED_LIMITS -327.6800 327.6700 DEPOSIT ABSOLUTE /end AXIS_DESCR
/end CHARACTERISTIC
/begin CHARACTERISTIC CrCtl_dvResBlwG6_MAP "KF Anstieg FGR Rampengeschwindigkeit bei WA von unten für 6. Gang" MAP 0xC92A0 Kf_Xs16_Ys16_Ws16 16383.50 dVel_20ms 0.00 16383.50 FORMAT "%8.2" EXTENDED_LIMITS -16384.00 16383.50
 /begin AXIS_DESCR STD_AXIS CrCtl_vBeg Vel 3 0.00 300.0000 FORMAT "%8.4" EXTENDED_LIMITS -327.6800 327.6700 DEPOSIT ABSOLUTE /end AXIS_DESCR
 /begin AXIS_DESCR STD_AXIS CrCtl_vDiff_mp Vel 1 0.00 300.0000 FORMAT "%8.4" EXTENDED_LIMITS -327.6800 327.6700 DEPOSIT ABSOLUTE /end AXIS_DESCR
/end CHARACTERISTIC
/begin CHARACTERISTIC CrCtl_facIncSlope_CUR "Überhöhungskennlinie für SET+, SET-, WA+, WA-" CURVE 0xC92B2 Kl_Xs16_Ws16 7800.049 Prc_1000 -3900.024 3900.024 FORMAT "%8.3" EXTENDED_LIMITS -4000.000 3999.878
 /begin AXIS_DESCR STD_AXIS Rail_tiThresMonEna Time_ms 6 0.00 655350.0 FORMAT "%8.1" DEPOSIT ABSOLUTE /end AXIS_DESCR
/end CHARACTERISTIC
/begin CHARACTERISTIC CrCtl_facPropAcc_C "Proportionalfaktor für Initialmoment von Fahrgeschwindigkeit in EIN+/WAU des FGR" VALUE 0xC92CC Kw_Ws16 79.99756 Vel2TrqPrp 0.00 79.99756 FORMAT "%8.5" EXTENDED_LIMITS -80.00000 79.99756 /end CHARACTERISTIC
/begin CHARACTERISTIC CrCtl_facPropDecl_C "Proportionalfaktor für Offset von Fahrgeschwindigkeit zur Momentenerhöhung nach EIN-" VALUE 0xC92CE Kw_Ws16 79.99756 Vel2TrqPrp 0.00 79.99756 FORMAT "%8.5" EXTENDED_LIMITS -80.00000 79.99756 /end CHARACTERISTIC
/begin CHARACTERISTIC CrCtl_facRedDecl_C "Faktor zur Momentenreduzierung bei Übergang HALTEN zu EIN- nach Ablauf TIP-Erkennung" VALUE 0xC92D0 Kw_Ws16 100.0000 Prc 0.00 100.0000 FORMAT "%8.4" EXTENDED_LIMITS -400.0000 399.9878 /end CHARACTERISTIC
/begin CHARACTERISTIC CrCtl_facRedHi_C "höherer Faktor Reduzierung FGR Moment bei Loslassen EIN+ (FGR-Moment > Schwelle)" VALUE 0xC92D2 Kw_Ws16 100.0000 Prc 0.00 100.0000 FORMAT "%8.4" EXTENDED_LIMITS -400.0000 399.9878 /end CHARACTERISTIC
/begin CHARACTERISTIC CrCtl_facRedLo_C "niederer Faktor Reduzierung FGR-Moment bei Loslassen EIN+ (FGR-Moment <= Schwelle)" VALUE 0xC92D4 Kw_Ws16 100.0000 Prc 0.00 100.0000 FORMAT "%8.4" EXTENDED_LIMITS -400.0000 399.9878 /end CHARACTERISTIC
/begin CHARACTERISTIC CrCtl_facResAbvFDC_CUR "Curve for reducing the slope of ramp speed in WA- and Tip- at the end of the ramp" CURVE 0xC92D6 Kl_Xs16_Ws16 99.97559 Prc_1000 0.00 99.97559 FORMAT "%8.4" EXTENDED_LIMITS -4000.000 3999.878
 /begin AXIS_DESCR STD_AXIS CrCtl_vDiffRed_mp Vel 6 -327.6800 327.6700 FORMAT "%8.4" DEPOSIT ABSOLUTE /end AXIS_DESCR
/end CHARACTERISTIC
/begin CHARACTERISTIC CrCtl_facResAbv_CUR "Abflachungskennlinie für WA-" CURVE 0xC92F0 Kl_Xs16_Ws16 99.97559 Prc_1000 0.00 99.97559 FORMAT "%8.4" EXTENDED_LIMITS -4000.000 3999.878
 /begin AXIS_DESCR STD_AXIS CrCtl_vDiffRed_mp Vel 3 -327.6800 327.6700 FORMAT "%8.4" DEPOSIT ABSOLUTE /end AXIS_DESCR
/end CHARACTERISTIC
/begin CHARACTERISTIC CrCtl_facResBlwFDC_CUR " Curve for reducing the slope of ramp speed in WA+ and Tip+ at the end of the ramp" CURVE 0xC92FE Kl_Xs16_Ws16 99.97559 Prc_1000 0.00 99.97559 FORMAT "%8.4" EXTENDED_LIMITS -4000.000 3999.878
 /begin AXIS_DESCR STD_AXIS CrCtl_vDiffRed_mp Vel 6 -327.6800 327.6700 FORMAT "%8.4" DEPOSIT ABSOLUTE /end AXIS_DESCR
/end CHARACTERISTIC
/begin CHARACTERISTIC CrCtl_facResBlw_CUR "Abflachungskennlinie für WA+" CURVE 0xC9318 Kl_Xs16_Ws16 99.97559 Prc_1000 0.00 99.97559 FORMAT "%8.4" EXTENDED_LIMITS -4000.000 3999.878
 /begin AXIS_DESCR STD_AXIS CrCtl_vDiffRed_mp Vel 3 -327.6800 327.6700 FORMAT "%8.4" DEPOSIT ABSOLUTE /end AXIS_DESCR
/end CHARACTERISTIC
/begin CHARACTERISTIC CrCtl_facRmpRes_C "Faktor für Rampensteigung FGR-Geschwindigkeit WA (Endphase WA-Rampe)" VALUE 0xC9326 Kw_Ws16 1.000000 Fact 0.00 1.000000 FORMAT "%8.6" EXTENDED_LIMITS -4.000000 3.999878 /end CHARACTERISTIC
/begin CHARACTERISTIC CrCtl_HoldGear2IKi_C "Integralverstärkung Ki Kleinsignalbereich in HALTEN für 2. Gang" VALUE 0xC9328 Kw_Wu32 19999999.9953 Ki_Vel2TrqPrp 0.00 19999999.9953 FORMAT "%13.4" /end CHARACTERISTIC
/begin CHARACTERISTIC CrCtl_HoldGear2IKiPos_C "Integralverstärkung Ki pos. Großsignalbereich in HALTEN für 2. Gang" VALUE 0xC932C Kw_Wu32 19999999.9953 Ki_Vel2TrqPrp 0.00 19999999.9953 FORMAT "%13.4" /end CHARACTERISTIC
/begin CHARACTERISTIC CrCtl_HoldGear2IKiNeg_C "Integralverstärkung Ki neg. Großsignalbereich in HALTEN für 2. Gang" VALUE 0xC9330 Kw_Wu32 19999999.9953 Ki_Vel2TrqPrp 0.00 19999999.9953 FORMAT "%13.4" /end CHARACTERISTIC
/begin CHARACTERISTIC CrCtl_vHoldGear2IWinPos_C "obere Grenze Kleinsignalbereich I-Anteil in HALTEN, 2. Gang" VALUE 0xC9334 Kw_Ws16 300.0000 Vel 0.00 300.0000 FORMAT "%8.4" EXTENDED_LIMITS -327.6800 327.6700 /end CHARACTERISTIC
/begin CHARACTERISTIC CrCtl_vHoldGear2IWinNeg_C "untere Grenze Kleinsignalbereich I-Anteil in HALTEN, 2. Gang" VALUE 0xC9336 Kw_Ws16 300.0000 Vel -300.0000 0.00 FORMAT "%8.4" EXTENDED_LIMITS -327.6800 327.6700 /end CHARACTERISTIC
/begin CHARACTERISTIC CrCtl_HoldGear2PKp_C "Proportionalverstärkung Kp Kleinsignalbereich in HALTEN, 2. Gang" VALUE 0xC9338 Kw_Wu32 1310719.99969 Kp_Vel2TrqPrp 0.00 1310719.99969 FORMAT "%13.5" /end CHARACTERISTIC
/begin CHARACTERISTIC CrCtl_HoldGear2PKpPos_C "Proportionalverstärkung Kp pos. Großsignalbereich in HALTEN, 2. Gang" VALUE 0xC933C Kw_Wu32 1310719.99969 Kp_Vel2TrqPrp 0.00 1310719.99969 FORMAT "%13.5" /end CHARACTERISTIC
/begin CHARACTERISTIC CrCtl_HoldGear2PKpNeg_C "Proportionalverstärkung Kp neg. Großsignalbereich in HALTEN, 2. Gang" VALUE 0xC9340 Kw_Wu32 1310719.99969 Kp_Vel2TrqPrp 0.00 1310719.99969 FORMAT "%13.5" /end CHARACTERISTIC
/begin CHARACTERISTIC CrCtl_vHoldGear2PWinPos_C "obere Grenze Kleinsignalbereich P-Anteil in HALTEN, 2. Gang" VALUE 0xC9344 Kw_Ws16 300.0000 Vel 0.00 300.0000 FORMAT "%8.4" EXTENDED_LIMITS -327.6800 327.6700 /end CHARACTERISTIC
/begin CHARACTERISTIC CrCtl_vHoldGear2PWinNeg_C "untere Grenze Kleinsignalbereich P-Anteil in HALTEN, 2. Gang" VALUE 0xC9346 Kw_Ws16 300.0000 Vel -300.0000 0.00 FORMAT "%8.4" EXTENDED_LIMITS -327.6800 327.6700 /end CHARACTERISTIC
/begin CHARACTERISTIC CrCtl_HoldGear3IKi_C "Integralverstärkung Kleinsignalbereich in HALTEN, 3. Gang" VALUE 0xC9348 Kw_Wu32 19999999.9953 Ki_Vel2TrqPrp 0.00 19999999.9953 FORMAT "%13.4" /end CHARACTERISTIC
/begin CHARACTERISTIC CrCtl_HoldGear3IKiPos_C "Integralverstärkung Ki pos. Großsignalbereich in HALTEN, 3. Gang" VALUE 0xC934C Kw_Wu32 19999999.9953 Ki_Vel2TrqPrp 0.00 19999999.9953 FORMAT "%13.4" /end CHARACTERISTIC
/begin CHARACTERISTIC CrCtl_HoldGear3IKiNeg_C "Integralverstärkung Ki neg. Großsignalbereich in HALTEN, 3. Gang" VALUE 0xC9350 Kw_Wu32 19999999.9953 Ki_Vel2TrqPrp 0.00 19999999.9953 FORMAT "%13.4" /end CHARACTERISTIC
/begin CHARACTERISTIC CrCtl_vHoldGear3IWinPos_C "obere Grenze Kleinsignalbereich I-Anteil in HALTEN, 3. Gang" VALUE 0xC9354 Kw_Ws16 300.0000 Vel 0.00 300.0000 FORMAT "%8.4" EXTENDED_LIMITS -327.6800 327.6700 /end CHARACTERISTIC
/begin CHARACTERISTIC CrCtl_vHoldGear3IWinNeg_C "untere Grenze Kleinsignalbereich I-Anteil in HALTEN, 3. Gang" VALUE 0xC9356 Kw_Ws16 300.0000 Vel -300.0000 0.00 FORMAT "%8.4" EXTENDED_LIMITS -327.6800 327.6700 /end CHARACTERISTIC
/begin CHARACTERISTIC CrCtl_HoldGear3PKp_C "Proportionalverstärkung Kp Kleinsignalbereich in HALTEN, 3. Gang" VALUE 0xC9358 Kw_Wu32 1310719.99969 Kp_Vel2TrqPrp 0.00 1310719.99969 FORMAT "%13.5" /end CHARACTERISTIC
/begin CHARACTERISTIC CrCtl_HoldGear3PKpPos_C "Proportionalverstärkung Kp pos. Großsignalbereich in HALTEN, 3. Gang" VALUE 0xC935C Kw_Wu32 1310719.99969 Kp_Vel2TrqPrp 0.00 1310719.99969 FORMAT "%13.5" /end CHARACTERISTIC
/begin CHARACTERISTIC CrCtl_HoldGear3PKpNeg_C "Proportionalverstärkung Kp neg. Großsignalbereich in HALTEN, 3. Gang" VALUE 0xC9360 Kw_Wu32 1310719.99969 Kp_Vel2TrqPrp 0.00 1310719.99969 FORMAT "%13.5" /end CHARACTERISTIC
/begin CHARACTERISTIC CrCtl_vHoldGear3PWinPos_C "obere Grenze Kleinsignalbereich P-Anteil in HALTEN, 3. Gang" VALUE 0xC9364 Kw_Ws16 300.0000 Vel 0.00 300.0000 FORMAT "%8.4" EXTENDED_LIMITS -327.6800 327.6700 /end CHARACTERISTIC
/begin CHARACTERISTIC CrCtl_vHoldGear3PWinNeg_C "untere Grenze Kleinsignalbereich P-Anteil in HALTEN, 3. Gang" VALUE 0xC9366 Kw_Ws16 300.0000 Vel -300.0000 0.00 FORMAT "%8.4" EXTENDED_LIMITS -327.6800 327.6700 /end CHARACTERISTIC
/begin CHARACTERISTIC CrCtl_HoldGear4IKi_C "Integralverstärkung Kleinsignalbereich in HALTEN, 4. Gang" VALUE 0xC9368 Kw_Wu32 19999999.9953 Ki_Vel2TrqPrp 0.00 19999999.9953 FORMAT "%13.4" /end CHARACTERISTIC
/begin CHARACTERISTIC CrCtl_HoldGear4IKiPos_C "Integralverstärkung Ki pos. Großsignalbereich in HALTEN, 4. Gang" VALUE 0xC936C Kw_Wu32 19999999.9953 Ki_Vel2TrqPrp 0.00 19999999.9953 FORMAT "%13.4" /end CHARACTERISTIC
/begin CHARACTERISTIC CrCtl_HoldGear4IKiNeg_C "Integralverstärkung Ki neg. Großsignalbereich in HALTEN, 4. Gang" VALUE 0xC9370 Kw_Wu32 19999999.9953 Ki_Vel2TrqPrp 0.00 19999999.9953 FORMAT "%13.4" /end CHARACTERISTIC
/begin CHARACTERISTIC CrCtl_vHoldGear4IWinPos_C "obere Grenze Kleinsignalbereich I-Anteil in HALTEN, 4. Gang" VALUE 0xC9374 Kw_Ws16 300.0000 Vel 0.00 300.0000 FORMAT "%8.4" EXTENDED_LIMITS -327.6800 327.6700 /end CHARACTERISTIC
/begin CHARACTERISTIC CrCtl_vHoldGear4IWinNeg_C "untere Grenze Kleinsignalbereich I-Anteil in HALTEN, 4. Gang" VALUE 0xC9376 Kw_Ws16 300.0000 Vel -300.0000 0.00 FORMAT "%8.4" EXTENDED_LIMITS -327.6800 327.6700 /end CHARACTERISTIC
/begin CHARACTERISTIC CrCtl_HoldGear4PKp_C "Proportionalverstärkung Kp Kleinsignalbereich in HALTEN, 4 Gang" VALUE 0xC9378 Kw_Wu32 1310719.99969 Kp_Vel2TrqPrp 0.00 1310719.99969 FORMAT "%13.5" /end CHARACTERISTIC
/begin CHARACTERISTIC CrCtl_HoldGear4PKpPos_C "Proportionalverstärkung Kp pos. Großsignalbereich in HALTEN, 4. Gang" VALUE 0xC937C Kw_Wu32 1310719.99969 Kp_Vel2TrqPrp 0.00 1310719.99969 FORMAT "%13.5" /end CHARACTERISTIC
/begin CHARACTERISTIC CrCtl_HoldGear4PKpNeg_C "Proportionalverstärkung Kp neg. Großsignalbereich in HALTEN, 4. Gang" VALUE 0xC9380 Kw_Wu32 1310719.99969 Kp_Vel2TrqPrp 0.00 1310719.99969 FORMAT "%13.5" /end CHARACTERISTIC
/begin CHARACTERISTIC CrCtl_vHoldGear4PWinPos_C "obere Grenze Kleinsignalbereich P-Anteil in HALTEN, 4. Gang" VALUE 0xC9384 Kw_Ws16 300.0000 Vel 0.00 300.0000 FORMAT "%8.4" EXTENDED_LIMITS -327.6800 327.6700 /end CHARACTERISTIC
/begin CHARACTERISTIC CrCtl_vHoldGear4PWinNeg_C "untere Grenze Kleinsignalbereich P-Anteil in HALTEN, 4. Gang" VALUE 0xC9386 Kw_Ws16 300.0000 Vel -300.0000 0.00 FORMAT "%8.4" EXTENDED_LIMITS -327.6800 327.6700 /end CHARACTERISTIC
/begin CHARACTERISTIC CrCtl_HoldGear5IKi_C "Integralverstärkung Kleinsignalbereich in HALTEN, 5. Gang" VALUE 0xC9388 Kw_Wu32 19999999.9953 Ki_Vel2TrqPrp 0.00 19999999.9953 FORMAT "%13.4" /end CHARACTERISTIC
/begin CHARACTERISTIC CrCtl_HoldGear5IKiPos_C "Integralverstärkung Ki pos. Großsignalbereich in HALTEN, 5. Gang" VALUE 0xC938C Kw_Wu32 19999999.9953 Ki_Vel2TrqPrp 0.00 19999999.9953 FORMAT "%13.4" /end CHARACTERISTIC
/begin CHARACTERISTIC CrCtl_HoldGear5IKiNeg_C "Integralverstärkung Ki neg. Großsignalbereich in HALTEN, 5. Gang" VALUE 0xC9390 Kw_Wu32 19999999.9953 Ki_Vel2TrqPrp 0.00 19999999.9953 FORMAT "%13.4" /end CHARACTERISTIC
/begin CHARACTERISTIC CrCtl_vHoldGear5IWinPos_C "obere Grenze Kleinsignalbereich I-Anteil in HALTEN, 5. Gang" VALUE 0xC9394 Kw_Ws16 300.0000 Vel 0.00 300.0000 FORMAT "%8.4" EXTENDED_LIMITS -327.6800 327.6700 /end CHARACTERISTIC
/begin CHARACTERISTIC CrCtl_vHoldGear5IWinNeg_C "untere Grenze Kleinsignalbereich I-Anteil in HALTEN, 5. Gang" VALUE 0xC9396 Kw_Ws16 300.0000 Vel -300.0000 0.00 FORMAT "%8.4" EXTENDED_LIMITS -327.6800 327.6700 /end CHARACTERISTIC
/begin CHARACTERISTIC CrCtl_HoldGear5PKp_C "Proportionalverstärkung Kp Kleinsignalbereich in HALTEN, 5 Gang" VALUE 0xC9398 Kw_Wu32 1310719.99969 Kp_Vel2TrqPrp 0.00 1310719.99969 FORMAT "%13.5" /end CHARACTERISTIC
/begin CHARACTERISTIC CrCtl_HoldGear5PKpPos_C "Proportionalverstärkung Kp pos. Großsignalbereich in HALTEN, 5. Gang" VALUE 0xC939C Kw_Wu32 1310719.99969 Kp_Vel2TrqPrp 0.00 1310719.99969 FORMAT "%13.5" /end CHARACTERISTIC
/begin CHARACTERISTIC CrCtl_HoldGear5PKpNeg_C "Proportionalverstärkung Kp neg. Großsignalbereich in HALTEN, 5. Gang" VALUE 0xC93A0 Kw_Wu32 1310719.99969 Kp_Vel2TrqPrp 0.00 1310719.99969 FORMAT "%13.5" /end CHARACTERISTIC
/begin CHARACTERISTIC CrCtl_vHoldGear5PWinPos_C "obere Grenze Kleinsignalbereich P-Anteil in HALTEN, 5. Gang" VALUE 0xC93A4 Kw_Ws16 300.0000 Vel 0.00 300.0000 FORMAT "%8.4" EXTENDED_LIMITS -327.6800 327.6700 /end CHARACTERISTIC
/begin CHARACTERISTIC CrCtl_vHoldGear5PWinNeg_C "untere Grenze Kleinsignalbereich P-Anteil in HALTEN, 5. Gang" VALUE 0xC93A6 Kw_Ws16 300.0000 Vel -300.0000 0.00 FORMAT "%8.4" EXTENDED_LIMITS -327.6800 327.6700 /end CHARACTERISTIC
/begin CHARACTERISTIC CrCtl_HoldGear6IKi_C "Integralverstärkung Kleinsignalbereich in HALTEN, 6. Gang" VALUE 0xC93A8 Kw_Wu32 19999999.9953 Ki_Vel2TrqPrp 0.00 19999999.9953 FORMAT "%13.4" /end CHARACTERISTIC
/begin CHARACTERISTIC CrCtl_HoldGear6IKiPos_C "Integralverstärkung Ki neg. Großsignalbereich in HALTEN, 6. Gang" VALUE 0xC93AC Kw_Wu32 19999999.9953 Ki_Vel2TrqPrp 0.00 19999999.9953 FORMAT "%13.4" /end CHARACTERISTIC
/begin CHARACTERISTIC CrCtl_HoldGear6IKiNeg_C "Integralverstärkung Ki neg. Großsignalbereich in HALTEN, 6. Gang" VALUE 0xC93B0 Kw_Wu32 19999999.9953 Ki_Vel2TrqPrp 0.00 19999999.9953 FORMAT "%13.4" /end CHARACTERISTIC
/begin CHARACTERISTIC CrCtl_vHoldGear6IWinPos_C "obere Grenze Kleinsignalbereich I-Anteil in HALTEN, 6. Gang" VALUE 0xC93B4 Kw_Ws16 300.0000 Vel 0.00 300.0000 FORMAT "%8.4" EXTENDED_LIMITS -327.6800 327.6700 /end CHARACTERISTIC
/begin CHARACTERISTIC CrCtl_vHoldGear6IWinNeg_C "untere Grenze Kleinsignalbereich I-Anteil in HALTEN, 6. Gang" VALUE 0xC93B6 Kw_Ws16 300.0000 Vel -300.0000 0.00 FORMAT "%8.4" EXTENDED_LIMITS -327.6800 327.6700 /end CHARACTERISTIC
/begin CHARACTERISTIC CrCtl_HoldGear6PKp_C "Proportionalverstärkung Kp Kleinsignalbereich in HALTEN, 6 Gang" VALUE 0xC93B8 Kw_Wu32 1310719.99969 Kp_Vel2TrqPrp 0.00 1310719.99969 FORMAT "%13.5" /end CHARACTERISTIC
/begin CHARACTERISTIC CrCtl_HoldGear6PKpPos_C "Proportionalverstärkung Kp pos. Großsignalbereich in HALTEN, 6. Gang" VALUE 0xC93BC Kw_Wu32 1310719.99969 Kp_Vel2TrqPrp 0.00 1310719.99969 FORMAT "%13.5" /end CHARACTERISTIC
/begin CHARACTERISTIC CrCtl_HoldGear6PKpNeg_C "Proportionalverstärkung Kp neg. Großsignalbereich in HALTEN, 6. Gang" VALUE 0xC93C0 Kw_Wu32 1310719.99969 Kp_Vel2TrqPrp 0.00 1310719.99969 FORMAT "%13.5" /end CHARACTERISTIC
/begin CHARACTERISTIC CrCtl_vHoldGear6PWinPos_C "obere Grenze Kleinsignalbereich P-Anteil in HALTEN, 6. Gang" VALUE 0xC93C4 Kw_Ws16 300.0000 Vel 0.00 300.0000 FORMAT "%8.4" EXTENDED_LIMITS -327.6800 327.6700 /end CHARACTERISTIC
/begin CHARACTERISTIC CrCtl_vHoldGear6PWinNeg_C "untere Grenze Kleinsignalbereich P-Anteil in HALTEN, 6. Gang" VALUE 0xC93C6 Kw_Ws16 300.0000 Vel -300.0000 0.00 FORMAT "%8.4" EXTENDED_LIMITS -327.6800 327.6700 /end CHARACTERISTIC
/begin CHARACTERISTIC CrCtl_rAccPedVelMin_C "Minimum acc per ratio for cruise control" VALUE 0xC9518 Kw_Ws16 799.9878 Prc -400.0000 399.9878 FORMAT "%8.4" /end CHARACTERISTIC
/begin CHARACTERISTIC CrCtl_tiResAbvGear2DT1_C "DT1 Zeitkonstante T1 Endphase WA oben für 2. Gang" VALUE 0xC93C8 Kw_Wu32 4294.9673 TimeDelay_s 0.0000010000000 4294.9673 FORMAT "%9.4" /end CHARACTERISTIC
/begin CHARACTERISTIC CrCtl_ResAbvGear2DT1Kd_C "Differentialverstärkung Endphase WA oben 2. Gang" VALUE 0xC93CC Kw_Ws32 1310719.99969 Kd_Vel2TrqPrp -655360.000000 655359.999695 FORMAT "%13.6" /end CHARACTERISTIC
/begin CHARACTERISTIC CrCtl_tiResAbvGear3DT1_C "DT1 Zeitkonstante T1 Endphase WA oben für 3. Gang" VALUE 0xC93D0 Kw_Wu32 4294.9673 TimeDelay_s 0.0000010000000 4294.9673 FORMAT "%9.4" /end CHARACTERISTIC
/begin CHARACTERISTIC CrCtl_ResAbvGear3DT1Kd_C "Differentialverstärkung Endphase WA oben 3. Gang" VALUE 0xC93D4 Kw_Ws32 1310719.99969 Kd_Vel2TrqPrp -655360.000000 655359.999695 FORMAT "%13.6" /end CHARACTERISTIC
/begin CHARACTERISTIC CrCtl_tiResAbvGear4DT1_C "DT1 Zeitkonstante T1 Endphase WA oben für 4. Gang" VALUE 0xC93D8 Kw_Wu32 4294.9673 TimeDelay_s 0.0000010000000 4294.9673 FORMAT "%9.4" /end CHARACTERISTIC
/begin CHARACTERISTIC CrCtl_ResAbvGear4DT1Kd_C "Differentialverstärkung Endphase WA oben 4. Gang" VALUE 0xC93DC Kw_Ws32 1310719.99969 Kd_Vel2TrqPrp -655360.000000 655359.999695 FORMAT "%13.6" /end CHARACTERISTIC
/begin CHARACTERISTIC CrCtl_tiResAbvGear5DT1_C "DT1 Zeitkonstante T1 Endphase WA oben für 5. Gang" VALUE 0xC93E0 Kw_Wu32 4294.9673 TimeDelay_s 0.0000010000000 4294.9673 FORMAT "%9.4" /end CHARACTERISTIC
/begin CHARACTERISTIC CrCtl_ResAbvGear5DT1Kd_C "Differentialverstärkung Endphase WA oben 5. Gang" VALUE 0xC93E4 Kw_Ws32 1310719.99969 Kd_Vel2TrqPrp -655360.000000 655359.999695 FORMAT "%13.6" /end CHARACTERISTIC
/begin CHARACTERISTIC CrCtl_tiResAbvGear6DT1_C "DT1 Zeitkonstante T1 Endphase WA oben für 6. Gang" VALUE 0xC93E8 Kw_Wu32 4294.9673 TimeDelay_s 0.0000010000000 4294.9673 FORMAT "%9.4" /end CHARACTERISTIC
/begin CHARACTERISTIC CrCtl_ResAbvGear6DT1Kd_C "Differentialverstärkung Endphase WA oben 6. Gang" VALUE 0xC93EC Kw_Ws32 1310719.99969 Kd_Vel2TrqPrp -655360.000000 655359.999695 FORMAT "%13.6" /end CHARACTERISTIC
/begin CHARACTERISTIC CrCtl_ResBlwGear2IKi_C "PI-Reglerparametersatz für WA+ 2.Gang" VALUE 0xC93F0 Kw_Wu32 19999999.9953 Ki_Vel2TrqPrp 0.00 19999999.9953 FORMAT "%13.4" /end CHARACTERISTIC
/begin CHARACTERISTIC CrCtl_ResBlwGear2IKiPos_C "PI-Reglerparametersatz für WA+ 2.Gang" VALUE 0xC93F4 Kw_Wu32 19999999.9953 Ki_Vel2TrqPrp 0.00 19999999.9953 FORMAT "%13.4" /end CHARACTERISTIC
/begin CHARACTERISTIC CrCtl_ResBlwGear2IKiNeg_C "PI-Reglerparametersatz für WA+ 2.Gang" VALUE 0xC93F8 Kw_Wu32 19999999.9953 Ki_Vel2TrqPrp 0.00 19999999.9953 FORMAT "%13.4" /end CHARACTERISTIC
/begin CHARACTERISTIC CrCtl_vResBlwGear2IWinPos_C "PI-Reglerparametersatz für WA+ 2.Gang" VALUE 0xC93FC Kw_Ws16 300.0000 Vel 0.00 300.0000 FORMAT "%8.4" EXTENDED_LIMITS -327.6800 327.6700 /end CHARACTERISTIC
/begin CHARACTERISTIC CrCtl_vResBlwGear2IWinNeg_C "PI-Reglerparametersatz für WA+ 2.Gang" VALUE 0xC93FE Kw_Ws16 300.0000 Vel -300.0000 0.00 FORMAT "%8.4" EXTENDED_LIMITS -327.6800 327.6700 /end CHARACTERISTIC
/begin CHARACTERISTIC CrCtl_ResBlwGear2PKp_C "PI-Reglerparametersatz für WA+ 2.Gang" VALUE 0xC9400 Kw_Wu32 1310719.99969 Kp_Vel2TrqPrp 0.00 1310719.99969 FORMAT "%13.5" /end CHARACTERISTIC
/begin CHARACTERISTIC CrCtl_ResBlwGear2PKpPos_C "PI-Reglerparametersatz für WA+ 2.Gang" VALUE 0xC9404 Kw_Wu32 1310719.99969 Kp_Vel2TrqPrp 0.00 1310719.99969 FORMAT "%13.5" /end CHARACTERISTIC
/begin CHARACTERISTIC CrCtl_ResBlwGear2PKpNeg_C "PI-Reglerparametersatz für WA+ 2.Gang" VALUE 0xC9408 Kw_Wu32 1310719.99969 Kp_Vel2TrqPrp 0.00 1310719.99969 FORMAT "%13.5" /end CHARACTERISTIC
/begin CHARACTERISTIC CrCtl_vResBlwGear2PWinPos_C "PI-Reglerparametersatz für WA+ 2.Gang" VALUE 0xC940C Kw_Ws16 300.0000 Vel 0.00 300.0000 FORMAT "%8.4" EXTENDED_LIMITS -327.6800 327.6700 /end CHARACTERISTIC
/begin CHARACTERISTIC CrCtl_vResBlwGear2PWinNeg_C "PI-Reglerparametersatz für WA+ 2.Gang" VALUE 0xC940E Kw_Ws16 300.0000 Vel -300.0000 0.00 FORMAT "%8.4" EXTENDED_LIMITS -327.6800 327.6700 /end CHARACTERISTIC
/begin CHARACTERISTIC CrCtl_ResBlwGear3IKi_C "PI-Reglerparametersatz für WA+ 3.Gang" VALUE 0xC9410 Kw_Wu32 19999999.9953 Ki_Vel2TrqPrp 0.00 19999999.9953 FORMAT "%13.4" /end CHARACTERISTIC
/begin CHARACTERISTIC CrCtl_ResBlwGear3IKiPos_C "PI-Reglerparametersatz für WA+ 3.Gang" VALUE 0xC9414 Kw_Wu32 19999999.9953 Ki_Vel2TrqPrp 0.00 19999999.9953 FORMAT "%13.4" /end CHARACTERISTIC
/begin CHARACTERISTIC CrCtl_ResBlwGear3IKiNeg_C "PI-Reglerparametersatz für WA+ 3.Gang" VALUE 0xC9418 Kw_Wu32 19999999.9953 Ki_Vel2TrqPrp 0.00 19999999.9953 FORMAT "%13.4" /end CHARACTERISTIC
/begin CHARACTERISTIC CrCtl_vResBlwGear3IWinPos_C "PI-Reglerparametersatz für WA+ 3.Gang" VALUE 0xC941C Kw_Ws16 300.0000 Vel 0.00 300.0000 FORMAT "%8.4" EXTENDED_LIMITS -327.6800 327.6700 /end CHARACTERISTIC
/begin CHARACTERISTIC CrCtl_vResBlwGear3IWinNeg_C "PI-Reglerparametersatz für WA+ 3.Gang" VALUE 0xC941E Kw_Ws16 300.0000 Vel -300.0000 0.00 FORMAT "%8.4" EXTENDED_LIMITS -327.6800 327.6700 /end CHARACTERISTIC
/begin CHARACTERISTIC CrCtl_ResBlwGear3PKp_C "PI-Reglerparametersatz für WA+ 3.Gang" VALUE 0xC9420 Kw_Wu32 1310719.99969 Kp_Vel2TrqPrp 0.00 1310719.99969 FORMAT "%13.5" /end CHARACTERISTIC
/begin CHARACTERISTIC CrCtl_ResBlwGear3PKpPos_C "PI-Reglerparametersatz für WA+ 3.Gang" VALUE 0xC9424 Kw_Wu32 1310719.99969 Kp_Vel2TrqPrp 0.00 1310719.99969 FORMAT "%13.5" /end CHARACTERISTIC
/begin CHARACTERISTIC CrCtl_ResBlwGear3PKpNeg_C "PI-Reglerparametersatz für WA+ 3.Gang" VALUE 0xC9428 Kw_Wu32 1310719.99969 Kp_Vel2TrqPrp 0.00 1310719.99969 FORMAT "%13.5" /end CHARACTERISTIC
/begin CHARACTERISTIC CrCtl_vResBlwGear3PWinPos_C "PI-Reglerparametersatz für WA+ 3.Gang" VALUE 0xC942C Kw_Ws16 300.0000 Vel 0.00 300.0000 FORMAT "%8.4" EXTENDED_LIMITS -327.6800 327.6700 /end CHARACTERISTIC
/begin CHARACTERISTIC CrCtl_vResBlwGear3PWinNeg_C "PI-Reglerparametersatz für WA+ 3.Gang" VALUE 0xC942E Kw_Ws16 300.0000 Vel -300.0000 0.00 FORMAT "%8.4" EXTENDED_LIMITS -327.6800 327.6700 /end CHARACTERISTIC
/begin CHARACTERISTIC CrCtl_ResBlwGear4IKi_C "PI-Reglerparametersatz für WA+ 4.Gang" VALUE 0xC9430 Kw_Wu32 19999999.9953 Ki_Vel2TrqPrp 0.00 19999999.9953 FORMAT "%13.4" /end CHARACTERISTIC
/begin CHARACTERISTIC CrCtl_ResBlwGear4IKiPos_C "PI-Reglerparametersatz für WA+ 4.Gang" VALUE 0xC9434 Kw_Wu32 19999999.9953 Ki_Vel2TrqPrp 0.00 19999999.9953 FORMAT "%13.4" /end CHARACTERISTIC
/begin CHARACTERISTIC CrCtl_ResBlwGear4IKiNeg_C "PI-Reglerparametersatz für WA+ 4.Gang" VALUE 0xC9438 Kw_Wu32 19999999.9953 Ki_Vel2TrqPrp 0.00 19999999.9953 FORMAT "%13.4" /end CHARACTERISTIC
/begin CHARACTERISTIC CrCtl_vResBlwGear4IWinPos_C "PI-Reglerparametersatz für WA+ 4.Gang" VALUE 0xC943C Kw_Ws16 300.0000 Vel 0.00 300.0000 FORMAT "%8.4" EXTENDED_LIMITS -327.6800 327.6700 /end CHARACTERISTIC
/begin CHARACTERISTIC CrCtl_vResBlwGear4IWinNeg_C "PI-Reglerparametersatz für WA+ 4.Gang" VALUE 0xC943E Kw_Ws16 300.0000 Vel -300.0000 0.00 FORMAT "%8.4" EXTENDED_LIMITS -327.6800 327.6700 /end CHARACTERISTIC
/begin CHARACTERISTIC CrCtl_ResBlwGear4PKp_C "PI-Reglerparametersatz für WA+ 4.Gang" VALUE 0xC9440 Kw_Wu32 1310719.99969 Kp_Vel2TrqPrp 0.00 1310719.99969 FORMAT "%13.5" /end CHARACTERISTIC
/begin CHARACTERISTIC CrCtl_ResBlwGear4PKpPos_C "PI-Reglerparametersatz für WA+ 4.Gang" VALUE 0xC9444 Kw_Wu32 1310719.99969 Kp_Vel2TrqPrp 0.00 1310719.99969 FORMAT "%13.5" /end CHARACTERISTIC
/begin CHARACTERISTIC CrCtl_ResBlwGear4PKpNeg_C "PI-Reglerparametersatz für WA+ 4.Gang" VALUE 0xC9448 Kw_Wu32 1310719.99969 Kp_Vel2TrqPrp 0.00 1310719.99969 FORMAT "%13.5" /end CHARACTERISTIC
/begin CHARACTERISTIC CrCtl_vResBlwGear4PWinPos_C "PI-Reglerparametersatz für WA+ 4.Gang" VALUE 0xC944C Kw_Ws16 300.0000 Vel 0.00 300.0000 FORMAT "%8.4" EXTENDED_LIMITS -327.6800 327.6700 /end CHARACTERISTIC
/begin CHARACTERISTIC CrCtl_vResBlwGear4PWinNeg_C "PI-Reglerparametersatz für WA+ 4.Gang" VALUE 0xC944E Kw_Ws16 300.0000 Vel -300.0000 0.00 FORMAT "%8.4" EXTENDED_LIMITS -327.6800 327.6700 /end CHARACTERISTIC
/begin CHARACTERISTIC CrCtl_ResBlwGear5IKi_C "PI-Reglerparametersatz für WA+ 5.Gang" VALUE 0xC9450 Kw_Wu32 19999999.9953 Ki_Vel2TrqPrp 0.00 19999999.9953 FORMAT "%13.4" /end CHARACTERISTIC
/begin CHARACTERISTIC CrCtl_ResBlwGear5IKiPos_C "PI-Reglerparametersatz für WA+ 5.Gang" VALUE 0xC9454 Kw_Wu32 19999999.9953 Ki_Vel2TrqPrp 0.00 19999999.9953 FORMAT "%13.4" /end CHARACTERISTIC
/begin CHARACTERISTIC CrCtl_ResBlwGear5IKiNeg_C "PI-Reglerparametersatz für WA+ 5.Gang" VALUE 0xC9458 Kw_Wu32 19999999.9953 Ki_Vel2TrqPrp 0.00 19999999.9953 FORMAT "%13.4" /end CHARACTERISTIC
/begin CHARACTERISTIC CrCtl_vResBlwGear5IWinPos_C "PI-Reglerparametersatz für WA+ 5.Gang" VALUE 0xC945C Kw_Ws16 300.0000 Vel 0.00 300.0000 FORMAT "%8.4" EXTENDED_LIMITS -327.6800 327.6700 /end CHARACTERISTIC
/begin CHARACTERISTIC CrCtl_vResBlwGear5IWinNeg_C "PI-Reglerparametersatz für WA+ 5.Gang" VALUE 0xC945E Kw_Ws16 300.0000 Vel -300.0000 0.00 FORMAT "%8.4" EXTENDED_LIMITS -327.6800 327.6700 /end CHARACTERISTIC
/begin CHARACTERISTIC CrCtl_ResBlwGear5PKp_C "PI-Reglerparametersatz für WA+ 5.Gang" VALUE 0xC9460 Kw_Wu32 1310719.99969 Kp_Vel2TrqPrp 0.00 1310719.99969 FORMAT "%13.5" /end CHARACTERISTIC
/begin CHARACTERISTIC CrCtl_ResBlwGear5PKpPos_C "PI-Reglerparametersatz für WA+ 5.Gang" VALUE 0xC9464 Kw_Wu32 1310719.99969 Kp_Vel2TrqPrp 0.00 1310719.99969 FORMAT "%13.5" /end CHARACTERISTIC
/begin CHARACTERISTIC CrCtl_ResBlwGear5PKpNeg_C "PI-Reglerparametersatz für WA+ 5.Gang" VALUE 0xC9468 Kw_Wu32 1310719.99969 Kp_Vel2TrqPrp 0.00 1310719.99969 FORMAT "%13.5" /end CHARACTERISTIC
/begin CHARACTERISTIC CrCtl_vResBlwGear5PWinPos_C "PI-Reglerparametersatz für WA+ 5.Gang" VALUE 0xC946C Kw_Ws16 300.0000 Vel 0.00 300.0000 FORMAT "%8.4" EXTENDED_LIMITS -327.6800 327.6700 /end CHARACTERISTIC
/begin CHARACTERISTIC CrCtl_vResBlwGear5PWinNeg_C "PI-Reglerparametersatz für WA+ 5.Gang" VALUE 0xC946E Kw_Ws16 300.0000 Vel -300.0000 0.00 FORMAT "%8.4" EXTENDED_LIMITS -327.6800 327.6700 /end CHARACTERISTIC
/begin CHARACTERISTIC CrCtl_ResBlwGear6IKi_C "PI-Reglerparametersatz für WA+ 6.Gang" VALUE 0xC9470 Kw_Wu32 19999999.9953 Ki_Vel2TrqPrp 0.00 19999999.9953 FORMAT "%13.4" /end CHARACTERISTIC
/begin CHARACTERISTIC CrCtl_ResBlwGear6IKiPos_C "PI-Reglerparametersatz für WA+ 6.Gang" VALUE 0xC9474 Kw_Wu32 19999999.9953 Ki_Vel2TrqPrp 0.00 19999999.9953 FORMAT "%13.4" /end CHARACTERISTIC
/begin CHARACTERISTIC CrCtl_ResBlwGear6IKiNeg_C "PI-Reglerparametersatz für WA+ 6.Gang" VALUE 0xC9478 Kw_Wu32 19999999.9953 Ki_Vel2TrqPrp 0.00 19999999.9953 FORMAT "%13.4" /end CHARACTERISTIC
/begin CHARACTERISTIC CrCtl_vResBlwGear6IWinPos_C "PI-Reglerparametersatz für WA+ 6.Gang" VALUE 0xC947C Kw_Ws16 300.0000 Vel 0.00 300.0000 FORMAT "%8.4" EXTENDED_LIMITS -327.6800 327.6700 /end CHARACTERISTIC
/begin CHARACTERISTIC CrCtl_vResBlwGear6IWinNeg_C "PI-Reglerparametersatz für WA+ 6.Gang" VALUE 0xC947E Kw_Ws16 300.0000 Vel -300.0000 0.00 FORMAT "%8.4" EXTENDED_LIMITS -327.6800 327.6700 /end CHARACTERISTIC
/begin CHARACTERISTIC CrCtl_ResBlwGear6PKp_C "PI-Reglerparametersatz für WA+ 6.Gang" VALUE 0xC9480 Kw_Wu32 1310719.99969 Kp_Vel2TrqPrp 0.00 1310719.99969 FORMAT "%13.5" /end CHARACTERISTIC
/begin CHARACTERISTIC CrCtl_ResBlwGear6PKpPos_C "PI-Reglerparametersatz für WA+ 6.Gang" VALUE 0xC9484 Kw_Wu32 1310719.99969 Kp_Vel2TrqPrp 0.00 1310719.99969 FORMAT "%13.5" /end CHARACTERISTIC
/begin CHARACTERISTIC CrCtl_ResBlwGear6PKpNeg_C "PI-Reglerparametersatz für WA+ 6.Gang" VALUE 0xC9488 Kw_Wu32 1310719.99969 Kp_Vel2TrqPrp 0.00 1310719.99969 FORMAT "%13.5" /end CHARACTERISTIC
/begin CHARACTERISTIC CrCtl_vResBlwGear6PWinPos_C "PI-Reglerparametersatz für WA+ 6.Gang" VALUE 0xC948C Kw_Ws16 300.0000 Vel 0.00 300.0000 FORMAT "%8.4" EXTENDED_LIMITS -327.6800 327.6700 /end CHARACTERISTIC
/begin CHARACTERISTIC CrCtl_vResBlwGear6PWinNeg_C "PI-Reglerparametersatz für WA+ 6.Gang" VALUE 0xC948E Kw_Ws16 300.0000 Vel -300.0000 0.00 FORMAT "%8.4" EXTENDED_LIMITS -327.6800 327.6700 /end CHARACTERISTIC
/begin CHARACTERISTIC CrCtl_ResRmpGear2PKp_C "P-Reglerparametersatz für WA 2.Gang" VALUE 0xC9490 Kw_Wu32 1310719.99969 Kp_Vel2TrqPrp 0.00 1310719.99969 FORMAT "%13.5" /end CHARACTERISTIC
/begin CHARACTERISTIC CrCtl_ResRmpGear2PKpPos_C "P-Reglerparametersatz für WA 2.Gang" VALUE 0xC9494 Kw_Wu32 1310719.99969 Kp_Vel2TrqPrp 0.00 1310719.99969 FORMAT "%13.5" /end CHARACTERISTIC
/begin CHARACTERISTIC CrCtl_ResRmpGear2PKpNeg_C "P-Reglerparametersatz für WA 2.Gang" VALUE 0xC9498 Kw_Wu32 1310719.99969 Kp_Vel2TrqPrp 0.00 1310719.99969 FORMAT "%13.5" /end CHARACTERISTIC
/begin CHARACTERISTIC CrCtl_vResRmpGear2PWinPos_C "P-Reglerparametersatz für WA 2.Gang" VALUE 0xC949C Kw_Ws16 300.0000 Vel 0.00 300.0000 FORMAT "%8.4" EXTENDED_LIMITS -327.6800 327.6700 /end CHARACTERISTIC
/begin CHARACTERISTIC CrCtl_vResRmpGear2PWinNeg_C "P-Reglerparametersatz für WA 2.Gang" VALUE 0xC949E Kw_Ws16 300.0000 Vel -300.0000 0.00 FORMAT "%8.4" EXTENDED_LIMITS -327.6800 327.6700 /end CHARACTERISTIC
/begin CHARACTERISTIC CrCtl_ResRmpGear3PKp_C "P-Reglerparametersatz für WA 3.Gang" VALUE 0xC94A0 Kw_Wu32 1310719.99969 Kp_Vel2TrqPrp 0.00 1310719.99969 FORMAT "%13.5" /end CHARACTERISTIC
/begin CHARACTERISTIC CrCtl_ResRmpGear3PKpPos_C "P-Reglerparametersatz für WA 3.Gang" VALUE 0xC94A4 Kw_Wu32 1310719.99969 Kp_Vel2TrqPrp 0.00 1310719.99969 FORMAT "%13.5" /end CHARACTERISTIC
/begin CHARACTERISTIC CrCtl_ResRmpGear3PKpNeg_C "P-Reglerparametersatz für WA 3.Gang" VALUE 0xC94A8 Kw_Wu32 1310719.99969 Kp_Vel2TrqPrp 0.00 1310719.99969 FORMAT "%13.5" /end CHARACTERISTIC
/begin CHARACTERISTIC CrCtl_vResRmpGear3PWinPos_C "P-Reglerparametersatz für WA 3.Gang" VALUE 0xC94AC Kw_Ws16 300.0000 Vel 0.00 300.0000 FORMAT "%8.4" EXTENDED_LIMITS -327.6800 327.6700 /end CHARACTERISTIC
/begin CHARACTERISTIC CrCtl_vResRmpGear3PWinNeg_C "P-Reglerparametersatz für WA 3.Gang" VALUE 0xC94AE Kw_Ws16 300.0000 Vel -300.0000 0.00 FORMAT "%8.4" EXTENDED_LIMITS -327.6800 327.6700 /end CHARACTERISTIC
/begin CHARACTERISTIC CrCtl_ResRmpGear4PKp_C "P-Reglerparametersatz für WA 4.Gang" VALUE 0xC94B0 Kw_Wu32 1310719.99969 Kp_Vel2TrqPrp 0.00 1310719.99969 FORMAT "%13.5" /end CHARACTERISTIC
/begin CHARACTERISTIC CrCtl_ResRmpGear4PKpPos_C "P-Reglerparametersatz für WA 4.Gang" VALUE 0xC94B4 Kw_Wu32 1310719.99969 Kp_Vel2TrqPrp 0.00 1310719.99969 FORMAT "%13.5" /end CHARACTERISTIC
/begin CHARACTERISTIC CrCtl_ResRmpGear4PKpNeg_C "P-Reglerparametersatz für WA 4.Gang" VALUE 0xC94B8 Kw_Wu32 1310719.99969 Kp_Vel2TrqPrp 0.00 1310719.99969 FORMAT "%13.5" /end CHARACTERISTIC
/begin CHARACTERISTIC CrCtl_vResRmpGear4PWinPos_C "P-Reglerparametersatz für WA 4.Gang" VALUE 0xC94BC Kw_Ws16 300.0000 Vel 0.00 300.0000 FORMAT "%8.4" EXTENDED_LIMITS -327.6800 327.6700 /end CHARACTERISTIC
/begin CHARACTERISTIC CrCtl_vResRmpGear4PWinNeg_C "P-Reglerparametersatz für WA 4.Gang" VALUE 0xC94BE Kw_Ws16 300.0000 Vel -300.0000 0.00 FORMAT "%8.4" EXTENDED_LIMITS -327.6800 327.6700 /end CHARACTERISTIC
/begin CHARACTERISTIC CrCtl_ResRmpGear5PKp_C "P-Reglerparametersatz für WA 5.Gang" VALUE 0xC94C0 Kw_Wu32 1310719.99969 Kp_Vel2TrqPrp 0.00 1310719.99969 FORMAT "%13.5" /end CHARACTERISTIC
/begin CHARACTERISTIC CrCtl_ResRmpGear5PKpPos_C "P-Reglerparametersatz für WA 5.Gang" VALUE 0xC94C4 Kw_Wu32 1310719.99969 Kp_Vel2TrqPrp 0.00 1310719.99969 FORMAT "%13.5" /end CHARACTERISTIC
/begin CHARACTERISTIC CrCtl_ResRmpGear5PKpNeg_C "P-Reglerparametersatz für WA 5.Gang" VALUE 0xC94C8 Kw_Wu32 1310719.99969 Kp_Vel2TrqPrp 0.00 1310719.99969 FORMAT "%13.5" /end CHARACTERISTIC
/begin CHARACTERISTIC CrCtl_vResRmpGear5PWinPos_C "P-Reglerparametersatz für WA 5.Gang" VALUE 0xC94CC Kw_Ws16 300.0000 Vel 0.00 300.0000 FORMAT "%8.4" EXTENDED_LIMITS -327.6800 327.6700 /end CHARACTERISTIC
/begin CHARACTERISTIC CrCtl_vResRmpGear5PWinNeg_C "P-Reglerparametersatz für WA 5.Gang" VALUE 0xC94CE Kw_Ws16 300.0000 Vel -300.0000 0.00 FORMAT "%8.4" EXTENDED_LIMITS -327.6800 327.6700 /end CHARACTERISTIC
/begin CHARACTERISTIC CrCtl_ResRmpGear6PKp_C "P-Reglerparametersatz für WA 6.Gang" VALUE 0xC94D0 Kw_Wu32 1310719.99969 Kp_Vel2TrqPrp 0.00 1310719.99969 FORMAT "%13.5" /end CHARACTERISTIC
/begin CHARACTERISTIC CrCtl_ResRmpGear6PKpPos_C "P-Reglerparametersatz für WA 6.Gang" VALUE 0xC94D4 Kw_Wu32 1310719.99969 Kp_Vel2TrqPrp 0.00 1310719.99969 FORMAT "%13.5" /end CHARACTERISTIC
/begin CHARACTERISTIC CrCtl_ResRmpGear6PKpNeg_C "P-Reglerparametersatz für WA 6.Gang" VALUE 0xC94D8 Kw_Wu32 1310719.99969 Kp_Vel2TrqPrp 0.00 1310719.99969 FORMAT "%13.5" /end CHARACTERISTIC
/begin CHARACTERISTIC CrCtl_vResRmpGear6PWinPos_C "P-Reglerparametersatz für WA 6.Gang" VALUE 0xC94DC Kw_Ws16 300.0000 Vel 0.00 300.0000 FORMAT "%8.4" EXTENDED_LIMITS -327.6800 327.6700 /end CHARACTERISTIC
/begin CHARACTERISTIC CrCtl_vResRmpGear6PWinNeg_C "P-Reglerparametersatz für WA 6.Gang" VALUE 0xC94DE Kw_Ws16 300.0000 Vel -300.0000 0.00 FORMAT "%8.4" EXTENDED_LIMITS -327.6800 327.6700 /end CHARACTERISTIC
/begin CHARACTERISTIC CrCtl_swtCrCtlType_C "Schalter um Typ des Tempomats auszuwählen (1: herkömmlicher Tempomat, 2: Stufentempomat)" VALUE 0xC951A Kw_Wu8 255.0 OneToOne 0.00 255.0 FORMAT "%5.1" /end CHARACTERISTIC
/begin CHARACTERISTIC CrCtl_swtOffset_C "Umschaltung zwischen gesendeter und berechneter Anzeigegeschwindigkeit (1: berechnete, 0: gesendete)" VALUE 0xC951B Kw_Wu8 255.0 OneToOne 0.00 255.0 FORMAT "%5.1" /end CHARACTERISTIC
/begin CHARACTERISTIC CrCtl_swtResOff_C "0...keine Wiederaufnahme im Stufentemp. Zustand OFF; 1...Wiederaufnahme im Stufentempomat-Zustand OFF erlaubt" VALUE 0xC94E0 Kw_Wu8 255.0 OneToOne 0.00 255.0 FORMAT "%5.1" /end CHARACTERISTIC
/begin CHARACTERISTIC CrCtl_swtVSSFil_C "Schalter zur Auswahl zwischen gefilterter und ungefilterter Fahrzeug-Ist-Geschwindigkeit (1: gefiltert 0: ungefiltert)" VALUE 0xC951C Kw_Wu8 255.0 OneToOne 0.00 255.0 FORMAT "%5.1" /end CHARACTERISTIC
/begin CHARACTERISTIC CrCtl_tiDisableDiagVCrCtl_C "Time to disable cruise control diagnostics" VALUE 0xC9520 Kw_Wu32 42949672950.0 Time_ms 0.00 42949672950.0 FORMAT "%13.1" /end CHARACTERISTIC
/begin CHARACTERISTIC CrCtl_tiDispOffFil_C "time delay for tracking speed set point" VALUE 0xC9524 Kw_Wu32 4294.9673 TimeDelay_s 0.0000010000000 4294.9673 FORMAT "%9.4" /end CHARACTERISTIC
/begin CHARACTERISTIC CrCtl_tiOff_C "Dauer zum niederrampen zum gewünschten Drehmoment" VALUE 0xC94E2 Kw_Wu16 655350.0 TimeDeb 0.00 655350.0 FORMAT "%8.1" /end CHARACTERISTIC
/begin CHARACTERISTIC CrCtl_tiTipUpDn_C "Erkennungszeit TIP-UP/DOWN" VALUE 0xC94E4 Kw_Wu16 655350.0 Time_ms 0.00 655350.0 FORMAT "%8.1" /end CHARACTERISTIC
/begin CHARACTERISTIC CrCtl_tiVSSFil_C "time delay for tracking speed set point" VALUE 0xC9528 Kw_Wu32 4294.9673 TimeDelay_s 0.0000010000000 4294.9673 FORMAT "%9.4" /end CHARACTERISTIC
/begin CHARACTERISTIC CrCtl_trqDesThres_C "Momentenschwelle zur Entscheidung der Momentenrampensteigung zur Momentenreduzierung nach SET+" VALUE 0xC94E6 Kw_Ws16 500.0000 TrqPrp 0.00 500.0000 FORMAT "%8.4" EXTENDED_LIMITS -6553.600 6553.400 /end CHARACTERISTIC
/begin CHARACTERISTIC CrCtl_trqDes_Vector "#SSD Bypass label, nicht editieren!" VALUE 0xC30DA Kw_Wu8 255.0 OneToOne 0.00 255.0 FORMAT "%5.1" /end CHARACTERISTIC
/begin CHARACTERISTIC CrCtl_trqDes_Channel "#SSD Bypass label, nicht editieren!" VALUE 0xC30DB Kw_Wu8 255.0 OneToOne 0.00 255.0 FORMAT "%5.1" /end CHARACTERISTIC
/begin CHARACTERISTIC CrCtl_trqLead_Vector "#SSD Bypass label, nicht editieren!" VALUE 0xC30DC Kw_Wu8 255.0 OneToOne 0.00 255.0 FORMAT "%5.1" /end CHARACTERISTIC
/begin CHARACTERISTIC CrCtl_trqLead_Channel "#SSD Bypass label, nicht editieren!" VALUE 0xC30DD Kw_Wu8 255.0 OneToOne 0.00 255.0 FORMAT "%5.1" /end CHARACTERISTIC
/begin CHARACTERISTIC CrCtl_trqMaxOfs_C "Offset auf maximales Moment CoDT_trqMax" VALUE 0xC94E8 Kw_Ws16 500.0000 TrqPrp 0.00 500.0000 FORMAT "%8.4" EXTENDED_LIMITS -6553.600 6553.400 /end CHARACTERISTIC
/begin CHARACTERISTIC CrCtl_trqOffComf_C "Momentenschwelle für Umschaltung der Rampensteigung bei Komfortabschaltung" VALUE 0xC94EA Kw_Ws16 11000.00 TrqPrp -5000.000 6000.000 FORMAT "%8.3" EXTENDED_LIMITS -6553.600 6553.400 /end CHARACTERISTIC
/begin CHARACTERISTIC CrCtl_trqOffFast12_C "Umschaltschwelle von Rampe 1 auf Rampe 2" VALUE 0xC94EC Kw_Ws16 11000.00 TrqPrp -5000.000 6000.000 FORMAT "%8.3" EXTENDED_LIMITS -6553.600 6553.400 /end CHARACTERISTIC
/begin CHARACTERISTIC CrCtl_trqOffFast23_C "Umschaltschwelle von Rampe 2 auf Rampe 3" VALUE 0xC94EE Kw_Ws16 11000.00 TrqPrp -5000.000 6000.000 FORMAT "%8.3" EXTENDED_LIMITS -6553.600 6553.400 /end CHARACTERISTIC
/begin CHARACTERISTIC CrCtl_uBattMin_C "min batteriespannung" VALUE 0xC952C Kw_Ws16 1281232. Volt_Batt -640625.6 640606.1 FORMAT "%8.1" /end CHARACTERISTIC
/begin CHARACTERISTIC CrCtl_vAccSet_C "Setzwertkorrektur nach SET+" VALUE 0xC94F0 Kw_Ws16 300.0000 Vel 0.00 300.0000 FORMAT "%8.4" EXTENDED_LIMITS -327.6800 327.6700 /end CHARACTERISTIC
/begin CHARACTERISTIC CrCtl_vAlwDvtThres_C "zulässige Regelabweichung für TIP-UP/DOWN FGR" VALUE 0xC94F2 Kw_Ws16 300.0000 Vel 0.00 300.0000 FORMAT "%8.4" EXTENDED_LIMITS -327.6800 327.6700 /end CHARACTERISTIC
/begin CHARACTERISTIC CrCtl_vAlwMaxKm_C "maximal erlaubte FGR-geschw." VALUE 0xC952E Kw_Ws16 300.0000 Vel 0.00 300.0000 FORMAT "%8.4" EXTENDED_LIMITS -327.6800 327.6700 /end CHARACTERISTIC
/begin CHARACTERISTIC CrCtl_vAlwMaxM_C "max erlaubte FGR-geschwindigkeit" VALUE 0xC9530 Kw_Ws16 300.0000 Vel_mph 0.00 300.0000 FORMAT "%8.4" EXTENDED_LIMITS -327.6800 327.6700 /end CHARACTERISTIC
/begin CHARACTERISTIC CrCtl_vAlwMinKm_C "min. erlaubte FGR-geschwindigkeit" VALUE 0xC9532 Kw_Ws16 300.0000 Vel 0.00 300.0000 FORMAT "%8.4" EXTENDED_LIMITS -327.6800 327.6700 /end CHARACTERISTIC
/begin CHARACTERISTIC CrCtl_vAlwMinM_C "min. erlaubte FGR-geschwindigkeit" VALUE 0xC9534 Kw_Ws16 300.0000 Vel_mph 0.00 300.0000 FORMAT "%8.4" EXTENDED_LIMITS -327.6800 327.6700 /end CHARACTERISTIC
/begin CHARACTERISTIC CrCtl_vDeclSet_C "Setzwertkorrektur nach SET-" VALUE 0xC94F4 Kw_Ws16 300.0000 Vel 0.00 300.0000 FORMAT "%8.4" EXTENDED_LIMITS -327.6800 327.6700 /end CHARACTERISTIC
/begin CHARACTERISTIC CrCtl_vDiffAccMax_C "Geschwindigkeitsschwelle für Setzwertkorrektur nach SET+" VALUE 0xC94F6 Kw_Ws16 300.0000 Vel 0.00 300.0000 FORMAT "%8.4" EXTENDED_LIMITS -327.6800 327.6700 /end CHARACTERISTIC
/begin CHARACTERISTIC CrCtl_vDiffAcc_C "Geschwindigkeitsoffset für doppelte Momentenrampensteigung bei Übergang EIN+ zu HALTEN des FGR" VALUE 0xC94F8 Kw_Ws16 300.0000 Vel 0.00 300.0000 FORMAT "%8.4" EXTENDED_LIMITS -327.6800 327.6700 /end CHARACTERISTIC
/begin CHARACTERISTIC CrCtl_vDiffDeclMax_C "Geschwindigkeitsschwelle für Setzwertkorrektur nach SET-" VALUE 0xC94FA Kw_Ws16 300.0000 Vel 0.00 300.0000 FORMAT "%8.4" EXTENDED_LIMITS -327.6800 327.6700 /end CHARACTERISTIC
/begin CHARACTERISTIC CrCtl_vDiffDecl_C "Geschwindigkeitsoffset für doppelte Momentenrampensteigung bei Übergang EIN- zu HALTEN des FGR" VALUE 0xC94FC Kw_Ws16 300.0000 Vel 0.00 300.0000 FORMAT "%8.4" EXTENDED_LIMITS -327.6800 327.6700 /end CHARACTERISTIC
/begin CHARACTERISTIC CrCtl_vDiffResAbv_C "Schwelle Differenz Ist- und Sollgeschwindigkeit für Reduzierung Zielgeschwindigkeitsrampe bei WA von oben" VALUE 0xC94FE Kw_Ws16 300.0000 Vel 0.00 300.0000 FORMAT "%8.4" EXTENDED_LIMITS -327.6800 327.6700 /end CHARACTERISTIC
/begin CHARACTERISTIC CrCtl_vDiffResBlw_C "Schwelle Differenz Ist- und Sollgeschwindigkeit für Reduzierung Zielgeschwindigkeitsrampe bei WA von unten" VALUE 0xC9500 Kw_Ws16 300.0000 Vel 0.00 300.0000 FORMAT "%8.4" EXTENDED_LIMITS -327.6800 327.6700 /end CHARACTERISTIC
/begin CHARACTERISTIC CrCtl_vDvtNegTipDwn_C "FGR: zulässige negative Regelabweichung TIP-DWN" VALUE 0xC9502 Kw_Ws16 300.0000 Vel 0.00 300.0000 FORMAT "%8.4" EXTENDED_LIMITS -327.6800 327.6700 /end CHARACTERISTIC
/begin CHARACTERISTIC CrCtl_vDvtNegTipUp_C "FGR: zulässige negative Regelabweichung TIP-UP" VALUE 0xC9504 Kw_Ws16 300.0000 Vel 0.00 300.0000 FORMAT "%8.4" EXTENDED_LIMITS -327.6800 327.6700 /end CHARACTERISTIC
/begin CHARACTERISTIC CrCtl_vDvtPosTipDwn_C "FGR: zulässige positive Regelabweichung TIP-DWN" VALUE 0xC9506 Kw_Ws16 300.0000 Vel 0.00 300.0000 FORMAT "%8.4" EXTENDED_LIMITS -327.6800 327.6700 /end CHARACTERISTIC
/begin CHARACTERISTIC CrCtl_vOffMax_C "Maximum velocity of cruise control" VALUE 0xC9536 Kw_Ws16 300.0000 Vel 0.00 300.0000 FORMAT "%8.4" EXTENDED_LIMITS -327.6800 327.6700 /end CHARACTERISTIC
/begin CHARACTERISTIC CrCtl_vOfsDecl_C "neg. Offset für Sollgeschwindigkeit für Übergang EIN- zu HALTEN des FGR" VALUE 0xC9508 Kw_Ws16 300.0000 Vel 0.00 300.0000 FORMAT "%8.4" EXTENDED_LIMITS -327.6800 327.6700 /end CHARACTERISTIC
/begin CHARACTERISTIC CrCtl_vOfsResBlw_C "Geschwindigkeitsoffset für Übergang WA+ --> Konstantfahrt" VALUE 0xC950A Kw_Ws16 300.0000 Vel 0.00 300.0000 FORMAT "%8.4" EXTENDED_LIMITS -327.6800 327.6700 /end CHARACTERISTIC
/begin CHARACTERISTIC CrCtl_vOfsRes_C "Offset FGR-Sollgeschwindigkeit für Übergang WA zu HALTEN" VALUE 0xC950C Kw_Ws16 300.0000 Vel 0.00 300.0000 FORMAT "%8.4" EXTENDED_LIMITS -327.6800 327.6700 /end CHARACTERISTIC
/begin CHARACTERISTIC CrCtl_vRlsOfsI_C "FGR, Offset-Schwellwert für Freigabe Integrator" VALUE 0xC950E Kw_Ws16 300.0000 Vel 0.00 300.0000 FORMAT "%8.4" EXTENDED_LIMITS -327.6800 327.6700 /end CHARACTERISTIC
/begin CHARACTERISTIC CrCtl_vTipStep_C "#SSD FGR TIP-UP/DOWN Geschwindigkeitsschritt" VALUE 0xC9510 Kw_Ws16 300.0000 Vel 0.00 300.0000 FORMAT "%8.4" EXTENDED_LIMITS -327.6800 327.6700 /end CHARACTERISTIC
/begin CHARACTERISTIC CrSCD_ctGapIncs_C "#SSD Kurbelwellenkonfiguration: Anzahl der fehlenden Inkremente in der Lücke (virtuelle Inkremente)" VALUE 0xC05F2 Kw_Wu8 0.00 OneToOne 2.000 2.000 FORMAT "%5.3" EXTENDED_LIMITS 0.00 255.0 /end CHARACTERISTIC
/begin CHARACTERISTIC CrSCD_ctGaps_C "#SSD Kurbelwellenkonfiguration: Anzahl der Lücken auf dem Inkrementgeberrad" VALUE 0xC05F3 Kw_Wu8 3.000 OneToOne 1.000 4.000 FORMAT "%5.3" EXTENDED_LIMITS 0.00 255.0 /end CHARACTERISTIC
/begin CHARACTERISTIC CrSCD_ctIncs_C "#SSD Kurbelwellenkonfiguration: Anzahl der Inkremente einschließlich virtueller Lückenzähne" VALUE 0xC05F4 Kw_Wu8 110.0 OneToOne 10.00 120.0 FORMAT "%5.1" EXTENDED_LIMITS 0.00 255.0 /end CHARACTERISTIC
/begin CHARACTERISTIC CrSCD_ctThresCtlMin_C "#SSD Kleinste Schwelle der dyn. Schwellennachführung des Kurbelwellensignals" VALUE 0xC05EC Kw_Wu8 7.000 OneToOne 0.00 7.000 FORMAT "%5.3" EXTENDED_LIMITS 0.00 255.0 /end CHARACTERISTIC
/begin CHARACTERISTIC CrSCD_ctTurns_C "#SSD Anzahl der Kurbelwellenumdrehungen pro Nockenwellenumdrehung (1 = 2 Takter, 2 = 4 Takter)" VALUE 0xC05DA Kw_Wu8 1.000 OneToOne 1.000 2.000 FORMAT "%5.3" EXTENDED_LIMITS 0.00 255.0 /end CHARACTERISTIC
/begin CHARACTERISTIC CrSCD_facGapPlausHigh_CUR "#SSD Verhältnis zur Bestimmung der oberen Grenze des Fensters zur Lückenplausibilisierung des Inkrementsignals" CURVE 0xC956A Kl_Xs16_Ws16 3.000000 Fact_Inc 3.000000 6.000000 FORMAT "%8.6" EXTENDED_LIMITS -128.0000 127.9961
 /begin AXIS_DESCR STD_AXIS CrSCD_tiIncr TimeDT 10 100.0000 32767.00 FORMAT "%8.2" EXTENDED_LIMITS 0.00 65535.00 DEPOSIT ABSOLUTE /end AXIS_DESCR
/end CHARACTERISTIC
/begin CHARACTERISTIC CrSCD_facGapPlausLow_CUR "#SSD Verhältnis zur Bestimmung der unteren Grenze des Fensters zur Lückenplausibilisierung des Inkrementsignals" CURVE 0xC9594 Kl_Xs16_Ws16 3.000000 Fact_Inc 0.00 3.000000 FORMAT "%8.6" EXTENDED_LIMITS -128.0000 127.9961
 /begin AXIS_DESCR STD_AXIS CrSCD_tiIncr TimeDT 10 100.0000 32767.00 FORMAT "%8.2" EXTENDED_LIMITS 0.00 65535.00 DEPOSIT ABSOLUTE /end AXIS_DESCR
/end CHARACTERISTIC
/begin CHARACTERISTIC CrSCD_facIncPlausHigh_CUR "#SSD Verhältnis zur Bestimmung der obere Grenze des Fensters zur Plausibilisierung des Inkrementsignals" CURVE 0xC95BE Kl_Xs16_Ws16 1.000000 Fact_Inc 1.000000 2.000000 FORMAT "%8.6" EXTENDED_LIMITS -128.0000 127.9961
 /begin AXIS_DESCR STD_AXIS CrSCD_tiIncr TimeDT 10 100.0000 32767.00 FORMAT "%8.2" EXTENDED_LIMITS 0.00 65535.00 DEPOSIT ABSOLUTE /end AXIS_DESCR
/end CHARACTERISTIC
/begin CHARACTERISTIC CrSCD_facIncPlausLow_CUR "#SSD Verhältnis zur Bestimmung der unteren Grenze des Fensters zur Plausibilisierung des Inkrementsignals" CURVE 0xC95E8 Kl_Xs16_Ws16 1.000000 Fact_Inc 0.00 1.000000 FORMAT "%8.6" EXTENDED_LIMITS -128.0000 127.9961
 /begin AXIS_DESCR STD_AXIS CrSCD_tiIncr TimeDT 10 100.0000 32767.00 FORMAT "%8.2" EXTENDED_LIMITS 0.00 65535.00 DEPOSIT ABSOLUTE /end AXIS_DESCR
/end CHARACTERISTIC
/begin CHARACTERISTIC CrSCD_nFast_C "#SSD Frequenz für das winkelsynchrone Interruptsystem, wenn kein Inkrementsignal vorhanden" VALUE 0xC05DC Kw_Ws16 8000.000 EngN 0.00 8000.000 FORMAT "%8.3" EXTENDED_LIMITS -32768.00 32767.00 /end CHARACTERISTIC
/begin CHARACTERISTIC CrSCD_nMax_C "#SSD Größte zulässige Frequenz des Inkrementsignals" VALUE 0xC05DE Kw_Ws16 2000.000 EngN 5000.000 7000.000 FORMAT "%8.3" EXTENDED_LIMITS -32768.00 32767.00 /end CHARACTERISTIC
/begin CHARACTERISTIC CrSCD_nMin_C "#SSD Kleinste zulässige Frequenz des Inkrementsignals" VALUE 0xC05E0 Kw_Ws16 480.0000 EngN 20.00000 500.0000 FORMAT "%8.4" EXTENDED_LIMITS -32768.00 32767.00 /end CHARACTERISTIC
/begin CHARACTERISTIC CrSCD_nSlowHigh_C "#SSD Obere Drehzahlschwelle ab der das Slow-Bit für die Diahnose zurückgesetzt wird" VALUE 0xC05E2 Kw_Ws16 3000.000 EngN 0.00 3000.000 FORMAT "%8.3" EXTENDED_LIMITS -32768.00 32767.00 /end CHARACTERISTIC
/begin CHARACTERISTIC CrSCD_nSlow_C "#SSD Schwelle ab der Unterdrehzahl gemeldet wird" VALUE 0xC05E4 Kw_Ws16 1000.000 EngN 0.00 1000.000 FORMAT "%8.3" EXTENDED_LIMITS -32768.00 32767.00 /end CHARACTERISTIC
/begin CHARACTERISTIC CrSCD_nThresCtlHigh_C "#SSD Obere Schwelle zur Aktiviereung der dyn. Schwellennachführung" VALUE 0xC05EE Kw_Ws16 65535.00 EngN -32768.00 32767.00 FORMAT "%8.2" /end CHARACTERISTIC
/begin CHARACTERISTIC CrSCD_nThresCtlLow_C "#SSD Untere Schwelle zur Aktivierung der dyn. Schwellennachführung" VALUE 0xC05F0 Kw_Ws16 65535.00 EngN -32768.00 32767.00 FORMAT "%8.2" /end CHARACTERISTIC
/begin CHARACTERISTIC CrSCD_numFBCSeg_C "#SSD Anzahl der FBC segmente" VALUE 0xC05F5 Kw_Wu8 7.000 OneToOne 1.000 8.000 FORMAT "%5.3" EXTENDED_LIMITS 0.00 255.0 /end CHARACTERISTIC
/begin CHARACTERISTIC CrSCD_numShftMisf_C "#SSD Phasenverschiebung Segmentsystem für Aussetzererkennung (in MAR-Segmenten)" VALUE 0xC05E6 Kw_Wu8 1.000 OneToOne 0.00 1.000 FORMAT "%5.3" EXTENDED_LIMITS 0.00 255.0 /end CHARACTERISTIC
/begin CHARACTERISTIC CrSCD_numTDCSeg_C "#SSD Anzahl der Segment pro OT" VALUE 0xC05F6 Kw_Wu8 0.00 OneToOne 2.000 2.000 FORMAT "%5.3" EXTENDED_LIMITS 0.00 255.0 READ_ONLY /end CHARACTERISTIC
/begin CHARACTERISTIC CrSCD_phiGap2Zero_C "#SSD Winkel zwischen Lücke und physikalischer Nullposition" VALUE 0xC05F8 Kw_Ws16 720.0000 AngleCrS 0.00 720.0000 FORMAT "%8.4" EXTENDED_LIMITS -768.0000 767.9766 /end CHARACTERISTIC
/begin CHARACTERISTIC CrSCD_phiIncCor_CUR "#SSD Phasenkorrekturkennlinie des Inkrementsystems der Kurbelwelle" CURVE 0xC9538 Kl_Xs16_Ws16 50.01562 AngleCrS -25.00781 25.00781 FORMAT "%8.5" EXTENDED_LIMITS -768.0000 767.9766
 /begin AXIS_DESCR STD_AXIS CrSCD_nAvrg EngN 12 0.00 6000.000 FORMAT "%8.3" EXTENDED_LIMITS -32768.00 32767.00 DEPOSIT ABSOLUTE /end AXIS_DESCR
/end CHARACTERISTIC
/begin CHARACTERISTIC CrSCD_phiSegLength_C "#SSD Kurbelwellenkonfiguration: Segementlänge" VALUE 0xC05E8 Kw_Ws16 90.00000 AngleCrS 30.00000 120.0000 FORMAT "%8.4" EXTENDED_LIMITS -768.0000 767.9766 /end CHARACTERISTIC
/begin CHARACTERISTIC CrSCD_phiSegPhase_C "#SSD Phasenlage der Drehzahlsegmente zum OT" VALUE 0xC05EA Kw_Ws16 720.0000 AngleCrS 0.00 720.0000 FORMAT "%8.4" EXTENDED_LIMITS -768.0000 767.9766 /end CHARACTERISTIC
/begin CHARACTERISTIC CrSCD_tiPlausCalcOff_C "#SSD Schwelle zum Abschalten der Berechnung der Plausibilitätsfenster" VALUE 0xC05FA Kw_Ws16 32767.00 TimeDT 0.00 32767.00 FORMAT "%8.2" EXTENDED_LIMITS -32768.00 32767.00 /end CHARACTERISTIC
/begin CHARACTERISTIC CrS_ctMaxInjStrt_C "#SSD Maximale Anzahl von Testeinspritzungen" VALUE 0xC05C6 Kw_Wu16 100.0000 OneToOne 0.00 100.0000 FORMAT "%8.4" EXTENDED_LIMITS 0.00 65535.00 /end CHARACTERISTIC
/begin CHARACTERISTIC CrS_facSegTimeMax_C "#SSD Maximales Verhältnis der Segmentzeiten, das eine konstante Motordrehzahl signalisiert" VALUE 0xC05C8 Kw_Ws32 100.000000000 Fact1 0.00 100.000000000 FORMAT "%13.9" EXTENDED_LIMITS -16777216.0000 16777215.9922 /end CHARACTERISTIC
/begin CHARACTERISTIC CrS_facSegTimeMin_C "#SSD Minimales Verhältnis der Segmentzeiten, das eine konstante Motordrehzahl signalisiert" VALUE 0xC05CC Kw_Ws32 100.000000000 Fact1 0.00 100.000000000 FORMAT "%13.9" EXTENDED_LIMITS -16777216.0000 16777215.9922 /end CHARACTERISTIC
/begin CHARACTERISTIC CrS_facSegTime_C "#SSD Verhältnis der Segmentzeiten" VALUE 0xC05D0 Kw_Ws32 99.0000000000 Fact1 1.00000000000 100.000000000 FORMAT "%13.9" EXTENDED_LIMITS -16777216.0000 16777215.9922 /end CHARACTERISTIC
/begin CHARACTERISTIC CrS_phiSegLengthStrtSpd_C "#SSD Segmentlänge, die berechnet werden soll" VALUE 0xC05D4 Kw_Ws16 180.0000 AngleCrS 0.00 180.0000 FORMAT "%8.4" EXTENDED_LIMITS -768.0000 767.9766 /end CHARACTERISTIC
/begin CHARACTERISTIC CrS_phiSegOfsStrtSpdOld_C "#SSD Segment Offset des alten Segmentes bezüglich TDC" VALUE 0xC05D6 Kw_Ws16 1440.000 AngleCrS -720.0000 720.0000 FORMAT "%8.4" EXTENDED_LIMITS -768.0000 767.9766 /end CHARACTERISTIC
/begin CHARACTERISTIC CrS_phiSegOfsStrtSpd_C "#SSD Segment Offset des aktuellen Segmentes bezüglich TDC" VALUE 0xC05D8 Kw_Ws16 1440.000 AngleCrS -720.0000 720.0000 FORMAT "%8.4" EXTENDED_LIMITS -768.0000 767.9766 /end CHARACTERISTIC
/begin CHARACTERISTIC CTSCD_uSRCMin_C "Minimalwert für SRC WTF-Sensor" VALUE 0xC9614 Kw_Ws16 5200.391 Volt 0.00 5200.391 FORMAT "%8.3" EXTENDED_LIMITS -160156.4 160151.5 /end CHARACTERISTIC
/begin CHARACTERISTIC CTSCD_uSRCMax_C "Maximalwert für SRC WTF-Sensor" VALUE 0xC9616 Kw_Ws16 5200.391 Volt 0.00 5200.391 FORMAT "%8.3" EXTENDED_LIMITS -160156.4 160151.5 /end CHARACTERISTIC
/begin CHARACTERISTIC CTSCD_tLin_CUR "Linearisierungskennlinie für WTF-Sensor" CURVE 0xC9618 Kl_Xs16_Ws16 950.0000 Temp_Cels -50.1400 899.8600 FORMAT "%8.4" EXTENDED_LIMITS -3549.940 3003.560
 /begin AXIS_DESCR STD_AXIS CTSCD_uRaw Volt 20 0.00 5200.391 FORMAT "%8.3" EXTENDED_LIMITS -160156.4 160151.5 DEPOSIT ABSOLUTE /end AXIS_DESCR
/end CHARACTERISTIC
/begin CHARACTERISTIC CTSCD_DebSigDef_C "#SSD Fehlerentprellung Wassertemperatur über CAN" VALUE 0xC966A Kw_Wu16 655350.0 Time_ms 0.00 655350.0 FORMAT "%8.1" /end CHARACTERISTIC
/begin CHARACTERISTIC CTSCD_DebSigOk_C "Heilungsentprellung Wassertemperatur über CAN" VALUE 0xC966C Kw_Wu16 655350.0 Time_ms 0.00 655350.0 FORMAT "%8.1" /end CHARACTERISTIC
/begin CHARACTERISTIC CTSCD_DebSRCHighDef_C "#SSD WTF Fehlerentprellzeit fuer SRC-High" VALUE 0xC966E Kw_Wu16 655350.0 Time_ms 0.00 655350.0 FORMAT "%8.1" /end CHARACTERISTIC
/begin CHARACTERISTIC CTSCD_DebSRCHighOk_C "WTF Heilungsentprellzeit fuer SRC-High" VALUE 0xC9670 Kw_Wu16 655350.0 Time_ms 0.00 655350.0 FORMAT "%8.1" /end CHARACTERISTIC
/begin CHARACTERISTIC CTSCD_DebSRCLowDef_C "#SSD WTF Fehlerentprellzeit fuer SRC-Low" VALUE 0xC9672 Kw_Wu16 655350.0 Time_ms 0.00 655350.0 FORMAT "%8.1" /end CHARACTERISTIC
/begin CHARACTERISTIC CTSCD_DebSRCLowOk_C "WTF Heilungsentprellzeit fuer SRC-Low" VALUE 0xC9674 Kw_Wu16 655350.0 Time_ms 0.00 655350.0 FORMAT "%8.1" /end CHARACTERISTIC
/begin CHARACTERISTIC CTSCD_dtRmpSlp2UpDwn_C "Auf- und Abwärts Rampensteigung im Zustand 2 beim Übergang  zweier Ersatzwerte für den Wassertemperaturfühler" VALUE 0xC9678 Kw_Wu32 6553598.99749 RmpTemp 1.00097656250 6553599.99847 FORMAT "%13.5" EXTENDED_LIMITS 0.00 6553599.99847 /end CHARACTERISTIC
/begin CHARACTERISTIC CTSCD_dtFlTempUp_C "ramp slope up in C/ms" VALUE 0xC967C Kw_Wu32 6553.59899750 RmpTempCels 0.00100097656250 6553.59999847 FORMAT "%13.8" EXTENDED_LIMITS 0.00 6553.59999847 /end CHARACTERISTIC
/begin CHARACTERISTIC CTSCD_dtFlTempDwn_C " ramp slope down in C/ms" VALUE 0xC9680 Kw_Wu32 6553.59899750 RmpTempCels 0.00100097656250 6553.59999847 FORMAT "%13.8" EXTENDED_LIMITS 0.00 6553.59999847 /end CHARACTERISTIC
/begin CHARACTERISTIC CTSCD_numAdc_C "#SSD Applikationsparameter fuer Kuehlwassertemperatur-Fuehler" VALUE 0xC9684 Kw_Wu8 26.0000000000 NumPinAdc 0.00 26.0000000000 FORMAT "%13.10" /end CHARACTERISTIC
/begin CHARACTERISTIC CTSCD_dtRmpSlp1Up_C "Aufwärts Rampensteigung  im Zustand 1 bei  Übergang Messwert  Vorgabewert für WTF" VALUE 0xC9688 Kw_Wu32 6553598.99749 RmpTemp 1.00097656250 6553599.99847 FORMAT "%13.5" EXTENDED_LIMITS 0.00 6553599.99847 /end CHARACTERISTIC
/begin CHARACTERISTIC CTSCD_dtRmpSlp1Dwn_C "Abwärtsrampensteigung im Zustand 1 beim Übergang  Messwert Vorgabewert   für WTF" VALUE 0xC968C Kw_Wu32 6553598.99749 RmpTemp 1.00097656250 6553599.99847 FORMAT "%13.5" EXTENDED_LIMITS 0.00 6553599.99847 /end CHARACTERISTIC
/begin CHARACTERISTIC CTSCD_stSensIDWord_C "#SSD Geberkennwort WTF-Sensor" VALUE 0xC9690 Kw_Wu8 255.0 OneToOne 0.00 255.0 FORMAT "%5.1" /end CHARACTERISTIC
/begin CHARACTERISTIC CTSCD_swtPHtrIgnoreCAN_C "Schalter um Wert von CAN oder HW zu wählen (1: CAN, 0: HW)" VALUE 0xC9691 Kw_Wu8 1.000 OneToOne 0.00 1.000 FORMAT "%5.3" EXTENDED_LIMITS 0.00 255.0 /end CHARACTERISTIC
/begin CHARACTERISTIC CTSCD_swtSigVal_C "Signalquelle ADC/CAN (0: ADC, 1: CAN)" VALUE 0xC9692 Kw_Wu8 1.000 OneToOne 0.00 1.000 FORMAT "%5.3" EXTENDED_LIMITS 0.00 255.0 /end CHARACTERISTIC
/begin CHARACTERISTIC CTSCD_tClntPMin_C "Threshold Value of Coolant Temperature before Correction" VALUE 0xC9694 Kw_Ws16 250.0000 Temp_Cels -50.14000 199.8600 FORMAT "%8.4" EXTENDED_LIMITS -3549.940 3003.560 /end CHARACTERISTIC
/begin CHARACTERISTIC CTSCD_tDflCold_C "Wassertemperatur-Vorgabewert  im  Glüh und Startvorgang bei defektem WTS-Sensor" VALUE 0xC9696 Kw_Ws16 950.0000 Temp_Cels -50.1400 899.8600 FORMAT "%8.4" EXTENDED_LIMITS -3549.940 3003.560 /end CHARACTERISTIC
/begin CHARACTERISTIC CTSCD_tDflWarm_C "Wassertemperatur-Vorgabewert  nach Glüh und Startvorgang  bei defektem WTS-Sensor" VALUE 0xC9698 Kw_Ws16 950.0000 Temp_Cels -50.1400 899.8600 FORMAT "%8.4" EXTENDED_LIMITS -3549.940 3003.560 /end CHARACTERISTIC
/begin CHARACTERISTIC CTSCD_tDiffThres_C "Difference Threshold value of Fuel and Coolant Temperature" VALUE 0xC969A Kw_Ws16 250.0000 Temp_Cels -50.14000 199.8600 FORMAT "%8.4" EXTENDED_LIMITS -3549.940 3003.560 /end CHARACTERISTIC
/begin CHARACTERISTIC CTSCD_tFuelMin_C "Threshold Value of Fuel Temperature" VALUE 0xC969C Kw_Ws16 250.0000 Temp_Cels -50.14000 199.8600 FORMAT "%8.4" EXTENDED_LIMITS -3549.940 3003.560 /end CHARACTERISTIC
/begin CHARACTERISTIC CTSCD_tiWait_C "Time delay to set CTSCD_stPHtr 5th Bit" VALUE 0xC969E Kw_Wu16 655350.0 Time_ms 0.00 655350.0 FORMAT "%8.1" /end CHARACTERISTIC
/begin CHARACTERISTIC CWBGSTUT "0: Programmiermodus gesperrt, 1: Programmiermodus verfügbar" VALUE 0xC05BE KwWU8 255.0 dez 0.00 255.0 FORMAT "%5.1" /end CHARACTERISTIC
/begin CHARACTERISTIC CycSigCheck_nLimit_C "Drehzahllimit für Berechnung des zyklische Signaturchecks" VALUE 0xC96A0 Kw_Wu16 6000.000 EngN 0.00 6000.000 FORMAT "%8.3" EXTENDED_LIMITS 0.00 65535.00 /end CHARACTERISTIC
/begin CHARACTERISTIC CycSigCheck_swtMode_C "Cycsig Berechnung startet mit: 0 Prgramm; 1 Daten" VALUE 0xC96A2 Kw_Wu8 1.000 OneToOne 0.00 1.000 FORMAT "%5.3" EXTENDED_LIMITS 0.00 255.0 /end CHARACTERISTIC
/begin CHARACTERISTIC CycSigCheck_swtOff_C "Abschalten der Erkennung von fehlerhaften Signaturen in Applikations SG" VALUE 0xC96A3 Kw_Wu8 1.000 OneToOne 0.00 1.000 FORMAT "%5.3" EXTENDED_LIMITS 0.00 255.0 /end CHARACTERISTIC
/begin CHARACTERISTIC DCC_DebPlausTrqDesDef_C "Defektzeit des Fehlerpfad Plausibilitaet Radmoment-Anforderung" VALUE 0xC96A4 Kw_Wu16 65535.00 OneToOne 0.00 65535.00 FORMAT "%8.2" /end CHARACTERISTIC
/begin CHARACTERISTIC DCC_DebPlausTrqDesOk_C "Heilungszeit des Fehlerpfad Plausibilitaet Radmoment-Anforderung" VALUE 0xC96A6 Kw_Wu16 65535.00 OneToOne 0.00 65535.00 FORMAT "%8.2" /end CHARACTERISTIC
/begin CHARACTERISTIC DCC_EngSpdKi_C "deviation is within small signal bounds" VALUE 0xC96A8 Kw_Wu32 799999.999814 Ki_rpm2Nm 0.00 799999.999814 FORMAT "%13.6" /end CHARACTERISTIC
/begin CHARACTERISTIC DCC_EngSpdKiPos_C "deviation is greater than small signal bound" VALUE 0xC96AC Kw_Wu32 799999.999814 Ki_rpm2Nm 0.00 799999.999814 FORMAT "%13.6" /end CHARACTERISTIC
/begin CHARACTERISTIC DCC_EngSpdKiNeg_C "deviation is smaller than small signal bound" VALUE 0xC96B0 Kw_Wu32 799999.999814 Ki_rpm2Nm 0.00 799999.999814 FORMAT "%13.6" /end CHARACTERISTIC
/begin CHARACTERISTIC DCC_nEngSpdIWinPos_C "Obere Kleinsignalgrenze für das I-Glied des PI-Reglers" VALUE 0xC96B4 Kw_Ws16 8191.875 EngN_HiRes -4096.000 4095.875 FORMAT "%8.3" /end CHARACTERISTIC
/begin CHARACTERISTIC DCC_nEngSpdIWinNeg_C "Untere Kleinsignalgrenze für das I-Glied des PIDT1-Reglers" VALUE 0xC96B6 Kw_Ws16 8191.875 EngN_HiRes -4096.000 4095.875 FORMAT "%8.3" /end CHARACTERISTIC
/begin CHARACTERISTIC DCC_EngSpdKp_C "deviation is within small signal bounds" VALUE 0xC96B8 Kw_Wu32 52428.7999878 Kp_rpm2Nm 0.00 52428.7999878 FORMAT "%13.7" /end CHARACTERISTIC
/begin CHARACTERISTIC DCC_EngSpdKpPos_C "deviation is greater than small signal bound" VALUE 0xC96BC Kw_Wu32 52428.7999878 Kp_rpm2Nm 0.00 52428.7999878 FORMAT "%13.7" /end CHARACTERISTIC
/begin CHARACTERISTIC DCC_EngSpdKpNeg_C "deviation is smaller than small signal bound" VALUE 0xC96C0 Kw_Wu32 52428.7999878 Kp_rpm2Nm 0.00 52428.7999878 FORMAT "%13.7" /end CHARACTERISTIC
/begin CHARACTERISTIC DCC_nEngSpdPWinPos_C "Obere Kleinsignalgrenze für das P-Glied des PI-Reglers" VALUE 0xC96C4 Kw_Ws16 8191.875 EngN_HiRes -4096.000 4095.875 FORMAT "%8.3" /end CHARACTERISTIC
/begin CHARACTERISTIC DCC_nEngSpdPWinNeg_C "Untere Kleinsignalgrenze für das P-Glied des PIDT1-Reglers" VALUE 0xC96C6 Kw_Ws16 8191.875 EngN_HiRes -4096.000 4095.875 FORMAT "%8.3" /end CHARACTERISTIC
/begin CHARACTERISTIC DCC_lWheelDyn_C "Radumfang des Fahrzeug-Rad" VALUE 0xC96C8 Kw_Ws16 99.99219 Length1 0.007812500 100.0000 FORMAT "%8.4" EXTENDED_LIMITS -256.0000 255.9922 /end CHARACTERISTIC
/begin CHARACTERISTIC DCC_nSetPoint_CUR "Kennlinie fuer DCC setpoint" CURVE 0xC96CA Kl_Xs16_Ws16 5000.000 EngN 0.00 5000.000 FORMAT "%8.3" EXTENDED_LIMITS -32768.00 32767.00
 /begin AXIS_DESCR STD_AXIS DCC_nSetPointRaw_mp EngN 6 0.00 5000.000 FORMAT "%8.3" EXTENDED_LIMITS -32768.00 32767.00 DEPOSIT ABSOLUTE /end AXIS_DESCR
/end CHARACTERISTIC
/begin CHARACTERISTIC DCC_nShft_C "Drehzahlschwelle Gangerkennung" VALUE 0xC96E4 Kw_Ws16 8000.000 EngN 0.00 8000.000 FORMAT "%8.3" EXTENDED_LIMITS -32768.00 32767.00 /end CHARACTERISTIC
/begin CHARACTERISTIC DCC_numGearMax_C "Anzahl Getreibegaenge" VALUE 0xC96E6 Kw_Ws8 7.000 OneToOne -1.000 6.000 FORMAT "%5.3" EXTENDED_LIMITS -128.0 127.0 /end CHARACTERISTIC
/begin CHARACTERISTIC DCC_swtARWMode_C "Schalten  für das Entscheiden des    Anti-Reset-Windup   Verhaltens" VALUE 0xC96E7 Kw_Wu8 255.0 OneToOne 0.00 255.0 FORMAT "%5.1" /end CHARACTERISTIC
/begin CHARACTERISTIC DCC_swtTrqDesShutOff_C "Shalter fuer Abshaltbedinung Radmoment" VALUE 0xC96E8 Kw_Wu8 255.0 OneToOne 0.00 255.0 FORMAT "%5.1" /end CHARACTERISTIC
/begin CHARACTERISTIC DCC_tiBrkPressedDel_C "Verzoegerung Bremssignal" VALUE 0xC96EA Kw_Wu16 1000.000 Time_ms 0.00 1000.000 FORMAT "%8.3" EXTENDED_LIMITS 0.00 655350.0 /end CHARACTERISTIC
/begin CHARACTERISTIC DCC_tiEngSpdActv_C "Verzoegerung des DCC Freigabe Drehzahlregelung" VALUE 0xC96EC Kw_Wu16 1000.000 Time_ms 0.00 1000.000 FORMAT "%8.3" EXTENDED_LIMITS 0.00 655350.0 /end CHARACTERISTIC
/begin CHARACTERISTIC DCC_tiPlausBrk_C "Verzoegerung Bremssignal Plausibilitaetsfehler" VALUE 0xC96EE Kw_Wu16 1000.000 Time_ms 0.00 1000.000 FORMAT "%8.3" EXTENDED_LIMITS 0.00 655350.0 /end CHARACTERISTIC
/begin CHARACTERISTIC DCC_tiPT1_C "Filterkonstante Radmoment" VALUE 0xC96F0 Kw_Wu32 4294.9673 TimeDelay_s 0.0000010000000 4294.9673 FORMAT "%9.4" /end CHARACTERISTIC
/begin CHARACTERISTIC DCC_trqARWIMin_C "Mindestwert von    Anti-Reset-Windup" VALUE 0xC96F4 Kw_Ws16 6553.500 Trq -3276.800 3276.700 FORMAT "%8.3" /end CHARACTERISTIC
/begin CHARACTERISTIC DCC_trqEngSpdMax_C "Maximales Moment des Drehzahlreglers" VALUE 0xC96F6 Kw_Ws16 6553.500 Trq -3276.800 3276.700 FORMAT "%8.3" /end CHARACTERISTIC
/begin CHARACTERISTIC DCC_dtrqLimBrkUp_C "Positive Steigung der Rampe DCC Wunschmoment bei Betaetigung des Bremspedals" VALUE 0xC96F8 Kw_Wu32 13107199.9969 RmpTrqPrp 0.00 13107199.9969 FORMAT "%13.4" /end CHARACTERISTIC
/begin CHARACTERISTIC DCC_dtrqLimBrkDwn_C "Negative Steigung der Rampe DCC Wunschmoment bei Betaetigung des Bremspedals" VALUE 0xC96FC Kw_Wu32 13107199.9969 RmpTrqPrp 0.00 13107199.9969 FORMAT "%13.4" /end CHARACTERISTIC
/begin CHARACTERISTIC DCC_dtrqSwtUp_C "Positive Steigung beim Umschalten auf Drehzahlregelung" VALUE 0xC9700 Kw_Wu32 13107199.9969 RmpTrqPrp 0.00 13107199.9969 FORMAT "%13.4" /end CHARACTERISTIC
/begin CHARACTERISTIC DCC_dtrqSwtDwn_C "Negative Steigung beim Umschalten auf Drehzahlregelung" VALUE 0xC9704 Kw_Wu32 13107199.9969 RmpTrqPrp 0.00 13107199.9969 FORMAT "%13.4" /end CHARACTERISTIC
/begin CHARACTERISTIC DCC_dtrqLimUp_C "Positive Steigung der Rampe DCC Wunschmoment" VALUE 0xC9708 Kw_Wu32 13107199.9969 RmpTrqPrp 0.00 13107199.9969 FORMAT "%13.4" /end CHARACTERISTIC
/begin CHARACTERISTIC DCC_dtrqLimDwn_C "Negative Steigung der Rampe DCC Wunschmoment" VALUE 0xC970C Kw_Wu32 13107199.9969 RmpTrqPrp 0.00 13107199.9969 FORMAT "%13.4" /end CHARACTERISTIC
/begin CHARACTERISTIC DCC_trqReplVal_C "Ersatzwert DCC-Moment" VALUE 0xC9710 Kw_Ws16 13107.00 TrqPrp -6553.600 6553.400 FORMAT "%8.3" /end CHARACTERISTIC
/begin CHARACTERISTIC DCC_trqShft_CUR "Drehmomentkennlinie zur Initialisierung der Drehzahlregelung" CURVE 0xC9712 Kl_Xs16_Ws16 1500.000 Trq -500.0000 1000.000 FORMAT "%8.3" EXTENDED_LIMITS -3276.800 3276.700
 /begin AXIS_DESCR STD_AXIS Eng_nAvrg EngN 7 0.00 6000.000 FORMAT "%8.3" EXTENDED_LIMITS -32768.00 32767.00 DEPOSIT ABSOLUTE /end AXIS_DESCR
/end CHARACTERISTIC
/begin CHARACTERISTIC DCC_vLim_C "Geschwindigkeitsschwelle fuer DCC Eingriff" VALUE 0xC9730 Kw_Ws16 20.00000 Vel 0.00 20.00000 FORMAT "%8.5" EXTENDED_LIMITS -327.6800 327.6700 /end CHARACTERISTIC
/begin CHARACTERISTIC DrvTrn_drTransDTUp_C "Positive slope for torque changes" VALUE 0xC9734 Kw_Wu32 655359.999847 RmpTransR 0.00 655359.999847 FORMAT "%13.6" /end CHARACTERISTIC
/begin CHARACTERISTIC DrvTrn_drTransDTDwn_C "negative slope for torque changes" VALUE 0xC9738 Kw_Wu32 655359.999847 RmpTransR 0.00 655359.999847 FORMAT "%13.6" /end CHARACTERISTIC
/begin CHARACTERISTIC DrvTrn_rFlatTransDT_C "Ausgangswert des flachen Getriebeverhältnisses des drivetrain" VALUE 0xC973C Kw_Ws16 100.0000 TransR 0.00 100.0000 FORMAT "%8.4" EXTENDED_LIMITS -327.6800 327.6700 /end CHARACTERISTIC
/begin CHARACTERISTIC DrvTrn_rTransDTInit_C "Triebstrangübersetzungs-Vorgabewert (Radmoment pro Motormoment)" VALUE 0xC973E Kw_Ws16 100.0000 TransR 0.00 100.0000 FORMAT "%8.4" EXTENDED_LIMITS -327.6800 327.6700 /end CHARACTERISTIC
/begin CHARACTERISTIC DrvTrn_swtCAN_C "für Aktivierung von rTrans von CAN schalten" VALUE 0xC9740 Kw_Wu8 1.000 OneToOne 0.00 1.000 FORMAT "%5.3" EXTENDED_LIMITS 0.00 255.0 /end CHARACTERISTIC
/begin CHARACTERISTIC DrvTrn_swtrTransSel_C "Schalter zur aktivierung des Übersetzungsverhältniss-Momentanwertes (1: verzögert, 0: direkter Wert)" VALUE 0xC9741 Kw_Wu8 1.000 OneToOne 0.00 1.000 FORMAT "%5.3" EXTENDED_LIMITS 0.00 255.0 /end CHARACTERISTIC
/begin CHARACTERISTIC DrvTrn_tiRTransDT_C "Zeitintervall für das Einfrieren des aktuellen Triebstrangübersetzungswert" VALUE 0xC9742 Kw_Ws16 655140.0 Time_ms 0.00 655140.0 FORMAT "%8.1" EXTENDED_LIMITS -327680.0 327670.0 /end CHARACTERISTIC
/begin CHARACTERISTIC DrvTrn_vLimTransDT_C "Geschwindigkeits begrenzung" VALUE 0xC9744 Kw_Ws16 200.0000 Vel 0.00 200.0000 FORMAT "%8.4" EXTENDED_LIMITS -327.6800 327.6700 /end CHARACTERISTIC
/begin CHARACTERISTIC DSCHED_numSelFID_C "FID auswählbar zur Anzeige der defekten und nicht defekten DFPs welche den ausgewählten FID verriegeln" VALUE 0xC9748 Kw_Wu16 61727.0000000 FidName 0.00 61727.0000000 FORMAT "%13.7" /end CHARACTERISTIC
/begin CHARACTERISTIC DVMARK "Mindestabstand von Geschwindigkeits-Marken beim Stufentempomat" VALUE 0xC05AC KwWU16 655.3500 Vel 0.00 655.3500 FORMAT "%8.4" /end CHARACTERISTIC
/begin CHARACTERISTIC DVMARKMI "dvmark_w für mph-Tachometer" VALUE 0xC05AE KwWU16 655.3500 Vel 0.00 655.3500 FORMAT "%8.4" /end CHARACTERISTIC
/begin CHARACTERISTIC DVPRG "Schrittweite bei Anzeige der Regelgeschwindigkeit im Programmiermodus" VALUE 0xC05B0 KwWU16 655.3500 Vel 0.00 655.3500 FORMAT "%8.4" /end CHARACTERISTIC
/begin CHARACTERISTIC DVPRGMI "dvprg_w für mph-Tachometer" VALUE 0xC05B2 KwWU16 655.3500 Vel 0.00 655.3500 FORMAT "%8.4" /end CHARACTERISTIC
/begin CHARACTERISTIC DVSTUTOM "Schrittweite f ür Verstellung der Zielgeschwindigkeit ohne programmierte Marken" VALUE 0xC05B4 KwWU16 655.3500 Vel 0.00 655.3500 FORMAT "%8.4" /end CHARACTERISTIC
/begin CHARACTERISTIC DVSTUTOMMI "dvstutom_w für mph - tacho" VALUE 0xC05B6 KwWU16 655.3500 Vel 0.00 655.3500 FORMAT "%8.4" /end CHARACTERISTIC
/begin CHARACTERISTIC TFGRTP "Zeit für Tip-Erkennung bei FGR-Bedientasten" VALUE 0xC05BF KwWU8 5.100 t20msxs_ub_b5p1 0.00 5.100 FORMAT "%5.3" /end CHARACTERISTIC
/begin CHARACTERISTIC TMARK "Verzögerungszeit f ür Ein- und Ausblenden der Marken mit Tipschalter Aus" VALUE 0xC05C0 KwWU8 5.100 t20msxs_ub_b5p1 0.00 5.100 FORMAT "%5.3" /end CHARACTERISTIC
/begin CHARACTERISTIC TMRKBLI "Zeit für Ein- und Ausschaltung beim Blinken der Markenanzeige" VALUE 0xC05C1 KwWU8 5.100 t20msxs_ub_b5p1 0.00 5.100 FORMAT "%5.3" /end CHARACTERISTIC
/begin CHARACTERISTIC TSELO "Verzögerungszeit für das Setzen und Löschen von Marken" VALUE 0xC05C2 KwWU8 5.100 t20msxs_ub_b5p1 0.00 5.100 FORMAT "%5.3" /end CHARACTERISTIC
/begin CHARACTERISTIC TVSTUTK "Verzögerungszeit kurz für Verstellung bei gehaltener Taste" VALUE 0xC05C3 KwWU8 5.100 t20msxs_ub_b5p1 0.00 5.100 FORMAT "%5.3" /end CHARACTERISTIC
/begin CHARACTERISTIC TVSTUTL "Verzögerungszeit lang für Verstellung bei gehaltener Taste" VALUE 0xC05C4 KwWU8 5.100 t20msxs_ub_b5p1 0.00 5.100 FORMAT "%5.3" /end CHARACTERISTIC
/begin CHARACTERISTIC VFGRPRG "Geschindigkeitsschwelle zum Abschalten des FGR Programmiermodus" VALUE 0xC05B8 KwWU16 655.3500 Vel 0.00 655.3500 FORMAT "%8.4" /end CHARACTERISTIC
/begin CHARACTERISTIC VVEMOFS "Offset zur eingefrorenen vIst bei verzögern, ab der die v-Marke wieder zum Schleppzeiger wird" VALUE 0xC05BA KwWU16 655.3500 Vel 0.00 655.3500 FORMAT "%8.4" /end CHARACTERISTIC
/begin MEASUREMENT anzmark "Anzahl Geschwindigkeits-Marken Stufentempomat" UBYTE dez 1 100 0.00 255.0 FORMAT "%5.1" ECU_ADDRESS 0x7F89CA /end MEASUREMENT
/begin MEASUREMENT BGSTUTlokbits0 "keine Funktion" UWORD dez 1 100 0.00 65535.00 FORMAT "%8.2" ECU_ADDRESS 0x7F8ABC /end MEASUREMENT
/begin MEASUREMENT B_acc "Bedingung ACC-Steuergerät vorhanden" UBYTE B_TRUE 1 100 0.00 1.00000000000 BIT_MASK 0x1 FORMAT "%13.11" ECU_ADDRESS 0x7F87D3 /end MEASUREMENT
/begin MEASUREMENT B_besch "Bedingung FGR im Zustand Beschleunigen" UBYTE B_TRUE 1 100 0.00 1.00000000000 BIT_MASK 0x1 FORMAT "%13.11" ECU_ADDRESS 0x7F87D5 /end MEASUREMENT
/begin MEASUREMENT B_beveh "Bedingung Halten der Beschleunigen- oder Verzögerungs-Taste" UBYTE B_TRUE 1 100 0.00 1.00000000000 FORMAT "%13.11" ECU_ADDRESS 0x7F87D6 /end MEASUREMENT
/begin MEASUREMENT B_bv1 "Bedingung Bediensignal Stufentempomat Beschleunigen oder Verzögern 1. Stufe" UBYTE B_TRUE 1 100 0.00 1.00000000000 FORMAT "%13.11" ECU_ADDRESS 0x7F87D7 /end MEASUREMENT
/begin MEASUREMENT B_bv2 "Bedingung Bediensignal Stufentempomat Beschleunigen oder Verzögern 2. Stufe" UBYTE B_TRUE 1 100 0.00 1.00000000000 FORMAT "%13.11" ECU_ADDRESS 0x7F87D8 /end MEASUREMENT
/begin MEASUREMENT B_envtwa "Bedingung FGR aktiv vor Betätigung der Wiederaufnahme-Taste" UBYTE B_TRUE 1 100 0.00 1.00000000000 FORMAT "%13.11" ECU_ADDRESS 0x7F87DA /end MEASUREMENT
/begin MEASUREMENT B_fgrat "Bedingung: Tip-Schalter Aus am FGR-Bedienteil betätigt" UBYTE B_TRUE 1 100 0.00 1.00000000000 BIT_MASK 0x1 FORMAT "%13.11" ECU_ADDRESS 0x7F87DC /end MEASUREMENT
/begin MEASUREMENT B_fgren "Bedingung Fahrgeschwindigkeitsregelung aktiv (Enable)" UBYTE B_TRUE 1 100 0.00 1.00000000000 BIT_MASK 0x1 FORMAT "%13.11" ECU_ADDRESS 0x7F87DD /end MEASUREMENT
/begin MEASUREMENT B_fgrepa "Status in Cruise control" UBYTE B_TRUE 1 100 0.00 1.00000000000 FORMAT "%13.11" ECU_ADDRESS 0x7F87DE /end MEASUREMENT
/begin MEASUREMENT B_fgresv "" UBYTE B_TRUE 1 100 0.00 1.00000000000 BIT_MASK 0x1 FORMAT "%13.11" ECU_ADDRESS 0x7F87DF /end MEASUREMENT
/begin MEASUREMENT B_fgrtb2 "Bedingung FGR-Taste Auswahl der nächsthöheren Zielgeschwindigkeit" UBYTE B_TRUE 1 100 0.00 1.00000000000 BIT_MASK 0x1 FORMAT "%13.11" ECU_ADDRESS 0x7F87E0 /end MEASUREMENT
/begin MEASUREMENT B_fgrtbe "Bedingung FGR-Taste Beschleunigen" UBYTE B_TRUE 1 100 0.00 1.00000000000 BIT_MASK 0x1 FORMAT "%13.11" ECU_ADDRESS 0x7F87E1 /end MEASUREMENT
/begin MEASUREMENT B_fgrtv2 "Bedingung FGR-Taste Auswahl der nächstniederen Zielgeschwindigkeit" UBYTE B_TRUE 1 100 0.00 1.00000000000 BIT_MASK 0x1 FORMAT "%13.11" ECU_ADDRESS 0x7F87E2 /end MEASUREMENT
/begin MEASUREMENT B_fgrtve "Bedingung FGR-Taste Verzöägern" UBYTE B_TRUE 1 100 0.00 1.00000000000 BIT_MASK 0x1 FORMAT "%13.11" ECU_ADDRESS 0x7F87E3 /end MEASUREMENT
/begin MEASUREMENT B_fgrtwa "Bedingung FGR-Taste Wiederaufnahme" UBYTE B_TRUE 1 100 0.00 1.00000000000 BIT_MASK 0x1 FORMAT "%13.11" ECU_ADDRESS 0x7F87E4 /end MEASUREMENT
/begin MEASUREMENT B_fgrvem "Bedingung: FGR im Zustand Verzögern (aus ME)" UBYTE B_TRUE 1 100 0.00 1.00000000000 BIT_MASK 0x1 FORMAT "%13.11" ECU_ADDRESS 0x7F87E5 /end MEASUREMENT
/begin MEASUREMENT B_insfgre "Bedingung Fehler im INST-Kombi, FGR muss abgeschaltet werden" UBYTE B_TRUE 1 100 0.00 1.00000000000 BIT_MASK 0x1 FORMAT "%13.11" ECU_ADDRESS 0x7F87E6 /end MEASUREMENT
/begin MEASUREMENT B_kl15 "Bedingung Klemme 15" UBYTE B_TRUE 1 100 0.00 1.00000000000 BIT_MASK 0x1 FORMAT "%13.11" ECU_ADDRESS 0x7F87E7 /end MEASUREMENT
/begin MEASUREMENT B_km "Bedingung CAN-Kombi-Kodierung in km/h" UBYTE B_TRUE 1 100 0.00 1.00000000000 BIT_MASK 0x1 FORMAT "%13.11" ECU_ADDRESS 0x7F87E8 /end MEASUREMENT
/begin MEASUREMENT B_mmiena "Status bit" UBYTE B_TRUE 1 100 0.00 1.00000000000 BIT_MASK 0x1 FORMAT "%13.11" ECU_ADDRESS 0x7F87E9 /end MEASUREMENT
/begin MEASUREMENT B_mrkbli "Bedingung Blinken der Markenanzeige" UBYTE B_TRUE 1 100 0.00 1.00000000000 FORMAT "%13.11" ECU_ADDRESS 0x7F87EA /end MEASUREMENT
/begin MEASUREMENT B_mrkein "Bedingung Anzeige Geschwindigkeits-Marken im Kombi ein" UBYTE B_TRUE 1 100 0.00 1.00000000000 BIT_MASK 0x1 FORMAT "%13.11" ECU_ADDRESS 0x7F87EB /end MEASUREMENT
/begin MEASUREMENT B_mrkv "Bedingung Veränderung der Geschwindigkeits-Marken Stufentempomat" UBYTE B_TRUE 1 100 0.00 1.00000000000 BIT_MASK 0x1 FORMAT "%13.11" ECU_ADDRESS 0x7F87EC /end MEASUREMENT
/begin MEASUREMENT B_prgmod "Bedingung Programmiermodus Stufentempomat" UBYTE B_TRUE 1 100 0.00 1.00000000000 FORMAT "%13.11" ECU_ADDRESS 0x7F87EE /end MEASUREMENT
/begin MEASUREMENT B_tmark "Bedingung Taste Aus für die Zeit TMARK betätigt" UBYTE B_TRUE 1 100 0.00 1.00000000000 FORMAT "%13.11" ECU_ADDRESS 0x7F87EF /end MEASUREMENT
/begin MEASUREMENT B_tmrkbli "Bedingung"" Blinken der Markenanzeige""" UBYTE B_TRUE 1 100 0.00 1.00000000000 FORMAT "%13.11" ECU_ADDRESS 0x7F87F0 /end MEASUREMENT
/begin MEASUREMENT B_vziels "Bedingung Übernahme berechnete Zielgeschwindigkeit" UBYTE B_TRUE 1 100 0.00 1.00000000000 BIT_MASK 0x1 FORMAT "%13.11" ECU_ADDRESS 0x7F87F1 /end MEASUREMENT
/begin MEASUREMENT canzbl "Zähler für Aus-/Ein-Schaltungen beim Blinken der Markenanzeige" UBYTE dez 1 100 0.00 255.0 FORMAT "%5.1" ECU_ADDRESS 0x7F89CB /end MEASUREMENT
/begin MEASUREMENT CrCtl_BGSTUTbits2_mp "" UWORD OneToOne 1 100 0.00 65535.00 FORMAT "%8.2" ECU_ADDRESS 0x8FE5A6 /end MEASUREMENT
/begin MEASUREMENT CrCtl_dvAcc_mp "Rampensteigung bei Beschleunigung SET+" SWORD dVel_20ms 1 100 -16384.00 16383.50 FORMAT "%8.2" ECU_ADDRESS 0x8FE592 /end MEASUREMENT
/begin MEASUREMENT CrCtl_dvDecl_mp "Rampensteigung bei Verzögerung SET-" SWORD dVel_20ms 1 100 -16384.00 16383.50 FORMAT "%8.2" ECU_ADDRESS 0x8FE594 /end MEASUREMENT
/begin MEASUREMENT CrCtl_dvResAbv_mp "Rampensteigung bei WA-" SWORD dVel_20ms 1 100 -16384.00 16383.50 FORMAT "%8.2" ECU_ADDRESS 0x8FE596 /end MEASUREMENT
/begin MEASUREMENT CrCtl_dvResBlw_mp "Rampensteigung WA+" SWORD dVel_20ms 1 100 -16384.00 16383.50 FORMAT "%8.2" ECU_ADDRESS 0x8FE598 /end MEASUREMENT
/begin MEASUREMENT CrCtl_mrkeinvp_mp "" UBYTE OneToOne 1 100 0.00 255.0 FORMAT "%5.1" ECU_ADDRESS 0x8FE5A8 /end MEASUREMENT
/begin MEASUREMENT CrCtl_numVMrk "1 Index für vmrki..." UBYTE OneToOne 1 100 0.00 255.0 FORMAT "%5.1" ECU_ADDRESS 0x7F8838 /end MEASUREMENT
/begin MEASUREMENT CrCtl_rVnBeg "Verhältnis Geschwindigkeit zu Drehzahl bei Aktivierung FGR" SWORD VelToN 1 100 0.00 0.3276700 FORMAT "%9.7" ECU_ADDRESS 0x7F8BA8 /end MEASUREMENT
/begin MEASUREMENT CrCtl_st "Status FGR" UBYTE OneToOne 1 100 0.00 255.0 FORMAT "%5.1" ECU_ADDRESS 0x7F8839 /end MEASUREMENT
/begin MEASUREMENT CrCtl_stCAN "Status der CrCtl für CAN" UBYTE OneToOne 1 100 0.00 255.0 FORMAT "%5.1" ECU_ADDRESS 0x7F883B /end MEASUREMENT
/begin MEASUREMENT CrCtl_stCC "Status FGR" UBYTE OneToOne 1 100 0.00 255.0 FORMAT "%5.1" ECU_ADDRESS 0x7F883C /end MEASUREMENT
/begin MEASUREMENT CrCtl_stLampOut "Status der CrCtl-Lampe (wird über CAN versendet)" UBYTE OneToOne 1 100 0.00 255.0 FORMAT "%5.1" ECU_ADDRESS 0x7F883D /end MEASUREMENT
/begin MEASUREMENT CrCtl_stUpdateVMrk "Trigger zum senden der Botschaft" UBYTE OneToOne 1 100 0.00 255.0 FORMAT "%5.1" ECU_ADDRESS 0x7F883F /end MEASUREMENT
/begin MEASUREMENT CrCtl_stVCrCtl "Diagnosefreigabestatus für Anzeigegeschwindigkeit" UBYTE OneToOne 1 100 0.00 255.0 FORMAT "%5.1" ECU_ADDRESS 0x7F8840 /end MEASUREMENT
/begin MEASUREMENT CrCtl_stVDisp "Marke aus/ein" UBYTE OneToOne 1 100 0.00 255.0 FORMAT "%5.1" ECU_ADDRESS 0x7F8841 /end MEASUREMENT
/begin MEASUREMENT CrCtl_stVSetNew "neue Sollgeschwindigkeit aus Stufentempomat übernehmen" UBYTE OneToOne 1 100 0.00 255.0 FORMAT "%5.1" ECU_ADDRESS 0x7F8842 /end MEASUREMENT
/begin MEASUREMENT CrCtl_trqDT1_mp "DT1 Ausgang FGR" SWORD TrqPrp 1 100 -6553.600 6553.400 FORMAT "%8.3" ECU_ADDRESS 0x8FE59A /end MEASUREMENT
/begin MEASUREMENT CrCtl_trqI_mp "I-Anteil FGR" SWORD TrqPrp 1 100 -6553.600 6553.400 FORMAT "%8.3" ECU_ADDRESS 0x8FE59C /end MEASUREMENT
/begin MEASUREMENT CrCtl_trqMax_mp "Maximales Moment FGR" SWORD TrqPrp 1 100 -6553.600 6553.400 FORMAT "%8.3" ECU_ADDRESS 0x8FE59E /end MEASUREMENT
/begin MEASUREMENT CrCtl_trqP_mp "P-Anteil der Fahrgeschwindigkeits PI-Regelung" SWORD TrqPrp 1 100 -6553.600 6553.400 FORMAT "%8.3" ECU_ADDRESS 0x8FE5A0 /end MEASUREMENT
/begin MEASUREMENT CrCtl_vAlwMax "Obere Grenze für FGR-Sollgeschwindigkeit" SWORD Vel 1 100 0.00 300.0000 FORMAT "%8.4" ECU_ADDRESS 0x7F8BAE /end MEASUREMENT
/begin MEASUREMENT CrCtl_vAlwMin "min. mögliche Setzgeschwindigkeit" SWORD Vel 1 100 0.00 300.0000 FORMAT "%8.4" ECU_ADDRESS 0x7F8BB0 /end MEASUREMENT
/begin MEASUREMENT CrCtl_vBeg "FGR: Fahrgeschwindigkeit am Anfang von EIN+, EIN- und WA" SWORD Vel 1 100 0.00 300.0000 FORMAT "%8.4" ECU_ADDRESS 0x7F8BB2 /end MEASUREMENT
/begin MEASUREMENT CrCtl_vCurr "Fahrzeuggeschwindigkeit für FGR" SWORD Vel 1 100 0.00 300.0000 FORMAT "%8.4" ECU_ADDRESS 0x7F8BB4 /end MEASUREMENT
/begin MEASUREMENT CrCtl_vDes "Sollgeschwindigkeit FGR" SWORD Vel 1 100 0.00 300.0000 FORMAT "%8.4" ECU_ADDRESS 0x7F8BB6 /end MEASUREMENT
/begin MEASUREMENT CrCtl_vDesDisp "aktuelle Zielgeschwindigkeit STUT" SWORD Vel 1 100 0.00 300.0000 FORMAT "%8.4" ECU_ADDRESS 0x7F8BB8 /end MEASUREMENT
/begin MEASUREMENT CrCtl_vDiffRed_mp "Geschwindigkeitsdifferenz für Abflachungskennlinie" SWORD Vel 1 100 -327.6800 327.6700 FORMAT "%8.4" ECU_ADDRESS 0x8FE5A2 /end MEASUREMENT
/begin MEASUREMENT CrCtl_vDiff_mp "FGR: | CrCtl_vDes - CrCtl_vBeg |, Differenz V_SOLL und v bei Anfang EIN+, EIN- und WA" SWORD Vel 1 100 -327.6800 327.6700 FORMAT "%8.4" ECU_ADDRESS 0x8FE5A4 /end MEASUREMENT
/begin MEASUREMENT CrCtl_vDispOffset "Abweichung Anzeigegeschwindigkeit - gef. Messgeschwindigkeit" SWORD Vel 1 100 0.00 300.0000 FORMAT "%8.4" ECU_ADDRESS 0x7F8BBA /end MEASUREMENT
/begin MEASUREMENT CrCtl_vMrk1 "v-Marke 1 für Botschaft" SWORD Vel 1 100 0.00 300.0000 FORMAT "%8.4" ECU_ADDRESS 0x7F8BBC /end MEASUREMENT
/begin MEASUREMENT CrCtl_vMrk2 "v-Marke für 2 Botschaft" SWORD Vel 1 100 0.00 300.0000 FORMAT "%8.4" ECU_ADDRESS 0x7F8BBE /end MEASUREMENT
/begin MEASUREMENT CrCtl_vMrk3 "v-Marke 3 für Botschaft" SWORD Vel 1 100 0.00 300.0000 FORMAT "%8.4" ECU_ADDRESS 0x7F8BC0 /end MEASUREMENT
/begin MEASUREMENT CrCtl_vRmp "Rampenzielgeschwindigkeit FGR" SWORD Vel 1 100 0.00 300.0000 FORMAT "%8.4" ECU_ADDRESS 0x7F8BC2 /end MEASUREMENT
/begin MEASUREMENT CrCtl_vSetNew "neue Sollgeschwindigkeit aus Stufentempomat" SWORD Vel 1 100 0.00 300.0000 FORMAT "%8.4" ECU_ADDRESS 0x7F8BC4 /end MEASUREMENT
/begin MEASUREMENT CrSCD_dSegMisf "Verschiebung Segmentsystem für Aussetzererkennung" SBYTE OneToOne 1 100 -128.0 127.0 FORMAT "%5.1" ECU_ADDRESS 0x7F8843 /end MEASUREMENT
/begin MEASUREMENT CrSCD_incNextIntDelta_mp "Anzahl der Inkrements bis zum nächsten statischen  Interrupt" SWORD OneToOne 1 100 -32768.00 32767.00 FORMAT "%8.2" ECU_ADDRESS 0x8FE5C0 /end MEASUREMENT
/begin MEASUREMENT CrSCD_incNextInt_mp "Anzahl der Inkrements bis zum nächsten statischen  Interrupt" SBYTE OneToOne 1 100 -128.0 127.0 FORMAT "%5.1" ECU_ADDRESS 0x8FE5C2 /end MEASUREMENT
/begin MEASUREMENT CrSCD_nAvrg "gemittelte Kurbelwellendrehzahl des letzten und vorletzten segmentes" SWORD EngN 1 100 -32768.00 32767.00 FORMAT "%8.2" ECU_ADDRESS 0x7F8BC6 /end MEASUREMENT
/begin MEASUREMENT CrSCD_nAvrgHiRes "Gemittelte hochauflösende Drehzahl" SLONG EngN_HiRes 1 100 -268435456.000 268435455.875 FORMAT "%13.3" ECU_ADDRESS 0x7F9164 /end MEASUREMENT
/begin MEASUREMENT CrSCD_nCurr "aktuelle Motordrehzahl aus der letzten Segmentperiode" SWORD EngN 1 100 -32768.00 32767.00 FORMAT "%8.2" ECU_ADDRESS 0x7F8BC8 /end MEASUREMENT
/begin MEASUREMENT CrSCD_nCurrHiRes "Aktuelle hochauflösende Drehzahl" SLONG EngN_HiRes 1 100 -268435456.000 268435455.875 FORMAT "%13.3" ECU_ADDRESS 0x7F9168 /end MEASUREMENT
/begin MEASUREMENT CrSCD_nDyn "aktuelle Motordrehzahl mit Filter für Segment der Dekompressionsphase" SWORD EngN 1 100 -32768.00 32767.00 FORMAT "%8.2" ECU_ADDRESS 0x7F8BCA /end MEASUREMENT
/begin MEASUREMENT CrSCD_nHold "aktuelle Motordrehzahl des vorletzten Segmentes" SWORD EngN 1 100 -32768.00 32767.00 FORMAT "%8.2" ECU_ADDRESS 0x7F8BCC /end MEASUREMENT
/begin MEASUREMENT CrSCD_nIncr "Motordrehzahl aus Inkrementperiode" SWORD EngN 1 100 -32768.00 32767.00 FORMAT "%8.2" ECU_ADDRESS 0x7F8BCE /end MEASUREMENT
/begin MEASUREMENT CrSCD_nMisf "Drehzahlsignal für ODB-Zündaussetzererkennung" SWORD EngN 1 100 -32768.00 32767.00 FORMAT "%8.2" ECU_ADDRESS 0x7F8BD0 /end MEASUREMENT
/begin MEASUREMENT CrSCD_numSeg "aktuelle Segmentnummer  (Segment 0 ist bei OT 1)" UBYTE OneToOne 1 100 0.00 255.0 FORMAT "%5.1" ECU_ADDRESS 0x7F8844 /end MEASUREMENT
/begin MEASUREMENT CrSCD_phiCurr_mp "Aktueller Winkel basierent auf dem Inkrementsystem" SWORD AngleCrS 1 100 -768.0000 767.9766 FORMAT "%8.4" ECU_ADDRESS 0x8FE5C4 /end MEASUREMENT
/begin MEASUREMENT CrSCD_phiIncCor "aktuelle Phasenkorrektur des Inkrementsystems der Kurbelwelle" SWORD AngleCrS 1 100 -768.0000 767.9766 FORMAT "%8.4" ECU_ADDRESS 0x7F8BD2 /end MEASUREMENT
/begin MEASUREMENT CrSCD_phiIncr "Winkel eines Inkrements in Grad Kurbelwelle" SWORD AngleCrS 1 100 -768.0000 767.9766 FORMAT "%8.4" ECU_ADDRESS 0x7F8BD4 /end MEASUREMENT
/begin MEASUREMENT CrSCD_phiSegGrid_mp "Berechnete Drehzahlsegmentlänge" SWORD AngleCrS 1 100 -768.0000 767.9766 FORMAT "%8.4" ECU_ADDRESS 0x8FE5C6 /end MEASUREMENT
/begin MEASUREMENT CrSCD_stIncErr_mp "Fehlerstatus des Inkrementgebersignals (Signalstöhrungen, Frequenzstatus, Inkrementpufferstatus)" UBYTE OneToOne 1 100 0.00 255.0 FORMAT "%5.1" ECU_ADDRESS 0x8FE5C8 /end MEASUREMENT
/begin MEASUREMENT CrSCD_stIncSig_mp "Status des Inkrementgeber Signalauswertung (Plausibilisierung der Zahnflankenzeiten und -anzahl)" UBYTE OneToOne 1 100 0.00 255.0 FORMAT "%5.1" ECU_ADDRESS 0x8FE5C9 /end MEASUREMENT
/begin MEASUREMENT CrSCD_stIncSyncInc_mp "Synchronisationsstatus des Inkrementgebersignals nach Aufruf von CrSCD_UpdPos (Intern, Debugging)" UBYTE OneToOne 1 100 0.00 255.0 FORMAT "%5.1" ECU_ADDRESS 0x8FE5CA /end MEASUREMENT
/begin MEASUREMENT CrSCD_stIncSyncPhase_mp "Synchronisationsstatus des Inkrementgebersignals nach Aufruf von CaSCD_GetPos (Intern, Debugging)" UBYTE OneToOne 1 100 0.00 255.0 FORMAT "%5.1" ECU_ADDRESS 0x8FE5CB /end MEASUREMENT
/begin MEASUREMENT CrSCD_tiIncr "aktuelle Inkrementperiode (1 Inkrement = Winkelbereich aus 360°KW/CrSCD_ctIncs_C, Abtastung = 2ms)" UWORD TimeDT 1 100 0.00 65535.00 FORMAT "%8.2" ECU_ADDRESS 0x7F8BD6 /end MEASUREMENT
/begin MEASUREMENT CrSCD_tiSeg "aktuelle Segmentperiode (1 Segment = Winkelbereich der über CrSCD_phiSeg_C appliziert ist, Abtastung = n-sync.)" ULONG Per_Dur 1 100 0.00 4294967295.00 FORMAT "%13.2" ECU_ADDRESS 0x7F916C /end MEASUREMENT
/begin MEASUREMENT CrS_ctInjStrt_mp "Anzahl der durchgeführten Testeinspritzungen" UWORD OneToOne 1 100 0.00 65535.00 FORMAT "%8.2" ECU_ADDRESS 0x8FE5AA /end MEASUREMENT
/begin MEASUREMENT CrS_facSegTime_mp "Verhältnis der Segmentzeiten" SLONG Fact1 1 100 -16777216.0000 16777215.9922 FORMAT "%13.4" ECU_ADDRESS 0x8FE5AC /end MEASUREMENT
/begin MEASUREMENT CrS_numTDCStrtLst_mp "Zeigt den Zylinder an, in den als letztes eingespritzt wurde" UWORD OneToOne 1 100 0.00 65535.00 FORMAT "%8.2" ECU_ADDRESS 0x8FE5B0 /end MEASUREMENT
/begin MEASUREMENT CrS_numTDCStrt_mp "Zeigt die Zylinder an, in die bereits eingespritzt wurde" UWORD OneToOne 1 100 0.00 65535.00 FORMAT "%8.2" ECU_ADDRESS 0x8FE5B2 /end MEASUREMENT
/begin MEASUREMENT CrS_stStrt_mp "Messpunkt für Zustandsautomat" UBYTE OneToOne 1 100 0.00 255.0 FORMAT "%5.1" ECU_ADDRESS 0x8FE5B4 /end MEASUREMENT
/begin MEASUREMENT CrS_tiSegOld_mp "Segmentzeit vor einer Testeinspritzung" SLONG Per_Dur 1 100 -2147483648.00 2147483647.00 FORMAT "%13.2" ECU_ADDRESS 0x8FE5B8 /end MEASUREMENT
/begin MEASUREMENT CrS_tiSeg_mp "Segmentzeit nach einer Testeinspritzung" SLONG Per_Dur 1 100 -2147483648.00 2147483647.00 FORMAT "%13.2" ECU_ADDRESS 0x8FE5BC /end MEASUREMENT
/begin MEASUREMENT ctblink "Zeitzähler für Blinken der Markenanzeige" UBYTE t20msxs_ub_b5p1 1 100 0.00 5.100 FORMAT "%5.3" ECU_ADDRESS 0x7F89CC /end MEASUREMENT
/begin MEASUREMENT CTSCD_dtClnt "Wechselrate der Kuehlwassertemperatur" SWORD TempCels_100ms 1 100 -32768.00 32767.00 FORMAT "%8.2" ECU_ADDRESS 0x7F8AE6 /end MEASUREMENT
/begin MEASUREMENT CTSCD_stErrIni "Fehlerstatus ADC Kanal Kühlwassertemperatur während SG-Hochlauf" UBYTE OneToOne 1 100 0.00 255.0 FORMAT "%5.1" ECU_ADDRESS 0x7F87FB /end MEASUREMENT
/begin MEASUREMENT CTSCD_stPHtr "Heater Temperature status" UBYTE OneToOne 1 100 0.00 255.0 FORMAT "%5.1" ECU_ADDRESS 0x7F87FC /end MEASUREMENT
/begin MEASUREMENT CTSCD_stRmp_mp "Zustandsinformation aktiver Rampensteigungsparametersatz" UBYTE OneToOne 1 100 0.00 255.0 FORMAT "%5.1" ECU_ADDRESS 0x8FE5CC /end MEASUREMENT
/begin MEASUREMENT CTSCD_swtSig "Wassertemperatur über CAN oder ADC" UBYTE OneToOne 1 100 0.00 255.0 FORMAT "%5.1" ECU_ADDRESS 0x7F87FD /end MEASUREMENT
/begin MEASUREMENT CTSCD_tClnt "Kühlmitteltemperatur" SWORD Temp_Cels 1 100 -50.140 899.860 FORMAT "%8.3" ECU_ADDRESS 0x7F8AE8 /end MEASUREMENT
/begin MEASUREMENT CTSCD_tClntLin "linearisierter Wert aus HWK vorm Aufruf der Übergangsfunktion" SWORD Temp_Cels 1 100 -50.140 899.860 FORMAT "%8.3" ECU_ADDRESS 0x7F8AEA /end MEASUREMENT
/begin MEASUREMENT CTSCD_tClntP "Coolant Temperature Before correction" SWORD Temp_Cels 1 100 -50.140 899.860 FORMAT "%8.3" ECU_ADDRESS 0x7F8AEC /end MEASUREMENT
/begin MEASUREMENT CTSCD_uRaw "Wassertemperatur Spannungsrohwert" SWORD Volt 1 100 -160156.4 160151.5 FORMAT "%8.1" ECU_ADDRESS 0x7F8AEE /end MEASUREMENT
/begin MEASUREMENT CycSigCheck_stTest "cycsigcheck Status Bit0: 0/1 Prog/Data; Bit1: falsche Sig erkennen; Bit2: Zyklus kompl.; Bit3: shoff requ.; Bit4/5: Prog/Data OK" UBYTE OneToOne 1 100 0.00 255.0 FORMAT "%5.1" ECU_ADDRESS 0x7F8845 /end MEASUREMENT
/begin MEASUREMENT DCC_nDvthires_mp "Regelabweichung Drehzahlregelung DCC mit höhere Auflösung" SWORD EngN_HiRes 1 100 -4096.000 4095.875 FORMAT "%8.3" ECU_ADDRESS 0x8FE5CE /end MEASUREMENT
/begin MEASUREMENT DCC_nDvt_mp "Regelabweichung Drehzahlregelung DCC" SWORD EngN 1 100 -32768.00 32767.00 FORMAT "%8.2" ECU_ADDRESS 0x8FE5D0 /end MEASUREMENT
/begin MEASUREMENT DCC_nSetPointRaw_mp "Roherwert Sollwert Drehzahlregelung DCC" SWORD EngN 1 100 -32768.00 32767.00 FORMAT "%8.2" ECU_ADDRESS 0x8FE5D2 /end MEASUREMENT
/begin MEASUREMENT DCC_nSetPoint_mp "Sollwert Drehzahlregelung DCC" SWORD EngN 1 100 -32768.00 32767.00 FORMAT "%8.2" ECU_ADDRESS 0x8FE5D4 /end MEASUREMENT
/begin MEASUREMENT DCC_nShft_mp "Motordrehzahl freezed während der Gangschaltungen" SWORD EngN 1 100 -32768.00 32767.00 FORMAT "%8.2" ECU_ADDRESS 0x8FE5D6 /end MEASUREMENT
/begin MEASUREMENT DCC_nWheel_mp "Fahrzeugraddrehzahl" SWORD WheelN 1 100 -32768.00 32767.00 FORMAT "%8.2" ECU_ADDRESS 0x8FE5D8 /end MEASUREMENT
/begin MEASUREMENT DCC_rTransDTNext_mp "Uebersetzungverhaeltnis des wahrscheinlichen Zielganges" SWORD TransR 1 100 -327.6800 327.6700 FORMAT "%8.4" ECU_ADDRESS 0x8FE5DA /end MEASUREMENT
/begin MEASUREMENT DCC_stAckEngDCC "Status Quittierung Antreibstrang" UBYTE OneToOne 1 100 0.00 255.0 FORMAT "%5.1" ECU_ADDRESS 0x7F8846 /end MEASUREMENT
/begin MEASUREMENT DCC_stActive "Radmoment-Anforderung aktiv" UBYTE OneToOne 1 100 0.00 255.0 FORMAT "%5.1" ECU_ADDRESS 0x7F8847 /end MEASUREMENT
/begin MEASUREMENT DCC_stBrkPressed_mp "Status der Bremse" UBYTE OneToOne 1 100 0.00 255.0 FORMAT "%5.1" ECU_ADDRESS 0x8FE5DC /end MEASUREMENT
/begin MEASUREMENT DCC_stCtlVel "Status regelung Geschwindigkeit" UBYTE OneToOne 1 100 0.00 255.0 FORMAT "%5.1" ECU_ADDRESS 0x7F8848 /end MEASUREMENT
/begin MEASUREMENT DCC_stDCC "Zustandautomat DCC" UBYTE OneToOne 1 100 0.00 255.0 FORMAT "%5.1" ECU_ADDRESS 0x7F8849 /end MEASUREMENT
/begin MEASUREMENT DCC_stError "Fehlerzustand in DCC" UBYTE OneToOne 1 100 0.00 255.0 FORMAT "%5.1" ECU_ADDRESS 0x7F884A /end MEASUREMENT
/begin MEASUREMENT DCC_stGearNext_mp "Wahrscheinlicher Zielgang" SBYTE OneToOne 1 100 -128.0 127.0 FORMAT "%5.1" ECU_ADDRESS 0x8FE5DD /end MEASUREMENT
/begin MEASUREMENT DCC_stGearOld_mp "Eingelegter Gang vor grip Verlust" SBYTE OneToOne 1 100 -128.0 127.0 FORMAT "%5.1" ECU_ADDRESS 0x8FE5DE /end MEASUREMENT
/begin MEASUREMENT DCC_stRecDCC "Status ob DCC im fahrzeug verbaut ist" UBYTE OneToOne 1 100 0.00 255.0 FORMAT "%5.1" ECU_ADDRESS 0x7F884B /end MEASUREMENT
/begin MEASUREMENT DCC_stRls "Status freigabe DCC Eingriff" UBYTE OneToOne 1 100 0.00 255.0 FORMAT "%5.1" ECU_ADDRESS 0x7F884C /end MEASUREMENT
/begin MEASUREMENT DCC_stRlsMT_mp "Status freigabe DCC Eingriff fuer Handschalter" UBYTE OneToOne 1 100 0.00 255.0 FORMAT "%5.1" ECU_ADDRESS 0x8FE5DF /end MEASUREMENT
/begin MEASUREMENT DCC_swtPosAT_mp "Rampenschalterstellung Automatik" UBYTE OneToOne 1 100 0.00 255.0 FORMAT "%5.1" ECU_ADDRESS 0x8FE5E0 /end MEASUREMENT
/begin MEASUREMENT DCC_swtPosBrk_mp "Rampenschalterstellung im Ueberwachung des DCC-Moment" UBYTE OneToOne 1 100 0.00 255.0 FORMAT "%5.1" ECU_ADDRESS 0x8FE5E1 /end MEASUREMENT
/begin MEASUREMENT DCC_swtPosES_mp "Rampenschalterstellung drehzahlregelung" UBYTE OneToOne 1 100 0.00 255.0 FORMAT "%5.1" ECU_ADDRESS 0x8FE5E2 /end MEASUREMENT
/begin MEASUREMENT DCC_swtPosMT_mp "Rampenschalterstellung Handschalter" UBYTE OneToOne 1 100 0.00 255.0 FORMAT "%5.1" ECU_ADDRESS 0x8FE5E3 /end MEASUREMENT
/begin MEASUREMENT DCC_trqDes "Wunschmoment DCC" SWORD TrqPrp 1 100 -6553.600 6553.400 FORMAT "%8.3" ECU_ADDRESS 0x7F8BD8 /end MEASUREMENT
/begin MEASUREMENT DCC_trqDesDCCFlt_mp "PT1 gefilterter Werte Moment-Anforderung ueber Can" SWORD TrqPrp 1 100 -6553.600 6553.400 FORMAT "%8.3" ECU_ADDRESS 0x8FE5E4 /end MEASUREMENT
/begin MEASUREMENT DCC_trqDesDCCMT_mp "DCC Wunschmoment fuer Handschalter" SWORD TrqPrp 1 100 -6553.600 6553.400 FORMAT "%8.3" ECU_ADDRESS 0x8FE5E6 /end MEASUREMENT
/begin MEASUREMENT DCC_trqEngSpdRaw_mp "Drehmoment Drehzahlregler - Rohwert" SWORD Trq 1 100 -3276.800 3276.700 FORMAT "%8.3" ECU_ADDRESS 0x8FE5E8 /end MEASUREMENT
/begin MEASUREMENT DCC_trqEngSpd_mp "Drehmoment Drehzahlregler" SWORD TrqPrp 1 100 -6553.600 6553.400 FORMAT "%8.3" ECU_ADDRESS 0x8FE5EA /end MEASUREMENT
/begin MEASUREMENT DCC_trqIEngSpd_mp "I-Anteil Drehzahlregler" SWORD Trq 1 100 -3276.800 3276.700 FORMAT "%8.3" ECU_ADDRESS 0x8FE5EC /end MEASUREMENT
/begin MEASUREMENT DCC_trqIInit_mp "Initialisierungswert fuer Motordrehzahlregler" SWORD Trq 1 100 -3276.800 3276.700 FORMAT "%8.3" ECU_ADDRESS 0x8FE5EE /end MEASUREMENT
/begin MEASUREMENT DCC_trqPEngSpd_mp "P-Anteil Drehzahlregler" SWORD Trq 1 100 -3276.800 3276.700 FORMAT "%8.3" ECU_ADDRESS 0x8FE5F0 /end MEASUREMENT
/begin MEASUREMENT DCC_trqRaw "Rohwert Radmoment" SWORD TrqPrp 1 100 -6553.600 6553.400 FORMAT "%8.3" ECU_ADDRESS 0x7F8BDA /end MEASUREMENT
/begin MEASUREMENT DCC_trqRaw_mp "Rohwert Radmoment" SWORD TrqPrp 1 100 -6553.600 6553.400 FORMAT "%8.3" ECU_ADDRESS 0x8FE5F2 /end MEASUREMENT
/begin MEASUREMENT DCC_trqsaveStI_mp "Vorhergehender Wert des I-Zustandes des Motordrehzahlreglers" SWORD Trq 1 100 -3276.800 3276.700 FORMAT "%8.3" ECU_ADDRESS 0x8FE5F4 /end MEASUREMENT
/begin MEASUREMENT DCC_trqShft_mp "Drehmoment zur Initialisierung des Drehzahl Reglers" SWORD Trq 1 100 -3276.800 3276.700 FORMAT "%8.3" ECU_ADDRESS 0x8FE5F6 /end MEASUREMENT
/begin MEASUREMENT DCC_trqStI_mp "Anwesender Wert des I-Zustandes des Motordrehzahlreglers" SWORD Trq 1 100 -3276.800 3276.700 FORMAT "%8.3" ECU_ADDRESS 0x8FE5F8 /end MEASUREMENT
/begin MEASUREMENT DCC_vConv_mp "Fahrgeschwindigkeit (metres/min)" SLONG Vel_mpm 1 100 -21474836.4800 21474836.4700 FORMAT "%13.4" ECU_ADDRESS 0x8FE5FC /end MEASUREMENT
/begin MEASUREMENT DrvTrn_rFlatTransDT "Zugverhältnis für flache Drehkraftstruktur fahren" SWORD TransR 1 100 -327.6800 327.6700 FORMAT "%8.4" ECU_ADDRESS 0x7F8BE8 /end MEASUREMENT
/begin MEASUREMENT DrvTrn_rTransDT "Triebstrang-Übersetzung (Radmoment pro Motormoment)" SWORD TransR 1 100 -327.6800 327.6700 FORMAT "%8.4" ECU_ADDRESS 0x7F8BEA /end MEASUREMENT
/begin MEASUREMENT DrvTrn_rTransDTact_mp "aktueller Wert der Triebstrangübersetzung" SWORD TransR 1 100 -327.6800 327.6700 FORMAT "%8.4" ECU_ADDRESS 0x8FE600 /end MEASUREMENT
/begin MEASUREMENT DrvTrn_rTransDTRmpIn_mp "Input to the ramp for delaying torque requests" SWORD TransR 1 100 -327.6800 327.6700 FORMAT "%8.4" ECU_ADDRESS 0x8FE602 /end MEASUREMENT
/begin MEASUREMENT DSC_stTstTrigger_mp "Zustand Testeranforderung an DSM Scheduler" UBYTE OneToOne 1 100 0.00 255.0 FORMAT "%5.1" ECU_ADDRESS 0x8FE604 /end MEASUREMENT
/begin MEASUREMENT dvmark_w "Mindestabstand von Geschwindigkeitsmarken beim Stufentempomat" UWORD Vel 1 100 0.00 655.3500 FORMAT "%8.4" ECU_ADDRESS 0x7F90EA /end MEASUREMENT
/begin MEASUREMENT dvprg_w "Schrittweite bei Anzeige der Regelgeschwindigkeit im Programmiermodus" UWORD Vel 1 100 0.00 655.3500 FORMAT "%8.4" ECU_ADDRESS 0x7F90EC /end MEASUREMENT
/begin MEASUREMENT dvstutom_w "Schrittweite für Verstellung der Zielgeschwindigkeit ohne programmierte Marken" UWORD Vel 1 100 0.00 655.3500 FORMAT "%8.4" ECU_ADDRESS 0x7F90EE /end MEASUREMENT
/begin MEASUREMENT mmimrk_w "ported from ME9" UWORD Vel 1 100 0.00 655.3500 FORMAT "%8.4" ARRAY_SIZE 15 ECU_ADDRESS 0x7F934C /end MEASUREMENT
/begin MEASUREMENT mrknrc "Nummer veränderte Geschwindigkeits-Marke für schnelle CAN- Übertragung" UBYTE dez 1 100 0.00 255.0 FORMAT "%5.1" ECU_ADDRESS 0x7F89CE /end MEASUREMENT
/begin MEASUREMENT mrknrcan "Nummer Geschwindigkeits-Marken Stufentempomat f ür CAN- Übertragung" UBYTE dez 1 100 0.00 255.0 FORMAT "%5.1" ARRAY_SIZE 15 ECU_ADDRESS 0x7F932E /end MEASUREMENT
/begin MEASUREMENT mrknrint "Nummer Geschwindigkeits-Marken Stufentempomat intern" UBYTE dez 1 100 0.00 255.0 FORMAT "%5.1" ARRAY_SIZE 15 ECU_ADDRESS 0x7F933D /end MEASUREMENT
/begin MEASUREMENT mrkstut_w "Geschwindigkeits-Marken Stufentempomat" UWORD Vel 1 100 0.00 655.3500 FORMAT "%8.4" ARRAY_SIZE 15 ECU_ADDRESS 0x7F936A /end MEASUREMENT
/begin MEASUREMENT statvza "Status Zielgeschwindigkeit für Kombi-Anzeige Stufentempomat" UBYTE dez 1 100 0.00 255.0 FORMAT "%5.1" ECU_ADDRESS 0x7F89D3 /end MEASUREMENT
/begin MEASUREMENT vfgr_w "Fahrzeug-Ist-Geschwindigkeit für FGR" UWORD Vel 1 100 0.00 655.3500 FORMAT "%8.4" ECU_ADDRESS 0x7F90F2 /end MEASUREMENT
/begin MEASUREMENT vreglmax_w "Maximal zulässige Sollgeschwindigkeit für FGR" UWORD Vel 1 100 0.00 655.3500 FORMAT "%8.4" ECU_ADDRESS 0x7F90FA /end MEASUREMENT
/begin MEASUREMENT vreglmin_w "minimal zulässige Sollgeschwindigkeit für FGR" UWORD Vel 1 100 0.00 655.3500 FORMAT "%8.4" ECU_ADDRESS 0x7F90FC /end MEASUREMENT
/begin MEASUREMENT vzielakvp_w "Variable für Zielgeschwindigkeit im Kombi" UWORD Vel 1 100 0.00 655.3500 FORMAT "%8.4" ECU_ADDRESS 0x7F9102 /end MEASUREMENT
/begin MEASUREMENT vzielak_w "Zielgeschwindigkeit für Kombi-Anzeige Stufentempomat" UWORD Vel 1 100 0.00 655.3500 FORMAT "%8.4" ECU_ADDRESS 0x7F9100 /end MEASUREMENT
/begin MEASUREMENT vziels_w "Berechnete Soll-Zielgeschwindigkeit für FGR" UWORD Vel 1 100 0.00 655.3500 FORMAT "%8.4" ECU_ADDRESS 0x7F9104 /end MEASUREMENT
/begin MEASUREMENT vziel_w "Zielgeschwindigkeit für FGR" UWORD Vel 1 100 0.00 655.3500 FORMAT "%8.4" ECU_ADDRESS 0x7F90FE /end MEASUREMENT
/begin FUNCTION crctl_updatedem "FGR-Anforderungen Update (Abschalten + Regler)"
 /begin DEF_CHARACTERISTIC CrCtl_aAccLim_C CrCtl_AccGear2PKp_C CrCtl_AccGear2PKpPos_C CrCtl_AccGear2PKpNeg_C CrCtl_vAccGear2PWinPos_C CrCtl_vAccGear2PWinNeg_C CrCtl_AccGear3PKp_C CrCtl_AccGear3PKpPos_C CrCtl_AccGear3PKpNeg_C CrCtl_vAccGear3PWinPos_C CrCtl_vAccGear3PWinNeg_C CrCtl_AccGear4PKp_C CrCtl_AccGear4PKpPos_C CrCtl_AccGear4PKpNeg_C CrCtl_vAccGear4PWinPos_C CrCtl_vAccGear4PWinNeg_C CrCtl_AccGear5PKp_C CrCtl_AccGear5PKpPos_C CrCtl_AccGear5PKpNeg_C CrCtl_vAccGear5PWinPos_C CrCtl_vAccGear5PWinNeg_C CrCtl_AccGear6PKp_C CrCtl_AccGear6PKpPos_C CrCtl_AccGear6PKpNeg_C CrCtl_vAccGear6PWinPos_C CrCtl_vAccGear6PWinNeg_C CrCtl_aDeclLim_C CrCtl_ctMaxTip_C CrCtl_DeclGear2PKp_C CrCtl_DeclGear2PKpPos_C CrCtl_DeclGear2PKpNeg_C CrCtl_vDeclGear2PWinPos_C CrCtl_vDeclGear2PWinNeg_C CrCtl_DeclGear3PKp_C CrCtl_DeclGear3PKpPos_C CrCtl_DeclGear3PKpNeg_C CrCtl_vDeclGear3PWinPos_C CrCtl_vDeclGear3PWinNeg_C CrCtl_DeclGear4PKp_C CrCtl_DeclGear4PKpPos_C CrCtl_DeclGear4PKpNeg_C CrCtl_vDeclGear4PWinPos_C CrCtl_vDeclGear4PWinNeg_C CrCtl_DeclGear5PKp_C CrCtl_DeclGear5PKpPos_C CrCtl_DeclGear5PKpNeg_C CrCtl_vDeclGear5PWinPos_C CrCtl_vDeclGear5PWinNeg_C CrCtl_DeclGear6PKp_C CrCtl_DeclGear6PKpPos_C CrCtl_DeclGear6PKpNeg_C CrCtl_vDeclGear6PWinPos_C CrCtl_vDeclGear6PWinNeg_C CrCtl_dtrqAccDwn_C CrCtl_dtrqDeclUp_C CrCtl_dtrqOffComf1_C CrCtl_dtrqOffComf2_C CrCtl_dtrqOffFast1_CUR CrCtl_dtrqOffFast2_CUR CrCtl_dtrqOffFast3_CUR CrCtl_dvAccFDCG3_CUR CrCtl_dvAccFDCG4_CUR CrCtl_dvAccFDCG5_CUR CrCtl_dvAccFDCG6_CUR CrCtl_dvAccG3_CUR CrCtl_dvAccG4_CUR CrCtl_dvAccG5_CUR CrCtl_dvAccG6_CUR CrCtl_dvDeclFDCG3_CUR CrCtl_dvDeclFDCG4_CUR CrCtl_dvDeclFDCG5_CUR CrCtl_dvDeclFDCG6_CUR CrCtl_dvDeclG3_CUR CrCtl_dvDeclG4_CUR CrCtl_dvDeclG5_CUR CrCtl_dvDeclG6_CUR CrCtl_dvResAbvFDCG3_CUR CrCtl_dvResAbvFDCG4_CUR CrCtl_dvResAbvFDCG5_CUR CrCtl_dvResAbvFDCG6_CUR CrCtl_dvResAbvG3_MAP CrCtl_dvResAbvG4_MAP CrCtl_dvResAbvG5_MAP CrCtl_dvResAbvG6_MAP CrCtl_dvResBlwFDCG3_CUR CrCtl_dvResBlwFDCG4_CUR CrCtl_dvResBlwFDCG5_CUR CrCtl_dvResBlwFDCG6_CUR CrCtl_dvResBlwG3_MAP CrCtl_dvResBlwG4_MAP CrCtl_dvResBlwG5_MAP CrCtl_dvResBlwG6_MAP CrCtl_facIncSlope_CUR CrCtl_facPropAcc_C CrCtl_facPropDecl_C CrCtl_facRedDecl_C CrCtl_facRedHi_C CrCtl_facRedLo_C CrCtl_facResAbvFDC_CUR CrCtl_facResAbv_CUR CrCtl_facResBlwFDC_CUR CrCtl_facResBlw_CUR CrCtl_facRmpRes_C CrCtl_HoldGear2IKi_C CrCtl_HoldGear2IKiPos_C CrCtl_HoldGear2IKiNeg_C CrCtl_vHoldGear2IWinPos_C CrCtl_vHoldGear2IWinNeg_C CrCtl_HoldGear2PKp_C CrCtl_HoldGear2PKpPos_C CrCtl_HoldGear2PKpNeg_C CrCtl_vHoldGear2PWinPos_C CrCtl_vHoldGear2PWinNeg_C CrCtl_HoldGear3IKi_C CrCtl_HoldGear3IKiPos_C CrCtl_HoldGear3IKiNeg_C CrCtl_vHoldGear3IWinPos_C CrCtl_vHoldGear3IWinNeg_C CrCtl_HoldGear3PKp_C CrCtl_HoldGear3PKpPos_C CrCtl_HoldGear3PKpNeg_C CrCtl_vHoldGear3PWinPos_C CrCtl_vHoldGear3PWinNeg_C CrCtl_HoldGear4IKi_C CrCtl_HoldGear4IKiPos_C CrCtl_HoldGear4IKiNeg_C CrCtl_vHoldGear4IWinPos_C CrCtl_vHoldGear4IWinNeg_C CrCtl_HoldGear4PKp_C CrCtl_HoldGear4PKpPos_C CrCtl_HoldGear4PKpNeg_C CrCtl_vHoldGear4PWinPos_C CrCtl_vHoldGear4PWinNeg_C CrCtl_HoldGear5IKi_C CrCtl_HoldGear5IKiPos_C CrCtl_HoldGear5IKiNeg_C CrCtl_vHoldGear5IWinPos_C CrCtl_vHoldGear5IWinNeg_C CrCtl_HoldGear5PKp_C CrCtl_HoldGear5PKpPos_C CrCtl_HoldGear5PKpNeg_C CrCtl_vHoldGear5PWinPos_C CrCtl_vHoldGear5PWinNeg_C CrCtl_HoldGear6IKi_C CrCtl_HoldGear6IKiPos_C CrCtl_HoldGear6IKiNeg_C CrCtl_vHoldGear6IWinPos_C CrCtl_vHoldGear6IWinNeg_C CrCtl_HoldGear6PKp_C CrCtl_HoldGear6PKpPos_C CrCtl_HoldGear6PKpNeg_C CrCtl_vHoldGear6PWinPos_C CrCtl_vHoldGear6PWinNeg_C CrCtl_tiResAbvGear2DT1_C CrCtl_ResAbvGear2DT1Kd_C CrCtl_tiResAbvGear3DT1_C CrCtl_ResAbvGear3DT1Kd_C CrCtl_tiResAbvGear4DT1_C CrCtl_ResAbvGear4DT1Kd_C CrCtl_tiResAbvGear5DT1_C CrCtl_ResAbvGear5DT1Kd_C CrCtl_tiResAbvGear6DT1_C CrCtl_ResAbvGear6DT1Kd_C CrCtl_ResBlwGear2IKi_C CrCtl_ResBlwGear2IKiPos_C CrCtl_ResBlwGear2IKiNeg_C CrCtl_vResBlwGear2IWinPos_C CrCtl_vResBlwGear2IWinNeg_C CrCtl_ResBlwGear2PKp_C CrCtl_ResBlwGear2PKpPos_C CrCtl_ResBlwGear2PKpNeg_C CrCtl_vResBlwGear2PWinPos_C CrCtl_vResBlwGear2PWinNeg_C CrCtl_ResBlwGear3IKi_C CrCtl_ResBlwGear3IKiPos_C CrCtl_ResBlwGear3IKiNeg_C CrCtl_vResBlwGear3IWinPos_C CrCtl_vResBlwGear3IWinNeg_C CrCtl_ResBlwGear3PKp_C CrCtl_ResBlwGear3PKpPos_C CrCtl_ResBlwGear3PKpNeg_C CrCtl_vResBlwGear3PWinPos_C CrCtl_vResBlwGear3PWinNeg_C CrCtl_ResBlwGear4IKi_C CrCtl_ResBlwGear4IKiPos_C CrCtl_ResBlwGear4IKiNeg_C CrCtl_vResBlwGear4IWinPos_C CrCtl_vResBlwGear4IWinNeg_C CrCtl_ResBlwGear4PKp_C CrCtl_ResBlwGear4PKpPos_C CrCtl_ResBlwGear4PKpNeg_C CrCtl_vResBlwGear4PWinPos_C CrCtl_vResBlwGear4PWinNeg_C CrCtl_ResBlwGear5IKi_C CrCtl_ResBlwGear5IKiPos_C CrCtl_ResBlwGear5IKiNeg_C CrCtl_vResBlwGear5IWinPos_C CrCtl_vResBlwGear5IWinNeg_C CrCtl_ResBlwGear5PKp_C CrCtl_ResBlwGear5PKpPos_C CrCtl_ResBlwGear5PKpNeg_C CrCtl_vResBlwGear5PWinPos_C CrCtl_vResBlwGear5PWinNeg_C CrCtl_ResBlwGear6IKi_C CrCtl_ResBlwGear6IKiPos_C CrCtl_ResBlwGear6IKiNeg_C CrCtl_vResBlwGear6IWinPos_C CrCtl_vResBlwGear6IWinNeg_C CrCtl_ResBlwGear6PKp_C CrCtl_ResBlwGear6PKpPos_C CrCtl_ResBlwGear6PKpNeg_C CrCtl_vResBlwGear6PWinPos_C CrCtl_vResBlwGear6PWinNeg_C CrCtl_ResRmpGear2PKp_C CrCtl_ResRmpGear2PKpPos_C CrCtl_ResRmpGear2PKpNeg_C CrCtl_vResRmpGear2PWinPos_C CrCtl_vResRmpGear2PWinNeg_C CrCtl_ResRmpGear3PKp_C CrCtl_ResRmpGear3PKpPos_C CrCtl_ResRmpGear3PKpNeg_C CrCtl_vResRmpGear3PWinPos_C CrCtl_vResRmpGear3PWinNeg_C CrCtl_ResRmpGear4PKp_C CrCtl_ResRmpGear4PKpPos_C CrCtl_ResRmpGear4PKpNeg_C CrCtl_vResRmpGear4PWinPos_C CrCtl_vResRmpGear4PWinNeg_C CrCtl_ResRmpGear5PKp_C CrCtl_ResRmpGear5PKpPos_C CrCtl_ResRmpGear5PKpNeg_C CrCtl_vResRmpGear5PWinPos_C CrCtl_vResRmpGear5PWinNeg_C CrCtl_ResRmpGear6PKp_C CrCtl_ResRmpGear6PKpPos_C CrCtl_ResRmpGear6PKpNeg_C CrCtl_vResRmpGear6PWinPos_C CrCtl_vResRmpGear6PWinNeg_C CrCtl_swtResOff_C CrCtl_tiOff_C CrCtl_tiTipUpDn_C CrCtl_trqDesThres_C CrCtl_trqMaxOfs_C CrCtl_trqOffComf_C CrCtl_trqOffFast12_C CrCtl_trqOffFast23_C CrCtl_vAccSet_C CrCtl_vAlwDvtThres_C CrCtl_vDeclSet_C CrCtl_vDiffAccMax_C CrCtl_vDiffAcc_C CrCtl_vDiffDeclMax_C CrCtl_vDiffDecl_C CrCtl_vDiffResAbv_C CrCtl_vDiffResBlw_C CrCtl_vDvtNegTipDwn_C CrCtl_vDvtNegTipUp_C CrCtl_vDvtPosTipDwn_C CrCtl_vOfsDecl_C CrCtl_vOfsResBlw_C CrCtl_vOfsRes_C CrCtl_vRlsOfsI_C CrCtl_vTipStep_C /end DEF_CHARACTERISTIC
 /begin IN_MEASUREMENT CrCtl_vBeg CrCtl_vDiffRed_mp CrCtl_vDiff_mp Gearbx_stGear Rail_tiThresMonEna /end IN_MEASUREMENT
/end FUNCTION
/begin FUNCTION crctl_updatedem_msg ""
 /begin OUT_MEASUREMENT CrCtl_rVnBeg CrCtl_st CrCtl_stCAN CrCtl_stLampOut CrCtl_vBeg CrCtl_vDes CrCtl_vRmp /end OUT_MEASUREMENT
/end FUNCTION
/begin FUNCTION crctl_updatedem_uic ""
 /begin DEF_CHARACTERISTIC CrCtl_trqDes_Vector CrCtl_trqDes_Channel CrCtl_trqLead_Vector CrCtl_trqLead_Channel /end DEF_CHARACTERISTIC
 /begin OUT_MEASUREMENT CrCtl_dvAcc_mp CrCtl_dvDecl_mp CrCtl_dvResAbv_mp CrCtl_dvResBlw_mp CrCtl_trqDT1_mp CrCtl_trqI_mp CrCtl_trqMax_mp CrCtl_trqP_mp CrCtl_vDiffRed_mp CrCtl_vDiff_mp /end OUT_MEASUREMENT
/end FUNCTION
/begin FUNCTION crctl_vcrctl ""
 /begin DEF_CHARACTERISTIC CrCtl_DebToVCrCtlDef_C CrCtl_DebToVCrCtlOk_C CrCtl_rAccPedVelMin_C CrCtl_swtCrCtlType_C CrCtl_swtOffset_C CrCtl_swtVSSFil_C CrCtl_tiDisableDiagVCrCtl_C CrCtl_tiDispOffFil_C CrCtl_tiVSSFil_C CrCtl_uBattMin_C CrCtl_vAlwMaxKm_C CrCtl_vAlwMaxM_C CrCtl_vAlwMinKm_C CrCtl_vAlwMinM_C CrCtl_vOffMax_C /end DEF_CHARACTERISTIC
/end FUNCTION
/begin FUNCTION crctl_vcrctl_msg ""
 /begin OUT_MEASUREMENT CrCtl_stVCrCtl CrCtl_vAlwMax CrCtl_vAlwMin CrCtl_vCurr CrCtl_vDispOffset /end OUT_MEASUREMENT
/end FUNCTION
/begin FUNCTION crctl_vcrctl_uic "" /end FUNCTION
/begin FUNCTION crctl_vsetstep "Stufentempomat"
 /begin DEF_CHARACTERISTIC ANZMRKAUS ANZMRKMX CWBGSTUT DVMARK DVMARKMI DVPRG DVPRGMI DVSTUTOM DVSTUTOMMI TFGRTP TMARK TMRKBLI TSELO TVSTUTK TVSTUTL VFGRPRG VVEMOFS /end DEF_CHARACTERISTIC
/end FUNCTION
/begin FUNCTION crctl_vsetstep_msg ""
 /begin OUT_MEASUREMENT anzmark BGSTUTlokbits0 B_beveh B_bv1 B_bv2 B_envtwa B_fgrepa B_mrkbli B_mrkein B_mrkv B_prgmod B_tmark B_tmrkbli B_vziels canzbl ctblink dvmark_w dvprg_w dvstutom_w mrknrc mrknrcan mrknrint mrkstut_w statvza vzielakvp_w vzielak_w vziels_w /end OUT_MEASUREMENT
/end FUNCTION
/begin FUNCTION crctl_vsetstep_uic "" /begin OUT_MEASUREMENT CrCtl_BGSTUTbits2_mp CrCtl_mrkeinvp_mp /end OUT_MEASUREMENT /end FUNCTION
/begin FUNCTION crctl_vstepadapt "Aufbereitung der Größen für den Stufentempomaten" /end FUNCTION
/begin FUNCTION crctl_vstepadapt_msg ""
 /begin OUT_MEASUREMENT B_acc B_besch B_fgrat B_fgren B_fgresv B_fgrtb2 B_fgrtbe B_fgrtv2 B_fgrtve B_fgrtwa B_fgrvem B_insfgre B_kl15 B_km B_mmiena CrCtl_numVMrk CrCtl_stCC CrCtl_stUpdateVMrk CrCtl_stVDisp CrCtl_stVSetNew CrCtl_vDesDisp CrCtl_vMrk1 CrCtl_vMrk2 CrCtl_vMrk3 CrCtl_vSetNew mmimrk_w vfgr_w vreglmax_w vreglmin_w vziel_w /end OUT_MEASUREMENT
/end FUNCTION
/begin FUNCTION crctl_vstepadapt_uic "" /end FUNCTION
/begin FUNCTION crscd "Komponententreiber Kurbelwelle"
 /begin DEF_CHARACTERISTIC CrSCD_ctTurns_C CrSCD_nFast_C CrSCD_nMax_C CrSCD_nMin_C CrSCD_nSlowHigh_C CrSCD_nSlow_C CrSCD_numShftMisf_C CrSCD_phiIncCor_CUR CrSCD_phiSegLength_C CrSCD_phiSegPhase_C /end DEF_CHARACTERISTIC
 /begin IN_MEASUREMENT CrSCD_nAvrg /end IN_MEASUREMENT
/end FUNCTION
/begin FUNCTION crscd_msg ""
 /begin OUT_MEASUREMENT CrSCD_dSegMisf CrSCD_nAvrg CrSCD_nAvrgHiRes CrSCD_nCurr CrSCD_nCurrHiRes CrSCD_nDyn CrSCD_nHold CrSCD_nMisf CrSCD_numSeg CrSCD_phiIncCor CrSCD_phiIncr CrSCD_tiSeg /end OUT_MEASUREMENT
/end FUNCTION
/begin FUNCTION crscd_thresctl ""
 /begin DEF_CHARACTERISTIC CrSCD_ctThresCtlMin_C CrSCD_nThresCtlHigh_C CrSCD_nThresCtlLow_C /end DEF_CHARACTERISTIC
/end FUNCTION
/begin FUNCTION crscd_uic ""
 /begin OUT_MEASUREMENT CrSCD_incNextIntDelta_mp CrSCD_incNextInt_mp CrSCD_phiCurr_mp CrSCD_phiSegGrid_mp CrSCD_stIncErr_mp CrSCD_stIncSig_mp CrSCD_stIncSyncInc_mp CrSCD_stIncSyncPhase_mp /end OUT_MEASUREMENT
/end FUNCTION
/begin FUNCTION crscd_var ""
 /begin DEF_CHARACTERISTIC CrSCD_ctGapIncs_C CrSCD_ctGaps_C CrSCD_ctIncs_C CrSCD_facGapPlausHigh_CUR CrSCD_facGapPlausLow_CUR CrSCD_facIncPlausHigh_CUR CrSCD_facIncPlausLow_CUR CrSCD_numFBCSeg_C CrSCD_numTDCSeg_C CrSCD_phiGap2Zero_C CrSCD_tiPlausCalcOff_C /end DEF_CHARACTERISTIC
 /begin IN_MEASUREMENT CrSCD_tiIncr /end IN_MEASUREMENT
/end FUNCTION
/begin FUNCTION crscd_var_msg "" /begin OUT_MEASUREMENT CrSCD_nIncr CrSCD_tiIncr /end OUT_MEASUREMENT /end FUNCTION
/begin FUNCTION crs_chkstrtspd "Redundanter Start nur mit Kurbelwelle"
 /begin DEF_CHARACTERISTIC CrS_ctMaxInjStrt_C CrS_facSegTimeMax_C CrS_facSegTimeMin_C CrS_facSegTime_C CrS_phiSegLengthStrtSpd_C CrS_phiSegOfsStrtSpdOld_C CrS_phiSegOfsStrtSpd_C /end DEF_CHARACTERISTIC
/end FUNCTION
/begin FUNCTION crs_chkstrtspd_uic ""
 /begin OUT_MEASUREMENT CrS_ctInjStrt_mp CrS_facSegTime_mp CrS_numTDCStrtLst_mp CrS_numTDCStrt_mp CrS_stStrt_mp CrS_tiSegOld_mp CrS_tiSeg_mp /end OUT_MEASUREMENT
/end FUNCTION
/begin FUNCTION ctscd "Wassertemperaturfühler Komponententreiber"
 /begin DEF_CHARACTERISTIC CTSCD_uSRCMin_C CTSCD_uSRCMax_C CTSCD_tLin_CUR CTSCD_DebSigDef_C CTSCD_DebSigOk_C CTSCD_DebSRCHighDef_C CTSCD_DebSRCHighOk_C CTSCD_DebSRCLowDef_C CTSCD_DebSRCLowOk_C CTSCD_dtRmpSlp2UpDwn_C CTSCD_dtFlTempUp_C CTSCD_dtFlTempDwn_C CTSCD_numAdc_C CTSCD_dtRmpSlp1Up_C CTSCD_dtRmpSlp1Dwn_C CTSCD_stSensIDWord_C CTSCD_swtPHtrIgnoreCAN_C CTSCD_swtSigVal_C CTSCD_tClntPMin_C CTSCD_tDflCold_C CTSCD_tDflWarm_C CTSCD_tDiffThres_C CTSCD_tFuelMin_C CTSCD_tiWait_C /end DEF_CHARACTERISTIC
 /begin IN_MEASUREMENT CTSCD_uRaw /end IN_MEASUREMENT
/end FUNCTION
/begin FUNCTION ctscd_msg ""
 /begin OUT_MEASUREMENT CTSCD_dtClnt CTSCD_stErrIni CTSCD_stPHtr CTSCD_swtSig CTSCD_tClnt CTSCD_tClntLin CTSCD_tClntP CTSCD_uRaw /end OUT_MEASUREMENT
/end FUNCTION
/begin FUNCTION ctscd_uic "" /begin OUT_MEASUREMENT CTSCD_stRmp_mp /end OUT_MEASUREMENT /end FUNCTION
/begin FUNCTION ctscd_var "" /end FUNCTION
/begin FUNCTION ctscd_var_msg "" /end FUNCTION
/begin FUNCTION curmap_size_base "" /end FUNCTION
/begin FUNCTION curmap_size_proj "" /end FUNCTION
/begin FUNCTION curmap_size_sys "" /end FUNCTION
/begin FUNCTION cycsigcheck ""
 /begin DEF_CHARACTERISTIC CycSigCheck_nLimit_C CycSigCheck_swtMode_C CycSigCheck_swtOff_C /end DEF_CHARACTERISTIC
/end FUNCTION
/begin FUNCTION cycsigcheck_msg "" /begin OUT_MEASUREMENT CycSigCheck_stTest /end OUT_MEASUREMENT /end FUNCTION
/begin FUNCTION dcc_updatedem "Fahrgeschwindigkeitregelung"
 /begin DEF_CHARACTERISTIC DCC_DebPlausTrqDesDef_C DCC_DebPlausTrqDesOk_C DCC_EngSpdKi_C DCC_EngSpdKiPos_C DCC_EngSpdKiNeg_C DCC_nEngSpdIWinPos_C DCC_nEngSpdIWinNeg_C DCC_EngSpdKp_C DCC_EngSpdKpPos_C DCC_EngSpdKpNeg_C DCC_nEngSpdPWinPos_C DCC_nEngSpdPWinNeg_C DCC_lWheelDyn_C DCC_nSetPoint_CUR DCC_nShft_C DCC_numGearMax_C DCC_swtARWMode_C DCC_swtTrqDesShutOff_C DCC_tiBrkPressedDel_C DCC_tiEngSpdActv_C DCC_tiPlausBrk_C DCC_tiPT1_C DCC_trqARWIMin_C DCC_trqEngSpdMax_C DCC_dtrqLimBrkUp_C DCC_dtrqLimBrkDwn_C DCC_dtrqSwtUp_C DCC_dtrqSwtDwn_C DCC_dtrqLimUp_C DCC_dtrqLimDwn_C DCC_trqReplVal_C DCC_trqShft_CUR DCC_vLim_C /end DEF_CHARACTERISTIC
 /begin IN_MEASUREMENT DCC_nSetPointRaw_mp Eng_nAvrg /end IN_MEASUREMENT
/end FUNCTION
/begin FUNCTION dcc_updatedem_msg ""
 /begin OUT_MEASUREMENT DCC_stAckEngDCC DCC_stActive DCC_stCtlVel DCC_stDCC DCC_stError DCC_stRecDCC DCC_stRls DCC_trqDes DCC_trqRaw /end OUT_MEASUREMENT
/end FUNCTION
/begin FUNCTION dcc_updatedem_uic ""
 /begin OUT_MEASUREMENT DCC_nDvthires_mp DCC_nDvt_mp DCC_nSetPointRaw_mp DCC_nSetPoint_mp DCC_nShft_mp DCC_nWheel_mp DCC_rTransDTNext_mp DCC_stBrkPressed_mp DCC_stGearNext_mp DCC_stGearOld_mp DCC_stRlsMT_mp DCC_swtPosAT_mp DCC_swtPosBrk_mp DCC_swtPosES_mp DCC_swtPosMT_mp DCC_trqDesDCCFlt_mp DCC_trqDesDCCMT_mp DCC_trqEngSpdRaw_mp DCC_trqEngSpd_mp DCC_trqIEngSpd_mp DCC_trqIInit_mp DCC_trqPEngSpd_mp DCC_trqRaw_mp DCC_trqsaveStI_mp DCC_trqShft_mp DCC_trqStI_mp DCC_vConv_mp /end OUT_MEASUREMENT
/end FUNCTION
/begin FUNCTION drvtrn "Antriebsstrang"
 /begin DEF_CHARACTERISTIC DrvTrn_drTransDTUp_C DrvTrn_drTransDTDwn_C DrvTrn_rFlatTransDT_C DrvTrn_rTransDTInit_C DrvTrn_swtCAN_C DrvTrn_swtrTransSel_C DrvTrn_tiRTransDT_C DrvTrn_vLimTransDT_C /end DEF_CHARACTERISTIC
/end FUNCTION
/begin FUNCTION drvtrn_msg "" /begin OUT_MEASUREMENT DrvTrn_rFlatTransDT DrvTrn_rTransDT /end OUT_MEASUREMENT /end FUNCTION
/begin FUNCTION drvtrn_uic "" /begin OUT_MEASUREMENT DrvTrn_rTransDTact_mp DrvTrn_rTransDTRmpIn_mp /end OUT_MEASUREMENT /end FUNCTION
/begin FUNCTION dsched "" /begin DEF_CHARACTERISTIC DSCHED_numSelFID_C /end DEF_CHARACTERISTIC /end FUNCTION
/begin FUNCTION dsched_msg "" /end FUNCTION
/begin FUNCTION dsched_uic "" /begin OUT_MEASUREMENT DSC_stTstTrigger_mp /end OUT_MEASUREMENT /end FUNCTION
/begin COMPU_METHOD Acc "Fahrzeugbeschleunigung" RAT_FUNC "%6.5" "m/s^2" COEFFS 0 1000 0 0 0 1 /end COMPU_METHOD
/begin COMPU_METHOD AngleCrS "Winkel Kurbelwelle" RAT_FUNC "%6.4" "deg CrS" COEFFS 0 42.6666666666667 0 0 0 1 /end COMPU_METHOD
/begin COMPU_METHOD B_TRUE "Umrechnung   ----> FALSE;    TRUE = TRUE" TAB_VERB "%6.3" "-" COMPU_TAB_REF B_TRUE /end COMPU_METHOD
/begin COMPU_VTAB B_TRUE "Umrechnung   ----> FALSE;    TRUE = TRUE" TAB_VERB 2 0 "FALSE" 1 "TRUE" /end COMPU_VTAB
/begin COMPU_METHOD dez "K3 Umwandlungen" RAT_FUNC "%6.2" "-" COEFFS 0 1 0 0 0 1 /end COMPU_METHOD
/begin COMPU_METHOD dTrqPrp_20ms "Anstieg Vortriebsmoment im 20 ms Raster" RAT_FUNC "%6.1" "Nm/s" COEFFS 0 0.1 0 0 0 1 /end COMPU_METHOD
/begin COMPU_METHOD dVel_20ms "Anstieg Fahrgeschwindigkeit im 20 ms Raster" RAT_FUNC "%6.3" "(km/h)/s" COEFFS 0 2 0 0 0 1 /end COMPU_METHOD
/begin COMPU_METHOD EngN "Motordrehzahl" RAT_FUNC "%6.2" "rpm" COEFFS 0 1 0 0 0 1 /end COMPU_METHOD
/begin COMPU_METHOD EngN_HiRes "Motordrehzahl, höhere Auflösung als EngM" RAT_FUNC "%6.3" "rpm" COEFFS 0 8 0 0 0 1 /end COMPU_METHOD
/begin COMPU_METHOD Fact "Faktor mit Auflösung 1 / 8192, hauptsächlich für einen Faktorenbereich 0...1 verwendet" RAT_FUNC "%6.5" "-" COEFFS 0 8192 0 0 0 1 /end COMPU_METHOD
/begin COMPU_METHOD Fact1 "Faktor mit Auflösung 0,01 (100 mal höherer Bereich als Fact)" RAT_FUNC "%6.4" "-" COEFFS 0 128 0 0 0 1 /end COMPU_METHOD
/begin COMPU_METHOD FactHigh "Faktor mit Auflösung 1/4096, hauptsächlich für einen Faktorenbereich 0.1...10 verwendet" RAT_FUNC "%6.5" "-" COEFFS 0 8192 0 0 0 1 /end COMPU_METHOD
/begin COMPU_METHOD Fact_Inc "Faktor für Inkrement/Gap Plausibilitäts-Fenster" RAT_FUNC "%6.4" "-" COEFFS 0 256 0 0 0 1 /end COMPU_METHOD
/begin COMPU_METHOD FidName "Verbale Umrechnung für Fid-Namen" TAB_VERB "%6.3" "-" COMPU_TAB_REF FidName /end COMPU_METHOD
/begin COMPU_VTAB FidName "Verbale Umrechnung für Fid-Namen" TAB_VERB 1436 0 "Fid_unused" 4097 "Fid_ACCIRevErr_MAX" 4098 "Fid_ACCRevErr_MAX" 4099 "Fid_ACC_AliveErr_MAX" 4100 "Fid_ACC_CsErr_MAX" 4101 "Fid_ACC_TiOutErr_MAX" 4102 "Fid_ACCtl_MAX" 4103 "Fid_ACCtlDflt1_MAX" 4104 "Fid_ACCtlDflt2_MAX" 4105 "Fid_ACCtl_ACTrqErr_MAX" 4106 "Fid_ACCtl_CTSErr_MAX" 4107 "Fid_ACCtl_FanErr_MAX" 4108 "Fid_ACCtl_TGearbxErr_MAX" 4109 "Fid_ACCtl_VSSErr_MAX" 4110 "Fid_ACTrqC_MAX" 4111 "Fid_AFSCD_MAX" 4112 "Fid_AFSCD_AirPerTime_MAX" 4113 "Fid_AFSCD_PlOffsDrft_MAX" 4114 "Fid_AFSCD_PlSetyDrft_MAX" 4115 "Fid_AFSCD_SRCCorrAirm_MAX" 4116 "Fid_AFSCD_SRCDcyc_MAX" 4117 "Fid_AFSCD_SRCRawAirm_MAX" 4118 "Fid_AFSCD_SRCRefSig_MAX" 4119 "Fid_AFS_CanMon_MAX" 4120 "Fid_AFS_GenDisableCond_MAX" 4121 "Fid_AOHt_AltErr_MAX" 4122 "Fid_AOHt_ShutOffErr_MAX" 4123 "Fid_APP1_MAX" 4124 "Fid_APP2_MAX" 4125 "Fid_APPKickdown_MAX" 4126 "Fid_APSCD_MAX" 4127 "Fid_ARSOff_MAX" 4128 "Fid_ASDdc_MAX" 4129 "Fid_ASModSwtOffEng_MAX" 4130 "Fid_ASModSwtOffIndVol_MAX" 4131 "Fid_AccPed_MAX" 4132 "Fid_AccPedBrkPres_MAX" 4133 "Fid_AccPedVel_MAX" 4134 "Fid_AccPed_Brk_MAX" 4135 "Fid_AirCtl_MAX" 4136 "Fid_AirCtlNeg_MAX" 4137 "Fid_AirCtlNeg2_MAX" 4138 "Fid_AirCtlPFltEGRRed_MAX" 4139 "Fid_AirCtlPlateBreak_MAX" 4140 "Fid_AirCtlPlateBreakActv_MAX" 4141 "Fid_AirCtlPos_MAX" 4142 "Fid_AirCtlPos2_MAX" 4143 "Fid_AirCtl_Brk_MAX" 4144 "Fid_BPSCDMon_MAX" 4145 "Fid_CTSCDFlTemp_MAX" 4146 "Fid_CTSCD_Plaus_MAX" 4147 "Fid_ClgDynTst_MAX" 4148 "Fid_CmbChb_MAX" 4149 "Fid_CoDT_GripDeb_MAX" 4150 "Fid_CoEngIRevSys1_MAX" 4151 "Fid_CoEngIRevSys2_MAX" 4152 "Fid_CoEngIRevVeh_MAX" 4153 "Fid_CoEngPFltErr_MAX" 4154 "Fid_CoEngRevSys1_MAX" 4155 "Fid_CoEngRevSys2_MAX" 4156 "Fid_CoEngRevVeh_MAX" 4157 "Fid_CoEngShOffTst_MAX" 4158 "Fid_CoEngSoftShOffTV_MAX" 4159 "Fid_CoEng_ActrPrt_MAX" 4160 "Fid_CoEng_Nrml2Strt_MAX" 4161 "Fid_CoEng_PwrStgEnable_MAX" 4162 "Fid_CoEng_trqLimErr_MAX" 4163 "Fid_CoEng_trqLimErr1_MAX" 4164 "Fid_CoEng_trqLimErr2_MAX" 4165 "Fid_CoEng_trqLimErr3_MAX" 4166 "Fid_CoEng_trqLimErr4_MAX" 4167 "Fid_CoVM_StabDem_Err_MAX" 4168 "Fid_CoVehtrqLimErr_MAX" 4169 "Fid_CpBVlvOff_MAX" 4170 "Fid_CrCtlShutOffIr_MAX" 4171 "Fid_CrCtl_ASCTimeout_MAX" 4172 "Fid_CrCtl_CanDef_MAX" 4173 "Fid_CrCtl_KombiTimeout_MAX" 4174 "Fid_CrCtl_vCrCtl_MAX" 4175 "Fid_DCCIRevErr_MAX" 4176 "Fid_DCCRevErr_MAX" 4177 "Fid_DCC_AliveErr_MAX" 4178 "Fid_DCC_CsErr_MAX" 4179 "Fid_DCC_PlausErr_MAX" 4180 "Fid_DCC_TiOutErr_MAX" 4181 "Fid_DSM_Wuc_MAX" 4182 "Fid_EATSCDTSubs_MAX" 4183 "Fid_EBAFCD_MAX" 4184 "Fid_EBFCD_MAX" 4185 "Fid_ECU_MAX" 4186 "Fid_EGSysCoLSU0_MAX" 4187 "Fid_EGSysCoNSC_MAX" 4188 "Fid_EGSysCoOxi_MAX" 4189 "Fid_EGSysCoTrbn_MAX" 4190 "Fid_EGSysCoTube0_MAX" 4191 "Fid_EGSysCoTube1_MAX" 4192 "Fid_EGSysHtgDel_MAX" 4193 "Fid_EGSysNSC_MAX" 4194 "Fid_EGSysOxiCat_MAX" 4195 "Fid_EGSysPresEnv_MAX" 4196 "Fid_EGSysStrt_MAX" 4197 "Fid_EGSysTemp_MAX" 4198 "Fid_EGSysTrbn_MAX" 4199 "Fid_EGSysTube_MAX" 4200 "Fid_EGSys_AP_MAX" 4201 "Fid_EGTRgnLck_MAX" 4202 "Fid_EGTTempGvnrAirCtl_MAX" 4203 "Fid_EGTTempGvnrInr_MAX" 4204 "Fid_EGTTempGvnrOutr_MAX" 4205 "Fid_EMCCD_ShutOff_MAX" 4206 "Fid_ETClbCorActv_MAX" 4207 "Fid_EngCTSCD_MAX" 4208 "Fid_EngMCaSBackUp_MAX" 4209 "Fid_EngMCrSBackUp_MAX" 4210 "Fid_EngMTEng_MAX" 4211 "Fid_EngMTrqFrcPDiff_MAX" 4212 "Fid_EngMVVeh_MAX" 4213 "Fid_EngM_ChkStrtSpd_MAX" 4214 "Fid_EngPrt_nLimErr_MAX" 4215 "Fid_FBC_MAX" 4216 "Fid_FBCMonI_MAX" 4217 "Fid_FMASwtOff1_MAX" 4218 "Fid_FMASwtOff3_MAX" 4219 "Fid_FMTC_AirCorr_MAX" 4220 "Fid_FMTC_SOECorr_MAX" 4221 "Fid_FTSCDErr_MAX" 4222 "Fid_FWOscDet_MAX" 4223 "Fid_FanCtl_MAX" 4224 "Fid_FanGbxOil_MAX" 4225 "Fid_FlMngFullLdRglOff_MAX" 4226 "Fid_FlMngSmkDefect_MAX" 4227 "Fid_FlSysCTSSens_MAX" 4228 "Fid_FlSysDens_MAX" 4229 "Fid_FlSysFTSSens_MAX" 4230 "Fid_FrmMngAPP_MAX" 4231 "Fid_FrmMngARS_MAX" 4232 "Fid_FrmMngAddLevl_MAX" 4233 "Fid_FrmMngBrk_MAX" 4234 "Fid_FrmMngBrkDef_MAX" 4235 "Fid_FrmMngCoEng_MAX" 4236 "Fid_FrmMngCoEng_St2_MAX" 4237 "Fid_FrmMngConvDef_MAX" 4238 "Fid_FrmMngEngOvrSpd_MAX" 4239 "Fid_FrmMngEngRpmTemp_MAX" 4240 "Fid_FrmMngEngSpd_MAX" 4241 "Fid_FrmMngInjDU1_MAX" 4242 "Fid_FrmMngInjDU2_MAX" 4243 "Fid_FrmMngInjVlv_MAX" 4244 "Fid_FrmMngOBDCtl_MAX" 4245 "Fid_FrmMngPFltDef_MAX" 4246 "Fid_FrmMngParkConsumer_MAX" 4247 "Fid_FrmMngPla_DSC_MAX" 4248 "Fid_FrmMngPla_EGS_MAX" 4249 "Fid_FrmMngPowerTrainCAN_MAX" 4250 "Fid_FrmMngPwrMngLIGovSt_MAX" 4251 "Fid_FrmMngSIG_ARS_MAX" 4252 "Fid_FrmMngSIG_DSC_MAX" 4253 "Fid_FrmMngSig_EGS_MAX" 4254 "Fid_FrmMngTO_ARS_MAX" 4255 "Fid_FrmMngTO_DSC_MAX" 4256 "Fid_FrmMngTo_EGS_MAX" 4257 "Fid_FrmMngTrqGearbx_MAX" 4258 "Fid_FrmMngWaterVlv_MAX" 4259 "Fid_FrmMng_ST_TORQ_MAX" 4260 "Fid_FrmMng_stTrq_MAX" 4261 "Fid_FrmMngnSetpoint_MAX" 4262 "Fid_FrmMngpVal_MAX" 4263 "Fid_FrmMngtEng_MAX" 4264 "Fid_GearbxDrvAway_MAX" 4265 "Fid_GearbxDrvAwayInactiv_MAX" 4266 "Fid_GearbxPtCANErr_MAX" 4267 "Fid_GearbxTrqLimErr_MAX" 4268 "Fid_Gearbx_GearDet_MAX" 4269 "Fid_Gearbx_TrqIntv_Err_MAX" 4270 "Fid_GlwCtl1_MAX" 4271 "Fid_HDC_MAX" 4272 "Fid_IndSys1_MAX" 4273 "Fid_IndSys2_MAX" 4274 "Fid_InjCrvCoErr_MAX" 4275 "Fid_InjCtl_qLimErr_MAX" 4276 "Fid_InjVlvWvCorOff_MAX" 4277 "Fid_LIGovSetpDrvAway_MAX" 4278 "Fid_LIGovSetpointDrvAwy_MAX" 4279 "Fid_LIGovUbr_MAX" 4280 "Fid_LSUCDMon0_MAX" 4281 "Fid_LSUCDO20_MAX" 4282 "Fid_LSUCDRi0_MAX" 4283 "Fid_LSUCDactiv0_MAX" 4284 "Fid_LSUCDlsu0_MAX" 4285 "Fid_LSUClbSched_MAX" 4286 "Fid_LSUCtl0_MAX" 4287 "Fid_LSUMonAllChecks_MAX" 4288 "Fid_LSUMonPlausChk_MAX" 4289 "Fid_Layer_FI_TANS_MAX" 4290 "Fid_Layer_FI_TUMG_MAX" 4291 "Fid_Layer_MANHYDR_MAX" 4292 "Fid_Layer_MANLUFT_MAX" 4293 "Fid_MSidCD_ECU_MAX" 4294 "Fid_MSidCD_Pin_MAX" 4295 "Fid_MeUnCDCalcI_MAX" 4296 "Fid_OTSCD_MAX" 4297 "Fid_PCR_MAX" 4298 "Fid_PCRBalGvnr_MAX" 4299 "Fid_PCRExtnLimActr_MAX" 4300 "Fid_PCRGvnrDvtNeg_MAX" 4301 "Fid_PCRGvnrDvtPos_MAX" 4302 "Fid_PCRLPGvnrDvtNeg_MAX" 4303 "Fid_PCRLPGvnrDvtPos_MAX" 4304 "Fid_PCRSurgeLIGov_MAX" 4305 "Fid_PCR_LP_MAX" 4306 "Fid_PCR_LPMS_MAX" 4307 "Fid_PCR_MS_MAX" 4308 "Fid_PCR_SurgeDet_MAX" 4309 "Fid_PCVCDCalcI_MAX" 4310 "Fid_PFltAshCor_MAX" 4311 "Fid_PFltAshCorRgn_MAX" 4312 "Fid_PFltBrk_MAX" 4313 "Fid_PFltChar_MAX" 4314 "Fid_PFltChngPar_MAX" 4315 "Fid_PFltClth_MAX" 4316 "Fid_PFltDiagRls1_MAX" 4317 "Fid_PFltDiagRls2_MAX" 4318 "Fid_PFltDynChk_MAX" 4319 "Fid_PFltEngPrtRgnMon_MAX" 4320 "Fid_PFltGearDet_MAX" 4321 "Fid_PFltHsLnChk_MAX" 4322 "Fid_PFltLckRgnErr_MAX" 4323 "Fid_PFltLckRgnFuel_MAX" 4324 "Fid_PFltNumPFltErr_MAX" 4325 "Fid_PFltNumPFltErrLck_MAX" 4326 "Fid_PFltPPreErr_MAX" 4327 "Fid_PFltPlausPres_MAX" 4328 "Fid_PFltPlausTemp_MAX" 4329 "Fid_PFltPresPlausProj_MAX" 4330 "Fid_PFltPresSensFrz_MAX" 4331 "Fid_PFltPresSensHsLn_MAX" 4332 "Fid_PFltSRCPres_MAX" 4333 "Fid_PFltSRCTemp_MAX" 4334 "Fid_PFltSimOn_MAX" 4335 "Fid_PFltSpdVeh_MAX" 4336 "Fid_PFltSuc_MAX" 4337 "Fid_PFltTempAir_MAX" 4338 "Fid_PFltTempClnt_MAX" 4339 "Fid_PFltTempOxiPre_MAX" 4340 "Fid_PFltTempPre_MAX" 4341 "Fid_PFltTempSensFrz_MAX" 4342 "Fid_PFltVltgBatt_MAX" 4343 "Fid_RailCDRPSErrChk_MAX" 4344 "Fid_RailCDSubstVal_MAX" 4345 "Fid_RailCD_PMonStrt_MAX" 4346 "Fid_RailCtlMode_MAX" 4347 "Fid_RailMeUn0Blk_MAX" 4348 "Fid_RailMeUn0Rls_MAX" 4349 "Fid_RailMeUn1Blk_MAX" 4350 "Fid_RailMeUn1Rls_MAX" 4351 "Fid_RailMeUn2Blk_MAX" 4352 "Fid_RailMeUn2Rls_MAX" 4353 "Fid_RailMeUn3Blk_MAX" 4354 "Fid_RailMeUn3Rls_MAX" 4355 "Fid_RailMeUn4Blk_MAX" 4356 "Fid_RailMeUn4Rls_MAX" 4357 "Fid_RailMeUnCtlMode_MAX" 4358 "Fid_RailPCV0Blk_MAX" 4359 "Fid_RailPCV0Rls_MAX" 4360 "Fid_RailPCV1Blk_MAX" 4361 "Fid_RailPCV1Rls_MAX" 4362 "Fid_RailPCV2Blk_MAX" 4363 "Fid_RailPCV2Rls_MAX" 4364 "Fid_RailPCV3Blk_MAX" 4365 "Fid_RailPCV3Rls_MAX" 4366 "Fid_RailPCV4Blk_MAX" 4367 "Fid_RailPCV4Rls_MAX" 4368 "Fid_RailPCV5Blk_MAX" 4369 "Fid_RailPCV5Rls_MAX" 4370 "Fid_RailPCVCtlMode_MAX" 4371 "Fid_RailSetPointLim_MAX" 4372 "Fid_RailSetPointRed_MAX" 4373 "Fid_ShuttrCTS_MAX" 4374 "Fid_ShuttrEGS_MAX" 4375 "Fid_SignalsTstNLim_MAX" 4376 "Fid_StSysImmo_MAX" 4377 "Fid_StSysStrtTipGbxDat_MAX" 4378 "Fid_T15CDCanError_MAX" 4379 "Fid_T50CDSig_MAX" 4380 "Fid_UsrDa_FDCOff_MAX" 4381 "Fid_VehDaDist_MAX" 4382 "Fid_ZFCClbActv_MAX" 4383 "Fid_ZFCCldCmbCham_MAX" 8193 "Fid_ACCIRevErr_MIN" 8194 "Fid_ACCRevErr_MIN" 8195 "Fid_ACC_AliveErr_MIN" 8196 "Fid_ACC_CsErr_MIN" 8197 "Fid_ACC_TiOutErr_MIN" 8198 "Fid_ACCtl_MIN" 8199 "Fid_ACCtlDflt1_MIN" 8200 "Fid_ACCtlDflt2_MIN" 8201 "Fid_ACCtl_ACTrqErr_MIN" 8202 "Fid_ACCtl_CTSErr_MIN" 8203 "Fid_ACCtl_FanErr_MIN" 8204 "Fid_ACCtl_TGearbxErr_MIN" 8205 "Fid_ACCtl_VSSErr_MIN" 8206 "Fid_ACTrqC_MIN" 8207 "Fid_AFSCD_MIN" 8208 "Fid_AFSCD_AirPerTime_MIN" 8209 "Fid_AFSCD_PlOffsDrft_MIN" 8210 "Fid_AFSCD_PlSetyDrft_MIN" 8211 "Fid_AFSCD_SRCCorrAirm_MIN" 8212 "Fid_AFSCD_SRCDcyc_MIN" 8213 "Fid_AFSCD_SRCRawAirm_MIN" 8214 "Fid_AFSCD_SRCRefSig_MIN" 8215 "Fid_AFS_CanMon_MIN" 8216 "Fid_AFS_GenDisableCond_MIN" 8217 "Fid_AOHt_AltErr_MIN" 8218 "Fid_AOHt_ShutOffErr_MIN" 8219 "Fid_APP1_MIN" 8220 "Fid_APP2_MIN" 8221 "Fid_APPKickdown_MIN" 8222 "Fid_APSCD_MIN" 8223 "Fid_ARSOff_MIN" 8224 "Fid_ASDdc_MIN" 8225 "Fid_ASModSwtOffEng_MIN" 8226 "Fid_ASModSwtOffIndVol_MIN" 8227 "Fid_AccPed_MIN" 8228 "Fid_AccPedBrkPres_MIN" 8229 "Fid_AccPedVel_MIN" 8230 "Fid_AccPed_Brk_MIN" 8231 "Fid_AirCtl_MIN" 8232 "Fid_AirCtlNeg_MIN" 8233 "Fid_AirCtlNeg2_MIN" 8234 "Fid_AirCtlPFltEGRRed_MIN" 8235 "Fid_AirCtlPlateBreak_MIN" 8236 "Fid_AirCtlPlateBreakActv_MIN" 8237 "Fid_AirCtlPos_MIN" 8238 "Fid_AirCtlPos2_MIN" 8239 "Fid_AirCtl_Brk_MIN" 8240 "Fid_BPSCDMon_MIN" 8241 "Fid_CTSCDFlTemp_MIN" 8242 "Fid_CTSCD_Plaus_MIN" 8243 "Fid_ClgDynTst_MIN" 8244 "Fid_CmbChb_MIN" 8245 "Fid_CoDT_GripDeb_MIN" 8246 "Fid_CoEngIRevSys1_MIN" 8247 "Fid_CoEngIRevSys2_MIN" 8248 "Fid_CoEngIRevVeh_MIN" 8249 "Fid_CoEngPFltErr_MIN" 8250 "Fid_CoEngRevSys1_MIN" 8251 "Fid_CoEngRevSys2_MIN" 8252 "Fid_CoEngRevVeh_MIN" 8253 "Fid_CoEngShOffTst_MIN" 8254 "Fid_CoEngSoftShOffTV_MIN" 8255 "Fid_CoEng_ActrPrt_MIN" 8256 "Fid_CoEng_Nrml2Strt_MIN" 8257 "Fid_CoEng_PwrStgEnable_MIN" 8258 "Fid_CoEng_trqLimErr_MIN" 8259 "Fid_CoEng_trqLimErr1_MIN" 8260 "Fid_CoEng_trqLimErr2_MIN" 8261 "Fid_CoEng_trqLimErr3_MIN" 8262 "Fid_CoEng_trqLimErr4_MIN" 8263 "Fid_CoVM_StabDem_Err_MIN" 8264 "Fid_CoVehtrqLimErr_MIN" 8265 "Fid_CpBVlvOff_MIN" 8266 "Fid_CrCtlShutOffIr_MIN" 8267 "Fid_CrCtl_ASCTimeout_MIN" 8268 "Fid_CrCtl_CanDef_MIN" 8269 "Fid_CrCtl_KombiTimeout_MIN" 8270 "Fid_CrCtl_vCrCtl_MIN" 8271 "Fid_DCCIRevErr_MIN" 8272 "Fid_DCCRevErr_MIN" 8273 "Fid_DCC_AliveErr_MIN" 8274 "Fid_DCC_CsErr_MIN" 8275 "Fid_DCC_PlausErr_MIN" 8276 "Fid_DCC_TiOutErr_MIN" 8277 "Fid_DSM_Wuc_MIN" 8278 "Fid_EATSCDTSubs_MIN" 8279 "Fid_EBAFCD_MIN" 8280 "Fid_EBFCD_MIN" 8281 "Fid_ECU_MIN" 8282 "Fid_EGSysCoLSU0_MIN" 8283 "Fid_EGSysCoNSC_MIN" 8284 "Fid_EGSysCoOxi_MIN" 8285 "Fid_EGSysCoTrbn_MIN" 8286 "Fid_EGSysCoTube0_MIN" 8287 "Fid_EGSysCoTube1_MIN" 8288 "Fid_EGSysHtgDel_MIN" 8289 "Fid_EGSysNSC_MIN" 8290 "Fid_EGSysOxiCat_MIN" 8291 "Fid_EGSysPresEnv_MIN" 8292 "Fid_EGSysStrt_MIN" 8293 "Fid_EGSysTemp_MIN" 8294 "Fid_EGSysTrbn_MIN" 8295 "Fid_EGSysTube_MIN" 8296 "Fid_EGSys_AP_MIN" 8297 "Fid_EGTRgnLck_MIN" 8298 "Fid_EGTTempGvnrAirCtl_MIN" 8299 "Fid_EGTTempGvnrInr_MIN" 8300 "Fid_EGTTempGvnrOutr_MIN" 8301 "Fid_EMCCD_ShutOff_MIN" 8302 "Fid_ETClbCorActv_MIN" 8303 "Fid_EngCTSCD_MIN" 8304 "Fid_EngMCaSBackUp_MIN" 8305 "Fid_EngMCrSBackUp_MIN" 8306 "Fid_EngMTEng_MIN" 8307 "Fid_EngMTrqFrcPDiff_MIN" 8308 "Fid_EngMVVeh_MIN" 8309 "Fid_EngM_ChkStrtSpd_MIN" 8310 "Fid_EngPrt_nLimErr_MIN" 8311 "Fid_FBC_MIN" 8312 "Fid_FBCMonI_MIN" 8313 "Fid_FMASwtOff1_MIN" 8314 "Fid_FMASwtOff3_MIN" 8315 "Fid_FMTC_AirCorr_MIN" 8316 "Fid_FMTC_SOECorr_MIN" 8317 "Fid_FTSCDErr_MIN" 8318 "Fid_FWOscDet_MIN" 8319 "Fid_FanCtl_MIN" 8320 "Fid_FanGbxOil_MIN" 8321 "Fid_FlMngFullLdRglOff_MIN" 8322 "Fid_FlMngSmkDefect_MIN" 8323 "Fid_FlSysCTSSens_MIN" 8324 "Fid_FlSysDens_MIN" 8325 "Fid_FlSysFTSSens_MIN" 8326 "Fid_FrmMngAPP_MIN" 8327 "Fid_FrmMngARS_MIN" 8328 "Fid_FrmMngAddLevl_MIN" 8329 "Fid_FrmMngBrk_MIN" 8330 "Fid_FrmMngBrkDef_MIN" 8331 "Fid_FrmMngCoEng_MIN" 8332 "Fid_FrmMngCoEng_St2_MIN" 8333 "Fid_FrmMngConvDef_MIN" 8334 "Fid_FrmMngEngOvrSpd_MIN" 8335 "Fid_FrmMngEngRpmTemp_MIN" 8336 "Fid_FrmMngEngSpd_MIN" 8337 "Fid_FrmMngInjDU1_MIN" 8338 "Fid_FrmMngInjDU2_MIN" 8339 "Fid_FrmMngInjVlv_MIN" 8340 "Fid_FrmMngOBDCtl_MIN" 8341 "Fid_FrmMngPFltDef_MIN" 8342 "Fid_FrmMngParkConsumer_MIN" 8343 "Fid_FrmMngPla_DSC_MIN" 8344 "Fid_FrmMngPla_EGS_MIN" 8345 "Fid_FrmMngPowerTrainCAN_MIN" 8346 "Fid_FrmMngPwrMngLIGovSt_MIN" 8347 "Fid_FrmMngSIG_ARS_MIN" 8348 "Fid_FrmMngSIG_DSC_MIN" 8349 "Fid_FrmMngSig_EGS_MIN" 8350 "Fid_FrmMngTO_ARS_MIN" 8351 "Fid_FrmMngTO_DSC_MIN" 8352 "Fid_FrmMngTo_EGS_MIN" 8353 "Fid_FrmMngTrqGearbx_MIN" 8354 "Fid_FrmMngWaterVlv_MIN" 8355 "Fid_FrmMng_ST_TORQ_MIN" 8356 "Fid_FrmMng_stTrq_MIN" 8357 "Fid_FrmMngnSetpoint_MIN" 8358 "Fid_FrmMngpVal_MIN" 8359 "Fid_FrmMngtEng_MIN" 8360 "Fid_GearbxDrvAway_MIN" 8361 "Fid_GearbxDrvAwayInactiv_MIN" 8362 "Fid_GearbxPtCANErr_MIN" 8363 "Fid_GearbxTrqLimErr_MIN" 8364 "Fid_Gearbx_GearDet_MIN" 8365 "Fid_Gearbx_TrqIntv_Err_MIN" 8366 "Fid_GlwCtl1_MIN" 8367 "Fid_HDC_MIN" 8368 "Fid_IndSys1_MIN" 8369 "Fid_IndSys2_MIN" 8370 "Fid_InjCrvCoErr_MIN" 8371 "Fid_InjCtl_qLimErr_MIN" 8372 "Fid_InjVlvWvCorOff_MIN" 8373 "Fid_LIGovSetpDrvAway_MIN" 8374 "Fid_LIGovSetpointDrvAwy_MIN" 8375 "Fid_LIGovUbr_MIN" 8376 "Fid_LSUCDMon0_MIN" 8377 "Fid_LSUCDO20_MIN" 8378 "Fid_LSUCDRi0_MIN" 8379 "Fid_LSUCDactiv0_MIN" 8380 "Fid_LSUCDlsu0_MIN" 8381 "Fid_LSUClbSched_MIN" 8382 "Fid_LSUCtl0_MIN" 8383 "Fid_LSUMonAllChecks_MIN" 8384 "Fid_LSUMonPlausChk_MIN" 8385 "Fid_Layer_FI_TANS_MIN" 8386 "Fid_Layer_FI_TUMG_MIN" 8387 "Fid_Layer_MANHYDR_MIN" 8388 "Fid_Layer_MANLUFT_MIN" 8389 "Fid_MSidCD_ECU_MIN" 8390 "Fid_MSidCD_Pin_MIN" 8391 "Fid_MeUnCDCalcI_MIN" 8392 "Fid_OTSCD_MIN" 8393 "Fid_PCR_MIN" 8394 "Fid_PCRBalGvnr_MIN" 8395 "Fid_PCRExtnLimActr_MIN" 8396 "Fid_PCRGvnrDvtNeg_MIN" 8397 "Fid_PCRGvnrDvtPos_MIN" 8398 "Fid_PCRLPGvnrDvtNeg_MIN" 8399 "Fid_PCRLPGvnrDvtPos_MIN" 8400 "Fid_PCRSurgeLIGov_MIN" 8401 "Fid_PCR_LP_MIN" 8402 "Fid_PCR_LPMS_MIN" 8403 "Fid_PCR_MS_MIN" 8404 "Fid_PCR_SurgeDet_MIN" 8405 "Fid_PCVCDCalcI_MIN" 8406 "Fid_PFltAshCor_MIN" 8407 "Fid_PFltAshCorRgn_MIN" 8408 "Fid_PFltBrk_MIN" 8409 "Fid_PFltChar_MIN" 8410 "Fid_PFltChngPar_MIN" 8411 "Fid_PFltClth_MIN" 8412 "Fid_PFltDiagRls1_MIN" 8413 "Fid_PFltDiagRls2_MIN" 8414 "Fid_PFltDynChk_MIN" 8415 "Fid_PFltEngPrtRgnMon_MIN" 8416 "Fid_PFltGearDet_MIN" 8417 "Fid_PFltHsLnChk_MIN" 8418 "Fid_PFltLckRgnErr_MIN" 8419 "Fid_PFltLckRgnFuel_MIN" 8420 "Fid_PFltNumPFltErr_MIN" 8421 "Fid_PFltNumPFltErrLck_MIN" 8422 "Fid_PFltPPreErr_MIN" 8423 "Fid_PFltPlausPres_MIN" 8424 "Fid_PFltPlausTemp_MIN" 8425 "Fid_PFltPresPlausProj_MIN" 8426 "Fid_PFltPresSensFrz_MIN" 8427 "Fid_PFltPresSensHsLn_MIN" 8428 "Fid_PFltSRCPres_MIN" 8429 "Fid_PFltSRCTemp_MIN" 8430 "Fid_PFltSimOn_MIN" 8431 "Fid_PFltSpdVeh_MIN" 8432 "Fid_PFltSuc_MIN" 8433 "Fid_PFltTempAir_MIN" 8434 "Fid_PFltTempClnt_MIN" 8435 "Fid_PFltTempOxiPre_MIN" 8436 "Fid_PFltTempPre_MIN" 8437 "Fid_PFltTempSensFrz_MIN" 8438 "Fid_PFltVltgBatt_MIN" 8439 "Fid_RailCDRPSErrChk_MIN" 8440 "Fid_RailCDSubstVal_MIN" 8441 "Fid_RailCD_PMonStrt_MIN" 8442 "Fid_RailCtlMode_MIN" 8443 "Fid_RailMeUn0Blk_MIN" 8444 "Fid_RailMeUn0Rls_MIN" 8445 "Fid_RailMeUn1Blk_MIN" 8446 "Fid_RailMeUn1Rls_MIN" 8447 "Fid_RailMeUn2Blk_MIN" 8448 "Fid_RailMeUn2Rls_MIN" 8449 "Fid_RailMeUn3Blk_MIN" 8450 "Fid_RailMeUn3Rls_MIN" 8451 "Fid_RailMeUn4Blk_MIN" 8452 "Fid_RailMeUn4Rls_MIN" 8453 "Fid_RailMeUnCtlMode_MIN" 8454 "Fid_RailPCV0Blk_MIN" 8455 "Fid_RailPCV0Rls_MIN" 8456 "Fid_RailPCV1Blk_MIN" 8457 "Fid_RailPCV1Rls_MIN" 8458 "Fid_RailPCV2Blk_MIN" 8459 "Fid_RailPCV2Rls_MIN" 8460 "Fid_RailPCV3Blk_MIN" 8461 "Fid_RailPCV3Rls_MIN" 8462 "Fid_RailPCV4Blk_MIN" 8463 "Fid_RailPCV4Rls_MIN" 8464 "Fid_RailPCV5Blk_MIN" 8465 "Fid_RailPCV5Rls_MIN" 8466 "Fid_RailPCVCtlMode_MIN" 8467 "Fid_RailSetPointLim_MIN" 8468 "Fid_RailSetPointRed_MIN" 8469 "Fid_ShuttrCTS_MIN" 8470 "Fid_ShuttrEGS_MIN" 8471 "Fid_SignalsTstNLim_MIN" 8472 "Fid_StSysImmo_MIN" 8473 "Fid_StSysStrtTipGbxDat_MIN" 8474 "Fid_T15CDCanError_MIN" 8475 "Fid_T50CDSig_MIN" 8476 "Fid_UsrDa_FDCOff_MIN" 8477 "Fid_VehDaDist_MIN" 8478 "Fid_ZFCClbActv_MIN" 8479 "Fid_ZFCCldCmbCham_MIN" 16385 "Fid_ACCIRevErr_SIG" 16386 "Fid_ACCRevErr_SIG" 16387 "Fid_ACC_AliveErr_SIG" 16388 "Fid_ACC_CsErr_SIG" 16389 "Fid_ACC_TiOutErr_SIG" 16390 "Fid_ACCtl_SIG" 16391 "Fid_ACCtlDflt1_SIG" 16392 "Fid_ACCtlDflt2_SIG" 16393 "Fid_ACCtl_ACTrqErr_SIG" 16394 "Fid_ACCtl_CTSErr_SIG" 16395 "Fid_ACCtl_FanErr_SIG" 16396 "Fid_ACCtl_TGearbxErr_SIG" 16397 "Fid_ACCtl_VSSErr_SIG" 16398 "Fid_ACTrqC_SIG" 16399 "Fid_AFSCD_SIG" 16400 "Fid_AFSCD_AirPerTime_SIG" 16401 "Fid_AFSCD_PlOffsDrft_SIG" 16402 "Fid_AFSCD_PlSetyDrft_SIG" 16403 "Fid_AFSCD_SRCCorrAirm_SIG" 16404 "Fid_AFSCD_SRCDcyc_SIG" 16405 "Fid_AFSCD_SRCRawAirm_SIG" 16406 "Fid_AFSCD_SRCRefSig_SIG" 16407 "Fid_AFS_CanMon_SIG" 16408 "Fid_AFS_GenDisableCond_SIG" 16409 "Fid_AOHt_AltErr_SIG" 16410 "Fid_AOHt_ShutOffErr_SIG" 16411 "Fid_APP1_SIG" 16412 "Fid_APP2_SIG" 16413 "Fid_APPKickdown_SIG" 16414 "Fid_APSCD_SIG" 16415 "Fid_ARSOff_SIG" 16416 "Fid_ASDdc_SIG" 16417 "Fid_ASModSwtOffEng_SIG" 16418 "Fid_ASModSwtOffIndVol_SIG" 16419 "Fid_AccPed_SIG" 16420 "Fid_AccPedBrkPres_SIG" 16421 "Fid_AccPedVel_SIG" 16422 "Fid_AccPed_Brk_SIG" 16423 "Fid_AirCtl_SIG" 16424 "Fid_AirCtlNeg_SIG" 16425 "Fid_AirCtlNeg2_SIG" 16426 "Fid_AirCtlPFltEGRRed_SIG" 16427 "Fid_AirCtlPlateBreak_SIG" 16428 "Fid_AirCtlPlateBreakActv_SIG" 16429 "Fid_AirCtlPos_SIG" 16430 "Fid_AirCtlPos2_SIG" 16431 "Fid_AirCtl_Brk_SIG" 16432 "Fid_BPSCDMon_SIG" 16433 "Fid_CTSCDFlTemp_SIG" 16434 "Fid_CTSCD_Plaus_SIG" 16435 "Fid_ClgDynTst_SIG" 16436 "Fid_CmbChb_SIG" 16437 "Fid_CoDT_GripDeb_SIG" 16438 "Fid_CoEngIRevSys1_SIG" 16439 "Fid_CoEngIRevSys2_SIG" 16440 "Fid_CoEngIRevVeh_SIG" 16441 "Fid_CoEngPFltErr_SIG" 16442 "Fid_CoEngRevSys1_SIG" 16443 "Fid_CoEngRevSys2_SIG" 16444 "Fid_CoEngRevVeh_SIG" 16445 "Fid_CoEngShOffTst_SIG" 16446 "Fid_CoEngSoftShOffTV_SIG" 16447 "Fid_CoEng_ActrPrt_SIG" 16448 "Fid_CoEng_Nrml2Strt_SIG" 16449 "Fid_CoEng_PwrStgEnable_SIG" 16450 "Fid_CoEng_trqLimErr_SIG" 16451 "Fid_CoEng_trqLimErr1_SIG" 16452 "Fid_CoEng_trqLimErr2_SIG" 16453 "Fid_CoEng_trqLimErr3_SIG" 16454 "Fid_CoEng_trqLimErr4_SIG" 16455 "Fid_CoVM_StabDem_Err_SIG" 16456 "Fid_CoVehtrqLimErr_SIG" 16457 "Fid_CpBVlvOff_SIG" 16458 "Fid_CrCtlShutOffIr_SIG" 16459 "Fid_CrCtl_ASCTimeout_SIG" 16460 "Fid_CrCtl_CanDef_SIG" 16461 "Fid_CrCtl_KombiTimeout_SIG" 16462 "Fid_CrCtl_vCrCtl_SIG" 16463 "Fid_DCCIRevErr_SIG" 16464 "Fid_DCCRevErr_SIG" 16465 "Fid_DCC_AliveErr_SIG" 16466 "Fid_DCC_CsErr_SIG" 16467 "Fid_DCC_PlausErr_SIG" 16468 "Fid_DCC_TiOutErr_SIG" 16469 "Fid_DSM_Wuc_SIG" 16470 "Fid_EATSCDTSubs_SIG" 16471 "Fid_EBAFCD_SIG" 16472 "Fid_EBFCD_SIG" 16473 "Fid_ECU_SIG" 16474 "Fid_EGSysCoLSU0_SIG" 16475 "Fid_EGSysCoNSC_SIG" 16476 "Fid_EGSysCoOxi_SIG" 16477 "Fid_EGSysCoTrbn_SIG" 16478 "Fid_EGSysCoTube0_SIG" 16479 "Fid_EGSysCoTube1_SIG" 16480 "Fid_EGSysHtgDel_SIG" 16481 "Fid_EGSysNSC_SIG" 16482 "Fid_EGSysOxiCat_SIG" 16483 "Fid_EGSysPresEnv_SIG" 16484 "Fid_EGSysStrt_SIG" 16485 "Fid_EGSysTemp_SIG" 16486 "Fid_EGSysTrbn_SIG" 16487 "Fid_EGSysTube_SIG" 16488 "Fid_EGSys_AP_SIG" 16489 "Fid_EGTRgnLck_SIG" 16490 "Fid_EGTTempGvnrAirCtl_SIG" 16491 "Fid_EGTTempGvnrInr_SIG" 16492 "Fid_EGTTempGvnrOutr_SIG" 16493 "Fid_EMCCD_ShutOff_SIG" 16494 "Fid_ETClbCorActv_SIG" 16495 "Fid_EngCTSCD_SIG" 16496 "Fid_EngMCaSBackUp_SIG" 16497 "Fid_EngMCrSBackUp_SIG" 16498 "Fid_EngMTEng_SIG" 16499 "Fid_EngMTrqFrcPDiff_SIG" 16500 "Fid_EngMVVeh_SIG" 16501 "Fid_EngM_ChkStrtSpd_SIG" 16502 "Fid_EngPrt_nLimErr_SIG" 16503 "Fid_FBC_SIG" 16504 "Fid_FBCMonI_SIG" 16505 "Fid_FMASwtOff1_SIG" 16506 "Fid_FMASwtOff3_SIG" 16507 "Fid_FMTC_AirCorr_SIG" 16508 "Fid_FMTC_SOECorr_SIG" 16509 "Fid_FTSCDErr_SIG" 16510 "Fid_FWOscDet_SIG" 16511 "Fid_FanCtl_SIG" 16512 "Fid_FanGbxOil_SIG" 16513 "Fid_FlMngFullLdRglOff_SIG" 16514 "Fid_FlMngSmkDefect_SIG" 16515 "Fid_FlSysCTSSens_SIG" 16516 "Fid_FlSysDens_SIG" 16517 "Fid_FlSysFTSSens_SIG" 16518 "Fid_FrmMngAPP_SIG" 16519 "Fid_FrmMngARS_SIG" 16520 "Fid_FrmMngAddLevl_SIG" 16521 "Fid_FrmMngBrk_SIG" 16522 "Fid_FrmMngBrkDef_SIG" 16523 "Fid_FrmMngCoEng_SIG" 16524 "Fid_FrmMngCoEng_St2_SIG" 16525 "Fid_FrmMngConvDef_SIG" 16526 "Fid_FrmMngEngOvrSpd_SIG" 16527 "Fid_FrmMngEngRpmTemp_SIG" 16528 "Fid_FrmMngEngSpd_SIG" 16529 "Fid_FrmMngInjDU1_SIG" 16530 "Fid_FrmMngInjDU2_SIG" 16531 "Fid_FrmMngInjVlv_SIG" 16532 "Fid_FrmMngOBDCtl_SIG" 16533 "Fid_FrmMngPFltDef_SIG" 16534 "Fid_FrmMngParkConsumer_SIG" 16535 "Fid_FrmMngPla_DSC_SIG" 16536 "Fid_FrmMngPla_EGS_SIG" 16537 "Fid_FrmMngPowerTrainCAN_SIG" 16538 "Fid_FrmMngPwrMngLIGovSt_SIG" 16539 "Fid_FrmMngSIG_ARS_SIG" 16540 "Fid_FrmMngSIG_DSC_SIG" 16541 "Fid_FrmMngSig_EGS_SIG" 16542 "Fid_FrmMngTO_ARS_SIG" 16543 "Fid_FrmMngTO_DSC_SIG" 16544 "Fid_FrmMngTo_EGS_SIG" 16545 "Fid_FrmMngTrqGearbx_SIG" 16546 "Fid_FrmMngWaterVlv_SIG" 16547 "Fid_FrmMng_ST_TORQ_SIG" 16548 "Fid_FrmMng_stTrq_SIG" 16549 "Fid_FrmMngnSetpoint_SIG" 16550 "Fid_FrmMngpVal_SIG" 16551 "Fid_FrmMngtEng_SIG" 16552 "Fid_GearbxDrvAway_SIG" 16553 "Fid_GearbxDrvAwayInactiv_SIG" 16554 "Fid_GearbxPtCANErr_SIG" 16555 "Fid_GearbxTrqLimErr_SIG" 16556 "Fid_Gearbx_GearDet_SIG" 16557 "Fid_Gearbx_TrqIntv_Err_SIG" 16558 "Fid_GlwCtl1_SIG" 16559 "Fid_HDC_SIG" 16560 "Fid_IndSys1_SIG" 16561 "Fid_IndSys2_SIG" 16562 "Fid_InjCrvCoErr_SIG" 16563 "Fid_InjCtl_qLimErr_SIG" 16564 "Fid_InjVlvWvCorOff_SIG" 16565 "Fid_LIGovSetpDrvAway_SIG" 16566 "Fid_LIGovSetpointDrvAwy_SIG" 16567 "Fid_LIGovUbr_SIG" 16568 "Fid_LSUCDMon0_SIG" 16569 "Fid_LSUCDO20_SIG" 16570 "Fid_LSUCDRi0_SIG" 16571 "Fid_LSUCDactiv0_SIG" 16572 "Fid_LSUCDlsu0_SIG" 16573 "Fid_LSUClbSched_SIG" 16574 "Fid_LSUCtl0_SIG" 16575 "Fid_LSUMonAllChecks_SIG" 16576 "Fid_LSUMonPlausChk_SIG" 16577 "Fid_Layer_FI_TANS_SIG" 16578 "Fid_Layer_FI_TUMG_SIG" 16579 "Fid_Layer_MANHYDR_SIG" 16580 "Fid_Layer_MANLUFT_SIG" 16581 "Fid_MSidCD_ECU_SIG" 16582 "Fid_MSidCD_Pin_SIG" 16583 "Fid_MeUnCDCalcI_SIG" 16584 "Fid_OTSCD_SIG" 16585 "Fid_PCR_SIG" 16586 "Fid_PCRBalGvnr_SIG" 16587 "Fid_PCRExtnLimActr_SIG" 16588 "Fid_PCRGvnrDvtNeg_SIG" 16589 "Fid_PCRGvnrDvtPos_SIG" 16590 "Fid_PCRLPGvnrDvtNeg_SIG" 16591 "Fid_PCRLPGvnrDvtPos_SIG" 16592 "Fid_PCRSurgeLIGov_SIG" 16593 "Fid_PCR_LP_SIG" 16594 "Fid_PCR_LPMS_SIG" 16595 "Fid_PCR_MS_SIG" 16596 "Fid_PCR_SurgeDet_SIG" 16597 "Fid_PCVCDCalcI_SIG" 16598 "Fid_PFltAshCor_SIG" 16599 "Fid_PFltAshCorRgn_SIG" 16600 "Fid_PFltBrk_SIG" 16601 "Fid_PFltChar_SIG" 16602 "Fid_PFltChngPar_SIG" 16603 "Fid_PFltClth_SIG" 16604 "Fid_PFltDiagRls1_SIG" 16605 "Fid_PFltDiagRls2_SIG" 16606 "Fid_PFltDynChk_SIG" 16607 "Fid_PFltEngPrtRgnMon_SIG" 16608 "Fid_PFltGearDet_SIG" 16609 "Fid_PFltHsLnChk_SIG" 16610 "Fid_PFltLckRgnErr_SIG" 16611 "Fid_PFltLckRgnFuel_SIG" 16612 "Fid_PFltNumPFltErr_SIG" 16613 "Fid_PFltNumPFltErrLck_SIG" 16614 "Fid_PFltPPreErr_SIG" 16615 "Fid_PFltPlausPres_SIG" 16616 "Fid_PFltPlausTemp_SIG" 16617 "Fid_PFltPresPlausProj_SIG" 16618 "Fid_PFltPresSensFrz_SIG" 16619 "Fid_PFltPresSensHsLn_SIG" 16620 "Fid_PFltSRCPres_SIG" 16621 "Fid_PFltSRCTemp_SIG" 16622 "Fid_PFltSimOn_SIG" 16623 "Fid_PFltSpdVeh_SIG" 16624 "Fid_PFltSuc_SIG" 16625 "Fid_PFltTempAir_SIG" 16626 "Fid_PFltTempClnt_SIG" 16627 "Fid_PFltTempOxiPre_SIG" 16628 "Fid_PFltTempPre_SIG" 16629 "Fid_PFltTempSensFrz_SIG" 16630 "Fid_PFltVltgBatt_SIG" 16631 "Fid_RailCDRPSErrChk_SIG" 16632 "Fid_RailCDSubstVal_SIG" 16633 "Fid_RailCD_PMonStrt_SIG" 16634 "Fid_RailCtlMode_SIG" 16635 "Fid_RailMeUn0Blk_SIG" 16636 "Fid_RailMeUn0Rls_SIG" 16637 "Fid_RailMeUn1Blk_SIG" 16638 "Fid_RailMeUn1Rls_SIG" 16639 "Fid_RailMeUn2Blk_SIG" 16640 "Fid_RailMeUn2Rls_SIG" 16641 "Fid_RailMeUn3Blk_SIG" 16642 "Fid_RailMeUn3Rls_SIG" 16643 "Fid_RailMeUn4Blk_SIG" 16644 "Fid_RailMeUn4Rls_SIG" 16645 "Fid_RailMeUnCtlMode_SIG" 16646 "Fid_RailPCV0Blk_SIG" 16647 "Fid_RailPCV0Rls_SIG" 16648 "Fid_RailPCV1Blk_SIG" 16649 "Fid_RailPCV1Rls_SIG" 16650 "Fid_RailPCV2Blk_SIG" 16651 "Fid_RailPCV2Rls_SIG" 16652 "Fid_RailPCV3Blk_SIG" 16653 "Fid_RailPCV3Rls_SIG" 16654 "Fid_RailPCV4Blk_SIG" 16655 "Fid_RailPCV4Rls_SIG" 16656 "Fid_RailPCV5Blk_SIG" 16657 "Fid_RailPCV5Rls_SIG" 16658 "Fid_RailPCVCtlMode_SIG" 16659 "Fid_RailSetPointLim_SIG" 16660 "Fid_RailSetPointRed_SIG" 16661 "Fid_ShuttrCTS_SIG" 16662 "Fid_ShuttrEGS_SIG" 16663 "Fid_SignalsTstNLim_SIG" 16664 "Fid_StSysImmo_SIG" 16665 "Fid_StSysStrtTipGbxDat_SIG" 16666 "Fid_T15CDCanError_SIG" 16667 "Fid_T50CDSig_SIG" 16668 "Fid_UsrDa_FDCOff_SIG" 16669 "Fid_VehDaDist_SIG" 16670 "Fid_ZFCClbActv_SIG" 16671 "Fid_ZFCCldCmbCham_SIG" 32769 "Fid_ACCIRevErr_NPL" 32770 "Fid_ACCRevErr_NPL" 32771 "Fid_ACC_AliveErr_NPL" 32772 "Fid_ACC_CsErr_NPL" 32773 "Fid_ACC_TiOutErr_NPL" 32774 "Fid_ACCtl_NPL" 32775 "Fid_ACCtlDflt1_NPL" 32776 "Fid_ACCtlDflt2_NPL" 32777 "Fid_ACCtl_ACTrqErr_NPL" 32778 "Fid_ACCtl_CTSErr_NPL" 32779 "Fid_ACCtl_FanErr_NPL" 32780 "Fid_ACCtl_TGearbxErr_NPL" 32781 "Fid_ACCtl_VSSErr_NPL" 32782 "Fid_ACTrqC_NPL" 32783 "Fid_AFSCD_NPL" 32784 "Fid_AFSCD_AirPerTime_NPL" 32785 "Fid_AFSCD_PlOffsDrft_NPL" 32786 "Fid_AFSCD_PlSetyDrft_NPL" 32787 "Fid_AFSCD_SRCCorrAirm_NPL" 32788 "Fid_AFSCD_SRCDcyc_NPL" 32789 "Fid_AFSCD_SRCRawAirm_NPL" 32790 "Fid_AFSCD_SRCRefSig_NPL" 32791 "Fid_AFS_CanMon_NPL" 32792 "Fid_AFS_GenDisableCond_NPL" 32793 "Fid_AOHt_AltErr_NPL" 32794 "Fid_AOHt_ShutOffErr_NPL" 32795 "Fid_APP1_NPL" 32796 "Fid_APP2_NPL" 32797 "Fid_APPKickdown_NPL" 32798 "Fid_APSCD_NPL" 32799 "Fid_ARSOff_NPL" 32800 "Fid_ASDdc_NPL" 32801 "Fid_ASModSwtOffEng_NPL" 32802 "Fid_ASModSwtOffIndVol_NPL" 32803 "Fid_AccPed_NPL" 32804 "Fid_AccPedBrkPres_NPL" 32805 "Fid_AccPedVel_NPL" 32806 "Fid_AccPed_Brk_NPL" 32807 "Fid_AirCtl_NPL" 32808 "Fid_AirCtlNeg_NPL" 32809 "Fid_AirCtlNeg2_NPL" 32810 "Fid_AirCtlPFltEGRRed_NPL" 32811 "Fid_AirCtlPlateBreak_NPL" 32812 "Fid_AirCtlPlateBreakActv_NPL" 32813 "Fid_AirCtlPos_NPL" 32814 "Fid_AirCtlPos2_NPL" 32815 "Fid_AirCtl_Brk_NPL" 32816 "Fid_BPSCDMon_NPL" 32817 "Fid_CTSCDFlTemp_NPL" 32818 "Fid_CTSCD_Plaus_NPL" 32819 "Fid_ClgDynTst_NPL" 32820 "Fid_CmbChb_NPL" 32821 "Fid_CoDT_GripDeb_NPL" 32822 "Fid_CoEngIRevSys1_NPL" 32823 "Fid_CoEngIRevSys2_NPL" 32824 "Fid_CoEngIRevVeh_NPL" 32825 "Fid_CoEngPFltErr_NPL" 32826 "Fid_CoEngRevSys1_NPL" 32827 "Fid_CoEngRevSys2_NPL" 32828 "Fid_CoEngRevVeh_NPL" 32829 "Fid_CoEngShOffTst_NPL" 32830 "Fid_CoEngSoftShOffTV_NPL" 32831 "Fid_CoEng_ActrPrt_NPL" 32832 "Fid_CoEng_Nrml2Strt_NPL" 32833 "Fid_CoEng_PwrStgEnable_NPL" 32834 "Fid_CoEng_trqLimErr_NPL" 32835 "Fid_CoEng_trqLimErr1_NPL" 32836 "Fid_CoEng_trqLimErr2_NPL" 32837 "Fid_CoEng_trqLimErr3_NPL" 32838 "Fid_CoEng_trqLimErr4_NPL" 32839 "Fid_CoVM_StabDem_Err_NPL" 32840 "Fid_CoVehtrqLimErr_NPL" 32841 "Fid_CpBVlvOff_NPL" 32842 "Fid_CrCtlShutOffIr_NPL" 32843 "Fid_CrCtl_ASCTimeout_NPL" 32844 "Fid_CrCtl_CanDef_NPL" 32845 "Fid_CrCtl_KombiTimeout_NPL" 32846 "Fid_CrCtl_vCrCtl_NPL" 32847 "Fid_DCCIRevErr_NPL" 32848 "Fid_DCCRevErr_NPL" 32849 "Fid_DCC_AliveErr_NPL" 32850 "Fid_DCC_CsErr_NPL" 32851 "Fid_DCC_PlausErr_NPL" 32852 "Fid_DCC_TiOutErr_NPL" 32853 "Fid_DSM_Wuc_NPL" 32854 "Fid_EATSCDTSubs_NPL" 32855 "Fid_EBAFCD_NPL" 32856 "Fid_EBFCD_NPL" 32857 "Fid_ECU_NPL" 32858 "Fid_EGSysCoLSU0_NPL" 32859 "Fid_EGSysCoNSC_NPL" 32860 "Fid_EGSysCoOxi_NPL" 32861 "Fid_EGSysCoTrbn_NPL" 32862 "Fid_EGSysCoTube0_NPL" 32863 "Fid_EGSysCoTube1_NPL" 32864 "Fid_EGSysHtgDel_NPL" 32865 "Fid_EGSysNSC_NPL" 32866 "Fid_EGSysOxiCat_NPL" 32867 "Fid_EGSysPresEnv_NPL" 32868 "Fid_EGSysStrt_NPL" 32869 "Fid_EGSysTemp_NPL" 32870 "Fid_EGSysTrbn_NPL" 32871 "Fid_EGSysTube_NPL" 32872 "Fid_EGSys_AP_NPL" 32873 "Fid_EGTRgnLck_NPL" 32874 "Fid_EGTTempGvnrAirCtl_NPL" 32875 "Fid_EGTTempGvnrInr_NPL" 32876 "Fid_EGTTempGvnrOutr_NPL" 32877 "Fid_EMCCD_ShutOff_NPL" 32878 "Fid_ETClbCorActv_NPL" 32879 "Fid_EngCTSCD_NPL" 32880 "Fid_EngMCaSBackUp_NPL" 32881 "Fid_EngMCrSBackUp_NPL" 32882 "Fid_EngMTEng_NPL" 32883 "Fid_EngMTrqFrcPDiff_NPL" 32884 "Fid_EngMVVeh_NPL" 32885 "Fid_EngM_ChkStrtSpd_NPL" 32886 "Fid_EngPrt_nLimErr_NPL" 32887 "Fid_FBC_NPL" 32888 "Fid_FBCMonI_NPL" 32889 "Fid_FMASwtOff1_NPL" 32890 "Fid_FMASwtOff3_NPL" 32891 "Fid_FMTC_AirCorr_NPL" 32892 "Fid_FMTC_SOECorr_NPL" 32893 "Fid_FTSCDErr_NPL" 32894 "Fid_FWOscDet_NPL" 32895 "Fid_FanCtl_NPL" 32896 "Fid_FanGbxOil_NPL" 32897 "Fid_FlMngFullLdRglOff_NPL" 32898 "Fid_FlMngSmkDefect_NPL" 32899 "Fid_FlSysCTSSens_NPL" 32900 "Fid_FlSysDens_NPL" 32901 "Fid_FlSysFTSSens_NPL" 32902 "Fid_FrmMngAPP_NPL" 32903 "Fid_FrmMngARS_NPL" 32904 "Fid_FrmMngAddLevl_NPL" 32905 "Fid_FrmMngBrk_NPL" 32906 "Fid_FrmMngBrkDef_NPL" 32907 "Fid_FrmMngCoEng_NPL" 32908 "Fid_FrmMngCoEng_St2_NPL" 32909 "Fid_FrmMngConvDef_NPL" 32910 "Fid_FrmMngEngOvrSpd_NPL" 32911 "Fid_FrmMngEngRpmTemp_NPL" 32912 "Fid_FrmMngEngSpd_NPL" 32913 "Fid_FrmMngInjDU1_NPL" 32914 "Fid_FrmMngInjDU2_NPL" 32915 "Fid_FrmMngInjVlv_NPL" 32916 "Fid_FrmMngOBDCtl_NPL" 32917 "Fid_FrmMngPFltDef_NPL" 32918 "Fid_FrmMngParkConsumer_NPL" 32919 "Fid_FrmMngPla_DSC_NPL" 32920 "Fid_FrmMngPla_EGS_NPL" 32921 "Fid_FrmMngPowerTrainCAN_NPL" 32922 "Fid_FrmMngPwrMngLIGovSt_NPL" 32923 "Fid_FrmMngSIG_ARS_NPL" 32924 "Fid_FrmMngSIG_DSC_NPL" 32925 "Fid_FrmMngSig_EGS_NPL" 32926 "Fid_FrmMngTO_ARS_NPL" 32927 "Fid_FrmMngTO_DSC_NPL" 32928 "Fid_FrmMngTo_EGS_NPL" 32929 "Fid_FrmMngTrqGearbx_NPL" 32930 "Fid_FrmMngWaterVlv_NPL" 32931 "Fid_FrmMng_ST_TORQ_NPL" 32932 "Fid_FrmMng_stTrq_NPL" 32933 "Fid_FrmMngnSetpoint_NPL" 32934 "Fid_FrmMngpVal_NPL" 32935 "Fid_FrmMngtEng_NPL" 32936 "Fid_GearbxDrvAway_NPL" 32937 "Fid_GearbxDrvAwayInactiv_NPL" 32938 "Fid_GearbxPtCANErr_NPL" 32939 "Fid_GearbxTrqLimErr_NPL" 32940 "Fid_Gearbx_GearDet_NPL" 32941 "Fid_Gearbx_TrqIntv_Err_NPL" 32942 "Fid_GlwCtl1_NPL" 32943 "Fid_HDC_NPL" 32944 "Fid_IndSys1_NPL" 32945 "Fid_IndSys2_NPL" 32946 "Fid_InjCrvCoErr_NPL" 32947 "Fid_InjCtl_qLimErr_NPL" 32948 "Fid_InjVlvWvCorOff_NPL" 32949 "Fid_LIGovSetpDrvAway_NPL" 32950 "Fid_LIGovSetpointDrvAwy_NPL" 32951 "Fid_LIGovUbr_NPL" 32952 "Fid_LSUCDMon0_NPL" 32953 "Fid_LSUCDO20_NPL" 32954 "Fid_LSUCDRi0_NPL" 32955 "Fid_LSUCDactiv0_NPL" 32956 "Fid_LSUCDlsu0_NPL" 32957 "Fid_LSUClbSched_NPL" 32958 "Fid_LSUCtl0_NPL" 32959 "Fid_LSUMonAllChecks_NPL" 32960 "Fid_LSUMonPlausChk_NPL" 32961 "Fid_Layer_FI_TANS_NPL" 32962 "Fid_Layer_FI_TUMG_NPL" 32963 "Fid_Layer_MANHYDR_NPL" 32964 "Fid_Layer_MANLUFT_NPL" 32965 "Fid_MSidCD_ECU_NPL" 32966 "Fid_MSidCD_Pin_NPL" 32967 "Fid_MeUnCDCalcI_NPL" 32968 "Fid_OTSCD_NPL" 32969 "Fid_PCR_NPL" 32970 "Fid_PCRBalGvnr_NPL" 32971 "Fid_PCRExtnLimActr_NPL" 32972 "Fid_PCRGvnrDvtNeg_NPL" 32973 "Fid_PCRGvnrDvtPos_NPL" 32974 "Fid_PCRLPGvnrDvtNeg_NPL" 32975 "Fid_PCRLPGvnrDvtPos_NPL" 32976 "Fid_PCRSurgeLIGov_NPL" 32977 "Fid_PCR_LP_NPL" 32978 "Fid_PCR_LPMS_NPL" 32979 "Fid_PCR_MS_NPL" 32980 "Fid_PCR_SurgeDet_NPL" 32981 "Fid_PCVCDCalcI_NPL" 32982 "Fid_PFltAshCor_NPL" 32983 "Fid_PFltAshCorRgn_NPL" 32984 "Fid_PFltBrk_NPL" 32985 "Fid_PFltChar_NPL" 32986 "Fid_PFltChngPar_NPL" 32987 "Fid_PFltClth_NPL" 32988 "Fid_PFltDiagRls1_NPL" 32989 "Fid_PFltDiagRls2_NPL" 32990 "Fid_PFltDynChk_NPL" 32991 "Fid_PFltEngPrtRgnMon_NPL" 32992 "Fid_PFltGearDet_NPL" 32993 "Fid_PFltHsLnChk_NPL" 32994 "Fid_PFltLckRgnErr_NPL" 32995 "Fid_PFltLckRgnFuel_NPL" 32996 "Fid_PFltNumPFltErr_NPL" 32997 "Fid_PFltNumPFltErrLck_NPL" 32998 "Fid_PFltPPreErr_NPL" 32999 "Fid_PFltPlausPres_NPL" 33000 "Fid_PFltPlausTemp_NPL" 33001 "Fid_PFltPresPlausProj_NPL" 33002 "Fid_PFltPresSensFrz_NPL" 33003 "Fid_PFltPresSensHsLn_NPL" 33004 "Fid_PFltSRCPres_NPL" 33005 "Fid_PFltSRCTemp_NPL" 33006 "Fid_PFltSimOn_NPL" 33007 "Fid_PFltSpdVeh_NPL" 33008 "Fid_PFltSuc_NPL" 33009 "Fid_PFltTempAir_NPL" 33010 "Fid_PFltTempClnt_NPL" 33011 "Fid_PFltTempOxiPre_NPL" 33012 "Fid_PFltTempPre_NPL" 33013 "Fid_PFltTempSensFrz_NPL" 33014 "Fid_PFltVltgBatt_NPL" 33015 "Fid_RailCDRPSErrChk_NPL" 33016 "Fid_RailCDSubstVal_NPL" 33017 "Fid_RailCD_PMonStrt_NPL" 33018 "Fid_RailCtlMode_NPL" 33019 "Fid_RailMeUn0Blk_NPL" 33020 "Fid_RailMeUn0Rls_NPL" 33021 "Fid_RailMeUn1Blk_NPL" 33022 "Fid_RailMeUn1Rls_NPL" 33023 "Fid_RailMeUn2Blk_NPL" 33024 "Fid_RailMeUn2Rls_NPL" 33025 "Fid_RailMeUn3Blk_NPL" 33026 "Fid_RailMeUn3Rls_NPL" 33027 "Fid_RailMeUn4Blk_NPL" 33028 "Fid_RailMeUn4Rls_NPL" 33029 "Fid_RailMeUnCtlMode_NPL" 33030 "Fid_RailPCV0Blk_NPL" 33031 "Fid_RailPCV0Rls_NPL" 33032 "Fid_RailPCV1Blk_NPL" 33033 "Fid_RailPCV1Rls_NPL" 33034 "Fid_RailPCV2Blk_NPL" 33035 "Fid_RailPCV2Rls_NPL" 33036 "Fid_RailPCV3Blk_NPL" 33037 "Fid_RailPCV3Rls_NPL" 33038 "Fid_RailPCV4Blk_NPL" 33039 "Fid_RailPCV4Rls_NPL" 33040 "Fid_RailPCV5Blk_NPL" 33041 "Fid_RailPCV5Rls_NPL" 33042 "Fid_RailPCVCtlMode_NPL" 33043 "Fid_RailSetPointLim_NPL" 33044 "Fid_RailSetPointRed_NPL" 33045 "Fid_ShuttrCTS_NPL" 33046 "Fid_ShuttrEGS_NPL" 33047 "Fid_SignalsTstNLim_NPL" 33048 "Fid_StSysImmo_NPL" 33049 "Fid_StSysStrtTipGbxDat_NPL" 33050 "Fid_T15CDCanError_NPL" 33051 "Fid_T50CDSig_NPL" 33052 "Fid_UsrDa_FDCOff_NPL" 33053 "Fid_VehDaDist_NPL" 33054 "Fid_ZFCClbActv_NPL" 33055 "Fid_ZFCCldCmbCham_NPL" 61441 "Fid_ACCIRevErr" 61442 "Fid_ACCRevErr" 61443 "Fid_ACC_AliveErr" 61444 "Fid_ACC_CsErr" 61445 "Fid_ACC_TiOutErr" 61446 "Fid_ACCtl" 61447 "Fid_ACCtlDflt1" 61448 "Fid_ACCtlDflt2" 61449 "Fid_ACCtl_ACTrqErr" 61450 "Fid_ACCtl_CTSErr" 61451 "Fid_ACCtl_FanErr" 61452 "Fid_ACCtl_TGearbxErr" 61453 "Fid_ACCtl_VSSErr" 61454 "Fid_ACTrqC" 61455 "Fid_AFSCD" 61456 "Fid_AFSCD_AirPerTime" 61457 "Fid_AFSCD_PlOffsDrft" 61458 "Fid_AFSCD_PlSetyDrft" 61459 "Fid_AFSCD_SRCCorrAirm" 61460 "Fid_AFSCD_SRCDcyc" 61461 "Fid_AFSCD_SRCRawAirm" 61462 "Fid_AFSCD_SRCRefSig" 61463 "Fid_AFS_CanMon" 61464 "Fid_AFS_GenDisableCond" 61465 "Fid_AOHt_AltErr" 61466 "Fid_AOHt_ShutOffErr" 61467 "Fid_APP1" 61468 "Fid_APP2" 61469 "Fid_APPKickdown" 61470 "Fid_APSCD" 61471 "Fid_ARSOff" 61472 "Fid_ASDdc" 61473 "Fid_ASModSwtOffEng" 61474 "Fid_ASModSwtOffIndVol" 61475 "Fid_AccPed" 61476 "Fid_AccPedBrkPres" 61477 "Fid_AccPedVel" 61478 "Fid_AccPed_Brk" 61479 "Fid_AirCtl" 61480 "Fid_AirCtlNeg" 61481 "Fid_AirCtlNeg2" 61482 "Fid_AirCtlPFltEGRRed" 61483 "Fid_AirCtlPlateBreak" 61484 "Fid_AirCtlPlateBreakActv" 61485 "Fid_AirCtlPos" 61486 "Fid_AirCtlPos2" 61487 "Fid_AirCtl_Brk" 61488 "Fid_BPSCDMon" 61489 "Fid_CTSCDFlTemp" 61490 "Fid_CTSCD_Plaus" 61491 "Fid_ClgDynTst" 61492 "Fid_CmbChb" 61493 "Fid_CoDT_GripDeb" 61494 "Fid_CoEngIRevSys1" 61495 "Fid_CoEngIRevSys2" 61496 "Fid_CoEngIRevVeh" 61497 "Fid_CoEngPFltErr" 61498 "Fid_CoEngRevSys1" 61499 "Fid_CoEngRevSys2" 61500 "Fid_CoEngRevVeh" 61501 "Fid_CoEngShOffTst" 61502 "Fid_CoEngSoftShOffTV" 61503 "Fid_CoEng_ActrPrt" 61504 "Fid_CoEng_Nrml2Strt" 61505 "Fid_CoEng_PwrStgEnable" 61506 "Fid_CoEng_trqLimErr" 61507 "Fid_CoEng_trqLimErr1" 61508 "Fid_CoEng_trqLimErr2" 61509 "Fid_CoEng_trqLimErr3" 61510 "Fid_CoEng_trqLimErr4" 61511 "Fid_CoVM_StabDem_Err" 61512 "Fid_CoVehtrqLimErr" 61513 "Fid_CpBVlvOff" 61514 "Fid_CrCtlShutOffIr" 61515 "Fid_CrCtl_ASCTimeout" 61516 "Fid_CrCtl_CanDef" 61517 "Fid_CrCtl_KombiTimeout" 61518 "Fid_CrCtl_vCrCtl" 61519 "Fid_DCCIRevErr" 61520 "Fid_DCCRevErr" 61521 "Fid_DCC_AliveErr" 61522 "Fid_DCC_CsErr" 61523 "Fid_DCC_PlausErr" 61524 "Fid_DCC_TiOutErr" 61525 "Fid_DSM_Wuc" 61526 "Fid_EATSCDTSubs" 61527 "Fid_EBAFCD" 61528 "Fid_EBFCD" 61529 "Fid_ECU" 61530 "Fid_EGSysCoLSU0" 61531 "Fid_EGSysCoNSC" 61532 "Fid_EGSysCoOxi" 61533 "Fid_EGSysCoTrbn" 61534 "Fid_EGSysCoTube0" 61535 "Fid_EGSysCoTube1" 61536 "Fid_EGSysHtgDel" 61537 "Fid_EGSysNSC" 61538 "Fid_EGSysOxiCat" 61539 "Fid_EGSysPresEnv" 61540 "Fid_EGSysStrt" 61541 "Fid_EGSysTemp" 61542 "Fid_EGSysTrbn" 61543 "Fid_EGSysTube" 61544 "Fid_EGSys_AP" 61545 "Fid_EGTRgnLck" 61546 "Fid_EGTTempGvnrAirCtl" 61547 "Fid_EGTTempGvnrInr" 61548 "Fid_EGTTempGvnrOutr" 61549 "Fid_EMCCD_ShutOff" 61550 "Fid_ETClbCorActv" 61551 "Fid_EngCTSCD" 61552 "Fid_EngMCaSBackUp" 61553 "Fid_EngMCrSBackUp" 61554 "Fid_EngMTEng" 61555 "Fid_EngMTrqFrcPDiff" 61556 "Fid_EngMVVeh" 61557 "Fid_EngM_ChkStrtSpd" 61558 "Fid_EngPrt_nLimErr" 61559 "Fid_FBC" 61560 "Fid_FBCMonI" 61561 "Fid_FMASwtOff1" 61562 "Fid_FMASwtOff3" 61563 "Fid_FMTC_AirCorr" 61564 "Fid_FMTC_SOECorr" 61565 "Fid_FTSCDErr" 61566 "Fid_FWOscDet" 61567 "Fid_FanCtl" 61568 "Fid_FanGbxOil" 61569 "Fid_FlMngFullLdRglOff" 61570 "Fid_FlMngSmkDefect" 61571 "Fid_FlSysCTSSens" 61572 "Fid_FlSysDens" 61573 "Fid_FlSysFTSSens" 61574 "Fid_FrmMngAPP" 61575 "Fid_FrmMngARS" 61576 "Fid_FrmMngAddLevl" 61577 "Fid_FrmMngBrk" 61578 "Fid_FrmMngBrkDef" 61579 "Fid_FrmMngCoEng" 61580 "Fid_FrmMngCoEng_St2" 61581 "Fid_FrmMngConvDef" 61582 "Fid_FrmMngEngOvrSpd" 61583 "Fid_FrmMngEngRpmTemp" 61584 "Fid_FrmMngEngSpd" 61585 "Fid_FrmMngInjDU1" 61586 "Fid_FrmMngInjDU2" 61587 "Fid_FrmMngInjVlv" 61588 "Fid_FrmMngOBDCtl" 61589 "Fid_FrmMngPFltDef" 61590 "Fid_FrmMngParkConsumer" 61591 "Fid_FrmMngPla_DSC" 61592 "Fid_FrmMngPla_EGS" 61593 "Fid_FrmMngPowerTrainCAN" 61594 "Fid_FrmMngPwrMngLIGovSt" 61595 "Fid_FrmMngSIG_ARS" 61596 "Fid_FrmMngSIG_DSC" 61597 "Fid_FrmMngSig_EGS" 61598 "Fid_FrmMngTO_ARS" 61599 "Fid_FrmMngTO_DSC" 61600 "Fid_FrmMngTo_EGS" 61601 "Fid_FrmMngTrqGearbx" 61602 "Fid_FrmMngWaterVlv" 61603 "Fid_FrmMng_ST_TORQ" 61604 "Fid_FrmMng_stTrq" 61605 "Fid_FrmMngnSetpoint" 61606 "Fid_FrmMngpVal" 61607 "Fid_FrmMngtEng" 61608 "Fid_GearbxDrvAway" 61609 "Fid_GearbxDrvAwayInactiv" 61610 "Fid_GearbxPtCANErr" 61611 "Fid_GearbxTrqLimErr" 61612 "Fid_Gearbx_GearDet" 61613 "Fid_Gearbx_TrqIntv_Err" 61614 "Fid_GlwCtl1" 61615 "Fid_HDC" 61616 "Fid_IndSys1" 61617 "Fid_IndSys2" 61618 "Fid_InjCrvCoErr" 61619 "Fid_InjCtl_qLimErr" 61620 "Fid_InjVlvWvCorOff" 61621 "Fid_LIGovSetpDrvAway" 61622 "Fid_LIGovSetpointDrvAwy" 61623 "Fid_LIGovUbr" 61624 "Fid_LSUCDMon0" 61625 "Fid_LSUCDO20" 61626 "Fid_LSUCDRi0" 61627 "Fid_LSUCDactiv0" 61628 "Fid_LSUCDlsu0" 61629 "Fid_LSUClbSched" 61630 "Fid_LSUCtl0" 61631 "Fid_LSUMonAllChecks" 61632 "Fid_LSUMonPlausChk" 61633 "Fid_Layer_FI_TANS" 61634 "Fid_Layer_FI_TUMG" 61635 "Fid_Layer_MANHYDR" 61636 "Fid_Layer_MANLUFT" 61637 "Fid_MSidCD_ECU" 61638 "Fid_MSidCD_Pin" 61639 "Fid_MeUnCDCalcI" 61640 "Fid_OTSCD" 61641 "Fid_PCR" 61642 "Fid_PCRBalGvnr" 61643 "Fid_PCRExtnLimActr" 61644 "Fid_PCRGvnrDvtNeg" 61645 "Fid_PCRGvnrDvtPos" 61646 "Fid_PCRLPGvnrDvtNeg" 61647 "Fid_PCRLPGvnrDvtPos" 61648 "Fid_PCRSurgeLIGov" 61649 "Fid_PCR_LP" 61650 "Fid_PCR_LPMS" 61651 "Fid_PCR_MS" 61652 "Fid_PCR_SurgeDet" 61653 "Fid_PCVCDCalcI" 61654 "Fid_PFltAshCor" 61655 "Fid_PFltAshCorRgn" 61656 "Fid_PFltBrk" 61657 "Fid_PFltChar" 61658 "Fid_PFltChngPar" 61659 "Fid_PFltClth" 61660 "Fid_PFltDiagRls1" 61661 "Fid_PFltDiagRls2" 61662 "Fid_PFltDynChk" 61663 "Fid_PFltEngPrtRgnMon" 61664 "Fid_PFltGearDet" 61665 "Fid_PFltHsLnChk" 61666 "Fid_PFltLckRgnErr" 61667 "Fid_PFltLckRgnFuel" 61668 "Fid_PFltNumPFltErr" 61669 "Fid_PFltNumPFltErrLck" 61670 "Fid_PFltPPreErr" 61671 "Fid_PFltPlausPres" 61672 "Fid_PFltPlausTemp" 61673 "Fid_PFltPresPlausProj" 61674 "Fid_PFltPresSensFrz" 61675 "Fid_PFltPresSensHsLn" 61676 "Fid_PFltSRCPres" 61677 "Fid_PFltSRCTemp" 61678 "Fid_PFltSimOn" 61679 "Fid_PFltSpdVeh" 61680 "Fid_PFltSuc" 61681 "Fid_PFltTempAir" 61682 "Fid_PFltTempClnt" 61683 "Fid_PFltTempOxiPre" 61684 "Fid_PFltTempPre" 61685 "Fid_PFltTempSensFrz" 61686 "Fid_PFltVltgBatt" 61687 "Fid_RailCDRPSErrChk" 61688 "Fid_RailCDSubstVal" 61689 "Fid_RailCD_PMonStrt" 61690 "Fid_RailCtlMode" 61691 "Fid_RailMeUn0Blk" 61692 "Fid_RailMeUn0Rls" 61693 "Fid_RailMeUn1Blk" 61694 "Fid_RailMeUn1Rls" 61695 "Fid_RailMeUn2Blk" 61696 "Fid_RailMeUn2Rls" 61697 "Fid_RailMeUn3Blk" 61698 "Fid_RailMeUn3Rls" 61699 "Fid_RailMeUn4Blk" 61700 "Fid_RailMeUn4Rls" 61701 "Fid_RailMeUnCtlMode" 61702 "Fid_RailPCV0Blk" 61703 "Fid_RailPCV0Rls" 61704 "Fid_RailPCV1Blk" 61705 "Fid_RailPCV1Rls" 61706 "Fid_RailPCV2Blk" 61707 "Fid_RailPCV2Rls" 61708 "Fid_RailPCV3Blk" 61709 "Fid_RailPCV3Rls" 61710 "Fid_RailPCV4Blk" 61711 "Fid_RailPCV4Rls" 61712 "Fid_RailPCV5Blk" 61713 "Fid_RailPCV5Rls" 61714 "Fid_RailPCVCtlMode" 61715 "Fid_RailSetPointLim" 61716 "Fid_RailSetPointRed" 61717 "Fid_ShuttrCTS" 61718 "Fid_ShuttrEGS" 61719 "Fid_SignalsTstNLim" 61720 "Fid_StSysImmo" 61721 "Fid_StSysStrtTipGbxDat" 61722 "Fid_T15CDCanError" 61723 "Fid_T50CDSig" 61724 "Fid_UsrDa_FDCOff" 61725 "Fid_VehDaDist" 61726 "Fid_ZFCClbActv" 61727 "Fid_ZFCCldCmbCham" /end COMPU_VTAB
/begin COMPU_METHOD Kd_Vel2TrqPrp "Differentialverstärkung (Fahrgeschwindigkeit zu Vortriebsmoment)" RAT_FUNC "%6.5" "Nm/(km/h)" COEFFS 0 3276.8 0 0 0 1 /end COMPU_METHOD
/begin COMPU_METHOD Ki_rpm2Nm "Integralverstärkung Ki (Motordrehzahl EngN zu Motormoment Trq)" RAT_FUNC "%6.5" "Nm/(rpm*s)" COEFFS 0 5368.70912 0 0 0 1 /end COMPU_METHOD
/begin COMPU_METHOD Ki_Vel2TrqPrp "Integralverstärkung (Fahrgeschwindigkeit zu Vortriebsmoment)" RAT_FUNC "%6.4" "Nm/(km/h)/s" COEFFS 0 214.7483648 0 0 0 1 /end COMPU_METHOD
/begin COMPU_METHOD Kp_rpm2Nm "Proportionale Verstärkung Kp (Motordrehzahl EngN zu Moment Trq)" RAT_FUNC "%7.6" "Nm/rpm" COEFFS 0 81920 0 0 0 1 /end COMPU_METHOD
/begin COMPU_METHOD Kp_Vel2TrqPrp "Proportionalverstärkung (Fahrgeschwindigkeit zu Vortriebsmoment)" RAT_FUNC "%6.5" "Nm/(km/h)" COEFFS 0 3276.8 0 0 0 1 /end COMPU_METHOD
/begin COMPU_METHOD Length1 "Abstand in Meter" RAT_FUNC "%6.4" "m" COEFFS 0 128 0 0 0 1 /end COMPU_METHOD
/begin COMPU_METHOD NumPinAdc "verbale Umrechnung für ADC Signale" TAB_VERB "%6.3" "-" COMPU_TAB_REF NumPinAdc /end COMPU_METHOD
/begin COMPU_VTAB NumPinAdc "verbale Umrechnung für ADC Signale" TAB_VERB 27 0 "Water_Temperature_Sensor_182" 1 "Intake_Air_Temperature_Sensor_157" 2 "Charge_Air_Temperature_Sensor_183" 3 "Exhaust_Temperature_Sensor_2_134" 4 "Exhaust_Temperature_Sensor_1_158" 5 "1st_APP_Sensor_252" 6 "2nd_APP_Sensor_239" 7 "ADC_REF" 8 "Boost_Pressure_Sensor_154" 9 "Atmospheric_Pressure_Sensor" 10 "Battery_Voltage_Sensor" 11 "Rail_Pressure_Sensor_156" 12 "Rail_Pressure_Peak_Value_156" 13 "Booster_Voltage_Sensor" 14 "Current_MeUn_Sensor" 15 "Current_PCV_Sensor" 16 "Voltage_Bank_1" 17 "Voltage_Bank_2" 18 "Pressure_Upstream_Particle_Filter_159" 19 "Engine_Oil_Pressure_110" 20 "Temperature_ECU_PCB" 21 "Voltage_Lambda_Ua" 22 "Voltage_Lambda_Ri" 23 "EMCCD_Current_Governor1_124" 24 "EMCCD_Current_Governor2_121" 25 "ADC_DUMMY_NOT_USED" 26 "ADC_DUMMY_A_NOT_USED" /end COMPU_VTAB
/begin COMPU_METHOD OneToOne "eins zu eins (physikalischer Wert ist gleich dem internen Wert)" RAT_FUNC "%6.2" "-" COEFFS 0 1 0 0 0 1 /end COMPU_METHOD
/begin COMPU_METHOD Per_Dur "Periodendauer Segmentzeit" RAT_FUNC "%6.2" "usec" COEFFS 0 1 0 0 0 1 /end COMPU_METHOD
/begin COMPU_METHOD Prc "Prozent, gleiche interne Auflösung wie Fact, aber Darstellung in Prozent (0...100%)" RAT_FUNC "%6.4" "%" COEFFS 0 81.92 0 0 0 1 /end COMPU_METHOD
/begin COMPU_METHOD Prc_1000 "Prozentumrechnung mit größerer Quantisierung, dafür größerer Wertebereich" RAT_FUNC "%6.3" "%" COEFFS 0 8.192 0 0 0 1 /end COMPU_METHOD
/begin COMPU_METHOD RmpTemp "Rampengradient für Temperatur" RAT_FUNC "%6.4" "deg C/s" COEFFS 0 655.36 0 0 0 1 /end COMPU_METHOD
/begin COMPU_METHOD RmpTempCels "temperature ramp gradient in Centigrade" RAT_FUNC "%8.7" "C/ms" COEFFS 0 655360 0 0 0 1 /end COMPU_METHOD
/begin COMPU_METHOD RmpTransR "Umrechnung für die Rampensteigung des Triebstrangübersetzungverhältnisses" RAT_FUNC "%6.5" "1/s" COEFFS 0 6553.6 0 0 0 1 /end COMPU_METHOD
/begin COMPU_METHOD RmpTrqPrp "Rampenanstieg für Vortriebsmoment [Nm/s]" RAT_FUNC "%6.4" "Nm/s" COEFFS 0 327.68 0 0 0 1 /end COMPU_METHOD
/begin COMPU_METHOD t20msxs_ub_b5p1 "K3 Umwandlungen" RAT_FUNC "%6.4" "s" COEFFS 0 1 0 0 0 0.02 /end COMPU_METHOD
/begin COMPU_METHOD TempCels_100ms "Temperatur Differenz in Grad C/sec (bezgl. 100ms task)" RAT_FUNC "%6.2" "deg C/s" COEFFS 0 1 0 0 0 1 /end COMPU_METHOD
/begin COMPU_METHOD Temp_Cels "Temperatur dargestellt in °C (gleiche interne Darstellung wie Temp_Kelv)" RAT_FUNC "%6.1" "deg C" COEFFS 0 10 2731.4 0 0 1 /end COMPU_METHOD
/begin COMPU_METHOD TimeDeb "Entprellzeit in Millisekunden für Libraryfunktion Debounce" RAT_FUNC "%6.1" "ms" COEFFS 0 0.1 0 0 0 1 /end COMPU_METHOD
/begin COMPU_METHOD TimeDelay_s "Zeitkonstante T1 (in s) für PT1, DT1, etc." RAT_FUNC "%9.3" "s" COEFFS 0 0 1 0 0.00023283064365387 0 /end COMPU_METHOD
/begin COMPU_METHOD TimeDT "Abtastzeit (in us) für Library Regler, Filter, etc." RAT_FUNC "%6.2" "us" COEFFS 0 1 0 0 0 1 /end COMPU_METHOD
/begin COMPU_METHOD Time_ms "Zeit in ms für Fehlerentprellung (DSM) und SW-Timer" RAT_FUNC "%6.1" "ms" COEFFS 0 0.1 0 0 0 1 /end COMPU_METHOD
/begin COMPU_METHOD TransR "Übersetzungsverhältnis (Getriebe etc.)" RAT_FUNC "%6.4" "-" COEFFS 0 100 0 0 0 1 /end COMPU_METHOD
/begin COMPU_METHOD Trq "Motormoment" RAT_FUNC "%6.3" "Nm" COEFFS 0 10 0 0 0 1 /end COMPU_METHOD
/begin COMPU_METHOD TrqPrp "Vortriebsmoment" RAT_FUNC "%6.3" "Nm" COEFFS 0 5 0 0 0 1 /end COMPU_METHOD
/begin COMPU_METHOD Vel "Fahrzeuggeschwindigkeit, gleiche interne Auflösung wie Vel_SI" RAT_FUNC "%6.4" "km/h" COEFFS 0 100 0 0 0 1 /end COMPU_METHOD
/begin COMPU_METHOD Vel2TrqPrp "Umwandlung von Fahrgeschwindigkeit zu Vortriebsmoment" RAT_FUNC "%6.4" "Nm/(km/h)" COEFFS 0 409.6 0 0 0 1 /end COMPU_METHOD
/begin COMPU_METHOD VelToN "Verhältnis Fahrzeuggeschwindigkeit zu Motordrehzahl v/n" RAT_FUNC "%8.7" "(km/h)/rpm" COEFFS 0 100000 0 0 0 1 /end COMPU_METHOD
/begin COMPU_METHOD Vel_mph "vehicle speed in mph" RAT_FUNC "%6.4" "mph" COEFFS 0 100 0 0 0 1 /end COMPU_METHOD
/begin COMPU_METHOD Vel_mpm "Umrechnung von Kmph nach mpm" RAT_FUNC "%6.4" "m/min" COEFFS 0 100 0 0 0 1 /end COMPU_METHOD
/begin COMPU_METHOD Volt "Spannung in V (von ADC)" RAT_FUNC "%6.2" "mV" COEFFS 0 0.2046 0 0 0 1 /end COMPU_METHOD
/begin COMPU_METHOD Volt_Batt "Batteriespannung" RAT_FUNC "%6.1" "mV" COEFFS 0 0.05115 0 0 0 1 /end COMPU_METHOD
/begin COMPU_METHOD WheelN "Umrechnung fuer RPM" RAT_FUNC "%6.2" "rpm" COEFFS 0 1 0 0 0 1 /end COMPU_METHOD
/begin RECORD_LAYOUT Kf_Xs16_Ys16_Ws16 NO_AXIS_PTS_X 1 SWORD NO_AXIS_PTS_Y 2 SWORD AXIS_PTS_X 3 SWORD INDEX_INCR DIRECT AXIS_PTS_Y 4 SWORD INDEX_INCR DIRECT FNC_VALUES 5 SWORD COLUMN_DIR DIRECT /end RECORD_LAYOUT
/begin RECORD_LAYOUT Kl_Xs16_Ws16 NO_AXIS_PTS_X 1 SWORD AXIS_PTS_X 2 SWORD INDEX_INCR DIRECT FNC_VALUES 3 SWORD COLUMN_DIR DIRECT /end RECORD_LAYOUT
/begin RECORD_LAYOUT KwWU16 FNC_VALUES 1 UWORD COLUMN_DIR DIRECT /end RECORD_LAYOUT
/begin RECORD_LAYOUT KwWU8 FNC_VALUES 1 UBYTE COLUMN_DIR DIRECT /end RECORD_LAYOUT
/begin RECORD_LAYOUT Kw_Ws16 FNC_VALUES 1 SWORD COLUMN_DIR DIRECT /end RECORD_LAYOUT
/begin RECORD_LAYOUT Kw_Ws32 FNC_VALUES 1 SLONG COLUMN_DIR DIRECT /end RECORD_LAYOUT
/begin RECORD_LAYOUT Kw_Ws8 FNC_VALUES 1 SBYTE COLUMN_DIR DIRECT /end RECORD_LAYOUT
/begin RECORD_LAYOUT Kw_Wu16 FNC_VALUES 1 UWORD COLUMN_DIR DIRECT /end RECORD_LAYOUT
/begin RECORD_LAYOUT Kw_Wu32 FNC_VALUES 1 ULONG COLUMN_DIR DIRECT /end RECORD_LAYOUT
/begin RECORD_LAYOUT Kw_Wu8 FNC_VALUES 1 UBYTE COLUMN_DIR DIRECT /end RECORD_LAYOUT
/end MODULE
/end PROJECT
