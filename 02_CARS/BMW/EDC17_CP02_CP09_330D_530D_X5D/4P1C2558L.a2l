ASAP2_VERSION 1 4
/begin PROJECT P_558 "EDC17_CP02"
/begin HEADER "" VERSION "V1C1" PROJECT_NO P_558 /end HEADER
/begin MODULE DIM ""
/begin MOD_COMMON "" BYTE_ORDER MSB_LAST ALIGNMENT_BYTE 1 ALIGNMENT_WORD 2 ALIGNMENT_LONG 4 ALIGNMENT_FLOAT32_IEEE 4 /end MOD_COMMON
/begin CHARACTERISTIC AFS_dmAirSubsVal_MAP "" MAP 0x8006DCA8 Map_Xs16Ys16Ws16 1000.000 AirMassPerTime 0.00 1000.000 FORMAT "%8.3" EXTENDED_LIMITS -3276.800 3276.700
 /begin AXIS_DESCR STD_AXIS Epm_nEng EngN 16 0.00 6000.000 FORMAT "%8.3" EXTENDED_LIMITS -16384.00 16383.50 DEPOSIT ABSOLUTE /end AXIS_DESCR
 /begin AXIS_DESCR STD_AXIS Air_pCACDs Pres_hPa 16 0.00 3500.000 FORMAT "%8.3" EXTENDED_LIMITS -32768.00 32767.00 DEPOSIT ABSOLUTE /end AXIS_DESCR
/end CHARACTERISTIC
/begin CHARACTERISTIC AFS_dmIdlAirMsLim_C "" VALUE 0x8006E17C Val_Ws16 1000.000 AirMassPerTime 0.00 1000.000 FORMAT "%8.3" EXTENDED_LIMITS -3276.800 3276.700 /end CHARACTERISTIC
/begin CHARACTERISTIC AFS_dmLdAirMsLim_C "" VALUE 0x8006E17E Val_Ws16 1000.000 AirMassPerTime 0.00 1000.000 FORMAT "%8.3" EXTENDED_LIMITS -3276.800 3276.700 /end CHARACTERISTIC
/begin CHARACTERISTIC AFS_dmTransf_CUR "" CURVE 0x80046A80 Cur_Xs16Ws16 2000.000 AirMassPerTime -1000.000 1000.000 FORMAT "%8.3" EXTENDED_LIMITS -3276.800 3276.700
 /begin AXIS_DESCR STD_AXIS AFS_tiRaw Time_PwmHigh 32 -1638.400 1638.350 FORMAT "%8.3" DEPOSIT ABSOLUTE /end AXIS_DESCR
/end CHARACTERISTIC
/begin CHARACTERISTIC AFS_dpLdAdjThresHi_C "" VALUE 0x8006E180 Val_Ws16 3500.000 RmpPres_hPa 0.00 3500.000 FORMAT "%8.3" EXTENDED_LIMITS -500.0000 499.9847 /end CHARACTERISTIC
/begin CHARACTERISTIC AFS_dqLdAdjThresHi_C "" VALUE 0x8006E182 Val_Ws16 327.6700 RmpInjMass 0.00 327.6700 FORMAT "%8.4" EXTENDED_LIMITS -5.000000 4.999847 /end CHARACTERISTIC
/begin CHARACTERISTIC AFS_drWtPenDetThresHi_C "" VALUE 0x8006E184 Val_Ws16 3.000000 Rmp_1 0.00 3.000000 FORMAT "%8.6" EXTENDED_LIMITS -32.76800 32.76700 /end CHARACTERISTIC
/begin CHARACTERISTIC AFS_dtAirThres_C "" VALUE 0x8006DEEC Val_Ws16 65535.00 TempCels_100ms -32768.00 32767.00 FORMAT "%8.2" /end CHARACTERISTIC
/begin CHARACTERISTIC AFS_facCorExtpIdl_CUR "" CURVE 0x8006E186 Cur_Xs16Ws16 4.000000 Fact 0.00 4.000000 FORMAT "%8.6" EXTENDED_LIMITS -4.000000 3.999878
 /begin AXIS_DESCR STD_AXIS AFS_facCorIpo_mp Fact 16 0.00 1.000000 FORMAT "%8.6" EXTENDED_LIMITS -4.000000 3.999878 DEPOSIT ABSOLUTE /end AXIS_DESCR
/end CHARACTERISTIC
/begin CHARACTERISTIC AFS_facCorExtpLd_CUR "" CURVE 0x8006E1C8 Cur_Xs16Ws16 4.000000 Fact 0.00 4.000000 FORMAT "%8.6" EXTENDED_LIMITS -4.000000 3.999878
 /begin AXIS_DESCR STD_AXIS AFS_facCorIpo_mp Fact 16 0.00 3.000000 FORMAT "%8.6" EXTENDED_LIMITS -4.000000 3.999878 DEPOSIT ABSOLUTE /end AXIS_DESCR
/end CHARACTERISTIC
/begin CHARACTERISTIC AFS_facHiThresIdlAdjVal_C "" VALUE 0x8006E20A Val_Ws16 3.000000 Fact 0.00 3.000000 FORMAT "%8.6" EXTENDED_LIMITS -4.000000 3.999878 /end CHARACTERISTIC
/begin CHARACTERISTIC AFS_facHiThresLdAdjVal_C "" VALUE 0x8006E20C Val_Ws16 3.000000 Fact 0.00 3.000000 FORMAT "%8.6" EXTENDED_LIMITS -4.000000 3.999878 /end CHARACTERISTIC
/begin CHARACTERISTIC AFS_facIdlAdjValStepLim_C "" VALUE 0x8006E20E Val_Ws16 3.000000 Fact 0.00 3.000000 FORMAT "%8.6" EXTENDED_LIMITS -4.000000 3.999878 /end CHARACTERISTIC
/begin CHARACTERISTIC AFS_facLdAdjValStepLim_C "" VALUE 0x8006E210 Val_Ws16 3.000000 Fact 0.00 3.000000 FORMAT "%8.6" EXTENDED_LIMITS -4.000000 3.999878 /end CHARACTERISTIC
/begin CHARACTERISTIC AFS_facLoThresIdlAdjVal_C "" VALUE 0x8006E212 Val_Ws16 2.000000 Fact 0.00 2.000000 FORMAT "%8.6" EXTENDED_LIMITS -4.000000 3.999878 /end CHARACTERISTIC
/begin CHARACTERISTIC AFS_facLoThresLdAdjVal_C "" VALUE 0x8006E214 Val_Ws16 2.000000 Fact 0.00 2.000000 FORMAT "%8.6" EXTENDED_LIMITS -4.000000 3.999878 /end CHARACTERISTIC
/begin CHARACTERISTIC AFS_facPerCor_C "" VALUE 0x80046B02 Val_Ws16 7.999878 Fact -4.000000 3.999878 FORMAT "%8.6" /end CHARACTERISTIC
/begin CHARACTERISTIC AFS_facPlsCor_MAP "" MAP 0x8006DEEE Map_Xs16Ys16Ws16 1.000000 Fact 0.00 1.000000 FORMAT "%8.6" EXTENDED_LIMITS -4.000000 3.999878
 /begin AXIS_DESCR STD_AXIS Epm_nEng EngN 16 0.00 6000.000 FORMAT "%8.3" EXTENDED_LIMITS -16384.00 16383.50 DEPOSIT ABSOLUTE /end AXIS_DESCR
 /begin AXIS_DESCR STD_AXIS InjCtl_qCurr InjMass 16 0.00 327.6700 FORMAT "%8.4" EXTENDED_LIMITS -327.6800 327.6700 DEPOSIT ABSOLUTE /end AXIS_DESCR
/end CHARACTERISTIC
/begin CHARACTERISTIC AFS_facSwtOnCor_C "" VALUE 0x8006E132 Val_Ws16 3.000000 Fact 0.00 3.000000 FORMAT "%8.6" EXTENDED_LIMITS -4.000000 3.999878 /end CHARACTERISTIC
/begin CHARACTERISTIC AFS_HiBattDeb.tiHiLo_C "/" VALUE 0x8006E134 Kw_Ws16 655350.0 TimeDeb -327680.0 327670.0 FORMAT "%8.1" /end CHARACTERISTIC
/begin CHARACTERISTIC AFS_HiBattDeb.tiLoHi_C "/" VALUE 0x8006E136 Kw_Ws16 655350.0 TimeDeb -327680.0 327670.0 FORMAT "%8.1" /end CHARACTERISTIC
/begin CHARACTERISTIC AFS_HiTempDeb.tiHiLo_C "/" VALUE 0x8006E138 Kw_Ws16 655350.0 TimeDeb -327680.0 327670.0 FORMAT "%8.1" /end CHARACTERISTIC
/begin CHARACTERISTIC AFS_HiTempDeb.tiLoHi_C "/" VALUE 0x8006E13A Kw_Ws16 655350.0 TimeDeb -327680.0 327670.0 FORMAT "%8.1" /end CHARACTERISTIC
/begin CHARACTERISTIC AFS_LoBattDeb.tiHiLo_C "/" VALUE 0x8006E13C Kw_Ws16 655350.0 TimeDeb -327680.0 327670.0 FORMAT "%8.1" /end CHARACTERISTIC
/begin CHARACTERISTIC AFS_LoBattDeb.tiLoHi_C "/" VALUE 0x8006E13E Kw_Ws16 655350.0 TimeDeb -327680.0 327670.0 FORMAT "%8.1" /end CHARACTERISTIC
/begin CHARACTERISTIC AFS_LoTempDeb.tiHiLo_C "/" VALUE 0x8006E140 Kw_Ws16 655350.0 TimeDeb -327680.0 327670.0 FORMAT "%8.1" /end CHARACTERISTIC
/begin CHARACTERISTIC AFS_LoTempDeb.tiLoHi_C "/" VALUE 0x8006E142 Kw_Ws16 655350.0 TimeDeb -327680.0 327670.0 FORMAT "%8.1" /end CHARACTERISTIC
/begin CHARACTERISTIC AFS_nAvrgIdlAdjThresHi_C "" VALUE 0x8006E216 Val_Ws16 5960.000 EngN 40.00000 6000.000 FORMAT "%8.3" EXTENDED_LIMITS -16384.00 16383.50 /end CHARACTERISTIC
/begin CHARACTERISTIC AFS_nAvrgIdlAdjThresLo_C "" VALUE 0x8006E218 Val_Ws16 5960.000 EngN 40.00000 6000.000 FORMAT "%8.3" EXTENDED_LIMITS -16384.00 16383.50 /end CHARACTERISTIC
/begin CHARACTERISTIC AFS_nAvrgThrHiPlHi_C "" VALUE 0x8006E144 Val_Ws16 6000.000 EngN 0.00 6000.000 FORMAT "%8.3" EXTENDED_LIMITS -16384.00 16383.50 /end CHARACTERISTIC
/begin CHARACTERISTIC AFS_nAvrgThrHiPlLo_C "" VALUE 0x8006E146 Val_Ws16 6000.000 EngN 0.00 6000.000 FORMAT "%8.3" EXTENDED_LIMITS -16384.00 16383.50 /end CHARACTERISTIC
/begin CHARACTERISTIC AFS_nAvrgThrHiSRCLo_C "" VALUE 0x80046B04 Val_Ws16 6000.000 EngN 0.00 6000.000 FORMAT "%8.3" EXTENDED_LIMITS -16384.00 16383.50 /end CHARACTERISTIC
/begin CHARACTERISTIC AFS_nAvrgThrLoPlHi_C "" VALUE 0x8006E148 Val_Ws16 6000.000 EngN 0.00 6000.000 FORMAT "%8.3" EXTENDED_LIMITS -16384.00 16383.50 /end CHARACTERISTIC
/begin CHARACTERISTIC AFS_nAvrgThrLoPlLo_C "" VALUE 0x8006E14A Val_Ws16 6000.000 EngN 0.00 6000.000 FORMAT "%8.3" EXTENDED_LIMITS -16384.00 16383.50 /end CHARACTERISTIC
/begin CHARACTERISTIC AFS_nAvrgThrLoSRCLo_C "" VALUE 0x80046B06 Val_Ws16 6000.000 EngN 0.00 6000.000 FORMAT "%8.3" EXTENDED_LIMITS -16384.00 16383.50 /end CHARACTERISTIC
/begin CHARACTERISTIC AFS_pAirThrLo_C "" VALUE 0x8006E14C Val_Ws16 3000.000 Pres_hPa 500.0000 3500.000 FORMAT "%8.3" EXTENDED_LIMITS -32768.00 32767.00 /end CHARACTERISTIC
/begin CHARACTERISTIC AFS_pBstAtmDiffLim_C "" VALUE 0x8006E21A Val_Ws16 3500.000 Pres_hPa 0.00 3500.000 FORMAT "%8.3" EXTENDED_LIMITS -32768.00 32767.00 /end CHARACTERISTIC
/begin CHARACTERISTIC AFS_pBstLdAdjThresHi_C "" VALUE 0x8006E21C Val_Ws16 3500.000 Pres_hPa 0.00 3500.000 FORMAT "%8.3" EXTENDED_LIMITS -32768.00 32767.00 /end CHARACTERISTIC
/begin CHARACTERISTIC AFS_pBstLdAdjThresLo_C "" VALUE 0x8006E21E Val_Ws16 3500.000 Pres_hPa 0.00 3500.000 FORMAT "%8.3" EXTENDED_LIMITS -32768.00 32767.00 /end CHARACTERISTIC
/begin CHARACTERISTIC AFS_pBstThrHiPlHi_C "" VALUE 0x8006E14E Val_Ws16 3500.000 Pres_hPa 0.00 3500.000 FORMAT "%8.3" EXTENDED_LIMITS -32768.00 32767.00 /end CHARACTERISTIC
/begin CHARACTERISTIC AFS_pBstThrLoPlLo_C "" VALUE 0x8006E150 Val_Ws16 3500.000 Pres_hPa 0.00 3500.000 FORMAT "%8.3" EXTENDED_LIMITS -32768.00 32767.00 /end CHARACTERISTIC
/begin CHARACTERISTIC AFS_qAirmThrSRCHiActv_CUR "" CURVE 0x80046B08 Cur_Xs16Ws16 100.0000 InjMass 0.00 100.0000 FORMAT "%8.4" EXTENDED_LIMITS -327.6800 327.6700
 /begin AXIS_DESCR STD_AXIS Epm_nEng EngN 25 0.00 6000.000 FORMAT "%8.3" EXTENDED_LIMITS -16384.00 16383.50 DEPOSIT ABSOLUTE /end AXIS_DESCR
/end CHARACTERISTIC
/begin CHARACTERISTIC AFS_qCurrIdlAdjThresHi_C "" VALUE 0x8006E220 Val_Ws16 327.6700 InjMass 0.00 327.6700 FORMAT "%8.4" EXTENDED_LIMITS -327.6800 327.6700 /end CHARACTERISTIC
/begin CHARACTERISTIC AFS_qCurrIdlAdjThresLo_C "" VALUE 0x8006E222 Val_Ws16 327.6700 InjMass 0.00 327.6700 FORMAT "%8.4" EXTENDED_LIMITS -327.6800 327.6700 /end CHARACTERISTIC
/begin CHARACTERISTIC AFS_qRawThrHi_C "" VALUE 0x8006E152 Val_Ws16 150.0000 InjMass 0.00 150.0000 FORMAT "%8.4" EXTENDED_LIMITS -327.6800 327.6700 /end CHARACTERISTIC
/begin CHARACTERISTIC AFS_qWinLdAdjThresHi_CUR "" CURVE 0x8006E224 Cur_Xs16Ws16 327.6700 InjMass 0.00 327.6700 FORMAT "%8.4" EXTENDED_LIMITS -327.6800 327.6700
 /begin AXIS_DESCR STD_AXIS Epm_nEng EngN 16 40.00000 6000.000 FORMAT "%8.3" EXTENDED_LIMITS -16384.00 16383.50 DEPOSIT ABSOLUTE /end AXIS_DESCR
/end CHARACTERISTIC
/begin CHARACTERISTIC AFS_qWinLdAdjThresLo_CUR "" CURVE 0x8006E266 Cur_Xs16Ws16 327.6700 InjMass 0.00 327.6700 FORMAT "%8.4" EXTENDED_LIMITS -327.6800 327.6700
 /begin AXIS_DESCR STD_AXIS Epm_nEng EngN 16 40.00000 6000.000 FORMAT "%8.3" EXTENDED_LIMITS -16384.00 16383.50 DEPOSIT ABSOLUTE /end AXIS_DESCR
/end CHARACTERISTIC
/begin CHARACTERISTIC AFS_rAirThrHiPlHi_C "" VALUE 0x8006E154 Val_Ws16 7.999878 Fact -4.000000 3.999878 FORMAT "%8.6" /end CHARACTERISTIC
/begin CHARACTERISTIC AFS_rAirThrLoPlLo_C "" VALUE 0x8006E156 Val_Ws16 7.999878 Fact -4.000000 3.999878 FORMAT "%8.6" /end CHARACTERISTIC
/begin CHARACTERISTIC AFS_rEGRPThrHi_C "" VALUE 0x8006E158 Val_Ws16 400.0000 Prc -200.0000 200.0000 FORMAT "%8.4" EXTENDED_LIMITS -400.0000 399.9878 /end CHARACTERISTIC
/begin CHARACTERISTIC AFS_rSwirlThrHi_C "" VALUE 0x8006E15A Val_Ws16 100.0000 Prc 0.00 100.0000 FORMAT "%8.4" EXTENDED_LIMITS -400.0000 399.9878 /end CHARACTERISTIC
/begin CHARACTERISTIC AFS_rSwirlThrLo_C "" VALUE 0x8006E15C Val_Ws16 100.0000 Prc 0.00 100.0000 FORMAT "%8.4" EXTENDED_LIMITS -400.0000 399.9878 /end CHARACTERISTIC
/begin CHARACTERISTIC AFS_rTVAThrHi_C "" VALUE 0x8006E15E Val_Ws16 100.0000 Prc 0.00 100.0000 FORMAT "%8.4" EXTENDED_LIMITS -400.0000 399.9878 /end CHARACTERISTIC
/begin CHARACTERISTIC AFS_rTVAThrLo_C "" VALUE 0x8006E160 Val_Ws16 100.0000 Prc 0.00 100.0000 FORMAT "%8.4" EXTENDED_LIMITS -400.0000 399.9878 /end CHARACTERISTIC
/begin CHARACTERISTIC AFS_stInhRls_C "" VALUE 0x8006E162 Val_Wu16 65535.00 OneToOne 0.00 65535.00 FORMAT "%8.2" /end CHARACTERISTIC
/begin CHARACTERISTIC AFS_Swt.xVal_C "/" VALUE 0x80046B6E Kw_Wu8 1.000 OneToOne 0.00 1.000 FORMAT "%5.3" EXTENDED_LIMITS 0.00 255.0 /end CHARACTERISTIC
/begin CHARACTERISTIC AFS_Swt.xTyp_C "/" VALUE 0x80046B6F Kw_Wu8 2.000 OneToOne 0.00 2.000 FORMAT "%5.3" EXTENDED_LIMITS 0.00 255.0 /end CHARACTERISTIC
/begin CHARACTERISTIC AFS_swtActvEEPLoThres_C "" VALUE 0x8006E2A8 Val_Wu8 1.000 OneToOne 0.00 1.000 FORMAT "%5.3" EXTENDED_LIMITS 0.00 255.0 /end CHARACTERISTIC
/begin CHARACTERISTIC AFS_swtAirMsCorRls_C "" VALUE 0x8006E2A9 Val_Wu8 1.000 OneToOne 0.00 1.000 FORMAT "%5.3" EXTENDED_LIMITS 0.00 255.0 /end CHARACTERISTIC
/begin CHARACTERISTIC AFS_swtClrEEPAdjVal_C "" VALUE 0x8006E2AA Val_Wu8 1.000 OneToOne 0.00 1.000 FORMAT "%5.3" EXTENDED_LIMITS 0.00 255.0 /end CHARACTERISTIC
/begin CHARACTERISTIC AFS_swtCurrAdjRls_C "" VALUE 0x8006E2AB Val_Wu8 1.000 OneToOne 0.00 1.000 FORMAT "%5.3" EXTENDED_LIMITS 0.00 255.0 /end CHARACTERISTIC
/begin CHARACTERISTIC AFS_swtOffTstSel_C "" VALUE 0x80046B70 Val_Wu8 255.0 OneToOne 0.00 255.0 FORMAT "%5.1" /end CHARACTERISTIC
/begin CHARACTERISTIC AFS_swtOscSel_C "" VALUE 0x80046B71 Val_Wu8 255.0 OneToOne 0.00 255.0 FORMAT "%5.1" /end CHARACTERISTIC
/begin CHARACTERISTIC AFS_swtWtPenMon_C "" VALUE 0x8006E2AC Val_Wu8 1.000 OneToOne 0.00 1.000 FORMAT "%5.3" EXTENDED_LIMITS 0.00 255.0 /end CHARACTERISTIC
/begin CHARACTERISTIC AFS_tAirAdjRlsThresHi_C "" VALUE 0x8006E2AE Val_Ws16 250.0000 Temp_Cels -50.14000 199.8600 FORMAT "%8.4" EXTENDED_LIMITS -3549.940 3003.560 /end CHARACTERISTIC
/begin CHARACTERISTIC AFS_tAirAdjRlsThresLo_C "" VALUE 0x8006E2B0 Val_Ws16 250.0000 Temp_Cels -50.14000 199.8600 FORMAT "%8.4" EXTENDED_LIMITS -3549.940 3003.560 /end CHARACTERISTIC
/begin CHARACTERISTIC AFS_tClntThrHi_C "" VALUE 0x8006E164 Val_Ws16 200.0000 Temp_Cels -50.14000 149.8600 FORMAT "%8.4" EXTENDED_LIMITS -3549.940 3003.560 /end CHARACTERISTIC
/begin CHARACTERISTIC AFS_tClntThrLo_C "" VALUE 0x8006E166 Val_Ws16 200.0000 Temp_Cels -50.14000 149.8600 FORMAT "%8.4" EXTENDED_LIMITS -3549.940 3003.560 /end CHARACTERISTIC
/begin CHARACTERISTIC AFS_tEnvAdjRlsThresHi_C "" VALUE 0x8006E2B2 Val_Ws16 250.0000 Temp_Cels -50.14000 199.8600 FORMAT "%8.4" EXTENDED_LIMITS -3549.940 3003.560 /end CHARACTERISTIC
/begin CHARACTERISTIC AFS_tEnvAdjRlsThresLo_C "" VALUE 0x8006E2B4 Val_Ws16 250.0000 Temp_Cels -50.14000 199.8600 FORMAT "%8.4" EXTENDED_LIMITS -3549.940 3003.560 /end CHARACTERISTIC
/begin CHARACTERISTIC AFS_tiAdjRlsDel_C "" VALUE 0x8006E2B6 Val_Wu16 655350.0 Time_ms 0.00 655350.0 FORMAT "%8.1" /end CHARACTERISTIC
/begin CHARACTERISTIC AFS_tiAirMsPT1_C "" VALUE 0x8006E2B8 Val_Ws32 4294967.2940 TimeDelay_ms 0.0020000000009 4294967.2960 FORMAT "%12.4" /end CHARACTERISTIC
/begin CHARACTERISTIC AFS_tiBstPresPT1_C "" VALUE 0x8006E2BC Val_Ws32 4294967.2940 TimeDelay_ms 0.0020000000009 4294967.2960 FORMAT "%12.4" /end CHARACTERISTIC
/begin CHARACTERISTIC AFS_tiCorFacPT1_C "" VALUE 0x8006E2C0 Val_Ws32 4294967.2940 TimeDelay_ms 0.0020000000009 4294967.2960 FORMAT "%12.4" /end CHARACTERISTIC
/begin CHARACTERISTIC AFS_tiCorSRCHi_C "" VALUE 0x80046B72 Val_Ws16 3276.750 Time_PwmHigh -1638.400 1638.350 FORMAT "%8.3" /end CHARACTERISTIC
/begin CHARACTERISTIC AFS_tiCorSRCLo_C "" VALUE 0x80046B74 Val_Ws16 3276.750 Time_PwmHigh -1638.400 1638.350 FORMAT "%8.3" /end CHARACTERISTIC
/begin CHARACTERISTIC AFS_tiDlyActvSRCHiAirm_C "" VALUE 0x80046B76 Val_Ws16 655350.0 Time_ms -327680.0 327670.0 FORMAT "%8.1" /end CHARACTERISTIC
/begin CHARACTERISTIC AFS_tiDlyEGRPPlSetyDrft_C "" VALUE 0x8006E168 Val_Ws16 655350.0 Time_ms -327680.0 327670.0 FORMAT "%8.1" /end CHARACTERISTIC
/begin CHARACTERISTIC AFS_tiDlyStrPlSetyDrft_C "" VALUE 0x8006E16C Val_Wu32 42949672950.0 Time_ms 0.00 42949672950.0 FORMAT "%13.1" /end CHARACTERISTIC
/begin CHARACTERISTIC AFS_tiDlySwtOnCor_C "" VALUE 0x8006E170 Val_Ws16 655350.0 Time_ms -327680.0 327670.0 FORMAT "%8.1" /end CHARACTERISTIC
/begin CHARACTERISTIC AFS_tiIdlAdjRlsDeb.tiHiLo_C "/" VALUE 0x8006E2C4 Kw_Ws16 655350.0 TimeDeb -327680.0 327670.0 FORMAT "%8.1" /end CHARACTERISTIC
/begin CHARACTERISTIC AFS_tiIdlAdjRlsDeb.tiLoHi_C "/" VALUE 0x8006E2C6 Kw_Ws16 655350.0 TimeDeb -327680.0 327670.0 FORMAT "%8.1" /end CHARACTERISTIC
/begin CHARACTERISTIC AFS_tiLdAdjRlsDeb.tiHiLo_C "/" VALUE 0x8006E2C8 Kw_Ws16 655350.0 TimeDeb -327680.0 327670.0 FORMAT "%8.1" /end CHARACTERISTIC
/begin CHARACTERISTIC AFS_tiLdAdjRlsDeb.tiLoHi_C "/" VALUE 0x8006E2CA Kw_Ws16 655350.0 TimeDeb -327680.0 327670.0 FORMAT "%8.1" /end CHARACTERISTIC
/begin CHARACTERISTIC AFS_tiLPFiltPT1_C "" VALUE 0x80046B78 Val_Ws32 4294967.2940 TimeDelay_ms 0.0020000000009 4294967.2960 FORMAT "%12.4" /end CHARACTERISTIC
/begin CHARACTERISTIC AFS_tiOffsDrftTstDly_C "" VALUE 0x80046B7C Val_Ws16 15000.00 Time_ms 0.00 15000.00 FORMAT "%8.2" EXTENDED_LIMITS -327680.0 327670.0 /end CHARACTERISTIC
/begin CHARACTERISTIC AFS_tiOffsDrftTstLim_C "" VALUE 0x80046B7E Val_Ws16 327670.0 Time_ms 0.00 327670.0 FORMAT "%8.1" EXTENDED_LIMITS -327680.0 327670.0 /end CHARACTERISTIC
/begin CHARACTERISTIC AFS_tiPerHFM6_C "" VALUE 0x80046B80 Val_Ws32 214748.364750 Time_Period_HFM6 -107374.182400 107374.182350 FORMAT "%13.6" /end CHARACTERISTIC
/begin CHARACTERISTIC AFS_tiQntCurrPT1_C "" VALUE 0x8006E2CC Val_Ws32 4294967.2940 TimeDelay_ms 0.0020000000009 4294967.2960 FORMAT "%12.4" /end CHARACTERISTIC
/begin CHARACTERISTIC AFS_tiRawSRCHi_C "" VALUE 0x80046B84 Val_Ws16 3276.750 Time_PwmHigh -1638.400 1638.350 FORMAT "%8.3" /end CHARACTERISTIC
/begin CHARACTERISTIC AFS_tiRawSRCLo_C "" VALUE 0x80046B86 Val_Ws16 3276.750 Time_PwmHigh -1638.400 1638.350 FORMAT "%8.3" /end CHARACTERISTIC
/begin CHARACTERISTIC AFS_tiStrtDelAdjRls_C "" VALUE 0x8006E2D0 Val_Wu32 3600000.00000 Time_ms 0.00 3600000.00000 FORMAT "%13.5" EXTENDED_LIMITS 0.00 42949672950.0 /end CHARACTERISTIC
/begin CHARACTERISTIC AFS_tiThrHiPlOffsDrft_C "" VALUE 0x80046B88 Val_Ws16 3276.750 Time_PwmHigh -1638.400 1638.350 FORMAT "%8.3" /end CHARACTERISTIC
/begin CHARACTERISTIC AFS_tiThrLoPlOffsDrft_C "" VALUE 0x80046B8A Val_Ws16 3276.750 Time_PwmHigh -1638.400 1638.350 FORMAT "%8.3" /end CHARACTERISTIC
/begin CHARACTERISTIC AFS_tiWtPenDeb.tiHiLo_C "/" VALUE 0x8006E2D4 Kw_Ws16 655350.0 TimeDeb -327680.0 327670.0 FORMAT "%8.1" /end CHARACTERISTIC
/begin CHARACTERISTIC AFS_tiWtPenDeb.tiLoHi_C "/" VALUE 0x8006E2D6 Kw_Ws16 655350.0 TimeDeb -327680.0 327670.0 FORMAT "%8.1" /end CHARACTERISTIC
/begin CHARACTERISTIC AFS_tiWtPenDetPT1_C "" VALUE 0x8006E2D8 Val_Ws32 4294967.2940 TimeDelay_ms 0.0020000000009 4294967.2960 FORMAT "%12.4" /end CHARACTERISTIC
/begin CHARACTERISTIC AFS_tTempHi_C "" VALUE 0x8006E172 Val_Ws16 6553.500 Temp_Cels -3549.940 3003.560 FORMAT "%8.3" /end CHARACTERISTIC
/begin CHARACTERISTIC AFS_tTempLo_C "" VALUE 0x8006E174 Val_Ws16 6553.500 Temp_Cels -3549.940 3003.560 FORMAT "%8.3" /end CHARACTERISTIC
/begin CHARACTERISTIC AFS_uBattMax_C "" VALUE 0x8006E176 Val_Ws16 1310700. Volt_Batt -655360.0 655340.0 FORMAT "%8.1" /end CHARACTERISTIC
/begin CHARACTERISTIC AFS_uBattMin_C "" VALUE 0x8006E178 Val_Ws16 1310700. Volt_Batt -655360.0 655340.0 FORMAT "%8.1" /end CHARACTERISTIC
/begin CHARACTERISTIC AFS_vVehLdAdjThresHi_C "" VALUE 0x8006E2DC Val_Ws16 300.0000 Vel 0.00 300.0000 FORMAT "%8.4" EXTENDED_LIMITS -327.6800 327.6700 /end CHARACTERISTIC
/begin CHARACTERISTIC AFS_vVehLdAdjThresLo_C "" VALUE 0x8006E2DE Val_Ws16 300.0000 Vel 0.00 300.0000 FORMAT "%8.4" EXTENDED_LIMITS -327.6800 327.6700 /end CHARACTERISTIC
/begin CHARACTERISTIC AirCtl_AirTempCor.xVal_C "DAMOS-Schalter für additive/multiplikative Lufttemperaturkorrektur/" VALUE 0x8004852A Kw_Wu8 0.00 OneToOne 0.00 0.00 FORMAT "%5.2" EXTENDED_LIMITS 0.00 255.0 /end CHARACTERISTIC
/begin CHARACTERISTIC AirCtl_AirTempCor.xTyp_C "DAMOS-Schalter für additive/multiplikative Lufttemperaturkorrektur/" VALUE 0x8004852B Kw_Wu8 0.00 OneToOne 0.00 0.00 FORMAT "%5.2" EXTENDED_LIMITS 0.00 255.0 /end CHARACTERISTIC
/begin CHARACTERISTIC AirCtl_AirTempCorBasEOMQnt1_MAP "Grundkennfeld für Lufttemperatur in der ersten auf Einspritzmenge basierten Betriebsart" MAP 0x8006E39C Kf_Xs16_Ys16_Ws16 1.000000 AirMassPerCyl 0.00 1.000000 FORMAT "%8.6" EXTENDED_LIMITS -3276.800 3276.700
 /begin AXIS_DESCR STD_AXIS Epm_nEng EngN 16 0.00 6000.000 FORMAT "%8.3" EXTENDED_LIMITS -16384.00 16383.50 DEPOSIT ABSOLUTE /end AXIS_DESCR
 /begin AXIS_DESCR STD_AXIS AirCtl_qDesValInl_mp InjMass 16 0.00 327.6700 FORMAT "%8.4" EXTENDED_LIMITS -327.6800 327.6700 DEPOSIT ABSOLUTE /end AXIS_DESCR
/end CHARACTERISTIC
/begin CHARACTERISTIC AirCtl_AirTempCorBas_MAP "Grundkennfeld für Lufttemperaturkorrektur" MAP 0x8004852C Kf_Xs16_Ys16_Ws16 1.000000 AirMassPerCyl 0.00 1.000000 FORMAT "%8.6" EXTENDED_LIMITS -3276.800 3276.700
 /begin AXIS_DESCR STD_AXIS Epm_nEng EngN 16 0.00 6000.000 FORMAT "%8.3" EXTENDED_LIMITS -16384.00 16383.50 DEPOSIT ABSOLUTE /end AXIS_DESCR
 /begin AXIS_DESCR STD_AXIS AirCtl_qDesVal_mp InjMass 16 0.00 327.6700 FORMAT "%8.4" EXTENDED_LIMITS -327.6800 327.6700 DEPOSIT ABSOLUTE /end AXIS_DESCR
/end CHARACTERISTIC
/begin CHARACTERISTIC AirCtl_DKdEOM_C "" VALUE 0x8004A728 Kw_Ws32 3999.99999814 Kd_Ampc2Prc 0.00 3999.99999814 FORMAT "%13.8" EXTENDED_LIMITS -4000.00000000 3999.99999814 /end CHARACTERISTIC
/begin CHARACTERISTIC AirCtl_DKdmDes_C "" VALUE 0x80049470 Kw_Ws32 32767.9999847 Kd 0.00 32767.9999847 FORMAT "%13.7" EXTENDED_LIMITS -32768.0000000 32767.9999847 /end CHARACTERISTIC
/begin CHARACTERISTIC AirCtl_DKdNegEOM_CUR "" CURVE 0x8004A72C Kl_Xs16_Ws16 62.49809 Kd_Ampc2PrcRedRes 0.00 62.49809 FORMAT "%8.5" EXTENDED_LIMITS -62.50000 62.49809
 /begin AXIS_DESCR STD_AXIS AirCtl_mDesStat AirMassPerCyl 8 -5000.000 5000.000 FORMAT "%8.3" EXTENDED_LIMITS -3276.800 3276.700 DEPOSIT ABSOLUTE /end AXIS_DESCR
/end CHARACTERISTIC
/begin CHARACTERISTIC AirCtl_DKdNegMDes_CUR "" CURVE 0x80049474 Kl_Xs16_Ws16 511.9844 Kd_RedRes 0.00 511.9844 FORMAT "%8.4" EXTENDED_LIMITS -512.0000 511.9844
 /begin AXIS_DESCR STD_AXIS AirCtl_dmDesCor_mp AirMassPerCyl 8 -5000.000 5000.000 FORMAT "%8.3" EXTENDED_LIMITS -3276.800 3276.700 DEPOSIT ABSOLUTE /end AXIS_DESCR
/end CHARACTERISTIC
/begin CHARACTERISTIC AirCtl_DKdNeg_CUR "Grundwert der Verstärkung des DT1-Glieds bei negativen Großsignalen" CURVE 0x80049F40 Kl_Xs16_Ws16 62.49809 Kd_Ampc2PrcRedRes 0.00 62.49809 FORMAT "%8.5" EXTENDED_LIMITS -62.50000 62.49809
 /begin AXIS_DESCR STD_AXIS AirCtl_mDesStat AirMassPerCyl 8 -5000.000 5000.000 FORMAT "%8.3" EXTENDED_LIMITS -3276.800 3276.700 DEPOSIT ABSOLUTE /end AXIS_DESCR
/end CHARACTERISTIC
/begin CHARACTERISTIC AirCtl_DKdPosEOM_CUR "" CURVE 0x8004A74E Kl_Xs16_Ws16 62.49809 Kd_Ampc2PrcRedRes 0.00 62.49809 FORMAT "%8.5" EXTENDED_LIMITS -62.50000 62.49809
 /begin AXIS_DESCR STD_AXIS AirCtl_mDesStat AirMassPerCyl 8 -5000.000 5000.000 FORMAT "%8.3" EXTENDED_LIMITS -3276.800 3276.700 DEPOSIT ABSOLUTE /end AXIS_DESCR
/end CHARACTERISTIC
/begin CHARACTERISTIC AirCtl_DKdPosMDes_CUR "" CURVE 0x80049496 Kl_Xs16_Ws16 511.9844 Kd_RedRes 0.00 511.9844 FORMAT "%8.4" EXTENDED_LIMITS -512.0000 511.9844
 /begin AXIS_DESCR STD_AXIS AirCtl_dmDesCor_mp AirMassPerCyl 8 -5000.000 5000.000 FORMAT "%8.3" EXTENDED_LIMITS -3276.800 3276.700 DEPOSIT ABSOLUTE /end AXIS_DESCR
/end CHARACTERISTIC
/begin CHARACTERISTIC AirCtl_DKdPos_CUR "Grundwert der Verstärkung des DT1-Glieds bei positiven Großsignalen" CURVE 0x80049F62 Kl_Xs16_Ws16 62.49809 Kd_Ampc2PrcRedRes 0.00 62.49809 FORMAT "%8.5" EXTENDED_LIMITS -62.50000 62.49809
 /begin AXIS_DESCR STD_AXIS AirCtl_mDesStat AirMassPerCyl 8 -5000.000 5000.000 FORMAT "%8.3" EXTENDED_LIMITS -3276.800 3276.700 DEPOSIT ABSOLUTE /end AXIS_DESCR
/end CHARACTERISTIC
/begin CHARACTERISTIC AirCtl_DKd_C "Grundwert der Verstärkung des DT1-Glieds bei Kleinsignalen abhängig von Luftmassensollwert" VALUE 0x80049F84 Kw_Ws32 3999.99999814 Kd_Ampc2Prc 0.00 3999.99999814 FORMAT "%13.8" EXTENDED_LIMITS -4000.00000000 3999.99999814 /end CHARACTERISTIC
/begin CHARACTERISTIC AirCtl_dmDesBas.Pos_C "/" VALUE 0x800494C8 Kw_Ws32 3276799.99847 RmpAirMassPerCyl 0.00 3276799.99847 FORMAT "%13.5" EXTENDED_LIMITS -3276800.00000 3276799.99847 /end CHARACTERISTIC
/begin CHARACTERISTIC AirCtl_dmDesBas.Neg_C "/" VALUE 0x800494CC Kw_Ws32 3276799.99847 RmpAirMassPerCyl 0.00 3276799.99847 FORMAT "%13.5" EXTENDED_LIMITS -3276800.00000 3276799.99847 /end CHARACTERISTIC
/begin CHARACTERISTIC AirCtl_dmDWinNegDes_C "" VALUE 0x800494B8 Kw_Ws16 3276.800 AirMassPerCyl -3276.800 0.00 FORMAT "%8.3" EXTENDED_LIMITS -3276.800 3276.700 /end CHARACTERISTIC
/begin CHARACTERISTIC AirCtl_dmDWinNegEOM_C "" VALUE 0x8004A770 Kw_Ws16 6553.500 AirMassPerCyl -3276.800 3276.700 FORMAT "%8.3" /end CHARACTERISTIC
/begin CHARACTERISTIC AirCtl_dmDWinNeg_C "untere Kleinsignalgrenze für das DT1-Glied abhängig von Einspritzmenge" VALUE 0x80049F88 Kw_Ws16 6553.500 AirMassPerCyl -3276.800 3276.700 FORMAT "%8.3" /end CHARACTERISTIC
/begin CHARACTERISTIC AirCtl_dmDWinPosDes_C "" VALUE 0x800494BA Kw_Ws16 3276.700 AirMassPerCyl 0.00 3276.700 FORMAT "%8.3" EXTENDED_LIMITS -3276.800 3276.700 /end CHARACTERISTIC
/begin CHARACTERISTIC AirCtl_dmDWinPosEOM_C "" VALUE 0x8004A772 Kw_Ws16 3276.700 AirMassPerCyl 0.00 3276.700 FORMAT "%8.3" EXTENDED_LIMITS -3276.800 3276.700 /end CHARACTERISTIC
/begin CHARACTERISTIC AirCtl_dmDWinPos_C "untere Kleinsignalgrenze für das DT1-Glied abhängig von Einspritzmenge" VALUE 0x80049F8A Kw_Ws16 3276.700 AirMassPerCyl 0.00 3276.700 FORMAT "%8.3" EXTENDED_LIMITS -3276.800 3276.700 /end CHARACTERISTIC
/begin CHARACTERISTIC AirCtl_dnSurgeHigh_CUR "" CURVE 0x8004AA4C Kl_Xs16_Ws16 3000.000 dn_dZ20 0.00 3000.000 FORMAT "%8.3" EXTENDED_LIMITS -163840.0 163835.0
 /begin AXIS_DESCR STD_AXIS Epm_nEng EngN 5 0.00 6000.000 FORMAT "%8.3" EXTENDED_LIMITS -16384.00 16383.50 DEPOSIT ABSOLUTE /end AXIS_DESCR
/end CHARACTERISTIC
/begin CHARACTERISTIC AirCtl_dnSurgeLow_CUR "" CURVE 0x8004AA62 Kl_Xs16_Ws16 3000.000 dn_dZ20 0.00 3000.000 FORMAT "%8.3" EXTENDED_LIMITS -163840.0 163835.0
 /begin AXIS_DESCR STD_AXIS Epm_nEng EngN 5 0.00 6000.000 FORMAT "%8.3" EXTENDED_LIMITS -16384.00 16383.50 DEPOSIT ABSOLUTE /end AXIS_DESCR
/end CHARACTERISTIC
/begin CHARACTERISTIC AirCtl_EOMI.Ki_C "Parameter für I-Regler im Regenerationsbetrieb/" VALUE 0x8004A774 Kw_Ws32 5.00000396642 Ki_Ampc2Prc 0.00 5.00000396642 FORMAT "%13.11" EXTENDED_LIMITS -122070.312500 122070.312443 /end CHARACTERISTIC
/begin CHARACTERISTIC AirCtl_EOMI.KiPos_C "Parameter für I-Regler im Regenerationsbetrieb/" VALUE 0x8004A778 Kw_Ws32 5.00000396642 Ki_Ampc2Prc 0.00 5.00000396642 FORMAT "%13.11" EXTENDED_LIMITS -122070.312500 122070.312443 /end CHARACTERISTIC
/begin CHARACTERISTIC AirCtl_EOMI.KiNeg_C "Parameter für I-Regler im Regenerationsbetrieb/" VALUE 0x8004A77C Kw_Ws32 5.00000396642 Ki_Ampc2Prc 0.00 5.00000396642 FORMAT "%13.11" EXTENDED_LIMITS -122070.312500 122070.312443 /end CHARACTERISTIC
/begin CHARACTERISTIC AirCtl_EOMI.WinPos_C "Parameter für I-Regler im Regenerationsbetrieb/" VALUE 0x8004A780 Kw_Ws32 1500.00000000 AirMassPerCyl 0.00 1500.00000000 FORMAT "%13.8" EXTENDED_LIMITS -214748364.800 214748364.700 /end CHARACTERISTIC
/begin CHARACTERISTIC AirCtl_EOMI.WinNeg_C "Parameter für I-Regler im Regenerationsbetrieb/" VALUE 0x8004A784 Kw_Ws32 1500.00000000 AirMassPerCyl -1500.00000000 0.00 FORMAT "%13.8" EXTENDED_LIMITS -214748364.800 214748364.700 /end CHARACTERISTIC
/begin CHARACTERISTIC AirCtl_EOMP.Kp_C "Parameter für P-Regler im Regenerationsbetrieb/" VALUE 0x8004A788 Kw_Ws32 10.0000016391 Kp_Ampc2Prc 0.00 10.0000016391 FORMAT "%13.10" EXTENDED_LIMITS -8000.00000000 7999.99999627 /end CHARACTERISTIC
/begin CHARACTERISTIC AirCtl_EOMP.KpPos_C "Parameter für P-Regler im Regenerationsbetrieb/" VALUE 0x8004A78C Kw_Ws32 10.0000016391 Kp_Ampc2Prc 0.00 10.0000016391 FORMAT "%13.10" EXTENDED_LIMITS -8000.00000000 7999.99999627 /end CHARACTERISTIC
/begin CHARACTERISTIC AirCtl_EOMP.KpNeg_C "Parameter für P-Regler im Regenerationsbetrieb/" VALUE 0x8004A790 Kw_Ws32 10.0000016391 Kp_Ampc2Prc 0.00 10.0000016391 FORMAT "%13.10" EXTENDED_LIMITS -8000.00000000 7999.99999627 /end CHARACTERISTIC
/begin CHARACTERISTIC AirCtl_EOMP.WinPos_C "Parameter für P-Regler im Regenerationsbetrieb/" VALUE 0x8004A794 Kw_Ws32 1500.00000000 AirMassPerCyl 0.00 1500.00000000 FORMAT "%13.8" EXTENDED_LIMITS -214748364.800 214748364.700 /end CHARACTERISTIC
/begin CHARACTERISTIC AirCtl_EOMP.WinNeg_C "Parameter für P-Regler im Regenerationsbetrieb/" VALUE 0x8004A798 Kw_Ws32 1500.00000000 AirMassPerCyl -1500.00000000 0.00 FORMAT "%13.8" EXTENDED_LIMITS -214748364.800 214748364.700 /end CHARACTERISTIC
/begin CHARACTERISTIC AirCtl_facActDesVal_C "Sicherheitsfaktor für den zu realisierenden Luftmassenstrom" VALUE 0x8006F7DC Val_Wu16 0.1999512 Fact 0.8000488 1.000000 FORMAT "%8.6" EXTENDED_LIMITS 0.00 7.999878 /end CHARACTERISTIC
/begin CHARACTERISTIC AirCtl_facAirTempCor2_CUR "" CURVE 0x800494D0 Kl_Xs16_Ws16 1.000000 Fact 0.00 1.000000 FORMAT "%8.6" EXTENDED_LIMITS -4.000000 3.999878
 /begin AXIS_DESCR STD_AXIS AirCtl_tEngDesVal_mp Temp_Cels 16 -0.04000000 5999.960 FORMAT "%8.3" EXTENDED_LIMITS -3549.940 3003.560 DEPOSIT ABSOLUTE /end AXIS_DESCR
/end CHARACTERISTIC
/begin CHARACTERISTIC AirCtl_facAirTempCorEOMQnt1_MAP "Kennfeld für Lufttemperaturkorrekturfaktor in der ersten auf Einspritzmenge basierten Betriebsart" MAP 0x8006E5E0 Kf_Xs16_Ys16_Ws16 1.000000 Fact 0.00 1.000000 FORMAT "%8.6" EXTENDED_LIMITS -4.000000 3.999878
 /begin AXIS_DESCR STD_AXIS Epm_nEng EngN 16 0.00 6000.000 FORMAT "%8.3" EXTENDED_LIMITS -16384.00 16383.50 DEPOSIT ABSOLUTE /end AXIS_DESCR
 /begin AXIS_DESCR STD_AXIS AirCtl_tAirDesVal_mp Temp_Cels 12 -50.14000 199.8600 FORMAT "%8.4" EXTENDED_LIMITS -3549.940 3003.560 DEPOSIT ABSOLUTE /end AXIS_DESCR
/end CHARACTERISTIC
/begin CHARACTERISTIC AirCtl_facAirTempCor_MAP "Kennfeld für Lufttemperaturkorrekturfaktor" MAP 0x80048770 Kf_Xs16_Ys16_Ws16 1.000000 Fact 0.00 1.000000 FORMAT "%8.6" EXTENDED_LIMITS -4.000000 3.999878
 /begin AXIS_DESCR STD_AXIS Epm_nEng EngN 16 0.00 6000.000 FORMAT "%8.3" EXTENDED_LIMITS -16384.00 16383.50 DEPOSIT ABSOLUTE /end AXIS_DESCR
 /begin AXIS_DESCR STD_AXIS AirCtl_tAirDesVal_mp Temp_Cels 12 -50.14000 199.8600 FORMAT "%8.4" EXTENDED_LIMITS -3549.940 3003.560 DEPOSIT ABSOLUTE /end AXIS_DESCR
/end CHARACTERISTIC
/begin CHARACTERISTIC AirCtl_facEngTempCorEOMQnt1_MAP "Kennfeld für Motortemperaturkorrektur für die erste auf Einspritzmenge basierten Betriebsart" MAP 0x8006E79C Kf_Xs16_Ys16_Ws16 1.000000 Fact 0.00 1.000000 FORMAT "%8.6" EXTENDED_LIMITS -4.000000 3.999878
 /begin AXIS_DESCR STD_AXIS Epm_nEng EngN 16 0.00 6000.000 FORMAT "%8.3" EXTENDED_LIMITS -16384.00 16383.50 DEPOSIT ABSOLUTE /end AXIS_DESCR
 /begin AXIS_DESCR STD_AXIS AirCtl_tEngDesVal_mp Temp_Cels 12 -50.14000 199.8600 FORMAT "%8.4" EXTENDED_LIMITS -3549.940 3003.560 DEPOSIT ABSOLUTE /end AXIS_DESCR
/end CHARACTERISTIC
/begin CHARACTERISTIC AirCtl_facEngTempCor_MAP "Kennfeld für Motortemperaturkorrekturfaktor" MAP 0x8004892C Kf_Xs16_Ys16_Ws16 1.000000 Fact 0.00 1.000000 FORMAT "%8.6" EXTENDED_LIMITS -4.000000 3.999878
 /begin AXIS_DESCR STD_AXIS Epm_nEng EngN 16 0.00 6000.000 FORMAT "%8.3" EXTENDED_LIMITS -16384.00 16383.50 DEPOSIT ABSOLUTE /end AXIS_DESCR
 /begin AXIS_DESCR STD_AXIS AirCtl_tEngDesVal_mp Temp_Cels 12 -50.14000 199.8600 FORMAT "%8.4" EXTENDED_LIMITS -3549.940 3003.560 DEPOSIT ABSOLUTE /end AXIS_DESCR
/end CHARACTERISTIC
/begin CHARACTERISTIC AirCtl_facEnvPresCorEOMQnt1_CUR "Kennlinie für Atmosphärenkorrektur für die erste auf Einspritzmenge basierten Betriebsart" CURVE 0x8006E958 Kl_Xs16_Ws16 1.000000 Fact 0.00 1.000000 FORMAT "%8.6" EXTENDED_LIMITS -4.000000 3.999878
 /begin AXIS_DESCR STD_AXIS EnvP_p Pres_hPa 25 0.00 3500.000 FORMAT "%8.3" EXTENDED_LIMITS -32768.00 32767.00 DEPOSIT ABSOLUTE /end AXIS_DESCR
/end CHARACTERISTIC
/begin CHARACTERISTIC AirCtl_facEnvPresCor_CUR "Kennlinie für Atmosphärenkorrektur" CURVE 0x80048AE8 Kl_Xs16_Ws16 1.000000 Fact 0.00 1.000000 FORMAT "%8.6" EXTENDED_LIMITS -4.000000 3.999878
 /begin AXIS_DESCR STD_AXIS EnvP_p Pres_hPa 25 0.00 3500.000 FORMAT "%8.3" EXTENDED_LIMITS -32768.00 32767.00 DEPOSIT ABSOLUTE /end AXIS_DESCR
/end CHARACTERISTIC
/begin CHARACTERISTIC AirCtl_facMaxTrmValRgn_C "" VALUE 0x80049CCC Kw_Ws16 7.999878 Fact -4.000000 3.999878 FORMAT "%8.6" /end CHARACTERISTIC
/begin CHARACTERISTIC AirCtl_facMinTrmValRgn_C "" VALUE 0x80049CCE Kw_Ws16 7.999878 Fact -4.000000 3.999878 FORMAT "%8.6" /end CHARACTERISTIC
/begin CHARACTERISTIC AirCtl_facParAirTempEOM_CUR "Lufttemperaturabhängiger Korrekturfaktor für Parameteradaption im Regenerationsbetrieb" CURVE 0x8004A79C Cur_Xs16Ws16 3.000000 Fact1 0.00 3.000000 FORMAT "%8.6" EXTENDED_LIMITS -256.0000 255.9922
 /begin AXIS_DESCR STD_AXIS AirCtl_tAirGov_mp Temp_Cels 25 -50.14000 199.8600 FORMAT "%8.4" EXTENDED_LIMITS -3549.940 3003.560 DEPOSIT ABSOLUTE /end AXIS_DESCR
/end CHARACTERISTIC
/begin CHARACTERISTIC AirCtl_facParAirTemp_CUR "Lufttemperaturabhängiger Korrekturfaktor für Parameteradaption" CURVE 0x80049F8C Cur_Xs16Ws16 3.000000 Fact1 0.00 3.000000 FORMAT "%8.6" EXTENDED_LIMITS -256.0000 255.9922
 /begin AXIS_DESCR STD_AXIS AirCtl_tAirGov_mp Temp_Cels 25 -50.14000 199.8600 FORMAT "%8.4" EXTENDED_LIMITS -3549.940 3003.560 DEPOSIT ABSOLUTE /end AXIS_DESCR
/end CHARACTERISTIC
/begin CHARACTERISTIC AirCtl_facParBasEOM_MAP "Kennfeld für Parameteradaption bei Regeneration" MAP 0x8004A802 Kf_Xs16_Ys16_Ws16 20.00000 Fact1 0.00 20.00000 FORMAT "%8.5" EXTENDED_LIMITS -256.0000 255.9922
 /begin AXIS_DESCR STD_AXIS Epm_nEng EngN 16 0.00 6000.000 FORMAT "%8.3" EXTENDED_LIMITS -16384.00 16383.50 DEPOSIT ABSOLUTE /end AXIS_DESCR
 /begin AXIS_DESCR STD_AXIS AirCtl_qDesVal InjMass 16 0.00 327.6700 FORMAT "%8.4" EXTENDED_LIMITS -327.6800 327.6700 DEPOSIT ABSOLUTE /end AXIS_DESCR
/end CHARACTERISTIC
/begin CHARACTERISTIC AirCtl_facParBas_MAP "Grundkennfeld für die Reglerparameteradaption" MAP 0x80049FF2 Kf_Xs16_Ys16_Ws16 20.00000 Fact1 0.00 20.00000 FORMAT "%8.5" EXTENDED_LIMITS -256.0000 255.9922
 /begin AXIS_DESCR STD_AXIS Epm_nEng EngN 16 0.00 8000.000 FORMAT "%8.3" EXTENDED_LIMITS -16384.00 16383.50 DEPOSIT ABSOLUTE /end AXIS_DESCR
 /begin AXIS_DESCR STD_AXIS AirCtl_qGov_mp InjMass 16 0.00 327.6700 FORMAT "%8.4" EXTENDED_LIMITS -327.6800 327.6700 DEPOSIT ABSOLUTE /end AXIS_DESCR
/end CHARACTERISTIC
/begin CHARACTERISTIC AirCtl_facParPresDiff_CUR "Kennfeld für Korrekturfaktor" CURVE 0x8006F09C Kl_Xs16_Ws16 3.000000 Fact1 0.00 3.000000 FORMAT "%8.6" EXTENDED_LIMITS -256.0000 255.9922
 /begin AXIS_DESCR STD_AXIS AirCtl_pFltPPFltDiff_mp Pres_hPa 26 0.00 3500.000 FORMAT "%8.3" EXTENDED_LIMITS -32768.00 32767.00 DEPOSIT ABSOLUTE /end AXIS_DESCR
/end CHARACTERISTIC
/begin CHARACTERISTIC AirCtl_facRmpEGRCls_C "Rampensteigung beim Schließen des ARF-Ventils im Übergang von Regenerationsbetrieb nach Normalbetrieb" VALUE 0x8006F34C Kw_Ws16 4998.932 PrcEGRRmp 1.068115 5000.000 FORMAT "%8.3" EXTENDED_LIMITS -5000.000 4999.847 /end CHARACTERISTIC
/begin CHARACTERISTIC AirCtl_facRmpEGROpn_C "Rampensteigung beim Öffnen des ARF-Ventils im Übergang von Regenerationsbetrieb nach Normalbetrieb" VALUE 0x8006F34E Kw_Ws16 4998.932 PrcEGRRmp -5000.000 -1.068115 FORMAT "%8.3" EXTENDED_LIMITS -5000.000 4999.847 /end CHARACTERISTIC
/begin CHARACTERISTIC AirCtl_facRmpValCor_CUR "Korrekturkennlinie für den zentralen EGT-Rampenwert" CURVE 0x8006E360 Kl_Xs16_Ws16 3.999939 CoEOMSwt_S16 -2.000000 1.999939 FORMAT "%8.6"
 /begin AXIS_DESCR STD_AXIS CoEOM_facRmpVal CoEOMSwt_S16 13 -2.000000 1.999939 FORMAT "%8.6" DEPOSIT ABSOLUTE /end AXIS_DESCR
/end CHARACTERISTIC
/begin CHARACTERISTIC AirCtl_Gov.xVal_C "Schalter für Luftmassensteuerung oder Luftmassenregelung mit Luftmassensteuerung/" VALUE 0x8006F08A Kw_Wu8 1.000 OneToOne 0.00 1.000 FORMAT "%5.3" EXTENDED_LIMITS 0.00 255.0 /end CHARACTERISTIC
/begin CHARACTERISTIC AirCtl_Gov.xTyp_C "Schalter für Luftmassensteuerung oder Luftmassenregelung mit Luftmassensteuerung/" VALUE 0x8006F08B Kw_Wu8 1.000 OneToOne 1.000 2.000 FORMAT "%5.3" EXTENDED_LIMITS 0.00 255.0 /end CHARACTERISTIC
/begin CHARACTERISTIC AirCtl_I.Ki_C "Regler-I-Parameter/" VALUE 0x8004A238 Kw_Ws32 5.00000396642 Ki_Ampc2Prc 0.00 5.00000396642 FORMAT "%13.11" EXTENDED_LIMITS -122070.312500 122070.312443 /end CHARACTERISTIC
/begin CHARACTERISTIC AirCtl_I.KiPos_C "Regler-I-Parameter/" VALUE 0x8004A23C Kw_Ws32 5.00000396642 Ki_Ampc2Prc 0.00 5.00000396642 FORMAT "%13.11" EXTENDED_LIMITS -122070.312500 122070.312443 /end CHARACTERISTIC
/begin CHARACTERISTIC AirCtl_I.KiNeg_C "Regler-I-Parameter/" VALUE 0x8004A240 Kw_Ws32 5.00000396642 Ki_Ampc2Prc 0.00 5.00000396642 FORMAT "%13.11" EXTENDED_LIMITS -122070.312500 122070.312443 /end CHARACTERISTIC
/begin CHARACTERISTIC AirCtl_I.WinPos_C "Regler-I-Parameter/" VALUE 0x8004A244 Kw_Ws32 1500.00000000 AirMassPerCyl 0.00 1500.00000000 FORMAT "%13.8" EXTENDED_LIMITS -214748364.800 214748364.700 /end CHARACTERISTIC
/begin CHARACTERISTIC AirCtl_I.WinNeg_C "Regler-I-Parameter/" VALUE 0x8004A248 Kw_Ws32 1500.00000000 AirMassPerCyl -1500.00000000 0.00 FORMAT "%13.8" EXTENDED_LIMITS -214748364.800 214748364.700 /end CHARACTERISTIC
/begin CHARACTERISTIC AirCtl_mAirTempCorBas2_MAP "" MAP 0x80049512 Kf_Xs16_Ys16_Ws16 1500.000 AirMassPerCyl 0.00 1500.000 FORMAT "%8.3" EXTENDED_LIMITS -3276.800 3276.700
 /begin AXIS_DESCR STD_AXIS Epm_nEng EngN 16 -16384.00 16383.50 FORMAT "%8.2" DEPOSIT ABSOLUTE /end AXIS_DESCR
 /begin AXIS_DESCR STD_AXIS AirCtl_qDesVal InjMass 16 -327.6800 327.6700 FORMAT "%8.4" DEPOSIT ABSOLUTE /end AXIS_DESCR
/end CHARACTERISTIC
/begin CHARACTERISTIC AirCtl_MaxTrmVal_C "maximaler ARF-Abgleichwert" VALUE 0x80048B4E Kw_Ws16 1.000000 AirMassPerCyl 0.00 1.000000 FORMAT "%8.6" EXTENDED_LIMITS -3276.800 3276.700 /end CHARACTERISTIC
/begin CHARACTERISTIC AirCtl_mDesAddEOMMax_C "" VALUE 0x80049C5A Kw_Ws16 1500.000 AirMassPerCyl 0.00 1500.000 FORMAT "%8.3" EXTENDED_LIMITS -3276.800 3276.700 /end CHARACTERISTIC
/begin CHARACTERISTIC AirCtl_mDesAddEOMMin_C "" VALUE 0x80049C5C Kw_Ws16 1500.000 AirMassPerCyl 0.00 1500.000 FORMAT "%8.3" EXTENDED_LIMITS -3276.800 3276.700 /end CHARACTERISTIC
/begin CHARACTERISTIC AirCtl_mDesAddMax_C "" VALUE 0x80049BE8 Kw_Ws16 1500.000 AirMassPerCyl 0.00 1500.000 FORMAT "%8.3" EXTENDED_LIMITS -3276.800 3276.700 /end CHARACTERISTIC
/begin CHARACTERISTIC AirCtl_mDesAddMin_C "" VALUE 0x80049BEA Kw_Ws16 1500.000 AirMassPerCyl 0.00 1500.000 FORMAT "%8.3" EXTENDED_LIMITS -3276.800 3276.700 /end CHARACTERISTIC
/begin CHARACTERISTIC AirCtl_mDesBasDef_MAP "" MAP 0x80049756 Kf_Xs16_Ys16_Ws16 1500.000 AirMassPerCyl 0.00 1500.000 FORMAT "%8.3" EXTENDED_LIMITS -3276.800 3276.700
 /begin AXIS_DESCR STD_AXIS Epm_nEng EngN 16 0.00 6000.000 FORMAT "%8.3" EXTENDED_LIMITS -16384.00 16383.50 DEPOSIT ABSOLUTE /end AXIS_DESCR
 /begin AXIS_DESCR STD_AXIS AirCtl_qDesVal InjMass 16 0.00 327.6700 FORMAT "%8.4" EXTENDED_LIMITS -327.6800 327.6700 DEPOSIT ABSOLUTE /end AXIS_DESCR
/end CHARACTERISTIC
/begin CHARACTERISTIC AirCtl_mDesBasEOMQnt1_MAP "Grundkennfeld für den Luftmassen-Sollwert für die erste auf Einspritzmenge basierte Betriebsart" MAP 0x8006E9BE Kf_Xs16_Ys16_Ws16 1500.000 AirMassPerCyl 0.00 1500.000 FORMAT "%8.3" EXTENDED_LIMITS -3276.800 3276.700
 /begin AXIS_DESCR STD_AXIS Epm_nEng EngN 16 0.00 6000.000 FORMAT "%8.3" EXTENDED_LIMITS -16384.00 16383.50 DEPOSIT ABSOLUTE /end AXIS_DESCR
 /begin AXIS_DESCR STD_AXIS AirCtl_qDesValInl_mp InjMass 16 0.00 327.6700 FORMAT "%8.4" EXTENDED_LIMITS -327.6800 327.6700 DEPOSIT ABSOLUTE /end AXIS_DESCR
/end CHARACTERISTIC
/begin CHARACTERISTIC AirCtl_mDesBasHiAltdDef_MAP "" MAP 0x8004999A Kf_Xs16_Ys16_Ws16 1500.000 AirMassPerCyl 0.00 1500.000 FORMAT "%8.3" EXTENDED_LIMITS -3276.800 3276.700
 /begin AXIS_DESCR STD_AXIS Epm_nEng EngN 16 0.00 6000.000 FORMAT "%8.3" EXTENDED_LIMITS -16384.00 16383.50 DEPOSIT ABSOLUTE /end AXIS_DESCR
 /begin AXIS_DESCR STD_AXIS AirCtl_qDesVal InjMass 16 0.00 327.6700 FORMAT "%8.4" EXTENDED_LIMITS -327.6800 327.6700 DEPOSIT ABSOLUTE /end AXIS_DESCR
/end CHARACTERISTIC
/begin CHARACTERISTIC AirCtl_mDesBasHiAltdEOMQnt1_MAP "Kennfeld für den Basisluftmassen-Sollwert in der Höhe für die erste auf Einspritzmenge basierte Betriebsart" MAP 0x8006EC02 Kf_Xs16_Ys16_Ws16 1500.000 AirMassPerCyl 0.00 1500.000 FORMAT "%8.3" EXTENDED_LIMITS -3276.800 3276.700
 /begin AXIS_DESCR STD_AXIS Epm_nEng EngN 16 0.00 6000.000 FORMAT "%8.3" EXTENDED_LIMITS -16384.00 16383.50 DEPOSIT ABSOLUTE /end AXIS_DESCR
 /begin AXIS_DESCR STD_AXIS AirCtl_qDesValInl_mp InjMass 16 0.00 327.6700 FORMAT "%8.4" EXTENDED_LIMITS -327.6800 327.6700 DEPOSIT ABSOLUTE /end AXIS_DESCR
/end CHARACTERISTIC
/begin CHARACTERISTIC AirCtl_mDesBasHiAltd_MAP "Kennfeld für den Basisluftmassensollwert in der Höhe" MAP 0x80048B50 Kf_Xs16_Ys16_Ws16 1500.000 AirMassPerCyl 0.00 1500.000 FORMAT "%8.3" EXTENDED_LIMITS -3276.800 3276.700
 /begin AXIS_DESCR STD_AXIS Epm_nEng EngN 16 0.00 6000.000 FORMAT "%8.3" EXTENDED_LIMITS -16384.00 16383.50 DEPOSIT ABSOLUTE /end AXIS_DESCR
 /begin AXIS_DESCR STD_AXIS AirCtl_qDesVal_mp InjMass 16 0.00 327.6700 FORMAT "%8.4" EXTENDED_LIMITS -327.6800 327.6700 DEPOSIT ABSOLUTE /end AXIS_DESCR
/end CHARACTERISTIC
/begin CHARACTERISTIC AirCtl_mDesBas_MAP "Grundkennfeld für den Luftmassensollwert" MAP 0x80048D94 Kf_Xs16_Ys16_Ws16 1500.000 AirMassPerCyl 0.00 1500.000 FORMAT "%8.3" EXTENDED_LIMITS -3276.800 3276.700
 /begin AXIS_DESCR STD_AXIS Epm_nEng EngN 16 0.00 6000.000 FORMAT "%8.3" EXTENDED_LIMITS -16384.00 16383.50 DEPOSIT ABSOLUTE /end AXIS_DESCR
 /begin AXIS_DESCR STD_AXIS AirCtl_qDesVal_mp InjMass 16 0.00 327.6700 FORMAT "%8.4" EXTENDED_LIMITS -327.6800 327.6700 DEPOSIT ABSOLUTE /end AXIS_DESCR
/end CHARACTERISTIC
/begin CHARACTERISTIC AirCtl_mDesConvBas_C "" VALUE 0x80049BEC Kw_Ws16 1500.000 AirMassPerCyl 0.00 1500.000 FORMAT "%8.3" EXTENDED_LIMITS -3276.800 3276.700 /end CHARACTERISTIC
/begin CHARACTERISTIC AirCtl_mDesConvEOM_C "" VALUE 0x80049C5E Kw_Ws16 1500.000 AirMassPerCyl 0.00 1500.000 FORMAT "%8.3" EXTENDED_LIMITS -3276.800 3276.700 /end CHARACTERISTIC
/begin CHARACTERISTIC AirCtl_mDesGearEOM_MAP "" MAP 0x80049C60 Kf_Xs16_Ys16_Ws16 3000.000 AirMassPerCyl -1500.000 1500.000 FORMAT "%8.3" EXTENDED_LIMITS -3276.800 3276.700
 /begin AXIS_DESCR STD_AXIS Epm_nEng EngN 4 0.00 6000.000 FORMAT "%8.3" EXTENDED_LIMITS -16384.00 16383.50 DEPOSIT ABSOLUTE /end AXIS_DESCR
 /begin AXIS_DESCR STD_AXIS AirCtl_qDesVal InjMass 4 0.00 327.6700 FORMAT "%8.4" EXTENDED_LIMITS -327.6800 327.6700 DEPOSIT ABSOLUTE /end AXIS_DESCR
/end CHARACTERISTIC
/begin CHARACTERISTIC AirCtl_mDesGear_MAP "" MAP 0x80049BEE Kf_Xs16_Ys16_Ws16 3000.000 AirMassPerCyl -1500.000 1500.000 FORMAT "%8.3" EXTENDED_LIMITS -3276.800 3276.700
 /begin AXIS_DESCR STD_AXIS Epm_nEng EngN 4 -16384.00 16383.50 FORMAT "%8.2" DEPOSIT ABSOLUTE /end AXIS_DESCR
 /begin AXIS_DESCR STD_AXIS AirCtl_qDesVal InjMass 4 0.00 327.6700 FORMAT "%8.4" EXTENDED_LIMITS -327.6800 327.6700 DEPOSIT ABSOLUTE /end AXIS_DESCR
/end CHARACTERISTIC
/begin CHARACTERISTIC AirCtl_mDesMaxVal_C "" VALUE 0x80049F3C Kw_Ws16 1500.000 AirMassPerCyl 0.00 1500.000 FORMAT "%8.3" EXTENDED_LIMITS -3276.800 3276.700 /end CHARACTERISTIC
/begin CHARACTERISTIC AirCtl_mDesMinVal_C "" VALUE 0x80049F3E Kw_Ws16 1500.000 AirMassPerCyl 0.00 1500.000 FORMAT "%8.3" EXTENDED_LIMITS -3276.800 3276.700 /end CHARACTERISTIC
/begin CHARACTERISTIC AirCtl_mDesRmp_CUR "" CURVE 0x80049CD0 Kl_Xs16_Ws16 10000.00 AirMassPerCyl -5000.000 5000.000 FORMAT "%8.3" EXTENDED_LIMITS -3276.800 3276.700
 /begin AXIS_DESCR STD_AXIS AirCtl_mDesCorCalc2_mp AirMassPerCyl 8 -5000.000 5000.000 FORMAT "%8.3" EXTENDED_LIMITS -3276.800 3276.700 DEPOSIT ABSOLUTE /end AXIS_DESCR
/end CHARACTERISTIC
/begin CHARACTERISTIC AirCtl_mDesStrgCorrEOM_MAP "" MAP 0x80049C94 Kf_Xs16_Ys16_Ws16 3000.000 AirMassPerCyl -1500.000 1500.000 FORMAT "%8.3" EXTENDED_LIMITS -3276.800 3276.700
 /begin AXIS_DESCR STD_AXIS StWhl_phiAg AngleStWhl 4 -180.0000 180.0000 FORMAT "%8.4" EXTENDED_LIMITS -1024.000 1023.969 DEPOSIT ABSOLUTE /end AXIS_DESCR
 /begin AXIS_DESCR STD_AXIS StWhl_dphiAg AngleVelStWhl 4 -1024.000 1023.969 FORMAT "%8.3" DEPOSIT ABSOLUTE /end AXIS_DESCR
/end CHARACTERISTIC
/begin CHARACTERISTIC AirCtl_mDesStrgCorr_MAP "" MAP 0x80049C22 Kf_Xs16_Ys16_Ws16 3000.000 AirMassPerCyl -1500.000 1500.000 FORMAT "%8.3" EXTENDED_LIMITS -3276.800 3276.700
 /begin AXIS_DESCR STD_AXIS StWhl_phiAg AngleStWhl 4 -180.0000 180.0000 FORMAT "%8.4" EXTENDED_LIMITS -1024.000 1023.969 DEPOSIT ABSOLUTE /end AXIS_DESCR
 /begin AXIS_DESCR STD_AXIS StWhl_dphiAg AngleVelStWhl 4 -1024.000 1023.969 FORMAT "%8.3" DEPOSIT ABSOLUTE /end AXIS_DESCR
/end CHARACTERISTIC
/begin CHARACTERISTIC AirCtl_mEngTempCorBasEOMQnt1_MAP "Grundkennfeld für Luftmassenkorrektur für die erste auf Einspritzmenge basierte Betriebsart" MAP 0x8006EE46 Kf_Xs16_Ys16_Ws16 1500.000 AirMassPerCyl 0.00 1500.000 FORMAT "%8.3" EXTENDED_LIMITS -3276.800 3276.700
 /begin AXIS_DESCR STD_AXIS Epm_nEng EngN 16 0.00 6000.000 FORMAT "%8.3" EXTENDED_LIMITS -16384.00 16383.50 DEPOSIT ABSOLUTE /end AXIS_DESCR
 /begin AXIS_DESCR STD_AXIS AirCtl_qDesValInl_mp InjMass 16 0.00 327.6700 FORMAT "%8.4" EXTENDED_LIMITS -327.6800 327.6700 DEPOSIT ABSOLUTE /end AXIS_DESCR
/end CHARACTERISTIC
/begin CHARACTERISTIC AirCtl_mEngTempCorBas_MAP "Grundkennfeld für Motortemperaturkorrektur" MAP 0x80048FD8 Kf_Xs16_Ys16_Ws16 1500.000 AirMassPerCyl 0.00 1500.000 FORMAT "%8.3" EXTENDED_LIMITS -3276.800 3276.700
 /begin AXIS_DESCR STD_AXIS Epm_nEng EngN 16 0.00 6000.000 FORMAT "%8.3" EXTENDED_LIMITS -16384.00 16383.50 DEPOSIT ABSOLUTE /end AXIS_DESCR
 /begin AXIS_DESCR STD_AXIS AirCtl_qDesVal_mp InjMass 16 0.00 327.6700 FORMAT "%8.4" EXTENDED_LIMITS -327.6800 327.6700 DEPOSIT ABSOLUTE /end AXIS_DESCR
/end CHARACTERISTIC
/begin CHARACTERISTIC AirCtl_MinTrmVal_C "minimaler ARF-Abgleichwert" VALUE 0x8004921C Kw_Ws16 1.000000 AirMassPerCyl 0.00 1.000000 FORMAT "%8.6" EXTENDED_LIMITS -3276.800 3276.700 /end CHARACTERISTIC
/begin CHARACTERISTIC AirCtl_mLiCor_C "" VALUE 0x80049BDE Kw_Ws16 6000.000 AirMassPerCyl 0.00 6000.000 FORMAT "%8.3" EXTENDED_LIMITS -3276.800 3276.700 /end CHARACTERISTIC
/begin CHARACTERISTIC AirCtl_mMaxDesVal_C "Maximaler Luftmassensollwert" VALUE 0x8004921E Kw_Ws16 1500.000 AirMassPerCyl 0.00 1500.000 FORMAT "%8.3" EXTENDED_LIMITS -3276.800 3276.700 /end CHARACTERISTIC
/begin CHARACTERISTIC AirCtl_mMaxDvtEOM_MAP "" MAP 0x8004AF08 Map_Xs16Ys16Ws16 200.0000 AirMassPerCyl 0.00 200.0000 FORMAT "%8.4" EXTENDED_LIMITS -3276.800 3276.700
 /begin AXIS_DESCR STD_AXIS Epm_nEng EngN 16 0.00 6000.000 FORMAT "%8.3" EXTENDED_LIMITS -16384.00 16383.50 DEPOSIT ABSOLUTE /end AXIS_DESCR
 /begin AXIS_DESCR STD_AXIS AirCtl_qMon InjMass 16 0.00 200.0000 FORMAT "%8.4" EXTENDED_LIMITS -327.6800 327.6700 DEPOSIT ABSOLUTE /end AXIS_DESCR
/end CHARACTERISTIC
/begin CHARACTERISTIC AirCtl_mMaxDvt_MAP "Kennfeld der oberen Grenze für die Erkennung einer bleibenden Regelabweichung" MAP 0x8004AB08 Map_Xs16Ys16Ws16 3276.700 AirMassPerCyl 0.00 3276.700 FORMAT "%8.3" EXTENDED_LIMITS -3276.800 3276.700
 /begin AXIS_DESCR STD_AXIS Epm_nEng EngN 14 0.00 8000.000 FORMAT "%8.3" EXTENDED_LIMITS -16384.00 16383.50 DEPOSIT ABSOLUTE /end AXIS_DESCR
 /begin AXIS_DESCR STD_AXIS AirCtl_qMon InjMass 16 0.00 200.0000 FORMAT "%8.4" EXTENDED_LIMITS -327.6800 327.6700 DEPOSIT ABSOLUTE /end AXIS_DESCR
/end CHARACTERISTIC
/begin CHARACTERISTIC AirCtl_mMinDesVal_C "Minimaler Luftmassensollwert" VALUE 0x80049220 Kw_Ws16 1500.000 AirMassPerCyl 0.00 1500.000 FORMAT "%8.3" EXTENDED_LIMITS -3276.800 3276.700 /end CHARACTERISTIC
/begin CHARACTERISTIC AirCtl_mMinDvtEOM_MAP "" MAP 0x8004B14C Map_Xs16Ys16Ws16 200.0000 AirMassPerCyl -200.0000 0.00 FORMAT "%8.4" EXTENDED_LIMITS -3276.800 3276.700
 /begin AXIS_DESCR STD_AXIS Epm_nEng EngN 16 0.00 6000.000 FORMAT "%8.3" EXTENDED_LIMITS -16384.00 16383.50 DEPOSIT ABSOLUTE /end AXIS_DESCR
 /begin AXIS_DESCR STD_AXIS AirCtl_qMon InjMass 16 0.00 200.0000 FORMAT "%8.4" EXTENDED_LIMITS -327.6800 327.6700 DEPOSIT ABSOLUTE /end AXIS_DESCR
/end CHARACTERISTIC
/begin CHARACTERISTIC AirCtl_mMinDvt_MAP "Kennfeld der unteren Grenze für die Erkennung einer bleibenden Regelabweichung" MAP 0x8004AD08 Map_Xs16Ys16Ws16 3276.800 AirMassPerCyl -3276.800 0.00 FORMAT "%8.3" EXTENDED_LIMITS -3276.800 3276.700
 /begin AXIS_DESCR STD_AXIS Epm_nEng EngN 14 0.00 8000.000 FORMAT "%8.3" EXTENDED_LIMITS -16384.00 16383.50 DEPOSIT ABSOLUTE /end AXIS_DESCR
 /begin AXIS_DESCR STD_AXIS AirCtl_qMon InjMass 16 0.00 200.0000 FORMAT "%8.4" EXTENDED_LIMITS -327.6800 327.6700 DEPOSIT ABSOLUTE /end AXIS_DESCR
/end CHARACTERISTIC
/begin CHARACTERISTIC AirCtl_mPil2CorBas_C "" VALUE 0x80049C56 Kw_Ws16 3000.000 AirMassPerCyl -1500.000 1500.000 FORMAT "%8.3" EXTENDED_LIMITS -3276.800 3276.700 /end CHARACTERISTIC
/begin CHARACTERISTIC AirCtl_mPil2CorEOM_C "" VALUE 0x80049CC8 Kw_Ws16 3000.000 AirMassPerCyl -1500.000 1500.000 FORMAT "%8.3" EXTENDED_LIMITS -3276.800 3276.700 /end CHARACTERISTIC
/begin CHARACTERISTIC AirCtl_mskGear_C "" VALUE 0x80049C58 Kw_Wu8 255.0 OneToOne 0.00 255.0 FORMAT "%5.1" /end CHARACTERISTIC
/begin CHARACTERISTIC AirCtl_nHealHi_C "Obere Drehzahlgrenze des Heilungsbereichs" VALUE 0x8006FBD4 Val_Ws16 8000.000 EngN1 0.00 8000.000 FORMAT "%8.3" EXTENDED_LIMITS -16384.00 16383.50 /end CHARACTERISTIC
/begin CHARACTERISTIC AirCtl_nHealLo_C "Untere Drehzahlgrenze des Heilungsbereichs" VALUE 0x8006FBD6 Val_Ws16 8000.000 EngN1 0.00 8000.000 FORMAT "%8.3" EXTENDED_LIMITS -16384.00 16383.50 /end CHARACTERISTIC
/begin CHARACTERISTIC AirCtl_nLiEGR_C "" VALUE 0x80049BE0 Kw_Ws16 6000.000 EngN 0.00 6000.000 FORMAT "%8.3" EXTENDED_LIMITS -16384.00 16383.50 /end CHARACTERISTIC
/begin CHARACTERISTIC AirCtl_nLoIdl_C "Obere Grenze der Leerlaufdrehzahl" VALUE 0x8006F7DE Val_Ws16 8000.000 EngN1 0.00 8000.000 FORMAT "%8.3" EXTENDED_LIMITS -16384.00 16383.50 /end CHARACTERISTIC
/begin CHARACTERISTIC AirCtl_nOvrRun_C "Drehzahlgrenze für Schubbetrieb" VALUE 0x8006F7E0 Val_Ws16 8000.000 EngN1 0.00 8000.000 FORMAT "%8.3" EXTENDED_LIMITS -16384.00 16383.50 /end CHARACTERISTIC
/begin CHARACTERISTIC AirCtl_numAirTempDesVal_C "Index für eine Temperatur aus dem Temperaturfeld des Ansaugtrakts in der Sollwertbildung" VALUE 0x80049222 Kw_Wu8 2.00000000000 AirTempFldSel 0.00 2.00000000000 FORMAT "%13.11" /end CHARACTERISTIC
/begin CHARACTERISTIC AirCtl_numAirTempGov_C "Index zur Auswahl einer Temperatur aus dem Temperaturfeld des Ansaugtrakts für die Abgasrückführregelung" VALUE 0x8004A24C Val_Wu8 2.00000000000 AirTempFldSel 0.00 2.00000000000 FORMAT "%13.11" /end CHARACTERISTIC
/begin CHARACTERISTIC AirCtl_numAirTempMon_C "Ausgewählte Temperatur aus dem Temperaturfeld des Ansaugtrakts für die Überwachung" VALUE 0x8006F7E2 Val_Wu8 2.00000000000 AirTempFldSel 0.00 2.00000000000 FORMAT "%13.11" /end CHARACTERISTIC
/begin CHARACTERISTIC AirCtl_numEngTempDesVal_C "Index für eine Temperatur aus dem Motortemperaturfeld in der Sollwertbildung" VALUE 0x80049223 Kw_Wu8 2.00000000000 EngTempFldSel 0.00 2.00000000000 FORMAT "%13.11" /end CHARACTERISTIC
/begin CHARACTERISTIC AirCtl_numEngTempMon_C "Ausgewählte Temperatur aus dem Motortemperaturfeld für die Überwachung" VALUE 0x8006F7E3 Val_Wu8 2.00000000000 EngTempFldSel 0.00 2.00000000000 FORMAT "%13.11" /end CHARACTERISTIC
/begin CHARACTERISTIC AirCtl_OvrRun_C "Grenzwert für Schubbetrieb" VALUE 0x8006F7E4 Val_Ws16 327.6700 InjMass 0.00 327.6700 FORMAT "%8.4" EXTENDED_LIMITS -327.6800 327.6700 /end CHARACTERISTIC
/begin CHARACTERISTIC AirCtl_P.Kp_C "Regler P-Parameter/" VALUE 0x8004A250 Kw_Ws32 10.0000016391 Kp_Ampc2Prc 0.00 10.0000016391 FORMAT "%13.10" EXTENDED_LIMITS -8000.00000000 7999.99999627 /end CHARACTERISTIC
/begin CHARACTERISTIC AirCtl_P.KpPos_C "Regler P-Parameter/" VALUE 0x8004A254 Kw_Ws32 10.0000016391 Kp_Ampc2Prc 0.00 10.0000016391 FORMAT "%13.10" EXTENDED_LIMITS -8000.00000000 7999.99999627 /end CHARACTERISTIC
/begin CHARACTERISTIC AirCtl_P.KpNeg_C "Regler P-Parameter/" VALUE 0x8004A258 Kw_Ws32 10.0000016391 Kp_Ampc2Prc 0.00 10.0000016391 FORMAT "%13.10" EXTENDED_LIMITS -8000.00000000 7999.99999627 /end CHARACTERISTIC
/begin CHARACTERISTIC AirCtl_P.WinPos_C "Regler P-Parameter/" VALUE 0x8004A25C Kw_Ws32 1500.00000000 AirMassPerCyl 0.00 1500.00000000 FORMAT "%13.8" EXTENDED_LIMITS -214748364.800 214748364.700 /end CHARACTERISTIC
/begin CHARACTERISTIC AirCtl_P.WinNeg_C "Regler P-Parameter/" VALUE 0x8004A260 Kw_Ws32 1500.00000000 AirMassPerCyl -1500.00000000 0.00 FORMAT "%13.8" EXTENDED_LIMITS -214748364.800 214748364.700 /end CHARACTERISTIC
/begin CHARACTERISTIC AirCtl_pAirHi_C "Obere Hysteresegrenze für Atmosphärendrucküberwachung" VALUE 0x8006F7E6 Val_Ws16 36268.00 Pres_hPa -32768.00 3500.00 FORMAT "%8.2" EXTENDED_LIMITS -32768.00 32767.00 /end CHARACTERISTIC
/begin CHARACTERISTIC AirCtl_pAirLo_C "Untere Hysteresegrenze für Atmosphärendrucküberwachung" VALUE 0x8006F7E8 Val_Ws16 36268.00 Pres_hPa -32768.00 3500.00 FORMAT "%8.2" EXTENDED_LIMITS -32768.00 32767.00 /end CHARACTERISTIC
/begin CHARACTERISTIC AirCtl_ParAdDT1.T1_C "/" VALUE 0x800494BC Kw_Ws32 4294.9672940 TimeDelay_s 0.000002000000001 4294.9672960 FORMAT "%12.7" /end CHARACTERISTIC
/begin CHARACTERISTIC AirCtl_ParAdDT1.Kd_C "/" VALUE 0x800494C0 Kw_Ws32 65535.9999847 Kd -32768.0000000 32767.9999847 FORMAT "%13.7" /end CHARACTERISTIC
/begin CHARACTERISTIC AirCtl_pBstPresRef_MAP "Referenzladedruck als Funktion von Einspritzmenge und Motordrehzahl" MAP 0x80049224 Kf_Xs16_Ys16_Ws16 3500.000 Pres_hPa 0.00 3500.000 FORMAT "%8.3" EXTENDED_LIMITS -32768.00 32767.00
 /begin AXIS_DESCR STD_AXIS Epm_nEng EngN 16 0.00 6000.000 FORMAT "%8.3" EXTENDED_LIMITS -16384.00 16383.50 DEPOSIT ABSOLUTE /end AXIS_DESCR
 /begin AXIS_DESCR STD_AXIS AirCtl_qDesVal_mp InjMass 16 0.00 327.6700 FORMAT "%8.4" EXTENDED_LIMITS -327.6800 327.6700 DEPOSIT ABSOLUTE /end AXIS_DESCR
/end CHARACTERISTIC
/begin CHARACTERISTIC AirCtl_qHealHi_C "Obere Einspritzmengengrenze des Heilungsbereichs" VALUE 0x8006FBD8 Val_Ws16 200.0000 InjMass 0.00 200.0000 FORMAT "%8.4" EXTENDED_LIMITS -327.6800 327.6700 /end CHARACTERISTIC
/begin CHARACTERISTIC AirCtl_qHealLo_C "Untere Einspritzmengengrenze des Heilungsbereichs" VALUE 0x8006FBDA Val_Ws16 200.0000 InjMass 0.00 200.0000 FORMAT "%8.4" EXTENDED_LIMITS -327.6800 327.6700 /end CHARACTERISTIC
/begin CHARACTERISTIC AirCtl_qHiEOM_CUR "Kennlinie für obere Hysteresegrenze für Abschaltung bei großer Einspritzmenge im Regenerationsbetrieb" CURVE 0x8006F8C4 Kl_Xs16_Ws16 200.0000 InjMass 0.00 200.0000 FORMAT "%8.4" EXTENDED_LIMITS -327.6800 327.6700
 /begin AXIS_DESCR STD_AXIS Epm_nEng EngN 25 0.00 6000.000 FORMAT "%8.3" EXTENDED_LIMITS -16384.00 16383.50 DEPOSIT ABSOLUTE /end AXIS_DESCR
/end CHARACTERISTIC
/begin CHARACTERISTIC AirCtl_qHi_CUR "Kennlinie für obere Hysteresegrenze für Abschaltung bei zu großer Einspritzmenge" CURVE 0x8006F92A Kl_Xs16_Ws16 200.0000 InjMass 0.00 200.0000 FORMAT "%8.4" EXTENDED_LIMITS -327.6800 327.6700
 /begin AXIS_DESCR STD_AXIS Epm_nEng EngN 16 0.00 6000.000 FORMAT "%8.3" EXTENDED_LIMITS -16384.00 16383.50 DEPOSIT ABSOLUTE /end AXIS_DESCR
/end CHARACTERISTIC
/begin CHARACTERISTIC AirCtl_qLoEOM_CUR "Kennlinie für untere Hysteresegrenze für Abschaltung bei großer Einspritzmenge im Regenerationsbetrieb" CURVE 0x8006F96C Kl_Xs16_Ws16 200.0000 InjMass 0.00 200.0000 FORMAT "%8.4" EXTENDED_LIMITS -327.6800 327.6700
 /begin AXIS_DESCR STD_AXIS Epm_nEng EngN 25 0.00 6000.000 FORMAT "%8.3" EXTENDED_LIMITS -16384.00 16383.50 DEPOSIT ABSOLUTE /end AXIS_DESCR
/end CHARACTERISTIC
/begin CHARACTERISTIC AirCtl_qLo_CUR "Kennlinie für untere Hysteresegrenze für Abschaltung bei zu großer Einspritzmenge" CURVE 0x8006F9D2 Kl_Xs16_Ws16 200.0000 InjMass 0.00 200.0000 FORMAT "%8.4" EXTENDED_LIMITS -327.6800 327.6700
 /begin AXIS_DESCR STD_AXIS Epm_nEng EngN 16 0.00 6000.000 FORMAT "%8.3" EXTENDED_LIMITS -16384.00 16383.50 DEPOSIT ABSOLUTE /end AXIS_DESCR
/end CHARACTERISTIC
/begin CHARACTERISTIC AirCtl_qSurgeHigh_CUR "" CURVE 0x8004AA78 Kl_Xs16_Ws16 100.0000 InjMass 0.00 100.0000 FORMAT "%8.4" EXTENDED_LIMITS -327.6800 327.6700
 /begin AXIS_DESCR STD_AXIS Epm_nEng EngN 5 0.00 6000.000 FORMAT "%8.3" EXTENDED_LIMITS -16384.00 16383.50 DEPOSIT ABSOLUTE /end AXIS_DESCR
/end CHARACTERISTIC
/begin CHARACTERISTIC AirCtl_qSurgeLow_CUR "" CURVE 0x8004AA8E Kl_Xs16_Ws16 100.0000 InjMass 0.00 100.0000 FORMAT "%8.4" EXTENDED_LIMITS -327.6800 327.6700
 /begin AXIS_DESCR STD_AXIS Epm_nEng EngN 5 0.00 6000.000 FORMAT "%8.3" EXTENDED_LIMITS -16384.00 16383.50 DEPOSIT ABSOLUTE /end AXIS_DESCR
/end CHARACTERISTIC
/begin CHARACTERISTIC AirCtl_rDflVal_CA "Vorgabewert für die Initialisierung des Regler I-Anteils im Abschaltfall" VAL_BLK 0x8004A264 ValA_Ws16 799.9878 Prc -400.0000 399.9878 FORMAT "%8.4" NUMBER 27 /end CHARACTERISTIC
/begin CHARACTERISTIC AirCtl_rEGRDflVal_CA "Feld der Vorgabewerte für das Abgasrückführventil" VAL_BLK 0x8006F7EA ValA_Ws16 799.9878 Prc -400.0000 399.9878 FORMAT "%8.4" NUMBER 27 /end CHARACTERISTIC
/begin CHARACTERISTIC AirCtl_rEGREOM_MAP "Kennfeld für ARF-Ventil Stellgröße im Regenerationsbetrieb" MAP 0x8006F350 Kf_Xs16_Ys16_Ws16 300.0000 Prc -100.0000 200.0000 FORMAT "%8.4" EXTENDED_LIMITS -400.0000 399.9878
 /begin AXIS_DESCR STD_AXIS Epm_nEng EngN 16 0.00 6000.000 FORMAT "%8.3" EXTENDED_LIMITS -16384.00 16383.50 DEPOSIT ABSOLUTE /end AXIS_DESCR
 /begin AXIS_DESCR STD_AXIS AirCtl_qGov_mp InjMass 16 0.00 327.6700 FORMAT "%8.4" EXTENDED_LIMITS -327.6800 327.6700 DEPOSIT ABSOLUTE /end AXIS_DESCR
/end CHARACTERISTIC
/begin CHARACTERISTIC AirCtl_rEGRInv_MAP "Kennfeld zum Rückrechnen von der Stellgröße des ARF-Ventils auf den Reglerausgang" MAP 0x8006F106 Kf_Xs16_Ys16_Ws16 300.0000 Prc -100.0000 200.0000 FORMAT "%8.4" EXTENDED_LIMITS -400.0000 399.9878
 /begin AXIS_DESCR STD_AXIS Epm_nEng EngN 16 0.00 6000.000 FORMAT "%8.3" EXTENDED_LIMITS -16384.00 16383.50 DEPOSIT ABSOLUTE /end AXIS_DESCR
 /begin AXIS_DESCR STD_AXIS AirCtl_rGovEGR_mp Prc 16 -100.0000 200.0000 FORMAT "%8.4" EXTENDED_LIMITS -400.0000 399.9878 DEPOSIT ABSOLUTE /end AXIS_DESCR
/end CHARACTERISTIC
/begin CHARACTERISTIC AirCtl_rEGRMax_C "Maximal zulässige Stllgröße für das ARF-Ventil" VALUE 0x8006F594 Kw_Ws16 100.0000 Prc 0.00 100.0000 FORMAT "%8.4" EXTENDED_LIMITS -400.0000 399.9878 /end CHARACTERISTIC
/begin CHARACTERISTIC AirCtl_rEGRMin_C "Minimal zzulässige Stellgröße für das ARF-ventil" VALUE 0x8006F596 Kw_Ws16 100.0000 Prc 0.00 100.0000 FORMAT "%8.4" EXTENDED_LIMITS -400.0000 399.9878 /end CHARACTERISTIC
/begin CHARACTERISTIC AirCtl_rEGR_MAP "Kennfeld für Abgasrückführstellgröße" MAP 0x8004A29A Map_Xs16Ys16Ws16 300.0000 Prc -100.0000 200.0000 FORMAT "%8.4" EXTENDED_LIMITS -400.0000 399.9878
 /begin AXIS_DESCR STD_AXIS Epm_nEng EngN 16 0.00 8000.000 FORMAT "%8.3" EXTENDED_LIMITS -16384.00 16383.50 DEPOSIT ABSOLUTE /end AXIS_DESCR
 /begin AXIS_DESCR STD_AXIS AirCtl_rGovOut_mp Prc 16 -400.0000 399.9878 FORMAT "%8.4" DEPOSIT ABSOLUTE /end AXIS_DESCR
/end CHARACTERISTIC
/begin CHARACTERISTIC AirCtl_rGovBgnNrmEOM_C "Stellgrösse für Drosselklappe zu Beginn des Übergangs von Normalbetrieb nach Regenerationsbetrieb" VALUE 0x8006F34A Kw_Ws16 100.0000 Prc 0.00 100.0000 FORMAT "%8.4" EXTENDED_LIMITS -400.0000 399.9878 /end CHARACTERISTIC
/begin CHARACTERISTIC AirCtl_rGovMax_C "Maximale Reglerstellgröße" VALUE 0x8006F08C Val_Ws16 300.0000 Prc -100.0000 200.0000 FORMAT "%8.4" EXTENDED_LIMITS -400.0000 399.9878 /end CHARACTERISTIC
/begin CHARACTERISTIC AirCtl_rGovMin_C "Minimale Reglerstellgröße" VALUE 0x8006F08E Val_Ws16 300.0000 Prc -100.0000 200.0000 FORMAT "%8.4" EXTENDED_LIMITS -400.0000 399.9878 /end CHARACTERISTIC
/begin CHARACTERISTIC AirCtl_rGovThresBgnNrm_C "Reglerausgang bei Beginn der Übergangsphase Normalbetrieb - Regeneration" VALUE 0x8006F090 Kw_Ws16 100.0000 Prc 0.00 100.0000 FORMAT "%8.4" EXTENDED_LIMITS -400.0000 399.9878 /end CHARACTERISTIC
/begin CHARACTERISTIC AirCtl_rSurgeHigh_MAP "" MAP 0x8004AAA4 Kf_Xs16_Ys16_Ws16 799.9878 Prc -400.0000 399.9878 FORMAT "%8.4"
 /begin AXIS_DESCR STD_AXIS Epm_nEng EngN 6 0.00 6000.000 FORMAT "%8.3" EXTENDED_LIMITS -16384.00 16383.50 DEPOSIT ABSOLUTE /end AXIS_DESCR
 /begin AXIS_DESCR STD_AXIS EnvP_p Pres_hPa 4 0.00 3500.000 FORMAT "%8.3" EXTENDED_LIMITS -32768.00 32767.00 DEPOSIT ABSOLUTE /end AXIS_DESCR
/end CHARACTERISTIC
/begin CHARACTERISTIC AirCtl_rSurgeOfs_CUR "" CURVE 0x8004AAEC Kl_Xs16_Ws16 799.9878 Prc -400.0000 399.9878 FORMAT "%8.4"
 /begin AXIS_DESCR STD_AXIS Epm_nEng EngN 5 0.00 6000.000 FORMAT "%8.3" EXTENDED_LIMITS -16384.00 16383.50 DEPOSIT ABSOLUTE /end AXIS_DESCR
/end CHARACTERISTIC
/begin CHARACTERISTIC AirCtl_rTVADflVal_CA "Feld der Vorgabewerte für die Drosselklappe" VAL_BLK 0x8006F820 ValA_Ws16 799.9878 Prc -400.0000 399.9878 FORMAT "%8.4" NUMBER 27 /end CHARACTERISTIC
/begin CHARACTERISTIC AirCtl_rTVAEOM_MAP "Kennfeld für Drosselklappenstellgröße bei Regenerationsbetrieb" MAP 0x8006F598 Kf_Xs16_Ys16_Ws16 300.0000 Prc -100.0000 200.0000 FORMAT "%8.4" EXTENDED_LIMITS -400.0000 399.9878
 /begin AXIS_DESCR STD_AXIS Epm_nEng EngN 16 0.00 6000.000 FORMAT "%8.3" EXTENDED_LIMITS -16384.00 16383.50 DEPOSIT ABSOLUTE /end AXIS_DESCR
 /begin AXIS_DESCR STD_AXIS AirCtl_rGovOut_mp Prc 16 -400.0000 399.9878 FORMAT "%8.4" DEPOSIT ABSOLUTE /end AXIS_DESCR
/end CHARACTERISTIC
/begin CHARACTERISTIC AirCtl_rTVA_MAP "Kennfeld für Drosselklappenstellgröße" MAP 0x8004A4DE Map_Xs16Ys16Ws16 300.0000 Prc -100.0000 200.0000 FORMAT "%8.4" EXTENDED_LIMITS -400.0000 399.9878
 /begin AXIS_DESCR STD_AXIS Epm_nEng EngN 16 0.00 8000.000 FORMAT "%8.3" EXTENDED_LIMITS -16384.00 16383.50 DEPOSIT ABSOLUTE /end AXIS_DESCR
 /begin AXIS_DESCR STD_AXIS AirCtl_rGovOut_mp Prc 16 -400.0000 399.9878 FORMAT "%8.4" DEPOSIT ABSOLUTE /end AXIS_DESCR
/end CHARACTERISTIC
/begin CHARACTERISTIC AirCtl_stBitMskEOM_CA "" VAL_BLK 0x8006FBC0 ValA_Wu32 4294967295.00 OneToOne 0.00 4294967295.00 FORMAT "%13.2" NUMBER 2 /end CHARACTERISTIC
/begin CHARACTERISTIC AirCtl_stCurrQntHiEOMMsk_C "Bitmaske zur Auswahl der oberen Einspritzmenge im Normal- oder Regenerationsbetrieb" VALUE 0x8006FA14 Kw_Wu32 4294967295.00 OneToOne 0.00 4294967295.00 FORMAT "%13.2" /end CHARACTERISTIC
/begin CHARACTERISTIC AirCtl_stCurrQntLoEOMMsk_C "Bitmaske zur Auswahl der unteren Einspritzmenge im Normal- oder Regenerationsbetrieb" VALUE 0x8006FA18 Kw_Wu32 4294967295.00 OneToOne 0.00 4294967295.00 FORMAT "%13.2" /end CHARACTERISTIC
/begin CHARACTERISTIC AirCtl_stCurrTrqHiEOMMsk_C "Bitmaske zur Auswahl der oberen Grenze für das inere Drehmoment im Normal- oder Regenerationsbetrieb" VALUE 0x8006FA1C Kw_Wu32 4294967295.00 OneToOne 0.00 4294967295.00 FORMAT "%13.2" /end CHARACTERISTIC
/begin CHARACTERISTIC AirCtl_stCurrTrqLoEOMMsk_C "Bitmaske zur Auswahl der unteren Grenze für das inere Drehmoment im Normal- oder Regenerationsbetrieb" VALUE 0x8006FA20 Kw_Wu32 4294967295.00 OneToOne 0.00 4294967295.00 FORMAT "%13.2" /end CHARACTERISTIC
/begin CHARACTERISTIC AirCtl_stDesValEOMMsk_CA "Bitmaske für die Auswahl der Regenerationsstufe" VAL_BLK 0x8006E398 ValA_Wu32 4294967295.00 OneToOne 0.00 4294967295.00 FORMAT "%13.2" NUMBER 1 /end CHARACTERISTIC
/begin CHARACTERISTIC AirCtl_stGovEOMMsk_C "Bitmaske zur Stellerkennfeldumschaltung bei Regenerationsbetrieb" VALUE 0x8006F094 Kw_Wu32 4294967295.00 OneToOne 0.00 4294967295.00 FORMAT "%13.2" /end CHARACTERISTIC
/begin CHARACTERISTIC AirCtl_stMonEOMMsk_CA "" VAL_BLK 0x8006FBC8 ValA_Wu32 4294967295.00 OneToOne 0.00 4294967295.00 FORMAT "%13.2" NUMBER 2 /end CHARACTERISTIC
/begin CHARACTERISTIC AirCtl_stPrioMon_CA "Feld der Prioritäten" VAL_BLK 0x8006F856 ValA_Ws16 65535.00 OneToOne -32768.00 32767.00 FORMAT "%8.2" NUMBER 27 /end CHARACTERISTIC
/begin CHARACTERISTIC AirCtl_stRgnMsk3_C "" VALUE 0x80049CF4 Kw_Wu32 4294967295.00 OneToOne 0.00 4294967295.00 FORMAT "%13.2" /end CHARACTERISTIC
/begin CHARACTERISTIC AirCtl_stShOffEOMMsk_C "Maske für Abschaltfall Regenerationsbetrieb" VALUE 0x8006FA24 Kw_Wu32 4294967295.00 OneToOne 0.00 4294967295.00 FORMAT "%13.2" /end CHARACTERISTIC
/begin CHARACTERISTIC AirCtl_swtBstPresCorVal_C "Schalter für die AGR-Sollwert Korrektur" VALUE 0x80049468 Kw_Wu8 255.0 OneToOne 0.00 255.0 FORMAT "%5.1" /end CHARACTERISTIC
/begin CHARACTERISTIC AirCtl_tAirCldHi_C "Obere Hysteresegrenze für zu niedrige Temperatur aus dem Temperaturfeld des Ansaugtrakts" VALUE 0x8006F88C Val_Ws16 190.0000 Temp_Cels -40.14000 149.8600 FORMAT "%8.4" EXTENDED_LIMITS -3549.940 3003.560 /end CHARACTERISTIC
/begin CHARACTERISTIC AirCtl_tAirCldLo_C "Untere Hysteresegrenze für zu niedrige Temperatur aus dem Temperaturfeld des Ansaugtrakts" VALUE 0x8006F88E Val_Ws16 240.0000 Temp_Cels -40.14000 199.8600 FORMAT "%8.4" EXTENDED_LIMITS -3549.940 3003.560 /end CHARACTERISTIC
/begin CHARACTERISTIC AirCtl_tAirWrmHi_C "Obere Hysteresegrenze für zu hohe Temperatur aus dem Temperaturfeld des Ansaugtrakts" VALUE 0x8006F890 Val_Ws16 240.0000 Temp_Cels -40.14000 199.8600 FORMAT "%8.4" EXTENDED_LIMITS -3549.940 3003.560 /end CHARACTERISTIC
/begin CHARACTERISTIC AirCtl_tAirWrmLo_C "Untere Hysteresegrenze für zu hohe Temperatur aus dem Temperaturfeld des Ansaugtrakts" VALUE 0x8006F892 Val_Ws16 190.0000 Temp_Cels -40.14000 149.8600 FORMAT "%8.4" EXTENDED_LIMITS -3549.940 3003.560 /end CHARACTERISTIC
/begin CHARACTERISTIC AirCtl_tClntCldHi_C "Obere Hysteresegrenze für zu hohe Temperatur aus dem Motortemperaturfeld" VALUE 0x8006F894 Val_Ws16 190.0000 Temp_Cels -40.14000 149.8600 FORMAT "%8.4" EXTENDED_LIMITS -3549.940 3003.560 /end CHARACTERISTIC
/begin CHARACTERISTIC AirCtl_tClntCldLo_C "Untere Hysteresegrenze für zu hohe Temperatur aus dem Motortemperaturfeld" VALUE 0x8006F896 Val_Ws16 240.0000 Temp_Cels -40.14000 199.8600 FORMAT "%8.4" EXTENDED_LIMITS -3549.940 3003.560 /end CHARACTERISTIC
/begin CHARACTERISTIC AirCtl_tClntWrmHi_C "Obere Hysteresegrenze für zu hohe Temperatur aus dem Motortemperaturfeld" VALUE 0x8006F898 Val_Ws16 240.0000 Temp_Cels -40.14000 199.8600 FORMAT "%8.4" EXTENDED_LIMITS -3549.940 3003.560 /end CHARACTERISTIC
/begin CHARACTERISTIC AirCtl_tClntWrmLo_C "Untere Hysteresegrenze für zu hohe Temperatur aus dem Motortemperaturfeld" VALUE 0x8006F89A Val_Ws16 190.0000 Temp_Cels -40.14000 149.8600 FORMAT "%8.4" EXTENDED_LIMITS -3549.940 3003.560 /end CHARACTERISTIC
/begin CHARACTERISTIC AirCtl_tiCldStrt_CUR "Kennlinie für die Zeit, in der die regelung nach Startabwurf abgeschaltet bleibt" CURVE 0x8006F89C Cur_Xs16Ws16 33000.00 Time_ms 0.00 33000.00 FORMAT "%8.2" EXTENDED_LIMITS -327680.0 327670.0
 /begin AXIS_DESCR STD_AXIS AirCtl_tEngMon_mp Temp_Cels 8 -100.1400 199.8600 FORMAT "%8.4" EXTENDED_LIMITS -3549.940 3003.560 DEPOSIT ABSOLUTE /end AXIS_DESCR
/end CHARACTERISTIC
/begin CHARACTERISTIC AirCtl_tiClth_C "Maximale Zeit für Schaltvorgangserkennung" VALUE 0x8006F8BE Val_Wu16 655350.0 TimeDeb 0.00 655350.0 FORMAT "%8.1" /end CHARACTERISTIC
/begin CHARACTERISTIC AirCtl_tiDT1EOM_C "" VALUE 0x8004AA48 Kw_Wu32 4294.9662960 TimeDelay_s 0.0010000000689 4294.9672960 FORMAT "%12.7" EXTENDED_LIMITS 0.000001000000000 4294.9672960 /end CHARACTERISTIC
/begin CHARACTERISTIC AirCtl_tiDT1mDes_C "" VALUE 0x800494C4 Kw_Ws32 4294.9662960 TimeDelay_s 0.0010000000689 4294.9672960 FORMAT "%12.7" EXTENDED_LIMITS 0.000002000000001 4294.9672960 /end CHARACTERISTIC
/begin CHARACTERISTIC AirCtl_tiDT1_C "Zeitkonstante des DT1-Gliedsabhängig von Luftmassensollwert" VALUE 0x8004A724 Kw_Wu32 4294.9662960 TimeDelay_s 0.0010000000689 4294.9672960 FORMAT "%12.7" EXTENDED_LIMITS 0.000001000000000 4294.9672960 /end CHARACTERISTIC
/begin CHARACTERISTIC AirCtl_tiEOMNrmMax_C "Maximale Übergangszeit zwischen Regenerations- und Normalbetrieb" VALUE 0x8006F098 Kw_Ws32 21474836.4700 Time_s 0.00 21474836.4700 FORMAT "%13.4" EXTENDED_LIMITS -21474836.4800 21474836.4700 /end CHARACTERISTIC
/begin CHARACTERISTIC AirCtl_tiLiEGR_C "" VALUE 0x80049BE4 Kw_Wu32 21474836.4700 Time_s 0.00 21474836.4700 FORMAT "%13.4" EXTENDED_LIMITS 0.00 42949672.9500 /end CHARACTERISTIC
/begin CHARACTERISTIC AirCtl_tiLoIdl_C "Maximale Zeit für Leerlauferkennung" VALUE 0x8006F8C0 Val_Ws16 655.3500 Time_s -327.6800 327.6700 FORMAT "%8.4" /end CHARACTERISTIC
/begin CHARACTERISTIC AirCtl_tiMonEOM_CA "" VAL_BLK 0x8006FBD0 ValA_Ws16 655350.0 TimeDeb -327680.0 327670.0 FORMAT "%8.1" NUMBER 2 /end CHARACTERISTIC
/begin CHARACTERISTIC AirCtl_tiSurgePT1_C "" VALUE 0x8004AB04 Val_Ws32 4294.9662960 TimeDelay_s 0.0010000000689 4294.9672960 FORMAT "%12.7" EXTENDED_LIMITS 0.000002000000001 4294.9672960 /end CHARACTERISTIC
/begin CHARACTERISTIC AirCtl_TrimAdjMax_C "maximaler Trimabgleichwert" VALUE 0x8004946A Kw_Ws16 10.00000 AirMassPerCyl 0.00 10.00000 FORMAT "%8.5" EXTENDED_LIMITS -3276.800 3276.700 /end CHARACTERISTIC
/begin CHARACTERISTIC AirCtl_TrimAdjMin_C "minimaler Trimabgleichwert" VALUE 0x8004946C Kw_Ws16 10.00000 AirMassPerCyl 0.00 10.00000 FORMAT "%8.5" EXTENDED_LIMITS -3276.800 3276.700 /end CHARACTERISTIC
/begin CHARACTERISTIC AirCtl_Trm.xVal_C "DAMOS-Schalter für additive/multiplikative Abgleichwertkorrektur/" VALUE 0x8004946E Kw_Wu8 0.00 OneToOne 0.00 0.00 FORMAT "%5.2" EXTENDED_LIMITS 0.00 255.0 /end CHARACTERISTIC
/begin CHARACTERISTIC AirCtl_Trm.xTyp_C "DAMOS-Schalter für additive/multiplikative Abgleichwertkorrektur/" VALUE 0x8004946F Kw_Wu8 0.00 OneToOne 0.00 0.00 FORMAT "%5.2" EXTENDED_LIMITS 0.00 255.0 /end CHARACTERISTIC
/begin CHARACTERISTIC AirCtl_TrmRgn_MAP "" MAP 0x80049CF8 Kf_Xs16_Ys16_Ws16 202.0000 AirMassPerCyl -101.0000 101.0000 FORMAT "%8.4" EXTENDED_LIMITS -3276.800 3276.700
 /begin AXIS_DESCR STD_AXIS Epm_nEng EngN 16 0.00 6000.000 FORMAT "%8.3" EXTENDED_LIMITS -16384.00 16383.50 DEPOSIT ABSOLUTE /end AXIS_DESCR
 /begin AXIS_DESCR STD_AXIS AirCtl_qDesVal InjMass 16 0.00 327.6700 FORMAT "%8.4" EXTENDED_LIMITS -327.6800 327.6700 DEPOSIT ABSOLUTE /end AXIS_DESCR
/end CHARACTERISTIC
/begin CHARACTERISTIC AirCtl_trqHiEOM_CUR "Kennlinie: obere Grenze des inneren Drehmoments im Regenerationsbetrieb" CURVE 0x8006FA28 Kl_Xs16_Ws16 1500.000 Trq -500.0000 1000.000 FORMAT "%8.3" EXTENDED_LIMITS -3276.800 3276.700
 /begin AXIS_DESCR STD_AXIS Epm_nEng EngN 25 0.00 6000.000 FORMAT "%8.3" EXTENDED_LIMITS -16384.00 16383.50 DEPOSIT ABSOLUTE /end AXIS_DESCR
/end CHARACTERISTIC
/begin CHARACTERISTIC AirCtl_trqHi_CUR "Kennlinie: obere Grenze des inneren Drehmoments im Normalbetrieb" CURVE 0x8006FA8E Kl_Xs16_Ws16 1500.000 Trq -500.0000 1000.000 FORMAT "%8.3" EXTENDED_LIMITS -3276.800 3276.700
 /begin AXIS_DESCR STD_AXIS Epm_nEng EngN 25 0.00 6000.000 FORMAT "%8.3" EXTENDED_LIMITS -16384.00 16383.50 DEPOSIT ABSOLUTE /end AXIS_DESCR
/end CHARACTERISTIC
/begin CHARACTERISTIC AirCtl_trqLoEOM_CUR "Kennlinie: untere Grenze des inneren Drehmoments im Regenerationsbetrieb" CURVE 0x8006FAF4 Kl_Xs16_Ws16 1500.000 Trq -500.0000 1000.000 FORMAT "%8.3" EXTENDED_LIMITS -3276.800 3276.700
 /begin AXIS_DESCR STD_AXIS Epm_nEng EngN 25 0.00 6000.000 FORMAT "%8.3" EXTENDED_LIMITS -16384.00 16383.50 DEPOSIT ABSOLUTE /end AXIS_DESCR
/end CHARACTERISTIC
/begin CHARACTERISTIC AirCtl_trqLo_CUR "Kennlinie: untere Grenze des inneren Drehmoments" CURVE 0x8006FB5A Kl_Xs16_Ws16 1500.000 Trq -500.0000 1000.000 FORMAT "%8.3" EXTENDED_LIMITS -3276.800 3276.700
 /begin AXIS_DESCR STD_AXIS Epm_nEng EngN 25 0.00 6000.000 FORMAT "%8.3" EXTENDED_LIMITS -16384.00 16383.50 DEPOSIT ABSOLUTE /end AXIS_DESCR
/end CHARACTERISTIC
/begin CHARACTERISTIC AirCtl_uBattThres_C "Grenze der Batteriespannungsüberwachung" VALUE 0x8006F8C2 Val_Ws16 1310700. Volt_Batt -655360.0 655340.0 FORMAT "%8.1" /end CHARACTERISTIC
/begin CHARACTERISTIC Air_rDtyCycMaxTAFS_C "" VALUE 0x8006E2E0 Val_Ws16 655.3500 DtyCyc -327.6800 327.6700 FORMAT "%8.4" /end CHARACTERISTIC
/begin CHARACTERISTIC Air_rDtyCycMinTAFS_C "" VALUE 0x8006E2E2 Val_Ws16 655.3500 DtyCyc -327.6800 327.6700 FORMAT "%8.4" /end CHARACTERISTIC
/begin CHARACTERISTIC Air_RmpSlpTAFS.Pos_C "/" VALUE 0x8006E354 Kw_Ws32 3276798.99750 RmpTemp 1.00097656250 3276799.99847 FORMAT "%13.5" EXTENDED_LIMITS -3276800.00000 3276799.99847 /end CHARACTERISTIC
/begin CHARACTERISTIC Air_RmpSlpTAFS.Neg_C "/" VALUE 0x8006E358 Kw_Ws32 3276798.99750 RmpTemp 1.00097656250 3276799.99847 FORMAT "%13.5" EXTENDED_LIMITS -3276800.00000 3276799.99847 /end CHARACTERISTIC
/begin CHARACTERISTIC Air_tiRefSigPerMaxTAFS_C "" VALUE 0x8006E2E4 Val_Ws32 214748.364750 Time_Period_HFM6 -107374.182400 107374.182350 FORMAT "%13.6" /end CHARACTERISTIC
/begin CHARACTERISTIC Air_tiRefSigPerMinTAFS_C "" VALUE 0x8006E2E8 Val_Ws32 214748.364750 Time_Period_HFM6 -107374.182400 107374.182350 FORMAT "%13.6" /end CHARACTERISTIC
/begin CHARACTERISTIC Air_TransStgTAFS.Dfl_C "/" VALUE 0x8006E35C Kw_Ws16 250.0000 Temp_Cels -50.04000 199.9600 FORMAT "%8.4" EXTENDED_LIMITS -3549.940 3003.560 /end CHARACTERISTIC
/begin CHARACTERISTIC Air_TransStgTAFS.stSensId_C "/" VALUE 0x8006E35E Kw_Wu8 5.000 OneToOne 0.00 5.000 FORMAT "%5.3" EXTENDED_LIMITS 0.00 255.0 /end CHARACTERISTIC
/begin CHARACTERISTIC Air_tTransfTAFS_CUR "" CURVE 0x8006E2EC Cur_Xs16Ws16 250.0000 Temp_Cels -50.04000 199.9600 FORMAT "%8.4" EXTENDED_LIMITS -3549.940 3003.560
 /begin AXIS_DESCR STD_AXIS Air_rRawTAFS DtyCyc 25 0.00 5200.000 FORMAT "%8.3" EXTENDED_LIMITS -327.6800 327.6700 DEPOSIT ABSOLUTE /end AXIS_DESCR
/end CHARACTERISTIC
/begin CHARACTERISTIC AltIO_tiLRAltMax_C "" VALUE 0x8004B3C8 Kw_Ws16 655.3500 Time_s -327.6800 327.6700 FORMAT "%8.4" /end CHARACTERISTIC
/begin CHARACTERISTIC AltIO_tiLRAltMin_C "" VALUE 0x8004B3CA Kw_Ws16 655.3500 Time_s -327.6800 327.6700 FORMAT "%8.4" /end CHARACTERISTIC
/begin CHARACTERISTIC AltIO_tiLR_C "" VALUE 0x8006FC40 Val_Ws16 655.3500 Time_s -327.6800 327.6700 FORMAT "%8.4" /end CHARACTERISTIC
/begin CHARACTERISTIC AltIO_uAltDesMax_C "" VALUE 0x8004B3CC Kw_Ws16 1310700. Volt_Batt -655360.0 655340.0 FORMAT "%8.1" /end CHARACTERISTIC
/begin CHARACTERISTIC AltIO_uAltDesMin_C "" VALUE 0x8004B3CE Kw_Ws16 1310700. Volt_Batt -655360.0 655340.0 FORMAT "%8.1" /end CHARACTERISTIC
/begin CHARACTERISTIC Alt_facCorTemp_CUR "" CURVE 0x8006FBDC Cur_Xs16Ws16 511.9922 Fact1 -256.0000 255.9922 FORMAT "%8.4"
 /begin AXIS_DESCR STD_AXIS EngDa_tEng Temp_Cels 4 -3549.940 3003.560 FORMAT "%8.3" DEPOSIT ABSOLUTE /end AXIS_DESCR
/end CHARACTERISTIC
/begin CHARACTERISTIC Alt_facCorT_CUR "" CURVE 0x8006FBEE Cur_Xs16Ws16 511.9922 Fact1 -256.0000 255.9922 FORMAT "%8.4"
 /begin AXIS_DESCR STD_AXIS CoEng_tiNormal Time_ms 4 0.00 42949672950.0 FORMAT "%13.1" DEPOSIT ABSOLUTE /end AXIS_DESCR
/end CHARACTERISTIC
/begin CHARACTERISTIC Alt_nThres_C "" VALUE 0x8006FC00 Kw_Ws16 32767.50 EngN -16384.00 16383.50 FORMAT "%8.2" /end CHARACTERISTIC
/begin CHARACTERISTIC Alt_stTrqMode_CW "" VALUE 0x8006FC02 Kw_Wu8 255.0 OneToOne 0.00 255.0 FORMAT "%5.1" /end CHARACTERISTIC
/begin CHARACTERISTIC Alt_swtLayer_C "" VALUE 0x8006FC03 Kw_Wu8 255.0 OneToOne 0.00 255.0 FORMAT "%5.1" /end CHARACTERISTIC
/begin CHARACTERISTIC Alt_tiPT1Del_C "" VALUE 0x8006FC04 Kw_Ws32 4294.9672940 TimeDelay_s 0.000002000000001 4294.9672960 FORMAT "%12.7" /end CHARACTERISTIC
/begin CHARACTERISTIC Alt_trqCalc_MAP "" MAP 0x8006FC08 Map_Xs16Ys16Ws16 6553.500 Trq -3276.800 3276.700 FORMAT "%8.3"
 /begin AXIS_DESCR STD_AXIS Epm_nEng EngN 4 -16384.00 16383.50 FORMAT "%8.2" DEPOSIT ABSOLUTE /end AXIS_DESCR
 /begin AXIS_DESCR STD_AXIS AltIO_rAltLoad DtyCyc 4 -327.6800 327.6700 FORMAT "%8.4" DEPOSIT ABSOLUTE /end AXIS_DESCR
/end CHARACTERISTIC
/begin CHARACTERISTIC Alt_uAltDes_C "" VALUE 0x8006FC3C Kw_Ws16 1310700. Volt_Batt -655360.0 655340.0 FORMAT "%8.1" /end CHARACTERISTIC
/begin CHARACTERISTIC Alt_uAltOff_C "" VALUE 0x8006FC3E Kw_Ws16 1310700. Volt_Batt -655360.0 655340.0 FORMAT "%8.1" /end CHARACTERISTIC
/begin CHARACTERISTIC APP_AliveDeb.tiHiLo_C "/" VALUE 0x80046B8C Kw_Ws16 500.0000 Time_ms 0.00 500.0000 FORMAT "%8.4" EXTENDED_LIMITS -327680.0 327670.0 /end CHARACTERISTIC
/begin CHARACTERISTIC APP_AliveDeb.tiLoHi_C "/" VALUE 0x80046B8E Kw_Ws16 500.0000 Time_ms 0.00 500.0000 FORMAT "%8.4" EXTENDED_LIMITS -327680.0 327670.0 /end CHARACTERISTIC
/begin CHARACTERISTIC APP_dRawSigFac_C "Faktor zwischen den Sensor-Rohsignalen" VALUE 0x80046C0C Val_Wu16 6.000000 Fact 0.00 6.000000 FORMAT "%8.6" EXTENDED_LIMITS 0.00 7.999878 /end CHARACTERISTIC
/begin CHARACTERISTIC APP_drLim.Pos_C "/" VALUE 0x80046B90 Kw_Ws32 200.000032783 RmpPrc 0.00 200.000032783 FORMAT "%13.9" EXTENDED_LIMITS -400000.000000 399999.999814 /end CHARACTERISTIC
/begin CHARACTERISTIC APP_drLim.Neg_C "/" VALUE 0x80046B94 Kw_Ws32 200.000032783 RmpPrc 0.00 200.000032783 FORMAT "%13.9" EXTENDED_LIMITS -400000.000000 399999.999814 /end CHARACTERISTIC
/begin CHARACTERISTIC APP_drLimpMax_C "Grenze für Fahrpedalwertgradient im Ersatzbetrieb" VALUE 0x80046B98 Val_Ws16 200.1953 PrcPerSec 0.00 200.1953 FORMAT "%8.4" EXTENDED_LIMITS -20000.00 19999.39 /end CHARACTERISTIC
/begin CHARACTERISTIC APP_drPlaMaxVal.Pos_C "/" VALUE 0x80046B9C Kw_Ws32 200.000032783 RmpPrc 0.00 200.000032783 FORMAT "%13.9" EXTENDED_LIMITS -400000.000000 399999.999814 /end CHARACTERISTIC
/begin CHARACTERISTIC APP_drPlaMaxVal.Neg_C "/" VALUE 0x80046BA0 Kw_Ws32 200.000032783 RmpPrc 0.00 200.000032783 FORMAT "%13.9" EXTENDED_LIMITS -400000.000000 399999.999814 /end CHARACTERISTIC
/begin CHARACTERISTIC APP_drUnFltLim_C "Schwelle für Fahrpedalwertgradient zum Rücksetzen der Plausibilität mit der Bremse" VALUE 0x80046BE4 Val_Ws16 200.1953 PrcPerSec 0.00 200.1953 FORMAT "%8.4" EXTENDED_LIMITS -20000.00 19999.39 /end CHARACTERISTIC
/begin CHARACTERISTIC APP_duLimErr.Pos_C "/" VALUE 0x80046C00 Kw_Ws32 6553599.99695 RmpVolt 0.00 6553599.99695 FORMAT "%13.5" EXTENDED_LIMITS -6553600.00000 6553599.99695 /end CHARACTERISTIC
/begin CHARACTERISTIC APP_duLimErr.Neg_C "/" VALUE 0x80046C04 Kw_Ws32 6553599.99695 RmpVolt 0.00 6553599.99695 FORMAT "%13.5" EXTENDED_LIMITS -6553600.00000 6553599.99695 /end CHARACTERISTIC
/begin CHARACTERISTIC APP_GradCondDeb.tiHiLo_C "/" VALUE 0x80046BE6 Kw_Ws16 1000.000 Time_ms 0.00 1000.000 FORMAT "%8.3" EXTENDED_LIMITS -327680.0 327670.0 /end CHARACTERISTIC
/begin CHARACTERISTIC APP_GradCondDeb.tiLoHi_C "/" VALUE 0x80046BE8 Kw_Ws16 1000.000 Time_ms 0.00 1000.000 FORMAT "%8.3" EXTENDED_LIMITS -327680.0 327670.0 /end CHARACTERISTIC
/begin CHARACTERISTIC APP_nLim_C "Drehzahlschwelle für Freigabe der Fahrpedal-Bremse-Plausibilisierung" VALUE 0x80046BEA Val_Ws16 6000.000 EngN 0.00 6000.000 FORMAT "%8.3" EXTENDED_LIMITS -16384.00 16383.50 /end CHARACTERISTIC
/begin CHARACTERISTIC APP_pBrkHigh_C "obere Bremsdruckschwelle" VALUE 0x80046BEC Kw_Wu16 100.0000 Pres_bar 0.00 100.0000 FORMAT "%8.4" EXTENDED_LIMITS 0.00 65535.00 /end CHARACTERISTIC
/begin CHARACTERISTIC APP_pBrkLow_C "Lower Bremsdruckschwelle" VALUE 0x80046BEE Kw_Wu16 100.0000 Pres_bar 0.00 100.0000 FORMAT "%8.4" EXTENDED_LIMITS 0.00 65535.00 /end CHARACTERISTIC
/begin CHARACTERISTIC APP_PlaBrkDetDeb.tiLoHi_C "/" VALUE 0x80046BF2 Kw_Ws16 1000.000 Time_ms 0.00 1000.000 FORMAT "%8.3" EXTENDED_LIMITS -327680.0 327670.0 /end CHARACTERISTIC
/begin CHARACTERISTIC APP_PlaBrkRstDeb.tiLoHi_C "/" VALUE 0x80046BF6 Kw_Ws16 1000.000 Time_ms 0.00 1000.000 FORMAT "%8.3" EXTENDED_LIMITS -327680.0 327670.0 /end CHARACTERISTIC
/begin CHARACTERISTIC APP_rLimpMax_C "Grenze für Fahrpedalwert im Ersatzbetrieb" VALUE 0x80046BA4 Val_Ws16 100.0000 Prc 0.00 100.0000 FORMAT "%8.4" EXTENDED_LIMITS -400.0000 399.9878 /end CHARACTERISTIC
/begin CHARACTERISTIC APP_rLinAPP_CUR "Linearisierungskennlinie für das Fahrpedal" CURVE 0x80046C0E Cur_Xs16Ws16 100.0000 Prc 0.00 100.0000 FORMAT "%8.4" EXTENDED_LIMITS -400.0000 399.9878
 /begin AXIS_DESCR STD_AXIS APP_uUnJit_mp Volt 2 0.00 5200.000 FORMAT "%8.3" EXTENDED_LIMITS -6553.600 6553.400 DEPOSIT ABSOLUTE /end AXIS_DESCR
/end CHARACTERISTIC
/begin CHARACTERISTIC APP_rPlaMaxVal_C "Maximalwert für Fahrpedal bei Plausibilitätsverletzung mit der Bremse" VALUE 0x80046BA6 Val_Ws16 100.0000 Prc 0.00 100.0000 FORMAT "%8.4" EXTENDED_LIMITS -400.0000 399.9878 /end CHARACTERISTIC
/begin CHARACTERISTIC APP_rPlaMaxVal_CUR "Bremse druckabhängige APP Wiederbeschaffungswert Curve" CURVE 0x80046BA8 Kl_Xs16_Ws16 100.0000 Prc 0.00 100.0000 FORMAT "%8.4" EXTENDED_LIMITS -400.0000 399.9878
 /begin AXIS_DESCR STD_AXIS Com_pBrkSys Pres_bar 6 0.00 100.0000 FORMAT "%8.4" EXTENDED_LIMITS 0.00 65535.00 DEPOSIT ABSOLUTE /end AXIS_DESCR
/end CHARACTERISTIC
/begin CHARACTERISTIC APP_rThresAliveDet_C "Schwelle für Fahrpedal Lebenderkennung" VALUE 0x80046BC2 Val_Ws16 100.0000 Prc 0.00 100.0000 FORMAT "%8.4" EXTENDED_LIMITS -400.0000 399.9878 /end CHARACTERISTIC
/begin CHARACTERISTIC APP_rThresFltLowNeg_C "" VALUE 0x80046C18 Val_Ws16 100.0000 Prc 0.00 100.0000 FORMAT "%8.4" EXTENDED_LIMITS -400.0000 399.9878 /end CHARACTERISTIC
/begin CHARACTERISTIC APP_rThresFltLowPos_C "" VALUE 0x80046C1A Val_Ws16 100.0000 Prc 0.00 100.0000 FORMAT "%8.4" EXTENDED_LIMITS -400.0000 399.9878 /end CHARACTERISTIC
/begin CHARACTERISTIC APP_rThresFltMidNeg_C "" VALUE 0x80046C1C Val_Ws16 100.0000 Prc 0.00 100.0000 FORMAT "%8.4" EXTENDED_LIMITS -400.0000 399.9878 /end CHARACTERISTIC
/begin CHARACTERISTIC APP_rThresFltMidPos_C "" VALUE 0x80046C1E Val_Ws16 100.0000 Prc 0.00 100.0000 FORMAT "%8.4" EXTENDED_LIMITS -400.0000 399.9878 /end CHARACTERISTIC
/begin CHARACTERISTIC APP_swtAliveDetEna_C "Schalter zur Aktivierung der Fahrpedal-Lebenderkennung" VALUE 0x80046BC4 Val_Wu8 1.000 OneToOne 0.00 1.000 FORMAT "%5.3" EXTENDED_LIMITS 0.00 255.0 /end CHARACTERISTIC
/begin CHARACTERISTIC APP_swtAppGradEna_C "Schalter um Rücksetzen der Fahrpedal-Bremse-Plausibilität durch Fahrpedalgradient zu aktivieren" VALUE 0x80046BF8 Val_Wu8 1.000 OneToOne 0.00 1.000 FORMAT "%5.3" EXTENDED_LIMITS 0.00 255.0 /end CHARACTERISTIC
/begin CHARACTERISTIC APP_swtBrkDet_C "Schalter zur Auswahl der Bremserkennung über Wert oder Flanke" VALUE 0x80046BF9 Val_Wu8 1.000 OneToOne 0.00 1.000 FORMAT "%5.3" EXTENDED_LIMITS 0.00 255.0 /end CHARACTERISTIC
/begin CHARACTERISTIC APP_swtBrkPres_C "Für die Betrachtung des Bremsdrucks schalten" VALUE 0x80046BFA Kw_Wu8 1.000 OneToOne 0.00 1.000 FORMAT "%5.3" EXTENDED_LIMITS 0.00 255.0 /end CHARACTERISTIC
/begin CHARACTERISTIC APP_swtEnaUnJit_C "Schalter zum Aktivieren der Entjitterung" VALUE 0x80046C20 Val_Wu8 1.000 OneToOne 0.00 1.000 FORMAT "%5.3" EXTENDED_LIMITS 0.00 255.0 /end CHARACTERISTIC
/begin CHARACTERISTIC APP_swtNoFlt_C "Schalter zum Deaktivieren der Filterung bei gedrückter Kupplung" VALUE 0x80046C21 Val_Wu8 1.000 OneToOne 0.00 1.000 FORMAT "%5.3" EXTENDED_LIMITS 0.00 255.0 /end CHARACTERISTIC
/begin CHARACTERISTIC APP_swtPlaChkEna_C "Schalter zur Aktivierung der Fahrpedal-Bremse-Plausibilisierung" VALUE 0x80046BC5 Val_Wu8 1.000 OneToOne 0.00 1.000 FORMAT "%5.3" EXTENDED_LIMITS 0.00 255.0 /end CHARACTERISTIC
/begin CHARACTERISTIC APP_swtRstCon_C "Schalter zur Auswahl der Rücksetzbedingungen der Fahrpedal-Bremse-Plausibilisierung" VALUE 0x80046BFB Val_Wu8 1.000 OneToOne 0.00 1.000 FORMAT "%5.3" EXTENDED_LIMITS 0.00 255.0 /end CHARACTERISTIC
/begin CHARACTERISTIC APP_swtStepLim_C "Schalter um die Schrittbegrentzungsfunktion zu aktivieren (1: aktieviert, 0:deaktiviert)" VALUE 0x80046C22 Val_Wu8 255.0 OneToOne 0.00 255.0 FORMAT "%5.1" /end CHARACTERISTIC
/begin CHARACTERISTIC APP_swtVehDynReqd_C "Schalter zur Deaktivierung der Fahrpedal-Bremse-Plausibilisierung bei aktiven externen Eingriffen" VALUE 0x80046BFC Val_Wu8 1.000 OneToOne 0.00 1.000 FORMAT "%5.3" EXTENDED_LIMITS 0.00 255.0 /end CHARACTERISTIC
/begin CHARACTERISTIC APP_tiLowNegPT1_C "" VALUE 0x80046C24 Val_Ws32 4294.9672940 TimeDelay_s 0.000002000000001 4294.9672960 FORMAT "%12.7" /end CHARACTERISTIC
/begin CHARACTERISTIC APP_tiLowPosPT1_C "" VALUE 0x80046C28 Val_Ws32 4294.9672940 TimeDelay_s 0.000002000000001 4294.9672960 FORMAT "%12.7" /end CHARACTERISTIC
/begin CHARACTERISTIC APP_tiMidNegPT1_C "" VALUE 0x80046C2C Val_Ws32 4294.9672940 TimeDelay_s 0.000002000000001 4294.9672960 FORMAT "%12.7" /end CHARACTERISTIC
/begin CHARACTERISTIC APP_tiMidPosPT1_C "" VALUE 0x80046C30 Val_Ws32 4294.9672940 TimeDelay_s 0.000002000000001 4294.9672960 FORMAT "%12.7" /end CHARACTERISTIC
/begin CHARACTERISTIC APP_tiUppNegPT1_C "" VALUE 0x80046C34 Val_Ws32 4294.9672940 TimeDelay_s 0.000002000000001 4294.9672960 FORMAT "%12.7" /end CHARACTERISTIC
/begin CHARACTERISTIC APP_tiUppPosPT1_C "" VALUE 0x80046C38 Val_Ws32 4294.9672940 TimeDelay_s 0.000002000000001 4294.9672960 FORMAT "%12.7" /end CHARACTERISTIC
/begin CHARACTERISTIC APP_uAPPDef_C "Fahrpedalersatzwert bei Defekt beider Geber" VALUE 0x80046C08 Val_Ws16 5300.000 Volt 0.00 5300.000 FORMAT "%8.3" EXTENDED_LIMITS -6553.600 6553.400 /end CHARACTERISTIC
/begin CHARACTERISTIC APP_uJitter_C "Spannungsschwelle für Entjittern" VALUE 0x80046C3C Val_Ws16 0.4000000 Volt 0.00 0.4000000 FORMAT "%9.7" EXTENDED_LIMITS -6553.600 6553.400 /end CHARACTERISTIC
/begin CHARACTERISTIC APP_uKDHighAPP_C "Obere Hystereschwelle für Kickdownerkennung" VALUE 0x80046BD0 Val_Ws16 5200.000 Volt 0.00 5200.000 FORMAT "%8.3" EXTENDED_LIMITS -6553.600 6553.400 /end CHARACTERISTIC
/begin CHARACTERISTIC APP_uKDLowAPP_C "Untere Hystereseschwelle für Kickdownerkennung" VALUE 0x80046BD2 Val_Ws16 11753.60 Volt -6553.600 5200.000 FORMAT "%8.3" EXTENDED_LIMITS -6553.600 6553.400 /end CHARACTERISTIC
/begin CHARACTERISTIC APP_uRaw1Def_C "Ersatzwert bei Sensor 1 defekt" VALUE 0x80046C3E Val_Ws16 5000.000 Volt 0.00 5000.000 FORMAT "%8.3" EXTENDED_LIMITS -6553.600 6553.400 /end CHARACTERISTIC
/begin CHARACTERISTIC APP_uRaw1SRCHigh_C "SRC high Schwelle für Sensor 1" VALUE 0x80046BC8 Val_Ws16 5200.000 Volt 0.00 5200.000 FORMAT "%8.3" EXTENDED_LIMITS -6553.600 6553.400 /end CHARACTERISTIC
/begin CHARACTERISTIC APP_uRaw1SRCLow_C "SRC low Schwelle für Sensor 1" VALUE 0x80046BCA Val_Ws16 5200.000 Volt 0.00 5200.000 FORMAT "%8.3" EXTENDED_LIMITS -6553.600 6553.400 /end CHARACTERISTIC
/begin CHARACTERISTIC APP_uRaw2Def_C "Ersatzwert bei Sensor 2 defekt" VALUE 0x80046C40 Val_Ws16 5000.000 Volt 0.00 5000.000 FORMAT "%8.3" EXTENDED_LIMITS -6553.600 6553.400 /end CHARACTERISTIC
/begin CHARACTERISTIC APP_uRaw2Offset_C "Offset für Sensorsignal 2" VALUE 0x80046C0A Val_Ws16 5300.000 Volt 0.00 5300.000 FORMAT "%8.3" EXTENDED_LIMITS -6553.600 6553.400 /end CHARACTERISTIC
/begin CHARACTERISTIC APP_uRaw2SRCHigh_C "SRC high Schwelle für Sensor 2" VALUE 0x80046BCC Val_Ws16 5200.000 Volt 0.00 5200.000 FORMAT "%8.3" EXTENDED_LIMITS -6553.600 6553.400 /end CHARACTERISTIC
/begin CHARACTERISTIC APP_uRaw2SRCLow_C "SRC low Schwelle für Sensor 2" VALUE 0x80046BCE Val_Ws16 5200.000 Volt 0.00 5200.000 FORMAT "%8.3" EXTENDED_LIMITS -6553.600 6553.400 /end CHARACTERISTIC
/begin CHARACTERISTIC APP_uSyncMin_C "Untere Spannungsschwelle für Gleichlaufprüfung Sensor1/Sensor2" VALUE 0x80046BD4 Val_Ws16 5200.000 Volt 0.00 5200.000 FORMAT "%8.3" EXTENDED_LIMITS -6553.600 6553.400 /end CHARACTERISTIC
/begin CHARACTERISTIC APP_uSync_CUR "Kennlinie zur Bestimmung der maximal zulässigen Abweichung zwischen Sensor 1 und Sensor 2" CURVE 0x80046BD6 Cur_Xs16Ws16 5200.000 Volt 0.00 5200.000 FORMAT "%8.3" EXTENDED_LIMITS -6553.600 6553.400
 /begin AXIS_DESCR STD_AXIS APP_uMin12half_mp Volt 3 0.00 5200.000 FORMAT "%8.3" EXTENDED_LIMITS -6553.600 6553.400 DEPOSIT ABSOLUTE /end AXIS_DESCR
/end CHARACTERISTIC
/begin CHARACTERISTIC APP_vLim_C "Geschwindigkeitsschwelle zur Freigabe der Fahrpedal-Bremse-Plausibilisierung" VALUE 0x80046BFE Val_Ws16 250.0000 Vel 0.00 250.0000 FORMAT "%8.4" EXTENDED_LIMITS -327.6800 327.6700 /end CHARACTERISTIC
/begin CHARACTERISTIC ASDdc_GovClth.T1_C "/" VALUE 0x80046C54 Val_Wr32 1.50000000 ASDdc_GovDT1T1_float 0.00 1.50000000 FORMAT "%10.8" EXTENDED_LIMITS -1.00000000E+037 1.00000000E+037 /end CHARACTERISTIC
/begin CHARACTERISTIC ASDdc_GovClth.Kd_C "/" VALUE 0x80046C58 Val_Wr32 5.00000000 ASDdc_GovDT1Kd_float 0.00 5.00000000 FORMAT "%10.8" EXTENDED_LIMITS -1.00000000E+037 1.00000000E+037 /end CHARACTERISTIC
/begin CHARACTERISTIC ASDdc_GovExtIntv.T1_C "/" VALUE 0x80046C5C Val_Wr32 1.50000000 ASDdc_GovDT1T1_float 0.00 1.50000000 FORMAT "%10.8" EXTENDED_LIMITS -1.00000000E+037 1.00000000E+037 /end CHARACTERISTIC
/begin CHARACTERISTIC ASDdc_GovExtIntv.Kd_C "/" VALUE 0x80046C60 Val_Wr32 5.00000000 ASDdc_GovDT1Kd_float 0.00 5.00000000 FORMAT "%10.8" EXTENDED_LIMITS -1.00000000E+037 1.00000000E+037 /end CHARACTERISTIC
/begin CHARACTERISTIC ASDdc_GovGrip.T1_MAP "/" MAP 0x80046C64 Map_Xs16Ys16Ws16 1.498917 TimeDelay_s_Lin_16 0.001068148 1.499985 FORMAT "%8.6" EXTENDED_LIMITS -5.000153 5.000000
 /begin AXIS_DESCR STD_AXIS PT_rTrq TransR 16 -327.6800 327.6700 FORMAT "%8.4" DEPOSIT ABSOLUTE /end AXIS_DESCR
 /begin AXIS_DESCR STD_AXIS ASDdc_nEngParSel_mp EngN 5 -16384.00 16383.50 FORMAT "%8.2" DEPOSIT ABSOLUTE /end AXIS_DESCR
/end CHARACTERISTIC
/begin CHARACTERISTIC ASDdc_GovGrip.Kd_MAP "/" MAP 0x80046D32 Map_Xs16Ys16Ws16 1.500000 Kd16_sqr_rpm2Nm 0.00 1.500000 FORMAT "%8.6" EXTENDED_LIMITS -32.00000 31.99902
 /begin AXIS_DESCR STD_AXIS PT_rTrq TransR 16 -327.6800 327.6700 FORMAT "%8.4" DEPOSIT ABSOLUTE /end AXIS_DESCR
 /begin AXIS_DESCR STD_AXIS ASDdc_nEngParSel_mp EngN 5 -16384.00 16383.50 FORMAT "%8.2" DEPOSIT ABSOLUTE /end AXIS_DESCR
/end CHARACTERISTIC
/begin CHARACTERISTIC ASDdc_GovSt3.T1_C "/" VALUE 0x80046E00 Val_Wr32 1.50000000 ASDdc_GovDT1T1_float 0.00 1.50000000 FORMAT "%10.8" EXTENDED_LIMITS -1.00000000E+037 1.00000000E+037 /end CHARACTERISTIC
/begin CHARACTERISTIC ASDdc_GovSt3.Kd_C "/" VALUE 0x80046E04 Val_Wr32 5.00000000 ASDdc_GovDT1Kd_float 0.00 5.00000000 FORMAT "%10.8" EXTENDED_LIMITS -1.00000000E+037 1.00000000E+037 /end CHARACTERISTIC
/begin CHARACTERISTIC ASDdc_GovSt4.T1_C "/" VALUE 0x80046E08 Val_Wr32 1.50000000 ASDdc_GovDT1T1_float 0.00 1.50000000 FORMAT "%10.8" EXTENDED_LIMITS -1.00000000E+037 1.00000000E+037 /end CHARACTERISTIC
/begin CHARACTERISTIC ASDdc_GovSt4.Kd_C "/" VALUE 0x80046E0C Val_Wr32 5.00000000 ASDdc_GovDT1Kd_float 0.00 5.00000000 FORMAT "%10.8" EXTENDED_LIMITS -1.00000000E+037 1.00000000E+037 /end CHARACTERISTIC
/begin CHARACTERISTIC ASDdc_numDflSt_C "Nummer des Default-Primärzustandes (dezimal kodiert)" VALUE 0x80046E10 Val_Wu16 4.000000 OneToOne 0.00 4.000000 FORMAT "%8.6" EXTENDED_LIMITS 0.00 65535.00 /end CHARACTERISTIC
/begin CHARACTERISTIC ASDdc_numPrio_CA "Prioritäten der Primärzustände" VAL_BLK 0x80046E12 ValA_Wu8 255.0 OneToOne 0.00 255.0 FORMAT "%5.1" NUMBER 5 /end CHARACTERISTIC
/begin CHARACTERISTIC ASDdc_stCfgClthOpn_C "Konfiguration der Eingangsbedingung ""offener Wandlerkupplung""" VALUE 0x80046E18 Val_Wu16 65535.00 OneToOne 0.00 65535.00 FORMAT "%8.2" /end CHARACTERISTIC
/begin CHARACTERISTIC ASDdc_stCfgClthSlipClsd_C "Konfiguration der Eingangsbedingung ""geregelter (geschlossener) Wandlerkupplung""" VALUE 0x80046E1A Val_Wu16 65535.00 OneToOne 0.00 65535.00 FORMAT "%8.2" /end CHARACTERISTIC
/begin CHARACTERISTIC ASDdc_stCfgClthSlipOpn_C "Konfiguration der Eingangsbedingung ""geregelter (offener) Wandlerkupplung""" VALUE 0x80046E1C Val_Wu16 65535.00 OneToOne 0.00 65535.00 FORMAT "%8.2" /end CHARACTERISTIC
/begin CHARACTERISTIC ASDdc_stCfgClthSlip_C "Konfiguration der Eingangsbedingung ""geregelter Wandlerkupplung""" VALUE 0x80046E1E Val_Wu16 65535.00 OneToOne 0.00 65535.00 FORMAT "%8.2" /end CHARACTERISTIC
/begin CHARACTERISTIC ASDdc_stCfgConExtIntv_C "Festlegung der Eingangsbedingung ""Externer Momenteneingriff"" (Bitmaske zur Nachricht GlbDa_stTrqDem)" VALUE 0x80046E20 Val_Wu16 65535.00 OneToOne 0.00 65535.00 FORMAT "%8.2" /end CHARACTERISTIC
/begin CHARACTERISTIC ASDdc_stExtIntv_C "Konfiguration der Eingangsbedingung ""Externer Momenteneingriff""" VALUE 0x80046E22 Val_Wu16 65535.00 OneToOne 0.00 65535.00 FORMAT "%8.2" /end CHARACTERISTIC
/begin CHARACTERISTIC ASDdc_stGearSwt_C "Konfiguration der Eingangsbedingung ""Gangumschaltung aktiv""" VALUE 0x80046E24 Val_Wu16 65535.00 OneToOne 0.00 65535.00 FORMAT "%8.2" /end CHARACTERISTIC
/begin CHARACTERISTIC ASDdc_stGripRaw_C "Konfiguration der Eingangsbedingung ""geschlossener Antriebsstrang""" VALUE 0x80046E26 Val_Wu16 65535.00 OneToOne 0.00 65535.00 FORMAT "%8.2" /end CHARACTERISTIC
/begin CHARACTERISTIC ASDdc_stGrip_C "Konfiguration der Eingangsbedingung ""geschlossener Antriebsstrang und Nulldurchgang des Störungsreglers""" VALUE 0x80046E28 Val_Wu16 65535.00 OneToOne 0.00 65535.00 FORMAT "%8.2" /end CHARACTERISTIC
/begin CHARACTERISTIC ASDdc_swtCalcN_C "1: ASDdc_nEngParSel_mp = EPM_nEng; 0: ASDdc_nEngParSel_mp = EPM_nEng - SpdGov_nSetPLo[1]" VALUE 0x80046E2A Val_Wu8 255.0 OneToOne 0.00 255.0 FORMAT "%5.1" /end CHARACTERISTIC
/begin CHARACTERISTIC ASDdc_swtIniParSet_C "Schalter zur Aktivierung/Deaktivierung der kontinuierlichen Initialisierung aufgrund Parametersatzwechsels" VALUE 0x80046C44 Val_Wu8 255.0 OneToOne 0.00 255.0 FORMAT "%5.1" /end CHARACTERISTIC
/begin CHARACTERISTIC ASDdc_swtLADFrz_C "Schalter zum Aktivieren der Einfrierung des ASDdc in speziellen Fällen des ASDrf_stLAD (FF = nie einfrieren)" VALUE 0x80046C45 Val_Wu8 255.0 OneToOne 0.00 255.0 FORMAT "%5.1" /end CHARACTERISTIC
/begin CHARACTERISTIC ASDdc_swtOpr_C "Schalter des Verknüpfungsoperators (00=OR : 01=AND : 10=NAND : 11=NOR)" VALUE 0x80046E2C Val_Wu16 65535.00 OneToOne 0.00 65535.00 FORMAT "%8.2" /end CHARACTERISTIC
/begin CHARACTERISTIC ASDdc_trqLimMax_C "ASD Störungsregler Ausgangsbegrenzung Maximum" VALUE 0x80046C48 Val_Wr32 1500.00000 Trq_float -500.000000 1000.00000 FORMAT "%10.5" EXTENDED_LIMITS -1.00000000E+037 1.00000000E+037 /end CHARACTERISTIC
/begin CHARACTERISTIC ASDdc_trqLimMin_C "ASD Störungsregler Ausgangsbegrenzung Minimum" VALUE 0x80046C4C Val_Wr32 1500.00000 Trq_float -500.000000 1000.00000 FORMAT "%10.5" EXTENDED_LIMITS -1.00000000E+037 1.00000000E+037 /end CHARACTERISTIC
/begin CHARACTERISTIC ASDdc_vLimIni_C "ASD Störungsregler Geschwindigkeitsschwelle für Initialisierung / Deaktivierung" VALUE 0x80046C50 Val_Ws16 655.3500 Vel -327.6800 327.6700 FORMAT "%8.4" /end CHARACTERISTIC
/begin CHARACTERISTIC Com_ctHeatACSelfRec_C "" VALUE 0x8004B390 Val_Wu8 255.0 OneToOne 0.00 255.0 FORMAT "%5.1" /end CHARACTERISTIC
/begin CHARACTERISTIC Com_facTrqAC_MAP "" MAP 0x8004B394 Map_Xs16Ys16Ws16 10.00000 Fact100 0.00 10.00000 FORMAT "%8.5" EXTENDED_LIMITS -327.6800 327.6700
 /begin AXIS_DESCR STD_AXIS Com_trqAC Trq 4 -3276.800 3276.700 FORMAT "%8.3" DEPOSIT ABSOLUTE /end AXIS_DESCR
 /begin AXIS_DESCR STD_AXIS Epm_nEng EngN 4 -16384.00 16383.50 FORMAT "%8.2" DEPOSIT ABSOLUTE /end AXIS_DESCR
/end CHARACTERISTIC
/begin CHARACTERISTIC Com_swtHeatAC_C "" VALUE 0x8004B391 Val_Wu8 1.000 OneToOne 0.00 1.000 FORMAT "%5.3" EXTENDED_LIMITS 0.00 255.0 /end CHARACTERISTIC
/begin CHARACTERISTIC Com_tiHeatACSelfRec_C "" VALUE 0x8004B392 Val_Ws16 327670.0 Time_ms 0.00 327670.0 FORMAT "%8.1" EXTENDED_LIMITS -327680.0 327670.0 /end CHARACTERISTIC
/begin CHARACTERISTIC WaHtEl_4WinSigDur.tiErr1Min_C "/" VALUE 0x800484B8 Kw_Ws16 655350.0 Time_ms -327680.0 327670.0 FORMAT "%8.1" /end CHARACTERISTIC
/begin CHARACTERISTIC WaHtEl_4WinSigDur.tiErr1Max_C "/" VALUE 0x800484BA Kw_Ws16 655350.0 Time_ms -327680.0 327670.0 FORMAT "%8.1" /end CHARACTERISTIC
/begin CHARACTERISTIC WaHtEl_4WinSigDur.tiErr2Min_C "/" VALUE 0x800484BC Kw_Ws16 655350.0 Time_ms -327680.0 327670.0 FORMAT "%8.1" /end CHARACTERISTIC
/begin CHARACTERISTIC WaHtEl_4WinSigDur.tiErr2Max_C "/" VALUE 0x800484BE Kw_Ws16 655350.0 Time_ms -327680.0 327670.0 FORMAT "%8.1" /end CHARACTERISTIC
/begin CHARACTERISTIC WaHtEl_4WinSigDur.tiErr3Min_C "/" VALUE 0x800484C0 Kw_Ws16 655350.0 Time_ms -327680.0 327670.0 FORMAT "%8.1" /end CHARACTERISTIC
/begin CHARACTERISTIC WaHtEl_4WinSigDur.tiErr3Max_C "/" VALUE 0x800484C2 Kw_Ws16 655350.0 Time_ms -327680.0 327670.0 FORMAT "%8.1" /end CHARACTERISTIC
/begin CHARACTERISTIC WaHtEl_4WinSigDur.tiErr4Min_C "/" VALUE 0x800484C4 Kw_Ws16 655350.0 Time_ms -327680.0 327670.0 FORMAT "%8.1" /end CHARACTERISTIC
/begin CHARACTERISTIC WaHtEl_4WinSigDur.tiErr4Max_C "/" VALUE 0x800484C6 Kw_Ws16 655350.0 Time_ms -327680.0 327670.0 FORMAT "%8.1" /end CHARACTERISTIC
/begin CHARACTERISTIC WaHtEl_Pwm.tiPer_C "/" VALUE 0x800484C8 Kw_Ws16 6553.500 Period -3276.800 3276.700 FORMAT "%8.3" /end CHARACTERISTIC
/begin CHARACTERISTIC WaHtEl_Pwm.stLvl_C "/" VALUE 0x800484CA Kw_Wu8 1.000 OneToOne 0.00 1.000 FORMAT "%5.3" EXTENDED_LIMITS 0.00 255.0 /end CHARACTERISTIC
/begin CHARACTERISTIC WaHtEl_Pwm.rMaxDty_C "/" VALUE 0x800484CC Kw_Ws16 100.0000 DtyCyc 0.00 100.0000 FORMAT "%8.4" EXTENDED_LIMITS -327.6800 327.6700 /end CHARACTERISTIC
/begin CHARACTERISTIC WaHtEl_Pwm.rPerUn_C "/" VALUE 0x800484CE Kw_Ws16 3276.700 Period 0.00 3276.700 FORMAT "%8.3" EXTENDED_LIMITS -3276.800 3276.700 /end CHARACTERISTIC
/begin CHARACTERISTIC WaHtEl_Pwm.tiPh_C "/" VALUE 0x800484D0 Kw_Ws16 65535.00 OneToOne -32768.00 32767.00 FORMAT "%8.2" /end CHARACTERISTIC
/begin CHARACTERISTIC WaHtEl_PwmOut.rMin_C "/" VALUE 0x800484D2 Kw_Ws16 100.0000 DtyCyc 0.00 100.0000 FORMAT "%8.4" EXTENDED_LIMITS -327.6800 327.6700 /end CHARACTERISTIC
/begin CHARACTERISTIC WaHtEl_PwmOut.rMax_C "/" VALUE 0x800484D4 Kw_Ws16 100.0000 DtyCyc 0.00 100.0000 FORMAT "%8.4" EXTENDED_LIMITS -327.6800 327.6700 /end CHARACTERISTIC
/begin CHARACTERISTIC WaHtEl_PwmOut.tiBtwTstSCB_C "/" VALUE 0x800484D6 Kw_Ws16 1000.000 Time_ms 0.00 1000.000 FORMAT "%8.3" EXTENDED_LIMITS -327680.0 327670.0 /end CHARACTERISTIC
/begin CHARACTERISTIC WaHtEl_PwmOut.tiBtwTstOT_C "/" VALUE 0x800484D8 Kw_Ws16 327.6700 Time_s 0.00 327.6700 FORMAT "%8.4" EXTENDED_LIMITS -327.6800 327.6700 /end CHARACTERISTIC
/begin CHARACTERISTIC WaHtEl_PwmOut.numTstMax_C "/" VALUE 0x800484DA Kw_Wu16 65535.00 OneToOne 0.00 65535.00 FORMAT "%8.2" /end CHARACTERISTIC
/begin CHARACTERISTIC WaHtEl_PwmOut.swtBattCor_C "/" VALUE 0x800484DC Kw_Wu8 1.000 OneToOne 0.00 1.000 FORMAT "%5.3" EXTENDED_LIMITS 0.00 255.0 /end CHARACTERISTIC
/begin CHARACTERISTIC WaHtEl_PwmOut.swtPsInv_C "/" VALUE 0x800484DD Kw_Wu8 255.0 OneToOne 0.00 255.0 FORMAT "%5.1" /end CHARACTERISTIC
/begin CHARACTERISTIC WaHtEl_rCnv_CUR "" CURVE 0x800484DE Cur_Xs16Ws16 100.0000 DtyCyc 0.00 100.0000 FORMAT "%8.4" EXTENDED_LIMITS -327.6800 327.6700
 /begin AXIS_DESCR STD_AXIS WaHtEl_r Prc 16 -400.0000 399.9878 FORMAT "%8.4" DEPOSIT ABSOLUTE /end AXIS_DESCR
/end CHARACTERISTIC
/begin CHARACTERISTIC WaHtEl_rPsDisbl_C "" VALUE 0x80048520 Val_Ws16 100.0000 DtyCyc 0.00 100.0000 FORMAT "%8.4" EXTENDED_LIMITS -327.6800 327.6700 /end CHARACTERISTIC
/begin CHARACTERISTIC WaHtEl_rPsRecg_C "" VALUE 0x80048522 Val_Ws16 75.00000 DtyCyc 0.00 75.00000 FORMAT "%8.5" EXTENDED_LIMITS -327.6800 327.6700 /end CHARACTERISTIC
/begin CHARACTERISTIC WaHtEl_stPsDiaDisbl_C "" VALUE 0x80048524 Val_Wu8 255.0 OneToOne 0.00 255.0 FORMAT "%5.1" /end CHARACTERISTIC
/begin CHARACTERISTIC WaHtEl_stPsDisbl_C "" VALUE 0x80048525 Val_Wu8 255.0 OneToOne 0.00 255.0 FORMAT "%5.1" /end CHARACTERISTIC
/begin CHARACTERISTIC WaHtEl_tiDebHtRecg_C "" VALUE 0x80048526 Val_Ws16 655350.0 TimeDeb -327680.0 327670.0 FORMAT "%8.1" /end CHARACTERISTIC
/begin CHARACTERISTIC WaHtEl_typ4WinDia_C "" VALUE 0x80048528 Val_Wu8 0.00 Typ4WinDia 0.00 0.00 FORMAT "%13.2" EXTENDED_LIMITS 0.00 3.00000000000 /end CHARACTERISTIC
/begin MEASUREMENT AFS_dm "" SWORD AirMassPerTime 1 100 -3276.800 3276.700 FORMAT "%8.3" ECU_ADDRESS 0xD0006980 /end MEASUREMENT
/begin MEASUREMENT AFS_dmAirFrz_mp "" SWORD AirMassPerTime 1 100 -3276.800 3276.700 FORMAT "%8.3" ECU_ADDRESS 0xC000004C /end MEASUREMENT
/begin MEASUREMENT AFS_dmAirMsFlt_mp "" SWORD AirMassPerTime 1 100 -3276.800 3276.700 FORMAT "%8.3" ECU_ADDRESS 0xC0000062 /end MEASUREMENT
/begin MEASUREMENT AFS_dmAirSubsVal_mp "" SWORD AirMassPerTime 1 100 -3276.800 3276.700 FORMAT "%8.3" ECU_ADDRESS 0xC000004E /end MEASUREMENT
/begin MEASUREMENT AFS_dmComp_mp "" SWORD AirMassPerTime 1 100 -3276.800 3276.700 FORMAT "%8.3" ECU_ADDRESS 0xC0000050 /end MEASUREMENT
/begin MEASUREMENT AFS_dmDrft "" SWORD AirMassPerTime 1 100 -3276.800 3276.700 FORMAT "%8.3" ECU_ADDRESS 0xD0006986 /end MEASUREMENT
/begin MEASUREMENT AFS_dmIdlAirMs_mp "" SWORD AirMassPerTime 1 100 -3276.800 3276.700 FORMAT "%8.3" ECU_ADDRESS 0xC0000064 /end MEASUREMENT
/begin MEASUREMENT AFS_dmLdAirMs_mp "" SWORD AirMassPerTime 1 100 -3276.800 3276.700 FORMAT "%8.3" ECU_ADDRESS 0xC0000066 /end MEASUREMENT
/begin MEASUREMENT AFS_dmPlsCorr_mp "" SWORD AirMassPerTime 1 100 -3276.800 3276.700 FORMAT "%8.3" ECU_ADDRESS 0xC0000052 /end MEASUREMENT
/begin MEASUREMENT AFS_dmSens "" SWORD AirMassPerTime 1 100 -3276.800 3276.700 FORMAT "%8.3" ECU_ADDRESS 0xD0006988 /end MEASUREMENT
/begin MEASUREMENT AFS_dmSensCorr_mp "" SWORD AirMassPerTime 1 100 -3276.800 3276.700 FORMAT "%8.3" ECU_ADDRESS 0xC0000054 /end MEASUREMENT
/begin MEASUREMENT AFS_dpIntValAbsFlt_mp "" SWORD RmpPres_hPa 1 100 -500.0000 499.9847 FORMAT "%8.4" ECU_ADDRESS 0xC0000068 /end MEASUREMENT
/begin MEASUREMENT AFS_dpIntValAbs_mp "" SWORD RmpPres_hPa 1 100 -500.0000 499.9847 FORMAT "%8.4" ECU_ADDRESS 0xC000006A /end MEASUREMENT
/begin MEASUREMENT AFS_dqCurrAbsFlt_mp "" SWORD RmpInjMass 1 100 -5.000000 4.999847 FORMAT "%8.6" ECU_ADDRESS 0xC000006C /end MEASUREMENT
/begin MEASUREMENT AFS_dqCurrAbs_mp "" SWORD RmpInjMass 1 100 -5.000000 4.999847 FORMAT "%8.6" ECU_ADDRESS 0xC000006E /end MEASUREMENT
/begin MEASUREMENT AFS_drWtPenDetFlt_mp "" SWORD Rmp_1 1 100 -32.76800 32.76700 FORMAT "%8.5" ECU_ADDRESS 0xC0000070 /end MEASUREMENT
/begin MEASUREMENT AFS_drWtPenDet_mp "" SWORD Rmp_1 1 100 -32.76800 32.76700 FORMAT "%8.5" ECU_ADDRESS 0xC0000072 /end MEASUREMENT
/begin MEASUREMENT AFS_facCalcIdlAdjVal_mp "" SWORD Fact 1 100 -4.000000 3.999878 FORMAT "%8.6" ECU_ADDRESS 0xC0000074 /end MEASUREMENT
/begin MEASUREMENT AFS_facCalcLdAdjVal_mp "" SWORD Fact 1 100 -4.000000 3.999878 FORMAT "%8.6" ECU_ADDRESS 0xC0000076 /end MEASUREMENT
/begin MEASUREMENT AFS_facCalcValFlt_mp "" SWORD Fact 1 100 -4.000000 3.999878 FORMAT "%8.6" ECU_ADDRESS 0xC0000078 /end MEASUREMENT
/begin MEASUREMENT AFS_facCalcVal_mp "" SWORD Fact 1 100 -4.000000 3.999878 FORMAT "%8.6" ECU_ADDRESS 0xC000007A /end MEASUREMENT
/begin MEASUREMENT AFS_facCorIdl_mp "" SWORD Fact 1 100 -4.000000 3.999878 FORMAT "%8.6" ECU_ADDRESS 0xC000007C /end MEASUREMENT
/begin MEASUREMENT AFS_facCorIpo_mp "" SWORD Fact 1 100 -4.000000 3.999878 FORMAT "%8.6" ECU_ADDRESS 0xC000007E /end MEASUREMENT
/begin MEASUREMENT AFS_facCorLd_mp "" SWORD Fact 1 100 -4.000000 3.999878 FORMAT "%8.6" ECU_ADDRESS 0xC0000080 /end MEASUREMENT
/begin MEASUREMENT AFS_facIdlAdjValUnLim_mp "" SWORD Fact 1 100 -4.000000 3.999878 FORMAT "%8.6" ECU_ADDRESS 0xC0000082 /end MEASUREMENT
/begin MEASUREMENT AFS_facIdlAdjVal_mp "" SWORD Fact 1 100 -4.000000 3.999878 FORMAT "%8.6" ECU_ADDRESS 0xC0000084 /end MEASUREMENT
/begin MEASUREMENT AFS_facLdAdjValUnLim_mp "" SWORD Fact 1 100 -4.000000 3.999878 FORMAT "%8.6" ECU_ADDRESS 0xC0000086 /end MEASUREMENT
/begin MEASUREMENT AFS_facLdAdjVal_mp "" SWORD Fact 1 100 -4.000000 3.999878 FORMAT "%8.6" ECU_ADDRESS 0xC0000088 /end MEASUREMENT
/begin MEASUREMENT AFS_facPlsCor_mp "" SWORD Fact 1 100 -4.000000 3.999878 FORMAT "%8.6" ECU_ADDRESS 0xC0000056 /end MEASUREMENT
/begin MEASUREMENT AFS_facSwtOnCor_mp "" SWORD Fact 1 100 -4.000000 3.999878 FORMAT "%8.6" ECU_ADDRESS 0xC0000058 /end MEASUREMENT
/begin MEASUREMENT AFS_mAirPerCyl "" SWORD AirMassPerCyl 1 100 -3276.800 3276.700 FORMAT "%8.3" ECU_ADDRESS 0xD000698A /end MEASUREMENT
/begin MEASUREMENT AFS_mAirPerCylFlt "" SWORD AirMassPerCyl 1 100 -3276.800 3276.700 FORMAT "%8.3" ECU_ADDRESS 0xD0006990 /end MEASUREMENT
/begin MEASUREMENT AFS_mAirPerCyl_mp "" SWORD AirMassPerCyl 1 100 -3276.800 3276.700 FORMAT "%8.3" ECU_ADDRESS 0xC000005A /end MEASUREMENT
/begin MEASUREMENT AFS_qAirmThrSRCHiActv_mp "" SWORD InjMass 1 100 -327.6800 327.6700 FORMAT "%8.4" ECU_ADDRESS 0xC0000042 /end MEASUREMENT
/begin MEASUREMENT AFS_qWinLdAdjThresHi_mp "" SWORD InjMass 1 100 -327.6800 327.6700 FORMAT "%8.4" ECU_ADDRESS 0xC000008A /end MEASUREMENT
/begin MEASUREMENT AFS_qWinLdAdjThresLo_mp "" SWORD InjMass 1 100 -327.6800 327.6700 FORMAT "%8.4" ECU_ADDRESS 0xC000008C /end MEASUREMENT
/begin MEASUREMENT AFS_rNorm_mp "" SWORD Fact 1 100 -4.000000 3.999878 FORMAT "%8.6" ECU_ADDRESS 0xC000005C /end MEASUREMENT
/begin MEASUREMENT AFS_stAdjRlsDel_mp "" UBYTE OneToOne 1 100 0.00 255.0 FORMAT "%5.1" ECU_ADDRESS 0xC000008E /end MEASUREMENT
/begin MEASUREMENT AFS_stDrft "" UBYTE OneToOne 1 100 0.00 255.0 FORMAT "%5.1" ECU_ADDRESS 0xD0008EF6 /end MEASUREMENT
/begin MEASUREMENT AFS_stDrftMonRls "" UBYTE OneToOne 1 100 0.00 255.0 FORMAT "%5.1" ECU_ADDRESS 0xD0008EF9 /end MEASUREMENT
/begin MEASUREMENT AFS_stDrftMonRls_mp "" UBYTE OneToOne 1 100 0.00 255.0 FORMAT "%5.1" ECU_ADDRESS 0xC000005E /end MEASUREMENT
/begin MEASUREMENT AFS_stEnvCon_mp "" UBYTE OneToOne 1 100 0.00 255.0 FORMAT "%5.1" ECU_ADDRESS 0xC000008F /end MEASUREMENT
/begin MEASUREMENT AFS_stIdlAdjRlsCon_mp "" UBYTE OneToOne 1 100 0.00 255.0 FORMAT "%5.1" ECU_ADDRESS 0xC0000090 /end MEASUREMENT
/begin MEASUREMENT AFS_stIpoRng_mp "" UBYTE OneToOne 1 100 0.00 255.0 FORMAT "%5.1" ECU_ADDRESS 0xC0000091 /end MEASUREMENT
/begin MEASUREMENT AFS_stLdAdjRlsCon_mp "" UBYTE OneToOne 1 100 0.00 255.0 FORMAT "%5.1" ECU_ADDRESS 0xC0000092 /end MEASUREMENT
/begin MEASUREMENT AFS_stOffsTst "" UBYTE OneToOne 1 100 0.00 255.0 FORMAT "%5.1" ECU_ADDRESS 0xD0008EFA /end MEASUREMENT
/begin MEASUREMENT AFS_stPlSetyDrftRls_mp "" UBYTE OneToOne 1 100 0.00 255.0 FORMAT "%5.1" ECU_ADDRESS 0xC000005F /end MEASUREMENT
/begin MEASUREMENT AFS_stPlSetyDrft_mp "" UBYTE OneToOne 1 100 0.00 255.0 FORMAT "%5.1" ECU_ADDRESS 0xC0000060 /end MEASUREMENT
/begin MEASUREMENT AFS_stPlSetyRls_mp "" UBYTE OneToOne 1 100 0.00 255.0 FORMAT "%5.1" ECU_ADDRESS 0xC0000061 /end MEASUREMENT
/begin MEASUREMENT AFS_stPlsOffsDrftTstActv_mp "" UBYTE OneToOne 1 100 0.00 255.0 FORMAT "%5.1" ECU_ADDRESS 0xC0000044 /end MEASUREMENT
/begin MEASUREMENT AFS_stRstLoDrftThres_mp "" UBYTE OneToOne 1 100 0.00 255.0 FORMAT "%5.1" ECU_ADDRESS 0xC0000093 /end MEASUREMENT
/begin MEASUREMENT AFS_stSRCHiRls_mp "" UBYTE OneToOne 1 100 0.00 255.0 FORMAT "%5.1" ECU_ADDRESS 0xC0000045 /end MEASUREMENT
/begin MEASUREMENT AFS_stSRCHiTstRls_mp "" UBYTE OneToOne 1 100 0.00 255.0 FORMAT "%5.1" ECU_ADDRESS 0xC0000046 /end MEASUREMENT
/begin MEASUREMENT AFS_stSRCLoTstRls_mp "" UBYTE OneToOne 1 100 0.00 255.0 FORMAT "%5.1" ECU_ADDRESS 0xC0000047 /end MEASUREMENT
/begin MEASUREMENT AFS_stWtPenDetDeb_mp "" UBYTE OneToOne 1 100 0.00 255.0 FORMAT "%5.1" ECU_ADDRESS 0xC0000094 /end MEASUREMENT
/begin MEASUREMENT AFS_stWtPenDet_mp "" UBYTE OneToOne 1 100 0.00 255.0 FORMAT "%5.1" ECU_ADDRESS 0xC0000095 /end MEASUREMENT
/begin MEASUREMENT AFS_swtActvAftRun "" UBYTE OneToOne 1 100 0.00 255.0 FORMAT "%5.1" ECU_ADDRESS 0xD0008EFB /end MEASUREMENT
/begin MEASUREMENT AFS_tiCor_mp "" SWORD Time_PwmHigh 1 100 -1638.400 1638.350 FORMAT "%8.3" ECU_ADDRESS 0xC0000048 /end MEASUREMENT
/begin MEASUREMENT AFS_tiRaw "" SWORD Time_PwmHigh 1 100 -1638.400 1638.350 FORMAT "%8.3" ECU_ADDRESS 0xD0006992 /end MEASUREMENT
/begin MEASUREMENT AFS_tiRawAvrg_mp "" SWORD Time_PwmHigh 1 100 -1638.400 1638.350 FORMAT "%8.3" ECU_ADDRESS 0xC000004A /end MEASUREMENT
/begin MEASUREMENT AirCtl_AirTempCorBasEOMQnt1_mp "Basiswert der Lufttemperaturkorrektur für die erste mengenbasierte Betriebsart" SWORD AirMassPerCyl 1 100 -3276.800 3276.700 FORMAT "%8.3" ECU_ADDRESS 0xC0000102 /end MEASUREMENT
/begin MEASUREMENT AirCtl_AirTempCorBas_mp "Basiswert der Lufttemperaturkorrektur" SWORD AirMassPerCyl 1 100 -3276.800 3276.700 FORMAT "%8.3" ECU_ADDRESS 0xC0000098 /end MEASUREMENT
/begin MEASUREMENT AirCtl_AirTempCorEOMQnt1_mp "Wert aus der Lufttemperaturkorrektur für die erste mengenbasierte Betriebsart" SWORD AirMassPerCyl 1 100 -3276.800 3276.700 FORMAT "%8.3" ECU_ADDRESS 0xC0000104 /end MEASUREMENT
/begin MEASUREMENT AirCtl_AirTempCor_mp "Lufttemperaturkorrekturwert" SWORD AirMassPerCyl 1 100 -3276.800 3276.700 FORMAT "%8.3" ECU_ADDRESS 0xC000009A /end MEASUREMENT
/begin MEASUREMENT AirCtl_DKdmDes_mp "" SLONG Kd 1 100 -32768.0000000 32767.9999847 FORMAT "%13.7" ECU_ADDRESS 0xC00000D4 /end MEASUREMENT
/begin MEASUREMENT AirCtl_DKdNegMDes_mp "" SWORD Kd_RedRes 1 100 -512.0000 511.9844 FORMAT "%8.4" ECU_ADDRESS 0xC00000D8 /end MEASUREMENT
/begin MEASUREMENT AirCtl_DKdPosMDes_mp "" SWORD Kd_RedRes 1 100 -512.0000 511.9844 FORMAT "%8.4" ECU_ADDRESS 0xC00000DA /end MEASUREMENT
/begin MEASUREMENT AirCtl_dmDesCor_mp "" SWORD AirMassPerCyl 1 100 -3276.800 3276.700 FORMAT "%8.3" ECU_ADDRESS 0xC00000DC /end MEASUREMENT
/begin MEASUREMENT AirCtl_dmDWinNegDes_mp "" SWORD AirMassPerCyl 1 100 -3276.800 3276.700 FORMAT "%8.3" ECU_ADDRESS 0xC00000DE /end MEASUREMENT
/begin MEASUREMENT AirCtl_dmDWinPosDes_mp "" SWORD AirMassPerCyl 1 100 -3276.800 3276.700 FORMAT "%8.3" ECU_ADDRESS 0xC00000E0 /end MEASUREMENT
/begin MEASUREMENT AirCtl_dnAvrg_mp "" SWORD dn_dZ20 1 100 -163840.0 163835.0 FORMAT "%8.1" ECU_ADDRESS 0xC00001A4 /end MEASUREMENT
/begin MEASUREMENT AirCtl_dnSurgeHigh_mp "" SWORD dn_dZ20 1 100 -163840.0 163835.0 FORMAT "%8.1" ECU_ADDRESS 0xC00001A6 /end MEASUREMENT
/begin MEASUREMENT AirCtl_dnSurgeLow_mp "" SWORD dn_dZ20 1 100 -163840.0 163835.0 FORMAT "%8.1" ECU_ADDRESS 0xC00001A8 /end MEASUREMENT
/begin MEASUREMENT AirCtl_facAirTempCor2_mp "" SWORD Fact 1 100 -4.000000 3.999878 FORMAT "%8.6" ECU_ADDRESS 0xC00000E2 /end MEASUREMENT
/begin MEASUREMENT AirCtl_facAirTempCorEOMQnt1_mp "Korrekturfaktor zum Basiswert der Lufttemperaturkorrektur für die erste mengenbasierte Betriebsart" SWORD Fact 1 100 -4.000000 3.999878 FORMAT "%8.6" ECU_ADDRESS 0xC0000106 /end MEASUREMENT
/begin MEASUREMENT AirCtl_facAirTempCor_mp "Korrekturfaktor für den Basiswert der Lufttemperaturkorrektur" SWORD Fact 1 100 -4.000000 3.999878 FORMAT "%8.6" ECU_ADDRESS 0xC000009C /end MEASUREMENT
/begin MEASUREMENT AirCtl_facBstPresCor_mp "Ladedruckabhängiger Korrekturfaktor" SWORD Fact 1 100 -4.000000 3.999878 FORMAT "%8.6" ECU_ADDRESS 0xC000009E /end MEASUREMENT
/begin MEASUREMENT AirCtl_facEngTempCorEOMQnt1_mp "Korrekturfaktor zum Basiswert der Motortemperaturkorrektur für die erste mengenbasierte Betriebsart" SWORD Fact 1 100 -4.000000 3.999878 FORMAT "%8.6" ECU_ADDRESS 0xC0000108 /end MEASUREMENT
/begin MEASUREMENT AirCtl_facEngTempCor_mp "Korrekturfaktor für den Basiswert der Motortemperaturkorrektur" SWORD Fact 1 100 -4.000000 3.999878 FORMAT "%8.6" ECU_ADDRESS 0xC00000A0 /end MEASUREMENT
/begin MEASUREMENT AirCtl_facEnvPresCorEOMQnt1_mp "Atmosphärendruckabhängiger Korrekturfaktor für die erste mengenbasierte Betriebsart" SWORD Fact 1 100 -4.000000 3.999878 FORMAT "%8.6" ECU_ADDRESS 0xC000010A /end MEASUREMENT
/begin MEASUREMENT AirCtl_facEnvPresCor_mp "Atmosphärendruckabhängiger Korrekturfaktor" SWORD Fact 1 100 -4.000000 3.999878 FORMAT "%8.6" ECU_ADDRESS 0xC00000A2 /end MEASUREMENT
/begin MEASUREMENT AirCtl_facParAirTempEOM_mp "Lufttemperaturabhängiger Korrekturfaktor für die Parameteradaption im Regenerationsbetrieb" SWORD Fact1 1 100 -256.0000 255.9922 FORMAT "%8.4" ECU_ADDRESS 0xC000016A /end MEASUREMENT
/begin MEASUREMENT AirCtl_facParAirTemp_mp "Lufttemperaturabhängiger Korrekturfaktor für die Parameteradaption" SWORD Fact1 1 100 -256.0000 255.9922 FORMAT "%8.4" ECU_ADDRESS 0xC0000146 /end MEASUREMENT
/begin MEASUREMENT AirCtl_facParBasEOM_mp "Basisfaktor der Parameteradaption im Regenerationsbetrieb" SWORD Fact1 1 100 -256.0000 255.9922 FORMAT "%8.4" ECU_ADDRESS 0xC000016C /end MEASUREMENT
/begin MEASUREMENT AirCtl_facParBas_mp "Basisfaktor der Parameteradaption" SWORD Fact1 1 100 -256.0000 255.9922 FORMAT "%8.4" ECU_ADDRESS 0xC0000148 /end MEASUREMENT
/begin MEASUREMENT AirCtl_facParCorEOM_mp "Lufttemperatur abhängig korrigierter Parameteradaptionsfaktor im Regenerationsbetrieb" SWORD Fact1 1 100 -256.0000 255.9922 FORMAT "%8.4" ECU_ADDRESS 0xC000016E /end MEASUREMENT
/begin MEASUREMENT AirCtl_facParCor_mp "Über Lufttemperatur korrigierter Parameteradaptionsfaktor" SWORD Fact1 1 100 -256.0000 255.9922 FORMAT "%8.4" ECU_ADDRESS 0xC000014A /end MEASUREMENT
/begin MEASUREMENT AirCtl_facParNrm_mp "Parameteradaptionsfaktor im Normalbetrieb" SWORD Fact1 1 100 -256.0000 255.9922 FORMAT "%8.4" ECU_ADDRESS 0xC000014C /end MEASUREMENT
/begin MEASUREMENT AirCtl_facParPresDiff_mp "Differenzdruck abhängiger Parameteradaptionsfaktor" SWORD Fact1 1 100 -256.0000 255.9922 FORMAT "%8.4" ECU_ADDRESS 0xC0000172 /end MEASUREMENT
/begin MEASUREMENT AirCtl_facRmpValCor_mp "Korrigierter zentraler EGT-Rampenwert" SWORD CoEOMSwt_S16 1 100 -2.000000 1.999939 FORMAT "%8.6" ECU_ADDRESS 0xC00000CE /end MEASUREMENT
/begin MEASUREMENT AirCtl_facTrmRgn_mp "" SWORD Fact 1 100 -4.000000 3.999878 FORMAT "%8.6" ECU_ADDRESS 0xC0000138 /end MEASUREMENT
/begin MEASUREMENT AirCtl_mActVal_mp "Für die Abgasrückführregelung ausgewählter Luftmassenistwert" SWORD AirMassPerCyl 1 100 -3276.800 3276.700 FORMAT "%8.3" ECU_ADDRESS 0xC000014E /end MEASUREMENT
/begin MEASUREMENT AirCtl_mAirTempCor2_mp "" SWORD AirMassPerCyl 1 100 -3276.800 3276.700 FORMAT "%8.3" ECU_ADDRESS 0xC00000E4 /end MEASUREMENT
/begin MEASUREMENT AirCtl_mAirTempCorBas2_mp "" SWORD AirMassPerCyl 1 100 -3276.800 3276.700 FORMAT "%8.3" ECU_ADDRESS 0xC00000E6 /end MEASUREMENT
/begin MEASUREMENT AirCtl_mDesAdd1_mp "" SWORD AirMassPerCyl 1 100 -3276.800 3276.700 FORMAT "%8.3" ECU_ADDRESS 0xC00000EE /end MEASUREMENT
/begin MEASUREMENT AirCtl_mDesAddBas_mp "" SWORD AirMassPerCyl 1 100 -3276.800 3276.700 FORMAT "%8.3" ECU_ADDRESS 0xC00000F0 /end MEASUREMENT
/begin MEASUREMENT AirCtl_mDesAddEOM1_mp "" SWORD AirMassPerCyl 1 100 -3276.800 3276.700 FORMAT "%8.3" ECU_ADDRESS 0xC0000124 /end MEASUREMENT
/begin MEASUREMENT AirCtl_mDesAddEOM_mp "" SWORD AirMassPerCyl 1 100 -3276.800 3276.700 FORMAT "%8.3" ECU_ADDRESS 0xC0000126 /end MEASUREMENT
/begin MEASUREMENT AirCtl_mDesAddUnLimEOM_mp "" SWORD AirMassPerCyl 1 100 -3276.800 3276.700 FORMAT "%8.3" ECU_ADDRESS 0xC0000128 /end MEASUREMENT
/begin MEASUREMENT AirCtl_mDesAddUnLim_mp "" SWORD AirMassPerCyl 1 100 -3276.800 3276.700 FORMAT "%8.3" ECU_ADDRESS 0xC00000F2 /end MEASUREMENT
/begin MEASUREMENT AirCtl_mDesAdd_mp "" SWORD AirMassPerCyl 1 100 -3276.800 3276.700 FORMAT "%8.3" ECU_ADDRESS 0xC00000F4 /end MEASUREMENT
/begin MEASUREMENT AirCtl_mDesBas "Basis-Luftmassen-Sollwert aus Grundkennfeld" SWORD AirMassPerCyl 1 100 -3276.800 3276.700 FORMAT "%8.3" ECU_ADDRESS 0xD0006B4C /end MEASUREMENT
/begin MEASUREMENT AirCtl_mDesBasAddEOM_mp "" SWORD AirMassPerCyl 1 100 -3276.800 3276.700 FORMAT "%8.3" ECU_ADDRESS 0xC000012A /end MEASUREMENT
/begin MEASUREMENT AirCtl_mDesBasDef_mp "" SWORD AirMassPerCyl 1 100 -3276.800 3276.700 FORMAT "%8.3" ECU_ADDRESS 0xC00000E8 /end MEASUREMENT
/begin MEASUREMENT AirCtl_mDesBasEOMQnt1_mp "Basis-Luftmassen-Sollwert für die erste auf Einspritzmenge basierte Betriebsart" SWORD AirMassPerCyl 1 100 -3276.800 3276.700 FORMAT "%8.3" ECU_ADDRESS 0xC000010C /end MEASUREMENT
/begin MEASUREMENT AirCtl_mDesBasHiAltdDef_mp "" SWORD AirMassPerCyl 1 100 -3276.800 3276.700 FORMAT "%8.3" ECU_ADDRESS 0xC00000EA /end MEASUREMENT
/begin MEASUREMENT AirCtl_mDesBasHiAltdEOMQnt1_mp "höhenabhängiger Basis-Luftmassen-Sollwert für die erste auf Einspritzmenge basierte Betriebsart" SWORD AirMassPerCyl 1 100 -3276.800 3276.700 FORMAT "%8.3" ECU_ADDRESS 0xC000010E /end MEASUREMENT
/begin MEASUREMENT AirCtl_mDesBasHiAltd_mp "Höhenbasiswert des Luftmassensollwerts" SWORD AirMassPerCyl 1 100 -3276.800 3276.700 FORMAT "%8.3" ECU_ADDRESS 0xC00000A4 /end MEASUREMENT
/begin MEASUREMENT AirCtl_mDesConvBas_mp "" SWORD AirMassPerCyl 1 100 -3276.800 3276.700 FORMAT "%8.3" ECU_ADDRESS 0xC00000F6 /end MEASUREMENT
/begin MEASUREMENT AirCtl_mDesConvEOM_mp "" SWORD AirMassPerCyl 1 100 -3276.800 3276.700 FORMAT "%8.3" ECU_ADDRESS 0xC000012C /end MEASUREMENT
/begin MEASUREMENT AirCtl_mDesCor2_mp "unbegrenzter stationärer Luftmassen-Sollwert" SWORD AirMassPerCyl 1 100 -3276.800 3276.700 FORMAT "%8.3" ECU_ADDRESS 0xC00000A6 /end MEASUREMENT
/begin MEASUREMENT AirCtl_mDesCorCalc1 "" SWORD AirMassPerCyl 1 100 -3276.800 3276.700 FORMAT "%8.3" ECU_ADDRESS 0xD0006B52 /end MEASUREMENT
/begin MEASUREMENT AirCtl_mDesCorCalc2_mp "" SWORD AirMassPerCyl 1 100 -3276.800 3276.700 FORMAT "%8.3" ECU_ADDRESS 0xC000013A /end MEASUREMENT
/begin MEASUREMENT AirCtl_mDesCorCalc3_mp "" SWORD AirMassPerCyl 1 100 -3276.800 3276.700 FORMAT "%8.3" ECU_ADDRESS 0xC000013C /end MEASUREMENT
/begin MEASUREMENT AirCtl_mDesCorCalc4_mp "" SWORD AirMassPerCyl 1 100 -3276.800 3276.700 FORMAT "%8.3" ECU_ADDRESS 0xC000013E /end MEASUREMENT
/begin MEASUREMENT AirCtl_mDesCor_mp "Luftmassensollwert [mg/stroke] Korrektur" SWORD AirMassPerCyl 1 100 -3276.800 3276.700 FORMAT "%8.3" ECU_ADDRESS 0xC00000A8 /end MEASUREMENT
/begin MEASUREMENT AirCtl_mDesDef_mp "" SWORD AirMassPerCyl 1 100 -3276.800 3276.700 FORMAT "%8.3" ECU_ADDRESS 0xC00000EC /end MEASUREMENT
/begin MEASUREMENT AirCtl_mDesDyn_mp "dynamischer Anteil des Luftmassensollwerts" SWORD AirMassPerCyl 1 100 -3276.800 3276.700 FORMAT "%8.3" ECU_ADDRESS 0xC00000AA /end MEASUREMENT
/begin MEASUREMENT AirCtl_mDesGearEOM_mp "" SWORD AirMassPerCyl 1 100 -3276.800 3276.700 FORMAT "%8.3" ECU_ADDRESS 0xC000012E /end MEASUREMENT
/begin MEASUREMENT AirCtl_mDesGearSwtEOM_mp "" SWORD AirMassPerCyl 1 100 -3276.800 3276.700 FORMAT "%8.3" ECU_ADDRESS 0xC0000130 /end MEASUREMENT
/begin MEASUREMENT AirCtl_mDesGearSwt_mp "" SWORD AirMassPerCyl 1 100 -3276.800 3276.700 FORMAT "%8.3" ECU_ADDRESS 0xC00000F8 /end MEASUREMENT
/begin MEASUREMENT AirCtl_mDesGear_mp "" SWORD AirMassPerCyl 1 100 -3276.800 3276.700 FORMAT "%8.3" ECU_ADDRESS 0xC00000FA /end MEASUREMENT
/begin MEASUREMENT AirCtl_mDesMax_mp "Berechneter Luftmassenstrom bei geschlossenen Abgasrückführventil" SWORD AirMassPerCyl 1 100 -3276.800 3276.700 FORMAT "%8.3" ECU_ADDRESS 0xC000018A /end MEASUREMENT
/begin MEASUREMENT AirCtl_mDesPil2CorBas_mp "" SWORD AirMassPerCyl 1 100 -3276.800 3276.700 FORMAT "%8.3" ECU_ADDRESS 0xC00000FC /end MEASUREMENT
/begin MEASUREMENT AirCtl_mDesPil2CorEOM_mp "" SWORD AirMassPerCyl 1 100 -3276.800 3276.700 FORMAT "%8.3" ECU_ADDRESS 0xC0000132 /end MEASUREMENT
/begin MEASUREMENT AirCtl_mDesStat "Luftmassengradient nach DT1 Glied" SWORD AirMassPerCyl 1 100 -3276.800 3276.700 FORMAT "%8.3" ECU_ADDRESS 0xD0006B54 /end MEASUREMENT
/begin MEASUREMENT AirCtl_mDesStrgCorrEOM_mp "" SWORD AirMassPerCyl 1 100 -3276.800 3276.700 FORMAT "%8.3" ECU_ADDRESS 0xC0000134 /end MEASUREMENT
/begin MEASUREMENT AirCtl_mDesStrgCorrSwtEOM_mp "" SWORD AirMassPerCyl 1 100 -3276.800 3276.700 FORMAT "%8.3" ECU_ADDRESS 0xC0000136 /end MEASUREMENT
/begin MEASUREMENT AirCtl_mDesStrgCorrSwt_mp "" SWORD AirMassPerCyl 1 100 -3276.800 3276.700 FORMAT "%8.3" ECU_ADDRESS 0xC00000FE /end MEASUREMENT
/begin MEASUREMENT AirCtl_mDesStrgCorr_mp "" SWORD AirMassPerCyl 1 100 -3276.800 3276.700 FORMAT "%8.3" ECU_ADDRESS 0xC0000100 /end MEASUREMENT
/begin MEASUREMENT AirCtl_mDesSum_mp "" SWORD AirMassPerCyl 1 100 -3276.800 3276.700 FORMAT "%8.3" ECU_ADDRESS 0xC00000AC /end MEASUREMENT
/begin MEASUREMENT AirCtl_mDesTrm_mp "" SWORD AirMassPerCyl 1 100 -3276.800 3276.700 FORMAT "%8.3" ECU_ADDRESS 0xC0000140 /end MEASUREMENT
/begin MEASUREMENT AirCtl_mDesVal "Luftmassensollwert" SWORD AirMassPerCyl 1 100 -3276.800 3276.700 FORMAT "%8.3" ECU_ADDRESS 0xD0006B5A /end MEASUREMENT
/begin MEASUREMENT AirCtl_mDesVal1Cor_mp "Korrigierter Basiswert des Luftmassensollwerts" SWORD AirMassPerCyl 1 100 -3276.800 3276.700 FORMAT "%8.3" ECU_ADDRESS 0xC00000AE /end MEASUREMENT
/begin MEASUREMENT AirCtl_mDesVal1EOMQnt1_mp "druckkorrigierter Basis-Luftmassen-Sollwert für die erste auf Einspritzmenge basierte Betriebsart" SWORD AirMassPerCyl 1 100 -3276.800 3276.700 FORMAT "%8.3" ECU_ADDRESS 0xC0000110 /end MEASUREMENT
/begin MEASUREMENT AirCtl_mDesVal1_mp "Luftmassensollwert nach Höhen- und Atmosphärendruckkorrektur" SWORD AirMassPerCyl 1 100 -3276.800 3276.700 FORMAT "%8.3" ECU_ADDRESS 0xC00000B0 /end MEASUREMENT
/begin MEASUREMENT AirCtl_mDesVal2EOMQnt1_mp "Luftmassen-Sollwert nach Lufttemperaturkorrektur für die erste auf Einspritzmenge basierte Betriebsart" SWORD AirMassPerCyl 1 100 -3276.800 3276.700 FORMAT "%8.3" ECU_ADDRESS 0xC0000112 /end MEASUREMENT
/begin MEASUREMENT AirCtl_mDesVal2_mp "Luftmassensollwert nach Abgleichwertkorrektur" SWORD AirMassPerCyl 1 100 -3276.800 3276.700 FORMAT "%8.3" ECU_ADDRESS 0xC00000B2 /end MEASUREMENT
/begin MEASUREMENT AirCtl_mDesVal3EOMQnt1_mp "Luftmassen-Sollwert nach Motortemperaturkorrektur für die erste auf Einspritzmenge basierte Betriebsart" SWORD AirMassPerCyl 1 100 -3276.800 3276.700 FORMAT "%8.3" ECU_ADDRESS 0xC0000114 /end MEASUREMENT
/begin MEASUREMENT AirCtl_mDesVal3_mp "Luftmassensollwert nach Lufttemperaturkorrektur" SWORD AirMassPerCyl 1 100 -3276.800 3276.700 FORMAT "%8.3" ECU_ADDRESS 0xC00000B4 /end MEASUREMENT
/begin MEASUREMENT AirCtl_mDesVal4EOMQnt1_mp "Luftmassen-Sollwert nach Ladedruckkorrektur für die erste auf Einspritzmenge basierte Betriebsart" SWORD AirMassPerCyl 1 100 -3276.800 3276.700 FORMAT "%8.3" ECU_ADDRESS 0xC0000116 /end MEASUREMENT
/begin MEASUREMENT AirCtl_mDesVal4_mp "Luftmassensollwert nach Motortemperaturkorrektur" SWORD AirMassPerCyl 1 100 -3276.800 3276.700 FORMAT "%8.3" ECU_ADDRESS 0xC00000B6 /end MEASUREMENT
/begin MEASUREMENT AirCtl_mDesVal5CorEOMQnt1_mp "korrigierter Luftmassen-Sollwert für die erste auf Einspritzmenge basierte Betriebsart" SWORD AirMassPerCyl 1 100 -3276.800 3276.700 FORMAT "%8.3" ECU_ADDRESS 0xC0000118 /end MEASUREMENT
/begin MEASUREMENT AirCtl_mDesVal5EOMQnt1_mp "Luftmassen-Sollwert nach Temperaturreglerkorrektur für die erste auf Einspritzmenge basierte Betriebsart" SWORD AirMassPerCyl 1 100 -3276.800 3276.700 FORMAT "%8.3" ECU_ADDRESS 0xC000011A /end MEASUREMENT
/begin MEASUREMENT AirCtl_mDesVal5_mp "Luftmassensollwert nach Ladedruckkorrektur" SWORD AirMassPerCyl 1 100 -3276.800 3276.700 FORMAT "%8.3" ECU_ADDRESS 0xC00000B8 /end MEASUREMENT
/begin MEASUREMENT AirCtl_mDesValNrm_mp "Luftmassensollwert im Normalbetrieb" SWORD AirMassPerCyl 1 100 -3276.800 3276.700 FORMAT "%8.3" ECU_ADDRESS 0xC00000BA /end MEASUREMENT
/begin MEASUREMENT AirCtl_mEngTempCorBasEOMQnt1_mp "Basis-Luftmassen-Sollwert der Motortemperaturkorrektur für die erste auf Einspritzmenge basierte Betriebsart" SWORD AirMassPerCyl 1 100 -3276.800 3276.700 FORMAT "%8.3" ECU_ADDRESS 0xC000011C /end MEASUREMENT
/begin MEASUREMENT AirCtl_mEngTempCorBas_mp "Basiswert der Motortemperaturkorrektur" SWORD AirMassPerCyl 1 100 -3276.800 3276.700 FORMAT "%8.3" ECU_ADDRESS 0xC00000BC /end MEASUREMENT
/begin MEASUREMENT AirCtl_mEngTempCorEOMQnt1_mp "Motortemperatur abhängiger Luftmassenkorrekturwert für die erste auf Einspritzmenge basierte Betriebsart" SWORD AirMassPerCyl 1 100 -3276.800 3276.700 FORMAT "%8.3" ECU_ADDRESS 0xC000011E /end MEASUREMENT
/begin MEASUREMENT AirCtl_mEngTempCor_mp "Motortemperaturabhängiger Luftmassenkorrekturwert" SWORD AirMassPerCyl 1 100 -3276.800 3276.700 FORMAT "%8.3" ECU_ADDRESS 0xC00000BE /end MEASUREMENT
/begin MEASUREMENT AirCtl_mGovDvt "Regelabweichung der Abgasrückführregelung" SWORD AirMassPerCyl 1 100 -3276.800 3276.700 FORMAT "%8.3" ECU_ADDRESS 0xD0006B60 /end MEASUREMENT
/begin MEASUREMENT AirCtl_mMaxDvt "Obere Grenze für die Erkennung einer bleibenden Regelabweichung" SWORD AirMassPerCyl 1 100 -3276.800 3276.700 FORMAT "%8.3" ECU_ADDRESS 0xD0006B66 /end MEASUREMENT
/begin MEASUREMENT AirCtl_mMaxDvt1EOM_mp "" SWORD AirMassPerCyl 1 100 -3276.800 3276.700 FORMAT "%8.3" ECU_ADDRESS 0xC00001C6 /end MEASUREMENT
/begin MEASUREMENT AirCtl_mMaxDvt1_mp "" SWORD AirMassPerCyl 1 100 -3276.800 3276.700 FORMAT "%8.3" ECU_ADDRESS 0xC00001C2 /end MEASUREMENT
/begin MEASUREMENT AirCtl_mMinDvt "Untere Grenze für die Erkennung einer bleibenden Regelabweichung" SWORD AirMassPerCyl 1 100 -3276.800 3276.700 FORMAT "%8.3" ECU_ADDRESS 0xD0006B6C /end MEASUREMENT
/begin MEASUREMENT AirCtl_mMinDvt1EOM_mp "" SWORD AirMassPerCyl 1 100 -3276.800 3276.700 FORMAT "%8.3" ECU_ADDRESS 0xC00001C8 /end MEASUREMENT
/begin MEASUREMENT AirCtl_mMinDvt1_mp "" SWORD AirMassPerCyl 1 100 -3276.800 3276.700 FORMAT "%8.3" ECU_ADDRESS 0xC00001C4 /end MEASUREMENT
/begin MEASUREMENT AirCtl_numEOMMode_mp "" UBYTE OneToOne 1 100 0.00 255.0 FORMAT "%5.1" ECU_ADDRESS 0xC00001B4 /end MEASUREMENT
/begin MEASUREMENT AirCtl_pBstPresRef_mp "Referenzladedruck" SWORD Pres_hPa 1 100 -32768.00 3500.00 FORMAT "%8.2" ECU_ADDRESS 0xC00000C0 /end MEASUREMENT
/begin MEASUREMENT AirCtl_pFltPPFltDiff_mp "" SWORD Pres_hPa 1 100 -32768.00 3500.00 FORMAT "%8.2" ECU_ADDRESS 0xC0000170 /end MEASUREMENT
/begin MEASUREMENT AirCtl_qCtlVal "Einspritzmenge für die Steuerung der Abgasrückführregelung" SWORD InjMass 1 100 -327.6800 327.6700 FORMAT "%8.4" ECU_ADDRESS 0xD0006B72 /end MEASUREMENT
/begin MEASUREMENT AirCtl_qDesVal "Einspritzmenge für die Sollwertbildung der Abgasrückführregelung" SWORD InjMass 1 100 -327.6800 327.6700 FORMAT "%8.4" ECU_ADDRESS 0xD0006B78 /end MEASUREMENT
/begin MEASUREMENT AirCtl_qDesValInl_mp "Einspritzmenge für die Sollwertbildung der Abgasrückführregelung" SWORD InjMass 1 100 -327.6800 327.6700 FORMAT "%8.4" ECU_ADDRESS 0xC0000120 /end MEASUREMENT
/begin MEASUREMENT AirCtl_qDesVal_mp "Einspritzmenge für die Sollwertbildung der Abgasrückführregelung" SWORD InjMass 1 100 -327.6800 327.6700 FORMAT "%8.4" ECU_ADDRESS 0xC00000C2 /end MEASUREMENT
/begin MEASUREMENT AirCtl_qGov "Einspritzmenge für den Regler der Abgasrückführregelung" SWORD InjMass 1 100 -327.6800 327.6700 FORMAT "%8.4" ECU_ADDRESS 0xD0006B7E /end MEASUREMENT
/begin MEASUREMENT AirCtl_qGov_mp "Einspritzmenge für den Regler der Abgasrückführregelung" SWORD InjMass 1 100 -327.6800 327.6700 FORMAT "%8.4" ECU_ADDRESS 0xC0000150 /end MEASUREMENT
/begin MEASUREMENT AirCtl_qHi_mp "Obere Grenze für zu hohe Einspritzmenge" SWORD InjMass 1 100 -327.6800 327.6700 FORMAT "%8.4" ECU_ADDRESS 0xC000019C /end MEASUREMENT
/begin MEASUREMENT AirCtl_qLo_mp "Untere Grenze für zu hohe Einspritzmenge" SWORD InjMass 1 100 -327.6800 327.6700 FORMAT "%8.4" ECU_ADDRESS 0xC000019E /end MEASUREMENT
/begin MEASUREMENT AirCtl_qMon "Einspritzmenge für die Überwachung der Abgasrückführregelung" SWORD InjMass 1 100 -327.6800 327.6700 FORMAT "%8.4" ECU_ADDRESS 0xD0006B84 /end MEASUREMENT
/begin MEASUREMENT AirCtl_qSurgeHigh_mp "" SWORD InjMass 1 100 -327.6800 327.6700 FORMAT "%8.4" ECU_ADDRESS 0xC00001AA /end MEASUREMENT
/begin MEASUREMENT AirCtl_qSurgeLow_mp "" SWORD InjMass 1 100 -327.6800 327.6700 FORMAT "%8.4" ECU_ADDRESS 0xC00001AC /end MEASUREMENT
/begin MEASUREMENT AirCtl_rCtlVal "Steueranteil der Abgasrückführregelung" SWORD Prc 1 100 -400.0000 399.9878 FORMAT "%8.4" ECU_ADDRESS 0xD0006B8A /end MEASUREMENT
/begin MEASUREMENT AirCtl_rEGREOMNrm_mp "Reglerstellgröße für das Abgasrückführventil im Übergang von Normal- nach Regenerationsbetrieb" SWORD Prc 1 100 -400.0000 399.9878 FORMAT "%8.4" ECU_ADDRESS 0xC000017C /end MEASUREMENT
/begin MEASUREMENT AirCtl_rEGREOM_mp "Reglerstellgröße für das Abgasrückführventil im Regenerationsbetrieb" SWORD Prc 1 100 -400.0000 399.9878 FORMAT "%8.4" ECU_ADDRESS 0xC000017E /end MEASUREMENT
/begin MEASUREMENT AirCtl_rEGRInv_mp "invertierte Reglerstellgröße für das Abgasrückführventil" SWORD Prc 1 100 -400.0000 399.9878 FORMAT "%8.4" ECU_ADDRESS 0xC0000176 /end MEASUREMENT
/begin MEASUREMENT AirCtl_rEGRNrmEOM_mp "Reglerstellgröße für das Abgasrückführventil im Übergang von Regeneration zum Normalbetrieb" SWORD Prc 1 100 -400.0000 399.9878 FORMAT "%8.4" ECU_ADDRESS 0xC0000180 /end MEASUREMENT
/begin MEASUREMENT AirCtl_rEGR_mp "Reglerstellgröße für das Abgasrückführventil" SWORD Prc 1 100 -400.0000 399.9878 FORMAT "%8.4" ECU_ADDRESS 0xC0000152 /end MEASUREMENT
/begin MEASUREMENT AirCtl_rEOMBgnInit_mp "Reglerstellgröße für das Abgasrückführventil zu Beginn des Übergangs von Normalbetrieb nach Regenerationsbetrieb" SWORD Prc 1 100 -400.0000 399.9878 FORMAT "%8.4" ECU_ADDRESS 0xC0000178 /end MEASUREMENT
/begin MEASUREMENT AirCtl_rEOMEndInit_mp "Reglerstellgröße für das Abgasrückführventil am Ende der Initialisierung" SWORD Prc 1 100 -400.0000 399.9878 FORMAT "%8.4" ECU_ADDRESS 0xC000017A /end MEASUREMENT
/begin MEASUREMENT AirCtl_rGovDvtNrm "Normierte Regelabweichung" SWORD Prc 1 100 -400.0000 399.9878 FORMAT "%8.4" ECU_ADDRESS 0xD0006B90 /end MEASUREMENT
/begin MEASUREMENT AirCtl_rGovEGR "Sollposition des Abgasrückführventils aus der Abgasrückführregelung" SWORD Prc 1 100 -400.0000 399.9878 FORMAT "%8.4" ECU_ADDRESS 0xD0006B96 /end MEASUREMENT
/begin MEASUREMENT AirCtl_rGovEGRNrm_mp "Reglerstellgröße für das Abgasrückführventil im Normalbetrieb" SWORD Prc 1 100 -400.0000 399.9878 FORMAT "%8.4" ECU_ADDRESS 0xC0000154 /end MEASUREMENT
/begin MEASUREMENT AirCtl_rGovEGR_mp "Sollposition des Abgasrückführventils aus der Abgasrückführregelung" SWORD Prc 1 100 -400.0000 399.9878 FORMAT "%8.4" ECU_ADDRESS 0xC0000174 /end MEASUREMENT
/begin MEASUREMENT AirCtl_rGovOutUnLimCor_mp "Unbegrenzte korrigierte Stellgröße der Abgasrückführregelung" SWORD Prc 1 100 -400.0000 399.9878 FORMAT "%8.4" ECU_ADDRESS 0xC0000156 /end MEASUREMENT
/begin MEASUREMENT AirCtl_rGovOutUnLim_mp "Unbegrenzt Stellgröße der Abgasrückführregelung" SWORD Prc 1 100 -400.0000 399.9878 FORMAT "%8.4" ECU_ADDRESS 0xC0000158 /end MEASUREMENT
/begin MEASUREMENT AirCtl_rGovOut_mp "Begrenzte Stellgröße des Abgasrückführreglers" SWORD Prc 1 100 -400.0000 399.9878 FORMAT "%8.4" ECU_ADDRESS 0xC000015A /end MEASUREMENT
/begin MEASUREMENT AirCtl_rGovTVA "Sollposition der Drosselklappe aus der Abgasrückführregelung" SWORD Prc 1 100 -400.0000 399.9878 FORMAT "%8.4" ECU_ADDRESS 0xD0006B9C /end MEASUREMENT
/begin MEASUREMENT AirCtl_rGovTVANrm_mp "Reglerstellgröße für die Drosselklappe im Normalbetrieb im Normalbetrieb" SWORD Prc 1 100 -400.0000 399.9878 FORMAT "%8.4" ECU_ADDRESS 0xC000015C /end MEASUREMENT
/begin MEASUREMENT AirCtl_rOutD_mp "dynamischer Steueranteil der Abgasrückführregelung" SWORD Prc 1 100 -400.0000 399.9878 FORMAT "%8.4" ECU_ADDRESS 0xC000015E /end MEASUREMENT
/begin MEASUREMENT AirCtl_rOutI_mp "I-Anteil des Abgasrückführreglers" SWORD Prc 1 100 -400.0000 399.9878 FORMAT "%8.4" ECU_ADDRESS 0xC0000160 /end MEASUREMENT
/begin MEASUREMENT AirCtl_rOutP_mp "P-Anteil des Abgasrückführreglers" SWORD Prc 1 100 -400.0000 399.9878 FORMAT "%8.4" ECU_ADDRESS 0xC0000162 /end MEASUREMENT
/begin MEASUREMENT AirCtl_rPIDCtl_mp "Summe aus Regler- und Steueranteil der Abgasrückführregelung" SWORD Prc 1 100 -400.0000 399.9878 FORMAT "%8.4" ECU_ADDRESS 0xC0000164 /end MEASUREMENT
/begin MEASUREMENT AirCtl_rSurgeHigh_mp "" SWORD Prc 1 100 -400.0000 399.9878 FORMAT "%8.4" ECU_ADDRESS 0xC00001AE /end MEASUREMENT
/begin MEASUREMENT AirCtl_rSurgeLow_mp "" SWORD Prc 1 100 -400.0000 399.9878 FORMAT "%8.4" ECU_ADDRESS 0xC00001B0 /end MEASUREMENT
/begin MEASUREMENT AirCtl_rSurgeOfs_mp "" SWORD Prc 1 100 -400.0000 399.9878 FORMAT "%8.4" ECU_ADDRESS 0xC00001B2 /end MEASUREMENT
/begin MEASUREMENT AirCtl_rTVAEOM_mp "Stellgröße des Reglers für die Drosselklappe im Regenerationsbetrieb" SWORD Prc 1 100 -400.0000 399.9878 FORMAT "%8.4" ECU_ADDRESS 0xC0000182 /end MEASUREMENT
/begin MEASUREMENT AirCtl_rTVA_mp "Reglerstellgröße für die Drosselklappe" SWORD Prc 1 100 -400.0000 399.9878 FORMAT "%8.4" ECU_ADDRESS 0xC0000166 /end MEASUREMENT
/begin MEASUREMENT AirCtl_stAirCtlBits_mp "Anzeige der Abschaltursache in der ARF-Überwachung (bitorientiert)" ULONG OneToOne 1 100 0.00 4294967295.00 FORMAT "%13.2" ECU_ADDRESS 0xC0000184 /end MEASUREMENT
/begin MEASUREMENT AirCtl_stBitMskEOM_mp "" ULONG OneToOne 1 100 0.00 4294967295.00 FORMAT "%13.2" ECU_ADDRESS 0xC00001B8 /end MEASUREMENT
/begin MEASUREMENT AirCtl_stDebDef_mp "Status, ob auf bleibende Regelabweichung überwacht wird" UBYTE OneToOne 1 100 0.00 255.0 FORMAT "%5.1" ECU_ADDRESS 0xC000018C /end MEASUREMENT
/begin MEASUREMENT AirCtl_stDesChk_mp "Status der Überprüfung des Luftmassensollwerts" UBYTE OneToOne 1 100 0.00 255.0 FORMAT "%5.1" ECU_ADDRESS 0xC000018D /end MEASUREMENT
/begin MEASUREMENT AirCtl_stDesEOM "Status der Regenerationsanforderung" UBYTE OneToOne 1 100 0.00 255.0 FORMAT "%5.1" ECU_ADDRESS 0xD0008F09 /end MEASUREMENT
/begin MEASUREMENT AirCtl_stEOMDesVal_mp "Status über den Wechsel in eine andere Betriebsart" ULONG OneToOne 1 100 0.00 4294967295.00 FORMAT "%13.2" ECU_ADDRESS 0xC00000D0 /end MEASUREMENT
/begin MEASUREMENT AirCtl_stEOMMon "Status der Betriebsartenüberwachung" ULONG OneToOne 1 100 0.00 4294967295.00 FORMAT "%13.2" ECU_ADDRESS 0xD0004408 /end MEASUREMENT
/begin MEASUREMENT AirCtl_stGov "Statusbitleiste für Zustand des Luftmassenreglers" UBYTE OneToOne 1 100 0.00 255.0 FORMAT "%5.1" ECU_ADDRESS 0xD0008F0C /end MEASUREMENT
/begin MEASUREMENT AirCtl_stHealDef_mp "Status, ob Heilung von erkannter bleibenden Regelabweichung zulässig" UBYTE OneToOne 1 100 0.00 255.0 FORMAT "%5.1" ECU_ADDRESS 0xC000018E /end MEASUREMENT
/begin MEASUREMENT AirCtl_stMaxDvt_mp "Status, ob die obere Grenze für die Erkennung einer bleibenden Regelabweichung überschritten" UBYTE OneToOne 1 100 0.00 255.0 FORMAT "%5.1" ECU_ADDRESS 0xC000018F /end MEASUREMENT
/begin MEASUREMENT AirCtl_stMinDvt_mp "Status, ob untere Grenze für die Erkennung einer bleibenden Regelabweichung unterschritten" UBYTE OneToOne 1 100 0.00 255.0 FORMAT "%5.1" ECU_ADDRESS 0xC0000190 /end MEASUREMENT
/begin MEASUREMENT AirCtl_stMon "Priorisierter Abschaltfall der Überwachung" UBYTE OneToOne 1 100 0.00 255.0 FORMAT "%5.1" ECU_ADDRESS 0xD0008F0F /end MEASUREMENT
/begin MEASUREMENT AirCtl_stMonBits_mp "Selektierte Abschaltfälle" ULONG OneToOne 1 100 0.00 4294967295.00 FORMAT "%13.2" ECU_ADDRESS 0xC0000194 /end MEASUREMENT
/begin MEASUREMENT AirCtl_stSelBitMskEOM_mp "" ULONG OneToOne 1 100 0.00 4294967295.00 FORMAT "%13.2" ECU_ADDRESS 0xC00001BC /end MEASUREMENT
/begin MEASUREMENT AirCtl_swtAirTempCor "Schalter für add./mult. Lufttemperatur-Korrektur" UBYTE OneToOne 1 100 0.00 255.0 FORMAT "%5.1" ECU_ADDRESS 0xD0008F12 /end MEASUREMENT
/begin MEASUREMENT AirCtl_swtGov "Schalter: Regler ein/aus" UBYTE OneToOne 1 100 0.00 255.0 FORMAT "%5.1" ECU_ADDRESS 0xD0008F13 /end MEASUREMENT
/begin MEASUREMENT AirCtl_swtGovEna "Schalter für Luftmassenregelung" UBYTE OneToOne 1 100 0.00 255.0 FORMAT "%5.1" ECU_ADDRESS 0xD0008F14 /end MEASUREMENT
/begin MEASUREMENT AirCtl_swtTrm "Schalter für add. / mult. Abgleichkorrektur" UBYTE OneToOne 1 100 0.00 255.0 FORMAT "%5.1" ECU_ADDRESS 0xD0008F15 /end MEASUREMENT
/begin MEASUREMENT AirCtl_tAirDesVal_mp "Ausgewählte Lufttemperatur für die Sollwertbildung" SWORD Temp_Cels 1 100 -3549.940 3003.560 FORMAT "%8.3" ECU_ADDRESS 0xC00000C4 /end MEASUREMENT
/begin MEASUREMENT AirCtl_tAirGov_mp "Ausgewälte Lufttemperatur für die Abgasrückführregelung" SWORD Temp_Cels 1 100 -3549.940 3003.560 FORMAT "%8.3" ECU_ADDRESS 0xC0000168 /end MEASUREMENT
/begin MEASUREMENT AirCtl_tAirMon_mp "Ausgewählte Temperatur aus dem temperaturfeld des Ansaugtrakts für die Überwachung" SWORD Temp_Cels 1 100 -3549.940 3003.560 FORMAT "%8.3" ECU_ADDRESS 0xC0000198 /end MEASUREMENT
/begin MEASUREMENT AirCtl_tEngDesVal_mp "Ausgewählte Motortemperatur für die Sollwertbildung" SWORD Temp_Cels 1 100 -3549.940 3003.560 FORMAT "%8.3" ECU_ADDRESS 0xC00000C6 /end MEASUREMENT
/begin MEASUREMENT AirCtl_tEngMon_mp "Ausgewählte Temperatur aus dem Motortemperaturfeld für die Überwachung" SWORD Temp_Cels 1 100 -3549.940 3003.560 FORMAT "%8.3" ECU_ADDRESS 0xC0000188 /end MEASUREMENT
/begin MEASUREMENT AirCtl_tiCldStrt_mp "Zeit, in der die Regelung nach Startabwurf abgeschaltet bleibt" UWORD Time_ms 1 100 0.00 655350.0 FORMAT "%8.1" ECU_ADDRESS 0xC000019A /end MEASUREMENT
/begin MEASUREMENT AirCtl_tiMonEOM_mp "" SWORD TimeDeb 1 100 -327680.0 327670.0 FORMAT "%8.1" ECU_ADDRESS 0xC00001C0 /end MEASUREMENT
/begin MEASUREMENT AirCtl_TrmBas_mp "" SLONG AirMassPerCyl 1 100 -214748364.800 214748364.700 FORMAT "%13.3" ECU_ADDRESS 0xC00000C8 /end MEASUREMENT
/begin MEASUREMENT AirCtl_TrmRgn_mp "" SWORD AirMassPerCyl 1 100 -3276.800 3276.700 FORMAT "%8.3" ECU_ADDRESS 0xC0000142 /end MEASUREMENT
/begin MEASUREMENT AirCtl_TrmValCust_mp "" SWORD AirMassPerCyl 1 100 -3276.800 3276.700 FORMAT "%8.3" ECU_ADDRESS 0xC0000144 /end MEASUREMENT
/begin MEASUREMENT AirCtl_TrmVal_mp "Abgleichwert des Luftmassensollwerts" SWORD AirMassPerCyl 1 100 -3276.800 3276.700 FORMAT "%8.3" ECU_ADDRESS 0xC00000CC /end MEASUREMENT
/begin MEASUREMENT AirCtl_trqCtlVal "inneres Drehmoment für die Steuerung der Abgasrückführregelung" SWORD Trq 1 100 -3276.800 3276.700 FORMAT "%8.3" ECU_ADDRESS 0xD0006BA2 /end MEASUREMENT
/begin MEASUREMENT AirCtl_trqDesVal "" SWORD Trq 1 100 -3276.800 3276.700 FORMAT "%8.3" ECU_ADDRESS 0xD0006BA4 /end MEASUREMENT
/begin MEASUREMENT AirCtl_trqDesValInl_mp "inneres Drehmoment für die Sollwertbildung der Abgasrückführregelung" SWORD Trq 1 100 -3276.800 3276.700 FORMAT "%8.3" ECU_ADDRESS 0xC0000122 /end MEASUREMENT
/begin MEASUREMENT AirCtl_trqGov "inneres Drehmoment für die Abgasrückführregelung" SWORD Trq 1 100 -3276.800 3276.700 FORMAT "%8.3" ECU_ADDRESS 0xD0006BA6 /end MEASUREMENT
/begin MEASUREMENT AirCtl_trqHi_mp "obere Grenze des inneren Drehmoments" SWORD Trq 1 100 -3276.800 3276.700 FORMAT "%8.3" ECU_ADDRESS 0xC00001A0 /end MEASUREMENT
/begin MEASUREMENT AirCtl_trqLo_mp "untere Grenze des inneren Drehmoments" SWORD Trq 1 100 -3276.800 3276.700 FORMAT "%8.3" ECU_ADDRESS 0xC00001A2 /end MEASUREMENT
/begin MEASUREMENT AirCtl_trqMon "inneres Drehmoment für die Überwachung der Abgasrückführregelung" SWORD Trq 1 100 -3276.800 3276.700 FORMAT "%8.3" ECU_ADDRESS 0xD0006BA8 /end MEASUREMENT
/begin MEASUREMENT AirC_trqDes "" SWORD Trq 1 100 -3276.800 3276.700 FORMAT "%8.3" ECU_ADDRESS 0xD0006B48 /end MEASUREMENT
/begin MEASUREMENT AirSys_tFld "Temperaturfeld Ansaugtrakt" SWORD Temp_Cels 1 100 -3549.940 3003.560 FORMAT "%8.3" ARRAY_SIZE 3 ECU_ADDRESS 0xD0006BB6 /end MEASUREMENT
/begin MEASUREMENT Air_rRawTAFS "" SWORD DtyCyc 1 100 -327.6800 327.6700 FORMAT "%8.4" ECU_ADDRESS 0xD0006BD4 /end MEASUREMENT
/begin MEASUREMENT Air_tAFS "" SWORD Temp_Cels 1 100 -3549.940 3003.560 FORMAT "%8.3" ECU_ADDRESS 0xD0006BD6 /end MEASUREMENT
/begin MEASUREMENT Air_tiRawTAFS "" SLONG Time_Period_HFM6 1 100 -107374.182400 107374.182350 FORMAT "%13.6" ECU_ADDRESS 0xD00042D0 /end MEASUREMENT
/begin MEASUREMENT Air_tSensTAFS "" SWORD Temp_Cels 1 100 -3549.940 3003.560 FORMAT "%8.3" ECU_ADDRESS 0xD0006BE2 /end MEASUREMENT
/begin MEASUREMENT AltIO_rAltLoad "" SWORD DtyCyc 1 100 -327.6800 327.6700 FORMAT "%8.4" ECU_ADDRESS 0xD0006BEC /end MEASUREMENT
/begin MEASUREMENT AltIO_stErrAlt "" UBYTE OneToOne 1 100 0.00 255.0 FORMAT "%5.1" ECU_ADDRESS 0xD0008F1A /end MEASUREMENT
/begin MEASUREMENT AltIO_stGenManuFak "" UBYTE OneToOne 1 100 0.00 255.0 FORMAT "%5.1" ECU_ADDRESS 0xD0008F1B /end MEASUREMENT
/begin MEASUREMENT AltIO_stGenTypKenn "" UBYTE OneToOne 1 100 0.00 255.0 FORMAT "%5.1" ECU_ADDRESS 0xD0008F1C /end MEASUREMENT
/begin MEASUREMENT AltIO_tiLRAlt "" SWORD Time_s 1 100 -327.6800 327.6700 FORMAT "%8.4" ECU_ADDRESS 0xD0006BEE /end MEASUREMENT
/begin MEASUREMENT AltIO_uAltDes "" SWORD Volt_Batt 1 100 -655360.0 655340.0 FORMAT "%8.1" ECU_ADDRESS 0xD0006BF2 /end MEASUREMENT
/begin MEASUREMENT Alt_trqCor_mp "" SWORD Trq 1 100 -3276.800 3276.700 FORMAT "%8.3" ECU_ADDRESS 0xC00001CA /end MEASUREMENT
/begin MEASUREMENT Alt_trqDes "" SWORD Trq 1 100 -3276.800 3276.700 FORMAT "%8.3" ECU_ADDRESS 0xD0006BF4 /end MEASUREMENT
/begin MEASUREMENT Alt_trqFlt_mp "" SWORD Trq 1 100 -3276.800 3276.700 FORMAT "%8.3" ECU_ADDRESS 0xC00001CC /end MEASUREMENT
/begin MEASUREMENT Alt_trqResv "" SWORD Trq 1 100 -3276.800 3276.700 FORMAT "%8.3" ECU_ADDRESS 0xD0006BF6 /end MEASUREMENT
/begin MEASUREMENT APP_drUnFlt "" SWORD PrcPerSec 1 100 -20000.00 19999.39 FORMAT "%8.2" ECU_ADDRESS 0xD0006994 /end MEASUREMENT
/begin MEASUREMENT APP_r "" SWORD Prc 1 100 -400.0000 399.9878 FORMAT "%8.4" ECU_ADDRESS 0xD0006996 /end MEASUREMENT
/begin MEASUREMENT APP_rFltUnLim_mp "Gefilterter Wert von APP ohne Step limitation" SWORD Prc 1 100 -400.0000 399.9878 FORMAT "%8.4" ECU_ADDRESS 0xC00001E0 /end MEASUREMENT
/begin MEASUREMENT APP_rFlt_mp "" SWORD Prc 1 100 -400.0000 399.9878 FORMAT "%8.4" ECU_ADDRESS 0xC00001E2 /end MEASUREMENT
/begin MEASUREMENT APP_rNextThres_mp "Berechneter Wert des nächsten Schwellwertes" SWORD Prc 1 100 -400.0000 399.9878 FORMAT "%8.4" ECU_ADDRESS 0xC00001E4 /end MEASUREMENT
/begin MEASUREMENT APP_rPlaMaxVal_mp "Maximaler APP Wert, als Glaubwürdigkeit mit Bremse ausfiel" SWORD Prc 1 100 -400.0000 399.9878 FORMAT "%8.4" ECU_ADDRESS 0xC00001CE /end MEASUREMENT
/begin MEASUREMENT APP_rPla_mp "" SWORD Prc 1 100 -400.0000 399.9878 FORMAT "%8.4" ECU_ADDRESS 0xC00001D0 /end MEASUREMENT
/begin MEASUREMENT APP_rStepLim_mp "" SWORD Prc 1 100 -400.0000 399.9878 FORMAT "%8.4" ECU_ADDRESS 0xC00001E6 /end MEASUREMENT
/begin MEASUREMENT APP_rUnFlt "" SWORD Prc 1 100 -400.0000 399.9878 FORMAT "%8.4" ECU_ADDRESS 0xD0006998 /end MEASUREMENT
/begin MEASUREMENT APP_rUnLim_mp "" SWORD Prc 1 100 -400.0000 399.9878 FORMAT "%8.4" ECU_ADDRESS 0xC00001D2 /end MEASUREMENT
/begin MEASUREMENT APP_stAlive_mp "" UBYTE OneToOne 1 100 0.00 255.0 FORMAT "%5.1" ECU_ADDRESS 0xC00001D4 /end MEASUREMENT
/begin MEASUREMENT APP_stKD "" UBYTE OneToOne 1 100 0.00 255.0 FORMAT "%5.1" ECU_ADDRESS 0xD0009225 /end MEASUREMENT
/begin MEASUREMENT APP_stPlaBrk "" UBYTE OneToOne 1 100 0.00 255.0 FORMAT "%5.1" ECU_ADDRESS 0xD0009226 /end MEASUREMENT
/begin MEASUREMENT APP_stPlaBrkDet_mp "" UBYTE OneToOne 1 100 0.00 255.0 FORMAT "%5.1" ECU_ADDRESS 0xC00001DC /end MEASUREMENT
/begin MEASUREMENT APP_stPlaBrkPres "Status, ob die Bremsdruckglaubwürdigkeit aktiv ist" UBYTE OneToOne 1 100 0.00 255.0 FORMAT "%5.1" ECU_ADDRESS 0xD0009227 /end MEASUREMENT
/begin MEASUREMENT APP_stPlaBrkRst_mp "" UBYTE OneToOne 1 100 0.00 255.0 FORMAT "%5.1" ECU_ADDRESS 0xC00001DD /end MEASUREMENT
/begin MEASUREMENT APP_stPos_mp "Status der PWG Position" UBYTE OneToOne 1 100 0.00 255.0 FORMAT "%5.1" ECU_ADDRESS 0xC00001E8 /end MEASUREMENT
/begin MEASUREMENT APP_stSigSrc "" UBYTE OneToOne 1 100 0.00 255.0 FORMAT "%5.1" ECU_ADDRESS 0xD0008EFC /end MEASUREMENT
/begin MEASUREMENT APP_stTempErr_mp "" UBYTE OneToOne 1 100 0.00 255.0 FORMAT "%5.1" ECU_ADDRESS 0xC00001DE /end MEASUREMENT
/begin MEASUREMENT APP_uDiffMax_mp "" SWORD Volt 1 100 -6553.600 6553.400 FORMAT "%8.3" ECU_ADDRESS 0xC00001D6 /end MEASUREMENT
/begin MEASUREMENT APP_uDiff_mp "" SWORD Volt 1 100 -6553.600 6553.400 FORMAT "%8.3" ECU_ADDRESS 0xC00001D8 /end MEASUREMENT
/begin MEASUREMENT APP_uMin12half_mp "" SWORD Volt 1 100 -6553.600 6553.400 FORMAT "%8.3" ECU_ADDRESS 0xC00001DA /end MEASUREMENT
/begin MEASUREMENT APP_uRaw1 "" SWORD Volt 1 100 -6553.600 6553.400 FORMAT "%8.3" ECU_ADDRESS 0xD000699A /end MEASUREMENT
/begin MEASUREMENT APP_uRaw1unLim_mp "" SWORD Volt 1 100 -6553.600 6553.400 FORMAT "%8.3" ECU_ADDRESS 0xC00001EA /end MEASUREMENT
/begin MEASUREMENT APP_uRaw2 "" SWORD Volt 1 100 -6553.600 6553.400 FORMAT "%8.3" ECU_ADDRESS 0xD000699C /end MEASUREMENT
/begin MEASUREMENT APP_uRaw2unLim_mp "" SWORD Volt 1 100 -6553.600 6553.400 FORMAT "%8.3" ECU_ADDRESS 0xC00001EC /end MEASUREMENT
/begin MEASUREMENT APP_uRaw_mp "" SWORD Volt 1 100 -6553.600 6553.400 FORMAT "%8.3" ECU_ADDRESS 0xC00001EE /end MEASUREMENT
/begin MEASUREMENT APP_uUnJit_mp "" SWORD Volt 1 100 -6553.600 6553.400 FORMAT "%8.3" ECU_ADDRESS 0xC00001F0 /end MEASUREMENT
/begin MEASUREMENT ASDdc_KdGovCurr_mp "Aktueller Parameter Kd des ASD Störungsreglers" FLOAT32_IEEE ASDdc_GovDT1Kd_float 1 100 -1.00000000 100.000000 FORMAT "%10.6" ECU_ADDRESS 0xC00001F4 /end MEASUREMENT
/begin MEASUREMENT ASDdc_nEngParSel_mp "Motordrehzahl für die Parametersatzauswahl beim ASD Störungsregler" SWORD EngN 1 100 -16384.00 16383.50 FORMAT "%8.2" ECU_ADDRESS 0xC0000204 /end MEASUREMENT
/begin MEASUREMENT ASDdc_stClthParSet_mp "Kupplungsparametersatz aktiv/inaktiv (aktiv = TRUE)" UBYTE OneToOne 1 100 0.00 255.0 FORMAT "%5.1" ECU_ADDRESS 0xC0000206 /end MEASUREMENT
/begin MEASUREMENT ASDdc_stCon_mp "Zustand der Eingangsbedingungen (bitkodiert)" UWORD OneToOne 1 100 0.00 65535.00 FORMAT "%8.2" ECU_ADDRESS 0xC0000208 /end MEASUREMENT
/begin MEASUREMENT ASDdc_stPrioSt_mp "Aktiver Zustand nach der Priorisierung (dezimal kodiert)" UWORD OneToOne 1 100 0.00 65535.00 FORMAT "%8.2" ECU_ADDRESS 0xC000020A /end MEASUREMENT
/begin MEASUREMENT ASDdc_stReIni_mp "Deaktivierung (Initialisierung) des Störungsreglers (inaktiv = TRUE)" UBYTE OneToOne 1 100 0.00 255.0 FORMAT "%5.1" ECU_ADDRESS 0xC00001F8 /end MEASUREMENT
/begin MEASUREMENT ASDdc_stSelSt_mp "Ausgewählter Primärzustand (dezimal kodiert)" UWORD OneToOne 1 100 0.00 65535.00 FORMAT "%8.2" ECU_ADDRESS 0xC000020C /end MEASUREMENT
/begin MEASUREMENT ASDdc_stVldSt_mp "Auswertung der Primärzustände; konkurrierende Zustände möglich (bitkodiert)" UWORD OneToOne 1 100 0.00 65535.00 FORMAT "%8.2" ECU_ADDRESS 0xC000020E /end MEASUREMENT
/begin MEASUREMENT ASDdc_T1GovCurr_mp "Aktueller Parameter T1 des ASD Störungsreglers" FLOAT32_IEEE ASDdc_GovDT1T1_float 1 100 -1.00000000 100.000000 FORMAT "%10.6" ECU_ADDRESS 0xC00001FC /end MEASUREMENT
/begin MEASUREMENT ASDdc_trq "ASD Störungsregler Ausgangsmoment" SWORD Trq 1 100 -3276.800 3276.700 FORMAT "%8.3" ECU_ADDRESS 0xD00069A0 /end MEASUREMENT
/begin MEASUREMENT ASDdc_trqUnLtd_mp "ASD Störungsregler Momentforderung vor der Limitierung" FLOAT32_IEEE Trq_float 1 100 -50.0000000 50.0000000 FORMAT "%10.7" ECU_ADDRESS 0xC0000200 /end MEASUREMENT
/begin MEASUREMENT Com_bRecHeatAC "" UBYTE OneToOne 1 100 0.00 255.0 FORMAT "%5.1" ECU_ADDRESS 0xD0008F72 /end MEASUREMENT
/begin MEASUREMENT Com_facTrqAC_mp "" SWORD Fact100 1 100 -327.6800 327.6700 FORMAT "%8.4" ECU_ADDRESS 0xC0000096 /end MEASUREMENT
/begin MEASUREMENT Com_rHtFlowReq "" SWORD Prc 1 100 -400.0000 399.9878 FORMAT "%8.4" ECU_ADDRESS 0xD0006CFC /end MEASUREMENT
/begin MEASUREMENT Com_stAC "Übersicht Klimazustände" UBYTE OneToOne 1 100 0.00 255.0 FORMAT "%5.1" ECU_ADDRESS 0xD0008F7D /end MEASUREMENT
/begin MEASUREMENT Com_stACnMin "" UBYTE OneToOne 1 100 0.00 255.0 FORMAT "%5.1" ECU_ADDRESS 0xD0008F7E /end MEASUREMENT
/begin MEASUREMENT Com_swtAC "" UBYTE OneToOne 1 100 0.00 255.0 FORMAT "%5.1" ECU_ADDRESS 0xD0008FAE /end MEASUREMENT
/begin MEASUREMENT Com_trqAC "" SWORD Trq 1 100 -3276.800 3276.700 FORMAT "%8.3" ECU_ADDRESS 0xD0006D12 /end MEASUREMENT
/begin MEASUREMENT ESS_rLdAlt "" SWORD DtyCyc 1 100 -327.6800 327.6700 FORMAT "%8.4" ECU_ADDRESS 0xD0006DCA /end MEASUREMENT
/begin MEASUREMENT WaHtEl_r "" SWORD Prc 1 100 -400.0000 399.9878 FORMAT "%8.4" ECU_ADDRESS 0xD0007606 /end MEASUREMENT
/begin MEASUREMENT WaHtEl_rPs "" SWORD DtyCyc 1 100 -327.6800 327.6700 FORMAT "%8.4" ECU_ADDRESS 0xD0007608 /end MEASUREMENT
/begin MEASUREMENT WaHtEl_stErrMsg_mp "" UBYTE OneToOne 1 100 0.00 255.0 FORMAT "%5.1" ECU_ADDRESS 0xC0000040 /end MEASUREMENT
/begin MEASUREMENT WaHtEl_stRecg_mp "" UBYTE OneToOne 1 100 0.00 255.0 FORMAT "%5.1" ECU_ADDRESS 0xC0000041 /end MEASUREMENT
/begin FUNCTION AddHtr_DD ""
 /begin DEF_CHARACTERISTIC WaHtEl_4WinSigDur.tiErr1Min_C WaHtEl_4WinSigDur.tiErr1Max_C WaHtEl_4WinSigDur.tiErr2Min_C WaHtEl_4WinSigDur.tiErr2Max_C WaHtEl_4WinSigDur.tiErr3Min_C WaHtEl_4WinSigDur.tiErr3Max_C WaHtEl_4WinSigDur.tiErr4Min_C WaHtEl_4WinSigDur.tiErr4Max_C WaHtEl_Pwm.tiPer_C WaHtEl_Pwm.stLvl_C WaHtEl_Pwm.rMaxDty_C WaHtEl_Pwm.rPerUn_C WaHtEl_Pwm.tiPh_C WaHtEl_PwmOut.rMin_C WaHtEl_PwmOut.rMax_C WaHtEl_PwmOut.tiBtwTstSCB_C WaHtEl_PwmOut.tiBtwTstOT_C WaHtEl_PwmOut.numTstMax_C WaHtEl_PwmOut.swtBattCor_C WaHtEl_PwmOut.swtPsInv_C WaHtEl_rCnv_CUR WaHtEl_rPsDisbl_C WaHtEl_rPsRecg_C WaHtEl_stPsDiaDisbl_C WaHtEl_stPsDisbl_C WaHtEl_tiDebHtRecg_C WaHtEl_typ4WinDia_C /end DEF_CHARACTERISTIC
 /begin IN_MEASUREMENT BattU_facCor DevLib_stPwrStgEnaCond /end IN_MEASUREMENT
 /begin OUT_MEASUREMENT WaHtEl_r WaHtEl_rPs /end OUT_MEASUREMENT
 /begin LOC_MEASUREMENT WaHtEl_stErrMsg_mp WaHtEl_stRecg_mp /end LOC_MEASUREMENT
/end FUNCTION
/begin FUNCTION afst_dd ""
 /begin DEF_CHARACTERISTIC Air_rDtyCycMaxTAFS_C Air_rDtyCycMinTAFS_C Air_tiRefSigPerMaxTAFS_C Air_tiRefSigPerMinTAFS_C Air_tTransfTAFS_CUR /end DEF_CHARACTERISTIC
 /begin OUT_MEASUREMENT Air_rRawTAFS Air_tiRawTAFS Air_tSensTAFS /end OUT_MEASUREMENT
/end FUNCTION
/begin FUNCTION afst_vd ""
 /begin DEF_CHARACTERISTIC Air_RmpSlpTAFS.Pos_C Air_RmpSlpTAFS.Neg_C Air_TransStgTAFS.Dfl_C Air_TransStgTAFS.stSensId_C /end DEF_CHARACTERISTIC
 /begin OUT_MEASUREMENT Air_tAFS /end OUT_MEASUREMENT
/end FUNCTION
/begin FUNCTION AFS_DD ""
 /begin DEF_CHARACTERISTIC AFS_dmTransf_CUR AFS_facPerCor_C AFS_nAvrgThrHiSRCLo_C AFS_nAvrgThrLoSRCLo_C AFS_qAirmThrSRCHiActv_CUR AFS_Swt.xVal_C AFS_Swt.xTyp_C AFS_swtOffTstSel_C AFS_swtOscSel_C AFS_tiCorSRCHi_C AFS_tiCorSRCLo_C AFS_tiDlyActvSRCHiAirm_C AFS_tiLPFiltPT1_C AFS_tiOffsDrftTstDly_C AFS_tiOffsDrftTstLim_C AFS_tiPerHFM6_C AFS_tiRawSRCHi_C AFS_tiRawSRCLo_C AFS_tiThrHiPlOffsDrft_C AFS_tiThrLoPlOffsDrft_C /end DEF_CHARACTERISTIC
 /begin IN_MEASUREMENT EpmCrS_numSeg EpmCrS_tiSeg Epm_nEng SyC_stSub /end IN_MEASUREMENT
 /begin OUT_MEASUREMENT AFS_dmSens AFS_stOffsTst AFS_swtActvAftRun AFS_tiRaw /end OUT_MEASUREMENT
 /begin LOC_MEASUREMENT AFS_qAirmThrSRCHiActv_mp AFS_stPlsOffsDrftTstActv_mp AFS_stSRCHiRls_mp AFS_stSRCHiTstRls_mp AFS_stSRCLoTstRls_mp AFS_tiCor_mp AFS_tiRawAvrg_mp /end LOC_MEASUREMENT
/end FUNCTION
/begin FUNCTION afs_vd ""
 /begin DEF_CHARACTERISTIC AFS_dmAirSubsVal_MAP AFS_dtAirThres_C AFS_facPlsCor_MAP AFS_facSwtOnCor_C AFS_HiBattDeb.tiHiLo_C AFS_HiBattDeb.tiLoHi_C AFS_HiTempDeb.tiHiLo_C AFS_HiTempDeb.tiLoHi_C AFS_LoBattDeb.tiHiLo_C AFS_LoBattDeb.tiLoHi_C AFS_LoTempDeb.tiHiLo_C AFS_LoTempDeb.tiLoHi_C AFS_nAvrgThrHiPlHi_C AFS_nAvrgThrHiPlLo_C AFS_nAvrgThrLoPlHi_C AFS_nAvrgThrLoPlLo_C AFS_pAirThrLo_C AFS_pBstThrHiPlHi_C AFS_pBstThrLoPlLo_C AFS_qRawThrHi_C AFS_rAirThrHiPlHi_C AFS_rAirThrLoPlLo_C AFS_rEGRPThrHi_C AFS_rSwirlThrHi_C AFS_rSwirlThrLo_C AFS_rTVAThrHi_C AFS_rTVAThrLo_C AFS_stInhRls_C AFS_tClntThrHi_C AFS_tClntThrLo_C AFS_tiDlyEGRPPlSetyDrft_C AFS_tiDlyStrPlSetyDrft_C AFS_tiDlySwtOnCor_C AFS_tTempHi_C AFS_tTempLo_C AFS_uBattMax_C AFS_uBattMin_C /end DEF_CHARACTERISTIC
 /begin IN_MEASUREMENT Air_dtTCACDs Air_pCACDs Air_pUnFltPCACDs ASMod_dmIndAirRef CEngDsT_t CoEng_stAftRun CoEng_stEng CoEng_tiNormal EGRVlv_r EnvP_p Epm_nEng Epm_numCyl InjCtl_qCurr InjCtl_qRaw ThrVlv_r VSwVlv_r /end IN_MEASUREMENT
 /begin OUT_MEASUREMENT AFS_dm AFS_mAirPerCyl AFS_mAirPerCylFlt AFS_stDrftMonRls /end OUT_MEASUREMENT
 /begin LOC_MEASUREMENT AFS_dmAirFrz_mp AFS_dmAirSubsVal_mp AFS_dmComp_mp AFS_dmPlsCorr_mp AFS_dmSensCorr_mp AFS_facPlsCor_mp AFS_facSwtOnCor_mp AFS_mAirPerCyl_mp AFS_rNorm_mp AFS_stDrftMonRls_mp AFS_stPlSetyDrftRls_mp AFS_stPlSetyDrft_mp AFS_stPlSetyRls_mp /end LOC_MEASUREMENT
/end FUNCTION
/begin FUNCTION afs_vddrftcomp ""
 /begin DEF_CHARACTERISTIC AFS_dmIdlAirMsLim_C AFS_dmLdAirMsLim_C AFS_dpLdAdjThresHi_C AFS_dqLdAdjThresHi_C AFS_drWtPenDetThresHi_C AFS_facCorExtpIdl_CUR AFS_facCorExtpLd_CUR AFS_facHiThresIdlAdjVal_C AFS_facHiThresLdAdjVal_C AFS_facIdlAdjValStepLim_C AFS_facLdAdjValStepLim_C AFS_facLoThresIdlAdjVal_C AFS_facLoThresLdAdjVal_C AFS_nAvrgIdlAdjThresHi_C AFS_nAvrgIdlAdjThresLo_C AFS_pBstAtmDiffLim_C AFS_pBstLdAdjThresHi_C AFS_pBstLdAdjThresLo_C AFS_qCurrIdlAdjThresHi_C AFS_qCurrIdlAdjThresLo_C AFS_qWinLdAdjThresHi_CUR AFS_qWinLdAdjThresLo_CUR AFS_swtActvEEPLoThres_C AFS_swtAirMsCorRls_C AFS_swtClrEEPAdjVal_C AFS_swtCurrAdjRls_C AFS_swtWtPenMon_C AFS_tAirAdjRlsThresHi_C AFS_tAirAdjRlsThresLo_C AFS_tEnvAdjRlsThresHi_C AFS_tEnvAdjRlsThresLo_C AFS_tiAdjRlsDel_C AFS_tiAirMsPT1_C AFS_tiBstPresPT1_C AFS_tiCorFacPT1_C AFS_tiIdlAdjRlsDeb.tiHiLo_C AFS_tiIdlAdjRlsDeb.tiLoHi_C AFS_tiLdAdjRlsDeb.tiHiLo_C AFS_tiLdAdjRlsDeb.tiLoHi_C AFS_tiQntCurrPT1_C AFS_tiStrtDelAdjRls_C AFS_tiWtPenDeb.tiHiLo_C AFS_tiWtPenDeb.tiLoHi_C AFS_tiWtPenDetPT1_C AFS_vVehLdAdjThresHi_C AFS_vVehLdAdjThresLo_C /end DEF_CHARACTERISTIC
 /begin IN_MEASUREMENT AFS_dmSens AFS_stDrftMonRls AirCtl_stMon Air_pUnFltPCACDs Air_tCACDs ASMod_dmIndAirRef CoEng_tiNormal EnvP_p EnvT_t Epm_nEng InjCtl_qCurr VehV_v /end IN_MEASUREMENT
 /begin OUT_MEASUREMENT AFS_dmAirMsFlt_mp AFS_dmDrft AFS_dmIdlAirMs_mp AFS_dmLdAirMs_mp AFS_dpIntValAbsFlt_mp AFS_dpIntValAbs_mp AFS_dqCurrAbsFlt_mp AFS_dqCurrAbs_mp AFS_drWtPenDetFlt_mp AFS_drWtPenDet_mp AFS_facCalcIdlAdjVal_mp AFS_facCalcLdAdjVal_mp AFS_facCalcValFlt_mp AFS_facCalcVal_mp AFS_facCorIdl_mp AFS_facCorIpo_mp AFS_facCorLd_mp AFS_facIdlAdjValUnLim_mp AFS_facIdlAdjVal_mp AFS_facLdAdjValUnLim_mp AFS_facLdAdjVal_mp AFS_qWinLdAdjThresHi_mp AFS_qWinLdAdjThresLo_mp AFS_stAdjRlsDel_mp AFS_stDrft AFS_stEnvCon_mp AFS_stIdlAdjRlsCon_mp AFS_stIpoRng_mp AFS_stLdAdjRlsCon_mp AFS_stRstLoDrftThres_mp AFS_stWtPenDetDeb_mp AFS_stWtPenDet_mp /end OUT_MEASUREMENT
/end FUNCTION
/begin FUNCTION AircECU_Can ""
 /begin DEF_CHARACTERISTIC Com_ctHeatACSelfRec_C Com_swtHeatAC_C Com_tiHeatACSelfRec_C /end DEF_CHARACTERISTIC
 /begin LOC_MEASUREMENT Com_bRecHeatAC /end LOC_MEASUREMENT
/end FUNCTION
/begin FUNCTION AircECU_co "" /begin DEF_CHARACTERISTIC Com_facTrqAC_MAP /end DEF_CHARACTERISTIC /begin IN_MEASUREMENT Epm_nEng /end IN_MEASUREMENT /begin OUT_MEASUREMENT Com_stAC /end OUT_MEASUREMENT
 /begin LOC_MEASUREMENT AirC_trqDes Com_facTrqAC_mp Com_rHtFlowReq Com_stACnMin Com_swtAC Com_trqAC /end LOC_MEASUREMENT
/end FUNCTION
/begin FUNCTION airctl_co ""
 /begin IN_MEASUREMENT InjCtl_qCurr InjCtl_qRaw PthLead_trqInrCurr PthLead_trqInrLead /end IN_MEASUREMENT
 /begin OUT_MEASUREMENT AirCtl_qCtlVal AirCtl_qDesVal AirCtl_qGov AirCtl_qMon AirCtl_trqCtlVal AirCtl_trqDesVal AirCtl_trqGov AirCtl_trqMon /end OUT_MEASUREMENT
/end FUNCTION
/begin FUNCTION airctl_ctlvalcalc "" /begin IN_MEASUREMENT AirCtl_qCtlVal AirCtl_trqCtlVal /end IN_MEASUREMENT /begin OUT_MEASUREMENT AirCtl_rCtlVal /end OUT_MEASUREMENT /end FUNCTION
/begin FUNCTION AirCtl_DesValCalc ""
 /begin DEF_CHARACTERISTIC AirCtl_AirTempCor.xVal_C AirCtl_AirTempCor.xTyp_C AirCtl_AirTempCorBas_MAP AirCtl_facAirTempCor_MAP AirCtl_facEngTempCor_MAP AirCtl_facEnvPresCor_CUR AirCtl_MaxTrmVal_C AirCtl_mDesBasHiAltd_MAP AirCtl_mDesBas_MAP AirCtl_mEngTempCorBas_MAP AirCtl_MinTrmVal_C AirCtl_mMaxDesVal_C AirCtl_mMinDesVal_C AirCtl_numAirTempDesVal_C AirCtl_numEngTempDesVal_C AirCtl_pBstPresRef_MAP AirCtl_swtBstPresCorVal_C AirCtl_TrimAdjMax_C AirCtl_TrimAdjMin_C AirCtl_Trm.xVal_C AirCtl_Trm.xTyp_C /end DEF_CHARACTERISTIC
 /begin IN_MEASUREMENT AirCtl_qDesVal AirCtl_trqDesVal AirSys_tFld Air_pCACDs EngDa_tFld EnvP_p Epm_nEng /end IN_MEASUREMENT
 /begin OUT_MEASUREMENT AirCtl_mDesBas AirCtl_mDesStat AirCtl_mDesVal AirCtl_swtAirTempCor AirCtl_swtTrm /end OUT_MEASUREMENT
 /begin LOC_MEASUREMENT AirCtl_AirTempCorBas_mp AirCtl_AirTempCor_mp AirCtl_facAirTempCor_mp AirCtl_facBstPresCor_mp AirCtl_facEngTempCor_mp AirCtl_facEnvPresCor_mp AirCtl_mDesBasHiAltd_mp AirCtl_mDesCor2_mp AirCtl_mDesCor_mp AirCtl_mDesDyn_mp AirCtl_mDesSum_mp AirCtl_mDesVal1Cor_mp AirCtl_mDesVal1_mp AirCtl_mDesVal2_mp AirCtl_mDesVal3_mp AirCtl_mDesVal4_mp AirCtl_mDesVal5_mp AirCtl_mDesValNrm_mp AirCtl_mEngTempCorBas_mp AirCtl_mEngTempCor_mp AirCtl_pBstPresRef_mp AirCtl_qDesVal_mp AirCtl_tAirDesVal_mp AirCtl_tEngDesVal_mp AirCtl_TrmBas_mp AirCtl_TrmVal_mp /end LOC_MEASUREMENT
/end FUNCTION
/begin FUNCTION airctl_desvalcalc_inl1 "" /begin DEF_CHARACTERISTIC AirCtl_facRmpValCor_CUR AirCtl_stDesValEOMMsk_CA /end DEF_CHARACTERISTIC /begin IN_MEASUREMENT CoEOM_facRmpVal CoEOM_stOpModeAct /end IN_MEASUREMENT /begin LOC_MEASUREMENT AirCtl_facRmpValCor_mp AirCtl_stEOMDesVal_mp /end LOC_MEASUREMENT /end FUNCTION
/begin FUNCTION AirCtl_DesValCalc_Inl2 ""
 /begin DEF_CHARACTERISTIC AirCtl_DKdmDes_C AirCtl_DKdNegMDes_CUR AirCtl_DKdPosMDes_CUR AirCtl_dmDWinNegDes_C AirCtl_dmDWinPosDes_C AirCtl_ParAdDT1.T1_C AirCtl_ParAdDT1.Kd_C AirCtl_tiDT1mDes_C /end DEF_CHARACTERISTIC
 /begin IN_MEASUREMENT AirCtl_qDesVal AirCtl_trqDesVal /end IN_MEASUREMENT
 /begin LOC_MEASUREMENT AirCtl_DKdmDes_mp AirCtl_DKdNegMDes_mp AirCtl_DKdPosMDes_mp AirCtl_dmDesCor_mp AirCtl_dmDWinNegDes_mp AirCtl_dmDWinPosDes_mp /end LOC_MEASUREMENT
/end FUNCTION
/begin FUNCTION AirCtl_DesValCalc_Inl3 ""
 /begin DEF_CHARACTERISTIC AirCtl_dmDesBas.Pos_C AirCtl_dmDesBas.Neg_C AirCtl_facAirTempCor2_CUR AirCtl_mAirTempCorBas2_MAP AirCtl_mDesBasDef_MAP AirCtl_mDesBasHiAltdDef_MAP AirCtl_mLiCor_C AirCtl_nLiEGR_C AirCtl_tiLiEGR_C /end DEF_CHARACTERISTIC
 /begin IN_MEASUREMENT AirCtl_qDesVal AirCtl_tEngDesVal_mp AirCtl_trqDesVal Epm_nEng /end IN_MEASUREMENT
 /begin LOC_MEASUREMENT AirCtl_facAirTempCor2_mp AirCtl_mAirTempCor2_mp AirCtl_mAirTempCorBas2_mp AirCtl_mDesBasDef_mp AirCtl_mDesBasHiAltdDef_mp AirCtl_mDesDef_mp /end LOC_MEASUREMENT
/end FUNCTION
/begin FUNCTION AirCtl_DesValCalc_Inl4 ""
 /begin DEF_CHARACTERISTIC AirCtl_mDesAddMax_C AirCtl_mDesAddMin_C AirCtl_mDesConvBas_C AirCtl_mDesGear_MAP AirCtl_mDesStrgCorr_MAP AirCtl_mPil2CorBas_C AirCtl_mskGear_C /end DEF_CHARACTERISTIC
 /begin IN_MEASUREMENT AirCtl_qDesVal AirCtl_trqDesVal Clth_st Epm_nEng InjCrv_stInjCharActVal PT_numTraGear StWhl_dphiAg StWhl_phiAg /end IN_MEASUREMENT
 /begin LOC_MEASUREMENT AirCtl_mDesAdd1_mp AirCtl_mDesAddBas_mp AirCtl_mDesAddUnLim_mp AirCtl_mDesAdd_mp AirCtl_mDesConvBas_mp AirCtl_mDesGearSwt_mp AirCtl_mDesGear_mp AirCtl_mDesPil2CorBas_mp AirCtl_mDesStrgCorrSwt_mp AirCtl_mDesStrgCorr_mp /end LOC_MEASUREMENT
 /begin SUB_FUNCTION AirCtl_DesValCalc /end SUB_FUNCTION
/end FUNCTION
/begin FUNCTION airctl_desvalcalc_inl5 ""
 /begin DEF_CHARACTERISTIC AirCtl_AirTempCorBasEOMQnt1_MAP AirCtl_facAirTempCorEOMQnt1_MAP AirCtl_facEngTempCorEOMQnt1_MAP AirCtl_facEnvPresCorEOMQnt1_CUR AirCtl_mDesBasEOMQnt1_MAP AirCtl_mDesBasHiAltdEOMQnt1_MAP AirCtl_mEngTempCorBasEOMQnt1_MAP /end DEF_CHARACTERISTIC
 /begin IN_MEASUREMENT AirCtl_qDesVal AirCtl_swtAirTempCor AirCtl_tAirDesVal_mp AirCtl_tEngDesVal_mp AirCtl_trqDesVal EnvP_p Epm_nEng ETCtl_mAirDesVal /end IN_MEASUREMENT
 /begin LOC_MEASUREMENT AirCtl_AirTempCorBasEOMQnt1_mp AirCtl_AirTempCorEOMQnt1_mp AirCtl_facAirTempCorEOMQnt1_mp AirCtl_facEngTempCorEOMQnt1_mp AirCtl_facEnvPresCorEOMQnt1_mp AirCtl_mDesBasEOMQnt1_mp AirCtl_mDesBasHiAltdEOMQnt1_mp AirCtl_mDesVal1EOMQnt1_mp AirCtl_mDesVal2EOMQnt1_mp AirCtl_mDesVal3EOMQnt1_mp AirCtl_mDesVal4EOMQnt1_mp AirCtl_mDesVal5CorEOMQnt1_mp AirCtl_mDesVal5EOMQnt1_mp AirCtl_mEngTempCorBasEOMQnt1_mp AirCtl_mEngTempCorEOMQnt1_mp AirCtl_qDesValInl_mp AirCtl_trqDesValInl_mp /end LOC_MEASUREMENT
/end FUNCTION
/begin FUNCTION AirCtl_DesValCalc_Inl6 ""
 /begin DEF_CHARACTERISTIC AirCtl_mDesAddEOMMax_C AirCtl_mDesAddEOMMin_C AirCtl_mDesConvEOM_C AirCtl_mDesGearEOM_MAP AirCtl_mDesStrgCorrEOM_MAP AirCtl_mPil2CorEOM_C /end DEF_CHARACTERISTIC
 /begin IN_MEASUREMENT AirCtl_qDesVal AirCtl_trqDesVal Clth_st Epm_nEng InjCrv_stInjCharActVal PT_numTraGear StWhl_dphiAg StWhl_phiAg /end IN_MEASUREMENT
 /begin LOC_MEASUREMENT AirCtl_mDesAddEOM1_mp AirCtl_mDesAddEOM_mp AirCtl_mDesAddUnLimEOM_mp AirCtl_mDesBasAddEOM_mp AirCtl_mDesConvEOM_mp AirCtl_mDesGearEOM_mp AirCtl_mDesGearSwtEOM_mp AirCtl_mDesPil2CorEOM_mp AirCtl_mDesStrgCorrEOM_mp AirCtl_mDesStrgCorrSwtEOM_mp /end LOC_MEASUREMENT
 /begin SUB_FUNCTION AirCtl_DesValCalc /end SUB_FUNCTION
/end FUNCTION
/begin FUNCTION AirCtl_DesValCalc_Inl7 ""
 /begin DEF_CHARACTERISTIC AirCtl_facMaxTrmValRgn_C AirCtl_facMinTrmValRgn_C AirCtl_mDesRmp_CUR AirCtl_stRgnMsk3_C AirCtl_TrmRgn_MAP /end DEF_CHARACTERISTIC
 /begin IN_MEASUREMENT AirCtl_qDesVal AirCtl_trqDesVal EGT_st Epm_nEng /end IN_MEASUREMENT
 /begin OUT_MEASUREMENT AirCtl_mDesCorCalc1 /end OUT_MEASUREMENT
 /begin LOC_MEASUREMENT AirCtl_facTrmRgn_mp AirCtl_mDesCorCalc2_mp AirCtl_mDesCorCalc3_mp AirCtl_mDesCorCalc4_mp AirCtl_mDesTrm_mp AirCtl_TrmRgn_mp AirCtl_TrmValCust_mp /end LOC_MEASUREMENT
/end FUNCTION
/begin FUNCTION AirCtl_DesValCalc_Inl8 "" /begin DEF_CHARACTERISTIC AirCtl_mDesMaxVal_C AirCtl_mDesMinVal_C /end DEF_CHARACTERISTIC /end FUNCTION
/begin FUNCTION AirCtl_Gov ""
 /begin DEF_CHARACTERISTIC AirCtl_DKdNeg_CUR AirCtl_DKdPos_CUR AirCtl_DKd_C AirCtl_dmDWinNeg_C AirCtl_dmDWinPos_C AirCtl_facParAirTemp_CUR AirCtl_facParBas_MAP AirCtl_I.Ki_C AirCtl_I.KiPos_C AirCtl_I.KiNeg_C AirCtl_I.WinPos_C AirCtl_I.WinNeg_C AirCtl_numAirTempGov_C AirCtl_P.Kp_C AirCtl_P.KpPos_C AirCtl_P.KpNeg_C AirCtl_P.WinPos_C AirCtl_P.WinNeg_C AirCtl_rDflVal_CA AirCtl_rEGR_MAP AirCtl_rTVA_MAP AirCtl_tiDT1_C /end DEF_CHARACTERISTIC
 /begin REF_CHARACTERISTIC HESrv_swtPOpVis_C HESrv_swtScndFlwActv_C /end REF_CHARACTERISTIC
 /begin IN_MEASUREMENT AirCtl_mDesStat AirCtl_qGov AirCtl_rCtlVal AirCtl_trqGov Epm_nEng /end IN_MEASUREMENT
 /begin OUT_MEASUREMENT AirCtl_mGovDvt /end OUT_MEASUREMENT
 /begin LOC_MEASUREMENT AirCtl_facParAirTemp_mp AirCtl_facParBas_mp AirCtl_facParCor_mp AirCtl_facParNrm_mp AirCtl_mActVal_mp AirCtl_qGov_mp AirCtl_rEGR_mp AirCtl_rGovEGRNrm_mp AirCtl_rGovOutUnLimCor_mp AirCtl_rGovOutUnLim_mp AirCtl_rGovOut_mp AirCtl_rGovTVANrm_mp AirCtl_rOutD_mp AirCtl_rOutI_mp AirCtl_rOutP_mp AirCtl_rPIDCtl_mp AirCtl_rTVA_mp AirCtl_swtGovEna AirCtl_tAirGov_mp /end LOC_MEASUREMENT
/end FUNCTION
/begin FUNCTION airctl_gov_inl1 "" /begin IN_MEASUREMENT AFS_mAirPerCylB1 AFS_mAirPerCylB2 /end IN_MEASUREMENT /end FUNCTION
/begin FUNCTION airctl_gov_inl10 "" /begin DEF_CHARACTERISTIC AirCtl_Gov.xVal_C AirCtl_Gov.xTyp_C /end DEF_CHARACTERISTIC /begin OUT_MEASUREMENT AirCtl_swtGov /end OUT_MEASUREMENT /end FUNCTION
/begin FUNCTION airctl_gov_inl11 "" /begin DEF_CHARACTERISTIC AirCtl_rGovMax_C AirCtl_rGovMin_C /end DEF_CHARACTERISTIC /end FUNCTION
/begin FUNCTION airctl_gov_inl2 "" /end FUNCTION
/begin FUNCTION airctl_gov_inl3 ""
 /begin DEF_CHARACTERISTIC AirCtl_rGovThresBgnNrm_C AirCtl_stGovEOMMsk_C AirCtl_tiEOMNrmMax_C /end DEF_CHARACTERISTIC
 /begin IN_MEASUREMENT CoEOM_stOpModeAct /end IN_MEASUREMENT
 /begin OUT_MEASUREMENT AirCtl_stDesEOM AirCtl_stGov /end OUT_MEASUREMENT
/end FUNCTION
/begin FUNCTION AirCtl_Gov_Inl4 ""
 /begin DEF_CHARACTERISTIC AirCtl_DKdEOM_C AirCtl_DKdNegEOM_CUR AirCtl_DKdPosEOM_CUR AirCtl_dmDWinNegEOM_C AirCtl_dmDWinPosEOM_C AirCtl_EOMI.Ki_C AirCtl_EOMI.KiPos_C AirCtl_EOMI.KiNeg_C AirCtl_EOMI.WinPos_C AirCtl_EOMI.WinNeg_C AirCtl_EOMP.Kp_C AirCtl_EOMP.KpPos_C AirCtl_EOMP.KpNeg_C AirCtl_EOMP.WinPos_C AirCtl_EOMP.WinNeg_C AirCtl_facParAirTempEOM_CUR AirCtl_facParBasEOM_MAP AirCtl_tiDT1EOM_C /end DEF_CHARACTERISTIC
 /begin IN_MEASUREMENT AirCtl_mDesStat AirCtl_qDesVal AirCtl_qGov AirCtl_stGov AirCtl_tAirGov_mp AirCtl_trqGov Epm_nEng /end IN_MEASUREMENT
 /begin LOC_MEASUREMENT AirCtl_facParAirTempEOM_mp AirCtl_facParBasEOM_mp AirCtl_facParCorEOM_mp /end LOC_MEASUREMENT
/end FUNCTION
/begin FUNCTION airctl_gov_inl5 "" /begin DEF_CHARACTERISTIC AirCtl_facParPresDiff_CUR /end DEF_CHARACTERISTIC /begin IN_MEASUREMENT Exh_pFltPPFltDiff /end IN_MEASUREMENT /begin OUT_MEASUREMENT AirCtl_facParPresDiff_mp /end OUT_MEASUREMENT /begin LOC_MEASUREMENT AirCtl_pFltPPFltDiff_mp /end LOC_MEASUREMENT /end FUNCTION
/begin FUNCTION airctl_gov_inl6 "" /begin DEF_CHARACTERISTIC AirCtl_rEGRInv_MAP AirCtl_rGovBgnNrmEOM_C /end DEF_CHARACTERISTIC /begin IN_MEASUREMENT AirCtl_rGovEGR AirCtl_stGov Epm_nEng /end IN_MEASUREMENT
 /begin OUT_MEASUREMENT AirCtl_rEGRInv_mp AirCtl_rEOMBgnInit_mp AirCtl_rEOMEndInit_mp /end OUT_MEASUREMENT
 /begin LOC_MEASUREMENT AirCtl_rGovEGR_mp /end LOC_MEASUREMENT
/end FUNCTION
/begin FUNCTION airctl_gov_inl7 "" /end FUNCTION
/begin FUNCTION airctl_gov_inl8 "" /end FUNCTION
/begin FUNCTION airctl_gov_inl9 ""
 /begin DEF_CHARACTERISTIC AirCtl_facRmpEGRCls_C AirCtl_facRmpEGROpn_C AirCtl_rEGREOM_MAP AirCtl_rEGRMax_C AirCtl_rEGRMin_C AirCtl_rTVAEOM_MAP /end DEF_CHARACTERISTIC
 /begin IN_MEASUREMENT AirCtl_qGov AirCtl_qGov_mp AirCtl_rGovOut_mp AirCtl_stDesEOM AirCtl_stGov AirCtl_trqGov Epm_nEng /end IN_MEASUREMENT
 /begin LOC_MEASUREMENT AirCtl_rEGREOMNrm_mp AirCtl_rEGREOM_mp AirCtl_rEGRNrmEOM_mp AirCtl_rGovEGR AirCtl_rGovTVA AirCtl_rTVAEOM_mp /end LOC_MEASUREMENT
/end FUNCTION
/begin FUNCTION airctl_mon ""
 /begin DEF_CHARACTERISTIC AirCtl_facActDesVal_C AirCtl_nLoIdl_C AirCtl_nOvrRun_C AirCtl_numAirTempMon_C AirCtl_numEngTempMon_C AirCtl_OvrRun_C AirCtl_pAirHi_C AirCtl_pAirLo_C AirCtl_rEGRDflVal_CA AirCtl_rTVADflVal_CA AirCtl_stPrioMon_CA AirCtl_tAirCldHi_C AirCtl_tAirCldLo_C AirCtl_tAirWrmHi_C AirCtl_tAirWrmLo_C AirCtl_tClntCldHi_C AirCtl_tClntCldLo_C AirCtl_tClntWrmHi_C AirCtl_tClntWrmLo_C AirCtl_tiCldStrt_CUR AirCtl_tiClth_C AirCtl_tiLoIdl_C AirCtl_uBattThres_C /end DEF_CHARACTERISTIC
 /begin IN_MEASUREMENT Epm_nEng /end IN_MEASUREMENT
 /begin OUT_MEASUREMENT AirCtl_mDesMax_mp AirCtl_mMaxDvt AirCtl_mMinDvt AirCtl_rGovDvtNrm AirCtl_stDebDef_mp AirCtl_stDesChk_mp AirCtl_stHealDef_mp AirCtl_stMaxDvt_mp AirCtl_stMinDvt_mp AirCtl_stMon AirCtl_stMonBits_mp AirCtl_tAirMon_mp AirCtl_tiCldStrt_mp /end OUT_MEASUREMENT
 /begin LOC_MEASUREMENT AirCtl_stAirCtlBits_mp AirCtl_tEngMon_mp /end LOC_MEASUREMENT
/end FUNCTION
/begin FUNCTION airctl_mon_inl1 ""
 /begin DEF_CHARACTERISTIC AirCtl_qHiEOM_CUR AirCtl_qHi_CUR AirCtl_qLoEOM_CUR AirCtl_qLo_CUR AirCtl_stCurrQntHiEOMMsk_C AirCtl_stCurrQntLoEOMMsk_C AirCtl_stCurrTrqHiEOMMsk_C AirCtl_stCurrTrqLoEOMMsk_C AirCtl_stShOffEOMMsk_C AirCtl_trqHiEOM_CUR AirCtl_trqHi_CUR AirCtl_trqLoEOM_CUR AirCtl_trqLo_CUR /end DEF_CHARACTERISTIC
 /begin IN_MEASUREMENT AirCtl_qMon AirCtl_trqMon CoEOM_stOpModeAct Epm_nEng /end IN_MEASUREMENT
 /begin OUT_MEASUREMENT AirCtl_stEOMMon /end OUT_MEASUREMENT
 /begin LOC_MEASUREMENT AirCtl_qHi_mp AirCtl_qLo_mp AirCtl_trqHi_mp AirCtl_trqLo_mp /end LOC_MEASUREMENT
/end FUNCTION
/begin FUNCTION AirCtl_Mon_Inl2 ""
 /begin DEF_CHARACTERISTIC AirCtl_dnSurgeHigh_CUR AirCtl_dnSurgeLow_CUR AirCtl_qSurgeHigh_CUR AirCtl_qSurgeLow_CUR AirCtl_rSurgeHigh_MAP AirCtl_rSurgeOfs_CUR AirCtl_tiSurgePT1_C /end DEF_CHARACTERISTIC
 /begin IN_MEASUREMENT AirCtl_qMon EnvP_p Epm_dnEng Epm_nEng TCPrt_rPresRat /end IN_MEASUREMENT
 /begin OUT_MEASUREMENT AirCtl_dnAvrg_mp AirCtl_dnSurgeHigh_mp AirCtl_dnSurgeLow_mp AirCtl_qSurgeHigh_mp AirCtl_qSurgeLow_mp AirCtl_rSurgeHigh_mp AirCtl_rSurgeLow_mp AirCtl_rSurgeOfs_mp /end OUT_MEASUREMENT
/end FUNCTION
/begin FUNCTION airctl_mon_inl3 ""
 /begin DEF_CHARACTERISTIC AirCtl_stBitMskEOM_CA AirCtl_stMonEOMMsk_CA AirCtl_tiMonEOM_CA /end DEF_CHARACTERISTIC
 /begin IN_MEASUREMENT CoEOM_stOpModeAct /end IN_MEASUREMENT
 /begin LOC_MEASUREMENT AirCtl_numEOMMode_mp AirCtl_stBitMskEOM_mp AirCtl_stSelBitMskEOM_mp AirCtl_tiMonEOM_mp /end LOC_MEASUREMENT
/end FUNCTION
/begin FUNCTION AirCtl_Mon_Inl4 "" /begin DEF_CHARACTERISTIC AirCtl_mMaxDvt_MAP AirCtl_mMinDvt_MAP /end DEF_CHARACTERISTIC /begin IN_MEASUREMENT AirCtl_qMon Epm_nEng /end IN_MEASUREMENT /begin OUT_MEASUREMENT AirCtl_mMaxDvt1_mp AirCtl_mMinDvt1_mp /end OUT_MEASUREMENT /end FUNCTION
/begin FUNCTION airctl_mon_inl5 ""
 /begin DEF_CHARACTERISTIC AirCtl_nHealHi_C AirCtl_nHealLo_C AirCtl_qHealHi_C AirCtl_qHealLo_C /end DEF_CHARACTERISTIC
 /begin IN_MEASUREMENT AirCtl_qMon Epm_nEng /end IN_MEASUREMENT
/end FUNCTION
/begin FUNCTION airctl_mon_inl6 "" /begin REF_CHARACTERISTIC HESrv_swtPOpVis_C /end REF_CHARACTERISTIC /end FUNCTION
/begin FUNCTION airctl_mon_inl7 "" /end FUNCTION
/begin FUNCTION AirCtl_Mon_Inl8 "" /begin DEF_CHARACTERISTIC AirCtl_mMaxDvtEOM_MAP AirCtl_mMinDvtEOM_MAP /end DEF_CHARACTERISTIC /begin IN_MEASUREMENT AirCtl_qMon Epm_nEng /end IN_MEASUREMENT /begin OUT_MEASUREMENT AirCtl_mMaxDvt1EOM_mp AirCtl_mMinDvt1EOM_mp /end OUT_MEASUREMENT /end FUNCTION
/begin FUNCTION AirSys_Adapt "" /end FUNCTION
/begin FUNCTION airsys_airtemp "" /begin OUT_MEASUREMENT AirSys_tFld /end OUT_MEASUREMENT /end FUNCTION
/begin FUNCTION airsys_lib "" /end FUNCTION
/begin FUNCTION AltIO_DD ""
 /begin DEF_CHARACTERISTIC AltIO_tiLRAltMax_C AltIO_tiLRAltMin_C AltIO_uAltDesMax_C AltIO_uAltDesMin_C /end DEF_CHARACTERISTIC
 /begin OUT_MEASUREMENT AltIO_rAltLoad AltIO_stErrAlt AltIO_stGenManuFak AltIO_stGenTypKenn AltIO_tiLRAlt AltIO_uAltDes /end OUT_MEASUREMENT
/end FUNCTION
/begin FUNCTION alt_demand ""
 /begin DEF_CHARACTERISTIC Alt_facCorTemp_CUR Alt_facCorT_CUR Alt_nThres_C Alt_stTrqMode_CW Alt_swtLayer_C Alt_tiPT1Del_C Alt_trqCalc_MAP Alt_uAltDes_C Alt_uAltOff_C /end DEF_CHARACTERISTIC
 /begin IN_MEASUREMENT AltIO_rAltLoad AltIO_tiLRAlt AltIO_uAltDes Alt_uAltLayer CoEng_tiNormal CoESS_stAlt EngDa_tEng Epm_nEng /end IN_MEASUREMENT
 /begin OUT_MEASUREMENT Alt_trqDes Alt_trqResv ESS_rLdAlt /end OUT_MEASUREMENT
 /begin LOC_MEASUREMENT Alt_trqCor_mp Alt_trqFlt_mp /end LOC_MEASUREMENT
/end FUNCTION
/begin FUNCTION alt_demand_inl "" /begin DEF_CHARACTERISTIC AltIO_tiLR_C /end DEF_CHARACTERISTIC /end FUNCTION
/begin FUNCTION Amd29bdd160 "" /end FUNCTION
/begin FUNCTION Amd29bdd320 "" /end FUNCTION
/begin FUNCTION APP_ChkSig ""
 /begin DEF_CHARACTERISTIC APP_AliveDeb.tiHiLo_C APP_AliveDeb.tiLoHi_C APP_drLim.Pos_C APP_drLim.Neg_C APP_drLimpMax_C APP_drPlaMaxVal.Pos_C APP_drPlaMaxVal.Neg_C APP_rLimpMax_C APP_rPlaMaxVal_C APP_rPlaMaxVal_CUR APP_rThresAliveDet_C APP_swtAliveDetEna_C APP_swtPlaChkEna_C /end DEF_CHARACTERISTIC
 /begin IN_MEASUREMENT Brk_st Com_pBrkSys /end IN_MEASUREMENT
 /begin LOC_MEASUREMENT APP_rPlaMaxVal_mp APP_rPla_mp APP_rUnLim_mp APP_stAlive_mp /end LOC_MEASUREMENT
/end FUNCTION
/begin FUNCTION APP_DD1 "" /begin DEF_CHARACTERISTIC APP_uRaw1SRCHigh_C APP_uRaw1SRCLow_C /end DEF_CHARACTERISTIC /end FUNCTION
/begin FUNCTION APP_DD2 "" /begin DEF_CHARACTERISTIC APP_uRaw2SRCHigh_C APP_uRaw2SRCLow_C /end DEF_CHARACTERISTIC /begin IN_MEASUREMENT MoCADC_st /end IN_MEASUREMENT /end FUNCTION
/begin FUNCTION APP_Kickdown "" /begin DEF_CHARACTERISTIC APP_uKDHighAPP_C APP_uKDLowAPP_C /end DEF_CHARACTERISTIC /end FUNCTION
/begin FUNCTION APP_Plaus12 "" /begin DEF_CHARACTERISTIC APP_uSyncMin_C APP_uSync_CUR /end DEF_CHARACTERISTIC /begin LOC_MEASUREMENT APP_uDiffMax_mp APP_uDiff_mp APP_uMin12half_mp /end LOC_MEASUREMENT /end FUNCTION
/begin FUNCTION APP_PlausBrk ""
 /begin DEF_CHARACTERISTIC APP_drUnFltLim_C APP_GradCondDeb.tiHiLo_C APP_GradCondDeb.tiLoHi_C APP_nLim_C APP_pBrkHigh_C APP_pBrkLow_C APP_PlaBrkDetDeb.tiHiLo_C APP_PlaBrkDetDeb.tiLoHi_C APP_PlaBrkRstDeb.tiHiLo_C APP_PlaBrkRstDeb.tiLoHi_C APP_swtAppGradEna_C APP_swtBrkDet_C APP_swtBrkPres_C APP_swtRstCon_C APP_swtVehDynReqd_C APP_vLim_C /end DEF_CHARACTERISTIC
 /begin IN_MEASUREMENT Brk_stMn Brk_stRed Epm_nEng GlbDa_stTrqDem VehV_v /end IN_MEASUREMENT
 /begin LOC_MEASUREMENT APP_stPlaBrkDet_mp APP_stPlaBrkRst_mp /end LOC_MEASUREMENT
/end FUNCTION
/begin FUNCTION APP_SelSig ""
 /begin DEF_CHARACTERISTIC APP_duLimErr.Pos_C APP_duLimErr.Neg_C APP_uAPPDef_C APP_uRaw2Offset_C /end DEF_CHARACTERISTIC
 /begin IN_MEASUREMENT MoFAPP_stLimpMsg /end IN_MEASUREMENT
 /begin LOC_MEASUREMENT APP_stTempErr_mp /end LOC_MEASUREMENT
/end FUNCTION
/begin FUNCTION APP_VD ""
 /begin DEF_CHARACTERISTIC APP_dRawSigFac_C APP_rLinAPP_CUR APP_rThresFltLowNeg_C APP_rThresFltLowPos_C APP_rThresFltMidNeg_C APP_rThresFltMidPos_C APP_swtEnaUnJit_C APP_swtNoFlt_C APP_swtStepLim_C APP_tiLowNegPT1_C APP_tiLowPosPT1_C APP_tiMidNegPT1_C APP_tiMidPosPT1_C APP_tiUppNegPT1_C APP_tiUppPosPT1_C APP_uJitter_C APP_uRaw1Def_C APP_uRaw2Def_C /end DEF_CHARACTERISTIC
 /begin IN_MEASUREMENT Brk_st Clth_st /end IN_MEASUREMENT
 /begin OUT_MEASUREMENT APP_drUnFlt APP_r APP_rUnFlt APP_stKD APP_stPlaBrk APP_stPlaBrkPres APP_stSigSrc APP_uRaw1 APP_uRaw2 /end OUT_MEASUREMENT
 /begin LOC_MEASUREMENT APP_rFltUnLim_mp APP_rFlt_mp APP_rNextThres_mp APP_rStepLim_mp APP_stPos_mp APP_uRaw1unLim_mp APP_uRaw2unLim_mp APP_uRaw_mp APP_uUnJit_mp /end LOC_MEASUREMENT
/end FUNCTION
/begin FUNCTION ASDdc_Governor ""
 /begin DEF_CHARACTERISTIC ASDdc_swtIniParSet_C ASDdc_swtLADFrz_C ASDdc_trqLimMax_C ASDdc_trqLimMin_C ASDdc_vLimIni_C /end DEF_CHARACTERISTIC
 /begin IN_MEASUREMENT ASDrf_stLAD CoEng_st Epm_nEng PthSet_stOvrRun PthSet_trqASDdcInit VehV_v /end IN_MEASUREMENT
 /begin OUT_MEASUREMENT ASDdc_trq /end OUT_MEASUREMENT
 /begin LOC_MEASUREMENT ASDdc_KdGovCurr_mp ASDdc_stReIni_mp ASDdc_T1GovCurr_mp ASDdc_trqUnLtd_mp /end LOC_MEASUREMENT
/end FUNCTION
/begin FUNCTION ASDdc_SelectParameter ""
 /begin DEF_CHARACTERISTIC ASDdc_GovClth.T1_C ASDdc_GovClth.Kd_C ASDdc_GovExtIntv.T1_C ASDdc_GovExtIntv.Kd_C ASDdc_GovGrip.T1_MAP ASDdc_GovGrip.Kd_MAP ASDdc_GovSt3.T1_C ASDdc_GovSt3.Kd_C ASDdc_GovSt4.T1_C ASDdc_GovSt4.Kd_C ASDdc_numDflSt_C ASDdc_numPrio_CA ASDdc_stCfgClthOpn_C ASDdc_stCfgClthSlipClsd_C ASDdc_stCfgClthSlipOpn_C ASDdc_stCfgClthSlip_C ASDdc_stCfgConExtIntv_C ASDdc_stExtIntv_C ASDdc_stGearSwt_C ASDdc_stGripRaw_C ASDdc_stGrip_C ASDdc_swtCalcN_C ASDdc_swtOpr_C /end DEF_CHARACTERISTIC
 /begin IN_MEASUREMENT ASDdc_trq Clth_st Epm_nEng GlbDa_stTrqDem PT_rTrq PT_stGrip PT_stTraShftOp SpdGov_nSetPLo /end IN_MEASUREMENT
 /begin LOC_MEASUREMENT ASDdc_nEngParSel_mp ASDdc_stClthParSet_mp ASDdc_stCon_mp ASDdc_stPrioSt_mp ASDdc_stSelSt_mp ASDdc_stVldSt_mp /end LOC_MEASUREMENT
/end FUNCTION
/begin COMPU_METHOD AirMassPerCyl "" RAT_FUNC "%6.3" "mg/Hub" COEFFS 0 10 0 0 0 1 /end COMPU_METHOD
/begin COMPU_METHOD AirMassPerTime "" RAT_FUNC "%6.3" "Kg/h" COEFFS 0 10 0 0 0 1 /end COMPU_METHOD
/begin COMPU_METHOD AirTempFldSel "" TAB_VERB "%6.3" "-" COMPU_TAB_REF AirTempFldSel /end COMPU_METHOD
/begin COMPU_METHOD DEFAULT_FORMULA "DEFAULT_FORMULA" RAT_FUNC "%7.0" "" COEFFS 0 1 0 0 0 1 /end COMPU_METHOD
/begin COMPU_METHOD DEFAULT_FORMULA "DEFAULT_FORMULA" RAT_FUNC "%7.0" "" COEFFS 0 1 0 0 0 1 /end COMPU_METHOD
/begin COMPU_METHOD DEFAULT_FORMULA "DEFAULT_FORMULA" RAT_FUNC "%7.0" "" COEFFS 0 1 0 0 0 1 /end COMPU_METHOD
/begin COMPU_METHOD DEFAULT_FORMULA "DEFAULT_FORMULA" RAT_FUNC "%7.0" "" COEFFS 0 1 0 0 0 1 /end COMPU_METHOD
/begin COMPU_METHOD DEFAULT_FORMULA "DEFAULT_FORMULA" RAT_FUNC "%7.0" "" COEFFS 0 1 0 0 0 1 /end COMPU_METHOD
/begin COMPU_METHOD DEFAULT_FORMULA "DEFAULT_FORMULA" RAT_FUNC "%7.0" "" COEFFS 0 1 0 0 0 1 /end COMPU_METHOD
/begin COMPU_METHOD DEFAULT_FORMULA "DEFAULT_FORMULA" RAT_FUNC "%7.0" "" COEFFS 0 1 0 0 0 1 /end COMPU_METHOD
/begin COMPU_METHOD DEFAULT_FORMULA "DEFAULT_FORMULA" RAT_FUNC "%7.0" "" COEFFS 0 1 0 0 0 1 /end COMPU_METHOD
/begin COMPU_VTAB AirTempFldSel "" TAB_VERB 3 0 "Air_tCACDs" 1 "Air_tAFS" 2 "EnvT_t" /end COMPU_VTAB
/begin COMPU_METHOD AngleStWhl "" RAT_FUNC "%6.4" "deg StWhl" COEFFS 0 32 0 0 0 1 /end COMPU_METHOD
/begin COMPU_METHOD AngleVelStWhl "" RAT_FUNC "%6.4" "deg StWhl/s" COEFFS 0 32 0 0 0 1 /end COMPU_METHOD
/begin COMPU_METHOD ASDdc_GovDT1Kd_float "" RAT_FUNC "%6.2" "(Nm/rpm)^0.5" COEFFS 0 1 0 0 0 1 /end COMPU_METHOD
/begin COMPU_METHOD ASDdc_GovDT1T1_float "" RAT_FUNC "%6.2" "s" COEFFS 0 1 0 0 0 1 /end COMPU_METHOD
/begin COMPU_METHOD CoEOMSwt_S16 "" RAT_FUNC "%7.6" "-" COEFFS 0 16384 0 0 0 1 /end COMPU_METHOD
/begin COMPU_METHOD dn_dZ20 "" RAT_FUNC "%6.2" "rpm/s" COEFFS 0 0.2 0 0 0 1 /end COMPU_METHOD
/begin COMPU_METHOD DtyCyc "" RAT_FUNC "%6.4" "%" COEFFS 0 100 0 0 0 1 /end COMPU_METHOD
/begin COMPU_METHOD EngN "" RAT_FUNC "%6.3" "rpm" COEFFS 0 2 0 0 0 1 /end COMPU_METHOD
/begin COMPU_METHOD EngN1 "" RAT_FUNC "%6.3" "rpm" COEFFS 0 2 0 0 0 1 /end COMPU_METHOD
/begin COMPU_METHOD EngTempFldSel "" TAB_VERB "%6.3" "-" COMPU_TAB_REF EngTempFldSel /end COMPU_METHOD
/begin COMPU_VTAB EngTempFldSel "" TAB_VERB 3 0 "Coolant_Temperature" 1 "Oil_Temperature" 2 "EngDa_tEng" /end COMPU_VTAB
/begin COMPU_METHOD Fact "" RAT_FUNC "%6.5" "-" COEFFS 0 8192 0 0 0 1 /end COMPU_METHOD
/begin COMPU_METHOD Fact1 "" RAT_FUNC "%6.4" "-" COEFFS 0 128 0 0 0 1 /end COMPU_METHOD
/begin COMPU_METHOD Fact100 "" RAT_FUNC "%6.4" "-" COEFFS 0 100 0 0 0 1 /end COMPU_METHOD
/begin COMPU_METHOD InjMass "" RAT_FUNC "%6.4" "mg/hub" COEFFS 0 100 0 0 0 1 /end COMPU_METHOD
/begin COMPU_METHOD Kd "" RAT_FUNC "%7.6" "1/1" COEFFS 0 65536 0 0 0 1 /end COMPU_METHOD
/begin COMPU_METHOD Kd16_sqr_rpm2Nm "" RAT_FUNC "%6.5" "(Nm/rpm)^0.5" COEFFS 0 1024 0 0 0 1 /end COMPU_METHOD
/begin COMPU_METHOD Kd_Ampc2Prc "" RAT_FUNC "%8.7" "%/(mg/Hub Luft)" COEFFS 0 536870.912 0 0 0 1 /end COMPU_METHOD
/begin COMPU_METHOD Kd_Ampc2PrcRedRes "" RAT_FUNC "%6.4" "%/(mg/Hub Luft)" COEFFS 0 524.288 0 0 0 1 /end COMPU_METHOD
/begin COMPU_METHOD Kd_RedRes "" RAT_FUNC "%6.4" "1/1" COEFFS 0 64 0 0 0 1 /end COMPU_METHOD
/begin COMPU_METHOD Ki_Ampc2Prc "" RAT_FUNC "%7.6" "%/(mg/Hub Luft)/s" COEFFS 0 17592.186044416 0 0 0 1 /end COMPU_METHOD
/begin COMPU_METHOD Kp_Ampc2Prc "" RAT_FUNC "%8.7" "%/(mg/Hub Luft)" COEFFS 0 268435.456 0 0 0 1 /end COMPU_METHOD
/begin COMPU_METHOD OneToOne "" RAT_FUNC "%6.2" "-" COEFFS 0 1 0 0 0 1 /end COMPU_METHOD
/begin COMPU_METHOD Period "" RAT_FUNC "%6.3" "ms" COEFFS 0 10 0 0 0 1 /end COMPU_METHOD
/begin COMPU_METHOD Prc "" RAT_FUNC "%6.4" "%" COEFFS 0 81.92 0 0 0 1 /end COMPU_METHOD
/begin COMPU_METHOD PrcEGRRmp "" RAT_FUNC "%6.3" "%" COEFFS 0 6.5536 0 0 0 1 /end COMPU_METHOD
/begin COMPU_METHOD PrcPerSec "" RAT_FUNC "%6.3" "%/s" COEFFS 0 1.6384 0 0 0 1 /end COMPU_METHOD
/begin COMPU_METHOD Pres_bar "" RAT_FUNC "%6.2" "bar" COEFFS 0 1 0 0 0 1 /end COMPU_METHOD
/begin COMPU_METHOD Pres_hPa "" RAT_FUNC "%6.2" "hPa" COEFFS 0 1 0 0 0 1 /end COMPU_METHOD
/begin COMPU_METHOD RmpAirMassPerCyl "" RAT_FUNC "%6.4" "mg/hub/s" COEFFS 0 655.36 0 0 0 1 /end COMPU_METHOD
/begin COMPU_METHOD RmpInjMass "" RAT_FUNC "%6.5" "(mg/stroke)/s" COEFFS 0 6553.6 0 0 0 1 /end COMPU_METHOD
/begin COMPU_METHOD RmpPrc "" RAT_FUNC "%6.5" "%/s" COEFFS 0 5368.70912 0 0 0 1 /end COMPU_METHOD
/begin COMPU_METHOD RmpPres_hPa "" RAT_FUNC "%6.4" "hPa/s" COEFFS 0 65.536 0 0 0 1 /end COMPU_METHOD
/begin COMPU_METHOD RmpTemp "" RAT_FUNC "%6.4" "K/s" COEFFS 0 655.36 0 0 0 1 /end COMPU_METHOD
/begin COMPU_METHOD RmpVolt "" RAT_FUNC "%6.4" "mV/s" COEFFS 0 327.68 0 0 0 1 /end COMPU_METHOD
/begin COMPU_METHOD Rmp_1 "" RAT_FUNC "%6.5" "1/s" COEFFS 0 1000 0 0 0 1 /end COMPU_METHOD
/begin COMPU_METHOD TempCels_100ms "" RAT_FUNC "%6.2" "deg C/s" COEFFS 0 1 0 0 0 1 /end COMPU_METHOD
/begin COMPU_METHOD Temp_Cels "" RAT_FUNC "%6.1" "deg C" COEFFS 0 10 2731.4 0 0 1 /end COMPU_METHOD
/begin COMPU_METHOD TimeDeb "" RAT_FUNC "%6.1" "ms" COEFFS 0 0.1 0 0 0 1 /end COMPU_METHOD
/begin COMPU_METHOD TimeDelay_ms "" RAT_FUNC "%12.1" "ms" COEFFS 0 0 1 0 2.3283064365387e-007 0 /end COMPU_METHOD
/begin COMPU_METHOD TimeDelay_s "" RAT_FUNC "%12.4" "s" COEFFS 0 0 1 0 0.00023283064365387 0 /end COMPU_METHOD
/begin COMPU_METHOD TimeDelay_s_Lin_16 "" RAT_FUNC "%6.5" "s" COEFFS 0 6553.4 0 0 0 1 /end COMPU_METHOD
/begin COMPU_METHOD Time_ms "" RAT_FUNC "%6.1" "ms" COEFFS 0 0.1 0 0 0 1 /end COMPU_METHOD
/begin COMPU_METHOD Time_Period_HFM6 "" RAT_FUNC "%7.6" "ms" COEFFS 0 20000 0 0 0 1 /end COMPU_METHOD
/begin COMPU_METHOD Time_PwmHigh "" RAT_FUNC "%6.4" "us" COEFFS 0 20 0 0 0 1 /end COMPU_METHOD
/begin COMPU_METHOD Time_s "" RAT_FUNC "%6.4" "s" COEFFS 0 100 0 0 0 1 /end COMPU_METHOD
/begin COMPU_METHOD TransR "" RAT_FUNC "%6.4" "-" COEFFS 0 100 0 0 0 1 /end COMPU_METHOD
/begin COMPU_METHOD Trq "" RAT_FUNC "%6.3" "Nm" COEFFS 0 10 0 0 0 1 /end COMPU_METHOD
/begin COMPU_METHOD Trq_float "" RAT_FUNC "%6.2" "Nm" COEFFS 0 1 0 0 0 1 /end COMPU_METHOD
/begin COMPU_METHOD Typ4WinDia "" TAB_VERB "%6.3" "-" COMPU_TAB_REF Typ4WinDia /end COMPU_METHOD
/begin COMPU_VTAB Typ4WinDia "" TAB_VERB 4 0 "4 Window diagnosis over PWM control line" 1 "4 Window diagnosis through Digital input" 2 "4 Window diagnosis over external interface" 3 "No 4 Window diagnosis." /end COMPU_VTAB
/begin COMPU_METHOD Vel "" RAT_FUNC "%6.4" "km/h" COEFFS 0 100 0 0 0 1 /end COMPU_METHOD
/begin COMPU_METHOD Volt "" RAT_FUNC "%6.3" "mV" COEFFS 0 5 0 0 0 1 /end COMPU_METHOD
/begin COMPU_METHOD Volt_Batt "" RAT_FUNC "%6.1" "mV" COEFFS 0 0.05 0 0 0 1 /end COMPU_METHOD
/begin RECORD_LAYOUT Cur_Xs16Ws16 NO_AXIS_PTS_X 1 SWORD AXIS_PTS_X 2 SWORD INDEX_INCR DIRECT FNC_VALUES 3 SWORD COLUMN_DIR DIRECT /end RECORD_LAYOUT
/begin RECORD_LAYOUT Kf_Xs16_Ys16_Ws16 NO_AXIS_PTS_X 1 SWORD NO_AXIS_PTS_Y 2 SWORD AXIS_PTS_X 3 SWORD INDEX_INCR DIRECT AXIS_PTS_Y 4 SWORD INDEX_INCR DIRECT FNC_VALUES 5 SWORD COLUMN_DIR DIRECT /end RECORD_LAYOUT
/begin RECORD_LAYOUT Kl_Xs16_Ws16 NO_AXIS_PTS_X 1 SWORD AXIS_PTS_X 2 SWORD INDEX_INCR DIRECT FNC_VALUES 3 SWORD COLUMN_DIR DIRECT /end RECORD_LAYOUT
/begin RECORD_LAYOUT Kw_Ws16 FNC_VALUES 1 SWORD COLUMN_DIR DIRECT /end RECORD_LAYOUT
/begin RECORD_LAYOUT Kw_Ws32 FNC_VALUES 1 SLONG COLUMN_DIR DIRECT /end RECORD_LAYOUT
/begin RECORD_LAYOUT Kw_Wu16 FNC_VALUES 1 UWORD COLUMN_DIR DIRECT /end RECORD_LAYOUT
/begin RECORD_LAYOUT Kw_Wu32 FNC_VALUES 1 ULONG COLUMN_DIR DIRECT /end RECORD_LAYOUT
/begin RECORD_LAYOUT Kw_Wu8 FNC_VALUES 1 UBYTE COLUMN_DIR DIRECT /end RECORD_LAYOUT
/begin RECORD_LAYOUT Map_Xs16Ys16Ws16 NO_AXIS_PTS_X 1 SWORD NO_AXIS_PTS_Y 2 SWORD AXIS_PTS_X 3 SWORD INDEX_INCR DIRECT AXIS_PTS_Y 4 SWORD INDEX_INCR DIRECT FNC_VALUES 5 SWORD COLUMN_DIR DIRECT /end RECORD_LAYOUT
/begin RECORD_LAYOUT ValA_Ws16 FNC_VALUES 1 SWORD COLUMN_DIR DIRECT /end RECORD_LAYOUT
/begin RECORD_LAYOUT ValA_Wu32 FNC_VALUES 1 ULONG COLUMN_DIR DIRECT /end RECORD_LAYOUT
/begin RECORD_LAYOUT ValA_Wu8 FNC_VALUES 1 UBYTE COLUMN_DIR DIRECT /end RECORD_LAYOUT
/begin RECORD_LAYOUT Val_Wr32 FNC_VALUES 1 FLOAT32_IEEE COLUMN_DIR DIRECT /end RECORD_LAYOUT
/begin RECORD_LAYOUT Val_Ws16 FNC_VALUES 1 SWORD COLUMN_DIR DIRECT /end RECORD_LAYOUT
/begin RECORD_LAYOUT Val_Ws32 FNC_VALUES 1 SLONG COLUMN_DIR DIRECT /end RECORD_LAYOUT
/begin RECORD_LAYOUT Val_Wu16 FNC_VALUES 1 UWORD COLUMN_DIR DIRECT /end RECORD_LAYOUT
/begin RECORD_LAYOUT Val_Wu32 FNC_VALUES 1 ULONG COLUMN_DIR DIRECT /end RECORD_LAYOUT
/begin RECORD_LAYOUT Val_Wu8 FNC_VALUES 1 UBYTE COLUMN_DIR DIRECT /end RECORD_LAYOUT
/end MODULE
/end PROJECT
