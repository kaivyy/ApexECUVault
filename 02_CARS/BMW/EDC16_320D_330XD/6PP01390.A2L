ASAP2_VERSION 1 3
/begin PROJECT P390 "BMW DDE6.2 6-Zylinder VP0.1 11.11.2003 CAN12H"
/begin HEADER "" VERSION "VP01_6Z_CAN12H" PROJECT_NO P390 /end HEADER
/begin MODULE DIM ""
/begin MOD_COMMON "" BYTE_ORDER MSB_FIRST ALIGNMENT_BYTE 1 ALIGNMENT_WORD 2 ALIGNMENT_LONG 4 ALIGNMENT_FLOAT32_IEEE 4 /end MOD_COMMON
/begin CHARACTERISTIC DSM_RdyABForceMsk_C "Maske zur Erzwingung von Readiness durch bitweises AND mit Message DSM_stRdyAB" VALUE 0xCC950 Kw_Wu16 65535.00 OneToOne 0.00 65535.00 FORMAT "%8.2" /end CHARACTERISTIC
/begin CHARACTERISTIC DSM_RdyCDForceMsk_C "Maske zur Erzwingung von Readiness durch bitweises AND mit Message DSM_stRdyCD" VALUE 0xCC952 Kw_Wu16 65535.00 OneToOne 0.00 65535.00 FORMAT "%8.2" /end CHARACTERISTIC
/begin CHARACTERISTIC DSM_RdyOnMilEnable_C "Verhalten Readiness bei angesteuerter MIL" VALUE 0xCC954 Kw_Wu8 1.00000000000 RdyOnMilEnable 0.00 1.00000000000 FORMAT "%13.11" /end CHARACTERISTIC
/begin CHARACTERISTIC DSM_TypDfp_Layer_TANS_C "Konvertierung der Fehlertypen auf der Diagnoseschnittstelle fuer Fehlerpfad Dfp_Layer_TANS" VAL_BLK 0xCC298 Kwb_Wu8 255.0 OneToOne 0.00 255.0 FORMAT "%5.1" NUMBER 4 /end CHARACTERISTIC
/begin CHARACTERISTIC DSM_TypDfp_ACCDSwtin_C "Konvertierung der Fehlertypen auf der Diagnoseschnittstelle fuer Fehlerpfad Dfp_ACCDSwtin" VAL_BLK 0xCC29C Kwb_Wu8 255.0 OneToOne 0.00 255.0 FORMAT "%5.1" NUMBER 4 /end CHARACTERISTIC
/begin CHARACTERISTIC DSM_TypDfp_ACC_PlausTrqDes_C "Konvertierung der Fehlertypen auf der Diagnoseschnittstelle fuer Fehlerpfad Dfp_ACC_PlausTrqDes" VAL_BLK 0xCC2A0 Kwb_Wu8 255.0 OneToOne 0.00 255.0 FORMAT "%5.1" NUMBER 4 /end CHARACTERISTIC
/begin CHARACTERISTIC DSM_TypDfp_ACC_trqInr_C "Konvertierung der Fehlertypen auf der Diagnoseschnittstelle fuer Fehlerpfad Dfp_ACC_trqInr" VAL_BLK 0xCC2A4 Kwb_Wu8 255.0 OneToOne 0.00 255.0 FORMAT "%5.1" NUMBER 4 /end CHARACTERISTIC
/begin CHARACTERISTIC DSM_TypDfp_ACTrq_C "Konvertierung der Fehlertypen auf der Diagnoseschnittstelle fuer Fehlerpfad Dfp_ACTrq" VAL_BLK 0xCC2A8 Kwb_Wu8 255.0 OneToOne 0.00 255.0 FORMAT "%5.1" NUMBER 4 /end CHARACTERISTIC
/begin CHARACTERISTIC DSM_TypDfp_ADCMon_C "Konvertierung der Fehlertypen auf der Diagnoseschnittstelle fuer Fehlerpfad Dfp_ADCMon" VAL_BLK 0xCC2AC Kwb_Wu8 255.0 OneToOne 0.00 255.0 FORMAT "%5.1" NUMBER 4 /end CHARACTERISTIC
/begin CHARACTERISTIC DSM_TypDfp_AFSCDIdlAdjVal_C "Konvertierung der Fehlertypen auf der Diagnoseschnittstelle fuer Fehlerpfad Dfp_AFSCDIdlAdjVal" VAL_BLK 0xCC2B0 Kwb_Wu8 255.0 OneToOne 0.00 255.0 FORMAT "%5.1" NUMBER 4 /end CHARACTERISTIC
/begin CHARACTERISTIC DSM_TypDfp_AFSCDLdAdjVal_C "Konvertierung der Fehlertypen auf der Diagnoseschnittstelle fuer Fehlerpfad Dfp_AFSCDLdAdjVal" VAL_BLK 0xCC2B4 Kwb_Wu8 255.0 OneToOne 0.00 255.0 FORMAT "%5.1" NUMBER 4 /end CHARACTERISTIC
/begin CHARACTERISTIC DSM_TypDfp_AFSCD_AirTempDcyc_C "Konvertierung der Fehlertypen auf der Diagnoseschnittstelle fuer Fehlerpfad Dfp_AFSCD_AirTempDcyc" VAL_BLK 0xCC2B8 Kwb_Wu8 255.0 OneToOne 0.00 255.0 FORMAT "%5.1" NUMBER 4 /end CHARACTERISTIC
/begin CHARACTERISTIC DSM_TypDfp_AFSCD_PlOffsDrft_C "Konvertierung der Fehlertypen auf der Diagnoseschnittstelle fuer Fehlerpfad Dfp_AFSCD_PlOffsDrft" VAL_BLK 0xCC2BC Kwb_Wu8 255.0 OneToOne 0.00 255.0 FORMAT "%5.1" NUMBER 4 /end CHARACTERISTIC
/begin CHARACTERISTIC DSM_TypDfp_AFSCD_PlSetyDrft_C "Konvertierung der Fehlertypen auf der Diagnoseschnittstelle fuer Fehlerpfad Dfp_AFSCD_PlSetyDrft" VAL_BLK 0xCC2C0 Kwb_Wu8 255.0 OneToOne 0.00 255.0 FORMAT "%5.1" NUMBER 4 /end CHARACTERISTIC
/begin CHARACTERISTIC DSM_TypDfp_AFSCD_SRCAirTemp_C "Konvertierung der Fehlertypen auf der Diagnoseschnittstelle fuer Fehlerpfad Dfp_AFSCD_SRCAirTemp" VAL_BLK 0xCC2C4 Kwb_Wu8 255.0 OneToOne 0.00 255.0 FORMAT "%5.1" NUMBER 4 /end CHARACTERISTIC
/begin CHARACTERISTIC DSM_TypDfp_AFSCD_SRCBatt_C "Konvertierung der Fehlertypen auf der Diagnoseschnittstelle fuer Fehlerpfad Dfp_AFSCD_SRCBatt" VAL_BLK 0xCC2C8 Kwb_Wu8 255.0 OneToOne 0.00 255.0 FORMAT "%5.1" NUMBER 4 /end CHARACTERISTIC
/begin CHARACTERISTIC DSM_TypDfp_AFSCD_SRCCorrAirm_C "Konvertierung der Fehlertypen auf der Diagnoseschnittstelle fuer Fehlerpfad Dfp_AFSCD_SRCCorrAirm" VAL_BLK 0xCC2CC Kwb_Wu8 255.0 OneToOne 0.00 255.0 FORMAT "%5.1" NUMBER 4 /end CHARACTERISTIC
/begin CHARACTERISTIC DSM_TypDfp_AFSCD_SRCRawAirm_C "Konvertierung der Fehlertypen auf der Diagnoseschnittstelle fuer Fehlerpfad Dfp_AFSCD_SRCRawAirm" VAL_BLK 0xCC2D0 Kwb_Wu8 255.0 OneToOne 0.00 255.0 FORMAT "%5.1" NUMBER 4 /end CHARACTERISTIC
/begin CHARACTERISTIC DSM_TypDfp_AFSCD_SRCRefSigPer_C "Konvertierung der Fehlertypen auf der Diagnoseschnittstelle fuer Fehlerpfad Dfp_AFSCD_SRCRefSigPer" VAL_BLK 0xCC2D4 Kwb_Wu8 255.0 OneToOne 0.00 255.0 FORMAT "%5.1" NUMBER 4 /end CHARACTERISTIC
/begin CHARACTERISTIC DSM_TypDfp_AOHtCD_C "Konvertierung der Fehlertypen auf der Diagnoseschnittstelle fuer Fehlerpfad Dfp_AOHtCD" VAL_BLK 0xCC2D8 Kwb_Wu8 255.0 OneToOne 0.00 255.0 FORMAT "%5.1" NUMBER 4 /end CHARACTERISTIC
/begin CHARACTERISTIC DSM_TypDfp_AOHtCD_AOHtDia1_C "Konvertierung der Fehlertypen auf der Diagnoseschnittstelle fuer Fehlerpfad Dfp_AOHtCD_AOHtDia1" VAL_BLK 0xCC2DC Kwb_Wu8 255.0 OneToOne 0.00 255.0 FORMAT "%5.1" NUMBER 4 /end CHARACTERISTIC
/begin CHARACTERISTIC DSM_TypDfp_AOHtCD_AOHtDia2_C "Konvertierung der Fehlertypen auf der Diagnoseschnittstelle fuer Fehlerpfad Dfp_AOHtCD_AOHtDia2" VAL_BLK 0xCC2E0 Kwb_Wu8 255.0 OneToOne 0.00 255.0 FORMAT "%5.1" NUMBER 4 /end CHARACTERISTIC
/begin CHARACTERISTIC DSM_TypDfp_Layer_TUMG_C "Konvertierung der Fehlertypen auf der Diagnoseschnittstelle fuer Fehlerpfad Dfp_Layer_TUMG" VAL_BLK 0xCC2E4 Kwb_Wu8 255.0 OneToOne 0.00 255.0 FORMAT "%5.1" NUMBER 4 /end CHARACTERISTIC
/begin CHARACTERISTIC DSM_TypDfp_AOHtCD_AOHtDia3_C "Konvertierung der Fehlertypen auf der Diagnoseschnittstelle fuer Fehlerpfad Dfp_AOHtCD_AOHtDia3" VAL_BLK 0xCC2E8 Kwb_Wu8 255.0 OneToOne 0.00 255.0 FORMAT "%5.1" NUMBER 4 /end CHARACTERISTIC
/begin CHARACTERISTIC DSM_TypDfp_APP1_C "Konvertierung der Fehlertypen auf der Diagnoseschnittstelle fuer Fehlerpfad Dfp_APP1" VAL_BLK 0xCC2EC Kwb_Wu8 255.0 OneToOne 0.00 255.0 FORMAT "%5.1" NUMBER 4 /end CHARACTERISTIC
/begin CHARACTERISTIC DSM_TypDfp_Layer_GEN_C "Konvertierung der Fehlertypen auf der Diagnoseschnittstelle fuer Fehlerpfad Dfp_Layer_GEN" VAL_BLK 0xCC2F0 Kwb_Wu8 255.0 OneToOne 0.00 255.0 FORMAT "%5.1" NUMBER 4 /end CHARACTERISTIC
/begin CHARACTERISTIC DSM_TypDfp_Layer_BSD_C "Konvertierung der Fehlertypen auf der Diagnoseschnittstelle fuer Fehlerpfad Dfp_Layer_BSD" VAL_BLK 0xCC2F4 Kwb_Wu8 255.0 OneToOne 0.00 255.0 FORMAT "%5.1" NUMBER 4 /end CHARACTERISTIC
/begin CHARACTERISTIC DSM_TypDfp_APP2_C "Konvertierung der Fehlertypen auf der Diagnoseschnittstelle fuer Fehlerpfad Dfp_APP2" VAL_BLK 0xCC2F8 Kwb_Wu8 255.0 OneToOne 0.00 255.0 FORMAT "%5.1" NUMBER 4 /end CHARACTERISTIC
/begin CHARACTERISTIC DSM_TypDfp_APSCD_C "Konvertierung der Fehlertypen auf der Diagnoseschnittstelle fuer Fehlerpfad Dfp_APSCD" VAL_BLK 0xCC2FC Kwb_Wu8 255.0 OneToOne 0.00 255.0 FORMAT "%5.1" NUMBER 4 /end CHARACTERISTIC
/begin CHARACTERISTIC DSM_TypDfp_ARS_C "Konvertierung der Fehlertypen auf der Diagnoseschnittstelle fuer Fehlerpfad Dfp_ARS" VAL_BLK 0xCC300 Kwb_Wu8 255.0 OneToOne 0.00 255.0 FORMAT "%5.1" NUMBER 4 /end CHARACTERISTIC
/begin CHARACTERISTIC DSM_TypDfp_AccPedPlausBrk_C "Konvertierung der Fehlertypen auf der Diagnoseschnittstelle fuer Fehlerpfad Dfp_AccPedPlausBrk" VAL_BLK 0xCC304 Kwb_Wu8 255.0 OneToOne 0.00 255.0 FORMAT "%5.1" NUMBER 4 /end CHARACTERISTIC
/begin CHARACTERISTIC DSM_TypDfp_AirCtlPlateBreak_C "DSM variable for Dfp_AirCtlPlateBreak_mp" VAL_BLK 0xCC308 Kwb_Wu8 255.0 OneToOne 0.00 255.0 FORMAT "%5.1" NUMBER 4 /end CHARACTERISTIC
/begin CHARACTERISTIC DSM_TypDfp_AirCtl_GovNegDev_C "Konvertierung der Fehlertypen auf der Diagnoseschnittstelle fuer Fehlerpfad Dfp_AirCtl_GovNegDev" VAL_BLK 0xCC30C Kwb_Wu8 255.0 OneToOne 0.00 255.0 FORMAT "%5.1" NUMBER 4 /end CHARACTERISTIC
/begin CHARACTERISTIC DSM_TypDfp_AirCtl_GovNegDev2_C "Konvertierung der Fehlertypen auf der Diagnoseschnittstelle fuer Fehlerpfad Dfp_AirCtl_GovNegDev2" VAL_BLK 0xCC310 Kwb_Wu8 255.0 OneToOne 0.00 255.0 FORMAT "%5.1" NUMBER 4 /end CHARACTERISTIC
/begin CHARACTERISTIC DSM_TypDfp_AirCtl_GovPosDev_C "Konvertierung der Fehlertypen auf der Diagnoseschnittstelle fuer Fehlerpfad Dfp_AirCtl_GovPosDev" VAL_BLK 0xCC314 Kwb_Wu8 255.0 OneToOne 0.00 255.0 FORMAT "%5.1" NUMBER 4 /end CHARACTERISTIC
/begin CHARACTERISTIC DSM_TypDfp_AirCtl_GovPosDev2_C "Konvertierung der Fehlertypen auf der Diagnoseschnittstelle fuer Fehlerpfad Dfp_AirCtl_GovPosDev2" VAL_BLK 0xCC318 Kwb_Wu8 255.0 OneToOne 0.00 255.0 FORMAT "%5.1" NUMBER 4 /end CHARACTERISTIC
/begin CHARACTERISTIC DSM_TypDfp_AltCD_C "Konvertierung der Fehlertypen auf der Diagnoseschnittstelle fuer Fehlerpfad Dfp_AltCD" VAL_BLK 0xCC31C Kwb_Wu8 255.0 OneToOne 0.00 255.0 FORMAT "%5.1" NUMBER 4 /end CHARACTERISTIC
/begin CHARACTERISTIC DSM_TypDfp_Layer_QLT_C "Konvertierung der Fehlertypen auf der Diagnoseschnittstelle fuer Fehlerpfad Dfp_Layer_QLT" VAL_BLK 0xCC320 Kwb_Wu8 255.0 OneToOne 0.00 255.0 FORMAT "%5.1" NUMBER 4 /end CHARACTERISTIC
/begin CHARACTERISTIC DSM_TypDfp_BPACD_BPADia1_C "Konvertierung der Fehlertypen auf der Diagnoseschnittstelle fuer Fehlerpfad Dfp_BPACD_BPADia1" VAL_BLK 0xCC324 Kwb_Wu8 255.0 OneToOne 0.00 255.0 FORMAT "%5.1" NUMBER 4 /end CHARACTERISTIC
/begin CHARACTERISTIC DSM_TypDfp_Layer_IBS1_C "Konvertierung der Fehlertypen auf der Diagnoseschnittstelle fuer Fehlerpfad Dfp_Layer_IBS1" VAL_BLK 0xCC328 Kwb_Wu8 255.0 OneToOne 0.00 255.0 FORMAT "%5.1" NUMBER 4 /end CHARACTERISTIC
/begin CHARACTERISTIC DSM_TypDfp_Layer_IBS2_C "Konvertierung der Fehlertypen auf der Diagnoseschnittstelle fuer Fehlerpfad Dfp_Layer_IBS2" VAL_BLK 0xCC32C Kwb_Wu8 255.0 OneToOne 0.00 255.0 FORMAT "%5.1" NUMBER 4 /end CHARACTERISTIC
/begin CHARACTERISTIC DSM_TypDfp_Layer_IBS3_C "Konvertierung der Fehlertypen auf der Diagnoseschnittstelle fuer Fehlerpfad Dfp_Layer_IBS3" VAL_BLK 0xCC330 Kwb_Wu8 255.0 OneToOne 0.00 255.0 FORMAT "%5.1" NUMBER 4 /end CHARACTERISTIC
/begin CHARACTERISTIC DSM_TypDfp_Layer_PMBN_C "Konvertierung der Fehlertypen auf der Diagnoseschnittstelle fuer Fehlerpfad Dfp_Layer_PMBN" VAL_BLK 0xCC334 Kwb_Wu8 255.0 OneToOne 0.00 255.0 FORMAT "%5.1" NUMBER 4 /end CHARACTERISTIC
/begin CHARACTERISTIC DSM_TypDfp_Layer_PMBATT_C "Konvertierung der Fehlertypen auf der Diagnoseschnittstelle fuer Fehlerpfad Dfp_Layer_PMBATT" VAL_BLK 0xCC338 Kwb_Wu8 255.0 OneToOne 0.00 255.0 FORMAT "%5.1" NUMBER 4 /end CHARACTERISTIC
/begin CHARACTERISTIC DSM_TypDfp_BPACD_BPADia2_C "Konvertierung der Fehlertypen auf der Diagnoseschnittstelle fuer Fehlerpfad Dfp_BPACD_BPADia2" VAL_BLK 0xCC33C Kwb_Wu8 255.0 OneToOne 0.00 255.0 FORMAT "%5.1" NUMBER 4 /end CHARACTERISTIC
/begin CHARACTERISTIC DSM_TypDfp_BPACD_BPADia3_C "Konvertierung der Fehlertypen auf der Diagnoseschnittstelle fuer Fehlerpfad Dfp_BPACD_BPADia3" VAL_BLK 0xCC340 Kwb_Wu8 255.0 OneToOne 0.00 255.0 FORMAT "%5.1" NUMBER 4 /end CHARACTERISTIC
/begin CHARACTERISTIC DSM_TypDfp_BPACD_Max_C "Konvertierung der Fehlertypen auf der Diagnoseschnittstelle fuer Fehlerpfad Dfp_BPACD_Max" VAL_BLK 0xCC344 Kwb_Wu8 255.0 OneToOne 0.00 255.0 FORMAT "%5.1" NUMBER 4 /end CHARACTERISTIC
/begin CHARACTERISTIC DSM_TypDfp_BPACD_Min_C "Konvertierung der Fehlertypen auf der Diagnoseschnittstelle fuer Fehlerpfad Dfp_BPACD_Min" VAL_BLK 0xCC348 Kwb_Wu8 255.0 OneToOne 0.00 255.0 FORMAT "%5.1" NUMBER 4 /end CHARACTERISTIC
/begin CHARACTERISTIC DSM_TypDfp_BPACD_SigNpl_C "Konvertierung der Fehlertypen auf der Diagnoseschnittstelle fuer Fehlerpfad Dfp_BPACD_SigNpl" VAL_BLK 0xCC34C Kwb_Wu8 255.0 OneToOne 0.00 255.0 FORMAT "%5.1" NUMBER 4 /end CHARACTERISTIC
/begin CHARACTERISTIC DSM_TypDfp_BPSCD_C "Konvertierung der Fehlertypen auf der Diagnoseschnittstelle fuer Fehlerpfad Dfp_BPSCD" VAL_BLK 0xCC350 Kwb_Wu8 255.0 OneToOne 0.00 255.0 FORMAT "%5.1" NUMBER 4 /end CHARACTERISTIC
/begin CHARACTERISTIC DSM_TypDfp_BattCD_C "Konvertierung der Fehlertypen auf der Diagnoseschnittstelle fuer Fehlerpfad Dfp_BattCD" VAL_BLK 0xCC354 Kwb_Wu8 255.0 OneToOne 0.00 255.0 FORMAT "%5.1" NUMBER 4 /end CHARACTERISTIC
/begin CHARACTERISTIC DSM_TypDfp_BrkCD_C "Konvertierung der Fehlertypen auf der Diagnoseschnittstelle fuer Fehlerpfad Dfp_BrkCD" VAL_BLK 0xCC358 Kwb_Wu8 255.0 OneToOne 0.00 255.0 FORMAT "%5.1" NUMBER 4 /end CHARACTERISTIC
/begin CHARACTERISTIC DSM_TypDfp_Bss_C "Konvertierung der Fehlertypen auf der Diagnoseschnittstelle fuer Fehlerpfad Dfp_Bss" VAL_BLK 0xCC35C Kwb_Wu8 255.0 OneToOne 0.00 255.0 FORMAT "%5.1" NUMBER 4 /end CHARACTERISTIC
/begin CHARACTERISTIC DSM_TypDfp_CBACD_C "Konvertierung der Fehlertypen auf der Diagnoseschnittstelle fuer Fehlerpfad Dfp_CBACD" VAL_BLK 0xCC360 Kwb_Wu8 255.0 OneToOne 0.00 255.0 FORMAT "%5.1" NUMBER 4 /end CHARACTERISTIC
/begin CHARACTERISTIC DSM_TypDfp_CTSCD_C "Konvertierung der Fehlertypen auf der Diagnoseschnittstelle fuer Fehlerpfad Dfp_CTSCD" VAL_BLK 0xCC364 Kwb_Wu8 255.0 OneToOne 0.00 255.0 FORMAT "%5.1" NUMBER 4 /end CHARACTERISTIC
/begin CHARACTERISTIC DSM_TypDfp_Clg_DynTst_C "Konvertierung der Fehlertypen auf der Diagnoseschnittstelle fuer Fehlerpfad Dfp_Clg_DynTst" VAL_BLK 0xCC368 Kwb_Wu8 255.0 OneToOne 0.00 255.0 FORMAT "%5.1" NUMBER 4 /end CHARACTERISTIC
/begin CHARACTERISTIC DSM_TypDfp_CmbChbMisfire1_C "Konvertierung der Fehlertypen auf der Diagnoseschnittstelle fuer Fehlerpfad Dfp_CmbChbMisfire1" VAL_BLK 0xCC36C Kwb_Wu8 255.0 OneToOne 0.00 255.0 FORMAT "%5.1" NUMBER 4 /end CHARACTERISTIC
/begin CHARACTERISTIC DSM_TypDfp_CmbChbMisfire2_C "Konvertierung der Fehlertypen auf der Diagnoseschnittstelle fuer Fehlerpfad Dfp_CmbChbMisfire2" VAL_BLK 0xCC370 Kwb_Wu8 255.0 OneToOne 0.00 255.0 FORMAT "%5.1" NUMBER 4 /end CHARACTERISTIC
/begin CHARACTERISTIC DSM_TypDfp_CmbChbMisfire3_C "Konvertierung der Fehlertypen auf der Diagnoseschnittstelle fuer Fehlerpfad Dfp_CmbChbMisfire3" VAL_BLK 0xCC374 Kwb_Wu8 255.0 OneToOne 0.00 255.0 FORMAT "%5.1" NUMBER 4 /end CHARACTERISTIC
/begin CHARACTERISTIC DSM_TypDfp_CmbChbMisfire4_C "Konvertierung der Fehlertypen auf der Diagnoseschnittstelle fuer Fehlerpfad Dfp_CmbChbMisfire4" VAL_BLK 0xCC378 Kwb_Wu8 255.0 OneToOne 0.00 255.0 FORMAT "%5.1" NUMBER 4 /end CHARACTERISTIC
/begin CHARACTERISTIC DSM_TypDfp_CmbChbMisfire5_C "Konvertierung der Fehlertypen auf der Diagnoseschnittstelle fuer Fehlerpfad Dfp_CmbChbMisfire5" VAL_BLK 0xCC37C Kwb_Wu8 255.0 OneToOne 0.00 255.0 FORMAT "%5.1" NUMBER 4 /end CHARACTERISTIC
/begin CHARACTERISTIC DSM_TypDfp_CmbChbMisfire6_C "Konvertierung der Fehlertypen auf der Diagnoseschnittstelle fuer Fehlerpfad Dfp_CmbChbMisfire6" VAL_BLK 0xCC380 Kwb_Wu8 255.0 OneToOne 0.00 255.0 FORMAT "%5.1" NUMBER 4 /end CHARACTERISTIC
/begin CHARACTERISTIC DSM_TypDfp_CmbChbMisfireMul_C "Konvertierung der Fehlertypen auf der Diagnoseschnittstelle fuer Fehlerpfad Dfp_CmbChbMisfireMul" VAL_BLK 0xCC384 Kwb_Wu8 255.0 OneToOne 0.00 255.0 FORMAT "%5.1" NUMBER 4 /end CHARACTERISTIC
/begin CHARACTERISTIC DSM_TypDfp_CoVMDCSh_C "Konvertierung der Fehlertypen auf der Diagnoseschnittstelle fuer Fehlerpfad Dfp_CoVMDCSh" VAL_BLK 0xCC388 Kwb_Wu8 255.0 OneToOne 0.00 255.0 FORMAT "%5.1" NUMBER 4 /end CHARACTERISTIC
/begin CHARACTERISTIC DSM_TypDfp_ConvCD_C "Konvertierung der Fehlertypen auf der Diagnoseschnittstelle fuer Fehlerpfad Dfp_ConvCD" VAL_BLK 0xCC38C Kwb_Wu8 255.0 OneToOne 0.00 255.0 FORMAT "%5.1" NUMBER 4 /end CHARACTERISTIC
/begin CHARACTERISTIC DSM_TypDfp_CrCCDMFL_C "Konvertierung der Fehlertypen auf der Diagnoseschnittstelle fuer Fehlerpfad Dfp_CrCCDMFL" VAL_BLK 0xCC390 Kwb_Wu8 255.0 OneToOne 0.00 255.0 FORMAT "%5.1" NUMBER 4 /end CHARACTERISTIC
/begin CHARACTERISTIC DSM_TypDfp_CrCtl_vCrCtl_C "Konvertierung der Fehlertypen auf der Diagnoseschnittstelle fuer Fehlerpfad Dfp_CrCtl_vCrCtl" VAL_BLK 0xCC394 Kwb_Wu8 255.0 OneToOne 0.00 255.0 FORMAT "%5.1" NUMBER 4 /end CHARACTERISTIC
/begin CHARACTERISTIC DSM_TypDfp_Dummy1_C "Konvertierung der Fehlertypen auf der Diagnoseschnittstelle fuer Fehlerpfad Dfp_Dummy1" VAL_BLK 0xCC398 Kwb_Wu8 255.0 OneToOne 0.00 255.0 FORMAT "%5.1" NUMBER 4 /end CHARACTERISTIC
/begin CHARACTERISTIC DSM_TypDfp_EATSCD_C "Konvertierung der Fehlertypen auf der Diagnoseschnittstelle fuer Fehlerpfad Dfp_EATSCD" VAL_BLK 0xCC39C Kwb_Wu8 255.0 OneToOne 0.00 255.0 FORMAT "%5.1" NUMBER 4 /end CHARACTERISTIC
/begin CHARACTERISTIC DSM_TypDfp_EBAFCD_C "Konvertierung der Fehlertypen auf der Diagnoseschnittstelle fuer Fehlerpfad Dfp_EBAFCD" VAL_BLK 0xCC3A0 Kwb_Wu8 255.0 OneToOne 0.00 255.0 FORMAT "%5.1" NUMBER 4 /end CHARACTERISTIC
/begin CHARACTERISTIC DSM_TypDfp_EBFCD_C "Konvertierung der Fehlertypen auf der Diagnoseschnittstelle fuer Fehlerpfad Dfp_EBFCD" VAL_BLK 0xCC3A4 Kwb_Wu8 255.0 OneToOne 0.00 255.0 FORMAT "%5.1" NUMBER 4 /end CHARACTERISTIC
/begin CHARACTERISTIC DSM_TypDfp_EBTSCD_C "Konvertierung der Fehlertypen auf der Diagnoseschnittstelle fuer Fehlerpfad Dfp_EBTSCD" VAL_BLK 0xCC3A8 Kwb_Wu8 255.0 OneToOne 0.00 255.0 FORMAT "%5.1" NUMBER 4 /end CHARACTERISTIC
/begin CHARACTERISTIC DSM_TypDfp_EBTSCD_OvrTemp_C "Konvertierung der Fehlertypen auf der Diagnoseschnittstelle fuer Fehlerpfad Dfp_EBTSCD_OvrTemp" VAL_BLK 0xCC3AC Kwb_Wu8 255.0 OneToOne 0.00 255.0 FORMAT "%5.1" NUMBER 4 /end CHARACTERISTIC
/begin CHARACTERISTIC DSM_TypDfp_EEPCDVarMng_C "Konvertierung der Fehlertypen auf der Diagnoseschnittstelle fuer Fehlerpfad Dfp_EEPCDVarMng" VAL_BLK 0xCC3B0 Kwb_Wu8 255.0 OneToOne 0.00 255.0 FORMAT "%5.1" NUMBER 4 /end CHARACTERISTIC
/begin CHARACTERISTIC DSM_TypDfp_EGPpCD_C "Konvertierung der Fehlertypen auf der Diagnoseschnittstelle fuer Fehlerpfad Dfp_EGPpCD" VAL_BLK 0xCC3B4 Kwb_Wu8 255.0 OneToOne 0.00 255.0 FORMAT "%5.1" NUMBER 4 /end CHARACTERISTIC
/begin CHARACTERISTIC DSM_TypDfp_EGPpCDTPreTrbn_C "Konvertierung der Fehlertypen auf der Diagnoseschnittstelle fuer Fehlerpfad Dfp_EgPpCDTPreTrbn" VAL_BLK 0xCC3B8 Kwb_Wu8 255.0 OneToOne 0.00 255.0 FORMAT "%5.1" NUMBER 4 /end CHARACTERISTIC
/begin CHARACTERISTIC DSM_TypDfp_Layer_PMRUHVERL_C "" VAL_BLK 0xCC3BC Kwb_Wu8 255.0 OneToOne 0.00 255.0 FORMAT "%5.1" NUMBER 4 /end CHARACTERISTIC
/begin CHARACTERISTIC DSM_TypDfp_EGRCD_Max_C "Konvertierung der Fehlertypen auf der Diagnoseschnittstelle fuer Fehlerpfad Dfp_EGRCD_Max" VAL_BLK 0xCC3C0 Kwb_Wu8 255.0 OneToOne 0.00 255.0 FORMAT "%5.1" NUMBER 4 /end CHARACTERISTIC
/begin CHARACTERISTIC DSM_TypDfp_EGRCD_Min_C "Konvertierung der Fehlertypen auf der Diagnoseschnittstelle fuer Fehlerpfad Dfp_EGRCD_Min" VAL_BLK 0xCC3C4 Kwb_Wu8 255.0 OneToOne 0.00 255.0 FORMAT "%5.1" NUMBER 4 /end CHARACTERISTIC
/begin CHARACTERISTIC DSM_TypDfp_EGRCD_SigNpl_C "Konvertierung der Fehlertypen auf der Diagnoseschnittstelle fuer Fehlerpfad Dfp_EGRCD_SigNpl" VAL_BLK 0xCC3C8 Kwb_Wu8 255.0 OneToOne 0.00 255.0 FORMAT "%5.1" NUMBER 4 /end CHARACTERISTIC
/begin CHARACTERISTIC DSM_TypDfp_EGTRgnOilDil_C "Konvertierung der Fehlertypen auf der Diagnoseschnittstelle fuer Fehlerpfad Dfp_EGTRgnOilDil" VAL_BLK 0xCC3CC Kwb_Wu8 255.0 OneToOne 0.00 255.0 FORMAT "%5.1" NUMBER 4 /end CHARACTERISTIC
/begin CHARACTERISTIC DSM_TypDfp_Layer_TOENS_C "" VAL_BLK 0xCC3D0 Kwb_Wu8 255.0 OneToOne 0.00 255.0 FORMAT "%5.1" NUMBER 4 /end CHARACTERISTIC
/begin CHARACTERISTIC DSM_TypDfp_Layer_MANHYDR_C "" VAL_BLK 0xCC3D4 Kwb_Wu8 255.0 OneToOne 0.00 255.0 FORMAT "%5.1" NUMBER 4 /end CHARACTERISTIC
/begin CHARACTERISTIC DSM_TypDfp_Layer_MANLUFT_C "" VAL_BLK 0xCC3D8 Kwb_Wu8 255.0 OneToOne 0.00 255.0 FORMAT "%5.1" NUMBER 4 /end CHARACTERISTIC
/begin CHARACTERISTIC DSM_TypDfp_ETClbETFltInj1_C "Konvertierung der Fehlertypen auf der Diagnoseschnittstelle fuer Fehlerpfad Dfp_ETClbETFltInj1" VAL_BLK 0xCC3DC Kwb_Wu8 255.0 OneToOne 0.00 255.0 FORMAT "%5.1" NUMBER 4 /end CHARACTERISTIC
/begin CHARACTERISTIC DSM_TypDfp_ETClbETFltInj2_C "Konvertierung der Fehlertypen auf der Diagnoseschnittstelle fuer Fehlerpfad Dfp_ETClbETFltInj2" VAL_BLK 0xCC3E0 Kwb_Wu8 255.0 OneToOne 0.00 255.0 FORMAT "%5.1" NUMBER 4 /end CHARACTERISTIC
/begin CHARACTERISTIC DSM_TypDfp_ETClbETFltInj3_C "Konvertierung der Fehlertypen auf der Diagnoseschnittstelle fuer Fehlerpfad Dfp_ETClbETFltInj3" VAL_BLK 0xCC3E4 Kwb_Wu8 255.0 OneToOne 0.00 255.0 FORMAT "%5.1" NUMBER 4 /end CHARACTERISTIC
/begin CHARACTERISTIC DSM_TypDfp_ETClbETFltInj4_C "Konvertierung der Fehlertypen auf der Diagnoseschnittstelle fuer Fehlerpfad Dfp_ETClbETFltInj4" VAL_BLK 0xCC3E8 Kwb_Wu8 255.0 OneToOne 0.00 255.0 FORMAT "%5.1" NUMBER 4 /end CHARACTERISTIC
/begin CHARACTERISTIC DSM_TypDfp_ETClbETFltInj5_C "Konvertierung der Fehlertypen auf der Diagnoseschnittstelle fuer Fehlerpfad Dfp_ETClbETFltInj5" VAL_BLK 0xCC3EC Kwb_Wu8 255.0 OneToOne 0.00 255.0 FORMAT "%5.1" NUMBER 4 /end CHARACTERISTIC
/begin CHARACTERISTIC DSM_TypDfp_ETClbETFltInj6_C "Konvertierung der Fehlertypen auf der Diagnoseschnittstelle fuer Fehlerpfad Dfp_ETClbETFltInj6" VAL_BLK 0xCC3F0 Kwb_Wu8 255.0 OneToOne 0.00 255.0 FORMAT "%5.1" NUMBER 4 /end CHARACTERISTIC
/begin CHARACTERISTIC DSM_TypDfp_ETClbInj1_C "Konvertierung der Fehlertypen auf der Diagnoseschnittstelle fuer Fehlerpfad Dfp_ETClbInj1" VAL_BLK 0xCC3F4 Kwb_Wu8 255.0 OneToOne 0.00 255.0 FORMAT "%5.1" NUMBER 4 /end CHARACTERISTIC
/begin CHARACTERISTIC DSM_TypDfp_ETClbInj2_C "Konvertierung der Fehlertypen auf der Diagnoseschnittstelle fuer Fehlerpfad Dfp_ETClbInj2" VAL_BLK 0xCC3F8 Kwb_Wu8 255.0 OneToOne 0.00 255.0 FORMAT "%5.1" NUMBER 4 /end CHARACTERISTIC
/begin CHARACTERISTIC DSM_TypDfp_ETClbInj3_C "Konvertierung der Fehlertypen auf der Diagnoseschnittstelle fuer Fehlerpfad Dfp_ETClbInj3" VAL_BLK 0xCC3FC Kwb_Wu8 255.0 OneToOne 0.00 255.0 FORMAT "%5.1" NUMBER 4 /end CHARACTERISTIC
/begin CHARACTERISTIC DSM_TypDfp_ETClbInj4_C "Konvertierung der Fehlertypen auf der Diagnoseschnittstelle fuer Fehlerpfad Dfp_ETClbInj4" VAL_BLK 0xCC400 Kwb_Wu8 255.0 OneToOne 0.00 255.0 FORMAT "%5.1" NUMBER 4 /end CHARACTERISTIC
/begin CHARACTERISTIC DSM_TypDfp_ETClbInj5_C "Konvertierung der Fehlertypen auf der Diagnoseschnittstelle fuer Fehlerpfad Dfp_ETClbInj5" VAL_BLK 0xCC404 Kwb_Wu8 255.0 OneToOne 0.00 255.0 FORMAT "%5.1" NUMBER 4 /end CHARACTERISTIC
/begin CHARACTERISTIC DSM_TypDfp_ETClbInj6_C "Konvertierung der Fehlertypen auf der Diagnoseschnittstelle fuer Fehlerpfad Dfp_ETClbInj6" VAL_BLK 0xCC408 Kwb_Wu8 255.0 OneToOne 0.00 255.0 FORMAT "%5.1" NUMBER 4 /end CHARACTERISTIC
/begin CHARACTERISTIC DSM_TypDfp_EngMCaS1_C "Konvertierung der Fehlertypen auf der Diagnoseschnittstelle fuer Fehlerpfad Dfp_EngMCaS1" VAL_BLK 0xCC40C Kwb_Wu8 255.0 OneToOne 0.00 255.0 FORMAT "%5.1" NUMBER 4 /end CHARACTERISTIC
/begin CHARACTERISTIC DSM_TypDfp_EngMCrS1_C "Konvertierung der Fehlertypen auf der Diagnoseschnittstelle fuer Fehlerpfad Dfp_EngMCrS1" VAL_BLK 0xCC410 Kwb_Wu8 255.0 OneToOne 0.00 255.0 FORMAT "%5.1" NUMBER 4 /end CHARACTERISTIC
/begin CHARACTERISTIC DSM_TypDfp_EngMOfsCaSCrS_C "Konvertierung der Fehlertypen auf der Diagnoseschnittstelle fuer Fehlerpfad Dfp_EngMOfsCaSCrS" VAL_BLK 0xCC414 Kwb_Wu8 255.0 OneToOne 0.00 255.0 FORMAT "%5.1" NUMBER 4 /end CHARACTERISTIC
/begin CHARACTERISTIC DSM_TypDfp_EngMntCtl1_Dia1_C "" VAL_BLK 0xCC418 Kwb_Wu8 255.0 OneToOne 0.00 255.0 FORMAT "%5.1" NUMBER 4 /end CHARACTERISTIC
/begin CHARACTERISTIC DSM_TypDfp_EngMntCtl1_Dia2_C "" VAL_BLK 0xCC41C Kwb_Wu8 255.0 OneToOne 0.00 255.0 FORMAT "%5.1" NUMBER 4 /end CHARACTERISTIC
/begin CHARACTERISTIC DSM_TypDfp_EngMntCtl1_Dia3_C "" VAL_BLK 0xCC420 Kwb_Wu8 255.0 OneToOne 0.00 255.0 FORMAT "%5.1" NUMBER 4 /end CHARACTERISTIC
/begin CHARACTERISTIC DSM_TypDfp_EngMntCtl1_Max_C "" VAL_BLK 0xCC424 Kwb_Wu8 255.0 OneToOne 0.00 255.0 FORMAT "%5.1" NUMBER 4 /end CHARACTERISTIC
/begin CHARACTERISTIC DSM_TypDfp_EngMntCtl1_Min_C "" VAL_BLK 0xCC428 Kwb_Wu8 255.0 OneToOne 0.00 255.0 FORMAT "%5.1" NUMBER 4 /end CHARACTERISTIC
/begin CHARACTERISTIC DSM_TypDfp_EngMntCtl1_SigNpl_C "" VAL_BLK 0xCC42C Kwb_Wu8 255.0 OneToOne 0.00 255.0 FORMAT "%5.1" NUMBER 4 /end CHARACTERISTIC
/begin CHARACTERISTIC DSM_TypDfp_EngMntCtlCD_C "Konvertierung der Fehlertypen auf der Diagnoseschnittstelle fuer Fehlerpfad Dfp_EngMntCtlCD" VAL_BLK 0xCC430 Kwb_Wu8 255.0 OneToOne 0.00 255.0 FORMAT "%5.1" NUMBER 4 /end CHARACTERISTIC
/begin CHARACTERISTIC DSM_TypDfp_EngMntCtl_Dia1_C "" VAL_BLK 0xCC434 Kwb_Wu8 255.0 OneToOne 0.00 255.0 FORMAT "%5.1" NUMBER 4 /end CHARACTERISTIC
/begin CHARACTERISTIC DSM_TypDfp_EngMntCtl_Dia2_C "" VAL_BLK 0xCC438 Kwb_Wu8 255.0 OneToOne 0.00 255.0 FORMAT "%5.1" NUMBER 4 /end CHARACTERISTIC
/begin CHARACTERISTIC DSM_TypDfp_EngMntCtl_Dia3_C "" VAL_BLK 0xCC43C Kwb_Wu8 255.0 OneToOne 0.00 255.0 FORMAT "%5.1" NUMBER 4 /end CHARACTERISTIC
/begin CHARACTERISTIC DSM_TypDfp_EngMntCtl_Max_C "" VAL_BLK 0xCC440 Kwb_Wu8 255.0 OneToOne 0.00 255.0 FORMAT "%5.1" NUMBER 4 /end CHARACTERISTIC
/begin CHARACTERISTIC DSM_TypDfp_EngMntCtl_Min_C "" VAL_BLK 0xCC444 Kwb_Wu8 255.0 OneToOne 0.00 255.0 FORMAT "%5.1" NUMBER 4 /end CHARACTERISTIC
/begin CHARACTERISTIC DSM_TypDfp_EngMntCtl_SigNpl_C "" VAL_BLK 0xCC448 Kwb_Wu8 255.0 OneToOne 0.00 255.0 FORMAT "%5.1" NUMBER 4 /end CHARACTERISTIC
/begin CHARACTERISTIC DSM_TypDfp_EngPrtFWODet_C "Konvertierung der Fehlertypen auf der Diagnoseschnittstelle fuer Fehlerpfad Dfp_EngPrtFWODet" VAL_BLK 0xCC44C Kwb_Wu8 255.0 OneToOne 0.00 255.0 FORMAT "%5.1" NUMBER 4 /end CHARACTERISTIC
/begin CHARACTERISTIC DSM_TypDfp_FBCqDvt_C "Konvertierung der Fehlertypen auf der Diagnoseschnittstelle fuer Fehlerpfad Dfp_FBCqDvt" VAL_BLK 0xCC450 Kwb_Wu8 255.0 OneToOne 0.00 255.0 FORMAT "%5.1" NUMBER 4 /end CHARACTERISTIC
/begin CHARACTERISTIC DSM_TypDfp_FMTC_NonMonotonMap_C "Konvertierung der Fehlertypen auf der Diagnoseschnittstelle fuer Fehlerpfad Dfp_FMTC_NonMonotonMap" VAL_BLK 0xCC454 Kwb_Wu8 255.0 OneToOne 0.00 255.0 FORMAT "%5.1" NUMBER 4 /end CHARACTERISTIC
/begin CHARACTERISTIC DSM_TypDfp_FTSCD_C "Konvertierung der Fehlertypen auf der Diagnoseschnittstelle fuer Fehlerpfad Dfp_FTSCD" VAL_BLK 0xCC458 Kwb_Wu8 255.0 OneToOne 0.00 255.0 FORMAT "%5.1" NUMBER 4 /end CHARACTERISTIC
/begin CHARACTERISTIC DSM_TypDfp_FanCD_C "Konvertierung der Fehlertypen auf der Diagnoseschnittstelle fuer Fehlerpfad Dfp_FanCD" VAL_BLK 0xCC45C Kwb_Wu8 255.0 OneToOne 0.00 255.0 FORMAT "%5.1" NUMBER 4 /end CHARACTERISTIC
/begin CHARACTERISTIC DSM_TypDfp_FanCD_FanCtlr1_C "Konvertierung der Fehlertypen auf der Diagnoseschnittstelle fuer Fehlerpfad Dfp_FanCD_FanCtlr1" VAL_BLK 0xCC460 Kwb_Wu8 255.0 OneToOne 0.00 255.0 FORMAT "%5.1" NUMBER 4 /end CHARACTERISTIC
/begin CHARACTERISTIC DSM_TypDfp_FanCD_FanCtlr2_C "Konvertierung der Fehlertypen auf der Diagnoseschnittstelle fuer Fehlerpfad Dfp_FanCD_FanCtlr2" VAL_BLK 0xCC464 Kwb_Wu8 255.0 OneToOne 0.00 255.0 FORMAT "%5.1" NUMBER 4 /end CHARACTERISTIC
/begin CHARACTERISTIC DSM_TypDfp_FanCD_FanCtlr3_C "Konvertierung der Fehlertypen auf der Diagnoseschnittstelle fuer Fehlerpfad Dfp_FanCD_FanCtlr3" VAL_BLK 0xCC468 Kwb_Wu8 255.0 OneToOne 0.00 255.0 FORMAT "%5.1" NUMBER 4 /end CHARACTERISTIC
/begin CHARACTERISTIC DSM_TypDfp_FlFCD_C "Konvertierung der Fehlertypen auf der Diagnoseschnittstelle fuer Fehlerpfad Dfp_FlFCD" VAL_BLK 0xCC46C Kwb_Wu8 255.0 OneToOne 0.00 255.0 FORMAT "%5.1" NUMBER 4 /end CHARACTERISTIC
/begin CHARACTERISTIC DSM_TypDfp_FlMngSmkDefect_C "Konvertierung der Fehlertypen auf der Diagnoseschnittstelle fuer Fehlerpfad Dfp_FlMngSmkDefect" VAL_BLK 0xCC470 Kwb_Wu8 255.0 OneToOne 0.00 255.0 FORMAT "%5.1" NUMBER 4 /end CHARACTERISTIC
/begin CHARACTERISTIC DSM_TypDfp_FrmMngBOS_RESET_C "Konvertierung der Fehlertypen auf der Diagnoseschnittstelle fuer Fehlerpfad Dfp_FrmMngBOS_RESET" VAL_BLK 0xCC474 Kwb_Wu8 255.0 OneToOne 0.00 255.0 FORMAT "%5.1" NUMBER 4 /end CHARACTERISTIC
/begin CHARACTERISTIC DSM_TypDfp_FrmMngBOS_RESET_2_C "" VAL_BLK 0xCC478 Kwb_Wu8 255.0 OneToOne 0.00 255.0 FORMAT "%5.1" NUMBER 4 /end CHARACTERISTIC
/begin CHARACTERISTIC DSM_TypDfp_FrmMngDMANFAFS_C "Konvertierung der Fehlertypen auf der Diagnoseschnittstelle fuer Fehlerpfad Dfp_FrmMngDMANFAFS" VAL_BLK 0xCC47C Kwb_Wu8 255.0 OneToOne 0.00 255.0 FORMAT "%5.1" NUMBER 4 /end CHARACTERISTIC
/begin CHARACTERISTIC DSM_TypDfp_FrmMngDRMANFSSG_C "Konvertierung der Fehlertypen auf der Diagnoseschnittstelle fuer Fehlerpfad Dfp_FrmMngDRMANFSSG" VAL_BLK 0xCC480 Kwb_Wu8 255.0 OneToOne 0.00 255.0 FORMAT "%5.1" NUMBER 4 /end CHARACTERISTIC
/begin CHARACTERISTIC DSM_TypDfp_FrmMngGEARBX_DATA_C "type for faults in path" VAL_BLK 0xCC484 Kwb_Wu8 255.0 OneToOne 0.00 255.0 FORMAT "%5.1" NUMBER 4 /end CHARACTERISTIC
/begin CHARACTERISTIC DSM_TypDfp_FrmMngGEARBX_DATA2_C "Konvertierung der Fehlertypen auf der Diagnoseschnittstelle fuer Fehlerpfad Dfp_FrmMngGEARBX_DATA2" VAL_BLK 0xCC488 Kwb_Wu8 255.0 OneToOne 0.00 255.0 FORMAT "%5.1" NUMBER 4 /end CHARACTERISTIC
/begin CHARACTERISTIC DSM_TypDfp_FrmMngHEAT_AC_C "type for faults in path" VAL_BLK 0xCC48C Kwb_Wu8 255.0 OneToOne 0.00 255.0 FORMAT "%5.1" NUMBER 4 /end CHARACTERISTIC
/begin CHARACTERISTIC DSM_TypDfp_FrmMngLENKRADWINKEL_C "Konvertierung der Fehlertypen auf der Diagnoseschnittstelle fuer Fehlerpfad Dfp_FrmMngLENKRADWINKEL" VAL_BLK 0xCC490 Kwb_Wu8 255.0 OneToOne 0.00 255.0 FORMAT "%5.1" NUMBER 4 /end CHARACTERISTIC
/begin CHARACTERISTIC DSM_TypDfp_FrmMngMILEAGE_RANGE_C "Konvertierung der Fehlertypen auf der Diagnoseschnittstelle fuer Fehlerpfad Dfp_FrmMngMILEAGE_RANGE" VAL_BLK 0xCC494 Kwb_Wu8 255.0 OneToOne 0.00 255.0 FORMAT "%5.1" NUMBER 4 /end CHARACTERISTIC
/begin CHARACTERISTIC DSM_TypDfp_FrmMngOPCRCTLACC_C "Konvertierung der Fehlertypen auf der Diagnoseschnittstelle fuer Fehlerpfad Dfp_FrmMngOPCRCTLACC" VAL_BLK 0xCC498 Kwb_Wu8 255.0 OneToOne 0.00 255.0 FORMAT "%5.1" NUMBER 4 /end CHARACTERISTIC
/begin CHARACTERISTIC DSM_TypDfp_FrmMngPRGG_CCTR_C "Konvertierung der Fehlertypen auf der Diagnoseschnittstelle fuer Fehlerpfad Dfp_FrmMngPRGG_CCTR" VAL_BLK 0xCC49C Kwb_Wu8 255.0 OneToOne 0.00 255.0 FORMAT "%5.1" NUMBER 4 /end CHARACTERISTIC
/begin CHARACTERISTIC DSM_TypDfp_FrmMngPWRMNG_LOADV_C "Konvertierung der Fehlertypen auf der Diagnoseschnittstelle fuer Fehlerpfad Dfp_FrmMngPWRMNG_LOADV" VAL_BLK 0xCC4A0 Kwb_Wu8 255.0 OneToOne 0.00 255.0 FORMAT "%5.1" NUMBER 4 /end CHARACTERISTIC
/begin CHARACTERISTIC DSM_TypDfp_FrmMngParkConsumer_C "Konvertierung der Fehlertypen auf der Diagnoseschnittstelle fuer Fehlerpfad Dfp_FrmMngParkConsumer" VAL_BLK 0xCC4A4 Kwb_Wu8 255.0 OneToOne 0.00 255.0 FORMAT "%5.1" NUMBER 4 /end CHARACTERISTIC
/begin CHARACTERISTIC DSM_TypDfp_FrmMngRQSTGEFAN_C "RQ_STG_EFAN - CAN-message related errors" VAL_BLK 0xCC4A8 Kwb_Wu8 255.0 OneToOne 0.00 255.0 FORMAT "%5.1" NUMBER 4 /end CHARACTERISTIC
/begin CHARACTERISTIC DSM_TypDfp_FrmMngSSGErr_C "Konvertierung der Fehlertypen auf der Diagnoseschnittstelle fuer Fehlerpfad Dfp_FrmMngSSGErr" VAL_BLK 0xCC4AC Kwb_Wu8 255.0 OneToOne 0.00 255.0 FORMAT "%5.1" NUMBER 4 /end CHARACTERISTIC
/begin CHARACTERISTIC DSM_TypDfp_FrmMngSSGShOff_C "Konvertierung der Fehlertypen auf der Diagnoseschnittstelle fuer Fehlerpfad Dfp_FrmMngSSGShOff" VAL_BLK 0xCC4B0 Kwb_Wu8 255.0 OneToOne 0.00 255.0 FORMAT "%5.1" NUMBER 4 /end CHARACTERISTIC
/begin CHARACTERISTIC DSM_TypDfp_FrmMngSTAT_ANH_C "Konvertierung der Fehlertypen auf der Diagnoseschnittstelle fuer Fehlerpfad Dfp_FrmMngSTAT_ANH" VAL_BLK 0xCC4B4 Kwb_Wu8 255.0 OneToOne 0.00 255.0 FORMAT "%5.1" NUMBER 4 /end CHARACTERISTIC
/begin CHARACTERISTIC DSM_TypDfp_FrmMngSTAT_ARS_C "type for faults in path" VAL_BLK 0xCC4B8 Kwb_Wu8 255.0 OneToOne 0.00 255.0 FORMAT "%5.1" NUMBER 4 /end CHARACTERISTIC
/begin CHARACTERISTIC DSM_TypDfp_FrmMngSTAT_DSC_C "type for faults in path" VAL_BLK 0xCC4BC Kwb_Wu8 255.0 OneToOne 0.00 255.0 FORMAT "%5.1" NUMBER 4 /end CHARACTERISTIC
/begin CHARACTERISTIC DSM_TypDfp_FrmMngSTAT_EKP_C "Konvertierung der Fehlertypen auf der Diagnoseschnittstelle fuer Fehlerpfad Dfp_FrmMngSTAT_EKP" VAL_BLK 0xCC4C0 Kwb_Wu8 255.0 OneToOne 0.00 255.0 FORMAT "%5.1" NUMBER 4 /end CHARACTERISTIC
/begin CHARACTERISTIC DSM_TypDfp_FrmMngSTAT_KOMBI_C "Konvertierung der Fehlertypen auf der Diagnoseschnittstelle fuer Fehlerpfad Dfp_FrmMngSTAT_KOMBI" VAL_BLK 0xCC4C4 Kwb_Wu8 255.0 OneToOne 0.00 255.0 FORMAT "%5.1" NUMBER 4 /end CHARACTERISTIC
/begin CHARACTERISTIC DSM_TypDfp_FrmMngSTAT_SITZ_C "Konvertierung der Fehlertypen auf der Diagnoseschnittstelle fuer Fehlerpfad Dfp_FrmMngSTAT_SITZ" VAL_BLK 0xCC4C8 Kwb_Wu8 255.0 OneToOne 0.00 255.0 FORMAT "%5.1" NUMBER 4 /end CHARACTERISTIC
/begin CHARACTERISTIC DSM_TypDfp_FrmMngStOBDGbxMilOf_C "Konvertierung der Fehlertypen auf der Diagnoseschnittstelle fuer Fehlerpfad Dfp_FrmMngStOBDGbxMilOf" VAL_BLK 0xCC4CC Kwb_Wu8 255.0 OneToOne 0.00 255.0 FORMAT "%5.1" NUMBER 4 /end CHARACTERISTIC
/begin CHARACTERISTIC DSM_TypDfp_FrmMngStOBDGbxMilOn_C "Konvertierung der Fehlertypen auf der Diagnoseschnittstelle fuer Fehlerpfad Dfp_FrmMngStOBDGbxMilOn" VAL_BLK 0xCC4D0 Kwb_Wu8 255.0 OneToOne 0.00 255.0 FORMAT "%5.1" NUMBER 4 /end CHARACTERISTIC
/begin CHARACTERISTIC DSM_TypDfp_FrmMngTEMPRELTIME_C "Konvertierung der Fehlertypen auf der Diagnoseschnittstelle fuer Fehlerpfad Dfp_FrmMngTEMPRELTIME" VAL_BLK 0xCC4D4 Kwb_Wu8 255.0 OneToOne 0.00 255.0 FORMAT "%5.1" NUMBER 4 /end CHARACTERISTIC
/begin CHARACTERISTIC DSM_TypDfp_FrmMngTERMINAL_C "type for faults in path" VAL_BLK 0xCC4D8 Kwb_Wu8 255.0 OneToOne 0.00 255.0 FORMAT "%5.1" NUMBER 4 /end CHARACTERISTIC
/begin CHARACTERISTIC DSM_TypDfp_FrmMngTIME_DATE_C "Konvertierung der Fehlertypen auf der Diagnoseschnittstelle fuer Fehlerpfad Dfp_FrmMngTIME_DATE" VAL_BLK 0xCC4DC Kwb_Wu8 255.0 OneToOne 0.00 255.0 FORMAT "%5.1" NUMBER 4 /end CHARACTERISTIC
/begin CHARACTERISTIC DSM_TypDfp_FrmMngTORQUE_DSC_C "type for faults in path" VAL_BLK 0xCC4E0 Kwb_Wu8 255.0 OneToOne 0.00 255.0 FORMAT "%5.1" NUMBER 4 /end CHARACTERISTIC
/begin CHARACTERISTIC DSM_TypDfp_FrmMngTORQUE_GEARBX_C "type for faults in path" VAL_BLK 0xCC4E4 Kwb_Wu8 255.0 OneToOne 0.00 255.0 FORMAT "%5.1" NUMBER 4 /end CHARACTERISTIC
/begin CHARACTERISTIC DSM_TypDfp_FrmMngTrq_ReqACC_C "Konvertierung der Fehlertypen auf der Diagnoseschnittstelle fuer Fehlerpfad Dfp_FrmMngTrq_ReqACC" VAL_BLK 0xCC4E8 Kwb_Wu8 255.0 OneToOne 0.00 255.0 FORMAT "%5.1" NUMBER 4 /end CHARACTERISTIC
/begin CHARACTERISTIC DSM_TypDfp_FrmMngVEH_MOD_C "VEH_MOD - CAN-message related errors" VAL_BLK 0xCC4EC Kwb_Wu8 255.0 OneToOne 0.00 255.0 FORMAT "%5.1" NUMBER 4 /end CHARACTERISTIC
/begin CHARACTERISTIC DSM_TypDfp_FrmMngVELOCITY_C "type for faults in path" VAL_BLK 0xCC4F0 Kwb_Wu8 255.0 OneToOne 0.00 255.0 FORMAT "%5.1" NUMBER 4 /end CHARACTERISTIC
/begin CHARACTERISTIC DSM_TypDfp_FrmMngWHEEL_SPEED_C "Konvertierung der Fehlertypen auf der Diagnoseschnittstelle fuer Fehlerpfad Dfp_FrmMngWHEEL_SPEED" VAL_BLK 0xCC4F4 Kwb_Wu8 255.0 OneToOne 0.00 255.0 FORMAT "%5.1" NUMBER 4 /end CHARACTERISTIC
/begin CHARACTERISTIC DSM_TypDfp_FrmMngstCurr_C "Fehlertyp Feld für Dfp_FrmMngstCurr" VAL_BLK 0xCC4F8 Kwb_Wu8 255.0 OneToOne 0.00 255.0 FORMAT "%5.1" NUMBER 4 /end CHARACTERISTIC
/begin CHARACTERISTIC DSM_TypDfp_FrmMngswtPSPOff_C "Fehlertyp Feld für Dfp_FrmMngswtPSPOff" VAL_BLK 0xCC4FC Kwb_Wu8 255.0 OneToOne 0.00 255.0 FORMAT "%5.1" NUMBER 4 /end CHARACTERISTIC
/begin CHARACTERISTIC DSM_TypDfp_GearbxIncMax_C "Konvertierung der Fehlertypen auf der Diagnoseschnittstelle fuer Fehlerpfad Dfp_GearbxIncMax" VAL_BLK 0xCC500 Kwb_Wu8 255.0 OneToOne 0.00 255.0 FORMAT "%5.1" NUMBER 4 /end CHARACTERISTIC
/begin CHARACTERISTIC DSM_TypDfp_GlwCD_C "Konvertierung der Fehlertypen auf der Diagnoseschnittstelle fuer Fehlerpfad Dfp_GlwCD" VAL_BLK 0xCC504 Kwb_Wu8 255.0 OneToOne 0.00 255.0 FORMAT "%5.1" NUMBER 4 /end CHARACTERISTIC
/begin CHARACTERISTIC DSM_TypDfp_GlwCDGlwCirc1_C "Konvertierung der Fehlertypen auf der Diagnoseschnittstelle fuer Fehlerpfad Dfp_GlwCDGlwCirc1" VAL_BLK 0xCC508 Kwb_Wu8 255.0 OneToOne 0.00 255.0 FORMAT "%5.1" NUMBER 4 /end CHARACTERISTIC
/begin CHARACTERISTIC DSM_TypDfp_GlwCDGlwCirc2_C "Konvertierung der Fehlertypen auf der Diagnoseschnittstelle fuer Fehlerpfad Dfp_GlwCDGlwCirc2" VAL_BLK 0xCC50C Kwb_Wu8 255.0 OneToOne 0.00 255.0 FORMAT "%5.1" NUMBER 4 /end CHARACTERISTIC
/begin CHARACTERISTIC DSM_TypDfp_GlwCDGlwCirc3_C "Konvertierung der Fehlertypen auf der Diagnoseschnittstelle fuer Fehlerpfad Dfp_GlwCDGlwCirc3" VAL_BLK 0xCC510 Kwb_Wu8 255.0 OneToOne 0.00 255.0 FORMAT "%5.1" NUMBER 4 /end CHARACTERISTIC
/begin CHARACTERISTIC DSM_TypDfp_GlwCDGlwCirc4_C "Konvertierung der Fehlertypen auf der Diagnoseschnittstelle fuer Fehlerpfad Dfp_GlwCDGlwCirc4" VAL_BLK 0xCC514 Kwb_Wu8 255.0 OneToOne 0.00 255.0 FORMAT "%5.1" NUMBER 4 /end CHARACTERISTIC
/begin CHARACTERISTIC DSM_TypDfp_GlwCDGlwCirc5_C "Konvertierung der Fehlertypen auf der Diagnoseschnittstelle fuer Fehlerpfad Dfp_GlwCDGlwCirc5" VAL_BLK 0xCC518 Kwb_Wu8 255.0 OneToOne 0.00 255.0 FORMAT "%5.1" NUMBER 4 /end CHARACTERISTIC
/begin CHARACTERISTIC DSM_TypDfp_GlwCDGlwCirc6_C "Konvertierung der Fehlertypen auf der Diagnoseschnittstelle fuer Fehlerpfad Dfp_GlwCDGlwCirc6" VAL_BLK 0xCC51C Kwb_Wu8 255.0 OneToOne 0.00 255.0 FORMAT "%5.1" NUMBER 4 /end CHARACTERISTIC
/begin CHARACTERISTIC DSM_TypDfp_GlwCDGlwCirc7_C "Konvertierung der Fehlertypen auf der Diagnoseschnittstelle fuer Fehlerpfad Dfp_GlwCDGlwCirc7" VAL_BLK 0xCC520 Kwb_Wu8 255.0 OneToOne 0.00 255.0 FORMAT "%5.1" NUMBER 4 /end CHARACTERISTIC
/begin CHARACTERISTIC DSM_TypDfp_GlwCDGlwCirc8_C "Konvertierung der Fehlertypen auf der Diagnoseschnittstelle fuer Fehlerpfad Dfp_GlwCDGlwCirc8" VAL_BLK 0xCC524 Kwb_Wu8 255.0 OneToOne 0.00 255.0 FORMAT "%5.1" NUMBER 4 /end CHARACTERISTIC
/begin CHARACTERISTIC DSM_TypDfp_GlwCtl_C "Konvertierung der Fehlertypen auf der Diagnoseschnittstelle fuer Fehlerpfad Dfp_GlwCtl" VAL_BLK 0xCC528 Kwb_Wu8 255.0 OneToOne 0.00 255.0 FORMAT "%5.1" NUMBER 4 /end CHARACTERISTIC
/begin CHARACTERISTIC DSM_TypDfp_HWEMonCom_C "Konvertierung der Fehlertypen auf der Diagnoseschnittstelle fuer Fehlerpfad Dfp_HWEMonCom" VAL_BLK 0xCC52C Kwb_Wu8 255.0 OneToOne 0.00 255.0 FORMAT "%5.1" NUMBER 4 /end CHARACTERISTIC
/begin CHARACTERISTIC DSM_TypDfp_HWEMonEEPROM_C "Konvertierung der Fehlertypen auf der Diagnoseschnittstelle fuer Fehlerpfad Dfp_HWEMonEEPROM" VAL_BLK 0xCC530 Kwb_Wu8 255.0 OneToOne 0.00 255.0 FORMAT "%5.1" NUMBER 4 /end CHARACTERISTIC
/begin CHARACTERISTIC DSM_TypDfp_HWEMonRcyLocked_C "Konvertierung der Fehlertypen auf der Diagnoseschnittstelle fuer Fehlerpfad Dfp_HWEMonRcyLocked" VAL_BLK 0xCC534 Kwb_Wu8 255.0 OneToOne 0.00 255.0 FORMAT "%5.1" NUMBER 4 /end CHARACTERISTIC
/begin CHARACTERISTIC DSM_TypDfp_HWEMonRcySuppressed_C "Konvertierung der Fehlertypen auf der Diagnoseschnittstelle fuer Fehlerpfad Dfp_HWEMonRcySuppressed" VAL_BLK 0xCC538 Kwb_Wu8 255.0 OneToOne 0.00 255.0 FORMAT "%5.1" NUMBER 4 /end CHARACTERISTIC
/begin CHARACTERISTIC DSM_TypDfp_HWEMonRcyVisible_C "Konvertierung der Fehlertypen auf der Diagnoseschnittstelle fuer Fehlerpfad Dfp_HWEMonRcyVisible" VAL_BLK 0xCC53C Kwb_Wu8 255.0 OneToOne 0.00 255.0 FORMAT "%5.1" NUMBER 4 /end CHARACTERISTIC
/begin CHARACTERISTIC DSM_TypDfp_HWEMonUMaxSupply_C "Konvertierung der Fehlertypen auf der Diagnoseschnittstelle fuer Fehlerpfad Dfp_HWEMonUMaxSupply" VAL_BLK 0xCC540 Kwb_Wu8 255.0 OneToOne 0.00 255.0 FORMAT "%5.1" NUMBER 4 /end CHARACTERISTIC
/begin CHARACTERISTIC DSM_TypDfp_HWEMonUMinSupply_C "Konvertierung der Fehlertypen auf der Diagnoseschnittstelle fuer Fehlerpfad Dfp_HWEMonUMinSupply" VAL_BLK 0xCC544 Kwb_Wu8 255.0 OneToOne 0.00 255.0 FORMAT "%5.1" NUMBER 4 /end CHARACTERISTIC
/begin CHARACTERISTIC DSM_TypDfp_IATSCD_C "Konvertierung der Fehlertypen auf der Diagnoseschnittstelle fuer Fehlerpfad Dfp_IATSCD" VAL_BLK 0xCC548 Kwb_Wu8 255.0 OneToOne 0.00 255.0 FORMAT "%5.1" NUMBER 4 /end CHARACTERISTIC
/begin CHARACTERISTIC DSM_TypDfp_IATSCD_CATS_C "Konvertierung der Fehlertypen auf der Diagnoseschnittstelle fuer Fehlerpfad Dfp_IATSCD_CATS" VAL_BLK 0xCC54C Kwb_Wu8 255.0 OneToOne 0.00 255.0 FORMAT "%5.1" NUMBER 4 /end CHARACTERISTIC
/begin CHARACTERISTIC DSM_TypDfp_ImmCtlImmCD_C "Konvertierung der Fehlertypen auf der Diagnoseschnittstelle fuer Fehlerpfad Dfp_ImmCtlImmCD" VAL_BLK 0xCC550 Kwb_Wu8 255.0 OneToOne 0.00 255.0 FORMAT "%5.1" NUMBER 4 /end CHARACTERISTIC
/begin CHARACTERISTIC DSM_TypDfp_ImmCtlImmEep_C "Konvertierung der Fehlertypen auf der Diagnoseschnittstelle fuer Fehlerpfad Dfp_ImmCtlImmEep" VAL_BLK 0xCC554 Kwb_Wu8 255.0 OneToOne 0.00 255.0 FORMAT "%5.1" NUMBER 4 /end CHARACTERISTIC
/begin CHARACTERISTIC DSM_TypDfp_ImmCtlMpl_C "Konvertierung der Fehlertypen auf der Diagnoseschnittstelle fuer Fehlerpfad Dfp_ImmCtlMpl" VAL_BLK 0xCC558 Kwb_Wu8 255.0 OneToOne 0.00 255.0 FORMAT "%5.1" NUMBER 4 /end CHARACTERISTIC
/begin CHARACTERISTIC DSM_TypDfp_IndSys1_C "Konvertierung der Fehlertypen auf der Diagnoseschnittstelle fuer Fehlerpfad Dfp_IndSys1" VAL_BLK 0xCC55C Kwb_Wu8 255.0 OneToOne 0.00 255.0 FORMAT "%5.1" NUMBER 4 /end CHARACTERISTIC
/begin CHARACTERISTIC DSM_TypDfp_IndSys2_C "Konvertierung der Fehlertypen auf der Diagnoseschnittstelle fuer Fehlerpfad Dfp_IndSys2" VAL_BLK 0xCC560 Kwb_Wu8 255.0 OneToOne 0.00 255.0 FORMAT "%5.1" NUMBER 4 /end CHARACTERISTIC
/begin CHARACTERISTIC DSM_TypDfp_InjCrv_InjLim_C "Konvertierung der Fehlertypen auf der Diagnoseschnittstelle fuer Fehlerpfad Dfp_InjCrv_InjLim" VAL_BLK 0xCC564 Kwb_Wu8 255.0 OneToOne 0.00 255.0 FORMAT "%5.1" NUMBER 4 /end CHARACTERISTIC
/begin CHARACTERISTIC DSM_TypDfp_InjCtlAdjQnt_C "Konvertierung der Fehlertypen auf der Diagnoseschnittstelle fuer Fehlerpfad Dfp_InjCtlAdjQnt" VAL_BLK 0xCC568 Kwb_Wu8 255.0 OneToOne 0.00 255.0 FORMAT "%5.1" NUMBER 4 /end CHARACTERISTIC
/begin CHARACTERISTIC DSM_TypDfp_InjCtlDrift_C "Konvertierung der Fehlertypen auf der Diagnoseschnittstelle fuer Fehlerpfad Dfp_InjCtlDrift" VAL_BLK 0xCC56C Kwb_Wu8 255.0 OneToOne 0.00 255.0 FORMAT "%5.1" NUMBER 4 /end CHARACTERISTIC
/begin CHARACTERISTIC DSM_TypDfp_InjVCDActrChrg_C "Konvertierung der Fehlertypen auf der Diagnoseschnittstelle fuer Fehlerpfad Dfp_InjVCDActrChrg" VAL_BLK 0xCC570 Kwb_Wu8 255.0 OneToOne 0.00 255.0 FORMAT "%5.1" NUMBER 4 /end CHARACTERISTIC
/begin CHARACTERISTIC DSM_TypDfp_InjVCDActrEnrg1_C "Konvertierung der Fehlertypen auf der Diagnoseschnittstelle fuer Fehlerpfad Dfp_InjVCDActrEnrg1" VAL_BLK 0xCC574 Kwb_Wu8 255.0 OneToOne 0.00 255.0 FORMAT "%5.1" NUMBER 4 /end CHARACTERISTIC
/begin CHARACTERISTIC DSM_TypDfp_InjVCDActrEnrg2_C "Konvertierung der Fehlertypen auf der Diagnoseschnittstelle fuer Fehlerpfad Dfp_InjVCDActrEnrg2" VAL_BLK 0xCC578 Kwb_Wu8 255.0 OneToOne 0.00 255.0 FORMAT "%5.1" NUMBER 4 /end CHARACTERISTIC
/begin CHARACTERISTIC DSM_TypDfp_InjVCDActrEnrg3_C "Konvertierung der Fehlertypen auf der Diagnoseschnittstelle fuer Fehlerpfad Dfp_InjVCDActrEnrg3" VAL_BLK 0xCC57C Kwb_Wu8 255.0 OneToOne 0.00 255.0 FORMAT "%5.1" NUMBER 4 /end CHARACTERISTIC
/begin CHARACTERISTIC DSM_TypDfp_InjVCDActrEnrg4_C "Konvertierung der Fehlertypen auf der Diagnoseschnittstelle fuer Fehlerpfad Dfp_InjVCDActrEnrg4" VAL_BLK 0xCC580 Kwb_Wu8 255.0 OneToOne 0.00 255.0 FORMAT "%5.1" NUMBER 4 /end CHARACTERISTIC
/begin CHARACTERISTIC DSM_TypDfp_InjVCDActrEnrg5_C "Konvertierung der Fehlertypen auf der Diagnoseschnittstelle fuer Fehlerpfad Dfp_InjVCDActrEnrg5" VAL_BLK 0xCC584 Kwb_Wu8 255.0 OneToOne 0.00 255.0 FORMAT "%5.1" NUMBER 4 /end CHARACTERISTIC
/begin CHARACTERISTIC DSM_TypDfp_InjVCDActrEnrg6_C "Konvertierung der Fehlertypen auf der Diagnoseschnittstelle fuer Fehlerpfad Dfp_InjVCDActrEnrg6" VAL_BLK 0xCC588 Kwb_Wu8 255.0 OneToOne 0.00 255.0 FORMAT "%5.1" NUMBER 4 /end CHARACTERISTIC
/begin CHARACTERISTIC DSM_TypDfp_InjVCDActrEnrg7_C "Konvertierung der Fehlertypen auf der Diagnoseschnittstelle fuer Fehlerpfad Dfp_InjVCDActrEnrg7" VAL_BLK 0xCC58C Kwb_Wu8 255.0 OneToOne 0.00 255.0 FORMAT "%5.1" NUMBER 4 /end CHARACTERISTIC
/begin CHARACTERISTIC DSM_TypDfp_InjVCDActrEnrg8_C "Konvertierung der Fehlertypen auf der Diagnoseschnittstelle fuer Fehlerpfad Dfp_InjVCDActrEnrg8" VAL_BLK 0xCC590 Kwb_Wu8 255.0 OneToOne 0.00 255.0 FORMAT "%5.1" NUMBER 4 /end CHARACTERISTIC
/begin CHARACTERISTIC DSM_TypDfp_InjVCDActrVolt_C "Konvertierung der Fehlertypen auf der Diagnoseschnittstelle fuer Fehlerpfad Dfp_InjVCDActrVolt" VAL_BLK 0xCC594 Kwb_Wu8 255.0 OneToOne 0.00 255.0 FORMAT "%5.1" NUMBER 4 /end CHARACTERISTIC
/begin CHARACTERISTIC DSM_TypDfp_InjVCDClsBank1_C "Konvertierung der Fehlertypen auf der Diagnoseschnittstelle fuer Fehlerpfad Dfp_InjVCDClsBank1" VAL_BLK 0xCC598 Kwb_Wu8 255.0 OneToOne 0.00 255.0 FORMAT "%5.1" NUMBER 4 /end CHARACTERISTIC
/begin CHARACTERISTIC DSM_TypDfp_InjVCDClsBank2_C "Konvertierung der Fehlertypen auf der Diagnoseschnittstelle fuer Fehlerpfad Dfp_InjVCDClsBank2" VAL_BLK 0xCC59C Kwb_Wu8 255.0 OneToOne 0.00 255.0 FORMAT "%5.1" NUMBER 4 /end CHARACTERISTIC
/begin CHARACTERISTIC DSM_TypDfp_InjVCDMonCab_C "Konvertierung der Fehlertypen auf der Diagnoseschnittstelle fuer Fehlerpfad Dfp_InjVCDMonCab" VAL_BLK 0xCC5A0 Kwb_Wu8 255.0 OneToOne 0.00 255.0 FORMAT "%5.1" NUMBER 4 /end CHARACTERISTIC
/begin CHARACTERISTIC DSM_TypDfp_InjVCDMonSwt_C "Konvertierung der Fehlertypen auf der Diagnoseschnittstelle fuer Fehlerpfad Dfp_InjVCDMonSwt" VAL_BLK 0xCC5A4 Kwb_Wu8 255.0 OneToOne 0.00 255.0 FORMAT "%5.1" NUMBER 4 /end CHARACTERISTIC
/begin CHARACTERISTIC DSM_TypDfp_InjVCDShOffDCDC_C "Konvertierung der Fehlertypen auf der Diagnoseschnittstelle fuer Fehlerpfad Dfp_InjVCDShOffDCDC" VAL_BLK 0xCC5A8 Kwb_Wu8 255.0 OneToOne 0.00 255.0 FORMAT "%5.1" NUMBER 4 /end CHARACTERISTIC
/begin CHARACTERISTIC DSM_TypDfp_InjVCDUBuf_C "Konvertierung der Fehlertypen auf der Diagnoseschnittstelle fuer Fehlerpfad Dfp_InjVCDUBuf" VAL_BLK 0xCC5AC Kwb_Wu8 255.0 OneToOne 0.00 255.0 FORMAT "%5.1" NUMBER 4 /end CHARACTERISTIC
/begin CHARACTERISTIC DSM_TypDfp_InjVCD_CY370Ampl_C "Konvertierung der Fehlertypen auf der Diagnoseschnittstelle fuer Fehlerpfad Dfp_InjVCD_CY370Ampl" VAL_BLK 0xCC5B0 Kwb_Wu8 255.0 OneToOne 0.00 255.0 FORMAT "%5.1" NUMBER 4 /end CHARACTERISTIC
/begin CHARACTERISTIC DSM_TypDfp_InjVlvBnk1A_C "Konvertierung der Fehlertypen auf der Diagnoseschnittstelle fuer Fehlerpfad Dfp_InjVlvBnk1A" VAL_BLK 0xCC5B4 Kwb_Wu8 255.0 OneToOne 0.00 255.0 FORMAT "%5.1" NUMBER 4 /end CHARACTERISTIC
/begin CHARACTERISTIC DSM_TypDfp_InjVlvBnk1B_C "Konvertierung der Fehlertypen auf der Diagnoseschnittstelle fuer Fehlerpfad Dfp_InjVlvBnk1B" VAL_BLK 0xCC5B8 Kwb_Wu8 255.0 OneToOne 0.00 255.0 FORMAT "%5.1" NUMBER 4 /end CHARACTERISTIC
/begin CHARACTERISTIC DSM_TypDfp_InjVlvBnk2A_C "Konvertierung der Fehlertypen auf der Diagnoseschnittstelle fuer Fehlerpfad Dfp_InjVlvBnk2A" VAL_BLK 0xCC5BC Kwb_Wu8 255.0 OneToOne 0.00 255.0 FORMAT "%5.1" NUMBER 4 /end CHARACTERISTIC
/begin CHARACTERISTIC DSM_TypDfp_InjVlvBnk2B_C "Konvertierung der Fehlertypen auf der Diagnoseschnittstelle fuer Fehlerpfad Dfp_InjVlvBnk2B" VAL_BLK 0xCC5C0 Kwb_Wu8 255.0 OneToOne 0.00 255.0 FORMAT "%5.1" NUMBER 4 /end CHARACTERISTIC
/begin CHARACTERISTIC DSM_TypDfp_InjVlvChipA_C "Konvertierung der Fehlertypen auf der Diagnoseschnittstelle fuer Fehlerpfad Dfp_InjVlvChipA" VAL_BLK 0xCC5C4 Kwb_Wu8 255.0 OneToOne 0.00 255.0 FORMAT "%5.1" NUMBER 4 /end CHARACTERISTIC
/begin CHARACTERISTIC DSM_TypDfp_InjVlvChipB_C "Konvertierung der Fehlertypen auf der Diagnoseschnittstelle fuer Fehlerpfad Dfp_InjVlvChipB" VAL_BLK 0xCC5C8 Kwb_Wu8 255.0 OneToOne 0.00 255.0 FORMAT "%5.1" NUMBER 4 /end CHARACTERISTIC
/begin CHARACTERISTIC DSM_TypDfp_InjVlvCyl1A_C "Konvertierung der Fehlertypen auf der Diagnoseschnittstelle fuer Fehlerpfad Dfp_InjVlvCyl1A" VAL_BLK 0xCC5CC Kwb_Wu8 255.0 OneToOne 0.00 255.0 FORMAT "%5.1" NUMBER 4 /end CHARACTERISTIC
/begin CHARACTERISTIC DSM_TypDfp_InjVlvCyl1B_C "Konvertierung der Fehlertypen auf der Diagnoseschnittstelle fuer Fehlerpfad Dfp_InjVlvCyl1B" VAL_BLK 0xCC5D0 Kwb_Wu8 255.0 OneToOne 0.00 255.0 FORMAT "%5.1" NUMBER 4 /end CHARACTERISTIC
/begin CHARACTERISTIC DSM_TypDfp_InjVlvCyl1C_C "Konvertierung der Fehlertypen auf der Diagnoseschnittstelle fuer Fehlerpfad Dfp_InjVlvCyl1C" VAL_BLK 0xCC5D4 Kwb_Wu8 255.0 OneToOne 0.00 255.0 FORMAT "%5.1" NUMBER 4 /end CHARACTERISTIC
/begin CHARACTERISTIC DSM_TypDfp_InjVlvCyl2A_C "Konvertierung der Fehlertypen auf der Diagnoseschnittstelle fuer Fehlerpfad Dfp_InjVlvCyl2A" VAL_BLK 0xCC5D8 Kwb_Wu8 255.0 OneToOne 0.00 255.0 FORMAT "%5.1" NUMBER 4 /end CHARACTERISTIC
/begin CHARACTERISTIC DSM_TypDfp_InjVlvCyl2B_C "Konvertierung der Fehlertypen auf der Diagnoseschnittstelle fuer Fehlerpfad Dfp_InjVlvCyl2B" VAL_BLK 0xCC5DC Kwb_Wu8 255.0 OneToOne 0.00 255.0 FORMAT "%5.1" NUMBER 4 /end CHARACTERISTIC
/begin CHARACTERISTIC DSM_TypDfp_InjVlvCyl2C_C "Konvertierung der Fehlertypen auf der Diagnoseschnittstelle fuer Fehlerpfad Dfp_InjVlvCyl2C" VAL_BLK 0xCC5E0 Kwb_Wu8 255.0 OneToOne 0.00 255.0 FORMAT "%5.1" NUMBER 4 /end CHARACTERISTIC
/begin CHARACTERISTIC DSM_TypDfp_InjVlvCyl3A_C "Konvertierung der Fehlertypen auf der Diagnoseschnittstelle fuer Fehlerpfad Dfp_InjVlvCyl3A" VAL_BLK 0xCC5E4 Kwb_Wu8 255.0 OneToOne 0.00 255.0 FORMAT "%5.1" NUMBER 4 /end CHARACTERISTIC
/begin CHARACTERISTIC DSM_TypDfp_InjVlvCyl3B_C "Konvertierung der Fehlertypen auf der Diagnoseschnittstelle fuer Fehlerpfad Dfp_InjVlvCyl3B" VAL_BLK 0xCC5E8 Kwb_Wu8 255.0 OneToOne 0.00 255.0 FORMAT "%5.1" NUMBER 4 /end CHARACTERISTIC
/begin CHARACTERISTIC DSM_TypDfp_InjVlvCyl3C_C "Konvertierung der Fehlertypen auf der Diagnoseschnittstelle fuer Fehlerpfad Dfp_InjVlvCyl3C" VAL_BLK 0xCC5EC Kwb_Wu8 255.0 OneToOne 0.00 255.0 FORMAT "%5.1" NUMBER 4 /end CHARACTERISTIC
/begin CHARACTERISTIC DSM_TypDfp_InjVlvCyl4A_C "Konvertierung der Fehlertypen auf der Diagnoseschnittstelle fuer Fehlerpfad Dfp_InjVlvCyl4A" VAL_BLK 0xCC5F0 Kwb_Wu8 255.0 OneToOne 0.00 255.0 FORMAT "%5.1" NUMBER 4 /end CHARACTERISTIC
/begin CHARACTERISTIC DSM_TypDfp_InjVlvCyl4B_C "Konvertierung der Fehlertypen auf der Diagnoseschnittstelle fuer Fehlerpfad Dfp_InjVlvCyl4B" VAL_BLK 0xCC5F4 Kwb_Wu8 255.0 OneToOne 0.00 255.0 FORMAT "%5.1" NUMBER 4 /end CHARACTERISTIC
/begin CHARACTERISTIC DSM_TypDfp_InjVlvCyl4C_C "Konvertierung der Fehlertypen auf der Diagnoseschnittstelle fuer Fehlerpfad Dfp_InjVlvCyl4C" VAL_BLK 0xCC5F8 Kwb_Wu8 255.0 OneToOne 0.00 255.0 FORMAT "%5.1" NUMBER 4 /end CHARACTERISTIC
/begin CHARACTERISTIC DSM_TypDfp_InjVlvCyl5A_C "Konvertierung der Fehlertypen auf der Diagnoseschnittstelle fuer Fehlerpfad Dfp_InjVlvCyl5A" VAL_BLK 0xCC5FC Kwb_Wu8 255.0 OneToOne 0.00 255.0 FORMAT "%5.1" NUMBER 4 /end CHARACTERISTIC
/begin CHARACTERISTIC DSM_TypDfp_InjVlvCyl5B_C "Konvertierung der Fehlertypen auf der Diagnoseschnittstelle fuer Fehlerpfad Dfp_InjVlvCyl5B" VAL_BLK 0xCC600 Kwb_Wu8 255.0 OneToOne 0.00 255.0 FORMAT "%5.1" NUMBER 4 /end CHARACTERISTIC
/begin CHARACTERISTIC DSM_TypDfp_InjVlvCyl5C_C "Konvertierung der Fehlertypen auf der Diagnoseschnittstelle fuer Fehlerpfad Dfp_InjVlvCyl5C" VAL_BLK 0xCC604 Kwb_Wu8 255.0 OneToOne 0.00 255.0 FORMAT "%5.1" NUMBER 4 /end CHARACTERISTIC
/begin CHARACTERISTIC DSM_TypDfp_InjVlvCyl6A_C "Konvertierung der Fehlertypen auf der Diagnoseschnittstelle fuer Fehlerpfad Dfp_InjVlvCyl6A" VAL_BLK 0xCC608 Kwb_Wu8 255.0 OneToOne 0.00 255.0 FORMAT "%5.1" NUMBER 4 /end CHARACTERISTIC
/begin CHARACTERISTIC DSM_TypDfp_InjVlvCyl6B_C "Konvertierung der Fehlertypen auf der Diagnoseschnittstelle fuer Fehlerpfad Dfp_InjVlvCyl6B" VAL_BLK 0xCC60C Kwb_Wu8 255.0 OneToOne 0.00 255.0 FORMAT "%5.1" NUMBER 4 /end CHARACTERISTIC
/begin CHARACTERISTIC DSM_TypDfp_InjVlvCyl6C_C "Konvertierung der Fehlertypen auf der Diagnoseschnittstelle fuer Fehlerpfad Dfp_InjVlvCyl6C" VAL_BLK 0xCC610 Kwb_Wu8 255.0 OneToOne 0.00 255.0 FORMAT "%5.1" NUMBER 4 /end CHARACTERISTIC
/begin CHARACTERISTIC DSM_TypDfp_InjVlvCyl7A_C "Konvertierung der Fehlertypen auf der Diagnoseschnittstelle fuer Fehlerpfad Dfp_InjVlvCyl7A" VAL_BLK 0xCC614 Kwb_Wu8 255.0 OneToOne 0.00 255.0 FORMAT "%5.1" NUMBER 4 /end CHARACTERISTIC
/begin CHARACTERISTIC DSM_TypDfp_InjVlvCyl7B_C "Konvertierung der Fehlertypen auf der Diagnoseschnittstelle fuer Fehlerpfad Dfp_InjVlvCyl7B" VAL_BLK 0xCC618 Kwb_Wu8 255.0 OneToOne 0.00 255.0 FORMAT "%5.1" NUMBER 4 /end CHARACTERISTIC
/begin CHARACTERISTIC DSM_TypDfp_InjVlvCyl7C_C "Konvertierung der Fehlertypen auf der Diagnoseschnittstelle fuer Fehlerpfad Dfp_InjVlvCyl7C" VAL_BLK 0xCC61C Kwb_Wu8 255.0 OneToOne 0.00 255.0 FORMAT "%5.1" NUMBER 4 /end CHARACTERISTIC
/begin CHARACTERISTIC DSM_TypDfp_InjVlvCyl8A_C "Konvertierung der Fehlertypen auf der Diagnoseschnittstelle fuer Fehlerpfad Dfp_InjVlvCyl8A" VAL_BLK 0xCC620 Kwb_Wu8 255.0 OneToOne 0.00 255.0 FORMAT "%5.1" NUMBER 4 /end CHARACTERISTIC
/begin CHARACTERISTIC DSM_TypDfp_InjVlvCyl8B_C "Konvertierung der Fehlertypen auf der Diagnoseschnittstelle fuer Fehlerpfad Dfp_InjVlvCyl8B" VAL_BLK 0xCC624 Kwb_Wu8 255.0 OneToOne 0.00 255.0 FORMAT "%5.1" NUMBER 4 /end CHARACTERISTIC
/begin CHARACTERISTIC DSM_TypDfp_InjVlvCyl8C_C "Konvertierung der Fehlertypen auf der Diagnoseschnittstelle fuer Fehlerpfad Dfp_InjVlvCyl8C" VAL_BLK 0xCC628 Kwb_Wu8 255.0 OneToOne 0.00 255.0 FORMAT "%5.1" NUMBER 4 /end CHARACTERISTIC
/begin CHARACTERISTIC DSM_TypDfp_InjVlvNVC1_C "Konvertierung der Fehlertypen auf der Diagnoseschnittstelle fuer Fehlerpfad Dfp_InjVlvNVC1" VAL_BLK 0xCC62C Kwb_Wu8 255.0 OneToOne 0.00 255.0 FORMAT "%5.1" NUMBER 4 /end CHARACTERISTIC
/begin CHARACTERISTIC DSM_TypDfp_InjVlvNVC2_C "Konvertierung der Fehlertypen auf der Diagnoseschnittstelle fuer Fehlerpfad Dfp_InjVlvNVC2" VAL_BLK 0xCC630 Kwb_Wu8 255.0 OneToOne 0.00 255.0 FORMAT "%5.1" NUMBER 4 /end CHARACTERISTIC
/begin CHARACTERISTIC DSM_TypDfp_InjVlvNVC3_C "Konvertierung der Fehlertypen auf der Diagnoseschnittstelle fuer Fehlerpfad Dfp_InjVlvNVC3" VAL_BLK 0xCC634 Kwb_Wu8 255.0 OneToOne 0.00 255.0 FORMAT "%5.1" NUMBER 4 /end CHARACTERISTIC
/begin CHARACTERISTIC DSM_TypDfp_InjVlvNVC4_C "Konvertierung der Fehlertypen auf der Diagnoseschnittstelle fuer Fehlerpfad Dfp_InjVlvNVC4" VAL_BLK 0xCC638 Kwb_Wu8 255.0 OneToOne 0.00 255.0 FORMAT "%5.1" NUMBER 4 /end CHARACTERISTIC
/begin CHARACTERISTIC DSM_TypDfp_InjVlvNVC5_C "Konvertierung der Fehlertypen auf der Diagnoseschnittstelle fuer Fehlerpfad Dfp_InjVlvNVC5" VAL_BLK 0xCC63C Kwb_Wu8 255.0 OneToOne 0.00 255.0 FORMAT "%5.1" NUMBER 4 /end CHARACTERISTIC
/begin CHARACTERISTIC DSM_TypDfp_InjVlvNVC6_C "Konvertierung der Fehlertypen auf der Diagnoseschnittstelle fuer Fehlerpfad Dfp_InjVlvNVC6" VAL_BLK 0xCC640 Kwb_Wu8 255.0 OneToOne 0.00 255.0 FORMAT "%5.1" NUMBER 4 /end CHARACTERISTIC
/begin CHARACTERISTIC DSM_TypDfp_InjVlvNVC7_C "Konvertierung der Fehlertypen auf der Diagnoseschnittstelle fuer Fehlerpfad Dfp_InjVlvNVC7" VAL_BLK 0xCC644 Kwb_Wu8 255.0 OneToOne 0.00 255.0 FORMAT "%5.1" NUMBER 4 /end CHARACTERISTIC
/begin CHARACTERISTIC DSM_TypDfp_InjVlvNVC8_C "Konvertierung der Fehlertypen auf der Diagnoseschnittstelle fuer Fehlerpfad Dfp_InjVlvNVC8" VAL_BLK 0xCC648 Kwb_Wu8 255.0 OneToOne 0.00 255.0 FORMAT "%5.1" NUMBER 4 /end CHARACTERISTIC
/begin CHARACTERISTIC DSM_TypDfp_LPACD_Max_C "Konvertierung der Fehlertypen auf der Diagnoseschnittstelle fuer Fehlerpfad Dfp_LPACD_Max" VAL_BLK 0xCC64C Kwb_Wu8 255.0 OneToOne 0.00 255.0 FORMAT "%5.1" NUMBER 4 /end CHARACTERISTIC
/begin CHARACTERISTIC DSM_TypDfp_LPACD_Min_C "Konvertierung der Fehlertypen auf der Diagnoseschnittstelle fuer Fehlerpfad Dfp_LPACD_Min" VAL_BLK 0xCC650 Kwb_Wu8 255.0 OneToOne 0.00 255.0 FORMAT "%5.1" NUMBER 4 /end CHARACTERISTIC
/begin CHARACTERISTIC DSM_TypDfp_LPACD_SigNpl_C "Konvertierung der Fehlertypen auf der Diagnoseschnittstelle fuer Fehlerpfad Dfp_LPACD_SigNpl" VAL_BLK 0xCC654 Kwb_Wu8 255.0 OneToOne 0.00 255.0 FORMAT "%5.1" NUMBER 4 /end CHARACTERISTIC
/begin CHARACTERISTIC DSM_TypDfp_LSUCDCircNernst0_C "Konvertierung der Fehlertypen auf der Diagnoseschnittstelle fuer Fehlerpfad Dfp_LSUCDCircNernst0" VAL_BLK 0xCC658 Kwb_Wu8 255.0 OneToOne 0.00 255.0 FORMAT "%5.1" NUMBER 4 /end CHARACTERISTIC
/begin CHARACTERISTIC DSM_TypDfp_LSUCDCircPumpCur0_C "Konvertierung der Fehlertypen auf der Diagnoseschnittstelle fuer Fehlerpfad Dfp_LSUCDCircPumpCur0" VAL_BLK 0xCC65C Kwb_Wu8 255.0 OneToOne 0.00 255.0 FORMAT "%5.1" NUMBER 4 /end CHARACTERISTIC
/begin CHARACTERISTIC DSM_TypDfp_LSUCDCircVirtGnd0_C "Konvertierung der Fehlertypen auf der Diagnoseschnittstelle fuer Fehlerpfad Dfp_LSUCDCircVirtGnd0" VAL_BLK 0xCC660 Kwb_Wu8 255.0 OneToOne 0.00 255.0 FORMAT "%5.1" NUMBER 4 /end CHARACTERISTIC
/begin CHARACTERISTIC DSM_TypDfp_LSUCDHeater0_C "Konvertierung der Fehlertypen auf der Diagnoseschnittstelle fuer Fehlerpfad Dfp_LSUCDHeater0" VAL_BLK 0xCC664 Kwb_Wu8 255.0 OneToOne 0.00 255.0 FORMAT "%5.1" NUMBER 4 /end CHARACTERISTIC
/begin CHARACTERISTIC DSM_TypDfp_LSUCDHtCoup0_C "Konvertierung der Fehlertypen auf der Diagnoseschnittstelle fuer Fehlerpfad Dfp_LSUCDHtCoup0" VAL_BLK 0xCC668 Kwb_Wu8 255.0 OneToOne 0.00 255.0 FORMAT "%5.1" NUMBER 4 /end CHARACTERISTIC
/begin CHARACTERISTIC DSM_TypDfp_LSUCDO20_C "Konvertierung der Fehlertypen auf der Diagnoseschnittstelle fuer Fehlerpfad Dfp_LSUCDO20" VAL_BLK 0xCC66C Kwb_Wu8 255.0 OneToOne 0.00 255.0 FORMAT "%5.1" NUMBER 4 /end CHARACTERISTIC
/begin CHARACTERISTIC DSM_TypDfp_LSUCDO2Clb0_C "Konvertierung der Fehlertypen auf der Diagnoseschnittstelle fuer Fehlerpfad Dfp_LSUCDO2Clb0" VAL_BLK 0xCC670 Kwb_Wu8 255.0 OneToOne 0.00 255.0 FORMAT "%5.1" NUMBER 4 /end CHARACTERISTIC
/begin CHARACTERISTIC DSM_TypDfp_LSUCDRiClb0_C "Konvertierung der Fehlertypen auf der Diagnoseschnittstelle fuer Fehlerpfad Dfp_LSUCDRiClb0" VAL_BLK 0xCC674 Kwb_Wu8 255.0 OneToOne 0.00 255.0 FORMAT "%5.1" NUMBER 4 /end CHARACTERISTIC
/begin CHARACTERISTIC DSM_TypDfp_LSUCDSPI0_C "Konvertierung der Fehlertypen auf der Diagnoseschnittstelle fuer Fehlerpfad Dfp_LSUCDSPI0" VAL_BLK 0xCC678 Kwb_Wu8 255.0 OneToOne 0.00 255.0 FORMAT "%5.1" NUMBER 4 /end CHARACTERISTIC
/begin CHARACTERISTIC DSM_TypDfp_LSUCDSPIBattLow0_C "Konvertierung der Fehlertypen auf der Diagnoseschnittstelle fuer Fehlerpfad Dfp_LSUCDSPIBattLow0" VAL_BLK 0xCC67C Kwb_Wu8 255.0 OneToOne 0.00 255.0 FORMAT "%5.1" NUMBER 4 /end CHARACTERISTIC
/begin CHARACTERISTIC DSM_TypDfp_LSUCDWireIP0_C "Konvertierung der Fehlertypen auf der Diagnoseschnittstelle fuer Fehlerpfad Dfp_LSUCDWireIP0" VAL_BLK 0xCC680 Kwb_Wu8 255.0 OneToOne 0.00 255.0 FORMAT "%5.1" NUMBER 4 /end CHARACTERISTIC
/begin CHARACTERISTIC DSM_TypDfp_LSUCtlRiExc0_C "Konvertierung der Fehlertypen auf der Diagnoseschnittstelle fuer Fehlerpfad Dfp_LSUCtlRiExc0" VAL_BLK 0xCC684 Kwb_Wu8 255.0 OneToOne 0.00 255.0 FORMAT "%5.1" NUMBER 4 /end CHARACTERISTIC
/begin CHARACTERISTIC DSM_TypDfp_LSUMon1Sens_C "Konvertierung der Fehlertypen auf der Diagnoseschnittstelle fuer Fehlerpfad Dfp_LSUMon1Sens" VAL_BLK 0xCC688 Kwb_Wu8 255.0 OneToOne 0.00 255.0 FORMAT "%5.1" NUMBER 4 /end CHARACTERISTIC
/begin CHARACTERISTIC DSM_TypDfp_LSUMon2Sens_C "Konvertierung der Fehlertypen auf der Diagnoseschnittstelle fuer Fehlerpfad Dfp_LSUMon2Sens" VAL_BLK 0xCC68C Kwb_Wu8 255.0 OneToOne 0.00 255.0 FORMAT "%5.1" NUMBER 4 /end CHARACTERISTIC
/begin CHARACTERISTIC DSM_TypDfp_LubCD_C "Konvertierung der Fehlertypen auf der Diagnoseschnittstelle fuer Fehlerpfad Dfp_LubCD" VAL_BLK 0xCC690 Kwb_Wu8 255.0 OneToOne 0.00 255.0 FORMAT "%5.1" NUMBER 4 /end CHARACTERISTIC
/begin CHARACTERISTIC DSM_TypDfp_MIL_C "Konvertierung der Fehlertypen auf der Diagnoseschnittstelle fuer Fehlerpfad Dfp_MIL" VAL_BLK 0xCC694 Kwb_Wu8 255.0 OneToOne 0.00 255.0 FORMAT "%5.1" NUMBER 4 /end CHARACTERISTIC
/begin CHARACTERISTIC DSM_TypDfp_MRlyCD_C "Konvertierung der Fehlertypen auf der Diagnoseschnittstelle fuer Fehlerpfad Dfp_MRlyCD" VAL_BLK 0xCC698 Kwb_Wu8 255.0 OneToOne 0.00 255.0 FORMAT "%5.1" NUMBER 4 /end CHARACTERISTIC
/begin CHARACTERISTIC DSM_TypDfp_MSidCD_Comm_C "Konvertierung der Fehlertypen auf der Diagnoseschnittstelle fuer Fehlerpfad Dfp_MSidCD_Comm" VAL_BLK 0xCC69C Kwb_Wu8 255.0 OneToOne 0.00 255.0 FORMAT "%5.1" NUMBER 4 /end CHARACTERISTIC
/begin CHARACTERISTIC DSM_TypDfp_MSidCD_Pin_C "Konvertierung der Fehlertypen auf der Diagnoseschnittstelle fuer Fehlerpfad Dfp_MSidCD_Pin" VAL_BLK 0xCC6A0 Kwb_Wu8 255.0 OneToOne 0.00 255.0 FORMAT "%5.1" NUMBER 4 /end CHARACTERISTIC
/begin CHARACTERISTIC DSM_TypDfp_MSidCD_Sel_INI_C "Konvertierung der Fehlertypen auf der Diagnoseschnittstelle fuer Fehlerpfad Dfp_MSidCD_Sel_INI" VAL_BLK 0xCC6A4 Kwb_Wu8 255.0 OneToOne 0.00 255.0 FORMAT "%5.1" NUMBER 4 /end CHARACTERISTIC
/begin CHARACTERISTIC DSM_TypDfp_MSidCD_Select_C "Konvertierung der Fehlertypen auf der Diagnoseschnittstelle fuer Fehlerpfad Dfp_MSidCD_Select" VAL_BLK 0xCC6A8 Kwb_Wu8 255.0 OneToOne 0.00 255.0 FORMAT "%5.1" NUMBER 4 /end CHARACTERISTIC
/begin CHARACTERISTIC DSM_TypDfp_MeUnCDNoLoad_C "Konvertierung der Fehlertypen auf der Diagnoseschnittstelle fuer Fehlerpfad Dfp_MeUnCDNoLoad" VAL_BLK 0xCC6AC Kwb_Wu8 255.0 OneToOne 0.00 255.0 FORMAT "%5.1" NUMBER 4 /end CHARACTERISTIC
/begin CHARACTERISTIC DSM_TypDfp_MeUnCDSCBat_C "Konvertierung der Fehlertypen auf der Diagnoseschnittstelle fuer Fehlerpfad Dfp_MeUnCDSCBat" VAL_BLK 0xCC6B0 Kwb_Wu8 255.0 OneToOne 0.00 255.0 FORMAT "%5.1" NUMBER 4 /end CHARACTERISTIC
/begin CHARACTERISTIC DSM_TypDfp_MeUnCDSCGnd_C "Konvertierung der Fehlertypen auf der Diagnoseschnittstelle fuer Fehlerpfad Dfp_MeUnCDSCGnd" VAL_BLK 0xCC6B4 Kwb_Wu8 255.0 OneToOne 0.00 255.0 FORMAT "%5.1" NUMBER 4 /end CHARACTERISTIC
/begin CHARACTERISTIC DSM_TypDfp_MeUnCD_ADC_C "Konvertierung der Fehlertypen auf der Diagnoseschnittstelle fuer Fehlerpfad Dfp_MeUnCD_ADC" VAL_BLK 0xCC6B8 Kwb_Wu8 255.0 OneToOne 0.00 255.0 FORMAT "%5.1" NUMBER 4 /end CHARACTERISTIC
/begin CHARACTERISTIC DSM_TypDfp_MeUnCD_SigTst_C "Konvertierung der Fehlertypen auf der Diagnoseschnittstelle fuer Fehlerpfad Dfp_MeUnCD_SigTst" VAL_BLK 0xCC6BC Kwb_Wu8 255.0 OneToOne 0.00 255.0 FORMAT "%5.1" NUMBER 4 /end CHARACTERISTIC
/begin CHARACTERISTIC DSM_TypDfp_Montr_C "Konvertierung der Fehlertypen auf der Diagnoseschnittstelle fuer Fehlerpfad Dfp_Montr" VAL_BLK 0xCC6C0 Kwb_Wu8 255.0 OneToOne 0.00 255.0 FORMAT "%5.1" NUMBER 4 /end CHARACTERISTIC
/begin CHARACTERISTIC DSM_TypDfp_NetMngDeviceA_C "Konvertierung der Fehlertypen auf der Diagnoseschnittstelle fuer Fehlerpfad Dfp_NetMngDeviceA" VAL_BLK 0xCC6C4 Kwb_Wu8 255.0 OneToOne 0.00 255.0 FORMAT "%5.1" NUMBER 4 /end CHARACTERISTIC
/begin CHARACTERISTIC DSM_TypDfp_NetMngDeviceB_C "Konvertierung der Fehlertypen auf der Diagnoseschnittstelle fuer Fehlerpfad Dfp_NetMngDeviceB" VAL_BLK 0xCC6C8 Kwb_Wu8 255.0 OneToOne 0.00 255.0 FORMAT "%5.1" NUMBER 4 /end CHARACTERISTIC
/begin CHARACTERISTIC DSM_TypDfp_NetMngDeviceC_C "Konvertierung der Fehlertypen auf der Diagnoseschnittstelle fuer Fehlerpfad Dfp_NetMngDeviceC" VAL_BLK 0xCC6CC Kwb_Wu8 255.0 OneToOne 0.00 255.0 FORMAT "%5.1" NUMBER 4 /end CHARACTERISTIC
/begin CHARACTERISTIC DSM_TypDfp_OPSCD_Lamp_C "Konvertierung der Fehlertypen auf der Diagnoseschnittstelle fuer Fehlerpfad Dfp_OPSCD_Lamp" VAL_BLK 0xCC6D0 Kwb_Wu8 255.0 OneToOne 0.00 255.0 FORMAT "%5.1" NUMBER 4 /end CHARACTERISTIC
/begin CHARACTERISTIC DSM_TypDfp_OPSCD_anain_C "Konvertierung der Fehlertypen auf der Diagnoseschnittstelle fuer Fehlerpfad Dfp_OPSCD_anain" VAL_BLK 0xCC6D4 Kwb_Wu8 255.0 OneToOne 0.00 255.0 FORMAT "%5.1" NUMBER 4 /end CHARACTERISTIC
/begin CHARACTERISTIC DSM_TypDfp_OTSCD_C "Konvertierung der Fehlertypen auf der Diagnoseschnittstelle fuer Fehlerpfad Dfp_OTSCD" VAL_BLK 0xCC6D8 Kwb_Wu8 255.0 OneToOne 0.00 255.0 FORMAT "%5.1" NUMBER 4 /end CHARACTERISTIC
/begin CHARACTERISTIC DSM_TypDfp_OvRMon_C "Konvertierung der Fehlertypen auf der Diagnoseschnittstelle fuer Fehlerpfad Dfp_OvRMon" VAL_BLK 0xCC6DC Kwb_Wu8 255.0 OneToOne 0.00 255.0 FORMAT "%5.1" NUMBER 4 /end CHARACTERISTIC
/begin CHARACTERISTIC DSM_TypDfp_OvRMonBrk_C "conversion of fault types for diagnostic interface for fault path Dfp_OvRMonBrk" VAL_BLK 0xCC6E0 Kwb_Wu8 255.0 OneToOne 0.00 255.0 FORMAT "%5.1" NUMBER 4 /end CHARACTERISTIC
/begin CHARACTERISTIC DSM_TypDfp_OvRMonSigA_C "Konvertierung der Fehlertypen auf der Diagnoseschnittstelle fuer Fehlerpfad Dfp_OvRMonSigA" VAL_BLK 0xCC6E4 Kwb_Wu8 255.0 OneToOne 0.00 255.0 FORMAT "%5.1" NUMBER 4 /end CHARACTERISTIC
/begin CHARACTERISTIC DSM_TypDfp_OxiCCDTPre_C "Konvertierung der Fehlertypen auf der Diagnoseschnittstelle fuer Fehlerpfad Dfp_OxiCCDTPre" VAL_BLK 0xCC6E8 Kwb_Wu8 255.0 OneToOne 0.00 255.0 FORMAT "%5.1" NUMBER 4 /end CHARACTERISTIC
/begin CHARACTERISTIC DSM_TypDfp_PCR_GovDevNeg_C "Konvertierung der Fehlertypen auf der Diagnoseschnittstelle fuer Fehlerpfad Dfp_PCR_GovDevNeg" VAL_BLK 0xCC6EC Kwb_Wu8 255.0 OneToOne 0.00 255.0 FORMAT "%5.1" NUMBER 4 /end CHARACTERISTIC
/begin CHARACTERISTIC DSM_TypDfp_PCR_GovDevPos_C "Konvertierung der Fehlertypen auf der Diagnoseschnittstelle fuer Fehlerpfad Dfp_PCR_GovDevPos" VAL_BLK 0xCC6F0 Kwb_Wu8 255.0 OneToOne 0.00 255.0 FORMAT "%5.1" NUMBER 4 /end CHARACTERISTIC
/begin CHARACTERISTIC DSM_TypDfp_PCVCDNoLoad_C "Konvertierung der Fehlertypen auf der Diagnoseschnittstelle fuer Fehlerpfad Dfp_PCVCDNoLoad" VAL_BLK 0xCC6F4 Kwb_Wu8 255.0 OneToOne 0.00 255.0 FORMAT "%5.1" NUMBER 4 /end CHARACTERISTIC
/begin CHARACTERISTIC DSM_TypDfp_PCVCDSCBat_C "Konvertierung der Fehlertypen auf der Diagnoseschnittstelle fuer Fehlerpfad Dfp_PCVCDSCBat" VAL_BLK 0xCC6F8 Kwb_Wu8 255.0 OneToOne 0.00 255.0 FORMAT "%5.1" NUMBER 4 /end CHARACTERISTIC
/begin CHARACTERISTIC DSM_TypDfp_PCVCDSCGnd_C "Konvertierung der Fehlertypen auf der Diagnoseschnittstelle fuer Fehlerpfad Dfp_PCVCDSCGnd" VAL_BLK 0xCC6FC Kwb_Wu8 255.0 OneToOne 0.00 255.0 FORMAT "%5.1" NUMBER 4 /end CHARACTERISTIC
/begin CHARACTERISTIC DSM_TypDfp_PCVCD_ADC_C "Konvertierung der Fehlertypen auf der Diagnoseschnittstelle fuer Fehlerpfad Dfp_PCVCD_ADC" VAL_BLK 0xCC700 Kwb_Wu8 255.0 OneToOne 0.00 255.0 FORMAT "%5.1" NUMBER 4 /end CHARACTERISTIC
/begin CHARACTERISTIC DSM_TypDfp_PCVCD_SigTst_C "Konvertierung der Fehlertypen auf der Diagnoseschnittstelle fuer Fehlerpfad Dfp_PCVCD_SigTst" VAL_BLK 0xCC704 Kwb_Wu8 255.0 OneToOne 0.00 255.0 FORMAT "%5.1" NUMBER 4 /end CHARACTERISTIC
/begin CHARACTERISTIC DSM_TypDfp_PFltAPSens_C "Konvertierung der Fehlertypen auf der Diagnoseschnittstelle fuer Fehlerpfad Dfp_PFltAPSens" VAL_BLK 0xCC708 Kwb_Wu8 255.0 OneToOne 0.00 255.0 FORMAT "%5.1" NUMBER 4 /end CHARACTERISTIC
/begin CHARACTERISTIC DSM_TypDfp_PFltCDPPre_C "Konvertierung der Fehlertypen auf der Diagnoseschnittstelle fuer Fehlerpfad Dfp_PFltCDPPre" VAL_BLK 0xCC70C Kwb_Wu8 255.0 OneToOne 0.00 255.0 FORMAT "%5.1" NUMBER 4 /end CHARACTERISTIC
/begin CHARACTERISTIC DSM_TypDfp_PFltCDTempPre_C "Konvertierung der Fehlertypen auf der Diagnoseschnittstelle fuer Fehlerpfad Dfp_PFltCDTempPre" VAL_BLK 0xCC710 Kwb_Wu8 255.0 OneToOne 0.00 255.0 FORMAT "%5.1" NUMBER 4 /end CHARACTERISTIC
/begin CHARACTERISTIC DSM_TypDfp_PFltChar_C "Konvertierung der Fehlertypen auf der Diagnoseschnittstelle fuer Fehlerpfad Dfp_PFltChar" VAL_BLK 0xCC714 Kwb_Wu8 255.0 OneToOne 0.00 255.0 FORMAT "%5.1" NUMBER 4 /end CHARACTERISTIC
/begin CHARACTERISTIC DSM_TypDfp_PFltEngPrt_C "Konvertierung der Fehlertypen auf der Diagnoseschnittstelle fuer Fehlerpfad Dfp_PFltEngPrt" VAL_BLK 0xCC718 Kwb_Wu8 255.0 OneToOne 0.00 255.0 FORMAT "%5.1" NUMBER 4 /end CHARACTERISTIC
/begin CHARACTERISTIC DSM_TypDfp_PFltPresDynPlaus_C "Konvertierung der Fehlertypen auf der Diagnoseschnittstelle fuer Fehlerpfad Dfp_PFltPresDynPlaus" VAL_BLK 0xCC71C Kwb_Wu8 255.0 OneToOne 0.00 255.0 FORMAT "%5.1" NUMBER 4 /end CHARACTERISTIC
/begin CHARACTERISTIC DSM_TypDfp_PFltPresSens_C "Konvertierung der Fehlertypen auf der Diagnoseschnittstelle fuer Fehlerpfad Dfp_PFltPresSens" VAL_BLK 0xCC720 Kwb_Wu8 255.0 OneToOne 0.00 255.0 FORMAT "%5.1" NUMBER 4 /end CHARACTERISTIC
/begin CHARACTERISTIC DSM_TypDfp_PFltPresSensFrz_C "Konvertierung der Fehlertypen auf der Diagnoseschnittstelle fuer Fehlerpfad Dfp_PFltPresSensFrz" VAL_BLK 0xCC724 Kwb_Wu8 255.0 OneToOne 0.00 255.0 FORMAT "%5.1" NUMBER 4 /end CHARACTERISTIC
/begin CHARACTERISTIC DSM_TypDfp_PFltPresSensHsLn_C "Konvertierung der Fehlertypen auf der Diagnoseschnittstelle fuer Fehlerpfad Dfp_PFltPresSensHsLn" VAL_BLK 0xCC728 Kwb_Wu8 255.0 OneToOne 0.00 255.0 FORMAT "%5.1" NUMBER 4 /end CHARACTERISTIC
/begin CHARACTERISTIC DSM_TypDfp_PFltPresSensSot_C "Konvertierung der Fehlertypen auf der Diagnoseschnittstelle fuer Fehlerpfad Dfp_PFltPresSensSot" VAL_BLK 0xCC72C Kwb_Wu8 255.0 OneToOne 0.00 255.0 FORMAT "%5.1" NUMBER 4 /end CHARACTERISTIC
/begin CHARACTERISTIC DSM_TypDfp_PFltRgnPerm_C "Konvertierung der Fehlertypen auf der Diagnoseschnittstelle fuer Fehlerpfad Dfp_PFltRgnPerm" VAL_BLK 0xCC730 Kwb_Wu8 255.0 OneToOne 0.00 255.0 FORMAT "%5.1" NUMBER 4 /end CHARACTERISTIC
/begin CHARACTERISTIC DSM_TypDfp_PFltTempDwnStrm_C "Konvertierung der Fehlertypen auf der Diagnoseschnittstelle fuer Fehlerpfad Dfp_PFltTempDwnStrm" VAL_BLK 0xCC734 Kwb_Wu8 255.0 OneToOne 0.00 255.0 FORMAT "%5.1" NUMBER 4 /end CHARACTERISTIC
/begin CHARACTERISTIC DSM_TypDfp_PFltTempSens_C "Konvertierung der Fehlertypen auf der Diagnoseschnittstelle fuer Fehlerpfad Dfp_PFltTempSens" VAL_BLK 0xCC738 Kwb_Wu8 255.0 OneToOne 0.00 255.0 FORMAT "%5.1" NUMBER 4 /end CHARACTERISTIC
/begin CHARACTERISTIC DSM_TypDfp_PFltTempUpStrm_C "Konvertierung der Fehlertypen auf der Diagnoseschnittstelle fuer Fehlerpfad Dfp_PFltTempUpStrm" VAL_BLK 0xCC73C Kwb_Wu8 255.0 OneToOne 0.00 255.0 FORMAT "%5.1" NUMBER 4 /end CHARACTERISTIC
/begin CHARACTERISTIC DSM_TypDfp_PFltmSotDiffMax_C "Konvertierung der Fehlertypen auf der Diagnoseschnittstelle fuer Fehlerpfad Dfp_PFltmSotDiffMax" VAL_BLK 0xCC740 Kwb_Wu8 255.0 OneToOne 0.00 255.0 FORMAT "%5.1" NUMBER 4 /end CHARACTERISTIC
/begin CHARACTERISTIC DSM_TypDfp_QLTCD_C "Konvertierung der Fehlertypen auf der Diagnoseschnittstelle fuer Fehlerpfad Dfp_QLTCD" VAL_BLK 0xCC744 Kwb_Wu8 255.0 OneToOne 0.00 255.0 FORMAT "%5.1" NUMBER 4 /end CHARACTERISTIC
/begin CHARACTERISTIC DSM_TypDfp_RTMMon_C "Konvertierung der Fehlertypen auf der Diagnoseschnittstelle fuer Fehlerpfad Dfp_RTMMon" VAL_BLK 0xCC748 Kwb_Wu8 255.0 OneToOne 0.00 255.0 FORMAT "%5.1" NUMBER 4 /end CHARACTERISTIC
/begin CHARACTERISTIC DSM_TypDfp_RailCD_C "Konvertierung der Fehlertypen auf der Diagnoseschnittstelle fuer Fehlerpfad Dfp_RailCD" VAL_BLK 0xCC74C Kwb_Wu8 255.0 OneToOne 0.00 255.0 FORMAT "%5.1" NUMBER 4 /end CHARACTERISTIC
/begin CHARACTERISTIC DSM_TypDfp_RailCDOfsTst_C "Konvertierung der Fehlertypen auf der Diagnoseschnittstelle fuer Fehlerpfad Dfp_RailCDOfsTst" VAL_BLK 0xCC750 Kwb_Wu8 255.0 OneToOne 0.00 255.0 FORMAT "%5.1" NUMBER 4 /end CHARACTERISTIC
/begin CHARACTERISTIC DSM_TypDfp_RailCD_PMonStrt_C "Konvertierung der Fehlertypen auf der Diagnoseschnittstelle fuer Fehlerpfad Dfp_RailCD_PMonStrt" VAL_BLK 0xCC754 Kwb_Wu8 255.0 OneToOne 0.00 255.0 FORMAT "%5.1" NUMBER 4 /end CHARACTERISTIC
/begin CHARACTERISTIC DSM_TypDfp_RailCtlModeMeUnDiag_C "Konvertierung der Fehlertypen auf der Diagnoseschnittstelle fuer Fehlerpfad Dfp_RailCtlModeMeUnDiag" VAL_BLK 0xCC758 Kwb_Wu8 255.0 OneToOne 0.00 255.0 FORMAT "%5.1" NUMBER 4 /end CHARACTERISTIC
/begin CHARACTERISTIC DSM_TypDfp_RailCtlModePCVDiag_C "Konvertierung der Fehlertypen auf der Diagnoseschnittstelle fuer Fehlerpfad Dfp_RailCtlModePCVDiag" VAL_BLK 0xCC75C Kwb_Wu8 255.0 OneToOne 0.00 255.0 FORMAT "%5.1" NUMBER 4 /end CHARACTERISTIC
/begin CHARACTERISTIC DSM_TypDfp_RailMeUn0_C "Konvertierung der Fehlertypen auf der Diagnoseschnittstelle fuer Fehlerpfad Dfp_RailMeUn0" VAL_BLK 0xCC760 Kwb_Wu8 255.0 OneToOne 0.00 255.0 FORMAT "%5.1" NUMBER 4 /end CHARACTERISTIC
/begin CHARACTERISTIC DSM_TypDfp_RailMeUn1_C "Konvertierung der Fehlertypen auf der Diagnoseschnittstelle fuer Fehlerpfad Dfp_RailMeUn1" VAL_BLK 0xCC764 Kwb_Wu8 255.0 OneToOne 0.00 255.0 FORMAT "%5.1" NUMBER 4 /end CHARACTERISTIC
/begin CHARACTERISTIC DSM_TypDfp_RailMeUn2_C "Konvertierung der Fehlertypen auf der Diagnoseschnittstelle fuer Fehlerpfad Dfp_RailMeUn2" VAL_BLK 0xCC768 Kwb_Wu8 255.0 OneToOne 0.00 255.0 FORMAT "%5.1" NUMBER 4 /end CHARACTERISTIC
/begin CHARACTERISTIC DSM_TypDfp_RailMeUn3_C "Konvertierung der Fehlertypen auf der Diagnoseschnittstelle fuer Fehlerpfad Dfp_RailMeUn3" VAL_BLK 0xCC76C Kwb_Wu8 255.0 OneToOne 0.00 255.0 FORMAT "%5.1" NUMBER 4 /end CHARACTERISTIC
/begin CHARACTERISTIC DSM_TypDfp_RailMeUn4_C "Konvertierung der Fehlertypen auf der Diagnoseschnittstelle fuer Fehlerpfad Dfp_RailMeUn4" VAL_BLK 0xCC770 Kwb_Wu8 255.0 OneToOne 0.00 255.0 FORMAT "%5.1" NUMBER 4 /end CHARACTERISTIC
/begin CHARACTERISTIC DSM_TypDfp_RailPCV0_C "Konvertierung der Fehlertypen auf der Diagnoseschnittstelle fuer Fehlerpfad Dfp_RailPCV0" VAL_BLK 0xCC774 Kwb_Wu8 255.0 OneToOne 0.00 255.0 FORMAT "%5.1" NUMBER 4 /end CHARACTERISTIC
/begin CHARACTERISTIC DSM_TypDfp_RailPCV1_C "Konvertierung der Fehlertypen auf der Diagnoseschnittstelle fuer Fehlerpfad Dfp_RailPCV1" VAL_BLK 0xCC778 Kwb_Wu8 255.0 OneToOne 0.00 255.0 FORMAT "%5.1" NUMBER 4 /end CHARACTERISTIC
/begin CHARACTERISTIC DSM_TypDfp_RailPCV2_C "Konvertierung der Fehlertypen auf der Diagnoseschnittstelle fuer Fehlerpfad Dfp_RailPCV2" VAL_BLK 0xCC77C Kwb_Wu8 255.0 OneToOne 0.00 255.0 FORMAT "%5.1" NUMBER 4 /end CHARACTERISTIC
/begin CHARACTERISTIC DSM_TypDfp_RailPCV3_C "Konvertierung der Fehlertypen auf der Diagnoseschnittstelle fuer Fehlerpfad Dfp_RailPCV3" VAL_BLK 0xCC780 Kwb_Wu8 255.0 OneToOne 0.00 255.0 FORMAT "%5.1" NUMBER 4 /end CHARACTERISTIC
/begin CHARACTERISTIC DSM_TypDfp_RailPCV4_C "Konvertierung der Fehlertypen auf der Diagnoseschnittstelle fuer Fehlerpfad Dfp_RailPCV4" VAL_BLK 0xCC784 Kwb_Wu8 255.0 OneToOne 0.00 255.0 FORMAT "%5.1" NUMBER 4 /end CHARACTERISTIC
/begin CHARACTERISTIC DSM_TypDfp_RailPCV5_C "Konvertierung der Fehlertypen auf der Diagnoseschnittstelle fuer Fehlerpfad Dfp_RailPCV5" VAL_BLK 0xCC788 Kwb_Wu8 255.0 OneToOne 0.00 255.0 FORMAT "%5.1" NUMBER 4 /end CHARACTERISTIC
/begin CHARACTERISTIC DSM_TypDfp_SOPTst_C "Konvertierung der Fehlertypen auf der Diagnoseschnittstelle fuer Fehlerpfad Dfp_SOPTst" VAL_BLK 0xCC78C Kwb_Wu8 255.0 OneToOne 0.00 255.0 FORMAT "%5.1" NUMBER 4 /end CHARACTERISTIC
/begin CHARACTERISTIC DSM_TypDfp_SSpMon1_C "Konvertierung der Fehlertypen auf der Diagnoseschnittstelle fuer Fehlerpfad Dfp_SSpMon1" VAL_BLK 0xCC790 Kwb_Wu8 255.0 OneToOne 0.00 255.0 FORMAT "%5.1" NUMBER 4 /end CHARACTERISTIC
/begin CHARACTERISTIC DSM_TypDfp_SSpMon2_C "Konvertierung der Fehlertypen auf der Diagnoseschnittstelle fuer Fehlerpfad Dfp_SSpMon2" VAL_BLK 0xCC794 Kwb_Wu8 255.0 OneToOne 0.00 255.0 FORMAT "%5.1" NUMBER 4 /end CHARACTERISTIC
/begin CHARACTERISTIC DSM_TypDfp_SSpMon3_C "Konvertierung der Fehlertypen auf der Diagnoseschnittstelle fuer Fehlerpfad Dfp_SSpMon3" VAL_BLK 0xCC798 Kwb_Wu8 255.0 OneToOne 0.00 255.0 FORMAT "%5.1" NUMBER 4 /end CHARACTERISTIC
/begin CHARACTERISTIC DSM_TypDfp_ShutCD_C "Konvertierung der Fehlertypen auf der Diagnoseschnittstelle fuer Fehlerpfad Dfp_ShutCD" VAL_BLK 0xCC79C Kwb_Wu8 255.0 OneToOne 0.00 255.0 FORMAT "%5.1" NUMBER 4 /end CHARACTERISTIC
/begin CHARACTERISTIC DSM_TypDfp_StSysTrqShutOff_C "Konvertierung der Fehlertypen auf der Diagnoseschnittstelle fuer Fehlerpfad Dfp_StSysTrqShutOff" VAL_BLK 0xCC7A0 Kwb_Wu8 255.0 OneToOne 0.00 255.0 FORMAT "%5.1" NUMBER 4 /end CHARACTERISTIC
/begin CHARACTERISTIC DSM_TypDfp_StrtCD_Actr_C "Konvertierung der Fehlertypen auf der Diagnoseschnittstelle fuer Fehlerpfad Dfp_StrtCD_Actr" VAL_BLK 0xCC7A4 Kwb_Wu8 255.0 OneToOne 0.00 255.0 FORMAT "%5.1" NUMBER 4 /end CHARACTERISTIC
/begin CHARACTERISTIC DSM_TypDfp_SysLamp_C "Konvertierung der Fehlertypen auf der Diagnoseschnittstelle fuer Fehlerpfad Dfp_SysLamp" VAL_BLK 0xCC7A8 Kwb_Wu8 255.0 OneToOne 0.00 255.0 FORMAT "%5.1" NUMBER 4 /end CHARACTERISTIC
/begin CHARACTERISTIC DSM_TypDfp_T15CD_C "Konvertierung der Fehlertypen auf der Diagnoseschnittstelle fuer Fehlerpfad Dfp_T15CD" VAL_BLK 0xCC7AC Kwb_Wu8 255.0 OneToOne 0.00 255.0 FORMAT "%5.1" NUMBER 4 /end CHARACTERISTIC
/begin CHARACTERISTIC DSM_TypDfp_TGearbx_C "Konvertierung der Fehlertypen auf der Diagnoseschnittstelle fuer Fehlerpfad Dfp_TGearbx" VAL_BLK 0xCC7B0 Kwb_Wu8 255.0 OneToOne 0.00 255.0 FORMAT "%5.1" NUMBER 4 /end CHARACTERISTIC
/begin CHARACTERISTIC DSM_TypDfp_TPUMon_C "Konvertierung der Fehlertypen auf der Diagnoseschnittstelle fuer Fehlerpfad Dfp_TPUMon" VAL_BLK 0xCC7B4 Kwb_Wu8 255.0 OneToOne 0.00 255.0 FORMAT "%5.1" NUMBER 4 /end CHARACTERISTIC
/begin CHARACTERISTIC DSM_TypDfp_TVACD_Max_C "Konvertierung der Fehlertypen auf der Diagnoseschnittstelle fuer Fehlerpfad Dfp_TVACD_Max" VAL_BLK 0xCC7B8 Kwb_Wu8 255.0 OneToOne 0.00 255.0 FORMAT "%5.1" NUMBER 4 /end CHARACTERISTIC
/begin CHARACTERISTIC DSM_TypDfp_TVACD_Min_C "Konvertierung der Fehlertypen auf der Diagnoseschnittstelle fuer Fehlerpfad Dfp_TVACD_Min" VAL_BLK 0xCC7BC Kwb_Wu8 255.0 OneToOne 0.00 255.0 FORMAT "%5.1" NUMBER 4 /end CHARACTERISTIC
/begin CHARACTERISTIC DSM_TypDfp_TVACD_SigNpl_C "Konvertierung der Fehlertypen auf der Diagnoseschnittstelle fuer Fehlerpfad Dfp_TVACD_SigNpl" VAL_BLK 0xCC7C0 Kwb_Wu8 255.0 OneToOne 0.00 255.0 FORMAT "%5.1" NUMBER 4 /end CHARACTERISTIC
/begin CHARACTERISTIC DSM_TypDfp_TVACD_TVADia1_C "Konvertierung der Fehlertypen auf der Diagnoseschnittstelle fuer Fehlerpfad Dfp_TVACD_TVADia1" VAL_BLK 0xCC7C4 Kwb_Wu8 255.0 OneToOne 0.00 255.0 FORMAT "%5.1" NUMBER 4 /end CHARACTERISTIC
/begin CHARACTERISTIC DSM_TypDfp_TVACD_TVADia2_C "Konvertierung der Fehlertypen auf der Diagnoseschnittstelle fuer Fehlerpfad Dfp_TVACD_TVADia2" VAL_BLK 0xCC7C8 Kwb_Wu8 255.0 OneToOne 0.00 255.0 FORMAT "%5.1" NUMBER 4 /end CHARACTERISTIC
/begin CHARACTERISTIC DSM_TypDfp_TVACD_TVADia3_C "Konvertierung der Fehlertypen auf der Diagnoseschnittstelle fuer Fehlerpfad Dfp_TVACD_TVADia3" VAL_BLK 0xCC7CC Kwb_Wu8 255.0 OneToOne 0.00 255.0 FORMAT "%5.1" NUMBER 4 /end CHARACTERISTIC
/begin CHARACTERISTIC DSM_TypDfp_VSACD_Max_C "Konvertierung der Fehlertypen auf der Diagnoseschnittstelle fuer Fehlerpfad Dfp_VSACD_Max" VAL_BLK 0xCC7D0 Kwb_Wu8 255.0 OneToOne 0.00 255.0 FORMAT "%5.1" NUMBER 4 /end CHARACTERISTIC
/begin CHARACTERISTIC DSM_TypDfp_VSACD_Min_C "Konvertierung der Fehlertypen auf der Diagnoseschnittstelle fuer Fehlerpfad Dfp_VSACD_Min" VAL_BLK 0xCC7D4 Kwb_Wu8 255.0 OneToOne 0.00 255.0 FORMAT "%5.1" NUMBER 4 /end CHARACTERISTIC
/begin CHARACTERISTIC DSM_TypDfp_VSACD_SigNpl_C "Konvertierung der Fehlertypen auf der Diagnoseschnittstelle fuer Fehlerpfad Dfp_VSACD_SigNpl" VAL_BLK 0xCC7D8 Kwb_Wu8 255.0 OneToOne 0.00 255.0 FORMAT "%5.1" NUMBER 4 /end CHARACTERISTIC
/begin CHARACTERISTIC DSM_TypDfp_VSACD_VSADia1_C "Konvertierung der Fehlertypen auf der Diagnoseschnittstelle fuer Fehlerpfad Dfp_VSACD_VSADia1" VAL_BLK 0xCC7DC Kwb_Wu8 255.0 OneToOne 0.00 255.0 FORMAT "%5.1" NUMBER 4 /end CHARACTERISTIC
/begin CHARACTERISTIC DSM_TypDfp_VSACD_VSADia2_C "Konvertierung der Fehlertypen auf der Diagnoseschnittstelle fuer Fehlerpfad Dfp_VSACD_VSADia2" VAL_BLK 0xCC7E0 Kwb_Wu8 255.0 OneToOne 0.00 255.0 FORMAT "%5.1" NUMBER 4 /end CHARACTERISTIC
/begin CHARACTERISTIC DSM_TypDfp_VSACD_VSADia3_C "Konvertierung der Fehlertypen auf der Diagnoseschnittstelle fuer Fehlerpfad Dfp_VSACD_VSADia3" VAL_BLK 0xCC7E4 Kwb_Wu8 255.0 OneToOne 0.00 255.0 FORMAT "%5.1" NUMBER 4 /end CHARACTERISTIC
/begin CHARACTERISTIC DSM_TypDfp_VSACD_VSADia4_C "Konvertierung der Fehlertypen auf der Diagnoseschnittstelle fuer Fehlerpfad Dfp_VSACD_VSADia4" VAL_BLK 0xCC7E8 Kwb_Wu8 255.0 OneToOne 0.00 255.0 FORMAT "%5.1" NUMBER 4 /end CHARACTERISTIC
/begin CHARACTERISTIC DSM_TypDfp_VSSCD1_C "Konvertierung der Fehlertypen auf der Diagnoseschnittstelle fuer Fehlerpfad Dfp_VSSCD1" VAL_BLK 0xCC7EC Kwb_Wu8 255.0 OneToOne 0.00 255.0 FORMAT "%5.1" NUMBER 4 /end CHARACTERISTIC
/begin CHARACTERISTIC DSM_TypDfp_VSSCD2_C "Konvertierung der Fehlertypen auf der Diagnoseschnittstelle fuer Fehlerpfad Dfp_VSSCD2" VAL_BLK 0xCC7F0 Kwb_Wu8 255.0 OneToOne 0.00 255.0 FORMAT "%5.1" NUMBER 4 /end CHARACTERISTIC
/begin CHARACTERISTIC DSM_TypDfp_WdCom_C "Konvertierung der Fehlertypen auf der Diagnoseschnittstelle fuer Fehlerpfad Dfp_WdCom" VAL_BLK 0xCC7F4 Kwb_Wu8 255.0 OneToOne 0.00 255.0 FORMAT "%5.1" NUMBER 4 /end CHARACTERISTIC
/begin CHARACTERISTIC DSM_TsfDfp_Layer_TANS_C "Schwerezaehlergrenze fuer Fehlerpfad Dfp_Layer_TANS" VALUE 0xCC7F8 Kw_Wu8 51000. TimeDsmTsf 0.00 51000. FORMAT "%5.0" /end CHARACTERISTIC
/begin CHARACTERISTIC DSM_TsfDfp_ACCDSwtin_C "Schwerezaehlergrenze fuer Fehlerpfad Dfp_ACCDSwtin" VALUE 0xCC7F9 Kw_Wu8 51000. TimeDsmTsf 0.00 51000. FORMAT "%5.0" /end CHARACTERISTIC
/begin CHARACTERISTIC DSM_TsfDfp_ACC_PlausTrqDes_C "Schwerezaehlergrenze fuer Fehlerpfad Dfp_ACC_PlausTrqDes" VALUE 0xCC7FA Kw_Wu8 51000. TimeDsmTsf 0.00 51000. FORMAT "%5.0" /end CHARACTERISTIC
/begin CHARACTERISTIC DSM_TsfDfp_ACC_trqInr_C "Schwerezaehlergrenze fuer Fehlerpfad Dfp_ACC_trqInr" VALUE 0xCC7FB Kw_Wu8 51000. TimeDsmTsf 0.00 51000. FORMAT "%5.0" /end CHARACTERISTIC
/begin CHARACTERISTIC DSM_TsfDfp_ACTrq_C "Schwerezaehlergrenze fuer Fehlerpfad Dfp_ACTrq" VALUE 0xCC7FC Kw_Wu8 51000. TimeDsmTsf 0.00 51000. FORMAT "%5.0" /end CHARACTERISTIC
/begin CHARACTERISTIC DSM_TsfDfp_ADCMon_C "Schwerezaehlergrenze fuer Fehlerpfad Dfp_ADCMon" VALUE 0xCC7FD Kw_Wu8 51000. TimeDsmTsf 0.00 51000. FORMAT "%5.0" /end CHARACTERISTIC
/begin CHARACTERISTIC DSM_TsfDfp_AFSCDIdlAdjVal_C "Schwerezaehlergrenze fuer Fehlerpfad Dfp_AFSCDIdlAdjVal" VALUE 0xCC7FE Kw_Wu8 51000. TimeDsmTsf 0.00 51000. FORMAT "%5.0" /end CHARACTERISTIC
/begin CHARACTERISTIC DSM_TsfDfp_AFSCDLdAdjVal_C "Schwerezaehlergrenze fuer Fehlerpfad Dfp_AFSCDLdAdjVal" VALUE 0xCC7FF Kw_Wu8 51000. TimeDsmTsf 0.00 51000. FORMAT "%5.0" /end CHARACTERISTIC
/begin CHARACTERISTIC DSM_TsfDfp_AFSCD_AirTempDcyc_C "Schwerezaehlergrenze fuer Fehlerpfad Dfp_AFSCD_AirTempDcyc" VALUE 0xCC800 Kw_Wu8 51000. TimeDsmTsf 0.00 51000. FORMAT "%5.0" /end CHARACTERISTIC
/begin CHARACTERISTIC DSM_TsfDfp_AFSCD_PlOffsDrft_C "Schwerezaehlergrenze fuer Fehlerpfad Dfp_AFSCD_PlOffsDrft" VALUE 0xCC801 Kw_Wu8 51000. TimeDsmTsf 0.00 51000. FORMAT "%5.0" /end CHARACTERISTIC
/begin CHARACTERISTIC DSM_TsfDfp_AFSCD_PlSetyDrft_C "Schwerezaehlergrenze fuer Fehlerpfad Dfp_AFSCD_PlSetyDrft" VALUE 0xCC802 Kw_Wu8 51000. TimeDsmTsf 0.00 51000. FORMAT "%5.0" /end CHARACTERISTIC
/begin CHARACTERISTIC DSM_TsfDfp_AFSCD_SRCAirTemp_C "Schwerezaehlergrenze fuer Fehlerpfad Dfp_AFSCD_SRCAirTemp" VALUE 0xCC803 Kw_Wu8 51000. TimeDsmTsf 0.00 51000. FORMAT "%5.0" /end CHARACTERISTIC
/begin CHARACTERISTIC DSM_TsfDfp_AFSCD_SRCBatt_C "Schwerezaehlergrenze fuer Fehlerpfad Dfp_AFSCD_SRCBatt" VALUE 0xCC804 Kw_Wu8 51000. TimeDsmTsf 0.00 51000. FORMAT "%5.0" /end CHARACTERISTIC
/begin CHARACTERISTIC DSM_TsfDfp_AFSCD_SRCCorrAirm_C "Schwerezaehlergrenze fuer Fehlerpfad Dfp_AFSCD_SRCCorrAirm" VALUE 0xCC805 Kw_Wu8 51000. TimeDsmTsf 0.00 51000. FORMAT "%5.0" /end CHARACTERISTIC
/begin CHARACTERISTIC DSM_TsfDfp_AFSCD_SRCRawAirm_C "Schwerezaehlergrenze fuer Fehlerpfad Dfp_AFSCD_SRCRawAirm" VALUE 0xCC806 Kw_Wu8 51000. TimeDsmTsf 0.00 51000. FORMAT "%5.0" /end CHARACTERISTIC
/begin CHARACTERISTIC DSM_TsfDfp_AFSCD_SRCRefSigPer_C "Schwerezaehlergrenze fuer Fehlerpfad Dfp_AFSCD_SRCRefSigPer" VALUE 0xCC807 Kw_Wu8 51000. TimeDsmTsf 0.00 51000. FORMAT "%5.0" /end CHARACTERISTIC
/begin CHARACTERISTIC DSM_TsfDfp_AOHtCD_C "Schwerezaehlergrenze fuer Fehlerpfad Dfp_AOHtCD" VALUE 0xCC808 Kw_Wu8 51000. TimeDsmTsf 0.00 51000. FORMAT "%5.0" /end CHARACTERISTIC
/begin CHARACTERISTIC DSM_TsfDfp_AOHtCD_AOHtDia1_C "Schwerezaehlergrenze fuer Fehlerpfad Dfp_AOHtCD_AOHtDia1" VALUE 0xCC809 Kw_Wu8 51000. TimeDsmTsf 0.00 51000. FORMAT "%5.0" /end CHARACTERISTIC
/begin CHARACTERISTIC DSM_TsfDfp_AOHtCD_AOHtDia2_C "Schwerezaehlergrenze fuer Fehlerpfad Dfp_AOHtCD_AOHtDia2" VALUE 0xCC80A Kw_Wu8 51000. TimeDsmTsf 0.00 51000. FORMAT "%5.0" /end CHARACTERISTIC
/begin CHARACTERISTIC DSM_TsfDfp_Layer_TUMG_C "Schwerezaehlergrenze fuer Fehlerpfad Dfp_Layer_TUMG" VALUE 0xCC80B Kw_Wu8 51000. TimeDsmTsf 0.00 51000. FORMAT "%5.0" /end CHARACTERISTIC
/begin CHARACTERISTIC DSM_TsfDfp_AOHtCD_AOHtDia3_C "Schwerezaehlergrenze fuer Fehlerpfad Dfp_AOHtCD_AOHtDia3" VALUE 0xCC80C Kw_Wu8 51000. TimeDsmTsf 0.00 51000. FORMAT "%5.0" /end CHARACTERISTIC
/begin CHARACTERISTIC DSM_TsfDfp_APP1_C "Schwerezaehlergrenze fuer Fehlerpfad Dfp_APP1" VALUE 0xCC80D Kw_Wu8 51000. TimeDsmTsf 0.00 51000. FORMAT "%5.0" /end CHARACTERISTIC
/begin CHARACTERISTIC DSM_TsfDfp_Layer_GEN_C "Schwerezaehlergrenze fuer Fehlerpfad Dfp_Layer_GEN" VALUE 0xCC80E Kw_Wu8 51000. TimeDsmTsf 0.00 51000. FORMAT "%5.0" /end CHARACTERISTIC
/begin CHARACTERISTIC DSM_TsfDfp_Layer_BSD_C "Schwerezaehlergrenze fuer Fehlerpfad Dfp_Layer_BSD" VALUE 0xCC80F Kw_Wu8 51000. TimeDsmTsf 0.00 51000. FORMAT "%5.0" /end CHARACTERISTIC
/begin CHARACTERISTIC DSM_TsfDfp_APP2_C "Schwerezaehlergrenze fuer Fehlerpfad Dfp_APP2" VALUE 0xCC810 Kw_Wu8 51000. TimeDsmTsf 0.00 51000. FORMAT "%5.0" /end CHARACTERISTIC
/begin CHARACTERISTIC DSM_TsfDfp_APSCD_C "Schwerezaehlergrenze fuer Fehlerpfad Dfp_APSCD" VALUE 0xCC811 Kw_Wu8 51000. TimeDsmTsf 0.00 51000. FORMAT "%5.0" /end CHARACTERISTIC
/begin CHARACTERISTIC DSM_TsfDfp_ARS_C "Schwerezaehlergrenze fuer Fehlerpfad Dfp_ARS" VALUE 0xCC812 Kw_Wu8 51000. TimeDsmTsf 0.00 51000. FORMAT "%5.0" /end CHARACTERISTIC
/begin CHARACTERISTIC DSM_TsfDfp_AccPedPlausBrk_C "Schwerezaehlergrenze fuer Fehlerpfad Dfp_AccPedPlausBrk" VALUE 0xCC813 Kw_Wu8 51000. TimeDsmTsf 0.00 51000. FORMAT "%5.0" /end CHARACTERISTIC
/begin CHARACTERISTIC DSM_TsfDfp_AirCtlPlateBreak_C "DSM variable for Dfp_AirCtlPlateBreak_mp" VALUE 0xCC814 Kw_Wu8 51000. TimeDsmTsf 0.00 51000. FORMAT "%5.0" /end CHARACTERISTIC
/begin CHARACTERISTIC DSM_TsfDfp_AirCtl_GovNegDev_C "Schwerezaehlergrenze fuer Fehlerpfad Dfp_AirCtl_GovNegDev" VALUE 0xCC815 Kw_Wu8 51000. TimeDsmTsf 0.00 51000. FORMAT "%5.0" /end CHARACTERISTIC
/begin CHARACTERISTIC DSM_TsfDfp_AirCtl_GovNegDev2_C "Schwerezaehlergrenze fuer Fehlerpfad Dfp_AirCtl_GovNegDev2" VALUE 0xCC816 Kw_Wu8 51000. TimeDsmTsf 0.00 51000. FORMAT "%5.0" /end CHARACTERISTIC
/begin CHARACTERISTIC DSM_TsfDfp_AirCtl_GovPosDev_C "Schwerezaehlergrenze fuer Fehlerpfad Dfp_AirCtl_GovPosDev" VALUE 0xCC817 Kw_Wu8 51000. TimeDsmTsf 0.00 51000. FORMAT "%5.0" /end CHARACTERISTIC
/begin CHARACTERISTIC DSM_TsfDfp_AirCtl_GovPosDev2_C "Schwerezaehlergrenze fuer Fehlerpfad Dfp_AirCtl_GovPosDev2" VALUE 0xCC818 Kw_Wu8 51000. TimeDsmTsf 0.00 51000. FORMAT "%5.0" /end CHARACTERISTIC
/begin CHARACTERISTIC DSM_TsfDfp_AltCD_C "Schwerezaehlergrenze fuer Fehlerpfad Dfp_AltCD" VALUE 0xCC819 Kw_Wu8 51000. TimeDsmTsf 0.00 51000. FORMAT "%5.0" /end CHARACTERISTIC
/begin CHARACTERISTIC DSM_TsfDfp_Layer_QLT_C "Schwerezaehlergrenze fuer Fehlerpfad Dfp_Layer_QLT" VALUE 0xCC81A Kw_Wu8 51000. TimeDsmTsf 0.00 51000. FORMAT "%5.0" /end CHARACTERISTIC
/begin CHARACTERISTIC DSM_TsfDfp_BPACD_BPADia1_C "Schwerezaehlergrenze fuer Fehlerpfad Dfp_BPACD_BPADia1" VALUE 0xCC81B Kw_Wu8 51000. TimeDsmTsf 0.00 51000. FORMAT "%5.0" /end CHARACTERISTIC
/begin CHARACTERISTIC DSM_TsfDfp_Layer_IBS1_C "Schwerezaehlergrenze fuer Fehlerpfad Dfp_Layer_IBS1" VALUE 0xCC81C Kw_Wu8 51000. TimeDsmTsf 0.00 51000. FORMAT "%5.0" /end CHARACTERISTIC
/begin CHARACTERISTIC DSM_TsfDfp_Layer_IBS2_C "Schwerezaehlergrenze fuer Fehlerpfad Dfp_Layer_IBS2" VALUE 0xCC81D Kw_Wu8 51000. TimeDsmTsf 0.00 51000. FORMAT "%5.0" /end CHARACTERISTIC
/begin CHARACTERISTIC DSM_TsfDfp_Layer_IBS3_C "Schwerezaehlergrenze fuer Fehlerpfad Dfp_Layer_IBS3" VALUE 0xCC81E Kw_Wu8 51000. TimeDsmTsf 0.00 51000. FORMAT "%5.0" /end CHARACTERISTIC
/begin CHARACTERISTIC DSM_TsfDfp_Layer_PMBN_C "Schwerezaehlergrenze fuer Fehlerpfad Dfp_Layer_PMBN" VALUE 0xCC81F Kw_Wu8 51000. TimeDsmTsf 0.00 51000. FORMAT "%5.0" /end CHARACTERISTIC
/begin CHARACTERISTIC DSM_TsfDfp_Layer_PMBATT_C "Schwerezaehlergrenze fuer Fehlerpfad Dfp_Layer_PMBATT" VALUE 0xCC820 Kw_Wu8 51000. TimeDsmTsf 0.00 51000. FORMAT "%5.0" /end CHARACTERISTIC
/begin CHARACTERISTIC DSM_TsfDfp_BPACD_BPADia2_C "Schwerezaehlergrenze fuer Fehlerpfad Dfp_BPACD_BPADia2" VALUE 0xCC821 Kw_Wu8 51000. TimeDsmTsf 0.00 51000. FORMAT "%5.0" /end CHARACTERISTIC
/begin CHARACTERISTIC DSM_TsfDfp_BPACD_BPADia3_C "Schwerezaehlergrenze fuer Fehlerpfad Dfp_BPACD_BPADia3" VALUE 0xCC822 Kw_Wu8 51000. TimeDsmTsf 0.00 51000. FORMAT "%5.0" /end CHARACTERISTIC
/begin CHARACTERISTIC DSM_TsfDfp_BPACD_Max_C "Schwerezaehlergrenze fuer Fehlerpfad Dfp_BPACD_Max" VALUE 0xCC823 Kw_Wu8 51000. TimeDsmTsf 0.00 51000. FORMAT "%5.0" /end CHARACTERISTIC
/begin CHARACTERISTIC DSM_TsfDfp_BPACD_Min_C "Schwerezaehlergrenze fuer Fehlerpfad Dfp_BPACD_Min" VALUE 0xCC824 Kw_Wu8 51000. TimeDsmTsf 0.00 51000. FORMAT "%5.0" /end CHARACTERISTIC
/begin CHARACTERISTIC DSM_TsfDfp_BPACD_SigNpl_C "Schwerezaehlergrenze fuer Fehlerpfad Dfp_BPACD_SigNpl" VALUE 0xCC825 Kw_Wu8 51000. TimeDsmTsf 0.00 51000. FORMAT "%5.0" /end CHARACTERISTIC
/begin CHARACTERISTIC DSM_TsfDfp_BPSCD_C "Schwerezaehlergrenze fuer Fehlerpfad Dfp_BPSCD" VALUE 0xCC826 Kw_Wu8 51000. TimeDsmTsf 0.00 51000. FORMAT "%5.0" /end CHARACTERISTIC
/begin CHARACTERISTIC DSM_TsfDfp_BattCD_C "Schwerezaehlergrenze fuer Fehlerpfad Dfp_BattCD" VALUE 0xCC827 Kw_Wu8 51000. TimeDsmTsf 0.00 51000. FORMAT "%5.0" /end CHARACTERISTIC
/begin CHARACTERISTIC DSM_TsfDfp_BrkCD_C "Schwerezaehlergrenze fuer Fehlerpfad Dfp_BrkCD" VALUE 0xCC828 Kw_Wu8 51000. TimeDsmTsf 0.00 51000. FORMAT "%5.0" /end CHARACTERISTIC
/begin CHARACTERISTIC DSM_TsfDfp_Bss_C "Schwerezaehlergrenze fuer Fehlerpfad Dfp_Bss" VALUE 0xCC829 Kw_Wu8 51000. TimeDsmTsf 0.00 51000. FORMAT "%5.0" /end CHARACTERISTIC
/begin CHARACTERISTIC DSM_TsfDfp_CBACD_C "Schwerezaehlergrenze fuer Fehlerpfad Dfp_CBACD" VALUE 0xCC82A Kw_Wu8 51000. TimeDsmTsf 0.00 51000. FORMAT "%5.0" /end CHARACTERISTIC
/begin CHARACTERISTIC DSM_TsfDfp_CTSCD_C "Schwerezaehlergrenze fuer Fehlerpfad Dfp_CTSCD" VALUE 0xCC82B Kw_Wu8 51000. TimeDsmTsf 0.00 51000. FORMAT "%5.0" /end CHARACTERISTIC
/begin CHARACTERISTIC DSM_TsfDfp_Clg_DynTst_C "Schwerezaehlergrenze fuer Fehlerpfad Dfp_Clg_DynTst" VALUE 0xCC82C Kw_Wu8 51000. TimeDsmTsf 0.00 51000. FORMAT "%5.0" /end CHARACTERISTIC
/begin CHARACTERISTIC DSM_TsfDfp_CmbChbMisfire1_C "Schwerezaehlergrenze fuer Fehlerpfad Dfp_CmbChbMisfire1" VALUE 0xCC82D Kw_Wu8 51000. TimeDsmTsf 0.00 51000. FORMAT "%5.0" /end CHARACTERISTIC
/begin CHARACTERISTIC DSM_TsfDfp_CmbChbMisfire2_C "Schwerezaehlergrenze fuer Fehlerpfad Dfp_CmbChbMisfire2" VALUE 0xCC82E Kw_Wu8 51000. TimeDsmTsf 0.00 51000. FORMAT "%5.0" /end CHARACTERISTIC
/begin CHARACTERISTIC DSM_TsfDfp_CmbChbMisfire3_C "Schwerezaehlergrenze fuer Fehlerpfad Dfp_CmbChbMisfire3" VALUE 0xCC82F Kw_Wu8 51000. TimeDsmTsf 0.00 51000. FORMAT "%5.0" /end CHARACTERISTIC
/begin CHARACTERISTIC DSM_TsfDfp_CmbChbMisfire4_C "Schwerezaehlergrenze fuer Fehlerpfad Dfp_CmbChbMisfire4" VALUE 0xCC830 Kw_Wu8 51000. TimeDsmTsf 0.00 51000. FORMAT "%5.0" /end CHARACTERISTIC
/begin CHARACTERISTIC DSM_TsfDfp_CmbChbMisfire5_C "Schwerezaehlergrenze fuer Fehlerpfad Dfp_CmbChbMisfire5" VALUE 0xCC831 Kw_Wu8 51000. TimeDsmTsf 0.00 51000. FORMAT "%5.0" /end CHARACTERISTIC
/begin CHARACTERISTIC DSM_TsfDfp_CmbChbMisfire6_C "Schwerezaehlergrenze fuer Fehlerpfad Dfp_CmbChbMisfire6" VALUE 0xCC832 Kw_Wu8 51000. TimeDsmTsf 0.00 51000. FORMAT "%5.0" /end CHARACTERISTIC
/begin CHARACTERISTIC DSM_TsfDfp_CmbChbMisfireMul_C "Schwerezaehlergrenze fuer Fehlerpfad Dfp_CmbChbMisfireMul" VALUE 0xCC833 Kw_Wu8 51000. TimeDsmTsf 0.00 51000. FORMAT "%5.0" /end CHARACTERISTIC
/begin CHARACTERISTIC DSM_TsfDfp_CoVMDCSh_C "Schwerezaehlergrenze fuer Fehlerpfad Dfp_CoVMDCSh" VALUE 0xCC834 Kw_Wu8 51000. TimeDsmTsf 0.00 51000. FORMAT "%5.0" /end CHARACTERISTIC
/begin CHARACTERISTIC DSM_TsfDfp_ConvCD_C "Schwerezaehlergrenze fuer Fehlerpfad Dfp_ConvCD" VALUE 0xCC835 Kw_Wu8 51000. TimeDsmTsf 0.00 51000. FORMAT "%5.0" /end CHARACTERISTIC
/begin CHARACTERISTIC DSM_TsfDfp_CrCCDMFL_C "Schwerezaehlergrenze fuer Fehlerpfad Dfp_CrCCDMFL" VALUE 0xCC836 Kw_Wu8 51000. TimeDsmTsf 0.00 51000. FORMAT "%5.0" /end CHARACTERISTIC
/begin CHARACTERISTIC DSM_TsfDfp_CrCtl_vCrCtl_C "Schwerezaehlergrenze fuer Fehlerpfad Dfp_CrCtl_vCrCtl" VALUE 0xCC837 Kw_Wu8 51000. TimeDsmTsf 0.00 51000. FORMAT "%5.0" /end CHARACTERISTIC
/begin CHARACTERISTIC DSM_TsfDfp_Dummy1_C "Schwerezaehlergrenze fuer Fehlerpfad Dfp_Dummy1" VALUE 0xCC838 Kw_Wu8 51000. TimeDsmTsf 0.00 51000. FORMAT "%5.0" /end CHARACTERISTIC
/begin CHARACTERISTIC DSM_TsfDfp_EATSCD_C "Schwerezaehlergrenze fuer Fehlerpfad Dfp_EATSCD" VALUE 0xCC839 Kw_Wu8 51000. TimeDsmTsf 0.00 51000. FORMAT "%5.0" /end CHARACTERISTIC
/begin CHARACTERISTIC DSM_TsfDfp_EBAFCD_C "Schwerezaehlergrenze fuer Fehlerpfad Dfp_EBAFCD" VALUE 0xCC83A Kw_Wu8 51000. TimeDsmTsf 0.00 51000. FORMAT "%5.0" /end CHARACTERISTIC
/begin CHARACTERISTIC DSM_TsfDfp_EBFCD_C "Schwerezaehlergrenze fuer Fehlerpfad Dfp_EBFCD" VALUE 0xCC83B Kw_Wu8 51000. TimeDsmTsf 0.00 51000. FORMAT "%5.0" /end CHARACTERISTIC
/begin CHARACTERISTIC DSM_TsfDfp_EBTSCD_C "Schwerezaehlergrenze fuer Fehlerpfad Dfp_EBTSCD" VALUE 0xCC83C Kw_Wu8 51000. TimeDsmTsf 0.00 51000. FORMAT "%5.0" /end CHARACTERISTIC
/begin CHARACTERISTIC DSM_TsfDfp_EBTSCD_OvrTemp_C "Schwerezaehlergrenze fuer Fehlerpfad Dfp_EBTSCD_OvrTemp" VALUE 0xCC83D Kw_Wu8 51000. TimeDsmTsf 0.00 51000. FORMAT "%5.0" /end CHARACTERISTIC
/begin CHARACTERISTIC DSM_TsfDfp_EEPCDVarMng_C "Schwerezaehlergrenze fuer Fehlerpfad Dfp_EEPCDVarMng" VALUE 0xCC83E Kw_Wu8 51000. TimeDsmTsf 0.00 51000. FORMAT "%5.0" /end CHARACTERISTIC
/begin CHARACTERISTIC DSM_TsfDfp_EGPpCD_C "Schwerezaehlergrenze fuer Fehlerpfad Dfp_EGPpCD" VALUE 0xCC83F Kw_Wu8 51000. TimeDsmTsf 0.00 51000. FORMAT "%5.0" /end CHARACTERISTIC
/begin CHARACTERISTIC DSM_TsfDfp_EGPpCDTPreTrbn_C "Schwerezaehlergrenze fuer Fehlerpfad Dfp_EgPpCDTPreTrbn" VALUE 0xCC840 Kw_Wu8 51000. TimeDsmTsf 0.00 51000. FORMAT "%5.0" /end CHARACTERISTIC
/begin CHARACTERISTIC DSM_TsfDfp_Layer_PMRUHVERL_C "" VALUE 0xCC841 Kw_Wu8 51000. TimeDsmTsf 0.00 51000. FORMAT "%5.0" /end CHARACTERISTIC
/begin CHARACTERISTIC DSM_TsfDfp_EGRCD_Max_C "Schwerezaehlergrenze fuer Fehlerpfad Dfp_EGRCD_Max" VALUE 0xCC842 Kw_Wu8 51000. TimeDsmTsf 0.00 51000. FORMAT "%5.0" /end CHARACTERISTIC
/begin CHARACTERISTIC DSM_TsfDfp_EGRCD_Min_C "Schwerezaehlergrenze fuer Fehlerpfad Dfp_EGRCD_Min" VALUE 0xCC843 Kw_Wu8 51000. TimeDsmTsf 0.00 51000. FORMAT "%5.0" /end CHARACTERISTIC
/begin CHARACTERISTIC DSM_TsfDfp_EGRCD_SigNpl_C "Schwerezaehlergrenze fuer Fehlerpfad Dfp_EGRCD_SigNpl" VALUE 0xCC844 Kw_Wu8 51000. TimeDsmTsf 0.00 51000. FORMAT "%5.0" /end CHARACTERISTIC
/begin CHARACTERISTIC DSM_TsfDfp_EGTRgnOilDil_C "Schwerezaehlergrenze fuer Fehlerpfad Dfp_EGTRgnOilDil" VALUE 0xCC845 Kw_Wu8 51000. TimeDsmTsf 0.00 51000. FORMAT "%5.0" /end CHARACTERISTIC
/begin CHARACTERISTIC DSM_TsfDfp_Layer_TOENS_C "" VALUE 0xCC846 Kw_Wu8 51000. TimeDsmTsf 0.00 51000. FORMAT "%5.0" /end CHARACTERISTIC
/begin CHARACTERISTIC DSM_TsfDfp_Layer_MANHYDR_C "" VALUE 0xCC847 Kw_Wu8 51000. TimeDsmTsf 0.00 51000. FORMAT "%5.0" /end CHARACTERISTIC
/begin CHARACTERISTIC DSM_TsfDfp_Layer_MANLUFT_C "" VALUE 0xCC848 Kw_Wu8 51000. TimeDsmTsf 0.00 51000. FORMAT "%5.0" /end CHARACTERISTIC
/begin CHARACTERISTIC DSM_TsfDfp_ETClbETFltInj1_C "Schwerezaehlergrenze fuer Fehlerpfad Dfp_ETClbETFltInj1" VALUE 0xCC849 Kw_Wu8 51000. TimeDsmTsf 0.00 51000. FORMAT "%5.0" /end CHARACTERISTIC
/begin CHARACTERISTIC DSM_TsfDfp_ETClbETFltInj2_C "Schwerezaehlergrenze fuer Fehlerpfad Dfp_ETClbETFltInj2" VALUE 0xCC84A Kw_Wu8 51000. TimeDsmTsf 0.00 51000. FORMAT "%5.0" /end CHARACTERISTIC
/begin CHARACTERISTIC DSM_TsfDfp_ETClbETFltInj3_C "Schwerezaehlergrenze fuer Fehlerpfad Dfp_ETClbETFltInj3" VALUE 0xCC84B Kw_Wu8 51000. TimeDsmTsf 0.00 51000. FORMAT "%5.0" /end CHARACTERISTIC
/begin CHARACTERISTIC DSM_TsfDfp_ETClbETFltInj4_C "Schwerezaehlergrenze fuer Fehlerpfad Dfp_ETClbETFltInj4" VALUE 0xCC84C Kw_Wu8 51000. TimeDsmTsf 0.00 51000. FORMAT "%5.0" /end CHARACTERISTIC
/begin CHARACTERISTIC DSM_TsfDfp_ETClbETFltInj5_C "Schwerezaehlergrenze fuer Fehlerpfad Dfp_ETClbETFltInj5" VALUE 0xCC84D Kw_Wu8 51000. TimeDsmTsf 0.00 51000. FORMAT "%5.0" /end CHARACTERISTIC
/begin CHARACTERISTIC DSM_TsfDfp_ETClbETFltInj6_C "Schwerezaehlergrenze fuer Fehlerpfad Dfp_ETClbETFltInj6" VALUE 0xCC84E Kw_Wu8 51000. TimeDsmTsf 0.00 51000. FORMAT "%5.0" /end CHARACTERISTIC
/begin CHARACTERISTIC DSM_TsfDfp_ETClbInj1_C "Schwerezaehlergrenze fuer Fehlerpfad Dfp_ETClbInj1" VALUE 0xCC84F Kw_Wu8 51000. TimeDsmTsf 0.00 51000. FORMAT "%5.0" /end CHARACTERISTIC
/begin CHARACTERISTIC DSM_TsfDfp_ETClbInj2_C "Schwerezaehlergrenze fuer Fehlerpfad Dfp_ETClbInj2" VALUE 0xCC850 Kw_Wu8 51000. TimeDsmTsf 0.00 51000. FORMAT "%5.0" /end CHARACTERISTIC
/begin CHARACTERISTIC DSM_TsfDfp_ETClbInj3_C "Schwerezaehlergrenze fuer Fehlerpfad Dfp_ETClbInj3" VALUE 0xCC851 Kw_Wu8 51000. TimeDsmTsf 0.00 51000. FORMAT "%5.0" /end CHARACTERISTIC
/begin CHARACTERISTIC DSM_TsfDfp_ETClbInj4_C "Schwerezaehlergrenze fuer Fehlerpfad Dfp_ETClbInj4" VALUE 0xCC852 Kw_Wu8 51000. TimeDsmTsf 0.00 51000. FORMAT "%5.0" /end CHARACTERISTIC
/begin CHARACTERISTIC DSM_TsfDfp_ETClbInj5_C "Schwerezaehlergrenze fuer Fehlerpfad Dfp_ETClbInj5" VALUE 0xCC853 Kw_Wu8 51000. TimeDsmTsf 0.00 51000. FORMAT "%5.0" /end CHARACTERISTIC
/begin CHARACTERISTIC DSM_TsfDfp_ETClbInj6_C "Schwerezaehlergrenze fuer Fehlerpfad Dfp_ETClbInj6" VALUE 0xCC854 Kw_Wu8 51000. TimeDsmTsf 0.00 51000. FORMAT "%5.0" /end CHARACTERISTIC
/begin CHARACTERISTIC DSM_TsfDfp_EngMCaS1_C "Schwerezaehlergrenze fuer Fehlerpfad Dfp_EngMCaS1" VALUE 0xCC855 Kw_Wu8 51000. TimeDsmTsf 0.00 51000. FORMAT "%5.0" /end CHARACTERISTIC
/begin CHARACTERISTIC DSM_TsfDfp_EngMCrS1_C "Schwerezaehlergrenze fuer Fehlerpfad Dfp_EngMCrS1" VALUE 0xCC856 Kw_Wu8 51000. TimeDsmTsf 0.00 51000. FORMAT "%5.0" /end CHARACTERISTIC
/begin CHARACTERISTIC DSM_TsfDfp_EngMOfsCaSCrS_C "Schwerezaehlergrenze fuer Fehlerpfad Dfp_EngMOfsCaSCrS" VALUE 0xCC857 Kw_Wu8 51000. TimeDsmTsf 0.00 51000. FORMAT "%5.0" /end CHARACTERISTIC
/begin CHARACTERISTIC DSM_TsfDfp_EngMntCtl1_Dia1_C "" VALUE 0xCC858 Kw_Wu8 51000. TimeDsmTsf 0.00 51000. FORMAT "%5.0" /end CHARACTERISTIC
/begin CHARACTERISTIC DSM_TsfDfp_EngMntCtl1_Dia2_C "" VALUE 0xCC859 Kw_Wu8 51000. TimeDsmTsf 0.00 51000. FORMAT "%5.0" /end CHARACTERISTIC
/begin CHARACTERISTIC DSM_TsfDfp_EngMntCtl1_Dia3_C "" VALUE 0xCC85A Kw_Wu8 51000. TimeDsmTsf 0.00 51000. FORMAT "%5.0" /end CHARACTERISTIC
/begin CHARACTERISTIC DSM_TsfDfp_EngMntCtl1_Max_C "" VALUE 0xCC85B Kw_Wu8 51000. TimeDsmTsf 0.00 51000. FORMAT "%5.0" /end CHARACTERISTIC
/begin CHARACTERISTIC DSM_TsfDfp_EngMntCtl1_Min_C "" VALUE 0xCC85C Kw_Wu8 51000. TimeDsmTsf 0.00 51000. FORMAT "%5.0" /end CHARACTERISTIC
/begin CHARACTERISTIC DSM_TsfDfp_EngMntCtl1_SigNpl_C "" VALUE 0xCC85D Kw_Wu8 51000. TimeDsmTsf 0.00 51000. FORMAT "%5.0" /end CHARACTERISTIC
/begin CHARACTERISTIC DSM_TsfDfp_EngMntCtlCD_C "Schwerezaehlergrenze fuer Fehlerpfad Dfp_EngMntCtlCD" VALUE 0xCC85E Kw_Wu8 51000. TimeDsmTsf 0.00 51000. FORMAT "%5.0" /end CHARACTERISTIC
/begin CHARACTERISTIC DSM_TsfDfp_EngMntCtl_Dia1_C "" VALUE 0xCC85F Kw_Wu8 51000. TimeDsmTsf 0.00 51000. FORMAT "%5.0" /end CHARACTERISTIC
/begin CHARACTERISTIC DSM_TsfDfp_EngMntCtl_Dia2_C "" VALUE 0xCC860 Kw_Wu8 51000. TimeDsmTsf 0.00 51000. FORMAT "%5.0" /end CHARACTERISTIC
/begin CHARACTERISTIC DSM_TsfDfp_EngMntCtl_Dia3_C "" VALUE 0xCC861 Kw_Wu8 51000. TimeDsmTsf 0.00 51000. FORMAT "%5.0" /end CHARACTERISTIC
/begin CHARACTERISTIC DSM_TsfDfp_EngMntCtl_Max_C "" VALUE 0xCC862 Kw_Wu8 51000. TimeDsmTsf 0.00 51000. FORMAT "%5.0" /end CHARACTERISTIC
/begin CHARACTERISTIC DSM_TsfDfp_EngMntCtl_Min_C "" VALUE 0xCC863 Kw_Wu8 51000. TimeDsmTsf 0.00 51000. FORMAT "%5.0" /end CHARACTERISTIC
/begin CHARACTERISTIC DSM_TsfDfp_EngMntCtl_SigNpl_C "" VALUE 0xCC864 Kw_Wu8 51000. TimeDsmTsf 0.00 51000. FORMAT "%5.0" /end CHARACTERISTIC
/begin CHARACTERISTIC DSM_TsfDfp_EngPrtFWODet_C "Schwerezaehlergrenze fuer Fehlerpfad Dfp_EngPrtFWODet" VALUE 0xCC865 Kw_Wu8 51000. TimeDsmTsf 0.00 51000. FORMAT "%5.0" /end CHARACTERISTIC
/begin CHARACTERISTIC DSM_TsfDfp_FBCqDvt_C "Schwerezaehlergrenze fuer Fehlerpfad Dfp_FBCqDvt" VALUE 0xCC866 Kw_Wu8 51000. TimeDsmTsf 0.00 51000. FORMAT "%5.0" /end CHARACTERISTIC
/begin CHARACTERISTIC DSM_TsfDfp_FMTC_NonMonotonMap_C "Schwerezaehlergrenze fuer Fehlerpfad Dfp_FMTC_NonMonotonMap" VALUE 0xCC867 Kw_Wu8 51000. TimeDsmTsf 0.00 51000. FORMAT "%5.0" /end CHARACTERISTIC
/begin CHARACTERISTIC DSM_TsfDfp_FTSCD_C "Schwerezaehlergrenze fuer Fehlerpfad Dfp_FTSCD" VALUE 0xCC868 Kw_Wu8 51000. TimeDsmTsf 0.00 51000. FORMAT "%5.0" /end CHARACTERISTIC
/begin CHARACTERISTIC DSM_TsfDfp_FanCD_C "Schwerezaehlergrenze fuer Fehlerpfad Dfp_FanCD" VALUE 0xCC869 Kw_Wu8 51000. TimeDsmTsf 0.00 51000. FORMAT "%5.0" /end CHARACTERISTIC
/begin CHARACTERISTIC DSM_TsfDfp_FanCD_FanCtlr1_C "Schwerezaehlergrenze fuer Fehlerpfad Dfp_FanCD_FanCtlr1" VALUE 0xCC86A Kw_Wu8 51000. TimeDsmTsf 0.00 51000. FORMAT "%5.0" /end CHARACTERISTIC
/begin CHARACTERISTIC DSM_TsfDfp_FanCD_FanCtlr2_C "Schwerezaehlergrenze fuer Fehlerpfad Dfp_FanCD_FanCtlr2" VALUE 0xCC86B Kw_Wu8 51000. TimeDsmTsf 0.00 51000. FORMAT "%5.0" /end CHARACTERISTIC
/begin CHARACTERISTIC DSM_TsfDfp_FanCD_FanCtlr3_C "Schwerezaehlergrenze fuer Fehlerpfad Dfp_FanCD_FanCtlr3" VALUE 0xCC86C Kw_Wu8 51000. TimeDsmTsf 0.00 51000. FORMAT "%5.0" /end CHARACTERISTIC
/begin CHARACTERISTIC DSM_TsfDfp_FlFCD_C "Schwerezaehlergrenze fuer Fehlerpfad Dfp_FlFCD" VALUE 0xCC86D Kw_Wu8 51000. TimeDsmTsf 0.00 51000. FORMAT "%5.0" /end CHARACTERISTIC
/begin CHARACTERISTIC DSM_TsfDfp_FlMngSmkDefect_C "Schwerezaehlergrenze fuer Fehlerpfad Dfp_FlMngSmkDefect" VALUE 0xCC86E Kw_Wu8 51000. TimeDsmTsf 0.00 51000. FORMAT "%5.0" /end CHARACTERISTIC
/begin CHARACTERISTIC DSM_TsfDfp_FrmMngBOS_RESET_C "Schwerezaehlergrenze fuer Fehlerpfad Dfp_FrmMngBOS_RESET" VALUE 0xCC86F Kw_Wu8 51000. TimeDsmTsf 0.00 51000. FORMAT "%5.0" /end CHARACTERISTIC
/begin CHARACTERISTIC DSM_TsfDfp_FrmMngBOS_RESET_2_C "" VALUE 0xCC870 Kw_Wu8 51000. TimeDsmTsf 0.00 51000. FORMAT "%5.0" /end CHARACTERISTIC
/begin CHARACTERISTIC DSM_TsfDfp_FrmMngDMANFAFS_C "Schwerezaehlergrenze fuer Fehlerpfad Dfp_FrmMngDMANFAFS" VALUE 0xCC871 Kw_Wu8 51000. TimeDsmTsf 0.00 51000. FORMAT "%5.0" /end CHARACTERISTIC
/begin CHARACTERISTIC DSM_TsfDfp_FrmMngDRMANFSSG_C "Schwerezaehlergrenze fuer Fehlerpfad Dfp_FrmMngDRMANFSSG" VALUE 0xCC872 Kw_Wu8 51000. TimeDsmTsf 0.00 51000. FORMAT "%5.0" /end CHARACTERISTIC
/begin CHARACTERISTIC DSM_TsfDfp_FrmMngGEARBX_DATA_C "severity-counter for path" VALUE 0xCC873 Kw_Wu8 51000. TimeDsmTsf 0.00 51000. FORMAT "%5.0" /end CHARACTERISTIC
/begin CHARACTERISTIC DSM_TsfDfp_FrmMngGEARBX_DATA2_C "Schwerezaehlergrenze fuer Fehlerpfad Dfp_FrmMngGEARBX_DATA2" VALUE 0xCC874 Kw_Wu8 51000. TimeDsmTsf 0.00 51000. FORMAT "%5.0" /end CHARACTERISTIC
/begin CHARACTERISTIC DSM_TsfDfp_FrmMngHEAT_AC_C "severity-counter for path" VALUE 0xCC875 Kw_Wu8 51000. TimeDsmTsf 0.00 51000. FORMAT "%5.0" /end CHARACTERISTIC
/begin CHARACTERISTIC DSM_TsfDfp_FrmMngLENKRADWINKEL_C "Schwerezaehlergrenze fuer Fehlerpfad Dfp_FrmMngLENKRADWINKEL" VALUE 0xCC876 Kw_Wu8 51000. TimeDsmTsf 0.00 51000. FORMAT "%5.0" /end CHARACTERISTIC
/begin CHARACTERISTIC DSM_TsfDfp_FrmMngMILEAGE_RANGE_C "Schwerezaehlergrenze fuer Fehlerpfad Dfp_FrmMngMILEAGE_RANGE" VALUE 0xCC877 Kw_Wu8 51000. TimeDsmTsf 0.00 51000. FORMAT "%5.0" /end CHARACTERISTIC
/begin CHARACTERISTIC DSM_TsfDfp_FrmMngOPCRCTLACC_C "Schwerezaehlergrenze fuer Fehlerpfad Dfp_FrmMngOPCRCTLACC" VALUE 0xCC878 Kw_Wu8 51000. TimeDsmTsf 0.00 51000. FORMAT "%5.0" /end CHARACTERISTIC
/begin CHARACTERISTIC DSM_TsfDfp_FrmMngPRGG_CCTR_C "Schwerezaehlergrenze fuer Fehlerpfad Dfp_FrmMngPRGG_CCTR" VALUE 0xCC879 Kw_Wu8 51000. TimeDsmTsf 0.00 51000. FORMAT "%5.0" /end CHARACTERISTIC
/begin CHARACTERISTIC DSM_TsfDfp_FrmMngPWRMNG_LOADV_C "Schwerezaehlergrenze fuer Fehlerpfad Dfp_FrmMngPWRMNG_LOADV" VALUE 0xCC87A Kw_Wu8 51000. TimeDsmTsf 0.00 51000. FORMAT "%5.0" /end CHARACTERISTIC
/begin CHARACTERISTIC DSM_TsfDfp_FrmMngParkConsumer_C "Schwerezaehlgrenze fuer Fehlerpfad Dfp_FrmMngParkConsumer" VALUE 0xCC87B Kw_Wu8 51000. TimeDsmTsf 0.00 51000. FORMAT "%5.0" /end CHARACTERISTIC
/begin CHARACTERISTIC DSM_TsfDfp_FrmMngRQSTGEFAN_C "RQ_STG_EFAN - CAN-message related errors" VALUE 0xCC87C Kw_Wu8 51000. TimeDsmTsf 0.00 51000. FORMAT "%5.0" /end CHARACTERISTIC
/begin CHARACTERISTIC DSM_TsfDfp_FrmMngSSGErr_C "Schwerezaehlergrenze fuer Fehlerpfad Dfp_FrmMngSSGErr" VALUE 0xCC87D Kw_Wu8 51000. TimeDsmTsf 0.00 51000. FORMAT "%5.0" /end CHARACTERISTIC
/begin CHARACTERISTIC DSM_TsfDfp_FrmMngSSGShOff_C "Schwerezaehlergrenze fuer Fehlerpfad Dfp_FrmMngSSGShOff" VALUE 0xCC87E Kw_Wu8 51000. TimeDsmTsf 0.00 51000. FORMAT "%5.0" /end CHARACTERISTIC
/begin CHARACTERISTIC DSM_TsfDfp_FrmMngSTAT_ANH_C "Schwerezaehlergrenze fuer Fehlerpfad Dfp_FrmMngSTAT_ANH" VALUE 0xCC87F Kw_Wu8 51000. TimeDsmTsf 0.00 51000. FORMAT "%5.0" /end CHARACTERISTIC
/begin CHARACTERISTIC DSM_TsfDfp_FrmMngSTAT_ARS_C "severity-counter for path" VALUE 0xCC880 Kw_Wu8 51000. TimeDsmTsf 0.00 51000. FORMAT "%5.0" /end CHARACTERISTIC
/begin CHARACTERISTIC DSM_TsfDfp_FrmMngSTAT_DSC_C "severity-counter for path" VALUE 0xCC881 Kw_Wu8 51000. TimeDsmTsf 0.00 51000. FORMAT "%5.0" /end CHARACTERISTIC
/begin CHARACTERISTIC DSM_TsfDfp_FrmMngSTAT_EKP_C "Schwerezaehlergrenze fuer Fehlerpfad Dfp_FrmMngSTAT_EKP" VALUE 0xCC882 Kw_Wu8 51000. TimeDsmTsf 0.00 51000. FORMAT "%5.0" /end CHARACTERISTIC
/begin CHARACTERISTIC DSM_TsfDfp_FrmMngSTAT_KOMBI_C "Schwerezaehlergrenze fuer Fehlerpfad Dfp_FrmMngSTAT_KOMBI" VALUE 0xCC883 Kw_Wu8 51000. TimeDsmTsf 0.00 51000. FORMAT "%5.0" /end CHARACTERISTIC
/begin CHARACTERISTIC DSM_TsfDfp_FrmMngSTAT_SITZ_C "Schwerezaehlergrenze fuer Fehlerpfad Dfp_FrmMngSTAT_SITZ" VALUE 0xCC884 Kw_Wu8 51000. TimeDsmTsf 0.00 51000. FORMAT "%5.0" /end CHARACTERISTIC
/begin CHARACTERISTIC DSM_TsfDfp_FrmMngStOBDGbxMilOf_C "Schwerezaehlergrenze fuer Fehlerpfad Dfp_FrmMngStOBDGbxMilOf" VALUE 0xCC885 Kw_Wu8 51000. TimeDsmTsf 0.00 51000. FORMAT "%5.0" /end CHARACTERISTIC
/begin CHARACTERISTIC DSM_TsfDfp_FrmMngStOBDGbxMilOn_C "Schwerezaehlergrenze fuer Fehlerpfad Dfp_FrmMngStOBDGbxMilOn" VALUE 0xCC886 Kw_Wu8 51000. TimeDsmTsf 0.00 51000. FORMAT "%5.0" /end CHARACTERISTIC
/begin CHARACTERISTIC DSM_TsfDfp_FrmMngTEMPRELTIME_C "Schwerezaehlergrenze fuer Fehlerpfad Dfp_FrmMngTEMPRELTIME" VALUE 0xCC887 Kw_Wu8 51000. TimeDsmTsf 0.00 51000. FORMAT "%5.0" /end CHARACTERISTIC
/begin CHARACTERISTIC DSM_TsfDfp_FrmMngTERMINAL_C "severity-counter for path" VALUE 0xCC888 Kw_Wu8 51000. TimeDsmTsf 0.00 51000. FORMAT "%5.0" /end CHARACTERISTIC
/begin CHARACTERISTIC DSM_TsfDfp_FrmMngTIME_DATE_C "Schwerezaehlergrenze fuer Fehlerpfad Dfp_FrmMngTIME_DATE" VALUE 0xCC889 Kw_Wu8 51000. TimeDsmTsf 0.00 51000. FORMAT "%5.0" /end CHARACTERISTIC
/begin CHARACTERISTIC DSM_TsfDfp_FrmMngTORQUE_DSC_C "severity-counter for path" VALUE 0xCC88A Kw_Wu8 51000. TimeDsmTsf 0.00 51000. FORMAT "%5.0" /end CHARACTERISTIC
/begin CHARACTERISTIC DSM_TsfDfp_FrmMngTORQUE_GEARBX_C "severity-counter for path" VALUE 0xCC88B Kw_Wu8 51000. TimeDsmTsf 0.00 51000. FORMAT "%5.0" /end CHARACTERISTIC
/begin CHARACTERISTIC DSM_TsfDfp_FrmMngTrq_ReqACC_C "Schwerezaehlergrenze fuer Fehlerpfad Dfp_FrmMngTrq_ReqACC" VALUE 0xCC88C Kw_Wu8 51000. TimeDsmTsf 0.00 51000. FORMAT "%5.0" /end CHARACTERISTIC
/begin CHARACTERISTIC DSM_TsfDfp_FrmMngVEH_MOD_C "VEH_MOD - CAN-message related errors" VALUE 0xCC88D Kw_Wu8 51000. TimeDsmTsf 0.00 51000. FORMAT "%5.0" /end CHARACTERISTIC
/begin CHARACTERISTIC DSM_TsfDfp_FrmMngVELOCITY_C "severity-counter for path" VALUE 0xCC88E Kw_Wu8 51000. TimeDsmTsf 0.00 51000. FORMAT "%5.0" /end CHARACTERISTIC
/begin CHARACTERISTIC DSM_TsfDfp_FrmMngWHEEL_SPEED_C "Schwerezaehlergrenze fuer Fehlerpfad Dfp_FrmMngWHEEL_SPEED" VALUE 0xCC88F Kw_Wu8 51000. TimeDsmTsf 0.00 51000. FORMAT "%5.0" /end CHARACTERISTIC
/begin CHARACTERISTIC DSM_TsfDfp_FrmMngstCurr_C "Schwerezählergrenze für Dfp_FrmMngstCurr" VALUE 0xCC890 Kw_Wu8 51000. TimeDsmTsf 0.00 51000. FORMAT "%5.0" /end CHARACTERISTIC
/begin CHARACTERISTIC DSM_TsfDfp_FrmMngswtPSPOff_C "Schwerezählergrenze für Dfp_FrmMngswtPSPOff" VALUE 0xCC891 Kw_Wu8 51000. TimeDsmTsf 0.00 51000. FORMAT "%5.0" /end CHARACTERISTIC
/begin CHARACTERISTIC DSM_TsfDfp_GearbxIncMax_C "Schwerezaehlergrenze fuer Fehlerpfad Dfp_GearbxIncMax" VALUE 0xCC892 Kw_Wu8 51000. TimeDsmTsf 0.00 51000. FORMAT "%5.0" /end CHARACTERISTIC
/begin CHARACTERISTIC DSM_TsfDfp_GlwCD_C "Schwerezaehlergrenze fuer Fehlerpfad Dfp_GlwCD" VALUE 0xCC893 Kw_Wu8 51000. TimeDsmTsf 0.00 51000. FORMAT "%5.0" /end CHARACTERISTIC
/begin CHARACTERISTIC DSM_TsfDfp_GlwCDGlwCirc1_C "Schwerezaehlergrenze fuer Fehlerpfad Dfp_GlwCDGlwCirc1" VALUE 0xCC894 Kw_Wu8 51000. TimeDsmTsf 0.00 51000. FORMAT "%5.0" /end CHARACTERISTIC
/begin CHARACTERISTIC DSM_TsfDfp_GlwCDGlwCirc2_C "Schwerezaehlergrenze fuer Fehlerpfad Dfp_GlwCDGlwCirc2" VALUE 0xCC895 Kw_Wu8 51000. TimeDsmTsf 0.00 51000. FORMAT "%5.0" /end CHARACTERISTIC
/begin CHARACTERISTIC DSM_TsfDfp_GlwCDGlwCirc3_C "Schwerezaehlergrenze fuer Fehlerpfad Dfp_GlwCDGlwCirc3" VALUE 0xCC896 Kw_Wu8 51000. TimeDsmTsf 0.00 51000. FORMAT "%5.0" /end CHARACTERISTIC
/begin CHARACTERISTIC DSM_TsfDfp_GlwCDGlwCirc4_C "Schwerezaehlergrenze fuer Fehlerpfad Dfp_GlwCDGlwCirc4" VALUE 0xCC897 Kw_Wu8 51000. TimeDsmTsf 0.00 51000. FORMAT "%5.0" /end CHARACTERISTIC
/begin CHARACTERISTIC DSM_TsfDfp_GlwCDGlwCirc5_C "Schwerezaehlergrenze fuer Fehlerpfad Dfp_GlwCDGlwCirc5" VALUE 0xCC898 Kw_Wu8 51000. TimeDsmTsf 0.00 51000. FORMAT "%5.0" /end CHARACTERISTIC
/begin CHARACTERISTIC DSM_TsfDfp_GlwCDGlwCirc6_C "Schwerezaehlergrenze fuer Fehlerpfad Dfp_GlwCDGlwCirc6" VALUE 0xCC899 Kw_Wu8 51000. TimeDsmTsf 0.00 51000. FORMAT "%5.0" /end CHARACTERISTIC
/begin CHARACTERISTIC DSM_TsfDfp_GlwCDGlwCirc7_C "Schwerezaehlergrenze fuer Fehlerpfad Dfp_GlwCDGlwCirc7" VALUE 0xCC89A Kw_Wu8 51000. TimeDsmTsf 0.00 51000. FORMAT "%5.0" /end CHARACTERISTIC
/begin CHARACTERISTIC DSM_TsfDfp_GlwCDGlwCirc8_C "Schwerezaehlergrenze fuer Fehlerpfad Dfp_GlwCDGlwCirc8" VALUE 0xCC89B Kw_Wu8 51000. TimeDsmTsf 0.00 51000. FORMAT "%5.0" /end CHARACTERISTIC
/begin CHARACTERISTIC DSM_TsfDfp_GlwCtl_C "Schwerezaehlergrenze fuer Fehlerpfad Dfp_GlwCtl" VALUE 0xCC89C Kw_Wu8 51000. TimeDsmTsf 0.00 51000. FORMAT "%5.0" /end CHARACTERISTIC
/begin CHARACTERISTIC DSM_TsfDfp_HWEMonCom_C "Schwerezaehlergrenze fuer Fehlerpfad Dfp_HWEMonCom" VALUE 0xCC89D Kw_Wu8 51000. TimeDsmTsf 0.00 51000. FORMAT "%5.0" /end CHARACTERISTIC
/begin CHARACTERISTIC DSM_TsfDfp_HWEMonEEPROM_C "Schwerezaehlergrenze fuer Fehlerpfad Dfp_HWEMonEEPROM" VALUE 0xCC89E Kw_Wu8 51000. TimeDsmTsf 0.00 51000. FORMAT "%5.0" /end CHARACTERISTIC
/begin CHARACTERISTIC DSM_TsfDfp_HWEMonRcyLocked_C "Schwerezaehlergrenze fuer Fehlerpfad Dfp_HWEMonRcyLocked" VALUE 0xCC89F Kw_Wu8 51000. TimeDsmTsf 0.00 51000. FORMAT "%5.0" /end CHARACTERISTIC
/begin CHARACTERISTIC DSM_TsfDfp_HWEMonRcySuppressed_C "Schwerezaehlergrenze fuer Fehlerpfad Dfp_HWEMonRcySuppressed" VALUE 0xCC8A0 Kw_Wu8 51000. TimeDsmTsf 0.00 51000. FORMAT "%5.0" /end CHARACTERISTIC
/begin CHARACTERISTIC DSM_TsfDfp_HWEMonRcyVisible_C "Schwerezaehlergrenze fuer Fehlerpfad Dfp_HWEMonRcyVisible" VALUE 0xCC8A1 Kw_Wu8 51000. TimeDsmTsf 0.00 51000. FORMAT "%5.0" /end CHARACTERISTIC
/begin CHARACTERISTIC DSM_TsfDfp_HWEMonUMaxSupply_C "Schwerezaehlergrenze fuer Fehlerpfad Dfp_HWEMonUMaxSupply" VALUE 0xCC8A2 Kw_Wu8 51000. TimeDsmTsf 0.00 51000. FORMAT "%5.0" /end CHARACTERISTIC
/begin CHARACTERISTIC DSM_TsfDfp_HWEMonUMinSupply_C "Schwerezaehlergrenze fuer Fehlerpfad Dfp_HWEMonUMinSupply" VALUE 0xCC8A3 Kw_Wu8 51000. TimeDsmTsf 0.00 51000. FORMAT "%5.0" /end CHARACTERISTIC
/begin CHARACTERISTIC DSM_TsfDfp_IATSCD_C "Schwerezaehlergrenze fuer Fehlerpfad Dfp_IATSCD" VALUE 0xCC8A4 Kw_Wu8 51000. TimeDsmTsf 0.00 51000. FORMAT "%5.0" /end CHARACTERISTIC
/begin CHARACTERISTIC DSM_TsfDfp_IATSCD_CATS_C "Schwerezaehlergrenze fuer Fehlerpfad Dfp_IATSCD_CATS" VALUE 0xCC8A5 Kw_Wu8 51000. TimeDsmTsf 0.00 51000. FORMAT "%5.0" /end CHARACTERISTIC
/begin CHARACTERISTIC DSM_TsfDfp_ImmCtlImmCD_C "Schwerezaehlergrenze fuer Fehlerpfad Dfp_ImmCtlImmCD" VALUE 0xCC8A6 Kw_Wu8 51000. TimeDsmTsf 0.00 51000. FORMAT "%5.0" /end CHARACTERISTIC
/begin CHARACTERISTIC DSM_TsfDfp_ImmCtlImmEep_C "Schwerezaehlergrenze fuer Fehlerpfad Dfp_ImmCtlImmEep" VALUE 0xCC8A7 Kw_Wu8 51000. TimeDsmTsf 0.00 51000. FORMAT "%5.0" /end CHARACTERISTIC
/begin CHARACTERISTIC DSM_TsfDfp_ImmCtlMpl_C "Schwerezaehlergrenze fuer Fehlerpfad Dfp_ImmCtlMpl" VALUE 0xCC8A8 Kw_Wu8 51000. TimeDsmTsf 0.00 51000. FORMAT "%5.0" /end CHARACTERISTIC
/begin CHARACTERISTIC DSM_TsfDfp_IndSys1_C "Schwerezaehlergrenze fuer Fehlerpfad Dfp_IndSys1" VALUE 0xCC8A9 Kw_Wu8 51000. TimeDsmTsf 0.00 51000. FORMAT "%5.0" /end CHARACTERISTIC
/begin CHARACTERISTIC DSM_TsfDfp_IndSys2_C "Schwerezaehlergrenze fuer Fehlerpfad Dfp_IndSys2" VALUE 0xCC8AA Kw_Wu8 51000. TimeDsmTsf 0.00 51000. FORMAT "%5.0" /end CHARACTERISTIC
/begin CHARACTERISTIC DSM_TsfDfp_InjCrv_InjLim_C "Schwerezaehlergrenze fuer Fehlerpfad Dfp_InjCrv_InjLim" VALUE 0xCC8AB Kw_Wu8 51000. TimeDsmTsf 0.00 51000. FORMAT "%5.0" /end CHARACTERISTIC
/begin CHARACTERISTIC DSM_TsfDfp_InjCtlAdjQnt_C "Schwerezaehlergrenze fuer Fehlerpfad Dfp_InjCtlAdjQnt" VALUE 0xCC8AC Kw_Wu8 51000. TimeDsmTsf 0.00 51000. FORMAT "%5.0" /end CHARACTERISTIC
/begin CHARACTERISTIC DSM_TsfDfp_InjCtlDrift_C "Schwerezaehlergrenze fuer Fehlerpfad Dfp_InjCtlDrift" VALUE 0xCC8AD Kw_Wu8 51000. TimeDsmTsf 0.00 51000. FORMAT "%5.0" /end CHARACTERISTIC
/begin CHARACTERISTIC DSM_TsfDfp_InjVCDActrChrg_C "Schwerezaehlergrenze fuer Fehlerpfad Dfp_InjVCDActrChrg" VALUE 0xCC8AE Kw_Wu8 51000. TimeDsmTsf 0.00 51000. FORMAT "%5.0" /end CHARACTERISTIC
/begin CHARACTERISTIC DSM_TsfDfp_InjVCDActrEnrg1_C "Schwerezaehlergrenze fuer Fehlerpfad Dfp_InjVCDActrEnrg1" VALUE 0xCC8AF Kw_Wu8 51000. TimeDsmTsf 0.00 51000. FORMAT "%5.0" /end CHARACTERISTIC
/begin CHARACTERISTIC DSM_TsfDfp_InjVCDActrEnrg2_C "Schwerezaehlergrenze fuer Fehlerpfad Dfp_InjVCDActrEnrg2" VALUE 0xCC8B0 Kw_Wu8 51000. TimeDsmTsf 0.00 51000. FORMAT "%5.0" /end CHARACTERISTIC
/begin CHARACTERISTIC DSM_TsfDfp_InjVCDActrEnrg3_C "Schwerezaehlergrenze fuer Fehlerpfad Dfp_InjVCDActrEnrg3" VALUE 0xCC8B1 Kw_Wu8 51000. TimeDsmTsf 0.00 51000. FORMAT "%5.0" /end CHARACTERISTIC
/begin CHARACTERISTIC DSM_TsfDfp_InjVCDActrEnrg4_C "Schwerezaehlergrenze fuer Fehlerpfad Dfp_InjVCDActrEnrg4" VALUE 0xCC8B2 Kw_Wu8 51000. TimeDsmTsf 0.00 51000. FORMAT "%5.0" /end CHARACTERISTIC
/begin CHARACTERISTIC DSM_TsfDfp_InjVCDActrEnrg5_C "Schwerezaehlergrenze fuer Fehlerpfad Dfp_InjVCDActrEnrg5" VALUE 0xCC8B3 Kw_Wu8 51000. TimeDsmTsf 0.00 51000. FORMAT "%5.0" /end CHARACTERISTIC
/begin CHARACTERISTIC DSM_TsfDfp_InjVCDActrEnrg6_C "Schwerezaehlergrenze fuer Fehlerpfad Dfp_InjVCDActrEnrg6" VALUE 0xCC8B4 Kw_Wu8 51000. TimeDsmTsf 0.00 51000. FORMAT "%5.0" /end CHARACTERISTIC
/begin CHARACTERISTIC DSM_TsfDfp_InjVCDActrEnrg7_C "Schwerezaehlergrenze fuer Fehlerpfad Dfp_InjVCDActrEnrg7" VALUE 0xCC8B5 Kw_Wu8 51000. TimeDsmTsf 0.00 51000. FORMAT "%5.0" /end CHARACTERISTIC
/begin CHARACTERISTIC DSM_TsfDfp_InjVCDActrEnrg8_C "Schwerezaehlergrenze fuer Fehlerpfad Dfp_InjVCDActrEnrg8" VALUE 0xCC8B6 Kw_Wu8 51000. TimeDsmTsf 0.00 51000. FORMAT "%5.0" /end CHARACTERISTIC
/begin CHARACTERISTIC DSM_TsfDfp_InjVCDActrVolt_C "Schwerezaehlergrenze fuer Fehlerpfad Dfp_InjVCDActrVolt" VALUE 0xCC8B7 Kw_Wu8 51000. TimeDsmTsf 0.00 51000. FORMAT "%5.0" /end CHARACTERISTIC
/begin CHARACTERISTIC DSM_TsfDfp_InjVCDClsBank1_C "Schwerezaehlergrenze fuer Fehlerpfad Dfp_InjVCDClsBank1" VALUE 0xCC8B8 Kw_Wu8 51000. TimeDsmTsf 0.00 51000. FORMAT "%5.0" /end CHARACTERISTIC
/begin CHARACTERISTIC DSM_TsfDfp_InjVCDClsBank2_C "Schwerezaehlergrenze fuer Fehlerpfad Dfp_InjVCDClsBank2" VALUE 0xCC8B9 Kw_Wu8 51000. TimeDsmTsf 0.00 51000. FORMAT "%5.0" /end CHARACTERISTIC
/begin CHARACTERISTIC DSM_TsfDfp_InjVCDMonCab_C "Schwerezaehlergrenze fuer Fehlerpfad Dfp_InjVCDMonCab" VALUE 0xCC8BA Kw_Wu8 51000. TimeDsmTsf 0.00 51000. FORMAT "%5.0" /end CHARACTERISTIC
/begin CHARACTERISTIC DSM_TsfDfp_InjVCDMonSwt_C "Schwerezaehlergrenze fuer Fehlerpfad Dfp_InjVCDMonSwt" VALUE 0xCC8BB Kw_Wu8 51000. TimeDsmTsf 0.00 51000. FORMAT "%5.0" /end CHARACTERISTIC
/begin CHARACTERISTIC DSM_TsfDfp_InjVCDShOffDCDC_C "Schwerezaehlergrenze fuer Fehlerpfad Dfp_InjVCDShOffDCDC" VALUE 0xCC8BC Kw_Wu8 51000. TimeDsmTsf 0.00 51000. FORMAT "%5.0" /end CHARACTERISTIC
/begin CHARACTERISTIC DSM_TsfDfp_InjVCDUBuf_C "Schwerezaehlergrenze fuer Fehlerpfad Dfp_InjVCDUBuf" VALUE 0xCC8BD Kw_Wu8 51000. TimeDsmTsf 0.00 51000. FORMAT "%5.0" /end CHARACTERISTIC
/begin CHARACTERISTIC DSM_TsfDfp_InjVCD_CY370Ampl_C "Schwerezaehlergrenze fuer Fehlerpfad Dfp_InjVCD_CY370Ampl" VALUE 0xCC8BE Kw_Wu8 51000. TimeDsmTsf 0.00 51000. FORMAT "%5.0" /end CHARACTERISTIC
/begin CHARACTERISTIC DSM_TsfDfp_InjVlvBnk1A_C "Schwerezaehlergrenze fuer Fehlerpfad Dfp_InjVlvBnk1A" VALUE 0xCC8BF Kw_Wu8 51000. TimeDsmTsf 0.00 51000. FORMAT "%5.0" /end CHARACTERISTIC
/begin CHARACTERISTIC DSM_TsfDfp_InjVlvBnk1B_C "Schwerezaehlergrenze fuer Fehlerpfad Dfp_InjVlvBnk1B" VALUE 0xCC8C0 Kw_Wu8 51000. TimeDsmTsf 0.00 51000. FORMAT "%5.0" /end CHARACTERISTIC
/begin CHARACTERISTIC DSM_TsfDfp_InjVlvBnk2A_C "Schwerezaehlergrenze fuer Fehlerpfad Dfp_InjVlvBnk2A" VALUE 0xCC8C1 Kw_Wu8 51000. TimeDsmTsf 0.00 51000. FORMAT "%5.0" /end CHARACTERISTIC
/begin CHARACTERISTIC DSM_TsfDfp_InjVlvBnk2B_C "Schwerezaehlergrenze fuer Fehlerpfad Dfp_InjVlvBnk2B" VALUE 0xCC8C2 Kw_Wu8 51000. TimeDsmTsf 0.00 51000. FORMAT "%5.0" /end CHARACTERISTIC
/begin CHARACTERISTIC DSM_TsfDfp_InjVlvChipA_C "Schwerezaehlergrenze fuer Fehlerpfad Dfp_InjVlvChipA" VALUE 0xCC8C3 Kw_Wu8 51000. TimeDsmTsf 0.00 51000. FORMAT "%5.0" /end CHARACTERISTIC
/begin CHARACTERISTIC DSM_TsfDfp_InjVlvChipB_C "Schwerezaehlergrenze fuer Fehlerpfad Dfp_InjVlvChipB" VALUE 0xCC8C4 Kw_Wu8 51000. TimeDsmTsf 0.00 51000. FORMAT "%5.0" /end CHARACTERISTIC
/begin CHARACTERISTIC DSM_TsfDfp_InjVlvCyl1A_C "Schwerezaehlergrenze fuer Fehlerpfad Dfp_InjVlvCyl1A" VALUE 0xCC8C5 Kw_Wu8 51000. TimeDsmTsf 0.00 51000. FORMAT "%5.0" /end CHARACTERISTIC
/begin CHARACTERISTIC DSM_TsfDfp_InjVlvCyl1B_C "Schwerezaehlergrenze fuer Fehlerpfad Dfp_InjVlvCyl1B" VALUE 0xCC8C6 Kw_Wu8 51000. TimeDsmTsf 0.00 51000. FORMAT "%5.0" /end CHARACTERISTIC
/begin CHARACTERISTIC DSM_TsfDfp_InjVlvCyl1C_C "Schwerezaehlergrenze fuer Fehlerpfad Dfp_InjVlvCyl1C" VALUE 0xCC8C7 Kw_Wu8 51000. TimeDsmTsf 0.00 51000. FORMAT "%5.0" /end CHARACTERISTIC
/begin CHARACTERISTIC DSM_TsfDfp_InjVlvCyl2A_C "Schwerezaehlergrenze fuer Fehlerpfad Dfp_InjVlvCyl2A" VALUE 0xCC8C8 Kw_Wu8 51000. TimeDsmTsf 0.00 51000. FORMAT "%5.0" /end CHARACTERISTIC
/begin CHARACTERISTIC DSM_TsfDfp_InjVlvCyl2B_C "Schwerezaehlergrenze fuer Fehlerpfad Dfp_InjVlvCyl2B" VALUE 0xCC8C9 Kw_Wu8 51000. TimeDsmTsf 0.00 51000. FORMAT "%5.0" /end CHARACTERISTIC
/begin CHARACTERISTIC DSM_TsfDfp_InjVlvCyl2C_C "Schwerezaehlergrenze fuer Fehlerpfad Dfp_InjVlvCyl2C" VALUE 0xCC8CA Kw_Wu8 51000. TimeDsmTsf 0.00 51000. FORMAT "%5.0" /end CHARACTERISTIC
/begin CHARACTERISTIC DSM_TsfDfp_InjVlvCyl3A_C "Schwerezaehlergrenze fuer Fehlerpfad Dfp_InjVlvCyl3A" VALUE 0xCC8CB Kw_Wu8 51000. TimeDsmTsf 0.00 51000. FORMAT "%5.0" /end CHARACTERISTIC
/begin CHARACTERISTIC DSM_TsfDfp_InjVlvCyl3B_C "Schwerezaehlergrenze fuer Fehlerpfad Dfp_InjVlvCyl3B" VALUE 0xCC8CC Kw_Wu8 51000. TimeDsmTsf 0.00 51000. FORMAT "%5.0" /end CHARACTERISTIC
/begin CHARACTERISTIC DSM_TsfDfp_InjVlvCyl3C_C "Schwerezaehlergrenze fuer Fehlerpfad Dfp_InjVlvCyl3C" VALUE 0xCC8CD Kw_Wu8 51000. TimeDsmTsf 0.00 51000. FORMAT "%5.0" /end CHARACTERISTIC
/begin CHARACTERISTIC DSM_TsfDfp_InjVlvCyl4A_C "Schwerezaehlergrenze fuer Fehlerpfad Dfp_InjVlvCyl4A" VALUE 0xCC8CE Kw_Wu8 51000. TimeDsmTsf 0.00 51000. FORMAT "%5.0" /end CHARACTERISTIC
/begin CHARACTERISTIC DSM_TsfDfp_InjVlvCyl4B_C "Schwerezaehlergrenze fuer Fehlerpfad Dfp_InjVlvCyl4B" VALUE 0xCC8CF Kw_Wu8 51000. TimeDsmTsf 0.00 51000. FORMAT "%5.0" /end CHARACTERISTIC
/begin CHARACTERISTIC DSM_TsfDfp_InjVlvCyl4C_C "Schwerezaehlergrenze fuer Fehlerpfad Dfp_InjVlvCyl4C" VALUE 0xCC8D0 Kw_Wu8 51000. TimeDsmTsf 0.00 51000. FORMAT "%5.0" /end CHARACTERISTIC
/begin CHARACTERISTIC DSM_TsfDfp_InjVlvCyl5A_C "Schwerezaehlergrenze fuer Fehlerpfad Dfp_InjVlvCyl5A" VALUE 0xCC8D1 Kw_Wu8 51000. TimeDsmTsf 0.00 51000. FORMAT "%5.0" /end CHARACTERISTIC
/begin CHARACTERISTIC DSM_TsfDfp_InjVlvCyl5B_C "Schwerezaehlergrenze fuer Fehlerpfad Dfp_InjVlvCyl5B" VALUE 0xCC8D2 Kw_Wu8 51000. TimeDsmTsf 0.00 51000. FORMAT "%5.0" /end CHARACTERISTIC
/begin CHARACTERISTIC DSM_TsfDfp_InjVlvCyl5C_C "Schwerezaehlergrenze fuer Fehlerpfad Dfp_InjVlvCyl5C" VALUE 0xCC8D3 Kw_Wu8 51000. TimeDsmTsf 0.00 51000. FORMAT "%5.0" /end CHARACTERISTIC
/begin CHARACTERISTIC DSM_TsfDfp_InjVlvCyl6A_C "Schwerezaehlergrenze fuer Fehlerpfad Dfp_InjVlvCyl6A" VALUE 0xCC8D4 Kw_Wu8 51000. TimeDsmTsf 0.00 51000. FORMAT "%5.0" /end CHARACTERISTIC
/begin CHARACTERISTIC DSM_TsfDfp_InjVlvCyl6B_C "Schwerezaehlergrenze fuer Fehlerpfad Dfp_InjVlvCyl6B" VALUE 0xCC8D5 Kw_Wu8 51000. TimeDsmTsf 0.00 51000. FORMAT "%5.0" /end CHARACTERISTIC
/begin CHARACTERISTIC DSM_TsfDfp_InjVlvCyl6C_C "Schwerezaehlergrenze fuer Fehlerpfad Dfp_InjVlvCyl6C" VALUE 0xCC8D6 Kw_Wu8 51000. TimeDsmTsf 0.00 51000. FORMAT "%5.0" /end CHARACTERISTIC
/begin CHARACTERISTIC DSM_TsfDfp_InjVlvCyl7A_C "Schwerezaehlergrenze fuer Fehlerpfad Dfp_InjVlvCyl7A" VALUE 0xCC8D7 Kw_Wu8 51000. TimeDsmTsf 0.00 51000. FORMAT "%5.0" /end CHARACTERISTIC
/begin CHARACTERISTIC DSM_TsfDfp_InjVlvCyl7B_C "Schwerezaehlergrenze fuer Fehlerpfad Dfp_InjVlvCyl7B" VALUE 0xCC8D8 Kw_Wu8 51000. TimeDsmTsf 0.00 51000. FORMAT "%5.0" /end CHARACTERISTIC
/begin CHARACTERISTIC DSM_TsfDfp_InjVlvCyl7C_C "Schwerezaehlergrenze fuer Fehlerpfad Dfp_InjVlvCyl7C" VALUE 0xCC8D9 Kw_Wu8 51000. TimeDsmTsf 0.00 51000. FORMAT "%5.0" /end CHARACTERISTIC
/begin CHARACTERISTIC DSM_TsfDfp_InjVlvCyl8A_C "Schwerezaehlergrenze fuer Fehlerpfad Dfp_InjVlvCyl8A" VALUE 0xCC8DA Kw_Wu8 51000. TimeDsmTsf 0.00 51000. FORMAT "%5.0" /end CHARACTERISTIC
/begin CHARACTERISTIC DSM_TsfDfp_InjVlvCyl8B_C "Schwerezaehlergrenze fuer Fehlerpfad Dfp_InjVlvCyl8B" VALUE 0xCC8DB Kw_Wu8 51000. TimeDsmTsf 0.00 51000. FORMAT "%5.0" /end CHARACTERISTIC
/begin CHARACTERISTIC DSM_TsfDfp_InjVlvCyl8C_C "Schwerezaehlergrenze fuer Fehlerpfad Dfp_InjVlvCyl8C" VALUE 0xCC8DC Kw_Wu8 51000. TimeDsmTsf 0.00 51000. FORMAT "%5.0" /end CHARACTERISTIC
/begin CHARACTERISTIC DSM_TsfDfp_InjVlvNVC1_C "Schwerezaehlergrenze fuer Fehlerpfad Dfp_InjVlvNVC1" VALUE 0xCC8DD Kw_Wu8 51000. TimeDsmTsf 0.00 51000. FORMAT "%5.0" /end CHARACTERISTIC
/begin CHARACTERISTIC DSM_TsfDfp_InjVlvNVC2_C "Schwerezaehlergrenze fuer Fehlerpfad Dfp_InjVlvNVC2" VALUE 0xCC8DE Kw_Wu8 51000. TimeDsmTsf 0.00 51000. FORMAT "%5.0" /end CHARACTERISTIC
/begin CHARACTERISTIC DSM_TsfDfp_InjVlvNVC3_C "Schwerezaehlergrenze fuer Fehlerpfad Dfp_InjVlvNVC3" VALUE 0xCC8DF Kw_Wu8 51000. TimeDsmTsf 0.00 51000. FORMAT "%5.0" /end CHARACTERISTIC
/begin CHARACTERISTIC DSM_TsfDfp_InjVlvNVC4_C "Schwerezaehlergrenze fuer Fehlerpfad Dfp_InjVlvNVC4" VALUE 0xCC8E0 Kw_Wu8 51000. TimeDsmTsf 0.00 51000. FORMAT "%5.0" /end CHARACTERISTIC
/begin CHARACTERISTIC DSM_TsfDfp_InjVlvNVC5_C "Schwerezaehlergrenze fuer Fehlerpfad Dfp_InjVlvNVC5" VALUE 0xCC8E1 Kw_Wu8 51000. TimeDsmTsf 0.00 51000. FORMAT "%5.0" /end CHARACTERISTIC
/begin CHARACTERISTIC DSM_TsfDfp_InjVlvNVC6_C "Schwerezaehlergrenze fuer Fehlerpfad Dfp_InjVlvNVC6" VALUE 0xCC8E2 Kw_Wu8 51000. TimeDsmTsf 0.00 51000. FORMAT "%5.0" /end CHARACTERISTIC
/begin CHARACTERISTIC DSM_TsfDfp_InjVlvNVC7_C "Schwerezaehlergrenze fuer Fehlerpfad Dfp_InjVlvNVC7" VALUE 0xCC8E3 Kw_Wu8 51000. TimeDsmTsf 0.00 51000. FORMAT "%5.0" /end CHARACTERISTIC
/begin CHARACTERISTIC DSM_TsfDfp_InjVlvNVC8_C "Schwerezaehlergrenze fuer Fehlerpfad Dfp_InjVlvNVC8" VALUE 0xCC8E4 Kw_Wu8 51000. TimeDsmTsf 0.00 51000. FORMAT "%5.0" /end CHARACTERISTIC
/begin CHARACTERISTIC DSM_TsfDfp_LPACD_Max_C "Schwerezaehlergrenze fuer Fehlerpfad Dfp_LPACD_Max" VALUE 0xCC8E5 Kw_Wu8 51000. TimeDsmTsf 0.00 51000. FORMAT "%5.0" /end CHARACTERISTIC
/begin CHARACTERISTIC DSM_TsfDfp_LPACD_Min_C "Schwerezaehlergrenze fuer Fehlerpfad Dfp_LPACD_Min" VALUE 0xCC8E6 Kw_Wu8 51000. TimeDsmTsf 0.00 51000. FORMAT "%5.0" /end CHARACTERISTIC
/begin CHARACTERISTIC DSM_TsfDfp_LPACD_SigNpl_C "Schwerezaehlergrenze fuer Fehlerpfad Dfp_LPACD_SigNpl" VALUE 0xCC8E7 Kw_Wu8 51000. TimeDsmTsf 0.00 51000. FORMAT "%5.0" /end CHARACTERISTIC
/begin CHARACTERISTIC DSM_TsfDfp_LSUCDCircNernst0_C "Schwerezaehlergrenze fuer Fehlerpfad Dfp_LSUCDCircNernst0" VALUE 0xCC8E8 Kw_Wu8 51000. TimeDsmTsf 0.00 51000. FORMAT "%5.0" /end CHARACTERISTIC
/begin CHARACTERISTIC DSM_TsfDfp_LSUCDCircPumpCur0_C "Schwerezaehlergrenze fuer Fehlerpfad Dfp_LSUCDCircPumpCur0" VALUE 0xCC8E9 Kw_Wu8 51000. TimeDsmTsf 0.00 51000. FORMAT "%5.0" /end CHARACTERISTIC
/begin CHARACTERISTIC DSM_TsfDfp_LSUCDCircVirtGnd0_C "Schwerezaehlergrenze fuer Fehlerpfad Dfp_LSUCDCircVirtGnd0" VALUE 0xCC8EA Kw_Wu8 51000. TimeDsmTsf 0.00 51000. FORMAT "%5.0" /end CHARACTERISTIC
/begin CHARACTERISTIC DSM_TsfDfp_LSUCDHeater0_C "Schwerezaehlergrenze fuer Fehlerpfad Dfp_LSUCDHeater0" VALUE 0xCC8EB Kw_Wu8 51000. TimeDsmTsf 0.00 51000. FORMAT "%5.0" /end CHARACTERISTIC
/begin CHARACTERISTIC DSM_TsfDfp_LSUCDHtCoup0_C "Schwerezaehlergrenze fuer Fehlerpfad Dfp_LSUCDHtCoup0" VALUE 0xCC8EC Kw_Wu8 51000. TimeDsmTsf 0.00 51000. FORMAT "%5.0" /end CHARACTERISTIC
/begin CHARACTERISTIC DSM_TsfDfp_LSUCDO20_C "Schwerezaehlergrenze fuer Fehlerpfad Dfp_LSUCDO20" VALUE 0xCC8ED Kw_Wu8 51000. TimeDsmTsf 0.00 51000. FORMAT "%5.0" /end CHARACTERISTIC
/begin CHARACTERISTIC DSM_TsfDfp_LSUCDO2Clb0_C "Schwerezaehlergrenze fuer Fehlerpfad Dfp_LSUCDO2Clb0" VALUE 0xCC8EE Kw_Wu8 51000. TimeDsmTsf 0.00 51000. FORMAT "%5.0" /end CHARACTERISTIC
/begin CHARACTERISTIC DSM_TsfDfp_LSUCDRiClb0_C "Schwerezaehlergrenze fuer Fehlerpfad Dfp_LSUCDRiClb0" VALUE 0xCC8EF Kw_Wu8 51000. TimeDsmTsf 0.00 51000. FORMAT "%5.0" /end CHARACTERISTIC
/begin CHARACTERISTIC DSM_TsfDfp_LSUCDSPI0_C "Schwerezaehlergrenze fuer Fehlerpfad Dfp_LSUCDSPI0" VALUE 0xCC8F0 Kw_Wu8 51000. TimeDsmTsf 0.00 51000. FORMAT "%5.0" /end CHARACTERISTIC
/begin CHARACTERISTIC DSM_TsfDfp_LSUCDSPIBattLow0_C "Schwerezaehlergrenze fuer Fehlerpfad Dfp_LSUCDSPIBattLow0" VALUE 0xCC8F1 Kw_Wu8 51000. TimeDsmTsf 0.00 51000. FORMAT "%5.0" /end CHARACTERISTIC
/begin CHARACTERISTIC DSM_TsfDfp_LSUCDWireIP0_C "Schwerezaehlergrenze fuer Fehlerpfad Dfp_LSUCDWireIP0" VALUE 0xCC8F2 Kw_Wu8 51000. TimeDsmTsf 0.00 51000. FORMAT "%5.0" /end CHARACTERISTIC
/begin CHARACTERISTIC DSM_TsfDfp_LSUCtlRiExc0_C "Schwerezaehlergrenze fuer Fehlerpfad Dfp_LSUCtlRiExc0" VALUE 0xCC8F3 Kw_Wu8 51000. TimeDsmTsf 0.00 51000. FORMAT "%5.0" /end CHARACTERISTIC
/begin CHARACTERISTIC DSM_TsfDfp_LSUMon1Sens_C "Schwerezaehlergrenze fuer Fehlerpfad Dfp_LSUMon1Sens" VALUE 0xCC8F4 Kw_Wu8 51000. TimeDsmTsf 0.00 51000. FORMAT "%5.0" /end CHARACTERISTIC
/begin CHARACTERISTIC DSM_TsfDfp_LSUMon2Sens_C "Schwerezaehlergrenze fuer Fehlerpfad Dfp_LSUMon2Sens" VALUE 0xCC8F5 Kw_Wu8 51000. TimeDsmTsf 0.00 51000. FORMAT "%5.0" /end CHARACTERISTIC
/begin CHARACTERISTIC DSM_TsfDfp_LubCD_C "Schwerezaehlergrenze fuer Fehlerpfad Dfp_LubCD" VALUE 0xCC8F6 Kw_Wu8 51000. TimeDsmTsf 0.00 51000. FORMAT "%5.0" /end CHARACTERISTIC
/begin CHARACTERISTIC DSM_TsfDfp_MIL_C "Schwerezaehlergrenze fuer Fehlerpfad Dfp_MIL" VALUE 0xCC8F7 Kw_Wu8 51000. TimeDsmTsf 0.00 51000. FORMAT "%5.0" /end CHARACTERISTIC
/begin CHARACTERISTIC DSM_TsfDfp_MRlyCD_C "Schwerezaehlergrenze fuer Fehlerpfad Dfp_MRlyCD" VALUE 0xCC8F8 Kw_Wu8 51000. TimeDsmTsf 0.00 51000. FORMAT "%5.0" /end CHARACTERISTIC
/begin CHARACTERISTIC DSM_TsfDfp_MSidCD_Comm_C "Schwerezaehlergrenze fuer Fehlerpfad Dfp_MSidCD_Comm" VALUE 0xCC8F9 Kw_Wu8 51000. TimeDsmTsf 0.00 51000. FORMAT "%5.0" /end CHARACTERISTIC
/begin CHARACTERISTIC DSM_TsfDfp_MSidCD_Pin_C "Schwerezaehlergrenze fuer Fehlerpfad Dfp_MSidCD_Pin" VALUE 0xCC8FA Kw_Wu8 51000. TimeDsmTsf 0.00 51000. FORMAT "%5.0" /end CHARACTERISTIC
/begin CHARACTERISTIC DSM_TsfDfp_MSidCD_Sel_INI_C "Schwerezaehlergrenze fuer Fehlerpfad Dfp_MSidCD_Sel_INI" VALUE 0xCC8FB Kw_Wu8 51000. TimeDsmTsf 0.00 51000. FORMAT "%5.0" /end CHARACTERISTIC
/begin CHARACTERISTIC DSM_TsfDfp_MSidCD_Select_C "Schwerezaehlergrenze fuer Fehlerpfad Dfp_MSidCD_Select" VALUE 0xCC8FC Kw_Wu8 51000. TimeDsmTsf 0.00 51000. FORMAT "%5.0" /end CHARACTERISTIC
/begin CHARACTERISTIC DSM_TsfDfp_MeUnCDNoLoad_C "Schwerezaehlergrenze fuer Fehlerpfad Dfp_MeUnCDNoLoad" VALUE 0xCC8FD Kw_Wu8 51000. TimeDsmTsf 0.00 51000. FORMAT "%5.0" /end CHARACTERISTIC
/begin CHARACTERISTIC DSM_TsfDfp_MeUnCDSCBat_C "Schwerezaehlergrenze fuer Fehlerpfad Dfp_MeUnCDSCBat" VALUE 0xCC8FE Kw_Wu8 51000. TimeDsmTsf 0.00 51000. FORMAT "%5.0" /end CHARACTERISTIC
/begin CHARACTERISTIC DSM_TsfDfp_MeUnCDSCGnd_C "Schwerezaehlergrenze fuer Fehlerpfad Dfp_MeUnCDSCGnd" VALUE 0xCC8FF Kw_Wu8 51000. TimeDsmTsf 0.00 51000. FORMAT "%5.0" /end CHARACTERISTIC
/begin CHARACTERISTIC DSM_TsfDfp_MeUnCD_ADC_C "Schwerezaehlergrenze fuer Fehlerpfad Dfp_MeUnCD_ADC" VALUE 0xCC900 Kw_Wu8 51000. TimeDsmTsf 0.00 51000. FORMAT "%5.0" /end CHARACTERISTIC
/begin CHARACTERISTIC DSM_TsfDfp_MeUnCD_SigTst_C "Schwerezaehlergrenze fuer Fehlerpfad Dfp_MeUnCD_SigTst" VALUE 0xCC901 Kw_Wu8 51000. TimeDsmTsf 0.00 51000. FORMAT "%5.0" /end CHARACTERISTIC
/begin CHARACTERISTIC DSM_TsfDfp_Montr_C "Schwerezaehlergrenze fuer Fehlerpfad Dfp_Montr" VALUE 0xCC902 Kw_Wu8 51000. TimeDsmTsf 0.00 51000. FORMAT "%5.0" /end CHARACTERISTIC
/begin CHARACTERISTIC DSM_TsfDfp_NetMngDeviceA_C "Schwerezaehlergrenze fuer Fehlerpfad Dfp_NetMngDeviceA" VALUE 0xCC903 Kw_Wu8 51000. TimeDsmTsf 0.00 51000. FORMAT "%5.0" /end CHARACTERISTIC
/begin CHARACTERISTIC DSM_TsfDfp_NetMngDeviceB_C "Schwerezaehlergrenze fuer Fehlerpfad Dfp_NetMngDeviceB" VALUE 0xCC904 Kw_Wu8 51000. TimeDsmTsf 0.00 51000. FORMAT "%5.0" /end CHARACTERISTIC
/begin CHARACTERISTIC DSM_TsfDfp_NetMngDeviceC_C "Schwerezaehlergrenze fuer Fehlerpfad Dfp_NetMngDeviceC" VALUE 0xCC905 Kw_Wu8 51000. TimeDsmTsf 0.00 51000. FORMAT "%5.0" /end CHARACTERISTIC
/begin CHARACTERISTIC DSM_TsfDfp_OPSCD_Lamp_C "Schwerezaehlergrenze fuer Fehlerpfad Dfp_OPSCD_Lamp" VALUE 0xCC906 Kw_Wu8 51000. TimeDsmTsf 0.00 51000. FORMAT "%5.0" /end CHARACTERISTIC
/begin CHARACTERISTIC DSM_TsfDfp_OPSCD_anain_C "Schwerezaehlergrenze fuer Fehlerpfad Dfp_OPSCD_anain" VALUE 0xCC907 Kw_Wu8 51000. TimeDsmTsf 0.00 51000. FORMAT "%5.0" /end CHARACTERISTIC
/begin CHARACTERISTIC DSM_TsfDfp_OTSCD_C "Schwerezaehlergrenze fuer Fehlerpfad Dfp_OTSCD" VALUE 0xCC908 Kw_Wu8 51000. TimeDsmTsf 0.00 51000. FORMAT "%5.0" /end CHARACTERISTIC
/begin CHARACTERISTIC DSM_TsfDfp_OvRMon_C "Schwerezaehlergrenze fuer Fehlerpfad Dfp_OvRMon" VALUE 0xCC909 Kw_Wu8 51000. TimeDsmTsf 0.00 51000. FORMAT "%5.0" /end CHARACTERISTIC
/begin CHARACTERISTIC DSM_TsfDfp_OvRMonBrk_C "Schwerezaehlergrenze fuer Fehlerpfad Dfp_OvRMonBrk" VALUE 0xCC90A Kw_Wu8 51000. TimeDsmTsf 0.00 51000. FORMAT "%5.0" /end CHARACTERISTIC
/begin CHARACTERISTIC DSM_TsfDfp_OvRMonSigA_C "Schwerezaehlergrenze fuer Fehlerpfad Dfp_OvRMonSigA" VALUE 0xCC90B Kw_Wu8 51000. TimeDsmTsf 0.00 51000. FORMAT "%5.0" /end CHARACTERISTIC
/begin CHARACTERISTIC DSM_TsfDfp_OxiCCDTPre_C "Schwerezaehlergrenze fuer Fehlerpfad Dfp_OxiCCDTPre" VALUE 0xCC90C Kw_Wu8 51000. TimeDsmTsf 0.00 51000. FORMAT "%5.0" /end CHARACTERISTIC
/begin CHARACTERISTIC DSM_TsfDfp_PCR_GovDevNeg_C "Schwerezaehlergrenze fuer Fehlerpfad Dfp_PCR_GovDevNeg" VALUE 0xCC90D Kw_Wu8 51000. TimeDsmTsf 0.00 51000. FORMAT "%5.0" /end CHARACTERISTIC
/begin CHARACTERISTIC DSM_TsfDfp_PCR_GovDevPos_C "Schwerezaehlergrenze fuer Fehlerpfad Dfp_PCR_GovDevPos" VALUE 0xCC90E Kw_Wu8 51000. TimeDsmTsf 0.00 51000. FORMAT "%5.0" /end CHARACTERISTIC
/begin CHARACTERISTIC DSM_TsfDfp_PCVCDNoLoad_C "Schwerezaehlergrenze fuer Fehlerpfad Dfp_PCVCDNoLoad" VALUE 0xCC90F Kw_Wu8 51000. TimeDsmTsf 0.00 51000. FORMAT "%5.0" /end CHARACTERISTIC
/begin CHARACTERISTIC DSM_TsfDfp_PCVCDSCBat_C "Schwerezaehlergrenze fuer Fehlerpfad Dfp_PCVCDSCBat" VALUE 0xCC910 Kw_Wu8 51000. TimeDsmTsf 0.00 51000. FORMAT "%5.0" /end CHARACTERISTIC
/begin CHARACTERISTIC DSM_TsfDfp_PCVCDSCGnd_C "Schwerezaehlergrenze fuer Fehlerpfad Dfp_PCVCDSCGnd" VALUE 0xCC911 Kw_Wu8 51000. TimeDsmTsf 0.00 51000. FORMAT "%5.0" /end CHARACTERISTIC
/begin CHARACTERISTIC DSM_TsfDfp_PCVCD_ADC_C "Schwerezaehlergrenze fuer Fehlerpfad Dfp_PCVCD_ADC" VALUE 0xCC912 Kw_Wu8 51000. TimeDsmTsf 0.00 51000. FORMAT "%5.0" /end CHARACTERISTIC
/begin CHARACTERISTIC DSM_TsfDfp_PCVCD_SigTst_C "Schwerezaehlergrenze fuer Fehlerpfad Dfp_PCVCD_SigTst" VALUE 0xCC913 Kw_Wu8 51000. TimeDsmTsf 0.00 51000. FORMAT "%5.0" /end CHARACTERISTIC
/begin CHARACTERISTIC DSM_TsfDfp_PFltAPSens_C "Schwerezaehlergrenze fuer Fehlerpfad Dfp_PFltAPSens" VALUE 0xCC914 Kw_Wu8 51000. TimeDsmTsf 0.00 51000. FORMAT "%5.0" /end CHARACTERISTIC
/begin CHARACTERISTIC DSM_TsfDfp_PFltCDPPre_C "Schwerezaehlergrenze fuer Fehlerpfad Dfp_PFltCDPPre" VALUE 0xCC915 Kw_Wu8 51000. TimeDsmTsf 0.00 51000. FORMAT "%5.0" /end CHARACTERISTIC
/begin CHARACTERISTIC DSM_TsfDfp_PFltCDTempPre_C "Schwerezaehlergrenze fuer Fehlerpfad Dfp_PFltCDTempPre" VALUE 0xCC916 Kw_Wu8 51000. TimeDsmTsf 0.00 51000. FORMAT "%5.0" /end CHARACTERISTIC
/begin CHARACTERISTIC DSM_TsfDfp_PFltChar_C "Schwerezaehlergrenze fuer Fehlerpfad Dfp_PFltChar" VALUE 0xCC917 Kw_Wu8 51000. TimeDsmTsf 0.00 51000. FORMAT "%5.0" /end CHARACTERISTIC
/begin CHARACTERISTIC DSM_TsfDfp_PFltEngPrt_C "Schwerezaehlergrenze fuer Fehlerpfad Dfp_PFltEngPrt" VALUE 0xCC918 Kw_Wu8 51000. TimeDsmTsf 0.00 51000. FORMAT "%5.0" /end CHARACTERISTIC
/begin CHARACTERISTIC DSM_TsfDfp_PFltPresDynPlaus_C "Schwerezaehlergrenze fuer Fehlerpfad Dfp_PFltPresDynPlaus" VALUE 0xCC919 Kw_Wu8 51000. TimeDsmTsf 0.00 51000. FORMAT "%5.0" /end CHARACTERISTIC
/begin CHARACTERISTIC DSM_TsfDfp_PFltPresSens_C "Schwerezaehlergrenze fuer Fehlerpfad Dfp_PFltPresSens" VALUE 0xCC91A Kw_Wu8 51000. TimeDsmTsf 0.00 51000. FORMAT "%5.0" /end CHARACTERISTIC
/begin CHARACTERISTIC DSM_TsfDfp_PFltPresSensFrz_C "Schwerezaehlergrenze fuer Fehlerpfad Dfp_PFltPresSensFrz" VALUE 0xCC91B Kw_Wu8 51000. TimeDsmTsf 0.00 51000. FORMAT "%5.0" /end CHARACTERISTIC
/begin CHARACTERISTIC DSM_TsfDfp_PFltPresSensHsLn_C "Schwerezaehlergrenze fuer Fehlerpfad Dfp_PFltPresSensHsLn" VALUE 0xCC91C Kw_Wu8 51000. TimeDsmTsf 0.00 51000. FORMAT "%5.0" /end CHARACTERISTIC
/begin CHARACTERISTIC DSM_TsfDfp_PFltPresSensSot_C "Schwerezaehlergrenze fuer Fehlerpfad Dfp_PFltPresSensSot" VALUE 0xCC91D Kw_Wu8 51000. TimeDsmTsf 0.00 51000. FORMAT "%5.0" /end CHARACTERISTIC
/begin CHARACTERISTIC DSM_TsfDfp_PFltRgnPerm_C "Schwerezaehlergrenze fuer Fehlerpfad Dfp_PFltRgnPerm" VALUE 0xCC91E Kw_Wu8 51000. TimeDsmTsf 0.00 51000. FORMAT "%5.0" /end CHARACTERISTIC
/begin CHARACTERISTIC DSM_TsfDfp_PFltTempDwnStrm_C "Schwerezaehlergrenze fuer Fehlerpfad Dfp_PFltTempDwnStrm" VALUE 0xCC91F Kw_Wu8 51000. TimeDsmTsf 0.00 51000. FORMAT "%5.0" /end CHARACTERISTIC
/begin CHARACTERISTIC DSM_TsfDfp_PFltTempSens_C "Schwerezaehlergrenze fuer Fehlerpfad Dfp_PFltTempSens" VALUE 0xCC920 Kw_Wu8 51000. TimeDsmTsf 0.00 51000. FORMAT "%5.0" /end CHARACTERISTIC
/begin CHARACTERISTIC DSM_TsfDfp_PFltTempUpStrm_C "Schwerezaehlergrenze fuer Fehlerpfad Dfp_PFltTempUpStrm" VALUE 0xCC921 Kw_Wu8 51000. TimeDsmTsf 0.00 51000. FORMAT "%5.0" /end CHARACTERISTIC
/begin CHARACTERISTIC DSM_TsfDfp_PFltmSotDiffMax_C "Schwerezaehlergrenze fuer Fehlerpfad Dfp_PFltmSotDiffMax" VALUE 0xCC922 Kw_Wu8 51000. TimeDsmTsf 0.00 51000. FORMAT "%5.0" /end CHARACTERISTIC
/begin CHARACTERISTIC DSM_TsfDfp_QLTCD_C "Schwerezaehlergrenze fuer Fehlerpfad Dfp_QLTCD" VALUE 0xCC923 Kw_Wu8 51000. TimeDsmTsf 0.00 51000. FORMAT "%5.0" /end CHARACTERISTIC
/begin CHARACTERISTIC DSM_TsfDfp_RTMMon_C "Grenze für Zähler des Schwerefehlers für den Fehlerpfad Dfp_RTMMon" VALUE 0xCC924 Kw_Wu8 51000. TimeDsmTsf 0.00 51000. FORMAT "%5.0" /end CHARACTERISTIC
/begin CHARACTERISTIC DSM_TsfDfp_RailCD_C "Schwerezaehlergrenze fuer Fehlerpfad Dfp_RailCD" VALUE 0xCC925 Kw_Wu8 51000. TimeDsmTsf 0.00 51000. FORMAT "%5.0" /end CHARACTERISTIC
/begin CHARACTERISTIC DSM_TsfDfp_RailCDOfsTst_C "Schwerezaehlergrenze fuer Fehlerpfad Dfp_RailCDOfsTst" VALUE 0xCC926 Kw_Wu8 51000. TimeDsmTsf 0.00 51000. FORMAT "%5.0" /end CHARACTERISTIC
/begin CHARACTERISTIC DSM_TsfDfp_RailCD_PMonStrt_C "Schwerezaehlergrenze fuer Fehlerpfad Dfp_RailCD_PMonStrt" VALUE 0xCC927 Kw_Wu8 51000. TimeDsmTsf 0.00 51000. FORMAT "%5.0" /end CHARACTERISTIC
/begin CHARACTERISTIC DSM_TsfDfp_RailCtlModeMeUnDiag_C "Schwerezaehlergrenze fuer Fehlerpfad Dfp_RailCtlModeMeUnDiag" VALUE 0xCC928 Kw_Wu8 51000. TimeDsmTsf 0.00 51000. FORMAT "%5.0" /end CHARACTERISTIC
/begin CHARACTERISTIC DSM_TsfDfp_RailCtlModePCVDiag_C "Schwerezaehlergrenze fuer Fehlerpfad Dfp_RailCtlModePCVDiag" VALUE 0xCC929 Kw_Wu8 51000. TimeDsmTsf 0.00 51000. FORMAT "%5.0" /end CHARACTERISTIC
/begin CHARACTERISTIC DSM_TsfDfp_RailMeUn0_C "Schwerezaehlergrenze fuer Fehlerpfad Dfp_RailMeUn0" VALUE 0xCC92A Kw_Wu8 51000. TimeDsmTsf 0.00 51000. FORMAT "%5.0" /end CHARACTERISTIC
/begin CHARACTERISTIC DSM_TsfDfp_RailMeUn1_C "Schwerezaehlergrenze fuer Fehlerpfad Dfp_RailMeUn1" VALUE 0xCC92B Kw_Wu8 51000. TimeDsmTsf 0.00 51000. FORMAT "%5.0" /end CHARACTERISTIC
/begin CHARACTERISTIC DSM_TsfDfp_RailMeUn2_C "Schwerezaehlergrenze fuer Fehlerpfad Dfp_RailMeUn2" VALUE 0xCC92C Kw_Wu8 51000. TimeDsmTsf 0.00 51000. FORMAT "%5.0" /end CHARACTERISTIC
/begin CHARACTERISTIC DSM_TsfDfp_RailMeUn3_C "Schwerezaehlergrenze fuer Fehlerpfad Dfp_RailMeUn3" VALUE 0xCC92D Kw_Wu8 51000. TimeDsmTsf 0.00 51000. FORMAT "%5.0" /end CHARACTERISTIC
/begin CHARACTERISTIC DSM_TsfDfp_RailMeUn4_C "Schwerezaehlergrenze fuer Fehlerpfad Dfp_RailMeUn4" VALUE 0xCC92E Kw_Wu8 51000. TimeDsmTsf 0.00 51000. FORMAT "%5.0" /end CHARACTERISTIC
/begin CHARACTERISTIC DSM_TsfDfp_RailPCV0_C "Schwerezaehlergrenze fuer Fehlerpfad Dfp_RailPCV0" VALUE 0xCC92F Kw_Wu8 51000. TimeDsmTsf 0.00 51000. FORMAT "%5.0" /end CHARACTERISTIC
/begin CHARACTERISTIC DSM_TsfDfp_RailPCV1_C "Schwerezaehlergrenze fuer Fehlerpfad Dfp_RailPCV1" VALUE 0xCC930 Kw_Wu8 51000. TimeDsmTsf 0.00 51000. FORMAT "%5.0" /end CHARACTERISTIC
/begin CHARACTERISTIC DSM_TsfDfp_RailPCV2_C "Schwerezaehlergrenze fuer Fehlerpfad Dfp_RailPCV2" VALUE 0xCC931 Kw_Wu8 51000. TimeDsmTsf 0.00 51000. FORMAT "%5.0" /end CHARACTERISTIC
/begin CHARACTERISTIC DSM_TsfDfp_RailPCV3_C "Schwerezaehlergrenze fuer Fehlerpfad Dfp_RailPCV3" VALUE 0xCC932 Kw_Wu8 51000. TimeDsmTsf 0.00 51000. FORMAT "%5.0" /end CHARACTERISTIC
/begin CHARACTERISTIC DSM_TsfDfp_RailPCV4_C "Schwerezaehlergrenze fuer Fehlerpfad Dfp_RailPCV4" VALUE 0xCC933 Kw_Wu8 51000. TimeDsmTsf 0.00 51000. FORMAT "%5.0" /end CHARACTERISTIC
/begin CHARACTERISTIC DSM_TsfDfp_RailPCV5_C "Schwerezaehlergrenze fuer Fehlerpfad Dfp_RailPCV5" VALUE 0xCC934 Kw_Wu8 51000. TimeDsmTsf 0.00 51000. FORMAT "%5.0" /end CHARACTERISTIC
/begin CHARACTERISTIC DSM_TsfDfp_SOPTst_C "Schwerezaehlergrenze fuer Fehlerpfad Dfp_SOPTst" VALUE 0xCC935 Kw_Wu8 51000. TimeDsmTsf 0.00 51000. FORMAT "%5.0" /end CHARACTERISTIC
/begin CHARACTERISTIC DSM_TsfDfp_SSpMon1_C "Schwerezaehlergrenze fuer Fehlerpfad Dfp_SSpMon1" VALUE 0xCC936 Kw_Wu8 51000. TimeDsmTsf 0.00 51000. FORMAT "%5.0" /end CHARACTERISTIC
/begin CHARACTERISTIC DSM_TsfDfp_SSpMon2_C "Schwerezaehlergrenze fuer Fehlerpfad Dfp_SSpMon2" VALUE 0xCC937 Kw_Wu8 51000. TimeDsmTsf 0.00 51000. FORMAT "%5.0" /end CHARACTERISTIC
/begin CHARACTERISTIC DSM_TsfDfp_SSpMon3_C "Schwerezaehlergrenze fuer Fehlerpfad Dfp_SSpMon3" VALUE 0xCC938 Kw_Wu8 51000. TimeDsmTsf 0.00 51000. FORMAT "%5.0" /end CHARACTERISTIC
/begin CHARACTERISTIC DSM_TsfDfp_ShutCD_C "Schwerezaehlergrenze fuer Fehlerpfad Dfp_ShutCD" VALUE 0xCC939 Kw_Wu8 51000. TimeDsmTsf 0.00 51000. FORMAT "%5.0" /end CHARACTERISTIC
/begin CHARACTERISTIC DSM_TsfDfp_StSysTrqShutOff_C "Schwerezaehlergrenze fuer Fehlerpfad Dfp_StSysTrqShutOff" VALUE 0xCC93A Kw_Wu8 51000. TimeDsmTsf 0.00 51000. FORMAT "%5.0" /end CHARACTERISTIC
/begin CHARACTERISTIC DSM_TsfDfp_StrtCD_Actr_C "Schwerezaehlergrenze fuer Fehlerpfad Dfp_StrtCD_Actr" VALUE 0xCC93B Kw_Wu8 51000. TimeDsmTsf 0.00 51000. FORMAT "%5.0" /end CHARACTERISTIC
/begin CHARACTERISTIC DSM_TsfDfp_SysLamp_C "Schwerezaehlergrenze fuer Fehlerpfad Dfp_SysLamp" VALUE 0xCC93C Kw_Wu8 51000. TimeDsmTsf 0.00 51000. FORMAT "%5.0" /end CHARACTERISTIC
/begin CHARACTERISTIC DSM_TsfDfp_T15CD_C "Schwerezaehlergrenze fuer Fehlerpfad Dfp_T15CD" VALUE 0xCC93D Kw_Wu8 51000. TimeDsmTsf 0.00 51000. FORMAT "%5.0" /end CHARACTERISTIC
/begin CHARACTERISTIC DSM_TsfDfp_TGearbx_C "Schwerezaehlergrenze fuer Fehlerpfad Dfp_TGearbx" VALUE 0xCC93E Kw_Wu8 51000. TimeDsmTsf 0.00 51000. FORMAT "%5.0" /end CHARACTERISTIC
/begin CHARACTERISTIC DSM_TsfDfp_TPUMon_C "Schwerezaehlergrenze fuer Fehlerpfad Dfp_TPUMon" VALUE 0xCC93F Kw_Wu8 51000. TimeDsmTsf 0.00 51000. FORMAT "%5.0" /end CHARACTERISTIC
/begin CHARACTERISTIC DSM_TsfDfp_TVACD_Max_C "Schwerezaehlergrenze fuer Fehlerpfad Dfp_TVACD_Max" VALUE 0xCC940 Kw_Wu8 51000. TimeDsmTsf 0.00 51000. FORMAT "%5.0" /end CHARACTERISTIC
/begin CHARACTERISTIC DSM_TsfDfp_TVACD_Min_C "Schwerezaehlergrenze fuer Fehlerpfad Dfp_TVACD_Min" VALUE 0xCC941 Kw_Wu8 51000. TimeDsmTsf 0.00 51000. FORMAT "%5.0" /end CHARACTERISTIC
/begin CHARACTERISTIC DSM_TsfDfp_TVACD_SigNpl_C "Schwerezaehlergrenze fuer Fehlerpfad Dfp_TVACD_SigNpl" VALUE 0xCC942 Kw_Wu8 51000. TimeDsmTsf 0.00 51000. FORMAT "%5.0" /end CHARACTERISTIC
/begin CHARACTERISTIC DSM_TsfDfp_TVACD_TVADia1_C "Schwerezaehlergrenze fuer Fehlerpfad Dfp_TVACD_TVADia1" VALUE 0xCC943 Kw_Wu8 51000. TimeDsmTsf 0.00 51000. FORMAT "%5.0" /end CHARACTERISTIC
/begin CHARACTERISTIC DSM_TsfDfp_TVACD_TVADia2_C "Schwerezaehlergrenze fuer Fehlerpfad Dfp_TVACD_TVADia2" VALUE 0xCC944 Kw_Wu8 51000. TimeDsmTsf 0.00 51000. FORMAT "%5.0" /end CHARACTERISTIC
/begin CHARACTERISTIC DSM_TsfDfp_TVACD_TVADia3_C "Schwerezaehlergrenze fuer Fehlerpfad Dfp_TVACD_TVADia3" VALUE 0xCC945 Kw_Wu8 51000. TimeDsmTsf 0.00 51000. FORMAT "%5.0" /end CHARACTERISTIC
/begin CHARACTERISTIC DSM_TsfDfp_VSACD_Max_C "Schwerezaehlergrenze fuer Fehlerpfad Dfp_VSACD_Max" VALUE 0xCC946 Kw_Wu8 51000. TimeDsmTsf 0.00 51000. FORMAT "%5.0" /end CHARACTERISTIC
/begin CHARACTERISTIC DSM_TsfDfp_VSACD_Min_C "Schwerezaehlergrenze fuer Fehlerpfad Dfp_VSACD_Min" VALUE 0xCC947 Kw_Wu8 51000. TimeDsmTsf 0.00 51000. FORMAT "%5.0" /end CHARACTERISTIC
/begin CHARACTERISTIC DSM_TsfDfp_VSACD_SigNpl_C "Schwerezaehlergrenze fuer Fehlerpfad Dfp_VSACD_SigNpl" VALUE 0xCC948 Kw_Wu8 51000. TimeDsmTsf 0.00 51000. FORMAT "%5.0" /end CHARACTERISTIC
/begin CHARACTERISTIC DSM_TsfDfp_VSACD_VSADia1_C "Schwerezaehlergrenze fuer Fehlerpfad Dfp_VSACD_VSADia1" VALUE 0xCC949 Kw_Wu8 51000. TimeDsmTsf 0.00 51000. FORMAT "%5.0" /end CHARACTERISTIC
/begin CHARACTERISTIC DSM_TsfDfp_VSACD_VSADia2_C "Schwerezaehlergrenze fuer Fehlerpfad Dfp_VSACD_VSADia2" VALUE 0xCC94A Kw_Wu8 51000. TimeDsmTsf 0.00 51000. FORMAT "%5.0" /end CHARACTERISTIC
/begin CHARACTERISTIC DSM_TsfDfp_VSACD_VSADia3_C "Schwerezaehlergrenze fuer Fehlerpfad Dfp_VSACD_VSADia3" VALUE 0xCC94B Kw_Wu8 51000. TimeDsmTsf 0.00 51000. FORMAT "%5.0" /end CHARACTERISTIC
/begin CHARACTERISTIC DSM_TsfDfp_VSACD_VSADia4_C "Schwerezaehlergrenze fuer Fehlerpfad Dfp_VSACD_VSADia4" VALUE 0xCC94C Kw_Wu8 51000. TimeDsmTsf 0.00 51000. FORMAT "%5.0" /end CHARACTERISTIC
/begin CHARACTERISTIC DSM_TsfDfp_VSSCD1_C "Schwerezaehlergrenze fuer Fehlerpfad Dfp_VSSCD1" VALUE 0xCC94D Kw_Wu8 51000. TimeDsmTsf 0.00 51000. FORMAT "%5.0" /end CHARACTERISTIC
/begin CHARACTERISTIC DSM_TsfDfp_VSSCD2_C "Schwerezaehlergrenze fuer Fehlerpfad Dfp_VSSCD2" VALUE 0xCC94E Kw_Wu8 51000. TimeDsmTsf 0.00 51000. FORMAT "%5.0" /end CHARACTERISTIC
/begin CHARACTERISTIC DSM_TsfDfp_WdCom_C "Schwerezaehlergrenze fuer Fehlerpfad Dfp_WdCom" VALUE 0xCC94F Kw_Wu8 51000. TimeDsmTsf 0.00 51000. FORMAT "%5.0" /end CHARACTERISTIC
/begin CHARACTERISTIC EATSCD_uSRCMin_C "SRC Minimum Umgebungstemperatur" VALUE 0xCC95C Kw_Ws16 5200.391 Volt 0.00 5200.391 FORMAT "%8.3" EXTENDED_LIMITS -160156.4 160151.5 /end CHARACTERISTIC
/begin CHARACTERISTIC EATSCD_uSRCMax_C "SRC Maximum Umgebungstemperatur" VALUE 0xCC95E Kw_Ws16 5200.391 Volt 0.00 5200.391 FORMAT "%8.3" EXTENDED_LIMITS -160156.4 160151.5 /end CHARACTERISTIC
/begin CHARACTERISTIC EATSCD_tLin_CUR "Linearisierungskennlinie der Umgebungstemperatur" CURVE 0xCC960 Kl_Xs16_Ws16 950.0000 Temp_Cels -50.1400 899.8600 FORMAT "%8.4" EXTENDED_LIMITS -3549.940 3003.560
 /begin AXIS_DESCR STD_AXIS EATSCD_uRaw Volt 25 0.00 5200.391 FORMAT "%8.3" EXTENDED_LIMITS -160156.4 160151.5 DEPOSIT ABSOLUTE /end AXIS_DESCR
/end CHARACTERISTIC
/begin CHARACTERISTIC EATSCD_DebSigDef_C "Entprellzeit defekt CAN Signal Fehler Umgebungstemperatur" VALUE 0xCC9C6 Kw_Wu16 655350.0 Time_ms 0.00 655350.0 FORMAT "%8.1" /end CHARACTERISTIC
/begin CHARACTERISTIC EATSCD_DebSigOk_C "Heilungsentprellzeit CAN Signalfehler Umgebungstemperatur" VALUE 0xCC9C8 Kw_Wu16 655350.0 Time_ms 0.00 655350.0 FORMAT "%8.1" /end CHARACTERISTIC
/begin CHARACTERISTIC EATSCD_DebSRCHighDef_C "EATS Fehlerentprellungszeit fuer SRC-High" VALUE 0xCC9CA Kw_Wu16 655350.0 Time_ms 0.00 655350.0 FORMAT "%8.1" /end CHARACTERISTIC
/begin CHARACTERISTIC EATSCD_DebSRCHighOk_C "EATS Heilungsentprellzeit fuer SRC-High" VALUE 0xCC9CC Kw_Wu16 655350.0 Time_ms 0.00 655350.0 FORMAT "%8.1" /end CHARACTERISTIC
/begin CHARACTERISTIC EATSCD_DebSRCLowDef_C "EATS Fehlerentprellungszeit fuer SRC-Low" VALUE 0xCC9CE Kw_Wu16 655350.0 Time_ms 0.00 655350.0 FORMAT "%8.1" /end CHARACTERISTIC
/begin CHARACTERISTIC EATSCD_DebSRCLowOk_C "EATS Heilungsentprellzeit fuer SRC-Low" VALUE 0xCC9D0 Kw_Wu16 655350.0 Time_ms 0.00 655350.0 FORMAT "%8.1" /end CHARACTERISTIC
/begin CHARACTERISTIC EATSCD_dtRmpSubs_C "Rampensteigung für Umgebungstemperatur" VALUE 0xCC9D4 Kw_Wu32 6553.59899750 RmpTempCels 0.00100097656250 6553.59999847 FORMAT "%13.8" EXTENDED_LIMITS 0.00 6553.59999847 /end CHARACTERISTIC
/begin CHARACTERISTIC EATSCD_dtRmpSubsUp_C "Rampensteigung für Umschaltung der Umgebungstemperatur" VALUE 0xCC9D8 Kw_Wu32 6553.59899750 RmpTempCels 0.00100097656250 6553.59999847 FORMAT "%13.8" EXTENDED_LIMITS 0.00 6553.59999847 /end CHARACTERISTIC
/begin CHARACTERISTIC EATSCD_dtRmpSubsDwn_C "Rampensteigung für Umschaltung der Umgebungstemperatur" VALUE 0xCC9DC Kw_Wu32 6553.59899750 RmpTempCels 0.00100097656250 6553.59999847 FORMAT "%13.8" EXTENDED_LIMITS 0.00 6553.59999847 /end CHARACTERISTIC
/begin CHARACTERISTIC EATSCD_numAdc_C "#SSD Applikationsparameter fuer Umgebungslufttemperatur-Fuhehler" VALUE 0xCC9E0 Kw_Wu8 44.0000000000 NumPinAdc 0.00 44.0000000000 FORMAT "%13.10" /end CHARACTERISTIC
/begin CHARACTERISTIC EATSCD_dtRmpSlpUp_C "popsitive Rampensteigung" VALUE 0xCC9E4 Kw_Wu32 6553598.99749 RmpTemp 1.00097656250 6553599.99847 FORMAT "%13.5" EXTENDED_LIMITS 0.00 6553599.99847 /end CHARACTERISTIC
/begin CHARACTERISTIC EATSCD_dtRmpSlpDwn_C "negative Rampensteigung" VALUE 0xCC9E8 Kw_Wu32 6553598.99749 RmpTemp 1.00097656250 6553599.99847 FORMAT "%13.5" EXTENDED_LIMITS 0.00 6553599.99847 /end CHARACTERISTIC
/begin CHARACTERISTIC EATSCD_swtSensImpl_C "Schalter zur Auswahl der Umgebungstemperatur" VALUE 0xCC9EC Kw_Wu8 2.000 OneToOne 0.00 2.000 FORMAT "%5.3" EXTENDED_LIMITS 0.00 255.0 /end CHARACTERISTIC
/begin CHARACTERISTIC EATSCD_swtSigVal_C "Datensatzwert Signalquelle Umgebungsluftemperatur (ADC oder CAN)" VALUE 0xCC9ED Kw_Wu8 1.000 OneToOne 0.00 1.000 FORMAT "%5.3" EXTENDED_LIMITS 0.00 255.0 /end CHARACTERISTIC
/begin CHARACTERISTIC EATSCD_tAirSubs_C "Ersatzwert für Umgebungstemperatur" VALUE 0xCC9EE Kw_Ws16 250.0000 Temp_Cels -50.14000 199.8600 FORMAT "%8.4" EXTENDED_LIMITS -3549.940 3003.560 /end CHARACTERISTIC
/begin CHARACTERISTIC EATSCD_stSensIDWord_C "Geberkennwort Umgebungstemperatur" VALUE 0xCC9F0 Kw_Wu16 65535.00 OneToOne 0.00 65535.00 FORMAT "%8.2" /end CHARACTERISTIC
/begin CHARACTERISTIC EATSCD_tDfl_C "Vorgabewert Umgebungstemperatur" VALUE 0xCC9F2 Kw_Ws16 950.0000 Temp_Cels -50.1400 899.8600 FORMAT "%8.4" EXTENDED_LIMITS -3549.940 3003.560 /end CHARACTERISTIC
/begin MEASUREMENT DfpErrCol_mp "Meßpunkt der für alle Fehlerpfade die Fehlerinformation gesammelt zur Verfügung stellt." UWORD OneToOne 1 100 0.00 65535.00 FORMAT "%8.2" ARRAY_SIZE 22 ECU_ADDRESS 0x6F802A /end MEASUREMENT
/begin MEASUREMENT DFPM_stFCMChkCause "Message für DSM internen gebrauch (unterstützung bei DSM problemen)" UBYTE FCMChkCause 1 100 1.00000000000 15.0000000000 FORMAT "%13.10" ECU_ADDRESS 0x7FA314 /end MEASUREMENT
/begin MEASUREMENT DfpZyfCol_mp "Meßpunkt der gesammelt für alle Fehlerpfade das Zyklus Bit (getested Info) zur Verfügung stellt." UWORD OneToOne 1 100 0.00 65535.00 FORMAT "%8.2" ARRAY_SIZE 22 ECU_ADDRESS 0x6F8056 /end MEASUREMENT
/begin MEASUREMENT DSCHED_numDefDfpArray_mp "Array von defekten DFPs welche einen ausgewählten FID verriegeln" UWORD DfpName 1 100 0.00 344.000000000 FORMAT "%13.9" ARRAY_SIZE 10 ECU_ADDRESS 0x8FEBE0 /end MEASUREMENT
/begin MEASUREMENT DSCHED_numOkDfpArray_mp "Array von nicht defekten DFPs welche einen ausgewählten FID verriegeln" UWORD DfpName 1 100 0.00 344.000000000 FORMAT "%13.9" ARRAY_SIZE 20 ECU_ADDRESS 0x8FEBF4 /end MEASUREMENT
/begin MEASUREMENT DSM_ctDfctPath "Anzahl der momentan defekten Fehlerpfade" UWORD OneToOne 1 100 0.00 65535.00 FORMAT "%8.2" ECU_ADDRESS 0x7F8B86 /end MEASUREMENT
/begin MEASUREMENT DSM_ctFcmEntry "Anzahl der belegten Fehlerspeichereinträge" UBYTE OneToOne 1 100 0.00 255.0 FORMAT "%5.1" ECU_ADDRESS 0x7F8810 /end MEASUREMENT
/begin MEASUREMENT DSM_ctFCMEntrySize_mp "Größe eines Fehlerspeichereintrages in Bytes (Inklusive Füllbyte falls vorhanden)" UBYTE OneToOne 1 100 0.00 255.0 FORMAT "%5.1" ECU_ADDRESS 0x8FEC1C /end MEASUREMENT
/begin MEASUREMENT DSM_ctOBDPath "Anzahl der momentanen OBD-fehler im Fehlerspeicher" UBYTE OneToOne 1 100 0.00 255.0 FORMAT "%5.1" ECU_ADDRESS 0x7F8811 /end MEASUREMENT
/begin MEASUREMENT DSM_ctOBDValidPath "Anzahl bestätigter OBD relevanter Fehlerspeicher Einträge." UBYTE OneToOne 1 100 0.00 255.0 FORMAT "%5.1" ECU_ADDRESS 0x7F8812 /end MEASUREMENT
/begin MEASUREMENT DSM_ctPath_mp "Anzahl der existierenden Fehlerpfade" UWORD OneToOne 1 100 0.00 65535.00 FORMAT "%8.2" ECU_ADDRESS 0x8FEC1E /end MEASUREMENT
/begin MEASUREMENT DSM_ctRdyActCyc_mp "Status für jedes Readinessbit aus dem aktuellen driving cycle" UBYTE OneToOne 1 100 0.00 255.0 FORMAT "%5.1" ECU_ADDRESS 0x6F8020 /end MEASUREMENT
/begin MEASUREMENT DSM_ctRdyCycCat_mp "Anzahl der für Readiness Bit Catalyst erreichten Zyklen." UBYTE OneToOne 1 100 0.00 255.0 FORMAT "%5.1" ECU_ADDRESS 0x8FEBC7 /end MEASUREMENT
/begin MEASUREMENT DSM_ctRdyCycCompr_mp "Anzahl der für Readiness Bit Comprehensive Components erreichten Zyklen." UBYTE OneToOne 1 100 0.00 255.0 FORMAT "%5.1" ECU_ADDRESS 0x8FEBC8 /end MEASUREMENT
/begin MEASUREMENT DSM_ctRdyCycEGR_mp "Anzahl der für Readiness Bit EGR erreichten Zyklen." UBYTE OneToOne 1 100 0.00 255.0 FORMAT "%5.1" ECU_ADDRESS 0x8FEBC9 /end MEASUREMENT
/begin MEASUREMENT DSM_ctRdyCycFuel_mp "Anzahl der für Readiness Bit Fuel System erreichten Zyklen." UBYTE OneToOne 1 100 0.00 255.0 FORMAT "%5.1" ECU_ADDRESS 0x8FEBCA /end MEASUREMENT
/begin MEASUREMENT DSM_ctRdyCycMisf_mp "Anzahl der für Readiness Bit Misfire erreichten Zyklen." UBYTE OneToOne 1 100 0.00 255.0 FORMAT "%5.1" ECU_ADDRESS 0x8FEBCB /end MEASUREMENT
/begin MEASUREMENT DSM_ctRdyCycOxSenHt_mp "Anzahl erreichter Zyklen für Readiness Bit Oxygen Sensor Heater" UBYTE OneToOne 1 100 0.00 255.0 FORMAT "%5.1" ECU_ADDRESS 0x8FEBCC /end MEASUREMENT
/begin MEASUREMENT DSM_ctRdyCycOxSen_mp "Anzahl der erreichten Zyklen für Readiness Bit Oxygen Sensor" UBYTE OneToOne 1 100 0.00 255.0 FORMAT "%5.1" ECU_ADDRESS 0x8FEBCD /end MEASUREMENT
/begin MEASUREMENT DSM_ctRdyLimCat_mp "Notwendige Anzahl Zyklen für Readiness Bit Catalyst." UBYTE OneToOne 1 100 0.00 255.0 FORMAT "%5.1" ECU_ADDRESS 0x8FEBCE /end MEASUREMENT
/begin MEASUREMENT DSM_ctRdyLimCompr_mp "Notwendige Anzahl Zyklen für Readiness Bit Comprehensive Components." UBYTE OneToOne 1 100 0.00 255.0 FORMAT "%5.1" ECU_ADDRESS 0x8FEBCF /end MEASUREMENT
/begin MEASUREMENT DSM_ctRdyLimEGR_mp "Notwendige Anzahl Zyklen für Readiness Bit EGR." UBYTE OneToOne 1 100 0.00 255.0 FORMAT "%5.1" ECU_ADDRESS 0x8FEBD0 /end MEASUREMENT
/begin MEASUREMENT DSM_ctRdyLimFuel_mp "Notwendige Anzahl Zyklen für Readiness Bit Fuel System." UBYTE OneToOne 1 100 0.00 255.0 FORMAT "%5.1" ECU_ADDRESS 0x8FEBD1 /end MEASUREMENT
/begin MEASUREMENT DSM_ctRdyLimMisf_mp "Notwendige Anzahl Zyklen für Readiness Bit Misfire." UBYTE OneToOne 1 100 0.00 255.0 FORMAT "%5.1" ECU_ADDRESS 0x8FEBD2 /end MEASUREMENT
/begin MEASUREMENT DSM_ctRdyLimOxSenHt_mp "Notwendige Anzahl von Zyklen für Readiness Bit Oxygen Sensor Heater" UBYTE OneToOne 1 100 0.00 255.0 FORMAT "%5.1" ECU_ADDRESS 0x8FEBD3 /end MEASUREMENT
/begin MEASUREMENT DSM_ctRdyLimOxSen_mp "Notwendige Anzahl Zyklen für Readiness Bit Oxygen Sensor" UBYTE OneToOne 1 100 0.00 255.0 FORMAT "%5.1" ECU_ADDRESS 0x8FEBD4 /end MEASUREMENT
/begin MEASUREMENT DSM_ctRdyPathsCat_mp "Anzahl von Fehlerpfaden die zum Readiness Bit Catalyst gehören." UBYTE OneToOne 1 100 0.00 255.0 FORMAT "%5.1" ECU_ADDRESS 0x8FEBD5 /end MEASUREMENT
/begin MEASUREMENT DSM_ctRdyPathsCompr_mp "Anzahl von Fehlerpfaden die zum Readiness Bit Comprehensive Components gehören." UBYTE OneToOne 1 100 0.00 255.0 FORMAT "%5.1" ECU_ADDRESS 0x8FEBD6 /end MEASUREMENT
/begin MEASUREMENT DSM_ctRdyPathsEGR_mp "Anzahl von Fehlerpfaden die zum Readiness Bit EGR gehören." UBYTE OneToOne 1 100 0.00 255.0 FORMAT "%5.1" ECU_ADDRESS 0x8FEBD7 /end MEASUREMENT
/begin MEASUREMENT DSM_ctRdyPathsFuel_mp "Anzahl von Fehlerpfaden die zum Readiness Bit Fuel System gehören." UBYTE OneToOne 1 100 0.00 255.0 FORMAT "%5.1" ECU_ADDRESS 0x8FEBD8 /end MEASUREMENT
/begin MEASUREMENT DSM_ctRdyPathsMisf_mp "Anzahl von Fehlerpfaden die zum Readiness Bit Misfire gehören." UBYTE OneToOne 1 100 0.00 255.0 FORMAT "%5.1" ECU_ADDRESS 0x8FEBD9 /end MEASUREMENT
/begin MEASUREMENT DSM_ctRdyPathsOxSenHt_mp "Anzahl von Fehlerpfaden, die zum Readiness Bit Oxygen Sensor Heater gehören" UBYTE OneToOne 1 100 0.00 255.0 FORMAT "%5.1" ECU_ADDRESS 0x8FEBDA /end MEASUREMENT
/begin MEASUREMENT DSM_ctRdyPathsOxSen_mp "Anzahl der Fehlerpfade die zum Readiness Bit Oxygen Sensor gehören" UBYTE OneToOne 1 100 0.00 255.0 FORMAT "%5.1" ECU_ADDRESS 0x8FEBDB /end MEASUREMENT
/begin MEASUREMENT DSM_ctRdyTstCat_mp "Anzahl von in diesem Zyklus getesteten Fehlerpfaden die zum Readiness Bit Catalyst gehören." UBYTE OneToOne 1 100 0.00 255.0 FORMAT "%5.1" ECU_ADDRESS 0x8FEBDC /end MEASUREMENT
/begin MEASUREMENT DSM_ctRdyTstCompr_mp "Anzahl von in diesem Zyklus getesteten Fehlerpfaden die zum Readiness Bit Comprehensive Components  gehören." UBYTE OneToOne 1 100 0.00 255.0 FORMAT "%5.1" ECU_ADDRESS 0x6F8022 /end MEASUREMENT
/begin MEASUREMENT DSM_ctRdyTstEGR_mp "Anzahl von in diesem Zyklus getesteten Fehlerpfaden die zum Readiness Bit EGR gehören." UBYTE OneToOne 1 100 0.00 255.0 FORMAT "%5.1" ECU_ADDRESS 0x6F8024 /end MEASUREMENT
/begin MEASUREMENT DSM_ctRdyTstFuel_mp "Anzahl von in diesem Zyklus getesteten Fehlerpfaden die zum Readiness Bit Fuel System gehören." UBYTE OneToOne 1 100 0.00 255.0 FORMAT "%5.1" ECU_ADDRESS 0x6F8026 /end MEASUREMENT
/begin MEASUREMENT DSM_ctRdyTstMisf_mp "Anzahl von in diesem Zyklus getesteten Fehlerpfaden die zum Readiness Bit Misfire  gehören." UBYTE OneToOne 1 100 0.00 255.0 FORMAT "%5.1" ECU_ADDRESS 0x6F8028 /end MEASUREMENT
/begin MEASUREMENT DSM_ctRdyTstOxSenHt_mp "Anzahl von in diesem Zyklus getesteten Fehlerpfaden die zum Readiness Bit Oxygen Sensor Heater gehören." UBYTE OneToOne 1 100 0.00 255.0 FORMAT "%5.1" ECU_ADDRESS 0x8FEBDD /end MEASUREMENT
/begin MEASUREMENT DSM_ctRdyTstOxSen_mp "Anzahl von in diesem Zyklus getesteten Fehlerpfaden die zum Readiness Bit Oxygen Sensor Heater gehören." UBYTE OneToOne 1 100 0.00 255.0 FORMAT "%5.1" ECU_ADDRESS 0x8FEBDE /end MEASUREMENT
/begin MEASUREMENT DSM_ctTstPath "Anzahl der getesteten Fehlerpfade" UWORD OneToOne 1 100 0.00 65535.00 FORMAT "%8.2" ECU_ADDRESS 0x7F8B88 /end MEASUREMENT
/begin MEASUREMENT DSM_ctWUC "Anzahl der Warm Up Cycle seit dem letzten Fehlerspeicherlöschen  (PID $30)" UBYTE OneToOne 1 100 0.00 255.0 FORMAT "%5.1" ECU_ADDRESS 0x7FEF2A /end MEASUREMENT
/begin MEASUREMENT DSM_lDist "Anzahl der gefahrenen Strecke seitdem letzten Fehlerspeicherlöschen (PID $31)" UWORD OneToOne 1 100 0.00 65535.00 FORMAT "%8.2" ECU_ADDRESS 0x7FEF2C /end MEASUREMENT
/begin MEASUREMENT DSM_stCycles "Status der DSM Trigger Zyklen (WUC, DC, ...)" UBYTE OneToOne 1 100 0.00 255.0 FORMAT "%5.1" ECU_ADDRESS 0x7F8813 /end MEASUREMENT
/begin MEASUREMENT DSM_stECUMasterSlave "Statusinformation ob das Steuergerät ein Master- oder ein Slave-Steuergerät ist" UBYTE OneToOne 1 100 0.00 255.0 FORMAT "%5.1" ECU_ADDRESS 0x7F8814 /end MEASUREMENT
/begin MEASUREMENT DSM_stInhDelay "Status Fehlerverriegelungs Verzögerung (1 wenn mindestens 1 Verzögerung aktiv)" UBYTE OneToOne 1 100 0.00 255.0 FORMAT "%5.1" ECU_ADDRESS 0x7F8815 /end MEASUREMENT
/begin MEASUREMENT DSM_stMIL "DSM Mil Anforderungsstatus (1 = kontinuierlich, 2 blinkend)" UBYTE OneToOne 1 100 0.00 255.0 FORMAT "%5.1" ECU_ADDRESS 0x7F8816 /end MEASUREMENT
/begin MEASUREMENT DSM_stPID41 "Readiness Status für Diagnoseschnittstelle gemäß ISO/DIS 15031-6.5, PID41" ULONG OneToOne 1 100 0.00 4294967295.00 FORMAT "%13.2" ECU_ADDRESS 0x7F9100 /end MEASUREMENT
/begin MEASUREMENT DSM_stRdyAB "Readiness Status für Diagnoseschnittstelle gemäß SAE J1979 PID1 Byte A + B" UWORD OneToOne 1 100 0.00 65535.00 FORMAT "%8.2" ECU_ADDRESS 0x7F8B8A /end MEASUREMENT
/begin MEASUREMENT DSM_stRdyCD "Readiness Status für Diagnoseschnittstelle gemäß SAE J1979 PID1 Byte C * D" UWORD OneToOne 1 100 0.00 65535.00 FORMAT "%8.2" ECU_ADDRESS 0x7F8B8C /end MEASUREMENT
/begin MEASUREMENT DSM_stRdyCheckEnable "veroderte ready-bits der dfps, die durch die Funktion DSM_SetDfpSleep ermittelt wurden" UBYTE OneToOne 1 100 0.00 255.0 FORMAT "%5.1" ECU_ADDRESS 0x7F8817 /end MEASUREMENT
/begin MEASUREMENT DSM_stSysLamp "DSM System Lampen Anforderungsstatus (1 = kontinuierlich)" UBYTE OneToOne 1 100 0.00 255.0 FORMAT "%5.1" ECU_ADDRESS 0x7F8818 /end MEASUREMENT
/begin MEASUREMENT DSM_tiDCDelay_mp "aktuelle Zeit für Driving cycle Verzögerungszeit" UWORD OneToOne 1 100 0.00 65535.00 FORMAT "%8.2" ECU_ADDRESS 0x6F8082 /end MEASUREMENT
/begin MEASUREMENT EATSCD_swtSig "Signalquelle Umgebungstemperatur (ADC oder CAN)" UBYTE OneToOne 1 100 0.00 255.0 FORMAT "%5.1" ECU_ADDRESS 0x7F8819 /end MEASUREMENT
/begin MEASUREMENT EATSCD_tAir "Umgebungstemperatur" SWORD Temp_Cels 1 100 -50.140 899.860 FORMAT "%8.3" ECU_ADDRESS 0x7F8B90 /end MEASUREMENT
/begin MEASUREMENT EATSCD_tAirLin "linearisierter Wert der Umgebungstemperatur" SWORD Temp_Cels 1 100 -50.140 899.860 FORMAT "%8.3" ECU_ADDRESS 0x7F8B92 /end MEASUREMENT
/begin MEASUREMENT EATSCD_uRaw "Spannungsrohwert der Umgebungstemperatur" SWORD Volt 1 100 0.00 5000.000 FORMAT "%8.3" ECU_ADDRESS 0x7F8B94 /end MEASUREMENT
/begin MEASUREMENT EGT_tInrBiTrb "Temperatur des inneren Reglers für Bi-Turbo Motoren." SWORD Temp_Cels 1 100 -50.140 899.860 FORMAT "%8.3" ECU_ADDRESS 0x7F8BDA /end MEASUREMENT
/begin MEASUREMENT EGT_tInrDesCorBiTrb "Vorgabe Korrekturwert des inneren Reglers für Bi_Turbo Motoren" SWORD Temp_Cels 1 100 -50.140 899.860 FORMAT "%8.3" ECU_ADDRESS 0x7F8BDC /end MEASUREMENT
/begin MEASUREMENT EGT_tInrDesInTempGvnr "Kundenspezifischer Temperaturvorgabewert des inneren Reglers." SWORD Temp_Cels 1 100 -50.140 899.860 FORMAT "%8.3" ECU_ADDRESS 0x7F8BE0 /end MEASUREMENT
/begin MEASUREMENT EGT_tOutrDesInTempGvnr "Kundenspezifischer Temperaturvorgabewert des äußeren Reglers." SWORD Temp_Cels 1 100 -50.140 899.860 FORMAT "%8.3" ECU_ADDRESS 0x7F8BE6 /end MEASUREMENT
/begin MEASUREMENT FidCol_mp "Meßpunkt der gesammelt den Zustand aller Funktionsidentifier (Fid) zur Verfügung stellt." UWORD OneToOne 1 100 0.00 65535.00 FORMAT "%8.2" ARRAY_SIZE 17 ECU_ADDRESS 0x8FEC20 /end MEASUREMENT
/begin MEASUREMENT FrmMng_stSTAT_HDC "Zustand CAN-Botschaft S_HDC" UBYTE OneToOne 1 100 0.00 255.0 FORMAT "%5.1" ECU_ADDRESS 0x7F8889 /end MEASUREMENT
/begin MEASUREMENT PFlt_tOxiPst "Temperatur nach dem Oxidations Katalysator" SWORD Temp_Cels 1 100 -50.140 899.860 FORMAT "%8.3" ECU_ADDRESS 0x7F8FBE /end MEASUREMENT
/begin MEASUREMENT PFlt_tTurbPre "Temperatur vor dem Turbolader" SWORD Temp_Cels 1 100 -50.140 899.860 FORMAT "%8.3" ECU_ADDRESS 0x7F8FC8 /end MEASUREMENT
/begin MEASUREMENT Uhwe_ctAtomicLvl_mp "Interrupt Lock Level" ULONG OneToOne 1 100 0.00 4294967295.00 FORMAT "%13.2" ECU_ADDRESS 0x8FEC44 /end MEASUREMENT
/begin FUNCTION dsm_auto_trans ""
 /begin DEF_CHARACTERISTIC DSM_TypDfp_Layer_TANS_C DSM_TypDfp_ACCDSwtin_C DSM_TypDfp_ACC_PlausTrqDes_C DSM_TypDfp_ACC_trqInr_C DSM_TypDfp_ACTrq_C DSM_TypDfp_ADCMon_C DSM_TypDfp_AFSCDIdlAdjVal_C DSM_TypDfp_AFSCDLdAdjVal_C DSM_TypDfp_AFSCD_AirTempDcyc_C DSM_TypDfp_AFSCD_PlOffsDrft_C DSM_TypDfp_AFSCD_PlSetyDrft_C DSM_TypDfp_AFSCD_SRCAirTemp_C DSM_TypDfp_AFSCD_SRCBatt_C DSM_TypDfp_AFSCD_SRCCorrAirm_C DSM_TypDfp_AFSCD_SRCRawAirm_C DSM_TypDfp_AFSCD_SRCRefSigPer_C DSM_TypDfp_AOHtCD_C DSM_TypDfp_AOHtCD_AOHtDia1_C DSM_TypDfp_AOHtCD_AOHtDia2_C DSM_TypDfp_Layer_TUMG_C DSM_TypDfp_AOHtCD_AOHtDia3_C DSM_TypDfp_APP1_C DSM_TypDfp_Layer_GEN_C DSM_TypDfp_Layer_BSD_C DSM_TypDfp_APP2_C DSM_TypDfp_APSCD_C DSM_TypDfp_ARS_C DSM_TypDfp_AccPedPlausBrk_C DSM_TypDfp_AirCtlPlateBreak_C DSM_TypDfp_AirCtl_GovNegDev_C DSM_TypDfp_AirCtl_GovNegDev2_C DSM_TypDfp_AirCtl_GovPosDev_C DSM_TypDfp_AirCtl_GovPosDev2_C DSM_TypDfp_AltCD_C DSM_TypDfp_Layer_QLT_C DSM_TypDfp_BPACD_BPADia1_C DSM_TypDfp_Layer_IBS1_C DSM_TypDfp_Layer_IBS2_C DSM_TypDfp_Layer_IBS3_C DSM_TypDfp_Layer_PMBN_C DSM_TypDfp_Layer_PMBATT_C DSM_TypDfp_BPACD_BPADia2_C DSM_TypDfp_BPACD_BPADia3_C DSM_TypDfp_BPACD_Max_C DSM_TypDfp_BPACD_Min_C DSM_TypDfp_BPACD_SigNpl_C DSM_TypDfp_BPSCD_C DSM_TypDfp_BattCD_C DSM_TypDfp_BrkCD_C DSM_TypDfp_Bss_C DSM_TypDfp_CBACD_C DSM_TypDfp_CTSCD_C DSM_TypDfp_Clg_DynTst_C DSM_TypDfp_CmbChbMisfire1_C DSM_TypDfp_CmbChbMisfire2_C DSM_TypDfp_CmbChbMisfire3_C DSM_TypDfp_CmbChbMisfire4_C DSM_TypDfp_CmbChbMisfire5_C DSM_TypDfp_CmbChbMisfire6_C DSM_TypDfp_CmbChbMisfireMul_C DSM_TypDfp_CoVMDCSh_C DSM_TypDfp_ConvCD_C DSM_TypDfp_CrCCDMFL_C DSM_TypDfp_CrCtl_vCrCtl_C DSM_TypDfp_Dummy1_C DSM_TypDfp_EATSCD_C DSM_TypDfp_EBAFCD_C DSM_TypDfp_EBFCD_C DSM_TypDfp_EBTSCD_C DSM_TypDfp_EBTSCD_OvrTemp_C DSM_TypDfp_EEPCDVarMng_C DSM_TypDfp_EGPpCD_C DSM_TypDfp_EGPpCDTPreTrbn_C DSM_TypDfp_Layer_PMRUHVERL_C DSM_TypDfp_EGRCD_Max_C DSM_TypDfp_EGRCD_Min_C DSM_TypDfp_EGRCD_SigNpl_C DSM_TypDfp_EGTRgnOilDil_C DSM_TypDfp_Layer_TOENS_C DSM_TypDfp_Layer_MANHYDR_C DSM_TypDfp_Layer_MANLUFT_C DSM_TypDfp_ETClbETFltInj1_C DSM_TypDfp_ETClbETFltInj2_C DSM_TypDfp_ETClbETFltInj3_C DSM_TypDfp_ETClbETFltInj4_C DSM_TypDfp_ETClbETFltInj5_C DSM_TypDfp_ETClbETFltInj6_C DSM_TypDfp_ETClbInj1_C DSM_TypDfp_ETClbInj2_C DSM_TypDfp_ETClbInj3_C DSM_TypDfp_ETClbInj4_C DSM_TypDfp_ETClbInj5_C DSM_TypDfp_ETClbInj6_C DSM_TypDfp_EngMCaS1_C DSM_TypDfp_EngMCrS1_C DSM_TypDfp_EngMOfsCaSCrS_C DSM_TypDfp_EngMntCtl1_Dia1_C DSM_TypDfp_EngMntCtl1_Dia2_C DSM_TypDfp_EngMntCtl1_Dia3_C DSM_TypDfp_EngMntCtl1_Max_C DSM_TypDfp_EngMntCtl1_Min_C DSM_TypDfp_EngMntCtl1_SigNpl_C DSM_TypDfp_EngMntCtlCD_C DSM_TypDfp_EngMntCtl_Dia1_C DSM_TypDfp_EngMntCtl_Dia2_C DSM_TypDfp_EngMntCtl_Dia3_C DSM_TypDfp_EngMntCtl_Max_C DSM_TypDfp_EngMntCtl_Min_C DSM_TypDfp_EngMntCtl_SigNpl_C DSM_TypDfp_EngPrtFWODet_C DSM_TypDfp_FBCqDvt_C DSM_TypDfp_FMTC_NonMonotonMap_C DSM_TypDfp_FTSCD_C DSM_TypDfp_FanCD_C DSM_TypDfp_FanCD_FanCtlr1_C DSM_TypDfp_FanCD_FanCtlr2_C DSM_TypDfp_FanCD_FanCtlr3_C DSM_TypDfp_FlFCD_C DSM_TypDfp_FlMngSmkDefect_C DSM_TypDfp_FrmMngBOS_RESET_C DSM_TypDfp_FrmMngBOS_RESET_2_C DSM_TypDfp_FrmMngDMANFAFS_C DSM_TypDfp_FrmMngDRMANFSSG_C DSM_TypDfp_FrmMngGEARBX_DATA_C DSM_TypDfp_FrmMngGEARBX_DATA2_C DSM_TypDfp_FrmMngHEAT_AC_C DSM_TypDfp_FrmMngLENKRADWINKEL_C DSM_TypDfp_FrmMngMILEAGE_RANGE_C DSM_TypDfp_FrmMngOPCRCTLACC_C DSM_TypDfp_FrmMngPRGG_CCTR_C DSM_TypDfp_FrmMngPWRMNG_LOADV_C DSM_TypDfp_FrmMngParkConsumer_C DSM_TypDfp_FrmMngRQSTGEFAN_C DSM_TypDfp_FrmMngSSGErr_C DSM_TypDfp_FrmMngSSGShOff_C DSM_TypDfp_FrmMngSTAT_ANH_C DSM_TypDfp_FrmMngSTAT_ARS_C DSM_TypDfp_FrmMngSTAT_DSC_C DSM_TypDfp_FrmMngSTAT_EKP_C DSM_TypDfp_FrmMngSTAT_KOMBI_C DSM_TypDfp_FrmMngSTAT_SITZ_C DSM_TypDfp_FrmMngStOBDGbxMilOf_C DSM_TypDfp_FrmMngStOBDGbxMilOn_C DSM_TypDfp_FrmMngTEMPRELTIME_C DSM_TypDfp_FrmMngTERMINAL_C DSM_TypDfp_FrmMngTIME_DATE_C DSM_TypDfp_FrmMngTORQUE_DSC_C DSM_TypDfp_FrmMngTORQUE_GEARBX_C DSM_TypDfp_FrmMngTrq_ReqACC_C DSM_TypDfp_FrmMngVEH_MOD_C DSM_TypDfp_FrmMngVELOCITY_C DSM_TypDfp_FrmMngWHEEL_SPEED_C DSM_TypDfp_FrmMngstCurr_C DSM_TypDfp_FrmMngswtPSPOff_C DSM_TypDfp_GearbxIncMax_C DSM_TypDfp_GlwCD_C DSM_TypDfp_GlwCDGlwCirc1_C DSM_TypDfp_GlwCDGlwCirc2_C DSM_TypDfp_GlwCDGlwCirc3_C DSM_TypDfp_GlwCDGlwCirc4_C DSM_TypDfp_GlwCDGlwCirc5_C DSM_TypDfp_GlwCDGlwCirc6_C DSM_TypDfp_GlwCDGlwCirc7_C DSM_TypDfp_GlwCDGlwCirc8_C DSM_TypDfp_GlwCtl_C DSM_TypDfp_HWEMonCom_C DSM_TypDfp_HWEMonEEPROM_C DSM_TypDfp_HWEMonRcyLocked_C DSM_TypDfp_HWEMonRcySuppressed_C DSM_TypDfp_HWEMonRcyVisible_C DSM_TypDfp_HWEMonUMaxSupply_C DSM_TypDfp_HWEMonUMinSupply_C DSM_TypDfp_IATSCD_C DSM_TypDfp_IATSCD_CATS_C DSM_TypDfp_ImmCtlImmCD_C DSM_TypDfp_ImmCtlImmEep_C DSM_TypDfp_ImmCtlMpl_C DSM_TypDfp_IndSys1_C DSM_TypDfp_IndSys2_C DSM_TypDfp_InjCrv_InjLim_C DSM_TypDfp_InjCtlAdjQnt_C DSM_TypDfp_InjCtlDrift_C DSM_TypDfp_InjVCDActrChrg_C DSM_TypDfp_InjVCDActrEnrg1_C DSM_TypDfp_InjVCDActrEnrg2_C DSM_TypDfp_InjVCDActrEnrg3_C DSM_TypDfp_InjVCDActrEnrg4_C DSM_TypDfp_InjVCDActrEnrg5_C DSM_TypDfp_InjVCDActrEnrg6_C DSM_TypDfp_InjVCDActrEnrg7_C DSM_TypDfp_InjVCDActrEnrg8_C DSM_TypDfp_InjVCDActrVolt_C DSM_TypDfp_InjVCDClsBank1_C DSM_TypDfp_InjVCDClsBank2_C DSM_TypDfp_InjVCDMonCab_C DSM_TypDfp_InjVCDMonSwt_C DSM_TypDfp_InjVCDShOffDCDC_C DSM_TypDfp_InjVCDUBuf_C DSM_TypDfp_InjVCD_CY370Ampl_C DSM_TypDfp_InjVlvBnk1A_C DSM_TypDfp_InjVlvBnk1B_C DSM_TypDfp_InjVlvBnk2A_C DSM_TypDfp_InjVlvBnk2B_C DSM_TypDfp_InjVlvChipA_C DSM_TypDfp_InjVlvChipB_C DSM_TypDfp_InjVlvCyl1A_C DSM_TypDfp_InjVlvCyl1B_C DSM_TypDfp_InjVlvCyl1C_C DSM_TypDfp_InjVlvCyl2A_C DSM_TypDfp_InjVlvCyl2B_C DSM_TypDfp_InjVlvCyl2C_C DSM_TypDfp_InjVlvCyl3A_C DSM_TypDfp_InjVlvCyl3B_C DSM_TypDfp_InjVlvCyl3C_C DSM_TypDfp_InjVlvCyl4A_C DSM_TypDfp_InjVlvCyl4B_C DSM_TypDfp_InjVlvCyl4C_C DSM_TypDfp_InjVlvCyl5A_C DSM_TypDfp_InjVlvCyl5B_C DSM_TypDfp_InjVlvCyl5C_C DSM_TypDfp_InjVlvCyl6A_C DSM_TypDfp_InjVlvCyl6B_C DSM_TypDfp_InjVlvCyl6C_C DSM_TypDfp_InjVlvCyl7A_C DSM_TypDfp_InjVlvCyl7B_C DSM_TypDfp_InjVlvCyl7C_C DSM_TypDfp_InjVlvCyl8A_C DSM_TypDfp_InjVlvCyl8B_C DSM_TypDfp_InjVlvCyl8C_C DSM_TypDfp_InjVlvNVC1_C DSM_TypDfp_InjVlvNVC2_C DSM_TypDfp_InjVlvNVC3_C DSM_TypDfp_InjVlvNVC4_C DSM_TypDfp_InjVlvNVC5_C DSM_TypDfp_InjVlvNVC6_C DSM_TypDfp_InjVlvNVC7_C DSM_TypDfp_InjVlvNVC8_C DSM_TypDfp_LPACD_Max_C DSM_TypDfp_LPACD_Min_C DSM_TypDfp_LPACD_SigNpl_C DSM_TypDfp_LSUCDCircNernst0_C DSM_TypDfp_LSUCDCircPumpCur0_C DSM_TypDfp_LSUCDCircVirtGnd0_C DSM_TypDfp_LSUCDHeater0_C DSM_TypDfp_LSUCDHtCoup0_C DSM_TypDfp_LSUCDO20_C DSM_TypDfp_LSUCDO2Clb0_C DSM_TypDfp_LSUCDRiClb0_C DSM_TypDfp_LSUCDSPI0_C DSM_TypDfp_LSUCDSPIBattLow0_C DSM_TypDfp_LSUCDWireIP0_C DSM_TypDfp_LSUCtlRiExc0_C DSM_TypDfp_LSUMon1Sens_C DSM_TypDfp_LSUMon2Sens_C DSM_TypDfp_LubCD_C DSM_TypDfp_MIL_C DSM_TypDfp_MRlyCD_C DSM_TypDfp_MSidCD_Comm_C DSM_TypDfp_MSidCD_Pin_C DSM_TypDfp_MSidCD_Sel_INI_C DSM_TypDfp_MSidCD_Select_C DSM_TypDfp_MeUnCDNoLoad_C DSM_TypDfp_MeUnCDSCBat_C DSM_TypDfp_MeUnCDSCGnd_C DSM_TypDfp_MeUnCD_ADC_C DSM_TypDfp_MeUnCD_SigTst_C DSM_TypDfp_Montr_C DSM_TypDfp_NetMngDeviceA_C DSM_TypDfp_NetMngDeviceB_C DSM_TypDfp_NetMngDeviceC_C DSM_TypDfp_OPSCD_Lamp_C DSM_TypDfp_OPSCD_anain_C DSM_TypDfp_OTSCD_C DSM_TypDfp_OvRMon_C DSM_TypDfp_OvRMonBrk_C DSM_TypDfp_OvRMonSigA_C DSM_TypDfp_OxiCCDTPre_C DSM_TypDfp_PCR_GovDevNeg_C DSM_TypDfp_PCR_GovDevPos_C DSM_TypDfp_PCVCDNoLoad_C DSM_TypDfp_PCVCDSCBat_C DSM_TypDfp_PCVCDSCGnd_C DSM_TypDfp_PCVCD_ADC_C DSM_TypDfp_PCVCD_SigTst_C DSM_TypDfp_PFltAPSens_C DSM_TypDfp_PFltCDPPre_C DSM_TypDfp_PFltCDTempPre_C DSM_TypDfp_PFltChar_C DSM_TypDfp_PFltEngPrt_C DSM_TypDfp_PFltPresDynPlaus_C DSM_TypDfp_PFltPresSens_C DSM_TypDfp_PFltPresSensFrz_C DSM_TypDfp_PFltPresSensHsLn_C DSM_TypDfp_PFltPresSensSot_C DSM_TypDfp_PFltRgnPerm_C DSM_TypDfp_PFltTempDwnStrm_C DSM_TypDfp_PFltTempSens_C DSM_TypDfp_PFltTempUpStrm_C DSM_TypDfp_PFltmSotDiffMax_C DSM_TypDfp_QLTCD_C DSM_TypDfp_RTMMon_C DSM_TypDfp_RailCD_C DSM_TypDfp_RailCDOfsTst_C DSM_TypDfp_RailCD_PMonStrt_C DSM_TypDfp_RailCtlModeMeUnDiag_C DSM_TypDfp_RailCtlModePCVDiag_C DSM_TypDfp_RailMeUn0_C DSM_TypDfp_RailMeUn1_C DSM_TypDfp_RailMeUn2_C DSM_TypDfp_RailMeUn3_C DSM_TypDfp_RailMeUn4_C DSM_TypDfp_RailPCV0_C DSM_TypDfp_RailPCV1_C DSM_TypDfp_RailPCV2_C DSM_TypDfp_RailPCV3_C DSM_TypDfp_RailPCV4_C DSM_TypDfp_RailPCV5_C DSM_TypDfp_SOPTst_C DSM_TypDfp_SSpMon1_C DSM_TypDfp_SSpMon2_C DSM_TypDfp_SSpMon3_C DSM_TypDfp_ShutCD_C DSM_TypDfp_StSysTrqShutOff_C DSM_TypDfp_StrtCD_Actr_C DSM_TypDfp_SysLamp_C DSM_TypDfp_T15CD_C DSM_TypDfp_TGearbx_C DSM_TypDfp_TPUMon_C DSM_TypDfp_TVACD_Max_C DSM_TypDfp_TVACD_Min_C DSM_TypDfp_TVACD_SigNpl_C DSM_TypDfp_TVACD_TVADia1_C DSM_TypDfp_TVACD_TVADia2_C DSM_TypDfp_TVACD_TVADia3_C DSM_TypDfp_VSACD_Max_C DSM_TypDfp_VSACD_Min_C DSM_TypDfp_VSACD_SigNpl_C DSM_TypDfp_VSACD_VSADia1_C DSM_TypDfp_VSACD_VSADia2_C DSM_TypDfp_VSACD_VSADia3_C DSM_TypDfp_VSACD_VSADia4_C DSM_TypDfp_VSSCD1_C DSM_TypDfp_VSSCD2_C DSM_TypDfp_WdCom_C /end DEF_CHARACTERISTIC
/end FUNCTION
/begin FUNCTION dsm_auto_tsf ""
 /begin DEF_CHARACTERISTIC DSM_TsfDfp_Layer_TANS_C DSM_TsfDfp_ACCDSwtin_C DSM_TsfDfp_ACC_PlausTrqDes_C DSM_TsfDfp_ACC_trqInr_C DSM_TsfDfp_ACTrq_C DSM_TsfDfp_ADCMon_C DSM_TsfDfp_AFSCDIdlAdjVal_C DSM_TsfDfp_AFSCDLdAdjVal_C DSM_TsfDfp_AFSCD_AirTempDcyc_C DSM_TsfDfp_AFSCD_PlOffsDrft_C DSM_TsfDfp_AFSCD_PlSetyDrft_C DSM_TsfDfp_AFSCD_SRCAirTemp_C DSM_TsfDfp_AFSCD_SRCBatt_C DSM_TsfDfp_AFSCD_SRCCorrAirm_C DSM_TsfDfp_AFSCD_SRCRawAirm_C DSM_TsfDfp_AFSCD_SRCRefSigPer_C DSM_TsfDfp_AOHtCD_C DSM_TsfDfp_AOHtCD_AOHtDia1_C DSM_TsfDfp_AOHtCD_AOHtDia2_C DSM_TsfDfp_Layer_TUMG_C DSM_TsfDfp_AOHtCD_AOHtDia3_C DSM_TsfDfp_APP1_C DSM_TsfDfp_Layer_GEN_C DSM_TsfDfp_Layer_BSD_C DSM_TsfDfp_APP2_C DSM_TsfDfp_APSCD_C DSM_TsfDfp_ARS_C DSM_TsfDfp_AccPedPlausBrk_C DSM_TsfDfp_AirCtlPlateBreak_C DSM_TsfDfp_AirCtl_GovNegDev_C DSM_TsfDfp_AirCtl_GovNegDev2_C DSM_TsfDfp_AirCtl_GovPosDev_C DSM_TsfDfp_AirCtl_GovPosDev2_C DSM_TsfDfp_AltCD_C DSM_TsfDfp_Layer_QLT_C DSM_TsfDfp_BPACD_BPADia1_C DSM_TsfDfp_Layer_IBS1_C DSM_TsfDfp_Layer_IBS2_C DSM_TsfDfp_Layer_IBS3_C DSM_TsfDfp_Layer_PMBN_C DSM_TsfDfp_Layer_PMBATT_C DSM_TsfDfp_BPACD_BPADia2_C DSM_TsfDfp_BPACD_BPADia3_C DSM_TsfDfp_BPACD_Max_C DSM_TsfDfp_BPACD_Min_C DSM_TsfDfp_BPACD_SigNpl_C DSM_TsfDfp_BPSCD_C DSM_TsfDfp_BattCD_C DSM_TsfDfp_BrkCD_C DSM_TsfDfp_Bss_C DSM_TsfDfp_CBACD_C DSM_TsfDfp_CTSCD_C DSM_TsfDfp_Clg_DynTst_C DSM_TsfDfp_CmbChbMisfire1_C DSM_TsfDfp_CmbChbMisfire2_C DSM_TsfDfp_CmbChbMisfire3_C DSM_TsfDfp_CmbChbMisfire4_C DSM_TsfDfp_CmbChbMisfire5_C DSM_TsfDfp_CmbChbMisfire6_C DSM_TsfDfp_CmbChbMisfireMul_C DSM_TsfDfp_CoVMDCSh_C DSM_TsfDfp_ConvCD_C DSM_TsfDfp_CrCCDMFL_C DSM_TsfDfp_CrCtl_vCrCtl_C DSM_TsfDfp_Dummy1_C DSM_TsfDfp_EATSCD_C DSM_TsfDfp_EBAFCD_C DSM_TsfDfp_EBFCD_C DSM_TsfDfp_EBTSCD_C DSM_TsfDfp_EBTSCD_OvrTemp_C DSM_TsfDfp_EEPCDVarMng_C DSM_TsfDfp_EGPpCD_C DSM_TsfDfp_EGPpCDTPreTrbn_C DSM_TsfDfp_Layer_PMRUHVERL_C DSM_TsfDfp_EGRCD_Max_C DSM_TsfDfp_EGRCD_Min_C DSM_TsfDfp_EGRCD_SigNpl_C DSM_TsfDfp_EGTRgnOilDil_C DSM_TsfDfp_Layer_TOENS_C DSM_TsfDfp_Layer_MANHYDR_C DSM_TsfDfp_Layer_MANLUFT_C DSM_TsfDfp_ETClbETFltInj1_C DSM_TsfDfp_ETClbETFltInj2_C DSM_TsfDfp_ETClbETFltInj3_C DSM_TsfDfp_ETClbETFltInj4_C DSM_TsfDfp_ETClbETFltInj5_C DSM_TsfDfp_ETClbETFltInj6_C DSM_TsfDfp_ETClbInj1_C DSM_TsfDfp_ETClbInj2_C DSM_TsfDfp_ETClbInj3_C DSM_TsfDfp_ETClbInj4_C DSM_TsfDfp_ETClbInj5_C DSM_TsfDfp_ETClbInj6_C DSM_TsfDfp_EngMCaS1_C DSM_TsfDfp_EngMCrS1_C DSM_TsfDfp_EngMOfsCaSCrS_C DSM_TsfDfp_EngMntCtl1_Dia1_C DSM_TsfDfp_EngMntCtl1_Dia2_C DSM_TsfDfp_EngMntCtl1_Dia3_C DSM_TsfDfp_EngMntCtl1_Max_C DSM_TsfDfp_EngMntCtl1_Min_C DSM_TsfDfp_EngMntCtl1_SigNpl_C DSM_TsfDfp_EngMntCtlCD_C DSM_TsfDfp_EngMntCtl_Dia1_C DSM_TsfDfp_EngMntCtl_Dia2_C DSM_TsfDfp_EngMntCtl_Dia3_C DSM_TsfDfp_EngMntCtl_Max_C DSM_TsfDfp_EngMntCtl_Min_C DSM_TsfDfp_EngMntCtl_SigNpl_C DSM_TsfDfp_EngPrtFWODet_C DSM_TsfDfp_FBCqDvt_C DSM_TsfDfp_FMTC_NonMonotonMap_C DSM_TsfDfp_FTSCD_C DSM_TsfDfp_FanCD_C DSM_TsfDfp_FanCD_FanCtlr1_C DSM_TsfDfp_FanCD_FanCtlr2_C DSM_TsfDfp_FanCD_FanCtlr3_C DSM_TsfDfp_FlFCD_C DSM_TsfDfp_FlMngSmkDefect_C DSM_TsfDfp_FrmMngBOS_RESET_C DSM_TsfDfp_FrmMngBOS_RESET_2_C DSM_TsfDfp_FrmMngDMANFAFS_C DSM_TsfDfp_FrmMngDRMANFSSG_C DSM_TsfDfp_FrmMngGEARBX_DATA_C DSM_TsfDfp_FrmMngGEARBX_DATA2_C DSM_TsfDfp_FrmMngHEAT_AC_C DSM_TsfDfp_FrmMngLENKRADWINKEL_C DSM_TsfDfp_FrmMngMILEAGE_RANGE_C DSM_TsfDfp_FrmMngOPCRCTLACC_C DSM_TsfDfp_FrmMngPRGG_CCTR_C DSM_TsfDfp_FrmMngPWRMNG_LOADV_C DSM_TsfDfp_FrmMngParkConsumer_C DSM_TsfDfp_FrmMngRQSTGEFAN_C DSM_TsfDfp_FrmMngSSGErr_C DSM_TsfDfp_FrmMngSSGShOff_C DSM_TsfDfp_FrmMngSTAT_ANH_C DSM_TsfDfp_FrmMngSTAT_ARS_C DSM_TsfDfp_FrmMngSTAT_DSC_C DSM_TsfDfp_FrmMngSTAT_EKP_C DSM_TsfDfp_FrmMngSTAT_KOMBI_C DSM_TsfDfp_FrmMngSTAT_SITZ_C DSM_TsfDfp_FrmMngStOBDGbxMilOf_C DSM_TsfDfp_FrmMngStOBDGbxMilOn_C DSM_TsfDfp_FrmMngTEMPRELTIME_C DSM_TsfDfp_FrmMngTERMINAL_C DSM_TsfDfp_FrmMngTIME_DATE_C DSM_TsfDfp_FrmMngTORQUE_DSC_C DSM_TsfDfp_FrmMngTORQUE_GEARBX_C DSM_TsfDfp_FrmMngTrq_ReqACC_C DSM_TsfDfp_FrmMngVEH_MOD_C DSM_TsfDfp_FrmMngVELOCITY_C DSM_TsfDfp_FrmMngWHEEL_SPEED_C DSM_TsfDfp_FrmMngstCurr_C DSM_TsfDfp_FrmMngswtPSPOff_C DSM_TsfDfp_GearbxIncMax_C DSM_TsfDfp_GlwCD_C DSM_TsfDfp_GlwCDGlwCirc1_C DSM_TsfDfp_GlwCDGlwCirc2_C DSM_TsfDfp_GlwCDGlwCirc3_C DSM_TsfDfp_GlwCDGlwCirc4_C DSM_TsfDfp_GlwCDGlwCirc5_C DSM_TsfDfp_GlwCDGlwCirc6_C DSM_TsfDfp_GlwCDGlwCirc7_C DSM_TsfDfp_GlwCDGlwCirc8_C DSM_TsfDfp_GlwCtl_C DSM_TsfDfp_HWEMonCom_C DSM_TsfDfp_HWEMonEEPROM_C DSM_TsfDfp_HWEMonRcyLocked_C DSM_TsfDfp_HWEMonRcySuppressed_C DSM_TsfDfp_HWEMonRcyVisible_C DSM_TsfDfp_HWEMonUMaxSupply_C DSM_TsfDfp_HWEMonUMinSupply_C DSM_TsfDfp_IATSCD_C DSM_TsfDfp_IATSCD_CATS_C DSM_TsfDfp_ImmCtlImmCD_C DSM_TsfDfp_ImmCtlImmEep_C DSM_TsfDfp_ImmCtlMpl_C DSM_TsfDfp_IndSys1_C DSM_TsfDfp_IndSys2_C DSM_TsfDfp_InjCrv_InjLim_C DSM_TsfDfp_InjCtlAdjQnt_C DSM_TsfDfp_InjCtlDrift_C DSM_TsfDfp_InjVCDActrChrg_C DSM_TsfDfp_InjVCDActrEnrg1_C DSM_TsfDfp_InjVCDActrEnrg2_C DSM_TsfDfp_InjVCDActrEnrg3_C DSM_TsfDfp_InjVCDActrEnrg4_C DSM_TsfDfp_InjVCDActrEnrg5_C DSM_TsfDfp_InjVCDActrEnrg6_C DSM_TsfDfp_InjVCDActrEnrg7_C DSM_TsfDfp_InjVCDActrEnrg8_C DSM_TsfDfp_InjVCDActrVolt_C DSM_TsfDfp_InjVCDClsBank1_C DSM_TsfDfp_InjVCDClsBank2_C DSM_TsfDfp_InjVCDMonCab_C DSM_TsfDfp_InjVCDMonSwt_C DSM_TsfDfp_InjVCDShOffDCDC_C DSM_TsfDfp_InjVCDUBuf_C DSM_TsfDfp_InjVCD_CY370Ampl_C DSM_TsfDfp_InjVlvBnk1A_C DSM_TsfDfp_InjVlvBnk1B_C DSM_TsfDfp_InjVlvBnk2A_C DSM_TsfDfp_InjVlvBnk2B_C DSM_TsfDfp_InjVlvChipA_C DSM_TsfDfp_InjVlvChipB_C DSM_TsfDfp_InjVlvCyl1A_C DSM_TsfDfp_InjVlvCyl1B_C DSM_TsfDfp_InjVlvCyl1C_C DSM_TsfDfp_InjVlvCyl2A_C DSM_TsfDfp_InjVlvCyl2B_C DSM_TsfDfp_InjVlvCyl2C_C DSM_TsfDfp_InjVlvCyl3A_C DSM_TsfDfp_InjVlvCyl3B_C DSM_TsfDfp_InjVlvCyl3C_C DSM_TsfDfp_InjVlvCyl4A_C DSM_TsfDfp_InjVlvCyl4B_C DSM_TsfDfp_InjVlvCyl4C_C DSM_TsfDfp_InjVlvCyl5A_C DSM_TsfDfp_InjVlvCyl5B_C DSM_TsfDfp_InjVlvCyl5C_C DSM_TsfDfp_InjVlvCyl6A_C DSM_TsfDfp_InjVlvCyl6B_C DSM_TsfDfp_InjVlvCyl6C_C DSM_TsfDfp_InjVlvCyl7A_C DSM_TsfDfp_InjVlvCyl7B_C DSM_TsfDfp_InjVlvCyl7C_C DSM_TsfDfp_InjVlvCyl8A_C DSM_TsfDfp_InjVlvCyl8B_C DSM_TsfDfp_InjVlvCyl8C_C DSM_TsfDfp_InjVlvNVC1_C DSM_TsfDfp_InjVlvNVC2_C DSM_TsfDfp_InjVlvNVC3_C DSM_TsfDfp_InjVlvNVC4_C DSM_TsfDfp_InjVlvNVC5_C DSM_TsfDfp_InjVlvNVC6_C DSM_TsfDfp_InjVlvNVC7_C DSM_TsfDfp_InjVlvNVC8_C DSM_TsfDfp_LPACD_Max_C DSM_TsfDfp_LPACD_Min_C DSM_TsfDfp_LPACD_SigNpl_C DSM_TsfDfp_LSUCDCircNernst0_C DSM_TsfDfp_LSUCDCircPumpCur0_C DSM_TsfDfp_LSUCDCircVirtGnd0_C DSM_TsfDfp_LSUCDHeater0_C DSM_TsfDfp_LSUCDHtCoup0_C DSM_TsfDfp_LSUCDO20_C DSM_TsfDfp_LSUCDO2Clb0_C DSM_TsfDfp_LSUCDRiClb0_C DSM_TsfDfp_LSUCDSPI0_C DSM_TsfDfp_LSUCDSPIBattLow0_C DSM_TsfDfp_LSUCDWireIP0_C DSM_TsfDfp_LSUCtlRiExc0_C DSM_TsfDfp_LSUMon1Sens_C DSM_TsfDfp_LSUMon2Sens_C DSM_TsfDfp_LubCD_C DSM_TsfDfp_MIL_C DSM_TsfDfp_MRlyCD_C DSM_TsfDfp_MSidCD_Comm_C DSM_TsfDfp_MSidCD_Pin_C DSM_TsfDfp_MSidCD_Sel_INI_C DSM_TsfDfp_MSidCD_Select_C DSM_TsfDfp_MeUnCDNoLoad_C DSM_TsfDfp_MeUnCDSCBat_C DSM_TsfDfp_MeUnCDSCGnd_C DSM_TsfDfp_MeUnCD_ADC_C DSM_TsfDfp_MeUnCD_SigTst_C DSM_TsfDfp_Montr_C DSM_TsfDfp_NetMngDeviceA_C DSM_TsfDfp_NetMngDeviceB_C DSM_TsfDfp_NetMngDeviceC_C DSM_TsfDfp_OPSCD_Lamp_C DSM_TsfDfp_OPSCD_anain_C DSM_TsfDfp_OTSCD_C DSM_TsfDfp_OvRMon_C DSM_TsfDfp_OvRMonBrk_C DSM_TsfDfp_OvRMonSigA_C DSM_TsfDfp_OxiCCDTPre_C DSM_TsfDfp_PCR_GovDevNeg_C DSM_TsfDfp_PCR_GovDevPos_C DSM_TsfDfp_PCVCDNoLoad_C DSM_TsfDfp_PCVCDSCBat_C DSM_TsfDfp_PCVCDSCGnd_C DSM_TsfDfp_PCVCD_ADC_C DSM_TsfDfp_PCVCD_SigTst_C DSM_TsfDfp_PFltAPSens_C DSM_TsfDfp_PFltCDPPre_C DSM_TsfDfp_PFltCDTempPre_C DSM_TsfDfp_PFltChar_C DSM_TsfDfp_PFltEngPrt_C DSM_TsfDfp_PFltPresDynPlaus_C DSM_TsfDfp_PFltPresSens_C DSM_TsfDfp_PFltPresSensFrz_C DSM_TsfDfp_PFltPresSensHsLn_C DSM_TsfDfp_PFltPresSensSot_C DSM_TsfDfp_PFltRgnPerm_C DSM_TsfDfp_PFltTempDwnStrm_C DSM_TsfDfp_PFltTempSens_C DSM_TsfDfp_PFltTempUpStrm_C DSM_TsfDfp_PFltmSotDiffMax_C DSM_TsfDfp_QLTCD_C DSM_TsfDfp_RTMMon_C DSM_TsfDfp_RailCD_C DSM_TsfDfp_RailCDOfsTst_C DSM_TsfDfp_RailCD_PMonStrt_C DSM_TsfDfp_RailCtlModeMeUnDiag_C DSM_TsfDfp_RailCtlModePCVDiag_C DSM_TsfDfp_RailMeUn0_C DSM_TsfDfp_RailMeUn1_C DSM_TsfDfp_RailMeUn2_C DSM_TsfDfp_RailMeUn3_C DSM_TsfDfp_RailMeUn4_C DSM_TsfDfp_RailPCV0_C DSM_TsfDfp_RailPCV1_C DSM_TsfDfp_RailPCV2_C DSM_TsfDfp_RailPCV3_C DSM_TsfDfp_RailPCV4_C DSM_TsfDfp_RailPCV5_C DSM_TsfDfp_SOPTst_C DSM_TsfDfp_SSpMon1_C DSM_TsfDfp_SSpMon2_C DSM_TsfDfp_SSpMon3_C DSM_TsfDfp_ShutCD_C DSM_TsfDfp_StSysTrqShutOff_C DSM_TsfDfp_StrtCD_Actr_C DSM_TsfDfp_SysLamp_C DSM_TsfDfp_T15CD_C DSM_TsfDfp_TGearbx_C DSM_TsfDfp_TPUMon_C DSM_TsfDfp_TVACD_Max_C DSM_TsfDfp_TVACD_Min_C DSM_TsfDfp_TVACD_SigNpl_C DSM_TsfDfp_TVACD_TVADia1_C DSM_TsfDfp_TVACD_TVADia2_C DSM_TsfDfp_TVACD_TVADia3_C DSM_TsfDfp_VSACD_Max_C DSM_TsfDfp_VSACD_Min_C DSM_TsfDfp_VSACD_SigNpl_C DSM_TsfDfp_VSACD_VSADia1_C DSM_TsfDfp_VSACD_VSADia2_C DSM_TsfDfp_VSACD_VSADia3_C DSM_TsfDfp_VSACD_VSADia4_C DSM_TsfDfp_VSSCD1_C DSM_TsfDfp_VSSCD2_C DSM_TsfDfp_WdCom_C /end DEF_CHARACTERISTIC
/end FUNCTION
/begin FUNCTION dsm_msg ""
 /begin OUT_MEASUREMENT DFPM_stFCMChkCause DSM_ctDfctPath DSM_ctFcmEntry DSM_ctOBDPath DSM_ctOBDValidPath DSM_ctTstPath DSM_ctWUC DSM_lDist DSM_stCycles DSM_stECUMasterSlave DSM_stInhDelay DSM_stMIL DSM_stPID41 DSM_stRdyAB DSM_stRdyCD DSM_stRdyCheckEnable DSM_stSysLamp /end OUT_MEASUREMENT
/end FUNCTION
/begin FUNCTION dsm_rdy ""
 /begin DEF_CHARACTERISTIC DSM_RdyABForceMsk_C DSM_RdyCDForceMsk_C DSM_RdyOnMilEnable_C /end DEF_CHARACTERISTIC
/end FUNCTION
/begin FUNCTION dsm_rdy_msg "" /end FUNCTION
/begin FUNCTION dsm_rdy_uic ""
 /begin OUT_MEASUREMENT DSM_ctRdyActCyc_mp DSM_ctRdyCycCat_mp DSM_ctRdyCycCompr_mp DSM_ctRdyCycEGR_mp DSM_ctRdyCycFuel_mp DSM_ctRdyCycMisf_mp DSM_ctRdyCycOxSenHt_mp DSM_ctRdyCycOxSen_mp DSM_ctRdyLimCat_mp DSM_ctRdyLimCompr_mp DSM_ctRdyLimEGR_mp DSM_ctRdyLimFuel_mp DSM_ctRdyLimMisf_mp DSM_ctRdyLimOxSenHt_mp DSM_ctRdyLimOxSen_mp DSM_ctRdyPathsCat_mp DSM_ctRdyPathsCompr_mp DSM_ctRdyPathsEGR_mp DSM_ctRdyPathsFuel_mp DSM_ctRdyPathsMisf_mp DSM_ctRdyPathsOxSenHt_mp DSM_ctRdyPathsOxSen_mp DSM_ctRdyTstCat_mp DSM_ctRdyTstCompr_mp DSM_ctRdyTstEGR_mp DSM_ctRdyTstFuel_mp DSM_ctRdyTstMisf_mp DSM_ctRdyTstOxSenHt_mp DSM_ctRdyTstOxSen_mp /end OUT_MEASUREMENT
/end FUNCTION
/begin FUNCTION dsm_sy_conf "" /end FUNCTION
/begin FUNCTION dsm_uic ""
 /begin OUT_MEASUREMENT DfpErrCol_mp DfpZyfCol_mp DSCHED_numDefDfpArray_mp DSCHED_numOkDfpArray_mp DSM_ctFCMEntrySize_mp DSM_ctPath_mp DSM_tiDCDelay_mp FidCol_mp /end OUT_MEASUREMENT
/end FUNCTION
/begin FUNCTION dummy "" /end FUNCTION
/begin FUNCTION dummy_proj_msg ""
 /begin OUT_MEASUREMENT EGT_tInrBiTrb EGT_tInrDesCorBiTrb EGT_tInrDesInTempGvnr EGT_tOutrDesInTempGvnr FrmMng_stSTAT_HDC PFlt_tOxiPst PFlt_tTurbPre /end OUT_MEASUREMENT
/end FUNCTION
/begin FUNCTION dummy_uic "" /begin OUT_MEASUREMENT Uhwe_ctAtomicLvl_mp /end OUT_MEASUREMENT /end FUNCTION
/begin FUNCTION eatscd "Umgebungslufttemperaturerfassung"
 /begin DEF_CHARACTERISTIC EATSCD_uSRCMin_C EATSCD_uSRCMax_C EATSCD_tLin_CUR EATSCD_DebSigDef_C EATSCD_DebSigOk_C EATSCD_DebSRCHighDef_C EATSCD_DebSRCHighOk_C EATSCD_DebSRCLowDef_C EATSCD_DebSRCLowOk_C EATSCD_dtRmpSubs_C EATSCD_dtRmpSubsUp_C EATSCD_dtRmpSubsDwn_C EATSCD_numAdc_C EATSCD_dtRmpSlpUp_C EATSCD_dtRmpSlpDwn_C EATSCD_swtSensImpl_C EATSCD_swtSigVal_C EATSCD_tAirSubs_C EATSCD_stSensIDWord_C EATSCD_tDfl_C /end DEF_CHARACTERISTIC
 /begin IN_MEASUREMENT EATSCD_uRaw /end IN_MEASUREMENT
/end FUNCTION
/begin FUNCTION eatscd_msg "" /begin OUT_MEASUREMENT EATSCD_swtSig EATSCD_tAir EATSCD_tAirLin EATSCD_uRaw /end OUT_MEASUREMENT /end FUNCTION
/begin FUNCTION eatscd_uic "" /end FUNCTION
/begin COMPU_METHOD DfpName "Verbale Umrechnung für Fehlerpfadnamen" TAB_VERB "%6.3" "-" COMPU_TAB_REF DfpName /end COMPU_METHOD
/begin COMPU_VTAB DfpName "Verbale Umrechnung für Fehlerpfadnamen" TAB_VERB 345 0 "Dfp_unused" 1 "Dfp_Layer_TANS" 2 "Dfp_ACCDSwtin" 3 "Dfp_ACC_PlausTrqDes" 4 "Dfp_ACC_trqInr" 5 "Dfp_ACTrq" 6 "Dfp_ADCMon" 7 "Dfp_AFSCDIdlAdjVal" 8 "Dfp_AFSCDLdAdjVal" 9 "Dfp_AFSCD_AirTempDcyc" 10 "Dfp_AFSCD_PlOffsDrft" 11 "Dfp_AFSCD_PlSetyDrft" 12 "Dfp_AFSCD_SRCAirTemp" 13 "Dfp_AFSCD_SRCBatt" 14 "Dfp_AFSCD_SRCCorrAirm" 15 "Dfp_AFSCD_SRCRawAirm" 16 "Dfp_AFSCD_SRCRefSigPer" 17 "Dfp_AOHtCD" 18 "Dfp_AOHtCD_AOHtDia1" 19 "Dfp_AOHtCD_AOHtDia2" 20 "Dfp_Layer_TUMG" 21 "Dfp_AOHtCD_AOHtDia3" 22 "Dfp_APP1" 23 "Dfp_Layer_GEN" 24 "Dfp_Layer_BSD" 25 "Dfp_APP2" 26 "Dfp_APSCD" 27 "Dfp_ARS" 28 "Dfp_AccPedPlausBrk" 29 "Dfp_AirCtlPlateBreak" 30 "Dfp_AirCtl_GovNegDev" 31 "Dfp_AirCtl_GovNegDev2" 32 "Dfp_AirCtl_GovPosDev" 33 "Dfp_AirCtl_GovPosDev2" 34 "Dfp_AltCD" 35 "Dfp_Layer_QLT" 36 "Dfp_BPACD_BPADia1" 37 "Dfp_Layer_IBS1" 38 "Dfp_Layer_IBS2" 39 "Dfp_Layer_IBS3" 40 "Dfp_Layer_PMBN" 41 "Dfp_Layer_PMBATT" 42 "Dfp_BPACD_BPADia2" 43 "Dfp_BPACD_BPADia3" 44 "Dfp_BPACD_Max" 45 "Dfp_BPACD_Min" 46 "Dfp_BPACD_SigNpl" 47 "Dfp_BPSCD" 48 "Dfp_BattCD" 49 "Dfp_BrkCD" 50 "Dfp_Bss" 51 "Dfp_CBACD" 52 "Dfp_CTSCD" 53 "Dfp_Clg_DynTst" 54 "Dfp_CmbChbMisfire1" 55 "Dfp_CmbChbMisfire2" 56 "Dfp_CmbChbMisfire3" 57 "Dfp_CmbChbMisfire4" 58 "Dfp_CmbChbMisfire5" 59 "Dfp_CmbChbMisfire6" 60 "Dfp_CmbChbMisfireMul" 61 "Dfp_CoVMDCSh" 62 "Dfp_ConvCD" 63 "Dfp_CrCCDMFL" 64 "Dfp_CrCtl_vCrCtl" 65 "Dfp_Dummy1" 66 "Dfp_EATSCD" 67 "Dfp_EBAFCD" 68 "Dfp_EBFCD" 69 "Dfp_EBTSCD" 70 "Dfp_EBTSCD_OvrTemp" 71 "Dfp_EEPCDVarMng" 72 "Dfp_EGPpCD" 73 "Dfp_EGPpCDTPreTrbn" 74 "Dfp_Layer_PMRUHVERL" 75 "Dfp_EGRCD_Max" 76 "Dfp_EGRCD_Min" 77 "Dfp_EGRCD_SigNpl" 78 "Dfp_EGTRgnOilDil" 79 "Dfp_Layer_TOENS" 80 "Dfp_Layer_MANHYDR" 81 "Dfp_Layer_MANLUFT" 82 "Dfp_ETClbETFltInj1" 83 "Dfp_ETClbETFltInj2" 84 "Dfp_ETClbETFltInj3" 85 "Dfp_ETClbETFltInj4" 86 "Dfp_ETClbETFltInj5" 87 "Dfp_ETClbETFltInj6" 88 "Dfp_ETClbInj1" 89 "Dfp_ETClbInj2" 90 "Dfp_ETClbInj3" 91 "Dfp_ETClbInj4" 92 "Dfp_ETClbInj5" 93 "Dfp_ETClbInj6" 94 "Dfp_EngMCaS1" 95 "Dfp_EngMCrS1" 96 "Dfp_EngMOfsCaSCrS" 97 "Dfp_EngMntCtl1_Dia1" 98 "Dfp_EngMntCtl1_Dia2" 99 "Dfp_EngMntCtl1_Dia3" 100 "Dfp_EngMntCtl1_Max" 101 "Dfp_EngMntCtl1_Min" 102 "Dfp_EngMntCtl1_SigNpl" 103 "Dfp_EngMntCtlCD" 104 "Dfp_EngMntCtl_Dia1" 105 "Dfp_EngMntCtl_Dia2" 106 "Dfp_EngMntCtl_Dia3" 107 "Dfp_EngMntCtl_Max" 108 "Dfp_EngMntCtl_Min" 109 "Dfp_EngMntCtl_SigNpl" 110 "Dfp_EngPrtFWODet" 111 "Dfp_FBCqDvt" 112 "Dfp_FMTC_NonMonotonMap" 113 "Dfp_FTSCD" 114 "Dfp_FanCD" 115 "Dfp_FanCD_FanCtlr1" 116 "Dfp_FanCD_FanCtlr2" 117 "Dfp_FanCD_FanCtlr3" 118 "Dfp_FlFCD" 119 "Dfp_FlMngSmkDefect" 120 "Dfp_FrmMngBOS_RESET" 121 "Dfp_FrmMngBOS_RESET_2" 122 "Dfp_FrmMngDMANFAFS" 123 "Dfp_FrmMngDRMANFSSG" 124 "Dfp_FrmMngGEARBX_DATA" 125 "Dfp_FrmMngGEARBX_DATA2" 126 "Dfp_FrmMngHEAT_AC" 127 "Dfp_FrmMngLENKRADWINKEL" 128 "Dfp_FrmMngMILEAGE_RANGE" 129 "Dfp_FrmMngOPCRCTLACC" 130 "Dfp_FrmMngPRGG_CCTR" 131 "Dfp_FrmMngPWRMNG_LOADV" 132 "Dfp_FrmMngParkConsumer" 133 "Dfp_FrmMngRQSTGEFAN" 134 "Dfp_FrmMngSSGErr" 135 "Dfp_FrmMngSSGShOff" 136 "Dfp_FrmMngSTAT_ANH" 137 "Dfp_FrmMngSTAT_ARS" 138 "Dfp_FrmMngSTAT_DSC" 139 "Dfp_FrmMngSTAT_EKP" 140 "Dfp_FrmMngSTAT_KOMBI" 141 "Dfp_FrmMngSTAT_SITZ" 142 "Dfp_FrmMngStOBDGbxMilOf" 143 "Dfp_FrmMngStOBDGbxMilOn" 144 "Dfp_FrmMngTEMPRELTIME" 145 "Dfp_FrmMngTERMINAL" 146 "Dfp_FrmMngTIME_DATE" 147 "Dfp_FrmMngTORQUE_DSC" 148 "Dfp_FrmMngTORQUE_GEARBX" 149 "Dfp_FrmMngTrq_ReqACC" 150 "Dfp_FrmMngVEH_MOD" 151 "Dfp_FrmMngVELOCITY" 152 "Dfp_FrmMngWHEEL_SPEED" 153 "Dfp_FrmMngstCurr" 154 "Dfp_FrmMngswtPSPOff" 155 "Dfp_GearbxIncMax" 156 "Dfp_GlwCD" 157 "Dfp_GlwCDGlwCirc1" 158 "Dfp_GlwCDGlwCirc2" 159 "Dfp_GlwCDGlwCirc3" 160 "Dfp_GlwCDGlwCirc4" 161 "Dfp_GlwCDGlwCirc5" 162 "Dfp_GlwCDGlwCirc6" 163 "Dfp_GlwCDGlwCirc7" 164 "Dfp_GlwCDGlwCirc8" 165 "Dfp_GlwCtl" 166 "Dfp_HWEMonCom" 167 "Dfp_HWEMonEEPROM" 168 "Dfp_HWEMonRcyLocked" 169 "Dfp_HWEMonRcySuppressed" 170 "Dfp_HWEMonRcyVisible" 171 "Dfp_HWEMonUMaxSupply" 172 "Dfp_HWEMonUMinSupply" 173 "Dfp_IATSCD" 174 "Dfp_IATSCD_CATS" 175 "Dfp_ImmCtlImmCD" 176 "Dfp_ImmCtlImmEep" 177 "Dfp_ImmCtlMpl" 178 "Dfp_IndSys1" 179 "Dfp_IndSys2" 180 "Dfp_InjCrv_InjLim" 181 "Dfp_InjCtlAdjQnt" 182 "Dfp_InjCtlDrift" 183 "Dfp_InjVCDActrChrg" 184 "Dfp_InjVCDActrEnrg1" 185 "Dfp_InjVCDActrEnrg2" 186 "Dfp_InjVCDActrEnrg3" 187 "Dfp_InjVCDActrEnrg4" 188 "Dfp_InjVCDActrEnrg5" 189 "Dfp_InjVCDActrEnrg6" 190 "Dfp_InjVCDActrEnrg7" 191 "Dfp_InjVCDActrEnrg8" 192 "Dfp_InjVCDActrVolt" 193 "Dfp_InjVCDClsBank1" 194 "Dfp_InjVCDClsBank2" 195 "Dfp_InjVCDMonCab" 196 "Dfp_InjVCDMonSwt" 197 "Dfp_InjVCDShOffDCDC" 198 "Dfp_InjVCDUBuf" 199 "Dfp_InjVCD_CY370Ampl" 200 "Dfp_InjVlvBnk1A" 201 "Dfp_InjVlvBnk1B" 202 "Dfp_InjVlvBnk2A" 203 "Dfp_InjVlvBnk2B" 204 "Dfp_InjVlvChipA" 205 "Dfp_InjVlvChipB" 206 "Dfp_InjVlvCyl1A" 207 "Dfp_InjVlvCyl1B" 208 "Dfp_InjVlvCyl1C" 209 "Dfp_InjVlvCyl2A" 210 "Dfp_InjVlvCyl2B" 211 "Dfp_InjVlvCyl2C" 212 "Dfp_InjVlvCyl3A" 213 "Dfp_InjVlvCyl3B" 214 "Dfp_InjVlvCyl3C" 215 "Dfp_InjVlvCyl4A" 216 "Dfp_InjVlvCyl4B" 217 "Dfp_InjVlvCyl4C" 218 "Dfp_InjVlvCyl5A" 219 "Dfp_InjVlvCyl5B" 220 "Dfp_InjVlvCyl5C" 221 "Dfp_InjVlvCyl6A" 222 "Dfp_InjVlvCyl6B" 223 "Dfp_InjVlvCyl6C" 224 "Dfp_InjVlvCyl7A" 225 "Dfp_InjVlvCyl7B" 226 "Dfp_InjVlvCyl7C" 227 "Dfp_InjVlvCyl8A" 228 "Dfp_InjVlvCyl8B" 229 "Dfp_InjVlvCyl8C" 230 "Dfp_InjVlvNVC1" 231 "Dfp_InjVlvNVC2" 232 "Dfp_InjVlvNVC3" 233 "Dfp_InjVlvNVC4" 234 "Dfp_InjVlvNVC5" 235 "Dfp_InjVlvNVC6" 236 "Dfp_InjVlvNVC7" 237 "Dfp_InjVlvNVC8" 238 "Dfp_LPACD_Max" 239 "Dfp_LPACD_Min" 240 "Dfp_LPACD_SigNpl" 241 "Dfp_LSUCDCircNernst0" 242 "Dfp_LSUCDCircPumpCur0" 243 "Dfp_LSUCDCircVirtGnd0" 244 "Dfp_LSUCDHeater0" 245 "Dfp_LSUCDHtCoup0" 246 "Dfp_LSUCDO20" 247 "Dfp_LSUCDO2Clb0" 248 "Dfp_LSUCDRiClb0" 249 "Dfp_LSUCDSPI0" 250 "Dfp_LSUCDSPIBattLow0" 251 "Dfp_LSUCDWireIP0" 252 "Dfp_LSUCtlRiExc0" 253 "Dfp_LSUMon1Sens" 254 "Dfp_LSUMon2Sens" 255 "Dfp_LubCD" 256 "Dfp_MIL" 257 "Dfp_MRlyCD" 258 "Dfp_MSidCD_Comm" 259 "Dfp_MSidCD_Pin" 260 "Dfp_MSidCD_Sel_INI" 261 "Dfp_MSidCD_Select" 262 "Dfp_MeUnCDNoLoad" 263 "Dfp_MeUnCDSCBat" 264 "Dfp_MeUnCDSCGnd" 265 "Dfp_MeUnCD_ADC" 266 "Dfp_MeUnCD_SigTst" 267 "Dfp_Montr" 268 "Dfp_NetMngDeviceA" 269 "Dfp_NetMngDeviceB" 270 "Dfp_NetMngDeviceC" 271 "Dfp_OPSCD_Lamp" 272 "Dfp_OPSCD_anain" 273 "Dfp_OTSCD" 274 "Dfp_OvRMon" 275 "Dfp_OvRMonBrk" 276 "Dfp_OvRMonSigA" 277 "Dfp_OxiCCDTPre" 278 "Dfp_PCR_GovDevNeg" 279 "Dfp_PCR_GovDevPos" 280 "Dfp_PCVCDNoLoad" 281 "Dfp_PCVCDSCBat" 282 "Dfp_PCVCDSCGnd" 283 "Dfp_PCVCD_ADC" 284 "Dfp_PCVCD_SigTst" 285 "Dfp_PFltAPSens" 286 "Dfp_PFltCDPPre" 287 "Dfp_PFltCDTempPre" 288 "Dfp_PFltChar" 289 "Dfp_PFltEngPrt" 290 "Dfp_PFltPresDynPlaus" 291 "Dfp_PFltPresSens" 292 "Dfp_PFltPresSensFrz" 293 "Dfp_PFltPresSensHsLn" 294 "Dfp_PFltPresSensSot" 295 "Dfp_PFltRgnPerm" 296 "Dfp_PFltTempDwnStrm" 297 "Dfp_PFltTempSens" 298 "Dfp_PFltTempUpStrm" 299 "Dfp_PFltmSotDiffMax" 300 "Dfp_QLTCD" 301 "Dfp_RTMMon" 302 "Dfp_RailCD" 303 "Dfp_RailCDOfsTst" 304 "Dfp_RailCD_PMonStrt" 305 "Dfp_RailCtlModeMeUnDiag" 306 "Dfp_RailCtlModePCVDiag" 307 "Dfp_RailMeUn0" 308 "Dfp_RailMeUn1" 309 "Dfp_RailMeUn2" 310 "Dfp_RailMeUn3" 311 "Dfp_RailMeUn4" 312 "Dfp_RailPCV0" 313 "Dfp_RailPCV1" 314 "Dfp_RailPCV2" 315 "Dfp_RailPCV3" 316 "Dfp_RailPCV4" 317 "Dfp_RailPCV5" 318 "Dfp_SOPTst" 319 "Dfp_SSpMon1" 320 "Dfp_SSpMon2" 321 "Dfp_SSpMon3" 322 "Dfp_ShutCD" 323 "Dfp_StSysTrqShutOff" 324 "Dfp_StrtCD_Actr" 325 "Dfp_SysLamp" 326 "Dfp_T15CD" 327 "Dfp_TGearbx" 328 "Dfp_TPUMon" 329 "Dfp_TVACD_Max" 330 "Dfp_TVACD_Min" 331 "Dfp_TVACD_SigNpl" 332 "Dfp_TVACD_TVADia1" 333 "Dfp_TVACD_TVADia2" 334 "Dfp_TVACD_TVADia3" 335 "Dfp_VSACD_Max" 336 "Dfp_VSACD_Min" 337 "Dfp_VSACD_SigNpl" 338 "Dfp_VSACD_VSADia1" 339 "Dfp_VSACD_VSADia2" 340 "Dfp_VSACD_VSADia3" 341 "Dfp_VSACD_VSADia4" 342 "Dfp_VSSCD1" 343 "Dfp_VSSCD2" 344 "Dfp_WdCom" /end COMPU_VTAB
/begin COMPU_METHOD FCMChkCause "Verbale Umrechnung für Message für DSM internen gebrauch (unterstützung bei DSM problemen)" TAB_VERB "%6.3" "-" COMPU_TAB_REF FCMChkCause /end COMPU_METHOD
/begin COMPU_VTAB FCMChkCause "Verbale Umrechnung für Message für DSM internen gebrauch (unterstützung bei DSM problemen)" TAB_VERB 15 1 "fcmEnd npl: fcmEnd > FCM_TAB_SIZE" 2 "Erf and Typ npl" 3 "fcmEnd npl: line == fcmEnd" 4 "Mem set but no entry" 5 "No Mem set but entry" 6 "Mem npl class blocked" 7 "class npl" 8 "Mil npl 1" 9 "Mil npl 2" 10 "Scatt npl" 11 "Flc npl" 12 "Hlc npl" 13 "Fcm blocked" 14 "complement npl" 15 "dpfToClear are blocked" /end COMPU_VTAB
/begin COMPU_METHOD NumPinAdc "verbale Umrechnung für ADC Signale" TAB_VERB "%6.3" "-" COMPU_TAB_REF NumPinAdc /end COMPU_METHOD
/begin COMPU_VTAB NumPinAdc "verbale Umrechnung für ADC Signale" TAB_VERB 45 0 "Water_Temperature_Sensor_182" 1 "Intake_Air_Temperature_Sensor_157" 2 "Charge_Air_Temperature_Sensor_183" 3 "Exhaust_Temperature_Sensor_2_134" 4 "Exhaust_Temperature_Sensor_1_158" 5 "1st_APP_Sensor_252" 6 "2nd_APP_Sensor_239" 7 "ADC_REF" 8 "Boost_Pressure_Sensor_154" 9 "Atmospheric_Pressure_Sensor" 10 "Battery_Voltage_Sensor" 11 "Rail_Pressure_Sensor_156" 12 "Rail_Pressure_Peak_Value_156" 13 "Booster_Voltage_Sensor" 14 "Current_MeUn_Sensor" 15 "Current_PCV_Sensor" 16 "Voltage_Bank_1" 17 "Voltage_Bank_2" 18 "Pressure_Upstream_Particle_Filter_159" 19 "Engine_Oil_Pressure_110" 20 "Temperature_ECU_PCB" 21 "Voltage_Lambda_Ua" 22 "Voltage_Lambda_Ri" 23 "ADC_DUMMY_A_NOT_USED" 24 "ADC_DUMMY_NOT_USED" 25 "Charge_Actuator_Event_0" 26 "Voltage_Piezo_Actuator_Bank_2_Event_0" 27 "Voltage_Piezo_Actuator_Bank_1_Event_0" 28 "Charge_Actuator_Event_1" 29 "Voltage_Piezo_Actuator_Bank_2_Event_1" 30 "Voltage_Piezo_Actuator_Bank_1_Event_1" 31 "Charge_Actuator_Event_2" 32 "Voltage_Piezo_Actuator_Bank_2_Event_2" 33 "Voltage_Piezo_Actuator_Bank_1_Event_2" 34 "Charge_Actuator_Event_3" 35 "Voltage_Piezo_Actuator_Bank_2_Event_3" 36 "Voltage_Piezo_Actuator_Bank_1_Event_3" 37 "Charge_Actuator_Event_4" 38 "Voltage_Piezo_Actuator_Bank_2_Event_4" 39 "Voltage_Piezo_Actuator_Bank_1_Event_4" 40 "Charge_Actuator_Event_5" 41 "Voltage_Piezo_Actuator_Bank_2_Event_5" 42 "Voltage_Piezo_Actuator_Bank_1_Event_5" 43 "Booster_Voltage_Piezo" 44 "Piezo_Voltage" /end COMPU_VTAB
/begin COMPU_METHOD OneToOne "eins zu eins (physikalischer Wert ist gleich dem internen Wert)" RAT_FUNC "%6.2" "-" COEFFS 0 1 0 0 0 1 /end COMPU_METHOD
/begin COMPU_METHOD RdyOnMilEnable "Verbale Umrechnung für DSM_RdyOnMilEnable_C" TAB_VERB "%6.3" "-" COMPU_TAB_REF RdyOnMilEnable /end COMPU_METHOD
/begin COMPU_VTAB RdyOnMilEnable "Verbale Umrechnung für DSM_RdyOnMilEnable_C" TAB_VERB 2 0 "normal" 1 "set all Rdy bits on Mil ON" /end COMPU_VTAB
/begin COMPU_METHOD RmpTemp "Rampengradient für Temperatur" RAT_FUNC "%6.4" "deg C/s" COEFFS 0 655.36 0 0 0 1 /end COMPU_METHOD
/begin COMPU_METHOD RmpTempCels "temperature ramp gradient in Centigrade" RAT_FUNC "%8.7" "C/ms" COEFFS 0 655360 0 0 0 1 /end COMPU_METHOD
/begin COMPU_METHOD Temp_Cels "Temperatur dargestellt in °C (gleiche interne Darstellung wie Temp_Kelv)" RAT_FUNC "%6.1" "deg C" COEFFS 0 10 2731.4 0 0 1 /end COMPU_METHOD
/begin COMPU_METHOD TimeDsmTsf "Skalierung der DSM Schwerezähler Werte" RAT_FUNC "%6.0" "ms" COEFFS 0 0.005 0 0 0 1 /end COMPU_METHOD
/begin COMPU_METHOD Time_ms "Zeit in ms für Fehlerentprellung (DSM) und SW-Timer" RAT_FUNC "%6.1" "ms" COEFFS 0 0.1 0 0 0 1 /end COMPU_METHOD
/begin COMPU_METHOD Volt "Spannung in V (von ADC)" RAT_FUNC "%6.2" "mV" COEFFS 0 0.2046 0 0 0 1 /end COMPU_METHOD
/begin RECORD_LAYOUT Kl_Xs16_Ws16 NO_AXIS_PTS_X 1 SWORD AXIS_PTS_X 2 SWORD INDEX_INCR DIRECT FNC_VALUES 3 SWORD COLUMN_DIR DIRECT /end RECORD_LAYOUT
/begin RECORD_LAYOUT Kwb_Wu8 FNC_VALUES 1 UBYTE COLUMN_DIR DIRECT /end RECORD_LAYOUT
/begin RECORD_LAYOUT Kw_Ws16 FNC_VALUES 1 SWORD COLUMN_DIR DIRECT /end RECORD_LAYOUT
/begin RECORD_LAYOUT Kw_Wu16 FNC_VALUES 1 UWORD COLUMN_DIR DIRECT /end RECORD_LAYOUT
/begin RECORD_LAYOUT Kw_Wu32 FNC_VALUES 1 ULONG COLUMN_DIR DIRECT /end RECORD_LAYOUT
/begin RECORD_LAYOUT Kw_Wu8 FNC_VALUES 1 UBYTE COLUMN_DIR DIRECT /end RECORD_LAYOUT
/end MODULE
/end PROJECT
