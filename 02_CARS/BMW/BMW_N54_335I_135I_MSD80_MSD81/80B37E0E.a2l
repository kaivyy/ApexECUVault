ASAP2_VERSION 1 41
/begin PROJECT MSD70 "Spray Guided DI-System with Piezo Injectors for 6-Cylinder"
/begin HEADER "_default_HeaderComment" PROJECT_NO _0B /end HEADER
/begin MODULE _default_ModuleName "_default_ModuleLongIdentifier"
/begin MOD_COMMON "_default_ModCommonComment" DEPOSIT ABSOLUTE BYTE_ORDER MSB_LAST ALIGNMENT_BYTE 1 ALIGNMENT_WORD 2 ALIGNMENT_LONG 2 ALIGNMENT_FLOAT32_IEEE 2 ALIGNMENT_FLOAT64_IEEE 4 /end MOD_COMMON
/begin MEASUREMENT B_nplms_reset "Reset of adaption values for next restart" UBYTE _CNV_R_R_Def_dez_sl_575_CM 1 100. 0. 255. DISPLAY_IDENTIFIER B_NPLMS_RESET ECU_ADDRESS 0xc0004310 FORMAT "%3.0" /end MEASUREMENT
/begin MEASUREMENT Ctr_drdiag "Zeit erlaubt für Drucksensorabgleich" UWORD _CNV_R_R_Def_td_ub__593_CM 1 100. 0. 6553.5 DISPLAY_IDENTIFIER CTR_DRDIAG ECU_ADDRESS 0xc0001aa0 FORMAT "%6.1" /end MEASUREMENT
/begin MEASUREMENT Diag_mso "Obere Diagnose-Schwelle Massenstrom" UWORD _CNV_R_R_Def_f_uw_b_579_CM 1 100. 0. 1.9999 DISPLAY_IDENTIFIER DIAG_MSO ECU_ADDRESS 0xc0001abe FORMAT "%14.5" /end MEASUREMENT
/begin MEASUREMENT Diag_mso2 "Obere Diagnose-Schwelle Massenstrom (Bank2)" UWORD _CNV_R_R_Def_f_uw_b_579_CM 1 100. 0. 1.9999 DISPLAY_IDENTIFIER DIAG_MSO2 ECU_ADDRESS 0xc0001ac2 FORMAT "%14.5" /end MEASUREMENT
/begin MEASUREMENT Diag_mso2_f "Obere Diagnose-Schwelle Massenstrom (Bank2) gefiltert" UWORD _CNV_R_R_Def_f_uw_b_579_CM 1 100. 0. 1.9999 DISPLAY_IDENTIFIER DIAG_MSO2_F ECU_ADDRESS 0xc0001aca FORMAT "%14.5" /end MEASUREMENT
/begin MEASUREMENT Diag_mso_f "Obere Diagnose-Schwelle Massenstrom (Bank1) gefiltert" UWORD _CNV_R_R_Def_f_uw_b_579_CM 1 100. 0. 1.9999 DISPLAY_IDENTIFIER DIAG_MSO_F ECU_ADDRESS 0xc0001ac6 FORMAT "%14.5" /end MEASUREMENT
/begin MEASUREMENT Diag_mso_off "Offset obere Diagnoseschwelle" SWORD _CNV_R_R_Def_f_uw_b_579_CM 1 100. -1. 0.9999 DISPLAY_IDENTIFIER DIAG_MSO_OFF ECU_ADDRESS 0xc0001ace FORMAT "%14.5" /end MEASUREMENT
/begin MEASUREMENT Diag_msu "Untere Diagnose-Schwelle Massenstrom" UWORD _CNV_R_R_Def_f_uw_b_579_CM 1 100. 0. 1.9999 DISPLAY_IDENTIFIER DIAG_MSU ECU_ADDRESS 0xc0001abc FORMAT "%14.5" /end MEASUREMENT
/begin MEASUREMENT Diag_msu2 "Untere Diagnose-Schwelle Massenstrom (Bank2)" UWORD _CNV_R_R_Def_f_uw_b_579_CM 1 100. 0. 1.9999 DISPLAY_IDENTIFIER DIAG_MSU2 ECU_ADDRESS 0xc0001ac0 FORMAT "%14.5" /end MEASUREMENT
/begin MEASUREMENT Diag_msu2_f "Untere Diagnose-Schwelle Massenstrom (Bank2) gefiltert" UWORD _CNV_R_R_Def_f_uw_b_579_CM 1 100. 0. 1.9999 DISPLAY_IDENTIFIER DIAG_MSU2_F ECU_ADDRESS 0xc0001ac8 FORMAT "%14.5" /end MEASUREMENT
/begin MEASUREMENT Diag_msu_f "Untere Diagnose-Schwelle Massenstrom (Bank1) gefiltert" UWORD _CNV_R_R_Def_f_uw_b_579_CM 1 100. 0. 1.9999 DISPLAY_IDENTIFIER DIAG_MSU_F ECU_ADDRESS 0xc0001ac4 FORMAT "%14.5" /end MEASUREMENT
/begin MEASUREMENT Diag_msu_off "Offset untere Diagnoseschwelle" SWORD _CNV_R_R_Def_f_uw_b_579_CM 1 100. -1. 0.9999 DISPLAY_IDENTIFIER DIAG_MSU_OFF ECU_ADDRESS 0xc0001acc FORMAT "%14.5" /end MEASUREMENT
/begin MEASUREMENT Diag_pso "Obergrenze DPSR-Diagnose gefiltert" SWORD _CNV_R_R_Def_f_sw_b_606_CM 1 100. -4. 3.9998 DISPLAY_IDENTIFIER DIAG_PSO ECU_ADDRESS 0xc0001ad4 FORMAT "%9.4" /end MEASUREMENT
/begin MEASUREMENT Diag_pso_f "Obergrenze DPSR-Diagnose gefiltert" SWORD _CNV_R_R_Def_f_sw_b_606_CM 1 100. -4. 3.9998 DISPLAY_IDENTIFIER DIAG_PSO_F ECU_ADDRESS 0xc0001ad0 FORMAT "%9.4" /end MEASUREMENT
/begin MEASUREMENT Diag_psu "Untergrenze DPSR-Diagnose gefiltert" SWORD _CNV_R_R_Def_f_sw_b_606_CM 1 100. -4. 3.9998 DISPLAY_IDENTIFIER DIAG_PSU ECU_ADDRESS 0xc0001ad6 FORMAT "%9.4" /end MEASUREMENT
/begin MEASUREMENT Diag_psu_f "Untergrenze DPSR-Diagnose gefiltert" SWORD _CNV_R_R_Def_f_sw_b_606_CM 1 100. -4. 3.9998 DISPLAY_IDENTIFIER DIAG_PSU_F ECU_ADDRESS 0xc0001ad2 FORMAT "%9.4" /end MEASUREMENT
/begin MEASUREMENT Disa_bereich "Bereich DISA Umschaltung" UBYTE _CNV_R_R_Def_dez_sl_575_CM 1 100. 0. 255. DISPLAY_IDENTIFIER DISA_BEREICH ECU_ADDRESS 0xd0006dd8 FORMAT "%3.0" /end MEASUREMENT
/begin MEASUREMENT Dkaus_timer "VVT-DK Adaptionsumschaltungstimer" UBYTE _CNV_R_R_Def_dez_sl_575_CM 1 100. 0. 255. DISPLAY_IDENTIFIER DKAUS_TIMER ECU_ADDRESS 0xd0006edd FORMAT "%3.0" /end MEASUREMENT
/begin MEASUREMENT Dmszyl_spuel "Mszyl Anteil ueberspuel" UWORD _CNV_R_R_Def_ms_uw__611_CM 1 100. 0. 2047.9687 DISPLAY_IDENTIFIER DMSZYL_SPUEL ECU_ADDRESS 0xd0006dba FORMAT "%8.3" /end MEASUREMENT
/begin MEASUREMENT Dmszyl_uk "Mszyl Anteil unkritisches" UWORD _CNV_R_R_Def_ms_uw__611_CM 1 100. 0. 2047.9687 DISPLAY_IDENTIFIER DMSZYL_UK ECU_ADDRESS 0xd0006db8 FORMAT "%8.3" /end MEASUREMENT
/begin MEASUREMENT Dnkw_eisyd "Differenzdrehzahl für Eisy Diagnose Dynamikerkennung" SWORD _CNV_R_R_Def_n_sw_q_612_CM 1 100. -32768. 32767. DISPLAY_IDENTIFIER DNKW_EISYD ECU_ADDRESS 0xc0001a8e FORMAT "%5.0" /end MEASUREMENT
/begin MEASUREMENT Dpirgn "1013 mbar - Pirg" UWORD _CNV_R_R_Def_p_sw_q_578_CM 1 100. 0. 2559.9609 DISPLAY_IDENTIFIER DPIRGN ECU_ADDRESS 0xd0006dd0 FORMAT "%7.2" /end MEASUREMENT
/begin MEASUREMENT Dps_abs "Deltadrucksensor Ps_abs-Pu" SWORD _CNV_R_R_Def_p_sw_q_578_CM 1 100. -1280. 1279.9609 DISPLAY_IDENTIFIER DPS_ABS ECU_ADDRESS 0xc0001a9a FORMAT "%7.2" /end MEASUREMENT
/begin MEASUREMENT Dps_abs_acc "Summe Deltadruck Ps_abs-Pu" SLONG _CNV_R_R_Def_p_sw_q_578_CM 1 100. -83886080. 83886079.96089999 DISPLAY_IDENTIFIER DPS_ABS_ACC ECU_ADDRESS 0xc0001aa6 FORMAT "%9.2" /end MEASUREMENT
/begin MEASUREMENT Dpsrseg_puls "Puls-Amplitude auf Differenzdruck Saugrohr" SWORD _CNV_R_R_Def_p_sw_q_578_CM 1 100. -1280. 1279.9609 DISPLAY_IDENTIFIER DPSRSEG_PULS ECU_ADDRESS 0xd0007038 FORMAT "%7.2" /end MEASUREMENT
/begin MEASUREMENT Dpvdkds "Deltadrucksensor Pvdkds-Pu" SWORD _CNV_R_R_Def_p_sw_q_578_CM 1 100. -1280. 1279.9609 DISPLAY_IDENTIFIER DPVDKDS ECU_ADDRESS 0xc0001a98 FORMAT "%7.2" /end MEASUREMENT
/begin MEASUREMENT Dpvdkds_acc "Summe Deltadruck Pvdkds-Pu" SLONG _CNV_R_R_Def_p_sw_q_578_CM 1 100. -83886080. 83886079.96089999 DISPLAY_IDENTIFIER DPVDKDS_ACC ECU_ADDRESS 0xc0001aa2 FORMAT "%9.2" /end MEASUREMENT
/begin MEASUREMENT Drf_eisyd "Differenzlast für Eisy Diagnose Dynamikerkennung" SWORD _CNV_R_R_Def_rf_sw__616_CM 1 100. -327.68 327.67 DISPLAY_IDENTIFIER DRF_EISYD ECU_ADDRESS 0xc0001a92 FORMAT "%9.4" /end MEASUREMENT
/begin MEASUREMENT Drf_spuel "Rf Anteil ueberspuel" SWORD _CNV_R_R_Def_rf_sw__616_CM 1 100. -327.68 327.67 DISPLAY_IDENTIFIER DRF_SPUEL ECU_ADDRESS 0xd0006dbe FORMAT "%9.4" /end MEASUREMENT
/begin MEASUREMENT Drf_spuel_tmp "" SWORD _CNV_R_R_Def_rf_sw__616_CM 1 100. -327.68 327.67 DISPLAY_IDENTIFIER DRF_SPUEL_TMP ECU_ADDRESS 0xd0006de2 FORMAT "%9.4" /end MEASUREMENT
/begin MEASUREMENT Drf_uk "Rf Anteil unkritisches" SWORD _CNV_R_R_Def_rf_sw__616_CM 1 100. -327.68 327.67 DISPLAY_IDENTIFIER DRF_UK ECU_ADDRESS 0xd0006dbc FORMAT "%9.4" /end MEASUREMENT
/begin MEASUREMENT Drf_uk_tmp "" SWORD _CNV_R_R_Def_rf_sw__616_CM 1 100. -327.68 327.67 DISPLAY_IDENTIFIER DRF_UK_TMP ECU_ADDRESS 0xd0006de4 FORMAT "%9.4" /end MEASUREMENT
/begin MEASUREMENT Drf_zylvol "" SWORD _CNV_R_R_Def_rf_sw__616_CM 1 100. -327.68 327.67 DISPLAY_IDENTIFIER DRF_ZYLVOL ECU_ADDRESS 0xd0006db6 FORMAT "%9.4" /end MEASUREMENT
/begin MEASUREMENT Drfnorm_spuel "Rf Anteil ueberspuel, norm" SWORD _CNV_R_R_Def_rf_sw__616_CM 1 100. -327.68 327.67 DISPLAY_IDENTIFIER DRFNORM_SPUEL ECU_ADDRESS 0xd0006db0 FORMAT "%9.4" /end MEASUREMENT
/begin MEASUREMENT Drfnorm_uk "Rf Anteil unkritisches, norm" SWORD _CNV_R_R_Def_rf_sw__616_CM 1 100. -327.68 327.67 DISPLAY_IDENTIFIER DRFNORM_UK ECU_ADDRESS 0xd0006de0 FORMAT "%9.4" /end MEASUREMENT
/begin MEASUREMENT Eisy_segtoggle "" UBYTE _CNV_R_R_Def_dez_sl_575_CM 1 100. 0. 255. DISPLAY_IDENTIFIER EISY_SEGTOGGLE ECU_ADDRESS 0xd0006ccb FORMAT "%3.0" /end MEASUREMENT
/begin MEASUREMENT Eisyagr_kor_fak "" UWORD _CNV_R_R_Def_f_uw_b_604_CM 1 100. 0. 31.9995 DISPLAY_IDENTIFIER EISYAGR_KOR_FAK ECU_ADDRESS 0xd0006cee FORMAT "%9.4" /end MEASUREMENT
/begin MEASUREMENT Eisyagr_korfak_b "" UBYTE _CNV_R_R_Def_f_ub_b_625_CM 1 100. 0. 1.9921 DISPLAY_IDENTIFIER EISYAGR_KORFAK_B ECU_ADDRESS 0xd0006cc6 /end MEASUREMENT
/begin MEASUREMENT Eisyagr_korfak_f "" UWORD _CNV_R_R_Def_f_uw_b_604_CM 1 100. 0. 31.9995 DISPLAY_IDENTIFIER EISYAGR_KORFAK_F ECU_ADDRESS 0xd0006cf0 FORMAT "%9.4" /end MEASUREMENT
/begin MEASUREMENT Eisydk_kor_fak "Ms/Ps Reglerausgang, Faktor" UWORD _CNV_R_R_Def_f_uw_b_579_CM 1 100. 0. 1.9999 DISPLAY_IDENTIFIER EISYDK_KOR_FAK ECU_ADDRESS 0xd0006ce6 FORMAT "%14.5" /end MEASUREMENT
/begin MEASUREMENT Eisydk_kor_off "Ms/Ps Reglerausgang, Offset" SWORD _CNV_R_R_Def_ms_uw__611_CM 1 100. -1024. 1023.9687 DISPLAY_IDENTIFIER EISYDK_KOR_OFF ECU_ADDRESS 0xd0006ce2 FORMAT "%8.3" /end MEASUREMENT
/begin MEASUREMENT Eisydk_korfak_b "" UBYTE _CNV_R_R_Def_f_ub_b_625_CM 1 100. 0. 1.9921 DISPLAY_IDENTIFIER EISYDK_KORFAK_B ECU_ADDRESS 0xd0006cca /end MEASUREMENT
/begin MEASUREMENT Eisydk_korfak_f "Ms/Ps Reglerausgang, Faktor" UWORD _CNV_R_R_Def_f_uw_b_579_CM 1 100. 0. 1.9999 DISPLAY_IDENTIFIER EISYDK_KORFAK_F ECU_ADDRESS 0xd0006ce8 FORMAT "%14.5" /end MEASUREMENT
/begin MEASUREMENT Eisydk_koroff_b "" SBYTE _CNV_R_R_Def_ms_sb__626_CM 1 100. -1024. 1016. DISPLAY_IDENTIFIER EISYDK_KOROFF_B ECU_ADDRESS 0xd0006cc8 FORMAT "%5.2" /end MEASUREMENT
/begin MEASUREMENT Eisydk_koroff_f "Gefilterter Ms/Ps Reglerausgang, Offset" SWORD _CNV_R_R_Def_ms_uw__611_CM 1 100. -1024. 1023.9687 DISPLAY_IDENTIFIER EISYDK_KOROFF_F ECU_ADDRESS 0xd0006ce4 FORMAT "%8.3" /end MEASUREMENT
/begin MEASUREMENT Eisyev_kor_fak "" UWORD _CNV_R_R_Def_f_uw_b_579_CM 1 100. 0. 1.9999 DISPLAY_IDENTIFIER EISYEV_KOR_FAK ECU_ADDRESS 0xd0006cea FORMAT "%14.5" /end MEASUREMENT
/begin MEASUREMENT Eisyev_kor_off "Offset" SWORD _CNV_R_R_Def_ms_uw__611_CM 1 100. -1024. 1023.9687 DISPLAY_IDENTIFIER EISYEV_KOR_OFF ECU_ADDRESS 0xd0006cec FORMAT "%8.3" /end MEASUREMENT
/begin MEASUREMENT Eisyev_korfak_b "" UBYTE _CNV_R_R_Def_f_ub_b_625_CM 1 100. 0. 1.9921 DISPLAY_IDENTIFIER EISYEV_KORFAK_B ECU_ADDRESS 0xd0006cc9 /end MEASUREMENT
/begin MEASUREMENT Eisyev_koroff_b "" SBYTE _CNV_R_R_Def_ms_sb__626_CM 1 100. -1024. 1016. DISPLAY_IDENTIFIER EISYEV_KOROFF_B ECU_ADDRESS 0xd0006cc7 FORMAT "%5.2" /end MEASUREMENT
/begin MEASUREMENT F_abgd "Faktor" UWORD _CNV_R_R_Def_f_sw_b_608_CM 1 100. 0. 3.9999 DISPLAY_IDENTIFIER F_ABGD ECU_ADDRESS 0xd0006e06 FORMAT "%14.5" /end MEASUREMENT
/begin MEASUREMENT F_mr_ramp "Ramp faktor" UWORD _CNV_R_R_Def_f_uw_b_591_CM 1 100. 0. 0.9999 DISPLAY_IDENTIFIER F_MR_RAMP ECU_ADDRESS 0xd0006f0e FORMAT "%14.5" /end MEASUREMENT
/begin MEASUREMENT F_pagr "Druckkorrektur für AGR Durchfluss" UWORD _CNV_R_R_Def_f_uw_b_579_CM 1 100. 0. 1.9999 DISPLAY_IDENTIFIER F_PAGR ECU_ADDRESS 0xd0007040 FORMAT "%14.5" /end MEASUREMENT
/begin MEASUREMENT F_pspu "Faktor Ps/Pu" UWORD _CNV_R_R_Def_f_uw_b_579_CM 1 100. 0. 1.9999 DISPLAY_IDENTIFIER F_PSPU ECU_ADDRESS 0xd0006dfe FORMAT "%14.5" /end MEASUREMENT
/begin MEASUREMENT F_pssolverh "Soll-druck Verhältnis" UWORD _CNV_R_R_Def_f_uw_b_629_CM 1 100. 0. 9.999800000000001 DISPLAY_IDENTIFIER F_PSSOLVERH ECU_ADDRESS 0xd0006eea FORMAT "%9.4" /end MEASUREMENT
/begin MEASUREMENT F_quot_spuel "" UWORD _CNV_R_R_Def_f_uw_b_591_CM 1 100. 0. 0.9999 DISPLAY_IDENTIFIER F_QUOT_SPUEL ECU_ADDRESS 0xd0006cd2 FORMAT "%14.5" /end MEASUREMENT
/begin MEASUREMENT F_quot_uk "" UWORD _CNV_R_R_Def_f_uw_b_591_CM 1 100. 0. 0.9999 DISPLAY_IDENTIFIER F_QUOT_UK ECU_ADDRESS 0xd0006cd0 FORMAT "%14.5" /end MEASUREMENT
/begin MEASUREMENT F_quotdiagh "Quotient von Mshfm_ist und Mszyl_diag" UWORD _CNV_R_R_Def_f_uw_b_579_CM 1 100. 0. 1.9999 DISPLAY_IDENTIFIER F_QUOTDIAGH ECU_ADDRESS 0xc0001aaa FORMAT "%14.5" /end MEASUREMENT
/begin MEASUREMENT F_quotdiaghf "Quotient von Mshfm_ist und Mszyl_diag (gefiltert)" UWORD _CNV_R_R_Def_f_uw_b_579_CM 1 100. 0. 1.9999 DISPLAY_IDENTIFIER F_QUOTDIAGHF ECU_ADDRESS 0xc0001aac FORMAT "%14.5" /end MEASUREMENT
/begin MEASUREMENT F_quotdiagl "Quotient von Mslam und Mszyl_diagf" UWORD _CNV_R_R_Def_f_uw_b_579_CM 1 100. 0. 1.9999 DISPLAY_IDENTIFIER F_QUOTDIAGL ECU_ADDRESS 0xc0001aae FORMAT "%14.5" /end MEASUREMENT
/begin MEASUREMENT F_quotdiagl2 "Quotient von Mslam2 und Mszyl_diagf" UWORD _CNV_R_R_Def_f_uw_b_579_CM 1 100. 0. 1.9999 DISPLAY_IDENTIFIER F_QUOTDIAGL2 ECU_ADDRESS 0xc0001ab2 FORMAT "%14.5" /end MEASUREMENT
/begin MEASUREMENT F_quotdiaglf "Quotient von Mslam und Mszyl_diagf (gefiltert)" UWORD _CNV_R_R_Def_f_uw_b_579_CM 1 100. 0. 1.9999 DISPLAY_IDENTIFIER F_QUOTDIAGLF ECU_ADDRESS 0xc0001ab0 FORMAT "%14.5" /end MEASUREMENT
/begin MEASUREMENT F_quotdiaglf2 "Quotient von Mslam2 und Mszyl_diagf (gefiltert)" UWORD _CNV_R_R_Def_f_uw_b_579_CM 1 100. 0. 1.9999 DISPLAY_IDENTIFIER F_QUOTDIAGLF2 ECU_ADDRESS 0xc0001ab4 FORMAT "%14.5" /end MEASUREMENT
/begin MEASUREMENT F_stend_trans "Faktor Start" UWORD _CNV_R_R_Def_f_uw_b_591_CM 1 100. 0. 0.9999 DISPLAY_IDENTIFIER F_STEND_TRANS ECU_ADDRESS 0xd0006e08 FORMAT "%14.5" /end MEASUREMENT
/begin MEASUREMENT F_tagr "Temperaturkorrektur für AGR Durchfluss" UWORD _CNV_R_R_Def_f_uw_b_579_CM 1 100. 0. 1.9999 DISPLAY_IDENTIFIER F_TAGR ECU_ADDRESS 0xd0007042 FORMAT "%14.5" /end MEASUREMENT
/begin MEASUREMENT F_tzkorbls "Faktor Temperaturkorrektur im Brennraum/Vor Drosselklappe" UWORD _CNV_R_R_Def_f_uw_b_579_CM 1 100. 0. 1.9999 DISPLAY_IDENTIFIER F_TZKORBLS ECU_ADDRESS 0xd0006dce FORMAT "%14.5" /end MEASUREMENT
/begin MEASUREMENT F_tzylkor "Faktor Temperaturkorrektur im Brennraum/Vor Drosselklappe" UWORD _CNV_R_R_Def_f_uw_b_579_CM 1 100. 0. 1.9999 DISPLAY_IDENTIFIER F_TZYLKOR ECU_ADDRESS 0xd0006dcc FORMAT "%14.5" /end MEASUREMENT
/begin MEASUREMENT F_umsrfn "Faktor Massenstrom in relative Luftfuellung" UWORD _CNV_R_R_Def_umr_uw_635_CM 1 100. 0. 3999.9389 DISPLAY_IDENTIFIER F_UMSRFN ECU_ADDRESS 0xd0006dc4 FORMAT "%7.2" /end MEASUREMENT
/begin MEASUREMENT Fupsms "Faktor systembezogene Umrechung Druck auf Luftmasse" UWORD _CNV_R_R_Def_f_uw_b_579_CM 1 100. 0. 1.9999 DISPLAY_IDENTIFIER FUPSMS ECU_ADDRESS 0xd0006dc2 FORMAT "%14.5" /end MEASUREMENT
/begin MEASUREMENT Fupsms_bas "Faktor systembezogene Umrechung Druck auf Luftmasse, bas" UWORD _CNV_R_R_Def_f_uw_b_579_CM 1 100. 0. 1.9999 DISPLAY_IDENTIFIER FUPSMS_BAS ECU_ADDRESS 0xd0006dfc FORMAT "%14.5" /end MEASUREMENT
/begin MEASUREMENT Fupsrf "Faktor systembezogene Umrechung Druck auf Füllung" UWORD _CNV_R_R_Def_f_uw_b_639_CM 1 100. 0. 0.2999 DISPLAY_IDENTIFIER FUPSRF ECU_ADDRESS 0xd0006dc0 FORMAT "%14.6" /end MEASUREMENT
/begin MEASUREMENT Hubev_ist_m "Ist-Hub Mittelwert Bank1/2" UWORD _CNV_R_R_Def_hub_uw_605_CM 1 100. 0. 65.535 DISPLAY_IDENTIFIER HUBEV_IST_M ECU_ADDRESS 0xd0006df6 FORMAT "%8.3" /end MEASUREMENT
/begin MEASUREMENT Hubev_mareg "Istwert Einlassventilhub plus Korrektur von Regler" UWORD _CNV_R_R_Def_hub_uw_605_CM 1 100. 0. 65.535 DISPLAY_IDENTIFIER HUBEV_MAREG ECU_ADDRESS 0xd0006dd4 FORMAT "%8.3" /end MEASUREMENT
/begin MEASUREMENT Klaf_outdk "Ausgang Ausflusskennlinie" UWORD _CNV_R_R_Def_f_uw_b_591_CM 1 100. 0. 0.9999 DISPLAY_IDENTIFIER KLAF_OUTDK ECU_ADDRESS 0xd0006da8 FORMAT "%14.5" /end MEASUREMENT
/begin MEASUREMENT Klaf_outwdkdiag "" UWORD _CNV_R_R_Def_f_uw_b_591_CM 1 100. 0. 0.9999 DISPLAY_IDENTIFIER KLAF_OUTWDKDIAG ECU_ADDRESS 0xc0001ada FORMAT "%14.5" /end MEASUREMENT
/begin MEASUREMENT Klafout_spuel "" UWORD _CNV_R_R_Def_f_uw_b_591_CM 1 100. 0. 0.9999 DISPLAY_IDENTIFIER KLAFOUT_SPUEL ECU_ADDRESS 0xd0006de8 FORMAT "%14.5" /end MEASUREMENT
/begin MEASUREMENT Klafout_uk "" UWORD _CNV_R_R_Def_f_uw_b_591_CM 1 100. 0. 0.9999 DISPLAY_IDENTIFIER KLAFOUT_UK ECU_ADDRESS 0xd0006de6 FORMAT "%14.5" /end MEASUREMENT
/begin MEASUREMENT Lolimot_dkaus "" FLOAT32_IEEE _CNV_R_R_Def_dez_sl_575_CM 1 100. -1000000000000. 10000000000000. DISPLAY_IDENTIFIER LOLIMOT_DKAUS ECU_ADDRESS 0xc0001b28 FORMAT "%14.7" /end MEASUREMENT
/begin MEASUREMENT Lolimot_dkein "" FLOAT32_IEEE _CNV_R_R_Def_dez_sl_575_CM 1 100. -1000000000000. 10000000000000. DISPLAY_IDENTIFIER LOLIMOT_DKEIN ECU_ADDRESS 0xc0001b24 FORMAT "%14.7" /end MEASUREMENT
/begin MEASUREMENT Lolimot_dklern "" FLOAT32_IEEE _CNV_R_R_Def_dez_sl_575_CM 1 100. -1000000000000. 10000000000000. DISPLAY_IDENTIFIER LOLIMOT_DKLERN ECU_ADDRESS 0xc0001b20 FORMAT "%14.7" /end MEASUREMENT
/begin MEASUREMENT Mareg_dk "Massenstromregler, Ausgang Offset, DK-Teil" SWORD _CNV_R_R_Def_f_uw_b_579_CM 1 100. -1. 0.9999 DISPLAY_IDENTIFIER MAREG_DK ECU_ADDRESS 0xd0006ecc FORMAT "%14.5" /end MEASUREMENT
/begin MEASUREMENT Mareg_dkaus "Ausgang KNN Drosselklappe" SWORD _CNV_R_R_Def_f_uw_b_579_CM 1 100. -1. 0.9999 DISPLAY_IDENTIFIER MAREG_DKAUS ECU_ADDRESS 0xd0006f0a FORMAT "%14.5" /end MEASUREMENT
/begin MEASUREMENT Mareg_dkdiff "Regeldifferenz Regler Drosselklappe" SWORD _CNV_R_R_Def_f_uw_b_579_CM 1 100. -1. 0.9999 DISPLAY_IDENTIFIER MAREG_DKDIFF ECU_ADDRESS 0xd0006ef6 FORMAT "%14.5" /end MEASUREMENT
/begin MEASUREMENT Mareg_dki "Ausgangswert Regler Drosselklappe Integralanteil" SWORD _CNV_R_R_Def_f_uw_b_579_CM 1 100. -1. 0.9999 DISPLAY_IDENTIFIER MAREG_DKI ECU_ADDRESS 0xd0006efa FORMAT "%14.5" /end MEASUREMENT
/begin MEASUREMENT Mareg_dknn "Ausgang KNN Drosselklappe" SWORD _CNV_R_R_Def_f_uw_b_579_CM 1 100. -1. 0.9999 DISPLAY_IDENTIFIER MAREG_DKNN ECU_ADDRESS 0xd0006f08 FORMAT "%14.5" /end MEASUREMENT
/begin MEASUREMENT Mareg_dknn_out "Ausgang KNN Drosselklappe, rampe" SWORD _CNV_R_R_Def_f_uw_b_579_CM 1 100. -1. 0.9999 DISPLAY_IDENTIFIER MAREG_DKNN_OUT ECU_ADDRESS 0xd0006f0c FORMAT "%14.5" /end MEASUREMENT
/begin MEASUREMENT Mareg_dkp "Ausgangswert Regler Drosselklappe Proportionalanteil" SWORD _CNV_R_R_Def_f_uw_b_579_CM 1 100. -1. 0.9999 DISPLAY_IDENTIFIER MAREG_DKP ECU_ADDRESS 0xd0006ef8 FORMAT "%14.5" /end MEASUREMENT
/begin MEASUREMENT Mareg_dkst "Statuswert Regler Drosselklappe" UBYTE _CNV_R_R_Def_dez_sl_575_CM 1 100. 0. 255. DISPLAY_IDENTIFIER MAREG_DKST ECU_ADDRESS 0xd0006eda FORMAT "%3.0" /end MEASUREMENT
/begin MEASUREMENT Mareg_er_dk "Fehler KNN DK-Adaption" SWORD _CNV_R_R_Def_f_uw_b_579_CM 1 100. -1. 0.9999 DISPLAY_IDENTIFIER MAREG_ER_DK ECU_ADDRESS 0xc0001b1e FORMAT "%14.5" /end MEASUREMENT
/begin MEASUREMENT Mareg_er_vvt "Fehler KNN Hubadaption" SWORD _CNV_R_R_Def_f_uw_b_579_CM 1 100. -1. 0.9999 DISPLAY_IDENTIFIER MAREG_ER_VVT ECU_ADDRESS 0xd0006f04 FORMAT "%14.5" /end MEASUREMENT
/begin MEASUREMENT Mareg_pidk "Ausgang Drosselklappenregler" SWORD _CNV_R_R_Def_f_uw_b_579_CM 1 100. -1. 0.9999 DISPLAY_IDENTIFIER MAREG_PIDK ECU_ADDRESS 0xd0006f06 FORMAT "%14.5" /end MEASUREMENT
/begin MEASUREMENT Mareg_pivvt "Ausgang Hubregler" SWORD _CNV_R_R_Def_f_uw_b_579_CM 1 100. -1. 0.9999 DISPLAY_IDENTIFIER MAREG_PIVVT ECU_ADDRESS 0xd0006efc FORMAT "%14.5" /end MEASUREMENT
/begin MEASUREMENT Mareg_vvt "" SWORD _CNV_R_R_Def_f_uw_b_579_CM 1 100. -1. 0.9999 DISPLAY_IDENTIFIER MAREG_VVT ECU_ADDRESS 0xd0006eca FORMAT "%14.5" /end MEASUREMENT
/begin MEASUREMENT Mareg_vvtaus "Ausgang KNN Hubadaption" SWORD _CNV_R_R_Def_f_uw_b_579_CM 1 100. -1. 0.9999 DISPLAY_IDENTIFIER MAREG_VVTAUS ECU_ADDRESS 0xd0006f00 FORMAT "%14.5" /end MEASUREMENT
/begin MEASUREMENT Mareg_vvtdiff "Regeldifferenz Regler Hub" SWORD _CNV_R_R_Def_f_uw_b_579_CM 1 100. -1. 0.9999 DISPLAY_IDENTIFIER MAREG_VVTDIFF ECU_ADDRESS 0xd0006ef0 FORMAT "%14.5" /end MEASUREMENT
/begin MEASUREMENT Mareg_vvti "Ausgangswert Regler Hub Integralanteil" SWORD _CNV_R_R_Def_f_uw_b_579_CM 1 100. -1. 0.9999 DISPLAY_IDENTIFIER MAREG_VVTI ECU_ADDRESS 0xd0006ef4 FORMAT "%14.5" /end MEASUREMENT
/begin MEASUREMENT Mareg_vvtnn "Ausgang KNN Hubadaption" SWORD _CNV_R_R_Def_f_uw_b_579_CM 1 100. -1. 0.9999 DISPLAY_IDENTIFIER MAREG_VVTNN ECU_ADDRESS 0xd0006efe FORMAT "%14.5" /end MEASUREMENT
/begin MEASUREMENT Mareg_vvtnn_out "Ausgang KNN Hubadaption, rampe" SWORD _CNV_R_R_Def_f_uw_b_579_CM 1 100. -1. 0.9999 DISPLAY_IDENTIFIER MAREG_VVTNN_OUT ECU_ADDRESS 0xd0006f02 FORMAT "%14.5" /end MEASUREMENT
/begin MEASUREMENT Mareg_vvtp "Ausgangswert Regler Hub Proportionalanteil" SWORD _CNV_R_R_Def_f_uw_b_579_CM 1 100. -1. 0.9999 DISPLAY_IDENTIFIER MAREG_VVTP ECU_ADDRESS 0xd0006ef2 FORMAT "%14.5" /end MEASUREMENT
/begin MEASUREMENT Mareg_vvtst "Statuswert Regler Hub" UBYTE _CNV_R_R_Def_dez_sl_575_CM 1 100. 0. 255. DISPLAY_IDENTIFIER MAREG_VVTST ECU_ADDRESS 0xd0006ed9 FORMAT "%3.0" /end MEASUREMENT
/begin MEASUREMENT Modab_fak "Modell-abgleich regler, Ausgang Faktor" UWORD _CNV_R_R_Def_f_uw_b_579_CM 1 100. 0. 1.9999 DISPLAY_IDENTIFIER MODAB_FAK ECU_ADDRESS 0xd0006ec8 FORMAT "%14.5" /end MEASUREMENT
/begin MEASUREMENT Modab_off "Modell-abgleich regler, Ausgang Offset" SWORD _CNV_R_R_Def_ms_uw__611_CM 1 100. -1024. 1023.9687 DISPLAY_IDENTIFIER MODAB_OFF ECU_ADDRESS 0xd0006ec4 FORMAT "%8.3" /end MEASUREMENT
/begin MEASUREMENT Modab_off_adp "" SWORD _CNV_R_R_Def_ms_uw__611_CM 1 100. -1024. 1023.9687 DISPLAY_IDENTIFIER MODAB_OFF_ADP ECU_ADDRESS 0xd0006ec6 FORMAT "%8.3" /end MEASUREMENT
/begin MEASUREMENT Modab_reg_diff "Modell-abgleich regler differenz" SWORD _CNV_R_R_Def_ms_uw__611_CM 1 100. -1024. 1023.9687 DISPLAY_IDENTIFIER MODAB_REG_DIFF ECU_ADDRESS 0xd0006ee0 FORMAT "%8.3" /end MEASUREMENT
/begin MEASUREMENT Modab_reg_in "Modell-abgleich regler, Eingang" SWORD _CNV_R_R_Def_f_uw_b_579_CM 1 100. -1. 0.9999 DISPLAY_IDENTIFIER MODAB_REG_IN ECU_ADDRESS 0xd0006ee2 FORMAT "%14.5" /end MEASUREMENT
/begin MEASUREMENT Modab_reg_out "Modell-abgleich regler, Ausgang" UWORD _CNV_R_R_Def_f_uw_b_579_CM 1 100. 0. 1.9999 DISPLAY_IDENTIFIER MODAB_REG_OUT ECU_ADDRESS 0xd0006ee4 FORMAT "%14.5" /end MEASUREMENT
/begin MEASUREMENT Modab_reg_outadp "Modell-abgleich regler adp, Ausgang" SWORD _CNV_R_R_Def_f_sw_b_608_CM 1 100. -2. 1.9999 DISPLAY_IDENTIFIER MODAB_REG_OUTADP ECU_ADDRESS 0xd0006ee6 FORMAT "%14.5" /end MEASUREMENT
/begin MEASUREMENT Modab_reg_vl "Modell-abgleich Eingang bei Vollast" SWORD _CNV_R_R_Def_f_uw_b_579_CM 1 100. -1. 0.9999 DISPLAY_IDENTIFIER MODAB_REG_VL ECU_ADDRESS 0xd0006ede FORMAT "%14.5" /end MEASUREMENT
/begin MEASUREMENT Modelle "Modellzähler, nur dummy, keine Funktion" UBYTE _CNV_R_R_Def_dez_sl_575_CM 1 100. 0. 255. DISPLAY_IDENTIFIER MODELLE ECU_ADDRESS 0xd0006edb FORMAT "%3.0" /end MEASUREMENT
/begin MEASUREMENT Mr_pskor_fak "Linearisierungsfaktor für Massentromregler" UWORD _CNV_R_R_Def_f_uw_b_629_CM 1 100. 0. 9.999800000000001 DISPLAY_IDENTIFIER MR_PSKOR_FAK ECU_ADDRESS 0xd0006ee8 FORMAT "%9.4" /end MEASUREMENT
/begin MEASUREMENT Mrd_ms_fak "Massenstromregler, Ausgang Faktor DK-Teil" UWORD _CNV_R_R_Def_f_uw_b_579_CM 1 100. 0. 1.9999 DISPLAY_IDENTIFIER MRD_MS_FAK ECU_ADDRESS 0xd0006ed2 FORMAT "%14.5" /end MEASUREMENT
/begin MEASUREMENT Mrd_ms_off "Massenstromregler, Ausgang Offset DK-Teil" SWORD _CNV_R_R_Def_ms_uw__611_CM 1 100. -1024. 1023.9687 DISPLAY_IDENTIFIER MRD_MS_OFF ECU_ADDRESS 0xd0006ed0 FORMAT "%8.3" /end MEASUREMENT
/begin MEASUREMENT Mrd_msfakkor_f "" UWORD _CNV_R_R_Def_f_uw_b_579_CM 1 100. 0. 1.9999 DISPLAY_IDENTIFIER MRD_MSFAKKOR_F ECU_ADDRESS 0xd0006d06 FORMAT "%14.5" /end MEASUREMENT
/begin MEASUREMENT Mrd_msoffkor_f "" SWORD _CNV_R_R_Def_ms_uw__611_CM 1 100. -1024. 1023.9687 DISPLAY_IDENTIFIER MRD_MSOFFKOR_F ECU_ADDRESS 0xd0006d08 FORMAT "%8.3" /end MEASUREMENT
/begin MEASUREMENT Mrnn_test_dk "Ausgang KNN Drosselklappe" SWORD _CNV_R_R_Def_f_uw_b_579_CM 1 100. -1. 0.9999 DISPLAY_IDENTIFIER MRNN_TEST_DK ECU_ADDRESS 0xc0001b1c FORMAT "%14.5" /end MEASUREMENT
/begin MEASUREMENT Mrv_ms_fak "Massenstromregler, Ausgang Faktor Hub-Teil" UWORD _CNV_R_R_Def_f_uw_b_579_CM 1 100. 0. 1.9999 DISPLAY_IDENTIFIER MRV_MS_FAK ECU_ADDRESS 0xc000518c FORMAT "%14.5" /end MEASUREMENT
/begin MEASUREMENT Mrv_ms_off "Massenstromregler, Ausgang Offset Hub-Teil" SWORD _CNV_R_R_Def_ms_uw__611_CM 1 100. -1024. 1023.9687 DISPLAY_IDENTIFIER MRV_MS_OFF ECU_ADDRESS 0xd0006ece FORMAT "%8.3" /end MEASUREMENT
/begin MEASUREMENT Ms_diff "Differenz Massenstrom gemessen zu Modellgröße" SWORD _CNV_R_R_Def_ms_uw__611_CM 1 100. -1024. 1023.9687 DISPLAY_IDENTIFIER MS_DIFF ECU_ADDRESS 0xd0006ed4 FORMAT "%8.3" /end MEASUREMENT
/begin MEASUREMENT Msagr "Massenstrom AGR" UWORD _CNV_R_R_Def_ms_uw__611_CM 1 100. 0. 2047.9687 DISPLAY_IDENTIFIER MSAGR ECU_ADDRESS 0xd0006cfc FORMAT "%8.3" /end MEASUREMENT
/begin MEASUREMENT Msagr_fg "Massenstrom AGR frischgas" UWORD _CNV_R_R_Def_ms_uw__611_CM 1 100. 0. 2047.9687 DISPLAY_IDENTIFIER MSAGR_FG ECU_ADDRESS 0xd0006cfa FORMAT "%8.3" /end MEASUREMENT
/begin MEASUREMENT Msagr_ig "Massenstrom AGR inertgas" UWORD _CNV_R_R_Def_ms_uw__611_CM 1 100. 0. 2047.9687 DISPLAY_IDENTIFIER MSAGR_IG ECU_ADDRESS 0xd0006cf8 FORMAT "%8.3" /end MEASUREMENT
/begin MEASUREMENT Msagrv "Massenstrom AGR" UWORD _CNV_R_R_Def_ms_uw__611_CM 1 100. 0. 2047.9687 DISPLAY_IDENTIFIER MSAGRV ECU_ADDRESS 0xd0007044 FORMAT "%8.3" /end MEASUREMENT
/begin MEASUREMENT Msdk "Massenstrom DK" UWORD _CNV_R_R_Def_ms_uw__611_CM 1 100. 0. 2047.9687 DISPLAY_IDENTIFIER MSDK ECU_ADDRESS 0xd0006ccc FORMAT "%8.3" /end MEASUREMENT
/begin MEASUREMENT Msdk_diff "Differenz Massenstrom HFM zu Massenstrom Drosselklappe (Modellgröße)" SWORD _CNV_R_R_Def_ms_uw__611_CM 1 100. -1024. 1023.9687 DISPLAY_IDENTIFIER MSDK_DIFF ECU_ADDRESS 0xd0006eec FORMAT "%8.3" /end MEASUREMENT
/begin MEASUREMENT Msdk_f "Massenstrom gefiltert" UWORD _CNV_R_R_Def_ms_uw__611_CM 1 100. 0. 2047.9687 DISPLAY_IDENTIFIER MSDK_F ECU_ADDRESS 0xd0006ed6 FORMAT "%8.3" /end MEASUREMENT
/begin MEASUREMENT Msdk_ur "Massenstrom DK vor Umschaltung B_psintmx" UWORD _CNV_R_R_Def_ms_uw__611_CM 1 100. 0. 2047.9687 DISPLAY_IDENTIFIER MSDK_UR ECU_ADDRESS 0xd0006da4 FORMAT "%8.3" /end MEASUREMENT
/begin MEASUREMENT Mshfm_f "Gefilterter Massenstrom HFM" UWORD _CNV_R_R_Def_ms_uw__611_CM 1 100. 0. 2047.9687 DISPLAY_IDENTIFIER MSHFM_F ECU_ADDRESS 0xd0006cde FORMAT "%8.3" /end MEASUREMENT
/begin MEASUREMENT Mshfm_kor "Korrigierter Massenstrom HFM" UWORD _CNV_R_R_Def_ms_uw__611_CM 1 100. 0. 2047.9687 DISPLAY_IDENTIFIER MSHFM_KOR ECU_ADDRESS 0xd0006f10 FORMAT "%8.3" /end MEASUREMENT
/begin MEASUREMENT Msnagr "Druckkorrigierter Normdurchfluss AGR" UWORD _CNV_R_R_Def_ms_uw__611_CM 1 100. 0. 2047.9687 DISPLAY_IDENTIFIER MSNAGR ECU_ADDRESS 0xd0007046 FORMAT "%8.3" /end MEASUREMENT
/begin MEASUREMENT Msnagr_roh "Normierter Durchfluß AGR" UWORD _CNV_R_R_Def_ms_uw__611_CM 1 100. 0. 2047.9687 DISPLAY_IDENTIFIER MSNAGR_ROH ECU_ADDRESS 0xd0007048 FORMAT "%8.3" /end MEASUREMENT
/begin MEASUREMENT Msndk "Normierte Massenstrom" UWORD _CNV_R_R_Def_ms_uw__611_CM 1 100. 0. 2047.9687 DISPLAY_IDENTIFIER MSNDK ECU_ADDRESS 0xd0006daa FORMAT "%8.3" /end MEASUREMENT
/begin MEASUREMENT Msndk_oma "Normierte Massenstrom ohne ablgeleich" UWORD _CNV_R_R_Def_ms_uw__611_CM 1 100. 0. 2047.9687 DISPLAY_IDENTIFIER MSNDK_OMA ECU_ADDRESS 0xd0006da2 FORMAT "%8.3" /end MEASUREMENT
/begin MEASUREMENT Msndk_roh "Unkorrigiert Norm Massenstrom uber DK" UWORD _CNV_R_R_Def_ms_uw__664_CM 1 100. 0. 8191.875 DISPLAY_IDENTIFIER MSNDK_ROH ECU_ADDRESS 0xd0006dac FORMAT "%7.2" /end MEASUREMENT
/begin MEASUREMENT Msnzyl "Massenstrom Zylinder ungedrosselt" UWORD _CNV_R_R_Def_ms_uw__611_CM 1 100. 0. 2047.9687 DISPLAY_IDENTIFIER MSNZYL ECU_ADDRESS 0xd0006dd6 FORMAT "%8.3" /end MEASUREMENT
/begin MEASUREMENT Msnzyl_k "Massenstrom Zylinder normalisiert mit Reglereingriffe" UWORD _CNV_R_R_Def_ms_uw__611_CM 1 100. 0. 2047.9687 DISPLAY_IDENTIFIER MSNZYL_K ECU_ADDRESS 0xd0006e02 FORMAT "%8.3" /end MEASUREMENT
/begin MEASUREMENT Mszyl "Massenstrom Zylinder" UWORD _CNV_R_R_Def_ms_uw__611_CM 1 100. 0. 2047.9687 DISPLAY_IDENTIFIER MSZYL ECU_ADDRESS 0xd0006dc6 FORMAT "%8.3" /end MEASUREMENT
/begin MEASUREMENT Mszyl_diag "Massenstrom in Zylinder (Modell)" UWORD _CNV_R_R_Def_ms_uw__611_CM 1 100. 0. 2047.9687 DISPLAY_IDENTIFIER MSZYL_DIAG ECU_ADDRESS 0xc0001a88 FORMAT "%8.3" /end MEASUREMENT
/begin MEASUREMENT Mszyl_diagf "Massenstrom in Zylinder (Modell) (gefiltert)" UWORD _CNV_R_R_Def_ms_uw__611_CM 1 100. 0. 2047.9687 DISPLAY_IDENTIFIER MSZYL_DIAGF ECU_ADDRESS 0xc0001a8a FORMAT "%8.3" /end MEASUREMENT
/begin MEASUREMENT Mszyl_diff "Differenz Massenstrom Lambda zu Massenstrom über Einspritzung (Modellgröße)" SWORD _CNV_R_R_Def_ms_uw__611_CM 1 100. -1024. 1023.9687 DISPLAY_IDENTIFIER MSZYL_DIFF ECU_ADDRESS 0xd0006eee FORMAT "%8.3" /end MEASUREMENT
/begin MEASUREMENT Mszyl_f "Massenstrom Zylinder verzögert und gefiltert" UWORD _CNV_R_R_Def_ms_uw__611_CM 1 100. 0. 2047.9687 DISPLAY_IDENTIFIER MSZYL_F ECU_ADDRESS 0xd0006d00 FORMAT "%8.3" /end MEASUREMENT
/begin MEASUREMENT Mszyl_fg "Massenstrom AGR gesamt" UWORD _CNV_R_R_Def_ms_uw__611_CM 1 100. 0. 2047.9687 DISPLAY_IDENTIFIER MSZYL_FG ECU_ADDRESS 0xd0006cce FORMAT "%8.3" /end MEASUREMENT
/begin MEASUREMENT Mszyl_ges "Angesaugte Luftmasse incl. AGR" UWORD _CNV_R_R_Def_ml_uw__662_CM 1 100. 0. 6553.5 DISPLAY_IDENTIFIER MSZYL_GES ECU_ADDRESS 0xd0006dca FORMAT "%6.1" /end MEASUREMENT
/begin MEASUREMENT Mszyl_nn "Massenstrom Zylinder, aus Neuronales Netz" UWORD _CNV_R_R_Def_ms_uw__611_CM 1 100. 0. 2047.9687 DISPLAY_IDENTIFIER MSZYL_NN ECU_ADDRESS 0xd0006e04 FORMAT "%8.3" /end MEASUREMENT
/begin MEASUREMENT Mszyl_td "Massenstrom Zylinder verzögert" UWORD _CNV_R_R_Def_ms_uw__611_CM 1 100. 0. 2047.9687 DISPLAY_IDENTIFIER MSZYL_TD ECU_ADDRESS 0xd0006cf6 FORMAT "%8.3" /end MEASUREMENT
/begin MEASUREMENT Nkw_eisydf "Drehzahl für Eisy Diagnose gefiltert Dynamikerkennung" SWORD _CNV_R_R_Def_n_sw_q_612_CM 1 100. -32768. 32767. DISPLAY_IDENTIFIER NKW_EISYDF ECU_ADDRESS 0xc0001a8c FORMAT "%5.0" /end MEASUREMENT
/begin MEASUREMENT Nw_posi "Nockenwellenposition" UWORD _CNV_R_R_Def_spr_sw_583_CM 1 100. 0. 6553.5 DISPLAY_IDENTIFIER NW_POSI ECU_ADDRESS 0xd0007998 FORMAT "%7.2" ARRAY_SIZE 2 MATRIX_DIM 2 1 1 /end MEASUREMENT
/begin MEASUREMENT Oz_diagtoens "Töns Diagnose Byte" UWORD _CNV_R_R_Def_dez_sl_575_CM 1 100. 0. 65535. DISPLAY_IDENTIFIER OZ_DIAGTOENS ECU_ADDRESS 0xc0004fe8 FORMAT "%5.0" /end MEASUREMENT
/begin MEASUREMENT Oz_permerrz "" UBYTE _CNV_R_R_Def_dez_sl_575_CM 1 100. 0. 255. DISPLAY_IDENTIFIER OZ_PERMERRZ ECU_ADDRESS 0xc0004050 FORMAT "%3.0" /end MEASUREMENT
/begin MEASUREMENT Oz_tempplz "Anzahl der unplausibel Sprünge QLT Temperatur" UBYTE _CNV_R_R_Def_dez_sl_575_CM 1 100. 0. 255. DISPLAY_IDENTIFIER OZ_TEMPPLZ ECU_ADDRESS 0xc0004fea FORMAT "%3.0" /end MEASUREMENT
/begin MEASUREMENT Oz_temprold "Alte QLT Temperatur für die Plausibilisierung" UBYTE _CNV_R_R_Def_dez_sl_575_CM 1 100. 0. 255. DISPLAY_IDENTIFIER OZ_TEMPROLD ECU_ADDRESS 0xc0004feb FORMAT "%3.0" /end MEASUREMENT
/begin MEASUREMENT Pakps_kor "" UWORD _CNV_R_R_Def_f_uw_b_579_CM 1 100. 0. 1.9999 DISPLAY_IDENTIFIER PAKPS_KOR ECU_ADDRESS 0xd0006db4 FORMAT "%14.5" /end MEASUREMENT
/begin MEASUREMENT Pakps_offs "" SWORD _CNV_R_R_Def_f_uw_b_579_CM 1 100. -1. 0.9999 DISPLAY_IDENTIFIER PAKPS_OFFS ECU_ADDRESS 0xd0006db2 FORMAT "%14.5" /end MEASUREMENT
/begin MEASUREMENT Pirg "Partialdruck Restgas internes AGR" UWORD _CNV_R_R_Def_p_sw_q_578_CM 1 100. 0. 2559.9609 DISPLAY_IDENTIFIER PIRG ECU_ADDRESS 0xd0006dc8 FORMAT "%7.2" /end MEASUREMENT
/begin MEASUREMENT Pirg_abgd "Pirg: Altitude korrigiert" UWORD _CNV_R_R_Def_p_sw_q_578_CM 1 100. 0. 2559.9609 DISPLAY_IDENTIFIER PIRG_ABGD ECU_ADDRESS 0xd0006dd2 FORMAT "%7.2" /end MEASUREMENT
/begin MEASUREMENT Pirg_nn "Partialdruck Restgas internes AGR aus N.N." UWORD _CNV_R_R_Def_p_sw_q_578_CM 1 100. 0. 2559.9609 DISPLAY_IDENTIFIER PIRG_NN ECU_ADDRESS 0xd0006e12 FORMAT "%7.2" /end MEASUREMENT
/begin MEASUREMENT Pirg_nnbeg "Partialdruck Restgas Begrenzt" UWORD _CNV_R_R_Def_p_sw_q_578_CM 1 100. 0. 2559.9609 DISPLAY_IDENTIFIER PIRG_NNBEG ECU_ADDRESS 0xd0006e16 FORMAT "%7.2" /end MEASUREMENT
/begin MEASUREMENT Pirg_nnbegf "Partialdruck Restgas begrenzt und gefiltert" UWORD _CNV_R_R_Def_p_sw_q_578_CM 1 100. 0. 2559.9609 DISPLAY_IDENTIFIER PIRG_NNBEGF ECU_ADDRESS 0xd0006e18 FORMAT "%7.2" /end MEASUREMENT
/begin MEASUREMENT Pirg_nnf "Partialdruck Restgas internes AGR aus N.N. (filt)" UWORD _CNV_R_R_Def_p_sw_q_578_CM 1 100. 0. 2559.9609 DISPLAY_IDENTIFIER PIRG_NNF ECU_ADDRESS 0xd0006e14 FORMAT "%7.2" /end MEASUREMENT
/begin MEASUREMENT Pllk "" UWORD _CNV_R_R_Def_p_sw_q_578_CM 1 100. 0. 2559.9609 DISPLAY_IDENTIFIER PLLK ECU_ADDRESS 0xd0007094 FORMAT "%7.2" /end MEASUREMENT
/begin MEASUREMENT Ps_abs_offset "Offset, Ps_abs Sensor" SWORD _CNV_R_R_Def_p_sw_q_578_CM 1 100. -1280. 1279.9609 DISPLAY_IDENTIFIER PS_ABS_OFFSET ECU_ADDRESS 0xc0001a9e FORMAT "%7.2" /end MEASUREMENT
/begin MEASUREMENT Ps_abs_t100 "Druck im Saugrohr, 100ms raster" UWORD _CNV_R_R_Def_p_sw_q_578_CM 1 100. 0. 2559.9609 DISPLAY_IDENTIFIER PS_ABS_T100 ECU_ADDRESS 0xc0001a96 FORMAT "%7.2" /end MEASUREMENT
/begin MEASUREMENT Psev "Absolut Druck benutzt beim EISY_EV" UWORD _CNV_R_R_Def_p_sw_q_578_CM 1 100. 0. 2559.9609 DISPLAY_IDENTIFIER PSEV ECU_ADDRESS 0xd0006ce0 FORMAT "%7.2" /end MEASUREMENT
/begin MEASUREMENT Pspvagr "Druckverhältnis für AGR" UWORD _CNV_R_R_Def_f_uw_b_591_CM 1 100. 0. 0.9999847412109381 DISPLAY_IDENTIFIER PSPVAGR ECU_ADDRESS 0xd000704a FORMAT "%14.5" /end MEASUREMENT
/begin MEASUREMENT Pspvdk "Druck verhaeltnis vor Drosselklappe" UWORD _CNV_R_R_Def_f_uw_b_591_CM 1 100. 0. 0.9999 DISPLAY_IDENTIFIER PSPVDK ECU_ADDRESS 0xd0006da0 FORMAT "%14.5" /end MEASUREMENT
/begin MEASUREMENT Psreg_diag "" SWORD _CNV_R_R_Def_f_sw_b_606_CM 1 100. -4. 3.9998 DISPLAY_IDENTIFIER PSREG_DIAG ECU_ADDRESS 0xc0001ab8 FORMAT "%9.4" /end MEASUREMENT
/begin MEASUREMENT Psreg_diag_f "" SWORD _CNV_R_R_Def_f_sw_b_606_CM 1 100. -4. 3.9998 DISPLAY_IDENTIFIER PSREG_DIAG_F ECU_ADDRESS 0xc0001aba FORMAT "%9.4" /end MEASUREMENT
/begin MEASUREMENT Pssol_pn "Druckverhaeltnis Pssol / 1013 hPa" UWORD _CNV_R_R_Def_f_uw_b_591_CM 1 100. 0. 0.9999 DISPLAY_IDENTIFIER PSSOL_PN ECU_ADDRESS 0xd0006d0c FORMAT "%14.5" /end MEASUREMENT
/begin MEASUREMENT Pvdkds_f "Druck vor Drosselklappe v. Drucksensor gefiltert" UWORD _CNV_R_R_Def_p_sw_q_578_CM 1 100. 0. 2559.9609 DISPLAY_IDENTIFIER PVDKDS_F ECU_ADDRESS 0xd0006d02 FORMAT "%7.2" /end MEASUREMENT
/begin MEASUREMENT Pvdkds_offset "Offset, Pvdkds Sensor" SWORD _CNV_R_R_Def_p_sw_q_578_CM 1 100. -1280. 1279.9609 DISPLAY_IDENTIFIER PVDKDS_OFFSET ECU_ADDRESS 0xc0001a9c FORMAT "%7.2" /end MEASUREMENT
/begin MEASUREMENT Pvdkds_t100 "Druck vor Drosselklappe, 100ms raster" UWORD _CNV_R_R_Def_p_sw_q_578_CM 1 100. 0. 2559.9609 DISPLAY_IDENTIFIER PVDKDS_T100 ECU_ADDRESS 0xc0001a94 FORMAT "%7.2" /end MEASUREMENT
/begin MEASUREMENT Rf "Relative Luftfuellung" SWORD _CNV_R_R_Def_rf_sw__616_CM 1 100. -327.68 327.67 DISPLAY_IDENTIFIER RF ECU_ADDRESS 0xd0006cd4 FORMAT "%9.4" /end MEASUREMENT
/begin MEASUREMENT Rf_eisydf "Last für Eisy Diagnose gefiltert Dynamikerkennung" SWORD _CNV_R_R_Def_rf_sw__616_CM 1 100. -327.68 327.67 DISPLAY_IDENTIFIER RF_EISYDF ECU_ADDRESS 0xc0001a90 FORMAT "%9.4" /end MEASUREMENT
/begin MEASUREMENT Rf_f "Relative Luftfuellung, Gefilterte aus Lambda-Modell" SWORD _CNV_R_R_Def_rf_sw__616_CM 1 100. -327.68 327.67 DISPLAY_IDENTIFIER RF_F ECU_ADDRESS 0xd0006cf4 FORMAT "%9.4" /end MEASUREMENT
/begin MEASUREMENT Rf_fg "Relative Luftfuellung AGR" SWORD _CNV_R_R_Def_rf_sw__616_CM 1 100. -327.68 327.67 DISPLAY_IDENTIFIER RF_FG ECU_ADDRESS 0xd0006cfe FORMAT "%9.4" /end MEASUREMENT
/begin MEASUREMENT Rf_ges "Relative Luftfuellung gesamt" SWORD _CNV_R_R_Def_rf_sw__616_CM 1 100. -327.68 327.67 DISPLAY_IDENTIFIER RF_GES ECU_ADDRESS 0xd0006cdc FORMAT "%9.4" /end MEASUREMENT
/begin MEASUREMENT Rf_hfm_f "Relative Luftfuellung über HFM gemessen" SWORD _CNV_R_R_Def_rf_sw__616_CM 1 100. -327.68 327.67 DISPLAY_IDENTIFIER RF_HFM_F ECU_ADDRESS 0xd0006cd6 FORMAT "%9.4" /end MEASUREMENT
/begin MEASUREMENT Rf_start "Relative Luftfuellung, im Start" SWORD _CNV_R_R_Def_rf_sw__616_CM 1 100. -327.68 327.67 DISPLAY_IDENTIFIER RF_START ECU_ADDRESS 0xd0006cd8 FORMAT "%9.4" /end MEASUREMENT
/begin MEASUREMENT Rf_td "Relative Luftfuellung, Zeitversörgert aus Lambda-Modell" SWORD _CNV_R_R_Def_rf_sw__616_CM 1 100. -327.68 327.67 DISPLAY_IDENTIFIER RF_TD ECU_ADDRESS 0xd0006cf2 FORMAT "%9.4" /end MEASUREMENT
/begin MEASUREMENT Rf_ubeg "Rf Unbegrenzt" SWORD _CNV_R_R_Def_rf_sw__616_CM 1 100. -327.68 327.67 DISPLAY_IDENTIFIER RF_UBEG ECU_ADDRESS 0xd0006d0a FORMAT "%9.4" /end MEASUREMENT
/begin MEASUREMENT Rf_zylvol "Normalisiert Volumetrisches Zylinder-Fuellung" SWORD _CNV_R_R_Def_rf_sw__616_CM 1 100. -327.68 327.67 DISPLAY_IDENTIFIER RF_ZYLVOL ECU_ADDRESS 0xd0006ddc FORMAT "%9.4" /end MEASUREMENT
/begin MEASUREMENT Rfv_ist "Modellierter Ungedrosselt Rf begrenzt" SWORD _CNV_R_R_Def_rf_sw__616_CM 1 100. -327.68 327.67 DISPLAY_IDENTIFIER RFV_IST ECU_ADDRESS 0xd0006e10 FORMAT "%9.4" /end MEASUREMENT
/begin MEASUREMENT Rfv_ist_hub "" SWORD _CNV_R_R_Def_rf_sw__616_CM 1 100. -327.68 327.67 DISPLAY_IDENTIFIER RFV_IST_HUB ECU_ADDRESS 0xd0006e00 FORMAT "%9.4" /end MEASUREMENT
/begin MEASUREMENT Rfv_ist_nn "Modellierter Ungedrosselt Rf aus N.N." SWORD _CNV_R_R_Def_rf_sw__616_CM 1 100. -327.68 327.67 DISPLAY_IDENTIFIER RFV_IST_NN ECU_ADDRESS 0xd0006e0a FORMAT "%9.4" /end MEASUREMENT
/begin MEASUREMENT Rfv_ist_nnbeg "Modellierter Ungedrosselt Rf aus N.N. (begr.)" SWORD _CNV_R_R_Def_rf_sw__616_CM 1 100. -327.68 327.67 DISPLAY_IDENTIFIER RFV_IST_NNBEG ECU_ADDRESS 0xd0006e0e FORMAT "%9.4" /end MEASUREMENT
/begin MEASUREMENT Rfv_ist_nnf "Modellierter Ungedrosselt Rf aus N.N. (filt)" SWORD _CNV_R_R_Def_rf_sw__616_CM 1 100. -327.68 327.67 DISPLAY_IDENTIFIER RFV_IST_NNF ECU_ADDRESS 0xd0006e0c FORMAT "%9.4" /end MEASUREMENT
/begin MEASUREMENT Rfv_zylvol "Normalisiert Volumetrisches Zylinder-Fuellung" SWORD _CNV_R_R_Def_rf_sw__616_CM 1 100. -327.68 327.67 DISPLAY_IDENTIFIER RFV_ZYLVOL ECU_ADDRESS 0xd0006dda FORMAT "%9.4" /end MEASUREMENT
/begin MEASUREMENT Rfvist_st "Relative Luftfuellung, im Start, Norm-Bedingingen" SWORD _CNV_R_R_Def_rf_sw__616_CM 1 100. -327.68 327.67 DISPLAY_IDENTIFIER RFVIST_ST ECU_ADDRESS 0xd0006cda FORMAT "%9.4" /end MEASUREMENT
/begin MEASUREMENT Rfzyl_nn "" SWORD _CNV_R_R_Def_rf_sw__616_CM 1 100. -327.68 327.67 DISPLAY_IDENTIFIER RFZYL_NN ECU_ADDRESS 0xd0006dde FORMAT "%9.4" /end MEASUREMENT
/begin MEASUREMENT Spr_diff "Differenz der Spreizungen" SWORD _CNV_R_R_Def_spr_sw_583_CM 1 100. -3276.8 3276.7 DISPLAY_IDENTIFIER SPR_DIFF ECU_ADDRESS 0xd0006dee FORMAT "%7.2" /end MEASUREMENT
/begin MEASUREMENT Spr_sum "Summe Spreizungen" UWORD _CNV_R_R_Def_spr_sw_583_CM 1 100. 0. 6553.5 DISPLAY_IDENTIFIER SPR_SUM ECU_ADDRESS 0xd0006dea FORMAT "%7.2" /end MEASUREMENT
/begin MEASUREMENT Spr_sum_f "Summe Spreizungen gefiltert" UWORD _CNV_R_R_Def_spr_sw_583_CM 1 100. 0. 6553.5 DISPLAY_IDENTIFIER SPR_SUM_F ECU_ADDRESS 0xd0006dec FORMAT "%7.2" /end MEASUREMENT
/begin MEASUREMENT Spr_swp "Schwerpunkt der Spreizung" SWORD _CNV_R_R_Def_spr_sw_583_CM 1 100. -3276.8 3276.7 DISPLAY_IDENTIFIER SPR_SWP ECU_ADDRESS 0xd0006df0 FORMAT "%7.2" /end MEASUREMENT
/begin MEASUREMENT St_disa_umschalt "Statuswort" UBYTE _CNV_R_R_Def_dez_sl_575_CM 1 100. 0. 255. DISPLAY_IDENTIFIER ST_DISA_UMSCHALT ECU_ADDRESS 0xd0006dd9 FORMAT "%3.0" /end MEASUREMENT
/begin MEASUREMENT St_disa_umschalt.B_disa_deak "Bedingung DISA umschaltung bereit" UBYTE _CNV_S_2_Def_bit_ub_700_CM 1 100. 0. 1. DISPLAY_IDENTIFIER B_DISA_DEAK ECU_ADDRESS 0xd0006dd9 BIT_MASK 0x1 /end MEASUREMENT
/begin MEASUREMENT St_disa_umschalt.B_evnnumsch "Bedingung DISA umschaltung bereit" UBYTE _CNV_S_2_Def_bit_ub_701_CM 1 100. 0. 2. DISPLAY_IDENTIFIER B_EVNNUMSCH ECU_ADDRESS 0xd0006dd9 BIT_MASK 0x2 /end MEASUREMENT
/begin MEASUREMENT St_dqlt0 "Statuswort" UBYTE _CNV_R_R_Def_dez_sl_575_CM 1 100. 0. 255. DISPLAY_IDENTIFIER ST_DQLT0 ECU_ADDRESS 0xd0006b14 FORMAT "%3.0" /end MEASUREMENT
/begin MEASUREMENT St_dqlt0.B_ozdiagnmotok "Motordrehzahl ok für die Diagnose" UBYTE _CNV_S_2_Def_bit_ub_707_CM 1 100. 0. 128. DISPLAY_IDENTIFIER B_OZDIAGNMOTOK ECU_ADDRESS 0xd0006b14 BIT_MASK 0x80 /end MEASUREMENT
/begin MEASUREMENT St_dqlt0.B_ozerrbsd "BSD global Fehler" UBYTE _CNV_S_2_Def_bit_ub_706_CM 1 100. 0. 64. DISPLAY_IDENTIFIER B_OZERRBSD ECU_ADDRESS 0xd0006b14 BIT_MASK 0x40 /end MEASUREMENT
/begin MEASUREMENT St_dqlt0.B_ozkttoens "Töns-Sensor verbaut" UBYTE _CNV_S_2_Def_bit_ub_705_CM 1 100. 0. 32. DISPLAY_IDENTIFIER B_OZKTTOENS ECU_ADDRESS 0xd0006b14 BIT_MASK 0x20 /end MEASUREMENT
/begin MEASUREMENT St_dqlt0.B_ozlerr "Messfehler Ölniveau" UBYTE _CNV_S_2_Def_bit_ub_700_CM 1 100. 0. 1. DISPLAY_IDENTIFIER B_OZLERR ECU_ADDRESS 0xd0006b14 BIT_MASK 0x1 /end MEASUREMENT
/begin MEASUREMENT St_dqlt0.B_ozqerr "Messfehler Ölzustand" UBYTE _CNV_S_2_Def_bit_ub_701_CM 1 100. 0. 2. DISPLAY_IDENTIFIER B_OZQERR ECU_ADDRESS 0xd0006b14 BIT_MASK 0x2 /end MEASUREMENT
/begin MEASUREMENT St_dqlt0.B_ozterr "Messfehler Öltemperatur" UBYTE _CNV_S_2_Def_bit_ub_702_CM 1 100. 0. 4. DISPLAY_IDENTIFIER B_OZTERR ECU_ADDRESS 0xd0006b14 BIT_MASK 0x4 /end MEASUREMENT
/begin MEASUREMENT St_dqlt0.B_td_ogerr "Statuswort" UBYTE _CNV_S_2_Def_bit_ub_703_CM 1 100. 0. 8. DISPLAY_IDENTIFIER B_TD_OGERR ECU_ADDRESS 0xd0006b14 BIT_MASK 0x8 /end MEASUREMENT
/begin MEASUREMENT St_dqlt0.B_td_ogupl "Statuswort" UBYTE _CNV_S_2_Def_bit_ub_704_CM 1 100. 0. 16. DISPLAY_IDENTIFIER B_TD_OGUPL ECU_ADDRESS 0xd0006b14 BIT_MASK 0x10 /end MEASUREMENT
/begin MEASUREMENT St_dqlt1 "Statuswort" UBYTE _CNV_R_R_Def_dez_sl_575_CM 1 100. 0. 255. DISPLAY_IDENTIFIER ST_DQLT1 ECU_ADDRESS 0xd0006b15 FORMAT "%3.0" /end MEASUREMENT
/begin MEASUREMENT St_dqlt1.B_ozerr "Sensorfehler in FS eingetragen" UBYTE _CNV_S_2_Def_bit_ub_700_CM 1 100. 0. 1. DISPLAY_IDENTIFIER B_OZERR ECU_ADDRESS 0xd0006b15 BIT_MASK 0x1 /end MEASUREMENT
/begin MEASUREMENT St_dqlt1.B_ozfbsd2 "BSD Sensor Fehler von FI_BSD_4" UBYTE _CNV_S_2_Def_bit_ub_701_CM 1 100. 0. 2. DISPLAY_IDENTIFIER B_OZFBSD2 ECU_ADDRESS 0xd0006b15 BIT_MASK 0x2 /end MEASUREMENT
/begin MEASUREMENT St_dqlt1.B_oztemppl "QLT Temperatur unplausibel" UBYTE _CNV_S_2_Def_bit_ub_702_CM 1 100. 0. 4. DISPLAY_IDENTIFIER B_OZTEMPPL ECU_ADDRESS 0xd0006b15 BIT_MASK 0x4 /end MEASUREMENT
/begin MEASUREMENT St_drdiag "Statuswort" UBYTE _CNV_R_R_Def_dez_sl_575_CM 1 100. 0. 255. DISPLAY_IDENTIFIER ST_DRDIAG ECU_ADDRESS 0xc0001a80 FORMAT "%3.0" /end MEASUREMENT
/begin MEASUREMENT St_drdiag.B_drdiag_akt "B_drdiag_akt" UBYTE _CNV_S_2_Def_bit_ub_700_CM 1 100. 0. 1. DISPLAY_IDENTIFIER B_DRDIAG_AKT ECU_ADDRESS 0xc0001a80 BIT_MASK 0x1 /end MEASUREMENT
/begin MEASUREMENT St_drdiag.B_drdiag_akt_old "B_drdiag_akt_old" UBYTE _CNV_S_2_Def_bit_ub_701_CM 1 100. 0. 2. DISPLAY_IDENTIFIER B_DRDIAG_AKT_OLD ECU_ADDRESS 0xc0001a80 BIT_MASK 0x2 /end MEASUREMENT
/begin MEASUREMENT St_drdiag.B_psabs_pl "B_psabs_pl" UBYTE _CNV_S_2_Def_bit_ub_703_CM 1 100. 0. 8. DISPLAY_IDENTIFIER B_PSABS_PL ECU_ADDRESS 0xc0001a80 BIT_MASK 0x8 /end MEASUREMENT
/begin MEASUREMENT St_drdiag.B_pvdkds_pl "B_pvdkds_pl" UBYTE _CNV_S_2_Def_bit_ub_702_CM 1 100. 0. 4. DISPLAY_IDENTIFIER B_PVDKDS_PL ECU_ADDRESS 0xc0001a80 BIT_MASK 0x4 /end MEASUREMENT
/begin MEASUREMENT St_eisy_hfm "Statusbyte eisy miscellaneous" UBYTE _CNV_R_R_Def_dez_sl_575_CM 1 100. 0. 255. DISPLAY_IDENTIFIER ST_EISY_HFM ECU_ADDRESS 0xd0006cc5 FORMAT "%3.0" /end MEASUREMENT
/begin MEASUREMENT St_eisy_hfm.B_mrmslam "Bedingung MS-Abgleich soll über Lambda passieren" UBYTE _CNV_S_2_Def_bit_ub_700_CM 1 100. 0. 1. DISPLAY_IDENTIFIER B_MRMSLAM ECU_ADDRESS 0xd0006cc5 BIT_MASK 0x1 /end MEASUREMENT
/begin MEASUREMENT St_eisy_segment "Statusbyte EISY Segment" UBYTE _CNV_R_R_Def_dez_sl_575_CM 1 100. 0. 255. DISPLAY_IDENTIFIER ST_EISY_SEGMENT ECU_ADDRESS 0xd0006cc4 FORMAT "%3.0" /end MEASUREMENT
/begin MEASUREMENT St_eisy_segment.B_eisy_dkseg "Bedingung eisy_dk, einmal durchgelaufen im Segmenttask" UBYTE _CNV_S_2_Def_bit_ub_700_CM 1 100. 0. 1. DISPLAY_IDENTIFIER B_EISY_DKSEG ECU_ADDRESS 0xd0006cc4 BIT_MASK 0x1 /end MEASUREMENT
/begin MEASUREMENT St_eisy_segment.B_eisy_evseg "Bedingung eisy_ev, einmal durchgelaufen im Segmenttask" UBYTE _CNV_S_2_Def_bit_ub_701_CM 1 100. 0. 2. DISPLAY_IDENTIFIER B_EISY_EVSEG ECU_ADDRESS 0xd0006cc4 BIT_MASK 0x2 /end MEASUREMENT
/begin MEASUREMENT St_eisyad_read "" UBYTE _CNV_R_R_Def_dez_sl_575_CM 1 100. 0. 255. DISPLAY_IDENTIFIER ST_EISYAD_READ ECU_ADDRESS 0xc00041e0 FORMAT "%3.0" /end MEASUREMENT
/begin MEASUREMENT St_eisyad_read.B_maregdk_ad "Adaption Massenstromregler auf DK erstmalig erfolgt" UBYTE _CNV_S_2_Def_bit_ub_702_CM 1 100. 0. 4. DISPLAY_IDENTIFIER B_MAREGDK_AD ECU_ADDRESS 0xc00041e0 BIT_MASK 0x4 /end MEASUREMENT
/begin MEASUREMENT St_eisyad_read.B_psrhub_ad "Adaption Druckregler auf Hub erstmalig erfolgt" UBYTE _CNV_S_2_Def_bit_ub_700_CM 1 100. 0. 1. DISPLAY_IDENTIFIER B_PSRHUB_AD ECU_ADDRESS 0xc00041e0 BIT_MASK 0x1 /end MEASUREMENT
/begin MEASUREMENT St_eisyd_rbm "Statuswort" UBYTE _CNV_R_R_Def_dez_sl_575_CM 1 100. 0. 255. DISPLAY_IDENTIFIER ST_EISYD_RBM ECU_ADDRESS 0xd0007036 FORMAT "%3.0" /end MEASUREMENT
/begin MEASUREMENT St_eisyd_rbm.B_eisyd_rbmsc "Eisy-Diag RBM-Special Condition Bit gesetzt" UBYTE _CNV_S_2_Def_bit_ub_705_CM 1 100. 0. 32. DISPLAY_IDENTIFIER B_EISYD_RBMSC ECU_ADDRESS 0xd0007036 BIT_MASK 0x20 /end MEASUREMENT
/begin MEASUREMENT St_eisyd_rbm.B_pend_allg "Globales Pending Bit" UBYTE _CNV_S_2_Def_bit_ub_700_CM 1 100. 0. 1. DISPLAY_IDENTIFIER B_PEND_ALLG ECU_ADDRESS 0xd0007036 BIT_MASK 0x1 /end MEASUREMENT
/begin MEASUREMENT St_eisyd_rbm.B_pend_dpsr "DPSR Pending Bit" UBYTE _CNV_S_2_Def_bit_ub_702_CM 1 100. 0. 4. DISPLAY_IDENTIFIER B_PEND_DPSR ECU_ADDRESS 0xd0007036 BIT_MASK 0x4 /end MEASUREMENT
/begin MEASUREMENT St_eisyd_rbm.B_pend_hfm "HFM Pending Bit" UBYTE _CNV_S_2_Def_bit_ub_701_CM 1 100. 0. 2. DISPLAY_IDENTIFIER B_PEND_HFM ECU_ADDRESS 0xd0007036 BIT_MASK 0x2 /end MEASUREMENT
/begin MEASUREMENT St_eisyd_rbm.B_rbmcompl_dpsr "DPSR Diag completed Bit" UBYTE _CNV_S_2_Def_bit_ub_703_CM 1 100. 0. 8. DISPLAY_IDENTIFIER B_RBMCOMPL_DPSR ECU_ADDRESS 0xd0007036 BIT_MASK 0x8 /end MEASUREMENT
/begin MEASUREMENT St_eisyd_rbm.B_rbmcompl_hfm "HFM Diag completed Bit" UBYTE _CNV_S_2_Def_bit_ub_704_CM 1 100. 0. 16. DISPLAY_IDENTIFIER B_RBMCOMPL_HFM ECU_ADDRESS 0xd0007036 BIT_MASK 0x10 /end MEASUREMENT
/begin MEASUREMENT St_eisydiag1 "Statuswort" UBYTE _CNV_R_R_Def_dez_sl_575_CM 1 100. 0. 255. DISPLAY_IDENTIFIER ST_EISYDIAG1 ECU_ADDRESS 0xc0001a81 FORMAT "%3.0" /end MEASUREMENT
/begin MEASUREMENT St_eisydiag1.B_disa_diag "Freigabe Disa-Diagnose" UBYTE _CNV_S_2_Def_bit_ub_701_CM 1 100. 0. 2. DISPLAY_IDENTIFIER B_DISA_DIAG ECU_ADDRESS 0xc0001a81 BIT_MASK 0x2 /end MEASUREMENT
/begin MEASUREMENT St_eisydiag1.B_dpsr_diag "Freigabe Dpsr-Diagnose" UBYTE _CNV_S_2_Def_bit_ub_702_CM 1 100. 0. 4. DISPLAY_IDENTIFIER B_DPSR_DIAG ECU_ADDRESS 0xc0001a81 BIT_MASK 0x4 /end MEASUREMENT
/begin MEASUREMENT St_eisydiag1.B_eisy_diag "Freigabe Eisy-Diagnose (Globales Freigabe-Bit)" UBYTE _CNV_S_2_Def_bit_ub_705_CM 1 100. 0. 32. DISPLAY_IDENTIFIER B_EISY_DIAG ECU_ADDRESS 0xc0001a81 BIT_MASK 0x20 /end MEASUREMENT
/begin MEASUREMENT St_eisydiag1.B_eisyd_on "B_eisyd_on" UBYTE _CNV_S_2_Def_bit_ub_707_CM 1 100. 0. 128. DISPLAY_IDENTIFIER B_EISYD_ON ECU_ADDRESS 0xc0001a81 BIT_MASK 0x80 /end MEASUREMENT
/begin MEASUREMENT St_eisydiag1.B_hfm_diag "Freigabe Eisy-Diag" UBYTE _CNV_S_2_Def_bit_ub_700_CM 1 100. 0. 1. DISPLAY_IDENTIFIER B_HFM_DIAG ECU_ADDRESS 0xc0001a81 BIT_MASK 0x1 /end MEASUREMENT
/begin MEASUREMENT St_eisydiag1.B_mslam2_diag "Freigabe Mslam2-Diagnose" UBYTE _CNV_S_2_Def_bit_ub_704_CM 1 100. 0. 16. DISPLAY_IDENTIFIER B_MSLAM2_DIAG ECU_ADDRESS 0xc0001a81 BIT_MASK 0x10 /end MEASUREMENT
/begin MEASUREMENT St_eisydiag1.B_mslam_diag "Freigabe Mslam-Diagnose" UBYTE _CNV_S_2_Def_bit_ub_703_CM 1 100. 0. 8. DISPLAY_IDENTIFIER B_MSLAM_DIAG ECU_ADDRESS 0xc0001a81 BIT_MASK 0x8 /end MEASUREMENT
/begin MEASUREMENT St_eisydiag1.B_mszyldiag_mod "=1: Mszyl_diag wird mit Ps berechnet, sonst mit Ps_ist" UBYTE _CNV_S_2_Def_bit_ub_706_CM 1 100. 0. 64. DISPLAY_IDENTIFIER B_MSZYLDIAG_MOD ECU_ADDRESS 0xc0001a81 BIT_MASK 0x40 /end MEASUREMENT
/begin MEASUREMENT St_eisydiag2 "Statuswort" UBYTE _CNV_R_R_Def_dez_sl_575_CM 1 100. 0. 255. DISPLAY_IDENTIFIER ST_EISYDIAG2 ECU_ADDRESS 0xc0001a82 FORMAT "%3.0" /end MEASUREMENT
/begin MEASUREMENT St_eisydiag2.B_npl_mshfm "Statuswort" UBYTE _CNV_S_2_Def_bit_ub_704_CM 1 100. 0. 16. DISPLAY_IDENTIFIER B_NPL_MSHFM ECU_ADDRESS 0xc0001a82 BIT_MASK 0x10 /end MEASUREMENT
/begin MEASUREMENT St_eisydiag2.B_nplhfm_mn "Statuswort" UBYTE _CNV_S_2_Def_bit_ub_705_CM 1 100. 0. 32. DISPLAY_IDENTIFIER B_NPLHFM_MN ECU_ADDRESS 0xc0001a82 BIT_MASK 0x20 /end MEASUREMENT
/begin MEASUREMENT St_eisydiag2.B_nplhfm_mx "Statuswort" UBYTE _CNV_S_2_Def_bit_ub_706_CM 1 100. 0. 64. DISPLAY_IDENTIFIER B_NPLHFM_MX ECU_ADDRESS 0xc0001a82 BIT_MASK 0x40 /end MEASUREMENT
/begin MEASUREMENT St_eisydiag2.B_nplmslam2_mn "Statuswort" UBYTE _CNV_S_2_Def_bit_ub_702_CM 1 100. 0. 4. DISPLAY_IDENTIFIER B_NPLMSLAM2_MN ECU_ADDRESS 0xc0001a82 BIT_MASK 0x4 /end MEASUREMENT
/begin MEASUREMENT St_eisydiag2.B_nplmslam2_mx "Statuswort" UBYTE _CNV_S_2_Def_bit_ub_703_CM 1 100. 0. 8. DISPLAY_IDENTIFIER B_NPLMSLAM2_MX ECU_ADDRESS 0xc0001a82 BIT_MASK 0x8 /end MEASUREMENT
/begin MEASUREMENT St_eisydiag2.B_nplmslam_mn "Statuswort" UBYTE _CNV_S_2_Def_bit_ub_700_CM 1 100. 0. 1. DISPLAY_IDENTIFIER B_NPLMSLAM_MN ECU_ADDRESS 0xc0001a82 BIT_MASK 0x1 /end MEASUREMENT
/begin MEASUREMENT St_eisydiag2.B_nplmslam_mx "Statuswort" UBYTE _CNV_S_2_Def_bit_ub_701_CM 1 100. 0. 2. DISPLAY_IDENTIFIER B_NPLMSLAM_MX ECU_ADDRESS 0xc0001a82 BIT_MASK 0x2 /end MEASUREMENT
/begin MEASUREMENT St_eisydiag3 "Statuswort" UBYTE _CNV_R_R_Def_dez_sl_575_CM 1 100. 0. 255. DISPLAY_IDENTIFIER ST_EISYDIAG3 ECU_ADDRESS 0xc0001a83 FORMAT "%3.0" /end MEASUREMENT
/begin MEASUREMENT St_eisydiag3.B_npl_dpsr "Statuswort" UBYTE _CNV_S_2_Def_bit_ub_700_CM 1 100. 0. 1. DISPLAY_IDENTIFIER B_NPL_DPSR ECU_ADDRESS 0xc0001a83 BIT_MASK 0x1 /end MEASUREMENT
/begin MEASUREMENT St_eisydiag3.B_npldpsr_mn "Statuswort" UBYTE _CNV_S_2_Def_bit_ub_701_CM 1 100. 0. 2. DISPLAY_IDENTIFIER B_NPLDPSR_MN ECU_ADDRESS 0xc0001a83 BIT_MASK 0x2 /end MEASUREMENT
/begin MEASUREMENT St_eisydiag3.B_npldpsr_mx "Statuswort" UBYTE _CNV_S_2_Def_bit_ub_702_CM 1 100. 0. 4. DISPLAY_IDENTIFIER B_NPLDPSR_MX ECU_ADDRESS 0xc0001a83 BIT_MASK 0x4 /end MEASUREMENT
/begin MEASUREMENT St_eisydiag4 "Statuswort" UBYTE _CNV_R_R_Def_dez_sl_575_CM 1 100. 0. 255. DISPLAY_IDENTIFIER ST_EISYDIAG4 ECU_ADDRESS 0xd0007034 FORMAT "%3.0" /end MEASUREMENT
/begin MEASUREMENT St_eisydiag4.B_disad_b1 "Statuswort" UBYTE _CNV_S_2_Def_bit_ub_701_CM 1 100. 0. 2. DISPLAY_IDENTIFIER B_DISAD_B1 ECU_ADDRESS 0xd0007034 BIT_MASK 0x2 /end MEASUREMENT
/begin MEASUREMENT St_eisydiag4.B_disad_b2 "Statuswort" UBYTE _CNV_S_2_Def_bit_ub_702_CM 1 100. 0. 4. DISPLAY_IDENTIFIER B_DISAD_B2 ECU_ADDRESS 0xd0007034 BIT_MASK 0x4 /end MEASUREMENT
/begin MEASUREMENT St_eisydiag4.B_disad_b3 "Statuswort" UBYTE _CNV_S_2_Def_bit_ub_703_CM 1 100. 0. 8. DISPLAY_IDENTIFIER B_DISAD_B3 ECU_ADDRESS 0xd0007034 BIT_MASK 0x8 /end MEASUREMENT
/begin MEASUREMENT St_eisydiag4.B_disad_b4 "Statuswort" UBYTE _CNV_S_2_Def_bit_ub_704_CM 1 100. 0. 16. DISPLAY_IDENTIFIER B_DISAD_B4 ECU_ADDRESS 0xd0007034 BIT_MASK 0x10 /end MEASUREMENT
/begin MEASUREMENT St_eisydiag4.B_dpsr_puls "Statuswort" UBYTE _CNV_S_2_Def_bit_ub_705_CM 1 100. 0. 32. DISPLAY_IDENTIFIER B_DPSR_PULS ECU_ADDRESS 0xd0007034 BIT_MASK 0x20 /end MEASUREMENT
/begin MEASUREMENT St_eisydiag4.B_npl_disa "Statuswort" UBYTE _CNV_S_2_Def_bit_ub_700_CM 1 100. 0. 1. DISPLAY_IDENTIFIER B_NPL_DISA ECU_ADDRESS 0xd0007034 BIT_MASK 0x1 /end MEASUREMENT
/begin MEASUREMENT St_eisydiag5 "Statuswort" UBYTE _CNV_R_R_Def_dez_sl_575_CM 1 100. 0. 255. DISPLAY_IDENTIFIER ST_EISYDIAG5 ECU_ADDRESS 0xd0007035 FORMAT "%3.0" /end MEASUREMENT
/begin MEASUREMENT St_eisydiag5.B_disab1_f "Disa Fehler in Bereich 1" UBYTE _CNV_S_2_Def_bit_ub_700_CM 1 100. 0. 1. DISPLAY_IDENTIFIER B_DISAB1_F ECU_ADDRESS 0xd0007035 BIT_MASK 0x1 /end MEASUREMENT
/begin MEASUREMENT St_eisydiag5.B_disab2_f "Disa Fehler in Bereich 2" UBYTE _CNV_S_2_Def_bit_ub_701_CM 1 100. 0. 2. DISPLAY_IDENTIFIER B_DISAB2_F ECU_ADDRESS 0xd0007035 BIT_MASK 0x2 /end MEASUREMENT
/begin MEASUREMENT St_eisydiag5.B_disab3_f "Disa Fehler in Bereich 3" UBYTE _CNV_S_2_Def_bit_ub_702_CM 1 100. 0. 4. DISPLAY_IDENTIFIER B_DISAB3_F ECU_ADDRESS 0xd0007035 BIT_MASK 0x4 /end MEASUREMENT
/begin MEASUREMENT St_eisydiag5.B_disab4_f "Disa Fehler in Bereich 4" UBYTE _CNV_S_2_Def_bit_ub_703_CM 1 100. 0. 8. DISPLAY_IDENTIFIER B_DISAB4_F ECU_ADDRESS 0xd0007035 BIT_MASK 0x8 /end MEASUREMENT
/begin MEASUREMENT St_eisydyn "Statuswort" UBYTE _CNV_R_R_Def_dez_sl_575_CM 1 100. 0. 255. DISPLAY_IDENTIFIER ST_EISYDYN ECU_ADDRESS 0xc0001adc FORMAT "%3.0" /end MEASUREMENT
/begin MEASUREMENT St_eisydyn.B_eisyd_stat "Dynamik für Diagnsoe Eisy erkannt" UBYTE _CNV_S_2_Def_bit_ub_700_CM 1 100. 0. 1. DISPLAY_IDENTIFIER B_EISYD_STAT ECU_ADDRESS 0xc0001adc BIT_MASK 0x1 /end MEASUREMENT
/begin MEASUREMENT St_eisydyn.B_eisyd_statn "Drehzaldynamik für Diagnose Eisy erkannt" UBYTE _CNV_S_2_Def_bit_ub_702_CM 1 100. 0. 4. DISPLAY_IDENTIFIER B_EISYD_STATN ECU_ADDRESS 0xc0001adc BIT_MASK 0x4 /end MEASUREMENT
/begin MEASUREMENT St_eisydyn.B_eisyd_statrf "Lastdynamik für Diagnose Eisy erkannt" UBYTE _CNV_S_2_Def_bit_ub_703_CM 1 100. 0. 8. DISPLAY_IDENTIFIER B_EISYD_STATRF ECU_ADDRESS 0xc0001adc BIT_MASK 0x8 /end MEASUREMENT
/begin MEASUREMENT St_eisydyn.B_eisyd_stattmp "Dynamik für Diagnose Eisy erkannt temporär" UBYTE _CNV_S_2_Def_bit_ub_701_CM 1 100. 0. 2. DISPLAY_IDENTIFIER B_EISYD_STATTMP ECU_ADDRESS 0xc0001adc BIT_MASK 0x2 /end MEASUREMENT
/begin MEASUREMENT St_mareg "Statusbyte EISY_MR" UBYTE _CNV_R_R_Def_dez_sl_575_CM 1 100. 0. 255. DISPLAY_IDENTIFIER ST_MAREG ECU_ADDRESS 0xd0006ec3 FORMAT "%3.0" /end MEASUREMENT
/begin MEASUREMENT St_mareg.B_maregaddk "Bedingung Adaption aus DK-NN lesen" UBYTE _CNV_S_2_Def_bit_ub_707_CM 1 100. 0. 128. DISPLAY_IDENTIFIER B_MAREGADDK ECU_ADDRESS 0xd0006ec3 BIT_MASK 0x80 /end MEASUREMENT
/begin MEASUREMENT St_mareg.B_maregadvvt "Bedingung Adaption aus VVT-NN lesen" UBYTE _CNV_S_2_Def_bit_ub_706_CM 1 100. 0. 64. DISPLAY_IDENTIFIER B_MAREGADVVT ECU_ADDRESS 0xd0006ec3 BIT_MASK 0x40 /end MEASUREMENT
/begin MEASUREMENT St_mareg.B_maregdk1 "Bedingung Regler Drosselklappe freigegeben" UBYTE _CNV_S_2_Def_bit_ub_702_CM 1 100. 0. 4. DISPLAY_IDENTIFIER B_MAREGDK1 ECU_ADDRESS 0xd0006ec3 BIT_MASK 0x4 /end MEASUREMENT
/begin MEASUREMENT St_mareg.B_maregdk2 "Bedingung KNN Drosselklappe freigegeben" UBYTE _CNV_S_2_Def_bit_ub_703_CM 1 100. 0. 8. DISPLAY_IDENTIFIER B_MAREGDK2 ECU_ADDRESS 0xd0006ec3 BIT_MASK 0x8 /end MEASUREMENT
/begin MEASUREMENT St_mareg.B_mareghub1 "Bedingung Regler Hub freigegeben" UBYTE _CNV_S_2_Def_bit_ub_700_CM 1 100. 0. 1. DISPLAY_IDENTIFIER B_MAREGHUB1 ECU_ADDRESS 0xd0006ec3 BIT_MASK 0x1 /end MEASUREMENT
/begin MEASUREMENT St_mareg.B_mareghub2 "Bedingung KNN Hub freigegeben" UBYTE _CNV_S_2_Def_bit_ub_701_CM 1 100. 0. 2. DISPLAY_IDENTIFIER B_MAREGHUB2 ECU_ADDRESS 0xd0006ec3 BIT_MASK 0x2 /end MEASUREMENT
/begin MEASUREMENT St_mareg.B_mradon "Bedingung KNN Adaption freigegeben" UBYTE _CNV_S_2_Def_bit_ub_704_CM 1 100. 0. 16. DISPLAY_IDENTIFIER B_MRADON ECU_ADDRESS 0xd0006ec3 BIT_MASK 0x10 /end MEASUREMENT
/begin MEASUREMENT St_mareg.B_mron "Bedingung MR freigegeben" UBYTE _CNV_S_2_Def_bit_ub_705_CM 1 100. 0. 32. DISPLAY_IDENTIFIER B_MRON ECU_ADDRESS 0xd0006ec3 BIT_MASK 0x20 /end MEASUREMENT
/begin MEASUREMENT St_mareg_lim "Statusbyte EISY_MR Limitierung" UBYTE _CNV_R_R_Def_dez_sl_575_CM 1 100. 0. 255. DISPLAY_IDENTIFIER ST_MAREG_LIM ECU_ADDRESS 0xd0006ed8 FORMAT "%3.0" /end MEASUREMENT
/begin MEASUREMENT St_mareg_lim.B_mareg_dkmn "Bedingung KNN Drosselklappe MIN" UBYTE _CNV_S_2_Def_bit_ub_702_CM 1 100. 0. 4. DISPLAY_IDENTIFIER B_MAREG_DKMN ECU_ADDRESS 0xd0006ed8 BIT_MASK 0x4 /end MEASUREMENT
/begin MEASUREMENT St_mareg_lim.B_mareg_dkmx "Bedingung KNN Drosselklappe MAX" UBYTE _CNV_S_2_Def_bit_ub_703_CM 1 100. 0. 8. DISPLAY_IDENTIFIER B_MAREG_DKMX ECU_ADDRESS 0xd0006ed8 BIT_MASK 0x8 /end MEASUREMENT
/begin MEASUREMENT St_mareg_lim.B_mareg_vvtmn "Bedingung KNN Hub MIN" UBYTE _CNV_S_2_Def_bit_ub_700_CM 1 100. 0. 1. DISPLAY_IDENTIFIER B_MAREG_VVTMN ECU_ADDRESS 0xd0006ed8 BIT_MASK 0x1 /end MEASUREMENT
/begin MEASUREMENT St_mareg_lim.B_mareg_vvtmx "Bedingung KNN Hub MAX" UBYTE _CNV_S_2_Def_bit_ub_701_CM 1 100. 0. 2. DISPLAY_IDENTIFIER B_MAREG_VVTMX ECU_ADDRESS 0xd0006ed8 BIT_MASK 0x2 /end MEASUREMENT
/begin MEASUREMENT St_mareg_puls "Statusbyte Ausblenden HFM-Pulsationen" UBYTE _CNV_R_R_Def_dez_sl_575_CM 1 100. 0. 255. DISPLAY_IDENTIFIER ST_MAREG_PULS ECU_ADDRESS 0xd0006ec0 FORMAT "%3.0" /end MEASUREMENT
/begin MEASUREMENT St_mareg_puls.B_hfm_dkerr2pot "Statusbyte Ausblenden HFM-Pulsationen" UBYTE _CNV_S_2_Def_bit_ub_704_CM 1 100. 0. 16. DISPLAY_IDENTIFIER B_HFM_DKERR2POT ECU_ADDRESS 0xd0006ec0 BIT_MASK 0x10 /end MEASUREMENT
/begin MEASUREMENT St_mareg_puls.B_hfmpuls "Statusbyte Ausblenden HFM-Pulsationen" UBYTE _CNV_S_2_Def_bit_ub_700_CM 1 100. 0. 1. DISPLAY_IDENTIFIER B_HFMPULS ECU_ADDRESS 0xd0006ec0 BIT_MASK 0x1 /end MEASUREMENT
/begin MEASUREMENT St_mareg_puls.B_hfmpuls1 "Statusbyte Ausblenden HFM-Pulsationen" UBYTE _CNV_S_2_Def_bit_ub_701_CM 1 100. 0. 2. DISPLAY_IDENTIFIER B_HFMPULS1 ECU_ADDRESS 0xd0006ec0 BIT_MASK 0x2 /end MEASUREMENT
/begin MEASUREMENT St_mareg_puls.B_hfmpuls2 "Statusbyte Ausblenden HFM-Pulsationen" UBYTE _CNV_S_2_Def_bit_ub_702_CM 1 100. 0. 4. DISPLAY_IDENTIFIER B_HFMPULS2 ECU_ADDRESS 0xd0006ec0 BIT_MASK 0x4 /end MEASUREMENT
/begin MEASUREMENT St_mareg_puls.B_hfmpuls3 "Statusbyte Ausblenden HFM-Pulsationen" UBYTE _CNV_S_2_Def_bit_ub_703_CM 1 100. 0. 8. DISPLAY_IDENTIFIER B_HFMPULS3 ECU_ADDRESS 0xd0006ec0 BIT_MASK 0x8 /end MEASUREMENT
/begin MEASUREMENT St_modab "Statusbyte MODAB regler" UBYTE _CNV_R_R_Def_dez_sl_575_CM 1 100. 0. 255. DISPLAY_IDENTIFIER ST_MODAB ECU_ADDRESS 0xd0006ec1 FORMAT "%3.0" /end MEASUREMENT
/begin MEASUREMENT St_modab.B_eisy_clrad "Statusbyte MODAB regler" UBYTE _CNV_S_2_Def_bit_ub_706_CM 1 100. 0. 64. DISPLAY_IDENTIFIER B_EISY_CLRAD ECU_ADDRESS 0xd0006ec1 BIT_MASK 0x40 /end MEASUREMENT
/begin MEASUREMENT St_modab.B_llk_mr "Statusbyte MODAB regler" UBYTE _CNV_S_2_Def_bit_ub_705_CM 1 100. 0. 32. DISPLAY_IDENTIFIER B_LLK_MR ECU_ADDRESS 0xd0006ec1 BIT_MASK 0x20 /end MEASUREMENT
/begin MEASUREMENT St_modab.B_modab_on "MODAB regler aktiviert" UBYTE _CNV_S_2_Def_bit_ub_700_CM 1 100. 0. 1. DISPLAY_IDENTIFIER B_MODAB_ON ECU_ADDRESS 0xd0006ec1 BIT_MASK 0x1 /end MEASUREMENT
/begin MEASUREMENT St_modab.B_modab_zul "MODAB regler zulässig" UBYTE _CNV_S_2_Def_bit_ub_701_CM 1 100. 0. 2. DISPLAY_IDENTIFIER B_MODAB_ZUL ECU_ADDRESS 0xd0006ec1 BIT_MASK 0x2 /end MEASUREMENT
/begin MEASUREMENT St_modab.B_startende_verz "Statusbyte MODAB regler" UBYTE _CNV_S_2_Def_bit_ub_707_CM 1 100. 0. 128. DISPLAY_IDENTIFIER B_STARTENDE_VERZ ECU_ADDRESS 0xd0006ec1 BIT_MASK 0x80 /end MEASUREMENT
/begin MEASUREMENT St_modab.B_timsallv "Statusbyte MODAB regler" UBYTE _CNV_S_2_Def_bit_ub_704_CM 1 100. 0. 16. DISPLAY_IDENTIFIER B_TIMSALLV ECU_ADDRESS 0xd0006ec1 BIT_MASK 0x10 /end MEASUREMENT
/begin MEASUREMENT St_modab.B_timsavvt "Statusbyte MODAB regler" UBYTE _CNV_S_2_Def_bit_ub_703_CM 1 100. 0. 8. DISPLAY_IDENTIFIER B_TIMSAVVT ECU_ADDRESS 0xd0006ec1 BIT_MASK 0x8 /end MEASUREMENT
/begin MEASUREMENT St_modab.B_timsvvt "Statusbyte MODAB regler" UBYTE _CNV_S_2_Def_bit_ub_702_CM 1 100. 0. 4. DISPLAY_IDENTIFIER B_TIMSVVT ECU_ADDRESS 0xd0006ec1 BIT_MASK 0x4 /end MEASUREMENT
/begin MEASUREMENT St_modab2 "Statusbyte2 MODAB regler" UBYTE _CNV_R_R_Def_dez_sl_575_CM 1 100. 0. 255. DISPLAY_IDENTIFIER ST_MODAB2 ECU_ADDRESS 0xd0006ec2 FORMAT "%3.0" /end MEASUREMENT
/begin MEASUREMENT St_modab2.B_modab_off "Statusbyte2 MODAB regler" UBYTE _CNV_S_2_Def_bit_ub_700_CM 1 100. 0. 1. DISPLAY_IDENTIFIER B_MODAB_OFF ECU_ADDRESS 0xd0006ec2 BIT_MASK 0x1 /end MEASUREMENT
/begin MEASUREMENT St_modab2.B_modabst_on "Statusbyte2 MODAB regler" UBYTE _CNV_S_2_Def_bit_ub_701_CM 1 100. 0. 2. DISPLAY_IDENTIFIER B_MODABST_ON ECU_ADDRESS 0xd0006ec2 BIT_MASK 0x2 /end MEASUREMENT
/begin MEASUREMENT St_modab2.B_mradonte "Statusbyte2 MODAB regler" UBYTE _CNV_S_2_Def_bit_ub_702_CM 1 100. 0. 4. DISPLAY_IDENTIFIER B_MRADONTE ECU_ADDRESS 0xd0006ec2 BIT_MASK 0x4 /end MEASUREMENT
/begin MEASUREMENT St_oz_o "Statuswort" UBYTE _CNV_R_R_Def_dez_sl_575_CM 1 100. 0. 255. DISPLAY_IDENTIFIER ST_OZ_O ECU_ADDRESS 0xd0006b16 FORMAT "%3.0" /end MEASUREMENT
/begin MEASUREMENT St_oz_o.B_mol_sf "Sensorfehler in FS eingetragen für CC-Meldung" UBYTE _CNV_S_2_Def_bit_ub_701_CM 1 100. 0. 2. DISPLAY_IDENTIFIER B_MOL_SF ECU_ADDRESS 0xd0006b16 BIT_MASK 0x2 /end MEASUREMENT
/begin MEASUREMENT St_oz_o.B_oztemic "QLT-Temic verbaut" UBYTE _CNV_S_2_Def_bit_ub_700_CM 1 100. 0. 1. DISPLAY_IDENTIFIER B_OZTEMIC ECU_ADDRESS 0xd0006b16 BIT_MASK 0x1 /end MEASUREMENT
/begin MEASUREMENT St_stend_verz "Statusbyte" UBYTE _CNV_R_R_Def_dez_sl_575_CM 1 100. 0. 255. DISPLAY_IDENTIFIER ST_STEND_VERZ ECU_ADDRESS 0xd0006d04 FORMAT "%3.0" /end MEASUREMENT
/begin MEASUREMENT St_stend_verz.B_startende_rfvst "B_startende verzörgert" UBYTE _CNV_S_2_Def_bit_ub_700_CM 1 100. 0. 1. DISPLAY_IDENTIFIER B_STARTENDE_RFVST ECU_ADDRESS 0xd0006d04 BIT_MASK 0x1 /end MEASUREMENT
/begin MEASUREMENT St_vsa "Nockenwellenflanke Auslasssspreizung > 720° KW" UBYTE _CNV_R_R_Def_dez_sl_575_CM 1 100. 0. 255. DISPLAY_IDENTIFIER ST_VSA ECU_ADDRESS 0xc0004731 FORMAT "%3.0" /end MEASUREMENT
/begin MEASUREMENT St_vsa.B_npos1dyn "Nockenwellenflanke Auslasssspreizung > 720° KW" UBYTE _CNV_S_2_Def_bit_ub_707_CM 1 100. 0. 128. DISPLAY_IDENTIFIER B_NPOS1DYN ECU_ADDRESS 0xc0004731 BIT_MASK 0x80 /end MEASUREMENT
/begin MEASUREMENT St_vsa.B_vsaadnok "Anschlagadaption Auslassvanos nach Powerfail nicht erfolgt" UBYTE _CNV_S_2_Def_bit_ub_704_CM 1 100. 0. 16. DISPLAY_IDENTIFIER B_VSAADNOK ECU_ADDRESS 0xc0004731 BIT_MASK 0x10 /end MEASUREMENT
/begin MEASUREMENT St_vsa.B_vsaadok "Anschlagadaptionstimer Auslassvanos > K_VNS_ADEND" UBYTE _CNV_S_2_Def_bit_ub_706_CM 1 100. 0. 64. DISPLAY_IDENTIFIER B_VSAADOK ECU_ADDRESS 0xc0004731 BIT_MASK 0x40 /end MEASUREMENT
/begin MEASUREMENT St_vsa.B_vsaadp "Status Anschlagadaption Auslassspreizung variable NWS" UBYTE _CNV_S_2_Def_bit_ub_700_CM 1 100. 0. 1. DISPLAY_IDENTIFIER B_VSAADP ECU_ADDRESS 0xc0004731 BIT_MASK 0x1 /end MEASUREMENT
/begin MEASUREMENT St_vsa.B_vsadyn "Dynamikbegrenzung Auslassnockenwelle aktiv" UBYTE _CNV_S_2_Def_bit_ub_703_CM 1 100. 0. 8. DISPLAY_IDENTIFIER B_VSADYN ECU_ADDRESS 0xc0004731 BIT_MASK 0x8 /end MEASUREMENT
/begin MEASUREMENT St_vsa.B_vsaflan "Nockenwellenflanke Auslassspreizung variable NWS" UBYTE _CNV_S_2_Def_bit_ub_705_CM 1 100. 0. 32. DISPLAY_IDENTIFIER B_VSAFLAN ECU_ADDRESS 0xc0004731 BIT_MASK 0x20 /end MEASUREMENT
/begin MEASUREMENT St_vsa.B_vsanwerr "Fehler Auslassnockenwellenposition in der HW-Schale" UBYTE _CNV_S_2_Def_bit_ub_701_CM 1 100. 0. 2. DISPLAY_IDENTIFIER B_VSANWERR ECU_ADDRESS 0xc0004731 BIT_MASK 0x2 /end MEASUREMENT
/begin MEASUREMENT St_vsa.B_vsaspran "Istspreizung Auslassnockenwelle wird begrenzt" UBYTE _CNV_S_2_Def_bit_ub_702_CM 1 100. 0. 4. DISPLAY_IDENTIFIER B_VSASPRAN ECU_ADDRESS 0xc0004731 BIT_MASK 0x4 /end MEASUREMENT
/begin MEASUREMENT St_vse "Statuswort Einlassvanos" UBYTE _CNV_R_R_Def_dez_sl_575_CM 1 100. 0. 255. DISPLAY_IDENTIFIER ST_VSE ECU_ADDRESS 0xc0004730 FORMAT "%3.0" /end MEASUREMENT
/begin MEASUREMENT St_vse.B_npos0dyn "Nockenwellenflanke Einlasssspreizung > 720° KW" UBYTE _CNV_S_2_Def_bit_ub_707_CM 1 100. 0. 128. DISPLAY_IDENTIFIER B_NPOS0DYN ECU_ADDRESS 0xc0004730 BIT_MASK 0x80 /end MEASUREMENT
/begin MEASUREMENT St_vse.B_vseadnok "Anschlagadaption Einlassvanos nach Powerfail nicht erfolgt" UBYTE _CNV_S_2_Def_bit_ub_704_CM 1 100. 0. 16. DISPLAY_IDENTIFIER B_VSEADNOK ECU_ADDRESS 0xc0004730 BIT_MASK 0x10 /end MEASUREMENT
/begin MEASUREMENT St_vse.B_vseadok "Anschlagadaptionstimer Einlassvanos > K_VNS_ADEND" UBYTE _CNV_S_2_Def_bit_ub_706_CM 1 100. 0. 64. DISPLAY_IDENTIFIER B_VSEADOK ECU_ADDRESS 0xc0004730 BIT_MASK 0x40 /end MEASUREMENT
/begin MEASUREMENT St_vse.B_vseadp "Status Anschlagadaption Einlassspreizung variable NWS" UBYTE _CNV_S_2_Def_bit_ub_700_CM 1 100. 0. 1. DISPLAY_IDENTIFIER B_VSEADP ECU_ADDRESS 0xc0004730 BIT_MASK 0x1 /end MEASUREMENT
/begin MEASUREMENT St_vse.B_vsedyn "Dynamikbegrenzung Einlassnockenwelle aktiv" UBYTE _CNV_S_2_Def_bit_ub_703_CM 1 100. 0. 8. DISPLAY_IDENTIFIER B_VSEDYN ECU_ADDRESS 0xc0004730 BIT_MASK 0x8 /end MEASUREMENT
/begin MEASUREMENT St_vse.B_vseflan "Nockenwellenflanke Einlassspreizung variable NWS" UBYTE _CNV_S_2_Def_bit_ub_705_CM 1 100. 0. 32. DISPLAY_IDENTIFIER B_VSEFLAN ECU_ADDRESS 0xc0004730 BIT_MASK 0x20 /end MEASUREMENT
/begin MEASUREMENT St_vse.B_vsenwerr "Fehler Einlassnockenwellenposition in der HW-Schale" UBYTE _CNV_S_2_Def_bit_ub_701_CM 1 100. 0. 2. DISPLAY_IDENTIFIER B_VSENWERR ECU_ADDRESS 0xc0004730 BIT_MASK 0x2 /end MEASUREMENT
/begin MEASUREMENT St_vse.B_vsespran "Istspreizung Einlassnockenwelle wird begrenzt" UBYTE _CNV_S_2_Def_bit_ub_702_CM 1 100. 0. 4. DISPLAY_IDENTIFIER B_VSESPRAN ECU_ADDRESS 0xc0004730 BIT_MASK 0x4 /end MEASUREMENT
/begin MEASUREMENT St_wdkdiag "Statuswort" UBYTE _CNV_R_R_Def_dez_sl_575_CM 1 100. 0. 255. DISPLAY_IDENTIFIER ST_WDKDIAG ECU_ADDRESS 0xc0001a84 FORMAT "%3.0" /end MEASUREMENT
/begin MEASUREMENT St_wdkdiag.B_wdkdiag_ugd "Statuswort" UBYTE _CNV_S_2_Def_bit_ub_701_CM 1 100. 0. 2. DISPLAY_IDENTIFIER B_WDKDIAG_UGD ECU_ADDRESS 0xc0001a84 BIT_MASK 0x2 /end MEASUREMENT
/begin MEASUREMENT T_systemvns "Zeitstempel für Vanos" ULONG _CNV_R_R_Def_td_ul__720_CM 1 100. 0. 4294967295. DISPLAY_IDENTIFIER T_SYSTEMVNS ECU_ADDRESS 0xd00079a4 FORMAT "%7.0" /end MEASUREMENT
/begin MEASUREMENT Td_mszylpt1 "Zeitkonstante PT1-Glied" UWORD _CNV_R_R_Def_zk10ms_723_CM 1 100. 1.e-002 655.36 DISPLAY_IDENTIFIER TD_MSZYLPT1 ECU_ADDRESS 0xc0001ab6 FORMAT "%9.4" /end MEASUREMENT
/begin MEASUREMENT Uefl_spuel "Überschneidungsfläche, Ueberspuel" UWORD _CNV_R_R_Def_a_uw_q_736_CM 1 100. 0. 1048.56 DISPLAY_IDENTIFIER UEFL_SPUEL ECU_ADDRESS 0xd0006df4 FORMAT "%8.3" /end MEASUREMENT
/begin MEASUREMENT Uefl_uk "Überschneidungsfläche, Unterkritisches" UWORD _CNV_R_R_Def_a_uw_q_736_CM 1 100. 0. 1048.56 DISPLAY_IDENTIFIER UEFL_UK ECU_ADDRESS 0xd0006df2 FORMAT "%8.3" /end MEASUREMENT
/begin MEASUREMENT Vnsfaktmot "ausgegebenes variables NWS Tastverhaeltnis Tmot-abhaengig" UBYTE _CNV_R_R_Def_f_ub_b_625_CM 1 100. 0. 1.9921 DISPLAY_IDENTIFIER VNSFAKTMOT ECU_ADDRESS 0xd00078f1 /end MEASUREMENT
/begin MEASUREMENT Vnsfaktvub "ausgegebenes variables NWS Tastverhaeltnis ub-abhaengig" UBYTE _CNV_R_R_Def_f_ub_b_625_CM 1 100. 0. 1.9921 DISPLAY_IDENTIFIER VNSFAKTVUB ECU_ADDRESS 0xd00078f0 /end MEASUREMENT
/begin MEASUREMENT Vsa_adp "Adaptionswert Anschlag Auslassspreizung variable NWS" UWORD _CNV_R_R_Def_spr_sw_583_CM 1 100. 0. 6553.5 DISPLAY_IDENTIFIER VSA_ADP ECU_ADDRESS 0xc000472e FORMAT "%7.2" /end MEASUREMENT
/begin MEASUREMENT Vsa_adp_fl "Flankenindividuelle Adaption Auslassspreizung variable NWS" SBYTE _CNV_R_R_Def_spr_sb_740_CM 1 100. -6.4 6.35 DISPLAY_IDENTIFIER VSA_ADP_FL ECU_ADDRESS 0xc0004728 FORMAT "%5.2" ARRAY_SIZE 4 MATRIX_DIM 4 1 1 /end MEASUREMENT
/begin MEASUREMENT Vsa_spri "Istwert Auslassspreizung variable NWS" UWORD _CNV_R_R_Def_spr_sw_583_CM 1 100. 0. 6553.5 DISPLAY_IDENTIFIER VSA_SPRI ECU_ADDRESS 0xd0007996 FORMAT "%7.2" /end MEASUREMENT
/begin MEASUREMENT Vsa_spri_m "Mittelwert Auslassspreizung variable NWS, Bank1/2" UWORD _CNV_R_R_Def_spr_sw_583_CM 1 100. 0. 6553.5 DISPLAY_IDENTIFIER VSA_SPRI_M ECU_ADDRESS 0xd0006dfa FORMAT "%7.2" /end MEASUREMENT
/begin MEASUREMENT Vsa_sprs "Sollwert Auslassspreizung variable NWS" UWORD _CNV_R_R_Def_spr_sw_583_CM 1 100. 0. 6553.5 DISPLAY_IDENTIFIER VSA_SPRS ECU_ADDRESS 0xd00078ec FORMAT "%7.2" /end MEASUREMENT
/begin MEASUREMENT Vsa_tv "Tastverhaeltnis Auslassspreizung variable NWS" UWORD _CNV_R_R_Def_rf_sw__616_CM 1 100. 0. 655.35 DISPLAY_IDENTIFIER VSA_TV ECU_ADDRESS 0xd00078ee FORMAT "%7.2" /end MEASUREMENT
/begin MEASUREMENT Vsa_tv_i "Reglerausgang I-Regler Auslassspreizung variable NWS" UWORD _CNV_R_R_Def_rel_uw_742_CM 1 100. -100. 99.9969 DISPLAY_IDENTIFIER VSA_TV_I ECU_ADDRESS 0xd00078fe FORMAT "%8.3" /end MEASUREMENT
/begin MEASUREMENT Vsa_tv_p "Reglerausgang P-Regler Auslassspreizung variable NWS" UWORD _CNV_R_R_Def_rel_uw_742_CM 1 100. -100. 99.9969 DISPLAY_IDENTIFIER VSA_TV_P ECU_ADDRESS 0xd0007900 FORMAT "%8.3" /end MEASUREMENT
/begin MEASUREMENT Vsa_vg "Verstellgeschwindigkeit Auslassspreizung variable NWS" SWORD _CNV_R_R_Def_vg_sw__743_CM 1 100. -25600. 25599.2187 DISPLAY_IDENTIFIER VSA_VG ECU_ADDRESS 0xd00079a0 FORMAT "%7.2" /end MEASUREMENT
/begin MEASUREMENT Vsadwnwkl "Delta Kennlinie Auslassspreizung variable NWS" UWORD _CNV_R_R_Def_spr_uw_744_CM 1 100. -3276.8 3276.7 DISPLAY_IDENTIFIER VSADWNWKL ECU_ADDRESS 0xd00078fa FORMAT "%7.2" /end MEASUREMENT
/begin MEASUREMENT Vsadwnwv "Delta Kennlinie Auslassspreizung variable NWS" UWORD _CNV_R_R_Def_spr_uw_744_CM 1 100. -3276.8 3276.7 DISPLAY_IDENTIFIER VSADWNWV ECU_ADDRESS 0xd00078fc FORMAT "%7.2" /end MEASUREMENT
/begin MEASUREMENT Vsaspris "geschaetzter Istwert Auslassspreizung variable NWS" UWORD _CNV_R_R_Def_spr_sw_583_CM 1 100. 0. 6553.5 DISPLAY_IDENTIFIER VSASPRIS ECU_ADDRESS 0xd00079a2 FORMAT "%7.2" /end MEASUREMENT
/begin MEASUREMENT Vse_adp "Adaptionswert Anschlag Einlassspreizung variable NWS" UWORD _CNV_R_R_Def_spr_sw_583_CM 1 100. 0. 6553.5 DISPLAY_IDENTIFIER VSE_ADP ECU_ADDRESS 0xc000472c FORMAT "%7.2" /end MEASUREMENT
/begin MEASUREMENT Vse_adp_fl "Flankenindividuelle Adaption Einlassspreizung variable NWS" SBYTE _CNV_R_R_Def_spr_sb_740_CM 1 100. -6.4 6.35 DISPLAY_IDENTIFIER VSE_ADP_FL ECU_ADDRESS 0xc0004724 FORMAT "%5.2" ARRAY_SIZE 4 MATRIX_DIM 4 1 1 /end MEASUREMENT
/begin MEASUREMENT Vse_spri "Istwert Einlassspreizung variable NWS" UWORD _CNV_R_R_Def_spr_sw_583_CM 1 100. 0. 6553.5 DISPLAY_IDENTIFIER VSE_SPRI ECU_ADDRESS 0xd0007994 FORMAT "%7.2" /end MEASUREMENT
/begin MEASUREMENT Vse_spri_m "Mittelwert Einlassspreizung variable NWS, Bank1/2" UWORD _CNV_R_R_Def_spr_sw_583_CM 1 100. 0. 6553.5 DISPLAY_IDENTIFIER VSE_SPRI_M ECU_ADDRESS 0xd0006df8 FORMAT "%7.2" /end MEASUREMENT
/begin MEASUREMENT Vse_sprs "Sollwert Einlassspreizung variable NWS" UWORD _CNV_R_R_Def_spr_sw_583_CM 1 100. 0. 6553.5 DISPLAY_IDENTIFIER VSE_SPRS ECU_ADDRESS 0xd00078e8 FORMAT "%7.2" /end MEASUREMENT
/begin MEASUREMENT Vse_tv "Tastverhaeltnis Einlassspreizung variable NWS" UWORD _CNV_R_R_Def_rf_sw__616_CM 1 100. 0. 655.35 DISPLAY_IDENTIFIER VSE_TV ECU_ADDRESS 0xd00078ea FORMAT "%7.2" /end MEASUREMENT
/begin MEASUREMENT Vse_tv_i "Reglerausgang I-Regler Einlassspreizung variable NWS" UWORD _CNV_R_R_Def_rel_uw_742_CM 1 100. -100. 99.9969 DISPLAY_IDENTIFIER VSE_TV_I ECU_ADDRESS 0xd00078f6 FORMAT "%8.3" /end MEASUREMENT
/begin MEASUREMENT Vse_tv_p "Reglerausgang P-Regler Einlassspreizung variable NWS" UWORD _CNV_R_R_Def_rel_uw_742_CM 1 100. -100. 99.9969 DISPLAY_IDENTIFIER VSE_TV_P ECU_ADDRESS 0xd00078f8 FORMAT "%8.3" /end MEASUREMENT
/begin MEASUREMENT Vse_vg "Verstellgeschwindigkeit Einlassspreizung variable NWS" SWORD _CNV_R_R_Def_vg_sw__743_CM 1 100. -25600. 25599.2187 DISPLAY_IDENTIFIER VSE_VG ECU_ADDRESS 0xd000799c FORMAT "%7.2" /end MEASUREMENT
/begin MEASUREMENT Vsedwnwkl "Delta Kennlinie Einlassspreizung variable NWS" UWORD _CNV_R_R_Def_spr_uw_744_CM 1 100. -3276.8 3276.7 DISPLAY_IDENTIFIER VSEDWNWKL ECU_ADDRESS 0xd00078f2 FORMAT "%7.2" /end MEASUREMENT
/begin MEASUREMENT Vsedwnwv "Delta Kennlinie Einlaspreizung variable NWS" UWORD _CNV_R_R_Def_spr_uw_744_CM 1 100. -3276.8 3276.7 DISPLAY_IDENTIFIER VSEDWNWV ECU_ADDRESS 0xd00078f4 FORMAT "%7.2" /end MEASUREMENT
/begin MEASUREMENT Vsespris "geschaetzter Istwert Einlassspreizung variable NWS" UWORD _CNV_R_R_Def_spr_sw_583_CM 1 100. 0. 6553.5 DISPLAY_IDENTIFIER VSESPRIS ECU_ADDRESS 0xd000799e FORMAT "%7.2" /end MEASUREMENT
/begin MEASUREMENT Vvtaus_timer "DK-VVT Adaptionsumschaltungstimer" UBYTE _CNV_R_R_Def_dez_sl_575_CM 1 100. 0. 255. DISPLAY_IDENTIFIER VVTAUS_TIMER ECU_ADDRESS 0xd0006edc FORMAT "%3.0" /end MEASUREMENT
/begin MEASUREMENT Wdk_diag "Aus Hauptfüllungssignal berechneter Drosselklappenwinkel" UWORD _CNV_R_R_Def_wdk_sw_691_CM 1 100. 0. 1599.9755 DISPLAY_IDENTIFIER WDK_DIAG ECU_ADDRESS 0xc0001a86 FORMAT "%7.2" /end MEASUREMENT
/begin MEASUREMENT Wdk_ug "Drosselklappe winkel UG" UWORD _CNV_R_R_Def_wdk_sw_691_CM 1 100. 0. 1599.9755 DISPLAY_IDENTIFIER WDK_UG ECU_ADDRESS 0xd0006da6 FORMAT "%7.2" /end MEASUREMENT
/begin MEASUREMENT Z_norm_dk "" FLOAT32_IEEE _CNV_R_R_Def_dez_sl_575_CM 1 100. -1000000000000. 10000000000000. DISPLAY_IDENTIFIER Z_NORM_DK ECU_ADDRESS 0xc0001b2c FORMAT "%14.7" ARRAY_SIZE 15 MATRIX_DIM 15 1 1 /end MEASUREMENT
/begin MEASUREMENT Zk_diag_mss "Zeitkonstante zur Filterung Diagnoseschwellen Massenstrom" UWORD _CNV_R_R_Def_zk100m_749_CM 1 100. 0.1 6553.6 DISPLAY_IDENTIFIER ZK_DIAG_MSS ECU_ADDRESS 0xc0001ad8 FORMAT "%6.1" /end MEASUREMENT
/begin MEASUREMENT w_dknn_N "" FLOAT32_IEEE _CNV_R_R_Def_dez_sl_575_CM 1 100. -1000000000000. 10000000000000. DISPLAY_IDENTIFIER W_DKNN_N ECU_ADDRESS 0xc0004220 FORMAT "%14.7" ARRAY_SIZE 15 MATRIX_DIM 15 1 1 /end MEASUREMENT
/begin MEASUREMENT w_dknn_Vsa_spri "" FLOAT32_IEEE _CNV_R_R_Def_dez_sl_575_CM 1 100. -1000000000000. 10000000000000. DISPLAY_IDENTIFIER W_DKNN_VSA_SPRI ECU_ADDRESS 0xc0004298 FORMAT "%14.7" ARRAY_SIZE 15 MATRIX_DIM 15 1 1 /end MEASUREMENT
/begin MEASUREMENT w_dknn_Vse_spri "" FLOAT32_IEEE _CNV_R_R_Def_dez_sl_575_CM 1 100. -1000000000000. 10000000000000. DISPLAY_IDENTIFIER W_DKNN_VSE_SPRI ECU_ADDRESS 0xc000425c FORMAT "%14.7" ARRAY_SIZE 15 MATRIX_DIM 15 1 1 /end MEASUREMENT
/begin MEASUREMENT w_dknn_Wdk_ist "" FLOAT32_IEEE _CNV_R_R_Def_dez_sl_575_CM 1 100. -1000000000000. 10000000000000. DISPLAY_IDENTIFIER W_DKNN_WDK_IST ECU_ADDRESS 0xc00042d4 FORMAT "%14.7" ARRAY_SIZE 15 MATRIX_DIM 15 1 1 /end MEASUREMENT
/begin MEASUREMENT w_dknn_bias "" FLOAT32_IEEE _CNV_R_R_Def_dez_sl_575_CM 1 100. -1000000000000. 10000000000000. DISPLAY_IDENTIFIER W_DKNN_BIAS ECU_ADDRESS 0xc00041e4 FORMAT "%14.7" ARRAY_SIZE 15 MATRIX_DIM 15 1 1 /end MEASUREMENT
/begin AXIS_PTS GAX_15MODELLE "Modelle eines LOLIMOT-KNN mit 15 Neuronen (Zähler)" 0xa10126b0 Modelle _REC_AXS_20_u1 255. _CNV_R_R_Def_dez_sl_575_CM 15 0. 255. FORMAT "%3.0" /end AXIS_PTS
/begin AXIS_PTS GAX_6MODELLE "Modelle eines LOLIMOT-KNN mit 6 Neuronen (Zähler)" 0xa10126c4 Modelle _REC_AXS_20_u1 255. _CNV_R_R_Def_dez_sl_575_CM 6 0. 255. FORMAT "%3.0" /end AXIS_PTS
/begin AXIS_PTS GAX_PIRGNN "Neuronen des PIRG NN-MLP" 0xa10119ac Modelle _REC_AXS_20_u1 255. _CNV_R_R_Def_dez_sl_575_CM 20 0. 255. FORMAT "%3.0" /end AXIS_PTS
/begin AXIS_PTS GAX_RFVISTNN "Neuronen des RFVISTNN-MLP" 0xa10114e4 Modelle _REC_AXS_20_u1 255. _CNV_R_R_Def_dez_sl_575_CM 20 0. 255. FORMAT "%3.0" /end AXIS_PTS
/begin CHARACTERISTIC CW_EAVNSKT "Codewort Konfiguration EAVNSKT" VALUE 0xa101e864 _REC_VAL_20_u1 99.45 _CNV_R_R_Def_dez_sl_575_CM 0. 255. FORMAT "%3.0" /end CHARACTERISTIC
/begin CHARACTERISTIC CW_EISY "Codeword Umschaltung EISY Modus" VALUE 0xa1011188 _REC_VAL_20_u1 99.45 _CNV_R_R_Def_dez_sl_575_CM 0. 255. FORMAT "%3.0" /end CHARACTERISTIC
/begin CHARACTERISTIC CW_EISYD_RUNTIME "Codewort zur LZ Optimierung" VALUE 0xa1012d42 _REC_VAL_20_u2 0. _CNV_R_R_Def_dez_sl_575_CM 0. 65535. FORMAT "%5.0" /end CHARACTERISTIC
/begin CHARACTERISTIC CW_EISY_DFSPE "Schaltet zwischen ent- und unentprellter FSP-Abfrage um" VALUE 0xa1012d48 _REC_VAL_20_u2 0. _CNV_R_R_Def_dez_sl_575_CM 0. 65535. FORMAT "%5.0" /end CHARACTERISTIC
/begin CHARACTERISTIC CW_EISY_DIAG "Aktiviert Freigabebedingungen Eisy-Diag" VALUE 0xa1012d44 _REC_VAL_20_u2 0. _CNV_R_R_Def_dez_sl_575_CM 0. 65535. FORMAT "%5.0" /end CHARACTERISTIC
/begin CHARACTERISTIC CW_EISY_DRBM "Aktiviert RBM Freigabebedingungen Eisy-Diag" VALUE 0xa1012d46 _REC_VAL_20_u2 0. _CNV_R_R_Def_dez_sl_575_CM 0. 65535. FORMAT "%5.0" /end CHARACTERISTIC
/begin CHARACTERISTIC CW_EISY_TGLE "Codeword Umschaltung EISY-Laufzeit-Modus" VALUE 0xa1011189 _REC_VAL_20_u1 99.45 _CNV_R_R_Def_dez_sl_575_CM 0. 255. FORMAT "%3.0" /end CHARACTERISTIC
/begin CHARACTERISTIC CW_EISY_TURBO "Turbo Berechnung" VALUE 0xa10113b4 _REC_VAL_20_u1 99.45 _CNV_R_R_Def_dez_sl_575_CM 0. 255. FORMAT "%3.0" /end CHARACTERISTIC
/begin CHARACTERISTIC CW_MPR_KOORD "Codeword Umschaltung PSREG MAREG zwischen DI/TURBO und VVT" VALUE 0xa101118a _REC_VAL_20_u1 99.45 _CNV_R_R_Def_dez_sl_575_CM 0. 255. FORMAT "%3.0" /end CHARACTERISTIC
/begin CHARACTERISTIC CW_TZKBLS "(0: F_tvdk) (1: Ftev) (else: Ftbr_kor)" VALUE 0xa101141f _REC_VAL_20_u1 99.45 _CNV_R_R_Def_dez_sl_575_CM 0. 255. FORMAT "%3.0" /end CHARACTERISTIC
/begin CHARACTERISTIC CW_TZYLKOR "(0: F_tvdk) (1: Ftev) (else: Ftbr)" VALUE 0xa101141e _REC_VAL_20_u1 99.45 _CNV_R_R_Def_dez_sl_575_CM 0. 255. FORMAT "%3.0" /end CHARACTERISTIC
/begin CHARACTERISTIC CW_VNSABST "Verhinderung der Verriegelung durch Abstand vom Anschlag" VALUE 0xa101d200 _REC_VAL_20_u1 99.45 _CNV_R_R_Def_dez_sl_575_CM 0. 255. FORMAT "%3.0" /end CHARACTERISTIC
/begin CHARACTERISTIC CW_VNSDYN "Verhinderung der Verriegelung durch adapt. Druckvorsteuerung" VALUE 0xa101d1ff _REC_VAL_20_u1 99.45 _CNV_R_R_Def_dez_sl_575_CM 0. 255. FORMAT "%3.0" /end CHARACTERISTIC
/begin CHARACTERISTIC KF_DIAGDPSRD_O "Obere Diagnose-Schwelle DPSR: Delta zu K_PSREGMN" MAP 0xa1012f0c _REC_MAP_52_UBYTE_s2_s2_s2 7.999800000000001 _CNV_R_R_Def_f_sw_b_606_CM -4. 3.9998 FORMAT "%7.4"
 /begin AXIS_DESCR STD_AXIS Nkw _CNV_R_R_Def_n_sw_q_612_CM 4 -32768. 32767. FORMAT "%5.0" /end AXIS_DESCR
 /begin AXIS_DESCR STD_AXIS Rf_soll _CNV_R_R_Def_rf_sw__616_CM 4 -327.68 327.67 FORMAT "%7.4" /end AXIS_DESCR
/end CHARACTERISTIC
/begin CHARACTERISTIC KF_DIAGDPSRD_U "Untere Diagnose-Schwelle DPSR: Delta zu K_PSREGMN" MAP 0xa1012ed8 _REC_MAP_52_UBYTE_s2_s2_s2 7.999800000000001 _CNV_R_R_Def_f_sw_b_606_CM -4. 3.9998 FORMAT "%7.4"
 /begin AXIS_DESCR STD_AXIS Nkw _CNV_R_R_Def_n_sw_q_612_CM 4 -32768. 32767. FORMAT "%5.0" /end AXIS_DESCR
 /begin AXIS_DESCR STD_AXIS Rf_soll _CNV_R_R_Def_rf_sw__616_CM 4 -327.68 327.67 FORMAT "%7.4" /end AXIS_DESCR
/end CHARACTERISTIC
/begin CHARACTERISTIC KF_DIAG_MSO "Maximaler Massenstrom" MAP 0xa1012e08 _REC_MAP_52_UBYTE_u2_s2_s2 1.9999 _CNV_R_R_Def_f_uw_b_579_CM 0. 1.9999 FORMAT "%14.5"
 /begin AXIS_DESCR STD_AXIS Nkw _CNV_R_R_Def_n_sw_q_612_CM 4 -32768. 32767. FORMAT "%5.0" /end AXIS_DESCR
 /begin AXIS_DESCR STD_AXIS Rf_soll _CNV_R_R_Def_rf_sw__616_CM 4 -327.68 327.67 FORMAT "%7.4" /end AXIS_DESCR
/end CHARACTERISTIC
/begin CHARACTERISTIC KF_DIAG_MSO2 "Maximaler Massenstrom" MAP 0xa1012e70 _REC_MAP_52_UBYTE_u2_s2_s2 1.9999 _CNV_R_R_Def_f_uw_b_579_CM 0. 1.9999 FORMAT "%14.5"
 /begin AXIS_DESCR STD_AXIS Nkw _CNV_R_R_Def_n_sw_q_612_CM 4 -32768. 32767. FORMAT "%5.0" /end AXIS_DESCR
 /begin AXIS_DESCR STD_AXIS Rf_soll _CNV_R_R_Def_rf_sw__616_CM 4 -327.68 327.67 FORMAT "%7.4" /end AXIS_DESCR
/end CHARACTERISTIC
/begin CHARACTERISTIC KF_DIAG_MSU "Minimaler Massenstrom" MAP 0xa1012dd4 _REC_MAP_52_UBYTE_u2_s2_s2 1.9999 _CNV_R_R_Def_f_uw_b_579_CM 0. 1.9999 FORMAT "%14.5"
 /begin AXIS_DESCR STD_AXIS Nkw _CNV_R_R_Def_n_sw_q_612_CM 4 -32768. 32767. FORMAT "%5.0" /end AXIS_DESCR
 /begin AXIS_DESCR STD_AXIS Rf_soll _CNV_R_R_Def_rf_sw__616_CM 4 -327.68 327.67 FORMAT "%7.4" /end AXIS_DESCR
/end CHARACTERISTIC
/begin CHARACTERISTIC KF_DIAG_MSU2 "Minimaler Massenstrom" MAP 0xa1012e3c _REC_MAP_52_UBYTE_u2_s2_s2 1.9999 _CNV_R_R_Def_f_uw_b_579_CM 0. 1.9999 FORMAT "%14.5"
 /begin AXIS_DESCR STD_AXIS Nkw _CNV_R_R_Def_n_sw_q_612_CM 4 -32768. 32767. FORMAT "%5.0" /end AXIS_DESCR
 /begin AXIS_DESCR STD_AXIS Rf_soll _CNV_R_R_Def_rf_sw__616_CM 4 -327.68 327.67 FORMAT "%7.4" /end AXIS_DESCR
/end CHARACTERISTIC
/begin CHARACTERISTIC KF_DRFV_SPUEL "Ueberspuel Rf Anteil" MAP 0xa1012420 _REC_MAP_52_UBYTE_s2_u2_s2 98.30250000000001 _CNV_R_R_Def_rf_sw__616_CM -327.68 327.67 FORMAT "%7.4"
 /begin AXIS_DESCR STD_AXIS Uefl_spuel _CNV_R_R_Def_a_uw_q_736_CM 8 0. 1048.56 /end AXIS_DESCR
 /begin AXIS_DESCR STD_AXIS Nkw _CNV_R_R_Def_n_sw_q_612_CM 8 -32768. 32767. FORMAT "%5.0" /end AXIS_DESCR
/end CHARACTERISTIC
/begin CHARACTERISTIC KF_DRFV_UK "Unkritisches Rf Anteil" MAP 0xa101237c _REC_MAP_52_UBYTE_s2_u2_s2 98.30250000000001 _CNV_R_R_Def_rf_sw__616_CM -327.68 327.67 FORMAT "%7.4" /begin AXIS_DESCR STD_AXIS Uefl_uk _CNV_R_R_Def_a_uw_q_736_CM 8 0. 1048.56 /end AXIS_DESCR
 /begin AXIS_DESCR STD_AXIS Nkw _CNV_R_R_Def_n_sw_q_612_CM 8 -32768. 32767. FORMAT "%5.0" /end AXIS_DESCR
/end CHARACTERISTIC
/begin CHARACTERISTIC KF_MAREGDKI "I-Anteil PI-Regler Mareg DK" MAP 0xa1012648 _REC_MAP_52_UBYTE_u2_s2_s2 1.9999 _CNV_R_R_Def_f_uw_b_579_CM 0. 1.9999 FORMAT "%14.5"
 /begin AXIS_DESCR STD_AXIS Nkw _CNV_R_R_Def_n_sw_q_612_CM 4 -32768. 32767. FORMAT "%5.0" /end AXIS_DESCR
 /begin AXIS_DESCR STD_AXIS Rfv_soll _CNV_R_R_Def_rf_sw__616_CM 4 -327.68 327.67 FORMAT "%7.4" /end AXIS_DESCR
/end CHARACTERISTIC
/begin CHARACTERISTIC KF_MAREGDKI_TE "I-Anteil PI-Regler Mareg DK bei Tankentlüftung" MAP 0xa101267c _REC_MAP_52_UBYTE_u2_s2_s2 1.9999 _CNV_R_R_Def_f_uw_b_579_CM 0. 1.9999 FORMAT "%14.5"
 /begin AXIS_DESCR STD_AXIS Nkw _CNV_R_R_Def_n_sw_q_612_CM 4 -32768. 32767. FORMAT "%5.0" /end AXIS_DESCR
 /begin AXIS_DESCR STD_AXIS Rfv_soll _CNV_R_R_Def_rf_sw__616_CM 4 -327.68 327.67 FORMAT "%7.4" /end AXIS_DESCR
/end CHARACTERISTIC
/begin CHARACTERISTIC KF_MAREGDKP "P-Anteil PI-Regler Mareg DK" MAP 0xa10125e0 _REC_MAP_52_UBYTE_u2_s2_s2 63.99900000000001 _CNV_R_R_Def_f_uw_b_580_CM 0. 63.999 FORMAT "%7.4"
 /begin AXIS_DESCR STD_AXIS Nkw _CNV_R_R_Def_n_sw_q_612_CM 4 -32768. 32767. FORMAT "%5.0" /end AXIS_DESCR
 /begin AXIS_DESCR STD_AXIS Rfv_soll _CNV_R_R_Def_rf_sw__616_CM 4 -327.68 327.67 FORMAT "%7.4" /end AXIS_DESCR
/end CHARACTERISTIC
/begin CHARACTERISTIC KF_MAREGDKP_TE "P-Anteil PI-Regler Mareg DK bei Tankentlüftung" MAP 0xa1012614 _REC_MAP_52_UBYTE_u2_s2_s2 63.99900000000001 _CNV_R_R_Def_f_uw_b_580_CM 0. 63.999 FORMAT "%7.4"
 /begin AXIS_DESCR STD_AXIS Nkw _CNV_R_R_Def_n_sw_q_612_CM 4 -32768. 32767. FORMAT "%5.0" /end AXIS_DESCR
 /begin AXIS_DESCR STD_AXIS Rfv_soll _CNV_R_R_Def_rf_sw__616_CM 4 -327.68 327.67 FORMAT "%7.4" /end AXIS_DESCR
/end CHARACTERISTIC
/begin CHARACTERISTIC KF_MSNDK "Normierter Massenstrom ueber Drosselklappe" MAP 0xa10112b0 _REC_MAP_52_UBYTE_u2_s2_s2 81.91875 _CNV_R_R_Def_ms_uw__664_CM 0. 8191.875 FORMAT "%5.2"
 /begin AXIS_DESCR STD_AXIS Wdk_ist _CNV_R_R_Def_wdk_sw_691_CM 16 -800. 799.9755 FORMAT "%5.2" /end AXIS_DESCR
 /begin AXIS_DESCR STD_AXIS Nkw _CNV_R_R_Def_n_sw_q_612_CM 6 -32768. 32767. FORMAT "%5.0" /end AXIS_DESCR
/end CHARACTERISTIC
/begin CHARACTERISTIC KF_NLEV "Sollwert Einlassventilhub im Start" MAP 0xa1011eac _REC_MAP_52_UBYTE_u2_u2_u2 1.9999 _CNV_R_R_Def_f_uw_b_579_CM 0. 1.9999 FORMAT "%14.5"
 /begin AXIS_DESCR STD_AXIS F_pspu _CNV_R_R_Def_f_uw_b_579_CM 12 0. 1.9999 FORMAT "%14.5" /end AXIS_DESCR
 /begin AXIS_DESCR STD_AXIS Pirg_abgd _CNV_R_R_Def_p_sw_q_578_CM 8 0. 2559.9609 FORMAT "%5.2" /end AXIS_DESCR
/end CHARACTERISTIC
/begin CHARACTERISTIC KF_PAKPSOFFS "" MAP 0xa101203c _REC_MAP_52_UBYTE_s2_s2_u2 1.9999 _CNV_R_R_Def_f_uw_b_579_CM -1. 0.9999 FORMAT "%14.5"
 /begin AXIS_DESCR STD_AXIS Nkw _CNV_R_R_Def_n_sw_q_612_CM 8 -32768. 32767. FORMAT "%5.0" /end AXIS_DESCR
 /begin AXIS_DESCR STD_AXIS Uefl_spuel _CNV_R_R_Def_a_uw_q_736_CM 8 0. 1048.56 /end AXIS_DESCR
/end CHARACTERISTIC
/begin CHARACTERISTIC KF_PSPAKOFFS "" MAP 0xa1011f98 _REC_MAP_52_UBYTE_s2_s2_u2 1.9999 _CNV_R_R_Def_f_uw_b_579_CM -1. 0.9999 FORMAT "%14.5"
 /begin AXIS_DESCR STD_AXIS Nkw _CNV_R_R_Def_n_sw_q_612_CM 8 -32768. 32767. FORMAT "%5.0" /end AXIS_DESCR
 /begin AXIS_DESCR STD_AXIS Uefl_uk _CNV_R_R_Def_a_uw_q_736_CM 8 0. 1048.56 /end AXIS_DESCR
/end CHARACTERISTIC
/begin CHARACTERISTIC KF_RFVIST_ST "Start Relativ-Fuellung" MAP 0xa10111e8 _REC_MAP_52_UBYTE_s2_u2_s2 98.30250000000001 _CNV_R_R_Def_rf_sw__616_CM -327.68 327.67 FORMAT "%7.4" /begin AXIS_DESCR STD_AXIS Hubev_soll _CNV_R_R_Def_hub_uw_605_CM 6 0. 65.535 /end AXIS_DESCR
 /begin AXIS_DESCR STD_AXIS Nkw _CNV_R_R_Def_n_sw_q_612_CM 6 -32768. 32767. FORMAT "%5.0" /end AXIS_DESCR
/end CHARACTERISTIC
/begin CHARACTERISTIC KF_RFVZYLVOL "Volumetrisches Zylinder-Fuellung" MAP 0xa1012228 _REC_MAP_52_UBYTE_s2_s2_u2 98.30250000000001 _CNV_R_R_Def_rf_sw__616_CM -327.68 327.67 FORMAT "%7.4"
 /begin AXIS_DESCR STD_AXIS Nkw _CNV_R_R_Def_n_sw_q_612_CM 12 -32768. 32767. FORMAT "%5.0" /end AXIS_DESCR
 /begin AXIS_DESCR STD_AXIS Vse_spri _CNV_R_R_Def_spr_sw_583_CM 12 0. 6553.5 FORMAT "%5.2" /end AXIS_DESCR
/end CHARACTERISTIC
/begin CHARACTERISTIC KF_TDMSZYL "Kennfeld zur Filterung der Variablen Verzögerung von Mszyl_diag" MAP 0xa1012ea4 _REC_MAP_52_UBYTE_u2_s2_s2 655.35 _CNV_R_R_Def_zk10ms_723_CM 1.e-002 655.36 FORMAT "%7.4"
 /begin AXIS_DESCR STD_AXIS Nkw _CNV_R_R_Def_n_sw_q_612_CM 4 -32768. 32767. FORMAT "%5.0" /end AXIS_DESCR
 /begin AXIS_DESCR STD_AXIS Rf _CNV_R_R_Def_rf_sw__616_CM 4 -327.68 327.67 FORMAT "%7.4" /end AXIS_DESCR
/end CHARACTERISTIC
/begin CHARACTERISTIC KF_THFMOD "Filterkonstante fuer Massenstromfilter" MAP 0xa1012800 _REC_MAP_52_UBYTE_u2_s2_s2 655.35 _CNV_R_R_Def_zk10ms_723_CM 1.e-002 655.36 FORMAT "%7.4"
 /begin AXIS_DESCR STD_AXIS Nkw _CNV_R_R_Def_n_sw_q_612_CM 6 -32768. 32767. FORMAT "%5.0" /end AXIS_DESCR
 /begin AXIS_DESCR STD_AXIS Rf_soll _CNV_R_R_Def_rf_sw__616_CM 6 -327.68 327.67 FORMAT "%7.4" /end AXIS_DESCR
/end CHARACTERISTIC
/begin CHARACTERISTIC KF_UEF_SPUEL "Kennfeld für Überschneidungsfläche" MAP 0xa1012184 _REC_MAP_52_UBYTE_u2_u2_s2 104.856 _CNV_R_R_Def_a_uw_q_736_CM 0. 1048.56
 /begin AXIS_DESCR STD_AXIS Spr_sum_f _CNV_R_R_Def_spr_sw_583_CM 8 0. 6553.5 FORMAT "%5.2" /end AXIS_DESCR
 /begin AXIS_DESCR STD_AXIS Spr_swp _CNV_R_R_Def_spr_sw_583_CM 8 -3276.8 3276.7 FORMAT "%5.2" /end AXIS_DESCR
/end CHARACTERISTIC
/begin CHARACTERISTIC KF_UEF_UK "Kennfeld für Überschneidungsfläche" MAP 0xa10120e0 _REC_MAP_52_UBYTE_u2_u2_s2 104.856 _CNV_R_R_Def_a_uw_q_736_CM 0. 1048.56
 /begin AXIS_DESCR STD_AXIS Spr_sum_f _CNV_R_R_Def_spr_sw_583_CM 8 0. 6553.5 FORMAT "%5.2" /end AXIS_DESCR
 /begin AXIS_DESCR STD_AXIS Spr_swp _CNV_R_R_Def_spr_sw_583_CM 8 -3276.8 3276.7 FORMAT "%5.2" /end AXIS_DESCR
/end CHARACTERISTIC
/begin CHARACTERISTIC KF_ZK_MSKOR "Filterkonstante fuer HFM-Massenstromfilter" MAP 0xa1012864 _REC_MAP_52_UBYTE_u2_s2_s2 655.35 _CNV_R_R_Def_zk10ms_723_CM 1.e-002 655.36 FORMAT "%7.4"
 /begin AXIS_DESCR STD_AXIS Rfv_soll _CNV_R_R_Def_rf_sw__616_CM 6 -327.68 327.67 FORMAT "%7.4" /end AXIS_DESCR
 /begin AXIS_DESCR STD_AXIS Nkw _CNV_R_R_Def_n_sw_q_612_CM 6 -32768. 32767. FORMAT "%5.0" /end AXIS_DESCR
/end CHARACTERISTIC
/begin CHARACTERISTIC KL_AF "Ausflusskennlinie" CURVE 0xa101124c _REC_CUR_TKL_UW_VV__u2_u2 0.9999 _CNV_R_R_Def_f_uw_b_591_CM 0. 0.9999 FORMAT "%14.5"
 /begin AXIS_DESCR STD_AXIS Pspvdk _CNV_R_R_Def_f_uw_b_591_CM 24 0. 0.9999 FORMAT "%14.5" /end AXIS_DESCR
/end CHARACTERISTIC
/begin CHARACTERISTIC KL_AF_SPUEL "Ausflusskennlinie" CURVE 0xa10113bc _REC_CUR_TKL_UW_VV__u2_u2 0.9999 _CNV_R_R_Def_f_uw_b_591_CM 0. 0.9999 FORMAT "%14.5"
 /begin AXIS_DESCR STD_AXIS Pakps_kor _CNV_R_R_Def_f_uw_b_579_CM 24 0. 1.9999 FORMAT "%14.5" /end AXIS_DESCR
/end CHARACTERISTIC
/begin CHARACTERISTIC KL_CDK_N "Zentren Lolimot-Modelle Eingang Nkw, DK-Zweig" CURVE 0xa10126cc _REC_CUR_20_s2_u1 65535. _CNV_R_R_Def_n_sw_q_612_CM -32768. 32767. FORMAT "%5.0"
 /begin AXIS_DESCR COM_AXIS Modelle _CNV_R_R_Def_dez_sl_575_CM 15 0. 255. FORMAT "%3.0" AXIS_PTS_REF GAX_15MODELLE /end AXIS_DESCR
/end CHARACTERISTIC
/begin CHARACTERISTIC KL_CDK_VSA_SPRI "Zentren Lolimot-Modelle Eingang Vsa_spri, DK-Zweig" CURVE 0xa101270c _REC_CUR_20_u2_u1 6553.5 _CNV_R_R_Def_spr_sw_583_CM 0. 6553.5 FORMAT "%5.2"
 /begin AXIS_DESCR COM_AXIS Modelle _CNV_R_R_Def_dez_sl_575_CM 15 0. 255. FORMAT "%3.0" AXIS_PTS_REF GAX_15MODELLE /end AXIS_DESCR
/end CHARACTERISTIC
/begin CHARACTERISTIC KL_CDK_VSE_SPRI "Zentren Lolimot-Modelle Eingang Vse_spri, DK-Zweig" CURVE 0xa10126ec _REC_CUR_20_u2_u1 6553.5 _CNV_R_R_Def_spr_sw_583_CM 0. 6553.5 FORMAT "%5.2"
 /begin AXIS_DESCR COM_AXIS Modelle _CNV_R_R_Def_dez_sl_575_CM 15 0. 255. FORMAT "%3.0" AXIS_PTS_REF GAX_15MODELLE /end AXIS_DESCR
/end CHARACTERISTIC
/begin CHARACTERISTIC KL_CDK_WDK_IST "Zentren Lolimot-Modelle Eingang Wdk_ist, DK-Zweig" CURVE 0xa101272c _REC_CUR_20_s2_u1 1599.9755 _CNV_R_R_Def_wdk_sw_691_CM -800. 799.9755 FORMAT "%5.2"
 /begin AXIS_DESCR COM_AXIS Modelle _CNV_R_R_Def_dez_sl_575_CM 15 0. 255. FORMAT "%3.0" AXIS_PTS_REF GAX_15MODELLE /end AXIS_DESCR
/end CHARACTERISTIC
/begin CHARACTERISTIC KL_ETADK "Lernfaktor für DK-Lolimot-KNN" CURVE 0xa10127cc _REC_CUR_TKL_UW_VV__S4_S4 0. _CNV_R_R_Def_dez_sl_575_CM 0. 10000000000000. FORMAT "%14.7"
 /begin AXIS_DESCR STD_AXIS NO_INPUT_QUANTITY _CNV_R_R_Def_dez_sl_575_CM 6 -1000000000000. 10000000000000. FORMAT "%14.7" /end AXIS_DESCR
/end CHARACTERISTIC
/begin CHARACTERISTIC KL_HUBFMAON "" CURVE 0xa1012574 _REC_CUR_TKL_UW_VV__u2_s2 65.535 _CNV_R_R_Def_hub_uw_605_CM 0. 65.535
 /begin AXIS_DESCR STD_AXIS Nkw _CNV_R_R_Def_n_sw_q_612_CM 8 -32768. 32767. FORMAT "%5.0" /end AXIS_DESCR
/end CHARACTERISTIC
/begin CHARACTERISTIC KL_HUBFMAUN "" CURVE 0xa1012598 _REC_CUR_TKL_UW_VV__u2_s2 65.535 _CNV_R_R_Def_hub_uw_605_CM 0. 65.535
 /begin AXIS_DESCR STD_AXIS Nkw _CNV_R_R_Def_n_sw_q_612_CM 8 -32768. 32767. FORMAT "%5.0" /end AXIS_DESCR
/end CHARACTERISTIC
/begin CHARACTERISTIC KL_HUBMSON "" CURVE 0xa10125bc _REC_CUR_TKL_UW_VV__u2_s2 65.535 _CNV_R_R_Def_hub_uw_605_CM 0. 65.535
 /begin AXIS_DESCR STD_AXIS Nkw _CNV_R_R_Def_n_sw_q_612_CM 8 -32768. 32767. FORMAT "%5.0" /end AXIS_DESCR
/end CHARACTERISTIC
/begin CHARACTERISTIC KL_MRD_EV "Gewichtung Eingang Pspvdk_soll" CURVE 0xa10111b0 _REC_CUR_TKL_UW_VV__u2_u2 3.9999 _CNV_R_R_Def_f_sw_b_608_CM 0. 3.9999 FORMAT "%14.5"
 /begin AXIS_DESCR STD_AXIS Pspvdk_soll _CNV_R_R_Def_f_sw_b_608_CM 6 0. 3.9999 FORMAT "%14.5" /end AXIS_DESCR
/end CHARACTERISTIC
/begin CHARACTERISTIC KL_MSNAGR "Normierter Durchfluss AGR-Ventil" CURVE 0xa1012f40 _REC_CUR_TKL_UW_VV__u2_u2 102.398435 _CNV_R_R_Def_ms_uw__611_CM 0. 2047.9687 /begin AXIS_DESCR STD_AXIS Agrpos _CNV_R_R_Def_f_uw_b_576_CM 12 0. 99.9984 /end AXIS_DESCR /end CHARACTERISTIC
/begin CHARACTERISTIC KL_PIRG_MX "Kennlinie MAX-Grenze Pirg aus N.N." CURVE 0xa1011e74 _REC_CUR_TKL_UW_VV__u2_s2 102.398436 _CNV_R_R_Def_p_sw_q_578_CM 0. 2559.9609 FORMAT "%5.2"
 /begin AXIS_DESCR STD_AXIS Nkw _CNV_R_R_Def_n_sw_q_612_CM 6 -32768. 32767. FORMAT "%5.0" /end AXIS_DESCR
/end CHARACTERISTIC
/begin CHARACTERISTIC KL_PIRG_START "Pirg während Start" CURVE 0xa101146c _REC_CUR_TKL_UW_VV__u2_s2 102.398436 _CNV_R_R_Def_p_sw_q_578_CM 0. 2559.9609 FORMAT "%5.2"
 /begin AXIS_DESCR STD_AXIS Nkw _CNV_R_R_Def_n_sw_q_612_CM 8 -32768. 32767. FORMAT "%5.0" /end AXIS_DESCR
/end CHARACTERISTIC
/begin CHARACTERISTIC KL_PSREGAGR_KOR "" CURVE 0xa10111cc _REC_CUR_TKL_UW_VV__u2_u2 15.9997 _CNV_R_R_Def_f_uw_b_594_CM 0. 15.9997 FORMAT "%7.4"
 /begin AXIS_DESCR STD_AXIS NO_INPUT_QUANTITY _CNV_R_R_Def_f_uw_b_591_CM 6 0. 0.9999 FORMAT "%14.5" /end AXIS_DESCR
/end CHARACTERISTIC
/begin CHARACTERISTIC KL_RANWI "Kennlinie Regler I-Anteil Auslassspreizung variable NWS" CURVE 0xa101d378 _REC_CUR_TKL_UW_VV__u2_u2 99.99844999999999 _CNV_R_R_Def_rel_uw_742_CM -100. 99.9969
 /begin AXIS_DESCR STD_AXIS Vsadwnwkl _CNV_R_R_Def_spr_uw_744_CM 16 -3276.8 3276.7 FORMAT "%5.2" /end AXIS_DESCR
/end CHARACTERISTIC
/begin CHARACTERISTIC KL_RANWP "Kennlinie Regler P-Anteil Auslassspreizung variable NWS" CURVE 0xa101d334 _REC_CUR_TKL_UW_VV__u2_u2 99.99844999999999 _CNV_R_R_Def_rel_uw_742_CM -100. 99.9969
 /begin AXIS_DESCR STD_AXIS Vsadwnwkl _CNV_R_R_Def_spr_uw_744_CM 16 -3276.8 3276.7 FORMAT "%5.2" /end AXIS_DESCR
/end CHARACTERISTIC
/begin CHARACTERISTIC KL_RENWI "Kennlinie Regler I-Anteil Einlassspreizung variable NWS" CURVE 0xa101d2f0 _REC_CUR_TKL_UW_VV__u2_u2 99.99844999999999 _CNV_R_R_Def_rel_uw_742_CM -100. 99.9969
 /begin AXIS_DESCR STD_AXIS Vsedwnwkl _CNV_R_R_Def_spr_uw_744_CM 16 -3276.8 3276.7 FORMAT "%5.2" /end AXIS_DESCR
/end CHARACTERISTIC
/begin CHARACTERISTIC KL_RENWP "Kennlinie Regler P-Anteil Einlassspreizung variable NWS" CURVE 0xa101d2ac _REC_CUR_TKL_UW_VV__u2_u2 99.99844999999999 _CNV_R_R_Def_rel_uw_742_CM -100. 99.9969
 /begin AXIS_DESCR STD_AXIS Vsedwnwkl _CNV_R_R_Def_spr_uw_744_CM 16 -3276.8 3276.7 FORMAT "%5.2" /end AXIS_DESCR
/end CHARACTERISTIC
/begin CHARACTERISTIC KL_RFVIST_MN "Minimales Rfv_ist aus N.N" CURVE 0xa10114c8 _REC_CUR_TKL_UW_VV__s2_s2 98.30250000000001 _CNV_R_R_Def_rf_sw__616_CM -327.68 327.67 FORMAT "%7.4"
 /begin AXIS_DESCR STD_AXIS Nkw _CNV_R_R_Def_n_sw_q_612_CM 6 -32768. 32767. FORMAT "%5.0" /end AXIS_DESCR
/end CHARACTERISTIC
/begin CHARACTERISTIC KL_RFVIST_MX "Kennlinie MIN-Grenze Pirg aus N.N." CURVE 0xa1011e90 _REC_CUR_TKL_UW_VV__s2_s2 98.30250000000001 _CNV_R_R_Def_rf_sw__616_CM -327.68 327.67 FORMAT "%7.4"
 /begin AXIS_DESCR STD_AXIS Nkw _CNV_R_R_Def_n_sw_q_612_CM 6 -32768. 32767. FORMAT "%5.0" /end AXIS_DESCR
/end CHARACTERISTIC
/begin CHARACTERISTIC KL_RFVIST_START "Pirg während Start" CURVE 0xa10114a4 _REC_CUR_TKL_UW_VV__s2_s2 98.30250000000001 _CNV_R_R_Def_rf_sw__616_CM -327.68 327.67 FORMAT "%7.4"
 /begin AXIS_DESCR STD_AXIS Nkw _CNV_R_R_Def_n_sw_q_612_CM 8 -32768. 32767. FORMAT "%5.0" /end AXIS_DESCR
/end CHARACTERISTIC
/begin CHARACTERISTIC KL_RFVSOLL "Schwelle für Rfv_soll zur Aktivierung Disadiagnose" CURVE 0xa1012db0 _REC_CUR_TKL_UW_VV__s2_s2 98.30250000000001 _CNV_R_R_Def_rf_sw__616_CM -327.68 327.67 FORMAT "%7.4"
 /begin AXIS_DESCR STD_AXIS Nkw _CNV_R_R_Def_n_sw_q_612_CM 8 -32768. 32767. FORMAT "%5.0" /end AXIS_DESCR
/end CHARACTERISTIC
/begin CHARACTERISTIC KL_SDK_N "Breiten Lolimot-Modelle Eingang Nkw, DK-Zweig" CURVE 0xa101274c _REC_CUR_20_s2_u1 65535. _CNV_R_R_Def_n_sw_q_612_CM -32768. 32767. FORMAT "%5.0"
 /begin AXIS_DESCR COM_AXIS Modelle _CNV_R_R_Def_dez_sl_575_CM 15 0. 255. FORMAT "%3.0" AXIS_PTS_REF GAX_15MODELLE /end AXIS_DESCR
/end CHARACTERISTIC
/begin CHARACTERISTIC KL_SDK_VSA_SPRI "Breiten Lolimot-Modelle Eingang Vsa_spri, DK-Zweig" CURVE 0xa101278c _REC_CUR_20_u2_u1 6553.5 _CNV_R_R_Def_spr_sw_583_CM 0. 6553.5 FORMAT "%5.2"
 /begin AXIS_DESCR COM_AXIS Modelle _CNV_R_R_Def_dez_sl_575_CM 15 0. 255. FORMAT "%3.0" AXIS_PTS_REF GAX_15MODELLE /end AXIS_DESCR
/end CHARACTERISTIC
/begin CHARACTERISTIC KL_SDK_VSE_SPRI "Breiten Lolimot-Modelle Eingang Vse_spri, DK-Zweig" CURVE 0xa101276c _REC_CUR_20_u2_u1 6553.5 _CNV_R_R_Def_spr_sw_583_CM 0. 6553.5 FORMAT "%5.2"
 /begin AXIS_DESCR COM_AXIS Modelle _CNV_R_R_Def_dez_sl_575_CM 15 0. 255. FORMAT "%3.0" AXIS_PTS_REF GAX_15MODELLE /end AXIS_DESCR
/end CHARACTERISTIC
/begin CHARACTERISTIC KL_SDK_WDK_IST "Breiten Lolimot-Modelle Eingang Wdk_ist, DK-Zweig" CURVE 0xa10127ac _REC_CUR_20_s2_u1 1599.9755 _CNV_R_R_Def_wdk_sw_691_CM -800. 799.9755 FORMAT "%5.2"
 /begin AXIS_DESCR COM_AXIS Modelle _CNV_R_R_Def_dez_sl_575_CM 15 0. 255. FORMAT "%3.0" AXIS_PTS_REF GAX_15MODELLE /end AXIS_DESCR
/end CHARACTERISTIC
/begin CHARACTERISTIC KL_STEND_TRANS "Start Faktor" CURVE 0xa1011490 _REC_CUR_TKL_UW_VV__u2_s2 0.9999 _CNV_R_R_Def_f_uw_b_591_CM 0. 0.9999 FORMAT "%14.5"
 /begin AXIS_DESCR STD_AXIS Nkw _CNV_R_R_Def_n_sw_q_612_CM 4 -32768. 32767. FORMAT "%5.0" /end AXIS_DESCR
/end CHARACTERISTIC
/begin CHARACTERISTIC KL_TD_MRONST "" CURVE 0xa1012550 _REC_CUR_TKL_UW_VV__u2_s2 131.07 _CNV_R_R_Def_td_ub__593_CM 0. 6553.5 FORMAT "%4.1"
 /begin AXIS_DESCR STD_AXIS Tmot_start _CNV_R_R_Def_t_sw_q_620_CM 8 -327.68 327.67 FORMAT "%5.2" /end AXIS_DESCR
/end CHARACTERISTIC
/begin CHARACTERISTIC KL_TKAGR "Temperaturkorrektur für Normdurchfluss" CURVE 0xa1012f74 _REC_CUR_TKL_UW_VV__u2_s2 1.9999 _CNV_R_R_Def_f_uw_b_579_CM 0. 1.9999 FORMAT "%14.5"
 /begin AXIS_DESCR STD_AXIS Tabg_agr _CNV_R_R_Def_t_sw_q_618_CM 6 -3276.8 3276.7 FORMAT "%4.1" /end AXIS_DESCR
/end CHARACTERISTIC
/begin CHARACTERISTIC KL_VNSTMOT "Korrekturkennlinie P-Anteil (Wichtung TV ueber Tmot wegen hohem Druck bei tiefen Temperaturen)" CURVE 0xa101d250 _REC_CUR_TKL_UW_VV__u1_s2 1.9921 _CNV_R_R_Def_f_ub_b_625_CM 0. 1.9921
 /begin AXIS_DESCR STD_AXIS Tmot _CNV_R_R_Def_t_sw_q_620_CM 6 -327.68 327.67 FORMAT "%5.2" /end AXIS_DESCR
/end CHARACTERISTIC
/begin CHARACTERISTIC KL_VNSTVUB "Kennlinie ub-AbhaEngigkeit TastverhaEltnis variable NWS" CURVE 0xa101d23c _REC_CUR_TKL_UW_VV__u1_u2 1.9921 _CNV_R_R_Def_f_ub_b_625_CM 0. 1.9921
 /begin AXIS_DESCR STD_AXIS Ub _CNV_R_R_Def_u_sb_q_598_CM 6 0. 6173.397 FORMAT "%4.1" /end AXIS_DESCR
/end CHARACTERISTIC
/begin CHARACTERISTIC KL_VSA_ITMOT "Initialisierung I-Regler (Tmot) Auslaß" CURVE 0xa101d288 _REC_CUR_TKL_UW_VV__u2_s2 99.99844999999999 _CNV_R_R_Def_rel_uw_742_CM -100. 99.9969
 /begin AXIS_DESCR STD_AXIS Tmot _CNV_R_R_Def_t_sw_q_620_CM 8 -327.68 327.67 FORMAT "%5.2" /end AXIS_DESCR
/end CHARACTERISTIC
/begin CHARACTERISTIC KL_VSE_ITMOT "Initialisierung I-Regler (Tmot) Einlaß" CURVE 0xa101d264 _REC_CUR_TKL_UW_VV__u2_s2 99.99844999999999 _CNV_R_R_Def_rel_uw_742_CM -100. 99.9969
 /begin AXIS_DESCR STD_AXIS Tmot _CNV_R_R_Def_t_sw_q_620_CM 8 -327.68 327.67 FORMAT "%5.2" /end AXIS_DESCR
/end CHARACTERISTIC
/begin CHARACTERISTIC KL_WBIAS_PIRG "Gewichte der Neuronen für Bias, PIRGNN" CURVE 0xa1011c94 _REC_CUR_20_S4_u1 11000000000000. _CNV_R_R_Def_dez_sl_575_CM -1000000000000. 10000000000000. FORMAT "%14.7"
 /begin AXIS_DESCR COM_AXIS Modelle _CNV_R_R_Def_dez_sl_575_CM 20 0. 255. FORMAT "%3.0" AXIS_PTS_REF GAX_PIRGNN /end AXIS_DESCR
/end CHARACTERISTIC
/begin CHARACTERISTIC KL_WBIAS_PIRG2 "Gewichte der Neuronen für Bias, PIRGNN" CURVE 0xa1011ce4 _REC_CUR_20_S4_u1 11000000000000. _CNV_R_R_Def_dez_sl_575_CM -1000000000000. 10000000000000. FORMAT "%14.7"
 /begin AXIS_DESCR COM_AXIS Modelle _CNV_R_R_Def_dez_sl_575_CM 20 0. 255. FORMAT "%3.0" AXIS_PTS_REF GAX_PIRGNN /end AXIS_DESCR
/end CHARACTERISTIC
/begin CHARACTERISTIC KL_WBIAS_PIRG3 "Gewichte der Neuronen für Bias, PIRGNN" CURVE 0xa1011d34 _REC_CUR_20_S4_u1 11000000000000. _CNV_R_R_Def_dez_sl_575_CM -1000000000000. 10000000000000. FORMAT "%14.7"
 /begin AXIS_DESCR COM_AXIS Modelle _CNV_R_R_Def_dez_sl_575_CM 20 0. 255. FORMAT "%3.0" AXIS_PTS_REF GAX_PIRGNN /end AXIS_DESCR
/end CHARACTERISTIC
/begin CHARACTERISTIC KL_WBIAS_RF "Gewichte der Neuronen für Bias, RFVISTNN" CURVE 0xa10117cc _REC_CUR_20_S4_u1 11000000000000. _CNV_R_R_Def_dez_sl_575_CM -1000000000000. 10000000000000. FORMAT "%14.7"
 /begin AXIS_DESCR COM_AXIS Modelle _CNV_R_R_Def_dez_sl_575_CM 20 0. 255. FORMAT "%3.0" AXIS_PTS_REF GAX_RFVISTNN /end AXIS_DESCR
/end CHARACTERISTIC
/begin CHARACTERISTIC KL_WBIAS_RF2 "Gewichte der Neuronen für Bias, RFVISTNN" CURVE 0xa101181c _REC_CUR_20_S4_u1 11000000000000. _CNV_R_R_Def_dez_sl_575_CM -1000000000000. 10000000000000. FORMAT "%14.7"
 /begin AXIS_DESCR COM_AXIS Modelle _CNV_R_R_Def_dez_sl_575_CM 20 0. 255. FORMAT "%3.0" AXIS_PTS_REF GAX_RFVISTNN /end AXIS_DESCR
/end CHARACTERISTIC
/begin CHARACTERISTIC KL_WBIAS_RF3 "Gewichte der Neuronen für Bias, RFVISTNN" CURVE 0xa101186c _REC_CUR_20_S4_u1 11000000000000. _CNV_R_R_Def_dez_sl_575_CM -1000000000000. 10000000000000. FORMAT "%14.7"
 /begin AXIS_DESCR COM_AXIS Modelle _CNV_R_R_Def_dez_sl_575_CM 20 0. 255. FORMAT "%3.0" AXIS_PTS_REF GAX_RFVISTNN /end AXIS_DESCR
/end CHARACTERISTIC
/begin CHARACTERISTIC KL_WDK_UG "Minimal DK Winkel UG" CURVE 0xa10113a0 _REC_CUR_TKL_UW_VV__u2_s2 95.99852999999999 _CNV_R_R_Def_wdk_sw_691_CM 0. 1599.9755 FORMAT "%5.2"
 /begin AXIS_DESCR STD_AXIS Nkw _CNV_R_R_Def_n_sw_q_612_CM 4 -32768. 32767. FORMAT "%5.0" /end AXIS_DESCR
/end CHARACTERISTIC
/begin CHARACTERISTIC KL_WNKW_PIRG "Gewichte der Neuronen für Eingang Nkw, PIRGNN" CURVE 0xa1011ba4 _REC_CUR_20_S4_u1 11000000000000. _CNV_R_R_Def_dez_sl_575_CM -1000000000000. 10000000000000. FORMAT "%14.7"
 /begin AXIS_DESCR COM_AXIS Modelle _CNV_R_R_Def_dez_sl_575_CM 20 0. 255. FORMAT "%3.0" AXIS_PTS_REF GAX_PIRGNN /end AXIS_DESCR
/end CHARACTERISTIC
/begin CHARACTERISTIC KL_WNKW_PIRG2 "Gewichte der Neuronen für Eingang Nkw, PIRGNN" CURVE 0xa1011bf4 _REC_CUR_20_S4_u1 11000000000000. _CNV_R_R_Def_dez_sl_575_CM -1000000000000. 10000000000000. FORMAT "%14.7"
 /begin AXIS_DESCR COM_AXIS Modelle _CNV_R_R_Def_dez_sl_575_CM 20 0. 255. FORMAT "%3.0" AXIS_PTS_REF GAX_PIRGNN /end AXIS_DESCR
/end CHARACTERISTIC
/begin CHARACTERISTIC KL_WNKW_PIRG3 "Gewichte der Neuronen für Eingang Nkw, PIRGNN" CURVE 0xa1011c44 _REC_CUR_20_S4_u1 11000000000000. _CNV_R_R_Def_dez_sl_575_CM -1000000000000. 10000000000000. FORMAT "%14.7"
 /begin AXIS_DESCR COM_AXIS Modelle _CNV_R_R_Def_dez_sl_575_CM 20 0. 255. FORMAT "%3.0" AXIS_PTS_REF GAX_PIRGNN /end AXIS_DESCR
/end CHARACTERISTIC
/begin CHARACTERISTIC KL_WNKW_RF "Gewichte der Neuronen für Eingang Nkw, RFVISTNN" CURVE 0xa10116dc _REC_CUR_20_S4_u1 11000000000000. _CNV_R_R_Def_dez_sl_575_CM -1000000000000. 10000000000000. FORMAT "%14.7"
 /begin AXIS_DESCR COM_AXIS Modelle _CNV_R_R_Def_dez_sl_575_CM 20 0. 255. FORMAT "%3.0" AXIS_PTS_REF GAX_RFVISTNN /end AXIS_DESCR
/end CHARACTERISTIC
/begin CHARACTERISTIC KL_WNKW_RF2 "Gewichte der Neuronen für Eingang Nkw, RFVISTNN" CURVE 0xa101172c _REC_CUR_20_S4_u1 11000000000000. _CNV_R_R_Def_dez_sl_575_CM -1000000000000. 10000000000000. FORMAT "%14.7"
 /begin AXIS_DESCR COM_AXIS Modelle _CNV_R_R_Def_dez_sl_575_CM 20 0. 255. FORMAT "%3.0" AXIS_PTS_REF GAX_RFVISTNN /end AXIS_DESCR
/end CHARACTERISTIC
/begin CHARACTERISTIC KL_WNKW_RF3 "Gewichte der Neuronen für Eingang Nkw, RFVISTNN" CURVE 0xa101177c _REC_CUR_20_S4_u1 11000000000000. _CNV_R_R_Def_dez_sl_575_CM -1000000000000. 10000000000000. FORMAT "%14.7"
 /begin AXIS_DESCR COM_AXIS Modelle _CNV_R_R_Def_dez_sl_575_CM 20 0. 255. FORMAT "%3.0" AXIS_PTS_REF GAX_RFVISTNN /end AXIS_DESCR
/end CHARACTERISTIC
/begin CHARACTERISTIC KL_WOUT_PIRG "Gewichte der Neuronen für Ausgang, PIRGNN" CURVE 0xa1011d84 _REC_CUR_20_S4_u1 11000000000000. _CNV_R_R_Def_dez_sl_575_CM -1000000000000. 10000000000000. FORMAT "%14.7"
 /begin AXIS_DESCR COM_AXIS Modelle _CNV_R_R_Def_dez_sl_575_CM 20 0. 255. FORMAT "%3.0" AXIS_PTS_REF GAX_PIRGNN /end AXIS_DESCR
/end CHARACTERISTIC
/begin CHARACTERISTIC KL_WOUT_PIRG2 "Gewichte der Neuronen für Ausgang, PIRGNN" CURVE 0xa1011dd4 _REC_CUR_20_S4_u1 11000000000000. _CNV_R_R_Def_dez_sl_575_CM -1000000000000. 10000000000000. FORMAT "%14.7"
 /begin AXIS_DESCR COM_AXIS Modelle _CNV_R_R_Def_dez_sl_575_CM 20 0. 255. FORMAT "%3.0" AXIS_PTS_REF GAX_PIRGNN /end AXIS_DESCR
/end CHARACTERISTIC
/begin CHARACTERISTIC KL_WOUT_PIRG3 "Gewichte der Neuronen für Ausgang, PIRGNN" CURVE 0xa1011e24 _REC_CUR_20_S4_u1 11000000000000. _CNV_R_R_Def_dez_sl_575_CM -1000000000000. 10000000000000. FORMAT "%14.7"
 /begin AXIS_DESCR COM_AXIS Modelle _CNV_R_R_Def_dez_sl_575_CM 20 0. 255. FORMAT "%3.0" AXIS_PTS_REF GAX_PIRGNN /end AXIS_DESCR
/end CHARACTERISTIC
/begin CHARACTERISTIC KL_WOUT_RF "Gewichte der Neuronen für Ausgang, RFVISTNN" CURVE 0xa10118bc _REC_CUR_20_S4_u1 11000000000000. _CNV_R_R_Def_dez_sl_575_CM -1000000000000. 10000000000000. FORMAT "%14.7"
 /begin AXIS_DESCR COM_AXIS Modelle _CNV_R_R_Def_dez_sl_575_CM 20 0. 255. FORMAT "%3.0" AXIS_PTS_REF GAX_RFVISTNN /end AXIS_DESCR
/end CHARACTERISTIC
/begin CHARACTERISTIC KL_WOUT_RF2 "Gewichte der Neuronen für Ausgang, RFVISTNN" CURVE 0xa101190c _REC_CUR_20_S4_u1 11000000000000. _CNV_R_R_Def_dez_sl_575_CM -1000000000000. 10000000000000. FORMAT "%14.7"
 /begin AXIS_DESCR COM_AXIS Modelle _CNV_R_R_Def_dez_sl_575_CM 20 0. 255. FORMAT "%3.0" AXIS_PTS_REF GAX_RFVISTNN /end AXIS_DESCR
/end CHARACTERISTIC
/begin CHARACTERISTIC KL_WOUT_RF3 "Gewichte der Neuronen für Ausgang, RFVISTNN" CURVE 0xa101195c _REC_CUR_20_S4_u1 11000000000000. _CNV_R_R_Def_dez_sl_575_CM -1000000000000. 10000000000000. FORMAT "%14.7"
 /begin AXIS_DESCR COM_AXIS Modelle _CNV_R_R_Def_dez_sl_575_CM 20 0. 255. FORMAT "%3.0" AXIS_PTS_REF GAX_RFVISTNN /end AXIS_DESCR
/end CHARACTERISTIC
/begin CHARACTERISTIC KL_WVSA_PIRG "Gewichte der Neuronen für Eingang Vsa_spri, PIRGNN" CURVE 0xa1011ab4 _REC_CUR_20_S4_u1 11000000000000. _CNV_R_R_Def_dez_sl_575_CM -1000000000000. 10000000000000. FORMAT "%14.7"
 /begin AXIS_DESCR COM_AXIS Modelle _CNV_R_R_Def_dez_sl_575_CM 20 0. 255. FORMAT "%3.0" AXIS_PTS_REF GAX_PIRGNN /end AXIS_DESCR
/end CHARACTERISTIC
/begin CHARACTERISTIC KL_WVSA_PIRG2 "Gewichte der Neuronen für Eingang Vsa_spri, PIRGNN" CURVE 0xa1011b04 _REC_CUR_20_S4_u1 11000000000000. _CNV_R_R_Def_dez_sl_575_CM -1000000000000. 10000000000000. FORMAT "%14.7"
 /begin AXIS_DESCR COM_AXIS Modelle _CNV_R_R_Def_dez_sl_575_CM 20 0. 255. FORMAT "%3.0" AXIS_PTS_REF GAX_PIRGNN /end AXIS_DESCR
/end CHARACTERISTIC
/begin CHARACTERISTIC KL_WVSA_PIRG3 "Gewichte der Neuronen für Eingang Vsa_spri, PIRGNN" CURVE 0xa1011b54 _REC_CUR_20_S4_u1 11000000000000. _CNV_R_R_Def_dez_sl_575_CM -1000000000000. 10000000000000. FORMAT "%14.7"
 /begin AXIS_DESCR COM_AXIS Modelle _CNV_R_R_Def_dez_sl_575_CM 20 0. 255. FORMAT "%3.0" AXIS_PTS_REF GAX_PIRGNN /end AXIS_DESCR
/end CHARACTERISTIC
/begin CHARACTERISTIC KL_WVSA_RF "Gewichte der Neuronen für Eingang Vsa_spri, RFVISTNN" CURVE 0xa10115ec _REC_CUR_20_S4_u1 11000000000000. _CNV_R_R_Def_dez_sl_575_CM -1000000000000. 10000000000000. FORMAT "%14.7"
 /begin AXIS_DESCR COM_AXIS Modelle _CNV_R_R_Def_dez_sl_575_CM 20 0. 255. FORMAT "%3.0" AXIS_PTS_REF GAX_RFVISTNN /end AXIS_DESCR
/end CHARACTERISTIC
/begin CHARACTERISTIC KL_WVSA_RF2 "Gewichte der Neuronen für Eingang Vsa_spri, RFVISTNN" CURVE 0xa101163c _REC_CUR_20_S4_u1 11000000000000. _CNV_R_R_Def_dez_sl_575_CM -1000000000000. 10000000000000. FORMAT "%14.7"
 /begin AXIS_DESCR COM_AXIS Modelle _CNV_R_R_Def_dez_sl_575_CM 20 0. 255. FORMAT "%3.0" AXIS_PTS_REF GAX_RFVISTNN /end AXIS_DESCR
/end CHARACTERISTIC
/begin CHARACTERISTIC KL_WVSA_RF3 "Gewichte der Neuronen für Eingang Vsa_spri, RFVISTNN" CURVE 0xa101168c _REC_CUR_20_S4_u1 11000000000000. _CNV_R_R_Def_dez_sl_575_CM -1000000000000. 10000000000000. FORMAT "%14.7"
 /begin AXIS_DESCR COM_AXIS Modelle _CNV_R_R_Def_dez_sl_575_CM 20 0. 255. FORMAT "%3.0" AXIS_PTS_REF GAX_RFVISTNN /end AXIS_DESCR
/end CHARACTERISTIC
/begin CHARACTERISTIC KL_WVSE_PIRG "Gewichte der Neuronen für Eingang Vse_spri, PIRGNN" CURVE 0xa10119c4 _REC_CUR_20_S4_u1 11000000000000. _CNV_R_R_Def_dez_sl_575_CM -1000000000000. 10000000000000. FORMAT "%14.7"
 /begin AXIS_DESCR COM_AXIS Modelle _CNV_R_R_Def_dez_sl_575_CM 20 0. 255. FORMAT "%3.0" AXIS_PTS_REF GAX_PIRGNN /end AXIS_DESCR
/end CHARACTERISTIC
/begin CHARACTERISTIC KL_WVSE_PIRG2 "Gewichte der Neuronen für Eingang Vse_spri, PIRGNN" CURVE 0xa1011a14 _REC_CUR_20_S4_u1 11000000000000. _CNV_R_R_Def_dez_sl_575_CM -1000000000000. 10000000000000. FORMAT "%14.7"
 /begin AXIS_DESCR COM_AXIS Modelle _CNV_R_R_Def_dez_sl_575_CM 20 0. 255. FORMAT "%3.0" AXIS_PTS_REF GAX_PIRGNN /end AXIS_DESCR
/end CHARACTERISTIC
/begin CHARACTERISTIC KL_WVSE_PIRG3 "Gewichte der Neuronen für Eingang Vse_spri, PIRGNN" CURVE 0xa1011a64 _REC_CUR_20_S4_u1 11000000000000. _CNV_R_R_Def_dez_sl_575_CM -1000000000000. 10000000000000. FORMAT "%14.7"
 /begin AXIS_DESCR COM_AXIS Modelle _CNV_R_R_Def_dez_sl_575_CM 20 0. 255. FORMAT "%3.0" AXIS_PTS_REF GAX_PIRGNN /end AXIS_DESCR
/end CHARACTERISTIC
/begin CHARACTERISTIC KL_WVSE_RF "Gewichte der Neuronen für Eingang Vse_spri, RFVISTNN" CURVE 0xa10114fc _REC_CUR_20_S4_u1 11000000000000. _CNV_R_R_Def_dez_sl_575_CM -1000000000000. 10000000000000. FORMAT "%14.7"
 /begin AXIS_DESCR COM_AXIS Modelle _CNV_R_R_Def_dez_sl_575_CM 20 0. 255. FORMAT "%3.0" AXIS_PTS_REF GAX_RFVISTNN /end AXIS_DESCR
/end CHARACTERISTIC
/begin CHARACTERISTIC KL_WVSE_RF2 "Gewichte der Neuronen für Eingang Vse_spri, RFVISTNN" CURVE 0xa101154c _REC_CUR_20_S4_u1 11000000000000. _CNV_R_R_Def_dez_sl_575_CM -1000000000000. 10000000000000. FORMAT "%14.7"
 /begin AXIS_DESCR COM_AXIS Modelle _CNV_R_R_Def_dez_sl_575_CM 20 0. 255. FORMAT "%3.0" AXIS_PTS_REF GAX_RFVISTNN /end AXIS_DESCR
/end CHARACTERISTIC
/begin CHARACTERISTIC KL_WVSE_RF3 "Gewichte der Neuronen für Eingang Vse_spri, RFVISTNN" CURVE 0xa101159c _REC_CUR_20_S4_u1 11000000000000. _CNV_R_R_Def_dez_sl_575_CM -1000000000000. 10000000000000. FORMAT "%14.7"
 /begin AXIS_DESCR COM_AXIS Modelle _CNV_R_R_Def_dez_sl_575_CM 20 0. 255. FORMAT "%3.0" AXIS_PTS_REF GAX_RFVISTNN /end AXIS_DESCR
/end CHARACTERISTIC
/begin CHARACTERISTIC KL_ZKMSKOR_PSP "Filterkonstante fuer HFM-Massenstromfilter" CURVE 0xa10128c8 _REC_CUR_TKL_UW_VV__u2_u2 655.35 _CNV_R_R_Def_zk10ms_723_CM 1.e-002 655.36 FORMAT "%7.4"
 /begin AXIS_DESCR STD_AXIS Pspvdk_soll _CNV_R_R_Def_f_sw_b_608_CM 4 0. 3.9999 FORMAT "%14.5" /end AXIS_DESCR
/end CHARACTERISTIC
/begin CHARACTERISTIC K_ANZ_DKNN "Anzahl Modelle für DK-Lolimot-KNN" VALUE 0xa10124cc _REC_VAL_20_u1 15. _CNV_R_R_Def_dez_sl_575_CM 0. 15. FORMAT "%3.0" /end CHARACTERISTIC
/begin CHARACTERISTIC K_ASP_ADPWF "Adaptionswert Anschlag Auslassspreizung bei Powerfail" VALUE 0xa101d23a _REC_VAL_20_u2 131.07 _CNV_R_R_Def_spr_sw_583_CM 0. 6553.5 FORMAT "%5.2" /end CHARACTERISTIC
/begin CHARACTERISTIC K_ASP_ADTV "Adaptionstastverhaeltnis Auslassspreizung variable NWS" VALUE 0xa101d1fb _REC_VAL_20_u1 99.45 _CNV_R_R_Def_dez_sl_575_CM 0. 255. FORMAT "%3.0" /end CHARACTERISTIC
/begin CHARACTERISTIC K_ASP_BA "Betriebsartenwahlschalter Auslassspreizung variable NWS" VALUE 0xa101d236 _REC_VAL_20_u1 99.45 _CNV_R_R_Def_dez_sl_575_CM 0. 255. FORMAT "%3.0" /end CHARACTERISTIC
/begin CHARACTERISTIC K_ASP_TVHB "ausgegebenes Tastverhaeltnis bei Handbetrieb fuer Auslassspreizung variable NWS" VALUE 0xa101d1fc _REC_VAL_20_u1 99.45 _CNV_R_R_Def_dez_sl_575_CM 0. 255. FORMAT "%3.0" /end CHARACTERISTIC
/begin CHARACTERISTIC K_ASP_WNWS "Sollspreizung bei Handbetrieb fuer Auslassspreizung variable NWS" VALUE 0xa101d238 _REC_VAL_20_u2 131.07 _CNV_R_R_Def_spr_sw_583_CM 0. 6553.5 FORMAT "%5.2" /end CHARACTERISTIC
/begin CHARACTERISTIC K_BGMSVVTDPS "" VALUE 0xa10124ee _REC_VAL_20_u1 0.996 _CNV_R_R_Def_f_ub_b_573_CM 0. 0.996 /end CHARACTERISTIC
/begin CHARACTERISTIC K_BGWDKDPSGR "" VALUE 0xa1012d9a _REC_VAL_20_s2 102.398436 _CNV_R_R_Def_p_sw_q_578_CM -1280. 1279.9609 FORMAT "%5.2" /end CHARACTERISTIC
/begin CHARACTERISTIC K_DIAG_MSO_OFFGD "Offset obere Diagnoseschwelle gedrosselter Betrieb" VALUE 0xa1012d88 _REC_VAL_20_s2 1.9999 _CNV_R_R_Def_f_uw_b_579_CM -1. 0.9999 FORMAT "%14.5" /end CHARACTERISTIC
/begin CHARACTERISTIC K_DIAG_MSO_OFFTD "Offset obere Diagnoseschwelle teilgedrosselter Betrieb" VALUE 0xa1012d8c _REC_VAL_20_s2 1.9999 _CNV_R_R_Def_f_uw_b_579_CM -1. 0.9999 FORMAT "%14.5" /end CHARACTERISTIC
/begin CHARACTERISTIC K_DIAG_MSU_OFFGD "Offset untere Diagnoseschwelle gedrosselter Betrieb" VALUE 0xa1012d86 _REC_VAL_20_s2 1.9999 _CNV_R_R_Def_f_uw_b_579_CM -1. 0.9999 FORMAT "%14.5" /end CHARACTERISTIC
/begin CHARACTERISTIC K_DIAG_MSU_OFFTD "Offset untere Diagnoseschwelle teilgedrosselter Betrieb" VALUE 0xa1012d8a _REC_VAL_20_s2 1.9999 _CNV_R_R_Def_f_uw_b_579_CM -1. 0.9999 FORMAT "%14.5" /end CHARACTERISTIC
/begin CHARACTERISTIC K_DISAB1_MN "Min Nkw Wert für DISA-Bereich 1" VALUE 0xa1012d74 _REC_VAL_20_s2 0. _CNV_R_R_Def_n_sw_q_612_CM -32768. 32767. FORMAT "%5.0" /end CHARACTERISTIC
/begin CHARACTERISTIC K_DISAB1_MX "Max Nkw Wert für DISA-Bereich 1" VALUE 0xa1012d72 _REC_VAL_20_s2 0. _CNV_R_R_Def_n_sw_q_612_CM -32768. 32767. FORMAT "%5.0" /end CHARACTERISTIC
/begin CHARACTERISTIC K_DISAB2_MN "Min Nkw Wert für DISA-Bereich 2" VALUE 0xa1012d78 _REC_VAL_20_s2 0. _CNV_R_R_Def_n_sw_q_612_CM -32768. 32767. FORMAT "%5.0" /end CHARACTERISTIC
/begin CHARACTERISTIC K_DISAB2_MX "Max Nkw Wert für DISA-Bereich 2" VALUE 0xa1012d76 _REC_VAL_20_s2 0. _CNV_R_R_Def_n_sw_q_612_CM -32768. 32767. FORMAT "%5.0" /end CHARACTERISTIC
/begin CHARACTERISTIC K_DISAB3_MN "Min Nkw Wert für DISA-Bereich 3" VALUE 0xa1012d7c _REC_VAL_20_s2 0. _CNV_R_R_Def_n_sw_q_612_CM -32768. 32767. FORMAT "%5.0" /end CHARACTERISTIC
/begin CHARACTERISTIC K_DISAB3_MX "Max Nkw Wert für DISA-Bereich 3" VALUE 0xa1012d7a _REC_VAL_20_s2 0. _CNV_R_R_Def_n_sw_q_612_CM -32768. 32767. FORMAT "%5.0" /end CHARACTERISTIC
/begin CHARACTERISTIC K_DISAB4_MN "Min Nkw Wert für DISA-Bereich 4" VALUE 0xa1012d80 _REC_VAL_20_s2 0. _CNV_R_R_Def_n_sw_q_612_CM -32768. 32767. FORMAT "%5.0" /end CHARACTERISTIC
/begin CHARACTERISTIC K_DISAB4_MX "Max Nkw Wert für DISA-Bereich 4" VALUE 0xa1012d7e _REC_VAL_20_s2 0. _CNV_R_R_Def_n_sw_q_612_CM -32768. 32767. FORMAT "%5.0" /end CHARACTERISTIC
/begin CHARACTERISTIC K_DISADTAMN "Minwert Tans für Disadiagnose" VALUE 0xa1012d84 _REC_VAL_20_s2 131.07 _CNV_R_R_Def_t_sw_q_618_CM -3276.8 3276.7 FORMAT "%4.1" /end CHARACTERISTIC
/begin CHARACTERISTIC K_DISADTAMX "Maxwert Tans für Disadiagnose" VALUE 0xa1012d82 _REC_VAL_20_s2 131.07 _CNV_R_R_Def_t_sw_q_618_CM -3276.8 3276.7 FORMAT "%4.1" /end CHARACTERISTIC
/begin CHARACTERISTIC K_DISAIST_B1 "Deak. Schwelle DISA" VALUE 0xa1011440 _REC_VAL_20_u2 99.9984 _CNV_R_R_Def_f_uw_b_576_CM 0. 99.9984 /end CHARACTERISTIC
/begin CHARACTERISTIC K_DISAIST_B2 "Obererschwelle DISA" VALUE 0xa101143e _REC_VAL_20_u2 99.9984 _CNV_R_R_Def_f_uw_b_576_CM 0. 99.9984 /end CHARACTERISTIC
/begin CHARACTERISTIC K_DISAIST_B3 "Unterschwelle DISA" VALUE 0xa101143c _REC_VAL_20_u2 99.9984 _CNV_R_R_Def_f_uw_b_576_CM 0. 99.9984 /end CHARACTERISTIC
/begin CHARACTERISTIC K_DISATD "Wartezeit nach Disa-Umschaltung bis Bereich erkannt wird" VALUE 0xa1012d3f _REC_VAL_20_u1 25.5 _CNV_R_R_Def_td_ub__593_CM 0. 25.5 FORMAT "%4.1" /end CHARACTERISTIC
/begin CHARACTERISTIC K_DKMX "Maximalwert für Gewichte für DK-Lolimot-KNN" VALUE 0xa10124e4 _REC_VAL_20_S4 0. _CNV_R_R_Def_dez_sl_575_CM -1000000000000. 10000000000000. FORMAT "%14.7" /end CHARACTERISTIC
/begin CHARACTERISTIC K_DNKW_DISA1 "Delta Hysterese-schwelle DISA (Übergang Disabereich 2->1)" VALUE 0xa101144a _REC_VAL_20_s2 0. _CNV_R_R_Def_n_sw_q_612_CM -32768. 32767. FORMAT "%5.0" /end CHARACTERISTIC
/begin CHARACTERISTIC K_DNKW_DISA2 "Delta Hysterese-schwelle DISA (Übergang Disabereich 3->2)" VALUE 0xa101144c _REC_VAL_20_s2 0. _CNV_R_R_Def_n_sw_q_612_CM -32768. 32767. FORMAT "%5.0" /end CHARACTERISTIC
/begin CHARACTERISTIC K_DNKW_EISYDMN "Minschwelle für Drehzahldynamik Eisy Diagnose" VALUE 0xa1012d94 _REC_VAL_20_s2 0. _CNV_R_R_Def_n_sw_q_612_CM -32768. 32767. FORMAT "%5.0" /end CHARACTERISTIC
/begin CHARACTERISTIC K_DNKW_EISYDMX "Maxschwelle für Drehzahldynamik Eisy Diagnose" VALUE 0xa1012d92 _REC_VAL_20_s2 0. _CNV_R_R_Def_n_sw_q_612_CM -32768. 32767. FORMAT "%5.0" /end CHARACTERISTIC
/begin CHARACTERISTIC K_DPSRP_MN1 "Min Amplitude des Dpsr-Jitters (Disa-Bereich 1)" VALUE 0xa1012d6a _REC_VAL_20_s2 102.398436 _CNV_R_R_Def_p_sw_q_578_CM -1280. 1279.9609 FORMAT "%5.2" /end CHARACTERISTIC
/begin CHARACTERISTIC K_DPSRP_MN2 "Min Amplitude des Dpsr-Jitters (Disa-Bereich 2)" VALUE 0xa1012d6c _REC_VAL_20_s2 102.398436 _CNV_R_R_Def_p_sw_q_578_CM -1280. 1279.9609 FORMAT "%5.2" /end CHARACTERISTIC
/begin CHARACTERISTIC K_DPSRP_MN3 "Min Amplitude des Dpsr-Jitters (Disa-Bereich 3)" VALUE 0xa1012d6e _REC_VAL_20_s2 102.398436 _CNV_R_R_Def_p_sw_q_578_CM -1280. 1279.9609 FORMAT "%5.2" /end CHARACTERISTIC
/begin CHARACTERISTIC K_DPSRP_MN4 "Min Amplitude des Dpsr-Jitters (Disa-Bereich 4)" VALUE 0xa1012d70 _REC_VAL_20_s2 102.398436 _CNV_R_R_Def_p_sw_q_578_CM -1280. 1279.9609 FORMAT "%5.2" /end CHARACTERISTIC
/begin CHARACTERISTIC K_DRF_EISYDMN "Minschwelle für Lastdynamik Eisy Diagnose" VALUE 0xa1012d98 _REC_VAL_20_s2 98.30250000000001 _CNV_R_R_Def_rf_sw__616_CM -327.68 327.67 FORMAT "%7.4" /end CHARACTERISTIC
/begin CHARACTERISTIC K_DRF_EISYDMX "Maxschwelle für Lastdynamik Eisy Diagnose" VALUE 0xa1012d96 _REC_VAL_20_s2 98.30250000000001 _CNV_R_R_Def_rf_sw__616_CM -327.68 327.67 FORMAT "%7.4" /end CHARACTERISTIC
/begin CHARACTERISTIC K_DTOG_UBMIN "" VALUE 0xa100de46 _REC_VAL_20_u2 123.46794 _CNV_R_R_Def_u_sb_q_598_CM 0. 6173.397 FORMAT "%4.1" /end CHARACTERISTIC
/begin CHARACTERISTIC K_DVNS_IREGOFF1 "Abstand zum Anschlag bei dem der I-Anteil nicht gerechnet wird" VAL_BLK 0xa101d22e _REC_VAL_2_u2 131.07 _CNV_R_R_Def_spr_sw_583_CM 0. 6553.5 FORMAT "%5.2" NUMBER 2 /end CHARACTERISTIC
/begin CHARACTERISTIC K_DVNS_IREGOFF2 "Abstand zum Anschlag bei dem der I-Anteil nicht gerechnet wird" VAL_BLK 0xa101d232 _REC_VAL_2_u2 131.07 _CNV_R_R_Def_spr_sw_583_CM 0. 6553.5 FORMAT "%5.2" NUMBER 2 /end CHARACTERISTIC
/begin CHARACTERISTIC K_EINGANG_DK "Anzahl Eingänge für DK-Lolimot-KNN" VALUE 0xa10124cd _REC_VAL_20_u1 4. _CNV_R_R_Def_dez_sl_575_CM 0. 4. FORMAT "%3.0" /end CHARACTERISTIC
/begin CHARACTERISTIC K_EISY_SEG2SCHW "Zweite Drehzahlschwelle für eisy segment task laufzeit opt." VALUE 0xa10111a0 _REC_VAL_20_s2 0. _CNV_R_R_Def_n_sw_q_612_CM -32768. 32767. FORMAT "%5.0" /end CHARACTERISTIC
/begin CHARACTERISTIC K_EISY_SEGSCHW "Drehzahlschwelle für eisy segment task laufzeit opt." VALUE 0xa101119e _REC_VAL_20_s2 0. _CNV_R_R_Def_n_sw_q_612_CM -32768. 32767. FORMAT "%5.0" /end CHARACTERISTIC
/begin CHARACTERISTIC K_ESP_ADPWF "Adaptionswert Anschlag Einlassspreizung bei Powerfail" VALUE 0xa101d204 _REC_VAL_20_u2 131.07 _CNV_R_R_Def_spr_sw_583_CM 0. 6553.5 FORMAT "%5.2" /end CHARACTERISTIC
/begin CHARACTERISTIC K_ESP_ADTV "Adaptionstastverhaeltnis Einlassspreizung variable NWS" VALUE 0xa101d1f9 _REC_VAL_20_u1 99.45 _CNV_R_R_Def_dez_sl_575_CM 0. 255. FORMAT "%3.0" /end CHARACTERISTIC
/begin CHARACTERISTIC K_ESP_BA "Betriebsartenwahlschalter Einlassspreizung variable NWS" VALUE 0xa101d1f8 _REC_VAL_20_u1 99.45 _CNV_R_R_Def_dez_sl_575_CM 0. 255. FORMAT "%3.0" /end CHARACTERISTIC
/begin CHARACTERISTIC K_ESP_TVHB "ausgegebenes Tastverhaeltnis bei Handbetrieb fuer Einlassspreizung variable NWS" VALUE 0xa101d1fa _REC_VAL_20_u1 99.45 _CNV_R_R_Def_dez_sl_575_CM 0. 255. FORMAT "%3.0" /end CHARACTERISTIC
/begin CHARACTERISTIC K_ESP_WNWS "Sollspreizung bei Handbetrieb fuer Einlassspreizung variable NWS" VALUE 0xa101d202 _REC_VAL_20_u2 131.07 _CNV_R_R_Def_spr_sw_583_CM 0. 6553.5 FORMAT "%5.2" /end CHARACTERISTIC
/begin CHARACTERISTIC K_HUBMN_DIAG "Minimalhub für Freigabe HFM-Diagnose" VALUE 0xa1012d9c _REC_VAL_20_u2 65.535 _CNV_R_R_Def_hub_uw_605_CM 0. 65.535 /end CHARACTERISTIC
/begin CHARACTERISTIC K_HUBOFF "" VALUE 0xa101142e _REC_VAL_20_u2 65.535 _CNV_R_R_Def_hub_uw_605_CM 0. 65.535 /end CHARACTERISTIC
/begin CHARACTERISTIC K_LOLIDK_MN "Lolimot Mingrenze VVT" VALUE 0xa101254a _REC_VAL_20_S4 0. _CNV_R_R_Def_dez_sl_575_CM -1000000000000. 10000000000000. FORMAT "%14.7" /end CHARACTERISTIC
/begin CHARACTERISTIC K_LOLIDK_MX "Lolimot Maxgrenze VVT" VALUE 0xa1012546 _REC_VAL_20_S4 0. _CNV_R_R_Def_dez_sl_575_CM -1000000000000. 10000000000000. FORMAT "%14.7" /end CHARACTERISTIC
/begin CHARACTERISTIC K_MAREGDKIMN "Minimalbegrenzung I-Anteil Mareg Drosselklappe" VALUE 0xa10124d6 _REC_VAL_20_s2 1.9999 _CNV_R_R_Def_f_uw_b_579_CM -1. 0.9999 FORMAT "%14.5" /end CHARACTERISTIC
/begin CHARACTERISTIC K_MAREGDKIMX "Maximalbegrenzung I-Anteil Mareg Drosselklappe" VALUE 0xa10124d8 _REC_VAL_20_s2 1.9999 _CNV_R_R_Def_f_uw_b_579_CM -1. 0.9999 FORMAT "%14.5" /end CHARACTERISTIC
/begin CHARACTERISTIC K_MAREGDKMN "Minimalbegrenzung Reglerausgang Mareg Drosselklappe" VALUE 0xa10124d2 _REC_VAL_20_s2 1.9999 _CNV_R_R_Def_f_uw_b_579_CM -1. 0.9999 FORMAT "%14.5" /end CHARACTERISTIC
/begin CHARACTERISTIC K_MAREGDKMX "Maximalbegrenzung Reglerausgang Mareg Drosselklappe" VALUE 0xa10124d4 _REC_VAL_20_s2 1.9999 _CNV_R_R_Def_f_uw_b_579_CM -1. 0.9999 FORMAT "%14.5" /end CHARACTERISTIC
/begin CHARACTERISTIC K_MAREGDKNN_MN "Minimalbegrenzung Lolimot-Lern Mareg Drosselklappe" VALUE 0xa10124da _REC_VAL_20_s2 1.9999 _CNV_R_R_Def_f_uw_b_579_CM -1. 0.9999 FORMAT "%14.5" /end CHARACTERISTIC
/begin CHARACTERISTIC K_MAREGDKNN_MX "Maximalbegrenzung Lolimot-Lern Mareg Drosselklappe" VALUE 0xa10124dc _REC_VAL_20_s2 1.9999 _CNV_R_R_Def_f_uw_b_579_CM -1. 0.9999 FORMAT "%14.5" /end CHARACTERISTIC
/begin CHARACTERISTIC K_MRDVH_MN "Schwellwert für Freigabe Mareg DK-Adaption abh. von Dhubra" VALUE 0xa10124e2 _REC_VAL_20_u2 65.535 _CNV_R_R_Def_hub_uw_605_CM 0. 65.535 /end CHARACTERISTIC
/begin CHARACTERISTIC K_MRD_MN "Schwellwert für Freigabe Mareg DK-Teil abhängig von Dpsfak" VALUE 0xa10124cf _REC_VAL_20_u1 0.996 _CNV_R_R_Def_f_ub_b_573_CM 0. 0.996 /end CHARACTERISTIC
/begin CHARACTERISTIC K_MRD_MS_FAK "Voreinstellung Faktor DK-Regler-Ausgang" VALUE 0xa10124e0 _REC_VAL_20_s2 1.9999 _CNV_R_R_Def_f_uw_b_579_CM -1. 0.9999 FORMAT "%14.5" /end CHARACTERISTIC
/begin CHARACTERISTIC K_MRD_MS_OFF "Voreinstellung Offset Hub-Regler-Ausgang" VALUE 0xa10124de _REC_VAL_20_s2 102.398435 _CNV_R_R_Def_ms_uw__611_CM -1024. 1023.9687 /end CHARACTERISTIC
/begin CHARACTERISTIC K_MRGES_DKMN "" VALUE 0xa101252a _REC_VAL_20_s2 1.9999 _CNV_R_R_Def_f_uw_b_579_CM -1. 0.9999 FORMAT "%14.5" /end CHARACTERISTIC
/begin CHARACTERISTIC K_MRGES_DKMX "" VALUE 0xa1012528 _REC_VAL_20_s2 1.9999 _CNV_R_R_Def_f_uw_b_579_CM -1. 0.9999 FORMAT "%14.5" /end CHARACTERISTIC
/begin CHARACTERISTIC K_MRLINDK_MN "" VALUE 0xa101253e _REC_VAL_20_u2 0.9999 _CNV_R_R_Def_f_uw_b_591_CM 0. 0.9999 FORMAT "%14.5" /end CHARACTERISTIC
/begin CHARACTERISTIC K_MRV_MX "Schwellwert für Freigabe Mareg VVT-Teil abhängig von Dpsfak" VALUE 0xa10124ce _REC_VAL_20_u1 0.996 _CNV_R_R_Def_f_ub_b_573_CM 0. 0.996 /end CHARACTERISTIC
/begin CHARACTERISTIC K_NADONN "Mareg enable Schwelle, Motordrehzahl" VALUE 0xa1012534 _REC_VAL_20_s2 0. _CNV_R_R_Def_n_sw_q_612_CM -32768. 32767. FORMAT "%5.0" /end CHARACTERISTIC
/begin CHARACTERISTIC K_NEDIAGMN "" VALUE 0xa1012d54 _REC_VAL_20_s2 0. _CNV_R_R_Def_n_sw_q_612_CM -32768. 32767. FORMAT "%5.0" /end CHARACTERISTIC
/begin CHARACTERISTIC K_NEDIAGMX "" VALUE 0xa1012d56 _REC_VAL_20_s2 0. _CNV_R_R_Def_n_sw_q_612_CM -32768. 32767. FORMAT "%5.0" /end CHARACTERISTIC
/begin CHARACTERISTIC K_NKWDISADEAK "Deak. Schwelle DISA" VALUE 0xa1011442 _REC_VAL_20_s2 0. _CNV_R_R_Def_n_sw_q_612_CM -32768. 32767. FORMAT "%5.0" /end CHARACTERISTIC
/begin CHARACTERISTIC K_NKWMIN_MR "Minimaldrehzahl Massenstromregler" VALUE 0xa1012540 _REC_VAL_20_s2 0. _CNV_R_R_Def_n_sw_q_612_CM -32768. 32767. FORMAT "%5.0" /end CHARACTERISTIC
/begin CHARACTERISTIC K_NKWMRNN_RAMP "Nkw ramp enable" VALUE 0xa1012522 _REC_VAL_20_s2 0. _CNV_R_R_Def_n_sw_q_612_CM -32768. 32767. FORMAT "%5.0" /end CHARACTERISTIC
/begin CHARACTERISTIC K_NKW_DISA1 "Obere Hysterese-schwelle DISA (Übergang Disabereich 1->2)" VALUE 0xa1011446 _REC_VAL_20_s2 0. _CNV_R_R_Def_n_sw_q_612_CM -32768. 32767. FORMAT "%5.0" /end CHARACTERISTIC
/begin CHARACTERISTIC K_NKW_DISA2 "Obere Hysterese-schwelle DISA (Übergang Disabereich 2->3)" VALUE 0xa1011448 _REC_VAL_20_s2 0. _CNV_R_R_Def_n_sw_q_612_CM -32768. 32767. FORMAT "%5.0" /end CHARACTERISTIC
/begin CHARACTERISTIC K_NMIN_RF_START "min. Drehzahl fuer konst. RF im Start." VALUE 0xa10113ba _REC_VAL_20_s2 0. _CNV_R_R_Def_n_sw_q_612_CM -32768. 32767. FORMAT "%5.0" /end CHARACTERISTIC
/begin CHARACTERISTIC K_NMN_HFMDPERM "Drehzahl über der B_hfm_diag durch S_HFM_DIAG_PERM gesetzt wird" VALUE 0xa1012dae _REC_VAL_20_s2 0. _CNV_R_R_Def_n_sw_q_612_CM -32768. 32767. FORMAT "%5.0" /end CHARACTERISTIC
/begin CHARACTERISTIC K_NMOTVNSAD "Drehrahl, unterhalb der die Adaption verboten ist" VALUE 0xa101d212 _REC_VAL_20_s2 0. _CNV_R_R_Def_n_sw_q_612_CM 0. 32767. FORMAT "%5.0" /end CHARACTERISTIC
/begin CHARACTERISTIC K_NMSNVTO "" VALUE 0xa101253c _REC_VAL_20_s2 0. _CNV_R_R_Def_n_sw_q_612_CM -32768. 32767. FORMAT "%5.0" /end CHARACTERISTIC
/begin CHARACTERISTIC K_NNADQUOT_DK "Aufteilungsfaktor für DK-Lolimot-KNN" VALUE 0xa10124e8 _REC_VAL_20_S4 0. _CNV_R_R_Def_dez_sl_575_CM -1000000000000. 10000000000000. FORMAT "%14.7" /end CHARACTERISTIC
/begin CHARACTERISTIC K_NWAFLANKE "Individuelle Flankenkorrektur Auslass Bank1" VAL_BLK 0xa101e880 _REC_VAL_2_u2 131.07 _CNV_R_R_Def_spr_sw_583_CM 0. 6553.5 FORMAT "%5.2" NUMBER 4 /end CHARACTERISTIC
/begin CHARACTERISTIC K_NWASB "Bereich Nockenwellen-Auslassspreizung" VALUE 0xa1011452 _REC_VAL_20_u2 131.07 _CNV_R_R_Def_spr_sw_583_CM 0. 6553.5 FORMAT "%5.2" /end CHARACTERISTIC
/begin CHARACTERISTIC K_NWEFLANKE "Individuelle Flankenkorrektur Einlass Bank1" VAL_BLK 0xa101e878 _REC_VAL_2_u2 131.07 _CNV_R_R_Def_spr_sw_583_CM 0. 6553.5 FORMAT "%5.2" NUMBER 4 /end CHARACTERISTIC
/begin CHARACTERISTIC K_NWESB "Bereich Nockenwellen-Einlassspreizung" VALUE 0xa1011450 _REC_VAL_20_u2 131.07 _CNV_R_R_Def_spr_sw_583_CM 0. 6553.5 FORMAT "%5.2" /end CHARACTERISTIC
/begin CHARACTERISTIC K_NWSEGOFFS "Vanos Segmentoffset zur Flankenidentifikation" VAL_BLK 0xa101e870 _REC_VAL_2_u2 131.07 _CNV_R_R_Def_spr_sw_583_CM 0. 6553.5 FORMAT "%5.2" NUMBER 4 /end CHARACTERISTIC
/begin CHARACTERISTIC K_NW_MIN "minimale Nockenwellenposition Rohwert" VAL_BLK 0xa101e888 _REC_VAL_2_u2 131.07 _CNV_R_R_Def_spr_sw_583_CM 0. 6553.5 FORMAT "%5.2" NUMBER 2 /end CHARACTERISTIC
/begin CHARACTERISTIC K_OZDIAGNMOT "Mindestdrehzahl zur QLT-Diagnose" VALUE 0xa100de40 _REC_VAL_20_s2 0. _CNV_R_R_Def_n_sw_q_612_CM -32768. 32767. FORMAT "%5.0" /end CHARACTERISTIC
/begin CHARACTERISTIC K_OZDIAGNMOT2 "Max Drehzahl zur QLT-Diagnose" VALUE 0xa100de42 _REC_VAL_20_s2 0. _CNV_R_R_Def_n_sw_q_612_CM -32768. 32767. FORMAT "%5.0" /end CHARACTERISTIC
/begin CHARACTERISTIC K_OZDIAGSPG "Spannung, unterhalb der die Diagnose ausgeblendet wird" VALUE 0xa100de48 _REC_VAL_20_u2 123.46794 _CNV_R_R_Def_u_sb_q_598_CM 0. 6173.397 FORMAT "%4.1" /end CHARACTERISTIC
/begin CHARACTERISTIC K_OZERRD "Entprellzeit Sensor- und Kommunikationsfehler" VALUE 0xa100de4a _REC_VAL_20_u2 0. _CNV_R_R_Def_dez_sl_575_CM 0. 65535. FORMAT "%5.0" /end CHARACTERISTIC
/begin CHARACTERISTIC K_OZHEAL "Entprellzeit Fehler-Healing" VALUE 0xa100de4c _REC_VAL_20_u2 0. _CNV_R_R_Def_dez_sl_575_CM 0. 65535. FORMAT "%5.0" /end CHARACTERISTIC
/begin CHARACTERISTIC K_OZPLTEMP "Max Temperatursprung QLT (Plausibilisierung wegen ASIC-Pins Bruch)" VALUE 0xa100de50 _REC_VAL_20_u1 99.45 _CNV_R_R_Def_dez_sl_575_CM 0. 255. FORMAT "%3.0" /end CHARACTERISTIC
/begin CHARACTERISTIC K_OZPLZTEMP "Max unplausibel Sprünge (Plausibilisierung wegen ASIC-Pins Bruch)" VALUE 0xa100de51 _REC_VAL_20_u1 99.45 _CNV_R_R_Def_dez_sl_575_CM 0. 255. FORMAT "%3.0" /end CHARACTERISTIC
/begin CHARACTERISTIC K_OZTEMPQERR "Temperaturschwelle für den Permittivitätsfehler" VALUE 0xa100de44 _REC_VAL_20_s2 131.07 _CNV_R_R_Def_t_sw_q_618_CM -3276.8 3276.7 FORMAT "%4.1" /end CHARACTERISTIC
/begin CHARACTERISTIC K_OZZTEMP "Max Zeit mit dem selben Temperaturwert (Plausibilisierung wegen ASIC-Pins Bruch)" VALUE 0xa100de4e _REC_VAL_20_u2 0. _CNV_R_R_Def_dez_sl_575_CM 0. 65535. FORMAT "%5.0" /end CHARACTERISTIC
/begin CHARACTERISTIC K_PIRGNN_ANZ "Anzahl Neuronen für PIRG NN" VALUE 0xa1011427 _REC_VAL_20_u1 20. _CNV_R_R_Def_dez_sl_575_CM 0. 20. FORMAT "%3.0" /end CHARACTERISTIC
/begin CHARACTERISTIC K_PIRGNN_ANZ2 "Anzahl Neuronen für PIRG NN" VALUE 0xa1011428 _REC_VAL_20_u1 20. _CNV_R_R_Def_dez_sl_575_CM 0. 20. FORMAT "%3.0" /end CHARACTERISTIC
/begin CHARACTERISTIC K_PIRGNN_ANZ3 "Anzahl Neuronen für PIRG NN" VALUE 0xa1011429 _REC_VAL_20_u1 20. _CNV_R_R_Def_dez_sl_575_CM 0. 20. FORMAT "%3.0" /end CHARACTERISTIC
/begin CHARACTERISTIC K_PIRGWOUT_BIAS "Gewichte des Biasterms der Ausgangschicht, PIRG NN" VALUE 0xa1011460 _REC_VAL_20_S4 0. _CNV_R_R_Def_dez_sl_575_CM -1000000000000. 10000000000000. FORMAT "%14.7" /end CHARACTERISTIC
/begin CHARACTERISTIC K_PIRGWOUT_BIAS2 "Gewichte des Biasterms der Ausgangschicht, PIRG NN" VALUE 0xa1011464 _REC_VAL_20_S4 0. _CNV_R_R_Def_dez_sl_575_CM -1000000000000. 10000000000000. FORMAT "%14.7" /end CHARACTERISTIC
/begin CHARACTERISTIC K_PIRGWOUT_BIAS3 "Gewichte des Biasterms der Ausgangschicht, PIRG NN" VALUE 0xa1011468 _REC_VAL_20_S4 0. _CNV_R_R_Def_dez_sl_575_CM -1000000000000. 10000000000000. FORMAT "%14.7" /end CHARACTERISTIC
/begin CHARACTERISTIC K_PIRG_MN "Kennwert MIN-Grenze Pirg aus N.N." VALUE 0xa101144e _REC_VAL_20_u2 102.398436 _CNV_R_R_Def_p_sw_q_578_CM 0. 2559.9609 FORMAT "%5.2" /end CHARACTERISTIC
/begin CHARACTERISTIC K_PSABS_T100 "Ps_abs_t100 Ersatzwert bis Layer 12" VALUE 0xa1012daa _REC_VAL_20_u2 102.398436 _CNV_R_R_Def_p_sw_q_578_CM 0. 2559.9609 FORMAT "%5.2" /end CHARACTERISTIC
/begin CHARACTERISTIC K_PSABS_TOL "Ps_abs Sensor Toleranz" VALUE 0xa1012da6 _REC_VAL_20_u2 102.398436 _CNV_R_R_Def_p_sw_q_578_CM 0. 2559.9609 FORMAT "%5.2" /end CHARACTERISTIC
/begin CHARACTERISTIC K_PSPVK_SOLLMN1 "" VALUE 0xa1012514 _REC_VAL_20_u2 3.9999 _CNV_R_R_Def_f_sw_b_608_CM 0. 3.9999 FORMAT "%14.5" /end CHARACTERISTIC
/begin CHARACTERISTIC K_PSPVK_SOLLMN2 "" VALUE 0xa1012516 _REC_VAL_20_u2 3.9999 _CNV_R_R_Def_f_sw_b_608_CM 0. 3.9999 FORMAT "%14.5" /end CHARACTERISTIC
/begin CHARACTERISTIC K_PSPVK_SOLLMN3 "" VALUE 0xa1012518 _REC_VAL_20_u2 3.9999 _CNV_R_R_Def_f_sw_b_608_CM 0. 3.9999 FORMAT "%14.5" /end CHARACTERISTIC
/begin CHARACTERISTIC K_PSPVK_SOLLMN4 "" VALUE 0xa101251a _REC_VAL_20_u2 3.9999 _CNV_R_R_Def_f_sw_b_608_CM 0. 3.9999 FORMAT "%14.5" /end CHARACTERISTIC
/begin CHARACTERISTIC K_PULSNMN1 "" VALUE 0xa10124fc _REC_VAL_20_s2 0. _CNV_R_R_Def_n_sw_q_612_CM -32768. 32767. FORMAT "%5.0" /end CHARACTERISTIC
/begin CHARACTERISTIC K_PULSNMN2 "" VALUE 0xa10124fe _REC_VAL_20_s2 0. _CNV_R_R_Def_n_sw_q_612_CM -32768. 32767. FORMAT "%5.0" /end CHARACTERISTIC
/begin CHARACTERISTIC K_PULSNMN3 "" VALUE 0xa1012500 _REC_VAL_20_s2 0. _CNV_R_R_Def_n_sw_q_612_CM -32768. 32767. FORMAT "%5.0" /end CHARACTERISTIC
/begin CHARACTERISTIC K_PULSNMN4 "" VALUE 0xa1012502 _REC_VAL_20_s2 0. _CNV_R_R_Def_n_sw_q_612_CM -32768. 32767. FORMAT "%5.0" /end CHARACTERISTIC
/begin CHARACTERISTIC K_PULSNMX1 "" VALUE 0xa10124f4 _REC_VAL_20_s2 0. _CNV_R_R_Def_n_sw_q_612_CM -32768. 32767. FORMAT "%5.0" /end CHARACTERISTIC
/begin CHARACTERISTIC K_PULSNMX2 "" VALUE 0xa10124f6 _REC_VAL_20_s2 0. _CNV_R_R_Def_n_sw_q_612_CM -32768. 32767. FORMAT "%5.0" /end CHARACTERISTIC
/begin CHARACTERISTIC K_PULSNMX3 "" VALUE 0xa10124f8 _REC_VAL_20_s2 0. _CNV_R_R_Def_n_sw_q_612_CM -32768. 32767. FORMAT "%5.0" /end CHARACTERISTIC
/begin CHARACTERISTIC K_PULSNMX4 "" VALUE 0xa10124fa _REC_VAL_20_s2 0. _CNV_R_R_Def_n_sw_q_612_CM -32768. 32767. FORMAT "%5.0" /end CHARACTERISTIC
/begin CHARACTERISTIC K_PULSRFVMN1 "" VALUE 0xa101250c _REC_VAL_20_s2 98.30250000000001 _CNV_R_R_Def_rf_sw__616_CM -327.68 327.67 FORMAT "%7.4" /end CHARACTERISTIC
/begin CHARACTERISTIC K_PULSRFVMN2 "" VALUE 0xa101250e _REC_VAL_20_s2 98.30250000000001 _CNV_R_R_Def_rf_sw__616_CM -327.68 327.67 FORMAT "%7.4" /end CHARACTERISTIC
/begin CHARACTERISTIC K_PULSRFVMN3 "" VALUE 0xa1012510 _REC_VAL_20_s2 98.30250000000001 _CNV_R_R_Def_rf_sw__616_CM -327.68 327.67 FORMAT "%7.4" /end CHARACTERISTIC
/begin CHARACTERISTIC K_PULSRFVMN4 "" VALUE 0xa1012512 _REC_VAL_20_s2 98.30250000000001 _CNV_R_R_Def_rf_sw__616_CM -327.68 327.67 FORMAT "%7.4" /end CHARACTERISTIC
/begin CHARACTERISTIC K_PULSRFVMX1 "" VALUE 0xa1012504 _REC_VAL_20_s2 98.30250000000001 _CNV_R_R_Def_rf_sw__616_CM -327.68 327.67 FORMAT "%7.4" /end CHARACTERISTIC
/begin CHARACTERISTIC K_PULSRFVMX2 "" VALUE 0xa1012506 _REC_VAL_20_s2 98.30250000000001 _CNV_R_R_Def_rf_sw__616_CM -327.68 327.67 FORMAT "%7.4" /end CHARACTERISTIC
/begin CHARACTERISTIC K_PULSRFVMX3 "" VALUE 0xa1012508 _REC_VAL_20_s2 98.30250000000001 _CNV_R_R_Def_rf_sw__616_CM -327.68 327.67 FORMAT "%7.4" /end CHARACTERISTIC
/begin CHARACTERISTIC K_PULSRFVMX4 "" VALUE 0xa101250a _REC_VAL_20_s2 98.30250000000001 _CNV_R_R_Def_rf_sw__616_CM -327.68 327.67 FORMAT "%7.4" /end CHARACTERISTIC
/begin CHARACTERISTIC K_PUMN_DIAG "Minimal Umgebungsdruck für Freigabe Diagnose" VALUE 0xa1012d9e _REC_VAL_20_u2 102.398436 _CNV_R_R_Def_p_sw_q_578_CM 0. 2559.9609 FORMAT "%5.2" /end CHARACTERISTIC
/begin CHARACTERISTIC K_PVDKDS_T100 "Pvdkds_t100 Ersatzwert bis Layer 12" VALUE 0xa1012da8 _REC_VAL_20_u2 102.398436 _CNV_R_R_Def_p_sw_q_578_CM 0. 2559.9609 FORMAT "%5.2" /end CHARACTERISTIC
/begin CHARACTERISTIC K_PVDKDS_TOL "Pvdkds Sensor Toleranz" VALUE 0xa1012da4 _REC_VAL_20_u2 102.398436 _CNV_R_R_Def_p_sw_q_578_CM 0. 2559.9609 FORMAT "%5.2" /end CHARACTERISTIC
/begin CHARACTERISTIC K_RFEDIAGMN "Minimale Rf für Eisy-Diagnose" VALUE 0xa1012d58 _REC_VAL_20_s2 98.30250000000001 _CNV_R_R_Def_rf_sw__616_CM -327.68 327.67 FORMAT "%7.4" /end CHARACTERISTIC
/begin CHARACTERISTIC K_RFEDIAGMX "Maximale Rf für Eisy-Diagnose" VALUE 0xa1012d5a _REC_VAL_20_s2 98.30250000000001 _CNV_R_R_Def_rf_sw__616_CM -327.68 327.67 FORMAT "%7.4" /end CHARACTERISTIC
/begin CHARACTERISTIC K_RFMIN_EISY "MIN Rf aus EISY" VALUE 0xa1011198 _REC_VAL_20_s2 98.30250000000001 _CNV_R_R_Def_rf_sw__616_CM -327.68 327.67 FORMAT "%7.4" /end CHARACTERISTIC
/begin CHARACTERISTIC K_RFTDINI "Ini Wert für Rf verzögert" VALUE 0xa10111aa _REC_VAL_20_s2 98.30250000000001 _CNV_R_R_Def_rf_sw__616_CM -327.68 327.67 FORMAT "%7.4" /end CHARACTERISTIC
/begin CHARACTERISTIC K_RFVISTNN_ANZ "Anzahl Neuronen für RFVISTNN" VALUE 0xa1011424 _REC_VAL_20_u1 20. _CNV_R_R_Def_dez_sl_575_CM 0. 20. FORMAT "%3.0" /end CHARACTERISTIC
/begin CHARACTERISTIC K_RFVISTNN_ANZ2 "Anzahl Neuronen für RFVISTNN" VALUE 0xa1011425 _REC_VAL_20_u1 20. _CNV_R_R_Def_dez_sl_575_CM 0. 20. FORMAT "%3.0" /end CHARACTERISTIC
/begin CHARACTERISTIC K_RFVISTNN_ANZ3 "Anzahl Neuronen für RFVISTNN" VALUE 0xa1011426 _REC_VAL_20_u1 20. _CNV_R_R_Def_dez_sl_575_CM 0. 20. FORMAT "%3.0" /end CHARACTERISTIC
/begin CHARACTERISTIC K_RFVISTWOUT_BIAS "Gewichte des Biasterms der Ausgangschicht, RFVISTNN" VALUE 0xa1011454 _REC_VAL_20_S4 0. _CNV_R_R_Def_dez_sl_575_CM -1000000000000. 10000000000000. FORMAT "%14.7" /end CHARACTERISTIC
/begin CHARACTERISTIC K_RFVISTWOUT_BIAS2 "Gewichte des Biasterms der Ausgangschicht, RFVISTNN" VALUE 0xa1011458 _REC_VAL_20_S4 0. _CNV_R_R_Def_dez_sl_575_CM -1000000000000. 10000000000000. FORMAT "%14.7" /end CHARACTERISTIC
/begin CHARACTERISTIC K_RFVISTWOUT_BIAS3 "Gewichte des Biasterms der Ausgangschicht, RFVISTNN" VALUE 0xa101145c _REC_VAL_20_S4 0. _CNV_R_R_Def_dez_sl_575_CM -1000000000000. 10000000000000. FORMAT "%14.7" /end CHARACTERISTIC
/begin CHARACTERISTIC K_SPRZG_AN "Position der Anschlagspreizung" VAL_BLK 0xa101e866 _REC_VAL_2_u2 131.07 _CNV_R_R_Def_spr_sw_583_CM 0. 6553.5 FORMAT "%5.2" NUMBER 2 /end CHARACTERISTIC
/begin CHARACTERISTIC K_SPRZG_VB "Verstellbereich Vanos" VAL_BLK 0xa101d1f4 _REC_VAL_2_u2 131.07 _CNV_R_R_Def_spr_sw_583_CM 0. 6553.5 FORMAT "%5.2" NUMBER 2 /end CHARACTERISTIC
/begin CHARACTERISTIC K_TADONTM "Mareg enable Schwelle, Motortemperatur" VALUE 0xa101252e _REC_VAL_20_s2 98.30250000000001 _CNV_R_R_Def_t_sw_q_620_CM -327.68 327.67 FORMAT "%5.2" /end CHARACTERISTIC
/begin CHARACTERISTIC K_TADONTNS "Mareg enable Schwelle, Zeit Nach Start" VALUE 0xa101252c _REC_VAL_20_u2 98.30250000000001 _CNV_R_R_Def_td_uw__679_CM 0. 655.35 FORMAT "%5.2" /end CHARACTERISTIC
/begin CHARACTERISTIC K_TAEDIAGMN "Minimal-Ansauglufttemperatur für Eisy-Diagnose" VALUE 0xa1012d5e _REC_VAL_20_s2 131.07 _CNV_R_R_Def_t_sw_q_618_CM -3276.8 3276.7 FORMAT "%4.1" /end CHARACTERISTIC
/begin CHARACTERISTIC K_TAEDIAGMX "Maximal-Ansauglufttemperatur für Eisy-Diagnose" VALUE 0xa1012d5c _REC_VAL_20_s2 131.07 _CNV_R_R_Def_t_sw_q_618_CM -3276.8 3276.7 FORMAT "%4.1" /end CHARACTERISTIC
/begin CHARACTERISTIC K_TDADONTAMN "Mareg enable Schwelle, Ansauglufttemperatur" VALUE 0xa1012530 _REC_VAL_20_s2 98.30250000000001 _CNV_R_R_Def_t_sw_q_620_CM -327.68 327.67 FORMAT "%5.2" /end CHARACTERISTIC
/begin CHARACTERISTIC K_TDADONTAMX "Mareg enable Schwelle, Ansauglufttemperatur" VALUE 0xa1012532 _REC_VAL_20_s2 98.30250000000001 _CNV_R_R_Def_t_sw_q_620_CM -327.68 327.67 FORMAT "%5.2" /end CHARACTERISTIC
/begin CHARACTERISTIC K_TD_DRDIAGAKT "Erlaubter Zeit für Drucksensorabgleich" VALUE 0xa1012da2 _REC_VAL_20_u2 131.07 _CNV_R_R_Def_td_ub__593_CM 0. 6553.5 FORMAT "%4.1" /end CHARACTERISTIC
/begin CHARACTERISTIC K_TD_EISYD "Zeitkonstante Verzögerung Freigabe Eisy Diagnose durch Dynamikerkennung" VALUE 0xa1012d40 _REC_VAL_20_u1 25.5 _CNV_R_R_Def_td_ub__593_CM 0. 25.5 FORMAT "%4.1" /end CHARACTERISTIC
/begin CHARACTERISTIC K_TD_EVNNUMSCH "DISA umschaltungzeit (segment)" VALUE 0xa1011430 _REC_VAL_20_u2 0. _CNV_R_R_Def_dez_sl_575_CM 0. 65535. FORMAT "%5.0" /end CHARACTERISTIC
/begin CHARACTERISTIC K_TD_MODABST "Time Delay Modab-Regler nach Start Ende" VALUE 0xa1012542 _REC_VAL_20_u2 131.07 _CNV_R_R_Def_td_ub__593_CM 0. 6553.5 FORMAT "%4.1" /end CHARACTERISTIC
/begin CHARACTERISTIC K_TD_MRADONTE "Time Delay Adapation Start nach Wechsel B_te auf 0" VALUE 0xa1012544 _REC_VAL_20_u2 131.07 _CNV_R_R_Def_td_ub__593_CM 0. 6553.5 FORMAT "%4.1" /end CHARACTERISTIC
/begin CHARACTERISTIC K_TD_NNOFF "Zeit für Filterung des NN Ausgang" VALUE 0xa10124f0 _REC_VAL_20_u1 99.45 _CNV_R_R_Def_dez_sl_575_CM 0. 255. FORMAT "%3.0" /end CHARACTERISTIC
/begin CHARACTERISTIC K_TD_NNON "Zeit für Filterung des NN Ausgang" VALUE 0xa10124ef _REC_VAL_20_u1 99.45 _CNV_R_R_Def_dez_sl_575_CM 0. 255. FORMAT "%3.0" /end CHARACTERISTIC
/begin CHARACTERISTIC K_TD_RFSTART "" VALUE 0xa101119a _REC_VAL_20_u2 0. _CNV_R_R_Def_dez_sl_575_CM 0. 65535. FORMAT "%5.0" /end CHARACTERISTIC
/begin CHARACTERISTIC K_TD_RFVST "" VALUE 0xa1011192 _REC_VAL_20_u2 0. _CNV_R_R_Def_dez_sl_575_CM 0. 65535. FORMAT "%5.0" /end CHARACTERISTIC
/begin CHARACTERISTIC K_TIMSALLVT "Turn-on delay B_timsllv" VALUE 0xa101253a _REC_VAL_20_u2 131.07 _CNV_R_R_Def_td_ub__593_CM 0. 6553.5 FORMAT "%4.1" /end CHARACTERISTIC
/begin CHARACTERISTIC K_TIMSAON "Turn-on delay B_timsvvt" VALUE 0xa1012536 _REC_VAL_20_u2 131.07 _CNV_R_R_Def_td_ub__593_CM 0. 6553.5 FORMAT "%4.1" /end CHARACTERISTIC
/begin CHARACTERISTIC K_TIMSAVT "Turn-on delay B_timsavvt" VALUE 0xa1012538 _REC_VAL_20_u2 131.07 _CNV_R_R_Def_td_ub__593_CM 0. 6553.5 FORMAT "%4.1" /end CHARACTERISTIC
/begin CHARACTERISTIC K_TMEDIAGMN "" VALUE 0xa1012d52 _REC_VAL_20_s2 98.30250000000001 _CNV_R_R_Def_t_sw_q_620_CM -327.68 327.67 FORMAT "%5.2" /end CHARACTERISTIC
/begin CHARACTERISTIC K_TMMRNN_RAMP "Tmot ramp enable" VALUE 0xa1012520 _REC_VAL_20_s2 98.30250000000001 _CNV_R_R_Def_t_sw_q_620_CM -327.68 327.67 FORMAT "%5.2" /end CHARACTERISTIC
/begin CHARACTERISTIC K_TNSEDIAGMN "" VALUE 0xa1012d50 _REC_VAL_20_u2 98.30250000000001 _CNV_R_R_Def_td_uw__679_CM 0. 655.35 FORMAT "%5.2" /end CHARACTERISTIC
/begin CHARACTERISTIC K_TNSMN_HFMPERM "Zeit nach Start nach der B_hfm_diag durch S_HFM_DIAG_PERM gesetzt wird" VALUE 0xa1012dac _REC_VAL_20_u2 98.30250000000001 _CNV_R_R_Def_td_uw__679_CM 0. 655.35 FORMAT "%5.2" /end CHARACTERISTIC
/begin CHARACTERISTIC K_TNSMRNN_RAMP "Zeit nach Start ramp enable" VALUE 0xa1012524 _REC_VAL_20_u2 98.30250000000001 _CNV_R_R_Def_td_uw__679_CM 0. 655.35 FORMAT "%5.2" /end CHARACTERISTIC
/begin CHARACTERISTIC K_TOGMAXUNPL "" VALUE 0xa100de38 _REC_VAL_20_u4 0. _CNV_R_R_Def_dez_sl_575_CM 0. 4294967295. FORMAT "%7.0" /end CHARACTERISTIC
/begin CHARACTERISTIC K_TOG_CNTMAX "" VALUE 0xa100de3c _REC_VAL_20_u4 0. _CNV_R_R_Def_dez_sl_575_CM 0. 4294967295. FORMAT "%7.0" /end CHARACTERISTIC
/begin CHARACTERISTIC K_UBATTMIN_DIAGPL "Minimale Batteriespannung für Eisy Diagnose" VALUE 0xa1012d4a _REC_VAL_20_u2 123.46794 _CNV_R_R_Def_u_sb_q_598_CM 0. 6173.397 FORMAT "%4.1" /end CHARACTERISTIC
/begin CHARACTERISTIC K_UBATTMIN_DPSRDIAG "Minimale Batteriespannung für DPSR und Disa Diagnose" VALUE 0xa1012d4c _REC_VAL_20_u2 123.46794 _CNV_R_R_Def_u_sb_q_598_CM 0. 6173.397 FORMAT "%4.1" /end CHARACTERISTIC
/begin CHARACTERISTIC K_UBATTMIN_HFMDIAG "Minimale Batteriespannung für HFM-Diagnose" VALUE 0xa1012d4e _REC_VAL_20_u2 123.46794 _CNV_R_R_Def_u_sb_q_598_CM 0. 6173.397 FORMAT "%4.1" /end CHARACTERISTIC
/begin CHARACTERISTIC K_UFAK_MS_RF "Faktor Massenstrom in relative Luftfuellung" VALUE 0xa10113b8 _REC_VAL_20_u2 0.2441 _CNV_R_R_Def_umr_uw_787_CM 0. 0.2441 FORMAT "%14.6" /end CHARACTERISTIC
/begin CHARACTERISTIC K_VNSADPEXT_OFF "Offset auf Anschlagsadaption von extern" VALUE 0xa101e86a _REC_VAL_20_u2 99.60000000000001 _CNV_R_R_Def_spr_sw_583_CM 0. 120. FORMAT "%5.2" /end CHARACTERISTIC
/begin CHARACTERISTIC K_VNSKRITLOC "Fangbereich des Verriegelungspins" VALUE 0xa101d1fe _REC_VAL_20_u1 25.5 _CNV_R_R_Def_spr_sw_583_CM 0. 25.5 FORMAT "%5.2" /end CHARACTERISTIC
/begin CHARACTERISTIC K_VNSNMOTAN "Drehzahl, unterhalb der die Einheiten Verriegeln koennen (Fliehkraefte zu klein)" VALUE 0xa101d214 _REC_VAL_20_s2 0. _CNV_R_R_Def_n_sw_q_612_CM -32768. 32767. FORMAT "%5.0" /end CHARACTERISTIC
/begin CHARACTERISTIC K_VNSRTVIMN "" VALUE 0xa101d222 _REC_VAL_20_u2 99.99844999999999 _CNV_R_R_Def_rel_uw_742_CM -100. 99.9969 /end CHARACTERISTIC
/begin CHARACTERISTIC K_VNSRTVIMX1 "" VAL_BLK 0xa101d224 _REC_VAL_2_u2 99.99844999999999 _CNV_R_R_Def_rel_uw_742_CM -100. 99.9969 NUMBER 2 /end CHARACTERISTIC
/begin CHARACTERISTIC K_VNSRTVIMX2 "" VAL_BLK 0xa101d228 _REC_VAL_2_u2 99.99844999999999 _CNV_R_R_Def_rel_uw_742_CM -100. 99.9969 NUMBER 2 /end CHARACTERISTIC
/begin CHARACTERISTIC K_VNSRTVMN "Reglerbegrenzung Tastverhaeltnis min" VAL_BLK 0xa101d206 _REC_VAL_2_s2 99.99844999999999 _CNV_R_R_Def_rel_sw_788_CM -100. 99.9969 NUMBER 2 /end CHARACTERISTIC
/begin CHARACTERISTIC K_VNSRTVMX "Reglerbegrenzung Tastverhaeltnis max" VAL_BLK 0xa101d20a _REC_VAL_2_s2 99.99844999999999 _CNV_R_R_Def_rel_sw_788_CM -100. 99.9969 NUMBER 2 /end CHARACTERISTIC
/begin CHARACTERISTIC K_VNSTVIABDY "Ablschlag vom I-Regleranteil fuer adapt. Druckvorsteuerung" VALUE 0xa101d21a _REC_VAL_20_u2 99.99844999999999 _CNV_R_R_Def_rel_uw_742_CM -100. 99.9969 /end CHARACTERISTIC
/begin CHARACTERISTIC K_VNS_ADEND "Zeit, in der die Adaption abgeschlossen sein sollte" VALUE 0xa101d210 _REC_VAL_20_u2 98.30250000000001 _CNV_R_R_Def_td_uw__679_CM 0. 655.35 FORMAT "%5.2" /end CHARACTERISTIC
/begin CHARACTERISTIC K_VNS_ADT "Zeit, bei der die NWn sicher mit ad_tv den Anschlag erreichen" VALUE 0xa101d20e _REC_VAL_20_u2 98.30250000000001 _CNV_R_R_Def_td_uw__679_CM 0. 655.35 FORMAT "%5.2" /end CHARACTERISTIC
/begin CHARACTERISTIC K_VNS_ANAB "Abstand vom Anschlag" VALUE 0xa101d1fd _REC_VAL_20_u1 25.5 _CNV_R_R_Def_spr_sw_583_CM 0. 25.5 FORMAT "%5.2" /end CHARACTERISTIC
/begin CHARACTERISTIC K_VNS_DELTMX_IREG "Maximal zulässige Regelabweichung für Abschaltung I-Anteil in Anschlagsnähe" VALUE 0xa101d22c _REC_VAL_20_u2 131.07 _CNV_R_R_Def_spr_uw_744_CM -3276.8 3276.7 FORMAT "%5.2" /end CHARACTERISTIC
/begin CHARACTERISTIC K_VNS_DYN "Aenderungsbegrenzung des TV (Druckanstiegsgeschwindigkeitsbegrenzung)" VALUE 0xa101d21c _REC_VAL_20_u2 98.30250000000001 _CNV_R_R_Def_rf_sw__616_CM 0. 655.35 FORMAT "%5.2" /end CHARACTERISTIC
/begin CHARACTERISTIC K_VNS_NMVSTOP "Drehzahl, unterhalb der bei Kl15 aus Magnetventil des Einlaß mit max. TV angesteuert wird" VALUE 0xa101d216 _REC_VAL_20_s2 0. _CNV_R_R_Def_n_sw_q_612_CM -32768. 32767. FORMAT "%5.0" /end CHARACTERISTIC
/begin CHARACTERISTIC K_VNS_TMVSTOP "Zeit, für die bei Kl15 aus Magnetventil des Einlaß mit max. TV angesteuert wird" VALUE 0xa101d218 _REC_VAL_20_u2 98.30250000000001 _CNV_R_R_Def_td_uw__679_CM 0. 655.35 FORMAT "%5.2" /end CHARACTERISTIC
/begin CHARACTERISTIC K_VNS_TVINKW "" VALUE 0xa101d220 _REC_VAL_20_s2 0. _CNV_R_R_Def_n_sw_q_612_CM -32768. 32767. FORMAT "%5.0" /end CHARACTERISTIC
/begin CHARACTERISTIC K_VNS_TVITMOT "" VALUE 0xa101d21e _REC_VAL_20_s2 98.30250000000001 _CNV_R_R_Def_t_sw_q_620_CM -327.68 327.67 FORMAT "%5.2" /end CHARACTERISTIC
/begin CHARACTERISTIC K_VSAOFF "" VALUE 0xa101142c _REC_VAL_20_u2 131.07 _CNV_R_R_Def_spr_sw_583_CM 0. 6553.5 FORMAT "%5.2" /end CHARACTERISTIC
/begin CHARACTERISTIC K_VSEOFF "" VALUE 0xa101142a _REC_VAL_20_u2 131.07 _CNV_R_R_Def_spr_sw_583_CM 0. 6553.5 FORMAT "%5.2" /end CHARACTERISTIC
/begin CHARACTERISTIC K_WDKMN_DDPSR "Minimal DK-Winkel für Freigabe DPSR-Diagnose" VALUE 0xa1012da0 _REC_VAL_20_s2 95.99852999999999 _CNV_R_R_Def_wdk_sw_691_CM -800. 799.9755 FORMAT "%5.2" /end CHARACTERISTIC
/begin CHARACTERISTIC K_ZKDIAG_HQ "" VALUE 0xa1012d60 _REC_VAL_20_u2 6553.5 _CNV_R_R_Def_zk100m_749_CM 0.1 6553.6 FORMAT "%4.1" /end CHARACTERISTIC
/begin CHARACTERISTIC K_ZKDIAG_MSLQ "" VALUE 0xa1012d64 _REC_VAL_20_u2 6553.5 _CNV_R_R_Def_zk100m_749_CM 0.1 6553.6 FORMAT "%4.1" /end CHARACTERISTIC
/begin CHARACTERISTIC K_ZKDIAG_PS "" VALUE 0xa1012d66 _REC_VAL_20_u2 6553.5 _CNV_R_R_Def_zk100m_749_CM 0.1 6553.6 FORMAT "%4.1" /end CHARACTERISTIC
/begin CHARACTERISTIC K_ZKDIAG_WDKPS "" VALUE 0xa1012d68 _REC_VAL_20_u2 6553.5 _CNV_R_R_Def_zk100m_749_CM 0.1 6553.6 FORMAT "%4.1" /end CHARACTERISTIC
/begin CHARACTERISTIC K_ZKLF "Zeitkonstante Filter pvdkds" VALUE 0xa10111a8 _REC_VAL_20_u2 655.35 _CNV_R_R_Def_zk10ms_723_CM 1.e-002 655.36 FORMAT "%7.4" /end CHARACTERISTIC
/begin CHARACTERISTIC K_ZKMRDEV_IN "" VALUE 0xa10111ac _REC_VAL_20_u2 0.9999 _CNV_R_R_Def_f_uw_b_591_CM 0. 0.9999 FORMAT "%14.5" /end CHARACTERISTIC
/begin CHARACTERISTIC K_ZK_DIAGPSREG "" VALUE 0xa1012d62 _REC_VAL_20_u2 6553.5 _CNV_R_R_Def_zk100m_749_CM 0.1 6553.6 FORMAT "%4.1" /end CHARACTERISTIC
/begin CHARACTERISTIC K_ZK_EISYDSTN "Filterkonstante Drehzahlfilterung für Dynamikerkennung Eisy Diagnose" VALUE 0xa1012d8e _REC_VAL_20_u2 0.9999 _CNV_R_R_Def_f_uw_b_591_CM 0. 0.9999 FORMAT "%14.5" /end CHARACTERISTIC
/begin CHARACTERISTIC K_ZK_EISYDSTRF "Filterkonstante Lastfilterung für Dynamikerkennung Eisy Diagnose" VALUE 0xa1012d90 _REC_VAL_20_u2 0.9999 _CNV_R_R_Def_f_uw_b_591_CM 0. 0.9999 FORMAT "%14.5" /end CHARACTERISTIC
/begin CHARACTERISTIC K_ZK_EVMRASPR "Zeitkonstante fuer 10ms Filterzyklus" VALUE 0xa101143a _REC_VAL_20_u2 655.35 _CNV_R_R_Def_zk10ms_723_CM 1.e-002 655.36 FORMAT "%7.4" /end CHARACTERISTIC
/begin CHARACTERISTIC K_ZK_EVMRESPR "Zeitkonstante fuer 10ms Filterzyklus" VALUE 0xa1011438 _REC_VAL_20_u2 655.35 _CNV_R_R_Def_zk10ms_723_CM 1.e-002 655.36 FORMAT "%7.4" /end CHARACTERISTIC
/begin CHARACTERISTIC K_ZK_EVMRHUB "Zeitkonstante fuer 10ms Filterzyklus" VALUE 0xa1011436 _REC_VAL_20_u2 655.35 _CNV_R_R_Def_zk10ms_723_CM 1.e-002 655.36 FORMAT "%7.4" /end CHARACTERISTIC
/begin CHARACTERISTIC K_ZK_EVNNUMSCH "Zeitkonstante fuer 10ms Filterzyklus" VALUE 0xa1011432 _REC_VAL_20_u2 655.35 _CNV_R_R_Def_zk10ms_723_CM 1.e-002 655.36 FORMAT "%7.4" /end CHARACTERISTIC
/begin CHARACTERISTIC K_ZK_MPRMSFAK "Zeitkonstante Filter " VALUE 0xa10111a4 _REC_VAL_20_u2 655.35 _CNV_R_R_Def_zk10ms_723_CM 1.e-002 655.36 FORMAT "%7.4" /end CHARACTERISTIC
/begin CHARACTERISTIC K_ZK_MPRMSOFF "Zeitkonstante Filter " VALUE 0xa10111a6 _REC_VAL_20_u2 655.35 _CNV_R_R_Def_zk10ms_723_CM 1.e-002 655.36 FORMAT "%7.4" /end CHARACTERISTIC
/begin CHARACTERISTIC K_ZK_MRDKOFF "Massenstromregler Aus" VALUE 0xa10124d0 _REC_VAL_20_u2 99.83844000000001 _CNV_R_R_Def_f_uw_b_764_CM 0. 127.998 /end CHARACTERISTIC
/begin CHARACTERISTIC K_ZK_MREVFAK "" VALUE 0xa1011194 _REC_VAL_20_u2 0.9999 _CNV_R_R_Def_f_uw_b_591_CM 0. 0.9999 FORMAT "%14.5" /end CHARACTERISTIC
/begin CHARACTERISTIC K_ZK_MREVOFF "" VALUE 0xa1011196 _REC_VAL_20_u2 0.9999 _CNV_R_R_Def_f_uw_b_591_CM 0. 0.9999 FORMAT "%14.5" /end CHARACTERISTIC
/begin CHARACTERISTIC K_ZK_MRRAMP "Ramp gradient" VALUE 0xa1012526 _REC_VAL_20_u2 0.9999 _CNV_R_R_Def_f_uw_b_591_CM 0. 0.9999 FORMAT "%14.5" /end CHARACTERISTIC
/begin CHARACTERISTIC K_ZK_MSHFM "Zeitkonstante Filter Mshfm_ist" VALUE 0xa10111a2 _REC_VAL_20_u2 655.35 _CNV_R_R_Def_zk10ms_723_CM 1.e-002 655.36 FORMAT "%7.4" /end CHARACTERISTIC
/begin CHARACTERISTIC K_ZK_NNOFF "" VALUE 0xa101251e _REC_VAL_20_u2 0.9999 _CNV_R_R_Def_f_uw_b_591_CM 0. 0.9999 FORMAT "%14.5" /end CHARACTERISTIC
/begin CHARACTERISTIC K_ZK_NNON "" VALUE 0xa101251c _REC_VAL_20_u2 0.9999 _CNV_R_R_Def_f_uw_b_591_CM 0. 0.9999 FORMAT "%14.5" /end CHARACTERISTIC
/begin CHARACTERISTIC K_ZK_PIRGF "Zeitkonstante fuer 10ms Filterzyklus" VALUE 0xa1011434 _REC_VAL_20_u2 655.35 _CNV_R_R_Def_zk10ms_723_CM 1.e-002 655.36 FORMAT "%7.4" /end CHARACTERISTIC
/begin CHARACTERISTIC K_ZK_RFSTART "" VALUE 0xa101119c _REC_VAL_20_u2 0.9999 _CNV_R_R_Def_f_uw_b_591_CM 0. 0.9999 FORMAT "%14.5" /end CHARACTERISTIC
/begin CHARACTERISTIC K_ZK_SPRUEF "Zeitkonstante fuer 10ms Filterzyklus" VALUE 0xa1011444 _REC_VAL_20_u2 655.35 _CNV_R_R_Def_zk10ms_723_CM 1.e-002 655.36 FORMAT "%7.4" /end CHARACTERISTIC
/begin CHARACTERISTIC S_ADP_RESET "Reset Adaptionswerte" VALUE 0xa10124c7 _REC_VAL_20_u1 99.45 _CNV_R_R_Def_dez_sl_575_CM 0. 255. FORMAT "%3.0" /end CHARACTERISTIC
/begin CHARACTERISTIC S_BTE_EDIAG "Schaltet B_te abfrage zu B_eisyd_on zu" VALUE 0xa1012d3c _REC_VAL_20_u1 99.45 _CNV_R_R_Def_dez_sl_575_CM 0. 255. FORMAT "%3.0" /end CHARACTERISTIC
/begin CHARACTERISTIC S_BTE_MR "Schaltet !B_te zu B_mradon zu" VALUE 0xa10124ed _REC_VAL_20_u1 99.45 _CNV_R_R_Def_dez_sl_575_CM 0. 255. FORMAT "%3.0" /end CHARACTERISTIC
/begin CHARACTERISTIC S_DISADIAGST_ON "Freigabe Einrechnung Dynamikerkennung in Eisy Diagnose DISA" VALUE 0xa1012d31 _REC_VAL_20_u1 1. _CNV_R_R_Def_dez_sl_575_CM 0. 1. FORMAT "%3.0" /end CHARACTERISTIC
/begin CHARACTERISTIC S_DISAD_APP "Wenn ==1, dann ist B_disa_diag == TRUE" VALUE 0xa1012d3b _REC_VAL_20_u1 99.45 _CNV_R_R_Def_dez_sl_575_CM 0. 255. FORMAT "%3.0" /end CHARACTERISTIC
/begin CHARACTERISTIC S_DISA_DIAG "" VALUE 0xa1012d37 _REC_VAL_20_u1 99.45 _CNV_R_R_Def_dez_sl_575_CM 0. 255. FORMAT "%3.0" /end CHARACTERISTIC
/begin CHARACTERISTIC S_DKNNON "Schalter Lolimot-KNN DK-Zweig ein/aus" VALUE 0xa10124c8 _REC_VAL_20_u1 99.45 _CNV_R_R_Def_dez_sl_575_CM 0. 255. FORMAT "%3.0" /end CHARACTERISTIC
/begin CHARACTERISTIC S_DPSRDIAGST_ON "Freigabe Einrechnung Dynamikerkennung in Eisy Diagnose DPSR" VALUE 0xa1012d2e _REC_VAL_20_u1 1. _CNV_R_R_Def_dez_sl_575_CM 0. 1. FORMAT "%3.0" /end CHARACTERISTIC
/begin CHARACTERISTIC S_DPSR_DIAG "" VALUE 0xa1012d35 _REC_VAL_20_u1 99.45 _CNV_R_R_Def_dez_sl_575_CM 0. 255. FORMAT "%3.0" /end CHARACTERISTIC
/begin CHARACTERISTIC S_DRDIAG_ON "Schalter Drucksensorabgleich auszufuhren" VALUE 0xa1012d2c _REC_VAL_20_u1 1. _CNV_R_R_Def_dez_sl_575_CM 0. 1. FORMAT "%3.0" /end CHARACTERISTIC
/begin CHARACTERISTIC S_EISYAD_TST "" VALUE 0xa10124c4 _REC_VAL_20_u1 99.45 _CNV_R_R_Def_dez_sl_575_CM 0. 255. FORMAT "%3.0" /end CHARACTERISTIC
/begin CHARACTERISTIC S_EISYD_APP "Wenn ==1, dann ist B_eisy_diag == TRUE" VALUE 0xa1012d3a _REC_VAL_20_u1 99.45 _CNV_R_R_Def_dez_sl_575_CM 0. 255. FORMAT "%3.0" /end CHARACTERISTIC
/begin CHARACTERISTIC S_EISYD_RF "Schalter zum Wechseln Rf Eingang für Rf Dynamikerkennung Eisy Diagnose" VALUE 0xa1012d2d _REC_VAL_20_u1 1. _CNV_R_R_Def_dez_sl_575_CM 0. 1. FORMAT "%3.0" /end CHARACTERISTIC
/begin CHARACTERISTIC S_EISYEV_DISAISTON "Umschaltung DISA Bereiche auf Disa_ist" VALUE 0xa1011421 _REC_VAL_20_u1 1. _CNV_R_R_Def_dez_sl_575_CM 0. 1. FORMAT "%3.0" /end CHARACTERISTIC
/begin CHARACTERISTIC S_EVNN_AUS "Schalter N.N. zum ausschalten" VALUE 0xa10113b5 _REC_VAL_20_u1 99.45 _CNV_R_R_Def_dez_sl_575_CM 0. 255. FORMAT "%3.0" /end CHARACTERISTIC
/begin CHARACTERISTIC S_HFMDIAGST_ON "Freigabe Einrechnung Dynamikerkennung in Eisy Diagnose HFM" VALUE 0xa1012d2f _REC_VAL_20_u1 1. _CNV_R_R_Def_dez_sl_575_CM 0. 1. FORMAT "%3.0" /end CHARACTERISTIC
/begin CHARACTERISTIC S_HFMDIAGTE_OFF "Freigabe Einrechnung TE erkennung in Eisy Diagnose HFM" VALUE 0xa1012d32 _REC_VAL_20_u1 1. _CNV_R_R_Def_dez_sl_575_CM 0. 1. FORMAT "%3.0" /end CHARACTERISTIC
/begin CHARACTERISTIC S_HFMD_SAON "Schaltet !B_sa zu Bildung B_hfm_diag zu" VALUE 0xa1012d3e _REC_VAL_20_u1 99.45 _CNV_R_R_Def_dez_sl_575_CM 0. 255. FORMAT "%3.0" /end CHARACTERISTIC
/begin CHARACTERISTIC S_HFM_DIAG "" VALUE 0xa1012d34 _REC_VAL_20_u1 99.45 _CNV_R_R_Def_dez_sl_575_CM 0. 255. FORMAT "%3.0" /end CHARACTERISTIC
/begin CHARACTERISTIC S_HFM_DIAG_PERM "" VALUE 0xa1012d33 _REC_VAL_20_u1 99.45 _CNV_R_R_Def_dez_sl_575_CM 0. 255. FORMAT "%3.0" /end CHARACTERISTIC
/begin CHARACTERISTIC S_MAREGOFF "Schalter Mareg Ausgang komplett ein/aus" VALUE 0xa10124c9 _REC_VAL_20_u1 99.45 _CNV_R_R_Def_dez_sl_575_CM 0. 255. FORMAT "%3.0" /end CHARACTERISTIC
/begin CHARACTERISTIC S_MODABLLTD_OFF "Deaktivieren Modabreglerauschaltung bei Teildrosselung" VALUE 0xa10124f2 _REC_VAL_20_u1 99.45 _CNV_R_R_Def_dez_sl_575_CM 0. 255. FORMAT "%3.0" /end CHARACTERISTIC
/begin CHARACTERISTIC S_MODABTE_OFF "Schaltet !B_te bei Berechnung B_modab_on hinzu" VALUE 0xa10124f1 _REC_VAL_20_u1 99.45 _CNV_R_R_Def_dez_sl_575_CM 0. 255. FORMAT "%3.0" /end CHARACTERISTIC
/begin CHARACTERISTIC S_MRDEVSOLL_OFF "" VALUE 0xa1011190 _REC_VAL_20_u1 99.45 _CNV_R_R_Def_dez_sl_575_CM 0. 255. FORMAT "%3.0" /end CHARACTERISTIC
/begin CHARACTERISTIC S_MRD_MS_FAK "Umschalter DK-Regler Faktor oder Offset" VALUE 0xa10124cb _REC_VAL_20_u1 99.45 _CNV_R_R_Def_dez_sl_575_CM 0. 255. FORMAT "%3.0" /end CHARACTERISTIC
/begin CHARACTERISTIC S_MRMSLAM_AUTO "Automatisch HFM Erkennung ein" VALUE 0xa101118b _REC_VAL_20_u1 99.45 _CNV_R_R_Def_dez_sl_575_CM 0. 255. FORMAT "%3.0" /end CHARACTERISTIC
/begin CHARACTERISTIC S_MROFF_KSD "Schaltet KSD ein/aus Mareg auszuschalten" VALUE 0xa10124ec _REC_VAL_20_u1 99.45 _CNV_R_R_Def_dez_sl_575_CM 0. 255. FORMAT "%3.0" /end CHARACTERISTIC
/begin CHARACTERISTIC S_MR_MS_FAK "Umschalter Hub-Regler Faktor oder Offset" VALUE 0xa10124ca _REC_VAL_20_u1 99.45 _CNV_R_R_Def_dez_sl_575_CM 0. 255. FORMAT "%3.0" /end CHARACTERISTIC
/begin CHARACTERISTIC S_MSDIAGST_ON "Freigabe Einrechnung Dynamikerkennung in Eisy Diagnose MSLAM" VALUE 0xa1012d30 _REC_VAL_20_u1 1. _CNV_R_R_Def_dez_sl_575_CM 0. 1. FORMAT "%3.0" /end CHARACTERISTIC
/begin CHARACTERISTIC S_MSLAM_DIAG "" VALUE 0xa1012d36 _REC_VAL_20_u1 99.45 _CNV_R_R_Def_dez_sl_575_CM 0. 255. FORMAT "%3.0" /end CHARACTERISTIC
/begin CHARACTERISTIC S_MSZYLDIAG_MOD "Wenn = 1, dann Mszyl Diagnose über Modelwert Ps" VALUE 0xa1012d38 _REC_VAL_20_u1 99.45 _CNV_R_R_Def_dez_sl_575_CM 0. 255. FORMAT "%3.0" /end CHARACTERISTIC
/begin CHARACTERISTIC S_MSZYL_3MOD "" VALUE 0xa10113b6 _REC_VAL_20_u1 99.45 _CNV_R_R_Def_dez_sl_575_CM 0. 255. FORMAT "%3.0" /end CHARACTERISTIC
/begin CHARACTERISTIC S_NPL_RESET "Reset Adaptionswerte, NPL" VALUE 0xa10124c6 _REC_VAL_20_u1 99.45 _CNV_R_R_Def_dez_sl_575_CM 0. 255. FORMAT "%3.0" /end CHARACTERISTIC
/begin CHARACTERISTIC S_OZBSDKOORD "BSD Koordinator aktiv" VALUE 0xa100de52 _REC_VAL_20_u1 99.45 _CNV_R_R_Def_dez_sl_575_CM 0. 255. FORMAT "%3.0" /end CHARACTERISTIC
/begin CHARACTERISTIC S_PIRGKON "Pirg Korrigierung vom Massenstromregler" VALUE 0xa1011423 _REC_VAL_20_u1 99.45 _CNV_R_R_Def_dez_sl_575_CM 0. 255. FORMAT "%3.0" /end CHARACTERISTIC
/begin CHARACTERISTIC S_PSPAGR_SOLL "" VALUE 0xa1011191 _REC_VAL_20_u1 99.45 _CNV_R_R_Def_dez_sl_575_CM 0. 255. FORMAT "%3.0" /end CHARACTERISTIC
/begin CHARACTERISTIC S_PSPN_OFF "Pspn Korrigierung Auschaltung" VALUE 0xa1011422 _REC_VAL_20_u1 1. _CNV_R_R_Def_dez_sl_575_CM 0. 1. FORMAT "%3.0" /end CHARACTERISTIC
/begin CHARACTERISTIC S_RFGDST_OFF "Rf Berechnung im Gedrosselt-Start Aus" VALUE 0xa101118c _REC_VAL_20_u1 99.45 _CNV_R_R_Def_dez_sl_575_CM 0. 255. FORMAT "%3.0" /end CHARACTERISTIC
/begin CHARACTERISTIC S_RFST_ON "Umschaltung Rf Berechnung im Start" VALUE 0xa101118d _REC_VAL_20_u1 99.45 _CNV_R_R_Def_dez_sl_575_CM 0. 255. FORMAT "%3.0" /end CHARACTERISTIC
/begin CHARACTERISTIC S_RFVISTHUB "Umschaltung" VALUE 0xa1011420 _REC_VAL_20_u1 1. _CNV_R_R_Def_dez_sl_575_CM 0. 1. FORMAT "%3.0" /end CHARACTERISTIC
/begin CHARACTERISTIC S_TALEER_DIS "Wenn = 1, Tank leer Diagnose ausgeschaltet" VALUE 0xa1012d39 _REC_VAL_20_u1 99.45 _CNV_R_R_Def_dez_sl_575_CM 0. 255. FORMAT "%3.0" /end CHARACTERISTIC
/begin CHARACTERISTIC S_TALEER_MR "B_taleer sperrt Adaption" VALUE 0xa10124c5 _REC_VAL_20_u1 99.45 _CNV_R_R_Def_dez_sl_575_CM 0. 255. FORMAT "%3.0" /end CHARACTERISTIC
/begin CHARACTERISTIC S_TD_MRDK "" VALUE 0xa101118f _REC_VAL_20_u1 99.45 _CNV_R_R_Def_dez_sl_575_CM 0. 255. FORMAT "%3.0" /end CHARACTERISTIC
/begin CHARACTERISTIC S_TD_MREVOFF "" VALUE 0xa101118e _REC_VAL_20_u1 99.45 _CNV_R_R_Def_dez_sl_575_CM 0. 255. FORMAT "%3.0" /end CHARACTERISTIC
/begin CHARACTERISTIC S_VNSIWS "Schalter fuer Istwertschaetzer" VALUE 0xa101e86c _REC_VAL_20_u1 99.45 _CNV_R_R_Def_dez_sl_575_CM 0. 255. FORMAT "%3.0" /end CHARACTERISTIC
/begin CHARACTERISTIC S_WDKDIAG_PSMOD "Schaltet zwischen Klaf_outdk und Klaf_outwdkdiag um" VALUE 0xa1012d3d _REC_VAL_20_u1 99.45 _CNV_R_R_Def_dez_sl_575_CM 0. 255. FORMAT "%3.0" /end CHARACTERISTIC
/begin COMPU_METHOD _CNV_R_R_Def_f_ub_b_573_CM "Def_f_ub_b1" RAT_FUNC "%6.3" "-" COEFFS 0. 256. 0. 0. 0. 1. /end COMPU_METHOD
/begin COMPU_METHOD _CNV_R_R_Def_dez_sl_575_CM "Def_dez_sl_q1" RAT_FUNC "%6.3" "-" COEFFS 0. 1. 0. 0. 0. 1. /end COMPU_METHOD
/begin COMPU_METHOD _CNV_R_R_Def_f_uw_b_576_CM "Def_f_uw_b100" RAT_FUNC "%6.3" "%" COEFFS 0. 65536. 0. 0. 0. 100. /end COMPU_METHOD
/begin COMPU_METHOD _CNV_R_R_Def_p_sw_q_578_CM "Def_p_sw_q0p039" RAT_FUNC "%6.3" "hPa" COEFFS 0. 256. 0. 0. 0. 10. /end COMPU_METHOD
/begin COMPU_METHOD _CNV_R_R_Def_f_uw_b_579_CM "Def_f_uw_b2" RAT_FUNC "%6.3" "-" COEFFS 0. 65536. 0. 0. 0. 2. /end COMPU_METHOD
/begin COMPU_METHOD _CNV_R_R_Def_f_uw_b_580_CM "Def_f_uw_b64" RAT_FUNC "%6.3" "-" COEFFS 0. 65536. 0. 0. 0. 64. /end COMPU_METHOD
/begin COMPU_METHOD _CNV_R_R_Def_spr_sw_583_CM "Def_spr_sw_q0p1" RAT_FUNC "%6.3" "° KW" COEFFS 0. 10. 0. 0. 0. 1. /end COMPU_METHOD
/begin COMPU_METHOD _CNV_R_R_Def_f_uw_b_591_CM "Def_f_uw_b1" RAT_FUNC "%6.3" "-" COEFFS 0. 65536. 0. 0. 0. 1. /end COMPU_METHOD
/begin COMPU_METHOD _CNV_R_R_Def_td_ub__593_CM "Def_td_ub_q0p1" RAT_FUNC "%6.3" "s" COEFFS 0. 10. 0. 0. 0. 1. /end COMPU_METHOD
/begin COMPU_METHOD _CNV_R_R_Def_f_uw_b_594_CM "Def_f_uw_b16" RAT_FUNC "%6.3" "-" COEFFS 0. 65536. 0. 0. 0. 16. /end COMPU_METHOD
/begin COMPU_METHOD _CNV_R_R_Def_u_sb_q_598_CM "Def_u_sb_q0p0942" RAT_FUNC "%6.3" "V" COEFFS 0. 1. 0. 0. 0. 9.420000000000001e-002 /end COMPU_METHOD
/begin COMPU_METHOD _CNV_R_R_Def_f_uw_b_604_CM "Def_f_uw_b32" RAT_FUNC "%6.3" "-" COEFFS 0. 65536. 0. 0. 0. 32. /end COMPU_METHOD
/begin COMPU_METHOD _CNV_R_R_Def_hub_uw_605_CM "Def_hub_uw_q0p001" RAT_FUNC "%6.3" "mm" COEFFS 0. 1000. 0. 0. 0. 1. /end COMPU_METHOD
/begin COMPU_METHOD _CNV_R_R_Def_f_sw_b_606_CM "Def_f_sw_b4" RAT_FUNC "%6.3" "-" COEFFS 0. 32768. 0. 0. 0. 4. /end COMPU_METHOD
/begin COMPU_METHOD _CNV_R_R_Def_f_sw_b_608_CM "Def_f_sw_b2" RAT_FUNC "%6.3" "-" COEFFS 0. 65536. 0. 0. 0. 4. /end COMPU_METHOD
/begin COMPU_METHOD _CNV_R_R_Def_ms_uw__611_CM "Def_ms_uw_q0p03125" RAT_FUNC "%6.3" "kg/h" COEFFS 0. 32. 0. 0. 0. 1. /end COMPU_METHOD
/begin COMPU_METHOD _CNV_R_R_Def_n_sw_q_612_CM "Def_n_sw_q1p0" RAT_FUNC "%6.3" "Upm" COEFFS 0. 1. 0. 0. 0. 1. /end COMPU_METHOD
/begin COMPU_METHOD _CNV_R_R_Def_rf_sw__616_CM "Def_rf_sw_q0p01" RAT_FUNC "%6.3" "%" COEFFS 0. 100. 0. 0. 0. 1. /end COMPU_METHOD
/begin COMPU_METHOD _CNV_R_R_Def_t_sw_q_618_CM "Def_t_sw_q0p1" RAT_FUNC "%6.3" "°C" COEFFS 0. 10. 0. 0. 0. 1. /end COMPU_METHOD
/begin COMPU_METHOD _CNV_R_R_Def_t_sw_q_620_CM "Def_t_sw_q0p01" RAT_FUNC "%6.3" "°C" COEFFS 0. 100. 0. 0. 0. 1. /end COMPU_METHOD
/begin COMPU_METHOD _CNV_R_R_Def_f_ub_b_625_CM "Def_f_ub_b2" RAT_FUNC "%6.3" "-" COEFFS 0. 256. 0. 0. 0. 2. /end COMPU_METHOD
/begin COMPU_METHOD _CNV_R_R_Def_ms_sb__626_CM "Def_ms_sb_q8" RAT_FUNC "%6.3" "kg/h" COEFFS 0. 1. 0. 0. 0. 8. /end COMPU_METHOD
/begin COMPU_METHOD _CNV_R_R_Def_f_uw_b_629_CM "Def_f_uw_b10" RAT_FUNC "%6.3" "%" COEFFS 0. 65536. 0. 0. 0. 10. /end COMPU_METHOD
/begin COMPU_METHOD _CNV_R_R_Def_umr_uw_635_CM "Def_umr_uw_b4000" RAT_FUNC "%6.3" "-" COEFFS 0. 65536. 0. 0. 0. 4000. /end COMPU_METHOD
/begin COMPU_METHOD _CNV_R_R_Def_f_uw_b_639_CM "Def_f_uw_b0p3" RAT_FUNC "%6.3" "%/hPa" COEFFS 0. 65536. 0. 0. 0. 0.3 /end COMPU_METHOD
/begin COMPU_METHOD _CNV_R_R_Def_ml_uw__662_CM "Def_ml_uw_q0p1" RAT_FUNC "%6.3" "kg/h" COEFFS 0. 10. 0. 0. 0. 1. /end COMPU_METHOD
/begin COMPU_METHOD _CNV_R_R_Def_ms_uw__664_CM "Def_ms_uw_b8192" RAT_FUNC "%6.3" "kg/h" COEFFS 0. 8. 0. 0. 0. 1. /end COMPU_METHOD
/begin COMPU_METHOD _CNV_R_R_Def_td_uw__679_CM "Def_td_uw_q0p01" RAT_FUNC "%6.3" "s" COEFFS 0. 100. 0. 0. 0. 1. /end COMPU_METHOD
/begin COMPU_METHOD _CNV_R_R_Def_wdk_sw_691_CM "Def_wdk_sw_q0p0244" RAT_FUNC "%6.3" "%" COEFFS 0. 4096. 0. 0. 0. 100. /end COMPU_METHOD
/begin COMPU_METHOD _CNV_S_2_Def_bit_ub_700_CM "Def_bit_ub_0" TAB_VERB "%6.3" "-" COMPU_TAB_REF _CNV_S_2_Def_bit_ub_700 /end COMPU_METHOD
/begin COMPU_VTAB _CNV_S_2_Def_bit_ub_700 "Def_bit_ub_0" TAB_VERB 2 0 "FALSE" 1 "TRUE" /end COMPU_VTAB
/begin COMPU_METHOD _CNV_S_2_Def_bit_ub_701_CM "Def_bit_ub_1" TAB_VERB "%6.3" "-" COMPU_TAB_REF _CNV_S_2_Def_bit_ub_701 /end COMPU_METHOD
/begin COMPU_VTAB _CNV_S_2_Def_bit_ub_701 "Def_bit_ub_1" TAB_VERB 2 0 "FALSE" 2 "TRUE" /end COMPU_VTAB
/begin COMPU_METHOD _CNV_S_2_Def_bit_ub_702_CM "Def_bit_ub_2" TAB_VERB "%6.3" "-" COMPU_TAB_REF _CNV_S_2_Def_bit_ub_702 /end COMPU_METHOD
/begin COMPU_VTAB _CNV_S_2_Def_bit_ub_702 "Def_bit_ub_2" TAB_VERB 2 0 "FALSE" 4 "TRUE" /end COMPU_VTAB
/begin COMPU_METHOD _CNV_S_2_Def_bit_ub_703_CM "Def_bit_ub_3" TAB_VERB "%6.3" "-" COMPU_TAB_REF _CNV_S_2_Def_bit_ub_703 /end COMPU_METHOD
/begin COMPU_VTAB _CNV_S_2_Def_bit_ub_703 "Def_bit_ub_3" TAB_VERB 2 0 "FALSE" 8 "TRUE" /end COMPU_VTAB
/begin COMPU_METHOD _CNV_S_2_Def_bit_ub_704_CM "Def_bit_ub_4" TAB_VERB "%6.3" "-" COMPU_TAB_REF _CNV_S_2_Def_bit_ub_704 /end COMPU_METHOD
/begin COMPU_VTAB _CNV_S_2_Def_bit_ub_704 "Def_bit_ub_4" TAB_VERB 2 0 "FALSE" 16 "TRUE" /end COMPU_VTAB
/begin COMPU_METHOD _CNV_S_2_Def_bit_ub_705_CM "Def_bit_ub_5" TAB_VERB "%6.3" "-" COMPU_TAB_REF _CNV_S_2_Def_bit_ub_705 /end COMPU_METHOD
/begin COMPU_VTAB _CNV_S_2_Def_bit_ub_705 "Def_bit_ub_5" TAB_VERB 2 0 "FALSE" 32 "TRUE" /end COMPU_VTAB
/begin COMPU_METHOD _CNV_S_2_Def_bit_ub_706_CM "Def_bit_ub_6" TAB_VERB "%6.3" "-" COMPU_TAB_REF _CNV_S_2_Def_bit_ub_706 /end COMPU_METHOD
/begin COMPU_VTAB _CNV_S_2_Def_bit_ub_706 "Def_bit_ub_6" TAB_VERB 2 0 "FALSE" 64 "TRUE" /end COMPU_VTAB
/begin COMPU_METHOD _CNV_S_2_Def_bit_ub_707_CM "Def_bit_ub_7" TAB_VERB "%6.3" "-" COMPU_TAB_REF _CNV_S_2_Def_bit_ub_707 /end COMPU_METHOD
/begin COMPU_VTAB _CNV_S_2_Def_bit_ub_707 "Def_bit_ub_7" TAB_VERB 2 0 "FALSE" 128 "TRUE" /end COMPU_VTAB
/begin COMPU_METHOD _CNV_R_R_Def_td_ul__720_CM "Def_td_ul_q1" RAT_FUNC "%6.3" "ms" COEFFS 0. 1. 0. 0. 0. 1. /end COMPU_METHOD
/begin COMPU_METHOD _CNV_R_R_Def_zk10ms_723_CM "Def_zk10ms_uw_b655p36" RAT_FUNC "%6.3" "s" COEFFS 0. 0. 655.36 0. 1. 0. /end COMPU_METHOD
/begin COMPU_METHOD _CNV_R_R_Def_a_uw_q_736_CM "Def_a_uw_q0p1" RAT_FUNC "%6.3" "mm/gKW" COEFFS 0. 1. 0. 0. 0. 1.6e-002 /end COMPU_METHOD
/begin COMPU_METHOD _CNV_R_R_Def_spr_sb_740_CM "Def_spr_sb_q0p05" RAT_FUNC "%6.3" "° KW" COEFFS 0. 20. 0. 0. 0. 1. /end COMPU_METHOD
/begin COMPU_METHOD _CNV_R_R_Def_rel_uw_742_CM "Def_rel_uw_q0p01" RAT_FUNC "%6.3" "%" COEFFS 0. 327.68 32768. 0. 0. 1. /end COMPU_METHOD
/begin COMPU_METHOD _CNV_R_R_Def_vg_sw__743_CM "Def_vg_sw_q0p781" RAT_FUNC "%6.3" "° KW/s" COEFFS 0. 1.28 0. 0. 0. 1. /end COMPU_METHOD
/begin COMPU_METHOD _CNV_R_R_Def_spr_uw_744_CM "Def_spr_uw_q0p01" RAT_FUNC "%6.3" "° KW" COEFFS 0. 10. 32768. 0. 0. 1. /end COMPU_METHOD
/begin COMPU_METHOD _CNV_R_R_Def_zk100m_749_CM "Def_zk100ms_uw_b6553p6" RAT_FUNC "%6.3" "s" COEFFS 0. 0. 6553.6 0. 1. 0. /end COMPU_METHOD
/begin COMPU_METHOD _CNV_R_R_Def_f_uw_b_764_CM "Def_f_uw_b128" RAT_FUNC "%6.3" "" COEFFS 0. 512. 0. 0. 0. 1. /end COMPU_METHOD
/begin COMPU_METHOD _CNV_R_R_Def_umr_uw_787_CM "Def_umr_uw_b0p244" RAT_FUNC "%6.3" "-" COEFFS 0. 33554432. 0. 0. 0. 125. /end COMPU_METHOD
/begin COMPU_METHOD _CNV_R_R_Def_rel_sw_788_CM "Def_rel_sw_q0p003" RAT_FUNC "%6.3" "%" COEFFS 0. 327.68 0. 0. 0. 1. /end COMPU_METHOD
/begin RECORD_LAYOUT _REC_VAL_20_u1 FNC_VALUES 1 UBYTE COLUMN_DIR DIRECT /end RECORD_LAYOUT
/begin RECORD_LAYOUT _REC_VAL_20_u2 FNC_VALUES 1 UWORD COLUMN_DIR DIRECT /end RECORD_LAYOUT
/begin RECORD_LAYOUT _REC_AXS_20_u1 NO_AXIS_PTS_X 1 UBYTE AXIS_PTS_X 2 UBYTE INDEX_INCR DIRECT /end RECORD_LAYOUT
/begin RECORD_LAYOUT _REC_VAL_20_s2 FNC_VALUES 1 SWORD COLUMN_DIR DIRECT /end RECORD_LAYOUT
/begin RECORD_LAYOUT _REC_CUR_20_u2_u1 FNC_VALUES 1 UWORD COLUMN_DIR DIRECT /end RECORD_LAYOUT
/begin RECORD_LAYOUT _REC_VAL_20_u4 FNC_VALUES 1 ULONG COLUMN_DIR DIRECT /end RECORD_LAYOUT
/begin RECORD_LAYOUT _REC_CUR_20_s2_u1 FNC_VALUES 1 SWORD COLUMN_DIR DIRECT /end RECORD_LAYOUT
/begin RECORD_LAYOUT _REC_MAP_52_UBYTE_s2_s2_u2 NO_AXIS_PTS_X 1 UBYTE NO_AXIS_PTS_Y 2 UBYTE AXIS_PTS_X 3 SWORD INDEX_INCR DIRECT AXIS_PTS_Y 4 UWORD INDEX_INCR DIRECT FNC_VALUES 5 SWORD COLUMN_DIR DIRECT /end RECORD_LAYOUT
/begin RECORD_LAYOUT _REC_MAP_52_UBYTE_u2_s2_s2 NO_AXIS_PTS_X 1 UBYTE NO_AXIS_PTS_Y 2 UBYTE AXIS_PTS_X 3 SWORD INDEX_INCR DIRECT AXIS_PTS_Y 4 SWORD INDEX_INCR DIRECT FNC_VALUES 5 UWORD COLUMN_DIR DIRECT /end RECORD_LAYOUT
/begin RECORD_LAYOUT _REC_MAP_52_UBYTE_u2_u2_u2 NO_AXIS_PTS_X 1 UBYTE NO_AXIS_PTS_Y 2 UBYTE AXIS_PTS_X 3 UWORD INDEX_INCR DIRECT AXIS_PTS_Y 4 UWORD INDEX_INCR DIRECT FNC_VALUES 5 UWORD COLUMN_DIR DIRECT /end RECORD_LAYOUT
/begin RECORD_LAYOUT _REC_MAP_52_UBYTE_s2_s2_s2 NO_AXIS_PTS_X 1 UBYTE NO_AXIS_PTS_Y 2 UBYTE AXIS_PTS_X 3 SWORD INDEX_INCR DIRECT AXIS_PTS_Y 4 SWORD INDEX_INCR DIRECT FNC_VALUES 5 SWORD COLUMN_DIR DIRECT /end RECORD_LAYOUT
/begin RECORD_LAYOUT _REC_MAP_52_UBYTE_u2_u2_s2 NO_AXIS_PTS_X 1 UBYTE NO_AXIS_PTS_Y 2 UBYTE AXIS_PTS_X 3 UWORD INDEX_INCR DIRECT AXIS_PTS_Y 4 SWORD INDEX_INCR DIRECT FNC_VALUES 5 UWORD COLUMN_DIR DIRECT /end RECORD_LAYOUT
/begin RECORD_LAYOUT _REC_MAP_52_UBYTE_s2_u2_s2 NO_AXIS_PTS_X 1 UBYTE NO_AXIS_PTS_Y 2 UBYTE AXIS_PTS_X 3 UWORD INDEX_INCR DIRECT AXIS_PTS_Y 4 SWORD INDEX_INCR DIRECT FNC_VALUES 5 SWORD COLUMN_DIR DIRECT /end RECORD_LAYOUT
/begin RECORD_LAYOUT _REC_CUR_TKL_UW_VV__u2_u2 NO_AXIS_PTS_X 1 UBYTE RESERVED 2 BYTE AXIS_PTS_X 3 UWORD INDEX_INCR DIRECT FNC_VALUES 4 UWORD COLUMN_DIR DIRECT /end RECORD_LAYOUT
/begin RECORD_LAYOUT _REC_CUR_TKL_UW_VV__u2_s2 NO_AXIS_PTS_X 1 UBYTE RESERVED 2 BYTE AXIS_PTS_X 3 SWORD INDEX_INCR DIRECT FNC_VALUES 4 UWORD COLUMN_DIR DIRECT /end RECORD_LAYOUT
/begin RECORD_LAYOUT _REC_CUR_TKL_UW_VV__u1_s2 NO_AXIS_PTS_X 1 UBYTE RESERVED 2 BYTE AXIS_PTS_X 3 SWORD INDEX_INCR DIRECT FNC_VALUES 4 UBYTE COLUMN_DIR DIRECT /end RECORD_LAYOUT
/begin RECORD_LAYOUT _REC_CUR_TKL_UW_VV__u1_u2 NO_AXIS_PTS_X 1 UBYTE RESERVED 2 BYTE AXIS_PTS_X 3 UWORD INDEX_INCR DIRECT FNC_VALUES 4 UBYTE COLUMN_DIR DIRECT /end RECORD_LAYOUT
/begin RECORD_LAYOUT _REC_CUR_TKL_UW_VV__s2_s2 NO_AXIS_PTS_X 1 UBYTE RESERVED 2 BYTE AXIS_PTS_X 3 SWORD INDEX_INCR DIRECT FNC_VALUES 4 SWORD COLUMN_DIR DIRECT /end RECORD_LAYOUT
/begin RECORD_LAYOUT _REC_CUR_TKL_UW_VV__S4_S4 NO_AXIS_PTS_X 1 UBYTE RESERVED 2 BYTE AXIS_PTS_X 3 FLOAT32_IEEE INDEX_INCR DIRECT FNC_VALUES 4 FLOAT32_IEEE COLUMN_DIR DIRECT /end RECORD_LAYOUT
/begin RECORD_LAYOUT _REC_CUR_20_S4_u1 FNC_VALUES 1 FLOAT32_IEEE COLUMN_DIR DIRECT /end RECORD_LAYOUT
/begin RECORD_LAYOUT _REC_VAL_20_S4 FNC_VALUES 1 FLOAT32_IEEE COLUMN_DIR DIRECT /end RECORD_LAYOUT
/begin RECORD_LAYOUT _REC_VAL_2_u2 FNC_VALUES 1 UWORD COLUMN_DIR DIRECT /end RECORD_LAYOUT
/begin RECORD_LAYOUT _REC_VAL_2_s2 FNC_VALUES 1 SWORD COLUMN_DIR DIRECT /end RECORD_LAYOUT
/begin FUNCTION DQLT ""
 /begin DEF_CHARACTERISTIC K_DTOG_UBMIN K_OZDIAGNMOT K_OZDIAGNMOT2 K_OZDIAGSPG K_OZERRD K_OZHEAL K_OZPLTEMP K_OZPLZTEMP K_OZTEMPQERR K_OZZTEMP K_TOGMAXUNPL K_TOG_CNTMAX S_OZBSDKOORD /end DEF_CHARACTERISTIC
 /begin OUT_MEASUREMENT Oz_diagtoens Oz_permerrz Oz_tempplz Oz_temprold St_dqlt0 St_dqlt0.B_ozdiagnmotok St_dqlt0.B_ozerrbsd St_dqlt0.B_ozkttoens St_dqlt0.B_ozlerr St_dqlt0.B_ozqerr St_dqlt0.B_ozterr St_dqlt0.B_td_ogerr St_dqlt0.B_td_ogupl St_dqlt1 St_dqlt1.B_ozerr St_dqlt1.B_ozfbsd2 St_dqlt1.B_oztemppl St_oz_o St_oz_o.B_mol_sf St_oz_o.B_oztemic /end OUT_MEASUREMENT
/end FUNCTION
/begin FUNCTION EAVANOS ""
 /begin DEF_CHARACTERISTIC CW_VNSABST CW_VNSDYN KL_RANWI KL_RANWP KL_RENWI KL_RENWP KL_VNSTMOT KL_VNSTVUB KL_VSA_ITMOT KL_VSE_ITMOT K_ASP_ADPWF K_ASP_ADTV K_ASP_BA K_ASP_TVHB K_ASP_WNWS K_DVNS_IREGOFF1 K_DVNS_IREGOFF2 K_ESP_ADPWF K_ESP_ADTV K_ESP_BA K_ESP_TVHB K_ESP_WNWS K_NMOTVNSAD K_SPRZG_VB K_VNSKRITLOC K_VNSNMOTAN K_VNSRTVIMN K_VNSRTVIMX1 K_VNSRTVIMX2 K_VNSRTVMN K_VNSRTVMX K_VNSTVIABDY K_VNS_ADEND K_VNS_ADT K_VNS_ANAB K_VNS_DELTMX_IREG K_VNS_DYN K_VNS_NMVSTOP K_VNS_TMVSTOP K_VNS_TVINKW K_VNS_TVITMOT /end DEF_CHARACTERISTIC
 /begin OUT_MEASUREMENT Vnsfaktmot Vnsfaktvub Vsa_sprs Vsa_tv Vsa_tv_i Vsa_tv_p Vsadwnwkl Vsadwnwv Vse_sprs Vse_tv Vse_tv_i Vse_tv_p Vsedwnwkl Vsedwnwv /end OUT_MEASUREMENT
/end FUNCTION
/begin FUNCTION EAVNSKT ""
 /begin DEF_CHARACTERISTIC CW_EAVNSKT K_NWAFLANKE K_NWEFLANKE K_NWSEGOFFS K_NW_MIN K_SPRZG_AN K_VNSADPEXT_OFF S_VNSIWS /end DEF_CHARACTERISTIC
 /begin OUT_MEASUREMENT Nw_posi St_vsa St_vsa.B_npos1dyn St_vsa.B_vsaadnok St_vsa.B_vsaadok St_vsa.B_vsaadp St_vsa.B_vsadyn St_vsa.B_vsaflan St_vsa.B_vsanwerr St_vsa.B_vsaspran St_vse St_vse.B_npos0dyn St_vse.B_vseadnok St_vse.B_vseadok St_vse.B_vseadp St_vse.B_vsedyn St_vse.B_vseflan St_vse.B_vsenwerr St_vse.B_vsespran T_systemvns Vsa_adp Vsa_adp_fl Vsa_spri Vsa_vg Vsaspris Vse_adp Vse_adp_fl Vse_spri Vse_vg Vsespris /end OUT_MEASUREMENT
/end FUNCTION
/begin FUNCTION EISY ""
 /begin DEF_CHARACTERISTIC CW_EISY CW_EISY_TGLE CW_MPR_KOORD KF_RFVIST_ST KL_MRD_EV KL_PSREGAGR_KOR K_EISY_SEG2SCHW K_EISY_SEGSCHW K_RFMIN_EISY K_RFTDINI K_TD_RFSTART K_TD_RFVST K_ZKLF K_ZKMRDEV_IN K_ZK_MPRMSFAK K_ZK_MPRMSOFF K_ZK_MREVFAK K_ZK_MREVOFF K_ZK_MSHFM K_ZK_RFSTART S_MRDEVSOLL_OFF S_MRMSLAM_AUTO S_PSPAGR_SOLL S_RFGDST_OFF S_RFST_ON S_TD_MRDK S_TD_MREVOFF /end DEF_CHARACTERISTIC
 /begin OUT_MEASUREMENT Eisy_segtoggle Eisyagr_kor_fak Eisyagr_korfak_b Eisyagr_korfak_f Eisydk_kor_fak Eisydk_kor_off Eisydk_korfak_b Eisydk_korfak_f Eisydk_koroff_b Eisydk_koroff_f Eisyev_kor_fak Eisyev_kor_off Eisyev_korfak_b Eisyev_koroff_b F_quot_spuel F_quot_uk Mrd_msfakkor_f Mrd_msoffkor_f Msagr Msagr_fg Msagr_ig Msdk Mshfm_f Mszyl_f Mszyl_fg Mszyl_td Psev Pssol_pn Pvdkds_f Rf Rf_f Rf_fg Rf_ges Rf_hfm_f Rf_start Rf_td Rf_ubeg Rfvist_st St_eisy_hfm St_eisy_hfm.B_mrmslam St_eisy_segment St_eisy_segment.B_eisy_dkseg St_eisy_segment.B_eisy_evseg St_stend_verz St_stend_verz.B_startende_rfvst /end OUT_MEASUREMENT
/end FUNCTION
/begin FUNCTION EISYAGR "" /begin DEF_CHARACTERISTIC KL_MSNAGR KL_TKAGR /end DEF_CHARACTERISTIC /begin OUT_MEASUREMENT F_pagr F_tagr Msagrv Msnagr Msnagr_roh Pspvagr /end OUT_MEASUREMENT /end FUNCTION
/begin FUNCTION EISY_DIAG ""
 /begin DEF_CHARACTERISTIC CW_EISYD_RUNTIME CW_EISY_DFSPE CW_EISY_DIAG CW_EISY_DRBM KF_DIAGDPSRD_O KF_DIAGDPSRD_U KF_DIAG_MSO KF_DIAG_MSO2 KF_DIAG_MSU KF_DIAG_MSU2 KF_TDMSZYL KL_RFVSOLL K_BGWDKDPSGR K_DIAG_MSO_OFFGD K_DIAG_MSO_OFFTD K_DIAG_MSU_OFFGD K_DIAG_MSU_OFFTD K_DISAB1_MN K_DISAB1_MX K_DISAB2_MN K_DISAB2_MX K_DISAB3_MN K_DISAB3_MX K_DISAB4_MN K_DISAB4_MX K_DISADTAMN K_DISADTAMX K_DISATD K_DNKW_EISYDMN K_DNKW_EISYDMX K_DPSRP_MN1 K_DPSRP_MN2 K_DPSRP_MN3 K_DPSRP_MN4 K_DRF_EISYDMN K_DRF_EISYDMX K_HUBMN_DIAG K_NEDIAGMN K_NEDIAGMX K_NMN_HFMDPERM K_PSABS_T100 K_PSABS_TOL K_PUMN_DIAG K_PVDKDS_T100 K_PVDKDS_TOL K_RFEDIAGMN K_RFEDIAGMX K_TAEDIAGMN K_TAEDIAGMX K_TD_DRDIAGAKT K_TD_EISYD K_TMEDIAGMN K_TNSEDIAGMN K_TNSMN_HFMPERM K_UBATTMIN_DIAGPL K_UBATTMIN_DPSRDIAG K_UBATTMIN_HFMDIAG K_WDKMN_DDPSR K_ZKDIAG_HQ K_ZKDIAG_MSLQ K_ZKDIAG_PS K_ZKDIAG_WDKPS K_ZK_DIAGPSREG K_ZK_EISYDSTN K_ZK_EISYDSTRF S_BTE_EDIAG S_DISADIAGST_ON S_DISAD_APP S_DISA_DIAG S_DPSRDIAGST_ON S_DPSR_DIAG S_DRDIAG_ON S_EISYD_APP S_EISYD_RF S_HFMDIAGST_ON S_HFMDIAGTE_OFF S_HFMD_SAON S_HFM_DIAG S_HFM_DIAG_PERM S_MSDIAGST_ON S_MSLAM_DIAG S_MSZYLDIAG_MOD S_TALEER_DIS S_WDKDIAG_PSMOD /end DEF_CHARACTERISTIC
 /begin OUT_MEASUREMENT Ctr_drdiag Diag_mso Diag_mso2 Diag_mso2_f Diag_mso_f Diag_mso_off Diag_msu Diag_msu2 Diag_msu2_f Diag_msu_f Diag_msu_off Diag_pso Diag_pso_f Diag_psu Diag_psu_f Dnkw_eisyd Dps_abs Dps_abs_acc Dpsrseg_puls Dpvdkds Dpvdkds_acc Drf_eisyd F_quotdiagh F_quotdiaghf F_quotdiagl F_quotdiagl2 F_quotdiaglf F_quotdiaglf2 Klaf_outwdkdiag Mszyl_diag Mszyl_diagf Nkw_eisydf Ps_abs_offset Ps_abs_t100 Psreg_diag Psreg_diag_f Pvdkds_offset Pvdkds_t100 Rf_eisydf St_drdiag St_drdiag.B_drdiag_akt St_drdiag.B_drdiag_akt_old St_drdiag.B_psabs_pl St_drdiag.B_pvdkds_pl St_eisyd_rbm St_eisyd_rbm.B_eisyd_rbmsc St_eisyd_rbm.B_pend_allg St_eisyd_rbm.B_pend_dpsr St_eisyd_rbm.B_pend_hfm St_eisyd_rbm.B_rbmcompl_dpsr St_eisyd_rbm.B_rbmcompl_hfm St_eisydiag1 St_eisydiag1.B_disa_diag St_eisydiag1.B_dpsr_diag St_eisydiag1.B_eisy_diag St_eisydiag1.B_eisyd_on St_eisydiag1.B_hfm_diag St_eisydiag1.B_mslam2_diag St_eisydiag1.B_mslam_diag St_eisydiag1.B_mszyldiag_mod St_eisydiag2 St_eisydiag2.B_npl_mshfm St_eisydiag2.B_nplhfm_mn St_eisydiag2.B_nplhfm_mx St_eisydiag2.B_nplmslam2_mn St_eisydiag2.B_nplmslam2_mx St_eisydiag2.B_nplmslam_mn St_eisydiag2.B_nplmslam_mx St_eisydiag3 St_eisydiag3.B_npl_dpsr St_eisydiag3.B_npldpsr_mn St_eisydiag3.B_npldpsr_mx St_eisydiag4 St_eisydiag4.B_disad_b1 St_eisydiag4.B_disad_b2 St_eisydiag4.B_disad_b3 St_eisydiag4.B_disad_b4 St_eisydiag4.B_dpsr_puls St_eisydiag4.B_npl_disa St_eisydiag5 St_eisydiag5.B_disab1_f St_eisydiag5.B_disab2_f St_eisydiag5.B_disab3_f St_eisydiag5.B_disab4_f St_eisydyn St_eisydyn.B_eisyd_stat St_eisydyn.B_eisyd_statn St_eisydyn.B_eisyd_statrf St_eisydyn.B_eisyd_stattmp St_wdkdiag St_wdkdiag.B_wdkdiag_ugd Td_mszylpt1 Wdk_diag Zk_diag_mss /end OUT_MEASUREMENT
/end FUNCTION
/begin FUNCTION EISY_DK "" /begin DEF_CHARACTERISTIC KF_MSNDK KL_AF KL_WDK_UG /end DEF_CHARACTERISTIC /begin OUT_MEASUREMENT Klaf_outdk Msdk_ur Msndk Msndk_oma Msndk_roh Pspvdk Wdk_ug /end OUT_MEASUREMENT /end FUNCTION
/begin FUNCTION EISY_EV ""
 /begin DEF_CHARACTERISTIC GAX_PIRGNN GAX_RFVISTNN CW_EISY_TURBO CW_TZKBLS CW_TZYLKOR KF_DRFV_SPUEL KF_DRFV_UK KF_NLEV KF_PAKPSOFFS KF_PSPAKOFFS KF_RFVZYLVOL KF_UEF_SPUEL KF_UEF_UK KL_AF_SPUEL KL_PIRG_MX KL_PIRG_START KL_RFVIST_MN KL_RFVIST_MX KL_RFVIST_START KL_STEND_TRANS KL_WBIAS_PIRG KL_WBIAS_PIRG2 KL_WBIAS_PIRG3 KL_WBIAS_RF KL_WBIAS_RF2 KL_WBIAS_RF3 KL_WNKW_PIRG KL_WNKW_PIRG2 KL_WNKW_PIRG3 KL_WNKW_RF KL_WNKW_RF2 KL_WNKW_RF3 KL_WOUT_PIRG KL_WOUT_PIRG2 KL_WOUT_PIRG3 KL_WOUT_RF KL_WOUT_RF2 KL_WOUT_RF3 KL_WVSA_PIRG KL_WVSA_PIRG2 KL_WVSA_PIRG3 KL_WVSA_RF KL_WVSA_RF2 KL_WVSA_RF3 KL_WVSE_PIRG KL_WVSE_PIRG2 KL_WVSE_PIRG3 KL_WVSE_RF KL_WVSE_RF2 KL_WVSE_RF3 K_DISAIST_B1 K_DISAIST_B2 K_DISAIST_B3 K_DNKW_DISA1 K_DNKW_DISA2 K_HUBOFF K_NKWDISADEAK K_NKW_DISA1 K_NKW_DISA2 K_NMIN_RF_START K_NWASB K_NWESB K_PIRGNN_ANZ K_PIRGNN_ANZ2 K_PIRGNN_ANZ3 K_PIRGWOUT_BIAS K_PIRGWOUT_BIAS2 K_PIRGWOUT_BIAS3 K_PIRG_MN K_RFVISTNN_ANZ K_RFVISTNN_ANZ2 K_RFVISTNN_ANZ3 K_RFVISTWOUT_BIAS K_RFVISTWOUT_BIAS2 K_RFVISTWOUT_BIAS3 K_TD_EVNNUMSCH K_UFAK_MS_RF K_VSAOFF K_VSEOFF K_ZK_EVMRASPR K_ZK_EVMRESPR K_ZK_EVMRHUB K_ZK_EVNNUMSCH K_ZK_PIRGF K_ZK_SPRUEF S_EISYEV_DISAISTON S_EVNN_AUS S_MSZYL_3MOD S_PIRGKON S_PSPN_OFF S_RFVISTHUB /end DEF_CHARACTERISTIC
 /begin OUT_MEASUREMENT Disa_bereich Dmszyl_spuel Dmszyl_uk Dpirgn Drf_spuel Drf_spuel_tmp Drf_uk Drf_uk_tmp Drf_zylvol Drfnorm_spuel Drfnorm_uk F_abgd F_pspu F_stend_trans F_tzkorbls F_tzylkor F_umsrfn Fupsms Fupsms_bas Fupsrf Hubev_ist_m Hubev_mareg Klafout_spuel Klafout_uk Msnzyl Msnzyl_k Mszyl Mszyl_ges Mszyl_nn Pakps_kor Pakps_offs Pirg Pirg_abgd Pirg_nn Pirg_nnbeg Pirg_nnbegf Pirg_nnf Rf_zylvol Rfv_ist Rfv_ist_hub Rfv_ist_nn Rfv_ist_nnbeg Rfv_ist_nnf Rfv_zylvol Rfzyl_nn Spr_diff Spr_sum Spr_sum_f Spr_swp St_disa_umschalt St_disa_umschalt.B_disa_deak St_disa_umschalt.B_evnnumsch Uefl_spuel Uefl_uk Vsa_spri_m Vse_spri_m /end OUT_MEASUREMENT
/end FUNCTION
/begin FUNCTION EISY_LLK "" /begin OUT_MEASUREMENT Pllk /end OUT_MEASUREMENT /end FUNCTION
/begin FUNCTION EISY_MR ""
 /begin DEF_CHARACTERISTIC GAX_15MODELLE GAX_6MODELLE KF_MAREGDKI KF_MAREGDKI_TE KF_MAREGDKP KF_MAREGDKP_TE KF_THFMOD KF_ZK_MSKOR KL_CDK_N KL_CDK_VSA_SPRI KL_CDK_VSE_SPRI KL_CDK_WDK_IST KL_ETADK KL_HUBFMAON KL_HUBFMAUN KL_HUBMSON KL_SDK_N KL_SDK_VSA_SPRI KL_SDK_VSE_SPRI KL_SDK_WDK_IST KL_TD_MRONST KL_ZKMSKOR_PSP K_ANZ_DKNN K_BGMSVVTDPS K_DKMX K_EINGANG_DK K_LOLIDK_MN K_LOLIDK_MX K_MAREGDKIMN K_MAREGDKIMX K_MAREGDKMN K_MAREGDKMX K_MAREGDKNN_MN K_MAREGDKNN_MX K_MRDVH_MN K_MRD_MN K_MRD_MS_FAK K_MRD_MS_OFF K_MRGES_DKMN K_MRGES_DKMX K_MRLINDK_MN K_MRV_MX K_NADONN K_NKWMIN_MR K_NKWMRNN_RAMP K_NMSNVTO K_NNADQUOT_DK K_PSPVK_SOLLMN1 K_PSPVK_SOLLMN2 K_PSPVK_SOLLMN3 K_PSPVK_SOLLMN4 K_PULSNMN1 K_PULSNMN2 K_PULSNMN3 K_PULSNMN4 K_PULSNMX1 K_PULSNMX2 K_PULSNMX3 K_PULSNMX4 K_PULSRFVMN1 K_PULSRFVMN2 K_PULSRFVMN3 K_PULSRFVMN4 K_PULSRFVMX1 K_PULSRFVMX2 K_PULSRFVMX3 K_PULSRFVMX4 K_TADONTM K_TADONTNS K_TDADONTAMN K_TDADONTAMX K_TD_MODABST K_TD_MRADONTE K_TD_NNOFF K_TD_NNON K_TIMSALLVT K_TIMSAON K_TIMSAVT K_TMMRNN_RAMP K_TNSMRNN_RAMP K_ZK_MRDKOFF K_ZK_MRRAMP K_ZK_NNOFF K_ZK_NNON S_ADP_RESET S_BTE_MR S_DKNNON S_EISYAD_TST S_MAREGOFF S_MODABLLTD_OFF S_MODABTE_OFF S_MRD_MS_FAK S_MROFF_KSD S_MR_MS_FAK S_NPL_RESET S_TALEER_MR /end DEF_CHARACTERISTIC
 /begin OUT_MEASUREMENT B_nplms_reset Dkaus_timer F_mr_ramp F_pssolverh Lolimot_dkaus Lolimot_dkein Lolimot_dklern Mareg_dk Mareg_dkaus Mareg_dkdiff Mareg_dki Mareg_dknn Mareg_dknn_out Mareg_dkp Mareg_dkst Mareg_er_dk Mareg_er_vvt Mareg_pidk Mareg_pivvt Mareg_vvt Mareg_vvtaus Mareg_vvtdiff Mareg_vvti Mareg_vvtnn Mareg_vvtnn_out Mareg_vvtp Mareg_vvtst Modab_fak Modab_off Modab_off_adp Modab_reg_diff Modab_reg_in Modab_reg_out Modab_reg_outadp Modab_reg_vl Modelle Mr_pskor_fak Mrd_ms_fak Mrd_ms_off Mrnn_test_dk Mrv_ms_fak Mrv_ms_off Ms_diff Msdk_diff Msdk_f Mshfm_kor Mszyl_diff St_eisyad_read St_eisyad_read.B_maregdk_ad St_eisyad_read.B_psrhub_ad St_mareg St_mareg.B_maregaddk St_mareg.B_maregadvvt St_mareg.B_maregdk1 St_mareg.B_maregdk2 St_mareg.B_mareghub1 St_mareg.B_mareghub2 St_mareg.B_mradon St_mareg.B_mron St_mareg_lim St_mareg_lim.B_mareg_dkmn St_mareg_lim.B_mareg_dkmx St_mareg_lim.B_mareg_vvtmn St_mareg_lim.B_mareg_vvtmx St_mareg_puls St_mareg_puls.B_hfm_dkerr2pot St_mareg_puls.B_hfmpuls St_mareg_puls.B_hfmpuls1 St_mareg_puls.B_hfmpuls2 St_mareg_puls.B_hfmpuls3 St_modab St_modab.B_eisy_clrad St_modab.B_llk_mr St_modab.B_modab_on St_modab.B_modab_zul St_modab.B_startende_verz St_modab.B_timsallv St_modab.B_timsavvt St_modab.B_timsvvt St_modab2 St_modab2.B_modab_off St_modab2.B_modabst_on St_modab2.B_mradonte Vvtaus_timer Z_norm_dk w_dknn_N w_dknn_Vsa_spri w_dknn_Vse_spri w_dknn_Wdk_ist w_dknn_bias /end OUT_MEASUREMENT
/end FUNCTION
/end MODULE
/end PROJECT
