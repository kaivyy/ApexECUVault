ASAP2_VERSION 1 30
/begin PROJECT MSS65-inj "Generiert am 14.10.05 um 11:34:36"
/begin HEADER "" VERSION "R341" /end HEADER
/begin MODULE _MSS65-inj "Generiert am 14.10.05 um 11:34:36"
/begin MOD_COMMON "" BYTE_ORDER MSB_FIRST ALIGNMENT_BYTE 1 ALIGNMENT_WORD 2 ALIGNMENT_LONG 4 ALIGNMENT_FLOAT32_IEEE 4 ALIGNMENT_FLOAT64_IEEE 8 /end MOD_COMMON
/begin CHARACTERISTIC K_KSD_OBD_CFG "Freigabe Kraftstoffsystemdiagnose" VALUE 0x744C8 TKW_VV_VV_UW 100.0 FORMULA_0863 0.0 1.0 FORMAT "%5.2" /end CHARACTERISTIC
/begin CHARACTERISTIC K_KSD_OBD_DIAG_T "KSD-Diagnosezeit" VALUE 0x744DA TKW_VV_VV_UW 100.0 FORMULA_0854 0.0 6553.5 /end CHARACTERISTIC
/begin CHARACTERISTIC K_KSD_OBD_LL_LAM_MAX "MAX-Gesamtabweichung Lambda KSD im LL" VALUE 0x744E4 TKW_VV_VV_UW 100.0 FORMULA_0024 0.0 1.998999953269959 FORMAT "%7.4" /end CHARACTERISTIC
/begin CHARACTERISTIC K_KSD_OBD_LL_LAM_MIN "MIN-Gesamtabweichung Lambda KSD im LL" VALUE 0x744E6 TKW_VV_VV_UW 100.0 FORMULA_0024 0.0 1.998999953269959 FORMAT "%7.4" /end CHARACTERISTIC
/begin CHARACTERISTIC K_KSD_OBD_LL_MAX_T "Zeit - MAX-Ueberschr. im LL" VALUE 0x744DC TKW_VV_VV_UW 100.0 FORMULA_0854 0.0 6553.5 /end CHARACTERISTIC
/begin CHARACTERISTIC K_KSD_OBD_LL_MIN_T "Zeit - MIN-Ueberschr. im LL" VALUE 0x744DE TKW_VV_VV_UW 100.0 FORMULA_0854 0.0 6553.5 /end CHARACTERISTIC
/begin CHARACTERISTIC K_KSD_OBD_N_MAX "max. Drehzahl f. KSD" VALUE 0x744D0 TKW_VV_VV_SW 100.0 FORMULA_0006 0.0 10000.0 /end CHARACTERISTIC
/begin CHARACTERISTIC K_KSD_OBD_N_MIN "min. Drehzahl f. KSD" VALUE 0x744D2 TKW_VV_VV_SW 100.0 FORMULA_0006 0.0 10000.0 /end CHARACTERISTIC
/begin CHARACTERISTIC K_KSD_OBD_OEL_SPERR_MAX "Schwelle fuer Erkennung Oelverduennung" VALUE 0x744C6 TKW_VV_VV_UB 100.0 FORMULA_0003 0.0 255.0 /end CHARACTERISTIC
/begin CHARACTERISTIC K_KSD_OBD_PUMG_MIN "min. Umgebungsdruck" VALUE 0x744D6 TKW_VV_VV_SW 100.0 FORMULA_0075 400.0 1200.0 FORMAT "%4.1" /end CHARACTERISTIC
/begin CHARACTERISTIC K_KSD_OBD_RF_MAX "max. relative Füllung f. KSD" VALUE 0x744CC TKW_VV_VV_SW 100.0 FORMULA_0007 0.0 2.0 FORMAT "%6.3" /end CHARACTERISTIC
/begin CHARACTERISTIC K_KSD_OBD_RF_MIN "min. relative Füllung f. KSD" VALUE 0x744CE TKW_VV_VV_SW 100.0 FORMULA_0007 0.0 2.0 FORMAT "%6.3" /end CHARACTERISTIC
/begin CHARACTERISTIC K_KSD_OBD_TAN "max. TAN-Schwelle" VALUE 0x744D4 TKW_VV_VV_SW 100.0 FORMULA_0023 -50.0 170.0 FORMAT "%4.1" /end CHARACTERISTIC
/begin CHARACTERISTIC K_KSD_OBD_TL_LAM_MAX "MAX-Gesamtabweichung Lambda KSD in TL" VALUE 0x744E8 TKW_VV_VV_UW 100.0 FORMULA_0024 0.0 1.998999953269959 FORMAT "%7.4" /end CHARACTERISTIC
/begin CHARACTERISTIC K_KSD_OBD_TL_LAM_MIN "MIN-Gesamtabweichung Lambda KSD im LL" VALUE 0x744EA TKW_VV_VV_UW 100.0 FORMULA_0024 0.0 1.998999953269959 FORMAT "%7.4" /end CHARACTERISTIC
/begin CHARACTERISTIC K_KSD_OBD_TL_MAX_T "Zeit - MAX-Ueberschr. in TL" VALUE 0x744E0 TKW_VV_VV_UW 100.0 FORMULA_0854 0.0 6553.5 /end CHARACTERISTIC
/begin CHARACTERISTIC K_KSD_OBD_TL_MIN_T "Zeit - MIN-Ueberschr. in TL" VALUE 0x744E2 TKW_VV_VV_UW 100.0 FORMULA_0854 0.0 6553.5 /end CHARACTERISTIC
/begin CHARACTERISTIC K_KSD_OBD_TMOT_MIN "min. TMOT-Schwelle f. KSD" VALUE 0x744CA TKW_VV_VV_SW 100.0 FORMULA_0023 -50.0 170.0 FORMAT "%4.1" /end CHARACTERISTIC
/begin CHARACTERISTIC K_KSD_OBD_V "max. Fahrzeuggeschwindigkeit f. LL-KSD" VALUE 0x744D8 TKW_VV_VV_SW 100.0 FORMULA_0076 -80.0 360.0 FORMAT "%4.1" /end CHARACTERISTIC
/begin CHARACTERISTIC K_LA_OBD_DYN_CNT_INC "Counter increments fuer rf_dyn_la_cnt" VALUE 0x7444C TKW_VV_VV_UB 100.0 FORMULA_0037 0.0 255.0 /end CHARACTERISTIC
/begin CHARACTERISTIC K_LA_OBD_DYN_DELTA_CNT "Anzahl der dyn Triggers bis status gesetzt wird" VALUE 0x7444A TKW_VV_VV_UW 100.0 FORMULA_0080 0.0 65535.0 FORMAT "%5.2" /end CHARACTERISTIC
/begin CHARACTERISTIC K_LA_OBD_DYN_DELTA_PUMP_RF "rf Differnez fuer Dynamikerkennung gegen Pumpen" VALUE 0x74448 TKW_VV_VV_SW 100.0 FORMULA_0007 0.0 2.0 FORMAT "%6.3" /end CHARACTERISTIC
/begin CHARACTERISTIC K_LA_OBD_DYN_DELTA_RF "rf Differnez fuer Dynamikerkennung" VALUE 0x74446 TKW_VV_VV_SW 100.0 FORMULA_0007 0.0 2.0 FORMAT "%6.3" /end CHARACTERISTIC
/begin CHARACTERISTIC K_LA_OBD_DYN_RF_T "Sperrzeit fuer Ruecknahme rf-Dynamik" VALUE 0x7444E TKW_VV_VV_UW 100.0 FORMULA_0021 0.0 655.3499755859375 FORMAT "%5.2" /end CHARACTERISTIC
/begin CHARACTERISTIC K_LANK_DIAG_CFG "Freigabe d. elektrischen Diag. NKAT" VALUE 0x74336 TKW_VV_VV_UB 100.0 FORMULA_0831 0.0 1.0 /end CHARACTERISTIC
/begin CHARACTERISTIC K_LANK_DIAG_GND_T "Zeitschwelle-NKAT fuer GND" VALUE 0x74342 TKW_VV_VV_UW 100.0 FORMULA_0021 0.0 655.0 FORMAT "%5.2" /end CHARACTERISTIC
/begin CHARACTERISTIC K_LANK_DIAG_MAX_T "Zeitschwelle-NKAT fuer UBATT" VALUE 0x74340 TKW_VV_VV_UW 100.0 FORMULA_0021 0.0 655.0 FORMAT "%5.2" /end CHARACTERISTIC
/begin CHARACTERISTIC K_LANK_DIAG_OL_IO_T "Zeitschwelle-NKAT fuer OL i.O." VALUE 0x74346 TKW_VV_VV_UW 100.0 FORMULA_0593 0.0 65535.0 /end CHARACTERISTIC
/begin CHARACTERISTIC K_LANK_DIAG_OL_T "Zeitschwelle-NKAT fuer OL" VALUE 0x74344 TKW_VV_VV_UW 100.0 FORMULA_0593 0.0 65535.0 /end CHARACTERISTIC
/begin CHARACTERISTIC K_LANK_DIAG_SONDTEMP "min. Sondentemperatur" VALUE 0x7433C TKW_VV_VV_SW 100.0 FORMULA_0023 -50.0 1250.0 FORMAT "%4.1" /end CHARACTERISTIC
/begin CHARACTERISTIC K_LANK_DIAG_STAB_T "Zeitschwelle f. stab. Zustand" VALUE 0x7433E TKW_VV_VV_UW 100.0 FORMULA_0021 0.0 655.0 FORMAT "%5.2" /end CHARACTERISTIC
/begin CHARACTERISTIC K_LANK_DIAG_TKAT "KAT-Temperaturschwelle" VALUE 0x7433A TKW_VV_VV_SW 100.0 FORMULA_0023 -50.0 1250.0 FORMAT "%4.1" /end CHARACTERISTIC
/begin CHARACTERISTIC K_LANK_DIAG_UMAX "MAX. NKAT-Sondenspannung" VALUE 0x74348 TKW_VV_VV_UW 100.0 FORMULA_0536 0.0 1200.0 /end CHARACTERISTIC
/begin CHARACTERISTIC K_LANK_DIAG_UMIN "MIN. NKAT-Sondenspannung" VALUE 0x7434A TKW_VV_VV_UW 100.0 FORMULA_0536 0.0 1200.0 /end CHARACTERISTIC
/begin CHARACTERISTIC K_LANK_DIAG_VK_REG_T "Aktivzeit VKAT-Regler" VALUE 0x74338 TKW_VV_VV_UW 100.0 FORMULA_0021 0.0 655.0 FORMAT "%5.2" /end CHARACTERISTIC
/begin CHARACTERISTIC K_LANK_FETT "Fettschwelle fuer NKAT-Signal" VALUE 0x74324 TKW_VV_VV_UW 100.0 FORMULA_0536 0.0 1200.0 /end CHARACTERISTIC
/begin CHARACTERISTIC K_LANK_MAGER "Magerschwelle fuer NKAT-Signal" VALUE 0x74326 TKW_VV_VV_UW 100.0 FORMULA_0536 0.0 1200.0 /end CHARACTERISTIC
/begin CHARACTERISTIC K_LANK_N_MAX "obere n-Schwelle als Ausschaltbedingung" VALUE 0x7432C TKW_VV_VV_SW 100.0 FORMULA_0006 0.0 10000.0 /end CHARACTERISTIC
/begin CHARACTERISTIC K_LANK_N_MIN "untere n-Schwelle als Ausschaltbedingung" VALUE 0x7432E TKW_VV_VV_SW 100.0 FORMULA_0006 0.0 10000.0 /end CHARACTERISTIC
/begin CHARACTERISTIC K_LANK_OBD_S_AUTOM_CNT "Anzahl d.fehlerhafte Diagnosen - Automatikprog." VALUE 0x7436B TKW_VV_VV_UB 100.0 FORMULA_0003 0.0 255.0 /end CHARACTERISTIC
/begin CHARACTERISTIC K_LANK_OBD_S_CFG "Freigabe d. NKAT-Schwingungspr." VALUE 0x7434C TKW_VV_VV_UW 100.0 FORMULA_0799 0.0 1.0 FORMAT "%5.2" /end CHARACTERISTIC
/begin CHARACTERISTIC K_LANK_OBD_S_CNT "Anzahl d.fehlerhafte Diagnosen" VALUE 0x7436C TKW_VV_VV_UB 100.0 FORMULA_0003 0.0 255.0 /end CHARACTERISTIC
/begin CHARACTERISTIC K_LANK_OBD_S_LAM_VKAT "VKAT-FETT-Schwelle f. VL-S-Diag." VALUE 0x74358 TKW_VV_VV_UW 100.0 FORMULA_0025 0.0 3.999000072479248 FORMAT "%6.3" /end CHARACTERISTIC
/begin CHARACTERISTIC K_LANK_OBD_S_NMAX "obere n-Schwelle als Ausschaltbedingung" VALUE 0x74350 TKW_VV_VV_SW 100.0 FORMULA_0006 0.0 10000.0 /end CHARACTERISTIC
/begin CHARACTERISTIC K_LANK_OBD_S_NMIN "untere n-Schwelle als Ausschaltbedingung" VALUE 0x74352 TKW_VV_VV_SW 100.0 FORMULA_0006 0.0 10000.0 /end CHARACTERISTIC
/begin CHARACTERISTIC K_LANK_OBD_S_SA_AUTOM "Anzahl der Automatikprogramme" VALUE 0x7436A TKW_VV_VV_UB 100.0 FORMULA_0003 0.0 255.0 /end CHARACTERISTIC
/begin CHARACTERISTIC K_LANK_OBD_S_SA_ML_SUM "min. aufsummierte Luftmassenstr. fuer SA-Diag." VALUE 0x74366 TKW_VV_VV_UW 100.0 FORMULA_0792 0.0 65535.0 /end CHARACTERISTIC
/begin CHARACTERISTIC K_LANK_OBD_S_SA_T "Wartezeit SCHUBDAUER - OBD-S-Diag." VALUE 0x7435C TKW_VV_VV_UW 100.0 FORMULA_0071 0.0 6553.5 FORMAT "%4.1" /end CHARACTERISTIC
/begin CHARACTERISTIC K_LANK_OBD_S_SA_US "Fehlerschwelle fuer OBD-S-Diag." VALUE 0x7435A TKW_VV_VV_UW 100.0 FORMULA_0536 0.0 1200.0 /end CHARACTERISTIC
/begin CHARACTERISTIC K_LANK_OBD_S_SA_WE_T "max. SCHUBDAUER fuer Schaltvorgang" VALUE 0x74362 TKW_VV_VV_UW 100.0 FORMULA_0071 0.0 6553.5 FORMAT "%4.1" /end CHARACTERISTIC
/begin CHARACTERISTIC K_LANK_OBD_S_TML "min. ML-Zeit" VALUE 0x7435E TKW_VV_VV_UW 100.0 FORMULA_0021 0.0 655.0 FORMAT "%5.2" /end CHARACTERISTIC
/begin CHARACTERISTIC K_LANK_OBD_S_USF "Fettschwelle fuer OBD-S-Diag." VALUE 0x7434E TKW_VV_VV_UW 100.0 FORMULA_0536 0.0 1200.0 /end CHARACTERISTIC
/begin CHARACTERISTIC K_LANK_OBD_S_VL_T "Wartezeit VL - OBD-S-Diag." VALUE 0x74356 TKW_VV_VV_UW 100.0 FORMULA_0021 0.0 655.0 FORMAT "%5.2" /end CHARACTERISTIC
/begin CHARACTERISTIC K_LANK_OBD_S_VL_US "Fehlerschwelle fuer OBD-S-Diag." VALUE 0x74354 TKW_VV_VV_UW 100.0 FORMULA_0536 0.0 1200.0 /end CHARACTERISTIC
/begin CHARACTERISTIC K_LANK_OBD_S_WE_CNT "Anzahl durchzufuehrende WE-Diagnosen" VALUE 0x7436D TKW_VV_VV_UB 100.0 FORMULA_0003 0.0 255.0 /end CHARACTERISTIC
/begin CHARACTERISTIC K_LANK_OBD_S_WE_LAM_T "max. Zeit in d. zus. Anfettung wirkt - OBD-S-Diag." VALUE 0x74364 TKW_VV_VV_UW 100.0 FORMULA_0071 0.0 6553.5 FORMAT "%4.1" /end CHARACTERISTIC
/begin CHARACTERISTIC K_LANK_OBD_S_WE_ML_SUM "min. aufsummierte Luftmassenstr. fuer. WE-Diag." VALUE 0x74368 TKW_VV_VV_UW 100.0 FORMULA_0792 0.0 65535.0 /end CHARACTERISTIC
/begin CHARACTERISTIC K_LANK_OBD_S_WE_T "Wartezeit WE - OBD-S-Diag." VALUE 0x74360 TKW_VV_VV_UW 100.0 FORMULA_0071 0.0 6553.5 FORMAT "%4.1" /end CHARACTERISTIC
/begin CHARACTERISTIC K_LANK_RF_MAX "obere rf-Schwelle als Ausschaltbedingung" VALUE 0x74330 TKW_VV_VV_SW 100.0 FORMULA_0007 0.0 2.0 FORMAT "%6.3" /end CHARACTERISTIC
/begin CHARACTERISTIC K_LANK_RF_MIN "untere rf-Schwelle als Ausschaltbedingung" VALUE 0x74332 TKW_VV_VV_SW 100.0 FORMULA_0007 0.0 2.0 FORMAT "%6.3" /end CHARACTERISTIC
/begin CHARACTERISTIC K_LANK_T_AUS "Ausschaltueberwachungszeit NKAT-Signal" VALUE 0x7432A TKW_VV_VV_UW 100.0 FORMULA_0021 0.0 655.0 FORMAT "%5.2" /end CHARACTERISTIC
/begin CHARACTERISTIC K_LANK_T_EIN "Einschaltueberwachungszeit NKAT-Signal" VALUE 0x74328 TKW_VV_VV_UW 100.0 FORMULA_0021 0.0 655.0 FORMAT "%5.2" /end CHARACTERISTIC
/begin CHARACTERISTIC K_LANK_TKAT_SCHW "Kattemperaturschwelle als Einschaltbedingung" VALUE 0x74334 TKW_VV_VV_SW 100.0 FORMULA_0023 -50.0 1200.0 FORMAT "%4.1" /end CHARACTERISTIC
/begin CHARACTERISTIC K_LANK_US_FILT_OB "Filterband - obere Schwelle" VALUE 0x7431A TKW_VV_VV_UW 100.0 FORMULA_0536 0.0 1200.0 /end CHARACTERISTIC
/begin CHARACTERISTIC K_LANK_US_FILT_T "Einschwingzeit - NKAT-Signal" VALUE 0x7431C TKW_VV_VV_UW 100.0 FORMULA_0672 0.0 655350.0 /end CHARACTERISTIC
/begin CHARACTERISTIC K_LANK_US_FILT_UNT "Filterband - untere Schwelle" VALUE 0x74318 TKW_VV_VV_UW 100.0 FORMULA_0536 0.0 1200.0 /end CHARACTERISTIC
/begin CHARACTERISTIC K_LANK_US_TAU "Zeitkonstante NKAT-Signal" VALUE 0x7431E TKW_VV_VV_UB 100.0 FORMULA_0658 1.009999960660934e-002 2.559999942779541 /end CHARACTERISTIC
/begin CHARACTERISTIC K_LANK_US_TAU_S "schnelle Filterkonstante NKAT-Signal" VALUE 0x74316 TKW_VV_VV_UW 100.0 FORMULA_0830 0.0 257.0 FORMAT "%5.2" /end CHARACTERISTIC
/begin CHARACTERISTIC K_LANK_USF "Fettschwelle fuer verbotenes Band" VALUE 0x74320 TKW_VV_VV_UW 100.0 FORMULA_0536 0.0 1200.0 /end CHARACTERISTIC
/begin CHARACTERISTIC K_LANK_USM "Magerschwelle fuer verbotenes Band" VALUE 0x74322 TKW_VV_VV_UW 100.0 FORMULA_0536 0.0 1200.0 /end CHARACTERISTIC
/begin CHARACTERISTIC K_LAVK_OBD_ACT_CFG "Freigabe aktive Plausi-Diagnose" VALUE 0x7449C TKW_VV_VV_UW 100.0 FORMULA_0799 0.0 1.0 FORMAT "%5.2" /end CHARACTERISTIC
/begin CHARACTERISTIC K_LAVK_OBD_ACT_EXD_N_SOLL "Prueflauf - angeforderte Drehzahl" VALUE 0x744C2 TKW_VV_VV_SW 100.0 FORMULA_0006 0.0 10000.0 /end CHARACTERISTIC
/begin CHARACTERISTIC K_LAVK_OBD_ACT_EXD_TIME "Prueflauf Freigabezeit" VALUE 0x744C4 TKW_VV_VV_UW 100.0 FORMULA_0854 0.0 6553.5 /end CHARACTERISTIC
/begin CHARACTERISTIC K_LAVK_OBD_ACT_F_T "FETT-Verzoegerungszeit - aktive Plausi-Diag." VALUE 0x744AC TKW_VV_VV_UW 100.0 FORMULA_0071 0.0 6553.5 FORMAT "%4.1" /end CHARACTERISTIC
/begin CHARACTERISTIC K_LAVK_OBD_ACT_LAM_IST_F "LA-Schwelle f. FETT-Fehler" VALUE 0x744B4 TKW_VV_VV_UW 100.0 FORMULA_0025 0.0 3.999000072479248 FORMAT "%6.3" /end CHARACTERISTIC
/begin CHARACTERISTIC K_LAVK_OBD_ACT_LAM_IST_M "LA-Schwelle f. MAGER-Fehler" VALUE 0x744B2 TKW_VV_VV_UW 100.0 FORMULA_0025 0.0 3.999000072479248 FORMAT "%6.3" /end CHARACTERISTIC
/begin CHARACTERISTIC K_LAVK_OBD_ACT_LAM_SOLL_F "SOLL-Lambda - FETT-Diagnose" VALUE 0x744B0 TKW_VV_VV_UW 100.0 FORMULA_0025 0.0 3.999000072479248 FORMAT "%6.3" /end CHARACTERISTIC
/begin CHARACTERISTIC K_LAVK_OBD_ACT_LAM_SOLL_M "SOLL-Lambda - MAGER-Diagnose" VALUE 0x744AE TKW_VV_VV_UW 100.0 FORMULA_0025 0.0 3.999000072479248 FORMAT "%6.3" /end CHARACTERISTIC
/begin CHARACTERISTIC K_LAVK_OBD_ACT_LANK_F "NKAT-Schwelle f. FETT-Fehler" VALUE 0x744B8 TKW_VV_VV_UW 100.0 FORMULA_0536 0.0 1200.0 /end CHARACTERISTIC
/begin CHARACTERISTIC K_LAVK_OBD_ACT_LANK_M "NKAT-Schwelle f. MAGER-Fehler" VALUE 0x744B6 TKW_VV_VV_UW 100.0 FORMULA_0536 0.0 1200.0 /end CHARACTERISTIC
/begin CHARACTERISTIC K_LAVK_OBD_ACT_M_T "MAGER-Verzoegerungszeit - aktive Plausi-Diag." VALUE 0x744AA TKW_VV_VV_UW 100.0 FORMULA_0071 0.0 6553.5 FORMAT "%4.1" /end CHARACTERISTIC
/begin CHARACTERISTIC K_LAVK_OBD_ACT_ML_SUM "min. aufsummierte Luftmassenstr. nach SA_WE" VALUE 0x744A0 TKW_VV_VV_UW 100.0 FORMULA_0792 0.0 65535.0 /end CHARACTERISTIC
/begin CHARACTERISTIC K_LAVK_OBD_ACT_N_MAX "max. Drehzahl f. aktive Plausi-Diag." VALUE 0x744A6 TKW_VV_VV_SW 100.0 FORMULA_0006 0.0 10000.0 /end CHARACTERISTIC
/begin CHARACTERISTIC K_LAVK_OBD_ACT_N_MIN "min. Drehzahl f. aktive Plausi-Diag." VALUE 0x744A8 TKW_VV_VV_SW 100.0 FORMULA_0006 0.0 10000.0 /end CHARACTERISTIC
/begin CHARACTERISTIC K_LAVK_OBD_ACT_NK_F_CNT "NKAT Fehlerzaehler - FETT-Diagnose" VALUE 0x744C0 TKW_VV_VV_UW 100.0 FORMULA_0010 0.0 65535.0 /end CHARACTERISTIC
/begin CHARACTERISTIC K_LAVK_OBD_ACT_NK_M_CNT "NKAT Fehlerzaehler - MAGER-Diagnose" VALUE 0x744BC TKW_VV_VV_UW 100.0 FORMULA_0010 0.0 65535.0 /end CHARACTERISTIC
/begin CHARACTERISTIC K_LAVK_OBD_ACT_RF_MAX "max. relative Füllung f. aktive Plausi-Diag." VALUE 0x744A2 TKW_VV_VV_SW 100.0 FORMULA_0007 0.0 2.0 FORMAT "%6.3" /end CHARACTERISTIC
/begin CHARACTERISTIC K_LAVK_OBD_ACT_RF_MIN "min. relative Füllung f. aktive Plausi-Diag." VALUE 0x744A4 TKW_VV_VV_SW 100.0 FORMULA_0007 0.0 2.0 FORMAT "%6.3" /end CHARACTERISTIC
/begin CHARACTERISTIC K_LAVK_OBD_ACT_TKAT "min. KAT-Temperatur - aktive Plausi.Diag." VALUE 0x7449E TKW_VV_VV_SW 100.0 FORMULA_0023 -50.0 1200.0 FORMAT "%4.1" /end CHARACTERISTIC
/begin CHARACTERISTIC K_LAVK_OBD_ACT_TRIM_F "Fehlersimulation TRIM_FETT_FEHLER" VALUE 0x74498 TKW_VV_VV_UW 100.0 FORMULA_0799 0.0 1.0 FORMAT "%5.2" /end CHARACTERISTIC
/begin CHARACTERISTIC K_LAVK_OBD_ACT_TRIM_M "Fehlersimulation TRIM_MAGER_FEHLER" VALUE 0x7449A TKW_VV_VV_UW 100.0 FORMULA_0799 0.0 1.0 FORMAT "%5.2" /end CHARACTERISTIC
/begin CHARACTERISTIC K_LAVK_OBD_ACT_VK_F_CNT "VKAT Fehlerzaehler - FETT-Diagnose" VALUE 0x744BE TKW_VV_VV_UW 100.0 FORMULA_0010 0.0 65535.0 /end CHARACTERISTIC
/begin CHARACTERISTIC K_LAVK_OBD_ACT_VK_M_CNT "VKAT Fehlerzaehler - MAGER-Diagnose" VALUE 0x744BA TKW_VV_VV_UW 100.0 FORMULA_0010 0.0 65535.0 /end CHARACTERISTIC
/begin CHARACTERISTIC K_LAVK_OBD_PLAU_CFG "Freigabe OBD-Plausibilitaet" VALUE 0x74450 TKW_VV_VV_UW 100.0 FORMULA_0860 0.0 1.0 FORMAT "%5.2" /end CHARACTERISTIC
/begin CHARACTERISTIC K_LAVK_OBD_PLAU_F_CNT "FETT-Plausi Fehlerzaehler" VALUE 0x7446A TKW_VV_VV_UW 100.0 FORMULA_0010 0.0 255.0 /end CHARACTERISTIC
/begin CHARACTERISTIC K_LAVK_OBD_PLAU_IP_N_MAX "max. Drehzahl f. IP-/VM-Verdacht bei Plausi-Diag." VALUE 0x7447C TKW_VV_VV_SW 100.0 FORMULA_0006 0.0 10000.0 /end CHARACTERISTIC
/begin CHARACTERISTIC K_LAVK_OBD_PLAU_IP_N_MIN "min. Drehzahl f. IP-/VM-Verdacht bei Plausi-Diag." VALUE 0x7447E TKW_VV_VV_SW 100.0 FORMULA_0006 0.0 10000.0 /end CHARACTERISTIC
/begin CHARACTERISTIC K_LAVK_OBD_PLAU_IP_REG_MAX "max. Regelabweichung bei IP/VM-Openload-Verdacht" VALUE 0x7447A TKW_VV_VV_UW 100.0 FORMULA_0024 0.0 1.998999953269959 FORMAT "%7.4" /end CHARACTERISTIC
/begin CHARACTERISTIC K_LAVK_OBD_PLAU_IP_REG_MIN "min. Regelabweichung bei IP/VM-Openload-Verdacht" VALUE 0x74478 TKW_VV_VV_UW 100.0 FORMULA_0024 0.0 1.998999953269959 FORMAT "%7.4" /end CHARACTERISTIC
/begin CHARACTERISTIC K_LAVK_OBD_PLAU_IP_STABIL_T "min. Zeit auf Erkennung DYNAMIK" VALUE 0x74476 TKW_VV_VV_UW 100.0 FORMULA_0668 0.0 6553500.0 /end CHARACTERISTIC
/begin CHARACTERISTIC K_LAVK_OBD_PLAU_LAM_FETT "VKAT-Lambda FETT-Schwelle f. OBD-Plausi" VALUE 0x74462 TKW_VV_VV_UW 100.0 FORMULA_0025 0.0 3.999000072479248 FORMAT "%6.3" /end CHARACTERISTIC
/begin CHARACTERISTIC K_LAVK_OBD_PLAU_LAM_MAGER "VKAT-Lambda MAGER-Schwelle f. OBD-Plausi" VALUE 0x74464 TKW_VV_VV_UW 100.0 FORMULA_0025 0.0 3.999000072479248 FORMAT "%6.3" /end CHARACTERISTIC
/begin CHARACTERISTIC K_LAVK_OBD_PLAU_LAM_MAX "VKAT-Lambda MIN-Schwelle f. OBD-Plausi" VALUE 0x74468 TKW_VV_VV_UW 100.0 FORMULA_0025 0.0 3.999000072479248 FORMAT "%6.3" /end CHARACTERISTIC
/begin CHARACTERISTIC K_LAVK_OBD_PLAU_LAM_MIN "VKAT-Lambda MIN-Schwelle f. OBD-Plausi" VALUE 0x74466 TKW_VV_VV_UW 100.0 FORMULA_0025 0.0 3.999000072479248 FORMAT "%6.3" /end CHARACTERISTIC
/begin CHARACTERISTIC K_LAVK_OBD_PLAU_LANK_MAX "NKAT-Signal MAGER-Schwelle f. OBD-Plausi" VALUE 0x7445E TKW_VV_VV_UW 100.0 FORMULA_0536 0.0 1200.0 /end CHARACTERISTIC
/begin CHARACTERISTIC K_LAVK_OBD_PLAU_LANK_MIN "NKAT-Signal FETT-Schwelle f. OBD-Plausi" VALUE 0x7445C TKW_VV_VV_UW 100.0 FORMULA_0536 0.0 1200.0 /end CHARACTERISTIC
/begin CHARACTERISTIC K_LAVK_OBD_PLAU_M_CNT "MAGER-Plausi Fehlerzaehler" VALUE 0x7446C TKW_VV_VV_UW 100.0 FORMULA_0010 0.0 255.0 /end CHARACTERISTIC
/begin CHARACTERISTIC K_LAVK_OBD_PLAU_ML_SUM "min. aufsummierte Luftmassenstr. nach SA_WE" VALUE 0x74474 TKW_VV_VV_UW 100.0 FORMULA_0792 0.0 65535.0 /end CHARACTERISTIC
/begin CHARACTERISTIC K_LAVK_OBD_PLAU_OL_CNT "F/M-Plausi Fehlerzaehler" VALUE 0x7446E TKW_VV_VV_UW 100.0 FORMULA_0010 0.0 65535.0 /end CHARACTERISTIC
/begin CHARACTERISTIC K_LAVK_OBD_PLAU_RF_MAX "max. relative Füllung f. OBD-Plausi" VALUE 0x74454 TKW_VV_VV_SW 100.0 FORMULA_0007 0.0 2.0 FORMAT "%6.3" /end CHARACTERISTIC
/begin CHARACTERISTIC K_LAVK_OBD_PLAU_RF_MIN "min. relative Füllung f. OBD-Plausi" VALUE 0x74456 TKW_VV_VV_SW 100.0 FORMULA_0007 0.0 2.0 FORMAT "%6.3" /end CHARACTERISTIC
/begin CHARACTERISTIC K_LAVK_OBD_PLAU_T "Verzoegerungszeit OBD-Plausibilisierung" VALUE 0x74470 TKW_VV_VV_UW 100.0 FORMULA_0071 0.0 6553.5 FORMAT "%4.1" /end CHARACTERISTIC
/begin CHARACTERISTIC K_LAVK_OBD_PLAU_TKAT_MAX "max. KAT-Temperatur f. OBD-Plausi" VALUE 0x7445A TKW_VV_VV_SW 100.0 FORMULA_0023 -50.0 1200.0 FORMAT "%4.1" /end CHARACTERISTIC
/begin CHARACTERISTIC K_LAVK_OBD_PLAU_TKAT_MIN "min. KAT-Temperatur f. OBD-Plausi" VALUE 0x74458 TKW_VV_VV_SW 100.0 FORMULA_0023 -50.0 1200.0 FORMAT "%4.1" /end CHARACTERISTIC
/begin CHARACTERISTIC K_LAVK_OBD_PLAU_UN_OSZI_OFF "Ausschaltzeit des ATIC42-Oszi f. UN-OL-Diag." VALUE 0x74472 TKW_VV_VV_UW 100.0 FORMULA_0071 0.0 6553.5 FORMAT "%4.1" /end CHARACTERISTIC
/begin CHARACTERISTIC K_LAVK_OBD_PLAU_UN_SCHW "VKAT-Schwelle f. UN-OPENLOAD-Diag." VALUE 0x74460 TKW_VV_VV_UW 100.0 FORMULA_0536 0.0 5000.0 /end CHARACTERISTIC
/begin CHARACTERISTIC K_LAVK_OBD_SA_CFG "Freigabe OBD-SA-Pruefung" VALUE 0x74480 TKW_VV_VV_UW 100.0 FORMULA_0861 0.0 1.0 FORMAT "%5.2" /end CHARACTERISTIC
/begin CHARACTERISTIC K_LAVK_OBD_SA_CNT "SA-Diag.-Fehlerzaehler" VALUE 0x74482 TKW_VV_VV_UW 100.0 FORMULA_0010 0.0 65535.0 /end CHARACTERISTIC
/begin CHARACTERISTIC K_LAVK_OBD_SA_DIAG_OL "VKAT-Lambda MAGER-Schwelle f. OPELNLOAD-Diag." VALUE 0x74444 TKW_VV_VV_UW 100.0 FORMULA_0536 0.0 5000.0 /end CHARACTERISTIC
/begin CHARACTERISTIC K_LAVK_OBD_SA_ML_SUM "min. aufsummierte Luftmassenstr. im ZUST_SA" VALUE 0x74488 TKW_VV_VV_UW 100.0 FORMULA_0792 0.0 65535.0 /end CHARACTERISTIC
/begin CHARACTERISTIC K_LAVK_OBD_SA_SCHW "SA-Diag.-Schwelle AD-Wert" VALUE 0x74486 TKW_VV_VV_UW 100.0 FORMULA_0536 0.0 5000.0 /end CHARACTERISTIC
/begin CHARACTERISTIC K_LAVK_OBD_SA_T "Verzoegerungszeit OBD-SA-Pruefung" VALUE 0x74484 TKW_VV_VV_UW 100.0 FORMULA_0071 0.0 6553.5 FORMAT "%4.1" /end CHARACTERISTIC
/begin CHARACTERISTIC K_LAVK_OBD_TL_CFG "Freigabe OBD-TL/VL-Diagnose" VALUE 0x7448C TKW_VV_VV_UW 100.0 FORMULA_0862 0.0 1.0 FORMAT "%5.2" /end CHARACTERISTIC
/begin CHARACTERISTIC K_LAVK_OBD_TL_CNT "TL/VL-Diag.-Fehlerzaehler" VALUE 0x7448E TKW_VV_VV_UW 100.0 FORMULA_0010 0.0 65535.0 /end CHARACTERISTIC
/begin CHARACTERISTIC K_LAVK_OBD_TL_ML_SUM "min. aufsummierte Luftmassenstr. nach SA_WE" VALUE 0x74492 TKW_VV_VV_UW 100.0 FORMULA_0792 0.0 65535.0 /end CHARACTERISTIC
/begin CHARACTERISTIC K_LAVK_OBD_TL_SCHW_MAX "VKAT-Lambda MAGER-Schwelle f. OPELNLOAD-Diag." VALUE 0x74494 TKW_VV_VV_UW 100.0 FORMULA_0536 0.0 5000.0 /end CHARACTERISTIC
/begin CHARACTERISTIC K_LAVK_OBD_TL_SCHW_MIN "VKAT-Lambda MAGER-Schwelle f. OPELNLOAD-Diag." VALUE 0x74496 TKW_VV_VV_UW 100.0 FORMULA_0536 0.0 5000.0 /end CHARACTERISTIC
/begin CHARACTERISTIC K_LAVK_OBD_TL_T "Verzoegerungszeit OBD-TL/VL-Diagnose" VALUE 0x74490 TKW_VV_VV_UW 100.0 FORMULA_0071 0.0 6553.5 FORMAT "%4.1" /end CHARACTERISTIC
/begin CHARACTERISTIC K_LAVK_OBD_TMOT "min. TMOT-Schwelle f. OBD-PLAUSI" VALUE 0x74452 TKW_VV_VV_SW 100.0 FORMULA_0023 -50.0 170.0 FORMAT "%4.1" /end CHARACTERISTIC
/begin CHARACTERISTIC K_LAVK_OBD_VK_TEMP "min. Sondentemperatur fuer Freigabe" VALUE 0x7448A TKW_VV_VV_SW 100.0 FORMULA_0791 -50.0 1250.0 /end CHARACTERISTIC
/begin CHARACTERISTIC K_LSH_UB_TAU "Zeitkonstante LSH-UB" VALUE 0x7492A TKW_VV_VV_UB 100.0 FORMULA_0679 0.1004000008106232 25.60000038146973 /end CHARACTERISTIC
/begin CHARACTERISTIC K_LSHNK_AKTIV_T "Heizzeit der LSH" VALUE 0x747FE TKW_VV_VV_UW 100.0 FORMULA_0021 0.0 655.0 FORMAT "%5.2" /end CHARACTERISTIC
/begin CHARACTERISTIC K_LSHNK_DIAG_CFG "Freigabe d. elektrischen Diag. LSH-NKAT" VALUE 0x747EC TKW_VV_VV_UB 100.0 FORMULA_0831 0.0 1.0 /end CHARACTERISTIC
/begin CHARACTERISTIC K_LSHNK_DIAG_R_TAU "Zeitkonstante zur Mittelung NKAT" VALUE 0x747F6 TKW_VV_VV_UB 100.0 FORMULA_0658 1.009999960660934e-002 2.559999942779541 /end CHARACTERISTIC
/begin CHARACTERISTIC K_LSHNK_DIAG_RO "obere NKAT-Widerstandsschwelle" VALUE 0x747FA TKW_VV_VV_UW 100.0 FORMULA_0541 0.0 6553.5 FORMAT "%4.1" /end CHARACTERISTIC
/begin CHARACTERISTIC K_LSHNK_DIAG_RU "untere NKAT-Widerstandsschwelle" VALUE 0x747FC TKW_VV_VV_UW 100.0 FORMULA_0541 0.0 6553.5 FORMAT "%4.1" /end CHARACTERISTIC
/begin CHARACTERISTIC K_LSHNK_DIAG_TAUP_T "Zeitschwelle ab Taupunktueberschr." VALUE 0x747F8 TKW_VV_VV_UW 100.0 FORMULA_0021 0.0 655.0 FORMAT "%5.2" /end CHARACTERISTIC
/begin CHARACTERISTIC K_LSHNK_RF_HYS "Hysterese f. RF-Schwelle" VALUE 0x747F0 TKW_VV_VV_SW 100.0 FORMULA_0007 0.0 2.0 FORMAT "%6.3" /end CHARACTERISTIC
/begin CHARACTERISTIC K_LSHNK_TAUP "Taupunkttemperatur" VALUE 0x747F4 TKW_VV_VV_SW 100.0 FORMULA_0023 0.0 250.0 FORMAT "%4.1" /end CHARACTERISTIC
/begin CHARACTERISTIC K_LSHNK_TKAT_MAX "max. KAT-Temperatur" VALUE 0x747F2 TKW_VV_VV_SW 100.0 FORMULA_0023 -50.0 1250.0 FORMAT "%4.1" /end CHARACTERISTIC
/begin CHARACTERISTIC K_LSHNK_UB_MAX "max. UB-Spannung" VALUE 0x747EE TKW_VV_VV_SW 100.0 FORMULA_0008 0.0 28.0 FORMAT "%4.1" /end CHARACTERISTIC
/begin CHARACTERISTIC K_LSHVK_AD_TEST "Umschaltung d. Sonden-Ri-Adaption" VALUE 0x748FA TKW_VV_VV_UW 100.0 FORMULA_0782 0.0 1.0 FORMAT "%5.2" /end CHARACTERISTIC
/begin CHARACTERISTIC K_LSHVK_CFG "LSH-Freigabe" VALUE 0x748BA TKW_VV_VV_UW 100.0 FORMULA_0946 0.0 65535.0 FORMAT "%5.2" /end CHARACTERISTIC
/begin CHARACTERISTIC K_LSHVK_DIAG_ANZ_MESS "Anzahl gueltiger Messungen" VALUE 0x748EC TKW_VV_VV_UW 100.0 FORMULA_0010 0.0 65535.0 /end CHARACTERISTIC
/begin CHARACTERISTIC K_LSHVK_DIAG_CFG "Freigabe d. elektrischen Diag. LSH-VKAT" VALUE 0x748DC TKW_VV_VV_UB 100.0 FORMULA_0831 0.0 1.0 /end CHARACTERISTIC
/begin CHARACTERISTIC K_LSHVK_DIAG_R_ADAPT "INIT-Wert der R-Adption" VALUE 0x748EA TKW_VV_VV_UW 100.0 FORMULA_0541 0.0 6553.5 FORMAT "%4.1" /end CHARACTERISTIC
/begin CHARACTERISTIC K_LSHVK_DIAG_R_OFFSET "LSHVK-Heizleistungs-Diagnoseoffset" VALUE 0x748E8 TKW_VV_VV_UW 100.0 FORMULA_0541 0.0 6553.5 FORMAT "%4.1" /end CHARACTERISTIC
/begin CHARACTERISTIC K_LSHVK_DIAG_R_TAU "Zeitkonstante zur Mittelung VKAT" VALUE 0x748E2 TKW_VV_VV_UB 100.0 FORMULA_0679 0.1004000008106232 25.60000038146973 /end CHARACTERISTIC
/begin CHARACTERISTIC K_LSHVK_DIAG_RO "obere VKAT-Widerstandsschwelle" VALUE 0x748E4 TKW_VV_VV_UW 100.0 FORMULA_0541 0.0 6553.5 FORMAT "%4.1" /end CHARACTERISTIC
/begin CHARACTERISTIC K_LSHVK_DIAG_RU "untere VKAT-Widerstandsschwelle" VALUE 0x748E6 TKW_VV_VV_UW 100.0 FORMULA_0541 0.0 6553.5 FORMAT "%4.1" /end CHARACTERISTIC
/begin CHARACTERISTIC K_LSHVK_DIAG_TEMP_IST_MAX "max. Sondentemperatur fuer LSHVK-Diag." VALUE 0x748E0 TKW_VV_VV_SW 100.0 FORMULA_0791 -50.0 1250.0 /end CHARACTERISTIC
/begin CHARACTERISTIC K_LSHVK_DIAG_TEMP_IST_MIN "min. Sondentemperatur fuer LSHVK-Diag." VALUE 0x748DE TKW_VV_VV_SW 100.0 FORMULA_0791 -50.0 1250.0 /end CHARACTERISTIC
/begin CHARACTERISTIC K_LSHVK_R_AD_GAIN_CNT "Zaehler fuer GAIN-Sonden-Ri-Adaption" VALUE 0x74908 TKW_VV_VV_UW 100.0 FORMULA_0010 0.0 65535.0 /end CHARACTERISTIC
/begin CHARACTERISTIC K_LSHVK_R_AD_GAIN_CNT_MIN "MIN-Zaehler fuer GAIN-Sonden-Ri-Adaption" VALUE 0x74906 TKW_VV_VV_UW 100.0 FORMULA_0010 0.0 65535.0 /end CHARACTERISTIC
/begin CHARACTERISTIC K_LSHVK_R_AD_GAIN_GRAD "max. GAIN-Gradient" VALUE 0x7491C TKW_VV_VV_UW 100.0 FORMULA_0073 0.0 4.0 FORMAT "%6.3" /end CHARACTERISTIC
/begin CHARACTERISTIC K_LSHVK_R_AD_GAIN_MAX "MAX-Schwelle f. GAIN-Sonden-Ri-Adapt." VALUE 0x74918 TKW_VV_VV_UW 100.0 FORMULA_0536 0.0 5000.0 /end CHARACTERISTIC
/begin CHARACTERISTIC K_LSHVK_R_AD_GAIN_MIN "MIN-Schwelle f. GAIN-Sonden-Ri-Adapt." VALUE 0x74916 TKW_VV_VV_UW 100.0 FORMULA_0536 0.0 5000.0 /end CHARACTERISTIC
/begin CHARACTERISTIC K_LSHVK_R_AD_GAIN_NV_MAX "max. Grenze fuer GAIN-Sonden-Ri-Adapt." VALUE 0x74930 TKW_VV_VV_UW 100.0 FORMULA_0073 0.0 4.0 FORMAT "%6.3" /end CHARACTERISTIC
/begin CHARACTERISTIC K_LSHVK_R_AD_GAIN_NV_MIN "min. Grenze fuer GAIN-Sonden-Ri-Adapt." VALUE 0x74932 TKW_VV_VV_UW 100.0 FORMULA_0073 0.0 4.0 FORMAT "%6.3" /end CHARACTERISTIC
/begin CHARACTERISTIC K_LSHVK_R_AD_GAIN_T "MIN-Zeit zwischen zwei GAIN-Adapt." VALUE 0x7490C TKW_VV_VV_UW 100.0 FORMULA_0021 0.0 655.0 FORMAT "%5.2" /end CHARACTERISTIC
/begin CHARACTERISTIC K_LSHVK_R_AD_GAIN_T1 "Filterkoeffizient - GAIN-Sonden-Ri-Adapt." VALUE 0x74910 TKW_VV_VV_UW 100.0 FORMULA_0949 0.0 6553500.0 /end CHARACTERISTIC
/begin CHARACTERISTIC K_LSHVK_R_AD_OFFS_CNT "Zaehler fuer OFFSET-Sonden-Ri-Adaption" VALUE 0x74904 TKW_VV_VV_UW 100.0 FORMULA_0010 0.0 65535.0 /end CHARACTERISTIC
/begin CHARACTERISTIC K_LSHVK_R_AD_OFFS_CNT_MIN "MIN-Zaehler fuer OFFSET-Sonden-Ri-Adaption" VALUE 0x74902 TKW_VV_VV_UW 100.0 FORMULA_0010 0.0 65535.0 /end CHARACTERISTIC
/begin CHARACTERISTIC K_LSHVK_R_AD_OFFS_GRAD "max. OFFEST-Gradient" VALUE 0x7491A TKW_VV_VV_UW 100.0 FORMULA_0536 0.0 5000.0 /end CHARACTERISTIC
/begin CHARACTERISTIC K_LSHVK_R_AD_OFFS_MAX "MAX-Schwelle f. Offset-Sonden-Ri-Adapt." VALUE 0x74914 TKW_VV_VV_SW 100.0 FORMULA_0536 -2500.0 2500.0 /end CHARACTERISTIC
/begin CHARACTERISTIC K_LSHVK_R_AD_OFFS_MIN "MIN-Schwelle f. Offset-Sonden-Ri-Adapt." VALUE 0x74912 TKW_VV_VV_SW 100.0 FORMULA_0536 -2500.0 2500.0 /end CHARACTERISTIC
/begin CHARACTERISTIC K_LSHVK_R_AD_OFFS_NV_MAX "max. Grenze fuer OFFEST-Sonden-Ri-Adapt." VALUE 0x7492C TKW_VV_VV_SW 100.0 FORMULA_0536 -5000.0 5000.0 /end CHARACTERISTIC
/begin CHARACTERISTIC K_LSHVK_R_AD_OFFS_NV_MIN "min. Grenze fuer OFFEST-Sonden-Ri-Adapt." VALUE 0x7492E TKW_VV_VV_SW 100.0 FORMULA_0536 -5000.0 5000.0 /end CHARACTERISTIC
/begin CHARACTERISTIC K_LSHVK_R_AD_OFFS_T "MIN-Zeit zwischen zwei OFFSET-Adapt." VALUE 0x7490A TKW_VV_VV_UW 100.0 FORMULA_0021 0.0 655.0 FORMAT "%5.2" /end CHARACTERISTIC
/begin CHARACTERISTIC K_LSHVK_R_AD_OFFS_T1 "Filterkoeffizient - OFFSET-Sonden-Ri-Adapt." VALUE 0x7490E TKW_VV_VV_UW 100.0 FORMULA_0949 0.0 6553500.0 /end CHARACTERISTIC
/begin CHARACTERISTIC K_LSHVK_R_AD_RESET "RESET d. Sonden-Ri-Adaption" VALUE 0x748FC TKW_VV_VV_UW 100.0 FORMULA_0784 0.0 1.0 FORMAT "%5.2" /end CHARACTERISTIC
/begin CHARACTERISTIC K_LSHVK_R_REF "Referenzspannung Ri" VALUE 0x748FE TKW_VV_VV_UW 100.0 FORMULA_0536 0.0 5000.0 /end CHARACTERISTIC
/begin CHARACTERISTIC K_LSHVK_R_REF_OFFS "Referenzspannung Ri fuer OFFSET-Adaption" VALUE 0x74900 TKW_VV_VV_UW 100.0 FORMULA_0536 0.0 5000.0 /end CHARACTERISTIC
/begin CHARACTERISTIC K_LSHVK_REG_K "Verstaerkungsfaktor PI-Regler" VALUE 0x748C2 TKW_VV_VV_UW 100.0 FORMULA_0947 0.0 1.0 FORMAT "%5.2" /end CHARACTERISTIC
/begin CHARACTERISTIC K_LSHVK_REG_TN "Nachstellzeit PI-Regler" VALUE 0x748C4 TKW_VV_VV_UW 100.0 FORMULA_0593 1.0 65535.0 /end CHARACTERISTIC
/begin CHARACTERISTIC K_LSHVK_RI_RANGE_SCHW "Umschalttemperatur ATIC42 zwischen Range1/2 Ri-Messung" VALUE 0x748D8 TKW_VV_VV_SW 100.0 FORMULA_0791 -50.0 1250.0 /end CHARACTERISTIC
/begin CHARACTERISTIC K_LSHVK_T_KL15_MAX "max. Heizdauer bei KL15 an" VALUE 0x748BC TKW_VV_VV_UW 100.0 FORMULA_0021 0.0 655.0 FORMAT "%5.2" /end CHARACTERISTIC
/begin CHARACTERISTIC K_LSHVK_TABG_HYS "Hysterese Abgastemperatur" VALUE 0x748BE TKW_VV_VV_SW 100.0 FORMULA_0801 -1000.0 1250.0 FORMAT "%4.1" /end CHARACTERISTIC
/begin CHARACTERISTIC K_LSHVK_TEMP_DIF_ZUL "zulaessige Temp-Differenz" VALUE 0x748D4 TKW_VV_VV_SW 100.0 FORMULA_0791 -50.0 1250.0 /end CHARACTERISTIC
/begin CHARACTERISTIC K_LSHVK_TEMP_FILT_TAU "" VALUE 0x748C0 TKW_VV_VV_UW 100.0 FORMULA_0754 0.0 255.9960021972656 FORMAT "%5.2" /end CHARACTERISTIC
/begin CHARACTERISTIC K_LSHVK_TEMP_IST_ENABLE_IP_LOOP "Einschalttemperatur ATIC42 IP Control loop" VALUE 0x748DA TKW_VV_VV_SW 100.0 FORMULA_0791 -50.0 1250.0 /end CHARACTERISTIC
/begin CHARACTERISTIC K_LSHVK_TEMP_IST_SCHW "Umschalttemperatur f. Filterkonstante" VALUE 0x748D6 TKW_VV_VV_SW 100.0 FORMULA_0791 -50.0 1250.0 /end CHARACTERISTIC
/begin CHARACTERISTIC K_LSHVK_TEMP_MAX "max. Sondentemperatur" VALUE 0x748CE TKW_VV_VV_SW 100.0 FORMULA_0791 -50.0 1250.0 /end CHARACTERISTIC
/begin CHARACTERISTIC K_LSHVK_TEMP_MIN "min. Sondentemperatur" VALUE 0x748D0 TKW_VV_VV_SW 100.0 FORMULA_0791 -50.0 1250.0 /end CHARACTERISTIC
/begin CHARACTERISTIC K_LSHVK_TEMP_REG_MIN "min. Sondentemperatur f. REG-Aktivierung" VALUE 0x748D2 TKW_VV_VV_SW 100.0 FORMULA_0791 -50.0 1250.0 /end CHARACTERISTIC
/begin CHARACTERISTIC K_LSHVK_TV_KORR_MIN "min. Tastverhaeltnis VKAT" VALUE 0x748C6 TKW_VV_VV_UW 100.0 FORMULA_0935 0.0 99.94999694824219 FORMAT "%5.2" /end CHARACTERISTIC
/begin CHARACTERISTIC K_LSHVK_UB_MAX "max. Bordspannung" VALUE 0x748CA TKW_VV_VV_UW 100.0 FORMULA_0008 0.0 25.0 FORMAT "%4.1" /end CHARACTERISTIC
/begin CHARACTERISTIC K_LSHVK_UB_NORM "Normbordspannung" VALUE 0x748C8 TKW_VV_VV_UW 100.0 FORMULA_0008 0.0 25.0 FORMAT "%4.1" /end CHARACTERISTIC
/begin CHARACTERISTIC K_LSHVK_UEFF_GRAD "Effektivspannungsgradient" VALUE 0x748CC TKW_VV_VV_UW 100.0 FORMULA_0948 0.0 25.0 FORMAT "%4.1" /end CHARACTERISTIC
/begin CHARACTERISTIC K_LSHVK_WSS_CFG "Wasserschlag-Konfiguration" VALUE 0x74934 TKW_VV_VV_UW 100.0 FORMULA_0950 0.0 65535.0 FORMAT "%5.2" /end CHARACTERISTIC
/begin CHARACTERISTIC K_LSRVK_OBD_CFG "Freigabe Sondeninnenwiderstandsdiag. LSH-VKAT" VALUE 0x748EE TKW_VV_VV_UB 100.0 FORMULA_0831 0.0 1.0 /end CHARACTERISTIC
/begin CHARACTERISTIC K_LSRVK_OBD_ML_SUM "min. aufsummierte Luftmassenstr. nach SA_WE" VALUE 0x748F0 TKW_VV_VV_UW 100.0 FORMULA_0792 0.0 65535.0 /end CHARACTERISTIC
/begin CHARACTERISTIC K_LSRVK_OBD_REF_CNT "Schwelle LA-Ri-GAIN-Ermittlungen f. Referenzwiderstandsdiagnose" VALUE 0x74922 TKW_VV_VV_UW 100.0 FORMULA_0010 0.0 65535.0 /end CHARACTERISTIC
/begin CHARACTERISTIC K_LSRVK_OBD_REF_GAIN_MAX "max. GAIN-Ri-Schwelle - Referenzwiderstandsdiag." VALUE 0x74920 TKW_VV_VV_UW 100.0 FORMULA_0073 0.0 4.0 FORMAT "%6.3" /end CHARACTERISTIC
/begin CHARACTERISTIC K_LSRVK_OBD_REF_GAIN_MIN "min. GAIN-Ri-Schwelle - Referenzwiderstandsdiag." VALUE 0x7491E TKW_VV_VV_UW 100.0 FORMULA_0073 0.0 4.0 FORMAT "%6.3" /end CHARACTERISTIC
/begin CHARACTERISTIC K_LSRVK_OBD_REF_OFFS_CNT "Schwelle LA-Ri-OFFSET-Ermittlungen f. Referenzwiderstandsdiagnose" VALUE 0x74928 TKW_VV_VV_UW 100.0 FORMULA_0010 0.0 65535.0 /end CHARACTERISTIC
/begin CHARACTERISTIC K_LSRVK_OBD_REF_OFFS_MAX "max. OFFSET-Ri-Schwelle - Referenzwiderstandsdiag." VALUE 0x74924 TKW_VV_VV_SW 100.0 FORMULA_0536 -5000.0 5000.0 /end CHARACTERISTIC
/begin CHARACTERISTIC K_LSRVK_OBD_REF_OFFS_MIN "min. OFFSET-Ri-Schwelle - Referenzwiderstandsdiag." VALUE 0x74926 TKW_VV_VV_SW 100.0 FORMULA_0536 -5000.0 5000.0 /end CHARACTERISTIC
/begin CHARACTERISTIC K_LSRVK_OBD_REG_T "Diag.zeit fuer d. max. Anschlagszeit d. Heizungsreglers" VALUE 0x748F6 TKW_VV_VV_UW 100.0 FORMULA_0593 0.0 65535.0 /end CHARACTERISTIC
/begin CHARACTERISTIC K_LSRVK_OBD_START_R "max. Ri-Schwelle f. Diag. nach Motorstart" VALUE 0x748F8 TKW_VV_VV_UW 100.0 FORMULA_0934 0.0 5000.0 /end CHARACTERISTIC
/begin CHARACTERISTIC K_LSRVK_OBD_TKAT_MAX "max. KAT-Temperatur f. LSRVK-OBD-Diag." VALUE 0x748F4 TKW_VV_VV_SW 100.0 FORMULA_0023 -50.0 1200.0 FORMAT "%4.1" /end CHARACTERISTIC
/begin CHARACTERISTIC K_LSRVK_OBD_TKAT_MIN "min. KAT-Temperatur f. LSRVK-OBD-Diag." VALUE 0x748F2 TKW_VV_VV_SW 100.0 FORMULA_0023 -50.0 1200.0 FORMAT "%4.1" /end CHARACTERISTIC
/begin CHARACTERISTIC K_MDRV_ALBV "Default-Konfiguration ALBV" VALUE 0x74BC8 TKW_VV_VV_UB 100.0 FORMULA_0219 0.0 255.0 /end CHARACTERISTIC
/begin CHARACTERISTIC K_MDRV_CFG "Konfiguration" VALUE 0x74BC0 TKW_VV_VV_UB 100.0 FORMULA_0955 0.0 255.0 /end CHARACTERISTIC
/begin CHARACTERISTIC K_MDRV_CFG_P400 "Konfiguration P400-Only" VALUE 0x74BC1 TKW_VV_VV_UB 100.0 FORMULA_0956 0.0 255.0 /end CHARACTERISTIC
/begin CHARACTERISTIC K_MDRV_DSC "Default-Konfiguration DSC" VALUE 0x74BC3 TKW_VV_VV_UB 100.0 FORMULA_0215 0.0 255.0 /end CHARACTERISTIC
/begin CHARACTERISTIC K_MDRV_EDCK "Default-Konfiguration EDCK" VALUE 0x74BC7 TKW_VV_VV_UB 100.0 FORMULA_0219 0.0 255.0 /end CHARACTERISTIC
/begin CHARACTERISTIC K_MDRV_ENG "Default-Konfiguration Motor" VALUE 0x74BC6 TKW_VV_VV_UB 100.0 FORMULA_0218 0.0 255.0 /end CHARACTERISTIC
/begin CHARACTERISTIC K_MDRV_HUD "Default-Konfiguration HUD" VALUE 0x74BC9 TKW_VV_VV_UB 100.0 FORMULA_0220 0.0 255.0 /end CHARACTERISTIC
/begin CHARACTERISTIC K_MDRV_MOD_SMG "Default-Konfiguration SMG-Mode" VALUE 0x74BC4 TKW_VV_VV_UB 100.0 FORMULA_0216 0.0 255.0 /end CHARACTERISTIC
/begin CHARACTERISTIC K_MDRV_P400_ONLY "P400-Sperre" VALUE 0x74BCA TKW_VV_VV_UW 100.0 FORMULA_0010 0.0 65535.0 /end CHARACTERISTIC
/begin CHARACTERISTIC K_MDRV_P500_START "P500-Hochlauf" VALUE 0x74BCC TKW_VV_VV_UW 100.0 FORMULA_0010 0.0 65535.0 /end CHARACTERISTIC
/begin CHARACTERISTIC K_MDRV_PTH_CNT_MAX "max. Entprellcounter" VALUE 0x74BC2 TKW_VV_VV_UB 100.0 FORMULA_0003 0.0 255.0 /end CHARACTERISTIC
/begin CHARACTERISTIC K_MDRV_STG_SMG "Default-Konfiguration SMG-Sufe" VALUE 0x74BC5 TKW_VV_VV_UB 100.0 FORMULA_0003 0.0 255.0 /end CHARACTERISTIC
/begin CHARACTERISTIC K_MDRV_TBLINK "Blinkzeit" VALUE 0x74BCE TKW_VV_VV_UW 100.0 FORMULA_0021 0.0 655.0 FORMAT "%5.2" /end CHARACTERISTIC
/begin CHARACTERISTIC K_MSG_CFG "CC-Konfiguration" VALUE 0x74BD0 TKW_VV_VV_UB 100.0 FORMULA_0961 0.0 255.0 /end CHARACTERISTIC
/begin CHARACTERISTIC K_MVAC_AL_BLS "dynamischer Durchflusswert MVAC zu Beginn S_BLS" VALUE 0x74C10 TKW_VV_VV_SW 100.0 FORMULA_0967 0.0 2.0 FORMAT "%5.2" /end CHARACTERISTIC
/begin CHARACTERISTIC K_MVAC_AL_LECK "Durchflusswert BKV Leckluft" VALUE 0x74C0C TKW_VV_VV_SW 100.0 FORMULA_0981 0.0 312.5 FORMAT "%4.1" /end CHARACTERISTIC
/begin CHARACTERISTIC K_MVAC_AL_SRMV "Durchflusswert SR/Mvac" VALUE 0x74BFA TKW_VV_VV_SW 100.0 FORMULA_0978 0.0 6.400000095367432 FORMAT "%6.3" /end CHARACTERISTIC
/begin CHARACTERISTIC K_MVAC_AL_UMMV_STAT "Durchflusswert BKV stationaer" VALUE 0x74C0A TKW_VV_VV_SW 100.0 FORMULA_0980 0.0 31.25 FORMAT "%5.2" /end CHARACTERISTIC
/begin CHARACTERISTIC K_MVAC_BRP_GRAD_RAMPE "Zeitfaktor Abregelrampe" VALUE 0x74C1C TKW_VV_VV_SW 100.0 FORMULA_0109 0.0 150.0 FORMAT "%5.2" /end CHARACTERISTIC
/begin CHARACTERISTIC K_MVAC_BRPGRAD_SW "Aufloeseschwelle brp_grad fuer AQ-Eingriff" VALUE 0x74C18 TKW_VV_VV_SW 100.0 FORMULA_0131 -5000.0 5000.0 /end CHARACTERISTIC
/begin CHARACTERISTIC K_MVAC_DEL_BLS "Verzug S_BLS bis can_brp_grad" VALUE 0x74C0E TKW_VV_VV_UW 100.0 FORMULA_0109 0.0 325.0 FORMAT "%5.2" /end CHARACTERISTIC
/begin CHARACTERISTIC K_MVAC_DEL_RSV "Verzug Schliesszeit RSV" VALUE 0x74BF8 TKW_VV_VV_UW 100.0 FORMULA_0109 0.0 325.0 FORMAT "%5.2" /end CHARACTERISTIC
/begin CHARACTERISTIC K_MVAC_ELUP_ST_DEL "Zeitverzoegerung fuer Berechnung von mvac_ml_sr_rsv_psens" VALUE 0x74BF0 TKW_VV_VV_UW 100.0 FORMULA_0109 0.0 325.0 FORMAT "%5.2" /end CHARACTERISTIC
/begin CHARACTERISTIC K_MVAC_HYS_MAX "Filterschwelle Differenzdruck" VALUE 0x74BF6 TKW_VV_VV_SW 100.0 FORMULA_0075 -2000.0 2000.0 FORMAT "%4.1" /end CHARACTERISTIC
/begin CHARACTERISTIC K_MVAC_HYS_MIN "Filterschwelle Differenzdruck" VALUE 0x74BF4 TKW_VV_VV_SW 100.0 FORMULA_0075 -2000.0 2000.0 FORMAT "%4.1" /end CHARACTERISTIC
/begin CHARACTERISTIC K_MVAC_ML_AEB_NEG "Aenderungsbegrenzung negativ fuer mvac_ml_sr" VALUE 0x74C04 TKW_VV_VV_UW 100.0 FORMULA_0979 0.0 200.0 FORMAT "%5.2" /end CHARACTERISTIC
/begin CHARACTERISTIC K_MVAC_ML_AEB_POS "Aenderungsbegrenzung positiv fuer mvac_ml_sr" VALUE 0x74C02 TKW_VV_VV_UW 100.0 FORMULA_0979 0.0 200.0 FORMAT "%5.2" /end CHARACTERISTIC
/begin CHARACTERISTIC K_MVAC_ML_CFG "Software-Schalter mvac_ml_sr" VALUE 0x74BF2 TKW_VV_VV_UB 100.0 FORMULA_0977 0.0 255.0 /end CHARACTERISTIC
/begin CHARACTERISTIC K_MVAC_ML_INTEGRATOR_TAU "Tau fuer mvac_ml-Integrator" VALUE 0x74C12 TKW_VV_VV_UW 100.0 FORMULA_0972 4.999999888241291e-003 40.0 FORMAT "%5.2" /end CHARACTERISTIC
/begin CHARACTERISTIC K_MVAC_ML_MIN "Schwelle Luftmassenstrom" VALUE 0x74BEE TKW_VV_VV_SW 100.0 FORMULA_0103 -100.0 1400.0 FORMAT "%4.1" /end CHARACTERISTIC
/begin CHARACTERISTIC K_MVAC_ML_SR_MAX "Schwelle Luftmassenstrom" VALUE 0x74BFE TKW_VV_VV_SW 100.0 FORMULA_0103 -100.0 1400.0 FORMAT "%4.1" /end CHARACTERISTIC
/begin CHARACTERISTIC K_MVAC_ML_SR_MIN "Schwelle Luftmassenstrom" VALUE 0x74BFC TKW_VV_VV_SW 100.0 FORMULA_0103 -100.0 1400.0 FORMAT "%4.1" /end CHARACTERISTIC
/begin CHARACTERISTIC K_MVAC_ML_TAU "Tau fuer mvac_ml_psens PT1-Glied" VALUE 0x74BEC TKW_VV_VV_UW 100.0 FORMULA_0976 4.999999888241291e-003 327.6700134277344 FORMAT "%6.3" /end CHARACTERISTIC
/begin CHARACTERISTIC K_MVAC_MLRF_SR_SPERRE "Ausgabesperre fuer mvac_rf_sr ueber time_ml" VALUE 0x74C00 TKW_VV_VV_UW 100.0 FORMULA_0021 0.0 655.0 FORMAT "%5.2" /end CHARACTERISTIC
/begin CHARACTERISTIC K_MVAC_N_MIN_B "Mindest-n fuer MVAC-LLS-AQ-B2-Eingriff bei Bremsung" VALUE 0x74C1A TKW_VV_VV_SW 100.0 FORMULA_0006 0.0 10000.0 /end CHARACTERISTIC
/begin CHARACTERISTIC K_MVAC_N_MIN_SA "Mindest-n fuer MVAC-LLS-AQ-B2-Eingriff bei SA" VALUE 0x74C20 TKW_VV_VV_SW 100.0 FORMULA_0006 0.0 10000.0 /end CHARACTERISTIC
/begin CHARACTERISTIC K_MVAC_P_DIAG_MAX "Obere Grenze Unterdruck-MVAC" VALUE 0x74BD8 TKW_VV_VV_SW 100.0 FORMULA_0971 -1100.0 200.0 /end CHARACTERISTIC
/begin CHARACTERISTIC K_MVAC_P_DIAG_MIN "Unter Grenze Unterdruck-MVAC" VALUE 0x74BD6 TKW_VV_VV_SW 100.0 FORMULA_0971 -1100.0 200.0 /end CHARACTERISTIC
/begin CHARACTERISTIC K_MVAC_P_DIAG_PDIFF_DELAY "Zeitverzoegerung fuer Berechnung von mvac_p_diag_pdiff_roh" VALUE 0x74BDE TKW_VV_VV_UW 100.0 FORMULA_0109 0.0 325.0 FORMAT "%5.2" /end CHARACTERISTIC
/begin CHARACTERISTIC K_MVAC_P_DIAG_PDIFF_NEG "minimale Differenz zum Modell" VALUE 0x74BE2 TKW_VV_VV_SW 100.0 FORMULA_0973 -1100.0 2000.0 FORMAT "%6.3" /end CHARACTERISTIC
/begin CHARACTERISTIC K_MVAC_P_DIAG_PDIFF_POS "Maximale Differenz zum Modell" VALUE 0x74BE0 TKW_VV_VV_SW 100.0 FORMULA_0973 -1100.0 2000.0 FORMAT "%6.3" /end CHARACTERISTIC
/begin CHARACTERISTIC K_MVAC_P_DIAG_PDIFF_ROH_TAU "Zeitkonstante fuer mvac_p_diag_pdiff_roh-Filterwert" VALUE 0x74BDA TKW_VV_VV_UW 100.0 FORMULA_0972 4.999999888241291e-003 327.6700134277344 FORMAT "%5.2" /end CHARACTERISTIC
/begin CHARACTERISTIC K_MVAC_P_DIAG_PDIFF_TAU "Zeitkonstante fuer mvac_p_diag_pdiff-Filterwert" VALUE 0x74BDC TKW_VV_VV_UW 100.0 FORMULA_0972 4.999999888241291e-003 327.6700134277344 FORMAT "%5.2" /end CHARACTERISTIC
/begin CHARACTERISTIC K_MVAC_P_DIAG_PDIFF_TMOT "minimale Differenz zum Modell" VALUE 0x74BE4 TKW_VV_VV_SW 100.0 FORMULA_0974 -50.0 2000.0 FORMAT "%6.3" /end CHARACTERISTIC
/begin CHARACTERISTIC K_MVAC_P_DIAG_TIME_ML "Diagnosefreigabe via time_ml" VALUE 0x74BD4 TKW_VV_VV_UW 100.0 FORMULA_0021 0.0 655.0 FORMAT "%5.2" /end CHARACTERISTIC
/begin CHARACTERISTIC K_MVAC_P_SENSOR_OFFSET "Offset des Drucksensors" VALUE 0x74BE8 TKW_VV_VV_SW 100.0 FORMULA_0973 0.0 625.0 FORMAT "%6.3" /end CHARACTERISTIC
/begin CHARACTERISTIC K_MVAC_P_SENSOR_STEIGUNG "Steigung des Drucksensors" VALUE 0x74BE6 TKW_VV_VV_SW 100.0 FORMULA_0975 -409.6000061035156 275.0 FORMAT "%6.3" /end CHARACTERISTIC
/begin CHARACTERISTIC K_MVAC_P_TAU "Filterkonstante fuer den Unterdruck-MVAC" VALUE 0x74BEA TKW_VV_VV_UB 100.0 FORMULA_0645 5.100000184029341e-003 1.279999971389771 /end CHARACTERISTIC
/begin CHARACTERISTIC K_MVAC_PDIFF_FILTER_TAU "Tau fuer mvac_pdiff_filter PT1-Glied" VALUE 0x74C1E TKW_VV_VV_UW 100.0 FORMULA_0976 4.999999888241291e-003 327.6700134277344 FORMAT "%6.3" /end CHARACTERISTIC
/begin CHARACTERISTIC K_MVAC_PDIFF_UM_BEGR_MAX "Max-Begrenzung Differenzdruck Mastervac/Umgebung" VALUE 0x74C08 TKW_VV_VV_SW 100.0 FORMULA_0075 -1100.0 200.0 FORMAT "%4.1" /end CHARACTERISTIC
/begin CHARACTERISTIC K_MVAC_PDIFF_UM_BEGR_MIN "Min-Begrenzung Differenzdruck Mastervac/Umgebung" VALUE 0x74C06 TKW_VV_VV_SW 100.0 FORMULA_0075 -1100.0 200.0 FORMAT "%4.1" /end CHARACTERISTIC
/begin CHARACTERISTIC K_MVAC_PL_P_IO_SW "IO-Schwell Unterdrucksensorwert nach 60 sec." VALUE 0x74C28 TKW_VV_VV_SW 100.0 FORMULA_0075 -1100.0 200.0 FORMAT "%4.1" /end CHARACTERISTIC
/begin CHARACTERISTIC K_MVAC_PL_PDIFF "Unterdruck-Delta zw. Sensor- und Modellwert bei PL-Start" VALUE 0x74C26 TKW_VV_VV_SW 100.0 FORMULA_0075 -1100.0 200.0 FORMAT "%4.1" /end CHARACTERISTIC
/begin CHARACTERISTIC K_MVAC_PL_TIME_LIMIT "Timer-Limit fuer MVAC-Prueflauf" VALUE 0x74C24 TKW_VV_VV_UB 100.0 FORMULA_0214 0.0 255.0 /end CHARACTERISTIC
/begin CHARACTERISTIC K_MVAC_PL_TIME_MS "Motorstandzeit bei MVAC-Prueflauf" VALUE 0x74C25 TKW_VV_VV_UB 100.0 FORMULA_0214 0.0 255.0 /end CHARACTERISTIC
/begin CHARACTERISTIC K_MVAC_RMP_FKT_SA_BEGR "Rampenhoechstwert fuer Zeitfaktor bei SA" VALUE 0x74C22 TKW_VV_VV_SW 100.0 FORMULA_0109 0.0 150.0 FORMAT "%5.2" /end CHARACTERISTIC
/begin CHARACTERISTIC K_MVAC_V "Volumen Mastervac" VALUE 0x74C14 TKW_VV_VV_SL 100.0 FORMULA_0982 0.0 1000000.0 FORMAT "%4.1" /end CHARACTERISTIC
/begin CHARACTERISTIC K_MZYL_CFG "Schalter Fuellungsberechnung" VALUE 0x74D02 TKW_VV_VV_UB 100.0 FORMULA_0987 0.0 255.0 /end CHARACTERISTIC
/begin CHARACTERISTIC K_MZYL_EV_RUECK "Vanos-Spreizung Delta" VALUE 0x74D08 TKW_VV_VV_SW 100.0 FORMULA_0102 -80.0 350.0 FORMAT "%4.1" /end CHARACTERISTIC
/begin CHARACTERISTIC K_MZYL_EV_RUECK_TMAX "Max. Zeit fuer EV Rueck" VALUE 0x74D0A TKW_VV_VV_UW 100.0 FORMULA_0985 0.0 40.0 FORMAT "%5.2" /end CHARACTERISTIC
/begin CHARACTERISTIC K_MZYL_HFM_AQ_MAX_FAK "Max. Wert fuer hfm_aq_fak" VALUE 0x74D0E TKW_VV_VV_SW 100.0 FORMULA_0558 -3.0 3.0 FORMAT "%7.4" /end CHARACTERISTIC
/begin CHARACTERISTIC K_MZYL_HFM_AQ_MIN_FAK "Min. Wert fuer hfm_aq_fak" VALUE 0x74D0C TKW_VV_VV_SW 100.0 FORMULA_0558 -3.0 3.0 FORMAT "%7.4" /end CHARACTERISTIC
/begin CHARACTERISTIC K_MZYL_R "Allgemeine Gaskonstante R" VALUE 0x74D06 TKW_VV_VV_UW 100.0 FORMULA_0990 0.0 6553.5 FORMAT "%4.1" /end CHARACTERISTIC
/begin CHARACTERISTIC K_MZYL_START_CFG "Schalter Fuellungsber. im Start" VALUE 0x74D03 TKW_VV_VV_UB 100.0 FORMULA_0988 0.0 255.0 /end CHARACTERISTIC
/begin CHARACTERISTIC K_MZYL_T_CFG "TAN fuer Fuellungsber. aus PSAU" VALUE 0x74D04 TKW_VV_VV_UB 100.0 FORMULA_0989 0.0 255.0 /end CHARACTERISTIC
/begin CHARACTERISTIC KF_LANK_OBD_S_LAM_SOLL "OFFSET SOLL-Lambda - zusaetzliche WE-Anfettung" MAP 0x743E2 TKF_SW_SW_SW 100.0 FORMULA_0025 -2.0 0.0 FORMAT "%6.3" /begin AXIS_DESCR STD_AXIS n FORMULA_0006 6 0.0 10000.0 MAX_GRAD 0.0 /end AXIS_DESCR
 /begin AXIS_DESCR STD_AXIS rf FORMULA_0007 6 0.0 2.0 MAX_GRAD 0.0 FORMAT "%6.3" /end AXIS_DESCR
/end CHARACTERISTIC
/begin CHARACTERISTIC KF_LANK_US_TAU_L "langsame Filterkonstante NKAT-Signal" MAP 0x743B0 TKF_SW_SW_UW 100.0 FORMULA_0830 0.0 257.0 FORMAT "%5.2" /begin AXIS_DESCR STD_AXIS n FORMULA_0006 4 0.0 10000.0 MAX_GRAD 0.0 /end AXIS_DESCR
 /begin AXIS_DESCR STD_AXIS rf FORMULA_0007 4 0.0 2.0 MAX_GRAD 0.0 FORMAT "%6.3" /end AXIS_DESCR
/end CHARACTERISTIC
/begin CHARACTERISTIC KF_LSHNK_TA_MAX "max. Tastverhältnis" MAP 0x74858 TKF_SW_SW_UW 100.0 FORMULA_0920 0.0 99.98999786376953 FORMAT "%5.2" /begin AXIS_DESCR STD_AXIS n FORMULA_0006 6 0.0 10000.0 MAX_GRAD 0.0 /end AXIS_DESCR
 /begin AXIS_DESCR STD_AXIS rf FORMULA_0007 6 0.0 2.0 MAX_GRAD 0.0 FORMAT "%6.3" /end AXIS_DESCR
/end CHARACTERISTIC
/begin CHARACTERISTIC KF_LSHVK_TEMP_SOLL "SOLL-Temp. bei Motor laeuft" MAP 0x74B1E TKF_SW_SW_SW 100.0 FORMULA_0791 -50.0 1250.0
 /begin AXIS_DESCR STD_AXIS tabg_hys-tmot_start FORMULA_0023 8 -50.0 1250.0 MAX_GRAD 0.0 FORMAT "%4.1" /end AXIS_DESCR
 /begin AXIS_DESCR STD_AXIS time_ml FORMULA_0021 8 0.0 327.0 MAX_GRAD 0.0 FORMAT "%5.2" /end AXIS_DESCR
/end CHARACTERISTIC
/begin CHARACTERISTIC KF_LSHVK_TV_KORR_MAX "max. Tastverhaeltnis VKAT" MAP 0x74ABC TKF_SW_SW_UW 100.0 FORMULA_0935 0.0 99.94999694824219 FORMAT "%5.2"
 /begin AXIS_DESCR STD_AXIS time_ml FORMULA_0021 6 0.0 327.0 MAX_GRAD 0.0 FORMAT "%5.2" /end AXIS_DESCR
 /begin AXIS_DESCR STD_AXIS lsh_ub_filt FORMULA_0008 6 0.0 28.0 MAX_GRAD 0.0 FORMAT "%4.1" /end AXIS_DESCR
/end CHARACTERISTIC
/begin CHARACTERISTIC KF_LSHVK_TV_VORST "Vorsteuertastverhaeltnis LSHVK" MAP 0x74A5A TKF_SW_SW_UW 100.0 FORMULA_0935 0.0 99.94999694824219 FORMAT "%5.2"
 /begin AXIS_DESCR STD_AXIS tabg FORMULA_0023 6 -50.0 1250.0 MAX_GRAD 0.0 FORMAT "%4.1" /end AXIS_DESCR
 /begin AXIS_DESCR STD_AXIS lshvk_temp_soll FORMULA_0791 6 -50.0 1250.0 MAX_GRAD 0.0 /end AXIS_DESCR
/end CHARACTERISTIC
/begin CHARACTERISTIC KF_MVAC_ELUP_ETA "ELUP-Wirkungsgrad auf MVAC-Modellberechnung" MAP 0x74CCC TKF_SW_SW_UB 100.0 FORMULA_0638 0.0 1.99210000038147
 /begin AXIS_DESCR STD_AXIS pumg FORMULA_0075 6 400.0 1200.0 MAX_GRAD 0.0 FORMAT "%4.1" /end AXIS_DESCR
 /begin AXIS_DESCR STD_AXIS tumg FORMULA_0023 5 -50.0 170.0 MAX_GRAD 0.0 FORMAT "%4.1" /end AXIS_DESCR
/end CHARACTERISTIC
/begin CHARACTERISTIC KF_MZYL_ADAPT_GEW "Rampe fuer Verhaeltniss hfm/aq" MAP 0x74E3A TKF_SW_SW_UW 100.0 FORMULA_0073 0.5 2.0 FORMAT "%6.3" /begin AXIS_DESCR STD_AXIS n FORMULA_0006 6 0.0 10000.0 MAX_GRAD 0.0 /end AXIS_DESCR
 /begin AXIS_DESCR STD_AXIS dr_rel FORMULA_0106 6 0.0 199.9938049316406 MAX_GRAD 0.0 FORMAT "%5.2" /end AXIS_DESCR
/end CHARACTERISTIC
/begin CHARACTERISTIC KF_MZYL_ADAPT_RAMPE_DOWN "Rampe fuer Verhaeltniss hfm/aq" MAP 0x74DD8 TKF_SW_SW_SW 100.0 FORMULA_0991 0.0 3.0 FORMAT "%7.4" /begin AXIS_DESCR STD_AXIS n FORMULA_0006 6 0.0 10000.0 MAX_GRAD 0.0 /end AXIS_DESCR
 /begin AXIS_DESCR STD_AXIS dr_rel FORMULA_0106 6 0.0 199.9938049316406 MAX_GRAD 0.0 FORMAT "%5.2" /end AXIS_DESCR
/end CHARACTERISTIC
/begin CHARACTERISTIC KF_MZYL_ADAPT_RAMPE_UP "Rampe fuer Verhaeltniss hfm/aq" MAP 0x74D76 TKF_SW_SW_SW 100.0 FORMULA_0991 0.0 3.0 FORMAT "%7.4" /begin AXIS_DESCR STD_AXIS n FORMULA_0006 6 0.0 10000.0 MAX_GRAD 0.0 /end AXIS_DESCR
 /begin AXIS_DESCR STD_AXIS dr_rel FORMULA_0106 6 0.0 199.9938049316406 MAX_GRAD 0.0 FORMAT "%5.2" /end AXIS_DESCR
/end CHARACTERISTIC
/begin CHARACTERISTIC KL_E_FUNKTION "Approximation der E-Funktion" CURVE 0x74780 TKL_SF_VV_SF 100.0 FORMULA_0044 -3.402823466385289e+038 3.402823466385289e+038 FORMAT "%5.2"
 /begin AXIS_DESCR STD_AXIS NO_INPUT_QUANTITY FORMULA_0044 13 -3.402823466385289e+038 3.402823466385289e+038 MAX_GRAD 0.0 FORMAT "%5.2" /end AXIS_DESCR
/end CHARACTERISTIC
/begin CHARACTERISTIC KL_KAT_OBD_LANK_LAM "Lambda der NKAT-Sonde" CURVE 0x7436E TKL_UW_VV_UW 100.0 FORMULA_0025 0.0 3.999000072479248 FORMAT "%6.3" /begin AXIS_DESCR STD_AXIS lank_us FORMULA_0536 16 0.0 1200.0 MAX_GRAD 0.0 /end AXIS_DESCR /end CHARACTERISTIC
/begin CHARACTERISTIC KL_KSD_OBD_OEL_DEC "DEC-Wert fuer Oel-Verduennung" CURVE 0x744FA TKL_SW_VV_UB 100.0 FORMULA_0003 0.0 255.0
 /begin AXIS_DESCR STD_AXIS toel FORMULA_0023 4 -50.0 170.0 MAX_GRAD 0.0 FORMAT "%4.1" /end AXIS_DESCR
/end CHARACTERISTIC
/begin CHARACTERISTIC KL_KSD_OBD_OEL_INC "INC-Wert fuer Oel-Verduennung" CURVE 0x744EC TKL_SW_VV_UB 100.0 FORMULA_0003 0.0 255.0
 /begin AXIS_DESCR STD_AXIS tmot FORMULA_0023 4 -50.0 170.0 MAX_GRAD 0.0 FORMAT "%4.1" /end AXIS_DESCR
/end CHARACTERISTIC
/begin CHARACTERISTIC KL_LSHNK_RF_AUS "RF-Schwelle - Ausschaltbedingung" CURVE 0x7480E TKL_SW_VV_SW 100.0 FORMULA_0007 0.0 2.0 FORMAT "%6.3" /begin AXIS_DESCR STD_AXIS n FORMULA_0006 5 0.0 10000.0 MAX_GRAD 0.0 /end AXIS_DESCR /end CHARACTERISTIC
/begin CHARACTERISTIC KL_LSHNK_SOND_TEMP "NKAT-Sondentemperatur" CURVE 0x74836 TKL_UW_VV_SW 100.0 FORMULA_0023 -50.0 1250.0 FORMAT "%4.1"
 /begin AXIS_DESCR STD_AXIS lshnk_r_gmw FORMULA_0541 8 0.0 100.0 MAX_GRAD 0.0 FORMAT "%4.1" /end AXIS_DESCR
/end CHARACTERISTIC
/begin CHARACTERISTIC KL_LSHNK_T_EIN "Verzoegerungszeit NKAT" CURVE 0x74800 TKL_SW_VV_UW 100.0 FORMULA_0800 0.0 65535.0
 /begin AXIS_DESCR STD_AXIS tmot FORMULA_0023 3 -50.0 170.0 MAX_GRAD 0.0 FORMAT "%4.1" /end AXIS_DESCR
/end CHARACTERISTIC
/begin CHARACTERISTIC KL_LSHNK_TA "Tastverhaeltnis" CURVE 0x74824 TKL_SW_VV_UW 100.0 FORMULA_0920 0.0 100.0 FORMAT "%5.2"
 /begin AXIS_DESCR STD_AXIS ub FORMULA_0008 4 0.0 28.0 MAX_GRAD 0.0 FORMAT "%4.1" /end AXIS_DESCR
/end CHARACTERISTIC
/begin CHARACTERISTIC KL_LSHVK_DIAG_TIME_ML "Verzoegerungszeit nach Startende" CURVE 0x74A36 TKL_SW_VV_UW 100.0 FORMULA_0021 0.0 655.3499755859375 FORMAT "%5.2"
 /begin AXIS_DESCR STD_AXIS zust_tmot_start FORMULA_0023 4 -50.0 170.0 MAX_GRAD 0.0 FORMAT "%4.1" /end AXIS_DESCR
/end CHARACTERISTIC
/begin CHARACTERISTIC KL_LSHVK_R_MESS_F "Adapt.Faktor Sonde" CURVE 0x749D4 TKL_UW_VV_UW 100.0 FORMULA_0951 0.0 1.999899983406067 /begin AXIS_DESCR STD_AXIS Abgasbank FORMULA_0010 2 1.0 2.0 MAX_GRAD 0.0 /end AXIS_DESCR /end CHARACTERISTIC
/begin CHARACTERISTIC KL_LSHVK_R_MESS_OFFS "Adapt.Offset Sonde" CURVE 0x749DE TKL_UW_VV_SW 100.0 FORMULA_0934 -160000.0 159995.109375 /begin AXIS_DESCR STD_AXIS Abgasbank FORMULA_0010 2 1.0 2.0 MAX_GRAD 0.0 /end AXIS_DESCR /end CHARACTERISTIC
/begin CHARACTERISTIC KL_LSHVK_SOND_TEMP "VKAT-Sondentemperatur ueber Heizerwiderstand" CURVE 0x749E8 TKL_UW_VV_SW 100.0 FORMULA_0023 -50.0 1250.0 FORMAT "%4.1"
 /begin AXIS_DESCR STD_AXIS lshvk_r FORMULA_0541 8 0.0 100.0 MAX_GRAD 0.0 FORMAT "%4.1" /end AXIS_DESCR
/end CHARACTERISTIC
/begin CHARACTERISTIC KL_LSHVK_TEMP_IST_HIGH "IST-Temp. d. Sonde" CURVE 0x74936 TKL_UW_VV_SW 100.0 FORMULA_0791 -50.0 1250.0
 /begin AXIS_DESCR STD_AXIS lshvk_r_mess_korr FORMULA_0934 16 0.0 5000.0 MAX_GRAD 0.0 /end AXIS_DESCR
/end CHARACTERISTIC
/begin CHARACTERISTIC KL_LSHVK_TEMP_IST_LOW "IST-Temp. d. Sonde m. Range 2 ATIC 42" CURVE 0x74978 TKL_UW_VV_SW 100.0 FORMULA_0791 -50.0 1250.0
 /begin AXIS_DESCR STD_AXIS lshvk_r_mess_korr FORMULA_0934 16 0.0 5000.0 MAX_GRAD 0.0 /end AXIS_DESCR
/end CHARACTERISTIC
/begin CHARACTERISTIC KL_LSHVK_TEMP_SOLL_MS "SOLL-Temp. bei Motor steht" CURVE 0x749BA TKL_SW_VV_SW 100.0 FORMULA_0791 -50.0 1250.0
 /begin AXIS_DESCR STD_AXIS tmot FORMULA_0023 6 -50.0 170.0 MAX_GRAD 0.0 FORMAT "%4.1" /end AXIS_DESCR
/end CHARACTERISTIC
/begin CHARACTERISTIC KL_LSHVK_UEFF_MAX "max. eff. Heizerspannung" CURVE 0x74A1C TKL_SW_VV_UW 100.0 FORMULA_0008 0.0 25.0 FORMAT "%4.1"
 /begin AXIS_DESCR STD_AXIS tabg_vkat FORMULA_0023 6 -50.0 1250.0 MAX_GRAD 0.0 FORMAT "%4.1" /end AXIS_DESCR
/end CHARACTERISTIC
/begin CHARACTERISTIC KL_LSRVK_OBD_START_TML "Zeit, bis VKAT-Arbeitstemperatur erreicht" CURVE 0x74A0A TKL_SW_VV_UW 100.0 FORMULA_0021 0.0 655.0 FORMAT "%5.2"
 /begin AXIS_DESCR STD_AXIS zust_tmot_start FORMULA_0023 4 -50.0 170.0 MAX_GRAD 0.0 FORMAT "%4.1" /end AXIS_DESCR
/end CHARACTERISTIC
/begin CHARACTERISTIC KL_LSRVK_OBD_TML "Verzoegerungszeit nach Startende" CURVE 0x74A48 TKL_SW_VV_UW 100.0 FORMULA_0021 0.0 655.0 FORMAT "%5.2"
 /begin AXIS_DESCR STD_AXIS zust_tmot_start FORMULA_0023 4 -50.0 170.0 MAX_GRAD 0.0 FORMAT "%4.1" /end AXIS_DESCR
/end CHARACTERISTIC
/begin CHARACTERISTIC KL_MVAC_BRP_GRAD "Kennlinie Durchflusswert MVAC von can_brp_grad" CURVE 0x74C66 TKL_SW_VV_SW 100.0 FORMULA_0967 0.0 2.0 FORMAT "%5.2"
 /begin AXIS_DESCR STD_AXIS can_brp_grad FORMULA_0131 14 -5000.0 5000.0 MAX_GRAD 0.0 /end AXIS_DESCR
/end CHARACTERISTIC
/begin CHARACTERISTIC KL_MVAC_ELUP "Kennlinie Wichtungsfaktor von mvac_ml_sr_rsv" CURVE 0x74C4C TKL_SW_VV_SW 100.0 FORMULA_0965 -32.0 32.0 FORMAT "%7.4"
 /begin AXIS_DESCR STD_AXIS mvac_pdiff_um FORMULA_0075 6 -1100.0 200.0 MAX_GRAD 0.0 FORMAT "%4.1" /end AXIS_DESCR
/end CHARACTERISTIC
/begin CHARACTERISTIC KL_MVAC_ML_WICHT "Kennlinie Wichtungsfaktor von mvac_ml_sr_rsv" CURVE 0x74C2A TKL_SW_VV_SW 100.0 FORMULA_0754 -128.0 127.0 FORMAT "%5.2"
 /begin AXIS_DESCR STD_AXIS ml_b2 FORMULA_0103 8 -100.0 1400.0 MAX_GRAD 0.0 FORMAT "%4.1" /end AXIS_DESCR
/end CHARACTERISTIC
/begin CHARACTERISTIC KL_MVAC_PDIFF_B "Kennlinie Betrag AQ-Eingriff bei Bremsung" CURVE 0x74CA0 TKL_SW_VV_UW 100.0 FORMULA_0143 0.0 6500.0 FORMAT "%4.1"
 /begin AXIS_DESCR STD_AXIS mvac_pdiff_filter FORMULA_0075 5 -2000.0 2000.0 MAX_GRAD 0.0 FORMAT "%4.1" /end AXIS_DESCR
/end CHARACTERISTIC
/begin CHARACTERISTIC KL_MVAC_PDIFF_SA "Kennlinie Betrag AQ-Eingriff Bank 2 bei SA" CURVE 0x74CB6 TKL_SW_VV_UW 100.0 FORMULA_0143 0.0 6500.0 FORMAT "%4.1"
 /begin AXIS_DESCR STD_AXIS mvac_pdiff_filter FORMULA_0075 5 -2000.0 2000.0 MAX_GRAD 0.0 FORMAT "%4.1" /end AXIS_DESCR
/end CHARACTERISTIC
/begin CHARACTERISTIC KL_MZYL_EV_A_MEAN "Wirksamer EV-Quersch. Rueckstr." CURVE 0x74D10 TKL_SW_VV_UW 100.0 FORMULA_0984 0.0 15.0 FORMAT "%6.3"
 /begin AXIS_DESCR STD_AXIS van_xd FORMULA_0102 12 0.0 160.0 MAX_GRAD 0.0 FORMAT "%4.1" /end AXIS_DESCR
/end CHARACTERISTIC
/begin CHARACTERISTIC KL_MZYL_PZYL_DP "Offset pzyl fuer EV-schliesst" CURVE 0x74D42 TKL_SW_VV_SW 100.0 FORMULA_0075 0.0 2000.0 FORMAT "%4.1" /begin AXIS_DESCR STD_AXIS n FORMULA_0006 8 0.0 10000.0 MAX_GRAD 0.0 /end AXIS_DESCR /end CHARACTERISTIC
/begin CHARACTERISTIC KL_MZYL_PZYL_DP_F "Faktor pzyl fuer EV-schliesst" CURVE 0x74D64 TKL_SW_VV_SW 100.0 FORMULA_0073 -4.0 4.0 FORMAT "%6.3"
 /begin AXIS_DESCR STD_AXIS psau_rel FORMULA_0106 4 0.0 120.0 MAX_GRAD 0.0 FORMAT "%5.2" /end AXIS_DESCR
/end CHARACTERISTIC
/begin MEASUREMENT ksd_obd_diag_t_b1 "KSD-Diagnosezeit" UWORD FORMULA_0854 0 0.0 0.0 6553.5 READ_WRITE ECU_ADDRESS 0x3FC5A2 /end MEASUREMENT
/begin MEASUREMENT ksd_obd_diag_t_b2 "KSD-Diagnosezeit" UWORD FORMULA_0854 0 0.0 0.0 6553.5 READ_WRITE ECU_ADDRESS 0x3FC5A4 /end MEASUREMENT
/begin MEASUREMENT ksd_obd_diag_time_b1 "KSD Diagzeit" UWORD FORMULA_0858 0 0 0.0 255.0 READ_WRITE BIT_MASK 0x8 ECU_ADDRESS 0x3FC586 /end MEASUREMENT
/begin MEASUREMENT ksd_obd_diag_time_b2 "KSD Diagzeit" UWORD FORMULA_0858 0 0 0.0 255.0 READ_WRITE BIT_MASK 0x8 ECU_ADDRESS 0x3FC588 /end MEASUREMENT
/begin MEASUREMENT ksd_obd_f_rel_b1 "Delta-LA-Adaptionsfaktor f. KSD" SWORD FORMULA_0024 0 0.0 -1.0 0.9998999834060669 READ_WRITE ECU_ADDRESS 0x3FC58E /end MEASUREMENT
/begin MEASUREMENT ksd_obd_f_rel_b2 "Delta-LA-Adaptionsfaktor f. KSD" SWORD FORMULA_0024 0 0.0 -1.0 0.9998999834060669 READ_WRITE ECU_ADDRESS 0x3FC590 /end MEASUREMENT
/begin MEASUREMENT ksd_obd_freig_aktiv_b1 "Freigabebedingungen KSD" UWORD FORMULA_0856 0 0 0.0 255.0 READ_WRITE BIT_MASK 0x2 ECU_ADDRESS 0x3FC586 /end MEASUREMENT
/begin MEASUREMENT ksd_obd_freig_aktiv_b2 "Freigabebedingungen KSD" UWORD FORMULA_0856 0 0 0.0 255.0 READ_WRITE BIT_MASK 0x2 ECU_ADDRESS 0x3FC588 /end MEASUREMENT
/begin MEASUREMENT ksd_obd_laa_f_b1 "LA-Adaptionsfaktor f. KSD" UWORD FORMULA_0024 0 0.0 0.0 1.998999953269959 READ_WRITE ECU_ADDRESS 0x3FC58A /end MEASUREMENT
/begin MEASUREMENT ksd_obd_laa_f_b2 "LA-Adaptionsfaktor f. KSD" UWORD FORMULA_0024 0 0.0 0.0 1.998999953269959 READ_WRITE ECU_ADDRESS 0x3FC58C /end MEASUREMENT
/begin MEASUREMENT ksd_obd_laa_offs_b1 "Offset-Lambdaadaption f. KSD" SWORD FORMULA_0535 0 0.0 -512.0 511.0 READ_WRITE ECU_ADDRESS 0x3FC592 /end MEASUREMENT
/begin MEASUREMENT ksd_obd_laa_offs_b2 "Offset-Lambdaadaption f. KSD" SWORD FORMULA_0535 0 0.0 -512.0 511.0 READ_WRITE ECU_ADDRESS 0x3FC594 /end MEASUREMENT
/begin MEASUREMENT ksd_obd_lam_b1 "Gesamtabweichung Lambda KSD" UWORD FORMULA_0024 0 0.0 0.0 1.998999953269959 READ_WRITE ECU_ADDRESS 0x3FC59E /end MEASUREMENT
/begin MEASUREMENT ksd_obd_lam_b2 "Gesamtabweichung Lambda KSD" UWORD FORMULA_0024 0 0.0 0.0 1.998999953269959 READ_WRITE ECU_ADDRESS 0x3FC5A0 /end MEASUREMENT
/begin MEASUREMENT ksd_obd_ll_max_t_b1 "Zeit d. max. Ueberschreitung im LL" UWORD FORMULA_0854 0 0.0 0.0 6553.5 READ_WRITE ECU_ADDRESS 0x3FC5A6 /end MEASUREMENT
/begin MEASUREMENT ksd_obd_ll_max_t_b2 "Zeit d. max. Ueberschreitung im LL" UWORD FORMULA_0854 0 0.0 0.0 6553.5 READ_WRITE ECU_ADDRESS 0x3FC5A8 /end MEASUREMENT
/begin MEASUREMENT ksd_obd_ll_min_t_b1 "Zeit d. min. Ueberschreitung im LL" UWORD FORMULA_0854 0 0.0 0.0 6553.5 READ_WRITE ECU_ADDRESS 0x3FC5AA /end MEASUREMENT
/begin MEASUREMENT ksd_obd_ll_min_t_b2 "Zeit d. min. Ueberschreitung im LL" UWORD FORMULA_0854 0 0.0 0.0 6553.5 READ_WRITE ECU_ADDRESS 0x3FC5AC /end MEASUREMENT
/begin MEASUREMENT ksd_obd_oel_sperr_b1 "Erkennung auf Oelverduennung" UWORD FORMULA_0855 0 0 0.0 255.0 READ_WRITE BIT_MASK 0x1 ECU_ADDRESS 0x3FC586 /end MEASUREMENT
/begin MEASUREMENT ksd_obd_oel_sperr_b2 "Erkennung auf Oelverduennung" UWORD FORMULA_0855 0 0 0.0 255.0 READ_WRITE BIT_MASK 0x1 ECU_ADDRESS 0x3FC588 /end MEASUREMENT
/begin MEASUREMENT ksd_obd_offs_delta_b1 "Dalta-Offset-Lambdaadaption f. KSD" SWORD FORMULA_0535 0 0.0 -512.0 511.0 READ_WRITE ECU_ADDRESS 0x3FC596 /end MEASUREMENT
/begin MEASUREMENT ksd_obd_offs_delta_b2 "Dalta-Offset-Lambdaadaption f. KSD" SWORD FORMULA_0535 0 0.0 -512.0 511.0 READ_WRITE ECU_ADDRESS 0x3FC598 /end MEASUREMENT
/begin MEASUREMENT ksd_obd_offs_rel_b1 "Delta-LA-Adaptionsoffset als Faktor f. KSD" SWORD FORMULA_0024 0 0.0 -1.0 0.9998999834060669 READ_WRITE ECU_ADDRESS 0x3FC59A /end MEASUREMENT
/begin MEASUREMENT ksd_obd_offs_rel_b2 "Delta-LA-Adaptionsoffset als Faktor f. KSD" SWORD FORMULA_0024 0 0.0 -1.0 0.9998999834060669 READ_WRITE ECU_ADDRESS 0x3FC59C /end MEASUREMENT
/begin MEASUREMENT ksd_obd_st_b1 "Status Kraftstoffsystemdiagnose" UWORD FORMULA_0080 0 0.0 0.0 65535.0 READ_WRITE ECU_ADDRESS 0x3FC586 /end MEASUREMENT
/begin MEASUREMENT ksd_obd_st_b2 "Status Kraftstoffsystemdiagnose" UWORD FORMULA_0080 0 0.0 0.0 65535.0 READ_WRITE ECU_ADDRESS 0x3FC588 /end MEASUREMENT
/begin MEASUREMENT ksd_obd_start_b1 "START-Werte - KSD-Diag" UWORD FORMULA_0857 0 0 0.0 255.0 READ_WRITE BIT_MASK 0x4 ECU_ADDRESS 0x3FC586 /end MEASUREMENT
/begin MEASUREMENT ksd_obd_start_b2 "START-Werte - KSD-Diag" UWORD FORMULA_0857 0 0 0.0 255.0 READ_WRITE BIT_MASK 0x4 ECU_ADDRESS 0x3FC588 /end MEASUREMENT
/begin MEASUREMENT ksd_obd_stop_b1 "KSD - SCND STOP" UWORD FORMULA_0859 0 0 0.0 255.0 READ_WRITE BIT_MASK 0x10 ECU_ADDRESS 0x3FC586 /end MEASUREMENT
/begin MEASUREMENT ksd_obd_stop_b2 "KSD - SCND STOP" UWORD FORMULA_0859 0 0 0.0 255.0 READ_WRITE BIT_MASK 0x10 ECU_ADDRESS 0x3FC588 /end MEASUREMENT
/begin MEASUREMENT ksd_obd_tl_max_t_b1 "Zeit d. max. Ueberschreitung im TL" UWORD FORMULA_0854 0 0.0 0.0 6553.5 READ_WRITE ECU_ADDRESS 0x3FC5AE /end MEASUREMENT
/begin MEASUREMENT ksd_obd_tl_max_t_b2 "Zeit d. max. Ueberschreitung im TL" UWORD FORMULA_0854 0 0.0 0.0 6553.5 READ_WRITE ECU_ADDRESS 0x3FC5B0 /end MEASUREMENT
/begin MEASUREMENT ksd_obd_tl_min_t_b1 "Zeit d. min. Ueberschreitung im TL" UWORD FORMULA_0854 0 0.0 0.0 6553.5 READ_WRITE ECU_ADDRESS 0x3FC5B2 /end MEASUREMENT
/begin MEASUREMENT ksd_obd_tl_min_t_b2 "Zeit d. min. Ueberschreitung im TL" UWORD FORMULA_0854 0 0.0 0.0 6553.5 READ_WRITE ECU_ADDRESS 0x3FC5B4 /end MEASUREMENT
/begin MEASUREMENT lank_ad_b1 "AD-Wert des NKAT-Signals" UWORD FORMULA_0536 0 0.0 0.0 1200.0 READ_WRITE ECU_ADDRESS 0x3FC502 /end MEASUREMENT
/begin MEASUREMENT lank_ad_b2 "AD-Wert des NKAT-Signals" UWORD FORMULA_0536 0 0.0 0.0 1200.0 READ_WRITE ECU_ADDRESS 0x3FC504 /end MEASUREMENT
/begin MEASUREMENT lank_diag_ol_b1 "OPENLOAD erkannt" UWORD FORMULA_0819 0 0 0.0 255.0 READ_WRITE BIT_MASK 0x4 ECU_ADDRESS 0x3FC51C /end MEASUREMENT
/begin MEASUREMENT lank_diag_ol_b2 "OPENLOAD erkannt" UWORD FORMULA_0819 0 0 0.0 255.0 READ_WRITE BIT_MASK 0x4 ECU_ADDRESS 0x3FC51E /end MEASUREMENT
/begin MEASUREMENT lank_diag_sh_to_gnd_b1 "SH_TO_GND erkannt" UWORD FORMULA_0818 0 0 0.0 255.0 READ_WRITE BIT_MASK 0x2 ECU_ADDRESS 0x3FC51C /end MEASUREMENT
/begin MEASUREMENT lank_diag_sh_to_gnd_b2 "SH_TO_GND erkannt" UWORD FORMULA_0818 0 0 0.0 255.0 READ_WRITE BIT_MASK 0x2 ECU_ADDRESS 0x3FC51E /end MEASUREMENT
/begin MEASUREMENT lank_diag_sh_to_ub_b1 "SH_TO_UB erkannt" UWORD FORMULA_0817 0 0 0.0 255.0 READ_WRITE BIT_MASK 0x1 ECU_ADDRESS 0x3FC51C /end MEASUREMENT
/begin MEASUREMENT lank_diag_sh_to_ub_b2 "SH_TO_UB erkannt" UWORD FORMULA_0817 0 0 0.0 255.0 READ_WRITE BIT_MASK 0x1 ECU_ADDRESS 0x3FC51E /end MEASUREMENT
/begin MEASUREMENT lank_diag_st_b1 "NKAT-Diag.-Status" UWORD FORMULA_0080 0 0.0 0.0 65535.0 READ_WRITE ECU_ADDRESS 0x3FC51C /end MEASUREMENT
/begin MEASUREMENT lank_diag_st_b2 "NKAT-Diag.-Status" UWORD FORMULA_0080 0 0.0 0.0 65535.0 READ_WRITE ECU_ADDRESS 0x3FC51E /end MEASUREMENT
/begin MEASUREMENT lank_diag_stab_b1 "Sondensignal stabil" UWORD FORMULA_0821 0 0 0.0 255.0 READ_WRITE BIT_MASK 0x10 ECU_ADDRESS 0x3FC51C /end MEASUREMENT
/begin MEASUREMENT lank_diag_stab_b2 "Sondensignal stabil" UWORD FORMULA_0821 0 0 0.0 255.0 READ_WRITE BIT_MASK 0x10 ECU_ADDRESS 0x3FC51E /end MEASUREMENT
/begin MEASUREMENT lank_diag_temp_b1 "min. Sondentemperatur erreicht" UWORD FORMULA_0820 0 0 0.0 255.0 READ_WRITE BIT_MASK 0x8 ECU_ADDRESS 0x3FC51C /end MEASUREMENT
/begin MEASUREMENT lank_diag_temp_b2 "min. Sondentemperatur erreicht" UWORD FORMULA_0820 0 0 0.0 255.0 READ_WRITE BIT_MASK 0x8 ECU_ADDRESS 0x3FC51E /end MEASUREMENT
/begin MEASUREMENT lank_lam_b1 "NKAT-Lambdawert" UWORD FORMULA_0025 0 0.0 0.0 3.999000072479248 READ_WRITE ECU_ADDRESS 0x3FC510 /end MEASUREMENT
/begin MEASUREMENT lank_lam_b2 "NKAT-Lambdawert" UWORD FORMULA_0025 0 0.0 0.0 3.999000072479248 READ_WRITE ECU_ADDRESS 0x3FC512 /end MEASUREMENT
/begin MEASUREMENT lank_obd_s_bed_b1 "S-Diag.-Ende" UWORD FORMULA_0823 0 0 0.0 255.0 READ_WRITE BIT_MASK 0x2 ECU_ADDRESS 0x3FC520 /end MEASUREMENT
/begin MEASUREMENT lank_obd_s_bed_b2 "S-Diag.-Ende" UWORD FORMULA_0823 0 0 0.0 255.0 READ_WRITE BIT_MASK 0x2 ECU_ADDRESS 0x3FC522 /end MEASUREMENT
/begin MEASUREMENT lank_obd_s_cnt_ausw_b1 "Zaehlerschwelle f. fehlerhafte Diagnose" UBYTE FORMULA_0003 0 0.0 0.0 255.0 READ_WRITE ECU_ADDRESS 0x3FC526 /end MEASUREMENT
/begin MEASUREMENT lank_obd_s_cnt_ausw_b2 "Zaehlerschwelle f. fehlerhafte Diagnose" UBYTE FORMULA_0003 0 0.0 0.0 255.0 READ_WRITE ECU_ADDRESS 0x3FC527 /end MEASUREMENT
/begin MEASUREMENT lank_obd_s_cnt_b1 "Zaehler fehlerhafte Diagnose" UBYTE FORMULA_0003 0 0.0 0.0 255.0 READ_WRITE ECU_ADDRESS 0x3FC524 /end MEASUREMENT
/begin MEASUREMENT lank_obd_s_cnt_b2 "Zaehler fehlerhafte Diagnose" UBYTE FORMULA_0003 0 0.0 0.0 255.0 READ_WRITE ECU_ADDRESS 0x3FC525 /end MEASUREMENT
/begin MEASUREMENT lank_obd_s_diag_b1 "S-Diag. Zustand" UWORD FORMULA_0822 0 0 0.0 255.0 READ_WRITE BIT_MASK 0x1 ECU_ADDRESS 0x3FC520 /end MEASUREMENT
/begin MEASUREMENT lank_obd_s_diag_b2 "S-Diag. Zustand" UWORD FORMULA_0822 0 0 0.0 255.0 READ_WRITE BIT_MASK 0x1 ECU_ADDRESS 0x3FC522 /end MEASUREMENT
/begin MEASUREMENT lank_obd_s_lam_soll_b1 "LAM-SOLL-OFFSET - zusaetzliche Anfettung" SWORD FORMULA_0025 0 0.0 -2.0 1.998999953269959 READ_WRITE ECU_ADDRESS 0x3FC528 /end MEASUREMENT
/begin MEASUREMENT lank_obd_s_lam_soll_b2 "LAM-SOLL-OFFSET - zusaetzliche Anfettung" SWORD FORMULA_0025 0 0.0 -2.0 1.998999953269959 READ_WRITE ECU_ADDRESS 0x3FC52A /end MEASUREMENT
/begin MEASUREMENT lank_obd_s_sa_diag_b1 "SA-Diagnose" UWORD FORMULA_0767 0 0 0.0 255.0 READ_WRITE BIT_MASK 0x4 ECU_ADDRESS 0x3FC520 /end MEASUREMENT
/begin MEASUREMENT lank_obd_s_sa_diag_b2 "SA-Diagnose" UWORD FORMULA_0767 0 0 0.0 255.0 READ_WRITE BIT_MASK 0x4 ECU_ADDRESS 0x3FC522 /end MEASUREMENT
/begin MEASUREMENT lank_obd_s_sa_phase_b1 "definierte SA-Phase" UWORD FORMULA_0824 0 0 0.0 255.0 READ_WRITE BIT_MASK 0x8 ECU_ADDRESS 0x3FC520 /end MEASUREMENT
/begin MEASUREMENT lank_obd_s_sa_phase_b2 "definierte SA-Phase" UWORD FORMULA_0824 0 0 0.0 255.0 READ_WRITE BIT_MASK 0x8 ECU_ADDRESS 0x3FC522 /end MEASUREMENT
/begin MEASUREMENT lank_obd_s_sa_we_b1 "Erkennung auf WE" UWORD FORMULA_0829 0 0 0.0 255.0 READ_WRITE BIT_MASK 0x800 ECU_ADDRESS 0x3FC520 /end MEASUREMENT
/begin MEASUREMENT lank_obd_s_sa_we_b2 "Erkennung auf WE" UWORD FORMULA_0829 0 0 0.0 255.0 READ_WRITE BIT_MASK 0x800 ECU_ADDRESS 0x3FC522 /end MEASUREMENT
/begin MEASUREMENT lank_obd_s_st_b1 "NKAT-OBD-S-Diag.-Status" UWORD FORMULA_0080 0 0.0 0.0 65535.0 READ_WRITE ECU_ADDRESS 0x3FC520 /end MEASUREMENT
/begin MEASUREMENT lank_obd_s_st_b2 "NKAT-OBD-S-Diag.-Status" UWORD FORMULA_0080 0 0.0 0.0 65535.0 READ_WRITE ECU_ADDRESS 0x3FC522 /end MEASUREMENT
/begin MEASUREMENT lank_obd_s_usf_b1 "Signallage" UWORD FORMULA_0828 0 0 0.0 255.0 READ_WRITE BIT_MASK 0x100 ECU_ADDRESS 0x3FC520 /end MEASUREMENT
/begin MEASUREMENT lank_obd_s_usf_b2 "Signallage" UWORD FORMULA_0828 0 0 0.0 255.0 READ_WRITE BIT_MASK 0x100 ECU_ADDRESS 0x3FC522 /end MEASUREMENT
/begin MEASUREMENT lank_obd_s_vl_diag_b1 "VL-Diagnose" UWORD FORMULA_0827 0 0 0.0 255.0 READ_WRITE BIT_MASK 0x80 ECU_ADDRESS 0x3FC520 /end MEASUREMENT
/begin MEASUREMENT lank_obd_s_vl_diag_b2 "VL-Diagnose" UWORD FORMULA_0827 0 0 0.0 255.0 READ_WRITE BIT_MASK 0x80 ECU_ADDRESS 0x3FC522 /end MEASUREMENT
/begin MEASUREMENT lank_obd_s_we_cnt_b1 "Zaehler - durchgefuehrte WE-Diagnosen" UBYTE FORMULA_0003 0 0.0 0.0 255.0 READ_WRITE ECU_ADDRESS 0x3FC52C /end MEASUREMENT
/begin MEASUREMENT lank_obd_s_we_cnt_b2 "Zaehler - durchgefuehrte WE-Diagnosen" UBYTE FORMULA_0003 0 0.0 0.0 255.0 READ_WRITE ECU_ADDRESS 0x3FC52D /end MEASUREMENT
/begin MEASUREMENT lank_obd_s_we_diag_b1 "WE-Diagnose" UWORD FORMULA_0769 0 0 0.0 255.0 READ_WRITE BIT_MASK 0x10 ECU_ADDRESS 0x3FC520 /end MEASUREMENT
/begin MEASUREMENT lank_obd_s_we_diag_b2 "WE-Diagnose" UWORD FORMULA_0769 0 0 0.0 255.0 READ_WRITE BIT_MASK 0x10 ECU_ADDRESS 0x3FC522 /end MEASUREMENT
/begin MEASUREMENT lank_obd_s_we_lam_time_b1 "WE-Wartezeit mit Anfettung" UWORD FORMULA_0826 0 0 0.0 255.0 READ_WRITE BIT_MASK 0x40 ECU_ADDRESS 0x3FC520 /end MEASUREMENT
/begin MEASUREMENT lank_obd_s_we_lam_time_b2 "WE-Wartezeit mit Anfettung" UWORD FORMULA_0826 0 0 0.0 255.0 READ_WRITE BIT_MASK 0x40 ECU_ADDRESS 0x3FC522 /end MEASUREMENT
/begin MEASUREMENT lank_obd_s_we_time_b1 "WE-Wartezeit ohne Anfettung" UWORD FORMULA_0825 0 0 0.0 255.0 READ_WRITE BIT_MASK 0x20 ECU_ADDRESS 0x3FC520 /end MEASUREMENT
/begin MEASUREMENT lank_obd_s_we_time_b2 "WE-Wartezeit ohne Anfettung" UWORD FORMULA_0825 0 0 0.0 255.0 READ_WRITE BIT_MASK 0x20 ECU_ADDRESS 0x3FC522 /end MEASUREMENT
/begin MEASUREMENT lank_sgn_b1 "NKAT-Signallage" UBYTE FORMULA_0810 0 0.0 0.0 255.0 READ_WRITE BIT_MASK 0x3 ECU_ADDRESS 0x3FC50E /end MEASUREMENT
/begin MEASUREMENT lank_sgn_b2 "NKAT-Signallage" UBYTE FORMULA_0810 0 0.0 0.0 255.0 READ_WRITE BIT_MASK 0x3 ECU_ADDRESS 0x3FC50F /end MEASUREMENT
/begin MEASUREMENT lank_st_aus_b1 "NKAT-Status AUS-Bedingungen" UWORD FORMULA_0080 0 0.0 0.0 65535.0 READ_WRITE ECU_ADDRESS 0x3FC518 /end MEASUREMENT
/begin MEASUREMENT lank_st_aus_b2 "NKAT-Status AUS-Bedingungen" UWORD FORMULA_0080 0 0.0 0.0 65535.0 READ_WRITE ECU_ADDRESS 0x3FC51A /end MEASUREMENT
/begin MEASUREMENT lank_st_aus_diag_b1 "Diag.Fehler vorhanden" UWORD FORMULA_0816 0 0 0.0 255.0 READ_WRITE BIT_MASK 0x8 ECU_ADDRESS 0x3FC518 /end MEASUREMENT
/begin MEASUREMENT lank_st_aus_diag_b2 "Diag.Fehler vorhanden" UWORD FORMULA_0816 0 0 0.0 255.0 READ_WRITE BIT_MASK 0x8 ECU_ADDRESS 0x3FC51A /end MEASUREMENT
/begin MEASUREMENT lank_st_aus_n_b1 "N-Schwelle verletzt" UWORD FORMULA_0813 0 0 0.0 255.0 READ_WRITE BIT_MASK 0x1 ECU_ADDRESS 0x3FC518 /end MEASUREMENT
/begin MEASUREMENT lank_st_aus_n_b2 "N-Schwelle verletzt" UWORD FORMULA_0813 0 0 0.0 255.0 READ_WRITE BIT_MASK 0x1 ECU_ADDRESS 0x3FC51A /end MEASUREMENT
/begin MEASUREMENT lank_st_aus_rf_b1 "RF-Schwelle verletzt" UWORD FORMULA_0814 0 0 0.0 255.0 READ_WRITE BIT_MASK 0x2 ECU_ADDRESS 0x3FC518 /end MEASUREMENT
/begin MEASUREMENT lank_st_aus_rf_b2 "RF-Schwelle verletzt" UWORD FORMULA_0814 0 0 0.0 255.0 READ_WRITE BIT_MASK 0x2 ECU_ADDRESS 0x3FC51A /end MEASUREMENT
/begin MEASUREMENT lank_st_aus_tkat_b1 "TKAT-Schwelle verletzt" UWORD FORMULA_0815 0 0 0.0 255.0 READ_WRITE BIT_MASK 0x4 ECU_ADDRESS 0x3FC518 /end MEASUREMENT
/begin MEASUREMENT lank_st_aus_tkat_b2 "TKAT-Schwelle verletzt" UWORD FORMULA_0815 0 0 0.0 255.0 READ_WRITE BIT_MASK 0x4 ECU_ADDRESS 0x3FC51A /end MEASUREMENT
/begin MEASUREMENT lank_st_ein_b1 "NKAT-Status EIN-Bedingungen" UWORD FORMULA_0080 0 0.0 0.0 65535.0 READ_WRITE ECU_ADDRESS 0x3FC514 /end MEASUREMENT
/begin MEASUREMENT lank_st_ein_b2 "NKAT-Status EIN-Bedingungen" UWORD FORMULA_0080 0 0.0 0.0 65535.0 READ_WRITE ECU_ADDRESS 0x3FC516 /end MEASUREMENT
/begin MEASUREMENT lank_st_sonde_b1 "Betriebsbereitschaft NKAT-Sonde" UWORD FORMULA_0811 0 0.0 0.0 65535.0 READ_WRITE BIT_MASK 0xF ECU_ADDRESS 0x3FC514 /end MEASUREMENT
/begin MEASUREMENT lank_st_sonde_b2 "Betriebsbereitschaft NKAT-Sonde" UWORD FORMULA_0811 0 0.0 0.0 65535.0 READ_WRITE BIT_MASK 0xF ECU_ADDRESS 0x3FC516 /end MEASUREMENT
/begin MEASUREMENT lank_st_us_tau_t_b1 "Einschwingzeit fuer NKAT-Regler" UWORD FORMULA_0812 0 0 0.0 255.0 READ_WRITE BIT_MASK 0x10 ECU_ADDRESS 0x3FC514 /end MEASUREMENT
/begin MEASUREMENT lank_st_us_tau_t_b2 "Einschwingzeit fuer NKAT-Regler" UWORD FORMULA_0812 0 0 0.0 255.0 READ_WRITE BIT_MASK 0x10 ECU_ADDRESS 0x3FC516 /end MEASUREMENT
/begin MEASUREMENT lank_us_b1 "NKAT-Sondensignal" UWORD FORMULA_0536 0 0.0 0.0 1200.0 READ_WRITE ECU_ADDRESS 0x3FC506 /end MEASUREMENT
/begin MEASUREMENT lank_us_b2 "NKAT-Sondensignal" UWORD FORMULA_0536 0 0.0 0.0 1200.0 READ_WRITE ECU_ADDRESS 0x3FC508 /end MEASUREMENT
/begin MEASUREMENT lank_us_filt_b1 "gefiltertes NKAT-Signal f. NKAT-Regler" UWORD FORMULA_0536 0 0.0 0.0 1200.0 READ_WRITE ECU_ADDRESS 0x3FC50A /end MEASUREMENT
/begin MEASUREMENT lank_us_filt_b2 "gefiltertes NKAT-Signal f. NKAT-Regler" UWORD FORMULA_0536 0 0.0 0.0 1200.0 READ_WRITE ECU_ADDRESS 0x3FC50C /end MEASUREMENT
/begin MEASUREMENT lavk_diag_ia_sa_openload_b1 "IA-OPENLOAD bei SA-Diag." UWORD FORMULA_0832 0 0 0.0 255.0 READ_WRITE BIT_MASK 0x1 ECU_ADDRESS 0x3FC532 /end MEASUREMENT
/begin MEASUREMENT lavk_diag_ia_sa_openload_b2 "IA-OPENLOAD bei SA-Diag." UWORD FORMULA_0832 0 0 0.0 255.0 READ_WRITE BIT_MASK 0x1 ECU_ADDRESS 0x3FC534 /end MEASUREMENT
/begin MEASUREMENT lavk_diag_ip_dynamik_check_b1 "Dynamikdiagnose IP-OL ausserhalb Band." UWORD FORMULA_0837 0 0 0.0 255.0 READ_WRITE BIT_MASK 0x100 ECU_ADDRESS 0x3FC532 /end MEASUREMENT
/begin MEASUREMENT lavk_diag_ip_dynamik_check_b2 "Dynamikdiagnose IP-OL ausserhalb Band." UWORD FORMULA_0837 0 0 0.0 255.0 READ_WRITE BIT_MASK 0x100 ECU_ADDRESS 0x3FC534 /end MEASUREMENT
/begin MEASUREMENT lavk_diag_ip_plau_openload_b1 "IP/VM-OPENLOAD bei Plau-Diag." UWORD FORMULA_0835 0 0 0.0 255.0 READ_WRITE BIT_MASK 0x8 ECU_ADDRESS 0x3FC532 /end MEASUREMENT
/begin MEASUREMENT lavk_diag_ip_plau_openload_b2 "IP/VM-OPENLOAD bei Plau-Diag." UWORD FORMULA_0835 0 0 0.0 255.0 READ_WRITE BIT_MASK 0x8 ECU_ADDRESS 0x3FC534 /end MEASUREMENT
/begin MEASUREMENT lavk_diag_ip_sa_openload_b1 "IP/VM-OPENLOAD bei SA-Diag." UWORD FORMULA_0833 0 0 0.0 255.0 READ_WRITE BIT_MASK 0x2 ECU_ADDRESS 0x3FC532 /end MEASUREMENT
/begin MEASUREMENT lavk_diag_ip_sa_openload_b2 "IP/VM-OPENLOAD bei SA-Diag." UWORD FORMULA_0833 0 0 0.0 255.0 READ_WRITE BIT_MASK 0x2 ECU_ADDRESS 0x3FC534 /end MEASUREMENT
/begin MEASUREMENT lavk_diag_ip_vm_sa_openload_b1 "IP/VM-VERDACHT bei SA-Diag." UWORD FORMULA_0836 0 0 0.0 255.0 READ_WRITE BIT_MASK 0x10 ECU_ADDRESS 0x3FC532 /end MEASUREMENT
/begin MEASUREMENT lavk_diag_ip_vm_sa_openload_b2 "IP/VM-VERDACHT bei SA-Diag." UWORD FORMULA_0836 0 0 0.0 255.0 READ_WRITE BIT_MASK 0x10 ECU_ADDRESS 0x3FC534 /end MEASUREMENT
/begin MEASUREMENT lavk_diag_st_b1 "Status DIAG-LAVK-Plausibilisierung" UWORD FORMULA_0080 0 0.0 0.0 65535.0 READ_WRITE ECU_ADDRESS 0x3FC532 /end MEASUREMENT
/begin MEASUREMENT lavk_diag_st_b2 "Status DIAG-LAVK-Plausibilisierung" UWORD FORMULA_0080 0 0.0 0.0 65535.0 READ_WRITE ECU_ADDRESS 0x3FC534 /end MEASUREMENT
/begin MEASUREMENT lavk_diag_un_plau_openload_b1 "UN-OPENLOAD bei Plau-Diag." UWORD FORMULA_0834 0 0 0.0 255.0 READ_WRITE BIT_MASK 0x4 ECU_ADDRESS 0x3FC532 /end MEASUREMENT
/begin MEASUREMENT lavk_diag_un_plau_openload_b2 "UN-OPENLOAD bei Plau-Diag." UWORD FORMULA_0834 0 0 0.0 255.0 READ_WRITE BIT_MASK 0x4 ECU_ADDRESS 0x3FC534 /end MEASUREMENT
/begin MEASUREMENT lavk_obd_act_aktiv_b1 "Aktivierung aktive Plausi-Diag." UWORD FORMULA_0843 0 0 0.0 255.0 READ_WRITE BIT_MASK 0x2 ECU_ADDRESS 0x3FC56A /end MEASUREMENT
/begin MEASUREMENT lavk_obd_act_aktiv_b2 "Aktivierung aktive Plausi-Diag." UWORD FORMULA_0843 0 0 0.0 255.0 READ_WRITE BIT_MASK 0x2 ECU_ADDRESS 0x3FC56C /end MEASUREMENT
/begin MEASUREMENT lavk_obd_act_anf_b1 "Anforderung aktive Plausi-Diag." UWORD FORMULA_0842 0 0 0.0 255.0 READ_WRITE BIT_MASK 0x1 ECU_ADDRESS 0x3FC56A /end MEASUREMENT
/begin MEASUREMENT lavk_obd_act_anf_b2 "Anforderung aktive Plausi-Diag." UWORD FORMULA_0842 0 0 0.0 255.0 READ_WRITE BIT_MASK 0x1 ECU_ADDRESS 0x3FC56C /end MEASUREMENT
/begin MEASUREMENT lavk_obd_act_ende_b1 "NKAT-FETT-Diagnose abgelaufen" UWORD FORMULA_0853 0 0 0.0 255.0 READ_WRITE BIT_MASK 0x4000 ECU_ADDRESS 0x3FC56A /end MEASUREMENT
/begin MEASUREMENT lavk_obd_act_ende_b2 "NKAT-FETT-Diagnose abgelaufen" UWORD FORMULA_0853 0 0 0.0 255.0 READ_WRITE BIT_MASK 0x4000 ECU_ADDRESS 0x3FC56C /end MEASUREMENT
/begin MEASUREMENT lavk_obd_act_exd_time_b1 "Prueflauf Freigabezeit" UWORD FORMULA_0854 0 0.0 0.0 6553.5 READ_WRITE ECU_ADDRESS 0x3FC582 /end MEASUREMENT
/begin MEASUREMENT lavk_obd_act_exd_time_b2 "Prueflauf Freigabezeit" UWORD FORMULA_0854 0 0.0 0.0 6553.5 READ_WRITE ECU_ADDRESS 0x3FC584 /end MEASUREMENT
/begin MEASUREMENT lavk_obd_act_fett_anf_b1 "FETT-Diag.Anforderung nach Mager-Diag." UWORD FORMULA_0770 0 0 0.0 255.0 READ_WRITE BIT_MASK 0x20 ECU_ADDRESS 0x3FC56A /end MEASUREMENT
/begin MEASUREMENT lavk_obd_act_fett_anf_b2 "FETT-Diag.Anforderung nach Mager-Diag." UWORD FORMULA_0770 0 0 0.0 255.0 READ_WRITE BIT_MASK 0x20 ECU_ADDRESS 0x3FC56C /end MEASUREMENT
/begin MEASUREMENT lavk_obd_act_fett_b1 "FETT-Diagnose - aktive Plausi-Diag." UWORD FORMULA_0769 0 0 0.0 255.0 READ_WRITE BIT_MASK 0x10 ECU_ADDRESS 0x3FC56A /end MEASUREMENT
/begin MEASUREMENT lavk_obd_act_fett_b2 "FETT-Diagnose - aktive Plausi-Diag." UWORD FORMULA_0769 0 0 0.0 255.0 READ_WRITE BIT_MASK 0x10 ECU_ADDRESS 0x3FC56C /end MEASUREMENT
/begin MEASUREMENT lavk_obd_act_mager_anf_b1 "Mager-Diag.Anforderung nach FETT-Diag." UWORD FORMULA_0844 0 0 0.0 255.0 READ_WRITE BIT_MASK 0x8 ECU_ADDRESS 0x3FC56A /end MEASUREMENT
/begin MEASUREMENT lavk_obd_act_mager_anf_b2 "Mager-Diag.Anforderung nach FETT-Diag." UWORD FORMULA_0844 0 0 0.0 255.0 READ_WRITE BIT_MASK 0x8 ECU_ADDRESS 0x3FC56C /end MEASUREMENT
/begin MEASUREMENT lavk_obd_act_mager_b1 "Mager-Diagnose - aktive Plausi-Diag." UWORD FORMULA_0767 0 0 0.0 255.0 READ_WRITE BIT_MASK 0x4 ECU_ADDRESS 0x3FC56A /end MEASUREMENT
/begin MEASUREMENT lavk_obd_act_mager_b2 "Mager-Diagnose - aktive Plausi-Diag." UWORD FORMULA_0767 0 0 0.0 255.0 READ_WRITE BIT_MASK 0x4 ECU_ADDRESS 0x3FC56C /end MEASUREMENT
/begin MEASUREMENT lavk_obd_act_nk_f_cnt_b1 "Zaehler VKAT - Diagnose FETT" UWORD FORMULA_0010 0 0.0 0.0 65535.0 READ_WRITE ECU_ADDRESS 0x3FC57A /end MEASUREMENT
/begin MEASUREMENT lavk_obd_act_nk_f_cnt_b2 "Zaehler VKAT - Diagnose FETT" UWORD FORMULA_0010 0 0.0 0.0 65535.0 READ_WRITE ECU_ADDRESS 0x3FC57C /end MEASUREMENT
/begin MEASUREMENT lavk_obd_act_nk_m_cnt_b1 "Zaehler NKAT - Diagnose MAGER" UWORD FORMULA_0010 0 0.0 0.0 65535.0 READ_WRITE ECU_ADDRESS 0x3FC576 /end MEASUREMENT
/begin MEASUREMENT lavk_obd_act_nk_m_cnt_b2 "Zaehler NKAT - Diagnose MAGER" UWORD FORMULA_0010 0 0.0 0.0 65535.0 READ_WRITE ECU_ADDRESS 0x3FC578 /end MEASUREMENT
/begin MEASUREMENT lavk_obd_act_nkat_f_io_b1 "NKAT-FETT-Diagnose i.O." UWORD FORMULA_0848 0 0 0.0 255.0 READ_WRITE BIT_MASK 0x200 ECU_ADDRESS 0x3FC56A /end MEASUREMENT
/begin MEASUREMENT lavk_obd_act_nkat_f_io_b2 "NKAT-FETT-Diagnose i.O." UWORD FORMULA_0848 0 0 0.0 255.0 READ_WRITE BIT_MASK 0x200 ECU_ADDRESS 0x3FC56C /end MEASUREMENT
/begin MEASUREMENT lavk_obd_act_nkat_f_nio_b1 "NKAT-FETT-Diagnose n.i.O." UWORD FORMULA_0852 0 0 0.0 255.0 READ_WRITE BIT_MASK 0x2000 ECU_ADDRESS 0x3FC56A /end MEASUREMENT
/begin MEASUREMENT lavk_obd_act_nkat_f_nio_b2 "NKAT-FETT-Diagnose n.i.O." UWORD FORMULA_0852 0 0 0.0 255.0 READ_WRITE BIT_MASK 0x2000 ECU_ADDRESS 0x3FC56C /end MEASUREMENT
/begin MEASUREMENT lavk_obd_act_nkat_m_io_b1 "NKAT-Mager-Diagnose i.O." UWORD FORMULA_0846 0 0 0.0 255.0 READ_WRITE BIT_MASK 0x80 ECU_ADDRESS 0x3FC56A /end MEASUREMENT
/begin MEASUREMENT lavk_obd_act_nkat_m_io_b2 "NKAT-Mager-Diagnose i.O." UWORD FORMULA_0846 0 0 0.0 255.0 READ_WRITE BIT_MASK 0x80 ECU_ADDRESS 0x3FC56C /end MEASUREMENT
/begin MEASUREMENT lavk_obd_act_nkat_m_nio_b1 "NKAT-Mager-Diagnose n.i.O." UWORD FORMULA_0850 0 0 0.0 255.0 READ_WRITE BIT_MASK 0x800 ECU_ADDRESS 0x3FC56A /end MEASUREMENT
/begin MEASUREMENT lavk_obd_act_nkat_m_nio_b2 "NKAT-Mager-Diagnose n.i.O." UWORD FORMULA_0850 0 0 0.0 255.0 READ_WRITE BIT_MASK 0x800 ECU_ADDRESS 0x3FC56C /end MEASUREMENT
/begin MEASUREMENT lavk_obd_act_st_b1 "Status aktive Plausi.Diagnose" UWORD FORMULA_0080 0 0.0 0.0 65535.0 READ_WRITE ECU_ADDRESS 0x3FC56A /end MEASUREMENT
/begin MEASUREMENT lavk_obd_act_st_b2 "Status aktive Plausi.Diagnose" UWORD FORMULA_0080 0 0.0 0.0 65535.0 READ_WRITE ECU_ADDRESS 0x3FC56C /end MEASUREMENT
/begin MEASUREMENT lavk_obd_act_verz_t_b1 "Verzoegerungszeit" UWORD FORMULA_0071 0 0.0 0.0 6553.5 READ_WRITE ECU_ADDRESS 0x3FC56E /end MEASUREMENT
/begin MEASUREMENT lavk_obd_act_verz_t_b2 "Verzoegerungszeit" UWORD FORMULA_0071 0 0.0 0.0 6553.5 READ_WRITE ECU_ADDRESS 0x3FC570 /end MEASUREMENT
/begin MEASUREMENT lavk_obd_act_vk_f_cnt_b1 "Zaehler NKAT - Diagnose FETT" UWORD FORMULA_0010 0 0.0 0.0 65535.0 READ_WRITE ECU_ADDRESS 0x3FC57E /end MEASUREMENT
/begin MEASUREMENT lavk_obd_act_vk_f_cnt_b2 "Zaehler NKAT - Diagnose FETT" UWORD FORMULA_0010 0 0.0 0.0 65535.0 READ_WRITE ECU_ADDRESS 0x3FC580 /end MEASUREMENT
/begin MEASUREMENT lavk_obd_act_vk_m_cnt_b1 "Zaehler VKAT - Diagnose MAGER" UWORD FORMULA_0010 0 0.0 0.0 65535.0 READ_WRITE ECU_ADDRESS 0x3FC572 /end MEASUREMENT
/begin MEASUREMENT lavk_obd_act_vk_m_cnt_b2 "Zaehler VKAT - Diagnose MAGER" UWORD FORMULA_0010 0 0.0 0.0 65535.0 READ_WRITE ECU_ADDRESS 0x3FC574 /end MEASUREMENT
/begin MEASUREMENT lavk_obd_act_vkat_f_io_b1 "VKAT-FETT-Diagnose i.O." UWORD FORMULA_0847 0 0 0.0 255.0 READ_WRITE BIT_MASK 0x100 ECU_ADDRESS 0x3FC56A /end MEASUREMENT
/begin MEASUREMENT lavk_obd_act_vkat_f_io_b2 "VKAT-FETT-Diagnose i.O." UWORD FORMULA_0847 0 0 0.0 255.0 READ_WRITE BIT_MASK 0x100 ECU_ADDRESS 0x3FC56C /end MEASUREMENT
/begin MEASUREMENT lavk_obd_act_vkat_f_nio_b1 "VKAT-FETT-Diagnose n.i.O." UWORD FORMULA_0851 0 0 0.0 255.0 READ_WRITE BIT_MASK 0x1000 ECU_ADDRESS 0x3FC56A /end MEASUREMENT
/begin MEASUREMENT lavk_obd_act_vkat_f_nio_b2 "VKAT-FETT-Diagnose n.i.O." UWORD FORMULA_0851 0 0 0.0 255.0 READ_WRITE BIT_MASK 0x1000 ECU_ADDRESS 0x3FC56C /end MEASUREMENT
/begin MEASUREMENT lavk_obd_act_vkat_m_io_b1 "VKAT-Mager-Diagnose i.O." UWORD FORMULA_0845 0 0 0.0 255.0 READ_WRITE BIT_MASK 0x40 ECU_ADDRESS 0x3FC56A /end MEASUREMENT
/begin MEASUREMENT lavk_obd_act_vkat_m_io_b2 "VKAT-Mager-Diagnose i.O." UWORD FORMULA_0845 0 0 0.0 255.0 READ_WRITE BIT_MASK 0x40 ECU_ADDRESS 0x3FC56C /end MEASUREMENT
/begin MEASUREMENT lavk_obd_act_vkat_m_nio_b1 "VKAT-Mager-Diagnose n.i.O." UWORD FORMULA_0849 0 0 0.0 255.0 READ_WRITE BIT_MASK 0x400 ECU_ADDRESS 0x3FC56A /end MEASUREMENT
/begin MEASUREMENT lavk_obd_act_vkat_m_nio_b2 "VKAT-Mager-Diagnose n.i.O." UWORD FORMULA_0849 0 0 0.0 255.0 READ_WRITE BIT_MASK 0x400 ECU_ADDRESS 0x3FC56C /end MEASUREMENT
/begin MEASUREMENT lavk_obd_plau_f_cnt_b1 "Fehlerzaehler FETT-Plausi" UWORD FORMULA_0010 0 0.0 0.0 65535.0 READ_WRITE ECU_ADDRESS 0x3FC542 /end MEASUREMENT
/begin MEASUREMENT lavk_obd_plau_f_cnt_b2 "Fehlerzaehler FETT-Plausi" UWORD FORMULA_0010 0 0.0 0.0 65535.0 READ_WRITE ECU_ADDRESS 0x3FC544 /end MEASUREMENT
/begin MEASUREMENT lavk_obd_plau_ip_stabil_t_b1 "min. Zeit auf Erkennung DYNAMIK" UWORD FORMULA_0668 0 0.0 0.0 6553500.0 READ_WRITE ECU_ADDRESS 0x3FC54E /end MEASUREMENT
/begin MEASUREMENT lavk_obd_plau_ip_stabil_t_b2 "min. Zeit auf Erkennung DYNAMIK" UWORD FORMULA_0668 0 0.0 0.0 6553500.0 READ_WRITE ECU_ADDRESS 0x3FC550 /end MEASUREMENT
/begin MEASUREMENT lavk_obd_plau_m_cnt_b1 "Fehlerzaehler MAGER-Plausi" UWORD FORMULA_0010 0 0.0 0.0 65535.0 READ_WRITE ECU_ADDRESS 0x3FC546 /end MEASUREMENT
/begin MEASUREMENT lavk_obd_plau_m_cnt_b2 "Fehlerzaehler MAGER-Plausi" UWORD FORMULA_0010 0 0.0 0.0 65535.0 READ_WRITE ECU_ADDRESS 0x3FC548 /end MEASUREMENT
/begin MEASUREMENT lavk_obd_plau_ol_cnt_b1 "Fehlerzaehler OL-Diag IP/VM" UWORD FORMULA_0010 0 0.0 0.0 65535.0 READ_WRITE ECU_ADDRESS 0x3FC54A /end MEASUREMENT
/begin MEASUREMENT lavk_obd_plau_ol_cnt_b2 "Fehlerzaehler OL-Diag IP/VM" UWORD FORMULA_0010 0 0.0 0.0 65535.0 READ_WRITE ECU_ADDRESS 0x3FC54C /end MEASUREMENT
/begin MEASUREMENT lavk_obd_plau_oszi_off_b1 "Ausschaltzeit des ATIC42-Oszi f. UN-OL-Diag." UWORD FORMULA_0071 0 0.0 0.0 6553.5 READ_WRITE ECU_ADDRESS 0x3FC53A /end MEASUREMENT
/begin MEASUREMENT lavk_obd_plau_oszi_off_b2 "Ausschaltzeit des ATIC42-Oszi f. UN-OL-Diag." UWORD FORMULA_0071 0 0.0 0.0 6553.5 READ_WRITE ECU_ADDRESS 0x3FC53C /end MEASUREMENT
/begin MEASUREMENT lavk_obd_plau_oszi_off_st_b1 "UN-OL - Abschalten des ATIC42-Oszi" UWORD FORMULA_0839 0 0 0.0 255.0 READ_WRITE BIT_MASK 0x10 ECU_ADDRESS 0x3FC536 /end MEASUREMENT
/begin MEASUREMENT lavk_obd_plau_oszi_off_st_b2 "UN-OL - Abschalten des ATIC42-Oszi" UWORD FORMULA_0839 0 0 0.0 255.0 READ_WRITE BIT_MASK 0x10 ECU_ADDRESS 0x3FC538 /end MEASUREMENT
/begin MEASUREMENT lavk_obd_plau_st_b1 "Status OBD-LAVK-Plausibilisierung" UWORD FORMULA_0080 0 0.0 0.0 65535.0 READ_WRITE ECU_ADDRESS 0x3FC536 /end MEASUREMENT
/begin MEASUREMENT lavk_obd_plau_st_b2 "Status OBD-LAVK-Plausibilisierung" UWORD FORMULA_0080 0 0.0 0.0 65535.0 READ_WRITE ECU_ADDRESS 0x3FC538 /end MEASUREMENT
/begin MEASUREMENT lavk_obd_plau_status_b1 "Plausi-Diagnose-Status" UWORD FORMULA_0838 0 0.0 0.0 65535.0 READ_WRITE BIT_MASK 0xF ECU_ADDRESS 0x3FC536 /end MEASUREMENT
/begin MEASUREMENT lavk_obd_plau_status_b2 "Plausi-Diagnose-Status" UWORD FORMULA_0838 0 0.0 0.0 65535.0 READ_WRITE BIT_MASK 0xF ECU_ADDRESS 0x3FC538 /end MEASUREMENT
/begin MEASUREMENT lavk_obd_plau_t_b1 "Verzoegerungszeit Plausi-Diag." UWORD FORMULA_0071 0 0.0 0.0 6553.5 READ_WRITE ECU_ADDRESS 0x3FC53E /end MEASUREMENT
/begin MEASUREMENT lavk_obd_plau_t_b2 "Verzoegerungszeit Plausi-Diag." UWORD FORMULA_0071 0 0.0 0.0 6553.5 READ_WRITE ECU_ADDRESS 0x3FC540 /end MEASUREMENT
/begin MEASUREMENT lavk_obd_plau_un_ol_diag_b1 "UN-OL-Diagnose abgelaufen" UWORD FORMULA_0840 0 0 0.0 255.0 READ_WRITE BIT_MASK 0x20 ECU_ADDRESS 0x3FC536 /end MEASUREMENT
/begin MEASUREMENT lavk_obd_plau_un_ol_diag_b2 "UN-OL-Diagnose abgelaufen" UWORD FORMULA_0840 0 0 0.0 255.0 READ_WRITE BIT_MASK 0x20 ECU_ADDRESS 0x3FC538 /end MEASUREMENT
/begin MEASUREMENT lavk_obd_sa_cnt_b1 "Fehlerzaehler SA-Pruefung" UWORD FORMULA_0010 0 0.0 0.0 65535.0 READ_WRITE ECU_ADDRESS 0x3FC55A /end MEASUREMENT
/begin MEASUREMENT lavk_obd_sa_cnt_b2 "Fehlerzaehler SA-Pruefung" UWORD FORMULA_0010 0 0.0 0.0 65535.0 READ_WRITE ECU_ADDRESS 0x3FC55C /end MEASUREMENT
/begin MEASUREMENT lavk_obd_sa_st_b1 "Status OBD-LAVK-SA-Pruefung" UWORD FORMULA_0841 0 0.0 0.0 65535.0 READ_WRITE BIT_MASK 0x3 ECU_ADDRESS 0x3FC552 /end MEASUREMENT
/begin MEASUREMENT lavk_obd_sa_st_b2 "Status OBD-LAVK-SA-Pruefung" UWORD FORMULA_0841 0 0.0 0.0 65535.0 READ_WRITE BIT_MASK 0x3 ECU_ADDRESS 0x3FC554 /end MEASUREMENT
/begin MEASUREMENT lavk_obd_sa_t_b1 "Verzoegerungszeit SA-Diag." UWORD FORMULA_0071 0 0.0 0.0 6553.5 READ_WRITE ECU_ADDRESS 0x3FC556 /end MEASUREMENT
/begin MEASUREMENT lavk_obd_sa_t_b2 "Verzoegerungszeit SA-Diag." UWORD FORMULA_0071 0 0.0 0.0 6553.5 READ_WRITE ECU_ADDRESS 0x3FC558 /end MEASUREMENT
/begin MEASUREMENT lavk_obd_tl_cnt_b1 "Fehlerzaehler TL/VL-Diagnose" UWORD FORMULA_0010 0 0.0 0.0 65535.0 READ_WRITE ECU_ADDRESS 0x3FC566 /end MEASUREMENT
/begin MEASUREMENT lavk_obd_tl_cnt_b2 "Fehlerzaehler TL/VL-Diagnose" UWORD FORMULA_0010 0 0.0 0.0 65535.0 READ_WRITE ECU_ADDRESS 0x3FC568 /end MEASUREMENT
/begin MEASUREMENT lavk_obd_tl_st_b1 "Status OBD-LAVK-Plausibilisierung" UWORD FORMULA_0841 0 0.0 0.0 65535.0 READ_WRITE BIT_MASK 0x3 ECU_ADDRESS 0x3FC55E /end MEASUREMENT
/begin MEASUREMENT lavk_obd_tl_st_b2 "Status OBD-LAVK-Plausibilisierung" UWORD FORMULA_0841 0 0.0 0.0 65535.0 READ_WRITE BIT_MASK 0x3 ECU_ADDRESS 0x3FC560 /end MEASUREMENT
/begin MEASUREMENT lavk_obd_tl_t_b1 "Verzoegerungszeit TL/VL-Diag." UWORD FORMULA_0071 0 0.0 0.0 6553.5 READ_WRITE ECU_ADDRESS 0x3FC562 /end MEASUREMENT
/begin MEASUREMENT lavk_obd_tl_t_b2 "Verzoegerungszeit TL/VL-Diag." UWORD FORMULA_0071 0 0.0 0.0 6553.5 READ_WRITE ECU_ADDRESS 0x3FC564 /end MEASUREMENT
/begin MEASUREMENT lsh_ub_filt "gefilterter Spannungswert U_KL87 fuer LSH" SWORD FORMULA_0008 0 0.0 0.0 28.0 READ_WRITE ECU_ADDRESS 0x3FC708 /end MEASUREMENT
/begin MEASUREMENT lshnk.ein_b1 "NKAT-LSH-EIN" UWORD FORMULA_0917 0 0 0.0 255.0 READ_WRITE BIT_MASK 0x1 ECU_ADDRESS 0x3FC614 /end MEASUREMENT
/begin MEASUREMENT lshnk.ein_b2 "NKAT-LSH-EIN" UWORD FORMULA_0917 0 0 0.0 255.0 READ_WRITE BIT_MASK 0x1 ECU_ADDRESS 0x3FC61A /end MEASUREMENT
/begin MEASUREMENT lshnk.exd_aktiv_b1 "NKAT-LSH: Tester" UWORD FORMULA_0919 0 0 0.0 255.0 READ_WRITE BIT_MASK 0x4 ECU_ADDRESS 0x3FC614 /end MEASUREMENT
/begin MEASUREMENT lshnk.exd_aktiv_b2 "NKAT-LSH: Tester" UWORD FORMULA_0919 0 0 0.0 255.0 READ_WRITE BIT_MASK 0x4 ECU_ADDRESS 0x3FC61A /end MEASUREMENT
/begin MEASUREMENT lshnk.taup_b1 "NKAT-LSH-TAUP" UWORD FORMULA_0918 0 0 0.0 255.0 READ_WRITE BIT_MASK 0x2 ECU_ADDRESS 0x3FC614 /end MEASUREMENT
/begin MEASUREMENT lshnk.taup_b2 "NKAT-LSH-TAUP" UWORD FORMULA_0918 0 0 0.0 255.0 READ_WRITE BIT_MASK 0x2 ECU_ADDRESS 0x3FC61A /end MEASUREMENT
/begin MEASUREMENT lshnk_b1.st "NKAT-LSH-Status" UWORD FORMULA_0080 0 0.0 0.0 65535.0 READ_WRITE ECU_ADDRESS 0x3FC614 /end MEASUREMENT
/begin MEASUREMENT lshnk_b1.ta "Ansteuertastverhaeltnis NKAT" UWORD FORMULA_0920 0 0.0 0.0 100.0 READ_WRITE ECU_ADDRESS 0x3FC616 /end MEASUREMENT
/begin MEASUREMENT lshnk_b1.temp "Sondentemperatur NKAT" SWORD FORMULA_0023 0 0.0 -50.0 1250.0 READ_WRITE ECU_ADDRESS 0x3FC618 /end MEASUREMENT
/begin MEASUREMENT lshnk_b2.st "NKAT-LSH-Status" UWORD FORMULA_0080 0 0.0 0.0 65535.0 READ_WRITE ECU_ADDRESS 0x3FC61A /end MEASUREMENT
/begin MEASUREMENT lshnk_b2.ta "Ansteuertastverhaeltnis NKAT" UWORD FORMULA_0920 0 0.0 0.0 100.0 READ_WRITE ECU_ADDRESS 0x3FC61C /end MEASUREMENT
/begin MEASUREMENT lshnk_b2.temp "Sondentemperatur NKAT" SWORD FORMULA_0023 0 0.0 -50.0 1250.0 READ_WRITE ECU_ADDRESS 0x3FC61E /end MEASUREMENT
/begin MEASUREMENT lshnk_diag.aktiv_b1 "NKAT-LSH-Diag-AKTIV" UWORD FORMULA_0922 0 0 0.0 255.0 READ_WRITE BIT_MASK 0x1 ECU_ADDRESS 0x3FC624 /end MEASUREMENT
/begin MEASUREMENT lshnk_diag.aktiv_b2 "NKAT-LSH-Diag-AKTIV" UWORD FORMULA_0922 0 0 0.0 255.0 READ_WRITE BIT_MASK 0x1 ECU_ADDRESS 0x3FC632 /end MEASUREMENT
/begin MEASUREMENT lshnk_diag.info_b1 "NKAT-LSH-Diag-INFO" UWORD FORMULA_0923 0 0 0.0 255.0 READ_WRITE BIT_MASK 0x2 ECU_ADDRESS 0x3FC624 /end MEASUREMENT
/begin MEASUREMENT lshnk_diag.info_b2 "NKAT-LSH-Diag-INFO" UWORD FORMULA_0923 0 0 0.0 255.0 READ_WRITE BIT_MASK 0x2 ECU_ADDRESS 0x3FC632 /end MEASUREMENT
/begin MEASUREMENT lshnk_diag.sh_to_x_sperren_b1 "NKAT-LSH-Einschalten aufgrund elektr. Diag. sperren" UWORD FORMULA_0924 0 0 0.0 255.0 READ_WRITE BIT_MASK 0x4 ECU_ADDRESS 0x3FC624 /end MEASUREMENT
/begin MEASUREMENT lshnk_diag.sh_to_x_sperren_b2 "NKAT-LSH-Einschalten aufgrund elektr. Diag. sperren" UWORD FORMULA_0924 0 0 0.0 255.0 READ_WRITE BIT_MASK 0x4 ECU_ADDRESS 0x3FC632 /end MEASUREMENT
/begin MEASUREMENT lshnk_diag_b1.i_ad "Heizerstrom NKAT" UWORD FORMULA_0925 0 0.0 0.0 4.762700080871582 READ_WRITE ECU_ADDRESS 0x3FC626 /end MEASUREMENT
/begin MEASUREMENT lshnk_diag_b1.i_cnt "Summen-Diag.Zaehler NKAT" UWORD FORMULA_0010 0 0.0 0.0 255.0 READ_WRITE ECU_ADDRESS 0x3FC628 /end MEASUREMENT
/begin MEASUREMENT lshnk_diag_b1.i_sum "Summe d. Heizerstroms NKAT" UWORD FORMULA_0925 0 0.0 0.0 304.8139038085938 READ_WRITE ECU_ADDRESS 0x3FC62A /end MEASUREMENT
/begin MEASUREMENT lshnk_diag_b1.i_wert "gemittelter Heizerstrom NKAT" UWORD FORMULA_0925 0 0.0 0.0 4.762700080871582 READ_WRITE ECU_ADDRESS 0x3FC62C /end MEASUREMENT
/begin MEASUREMENT lshnk_diag_b1.r "Heizerwiderstand NKAT" UWORD FORMULA_0541 0 0.0 0.0 100.0 READ_WRITE ECU_ADDRESS 0x3FC62E /end MEASUREMENT
/begin MEASUREMENT lshnk_diag_b1.st "NKAT-LSH-Diag.-Status" UWORD FORMULA_0080 0 0.0 0.0 65535.0 READ_WRITE ECU_ADDRESS 0x3FC624 /end MEASUREMENT
/begin MEASUREMENT lshnk_diag_b2.i_ad "Heizerstrom NKAT" UWORD FORMULA_0925 0 0.0 0.0 4.762700080871582 READ_WRITE ECU_ADDRESS 0x3FC634 /end MEASUREMENT
/begin MEASUREMENT lshnk_diag_b2.i_cnt "Summen-Diag.Zaehler NKAT" UWORD FORMULA_0010 0 0.0 0.0 255.0 READ_WRITE ECU_ADDRESS 0x3FC636 /end MEASUREMENT
/begin MEASUREMENT lshnk_diag_b2.i_sum "Summe d. Heizerstroms NKAT" UWORD FORMULA_0925 0 0.0 0.0 304.8139038085938 READ_WRITE ECU_ADDRESS 0x3FC638 /end MEASUREMENT
/begin MEASUREMENT lshnk_diag_b2.i_wert "gemittelter Heizerstrom NKAT" UWORD FORMULA_0925 0 0.0 0.0 4.762700080871582 READ_WRITE ECU_ADDRESS 0x3FC63A /end MEASUREMENT
/begin MEASUREMENT lshnk_diag_b2.r "Heizerwiderstand NKAT" UWORD FORMULA_0541 0 0.0 0.0 100.0 READ_WRITE ECU_ADDRESS 0x3FC63C /end MEASUREMENT
/begin MEASUREMENT lshnk_diag_b2.st "NKAT-LSH-Diag.-Status" UWORD FORMULA_0080 0 0.0 0.0 65535.0 READ_WRITE ECU_ADDRESS 0x3FC632 /end MEASUREMENT
/begin MEASUREMENT lshnk_exd_timeout_b1 "KWP-Ansteuerzeit" UWORD FORMULA_0921 0 0.0 0.0 655.3499755859375 READ_WRITE ECU_ADDRESS 0x3FC620 /end MEASUREMENT
/begin MEASUREMENT lshnk_exd_timeout_b2 "KWP-Ansteuerzeit" UWORD FORMULA_0921 0 0.0 0.0 655.3499755859375 READ_WRITE ECU_ADDRESS 0x3FC622 /end MEASUREMENT
/begin MEASUREMENT lshnk_rf_aus "Ausschaltschwelle RF fuer LSHN" SWORD FORMULA_0007 0 0.0 0.0 2.0 READ_WRITE ECU_ADDRESS 0x3FC640 /end MEASUREMENT
/begin MEASUREMENT lshnk_t_ein "Verzoegerungszeit nach START" UWORD FORMULA_0593 0 0.0 0.0 65535.0 READ_WRITE ECU_ADDRESS 0x3FC642 /end MEASUREMENT
/begin MEASUREMENT lshvk.begr_max_b1 "VKAT-LSH: MAX-Begrenzung" UWORD FORMULA_0931 0 0 0.0 255.0 READ_WRITE BIT_MASK 0x20 ECU_ADDRESS 0x3FC66E /end MEASUREMENT
/begin MEASUREMENT lshvk.begr_max_b2 "VKAT-LSH: MAX-Begrenzung" UWORD FORMULA_0931 0 0 0.0 255.0 READ_WRITE BIT_MASK 0x20 ECU_ADDRESS 0x3FC696 /end MEASUREMENT
/begin MEASUREMENT lshvk.begr_min_b1 "VKAT-LSH: MIN-Begrenzung" UWORD FORMULA_0932 0 0 0.0 255.0 READ_WRITE BIT_MASK 0x40 ECU_ADDRESS 0x3FC66E /end MEASUREMENT
/begin MEASUREMENT lshvk.begr_min_b2 "VKAT-LSH: MIN-Begrenzung" UWORD FORMULA_0932 0 0 0.0 255.0 READ_WRITE BIT_MASK 0x40 ECU_ADDRESS 0x3FC696 /end MEASUREMENT
/begin MEASUREMENT lshvk.exd_aktiv_b1 "VKAT-LSH: Tester" UWORD FORMULA_0933 0 0 0.0 255.0 READ_WRITE BIT_MASK 0x80 ECU_ADDRESS 0x3FC66E /end MEASUREMENT
/begin MEASUREMENT lshvk.exd_aktiv_b2 "VKAT-LSH: Tester" UWORD FORMULA_0933 0 0 0.0 255.0 READ_WRITE BIT_MASK 0x80 ECU_ADDRESS 0x3FC696 /end MEASUREMENT
/begin MEASUREMENT lshvk.freig_b1 "VKAT-LSH_FREIG" UWORD FORMULA_0926 0 0 0.0 255.0 READ_WRITE BIT_MASK 0x1 ECU_ADDRESS 0x3FC66E /end MEASUREMENT
/begin MEASUREMENT lshvk.freig_b2 "VKAT-LSH_FREIG" UWORD FORMULA_0926 0 0 0.0 255.0 READ_WRITE BIT_MASK 0x1 ECU_ADDRESS 0x3FC696 /end MEASUREMENT
/begin MEASUREMENT lshvk.max_temp_b1 "VKAT-LSH-MAX-TEMP" UWORD FORMULA_0929 0 0 0.0 255.0 READ_WRITE BIT_MASK 0x8 ECU_ADDRESS 0x3FC66E /end MEASUREMENT
/begin MEASUREMENT lshvk.max_temp_b2 "VKAT-LSH-MAX-TEMP" UWORD FORMULA_0929 0 0 0.0 255.0 READ_WRITE BIT_MASK 0x8 ECU_ADDRESS 0x3FC696 /end MEASUREMENT
/begin MEASUREMENT lshvk.min_temp_b1 "VKAT-LSH-MIN-TEMP" UWORD FORMULA_0930 0 0 0.0 255.0 READ_WRITE BIT_MASK 0x10 ECU_ADDRESS 0x3FC66E /end MEASUREMENT
/begin MEASUREMENT lshvk.min_temp_b2 "VKAT-LSH-MIN-TEMP" UWORD FORMULA_0930 0 0 0.0 255.0 READ_WRITE BIT_MASK 0x10 ECU_ADDRESS 0x3FC696 /end MEASUREMENT
/begin MEASUREMENT lshvk.reg_b1 "VKAT-LSH_REG" UWORD FORMULA_0927 0 0 0.0 255.0 READ_WRITE BIT_MASK 0x2 ECU_ADDRESS 0x3FC66E /end MEASUREMENT
/begin MEASUREMENT lshvk.reg_b2 "VKAT-LSH_REG" UWORD FORMULA_0927 0 0 0.0 255.0 READ_WRITE BIT_MASK 0x2 ECU_ADDRESS 0x3FC696 /end MEASUREMENT
/begin MEASUREMENT lshvk.temp_b1 "VKAT-LSH-TEMP" UWORD FORMULA_0928 0 0 0.0 255.0 READ_WRITE BIT_MASK 0x4 ECU_ADDRESS 0x3FC66E /end MEASUREMENT
/begin MEASUREMENT lshvk.temp_b2 "VKAT-LSH-TEMP" UWORD FORMULA_0928 0 0 0.0 255.0 READ_WRITE BIT_MASK 0x4 ECU_ADDRESS 0x3FC696 /end MEASUREMENT
/begin MEASUREMENT lshvk_b1.r_mess "AD-Wert/Sondenwiderstand VKAT" UWORD FORMULA_0934 0 0.0 0.0 5000.0 READ_WRITE ECU_ADDRESS 0x3FC676 /end MEASUREMENT
/begin MEASUREMENT lshvk_b1.r_mess_korr "korregierter gefilteter AD-Wert/Sondenwiderstand VKAT" UWORD FORMULA_0934 0 0.0 0.0 5000.0 READ_WRITE ECU_ADDRESS 0x3FC678 /end MEASUREMENT
/begin MEASUREMENT lshvk_b1.reg_t_max "Heizungsregleranschlagszeit" UWORD FORMULA_0593 0 0.0 0.0 65535.0 READ_WRITE ECU_ADDRESS 0x3FC694 /end MEASUREMENT
/begin MEASUREMENT lshvk_b1.st "VKAT-LSH-Status" UWORD FORMULA_0080 0 0.0 0.0 65535.0 READ_WRITE ECU_ADDRESS 0x3FC66E /end MEASUREMENT
/begin MEASUREMENT lshvk_b1.tabg_hys "Abgastemperatur inc. HYS-Betrachtung" SWORD FORMULA_0023 0 0.0 -50.0 1250.0 READ_WRITE ECU_ADDRESS 0x3FC67A /end MEASUREMENT
/begin MEASUREMENT lshvk_b1.temp_dif "Differenz IST-SOLL-Temp. VKAT" SWORD FORMULA_0791 0 0.0 -32767.0 32767.0 READ_WRITE ECU_ADDRESS 0x3FC67E /end MEASUREMENT
/begin MEASUREMENT lshvk_b1.temp_heiz "IST-Temp. VKAT - Heizleistung" SWORD FORMULA_0023 0 0.0 -50.0 1250.0 READ_WRITE ECU_ADDRESS 0x3FC674 /end MEASUREMENT
/begin MEASUREMENT lshvk_b1.temp_ist "IST-Temp. VKAT" SWORD FORMULA_0791 0 0.0 -50.0 1250.0 READ_WRITE ECU_ADDRESS 0x3FC672 /end MEASUREMENT
/begin MEASUREMENT lshvk_b1.temp_ist_roh "ungefilterte IST-Temp. VKAT" SWORD FORMULA_0791 0 0.0 -50.0 1250.0 READ_WRITE ECU_ADDRESS 0x3FC670 /end MEASUREMENT
/begin MEASUREMENT lshvk_b1.temp_soll "SOLL-Temp. VKAT" SWORD FORMULA_0791 0 0.0 -50.0 1250.0 READ_WRITE ECU_ADDRESS 0x3FC67C /end MEASUREMENT
/begin MEASUREMENT lshvk_b1.tv_add "Additiver Anteil des Tastverhaeltnisses" UWORD FORMULA_0935 0 0.0 0.0 3199.951171875 READ_WRITE ECU_ADDRESS 0x3FC68C /end MEASUREMENT
/begin MEASUREMENT lshvk_b1.tv_begr "TV-Wert aus Aenderungsbegr." UWORD FORMULA_0935 0 0.0 0.0 99.94999694824219 READ_WRITE ECU_ADDRESS 0x3FC686 /end MEASUREMENT
/begin MEASUREMENT lshvk_b1.tv_eff_max "max. eff. Heizerspannung" UWORD FORMULA_0935 0 0.0 0.0 99.94999694824219 READ_WRITE ECU_ADDRESS 0x3FC688 /end MEASUREMENT
/begin MEASUREMENT lshvk_b1.tv_grad "pos. Aenderungsbegrenzung" SWORD FORMULA_0936 0 0.0 -99.94999694824219 99.94999694824219 READ_WRITE ECU_ADDRESS 0x3FC690 /end MEASUREMENT
/begin MEASUREMENT lshvk_b1.tv_korr "korr. Tastverhaeltnis VKAT" UWORD FORMULA_0935 0 0.0 0.0 99.94999694824219 READ_WRITE ECU_ADDRESS 0x3FC684 /end MEASUREMENT
/begin MEASUREMENT lshvk_b1.tv_korr_max "Anteil des Tastverhaeltnisses ueber Aengerungsbegr." SWORD FORMULA_0935 0 0.0 -99.94999694824219 99.94999694824219 READ_WRITE ECU_ADDRESS 0x3FC68A /end MEASUREMENT
/begin MEASUREMENT lshvk_b1.tv_lim "aenderungsbegr. Tastverhaeltnis VKAT" UWORD FORMULA_0935 0 0.0 0.0 99.94999694824219 READ_WRITE ECU_ADDRESS 0x3FC68E /end MEASUREMENT
/begin MEASUREMENT lshvk_b1.tv_reg "hochaufgeloestes TV VKAT" UWORD FORMULA_0935 0 0.0 0.0 99.94999694824219 READ_WRITE ECU_ADDRESS 0x3FC682 /end MEASUREMENT
/begin MEASUREMENT lshvk_b1.tv_vorst "vorgesteuertes TV VKAT" UWORD FORMULA_0935 0 0.0 0.0 99.94999694824219 READ_WRITE ECU_ADDRESS 0x3FC680 /end MEASUREMENT
/begin MEASUREMENT lshvk_b2.r_mess "AD-Wert/Sondenwiderstand VKAT" UWORD FORMULA_0934 0 0.0 0.0 5000.0 READ_WRITE ECU_ADDRESS 0x3FC69E /end MEASUREMENT
/begin MEASUREMENT lshvk_b2.r_mess_korr "korregierter gefilteter AD-Wert/Sondenwiderstand VKAT" UWORD FORMULA_0934 0 0.0 0.0 5000.0 READ_WRITE ECU_ADDRESS 0x3FC6A0 /end MEASUREMENT
/begin MEASUREMENT lshvk_b2.reg_t_max "Heizungsregleranschlagszeit" UWORD FORMULA_0593 0 0.0 0.0 65535.0 READ_WRITE ECU_ADDRESS 0x3FC6BC /end MEASUREMENT
/begin MEASUREMENT lshvk_b2.st "VKAT-LSH-Status" UWORD FORMULA_0080 0 0.0 0.0 65535.0 READ_WRITE ECU_ADDRESS 0x3FC696 /end MEASUREMENT
/begin MEASUREMENT lshvk_b2.tabg_hys "Abgastemperatur inc. HYS-Betrachtung" SWORD FORMULA_0023 0 0.0 -50.0 1250.0 READ_WRITE ECU_ADDRESS 0x3FC6A2 /end MEASUREMENT
/begin MEASUREMENT lshvk_b2.temp_dif "Differenz IST-SOLL-Temp. VKAT" SWORD FORMULA_0791 0 0.0 -32767.0 32767.0 READ_WRITE ECU_ADDRESS 0x3FC6A6 /end MEASUREMENT
/begin MEASUREMENT lshvk_b2.temp_heiz "IST-Temp. VKAT - Heizleistung" SWORD FORMULA_0023 0 0.0 -50.0 1250.0 READ_WRITE ECU_ADDRESS 0x3FC69C /end MEASUREMENT
/begin MEASUREMENT lshvk_b2.temp_ist "IST-Temp. VKAT" SWORD FORMULA_0791 0 0.0 -50.0 1250.0 READ_WRITE ECU_ADDRESS 0x3FC69A /end MEASUREMENT
/begin MEASUREMENT lshvk_b2.temp_ist_roh "ungefilterte IST-Temp. VKAT" SWORD FORMULA_0791 0 0.0 -50.0 1250.0 READ_WRITE ECU_ADDRESS 0x3FC698 /end MEASUREMENT
/begin MEASUREMENT lshvk_b2.temp_soll "SOLL-Temp. VKAT" SWORD FORMULA_0791 0 0.0 -50.0 1250.0 READ_WRITE ECU_ADDRESS 0x3FC6A4 /end MEASUREMENT
/begin MEASUREMENT lshvk_b2.tv_add "Additiver Anteil des Tastverhaeltnisses" UWORD FORMULA_0935 0 0.0 0.0 3199.951171875 READ_WRITE ECU_ADDRESS 0x3FC6B4 /end MEASUREMENT
/begin MEASUREMENT lshvk_b2.tv_begr "TV-Wert aus Aenderungsbegr." UWORD FORMULA_0935 0 0.0 0.0 99.94999694824219 READ_WRITE ECU_ADDRESS 0x3FC6AE /end MEASUREMENT
/begin MEASUREMENT lshvk_b2.tv_eff_max "max. eff. Heizerspannung" UWORD FORMULA_0935 0 0.0 0.0 99.94999694824219 READ_WRITE ECU_ADDRESS 0x3FC6B0 /end MEASUREMENT
/begin MEASUREMENT lshvk_b2.tv_grad "pos. Aenderungsbegrenzung" SWORD FORMULA_0936 0 0.0 -99.94999694824219 99.94999694824219 READ_WRITE ECU_ADDRESS 0x3FC6B8 /end MEASUREMENT
/begin MEASUREMENT lshvk_b2.tv_korr "korr. Tastverhaeltnis VKAT" UWORD FORMULA_0935 0 0.0 0.0 99.94999694824219 READ_WRITE ECU_ADDRESS 0x3FC6AC /end MEASUREMENT
/begin MEASUREMENT lshvk_b2.tv_korr_max "Anteil des Tastverhaeltnisses ueber Aengerungsbegr." SWORD FORMULA_0935 0 0.0 -99.94999694824219 99.94999694824219 READ_WRITE ECU_ADDRESS 0x3FC6B2 /end MEASUREMENT
/begin MEASUREMENT lshvk_b2.tv_lim "aenderungsbegr. Tastverhaeltnis VKAT" UWORD FORMULA_0935 0 0.0 0.0 99.94999694824219 READ_WRITE ECU_ADDRESS 0x3FC6B6 /end MEASUREMENT
/begin MEASUREMENT lshvk_b2.tv_reg "hochaufgeloestes TV VKAT" UWORD FORMULA_0935 0 0.0 0.0 99.94999694824219 READ_WRITE ECU_ADDRESS 0x3FC6AA /end MEASUREMENT
/begin MEASUREMENT lshvk_b2.tv_vorst "vorgesteuertes TV VKAT" UWORD FORMULA_0935 0 0.0 0.0 99.94999694824219 READ_WRITE ECU_ADDRESS 0x3FC6A8 /end MEASUREMENT
/begin MEASUREMENT lshvk_diag_i_ad_b1 "Heizerstrom VKAT" UWORD FORMULA_0925 0 0.0 0.0 4.762700080871582 READ_WRITE ECU_ADDRESS 0x3FC6C4 /end MEASUREMENT
/begin MEASUREMENT lshvk_diag_i_ad_b2 "Heizerstrom VKAT" UWORD FORMULA_0925 0 0.0 0.0 4.762700080871582 READ_WRITE ECU_ADDRESS 0x3FC6C6 /end MEASUREMENT
/begin MEASUREMENT lshvk_diag_mess_cnt_b1 "Anzahl gueltiger VKAT-R-Messungen" UWORD FORMULA_0010 0 0.0 0.0 65535.0 READ_WRITE ECU_ADDRESS 0x3FC6CC /end MEASUREMENT
/begin MEASUREMENT lshvk_diag_mess_cnt_b2 "Anzahl gueltiger VKAT-R-Messungen" UWORD FORMULA_0010 0 0.0 0.0 65535.0 READ_WRITE ECU_ADDRESS 0x3FC6CE /end MEASUREMENT
/begin MEASUREMENT lshvk_diag_r_b1 "Heizerwiderstand VKAT" UWORD FORMULA_0541 0 0.0 0.0 100.0 READ_WRITE ECU_ADDRESS 0x3FC6C8 /end MEASUREMENT
/begin MEASUREMENT lshvk_diag_r_b2 "Heizerwiderstand VKAT" UWORD FORMULA_0541 0 0.0 0.0 100.0 READ_WRITE ECU_ADDRESS 0x3FC6CA /end MEASUREMENT
/begin MEASUREMENT lshvk_diag_time_ml "Verzoegerungszeit - Ermittlung Heizerwiderstand" UWORD FORMULA_0021 0 0.0 0.0 655.3499755859375 READ_WRITE ECU_ADDRESS 0x3FC6D0 /end MEASUREMENT
/begin MEASUREMENT lshvk_exd_timeout_b1 "KWP-Ansteuerzeit" UBYTE FORMULA_0937 0 0.0 0.0 25.5 READ_WRITE ECU_ADDRESS 0x3FC6C2 /end MEASUREMENT
/begin MEASUREMENT lshvk_exd_timeout_b2 "KWP-Ansteuerzeit" UBYTE FORMULA_0937 0 0.0 0.0 25.5 READ_WRITE ECU_ADDRESS 0x3FC6C3 /end MEASUREMENT
/begin MEASUREMENT lshvk_r_ad_gain_cnt_b1 "Zahler fuer Glaettungszeit" UWORD FORMULA_0010 0 0.0 0.0 65535.0 READ_WRITE ECU_ADDRESS 0x3FC6E8 /end MEASUREMENT
/begin MEASUREMENT lshvk_r_ad_gain_cnt_b2 "Zahler fuer Glaettungszeit" UWORD FORMULA_0010 0 0.0 0.0 65535.0 READ_WRITE ECU_ADDRESS 0x3FC6EA /end MEASUREMENT
/begin MEASUREMENT lshvk_r_ad_gain_delta_b1 "Delta-Sonden-Ri-Adaption" UWORD FORMULA_0073 0 0.0 0.0 4.0 READ_WRITE ECU_ADDRESS 0x3FC6F4 /end MEASUREMENT
/begin MEASUREMENT lshvk_r_ad_gain_delta_b2 "Delta-Sonden-Ri-Adaption" UWORD FORMULA_0073 0 0.0 0.0 4.0 READ_WRITE ECU_ADDRESS 0x3FC6F6 /end MEASUREMENT
/begin MEASUREMENT lshvk_r_ad_gain_delta_t_b1 "Delta-Zeit zwischen 2 GAIN-Adaptionen" ULONG FORMULA_0147 0 0.0 0.0 655.0 READ_WRITE ECU_ADDRESS 0x3FC6F8 /end MEASUREMENT
/begin MEASUREMENT lshvk_r_ad_gain_delta_t_b2 "Delta-Zeit zwischen 2 GAIN-Adaptionen" ULONG FORMULA_0147 0 0.0 0.0 655.0 READ_WRITE ECU_ADDRESS 0x3FC6FC /end MEASUREMENT
/begin MEASUREMENT lshvk_r_ad_gain_erfolgt_b1 "Erfolgte GAIN-Ri-Adaption" UWORD FORMULA_0944 0 0 0.0 255.0 READ_WRITE BIT_MASK 0x40 ECU_ADDRESS 0x3FC6E0 /end MEASUREMENT
/begin MEASUREMENT lshvk_r_ad_gain_erfolgt_b2 "Erfolgte GAIN-Ri-Adaption" UWORD FORMULA_0944 0 0 0.0 255.0 READ_WRITE BIT_MASK 0x40 ECU_ADDRESS 0x3FC6E2 /end MEASUREMENT
/begin MEASUREMENT lshvk_r_ad_gain_filt_b1 "gem. AD-Wert f. GAIN-Sonden-Ri-Adapt." UWORD FORMULA_0536 0 0.0 0.0 5000.0 READ_WRITE ECU_ADDRESS 0x3FC6F0 /end MEASUREMENT
/begin MEASUREMENT lshvk_r_ad_gain_filt_b2 "gem. AD-Wert f. GAIN-Sonden-Ri-Adapt." UWORD FORMULA_0536 0 0.0 0.0 5000.0 READ_WRITE ECU_ADDRESS 0x3FC6F2 /end MEASUREMENT
/begin MEASUREMENT lshvk_r_ad_gain_filt_st_b1 "GAIN-Ri-Filterung" UWORD FORMULA_0770 0 0 0.0 255.0 READ_WRITE BIT_MASK 0x20 ECU_ADDRESS 0x3FC6E0 /end MEASUREMENT
/begin MEASUREMENT lshvk_r_ad_gain_filt_st_b2 "GAIN-Ri-Filterung" UWORD FORMULA_0770 0 0 0.0 255.0 READ_WRITE BIT_MASK 0x20 ECU_ADDRESS 0x3FC6E2 /end MEASUREMENT
/begin MEASUREMENT lshvk_r_ad_gain_freig_b1 "GAIN-Sonden-Ri-Adaption FREIGABE" UWORD FORMULA_0943 0 0 0.0 255.0 READ_WRITE BIT_MASK 0x8 ECU_ADDRESS 0x3FC6E0 /end MEASUREMENT
/begin MEASUREMENT lshvk_r_ad_gain_freig_b2 "GAIN-Sonden-Ri-Adaption FREIGABE" UWORD FORMULA_0943 0 0 0.0 255.0 READ_WRITE BIT_MASK 0x8 ECU_ADDRESS 0x3FC6E2 /end MEASUREMENT
/begin MEASUREMENT lshvk_r_ad_gain_st_b1 "GAIN-Sonden-Ri-Adaption" UWORD FORMULA_0769 0 0 0.0 255.0 READ_WRITE BIT_MASK 0x10 ECU_ADDRESS 0x3FC6E0 /end MEASUREMENT
/begin MEASUREMENT lshvk_r_ad_gain_st_b2 "GAIN-Sonden-Ri-Adaption" UWORD FORMULA_0769 0 0 0.0 255.0 READ_WRITE BIT_MASK 0x10 ECU_ADDRESS 0x3FC6E2 /end MEASUREMENT
/begin MEASUREMENT lshvk_r_ad_offs_cnt_b1 "Zahler fuer Glaettungszeit" UWORD FORMULA_0010 0 0.0 0.0 65535.0 READ_WRITE ECU_ADDRESS 0x3FC6E4 /end MEASUREMENT
/begin MEASUREMENT lshvk_r_ad_offs_cnt_b2 "Zahler fuer Glaettungszeit" UWORD FORMULA_0010 0 0.0 0.0 65535.0 READ_WRITE ECU_ADDRESS 0x3FC6E6 /end MEASUREMENT
/begin MEASUREMENT lshvk_r_ad_offs_delta_t_b1 "Delta-Zeit zwischen 2 OFFSET-Adaptionen" ULONG FORMULA_0147 0 0.0 0.0 655.0 READ_WRITE ECU_ADDRESS 0x3FC700 /end MEASUREMENT
/begin MEASUREMENT lshvk_r_ad_offs_delta_t_b2 "Delta-Zeit zwischen 2 OFFSET-Adaptionen" ULONG FORMULA_0147 0 0.0 0.0 655.0 READ_WRITE ECU_ADDRESS 0x3FC704 /end MEASUREMENT
/begin MEASUREMENT lshvk_r_ad_offs_erfolgt_b1 "Erfolgte OFFSET-Ri-Adaption" UWORD FORMULA_0945 0 0 0.0 255.0 READ_WRITE BIT_MASK 0x80 ECU_ADDRESS 0x3FC6E0 /end MEASUREMENT
/begin MEASUREMENT lshvk_r_ad_offs_erfolgt_b2 "Erfolgte OFFSET-Ri-Adaption" UWORD FORMULA_0945 0 0 0.0 255.0 READ_WRITE BIT_MASK 0x80 ECU_ADDRESS 0x3FC6E2 /end MEASUREMENT
/begin MEASUREMENT lshvk_r_ad_offs_filt_b1 "gem. AD-Wert f. OFFSET-Sonden-Ri-Adapt." SWORD FORMULA_0536 0 0.0 -5000.0 5000.0 READ_WRITE ECU_ADDRESS 0x3FC6EC /end MEASUREMENT
/begin MEASUREMENT lshvk_r_ad_offs_filt_b2 "gem. AD-Wert f. OFFSET-Sonden-Ri-Adapt." SWORD FORMULA_0536 0 0.0 -5000.0 5000.0 READ_WRITE ECU_ADDRESS 0x3FC6EE /end MEASUREMENT
/begin MEASUREMENT lshvk_r_ad_offs_filt_st_b1 "OFFSET-Ri-Filterung" UWORD FORMULA_0767 0 0 0.0 255.0 READ_WRITE BIT_MASK 0x4 ECU_ADDRESS 0x3FC6E0 /end MEASUREMENT
/begin MEASUREMENT lshvk_r_ad_offs_filt_st_b2 "OFFSET-Ri-Filterung" UWORD FORMULA_0767 0 0 0.0 255.0 READ_WRITE BIT_MASK 0x4 ECU_ADDRESS 0x3FC6E2 /end MEASUREMENT
/begin MEASUREMENT lshvk_r_ad_offs_freig_b1 "OFFSET-Sonden-Ri-Adaption FREIGABE" UWORD FORMULA_0942 0 0 0.0 255.0 READ_WRITE BIT_MASK 0x1 ECU_ADDRESS 0x3FC6E0 /end MEASUREMENT
/begin MEASUREMENT lshvk_r_ad_offs_freig_b2 "OFFSET-Sonden-Ri-Adaption FREIGABE" UWORD FORMULA_0942 0 0 0.0 255.0 READ_WRITE BIT_MASK 0x1 ECU_ADDRESS 0x3FC6E2 /end MEASUREMENT
/begin MEASUREMENT lshvk_r_ad_offs_st_b1 "OFFSET-Sonden-Ri-Adaption" UWORD FORMULA_0843 0 0 0.0 255.0 READ_WRITE BIT_MASK 0x2 ECU_ADDRESS 0x3FC6E0 /end MEASUREMENT
/begin MEASUREMENT lshvk_r_ad_offs_st_b2 "OFFSET-Sonden-Ri-Adaption" UWORD FORMULA_0843 0 0 0.0 255.0 READ_WRITE BIT_MASK 0x2 ECU_ADDRESS 0x3FC6E2 /end MEASUREMENT
/begin MEASUREMENT lshvk_r_ad_st_b1 "Sonden-Ri-Adation-Status" UWORD FORMULA_0080 0 0.0 0.0 65535.0 READ_WRITE ECU_ADDRESS 0x3FC6E0 /end MEASUREMENT
/begin MEASUREMENT lshvk_r_ad_st_b2 "Sonden-Ri-Adation-Status" UWORD FORMULA_0080 0 0.0 0.0 65535.0 READ_WRITE ECU_ADDRESS 0x3FC6E2 /end MEASUREMENT
/begin MEASUREMENT lshvk_status "VKAT-LSH-Zusatzstatus" UBYTE FORMULA_0003 0 0.0 0.0 255.0 READ_WRITE ECU_ADDRESS 0x3FC6BE /end MEASUREMENT
/begin MEASUREMENT lshvk_temp_filt_tau "Filterkonstante PT1" UWORD FORMULA_0754 0 0.0 0.0 255.9960021972656 READ_WRITE ECU_ADDRESS 0x3FC6C0 /end MEASUREMENT
/begin MEASUREMENT lsrvk_obd_aktiv_b1 "VKAT-Sondeninnenwiderstand Diagnose" UWORD FORMULA_0938 0 0 0.0 255.0 READ_WRITE BIT_MASK 0x1 ECU_ADDRESS 0x3FC6D2 /end MEASUREMENT
/begin MEASUREMENT lsrvk_obd_aktiv_b2 "VKAT-Sondeninnenwiderstand Diagnose" UWORD FORMULA_0938 0 0 0.0 255.0 READ_WRITE BIT_MASK 0x1 ECU_ADDRESS 0x3FC6D4 /end MEASUREMENT
/begin MEASUREMENT lsrvk_obd_ref_b1 "Referenzwiderstandsdiagnose LSU4.9" UWORD FORMULA_0941 0 0 0.0 255.0 READ_WRITE BIT_MASK 0x8 ECU_ADDRESS 0x3FC6D2 /end MEASUREMENT
/begin MEASUREMENT lsrvk_obd_ref_b2 "Referenzwiderstandsdiagnose LSU4.9" UWORD FORMULA_0941 0 0 0.0 255.0 READ_WRITE BIT_MASK 0x8 ECU_ADDRESS 0x3FC6D4 /end MEASUREMENT
/begin MEASUREMENT lsrvk_obd_ref_cnt_b1 "Anzahl erfolgter LA-Ri-GAIN-Ermittlungen" UWORD FORMULA_0010 0 0.0 0.0 65535.0 READ_WRITE ECU_ADDRESS 0x3FC6D8 /end MEASUREMENT
/begin MEASUREMENT lsrvk_obd_ref_cnt_b2 "Anzahl erfolgter LA-Ri-GAIN-Ermittlungen" UWORD FORMULA_0010 0 0.0 0.0 65535.0 READ_WRITE ECU_ADDRESS 0x3FC6DA /end MEASUREMENT
/begin MEASUREMENT lsrvk_obd_ref_offs_cnt_b1 "Anzahl erfolgter LA-Ri-OFFSET-Ermittlungen" UWORD FORMULA_0010 0 0.0 0.0 65535.0 READ_WRITE ECU_ADDRESS 0x3FC6DC /end MEASUREMENT
/begin MEASUREMENT lsrvk_obd_ref_offs_cnt_b2 "Anzahl erfolgter LA-Ri-OFFSET-Ermittlungen" UWORD FORMULA_0010 0 0.0 0.0 65535.0 READ_WRITE ECU_ADDRESS 0x3FC6DE /end MEASUREMENT
/begin MEASUREMENT lsrvk_obd_reg_b1 "Heizerregleranschlagspruefung" UWORD FORMULA_0939 0 0 0.0 255.0 READ_WRITE BIT_MASK 0x2 ECU_ADDRESS 0x3FC6D2 /end MEASUREMENT
/begin MEASUREMENT lsrvk_obd_reg_b2 "Heizerregleranschlagspruefung" UWORD FORMULA_0939 0 0 0.0 255.0 READ_WRITE BIT_MASK 0x2 ECU_ADDRESS 0x3FC6D4 /end MEASUREMENT
/begin MEASUREMENT lsrvk_obd_st_b1 "VKAT-Ri-OBD-Status" UWORD FORMULA_0080 0 0.0 0.0 65535.0 READ_WRITE ECU_ADDRESS 0x3FC6D2 /end MEASUREMENT
/begin MEASUREMENT lsrvk_obd_st_b2 "VKAT-Ri-OBD-Status" UWORD FORMULA_0080 0 0.0 0.0 65535.0 READ_WRITE ECU_ADDRESS 0x3FC6D4 /end MEASUREMENT
/begin MEASUREMENT lsrvk_obd_start_b1 "Diagnose nach Motorstart" UWORD FORMULA_0940 0 0 0.0 255.0 READ_WRITE BIT_MASK 0x4 ECU_ADDRESS 0x3FC6D2 /end MEASUREMENT
/begin MEASUREMENT lsrvk_obd_start_b2 "Diagnose nach Motorstart" UWORD FORMULA_0940 0 0 0.0 255.0 READ_WRITE BIT_MASK 0x4 ECU_ADDRESS 0x3FC6D4 /end MEASUREMENT
/begin MEASUREMENT lsrvk_obd_tml "Verzoegerungszeit - LSHVK-Ri-Diagnose" UWORD FORMULA_0021 0 0.0 0.0 655.0 READ_WRITE ECU_ADDRESS 0x3FC6D6 /end MEASUREMENT
/begin MEASUREMENT mdrv_flags "MDRV fuer DME" UBYTE FORMULA_0003 0 0.0 0.0 255.0 READ_WRITE ECU_ADDRESS 0x3FC70D /end MEASUREMENT
/begin MEASUREMENT mdrv_flags_kl15 "MDRV Kl15" UBYTE FORMULA_0954 0 0 0.0 255.0 READ_WRITE BIT_MASK 0x8 ECU_ADDRESS 0x3FC70D /end MEASUREMENT
/begin MEASUREMENT mdrv_flags_power "MDRV Powertaster" UBYTE FORMULA_0953 0 0 0.0 255.0 READ_WRITE BIT_MASK 0x4 ECU_ADDRESS 0x3FC70D /end MEASUREMENT
/begin MEASUREMENT mdrv_flags_stat "MDRV fuer DME" UBYTE FORMULA_0952 0 0.0 0.0 255.0 READ_WRITE BIT_MASK 0x3 ECU_ADDRESS 0x3FC70D /end MEASUREMENT
/begin MEASUREMENT mdrv_pth_cnt "max. Entprellcounter" UBYTE FORMULA_0003 0 0.0 0.0 255.0 READ_WRITE ECU_ADDRESS 0x3FC70E /end MEASUREMENT
/begin MEASUREMENT mdrv_tblink "Blinktimer" UWORD FORMULA_0021 0 0.0 0.0 655.0 READ_WRITE ECU_ADDRESS 0x3FC710 /end MEASUREMENT
/begin MEASUREMENT ml_aq_b1 "ml aus aq" SWORD FORMULA_0103 0 0.0 -100.0 1400.0 READ_WRITE ECU_ADDRESS 0x3FC83E /end MEASUREMENT
/begin MEASUREMENT ml_aq_b2 "ml aus aq" SWORD FORMULA_0103 0 0.0 -100.0 1400.0 READ_WRITE ECU_ADDRESS 0x3FC840 /end MEASUREMENT
/begin MEASUREMENT ml_aq_hfm_b1 "ml aus Kombination von aq und hfm bestimmt" SWORD FORMULA_0103 0 0.0 -100.0 1400.0 READ_WRITE ECU_ADDRESS 0x3FC84A /end MEASUREMENT
/begin MEASUREMENT ml_aq_hfm_b2 "ml aus Kombination von aq und hfm bestimmt" SWORD FORMULA_0103 0 0.0 -100.0 1400.0 READ_WRITE ECU_ADDRESS 0x3FC84C /end MEASUREMENT
/begin MEASUREMENT ml_lam_b1 "Luftmassenstrom aus Lambda" SWORD FORMULA_0103 0 0.0 -100.0 1400.0 READ_WRITE ECU_ADDRESS 0x3FC806 /end MEASUREMENT
/begin MEASUREMENT ml_lam_b2 "Luftmassenstrom aus Lambda" SWORD FORMULA_0103 0 0.0 -100.0 1400.0 READ_WRITE ECU_ADDRESS 0x3FC836 /end MEASUREMENT
/begin MEASUREMENT ml_psau_b1 "Luftmassenstrom aus psau" SWORD FORMULA_0103 0 0.0 -100.0 1400.0 READ_WRITE ECU_ADDRESS 0x3FC7F4 /end MEASUREMENT
/begin MEASUREMENT ml_psau_b2 "Luftmassenstrom aus psau" SWORD FORMULA_0103 0 0.0 -100.0 1400.0 READ_WRITE ECU_ADDRESS 0x3FC824 /end MEASUREMENT
/begin MEASUREMENT msg_bos_kl15 "BOS-Meldg. bei Klemmenwechsel" UBYTE FORMULA_0960 0 0.0 0.0 255.0 READ_WRITE ECU_ADDRESS 0x3FC748 /end MEASUREMENT
/begin MEASUREMENT msg_clr_buf "Clear Sendebuffer" ULONG FORMULA_0000 0 0.0 0.0 4294967295.0 READ_WRITE ECU_ADDRESS 0x3FC740 /end MEASUREMENT
/begin MEASUREMENT msg_exd_st "Ext. Ansteuerung" UBYTE FORMULA_0037 0 0.0 0.0 255.0 READ_WRITE ECU_ADDRESS 0x3FC714 /end MEASUREMENT
/begin MEASUREMENT msg_exd_timeout "Timeout" UWORD FORMULA_0593 0 0.0 0.0 65535.0 READ_WRITE ARRAY_SIZE 2 ECU_ADDRESS 0x3FC744 MATRIX_DIM 2 1 1 /end MEASUREMENT
/begin MEASUREMENT msg_rec_rtime "Repeattime" UBYTE FORMULA_0214 0 0.0 0.0 255.0 READ_WRITE ARRAY_SIZE 2 ECU_ADDRESS 0x3FC749 MATRIX_DIM 2 1 1 /end MEASUREMENT
/begin MEASUREMENT msg_send_buf "Sendebuffer" ULONG FORMULA_0000 0 0.0 0.0 4294967295.0 READ_WRITE ECU_ADDRESS 0x3FC73C /end MEASUREMENT
/begin MEASUREMENT msg_send_id "gesendete ID pro Zyklus" UWORD FORMULA_0959 0 0.0 0.0 65535.0 READ_WRITE ECU_ADDRESS 0x3FC71A /end MEASUREMENT
/begin MEASUREMENT msg_send_st "Sendestatus" UBYTE FORMULA_0958 0 0.0 0.0 255.0 READ_WRITE ECU_ADDRESS 0x3FC716 /end MEASUREMENT
/begin MEASUREMENT msg_send_timeout "Timeout der akt. ID" UBYTE FORMULA_0214 0 0.0 0.0 255.0 READ_WRITE ECU_ADDRESS 0x3FC718 /end MEASUREMENT
/begin MEASUREMENT msg_send_typ "gesendeter Typ pro Zyklus" UBYTE FORMULA_0957 0 0.0 0.0 255.0 READ_WRITE ECU_ADDRESS 0x3FC715 /end MEASUREMENT
/begin MEASUREMENT msg_timer "Timer Meldung" UBYTE FORMULA_0461 0 0.0 0.0 25.5 READ_WRITE ARRAY_SIZE 32 ECU_ADDRESS 0x3FC71C MATRIX_DIM 32 1 1 /end MEASUREMENT
/begin MEASUREMENT mvac_al_brp_grad "dynamischer Durchflusswert MVAC" SWORD FORMULA_0967 0 0.0 0.0 2.0 READ_WRITE ECU_ADDRESS 0x3FC78A /end MEASUREMENT
/begin MEASUREMENT mvac_al_ummv_stat "Produkt aus K_MVAC_AL_UMMV_STAT und can_brp" SLONG FORMULA_0966 0 0.0 0.0 1000.0 READ_WRITE ECU_ADDRESS 0x3FC784 /end MEASUREMENT
/begin MEASUREMENT mvac_aq_bre_b "AQ-Offset LL-Steller Bank 2 bei Bremsung" UWORD FORMULA_0143 0 0.0 0.0 6500.0 READ_WRITE ECU_ADDRESS 0x3FC7A6 /end MEASUREMENT
/begin MEASUREMENT mvac_aq_bre_sa "AQ-Offset LL-Steller Bank 2 bei SA" UWORD FORMULA_0143 0 0.0 0.0 6500.0 READ_WRITE ECU_ADDRESS 0x3FC7B0 /end MEASUREMENT
/begin MEASUREMENT mvac_del_bls "Delay S_BLS bis can_brp_grad" UWORD FORMULA_0109 0 0.0 0.0 325.0 READ_WRITE ECU_ADDRESS 0x3FC788 /end MEASUREMENT
/begin MEASUREMENT mvac_del_rsv "Delay Schliesszeitverzug RSV(Modell)" UWORD FORMULA_0109 0 0.0 0.0 325.0 READ_WRITE ECU_ADDRESS 0x3FC75E /end MEASUREMENT
/begin MEASUREMENT mvac_del_rsv_mess "Delay Schliesszeitverzug RSV(Sensor)" UWORD FORMULA_0109 0 0.0 0.0 325.0 READ_WRITE ECU_ADDRESS 0x3FC760 /end MEASUREMENT
/begin MEASUREMENT mvac_elup_st_del "Zeitverzoegerung fuer Berechnung von mvac_ml_sr_rsv_psens" UWORD FORMULA_0109 0 0.0 0.0 325.0 READ_WRITE ECU_ADDRESS 0x3FC75A /end MEASUREMENT
/begin MEASUREMENT mvac_m "Luftmasse im Mastervac" SWORD FORMULA_0962 0 0.0 0.0 30.0 READ_WRITE ECU_ADDRESS 0x3FC74C /end MEASUREMENT
/begin MEASUREMENT mvac_ml "Gesamtluftmassenstrom zum Mastervac" SLONG FORMULA_0963 0 0.0 -250.0 700.0 READ_WRITE ECU_ADDRESS 0x3FC794 /end MEASUREMENT
/begin MEASUREMENT mvac_ml_brp "Luftmassenstrom zum Mastervac durch brp" SLONG FORMULA_0963 0 0.0 -700.0 250.0 READ_WRITE ECU_ADDRESS 0x3FC77C /end MEASUREMENT
/begin MEASUREMENT mvac_ml_brp_grad "Luftmassenstrom zum Mastervac durch brp_grad" SLONG FORMULA_0963 0 0.0 -700.0 250.0 READ_WRITE ECU_ADDRESS 0x3FC780 /end MEASUREMENT
/begin MEASUREMENT mvac_ml_elup "Luftmassenstrom ELUP/Mastervac" SWORD FORMULA_0965 0 0.0 -32.0 32.0 READ_WRITE ECU_ADDRESS 0x3FC774 /end MEASUREMENT
/begin MEASUREMENT mvac_ml_elup_sr "Minimum aus ml_elup und ml_sr" SLONG FORMULA_0963 0 0.0 -250.0 250.0 READ_WRITE ECU_ADDRESS 0x3FC790 /end MEASUREMENT
/begin MEASUREMENT mvac_ml_leck "Luftmassenstrom zum Mastervac durch Leckluft" SLONG FORMULA_0963 0 0.0 -5.0 5.0 READ_WRITE ECU_ADDRESS 0x3FC778 /end MEASUREMENT
/begin MEASUREMENT mvac_ml_old "Gesamtluftmassenstrom zum Mastervac t(-5ms)" SLONG FORMULA_0963 0 0.0 -250.0 700.0 READ_WRITE ECU_ADDRESS 0x3FC798 /end MEASUREMENT
/begin MEASUREMENT mvac_ml_psens "Luftmassenstrom neg. MVAC -> LLS, pos LLS -> MVAC" SLONG FORMULA_0963 0 0.0 -1000.0 1000.0 READ_WRITE ECU_ADDRESS 0x3FC750 /end MEASUREMENT
/begin MEASUREMENT mvac_ml_sr "Luftmassenstrom vom Saugrohr Bank2 zum Mastervac" SWORD FORMULA_0103 0 0.0 -200.0 200.0 READ_WRITE ECU_ADDRESS 0x3FC78C /end MEASUREMENT
/begin MEASUREMENT mvac_ml_sr_rsv "Luftmassenstrom(Modell) vom Saugrohr, differenzdruckabhaengig" SWORD FORMULA_0103 0 0.0 -100.0 1400.0 READ_WRITE ECU_ADDRESS 0x3FC76E /end MEASUREMENT
/begin MEASUREMENT mvac_ml_sr_rsv_mess "Luftmassenstrom(Senor) vom Saugrohr, differenzdruckabhaengig" SWORD FORMULA_0103 0 0.0 -100.0 1400.0 READ_WRITE ECU_ADDRESS 0x3FC770 /end MEASUREMENT
/begin MEASUREMENT mvac_ml_sr_rsv_mess_roh "Luftmassenstromrohwert(Sensor) Saugrohr/Mvac" SWORD FORMULA_0103 0 0.0 -100.0 1400.0 READ_WRITE ECU_ADDRESS 0x3FC76C /end MEASUREMENT
/begin MEASUREMENT mvac_ml_sr_rsv_psens "Luftmassenstrom neg. MVAC -> LLS, pos LLS -> MVAC" SWORD FORMULA_0103 0 0.0 -1000.0 1000.0 READ_WRITE ECU_ADDRESS 0x3FC758 /end MEASUREMENT
/begin MEASUREMENT mvac_ml_sr_rsv_psens_roh "Luftmassenstrom neg. MVAC -> LLS, pos LLS -> MVAC" SLONG FORMULA_0963 0 0.0 -1000.0 1000.0 READ_WRITE ECU_ADDRESS 0x3FC754 /end MEASUREMENT
/begin MEASUREMENT mvac_ml_sr_rsv_roh "Luftmassenstromrohwert(Modell) Saugrohr/Mvac" SWORD FORMULA_0103 0 0.0 -100.0 1400.0 READ_WRITE ECU_ADDRESS 0x3FC76A /end MEASUREMENT
/begin MEASUREMENT mvac_p_ad "Eingelesener Spannungswert fuer Unterdruck-MVAC" SWORD FORMULA_0114 0 0.0 0.0 1023.0 READ_WRITE ECU_ADDRESS 0x3FC7B2 /end MEASUREMENT
/begin MEASUREMENT mvac_p_diag_pdiff_delay "Zeitverzoegerung fuer Berechnung von mvac_p_diag_pdiff_roh" UWORD FORMULA_0109 0 0.0 0.0 325.0 READ_WRITE ECU_ADDRESS 0x3FC7CC /end MEASUREMENT
/begin MEASUREMENT mvac_p_diag_pdiff_neg "Unterschied Differenzdruck Modellwert < Sensorwert" SWORD FORMULA_0075 0 0.0 -1100.0 200.0 READ_WRITE ECU_ADDRESS 0x3FC7BE /end MEASUREMENT
/begin MEASUREMENT mvac_p_diag_pdiff_neg_roh "Unterschied Differenzdruck Modell < Sensor" SWORD FORMULA_0075 0 0.0 -1100.0 200.0 READ_WRITE ECU_ADDRESS 0x3FC7BA /end MEASUREMENT
/begin MEASUREMENT mvac_p_diag_pdiff_pos "Unterschied Differenzdruck Modellwert > Sensorwert" SWORD FORMULA_0075 0 0.0 -1100.0 200.0 READ_WRITE ECU_ADDRESS 0x3FC7BC /end MEASUREMENT
/begin MEASUREMENT mvac_p_diag_pdiff_pos_roh "Unterschied Differenzdruck Modell > Sensor bei LL bzw. SA" SWORD FORMULA_0075 0 0.0 -1100.0 200.0 READ_WRITE ECU_ADDRESS 0x3FC7B8 /end MEASUREMENT
/begin MEASUREMENT mvac_p_diag_pdiff_roh "Unterschied Differenzdruck Modell zu Sensor" SWORD FORMULA_0075 0 0.0 -1100.0 200.0 READ_WRITE ECU_ADDRESS 0x3FC7B6 /end MEASUREMENT
/begin MEASUREMENT mvac_p_modell_grad "Gradient Modelldruck Mastervac" SLONG FORMULA_0968 0 0.0 -1300000.0 1300000.0 READ_WRITE ECU_ADDRESS 0x3FC7A0 /end MEASUREMENT
/begin MEASUREMENT mvac_p_roh "Ungefilterter Messwert" SWORD FORMULA_0075 0 0.0 -1100.0 200.0 READ_WRITE ECU_ADDRESS 0x3FC7B4 /end MEASUREMENT
/begin MEASUREMENT mvac_pdiff_filter "Differenzdruck Umgebung/Mastervac gefiltert" SWORD FORMULA_0075 0 0.0 -2000.0 2000.0 READ_WRITE ECU_ADDRESS 0x3FC772 /end MEASUREMENT
/begin MEASUREMENT mvac_pdiff_sr "Differenzdruck(Modell) Saugrohr/Mastervac mit Hysterese" SWORD FORMULA_0075 0 0.0 -1200.0 1200.0 READ_WRITE ECU_ADDRESS 0x3FC766 /end MEASUREMENT
/begin MEASUREMENT mvac_pdiff_sr_mess "Differenzdruck(Sensor) Saugrohr/Mastervac mit Hysterese" SWORD FORMULA_0075 0 0.0 -1200.0 1200.0 READ_WRITE ECU_ADDRESS 0x3FC768 /end MEASUREMENT
/begin MEASUREMENT mvac_pdiff_sr_mess_roh "Differenzdruck(Sensor) Saugrohr/Mastervac direkt" SWORD FORMULA_0075 0 0.0 -1200.0 1200.0 READ_WRITE ECU_ADDRESS 0x3FC764 /end MEASUREMENT
/begin MEASUREMENT mvac_pdiff_sr_roh "Differenzdruck(Modell) Saugrohr/Mastervac direkt" SWORD FORMULA_0075 0 0.0 -1200.0 1200.0 READ_WRITE ECU_ADDRESS 0x3FC762 /end MEASUREMENT
/begin MEASUREMENT mvac_pl_p_modell_ml "PL Differenzdruck Modellwert bei B_ZUST_ML" SWORD FORMULA_0075 0 0.0 -1100.0 200.0 READ_WRITE ECU_ADDRESS 0x3FC7D2 /end MEASUREMENT
/begin MEASUREMENT mvac_pl_p_sensor_ml "PL Differenzdruck Sensorwert bei B_ZUST_ML" SWORD FORMULA_0075 0 0.0 -1100.0 200.0 READ_WRITE ECU_ADDRESS 0x3FC7D0 /end MEASUREMENT
/begin MEASUREMENT mvac_pl_p_sensor_ms_ende "PL Differenzdruck Sensor-Endwert bei B_ZUST_MS" SWORD FORMULA_0075 0 0.0 -1100.0 200.0 READ_WRITE ECU_ADDRESS 0x3FC7D4 /end MEASUREMENT
/begin MEASUREMENT mvac_pl_p_sensor_ms_start "PL Differenzdruck Sensor-Startwert bei B_ZUST_MS" SWORD FORMULA_0075 0 0.0 -1100.0 200.0 READ_WRITE ECU_ADDRESS 0x3FC7D6 /end MEASUREMENT
/begin MEASUREMENT mvac_pl_st "Prueflaufstatus MVAC" UBYTE FORMULA_0677 0 0.0 0.0 255.0 READ_WRITE ECU_ADDRESS 0x3FC7CE /end MEASUREMENT
/begin MEASUREMENT mvac_pl_timer "Timer fuer MVAC-Prueflauf" UBYTE FORMULA_0214 0 0.0 0.0 255.0 READ_WRITE ECU_ADDRESS 0x3FC7CF /end MEASUREMENT
/begin MEASUREMENT mvac_pos_rsv "Zustand Rueckschlagventil(Modell)" UBYTE FORMULA_0964 0 0.0 0.0 255.0 READ_WRITE ECU_ADDRESS 0x3FC75C /end MEASUREMENT
/begin MEASUREMENT mvac_pos_rsv_mess "Zustand Rueckschlagventil(Sensor)" UBYTE FORMULA_0964 0 0.0 0.0 255.0 READ_WRITE ECU_ADDRESS 0x3FC75D /end MEASUREMENT
/begin MEASUREMENT mvac_rmp_fkt_sa "Wert Zeitfaktor Abregelrampe durch B_SA" SWORD FORMULA_0109 0 0.0 0.0 150.0 READ_WRITE ECU_ADDRESS 0x3FC7AE /end MEASUREMENT
/begin MEASUREMENT mvac_rmp_fkt_sa_frei "MVAC Rampe bei SA grundsaetzlich bereit" UBYTE FORMULA_0970 0 0.0 0.0 255.0 READ_WRITE ECU_ADDRESS 0x3FC7A9 /end MEASUREMENT
/begin MEASUREMENT mvac_rmp_fkt_sa_neg "Wert Zeitfaktor fallende Abregelrampe durch B_SA" SWORD FORMULA_0109 0 0.0 0.0 150.0 READ_WRITE ECU_ADDRESS 0x3FC7AC /end MEASUREMENT
/begin MEASUREMENT mvac_rmp_fkt_sa_pos "Wert Zeitfaktor steigende Abregelrampe durch B_SA" SWORD FORMULA_0109 0 0.0 0.0 150.0 READ_WRITE ECU_ADDRESS 0x3FC7AA /end MEASUREMENT
/begin MEASUREMENT mvac_rmp_fkt_sa_start "MVAC Rampe bei SA gestartet" UBYTE FORMULA_0969 0 0.0 0.0 255.0 READ_WRITE ECU_ADDRESS 0x3FC7A8 /end MEASUREMENT
/begin MEASUREMENT mvac_spr_fkt_brp_grad "Wert Zeitfaktor Abregelrampe durch brp_grad" SWORD FORMULA_0109 0 0.0 0.0 150.0 READ_WRITE ECU_ADDRESS 0x3FC7A4 /end MEASUREMENT
/begin MEASUREMENT mzyl_aq_b1 "mzyl aus aq" SWORD FORMULA_0104 0 0.0 -500.0 1500.0 READ_WRITE ECU_ADDRESS 0x3FC842 /end MEASUREMENT
/begin MEASUREMENT mzyl_aq_b2 "mzyl aus aq" SWORD FORMULA_0104 0 0.0 -500.0 1500.0 READ_WRITE ECU_ADDRESS 0x3FC844 /end MEASUREMENT
/begin MEASUREMENT mzyl_aq_hfm_b1 "mzyl aus Kombination von aq und hfm bestimmt" SWORD FORMULA_0104 0 0.0 -500.0 1500.0 READ_WRITE ECU_ADDRESS 0x3FC84E /end MEASUREMENT
/begin MEASUREMENT mzyl_aq_hfm_b2 "mzyl aus Kombination von aq und hfm bestimmt" SWORD FORMULA_0104 0 0.0 -500.0 1500.0 READ_WRITE ECU_ADDRESS 0x3FC850 /end MEASUREMENT
/begin MEASUREMENT mzyl_b1.aq_rf_fak "Gewichtungsfaktor fuer rf Bildung aus aq" SWORD FORMULA_0558 0 0.0 -3.0 3.0 READ_WRITE ECU_ADDRESS 0x3FC804 /end MEASUREMENT
/begin MEASUREMENT mzyl_b1.e_mean_ues "Wirksamer Rueckstr. EV-Quers." UWORD FORMULA_0984 0 0.0 0.0 15.0 READ_WRITE ECU_ADDRESS 0x3FC7F6 /end MEASUREMENT
/begin MEASUREMENT mzyl_b1.gas_zustand "Gaszustand EV" UWORD FORMULA_0010 0 0.0 0.0 65535.0 READ_WRITE ECU_ADDRESS 0x3FC802 /end MEASUREMENT
/begin MEASUREMENT mzyl_b1.ges_asp "Wirksame Gesamtmasse/ASP" SWORD FORMULA_0104 0 0.0 -500.0 1500.0 READ_WRITE ECU_ADDRESS 0x3FC7DC /end MEASUREMENT
/begin MEASUREMENT mzyl_b1.ges_psau "Gesamtmasse/ASP aus psau" SWORD FORMULA_0104 0 0.0 -500.0 1500.0 READ_WRITE ECU_ADDRESS 0x3FC7E8 /end MEASUREMENT
/begin MEASUREMENT mzyl_b1.ges_roh "Ges.masse/ASP aus psau + EV-Verl" SWORD FORMULA_0104 0 0.0 -500.0 1500.0 READ_WRITE ECU_ADDRESS 0x3FC7EA /end MEASUREMENT
/begin MEASUREMENT mzyl_b1.ges_rueck "Rueckstr. Gesamtmasse durch EV" SWORD FORMULA_0104 0 0.0 -500.0 1500.0 READ_WRITE ECU_ADDRESS 0x3FC7FC /end MEASUREMENT
/begin MEASUREMENT mzyl_b1.ml_asp "Wirksame Luftmasse/ASP" SWORD FORMULA_0104 0 0.0 -500.0 1500.0 READ_WRITE ECU_ADDRESS 0x3FC7E0 /end MEASUREMENT
/begin MEASUREMENT mzyl_b1.ml_lam "Luftmasse aus Lambda" SWORD FORMULA_0104 0 0.0 -500.0 1500.0 READ_WRITE ECU_ADDRESS 0x3FC808 /end MEASUREMENT
/begin MEASUREMENT mzyl_b1.ml_psau "Luftmasse/ASP aus psau" SWORD FORMULA_0104 0 0.0 -500.0 1500.0 READ_WRITE ECU_ADDRESS 0x3FC7E6 /end MEASUREMENT
/begin MEASUREMENT mzyl_b1.ml_sum_sa "Summe Luftmassenstr. im ZUST_SA" SLONG FORMULA_0983 0 0.0 -214748364.8 214748364.7 READ_WRITE ECU_ADDRESS 0x3FC7EC /end MEASUREMENT
/begin MEASUREMENT mzyl_b1.ml_sum_we "Summe Luftmassenstr. nach SA_WE" SLONG FORMULA_0983 0 0.0 -214748364.8 214748364.7 READ_WRITE ECU_ADDRESS 0x3FC7F0 /end MEASUREMENT
/begin MEASUREMENT mzyl_b1.mldt "Wirksamer Luftmassenstrom" SWORD FORMULA_0103 0 0.0 -100.0 1400.0 READ_WRITE ECU_ADDRESS 0x3FC7E4 /end MEASUREMENT
/begin MEASUREMENT mzyl_b1.phi_ev_mean "Durchflussbeiwert EV" SWORD FORMULA_0558 0 0.0 -9.999999747378752e-005 1.0 READ_WRITE ECU_ADDRESS 0x3FC7FA /end MEASUREMENT
/begin MEASUREMENT mzyl_b1.pzyl "Zylinderinnendruck EV schliesst" SWORD FORMULA_0075 0 0.0 0.0 2000.0 READ_WRITE ECU_ADDRESS 0x3FC800 /end MEASUREMENT
/begin MEASUREMENT mzyl_b1.rf "Wirksames rf" SWORD FORMULA_0007 0 0.0 0.0 2.0 READ_WRITE ECU_ADDRESS 0x3FC7E2 /end MEASUREMENT
/begin MEASUREMENT mzyl_b1.rg_asp "Wirksame RG-Masse/ASP" SWORD FORMULA_0104 0 0.0 -500.0 1500.0 READ_WRITE ECU_ADDRESS 0x3FC7DE /end MEASUREMENT
/begin MEASUREMENT mzyl_b1.t_ues_ev "Zeit Rueckstr. EV" UWORD FORMULA_0985 0 0.0 0.0 40.0 READ_WRITE ECU_ADDRESS 0x3FC7FE /end MEASUREMENT
/begin MEASUREMENT mzyl_b1.w_ues_ev "Winkel Rueckstr. EV" SWORD FORMULA_0102 0 0.0 50.0 160.0 READ_WRITE ECU_ADDRESS 0x3FC7F8 /end MEASUREMENT
/begin MEASUREMENT mzyl_b2.aq_rf_fak "Gewichtungsfaktor fuer rf Bildung aus aq" SWORD FORMULA_0558 0 0.0 -3.0 3.0 READ_WRITE ECU_ADDRESS 0x3FC834 /end MEASUREMENT
/begin MEASUREMENT mzyl_b2.e_mean_ues "Wirksamer Rueckstr. EV-Quers." UWORD FORMULA_0984 0 0.0 0.0 15.0 READ_WRITE ECU_ADDRESS 0x3FC826 /end MEASUREMENT
/begin MEASUREMENT mzyl_b2.gas_zustand "Gaszustand EV" UWORD FORMULA_0010 0 0.0 0.0 65535.0 READ_WRITE ECU_ADDRESS 0x3FC832 /end MEASUREMENT
/begin MEASUREMENT mzyl_b2.ges_asp "Wirksame Gesamtmasse/ASP" SWORD FORMULA_0104 0 0.0 -500.0 1500.0 READ_WRITE ECU_ADDRESS 0x3FC80C /end MEASUREMENT
/begin MEASUREMENT mzyl_b2.ges_psau "Gesamtmasse/ASP aus psau" SWORD FORMULA_0104 0 0.0 -500.0 1500.0 READ_WRITE ECU_ADDRESS 0x3FC818 /end MEASUREMENT
/begin MEASUREMENT mzyl_b2.ges_roh "Ges.masse/ASP aus psau + EV-Verl" SWORD FORMULA_0104 0 0.0 -500.0 1500.0 READ_WRITE ECU_ADDRESS 0x3FC81A /end MEASUREMENT
/begin MEASUREMENT mzyl_b2.ges_rueck "Rueckstr. Gesamtmasse durch EV" SWORD FORMULA_0104 0 0.0 -500.0 1500.0 READ_WRITE ECU_ADDRESS 0x3FC82C /end MEASUREMENT
/begin MEASUREMENT mzyl_b2.ml_asp "Wirksame Luftmasse/ASP" SWORD FORMULA_0104 0 0.0 -500.0 1500.0 READ_WRITE ECU_ADDRESS 0x3FC810 /end MEASUREMENT
/begin MEASUREMENT mzyl_b2.ml_lam "Luftmasse aus Lambda" SWORD FORMULA_0104 0 0.0 -500.0 1500.0 READ_WRITE ECU_ADDRESS 0x3FC838 /end MEASUREMENT
/begin MEASUREMENT mzyl_b2.ml_psau "Luftmasse/ASP aus psau" SWORD FORMULA_0104 0 0.0 -500.0 1500.0 READ_WRITE ECU_ADDRESS 0x3FC816 /end MEASUREMENT
/begin MEASUREMENT mzyl_b2.ml_sum_sa "Summe Luftmassenstr. im ZUST_SA" SLONG FORMULA_0983 0 0.0 -214748364.8 214748364.7 READ_WRITE ECU_ADDRESS 0x3FC81C /end MEASUREMENT
/begin MEASUREMENT mzyl_b2.ml_sum_we "Summe Luftmassenstr. nach SA_WE" SLONG FORMULA_0983 0 0.0 -214748364.8 214748364.7 READ_WRITE ECU_ADDRESS 0x3FC820 /end MEASUREMENT
/begin MEASUREMENT mzyl_b2.mldt "Wirksamer Luftmassenstrom" SWORD FORMULA_0103 0 0.0 -100.0 1400.0 READ_WRITE ECU_ADDRESS 0x3FC814 /end MEASUREMENT
/begin MEASUREMENT mzyl_b2.phi_ev_mean "Durchflussbeiwert EV" SWORD FORMULA_0558 0 0.0 -9.999999747378752e-005 1.0 READ_WRITE ECU_ADDRESS 0x3FC82A /end MEASUREMENT
/begin MEASUREMENT mzyl_b2.pzyl "Zylinderinnendruck EV schliesst" SWORD FORMULA_0075 0 0.0 0.0 2000.0 READ_WRITE ECU_ADDRESS 0x3FC830 /end MEASUREMENT
/begin MEASUREMENT mzyl_b2.rf "Wirksames rf" SWORD FORMULA_0007 0 0.0 0.0 2.0 READ_WRITE ECU_ADDRESS 0x3FC812 /end MEASUREMENT
/begin MEASUREMENT mzyl_b2.rg_asp "Wirksame RG-Masse/ASP" SWORD FORMULA_0104 0 0.0 -500.0 1500.0 READ_WRITE ECU_ADDRESS 0x3FC80E /end MEASUREMENT
/begin MEASUREMENT mzyl_b2.t_ues_ev "Zeit Rueckstr. EV" UWORD FORMULA_0985 0 0.0 0.0 40.0 READ_WRITE ECU_ADDRESS 0x3FC82E /end MEASUREMENT
/begin MEASUREMENT mzyl_b2.w_ues_ev "Winkel Rueckstr. EV" SWORD FORMULA_0102 0 0.0 50.0 160.0 READ_WRITE ECU_ADDRESS 0x3FC828 /end MEASUREMENT
/begin MEASUREMENT mzyl_st "Status mzyl" UBYTE FORMULA_0986 0 0.0 0.0 255.0 READ_WRITE ECU_ADDRESS 0x3FC83C /end MEASUREMENT
/begin MEASUREMENT rf_aq_hfm_b1 "rf aus Kombination von aq und hfm bestimmt" SWORD FORMULA_0007 0 0.0 0.0 2.0 READ_WRITE ECU_ADDRESS 0x3FC846 /end MEASUREMENT
/begin MEASUREMENT rf_aq_hfm_b2 "rf aus Kombination von aq und hfm bestimmt" SWORD FORMULA_0007 0 0.0 0.0 2.0 READ_WRITE ECU_ADDRESS 0x3FC848 /end MEASUREMENT
/begin COMPU_METHOD FORMULA_0000 "FORMULA_0000" RAT_FUNC "%7.0" "-" COEFFS 0 1 0 0 0 1 /end COMPU_METHOD
/begin COMPU_METHOD FORMULA_0003 "FORMULA_0003" RAT_FUNC "%3.0" "-" COEFFS 0 1 0 0 0 1 /end COMPU_METHOD
/begin COMPU_METHOD FORMULA_0006 "FORMULA_0006" RAT_FUNC "%5.0" "Upm" COEFFS 0 1 0 0 0 1 /end COMPU_METHOD
/begin COMPU_METHOD FORMULA_0007 "FORMULA_0007" RAT_FUNC "%8.3" "-" COEFFS 0 10000.0 0.0 0 0.0 1.0 /end COMPU_METHOD
/begin COMPU_METHOD FORMULA_0008 "FORMULA_0008" RAT_FUNC "%6.1" "V" COEFFS 0 10.0 0.0 0 0.0 1.0 /end COMPU_METHOD
/begin COMPU_METHOD FORMULA_0010 "FORMULA_0010" RAT_FUNC "%5.0" "-" COEFFS 0 1 0 0 0 1 /end COMPU_METHOD
/begin COMPU_METHOD FORMULA_0021 "FORMULA_0021" RAT_FUNC "%7.2" "s" COEFFS 0 100.0 0.0 0 0.0 1.0 /end COMPU_METHOD
/begin COMPU_METHOD FORMULA_0023 "FORMULA_0023" RAT_FUNC "%6.1" "°C" COEFFS 0 10.0 2732.0 0 0.0 1.0 /end COMPU_METHOD
/begin COMPU_METHOD FORMULA_0024 "FORMULA_0024" RAT_FUNC "%9.4" "-" COEFFS 0 32768.0 0.0 0 0.0 1.0 /end COMPU_METHOD
/begin COMPU_METHOD FORMULA_0025 "FORMULA_0025" RAT_FUNC "%8.3" "-" COEFFS 0 16384.0 0.0 0 0.0 1.0 /end COMPU_METHOD
/begin COMPU_METHOD FORMULA_0037 "FORMULA_0037" RAT_FUNC "%5.2" "-" COEFFS 0 1 0 0 0 1 /end COMPU_METHOD
/begin COMPU_METHOD FORMULA_0044 "FORMULA_0044" RAT_FUNC "%9.2" "-" COEFFS 0 1 0 0 0 1 /end COMPU_METHOD
/begin COMPU_METHOD FORMULA_0071 "FORMULA_0071" RAT_FUNC "%6.1" "s" COEFFS 0 10.0 0.0 0 0.0 1.0 /end COMPU_METHOD
/begin COMPU_METHOD FORMULA_0073 "FORMULA_0073" RAT_FUNC "%8.3" "-" COEFFS 0 1024.0 0.0 0 0.0 1.0 /end COMPU_METHOD
/begin COMPU_METHOD FORMULA_0075 "FORMULA_0075" RAT_FUNC "%6.1" "mbar" COEFFS 0 16.0 0.0 0 0.0 1.0 /end COMPU_METHOD
/begin COMPU_METHOD FORMULA_0076 "FORMULA_0076" RAT_FUNC "%6.1" "km/h" COEFFS 0 16.0 0.0 0 0.0 1.0 /end COMPU_METHOD
/begin COMPU_METHOD FORMULA_0080 "FORMULA_0080" RAT_FUNC "%7.2" "-" COEFFS 0 1 0 0 0 1 /end COMPU_METHOD
/begin COMPU_METHOD FORMULA_0102 "FORMULA_0102" RAT_FUNC "%6.1" "°KW" COEFFS 0 10.0 0.0 0 0.0 1.0 /end COMPU_METHOD
/begin COMPU_METHOD FORMULA_0103 "FORMULA_0103" RAT_FUNC "%6.1" "kg/h" COEFFS 0 10.0 0.0 0 0.0 1.0 /end COMPU_METHOD
/begin COMPU_METHOD FORMULA_0104 "FORMULA_0104" RAT_FUNC "%6.1" "mg/asp" COEFFS 0 10.0 0.0 0 0.0 1.0 /end COMPU_METHOD
/begin COMPU_METHOD FORMULA_0106 "FORMULA_0106" RAT_FUNC "%7.2" "%" COEFFS 0 163.84 0.0 0 0.0 1.0 /end COMPU_METHOD
/begin COMPU_METHOD FORMULA_0109 "FORMULA_0109" RAT_FUNC "%7.2" "s" COEFFS 0 200.0 0.0 0 0.0 1.0 /end COMPU_METHOD
/begin COMPU_METHOD FORMULA_0114 "FORMULA_0114" RAT_FUNC "%5.0" "digit" COEFFS 0 1 0 0 0 1 /end COMPU_METHOD
/begin COMPU_METHOD FORMULA_0131 "FORMULA_0131" RAT_FUNC "%5.0" "bar/s" COEFFS 0 2.e-002 0.0 0 0.0 1.0 /end COMPU_METHOD
/begin COMPU_METHOD FORMULA_0143 "FORMULA_0143" RAT_FUNC "%6.1" "qmm" COEFFS 0 10.0 0.0 0 0.0 1.0 /end COMPU_METHOD
/begin COMPU_METHOD FORMULA_0147 "FORMULA_0147" RAT_FUNC "%9.2" "s" COEFFS 0 100.0 0.0 0 0.0 1.0 /end COMPU_METHOD
/begin COMPU_METHOD FORMULA_0214 "FORMULA_0214" RAT_FUNC "%3.0" "s" COEFFS 0 1 0 0 0 1 /end COMPU_METHOD
/begin COMPU_METHOD FORMULA_0215 "FORMULA_0215" TAB_VERB "%3.0" "-" COMPU_TAB_REF FORMULA_0215_VTAB /end COMPU_METHOD
/begin COMPU_METHOD FORMULA_0216 "FORMULA_0216" TAB_VERB "%3.0" "-" COMPU_TAB_REF FORMULA_0216_VTAB /end COMPU_METHOD
/begin COMPU_METHOD FORMULA_0218 "FORMULA_0218" TAB_VERB "%3.0" "-" COMPU_TAB_REF FORMULA_0218_VTAB /end COMPU_METHOD
/begin COMPU_METHOD FORMULA_0219 "FORMULA_0219" TAB_VERB "%3.0" "-" COMPU_TAB_REF FORMULA_0219_VTAB /end COMPU_METHOD
/begin COMPU_METHOD FORMULA_0220 "FORMULA_0220" TAB_VERB "%3.0" "-" COMPU_TAB_REF FORMULA_0220_VTAB /end COMPU_METHOD
/begin COMPU_METHOD FORMULA_0461 "FORMULA_0461" RAT_FUNC "%4.1" "s" COEFFS 0 10.0 0.0 0 0.0 1.0 /end COMPU_METHOD
/begin COMPU_METHOD FORMULA_0535 "FORMULA_0535" RAT_FUNC "%8.3" "mg/ASP" COEFFS 0 64.0 0.0 0 0.0 1.0 /end COMPU_METHOD
/begin COMPU_METHOD FORMULA_0536 "FORMULA_0536" RAT_FUNC "%5.0" "mV" COEFFS 0 0.2048 0.0 0 0.0 1.0 /end COMPU_METHOD
/begin COMPU_METHOD FORMULA_0541 "FORMULA_0541" RAT_FUNC "%6.1" "Ohm" COEFFS 0 10.0 0.0 0 0.0 1.0 /end COMPU_METHOD
/begin COMPU_METHOD FORMULA_0558 "FORMULA_0558" RAT_FUNC "%9.4" "-" COEFFS 0 10000.0 0.0 0 0.0 1.0 /end COMPU_METHOD
/begin COMPU_METHOD FORMULA_0593 "FORMULA_0593" RAT_FUNC "%5.0" "s" COEFFS 0 1 0 0 0 1 /end COMPU_METHOD
/begin COMPU_METHOD FORMULA_0638 "FORMULA_0638" RAT_FUNC "%5.2" "" COEFFS 0 128.0 0.0 0 0.0 1.0 /end COMPU_METHOD
/begin COMPU_METHOD FORMULA_0645 "FORMULA_0645" RAT_FUNC "%6.3" "s" COEFFS 0 0 1.28 0 1 0 /end COMPU_METHOD
/begin COMPU_METHOD FORMULA_0658 "FORMULA_0658" RAT_FUNC "%5.2" "s" COEFFS 0 0 2.56 0 1 0 /end COMPU_METHOD
/begin COMPU_METHOD FORMULA_0668 "FORMULA_0668" RAT_FUNC "%5.0" "ms" COEFFS 0 1.e-002 0.0 0 0.0 1.0 /end COMPU_METHOD
/begin COMPU_METHOD FORMULA_0672 "FORMULA_0672" RAT_FUNC "%5.0" "ms" COEFFS 0 0.1 0.0 0 0.0 1.0 /end COMPU_METHOD
/begin COMPU_METHOD FORMULA_0677 "FORMULA_0677" TAB_VERB "%3.0" "-" COMPU_TAB_REF FORMULA_0677_VTAB /end COMPU_METHOD
/begin COMPU_METHOD FORMULA_0679 "FORMULA_0679" RAT_FUNC "%5.2" "s" COEFFS 0 0 25.6 0 1 0 /end COMPU_METHOD
/begin COMPU_METHOD FORMULA_0754 "FORMULA_0754" RAT_FUNC "%7.2" "-" COEFFS 0 256.0 0.0 0 0.0 1.0 /end COMPU_METHOD
/begin COMPU_METHOD FORMULA_0767 "FORMULA_0767" TAB_VERB "%7.2" "-" COMPU_TAB_REF FORMULA_0767_VTAB /end COMPU_METHOD
/begin COMPU_METHOD FORMULA_0769 "FORMULA_0769" TAB_VERB "%7.2" "-" COMPU_TAB_REF FORMULA_0769_VTAB /end COMPU_METHOD
/begin COMPU_METHOD FORMULA_0770 "FORMULA_0770" TAB_VERB "%7.2" "-" COMPU_TAB_REF FORMULA_0770_VTAB /end COMPU_METHOD
/begin COMPU_METHOD FORMULA_0782 "FORMULA_0782" TAB_VERB "%7.2" "-" COMPU_TAB_REF FORMULA_0782_VTAB /end COMPU_METHOD
/begin COMPU_METHOD FORMULA_0784 "FORMULA_0784" TAB_VERB "%7.2" "-" COMPU_TAB_REF FORMULA_0784_VTAB /end COMPU_METHOD
/begin COMPU_METHOD FORMULA_0791 "FORMULA_0791" RAT_FUNC "%5.0" "°C" COEFFS 0 1 0 0 0 1 /end COMPU_METHOD
/begin COMPU_METHOD FORMULA_0792 "FORMULA_0792" RAT_FUNC "%5.0" "mg" COEFFS 0 1 0 0 0 1 /end COMPU_METHOD
/begin COMPU_METHOD FORMULA_0799 "FORMULA_0799" TAB_VERB "%7.2" "-" COMPU_TAB_REF FORMULA_0799_VTAB /end COMPU_METHOD
/begin COMPU_METHOD FORMULA_0800 "FORMULA_0800" RAT_FUNC "%5.0" "sec" COEFFS 0 1 0 0 0 1 /end COMPU_METHOD
/begin COMPU_METHOD FORMULA_0801 "FORMULA_0801" RAT_FUNC "%6.1" "°C" COEFFS 0 10.0 0.0 0 0.0 1.0 /end COMPU_METHOD
/begin COMPU_METHOD FORMULA_0810 "FORMULA_0810" TAB_VERB "%5.2" "-" COMPU_TAB_REF FORMULA_0810_VTAB /end COMPU_METHOD
/begin COMPU_METHOD FORMULA_0811 "FORMULA_0811" TAB_VERB "%7.2" "-" COMPU_TAB_REF FORMULA_0811_VTAB /end COMPU_METHOD
/begin COMPU_METHOD FORMULA_0812 "FORMULA_0812" TAB_VERB "%7.2" "-" COMPU_TAB_REF FORMULA_0812_VTAB /end COMPU_METHOD
/begin COMPU_METHOD FORMULA_0813 "FORMULA_0813" TAB_VERB "%7.2" "-" COMPU_TAB_REF FORMULA_0813_VTAB /end COMPU_METHOD
/begin COMPU_METHOD FORMULA_0814 "FORMULA_0814" TAB_VERB "%7.2" "-" COMPU_TAB_REF FORMULA_0814_VTAB /end COMPU_METHOD
/begin COMPU_METHOD FORMULA_0815 "FORMULA_0815" TAB_VERB "%7.2" "-" COMPU_TAB_REF FORMULA_0815_VTAB /end COMPU_METHOD
/begin COMPU_METHOD FORMULA_0816 "FORMULA_0816" TAB_VERB "%7.2" "-" COMPU_TAB_REF FORMULA_0816_VTAB /end COMPU_METHOD
/begin COMPU_METHOD FORMULA_0817 "FORMULA_0817" TAB_VERB "%7.2" "-" COMPU_TAB_REF FORMULA_0817_VTAB /end COMPU_METHOD
/begin COMPU_METHOD FORMULA_0818 "FORMULA_0818" TAB_VERB "%7.2" "-" COMPU_TAB_REF FORMULA_0818_VTAB /end COMPU_METHOD
/begin COMPU_METHOD FORMULA_0819 "FORMULA_0819" TAB_VERB "%7.2" "-" COMPU_TAB_REF FORMULA_0819_VTAB /end COMPU_METHOD
/begin COMPU_METHOD FORMULA_0820 "FORMULA_0820" TAB_VERB "%7.2" "-" COMPU_TAB_REF FORMULA_0820_VTAB /end COMPU_METHOD
/begin COMPU_METHOD FORMULA_0821 "FORMULA_0821" TAB_VERB "%7.2" "-" COMPU_TAB_REF FORMULA_0821_VTAB /end COMPU_METHOD
/begin COMPU_METHOD FORMULA_0822 "FORMULA_0822" TAB_VERB "%7.2" "-" COMPU_TAB_REF FORMULA_0822_VTAB /end COMPU_METHOD
/begin COMPU_METHOD FORMULA_0823 "FORMULA_0823" TAB_VERB "%7.2" "-" COMPU_TAB_REF FORMULA_0823_VTAB /end COMPU_METHOD
/begin COMPU_METHOD FORMULA_0824 "FORMULA_0824" TAB_VERB "%7.2" "-" COMPU_TAB_REF FORMULA_0824_VTAB /end COMPU_METHOD
/begin COMPU_METHOD FORMULA_0825 "FORMULA_0825" TAB_VERB "%7.2" "-" COMPU_TAB_REF FORMULA_0825_VTAB /end COMPU_METHOD
/begin COMPU_METHOD FORMULA_0826 "FORMULA_0826" TAB_VERB "%7.2" "-" COMPU_TAB_REF FORMULA_0826_VTAB /end COMPU_METHOD
/begin COMPU_METHOD FORMULA_0827 "FORMULA_0827" TAB_VERB "%7.2" "-" COMPU_TAB_REF FORMULA_0827_VTAB /end COMPU_METHOD
/begin COMPU_METHOD FORMULA_0828 "FORMULA_0828" TAB_VERB "%7.2" "-" COMPU_TAB_REF FORMULA_0828_VTAB /end COMPU_METHOD
/begin COMPU_METHOD FORMULA_0829 "FORMULA_0829" TAB_VERB "%7.2" "-" COMPU_TAB_REF FORMULA_0829_VTAB /end COMPU_METHOD
/begin COMPU_METHOD FORMULA_0830 "FORMULA_0830" RAT_FUNC "%7.2" "-" COEFFS 0 255.0 0.0 0 0.0 1.0 /end COMPU_METHOD
/begin COMPU_METHOD FORMULA_0831 "FORMULA_0831" TAB_VERB "%5.2" "-" COMPU_TAB_REF FORMULA_0831_VTAB /end COMPU_METHOD
/begin COMPU_METHOD FORMULA_0832 "FORMULA_0832" TAB_VERB "%7.2" "-" COMPU_TAB_REF FORMULA_0832_VTAB /end COMPU_METHOD
/begin COMPU_METHOD FORMULA_0833 "FORMULA_0833" TAB_VERB "%7.2" "-" COMPU_TAB_REF FORMULA_0833_VTAB /end COMPU_METHOD
/begin COMPU_METHOD FORMULA_0834 "FORMULA_0834" TAB_VERB "%7.2" "-" COMPU_TAB_REF FORMULA_0834_VTAB /end COMPU_METHOD
/begin COMPU_METHOD FORMULA_0835 "FORMULA_0835" TAB_VERB "%7.2" "-" COMPU_TAB_REF FORMULA_0835_VTAB /end COMPU_METHOD
/begin COMPU_METHOD FORMULA_0836 "FORMULA_0836" TAB_VERB "%7.2" "-" COMPU_TAB_REF FORMULA_0836_VTAB /end COMPU_METHOD
/begin COMPU_METHOD FORMULA_0837 "FORMULA_0837" TAB_VERB "%7.2" "-" COMPU_TAB_REF FORMULA_0837_VTAB /end COMPU_METHOD
/begin COMPU_METHOD FORMULA_0838 "FORMULA_0838" TAB_VERB "%7.2" "-" COMPU_TAB_REF FORMULA_0838_VTAB /end COMPU_METHOD
/begin COMPU_METHOD FORMULA_0839 "FORMULA_0839" TAB_VERB "%7.2" "-" COMPU_TAB_REF FORMULA_0839_VTAB /end COMPU_METHOD
/begin COMPU_METHOD FORMULA_0840 "FORMULA_0840" TAB_VERB "%7.2" "-" COMPU_TAB_REF FORMULA_0840_VTAB /end COMPU_METHOD
/begin COMPU_METHOD FORMULA_0841 "FORMULA_0841" TAB_VERB "%7.2" "-" COMPU_TAB_REF FORMULA_0841_VTAB /end COMPU_METHOD
/begin COMPU_METHOD FORMULA_0842 "FORMULA_0842" TAB_VERB "%7.2" "-" COMPU_TAB_REF FORMULA_0842_VTAB /end COMPU_METHOD
/begin COMPU_METHOD FORMULA_0843 "FORMULA_0843" TAB_VERB "%7.2" "-" COMPU_TAB_REF FORMULA_0843_VTAB /end COMPU_METHOD
/begin COMPU_METHOD FORMULA_0844 "FORMULA_0844" TAB_VERB "%7.2" "-" COMPU_TAB_REF FORMULA_0844_VTAB /end COMPU_METHOD
/begin COMPU_METHOD FORMULA_0845 "FORMULA_0845" TAB_VERB "%7.2" "-" COMPU_TAB_REF FORMULA_0845_VTAB /end COMPU_METHOD
/begin COMPU_METHOD FORMULA_0846 "FORMULA_0846" TAB_VERB "%7.2" "-" COMPU_TAB_REF FORMULA_0846_VTAB /end COMPU_METHOD
/begin COMPU_METHOD FORMULA_0847 "FORMULA_0847" TAB_VERB "%7.2" "-" COMPU_TAB_REF FORMULA_0847_VTAB /end COMPU_METHOD
/begin COMPU_METHOD FORMULA_0848 "FORMULA_0848" TAB_VERB "%7.2" "-" COMPU_TAB_REF FORMULA_0848_VTAB /end COMPU_METHOD
/begin COMPU_METHOD FORMULA_0849 "FORMULA_0849" TAB_VERB "%7.2" "-" COMPU_TAB_REF FORMULA_0849_VTAB /end COMPU_METHOD
/begin COMPU_METHOD FORMULA_0850 "FORMULA_0850" TAB_VERB "%7.2" "-" COMPU_TAB_REF FORMULA_0850_VTAB /end COMPU_METHOD
/begin COMPU_METHOD FORMULA_0851 "FORMULA_0851" TAB_VERB "%7.2" "-" COMPU_TAB_REF FORMULA_0851_VTAB /end COMPU_METHOD
/begin COMPU_METHOD FORMULA_0852 "FORMULA_0852" TAB_VERB "%7.2" "-" COMPU_TAB_REF FORMULA_0852_VTAB /end COMPU_METHOD
/begin COMPU_METHOD FORMULA_0853 "FORMULA_0853" TAB_VERB "%7.2" "-" COMPU_TAB_REF FORMULA_0853_VTAB /end COMPU_METHOD
/begin COMPU_METHOD FORMULA_0854 "FORMULA_0854" RAT_FUNC "%5.0" "s" COEFFS 0 10.0 0.0 0 0.0 1.0 /end COMPU_METHOD
/begin COMPU_METHOD FORMULA_0855 "FORMULA_0855" TAB_VERB "%7.2" "-" COMPU_TAB_REF FORMULA_0855_VTAB /end COMPU_METHOD
/begin COMPU_METHOD FORMULA_0856 "FORMULA_0856" TAB_VERB "%7.2" "-" COMPU_TAB_REF FORMULA_0856_VTAB /end COMPU_METHOD
/begin COMPU_METHOD FORMULA_0857 "FORMULA_0857" TAB_VERB "%7.2" "-" COMPU_TAB_REF FORMULA_0857_VTAB /end COMPU_METHOD
/begin COMPU_METHOD FORMULA_0858 "FORMULA_0858" TAB_VERB "%7.2" "-" COMPU_TAB_REF FORMULA_0858_VTAB /end COMPU_METHOD
/begin COMPU_METHOD FORMULA_0859 "FORMULA_0859" TAB_VERB "%7.2" "-" COMPU_TAB_REF FORMULA_0859_VTAB /end COMPU_METHOD
/begin COMPU_METHOD FORMULA_0860 "FORMULA_0860" TAB_VERB "%7.2" "-" COMPU_TAB_REF FORMULA_0860_VTAB /end COMPU_METHOD
/begin COMPU_METHOD FORMULA_0861 "FORMULA_0861" TAB_VERB "%7.2" "-" COMPU_TAB_REF FORMULA_0861_VTAB /end COMPU_METHOD
/begin COMPU_METHOD FORMULA_0862 "FORMULA_0862" TAB_VERB "%7.2" "-" COMPU_TAB_REF FORMULA_0862_VTAB /end COMPU_METHOD
/begin COMPU_METHOD FORMULA_0863 "FORMULA_0863" TAB_VERB "%7.2" "-" COMPU_TAB_REF FORMULA_0863_VTAB /end COMPU_METHOD
/begin COMPU_METHOD FORMULA_0917 "FORMULA_0917" TAB_VERB "%7.2" "-" COMPU_TAB_REF FORMULA_0917_VTAB /end COMPU_METHOD
/begin COMPU_METHOD FORMULA_0918 "FORMULA_0918" TAB_VERB "%7.2" "-" COMPU_TAB_REF FORMULA_0918_VTAB /end COMPU_METHOD
/begin COMPU_METHOD FORMULA_0919 "FORMULA_0919" TAB_VERB "%7.2" "-" COMPU_TAB_REF FORMULA_0919_VTAB /end COMPU_METHOD
/begin COMPU_METHOD FORMULA_0920 "FORMULA_0920" RAT_FUNC "%7.2" "%" COEFFS 0 81.92 0.0 0 0.0 1.0 /end COMPU_METHOD
/begin COMPU_METHOD FORMULA_0921 "FORMULA_0921" RAT_FUNC "%5.0" "s" COEFFS 0 100.0 0.0 0 0.0 1.0 /end COMPU_METHOD
/begin COMPU_METHOD FORMULA_0922 "FORMULA_0922" TAB_VERB "%7.2" "-" COMPU_TAB_REF FORMULA_0922_VTAB /end COMPU_METHOD
/begin COMPU_METHOD FORMULA_0923 "FORMULA_0923" TAB_VERB "%7.2" "-" COMPU_TAB_REF FORMULA_0923_VTAB /end COMPU_METHOD
/begin COMPU_METHOD FORMULA_0924 "FORMULA_0924" TAB_VERB "%7.2" "-" COMPU_TAB_REF FORMULA_0924_VTAB /end COMPU_METHOD
/begin COMPU_METHOD FORMULA_0925 "FORMULA_0925" RAT_FUNC "%7.2" "A" COEFFS 0 215.0 0.0 0 0.0 1.0 /end COMPU_METHOD
/begin COMPU_METHOD FORMULA_0926 "FORMULA_0926" TAB_VERB "%7.2" "-" COMPU_TAB_REF FORMULA_0926_VTAB /end COMPU_METHOD
/begin COMPU_METHOD FORMULA_0927 "FORMULA_0927" TAB_VERB "%7.2" "-" COMPU_TAB_REF FORMULA_0927_VTAB /end COMPU_METHOD
/begin COMPU_METHOD FORMULA_0928 "FORMULA_0928" TAB_VERB "%7.2" "-" COMPU_TAB_REF FORMULA_0928_VTAB /end COMPU_METHOD
/begin COMPU_METHOD FORMULA_0929 "FORMULA_0929" TAB_VERB "%7.2" "-" COMPU_TAB_REF FORMULA_0929_VTAB /end COMPU_METHOD
/begin COMPU_METHOD FORMULA_0930 "FORMULA_0930" TAB_VERB "%7.2" "-" COMPU_TAB_REF FORMULA_0930_VTAB /end COMPU_METHOD
/begin COMPU_METHOD FORMULA_0931 "FORMULA_0931" TAB_VERB "%7.2" "-" COMPU_TAB_REF FORMULA_0931_VTAB /end COMPU_METHOD
/begin COMPU_METHOD FORMULA_0932 "FORMULA_0932" TAB_VERB "%7.2" "-" COMPU_TAB_REF FORMULA_0932_VTAB /end COMPU_METHOD
/begin COMPU_METHOD FORMULA_0933 "FORMULA_0933" TAB_VERB "%7.2" "-" COMPU_TAB_REF FORMULA_0933_VTAB /end COMPU_METHOD
/begin COMPU_METHOD FORMULA_0934 "FORMULA_0934" RAT_FUNC "%5.0" "mV" COEFFS 0 0.2048 0.0 0 0.0 1.0 /end COMPU_METHOD
/begin COMPU_METHOD FORMULA_0935 "FORMULA_0935" RAT_FUNC "%7.2" "%" COEFFS 0 20.48 0.0 0 0.0 1.0 /end COMPU_METHOD
/begin COMPU_METHOD FORMULA_0936 "FORMULA_0936" RAT_FUNC "%7.2" "%/s" COEFFS 0 20.48 0.0 0 0.0 1.0 /end COMPU_METHOD
/begin COMPU_METHOD FORMULA_0937 "FORMULA_0937" RAT_FUNC "%3.0" "s" COEFFS 0 10.0 0.0 0 0.0 1.0 /end COMPU_METHOD
/begin COMPU_METHOD FORMULA_0938 "FORMULA_0938" TAB_VERB "%7.2" "-" COMPU_TAB_REF FORMULA_0938_VTAB /end COMPU_METHOD
/begin COMPU_METHOD FORMULA_0939 "FORMULA_0939" TAB_VERB "%7.2" "-" COMPU_TAB_REF FORMULA_0939_VTAB /end COMPU_METHOD
/begin COMPU_METHOD FORMULA_0940 "FORMULA_0940" TAB_VERB "%7.2" "-" COMPU_TAB_REF FORMULA_0940_VTAB /end COMPU_METHOD
/begin COMPU_METHOD FORMULA_0941 "FORMULA_0941" TAB_VERB "%7.2" "-" COMPU_TAB_REF FORMULA_0941_VTAB /end COMPU_METHOD
/begin COMPU_METHOD FORMULA_0942 "FORMULA_0942" TAB_VERB "%7.2" "-" COMPU_TAB_REF FORMULA_0942_VTAB /end COMPU_METHOD
/begin COMPU_METHOD FORMULA_0943 "FORMULA_0943" TAB_VERB "%7.2" "-" COMPU_TAB_REF FORMULA_0943_VTAB /end COMPU_METHOD
/begin COMPU_METHOD FORMULA_0944 "FORMULA_0944" TAB_VERB "%7.2" "-" COMPU_TAB_REF FORMULA_0944_VTAB /end COMPU_METHOD
/begin COMPU_METHOD FORMULA_0945 "FORMULA_0945" TAB_VERB "%7.2" "-" COMPU_TAB_REF FORMULA_0945_VTAB /end COMPU_METHOD
/begin COMPU_METHOD FORMULA_0946 "FORMULA_0946" TAB_VERB "%7.2" "-" COMPU_TAB_REF FORMULA_0946_VTAB /end COMPU_METHOD
/begin COMPU_METHOD FORMULA_0947 "FORMULA_0947" RAT_FUNC "%7.2" "%/°C" COEFFS 0 1024.0 0.0 0 0.0 1.0 /end COMPU_METHOD
/begin COMPU_METHOD FORMULA_0948 "FORMULA_0948" RAT_FUNC "%6.1" "V/s" COEFFS 0 10.0 0.0 0 0.0 1.0 /end COMPU_METHOD
/begin COMPU_METHOD FORMULA_0949 "FORMULA_0949" RAT_FUNC "%5.0" "-" COEFFS 0 1.e-002 0.0 0 0.0 1.0 /end COMPU_METHOD
/begin COMPU_METHOD FORMULA_0950 "FORMULA_0950" TAB_VERB "%7.2" "-" COMPU_TAB_REF FORMULA_0950_VTAB /end COMPU_METHOD
/begin COMPU_METHOD FORMULA_0951 "FORMULA_0951" RAT_FUNC "%5.0" "-" COEFFS 0 32768.0 0.0 0 0.0 1.0 /end COMPU_METHOD
/begin COMPU_METHOD FORMULA_0952 "FORMULA_0952" TAB_VERB "%3.0" "-" COMPU_TAB_REF FORMULA_0952_VTAB /end COMPU_METHOD
/begin COMPU_METHOD FORMULA_0953 "FORMULA_0953" TAB_VERB "%3.0" "-" COMPU_TAB_REF FORMULA_0953_VTAB /end COMPU_METHOD
/begin COMPU_METHOD FORMULA_0954 "FORMULA_0954" TAB_VERB "%3.0" "-" COMPU_TAB_REF FORMULA_0954_VTAB /end COMPU_METHOD
/begin COMPU_METHOD FORMULA_0955 "FORMULA_0955" TAB_VERB "%5.2" "-" COMPU_TAB_REF FORMULA_0955_VTAB /end COMPU_METHOD
/begin COMPU_METHOD FORMULA_0956 "FORMULA_0956" TAB_VERB "%5.2" "-" COMPU_TAB_REF FORMULA_0956_VTAB /end COMPU_METHOD
/begin COMPU_METHOD FORMULA_0957 "FORMULA_0957" TAB_VERB "%3.0" "-" COMPU_TAB_REF FORMULA_0957_VTAB /end COMPU_METHOD
/begin COMPU_METHOD FORMULA_0958 "FORMULA_0958" TAB_VERB "%3.0" "-" COMPU_TAB_REF FORMULA_0958_VTAB /end COMPU_METHOD
/begin COMPU_METHOD FORMULA_0959 "FORMULA_0959" TAB_VERB "%5.0" "-" COMPU_TAB_REF FORMULA_0959_VTAB /end COMPU_METHOD
/begin COMPU_METHOD FORMULA_0960 "FORMULA_0960" TAB_VERB "%3.0" "-" COMPU_TAB_REF FORMULA_0960_VTAB /end COMPU_METHOD
/begin COMPU_METHOD FORMULA_0961 "FORMULA_0961" TAB_VERB "%5.2" "-" COMPU_TAB_REF FORMULA_0961_VTAB /end COMPU_METHOD
/begin COMPU_METHOD FORMULA_0962 "FORMULA_0962" RAT_FUNC "%9.4" "g" COEFFS 0 512.0 0.0 0 0.0 1.0 /end COMPU_METHOD
/begin COMPU_METHOD FORMULA_0963 "FORMULA_0963" RAT_FUNC "%11.4" "kg/h" COEFFS 0 512.0 0.0 0 0.0 1.0 /end COMPU_METHOD
/begin COMPU_METHOD FORMULA_0964 "FORMULA_0964" TAB_VERB "%5.2" "-" COMPU_TAB_REF FORMULA_0964_VTAB /end COMPU_METHOD
/begin COMPU_METHOD FORMULA_0965 "FORMULA_0965" RAT_FUNC "%9.4" "kg/h" COEFFS 0 512.0 0.0 0 0.0 1.0 /end COMPU_METHOD
/begin COMPU_METHOD FORMULA_0966 "FORMULA_0966" RAT_FUNC "%8.1" "(kg/h)/mbar2^20" COEFFS 0 16.0 0.0 0 0.0 1.0 /end COMPU_METHOD
/begin COMPU_METHOD FORMULA_0967 "FORMULA_0967" RAT_FUNC "%7.2" "(kg/h)/mbar" COEFFS 0 1024.0 0.0 0 0.0 1.0 /end COMPU_METHOD
/begin COMPU_METHOD FORMULA_0968 "FORMULA_0968" RAT_FUNC "%11.4" "Pa/s" COEFFS 0 1600.0 0.0 0 0.0 1.0 /end COMPU_METHOD
/begin COMPU_METHOD FORMULA_0969 "FORMULA_0969" TAB_VERB "%5.2" "-" COMPU_TAB_REF FORMULA_0969_VTAB /end COMPU_METHOD
/begin COMPU_METHOD FORMULA_0970 "FORMULA_0970" TAB_VERB "%5.2" "-" COMPU_TAB_REF FORMULA_0970_VTAB /end COMPU_METHOD
/begin COMPU_METHOD FORMULA_0971 "FORMULA_0971" RAT_FUNC "%5.0" "mbar" COEFFS 0 16.0 0.0 0 0.0 1.0 /end COMPU_METHOD
/begin COMPU_METHOD FORMULA_0972 "FORMULA_0972" RAT_FUNC "%7.2" "s" COEFFS 0 0 327.67 0 1 0 /end COMPU_METHOD
/begin COMPU_METHOD FORMULA_0973 "FORMULA_0973" RAT_FUNC "%8.3" "mbar" COEFFS 0 16.0 0.0 0 0.0 1.0 /end COMPU_METHOD
/begin COMPU_METHOD FORMULA_0974 "FORMULA_0974" RAT_FUNC "%8.3" "°C" COEFFS 0 10.0 2732.0 0 0.0 1.0 /end COMPU_METHOD
/begin COMPU_METHOD FORMULA_0975 "FORMULA_0975" RAT_FUNC "%8.3" "mbar/V" COEFFS 0 80.0 0.0 0 0.0 1.0 /end COMPU_METHOD
/begin COMPU_METHOD FORMULA_0976 "FORMULA_0976" RAT_FUNC "%8.3" "s" COEFFS 0 0 327.67 0 1 0 /end COMPU_METHOD
/begin COMPU_METHOD FORMULA_0977 "FORMULA_0977" TAB_VERB "%5.2" "-" COMPU_TAB_REF FORMULA_0977_VTAB /end COMPU_METHOD
/begin COMPU_METHOD FORMULA_0978 "FORMULA_0978" RAT_FUNC "%8.3" "(kg/h)/mbar" COEFFS 0 1024.0 0.0 0 0.0 1.0 /end COMPU_METHOD
/begin COMPU_METHOD FORMULA_0979 "FORMULA_0979" RAT_FUNC "%7.2" "kg/h" COEFFS 0 80.0 0.0 0 0.0 1.0 /end COMPU_METHOD
/begin COMPU_METHOD FORMULA_0980 "FORMULA_0980" RAT_FUNC "%7.2" "1/2^20" COEFFS 0 16.0 0.0 0 0.0 1.0 /end COMPU_METHOD
/begin COMPU_METHOD FORMULA_0981 "FORMULA_0981" RAT_FUNC "%6.1" "1/2^20" COEFFS 0 16.0 0.0 0 0.0 1.0 /end COMPU_METHOD
/begin COMPU_METHOD FORMULA_0982 "FORMULA_0982" RAT_FUNC "%8.1" "ccm" COEFFS 0 10.0 0.0 0 0.0 1.0 /end COMPU_METHOD
/begin COMPU_METHOD FORMULA_0983 "FORMULA_0983" RAT_FUNC "%8.1" "mg" COEFFS 0 10.0 0.0 0 0.0 1.0 /end COMPU_METHOD
/begin COMPU_METHOD FORMULA_0984 "FORMULA_0984" RAT_FUNC "%8.3" "qcm" COEFFS 0 1000.0 0.0 0 0.0 1.0 /end COMPU_METHOD
/begin COMPU_METHOD FORMULA_0985 "FORMULA_0985" RAT_FUNC "%7.2" "ms" COEFFS 0 100.0 0.0 0 0.0 1.0 /end COMPU_METHOD
/begin COMPU_METHOD FORMULA_0986 "FORMULA_0986" TAB_VERB "%3.0" "-" COMPU_TAB_REF FORMULA_0986_VTAB /end COMPU_METHOD
/begin COMPU_METHOD FORMULA_0987 "FORMULA_0987" TAB_VERB "%5.2" "-" COMPU_TAB_REF FORMULA_0987_VTAB /end COMPU_METHOD
/begin COMPU_METHOD FORMULA_0988 "FORMULA_0988" TAB_VERB "%5.2" "-" COMPU_TAB_REF FORMULA_0988_VTAB /end COMPU_METHOD
/begin COMPU_METHOD FORMULA_0989 "FORMULA_0989" TAB_VERB "%5.2" "-" COMPU_TAB_REF FORMULA_0989_VTAB /end COMPU_METHOD
/begin COMPU_METHOD FORMULA_0990 "FORMULA_0990" RAT_FUNC "%6.1" "J/K*mol" COEFFS 0 10.0 0.0 0 0.0 1.0 /end COMPU_METHOD
/begin COMPU_METHOD FORMULA_0991 "FORMULA_0991" RAT_FUNC "%9.4" "-/tseg" COEFFS 0 10000.0 0.0 0 0.0 1.0 /end COMPU_METHOD
/begin COMPU_VTAB FORMULA_0215_VTAB "FORMULA_0215_VTAB" TAB_VERB 4 0 "k. Aenderung" 1 "Aus" 2 "Ein" 4 "Sport" DEFAULT_VALUE "undef" /end COMPU_VTAB
/begin COMPU_VTAB FORMULA_0216_VTAB "FORMULA_0216_VTAB" TAB_VERB 3 0 "k. Aenderung" 1 "Automat" 2 "Sequentiell" DEFAULT_VALUE "undef" /end COMPU_VTAB
/begin COMPU_VTAB FORMULA_0218_VTAB "FORMULA_0218_VTAB" TAB_VERB 4 0 "k. Aenderung" 1 "Komfort" 2 "Normal" 3 "Sport" DEFAULT_VALUE "undef" /end COMPU_VTAB
/begin COMPU_VTAB FORMULA_0219_VTAB "FORMULA_0219_VTAB" TAB_VERB 4 0 "k. Aenderung" 1 "KL1" 2 "KL2" 3 "KL3" DEFAULT_VALUE "undef" /end COMPU_VTAB
/begin COMPU_VTAB FORMULA_0220_VTAB "FORMULA_0220_VTAB" TAB_VERB 2 0 "k. Aenderung" 1 "M-Cfg" DEFAULT_VALUE "undef" /end COMPU_VTAB
/begin COMPU_VTAB FORMULA_0677_VTAB "FORMULA_0677_VTAB" TAB_VERB 7 0 "inaktiv" 1 "Bedingungen nicht erfuellt" 5 "aktiv" 6 "beendet" 7 "Abbruch" 8 "beendet niO" 9 "beendet iO" DEFAULT_VALUE "undef" /end COMPU_VTAB
/begin COMPU_VTAB FORMULA_0767_VTAB "FORMULA_0767_VTAB" TAB_VERB 1 0 "inaktiv" DEFAULT_VALUE "aktiv" /end COMPU_VTAB
/begin COMPU_VTAB FORMULA_0769_VTAB "FORMULA_0769_VTAB" TAB_VERB 1 0 "inaktiv" DEFAULT_VALUE "aktiv" /end COMPU_VTAB
/begin COMPU_VTAB FORMULA_0770_VTAB "FORMULA_0770_VTAB" TAB_VERB 1 0 "inaktiv" DEFAULT_VALUE "aktiv" /end COMPU_VTAB
/begin COMPU_VTAB FORMULA_0782_VTAB "FORMULA_0782_VTAB" TAB_VERB 2 0 "automatisch" 1 "manuell" /end COMPU_VTAB
/begin COMPU_VTAB FORMULA_0784_VTAB "FORMULA_0784_VTAB" TAB_VERB 2 0 "ADAPTION" 1 "RESET" /end COMPU_VTAB
/begin COMPU_VTAB FORMULA_0799_VTAB "FORMULA_0799_VTAB" TAB_VERB 2 0 "inaktiv" 1 "aktiv" /end COMPU_VTAB
/begin COMPU_VTAB FORMULA_0810_VTAB "FORMULA_0810_VTAB" TAB_VERB 3 0 "unplausibel" 1 "mager" 2 "fett" /end COMPU_VTAB
/begin COMPU_VTAB FORMULA_0811_VTAB "FORMULA_0811_VTAB" TAB_VERB 5 0 "-" 1 "Sonde AUS" 2 "UEBERW.EIN" 4 "Sonde EIN" 8 "UEBERW.AUS" /end COMPU_VTAB
/begin COMPU_VTAB FORMULA_0812_VTAB "FORMULA_0812_VTAB" TAB_VERB 1 0 "Einschwingzeit aktiv" DEFAULT_VALUE "Einschwingzeit abgelaufen" /end COMPU_VTAB
/begin COMPU_VTAB FORMULA_0813_VTAB "FORMULA_0813_VTAB" TAB_VERB 1 0 "i.O." DEFAULT_VALUE "n.i.O." /end COMPU_VTAB
/begin COMPU_VTAB FORMULA_0814_VTAB "FORMULA_0814_VTAB" TAB_VERB 1 0 "i.O." DEFAULT_VALUE "n.i.O." /end COMPU_VTAB
/begin COMPU_VTAB FORMULA_0815_VTAB "FORMULA_0815_VTAB" TAB_VERB 1 0 "i.O." DEFAULT_VALUE "n.i.O." /end COMPU_VTAB
/begin COMPU_VTAB FORMULA_0816_VTAB "FORMULA_0816_VTAB" TAB_VERB 1 0 "i.O." DEFAULT_VALUE "n.i.O." /end COMPU_VTAB
/begin COMPU_VTAB FORMULA_0817_VTAB "FORMULA_0817_VTAB" TAB_VERB 1 0 "i.O." DEFAULT_VALUE "SH_TO_UB" /end COMPU_VTAB
/begin COMPU_VTAB FORMULA_0818_VTAB "FORMULA_0818_VTAB" TAB_VERB 1 0 "i.O." DEFAULT_VALUE "SH_TO_GND" /end COMPU_VTAB
/begin COMPU_VTAB FORMULA_0819_VTAB "FORMULA_0819_VTAB" TAB_VERB 1 0 "i.O." DEFAULT_VALUE "openload" /end COMPU_VTAB
/begin COMPU_VTAB FORMULA_0820_VTAB "FORMULA_0820_VTAB" TAB_VERB 1 0 "n.i.O." DEFAULT_VALUE "Temp. i.O." /end COMPU_VTAB
/begin COMPU_VTAB FORMULA_0821_VTAB "FORMULA_0821_VTAB" TAB_VERB 1 0 "n.i.O." DEFAULT_VALUE "Signal i.O." /end COMPU_VTAB
/begin COMPU_VTAB FORMULA_0822_VTAB "FORMULA_0822_VTAB" TAB_VERB 1 0 "inaktive Diag." DEFAULT_VALUE "aktive Diag." /end COMPU_VTAB
/begin COMPU_VTAB FORMULA_0823_VTAB "FORMULA_0823_VTAB" TAB_VERB 1 0 "nicht beendet" DEFAULT_VALUE "Diag. abgelaufen" /end COMPU_VTAB
/begin COMPU_VTAB FORMULA_0824_VTAB "FORMULA_0824_VTAB" TAB_VERB 1 0 "nicht erfuellt" DEFAULT_VALUE "def. SA-Phase" /end COMPU_VTAB
/begin COMPU_VTAB FORMULA_0825_VTAB "FORMULA_0825_VTAB" TAB_VERB 1 0 "-" DEFAULT_VALUE "Zeit ist beendet" /end COMPU_VTAB
/begin COMPU_VTAB FORMULA_0826_VTAB "FORMULA_0826_VTAB" TAB_VERB 1 0 "-" DEFAULT_VALUE "Anfettung ist beendet" /end COMPU_VTAB
/begin COMPU_VTAB FORMULA_0827_VTAB "FORMULA_0827_VTAB" TAB_VERB 1 0 "inaktiv" DEFAULT_VALUE "aktiv" /end COMPU_VTAB
/begin COMPU_VTAB FORMULA_0828_VTAB "FORMULA_0828_VTAB" TAB_VERB 1 0 "aus MAGER" DEFAULT_VALUE "aus FETT" /end COMPU_VTAB
/begin COMPU_VTAB FORMULA_0829_VTAB "FORMULA_0829_VTAB" TAB_VERB 1 0 "kein WE" DEFAULT_VALUE "WE erkannt" /end COMPU_VTAB
/begin COMPU_VTAB FORMULA_0831_VTAB "FORMULA_0831_VTAB" TAB_VERB 2 0 "inaktiv" 1 "aktiv" /end COMPU_VTAB
/begin COMPU_VTAB FORMULA_0832_VTAB "FORMULA_0832_VTAB" TAB_VERB 1 0 "kein OPENLOAD" DEFAULT_VALUE "IA-OPENLOAD" /end COMPU_VTAB
/begin COMPU_VTAB FORMULA_0833_VTAB "FORMULA_0833_VTAB" TAB_VERB 1 0 "kein OPENLOAD" DEFAULT_VALUE "IP/VM-OPENLOAD" /end COMPU_VTAB
/begin COMPU_VTAB FORMULA_0834_VTAB "FORMULA_0834_VTAB" TAB_VERB 1 0 "kein OPENLOAD" DEFAULT_VALUE "UN-OPENLOAD" /end COMPU_VTAB
/begin COMPU_VTAB FORMULA_0835_VTAB "FORMULA_0835_VTAB" TAB_VERB 1 0 "kein OPENLOAD" DEFAULT_VALUE "IP/VM-OPENLOAD" /end COMPU_VTAB
/begin COMPU_VTAB FORMULA_0836_VTAB "FORMULA_0836_VTAB" TAB_VERB 1 0 "kein OPENLOAD" DEFAULT_VALUE "IP/VM-VERDACHT" /end COMPU_VTAB
/begin COMPU_VTAB FORMULA_0837_VTAB "FORMULA_0837_VTAB" TAB_VERB 1 0 "Diag aktiv" DEFAULT_VALUE "Ausserhalb Band" /end COMPU_VTAB
/begin COMPU_VTAB FORMULA_0838_VTAB "FORMULA_0838_VTAB" TAB_VERB 4 1 "Diag. aktiv" 3 "FETT-Plausi" 5 "MAGER-Plausi" 9 "IP/VM-Plausi" DEFAULT_VALUE "inaktiv" /end COMPU_VTAB
/begin COMPU_VTAB FORMULA_0839_VTAB "FORMULA_0839_VTAB" TAB_VERB 1 0 "Oszi an" DEFAULT_VALUE "Oszi aus" /end COMPU_VTAB
/begin COMPU_VTAB FORMULA_0840_VTAB "FORMULA_0840_VTAB" TAB_VERB 1 0 "--" DEFAULT_VALUE "ENDE" /end COMPU_VTAB
/begin COMPU_VTAB FORMULA_0841_VTAB "FORMULA_0841_VTAB" TAB_VERB 2 1 "Diag. aktiv" 3 "Diag. erfolgt" DEFAULT_VALUE "inaktiv" /end COMPU_VTAB
/begin COMPU_VTAB FORMULA_0842_VTAB "FORMULA_0842_VTAB" TAB_VERB 1 0 "nicht angefordert" DEFAULT_VALUE "angefordert" /end COMPU_VTAB
/begin COMPU_VTAB FORMULA_0843_VTAB "FORMULA_0843_VTAB" TAB_VERB 1 0 "inaktiv" DEFAULT_VALUE "aktiv" /end COMPU_VTAB
/begin COMPU_VTAB FORMULA_0844_VTAB "FORMULA_0844_VTAB" TAB_VERB 1 0 "inaktiv" DEFAULT_VALUE "aktiv" /end COMPU_VTAB
/begin COMPU_VTAB FORMULA_0845_VTAB "FORMULA_0845_VTAB" TAB_VERB 1 0 "-" DEFAULT_VALUE "i.O." /end COMPU_VTAB
/begin COMPU_VTAB FORMULA_0846_VTAB "FORMULA_0846_VTAB" TAB_VERB 1 0 "-" DEFAULT_VALUE "i.O." /end COMPU_VTAB
/begin COMPU_VTAB FORMULA_0847_VTAB "FORMULA_0847_VTAB" TAB_VERB 1 0 "-" DEFAULT_VALUE "i.O." /end COMPU_VTAB
/begin COMPU_VTAB FORMULA_0848_VTAB "FORMULA_0848_VTAB" TAB_VERB 1 0 "-" DEFAULT_VALUE "i.O." /end COMPU_VTAB
/begin COMPU_VTAB FORMULA_0849_VTAB "FORMULA_0849_VTAB" TAB_VERB 1 0 "-" DEFAULT_VALUE "n.i.O." /end COMPU_VTAB
/begin COMPU_VTAB FORMULA_0850_VTAB "FORMULA_0850_VTAB" TAB_VERB 1 0 "-" DEFAULT_VALUE "n.i.O." /end COMPU_VTAB
/begin COMPU_VTAB FORMULA_0851_VTAB "FORMULA_0851_VTAB" TAB_VERB 1 0 "-" DEFAULT_VALUE "n.i.O." /end COMPU_VTAB
/begin COMPU_VTAB FORMULA_0852_VTAB "FORMULA_0852_VTAB" TAB_VERB 1 0 "-" DEFAULT_VALUE "n.i.O." /end COMPU_VTAB
/begin COMPU_VTAB FORMULA_0853_VTAB "FORMULA_0853_VTAB" TAB_VERB 1 0 "-" DEFAULT_VALUE "ENDE" /end COMPU_VTAB
/begin COMPU_VTAB FORMULA_0855_VTAB "FORMULA_0855_VTAB" TAB_VERB 1 0 "-" DEFAULT_VALUE "OEL-Verduennung" /end COMPU_VTAB
/begin COMPU_VTAB FORMULA_0856_VTAB "FORMULA_0856_VTAB" TAB_VERB 1 0 "nicht erfuellt" DEFAULT_VALUE "erfuellt" /end COMPU_VTAB
/begin COMPU_VTAB FORMULA_0857_VTAB "FORMULA_0857_VTAB" TAB_VERB 1 0 "-" DEFAULT_VALUE "START-Werte" /end COMPU_VTAB
/begin COMPU_VTAB FORMULA_0858_VTAB "FORMULA_0858_VTAB" TAB_VERB 1 0 "laueft" DEFAULT_VALUE "fertig" /end COMPU_VTAB
/begin COMPU_VTAB FORMULA_0859_VTAB "FORMULA_0859_VTAB" TAB_VERB 1 0 "-" DEFAULT_VALUE "STOP" /end COMPU_VTAB
/begin COMPU_VTAB FORMULA_0860_VTAB "FORMULA_0860_VTAB" TAB_VERB 2 0 "OBD-Plausi inaktiv" 1 "OBD-Plausi aktiv" /end COMPU_VTAB
/begin COMPU_VTAB FORMULA_0861_VTAB "FORMULA_0861_VTAB" TAB_VERB 2 0 "OBD-SA inaktiv" 1 "OBD-SA aktiv" /end COMPU_VTAB
/begin COMPU_VTAB FORMULA_0862_VTAB "FORMULA_0862_VTAB" TAB_VERB 2 0 "OBD-TL/VL inaktiv" 1 "OBD-TL/VL aktiv" /end COMPU_VTAB
/begin COMPU_VTAB FORMULA_0863_VTAB "FORMULA_0863_VTAB" TAB_VERB 2 0 "KDS inaktiv" 1 "KSD aktiv" /end COMPU_VTAB
/begin COMPU_VTAB FORMULA_0917_VTAB "FORMULA_0917_VTAB" TAB_VERB 1 0 "LSHN inaktiv" DEFAULT_VALUE "LSHN aktiv" /end COMPU_VTAB
/begin COMPU_VTAB FORMULA_0918_VTAB "FORMULA_0918_VTAB" TAB_VERB 1 0 "unter TAUP" DEFAULT_VALUE "TAUP erreicht" /end COMPU_VTAB
/begin COMPU_VTAB FORMULA_0919_VTAB "FORMULA_0919_VTAB" TAB_VERB 1 0 "-" DEFAULT_VALUE "Anforderung" /end COMPU_VTAB
/begin COMPU_VTAB FORMULA_0922_VTAB "FORMULA_0922_VTAB" TAB_VERB 1 0 "Diag. inaktiv" DEFAULT_VALUE "Diag. aktiv" /end COMPU_VTAB
/begin COMPU_VTAB FORMULA_0923_VTAB "FORMULA_0923_VTAB" TAB_VERB 1 0 "R-Messung" DEFAULT_VALUE "R-Messung efolgt" /end COMPU_VTAB
/begin COMPU_VTAB FORMULA_0924_VTAB "FORMULA_0924_VTAB" TAB_VERB 1 0 "i.O." DEFAULT_VALUE "SH_TO_X_SPERREN" /end COMPU_VTAB
/begin COMPU_VTAB FORMULA_0926_VTAB "FORMULA_0926_VTAB" TAB_VERB 1 0 "LSHVK gesperrt" DEFAULT_VALUE "LSHVK freigegeben" /end COMPU_VTAB
/begin COMPU_VTAB FORMULA_0927_VTAB "FORMULA_0927_VTAB" TAB_VERB 1 0 "LSHVK-REG inaktiv" DEFAULT_VALUE "LSHVK-REG aktiv" /end COMPU_VTAB
/begin COMPU_VTAB FORMULA_0928_VTAB "FORMULA_0928_VTAB" TAB_VERB 1 0 "TEMP n.i.O." DEFAULT_VALUE "TEMP eingeregelt" /end COMPU_VTAB
/begin COMPU_VTAB FORMULA_0929_VTAB "FORMULA_0929_VTAB" TAB_VERB 1 0 "TEMP i.O." DEFAULT_VALUE "MAX-TEMP" /end COMPU_VTAB
/begin COMPU_VTAB FORMULA_0930_VTAB "FORMULA_0930_VTAB" TAB_VERB 1 0 "TEMP i.O." DEFAULT_VALUE "MIN-TEMP" /end COMPU_VTAB
/begin COMPU_VTAB FORMULA_0931_VTAB "FORMULA_0931_VTAB" TAB_VERB 1 0 "i.O." DEFAULT_VALUE "MAX" /end COMPU_VTAB
/begin COMPU_VTAB FORMULA_0932_VTAB "FORMULA_0932_VTAB" TAB_VERB 1 0 "i.O." DEFAULT_VALUE "MIN" /end COMPU_VTAB
/begin COMPU_VTAB FORMULA_0933_VTAB "FORMULA_0933_VTAB" TAB_VERB 1 0 "-" DEFAULT_VALUE "Anforderung" /end COMPU_VTAB
/begin COMPU_VTAB FORMULA_0938_VTAB "FORMULA_0938_VTAB" TAB_VERB 1 0 "Diagnose gesperrt" DEFAULT_VALUE "Diagnose freigegeben" /end COMPU_VTAB
/begin COMPU_VTAB FORMULA_0939_VTAB "FORMULA_0939_VTAB" TAB_VERB 1 0 "kein Regleranschlag" DEFAULT_VALUE "max. Regleranschlag" /end COMPU_VTAB
/begin COMPU_VTAB FORMULA_0940_VTAB "FORMULA_0940_VTAB" TAB_VERB 1 0 "Diagnose inaktiv" DEFAULT_VALUE "Diagnose aktiv" /end COMPU_VTAB
/begin COMPU_VTAB FORMULA_0941_VTAB "FORMULA_0941_VTAB" TAB_VERB 1 0 "Diagnose inaktiv" DEFAULT_VALUE "Diagnose aktiv" /end COMPU_VTAB
/begin COMPU_VTAB FORMULA_0942_VTAB "FORMULA_0942_VTAB" TAB_VERB 1 0 "inaktiv" DEFAULT_VALUE "FREIGABE" /end COMPU_VTAB
/begin COMPU_VTAB FORMULA_0943_VTAB "FORMULA_0943_VTAB" TAB_VERB 1 0 "inaktiv" DEFAULT_VALUE "FREIGABE" /end COMPU_VTAB
/begin COMPU_VTAB FORMULA_0944_VTAB "FORMULA_0944_VTAB" TAB_VERB 1 0 "no" DEFAULT_VALUE "yes" /end COMPU_VTAB
/begin COMPU_VTAB FORMULA_0945_VTAB "FORMULA_0945_VTAB" TAB_VERB 1 0 "no" DEFAULT_VALUE "yes" /end COMPU_VTAB
/begin COMPU_VTAB FORMULA_0946_VTAB "FORMULA_0946_VTAB" TAB_VERB 2 0 "keine Heizung" 1 "Heizung" DEFAULT_VALUE "undefiniert" /end COMPU_VTAB
/begin COMPU_VTAB FORMULA_0950_VTAB "FORMULA_0950_VTAB" TAB_VERB 2 0 "tmot_start" 1 "tabg_hys" /end COMPU_VTAB
/begin COMPU_VTAB FORMULA_0952_VTAB "FORMULA_0952_VTAB" TAB_VERB 3 0 "MDrv off" 1 "MDrv on" 2 "MDrv left" DEFAULT_VALUE "undef" /end COMPU_VTAB
/begin COMPU_VTAB FORMULA_0953_VTAB "FORMULA_0953_VTAB" TAB_VERB 1 0 "Aus" DEFAULT_VALUE "Ein" /end COMPU_VTAB
/begin COMPU_VTAB FORMULA_0954_VTAB "FORMULA_0954_VTAB" TAB_VERB 1 0 "Aus" DEFAULT_VALUE "Ein" /end COMPU_VTAB
/begin COMPU_VTAB FORMULA_0955_VTAB "FORMULA_0955_VTAB" TAB_VERB 5 0 "Schalter" 1 "Komfort" 2 "Normal" 3 "Sport" 4 "Konfigmode" DEFAULT_VALUE "undef" /end COMPU_VTAB
/begin COMPU_VTAB FORMULA_0956_VTAB "FORMULA_0956_VTAB" TAB_VERB 2 0 "nur US" 1 "immer" /end COMPU_VTAB
/begin COMPU_VTAB FORMULA_0957_VTAB "FORMULA_0957_VTAB" TAB_VERB 7 0 "empty" 2 "StVehM" 1 "Req" 48 "BOS" 50 "BOS_2" 64 "CC" 65 "CCext" DEFAULT_VALUE "undef" /end COMPU_VTAB
/begin COMPU_VTAB FORMULA_0958_VTAB "FORMULA_0958_VTAB" TAB_VERB 1 255 "empty" DEFAULT_VALUE "full" /end COMPU_VTAB
/begin COMPU_VTAB FORMULA_0959_VTAB "FORMULA_0959_VTAB" TAB_VERB 27 0 "empty" 1 "Oel" 917 "Req395" 26 "FGR" 27 "MinOel_1" 28 "MinOel_2" 29 "EML" 31 "MIL" 32 "Tank" 33 "Auss_1" 34 "Auss_2" 39 "Tmot_rot" 103 "Tgetr" 104 "Tsmg" 182 "Oel-Err" 212 "Oeldruck" 213 "noLoad" 220 "highLoad" 229 "BattLow" 247 "PM-Err" 257 "Tmot_gelb" 304 "BattZust" 305 "BattKont" 306 "BattVerb" 367 "ZWS" 18193 "unused" 65535 "VehMode" DEFAULT_VALUE "undef" /end COMPU_VTAB
/begin COMPU_VTAB FORMULA_0960_VTAB "FORMULA_0960_VTAB" TAB_VERB 3 0 "-" 1 "sende BOS nach Kl.wechsel" 2 "sende BOS nach Kombireset" /end COMPU_VTAB
/begin COMPU_VTAB FORMULA_0961_VTAB "FORMULA_0961_VTAB" TAB_VERB 2 0 "Normal" 1 "SMG-CC" /end COMPU_VTAB
/begin COMPU_VTAB FORMULA_0964_VTAB "FORMULA_0964_VTAB" TAB_VERB 2 0 "geschlossen" 1 "offen" DEFAULT_VALUE "undef" /end COMPU_VTAB
/begin COMPU_VTAB FORMULA_0969_VTAB "FORMULA_0969_VTAB" TAB_VERB 2 0 "inaktiv" 1 "aktiv" DEFAULT_VALUE "undef" /end COMPU_VTAB
/begin COMPU_VTAB FORMULA_0970_VTAB "FORMULA_0970_VTAB" TAB_VERB 2 0 "nein" 1 "ja" DEFAULT_VALUE "undef" /end COMPU_VTAB
/begin COMPU_VTAB FORMULA_0977_VTAB "FORMULA_0977_VTAB" TAB_VERB 2 0 "mvac_ml_sr_rsv_mess" 1 "mvac_ml_sr_rsv_psens" DEFAULT_VALUE "undef" /end COMPU_VTAB
/begin COMPU_VTAB FORMULA_0986_VTAB "FORMULA_0986_VTAB" TAB_VERB 4 1 "HFM" 2 "PSAU" 4 "AQ" 8 "HFM-AQ Komb" DEFAULT_VALUE "undefiniert" /end COMPU_VTAB
/begin COMPU_VTAB FORMULA_0987_VTAB "FORMULA_0987_VTAB" TAB_VERB 4 1 "HFM" 2 "PSAU" 4 "AQ" 8 "HFM-AQ Komb" DEFAULT_VALUE "undefiniert" /end COMPU_VTAB
/begin COMPU_VTAB FORMULA_0988_VTAB "FORMULA_0988_VTAB" TAB_VERB 3 1 "HFM" 2 "PSAU" 4 "AQ" DEFAULT_VALUE "undefiniert" /end COMPU_VTAB
/begin COMPU_VTAB FORMULA_0989_VTAB "FORMULA_0989_VTAB" TAB_VERB 4 1 "TAN HFM" 2 "TAN Modell" 4 "TMOT" 8 "TAN+TMOT/2" /end COMPU_VTAB
/begin FUNCTION Lambda-NK ""
 /begin DEF_CHARACTERISTIC K_LANK_DIAG_CFG K_LANK_DIAG_GND_T K_LANK_DIAG_MAX_T K_LANK_DIAG_OL_IO_T K_LANK_DIAG_OL_T K_LANK_DIAG_SONDTEMP K_LANK_DIAG_STAB_T K_LANK_DIAG_TKAT K_LANK_DIAG_UMAX K_LANK_DIAG_UMIN K_LANK_DIAG_VK_REG_T K_LANK_FETT K_LANK_MAGER K_LANK_N_MAX K_LANK_N_MIN K_LANK_OBD_S_AUTOM_CNT K_LANK_OBD_S_CFG K_LANK_OBD_S_CNT K_LANK_OBD_S_LAM_VKAT K_LANK_OBD_S_NMAX K_LANK_OBD_S_NMIN K_LANK_OBD_S_SA_AUTOM K_LANK_OBD_S_SA_ML_SUM K_LANK_OBD_S_SA_T K_LANK_OBD_S_SA_US K_LANK_OBD_S_SA_WE_T K_LANK_OBD_S_TML K_LANK_OBD_S_USF K_LANK_OBD_S_VL_T K_LANK_OBD_S_VL_US K_LANK_OBD_S_WE_CNT K_LANK_OBD_S_WE_LAM_T K_LANK_OBD_S_WE_ML_SUM K_LANK_OBD_S_WE_T K_LANK_RF_MAX K_LANK_RF_MIN K_LANK_T_AUS K_LANK_T_EIN K_LANK_TKAT_SCHW K_LANK_US_FILT_OB K_LANK_US_FILT_T K_LANK_US_FILT_UNT K_LANK_US_TAU K_LANK_US_TAU_S K_LANK_USF K_LANK_USM KF_LANK_OBD_S_LAM_SOLL KF_LANK_US_TAU_L KL_KAT_OBD_LANK_LAM /end DEF_CHARACTERISTIC
 /begin OUT_MEASUREMENT lank_ad_b1 lank_ad_b2 lank_diag_ol_b1 lank_diag_ol_b2 lank_diag_sh_to_gnd_b1 lank_diag_sh_to_gnd_b2 lank_diag_sh_to_ub_b1 lank_diag_sh_to_ub_b2 lank_diag_st_b1 lank_diag_st_b2 lank_diag_stab_b1 lank_diag_stab_b2 lank_diag_temp_b1 lank_diag_temp_b2 lank_lam_b1 lank_lam_b2 lank_obd_s_bed_b1 lank_obd_s_bed_b2 lank_obd_s_cnt_ausw_b1 lank_obd_s_cnt_ausw_b2 lank_obd_s_cnt_b1 lank_obd_s_cnt_b2 lank_obd_s_diag_b1 lank_obd_s_diag_b2 lank_obd_s_lam_soll_b1 lank_obd_s_lam_soll_b2 lank_obd_s_sa_diag_b1 lank_obd_s_sa_diag_b2 lank_obd_s_sa_phase_b1 lank_obd_s_sa_phase_b2 lank_obd_s_sa_we_b1 lank_obd_s_sa_we_b2 lank_obd_s_st_b1 lank_obd_s_st_b2 lank_obd_s_usf_b1 lank_obd_s_usf_b2 lank_obd_s_vl_diag_b1 lank_obd_s_vl_diag_b2 lank_obd_s_we_cnt_b1 lank_obd_s_we_cnt_b2 lank_obd_s_we_diag_b1 lank_obd_s_we_diag_b2 lank_obd_s_we_lam_time_b1 lank_obd_s_we_lam_time_b2 lank_obd_s_we_time_b1 lank_obd_s_we_time_b2 lank_sgn_b1 lank_sgn_b2 lank_st_aus_b1 lank_st_aus_b2 lank_st_aus_diag_b1 lank_st_aus_diag_b2 lank_st_aus_n_b1 lank_st_aus_n_b2 lank_st_aus_rf_b1 lank_st_aus_rf_b2 lank_st_aus_tkat_b1 lank_st_aus_tkat_b2 lank_st_ein_b1 lank_st_ein_b2 lank_st_sonde_b1 lank_st_sonde_b2 lank_st_us_tau_t_b1 lank_st_us_tau_t_b2 lank_us_b1 lank_us_b2 lank_us_filt_b1 lank_us_filt_b2 /end OUT_MEASUREMENT
/end FUNCTION
/begin FUNCTION LAVK-OBD ""
 /begin DEF_CHARACTERISTIC K_KSD_OBD_CFG K_KSD_OBD_DIAG_T K_KSD_OBD_LL_LAM_MAX K_KSD_OBD_LL_LAM_MIN K_KSD_OBD_LL_MAX_T K_KSD_OBD_LL_MIN_T K_KSD_OBD_N_MAX K_KSD_OBD_N_MIN K_KSD_OBD_OEL_SPERR_MAX K_KSD_OBD_PUMG_MIN K_KSD_OBD_RF_MAX K_KSD_OBD_RF_MIN K_KSD_OBD_TAN K_KSD_OBD_TL_LAM_MAX K_KSD_OBD_TL_LAM_MIN K_KSD_OBD_TL_MAX_T K_KSD_OBD_TL_MIN_T K_KSD_OBD_TMOT_MIN K_KSD_OBD_V K_LA_OBD_DYN_CNT_INC K_LA_OBD_DYN_DELTA_CNT K_LA_OBD_DYN_DELTA_PUMP_RF K_LA_OBD_DYN_DELTA_RF K_LA_OBD_DYN_RF_T K_LAVK_OBD_ACT_CFG K_LAVK_OBD_ACT_EXD_N_SOLL K_LAVK_OBD_ACT_EXD_TIME K_LAVK_OBD_ACT_F_T K_LAVK_OBD_ACT_LAM_IST_F K_LAVK_OBD_ACT_LAM_IST_M K_LAVK_OBD_ACT_LAM_SOLL_F K_LAVK_OBD_ACT_LAM_SOLL_M K_LAVK_OBD_ACT_LANK_F K_LAVK_OBD_ACT_LANK_M K_LAVK_OBD_ACT_M_T K_LAVK_OBD_ACT_ML_SUM K_LAVK_OBD_ACT_N_MAX K_LAVK_OBD_ACT_N_MIN K_LAVK_OBD_ACT_NK_F_CNT K_LAVK_OBD_ACT_NK_M_CNT K_LAVK_OBD_ACT_RF_MAX K_LAVK_OBD_ACT_RF_MIN K_LAVK_OBD_ACT_TKAT K_LAVK_OBD_ACT_TRIM_F K_LAVK_OBD_ACT_TRIM_M K_LAVK_OBD_ACT_VK_F_CNT K_LAVK_OBD_ACT_VK_M_CNT K_LAVK_OBD_PLAU_CFG K_LAVK_OBD_PLAU_F_CNT K_LAVK_OBD_PLAU_IP_N_MAX K_LAVK_OBD_PLAU_IP_N_MIN K_LAVK_OBD_PLAU_IP_REG_MAX K_LAVK_OBD_PLAU_IP_REG_MIN K_LAVK_OBD_PLAU_IP_STABIL_T K_LAVK_OBD_PLAU_LAM_FETT K_LAVK_OBD_PLAU_LAM_MAGER K_LAVK_OBD_PLAU_LAM_MAX K_LAVK_OBD_PLAU_LAM_MIN K_LAVK_OBD_PLAU_LANK_MAX K_LAVK_OBD_PLAU_LANK_MIN K_LAVK_OBD_PLAU_M_CNT K_LAVK_OBD_PLAU_ML_SUM K_LAVK_OBD_PLAU_OL_CNT K_LAVK_OBD_PLAU_RF_MAX K_LAVK_OBD_PLAU_RF_MIN K_LAVK_OBD_PLAU_T K_LAVK_OBD_PLAU_TKAT_MAX K_LAVK_OBD_PLAU_TKAT_MIN K_LAVK_OBD_PLAU_UN_OSZI_OFF K_LAVK_OBD_PLAU_UN_SCHW K_LAVK_OBD_SA_CFG K_LAVK_OBD_SA_CNT K_LAVK_OBD_SA_DIAG_OL K_LAVK_OBD_SA_ML_SUM K_LAVK_OBD_SA_SCHW K_LAVK_OBD_SA_T K_LAVK_OBD_TL_CFG K_LAVK_OBD_TL_CNT K_LAVK_OBD_TL_ML_SUM K_LAVK_OBD_TL_SCHW_MAX K_LAVK_OBD_TL_SCHW_MIN K_LAVK_OBD_TL_T K_LAVK_OBD_TMOT K_LAVK_OBD_VK_TEMP KL_KSD_OBD_OEL_DEC KL_KSD_OBD_OEL_INC /end DEF_CHARACTERISTIC
 /begin OUT_MEASUREMENT ksd_obd_diag_t_b1 ksd_obd_diag_t_b2 ksd_obd_diag_time_b1 ksd_obd_diag_time_b2 ksd_obd_f_rel_b1 ksd_obd_f_rel_b2 ksd_obd_freig_aktiv_b1 ksd_obd_freig_aktiv_b2 ksd_obd_laa_f_b1 ksd_obd_laa_f_b2 ksd_obd_laa_offs_b1 ksd_obd_laa_offs_b2 ksd_obd_lam_b1 ksd_obd_lam_b2 ksd_obd_ll_max_t_b1 ksd_obd_ll_max_t_b2 ksd_obd_ll_min_t_b1 ksd_obd_ll_min_t_b2 ksd_obd_oel_sperr_b1 ksd_obd_oel_sperr_b2 ksd_obd_offs_delta_b1 ksd_obd_offs_delta_b2 ksd_obd_offs_rel_b1 ksd_obd_offs_rel_b2 ksd_obd_st_b1 ksd_obd_st_b2 ksd_obd_start_b1 ksd_obd_start_b2 ksd_obd_stop_b1 ksd_obd_stop_b2 ksd_obd_tl_max_t_b1 ksd_obd_tl_max_t_b2 ksd_obd_tl_min_t_b1 ksd_obd_tl_min_t_b2 lavk_diag_ia_sa_openload_b1 lavk_diag_ia_sa_openload_b2 lavk_diag_ip_dynamik_check_b1 lavk_diag_ip_dynamik_check_b2 lavk_diag_ip_plau_openload_b1 lavk_diag_ip_plau_openload_b2 lavk_diag_ip_sa_openload_b1 lavk_diag_ip_sa_openload_b2 lavk_diag_ip_vm_sa_openload_b1 lavk_diag_ip_vm_sa_openload_b2 lavk_diag_st_b1 lavk_diag_st_b2 lavk_diag_un_plau_openload_b1 lavk_diag_un_plau_openload_b2 lavk_obd_act_aktiv_b1 lavk_obd_act_aktiv_b2 lavk_obd_act_anf_b1 lavk_obd_act_anf_b2 lavk_obd_act_ende_b1 lavk_obd_act_ende_b2 lavk_obd_act_exd_time_b1 lavk_obd_act_exd_time_b2 lavk_obd_act_fett_anf_b1 lavk_obd_act_fett_anf_b2 lavk_obd_act_fett_b1 lavk_obd_act_fett_b2 lavk_obd_act_mager_anf_b1 lavk_obd_act_mager_anf_b2 lavk_obd_act_mager_b1 lavk_obd_act_mager_b2 lavk_obd_act_nk_f_cnt_b1 lavk_obd_act_nk_f_cnt_b2 lavk_obd_act_nk_m_cnt_b1 lavk_obd_act_nk_m_cnt_b2 lavk_obd_act_nkat_f_io_b1 lavk_obd_act_nkat_f_io_b2 lavk_obd_act_nkat_f_nio_b1 lavk_obd_act_nkat_f_nio_b2 lavk_obd_act_nkat_m_io_b1 lavk_obd_act_nkat_m_io_b2 lavk_obd_act_nkat_m_nio_b1 lavk_obd_act_nkat_m_nio_b2 lavk_obd_act_st_b1 lavk_obd_act_st_b2 lavk_obd_act_verz_t_b1 lavk_obd_act_verz_t_b2 lavk_obd_act_vk_f_cnt_b1 lavk_obd_act_vk_f_cnt_b2 lavk_obd_act_vk_m_cnt_b1 lavk_obd_act_vk_m_cnt_b2 lavk_obd_act_vkat_f_io_b1 lavk_obd_act_vkat_f_io_b2 lavk_obd_act_vkat_f_nio_b1 lavk_obd_act_vkat_f_nio_b2 lavk_obd_act_vkat_m_io_b1 lavk_obd_act_vkat_m_io_b2 lavk_obd_act_vkat_m_nio_b1 lavk_obd_act_vkat_m_nio_b2 lavk_obd_plau_f_cnt_b1 lavk_obd_plau_f_cnt_b2 lavk_obd_plau_ip_stabil_t_b1 lavk_obd_plau_ip_stabil_t_b2 lavk_obd_plau_m_cnt_b1 lavk_obd_plau_m_cnt_b2 lavk_obd_plau_ol_cnt_b1 lavk_obd_plau_ol_cnt_b2 lavk_obd_plau_oszi_off_b1 lavk_obd_plau_oszi_off_b2 lavk_obd_plau_oszi_off_st_b1 lavk_obd_plau_oszi_off_st_b2 lavk_obd_plau_st_b1 lavk_obd_plau_st_b2 lavk_obd_plau_status_b1 lavk_obd_plau_status_b2 lavk_obd_plau_t_b1 lavk_obd_plau_t_b2 lavk_obd_plau_un_ol_diag_b1 lavk_obd_plau_un_ol_diag_b2 lavk_obd_sa_cnt_b1 lavk_obd_sa_cnt_b2 lavk_obd_sa_st_b1 lavk_obd_sa_st_b2 lavk_obd_sa_t_b1 lavk_obd_sa_t_b2 lavk_obd_tl_cnt_b1 lavk_obd_tl_cnt_b2 lavk_obd_tl_st_b1 lavk_obd_tl_st_b2 lavk_obd_tl_t_b1 lavk_obd_tl_t_b2 /end OUT_MEASUREMENT
/end FUNCTION
/begin FUNCTION LOLIMOT "" /begin DEF_CHARACTERISTIC KL_E_FUNKTION /end DEF_CHARACTERISTIC /end FUNCTION
/begin FUNCTION LSHNK ""
 /begin DEF_CHARACTERISTIC K_LSH_UB_TAU K_LSHNK_AKTIV_T K_LSHNK_DIAG_CFG K_LSHNK_DIAG_R_TAU K_LSHNK_DIAG_RO K_LSHNK_DIAG_RU K_LSHNK_DIAG_TAUP_T K_LSHNK_RF_HYS K_LSHNK_TAUP K_LSHNK_TKAT_MAX K_LSHNK_UB_MAX K_LSHVK_AD_TEST K_LSHVK_CFG K_LSHVK_DIAG_ANZ_MESS K_LSHVK_DIAG_CFG K_LSHVK_DIAG_R_ADAPT K_LSHVK_DIAG_R_OFFSET K_LSHVK_DIAG_R_TAU K_LSHVK_DIAG_RO K_LSHVK_DIAG_RU K_LSHVK_DIAG_TEMP_IST_MAX K_LSHVK_DIAG_TEMP_IST_MIN K_LSHVK_R_AD_GAIN_CNT K_LSHVK_R_AD_GAIN_CNT_MIN K_LSHVK_R_AD_GAIN_GRAD K_LSHVK_R_AD_GAIN_MAX K_LSHVK_R_AD_GAIN_MIN K_LSHVK_R_AD_GAIN_NV_MAX K_LSHVK_R_AD_GAIN_NV_MIN K_LSHVK_R_AD_GAIN_T K_LSHVK_R_AD_GAIN_T1 K_LSHVK_R_AD_OFFS_CNT K_LSHVK_R_AD_OFFS_CNT_MIN K_LSHVK_R_AD_OFFS_GRAD K_LSHVK_R_AD_OFFS_MAX K_LSHVK_R_AD_OFFS_MIN K_LSHVK_R_AD_OFFS_NV_MAX K_LSHVK_R_AD_OFFS_NV_MIN K_LSHVK_R_AD_OFFS_T K_LSHVK_R_AD_OFFS_T1 K_LSHVK_R_AD_RESET K_LSHVK_R_REF K_LSHVK_R_REF_OFFS K_LSHVK_REG_K K_LSHVK_REG_TN K_LSHVK_RI_RANGE_SCHW K_LSHVK_T_KL15_MAX K_LSHVK_TABG_HYS K_LSHVK_TEMP_DIF_ZUL K_LSHVK_TEMP_FILT_TAU K_LSHVK_TEMP_IST_ENABLE_IP_LOOP K_LSHVK_TEMP_IST_SCHW K_LSHVK_TEMP_MAX K_LSHVK_TEMP_MIN K_LSHVK_TEMP_REG_MIN K_LSHVK_TV_KORR_MIN K_LSHVK_UB_MAX K_LSHVK_UB_NORM K_LSHVK_UEFF_GRAD K_LSHVK_WSS_CFG K_LSRVK_OBD_CFG K_LSRVK_OBD_ML_SUM K_LSRVK_OBD_REF_CNT K_LSRVK_OBD_REF_GAIN_MAX K_LSRVK_OBD_REF_GAIN_MIN K_LSRVK_OBD_REF_OFFS_CNT K_LSRVK_OBD_REF_OFFS_MAX K_LSRVK_OBD_REF_OFFS_MIN K_LSRVK_OBD_REG_T K_LSRVK_OBD_START_R K_LSRVK_OBD_TKAT_MAX K_LSRVK_OBD_TKAT_MIN KF_LSHNK_TA_MAX KF_LSHVK_TEMP_SOLL KF_LSHVK_TV_KORR_MAX KF_LSHVK_TV_VORST KL_LSHNK_RF_AUS KL_LSHNK_SOND_TEMP KL_LSHNK_T_EIN KL_LSHNK_TA KL_LSHVK_DIAG_TIME_ML KL_LSHVK_R_MESS_F KL_LSHVK_R_MESS_OFFS KL_LSHVK_SOND_TEMP KL_LSHVK_TEMP_IST_HIGH KL_LSHVK_TEMP_IST_LOW KL_LSHVK_TEMP_SOLL_MS KL_LSHVK_UEFF_MAX KL_LSRVK_OBD_START_TML KL_LSRVK_OBD_TML /end DEF_CHARACTERISTIC
 /begin OUT_MEASUREMENT lsh_ub_filt lshnk.ein_b1 lshnk.ein_b2 lshnk.exd_aktiv_b1 lshnk.exd_aktiv_b2 lshnk.taup_b1 lshnk.taup_b2 lshnk_b1.st lshnk_b1.ta lshnk_b1.temp lshnk_b2.st lshnk_b2.ta lshnk_b2.temp lshnk_diag.aktiv_b1 lshnk_diag.aktiv_b2 lshnk_diag.info_b1 lshnk_diag.info_b2 lshnk_diag.sh_to_x_sperren_b1 lshnk_diag.sh_to_x_sperren_b2 lshnk_diag_b1.i_ad lshnk_diag_b1.i_cnt lshnk_diag_b1.i_sum lshnk_diag_b1.i_wert lshnk_diag_b1.r lshnk_diag_b1.st lshnk_diag_b2.i_ad lshnk_diag_b2.i_cnt lshnk_diag_b2.i_sum lshnk_diag_b2.i_wert lshnk_diag_b2.r lshnk_diag_b2.st lshnk_exd_timeout_b1 lshnk_exd_timeout_b2 lshnk_rf_aus lshnk_t_ein lshvk.begr_max_b1 lshvk.begr_max_b2 lshvk.begr_min_b1 lshvk.begr_min_b2 lshvk.exd_aktiv_b1 lshvk.exd_aktiv_b2 lshvk.freig_b1 lshvk.freig_b2 lshvk.max_temp_b1 lshvk.max_temp_b2 lshvk.min_temp_b1 lshvk.min_temp_b2 lshvk.reg_b1 lshvk.reg_b2 lshvk.temp_b1 lshvk.temp_b2 lshvk_b1.r_mess lshvk_b1.r_mess_korr lshvk_b1.reg_t_max lshvk_b1.st lshvk_b1.tabg_hys lshvk_b1.temp_dif lshvk_b1.temp_heiz lshvk_b1.temp_ist lshvk_b1.temp_ist_roh lshvk_b1.temp_soll lshvk_b1.tv_add lshvk_b1.tv_begr lshvk_b1.tv_eff_max lshvk_b1.tv_grad lshvk_b1.tv_korr lshvk_b1.tv_korr_max lshvk_b1.tv_lim lshvk_b1.tv_reg lshvk_b1.tv_vorst lshvk_b2.r_mess lshvk_b2.r_mess_korr lshvk_b2.reg_t_max lshvk_b2.st lshvk_b2.tabg_hys lshvk_b2.temp_dif lshvk_b2.temp_heiz lshvk_b2.temp_ist lshvk_b2.temp_ist_roh lshvk_b2.temp_soll lshvk_b2.tv_add lshvk_b2.tv_begr lshvk_b2.tv_eff_max lshvk_b2.tv_grad lshvk_b2.tv_korr lshvk_b2.tv_korr_max lshvk_b2.tv_lim lshvk_b2.tv_reg lshvk_b2.tv_vorst lshvk_diag_i_ad_b1 lshvk_diag_i_ad_b2 lshvk_diag_mess_cnt_b1 lshvk_diag_mess_cnt_b2 lshvk_diag_r_b1 lshvk_diag_r_b2 lshvk_diag_time_ml lshvk_exd_timeout_b1 lshvk_exd_timeout_b2 lshvk_r_ad_gain_cnt_b1 lshvk_r_ad_gain_cnt_b2 lshvk_r_ad_gain_delta_b1 lshvk_r_ad_gain_delta_b2 lshvk_r_ad_gain_delta_t_b1 lshvk_r_ad_gain_delta_t_b2 lshvk_r_ad_gain_erfolgt_b1 lshvk_r_ad_gain_erfolgt_b2 lshvk_r_ad_gain_filt_b1 lshvk_r_ad_gain_filt_b2 lshvk_r_ad_gain_filt_st_b1 lshvk_r_ad_gain_filt_st_b2 lshvk_r_ad_gain_freig_b1 lshvk_r_ad_gain_freig_b2 lshvk_r_ad_gain_st_b1 lshvk_r_ad_gain_st_b2 lshvk_r_ad_offs_cnt_b1 lshvk_r_ad_offs_cnt_b2 lshvk_r_ad_offs_delta_t_b1 lshvk_r_ad_offs_delta_t_b2 lshvk_r_ad_offs_erfolgt_b1 lshvk_r_ad_offs_erfolgt_b2 lshvk_r_ad_offs_filt_b1 lshvk_r_ad_offs_filt_b2 lshvk_r_ad_offs_filt_st_b1 lshvk_r_ad_offs_filt_st_b2 lshvk_r_ad_offs_freig_b1 lshvk_r_ad_offs_freig_b2 lshvk_r_ad_offs_st_b1 lshvk_r_ad_offs_st_b2 lshvk_r_ad_st_b1 lshvk_r_ad_st_b2 lshvk_status lshvk_temp_filt_tau lsrvk_obd_aktiv_b1 lsrvk_obd_aktiv_b2 lsrvk_obd_ref_b1 lsrvk_obd_ref_b2 lsrvk_obd_ref_cnt_b1 lsrvk_obd_ref_cnt_b2 lsrvk_obd_ref_offs_cnt_b1 lsrvk_obd_ref_offs_cnt_b2 lsrvk_obd_reg_b1 lsrvk_obd_reg_b2 lsrvk_obd_st_b1 lsrvk_obd_st_b2 lsrvk_obd_start_b1 lsrvk_obd_start_b2 lsrvk_obd_tml /end OUT_MEASUREMENT
/end FUNCTION
/begin FUNCTION M-Drive ""
 /begin DEF_CHARACTERISTIC K_MDRV_ALBV K_MDRV_CFG K_MDRV_CFG_P400 K_MDRV_DSC K_MDRV_EDCK K_MDRV_ENG K_MDRV_HUD K_MDRV_MOD_SMG K_MDRV_P400_ONLY K_MDRV_P500_START K_MDRV_PTH_CNT_MAX K_MDRV_STG_SMG K_MDRV_TBLINK /end DEF_CHARACTERISTIC
 /begin OUT_MEASUREMENT mdrv_flags mdrv_flags_kl15 mdrv_flags_power mdrv_flags_stat mdrv_pth_cnt mdrv_tblink /end OUT_MEASUREMENT
/end FUNCTION
/begin FUNCTION Mastervac ""
 /begin DEF_CHARACTERISTIC K_MVAC_AL_BLS K_MVAC_AL_LECK K_MVAC_AL_SRMV K_MVAC_AL_UMMV_STAT K_MVAC_BRP_GRAD_RAMPE K_MVAC_BRPGRAD_SW K_MVAC_DEL_BLS K_MVAC_DEL_RSV K_MVAC_ELUP_ST_DEL K_MVAC_HYS_MAX K_MVAC_HYS_MIN K_MVAC_ML_AEB_NEG K_MVAC_ML_AEB_POS K_MVAC_ML_CFG K_MVAC_ML_INTEGRATOR_TAU K_MVAC_ML_MIN K_MVAC_ML_SR_MAX K_MVAC_ML_SR_MIN K_MVAC_ML_TAU K_MVAC_MLRF_SR_SPERRE K_MVAC_N_MIN_B K_MVAC_N_MIN_SA K_MVAC_P_DIAG_MAX K_MVAC_P_DIAG_MIN K_MVAC_P_DIAG_PDIFF_DELAY K_MVAC_P_DIAG_PDIFF_NEG K_MVAC_P_DIAG_PDIFF_POS K_MVAC_P_DIAG_PDIFF_ROH_TAU K_MVAC_P_DIAG_PDIFF_TAU K_MVAC_P_DIAG_PDIFF_TMOT K_MVAC_P_DIAG_TIME_ML K_MVAC_P_SENSOR_OFFSET K_MVAC_P_SENSOR_STEIGUNG K_MVAC_P_TAU K_MVAC_PDIFF_FILTER_TAU K_MVAC_PDIFF_UM_BEGR_MAX K_MVAC_PDIFF_UM_BEGR_MIN K_MVAC_PL_P_IO_SW K_MVAC_PL_PDIFF K_MVAC_PL_TIME_LIMIT K_MVAC_PL_TIME_MS K_MVAC_RMP_FKT_SA_BEGR K_MVAC_V KF_MVAC_ELUP_ETA KL_MVAC_BRP_GRAD KL_MVAC_ELUP KL_MVAC_ML_WICHT KL_MVAC_PDIFF_B KL_MVAC_PDIFF_SA /end DEF_CHARACTERISTIC
 /begin OUT_MEASUREMENT mvac_al_brp_grad mvac_al_ummv_stat mvac_aq_bre_b mvac_aq_bre_sa mvac_del_bls mvac_del_rsv mvac_del_rsv_mess mvac_elup_st_del mvac_m mvac_ml mvac_ml_brp mvac_ml_brp_grad mvac_ml_elup mvac_ml_elup_sr mvac_ml_leck mvac_ml_old mvac_ml_psens mvac_ml_sr mvac_ml_sr_rsv mvac_ml_sr_rsv_mess mvac_ml_sr_rsv_mess_roh mvac_ml_sr_rsv_psens mvac_ml_sr_rsv_psens_roh mvac_ml_sr_rsv_roh mvac_p_ad mvac_p_diag_pdiff_delay mvac_p_diag_pdiff_neg mvac_p_diag_pdiff_neg_roh mvac_p_diag_pdiff_pos mvac_p_diag_pdiff_pos_roh mvac_p_diag_pdiff_roh mvac_p_modell_grad mvac_p_roh mvac_pdiff_filter mvac_pdiff_sr mvac_pdiff_sr_mess mvac_pdiff_sr_mess_roh mvac_pdiff_sr_roh mvac_pl_p_modell_ml mvac_pl_p_sensor_ml mvac_pl_p_sensor_ms_ende mvac_pl_p_sensor_ms_start mvac_pl_st mvac_pl_timer mvac_pos_rsv mvac_pos_rsv_mess mvac_rmp_fkt_sa mvac_rmp_fkt_sa_frei mvac_rmp_fkt_sa_neg mvac_rmp_fkt_sa_pos mvac_rmp_fkt_sa_start mvac_spr_fkt_brp_grad /end OUT_MEASUREMENT
/end FUNCTION
/begin FUNCTION Message-Kanal "" /begin DEF_CHARACTERISTIC K_MSG_CFG /end DEF_CHARACTERISTIC
 /begin OUT_MEASUREMENT msg_bos_kl15 msg_clr_buf msg_exd_st msg_exd_timeout msg_rec_rtime msg_send_buf msg_send_id msg_send_st msg_send_timeout msg_send_typ msg_timer /end OUT_MEASUREMENT
/end FUNCTION
/begin FUNCTION MZYL ""
 /begin DEF_CHARACTERISTIC K_MZYL_CFG K_MZYL_EV_RUECK K_MZYL_EV_RUECK_TMAX K_MZYL_HFM_AQ_MAX_FAK K_MZYL_HFM_AQ_MIN_FAK K_MZYL_R K_MZYL_START_CFG K_MZYL_T_CFG KF_MZYL_ADAPT_GEW KF_MZYL_ADAPT_RAMPE_DOWN KF_MZYL_ADAPT_RAMPE_UP KL_MZYL_EV_A_MEAN KL_MZYL_PZYL_DP KL_MZYL_PZYL_DP_F /end DEF_CHARACTERISTIC
 /begin OUT_MEASUREMENT ml_aq_b1 ml_aq_b2 ml_aq_hfm_b1 ml_aq_hfm_b2 ml_lam_b1 ml_lam_b2 ml_psau_b1 ml_psau_b2 mzyl_aq_b1 mzyl_aq_b2 mzyl_aq_hfm_b1 mzyl_aq_hfm_b2 mzyl_b1.aq_rf_fak mzyl_b1.e_mean_ues mzyl_b1.gas_zustand mzyl_b1.ges_asp mzyl_b1.ges_psau mzyl_b1.ges_roh mzyl_b1.ges_rueck mzyl_b1.ml_asp mzyl_b1.ml_lam mzyl_b1.ml_psau mzyl_b1.ml_sum_sa mzyl_b1.ml_sum_we mzyl_b1.mldt mzyl_b1.phi_ev_mean mzyl_b1.pzyl mzyl_b1.rf mzyl_b1.rg_asp mzyl_b1.t_ues_ev mzyl_b1.w_ues_ev mzyl_b2.aq_rf_fak mzyl_b2.e_mean_ues mzyl_b2.gas_zustand mzyl_b2.ges_asp mzyl_b2.ges_psau mzyl_b2.ges_roh mzyl_b2.ges_rueck mzyl_b2.ml_asp mzyl_b2.ml_lam mzyl_b2.ml_psau mzyl_b2.ml_sum_sa mzyl_b2.ml_sum_we mzyl_b2.mldt mzyl_b2.phi_ev_mean mzyl_b2.pzyl mzyl_b2.rf mzyl_b2.rg_asp mzyl_b2.t_ues_ev mzyl_b2.w_ues_ev mzyl_st rf_aq_hfm_b1 rf_aq_hfm_b2 /end OUT_MEASUREMENT
/end FUNCTION
/begin RECORD_LAYOUT TKF_SW_SW_SW FNC_VALUES 5 SWORD COLUMN_DIR DIRECT AXIS_PTS_X 3 SWORD INDEX_INCR DIRECT AXIS_PTS_Y 4 SWORD INDEX_INCR DIRECT NO_AXIS_PTS_X 1 UBYTE NO_AXIS_PTS_Y 2 UBYTE /end RECORD_LAYOUT
/begin RECORD_LAYOUT TKF_SW_SW_UB FNC_VALUES 5 UBYTE COLUMN_DIR DIRECT AXIS_PTS_X 3 SWORD INDEX_INCR DIRECT AXIS_PTS_Y 4 SWORD INDEX_INCR DIRECT NO_AXIS_PTS_X 1 UBYTE NO_AXIS_PTS_Y 2 UBYTE /end RECORD_LAYOUT
/begin RECORD_LAYOUT TKF_SW_SW_UW FNC_VALUES 5 UWORD COLUMN_DIR DIRECT AXIS_PTS_X 3 SWORD INDEX_INCR DIRECT AXIS_PTS_Y 4 SWORD INDEX_INCR DIRECT NO_AXIS_PTS_X 1 UBYTE NO_AXIS_PTS_Y 2 UBYTE /end RECORD_LAYOUT
/begin RECORD_LAYOUT TKL_SF_VV_SF FNC_VALUES 5 FLOAT32_IEEE COLUMN_DIR DIRECT AXIS_PTS_X 4 FLOAT32_IEEE INDEX_INCR DIRECT NO_AXIS_PTS_X 1 UBYTE RESERVED 2 BYTE RESERVED 3 WORD /end RECORD_LAYOUT
/begin RECORD_LAYOUT TKL_SW_VV_SW FNC_VALUES 4 SWORD COLUMN_DIR DIRECT AXIS_PTS_X 3 SWORD INDEX_INCR DIRECT NO_AXIS_PTS_X 1 UBYTE RESERVED 2 BYTE /end RECORD_LAYOUT
/begin RECORD_LAYOUT TKL_SW_VV_UB FNC_VALUES 4 UBYTE COLUMN_DIR DIRECT AXIS_PTS_X 3 SWORD INDEX_INCR DIRECT NO_AXIS_PTS_X 1 UBYTE RESERVED 2 BYTE /end RECORD_LAYOUT
/begin RECORD_LAYOUT TKL_SW_VV_UW FNC_VALUES 4 UWORD COLUMN_DIR DIRECT AXIS_PTS_X 3 SWORD INDEX_INCR DIRECT NO_AXIS_PTS_X 1 UBYTE RESERVED 2 BYTE /end RECORD_LAYOUT
/begin RECORD_LAYOUT TKL_UW_VV_SW FNC_VALUES 4 SWORD COLUMN_DIR DIRECT AXIS_PTS_X 3 UWORD INDEX_INCR DIRECT NO_AXIS_PTS_X 1 UBYTE RESERVED 2 BYTE /end RECORD_LAYOUT
/begin RECORD_LAYOUT TKL_UW_VV_UW FNC_VALUES 4 UWORD COLUMN_DIR DIRECT AXIS_PTS_X 3 UWORD INDEX_INCR DIRECT NO_AXIS_PTS_X 1 UBYTE RESERVED 2 BYTE /end RECORD_LAYOUT
/begin RECORD_LAYOUT TKW_VV_VV_SL FNC_VALUES 1 SLONG COLUMN_DIR DIRECT /end RECORD_LAYOUT
/begin RECORD_LAYOUT TKW_VV_VV_SW FNC_VALUES 1 SWORD COLUMN_DIR DIRECT /end RECORD_LAYOUT
/begin RECORD_LAYOUT TKW_VV_VV_UB FNC_VALUES 1 UBYTE COLUMN_DIR DIRECT /end RECORD_LAYOUT
/begin RECORD_LAYOUT TKW_VV_VV_UW FNC_VALUES 1 UWORD COLUMN_DIR DIRECT /end RECORD_LAYOUT
/end MODULE
/end PROJECT
