ASAP2_VERSION 1 4
/begin PROJECT P_558 "EDC17_CP02"
/begin HEADER "" VERSION "V1C1" PROJECT_NO P_558 /end HEADER
/begin MODULE DIM ""
/begin MOD_COMMON "" BYTE_ORDER MSB_LAST ALIGNMENT_BYTE 1 ALIGNMENT_WORD 2 ALIGNMENT_LONG 4 ALIGNMENT_FLOAT32_IEEE 4 /end MOD_COMMON
/begin CHARACTERISTIC DDRC_DurDeb.MeUn_tiOLDebOk_C "/" VALUE 0x80070E0C Val_Wu16 655350.0 DDRCTime_ms 0.00 655350.0 FORMAT "%8.1" /end CHARACTERISTIC
/begin CHARACTERISTIC DDRC_DurDeb.MeUn_tiOLDebDef_C "/" VALUE 0x80070E0E Val_Wu16 655350.0 DDRCTime_ms 0.00 655350.0 FORMAT "%8.1" /end CHARACTERISTIC
/begin CHARACTERISTIC DDRC_DurDeb.PCV_tiSRCMinDebOk_C "/" VALUE 0x80070E10 Val_Wu16 655350.0 DDRCTime_ms 0.00 655350.0 FORMAT "%8.1" /end CHARACTERISTIC
/begin CHARACTERISTIC DDRC_DurDeb.PCV_tiSRCMinDebDef_C "/" VALUE 0x80070E12 Val_Wu16 655350.0 DDRCTime_ms 0.00 655350.0 FORMAT "%8.1" /end CHARACTERISTIC
/begin CHARACTERISTIC DDRC_DurDeb.RailP_tiSRCMinDebOk_C "/" VALUE 0x80070E14 Val_Wu16 655350.0 DDRCTime_ms 0.00 655350.0 FORMAT "%8.1" /end CHARACTERISTIC
/begin CHARACTERISTIC DDRC_DurDeb.RailP_tiSRCMinDebDef_C "/" VALUE 0x80070E16 Val_Wu16 655350.0 DDRCTime_ms 0.00 655350.0 FORMAT "%8.1" /end CHARACTERISTIC
/begin CHARACTERISTIC DDRC_DurDeb.MeUn_tiSCBDebOk_C "/" VALUE 0x80070E18 Val_Wu16 655350.0 DDRCTime_ms 0.00 655350.0 FORMAT "%8.1" /end CHARACTERISTIC
/begin CHARACTERISTIC DDRC_DurDeb.MeUn_tiSCBDebDef_C "/" VALUE 0x80070E1A Val_Wu16 655350.0 DDRCTime_ms 0.00 655350.0 FORMAT "%8.1" /end CHARACTERISTIC
/begin CHARACTERISTIC DDRC_DurDeb.MeUn_tiSRCMinDebOk_C "/" VALUE 0x80070E1C Val_Wu16 655350.0 DDRCTime_ms 0.00 655350.0 FORMAT "%8.1" /end CHARACTERISTIC
/begin CHARACTERISTIC DDRC_DurDeb.MeUn_tiSRCMinDebDef_C "/" VALUE 0x80070E1E Val_Wu16 655350.0 DDRCTime_ms 0.00 655350.0 FORMAT "%8.1" /end CHARACTERISTIC
/begin CHARACTERISTIC DDRC_DurDeb.PCV_tiOLDebOk_C "/" VALUE 0x80070E20 Val_Wu16 655350.0 DDRCTime_ms 0.00 655350.0 FORMAT "%8.1" /end CHARACTERISTIC
/begin CHARACTERISTIC DDRC_DurDeb.PCV_tiOLDebDef_C "/" VALUE 0x80070E22 Val_Wu16 655350.0 DDRCTime_ms 0.00 655350.0 FORMAT "%8.1" /end CHARACTERISTIC
/begin CHARACTERISTIC DDRC_DurDeb.MeUn_tiSRCMaxDebOk_C "/" VALUE 0x80070E24 Val_Wu16 655350.0 DDRCTime_ms 0.00 655350.0 FORMAT "%8.1" /end CHARACTERISTIC
/begin CHARACTERISTIC DDRC_DurDeb.MeUn_tiSRCMaxDebDef_C "/" VALUE 0x80070E26 Val_Wu16 655350.0 DDRCTime_ms 0.00 655350.0 FORMAT "%8.1" /end CHARACTERISTIC
/begin CHARACTERISTIC DDRC_DurDeb.PCV_tiSRCMaxDebOk_C "/" VALUE 0x80070E28 Val_Wu16 655350.0 DDRCTime_ms 0.00 655350.0 FORMAT "%8.1" /end CHARACTERISTIC
/begin CHARACTERISTIC DDRC_DurDeb.PCV_tiSRCMaxDebDef_C "/" VALUE 0x80070E2A Val_Wu16 655350.0 DDRCTime_ms 0.00 655350.0 FORMAT "%8.1" /end CHARACTERISTIC
/begin CHARACTERISTIC DDRC_DurDeb.PCV_tiSCBDebOk_C "/" VALUE 0x80070E2C Val_Wu16 655350.0 DDRCTime_ms 0.00 655350.0 FORMAT "%8.1" /end CHARACTERISTIC
/begin CHARACTERISTIC DDRC_DurDeb.PCV_tiSCBDebDef_C "/" VALUE 0x80070E2E Val_Wu16 655350.0 DDRCTime_ms 0.00 655350.0 FORMAT "%8.1" /end CHARACTERISTIC
/begin CHARACTERISTIC DDRC_DurDeb.CtT_tiMinDebOk_C "/" VALUE 0x80070E30 Val_Wu16 655350.0 DDRCTime_ms 0.00 655350.0 FORMAT "%8.1" /end CHARACTERISTIC
/begin CHARACTERISTIC DDRC_DurDeb.CtT_tiMinDebDef_C "/" VALUE 0x80070E32 Val_Wu16 655350.0 DDRCTime_ms 0.00 655350.0 FORMAT "%8.1" /end CHARACTERISTIC
/begin CHARACTERISTIC DDRC_DurDeb.DSMTst_ExampleDebOk_C "/" VALUE 0x80070E34 Val_Wu16 655350.0 DDRCTime_ms 0.00 655350.0 FORMAT "%8.1" /end CHARACTERISTIC
/begin CHARACTERISTIC DDRC_DurDeb.DSMTst_ExampleDebDef_C "/" VALUE 0x80070E36 Val_Wu16 655350.0 DDRCTime_ms 0.00 655350.0 FORMAT "%8.1" /end CHARACTERISTIC
/begin CHARACTERISTIC DDRC_DurDeb.RailP_tiSRCMaxDebOk_C "/" VALUE 0x80070E38 Val_Wu16 655350.0 DDRCTime_ms 0.00 655350.0 FORMAT "%8.1" /end CHARACTERISTIC
/begin CHARACTERISTIC DDRC_DurDeb.RailP_tiSRCMaxDebDef_C "/" VALUE 0x80070E3A Val_Wu16 655350.0 DDRCTime_ms 0.00 655350.0 FORMAT "%8.1" /end CHARACTERISTIC
/begin CHARACTERISTIC DDRC_DurDeb.IVPSply_numVltgSRCMaxDebOk_C "/" VALUE 0x80070E3C Val_Wu16 65535.00 OneToOne 0.00 65535.00 FORMAT "%8.2" /end CHARACTERISTIC
/begin CHARACTERISTIC DDRC_DurDeb.IVPSply_numVltgSRCMaxDebDef_C "/" VALUE 0x80070E3E Val_Wu16 65535.00 OneToOne 0.00 65535.00 FORMAT "%8.2" /end CHARACTERISTIC
/begin CHARACTERISTIC DDRC_DurDeb.IVActr_numVltgSRCMaxDebOk_C "/" VALUE 0x80070E40 Val_Wu16 65535.00 OneToOne 0.00 65535.00 FORMAT "%8.2" /end CHARACTERISTIC
/begin CHARACTERISTIC DDRC_DurDeb.IVActr_numVltgSRCMaxDebDef_C "/" VALUE 0x80070E42 Val_Wu16 65535.00 OneToOne 0.00 65535.00 FORMAT "%8.2" /end CHARACTERISTIC
/begin CHARACTERISTIC DDRC_DurDeb.IVActr_numVltgSRCMinDebOk_C "/" VALUE 0x80070E44 Val_Wu16 65535.00 OneToOne 0.00 65535.00 FORMAT "%8.2" /end CHARACTERISTIC
/begin CHARACTERISTIC DDRC_DurDeb.IVActr_numVltgSRCMinDebDef_C "/" VALUE 0x80070E46 Val_Wu16 65535.00 OneToOne 0.00 65535.00 FORMAT "%8.2" /end CHARACTERISTIC
/begin CHARACTERISTIC DDRC_DurDeb.IVPSply_numDCDCDebOk_C "/" VALUE 0x80070E48 Val_Wu16 65535.00 OneToOne 0.00 65535.00 FORMAT "%8.2" /end CHARACTERISTIC
/begin CHARACTERISTIC DDRC_DurDeb.IVPSply_numDCDCDebDef_C "/" VALUE 0x80070E4A Val_Wu16 65535.00 OneToOne 0.00 65535.00 FORMAT "%8.2" /end CHARACTERISTIC
/begin CHARACTERISTIC DDRC_DurDeb.IVPSply_numVltgSRCMinDebOk_C "/" VALUE 0x80070E4C Val_Wu16 65535.00 OneToOne 0.00 65535.00 FORMAT "%8.2" /end CHARACTERISTIC
/begin CHARACTERISTIC DDRC_DurDeb.IVPSply_numVltgSRCMinDebDef_C "/" VALUE 0x80070E4E Val_Wu16 65535.00 OneToOne 0.00 65535.00 FORMAT "%8.2" /end CHARACTERISTIC
/begin CHARACTERISTIC DDRC_DurDeb.AirC_tiCmprSCBDebOk_C "/" VALUE 0x80070E50 Val_Wu16 655350.0 DDRCTime_ms 0.00 655350.0 FORMAT "%8.1" /end CHARACTERISTIC
/begin CHARACTERISTIC DDRC_DurDeb.AirC_tiCmprSCBDebDef_C "/" VALUE 0x80070E52 Val_Wu16 655350.0 DDRCTime_ms 0.00 655350.0 FORMAT "%8.1" /end CHARACTERISTIC
/begin CHARACTERISTIC DDRC_DurDeb.VSwVlv_tiOLDebOk_C "/" VALUE 0x80070E54 Val_Wu16 655350.0 DDRCTime_ms 0.00 655350.0 FORMAT "%8.1" /end CHARACTERISTIC
/begin CHARACTERISTIC DDRC_DurDeb.VSwVlv_tiOLDebDef_C "/" VALUE 0x80070E56 Val_Wu16 655350.0 DDRCTime_ms 0.00 655350.0 FORMAT "%8.1" /end CHARACTERISTIC
/begin CHARACTERISTIC DDRC_DurDeb.CEngUsT_tiSRCMinDebOk_C "/" VALUE 0x80070E58 Val_Wu16 655350.0 DDRCTime_ms 0.00 655350.0 FORMAT "%8.1" /end CHARACTERISTIC
/begin CHARACTERISTIC DDRC_DurDeb.CEngUsT_tiSRCMinDebDef_C "/" VALUE 0x80070E5A Val_Wu16 655350.0 DDRCTime_ms 0.00 655350.0 FORMAT "%8.1" /end CHARACTERISTIC
/begin CHARACTERISTIC DDRC_DurDeb.Air_tiDtyCycLoTAFSDebOk_C "/" VALUE 0x80070E5C Val_Wu16 655350.0 DDRCTime_ms 0.00 655350.0 FORMAT "%8.1" /end CHARACTERISTIC
/begin CHARACTERISTIC DDRC_DurDeb.Air_tiDtyCycLoTAFSDebDef_C "/" VALUE 0x80070E5E Val_Wu16 655350.0 DDRCTime_ms 0.00 655350.0 FORMAT "%8.1" /end CHARACTERISTIC
/begin CHARACTERISTIC DDRC_DurDeb.EMDmp_tiSCBDebOk_C "/" VALUE 0x80070E60 Val_Wu16 655350.0 DDRCTime_ms 0.00 655350.0 FORMAT "%8.1" /end CHARACTERISTIC
/begin CHARACTERISTIC DDRC_DurDeb.EMDmp_tiSCBDebDef_C "/" VALUE 0x80070E62 Val_Wu16 655350.0 DDRCTime_ms 0.00 655350.0 FORMAT "%8.1" /end CHARACTERISTIC
/begin CHARACTERISTIC DDRC_DurDeb.ECBVlv_tiSRCMaxDebOk_C "/" VALUE 0x80070E64 Val_Wu16 655350.0 DDRCTime_ms 0.00 655350.0 FORMAT "%8.1" /end CHARACTERISTIC
/begin CHARACTERISTIC DDRC_DurDeb.ECBVlv_tiSRCMaxDebDef_C "/" VALUE 0x80070E66 Val_Wu16 655350.0 DDRCTime_ms 0.00 655350.0 FORMAT "%8.1" /end CHARACTERISTIC
/begin CHARACTERISTIC DDRC_DurDeb.TrbCh_tiOLDebOk_C "/" VALUE 0x80070E68 Val_Wu16 655350.0 DDRCTime_ms 0.00 655350.0 FORMAT "%8.1" /end CHARACTERISTIC
/begin CHARACTERISTIC DDRC_DurDeb.TrbCh_tiOLDebDef_C "/" VALUE 0x80070E6A Val_Wu16 655350.0 DDRCTime_ms 0.00 655350.0 FORMAT "%8.1" /end CHARACTERISTIC
/begin CHARACTERISTIC DDRC_DurDeb.LSU_tiHtrSigDebOk_C "/" VALUE 0x80070E6C Val_Wu16 655350.0 DDRCTime_ms 0.00 655350.0 FORMAT "%8.1" /end CHARACTERISTIC
/begin CHARACTERISTIC DDRC_DurDeb.LSU_tiHtrSigDebDef_C "/" VALUE 0x80070E6E Val_Wu16 655350.0 DDRCTime_ms 0.00 655350.0 FORMAT "%8.1" /end CHARACTERISTIC
/begin CHARACTERISTIC DDRC_DurDeb.EGRVlv_tiSCGDebOk_C "/" VALUE 0x80070E70 Val_Wu16 655350.0 DDRCTime_ms 0.00 655350.0 FORMAT "%8.1" /end CHARACTERISTIC
/begin CHARACTERISTIC DDRC_DurDeb.EGRVlv_tiSCGDebDef_C "/" VALUE 0x80070E72 Val_Wu16 655350.0 DDRCTime_ms 0.00 655350.0 FORMAT "%8.1" /end CHARACTERISTIC
/begin CHARACTERISTIC DDRC_DurDeb.InjVlv_tiPresMinDebOk_C "/" VALUE 0x80070E74 Val_Wu16 655350.0 DDRCTime_ms 0.00 655350.0 FORMAT "%8.1" /end CHARACTERISTIC
/begin CHARACTERISTIC DDRC_DurDeb.InjVlv_tiPresMinDebDef_C "/" VALUE 0x80070E76 Val_Wu16 655350.0 DDRCTime_ms 0.00 655350.0 FORMAT "%8.1" /end CHARACTERISTIC
/begin CHARACTERISTIC DDRC_DurDeb.TECU_tiSRCMinDebOk_C "/" VALUE 0x80070E78 Val_Wu16 655350.0 DDRCTime_ms 0.00 655350.0 FORMAT "%8.1" /end CHARACTERISTIC
/begin CHARACTERISTIC DDRC_DurDeb.TECU_tiSRCMinDebDef_C "/" VALUE 0x80070E7A Val_Wu16 655350.0 DDRCTime_ms 0.00 655350.0 FORMAT "%8.1" /end CHARACTERISTIC
/begin CHARACTERISTIC DDRC_DurDeb.CEngUsT_tiSRCMaxDebOk_C "/" VALUE 0x80070E7C Val_Wu16 655350.0 DDRCTime_ms 0.00 655350.0 FORMAT "%8.1" /end CHARACTERISTIC
/begin CHARACTERISTIC DDRC_DurDeb.CEngUsT_tiSRCMaxDebDef_C "/" VALUE 0x80070E7E Val_Wu16 655350.0 DDRCTime_ms 0.00 655350.0 FORMAT "%8.1" /end CHARACTERISTIC
/begin CHARACTERISTIC DDRC_DurDeb.GbxNPos_tiSigDebOk_C "/" VALUE 0x80070E80 Val_Wu16 655350.0 DDRCTime_ms 0.00 655350.0 FORMAT "%8.1" /end CHARACTERISTIC
/begin CHARACTERISTIC DDRC_DurDeb.GbxNPos_tiSigDebDef_C "/" VALUE 0x80070E82 Val_Wu16 655350.0 DDRCTime_ms 0.00 655350.0 FORMAT "%8.1" /end CHARACTERISTIC
/begin CHARACTERISTIC DDRC_DurDeb.PFlt_tiSotMsMaxDebOk_C "/" VALUE 0x80070E84 Val_Wu16 655350.0 DDRCTime_ms 0.00 655350.0 FORMAT "%8.1" /end CHARACTERISTIC
/begin CHARACTERISTIC DDRC_DurDeb.PFlt_tiSotMsMaxDebDef_C "/" VALUE 0x80070E86 Val_Wu16 655350.0 DDRCTime_ms 0.00 655350.0 FORMAT "%8.1" /end CHARACTERISTIC
/begin CHARACTERISTIC DDRC_DurDeb.TECU_tiSRCMaxDebOk_C "/" VALUE 0x80070E88 Val_Wu16 655350.0 DDRCTime_ms 0.00 655350.0 FORMAT "%8.1" /end CHARACTERISTIC
/begin CHARACTERISTIC DDRC_DurDeb.TECU_tiSRCMaxDebDef_C "/" VALUE 0x80070E8A Val_Wu16 655350.0 DDRCTime_ms 0.00 655350.0 FORMAT "%8.1" /end CHARACTERISTIC
/begin CHARACTERISTIC DDRC_DurDeb.WaHtEl_tiOLDebOk_C "/" VALUE 0x80070E8C Val_Wu16 655350.0 DDRCTime_ms 0.00 655350.0 FORMAT "%8.1" /end CHARACTERISTIC
/begin CHARACTERISTIC DDRC_DurDeb.WaHtEl_tiOLDebDef_C "/" VALUE 0x80070E8E Val_Wu16 655350.0 DDRCTime_ms 0.00 655350.0 FORMAT "%8.1" /end CHARACTERISTIC
/begin CHARACTERISTIC DDRC_DurDeb.Oil_tiNplTDebOk_C "/" VALUE 0x80070E90 Val_Wu16 655350.0 DDRCTime_ms 0.00 655350.0 FORMAT "%8.1" /end CHARACTERISTIC
/begin CHARACTERISTIC DDRC_DurDeb.Oil_tiNplTDebDef_C "/" VALUE 0x80070E92 Val_Wu16 655350.0 DDRCTime_ms 0.00 655350.0 FORMAT "%8.1" /end CHARACTERISTIC
/begin CHARACTERISTIC DDRC_DurDeb.AFS_tiCorSRCMaxDebOk_C "/" VALUE 0x80070E94 Val_Wu16 655350.0 DDRCTime_ms 0.00 655350.0 FORMAT "%8.1" /end CHARACTERISTIC
/begin CHARACTERISTIC DDRC_DurDeb.AFS_tiCorSRCMaxDebDef_C "/" VALUE 0x80070E96 Val_Wu16 655350.0 DDRCTime_ms 0.00 655350.0 FORMAT "%8.1" /end CHARACTERISTIC
/begin CHARACTERISTIC DDRC_DurDeb.Exh_tiSRCMaxPPFltUsDebOk_C "/" VALUE 0x80070E98 Val_Wu16 655350.0 DDRCTime_ms 0.00 655350.0 FORMAT "%8.1" /end CHARACTERISTIC
/begin CHARACTERISTIC DDRC_DurDeb.Exh_tiSRCMaxPPFltUsDebDef_C "/" VALUE 0x80070E9A Val_Wu16 655350.0 DDRCTime_ms 0.00 655350.0 FORMAT "%8.1" /end CHARACTERISTIC
/begin CHARACTERISTIC DDRC_DurDeb.PFltLmp_tiSCGDebOk_C "/" VALUE 0x80070E9C Val_Wu16 655350.0 DDRCTime_ms 0.00 655350.0 FORMAT "%8.1" /end CHARACTERISTIC
/begin CHARACTERISTIC DDRC_DurDeb.PFltLmp_tiSCGDebDef_C "/" VALUE 0x80070E9E Val_Wu16 655350.0 DDRCTime_ms 0.00 655350.0 FORMAT "%8.1" /end CHARACTERISTIC
/begin CHARACTERISTIC DDRC_DurDeb.ThrVlv_tiOLDebOk_C "/" VALUE 0x80070EA0 Val_Wu16 655350.0 DDRCTime_ms 0.00 655350.0 FORMAT "%8.1" /end CHARACTERISTIC
/begin CHARACTERISTIC DDRC_DurDeb.ThrVlv_tiOLDebDef_C "/" VALUE 0x80070EA2 Val_Wu16 655350.0 DDRCTime_ms 0.00 655350.0 FORMAT "%8.1" /end CHARACTERISTIC
/begin CHARACTERISTIC DDRC_DurDeb.LSU_tiSPISigDebOk_C "/" VALUE 0x80070EA4 Val_Wu16 655350.0 DDRCTime_ms 0.00 655350.0 FORMAT "%8.1" /end CHARACTERISTIC
/begin CHARACTERISTIC DDRC_DurDeb.LSU_tiSPISigDebDef_C "/" VALUE 0x80070EA6 Val_Wu16 655350.0 DDRCTime_ms 0.00 655350.0 FORMAT "%8.1" /end CHARACTERISTIC
/begin CHARACTERISTIC DDRC_DurDeb.CEngDsT_tiMaxDebOk_C "/" VALUE 0x80070EA8 Val_Wu16 655350.0 DDRCTime_ms 0.00 655350.0 FORMAT "%8.1" /end CHARACTERISTIC
/begin CHARACTERISTIC DDRC_DurDeb.CEngDsT_tiMaxDebDef_C "/" VALUE 0x80070EAA Val_Wu16 655350.0 DDRCTime_ms 0.00 655350.0 FORMAT "%8.1" /end CHARACTERISTIC
/begin CHARACTERISTIC DDRC_DurDeb.AirC_tiClntSRCdcycMaxDebOk_C "/" VALUE 0x80070EAC Val_Wu16 655350.0 DDRCTime_ms 0.00 655350.0 FORMAT "%8.1" /end CHARACTERISTIC
/begin CHARACTERISTIC DDRC_DurDeb.AirC_tiClntSRCdcycMaxDebDef_C "/" VALUE 0x80070EAE Val_Wu16 655350.0 DDRCTime_ms 0.00 655350.0 FORMAT "%8.1" /end CHARACTERISTIC
/begin CHARACTERISTIC DDRC_DurDeb.APP_PlaAPP12DebOk_C "/" VALUE 0x80070EB0 Val_Wu16 655350.0 DDRCTime_ms 0.00 655350.0 FORMAT "%8.1" /end CHARACTERISTIC
/begin CHARACTERISTIC DDRC_DurDeb.APP_PlaAPP12DebDef_C "/" VALUE 0x80070EB2 Val_Wu16 655350.0 DDRCTime_ms 0.00 655350.0 FORMAT "%8.1" /end CHARACTERISTIC
/begin CHARACTERISTIC DDRC_DurDeb.WaHtEl_tiSCBDebOk_C "/" VALUE 0x80070EB4 Val_Wu16 655350.0 DDRCTime_ms 0.00 655350.0 FORMAT "%8.1" /end CHARACTERISTIC
/begin CHARACTERISTIC DDRC_DurDeb.WaHtEl_tiSCBDebDef_C "/" VALUE 0x80070EB6 Val_Wu16 655350.0 DDRCTime_ms 0.00 655350.0 FORMAT "%8.1" /end CHARACTERISTIC
/begin CHARACTERISTIC DDRC_DurDeb.Strt_tiOLDebOk_C "/" VALUE 0x80070EB8 Val_Wu16 655350.0 DDRCTime_ms 0.00 655350.0 FORMAT "%8.1" /end CHARACTERISTIC
/begin CHARACTERISTIC DDRC_DurDeb.Strt_tiOLDebDef_C "/" VALUE 0x80070EBA Val_Wu16 655350.0 DDRCTime_ms 0.00 655350.0 FORMAT "%8.1" /end CHARACTERISTIC
/begin CHARACTERISTIC DDRC_DurDeb.AirC_tiCmprRedTrqOLDebOk_C "/" VALUE 0x80070EBC Val_Wu16 655350.0 DDRCTime_ms 0.00 655350.0 FORMAT "%8.1" /end CHARACTERISTIC
/begin CHARACTERISTIC DDRC_DurDeb.AirC_tiCmprRedTrqOLDebDef_C "/" VALUE 0x80070EBE Val_Wu16 655350.0 DDRCTime_ms 0.00 655350.0 FORMAT "%8.1" /end CHARACTERISTIC
/begin CHARACTERISTIC DDRC_DurDeb.APP_tiSRCLowDebOk_C "/" VALUE 0x80070EC0 Val_Wu16 655350.0 DDRCTime_ms 0.00 655350.0 FORMAT "%8.1" /end CHARACTERISTIC
/begin CHARACTERISTIC DDRC_DurDeb.APP_tiSRCLowDebDef_C "/" VALUE 0x80070EC2 Val_Wu16 655350.0 DDRCTime_ms 0.00 655350.0 FORMAT "%8.1" /end CHARACTERISTIC
/begin CHARACTERISTIC DDRC_DurDeb.MeUn_tiSCGDebOk_C "/" VALUE 0x80070EC4 Val_Wu16 655350.0 DDRCTime_ms 0.00 655350.0 FORMAT "%8.1" /end CHARACTERISTIC
/begin CHARACTERISTIC DDRC_DurDeb.MeUn_tiSCGDebDef_C "/" VALUE 0x80070EC6 Val_Wu16 655350.0 DDRCTime_ms 0.00 655350.0 FORMAT "%8.1" /end CHARACTERISTIC
/begin CHARACTERISTIC DDRC_DurDeb.EGRVlv_tiSRCMaxDebOk_C "/" VALUE 0x80070EC8 Val_Wu16 655350.0 DDRCTime_ms 0.00 655350.0 FORMAT "%8.1" /end CHARACTERISTIC
/begin CHARACTERISTIC DDRC_DurDeb.EGRVlv_tiSRCMaxDebDef_C "/" VALUE 0x80070ECA Val_Wu16 655350.0 DDRCTime_ms 0.00 655350.0 FORMAT "%8.1" /end CHARACTERISTIC
/begin CHARACTERISTIC DDRC_DurDeb.Fan_tiOLDebOk_C "/" VALUE 0x80070ECC Val_Wu16 655350.0 DDRCTime_ms 0.00 655350.0 FORMAT "%8.1" /end CHARACTERISTIC
/begin CHARACTERISTIC DDRC_DurDeb.Fan_tiOLDebDef_C "/" VALUE 0x80070ECE Val_Wu16 655350.0 DDRCTime_ms 0.00 655350.0 FORMAT "%8.1" /end CHARACTERISTIC
/begin CHARACTERISTIC DDRC_DurDeb.LSU_tiHtrMaxDebOk_C "/" VALUE 0x80070ED0 Val_Wu16 655350.0 DDRCTime_ms 0.00 655350.0 FORMAT "%8.1" /end CHARACTERISTIC
/begin CHARACTERISTIC DDRC_DurDeb.LSU_tiHtrMaxDebDef_C "/" VALUE 0x80070ED2 Val_Wu16 655350.0 DDRCTime_ms 0.00 655350.0 FORMAT "%8.1" /end CHARACTERISTIC
/begin CHARACTERISTIC DDRC_DurDeb.VSwVlv_tiSRCMinDebOk_C "/" VALUE 0x80070ED4 Val_Wu16 655350.0 DDRCTime_ms 0.00 655350.0 FORMAT "%8.1" /end CHARACTERISTIC
/begin CHARACTERISTIC DDRC_DurDeb.VSwVlv_tiSRCMinDebDef_C "/" VALUE 0x80070ED6 Val_Wu16 655350.0 DDRCTime_ms 0.00 655350.0 FORMAT "%8.1" /end CHARACTERISTIC
/begin CHARACTERISTIC DDRC_DurDeb.CEngDsT_tiSigDebOk_C "/" VALUE 0x80070ED8 Val_Wu16 655350.0 DDRCTime_ms 0.00 655350.0 FORMAT "%8.1" /end CHARACTERISTIC
/begin CHARACTERISTIC DDRC_DurDeb.CEngDsT_tiSigDebDef_C "/" VALUE 0x80070EDA Val_Wu16 655350.0 DDRCTime_ms 0.00 655350.0 FORMAT "%8.1" /end CHARACTERISTIC
/begin CHARACTERISTIC DDRC_DurDeb.AirC_tiCmprOLDebOk_C "/" VALUE 0x80070EDC Val_Wu16 655350.0 DDRCTime_ms 0.00 655350.0 FORMAT "%8.1" /end CHARACTERISTIC
/begin CHARACTERISTIC DDRC_DurDeb.AirC_tiCmprOLDebDef_C "/" VALUE 0x80070EDE Val_Wu16 655350.0 DDRCTime_ms 0.00 655350.0 FORMAT "%8.1" /end CHARACTERISTIC
/begin CHARACTERISTIC DDRC_DurDeb.AirC_tiCmprRedTrqSCGDebOk_C "/" VALUE 0x80070EE0 Val_Wu16 655350.0 DDRCTime_ms 0.00 655350.0 FORMAT "%8.1" /end CHARACTERISTIC
/begin CHARACTERISTIC DDRC_DurDeb.AirC_tiCmprRedTrqSCGDebDef_C "/" VALUE 0x80070EE2 Val_Wu16 655350.0 DDRCTime_ms 0.00 655350.0 FORMAT "%8.1" /end CHARACTERISTIC
/begin CHARACTERISTIC DDRC_DurDeb.GlwPlg_tiComErrDebOk_C "/" VALUE 0x80070EE4 Val_Wu16 655350.0 DDRCTime_ms 0.00 655350.0 FORMAT "%8.1" /end CHARACTERISTIC
/begin CHARACTERISTIC DDRC_DurDeb.GlwPlg_tiComErrDebDef_C "/" VALUE 0x80070EE6 Val_Wu16 655350.0 DDRCTime_ms 0.00 655350.0 FORMAT "%8.1" /end CHARACTERISTIC
/begin CHARACTERISTIC DDRC_DurDeb.Air_tiPerHiTAFSDebOk_C "/" VALUE 0x80070EE8 Val_Wu16 655350.0 DDRCTime_ms 0.00 655350.0 FORMAT "%8.1" /end CHARACTERISTIC
/begin CHARACTERISTIC DDRC_DurDeb.Air_tiPerHiTAFSDebDef_C "/" VALUE 0x80070EEA Val_Wu16 655350.0 DDRCTime_ms 0.00 655350.0 FORMAT "%8.1" /end CHARACTERISTIC
/begin CHARACTERISTIC DDRC_DurDeb.ErrLmp_tiMILOLDebOk_C "/" VALUE 0x80070EEC Val_Wu16 655350.0 DDRCTime_ms 0.00 655350.0 FORMAT "%8.1" /end CHARACTERISTIC
/begin CHARACTERISTIC DDRC_DurDeb.ErrLmp_tiMILOLDebDef_C "/" VALUE 0x80070EEE Val_Wu16 655350.0 DDRCTime_ms 0.00 655350.0 FORMAT "%8.1" /end CHARACTERISTIC
/begin CHARACTERISTIC DDRC_DurDeb.EngStA_tiSCGDebOk_C "/" VALUE 0x80070EF0 Val_Wu16 655350.0 DDRCTime_ms 0.00 655350.0 FORMAT "%8.1" /end CHARACTERISTIC
/begin CHARACTERISTIC DDRC_DurDeb.EngStA_tiSCGDebDef_C "/" VALUE 0x80070EF2 Val_Wu16 655350.0 DDRCTime_ms 0.00 655350.0 FORMAT "%8.1" /end CHARACTERISTIC
/begin CHARACTERISTIC DDRC_DurDeb.FlFlt_tiSigDebOk_C "/" VALUE 0x80070EF4 Val_Wu16 655350.0 DDRCTime_ms 0.00 655350.0 FORMAT "%8.1" /end CHARACTERISTIC
/begin CHARACTERISTIC DDRC_DurDeb.FlFlt_tiSigDebDef_C "/" VALUE 0x80070EF6 Val_Wu16 655350.0 DDRCTime_ms 0.00 655350.0 FORMAT "%8.1" /end CHARACTERISTIC
/begin CHARACTERISTIC DDRC_DurDeb.ThrVlv_tiSCBDebOk_C "/" VALUE 0x80070EF8 Val_Wu16 655350.0 DDRCTime_ms 0.00 655350.0 FORMAT "%8.1" /end CHARACTERISTIC
/begin CHARACTERISTIC DDRC_DurDeb.ThrVlv_tiSCBDebDef_C "/" VALUE 0x80070EFA Val_Wu16 655350.0 DDRCTime_ms 0.00 655350.0 FORMAT "%8.1" /end CHARACTERISTIC
/begin CHARACTERISTIC DDRC_DurDeb.FuelT_tiMaxDebOk_C "/" VALUE 0x80070EFC Val_Wu16 655350.0 DDRCTime_ms 0.00 655350.0 FORMAT "%8.1" /end CHARACTERISTIC
/begin CHARACTERISTIC DDRC_DurDeb.FuelT_tiMaxDebDef_C "/" VALUE 0x80070EFE Val_Wu16 655350.0 DDRCTime_ms 0.00 655350.0 FORMAT "%8.1" /end CHARACTERISTIC
/begin CHARACTERISTIC DDRC_DurDeb.BrkP_tiMinDebOk_C "/" VALUE 0x80070F00 Val_Wu16 655350.0 DDRCTime_ms 0.00 655350.0 FORMAT "%8.1" /end CHARACTERISTIC
/begin CHARACTERISTIC DDRC_DurDeb.BrkP_tiMinDebDef_C "/" VALUE 0x80070F02 Val_Wu16 655350.0 DDRCTime_ms 0.00 655350.0 FORMAT "%8.1" /end CHARACTERISTIC
/begin CHARACTERISTIC DDRC_DurDeb.ErrLmp_tiSVSSCBDebOk_C "/" VALUE 0x80070F04 Val_Wu16 655350.0 DDRCTime_ms 0.00 655350.0 FORMAT "%8.1" /end CHARACTERISTIC
/begin CHARACTERISTIC DDRC_DurDeb.ErrLmp_tiSVSSCBDebDef_C "/" VALUE 0x80070F06 Val_Wu16 655350.0 DDRCTime_ms 0.00 655350.0 FORMAT "%8.1" /end CHARACTERISTIC
/begin CHARACTERISTIC DDRC_DurDeb.T15_tiNplDebOk_C "/" VALUE 0x80070F08 Val_Wu16 655350.0 DDRCTime_ms 0.00 655350.0 FORMAT "%8.1" /end CHARACTERISTIC
/begin CHARACTERISTIC DDRC_DurDeb.T15_tiNplDebDef_C "/" VALUE 0x80070F0A Val_Wu16 655350.0 DDRCTime_ms 0.00 655350.0 FORMAT "%8.1" /end CHARACTERISTIC
/begin CHARACTERISTIC DDRC_DurDeb.APP_tiSRCHighDebOk_C "/" VALUE 0x80070F0C Val_Wu16 655350.0 DDRCTime_ms 0.00 655350.0 FORMAT "%8.1" /end CHARACTERISTIC
/begin CHARACTERISTIC DDRC_DurDeb.APP_tiSRCHighDebDef_C "/" VALUE 0x80070F0E Val_Wu16 655350.0 DDRCTime_ms 0.00 655350.0 FORMAT "%8.1" /end CHARACTERISTIC
/begin CHARACTERISTIC DDRC_DurDeb.AirC_tiClntSRCMaxDebOk_C "/" VALUE 0x80070F10 Val_Wu16 655350.0 DDRCTime_ms 0.00 655350.0 FORMAT "%8.1" /end CHARACTERISTIC
/begin CHARACTERISTIC DDRC_DurDeb.AirC_tiClntSRCMaxDebDef_C "/" VALUE 0x80070F12 Val_Wu16 655350.0 DDRCTime_ms 0.00 655350.0 FORMAT "%8.1" /end CHARACTERISTIC
/begin CHARACTERISTIC DDRC_DurDeb.Oil_tiNplPDebOk_C "/" VALUE 0x80070F14 Val_Wu16 655350.0 DDRCTime_ms 0.00 655350.0 FORMAT "%8.1" /end CHARACTERISTIC
/begin CHARACTERISTIC DDRC_DurDeb.Oil_tiNplPDebDef_C "/" VALUE 0x80070F16 Val_Wu16 655350.0 DDRCTime_ms 0.00 655350.0 FORMAT "%8.1" /end CHARACTERISTIC
/begin CHARACTERISTIC DDRC_DurDeb.PFlt_tiDstrMinDebOk_C "/" VALUE 0x80070F18 Val_Wu16 655350.0 DDRCTime_ms 0.00 655350.0 FORMAT "%8.1" /end CHARACTERISTIC
/begin CHARACTERISTIC DDRC_DurDeb.PFlt_tiDstrMinDebDef_C "/" VALUE 0x80070F1A Val_Wu16 655350.0 DDRCTime_ms 0.00 655350.0 FORMAT "%8.1" /end CHARACTERISTIC
/begin CHARACTERISTIC DDRC_DurDeb.AFS_tiOffsDrftMaxDebOk_C "/" VALUE 0x80070F1C Val_Wu16 655350.0 DDRCTime_ms 0.00 655350.0 FORMAT "%8.1" /end CHARACTERISTIC
/begin CHARACTERISTIC DDRC_DurDeb.AFS_tiOffsDrftMaxDebDef_C "/" VALUE 0x80070F1E Val_Wu16 655350.0 DDRCTime_ms 0.00 655350.0 FORMAT "%8.1" /end CHARACTERISTIC
/begin CHARACTERISTIC DDRC_DurDeb.GlwPlg_tiBSDOLDebOk_C "/" VALUE 0x80070F20 Val_Wu16 655350.0 DDRCTime_ms 0.00 655350.0 FORMAT "%8.1" /end CHARACTERISTIC
/begin CHARACTERISTIC DDRC_DurDeb.GlwPlg_tiBSDOLDebDef_C "/" VALUE 0x80070F22 Val_Wu16 655350.0 DDRCTime_ms 0.00 655350.0 FORMAT "%8.1" /end CHARACTERISTIC
/begin CHARACTERISTIC DDRC_DurDeb.PFlt_tiSRCMinFlwRstnDebOk_C "/" VALUE 0x80070F24 Val_Wu16 655350.0 DDRCTime_ms 0.00 655350.0 FORMAT "%8.1" /end CHARACTERISTIC
/begin CHARACTERISTIC DDRC_DurDeb.PFlt_tiSRCMinFlwRstnDebDef_C "/" VALUE 0x80070F26 Val_Wu16 655350.0 DDRCTime_ms 0.00 655350.0 FORMAT "%8.1" /end CHARACTERISTIC
/begin CHARACTERISTIC DDRC_DurDeb.AirC_tiClntSRCPerMaxDebOk_C "/" VALUE 0x80070F28 Val_Wu16 655350.0 DDRCTime_ms 0.00 655350.0 FORMAT "%8.1" /end CHARACTERISTIC
/begin CHARACTERISTIC DDRC_DurDeb.AirC_tiClntSRCPerMaxDebDef_C "/" VALUE 0x80070F2A Val_Wu16 655350.0 DDRCTime_ms 0.00 655350.0 FORMAT "%8.1" /end CHARACTERISTIC
/begin CHARACTERISTIC DDRC_DurDeb.Exh_tiSRCMinPPFltUsDebOk_C "/" VALUE 0x80070F2C Val_Wu16 655350.0 DDRCTime_ms 0.00 655350.0 FORMAT "%8.1" /end CHARACTERISTIC
/begin CHARACTERISTIC DDRC_DurDeb.Exh_tiSRCMinPPFltUsDebDef_C "/" VALUE 0x80070F2E Val_Wu16 655350.0 DDRCTime_ms 0.00 655350.0 FORMAT "%8.1" /end CHARACTERISTIC
/begin CHARACTERISTIC DDRC_DurDeb.EngStA_tiSCBDebOk_C "/" VALUE 0x80070F30 Val_Wu16 655350.0 DDRCTime_ms 0.00 655350.0 FORMAT "%8.1" /end CHARACTERISTIC
/begin CHARACTERISTIC DDRC_DurDeb.EngStA_tiSCBDebDef_C "/" VALUE 0x80070F32 Val_Wu16 655350.0 DDRCTime_ms 0.00 655350.0 FORMAT "%8.1" /end CHARACTERISTIC
/begin CHARACTERISTIC DDRC_DurDeb.OilPLmp_tiSCBDebOk_C "/" VALUE 0x80070F34 Val_Wu16 655350.0 DDRCTime_ms 0.00 655350.0 FORMAT "%8.1" /end CHARACTERISTIC
/begin CHARACTERISTIC DDRC_DurDeb.OilPLmp_tiSCBDebDef_C "/" VALUE 0x80070F36 Val_Wu16 655350.0 DDRCTime_ms 0.00 655350.0 FORMAT "%8.1" /end CHARACTERISTIC
/begin CHARACTERISTIC DDRC_DurDeb.PFlt_tiNplHsChngPPFltDiffDebOk_C "/" VALUE 0x80070F38 Val_Wu16 655350.0 DDRCTime_ms 0.00 655350.0 FORMAT "%8.1" /end CHARACTERISTIC
/begin CHARACTERISTIC DDRC_DurDeb.PFlt_tiNplHsChngPPFltDiffDebDef_C "/" VALUE 0x80070F3A Val_Wu16 655350.0 DDRCTime_ms 0.00 655350.0 FORMAT "%8.1" /end CHARACTERISTIC
/begin CHARACTERISTIC DDRC_DurDeb.AirC_tiSwtNplDebOk_C "/" VALUE 0x80070F3C Val_Wu16 655350.0 DDRCTime_ms 0.00 655350.0 FORMAT "%8.1" /end CHARACTERISTIC
/begin CHARACTERISTIC DDRC_DurDeb.AirC_tiSwtNplDebDef_C "/" VALUE 0x80070F3E Val_Wu16 655350.0 DDRCTime_ms 0.00 655350.0 FORMAT "%8.1" /end CHARACTERISTIC
/begin CHARACTERISTIC DDRC_DurDeb.PFlt_tiSRCMaxFlwRstnDebOk_C "/" VALUE 0x80070F40 Val_Wu16 655350.0 DDRCTime_ms 0.00 655350.0 FORMAT "%8.1" /end CHARACTERISTIC
/begin CHARACTERISTIC DDRC_DurDeb.PFlt_tiSRCMaxFlwRstnDebDef_C "/" VALUE 0x80070F42 Val_Wu16 655350.0 DDRCTime_ms 0.00 655350.0 FORMAT "%8.1" /end CHARACTERISTIC
/begin CHARACTERISTIC DDRC_DurDeb.PFlt_tiRgnPermMaxDebOk_C "/" VALUE 0x80070F44 Val_Wu16 655350.0 DDRCTime_ms 0.00 655350.0 FORMAT "%8.1" /end CHARACTERISTIC
/begin CHARACTERISTIC DDRC_DurDeb.PFlt_tiRgnPermMaxDebDef_C "/" VALUE 0x80070F46 Val_Wu16 655350.0 DDRCTime_ms 0.00 655350.0 FORMAT "%8.1" /end CHARACTERISTIC
/begin CHARACTERISTIC DDRC_DurDeb.Air_PlsPCACDsDebOk_C "/" VALUE 0x80070F48 Val_Wu16 655350.0 DDRCTime_ms 0.00 655350.0 FORMAT "%8.1" /end CHARACTERISTIC
/begin CHARACTERISTIC DDRC_DurDeb.Air_PlsPCACDsDebDef_C "/" VALUE 0x80070F4A Val_Wu16 655350.0 DDRCTime_ms 0.00 655350.0 FORMAT "%8.1" /end CHARACTERISTIC
/begin CHARACTERISTIC DDRC_DurDeb.Strt_tiSCBDebOk_C "/" VALUE 0x80070F4C Val_Wu16 655350.0 DDRCTime_ms 0.00 655350.0 FORMAT "%8.1" /end CHARACTERISTIC
/begin CHARACTERISTIC DDRC_DurDeb.Strt_tiSCBDebDef_C "/" VALUE 0x80070F4E Val_Wu16 655350.0 DDRCTime_ms 0.00 655350.0 FORMAT "%8.1" /end CHARACTERISTIC
/begin CHARACTERISTIC DDRC_DurDeb.PFlt_tiEngPrtMaxDebOk_C "/" VALUE 0x80070F50 Val_Wu16 655350.0 DDRCTime_ms 0.00 655350.0 FORMAT "%8.1" /end CHARACTERISTIC
/begin CHARACTERISTIC DDRC_DurDeb.PFlt_tiEngPrtMaxDebDef_C "/" VALUE 0x80070F52 Val_Wu16 655350.0 DDRCTime_ms 0.00 655350.0 FORMAT "%8.1" /end CHARACTERISTIC
/begin CHARACTERISTIC DDRC_DurDeb.AirC_tiClntSRCMinDebOk_C "/" VALUE 0x80070F54 Val_Wu16 655350.0 DDRCTime_ms 0.00 655350.0 FORMAT "%8.1" /end CHARACTERISTIC
/begin CHARACTERISTIC DDRC_DurDeb.AirC_tiClntSRCMinDebDef_C "/" VALUE 0x80070F56 Val_Wu16 655350.0 DDRCTime_ms 0.00 655350.0 FORMAT "%8.1" /end CHARACTERISTIC
/begin CHARACTERISTIC DDRC_DurDeb.CByVlv_tiSCGDebOk_C "/" VALUE 0x80070F58 Val_Wu16 655350.0 DDRCTime_ms 0.00 655350.0 FORMAT "%8.1" /end CHARACTERISTIC
/begin CHARACTERISTIC DDRC_DurDeb.CByVlv_tiSCGDebDef_C "/" VALUE 0x80070F5A Val_Wu16 655350.0 DDRCTime_ms 0.00 655350.0 FORMAT "%8.1" /end CHARACTERISTIC
/begin CHARACTERISTIC DDRC_DurDeb.AirC_tiClntSRCPerMinDebOk_C "/" VALUE 0x80070F5C Val_Wu16 655350.0 DDRCTime_ms 0.00 655350.0 FORMAT "%8.1" /end CHARACTERISTIC
/begin CHARACTERISTIC DDRC_DurDeb.AirC_tiClntSRCPerMinDebDef_C "/" VALUE 0x80070F5E Val_Wu16 655350.0 DDRCTime_ms 0.00 655350.0 FORMAT "%8.1" /end CHARACTERISTIC
/begin CHARACTERISTIC DDRC_DurDeb.Strt_tiSCGDebOk_C "/" VALUE 0x80070F60 Val_Wu16 655350.0 DDRCTime_ms 0.00 655350.0 FORMAT "%8.1" /end CHARACTERISTIC
/begin CHARACTERISTIC DDRC_DurDeb.Strt_tiSCGDebDef_C "/" VALUE 0x80070F62 Val_Wu16 655350.0 DDRCTime_ms 0.00 655350.0 FORMAT "%8.1" /end CHARACTERISTIC
/begin CHARACTERISTIC DDRC_DurDeb.Clth_tiSigDebOk_C "/" VALUE 0x80070F64 Val_Wu16 655350.0 DDRCTime_ms 0.00 655350.0 FORMAT "%8.1" /end CHARACTERISTIC
/begin CHARACTERISTIC DDRC_DurDeb.Clth_tiSigDebDef_C "/" VALUE 0x80070F66 Val_Wu16 655350.0 DDRCTime_ms 0.00 655350.0 FORMAT "%8.1" /end CHARACTERISTIC
/begin CHARACTERISTIC DDRC_DurDeb.Air_tiSRCMinPCACDsDebOk_C "/" VALUE 0x80070F68 Val_Wu16 655350.0 DDRCTime_ms 0.00 655350.0 FORMAT "%8.1" /end CHARACTERISTIC
/begin CHARACTERISTIC DDRC_DurDeb.Air_tiSRCMinPCACDsDebDef_C "/" VALUE 0x80070F6A Val_Wu16 655350.0 DDRCTime_ms 0.00 655350.0 FORMAT "%8.1" /end CHARACTERISTIC
/begin CHARACTERISTIC DDRC_DurDeb.EngStA_tiOLDebOk_C "/" VALUE 0x80070F6C Val_Wu16 655350.0 DDRCTime_ms 0.00 655350.0 FORMAT "%8.1" /end CHARACTERISTIC
/begin CHARACTERISTIC DDRC_DurDeb.EngStA_tiOLDebDef_C "/" VALUE 0x80070F6E Val_Wu16 655350.0 DDRCTime_ms 0.00 655350.0 FORMAT "%8.1" /end CHARACTERISTIC
/begin CHARACTERISTIC DDRC_DurDeb.GbxNPos_tiSRCPerMinDebOk_C "/" VALUE 0x80070F70 Val_Wu16 655350.0 DDRCTime_ms 0.00 655350.0 FORMAT "%8.1" /end CHARACTERISTIC
/begin CHARACTERISTIC DDRC_DurDeb.GbxNPos_tiSRCPerMinDebDef_C "/" VALUE 0x80070F72 Val_Wu16 655350.0 DDRCTime_ms 0.00 655350.0 FORMAT "%8.1" /end CHARACTERISTIC
/begin CHARACTERISTIC DDRC_DurDeb.LSU_tiCircPmpCurSigDebOk_C "/" VALUE 0x80070F74 Val_Wu16 655350.0 DDRCTime_ms 0.00 655350.0 FORMAT "%8.1" /end CHARACTERISTIC
/begin CHARACTERISTIC DDRC_DurDeb.LSU_tiCircPmpCurSigDebDef_C "/" VALUE 0x80070F76 Val_Wu16 655350.0 DDRCTime_ms 0.00 655350.0 FORMAT "%8.1" /end CHARACTERISTIC
/begin CHARACTERISTIC DDRC_DurDeb.GbxNPos_tiSRCPerMaxDebOk_C "/" VALUE 0x80070F78 Val_Wu16 655350.0 DDRCTime_ms 0.00 655350.0 FORMAT "%8.1" /end CHARACTERISTIC
/begin CHARACTERISTIC DDRC_DurDeb.GbxNPos_tiSRCPerMaxDebDef_C "/" VALUE 0x80070F7A Val_Wu16 655350.0 DDRCTime_ms 0.00 655350.0 FORMAT "%8.1" /end CHARACTERISTIC
/begin CHARACTERISTIC DDRC_DurDeb.OilPLmp_tiOLDebOk_C "/" VALUE 0x80070F7C Val_Wu16 655350.0 DDRCTime_ms 0.00 655350.0 FORMAT "%8.1" /end CHARACTERISTIC
/begin CHARACTERISTIC DDRC_DurDeb.OilPLmp_tiOLDebDef_C "/" VALUE 0x80070F7E Val_Wu16 655350.0 DDRCTime_ms 0.00 655350.0 FORMAT "%8.1" /end CHARACTERISTIC
/begin CHARACTERISTIC DDRC_DurDeb.AFS_tiRawSRCMaxDebOk_C "/" VALUE 0x80070F80 Val_Wu16 655350.0 DDRCTime_ms 0.00 655350.0 FORMAT "%8.1" /end CHARACTERISTIC
/begin CHARACTERISTIC DDRC_DurDeb.AFS_tiRawSRCMaxDebDef_C "/" VALUE 0x80070F82 Val_Wu16 655350.0 DDRCTime_ms 0.00 655350.0 FORMAT "%8.1" /end CHARACTERISTIC
/begin CHARACTERISTIC DDRC_DurDeb.VSwVlv_tiSRCMaxDebOk_C "/" VALUE 0x80070F84 Val_Wu16 655350.0 DDRCTime_ms 0.00 655350.0 FORMAT "%8.1" /end CHARACTERISTIC
/begin CHARACTERISTIC DDRC_DurDeb.VSwVlv_tiSRCMaxDebDef_C "/" VALUE 0x80070F86 Val_Wu16 655350.0 DDRCTime_ms 0.00 655350.0 FORMAT "%8.1" /end CHARACTERISTIC
/begin CHARACTERISTIC DDRC_DurDeb.ErrLmp_tiMILSCGDebOk_C "/" VALUE 0x80070F88 Val_Wu16 655350.0 DDRCTime_ms 0.00 655350.0 FORMAT "%8.1" /end CHARACTERISTIC
/begin CHARACTERISTIC DDRC_DurDeb.ErrLmp_tiMILSCGDebDef_C "/" VALUE 0x80070F8A Val_Wu16 655350.0 DDRCTime_ms 0.00 655350.0 FORMAT "%8.1" /end CHARACTERISTIC
/begin CHARACTERISTIC DDRC_DurDeb.ErrLmp_tiSVSOLDebOk_C "/" VALUE 0x80070F8C Val_Wu16 655350.0 DDRCTime_ms 0.00 655350.0 FORMAT "%8.1" /end CHARACTERISTIC
/begin CHARACTERISTIC DDRC_DurDeb.ErrLmp_tiSVSOLDebDef_C "/" VALUE 0x80070F8E Val_Wu16 655350.0 DDRCTime_ms 0.00 655350.0 FORMAT "%8.1" /end CHARACTERISTIC
/begin CHARACTERISTIC DDRC_DurDeb.VSwVlv_tiSCBDebOk_C "/" VALUE 0x80070F90 Val_Wu16 655350.0 DDRCTime_ms 0.00 655350.0 FORMAT "%8.1" /end CHARACTERISTIC
/begin CHARACTERISTIC DDRC_DurDeb.VSwVlv_tiSCBDebDef_C "/" VALUE 0x80070F92 Val_Wu16 655350.0 DDRCTime_ms 0.00 655350.0 FORMAT "%8.1" /end CHARACTERISTIC
/begin CHARACTERISTIC DDRC_DurDeb.LSU_titExcMaxDebOk_C "/" VALUE 0x80070F94 Val_Wu16 655350.0 DDRCTime_ms 0.00 655350.0 FORMAT "%8.1" /end CHARACTERISTIC
/begin CHARACTERISTIC DDRC_DurDeb.LSU_titExcMaxDebDef_C "/" VALUE 0x80070F96 Val_Wu16 655350.0 DDRCTime_ms 0.00 655350.0 FORMAT "%8.1" /end CHARACTERISTIC
/begin CHARACTERISTIC DDRC_DurDeb.ECBVlv_tiSCBDebOk_C "/" VALUE 0x80070F98 Val_Wu16 655350.0 DDRCTime_ms 0.00 655350.0 FORMAT "%8.1" /end CHARACTERISTIC
/begin CHARACTERISTIC DDRC_DurDeb.ECBVlv_tiSCBDebDef_C "/" VALUE 0x80070F9A Val_Wu16 655350.0 DDRCTime_ms 0.00 655350.0 FORMAT "%8.1" /end CHARACTERISTIC
/begin CHARACTERISTIC DDRC_DurDeb.BattU_tiMaxDebOk_C "/" VALUE 0x80070F9C Val_Wu16 655350.0 DDRCTime_ms 0.00 655350.0 FORMAT "%8.1" /end CHARACTERISTIC
/begin CHARACTERISTIC DDRC_DurDeb.BattU_tiMaxDebDef_C "/" VALUE 0x80070F9E Val_Wu16 655350.0 DDRCTime_ms 0.00 655350.0 FORMAT "%8.1" /end CHARACTERISTIC
/begin CHARACTERISTIC DDRC_DurDeb.BattU_tiMinDebOk_C "/" VALUE 0x80070FA0 Val_Wu16 655350.0 DDRCTime_ms 0.00 655350.0 FORMAT "%8.1" /end CHARACTERISTIC
/begin CHARACTERISTIC DDRC_DurDeb.BattU_tiMinDebDef_C "/" VALUE 0x80070FA2 Val_Wu16 655350.0 DDRCTime_ms 0.00 655350.0 FORMAT "%8.1" /end CHARACTERISTIC
/begin CHARACTERISTIC DDRC_DurDeb.VSwVlv_tiSCGDebOk_C "/" VALUE 0x80070FA4 Val_Wu16 655350.0 DDRCTime_ms 0.00 655350.0 FORMAT "%8.1" /end CHARACTERISTIC
/begin CHARACTERISTIC DDRC_DurDeb.VSwVlv_tiSCGDebDef_C "/" VALUE 0x80070FA6 Val_Wu16 655350.0 DDRCTime_ms 0.00 655350.0 FORMAT "%8.1" /end CHARACTERISTIC
/begin CHARACTERISTIC DDRC_DurDeb.ErrLmp_tiMILSCBDebOk_C "/" VALUE 0x80070FA8 Val_Wu16 655350.0 DDRCTime_ms 0.00 655350.0 FORMAT "%8.1" /end CHARACTERISTIC
/begin CHARACTERISTIC DDRC_DurDeb.ErrLmp_tiMILSCBDebDef_C "/" VALUE 0x80070FAA Val_Wu16 655350.0 DDRCTime_ms 0.00 655350.0 FORMAT "%8.1" /end CHARACTERISTIC
/begin CHARACTERISTIC DDRC_DurDeb.ECBVlv_tiSCGDebOk_C "/" VALUE 0x80070FAC Val_Wu16 655350.0 DDRCTime_ms 0.00 655350.0 FORMAT "%8.1" /end CHARACTERISTIC
/begin CHARACTERISTIC DDRC_DurDeb.ECBVlv_tiSCGDebDef_C "/" VALUE 0x80070FAE Val_Wu16 655350.0 DDRCTime_ms 0.00 655350.0 FORMAT "%8.1" /end CHARACTERISTIC
/begin CHARACTERISTIC DDRC_DurDeb.PCV_tiSCGDebOk_C "/" VALUE 0x80070FB0 Val_Wu16 655350.0 DDRCTime_ms 0.00 655350.0 FORMAT "%8.1" /end CHARACTERISTIC
/begin CHARACTERISTIC DDRC_DurDeb.PCV_tiSCGDebDef_C "/" VALUE 0x80070FB2 Val_Wu16 655350.0 DDRCTime_ms 0.00 655350.0 FORMAT "%8.1" /end CHARACTERISTIC
/begin CHARACTERISTIC DDRC_DurDeb.Air_tiMinTCACDsDebOk_C "/" VALUE 0x80070FB4 Val_Wu16 655350.0 DDRCTime_ms 0.00 655350.0 FORMAT "%8.1" /end CHARACTERISTIC
/begin CHARACTERISTIC DDRC_DurDeb.Air_tiMinTCACDsDebDef_C "/" VALUE 0x80070FB6 Val_Wu16 655350.0 DDRCTime_ms 0.00 655350.0 FORMAT "%8.1" /end CHARACTERISTIC
/begin CHARACTERISTIC DDRC_DurDeb.LSU_tiCircPmpCurMaxDebOk_C "/" VALUE 0x80070FB8 Val_Wu16 655350.0 DDRCTime_ms 0.00 655350.0 FORMAT "%8.1" /end CHARACTERISTIC
/begin CHARACTERISTIC DDRC_DurDeb.LSU_tiCircPmpCurMaxDebDef_C "/" VALUE 0x80070FBA Val_Wu16 655350.0 DDRCTime_ms 0.00 655350.0 FORMAT "%8.1" /end CHARACTERISTIC
/begin CHARACTERISTIC DDRC_DurDeb.EGRVlv_tiSCBDebOk_C "/" VALUE 0x80070FBC Val_Wu16 655350.0 DDRCTime_ms 0.00 655350.0 FORMAT "%8.1" /end CHARACTERISTIC
/begin CHARACTERISTIC DDRC_DurDeb.EGRVlv_tiSCBDebDef_C "/" VALUE 0x80070FBE Val_Wu16 655350.0 DDRCTime_ms 0.00 655350.0 FORMAT "%8.1" /end CHARACTERISTIC
/begin CHARACTERISTIC DDRC_DurDeb.Air_tiNplPAirFltDsDebOk_C "/" VALUE 0x80070FC0 Val_Wu16 655350.0 DDRCTime_ms 0.00 655350.0 FORMAT "%8.1" /end CHARACTERISTIC
/begin CHARACTERISTIC DDRC_DurDeb.Air_tiNplPAirFltDsDebDef_C "/" VALUE 0x80070FC2 Val_Wu16 655350.0 DDRCTime_ms 0.00 655350.0 FORMAT "%8.1" /end CHARACTERISTIC
/begin CHARACTERISTIC DDRC_DurDeb.PSP_tiOLDebOk_C "/" VALUE 0x80070FC4 Val_Wu16 655350.0 DDRCTime_ms 0.00 655350.0 FORMAT "%8.1" /end CHARACTERISTIC
/begin CHARACTERISTIC DDRC_DurDeb.PSP_tiOLDebDef_C "/" VALUE 0x80070FC6 Val_Wu16 655350.0 DDRCTime_ms 0.00 655350.0 FORMAT "%8.1" /end CHARACTERISTIC
/begin CHARACTERISTIC DDRC_DurDeb.Air_tiDtyCycHiTAFSDebOk_C "/" VALUE 0x80070FC8 Val_Wu16 655350.0 DDRCTime_ms 0.00 655350.0 FORMAT "%8.1" /end CHARACTERISTIC
/begin CHARACTERISTIC DDRC_DurDeb.Air_tiDtyCycHiTAFSDebDef_C "/" VALUE 0x80070FCA Val_Wu16 655350.0 DDRCTime_ms 0.00 655350.0 FORMAT "%8.1" /end CHARACTERISTIC
/begin CHARACTERISTIC DDRC_DurDeb.EnvP_tiMaxDebOk_C "/" VALUE 0x80070FCC Val_Wu16 655350.0 DDRCTime_ms 0.00 655350.0 FORMAT "%8.1" /end CHARACTERISTIC
/begin CHARACTERISTIC DDRC_DurDeb.EnvP_tiMaxDebDef_C "/" VALUE 0x80070FCE Val_Wu16 655350.0 DDRCTime_ms 0.00 655350.0 FORMAT "%8.1" /end CHARACTERISTIC
/begin CHARACTERISTIC DDRC_DurDeb.CByVlv_tiOLDebOk_C "/" VALUE 0x80070FD0 Val_Wu16 655350.0 DDRCTime_ms 0.00 655350.0 FORMAT "%8.1" /end CHARACTERISTIC
/begin CHARACTERISTIC DDRC_DurDeb.CByVlv_tiOLDebDef_C "/" VALUE 0x80070FD2 Val_Wu16 655350.0 DDRCTime_ms 0.00 655350.0 FORMAT "%8.1" /end CHARACTERISTIC
/begin CHARACTERISTIC DDRC_DurDeb.FuelT_tiMinDebOk_C "/" VALUE 0x80070FD4 Val_Wu16 655350.0 DDRCTime_ms 0.00 655350.0 FORMAT "%8.1" /end CHARACTERISTIC
/begin CHARACTERISTIC DDRC_DurDeb.FuelT_tiMinDebDef_C "/" VALUE 0x80070FD6 Val_Wu16 655350.0 DDRCTime_ms 0.00 655350.0 FORMAT "%8.1" /end CHARACTERISTIC
/begin CHARACTERISTIC DDRC_DurDeb.PFltLmp_tiSCBDebOk_C "/" VALUE 0x80070FD8 Val_Wu16 655350.0 DDRCTime_ms 0.00 655350.0 FORMAT "%8.1" /end CHARACTERISTIC
/begin CHARACTERISTIC DDRC_DurDeb.PFltLmp_tiSCBDebDef_C "/" VALUE 0x80070FDA Val_Wu16 655350.0 DDRCTime_ms 0.00 655350.0 FORMAT "%8.1" /end CHARACTERISTIC
/begin CHARACTERISTIC DDRC_DurDeb.Exh_tiSRCMinTOxiCatUsDebOk_C "/" VALUE 0x80070FDC Val_Wu16 655350.0 DDRCTime_ms 0.00 655350.0 FORMAT "%8.1" /end CHARACTERISTIC
/begin CHARACTERISTIC DDRC_DurDeb.Exh_tiSRCMinTOxiCatUsDebDef_C "/" VALUE 0x80070FDE Val_Wu16 655350.0 DDRCTime_ms 0.00 655350.0 FORMAT "%8.1" /end CHARACTERISTIC
/begin CHARACTERISTIC DDRC_DurDeb.VehV_tiHWDebOk_C "/" VALUE 0x80070FE0 Val_Wu16 655350.0 DDRCTime_ms 0.00 655350.0 FORMAT "%8.1" /end CHARACTERISTIC
/begin CHARACTERISTIC DDRC_DurDeb.VehV_tiHWDebDef_C "/" VALUE 0x80070FE2 Val_Wu16 655350.0 DDRCTime_ms 0.00 655350.0 FORMAT "%8.1" /end CHARACTERISTIC
/begin CHARACTERISTIC DDRC_DurDeb.PSP_tiSCBDebOk_C "/" VALUE 0x80070FE4 Val_Wu16 655350.0 DDRCTime_ms 0.00 655350.0 FORMAT "%8.1" /end CHARACTERISTIC
/begin CHARACTERISTIC DDRC_DurDeb.PSP_tiSCBDebDef_C "/" VALUE 0x80070FE6 Val_Wu16 655350.0 DDRCTime_ms 0.00 655350.0 FORMAT "%8.1" /end CHARACTERISTIC
/begin CHARACTERISTIC DDRC_DurDeb.CThmst_tiSCBDebOk_C "/" VALUE 0x80070FE8 Val_Wu16 655350.0 DDRCTime_ms 0.00 655350.0 FORMAT "%8.1" /end CHARACTERISTIC
/begin CHARACTERISTIC DDRC_DurDeb.CThmst_tiSCBDebDef_C "/" VALUE 0x80070FEA Val_Wu16 655350.0 DDRCTime_ms 0.00 655350.0 FORMAT "%8.1" /end CHARACTERISTIC
/begin CHARACTERISTIC DDRC_DurDeb.AirC_tiClntSRCdcycMinDebOk_C "/" VALUE 0x80070FEC Val_Wu16 655350.0 DDRCTime_ms 0.00 655350.0 FORMAT "%8.1" /end CHARACTERISTIC
/begin CHARACTERISTIC DDRC_DurDeb.AirC_tiClntSRCdcycMinDebDef_C "/" VALUE 0x80070FEE Val_Wu16 655350.0 DDRCTime_ms 0.00 655350.0 FORMAT "%8.1" /end CHARACTERISTIC
/begin CHARACTERISTIC DDRC_DurDeb.Air_tiMaxTCACDsDebOk_C "/" VALUE 0x80070FF0 Val_Wu16 655350.0 DDRCTime_ms 0.00 655350.0 FORMAT "%8.1" /end CHARACTERISTIC
/begin CHARACTERISTIC DDRC_DurDeb.Air_tiMaxTCACDsDebDef_C "/" VALUE 0x80070FF2 Val_Wu16 655350.0 DDRCTime_ms 0.00 655350.0 FORMAT "%8.1" /end CHARACTERISTIC
/begin CHARACTERISTIC DDRC_DurDeb.TrbChLP_tiSCGDebOk_C "/" VALUE 0x80070FF4 Val_Wu16 655350.0 DDRCTime_ms 0.00 655350.0 FORMAT "%8.1" /end CHARACTERISTIC
/begin CHARACTERISTIC DDRC_DurDeb.TrbChLP_tiSCGDebDef_C "/" VALUE 0x80070FF6 Val_Wu16 655350.0 DDRCTime_ms 0.00 655350.0 FORMAT "%8.1" /end CHARACTERISTIC
/begin CHARACTERISTIC DDRC_DurDeb.PSP_tiSCGDebOk_C "/" VALUE 0x80070FF8 Val_Wu16 655350.0 DDRCTime_ms 0.00 655350.0 FORMAT "%8.1" /end CHARACTERISTIC
/begin CHARACTERISTIC DDRC_DurDeb.PSP_tiSCGDebDef_C "/" VALUE 0x80070FFA Val_Wu16 655350.0 DDRCTime_ms 0.00 655350.0 FORMAT "%8.1" /end CHARACTERISTIC
/begin CHARACTERISTIC DDRC_DurDeb.LSU_tiO2MaxDebOk_C "/" VALUE 0x80070FFC Val_Wu16 655350.0 DDRCTime_ms 0.00 655350.0 FORMAT "%8.1" /end CHARACTERISTIC
/begin CHARACTERISTIC DDRC_DurDeb.LSU_tiO2MaxDebDef_C "/" VALUE 0x80070FFE Val_Wu16 655350.0 DDRCTime_ms 0.00 655350.0 FORMAT "%8.1" /end CHARACTERISTIC
/begin CHARACTERISTIC DDRC_DurDeb.PFlt_tiSotMsDvtMaxDebOk_C "/" VALUE 0x80071000 Val_Wu16 655350.0 DDRCTime_ms 0.00 655350.0 FORMAT "%8.1" /end CHARACTERISTIC
/begin CHARACTERISTIC DDRC_DurDeb.PFlt_tiSotMsDvtMaxDebDef_C "/" VALUE 0x80071002 Val_Wu16 655350.0 DDRCTime_ms 0.00 655350.0 FORMAT "%8.1" /end CHARACTERISTIC
/begin CHARACTERISTIC DDRC_DurDeb.VehV_tiMaxDebOk_C "/" VALUE 0x80071004 Val_Wu16 655350.0 DDRCTime_ms 0.00 655350.0 FORMAT "%8.1" /end CHARACTERISTIC
/begin CHARACTERISTIC DDRC_DurDeb.VehV_tiMaxDebDef_C "/" VALUE 0x80071006 Val_Wu16 655350.0 DDRCTime_ms 0.00 655350.0 FORMAT "%8.1" /end CHARACTERISTIC
/begin CHARACTERISTIC DDRC_DurDeb.Exh_tiNplTPFltUsDebOk_C "/" VALUE 0x80071008 Val_Wu16 655350.0 DDRCTime_ms 0.00 655350.0 FORMAT "%8.1" /end CHARACTERISTIC
/begin CHARACTERISTIC DDRC_DurDeb.Exh_tiNplTPFltUsDebDef_C "/" VALUE 0x8007100A Val_Wu16 655350.0 DDRCTime_ms 0.00 655350.0 FORMAT "%8.1" /end CHARACTERISTIC
/begin CHARACTERISTIC DDRC_DurDeb.Oil_tiMaxTDebOk_C "/" VALUE 0x8007100C Val_Wu16 655350.0 DDRCTime_ms 0.00 655350.0 FORMAT "%8.1" /end CHARACTERISTIC
/begin CHARACTERISTIC DDRC_DurDeb.Oil_tiMaxTDebDef_C "/" VALUE 0x8007100E Val_Wu16 655350.0 DDRCTime_ms 0.00 655350.0 FORMAT "%8.1" /end CHARACTERISTIC
/begin CHARACTERISTIC DDRC_DurDeb.ErrLmp_tiSVSSCGDebOk_C "/" VALUE 0x80071010 Val_Wu16 655350.0 DDRCTime_ms 0.00 655350.0 FORMAT "%8.1" /end CHARACTERISTIC
/begin CHARACTERISTIC DDRC_DurDeb.ErrLmp_tiSVSSCGDebDef_C "/" VALUE 0x80071012 Val_Wu16 655350.0 DDRCTime_ms 0.00 655350.0 FORMAT "%8.1" /end CHARACTERISTIC
/begin CHARACTERISTIC DDRC_DurDeb.Exh_tiSRCMaxTOxiCatUsDebOk_C "/" VALUE 0x80071014 Val_Wu16 655350.0 DDRCTime_ms 0.00 655350.0 FORMAT "%8.1" /end CHARACTERISTIC
/begin CHARACTERISTIC DDRC_DurDeb.Exh_tiSRCMaxTOxiCatUsDebDef_C "/" VALUE 0x80071016 Val_Wu16 655350.0 DDRCTime_ms 0.00 655350.0 FORMAT "%8.1" /end CHARACTERISTIC
/begin CHARACTERISTIC DDRC_DurDeb.VSwVlv_tiGovDvtMaxDebOk_C "/" VALUE 0x80071018 Val_Wu16 655350.0 DDRCTime_ms 0.00 655350.0 FORMAT "%8.1" /end CHARACTERISTIC
/begin CHARACTERISTIC DDRC_DurDeb.VSwVlv_tiGovDvtMaxDebDef_C "/" VALUE 0x8007101A Val_Wu16 655350.0 DDRCTime_ms 0.00 655350.0 FORMAT "%8.1" /end CHARACTERISTIC
/begin CHARACTERISTIC DDRC_DurDeb.Brk_tiPlaDebOk_C "/" VALUE 0x8007101C Val_Wu16 655350.0 DDRCTime_ms 0.00 655350.0 FORMAT "%8.1" /end CHARACTERISTIC
/begin CHARACTERISTIC DDRC_DurDeb.Brk_tiPlaDebDef_C "/" VALUE 0x8007101E Val_Wu16 655350.0 DDRCTime_ms 0.00 655350.0 FORMAT "%8.1" /end CHARACTERISTIC
/begin CHARACTERISTIC DDRC_DurDeb.AFS_tiSetyDrftMinDebOk_C "/" VALUE 0x80071020 Val_Wu16 655350.0 DDRCTime_ms 0.00 655350.0 FORMAT "%8.1" /end CHARACTERISTIC
/begin CHARACTERISTIC DDRC_DurDeb.AFS_tiSetyDrftMinDebDef_C "/" VALUE 0x80071022 Val_Wu16 655350.0 DDRCTime_ms 0.00 655350.0 FORMAT "%8.1" /end CHARACTERISTIC
/begin CHARACTERISTIC DDRC_DurDeb.LSU_tiCircPmpCurMinDebOk_C "/" VALUE 0x80071024 Val_Wu16 655350.0 DDRCTime_ms 0.00 655350.0 FORMAT "%8.1" /end CHARACTERISTIC
/begin CHARACTERISTIC DDRC_DurDeb.LSU_tiCircPmpCurMinDebDef_C "/" VALUE 0x80071026 Val_Wu16 655350.0 DDRCTime_ms 0.00 655350.0 FORMAT "%8.1" /end CHARACTERISTIC
/begin CHARACTERISTIC DDRC_DurDeb.VSwVlv_tiGovDvtMinDebOk_C "/" VALUE 0x80071028 Val_Wu16 655350.0 DDRCTime_ms 0.00 655350.0 FORMAT "%8.1" /end CHARACTERISTIC
/begin CHARACTERISTIC DDRC_DurDeb.VSwVlv_tiGovDvtMinDebDef_C "/" VALUE 0x8007102A Val_Wu16 655350.0 DDRCTime_ms 0.00 655350.0 FORMAT "%8.1" /end CHARACTERISTIC
/begin CHARACTERISTIC DDRC_DurDeb.CEngDsT_tiMinDebOk_C "/" VALUE 0x8007102C Val_Wu16 655350.0 DDRCTime_ms 0.00 655350.0 FORMAT "%8.1" /end CHARACTERISTIC
/begin CHARACTERISTIC DDRC_DurDeb.CEngDsT_tiMinDebDef_C "/" VALUE 0x8007102E Val_Wu16 655350.0 DDRCTime_ms 0.00 655350.0 FORMAT "%8.1" /end CHARACTERISTIC
/begin CHARACTERISTIC DDRC_DurDeb.CThmst_tiOLDebOk_C "/" VALUE 0x80071030 Val_Wu16 655350.0 DDRCTime_ms 0.00 655350.0 FORMAT "%8.1" /end CHARACTERISTIC
/begin CHARACTERISTIC DDRC_DurDeb.CThmst_tiOLDebDef_C "/" VALUE 0x80071032 Val_Wu16 655350.0 DDRCTime_ms 0.00 655350.0 FORMAT "%8.1" /end CHARACTERISTIC
/begin CHARACTERISTIC DDRC_DurDeb.GbxNPos_tiSRCdcycMinDebOk_C "/" VALUE 0x80071034 Val_Wu16 655350.0 DDRCTime_ms 0.00 655350.0 FORMAT "%8.1" /end CHARACTERISTIC
/begin CHARACTERISTIC DDRC_DurDeb.GbxNPos_tiSRCdcycMinDebDef_C "/" VALUE 0x80071036 Val_Wu16 655350.0 DDRCTime_ms 0.00 655350.0 FORMAT "%8.1" /end CHARACTERISTIC
/begin CHARACTERISTIC DDRC_DurDeb.PFltLmp_tiOLDebOk_C "/" VALUE 0x80071038 Val_Wu16 655350.0 DDRCTime_ms 0.00 655350.0 FORMAT "%8.1" /end CHARACTERISTIC
/begin CHARACTERISTIC DDRC_DurDeb.PFltLmp_tiOLDebDef_C "/" VALUE 0x8007103A Val_Wu16 655350.0 DDRCTime_ms 0.00 655350.0 FORMAT "%8.1" /end CHARACTERISTIC
/begin CHARACTERISTIC DDRC_DurDeb.TrbChLP_tiSCBDebOk_C "/" VALUE 0x8007103C Val_Wu16 655350.0 DDRCTime_ms 0.00 655350.0 FORMAT "%8.1" /end CHARACTERISTIC
/begin CHARACTERISTIC DDRC_DurDeb.TrbChLP_tiSCBDebDef_C "/" VALUE 0x8007103E Val_Wu16 655350.0 DDRCTime_ms 0.00 655350.0 FORMAT "%8.1" /end CHARACTERISTIC
/begin CHARACTERISTIC DDRC_DurDeb.LSU_tiHtrMinDebOk_C "/" VALUE 0x80071040 Val_Wu16 655350.0 DDRCTime_ms 0.00 655350.0 FORMAT "%8.1" /end CHARACTERISTIC
/begin CHARACTERISTIC DDRC_DurDeb.LSU_tiHtrMinDebDef_C "/" VALUE 0x80071042 Val_Wu16 655350.0 DDRCTime_ms 0.00 655350.0 FORMAT "%8.1" /end CHARACTERISTIC
/begin CHARACTERISTIC DDRC_DurDeb.ThrVlv_tiSRCMaxDebOk_C "/" VALUE 0x80071044 Val_Wu16 655350.0 DDRCTime_ms 0.00 655350.0 FORMAT "%8.1" /end CHARACTERISTIC
/begin CHARACTERISTIC DDRC_DurDeb.ThrVlv_tiSRCMaxDebDef_C "/" VALUE 0x80071046 Val_Wu16 655350.0 DDRCTime_ms 0.00 655350.0 FORMAT "%8.1" /end CHARACTERISTIC
/begin CHARACTERISTIC DDRC_DurDeb.Fan_tiSCBDebOk_C "/" VALUE 0x80071048 Val_Wu16 655350.0 DDRCTime_ms 0.00 655350.0 FORMAT "%8.1" /end CHARACTERISTIC
/begin CHARACTERISTIC DDRC_DurDeb.Fan_tiSCBDebDef_C "/" VALUE 0x8007104A Val_Wu16 655350.0 DDRCTime_ms 0.00 655350.0 FORMAT "%8.1" /end CHARACTERISTIC
/begin CHARACTERISTIC DDRC_DurDeb.Oil_tiMinTDebOk_C "/" VALUE 0x8007104C Val_Wu16 655350.0 DDRCTime_ms 0.00 655350.0 FORMAT "%8.1" /end CHARACTERISTIC
/begin CHARACTERISTIC DDRC_DurDeb.Oil_tiMinTDebDef_C "/" VALUE 0x8007104E Val_Wu16 655350.0 DDRCTime_ms 0.00 655350.0 FORMAT "%8.1" /end CHARACTERISTIC
/begin CHARACTERISTIC DDRC_DurDeb.PFlt_tiSotMsDvtMinDebOk_C "/" VALUE 0x80071050 Val_Wu16 655350.0 DDRCTime_ms 0.00 655350.0 FORMAT "%8.1" /end CHARACTERISTIC
/begin CHARACTERISTIC DDRC_DurDeb.PFlt_tiSotMsDvtMinDebDef_C "/" VALUE 0x80071052 Val_Wu16 655350.0 DDRCTime_ms 0.00 655350.0 FORMAT "%8.1" /end CHARACTERISTIC
/begin CHARACTERISTIC DDRC_DurDeb.EnvP_tiMinDebOk_C "/" VALUE 0x80071054 Val_Wu16 655350.0 DDRCTime_ms 0.00 655350.0 FORMAT "%8.1" /end CHARACTERISTIC
/begin CHARACTERISTIC DDRC_DurDeb.EnvP_tiMinDebDef_C "/" VALUE 0x80071056 Val_Wu16 655350.0 DDRCTime_ms 0.00 655350.0 FORMAT "%8.1" /end CHARACTERISTIC
/begin CHARACTERISTIC DDRC_DurDeb.GlwPlg_tiBSDSCDebOk_C "/" VALUE 0x80071058 Val_Wu16 655350.0 DDRCTime_ms 0.00 655350.0 FORMAT "%8.1" /end CHARACTERISTIC
/begin CHARACTERISTIC DDRC_DurDeb.GlwPlg_tiBSDSCDebDef_C "/" VALUE 0x8007105A Val_Wu16 655350.0 DDRCTime_ms 0.00 655350.0 FORMAT "%8.1" /end CHARACTERISTIC
/begin CHARACTERISTIC DDRC_DurDeb.Brk_tiSigDebOk_C "/" VALUE 0x8007105C Val_Wu16 655350.0 DDRCTime_ms 0.00 655350.0 FORMAT "%8.1" /end CHARACTERISTIC
/begin CHARACTERISTIC DDRC_DurDeb.Brk_tiSigDebDef_C "/" VALUE 0x8007105E Val_Wu16 655350.0 DDRCTime_ms 0.00 655350.0 FORMAT "%8.1" /end CHARACTERISTIC
/begin CHARACTERISTIC DDRC_DurDeb.CThmst_tiSCGDebOk_C "/" VALUE 0x80071060 Val_Wu16 655350.0 DDRCTime_ms 0.00 655350.0 FORMAT "%8.1" /end CHARACTERISTIC
/begin CHARACTERISTIC DDRC_DurDeb.CThmst_tiSCGDebDef_C "/" VALUE 0x80071062 Val_Wu16 655350.0 DDRCTime_ms 0.00 655350.0 FORMAT "%8.1" /end CHARACTERISTIC
/begin CHARACTERISTIC DDRC_DurDeb.GlwPlg_tiBSDOTDebOk_C "/" VALUE 0x80071064 Val_Wu16 655350.0 DDRCTime_ms 0.00 655350.0 FORMAT "%8.1" /end CHARACTERISTIC
/begin CHARACTERISTIC DDRC_DurDeb.GlwPlg_tiBSDOTDebDef_C "/" VALUE 0x80071066 Val_Wu16 655350.0 DDRCTime_ms 0.00 655350.0 FORMAT "%8.1" /end CHARACTERISTIC
/begin CHARACTERISTIC DDRC_DurDeb.EnvT_tiMaxDebOk_C "/" VALUE 0x80071068 Val_Wu16 655350.0 DDRCTime_ms 0.00 655350.0 FORMAT "%8.1" /end CHARACTERISTIC
/begin CHARACTERISTIC DDRC_DurDeb.EnvT_tiMaxDebDef_C "/" VALUE 0x8007106A Val_Wu16 655350.0 DDRCTime_ms 0.00 655350.0 FORMAT "%8.1" /end CHARACTERISTIC
/begin CHARACTERISTIC DDRC_DurDeb.AFS_tiSetyDrftMaxDebOk_C "/" VALUE 0x8007106C Val_Wu16 655350.0 DDRCTime_ms 0.00 655350.0 FORMAT "%8.1" /end CHARACTERISTIC
/begin CHARACTERISTIC DDRC_DurDeb.AFS_tiSetyDrftMaxDebDef_C "/" VALUE 0x8007106E Val_Wu16 655350.0 DDRCTime_ms 0.00 655350.0 FORMAT "%8.1" /end CHARACTERISTIC
/begin CHARACTERISTIC DDRC_DurDeb.LSU_tiCircNernstMinDebOk_C "/" VALUE 0x80071070 Val_Wu16 655350.0 DDRCTime_ms 0.00 655350.0 FORMAT "%8.1" /end CHARACTERISTIC
/begin CHARACTERISTIC DDRC_DurDeb.LSU_tiCircNernstMinDebDef_C "/" VALUE 0x80071072 Val_Wu16 655350.0 DDRCTime_ms 0.00 655350.0 FORMAT "%8.1" /end CHARACTERISTIC
/begin CHARACTERISTIC DDRC_DurDeb.EGRVlv_tiGovDvtMaxDebOk_C "/" VALUE 0x80071074 Val_Wu16 655350.0 DDRCTime_ms 0.00 655350.0 FORMAT "%8.1" /end CHARACTERISTIC
/begin CHARACTERISTIC DDRC_DurDeb.EGRVlv_tiGovDvtMaxDebDef_C "/" VALUE 0x80071076 Val_Wu16 655350.0 DDRCTime_ms 0.00 655350.0 FORMAT "%8.1" /end CHARACTERISTIC
/begin CHARACTERISTIC DDRC_DurDeb.Exh_tiSRCMaxTPFltUsDebOk_C "/" VALUE 0x80071078 Val_Wu16 655350.0 DDRCTime_ms 0.00 655350.0 FORMAT "%8.1" /end CHARACTERISTIC
/begin CHARACTERISTIC DDRC_DurDeb.Exh_tiSRCMaxTPFltUsDebDef_C "/" VALUE 0x8007107A Val_Wu16 655350.0 DDRCTime_ms 0.00 655350.0 FORMAT "%8.1" /end CHARACTERISTIC
/begin CHARACTERISTIC DDRC_DurDeb.VehV_tiPlaDebOk_C "/" VALUE 0x8007107C Val_Wu16 655350.0 DDRCTime_ms 0.00 655350.0 FORMAT "%8.1" /end CHARACTERISTIC
/begin CHARACTERISTIC DDRC_DurDeb.VehV_tiPlaDebDef_C "/" VALUE 0x8007107E Val_Wu16 655350.0 DDRCTime_ms 0.00 655350.0 FORMAT "%8.1" /end CHARACTERISTIC
/begin CHARACTERISTIC DDRC_DurDeb.EMDmp_tiSCGDebOk_C "/" VALUE 0x80071080 Val_Wu16 655350.0 DDRCTime_ms 0.00 655350.0 FORMAT "%8.1" /end CHARACTERISTIC
/begin CHARACTERISTIC DDRC_DurDeb.EMDmp_tiSCGDebDef_C "/" VALUE 0x80071082 Val_Wu16 655350.0 DDRCTime_ms 0.00 655350.0 FORMAT "%8.1" /end CHARACTERISTIC
/begin CHARACTERISTIC DDRC_DurDeb.ECBVlv_tiOLDebOk_C "/" VALUE 0x80071084 Val_Wu16 655350.0 DDRCTime_ms 0.00 655350.0 FORMAT "%8.1" /end CHARACTERISTIC
/begin CHARACTERISTIC DDRC_DurDeb.ECBVlv_tiOLDebDef_C "/" VALUE 0x80071086 Val_Wu16 655350.0 DDRCTime_ms 0.00 655350.0 FORMAT "%8.1" /end CHARACTERISTIC
/begin CHARACTERISTIC DDRC_DurDeb.EnvT_tiMinDebOk_C "/" VALUE 0x80071088 Val_Wu16 655350.0 DDRCTime_ms 0.00 655350.0 FORMAT "%8.1" /end CHARACTERISTIC
/begin CHARACTERISTIC DDRC_DurDeb.EnvT_tiMinDebDef_C "/" VALUE 0x8007108A Val_Wu16 655350.0 DDRCTime_ms 0.00 655350.0 FORMAT "%8.1" /end CHARACTERISTIC
/begin CHARACTERISTIC DDRC_DurDeb.VehV_tiSigDebOk_C "/" VALUE 0x8007108C Val_Wu16 655350.0 DDRCTime_ms 0.00 655350.0 FORMAT "%8.1" /end CHARACTERISTIC
/begin CHARACTERISTIC DDRC_DurDeb.VehV_tiSigDebDef_C "/" VALUE 0x8007108E Val_Wu16 655350.0 DDRCTime_ms 0.00 655350.0 FORMAT "%8.1" /end CHARACTERISTIC
/begin CHARACTERISTIC DDRC_DurDeb.EGRVlv_tiOLDebOk_C "/" VALUE 0x80071090 Val_Wu16 655350.0 DDRCTime_ms 0.00 655350.0 FORMAT "%8.1" /end CHARACTERISTIC
/begin CHARACTERISTIC DDRC_DurDeb.EGRVlv_tiOLDebDef_C "/" VALUE 0x80071092 Val_Wu16 655350.0 DDRCTime_ms 0.00 655350.0 FORMAT "%8.1" /end CHARACTERISTIC
/begin CHARACTERISTIC DDRC_DurDeb.LSU_tiCircVirtGndMaxDebOk_C "/" VALUE 0x80071094 Val_Wu16 655350.0 DDRCTime_ms 0.00 655350.0 FORMAT "%8.1" /end CHARACTERISTIC
/begin CHARACTERISTIC DDRC_DurDeb.LSU_tiCircVirtGndMaxDebDef_C "/" VALUE 0x80071096 Val_Wu16 655350.0 DDRCTime_ms 0.00 655350.0 FORMAT "%8.1" /end CHARACTERISTIC
/begin CHARACTERISTIC DDRC_DurDeb.LSU_tiCircVirtGndSigDebOk_C "/" VALUE 0x80071098 Val_Wu16 655350.0 DDRCTime_ms 0.00 655350.0 FORMAT "%8.1" /end CHARACTERISTIC
/begin CHARACTERISTIC DDRC_DurDeb.LSU_tiCircVirtGndSigDebDef_C "/" VALUE 0x8007109A Val_Wu16 655350.0 DDRCTime_ms 0.00 655350.0 FORMAT "%8.1" /end CHARACTERISTIC
/begin CHARACTERISTIC DDRC_DurDeb.AFS_tiRawSRCMinDebOk_C "/" VALUE 0x8007109C Val_Wu16 655350.0 DDRCTime_ms 0.00 655350.0 FORMAT "%8.1" /end CHARACTERISTIC
/begin CHARACTERISTIC DDRC_DurDeb.AFS_tiRawSRCMinDebDef_C "/" VALUE 0x8007109E Val_Wu16 655350.0 DDRCTime_ms 0.00 655350.0 FORMAT "%8.1" /end CHARACTERISTIC
/begin CHARACTERISTIC DDRC_DurDeb.AFS_tiOffsDrftMinDebOk_C "/" VALUE 0x800710A0 Val_Wu16 655350.0 DDRCTime_ms 0.00 655350.0 FORMAT "%8.1" /end CHARACTERISTIC
/begin CHARACTERISTIC DDRC_DurDeb.AFS_tiOffsDrftMinDebDef_C "/" VALUE 0x800710A2 Val_Wu16 655350.0 DDRCTime_ms 0.00 655350.0 FORMAT "%8.1" /end CHARACTERISTIC
/begin CHARACTERISTIC DDRC_DurDeb.LSU_tiO2MinDebOk_C "/" VALUE 0x800710A4 Val_Wu16 655350.0 DDRCTime_ms 0.00 655350.0 FORMAT "%8.1" /end CHARACTERISTIC
/begin CHARACTERISTIC DDRC_DurDeb.LSU_tiO2MinDebDef_C "/" VALUE 0x800710A6 Val_Wu16 655350.0 DDRCTime_ms 0.00 655350.0 FORMAT "%8.1" /end CHARACTERISTIC
/begin CHARACTERISTIC DDRC_DurDeb.LSU_tiCircNernstMaxDebOk_C "/" VALUE 0x800710A8 Val_Wu16 655350.0 DDRCTime_ms 0.00 655350.0 FORMAT "%8.1" /end CHARACTERISTIC
/begin CHARACTERISTIC DDRC_DurDeb.LSU_tiCircNernstMaxDebDef_C "/" VALUE 0x800710AA Val_Wu16 655350.0 DDRCTime_ms 0.00 655350.0 FORMAT "%8.1" /end CHARACTERISTIC
/begin CHARACTERISTIC DDRC_DurDeb.ThrVlv_tiSRCMinDebOk_C "/" VALUE 0x800710AC Val_Wu16 655350.0 DDRCTime_ms 0.00 655350.0 FORMAT "%8.1" /end CHARACTERISTIC
/begin CHARACTERISTIC DDRC_DurDeb.ThrVlv_tiSRCMinDebDef_C "/" VALUE 0x800710AE Val_Wu16 655350.0 DDRCTime_ms 0.00 655350.0 FORMAT "%8.1" /end CHARACTERISTIC
/begin CHARACTERISTIC DDRC_DurDeb.EGRVlv_tiSRCMinDebOk_C "/" VALUE 0x800710B0 Val_Wu16 655350.0 DDRCTime_ms 0.00 655350.0 FORMAT "%8.1" /end CHARACTERISTIC
/begin CHARACTERISTIC DDRC_DurDeb.EGRVlv_tiSRCMinDebDef_C "/" VALUE 0x800710B2 Val_Wu16 655350.0 DDRCTime_ms 0.00 655350.0 FORMAT "%8.1" /end CHARACTERISTIC
/begin CHARACTERISTIC DDRC_DurDeb.ECBVlv_tiSRCMinDebOk_C "/" VALUE 0x800710B4 Val_Wu16 655350.0 DDRCTime_ms 0.00 655350.0 FORMAT "%8.1" /end CHARACTERISTIC
/begin CHARACTERISTIC DDRC_DurDeb.ECBVlv_tiSRCMinDebDef_C "/" VALUE 0x800710B6 Val_Wu16 655350.0 DDRCTime_ms 0.00 655350.0 FORMAT "%8.1" /end CHARACTERISTIC
/begin CHARACTERISTIC DDRC_DurDeb.PFlt_tiCharPDiffMinDebOk_C "/" VALUE 0x800710B8 Val_Wu16 655350.0 DDRCTime_ms 0.00 655350.0 FORMAT "%8.1" /end CHARACTERISTIC
/begin CHARACTERISTIC DDRC_DurDeb.PFlt_tiCharPDiffMinDebDef_C "/" VALUE 0x800710BA Val_Wu16 655350.0 DDRCTime_ms 0.00 655350.0 FORMAT "%8.1" /end CHARACTERISTIC
/begin CHARACTERISTIC DDRC_DurDeb.Air_tiPerLoTAFSDebOk_C "/" VALUE 0x800710BC Val_Wu16 655350.0 DDRCTime_ms 0.00 655350.0 FORMAT "%8.1" /end CHARACTERISTIC
/begin CHARACTERISTIC DDRC_DurDeb.Air_tiPerLoTAFSDebDef_C "/" VALUE 0x800710BE Val_Wu16 655350.0 DDRCTime_ms 0.00 655350.0 FORMAT "%8.1" /end CHARACTERISTIC
/begin CHARACTERISTIC DDRC_DurDeb.AirC_tiCmprRedTrqSCBDebOk_C "/" VALUE 0x800710C0 Val_Wu16 655350.0 DDRCTime_ms 0.00 655350.0 FORMAT "%8.1" /end CHARACTERISTIC
/begin CHARACTERISTIC DDRC_DurDeb.AirC_tiCmprRedTrqSCBDebDef_C "/" VALUE 0x800710C2 Val_Wu16 655350.0 DDRCTime_ms 0.00 655350.0 FORMAT "%8.1" /end CHARACTERISTIC
/begin CHARACTERISTIC DDRC_DurDeb.TrbChLP_tiOLDebOk_C "/" VALUE 0x800710C4 Val_Wu16 655350.0 DDRCTime_ms 0.00 655350.0 FORMAT "%8.1" /end CHARACTERISTIC
/begin CHARACTERISTIC DDRC_DurDeb.TrbChLP_tiOLDebDef_C "/" VALUE 0x800710C6 Val_Wu16 655350.0 DDRCTime_ms 0.00 655350.0 FORMAT "%8.1" /end CHARACTERISTIC
/begin CHARACTERISTIC DDRC_DurDeb.BrkP_tiMaxDebOk_C "/" VALUE 0x800710C8 Val_Wu16 655350.0 DDRCTime_ms 0.00 655350.0 FORMAT "%8.1" /end CHARACTERISTIC
/begin CHARACTERISTIC DDRC_DurDeb.BrkP_tiMaxDebDef_C "/" VALUE 0x800710CA Val_Wu16 655350.0 DDRCTime_ms 0.00 655350.0 FORMAT "%8.1" /end CHARACTERISTIC
/begin CHARACTERISTIC DDRC_DurDeb.AFS_tiCorSRCMinDebOk_C "/" VALUE 0x800710CC Val_Wu16 655350.0 DDRCTime_ms 0.00 655350.0 FORMAT "%8.1" /end CHARACTERISTIC
/begin CHARACTERISTIC DDRC_DurDeb.AFS_tiCorSRCMinDebDef_C "/" VALUE 0x800710CE Val_Wu16 655350.0 DDRCTime_ms 0.00 655350.0 FORMAT "%8.1" /end CHARACTERISTIC
/begin CHARACTERISTIC DDRC_DurDeb.EMDmp_tiOLDebOk_C "/" VALUE 0x800710D0 Val_Wu16 655350.0 DDRCTime_ms 0.00 655350.0 FORMAT "%8.1" /end CHARACTERISTIC
/begin CHARACTERISTIC DDRC_DurDeb.EMDmp_tiOLDebDef_C "/" VALUE 0x800710D2 Val_Wu16 655350.0 DDRCTime_ms 0.00 655350.0 FORMAT "%8.1" /end CHARACTERISTIC
/begin CHARACTERISTIC DDRC_DurDeb.Oil_tiComErrDebOk_C "/" VALUE 0x800710D4 Val_Wu16 655350.0 DDRCTime_ms 0.00 655350.0 FORMAT "%8.1" /end CHARACTERISTIC
/begin CHARACTERISTIC DDRC_DurDeb.Oil_tiComErrDebDef_C "/" VALUE 0x800710D6 Val_Wu16 655350.0 DDRCTime_ms 0.00 655350.0 FORMAT "%8.1" /end CHARACTERISTIC
/begin CHARACTERISTIC DDRC_DurDeb.AirC_tiSwtSigDebOk_C "/" VALUE 0x800710D8 Val_Wu16 655350.0 DDRCTime_ms 0.00 655350.0 FORMAT "%8.1" /end CHARACTERISTIC
/begin CHARACTERISTIC DDRC_DurDeb.AirC_tiSwtSigDebDef_C "/" VALUE 0x800710DA Val_Wu16 655350.0 DDRCTime_ms 0.00 655350.0 FORMAT "%8.1" /end CHARACTERISTIC
/begin CHARACTERISTIC DDRC_DurDeb.Air_tiSRCMaxPCACDsDebOk_C "/" VALUE 0x800710DC Val_Wu16 655350.0 DDRCTime_ms 0.00 655350.0 FORMAT "%8.1" /end CHARACTERISTIC
/begin CHARACTERISTIC DDRC_DurDeb.Air_tiSRCMaxPCACDsDebDef_C "/" VALUE 0x800710DE Val_Wu16 655350.0 DDRCTime_ms 0.00 655350.0 FORMAT "%8.1" /end CHARACTERISTIC
/begin CHARACTERISTIC DDRC_DurDeb.Air_tiMinPAirFltDsDebOk_C "/" VALUE 0x800710E0 Val_Wu16 655350.0 DDRCTime_ms 0.00 655350.0 FORMAT "%8.1" /end CHARACTERISTIC
/begin CHARACTERISTIC DDRC_DurDeb.Air_tiMinPAirFltDsDebDef_C "/" VALUE 0x800710E2 Val_Wu16 655350.0 DDRCTime_ms 0.00 655350.0 FORMAT "%8.1" /end CHARACTERISTIC
/begin CHARACTERISTIC DDRC_DurDeb.LSU_tiCircNernstSigDebOk_C "/" VALUE 0x800710E4 Val_Wu16 655350.0 DDRCTime_ms 0.00 655350.0 FORMAT "%8.1" /end CHARACTERISTIC
/begin CHARACTERISTIC DDRC_DurDeb.LSU_tiCircNernstSigDebDef_C "/" VALUE 0x800710E6 Val_Wu16 655350.0 DDRCTime_ms 0.00 655350.0 FORMAT "%8.1" /end CHARACTERISTIC
/begin CHARACTERISTIC DDRC_DurDeb.Exh_tiSRCMinTPFltUsDebOk_C "/" VALUE 0x800710E8 Val_Wu16 655350.0 DDRCTime_ms 0.00 655350.0 FORMAT "%8.1" /end CHARACTERISTIC
/begin CHARACTERISTIC DDRC_DurDeb.Exh_tiSRCMinTPFltUsDebDef_C "/" VALUE 0x800710EA Val_Wu16 655350.0 DDRCTime_ms 0.00 655350.0 FORMAT "%8.1" /end CHARACTERISTIC
/begin CHARACTERISTIC DDRC_DurDeb.GbxNPos_tiSRCdcycMaxDebOk_C "/" VALUE 0x800710EC Val_Wu16 655350.0 DDRCTime_ms 0.00 655350.0 FORMAT "%8.1" /end CHARACTERISTIC
/begin CHARACTERISTIC DDRC_DurDeb.GbxNPos_tiSRCdcycMaxDebDef_C "/" VALUE 0x800710EE Val_Wu16 655350.0 DDRCTime_ms 0.00 655350.0 FORMAT "%8.1" /end CHARACTERISTIC
/begin CHARACTERISTIC DDRC_DurDeb.EnvP_tiSigDebOk_C "/" VALUE 0x800710F0 Val_Wu16 655350.0 DDRCTime_ms 0.00 655350.0 FORMAT "%8.1" /end CHARACTERISTIC
/begin CHARACTERISTIC DDRC_DurDeb.EnvP_tiSigDebDef_C "/" VALUE 0x800710F2 Val_Wu16 655350.0 DDRCTime_ms 0.00 655350.0 FORMAT "%8.1" /end CHARACTERISTIC
/begin CHARACTERISTIC DDRC_DurDeb.EGRVlv_tiGovDvtMinDebOk_C "/" VALUE 0x800710F4 Val_Wu16 655350.0 DDRCTime_ms 0.00 655350.0 FORMAT "%8.1" /end CHARACTERISTIC
/begin CHARACTERISTIC DDRC_DurDeb.EGRVlv_tiGovDvtMinDebDef_C "/" VALUE 0x800710F6 Val_Wu16 655350.0 DDRCTime_ms 0.00 655350.0 FORMAT "%8.1" /end CHARACTERISTIC
/begin CHARACTERISTIC DDRC_DurDeb.CByVlv_tiSCBDebOk_C "/" VALUE 0x800710F8 Val_Wu16 655350.0 DDRCTime_ms 0.00 655350.0 FORMAT "%8.1" /end CHARACTERISTIC
/begin CHARACTERISTIC DDRC_DurDeb.CByVlv_tiSCBDebDef_C "/" VALUE 0x800710FA Val_Wu16 655350.0 DDRCTime_ms 0.00 655350.0 FORMAT "%8.1" /end CHARACTERISTIC
/begin CHARACTERISTIC DDRC_DurDeb.LSU_tiCircVirtGndMinDebOk_C "/" VALUE 0x800710FC Val_Wu16 655350.0 DDRCTime_ms 0.00 655350.0 FORMAT "%8.1" /end CHARACTERISTIC
/begin CHARACTERISTIC DDRC_DurDeb.LSU_tiCircVirtGndMinDebDef_C "/" VALUE 0x800710FE Val_Wu16 655350.0 DDRCTime_ms 0.00 655350.0 FORMAT "%8.1" /end CHARACTERISTIC
/begin CHARACTERISTIC DDRC_DurDeb.LSU_titExcMinDebOk_C "/" VALUE 0x80071100 Val_Wu16 655350.0 DDRCTime_ms 0.00 655350.0 FORMAT "%8.1" /end CHARACTERISTIC
/begin CHARACTERISTIC DDRC_DurDeb.LSU_titExcMinDebDef_C "/" VALUE 0x80071102 Val_Wu16 655350.0 DDRCTime_ms 0.00 655350.0 FORMAT "%8.1" /end CHARACTERISTIC
/begin CHARACTERISTIC DDRC_DurDeb.LSU_tiSPIBattLowMinDebOk_C "/" VALUE 0x80071104 Val_Wu16 655350.0 DDRCTime_ms 0.00 655350.0 FORMAT "%8.1" /end CHARACTERISTIC
/begin CHARACTERISTIC DDRC_DurDeb.LSU_tiSPIBattLowMinDebDef_C "/" VALUE 0x80071106 Val_Wu16 655350.0 DDRCTime_ms 0.00 655350.0 FORMAT "%8.1" /end CHARACTERISTIC
/begin CHARACTERISTIC DDRC_DurDeb.Air_tiMaxPAirFltDsDebOk_C "/" VALUE 0x80071108 Val_Wu16 655350.0 DDRCTime_ms 0.00 655350.0 FORMAT "%8.1" /end CHARACTERISTIC
/begin CHARACTERISTIC DDRC_DurDeb.Air_tiMaxPAirFltDsDebDef_C "/" VALUE 0x8007110A Val_Wu16 655350.0 DDRCTime_ms 0.00 655350.0 FORMAT "%8.1" /end CHARACTERISTIC
/begin CHARACTERISTIC DDRC_DurDeb.OilPLmp_tiSCGDebOk_C "/" VALUE 0x8007110C Val_Wu16 655350.0 DDRCTime_ms 0.00 655350.0 FORMAT "%8.1" /end CHARACTERISTIC
/begin CHARACTERISTIC DDRC_DurDeb.OilPLmp_tiSCGDebDef_C "/" VALUE 0x8007110E Val_Wu16 655350.0 DDRCTime_ms 0.00 655350.0 FORMAT "%8.1" /end CHARACTERISTIC
/begin CHARACTERISTIC DDRC_DurDeb.AirC_tiCmprSCGDebOk_C "/" VALUE 0x80071110 Val_Wu16 655350.0 DDRCTime_ms 0.00 655350.0 FORMAT "%8.1" /end CHARACTERISTIC
/begin CHARACTERISTIC DDRC_DurDeb.AirC_tiCmprSCGDebDef_C "/" VALUE 0x80071112 Val_Wu16 655350.0 DDRCTime_ms 0.00 655350.0 FORMAT "%8.1" /end CHARACTERISTIC
/begin CHARACTERISTIC DDRC_DurDeb.TrbCh_tiSCBDebOk_C "/" VALUE 0x80071114 Val_Wu16 655350.0 DDRCTime_ms 0.00 655350.0 FORMAT "%8.1" /end CHARACTERISTIC
/begin CHARACTERISTIC DDRC_DurDeb.TrbCh_tiSCBDebDef_C "/" VALUE 0x80071116 Val_Wu16 655350.0 DDRCTime_ms 0.00 655350.0 FORMAT "%8.1" /end CHARACTERISTIC
/begin CHARACTERISTIC DDRC_DurDeb.IVDia_numChpSPICfgDebOk_C "/" VALUE 0x80071118 Val_Wu16 65535.00 OneToOne 0.00 65535.00 FORMAT "%8.2" /end CHARACTERISTIC
/begin CHARACTERISTIC DDRC_DurDeb.IVDia_numChpSPICfgDebDef_C "/" VALUE 0x8007111A Val_Wu16 65535.00 OneToOne 0.00 65535.00 FORMAT "%8.2" /end CHARACTERISTIC
/begin CHARACTERISTIC DDRC_DurDeb.IVDia_numBnkHSBattDebOk_C "/" VALUE 0x8007111C Val_Wu16 65535.00 OneToOne 0.00 65535.00 FORMAT "%8.2" /end CHARACTERISTIC
/begin CHARACTERISTIC DDRC_DurDeb.IVDia_numBnkHSBattDebDef_C "/" VALUE 0x8007111E Val_Wu16 65535.00 OneToOne 0.00 65535.00 FORMAT "%8.2" /end CHARACTERISTIC
/begin CHARACTERISTIC DDRC_DurDeb.LSU_numO2PlausMaxDebOk_C "/" VALUE 0x80071120 Val_Wu16 65535.00 OneToOne 0.00 65535.00 FORMAT "%8.2" /end CHARACTERISTIC
/begin CHARACTERISTIC DDRC_DurDeb.LSU_numO2PlausMaxDebDef_C "/" VALUE 0x80071122 Val_Wu16 65535.00 OneToOne 0.00 65535.00 FORMAT "%8.2" /end CHARACTERISTIC
/begin CHARACTERISTIC DDRC_DurDeb.LSU_numO2ClbMaxDebOk_C "/" VALUE 0x80071124 Val_Wu16 65535.00 OneToOne 0.00 65535.00 FORMAT "%8.2" /end CHARACTERISTIC
/begin CHARACTERISTIC DDRC_DurDeb.LSU_numO2ClbMaxDebDef_C "/" VALUE 0x80071126 Val_Wu16 65535.00 OneToOne 0.00 65535.00 FORMAT "%8.2" /end CHARACTERISTIC
/begin CHARACTERISTIC DDRC_DurDeb.IVDia_numCylNoLdDebOk_C "/" VALUE 0x80071128 Val_Wu16 65535.00 OneToOne 0.00 65535.00 FORMAT "%8.2" /end CHARACTERISTIC
/begin CHARACTERISTIC DDRC_DurDeb.IVDia_numCylNoLdDebDef_C "/" VALUE 0x8007112A Val_Wu16 65535.00 OneToOne 0.00 65535.00 FORMAT "%8.2" /end CHARACTERISTIC
/begin CHARACTERISTIC DDRC_DurDeb.IVDia_numChpSPIRamDebOk_C "/" VALUE 0x8007112C Val_Wu16 65535.00 OneToOne 0.00 65535.00 FORMAT "%8.2" /end CHARACTERISTIC
/begin CHARACTERISTIC DDRC_DurDeb.IVDia_numChpSPIRamDebDef_C "/" VALUE 0x8007112E Val_Wu16 65535.00 OneToOne 0.00 65535.00 FORMAT "%8.2" /end CHARACTERISTIC
/begin CHARACTERISTIC DDRC_DurDeb.LSU_numRiClbMinDebOk_C "/" VALUE 0x80071130 Val_Wu16 65535.00 OneToOne 0.00 65535.00 FORMAT "%8.2" /end CHARACTERISTIC
/begin CHARACTERISTIC DDRC_DurDeb.LSU_numRiClbMinDebDef_C "/" VALUE 0x80071132 Val_Wu16 65535.00 OneToOne 0.00 65535.00 FORMAT "%8.2" /end CHARACTERISTIC
/begin CHARACTERISTIC DDRC_DurDeb.LSU_numO2PlausMinDebOk_C "/" VALUE 0x80071134 Val_Wu16 65535.00 OneToOne 0.00 65535.00 FORMAT "%8.2" /end CHARACTERISTIC
/begin CHARACTERISTIC DDRC_DurDeb.LSU_numO2PlausMinDebDef_C "/" VALUE 0x80071136 Val_Wu16 65535.00 OneToOne 0.00 65535.00 FORMAT "%8.2" /end CHARACTERISTIC
/begin CHARACTERISTIC DDRC_DurDeb.IVDia_numBnkTransferDebOk_C "/" VALUE 0x80071138 Val_Wu16 65535.00 OneToOne 0.00 65535.00 FORMAT "%8.2" /end CHARACTERISTIC
/begin CHARACTERISTIC DDRC_DurDeb.IVDia_numBnkTransferDebDef_C "/" VALUE 0x8007113A Val_Wu16 65535.00 OneToOne 0.00 65535.00 FORMAT "%8.2" /end CHARACTERISTIC
/begin CHARACTERISTIC DDRC_DurDeb.IVDia_numChpSPICollDebOk_C "/" VALUE 0x8007113C Val_Wu16 65535.00 OneToOne 0.00 65535.00 FORMAT "%8.2" /end CHARACTERISTIC
/begin CHARACTERISTIC DDRC_DurDeb.IVDia_numChpSPICollDebDef_C "/" VALUE 0x8007113E Val_Wu16 65535.00 OneToOne 0.00 65535.00 FORMAT "%8.2" /end CHARACTERISTIC
/begin CHARACTERISTIC DDRC_DurDeb.IVDia_numCylShCirLSBattDebOk_C "/" VALUE 0x80071140 Val_Wu16 65535.00 OneToOne 0.00 65535.00 FORMAT "%8.2" /end CHARACTERISTIC
/begin CHARACTERISTIC DDRC_DurDeb.IVDia_numCylShCirLSBattDebDef_C "/" VALUE 0x80071142 Val_Wu16 65535.00 OneToOne 0.00 65535.00 FORMAT "%8.2" /end CHARACTERISTIC
/begin CHARACTERISTIC DDRC_DurDeb.IVDia_numChpSPITransDebOk_C "/" VALUE 0x80071144 Val_Wu16 65535.00 OneToOne 0.00 65535.00 FORMAT "%8.2" /end CHARACTERISTIC
/begin CHARACTERISTIC DDRC_DurDeb.IVDia_numChpSPITransDebDef_C "/" VALUE 0x80071146 Val_Wu16 65535.00 OneToOne 0.00 65535.00 FORMAT "%8.2" /end CHARACTERISTIC
/begin CHARACTERISTIC DDRC_DurDeb.IVDia_numBnkShCirHiRstncDebOk_C "/" VALUE 0x80071148 Val_Wu16 65535.00 OneToOne 0.00 65535.00 FORMAT "%8.2" /end CHARACTERISTIC
/begin CHARACTERISTIC DDRC_DurDeb.IVDia_numBnkShCirHiRstncDebDef_C "/" VALUE 0x8007114A Val_Wu16 65535.00 OneToOne 0.00 65535.00 FORMAT "%8.2" /end CHARACTERISTIC
/begin CHARACTERISTIC DDRC_DurDeb.IVDia_numCylShCirLSLSDebOk_C "/" VALUE 0x8007114C Val_Wu16 65535.00 OneToOne 0.00 65535.00 FORMAT "%8.2" /end CHARACTERISTIC
/begin CHARACTERISTIC DDRC_DurDeb.IVDia_numCylShCirLSLSDebDef_C "/" VALUE 0x8007114E Val_Wu16 65535.00 OneToOne 0.00 65535.00 FORMAT "%8.2" /end CHARACTERISTIC
/begin CHARACTERISTIC DDRC_DurDeb.IVDia_numCylShCirHiRstncDebOk_C "/" VALUE 0x80071150 Val_Wu16 65535.00 OneToOne 0.00 65535.00 FORMAT "%8.2" /end CHARACTERISTIC
/begin CHARACTERISTIC DDRC_DurDeb.IVDia_numCylShCirHiRstncDebDef_C "/" VALUE 0x80071152 Val_Wu16 65535.00 OneToOne 0.00 65535.00 FORMAT "%8.2" /end CHARACTERISTIC
/begin CHARACTERISTIC DDRC_DurDeb.ETClb_numETMaxDebOk_C "/" VALUE 0x80071154 Val_Wu16 65535.00 OneToOne 0.00 65535.00 FORMAT "%8.2" /end CHARACTERISTIC
/begin CHARACTERISTIC DDRC_DurDeb.ETClb_numETMaxDebDef_C "/" VALUE 0x80071156 Val_Wu16 65535.00 OneToOne 0.00 65535.00 FORMAT "%8.2" /end CHARACTERISTIC
/begin CHARACTERISTIC DDRC_DurDeb.IVDia_numBnkBSHDebOk_C "/" VALUE 0x80071158 Val_Wu16 65535.00 OneToOne 0.00 65535.00 FORMAT "%8.2" /end CHARACTERISTIC
/begin CHARACTERISTIC DDRC_DurDeb.IVDia_numBnkBSHDebDef_C "/" VALUE 0x8007115A Val_Wu16 65535.00 OneToOne 0.00 65535.00 FORMAT "%8.2" /end CHARACTERISTIC
/begin CHARACTERISTIC DDRC_DurDeb.IVDia_numBnkShCirLSHSGndDebOk_C "/" VALUE 0x8007115C Val_Wu16 65535.00 OneToOne 0.00 65535.00 FORMAT "%8.2" /end CHARACTERISTIC
/begin CHARACTERISTIC DDRC_DurDeb.IVDia_numBnkShCirLSHSGndDebDef_C "/" VALUE 0x8007115E Val_Wu16 65535.00 OneToOne 0.00 65535.00 FORMAT "%8.2" /end CHARACTERISTIC
/begin CHARACTERISTIC DDRC_DurDeb.LSU_numRiClbMaxDebOk_C "/" VALUE 0x80071160 Val_Wu16 65535.00 OneToOne 0.00 65535.00 FORMAT "%8.2" /end CHARACTERISTIC
/begin CHARACTERISTIC DDRC_DurDeb.LSU_numRiClbMaxDebDef_C "/" VALUE 0x80071162 Val_Wu16 65535.00 OneToOne 0.00 65535.00 FORMAT "%8.2" /end CHARACTERISTIC
/begin CHARACTERISTIC DDRC_DurDeb.IVDia_numChpSPICtrlDebOk_C "/" VALUE 0x80071164 Val_Wu16 65535.00 OneToOne 0.00 65535.00 FORMAT "%8.2" /end CHARACTERISTIC
/begin CHARACTERISTIC DDRC_DurDeb.IVDia_numChpSPICtrlDebDef_C "/" VALUE 0x80071166 Val_Wu16 65535.00 OneToOne 0.00 65535.00 FORMAT "%8.2" /end CHARACTERISTIC
/begin CHARACTERISTIC DDRC_DurDeb.ETClb_numETMinDebOk_C "/" VALUE 0x80071168 Val_Wu16 65535.00 OneToOne 0.00 65535.00 FORMAT "%8.2" /end CHARACTERISTIC
/begin CHARACTERISTIC DDRC_DurDeb.ETClb_numETMinDebDef_C "/" VALUE 0x8007116A Val_Wu16 65535.00 OneToOne 0.00 65535.00 FORMAT "%8.2" /end CHARACTERISTIC
/begin CHARACTERISTIC DDRC_DurDeb.Clth_numPlaDebOk_C "/" VALUE 0x8007116C Val_Wu16 65535.00 OneToOne 0.00 65535.00 FORMAT "%8.2" /end CHARACTERISTIC
/begin CHARACTERISTIC DDRC_DurDeb.Clth_numPlaDebDef_C "/" VALUE 0x8007116E Val_Wu16 65535.00 OneToOne 0.00 65535.00 FORMAT "%8.2" /end CHARACTERISTIC
/begin CHARACTERISTIC DDRC_DurDeb.LSU_numDynChkMinDebOk_C "/" VALUE 0x80071170 Val_Wu16 65535.00 OneToOne 0.00 65535.00 FORMAT "%8.2" /end CHARACTERISTIC
/begin CHARACTERISTIC DDRC_DurDeb.LSU_numDynChkMinDebDef_C "/" VALUE 0x80071172 Val_Wu16 65535.00 OneToOne 0.00 65535.00 FORMAT "%8.2" /end CHARACTERISTIC
/begin CHARACTERISTIC DDRC_DurDeb.LSU_numO2ClbMinDebOk_C "/" VALUE 0x80071174 Val_Wu16 65535.00 OneToOne 0.00 65535.00 FORMAT "%8.2" /end CHARACTERISTIC
/begin CHARACTERISTIC DDRC_DurDeb.LSU_numO2ClbMinDebDef_C "/" VALUE 0x80071176 Val_Wu16 65535.00 OneToOne 0.00 65535.00 FORMAT "%8.2" /end CHARACTERISTIC
/begin CHARACTERISTIC DDRC_DurDeb.IVDia_numCylNoClsDebOk_C "/" VALUE 0x80071178 Val_Wu16 65535.00 OneToOne 0.00 65535.00 FORMAT "%8.2" /end CHARACTERISTIC
/begin CHARACTERISTIC DDRC_DurDeb.IVDia_numCylNoClsDebDef_C "/" VALUE 0x8007117A Val_Wu16 65535.00 OneToOne 0.00 65535.00 FORMAT "%8.2" /end CHARACTERISTIC
/begin CHARACTERISTIC DDRC_DurDeb.LSU_numWireIPSigDebOk_C "/" VALUE 0x8007117C Val_Wu16 65535.00 OneToOne 0.00 65535.00 FORMAT "%8.2" /end CHARACTERISTIC
/begin CHARACTERISTIC DDRC_DurDeb.LSU_numWireIPSigDebDef_C "/" VALUE 0x8007117E Val_Wu16 65535.00 OneToOne 0.00 65535.00 FORMAT "%8.2" /end CHARACTERISTIC
/begin CHARACTERISTIC DDRC_DurDeb.LSU_numCmpChkMinDebOk_C "/" VALUE 0x80071180 Val_Wu16 65535.00 OneToOne 0.00 65535.00 FORMAT "%8.2" /end CHARACTERISTIC
/begin CHARACTERISTIC DDRC_DurDeb.LSU_numCmpChkMinDebDef_C "/" VALUE 0x80071182 Val_Wu16 65535.00 OneToOne 0.00 65535.00 FORMAT "%8.2" /end CHARACTERISTIC
/begin CHARACTERISTIC DDRC_DurDeb.IVDia_numBnkShCirChSwtDebOk_C "/" VALUE 0x80071184 Val_Wu16 65535.00 OneToOne 0.00 65535.00 FORMAT "%8.2" /end CHARACTERISTIC
/begin CHARACTERISTIC DDRC_DurDeb.IVDia_numBnkShCirChSwtDebDef_C "/" VALUE 0x80071186 Val_Wu16 65535.00 OneToOne 0.00 65535.00 FORMAT "%8.2" /end CHARACTERISTIC
/begin CHARACTERISTIC DDRC_DurDeb.IVDia_numCylShCirLSHSDebOk_C "/" VALUE 0x80071188 Val_Wu16 65535.00 OneToOne 0.00 65535.00 FORMAT "%8.2" /end CHARACTERISTIC
/begin CHARACTERISTIC DDRC_DurDeb.IVDia_numCylShCirLSHSDebDef_C "/" VALUE 0x8007118A Val_Wu16 65535.00 OneToOne 0.00 65535.00 FORMAT "%8.2" /end CHARACTERISTIC
/begin CHARACTERISTIC DDRC_DurDeb.Com_tiPspToDebOk_C "/" VALUE 0x8007118C Val_Wu16 655350.0 DDRCTime_ms 0.00 655350.0 FORMAT "%8.1" /end CHARACTERISTIC
/begin CHARACTERISTIC DDRC_DurDeb.Com_tiPspToDebDef_C "/" VALUE 0x8007118E Val_Wu16 655350.0 DDRCTime_ms 0.00 655350.0 FORMAT "%8.1" /end CHARACTERISTIC
/begin CHARACTERISTIC DDRC_DurDeb.Com_tiTrqDemandGbxChkDebOk_C "/" VALUE 0x80071190 Val_Wu16 655350.0 DDRCTime_ms 0.00 655350.0 FORMAT "%8.1" /end CHARACTERISTIC
/begin CHARACTERISTIC DDRC_DurDeb.Com_tiTrqDemandGbxChkDebDef_C "/" VALUE 0x80071192 Val_Wu16 655350.0 DDRCTime_ms 0.00 655350.0 FORMAT "%8.1" /end CHARACTERISTIC
/begin CHARACTERISTIC DDRC_DurDeb.Sia_tiE5DebOk_C "/" VALUE 0x80071194 Val_Wu16 655350.0 DDRCTime_ms 0.00 655350.0 FORMAT "%8.1" /end CHARACTERISTIC
/begin CHARACTERISTIC DDRC_DurDeb.Sia_tiE5DebDef_C "/" VALUE 0x80071196 Val_Wu16 655350.0 DDRCTime_ms 0.00 655350.0 FORMAT "%8.1" /end CHARACTERISTIC
/begin CHARACTERISTIC DDRC_DurDeb.Com_tiTrqDemandAfsCtrDebOk_C "/" VALUE 0x80071198 Val_Wu16 655350.0 DDRCTime_ms 0.00 655350.0 FORMAT "%8.1" /end CHARACTERISTIC
/begin CHARACTERISTIC DDRC_DurDeb.Com_tiTrqDemandAfsCtrDebDef_C "/" VALUE 0x8007119A Val_Wu16 655350.0 DDRCTime_ms 0.00 655350.0 FORMAT "%8.1" /end CHARACTERISTIC
/begin CHARACTERISTIC DDRC_DurDeb.Sia_tiE11DebOk_C "/" VALUE 0x8007119C Val_Wu16 655350.0 DDRCTime_ms 0.00 655350.0 FORMAT "%8.1" /end CHARACTERISTIC
/begin CHARACTERISTIC DDRC_DurDeb.Sia_tiE11DebDef_C "/" VALUE 0x8007119E Val_Wu16 655350.0 DDRCTime_ms 0.00 655350.0 FORMAT "%8.1" /end CHARACTERISTIC
/begin CHARACTERISTIC DDRC_DurDeb.PCR_tiGovDvtMaxDebOk_C "/" VALUE 0x800711A0 Val_Wu16 655350.0 DDRCTime_ms 0.00 655350.0 FORMAT "%8.1" /end CHARACTERISTIC
/begin CHARACTERISTIC DDRC_DurDeb.PCR_tiGovDvtMaxDebDef_C "/" VALUE 0x800711A2 Val_Wu16 655350.0 DDRCTime_ms 0.00 655350.0 FORMAT "%8.1" /end CHARACTERISTIC
/begin CHARACTERISTIC DDRC_DurDeb.PCR_tiGovDvtLPMinDebOk_C "/" VALUE 0x800711A4 Val_Wu16 655350.0 DDRCTime_ms 0.00 655350.0 FORMAT "%8.1" /end CHARACTERISTIC
/begin CHARACTERISTIC DDRC_DurDeb.PCR_tiGovDvtLPMinDebDef_C "/" VALUE 0x800711A6 Val_Wu16 655350.0 DDRCTime_ms 0.00 655350.0 FORMAT "%8.1" /end CHARACTERISTIC
/begin CHARACTERISTIC DDRC_DurDeb.Rail_tiMeUn2DebOk_C "/" VALUE 0x800711A8 Val_Wu16 655350.0 DDRCTime_ms 0.00 655350.0 FORMAT "%8.1" /end CHARACTERISTIC
/begin CHARACTERISTIC DDRC_DurDeb.Rail_tiMeUn2DebDef_C "/" VALUE 0x800711AA Val_Wu16 655350.0 DDRCTime_ms 0.00 655350.0 FORMAT "%8.1" /end CHARACTERISTIC
/begin CHARACTERISTIC DDRC_DurDeb.AirCtl_tiGovDvtMinDebOk_C "/" VALUE 0x800711AC Val_Wu16 655350.0 DDRCTime_ms 0.00 655350.0 FORMAT "%8.1" /end CHARACTERISTIC
/begin CHARACTERISTIC DDRC_DurDeb.AirCtl_tiGovDvtMinDebDef_C "/" VALUE 0x800711AE Val_Wu16 655350.0 DDRCTime_ms 0.00 655350.0 FORMAT "%8.1" /end CHARACTERISTIC
/begin CHARACTERISTIC DDRC_DurDeb.WaHtEl_ti4WinErr3DebOk_C "/" VALUE 0x800711B0 Val_Wu16 655350.0 DDRCTime_ms 0.00 655350.0 FORMAT "%8.1" /end CHARACTERISTIC
/begin CHARACTERISTIC DDRC_DurDeb.WaHtEl_ti4WinErr3DebDef_C "/" VALUE 0x800711B2 Val_Wu16 655350.0 DDRCTime_ms 0.00 655350.0 FORMAT "%8.1" /end CHARACTERISTIC
/begin CHARACTERISTIC DDRC_DurDeb.ETCtl_tiDvtOutrMinDebOk_C "/" VALUE 0x800711B4 Val_Wu16 655350.0 DDRCTime_ms 0.00 655350.0 FORMAT "%8.1" /end CHARACTERISTIC
/begin CHARACTERISTIC DDRC_DurDeb.ETCtl_tiDvtOutrMinDebDef_C "/" VALUE 0x800711B6 Val_Wu16 655350.0 DDRCTime_ms 0.00 655350.0 FORMAT "%8.1" /end CHARACTERISTIC
/begin CHARACTERISTIC DDRC_DurDeb.Fan_ti4WinErr2DebOk_C "/" VALUE 0x800711B8 Val_Wu16 655350.0 DDRCTime_ms 0.00 655350.0 FORMAT "%8.1" /end CHARACTERISTIC
/begin CHARACTERISTIC DDRC_DurDeb.Fan_ti4WinErr2DebDef_C "/" VALUE 0x800711BA Val_Wu16 655350.0 DDRCTime_ms 0.00 655350.0 FORMAT "%8.1" /end CHARACTERISTIC
/begin CHARACTERISTIC DDRC_DurDeb.Com_tiTrqDemandAfsSigDebOk_C "/" VALUE 0x800711BC Val_Wu16 655350.0 DDRCTime_ms 0.00 655350.0 FORMAT "%8.1" /end CHARACTERISTIC
/begin CHARACTERISTIC DDRC_DurDeb.Com_tiTrqDemandAfsSigDebDef_C "/" VALUE 0x800711BE Val_Wu16 655350.0 DDRCTime_ms 0.00 655350.0 FORMAT "%8.1" /end CHARACTERISTIC
/begin CHARACTERISTIC DDRC_DurDeb.Fan_ti4WinErr1DebOk_C "/" VALUE 0x800711C0 Val_Wu16 655350.0 DDRCTime_ms 0.00 655350.0 FORMAT "%8.1" /end CHARACTERISTIC
/begin CHARACTERISTIC DDRC_DurDeb.Fan_ti4WinErr1DebDef_C "/" VALUE 0x800711C2 Val_Wu16 655350.0 DDRCTime_ms 0.00 655350.0 FORMAT "%8.1" /end CHARACTERISTIC
/begin CHARACTERISTIC DDRC_DurDeb.TrbCh_ti4WinErr1DebOk_C "/" VALUE 0x800711C4 Val_Wu16 655350.0 DDRCTime_ms 0.00 655350.0 FORMAT "%8.1" /end CHARACTERISTIC
/begin CHARACTERISTIC DDRC_DurDeb.TrbCh_ti4WinErr1DebDef_C "/" VALUE 0x800711C6 Val_Wu16 655350.0 DDRCTime_ms 0.00 655350.0 FORMAT "%8.1" /end CHARACTERISTIC
/begin CHARACTERISTIC DDRC_DurDeb.Sia_tiE3DebOk_C "/" VALUE 0x800711C8 Val_Wu16 655350.0 DDRCTime_ms 0.00 655350.0 FORMAT "%8.1" /end CHARACTERISTIC
/begin CHARACTERISTIC DDRC_DurDeb.Sia_tiE3DebDef_C "/" VALUE 0x800711CA Val_Wu16 655350.0 DDRCTime_ms 0.00 655350.0 FORMAT "%8.1" /end CHARACTERISTIC
/begin CHARACTERISTIC DDRC_DurDeb.Com_tiTrailerSigDebOk_C "/" VALUE 0x800711CC Val_Wu16 655350.0 DDRCTime_ms 0.00 655350.0 FORMAT "%8.1" /end CHARACTERISTIC
/begin CHARACTERISTIC DDRC_DurDeb.Com_tiTrailerSigDebDef_C "/" VALUE 0x800711CE Val_Wu16 655350.0 DDRCTime_ms 0.00 655350.0 FORMAT "%8.1" /end CHARACTERISTIC
/begin CHARACTERISTIC DDRC_DurDeb.Com_tiPspSigDebOk_C "/" VALUE 0x800711D0 Val_Wu16 655350.0 DDRCTime_ms 0.00 655350.0 FORMAT "%8.1" /end CHARACTERISTIC
/begin CHARACTERISTIC DDRC_DurDeb.Com_tiPspSigDebDef_C "/" VALUE 0x800711D2 Val_Wu16 655350.0 DDRCTime_ms 0.00 655350.0 FORMAT "%8.1" /end CHARACTERISTIC
/begin CHARACTERISTIC DDRC_DurDeb.Com_tiTimeDateSigDebOk_C "/" VALUE 0x800711D4 Val_Wu16 655350.0 DDRCTime_ms 0.00 655350.0 FORMAT "%8.1" /end CHARACTERISTIC
/begin CHARACTERISTIC DDRC_DurDeb.Com_tiTimeDateSigDebDef_C "/" VALUE 0x800711D6 Val_Wu16 655350.0 DDRCTime_ms 0.00 655350.0 FORMAT "%8.1" /end CHARACTERISTIC
/begin CHARACTERISTIC DDRC_DurDeb.Com_tiShutOffPSPSigDebOk_C "/" VALUE 0x800711D8 Val_Wu16 655350.0 DDRCTime_ms 0.00 655350.0 FORMAT "%8.1" /end CHARACTERISTIC
/begin CHARACTERISTIC DDRC_DurDeb.Com_tiShutOffPSPSigDebDef_C "/" VALUE 0x800711DA Val_Wu16 655350.0 DDRCTime_ms 0.00 655350.0 FORMAT "%8.1" /end CHARACTERISTIC
/begin CHARACTERISTIC DDRC_DurDeb.Com_tiMileageRangeToDebOk_C "/" VALUE 0x800711DC Val_Wu16 655350.0 DDRCTime_ms 0.00 655350.0 FORMAT "%8.1" /end CHARACTERISTIC
/begin CHARACTERISTIC DDRC_DurDeb.Com_tiMileageRangeToDebDef_C "/" VALUE 0x800711DE Val_Wu16 655350.0 DDRCTime_ms 0.00 655350.0 FORMAT "%8.1" /end CHARACTERISTIC
/begin CHARACTERISTIC DDRC_DurDeb.Com_tiStateARSSigDebOk_C "/" VALUE 0x800711E0 Val_Wu16 655350.0 DDRCTime_ms 0.00 655350.0 FORMAT "%8.1" /end CHARACTERISTIC
/begin CHARACTERISTIC DDRC_DurDeb.Com_tiStateARSSigDebDef_C "/" VALUE 0x800711E2 Val_Wu16 655350.0 DDRCTime_ms 0.00 655350.0 FORMAT "%8.1" /end CHARACTERISTIC
/begin CHARACTERISTIC DDRC_DurDeb.Com_tiTerminalCtrDebOk_C "/" VALUE 0x800711E4 Val_Wu16 655350.0 DDRCTime_ms 0.00 655350.0 FORMAT "%8.1" /end CHARACTERISTIC
/begin CHARACTERISTIC DDRC_DurDeb.Com_tiTerminalCtrDebDef_C "/" VALUE 0x800711E6 Val_Wu16 655350.0 DDRCTime_ms 0.00 655350.0 FORMAT "%8.1" /end CHARACTERISTIC
/begin CHARACTERISTIC DDRC_DurDeb.TrbCh_tiSCGDebOk_C "/" VALUE 0x800711E8 Val_Wu16 655350.0 DDRCTime_ms 0.00 655350.0 FORMAT "%8.1" /end CHARACTERISTIC
/begin CHARACTERISTIC DDRC_DurDeb.TrbCh_tiSCGDebDef_C "/" VALUE 0x800711EA Val_Wu16 655350.0 DDRCTime_ms 0.00 655350.0 FORMAT "%8.1" /end CHARACTERISTIC
/begin CHARACTERISTIC DDRC_DurDeb.Com_tiTerminalSigDebOk_C "/" VALUE 0x800711EC Val_Wu16 655350.0 DDRCTime_ms 0.00 655350.0 FORMAT "%8.1" /end CHARACTERISTIC
/begin CHARACTERISTIC DDRC_DurDeb.Com_tiTerminalSigDebDef_C "/" VALUE 0x800711EE Val_Wu16 655350.0 DDRCTime_ms 0.00 655350.0 FORMAT "%8.1" /end CHARACTERISTIC
/begin CHARACTERISTIC DDRC_DurDeb.Com_tiTrqDemandGbxCtrDebOk_C "/" VALUE 0x800711F0 Val_Wu16 655350.0 DDRCTime_ms 0.00 655350.0 FORMAT "%8.1" /end CHARACTERISTIC
/begin CHARACTERISTIC DDRC_DurDeb.Com_tiTrqDemandGbxCtrDebDef_C "/" VALUE 0x800711F2 Val_Wu16 655350.0 DDRCTime_ms 0.00 655350.0 FORMAT "%8.1" /end CHARACTERISTIC
/begin CHARACTERISTIC DDRC_DurDeb.Rail_tiPMonStrtDebOk_C "/" VALUE 0x800711F4 Val_Wu16 655350.0 DDRCTime_ms 0.00 655350.0 FORMAT "%8.1" /end CHARACTERISTIC
/begin CHARACTERISTIC DDRC_DurDeb.Rail_tiPMonStrtDebDef_C "/" VALUE 0x800711F6 Val_Wu16 655350.0 DDRCTime_ms 0.00 655350.0 FORMAT "%8.1" /end CHARACTERISTIC
/begin CHARACTERISTIC DDRC_DurDeb.Com_tiStateARSToDebOk_C "/" VALUE 0x800711F8 Val_Wu16 655350.0 DDRCTime_ms 0.00 655350.0 FORMAT "%8.1" /end CHARACTERISTIC
/begin CHARACTERISTIC DDRC_DurDeb.Com_tiStateARSToDebDef_C "/" VALUE 0x800711FA Val_Wu16 655350.0 DDRCTime_ms 0.00 655350.0 FORMAT "%8.1" /end CHARACTERISTIC
/begin CHARACTERISTIC DDRC_DurDeb.Com_tiMileageRangeSigDebOk_C "/" VALUE 0x800711FC Val_Wu16 655350.0 DDRCTime_ms 0.00 655350.0 FORMAT "%8.1" /end CHARACTERISTIC
/begin CHARACTERISTIC DDRC_DurDeb.Com_tiMileageRangeSigDebDef_C "/" VALUE 0x800711FE Val_Wu16 655350.0 DDRCTime_ms 0.00 655350.0 FORMAT "%8.1" /end CHARACTERISTIC
/begin CHARACTERISTIC DDRC_DurDeb.ThrVlv_ti4WinErr3DebOk_C "/" VALUE 0x80071200 Val_Wu16 655350.0 DDRCTime_ms 0.00 655350.0 FORMAT "%8.1" /end CHARACTERISTIC
/begin CHARACTERISTIC DDRC_DurDeb.ThrVlv_ti4WinErr3DebDef_C "/" VALUE 0x80071202 Val_Wu16 655350.0 DDRCTime_ms 0.00 655350.0 FORMAT "%8.1" /end CHARACTERISTIC
/begin CHARACTERISTIC DDRC_DurDeb.Com_tiStateDscToDebOk_C "/" VALUE 0x80071204 Val_Wu16 655350.0 DDRCTime_ms 0.00 655350.0 FORMAT "%8.1" /end CHARACTERISTIC
/begin CHARACTERISTIC DDRC_DurDeb.Com_tiStateDscToDebDef_C "/" VALUE 0x80071206 Val_Wu16 655350.0 DDRCTime_ms 0.00 655350.0 FORMAT "%8.1" /end CHARACTERISTIC
/begin CHARACTERISTIC DDRC_DurDeb.Com_tiTerminalToDebOk_C "/" VALUE 0x80071208 Val_Wu16 655350.0 DDRCTime_ms 0.00 655350.0 FORMAT "%8.1" /end CHARACTERISTIC
/begin CHARACTERISTIC DDRC_DurDeb.Com_tiTerminalToDebDef_C "/" VALUE 0x8007120A Val_Wu16 655350.0 DDRCTime_ms 0.00 655350.0 FORMAT "%8.1" /end CHARACTERISTIC
/begin CHARACTERISTIC DDRC_DurDeb.Rail_tiPCV1DebOk_C "/" VALUE 0x8007120C Val_Wu16 655350.0 DDRCTime_ms 0.00 655350.0 FORMAT "%8.1" /end CHARACTERISTIC
/begin CHARACTERISTIC DDRC_DurDeb.Rail_tiPCV1DebDef_C "/" VALUE 0x8007120E Val_Wu16 655350.0 DDRCTime_ms 0.00 655350.0 FORMAT "%8.1" /end CHARACTERISTIC
/begin CHARACTERISTIC DDRC_DurDeb.Sia_tiE10DebOk_C "/" VALUE 0x80071210 Val_Wu16 655350.0 DDRCTime_ms 0.00 655350.0 FORMAT "%8.1" /end CHARACTERISTIC
/begin CHARACTERISTIC DDRC_DurDeb.Sia_tiE10DebDef_C "/" VALUE 0x80071212 Val_Wu16 655350.0 DDRCTime_ms 0.00 655350.0 FORMAT "%8.1" /end CHARACTERISTIC
/begin CHARACTERISTIC DDRC_DurDeb.Com_tiStateSeatSigDebOk_C "/" VALUE 0x80071214 Val_Wu16 655350.0 DDRCTime_ms 0.00 655350.0 FORMAT "%8.1" /end CHARACTERISTIC
/begin CHARACTERISTIC DDRC_DurDeb.Com_tiStateSeatSigDebDef_C "/" VALUE 0x80071216 Val_Wu16 655350.0 DDRCTime_ms 0.00 655350.0 FORMAT "%8.1" /end CHARACTERISTIC
/begin CHARACTERISTIC DDRC_DurDeb.Com_tiStateARSCtrDebOk_C "/" VALUE 0x80071218 Val_Wu16 655350.0 DDRCTime_ms 0.00 655350.0 FORMAT "%8.1" /end CHARACTERISTIC
/begin CHARACTERISTIC DDRC_DurDeb.Com_tiStateARSCtrDebDef_C "/" VALUE 0x8007121A Val_Wu16 655350.0 DDRCTime_ms 0.00 655350.0 FORMAT "%8.1" /end CHARACTERISTIC
/begin CHARACTERISTIC DDRC_DurDeb.Com_tiTrqDemandDscSigDebOk_C "/" VALUE 0x8007121C Val_Wu16 655350.0 DDRCTime_ms 0.00 655350.0 FORMAT "%8.1" /end CHARACTERISTIC
/begin CHARACTERISTIC DDRC_DurDeb.Com_tiTrqDemandDscSigDebDef_C "/" VALUE 0x8007121E Val_Wu16 655350.0 DDRCTime_ms 0.00 655350.0 FORMAT "%8.1" /end CHARACTERISTIC
/begin CHARACTERISTIC DDRC_DurDeb.Com_tiLenkradwinkelSigDebOk_C "/" VALUE 0x80071220 Val_Wu16 655350.0 DDRCTime_ms 0.00 655350.0 FORMAT "%8.1" /end CHARACTERISTIC
/begin CHARACTERISTIC DDRC_DurDeb.Com_tiLenkradwinkelSigDebDef_C "/" VALUE 0x80071222 Val_Wu16 655350.0 DDRCTime_ms 0.00 655350.0 FORMAT "%8.1" /end CHARACTERISTIC
/begin CHARACTERISTIC DDRC_DurDeb.Com_tiWheelSpeedSigDebOk_C "/" VALUE 0x80071224 Val_Wu16 655350.0 DDRCTime_ms 0.00 655350.0 FORMAT "%8.1" /end CHARACTERISTIC
/begin CHARACTERISTIC DDRC_DurDeb.Com_tiWheelSpeedSigDebDef_C "/" VALUE 0x80071226 Val_Wu16 655350.0 DDRCTime_ms 0.00 655350.0 FORMAT "%8.1" /end CHARACTERISTIC
/begin CHARACTERISTIC DDRC_DurDeb.WaHtEl_ti4WinErr2DebOk_C "/" VALUE 0x80071228 Val_Wu16 655350.0 DDRCTime_ms 0.00 655350.0 FORMAT "%8.1" /end CHARACTERISTIC
/begin CHARACTERISTIC DDRC_DurDeb.WaHtEl_ti4WinErr2DebDef_C "/" VALUE 0x8007122A Val_Wu16 655350.0 DDRCTime_ms 0.00 655350.0 FORMAT "%8.1" /end CHARACTERISTIC
/begin CHARACTERISTIC DDRC_DurDeb.Rail_tiMeUn1DebOk_C "/" VALUE 0x8007122C Val_Wu16 655350.0 DDRCTime_ms 0.00 655350.0 FORMAT "%8.1" /end CHARACTERISTIC
/begin CHARACTERISTIC DDRC_DurDeb.Rail_tiMeUn1DebDef_C "/" VALUE 0x8007122E Val_Wu16 655350.0 DDRCTime_ms 0.00 655350.0 FORMAT "%8.1" /end CHARACTERISTIC
/begin CHARACTERISTIC DDRC_DurDeb.Sia_tiE4DebOk_C "/" VALUE 0x80071230 Val_Wu16 655350.0 DDRCTime_ms 0.00 655350.0 FORMAT "%8.1" /end CHARACTERISTIC
/begin CHARACTERISTIC DDRC_DurDeb.Sia_tiE4DebDef_C "/" VALUE 0x80071232 Val_Wu16 655350.0 DDRCTime_ms 0.00 655350.0 FORMAT "%8.1" /end CHARACTERISTIC
/begin CHARACTERISTIC DDRC_DurDeb.Fan_ti4WinErr3DebOk_C "/" VALUE 0x80071234 Val_Wu16 655350.0 DDRCTime_ms 0.00 655350.0 FORMAT "%8.1" /end CHARACTERISTIC
/begin CHARACTERISTIC DDRC_DurDeb.Fan_ti4WinErr3DebDef_C "/" VALUE 0x80071236 Val_Wu16 655350.0 DDRCTime_ms 0.00 655350.0 FORMAT "%8.1" /end CHARACTERISTIC
/begin CHARACTERISTIC DDRC_DurDeb.Com_tiShutOffPSPToDebOk_C "/" VALUE 0x80071238 Val_Wu16 655350.0 DDRCTime_ms 0.00 655350.0 FORMAT "%8.1" /end CHARACTERISTIC
/begin CHARACTERISTIC DDRC_DurDeb.Com_tiShutOffPSPToDebDef_C "/" VALUE 0x8007123A Val_Wu16 655350.0 DDRCTime_ms 0.00 655350.0 FORMAT "%8.1" /end CHARACTERISTIC
/begin CHARACTERISTIC DDRC_DurDeb.CJ945_tiSpiCommErrorDebOk_C "/" VALUE 0x8007123C Val_Wu16 655350.0 DDRCTime_ms 0.00 655350.0 FORMAT "%8.1" /end CHARACTERISTIC
/begin CHARACTERISTIC DDRC_DurDeb.CJ945_tiSpiCommErrorDebDef_C "/" VALUE 0x8007123E Val_Wu16 655350.0 DDRCTime_ms 0.00 655350.0 FORMAT "%8.1" /end CHARACTERISTIC
/begin CHARACTERISTIC DDRC_DurDeb.TrbCh_ti4WinErr2DebOk_C "/" VALUE 0x80071240 Val_Wu16 655350.0 DDRCTime_ms 0.00 655350.0 FORMAT "%8.1" /end CHARACTERISTIC
/begin CHARACTERISTIC DDRC_DurDeb.TrbCh_ti4WinErr2DebDef_C "/" VALUE 0x80071242 Val_Wu16 655350.0 DDRCTime_ms 0.00 655350.0 FORMAT "%8.1" /end CHARACTERISTIC
/begin CHARACTERISTIC DDRC_DurDeb.Rail_tiPCV3DebOk_C "/" VALUE 0x80071244 Val_Wu16 655350.0 DDRCTime_ms 0.00 655350.0 FORMAT "%8.1" /end CHARACTERISTIC
/begin CHARACTERISTIC DDRC_DurDeb.Rail_tiPCV3DebDef_C "/" VALUE 0x80071246 Val_Wu16 655350.0 DDRCTime_ms 0.00 655350.0 FORMAT "%8.1" /end CHARACTERISTIC
/begin CHARACTERISTIC DDRC_DurDeb.Com_tiTrqDemandDscChkDebOk_C "/" VALUE 0x80071248 Val_Wu16 655350.0 DDRCTime_ms 0.00 655350.0 FORMAT "%8.1" /end CHARACTERISTIC
/begin CHARACTERISTIC DDRC_DurDeb.Com_tiTrqDemandDscChkDebDef_C "/" VALUE 0x8007124A Val_Wu16 655350.0 DDRCTime_ms 0.00 655350.0 FORMAT "%8.1" /end CHARACTERISTIC
/begin CHARACTERISTIC DDRC_DurDeb.WaHtEl_tiSCGDebOk_C "/" VALUE 0x8007124C Val_Wu16 655350.0 DDRCTime_ms 0.00 655350.0 FORMAT "%8.1" /end CHARACTERISTIC
/begin CHARACTERISTIC DDRC_DurDeb.WaHtEl_tiSCGDebDef_C "/" VALUE 0x8007124E Val_Wu16 655350.0 DDRCTime_ms 0.00 655350.0 FORMAT "%8.1" /end CHARACTERISTIC
/begin CHARACTERISTIC DDRC_DurDeb.ETCtl_tiDvtInrMinDebOk_C "/" VALUE 0x80071250 Val_Wu16 655350.0 DDRCTime_ms 0.00 655350.0 FORMAT "%8.1" /end CHARACTERISTIC
/begin CHARACTERISTIC DDRC_DurDeb.ETCtl_tiDvtInrMinDebDef_C "/" VALUE 0x80071252 Val_Wu16 655350.0 DDRCTime_ms 0.00 655350.0 FORMAT "%8.1" /end CHARACTERISTIC
/begin CHARACTERISTIC DDRC_DurDeb.Rail_tiPCV2DebOk_C "/" VALUE 0x80071254 Val_Wu16 655350.0 DDRCTime_ms 0.00 655350.0 FORMAT "%8.1" /end CHARACTERISTIC
/begin CHARACTERISTIC DDRC_DurDeb.Rail_tiPCV2DebDef_C "/" VALUE 0x80071256 Val_Wu16 655350.0 DDRCTime_ms 0.00 655350.0 FORMAT "%8.1" /end CHARACTERISTIC
/begin CHARACTERISTIC DDRC_DurDeb.Rail_tiCPC3DebOk_C "/" VALUE 0x80071258 Val_Wu16 655350.0 DDRCTime_ms 0.00 655350.0 FORMAT "%8.1" /end CHARACTERISTIC
/begin CHARACTERISTIC DDRC_DurDeb.Rail_tiCPC3DebDef_C "/" VALUE 0x8007125A Val_Wu16 655350.0 DDRCTime_ms 0.00 655350.0 FORMAT "%8.1" /end CHARACTERISTIC
/begin CHARACTERISTIC DDRC_DurDeb.SSpMon1DebOk_C "/" VALUE 0x8007125C Val_Wu16 655350.0 DDRCTime_ms 0.00 655350.0 FORMAT "%8.1" /end CHARACTERISTIC
/begin CHARACTERISTIC DDRC_DurDeb.SSpMon1DebDef_C "/" VALUE 0x8007125E Val_Wu16 655350.0 DDRCTime_ms 0.00 655350.0 FORMAT "%8.1" /end CHARACTERISTIC
/begin CHARACTERISTIC DDRC_DurDeb.Com_tiTrailerToDebOk_C "/" VALUE 0x80071260 Val_Wu16 655350.0 DDRCTime_ms 0.00 655350.0 FORMAT "%8.1" /end CHARACTERISTIC
/begin CHARACTERISTIC DDRC_DurDeb.Com_tiTrailerToDebDef_C "/" VALUE 0x80071262 Val_Wu16 655350.0 DDRCTime_ms 0.00 655350.0 FORMAT "%8.1" /end CHARACTERISTIC
/begin CHARACTERISTIC DDRC_DurDeb.Com_tiStKombiCtrDebOk_C "/" VALUE 0x80071264 Val_Wu16 655350.0 DDRCTime_ms 0.00 655350.0 FORMAT "%8.1" /end CHARACTERISTIC
/begin CHARACTERISTIC DDRC_DurDeb.Com_tiStKombiCtrDebDef_C "/" VALUE 0x80071266 Val_Wu16 655350.0 DDRCTime_ms 0.00 655350.0 FORMAT "%8.1" /end CHARACTERISTIC
/begin CHARACTERISTIC DDRC_DurDeb.Com_tiZvKlappenSigDebOk_C "/" VALUE 0x80071268 Val_Wu16 655350.0 DDRCTime_ms 0.00 655350.0 FORMAT "%8.1" /end CHARACTERISTIC
/begin CHARACTERISTIC DDRC_DurDeb.Com_tiZvKlappenSigDebDef_C "/" VALUE 0x8007126A Val_Wu16 655350.0 DDRCTime_ms 0.00 655350.0 FORMAT "%8.1" /end CHARACTERISTIC
/begin CHARACTERISTIC DDRC_DurDeb.Com_tiHeatACSigDebOk_C "/" VALUE 0x8007126C Val_Wu16 655350.0 DDRCTime_ms 0.00 655350.0 FORMAT "%8.1" /end CHARACTERISTIC
/begin CHARACTERISTIC DDRC_DurDeb.Com_tiHeatACSigDebDef_C "/" VALUE 0x8007126E Val_Wu16 655350.0 DDRCTime_ms 0.00 655350.0 FORMAT "%8.1" /end CHARACTERISTIC
/begin CHARACTERISTIC DDRC_DurDeb.Fan_tiSCGDebOk_C "/" VALUE 0x80071270 Val_Wu16 655350.0 DDRCTime_ms 0.00 655350.0 FORMAT "%8.1" /end CHARACTERISTIC
/begin CHARACTERISTIC DDRC_DurDeb.Fan_tiSCGDebDef_C "/" VALUE 0x80071272 Val_Wu16 655350.0 DDRCTime_ms 0.00 655350.0 FORMAT "%8.1" /end CHARACTERISTIC
/begin CHARACTERISTIC DDRC_DurDeb.Com_tiTempRelTimeSigDebOk_C "/" VALUE 0x80071274 Val_Wu16 655350.0 DDRCTime_ms 0.00 655350.0 FORMAT "%8.1" /end CHARACTERISTIC
/begin CHARACTERISTIC DDRC_DurDeb.Com_tiTempRelTimeSigDebDef_C "/" VALUE 0x80071276 Val_Wu16 655350.0 DDRCTime_ms 0.00 655350.0 FORMAT "%8.1" /end CHARACTERISTIC
/begin CHARACTERISTIC DDRC_DurDeb.Com_tiTempRelTimeToDebOk_C "/" VALUE 0x80071278 Val_Wu16 655350.0 DDRCTime_ms 0.00 655350.0 FORMAT "%8.1" /end CHARACTERISTIC
/begin CHARACTERISTIC DDRC_DurDeb.Com_tiTempRelTimeToDebDef_C "/" VALUE 0x8007127A Val_Wu16 655350.0 DDRCTime_ms 0.00 655350.0 FORMAT "%8.1" /end CHARACTERISTIC
/begin CHARACTERISTIC DDRC_DurDeb.Com_tiStKombiToDebOk_C "/" VALUE 0x8007127C Val_Wu16 655350.0 DDRCTime_ms 0.00 655350.0 FORMAT "%8.1" /end CHARACTERISTIC
/begin CHARACTERISTIC DDRC_DurDeb.Com_tiStKombiToDebDef_C "/" VALUE 0x8007127E Val_Wu16 655350.0 DDRCTime_ms 0.00 655350.0 FORMAT "%8.1" /end CHARACTERISTIC
/begin CHARACTERISTIC DDRC_DurDeb.TrbCh_ti4WinErr3DebOk_C "/" VALUE 0x80071280 Val_Wu16 655350.0 DDRCTime_ms 0.00 655350.0 FORMAT "%8.1" /end CHARACTERISTIC
/begin CHARACTERISTIC DDRC_DurDeb.TrbCh_ti4WinErr3DebDef_C "/" VALUE 0x80071282 Val_Wu16 655350.0 DDRCTime_ms 0.00 655350.0 FORMAT "%8.1" /end CHARACTERISTIC
/begin CHARACTERISTIC DDRC_DurDeb.Com_tiStKombiSigDebOk_C "/" VALUE 0x80071284 Val_Wu16 655350.0 DDRCTime_ms 0.00 655350.0 FORMAT "%8.1" /end CHARACTERISTIC
/begin CHARACTERISTIC DDRC_DurDeb.Com_tiStKombiSigDebDef_C "/" VALUE 0x80071286 Val_Wu16 655350.0 DDRCTime_ms 0.00 655350.0 FORMAT "%8.1" /end CHARACTERISTIC
/begin CHARACTERISTIC DDRC_DurDeb.PCR_tiGovDvtMinDebOk_C "/" VALUE 0x80071288 Val_Wu16 655350.0 DDRCTime_ms 0.00 655350.0 FORMAT "%8.1" /end CHARACTERISTIC
/begin CHARACTERISTIC DDRC_DurDeb.PCR_tiGovDvtMinDebDef_C "/" VALUE 0x8007128A Val_Wu16 655350.0 DDRCTime_ms 0.00 655350.0 FORMAT "%8.1" /end CHARACTERISTIC
/begin CHARACTERISTIC DDRC_DurDeb.Com_tiLenkradwinkelToDebOk_C "/" VALUE 0x8007128C Val_Wu16 655350.0 DDRCTime_ms 0.00 655350.0 FORMAT "%8.1" /end CHARACTERISTIC
/begin CHARACTERISTIC DDRC_DurDeb.Com_tiLenkradwinkelToDebDef_C "/" VALUE 0x8007128E Val_Wu16 655350.0 DDRCTime_ms 0.00 655350.0 FORMAT "%8.1" /end CHARACTERISTIC
/begin CHARACTERISTIC DDRC_DurDeb.ThrVlv_ti4WinErr2DebOk_C "/" VALUE 0x80071290 Val_Wu16 655350.0 DDRCTime_ms 0.00 655350.0 FORMAT "%8.1" /end CHARACTERISTIC
/begin CHARACTERISTIC DDRC_DurDeb.ThrVlv_ti4WinErr2DebDef_C "/" VALUE 0x80071292 Val_Wu16 655350.0 DDRCTime_ms 0.00 655350.0 FORMAT "%8.1" /end CHARACTERISTIC
/begin CHARACTERISTIC DDRC_DurDeb.Com_tiGearboxDataSigDebOk_C "/" VALUE 0x80071294 Val_Wu16 655350.0 DDRCTime_ms 0.00 655350.0 FORMAT "%8.1" /end CHARACTERISTIC
/begin CHARACTERISTIC DDRC_DurDeb.Com_tiGearboxDataSigDebDef_C "/" VALUE 0x80071296 Val_Wu16 655350.0 DDRCTime_ms 0.00 655350.0 FORMAT "%8.1" /end CHARACTERISTIC
/begin CHARACTERISTIC DDRC_DurDeb.CY150_tiSpiCommErrorDebOk_C "/" VALUE 0x80071298 Val_Wu16 655350.0 DDRCTime_ms 0.00 655350.0 FORMAT "%8.1" /end CHARACTERISTIC
/begin CHARACTERISTIC DDRC_DurDeb.CY150_tiSpiCommErrorDebDef_C "/" VALUE 0x8007129A Val_Wu16 655350.0 DDRCTime_ms 0.00 655350.0 FORMAT "%8.1" /end CHARACTERISTIC
/begin CHARACTERISTIC DDRC_DurDeb.ETCtl_tiDvtInrMaxDebOk_C "/" VALUE 0x8007129C Val_Wu16 655350.0 DDRCTime_ms 0.00 655350.0 FORMAT "%8.1" /end CHARACTERISTIC
/begin CHARACTERISTIC DDRC_DurDeb.ETCtl_tiDvtInrMaxDebDef_C "/" VALUE 0x8007129E Val_Wu16 655350.0 DDRCTime_ms 0.00 655350.0 FORMAT "%8.1" /end CHARACTERISTIC
/begin CHARACTERISTIC DDRC_DurDeb.Com_tiStateSeatToDebOk_C "/" VALUE 0x800712A0 Val_Wu16 655350.0 DDRCTime_ms 0.00 655350.0 FORMAT "%8.1" /end CHARACTERISTIC
/begin CHARACTERISTIC DDRC_DurDeb.Com_tiStateSeatToDebDef_C "/" VALUE 0x800712A2 Val_Wu16 655350.0 DDRCTime_ms 0.00 655350.0 FORMAT "%8.1" /end CHARACTERISTIC
/begin CHARACTERISTIC DDRC_DurDeb.Sia_tiE7DebOk_C "/" VALUE 0x800712A4 Val_Wu16 655350.0 DDRCTime_ms 0.00 655350.0 FORMAT "%8.1" /end CHARACTERISTIC
/begin CHARACTERISTIC DDRC_DurDeb.Sia_tiE7DebDef_C "/" VALUE 0x800712A6 Val_Wu16 655350.0 DDRCTime_ms 0.00 655350.0 FORMAT "%8.1" /end CHARACTERISTIC
/begin CHARACTERISTIC DDRC_DurDeb.Com_tiGearboxData2ToDebOk_C "/" VALUE 0x800712A8 Val_Wu16 655350.0 DDRCTime_ms 0.00 655350.0 FORMAT "%8.1" /end CHARACTERISTIC
/begin CHARACTERISTIC DDRC_DurDeb.Com_tiGearboxData2ToDebDef_C "/" VALUE 0x800712AA Val_Wu16 655350.0 DDRCTime_ms 0.00 655350.0 FORMAT "%8.1" /end CHARACTERISTIC
/begin CHARACTERISTIC DDRC_DurDeb.Sia_tiE1DebOk_C "/" VALUE 0x800712AC Val_Wu16 655350.0 DDRCTime_ms 0.00 655350.0 FORMAT "%8.1" /end CHARACTERISTIC
/begin CHARACTERISTIC DDRC_DurDeb.Sia_tiE1DebDef_C "/" VALUE 0x800712AE Val_Wu16 655350.0 DDRCTime_ms 0.00 655350.0 FORMAT "%8.1" /end CHARACTERISTIC
/begin CHARACTERISTIC DDRC_DurDeb.Rail_tiMeUn4DebOk_C "/" VALUE 0x800712B0 Val_Wu16 655350.0 DDRCTime_ms 0.00 655350.0 FORMAT "%8.1" /end CHARACTERISTIC
/begin CHARACTERISTIC DDRC_DurDeb.Rail_tiMeUn4DebDef_C "/" VALUE 0x800712B2 Val_Wu16 655350.0 DDRCTime_ms 0.00 655350.0 FORMAT "%8.1" /end CHARACTERISTIC
/begin CHARACTERISTIC DDRC_DurDeb.Com_tiButtonMSAToDebOk_C "/" VALUE 0x800712B4 Val_Wu16 655350.0 DDRCTime_ms 0.00 655350.0 FORMAT "%8.1" /end CHARACTERISTIC
/begin CHARACTERISTIC DDRC_DurDeb.Com_tiButtonMSAToDebDef_C "/" VALUE 0x800712B6 Val_Wu16 655350.0 DDRCTime_ms 0.00 655350.0 FORMAT "%8.1" /end CHARACTERISTIC
/begin CHARACTERISTIC DDRC_DurDeb.Sia_tiE14DebOk_C "/" VALUE 0x800712B8 Val_Wu16 655350.0 DDRCTime_ms 0.00 655350.0 FORMAT "%8.1" /end CHARACTERISTIC
/begin CHARACTERISTIC DDRC_DurDeb.Sia_tiE14DebDef_C "/" VALUE 0x800712BA Val_Wu16 655350.0 DDRCTime_ms 0.00 655350.0 FORMAT "%8.1" /end CHARACTERISTIC
/begin CHARACTERISTIC DDRC_DurDeb.AirCtl_tiGovDvtEOMMaxDebOk_C "/" VALUE 0x800712BC Val_Wu16 655350.0 DDRCTime_ms 0.00 655350.0 FORMAT "%8.1" /end CHARACTERISTIC
/begin CHARACTERISTIC DDRC_DurDeb.AirCtl_tiGovDvtEOMMaxDebDef_C "/" VALUE 0x800712BE Val_Wu16 655350.0 DDRCTime_ms 0.00 655350.0 FORMAT "%8.1" /end CHARACTERISTIC
/begin CHARACTERISTIC DDRC_DurDeb.Com_tiTrqDemandDscCtrDebOk_C "/" VALUE 0x800712C0 Val_Wu16 655350.0 DDRCTime_ms 0.00 655350.0 FORMAT "%8.1" /end CHARACTERISTIC
/begin CHARACTERISTIC DDRC_DurDeb.Com_tiTrqDemandDscCtrDebDef_C "/" VALUE 0x800712C2 Val_Wu16 655350.0 DDRCTime_ms 0.00 655350.0 FORMAT "%8.1" /end CHARACTERISTIC
/begin CHARACTERISTIC DDRC_DurDeb.Com_tiTrqDemandDscToDebOk_C "/" VALUE 0x800712C4 Val_Wu16 655350.0 DDRCTime_ms 0.00 655350.0 FORMAT "%8.1" /end CHARACTERISTIC
/begin CHARACTERISTIC DDRC_DurDeb.Com_tiTrqDemandDscToDebDef_C "/" VALUE 0x800712C6 Val_Wu16 655350.0 DDRCTime_ms 0.00 655350.0 FORMAT "%8.1" /end CHARACTERISTIC
/begin CHARACTERISTIC DDRC_DurDeb.PCR_tiGovDvtLPMaxDebOk_C "/" VALUE 0x800712C8 Val_Wu16 655350.0 DDRCTime_ms 0.00 655350.0 FORMAT "%8.1" /end CHARACTERISTIC
/begin CHARACTERISTIC DDRC_DurDeb.PCR_tiGovDvtLPMaxDebDef_C "/" VALUE 0x800712CA Val_Wu16 655350.0 DDRCTime_ms 0.00 655350.0 FORMAT "%8.1" /end CHARACTERISTIC
/begin CHARACTERISTIC DDRC_DurDeb.Sia_tiE9DebOk_C "/" VALUE 0x800712CC Val_Wu16 655350.0 DDRCTime_ms 0.00 655350.0 FORMAT "%8.1" /end CHARACTERISTIC
/begin CHARACTERISTIC DDRC_DurDeb.Sia_tiE9DebDef_C "/" VALUE 0x800712CE Val_Wu16 655350.0 DDRCTime_ms 0.00 655350.0 FORMAT "%8.1" /end CHARACTERISTIC
/begin CHARACTERISTIC DDRC_DurDeb.TrbCh_tiSRCMaxDebOk_C "/" VALUE 0x800712D0 Val_Wu16 655350.0 DDRCTime_ms 0.00 655350.0 FORMAT "%8.1" /end CHARACTERISTIC
/begin CHARACTERISTIC DDRC_DurDeb.TrbCh_tiSRCMaxDebDef_C "/" VALUE 0x800712D2 Val_Wu16 655350.0 DDRCTime_ms 0.00 655350.0 FORMAT "%8.1" /end CHARACTERISTIC
/begin CHARACTERISTIC DDRC_DurDeb.Fan_ti4WinErr4DebOk_C "/" VALUE 0x800712D4 Val_Wu16 655350.0 DDRCTime_ms 0.00 655350.0 FORMAT "%8.1" /end CHARACTERISTIC
/begin CHARACTERISTIC DDRC_DurDeb.Fan_ti4WinErr4DebDef_C "/" VALUE 0x800712D6 Val_Wu16 655350.0 DDRCTime_ms 0.00 655350.0 FORMAT "%8.1" /end CHARACTERISTIC
/begin CHARACTERISTIC DDRC_DurDeb.Com_tiTrqDemandGbxSigDebOk_C "/" VALUE 0x800712D8 Val_Wu16 655350.0 DDRCTime_ms 0.00 655350.0 FORMAT "%8.1" /end CHARACTERISTIC
/begin CHARACTERISTIC DDRC_DurDeb.Com_tiTrqDemandGbxSigDebDef_C "/" VALUE 0x800712DA Val_Wu16 655350.0 DDRCTime_ms 0.00 655350.0 FORMAT "%8.1" /end CHARACTERISTIC
/begin CHARACTERISTIC DDRC_DurDeb.Rail_tiMeUn0DebOk_C "/" VALUE 0x800712DC Val_Wu16 655350.0 DDRCTime_ms 0.00 655350.0 FORMAT "%8.1" /end CHARACTERISTIC
/begin CHARACTERISTIC DDRC_DurDeb.Rail_tiMeUn0DebDef_C "/" VALUE 0x800712DE Val_Wu16 655350.0 DDRCTime_ms 0.00 655350.0 FORMAT "%8.1" /end CHARACTERISTIC
/begin CHARACTERISTIC DDRC_DurDeb.Com_tiWheelSpeedToDebOk_C "/" VALUE 0x800712E0 Val_Wu16 655350.0 DDRCTime_ms 0.00 655350.0 FORMAT "%8.1" /end CHARACTERISTIC
/begin CHARACTERISTIC DDRC_DurDeb.Com_tiWheelSpeedToDebDef_C "/" VALUE 0x800712E2 Val_Wu16 655350.0 DDRCTime_ms 0.00 655350.0 FORMAT "%8.1" /end CHARACTERISTIC
/begin CHARACTERISTIC DDRC_DurDeb.Com_tiTrqDemandAfsToDebOk_C "/" VALUE 0x800712E4 Val_Wu16 655350.0 DDRCTime_ms 0.00 655350.0 FORMAT "%8.1" /end CHARACTERISTIC
/begin CHARACTERISTIC DDRC_DurDeb.Com_tiTrqDemandAfsToDebDef_C "/" VALUE 0x800712E6 Val_Wu16 655350.0 DDRCTime_ms 0.00 655350.0 FORMAT "%8.1" /end CHARACTERISTIC
/begin CHARACTERISTIC DDRC_DurDeb.AirCtl_tiGovDvtEOMMinDebOk_C "/" VALUE 0x800712E8 Val_Wu16 655350.0 DDRCTime_ms 0.00 655350.0 FORMAT "%8.1" /end CHARACTERISTIC
/begin CHARACTERISTIC DDRC_DurDeb.AirCtl_tiGovDvtEOMMinDebDef_C "/" VALUE 0x800712EA Val_Wu16 655350.0 DDRCTime_ms 0.00 655350.0 FORMAT "%8.1" /end CHARACTERISTIC
/begin CHARACTERISTIC DDRC_DurDeb.Com_tiZvKlappenToDebOk_C "/" VALUE 0x800712EC Val_Wu16 655350.0 DDRCTime_ms 0.00 655350.0 FORMAT "%8.1" /end CHARACTERISTIC
/begin CHARACTERISTIC DDRC_DurDeb.Com_tiZvKlappenToDebDef_C "/" VALUE 0x800712EE Val_Wu16 655350.0 DDRCTime_ms 0.00 655350.0 FORMAT "%8.1" /end CHARACTERISTIC
/begin CHARACTERISTIC DDRC_DurDeb.Sia_tiE13DebOk_C "/" VALUE 0x800712F0 Val_Wu16 655350.0 DDRCTime_ms 0.00 655350.0 FORMAT "%8.1" /end CHARACTERISTIC
/begin CHARACTERISTIC DDRC_DurDeb.Sia_tiE13DebDef_C "/" VALUE 0x800712F2 Val_Wu16 655350.0 DDRCTime_ms 0.00 655350.0 FORMAT "%8.1" /end CHARACTERISTIC
/begin CHARACTERISTIC DDRC_DurDeb.Sia_tiE6DebOk_C "/" VALUE 0x800712F4 Val_Wu16 655350.0 DDRCTime_ms 0.00 655350.0 FORMAT "%8.1" /end CHARACTERISTIC
/begin CHARACTERISTIC DDRC_DurDeb.Sia_tiE6DebDef_C "/" VALUE 0x800712F6 Val_Wu16 655350.0 DDRCTime_ms 0.00 655350.0 FORMAT "%8.1" /end CHARACTERISTIC
/begin CHARACTERISTIC DDRC_DurDeb.ETCtl_tiDvtOutrMaxDebOk_C "/" VALUE 0x800712F8 Val_Wu16 655350.0 DDRCTime_ms 0.00 655350.0 FORMAT "%8.1" /end CHARACTERISTIC
/begin CHARACTERISTIC DDRC_DurDeb.ETCtl_tiDvtOutrMaxDebDef_C "/" VALUE 0x800712FA Val_Wu16 655350.0 DDRCTime_ms 0.00 655350.0 FORMAT "%8.1" /end CHARACTERISTIC
/begin CHARACTERISTIC DDRC_DurDeb.SSpMon2DebOk_C "/" VALUE 0x800712FC Val_Wu16 655350.0 DDRCTime_ms 0.00 655350.0 FORMAT "%8.1" /end CHARACTERISTIC
/begin CHARACTERISTIC DDRC_DurDeb.SSpMon2DebDef_C "/" VALUE 0x800712FE Val_Wu16 655350.0 DDRCTime_ms 0.00 655350.0 FORMAT "%8.1" /end CHARACTERISTIC
/begin CHARACTERISTIC DDRC_DurDeb.WaHtEl_ti4WinErr1DebOk_C "/" VALUE 0x80071300 Val_Wu16 655350.0 DDRCTime_ms 0.00 655350.0 FORMAT "%8.1" /end CHARACTERISTIC
/begin CHARACTERISTIC DDRC_DurDeb.WaHtEl_ti4WinErr1DebDef_C "/" VALUE 0x80071302 Val_Wu16 655350.0 DDRCTime_ms 0.00 655350.0 FORMAT "%8.1" /end CHARACTERISTIC
/begin CHARACTERISTIC DDRC_DurDeb.Sia_tiE2DebOk_C "/" VALUE 0x80071304 Val_Wu16 655350.0 DDRCTime_ms 0.00 655350.0 FORMAT "%8.1" /end CHARACTERISTIC
/begin CHARACTERISTIC DDRC_DurDeb.Sia_tiE2DebDef_C "/" VALUE 0x80071306 Val_Wu16 655350.0 DDRCTime_ms 0.00 655350.0 FORMAT "%8.1" /end CHARACTERISTIC
/begin CHARACTERISTIC DDRC_DurDeb.Sia_tiE8DebOk_C "/" VALUE 0x80071308 Val_Wu16 655350.0 DDRCTime_ms 0.00 655350.0 FORMAT "%8.1" /end CHARACTERISTIC
/begin CHARACTERISTIC DDRC_DurDeb.Sia_tiE8DebDef_C "/" VALUE 0x8007130A Val_Wu16 655350.0 DDRCTime_ms 0.00 655350.0 FORMAT "%8.1" /end CHARACTERISTIC
/begin CHARACTERISTIC DDRC_DurDeb.Rail_tiMeUn3DebOk_C "/" VALUE 0x8007130C Val_Wu16 655350.0 DDRCTime_ms 0.00 655350.0 FORMAT "%8.1" /end CHARACTERISTIC
/begin CHARACTERISTIC DDRC_DurDeb.Rail_tiMeUn3DebDef_C "/" VALUE 0x8007130E Val_Wu16 655350.0 DDRCTime_ms 0.00 655350.0 FORMAT "%8.1" /end CHARACTERISTIC
/begin CHARACTERISTIC DDRC_DurDeb.Rail_tiPCV4DebOk_C "/" VALUE 0x80071310 Val_Wu16 655350.0 DDRCTime_ms 0.00 655350.0 FORMAT "%8.1" /end CHARACTERISTIC
/begin CHARACTERISTIC DDRC_DurDeb.Rail_tiPCV4DebDef_C "/" VALUE 0x80071312 Val_Wu16 655350.0 DDRCTime_ms 0.00 655350.0 FORMAT "%8.1" /end CHARACTERISTIC
/begin CHARACTERISTIC DDRC_DurDeb.Com_tiButtonMSASigDebOk_C "/" VALUE 0x80071314 Val_Wu16 655350.0 DDRCTime_ms 0.00 655350.0 FORMAT "%8.1" /end CHARACTERISTIC
/begin CHARACTERISTIC DDRC_DurDeb.Com_tiButtonMSASigDebDef_C "/" VALUE 0x80071316 Val_Wu16 655350.0 DDRCTime_ms 0.00 655350.0 FORMAT "%8.1" /end CHARACTERISTIC
/begin CHARACTERISTIC DDRC_DurDeb.ThrVlv_ti4WinErr1DebOk_C "/" VALUE 0x80071318 Val_Wu16 655350.0 DDRCTime_ms 0.00 655350.0 FORMAT "%8.1" /end CHARACTERISTIC
/begin CHARACTERISTIC DDRC_DurDeb.ThrVlv_ti4WinErr1DebDef_C "/" VALUE 0x8007131A Val_Wu16 655350.0 DDRCTime_ms 0.00 655350.0 FORMAT "%8.1" /end CHARACTERISTIC
/begin CHARACTERISTIC DDRC_DurDeb.SSpMon3DebOk_C "/" VALUE 0x8007131C Val_Wu16 655350.0 DDRCTime_ms 0.00 655350.0 FORMAT "%8.1" /end CHARACTERISTIC
/begin CHARACTERISTIC DDRC_DurDeb.SSpMon3DebDef_C "/" VALUE 0x8007131E Val_Wu16 655350.0 DDRCTime_ms 0.00 655350.0 FORMAT "%8.1" /end CHARACTERISTIC
/begin CHARACTERISTIC DDRC_DurDeb.Com_tiTrqDemandGbxToDebOk_C "/" VALUE 0x80071320 Val_Wu16 655350.0 DDRCTime_ms 0.00 655350.0 FORMAT "%8.1" /end CHARACTERISTIC
/begin CHARACTERISTIC DDRC_DurDeb.Com_tiTrqDemandGbxToDebDef_C "/" VALUE 0x80071322 Val_Wu16 655350.0 DDRCTime_ms 0.00 655350.0 FORMAT "%8.1" /end CHARACTERISTIC
/begin CHARACTERISTIC DDRC_DurDeb.WaHtEl_ti4WinErr4DebOk_C "/" VALUE 0x80071324 Val_Wu16 655350.0 DDRCTime_ms 0.00 655350.0 FORMAT "%8.1" /end CHARACTERISTIC
/begin CHARACTERISTIC DDRC_DurDeb.WaHtEl_ti4WinErr4DebDef_C "/" VALUE 0x80071326 Val_Wu16 655350.0 DDRCTime_ms 0.00 655350.0 FORMAT "%8.1" /end CHARACTERISTIC
/begin CHARACTERISTIC DDRC_DurDeb.TrbCh_ti4WinErr4DebOk_C "/" VALUE 0x80071328 Val_Wu16 655350.0 DDRCTime_ms 0.00 655350.0 FORMAT "%8.1" /end CHARACTERISTIC
/begin CHARACTERISTIC DDRC_DurDeb.TrbCh_ti4WinErr4DebDef_C "/" VALUE 0x8007132A Val_Wu16 655350.0 DDRCTime_ms 0.00 655350.0 FORMAT "%8.1" /end CHARACTERISTIC
/begin CHARACTERISTIC DDRC_DurDeb.TrbCh_tiSRCMinDebOk_C "/" VALUE 0x8007132C Val_Wu16 655350.0 DDRCTime_ms 0.00 655350.0 FORMAT "%8.1" /end CHARACTERISTIC
/begin CHARACTERISTIC DDRC_DurDeb.TrbCh_tiSRCMinDebDef_C "/" VALUE 0x8007132E Val_Wu16 655350.0 DDRCTime_ms 0.00 655350.0 FORMAT "%8.1" /end CHARACTERISTIC
/begin CHARACTERISTIC DDRC_DurDeb.Sia_tiE15DebOk_C "/" VALUE 0x80071330 Val_Wu16 655350.0 DDRCTime_ms 0.00 655350.0 FORMAT "%8.1" /end CHARACTERISTIC
/begin CHARACTERISTIC DDRC_DurDeb.Sia_tiE15DebDef_C "/" VALUE 0x80071332 Val_Wu16 655350.0 DDRCTime_ms 0.00 655350.0 FORMAT "%8.1" /end CHARACTERISTIC
/begin CHARACTERISTIC DDRC_DurDeb.CY320_tiSpiCommErrorDebOk_C "/" VALUE 0x80071334 Val_Wu16 655350.0 DDRCTime_ms 0.00 655350.0 FORMAT "%8.1" /end CHARACTERISTIC
/begin CHARACTERISTIC DDRC_DurDeb.CY320_tiSpiCommErrorDebDef_C "/" VALUE 0x80071336 Val_Wu16 655350.0 DDRCTime_ms 0.00 655350.0 FORMAT "%8.1" /end CHARACTERISTIC
/begin CHARACTERISTIC DDRC_DurDeb.Com_tiVelocityToDebOk_C "/" VALUE 0x80071338 Val_Wu16 655350.0 DDRCTime_ms 0.00 655350.0 FORMAT "%8.1" /end CHARACTERISTIC
/begin CHARACTERISTIC DDRC_DurDeb.Com_tiVelocityToDebDef_C "/" VALUE 0x8007133A Val_Wu16 655350.0 DDRCTime_ms 0.00 655350.0 FORMAT "%8.1" /end CHARACTERISTIC
/begin CHARACTERISTIC DDRC_DurDeb.Com_tiGearboxData2SigDebOk_C "/" VALUE 0x8007133C Val_Wu16 655350.0 DDRCTime_ms 0.00 655350.0 FORMAT "%8.1" /end CHARACTERISTIC
/begin CHARACTERISTIC DDRC_DurDeb.Com_tiGearboxData2SigDebDef_C "/" VALUE 0x8007133E Val_Wu16 655350.0 DDRCTime_ms 0.00 655350.0 FORMAT "%8.1" /end CHARACTERISTIC
/begin CHARACTERISTIC DDRC_DurDeb.Com_tiStateDscSigDebOk_C "/" VALUE 0x80071340 Val_Wu16 655350.0 DDRCTime_ms 0.00 655350.0 FORMAT "%8.1" /end CHARACTERISTIC
/begin CHARACTERISTIC DDRC_DurDeb.Com_tiStateDscSigDebDef_C "/" VALUE 0x80071342 Val_Wu16 655350.0 DDRCTime_ms 0.00 655350.0 FORMAT "%8.1" /end CHARACTERISTIC
/begin CHARACTERISTIC DDRC_DurDeb.Rail_tiCPC4DebOk_C "/" VALUE 0x80071344 Val_Wu16 655350.0 DDRCTime_ms 0.00 655350.0 FORMAT "%8.1" /end CHARACTERISTIC
/begin CHARACTERISTIC DDRC_DurDeb.Rail_tiCPC4DebDef_C "/" VALUE 0x80071346 Val_Wu16 655350.0 DDRCTime_ms 0.00 655350.0 FORMAT "%8.1" /end CHARACTERISTIC
/begin CHARACTERISTIC DDRC_DurDeb.Com_tiHeatACToDebOk_C "/" VALUE 0x80071348 Val_Wu16 655350.0 DDRCTime_ms 0.00 655350.0 FORMAT "%8.1" /end CHARACTERISTIC
/begin CHARACTERISTIC DDRC_DurDeb.Com_tiHeatACToDebDef_C "/" VALUE 0x8007134A Val_Wu16 655350.0 DDRCTime_ms 0.00 655350.0 FORMAT "%8.1" /end CHARACTERISTIC
/begin CHARACTERISTIC DDRC_DurDeb.AirCtl_tiGovDvtMaxDebOk_C "/" VALUE 0x8007134C Val_Wu16 655350.0 DDRCTime_ms 0.00 655350.0 FORMAT "%8.1" /end CHARACTERISTIC
/begin CHARACTERISTIC DDRC_DurDeb.AirCtl_tiGovDvtMaxDebDef_C "/" VALUE 0x8007134E Val_Wu16 655350.0 DDRCTime_ms 0.00 655350.0 FORMAT "%8.1" /end CHARACTERISTIC
/begin CHARACTERISTIC DDRC_DurDeb.Rail_tiPCV0DebOk_C "/" VALUE 0x80071350 Val_Wu16 655350.0 DDRCTime_ms 0.00 655350.0 FORMAT "%8.1" /end CHARACTERISTIC
/begin CHARACTERISTIC DDRC_DurDeb.Rail_tiPCV0DebDef_C "/" VALUE 0x80071352 Val_Wu16 655350.0 DDRCTime_ms 0.00 655350.0 FORMAT "%8.1" /end CHARACTERISTIC
/begin CHARACTERISTIC DDRC_DurDeb.ThrVlv_ti4WinErr4DebOk_C "/" VALUE 0x80071354 Val_Wu16 655350.0 DDRCTime_ms 0.00 655350.0 FORMAT "%8.1" /end CHARACTERISTIC
/begin CHARACTERISTIC DDRC_DurDeb.ThrVlv_ti4WinErr4DebDef_C "/" VALUE 0x80071356 Val_Wu16 655350.0 DDRCTime_ms 0.00 655350.0 FORMAT "%8.1" /end CHARACTERISTIC
/begin CHARACTERISTIC DDRC_DurDeb.Com_tiGearboxDataToDebOk_C "/" VALUE 0x80071358 Val_Wu16 655350.0 DDRCTime_ms 0.00 655350.0 FORMAT "%8.1" /end CHARACTERISTIC
/begin CHARACTERISTIC DDRC_DurDeb.Com_tiGearboxDataToDebDef_C "/" VALUE 0x8007135A Val_Wu16 655350.0 DDRCTime_ms 0.00 655350.0 FORMAT "%8.1" /end CHARACTERISTIC
/begin CHARACTERISTIC DDRC_DurDeb.Com_tiTrqDemandAfsChkDebOk_C "/" VALUE 0x8007135C Val_Wu16 655350.0 DDRCTime_ms 0.00 655350.0 FORMAT "%8.1" /end CHARACTERISTIC
/begin CHARACTERISTIC DDRC_DurDeb.Com_tiTrqDemandAfsChkDebDef_C "/" VALUE 0x8007135E Val_Wu16 655350.0 DDRCTime_ms 0.00 655350.0 FORMAT "%8.1" /end CHARACTERISTIC
/begin CHARACTERISTIC DDRC_DurDeb.Com_tiVelocitySigDebOk_C "/" VALUE 0x80071360 Val_Wu16 655350.0 DDRCTime_ms 0.00 655350.0 FORMAT "%8.1" /end CHARACTERISTIC
/begin CHARACTERISTIC DDRC_DurDeb.Com_tiVelocitySigDebDef_C "/" VALUE 0x80071362 Val_Wu16 655350.0 DDRCTime_ms 0.00 655350.0 FORMAT "%8.1" /end CHARACTERISTIC
/begin CHARACTERISTIC DDRC_DurDeb.ThrVlv_tiSCGDebOk_C "/" VALUE 0x80071364 Val_Wu16 655350.0 DDRCTime_ms 0.00 655350.0 FORMAT "%8.1" /end CHARACTERISTIC
/begin CHARACTERISTIC DDRC_DurDeb.ThrVlv_tiSCGDebDef_C "/" VALUE 0x80071366 Val_Wu16 655350.0 DDRCTime_ms 0.00 655350.0 FORMAT "%8.1" /end CHARACTERISTIC
/begin CHARACTERISTIC DDRC_DurDeb.Com_tiTerminalChkDebOk_C "/" VALUE 0x80071368 Val_Wu16 655350.0 DDRCTime_ms 0.00 655350.0 FORMAT "%8.1" /end CHARACTERISTIC
/begin CHARACTERISTIC DDRC_DurDeb.Com_tiTerminalChkDebDef_C "/" VALUE 0x8007136A Val_Wu16 655350.0 DDRCTime_ms 0.00 655350.0 FORMAT "%8.1" /end CHARACTERISTIC
/begin CHARACTERISTIC DDRC_DurDeb.Rail_tiCPC1DebOk_C "/" VALUE 0x8007136C Val_Wu16 655350.0 DDRCTime_ms 0.00 655350.0 FORMAT "%8.1" /end CHARACTERISTIC
/begin CHARACTERISTIC DDRC_DurDeb.Rail_tiCPC1DebDef_C "/" VALUE 0x8007136E Val_Wu16 655350.0 DDRCTime_ms 0.00 655350.0 FORMAT "%8.1" /end CHARACTERISTIC
/begin CHARACTERISTIC DDRC_DurDeb.Sia_tiE12DebOk_C "/" VALUE 0x80071370 Val_Wu16 655350.0 DDRCTime_ms 0.00 655350.0 FORMAT "%8.1" /end CHARACTERISTIC
/begin CHARACTERISTIC DDRC_DurDeb.Sia_tiE12DebDef_C "/" VALUE 0x80071372 Val_Wu16 655350.0 DDRCTime_ms 0.00 655350.0 FORMAT "%8.1" /end CHARACTERISTIC
/begin CHARACTERISTIC DDRC_DurDeb.Com_tiTimeDateToDebOk_C "/" VALUE 0x80071374 Val_Wu16 655350.0 DDRCTime_ms 0.00 655350.0 FORMAT "%8.1" /end CHARACTERISTIC
/begin CHARACTERISTIC DDRC_DurDeb.Com_tiTimeDateToDebDef_C "/" VALUE 0x80071376 Val_Wu16 655350.0 DDRCTime_ms 0.00 655350.0 FORMAT "%8.1" /end CHARACTERISTIC
/begin CHARACTERISTIC DDRC_DurDeb.ETClb_numETFltMinDebOk_C "/" VALUE 0x80071378 Val_Wu16 65535.00 OneToOne 0.00 65535.00 FORMAT "%8.2" /end CHARACTERISTIC
/begin CHARACTERISTIC DDRC_DurDeb.ETClb_numETFltMinDebDef_C "/" VALUE 0x8007137A Val_Wu16 65535.00 OneToOne 0.00 65535.00 FORMAT "%8.2" /end CHARACTERISTIC
/begin CHARACTERISTIC DDRC_DurDeb.ETClb_numETFltMaxDebOk_C "/" VALUE 0x8007137C Val_Wu16 65535.00 OneToOne 0.00 65535.00 FORMAT "%8.2" /end CHARACTERISTIC
/begin CHARACTERISTIC DDRC_DurDeb.ETClb_numETFltMaxDebDef_C "/" VALUE 0x8007137E Val_Wu16 65535.00 OneToOne 0.00 65535.00 FORMAT "%8.2" /end CHARACTERISTIC
/begin CHARACTERISTIC DDRC_DurDeb.InjCrv_numInjLimDebOk_C "/" VALUE 0x80071380 Val_Wu16 65535.00 OneToOne 0.00 65535.00 FORMAT "%8.2" /end CHARACTERISTIC
/begin CHARACTERISTIC DDRC_DurDeb.InjCrv_numInjLimDebDef_C "/" VALUE 0x80071382 Val_Wu16 65535.00 OneToOne 0.00 65535.00 FORMAT "%8.2" /end CHARACTERISTIC
/begin CHARACTERISTIC DDRC_DurDeb.LSU_numHtCoupSigDebOk_C "/" VALUE 0x80071384 Val_Wu16 65535.00 OneToOne 0.00 65535.00 FORMAT "%8.2" /end CHARACTERISTIC
/begin CHARACTERISTIC DDRC_DurDeb.LSU_numHtCoupSigDebDef_C "/" VALUE 0x80071386 Val_Wu16 65535.00 OneToOne 0.00 65535.00 FORMAT "%8.2" /end CHARACTERISTIC
/begin CHARACTERISTIC DDRC_RatDeb.MeUn_tiOLUDRat_C "/" VALUE 0x80071388 Val_Wu8 3. DDRC_Ratio 1. 4. FORMAT "%2.0" /end CHARACTERISTIC
/begin CHARACTERISTIC DDRC_RatDeb.PCV_tiSRCMinUDRat_C "/" VALUE 0x80071389 Val_Wu8 3. DDRC_Ratio 1. 4. FORMAT "%2.0" /end CHARACTERISTIC
/begin CHARACTERISTIC DDRC_RatDeb.RailP_tiSRCMinUDRat_C "/" VALUE 0x8007138A Val_Wu8 3. DDRC_Ratio 1. 4. FORMAT "%2.0" /end CHARACTERISTIC
/begin CHARACTERISTIC DDRC_RatDeb.MeUn_tiSCBUDRat_C "/" VALUE 0x8007138B Val_Wu8 3. DDRC_Ratio 1. 4. FORMAT "%2.0" /end CHARACTERISTIC
/begin CHARACTERISTIC DDRC_RatDeb.MeUn_tiSRCMinUDRat_C "/" VALUE 0x8007138C Val_Wu8 3. DDRC_Ratio 1. 4. FORMAT "%2.0" /end CHARACTERISTIC
/begin CHARACTERISTIC DDRC_RatDeb.PCV_tiOLUDRat_C "/" VALUE 0x8007138D Val_Wu8 3. DDRC_Ratio 1. 4. FORMAT "%2.0" /end CHARACTERISTIC
/begin CHARACTERISTIC DDRC_RatDeb.MeUn_tiSRCMaxUDRat_C "/" VALUE 0x8007138E Val_Wu8 3. DDRC_Ratio 1. 4. FORMAT "%2.0" /end CHARACTERISTIC
/begin CHARACTERISTIC DDRC_RatDeb.PCV_tiSRCMaxUDRat_C "/" VALUE 0x8007138F Val_Wu8 3. DDRC_Ratio 1. 4. FORMAT "%2.0" /end CHARACTERISTIC
/begin CHARACTERISTIC DDRC_RatDeb.PCV_tiSCBUDRat_C "/" VALUE 0x80071390 Val_Wu8 3. DDRC_Ratio 1. 4. FORMAT "%2.0" /end CHARACTERISTIC
/begin CHARACTERISTIC DDRC_RatDeb.CtT_tiMinUDRat_C "/" VALUE 0x80071391 Val_Wu8 3. DDRC_Ratio 1. 4. FORMAT "%2.0" /end CHARACTERISTIC
/begin CHARACTERISTIC DDRC_RatDeb.DSMTst_ExampleUDRat_C "/" VALUE 0x80071392 Val_Wu8 3. DDRC_Ratio 1. 4. FORMAT "%2.0" /end CHARACTERISTIC
/begin CHARACTERISTIC DDRC_RatDeb.RailP_tiSRCMaxUDRat_C "/" VALUE 0x80071393 Val_Wu8 3. DDRC_Ratio 1. 4. FORMAT "%2.0" /end CHARACTERISTIC
/begin CHARACTERISTIC DDRC_RatDeb.IVPSply_numVltgSRCMaxUDRat_C "/" VALUE 0x80071394 Val_Wu8 3. DDRC_Ratio 1. 4. FORMAT "%2.0" /end CHARACTERISTIC
/begin CHARACTERISTIC DDRC_RatDeb.IVActr_numVltgSRCMaxUDRat_C "/" VALUE 0x80071395 Val_Wu8 3. DDRC_Ratio 1. 4. FORMAT "%2.0" /end CHARACTERISTIC
/begin CHARACTERISTIC DDRC_RatDeb.IVActr_numVltgSRCMinUDRat_C "/" VALUE 0x80071396 Val_Wu8 3. DDRC_Ratio 1. 4. FORMAT "%2.0" /end CHARACTERISTIC
/begin CHARACTERISTIC DDRC_RatDeb.IVPSply_numDCDCUDRat_C "/" VALUE 0x80071397 Val_Wu8 3. DDRC_Ratio 1. 4. FORMAT "%2.0" /end CHARACTERISTIC
/begin CHARACTERISTIC DDRC_RatDeb.IVPSply_numVltgSRCMinUDRat_C "/" VALUE 0x80071398 Val_Wu8 3. DDRC_Ratio 1. 4. FORMAT "%2.0" /end CHARACTERISTIC
/begin CHARACTERISTIC DDRC_RatDeb.AirC_tiCmprSCBUDRat_C "/" VALUE 0x80071399 Val_Wu8 3. DDRC_Ratio 1. 4. FORMAT "%2.0" /end CHARACTERISTIC
/begin CHARACTERISTIC DDRC_RatDeb.VSwVlv_tiOLUDRat_C "/" VALUE 0x8007139A Val_Wu8 3. DDRC_Ratio 1. 4. FORMAT "%2.0" /end CHARACTERISTIC
/begin CHARACTERISTIC DDRC_RatDeb.CEngUsT_tiSRCMinUDRat_C "/" VALUE 0x8007139B Val_Wu8 3. DDRC_Ratio 1. 4. FORMAT "%2.0" /end CHARACTERISTIC
/begin CHARACTERISTIC DDRC_RatDeb.Air_tiDtyCycLoTAFSUDRat_C "/" VALUE 0x8007139C Val_Wu8 3. DDRC_Ratio 1. 4. FORMAT "%2.0" /end CHARACTERISTIC
/begin CHARACTERISTIC DDRC_RatDeb.EMDmp_tiSCBUDRat_C "/" VALUE 0x8007139D Val_Wu8 3. DDRC_Ratio 1. 4. FORMAT "%2.0" /end CHARACTERISTIC
/begin CHARACTERISTIC DDRC_RatDeb.ECBVlv_tiSRCMaxUDRat_C "/" VALUE 0x8007139E Val_Wu8 3. DDRC_Ratio 1. 4. FORMAT "%2.0" /end CHARACTERISTIC
/begin CHARACTERISTIC DDRC_RatDeb.TrbCh_tiOLUDRat_C "/" VALUE 0x8007139F Val_Wu8 3. DDRC_Ratio 1. 4. FORMAT "%2.0" /end CHARACTERISTIC
/begin CHARACTERISTIC DDRC_RatDeb.LSU_tiHtrSigUDRat_C "/" VALUE 0x800713A0 Val_Wu8 3. DDRC_Ratio 1. 4. FORMAT "%2.0" /end CHARACTERISTIC
/begin CHARACTERISTIC DDRC_RatDeb.EGRVlv_tiSCGUDRat_C "/" VALUE 0x800713A1 Val_Wu8 3. DDRC_Ratio 1. 4. FORMAT "%2.0" /end CHARACTERISTIC
/begin CHARACTERISTIC DDRC_RatDeb.InjVlv_tiPresMinUDRat_C "/" VALUE 0x800713A2 Val_Wu8 3. DDRC_Ratio 1. 4. FORMAT "%2.0" /end CHARACTERISTIC
/begin CHARACTERISTIC DDRC_RatDeb.TECU_tiSRCMinUDRat_C "/" VALUE 0x800713A3 Val_Wu8 3. DDRC_Ratio 1. 4. FORMAT "%2.0" /end CHARACTERISTIC
/begin CHARACTERISTIC DDRC_RatDeb.CEngUsT_tiSRCMaxUDRat_C "/" VALUE 0x800713A4 Val_Wu8 3. DDRC_Ratio 1. 4. FORMAT "%2.0" /end CHARACTERISTIC
/begin CHARACTERISTIC DDRC_RatDeb.GbxNPos_tiSigUDRat_C "/" VALUE 0x800713A5 Val_Wu8 3. DDRC_Ratio 1. 4. FORMAT "%2.0" /end CHARACTERISTIC
/begin CHARACTERISTIC DDRC_RatDeb.PFlt_tiSotMsMaxUDRat_C "/" VALUE 0x800713A6 Val_Wu8 3. DDRC_Ratio 1. 4. FORMAT "%2.0" /end CHARACTERISTIC
/begin CHARACTERISTIC DDRC_RatDeb.TECU_tiSRCMaxUDRat_C "/" VALUE 0x800713A7 Val_Wu8 3. DDRC_Ratio 1. 4. FORMAT "%2.0" /end CHARACTERISTIC
/begin CHARACTERISTIC DDRC_RatDeb.WaHtEl_tiOLUDRat_C "/" VALUE 0x800713A8 Val_Wu8 3. DDRC_Ratio 1. 4. FORMAT "%2.0" /end CHARACTERISTIC
/begin CHARACTERISTIC DDRC_RatDeb.Oil_tiNplTUDRat_C "/" VALUE 0x800713A9 Val_Wu8 3. DDRC_Ratio 1. 4. FORMAT "%2.0" /end CHARACTERISTIC
/begin CHARACTERISTIC DDRC_RatDeb.AFS_tiCorSRCMaxUDRat_C "/" VALUE 0x800713AA Val_Wu8 3. DDRC_Ratio 1. 4. FORMAT "%2.0" /end CHARACTERISTIC
/begin CHARACTERISTIC DDRC_RatDeb.Exh_tiSRCMaxPPFltUsUDRat_C "/" VALUE 0x800713AB Val_Wu8 3. DDRC_Ratio 1. 4. FORMAT "%2.0" /end CHARACTERISTIC
/begin CHARACTERISTIC DDRC_RatDeb.PFltLmp_tiSCGUDRat_C "/" VALUE 0x800713AC Val_Wu8 3. DDRC_Ratio 1. 4. FORMAT "%2.0" /end CHARACTERISTIC
/begin CHARACTERISTIC DDRC_RatDeb.ThrVlv_tiOLUDRat_C "/" VALUE 0x800713AD Val_Wu8 3. DDRC_Ratio 1. 4. FORMAT "%2.0" /end CHARACTERISTIC
/begin CHARACTERISTIC DDRC_RatDeb.LSU_tiSPISigUDRat_C "/" VALUE 0x800713AE Val_Wu8 3. DDRC_Ratio 1. 4. FORMAT "%2.0" /end CHARACTERISTIC
/begin CHARACTERISTIC DDRC_RatDeb.CEngDsT_tiMaxUDRat_C "/" VALUE 0x800713AF Val_Wu8 3. DDRC_Ratio 1. 4. FORMAT "%2.0" /end CHARACTERISTIC
/begin CHARACTERISTIC DDRC_RatDeb.AirC_tiClntSRCdcycMaxUDRat_C "/" VALUE 0x800713B0 Val_Wu8 3. DDRC_Ratio 1. 4. FORMAT "%2.0" /end CHARACTERISTIC
/begin CHARACTERISTIC DDRC_RatDeb.APP_PlaAPP12UDRat_C "/" VALUE 0x800713B1 Val_Wu8 3. DDRC_Ratio 1. 4. FORMAT "%2.0" /end CHARACTERISTIC
/begin CHARACTERISTIC DDRC_RatDeb.WaHtEl_tiSCBUDRat_C "/" VALUE 0x800713B2 Val_Wu8 3. DDRC_Ratio 1. 4. FORMAT "%2.0" /end CHARACTERISTIC
/begin CHARACTERISTIC DDRC_RatDeb.Strt_tiOLUDRat_C "/" VALUE 0x800713B3 Val_Wu8 3. DDRC_Ratio 1. 4. FORMAT "%2.0" /end CHARACTERISTIC
/begin CHARACTERISTIC DDRC_RatDeb.AirC_tiCmprRedTrqOLUDRat_C "/" VALUE 0x800713B4 Val_Wu8 3. DDRC_Ratio 1. 4. FORMAT "%2.0" /end CHARACTERISTIC
/begin CHARACTERISTIC DDRC_RatDeb.APP_tiSRCLowUDRat_C "/" VALUE 0x800713B5 Val_Wu8 3. DDRC_Ratio 1. 4. FORMAT "%2.0" /end CHARACTERISTIC
/begin CHARACTERISTIC DDRC_RatDeb.MeUn_tiSCGUDRat_C "/" VALUE 0x800713B6 Val_Wu8 3. DDRC_Ratio 1. 4. FORMAT "%2.0" /end CHARACTERISTIC
/begin CHARACTERISTIC DDRC_RatDeb.EGRVlv_tiSRCMaxUDRat_C "/" VALUE 0x800713B7 Val_Wu8 3. DDRC_Ratio 1. 4. FORMAT "%2.0" /end CHARACTERISTIC
/begin CHARACTERISTIC DDRC_RatDeb.Fan_tiOLUDRat_C "/" VALUE 0x800713B8 Val_Wu8 3. DDRC_Ratio 1. 4. FORMAT "%2.0" /end CHARACTERISTIC
/begin CHARACTERISTIC DDRC_RatDeb.LSU_tiHtrMaxUDRat_C "/" VALUE 0x800713B9 Val_Wu8 3. DDRC_Ratio 1. 4. FORMAT "%2.0" /end CHARACTERISTIC
/begin CHARACTERISTIC DDRC_RatDeb.VSwVlv_tiSRCMinUDRat_C "/" VALUE 0x800713BA Val_Wu8 3. DDRC_Ratio 1. 4. FORMAT "%2.0" /end CHARACTERISTIC
/begin CHARACTERISTIC DDRC_RatDeb.CEngDsT_tiSigUDRat_C "/" VALUE 0x800713BB Val_Wu8 3. DDRC_Ratio 1. 4. FORMAT "%2.0" /end CHARACTERISTIC
/begin CHARACTERISTIC DDRC_RatDeb.AirC_tiCmprOLUDRat_C "/" VALUE 0x800713BC Val_Wu8 3. DDRC_Ratio 1. 4. FORMAT "%2.0" /end CHARACTERISTIC
/begin CHARACTERISTIC DDRC_RatDeb.AirC_tiCmprRedTrqSCGUDRat_C "/" VALUE 0x800713BD Val_Wu8 3. DDRC_Ratio 1. 4. FORMAT "%2.0" /end CHARACTERISTIC
/begin CHARACTERISTIC DDRC_RatDeb.GlwPlg_tiComErrUDRat_C "/" VALUE 0x800713BE Val_Wu8 3. DDRC_Ratio 1. 4. FORMAT "%2.0" /end CHARACTERISTIC
/begin CHARACTERISTIC DDRC_RatDeb.Air_tiPerHiTAFSUDRat_C "/" VALUE 0x800713BF Val_Wu8 3. DDRC_Ratio 1. 4. FORMAT "%2.0" /end CHARACTERISTIC
/begin CHARACTERISTIC DDRC_RatDeb.ErrLmp_tiMILOLUDRat_C "/" VALUE 0x800713C0 Val_Wu8 3. DDRC_Ratio 1. 4. FORMAT "%2.0" /end CHARACTERISTIC
/begin CHARACTERISTIC DDRC_RatDeb.EngStA_tiSCGUDRat_C "/" VALUE 0x800713C1 Val_Wu8 3. DDRC_Ratio 1. 4. FORMAT "%2.0" /end CHARACTERISTIC
/begin CHARACTERISTIC DDRC_RatDeb.FlFlt_tiSigUDRat_C "/" VALUE 0x800713C2 Val_Wu8 3. DDRC_Ratio 1. 4. FORMAT "%2.0" /end CHARACTERISTIC
/begin CHARACTERISTIC DDRC_RatDeb.ThrVlv_tiSCBUDRat_C "/" VALUE 0x800713C3 Val_Wu8 3. DDRC_Ratio 1. 4. FORMAT "%2.0" /end CHARACTERISTIC
/begin CHARACTERISTIC DDRC_RatDeb.FuelT_tiMaxUDRat_C "/" VALUE 0x800713C4 Val_Wu8 3. DDRC_Ratio 1. 4. FORMAT "%2.0" /end CHARACTERISTIC
/begin CHARACTERISTIC DDRC_RatDeb.BrkP_tiMinUDRat_C "/" VALUE 0x800713C5 Val_Wu8 3. DDRC_Ratio 1. 4. FORMAT "%2.0" /end CHARACTERISTIC
/begin CHARACTERISTIC DDRC_RatDeb.ErrLmp_tiSVSSCBUDRat_C "/" VALUE 0x800713C6 Val_Wu8 3. DDRC_Ratio 1. 4. FORMAT "%2.0" /end CHARACTERISTIC
/begin CHARACTERISTIC DDRC_RatDeb.T15_tiNplUDRat_C "/" VALUE 0x800713C7 Val_Wu8 3. DDRC_Ratio 1. 4. FORMAT "%2.0" /end CHARACTERISTIC
/begin CHARACTERISTIC DDRC_RatDeb.APP_tiSRCHighUDRat_C "/" VALUE 0x800713C8 Val_Wu8 3. DDRC_Ratio 1. 4. FORMAT "%2.0" /end CHARACTERISTIC
/begin CHARACTERISTIC DDRC_RatDeb.AirC_tiClntSRCMaxUDRat_C "/" VALUE 0x800713C9 Val_Wu8 3. DDRC_Ratio 1. 4. FORMAT "%2.0" /end CHARACTERISTIC
/begin CHARACTERISTIC DDRC_RatDeb.Oil_tiNplPUDRat_C "/" VALUE 0x800713CA Val_Wu8 3. DDRC_Ratio 1. 4. FORMAT "%2.0" /end CHARACTERISTIC
/begin CHARACTERISTIC DDRC_RatDeb.PFlt_tiDstrMinUDRat_C "/" VALUE 0x800713CB Val_Wu8 3. DDRC_Ratio 1. 4. FORMAT "%2.0" /end CHARACTERISTIC
/begin CHARACTERISTIC DDRC_RatDeb.AFS_tiOffsDrftMaxUDRat_C "/" VALUE 0x800713CC Val_Wu8 3. DDRC_Ratio 1. 4. FORMAT "%2.0" /end CHARACTERISTIC
/begin CHARACTERISTIC DDRC_RatDeb.GlwPlg_tiBSDOLUDRat_C "/" VALUE 0x800713CD Val_Wu8 3. DDRC_Ratio 1. 4. FORMAT "%2.0" /end CHARACTERISTIC
/begin CHARACTERISTIC DDRC_RatDeb.PFlt_tiSRCMinFlwRstnUDRat_C "/" VALUE 0x800713CE Val_Wu8 3. DDRC_Ratio 1. 4. FORMAT "%2.0" /end CHARACTERISTIC
/begin CHARACTERISTIC DDRC_RatDeb.AirC_tiClntSRCPerMaxUDRat_C "/" VALUE 0x800713CF Val_Wu8 3. DDRC_Ratio 1. 4. FORMAT "%2.0" /end CHARACTERISTIC
/begin CHARACTERISTIC DDRC_RatDeb.Exh_tiSRCMinPPFltUsUDRat_C "/" VALUE 0x800713D0 Val_Wu8 3. DDRC_Ratio 1. 4. FORMAT "%2.0" /end CHARACTERISTIC
/begin CHARACTERISTIC DDRC_RatDeb.EngStA_tiSCBUDRat_C "/" VALUE 0x800713D1 Val_Wu8 3. DDRC_Ratio 1. 4. FORMAT "%2.0" /end CHARACTERISTIC
/begin CHARACTERISTIC DDRC_RatDeb.OilPLmp_tiSCBUDRat_C "/" VALUE 0x800713D2 Val_Wu8 3. DDRC_Ratio 1. 4. FORMAT "%2.0" /end CHARACTERISTIC
/begin CHARACTERISTIC DDRC_RatDeb.PFlt_tiNplHsChngPPFltDiffUDRat_C "/" VALUE 0x800713D3 Val_Wu8 3. DDRC_Ratio 1. 4. FORMAT "%2.0" /end CHARACTERISTIC
/begin CHARACTERISTIC DDRC_RatDeb.AirC_tiSwtNplUDRat_C "/" VALUE 0x800713D4 Val_Wu8 3. DDRC_Ratio 1. 4. FORMAT "%2.0" /end CHARACTERISTIC
/begin CHARACTERISTIC DDRC_RatDeb.PFlt_tiSRCMaxFlwRstnUDRat_C "/" VALUE 0x800713D5 Val_Wu8 3. DDRC_Ratio 1. 4. FORMAT "%2.0" /end CHARACTERISTIC
/begin CHARACTERISTIC DDRC_RatDeb.PFlt_tiRgnPermMaxUDRat_C "/" VALUE 0x800713D6 Val_Wu8 3. DDRC_Ratio 1. 4. FORMAT "%2.0" /end CHARACTERISTIC
/begin CHARACTERISTIC DDRC_RatDeb.Air_PlsPCACDsUDRat_C "/" VALUE 0x800713D7 Val_Wu8 3. DDRC_Ratio 1. 4. FORMAT "%2.0" /end CHARACTERISTIC
/begin CHARACTERISTIC DDRC_RatDeb.Strt_tiSCBUDRat_C "/" VALUE 0x800713D8 Val_Wu8 3. DDRC_Ratio 1. 4. FORMAT "%2.0" /end CHARACTERISTIC
/begin CHARACTERISTIC DDRC_RatDeb.PFlt_tiEngPrtMaxUDRat_C "/" VALUE 0x800713D9 Val_Wu8 3. DDRC_Ratio 1. 4. FORMAT "%2.0" /end CHARACTERISTIC
/begin CHARACTERISTIC DDRC_RatDeb.AirC_tiClntSRCMinUDRat_C "/" VALUE 0x800713DA Val_Wu8 3. DDRC_Ratio 1. 4. FORMAT "%2.0" /end CHARACTERISTIC
/begin CHARACTERISTIC DDRC_RatDeb.CByVlv_tiSCGUDRat_C "/" VALUE 0x800713DB Val_Wu8 3. DDRC_Ratio 1. 4. FORMAT "%2.0" /end CHARACTERISTIC
/begin CHARACTERISTIC DDRC_RatDeb.AirC_tiClntSRCPerMinUDRat_C "/" VALUE 0x800713DC Val_Wu8 3. DDRC_Ratio 1. 4. FORMAT "%2.0" /end CHARACTERISTIC
/begin CHARACTERISTIC DDRC_RatDeb.Strt_tiSCGUDRat_C "/" VALUE 0x800713DD Val_Wu8 3. DDRC_Ratio 1. 4. FORMAT "%2.0" /end CHARACTERISTIC
/begin CHARACTERISTIC DDRC_RatDeb.Clth_tiSigUDRat_C "/" VALUE 0x800713DE Val_Wu8 3. DDRC_Ratio 1. 4. FORMAT "%2.0" /end CHARACTERISTIC
/begin CHARACTERISTIC DDRC_RatDeb.Air_tiSRCMinPCACDsUDRat_C "/" VALUE 0x800713DF Val_Wu8 3. DDRC_Ratio 1. 4. FORMAT "%2.0" /end CHARACTERISTIC
/begin CHARACTERISTIC DDRC_RatDeb.EngStA_tiOLUDRat_C "/" VALUE 0x800713E0 Val_Wu8 3. DDRC_Ratio 1. 4. FORMAT "%2.0" /end CHARACTERISTIC
/begin CHARACTERISTIC DDRC_RatDeb.GbxNPos_tiSRCPerMinUDRat_C "/" VALUE 0x800713E1 Val_Wu8 3. DDRC_Ratio 1. 4. FORMAT "%2.0" /end CHARACTERISTIC
/begin CHARACTERISTIC DDRC_RatDeb.LSU_tiCircPmpCurSigUDRat_C "/" VALUE 0x800713E2 Val_Wu8 3. DDRC_Ratio 1. 4. FORMAT "%2.0" /end CHARACTERISTIC
/begin CHARACTERISTIC DDRC_RatDeb.GbxNPos_tiSRCPerMaxUDRat_C "/" VALUE 0x800713E3 Val_Wu8 3. DDRC_Ratio 1. 4. FORMAT "%2.0" /end CHARACTERISTIC
/begin CHARACTERISTIC DDRC_RatDeb.OilPLmp_tiOLUDRat_C "/" VALUE 0x800713E4 Val_Wu8 3. DDRC_Ratio 1. 4. FORMAT "%2.0" /end CHARACTERISTIC
/begin CHARACTERISTIC DDRC_RatDeb.AFS_tiRawSRCMaxUDRat_C "/" VALUE 0x800713E5 Val_Wu8 3. DDRC_Ratio 1. 4. FORMAT "%2.0" /end CHARACTERISTIC
/begin CHARACTERISTIC DDRC_RatDeb.VSwVlv_tiSRCMaxUDRat_C "/" VALUE 0x800713E6 Val_Wu8 3. DDRC_Ratio 1. 4. FORMAT "%2.0" /end CHARACTERISTIC
/begin CHARACTERISTIC DDRC_RatDeb.ErrLmp_tiMILSCGUDRat_C "/" VALUE 0x800713E7 Val_Wu8 3. DDRC_Ratio 1. 4. FORMAT "%2.0" /end CHARACTERISTIC
/begin CHARACTERISTIC DDRC_RatDeb.ErrLmp_tiSVSOLUDRat_C "/" VALUE 0x800713E8 Val_Wu8 3. DDRC_Ratio 1. 4. FORMAT "%2.0" /end CHARACTERISTIC
/begin CHARACTERISTIC DDRC_RatDeb.VSwVlv_tiSCBUDRat_C "/" VALUE 0x800713E9 Val_Wu8 3. DDRC_Ratio 1. 4. FORMAT "%2.0" /end CHARACTERISTIC
/begin CHARACTERISTIC DDRC_RatDeb.LSU_titExcMaxUDRat_C "/" VALUE 0x800713EA Val_Wu8 3. DDRC_Ratio 1. 4. FORMAT "%2.0" /end CHARACTERISTIC
/begin CHARACTERISTIC DDRC_RatDeb.ECBVlv_tiSCBUDRat_C "/" VALUE 0x800713EB Val_Wu8 3. DDRC_Ratio 1. 4. FORMAT "%2.0" /end CHARACTERISTIC
/begin CHARACTERISTIC DDRC_RatDeb.BattU_tiMaxUDRat_C "/" VALUE 0x800713EC Val_Wu8 3. DDRC_Ratio 1. 4. FORMAT "%2.0" /end CHARACTERISTIC
/begin CHARACTERISTIC DDRC_RatDeb.BattU_tiMinUDRat_C "/" VALUE 0x800713ED Val_Wu8 3. DDRC_Ratio 1. 4. FORMAT "%2.0" /end CHARACTERISTIC
/begin CHARACTERISTIC DDRC_RatDeb.VSwVlv_tiSCGUDRat_C "/" VALUE 0x800713EE Val_Wu8 3. DDRC_Ratio 1. 4. FORMAT "%2.0" /end CHARACTERISTIC
/begin CHARACTERISTIC DDRC_RatDeb.ErrLmp_tiMILSCBUDRat_C "/" VALUE 0x800713EF Val_Wu8 3. DDRC_Ratio 1. 4. FORMAT "%2.0" /end CHARACTERISTIC
/begin CHARACTERISTIC DDRC_RatDeb.ECBVlv_tiSCGUDRat_C "/" VALUE 0x800713F0 Val_Wu8 3. DDRC_Ratio 1. 4. FORMAT "%2.0" /end CHARACTERISTIC
/begin CHARACTERISTIC DDRC_RatDeb.PCV_tiSCGUDRat_C "/" VALUE 0x800713F1 Val_Wu8 3. DDRC_Ratio 1. 4. FORMAT "%2.0" /end CHARACTERISTIC
/begin CHARACTERISTIC DDRC_RatDeb.Air_tiMinTCACDsUDRat_C "/" VALUE 0x800713F2 Val_Wu8 3. DDRC_Ratio 1. 4. FORMAT "%2.0" /end CHARACTERISTIC
/begin CHARACTERISTIC DDRC_RatDeb.LSU_tiCircPmpCurMaxUDRat_C "/" VALUE 0x800713F3 Val_Wu8 3. DDRC_Ratio 1. 4. FORMAT "%2.0" /end CHARACTERISTIC
/begin CHARACTERISTIC DDRC_RatDeb.EGRVlv_tiSCBUDRat_C "/" VALUE 0x800713F4 Val_Wu8 3. DDRC_Ratio 1. 4. FORMAT "%2.0" /end CHARACTERISTIC
/begin CHARACTERISTIC DDRC_RatDeb.Air_tiNplPAirFltDsUDRat_C "/" VALUE 0x800713F5 Val_Wu8 3. DDRC_Ratio 1. 4. FORMAT "%2.0" /end CHARACTERISTIC
/begin CHARACTERISTIC DDRC_RatDeb.PSP_tiOLUDRat_C "/" VALUE 0x800713F6 Val_Wu8 3. DDRC_Ratio 1. 4. FORMAT "%2.0" /end CHARACTERISTIC
/begin CHARACTERISTIC DDRC_RatDeb.Air_tiDtyCycHiTAFSUDRat_C "/" VALUE 0x800713F7 Val_Wu8 3. DDRC_Ratio 1. 4. FORMAT "%2.0" /end CHARACTERISTIC
/begin CHARACTERISTIC DDRC_RatDeb.EnvP_tiMaxUDRat_C "/" VALUE 0x800713F8 Val_Wu8 3. DDRC_Ratio 1. 4. FORMAT "%2.0" /end CHARACTERISTIC
/begin CHARACTERISTIC DDRC_RatDeb.CByVlv_tiOLUDRat_C "/" VALUE 0x800713F9 Val_Wu8 3. DDRC_Ratio 1. 4. FORMAT "%2.0" /end CHARACTERISTIC
/begin CHARACTERISTIC DDRC_RatDeb.FuelT_tiMinUDRat_C "/" VALUE 0x800713FA Val_Wu8 3. DDRC_Ratio 1. 4. FORMAT "%2.0" /end CHARACTERISTIC
/begin CHARACTERISTIC DDRC_RatDeb.PFltLmp_tiSCBUDRat_C "/" VALUE 0x800713FB Val_Wu8 3. DDRC_Ratio 1. 4. FORMAT "%2.0" /end CHARACTERISTIC
/begin CHARACTERISTIC DDRC_RatDeb.Exh_tiSRCMinTOxiCatUsUDRat_C "/" VALUE 0x800713FC Val_Wu8 3. DDRC_Ratio 1. 4. FORMAT "%2.0" /end CHARACTERISTIC
/begin CHARACTERISTIC DDRC_RatDeb.VehV_tiHWUDRat_C "/" VALUE 0x800713FD Val_Wu8 3. DDRC_Ratio 1. 4. FORMAT "%2.0" /end CHARACTERISTIC
/begin CHARACTERISTIC DDRC_RatDeb.PSP_tiSCBUDRat_C "/" VALUE 0x800713FE Val_Wu8 3. DDRC_Ratio 1. 4. FORMAT "%2.0" /end CHARACTERISTIC
/begin CHARACTERISTIC DDRC_RatDeb.CThmst_tiSCBUDRat_C "/" VALUE 0x800713FF Val_Wu8 3. DDRC_Ratio 1. 4. FORMAT "%2.0" /end CHARACTERISTIC
/begin CHARACTERISTIC DDRC_RatDeb.AirC_tiClntSRCdcycMinUDRat_C "/" VALUE 0x80071400 Val_Wu8 3. DDRC_Ratio 1. 4. FORMAT "%2.0" /end CHARACTERISTIC
/begin CHARACTERISTIC DDRC_RatDeb.Air_tiMaxTCACDsUDRat_C "/" VALUE 0x80071401 Val_Wu8 3. DDRC_Ratio 1. 4. FORMAT "%2.0" /end CHARACTERISTIC
/begin CHARACTERISTIC DDRC_RatDeb.TrbChLP_tiSCGUDRat_C "/" VALUE 0x80071402 Val_Wu8 3. DDRC_Ratio 1. 4. FORMAT "%2.0" /end CHARACTERISTIC
/begin CHARACTERISTIC DDRC_RatDeb.PSP_tiSCGUDRat_C "/" VALUE 0x80071403 Val_Wu8 3. DDRC_Ratio 1. 4. FORMAT "%2.0" /end CHARACTERISTIC
/begin CHARACTERISTIC DDRC_RatDeb.LSU_tiO2MaxUDRat_C "/" VALUE 0x80071404 Val_Wu8 3. DDRC_Ratio 1. 4. FORMAT "%2.0" /end CHARACTERISTIC
/begin CHARACTERISTIC DDRC_RatDeb.PFlt_tiSotMsDvtMaxUDRat_C "/" VALUE 0x80071405 Val_Wu8 3. DDRC_Ratio 1. 4. FORMAT "%2.0" /end CHARACTERISTIC
/begin CHARACTERISTIC DDRC_RatDeb.VehV_tiMaxUDRat_C "/" VALUE 0x80071406 Val_Wu8 3. DDRC_Ratio 1. 4. FORMAT "%2.0" /end CHARACTERISTIC
/begin CHARACTERISTIC DDRC_RatDeb.Exh_tiNplTPFltUsUDRat_C "/" VALUE 0x80071407 Val_Wu8 3. DDRC_Ratio 1. 4. FORMAT "%2.0" /end CHARACTERISTIC
/begin CHARACTERISTIC DDRC_RatDeb.Oil_tiMaxTUDRat_C "/" VALUE 0x80071408 Val_Wu8 3. DDRC_Ratio 1. 4. FORMAT "%2.0" /end CHARACTERISTIC
/begin CHARACTERISTIC DDRC_RatDeb.ErrLmp_tiSVSSCGUDRat_C "/" VALUE 0x80071409 Val_Wu8 3. DDRC_Ratio 1. 4. FORMAT "%2.0" /end CHARACTERISTIC
/begin CHARACTERISTIC DDRC_RatDeb.Exh_tiSRCMaxTOxiCatUsUDRat_C "/" VALUE 0x8007140A Val_Wu8 3. DDRC_Ratio 1. 4. FORMAT "%2.0" /end CHARACTERISTIC
/begin CHARACTERISTIC DDRC_RatDeb.VSwVlv_tiGovDvtMaxUDRat_C "/" VALUE 0x8007140B Val_Wu8 3. DDRC_Ratio 1. 4. FORMAT "%2.0" /end CHARACTERISTIC
/begin CHARACTERISTIC DDRC_RatDeb.Brk_tiPlaUDRat_C "/" VALUE 0x8007140C Val_Wu8 3. DDRC_Ratio 1. 4. FORMAT "%2.0" /end CHARACTERISTIC
/begin CHARACTERISTIC DDRC_RatDeb.AFS_tiSetyDrftMinUDRat_C "/" VALUE 0x8007140D Val_Wu8 3. DDRC_Ratio 1. 4. FORMAT "%2.0" /end CHARACTERISTIC
/begin CHARACTERISTIC DDRC_RatDeb.LSU_tiCircPmpCurMinUDRat_C "/" VALUE 0x8007140E Val_Wu8 3. DDRC_Ratio 1. 4. FORMAT "%2.0" /end CHARACTERISTIC
/begin CHARACTERISTIC DDRC_RatDeb.VSwVlv_tiGovDvtMinUDRat_C "/" VALUE 0x8007140F Val_Wu8 3. DDRC_Ratio 1. 4. FORMAT "%2.0" /end CHARACTERISTIC
/begin CHARACTERISTIC DDRC_RatDeb.CEngDsT_tiMinUDRat_C "/" VALUE 0x80071410 Val_Wu8 3. DDRC_Ratio 1. 4. FORMAT "%2.0" /end CHARACTERISTIC
/begin CHARACTERISTIC DDRC_RatDeb.CThmst_tiOLUDRat_C "/" VALUE 0x80071411 Val_Wu8 3. DDRC_Ratio 1. 4. FORMAT "%2.0" /end CHARACTERISTIC
/begin CHARACTERISTIC DDRC_RatDeb.GbxNPos_tiSRCdcycMinUDRat_C "/" VALUE 0x80071412 Val_Wu8 3. DDRC_Ratio 1. 4. FORMAT "%2.0" /end CHARACTERISTIC
/begin CHARACTERISTIC DDRC_RatDeb.PFltLmp_tiOLUDRat_C "/" VALUE 0x80071413 Val_Wu8 3. DDRC_Ratio 1. 4. FORMAT "%2.0" /end CHARACTERISTIC
/begin CHARACTERISTIC DDRC_RatDeb.TrbChLP_tiSCBUDRat_C "/" VALUE 0x80071414 Val_Wu8 3. DDRC_Ratio 1. 4. FORMAT "%2.0" /end CHARACTERISTIC
/begin CHARACTERISTIC DDRC_RatDeb.LSU_tiHtrMinUDRat_C "/" VALUE 0x80071415 Val_Wu8 3. DDRC_Ratio 1. 4. FORMAT "%2.0" /end CHARACTERISTIC
/begin CHARACTERISTIC DDRC_RatDeb.ThrVlv_tiSRCMaxUDRat_C "/" VALUE 0x80071416 Val_Wu8 3. DDRC_Ratio 1. 4. FORMAT "%2.0" /end CHARACTERISTIC
/begin CHARACTERISTIC DDRC_RatDeb.Fan_tiSCBUDRat_C "/" VALUE 0x80071417 Val_Wu8 3. DDRC_Ratio 1. 4. FORMAT "%2.0" /end CHARACTERISTIC
/begin CHARACTERISTIC DDRC_RatDeb.Oil_tiMinTUDRat_C "/" VALUE 0x80071418 Val_Wu8 3. DDRC_Ratio 1. 4. FORMAT "%2.0" /end CHARACTERISTIC
/begin CHARACTERISTIC DDRC_RatDeb.PFlt_tiSotMsDvtMinUDRat_C "/" VALUE 0x80071419 Val_Wu8 3. DDRC_Ratio 1. 4. FORMAT "%2.0" /end CHARACTERISTIC
/begin CHARACTERISTIC DDRC_RatDeb.EnvP_tiMinUDRat_C "/" VALUE 0x8007141A Val_Wu8 3. DDRC_Ratio 1. 4. FORMAT "%2.0" /end CHARACTERISTIC
/begin CHARACTERISTIC DDRC_RatDeb.GlwPlg_tiBSDSCUDRat_C "/" VALUE 0x8007141B Val_Wu8 3. DDRC_Ratio 1. 4. FORMAT "%2.0" /end CHARACTERISTIC
/begin CHARACTERISTIC DDRC_RatDeb.Brk_tiSigUDRat_C "/" VALUE 0x8007141C Val_Wu8 3. DDRC_Ratio 1. 4. FORMAT "%2.0" /end CHARACTERISTIC
/begin CHARACTERISTIC DDRC_RatDeb.CThmst_tiSCGUDRat_C "/" VALUE 0x8007141D Val_Wu8 3. DDRC_Ratio 1. 4. FORMAT "%2.0" /end CHARACTERISTIC
/begin CHARACTERISTIC DDRC_RatDeb.GlwPlg_tiBSDOTUDRat_C "/" VALUE 0x8007141E Val_Wu8 3. DDRC_Ratio 1. 4. FORMAT "%2.0" /end CHARACTERISTIC
/begin CHARACTERISTIC DDRC_RatDeb.EnvT_tiMaxUDRat_C "/" VALUE 0x8007141F Val_Wu8 3. DDRC_Ratio 1. 4. FORMAT "%2.0" /end CHARACTERISTIC
/begin CHARACTERISTIC DDRC_RatDeb.AFS_tiSetyDrftMaxUDRat_C "/" VALUE 0x80071420 Val_Wu8 3. DDRC_Ratio 1. 4. FORMAT "%2.0" /end CHARACTERISTIC
/begin CHARACTERISTIC DDRC_RatDeb.LSU_tiCircNernstMinUDRat_C "/" VALUE 0x80071421 Val_Wu8 3. DDRC_Ratio 1. 4. FORMAT "%2.0" /end CHARACTERISTIC
/begin CHARACTERISTIC DDRC_RatDeb.EGRVlv_tiGovDvtMaxUDRat_C "/" VALUE 0x80071422 Val_Wu8 3. DDRC_Ratio 1. 4. FORMAT "%2.0" /end CHARACTERISTIC
/begin CHARACTERISTIC DDRC_RatDeb.Exh_tiSRCMaxTPFltUsUDRat_C "/" VALUE 0x80071423 Val_Wu8 3. DDRC_Ratio 1. 4. FORMAT "%2.0" /end CHARACTERISTIC
/begin CHARACTERISTIC DDRC_RatDeb.VehV_tiPlaUDRat_C "/" VALUE 0x80071424 Val_Wu8 3. DDRC_Ratio 1. 4. FORMAT "%2.0" /end CHARACTERISTIC
/begin CHARACTERISTIC DDRC_RatDeb.EMDmp_tiSCGUDRat_C "/" VALUE 0x80071425 Val_Wu8 3. DDRC_Ratio 1. 4. FORMAT "%2.0" /end CHARACTERISTIC
/begin CHARACTERISTIC DDRC_RatDeb.ECBVlv_tiOLUDRat_C "/" VALUE 0x80071426 Val_Wu8 3. DDRC_Ratio 1. 4. FORMAT "%2.0" /end CHARACTERISTIC
/begin CHARACTERISTIC DDRC_RatDeb.EnvT_tiMinUDRat_C "/" VALUE 0x80071427 Val_Wu8 3. DDRC_Ratio 1. 4. FORMAT "%2.0" /end CHARACTERISTIC
/begin CHARACTERISTIC DDRC_RatDeb.VehV_tiSigUDRat_C "/" VALUE 0x80071428 Val_Wu8 3. DDRC_Ratio 1. 4. FORMAT "%2.0" /end CHARACTERISTIC
/begin CHARACTERISTIC DDRC_RatDeb.EGRVlv_tiOLUDRat_C "/" VALUE 0x80071429 Val_Wu8 3. DDRC_Ratio 1. 4. FORMAT "%2.0" /end CHARACTERISTIC
/begin CHARACTERISTIC DDRC_RatDeb.LSU_tiCircVirtGndMaxUDRat_C "/" VALUE 0x8007142A Val_Wu8 3. DDRC_Ratio 1. 4. FORMAT "%2.0" /end CHARACTERISTIC
/begin CHARACTERISTIC DDRC_RatDeb.LSU_tiCircVirtGndSigUDRat_C "/" VALUE 0x8007142B Val_Wu8 3. DDRC_Ratio 1. 4. FORMAT "%2.0" /end CHARACTERISTIC
/begin CHARACTERISTIC DDRC_RatDeb.AFS_tiRawSRCMinUDRat_C "/" VALUE 0x8007142C Val_Wu8 3. DDRC_Ratio 1. 4. FORMAT "%2.0" /end CHARACTERISTIC
/begin CHARACTERISTIC DDRC_RatDeb.AFS_tiOffsDrftMinUDRat_C "/" VALUE 0x8007142D Val_Wu8 3. DDRC_Ratio 1. 4. FORMAT "%2.0" /end CHARACTERISTIC
/begin CHARACTERISTIC DDRC_RatDeb.LSU_tiO2MinUDRat_C "/" VALUE 0x8007142E Val_Wu8 3. DDRC_Ratio 1. 4. FORMAT "%2.0" /end CHARACTERISTIC
/begin CHARACTERISTIC DDRC_RatDeb.LSU_tiCircNernstMaxUDRat_C "/" VALUE 0x8007142F Val_Wu8 3. DDRC_Ratio 1. 4. FORMAT "%2.0" /end CHARACTERISTIC
/begin CHARACTERISTIC DDRC_RatDeb.ThrVlv_tiSRCMinUDRat_C "/" VALUE 0x80071430 Val_Wu8 3. DDRC_Ratio 1. 4. FORMAT "%2.0" /end CHARACTERISTIC
/begin CHARACTERISTIC DDRC_RatDeb.EGRVlv_tiSRCMinUDRat_C "/" VALUE 0x80071431 Val_Wu8 3. DDRC_Ratio 1. 4. FORMAT "%2.0" /end CHARACTERISTIC
/begin CHARACTERISTIC DDRC_RatDeb.ECBVlv_tiSRCMinUDRat_C "/" VALUE 0x80071432 Val_Wu8 3. DDRC_Ratio 1. 4. FORMAT "%2.0" /end CHARACTERISTIC
/begin CHARACTERISTIC DDRC_RatDeb.PFlt_tiCharPDiffMinUDRat_C "/" VALUE 0x80071433 Val_Wu8 3. DDRC_Ratio 1. 4. FORMAT "%2.0" /end CHARACTERISTIC
/begin CHARACTERISTIC DDRC_RatDeb.Air_tiPerLoTAFSUDRat_C "/" VALUE 0x80071434 Val_Wu8 3. DDRC_Ratio 1. 4. FORMAT "%2.0" /end CHARACTERISTIC
/begin CHARACTERISTIC DDRC_RatDeb.AirC_tiCmprRedTrqSCBUDRat_C "/" VALUE 0x80071435 Val_Wu8 3. DDRC_Ratio 1. 4. FORMAT "%2.0" /end CHARACTERISTIC
/begin CHARACTERISTIC DDRC_RatDeb.TrbChLP_tiOLUDRat_C "/" VALUE 0x80071436 Val_Wu8 3. DDRC_Ratio 1. 4. FORMAT "%2.0" /end CHARACTERISTIC
/begin CHARACTERISTIC DDRC_RatDeb.BrkP_tiMaxUDRat_C "/" VALUE 0x80071437 Val_Wu8 3. DDRC_Ratio 1. 4. FORMAT "%2.0" /end CHARACTERISTIC
/begin CHARACTERISTIC DDRC_RatDeb.AFS_tiCorSRCMinUDRat_C "/" VALUE 0x80071438 Val_Wu8 3. DDRC_Ratio 1. 4. FORMAT "%2.0" /end CHARACTERISTIC
/begin CHARACTERISTIC DDRC_RatDeb.EMDmp_tiOLUDRat_C "/" VALUE 0x80071439 Val_Wu8 3. DDRC_Ratio 1. 4. FORMAT "%2.0" /end CHARACTERISTIC
/begin CHARACTERISTIC DDRC_RatDeb.Oil_tiComErrUDRat_C "/" VALUE 0x8007143A Val_Wu8 3. DDRC_Ratio 1. 4. FORMAT "%2.0" /end CHARACTERISTIC
/begin CHARACTERISTIC DDRC_RatDeb.AirC_tiSwtSigUDRat_C "/" VALUE 0x8007143B Val_Wu8 3. DDRC_Ratio 1. 4. FORMAT "%2.0" /end CHARACTERISTIC
/begin CHARACTERISTIC DDRC_RatDeb.Air_tiSRCMaxPCACDsUDRat_C "/" VALUE 0x8007143C Val_Wu8 3. DDRC_Ratio 1. 4. FORMAT "%2.0" /end CHARACTERISTIC
/begin CHARACTERISTIC DDRC_RatDeb.Air_tiMinPAirFltDsUDRat_C "/" VALUE 0x8007143D Val_Wu8 3. DDRC_Ratio 1. 4. FORMAT "%2.0" /end CHARACTERISTIC
/begin CHARACTERISTIC DDRC_RatDeb.LSU_tiCircNernstSigUDRat_C "/" VALUE 0x8007143E Val_Wu8 3. DDRC_Ratio 1. 4. FORMAT "%2.0" /end CHARACTERISTIC
/begin CHARACTERISTIC DDRC_RatDeb.Exh_tiSRCMinTPFltUsUDRat_C "/" VALUE 0x8007143F Val_Wu8 3. DDRC_Ratio 1. 4. FORMAT "%2.0" /end CHARACTERISTIC
/begin CHARACTERISTIC DDRC_RatDeb.GbxNPos_tiSRCdcycMaxUDRat_C "/" VALUE 0x80071440 Val_Wu8 3. DDRC_Ratio 1. 4. FORMAT "%2.0" /end CHARACTERISTIC
/begin CHARACTERISTIC DDRC_RatDeb.EnvP_tiSigUDRat_C "/" VALUE 0x80071441 Val_Wu8 3. DDRC_Ratio 1. 4. FORMAT "%2.0" /end CHARACTERISTIC
/begin CHARACTERISTIC DDRC_RatDeb.EGRVlv_tiGovDvtMinUDRat_C "/" VALUE 0x80071442 Val_Wu8 3. DDRC_Ratio 1. 4. FORMAT "%2.0" /end CHARACTERISTIC
/begin CHARACTERISTIC DDRC_RatDeb.CByVlv_tiSCBUDRat_C "/" VALUE 0x80071443 Val_Wu8 3. DDRC_Ratio 1. 4. FORMAT "%2.0" /end CHARACTERISTIC
/begin CHARACTERISTIC DDRC_RatDeb.LSU_tiCircVirtGndMinUDRat_C "/" VALUE 0x80071444 Val_Wu8 3. DDRC_Ratio 1. 4. FORMAT "%2.0" /end CHARACTERISTIC
/begin CHARACTERISTIC DDRC_RatDeb.LSU_titExcMinUDRat_C "/" VALUE 0x80071445 Val_Wu8 3. DDRC_Ratio 1. 4. FORMAT "%2.0" /end CHARACTERISTIC
/begin CHARACTERISTIC DDRC_RatDeb.LSU_tiSPIBattLowMinUDRat_C "/" VALUE 0x80071446 Val_Wu8 3. DDRC_Ratio 1. 4. FORMAT "%2.0" /end CHARACTERISTIC
/begin CHARACTERISTIC DDRC_RatDeb.Air_tiMaxPAirFltDsUDRat_C "/" VALUE 0x80071447 Val_Wu8 3. DDRC_Ratio 1. 4. FORMAT "%2.0" /end CHARACTERISTIC
/begin CHARACTERISTIC DDRC_RatDeb.OilPLmp_tiSCGUDRat_C "/" VALUE 0x80071448 Val_Wu8 3. DDRC_Ratio 1. 4. FORMAT "%2.0" /end CHARACTERISTIC
/begin CHARACTERISTIC DDRC_RatDeb.AirC_tiCmprSCGUDRat_C "/" VALUE 0x80071449 Val_Wu8 3. DDRC_Ratio 1. 4. FORMAT "%2.0" /end CHARACTERISTIC
/begin CHARACTERISTIC DDRC_RatDeb.TrbCh_tiSCBUDRat_C "/" VALUE 0x8007144A Val_Wu8 3. DDRC_Ratio 1. 4. FORMAT "%2.0" /end CHARACTERISTIC
/begin CHARACTERISTIC DDRC_RatDeb.IVDia_numChpSPICfgUDRat_C "/" VALUE 0x8007144B Val_Wu8 3. DDRC_Ratio 1. 4. FORMAT "%2.0" /end CHARACTERISTIC
/begin CHARACTERISTIC DDRC_RatDeb.IVDia_numBnkHSBattUDRat_C "/" VALUE 0x8007144C Val_Wu8 3. DDRC_Ratio 1. 4. FORMAT "%2.0" /end CHARACTERISTIC
/begin CHARACTERISTIC DDRC_RatDeb.LSU_numO2PlausMaxUDRat_C "/" VALUE 0x8007144D Val_Wu8 3. DDRC_Ratio 1. 4. FORMAT "%2.0" /end CHARACTERISTIC
/begin CHARACTERISTIC DDRC_RatDeb.LSU_numO2ClbMaxUDRat_C "/" VALUE 0x8007144E Val_Wu8 3. DDRC_Ratio 1. 4. FORMAT "%2.0" /end CHARACTERISTIC
/begin CHARACTERISTIC DDRC_RatDeb.IVDia_numCylNoLdUDRat_C "/" VALUE 0x8007144F Val_Wu8 3. DDRC_Ratio 1. 4. FORMAT "%2.0" /end CHARACTERISTIC
/begin CHARACTERISTIC DDRC_RatDeb.IVDia_numChpSPIRamUDRat_C "/" VALUE 0x80071450 Val_Wu8 3. DDRC_Ratio 1. 4. FORMAT "%2.0" /end CHARACTERISTIC
/begin CHARACTERISTIC DDRC_RatDeb.LSU_numRiClbMinUDRat_C "/" VALUE 0x80071451 Val_Wu8 3. DDRC_Ratio 1. 4. FORMAT "%2.0" /end CHARACTERISTIC
/begin CHARACTERISTIC DDRC_RatDeb.LSU_numO2PlausMinUDRat_C "/" VALUE 0x80071452 Val_Wu8 3. DDRC_Ratio 1. 4. FORMAT "%2.0" /end CHARACTERISTIC
/begin CHARACTERISTIC DDRC_RatDeb.IVDia_numBnkTransferUDRat_C "/" VALUE 0x80071453 Val_Wu8 3. DDRC_Ratio 1. 4. FORMAT "%2.0" /end CHARACTERISTIC
/begin CHARACTERISTIC DDRC_RatDeb.IVDia_numChpSPICollUDRat_C "/" VALUE 0x80071454 Val_Wu8 3. DDRC_Ratio 1. 4. FORMAT "%2.0" /end CHARACTERISTIC
/begin CHARACTERISTIC DDRC_RatDeb.IVDia_numCylShCirLSBattUDRat_C "/" VALUE 0x80071455 Val_Wu8 3. DDRC_Ratio 1. 4. FORMAT "%2.0" /end CHARACTERISTIC
/begin CHARACTERISTIC DDRC_RatDeb.IVDia_numChpSPITransUDRat_C "/" VALUE 0x80071456 Val_Wu8 3. DDRC_Ratio 1. 4. FORMAT "%2.0" /end CHARACTERISTIC
/begin CHARACTERISTIC DDRC_RatDeb.IVDia_numBnkShCirHiRstncUDRat_C "/" VALUE 0x80071457 Val_Wu8 3. DDRC_Ratio 1. 4. FORMAT "%2.0" /end CHARACTERISTIC
/begin CHARACTERISTIC DDRC_RatDeb.IVDia_numCylShCirLSLSUDRat_C "/" VALUE 0x80071458 Val_Wu8 3. DDRC_Ratio 1. 4. FORMAT "%2.0" /end CHARACTERISTIC
/begin CHARACTERISTIC DDRC_RatDeb.IVDia_numCylShCirHiRstncUDRat_C "/" VALUE 0x80071459 Val_Wu8 3. DDRC_Ratio 1. 4. FORMAT "%2.0" /end CHARACTERISTIC
/begin CHARACTERISTIC DDRC_RatDeb.ETClb_numETMaxUDRat_C "/" VALUE 0x8007145A Val_Wu8 3. DDRC_Ratio 1. 4. FORMAT "%2.0" /end CHARACTERISTIC
/begin CHARACTERISTIC DDRC_RatDeb.IVDia_numBnkBSHUDRat_C "/" VALUE 0x8007145B Val_Wu8 3. DDRC_Ratio 1. 4. FORMAT "%2.0" /end CHARACTERISTIC
/begin CHARACTERISTIC DDRC_RatDeb.IVDia_numBnkShCirLSHSGndUDRat_C "/" VALUE 0x8007145C Val_Wu8 3. DDRC_Ratio 1. 4. FORMAT "%2.0" /end CHARACTERISTIC
/begin CHARACTERISTIC DDRC_RatDeb.LSU_numRiClbMaxUDRat_C "/" VALUE 0x8007145D Val_Wu8 3. DDRC_Ratio 1. 4. FORMAT "%2.0" /end CHARACTERISTIC
/begin CHARACTERISTIC DDRC_RatDeb.IVDia_numChpSPICtrlUDRat_C "/" VALUE 0x8007145E Val_Wu8 3. DDRC_Ratio 1. 4. FORMAT "%2.0" /end CHARACTERISTIC
/begin CHARACTERISTIC DDRC_RatDeb.ETClb_numETMinUDRat_C "/" VALUE 0x8007145F Val_Wu8 3. DDRC_Ratio 1. 4. FORMAT "%2.0" /end CHARACTERISTIC
/begin CHARACTERISTIC DDRC_RatDeb.Clth_numPlaUDRat_C "/" VALUE 0x80071460 Val_Wu8 3. DDRC_Ratio 1. 4. FORMAT "%2.0" /end CHARACTERISTIC
/begin CHARACTERISTIC DDRC_RatDeb.LSU_numDynChkMinUDRat_C "/" VALUE 0x80071461 Val_Wu8 3. DDRC_Ratio 1. 4. FORMAT "%2.0" /end CHARACTERISTIC
/begin CHARACTERISTIC DDRC_RatDeb.LSU_numO2ClbMinUDRat_C "/" VALUE 0x80071462 Val_Wu8 3. DDRC_Ratio 1. 4. FORMAT "%2.0" /end CHARACTERISTIC
/begin CHARACTERISTIC DDRC_RatDeb.IVDia_numCylNoClsUDRat_C "/" VALUE 0x80071463 Val_Wu8 3. DDRC_Ratio 1. 4. FORMAT "%2.0" /end CHARACTERISTIC
/begin CHARACTERISTIC DDRC_RatDeb.LSU_numWireIPSigUDRat_C "/" VALUE 0x80071464 Val_Wu8 3. DDRC_Ratio 1. 4. FORMAT "%2.0" /end CHARACTERISTIC
/begin CHARACTERISTIC DDRC_RatDeb.LSU_numCmpChkMinUDRat_C "/" VALUE 0x80071465 Val_Wu8 3. DDRC_Ratio 1. 4. FORMAT "%2.0" /end CHARACTERISTIC
/begin CHARACTERISTIC DDRC_RatDeb.IVDia_numBnkShCirChSwtUDRat_C "/" VALUE 0x80071466 Val_Wu8 3. DDRC_Ratio 1. 4. FORMAT "%2.0" /end CHARACTERISTIC
/begin CHARACTERISTIC DDRC_RatDeb.IVDia_numCylShCirLSHSUDRat_C "/" VALUE 0x80071467 Val_Wu8 3. DDRC_Ratio 1. 4. FORMAT "%2.0" /end CHARACTERISTIC
/begin CHARACTERISTIC DevLib_nActrRls_C "" VALUE 0x8004BA00 Val_Ws16 5960.000 EngN 40.00000 6000.000 FORMAT "%8.3" EXTENDED_LIMITS -16384.00 16383.50 /end CHARACTERISTIC
/begin CHARACTERISTIC Devlib_PsDisbl.facLowHysLo_C "/" VALUE 0x8004BA04 Kw_Ws16 1.000000 Fact 0.00 1.000000 FORMAT "%8.6" EXTENDED_LIMITS -4.000000 3.999878 /end CHARACTERISTIC
/begin CHARACTERISTIC Devlib_PsDisbl.facLowHysHi_C "/" VALUE 0x8004BA06 Kw_Ws16 1.000000 Fact 0.00 1.000000 FORMAT "%8.6" EXTENDED_LIMITS -4.000000 3.999878 /end CHARACTERISTIC
/begin CHARACTERISTIC Devlib_PsDisbl.facHighHysLo_C "/" VALUE 0x8004BA08 Kw_Ws16 2.999878 Fact 1.000000 3.999878 FORMAT "%8.6" EXTENDED_LIMITS -4.000000 3.999878 /end CHARACTERISTIC
/begin CHARACTERISTIC Devlib_PsDisbl.facHighHysHi_C "/" VALUE 0x8004BA0A Kw_Ws16 2.999878 Fact 1.000000 3.999878 FORMAT "%8.6" EXTENDED_LIMITS -4.000000 3.999878 /end CHARACTERISTIC
/begin CHARACTERISTIC Devlib_PwrStg.BattLoHysLo_C "/" VALUE 0x8004BA0C Val_Ws16 1310700. Volt_Batt -655360.0 655340.0 FORMAT "%8.1" /end CHARACTERISTIC
/begin CHARACTERISTIC Devlib_PwrStg.BattLoHysHi_C "/" VALUE 0x8004BA0E Val_Ws16 1310700. Volt_Batt -655360.0 655340.0 FORMAT "%8.1" /end CHARACTERISTIC
/begin CHARACTERISTIC Devlib_PwrStg.BattHiHysLo_C "/" VALUE 0x8004BA10 Val_Ws16 1310700. Volt_Batt -655360.0 655340.0 FORMAT "%8.1" /end CHARACTERISTIC
/begin CHARACTERISTIC Devlib_PwrStg.BattHiHysHi_C "/" VALUE 0x8004BA12 Val_Ws16 1310700. Volt_Batt -655360.0 655340.0 FORMAT "%8.1" /end CHARACTERISTIC
/begin CHARACTERISTIC DevLib_tiActrPrt_C "" VALUE 0x8004BA02 Val_Ws16 2000.000 Time_ms 0.00 2000.000 FORMAT "%8.3" EXTENDED_LIMITS -327680.0 327670.0 /end CHARACTERISTIC
/begin CHARACTERISTIC DevLib_tiDlyT15_C "" VALUE 0x8004BA14 Kw_Wu16 655350.0 Time_ms 0.00 655350.0 FORMAT "%8.1" /end CHARACTERISTIC
/begin CHARACTERISTIC DewDet_cpGs_C "Spezifische Wärmekapazität vom Abgas" VALUE 0x80071468 Val_Ws16 2.000000 SpecificHeat 0.00 2.000000 FORMAT "%8.6" EXTENDED_LIMITS -3.276800 3.276700 /end CHARACTERISTIC
/begin CHARACTERISTIC DewDet_dmPlsThresLSU_CA "" VAL_BLK 0x8007146A Kwb_Ws16 1000.000 AirMassPerTime 0.00 1000.000 FORMAT "%8.3" EXTENDED_LIMITS -3276.800 3276.700 NUMBER 1 /end CHARACTERISTIC
/begin CHARACTERISTIC DewDet_facCldStrtLSU_CA "" VAL_BLK 0x8007146C Kwb_Ws16 1.000000 Fact 0.00 1.000000 FORMAT "%8.6" EXTENDED_LIMITS -4.000000 3.999878 NUMBER 1 /end CHARACTERISTIC
/begin CHARACTERISTIC DewDet_facPlsLSU_CA "" VAL_BLK 0x8007146E Kwb_Ws16 1.000000 Fact 0.00 1.000000 FORMAT "%8.6" EXTENDED_LIMITS -4.000000 3.999878 NUMBER 1 /end CHARACTERISTIC
/begin CHARACTERISTIC DewDet_facPlsThresLSU_CA "" VAL_BLK 0x80071470 Kwb_Ws16 1.000000 Fact 0.00 1.000000 FORMAT "%8.6" EXTENDED_LIMITS -4.000000 3.999878 NUMBER 1 /end CHARACTERISTIC
/begin CHARACTERISTIC DewDet_numEngTempStrt_C "Parameter zum Auswählen einer Motortemperatur aus dem Feld EngDa_tFld" VALUE 0x80071472 Kw_Wu8 2.00000000000 EngTempFldSel 0.00 2.00000000000 FORMAT "%13.11" /end CHARACTERISTIC
/begin CHARACTERISTIC DewDet_numLSU_CA "Parameterfeld zum Auswählen der Abgas- bzw. Wandtemperatur am Sondeneinbauort aus den Feldern ASMod_tEGFld bzw. ASMod_tWallFld" VAL_BLK 0x80071473 Kwb_Wu8 6.000 OneToOne 0.00 6.000 FORMAT "%5.3" EXTENDED_LIMITS 0.00 255.0 NUMBER 1 /end CHARACTERISTIC
/begin CHARACTERISTIC DewDet_numMaxCldStrt_CA "" VAL_BLK 0x80071474 Kwb_Wu8 10.00 OneToOne 0.00 10.00 FORMAT "%5.2" EXTENDED_LIMITS 0.00 255.0 NUMBER 1 /end CHARACTERISTIC
/begin CHARACTERISTIC DewDet_swtDewDetShOff_CA "" VAL_BLK 0x80071475 Kwb_Wu8 1.000 OneToOne 0.00 1.000 FORMAT "%5.3" EXTENDED_LIMITS 0.00 255.0 NUMBER 1 /end CHARACTERISTIC
/begin CHARACTERISTIC DewDet_tiDebLSU_CA "" VAL_BLK 0x80071476 Kwb_Ws16 20.00000 Time_s 0.00 20.00000 FORMAT "%8.5" EXTENDED_LIMITS -327.6800 327.6700 NUMBER 1 /end CHARACTERISTIC
/begin CHARACTERISTIC DewDet_tiDebNrmTransOk_C "Entprellzeit zur Verzögerung der Berechnungen nach Start bis gültige Temperaturen anliegen" VALUE 0x80071478 Kw_Ws16 1000.000 TimeDeb 0.00 1000.000 FORMAT "%8.3" EXTENDED_LIMITS -327680.0 327670.0 /end CHARACTERISTIC
/begin CHARACTERISTIC DewDet_tiHtgDelLSU_CA "" VAL_BLK 0x8007147C Kwb_Ws32 600.000000000 Time_s 0.00 600.000000000 FORMAT "%13.9" EXTENDED_LIMITS -21474836.4800 21474836.4700 NUMBER 1 /end CHARACTERISTIC
/begin CHARACTERISTIC DewDet_tIntegIni_CA "" VAL_BLK 0x80071480 Kwb_Ws16 100.0000 Temp_Cels -0.04000000 99.96000 FORMAT "%8.4" EXTENDED_LIMITS -3549.940 3003.560 NUMBER 1 /end CHARACTERISTIC
/begin CHARACTERISTIC DewDet_tiPlsLSU_CA "" VAL_BLK 0x80071482 Kwb_Ws16 20.00000 Time_s 0.00 20.00000 FORMAT "%8.5" EXTENDED_LIMITS -327.6800 327.6700 NUMBER 1 /end CHARACTERISTIC
/begin CHARACTERISTIC DewDet_tThresLSUAct_CA "" VAL_BLK 0x80071484 Kwb_Ws16 100.0000 Temp_Cels -0.04000000 99.96000 FORMAT "%8.4" EXTENDED_LIMITS -3549.940 3003.560 NUMBER 1 /end CHARACTERISTIC
/begin CHARACTERISTIC DewDet_tWtEquiv_CA "" VAL_BLK 0x80071486 Kwb_Ws16 1095.000 Temp_Cels -45.04000 1049.960 FORMAT "%8.3" EXTENDED_LIMITS -3549.940 3003.560 NUMBER 1 /end CHARACTERISTIC
/begin CHARACTERISTIC DewDet_wLSUIKi_CA "" VAL_BLK 0x80071488 Kwb_Ws16 5.000000 OneToOne 0.00 5.000000 FORMAT "%8.6" EXTENDED_LIMITS -32768.00 32767.00 NUMBER 1 /end CHARACTERISTIC
/begin CHARACTERISTIC DewDet_wThresLSU0_MAP "Wärmeschwellen Grundkennfeld Lambdasonde 0" MAP 0x8007148A Kf_Xs16_Ys16_Ws16 6000.000 Energy 0.00 6000.000 FORMAT "%8.3" EXTENDED_LIMITS -32768.00 32767.00
 /begin AXIS_DESCR STD_AXIS DewDet_tEGLSUInpCrv0_mp Temp_Cels 10 -45.04000 1049.960 FORMAT "%8.3" EXTENDED_LIMITS -3549.940 3003.560 DEPOSIT ABSOLUTE /end AXIS_DESCR
 /begin AXIS_DESCR STD_AXIS DewDet_tEngStrt_mp Temp_Cels 10 -45.04000 1049.960 FORMAT "%8.3" EXTENDED_LIMITS -3549.940 3003.560 DEPOSIT ABSOLUTE /end AXIS_DESCR
/end CHARACTERISTIC
/begin MEASUREMENT DevLib_stMonActrPrt "" UBYTE OneToOne 1 100 0.00 255.0 FORMAT "%5.1" ECU_ADDRESS 0xD0008FCD /end MEASUREMENT
/begin MEASUREMENT DevLib_stPwrStgEnaCond "" UWORD OneToOne 1 100 0.00 65535.00 FORMAT "%8.2" ECU_ADDRESS 0xD0007656 /end MEASUREMENT
/begin MEASUREMENT DewDet_ctCldStrtLSU_mp "Zähler für wiederholte Kaltstarts" UBYTE OneToOne 1 100 0.00 255.0 FORMAT "%5.1" ARRAY_SIZE 1 ECU_ADDRESS 0xC0000682 /end MEASUREMENT
/begin MEASUREMENT DewDet_dwLSU_mp "Abgaswärmestrom an Sondenposition" SWORD Pwr_kW_Sec 1 100 -327.6800 327.6700 FORMAT "%8.4" ARRAY_SIZE 1 ECU_ADDRESS 0xC0000684 /end MEASUREMENT
/begin MEASUREMENT DewDet_stHtgLSU "Statusbit Freigabe Sensor-Heizung" UBYTE OneToOne 1 100 0.00 255.0 FORMAT "%5.1" ARRAY_SIZE 1 ECU_ADDRESS 0xD0008FCE /end MEASUREMENT
/begin MEASUREMENT DewDet_stHtgLSULstTrp_mp "Status der Taupunktfreigabe des letzten Fahrzyklus" UBYTE OneToOne 1 100 0.00 255.0 FORMAT "%5.1" ARRAY_SIZE 1 ECU_ADDRESS 0xC0000686 /end MEASUREMENT
/begin MEASUREMENT DewDet_stHtgThresLSUHit_mp "Statusmessage für Überschreiten des Wärmemengenschwellwertes" UBYTE OneToOne 1 100 0.00 255.0 FORMAT "%5.1" ARRAY_SIZE 1 ECU_ADDRESS 0xC0000687 /end MEASUREMENT
/begin MEASUREMENT DewDet_stIntegIni_mp "Status Integrator Initialisierung" UBYTE OneToOne 1 100 0.00 255.0 FORMAT "%5.1" ARRAY_SIZE 1 ECU_ADDRESS 0xC0000688 /end MEASUREMENT
/begin MEASUREMENT DewDet_stPlsLSU_mp "Status-Bit gültiger Gaspuls" UBYTE OneToOne 1 100 0.00 255.0 FORMAT "%5.1" ARRAY_SIZE 1 ECU_ADDRESS 0xC0000689 /end MEASUREMENT
/begin MEASUREMENT DewDet_tEGLSUInpCrv0_mp "Messpunkt Eingang der Kennlinien" SWORD Temp_Cels 1 100 -3549.940 3003.560 FORMAT "%8.3" ECU_ADDRESS 0xC000068A /end MEASUREMENT
/begin MEASUREMENT DewDet_tEG_mp "Gewählte Abgastemperatur am jeweiligen Sondeneinbauort" SWORD Temp_Cels 1 100 -3549.940 3003.560 FORMAT "%8.3" ARRAY_SIZE 1 ECU_ADDRESS 0xC000068C /end MEASUREMENT
/begin MEASUREMENT DewDet_tEngStrt_mp "Gewählte Motortemperatur" SWORD Temp_Cels 1 100 -3549.940 3003.560 FORMAT "%8.3" ECU_ADDRESS 0xC0000680 /end MEASUREMENT
/begin MEASUREMENT DewDet_tWall_mp "Gewählte Rohrwandtemperatur am jeweiligen Sondeneinbauort" SWORD Temp_Cels 1 100 -3549.940 3003.560 FORMAT "%8.3" ARRAY_SIZE 1 ECU_ADDRESS 0xC000068E /end MEASUREMENT
/begin MEASUREMENT DewDet_wLSU_mp "integrierte Wärmemenge an Sensor-Position." SWORD Energy 1 100 -32768.00 32767.00 FORMAT "%8.2" ARRAY_SIZE 1 ECU_ADDRESS 0xC0000690 /end MEASUREMENT
/begin MEASUREMENT DewDet_wThresLSUAct_mp "aktueller Wärmeschwellwert an Sensorposition." SWORD Energy 1 100 -32768.00 32767.00 FORMAT "%8.2" ARRAY_SIZE 1 ECU_ADDRESS 0xC0000692 /end MEASUREMENT
/begin MEASUREMENT DewDet_wThresLSUNoPls_mp "Hitzeschwelle ohne gültigen Gaspuls." SWORD Energy 1 100 -32768.00 32767.00 FORMAT "%8.2" ARRAY_SIZE 1 ECU_ADDRESS 0xC0000694 /end MEASUREMENT
/begin MEASUREMENT DewDet_wThresLSUPls_mp "Hitzeschwelle für gültigen Gaspuls" SWORD Energy 1 100 -32768.00 32767.00 FORMAT "%8.2" ARRAY_SIZE 1 ECU_ADDRESS 0xC0000696 /end MEASUREMENT
/begin MEASUREMENT DewDet_wThresLSU_mp "Grundlegender Wert-Hitzeschwelle-Sensor" SWORD Energy 1 100 -32768.00 32767.00 FORMAT "%8.2" ARRAY_SIZE 1 ECU_ADDRESS 0xC0000698 /end MEASUREMENT
/begin MEASUREMENT DSM_xTabVersion "" UWORD DFC_OneToOne 1 100 0.00 65535.00 FORMAT "%8.2" ECU_ADDRESS 0xD0005E6A /end MEASUREMENT
/begin FUNCTION Cy100 "" /end FUNCTION
/begin FUNCTION Cy141 "" /end FUNCTION
/begin FUNCTION Cy150 "" /end FUNCTION
/begin FUNCTION Cy320 "" /end FUNCTION
/begin FUNCTION DDRC "" /begin OUT_MEASUREMENT DSM_xTabVersion /end OUT_MEASUREMENT /end FUNCTION
/begin FUNCTION ddrc_auto ""
 /begin DEF_CHARACTERISTIC DDRC_DurDeb.MeUn_tiOLDebOk_C DDRC_DurDeb.MeUn_tiOLDebDef_C DDRC_DurDeb.PCV_tiSRCMinDebOk_C DDRC_DurDeb.PCV_tiSRCMinDebDef_C DDRC_DurDeb.RailP_tiSRCMinDebOk_C DDRC_DurDeb.RailP_tiSRCMinDebDef_C DDRC_DurDeb.MeUn_tiSCBDebOk_C DDRC_DurDeb.MeUn_tiSCBDebDef_C DDRC_DurDeb.MeUn_tiSRCMinDebOk_C DDRC_DurDeb.MeUn_tiSRCMinDebDef_C DDRC_DurDeb.PCV_tiOLDebOk_C DDRC_DurDeb.PCV_tiOLDebDef_C DDRC_DurDeb.MeUn_tiSRCMaxDebOk_C DDRC_DurDeb.MeUn_tiSRCMaxDebDef_C DDRC_DurDeb.PCV_tiSRCMaxDebOk_C DDRC_DurDeb.PCV_tiSRCMaxDebDef_C DDRC_DurDeb.PCV_tiSCBDebOk_C DDRC_DurDeb.PCV_tiSCBDebDef_C DDRC_DurDeb.CtT_tiMinDebOk_C DDRC_DurDeb.CtT_tiMinDebDef_C DDRC_DurDeb.DSMTst_ExampleDebOk_C DDRC_DurDeb.DSMTst_ExampleDebDef_C DDRC_DurDeb.RailP_tiSRCMaxDebOk_C DDRC_DurDeb.RailP_tiSRCMaxDebDef_C DDRC_DurDeb.IVPSply_numVltgSRCMaxDebOk_C DDRC_DurDeb.IVPSply_numVltgSRCMaxDebDef_C DDRC_DurDeb.IVActr_numVltgSRCMaxDebOk_C DDRC_DurDeb.IVActr_numVltgSRCMaxDebDef_C DDRC_DurDeb.IVActr_numVltgSRCMinDebOk_C DDRC_DurDeb.IVActr_numVltgSRCMinDebDef_C DDRC_DurDeb.IVPSply_numDCDCDebOk_C DDRC_DurDeb.IVPSply_numDCDCDebDef_C DDRC_DurDeb.IVPSply_numVltgSRCMinDebOk_C DDRC_DurDeb.IVPSply_numVltgSRCMinDebDef_C DDRC_DurDeb.AirC_tiCmprSCBDebOk_C DDRC_DurDeb.AirC_tiCmprSCBDebDef_C DDRC_DurDeb.VSwVlv_tiOLDebOk_C DDRC_DurDeb.VSwVlv_tiOLDebDef_C DDRC_DurDeb.CEngUsT_tiSRCMinDebOk_C DDRC_DurDeb.CEngUsT_tiSRCMinDebDef_C DDRC_DurDeb.Air_tiDtyCycLoTAFSDebOk_C DDRC_DurDeb.Air_tiDtyCycLoTAFSDebDef_C DDRC_DurDeb.EMDmp_tiSCBDebOk_C DDRC_DurDeb.EMDmp_tiSCBDebDef_C DDRC_DurDeb.ECBVlv_tiSRCMaxDebOk_C DDRC_DurDeb.ECBVlv_tiSRCMaxDebDef_C DDRC_DurDeb.TrbCh_tiOLDebOk_C DDRC_DurDeb.TrbCh_tiOLDebDef_C DDRC_DurDeb.LSU_tiHtrSigDebOk_C DDRC_DurDeb.LSU_tiHtrSigDebDef_C DDRC_DurDeb.EGRVlv_tiSCGDebOk_C DDRC_DurDeb.EGRVlv_tiSCGDebDef_C DDRC_DurDeb.InjVlv_tiPresMinDebOk_C DDRC_DurDeb.InjVlv_tiPresMinDebDef_C DDRC_DurDeb.TECU_tiSRCMinDebOk_C DDRC_DurDeb.TECU_tiSRCMinDebDef_C DDRC_DurDeb.CEngUsT_tiSRCMaxDebOk_C DDRC_DurDeb.CEngUsT_tiSRCMaxDebDef_C DDRC_DurDeb.GbxNPos_tiSigDebOk_C DDRC_DurDeb.GbxNPos_tiSigDebDef_C DDRC_DurDeb.PFlt_tiSotMsMaxDebOk_C DDRC_DurDeb.PFlt_tiSotMsMaxDebDef_C DDRC_DurDeb.TECU_tiSRCMaxDebOk_C DDRC_DurDeb.TECU_tiSRCMaxDebDef_C DDRC_DurDeb.WaHtEl_tiOLDebOk_C DDRC_DurDeb.WaHtEl_tiOLDebDef_C DDRC_DurDeb.Oil_tiNplTDebOk_C DDRC_DurDeb.Oil_tiNplTDebDef_C DDRC_DurDeb.AFS_tiCorSRCMaxDebOk_C DDRC_DurDeb.AFS_tiCorSRCMaxDebDef_C DDRC_DurDeb.Exh_tiSRCMaxPPFltUsDebOk_C DDRC_DurDeb.Exh_tiSRCMaxPPFltUsDebDef_C DDRC_DurDeb.PFltLmp_tiSCGDebOk_C DDRC_DurDeb.PFltLmp_tiSCGDebDef_C DDRC_DurDeb.ThrVlv_tiOLDebOk_C DDRC_DurDeb.ThrVlv_tiOLDebDef_C DDRC_DurDeb.LSU_tiSPISigDebOk_C DDRC_DurDeb.LSU_tiSPISigDebDef_C DDRC_DurDeb.CEngDsT_tiMaxDebOk_C DDRC_DurDeb.CEngDsT_tiMaxDebDef_C DDRC_DurDeb.AirC_tiClntSRCdcycMaxDebOk_C DDRC_DurDeb.AirC_tiClntSRCdcycMaxDebDef_C DDRC_DurDeb.APP_PlaAPP12DebOk_C DDRC_DurDeb.APP_PlaAPP12DebDef_C DDRC_DurDeb.WaHtEl_tiSCBDebOk_C DDRC_DurDeb.WaHtEl_tiSCBDebDef_C DDRC_DurDeb.Strt_tiOLDebOk_C DDRC_DurDeb.Strt_tiOLDebDef_C DDRC_DurDeb.AirC_tiCmprRedTrqOLDebOk_C DDRC_DurDeb.AirC_tiCmprRedTrqOLDebDef_C DDRC_DurDeb.APP_tiSRCLowDebOk_C DDRC_DurDeb.APP_tiSRCLowDebDef_C DDRC_DurDeb.MeUn_tiSCGDebOk_C DDRC_DurDeb.MeUn_tiSCGDebDef_C DDRC_DurDeb.EGRVlv_tiSRCMaxDebOk_C DDRC_DurDeb.EGRVlv_tiSRCMaxDebDef_C DDRC_DurDeb.Fan_tiOLDebOk_C DDRC_DurDeb.Fan_tiOLDebDef_C DDRC_DurDeb.LSU_tiHtrMaxDebOk_C DDRC_DurDeb.LSU_tiHtrMaxDebDef_C DDRC_DurDeb.VSwVlv_tiSRCMinDebOk_C DDRC_DurDeb.VSwVlv_tiSRCMinDebDef_C DDRC_DurDeb.CEngDsT_tiSigDebOk_C DDRC_DurDeb.CEngDsT_tiSigDebDef_C DDRC_DurDeb.AirC_tiCmprOLDebOk_C DDRC_DurDeb.AirC_tiCmprOLDebDef_C DDRC_DurDeb.AirC_tiCmprRedTrqSCGDebOk_C DDRC_DurDeb.AirC_tiCmprRedTrqSCGDebDef_C DDRC_DurDeb.GlwPlg_tiComErrDebOk_C DDRC_DurDeb.GlwPlg_tiComErrDebDef_C DDRC_DurDeb.Air_tiPerHiTAFSDebOk_C DDRC_DurDeb.Air_tiPerHiTAFSDebDef_C DDRC_DurDeb.ErrLmp_tiMILOLDebOk_C DDRC_DurDeb.ErrLmp_tiMILOLDebDef_C DDRC_DurDeb.EngStA_tiSCGDebOk_C DDRC_DurDeb.EngStA_tiSCGDebDef_C DDRC_DurDeb.FlFlt_tiSigDebOk_C DDRC_DurDeb.FlFlt_tiSigDebDef_C DDRC_DurDeb.ThrVlv_tiSCBDebOk_C DDRC_DurDeb.ThrVlv_tiSCBDebDef_C DDRC_DurDeb.FuelT_tiMaxDebOk_C DDRC_DurDeb.FuelT_tiMaxDebDef_C DDRC_DurDeb.BrkP_tiMinDebOk_C DDRC_DurDeb.BrkP_tiMinDebDef_C DDRC_DurDeb.ErrLmp_tiSVSSCBDebOk_C DDRC_DurDeb.ErrLmp_tiSVSSCBDebDef_C DDRC_DurDeb.T15_tiNplDebOk_C DDRC_DurDeb.T15_tiNplDebDef_C DDRC_DurDeb.APP_tiSRCHighDebOk_C DDRC_DurDeb.APP_tiSRCHighDebDef_C DDRC_DurDeb.AirC_tiClntSRCMaxDebOk_C DDRC_DurDeb.AirC_tiClntSRCMaxDebDef_C DDRC_DurDeb.Oil_tiNplPDebOk_C DDRC_DurDeb.Oil_tiNplPDebDef_C DDRC_DurDeb.PFlt_tiDstrMinDebOk_C DDRC_DurDeb.PFlt_tiDstrMinDebDef_C DDRC_DurDeb.AFS_tiOffsDrftMaxDebOk_C DDRC_DurDeb.AFS_tiOffsDrftMaxDebDef_C DDRC_DurDeb.GlwPlg_tiBSDOLDebOk_C DDRC_DurDeb.GlwPlg_tiBSDOLDebDef_C DDRC_DurDeb.PFlt_tiSRCMinFlwRstnDebOk_C DDRC_DurDeb.PFlt_tiSRCMinFlwRstnDebDef_C DDRC_DurDeb.AirC_tiClntSRCPerMaxDebOk_C DDRC_DurDeb.AirC_tiClntSRCPerMaxDebDef_C DDRC_DurDeb.Exh_tiSRCMinPPFltUsDebOk_C DDRC_DurDeb.Exh_tiSRCMinPPFltUsDebDef_C DDRC_DurDeb.EngStA_tiSCBDebOk_C DDRC_DurDeb.EngStA_tiSCBDebDef_C DDRC_DurDeb.OilPLmp_tiSCBDebOk_C DDRC_DurDeb.OilPLmp_tiSCBDebDef_C DDRC_DurDeb.PFlt_tiNplHsChngPPFltDiffDebOk_C DDRC_DurDeb.PFlt_tiNplHsChngPPFltDiffDebDef_C DDRC_DurDeb.AirC_tiSwtNplDebOk_C DDRC_DurDeb.AirC_tiSwtNplDebDef_C DDRC_DurDeb.PFlt_tiSRCMaxFlwRstnDebOk_C DDRC_DurDeb.PFlt_tiSRCMaxFlwRstnDebDef_C DDRC_DurDeb.PFlt_tiRgnPermMaxDebOk_C DDRC_DurDeb.PFlt_tiRgnPermMaxDebDef_C DDRC_DurDeb.Air_PlsPCACDsDebOk_C DDRC_DurDeb.Air_PlsPCACDsDebDef_C DDRC_DurDeb.Strt_tiSCBDebOk_C DDRC_DurDeb.Strt_tiSCBDebDef_C DDRC_DurDeb.PFlt_tiEngPrtMaxDebOk_C DDRC_DurDeb.PFlt_tiEngPrtMaxDebDef_C DDRC_DurDeb.AirC_tiClntSRCMinDebOk_C DDRC_DurDeb.AirC_tiClntSRCMinDebDef_C DDRC_DurDeb.CByVlv_tiSCGDebOk_C DDRC_DurDeb.CByVlv_tiSCGDebDef_C DDRC_DurDeb.AirC_tiClntSRCPerMinDebOk_C DDRC_DurDeb.AirC_tiClntSRCPerMinDebDef_C DDRC_DurDeb.Strt_tiSCGDebOk_C DDRC_DurDeb.Strt_tiSCGDebDef_C DDRC_DurDeb.Clth_tiSigDebOk_C DDRC_DurDeb.Clth_tiSigDebDef_C DDRC_DurDeb.Air_tiSRCMinPCACDsDebOk_C DDRC_DurDeb.Air_tiSRCMinPCACDsDebDef_C DDRC_DurDeb.EngStA_tiOLDebOk_C DDRC_DurDeb.EngStA_tiOLDebDef_C DDRC_DurDeb.GbxNPos_tiSRCPerMinDebOk_C DDRC_DurDeb.GbxNPos_tiSRCPerMinDebDef_C DDRC_DurDeb.LSU_tiCircPmpCurSigDebOk_C DDRC_DurDeb.LSU_tiCircPmpCurSigDebDef_C DDRC_DurDeb.GbxNPos_tiSRCPerMaxDebOk_C DDRC_DurDeb.GbxNPos_tiSRCPerMaxDebDef_C DDRC_DurDeb.OilPLmp_tiOLDebOk_C DDRC_DurDeb.OilPLmp_tiOLDebDef_C DDRC_DurDeb.AFS_tiRawSRCMaxDebOk_C DDRC_DurDeb.AFS_tiRawSRCMaxDebDef_C DDRC_DurDeb.VSwVlv_tiSRCMaxDebOk_C DDRC_DurDeb.VSwVlv_tiSRCMaxDebDef_C DDRC_DurDeb.ErrLmp_tiMILSCGDebOk_C DDRC_DurDeb.ErrLmp_tiMILSCGDebDef_C DDRC_DurDeb.ErrLmp_tiSVSOLDebOk_C DDRC_DurDeb.ErrLmp_tiSVSOLDebDef_C DDRC_DurDeb.VSwVlv_tiSCBDebOk_C DDRC_DurDeb.VSwVlv_tiSCBDebDef_C DDRC_DurDeb.LSU_titExcMaxDebOk_C DDRC_DurDeb.LSU_titExcMaxDebDef_C DDRC_DurDeb.ECBVlv_tiSCBDebOk_C DDRC_DurDeb.ECBVlv_tiSCBDebDef_C DDRC_DurDeb.BattU_tiMaxDebOk_C DDRC_DurDeb.BattU_tiMaxDebDef_C DDRC_DurDeb.BattU_tiMinDebOk_C DDRC_DurDeb.BattU_tiMinDebDef_C DDRC_DurDeb.VSwVlv_tiSCGDebOk_C DDRC_DurDeb.VSwVlv_tiSCGDebDef_C DDRC_DurDeb.ErrLmp_tiMILSCBDebOk_C DDRC_DurDeb.ErrLmp_tiMILSCBDebDef_C DDRC_DurDeb.ECBVlv_tiSCGDebOk_C DDRC_DurDeb.ECBVlv_tiSCGDebDef_C DDRC_DurDeb.PCV_tiSCGDebOk_C DDRC_DurDeb.PCV_tiSCGDebDef_C DDRC_DurDeb.Air_tiMinTCACDsDebOk_C DDRC_DurDeb.Air_tiMinTCACDsDebDef_C DDRC_DurDeb.LSU_tiCircPmpCurMaxDebOk_C DDRC_DurDeb.LSU_tiCircPmpCurMaxDebDef_C DDRC_DurDeb.EGRVlv_tiSCBDebOk_C DDRC_DurDeb.EGRVlv_tiSCBDebDef_C DDRC_DurDeb.Air_tiNplPAirFltDsDebOk_C DDRC_DurDeb.Air_tiNplPAirFltDsDebDef_C DDRC_DurDeb.PSP_tiOLDebOk_C DDRC_DurDeb.PSP_tiOLDebDef_C DDRC_DurDeb.Air_tiDtyCycHiTAFSDebOk_C DDRC_DurDeb.Air_tiDtyCycHiTAFSDebDef_C DDRC_DurDeb.EnvP_tiMaxDebOk_C DDRC_DurDeb.EnvP_tiMaxDebDef_C DDRC_DurDeb.CByVlv_tiOLDebOk_C DDRC_DurDeb.CByVlv_tiOLDebDef_C DDRC_DurDeb.FuelT_tiMinDebOk_C DDRC_DurDeb.FuelT_tiMinDebDef_C DDRC_DurDeb.PFltLmp_tiSCBDebOk_C DDRC_DurDeb.PFltLmp_tiSCBDebDef_C DDRC_DurDeb.Exh_tiSRCMinTOxiCatUsDebOk_C DDRC_DurDeb.Exh_tiSRCMinTOxiCatUsDebDef_C DDRC_DurDeb.VehV_tiHWDebOk_C DDRC_DurDeb.VehV_tiHWDebDef_C DDRC_DurDeb.PSP_tiSCBDebOk_C DDRC_DurDeb.PSP_tiSCBDebDef_C DDRC_DurDeb.CThmst_tiSCBDebOk_C DDRC_DurDeb.CThmst_tiSCBDebDef_C DDRC_DurDeb.AirC_tiClntSRCdcycMinDebOk_C DDRC_DurDeb.AirC_tiClntSRCdcycMinDebDef_C DDRC_DurDeb.Air_tiMaxTCACDsDebOk_C DDRC_DurDeb.Air_tiMaxTCACDsDebDef_C DDRC_DurDeb.TrbChLP_tiSCGDebOk_C DDRC_DurDeb.TrbChLP_tiSCGDebDef_C DDRC_DurDeb.PSP_tiSCGDebOk_C DDRC_DurDeb.PSP_tiSCGDebDef_C DDRC_DurDeb.LSU_tiO2MaxDebOk_C DDRC_DurDeb.LSU_tiO2MaxDebDef_C DDRC_DurDeb.PFlt_tiSotMsDvtMaxDebOk_C DDRC_DurDeb.PFlt_tiSotMsDvtMaxDebDef_C DDRC_DurDeb.VehV_tiMaxDebOk_C DDRC_DurDeb.VehV_tiMaxDebDef_C DDRC_DurDeb.Exh_tiNplTPFltUsDebOk_C DDRC_DurDeb.Exh_tiNplTPFltUsDebDef_C DDRC_DurDeb.Oil_tiMaxTDebOk_C DDRC_DurDeb.Oil_tiMaxTDebDef_C DDRC_DurDeb.ErrLmp_tiSVSSCGDebOk_C DDRC_DurDeb.ErrLmp_tiSVSSCGDebDef_C DDRC_DurDeb.Exh_tiSRCMaxTOxiCatUsDebOk_C DDRC_DurDeb.Exh_tiSRCMaxTOxiCatUsDebDef_C DDRC_DurDeb.VSwVlv_tiGovDvtMaxDebOk_C DDRC_DurDeb.VSwVlv_tiGovDvtMaxDebDef_C DDRC_DurDeb.Brk_tiPlaDebOk_C DDRC_DurDeb.Brk_tiPlaDebDef_C DDRC_DurDeb.AFS_tiSetyDrftMinDebOk_C DDRC_DurDeb.AFS_tiSetyDrftMinDebDef_C DDRC_DurDeb.LSU_tiCircPmpCurMinDebOk_C DDRC_DurDeb.LSU_tiCircPmpCurMinDebDef_C DDRC_DurDeb.VSwVlv_tiGovDvtMinDebOk_C DDRC_DurDeb.VSwVlv_tiGovDvtMinDebDef_C DDRC_DurDeb.CEngDsT_tiMinDebOk_C DDRC_DurDeb.CEngDsT_tiMinDebDef_C DDRC_DurDeb.CThmst_tiOLDebOk_C DDRC_DurDeb.CThmst_tiOLDebDef_C DDRC_DurDeb.GbxNPos_tiSRCdcycMinDebOk_C DDRC_DurDeb.GbxNPos_tiSRCdcycMinDebDef_C DDRC_DurDeb.PFltLmp_tiOLDebOk_C DDRC_DurDeb.PFltLmp_tiOLDebDef_C DDRC_DurDeb.TrbChLP_tiSCBDebOk_C DDRC_DurDeb.TrbChLP_tiSCBDebDef_C DDRC_DurDeb.LSU_tiHtrMinDebOk_C DDRC_DurDeb.LSU_tiHtrMinDebDef_C DDRC_DurDeb.ThrVlv_tiSRCMaxDebOk_C DDRC_DurDeb.ThrVlv_tiSRCMaxDebDef_C DDRC_DurDeb.Fan_tiSCBDebOk_C DDRC_DurDeb.Fan_tiSCBDebDef_C DDRC_DurDeb.Oil_tiMinTDebOk_C DDRC_DurDeb.Oil_tiMinTDebDef_C DDRC_DurDeb.PFlt_tiSotMsDvtMinDebOk_C DDRC_DurDeb.PFlt_tiSotMsDvtMinDebDef_C DDRC_DurDeb.EnvP_tiMinDebOk_C DDRC_DurDeb.EnvP_tiMinDebDef_C DDRC_DurDeb.GlwPlg_tiBSDSCDebOk_C DDRC_DurDeb.GlwPlg_tiBSDSCDebDef_C DDRC_DurDeb.Brk_tiSigDebOk_C DDRC_DurDeb.Brk_tiSigDebDef_C DDRC_DurDeb.CThmst_tiSCGDebOk_C DDRC_DurDeb.CThmst_tiSCGDebDef_C DDRC_DurDeb.GlwPlg_tiBSDOTDebOk_C DDRC_DurDeb.GlwPlg_tiBSDOTDebDef_C DDRC_DurDeb.EnvT_tiMaxDebOk_C DDRC_DurDeb.EnvT_tiMaxDebDef_C DDRC_DurDeb.AFS_tiSetyDrftMaxDebOk_C DDRC_DurDeb.AFS_tiSetyDrftMaxDebDef_C DDRC_DurDeb.LSU_tiCircNernstMinDebOk_C DDRC_DurDeb.LSU_tiCircNernstMinDebDef_C DDRC_DurDeb.EGRVlv_tiGovDvtMaxDebOk_C DDRC_DurDeb.EGRVlv_tiGovDvtMaxDebDef_C DDRC_DurDeb.Exh_tiSRCMaxTPFltUsDebOk_C DDRC_DurDeb.Exh_tiSRCMaxTPFltUsDebDef_C DDRC_DurDeb.VehV_tiPlaDebOk_C DDRC_DurDeb.VehV_tiPlaDebDef_C DDRC_DurDeb.EMDmp_tiSCGDebOk_C DDRC_DurDeb.EMDmp_tiSCGDebDef_C DDRC_DurDeb.ECBVlv_tiOLDebOk_C DDRC_DurDeb.ECBVlv_tiOLDebDef_C DDRC_DurDeb.EnvT_tiMinDebOk_C DDRC_DurDeb.EnvT_tiMinDebDef_C DDRC_DurDeb.VehV_tiSigDebOk_C DDRC_DurDeb.VehV_tiSigDebDef_C DDRC_DurDeb.EGRVlv_tiOLDebOk_C DDRC_DurDeb.EGRVlv_tiOLDebDef_C DDRC_DurDeb.LSU_tiCircVirtGndMaxDebOk_C DDRC_DurDeb.LSU_tiCircVirtGndMaxDebDef_C DDRC_DurDeb.LSU_tiCircVirtGndSigDebOk_C DDRC_DurDeb.LSU_tiCircVirtGndSigDebDef_C DDRC_DurDeb.AFS_tiRawSRCMinDebOk_C DDRC_DurDeb.AFS_tiRawSRCMinDebDef_C DDRC_DurDeb.AFS_tiOffsDrftMinDebOk_C DDRC_DurDeb.AFS_tiOffsDrftMinDebDef_C DDRC_DurDeb.LSU_tiO2MinDebOk_C DDRC_DurDeb.LSU_tiO2MinDebDef_C DDRC_DurDeb.LSU_tiCircNernstMaxDebOk_C DDRC_DurDeb.LSU_tiCircNernstMaxDebDef_C DDRC_DurDeb.ThrVlv_tiSRCMinDebOk_C DDRC_DurDeb.ThrVlv_tiSRCMinDebDef_C DDRC_DurDeb.EGRVlv_tiSRCMinDebOk_C DDRC_DurDeb.EGRVlv_tiSRCMinDebDef_C DDRC_DurDeb.ECBVlv_tiSRCMinDebOk_C DDRC_DurDeb.ECBVlv_tiSRCMinDebDef_C DDRC_DurDeb.PFlt_tiCharPDiffMinDebOk_C DDRC_DurDeb.PFlt_tiCharPDiffMinDebDef_C DDRC_DurDeb.Air_tiPerLoTAFSDebOk_C DDRC_DurDeb.Air_tiPerLoTAFSDebDef_C DDRC_DurDeb.AirC_tiCmprRedTrqSCBDebOk_C DDRC_DurDeb.AirC_tiCmprRedTrqSCBDebDef_C DDRC_DurDeb.TrbChLP_tiOLDebOk_C DDRC_DurDeb.TrbChLP_tiOLDebDef_C DDRC_DurDeb.BrkP_tiMaxDebOk_C DDRC_DurDeb.BrkP_tiMaxDebDef_C DDRC_DurDeb.AFS_tiCorSRCMinDebOk_C DDRC_DurDeb.AFS_tiCorSRCMinDebDef_C DDRC_DurDeb.EMDmp_tiOLDebOk_C DDRC_DurDeb.EMDmp_tiOLDebDef_C DDRC_DurDeb.Oil_tiComErrDebOk_C DDRC_DurDeb.Oil_tiComErrDebDef_C DDRC_DurDeb.AirC_tiSwtSigDebOk_C DDRC_DurDeb.AirC_tiSwtSigDebDef_C DDRC_DurDeb.Air_tiSRCMaxPCACDsDebOk_C DDRC_DurDeb.Air_tiSRCMaxPCACDsDebDef_C DDRC_DurDeb.Air_tiMinPAirFltDsDebOk_C DDRC_DurDeb.Air_tiMinPAirFltDsDebDef_C DDRC_DurDeb.LSU_tiCircNernstSigDebOk_C DDRC_DurDeb.LSU_tiCircNernstSigDebDef_C DDRC_DurDeb.Exh_tiSRCMinTPFltUsDebOk_C DDRC_DurDeb.Exh_tiSRCMinTPFltUsDebDef_C DDRC_DurDeb.GbxNPos_tiSRCdcycMaxDebOk_C DDRC_DurDeb.GbxNPos_tiSRCdcycMaxDebDef_C DDRC_DurDeb.EnvP_tiSigDebOk_C DDRC_DurDeb.EnvP_tiSigDebDef_C DDRC_DurDeb.EGRVlv_tiGovDvtMinDebOk_C DDRC_DurDeb.EGRVlv_tiGovDvtMinDebDef_C DDRC_DurDeb.CByVlv_tiSCBDebOk_C DDRC_DurDeb.CByVlv_tiSCBDebDef_C DDRC_DurDeb.LSU_tiCircVirtGndMinDebOk_C DDRC_DurDeb.LSU_tiCircVirtGndMinDebDef_C DDRC_DurDeb.LSU_titExcMinDebOk_C DDRC_DurDeb.LSU_titExcMinDebDef_C DDRC_DurDeb.LSU_tiSPIBattLowMinDebOk_C DDRC_DurDeb.LSU_tiSPIBattLowMinDebDef_C DDRC_DurDeb.Air_tiMaxPAirFltDsDebOk_C DDRC_DurDeb.Air_tiMaxPAirFltDsDebDef_C DDRC_DurDeb.OilPLmp_tiSCGDebOk_C DDRC_DurDeb.OilPLmp_tiSCGDebDef_C DDRC_DurDeb.AirC_tiCmprSCGDebOk_C DDRC_DurDeb.AirC_tiCmprSCGDebDef_C DDRC_DurDeb.TrbCh_tiSCBDebOk_C DDRC_DurDeb.TrbCh_tiSCBDebDef_C DDRC_DurDeb.IVDia_numChpSPICfgDebOk_C DDRC_DurDeb.IVDia_numChpSPICfgDebDef_C DDRC_DurDeb.IVDia_numBnkHSBattDebOk_C DDRC_DurDeb.IVDia_numBnkHSBattDebDef_C DDRC_DurDeb.LSU_numO2PlausMaxDebOk_C DDRC_DurDeb.LSU_numO2PlausMaxDebDef_C DDRC_DurDeb.LSU_numO2ClbMaxDebOk_C DDRC_DurDeb.LSU_numO2ClbMaxDebDef_C DDRC_DurDeb.IVDia_numCylNoLdDebOk_C DDRC_DurDeb.IVDia_numCylNoLdDebDef_C DDRC_DurDeb.IVDia_numChpSPIRamDebOk_C DDRC_DurDeb.IVDia_numChpSPIRamDebDef_C DDRC_DurDeb.LSU_numRiClbMinDebOk_C DDRC_DurDeb.LSU_numRiClbMinDebDef_C DDRC_DurDeb.LSU_numO2PlausMinDebOk_C DDRC_DurDeb.LSU_numO2PlausMinDebDef_C DDRC_DurDeb.IVDia_numBnkTransferDebOk_C DDRC_DurDeb.IVDia_numBnkTransferDebDef_C DDRC_DurDeb.IVDia_numChpSPICollDebOk_C DDRC_DurDeb.IVDia_numChpSPICollDebDef_C DDRC_DurDeb.IVDia_numCylShCirLSBattDebOk_C DDRC_DurDeb.IVDia_numCylShCirLSBattDebDef_C DDRC_DurDeb.IVDia_numChpSPITransDebOk_C DDRC_DurDeb.IVDia_numChpSPITransDebDef_C DDRC_DurDeb.IVDia_numBnkShCirHiRstncDebOk_C DDRC_DurDeb.IVDia_numBnkShCirHiRstncDebDef_C DDRC_DurDeb.IVDia_numCylShCirLSLSDebOk_C DDRC_DurDeb.IVDia_numCylShCirLSLSDebDef_C DDRC_DurDeb.IVDia_numCylShCirHiRstncDebOk_C DDRC_DurDeb.IVDia_numCylShCirHiRstncDebDef_C DDRC_DurDeb.ETClb_numETMaxDebOk_C DDRC_DurDeb.ETClb_numETMaxDebDef_C DDRC_DurDeb.IVDia_numBnkBSHDebOk_C DDRC_DurDeb.IVDia_numBnkBSHDebDef_C DDRC_DurDeb.IVDia_numBnkShCirLSHSGndDebOk_C DDRC_DurDeb.IVDia_numBnkShCirLSHSGndDebDef_C DDRC_DurDeb.LSU_numRiClbMaxDebOk_C DDRC_DurDeb.LSU_numRiClbMaxDebDef_C DDRC_DurDeb.IVDia_numChpSPICtrlDebOk_C DDRC_DurDeb.IVDia_numChpSPICtrlDebDef_C DDRC_DurDeb.ETClb_numETMinDebOk_C DDRC_DurDeb.ETClb_numETMinDebDef_C DDRC_DurDeb.Clth_numPlaDebOk_C DDRC_DurDeb.Clth_numPlaDebDef_C DDRC_DurDeb.LSU_numDynChkMinDebOk_C DDRC_DurDeb.LSU_numDynChkMinDebDef_C DDRC_DurDeb.LSU_numO2ClbMinDebOk_C DDRC_DurDeb.LSU_numO2ClbMinDebDef_C DDRC_DurDeb.IVDia_numCylNoClsDebOk_C DDRC_DurDeb.IVDia_numCylNoClsDebDef_C DDRC_DurDeb.LSU_numWireIPSigDebOk_C DDRC_DurDeb.LSU_numWireIPSigDebDef_C DDRC_DurDeb.LSU_numCmpChkMinDebOk_C DDRC_DurDeb.LSU_numCmpChkMinDebDef_C DDRC_DurDeb.IVDia_numBnkShCirChSwtDebOk_C DDRC_DurDeb.IVDia_numBnkShCirChSwtDebDef_C DDRC_DurDeb.IVDia_numCylShCirLSHSDebOk_C DDRC_DurDeb.IVDia_numCylShCirLSHSDebDef_C DDRC_DurDeb.Com_tiPspToDebOk_C DDRC_DurDeb.Com_tiPspToDebDef_C DDRC_DurDeb.Com_tiTrqDemandGbxChkDebOk_C DDRC_DurDeb.Com_tiTrqDemandGbxChkDebDef_C DDRC_DurDeb.Sia_tiE5DebOk_C DDRC_DurDeb.Sia_tiE5DebDef_C DDRC_DurDeb.Com_tiTrqDemandAfsCtrDebOk_C DDRC_DurDeb.Com_tiTrqDemandAfsCtrDebDef_C DDRC_DurDeb.Sia_tiE11DebOk_C DDRC_DurDeb.Sia_tiE11DebDef_C DDRC_DurDeb.PCR_tiGovDvtMaxDebOk_C DDRC_DurDeb.PCR_tiGovDvtMaxDebDef_C DDRC_DurDeb.PCR_tiGovDvtLPMinDebOk_C DDRC_DurDeb.PCR_tiGovDvtLPMinDebDef_C DDRC_DurDeb.Rail_tiMeUn2DebOk_C DDRC_DurDeb.Rail_tiMeUn2DebDef_C DDRC_DurDeb.AirCtl_tiGovDvtMinDebOk_C DDRC_DurDeb.AirCtl_tiGovDvtMinDebDef_C DDRC_DurDeb.WaHtEl_ti4WinErr3DebOk_C DDRC_DurDeb.WaHtEl_ti4WinErr3DebDef_C DDRC_DurDeb.ETCtl_tiDvtOutrMinDebOk_C DDRC_DurDeb.ETCtl_tiDvtOutrMinDebDef_C DDRC_DurDeb.Fan_ti4WinErr2DebOk_C DDRC_DurDeb.Fan_ti4WinErr2DebDef_C DDRC_DurDeb.Com_tiTrqDemandAfsSigDebOk_C DDRC_DurDeb.Com_tiTrqDemandAfsSigDebDef_C DDRC_DurDeb.Fan_ti4WinErr1DebOk_C DDRC_DurDeb.Fan_ti4WinErr1DebDef_C DDRC_DurDeb.TrbCh_ti4WinErr1DebOk_C DDRC_DurDeb.TrbCh_ti4WinErr1DebDef_C DDRC_DurDeb.Sia_tiE3DebOk_C DDRC_DurDeb.Sia_tiE3DebDef_C DDRC_DurDeb.Com_tiTrailerSigDebOk_C DDRC_DurDeb.Com_tiTrailerSigDebDef_C DDRC_DurDeb.Com_tiPspSigDebOk_C DDRC_DurDeb.Com_tiPspSigDebDef_C DDRC_DurDeb.Com_tiTimeDateSigDebOk_C DDRC_DurDeb.Com_tiTimeDateSigDebDef_C DDRC_DurDeb.Com_tiShutOffPSPSigDebOk_C DDRC_DurDeb.Com_tiShutOffPSPSigDebDef_C DDRC_DurDeb.Com_tiMileageRangeToDebOk_C DDRC_DurDeb.Com_tiMileageRangeToDebDef_C DDRC_DurDeb.Com_tiStateARSSigDebOk_C DDRC_DurDeb.Com_tiStateARSSigDebDef_C DDRC_DurDeb.Com_tiTerminalCtrDebOk_C DDRC_DurDeb.Com_tiTerminalCtrDebDef_C DDRC_DurDeb.TrbCh_tiSCGDebOk_C DDRC_DurDeb.TrbCh_tiSCGDebDef_C DDRC_DurDeb.Com_tiTerminalSigDebOk_C DDRC_DurDeb.Com_tiTerminalSigDebDef_C DDRC_DurDeb.Com_tiTrqDemandGbxCtrDebOk_C DDRC_DurDeb.Com_tiTrqDemandGbxCtrDebDef_C DDRC_DurDeb.Rail_tiPMonStrtDebOk_C DDRC_DurDeb.Rail_tiPMonStrtDebDef_C DDRC_DurDeb.Com_tiStateARSToDebOk_C DDRC_DurDeb.Com_tiStateARSToDebDef_C DDRC_DurDeb.Com_tiMileageRangeSigDebOk_C DDRC_DurDeb.Com_tiMileageRangeSigDebDef_C DDRC_DurDeb.ThrVlv_ti4WinErr3DebOk_C DDRC_DurDeb.ThrVlv_ti4WinErr3DebDef_C DDRC_DurDeb.Com_tiStateDscToDebOk_C DDRC_DurDeb.Com_tiStateDscToDebDef_C DDRC_DurDeb.Com_tiTerminalToDebOk_C DDRC_DurDeb.Com_tiTerminalToDebDef_C DDRC_DurDeb.Rail_tiPCV1DebOk_C DDRC_DurDeb.Rail_tiPCV1DebDef_C DDRC_DurDeb.Sia_tiE10DebOk_C DDRC_DurDeb.Sia_tiE10DebDef_C DDRC_DurDeb.Com_tiStateSeatSigDebOk_C DDRC_DurDeb.Com_tiStateSeatSigDebDef_C DDRC_DurDeb.Com_tiStateARSCtrDebOk_C DDRC_DurDeb.Com_tiStateARSCtrDebDef_C DDRC_DurDeb.Com_tiTrqDemandDscSigDebOk_C DDRC_DurDeb.Com_tiTrqDemandDscSigDebDef_C DDRC_DurDeb.Com_tiLenkradwinkelSigDebOk_C DDRC_DurDeb.Com_tiLenkradwinkelSigDebDef_C DDRC_DurDeb.Com_tiWheelSpeedSigDebOk_C DDRC_DurDeb.Com_tiWheelSpeedSigDebDef_C DDRC_DurDeb.WaHtEl_ti4WinErr2DebOk_C DDRC_DurDeb.WaHtEl_ti4WinErr2DebDef_C DDRC_DurDeb.Rail_tiMeUn1DebOk_C DDRC_DurDeb.Rail_tiMeUn1DebDef_C DDRC_DurDeb.Sia_tiE4DebOk_C DDRC_DurDeb.Sia_tiE4DebDef_C DDRC_DurDeb.Fan_ti4WinErr3DebOk_C DDRC_DurDeb.Fan_ti4WinErr3DebDef_C DDRC_DurDeb.Com_tiShutOffPSPToDebOk_C DDRC_DurDeb.Com_tiShutOffPSPToDebDef_C DDRC_DurDeb.CJ945_tiSpiCommErrorDebOk_C DDRC_DurDeb.CJ945_tiSpiCommErrorDebDef_C DDRC_DurDeb.TrbCh_ti4WinErr2DebOk_C DDRC_DurDeb.TrbCh_ti4WinErr2DebDef_C DDRC_DurDeb.Rail_tiPCV3DebOk_C DDRC_DurDeb.Rail_tiPCV3DebDef_C DDRC_DurDeb.Com_tiTrqDemandDscChkDebOk_C DDRC_DurDeb.Com_tiTrqDemandDscChkDebDef_C DDRC_DurDeb.WaHtEl_tiSCGDebOk_C DDRC_DurDeb.WaHtEl_tiSCGDebDef_C DDRC_DurDeb.ETCtl_tiDvtInrMinDebOk_C DDRC_DurDeb.ETCtl_tiDvtInrMinDebDef_C DDRC_DurDeb.Rail_tiPCV2DebOk_C DDRC_DurDeb.Rail_tiPCV2DebDef_C DDRC_DurDeb.Rail_tiCPC3DebOk_C DDRC_DurDeb.Rail_tiCPC3DebDef_C DDRC_DurDeb.SSpMon1DebOk_C DDRC_DurDeb.SSpMon1DebDef_C DDRC_DurDeb.Com_tiTrailerToDebOk_C DDRC_DurDeb.Com_tiTrailerToDebDef_C DDRC_DurDeb.Com_tiStKombiCtrDebOk_C DDRC_DurDeb.Com_tiStKombiCtrDebDef_C DDRC_DurDeb.Com_tiZvKlappenSigDebOk_C DDRC_DurDeb.Com_tiZvKlappenSigDebDef_C DDRC_DurDeb.Com_tiHeatACSigDebOk_C DDRC_DurDeb.Com_tiHeatACSigDebDef_C DDRC_DurDeb.Fan_tiSCGDebOk_C DDRC_DurDeb.Fan_tiSCGDebDef_C DDRC_DurDeb.Com_tiTempRelTimeSigDebOk_C DDRC_DurDeb.Com_tiTempRelTimeSigDebDef_C DDRC_DurDeb.Com_tiTempRelTimeToDebOk_C DDRC_DurDeb.Com_tiTempRelTimeToDebDef_C DDRC_DurDeb.Com_tiStKombiToDebOk_C DDRC_DurDeb.Com_tiStKombiToDebDef_C DDRC_DurDeb.TrbCh_ti4WinErr3DebOk_C DDRC_DurDeb.TrbCh_ti4WinErr3DebDef_C DDRC_DurDeb.Com_tiStKombiSigDebOk_C DDRC_DurDeb.Com_tiStKombiSigDebDef_C DDRC_DurDeb.PCR_tiGovDvtMinDebOk_C DDRC_DurDeb.PCR_tiGovDvtMinDebDef_C DDRC_DurDeb.Com_tiLenkradwinkelToDebOk_C DDRC_DurDeb.Com_tiLenkradwinkelToDebDef_C DDRC_DurDeb.ThrVlv_ti4WinErr2DebOk_C DDRC_DurDeb.ThrVlv_ti4WinErr2DebDef_C DDRC_DurDeb.Com_tiGearboxDataSigDebOk_C DDRC_DurDeb.Com_tiGearboxDataSigDebDef_C DDRC_DurDeb.CY150_tiSpiCommErrorDebOk_C DDRC_DurDeb.CY150_tiSpiCommErrorDebDef_C DDRC_DurDeb.ETCtl_tiDvtInrMaxDebOk_C DDRC_DurDeb.ETCtl_tiDvtInrMaxDebDef_C DDRC_DurDeb.Com_tiStateSeatToDebOk_C DDRC_DurDeb.Com_tiStateSeatToDebDef_C DDRC_DurDeb.Sia_tiE7DebOk_C DDRC_DurDeb.Sia_tiE7DebDef_C DDRC_DurDeb.Com_tiGearboxData2ToDebOk_C DDRC_DurDeb.Com_tiGearboxData2ToDebDef_C DDRC_DurDeb.Sia_tiE1DebOk_C DDRC_DurDeb.Sia_tiE1DebDef_C DDRC_DurDeb.Rail_tiMeUn4DebOk_C DDRC_DurDeb.Rail_tiMeUn4DebDef_C DDRC_DurDeb.Com_tiButtonMSAToDebOk_C DDRC_DurDeb.Com_tiButtonMSAToDebDef_C DDRC_DurDeb.Sia_tiE14DebOk_C DDRC_DurDeb.Sia_tiE14DebDef_C DDRC_DurDeb.AirCtl_tiGovDvtEOMMaxDebOk_C DDRC_DurDeb.AirCtl_tiGovDvtEOMMaxDebDef_C DDRC_DurDeb.Com_tiTrqDemandDscCtrDebOk_C DDRC_DurDeb.Com_tiTrqDemandDscCtrDebDef_C DDRC_DurDeb.Com_tiTrqDemandDscToDebOk_C DDRC_DurDeb.Com_tiTrqDemandDscToDebDef_C DDRC_DurDeb.PCR_tiGovDvtLPMaxDebOk_C DDRC_DurDeb.PCR_tiGovDvtLPMaxDebDef_C DDRC_DurDeb.Sia_tiE9DebOk_C DDRC_DurDeb.Sia_tiE9DebDef_C DDRC_DurDeb.TrbCh_tiSRCMaxDebOk_C DDRC_DurDeb.TrbCh_tiSRCMaxDebDef_C DDRC_DurDeb.Fan_ti4WinErr4DebOk_C DDRC_DurDeb.Fan_ti4WinErr4DebDef_C DDRC_DurDeb.Com_tiTrqDemandGbxSigDebOk_C DDRC_DurDeb.Com_tiTrqDemandGbxSigDebDef_C DDRC_DurDeb.Rail_tiMeUn0DebOk_C DDRC_DurDeb.Rail_tiMeUn0DebDef_C DDRC_DurDeb.Com_tiWheelSpeedToDebOk_C DDRC_DurDeb.Com_tiWheelSpeedToDebDef_C DDRC_DurDeb.Com_tiTrqDemandAfsToDebOk_C DDRC_DurDeb.Com_tiTrqDemandAfsToDebDef_C DDRC_DurDeb.AirCtl_tiGovDvtEOMMinDebOk_C DDRC_DurDeb.AirCtl_tiGovDvtEOMMinDebDef_C DDRC_DurDeb.Com_tiZvKlappenToDebOk_C DDRC_DurDeb.Com_tiZvKlappenToDebDef_C DDRC_DurDeb.Sia_tiE13DebOk_C DDRC_DurDeb.Sia_tiE13DebDef_C DDRC_DurDeb.Sia_tiE6DebOk_C DDRC_DurDeb.Sia_tiE6DebDef_C DDRC_DurDeb.ETCtl_tiDvtOutrMaxDebOk_C DDRC_DurDeb.ETCtl_tiDvtOutrMaxDebDef_C DDRC_DurDeb.SSpMon2DebOk_C DDRC_DurDeb.SSpMon2DebDef_C DDRC_DurDeb.WaHtEl_ti4WinErr1DebOk_C DDRC_DurDeb.WaHtEl_ti4WinErr1DebDef_C DDRC_DurDeb.Sia_tiE2DebOk_C DDRC_DurDeb.Sia_tiE2DebDef_C DDRC_DurDeb.Sia_tiE8DebOk_C DDRC_DurDeb.Sia_tiE8DebDef_C DDRC_DurDeb.Rail_tiMeUn3DebOk_C DDRC_DurDeb.Rail_tiMeUn3DebDef_C DDRC_DurDeb.Rail_tiPCV4DebOk_C DDRC_DurDeb.Rail_tiPCV4DebDef_C DDRC_DurDeb.Com_tiButtonMSASigDebOk_C DDRC_DurDeb.Com_tiButtonMSASigDebDef_C DDRC_DurDeb.ThrVlv_ti4WinErr1DebOk_C DDRC_DurDeb.ThrVlv_ti4WinErr1DebDef_C DDRC_DurDeb.SSpMon3DebOk_C DDRC_DurDeb.SSpMon3DebDef_C DDRC_DurDeb.Com_tiTrqDemandGbxToDebOk_C DDRC_DurDeb.Com_tiTrqDemandGbxToDebDef_C DDRC_DurDeb.WaHtEl_ti4WinErr4DebOk_C DDRC_DurDeb.WaHtEl_ti4WinErr4DebDef_C DDRC_DurDeb.TrbCh_ti4WinErr4DebOk_C DDRC_DurDeb.TrbCh_ti4WinErr4DebDef_C DDRC_DurDeb.TrbCh_tiSRCMinDebOk_C DDRC_DurDeb.TrbCh_tiSRCMinDebDef_C DDRC_DurDeb.Sia_tiE15DebOk_C DDRC_DurDeb.Sia_tiE15DebDef_C DDRC_DurDeb.CY320_tiSpiCommErrorDebOk_C DDRC_DurDeb.CY320_tiSpiCommErrorDebDef_C DDRC_DurDeb.Com_tiVelocityToDebOk_C DDRC_DurDeb.Com_tiVelocityToDebDef_C DDRC_DurDeb.Com_tiGearboxData2SigDebOk_C DDRC_DurDeb.Com_tiGearboxData2SigDebDef_C DDRC_DurDeb.Com_tiStateDscSigDebOk_C DDRC_DurDeb.Com_tiStateDscSigDebDef_C DDRC_DurDeb.Rail_tiCPC4DebOk_C DDRC_DurDeb.Rail_tiCPC4DebDef_C DDRC_DurDeb.Com_tiHeatACToDebOk_C DDRC_DurDeb.Com_tiHeatACToDebDef_C DDRC_DurDeb.AirCtl_tiGovDvtMaxDebOk_C DDRC_DurDeb.AirCtl_tiGovDvtMaxDebDef_C DDRC_DurDeb.Rail_tiPCV0DebOk_C DDRC_DurDeb.Rail_tiPCV0DebDef_C DDRC_DurDeb.ThrVlv_ti4WinErr4DebOk_C DDRC_DurDeb.ThrVlv_ti4WinErr4DebDef_C DDRC_DurDeb.Com_tiGearboxDataToDebOk_C DDRC_DurDeb.Com_tiGearboxDataToDebDef_C DDRC_DurDeb.Com_tiTrqDemandAfsChkDebOk_C DDRC_DurDeb.Com_tiTrqDemandAfsChkDebDef_C DDRC_DurDeb.Com_tiVelocitySigDebOk_C DDRC_DurDeb.Com_tiVelocitySigDebDef_C DDRC_DurDeb.ThrVlv_tiSCGDebOk_C DDRC_DurDeb.ThrVlv_tiSCGDebDef_C DDRC_DurDeb.Com_tiTerminalChkDebOk_C DDRC_DurDeb.Com_tiTerminalChkDebDef_C DDRC_DurDeb.Rail_tiCPC1DebOk_C DDRC_DurDeb.Rail_tiCPC1DebDef_C DDRC_DurDeb.Sia_tiE12DebOk_C DDRC_DurDeb.Sia_tiE12DebDef_C DDRC_DurDeb.Com_tiTimeDateToDebOk_C DDRC_DurDeb.Com_tiTimeDateToDebDef_C DDRC_DurDeb.ETClb_numETFltMinDebOk_C DDRC_DurDeb.ETClb_numETFltMinDebDef_C DDRC_DurDeb.ETClb_numETFltMaxDebOk_C DDRC_DurDeb.ETClb_numETFltMaxDebDef_C DDRC_DurDeb.InjCrv_numInjLimDebOk_C DDRC_DurDeb.InjCrv_numInjLimDebDef_C DDRC_DurDeb.LSU_numHtCoupSigDebOk_C DDRC_DurDeb.LSU_numHtCoupSigDebDef_C DDRC_RatDeb.MeUn_tiOLUDRat_C DDRC_RatDeb.PCV_tiSRCMinUDRat_C DDRC_RatDeb.RailP_tiSRCMinUDRat_C DDRC_RatDeb.MeUn_tiSCBUDRat_C DDRC_RatDeb.MeUn_tiSRCMinUDRat_C DDRC_RatDeb.PCV_tiOLUDRat_C DDRC_RatDeb.MeUn_tiSRCMaxUDRat_C DDRC_RatDeb.PCV_tiSRCMaxUDRat_C DDRC_RatDeb.PCV_tiSCBUDRat_C DDRC_RatDeb.CtT_tiMinUDRat_C DDRC_RatDeb.DSMTst_ExampleUDRat_C DDRC_RatDeb.RailP_tiSRCMaxUDRat_C DDRC_RatDeb.IVPSply_numVltgSRCMaxUDRat_C DDRC_RatDeb.IVActr_numVltgSRCMaxUDRat_C DDRC_RatDeb.IVActr_numVltgSRCMinUDRat_C DDRC_RatDeb.IVPSply_numDCDCUDRat_C DDRC_RatDeb.IVPSply_numVltgSRCMinUDRat_C DDRC_RatDeb.AirC_tiCmprSCBUDRat_C DDRC_RatDeb.VSwVlv_tiOLUDRat_C DDRC_RatDeb.CEngUsT_tiSRCMinUDRat_C DDRC_RatDeb.Air_tiDtyCycLoTAFSUDRat_C DDRC_RatDeb.EMDmp_tiSCBUDRat_C DDRC_RatDeb.ECBVlv_tiSRCMaxUDRat_C DDRC_RatDeb.TrbCh_tiOLUDRat_C DDRC_RatDeb.LSU_tiHtrSigUDRat_C DDRC_RatDeb.EGRVlv_tiSCGUDRat_C DDRC_RatDeb.InjVlv_tiPresMinUDRat_C DDRC_RatDeb.TECU_tiSRCMinUDRat_C DDRC_RatDeb.CEngUsT_tiSRCMaxUDRat_C DDRC_RatDeb.GbxNPos_tiSigUDRat_C DDRC_RatDeb.PFlt_tiSotMsMaxUDRat_C DDRC_RatDeb.TECU_tiSRCMaxUDRat_C DDRC_RatDeb.WaHtEl_tiOLUDRat_C DDRC_RatDeb.Oil_tiNplTUDRat_C DDRC_RatDeb.AFS_tiCorSRCMaxUDRat_C DDRC_RatDeb.Exh_tiSRCMaxPPFltUsUDRat_C DDRC_RatDeb.PFltLmp_tiSCGUDRat_C DDRC_RatDeb.ThrVlv_tiOLUDRat_C DDRC_RatDeb.LSU_tiSPISigUDRat_C DDRC_RatDeb.CEngDsT_tiMaxUDRat_C DDRC_RatDeb.AirC_tiClntSRCdcycMaxUDRat_C DDRC_RatDeb.APP_PlaAPP12UDRat_C DDRC_RatDeb.WaHtEl_tiSCBUDRat_C DDRC_RatDeb.Strt_tiOLUDRat_C DDRC_RatDeb.AirC_tiCmprRedTrqOLUDRat_C DDRC_RatDeb.APP_tiSRCLowUDRat_C DDRC_RatDeb.MeUn_tiSCGUDRat_C DDRC_RatDeb.EGRVlv_tiSRCMaxUDRat_C DDRC_RatDeb.Fan_tiOLUDRat_C DDRC_RatDeb.LSU_tiHtrMaxUDRat_C DDRC_RatDeb.VSwVlv_tiSRCMinUDRat_C DDRC_RatDeb.CEngDsT_tiSigUDRat_C DDRC_RatDeb.AirC_tiCmprOLUDRat_C DDRC_RatDeb.AirC_tiCmprRedTrqSCGUDRat_C DDRC_RatDeb.GlwPlg_tiComErrUDRat_C DDRC_RatDeb.Air_tiPerHiTAFSUDRat_C DDRC_RatDeb.ErrLmp_tiMILOLUDRat_C DDRC_RatDeb.EngStA_tiSCGUDRat_C DDRC_RatDeb.FlFlt_tiSigUDRat_C DDRC_RatDeb.ThrVlv_tiSCBUDRat_C DDRC_RatDeb.FuelT_tiMaxUDRat_C DDRC_RatDeb.BrkP_tiMinUDRat_C DDRC_RatDeb.ErrLmp_tiSVSSCBUDRat_C DDRC_RatDeb.T15_tiNplUDRat_C DDRC_RatDeb.APP_tiSRCHighUDRat_C DDRC_RatDeb.AirC_tiClntSRCMaxUDRat_C DDRC_RatDeb.Oil_tiNplPUDRat_C DDRC_RatDeb.PFlt_tiDstrMinUDRat_C DDRC_RatDeb.AFS_tiOffsDrftMaxUDRat_C DDRC_RatDeb.GlwPlg_tiBSDOLUDRat_C DDRC_RatDeb.PFlt_tiSRCMinFlwRstnUDRat_C DDRC_RatDeb.AirC_tiClntSRCPerMaxUDRat_C DDRC_RatDeb.Exh_tiSRCMinPPFltUsUDRat_C DDRC_RatDeb.EngStA_tiSCBUDRat_C DDRC_RatDeb.OilPLmp_tiSCBUDRat_C DDRC_RatDeb.PFlt_tiNplHsChngPPFltDiffUDRat_C DDRC_RatDeb.AirC_tiSwtNplUDRat_C DDRC_RatDeb.PFlt_tiSRCMaxFlwRstnUDRat_C DDRC_RatDeb.PFlt_tiRgnPermMaxUDRat_C DDRC_RatDeb.Air_PlsPCACDsUDRat_C DDRC_RatDeb.Strt_tiSCBUDRat_C DDRC_RatDeb.PFlt_tiEngPrtMaxUDRat_C DDRC_RatDeb.AirC_tiClntSRCMinUDRat_C DDRC_RatDeb.CByVlv_tiSCGUDRat_C DDRC_RatDeb.AirC_tiClntSRCPerMinUDRat_C DDRC_RatDeb.Strt_tiSCGUDRat_C DDRC_RatDeb.Clth_tiSigUDRat_C DDRC_RatDeb.Air_tiSRCMinPCACDsUDRat_C DDRC_RatDeb.EngStA_tiOLUDRat_C DDRC_RatDeb.GbxNPos_tiSRCPerMinUDRat_C DDRC_RatDeb.LSU_tiCircPmpCurSigUDRat_C DDRC_RatDeb.GbxNPos_tiSRCPerMaxUDRat_C DDRC_RatDeb.OilPLmp_tiOLUDRat_C DDRC_RatDeb.AFS_tiRawSRCMaxUDRat_C DDRC_RatDeb.VSwVlv_tiSRCMaxUDRat_C DDRC_RatDeb.ErrLmp_tiMILSCGUDRat_C DDRC_RatDeb.ErrLmp_tiSVSOLUDRat_C DDRC_RatDeb.VSwVlv_tiSCBUDRat_C DDRC_RatDeb.LSU_titExcMaxUDRat_C DDRC_RatDeb.ECBVlv_tiSCBUDRat_C DDRC_RatDeb.BattU_tiMaxUDRat_C DDRC_RatDeb.BattU_tiMinUDRat_C DDRC_RatDeb.VSwVlv_tiSCGUDRat_C DDRC_RatDeb.ErrLmp_tiMILSCBUDRat_C DDRC_RatDeb.ECBVlv_tiSCGUDRat_C DDRC_RatDeb.PCV_tiSCGUDRat_C DDRC_RatDeb.Air_tiMinTCACDsUDRat_C DDRC_RatDeb.LSU_tiCircPmpCurMaxUDRat_C DDRC_RatDeb.EGRVlv_tiSCBUDRat_C DDRC_RatDeb.Air_tiNplPAirFltDsUDRat_C DDRC_RatDeb.PSP_tiOLUDRat_C DDRC_RatDeb.Air_tiDtyCycHiTAFSUDRat_C DDRC_RatDeb.EnvP_tiMaxUDRat_C DDRC_RatDeb.CByVlv_tiOLUDRat_C DDRC_RatDeb.FuelT_tiMinUDRat_C DDRC_RatDeb.PFltLmp_tiSCBUDRat_C DDRC_RatDeb.Exh_tiSRCMinTOxiCatUsUDRat_C DDRC_RatDeb.VehV_tiHWUDRat_C DDRC_RatDeb.PSP_tiSCBUDRat_C DDRC_RatDeb.CThmst_tiSCBUDRat_C DDRC_RatDeb.AirC_tiClntSRCdcycMinUDRat_C DDRC_RatDeb.Air_tiMaxTCACDsUDRat_C DDRC_RatDeb.TrbChLP_tiSCGUDRat_C DDRC_RatDeb.PSP_tiSCGUDRat_C DDRC_RatDeb.LSU_tiO2MaxUDRat_C DDRC_RatDeb.PFlt_tiSotMsDvtMaxUDRat_C DDRC_RatDeb.VehV_tiMaxUDRat_C DDRC_RatDeb.Exh_tiNplTPFltUsUDRat_C DDRC_RatDeb.Oil_tiMaxTUDRat_C DDRC_RatDeb.ErrLmp_tiSVSSCGUDRat_C DDRC_RatDeb.Exh_tiSRCMaxTOxiCatUsUDRat_C DDRC_RatDeb.VSwVlv_tiGovDvtMaxUDRat_C DDRC_RatDeb.Brk_tiPlaUDRat_C DDRC_RatDeb.AFS_tiSetyDrftMinUDRat_C DDRC_RatDeb.LSU_tiCircPmpCurMinUDRat_C DDRC_RatDeb.VSwVlv_tiGovDvtMinUDRat_C DDRC_RatDeb.CEngDsT_tiMinUDRat_C DDRC_RatDeb.CThmst_tiOLUDRat_C DDRC_RatDeb.GbxNPos_tiSRCdcycMinUDRat_C DDRC_RatDeb.PFltLmp_tiOLUDRat_C DDRC_RatDeb.TrbChLP_tiSCBUDRat_C DDRC_RatDeb.LSU_tiHtrMinUDRat_C DDRC_RatDeb.ThrVlv_tiSRCMaxUDRat_C DDRC_RatDeb.Fan_tiSCBUDRat_C DDRC_RatDeb.Oil_tiMinTUDRat_C DDRC_RatDeb.PFlt_tiSotMsDvtMinUDRat_C DDRC_RatDeb.EnvP_tiMinUDRat_C DDRC_RatDeb.GlwPlg_tiBSDSCUDRat_C DDRC_RatDeb.Brk_tiSigUDRat_C DDRC_RatDeb.CThmst_tiSCGUDRat_C DDRC_RatDeb.GlwPlg_tiBSDOTUDRat_C DDRC_RatDeb.EnvT_tiMaxUDRat_C DDRC_RatDeb.AFS_tiSetyDrftMaxUDRat_C DDRC_RatDeb.LSU_tiCircNernstMinUDRat_C DDRC_RatDeb.EGRVlv_tiGovDvtMaxUDRat_C DDRC_RatDeb.Exh_tiSRCMaxTPFltUsUDRat_C DDRC_RatDeb.VehV_tiPlaUDRat_C DDRC_RatDeb.EMDmp_tiSCGUDRat_C DDRC_RatDeb.ECBVlv_tiOLUDRat_C DDRC_RatDeb.EnvT_tiMinUDRat_C DDRC_RatDeb.VehV_tiSigUDRat_C DDRC_RatDeb.EGRVlv_tiOLUDRat_C DDRC_RatDeb.LSU_tiCircVirtGndMaxUDRat_C DDRC_RatDeb.LSU_tiCircVirtGndSigUDRat_C DDRC_RatDeb.AFS_tiRawSRCMinUDRat_C DDRC_RatDeb.AFS_tiOffsDrftMinUDRat_C DDRC_RatDeb.LSU_tiO2MinUDRat_C DDRC_RatDeb.LSU_tiCircNernstMaxUDRat_C DDRC_RatDeb.ThrVlv_tiSRCMinUDRat_C DDRC_RatDeb.EGRVlv_tiSRCMinUDRat_C DDRC_RatDeb.ECBVlv_tiSRCMinUDRat_C DDRC_RatDeb.PFlt_tiCharPDiffMinUDRat_C DDRC_RatDeb.Air_tiPerLoTAFSUDRat_C DDRC_RatDeb.AirC_tiCmprRedTrqSCBUDRat_C DDRC_RatDeb.TrbChLP_tiOLUDRat_C DDRC_RatDeb.BrkP_tiMaxUDRat_C DDRC_RatDeb.AFS_tiCorSRCMinUDRat_C DDRC_RatDeb.EMDmp_tiOLUDRat_C DDRC_RatDeb.Oil_tiComErrUDRat_C DDRC_RatDeb.AirC_tiSwtSigUDRat_C DDRC_RatDeb.Air_tiSRCMaxPCACDsUDRat_C DDRC_RatDeb.Air_tiMinPAirFltDsUDRat_C DDRC_RatDeb.LSU_tiCircNernstSigUDRat_C DDRC_RatDeb.Exh_tiSRCMinTPFltUsUDRat_C DDRC_RatDeb.GbxNPos_tiSRCdcycMaxUDRat_C DDRC_RatDeb.EnvP_tiSigUDRat_C DDRC_RatDeb.EGRVlv_tiGovDvtMinUDRat_C DDRC_RatDeb.CByVlv_tiSCBUDRat_C DDRC_RatDeb.LSU_tiCircVirtGndMinUDRat_C DDRC_RatDeb.LSU_titExcMinUDRat_C DDRC_RatDeb.LSU_tiSPIBattLowMinUDRat_C DDRC_RatDeb.Air_tiMaxPAirFltDsUDRat_C DDRC_RatDeb.OilPLmp_tiSCGUDRat_C DDRC_RatDeb.AirC_tiCmprSCGUDRat_C DDRC_RatDeb.TrbCh_tiSCBUDRat_C DDRC_RatDeb.IVDia_numChpSPICfgUDRat_C DDRC_RatDeb.IVDia_numBnkHSBattUDRat_C DDRC_RatDeb.LSU_numO2PlausMaxUDRat_C DDRC_RatDeb.LSU_numO2ClbMaxUDRat_C DDRC_RatDeb.IVDia_numCylNoLdUDRat_C DDRC_RatDeb.IVDia_numChpSPIRamUDRat_C DDRC_RatDeb.LSU_numRiClbMinUDRat_C DDRC_RatDeb.LSU_numO2PlausMinUDRat_C DDRC_RatDeb.IVDia_numBnkTransferUDRat_C DDRC_RatDeb.IVDia_numChpSPICollUDRat_C DDRC_RatDeb.IVDia_numCylShCirLSBattUDRat_C DDRC_RatDeb.IVDia_numChpSPITransUDRat_C DDRC_RatDeb.IVDia_numBnkShCirHiRstncUDRat_C DDRC_RatDeb.IVDia_numCylShCirLSLSUDRat_C DDRC_RatDeb.IVDia_numCylShCirHiRstncUDRat_C DDRC_RatDeb.ETClb_numETMaxUDRat_C DDRC_RatDeb.IVDia_numBnkBSHUDRat_C DDRC_RatDeb.IVDia_numBnkShCirLSHSGndUDRat_C DDRC_RatDeb.LSU_numRiClbMaxUDRat_C DDRC_RatDeb.IVDia_numChpSPICtrlUDRat_C DDRC_RatDeb.ETClb_numETMinUDRat_C DDRC_RatDeb.Clth_numPlaUDRat_C DDRC_RatDeb.LSU_numDynChkMinUDRat_C DDRC_RatDeb.LSU_numO2ClbMinUDRat_C DDRC_RatDeb.IVDia_numCylNoClsUDRat_C DDRC_RatDeb.LSU_numWireIPSigUDRat_C DDRC_RatDeb.LSU_numCmpChkMinUDRat_C DDRC_RatDeb.IVDia_numBnkShCirChSwtUDRat_C DDRC_RatDeb.IVDia_numCylShCirLSHSUDRat_C /end DEF_CHARACTERISTIC
/end FUNCTION
/begin FUNCTION DevLib_4WinDia "" /end FUNCTION
/begin FUNCTION DevLib_ActrPrt "" /begin DEF_CHARACTERISTIC DevLib_nActrRls_C DevLib_tiActrPrt_C /end DEF_CHARACTERISTIC /begin IN_MEASUREMENT CoEng_st Epm_nEng GlwCtl_stGlw /end IN_MEASUREMENT /begin OUT_MEASUREMENT DevLib_stMonActrPrt /end OUT_MEASUREMENT /end FUNCTION
/begin FUNCTION DevLib_DigOut "" /end FUNCTION
/begin FUNCTION DevLib_MacroDef "" /end FUNCTION
/begin FUNCTION DevLib_PwmOut "" /end FUNCTION
/begin FUNCTION DevLib_PwrStageState ""
 /begin DEF_CHARACTERISTIC Devlib_PsDisbl.facLowHysLo_C Devlib_PsDisbl.facLowHysHi_C Devlib_PsDisbl.facHighHysLo_C Devlib_PsDisbl.facHighHysHi_C Devlib_PwrStg.BattLoHysLo_C Devlib_PwrStg.BattLoHysHi_C Devlib_PwrStg.BattHiHysLo_C Devlib_PwrStg.BattHiHysHi_C DevLib_tiDlyT15_C /end DEF_CHARACTERISTIC
 /begin IN_MEASUREMENT BattU_facCor BattU_u NMng_stFadeOut SyC_stSub /end IN_MEASUREMENT
 /begin OUT_MEASUREMENT DevLib_stPwrStgEnaCond /end OUT_MEASUREMENT
/end FUNCTION
/begin FUNCTION DevLib_SRC "" /end FUNCTION
/begin FUNCTION DevLib_TransStage "" /end FUNCTION
/begin FUNCTION dewdet_htrrls ""
 /begin DEF_CHARACTERISTIC DewDet_cpGs_C DewDet_dmPlsThresLSU_CA DewDet_facCldStrtLSU_CA DewDet_facPlsLSU_CA DewDet_facPlsThresLSU_CA DewDet_numEngTempStrt_C DewDet_numLSU_CA DewDet_numMaxCldStrt_CA DewDet_swtDewDetShOff_CA DewDet_tiDebLSU_CA DewDet_tiDebNrmTransOk_C DewDet_tiHtgDelLSU_CA DewDet_tIntegIni_CA DewDet_tiPlsLSU_CA DewDet_tThresLSUAct_CA DewDet_tWtEquiv_CA DewDet_wLSUIKi_CA DewDet_wThresLSU0_MAP /end DEF_CHARACTERISTIC
 /begin IN_MEASUREMENT EngDa_tFld /end IN_MEASUREMENT
 /begin OUT_MEASUREMENT DewDet_ctCldStrtLSU_mp DewDet_dwLSU_mp DewDet_stHtgLSU DewDet_stHtgLSULstTrp_mp DewDet_stHtgThresLSUHit_mp DewDet_stIntegIni_mp DewDet_stPlsLSU_mp DewDet_tEGLSUInpCrv0_mp DewDet_tEG_mp DewDet_tWall_mp DewDet_wLSU_mp DewDet_wThresLSUAct_mp DewDet_wThresLSUNoPls_mp DewDet_wThresLSUPls_mp DewDet_wThresLSU_mp /end OUT_MEASUREMENT
 /begin LOC_MEASUREMENT DewDet_tEngStrt_mp /end LOC_MEASUREMENT
/end FUNCTION
/begin COMPU_METHOD AirMassPerTime "" RAT_FUNC "%6.3" "Kg/h" COEFFS 0 10 0 0 0 1 /end COMPU_METHOD
/begin COMPU_METHOD CppOfsFact "" RAT_FUNC "%6.4" "-" COEFFS 0 256 0 0 0 1 /end COMPU_METHOD
/begin COMPU_METHOD DDRCTime_ms "" RAT_FUNC "%8.2" "ms" COEFFS 0 1 0 0 0 10 /end COMPU_METHOD
/begin COMPU_METHOD DDRC_Ratio "" TAB_VERB "%2.1" "-" COMPU_TAB_REF DDRC_Ratio /end COMPU_METHOD
/begin COMPU_VTAB DDRC_Ratio "" TAB_VERB 4 1 "Ratio1" 2 "Ratio2" 3 "Ratio3" 4 "Ratio4" /end COMPU_VTAB
/begin COMPU_METHOD DFC_OneToOne "" RAT_FUNC "%8.3" "-" COEFFS 0 1 0 0 0 1 /end COMPU_METHOD
/begin COMPU_METHOD Energy "" RAT_FUNC "%6.2" "kJ" COEFFS 0 1 0 0 0 1 /end COMPU_METHOD
/begin COMPU_METHOD EngN "" RAT_FUNC "%6.3" "rpm" COEFFS 0 2 0 0 0 1 /end COMPU_METHOD
/begin COMPU_METHOD EngTempFldSel "" TAB_VERB "%6.3" "-" COMPU_TAB_REF EngTempFldSel /end COMPU_METHOD
/begin COMPU_VTAB EngTempFldSel "" TAB_VERB 3 0 "Coolant_Temperature" 1 "Oil_Temperature" 2 "EngDa_tEng" /end COMPU_VTAB
/begin COMPU_METHOD Fact "" RAT_FUNC "%6.5" "-" COEFFS 0 8192 0 0 0 1 /end COMPU_METHOD
/begin COMPU_METHOD OneToOne "" RAT_FUNC "%6.2" "-" COEFFS 0 1 0 0 0 1 /end COMPU_METHOD
/begin COMPU_METHOD Pwr_kW_Sec "" RAT_FUNC "%6.4" "kW/s" COEFFS 0 100 0 0 0 1 /end COMPU_METHOD
/begin COMPU_METHOD SpecificHeat "" RAT_FUNC "%7.6" "J/g/K" COEFFS 0 10000 0 0 0 1 /end COMPU_METHOD
/begin COMPU_METHOD Temp_Cels "" RAT_FUNC "%6.1" "deg C" COEFFS 0 10 2731.4 0 0 1 /end COMPU_METHOD
/begin COMPU_METHOD TimeDeb "" RAT_FUNC "%6.1" "ms" COEFFS 0 0.1 0 0 0 1 /end COMPU_METHOD
/begin COMPU_METHOD Time_ms "" RAT_FUNC "%6.1" "ms" COEFFS 0 0.1 0 0 0 1 /end COMPU_METHOD
/begin COMPU_METHOD Time_s "" RAT_FUNC "%6.4" "s" COEFFS 0 100 0 0 0 1 /end COMPU_METHOD
/begin COMPU_METHOD Volt_Batt "" RAT_FUNC "%6.1" "mV" COEFFS 0 0.05 0 0 0 1 /end COMPU_METHOD
/begin RECORD_LAYOUT Kf_Xs16_Ys16_Ws16 NO_AXIS_PTS_X 1 SWORD NO_AXIS_PTS_Y 2 SWORD AXIS_PTS_X 3 SWORD INDEX_INCR DIRECT AXIS_PTS_Y 4 SWORD INDEX_INCR DIRECT FNC_VALUES 5 SWORD COLUMN_DIR DIRECT /end RECORD_LAYOUT
/begin RECORD_LAYOUT Kwb_Ws16 FNC_VALUES 1 SWORD COLUMN_DIR DIRECT /end RECORD_LAYOUT
/begin RECORD_LAYOUT Kwb_Ws32 FNC_VALUES 1 SLONG COLUMN_DIR DIRECT /end RECORD_LAYOUT
/begin RECORD_LAYOUT Kwb_Wu8 FNC_VALUES 1 UBYTE COLUMN_DIR DIRECT /end RECORD_LAYOUT
/begin RECORD_LAYOUT Kw_Ws16 FNC_VALUES 1 SWORD COLUMN_DIR DIRECT /end RECORD_LAYOUT
/begin RECORD_LAYOUT Kw_Wu16 FNC_VALUES 1 UWORD COLUMN_DIR DIRECT /end RECORD_LAYOUT
/begin RECORD_LAYOUT Kw_Wu8 FNC_VALUES 1 UBYTE COLUMN_DIR DIRECT /end RECORD_LAYOUT
/begin RECORD_LAYOUT Val_Ws16 FNC_VALUES 1 SWORD COLUMN_DIR DIRECT /end RECORD_LAYOUT
/begin RECORD_LAYOUT Val_Wu16 FNC_VALUES 1 UWORD COLUMN_DIR DIRECT /end RECORD_LAYOUT
/begin RECORD_LAYOUT Val_Wu8 FNC_VALUES 1 UBYTE COLUMN_DIR DIRECT /end RECORD_LAYOUT
/end MODULE
/end PROJECT
