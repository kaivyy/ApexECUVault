ASAP2_VERSION 1 3
/begin PROJECT _725D601B "725D601B"
/begin HEADER "" VERSION "_725D601B" PROJECT_NO _725D601B /end HEADER
/begin MODULE DIM ""
/begin MOD_COMMON "" BYTE_ORDER MSB_FIRST ALIGNMENT_BYTE 1 ALIGNMENT_WORD 2 ALIGNMENT_LONG 2 ALIGNMENT_FLOAT32_IEEE 4 /end MOD_COMMON
/begin CHARACTERISTIC CLRS "Codewort f¸r Betriebsmodi LRS" VALUE 0xFCC6AE KwUb 255.0 dez 0.00 255.0 FORMAT "%5.1" /end CHARACTERISTIC
/begin CHARACTERISTIC CLRSHK "Codewort f¸r Freigabe LRSHK und Auswahl Initialisierung" VALUE 0xFD45FE KwWU8 255.0 dez 0.00 255.0 FORMAT "%5.1" /end CHARACTERISTIC
/begin CHARACTERISTIC CLRSHKEB "Codewort f¸r Konfigurieren Freigabe LRSHKEB" VALUE 0xFD45FF KwWU8 255.0 dez 0.00 255.0 FORMAT "%5.1" /end CHARACTERISTIC
/begin CHARACTERISTIC CLRSKA "Code-Wort Funktionsart Kat-Ausr‰umen" VALUE 0xFD46A2 KwWU8 255.0 dez 0.00 255.0 FORMAT "%5.1" /end CHARACTERISTIC
/begin CHARACTERISTIC CLRZWTMS "Codewort Zwangseinschaltung LR gem‰ﬂ CARB-Forderung" VALUE 0xFD441A KwUb 255.0 dez 0.00 255.0 FORMAT "%5.1" /end CHARACTERISTIC
/begin CHARACTERISTIC CREDSTU "Codewort f¸r Reduzierstufe ein/aus" VALUE 0xFCA07D KwUb 255.0 dez 0.00 255.0 FORMAT "%5.1" /end CHARACTERISTIC
/begin CHARACTERISTIC CTAGEFOSCX "fcoschk-Schwelle f¸r Zustand 2 bez¸glich H2-Konzentration hinter Kat" VALUE 0xFD4600 KwWU8 1.992 fak_ub_b2 0.00 1.992 FORMAT "%5.3" /end CHARACTERISTIC
/begin CHARACTERISTIC CWDMFAB "Codewort Sw-Schalter f¸r ƒnderungsbegrenzung" VALUE 0xFC9AD4 KwUb 255.0 DEZ 0.00 255.0 FORMAT "%5.1" /end CHARACTERISTIC
/begin CHARACTERISTIC CWDMFAB2 "Codewort2 Sw-Schalter f¸r ƒnderungsbegrenzung" VALUE 0xFC9AD5 KwUb 255.0 DEZ 0.00 255.0 FORMAT "%5.1" /end CHARACTERISTIC
/begin CHARACTERISTIC CWGALSV "Codewort f¸r zur¸cksetzen von Adaptionswerte bei Error E_LSV" VALUE 0xFD21BE KwUb 255.0 dez 0.00 255.0 FORMAT "%5.1" /end CHARACTERISTIC
/begin CHARACTERISTIC CWLRARL "Codewort f¸r F¸llungskorrektur statt Drehzahlkorrektur" VALUE 0xFC769E KwUb 255.0 dez 0.00 255.0 FORMAT "%5.1" /end CHARACTERISTIC
/begin CHARACTERISTIC CWLRFZA "Codewort Phasenlage Zwangsamplitude" VALUE 0xFCC6AF KwUb 255.0 dez 0.00 255.0 FORMAT "%5.1" /end CHARACTERISTIC
/begin CHARACTERISTIC CWLRMS "Codewort Magerschutz" VALUE 0xFD40FC KwUb 255.0 dez 0.00 255.0 FORMAT "%5.1" /end CHARACTERISTIC
/begin CHARACTERISTIC CWLSUMRS "Codewort Funktion LSUMRS" VALUE 0xFD046A KwUb 255.0 dez 0.00 255.0 FORMAT "%5.1" /end CHARACTERISTIC
/begin CHARACTERISTIC CWMBAS "Codewort f¸r MDBAS" VALUE 0xFC92B7 KwUb 255.0 dez 0.00 255.0 FORMAT "%5.1" /end CHARACTERISTIC
/begin CHARACTERISTIC CWMDBGRG "Codewort MDBGRG" VALUE 0xFD3604 KwUb 255.0 dez 0.00 255.0 FORMAT "%5.1" /end CHARACTERISTIC
/begin CHARACTERISTIC CWMDKOG "Codewort MDKOG: Z¸ndwinkelsp‰tverstellung bei Unterdruckbegrenzung" VALUE 0xFCA020 KwUb 255.0 dez 0.00 255.0 FORMAT "%5.1" /end CHARACTERISTIC
/begin CHARACTERISTIC CWPBREMS "Codewort Bremsedruck" VALUE 0xFD3605 KwUb 255.0 dez 0.00 255.0 FORMAT "%5.1" /end CHARACTERISTIC
/begin CHARACTERISTIC CWTEZW "Codewort Z¸ndwinkeleingriff bei TEV-Pr¸fung" VALUE 0xFCA021 KwUb 255.0 dez 0.00 255.0 FORMAT "%5.1" /end CHARACTERISTIC
/begin CHARACTERISTIC CWZWE "Codewort ZW-Eingriffe f¸r MD-Struktur aktiv" VALUE 0xFCA022 KwUb 255.0 dez 0.00 255.0 FORMAT "%5.1" /end CHARACTERISTIC
/begin CHARACTERISTIC CWZWVMX "Codewort Z¸ndwinkeleingriff bei VMAX-Begrenzung" VALUE 0xFCA023 KwUb 255.0 dez 0.00 255.0 FORMAT "%5.1" /end CHARACTERISTIC
/begin CHARACTERISTIC CW_FMKNUL "Codewort f¸r Berechnungsart fmknul" VALUE 0xFC9AD6 KwUb 255.0 dez 0.00 255.0 FORMAT "%5.1" /end CHARACTERISTIC
/begin CHARACTERISTIC DLAHINI "Initwert Integrator dlahi der stetigen LRHK" VALUE 0xFD458C KwWS16 1.999969 fak_sw_b1 -1.000000 0.9999695 FORMAT "%8.6" /end CHARACTERISTIC
/begin CHARACTERISTIC DLAHINI2 "Initwert Integrator dlahi der stetigen LRHK, Bank2" VALUE 0xFD458E KwWS16 1.999969 fak_sw_b1 -1.000000 0.9999695 FORMAT "%8.6" /end CHARACTERISTIC
/begin CHARACTERISTIC DLAMXSA "max Regeldifferenz, f¸r die nach SA die LRS gesperrt bleibt" VALUE 0xFCC928 KwUw 15.99976 fak_uw_b16 0.00 15.99976 FORMAT "%8.5" /end CHARACTERISTIC
/begin CHARACTERISTIC DLSDWE "D‰mpfung PT2-Filter Lastschlagd‰mpfung bei hohem Kupplungsmoment" VALUE 0xFC9ADA KwUw 1.999969 fak_uw_b2 0.00 1.999969 FORMAT "%8.6" /end CHARACTERISTIC
/begin CHARACTERISTIC DMDPUG "delta Moment Dashpotende" CURVE 0xFD36AC GklWSw 199.9969 rel_sw_b100 -100.0000 99.99695 FORMAT "%8.4"
 /begin AXIS_DESCR COM_AXIS gangi dez 8 0.00 255.0 FORMAT "%5.1" AXIS_PTS_REF SGA08MDUB /end AXIS_DESCR
/end CHARACTERISTIC
/begin CHARACTERISTIC DMIFSAWE "Schwelle bei mimin-Sprung f¸r R¸cksetzen von B_fil" VALUE 0xFC9ADC KwUw 99.99695 rel_uw_b100 0.001525879 99.99847 FORMAT "%8.5" /end CHARACTERISTIC
/begin CHARACTERISTIC DMIHTOELD "negativer Rampenschritt Momentenbegrenzung bei hohem toel" VALUE 0xFD362A KwUw 99.99847 rel_uw_b100 0.00 99.99847 FORMAT "%8.5" /end CHARACTERISTIC
/begin CHARACTERISTIC DMIHTOELI "possitiver Rampenschritt Momentenbegrenzung bei hohem toel" VALUE 0xFD362C KwUw 99.99847 rel_uw_b100 0.00 99.99847 FORMAT "%8.5" /end CHARACTERISTIC
/begin CHARACTERISTIC DMIZWMN "Offset auf indiziertes Motormoment bei sp‰testem Z¸ndwinkel und ASR-Eingriff" VALUE 0xFCA07E KwUb 99.61 rel_ub_b99p6 0.00 99.61 FORMAT "%5.2" /end CHARACTERISTIC
/begin CHARACTERISTIC DMLSDUG "Delta Moment Ende Lastschlagd‰mpfung" CURVE 0xFD36BC GklWSw 199.9969 rel_sw_b100 -100.0000 99.99695 FORMAT "%8.4"
 /begin AXIS_DESCR COM_AXIS gangi dez 8 0.00 255.0 FORMAT "%5.1" AXIS_PTS_REF SGA08MDUB /end AXIS_DESCR
/end CHARACTERISTIC
/begin CHARACTERISTIC DMRFAV "ƒnderungsbegrenzung von mr bei EGS-Notlauf" CURVE 0xFD36CC KlAUwSstUwWUw 199.9969 rel_uw_b200 0.00 199.9969 FORMAT "%8.4"
 /begin AXIS_DESCR STD_AXIS vfzg_w vfzg_uw_b512 2 0.00 511.9922 FORMAT "%8.4" DEPOSIT ABSOLUTE /end AXIS_DESCR
/end CHARACTERISTIC
/begin CHARACTERISTIC DMRKHO "obere Hytereseschwelle Katheiz-Momentenreserve mit ZW-Eingriff" VALUE 0xFCA024 KwUb 99.61 rel_ub_b99p6 0.00 99.61 FORMAT "%5.2" /end CHARACTERISTIC
/begin CHARACTERISTIC DMRKHU "Untere Hytereseschwelle Katheiz-Momentenreserve mit ZW-Eingriff" VALUE 0xFCA025 KwUb 99.61 rel_ub_b99p6 0.00 99.61 FORMAT "%5.2" /end CHARACTERISTIC
/begin CHARACTERISTIC DRLLRHKO "positive Delta-rl-Schwelle f¸r Ausblendung I-Anteil" VALUE 0xFD45DC KwWS16 1535.977 relNWU_q0p0234 -768.0000 767.9766 FORMAT "%8.4" /end CHARACTERISTIC
/begin CHARACTERISTIC DRLLRHKU "negative Delta-rl-Schwelle f¸r Ausblendung I-Anteil" VALUE 0xFD45DE KwWS16 1535.977 relNWU_q0p0234 -768.0000 767.9766 FORMAT "%8.4" /end CHARACTERISTIC
/begin CHARACTERISTIC DTMR "Hysterese f¸r Einschaltschwelle" VALUE 0xFCC904 KwUb 191.3 temp_ub_b191p25 0.00 191.3 FORMAT "%5.1" /end CHARACTERISTIC
/begin CHARACTERISTIC DTMTMRW "Temperaturdiff.-Schwelle f¸r die Pr¸fung, ob Zwangseinschaltung LR nˆtig (CARB)" VALUE 0xFD441B KwSb 191.3 temp_sb_q0p75 -96.00 95.25 FORMAT "%5.2" /end CHARACTERISTIC
/begin CHARACTERISTIC DZW2DZWQ "Deltaz¸ndwinkel (quadratisch)" CURVE 0xFC92B8 FklWUb 90.72 kwq_ub_q0p35576 0.00 90.72 FORMAT "%5.2"
 /begin AXIS_DESCR FIX_AXIS dzwb zw_sb_q0p75 128 0.00 95.25 FORMAT "%5.2" FIX_AXIS_PAR 0 0 128 /end AXIS_DESCR
/end CHARACTERISTIC
/begin CHARACTERISTIC DZWKOEFKT "" VALUE 0xFC9338 KwUb 11.20 fak_q0p0439 0.00 11.20 FORMAT "%5.2" /end CHARACTERISTIC
/begin CHARACTERISTIC DZWOLA "Lambda-Abh‰ngigkeit des optimalen Z¸ndwinkels bezogen auf Lambda 1" CURVE 0xFC955C KlAUbSstUbWSb 191.3 zw_sb_q0p75 -96.00 95.25 FORMAT "%5.2"
 /begin AXIS_DESCR STD_AXIS lambas fak_ub_b2 10 0.00 1.992 FORMAT "%5.3" DEPOSIT ABSOLUTE /end AXIS_DESCR
/end CHARACTERISTIC
/begin CHARACTERISTIC DZWOM "temperaturabh‰ngiger Offset des optimalen ZW" CURVE 0xFC9571 KlAUbSstUbWSb 191.3 zw_sb_q0p75 -96.00 95.25 FORMAT "%5.2"
 /begin AXIS_DESCR STD_AXIS tmot temp_ub_q0p75_o48 5 -48.00 143.3 FORMAT "%5.1" DEPOSIT ABSOLUTE /end AXIS_DESCR
/end CHARACTERISTIC
/begin CHARACTERISTIC ETALAM "Lambda-Wirkungsgrad" CURVE 0xFC9339 KlAUbSstUbWUb 127.5 rel_ub_b127p5 0.00 127.5 FORMAT "%5.1"
 /begin AXIS_DESCR STD_AXIS lambas fak_ub_b2 10 0.00 1.992 FORMAT "%5.3" DEPOSIT ABSOLUTE /end AXIS_DESCR
/end CHARACTERISTIC
/begin CHARACTERISTIC FBZFRAT "Bewertungsfaktor f¸r Integrationsgeschwindigkeit KFFRAT als f(abo)" CURVE 0xFD21BF KlAUbSstUbWUb 0.9961 fak_ub_b1 0.00 0.9961
 /begin AXIS_DESCR STD_AXIS abo dez 5 0.00 255.0 FORMAT "%5.1" DEPOSIT ABSOLUTE /end AXIS_DESCR
/end CHARACTERISTIC
/begin CHARACTERISTIC FDZWKOFTMT "" CURVE 0xFD3596 KlAUbSstUbWUb 0.9961 fak_ub_b1 0.00 0.9961
 /begin AXIS_DESCR STD_AXIS tmot temp_ub_q0p75_o48 6 -48.00 143.3 FORMAT "%5.1" DEPOSIT ABSOLUTE /end AXIS_DESCR
/end CHARACTERISTIC
/begin CHARACTERISTIC FKAXFOSC "Gewichtungsfaktor Sauerstoffspeicher in Abh‰ngigkeit von fcoschk" CURVE 0xFD467E KlAxU8SstxU8WU8 0.9961 fak_ub_b1 0.00 0.9961
 /begin AXIS_DESCR STD_AXIS fcoschk fak_ub_b2 3 0.00 1.992 FORMAT "%5.3" DEPOSIT ABSOLUTE /end AXIS_DESCR
/end CHARACTERISTIC
/begin CHARACTERISTIC FKAXFOSC2 "Gewichtungsfaktor Sauerstoffspeicher in Abh‰ngigkeit von fcoschk2" CURVE 0xFD4685 KlAxU8SstxU8WU8 0.9961 fak_ub_b1 0.00 0.9961
 /begin AXIS_DESCR STD_AXIS fcoschk2 fak_ub_b2 3 0.00 1.992 FORMAT "%5.3" DEPOSIT ABSOLUTE /end AXIS_DESCR
/end CHARACTERISTIC
/begin CHARACTERISTIC FLMLKAMA "Faktor zur Bewertung Schwellwert integr. Fettfl. f. Abbruch Kat-Ausr. Pre/Main" VALUE 0xFD46A3 KwWU8 7.969 fak_ub_b8 0.00 7.969 FORMAT "%5.3" /end CHARACTERISTIC
/begin CHARACTERISTIC FLMLKAMA2 "Fakt. zur Bewert. Schwellw. integr. Fettfl. f. Abbruch Kat-Ausr. Pre/Main, Bank2" VALUE 0xFD46A4 KwWU8 7.969 fak_ub_b8 0.00 7.969 FORMAT "%5.3" /end CHARACTERISTIC
/begin CHARACTERISTIC FMIHGN "Wichtungsfaktor Momentenbegrenzung bei Schaltgetriebeschutz" CURVE 0xFD3606 KlAUbSstUbWUb 1.992 rel_ub_b2p0 0.00 1.992 FORMAT "%5.3"
 /begin AXIS_DESCR STD_AXIS nmot nmot_ub_q40 8 0.00 10200. FORMAT "%5.0" DEPOSIT ABSOLUTE /end AXIS_DESCR
/end CHARACTERISTIC
/begin CHARACTERISTIC FMIVL "Faktor Korrektur maximales Moment bei VL" VALUE 0xFCA036 KwUb 1.992 fak_ub_b2 0.00 1.992 FORMAT "%5.3" /end CHARACTERISTIC
/begin CHARACTERISTIC FNSTABNV "Faktor zur Drehzahlstabilisierung durch Drehmoment" CURVE 0xFC8B1C KlAxU8SstxU16WU16 7.999878 fak_uw_b8 0.00 7.999878 FORMAT "%8.6"
 /begin AXIS_DESCR STD_AXIS fnsta_in fak_uw_b8 6 0.00 7.999878 FORMAT "%8.6" DEPOSIT ABSOLUTE /end AXIS_DESCR
/end CHARACTERISTIC
/begin CHARACTERISTIC FRAOMN "untere Begrenzung des Korrekturfaktors frao" VALUE 0xFD21CA KwUb 1.992 fak_ub_b2 0.00 1.992 FORMAT "%5.3" /end CHARACTERISTIC
/begin CHARACTERISTIC FRAOMX "obere Begrenzung des Korrekturfaktors frao" VALUE 0xFD21CB KwUb 1.992 fak_ub_b2 0.00 1.992 FORMAT "%5.3" /end CHARACTERISTIC
/begin CHARACTERISTIC FRAORN "untere reduzierte Schwelle des Korrekturfaktors frao" VALUE 0xFD21CC KwUb 1.992 fak_ub_b2 0.00 1.992 FORMAT "%5.3" /end CHARACTERISTIC
/begin CHARACTERISTIC FRAORX "obere reduzierte Schwelle des Korrekturfaktors frao" VALUE 0xFD21CD KwUb 1.992 fak_ub_b2 0.00 1.992 FORMAT "%5.3" /end CHARACTERISTIC
/begin CHARACTERISTIC FRATMN "untere Begrenzung des Korrekturfaktors frat" VALUE 0xFD21CE KwUb 1.992 fak_ub_b2 0.00 1.992 FORMAT "%5.3" /end CHARACTERISTIC
/begin CHARACTERISTIC FRATMX "obere Begrenzung des Korrekturfaktors frat" VALUE 0xFD21CF KwUb 1.992 fak_ub_b2 0.00 1.992 FORMAT "%5.3" /end CHARACTERISTIC
/begin CHARACTERISTIC FRAUMN "untere Begrenzung des Korrekturfaktors frau" VALUE 0xFD21D0 KwUb 1.992 fak_ub_b2 0.00 1.992 FORMAT "%5.3" /end CHARACTERISTIC
/begin CHARACTERISTIC FRAUMX "obere Begrenzung des Korrekturfaktors frau" VALUE 0xFD21D1 KwUb 1.992 fak_ub_b2 0.00 1.992 FORMAT "%5.3" /end CHARACTERISTIC
/begin CHARACTERISTIC FRAURN "untere reduzierte Schwelle des Korrekturfaktors frau" VALUE 0xFD21D2 KwUb 1.992 fak_ub_b2 0.00 1.992 FORMAT "%5.3" /end CHARACTERISTIC
/begin CHARACTERISTIC FRAURX "obere reduzierte Schwelle des Korrekturfaktors frau" VALUE 0xFD21D3 KwUb 1.992 fak_ub_b2 0.00 1.992 FORMAT "%5.3" /end CHARACTERISTIC
/begin CHARACTERISTIC FRLVTM "Korrekturfaktor max. Volumenstrom bei offener Drosselklappe" CURVE 0xFCA037 KlAUbSstUbWUb 1.992 fak_ub_b2 0.00 1.992 FORMAT "%5.3"
 /begin AXIS_DESCR STD_AXIS tmot temp_ub_q0p75_o48 5 -48.00 143.3 FORMAT "%5.1" DEPOSIT ABSOLUTE /end AXIS_DESCR
/end CHARACTERISTIC
/begin CHARACTERISTIC FRMAX "obere Regelbereichsgrenze" VALUE 0xFCC77A KwUw 1.999969 fak_uw_b2 0.00 1.999969 FORMAT "%8.6" /end CHARACTERISTIC
/begin CHARACTERISTIC FRMINKH "Magerbegrenzung Lambdaregelung bei KH mit SL" VALUE 0xFCC77C KwUw 1.999969 fak_uw_b2 0.00 1.999969 FORMAT "%8.6" /end CHARACTERISTIC
/begin CHARACTERISTIC ILMLKAXTK "Schwelle Fettfl‰che Kat-Ausr‰umen nach SA, Funktion der Kat-Temperatur" CURVE 0xFD4652 KlAxU8SstxU16WU16 291.2667 m_uw_b291p25 0.00 291.2667 FORMAT "%8.4"
 /begin AXIS_DESCR STD_AXIS xtkikm_w temp_q0p0234_o273 5 -273.1500 1262.827 FORMAT "%8.3" DEPOSIT ABSOLUTE /end AXIS_DESCR
/end CHARACTERISTIC
/begin CHARACTERISTIC ILMLKAXTK2 "Schwelle Fettfl‰che Kat-Ausr‰umen nach SA, Funktion der Kat-Temperartur" CURVE 0xFD4668 KlAxU8SstxU16WU16 291.2667 m_uw_b291p25 0.00 291.2667 FORMAT "%8.4"
 /begin AXIS_DESCR STD_AXIS xtkikm2_w temp_q0p0234_o273 5 -273.1500 1262.827 FORMAT "%8.3" DEPOSIT ABSOLUTE /end AXIS_DESCR
/end CHARACTERISTIC
/begin CHARACTERISTIC IMLEVABS "Schwelle Luftmassenintegral vor Freigabe Lambdaregelung nach Zylinderausblendung" VALUE 0xFCC92A KwUw 4660.267 m_uw_b4660 0.00 4660.267 FORMAT "%8.3" /end CHARACTERISTIC
/begin CHARACTERISTIC IMLEVABS2 "Schwelle Luftmassenintegral vor Freigabe Lambdareg. nach Zyl.ausblendung, Bank 2" VALUE 0xFCC92C KwUw 4660.267 m_uw_b4660 0.00 4660.267 FORMAT "%8.3" /end CHARACTERISTIC
/begin CHARACTERISTIC IMLKAMN "Schwellwert integr. Luftmasse f. Mindestdauer Katalysator-Ausr‰umen" VALUE 0xFD468C KwWU16 291.2622 m_uw_b291p25 0.00 291.2622 FORMAT "%8.4" /end CHARACTERISTIC
/begin CHARACTERISTIC IMLKAMN2 "Schwellwert integr. Luftmasse f. Mindestdauer Katalysator-Ausr‰umen Bank2" VALUE 0xFD468E KwWU16 291.2622 m_uw_b291p25 0.00 291.2622 FORMAT "%8.4" /end CHARACTERISTIC
/begin CHARACTERISTIC IMLSALR "Schwellwert integr. Luftmasse f. Einschaltverzˆgerung LR nach SA" VALUE 0xFCC92E KwUw 4660.267 m_uw_b4660 0.00 4660.267 FORMAT "%8.3" /end CHARACTERISTIC
/begin CHARACTERISTIC IMSLRUCAX "alternative Abgasm-Schw. f¸r Ausblendung I-Anteil nach Auslˆsung  Delta-rl" VALUE 0xFD45E0 KwWU16 7281.667 m_uw_b7281 0.00 7281.667 FORMAT "%8.3" /end CHARACTERISTIC
/begin CHARACTERISTIC IMSLRUX "Abgasmassen-Schw. f¸r Ausblendung I-Anteil nach Auslˆsung  Delta-rl" VALUE 0xFD45E2 KwWU16 7281.667 m_uw_b7281 0.00 7281.667 FORMAT "%8.3" /end CHARACTERISTIC
/begin CHARACTERISTIC KDLASHKI "Kennlinie ¸ber dlashkm, Bewertungsfaktor f¸r I-Anteil in der LRHK" CURVE 0xFD4450 GklWS16 1.999969 fak_sw_b1 -1.000000 0.9999695 FORMAT "%8.6"
 /begin AXIS_DESCR COM_AXIS dlashkm_w fak_sw_b1 9 -1.000000 0.9999695 FORMAT "%8.6" AXIS_PTS_REF SM109LHSW /end AXIS_DESCR
/end CHARACTERISTIC
/begin CHARACTERISTIC KDLASHKI2 "Kennlinie ¸ber dlashkm, Bewertungsfaktor f¸r I-Anteil in der LRHK, Bank 2" CURVE 0xFD4462 GklWS16 1.999969 fak_sw_b1 -1.000000 0.9999695 FORMAT "%8.6"
 /begin AXIS_DESCR COM_AXIS dlashkm2_w fak_sw_b1 9 -1.000000 0.9999695 FORMAT "%8.6" AXIS_PTS_REF SM209LHSW /end AXIS_DESCR
/end CHARACTERISTIC
/begin CHARACTERISTIC KDLASHKP "Kennlinie ¸ber dlashkm_w, Bewertungsfaktor f¸r P-Anteil in der LRHK" CURVE 0xFD4474 GklWS16 1.999969 fak_sw_b1 -1.000000 0.9999695 FORMAT "%8.6"
 /begin AXIS_DESCR COM_AXIS dlashkm_w fak_sw_b1 9 -1.000000 0.9999695 FORMAT "%8.6" AXIS_PTS_REF SM109LHSW /end AXIS_DESCR
/end CHARACTERISTIC
/begin CHARACTERISTIC KDLASHKP2 "Kennlinie ¸ber dlashkm, Bewertungsfaktor f¸r P-Anteil in der LRHK, Bank 2" CURVE 0xFD4486 GklWS16 1.999969 fak_sw_b1 -1.000000 0.9999695 FORMAT "%8.6"
 /begin AXIS_DESCR COM_AXIS dlashkm2_w fak_sw_b1 9 -1.000000 0.9999695 FORMAT "%8.6" AXIS_PTS_REF SM209LHSW /end AXIS_DESCR
/end CHARACTERISTIC
/begin CHARACTERISTIC KFDLASO "Kennfeld Lambdasollwert-Korrektur f¸r stetigen Lambdaregler" MAP 0xFCC6B0 GkfWSb 0.06226 fak_sb_b0p03125 -0.03125 0.03101 FORMAT "%7.5"
 /begin AXIS_DESCR COM_AXIS nmot nmot_ub_q40 10 0.00 10200. FORMAT "%5.0" AXIS_PTS_REF SNM10LSUB /end AXIS_DESCR
 /begin AXIS_DESCR COM_AXIS rl rel_ub_q0p75 10 0.00 191.3 FORMAT "%5.1" AXIS_PTS_REF SRL10LSUB /end AXIS_DESCR
/end CHARACTERISTIC
/begin CHARACTERISTIC KFDLASO2 "Kennfeld Lambdasollwert-Korrektur f¸r stetigen Lambdaregler, Bank2" MAP 0xFCC714 GkfWSb 0.06226 fak_sb_b0p03125 -0.03125 0.03101 FORMAT "%7.5"
 /begin AXIS_DESCR COM_AXIS nmot nmot_ub_q40 10 0.00 10200. FORMAT "%5.0" AXIS_PTS_REF SNM10LSUB /end AXIS_DESCR
 /begin AXIS_DESCR COM_AXIS rl rel_ub_q0p75 10 0.00 191.3 FORMAT "%5.1" AXIS_PTS_REF SRL10LSUB /end AXIS_DESCR
/end CHARACTERISTIC
/begin CHARACTERISTIC KFDLSD "D‰mpfung PT2-Filter Lastschlagd‰mpfung" MAP 0xFD36D6 GkfWUw 1.999969 fak_uw_b2 0.00 1.999969 FORMAT "%8.6"
 /begin AXIS_DESCR COM_AXIS gangi dez 8 0.00 255.0 FORMAT "%5.1" AXIS_PTS_REF SGA08MDUB /end AXIS_DESCR
 /begin AXIS_DESCR COM_AXIS nmot_w nmot_uw_q0p25 6 0.00 16383.75 FORMAT "%8.2" AXIS_PTS_REF SNM06MDUW /end AXIS_DESCR
/end CHARACTERISTIC
/begin CHARACTERISTIC KFDLSDS "D‰mpfung PT2-Filter Lastschlagd‰mpfung bei Datensatz 2" MAP 0xFD3736 GkfWUw 1.999969 fak_uw_b2 0.00 1.999969 FORMAT "%8.6"
 /begin AXIS_DESCR COM_AXIS gangi dez 8 0.00 255.0 FORMAT "%5.1" AXIS_PTS_REF SGA08MDUB /end AXIS_DESCR
 /begin AXIS_DESCR COM_AXIS nmot_w nmot_uw_q0p25 6 0.00 16383.75 FORMAT "%8.2" AXIS_PTS_REF SNM06MDUW /end AXIS_DESCR
/end CHARACTERISTIC
/begin CHARACTERISTIC KFDMDPO "Delta Moment Dashpotauslˆsung" MAP 0xFC9ADE GkfWSw 199.9969 rel_sw_b100 -100.0000 99.99695 FORMAT "%8.4"
 /begin AXIS_DESCR COM_AXIS gangi dez 8 0.00 255.0 FORMAT "%5.1" AXIS_PTS_REF SGA08MDUB /end AXIS_DESCR
 /begin AXIS_DESCR COM_AXIS mkfanb_w rel_sw_b100 6 -100.0000 99.99695 FORMAT "%8.4" AXIS_PTS_REF SMK06MDUW /end AXIS_DESCR
/end CHARACTERISTIC
/begin CHARACTERISTIC KFDMLSDO "Delta Moment Auslˆsung Lastschlagd‰mpfung" MAP 0xFC9B3E GkfWSw 199.9969 rel_sw_b100 -100.0000 99.99695 FORMAT "%8.4"
 /begin AXIS_DESCR COM_AXIS gangi dez 8 0.00 255.0 FORMAT "%5.1" AXIS_PTS_REF SGA08MDUB /end AXIS_DESCR
 /begin AXIS_DESCR COM_AXIS mkfanb_w rel_sw_b100 6 -100.0000 99.99695 FORMAT "%8.4" AXIS_PTS_REF SMK06MDUW /end AXIS_DESCR
/end CHARACTERISTIC
/begin CHARACTERISTIC KFDZWAGR "Z¸ndwinkeloffset bei AGR" MAP 0xFD35A3 KfAxUbAyUbSstxUbSstyUbWSb 191.3 zw_sb_q0p75 -96.00 95.25 FORMAT "%5.2"
 /begin AXIS_DESCR STD_AXIS rl rel_ub_q0p75 8 0.00 191.3 FORMAT "%5.1" DEPOSIT ABSOLUTE /end AXIS_DESCR
 /begin AXIS_DESCR STD_AXIS agrr rel_ub_b99p6 6 0.00 99.61 FORMAT "%5.2" DEPOSIT ABSOLUTE /end AXIS_DESCR
/end CHARACTERISTIC
/begin CHARACTERISTIC KFDZWKOEF "Kennfeld Koeffizient f¸r ZW-Wirkungsgrad" MAP 0xFC8F48 GkfWU8 11.20 fak_q0p0439 0.00 11.20 FORMAT "%5.2"
 /begin AXIS_DESCR COM_AXIS nmot_w nmot_uw_q0p25 16 0.00 16383.75 FORMAT "%8.2" AXIS_PTS_REF SNM16OPUW /end AXIS_DESCR
 /begin AXIS_DESCR COM_AXIS rl_w_kge rel_uw_q0p0234 16 0.00 1535.977 FORMAT "%8.3" AXIS_PTS_REF SRL16OPUW /end AXIS_DESCR
/end CHARACTERISTIC
/begin CHARACTERISTIC KFDZWKOEFT "Kennfeld Koeffizient f¸r ZW-Wirkungsgrad Teil-Dross" MAP 0xFC9048 GkfWU8 11.20 fak_q0p0439 0.00 11.20 FORMAT "%5.2"
 /begin AXIS_DESCR COM_AXIS nmot_w nmot_uw_q0p25 16 0.00 16383.75 FORMAT "%8.2" AXIS_PTS_REF SNM16OPUW /end AXIS_DESCR
 /begin AXIS_DESCR COM_AXIS rl_w_kge rel_uw_q0p0234 16 0.00 1535.977 FORMAT "%8.3" AXIS_PTS_REF SRL16OPUW /end AXIS_DESCR
/end CHARACTERISTIC
/begin CHARACTERISTIC KFETAGD "KF Wirkungsgrad gedrosselt in Bezug auf 100% bei ungedrosseltem Betrieb" MAP 0xFC957C GkfWUw 99.99847 rel_uw_b100 0.00 99.99847 FORMAT "%8.5"
 /begin AXIS_DESCR COM_AXIS nmot_w nmot_uw_q0p25 16 0.00 16383.75 FORMAT "%8.2" AXIS_PTS_REF SNM16OPUW /end AXIS_DESCR
 /begin AXIS_DESCR COM_AXIS rl_w_kge rel_uw_q0p0234 16 0.00 1535.977 FORMAT "%8.3" AXIS_PTS_REF SRL16OPUW /end AXIS_DESCR
/end CHARACTERISTIC
/begin CHARACTERISTIC KFFDMFBT "Faktor zur ‹berblendung ungedrosselt - teilgedrosselt - gedrosselt" MAP 0xFD368A KfAxUbAyUbSstxUbSstyUbWUb 0.9961 fak_ub_b1 0.00 0.9961
 /begin AXIS_DESCR STD_AXIS dpsfaktd fak_ub_q0p00392 6 0.00 1.000 FORMAT "%5.3" DEPOSIT ABSOLUTE /end AXIS_DESCR
 /begin AXIS_DESCR STD_AXIS dpsfak fak_ub_q0p00392 2 0.00 1.000 FORMAT "%5.3" DEPOSIT ABSOLUTE /end AXIS_DESCR
/end CHARACTERISTIC
/begin CHARACTERISTIC KFFMKNULFS "Kennfeld Faktor f¸r momentenneutraler Nulldurchgang f¸r DASH/LSD" MAP 0xFC99A0 KfAxUbAyUbSstxUwSstyUwWUw 1.999969 fak_uw_b2 0.00 1.999969 FORMAT "%8.6"
 /begin AXIS_DESCR STD_AXIS ntnmot_w fak_uw_b4 6 0.00 3.999939 FORMAT "%8.6" DEPOSIT ABSOLUTE /end AXIS_DESCR
 /begin AXIS_DESCR STD_AXIS gangi dez 8 0.00 7.000 FORMAT "%5.3" DEPOSIT ABSOLUTE /end AXIS_DESCR
/end CHARACTERISTIC
/begin CHARACTERISTIC KFFMKNULSS "" MAP 0xFC9A20 KfAxUbAyUbSstxUwSstyUwWUw 1.999969 fak_uw_b2 0.00 1.999969 FORMAT "%8.6"
 /begin AXIS_DESCR STD_AXIS ntnmot_w fak_uw_b4 6 0.00 3.999939 FORMAT "%8.6" DEPOSIT ABSOLUTE /end AXIS_DESCR
 /begin AXIS_DESCR STD_AXIS gangi dez 8 0.00 7.000 FORMAT "%5.3" DEPOSIT ABSOLUTE /end AXIS_DESCR
/end CHARACTERISTIC
/begin CHARACTERISTIC KFFRMIN "untere Regelbereichsgrenze" MAP 0xFCC77E KfAxUbAyUbSstxUbSstyUwWUw 1.999969 fak_uw_b2 0.00 1.999969 FORMAT "%8.6"
 /begin AXIS_DESCR STD_AXIS tmot temp_ub_q0p75_o48 5 -48.00 143.3 FORMAT "%5.1" DEPOSIT ABSOLUTE /end AXIS_DESCR
 /begin AXIS_DESCR STD_AXIS tnst_w t10msxs_uw_b655p35 4 0.00 655.3500 FORMAT "%8.4" DEPOSIT ABSOLUTE /end AXIS_DESCR
/end CHARACTERISTIC
/begin CHARACTERISTIC KFH2CONC "Betreibspunktabh‰ngige H2 Konzentration f¸r einen Neu-Kat" MAP 0xFD44B0 KfAxU8AyU8SstxU8SstyU8WU8 2040. m_q8p0_ppm 0.00 2040. FORMAT "%5.0"
 /begin AXIS_DESCR STD_AXIS nmot nmot_ub_q40 6 0.00 10200. FORMAT "%5.0" DEPOSIT ABSOLUTE /end AXIS_DESCR
 /begin AXIS_DESCR STD_AXIS rl rel_ub_q0p75 6 0.00 191.3 FORMAT "%5.1" DEPOSIT ABSOLUTE /end AXIS_DESCR
/end CHARACTERISTIC
/begin CHARACTERISTIC KFKDZWKOFT "" MAP 0xFC9148 GkfWU8 11.20 fak_q0p0439 0.00 11.20 FORMAT "%5.2"
 /begin AXIS_DESCR COM_AXIS nmot_w nmot_uw_q0p25 16 0.00 16383.75 FORMAT "%8.2" AXIS_PTS_REF SNM16OPUW /end AXIS_DESCR
 /begin AXIS_DESCR COM_AXIS rl_w_kge rel_uw_q0p0234 16 0.00 1535.977 FORMAT "%8.3" AXIS_PTS_REF SRL16OPUW /end AXIS_DESCR
/end CHARACTERISTIC
/begin CHARACTERISTIC KFLRSG1 "Kennfeld Reglerparameter g1 stetiger Lambdaregler" MAP 0xFD410A GkfWSw 63.99902 fak_sw_b32 -32.00000 31.99902 FORMAT "%8.5"
 /begin AXIS_DESCR COM_AXIS nmot_w nmot_uw_q0p25 7 0.00 16383.75 FORMAT "%8.2" AXIS_PTS_REF SNM07LSUW /end AXIS_DESCR
 /begin AXIS_DESCR COM_AXIS rl_w rel_uw_q0p0234 8 0.00 1535.977 FORMAT "%8.3" AXIS_PTS_REF SRL08LSUW /end AXIS_DESCR
/end CHARACTERISTIC
/begin CHARACTERISTIC KFLRSG2 "Kennfeld Reglerparameter g2 stetiger Lambdaregler" MAP 0xFD417A GkfWUw 63.99902 fak_uw_b64 0.00 63.99902 FORMAT "%8.5"
 /begin AXIS_DESCR COM_AXIS nmot_w nmot_uw_q0p25 7 0.00 16383.75 FORMAT "%8.2" AXIS_PTS_REF SNM07LSUW /end AXIS_DESCR
 /begin AXIS_DESCR COM_AXIS rl_w rel_uw_q0p0234 8 0.00 1535.977 FORMAT "%8.3" AXIS_PTS_REF SRL08LSUW /end AXIS_DESCR
/end CHARACTERISTIC
/begin CHARACTERISTIC KFLRSG4 "Kennfeld Reglerparameter g4 stetiger Lambdaregler" MAP 0xFD41EA GkfWSw 3.999939 fak_sw_b2 -2.000000 1.999939 FORMAT "%8.6"
 /begin AXIS_DESCR COM_AXIS nmot_w nmot_uw_q0p25 7 0.00 16383.75 FORMAT "%8.2" AXIS_PTS_REF SNM07LSUW /end AXIS_DESCR
 /begin AXIS_DESCR COM_AXIS rl_w rel_uw_q0p0234 8 0.00 1535.977 FORMAT "%8.3" AXIS_PTS_REF SRL08LSUW /end AXIS_DESCR
/end CHARACTERISTIC
/begin CHARACTERISTIC KFLRSP1 "Kennfeld Reglerparameter p1 stetiger Lambdaregler" MAP 0xFD425A GkfWUw 127.9980 fak_uw_b128 0.00 127.9980 FORMAT "%8.4"
 /begin AXIS_DESCR COM_AXIS nmot_w nmot_uw_q0p25 7 0.00 16383.75 FORMAT "%8.2" AXIS_PTS_REF SNM07LSUW /end AXIS_DESCR
 /begin AXIS_DESCR COM_AXIS rl_w rel_uw_q0p0234 8 0.00 1535.977 FORMAT "%8.3" AXIS_PTS_REF SRL08LSUW /end AXIS_DESCR
/end CHARACTERISTIC
/begin CHARACTERISTIC KFLRSP2 "Kennfeld Reglerparameter p2 stetiger Lambdaregler" MAP 0xFD42CA GkfWUw 127.9980 fak_uw_b128 0.00 127.9980 FORMAT "%8.4"
 /begin AXIS_DESCR COM_AXIS nmot_w nmot_uw_q0p25 7 0.00 16383.75 FORMAT "%8.2" AXIS_PTS_REF SNM07LSUW /end AXIS_DESCR
 /begin AXIS_DESCR COM_AXIS rl_w rel_uw_q0p0234 8 0.00 1535.977 FORMAT "%8.3" AXIS_PTS_REF SRL08LSUW /end AXIS_DESCR
/end CHARACTERISTIC
/begin CHARACTERISTIC KFLRSP3 "Kennfeld Reglerparameter p3 stetiger Lambdaregler" MAP 0xFD433A GkfWUw 127.9980 fak_uw_b128 0.00 127.9980 FORMAT "%8.4"
 /begin AXIS_DESCR COM_AXIS nmot_w nmot_uw_q0p25 7 0.00 16383.75 FORMAT "%8.2" AXIS_PTS_REF SNM07LSUW /end AXIS_DESCR
 /begin AXIS_DESCR COM_AXIS rl_w rel_uw_q0p0234 8 0.00 1535.977 FORMAT "%8.3" AXIS_PTS_REF SRL08LSUW /end AXIS_DESCR
/end CHARACTERISTIC
/begin CHARACTERISTIC KFLRSP4 "Kennfeld Reglerparameter p4 stetiger Lambdaregler" MAP 0xFD43AA GkfWSw 127.9980 fak_sw_b64 -64.00000 63.99805 FORMAT "%8.5"
 /begin AXIS_DESCR COM_AXIS nmot_w nmot_uw_q0p25 7 0.00 16383.75 FORMAT "%8.2" AXIS_PTS_REF SNM07LSUW /end AXIS_DESCR
 /begin AXIS_DESCR COM_AXIS rl_w rel_uw_q0p0234 8 0.00 1535.977 FORMAT "%8.3" AXIS_PTS_REF SRL08LSUW /end AXIS_DESCR
/end CHARACTERISTIC
/begin CHARACTERISTIC KFLRST "Kennfeld Streckentotzeit" MAP 0xFCC7B6 KfAxUwAyUwSstxUwSstyUwWUw 327.67000000 tz10msxs_uw_b327p68 0.010000000000 327.68000000 FORMAT "%12.8"
 /begin AXIS_DESCR STD_AXIS nmot_w nmot_uw_q0p25 7 0.00 16383.75 FORMAT "%8.2" DEPOSIT ABSOLUTE /end AXIS_DESCR
 /begin AXIS_DESCR STD_AXIS rl_w rel_uw_q0p0234 8 0.00 1535.977 FORMAT "%8.3" DEPOSIT ABSOLUTE /end AXIS_DESCR
/end CHARACTERISTIC
/begin CHARACTERISTIC KFLRSZ "Kennfeld Streckenzeitkonstante der LRS, 16-Bit" MAP 0xFCC848 KfAxUwAyUwSstxUwSstyUwWUw 655.34999985 zk10msxs_uw_b655 0.010000152590 655.36000000 FORMAT "%12.8"
 /begin AXIS_DESCR STD_AXIS nmot_w nmot_uw_q0p25 7 0.00 16383.75 FORMAT "%8.2" DEPOSIT ABSOLUTE /end AXIS_DESCR
 /begin AXIS_DESCR STD_AXIS rl_w rel_uw_q0p0234 8 0.00 1535.977 FORMAT "%8.3" DEPOSIT ABSOLUTE /end AXIS_DESCR
/end CHARACTERISTIC
/begin CHARACTERISTIC KFMIFALGD "Indiziertes Fahrerwunschmoment f¸r F¸llungspfad gedrosselt bei Lastschlagd." MAP 0xFD3796 KfAxUbAyUbSstxUbSstyUwWUw 99.99847 rel_uw_b100 0.00 99.99847 FORMAT "%8.5"
 /begin AXIS_DESCR STD_AXIS gangi dez 8 0.00 255.0 FORMAT "%5.1" DEPOSIT ABSOLUTE /end AXIS_DESCR
 /begin AXIS_DESCR STD_AXIS minbeg_w rel_uw_b100 8 0.00 99.99847 FORMAT "%8.5" DEPOSIT ABSOLUTE /end AXIS_DESCR
/end CHARACTERISTIC
/begin CHARACTERISTIC KFMIFALS "Indiziertes Fahrerwunschmoment f¸r F¸llungspfad bei Lastschlagd‰mpfung" MAP 0xFD3830 KfAxUbAyUbSstxUbSstyUwWUw 99.99847 rel_uw_b100 0.00 99.99847 FORMAT "%8.5"
 /begin AXIS_DESCR STD_AXIS gangi dez 8 0.00 255.0 FORMAT "%5.1" DEPOSIT ABSOLUTE /end AXIS_DESCR
 /begin AXIS_DESCR STD_AXIS minbeg_w rel_uw_b100 8 0.00 99.99847 FORMAT "%8.5" DEPOSIT ABSOLUTE /end AXIS_DESCR
/end CHARACTERISTIC
/begin CHARACTERISTIC KFMIFALSS "Indiziertes Fahrerwunschmoment f¸r F¸llungspfad bei Lastschlagd‰mpfung DS2" MAP 0xFD38CA KfAxUbAyUbSstxUbSstyUwWUw 99.99847 rel_uw_b100 0.00 99.99847 FORMAT "%8.5"
 /begin AXIS_DESCR STD_AXIS gangi dez 8 0.00 255.0 FORMAT "%5.1" DEPOSIT ABSOLUTE /end AXIS_DESCR
 /begin AXIS_DESCR STD_AXIS minbeg_w rel_uw_b100 8 0.00 99.99847 FORMAT "%8.5" DEPOSIT ABSOLUTE /end AXIS_DESCR
/end CHARACTERISTIC
/begin CHARACTERISTIC KFMILSD "Startwert indiziertes Moment f¸r Lastschlagd‰mpfung" MAP 0xFD3964 GkfWUw 98.99902 rel_uw_b100 0.9994507 99.99847 FORMAT "%8.5"
 /begin AXIS_DESCR COM_AXIS gangi dez 8 0.00 255.0 FORMAT "%5.1" AXIS_PTS_REF SGA08MDUB /end AXIS_DESCR
 /begin AXIS_DESCR COM_AXIS nmot_w nmot_uw_q0p25 6 0.00 16383.75 FORMAT "%8.2" AXIS_PTS_REF SNM06MDUW /end AXIS_DESCR
/end CHARACTERISTIC
/begin CHARACTERISTIC KFMIMR "Kennfeld fuer Momenten¸berhˆhung im Pedal¸berweg" MAP 0xFC9B9E KfAxUwAyUwSstxUwSstyUwWUw 199.9969 rel_uw_b200 0.00 199.9969 FORMAT "%8.4"
 /begin AXIS_DESCR STD_AXIS nmot_w nmot_uw_q0p25 16 0.00 16383.75 FORMAT "%8.2" DEPOSIT ABSOLUTE /end AXIS_DESCR
 /begin AXIS_DESCR STD_AXIS mrfag_w rel_uw_b200 6 0.00 199.9969 FORMAT "%8.4" DEPOSIT ABSOLUTE /end AXIS_DESCR
/end CHARACTERISTIC
/begin CHARACTERISTIC KFMIOP "Kennfeld optimales Motormoment" MAP 0xFC977C GkfWUw 99.99847 rel_uw_b100 0.00 99.99847 FORMAT "%8.5"
 /begin AXIS_DESCR COM_AXIS nmot_w nmot_uw_q0p25 16 0.00 16383.75 FORMAT "%8.2" AXIS_PTS_REF SNM16OPUW /end AXIS_DESCR
 /begin AXIS_DESCR COM_AXIS rl_w_kge rel_uw_q0p0234 16 0.00 1535.977 FORMAT "%8.3" AXIS_PTS_REF SRL16OPUW /end AXIS_DESCR
/end CHARACTERISTIC
/begin CHARACTERISTIC KFMIRL "Kennfeld f¸r Berechnung Sollf¸llung" MAP 0xFC5C40 KfAxUwAyUwSstxUwSstyUwWUw 1535.977 rel_uw_q0p0234 0.00 1535.977 FORMAT "%8.3"
 /begin AXIS_DESCR STD_AXIS nmot_w nmot_uw_q0p25 16 0.00 16383.75 FORMAT "%8.2" DEPOSIT ABSOLUTE /end AXIS_DESCR
 /begin AXIS_DESCR STD_AXIS misopl1_w rel_uw_b100 16 0.00 99.99847 FORMAT "%8.5" DEPOSIT ABSOLUTE /end AXIS_DESCR
/end CHARACTERISTIC
/begin CHARACTERISTIC KFMRMI "Kennfeld f¸r Momenten¸berhˆhung im Pedal¸berweg rel. in ind. Moment" MAP 0xFC9C8E KfAxUwAyUwSstxUwSstyUwWUw 175.5829 rel_uw_b200 24.41406 199.9969 FORMAT "%8.4"
 /begin AXIS_DESCR STD_AXIS nmot_w nmot_uw_q0p25 16 0.00 16383.75 FORMAT "%8.2" DEPOSIT ABSOLUTE /end AXIS_DESCR
 /begin AXIS_DESCR STD_AXIS fmil_w rel_uw_b200 6 0.00 199.9969 FORMAT "%8.4" DEPOSIT ABSOLUTE /end AXIS_DESCR
/end CHARACTERISTIC
/begin CHARACTERISTIC KFPED "Relatives Fahrerwunschmoment aus Fahrpedal" MAP 0xFC9D7E KfAxUwAyUwSstxUwSstyUwWUw 199.9969 rel_uw_b200 0.00 199.9969 FORMAT "%8.4"
 /begin AXIS_DESCR STD_AXIS wped_w relPED_uw_b100 16 0.00 100.0000 FORMAT "%8.4" DEPOSIT ABSOLUTE /end AXIS_DESCR
 /begin AXIS_DESCR STD_AXIS nmot_w nmot_uw_q0p25 8 0.00 16383.75 FORMAT "%8.2" DEPOSIT ABSOLUTE /end AXIS_DESCR
/end CHARACTERISTIC
/begin CHARACTERISTIC KFPEDS "Relatives Fahrerwunschmoment aus Fahrpedal f¸r Mode Sport" MAP 0xFC9EB2 KfAxUwAyUwSstxUwSstyUwWUw 199.9969 rel_uw_b200 0.00 199.9969 FORMAT "%8.4"
 /begin AXIS_DESCR STD_AXIS wped_w relPED_uw_b100 16 0.00 100.0000 FORMAT "%8.4" DEPOSIT ABSOLUTE /end AXIS_DESCR
 /begin AXIS_DESCR STD_AXIS nmot_w nmot_uw_q0p25 8 0.00 16383.75 FORMAT "%8.2" DEPOSIT ABSOLUTE /end AXIS_DESCR
/end CHARACTERISTIC
/begin CHARACTERISTIC KFRAT "F¸llungabh‰ngige Integrationsteigung f¸r FRAT" CURVE 0xFD21E4 KlAUbSstUbWUw 0.1999664 fak_uw_b5 0.00 0.1999664 FORMAT "%9.7"
 /begin AXIS_DESCR STD_AXIS dlrfrat fak_q0p0625 5 0.00 4095.938 FORMAT "%8.3" DEPOSIT ABSOLUTE /end AXIS_DESCR
/end CHARACTERISTIC
/begin CHARACTERISTIC KFRLMNN "Kennfeld minimale F¸llung" MAP 0xFD133E GkfWUb 191.3 rel_ub_q0p75 0.00 191.3 FORMAT "%5.1"
 /begin AXIS_DESCR COM_AXIS nmot nmot_ub_q40 12 0.00 10200. FORMAT "%5.0" AXIS_PTS_REF SNM12FEUB /end AXIS_DESCR
 /begin AXIS_DESCR COM_AXIS tmot temp_ub_q0p75_o48 4 -48.00 143.3 FORMAT "%5.1" AXIS_PTS_REF STM04FEUB /end AXIS_DESCR
/end CHARACTERISTIC
/begin CHARACTERISTIC KFRLMNNT "" MAP 0xFD136E GkfWUb 191.3 rel_ub_q0p75 0.00 191.3 FORMAT "%5.1"
 /begin AXIS_DESCR COM_AXIS nmot nmot_ub_q40 12 0.00 10200. FORMAT "%5.0" AXIS_PTS_REF SNM12FEUB /end AXIS_DESCR
 /begin AXIS_DESCR COM_AXIS tmot temp_ub_q0p75_o48 4 -48.00 143.3 FORMAT "%5.1" AXIS_PTS_REF STM04FEUB /end AXIS_DESCR
/end CHARACTERISTIC
/begin CHARACTERISTIC KFRLMNSAN "Kennfeld minimale F¸llung im Schub" MAP 0xFD139E GkfWUb 191.3 rel_ub_q0p75 0.00 191.3 FORMAT "%5.1"
 /begin AXIS_DESCR COM_AXIS nmot nmot_ub_q40 12 0.00 10200. FORMAT "%5.0" AXIS_PTS_REF SNM12FEUB /end AXIS_DESCR
 /begin AXIS_DESCR COM_AXIS tmot temp_ub_q0p75_o48 4 -48.00 143.3 FORMAT "%5.1" AXIS_PTS_REF STM04FEUB /end AXIS_DESCR
/end CHARACTERISTIC
/begin CHARACTERISTIC KFRLMNSANT "" MAP 0xFD13CE GkfWUb 191.3 rel_ub_q0p75 0.00 191.3 FORMAT "%5.1"
 /begin AXIS_DESCR COM_AXIS nmot nmot_ub_q40 12 0.00 10200. FORMAT "%5.0" AXIS_PTS_REF SNM12FEUB /end AXIS_DESCR
 /begin AXIS_DESCR COM_AXIS tmot temp_ub_q0p75_o48 4 -48.00 143.3 FORMAT "%5.1" AXIS_PTS_REF STM04FEUB /end AXIS_DESCR
/end CHARACTERISTIC
/begin CHARACTERISTIC KFUSHK "Sondenspannungssollwert f¸r Regelung hinter Kat. (statt KFUSRHK f¸r Variantenk.)" MAP 0xFD44E2 KfAxU8AyU8SstxU8SstyU8WU8 1.330 spg_ub_q0p0052_o0p2 -0.2000 1.130 FORMAT "%5.3"
 /begin AXIS_DESCR STD_AXIS nmot nmot_ub_q40 6 0.00 10200. FORMAT "%5.0" DEPOSIT ABSOLUTE /end AXIS_DESCR
 /begin AXIS_DESCR STD_AXIS rl rel_ub_q0p75 6 0.00 191.3 FORMAT "%5.1" DEPOSIT ABSOLUTE /end AXIS_DESCR
/end CHARACTERISTIC
/begin CHARACTERISTIC KFWMRFAG "Gang- und pedalwertabhaengiger Faktor fuer Fahrerwunsch mrfa_w" MAP 0xFD39C4 KfAxUbAyUbSstxUbSstyUwWUb 1.000 fak_ub_q0p00392 0.00 1.000 FORMAT "%5.3"
 /begin AXIS_DESCR STD_AXIS gangi dez 8 0.00 255.0 FORMAT "%5.1" DEPOSIT ABSOLUTE /end AXIS_DESCR
 /begin AXIS_DESCR STD_AXIS wped_w relPED_uw_b100 4 0.00 100.0000 FORMAT "%8.4" DEPOSIT ABSOLUTE /end AXIS_DESCR
/end CHARACTERISTIC
/begin CHARACTERISTIC KFWMRFAV "Geschwindigkeits- und pedalwertabhaengiger Faktor fuer Fahrerwunsch mrfa_w" MAP 0xFC9AA0 KfAxUbAyUbSstxUwSstyUwWUw 0.9999847 fak_uw_b1 0.00 0.9999847 FORMAT "%9.7"
 /begin AXIS_DESCR STD_AXIS vfzgk_w vfzg_uw_b512 4 0.00 511.9922 FORMAT "%8.4" DEPOSIT ABSOLUTE /end AXIS_DESCR
 /begin AXIS_DESCR STD_AXIS wped_w relPED_uw_b100 4 0.00 100.0000 FORMAT "%8.4" DEPOSIT ABSOLUTE /end AXIS_DESCR
/end CHARACTERISTIC
/begin CHARACTERISTIC KFWPFGR "Inverses Pedalkennfeld f¸r FGR-Betrieb" MAP 0xFD39F6 KfAxUwAyUwSstxUwSstyUwWUw 99.99847 rel_uw_b100 0.00 99.99847 FORMAT "%8.5"
 /begin AXIS_DESCR STD_AXIS mrfgr_w rel_uw_b200 16 0.00 199.9969 FORMAT "%8.4" DEPOSIT ABSOLUTE /end AXIS_DESCR
 /begin AXIS_DESCR STD_AXIS nmot_w nmot_uw_q0p25 8 0.00 16383.75 FORMAT "%8.2" DEPOSIT ABSOLUTE /end AXIS_DESCR
/end CHARACTERISTIC
/begin CHARACTERISTIC KFZDASH "Zeitkonstante PT1-Filter Dashpot" MAP 0xFD3B2A GkfWUw 1.9880486279 zk10msxs_uw_b655 0.010000152590 1.9980487805 FORMAT "%12.10"
 /begin AXIS_DESCR COM_AXIS gangi dez 8 0.00 255.0 FORMAT "%5.1" AXIS_PTS_REF SGA08MDUB /end AXIS_DESCR
 /begin AXIS_DESCR COM_AXIS nmot_w nmot_uw_q0p25 6 0.00 16383.75 FORMAT "%8.2" AXIS_PTS_REF SNM06MDUW /end AXIS_DESCR
/end CHARACTERISTIC
/begin CHARACTERISTIC KFZDASHQ "" MAP 0xFD3B8A GkfWUw 1.9880486279 zk10msxs_uw_b655 0.010000152590 1.9980487805 FORMAT "%12.10"
 /begin AXIS_DESCR COM_AXIS gangi dez 8 0.00 255.0 FORMAT "%5.1" AXIS_PTS_REF SGA08MDUB /end AXIS_DESCR
 /begin AXIS_DESCR COM_AXIS nmot_w nmot_uw_q0p25 6 0.00 16383.75 FORMAT "%8.2" AXIS_PTS_REF SNM06MDUW /end AXIS_DESCR
/end CHARACTERISTIC
/begin CHARACTERISTIC KFZDASHS "Zeitkonstante PT1-Filter Dashpot Sport Modus" MAP 0xFD3BEA GkfWUw 1.9880486279 zk10msxs_uw_b655 0.010000152590 1.9980487805 FORMAT "%12.10"
 /begin AXIS_DESCR COM_AXIS gangi dez 8 0.00 255.0 FORMAT "%5.1" AXIS_PTS_REF SGA08MDUB /end AXIS_DESCR
 /begin AXIS_DESCR COM_AXIS nmot_w nmot_uw_q0p25 6 0.00 16383.75 FORMAT "%8.2" AXIS_PTS_REF SNM06MDUW /end AXIS_DESCR
/end CHARACTERISTIC
/begin CHARACTERISTIC KFZLSD "Zeitkonstante PT2-Filter Lastschlagd‰mpfung" MAP 0xFD3C4A GkfWUw 1.9880486279 zk10msxs_uw_b655 0.010000152590 1.9980487805 FORMAT "%12.10"
 /begin AXIS_DESCR COM_AXIS gangi dez 8 0.00 255.0 FORMAT "%5.1" AXIS_PTS_REF SGA08MDUB /end AXIS_DESCR
 /begin AXIS_DESCR COM_AXIS nmot_w nmot_uw_q0p25 6 0.00 16383.75 FORMAT "%8.2" AXIS_PTS_REF SNM06MDUW /end AXIS_DESCR
/end CHARACTERISTIC
/begin CHARACTERISTIC KFZLSDQ "" MAP 0xFD3CAA GkfWUw 1.9880486279 zk10msxs_uw_b655 0.010000152590 1.9980487805 FORMAT "%12.10"
 /begin AXIS_DESCR COM_AXIS gangi dez 8 0.00 255.0 FORMAT "%5.1" AXIS_PTS_REF SGA08MDUB /end AXIS_DESCR
 /begin AXIS_DESCR COM_AXIS nmot_w nmot_uw_q0p25 6 0.00 16383.75 FORMAT "%8.2" AXIS_PTS_REF SNM06MDUW /end AXIS_DESCR
/end CHARACTERISTIC
/begin CHARACTERISTIC KFZLSDS "Zeitkonstante PT2-Filter Lastschlagd‰mpfung bei Datensatz 2" MAP 0xFD3D0A GkfWUw 1.9880486279 zk10msxs_uw_b655 0.010000152590 1.9980487805 FORMAT "%12.10"
 /begin AXIS_DESCR COM_AXIS gangi dez 8 0.00 255.0 FORMAT "%5.1" AXIS_PTS_REF SGA08MDUB /end AXIS_DESCR
 /begin AXIS_DESCR COM_AXIS nmot_w nmot_uw_q0p25 6 0.00 16383.75 FORMAT "%8.2" AXIS_PTS_REF SNM06MDUW /end AXIS_DESCR
/end CHARACTERISTIC
/begin CHARACTERISTIC KFZLSDWE "" MAP 0xFD3D6A GkfWUw 1.9880486279 zk10msxs_uw_b655 0.010000152590 1.9980487805 FORMAT "%12.10"
 /begin AXIS_DESCR COM_AXIS gangi dez 8 0.00 255.0 FORMAT "%5.1" AXIS_PTS_REF SGA08MDUB /end AXIS_DESCR
 /begin AXIS_DESCR COM_AXIS nmot_w nmot_uw_q0p25 6 0.00 16383.75 FORMAT "%8.2" AXIS_PTS_REF SNM06MDUW /end AXIS_DESCR
/end CHARACTERISTIC
/begin CHARACTERISTIC KFZWOP "optimaler Z¸ndwinkel" MAP 0xFC934E GkfWSb 191.3 zw_sb_q0p75 -96.00 95.25 FORMAT "%5.2"
 /begin AXIS_DESCR COM_AXIS nmot_w nmot_uw_q0p25 16 0.00 16383.75 FORMAT "%8.2" AXIS_PTS_REF SNM16OPUW /end AXIS_DESCR
 /begin AXIS_DESCR COM_AXIS rl_w_kge rel_uw_q0p0234 16 0.00 1535.977 FORMAT "%8.3" AXIS_PTS_REF SRL16OPUW /end AXIS_DESCR
/end CHARACTERISTIC
/begin CHARACTERISTIC KFZWOP2 "optimaler Z¸ndwinkel Variante 2" MAP 0xFC944E GkfWSb 191.3 zw_sb_q0p75 -96.00 95.25 FORMAT "%5.2"
 /begin AXIS_DESCR COM_AXIS nmot_w nmot_uw_q0p25 16 0.00 16383.75 FORMAT "%8.2" AXIS_PTS_REF SNM16OPUW /end AXIS_DESCR
 /begin AXIS_DESCR COM_AXIS rl_w_kge rel_uw_q0p0234 16 0.00 1535.977 FORMAT "%8.3" AXIS_PTS_REF SRL16OPUW /end AXIS_DESCR
/end CHARACTERISTIC
/begin CHARACTERISTIC KFZWOPLL "optimaler Z¸ndwinkel im Leerlauf" MAP 0xFC9248 KfAxU8AyU8SstxU8SstyU8WS8 191.3 zw_sb_q0p75 -96.00 95.25 FORMAT "%5.2"
 /begin AXIS_DESCR STD_AXIS nmot nmot_ub_q40 8 0.00 10200. FORMAT "%5.0" DEPOSIT ABSOLUTE /end AXIS_DESCR
 /begin AXIS_DESCR STD_AXIS rl_kge rel_ub_q0p75 5 0.00 191.3 FORMAT "%5.1" DEPOSIT ABSOLUTE /end AXIS_DESCR
/end CHARACTERISTIC
/begin CHARACTERISTIC KFZWOPLLT "optimaler Z¸ndwinkel im Leerlauf (VVT)" MAP 0xFC927F KfAxU8AyU8SstxU8SstyU8WS8 191.3 zw_sb_q0p75 -96.00 95.25 FORMAT "%5.2"
 /begin AXIS_DESCR STD_AXIS nmot nmot_ub_q40 8 0.00 10200. FORMAT "%5.0" DEPOSIT ABSOLUTE /end AXIS_DESCR
 /begin AXIS_DESCR STD_AXIS rl_kge rel_ub_q0p75 5 0.00 191.3 FORMAT "%5.1" DEPOSIT ABSOLUTE /end AXIS_DESCR
/end CHARACTERISTIC
/begin CHARACTERISTIC KILRHKML "I-Anteil fuer stetige LRHK" CURVE 0xFD4498 GklWU16 4.999847 fak_sw_b5 0.00 4.999847 FORMAT "%8.6"
 /begin AXIS_DESCR COM_AXIS ml m_ub_b1020 8 0.00 1020. FORMAT "%5.0" AXIS_PTS_REF SML08LHUB /end AXIS_DESCR
/end CHARACTERISTIC
/begin CHARACTERISTIC KLFDASH "" CURVE 0xFD3DCA KlAUwSstUwWUw 0.9999847 fak_uw_b1 0.00 0.9999847 FORMAT "%9.7"
 /begin AXIS_DESCR STD_AXIS bfzgqars_w bfzg_q0p025 6 0.00 1638.375 FORMAT "%8.3" DEPOSIT ABSOLUTE /end AXIS_DESCR
/end CHARACTERISTIC
/begin CHARACTERISTIC KLFLSD "" CURVE 0xFD3DE4 KlAUwSstUwWUw 0.9999847 fak_uw_b1 0.00 0.9999847 FORMAT "%9.7"
 /begin AXIS_DESCR STD_AXIS bfzgqars_w bfzg_q0p025 6 0.00 1638.375 FORMAT "%8.3" DEPOSIT ABSOLUTE /end AXIS_DESCR
/end CHARACTERISTIC
/begin CHARACTERISTIC KLFMAUS "" CURVE 0xFD3DFE KlAUbSstUbWUw 511.9922 vfzg_uw_b512 0.00 511.9922 FORMAT "%8.4"
 /begin AXIS_DESCR STD_AXIS gangi dez 6 0.00 255.0 FORMAT "%5.1" DEPOSIT ABSOLUTE /end AXIS_DESCR
/end CHARACTERISTIC
/begin CHARACTERISTIC KLFMKNUL "Kennlinie Faktor Kupplungsmoment 0" CURVE 0xFD3E12 GklWUw 1.999939 fak_uw_b2 0.00003051758 1.999969 FORMAT "%8.6"
 /begin AXIS_DESCR COM_AXIS mkfanb_w rel_sw_b100 6 -100.0000 99.99695 FORMAT "%8.4" AXIS_PTS_REF SMK06MDUW /end AXIS_DESCR
/end CHARACTERISTIC
/begin CHARACTERISTIC KLFOSCHKAX "Abgasmassenschwelle f¸r Einschaltbereitschaft LRSHK I-Anteil" CURVE 0xFD45CC KlAxU8SstxU8WU16 7281.667 m_uw_b7281 0.00 7281.667 FORMAT "%8.3"
 /begin AXIS_DESCR STD_AXIS fcoschk fak_ub_b2 5 0.00 1.992 FORMAT "%5.3" DEPOSIT ABSOLUTE /end AXIS_DESCR
/end CHARACTERISTIC
/begin CHARACTERISTIC KLFWUELL "Umrechnung von Summenverh‰ltnis der Spreizungen in zwopt LL-Gewichtung" CURVE 0xFC954E KlAUbSstUbWUb 0.9961 fak_ub_b1 0.00 0.9961
 /begin AXIS_DESCR STD_AXIS fwuell fak_ub_b2 6 0.00 1.992 FORMAT "%5.3" DEPOSIT ABSOLUTE /end AXIS_DESCR
/end CHARACTERISTIC
/begin CHARACTERISTIC KLH2DUSH "Delta Spannungsoffset  = f(H2-Konzentration) f¸r Sonde hinter Kat" CURVE 0xFD4558 KlAxU8SstxU8WU8 1.330 spg_ub_q0p0052_o0p2 -0.2000 1.130 FORMAT "%5.3"
 /begin AXIS_DESCR STD_AXIS h2concb m_q8p0_ppm 4 0.00 2040. FORMAT "%5.0" DEPOSIT ABSOLUTE /end AXIS_DESCR
/end CHARACTERISTIC
/begin CHARACTERISTIC KLH2FCOSC "alterungsbedingte Abnahme der H2-Konzentration = f(fcoschk(2))" CURVE 0xFD4561 KlAxU8SstxU8WU8 0.9961 fak_ub_b1 0.00 0.9961
 /begin AXIS_DESCR STD_AXIS fcoschk fak_ub_b2 4 0.00 1.992 FORMAT "%5.3" DEPOSIT ABSOLUTE /end AXIS_DESCR
/end CHARACTERISTIC
/begin CHARACTERISTIC KLTWEMEMO "Zeitbegr. Umschaltung LSD bei Wiedereinsetzen" CURVE 0xFD36A0 GklWUb 2.550 t10msxs_ub_b2p55 0.00 2.550 FORMAT "%5.3"
 /begin AXIS_DESCR COM_AXIS nmot_w nmot_uw_q0p25 6 0.00 16383.75 FORMAT "%8.2" AXIS_PTS_REF SNM06MDUW /end AXIS_DESCR
/end CHARACTERISTIC
/begin CHARACTERISTIC KLTWEMEMO2 "Zeitbegr. Umschaltung LSD bei Wiedereinsetzen f¸r Leerlauf" CURVE 0xFD36A6 GklWUb 2.550 t10msxs_ub_b2p55 0.00 2.550 FORMAT "%5.3"
 /begin AXIS_DESCR COM_AXIS nmot_w nmot_uw_q0p25 6 0.00 16383.75 FORMAT "%8.2" AXIS_PTS_REF SNM06MDUW /end AXIS_DESCR
/end CHARACTERISTIC
/begin CHARACTERISTIC KPLRHML "P-Anteil fuer stetige LRHK" CURVE 0xFD44A8 GklWU8 3.984 fak_ub_b4 0.00 3.984 FORMAT "%5.3"
 /begin AXIS_DESCR COM_AXIS ml m_ub_b1020 8 0.00 1020. FORMAT "%5.0" AXIS_PTS_REF SML08LHUB /end AXIS_DESCR
/end CHARACTERISTIC
/begin CHARACTERISTIC LADIFFTHR "Schwelle f¸r Lambda-Differenz f¸r LRS Reset bei Magerschutz" VALUE 0xFCC8DA KwSw 1.999969 fak_sw_b1 -1.000000 0.9999695 FORMAT "%8.6" /end CHARACTERISTIC
/begin CHARACTERISTIC LAKAMSAIML "Lambdasollwert f¸r Katalysator-Ausr‰umen (abh‰ngig von Abgasmasse und Fettfl.)" MAP 0xFD4608 KfAxU8AyU8SstxU16SstyU16WU16 1.000000 fak_uw_b16 0.00 1.000000 FORMAT "%8.6"
 /begin AXIS_DESCR STD_AXIS msabvhk_w m_uw_b6553p5 5 0.00 6553.500 FORMAT "%8.3" DEPOSIT ABSOLUTE /end AXIS_DESCR
 /begin AXIS_DESCR STD_AXIS imslaka_w m_uw_b291p25 5 0.00 291.2667 FORMAT "%8.4" DEPOSIT ABSOLUTE /end AXIS_DESCR
/end CHARACTERISTIC
/begin CHARACTERISTIC LALIUSHK "Lambdalinearisierung, Sonde hinter Katalysator, Quantisierung 0...<2" CURVE 0xFCC964 KlAxU8SstxU16WU16 1.999969 fak_uw_b2 0.00 1.999969 FORMAT "%8.6"
 /begin AXIS_DESCR STD_AXIS usrhk_w spg_uw_q0p00488_o1 10 -1.000000 318.9951 FORMAT "%8.4" DEPOSIT ABSOLUTE /end AXIS_DESCR
/end CHARACTERISTIC
/begin CHARACTERISTIC LALIUSHK2 "Lambdalinearisierung, Sonde hinter Katalysator, Quantisierung 0...<2, Bank 2" CURVE 0xFCC98E KlAxU8SstxU16WU16 1.999969 fak_uw_b2 0.00 1.999969 FORMAT "%8.6"
 /begin AXIS_DESCR STD_AXIS usrhk2_w spg_uw_q0p00488_o1 10 -1.000000 318.9951 FORMAT "%8.4" DEPOSIT ABSOLUTE /end AXIS_DESCR
/end CHARACTERISTIC
/begin CHARACTERISTIC LALIUSMN "minimales messbares Lambda" VALUE 0xFCC8DC KwUw 15.99976 fak_uw_b16 0.00 15.99976 FORMAT "%8.5" /end CHARACTERISTIC
/begin CHARACTERISTIC LAMBRSMN "Lambda-Schwelle Min. f¸r Auslˆsung Sperre I-Anteil" VALUE 0xFD45E4 KwWU16 15.99976 fak_uw_b16 0.00 15.99976 FORMAT "%8.5" /end CHARACTERISTIC
/begin CHARACTERISTIC LAMBRSMX "Lambda-Schwelle Max. f¸r Auslˆsung Sperre I-Anteil" VALUE 0xFD45E6 KwWU16 15.99976 fak_uw_b16 0.00 15.99976 FORMAT "%8.5" /end CHARACTERISTIC
/begin CHARACTERISTIC LAMKADEF "Defaultwert Lambda f¸r Katausr‰umen inaktiv" VALUE 0xFD4690 KwWU16 15.99976 fak_uw_b16 0.00 15.99976 FORMAT "%8.5" /end CHARACTERISTIC
/begin CHARACTERISTIC LAMLRAMN "minimale Lambda-Schwelle, bei der die Gemischadaption aktiv sein kann" VALUE 0xFD2264 KwUw 15.99976 fak_uw_b16 0.00 15.99976 FORMAT "%8.5" /end CHARACTERISTIC
/begin CHARACTERISTIC LAMLRAMX "maximale Lambda-Schwelle, bei der die Gemischadaption aktiv sein kann" VALUE 0xFD2266 KwUw 15.99976 fak_uw_b16 0.00 15.99976 FORMAT "%8.5" /end CHARACTERISTIC
/begin CHARACTERISTIC LAMSKAMX "Lambda-Ist vor Kat f¸r Erkennung Magerbedingung Kat-Ausr‰umen" VALUE 0xFD4692 KwWU16 15.99976 fak_uw_b16 0.00 15.99976 FORMAT "%8.5" /end CHARACTERISTIC
/begin CHARACTERISTIC LAMSKAMX2 "Lambda-Ist vor Kat f¸r Erkennung Magerbedingung Kat-Ausr‰umen, Bank2" VALUE 0xFD4694 KwWU16 15.99976 fak_uw_b16 0.00 15.99976 FORMAT "%8.5" /end CHARACTERISTIC
/begin CHARACTERISTIC LASHKAB "Startwert f¸r dynamische Sollwertanhebung (lamsolh) in der LRHK" VALUE 0xFCC9B8 KwWS16 1.999969 fak_sw_b1 -1.000000 0.9999695 FORMAT "%8.6" /end CHARACTERISTIC
/begin CHARACTERISTIC LASHKAB2 "Startwert f¸r dynamische Sollwertanhebung (lamsolh) in der LRHK, Bank 2" VALUE 0xFCC9BA KwWS16 1.999969 fak_sw_b1 -1.000000 0.9999695 FORMAT "%8.6" /end CHARACTERISTIC
/begin CHARACTERISTIC LRHIMN "minimale Integratorgrenze der stetigen LRHK" VALUE 0xFD4590 KwWS16 1.999969 fak_sw_b1 -1.000000 0.9999695 FORMAT "%8.6" /end CHARACTERISTIC
/begin CHARACTERISTIC LRHIMX "maximale Integratorgrenze der stetigen LRHK" VALUE 0xFD4592 KwWS16 1.999969 fak_sw_b1 -1.000000 0.9999695 FORMAT "%8.6" /end CHARACTERISTIC
/begin CHARACTERISTIC LRSGKTM "Korrekturkennlinie der Reglerparameter bei tiefen Motortemperaturen" CURVE 0xFD40FD KlAUbSstUbWUb 1.992 fak_ub_b2 0.00 1.992 FORMAT "%5.3"
 /begin AXIS_DESCR STD_AXIS tmot temp_ub_q0p75_o48 6 -48.00 143.3 FORMAT "%5.1" DEPOSIT ABSOLUTE /end AXIS_DESCR
/end CHARACTERISTIC
/begin CHARACTERISTIC LRSTPZA "Periodendauer der LRS-Zwangsamplitude" VALUE 0xFCC8DE KwUw 655.3500 t10msxs_uw_b655p35 0.00 655.3500 FORMAT "%8.4" /end CHARACTERISTIC
/begin CHARACTERISTIC LRSZAWML "Kennlinie Amplitude der LRS-Zwangsamplitude" CURVE 0xFCC8E0 KlAUwSstUwWUb 0.249023438 fak_ub_b0p25 0.00 0.249023438 FORMAT "%11.9"
 /begin AXIS_DESCR STD_AXIS ml_w m_uw_b6553p5 6 0.00 6553.500 FORMAT "%8.3" DEPOSIT ABSOLUTE /end AXIS_DESCR
/end CHARACTERISTIC
/begin CHARACTERISTIC MDHYEZ "Momenten-Hysterese bei Entscheidung der Zylinderausblendung" VALUE 0xFCA07F KwUb 99.61 rel_ub_b99p6 0.00 99.61 FORMAT "%5.2" /end CHARACTERISTIC
/begin CHARACTERISTIC MDHYST "Hysterese bei der Begrenzung des Sollmoments (Ebene 1 ‹berwachungskonzept)" VALUE 0xFCA034 KwUw 99.99847 rel_uw_b100 0.00 99.99847 FORMAT "%8.5" /end CHARACTERISTIC
/begin CHARACTERISTIC MIHGSLG "Drehmomentbegrenzung f¸r Schaltgetriebeschutz" CURVE 0xFD3617 KlAUbSstUbWUb 99.61 rel_ub_b99p6 0.00 99.61 FORMAT "%5.2"
 /begin AXIS_DESCR STD_AXIS gangi dez 7 0.00 255.0 FORMAT "%5.1" DEPOSIT ABSOLUTE /end AXIS_DESCR
/end CHARACTERISTIC
/begin CHARACTERISTIC MIHTOEL "variable Momentenbegrenzung bei kritisch hoher Oeltemperatur" CURVE 0xFD362E KlAUwSstUwWUw 99.99847 rel_uw_b100 0.00 99.99847 FORMAT "%8.5"
 /begin AXIS_DESCR STD_AXIS nmot_w nmot_uw_q0p25 6 0.00 16383.75 FORMAT "%8.2" DEPOSIT ABSOLUTE /end AXIS_DESCR
/end CHARACTERISTIC
/begin CHARACTERISTIC MKBRMXWP "Maximal zul‰ssiges Kupplungsmoment bei bet‰tigter Bremse" CURVE 0xFD3648 KlAUwSstUwWUw 99.99847 rel_uw_b100 0.00 99.99847 FORMAT "%8.5"
 /begin AXIS_DESCR STD_AXIS wped_w relPED_uw_b100 8 0.00 100.0000 FORMAT "%8.4" DEPOSIT ABSOLUTE /end AXIS_DESCR
/end CHARACTERISTIC
/begin CHARACTERISTIC MKLSDUGA "Kupplungsmoment-Schwelle f¸r Parameterumschaltung LSD gangabh‰ngig" CURVE 0xFD3E1E GklWSw 199.9969 rel_sw_b100 -100.0000 99.99695 FORMAT "%8.4"
 /begin AXIS_DESCR COM_AXIS gangi dez 8 0.00 255.0 FORMAT "%5.1" AXIS_PTS_REF SGA08MDUB /end AXIS_DESCR
/end CHARACTERISTIC
/begin CHARACTERISTIC MKPBREMSMX "Maximal  Kupplungsmoment in Abh‰ngigkeit vom Bremsdruck" CURVE 0xFD366A KlAUbSstUbWUw 99.99847 rel_uw_b100 0.00 99.99847 FORMAT "%8.5"
 /begin AXIS_DESCR STD_AXIS pbrems dez 8 0.00 255.0 FORMAT "%5.1" DEPOSIT ABSOLUTE /end AXIS_DESCR
/end CHARACTERISTIC
/begin CHARACTERISTIC MLO1 "obere Luftmengenschwelle Bereich 1" VALUE 0xFD21F4 KwUw 6553.500 m_uw_b6553p5 0.00 6553.500 FORMAT "%8.3" /end CHARACTERISTIC
/begin CHARACTERISTIC MLO1AC "obere Luftmengenschwelle Bereich 1 mit Kompressor" VALUE 0xFD21F6 KwUw 6553.500 m_uw_b6553p5 0.00 6553.500 FORMAT "%8.3" /end CHARACTERISTIC
/begin CHARACTERISTIC MLO2 "obere Luftmengenschwelle Bereich 2" VALUE 0xFC76A2 KwUw 6553.500 m_uw_b6553p5 0.00 6553.500 FORMAT "%8.3" /end CHARACTERISTIC
/begin CHARACTERISTIC MLO3 "obere Luftmengenschwelle Bereich 3" VALUE 0xFD21F8 KwUw 6553.500 m_uw_b6553p5 0.00 6553.500 FORMAT "%8.3" /end CHARACTERISTIC
/begin CHARACTERISTIC MLO3AC "obere Luftmengenschwelle Bereich 3 mit Kompressor" VALUE 0xFD21FA KwUw 6553.500 m_uw_b6553p5 0.00 6553.500 FORMAT "%8.3" /end CHARACTERISTIC
/begin CHARACTERISTIC MLU2 "untere Luftmengenschwelle Bereich 2" VALUE 0xFD21FC KwUw 6553.500 m_uw_b6553p5 0.00 6553.500 FORMAT "%8.3" /end CHARACTERISTIC
/begin CHARACTERISTIC MLU2AC "untere Luftmengenschwelle Bereich 2 mit Kompressor" VALUE 0xFD21FE KwUw 6553.500 m_uw_b6553p5 0.00 6553.500 FORMAT "%8.3" /end CHARACTERISTIC
/begin CHARACTERISTIC MLU2FA "untere Luftmengenschwelle bei Funktionsanforderung B_faan Bereich 2" VALUE 0xFD2200 KwUw 6553.500 m_uw_b6553p5 0.00 6553.500 FORMAT "%8.3" /end CHARACTERISTIC
/begin CHARACTERISTIC MLU4 "untere Luftmengenschwelle Bereich 4" VALUE 0xFC76A4 KwUw 6553.500 m_uw_b6553p5 0.00 6553.500 FORMAT "%8.3" /end CHARACTERISTIC
/begin CHARACTERISTIC MLU4AC "untere Luftmengenschwelle Bereich 4 mit Kompressor" VALUE 0xFC76A6 KwUw 6553.500 m_uw_b6553p5 0.00 6553.500 FORMAT "%8.3" /end CHARACTERISTIC
/begin CHARACTERISTIC MRFALLO "Obere Leerlaufschwelle des relativen Fahrerwunschmoments" VALUE 0xFC9FE6 KwUw 199.9969 rel_uw_b200 0.00 199.9969 FORMAT "%8.4" /end CHARACTERISTIC
/begin CHARACTERISTIC MRFALLU "Untere Leerlaufschwelle des relativen Fahrerwunschmoments" VALUE 0xFC9FE8 KwUw 199.9969 rel_uw_b200 0.00 199.9969 FORMAT "%8.4" /end CHARACTERISTIC
/begin CHARACTERISTIC MRFUEMXN "Kennlinie max. ereichbares Fahrerwunschmoment f¸r Pedal¸berweg" CURVE 0xFC9FEA KlAUwSstUwWUw 199.9969 rel_uw_b200 0.00 199.9969 FORMAT "%8.4"
 /begin AXIS_DESCR STD_AXIS nmot_w nmot_uw_q0p25 6 0.00 16383.75 FORMAT "%8.2" DEPOSIT ABSOLUTE /end AXIS_DESCR
/end CHARACTERISTIC
/begin CHARACTERISTIC N0 "Umrechnungskonstante f¸r Einrechnung Gemischkorrektur rkat" VALUE 0xFC769F KwUb 10200. nmot_ub_q40 0.00 10200. FORMAT "%5.0" /end CHARACTERISTIC
/begin CHARACTERISTIC NASNOT "Drehzahlschwelle f¸r ASR-Verbot wegen Abw¸rgeschutz" VALUE 0xFCA026 KwUb 2560. nmot_ub_q40 0.00 2560. FORMAT "%5.0" /end CHARACTERISTIC
/begin CHARACTERISTIC NGFSAWE "Schwelle Drehzahlgradient f¸r Sperrung Filter SA/WE" VALUE 0xFCA004 KwSw 25599.94 nmotg_sw_q0p39 -12800.16 12799.77 FORMAT "%8.2" /end CHARACTERISTIC
/begin CHARACTERISTIC NGHGS "Drehzahlgradient f¸r gangabh‰ngige Momentenbegrenzung" VALUE 0xFD3684 KwSw 25599.94 nmotg_sw_q0p39 -12800.16 12799.77 FORMAT "%8.2" /end CHARACTERISTIC
/begin CHARACTERISTIC NKUPZWEO "Obere Drehzahl-Hytereseschwelle f¸r KUP-ZW-Eingriffe" VALUE 0xFCA027 KwUb 10200. nmot_ub_q40 0.00 10200. FORMAT "%5.0" /end CHARACTERISTIC
/begin CHARACTERISTIC NKUPZWEU "Untere Drehzahl-Hytereseschwelle f¸r KUP-ZW-Eingriffe" VALUE 0xFCA028 KwUb 10200. nmot_ub_q40 0.00 10200. FORMAT "%5.0" /end CHARACTERISTIC
/begin CHARACTERISTIC NLLZWEO "Obere  Drehzahl-Hytereseschwelle f¸r LL-ZW-Eingriffe" VALUE 0xFCA029 KwUb 10200. nmot_ub_q40 0.00 10200. FORMAT "%5.0" /end CHARACTERISTIC
/begin CHARACTERISTIC NLLZWEU "Untere Drehzahl-Hytereseschwelle f¸r LL-ZW-Eingriffe" VALUE 0xFCA02A KwUb 10200. nmot_ub_q40 0.00 10200. FORMAT "%5.0" /end CHARACTERISTIC
/begin CHARACTERISTIC NLRHO "obere Drehzahlgrenze f¸r Regelung hinter Kat" VALUE 0xFD4601 KwWU8 10200. nmot_ub_q40 0.00 10200. FORMAT "%5.0" /end CHARACTERISTIC
/begin CHARACTERISTIC NLRHU "untere Drehzahlgrenze f¸r Regelung hinter Kat" VALUE 0xFD4602 KwWU8 10200. nmot_ub_q40 0.00 10200. FORMAT "%5.0" /end CHARACTERISTIC
/begin CHARACTERISTIC NLRKA "Drehzahlschwelle f¸r Unterdr¸cken gesteuertes Kat-Ausr‰umen" VALUE 0xFD46A5 KwWU8 10200. nmot_ub_q40 0.00 10200. FORMAT "%5.0" /end CHARACTERISTIC
/begin CHARACTERISTIC NLRSHB "Drehzahlschwelle, Abschalten LR bei Schub, in Verbindung mit LL und TLLRSHB" VALUE 0xFCC905 KwUb 10200. nmot_ub_q40 0.00 10200. FORMAT "%5.0" /end CHARACTERISTIC
/begin CHARACTERISTIC NLSDZWEO "Obere Drehzahl-Hytereseschwelle f¸r LSD-ZW-Eingriffe" VALUE 0xFCA02B KwUb 10200. nmot_ub_q40 0.00 10200. FORMAT "%5.0" /end CHARACTERISTIC
/begin CHARACTERISTIC NLSDZWEU "Untere Drehzahl-Hytereseschwelle f¸r LSD-ZW-Eingriffe" VALUE 0xFCA02C KwUb 10200. nmot_ub_q40 0.00 10200. FORMAT "%5.0" /end CHARACTERISTIC
/begin CHARACTERISTIC NMDSTAOF "Drehzahloffset auf Wiedereinsetzdrehzahl f¸r Momentenberechnung" VALUE 0xFC8B36 KwUb 10200. nmot_ub_q40 0.00 10200. FORMAT "%5.0" /end CHARACTERISTIC
/begin CHARACTERISTIC NO1 "obere Drehzahlschwelle Bereich 1" VALUE 0xFD21D4 KwUb 10200. nmot_ub_q40 0.00 10200. FORMAT "%5.0" /end CHARACTERISTIC
/begin CHARACTERISTIC NO2 "obere Drehzahlschwelle Bereich 2" VALUE 0xFD21D5 KwUb 10200. nmot_ub_q40 0.00 10200. FORMAT "%5.0" /end CHARACTERISTIC
/begin CHARACTERISTIC NOLRA "Codewort f¸r Adaptionsfreigabe" VALUE 0xFD21D6 KwUb 255.0 dez 0.00 255.0 FORMAT "%5.1" /end CHARACTERISTIC
/begin CHARACTERISTIC NRKAB "Mindestdrehzahl f¸r Begrenzung Stelleingriff rkat bei niedrigen Drehzahlen" VALUE 0xFC76A0 KwUb 10200. nmot_ub_q40 0.00 10200. FORMAT "%5.0" /end CHARACTERISTIC
/begin CHARACTERISTIC NU2 "untere Drehzahlschwelle Bereich 2" VALUE 0xFD21D7 KwUb 10200. nmot_ub_q40 0.00 10200. FORMAT "%5.0" /end CHARACTERISTIC
/begin CHARACTERISTIC NU3 "untere Drehzahlschwelle Bereich 3" VALUE 0xFD21D8 KwUb 10200. nmot_ub_q40 0.00 10200. FORMAT "%5.0" /end CHARACTERISTIC
/begin CHARACTERISTIC NVLSUMRSMX "Max. Anzahl von Starts mit tmst > TMOTMRSMX und gesetzter Verdachtbed. B_vlsumrs" VALUE 0xFD046B KwUb 255.0 dez 0.00 255.0 FORMAT "%5.1" /end CHARACTERISTIC
/begin CHARACTERISTIC PBREMSMX "Bremsdruck-Schwelle f¸r Freigabe Momentenbegrenzung" VALUE 0xFD3626 KwUb 255.0 dez 0.00 255.0 FORMAT "%5.1" /end CHARACTERISTIC
/begin CHARACTERISTIC PLRHFOSC "Wichtungsfaktor des P-Anteils in der LRHK ¸ber KAT-Alterung = f(fcoschk)" CURVE 0xFD456A KlAxU8SstxU8WU8 0.9961 fak_ub_b1 0.00 0.9961
 /begin AXIS_DESCR STD_AXIS fcoschk fak_ub_b2 8 0.00 1.992 FORMAT "%5.3" DEPOSIT ABSOLUTE /end AXIS_DESCR
/end CHARACTERISTIC
/begin CHARACTERISTIC PLRHFOSC2 "Wichtungsfaktor des P-Anteils in der LRHK ¸ber KAT-Alterung = f(fcoschk2)" CURVE 0xFD457B KlAxU8SstxU8WU8 0.9961 fak_ub_b1 0.00 0.9961
 /begin AXIS_DESCR STD_AXIS fcoschk2 fak_ub_b2 8 0.00 1.992 FORMAT "%5.3" DEPOSIT ABSOLUTE /end AXIS_DESCR
/end CHARACTERISTIC
/begin CHARACTERISTIC REDHYOC "Hysterese der Reduzierstufe bei grˆﬂerer Soll-Reduzierstufe als Ist-Wert" VALUE 0xFCA080 KwSb 5.100 rel_sb_q0p02 -2.560 2.540 FORMAT "%5.3" /end CHARACTERISTIC
/begin CHARACTERISTIC REDHYUC "Hysterese der Reduzierstufe bei kleinerer Soll-Reduzierstufe als Ist-Wert" VALUE 0xFCA081 KwSb 5.100 rel_sb_q0p02 -2.560 2.540 FORMAT "%5.3" /end CHARACTERISTIC
/begin CHARACTERISTIC REDMXSA "maximale Reduzierstufe bei sequentieller Schubabschaltung" VALUE 0xFCA082 KwUb 255.0 dez 0.00 255.0 FORMAT "%5.1" /end CHARACTERISTIC
/begin CHARACTERISTIC REDZEM "Schwelle zwischen Z¸ndeingriff und Einspritzausblendung" CURVE 0xFD3E32 KlAUbSstUbWUb 255.0 dez 0.00 255.0 FORMAT "%5.1"
 /begin AXIS_DESCR STD_AXIS tmot temp_ub_q0p75_o48 5 -48.00 143.3 FORMAT "%5.1" DEPOSIT ABSOLUTE /end AXIS_DESCR
/end CHARACTERISTIC
/begin CHARACTERISTIC RKATMN "untere Schwelle additive Korrektur pro Zeit" VALUE 0xFD2202 KwSw 383.9941 rel_sw_b192 -192.0000 191.9941 FORMAT "%8.4" /end CHARACTERISTIC
/begin CHARACTERISTIC RKATMX "obere Schwelle additive Korrektur pro Zeit" VALUE 0xFD2204 KwSw 383.9941 rel_sw_b192 -192.0000 191.9941 FORMAT "%8.4" /end CHARACTERISTIC
/begin CHARACTERISTIC RKATRN "reduzierte untere Schwelle additive Korrektur pro Zeit" VALUE 0xFD2206 KwSw 383.9941 rel_sw_b192 -192.0000 191.9941 FORMAT "%8.4" /end CHARACTERISTIC
/begin CHARACTERISTIC RKATRX "reduzierte obere Schwelle additive Korrektur pro Zeit" VALUE 0xFD2208 KwSw 383.9941 rel_sw_b192 -192.0000 191.9941 FORMAT "%8.4" /end CHARACTERISTIC
/begin CHARACTERISTIC RKAZMN "untere Schwelle additive Korrektur pro Z¸ndung" VALUE 0xFD220A KwSw 383.9941 rel_sw_b192 -192.0000 191.9941 FORMAT "%8.4" /end CHARACTERISTIC
/begin CHARACTERISTIC RKAZMX "obere Schwelle additive Korrektur pro Z¸ndung" VALUE 0xFD220C KwSw 383.9941 rel_sw_b192 -192.0000 191.9941 FORMAT "%8.4" /end CHARACTERISTIC
/begin CHARACTERISTIC RKAZRN "reduzierte untere Schwelle additive Korrektur pro Z¸ndung" VALUE 0xFD220E KwSw 383.9941 rel_sw_b192 -192.0000 191.9941 FORMAT "%8.4" /end CHARACTERISTIC
/begin CHARACTERISTIC RKAZRX "reduzierte obere Schwelle additive Korrektur pro Z¸ndung" VALUE 0xFD2210 KwSw 383.9941 rel_sw_b192 -192.0000 191.9941 FORMAT "%8.4" /end CHARACTERISTIC
/begin CHARACTERISTIC RL0 "Umrechnungskonstante f¸r Einrechnung Gemischkorrektur rkat" VALUE 0xFC769A KwWU16 191.6484 rel_uw_q0p0234 0.00 191.6484 FORMAT "%8.4" /end CHARACTERISTIC
/begin CHARACTERISTIC RLLRAMN "Mindestf¸llung f¸r Begrenzung Stelleingriff rkat bei niedriger F¸llung" VALUE 0xFC769C KwWU16 191.6484 rel_uw_q0p0234 0.00 191.6484 FORMAT "%8.4" /end CHARACTERISTIC
/begin CHARACTERISTIC RLLRHON "Kennlinie ¸ber nmot, obere rL Regelgrenze f¸r Regler hinter KAT" CURVE 0xFD45BC GklWU8 191.3 rel_ub_q0p75 0.00 191.3 FORMAT "%5.1"
 /begin AXIS_DESCR COM_AXIS nmot nmot_ub_q40 8 0.00 10200. FORMAT "%5.0" AXIS_PTS_REF SNM08LHUB /end AXIS_DESCR
/end CHARACTERISTIC
/begin CHARACTERISTIC RLLRHUN "Kennlinie ¸ber nmot, untere rL Regelgrenze f¸r Regler hinter KAT" CURVE 0xFD45C4 GklWU8 191.3 rel_ub_q0p75 0.00 191.3 FORMAT "%5.1"
 /begin AXIS_DESCR COM_AXIS nmot nmot_ub_q40 8 0.00 10200. FORMAT "%5.0" AXIS_PTS_REF SNM08LHUB /end AXIS_DESCR
/end CHARACTERISTIC
/begin CHARACTERISTIC RLLRSHB "relative Lastschwelle, Abschalten LR bei SLS, in Verbindung mit LL und NLRSHB" VALUE 0xFCC906 KwUb 191.3 rel_ub_q0p75 0.00 191.3 FORMAT "%5.1" /end CHARACTERISTIC
/begin CHARACTERISTIC RLLRUN "Kennlinie ¸ber nmot, untere rL Regelgrenze f¸r Regler vor KAT" CURVE 0xFCC907 KlAUbSstUbWUb 191.3 rel_ub_q0p75 0.00 191.3 FORMAT "%5.1"
 /begin AXIS_DESCR STD_AXIS nmot nmot_ub_q40 8 0.00 10200. FORMAT "%5.0" DEPOSIT ABSOLUTE /end AXIS_DESCR
/end CHARACTERISTIC
/begin CHARACTERISTIC RLO2 "obere Lastschwelle Bereich 2" VALUE 0xFD21D9 KwUb 191.3 rel_ub_q0p75 0.00 191.3 FORMAT "%5.1" /end CHARACTERISTIC
/begin CHARACTERISTIC RLO3 "obere rl - Schwelle Bereich 3" VALUE 0xFD21DA KwUb 191.3 rel_ub_q0p75 0.00 191.3 FORMAT "%5.1" /end CHARACTERISTIC
/begin CHARACTERISTIC RLO3AC "obere rl - Schwelle Bereich 3 mit kompressor" VALUE 0xFD21DB KwUb 191.3 rel_ub_q0p75 0.00 191.3 FORMAT "%5.1" /end CHARACTERISTIC
/begin CHARACTERISTIC RLSLSMN "min. rl f¸r Freigabe Regelung w‰hrend Sekund‰rluft" CURVE 0xFCC918 KlAUbSstUbWUb 191.3 rel_ub_q0p75 0.00 191.3 FORMAT "%5.1"
 /begin AXIS_DESCR STD_AXIS nmot nmot_ub_q40 4 0.00 10200. FORMAT "%5.0" DEPOSIT ABSOLUTE /end AXIS_DESCR
/end CHARACTERISTIC
/begin CHARACTERISTIC RLU2 "untere rl - Schwelle Bereich 2" VALUE 0xFD21DC KwUb 191.3 rel_ub_q0p75 0.00 191.3 FORMAT "%5.1" /end CHARACTERISTIC
/begin CHARACTERISTIC RLU2AC "untere rl - Schwelle Bereich 2 mit Kompressor" VALUE 0xFD21DD KwUb 191.3 rel_ub_q0p75 0.00 191.3 FORMAT "%5.1" /end CHARACTERISTIC
/begin CHARACTERISTIC RLU3 "untere rl - Schwelle Bereich 3" VALUE 0xFD21DE KwUb 191.3 rel_ub_q0p75 0.00 191.3 FORMAT "%5.1" /end CHARACTERISTIC
/begin CHARACTERISTIC RLU4 "untere rl -Schwelle oberer multiplikativer Bereich" VALUE 0xFD21DF KwUb 191.3 rel_ub_q0p75 0.00 191.3 FORMAT "%5.1" /end CHARACTERISTIC
/begin CHARACTERISTIC RLU4AC "untere rl -Schwelle oberer multiplikativer Bereich mit Kompressor" VALUE 0xFD21E0 KwUb 191.3 rel_ub_q0p75 0.00 191.3 FORMAT "%5.1" /end CHARACTERISTIC
/begin CHARACTERISTIC RLVMXN "Maximaler Volumenstrom bei offener Drosselklappe" CURVE 0xFCA042 KlAUbSstUbWUb 191.3 rel_ub_q0p75 0.00 191.3 FORMAT "%5.1"
 /begin AXIS_DESCR STD_AXIS snmta nmot_ub_q40 11 0.00 10200. FORMAT "%5.0" DEPOSIT ABSOLUTE /end AXIS_DESCR
/end CHARACTERISTIC
/begin CHARACTERISTIC RLVSMXN "Maximaler Volumenstrom bei offener Drosselklappe und SU" CURVE 0xFCA059 KlAUbSstUbWUb 191.3 rel_ub_q0p75 0.00 191.3 FORMAT "%5.1"
 /begin AXIS_DESCR STD_AXIS snmta nmot_ub_q40 11 0.00 10200. FORMAT "%5.0" DEPOSIT ABSOLUTE /end AXIS_DESCR
/end CHARACTERISTIC
/begin AXIS_PTS SGA08MDUB "St¸tzstellenverteilung Ist Gang 8 Sst." 0xFCF807 gangi SstAUbSstUb 255.0 dez 8 0.00 255.0 FORMAT "%5.1" DEPOSIT ABSOLUTE /end AXIS_PTS
/begin AXIS_PTS SM109LHSW "dlashk_w abh‰ngige St¸tzstellen (Anzahl 9)" 0xFD4594 dlashkm_w SstAU8SstS16 1.999969 fak_sw_b1 9 -1.000000 0.9999695 FORMAT "%8.6" DEPOSIT ABSOLUTE /end AXIS_PTS
/begin AXIS_PTS SM209LHSW "dlashk2_w abh‰ngige St¸tzstellen (Anzahl 9)" 0xFD45A8 dlashkm2_w SstAU8SstS16 1.999969 fak_sw_b1 9 -1.000000 0.9999695 FORMAT "%8.6" DEPOSIT ABSOLUTE /end AXIS_PTS
/begin AXIS_PTS SMK06MDUW "" 0xFCA006 mkfanb_w SstASwSstSw 199.9969 rel_sw_b100 6 -100.0000 99.99695 FORMAT "%8.4" DEPOSIT ABSOLUTE /end AXIS_PTS
/begin AXIS_PTS SML08LHUB "ml abh‰ngige St¸tzstellen (Anzahl 8)" 0xFCF817 ml SstAUbSstUb 1020. m_ub_b1020 8 0.00 1020. FORMAT "%5.0" DEPOSIT ABSOLUTE /end AXIS_PTS
/begin AXIS_PTS SNM06MDUW "Rover" 0xFCF8F2 nmot_w SstAUwSstUw 16383.75 nmot_uw_q0p25 6 0.00 16383.75 FORMAT "%8.2" DEPOSIT ABSOLUTE /end AXIS_PTS
/begin AXIS_PTS SNM07LSUW "St¸tzstellenverteilung Reglerparameter LRS" 0xFC1466 nmot_w SstAUwSstUw 16383.75 nmot_uw_q0p25 7 0.00 16383.75 FORMAT "%8.2" DEPOSIT ABSOLUTE /end AXIS_PTS
/begin AXIS_PTS SNM08LHUB "nmot abh‰ngige St¸tzstellen (Anzahl 8)" 0xFCF828 nmot SstAUbSstUb 10200. nmot_ub_q40 8 0.00 10200. FORMAT "%5.0" DEPOSIT ABSOLUTE /end AXIS_PTS
/begin AXIS_PTS SNM10LSUB "St¸tzstellenverteilung Kat-Vorsteuerwert LRS" 0xFC139D nmot SstAUbSstUb 10200. nmot_ub_q40 10 0.00 10200. FORMAT "%5.0" DEPOSIT ABSOLUTE /end AXIS_PTS
/begin AXIS_PTS SNM12FEUB "St¸tzstellen f¸r WDKSMX, WDKUGDN" 0xFC13B5 nmot SstAUbSstUb 10200. nmot_ub_q40 12 0.00 10200. FORMAT "%5.0" DEPOSIT ABSOLUTE /end AXIS_PTS
/begin AXIS_PTS SNM16OPUW "St¸tzstellenverteilung Drehzahl" 0xFC1476 nmot_w SstAUwSstUw 16383.75 nmot_uw_q0p25 16 0.00 16383.75 FORMAT "%8.2" DEPOSIT ABSOLUTE /end AXIS_PTS
/begin AXIS_PTS SRL08LSUW "St¸tzstellenverteilung Reglerparameter" 0xFC1498 rl_w SstAUwSstUw 1535.977 rel_uw_q0p0234 8 0.00 1535.977 FORMAT "%8.3" DEPOSIT ABSOLUTE /end AXIS_PTS
/begin AXIS_PTS SRL10LSUB "St¸tzstellenverteilung Kat-Vorsteuerwert LRS" 0xFC13F9 rl SstAUbSstUb 191.3 rel_ub_q0p75 10 0.00 191.3 FORMAT "%5.1" DEPOSIT ABSOLUTE /end AXIS_PTS
/begin AXIS_PTS SRL16OPUW "St¸tzstellenverteilung relative Luftf¸llung" 0xFC997C rl_w_kge SstAUwSstUw 1535.977 rel_uw_q0p0234 16 0.00 1535.977 FORMAT "%8.3" DEPOSIT ABSOLUTE /end AXIS_PTS
/begin AXIS_PTS STM04FEUB "St¸tzstellenverteilung Motortemperatur" 0xFC1434 tmot SstAUbSstUb 191.3 temp_ub_q0p75_o48 4 -48.00 143.3 FORMAT "%5.1" DEPOSIT ABSOLUTE /end AXIS_PTS
/begin CHARACTERISTIC STNMTA "St¸tzstellen-Korrektur von nmot" CURVE 0xFCA070 KlAUbSstUbWSb 10200. nmot_sb_q40 -5120. 5080. FORMAT "%5.0"
 /begin AXIS_DESCR STD_AXIS tans temp_ub_q0p75_o48 6 -48.00 143.3 FORMAT "%5.1" DEPOSIT ABSOLUTE /end AXIS_DESCR
/end CHARACTERISTIC
/begin CHARACTERISTIC S_dmfbdpf "Umschaltung Solldifferenzdruck Saugrohr gefiltert/ungefiltert f¸r Berechnung Fak" VALUE 0xFC9AD7 KwUb 255.0 dez 0.00 255.0 FORMAT "%5.1" /end CHARACTERISTIC
/begin CHARACTERISTIC TARA "Temperaturschwelle Ansaugluft" VALUE 0xFC76A8 KwUb 191.3 temp_ub_q0p75_o48 -48.00 143.3 FORMAT "%5.1" /end CHARACTERISTIC
/begin CHARACTERISTIC TARAU "Ansauglufttemperaturschwelle f¸r Einschalten der Lambda - Regelung" VALUE 0xFCC921 KwUb 191.3 temp_ub_q0p75_o48 -48.00 143.3 FORMAT "%5.1" /end CHARACTERISTIC
/begin CHARACTERISTIC TASHS "Schwelle Ansauglufttemp. f¸r Auslˆsung TLRHS - Sperrzeit LR bei Heiﬂstart" VALUE 0xFCC922 KwUb 191.3 temp_ub_q0p75_o48 -48.00 143.3 FORMAT "%5.1" /end CHARACTERISTIC
/begin CHARACTERISTIC TAUIDEC "Zeitkonstante Absteuern Integralanteil bei Grenzwertregelung LRS" VALUE 0xFCC8F4 KwUw 655.34999985 zk10msxs_uw_b655 0.010000152590 655.36000000 FORMAT "%12.8" /end CHARACTERISTIC
/begin CHARACTERISTIC TBLRH "Sperrzeit f¸r Regelung hinter Kat nach Freigabe durch Regelung vor Kat" VALUE 0xFD4603 KwWU8 25.50 t100msxs_ub_b25p5 0.00 25.50 FORMAT "%5.2" /end CHARACTERISTIC
/begin CHARACTERISTIC TBLRH2 "Sperrzeit f¸r Regelung hinter Kat nach Freigabe durch Regelung vor Kat Bank 2" VALUE 0xFD4604 KwWU8 25.50 t100msxs_ub_b25p5 0.00 25.50 FORMAT "%5.2" /end CHARACTERISTIC
/begin CHARACTERISTIC TDLAKAD "Absteuerzeit von lamka_w f¸r gesteuertes Katalysator-Ausr‰umen" VALUE 0xFD4696 KwWU16 1309.9800107 zk20msxs_uw_b1310 0.019989318685 1310.0000000 FORMAT "%12.7" /end CHARACTERISTIC
/begin CHARACTERISTIC TDLAKAU "Aufsteuerzeit von lamka_w f¸r gesteuertes Katalysator-Ausr‰umen" VALUE 0xFD4698 KwWU16 1309.9800107 zk20msxs_uw_b1310 0.019989318685 1310.0000000 FORMAT "%12.7" /end CHARACTERISTIC
/begin CHARACTERISTIC TDMFBSA "Zeitkonstante PT1-Filter beim Schubabschalten" VALUE 0xFCA014 KwUw 655.34999985 zk10msxs_uw_b655 0.010000152590 655.36000000 FORMAT "%12.8" /end CHARACTERISTIC
/begin CHARACTERISTIC TDMFBWE "Zeitkonstante PT1-Filter beim weichen Wiedereinsetzen" VALUE 0xFCA016 KwUw 655.34999985 zk10msxs_uw_b655 0.010000152590 655.36000000 FORMAT "%12.8" /end CHARACTERISTIC
/begin CHARACTERISTIC TDRLLRHKX "Entprellzeit Delta-rl-Bedingung  f¸r Ausblendung I-Anteil" VALUE 0xFD4605 KwWU8 25.50 t100msxs_ub_b25p5 0.00 25.50 FORMAT "%5.2" /end CHARACTERISTIC
/begin CHARACTERISTIC TGAALTWR "Zeit Zeitkonstante f¸rs R¸cksetzen  der Gemischkorrektur auf letzten Tripwert" VALUE 0xFD2212 KwUw 4.999924 zk200msxs_uw_b5 0.00 4.999924 FORMAT "%8.6" /end CHARACTERISTIC
/begin CHARACTERISTIC TKATMLRH "Einschaltschwelle Kat-Modelltemperatur  f¸r Lambdaregelung hinter Kat" VALUE 0xFD45E8 KwWU16 1535.977 temp_q0p0234_o273 -273.1500 1262.827 FORMAT "%8.3" /end CHARACTERISTIC
/begin CHARACTERISTIC TKATMLRH2 "Einschaltschwelle Kat-Modelltemperatur  f¸r Lambdaregelung hinter Kat, Bank 2" VALUE 0xFD45EA KwWU16 1535.977 temp_q0p0234_o273 -273.1500 1262.827 FORMAT "%8.3" /end CHARACTERISTIC
/begin CHARACTERISTIC TKATMLRHI "Einschaltschwelle Kat-Modelltemp.  f¸r I-Anteil Lambdaregelung hinter Kat" VALUE 0xFD45EC KwWU16 1535.977 temp_q0p0234_o273 -273.1500 1262.827 FORMAT "%8.3" /end CHARACTERISTIC
/begin CHARACTERISTIC TKATMLRHI2 "Einschaltschwelle Kat-Modelltemp.  f¸r I-Anteil Lambdaregelung hKat  Bank2" VALUE 0xFD45EE KwWU16 1535.977 temp_q0p0234_o273 -273.1500 1262.827 FORMAT "%8.3" /end CHARACTERISTIC
/begin CHARACTERISTIC TKATMLRHK "Kurztest: Einschaltschwelle Kat-Modelltemperatur  f¸r Lambdaregelung hinter Kat" VALUE 0xFD45F0 KwWU16 1535.977 temp_q0p0234_o273 -273.1500 1262.827 FORMAT "%8.3" /end CHARACTERISTIC
/begin CHARACTERISTIC TKATMLRHX "Obere Schwelle Kat-Modelltemperatur  f¸r Lambdaregelung hinter Kat" VALUE 0xFD45F2 KwWU16 1535.977 temp_q0p0234_o273 -273.1500 1262.827 FORMAT "%8.3" /end CHARACTERISTIC
/begin CHARACTERISTIC TKATMLRHX2 "Obere Schwelle Kat-Modelltemperatur  f¸r Lambdaregelung hinter Kat, Bank 2" VALUE 0xFD45F4 KwWU16 1535.977 temp_q0p0234_o273 -273.1500 1262.827 FORMAT "%8.3" /end CHARACTERISTIC
/begin CHARACTERISTIC TKATSZA "Kat-Temperaturschwelle f¸r Freigabe der Zwangsamplitude" VALUE 0xFCC8F6 KwUw 1279.980 temp_uw_q0p0195_o50 -50.00000 1229.980 FORMAT "%8.3" /end CHARACTERISTIC
/begin CHARACTERISTIC TKATSZA2 "Kat-Temperaturschwelle f¸r Freigabe der Zwangsamplitude, Bank 2" VALUE 0xFCC8F8 KwUw 1279.980 temp_uw_q0p0195_o50 -50.00000 1229.980 FORMAT "%8.3" /end CHARACTERISTIC
/begin CHARACTERISTIC TKTMHICAX "alternative Einschaltschw. Kat-Modelltemp.  f¸r I-Anteil Lambdareg. hinter Kat" VALUE 0xFD45F6 KwWU16 1535.977 temp_q0p0234_o273 -273.1500 1262.827 FORMAT "%8.3" /end CHARACTERISTIC
/begin CHARACTERISTIC TKTMHICAX2 "alternative Einschaltschw. Kat-Modelltemp.  f¸r I-Anteil Lambdareg. hKat, Bank2" VALUE 0xFD45F8 KwWU16 1535.977 temp_q0p0234_o273 -273.1500 1262.827 FORMAT "%8.3" /end CHARACTERISTIC
/begin CHARACTERISTIC TKTMLRCAX "alternative Einschaltschw. Kat-Modelltemp.  f¸r Lambdareg. hinter Kat" VALUE 0xFD45FA KwWU16 1535.977 temp_q0p0234_o273 -273.1500 1262.827 FORMAT "%8.3" /end CHARACTERISTIC
/begin CHARACTERISTIC TKTMLRCAX2 "alternative Einschaltschw. Kat-Modelltemp.  f¸r Lambdareg. hinter Kat Bank 2" VALUE 0xFD45FC KwWU16 1535.977 temp_q0p0234_o273 -273.1500 1262.827 FORMAT "%8.3" /end CHARACTERISTIC
/begin CHARACTERISTIC TLAKAMN "Mindestdauer Bed. lamsbrs_w oder lamsons_w > 1.0 f¸r Funktion Kat.-Ausr‰umen" VALUE 0xFD46A6 KwWU8 5.100 t20msxs_ub_b5p1 0.00 5.100 FORMAT "%5.3" /end CHARACTERISTIC
/begin CHARACTERISTIC TLAKAMN2 "Min. Dauer Bed. lamsbrs2_w or lamsons2_w > 1.0 f¸r Funktion Kat.-Ausr‰umen" VALUE 0xFD46A7 KwWU8 5.100 t20msxs_ub_b5p1 0.00 5.100 FORMAT "%5.3" /end CHARACTERISTIC
/begin CHARACTERISTIC TLAMSBRS "Entprellzeit  Sperre I-Anteil nach Auslˆsung durch Lambda-Bedingung" VALUE 0xFD4606 KwWU8 25.50 t100msxs_ub_b25p5 0.00 25.50 FORMAT "%5.2" /end CHARACTERISTIC
/begin CHARACTERISTIC TLRBAM "Sperrzeit f¸r Einschalten LR nach BA" CURVE 0xFCC930 KlAUbSstUbWUw 655.3500 t10msxs_uw_b655p35 0.00 655.3500 FORMAT "%8.4"
 /begin AXIS_DESCR STD_AXIS tmot temp_ub_q0p75_o48 8 -48.00 143.3 FORMAT "%5.1" DEPOSIT ABSOLUTE /end AXIS_DESCR
/end CHARACTERISTIC
/begin CHARACTERISTIC TLRHS "Sperrzeit LR bei Heiﬂstart, ausgelˆst ¸ber Schwellen TASHS und TMSHS" VALUE 0xFD441C KwUb 25.50 t100msxs_ub_b25p5 0.00 25.50 FORMAT "%5.2" /end CHARACTERISTIC
/begin CHARACTERISTIC TLRSLASA "Zeitdauer f¸r LRS-Abschaltung nach Schubabschneiden" VALUE 0xFD441D KwUb 25.40 t100msxs_ub_b25p5 0.1000 25.50 FORMAT "%5.2" /end CHARACTERISTIC
/begin CHARACTERISTIC TLRSZWSA "Zeitdauer f¸r LRS-Zwangseinschaltung nach Schubabschneiden" VALUE 0xFD4430 KwUw 6553.500 t100msxs_uw_b6553p5 0.00 6553.500 FORMAT "%8.3" /end CHARACTERISTIC
/begin CHARACTERISTIC TLRTMS "Sperrzeit LR nach Start, abh‰ngig von der Motortemperatur bei Start" CURVE 0xFD4432 KlAUbSstUbWUw 6553.500 t100msxs_uw_b6553p5 0.00 6553.500 FORMAT "%8.3"
 /begin AXIS_DESCR STD_AXIS tmst temp_ub_q0p75_o48 5 -48.00 143.3 FORMAT "%5.1" DEPOSIT ABSOLUTE /end AXIS_DESCR
/end CHARACTERISTIC
/begin CHARACTERISTIC TLRVAM "Sperrzeit f¸r Einschalten LR nach VA" CURVE 0xFCC94A KlAUbSstUbWUw 655.3500 t10msxs_uw_b655p35 0.00 655.3500 FORMAT "%8.4"
 /begin AXIS_DESCR STD_AXIS tmot temp_ub_q0p75_o48 8 -48.00 143.3 FORMAT "%5.1" DEPOSIT ABSOLUTE /end AXIS_DESCR
/end CHARACTERISTIC
/begin CHARACTERISTIC TLRZWTMS "Zeit f¸r Zwangseinschaltung LR (CARB-Forderung) nach Start" CURVE 0xFD4442 KlAUbSstUbWUw 6553.500 t100msxs_uw_b6553p5 0.00 6553.500 FORMAT "%8.3"
 /begin AXIS_DESCR STD_AXIS tmst temp_ub_q0p75_o48 4 -48.00 143.3 FORMAT "%5.1" DEPOSIT ABSOLUTE /end AXIS_DESCR
/end CHARACTERISTIC
/begin CHARACTERISTIC TMEWRAA "Einschalttemperatur LRA bezogen auf die modellierte Motortemperatur" VALUE 0xFD224C KwUb 191.3 temp_ub_q0p75_o48 -48.00 143.3 FORMAT "%5.1" /end CHARACTERISTIC
/begin CHARACTERISTIC TMFRATMN "minimale Temperatur bei der ftklra_w = 1 ist" VALUE 0xFD21E1 KwUb 191.3 temp_ub_q0p75_o48 -48.00 143.3 FORMAT "%5.1" /end CHARACTERISTIC
/begin CHARACTERISTIC TMFRATUB "untere Temperaturschwelle  bei der ftklra_w Konstant bleibt" VALUE 0xFD21E2 KwUb 191.3 temp_ub_q0p75_o48 -48.00 143.3 FORMAT "%5.1" /end CHARACTERISTIC
/begin CHARACTERISTIC TMLRZAMN "Minimale Motortemperatur f¸r Zusatzamplitude" VALUE 0xFCC778 KwUb 191.3 temp_ub_q0p75_o48 -48.00 143.3 FORMAT "%5.1" /end CHARACTERISTIC
/begin CHARACTERISTIC TMOTLRHI "Einschaltschwelle Motortemperatur  f¸r I-Anteil Lambdaregelung hinter Kat" VALUE 0xFD4607 KwWU8 191.3 temp_ub_q0p75_o48 -48.00 143.3 FORMAT "%5.1" /end CHARACTERISTIC
/begin CHARACTERISTIC TMOTMRSMX "Maximale Motorstarttemperatur bei der CSD-Fehler im n‰chste Trip best‰tigt wird" VALUE 0xFD046C KwUw 49151.25 temp_uw_q0p75_o48 -48.00000 49103.25 FORMAT "%8.2" /end CHARACTERISTIC
/begin CHARACTERISTIC TMRA1 "Ausschaltbedingung (S_LL = 0)" VALUE 0xFCC923 KwUb 191.3 temp_ub_q0p75_o48 -48.00 143.3 FORMAT "%5.1" /end CHARACTERISTIC
/begin CHARACTERISTIC TMRA2 "Ausschaltbedingung (S_LL = 1)" VALUE 0xFCC924 KwUb 191.3 temp_ub_q0p75_o48 -48.00 143.3 FORMAT "%5.1" /end CHARACTERISTIC
/begin CHARACTERISTIC TMRAA "Einschalttemperatur LRA" VALUE 0xFD224D KwUb 191.3 temp_ub_q0p75_o48 -48.00 143.3 FORMAT "%5.1" /end CHARACTERISTIC
/begin CHARACTERISTIC TMRAK "Ausschaltschwelle der Lambda - Regelung bei niedriger Starttemperatur" VALUE 0xFCC925 KwUb 191.3 temp_ub_q0p75_o48 -48.00 143.3 FORMAT "%5.1" /end CHARACTERISTIC
/begin CHARACTERISTIC TMSHS "Schwelle Motortemp. f¸r Auslˆsung TLRHS - Sperrzeit LR bei Heiﬂstart" VALUE 0xFCC926 KwUb 191.3 temp_ub_q0p75_o48 -48.00 143.3 FORMAT "%5.1" /end CHARACTERISTIC
/begin CHARACTERISTIC TMSPR "" VALUE 0xFC92B6 KwWU8 191.3 temp_ub_q0p75_o48 -48.00 143.3 FORMAT "%5.1" /end CHARACTERISTIC
/begin CHARACTERISTIC TMVER "Entprellzeit zur Erkennung einer dauerhaften Momentenbegrenzung" VALUE 0xFD3E2E KwUw 65535.00 t1sxs_uw_b65535 0.00 65535.00 FORMAT "%8.2" /end CHARACTERISTIC
/begin CHARACTERISTIC TPNSMD "Pr¸fzeit nach Startende f¸r Diagnose Momentenbegrenzung" VALUE 0xFD3E30 KwUw 65535.00 t1sxs_uw_b65535 0.00 65535.00 FORMAT "%8.2" /end CHARACTERISTIC
/begin CHARACTERISTIC TRAU "‹berwachungszeit f¸r untere Lastschwelle der Lambdaregelung" VALUE 0xFD441E KwUb 25.50 t100msxs_ub_b25p5 0.00 25.50 FORMAT "%5.2" /end CHARACTERISTIC
/begin CHARACTERISTIC TSAKAMN "Mindestdauer SA f¸r Funktion Katalysator-Ausr‰umen" VALUE 0xFD46A8 KwWU8 5.100 t20msxs_ub_b5p1 0.00 5.100 FORMAT "%5.3" /end CHARACTERISTIC
/begin CHARACTERISTIC TSAKAMN2 "Mindestdauer SA f¸r Funktion Katalysator-Ausr‰umen Bank2" VALUE 0xFD46A9 KwWU8 5.100 t20msxs_ub_b5p1 0.00 5.100 FORMAT "%5.3" /end CHARACTERISTIC
/begin CHARACTERISTIC TVBRMX "Verzˆgerungszeit f¸r Aktivierung der Brettfunktion" VALUE 0xFD3627 KwUb 12.75 t_q0p05 0.00 12.75 FORMAT "%5.2" /end CHARACTERISTIC
/begin CHARACTERISTIC TVDPSTEND "Verzˆgerungszeit B_stend f¸r Berechnung Erlaubnis Dashpot" VALUE 0xFCA018 KwUw 655.3500 t10msxs_uw_b655p35 0.00 655.3500 FORMAT "%8.4" /end CHARACTERISTIC
/begin CHARACTERISTIC TVFSAWE "Verzˆgerungszeit f¸r R¸cksetzen von B_fil" VALUE 0xFC9AD8 KwUb 2.540 t10msxs_ub_b2p55 0.01000 2.550 FORMAT "%5.3" /end CHARACTERISTIC
/begin CHARACTERISTIC TVLRA "Verzˆgerungszeit f¸r Aktivierung Gemischadaption nach Lambdaregelung aktiv" VALUE 0xFD224E KwUb 25.40 t100msxs_ub_b25p5 0.1000 25.50 FORMAT "%5.2" /end CHARACTERISTIC
/begin CHARACTERISTIC TVPBREMS "Verzˆgerungszeit f¸r Aktivierung der Bremsfunktion" VALUE 0xFD3628 KwUb 12.75 t_q0p05 0.00 12.75 FORMAT "%5.2" /end CHARACTERISTIC
/begin CHARACTERISTIC TVSLR "Dauer LRS-Ausschaltung ¸ber Ventilhubsteuerung" CURVE 0xFD441F KlAUbSstUbWUb 2.550 t10msxs_ub_b2p55 0.00 2.550 FORMAT "%5.3"
 /begin AXIS_DESCR STD_AXIS nmot nmot_ub_q40 8 0.00 10200. FORMAT "%5.0" DEPOSIT ABSOLUTE /end AXIS_DESCR
/end CHARACTERISTIC
/begin CHARACTERISTIC TWPFGR "Zeitkonstante PT1-Filter f¸r R¸ckgerechneter Pedalwert bei FGR-Betrieb" VALUE 0xFCA01A KwUw 3276.7499992 zk50msxs_uw_b3276p8 0.050000762951 3276.8000000 FORMAT "%12.7" /end CHARACTERISTIC
/begin CHARACTERISTIC USHKAMNW "Sondenspannung hinter Kat f¸r Erkennung Kat ist mit O2 gef¸llt (Word)" VALUE 0xFD469A KwWU16 319.9951 spg_uw_q0p00488_o1 -1.000000 318.9951 FORMAT "%8.4" /end CHARACTERISTIC
/begin CHARACTERISTIC USHKAMNW2 "Sondenspannung hinter Kat f¸r Erkennung Kat ist mit O2 gef¸llt, Bank 2 (Word)" VALUE 0xFD469C KwWU16 319.9951 spg_uw_q0p00488_o1 -1.000000 318.9951 FORMAT "%8.4" /end CHARACTERISTIC
/begin CHARACTERISTIC USHKAMXW "Sondenspannung hinter Kat f¸r Abbruch Kat-Ausr‰umen (Word)" VALUE 0xFD469E KwWU16 319.9951 spg_uw_q0p00488_o1 -1.000000 318.9951 FORMAT "%8.4" /end CHARACTERISTIC
/begin CHARACTERISTIC USHKAMXW2 "Sondenspannung hinter Kat f¸r Abbruch Kat-Ausr‰umen Bank2 (Word)" VALUE 0xFD46A0 KwWU16 319.9951 spg_uw_q0p00488_o1 -1.000000 318.9951 FORMAT "%8.4" /end CHARACTERISTIC
/begin CHARACTERISTIC VKUPZWEO "Obere vfzg-Hytereseschwelle f¸r KUP-ZW-Eingriffe" VALUE 0xFCA02D KwUb 318.8 vfzg_ub_q1p25 0.00 318.8 FORMAT "%5.1" /end CHARACTERISTIC
/begin CHARACTERISTIC VKUPZWEU "Untere vfzg-Hytereseschwelle f¸r KUP-ZW-Eingriffe" VALUE 0xFCA02E KwUb 318.8 vfzg_ub_q1p25 0.00 318.8 FORMAT "%5.1" /end CHARACTERISTIC
/begin CHARACTERISTIC VLLZWEO "Obere vfzg-Hytereseschwelle f¸r LL-ZW-Eingriffe" VALUE 0xFCA02F KwUb 318.8 vfzg_ub_q1p25 0.00 318.8 FORMAT "%5.1" /end CHARACTERISTIC
/begin CHARACTERISTIC VLLZWEU "Untere vfzg-Hytereseschwelle f¸r LL-ZW-Eingriffe" VALUE 0xFCA030 KwUb 318.8 vfzg_ub_q1p25 0.00 318.8 FORMAT "%5.1" /end CHARACTERISTIC
/begin CHARACTERISTIC VLSDZWEO "Obere vfzg-Hytereseschwelle f¸r LSD-ZW-Eingriffe" VALUE 0xFCA031 KwUb 318.8 vfzg_ub_q1p25 0.00 318.8 FORMAT "%5.1" /end CHARACTERISTIC
/begin CHARACTERISTIC VLSDZWEU "Untere vfzg-Hytereseschwelle f¸r LSD-ZW-Eingriffe" VALUE 0xFCA032 KwUb 318.8 vfzg_ub_q1p25 0.00 318.8 FORMAT "%5.1" /end CHARACTERISTIC
/begin CHARACTERISTIC VMKBRMX "Geschwindigkeitsschwelle f¸r Kupplungsmomentbegrenzung bei bet‰tigter Bremse" VALUE 0xFD3629 KwUb 318.8 vfzg_ub_q1p25 0.00 318.8 FORMAT "%5.1" /end CHARACTERISTIC
/begin CHARACTERISTIC WDKARN "DK-Winkel-Schwelle f¸r Gemischadaption aktiv" CURVE 0xFD224F KlAUbSstUbWUb 100.0 relDK_ub_b100 0.00 100.0 FORMAT "%5.1"
 /begin AXIS_DESCR STD_AXIS nmot nmot_ub_q40 10 0.00 10200. FORMAT "%5.0" DEPOSIT ABSOLUTE /end AXIS_DESCR
/end CHARACTERISTIC
/begin CHARACTERISTIC WIMAX "ObererSchranke interne Reglerzust‰nde stetige Lambdaregelung" VALUE 0xFCC8FA KwSw 7.999878 fak_sw_b4 -4.000000 3.999878 FORMAT "%8.6" /end CHARACTERISTIC
/begin CHARACTERISTIC WIMIN "Untere Schranke interne Reglerzustaende stetige Lambdaregelung" VALUE 0xFCC8FC KwSw 7.999878 fak_sw_b4 -4.000000 3.999878 FORMAT "%8.6" /end CHARACTERISTIC
/begin CHARACTERISTIC WPEDSPMN "untere Grenze wped_w, unter der auf Sport geschalten werden darf" VALUE 0xFCA01C KwUw 100.0000 relPED_uw_b100 0.00 100.0000 FORMAT "%8.4" /end CHARACTERISTIC
/begin CHARACTERISTIC WPEDSPMX "Pedalwertschwelle zum Aussprung aus der Spielausgleichphase (DARAC)" VALUE 0xFCA01E KwUw 100.0000 relPED_uw_b100 0.00 100.0000 FORMAT "%8.4" /end CHARACTERISTIC
/begin CHARACTERISTIC XIMAX "Oberer Schranke interne Reglerzust‰nde stetige Lambdaregelung" VALUE 0xFCC8FE KwSw 1.999969 fak_sw_b1 -1.000000 0.9999695 FORMAT "%8.6" /end CHARACTERISTIC
/begin CHARACTERISTIC XIMIN "Untere Schranke interne Reglerzustaende stetige Lambdaregelung" VALUE 0xFCC900 KwSw 1.999969 fak_sw_b1 -1.000000 0.9999695 FORMAT "%8.6" /end CHARACTERISTIC
/begin CHARACTERISTIC Y2MAX "Obere Schranke Integralanteil LRS" VALUE 0xFCC902 KwSw 1.999969 fak_sw_b1 -1.000000 0.9999695 FORMAT "%8.6" /end CHARACTERISTIC
/begin CHARACTERISTIC ZDZWKOEFT "" VALUE 0xFC999E KwUw 2047.938 zk10msxs_ub_b8 0.03125000 2047.969 FORMAT "%8.3" /end CHARACTERISTIC
/begin CHARACTERISTIC ZETABASN "Tiefpaﬂfilterzeitkonstante f¸r etabas_w" CURVE 0xFC5C34 GklWUb 2.54000 zk10msxs_ub_b2p55 0.0100000 2.55000 FORMAT "%7.5"
 /begin AXIS_DESCR COM_AXIS nmot nmot_ub_q40 12 0.00 10200. FORMAT "%5.0" AXIS_PTS_REF SNM12FEUB /end AXIS_DESCR
/end CHARACTERISTIC
/begin CHARACTERISTIC ZKFRAOA "Zeitkonstante f¸r frao-Integrator, f(Anzahl Starts mit ÷lverd¸nnung)" CURVE 0xFD2214 KlAUwSstUwWUw 4.999924 zk200msxs_uw_b5 0.00 4.999924 FORMAT "%8.6"
 /begin AXIS_DESCR STD_AXIS abo dez 3 0.00 255.0 FORMAT "%5.1" DEPOSIT ABSOLUTE /end AXIS_DESCR
/end CHARACTERISTIC
/begin CHARACTERISTIC ZKFRAUA "Zeitkonstante f¸r frau-Integrator, f(Anzahl Stats mit ÷lverd¸nnung)" CURVE 0xFD2222 KlAUwSstUwWUw 4.999924 zk200msxs_uw_b5 0.00 4.999924 FORMAT "%8.6"
 /begin AXIS_DESCR STD_AXIS abo dez 3 0.00 255.0 FORMAT "%5.1" DEPOSIT ABSOLUTE /end AXIS_DESCR
/end CHARACTERISTIC
/begin CHARACTERISTIC ZKFZNWLL "Zeitkonstante Ausblendung der zwopt LL-Umschaltung" VALUE 0xFC955B KwUb 7.969 zk10msxs_ub_b8 0.00 7.969 FORMAT "%5.3" /end CHARACTERISTIC
/begin CHARACTERISTIC ZKRKATA "Integrationsgeschwindigkeit Integrator rkat, f(abo)" CURVE 0xFD2230 KlAUwSstUwWUw 959.9854 zk200msxs_uw_b960 0.00 959.9854 FORMAT "%8.4"
 /begin AXIS_DESCR STD_AXIS abo dez 3 0.00 255.0 FORMAT "%5.1" DEPOSIT ABSOLUTE /end AXIS_DESCR
/end CHARACTERISTIC
/begin CHARACTERISTIC ZKRKAZA "Integrationsgeschwindigkeit Integrator rkaz, f(abo)" CURVE 0xFD223E KlAUwSstUwWUw 959.9854 zk200msxs_uw_b960 0.00 959.9854 FORMAT "%8.4"
 /begin AXIS_DESCR STD_AXIS abo dez 3 0.00 255.0 FORMAT "%5.1" DEPOSIT ABSOLUTE /end AXIS_DESCR
/end CHARACTERISTIC
/begin CHARACTERISTIC ZLASHKAB "Zeitkonstante f¸r Abregelung der dyn. Sollwertanhebung (dlasohkab) rin der LRHK" VALUE 0xFCC9BC KwWU16 655.3400 t10msxs_uw_b655p35 0.01000000 655.3500 FORMAT "%8.4" /end CHARACTERISTIC
/begin CHARACTERISTIC ZLASHKAB2 "Zeitkonst. f¸r Abregelung der dyn. Sollwertanhebung (dlasohkab) , Bank 2" VALUE 0xFCC9BE KwWU16 655.3400 t10msxs_uw_b655p35 0.01000000 655.3500 FORMAT "%8.4" /end CHARACTERISTIC
/begin CHARACTERISTIC ZLASOHML "Zeitkonstante f¸r PT1-Filter des Pseudo-Lambda hinter Kat" CURVE 0xFD4514 KlAxU8SstxU16WU16 655.3400 t10msxs_uw_b655p35 0.01000000 655.3500 FORMAT "%8.4"
 /begin AXIS_DESCR STD_AXIS ml_w m_uw_b6553p5 8 0.00 6553.500 FORMAT "%8.3" DEPOSIT ABSOLUTE /end AXIS_DESCR
/end CHARACTERISTIC
/begin CHARACTERISTIC ZLASOHML2 "Zeitkonstante f¸r PT1-Filter des Pseudo-Lambda hinter Kat, Bank 2" CURVE 0xFD4536 KlAxU8SstxU16WU16 655.3400 t10msxs_uw_b655p35 0.01000000 655.3500 FORMAT "%8.4"
 /begin AXIS_DESCR STD_AXIS ml_w m_uw_b6553p5 8 0.00 6553.500 FORMAT "%8.3" DEPOSIT ABSOLUTE /end AXIS_DESCR
/end CHARACTERISTIC
/begin CHARACTERISTIC ZMIBGR "Zeitkonstante f¸r Faktor gangabh. Momentenbegrenzung" VALUE 0xFD3686 KwUw 3276.7499992 zk50msxs_uw_b3276p8 0.050000762951 3276.8000000 FORMAT "%12.7" /end CHARACTERISTIC
/begin CHARACTERISTIC ZNGHGS "Zeitkonstante Tiefpaﬂ f¸r Drehzahlgradient" VALUE 0xFD3688 KwUw 3276.7499992 zk50msxs_uw_b3276p8 0.050000762951 3276.8000000 FORMAT "%12.7" /end CHARACTERISTIC
/begin CHARACTERISTIC ZRLFRAT "Filterzeitkonstante f¸r die Berechnung der Zeitkonstante der FRAT-Adaption" VALUE 0xFD21E3 KwUb 3.73846 zk200msxs_ub_b51p2 0.200000 3.93846 FORMAT "%7.5" /end CHARACTERISTIC
/begin CHARACTERISTIC ZRL_W_KGE "Zeitkonstante f¸r gefilterten rl_w Wert" CURVE 0xFD35E4 GklWUw 655.34999985 zk10msxs_uw_b655 0.010000152590 655.36000000 FORMAT "%12.8"
 /begin AXIS_DESCR COM_AXIS nmot_w nmot_uw_q0p25 16 0.00 16383.75 FORMAT "%8.2" AXIS_PTS_REF SNM16OPUW /end AXIS_DESCR
/end CHARACTERISTIC
/begin MEASUREMENT Asprll "Soll-Auslassspreizung im Leerlauf" UBYTE sprzi_q0p8 1 100 0 204 FORMAT "%5.1" ECU_ADDRESS 0x40398E /end MEASUREMENT
/begin MEASUREMENT B_abgy "Kennung Y-Konfiguration des  Abgassystems" UBYTE B_TRUE 1 100 0 1 BIT_MASK 0x1 FORMAT "%13.11" ECU_ADDRESS 0x403806 /end MEASUREMENT
/begin MEASUREMENT B_allzw "Bedingung zw-Verstellung durch MD-Struktur aktiv (LL,DASH,LSD,KUP)" UBYTE B_TRUE 1 100 0 1 BIT_MASK 0x1 FORMAT "%13.11" ECU_ADDRESS 0x3FC25A /end MEASUREMENT
/begin MEASUREMENT B_allzwe "Bedingung zw-Verstellung durch MD-Struktur aktiv (LL,DASH,LSD,KUP)" UBYTE B_TRUE 1 100 0 1 BIT_MASK 0x1 FORMAT "%13.11" ECU_ADDRESS 0x3FC25B /end MEASUREMENT
/begin MEASUREMENT B_asr "Bedingung f¸r ASR aktiv" UBYTE B_TRUE 1 100 0 1 BIT_MASK 0x1 FORMAT "%13.11" ECU_ADDRESS 0x3FC25C /end MEASUREMENT
/begin MEASUREMENT B_blrka "Bedingung gesteuertes Katalysator-Ausr‰umen angefordert" UBYTE B_TRUE 1 100 0 1 BIT_MASK 0x2 FORMAT "%13.11" ECU_ADDRESS 0x40359D /end MEASUREMENT
/begin MEASUREMENT B_blrka2 "Bedingung gesteuertes Katalysator-Ausr‰umen angefordert, Bank 2" UBYTE B_TRUE 1 100 0 1 BIT_MASK 0x10 FORMAT "%13.11" ECU_ADDRESS 0x40359D /end MEASUREMENT
/begin MEASUREMENT B_bremsold "Bedingung Bremse bet‰tigt Altwert" UBYTE B_TRUE 1 100 0 1 BIT_MASK 0x2 FORMAT "%13.11" ECU_ADDRESS 0x403CCA /end MEASUREMENT
/begin MEASUREMENT B_brvfp "Bedingung Bremse bet‰tigt vor Fahrpedal" UBYTE B_TRUE 1 100 0 1 BIT_MASK 0x1 FORMAT "%13.11" ECU_ADDRESS 0x403CCA /end MEASUREMENT
/begin MEASUREMENT B_clradlr "Bedingung: Adaptionswerte Lamdbaregelung selektiv loeschen" UBYTE B_TRUE 1 100 0 1 BIT_MASK 0x1 FORMAT "%13.11" ECU_ADDRESS 0x3FC0D2 /end MEASUREMENT
/begin MEASUREMENT B_clradlrh "Bedingung: Adaptionswerte Lambdaregelung h.KAT selektiv loeschen" UBYTE B_TRUE 1 100 0 1 BIT_MASK 0x1 FORMAT "%13.11" ECU_ADDRESS 0x3FC2DB /end MEASUREMENT
/begin MEASUREMENT B_ctagosx "Bedingung Sauerstoffspeicher Haupt-Kat unterhalb Schwelle" UBYTE B_TRUE 1 100 0 1 BIT_MASK 0x80 FORMAT "%13.11" ECU_ADDRESS 0x403573 /end MEASUREMENT
/begin MEASUREMENT B_ctagosx2 "Bedingung Sauerstoffspeicher Haupt-Kat unterhalb Schwelle, Bank 2" UBYTE B_TRUE 1 100 0 1 BIT_MASK 0x40 FORMAT "%13.11" ECU_ADDRESS 0x403576 /end MEASUREMENT
/begin MEASUREMENT B_dash "Bedingung: Dashpot-ƒnderungsbegrenzung aktiv" UBYTE B_TRUE 1 100 0 1 BIT_MASK 0x1 FORMAT "%13.11" ECU_ADDRESS 0x3FC24C /end MEASUREMENT
/begin MEASUREMENT B_dlahini "Bedingung Intiliasierung Integralanteil LRSHK" UBYTE B_TRUE 1 100 0 1 BIT_MASK 0x1 FORMAT "%13.11" ECU_ADDRESS 0x403565 /end MEASUREMENT
/begin MEASUREMENT B_dlahini2 "Bedingung Intiliasierung Integralanteil LRSHK, Bank2" UBYTE B_TRUE 1 100 0 1 BIT_MASK 0x2 FORMAT "%13.11" ECU_ADDRESS 0x403565 /end MEASUREMENT
/begin MEASUREMENT B_dp "Bedingung: Dashpotwert grˆﬂer Fahrerwunsch (=1)" UBYTE B_TRUE 1 100 0 1 BIT_MASK 0x1 FORMAT "%13.11" ECU_ADDRESS 0x3FC24D /end MEASUREMENT
/begin MEASUREMENT B_edp "Bedingung Erlaubnis Dashpot" UBYTE B_TRUE 1 100 0 1 BIT_MASK 0x1 FORMAT "%13.11" ECU_ADDRESS 0x3FC24E /end MEASUREMENT
/begin MEASUREMENT B_elsd "Bedingung Erlaubnis Lastschlagd‰mpfung" UBYTE B_TRUE 1 100 0 1 BIT_MASK 0x1 FORMAT "%13.11" ECU_ADDRESS 0x3FC24F /end MEASUREMENT
/begin MEASUREMENT B_eobdlr "OBDII-Summenfehler. sperrt die LR" UBYTE B_TRUE 1 100 0 1 BIT_MASK 0x1 FORMAT "%13.11" ECU_ADDRESS 0x3FC2C5 /end MEASUREMENT
/begin MEASUREMENT B_eobdlr2 "OBDII-Summenfehler. sperrt die LR, Bank 2" UBYTE B_TRUE 1 100 0 1 BIT_MASK 0x1 FORMAT "%13.11" ECU_ADDRESS 0x3FC2C6 /end MEASUREMENT
/begin MEASUREMENT B_fgr "Bedingung FGR (Tempomat) aktiv" UBYTE B_TRUE 1 100 0 1 BIT_MASK 0x1 FORMAT "%13.11" ECU_ADDRESS 0x3FC250 /end MEASUREMENT
/begin MEASUREMENT B_fil "Bedingung PT1-Filter f¸r SAWE aktiv" UBYTE B_TRUE 1 100 0 1 BIT_MASK 0x1 FORMAT "%13.11" ECU_ADDRESS 0x3FC251 /end MEASUREMENT
/begin MEASUREMENT B_flrsres "Bedingung Regler-Resetierung in Abh‰ngigkeit von B_lrsresf" UBYTE B_TRUE 1 100 0 1 BIT_MASK 0x1 FORMAT "%13.11" ECU_ADDRESS 0x3FC2B1 /end MEASUREMENT
/begin MEASUREMENT B_fnstab "Bedingung Drehzahlstabilisierung aktiv" UBYTE B_TRUE 1 100 0 1 BIT_MASK 0x1 FORMAT "%13.11" ECU_ADDRESS 0x3FC233 /end MEASUREMENT
/begin MEASUREMENT B_frao "Einschaltbedingung f¸r Adaption von frao" UBYTE B_TRUE 1 100 0 1 BIT_MASK 0x1 FORMAT "%13.11" ECU_ADDRESS 0x3FC0D3 /end MEASUREMENT
/begin MEASUREMENT B_fraor "Bedingung frao-Integrator auﬂerhalb reduzierter Bereich" UBYTE B_TRUE 1 100 0 1 BIT_MASK 0x1 FORMAT "%13.11" ECU_ADDRESS 0x3FC0D4 /end MEASUREMENT
/begin MEASUREMENT B_fraor2 "Bedingung frao2-Integrator auﬂerhalb reduzierter Bereich" UBYTE B_TRUE 1 100 0 1 BIT_MASK 0x1 FORMAT "%13.11" ECU_ADDRESS 0x3FC0D5 /end MEASUREMENT
/begin MEASUREMENT B_frat "Einschaltbedingung f¸r Adaption von frat" UBYTE B_TRUE 1 100 0 1 BIT_MASK 0x1 FORMAT "%13.11" ECU_ADDRESS 0x3FC0D6 /end MEASUREMENT
/begin MEASUREMENT B_frau "Einschaltbedingung f¸r Adaption von frau" UBYTE B_TRUE 1 100 0 1 BIT_MASK 0x1 FORMAT "%13.11" ECU_ADDRESS 0x3FC0D7 /end MEASUREMENT
/begin MEASUREMENT B_fraur "Bedingung frau-Integrator auﬂerhalb reduzierter Bereich" UBYTE B_TRUE 1 100 0 1 BIT_MASK 0x1 FORMAT "%13.11" ECU_ADDRESS 0x3FC0D8 /end MEASUREMENT
/begin MEASUREMENT B_fraur2 "Bedingung frau2-Integrator auﬂerhalb reduzierter Bereich" UBYTE B_TRUE 1 100 0 1 BIT_MASK 0x1 FORMAT "%13.11" ECU_ADDRESS 0x3FC0D9 /end MEASUREMENT
/begin MEASUREMENT B_frini "Bedingung Regelfaktor fr initialisieren" UBYTE B_TRUE 1 100 0 1 BIT_MASK 0x1 FORMAT "%13.11" ECU_ADDRESS 0x3FC2DC /end MEASUREMENT
/begin MEASUREMENT B_frini2 "Bedingung Regelfaktor fr initialisieren, Bank 2" UBYTE B_TRUE 1 100 0 1 BIT_MASK 0x1 FORMAT "%13.11" ECU_ADDRESS 0x3FC2DD /end MEASUREMENT
/begin MEASUREMENT B_frmax "Lambda-Regelung setzt Bit sobald FR am Anschlag FRMAX" UBYTE B_TRUE 1 100 0 1 BIT_MASK 0x1 FORMAT "%13.11" ECU_ADDRESS 0x3FC2B2 /end MEASUREMENT
/begin MEASUREMENT B_frmax2 "Lambda-Regelung setzt Bit sobald FR am Anschlag FRMAX, Bank 2" UBYTE B_TRUE 1 100 0 1 BIT_MASK 0x1 FORMAT "%13.11" ECU_ADDRESS 0x3FC2B3 /end MEASUREMENT
/begin MEASUREMENT B_frmin "Lambda-Regelung setzt Bit sobald FR am Anschlag FRMIN" UBYTE B_TRUE 1 100 0 1 BIT_MASK 0x1 FORMAT "%13.11" ECU_ADDRESS 0x3FC2B4 /end MEASUREMENT
/begin MEASUREMENT B_frmin2 "Lambda-Regelung setzt Bit sobald FR am Anschlag FRMIN, Bank 2" UBYTE B_TRUE 1 100 0 1 BIT_MASK 0x1 FORMAT "%13.11" ECU_ADDRESS 0x3FC2B5 /end MEASUREMENT
/begin MEASUREMENT B_gasp "Bedingung Grundadaption gesperrt" UBYTE B_TRUE 1 100 0 1 BIT_MASK 0x1 FORMAT "%13.11" ECU_ADDRESS 0x3FC0E7 /end MEASUREMENT
/begin MEASUREMENT B_hgsndy "Bedingung Drehzahldynamik in gangabh‰ngiger Momentenbegrenzung" UBYTE B_TRUE 1 100 0 1 BIT_MASK 0x4 FORMAT "%13.11" ECU_ADDRESS 0x403CCA /end MEASUREMENT
/begin MEASUREMENT B_idecay "Bedingung Grenzwertreg. auf fettes Soll-Lambda mit Absteuern Integralanteil LRS" UBYTE B_TRUE 1 100 0 1 BIT_MASK 0x1 FORMAT "%13.11" ECU_ADDRESS 0x3FC2B6 /end MEASUREMENT
/begin MEASUREMENT B_idecay2 "Bedingung mit Absteuern Integralanteil LRS, Bank 2" UBYTE B_TRUE 1 100 0 1 BIT_MASK 0x1 FORMAT "%13.11" ECU_ADDRESS 0x3FC2B7 /end MEASUREMENT
/begin MEASUREMENT B_iehshk "lokales Flag f¸r Abfrage HSH-Fehlerpfad gem‰ﬂ Abfrage SY_NOHK" UBYTE B_TRUE 1 100 0 1 BIT_MASK 0x2 FORMAT "%13.11" ECU_ADDRESS 0x403572 /end MEASUREMENT
/begin MEASUREMENT B_iekat "lokales Flag f¸r Abfrage DKAT-Fehlerpfad gem‰ﬂ Abfrage SY_BDE" UBYTE B_TRUE 1 100 0 1 BIT_MASK 0x4 FORMAT "%13.11" ECU_ADDRESS 0x403572 /end MEASUREMENT
/begin MEASUREMENT B_iekat2 "lokales Flag f¸r Abfrage DKAT-Fehlerpfad gem‰ﬂ Abfrage SY_BDE, Bank 2" UBYTE B_TRUE 1 100 0 1 BIT_MASK 0x1 FORMAT "%13.11" ECU_ADDRESS 0x403575 /end MEASUREMENT
/begin MEASUREMENT B_iekati "Flag f¸r Freigabe DKAT-Fehlerpfad f¸r I-Anteil gem‰ﬂ Abfrage SY_BDE" UBYTE B_TRUE 1 100 0 1 BIT_MASK 0x8 FORMAT "%13.11" ECU_ADDRESS 0x403572 /end MEASUREMENT
/begin MEASUREMENT B_iekati2 "Flag f¸r Freigabe DKAT-Fehlerpfad f¸r I-Anteil Bank 2 gem‰ﬂ  Abfrage SY_BDE" UBYTE B_TRUE 1 100 0 1 BIT_MASK 0x2 FORMAT "%13.11" ECU_ADDRESS 0x403575 /end MEASUREMENT
/begin MEASUREMENT B_ielsh "lokales Flag f¸r Abfrage LSH-Fehlerpfad gem‰ﬂ Abfrage SY_BDE" UBYTE B_TRUE 1 100 0 1 BIT_MASK 0x10 FORMAT "%13.11" ECU_ADDRESS 0x403572 /end MEASUREMENT
/begin MEASUREMENT B_ielsh2 "lokales Flag f¸r Abfrage LSH-Fehlerpfad gem‰ﬂ Abfrage SY_BDE, Bank 2" UBYTE B_TRUE 1 100 0 1 BIT_MASK 0x4 FORMAT "%13.11" ECU_ADDRESS 0x403575 /end MEASUREMENT
/begin MEASUREMENT B_iesls "lokales Flag f¸r Abfrage SLS-Fehlerpfad gem‰ﬂ Abfrage SY_SLS" UBYTE B_TRUE 1 100 0 1 BIT_MASK 0x20 FORMAT "%13.11" ECU_ADDRESS 0x403572 /end MEASUREMENT
/begin MEASUREMENT B_iesls2 "lokales Flag f¸r Abfrage SLS-Fehlerpfad gem‰ﬂ Abfrage SY_SLS, Bank 2" UBYTE B_TRUE 1 100 0 1 BIT_MASK 0x8 FORMAT "%13.11" ECU_ADDRESS 0x403575 /end MEASUREMENT
/begin MEASUREMENT B_ieteve2 "lokales Flag f¸r Abfrage TEV-Fehlerpfad gem‰ﬂ Abfrage SY_2TEV, Bank 2" UBYTE B_TRUE 1 100 0 1 BIT_MASK 0x10 FORMAT "%13.11" ECU_ADDRESS 0x403575 /end MEASUREMENT
/begin MEASUREMENT B_iflsd "Bedingung Initialisierung Filter Lastschlagd‰mpfung" UBYTE B_TRUE 1 100 0 1 BIT_MASK 0x1 FORMAT "%13.11" ECU_ADDRESS 0x3FC252 /end MEASUREMENT
/begin MEASUREMENT B_koefini "" UBYTE B_TRUE 1 100 0 1 FORMAT "%13.11" ECU_ADDRESS 0x4037F8 /end MEASUREMENT
/begin MEASUREMENT B_koefkf "" UBYTE B_TRUE 1 100 0 1 FORMAT "%13.11" ECU_ADDRESS 0x4037F9 /end MEASUREMENT
/begin MEASUREMENT B_lamka "Lambda f¸r Kat-Ausr‰umen aktiv" UBYTE B_TRUE 1 100 0 1 BIT_MASK 0x2 FORMAT "%13.11" ECU_ADDRESS 0x40359C /end MEASUREMENT
/begin MEASUREMENT B_lamka2 "Lambda f¸r Kat-Ausr‰umen aktiv" UBYTE B_TRUE 1 100 0 1 BIT_MASK 0x8 FORMAT "%13.11" ECU_ADDRESS 0x40359C /end MEASUREMENT
/begin MEASUREMENT B_lelshbb "Fehler LS hinter Haupt Kat, der Betriebsbereitschaft zur¸cksetzt (lokal)" UBYTE B_TRUE 1 100 0 1 BIT_MASK 0x2 FORMAT "%13.11" ECU_ADDRESS 0x403CE7 /end MEASUREMENT
/begin MEASUREMENT B_lelshbb2 "Fehler LS hinter Haupt Kat, der Betriebsbereitschaft zur¸cksetzt (lokal), Bank 2" UBYTE B_TRUE 1 100 0 1 BIT_MASK 0x10 FORMAT "%13.11" ECU_ADDRESS 0x403CE7 /end MEASUREMENT
/begin MEASUREMENT B_lelsubb "Fehler LSU, der Betriebsbereitschaft zur¸cksetzt (lokal)" UBYTE B_TRUE 1 100 0 1 BIT_MASK 0x4 FORMAT "%13.11" ECU_ADDRESS 0x403CE7 /end MEASUREMENT
/begin MEASUREMENT B_lelsubb2 "Fehler LSU, der Betriebsbereitschaft zur¸cksetzt (lokal), Bank 2" UBYTE B_TRUE 1 100 0 1 BIT_MASK 0x20 FORMAT "%13.11" ECU_ADDRESS 0x403CE7 /end MEASUREMENT
/begin MEASUREMENT B_ll "Bedingung Leerlauf aus Fahrersicht" UBYTE B_TRUE 1 100 0 1 BIT_MASK 0x1 FORMAT "%13.11" ECU_ADDRESS 0x3FC253 /end MEASUREMENT
/begin MEASUREMENT B_lr "LREB: Bedingung Lambdaregelung (vor Kat); (Bank 1)" UBYTE B_TRUE 1 100 0 1 BIT_MASK 0x1 FORMAT "%13.11" ECU_ADDRESS 0x3FC2C7 /end MEASUREMENT
/begin MEASUREMENT B_lr2 "Bedingung Lambdaregelung (vor Kat); Bank 2" UBYTE B_TRUE 1 100 0 1 BIT_MASK 0x1 FORMAT "%13.11" ECU_ADDRESS 0x3FC2C8 /end MEASUREMENT
/begin MEASUREMENT B_lr2s "CARB FREEZE FRAME, Bank1 bit 1, LR: Regelbetrieb mit zwei Sonden" UBYTE B_TRUE 1 100 0 1 BIT_MASK 0x2 FORMAT "%13.11" ECU_ADDRESS 0x403CE5 /end MEASUREMENT
/begin MEASUREMENT B_lr2s2 "CARB FREEZE FRAME, Bank2 Bit 1, LR: Regelbetrieb mit zwei Sonden" UBYTE B_TRUE 1 100 0 1 BIT_MASK 0x2 FORMAT "%13.11" ECU_ADDRESS 0x403CE6 /end MEASUREMENT
/begin MEASUREMENT B_lra "Bedingung Gemischadaption freigegeben" UBYTE B_TRUE 1 100 0 1 BIT_MASK 0x1 FORMAT "%13.11" ECU_ADDRESS 0x3FC0E8 /end MEASUREMENT
/begin MEASUREMENT B_lra2 "Bedingung Gemischadaption 2 freigegeben" UBYTE B_TRUE 1 100 0 1 BIT_MASK 0x1 FORMAT "%13.11" ECU_ADDRESS 0x3FC0E9 /end MEASUREMENT
/begin MEASUREMENT B_lraen "Bedingung Gemischadaption freigegeben" UBYTE B_TRUE 1 100 0 1 BIT_MASK 0x1 FORMAT "%13.11" ECU_ADDRESS 0x3FC0EA /end MEASUREMENT
/begin MEASUREMENT B_lrare "Bedingung Reset LRA" UBYTE B_TRUE 1 100 0 1 BIT_MASK 0x1 FORMAT "%13.11" ECU_ADDRESS 0x3FC0DA /end MEASUREMENT
/begin MEASUREMENT B_lrare2 "Bedingung Reset LRA Bank 2" UBYTE B_TRUE 1 100 0 1 BIT_MASK 0x1 FORMAT "%13.11" ECU_ADDRESS 0x3FC0DB /end MEASUREMENT
/begin MEASUREMENT B_lrareb "Bedingung Resetbereitschaft LRA" UBYTE B_TRUE 1 100 0 1 BIT_MASK 0x1 FORMAT "%13.11" ECU_ADDRESS 0x3FC0DC /end MEASUREMENT
/begin MEASUREMENT B_lrat "Bedingung Gemischadaption temperaturabh‰ngig freigegeben" UBYTE B_TRUE 1 100 0 1 BIT_MASK 0x1 FORMAT "%13.11" ECU_ADDRESS 0x3FC0EB /end MEASUREMENT
/begin MEASUREMENT B_lrdel "Bedingung Lambdaregelung (vor Kat) verzoegert; (Bank 1)" UBYTE B_TRUE 1 100 0 1 BIT_MASK 0x40 FORMAT "%13.11" ECU_ADDRESS 0x403572 /end MEASUREMENT
/begin MEASUREMENT B_lrdel2 "Bedingung Lambdaregelung (vor Kat) verzoegert; (Bank 2)" UBYTE B_TRUE 1 100 0 1 BIT_MASK 0x20 FORMAT "%13.11" ECU_ADDRESS 0x403575 /end MEASUREMENT
/begin MEASUREMENT B_lrhbb "Bankunabh‰nginge Betriebsbereich abh‰ngige Bedingung Freigabe I-Anteil" UBYTE B_TRUE 1 100 0 1 BIT_MASK 0x40 FORMAT "%13.11" ECU_ADDRESS 0x403573 /end MEASUREMENT
/begin MEASUREMENT B_lrhber "Betriebsbereich abh‰ngige Bedingung Freigabe I-Anteil" UBYTE B_TRUE 1 100 0 1 BIT_MASK 0x20 FORMAT "%13.11" ECU_ADDRESS 0x403573 /end MEASUREMENT
/begin MEASUREMENT B_lrhber2 "Betriebsbereich abh‰ngige Bedingung Freigabe I-Anteil Bank 2" UBYTE B_TRUE 1 100 0 1 BIT_MASK 0x8 FORMAT "%13.11" ECU_ADDRESS 0x403576 /end MEASUREMENT
/begin MEASUREMENT B_lrhk "Bedingung Lambdaregelung hinter Kat" UBYTE B_TRUE 1 100 0 1 BIT_MASK 0x1 FORMAT "%13.11" ECU_ADDRESS 0x403570 /end MEASUREMENT
/begin MEASUREMENT B_lrhk2 "Bedingung Lambdaregelung hinter Kat (Bank 2)" UBYTE B_TRUE 1 100 0 1 BIT_MASK 0x1 FORMAT "%13.11" ECU_ADDRESS 0x403571 /end MEASUREMENT
/begin MEASUREMENT B_lrhkb "Bedingung Lambdaregelung h. Kat, bankspez. Parameter Bank 1" UBYTE B_TRUE 1 100 0 1 BIT_MASK 0x80 FORMAT "%13.11" ECU_ADDRESS 0x403572 /end MEASUREMENT
/begin MEASUREMENT B_lrhkb2 "LRHK: Bedingung Lambdaregelung h. Kat, bankspez. Parameter Bank 2" UBYTE B_TRUE 1 100 0 1 BIT_MASK 0x40 FORMAT "%13.11" ECU_ADDRESS 0x403575 /end MEASUREMENT
/begin MEASUREMENT B_lrhkbt "Temperaturbedingung Lambdaregelung h. Kat, bankspez. Bank 1" UBYTE B_TRUE 1 100 0 1 BIT_MASK 0x1 FORMAT "%13.11" ECU_ADDRESS 0x403574 /end MEASUREMENT
/begin MEASUREMENT B_lrhkbt2 "Temperaturbedingung Lambdaregelung h. Kat, bankspez. Bank 2" UBYTE B_TRUE 1 100 0 1 BIT_MASK 0x10 FORMAT "%13.11" ECU_ADDRESS 0x403576 /end MEASUREMENT
/begin MEASUREMENT B_lrhkbti "Temperaturbed. f¸r I-Anteil Lambdaregelung h. Kat, bankspez. Bank 1" UBYTE B_TRUE 1 100 0 1 BIT_MASK 0x2 FORMAT "%13.11" ECU_ADDRESS 0x403574 /end MEASUREMENT
/begin MEASUREMENT B_lrhkbti2 "Temperaturbed. f¸r I-Anteil Lambdaregelung h. Kat, bankspez. Bank 2" UBYTE B_TRUE 1 100 0 1 BIT_MASK 0x20 FORMAT "%13.11" ECU_ADDRESS 0x403576 /end MEASUREMENT
/begin MEASUREMENT B_lrhkbv "Bank 1 bezogene Freigabebedingung, die  auf der Regelung vor Kat basieren" UBYTE B_TRUE 1 100 0 1 BIT_MASK 0x1 FORMAT "%13.11" ECU_ADDRESS 0x403573 /end MEASUREMENT
/begin MEASUREMENT B_lrhkbv2 "Bank 2 bezogene Freigabebedingung, die  auf der Regelung vor Kat basieren" UBYTE B_TRUE 1 100 0 1 BIT_MASK 0x80 FORMAT "%13.11" ECU_ADDRESS 0x403575 /end MEASUREMENT
/begin MEASUREMENT B_lrhkg "bankunabh‰ngige Bedingung Lambdaregelung hinter Kat" UBYTE B_TRUE 1 100 0 1 BIT_MASK 0x1 FORMAT "%13.11" ECU_ADDRESS 0x403572 /end MEASUREMENT
/begin MEASUREMENT B_lrhkgi "bankunabh‰ngige Bedingung I-Anteil Lambdaregelung hinter Kat" UBYTE B_TRUE 1 100 0 1 BIT_MASK 0x2 FORMAT "%13.11" ECU_ADDRESS 0x403573 /end MEASUREMENT
/begin MEASUREMENT B_lrhkp "LRHK: Freigabebedingung P-Anteil Lambdaregelung hinter Kat" UBYTE B_TRUE 1 100 0 1 BIT_MASK 0x2 FORMAT "%13.11" ECU_ADDRESS 0x403570 /end MEASUREMENT
/begin MEASUREMENT B_lrhkp2 "LRHK Bank2: Freigabebedingung P-Anteil Lambdaregelung hinter Kat" UBYTE B_TRUE 1 100 0 1 BIT_MASK 0x2 FORMAT "%13.11" ECU_ADDRESS 0x403571 /end MEASUREMENT
/begin MEASUREMENT B_lrhkpzp "Freigabebedingung P-Anteil Lambdaregelung hinter Kat, Zwei-Punkt-Variante" UBYTE B_TRUE 1 100 0 1 BIT_MASK 0x4 FORMAT "%13.11" ECU_ADDRESS 0x403570 /end MEASUREMENT
/begin MEASUREMENT B_lrhkpzp2 "Freigabebedingung P-Anteil LRHK, Zwei-Punkt-Variante, Bank 2" UBYTE B_TRUE 1 100 0 1 BIT_MASK 0x4 FORMAT "%13.11" ECU_ADDRESS 0x403571 /end MEASUREMENT
/begin MEASUREMENT B_lrhkzp "Bedingung Lambdaregelung hinter Kat, Zweipunkt-Variante" UBYTE B_TRUE 1 100 0 1 BIT_MASK 0x8 FORMAT "%13.11" ECU_ADDRESS 0x403570 /end MEASUREMENT
/begin MEASUREMENT B_lrhkzp2 "Bedingung Lambdaregelung hinter Kat, Zweipunkt-Variante, Bank 2" UBYTE B_TRUE 1 100 0 1 BIT_MASK 0x8 FORMAT "%13.11" ECU_ADDRESS 0x403571 /end MEASUREMENT
/begin MEASUREMENT B_lrhlas "Bedingung lamsons_w = 1.0 ODER B_khls = TRUE" UBYTE B_TRUE 1 100 0 1 BIT_MASK 0x10 FORMAT "%13.11" ECU_ADDRESS 0x403573 /end MEASUREMENT
/begin MEASUREMENT B_lrhlas2 "Bedingung lamsons2_w = 1.0 ODER B_khls = TRUE" UBYTE B_TRUE 1 100 0 1 BIT_MASK 0x4 FORMAT "%13.11" ECU_ADDRESS 0x403576 /end MEASUREMENT
/begin MEASUREMENT B_lrka "Bedingung Katalysator-Ausr‰umen" UBYTE B_TRUE 1 100 0 1 BIT_MASK 0x1 FORMAT "%13.11" ECU_ADDRESS 0x40359C /end MEASUREMENT
/begin MEASUREMENT B_lrka2 "Bedingung Katalysator-Ausr‰umen f¸r Stereo-LR Bank 2" UBYTE B_TRUE 1 100 0 1 BIT_MASK 0x4 FORMAT "%13.11" ECU_ADDRESS 0x40359C /end MEASUREMENT
/begin MEASUREMENT B_lrkaa "Bedingung Katalysator-Ausr‰umen auf-/abregeln" UBYTE B_TRUE 1 100 0 1 BIT_MASK 0x4 FORMAT "%13.11" ECU_ADDRESS 0x40359D /end MEASUREMENT
/begin MEASUREMENT B_lrkaa2 "Bedingung Katalysator-Ausr‰umen auf-/abregeln, Bank 2" UBYTE B_TRUE 1 100 0 1 BIT_MASK 0x20 FORMAT "%13.11" ECU_ADDRESS 0x40359D /end MEASUREMENT
/begin MEASUREMENT B_lrkae "Bedingung gesteuertes Katalysator-Ausr‰umen mˆglich" UBYTE B_TRUE 1 100 0 1 BIT_MASK 0x1 FORMAT "%13.11" ECU_ADDRESS 0x40359D /end MEASUREMENT
/begin MEASUREMENT B_lrkae2 "Bedingung gesteuertes Katalysator-Ausr‰umen mˆglich, Bank 2" UBYTE B_TRUE 1 100 0 1 BIT_MASK 0x8 FORMAT "%13.11" ECU_ADDRESS 0x40359D /end MEASUREMENT
/begin MEASUREMENT B_lrkaint "Lokale Bedingung Katalysator-Ausr‰umen umgesetzt auf 100ms-Raster" UBYTE B_TRUE 1 100 0 1 BIT_MASK 0x4 FORMAT "%13.11" ECU_ADDRESS 0x403573 /end MEASUREMENT
/begin MEASUREMENT B_lrkaint2 "Lokale Bedingung Katalysator-Ausr‰umen umgesetzt auf 100ms-Raster, Bank 2" UBYTE B_TRUE 1 100 0 1 BIT_MASK 0x1 FORMAT "%13.11" ECU_ADDRESS 0x403576 /end MEASUREMENT
/begin MEASUREMENT B_lrmsbrc "Bit Bereitschaft zum Reset bei Magerschutz" UBYTE B_TRUE 1 100 0 1 BIT_MASK 0x1 FORMAT "%13.11" ECU_ADDRESS 0x403CE3 /end MEASUREMENT
/begin MEASUREMENT B_lrmsbrc2 "Bit Bereitschaft zum Reset bei Magerschutz, Bank 2" UBYTE B_TRUE 1 100 0 1 BIT_MASK 0x2 FORMAT "%13.11" ECU_ADDRESS 0x403CE3 /end MEASUREMENT
/begin MEASUREMENT B_lrmsbs "Bedingung Abmagerungsverbot f¸r stetige Regelung, Bank 1" UBYTE B_TRUE 1 100 0 1 BIT_MASK 0x1 FORMAT "%13.11" ECU_ADDRESS 0x3FC2C9 /end MEASUREMENT
/begin MEASUREMENT B_lrmsbs2 "Bedingung Abmagerungsverbot f¸r stetige Regelung, Bank 2" UBYTE B_TRUE 1 100 0 1 BIT_MASK 0x1 FORMAT "%13.11" ECU_ADDRESS 0x3FC2CA /end MEASUREMENT
/begin MEASUREMENT B_lrnda "LR Bank1 aktiv, eventuell eingeschr‰nkt" UBYTE B_TRUE 1 100 0 1 BIT_MASK 0x1 FORMAT "%13.11" ECU_ADDRESS 0x3FC2CB /end MEASUREMENT
/begin MEASUREMENT B_lrnda2 "LR Bank2 aktiv, eventuell eingeschr‰nkt" UBYTE B_TRUE 1 100 0 1 BIT_MASK 0x1 FORMAT "%13.11" ECU_ADDRESS 0x3FC2CC /end MEASUREMENT
/begin MEASUREMENT B_lrrl "LREB: Von Last abh‰ngige Bedingung Lambdaregelung (vor Kat)" UBYTE B_TRUE 1 100 0 1 BIT_MASK 0x1 FORMAT "%13.11" ECU_ADDRESS 0x3FC2CD /end MEASUREMENT
/begin MEASUREMENT B_lrs "LRSEB: Bedingung Lambdaregelung intern (vor Kat), Bank 1" UBYTE B_TRUE 1 100 0 1 BIT_MASK 0x1 FORMAT "%13.11" ECU_ADDRESS 0x3FC2CE /end MEASUREMENT
/begin MEASUREMENT B_lrs2 "LRSEB: Bedingung Lambdaregelung intern (vor Kat), Bank 2" UBYTE B_TRUE 1 100 0 1 BIT_MASK 0x1 FORMAT "%13.11" ECU_ADDRESS 0x3FC2CF /end MEASUREMENT
/begin MEASUREMENT B_lrsrems "Bedingung fr-reset bei Abmagerungsverbot f¸r Bank 1" UBYTE B_TRUE 1 100 0 1 BIT_MASK 0x1 FORMAT "%13.11" ECU_ADDRESS 0x3FC2B8 /end MEASUREMENT
/begin MEASUREMENT B_lrsrems2 "Bedingung fr-reset bei Abmagerungsverbot f¸r Bank 2" UBYTE B_TRUE 1 100 0 1 BIT_MASK 0x1 FORMAT "%13.11" ECU_ADDRESS 0x3FC2B9 /end MEASUREMENT
/begin MEASUREMENT B_lrsresf "Bedingung Fr-Reset bei lamsons<LALIUSMN" UBYTE B_TRUE 1 100 0 1 BIT_MASK 0x1 FORMAT "%13.11" ECU_ADDRESS 0x3FC2D0 /end MEASUREMENT
/begin MEASUREMENT B_lrssa "LRSEB: Einschaltbed. f¸r Lambdareg. nach Schub bei langsamer Sonde" UBYTE B_TRUE 1 100 0 1 BIT_MASK 0x1 FORMAT "%13.11" ECU_ADDRESS 0x3FC2D1 /end MEASUREMENT
/begin MEASUREMENT B_lrssa2 "Einschaltbed. f¸r Lambdareg. nach Schub bei langsamer Sonde, Bank2" UBYTE B_TRUE 1 100 0 1 BIT_MASK 0x1 FORMAT "%13.11" ECU_ADDRESS 0x3FC2D2 /end MEASUREMENT
/begin MEASUREMENT B_lrssp "Lamda-Regelung setzt Bit, wenn Zusatzamplitude Vorzeichenwechsel" UBYTE B_TRUE 1 100 0 1 BIT_MASK 0x1 FORMAT "%13.11" ECU_ADDRESS 0x3FC2BA /end MEASUREMENT
/begin MEASUREMENT B_lrssp2 "Lambda-Regelung setzt Bit bei Vorzeichenwechsel Zusatzamplitude Bank 2" UBYTE B_TRUE 1 100 0 1 BIT_MASK 0x1 FORMAT "%13.11" ECU_ADDRESS 0x3FC2BB /end MEASUREMENT
/begin MEASUREMENT B_lrvk "CARB FREEZE FRAME, Bank1 Bit 4, LR: Regelung nur mit einer Sonde (vor KAT)" UBYTE B_TRUE 1 100 0 1 BIT_MASK 0x10 FORMAT "%13.11" ECU_ADDRESS 0x403CE5 /end MEASUREMENT
/begin MEASUREMENT B_lrvk2 "CARB FREEZE FRAME, Bank2 Bit 4, LR: Regelung nur mit einer Sonde (vor KAT)" UBYTE B_TRUE 1 100 0 1 BIT_MASK 0x10 FORMAT "%13.11" ECU_ADDRESS 0x403CE6 /end MEASUREMENT
/begin MEASUREMENT B_ls "Bedingung: Lastschlagbegrenzung kleiner Fahrerwunsch (=1)" UBYTE B_TRUE 1 100 0 1 BIT_MASK 0x1 FORMAT "%13.11" ECU_ADDRESS 0x3FC254 /end MEASUREMENT
/begin MEASUREMENT B_lsd "Bedingung: Pos. Lastschlagd‰mpfung aktiv" UBYTE B_TRUE 1 100 0 1 BIT_MASK 0x1 FORMAT "%13.11" ECU_ADDRESS 0x3FC255 /end MEASUREMENT
/begin MEASUREMENT B_mdee "Bedingung Momentenreduzierung ¸ber Einspritzausblendung erlaubt" UBYTE B_TRUE 1 100 0 1 BIT_MASK 0x1 FORMAT "%13.11" ECU_ADDRESS 0x3FC265 /end MEASUREMENT
/begin MEASUREMENT B_mdein "Bedingung Momenteneingriff aktiv" UBYTE B_TRUE 1 100 0 1 BIT_MASK 0x1 FORMAT "%13.11" ECU_ADDRESS 0x3FC25D /end MEASUREMENT
/begin MEASUREMENT B_mdredhyein "" UBYTE B_TRUE 1 100 0 1 BIT_MASK 0x1 FORMAT "%13.11" ECU_ADDRESS 0x3FC266 /end MEASUREMENT
/begin MEASUREMENT B_mibeg "Bedingung Momentenbegrenzung ist aktiv" UBYTE B_TRUE 1 100 0 1 BIT_MASK 0x1 FORMAT "%13.11" ECU_ADDRESS 0x3FC25E /end MEASUREMENT
/begin MEASUREMENT B_mibgr "Bedingung Regelung der gangabh. Momentenbegrenzung aktiv" UBYTE B_TRUE 1 100 0 1 BIT_MASK 0x8 FORMAT "%13.11" ECU_ADDRESS 0x403CCA /end MEASUREMENT
/begin MEASUREMENT B_mlevab "Bit Lambdaregelung bei/nach Zylinderausblendung" UBYTE B_TRUE 1 100 0 1 BIT_MASK 0x1 FORMAT "%13.11" ECU_ADDRESS 0x3FC2D3 /end MEASUREMENT
/begin MEASUREMENT B_mlevab2 "Bit Lambdaregelung bei/nach Zylinderausblendung, Bank 2" UBYTE B_TRUE 1 100 0 1 BIT_MASK 0x1 FORMAT "%13.11" ECU_ADDRESS 0x3FC2D4 /end MEASUREMENT
/begin MEASUREMENT B_mlrsa "LRSEB: Ausschaltbed. f¸r Lambdareg. auf bei und nach Schub ¸ber Luftmassenschw." UBYTE B_TRUE 1 100 0 1 BIT_MASK 0x1 FORMAT "%13.11" ECU_ADDRESS 0x3FC2D5 /end MEASUREMENT
/begin MEASUREMENT B_mrakt "Bedingung: Momentenreserve aktiv" UBYTE B_TRUE 1 100 0 1 BIT_MASK 0x1 FORMAT "%13.11" ECU_ADDRESS 0x3FC264 /end MEASUREMENT
/begin MEASUREMENT B_msabhka "Abgasmassenschwelle nach Kat-Ausr‰umen ¸berschritten; (Bank 1)" UBYTE B_TRUE 1 100 0 1 BIT_MASK 0x8 FORMAT "%13.11" ECU_ADDRESS 0x403573 /end MEASUREMENT
/begin MEASUREMENT B_msabhka2 "Abgasmassenschwelle nach Kat-Ausr‰umen ¸berschritten;  Bank 2" UBYTE B_TRUE 1 100 0 1 BIT_MASK 0x2 FORMAT "%13.11" ECU_ADDRESS 0x403576 /end MEASUREMENT
/begin MEASUREMENT B_msr "Bedingung f¸r Momentenschlupfregelung" UBYTE B_TRUE 1 100 0 1 BIT_MASK 0x1 FORMAT "%13.11" ECU_ADDRESS 0x3FC25F /end MEASUREMENT
/begin MEASUREMENT B_nofra "Bedingung Sperren der multiplikativen Gemischkorrektur" UBYTE B_TRUE 1 100 0 1 BIT_MASK 0x1 FORMAT "%13.11" ECU_ADDRESS 0x3FC0DD /end MEASUREMENT
/begin MEASUREMENT B_nofrat "Bedingung Sperren der temperaturabh‰ngige Gemischkorrektur" UBYTE B_TRUE 1 100 0 1 BIT_MASK 0x1 FORMAT "%13.11" ECU_ADDRESS 0x3FC0DE /end MEASUREMENT
/begin MEASUREMENT B_nolrb "CARB FREEZE FRAME, Bank1 Bit 2, LR: Steuerbetrieb durch Betriebsbedingungen" UBYTE B_TRUE 1 100 0 1 BIT_MASK 0x4 FORMAT "%13.11" ECU_ADDRESS 0x403CE5 /end MEASUREMENT
/begin MEASUREMENT B_nolrb2 "CARB FREEZE FRAME, Bank2 Bit 2, LR: Steuerung durch Betriebsbedingung" UBYTE B_TRUE 1 100 0 1 BIT_MASK 0x4 FORMAT "%13.11" ECU_ADDRESS 0x403CE6 /end MEASUREMENT
/begin MEASUREMENT B_nolre "CARB FREEZE FRAME, Bank1 Bit 3, LR: Steuerung nach Systemfehler" UBYTE B_TRUE 1 100 0 1 BIT_MASK 0x8 FORMAT "%13.11" ECU_ADDRESS 0x403CE5 /end MEASUREMENT
/begin MEASUREMENT B_nolre2 "CARB FREEZE FRAME, Bank2 Bit 3, LR: Steuerung nach Systemfehler" UBYTE B_TRUE 1 100 0 1 BIT_MASK 0x8 FORMAT "%13.11" ECU_ADDRESS 0x403CE6 /end MEASUREMENT
/begin MEASUREMENT B_nolrw "CARB FREEZE FRAME, Bank1 Bit 0, LR: Steuerbetrieb, Startbed. noch nicht erf¸llt" UBYTE B_TRUE 1 100 0 1 BIT_MASK 0x1 FORMAT "%13.11" ECU_ADDRESS 0x403CE5 /end MEASUREMENT
/begin MEASUREMENT B_nolrw2 "CARB FREEZE FRAME, Bank2 Bit 0, LR: Steuerbetrieb, Startbed. noch nicht erf¸llt" UBYTE B_TRUE 1 100 0 1 BIT_MASK 0x1 FORMAT "%13.11" ECU_ADDRESS 0x403CE6 /end MEASUREMENT
/begin MEASUREMENT B_norkat "Bedingung additive Korrektur der Gemischadaption pro Zeit abgeschaltet" UBYTE B_TRUE 1 100 0 1 BIT_MASK 0x1 FORMAT "%13.11" ECU_ADDRESS 0x3FC0DF /end MEASUREMENT
/begin MEASUREMENT B_norkaz "Bedingung additive Korrektur der Gemischadaption pro Z¸ndung abgeschaltet" UBYTE B_TRUE 1 100 0 1 BIT_MASK 0x1 FORMAT "%13.11" ECU_ADDRESS 0x3FC0E0 /end MEASUREMENT
/begin MEASUREMENT B_pedsport "Bedingung umschalten auf KFPEDS" UBYTE B_TRUE 1 100 0 1 BIT_MASK 0x1 FORMAT "%13.11" ECU_ADDRESS 0x3FC256 /end MEASUREMENT
/begin MEASUREMENT B_pspaus "Bedingung LR inaktiv bei projektspez. AUS-Bedingungen" UBYTE B_TRUE 1 100 0 1 BIT_MASK 0x1 FORMAT "%13.11" ECU_ADDRESS 0x3FC2D6 /end MEASUREMENT
/begin MEASUREMENT B_pspwl "Bedingung LR inaktiv bei projektspez. Warmlauf-Bedingungen" UBYTE B_TRUE 1 100 0 1 BIT_MASK 0x1 FORMAT "%13.11" ECU_ADDRESS 0x3FC2D7 /end MEASUREMENT
/begin MEASUREMENT B_rkat "Bedingung Lernbereich additive Korrektur pro Zeit aktiv" UBYTE B_TRUE 1 100 0 1 BIT_MASK 0x1 FORMAT "%13.11" ECU_ADDRESS 0x3FC0E1 /end MEASUREMENT
/begin MEASUREMENT B_rkatr "Bedingung rkat-Integrator auﬂerhalb reduzierten Bereich" UBYTE B_TRUE 1 100 0 1 BIT_MASK 0x1 FORMAT "%13.11" ECU_ADDRESS 0x3FC0E2 /end MEASUREMENT
/begin MEASUREMENT B_rkatr2 "Bedingung rkat2-Integrator auﬂerhalb reduzierten Bereich" UBYTE B_TRUE 1 100 0 1 BIT_MASK 0x1 FORMAT "%13.11" ECU_ADDRESS 0x3FC0E3 /end MEASUREMENT
/begin MEASUREMENT B_rkaz "Bedingung Lernbereich additive Korrektur pro Z¸ndung aktiv" UBYTE B_TRUE 1 100 0 1 BIT_MASK 0x1 FORMAT "%13.11" ECU_ADDRESS 0x3FC0E4 /end MEASUREMENT
/begin MEASUREMENT B_rkazr "Bedingung rkaz-Integrator auﬂerhalb reduzierten Bereich" UBYTE B_TRUE 1 100 0 1 BIT_MASK 0x1 FORMAT "%13.11" ECU_ADDRESS 0x3FC0E5 /end MEASUREMENT
/begin MEASUREMENT B_rkazr2 "Bedingung rkaz2-Integrator auﬂerhalb reduzierten Bereich" UBYTE B_TRUE 1 100 0 1 BIT_MASK 0x1 FORMAT "%13.11" ECU_ADDRESS 0x3FC0E6 /end MEASUREMENT
/begin MEASUREMENT B_sa "Bedingung Schubabschalten" UBYTE B_TRUE 1 100 0 1 BIT_MASK 0x1 FORMAT "%13.11" ECU_ADDRESS 0x3FC267 /end MEASUREMENT
/begin MEASUREMENT B_savmd "Bedingung: Schubabschalteverbot wegen Momentenanforderung" UBYTE B_TRUE 1 100 0 1 BIT_MASK 0x1 FORMAT "%13.11" ECU_ADDRESS 0x3FC260 /end MEASUREMENT
/begin MEASUREMENT B_sbbnhhk "Bedingung Sonde hinter Haupt-Kat betriebsbereit" UBYTE B_TRUE 1 100 0 1 BIT_MASK 0x1 FORMAT "%13.11" ECU_ADDRESS 0x403807 /end MEASUREMENT
/begin MEASUREMENT B_sgs "Bedingung: Momenteingriff zur Drehzahlsynchronisation bei Getriebeschaltung" UBYTE B_TRUE 1 100 0 1 BIT_MASK 0x1 FORMAT "%13.11" ECU_ADDRESS 0x3FC261 /end MEASUREMENT
/begin MEASUREMENT B_slspaus "Sekund‰rluft-spezifisches Sperrbit f¸r Lambdaregelung" UBYTE B_TRUE 1 100 0 1 BIT_MASK 0x1 FORMAT "%13.11" ECU_ADDRESS 0x3FC2D8 /end MEASUREMENT
/begin MEASUREMENT B_tarau "LREB: Bedingung Start bei niedrigen Ansauglufttemperaturen" UBYTE B_TRUE 1 100 0 1 BIT_MASK 0x1 FORMAT "%13.11" ECU_ADDRESS 0x3FC2D9 /end MEASUREMENT
/begin MEASUREMENT B_tmlr "LREB: Von Motortemp. abh‰ngige Bedingungen Lambdaregelung (vor Kat)" UBYTE B_TRUE 1 100 0 1 BIT_MASK 0x1 FORMAT "%13.11" ECU_ADDRESS 0x3FC2DA /end MEASUREMENT
/begin MEASUREMENT B_trigger "Start Signal im Oszillator f¸r Zwangsamplitude" UBYTE B_TRUE 1 100 0 1 BIT_MASK 0x1 FORMAT "%13.11" ECU_ADDRESS 0x3FC2BC /end MEASUREMENT
/begin MEASUREMENT B_tsten "Freigabe Grundadaption ¸ber Tester" UBYTE B_TRUE 1 100 0 1 BIT_MASK 0x1 FORMAT "%13.11" ECU_ADDRESS 0x3FC0EC /end MEASUREMENT
/begin MEASUREMENT B_update "B_update = false    kein Update der Zustandsgroessen in der LRS" UBYTE B_TRUE 1 100 0 1 BIT_MASK 0x1 FORMAT "%13.11" ECU_ADDRESS 0x3FC2BD /end MEASUREMENT
/begin MEASUREMENT B_update2 "B_update2= false    kein Update der Zustandsgroessen in der LRS, Bank2" UBYTE B_TRUE 1 100 0 1 BIT_MASK 0x1 FORMAT "%13.11" ECU_ADDRESS 0x3FC2BE /end MEASUREMENT
/begin MEASUREMENT B_vlsumrs "Bedingung Verdacht Magershift LSU bei nicht abgek¸hlter Sonde" UBYTE B_TRUE 1 100 0 1 BIT_MASK 0x1 FORMAT "%13.11" ECU_ADDRESS 0x403BA1 /end MEASUREMENT
/begin MEASUREMENT B_vlsumrs2 "Bedingung Verdacht Magershift LSU bei nicht abgek¸hlter Sonde, Bank 2" UBYTE B_TRUE 1 100 0 1 BIT_MASK 0x2 FORMAT "%13.11" ECU_ADDRESS 0x403BA1 /end MEASUREMENT
/begin MEASUREMENT B_wememo "" UBYTE B_TRUE 1 100 0 1 BIT_MASK 0x1 FORMAT "%13.11" ECU_ADDRESS 0x3FC257 /end MEASUREMENT
/begin MEASUREMENT B_y2max "Integralanteil der LRS hat obere Schranke erreicht" UBYTE B_TRUE 1 100 0 1 BIT_MASK 0x1 FORMAT "%13.11" ECU_ADDRESS 0x3FC2BF /end MEASUREMENT
/begin MEASUREMENT B_y2max2 "Integralanteil der LRS hat obere Schranke erreicht, Bank2" UBYTE B_TRUE 1 100 0 1 BIT_MASK 0x1 FORMAT "%13.11" ECU_ADDRESS 0x3FC2C0 /end MEASUREMENT
/begin MEASUREMENT B_y2min "Integralanteil der LRS hat untere Schranke erreicht" UBYTE B_TRUE 1 100 0 1 BIT_MASK 0x1 FORMAT "%13.11" ECU_ADDRESS 0x3FC2C1 /end MEASUREMENT
/begin MEASUREMENT B_y2min2 "Integralanteil der LRS hat untere Schranke erreicht, Bank2" UBYTE B_TRUE 1 100 0 1 BIT_MASK 0x1 FORMAT "%13.11" ECU_ADDRESS 0x3FC2C2 /end MEASUREMENT
/begin MEASUREMENT B_za "Bedingung Zwangsamplitude" UBYTE B_TRUE 1 100 0 1 BIT_MASK 0x1 FORMAT "%13.11" ECU_ADDRESS 0x3FC2C3 /end MEASUREMENT
/begin MEASUREMENT B_za2 "Bedingung Zwangsamplitude, Bank2" UBYTE B_TRUE 1 100 0 1 BIT_MASK 0x1 FORMAT "%13.11" ECU_ADDRESS 0x3FC2C4 /end MEASUREMENT
/begin MEASUREMENT B_zwvs "Bedingung f¸r schnellen ‰uﬂeren ZW-Eingriff der Momentenschnittstelle" UBYTE B_TRUE 1 100 0 1 BIT_MASK 0x1 FORMAT "%13.11" ECU_ADDRESS 0x3FC262 /end MEASUREMENT
/begin MEASUREMENT B_zwvz "Bedingung f¸r Z¸ndwinkeleingriff der Momentenschnittstelle" UBYTE B_TRUE 1 100 0 1 BIT_MASK 0x1 FORMAT "%13.11" ECU_ADDRESS 0x3FC263 /end MEASUREMENT
/begin MEASUREMENT dfr2_w "Delta Lambdaregler (Faktor ), Bank2" SWORD fak_sw_b1 1 100 -1 0.999969 FORMAT "%8.6" ECU_ADDRESS 0x404258 /end MEASUREMENT
/begin MEASUREMENT dfrm2_w "Abweichung schneller Mittelwert des Lambdareglers von 1.0 (Word)" SWORD fak_sw_b1 1 100 -1 0.999969 FORMAT "%8.6" ECU_ADDRESS 0x402DA8 /end MEASUREMENT
/begin MEASUREMENT dfrmin2_w "Untergrenze von dfr_w bei Magerschutz, Bank2" SWORD fak_sw_b1 1 100 -1 0.999969 FORMAT "%8.6" ECU_ADDRESS 0x40425A /end MEASUREMENT
/begin MEASUREMENT dfrmin_w "Untergrenze von dfr_w bei Magerschutz" SWORD fak_sw_b1 1 100 -1 0.999969 FORMAT "%8.6" ECU_ADDRESS 0x40425C /end MEASUREMENT
/begin MEASUREMENT dfrmn2_w "Untergrenze von dfr_w, Bank2" SWORD fak_sw_b1 1 100 -1 0.999969 FORMAT "%8.6" ECU_ADDRESS 0x40425E /end MEASUREMENT
/begin MEASUREMENT dfrmn_w "Untergrenze von dfr_w" SWORD fak_sw_b1 1 100 -1 0.999969 FORMAT "%8.6" ECU_ADDRESS 0x404260 /end MEASUREMENT
/begin MEASUREMENT dfrmt2_w "Abweichung schneller Mittelwert des Lambdareglers von 1.0 (Word)" SWORD fak_sw_b1 1 100 -1 0.999969 FORMAT "%8.6" ECU_ADDRESS 0x402DAA /end MEASUREMENT
/begin MEASUREMENT dfrmt_w "Abweichung schneller Mittelwert des Lambdareglers von 1.0 (Word)" SWORD fak_sw_b1 1 100 -1 0.999969 FORMAT "%8.6" ECU_ADDRESS 0x402DAC /end MEASUREMENT
/begin MEASUREMENT dfrm_w "Abweichung schneller Mittelwert des Lambdareglers von 1.0 (Word)" SWORD fak_sw_b1 1 100 -1 0.999969 FORMAT "%8.6" ECU_ADDRESS 0x402DAE /end MEASUREMENT
/begin MEASUREMENT dfrpr2_w "Delta Lambdaregler (Faktor); vorl‰ufiger Wert vor Abfrage auf Magerschutz, Bank2" SWORD fak_sw_b1 1 100 -1 0.999969 FORMAT "%8.6" ECU_ADDRESS 0x404262 /end MEASUREMENT
/begin MEASUREMENT dfrpr_w "Delta Lambdaregler (Faktor); vorl‰ufiger Wert vor Abfrage auf Magerschutz" SWORD fak_sw_b1 1 100 -1 0.999969 FORMAT "%8.6" ECU_ADDRESS 0x404264 /end MEASUREMENT
/begin MEASUREMENT dfrza2_w "LRS-Zwangsamplitude, Bank 2" SWORD fak_sw_b1 1 100 -1 0.999969 FORMAT "%8.6" ECU_ADDRESS 0x404266 /end MEASUREMENT
/begin MEASUREMENT dfrzaf2_w "LRS-Zwangsamplitude, gefiltert, Bank 2" SWORD fak_sw_b1 1 100 -1 0.999969 FORMAT "%8.6" ECU_ADDRESS 0x404268 /end MEASUREMENT
/begin MEASUREMENT dfrzaff2_w "Zusatzamplitude gefiltert auf fr-Ebene, Bank 2" SWORD fak_sw_b1 1 100 -1 0.999969 FORMAT "%8.6" ECU_ADDRESS 0x40426A /end MEASUREMENT
/begin MEASUREMENT dfrzaff_w "Zusatzamplitude gefiltert auf fr-Ebene" SWORD fak_sw_b1 1 100 -1 0.999969 FORMAT "%8.6" ECU_ADDRESS 0x40426C /end MEASUREMENT
/begin MEASUREMENT dfrzaf_w "LRS-Zwangsamplitude, gefiltert" SWORD fak_sw_b1 1 100 -1 0.999969 FORMAT "%8.6" ECU_ADDRESS 0x40426E /end MEASUREMENT
/begin MEASUREMENT dfrzapr_w "Gesteuerte Rechteckschwingung f¸r Zwangsamplitude" SWORD fak_sw_b1 1 100 -1 0.999969 FORMAT "%8.6" ECU_ADDRESS 0x404270 /end MEASUREMENT
/begin MEASUREMENT dfrza_w "LRS-Zwangsamplitude" SWORD fak_sw_b1 1 100 -1 0.999969 FORMAT "%8.6" ECU_ADDRESS 0x404272 /end MEASUREMENT
/begin MEASUREMENT dfr_w "Delta Lambdaregler (Faktor )" SWORD fak_sw_b1 1 100 -1 0.999969 FORMAT "%8.6" ECU_ADDRESS 0x404274 /end MEASUREMENT
/begin MEASUREMENT dlahfi2_w "I-Eingriff der Hinterkat-Sonden, Bank 2" SWORD fak_sw_b1 1 100 -1 0.999969 FORMAT "%8.6" ECU_ADDRESS 0x4047E4 /end MEASUREMENT
/begin MEASUREMENT dlahfi_w "I-Eingriff der Hinterkat-Sonden" SWORD fak_sw_b1 1 100 -1 0.999969 FORMAT "%8.6" ECU_ADDRESS 0x4047E6 /end MEASUREMENT
/begin MEASUREMENT dlahfp2_w "P-Eingriff der Hinterkat-Sonden, Bank 2" SWORD fak_sw_b1 1 100 -1 0.999969 FORMAT "%8.6" ECU_ADDRESS 0x4047E8 /end MEASUREMENT
/begin MEASUREMENT dlahfp_w "P-Eingriff der Hinterkat-Sonden" SWORD fak_sw_b1 1 100 -1 0.999969 FORMAT "%8.6" ECU_ADDRESS 0x4047EA /end MEASUREMENT
/begin MEASUREMENT dlahi2_w "I-Anteil der stetigen LRHK2" SWORD fak_sw_b1 1 100 -1 0.999969 FORMAT "%8.6" ECU_ADDRESS 0x4047EC /end MEASUREMENT
/begin MEASUREMENT dlahico2_w "I-Anteil der stetigen LRSHK Variante kontinuierlich, Bank 2" SWORD fak_sw_b1 1 100 -1 0.999969 FORMAT "%8.6" ECU_ADDRESS 0x3FE288 /end MEASUREMENT
/begin MEASUREMENT dlahico_w "I-Anteil der stetigen LRSHK Variante kontinuierlich" SWORD fak_sw_b1 1 100 -1 0.999969 FORMAT "%8.6" ECU_ADDRESS 0x3FE28A /end MEASUREMENT
/begin MEASUREMENT dlahini2_w "Intialisierungswert f¸r Integralanteil LRSHK, Bank2" SWORD fak_sw_b1 1 100 -1 0.999969 FORMAT "%8.6" ECU_ADDRESS 0x403542 /end MEASUREMENT
/begin MEASUREMENT dlahini_w "Intialisierungswert f¸r Integralanteil LRSHK" SWORD fak_sw_b1 1 100 -1 0.999969 FORMAT "%8.6" ECU_ADDRESS 0x403544 /end MEASUREMENT
/begin MEASUREMENT dlahi_w "I-Anteil der stetigen LRHK" SWORD fak_sw_b1 1 100 -1 0.999969 FORMAT "%8.6" ECU_ADDRESS 0x4047EE /end MEASUREMENT
/begin MEASUREMENT dlahkab2_w "Dynamische ‹berhˆhung des Pseudo Lambda-Sollwertes hinter Kat, Bank2" SWORD fak_sw_b1 1 100 -1 0.999969 FORMAT "%8.6" ECU_ADDRESS 0x4047F6 /end MEASUREMENT
/begin MEASUREMENT dlahkab_w "Dynamische ‹berhˆhung des Pseudo Lambda-Sollwertes hinter Kat" SWORD fak_sw_b1 1 100 -1 0.999969 FORMAT "%8.6" ECU_ADDRESS 0x4047F8 /end MEASUREMENT
/begin MEASUREMENT dlahp2_w "P-Anteil der stetigen LRHK2" SWORD fak_sw_b1 1 100 -1 0.999969 FORMAT "%8.6" ECU_ADDRESS 0x4047F0 /end MEASUREMENT
/begin MEASUREMENT dlahpco2_w "P-Anteil der stetigen LRSHK Variante kontinuierlich, Bank 2" SWORD fak_sw_b1 1 100 -1 0.999969 FORMAT "%8.6" ECU_ADDRESS 0x403546 /end MEASUREMENT
/begin MEASUREMENT dlahpco_w "P-Anteil der stetigen LRSHK Variante kontinuierlich" SWORD fak_sw_b1 1 100 -1 0.999969 FORMAT "%8.6" ECU_ADDRESS 0x403548 /end MEASUREMENT
/begin MEASUREMENT dlahp_w "P-Anteil der stetigen LRHK" SWORD fak_sw_b1 1 100 -1 0.999969 FORMAT "%8.6" ECU_ADDRESS 0x4047F2 /end MEASUREMENT
/begin MEASUREMENT dlamka2_w "Delta-Lambda: Hilfsgrˆsse f¸r Auf-/Abregeln von lamka2_w f¸r Bank 2" SWORD fak_sw_b8 1 100 -1 1 FORMAT "%8.6" ECU_ADDRESS 0x403578 /end MEASUREMENT
/begin MEASUREMENT dlamka_w "Delta-Lambda: Hilfsgrˆsse f¸r Auf-/Abregeln von lamka_w" SWORD fak_sw_b8 1 100 -1 1 FORMAT "%8.6" ECU_ADDRESS 0x40357A /end MEASUREMENT
/begin MEASUREMENT dlashki2_w "Delta-Lambda gewichtet f¸r I-Anteil LRSHK, Bank2" SWORD fak_sw_b1 1 100 -1 0.999969 FORMAT "%8.6" ECU_ADDRESS 0x40354A /end MEASUREMENT
/begin MEASUREMENT dlashki_w "Delta-Lambda gewichtet f¸r I-Anteil LRSHK" SWORD fak_sw_b1 1 100 -1 0.999969 FORMAT "%8.6" ECU_ADDRESS 0x40354C /end MEASUREMENT
/begin MEASUREMENT dlashkm2_w "Delta-Lambda aus Lambdaregelung hinter Kat (Ist-Wert fr-synchron gemittelt), Ba2" SWORD fak_sw_b1 1 100 -1 0.999969 FORMAT "%8.6" ECU_ADDRESS 0x40354E /end MEASUREMENT
/begin MEASUREMENT dlashkm_w "Delta-Lambda aus Lambdaregelung hinter Kat (Ist-Wert fr-synchron gemittelt)" SWORD fak_sw_b1 1 100 -1 0.999969 FORMAT "%8.6" ECU_ADDRESS 0x403550 /end MEASUREMENT
/begin MEASUREMENT dlashkp2_w "Delta-Lambda gewichtet f¸r P-Anteil LRSHK5.30, Bank2" SWORD fak_sw_b1 1 100 -1 0.999969 FORMAT "%8.6" ECU_ADDRESS 0x403552 /end MEASUREMENT
/begin MEASUREMENT dlashkp_w "Delta-Lambda gewichtet f¸r P-Anteil LRSHK5.30" SWORD fak_sw_b1 1 100 -1 0.999969 FORMAT "%8.6" ECU_ADDRESS 0x403554 /end MEASUREMENT
/begin MEASUREMENT dlaso "Korrekturwert Lambda-Sollwert f¸r stetigen Lambdaregler, 8 Bit" SBYTE fak_sb_b0p03125 1 100 -0.03125 0.0310059 FORMAT "%7.5" ECU_ADDRESS 0x403CE0 /end MEASUREMENT
/begin MEASUREMENT dlaso2 "Korrekturwert Lambda-Sollwert f¸r stetigen Lambdaregler, 8 Bit, Bank 2" SBYTE fak_sb_b0p03125 1 100 -0.03125 0.0310059 FORMAT "%7.5" ECU_ADDRESS 0x403CE1 /end MEASUREMENT
/begin MEASUREMENT dlhkpml2_w "ml-abh‰ngige Zwischengrˆﬂe P-Anteil der stetigen LRSHK, Bank 2" SWORD fak_sw_b4 1 100 -4 3.99988 FORMAT "%8.6" ECU_ADDRESS 0x403556 /end MEASUREMENT
/begin MEASUREMENT dlhkpml_w "ml-abh‰ngige Zwischengrˆﬂe P-Anteil der stetigen LRSHK" SWORD fak_sw_b4 1 100 -4 3.99988 FORMAT "%8.6" ECU_ADDRESS 0x403558 /end MEASUREMENT
/begin MEASUREMENT dlrfrat "Delta rl f¸r die Berechnug der Zeitkonstante der FRAT-Adaption" UWORD fak_q0p0625 1 100 0 4095.94 FORMAT "%8.3" ECU_ADDRESS 0x402DB0 /end MEASUREMENT
/begin MEASUREMENT dlsd_w "D‰mpfung PT2-Filter in Lastschlagd‰mpfung" UWORD fak_uw_b2 1 100 0 1.99997 FORMAT "%8.6" ECU_ADDRESS 0x4041A6 /end MEASUREMENT
/begin MEASUREMENT dmdpo_w "delta Moment Dashpot-Ausloesung" SWORD rel_sw_b100 1 100 -100 99.9969 FORMAT "%8.4" ECU_ADDRESS 0x4041A8 /end MEASUREMENT
/begin MEASUREMENT dmdpu_w "delta Moment Dashpot-Ende" SWORD rel_sw_b100 1 100 -100 99.9969 FORMAT "%8.4" ECU_ADDRESS 0x4041AA /end MEASUREMENT
/begin MEASUREMENT dmlsdo_w "Delta Moment Auslˆsung Lastschlagd‰mpfung" SWORD rel_sw_b100 1 100 -100 99.9969 FORMAT "%8.4" ECU_ADDRESS 0x4041AC /end MEASUREMENT
/begin MEASUREMENT dmlsdu_w "Delta Moment Ende Lastschlagd‰mpfung" SWORD rel_sw_b100 1 100 -100 99.9969 FORMAT "%8.4" ECU_ADDRESS 0x4041AE /end MEASUREMENT
/begin MEASUREMENT dmrkt_w "Momentenreserve im Kurztrip" UWORD rel_uw_b100 1 100 0 99.9985 FORMAT "%8.5" ECU_ADDRESS 0x4030E6 /end MEASUREMENT
/begin MEASUREMENT dmrmx_w "Delta-Moment F¸llung durch Momentenreserve" UWORD rel_uw_b100 1 100 0 99.9985 FORMAT "%8.5" ECU_ADDRESS 0x404204 /end MEASUREMENT
/begin MEASUREMENT dmzms_w "Abstand des indizierten Sollmoments vom zul‰ssigen Sollmoment" SWORD rel_sw_b100 1 100 -100 99.9969 FORMAT "%8.4" ECU_ADDRESS 0x4041F4 /end MEASUREMENT
/begin MEASUREMENT dpsfaktd "Faktor Saugrohrdruck f¸r gedrosselt, teilgedrosselt, ungedrosselt" UBYTE fak_ub_q0p00392 1 100 0 1 FORMAT "%5.3" ECU_ADDRESS 0x403994 /end MEASUREMENT
/begin MEASUREMENT drlsol_w "ƒnderung Sollf¸llung" SWORD rel_sw_q0p0234 1 100 -768 767.977 FORMAT "%8.4" ECU_ADDRESS 0x403FD0 /end MEASUREMENT
/begin MEASUREMENT dzwagr "delta Z¸ndwinkel bei B_AGR=1 (AGR aktiv)" SBYTE zw_sb_q0p75 1 100 -96 95.25 FORMAT "%5.2" ECU_ADDRESS 0x403CBE /end MEASUREMENT
/begin MEASUREMENT dzwb "Differenz BasisZW optimaler Z¸ndwinkel" SBYTE zw_sb_q0p75 1 100 -96 95.25 FORMAT "%5.2" ECU_ADDRESS 0x403CBF /end MEASUREMENT
/begin MEASUREMENT dzwi "Delta Z¸ndwinkel zwischen zwopt und zwout" SBYTE zw_sb_q0p75 1 100 -96 95.25 FORMAT "%5.2" ECU_ADDRESS 0x403CCD /end MEASUREMENT
/begin MEASUREMENT dzwkoef "Koeffizient auf delta Z¸ndwinkel" UBYTE fak_q0p0439 1 100 0 11.1961 FORMAT "%5.2" ECU_ADDRESS 0x4030CA /end MEASUREMENT
/begin MEASUREMENT dzwkoefkt "" UBYTE fak_q0p0439 1 100 0 11.1961 FORMAT "%5.2" ECU_ADDRESS 0x4030CB /end MEASUREMENT
/begin MEASUREMENT dzwkoeft "" UBYTE fak_q0p0439 1 100 0 11.1961 FORMAT "%5.2" ECU_ADDRESS 0x4030CC /end MEASUREMENT
/begin MEASUREMENT dzwkoeftnf "" UBYTE fak_q0p0439 1 100 0 11.1961 FORMAT "%5.2" ECU_ADDRESS 0x4030CD /end MEASUREMENT
/begin MEASUREMENT dzwkoefwt "" UBYTE fak_q0p0439 1 100 0 11.1961 FORMAT "%5.2" ECU_ADDRESS 0x4030CE /end MEASUREMENT
/begin MEASUREMENT dzwoag "abgasr¸ckf¸hrratenabh. Z¸ndwinkelkorrektur des optimalen ZW" SBYTE zw_sb_q0p75 1 100 -96 95.25 FORMAT "%5.2" ECU_ADDRESS 0x403CC0 /end MEASUREMENT
/begin MEASUREMENT dzwol "lambdaabh. Z¸ndwinkelkorrektur des optimalen ZW" SBYTE zw_sb_q0p75 1 100 -96 95.25 FORMAT "%5.2" ECU_ADDRESS 0x403CC1 /end MEASUREMENT
/begin MEASUREMENT dzwotm "temperaturabh‰ngige Z¸ndwinkelkorrektur des optimalen ZW" SBYTE zw_sb_q0p75 1 100 -96 95.25 FORMAT "%5.2" ECU_ADDRESS 0x403CC2 /end MEASUREMENT
/begin MEASUREMENT Esprll "Soll-Einlassspreizung im Leerlauf" UBYTE sprzi_q0p8 1 100 0 204 FORMAT "%5.1" ECU_ADDRESS 0x40398F /end MEASUREMENT
/begin MEASUREMENT esst_sm109lhsw "" ULONG dez 1 100 0 4.29497e+009 FORMAT "%13.2" ECU_ADDRESS 0x404C00 /end MEASUREMENT
/begin MEASUREMENT esst_sm209lhsw "" ULONG dez 1 100 0 4.29497e+009 FORMAT "%13.2" ECU_ADDRESS 0x404C04 /end MEASUREMENT
/begin MEASUREMENT esst_smk06mduw "" ULONG dez 1 100 0 4.29497e+009 FORMAT "%13.2" ECU_ADDRESS 0x404AEC /end MEASUREMENT
/begin MEASUREMENT esst_srl16opuw "" ULONG dez 1 100 0 4.29497e+009 FORMAT "%13.2" ECU_ADDRESS 0x404AE8 /end MEASUREMENT
/begin MEASUREMENT etabasf_w "Gefiltertes etabas_w" UWORD rel_uw_b100 1 100 0 99.9985 FORMAT "%8.5" ECU_ADDRESS 0x403FD2 /end MEASUREMENT
/begin MEASUREMENT etabas_w "multiplizierter zw und lambda-Wirkungsgrad" UWORD rel_uw_b100 1 100 0 99.9985 FORMAT "%8.5" ECU_ADDRESS 0x403FD4 /end MEASUREMENT
/begin MEASUREMENT etagd "Wirkungsgrad gedrosselt in Bezug auf 100% bei ungedrosseltem Betrieb" UBYTE rel_ub_b127p5 1 100 0 127.5 FORMAT "%5.1" ECU_ADDRESS 0x403CC3 /end MEASUREMENT
/begin MEASUREMENT etalab "Lambda-Wirkungsgrad ohne Eingriff bezogen auf optimales Moment bei Lambda=1" UBYTE rel_ub_b127p5 1 100 0 127.5 FORMAT "%5.1" ECU_ADDRESS 0x403CC4 /end MEASUREMENT
/begin MEASUREMENT etatrmn "minimaler Wert in der Wirkungsgradtrommel" UBYTE rel_ub_b127p5 1 100 0 127.5 FORMAT "%5.1" ECU_ADDRESS 0x403CC5 /end MEASUREMENT
/begin MEASUREMENT etazaist "Ist-Zylinderausblendungswirkungsgrad" UBYTE rel_ub_b127p5 1 100 0 127.5 FORMAT "%5.1" ECU_ADDRESS 0x403CCE /end MEASUREMENT
/begin MEASUREMENT etazwb "Z¸ndwinkelwirkungsgrad des Basisz¸ndwinkels" UBYTE rel_ub_b127p5 1 100 0 127.5 FORMAT "%5.1" ECU_ADDRESS 0x403CC6 /end MEASUREMENT
/begin MEASUREMENT etazwbm "gemittelter Z¸ndwinkelwirkungsgrad des Basisz¸ndwinkels" UBYTE rel_ub_b127p5 1 100 0 127.5 FORMAT "%5.1" ECU_ADDRESS 0x403CC7 /end MEASUREMENT
/begin MEASUREMENT etazwist "Ist-Z¸ndwinkelwirkungsgrad" UBYTE rel_ub_b127p5 1 100 0 127.5 FORMAT "%5.1" ECU_ADDRESS 0x403CCF /end MEASUREMENT
/begin MEASUREMENT fdmfbt "Faktor zur ‹berblendung ungedrosselt - teilgedrosselt - gedrosselt" UBYTE fak_ub_b1 1 100 0 0.996094 ECU_ADDRESS 0x403CCB /end MEASUREMENT
/begin MEASUREMENT ffcoscmx "Gewichtungsfaktor Sauerstoffspeicher ¸ber fcoschk" UBYTE fak_ub_b1 1 100 0 0.996094 ECU_ADDRESS 0x403598 /end MEASUREMENT
/begin MEASUREMENT ffcoscmx2 "Gewichtungsfaktor Sauerstoffspeicher ¸ber fcoschk2" UBYTE fak_ub_b1 1 100 0 0.996094 ECU_ADDRESS 0x403599 /end MEASUREMENT
/begin MEASUREMENT flglrs "CARB FREEZE FRAME Byte, Bank 1, f¸r LR" UBYTE dez 1 100 0 255 FORMAT "%5.1" ECU_ADDRESS 0x403CE5 /end MEASUREMENT
/begin MEASUREMENT flglrs2 "CARB FREEZE FRAME Byte, Bank 2, f¸r LR" UBYTE dez 1 100 0 255 FORMAT "%5.1" ECU_ADDRESS 0x403CE6 /end MEASUREMENT
/begin MEASUREMENT fmibgrv_w "Regelfaktor f¸r Korrektur gangabh‰ngige Momentenbegrenzung vor Filterung" UWORD fak_uw_b2 1 100 0 1.99997 FORMAT "%8.6" ECU_ADDRESS 0x4030D0 /end MEASUREMENT
/begin MEASUREMENT fmibgr_w "Regelfaktor f¸r Korrektur gangabh‰ngige Momentenbegrenzung" UWORD fak_uw_b2 1 100 0 1.99997 FORMAT "%8.6" ECU_ADDRESS 0x4030D2 /end MEASUREMENT
/begin MEASUREMENT fmil_w "Faktor rel/ind Moment" UWORD rel_uw_b200 1 100 0 199.997 FORMAT "%8.4" ECU_ADDRESS 0x4041B0 /end MEASUREMENT
/begin MEASUREMENT fmknul "" UWORD fak_uw_b2 1 100 3.05176e-005 1.99997 FORMAT "%8.6" ECU_ADDRESS 0x4041B2 /end MEASUREMENT
/begin MEASUREMENT fnstab_w "Faktor zur Stabilisierung mittels Drehzahlquotient" UWORD fak_uw_b8 1 100 0 7.99988 FORMAT "%8.6" ECU_ADDRESS 0x404796 /end MEASUREMENT
/begin MEASUREMENT fnsta_in "Source f¸r FNSTABNV" UWORD fak_uw_b8 1 100 0 7.99988 FORMAT "%8.6" ECU_ADDRESS 0x404798 /end MEASUREMENT
/begin MEASUREMENT fnwll "Gewichtungsfaktor fuer zwoptLL" UBYTE fak_ub_b1 1 100 0 0.996094 ECU_ADDRESS 0x403990 /end MEASUREMENT
/begin MEASUREMENT fnwlleff "Gewichtungsfaktor fuer zwoptLL" UBYTE fak_ub_b1 1 100 0 0.996094 ECU_ADDRESS 0x403991 /end MEASUREMENT
/begin MEASUREMENT fr2_w "Lambda-Regler-Ausgang; Bank2 (Word)" UWORD fak_uw_b2 1 100 0 1.99997 FORMAT "%8.6" ECU_ADDRESS 0x404276 /end MEASUREMENT
/begin MEASUREMENT fra2_w "multiplikative Gemischkorrektur der Gemischadaption (Word)" UWORD fak_uw_b2 1 100 0 1.99997 FORMAT "%8.6" ECU_ADDRESS 0x404078 /end MEASUREMENT
/begin MEASUREMENT frao2_w "multipl. Gemischadaptionsfaktor oberer Lastbereich Bank 2 (Word)" UWORD fak_uw_b2 1 100 0 1.99997 FORMAT "%8.6" ECU_ADDRESS 0x402DB2 /end MEASUREMENT
/begin MEASUREMENT fraolt2_w "multiplikative Gemischkorrektur  frao von dem letzten Trip 2. Bank" UWORD fak_uw_b2 1 100 0 1.99997 FORMAT "%8.6" ECU_ADDRESS 0x402DB4 /end MEASUREMENT
/begin MEASUREMENT fraolt_w "multiplikative Gemischkorrektur  frao von dem letzten Trip" UWORD fak_uw_b2 1 100 0 1.99997 FORMAT "%8.6" ECU_ADDRESS 0x402DB6 /end MEASUREMENT
/begin MEASUREMENT frao_w "multiplikativer Gemischadaptionsfaktor oberer Lastbereich (Word)" UWORD fak_uw_b2 1 100 0 1.99997 FORMAT "%8.6" ECU_ADDRESS 0x402DB8 /end MEASUREMENT
/begin MEASUREMENT frat2_w "temperaturabh‰ngige Gemischadaptionsfaktor (2. Bank)" UWORD fak_uw_b2 1 100 0 1.99997 FORMAT "%8.6" ECU_ADDRESS 0x402DBA /end MEASUREMENT
/begin MEASUREMENT frati2_w "temperaturabh‰ngige Gemischadaptionfaktor Integralwert (2. Bank)" UWORD fak_uw_b2 1 100 0 1.99997 FORMAT "%8.6" ECU_ADDRESS 0x40407A /end MEASUREMENT
/begin MEASUREMENT frati_w "temperaturabh‰ngige Gemischadaptionfaktor Integralwert" UWORD fak_uw_b2 1 100 0 1.99997 FORMAT "%8.6" ECU_ADDRESS 0x402DBC /end MEASUREMENT
/begin MEASUREMENT frat_w "temperaturabh‰ngige Gemischadaptionsfaktor" UWORD fak_uw_b2 1 100 0 1.99997 FORMAT "%8.6" ECU_ADDRESS 0x402DBE /end MEASUREMENT
/begin MEASUREMENT frau2_w "multipl. Gemischadaptionsfaktor unterer mult. Bereich der Bank 2 (Word)" UWORD fak_uw_b2 1 100 0 1.99997 FORMAT "%8.6" ECU_ADDRESS 0x402DC0 /end MEASUREMENT
/begin MEASUREMENT frault2_w "multiplikative Gemischkorrektur  frau von dem letzten Trip 2. Bank" UWORD fak_uw_b2 1 100 0 1.99997 FORMAT "%8.6" ECU_ADDRESS 0x402DC2 /end MEASUREMENT
/begin MEASUREMENT frault_w "multiplikative Gemischkorrektur  frau von dem letzten Trip" UWORD fak_uw_b2 1 100 0 1.99997 FORMAT "%8.6" ECU_ADDRESS 0x402DC4 /end MEASUREMENT
/begin MEASUREMENT frau_w "multiplikativer Gemischadaptionsfaktor unterer mult. Bereich (Word)" UWORD fak_uw_b2 1 100 0 1.99997 FORMAT "%8.6" ECU_ADDRESS 0x402DC6 /end MEASUREMENT
/begin MEASUREMENT fra_w "multiplikative Gemischkorrektur der Gemischadaption (Word)" UWORD fak_uw_b2 1 100 0 1.99997 FORMAT "%8.6" ECU_ADDRESS 0x40407C /end MEASUREMENT
/begin MEASUREMENT frini2_w "Initialisierungswert f¸r Regelfaktor Lambdaregelung, Bank 2" UWORD fak_uw_b2 1 100 0 1.99997 FORMAT "%8.6" ECU_ADDRESS 0x4042D0 /end MEASUREMENT
/begin MEASUREMENT frini_w "Initialisierungswert f¸r Regelfaktor Lambdaregelung" UWORD fak_uw_b2 1 100 0 1.99997 FORMAT "%8.6" ECU_ADDRESS 0x4042D2 /end MEASUREMENT
/begin MEASUREMENT frm2_w "schneller Mittelwert des Lambdaregelfaktors Bank 2(Word)" UWORD fak_uw_b2 1 100 0 1.99997 FORMAT "%8.6" ECU_ADDRESS 0x404278 /end MEASUREMENT
/begin MEASUREMENT frmn_w "Lambda-Regler-Ausgang Minimalwert" UWORD fak_uw_b2 1 100 0 1.99997 FORMAT "%8.6" ECU_ADDRESS 0x40427A /end MEASUREMENT
/begin MEASUREMENT frmx_w "LR mit Integratorstop : Max. Begrenzung Integrator fr,; FRMAX / angehoben d.DSLS" UWORD fak_uw_b2 1 100 0 1.99997 FORMAT "%8.6" ECU_ADDRESS 0x40427C /end MEASUREMENT
/begin MEASUREMENT frm_w "schneller Mittelwert des Lambdaregelfaktors (Word)" UWORD fak_uw_b2 1 100 0 1.99997 FORMAT "%8.6" ECU_ADDRESS 0x40427E /end MEASUREMENT
/begin MEASUREMENT froza2_w "Lambda-Regler-Ausgang ohne Zwangsanregung; Bank2" UWORD fak_uw_b2 1 100 0 1.99997 FORMAT "%8.6" ECU_ADDRESS 0x404280 /end MEASUREMENT
/begin MEASUREMENT froza_w "Lambda-Regler-Ausgang ohne Zwangsanregung" UWORD fak_uw_b2 1 100 0 1.99997 FORMAT "%8.6" ECU_ADDRESS 0x404282 /end MEASUREMENT
/begin MEASUREMENT fr_w "Lambda-Regler-Ausgang (Word)" UWORD fak_uw_b2 1 100 0 1.99997 FORMAT "%8.6" ECU_ADDRESS 0x404284 /end MEASUREMENT
/begin MEASUREMENT ftklra_w "Korrekturfaktor f¸r temperaturabh‰ngigen Adaptionsfaktor" UWORD fak_uw_b2 1 100 0 1.99997 FORMAT "%8.6" ECU_ADDRESS 0x402DC8 /end MEASUREMENT
/begin MEASUREMENT fwuell "Summenverh‰ltnis LL-Sollspreizungen zu aktuellen Ist-Spreizungen" UBYTE fak_ub_b2 1 100 0 1.99219 FORMAT "%5.3" ECU_ADDRESS 0x403992 /end MEASUREMENT
/begin MEASUREMENT fznwll "Faktor Ausblendung der zwopt LL-Umschaltung" UBYTE fak_ub_b1 1 100 0 0.996094 ECU_ADDRESS 0x403993 /end MEASUREMENT
/begin MEASUREMENT g1korr "Korrekturfaktor f¸r Reglerparameter G1" UBYTE fak_ub_b2 1 100 0 1.99219 FORMAT "%5.3" ECU_ADDRESS 0x403CE2 /end MEASUREMENT
/begin MEASUREMENT h2conc "Betriebspunktabh‰ngige H2 Konzentration hinter Neu-Kat" UBYTE m_q8p0_ppm 1 100 0 2040 FORMAT "%5.0" ECU_ADDRESS 0x403562 /end MEASUREMENT
/begin MEASUREMENT h2concb "H2 Konzentration angepasst an Kat-Alter =f(fcoschk), Bank 1" UBYTE m_q8p0_ppm 1 100 0 2040 FORMAT "%5.0" ECU_ADDRESS 0x403563 /end MEASUREMENT
/begin MEASUREMENT h2concb2 "H2 Konzentration angepasst an Kat-Alter =f(fcoschk2), Bank 2" UBYTE m_q8p0_ppm 1 100 0 2040 FORMAT "%5.0" ECU_ADDRESS 0x403564 /end MEASUREMENT
/begin MEASUREMENT iftkavx2_w "Fettfl‰chenschwelle = f(tikatm2_w,avkatf2), Bank 2" UWORD m_uw_b291p25 1 100 0 291.267 FORMAT "%8.4" ECU_ADDRESS 0x40357C /end MEASUREMENT
/begin MEASUREMENT iftkavx_w "Fettfl‰chenschwelle = f(tkivkm_w,Alterungsfaktor, [tkihkm_w])" UWORD m_uw_b291p25 1 100 0 291.267 FORMAT "%8.4" ECU_ADDRESS 0x40357E /end MEASUREMENT
/begin MEASUREMENT ilmltkx2_w "Ausgang Kennlinie ILMLKAXTK2" UWORD m_uw_b291p25 1 100 0 291.267 FORMAT "%8.4" ECU_ADDRESS 0x403580 /end MEASUREMENT
/begin MEASUREMENT ilmltkx_w "Ausgang Kennlinie ILMLKAXTK" UWORD m_uw_b291p25 1 100 0 291.267 FORMAT "%8.4" ECU_ADDRESS 0x403582 /end MEASUREMENT
/begin MEASUREMENT imlevab2_w "Luftmasse nach Zylinderausblendung f¸r stetige Lambdaregelung, Bank 2" UWORD m_uw_b4660 1 100 0 4660.27 FORMAT "%8.3" ECU_ADDRESS 0x4042CA /end MEASUREMENT
/begin MEASUREMENT imlevab_w "Luftmasse nach Zylinderausblendung f¸r stetige Lambdaregelung" UWORD m_uw_b4660 1 100 0 4660.27 FORMAT "%8.3" ECU_ADDRESS 0x4042CC /end MEASUREMENT
/begin MEASUREMENT imlka2_w "Integrator Luftmasse f¸r Katalysator-Ausr‰umen f¸r Stereo-LR Bank 2" UWORD m_uw_b291p25 1 100 0 291.267 FORMAT "%8.4" ECU_ADDRESS 0x403584 /end MEASUREMENT
/begin MEASUREMENT imlka_w "Integrator Luftmasse f¸r Katalysator-Ausr‰umen" UWORD m_uw_b291p25 1 100 0 291.267 FORMAT "%8.4" ECU_ADDRESS 0x403586 /end MEASUREMENT
/begin MEASUREMENT imllaka2_w "Integrator Fettfl‰che f¸r Katalysator-Ausr‰umen Bank2" UWORD m_uw_b291p25 1 100 0 30 FORMAT "%8.5" ECU_ADDRESS 0x403588 /end MEASUREMENT
/begin MEASUREMENT imllaka_w "Integrator Fettfl‰che f¸r Katalysator-Ausr‰umen" UWORD m_uw_b291p25 1 100 0 30 FORMAT "%8.5" ECU_ADDRESS 0x40358A /end MEASUREMENT
/begin MEASUREMENT imlrsa_w "Luftmasse nach SA f¸r stetige Lambdaregelung" UWORD m_uw_b4660 1 100 0 4660.27 FORMAT "%8.3" ECU_ADDRESS 0x4042CE /end MEASUREMENT
/begin MEASUREMENT imsbhka2_w "Abgasmassenintegral nach Kat-Ausr‰umen, Bank 2" UWORD m_uw_b7281 1 100 0 7281.67 FORMAT "%8.3" ECU_ADDRESS 0x40356A /end MEASUREMENT
/begin MEASUREMENT imsbhka_w "Abgasmassenintegral nach Kat-Ausr‰umen" UWORD m_uw_b7281 1 100 0 7281.67 FORMAT "%8.3" ECU_ADDRESS 0x40356C /end MEASUREMENT
/begin MEASUREMENT imsbhla_w "Abgasmasse nach Instation‰rbetrieb (drlas_w > DRLLRHKO ODER drlas < DRLLRHKU)" UWORD m_uw_b7281 1 100 0 7281.67 FORMAT "%8.3" ECU_ADDRESS 0x40356E /end MEASUREMENT
/begin MEASUREMENT imslaka2_w "Integrator Fettfl‰che f¸r Katalysator-Ausr‰umen, bank 2" UWORD m_uw_b291p25 1 100 0 30 FORMAT "%8.5" ECU_ADDRESS 0x40358C /end MEASUREMENT
/begin MEASUREMENT imslaka_w "Integrator Fettfl‰che f¸r Katalysator-Ausr‰umen" UWORD m_uw_b291p25 1 100 0 30 FORMAT "%8.5" ECU_ADDRESS 0x40358E /end MEASUREMENT
/begin MEASUREMENT iwflsd_w "Initialisierungswert Filter Lastschlagd‰mpfung" UWORD rel_uw_b100 1 100 0 99.9985 FORMAT "%8.5" ECU_ADDRESS 0x4041B4 /end MEASUREMENT
/begin MEASUREMENT ladiff2_w "Regelabweichung Lambda;Bank2" SWORD fak_sw_b1 1 100 -1 0.999969 FORMAT "%8.6" ECU_ADDRESS 0x404286 /end MEASUREMENT
/begin MEASUREMENT ladiff_w "Regelabweichung Lambda" SWORD fak_sw_b1 1 100 -1 0.999969 FORMAT "%8.6" ECU_ADDRESS 0x404288 /end MEASUREMENT
/begin MEASUREMENT lahkf2_w "Pseudolinearisietes Lambda hinter Kat, PT1-gefiltert, Auflˆsung 0 ... <2, Bank 2" UWORD fak_uw_b2 1 100 0 1.99997 FORMAT "%8.6" ECU_ADDRESS 0x4047FA /end MEASUREMENT
/begin MEASUREMENT lahkf_w "Pseudolinearisietes Lambda hinter Kat, PT1-gefiltert, Word, Auflˆsung 0 ... <2" UWORD fak_uw_b2 1 100 0 1.99997 FORMAT "%8.6" ECU_ADDRESS 0x4047FC /end MEASUREMENT
/begin MEASUREMENT lahkm2_w "fr-synchron gemittelter Pseudo Lambda-Istwert gem. mit Nernst-Sonde h.Kat, Bnk2" UWORD fak_uw_b2 1 100 0 1.99997 FORMAT "%8.6" ECU_ADDRESS 0x4047FE /end MEASUREMENT
/begin MEASUREMENT lahkmz "Zustandsbyte des Automaten: fr-synchrone Mittelung Pseodo-Lambda hinter Kat" UBYTE dez 1 100 0 255 FORMAT "%5.1" ECU_ADDRESS 0x4039B2 /end MEASUREMENT
/begin MEASUREMENT lahkmz2 "Zustandsbyte des Automaten: fr-synchrone Mittelung Pseodo-Lambda h. Kat, Bank 2" UBYTE dez 1 100 0 255 FORMAT "%5.1" ECU_ADDRESS 0x4039B3 /end MEASUREMENT
/begin MEASUREMENT lahkm_w "fr-synchron gemittelter Pseudo Lambda-Istwert gem.  Nernst-Sonde h.Kat" UWORD fak_uw_b2 1 100 0 1.99997 FORMAT "%8.6" ECU_ADDRESS 0x404800 /end MEASUREMENT
/begin MEASUREMENT lamka2_w "Lambdasollwert Katausr‰umen, Bank2" UWORD fak_uw_b16 1 100 0 15.9998 FORMAT "%8.5" ECU_ADDRESS 0x403590 /end MEASUREMENT
/begin MEASUREMENT lamka_w "Lambdasollwert Katausr‰umen" UWORD fak_uw_b16 1 100 0 15.9998 FORMAT "%8.5" ECU_ADDRESS 0x403592 /end MEASUREMENT
/begin MEASUREMENT lamsbgt2_w "Lambdasoll bezogen auf Brennraum Bank 2, totzeitverschoben" UWORD fak_uw_b16 1 100 0 15.9998 FORMAT "%8.5" ECU_ADDRESS 0x40428A /end MEASUREMENT
/begin MEASUREMENT lamsbgt_w "Lambdasoll bezogen auf Brennraum, totzeitverschoben" UWORD fak_uw_b16 1 100 0 15.9998 FORMAT "%8.5" ECU_ADDRESS 0x40428C /end MEASUREMENT
/begin MEASUREMENT lamsbpr2_w "Lambda-Soll-Wert vor Begrenzung nach unten, Bank 2" UWORD fak_uw_b16 1 100 0 15.9998 FORMAT "%8.5" ECU_ADDRESS 0x40428E /end MEASUREMENT
/begin MEASUREMENT lamsbpr_w "Lambda-Soll-Wert vor Begrenzung nach unten" UWORD fak_uw_b16 1 100 0 15.9998 FORMAT "%8.5" ECU_ADDRESS 0x404290 /end MEASUREMENT
/begin MEASUREMENT lamzak2_w "Lambdasondenistwert, korrigiert um Zusatzamplitude, Bank2" UWORD fak_uw_b16 1 100 0 15.9998 FORMAT "%8.5" ECU_ADDRESS 0x404292 /end MEASUREMENT
/begin MEASUREMENT lamzak_w "Lambdasondenistwert, korrigiert um Zusatzamplitude" UWORD fak_uw_b16 1 100 0 15.9998 FORMAT "%8.5" ECU_ADDRESS 0x404294 /end MEASUREMENT
/begin MEASUREMENT lamzapr2_w "Lambda-Ist-Wert bereinigt um Zwangsamplitude vor Begrenzung nach unten, Bank 2" UWORD fak_uw_b16 1 100 0 15.9998 FORMAT "%8.5" ECU_ADDRESS 0x404296 /end MEASUREMENT
/begin MEASUREMENT lamzapr_w "Lambda-Ist-Wert bereinigt um Zwangsamplitude vor Begrenzung nach unten" UWORD fak_uw_b16 1 100 0 15.9998 FORMAT "%8.5" ECU_ADDRESS 0x404298 /end MEASUREMENT
/begin MEASUREMENT lasolhk2_w "Pseudo Lambda-Sollwert hinter Kat, Quantisierung 0 ... <2, Bank 2" UWORD fak_uw_b2 1 100 0 1.99997 FORMAT "%8.6" ECU_ADDRESS 0x40355A /end MEASUREMENT
/begin MEASUREMENT lasolhk_w "Pseudo Lambda-Sollwert hinter Kat, Quantisierung 0 ... <2" UWORD fak_uw_b2 1 100 0 1.99997 FORMAT "%8.6" ECU_ADDRESS 0x40355C /end MEASUREMENT
/begin MEASUREMENT lasonhk2_w "Pseudo Lambda-Istwert gemessen mit Nernst-Sonde hinter Kat, Aufl. 0 .. <2,Bank2" UWORD fak_uw_b2 1 100 0 1.99997 FORMAT "%8.6" ECU_ADDRESS 0x404802 /end MEASUREMENT
/begin MEASUREMENT lasonhk_w "Pseudo Lambda-Istwert gemessen mit Nernst-Sonde hinter Kat, Aufl. 0 .. <2" UWORD fak_uw_b2 1 100 0 1.99997 FORMAT "%8.6" ECU_ADDRESS 0x404804 /end MEASUREMENT
/begin MEASUREMENT lrkaz "Zustandsbyte des Automaten Kat-Ausr‰umen" UBYTE dez 1 100 0 255 FORMAT "%5.1" ECU_ADDRESS 0x40359A /end MEASUREMENT
/begin MEASUREMENT lrkaz2 "Zustandsbyte des Automaten Kat-Ausr‰umen f¸r Stereo-LR Bank 2" UBYTE dez 1 100 0 255 FORMAT "%5.1" ECU_ADDRESS 0x40359B /end MEASUREMENT
/begin MEASUREMENT lrsg1_w "Interner Reglerkoeffizient stetige Lambdaregelung" SWORD fak_sw_b32 1 100 -32 31.999 FORMAT "%8.5" ECU_ADDRESS 0x40429A /end MEASUREMENT
/begin MEASUREMENT lrsg2_w "Interner Reglerkoeffizient stetige Lambdaregelung" UWORD fak_uw_b64 1 100 0 63.999 FORMAT "%8.5" ECU_ADDRESS 0x40429C /end MEASUREMENT
/begin MEASUREMENT lrsg4_w "Interner Reglerkoeffizient stetige Lambdaregelung" SWORD fak_sw_b2 1 100 -2 1.99994 FORMAT "%8.6" ECU_ADDRESS 0x40429E /end MEASUREMENT
/begin MEASUREMENT lrshkcLokBits "" UBYTE dez 1 100 0 255 FORMAT "%5.1" ECU_ADDRESS 0x403565 /end MEASUREMENT
/begin MEASUREMENT lrshkebAusBits "" UBYTE dez 1 100 0 255 FORMAT "%5.1" ECU_ADDRESS 0x403570 /end MEASUREMENT
/begin MEASUREMENT lrshkebAusBits1 "" UBYTE dez 1 100 0 255 FORMAT "%5.1" ECU_ADDRESS 0x403571 /end MEASUREMENT
/begin MEASUREMENT lrshkebAusBits10ms "" UBYTE dez 1 100 0 255 FORMAT "%5.1" ECU_ADDRESS 0x4039B4 /end MEASUREMENT
/begin MEASUREMENT lrshkebLokBits "" UBYTE dez 1 100 0 255 FORMAT "%5.1" ECU_ADDRESS 0x403572 /end MEASUREMENT
/begin MEASUREMENT lrshkebLokBits1 "" UBYTE dez 1 100 0 255 FORMAT "%5.1" ECU_ADDRESS 0x403573 /end MEASUREMENT
/begin MEASUREMENT lrshkebLokBits2 "" UBYTE dez 1 100 0 255 FORMAT "%5.1" ECU_ADDRESS 0x403574 /end MEASUREMENT
/begin MEASUREMENT lrshkebLokBits3 "" UBYTE dez 1 100 0 255 FORMAT "%5.1" ECU_ADDRESS 0x403575 /end MEASUREMENT
/begin MEASUREMENT lrshkebLokBits4 "" UBYTE dez 1 100 0 255 FORMAT "%5.1" ECU_ADDRESS 0x403576 /end MEASUREMENT
/begin MEASUREMENT lrskaAusBits20ms "" UBYTE dez 1 100 0 255 FORMAT "%5.1" ECU_ADDRESS 0x40359C /end MEASUREMENT
/begin MEASUREMENT lrskaLokBits20ms "" UBYTE dez 1 100 0 255 FORMAT "%5.1" ECU_ADDRESS 0x40359D /end MEASUREMENT
/begin MEASUREMENT lrsp1_w "Interner Reglerkoeffizient stetige Lambdaregelung" UWORD fak_uw_b128 1 100 0 127.998 FORMAT "%8.4" ECU_ADDRESS 0x4042A0 /end MEASUREMENT
/begin MEASUREMENT lrsp2_w "Interner Reglerkoeffizient stetige Lambdaregelung" UWORD fak_uw_b128 1 100 0 127.998 FORMAT "%8.4" ECU_ADDRESS 0x4042A2 /end MEASUREMENT
/begin MEASUREMENT lrsp3_w "Interner Reglerkoeffizient stetige Lambdaregelung" UWORD fak_uw_b128 1 100 0 127.998 FORMAT "%8.4" ECU_ADDRESS 0x4042A4 /end MEASUREMENT
/begin MEASUREMENT lrsp4_w "Interner Reglerkoeffizient stetige Lambdaregelung" SWORD fak_sw_b64 1 100 -64 63.998 FORMAT "%8.5" ECU_ADDRESS 0x4042A6 /end MEASUREMENT
/begin MEASUREMENT lrstza_w "Periodendauer Zwangsamplitude" UWORD t10msxs_uw_b655p35 1 100 0 655.35 FORMAT "%8.4" ECU_ADDRESS 0x4042A8 /end MEASUREMENT
/begin MEASUREMENT lrsw12_w "Interner Reglerzustand stetige Lambdaregelung;Bank2" SWORD fak_sw_b4 1 100 -4 3.99988 FORMAT "%8.6" ECU_ADDRESS 0x4042AA /end MEASUREMENT
/begin MEASUREMENT lrsw1_w "Interner Reglerzustand stetige Lambdaregelung" SWORD fak_sw_b4 1 100 -4 3.99988 FORMAT "%8.6" ECU_ADDRESS 0x4042AC /end MEASUREMENT
/begin MEASUREMENT lrsw22_w "Interner Reglerzustand stetige Lambdaregelung;Bank2" SWORD fak_sw_b4 1 100 -4 3.99988 FORMAT "%8.6" ECU_ADDRESS 0x4042AE /end MEASUREMENT
/begin MEASUREMENT lrsw2_w "Interner Reglerzustand stetige Lambdaregelung" SWORD fak_sw_b4 1 100 -4 3.99988 FORMAT "%8.6" ECU_ADDRESS 0x4042B0 /end MEASUREMENT
/begin MEASUREMENT lrsxk12_w "Interner Reglerzustand stetige Lambdaregelung;Bank 2" SWORD fak_sw_b1 1 100 -1 0.999969 FORMAT "%8.6" ECU_ADDRESS 0x4042B2 /end MEASUREMENT
/begin MEASUREMENT lrsxk1_w "Interner Reglerzustand stetige Lambdaregelung" SWORD fak_sw_b1 1 100 -1 0.999969 FORMAT "%8.6" ECU_ADDRESS 0x4042B4 /end MEASUREMENT
/begin MEASUREMENT lrsxk32_w "Interner Reglerzustand stetige Lambdaregelung;Bank2" SWORD fak_sw_b1 1 100 -1 0.999969 FORMAT "%8.6" ECU_ADDRESS 0x4042B6 /end MEASUREMENT
/begin MEASUREMENT lrsxk3_w "Interner Reglerzustand stetige Lambdaregelung" SWORD fak_sw_b1 1 100 -1 0.999969 FORMAT "%8.6" ECU_ADDRESS 0x4042B8 /end MEASUREMENT
/begin MEASUREMENT lrsxk42_w "Interner Reglerzustand stetige Lambdaregelung;Bank2" SWORD fak_sw_b1 1 100 -1 0.999969 FORMAT "%8.6" ECU_ADDRESS 0x4042BA /end MEASUREMENT
/begin MEASUREMENT lrsxk4_w "Interner Reglerzustand stetige Lambdaregelung" SWORD fak_sw_b1 1 100 -1 0.999969 FORMAT "%8.6" ECU_ADDRESS 0x4042BC /end MEASUREMENT
/begin MEASUREMENT lrsy22_w "Interner Reglerzustand stetige Lambdaregelung;Bank2" SWORD fak_sw_b1 1 100 -1 0.999969 FORMAT "%8.6" ECU_ADDRESS 0x4042BE /end MEASUREMENT
/begin MEASUREMENT lrsy2_w "Interner Reglerzustand stetige Lambdaregelung" SWORD fak_sw_b1 1 100 -1 0.999969 FORMAT "%8.6" ECU_ADDRESS 0x4042C0 /end MEASUREMENT
/begin MEASUREMENT lrsy42_w "Interner Reglerzustand stetige Lambdaregelung;Bank2" SWORD fak_sw_b8 1 100 -8 7.99976 FORMAT "%8.6" ECU_ADDRESS 0x4042C2 /end MEASUREMENT
/begin MEASUREMENT lrsy4_w "Interner Reglerzustand stetige Lambdaregelung" SWORD fak_sw_b8 1 100 -8 7.99976 FORMAT "%8.6" ECU_ADDRESS 0x4042C4 /end MEASUREMENT
/begin MEASUREMENT lrsza "Amplitude erzwungener Lambdamodulation" UBYTE fak_ub_b0p25 1 100 0 0.249023 FORMAT "%11.9" ECU_ADDRESS 0x40353C /end MEASUREMENT
/begin MEASUREMENT lurminstat "Lurmin Anforderung DMD - externer Funktionen" UBYTE DEZ 1 100 0 255 FORMAT "%5.1" ECU_ADDRESS 0x403880 /end MEASUREMENT
/begin MEASUREMENT mdindg_w "indiziertes Motormoment Hochdruckphase wenn alle Zylinder befeuert" UWORD rel_uw_b100 1 100 0 99.9985 FORMAT "%8.5" ECU_ADDRESS 0x4041F0 /end MEASUREMENT
/begin MEASUREMENT mdverbfa_w "" SWORD rel_sw_b100 1 100 -100 99.9969 FORMAT "%8.4" ECU_ADDRESS 0x4041B6 /end MEASUREMENT
/begin MEASUREMENT miautget_w "Motormoment ohne Getriebeeingriff" UWORD rel_uw_b100 1 100 0 99.9985 FORMAT "%8.5" ECU_ADDRESS 0x404196 /end MEASUREMENT
/begin MEASUREMENT miautgs_w "Motorsollmoment ohne Getriebeeingriff" UWORD rel_uw_b100 1 100 0 99.9985 FORMAT "%8.5" ECU_ADDRESS 0x404198 /end MEASUREMENT
/begin MEASUREMENT mibas_w "indiziertes Basis-Moment" UWORD rel_uw_b100 1 100 0 99.9985 FORMAT "%8.5" ECU_ADDRESS 0x40419C /end MEASUREMENT
/begin MEASUREMENT mibdp_w "indiziertes Soll-Motormoment Dashpot" UWORD rel_uw_b100 1 100 0 99.9985 FORMAT "%8.5" ECU_ADDRESS 0x4041B8 /end MEASUREMENT
/begin MEASUREMENT mibeg_w "Begrenzungsmoment" UWORD rel_uw_b100 1 100 0 99.9985 FORMAT "%8.5" ECU_ADDRESS 0x4041F6 /end MEASUREMENT
/begin MEASUREMENT mibgrht_w "Maximal zul‰ssiges Moment bei hohem toel" UWORD rel_uw_b100 1 100 0 99.9985 FORMAT "%8.5" ECU_ADDRESS 0x4030D4 /end MEASUREMENT
/begin MEASUREMENT mibgrv_w "indiziertes soll-Moment f¸r gangabh‰ngige Momentenbegrenzung vor Regelung" UWORD rel_uw_b100 1 100 0 99.9985 FORMAT "%8.5" ECU_ADDRESS 0x4030D6 /end MEASUREMENT
/begin MEASUREMENT mibgr_w "begrenztes soll-Moment" UWORD rel_uw_b100 1 100 0 99.9985 FORMAT "%8.5" ECU_ADDRESS 0x4030D8 /end MEASUREMENT
/begin MEASUREMENT miblsd_w "Begrenztes indiziertes Moment aus Lastschlagd‰mpfung" UWORD rel_uw_b100 1 100 0 99.9985 FORMAT "%8.5" ECU_ADDRESS 0x4041BA /end MEASUREMENT
/begin MEASUREMENT mibrmx_w "Maximal zul‰ssiges Moment bei bet‰tigter Bremse" UWORD rel_uw_b100 1 100 0 99.9985 FORMAT "%8.5" ECU_ADDRESS 0x4030DA /end MEASUREMENT
/begin MEASUREMENT midbgr_w "indiziertes soll-Moment, dejustiert, f¸r gangabh‰ngige Momentenbegrenzung" UWORD rel_uw_b100 1 100 0 99.9985 FORMAT "%8.5" ECU_ADDRESS 0x4030DC /end MEASUREMENT
/begin MEASUREMENT miextv_w "von extern gefordertes Moment vor Abw¸rgeschutz" UWORD rel_uw_b100 1 100 0 99.9985 FORMAT "%8.5" ECU_ADDRESS 0x4041F8 /end MEASUREMENT
/begin MEASUREMENT miext_w "von auﬂen (ASR, GS, usw.) angefordertes indiziertes Motormoment" UWORD rel_uw_b100 1 100 0 99.9985 FORMAT "%8.5" ECU_ADDRESS 0x4041FA /end MEASUREMENT
/begin MEASUREMENT mifa "indiziertes Motormoment Fahrerwunsch" UBYTE rel_ub_b99p6 1 100 0 99.6094 FORMAT "%5.2" ECU_ADDRESS 0x403CCC /end MEASUREMENT
/begin MEASUREMENT mifab_w "Begrenztes indiziertes Fahrerwunschmoment" UWORD rel_uw_b100 1 100 0 99.9985 FORMAT "%8.5" ECU_ADDRESS 0x4041FC /end MEASUREMENT
/begin MEASUREMENT mifafu_w "Fahrermomentenwunsch f¸r F¸llung" UWORD rel_uw_b100 1 100 0 99.9985 FORMAT "%8.5" ECU_ADDRESS 0x404206 /end MEASUREMENT
/begin MEASUREMENT mifal_w "Indiziertes Fahrerwunschmoment f¸r Momentenkoordination F¸llung" UWORD rel_uw_b100 1 100 0 99.9985 FORMAT "%8.5" ECU_ADDRESS 0x4041BC /end MEASUREMENT
/begin MEASUREMENT mifa_w "indiziertes Motormoment Fahrerwunsch" UWORD rel_uw_b100 1 100 0 99.9985 FORMAT "%8.5" ECU_ADDRESS 0x4041BE /end MEASUREMENT
/begin MEASUREMENT migef_w "Gefiltertes indiziertes Fahrerwunschmoment" UWORD rel_uw_b100 1 100 0 99.9985 FORMAT "%8.5" ECU_ADDRESS 0x4041C0 /end MEASUREMENT
/begin MEASUREMENT miistoar_w "Istmoment ohne Antiruckel-Anteil" UWORD rel_uw_b100 1 100 0 99.9985 FORMAT "%8.5" ECU_ADDRESS 0x40419A /end MEASUREMENT
/begin MEASUREMENT miist_w "indiziertes Motormoment Hochdruckphase Istwert" UWORD rel_uw_b100 1 100 0 99.9985 FORMAT "%8.5" ECU_ADDRESS 0x4041F2 /end MEASUREMENT
/begin MEASUREMENT mil1_w "ind. Moment aus MINMAX-Auswahl" UWORD rel_uw_b100 1 100 0 99.9985 FORMAT "%8.5" ECU_ADDRESS 0x4041C2 /end MEASUREMENT
/begin MEASUREMENT mil2_w "ind. Moment aus MINMAX-Auswahl" UWORD rel_uw_b100 1 100 0 99.9985 FORMAT "%8.5" ECU_ADDRESS 0x4041C4 /end MEASUREMENT
/begin MEASUREMENT mil3_w "ind. Moment aus MINMAX-Auswahl" UWORD rel_uw_b100 1 100 0 99.9985 FORMAT "%8.5" ECU_ADDRESS 0x4041C6 /end MEASUREMENT
/begin MEASUREMENT mill_w "Indiziertes Motormoment im Leerlauf" UWORD rel_uw_b100 1 100 0 99.9985 FORMAT "%8.5" ECU_ADDRESS 0x40412E /end MEASUREMENT
/begin MEASUREMENT milres_w "Momentenanforderung f¸r Luftpfad mit allen Reserven" UWORD rel_uw_b100 1 100 0 99.9985 FORMAT "%8.5" ECU_ADDRESS 0x404208 /end MEASUREMENT
/begin MEASUREMENT milsol_w "koordiniertes Moment f¸r F¸llung" UWORD rel_uw_b100 1 100 0 99.9985 FORMAT "%8.5" ECU_ADDRESS 0x40420A /end MEASUREMENT
/begin MEASUREMENT mimax_w "maximal erreichbares indiziertes Moment" UWORD rel_uw_b100 1 100 0 99.9985 FORMAT "%8.5" ECU_ADDRESS 0x40420C /end MEASUREMENT
/begin MEASUREMENT mimin_w "Minimales Motor-Moment" UWORD rel_uw_b100 1 100 0 99.9985 FORMAT "%8.5" ECU_ADDRESS 0x404130 /end MEASUREMENT
/begin MEASUREMENT mimxl1_w "Maximales optimales Moment bei Lambda = 1" UWORD rel_uw_b100 1 100 0 99.9985 FORMAT "%8.5" ECU_ADDRESS 0x40420E /end MEASUREMENT
/begin MEASUREMENT minbeg_w "Indiziertes Fahrerwunschmoment nach ƒnderungsbegrenzung" UWORD rel_uw_b100 1 100 0 99.9985 FORMAT "%8.5" ECU_ADDRESS 0x4041C8 /end MEASUREMENT
/begin MEASUREMENT mioptl1_w "optimales indiziertes Motormoment bei Lambda = 1" UWORD rel_uw_b100 1 100 0 99.9985 FORMAT "%8.5" ECU_ADDRESS 0x40419E /end MEASUREMENT
/begin MEASUREMENT mioptugd_w "optimales indiziertes Moment ungedrosselt" UWORD rel_uw_b100 1 100 0 99.9985 FORMAT "%8.5" ECU_ADDRESS 0x4041A0 /end MEASUREMENT
/begin MEASUREMENT miopt_w "optimales indiziertes Moment" UWORD rel_uw_b100 1 100 0 99.9985 FORMAT "%8.5" ECU_ADDRESS 0x4041A2 /end MEASUREMENT
/begin MEASUREMENT misolv_w "Indiziertes resultierendes Sollmoment vor Momentenbegrenzung" UWORD rel_uw_b100 1 100 0 99.9985 FORMAT "%8.5" ECU_ADDRESS 0x4041FE /end MEASUREMENT
/begin MEASUREMENT misol_w "Indiziertes resultierendes Sollmoment" UWORD rel_uw_b100 1 100 0 99.9985 FORMAT "%8.5" ECU_ADDRESS 0x3FC416 /end MEASUREMENT
/begin MEASUREMENT misopl1_w "Solluftmoment, r¸ckgerechnet auf Lambda=1 und zwopt" UWORD rel_uw_b100 1 100 0 99.9985 FORMAT "%8.5" ECU_ADDRESS 0x403FD6 /end MEASUREMENT
/begin MEASUREMENT mivbeb_w "Indiziertes Moment vor ƒnderungsbegrenzung, nach oben auf mimax_w begrenzt" UWORD rel_uw_b100 1 100 0 99.9985 FORMAT "%8.5" ECU_ADDRESS 0x4041CA /end MEASUREMENT
/begin MEASUREMENT mivbeg_w "inidziertes Fahrerwunschmoment vor ƒnderungsbegrenzung" UWORD rel_uw_b100 1 100 0 99.9985 FORMAT "%8.5" ECU_ADDRESS 0x4041CC /end MEASUREMENT
/begin MEASUREMENT mizsolv_w "Indiziertes resultierendes Sollmoment f¸r ZW-Eingriff vor Momentenbegrenzung" UWORD rel_uw_b100 1 100 0 99.9985 FORMAT "%8.5" ECU_ADDRESS 0x404200 /end MEASUREMENT
/begin MEASUREMENT mizsol_w "Indiziertes resultierendes Sollmoment f¸r ZW-Eingriff" UWORD rel_uw_b100 1 100 0 99.9985 FORMAT "%8.5" ECU_ADDRESS 0x404202 /end MEASUREMENT
/begin MEASUREMENT mizwmn_w "indiziertes Motormoment beim sp‰testen Z¸ndwinkel" UWORD rel_uw_b100 1 100 0 99.9985 FORMAT "%8.5" ECU_ADDRESS 0x404214 /end MEASUREMENT
/begin MEASUREMENT mi_mr_w "ind. Moment in rel. Moment" UWORD rel_uw_b200 1 100 0 199.997 FORMAT "%8.4" ECU_ADDRESS 0x4041CE /end MEASUREMENT
/begin MEASUREMENT mkfanb_w "Kupplungsmoment aus begrenztem Fahrerwunsch" SWORD rel_sw_b100 1 100 -100 99.9969 FORMAT "%8.4" ECU_ADDRESS 0x4041D0 /end MEASUREMENT
/begin MEASUREMENT mrfag_w "" UWORD rel_uw_b200 1 100 0 199.997 FORMAT "%8.4" ECU_ADDRESS 0x4041D2 /end MEASUREMENT
/begin MEASUREMENT mrfamx_w "Relatives Fahrerwunschmoment Maximalwert" UWORD rel_uw_b200 1 100 0 199.997 FORMAT "%8.4" ECU_ADDRESS 0x4041D4 /end MEASUREMENT
/begin MEASUREMENT mrfav_w "Relatives Fahrerwunschmoment vor Ber¸cksichtigung Notfahren" UWORD rel_uw_b200 1 100 0 199.997 FORMAT "%8.4" ECU_ADDRESS 0x4041D6 /end MEASUREMENT
/begin MEASUREMENT mrfa_w "Relatives Fahrerwunschmoment aus FGR und Pedal" UWORD rel_uw_b200 1 100 0 199.997 FORMAT "%8.4" ECU_ADDRESS 0x4041D8 /end MEASUREMENT
/begin MEASUREMENT mrfuemx_w "max. erreichbares rel. Fahrerwunschmoment f¸r Pedal¸berweg" UWORD rel_uw_b200 1 100 0 199.997 FORMAT "%8.4" ECU_ADDRESS 0x4041DA /end MEASUREMENT
/begin MEASUREMENT mrfue_w "Relatives Fahrerwunschmoment im Pedal¸berweg" UWORD rel_uw_b200 1 100 0 199.997 FORMAT "%8.4" ECU_ADDRESS 0x4041DC /end MEASUREMENT
/begin MEASUREMENT mrpedv_w "relatives Fahrerwunschmoment aus Fahrpedalkennfeld" UWORD rel_uw_b200 1 100 0 199.997 FORMAT "%8.4" ECU_ADDRESS 0x4041DE /end MEASUREMENT
/begin MEASUREMENT mrped_w "relatives Fahrerwunschmoment aus Fahrpedal" UWORD rel_uw_b200 1 100 0 199.997 FORMAT "%8.4" ECU_ADDRESS 0x4041E0 /end MEASUREMENT
/begin MEASUREMENT nghgs_w "gefilterter Drehzahlgradient" SWORD nmotg_sw_q0p39 1 100 -12800.2 12799.8 FORMAT "%8.2" ECU_ADDRESS 0x4030DE /end MEASUREMENT
/begin MEASUREMENT nstatfak "" UWORD fak_uw_b8 1 100 0 7.99988 FORMAT "%8.6" ECU_ADDRESS 0x40479A /end MEASUREMENT
/begin MEASUREMENT ntnmot_w "Quotient Wandler-Turbinendr. / Motordrehzahl" UWORD fak_uw_b4 1 100 0 3.99994 FORMAT "%8.6" ECU_ADDRESS 0x4041E2 /end MEASUREMENT
/begin MEASUREMENT nvlsumrs "Anzahl von Starts mit einer Motorstarttemp. von > TMOTMRSMX und Verdacht auf CSD" UBYTE dez 1 100 0 255 FORMAT "%5.1" ECU_ADDRESS 0x3FE0A7 /end MEASUREMENT
/begin MEASUREMENT nvlsumrs2 "Anzahl von Starts mit einer Motorstarttemp. von > TMOTMRSMX und Verdacht auf CSD" UBYTE dez 1 100 0 255 FORMAT "%5.1" ECU_ADDRESS 0x3FE0A8 /end MEASUREMENT
/begin MEASUREMENT nwem_fak "" UWORD fak_uw_b8 1 100 0 7.99988 FORMAT "%8.6" ECU_ADDRESS 0x40479C /end MEASUREMENT
/begin MEASUREMENT redhyst "Reduzierstufenhysterese" SBYTE rel_sb_q0p02 1 100 -2.56 2.54 FORMAT "%5.3" ECU_ADDRESS 0x403CD2 /end MEASUREMENT
/begin MEASUREMENT redneu "neu berechnete Reduzierstufe" UBYTE dez 1 100 0 255 FORMAT "%5.1" ECU_ADDRESS 0x403CD3 /end MEASUREMENT
/begin MEASUREMENT redsol "Berechnete Soll-Reduzierstufe" UBYTE dez 1 100 0 255 FORMAT "%5.1" ECU_ADDRESS 0x403CD4 /end MEASUREMENT
/begin MEASUREMENT redze "Schwelle in Reduzierstufe zwischen Z¸nd- und Einspritzeingriff" UBYTE dez 1 100 0 255 FORMAT "%5.1" ECU_ADDRESS 0x403CD5 /end MEASUREMENT
/begin MEASUREMENT redzst_w "Reduzierstufe ohne Hysterese und Rundung" UWORD rel_uw_q0p001 1 100 0 65.535 FORMAT "%8.5" ECU_ADDRESS 0x404216 /end MEASUREMENT
/begin MEASUREMENT rka2_w "Additive adaptive Korrektur der relativen Kraftstoffmasse" SWORD rel_sw_b1536 1 100 -1536 1535.95 FORMAT "%8.3" ECU_ADDRESS 0x40407E /end MEASUREMENT
/begin MEASUREMENT rkat2_w "additive Gemischkorrektur (pro Zeit) der Gemischadaption Bank 2 (Word)" SWORD rel_sw_b1536 1 100 -1536 1535.95 FORMAT "%8.3" ECU_ADDRESS 0x402DCA /end MEASUREMENT
/begin MEASUREMENT rkatlt2_w "additive Gemischkorrektur von der letzten Trip (HFM 2. Bank)" SWORD rel_sw_b1536 1 100 -1536 1535.95 FORMAT "%8.3" ECU_ADDRESS 0x402DCC /end MEASUREMENT
/begin MEASUREMENT rkatlt_w "additive Gemischkorrektur von der letzten Trip (HFM)" SWORD rel_sw_b1536 1 100 -1536 1535.95 FORMAT "%8.3" ECU_ADDRESS 0x402DCE /end MEASUREMENT
/begin MEASUREMENT rkat_w "additive Gemischkorrektur (pro Zeit) der Gemischdaption (Word)" SWORD rel_sw_b1536 1 100 -1536 1535.95 FORMAT "%8.3" ECU_ADDRESS 0x402DD0 /end MEASUREMENT
/begin MEASUREMENT rkaz2_w "additive Gemischkorrektur (pro Z¸ndung) der Gemischadaption Bank2 (Word)" SWORD rel_sw_b1536 1 100 -1536 1535.95 FORMAT "%8.3" ECU_ADDRESS 0x402DD2 /end MEASUREMENT
/begin MEASUREMENT rkazlt2_w "additive Gemischkorrektur von der letzten Trip (P-System 2. Bank)" SWORD rel_sw_b1536 1 100 -1536 1535.95 FORMAT "%8.3" ECU_ADDRESS 0x402DD4 /end MEASUREMENT
/begin MEASUREMENT rkazlt_w "additive Gemischkorrektur von der letzten Trip (P-System)" SWORD rel_sw_b1536 1 100 -1536 1535.95 FORMAT "%8.3" ECU_ADDRESS 0x402DD6 /end MEASUREMENT
/begin MEASUREMENT rkaz_w "additive Gemischkorrektur (pro Z¸ndung) der Gemischadaption" SWORD rel_sw_b1536 1 100 -1536 1535.95 FORMAT "%8.3" ECU_ADDRESS 0x402DD8 /end MEASUREMENT
/begin MEASUREMENT rka_w "Additive adaptive Korrektur der relativen Kraftstoffmasse" SWORD rel_sw_b1536 1 100 -1536 1535.95 FORMAT "%8.3" ECU_ADDRESS 0x404080 /end MEASUREMENT
/begin MEASUREMENT rlmin_w "minimal zul‰ssiges rl" UWORD rel_uw_q0p0234 1 100 0 1535.98 FORMAT "%8.3" ECU_ADDRESS 0x403FD8 /end MEASUREMENT
/begin MEASUREMENT rlsolold_w "" UWORD rel_uw_q0p0234 1 100 0 1535.98 FORMAT "%8.3" ECU_ADDRESS 0x403FDA /end MEASUREMENT
/begin MEASUREMENT rlsol_w "Soll-F¸llung" UWORD rel_uw_q0p0234 1 100 0 1535.98 FORMAT "%8.3" ECU_ADDRESS 0x403FDC /end MEASUREMENT
/begin MEASUREMENT rlugdob_w "F¸llung im ungedrosselten Zustand" UWORD rel_uw_q0p0234 1 100 0 1535.98 FORMAT "%8.3" ECU_ADDRESS 0x404210 /end MEASUREMENT
/begin MEASUREMENT rlugd_w "F¸llung im ungedrosselten Zustand" UWORD rel_uw_q0p0234 1 100 0 1535.98 FORMAT "%8.3" ECU_ADDRESS 0x404212 /end MEASUREMENT
/begin MEASUREMENT rlvugd "unkorrigierte F¸llung im ungedrosselten Zustand" UBYTE rel_ub_q0p75 1 100 0 191.25 FORMAT "%5.1" ECU_ADDRESS 0x403CD0 /end MEASUREMENT
/begin MEASUREMENT rl_kge "Eingang relative F¸llung f¸r mehrfach verwendete Kenngrˆﬂen" UBYTE rel_ub_q0p75 1 100 0 191.25 FORMAT "%5.1" ECU_ADDRESS 0x3FC3D7 /end MEASUREMENT
/begin MEASUREMENT rl_w_kge "Eingang relative F¸llung (Word) f¸r mehrfach verwendete Kenngr." UWORD rel_uw_q0p0234 1 100 0 1535.98 FORMAT "%8.3" ECU_ADDRESS 0x4041A4 /end MEASUREMENT
/begin MEASUREMENT snmta "St¸tzstellenkorrektur von nmot" UBYTE nmot_ub_q40 1 100 0 10200 FORMAT "%5.0" ECU_ADDRESS 0x403CD1 /end MEASUREMENT
/begin MEASUREMENT S_dp "Schalter Dashpot (1=ein)" UBYTE B_TRUE 1 100 0 1 BIT_MASK 0x1 FORMAT "%13.11" ECU_ADDRESS 0x3FC258 /end MEASUREMENT
/begin MEASUREMENT S_ls "Schalter Lastschlagd‰mpfung (1=ein)" UBYTE B_TRUE 1 100 0 1 BIT_MASK 0x1 FORMAT "%13.11" ECU_ADDRESS 0x3FC259 /end MEASUREMENT
/begin MEASUREMENT tansst "Ansaugluft-Temperatur bei Start" UBYTE temp_ub_q0p75_o48 1 100 -48 143.25 FORMAT "%5.1" ECU_ADDRESS 0x403CE8 /end MEASUREMENT
/begin MEASUREMENT tlrbamo_w "Ausgang der Kennlinie TLRBAM" UWORD t10msxs_uw_b655p35 1 100 0 655.35 FORMAT "%8.4" ECU_ADDRESS 0x40353E /end MEASUREMENT
/begin MEASUREMENT tlrs_w "Totzeit der Lambdaregelstrecke" UWORD tz10msxs_uw_b327p68 1 100 0.00500008 327.68 FORMAT "%12.8" ECU_ADDRESS 0x4042C6 /end MEASUREMENT
/begin MEASUREMENT tlrvamo_w "Ausgang der Kennlinie TLRVAM" UWORD t10msxs_uw_b655p35 1 100 0 655.35 FORMAT "%8.4" ECU_ADDRESS 0x403540 /end MEASUREMENT
/begin MEASUREMENT tsaka "Timer Schubdauer f¸r Katalysator-Ausr‰umen" UBYTE t20msxs_ub_b5p1 1 100 0 5.1 FORMAT "%5.3" ECU_ADDRESS 0x40359E /end MEASUREMENT
/begin MEASUREMENT tsaka2 "Timer Schubdauer f¸r Katalysator-Ausr‰umen f¸r Stereo_LR Bank 2" UBYTE t20msxs_ub_b5p1 1 100 0 5.1 FORMAT "%5.3" ECU_ADDRESS 0x40359F /end MEASUREMENT
/begin MEASUREMENT usnhhk_w "Spannung Lambdasonde (4.88mV/LSB) hinter Hauptkatalysator" UWORD spg_uw_q0p00488_o1 1 100 -1 318.995 FORMAT "%8.4" ECU_ADDRESS 0x4047F4 /end MEASUREMENT
/begin MEASUREMENT usrhk "aktuelle Regelschwelle Lambdasignal h.K." UBYTE spg_ub_q0p0052_o0p2 1 100 -0.2 1.13 FORMAT "%5.3" ECU_ADDRESS 0x403566 /end MEASUREMENT
/begin MEASUREMENT usrhk2 "aktuelle Regelschwelle Lambdasignal h.K., Bank 2" UBYTE spg_ub_q0p0052_o0p2 1 100 -0.2 1.13 FORMAT "%5.3" ECU_ADDRESS 0x403567 /end MEASUREMENT
/begin MEASUREMENT usrhk2_w "aktuelle Regelschwelle Lambdasignal hinter KAT (word) Bank2" UWORD spg_uw_q0p00488_o1 1 100 -1 318.995 FORMAT "%8.4" ECU_ADDRESS 0x40355E /end MEASUREMENT
/begin MEASUREMENT usrhkr "Ausgang Kennfeld KFUSHK" UBYTE spg_ub_q0p0052_o0p2 1 100 -0.2 1.13 FORMAT "%5.3" ECU_ADDRESS 0x403568 /end MEASUREMENT
/begin MEASUREMENT usrhk_w "aktuelle Regelschwelle Lambdasignal hinter KAT (word)" UWORD spg_uw_q0p00488_o1 1 100 -1 318.995 FORMAT "%8.4" ECU_ADDRESS 0x403560 /end MEASUREMENT
/begin MEASUREMENT wpfgruf_w "R¸ckgerechneter Pedalwert bei FGR-Betrieb ungefiltert" UWORD rel_uw_b100 1 100 0 99.9985 FORMAT "%8.5" ECU_ADDRESS 0x4041E4 /end MEASUREMENT
/begin MEASUREMENT wpfgr_w "R¸ckgerechneter Pedalwert bei FGR-Betrieb" UWORD rel_uw_b100 1 100 0 99.9985 FORMAT "%8.5" ECU_ADDRESS 0x4041E6 /end MEASUREMENT
/begin MEASUREMENT xtkikm2_w "Source f¸r Kennlinie ILMLKATKX2; wird gem‰ss Systemkonstante SY_BDE beschrieben" UWORD temp_q0p0234_o273 1 100 -273.15 1262.83 FORMAT "%8.3" ECU_ADDRESS 0x403594 /end MEASUREMENT
/begin MEASUREMENT xtkikm_w "Source f¸r Kennlinie ILMLKATKX; wird gem‰ss Systemkonstante SY_BDE beschrieben" UWORD temp_q0p0234_o273 1 100 -273.15 1262.83 FORMAT "%8.3" ECU_ADDRESS 0x403596 /end MEASUREMENT
/begin MEASUREMENT zdashvfmk "" UWORD zk10msxs_uw_b655 1 100 0.0100002 655.36 FORMAT "%12.8" ECU_ADDRESS 0x4041E8 /end MEASUREMENT
/begin MEASUREMENT zdash_w "Zeitkonstante Dashpot" UWORD zk10msxs_uw_b655 1 100 0.0100002 655.36 FORMAT "%12.8" ECU_ADDRESS 0x4041EA /end MEASUREMENT
/begin MEASUREMENT zkfrat_w "Zeitkonstante der FRAT-Adaption" UWORD fak_uw_b5 1 100 0 4.99992 FORMAT "%8.6" ECU_ADDRESS 0x402DDA /end MEASUREMENT
/begin MEASUREMENT zlasohf2_w "Zeitkonstante f¸r PT1-Filter des Pseudo-Lambda hinter Kat, Bank 2" UWORD t10msxs_uw_b655p35 1 100 0.01 655.35 FORMAT "%8.4" ECU_ADDRESS 0x404806 /end MEASUREMENT
/begin MEASUREMENT zlasohf_w "Zeitkonstante f¸r PT1-Filter des Pseudo-Lambda hinter Kat" UWORD t10msxs_uw_b655p35 1 100 0.01 655.35 FORMAT "%8.4" ECU_ADDRESS 0x404808 /end MEASUREMENT
/begin MEASUREMENT zlrs "Verzˆgerungszeitkonstante der Lambdaregelstrecke" UBYTE zk10msxs_ub_b2p55 1 100 0.01 2.55 FORMAT "%7.5" ECU_ADDRESS 0x403CE4 /end MEASUREMENT
/begin MEASUREMENT zlrs_w "Verzˆgerungszeitkonstante der Lambdaregelstrecke, 16 bit" UWORD zk10msxs_uw_b655 1 100 0.0100002 655.36 FORMAT "%12.8" ECU_ADDRESS 0x4042C8 /end MEASUREMENT
/begin MEASUREMENT zlsdvfmk "" UWORD zk10msxs_uw_b655 1 100 0.0100002 655.36 FORMAT "%12.8" ECU_ADDRESS 0x4041EC /end MEASUREMENT
/begin MEASUREMENT zlsd_w "Zeitkonstante PT2-Filter Lastschlagd‰mpfung" UWORD zk10msxs_uw_b655 1 100 0.0100002 655.36 FORMAT "%12.8" ECU_ADDRESS 0x4041EE /end MEASUREMENT
/begin MEASUREMENT zwopt "optimaler Z¸ndwinkel" SBYTE zw_sb_q0p75 1 100 -96 95.25 FORMAT "%5.2" ECU_ADDRESS 0x403CC8 /end MEASUREMENT
/begin MEASUREMENT zwoptl1 "optimaler Z¸ndwinkel bei Lambda=1" SBYTE zw_sb_q0p75 1 100 -96 95.25 FORMAT "%5.2" ECU_ADDRESS 0x403CC9 /end MEASUREMENT
/begin FUNCTION LRA "132.50    Adaptive Vorsteuerung f¸r Lambdaregelung"
 /begin DEF_CHARACTERISTIC CWGALSV CWLRARL FBZFRAT FRAOMN FRAOMX FRAORN FRAORX FRATMN FRATMX FRAUMN FRAUMX FRAURN FRAURX KFRAT MLO1 MLO1AC MLO2 MLO3 MLO3AC MLU2 MLU2AC MLU2FA MLU4 MLU4AC N0 NO1 NO2 NOLRA NRKAB NU2 NU3 RKATMN RKATMX RKATRN RKATRX RKAZMN RKAZMX RKAZRN RKAZRX RL0 RLLRAMN RLO2 RLO3 RLO3AC RLU2 RLU2AC RLU3 RLU4 RLU4AC TGAALTWR TMFRATMN TMFRATUB ZKFRAOA ZKFRAUA ZKRKATA ZKRKAZA ZRLFRAT /end DEF_CHARACTERISTIC
 /begin REF_CHARACTERISTIC TMRAA /end REF_CHARACTERISTIC
 /begin IN_MEASUREMENT abo B_abor B_agr B_edkvs B_edkvs2 B_eemrdy B_eepdif B_fa B_faan B_fakvs B_koe B_lr B_lr2 B_lra B_lra2 B_lrat B_lsvvsp B_stend frm2_w frm_w ml_w nmot rl rl_w tmot /end IN_MEASUREMENT
 /begin OUT_MEASUREMENT B_clradlr B_frao B_fraor B_fraor2 B_frat B_frau B_fraur B_fraur2 B_lrare B_lrare2 B_nofra B_nofrat B_norkat B_norkaz B_rkat B_rkatr B_rkatr2 B_rkaz B_rkazr B_rkazr2 fra2_w frao2_w frao_w frat2_w frati2_w frati_w frat_w frau2_w frau_w fra_w ftklra_w rka2_w rkat2_w rkat_w rkaz2_w rkaz_w rka_w /end OUT_MEASUREMENT
 /begin LOC_MEASUREMENT B_lrareb dfrm2_w dfrmt2_w dfrmt_w dfrm_w dlrfrat fraolt2_w fraolt_w frault2_w frault_w rkatlt2_w rkatlt_w rkazlt2_w rkazlt_w zkfrat_w /end LOC_MEASUREMENT
/end FUNCTION
/begin FUNCTION LRAEB "5.100     Einschaltbedingungen Gemischadaption" /begin DEF_CHARACTERISTIC LAMLRAMN LAMLRAMX TARA TMEWRAA TMRAA TVLRA WDKARN /end DEF_CHARACTERISTIC
 /begin IN_MEASUREMENT B_brems B_bt B_dsls B_dteaa B_dtest B_dvvtobd B_enws B_fa B_gap B_grdst B_lr B_lr2 B_lrasp B_lrasp2 B_mdarv B_sls B_te B_ukg B_vl lamsons_w nmot tans tmew tmot wdkba /end IN_MEASUREMENT
 /begin OUT_MEASUREMENT B_gasp B_lra B_lra2 B_lrat /end OUT_MEASUREMENT
 /begin LOC_MEASUREMENT B_lraen B_tsten /end LOC_MEASUREMENT
/end FUNCTION
/begin FUNCTION LRS "15.130    Stetige Lambdaregelung"
 /begin DEF_CHARACTERISTIC CLRS CWLRFZA CWLRMS FRMAX FRMINKH KFDLASO KFDLASO2 KFFRMIN KFLRSG1 KFLRSG2 KFLRSG4 KFLRSP1 KFLRSP2 KFLRSP3 KFLRSP4 KFLRST KFLRSZ LADIFFTHR LALIUSMN LRSGKTM LRSTPZA LRSZAWML TAUIDEC TKATSZA TKATSZA2 TMLRZAMN WIMAX WIMIN XIMAX XIMIN Y2MAX /end DEF_CHARACTERISTIC
 /begin REF_CHARACTERISTIC SNM07LSUW SNM10LSUB SRL08LSUW SRL10LSUB /end REF_CHARACTERISTIC
 /begin IN_MEASUREMENT B_frini B_frini2 B_gaeing B_gaeing2 B_kh B_lrka B_lrka2 B_lrmsbs B_lrmsbs2 B_lrs B_lrs2 B_lrsresf B_nswo1 B_sls dlahi2_w dlahi_w dlahp2_w dlahp_w esst_snm07lsuw esst_snm10lsub esst_srl08lsuw esst_srl10lsub flamsl2_w flamsl_w frini2_w frini_w lamsbg2_w lamsbg_w lamsoni2_w lamsoni_w lamsons2_w lamsons_w ml_w nmot nmot_w rl rl_w tkatm2_w tkatm_w tmot tnst_w /end IN_MEASUREMENT
 /begin OUT_MEASUREMENT B_frmax B_frmax2 B_frmin B_frmin2 B_lrsrems B_lrsrems2 B_lrssp B_lrssp2 B_za B_za2 dfrza2_w dfrzaf2_w dfrzaf_w dfrza_w fr2_w frm2_w frmn_w frmx_w frm_w fr_w ladiff2_w ladiff_w lamsbgt2_w lamsbgt_w lamzak2_w lamzak_w tlrs_w zlrs zlrs_w /end OUT_MEASUREMENT
 /begin LOC_MEASUREMENT B_flrsres B_idecay B_idecay2 B_lrmsbrc B_lrmsbrc2 B_trigger B_update B_update2 B_y2max B_y2max2 B_y2min B_y2min2 dfr2_w dfrmin2_w dfrmin_w dfrmn2_w dfrmn_w dfrpr2_w dfrpr_w dfrzaff2_w dfrzaff_w dfrzapr_w dfr_w dlahfi2_w dlahfi_w dlahfp2_w dlahfp_w dlaso dlaso2 froza2_w froza_w g1korr lamsbpr2_w lamsbpr_w lamzapr2_w lamzapr_w lrsg1_w lrsg2_w lrsg4_w lrsp1_w lrsp2_w lrsp3_w lrsp4_w lrstza_w lrsw12_w lrsw1_w lrsw22_w lrsw2_w lrsxk12_w lrsxk1_w lrsxk32_w lrsxk3_w lrsxk42_w lrsxk4_w lrsy22_w lrsy2_w lrsy42_w lrsy4_w lrsza /end LOC_MEASUREMENT
/end FUNCTION
/begin FUNCTION LRSBSEL "1.30      Koordination der durch die Y-Konfig. betroffenen Ein-/Ausg‰nge der LRS-Fktn." /begin REF_CHARACTERISTIC CWKONFLS /end REF_CHARACTERISTIC
 /begin IN_MEASUREMENT B_sbbhk B_sbbhk2 dlahico2_w dlahico_w dlahpco2_w dlahpco_w ushk2_w ushk_w /end IN_MEASUREMENT
 /begin OUT_MEASUREMENT B_abgy B_sbbnhhk dlahi2_w dlahi_w dlahp2_w dlahp_w usnhhk_w /end OUT_MEASUREMENT
/end FUNCTION
/begin FUNCTION LRSEB "22.10     Einschaltbedingungen stetige Lambdaregelung"
 /begin DEF_CHARACTERISTIC CLRZWTMS DLAMXSA DTMR DTMTMRW IMLEVABS IMLEVABS2 IMLSALR NLRSHB RLLRSHB RLLRUN RLSLSMN TARAU TASHS TLRBAM TLRHS TLRSLASA TLRSZWSA TLRTMS TLRVAM TLRZWTMS TMRA1 TMRA2 TMRAK TMSHS TRAU TVSLR /end DEF_CHARACTERISTIC
 /begin REF_CHARACTERISTIC CLRS LALIUSMN /end REF_CHARACTERISTIC
 /begin IN_MEASUREMENT B_bag B_bevab B_bevab2 B_craus B_dsla B_dslsk B_eev B_elsuv B_esls B_falr B_ll B_mdarv B_mdkat B_sa B_sbbhk B_sbbhk2 B_sbblsu B_sbblsu2 B_slsoff B_st B_stend B_temin B_temin2 B_vag B_vlsuftb B_vlsuftb2 lamsoni2_w lamsoni_w lamsons2_w lamsons_w ml_w nmot rl tans tmot tmotlin tmrw tmst /end IN_MEASUREMENT
 /begin OUT_MEASUREMENT B_eobdlr B_eobdlr2 B_lr B_lr2 B_lr2s B_lr2s2 B_lrmsbs B_lrmsbs2 B_lrnda B_lrnda2 B_lrs B_lrs2 B_lrsresf B_lrssa B_lrssa2 B_lrvk B_lrvk2 B_mlevab B_mlevab2 B_mlrsa B_nolrb B_nolrb2 B_nolre B_nolre2 B_nolrw B_nolrw2 B_tmlr flglrs flglrs2 /end OUT_MEASUREMENT
 /begin LOC_MEASUREMENT B_lelshbb B_lelshbb2 B_lelsubb B_lelsubb2 B_lrrl B_pspaus B_pspwl B_slspaus B_tarau imlevab2_w imlevab_w imlrsa_w tansst tlrbamo_w tlrvamo_w /end LOC_MEASUREMENT
/end FUNCTION
/begin FUNCTION LRSHKC "4.40      Lambdaregelung hinter Kat stetig , Version kontinuierlich"
 /begin DEF_CHARACTERISTIC DLAHINI DLAHINI2 KDLASHKI KDLASHKI2 KDLASHKP KDLASHKP2 KFH2CONC KFUSHK KILRHKML KLH2DUSH KLH2FCOSC KPLRHML LALIUSHK LALIUSHK2 LASHKAB LASHKAB2 LRHIMN LRHIMX PLRHFOSC PLRHFOSC2 SM109LHSW SM209LHSW ZLASHKAB ZLASHKAB2 ZLASOHML ZLASOHML2 /end DEF_CHARACTERISTIC
 /begin REF_CHARACTERISTIC CLRSHK SML08LHUB /end REF_CHARACTERISTIC
 /begin IN_MEASUREMENT B_lr B_lr2 B_lrhk B_lrhk2 B_lrhkp B_lrhkp2 B_lrka B_lrka2 B_lrssp B_pwf B_st esst_sml08lhub fcoschk fcoschk2 ml ml_w nmot rl ushk2_w ushk_w /end IN_MEASUREMENT
 /begin OUT_MEASUREMENT B_clradlrh dlahico2_w dlahico_w dlahpco2_w dlahpco_w lasolhk2_w lasolhk_w lasonhk2_w lasonhk_w usrhk usrhk2 usrhk2_w usrhk_w /end OUT_MEASUREMENT
 /begin LOC_MEASUREMENT B_dlahini B_dlahini2 dlahini2_w dlahini_w dlahkab2_w dlahkab_w dlashki2_w dlashki_w dlashkm2_w dlashkm_w dlashkp2_w dlashkp_w dlhkpml2_w dlhkpml_w esst_sm109lhsw esst_sm209lhsw h2conc h2concb h2concb2 lahkf2_w lahkf_w lahkm2_w lahkmz lahkmz2 lahkm_w lrshkcLokBits usrhkr zlasohf2_w zlasohf_w /end LOC_MEASUREMENT
/end FUNCTION
/begin FUNCTION LRSHKEB "4.20      Einschaltbedingungen Lambdaregelung (stetig) hinter Katalysator"
 /begin DEF_CHARACTERISTIC CLRSHK CLRSHKEB CTAGEFOSCX DRLLRHKO DRLLRHKU IMSLRUCAX IMSLRUX KLFOSCHKAX LAMBRSMN LAMBRSMX NLRHO NLRHU RLLRHON RLLRHUN TBLRH TBLRH2 TDRLLRHKX TKATMLRH TKATMLRH2 TKATMLRHI TKATMLRHI2 TKATMLRHK TKATMLRHX TKATMLRHX2 TKTMHICAX TKTMHICAX2 TKTMLRCAX TKTMLRCAX2 TLAMSBRS TMOTLRHI /end DEF_CHARACTERISTIC
 /begin REF_CHARACTERISTIC SNM08LHUB /end REF_CHARACTERISTIC
 /begin IN_MEASUREMENT B_dvvtobd B_edkvs B_edkvs2 B_falrshk B_falsh B_falsh2 B_lr B_lr2 B_lrka B_lrka2 B_mdarv B_sbbhk B_sbbhk2 B_tehb drlas_w esst_snm08lhub fcoschk fcoschk2 lamsbrs2_w lamsbrs_w lamsons2_w lamsons_w msabvhk2_w msabvhk_w nmot rl tkihkm2_w tkihkm_w tmot /end IN_MEASUREMENT
 /begin OUT_MEASUREMENT B_lrhk B_lrhk2 B_lrhkp B_lrhkp2 B_lrhkpzp B_lrhkpzp2 B_lrhkzp B_lrhkzp2 lrshkebAusBits lrshkebAusBits1 lrshkebAusBits10ms /end OUT_MEASUREMENT
 /begin LOC_MEASUREMENT B_ctagosx B_ctagosx2 B_iehshk B_iekat B_iekat2 B_iekati B_iekati2 B_ielsh B_ielsh2 B_iesls B_iesls2 B_ieteve2 B_lrdel B_lrdel2 B_lrhbb B_lrhber B_lrhber2 B_lrhkb B_lrhkb2 B_lrhkbt B_lrhkbt2 B_lrhkbti B_lrhkbti2 B_lrhkbv B_lrhkbv2 B_lrhkg B_lrhkgi B_lrhlas B_lrhlas2 B_lrkaint B_lrkaint2 B_msabhka B_msabhka2 imsbhka2_w imsbhka_w imsbhla_w lrshkebLokBits lrshkebLokBits1 lrshkebLokBits2 lrshkebLokBits3 lrshkebLokBits4 /end LOC_MEASUREMENT
/end FUNCTION
/begin FUNCTION LRSINI "1.10      Stetige Lambdaregelung, Koordination der Initialisierung" /begin IN_MEASUREMENT B_dtefrr frdter_w /end IN_MEASUREMENT /begin OUT_MEASUREMENT B_frini B_frini2 frini2_w frini_w /end OUT_MEASUREMENT /end FUNCTION
/begin FUNCTION LRSKA "6.120     Stetige Lambdaregelung Zusatzfunktion Katalysator-Ausr‰umen"
 /begin DEF_CHARACTERISTIC CLRSKA FKAXFOSC FKAXFOSC2 FLMLKAMA FLMLKAMA2 ILMLKAXTK ILMLKAXTK2 IMLKAMN IMLKAMN2 LAKAMSAIML LAMKADEF LAMSKAMX LAMSKAMX2 NLRKA TDLAKAD TDLAKAU TLAKAMN TLAKAMN2 TSAKAMN TSAKAMN2 USHKAMNW USHKAMNW2 USHKAMXW USHKAMXW2 /end DEF_CHARACTERISTIC
 /begin IN_MEASUREMENT B_bevab B_bevab2 B_lamdkt B_sbbhk B_sbbhk2 B_sbblsu B_sbblsu2 B_sbbvk B_sbbvk2 fcoschk fcoschk2 lamsbrs2_w lamsbrs_w lamsoni2_w lamsoni_w lamsons2_w lamsons_w msabvhk2_w msabvhk_w nmot tkiuem2_w tkiuem_w ushk2_w ushk_w /end IN_MEASUREMENT
 /begin OUT_MEASUREMENT B_lamka B_lamka2 B_lrka B_lrka2 ilmltkx2_w ilmltkx_w imllaka2_w imllaka_w imslaka2_w imslaka_w lamka2_w lamka_w lrskaAusBits20ms /end OUT_MEASUREMENT
 /begin LOC_MEASUREMENT B_blrka B_blrka2 B_lrkaa B_lrkaa2 B_lrkae B_lrkae2 dlamka2_w dlamka_w ffcoscmx ffcoscmx2 iftkavx2_w iftkavx_w imlka2_w imlka_w lrkaz lrkaz2 lrskaLokBits20ms tsaka tsaka2 xtkikm2_w xtkikm_w /end LOC_MEASUREMENT
/end FUNCTION
/begin FUNCTION LSUMRS "1.20      Erkennung Verdacht auf LSU-Mager-Shift" /begin DEF_CHARACTERISTIC CWLSUMRS NVLSUMRSMX TMOTMRSMX /end DEF_CHARACTERISTIC /begin IN_MEASUREMENT B_pwf B_stend tmst_w /end IN_MEASUREMENT /begin OUT_MEASUREMENT B_vlsumrs B_vlsumrs2 /end OUT_MEASUREMENT /begin LOC_MEASUREMENT nvlsumrs nvlsumrs2 /end LOC_MEASUREMENT /end FUNCTION
/begin FUNCTION lurman "lurman.   Lurmin-Manager" /begin IN_MEASUREMENT B_tdlurkor lurvvtstat /end IN_MEASUREMENT /begin OUT_MEASUREMENT lurminstat /end OUT_MEASUREMENT /end FUNCTION
/begin FUNCTION MDAUTG "2.60      Berechnung des Istmomentes f¸r die Getriebesteuerung"
 /begin IN_MEASUREMENT B_dash B_fil B_kh B_kw B_ll B_lsd B_mibeg B_sab B_zwvz dmaufr_w dmllr_w miasrs_w mibas_w mibgr_w mifa_w mimsr_w minmx_w miszul_w mivbeb_w mivmx_w mizwmn_w /end IN_MEASUREMENT
 /begin OUT_MEASUREMENT miautget_w miautgs_w miistoar_w /end OUT_MEASUREMENT
/end FUNCTION
/begin FUNCTION MDBAS "20.100    Berechnung der Basisgrˆﬂen f¸r Momentenschnittstelle"
 /begin DEF_CHARACTERISTIC CWMBAS DZW2DZWQ DZWKOEFKT DZWOLA DZWOM ETALAM FDZWKOFTMT KFDZWAGR KFDZWKOEF KFDZWKOEFT KFETAGD KFKDZWKOFT KFMIOP KFZWOP KFZWOP2 KFZWOPLL KFZWOPLLT KLFWUELL SRL16OPUW TMSPR ZDZWKOEFT ZKFZNWLL ZRL_W_KGE /end DEF_CHARACTERISTIC
 /begin REF_CHARACTERISTIC DTMSPR SNM16OPUW /end REF_CHARACTERISTIC
 /begin IN_MEASUREMENT agrr Asprl Asprlu B_agr B_ll B_st dpsfak dzwwl Esprl Esprlu esst_snm16opuw lambas nmot nmot_w rl rl_w tmot Vsa_spri Vse_spri zwbas /end IN_MEASUREMENT
 /begin OUT_MEASUREMENT dzwkoef dzwkoefkt dzwkoeft dzwkoeftnf dzwkoefwt dzwoag dzwol esst_srl16opuw etagd etalab etatrmn etazwb etazwbm mibas_w miopt_w rl_kge rl_w_kge zwopt zwoptl1 /end OUT_MEASUREMENT
 /begin LOC_MEASUREMENT Asprll B_koefini B_koefkf dzwagr dzwb dzwotm Esprll fnwll fnwlleff fwuell fznwll mioptl1_w mioptugd_w /end LOC_MEASUREMENT
/end FUNCTION
/begin FUNCTION MDBGRG "11.60     Momentenbegrenzung nach oben"
 /begin DEF_CHARACTERISTIC CWMDBGRG CWPBREMS DMIHTOELD DMIHTOELI FMIHGN MIHGSLG MIHTOEL MKBRMXWP MKPBREMSMX NGHGS PBREMSMX TVBRMX TVPBREMS VMKBRMX ZMIBGR ZNGHGS /end DEF_CHARACTERISTIC
 /begin REF_CHARACTERISTIC MDIMX /end REF_CHARACTERISTIC
 /begin IN_MEASUREMENT B_brems B_toelh2 codget gangi mdverl_w mifafu_w miint_w miist_w milsol_w ngas_w nmot nmot_w pbrems stbrems vfzg wped_w /end IN_MEASUREMENT
 /begin OUT_MEASUREMENT mibgr_w /end OUT_MEASUREMENT
 /begin LOC_MEASUREMENT B_bremsold B_brvfp B_hgsndy B_mibgr fmibgrv_w fmibgr_w mibgrht_w mibgrv_w mibrmx_w midbgr_w nghgs_w /end LOC_MEASUREMENT
/end FUNCTION
/begin FUNCTION MDFAW "40.70     Fahrerwunschmoment"
 /begin DEF_CHARACTERISTIC CWDMFAB CWDMFAB2 CW_FMKNUL DLSDWE DMDPUG DMIFSAWE DMLSDUG DMRFAV KFDLSD KFDLSDS KFDMDPO KFDMLSDO KFFDMFBT KFFMKNULFS KFFMKNULSS KFMIFALGD KFMIFALS KFMIFALSS KFMILSD KFMIMR KFMRMI KFPED KFPEDS KFWMRFAG KFWMRFAV KFWPFGR KFZDASH KFZDASHQ KFZDASHS KFZLSD KFZLSDQ KFZLSDS KFZLSDWE KLFDASH KLFLSD KLFMAUS KLFMKNUL KLTWEMEMO KLTWEMEMO2 MKLSDUGA MRFALLO MRFALLU MRFUEMXN NGFSAWE SMK06MDUW S_dmfbdpf TDMFBSA TDMFBWE TVDPSTEND TVFSAWE TWPFGR WPEDSPMN WPEDSPMX /end DEF_CHARACTERISTIC
 /begin REF_CHARACTERISTIC MDIMX SGA08MDUB SNM06MDUW S_mdversta /end REF_CHARACTERISTIC
 /begin IN_MEASUREMENT bfzgqars_w B_kuppl B_mbegegs B_nmot B_sa B_sab B_savfgr B_stend B_vnull dmllri_w dmverl_w dpsfak dpssolgd_w dpssol_uw dpssol_w egsstat_um esst_sga08mdub esst_snm06mduw gangi kfdps_aus mdverb_w mdverl_w miasrl_w mibgr_w miges_w miist_w milsol_w mimax_w mimin_w mimxl1_w minmx_w mivmx_w mrfgr_w mrstt_w ngfil_w nmot_w nturbc_w nturbv_w stgangr stmodvec vfzgk_w vfzg_w wped_w /end IN_MEASUREMENT
 /begin OUT_MEASUREMENT B_dash B_fgr B_fil B_ll B_lsd esst_smk06mduw fdmfbt fmil_w mifa mifal_w mifa_w mivbeg_w mrfamx_w mrfav_w mrfa_w mrfuemx_w mrfue_w mrped_w ntnmot_w wpfgruf_w wpfgr_w /end OUT_MEASUREMENT
 /begin LOC_MEASUREMENT B_dp B_edp B_elsd B_iflsd B_ls B_pedsport B_wememo dlsd_w dmdpo_w dmdpu_w dmlsdo_w dmlsdu_w dpsfaktd fmknul iwflsd_w mdverbfa_w mibdp_w miblsd_w migef_w mil1_w mil2_w mil3_w minbeg_w mivbeb_w mi_mr_w mkfanb_w mrfag_w mrpedv_w S_dp S_ls zdashvfmk zdash_w zlsdvfmk zlsd_w /end LOC_MEASUREMENT
/end FUNCTION
/begin FUNCTION MDFUE "17.20     Sollwertvorgabe f¸r Luftmasse aus Sollmoment" /begin DEF_CHARACTERISTIC KFMIRL KFRLMNN KFRLMNNT KFRLMNSAN KFRLMNSANT ZETABASN /end DEF_CHARACTERISTIC /begin REF_CHARACTERISTIC SNM12FEUB STM04FEUB /end REF_CHARACTERISTIC
 /begin IN_MEASUREMENT B_sa dpsfak esst_snm12feub esst_stm04feub etalab etazwbm milsol_w nmot nmot_w rlmax_w tmot /end IN_MEASUREMENT
 /begin OUT_MEASUREMENT drlsol_w rlmin_w rlsol_w /end OUT_MEASUREMENT
 /begin LOC_MEASUREMENT etabasf_w etabas_w misopl1_w rlsolold_w /end LOC_MEASUREMENT
/end FUNCTION
/begin FUNCTION MDIST "21.20     Motormomentenberechnung" /begin REF_CHARACTERISTIC DZW2DZWQ /end REF_CHARACTERISTIC /begin IN_MEASUREMENT dzwkoef miopt_w redist zwist zwopt /end IN_MEASUREMENT /begin OUT_MEASUREMENT etazaist etazwist miist_w /end OUT_MEASUREMENT /begin LOC_MEASUREMENT dzwi mdindg_w /end LOC_MEASUREMENT /end FUNCTION
/begin FUNCTION MDKOG "13.50     Drehmomentenkoordination f¸r Gesamteingriffe"
 /begin DEF_CHARACTERISTIC CWMDKOG CWTEZW CWZWE CWZWVMX DMRKHO DMRKHU MDHYST NASNOT NKUPZWEO NKUPZWEU NLLZWEO NLLZWEU NLSDZWEO NLSDZWEU TMVER TPNSMD VKUPZWEO VKUPZWEU VLLZWEO VLLZWEU VLSDZWEO VLSDZWEU /end DEF_CHARACTERISTIC
 /begin REF_CHARACTERISTIC MDIMX /end REF_CHARACTERISTIC
 /begin IN_MEASUREMENT B_dash B_fil B_HLSKW B_kh B_kuppl B_kw B_ll B_llrein B_lsd B_stend dmar_w dmllrz_w dmrkh dmrkt_w etazwb miasrl_w miasrs_w mibas_w mibgr_w mifa_w migs_w milres_w mimax_w mimsr_w minmx_w miopt_w misgs_w miszul_w mitebg_w mivmx_w nmot rlmin_w rlsol_w vfzg /end IN_MEASUREMENT
 /begin OUT_MEASUREMENT B_allzw B_allzwe B_asr B_mdein B_mibeg B_msr B_savmd B_sgs B_zwvs B_zwvz dmzms_w miext_w mifab_w misolv_w misol_w mizsol_w /end OUT_MEASUREMENT
 /begin LOC_MEASUREMENT mibeg_w miextv_w mizsolv_w /end LOC_MEASUREMENT
/end FUNCTION
/begin FUNCTION MDKOL "Momentenkoordination auf F¸llungsebene" /begin REF_CHARACTERISTIC MDIMX NASNOT /end REF_CHARACTERISTIC
 /begin IN_MEASUREMENT B_cwmdkol B_dash B_fil B_llrein B_lsd B_mibeg dmllr_w dmrkh dmrkt_w dmrllr_w etazwbm etazwmn miasrl_w mibgr_w mifal_w mifa_w miges_w migsl_w mimsr_w minmx_w misgsl_w miszull_w mitebg_w mivmx_w nmot vsdmr /end IN_MEASUREMENT
 /begin OUT_MEASUREMENT B_mrakt dmrmx_w mifafu_w milres_w milsol_w /end OUT_MEASUREMENT
/end FUNCTION
/begin FUNCTION MDMAX "5.50      Berechnung maximales indiziertes Motormoment" /begin DEF_CHARACTERISTIC FMIVL FRLVTM RLVMXN RLVSMXN STNMTA /end DEF_CHARACTERISTIC /begin REF_CHARACTERISTIC KFMIOP SNM16OPUW SRL16OPUW /end REF_CHARACTERISTIC
 /begin IN_MEASUREMENT B_su esst_snm16opuw esst_srl16opuw fho_w ftvdk mrfamx_w nmot nmot_w rlumax_w rl_w_kge tans tmot /end IN_MEASUREMENT
 /begin OUT_MEASUREMENT mimax_w mimxl1_w rlugdob_w rlugd_w rlvugd /end OUT_MEASUREMENT
 /begin LOC_MEASUREMENT snmta /end LOC_MEASUREMENT
/end FUNCTION
/begin FUNCTION MDMIN "5.10      Minimales Motormoment Koordination" /begin IN_MEASUREMENT B_sab fnstab_w mdverf_w /end IN_MEASUREMENT /begin OUT_MEASUREMENT mill_w mimin_w /end OUT_MEASUREMENT /end FUNCTION
/begin FUNCTION MDNSTAB "4.30      Drehmoment: Drehzahlstabilisierung" /begin DEF_CHARACTERISTIC FNSTABNV NMDSTAOF /end DEF_CHARACTERISTIC /begin IN_MEASUREMENT B_stend nmot_w nstat nwem_out /end IN_MEASUREMENT /begin OUT_MEASUREMENT B_fnstab fnstab_w fnsta_in /end OUT_MEASUREMENT /begin LOC_MEASUREMENT nstatfak nwem_fak /end LOC_MEASUREMENT /end FUNCTION
/begin FUNCTION MDRED "13.20     Berechnung Reduzierstufe aus Momentenanforderung" /begin DEF_CHARACTERISTIC CREDSTU DMIZWMN MDHYEZ REDHYOC REDHYUC REDMXSA REDZEM /end DEF_CHARACTERISTIC
 /begin IN_MEASUREMENT B_asr B_dknolu B_dkpu B_nmax B_sab B_savmd etazwmn mibas_w miopt_w misol_w redist tmot /end IN_MEASUREMENT
 /begin OUT_MEASUREMENT B_sa mizwmn_w redsol /end OUT_MEASUREMENT
 /begin LOC_MEASUREMENT B_mdee B_mdredhyein redhyst redneu redze redzst_w /end LOC_MEASUREMENT
/end FUNCTION
/begin FUNCTION MDTRIP "4.10      Berechnung der Momentenreserve im Kurztrip" /begin IN_MEASUREMENT dmrdkt_w dmrdsls_w dmrlash_w dmrlsh_w dmrlsv_w /end IN_MEASUREMENT /begin OUT_MEASUREMENT dmrkt_w /end OUT_MEASUREMENT /end FUNCTION
/begin COMPU_METHOD bfzg_q0p025 "" RAT_FUNC "%6.4" "m/s^2" COEFFS 0 40 0 0 0 1 /end COMPU_METHOD
/begin COMPU_METHOD B_TRUE "boolsche Zust‰nde, positive Logik" TAB_VERB "%6.3" "" COMPU_TAB_REF B_TRUE /end COMPU_METHOD
/begin COMPU_VTAB B_TRUE "boolsche Zust‰nde, positive Logik" TAB_VERB 2 0 "----" 1 "TRUE" /end COMPU_VTAB
/begin COMPU_METHOD DEZ "1 : 1 Umrechnug (dez/hex)" RAT_FUNC "%6.2" "" COEFFS 0 1 0 0 0 1 /end COMPU_METHOD
/begin COMPU_METHOD dez "1 : 1 Umrechnug (dez/hex)" RAT_FUNC "%6.2" "" COEFFS 0 1 0 0 0 1 /end COMPU_METHOD
/begin COMPU_METHOD fak_q0p0439 "" RAT_FUNC "%6.4" "%/(Grad KWQ)" COEFFS 0 32 0 0 0 1.405 /end COMPU_METHOD
/begin COMPU_METHOD fak_q0p0625 "" RAT_FUNC "%6.4" "-" COEFFS 0 16 0 0 0 1 /end COMPU_METHOD
/begin COMPU_METHOD fak_sb_b0p03125 "" RAT_FUNC "%6.5" "-" COEFFS 0 256 0 0 0 0.0625 /end COMPU_METHOD
/begin COMPU_METHOD fak_sw_b1 "" RAT_FUNC "%7.6" "-" COEFFS 0 65536 0 0 0 2 /end COMPU_METHOD
/begin COMPU_METHOD fak_sw_b2 "" RAT_FUNC "%7.6" "-" COEFFS 0 65536 0 0 0 4 /end COMPU_METHOD
/begin COMPU_METHOD fak_sw_b32 "" RAT_FUNC "%6.5" "-" COEFFS 0 65536 0 0 0 64 /end COMPU_METHOD
/begin COMPU_METHOD fak_sw_b4 "" RAT_FUNC "%6.5" "-" COEFFS 0 65536 0 0 0 8 /end COMPU_METHOD
/begin COMPU_METHOD fak_sw_b5 "" RAT_FUNC "%6.5" "-" COEFFS 0 65536 0 0 0 10 /end COMPU_METHOD
/begin COMPU_METHOD fak_sw_b64 "" RAT_FUNC "%6.4" "-" COEFFS 0 65536 0 0 0 128 /end COMPU_METHOD
/begin COMPU_METHOD fak_sw_b8 "" RAT_FUNC "%6.5" "-" COEFFS 0 65536 0 0 0 16 /end COMPU_METHOD
/begin COMPU_METHOD fak_ub_b0p25 "" RAT_FUNC "%10.7" "-" COEFFS 0 256 0 0 0 0.25 /end COMPU_METHOD
/begin COMPU_METHOD fak_ub_b1 "" RAT_FUNC "%6.4" "-" COEFFS 0 256 0 0 0 1 /end COMPU_METHOD
/begin COMPU_METHOD fak_ub_b2 "" RAT_FUNC "%6.4" "-" COEFFS 0 256 0 0 0 2 /end COMPU_METHOD
/begin COMPU_METHOD fak_ub_b4 "" RAT_FUNC "%6.4" "-" COEFFS 0 256 0 0 0 4 /end COMPU_METHOD
/begin COMPU_METHOD fak_ub_b8 "" RAT_FUNC "%6.4" "-" COEFFS 0 256 0 0 0 8 /end COMPU_METHOD
/begin COMPU_METHOD fak_ub_q0p00392 "" RAT_FUNC "%6.4" "-" COEFFS 0 255 0 0 0 1 /end COMPU_METHOD
/begin COMPU_METHOD fak_uw_b1 "" RAT_FUNC "%7.6" "-" COEFFS 0 65536 0 0 0 1 /end COMPU_METHOD
/begin COMPU_METHOD fak_uw_b128 "" RAT_FUNC "%6.4" "-" COEFFS 0 65536 0 0 0 128 /end COMPU_METHOD
/begin COMPU_METHOD fak_uw_b16 "" RAT_FUNC "%6.5" "-" COEFFS 0 65536 0 0 0 16 /end COMPU_METHOD
/begin COMPU_METHOD fak_uw_b2 "" RAT_FUNC "%7.6" "-" COEFFS 0 65536 0 0 0 2 /end COMPU_METHOD
/begin COMPU_METHOD fak_uw_b4 "" RAT_FUNC "%7.6" "-" COEFFS 0 65536 0 0 0 4 /end COMPU_METHOD
/begin COMPU_METHOD fak_uw_b5 "" RAT_FUNC "%7.6" "-" COEFFS 0 65536 0 0 0 5 /end COMPU_METHOD
/begin COMPU_METHOD fak_uw_b64 "" RAT_FUNC "%6.5" "-" COEFFS 0 65536 0 0 0 64 /end COMPU_METHOD
/begin COMPU_METHOD fak_uw_b8 "" RAT_FUNC "%6.5" "-" COEFFS 0 65536 0 0 0 8 /end COMPU_METHOD
/begin COMPU_METHOD kwq_ub_q0p35576 "" RAT_FUNC "%6.3" "Grad KWQ" COEFFS 0 25500 0 0 0 9072 /end COMPU_METHOD
/begin COMPU_METHOD m_q8p0_ppm "" RAT_FUNC "%6.2" "ppm" COEFFS 0 1 0 0 0 8 /end COMPU_METHOD
/begin COMPU_METHOD m_ub_b1020 "" RAT_FUNC "%6.2" "kg/h" COEFFS 0 1 0 0 0 4 /end COMPU_METHOD
/begin COMPU_METHOD m_uw_b291p25 "" RAT_FUNC "%6.4" "g" COEFFS 0 225 0 0 0 1 /end COMPU_METHOD
/begin COMPU_METHOD m_uw_b4660 "" RAT_FUNC "%6.4" "g" COEFFS 0 3600 0 0 0 256 /end COMPU_METHOD
/begin COMPU_METHOD m_uw_b6553p5 "" RAT_FUNC "%6.3" "kg/h" COEFFS 0 1 0 0 0 0.1 /end COMPU_METHOD
/begin COMPU_METHOD m_uw_b7281 "" RAT_FUNC "%6.3" "g" COEFFS 0 9 0 0 0 1 /end COMPU_METHOD
/begin COMPU_METHOD nmotg_sw_q0p39 "" RAT_FUNC "%6.3" "1/min/s" COEFFS 0 1 0 0 0 0.39063 /end COMPU_METHOD
/begin COMPU_METHOD nmot_sb_q40 "" RAT_FUNC "%6.1" "1/min" COEFFS 0 1 0 0 0 40 /end COMPU_METHOD
/begin COMPU_METHOD nmot_ub_q40 "" RAT_FUNC "%6.1" "1/min" COEFFS 0 1 0 0 0 40 /end COMPU_METHOD
/begin COMPU_METHOD nmot_uw_q0p25 "" RAT_FUNC "%6.3" "1/min" COEFFS 0 1 0 0 0 0.25 /end COMPU_METHOD
/begin COMPU_METHOD relDK_ub_b100 "" RAT_FUNC "%6.3" "%DK" COEFFS 0 255 0 0 0 100 /end COMPU_METHOD
/begin COMPU_METHOD relNWU_q0p0234 "" RAT_FUNC "%6.4" "%/NWU" COEFFS 0 32 0 0 0 0.75 /end COMPU_METHOD
/begin COMPU_METHOD relPED_uw_b100 "" RAT_FUNC "%6.4" "%PED" COEFFS 0 65535 0 0 0 100 /end COMPU_METHOD
/begin COMPU_METHOD rel_sb_q0p02 "" RAT_FUNC "%6.4" "%" COEFFS 0 50 0 0 0 1 /end COMPU_METHOD
/begin COMPU_METHOD rel_sw_b100 "" RAT_FUNC "%6.4" "%" COEFFS 0 32768 0 0 0 100 /end COMPU_METHOD
/begin COMPU_METHOD rel_sw_b1536 "" RAT_FUNC "%6.4" "%" COEFFS 0 65536 0 0 0 3072 /end COMPU_METHOD
/begin COMPU_METHOD rel_sw_b192 "" RAT_FUNC "%6.4" "%" COEFFS 0 65536 0 0 0 384 /end COMPU_METHOD
/begin COMPU_METHOD rel_sw_q0p0234 "" RAT_FUNC "%6.4" "%/seg" COEFFS 0 32 0 0 0 0.75 /end COMPU_METHOD
/begin COMPU_METHOD rel_ub_b127p5 "" RAT_FUNC "%6.3" "%" COEFFS 0 2 0 0 0 1 /end COMPU_METHOD
/begin COMPU_METHOD rel_ub_b2p0 "" RAT_FUNC "%6.4" "%" COEFFS 0 256 0 0 0 2 /end COMPU_METHOD
/begin COMPU_METHOD rel_ub_b99p6 "" RAT_FUNC "%6.3" "%" COEFFS 0 256 0 0 0 100 /end COMPU_METHOD
/begin COMPU_METHOD rel_ub_q0p75 "" RAT_FUNC "%6.3" "%" COEFFS 0 1 0 0 0 0.75 /end COMPU_METHOD
/begin COMPU_METHOD rel_uw_b100 "" RAT_FUNC "%6.4" "%" COEFFS 0 65536 0 0 0 100 /end COMPU_METHOD
/begin COMPU_METHOD rel_uw_b200 "" RAT_FUNC "%6.4" "%" COEFFS 0 65536 0 0 0 200 /end COMPU_METHOD
/begin COMPU_METHOD rel_uw_q0p001 "" RAT_FUNC "%6.5" "%" COEFFS 0 1000 0 0 0 1 /end COMPU_METHOD
/begin COMPU_METHOD rel_uw_q0p0234 "" RAT_FUNC "%6.4" "%" COEFFS 0 32 0 0 0 0.75 /end COMPU_METHOD
/begin COMPU_METHOD spg_ub_q0p0052_o0p2 "" RAT_FUNC "%6.3" "V" COEFFS 0 255 51 0 0 1.33 /end COMPU_METHOD
/begin COMPU_METHOD spg_uw_q0p00488_o1 "" RAT_FUNC "%6.3" "V" COEFFS 0 1024 1024 0 0 5 /end COMPU_METHOD
/begin COMPU_METHOD sprzi_q0p8 "" RAT_FUNC "%6.2" "Grad KW" COEFFS 0 1 0 0 0 0.8 /end COMPU_METHOD
/begin COMPU_METHOD t100msxs_ub_b25p5 "" RAT_FUNC "%6.3" "s" COEFFS 0 1 0 0 0 0.1 /end COMPU_METHOD
/begin COMPU_METHOD t100msxs_uw_b6553p5 "" RAT_FUNC "%6.3" "s" COEFFS 0 1 0 0 0 0.1 /end COMPU_METHOD
/begin COMPU_METHOD t10msxs_ub_b2p55 "" RAT_FUNC "%6.4" "s" COEFFS 0 1 0 0 0 0.01 /end COMPU_METHOD
/begin COMPU_METHOD t10msxs_uw_b655p35 "" RAT_FUNC "%6.4" "s" COEFFS 0 1 0 0 0 0.01 /end COMPU_METHOD
/begin COMPU_METHOD t1sxs_uw_b65535 "" RAT_FUNC "%6.2" "s" COEFFS 0 1 0 0 0 1 /end COMPU_METHOD
/begin COMPU_METHOD t20msxs_ub_b5p1 "" RAT_FUNC "%6.4" "s" COEFFS 0 1 0 0 0 0.02 /end COMPU_METHOD
/begin COMPU_METHOD temp_q0p0234_o273 "" RAT_FUNC "%6.1" "Grad C" COEFFS 0 1 273.15 0 0 0.0234375 /end COMPU_METHOD
/begin COMPU_METHOD temp_sb_q0p75 "" RAT_FUNC "%6.3" "Grad C" COEFFS 0 1 0 0 0 0.75 /end COMPU_METHOD
/begin COMPU_METHOD temp_ub_b191p25 "" RAT_FUNC "%6.3" "Grad C" COEFFS 0 1 0 0 0 0.75 /end COMPU_METHOD
/begin COMPU_METHOD temp_ub_q0p75_o48 "" RAT_FUNC "%6.2" "Grad C" COEFFS 0 1 48 0 0 0.75 /end COMPU_METHOD
/begin COMPU_METHOD temp_uw_q0p0195_o50 "" RAT_FUNC "%6.2" "Grad C" COEFFS 0 256 12800 0 0 5 /end COMPU_METHOD
/begin COMPU_METHOD temp_uw_q0p75_o48 "" RAT_FUNC "%6.2" "Grad C" COEFFS 0 1 48 0 0 0.75 /end COMPU_METHOD
/begin COMPU_METHOD tz10msxs_uw_b327p68 "" RAT_FUNC "%6.2" "s" COEFFS 0 0 327.68 0 1 0 /end COMPU_METHOD
/begin COMPU_METHOD t_q0p05 "" RAT_FUNC "%6.4" "s" COEFFS 0 100 0 0 0 5 /end COMPU_METHOD
/begin COMPU_METHOD vfzg_ub_q1p25 "" RAT_FUNC "%6.2" "km/h" COEFFS 0 1 0 0 0 1.25 /end COMPU_METHOD
/begin COMPU_METHOD vfzg_uw_b512 "" RAT_FUNC "%6.4" "km/h" COEFFS 0 65536 0 0 0 512 /end COMPU_METHOD
/begin COMPU_METHOD zk10msxs_ub_b2p55 "" RAT_FUNC "%6.4" "s" COEFFS 0 0 255 0 100 0 /end COMPU_METHOD
/begin COMPU_METHOD zk10msxs_ub_b8 "" RAT_FUNC "%6.4" "1/s" COEFFS 0 256 0 0 0 8 /end COMPU_METHOD
/begin COMPU_METHOD zk10msxs_uw_b655 "" RAT_FUNC "%6.2" "s" COEFFS 0 0 65536 0 100 0 /end COMPU_METHOD
/begin COMPU_METHOD zk200msxs_ub_b51p2 "" RAT_FUNC "%6.3" "s" COEFFS 0 0 51.2 0 1 0 /end COMPU_METHOD
/begin COMPU_METHOD zk200msxs_uw_b5 "" RAT_FUNC "%7.6" "1/s" COEFFS 0 65536 0 0 0 5 /end COMPU_METHOD
/begin COMPU_METHOD zk200msxs_uw_b960 "" RAT_FUNC "%6.4" "%/s" COEFFS 0 65536 0 0 0 960 /end COMPU_METHOD
/begin COMPU_METHOD zk20msxs_uw_b1310 "" RAT_FUNC "%6.1" "s" COEFFS 0 0 1310 0 1 0 /end COMPU_METHOD
/begin COMPU_METHOD zk50msxs_uw_b3276p8 "" RAT_FUNC "%6.1" "s" COEFFS 0 0 65536 0 20 0 /end COMPU_METHOD
/begin COMPU_METHOD zw_sb_q0p75 "" RAT_FUNC "%6.3" "Grad KW" COEFFS 0 255 0 0 0 191.25 /end COMPU_METHOD
/begin RECORD_LAYOUT FklWUb FNC_VALUES 1 UBYTE COLUMN_DIR DIRECT /end RECORD_LAYOUT
/begin RECORD_LAYOUT GkfWSb FNC_VALUES 1 SBYTE COLUMN_DIR DIRECT /end RECORD_LAYOUT
/begin RECORD_LAYOUT GkfWSw FNC_VALUES 1 SWORD COLUMN_DIR DIRECT /end RECORD_LAYOUT
/begin RECORD_LAYOUT GkfWU8 FNC_VALUES 1 UBYTE COLUMN_DIR DIRECT /end RECORD_LAYOUT
/begin RECORD_LAYOUT GkfWUb FNC_VALUES 1 UBYTE COLUMN_DIR DIRECT /end RECORD_LAYOUT
/begin RECORD_LAYOUT GkfWUw FNC_VALUES 1 UWORD COLUMN_DIR DIRECT /end RECORD_LAYOUT
/begin RECORD_LAYOUT GklWS16 FNC_VALUES 1 SWORD COLUMN_DIR DIRECT /end RECORD_LAYOUT
/begin RECORD_LAYOUT GklWSw FNC_VALUES 1 SWORD COLUMN_DIR DIRECT /end RECORD_LAYOUT
/begin RECORD_LAYOUT GklWU16 FNC_VALUES 1 UWORD COLUMN_DIR DIRECT /end RECORD_LAYOUT
/begin RECORD_LAYOUT GklWU8 FNC_VALUES 1 UBYTE COLUMN_DIR DIRECT /end RECORD_LAYOUT
/begin RECORD_LAYOUT GklWUb FNC_VALUES 1 UBYTE COLUMN_DIR DIRECT /end RECORD_LAYOUT
/begin RECORD_LAYOUT GklWUw FNC_VALUES 1 UWORD COLUMN_DIR DIRECT /end RECORD_LAYOUT
/begin RECORD_LAYOUT KfAxU8AyU8SstxU16SstyU16WU16 NO_AXIS_PTS_X 1 UWORD NO_AXIS_PTS_Y 2 UWORD AXIS_PTS_X 3 UWORD INDEX_INCR DIRECT AXIS_PTS_Y 4 UWORD INDEX_INCR DIRECT FNC_VALUES 5 UWORD COLUMN_DIR DIRECT /end RECORD_LAYOUT
/begin RECORD_LAYOUT KfAxU8AyU8SstxU8SstyU8WS8 NO_AXIS_PTS_X 1 UBYTE NO_AXIS_PTS_Y 2 UBYTE AXIS_PTS_X 3 UBYTE INDEX_INCR DIRECT AXIS_PTS_Y 4 UBYTE INDEX_INCR DIRECT FNC_VALUES 5 SBYTE COLUMN_DIR DIRECT /end RECORD_LAYOUT
/begin RECORD_LAYOUT KfAxU8AyU8SstxU8SstyU8WU8 NO_AXIS_PTS_X 1 UBYTE NO_AXIS_PTS_Y 2 UBYTE AXIS_PTS_X 3 UBYTE INDEX_INCR DIRECT AXIS_PTS_Y 4 UBYTE INDEX_INCR DIRECT FNC_VALUES 5 UBYTE COLUMN_DIR DIRECT /end RECORD_LAYOUT
/begin RECORD_LAYOUT KfAxUbAyUbSstxUbSstyUbWSb NO_AXIS_PTS_X 1 UBYTE NO_AXIS_PTS_Y 2 UBYTE AXIS_PTS_X 3 UBYTE INDEX_INCR DIRECT AXIS_PTS_Y 4 UBYTE INDEX_INCR DIRECT FNC_VALUES 5 SBYTE COLUMN_DIR DIRECT /end RECORD_LAYOUT
/begin RECORD_LAYOUT KfAxUbAyUbSstxUbSstyUbWUb NO_AXIS_PTS_X 1 UBYTE NO_AXIS_PTS_Y 2 UBYTE AXIS_PTS_X 3 UBYTE INDEX_INCR DIRECT AXIS_PTS_Y 4 UBYTE INDEX_INCR DIRECT FNC_VALUES 5 UBYTE COLUMN_DIR DIRECT /end RECORD_LAYOUT
/begin RECORD_LAYOUT KfAxUbAyUbSstxUbSstyUwWUb NO_AXIS_PTS_X 1 UBYTE NO_AXIS_PTS_Y 2 UBYTE AXIS_PTS_X 3 UBYTE INDEX_INCR DIRECT AXIS_PTS_Y 4 UWORD INDEX_INCR DIRECT FNC_VALUES 5 UBYTE COLUMN_DIR DIRECT /end RECORD_LAYOUT
/begin RECORD_LAYOUT KfAxUbAyUbSstxUbSstyUwWUw NO_AXIS_PTS_X 1 UBYTE NO_AXIS_PTS_Y 2 UBYTE AXIS_PTS_X 3 UBYTE INDEX_INCR DIRECT AXIS_PTS_Y 4 UWORD INDEX_INCR DIRECT FNC_VALUES 5 UWORD COLUMN_DIR DIRECT /end RECORD_LAYOUT
/begin RECORD_LAYOUT KfAxUbAyUbSstxUwSstyUwWUw NO_AXIS_PTS_X 1 UWORD NO_AXIS_PTS_Y 2 UWORD AXIS_PTS_X 3 UWORD INDEX_INCR DIRECT AXIS_PTS_Y 4 UWORD INDEX_INCR DIRECT FNC_VALUES 5 UWORD COLUMN_DIR DIRECT /end RECORD_LAYOUT
/begin RECORD_LAYOUT KfAxUwAyUwSstxUwSstyUwWUw NO_AXIS_PTS_X 1 UWORD NO_AXIS_PTS_Y 2 UWORD AXIS_PTS_X 3 UWORD INDEX_INCR DIRECT AXIS_PTS_Y 4 UWORD INDEX_INCR DIRECT FNC_VALUES 5 UWORD COLUMN_DIR DIRECT /end RECORD_LAYOUT
/begin RECORD_LAYOUT KlAUbSstUbWSb NO_AXIS_PTS_X 1 UBYTE AXIS_PTS_X 2 UBYTE INDEX_INCR DIRECT FNC_VALUES 3 SBYTE COLUMN_DIR DIRECT /end RECORD_LAYOUT
/begin RECORD_LAYOUT KlAUbSstUbWUb NO_AXIS_PTS_X 1 UBYTE AXIS_PTS_X 2 UBYTE INDEX_INCR DIRECT FNC_VALUES 3 UBYTE COLUMN_DIR DIRECT /end RECORD_LAYOUT
/begin RECORD_LAYOUT KlAUbSstUbWUw NO_AXIS_PTS_X 1 UBYTE AXIS_PTS_X 2 UBYTE INDEX_INCR DIRECT FNC_VALUES 3 UWORD COLUMN_DIR DIRECT /end RECORD_LAYOUT
/begin RECORD_LAYOUT KlAUwSstUwWUb NO_AXIS_PTS_X 1 UWORD AXIS_PTS_X 2 UWORD INDEX_INCR DIRECT FNC_VALUES 3 UBYTE COLUMN_DIR DIRECT /end RECORD_LAYOUT
/begin RECORD_LAYOUT KlAUwSstUwWUw NO_AXIS_PTS_X 1 UWORD AXIS_PTS_X 2 UWORD INDEX_INCR DIRECT FNC_VALUES 3 UWORD COLUMN_DIR DIRECT /end RECORD_LAYOUT
/begin RECORD_LAYOUT KlAxU8SstxU16WU16 NO_AXIS_PTS_X 1 UWORD AXIS_PTS_X 2 UWORD INDEX_INCR DIRECT FNC_VALUES 3 UWORD COLUMN_DIR DIRECT /end RECORD_LAYOUT
/begin RECORD_LAYOUT KlAxU8SstxU8WU16 NO_AXIS_PTS_X 1 UBYTE AXIS_PTS_X 2 UBYTE INDEX_INCR DIRECT FNC_VALUES 3 UWORD COLUMN_DIR DIRECT /end RECORD_LAYOUT
/begin RECORD_LAYOUT KlAxU8SstxU8WU8 NO_AXIS_PTS_X 1 UBYTE AXIS_PTS_X 2 UBYTE INDEX_INCR DIRECT FNC_VALUES 3 UBYTE COLUMN_DIR DIRECT /end RECORD_LAYOUT
/begin RECORD_LAYOUT KwSb FNC_VALUES 1 SBYTE COLUMN_DIR DIRECT /end RECORD_LAYOUT
/begin RECORD_LAYOUT KwSw FNC_VALUES 1 SWORD COLUMN_DIR DIRECT /end RECORD_LAYOUT
/begin RECORD_LAYOUT KwUb FNC_VALUES 1 UBYTE COLUMN_DIR DIRECT /end RECORD_LAYOUT
/begin RECORD_LAYOUT KwUw FNC_VALUES 1 UWORD COLUMN_DIR DIRECT /end RECORD_LAYOUT
/begin RECORD_LAYOUT KwWS16 FNC_VALUES 1 SWORD COLUMN_DIR DIRECT /end RECORD_LAYOUT
/begin RECORD_LAYOUT KwWU16 FNC_VALUES 1 UWORD COLUMN_DIR DIRECT /end RECORD_LAYOUT
/begin RECORD_LAYOUT KwWU8 FNC_VALUES 1 UBYTE COLUMN_DIR DIRECT /end RECORD_LAYOUT
/begin RECORD_LAYOUT SstASwSstSw NO_AXIS_PTS_X 1 SWORD AXIS_PTS_X 2 SWORD INDEX_INCR DIRECT /end RECORD_LAYOUT
/begin RECORD_LAYOUT SstAU8SstS16 NO_AXIS_PTS_X 1 SWORD AXIS_PTS_X 2 SWORD INDEX_INCR DIRECT /end RECORD_LAYOUT
/begin RECORD_LAYOUT SstAUbSstUb NO_AXIS_PTS_X 1 UBYTE AXIS_PTS_X 2 UBYTE INDEX_INCR DIRECT /end RECORD_LAYOUT
/begin RECORD_LAYOUT SstAUwSstUw NO_AXIS_PTS_X 1 UWORD AXIS_PTS_X 2 UWORD INDEX_INCR DIRECT /end RECORD_LAYOUT
/end MODULE
/end PROJECT
