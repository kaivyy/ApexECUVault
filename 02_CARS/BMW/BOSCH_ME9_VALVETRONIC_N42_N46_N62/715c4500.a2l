ASAP2_VERSION 1 3
/begin PROJECT _715C4500 "basisme9"
/begin HEADER "" VERSION "_715C4500" PROJECT_NO _715C4500 /end HEADER
/begin MODULE DIM ""
/begin MOD_COMMON "" BYTE_ORDER MSB_FIRST ALIGNMENT_BYTE 1 ALIGNMENT_WORD 2 ALIGNMENT_LONG 2 ALIGNMENT_FLOAT32_IEEE 4 /end MOD_COMMON
/begin CHARACTERISTIC CDCAGRE "Codewort CARB:	‹berwachung AGR-Endstufe" VAL_BLK 0xFD0AA4 KwbWU16 65535.00 dez 0.00 65535.00 FORMAT "%8.2" NUMBER 4 /end CHARACTERISTIC
/begin CHARACTERISTIC CDCAGRF "Codewort CARB: ‹berwachung AGR-FLOW" VAL_BLK 0xFD0AAC KwbWU16 65535.00 dez 0.00 65535.00 FORMAT "%8.2" NUMBER 4 /end CHARACTERISTIC
/begin CHARACTERISTIC CDCANWS "Codewort Carb: Nockenwellensteuerung Auslass Nockenwelle" VAL_BLK 0xFD0AB4 KwbWU16 65535.00 DEZ 0.00 65535.00 FORMAT "%8.2" NUMBER 4 /end CHARACTERISTIC
/begin CHARACTERISTIC CDCANWSE "Codewort CARB: Auslaﬂnockenwelle- Endstufe" VAL_BLK 0xFD0ABC KwbWU16 65535.00 dez 0.00 65535.00 FORMAT "%8.2" NUMBER 4 /end CHARACTERISTIC
/begin CHARACTERISTIC CDCBKVP "Codewort CARB: Bremskraftverst‰rker Pumpe" VAL_BLK 0xFD0ACC KwbWU16 65535.00 dez 0.00 65535.00 FORMAT "%8.2" NUMBER 4 /end CHARACTERISTIC
/begin CHARACTERISTIC CDCDDSS "Codewort CARB: Differenzdrucksensor Saugrohr" VAL_BLK 0xFD0B24 KwbWU16 65535.00 dez 0.00 65535.00 FORMAT "%8.2" NUMBER 4 /end CHARACTERISTIC
/begin CHARACTERISTIC CDCDMTK "Codewort CARB: Tankentl¸ftungssystem Feinstleck" VAL_BLK 0xFD0B5C KwbWU16 65535.00 dez 0.00 65535.00 FORMAT "%8.2" NUMBER 4 /end CHARACTERISTIC
/begin CHARACTERISTIC CDCDMTL "Codewort CARB: Tankentl¸ftungssystem Modulfehler (Hardware)" VAL_BLK 0xFD0B64 KwbWU16 65535.00 dez 0.00 65535.00 FORMAT "%8.2" NUMBER 4 /end CHARACTERISTIC
/begin CHARACTERISTIC CDCDSS "Codewort CARB: Saugrohr-Drucksensor" VAL_BLK 0xFD0B6C KwbWU16 65535.00 dez 0.00 65535.00 FORMAT "%8.2" NUMBER 4 /end CHARACTERISTIC
/begin CHARACTERISTIC CDCENWS "Codewort Carb: Nockenwellensteuerung Einlass Nockenwelle" VAL_BLK 0xFD0C2C KwbWU16 65535.00 DEZ 0.00 65535.00 FORMAT "%8.2" NUMBER 4 /end CHARACTERISTIC
/begin CHARACTERISTIC CDCENWSE "Codewort CARB: Einlaﬂnockenwelle- Endstufe" VAL_BLK 0xFD0C34 KwbWU16 65535.00 dez 0.00 65535.00 FORMAT "%8.2" NUMBER 4 /end CHARACTERISTIC
/begin CHARACTERISTIC CDCEV5 "Codewort CARB: EV von Zyl. 5" VAL_BLK 0xFD0C64 KwbWU16 65535.00 dez 0.00 65535.00 FORMAT "%8.2" NUMBER 4 /end CHARACTERISTIC
/begin CHARACTERISTIC CDCEV6 "Codewort CARB: EV von Zyl. 6" VAL_BLK 0xFD0C6C KwbWU16 65535.00 dez 0.00 65535.00 FORMAT "%8.2" NUMBER 4 /end CHARACTERISTIC
/begin CHARACTERISTIC CDCEV7 "Codewort CARB: EV von Zyl. 7" VAL_BLK 0xFD0C74 KwbWU16 65535.00 dez 0.00 65535.00 FORMAT "%8.2" NUMBER 4 /end CHARACTERISTIC
/begin CHARACTERISTIC CDCEV8 "Codewort CARB: EV von Zyl. 8" VAL_BLK 0xFD0C7C KwbWU16 65535.00 dez 0.00 65535.00 FORMAT "%8.2" NUMBER 4 /end CHARACTERISTIC
/begin CHARACTERISTIC CDCFRAO "Codewort CARB: LR-Adaption obere multiplikativ" VAL_BLK 0xFD0CA4 KwbUw 65535.00 dez 0.00 65535.00 FORMAT "%8.2" NUMBER 4 /end CHARACTERISTIC
/begin CHARACTERISTIC CDCFRAU "Codewort CARB: LR-Adaption untere multiplikativ" VAL_BLK 0xFD0CAC KwbUw 65535.00 dez 0.00 65535.00 FORMAT "%8.2" NUMBER 4 /end CHARACTERISTIC
/begin CHARACTERISTIC CDCFRST "Codewort CARB: LR-Abweichung" VAL_BLK 0xFD0CB4 KwbUw 65535.00 dez 0.00 65535.00 FORMAT "%8.2" NUMBER 4 /end CHARACTERISTIC
/begin CHARACTERISTIC CDCFST "Codewort CARB: Tankf¸llstand" VAL_BLK 0xFD0CBC KwbWU16 65535.00 dez 0.00 65535.00 FORMAT "%8.2" NUMBER 4 /end CHARACTERISTIC
/begin CHARACTERISTIC CDCHSVSA "Codewort CARB:	Lambdasonden-Heizung vor Katalysator" VAL_BLK 0xFD0CE4 KwbWU16 65535.00 dez 0.00 65535.00 FORMAT "%8.2" NUMBER 4 /end CHARACTERISTIC
/begin CHARACTERISTIC CDCKATSP "Codewort CARB:	Katalysator-Konvertierung" VAL_BLK 0xFD0CF4 KwbWU16 65535.00 dez 0.00 65535.00 FORMAT "%8.2" NUMBER 4 /end CHARACTERISTIC
/begin CHARACTERISTIC CDCKRTP "Codewort CARB: Klopfregelung Testimpulse" VAL_BLK 0xFD0D24 KwbUw 65535.00 dez 0.00 65535.00 FORMAT "%8.2" NUMBER 4 /end CHARACTERISTIC
/begin CHARACTERISTIC CDCKS1 "Codewort CARB:	Klopfsensor 1" VAL_BLK 0xFD0D2C KwbUw 65535.00 dez 0.00 65535.00 FORMAT "%8.2" NUMBER 4 /end CHARACTERISTIC
/begin CHARACTERISTIC CDCKS2 "Codewort CARB:	Klopfsensor 2" VAL_BLK 0xFD0D34 KwbUw 65535.00 dez 0.00 65535.00 FORMAT "%8.2" NUMBER 4 /end CHARACTERISTIC
/begin CHARACTERISTIC CDCKS3 "Codewort CARB:	Klopfsensor 3" VAL_BLK 0xFD0D3C KwbUw 65535.00 dez 0.00 65535.00 FORMAT "%8.2" NUMBER 4 /end CHARACTERISTIC
/begin CHARACTERISTIC CDCKS4 "Codewort CARB:	Klopfsensor 4" VAL_BLK 0xFD0D44 KwbUw 65535.00 dez 0.00 65535.00 FORMAT "%8.2" NUMBER 4 /end CHARACTERISTIC
/begin CHARACTERISTIC CDCKUPPL "Codewort CARB: Kupplungspedalwertgeber" VAL_BLK 0xFD0D4C KwbUw 65535.00 dez 0.00 65535.00 FORMAT "%8.2" NUMBER 4 /end CHARACTERISTIC
/begin CHARACTERISTIC CDCLASH "Codewort CARB:	Lambda-Sondenalterung hinter Kat." VAL_BLK 0xFD0D54 KwbUw 65535.00 dez 0.00 65535.00 FORMAT "%8.2" NUMBER 4 /end CHARACTERISTIC
/begin CHARACTERISTIC CDCLATP "Codewort CARB:	Lambda-Sondenalterung TP" VAL_BLK 0xFD0D5C KwbWU16 65535.00 dez 0.00 65535.00 FORMAT "%8.2" NUMBER 4 /end CHARACTERISTIC
/begin CHARACTERISTIC CDCLATV "Codewort CARB: Lambda-Sondenalterung TV" VAL_BLK 0xFD0D64 KwbWU16 65535.00 dez 0.00 65535.00 FORMAT "%8.2" NUMBER 4 /end CHARACTERISTIC
/begin CHARACTERISTIC CDCLATV2 "Codewort CARB:	Lambda-Sondenalterung TV (Bank 2)" VAL_BLK 0xFD0D6C KwbWU16 65535.00 dez 0.00 65535.00 FORMAT "%8.2" NUMBER 4 /end CHARACTERISTIC
/begin CHARACTERISTIC CDCLDP "Codewort CARB: Leckdiagnosepumpe" VAL_BLK 0xFD0D7C KwbWU16 65535.00 dez 0.00 65535.00 FORMAT "%8.2" NUMBER 4 /end CHARACTERISTIC
/begin CHARACTERISTIC CDCLLR "Codewort CARB: Leerlaufregelung am Anschlag" VAL_BLK 0xFD0D8C KwbUw 65535.00 dez 0.00 65535.00 FORMAT "%8.2" NUMBER 4 /end CHARACTERISTIC
/begin CHARACTERISTIC CDCLSH "Codewort CARB:	Lambda-Sonde hinter Kat" VAL_BLK 0xFD0D9C KwbUw 65535.00 dez 0.00 65535.00 FORMAT "%8.2" NUMBER 4 /end CHARACTERISTIC
/begin CHARACTERISTIC CDCLSV "Codewort CARB: Lambda-Sonde vor Kat" VAL_BLK 0xFD0DA4 KwbWU16 65535.00 dez 0.00 65535.00 FORMAT "%8.2" NUMBER 4 /end CHARACTERISTIC
/begin CHARACTERISTIC CDCLSV2 "Codewort CARB: Lambda-Sonde 2 vor Kat" VAL_BLK 0xFD0DAC KwbWU16 65535.00 dez 0.00 65535.00 FORMAT "%8.2" NUMBER 4 /end CHARACTERISTIC
/begin CHARACTERISTIC CDCMD "Codewort CARB: Aussetzer, Summenfehler (multiple)" VAL_BLK 0xFD0DC4 KwbWU16 65535.00 dez 0.00 65535.00 FORMAT "%8.2" NUMBER 4 /end CHARACTERISTIC
/begin CHARACTERISTIC CDCMD00 "Codewort CARB: Aussetzer Zyl. 0" VAL_BLK 0xFD0DCC KwbWU16 65535.00 dez 0.00 65535.00 FORMAT "%8.2" NUMBER 4 /end CHARACTERISTIC
/begin CHARACTERISTIC CDCMD01 "Codewort CARB: Aussetzer Zyl. 1" VAL_BLK 0xFD0DD4 KwbWU16 65535.00 dez 0.00 65535.00 FORMAT "%8.2" NUMBER 4 /end CHARACTERISTIC
/begin CHARACTERISTIC CDCMD02 "Codewort CARB: Aussetzer Zylinder 2" VAL_BLK 0xFD0DDC KwbWU16 65535.00 dez 0.00 65535.00 FORMAT "%8.2" NUMBER 4 /end CHARACTERISTIC
/begin CHARACTERISTIC CDCMD03 "Codewort CARB: Aussetzer Zylinder 3" VAL_BLK 0xFD0DE4 KwbWU16 65535.00 dez 0.00 65535.00 FORMAT "%8.2" NUMBER 4 /end CHARACTERISTIC
/begin CHARACTERISTIC CDCMD04 "Codewort CARB: Aussetzer Zylinder 4" VAL_BLK 0xFD0DEC KwbWU16 65535.00 dez 0.00 65535.00 FORMAT "%8.2" NUMBER 4 /end CHARACTERISTIC
/begin CHARACTERISTIC CDCMD05 "Codewort CARB: Aussetzer Zylinder 5" VAL_BLK 0xFD0DF4 KwbWU16 65535.00 dez 0.00 65535.00 FORMAT "%8.2" NUMBER 4 /end CHARACTERISTIC
/begin CHARACTERISTIC CDCMD06 "Codewort CARB: Aussetzer Zylinder 6" VAL_BLK 0xFD0DFC KwbWU16 65535.00 dez 0.00 65535.00 FORMAT "%8.2" NUMBER 4 /end CHARACTERISTIC
/begin CHARACTERISTIC CDCMD07 "Codewort CARB: Aussetzer Zylinder 7" VAL_BLK 0xFD0E04 KwbWU16 65535.00 dez 0.00 65535.00 FORMAT "%8.2" NUMBER 4 /end CHARACTERISTIC
/begin CHARACTERISTIC CDCMD08 "Codewort CARB: Aussetzer Zylinder 8" VAL_BLK 0xFD0E0C KwbWU16 65535.00 dez 0.00 65535.00 FORMAT "%8.2" NUMBER 4 /end CHARACTERISTIC
/begin CHARACTERISTIC CDCMD09 "Codewort CARB: Aussetzer Zylinder 9" VAL_BLK 0xFD0E14 KwbWU16 65535.00 dez 0.00 65535.00 FORMAT "%8.2" NUMBER 4 /end CHARACTERISTIC
/begin CHARACTERISTIC CDCMD10 "Codewort CARB: Aussetzer Zylinder 10" VAL_BLK 0xFD0E1C KwbWU16 65535.00 dez 0.00 65535.00 FORMAT "%8.2" NUMBER 4 /end CHARACTERISTIC
/begin CHARACTERISTIC CDCMD11 "Codewort CARB: Aussetzer Zylinder 11" VAL_BLK 0xFD0E24 KwbWU16 65535.00 dez 0.00 65535.00 FORMAT "%8.2" NUMBER 4 /end CHARACTERISTIC
/begin CHARACTERISTIC CDCMDK "Codewort CARB: Aussetzer, Summenfehler - multiple, kundendienstrelevant" VAL_BLK 0xFD0E34 KwbWU16 65535.00 dez 0.00 65535.00 FORMAT "%8.2" NUMBER 4 /end CHARACTERISTIC
/begin CHARACTERISTIC CDCMLE "Codewort CARB: Endstufe Motor L¸fter" VAL_BLK 0xFD0E44 KwbWU16 65535.00 dez 0.00 65535.00 FORMAT "%8.2" NUMBER 4 /end CHARACTERISTIC
/begin CHARACTERISTIC CDCNVRBUP "Codewort CARB: NVRAM Backup" VAL_BLK 0xFD0E54 KwbUw 65535.00 dez 0.00 65535.00 FORMAT "%8.2" NUMBER 4 /end CHARACTERISTIC
/begin CHARACTERISTIC CDCNWKW "Codewort CARB: Zuordnung Nockenwelle zu Kurbelwelle" VAL_BLK 0xFD0E5C KwbWU16 65535.00 dez 0.00 65535.00 FORMAT "%8.2" NUMBER 4 /end CHARACTERISTIC
/begin CHARACTERISTIC CDCPDDSS "Codewort CARB: Druck Differenzdrucksensor Saugrohr" VAL_BLK 0xFD0E64 KwbWU16 65535.00 dez 0.00 65535.00 FORMAT "%8.2" NUMBER 4 /end CHARACTERISTIC
/begin CHARACTERISTIC CDCPH "Codewort CARB: Phasensensor" VAL_BLK 0xFD0E6C KwbWU16 65535.00 DEZ 0.00 65535.00 FORMAT "%8.2" NUMBER 4 /end CHARACTERISTIC
/begin CHARACTERISTIC CDCPH2 "Codewort CARB: Phasensensor Bank 2" VAL_BLK 0xFD0E74 KwbWU16 65535.00 DEZ 0.00 65535.00 FORMAT "%8.2" NUMBER 4 /end CHARACTERISTIC
/begin CHARACTERISTIC CDCPH3 "Codewort CARB: Phasensensor 3" VAL_BLK 0xFD0E7C KwbWU16 65535.00 DEZ 0.00 65535.00 FORMAT "%8.2" NUMBER 4 /end CHARACTERISTIC
/begin CHARACTERISTIC CDCPH4 "Codewort CARB: Phasensensor 4" VAL_BLK 0xFD0E84 KwbWU16 65535.00 DEZ 0.00 65535.00 FORMAT "%8.2" NUMBER 4 /end CHARACTERISTIC
/begin CHARACTERISTIC CDCPHM "Codewort CARB: Phasensensor MIL" VAL_BLK 0xFD0E8C KwbWU16 65535.00 DEZ 0.00 65535.00 FORMAT "%8.2" NUMBER 4 /end CHARACTERISTIC
/begin CHARACTERISTIC CDCRKAT "Codewort CARB: LR-Adaption QL-additiv" VAL_BLK 0xFD0E94 KwbUw 65535.00 dez 0.00 65535.00 FORMAT "%8.2" NUMBER 4 /end CHARACTERISTIC
/begin CHARACTERISTIC CDCRKAZ "Codewort CARB: LR-Adaption ti-additiv" VAL_BLK 0xFD0E9C KwbUw 65535.00 dez 0.00 65535.00 FORMAT "%8.2" NUMBER 4 /end CHARACTERISTIC
/begin CHARACTERISTIC CDCSLPE "Codewort CARB: Sekund‰rluftpumpe (Endstufe)" VAL_BLK 0xFD0EA4 KwbWU16 65535.00 dez 0.00 65535.00 FORMAT "%8.2" NUMBER 4 /end CHARACTERISTIC
/begin CHARACTERISTIC CDCSLS "Codewort CARB: Sekund‰rluft-System" VAL_BLK 0xFD0EAC KwbUw 65535.00 dez 0.00 65535.00 FORMAT "%8.2" NUMBER 4 /end CHARACTERISTIC
/begin CHARACTERISTIC CDCSLV "Codewort CARB: Sekund‰rluftventil" VAL_BLK 0xFD0EB4 KwbUw 65535.00 dez 0.00 65535.00 FORMAT "%8.2" NUMBER 4 /end CHARACTERISTIC
/begin CHARACTERISTIC CDCSLVE "Codewort CARB: Sekund‰rluftventil (Endstufe)" VAL_BLK 0xFD0EBC KwbWU16 65535.00 dez 0.00 65535.00 FORMAT "%8.2" NUMBER 4 /end CHARACTERISTIC
/begin CHARACTERISTIC CDCSUE "Codewort Carb: Endstufe Saugrohrumschaltung" VAL_BLK 0xFD0ECC KwbUw 65535.00 dez 0.00 65535.00 FORMAT "%8.2" NUMBER 4 /end CHARACTERISTIC
/begin CHARACTERISTIC CDCTES "Codewort CARB: Tankentl¸ftungssystem" VAL_BLK 0xFD0EE4 KwbWU16 65535.00 dez 0.00 65535.00 FORMAT "%8.2" NUMBER 4 /end CHARACTERISTIC
/begin CHARACTERISTIC CDCTEVE "Codewort CARB:	Tankentl¸ftungsventil Endstufe" VAL_BLK 0xFD0EEC KwbWU16 65535.00 dez 0.00 65535.00 FORMAT "%8.2" NUMBER 4 /end CHARACTERISTIC
/begin CHARACTERISTIC CDCTEVE2 "Codewort CARB:	Tankentl¸ftungsventil Endstufe  Bank2" VAL_BLK 0xFD0EF4 KwbWU16 65535.00 dez 0.00 65535.00 FORMAT "%8.2" NUMBER 4 /end CHARACTERISTIC
/begin CHARACTERISTIC CDCTOENS "" VAL_BLK 0xFD0F0C KwbWU16 65535.00 dez 0.00 65535.00 FORMAT "%8.2" NUMBER 4 /end CHARACTERISTIC
/begin CHARACTERISTIC CDKAGRE "Codewort Kunde: ‹berwachung AGR-Endstufe" VALUE 0xFD0F9E KwWU16 65535.00 dez 0.00 65535.00 FORMAT "%8.2" /end CHARACTERISTIC
/begin CHARACTERISTIC CDKAGRF "Codewort Kunde: ‹berwachung AGR-FLOW" VALUE 0xFD0FA0 KwWU16 65535.00 dez 0.00 65535.00 FORMAT "%8.2" /end CHARACTERISTIC
/begin CHARACTERISTIC CDKANWS "Codewort Kunde: Nockenwellensteuerung Auslass Nockenwelle" VALUE 0xFD0FA2 KwWU16 65535.00 DEZ 0.00 65535.00 FORMAT "%8.2" /end CHARACTERISTIC
/begin CHARACTERISTIC CDKANWSE "Codewort Kunde:Auslaﬂnockenwelle- Endstufe" VALUE 0xFD0FA4 KwWU16 65535.00 dez 0.00 65535.00 FORMAT "%8.2" /end CHARACTERISTIC
/begin CHARACTERISTIC CDKBKVP "" VALUE 0xFD0FA8 KwWU16 65535.00 dez 0.00 65535.00 FORMAT "%8.2" /end CHARACTERISTIC
/begin CHARACTERISTIC CDKDDSS "Codewort Kunde: Differenzdrucksensor Saugrohr" VALUE 0xFD0FBE KwWU16 65535.00 dez 0.00 65535.00 FORMAT "%8.2" /end CHARACTERISTIC
/begin CHARACTERISTIC CDKDMTK "Codewort Kunde: Tankentl¸ftungssystem, Feinstleck" VALUE 0xFD0FCC KwWU16 65535.00 dez 0.00 65535.00 FORMAT "%8.2" /end CHARACTERISTIC
/begin CHARACTERISTIC CDKDMTL "Codewort Kunde: Tankentl¸ftungssystem, Modulefehler (Hardware)" VALUE 0xFD0FCE KwWU16 65535.00 dez 0.00 65535.00 FORMAT "%8.2" /end CHARACTERISTIC
/begin CHARACTERISTIC CDKDSS "Codewort Kunde: Saugrohr-Drucksensor" VALUE 0xFD0FD0 KwWU16 65535.00 dez 0.00 65535.00 FORMAT "%8.2" /end CHARACTERISTIC
/begin CHARACTERISTIC CDKENWS "Codewort Kunde: Nockenwellensteuerung Einlass Nockenwelle" VALUE 0xFD1000 KwWU16 65535.00 DEZ 0.00 65535.00 FORMAT "%8.2" /end CHARACTERISTIC
/begin CHARACTERISTIC CDKENWSE "Codewort Kunde: Einlaﬂnockenwelle- Endstufe" VALUE 0xFD1002 KwWU16 65535.00 dez 0.00 65535.00 FORMAT "%8.2" /end CHARACTERISTIC
/begin CHARACTERISTIC CDKEV5 "Codewort Kunde: EV von Zyl. 5" VALUE 0xFD100E KwWU16 65535.00 dez 0.00 65535.00 FORMAT "%8.2" /end CHARACTERISTIC
/begin CHARACTERISTIC CDKEV6 "Codewort Kunde: EV von Zyl. 6" VALUE 0xFD1010 KwWU16 65535.00 dez 0.00 65535.00 FORMAT "%8.2" /end CHARACTERISTIC
/begin CHARACTERISTIC CDKEV7 "Codewort Kunde: EV von Zyl. 7" VALUE 0xFD1012 KwWU16 65535.00 dez 0.00 65535.00 FORMAT "%8.2" /end CHARACTERISTIC
/begin CHARACTERISTIC CDKEV8 "Codewort Kunde: EV von Zyl. 8" VALUE 0xFD1014 KwWU16 65535.00 dez 0.00 65535.00 FORMAT "%8.2" /end CHARACTERISTIC
/begin CHARACTERISTIC CDKFRAO "Codewort Kunde: LR- Adaption multi. obere Schwelle" VALUE 0xFD101E KwUw 65535.00 dez 0.00 65535.00 FORMAT "%8.2" /end CHARACTERISTIC
/begin CHARACTERISTIC CDKFRAU "Codewort Kunde: LR- Adaption multi. untere Schwelle" VALUE 0xFD1020 KwUw 65535.00 dez 0.00 65535.00 FORMAT "%8.2" /end CHARACTERISTIC
/begin CHARACTERISTIC CDKFRST "Codewort Kunde: LR- Abweichung" VALUE 0xFD1022 KwUw 65535.00 dez 0.00 65535.00 FORMAT "%8.2" /end CHARACTERISTIC
/begin CHARACTERISTIC CDKFST "Codewort Kunde: Tankf¸llstand" VALUE 0xFD1024 KwWU16 65535.00 dez 0.00 65535.00 FORMAT "%8.2" /end CHARACTERISTIC
/begin CHARACTERISTIC CDKHSVSA "" VALUE 0xFD102E KwWU16 65535.00 dez 0.00 65535.00 FORMAT "%8.2" /end CHARACTERISTIC
/begin CHARACTERISTIC CDKKATSP "Codewort Kunde:	Katalysator-Konvertierung" VALUE 0xFD1032 KwWU16 65535.00 dez 0.00 65535.00 FORMAT "%8.2" /end CHARACTERISTIC
/begin CHARACTERISTIC CDKKRTP "Codewort Kunde: Klopfregelung Testimpuls" VALUE 0xFD103E KwUw 65535.00 dez 0.00 65535.00 FORMAT "%8.2" /end CHARACTERISTIC
/begin CHARACTERISTIC CDKKS1 "Codewort Kunde:	Klopfsensor 1" VALUE 0xFD1040 KwUw 65535.00 dez 0.00 65535.00 FORMAT "%8.2" /end CHARACTERISTIC
/begin CHARACTERISTIC CDKKS2 "Codewort Kunde:	Klopfsensor 2" VALUE 0xFD1042 KwUw 65535.00 dez 0.00 65535.00 FORMAT "%8.2" /end CHARACTERISTIC
/begin CHARACTERISTIC CDKKS3 "Codewort Kunde:	Klopfsensor 3" VALUE 0xFD1044 KwUw 65535.00 dez 0.00 65535.00 FORMAT "%8.2" /end CHARACTERISTIC
/begin CHARACTERISTIC CDKKS4 "Codewort Kunde:	Klopfsensor 4" VALUE 0xFD1046 KwUw 65535.00 dez 0.00 65535.00 FORMAT "%8.2" /end CHARACTERISTIC
/begin CHARACTERISTIC CDKKUPPL "Codewort Kunde: Pedalwertgeber Kupplung" VALUE 0xFD1048 KwUw 65535.00 dez 0.00 65535.00 FORMAT "%8.2" /end CHARACTERISTIC
/begin CHARACTERISTIC CDKLASH "Codewort Kunde: Lambda-Sondenalterung hinter Kat." VALUE 0xFD104A KwUw 65535.00 dez 0.00 65535.00 FORMAT "%8.2" /end CHARACTERISTIC
/begin CHARACTERISTIC CDKLATP "Codewort Kunde: Lambda-Sondenalterung TP" VALUE 0xFD104C KwWU16 65535.00 dez 0.00 65535.00 FORMAT "%8.2" /end CHARACTERISTIC
/begin CHARACTERISTIC CDKLATV "Codewort Kunde: Lambda-Sondenalterung TV" VALUE 0xFD104E KwWU16 65535.00 dez 0.00 65535.00 FORMAT "%8.2" /end CHARACTERISTIC
/begin CHARACTERISTIC CDKLATV2 "Codewort Kunde: Lambda-Sondenalterung TV Bank 2" VALUE 0xFD1050 KwWU16 65535.00 dez 0.00 65535.00 FORMAT "%8.2" /end CHARACTERISTIC
/begin CHARACTERISTIC CDKLDP "Codewort Kunde: Leckdiagnosepumpe" VALUE 0xFD1054 KwWU16 65535.00 dez 0.00 65535.00 FORMAT "%8.2" /end CHARACTERISTIC
/begin CHARACTERISTIC CDKLLR "Codewort Kunde: Leerlaufregelung am Anschlag" VALUE 0xFD1058 KwUw 65535.00 dez 0.00 65535.00 FORMAT "%8.2" /end CHARACTERISTIC
/begin CHARACTERISTIC CDKLSH "Codewort Kunde: Lambda-Sonde hinter Kat" VALUE 0xFD105C KwUw 65535.00 dez 0.00 65535.00 FORMAT "%8.2" /end CHARACTERISTIC
/begin CHARACTERISTIC CDKLSV "Codewort Kunde:	Lambda-Sonde vor Kat" VALUE 0xFD105E KwWU16 65535.00 dez 0.00 65535.00 FORMAT "%8.2" /end CHARACTERISTIC
/begin CHARACTERISTIC CDKLSV2 "Codewort Kunde:	Lambda-Sonde 2 vor Kat" VALUE 0xFD1060 KwWU16 65535.00 dez 0.00 65535.00 FORMAT "%8.2" /end CHARACTERISTIC
/begin CHARACTERISTIC CDKMD "Codewort Kunde: Aussetzer, Summenfehler (multiple)" VALUE 0xFD1066 KwWU16 65535.00 dez 0.00 65535.00 FORMAT "%8.2" /end CHARACTERISTIC
/begin CHARACTERISTIC CDKMD00 "Codewort Kunde: Aussetzer Zyl. 0" VALUE 0xFD1068 KwWU16 65535.00 dez 0.00 65535.00 FORMAT "%8.2" /end CHARACTERISTIC
/begin CHARACTERISTIC CDKMD01 "Codewort Kunde: Aussetzer Zyl. 1" VALUE 0xFD106A KwWU16 65535.00 dez 0.00 65535.00 FORMAT "%8.2" /end CHARACTERISTIC
/begin CHARACTERISTIC CDKMD02 "Codewort Kunde: Aussetzer Zylinder 2" VALUE 0xFD106C KwWU16 65535.00 dez 0.00 65535.00 FORMAT "%8.2" /end CHARACTERISTIC
/begin CHARACTERISTIC CDKMD03 "Codewort Kunde: Aussetzer Zylinder 3" VALUE 0xFD106E KwWU16 65535.00 dez 0.00 65535.00 FORMAT "%8.2" /end CHARACTERISTIC
/begin CHARACTERISTIC CDKMD04 "Codewort Kunde: Aussetzer Zylinder 4" VALUE 0xFD1070 KwWU16 65535.00 dez 0.00 65535.00 FORMAT "%8.2" /end CHARACTERISTIC
/begin CHARACTERISTIC CDKMD05 "Codewort Kunde: Aussetzer Zylinder 5" VALUE 0xFD1072 KwWU16 65535.00 dez 0.00 65535.00 FORMAT "%8.2" /end CHARACTERISTIC
/begin CHARACTERISTIC CDKMD06 "Codewort Kunde: Aussetzer Zylinder 6" VALUE 0xFD1074 KwWU16 65535.00 dez 0.00 65535.00 FORMAT "%8.2" /end CHARACTERISTIC
/begin CHARACTERISTIC CDKMD07 "Codewort Kunde: Aussetzer Zylinder 7" VALUE 0xFD1076 KwWU16 65535.00 dez 0.00 65535.00 FORMAT "%8.2" /end CHARACTERISTIC
/begin CHARACTERISTIC CDKMD08 "Codewort Kunde: Aussetzer Zylinder 8" VALUE 0xFD1078 KwWU16 65535.00 dez 0.00 65535.00 FORMAT "%8.2" /end CHARACTERISTIC
/begin CHARACTERISTIC CDKMD09 "Codewort Kunde: Aussetzer Zylinder 9" VALUE 0xFD107A KwWU16 65535.00 dez 0.00 65535.00 FORMAT "%8.2" /end CHARACTERISTIC
/begin CHARACTERISTIC CDKMD10 "Codewort Kunde: Aussetzer Zylinder 10" VALUE 0xFD107C KwWU16 65535.00 dez 0.00 65535.00 FORMAT "%8.2" /end CHARACTERISTIC
/begin CHARACTERISTIC CDKMD11 "Codewort Kunde: Aussetzer Zylinder 11" VALUE 0xFD107E KwWU16 65535.00 dez 0.00 65535.00 FORMAT "%8.2" /end CHARACTERISTIC
/begin CHARACTERISTIC CDKMDK "Codewort Kunde: Aussetzer, Summenfehler - multiple, kundendienstrelevant" VALUE 0xFD1082 KwWU16 65535.00 dez 0.00 65535.00 FORMAT "%8.2" /end CHARACTERISTIC
/begin CHARACTERISTIC CDKMLE "Codewort Kunde: Motorl¸fter- Endstufe" VALUE 0xFD1086 KwWU16 65535.00 dez 0.00 65535.00 FORMAT "%8.2" /end CHARACTERISTIC
/begin CHARACTERISTIC CDKNVRBUP "Codewort Kunde: NVRAM Backup" VALUE 0xFD108A KwUw 65535.00 dez 0.00 65535.00 FORMAT "%8.2" /end CHARACTERISTIC
/begin CHARACTERISTIC CDKNWKW "Codewort Kunde: Zuordnung Nockwelle zu Kurbelwelle" VALUE 0xFD108C KwWU16 65535.00 dez 0.00 65535.00 FORMAT "%8.2" /end CHARACTERISTIC
/begin CHARACTERISTIC CDKPDDSS "Codewort Kunde: Druck Differenzdrucksensor Saugrohr" VALUE 0xFD108E KwWU16 65535.00 dez 0.00 65535.00 FORMAT "%8.2" /end CHARACTERISTIC
/begin CHARACTERISTIC CDKPH "Codewort Kunde: Phasensensor" VALUE 0xFD1090 KwWU16 65535.00 DEZ 0.00 65535.00 FORMAT "%8.2" /end CHARACTERISTIC
/begin CHARACTERISTIC CDKPH2 "Codewort Kunde: Phasensensor 2" VALUE 0xFD1092 KwWU16 65535.00 DEZ 0.00 65535.00 FORMAT "%8.2" /end CHARACTERISTIC
/begin CHARACTERISTIC CDKPH3 "Codewort Kunde: Phasensensor 3" VALUE 0xFD1094 KwWU16 65535.00 DEZ 0.00 65535.00 FORMAT "%8.2" /end CHARACTERISTIC
/begin CHARACTERISTIC CDKPH4 "Codewort Kunde: Phasensensor 4" VALUE 0xFD1096 KwWU16 65535.00 DEZ 0.00 65535.00 FORMAT "%8.2" /end CHARACTERISTIC
/begin CHARACTERISTIC CDKPHM "Codewort Kunde: Phasensensor MIL" VALUE 0xFD1098 KwWU16 65535.00 DEZ 0.00 65535.00 FORMAT "%8.2" /end CHARACTERISTIC
/begin CHARACTERISTIC CDKRKAT "Codewort Kunde: LR- Adaption pro Zeit" VALUE 0xFD109A KwUw 65535.00 dez 0.00 65535.00 FORMAT "%8.2" /end CHARACTERISTIC
/begin CHARACTERISTIC CDKRKAZ "Codewort Kunde: LR- Adaption additiv pro Z¸ndung" VALUE 0xFD109C KwUw 65535.00 dez 0.00 65535.00 FORMAT "%8.2" /end CHARACTERISTIC
/begin CHARACTERISTIC CDKSLPE "Codewort Kunde: Sekund‰rluftpumpe  (Endstufe)" VALUE 0xFD109E KwWU16 65535.00 dez 0.00 65535.00 FORMAT "%8.2" /end CHARACTERISTIC
/begin CHARACTERISTIC CDKSLS "Codewort Kunde: Sekund‰rluft-System" VALUE 0xFD10A0 KwUw 65535.00 dez 0.00 65535.00 FORMAT "%8.2" /end CHARACTERISTIC
/begin CHARACTERISTIC CDKSLV "Codewort Kunde:	Sekund‰rluftventil" VALUE 0xFD10A2 KwUw 65535.00 dez 0.00 65535.00 FORMAT "%8.2" /end CHARACTERISTIC
/begin CHARACTERISTIC CDKSLVE "Codewort Kunde:	Sekund‰rluftventil (Endstufe)" VALUE 0xFD10A4 KwWU16 65535.00 dez 0.00 65535.00 FORMAT "%8.2" /end CHARACTERISTIC
/begin CHARACTERISTIC CDKSUE "Codewort Kunde: Endstufe Saugrohrumschaltung" VALUE 0xFD10A8 KwUw 65535.00 dez 0.00 65535.00 FORMAT "%8.2" /end CHARACTERISTIC
/begin CHARACTERISTIC CDKTES "Codewort Kunde: Tankentl¸ftungssystem" VALUE 0xFD10AE KwWU16 65535.00 dez 0.00 65535.00 FORMAT "%8.2" /end CHARACTERISTIC
/begin CHARACTERISTIC CDKTEVE "Codewort Kunde:	Tankentl¸ftungsventil Endstufe" VALUE 0xFD10B0 KwWU16 65535.00 dez 0.00 65535.00 FORMAT "%8.2" /end CHARACTERISTIC
/begin CHARACTERISTIC CDKTEVE2 "Codewort Kunde: Tankentl¸ftungsventil Endstufe Bank 2" VALUE 0xFD10B2 KwWU16 65535.00 dez 0.00 65535.00 FORMAT "%8.2" /end CHARACTERISTIC
/begin CHARACTERISTIC CDKTOENS "" VALUE 0xFD10B8 KwWU16 65535.00 dez 0.00 65535.00 FORMAT "%8.2" /end CHARACTERISTIC
/begin CHARACTERISTIC CDTAGRE "Codewort Tester: ‹berwachung AGR-Endstufe" VALUE 0xFD10DE KwWU16 65535.00 dez 0.00 65535.00 FORMAT "%8.2" /end CHARACTERISTIC
/begin CHARACTERISTIC CDTAGRF "Codewort Tester: ‹berwachung AGR-FLOW" VALUE 0xFD10E0 KwWU16 65535.00 dez 0.00 65535.00 FORMAT "%8.2" /end CHARACTERISTIC
/begin CHARACTERISTIC CDTANWS "Codewort Tester: Nockenwellensteuerung Auslass Nockenwelle" VALUE 0xFD10E2 KwWU16 65535.00 DEZ 0.00 65535.00 FORMAT "%8.2" /end CHARACTERISTIC
/begin CHARACTERISTIC CDTANWSE "Codewort Tester: Auslaﬂnockenwelle- Endstufe" VALUE 0xFD10E4 KwWU16 65535.00 dez 0.00 65535.00 FORMAT "%8.2" /end CHARACTERISTIC
/begin CHARACTERISTIC CDTBKVP "" VALUE 0xFD10E8 KwWU16 65535.00 dez 0.00 65535.00 FORMAT "%8.2" /end CHARACTERISTIC
/begin CHARACTERISTIC CDTDDSS "Codewort Tester: Differenzdrucksensor Saugrohr" VALUE 0xFD10FE KwWU16 65535.00 dez 0.00 65535.00 FORMAT "%8.2" /end CHARACTERISTIC
/begin CHARACTERISTIC CDTDMTK "Codewort Tester: Tankentl¸ftungssystem Feinstleck" VALUE 0xFD110C KwWU16 65535.00 dez 0.00 65535.00 FORMAT "%8.2" /end CHARACTERISTIC
/begin CHARACTERISTIC CDTDMTL "Codewort Tester: Tankentl¸ftungssystem Modulfehler (Hardware)" VALUE 0xFD110E KwWU16 65535.00 dez 0.00 65535.00 FORMAT "%8.2" /end CHARACTERISTIC
/begin CHARACTERISTIC CDTDSS "Codewort Tester: Saugrohr-Drucksensor" VALUE 0xFD1110 KwWU16 65535.00 dez 0.00 65535.00 FORMAT "%8.2" /end CHARACTERISTIC
/begin CHARACTERISTIC CDTENWS "Codewort Tester: Nockenwellensteuerung Einlass Nockenwelle" VALUE 0xFD1140 KwWU16 65535.00 DEZ 0.00 65535.00 FORMAT "%8.2" /end CHARACTERISTIC
/begin CHARACTERISTIC CDTENWSE "Codewort Tester: Einlaﬂnockenwelle- Endstufe" VALUE 0xFD1142 KwWU16 65535.00 dez 0.00 65535.00 FORMAT "%8.2" /end CHARACTERISTIC
/begin CHARACTERISTIC CDTEV5 "Codewort Tester: EV von Zyl. 5" VALUE 0xFD114E KwWU16 65535.00 dez 0.00 65535.00 FORMAT "%8.2" /end CHARACTERISTIC
/begin CHARACTERISTIC CDTEV6 "Codewort Tester: EV von Zyl. 6" VALUE 0xFD1150 KwWU16 65535.00 dez 0.00 65535.00 FORMAT "%8.2" /end CHARACTERISTIC
/begin CHARACTERISTIC CDTEV7 "Codewort Tester: EV von Zyl. 7" VALUE 0xFD1152 KwWU16 65535.00 dez 0.00 65535.00 FORMAT "%8.2" /end CHARACTERISTIC
/begin CHARACTERISTIC CDTEV8 "Codewort Tester: EV von Zyl. 8" VALUE 0xFD1154 KwWU16 65535.00 dez 0.00 65535.00 FORMAT "%8.2" /end CHARACTERISTIC
/begin CHARACTERISTIC CDTFRAO "Codewort Tester: LR-Adaption multiplikativ obere Schwelle" VALUE 0xFD115E KwUw 65535.00 dez 0.00 65535.00 FORMAT "%8.2" /end CHARACTERISTIC
/begin CHARACTERISTIC CDTFRAU "Codewort Tester: LR-Adaption multiplikativ untere Schwelle" VALUE 0xFD1160 KwUw 65535.00 dez 0.00 65535.00 FORMAT "%8.2" /end CHARACTERISTIC
/begin CHARACTERISTIC CDTFRST "Codewort Tester: LR-Abweichung" VALUE 0xFD1162 KwUw 65535.00 dez 0.00 65535.00 FORMAT "%8.2" /end CHARACTERISTIC
/begin CHARACTERISTIC CDTFST "Codewort Tester: Tankf¸llstand" VALUE 0xFD1164 KwWU16 65535.00 dez 0.00 65535.00 FORMAT "%8.2" /end CHARACTERISTIC
/begin CHARACTERISTIC CDTHSVSA "Codewort Tester: Lambdasonden-Heizung vor Katalysator" VALUE 0xFD116E KwWU16 65535.00 dez 0.00 65535.00 FORMAT "%8.2" /end CHARACTERISTIC
/begin CHARACTERISTIC CDTKATSP "Codewort Tester: Katalysator-Konvertierung" VALUE 0xFD1172 KwWU16 65535.00 dez 0.00 65535.00 FORMAT "%8.2" /end CHARACTERISTIC
/begin CHARACTERISTIC CDTKRTP "Codewort Tester: Klopfregelung Testimpuls" VALUE 0xFD117E KwUw 65535.00 dez 0.00 65535.00 FORMAT "%8.2" /end CHARACTERISTIC
/begin CHARACTERISTIC CDTKS1 "Codewort Tester: Klopfsensor 1" VALUE 0xFD1180 KwUw 65535.00 dez 0.00 65535.00 FORMAT "%8.2" /end CHARACTERISTIC
/begin CHARACTERISTIC CDTKS2 "Codewort Tester: Klopfsensor 2" VALUE 0xFD1182 KwUw 65535.00 dez 0.00 65535.00 FORMAT "%8.2" /end CHARACTERISTIC
/begin CHARACTERISTIC CDTKS3 "Codewort Tester: Klopfsensor 3" VALUE 0xFD1184 KwUw 65535.00 dez 0.00 65535.00 FORMAT "%8.2" /end CHARACTERISTIC
/begin CHARACTERISTIC CDTKS4 "Codewort Tester: Klopfsensor 4" VALUE 0xFD1186 KwUw 65535.00 dez 0.00 65535.00 FORMAT "%8.2" /end CHARACTERISTIC
/begin CHARACTERISTIC CDTKUPPL "Fehlerpfadcode: Pedalwertgeber Kupplung" VALUE 0xFD1188 KwUw 65535.00 dez 0.00 65535.00 FORMAT "%8.2" /end CHARACTERISTIC
/begin CHARACTERISTIC CDTLASH "Codewort Tester: Lambda-Sondenalterung hinter Kat" VALUE 0xFD118A KwUw 65535.00 dez 0.00 65535.00 FORMAT "%8.2" /end CHARACTERISTIC
/begin CHARACTERISTIC CDTLATP "Codewort Tester: Lambda-Sondenalterung TP" VALUE 0xFD118C KwWU16 65535.00 dez 0.00 65535.00 FORMAT "%8.2" /end CHARACTERISTIC
/begin CHARACTERISTIC CDTLATV "Codewort Tester: Lambda-Sondenalterung TV" VALUE 0xFD118E KwWU16 65535.00 dez 0.00 65535.00 FORMAT "%8.2" /end CHARACTERISTIC
/begin CHARACTERISTIC CDTLATV2 "Codewort Tester: Lambda-Sondenalterung TV (Bank 2)" VALUE 0xFD1190 KwWU16 65535.00 dez 0.00 65535.00 FORMAT "%8.2" /end CHARACTERISTIC
/begin CHARACTERISTIC CDTLDP "Codewort Tester: Tankentl¸ftung; Leckdiagnosepumpe" VALUE 0xFD1194 KwWU16 65535.00 dez 0.00 65535.00 FORMAT "%8.2" /end CHARACTERISTIC
/begin CHARACTERISTIC CDTLLR "Codewort Tester: Leerlaufregelung am Anschlag" VALUE 0xFD1198 KwUw 65535.00 dez 0.00 65535.00 FORMAT "%8.2" /end CHARACTERISTIC
/begin CHARACTERISTIC CDTLSH "Codewort Tester: Lambda-Sonde hinter Kat" VALUE 0xFD119C KwUw 65535.00 dez 0.00 65535.00 FORMAT "%8.2" /end CHARACTERISTIC
/begin CHARACTERISTIC CDTLSV "Codewort Tester: Lambda-Sonde vor Kat" VALUE 0xFD119E KwWU16 65535.00 dez 0.00 65535.00 FORMAT "%8.2" /end CHARACTERISTIC
/begin CHARACTERISTIC CDTLSV2 "Codewort Tester: Lambda-Sonde 2 vor Kat" VALUE 0xFD11A0 KwWU16 65535.00 dez 0.00 65535.00 FORMAT "%8.2" /end CHARACTERISTIC
/begin CHARACTERISTIC CDTMD "Codewort Tester: Aussetzer, Summenfehler (multiple)" VALUE 0xFD11A6 KwWU16 65535.00 dez 0.00 65535.00 FORMAT "%8.2" /end CHARACTERISTIC
/begin CHARACTERISTIC CDTMD00 "Codewort Tester: Aussetzer Zyl. 0" VALUE 0xFD11A8 KwWU16 65535.00 dez 0.00 65535.00 FORMAT "%8.2" /end CHARACTERISTIC
/begin CHARACTERISTIC CDTMD01 "Codewort Tester: Aussetzer Zyl. 1" VALUE 0xFD11AA KwWU16 65535.00 dez 0.00 65535.00 FORMAT "%8.2" /end CHARACTERISTIC
/begin CHARACTERISTIC CDTMD02 "Codewort Tester: Aussetzer Zylinder 2" VALUE 0xFD11AC KwWU16 65535.00 dez 0.00 65535.00 FORMAT "%8.2" /end CHARACTERISTIC
/begin CHARACTERISTIC CDTMD03 "Codewort Tester: Aussetzer Zylinder 3" VALUE 0xFD11AE KwWU16 65535.00 dez 0.00 65535.00 FORMAT "%8.2" /end CHARACTERISTIC
/begin CHARACTERISTIC CDTMD04 "Codewort Tester: Aussetzer Zylinder 4" VALUE 0xFD11B0 KwWU16 65535.00 dez 0.00 65535.00 FORMAT "%8.2" /end CHARACTERISTIC
/begin CHARACTERISTIC CDTMD05 "Codewort Tester: Aussetzer Zylinder 5" VALUE 0xFD11B2 KwWU16 65535.00 dez 0.00 65535.00 FORMAT "%8.2" /end CHARACTERISTIC
/begin CHARACTERISTIC CDTMD06 "Codewort Tester: Aussetzer Zylinder 6" VALUE 0xFD11B4 KwWU16 65535.00 dez 0.00 65535.00 FORMAT "%8.2" /end CHARACTERISTIC
/begin CHARACTERISTIC CDTMD07 "Codewort Tester: Aussetzer Zylinder 7" VALUE 0xFD11B6 KwWU16 65535.00 dez 0.00 65535.00 FORMAT "%8.2" /end CHARACTERISTIC
/begin CHARACTERISTIC CDTMD08 "Codewort Tester: Aussetzer Zylinder 8" VALUE 0xFD11B8 KwWU16 65535.00 dez 0.00 65535.00 FORMAT "%8.2" /end CHARACTERISTIC
/begin CHARACTERISTIC CDTMD09 "Codewort Tester: Aussetzer Zylinder 9" VALUE 0xFD11BA KwWU16 65535.00 dez 0.00 65535.00 FORMAT "%8.2" /end CHARACTERISTIC
/begin CHARACTERISTIC CDTMD10 "Codewort Tester: Aussetzer Zylinder 10" VALUE 0xFD11BC KwWU16 65535.00 dez 0.00 65535.00 FORMAT "%8.2" /end CHARACTERISTIC
/begin CHARACTERISTIC CDTMD11 "Codewort Tester: Aussetzer Zylinder 11" VALUE 0xFD11BE KwWU16 65535.00 dez 0.00 65535.00 FORMAT "%8.2" /end CHARACTERISTIC
/begin CHARACTERISTIC CDTMDK "Codewort Tester: Aussetzer, Summenfehler - multiple, kundendienstrelevant" VALUE 0xFD11C2 KwWU16 65535.00 dez 0.00 65535.00 FORMAT "%8.2" /end CHARACTERISTIC
/begin CHARACTERISTIC CDTMLE "Codewort Tester: Endstufe L¸fter" VALUE 0xFD11C6 KwWU16 65535.00 dez 0.00 65535.00 FORMAT "%8.2" /end CHARACTERISTIC
/begin CHARACTERISTIC CDTNVRBUP "Codewort Tester: NVRAM Backup" VALUE 0xFD11CA KwUw 65535.00 dez 0.00 65535.00 FORMAT "%8.2" /end CHARACTERISTIC
/begin CHARACTERISTIC CDTNWKW "Codewort Tester: Zuordnung Nockenwelle zu Kurbelwelle" VALUE 0xFD11CC KwWU16 65535.00 dez 0.00 65535.00 FORMAT "%8.2" /end CHARACTERISTIC
/begin CHARACTERISTIC CDTPDDSS "Codewort Tester: Druck Differenzdrucksensor Saugrohr" VALUE 0xFD11CE KwWU16 65535.00 dez 0.00 65535.00 FORMAT "%8.2" /end CHARACTERISTIC
/begin CHARACTERISTIC CDTPH "Codewort Tester: Phasensensor" VALUE 0xFD11D0 KwWU16 65535.00 DEZ 0.00 65535.00 FORMAT "%8.2" /end CHARACTERISTIC
/begin CHARACTERISTIC CDTPH2 "Codewort Tester: Phasensensor Bank 2" VALUE 0xFD11D2 KwWU16 65535.00 DEZ 0.00 65535.00 FORMAT "%8.2" /end CHARACTERISTIC
/begin CHARACTERISTIC CDTPH3 "Codewort Tester: Phasensensor 3" VALUE 0xFD11D4 KwWU16 65535.00 DEZ 0.00 65535.00 FORMAT "%8.2" /end CHARACTERISTIC
/begin CHARACTERISTIC CDTPH4 "Codewort Tester: Phasensensor 4" VALUE 0xFD11D6 KwWU16 65535.00 DEZ 0.00 65535.00 FORMAT "%8.2" /end CHARACTERISTIC
/begin CHARACTERISTIC CDTPHM "Codewort Tester: Phasensensor MIL" VALUE 0xFD11D8 KwWU16 65535.00 DEZ 0.00 65535.00 FORMAT "%8.2" /end CHARACTERISTIC
/begin CHARACTERISTIC CDTRKAT "Codewort Tester: LR-Adaption additiv pro Zeit" VALUE 0xFD11DA KwUw 65535.00 dez 0.00 65535.00 FORMAT "%8.2" /end CHARACTERISTIC
/begin CHARACTERISTIC CDTRKAZ "Codewort Tester: LR-Adaption additiv pro Z¸ndung" VALUE 0xFD11DC KwUw 65535.00 dez 0.00 65535.00 FORMAT "%8.2" /end CHARACTERISTIC
/begin CHARACTERISTIC CDTSLPE "Codewort Tester: Sekund‰rluftpumpe (Endstufe)" VALUE 0xFD11DE KwWU16 65535.00 dez 0.00 65535.00 FORMAT "%8.2" /end CHARACTERISTIC
/begin CHARACTERISTIC CDTSLS "Codewort Tester: Sekund‰rluft-System" VALUE 0xFD11E0 KwUw 65535.00 dez 0.00 65535.00 FORMAT "%8.2" /end CHARACTERISTIC
/begin CHARACTERISTIC CDTSLV "Codewort Tester: Sekund‰rluftventil" VALUE 0xFD11E2 KwUw 65535.00 dez 0.00 65535.00 FORMAT "%8.2" /end CHARACTERISTIC
/begin CHARACTERISTIC CDTSLVE "Codewort Tester: Sekund‰rluftventil (Endstufe)" VALUE 0xFD11E4 KwWU16 65535.00 dez 0.00 65535.00 FORMAT "%8.2" /end CHARACTERISTIC
/begin CHARACTERISTIC CDTSUE "Codewort Tester: Endstufe Saugrohrumschaltung" VALUE 0xFD11E8 KwUw 65535.00 dez 0.00 65535.00 FORMAT "%8.2" /end CHARACTERISTIC
/begin CHARACTERISTIC CDTTES "Codewort Tester: Tankentl¸ftungssystem" VALUE 0xFD11EE KwWU16 65535.00 dez 0.00 65535.00 FORMAT "%8.2" /end CHARACTERISTIC
/begin CHARACTERISTIC CDTTEVE "Codewort Tester: Tankentl¸ftungsventil Endstufe" VALUE 0xFD11F0 KwWU16 65535.00 dez 0.00 65535.00 FORMAT "%8.2" /end CHARACTERISTIC
/begin CHARACTERISTIC CDTTEVE2 "Codewort Tester: Tankentl¸ftungsventil Endstufe Bank 2" VALUE 0xFD11F2 KwWU16 65535.00 dez 0.00 65535.00 FORMAT "%8.2" /end CHARACTERISTIC
/begin CHARACTERISTIC CDTTOENS "" VALUE 0xFD11F8 KwWU16 65535.00 dez 0.00 65535.00 FORMAT "%8.2" /end CHARACTERISTIC
/begin CHARACTERISTIC CLAAGRE "Fehlerklasse: AGR-Ventil Endstufe" VALUE 0xFD06DB KwWU8 255.0 dez 0.00 255.0 FORMAT "%5.1" /end CHARACTERISTIC
/begin CHARACTERISTIC CLAAGRF "Fehlerklasse: ‹berwachung AGR-Flow" VALUE 0xFD06DC KwWU8 255.0 dez 0.00 255.0 FORMAT "%5.1" /end CHARACTERISTIC
/begin CHARACTERISTIC CLAANWS "Fehlerklasse: Nockenwellensteuerung Auslass Nockenwelle" VALUE 0xFD06DD KwWU8 255.0 DEZ 0.00 255.0 FORMAT "%5.1" /end CHARACTERISTIC
/begin CHARACTERISTIC CLAANWSE "Fehlerklasse: Auslaﬂnockenwelle- Endstufe" VALUE 0xFD06DE KwWU8 255.0 dez 0.00 255.0 FORMAT "%5.1" /end CHARACTERISTIC
/begin CHARACTERISTIC CLABKVP "" VALUE 0xFD06E0 KwWU8 255.0 dez 0.00 255.0 FORMAT "%5.1" /end CHARACTERISTIC
/begin CHARACTERISTIC CLADDSS "Fehlerklasse: Differenzdrucksensor Saugrohr" VALUE 0xFD06EB KwWU8 255.0 dez 0.00 255.0 FORMAT "%5.1" /end CHARACTERISTIC
/begin CHARACTERISTIC CLADMTK "Fehlerklasse: Tankdiagnose, Feinstleck" VALUE 0xFD06F2 KwWU8 255.0 dez 0.00 255.0 FORMAT "%5.1" /end CHARACTERISTIC
/begin CHARACTERISTIC CLADMTL "Fehlerklasse: Tankdiagnose, Modulfehler" VALUE 0xFD06F3 KwWU8 255.0 dez 0.00 255.0 FORMAT "%5.1" /end CHARACTERISTIC
/begin CHARACTERISTIC CLADSS "Fehlerklasse: Saugrohrdrucksensor" VALUE 0xFD06F4 KwWU8 255.0 dez 0.00 255.0 FORMAT "%5.1" /end CHARACTERISTIC
/begin CHARACTERISTIC CLAENWS "Fehlerklasse: Nockenwellensteuerung Einlass Nockenwelle" VALUE 0xFD070C KwWU8 255.0 DEZ 0.00 255.0 FORMAT "%5.1" /end CHARACTERISTIC
/begin CHARACTERISTIC CLAENWSE "Fehlerklasse: Einlaﬂnockenwelle- Endstufe" VALUE 0xFD070D KwWU8 255.0 dez 0.00 255.0 FORMAT "%5.1" /end CHARACTERISTIC
/begin CHARACTERISTIC CLAEV5 "Fehlerklasse: EV Endstufe 5" VALUE 0xFD0713 KwWU8 255.0 dez 0.00 255.0 FORMAT "%5.1" /end CHARACTERISTIC
/begin CHARACTERISTIC CLAEV6 "Fehlerklasse: EV Endstufe 6" VALUE 0xFD0714 KwWU8 255.0 dez 0.00 255.0 FORMAT "%5.1" /end CHARACTERISTIC
/begin CHARACTERISTIC CLAEV7 "Fehlerklasse: EV Endstufe 7" VALUE 0xFD0715 KwWU8 255.0 dez 0.00 255.0 FORMAT "%5.1" /end CHARACTERISTIC
/begin CHARACTERISTIC CLAEV8 "Fehlerklasse: EV Endstufe 8" VALUE 0xFD0716 KwWU8 255.0 dez 0.00 255.0 FORMAT "%5.1" /end CHARACTERISTIC
/begin CHARACTERISTIC CLAFRAO "Fehlerklasse: LR-Adaption oberer Bereich" VALUE 0xFD071B KwUb 255.0 dez 0.00 255.0 FORMAT "%5.1" /end CHARACTERISTIC
/begin CHARACTERISTIC CLAFRAU "Fehlerklasse: LR-Adaption unterer Bereich" VALUE 0xFD071C KwUb 255.0 dez 0.00 255.0 FORMAT "%5.1" /end CHARACTERISTIC
/begin CHARACTERISTIC CLAFRST "Fehlerklasse: LR-Abweichung" VALUE 0xFD071D KwUb 255.0 dez 0.00 255.0 FORMAT "%5.1" /end CHARACTERISTIC
/begin CHARACTERISTIC CLAFST "Fehlerklasse: Tankf¸llstandssensor" VALUE 0xFD071E KwWU8 255.0 dez 0.00 255.0 FORMAT "%5.1" /end CHARACTERISTIC
/begin CHARACTERISTIC CLAHSVSA "Fehlerklasse: Heizung Lambdasonde vor Kat" VALUE 0xFD0723 KwWU8 255.0 dez 0.00 255.0 FORMAT "%5.1" /end CHARACTERISTIC
/begin CHARACTERISTIC CLAKATSP "Fehlerklasse: Katalysator" VALUE 0xFD0725 KwWU8 255.0 dez 0.00 255.0 FORMAT "%5.1" /end CHARACTERISTIC
/begin CHARACTERISTIC CLAKRTP "Fehlerklasse: Klopfregelung Testimpuls" VALUE 0xFD072B KwUb 255.0 dez 0.00 255.0 FORMAT "%5.1" /end CHARACTERISTIC
/begin CHARACTERISTIC CLAKS1 "Fehlerklasse: Klopfsensor 1" VALUE 0xFD072C KwUb 255.0 dez 0.00 255.0 FORMAT "%5.1" /end CHARACTERISTIC
/begin CHARACTERISTIC CLAKS2 "Fehlerklasse: Klopfsensor 2" VALUE 0xFD072D KwUb 255.0 dez 0.00 255.0 FORMAT "%5.1" /end CHARACTERISTIC
/begin CHARACTERISTIC CLAKS3 "Fehlerklasse: Klopfsensor 3" VALUE 0xFD072E KwUb 255.0 dez 0.00 255.0 FORMAT "%5.1" /end CHARACTERISTIC
/begin CHARACTERISTIC CLAKS4 "Fehlerklasse: Klopfsensor 4" VALUE 0xFD072F KwUb 255.0 dez 0.00 255.0 FORMAT "%5.1" /end CHARACTERISTIC
/begin CHARACTERISTIC CLAKUPPL "Fehlerklasse: Pedalwertgeber Kupplung" VALUE 0xFD0730 KwUb 255.0 dez 0.00 255.0 FORMAT "%5.1" /end CHARACTERISTIC
/begin CHARACTERISTIC CLALASH "Fehlerklasse: Lambdasondenalterung hinter Kat" VALUE 0xFD0731 KwUb 255.0 dez 0.00 255.0 FORMAT "%5.1" /end CHARACTERISTIC
/begin CHARACTERISTIC CLALATP "Fehlerklasse: Lambda Sondenalterung vor Kat Tp" VALUE 0xFD0732 KwWU8 255.0 dez 0.00 255.0 FORMAT "%5.1" /end CHARACTERISTIC
/begin CHARACTERISTIC CLALATV "Fehlerklasse: Lambda Sondenalterung vor Kat Tv" VALUE 0xFD0733 KwWU8 255.0 dez 0.00 255.0 FORMAT "%5.1" /end CHARACTERISTIC
/begin CHARACTERISTIC CLALATV2 "Fehlerklasse: Lambda Sondenalterung vor Kat Tv Bank2" VALUE 0xFD0734 KwWU8 255.0 dez 0.00 255.0 FORMAT "%5.1" /end CHARACTERISTIC
/begin CHARACTERISTIC CLALDP "Fehlerklasse: Leckdiagnosepumpe" VALUE 0xFD0736 KwWU8 255.0 dez 0.00 255.0 FORMAT "%5.1" /end CHARACTERISTIC
/begin CHARACTERISTIC CLALLR "Fehlerklasse: Leerlaufregelung" VALUE 0xFD0738 KwUb 255.0 dez 0.00 255.0 FORMAT "%5.1" /end CHARACTERISTIC
/begin CHARACTERISTIC CLALSH "Fehlerklasse: Lambdasonde hinter Kat" VALUE 0xFD073A KwUb 255.0 dez 0.00 255.0 FORMAT "%5.1" /end CHARACTERISTIC
/begin CHARACTERISTIC CLALSV "Fehlerklasse: Lambdasonde vor Kat" VALUE 0xFD073B KwWU8 255.0 dez 0.00 255.0 FORMAT "%5.1" /end CHARACTERISTIC
/begin CHARACTERISTIC CLALSV2 "Fehlerklasse: Lambdasonde 2 vor Kat" VALUE 0xFD073C KwWU8 255.0 dez 0.00 255.0 FORMAT "%5.1" /end CHARACTERISTIC
/begin CHARACTERISTIC CLAMD "Fehlerklasse:  Aussetzer, Summenfehler (multiple)" VALUE 0xFD073F KwWU8 255.0 dez 0.00 255.0 FORMAT "%5.1" /end CHARACTERISTIC
/begin CHARACTERISTIC CLAMD00 "Fehlerklasse:  Aussetzer Zyl. 0" VALUE 0xFD0740 KwWU8 255.0 dez 0.00 255.0 FORMAT "%5.1" /end CHARACTERISTIC
/begin CHARACTERISTIC CLAMD01 "Fehlerklasse:  Aussetzer Zyl. 1" VALUE 0xFD0741 KwWU8 255.0 dez 0.00 255.0 FORMAT "%5.1" /end CHARACTERISTIC
/begin CHARACTERISTIC CLAMD02 "Fehlerklasse:  Aussetzer Zylinder 2" VALUE 0xFD0742 KwWU8 255.0 dez 0.00 255.0 FORMAT "%5.1" /end CHARACTERISTIC
/begin CHARACTERISTIC CLAMD03 "Fehlerklasse:  Aussetzer Zylinder 3" VALUE 0xFD0743 KwWU8 255.0 dez 0.00 255.0 FORMAT "%5.1" /end CHARACTERISTIC
/begin CHARACTERISTIC CLAMD04 "Fehlerklasse:  Aussetzer Zylinder 4" VALUE 0xFD0744 KwWU8 255.0 dez 0.00 255.0 FORMAT "%5.1" /end CHARACTERISTIC
/begin CHARACTERISTIC CLAMD05 "Fehlerklasse:  Aussetzer Zylinder 5" VALUE 0xFD0745 KwWU8 255.0 dez 0.00 255.0 FORMAT "%5.1" /end CHARACTERISTIC
/begin CHARACTERISTIC CLAMD06 "Fehlerklasse:  Aussetzer Zylinder 6" VALUE 0xFD0746 KwWU8 255.0 dez 0.00 255.0 FORMAT "%5.1" /end CHARACTERISTIC
/begin CHARACTERISTIC CLAMD07 "Fehlerklasse:  Aussetzer Zylinder 7" VALUE 0xFD0747 KwWU8 255.0 dez 0.00 255.0 FORMAT "%5.1" /end CHARACTERISTIC
/begin CHARACTERISTIC CLAMD08 "Fehlerklasse:  Aussetzer Zylinder 8" VALUE 0xFD0748 KwWU8 255.0 dez 0.00 255.0 FORMAT "%5.1" /end CHARACTERISTIC
/begin CHARACTERISTIC CLAMD09 "Fehlerklasse:  Aussetzer Zylinder 9" VALUE 0xFD0749 KwWU8 255.0 dez 0.00 255.0 FORMAT "%5.1" /end CHARACTERISTIC
/begin CHARACTERISTIC CLAMD10 "Fehlerklasse:  Aussetzer Zylinder 10" VALUE 0xFD074A KwWU8 255.0 dez 0.00 255.0 FORMAT "%5.1" /end CHARACTERISTIC
/begin CHARACTERISTIC CLAMD11 "Fehlerklasse:  Aussetzer Zylinder 11" VALUE 0xFD074B KwWU8 255.0 dez 0.00 255.0 FORMAT "%5.1" /end CHARACTERISTIC
/begin CHARACTERISTIC CLAMDK "Fehlerklasse:  Aussetzer, Summenfehler - multiple, kundendienstrelevant" VALUE 0xFD074D KwWU8 255.0 dez 0.00 255.0 FORMAT "%5.1" /end CHARACTERISTIC
/begin CHARACTERISTIC CLAMLE "Fehlerklasse: Motorl¸fter Endstufe" VALUE 0xFD074F KwWU8 255.0 dez 0.00 255.0 FORMAT "%5.1" /end CHARACTERISTIC
/begin CHARACTERISTIC CLANVRBUP "Fehlerklasse: NVRAM Backup" VALUE 0xFD0751 KwUb 255.0 dez 0.00 255.0 FORMAT "%5.1" /end CHARACTERISTIC
/begin CHARACTERISTIC CLANWKW "Fehlerklasse: Zuordnung Nockenwelle zu Kurbelwelle" VALUE 0xFD0752 KwWU8 255.0 dez 0.00 255.0 FORMAT "%5.1" /end CHARACTERISTIC
/begin CHARACTERISTIC CLAPDDSS "Fehlerklasse: Druck Differenzdrucksensor Saugrohr" VALUE 0xFD0753 KwWU8 255.0 dez 0.00 255.0 FORMAT "%5.1" /end CHARACTERISTIC
/begin CHARACTERISTIC CLAPH "Fehlerklasse: Phasengeber" VALUE 0xFD0754 KwWU8 255.0 DEZ 0.00 255.0 FORMAT "%5.1" /end CHARACTERISTIC
/begin CHARACTERISTIC CLAPH2 "Fehlerklasse: Phasengeber Bank 2" VALUE 0xFD0755 KwWU8 255.0 DEZ 0.00 255.0 FORMAT "%5.1" /end CHARACTERISTIC
/begin CHARACTERISTIC CLAPH3 "Fehlerklasse: Phasengeber 3" VALUE 0xFD0756 KwWU8 255.0 DEZ 0.00 255.0 FORMAT "%5.1" /end CHARACTERISTIC
/begin CHARACTERISTIC CLAPH4 "Fehlerklasse: Phasengeber 4" VALUE 0xFD0757 KwWU8 255.0 DEZ 0.00 255.0 FORMAT "%5.1" /end CHARACTERISTIC
/begin CHARACTERISTIC CLAPHM "Fehlerklasse: Phasengeber MIL" VALUE 0xFD0758 KwWU8 255.0 DEZ 0.00 255.0 FORMAT "%5.1" /end CHARACTERISTIC
/begin CHARACTERISTIC CLARKAT "Fehlerklasse: LR-Adaption additiver Bereich pro Zeit" VALUE 0xFD0759 KwUb 255.0 dez 0.00 255.0 FORMAT "%5.1" /end CHARACTERISTIC
/begin CHARACTERISTIC CLARKAZ "Fehlerklasse: LR-Adaption additiver Bereich pro Z¸ndung" VALUE 0xFD075A KwUb 255.0 dez 0.00 255.0 FORMAT "%5.1" /end CHARACTERISTIC
/begin CHARACTERISTIC CLASLPE "Fehlerklasse: Sekund‰rluftpumpe Endstufe" VALUE 0xFD075B KwWU8 255.0 dez 0.00 255.0 FORMAT "%5.1" /end CHARACTERISTIC
/begin CHARACTERISTIC CLASLS "Fehlerklasse: Sekund‰rluftsystem" VALUE 0xFD075C KwUb 255.0 dez 0.00 255.0 FORMAT "%5.1" /end CHARACTERISTIC
/begin CHARACTERISTIC CLASLV "Fehlerklasse: Dichtheit Sekund‰rluftventil" VALUE 0xFD075D KwUb 255.0 dez 0.00 255.0 FORMAT "%5.1" /end CHARACTERISTIC
/begin CHARACTERISTIC CLASLVE "Fehlerklasse: Sekund‰rluftventil Endstufe" VALUE 0xFD075E KwWU8 255.0 dez 0.00 255.0 FORMAT "%5.1" /end CHARACTERISTIC
/begin CHARACTERISTIC CLASUE "Fehlerklasse: Saugrohrumschaltung Endstufe" VALUE 0xFD0760 KwUb 255.0 dez 0.00 255.0 FORMAT "%5.1" /end CHARACTERISTIC
/begin CHARACTERISTIC CLATES "Fehlerklasse: Tankdiagnose, TEV offen" VALUE 0xFD0763 KwWU8 255.0 dez 0.00 255.0 FORMAT "%5.1" /end CHARACTERISTIC
/begin CHARACTERISTIC CLATEVE "Fehlerklasse: Tankentl¸ftungsventil Endstufe" VALUE 0xFD0764 KwWU8 255.0 dez 0.00 255.0 FORMAT "%5.1" /end CHARACTERISTIC
/begin CHARACTERISTIC CLATEVE2 "Fehlerklasse: Tankentl¸ftungsventil Endstufe Bank 2" VALUE 0xFD0765 KwWU8 255.0 dez 0.00 255.0 FORMAT "%5.1" /end CHARACTERISTIC
/begin CHARACTERISTIC CLATOENS "" VALUE 0xFD0768 KwWU8 255.0 dez 0.00 255.0 FORMAT "%5.1" /end CHARACTERISTIC
/begin CHARACTERISTIC FFTAGRE "Freeze Frame Tabelle: AGR-Ventil Endstufe" VAL_BLK 0xFD0780 KwbWU8 255.0 dez 0.00 255.0 FORMAT "%5.1" NUMBER 4 /end CHARACTERISTIC
/begin CHARACTERISTIC FFTAGRF "Freeze Frame Tabelle: ‹berwachung AGR-Flow" VAL_BLK 0xFD0784 KwbWU8 255.0 dez 0.00 255.0 FORMAT "%5.1" NUMBER 4 /end CHARACTERISTIC
/begin CHARACTERISTIC FFTANWS "Freeze Frame Tabelle: Nockenwellensteuerung Auslass Nockenwelle" VAL_BLK 0xFD0788 KwbWU8 255.0 DEZ 0.00 255.0 FORMAT "%5.1" NUMBER 4 /end CHARACTERISTIC
/begin CHARACTERISTIC FFTANWSE "Freeze Frame Tabelle: Auslaﬂnockenwelle- Endstufe" VAL_BLK 0xFD078C KwbWU8 255.0 dez 0.00 255.0 FORMAT "%5.1" NUMBER 4 /end CHARACTERISTIC
/begin CHARACTERISTIC FFTBKVP "" VAL_BLK 0xFD0794 KwbWU8 255.0 dez 0.00 255.0 FORMAT "%5.1" NUMBER 4 /end CHARACTERISTIC
/begin CHARACTERISTIC FFTDDSS "Freeze Frame Tabelle: Differenzdrucksensor Saugrohr" VAL_BLK 0xFD07C0 KwbWU8 255.0 dez 0.00 255.0 FORMAT "%5.1" NUMBER 4 /end CHARACTERISTIC
/begin CHARACTERISTIC FFTDMTK "Freeze Frame Tabelle: Tankdiagnose, Feinstleck" VAL_BLK 0xFD07DC KwbWU8 255.0 dez 0.00 255.0 FORMAT "%5.1" NUMBER 4 /end CHARACTERISTIC
/begin CHARACTERISTIC FFTDMTL "Freeze Frame Tabelle: Tankdiagnose, Modulfehler (Hardware)" VAL_BLK 0xFD07E0 KwbWU8 255.0 dez 0.00 255.0 FORMAT "%5.1" NUMBER 4 /end CHARACTERISTIC
/begin CHARACTERISTIC FFTDSS "Freeze Frame Tabelle: Saugrohrdrucksensor" VAL_BLK 0xFD07E4 KwbWU8 255.0 dez 0.00 255.0 FORMAT "%5.1" NUMBER 4 /end CHARACTERISTIC
/begin CHARACTERISTIC FFTENWS "Freeze Frame Tabelle: Nockenwellensteuerung Einlass Nockenwelle" VAL_BLK 0xFD0844 KwbWU8 255.0 DEZ 0.00 255.0 FORMAT "%5.1" NUMBER 4 /end CHARACTERISTIC
/begin CHARACTERISTIC FFTENWSE "Freeze Frame Tabelle: Einlaﬂnockenwelle- Endstufe" VAL_BLK 0xFD0848 KwbWU8 255.0 dez 0.00 255.0 FORMAT "%5.1" NUMBER 4 /end CHARACTERISTIC
/begin CHARACTERISTIC FFTEV5 "Freeze Frame Tabelle: EV Endstufe 5" VAL_BLK 0xFD0860 KwbWU8 255.0 dez 0.00 255.0 FORMAT "%5.1" NUMBER 4 /end CHARACTERISTIC
/begin CHARACTERISTIC FFTEV6 "Freeze frame Tabelle: EV Endstufe 6" VAL_BLK 0xFD0864 KwbWU8 255.0 dez 0.00 255.0 FORMAT "%5.1" NUMBER 4 /end CHARACTERISTIC
/begin CHARACTERISTIC FFTEV7 "Freeze Frame Tabelle: EV Endstufe 7" VAL_BLK 0xFD0868 KwbWU8 255.0 dez 0.00 255.0 FORMAT "%5.1" NUMBER 4 /end CHARACTERISTIC
/begin CHARACTERISTIC FFTEV8 "Freeze Frame Tabelle: EV Endstufe 8" VAL_BLK 0xFD086C KwbWU8 255.0 dez 0.00 255.0 FORMAT "%5.1" NUMBER 4 /end CHARACTERISTIC
/begin CHARACTERISTIC FFTFRAO "Freeze Frame Tabelle: FRAO Gemischadaption" VAL_BLK 0xFD0880 KwbUb 255.0 dez 0.00 255.0 FORMAT "%5.1" NUMBER 4 /end CHARACTERISTIC
/begin CHARACTERISTIC FFTFRAU "Freeze Frame Tabelle: FRAU Gemischadaption" VAL_BLK 0xFD0884 KwbUb 255.0 dez 0.00 255.0 FORMAT "%5.1" NUMBER 4 /end CHARACTERISTIC
/begin CHARACTERISTIC FFTFRST "Freeze Frame Tabelle: LR-Abweichung" VAL_BLK 0xFD0888 KwbUb 255.0 dez 0.00 255.0 FORMAT "%5.1" NUMBER 4 /end CHARACTERISTIC
/begin CHARACTERISTIC FFTFST "Freeze Frame Tabelle: Tankf¸llstand" VAL_BLK 0xFD088C KwbWU8 255.0 dez 0.00 255.0 FORMAT "%5.1" NUMBER 4 /end CHARACTERISTIC
/begin CHARACTERISTIC FFTHSVSA "Tabelle Umweltbedingungen Heizung Lambdasonde vor Kat" VAL_BLK 0xFD08A0 KwbWU8 255.0 dez 0.00 255.0 FORMAT "%5.1" NUMBER 4 /end CHARACTERISTIC
/begin CHARACTERISTIC FFTKATSP "Freeze Frame Tabelle: Katalysator" VAL_BLK 0xFD08A8 KwbWU8 255.0 dez 0.00 255.0 FORMAT "%5.1" NUMBER 4 /end CHARACTERISTIC
/begin CHARACTERISTIC FFTKRTP "Freeze Frame Tabelle: Klopfregelung Testimpuls" VAL_BLK 0xFD08C0 KwbUb 255.0 dez 0.00 255.0 FORMAT "%5.1" NUMBER 4 /end CHARACTERISTIC
/begin CHARACTERISTIC FFTKS1 "Freeze Frame Tabelle: Klopfsensor 1" VAL_BLK 0xFD08C4 KwbUb 255.0 dez 0.00 255.0 FORMAT "%5.1" NUMBER 4 /end CHARACTERISTIC
/begin CHARACTERISTIC FFTKS2 "Freeze Frame Tabelle: Klopfsensor 2" VAL_BLK 0xFD08C8 KwbUb 255.0 dez 0.00 255.0 FORMAT "%5.1" NUMBER 4 /end CHARACTERISTIC
/begin CHARACTERISTIC FFTKS3 "Freeze Frame Tabelle: Klopfsensor 3" VAL_BLK 0xFD08CC KwbUb 255.0 dez 0.00 255.0 FORMAT "%5.1" NUMBER 4 /end CHARACTERISTIC
/begin CHARACTERISTIC FFTKS4 "Freeze Frame Tabelle: Klopfsensor 4" VAL_BLK 0xFD08D0 KwbUb 255.0 dez 0.00 255.0 FORMAT "%5.1" NUMBER 4 /end CHARACTERISTIC
/begin CHARACTERISTIC FFTKUPPL "Freeze Frame Tabelle: Pedalwertgeber Kupplung" VAL_BLK 0xFD08D4 KwbUb 255.0 dez 0.00 255.0 FORMAT "%5.1" NUMBER 4 /end CHARACTERISTIC
/begin CHARACTERISTIC FFTLASH "Tabelle Umweltbedingungen Lambdasonde hinter Kat" VAL_BLK 0xFD08D8 KwbUb 255.0 dez 0.00 255.0 FORMAT "%5.1" NUMBER 4 /end CHARACTERISTIC
/begin CHARACTERISTIC FFTLATP "Tabelle Umweltbedingungen Lambda-Sondenalterung Tp vor Kat" VAL_BLK 0xFD08DC KwbWU8 255.0 dez 0.00 255.0 FORMAT "%5.1" NUMBER 4 /end CHARACTERISTIC
/begin CHARACTERISTIC FFTLATV "Tabelle Umweltbedingungen Lambda-Sondenalterung Tv vor Kat" VAL_BLK 0xFD08E0 KwbWU8 255.0 dez 0.00 255.0 FORMAT "%5.1" NUMBER 4 /end CHARACTERISTIC
/begin CHARACTERISTIC FFTLATV2 "Tabelle Umweltbedingungen Lambda-Sondenalterung Tv vor Kat Bank2" VAL_BLK 0xFD08E4 KwbWU8 255.0 dez 0.00 255.0 FORMAT "%5.1" NUMBER 4 /end CHARACTERISTIC
/begin CHARACTERISTIC FFTLDP "Freeze Frame Tabelle: Leckdiagnosepumpe" VAL_BLK 0xFD08EC KwbWU8 255.0 dez 0.00 255.0 FORMAT "%5.1" NUMBER 4 /end CHARACTERISTIC
/begin CHARACTERISTIC FFTLLR "Freeze Frame Tabelle: Leerlaufregelung" VAL_BLK 0xFD08F4 KwbUb 255.0 dez 0.00 255.0 FORMAT "%5.1" NUMBER 4 /end CHARACTERISTIC
/begin CHARACTERISTIC FFTLSH "Tabelle Umweltbedingungen Lambdasonde hinter Kat" VAL_BLK 0xFD08FC KwbUb 255.0 dez 0.00 255.0 FORMAT "%5.1" NUMBER 4 /end CHARACTERISTIC
/begin CHARACTERISTIC FFTLSV "Tabelle Umweltbedingungen: Lambdasonde vor Kat" VAL_BLK 0xFD0900 KwbWU8 255.0 dez 0.00 255.0 FORMAT "%5.1" NUMBER 4 /end CHARACTERISTIC
/begin CHARACTERISTIC FFTLSV2 "Tabelle Umweltbedingungen: Lambdasonde vor Kat Bank2" VAL_BLK 0xFD0904 KwbWU8 255.0 dez 0.00 255.0 FORMAT "%5.1" NUMBER 4 /end CHARACTERISTIC
/begin CHARACTERISTIC FFTMD "Freeze Frame Tabelle: Aussetzer, Summenfehler (multiple)" VAL_BLK 0xFD0910 KwbWU8 255.0 dez 0.00 255.0 FORMAT "%5.1" NUMBER 4 /end CHARACTERISTIC
/begin CHARACTERISTIC FFTMD00 "Freeze Frame Tabelle: Aussetzer Zyl. 0" VAL_BLK 0xFD0914 KwbWU8 255.0 dez 0.00 255.0 FORMAT "%5.1" NUMBER 4 /end CHARACTERISTIC
/begin CHARACTERISTIC FFTMD01 "Freeze Frame Tabelle: Aussetzer Zyl. 1" VAL_BLK 0xFD0918 KwbWU8 255.0 dez 0.00 255.0 FORMAT "%5.1" NUMBER 4 /end CHARACTERISTIC
/begin CHARACTERISTIC FFTMD02 "Freeze Frame Tabelle: Aussetzer Zylinder 2" VAL_BLK 0xFD091C KwbWU8 255.0 dez 0.00 255.0 FORMAT "%5.1" NUMBER 4 /end CHARACTERISTIC
/begin CHARACTERISTIC FFTMD03 "Freeze Frame Tabelle: Aussetzer Zylinder 3" VAL_BLK 0xFD0920 KwbWU8 255.0 dez 0.00 255.0 FORMAT "%5.1" NUMBER 4 /end CHARACTERISTIC
/begin CHARACTERISTIC FFTMD04 "Freeze Frame Tabelle: Aussetzer Zylinder 4" VAL_BLK 0xFD0924 KwbWU8 255.0 dez 0.00 255.0 FORMAT "%5.1" NUMBER 4 /end CHARACTERISTIC
/begin CHARACTERISTIC FFTMD05 "Freeze Frame Tabelle: Aussetzer Zylinder 5" VAL_BLK 0xFD0928 KwbWU8 255.0 dez 0.00 255.0 FORMAT "%5.1" NUMBER 4 /end CHARACTERISTIC
/begin CHARACTERISTIC FFTMD06 "Freeze Frame Tabelle: Aussetzer Zylinder 6" VAL_BLK 0xFD092C KwbWU8 255.0 dez 0.00 255.0 FORMAT "%5.1" NUMBER 4 /end CHARACTERISTIC
/begin CHARACTERISTIC FFTMD07 "Freeze Frame Tabelle: Aussetzer Zylinder 7" VAL_BLK 0xFD0930 KwbWU8 255.0 dez 0.00 255.0 FORMAT "%5.1" NUMBER 4 /end CHARACTERISTIC
/begin CHARACTERISTIC FFTMD08 "Freeze Frame Tabelle: Aussetzer Zylinder 8" VAL_BLK 0xFD0934 KwbWU8 255.0 dez 0.00 255.0 FORMAT "%5.1" NUMBER 4 /end CHARACTERISTIC
/begin CHARACTERISTIC FFTMD09 "Freeze Frame Tabelle: Aussetzer Zylinder 9" VAL_BLK 0xFD0938 KwbWU8 255.0 dez 0.00 255.0 FORMAT "%5.1" NUMBER 4 /end CHARACTERISTIC
/begin CHARACTERISTIC FFTMD10 "Freeze Frame Tabelle: Aussetzer Zylinder 10" VAL_BLK 0xFD093C KwbWU8 255.0 dez 0.00 255.0 FORMAT "%5.1" NUMBER 4 /end CHARACTERISTIC
/begin CHARACTERISTIC FFTMD11 "Freeze Frame Tabelle: Aussetzer Zylinder 11" VAL_BLK 0xFD0940 KwbWU8 255.0 dez 0.00 255.0 FORMAT "%5.1" NUMBER 4 /end CHARACTERISTIC
/begin CHARACTERISTIC FFTMDK "Freeze Frame Tabelle: Aussetzer, Summenfehler - multiple, kundendienstrelevant" VAL_BLK 0xFD0948 KwbWU8 255.0 dez 0.00 255.0 FORMAT "%5.1" NUMBER 4 /end CHARACTERISTIC
/begin CHARACTERISTIC FFTMLE "Freeze Frame Tabelle: Motorl¸fter Endstufe" VAL_BLK 0xFD0950 KwbWU8 255.0 dez 0.00 255.0 FORMAT "%5.1" NUMBER 4 /end CHARACTERISTIC
/begin CHARACTERISTIC FFTNVRBUP "Freeze Frame Tabelle: NVRAM Backup" VAL_BLK 0xFD0958 KwbUb 255.0 dez 0.00 255.0 FORMAT "%5.1" NUMBER 4 /end CHARACTERISTIC
/begin CHARACTERISTIC FFTNWKW "Freeze Frame Tabelle: Zuordnung Nockenwelle zu Kurbelwelle" VAL_BLK 0xFD095C KwbWU8 255.0 dez 0.00 255.0 FORMAT "%5.1" NUMBER 4 /end CHARACTERISTIC
/begin CHARACTERISTIC FFTPDDSS "Freeze Frame Table: Druck Differenzdrucksensor Saugrohr" VAL_BLK 0xFD0960 KwbWU8 255.0 dez 0.00 255.0 FORMAT "%5.1" NUMBER 4 /end CHARACTERISTIC
/begin CHARACTERISTIC FFTPH "Freeze Frame Tabelle: Phasensensor" VAL_BLK 0xFD0964 KwbWU8 255.0 DEZ 0.00 255.0 FORMAT "%5.1" NUMBER 4 /end CHARACTERISTIC
/begin CHARACTERISTIC FFTPH2 "Freeze Frame Tabelle: Phasensensor Bank 2" VAL_BLK 0xFD0968 KwbWU8 255.0 DEZ 0.00 255.0 FORMAT "%5.1" NUMBER 4 /end CHARACTERISTIC
/begin CHARACTERISTIC FFTPH3 "Freeze Frame Tabelle: Phasensensor 3" VAL_BLK 0xFD096C KwbWU8 255.0 DEZ 0.00 255.0 FORMAT "%5.1" NUMBER 4 /end CHARACTERISTIC
/begin CHARACTERISTIC FFTPH4 "Freeze Frame Tabelle: Phasensensor 4" VAL_BLK 0xFD0970 KwbWU8 255.0 DEZ 0.00 255.0 FORMAT "%5.1" NUMBER 4 /end CHARACTERISTIC
/begin CHARACTERISTIC FFTPHM "Freeze Frame Tabelle: Phasensensor MIL" VAL_BLK 0xFD0974 KwbWU8 255.0 DEZ 0.00 255.0 FORMAT "%5.1" NUMBER 4 /end CHARACTERISTIC
/begin CHARACTERISTIC FFTRKAT "Freeze Frame Tabelle: RKAT Gemischadaption" VAL_BLK 0xFD0978 KwbUb 255.0 dez 0.00 255.0 FORMAT "%5.1" NUMBER 4 /end CHARACTERISTIC
/begin CHARACTERISTIC FFTRKAZ "Freeze Frame Tabelle: RKAZ Gemischadaption" VAL_BLK 0xFD097C KwbUb 255.0 dez 0.00 255.0 FORMAT "%5.1" NUMBER 4 /end CHARACTERISTIC
/begin CHARACTERISTIC FFTSLPE "Freeze Frame Tabelle: Sekund‰rluftpumpe Endstufe" VAL_BLK 0xFD0980 KwbWU8 255.0 dez 0.00 255.0 FORMAT "%5.1" NUMBER 4 /end CHARACTERISTIC
/begin CHARACTERISTIC FFTSLS "Freeze Frame Tabelle: Sekund‰rluftsystem" VAL_BLK 0xFD0984 KwbUb 255.0 dez 0.00 255.0 FORMAT "%5.1" NUMBER 4 /end CHARACTERISTIC
/begin CHARACTERISTIC FFTSLV "Freeze Frame Tabelle: Dichtheit Sekund‰rluftventil" VAL_BLK 0xFD0988 KwbUb 255.0 dez 0.00 255.0 FORMAT "%5.1" NUMBER 4 /end CHARACTERISTIC
/begin CHARACTERISTIC FFTSLVE "Freeze Frame Tabelle: Sekund‰rluftventil Endstufe" VAL_BLK 0xFD098C KwbWU8 255.0 dez 0.00 255.0 FORMAT "%5.1" NUMBER 4 /end CHARACTERISTIC
/begin CHARACTERISTIC FFTSUE "Freeze Frame Tabelle: Saugrohrumschaltung Endstufe" VAL_BLK 0xFD0994 KwbUb 255.0 dez 0.00 255.0 FORMAT "%5.1" NUMBER 4 /end CHARACTERISTIC
/begin CHARACTERISTIC FFTTES "Freeze Frame Tabelle: Tankentl¸ftungsventil" VAL_BLK 0xFD09A0 KwbWU8 255.0 dez 0.00 255.0 FORMAT "%5.1" NUMBER 4 /end CHARACTERISTIC
/begin CHARACTERISTIC FFTTEVE "Freeze Frame Tabelle: Tankentl¸ftungsventil Endstufe" VAL_BLK 0xFD09A4 KwbWU8 255.0 dez 0.00 255.0 FORMAT "%5.1" NUMBER 4 /end CHARACTERISTIC
/begin CHARACTERISTIC FFTTEVE2 "Freeze Frame Tabelle: Tankentl¸ftungsventil" VAL_BLK 0xFD09A8 KwbWU8 255.0 dez 0.00 255.0 FORMAT "%5.1" NUMBER 4 /end CHARACTERISTIC
/begin CHARACTERISTIC FFTTOENS "" VAL_BLK 0xFD09B4 KwbWU8 255.0 dez 0.00 255.0 FORMAT "%5.1" NUMBER 4 /end CHARACTERISTIC
/begin CHARACTERISTIC TSFAGRE "Fehlersummenzeit: ‹berwachung AGR-Endstufe" VALUE 0xFD09FD KwWU8 255.0 dez 0.00 255.0 FORMAT "%5.1" /end CHARACTERISTIC
/begin CHARACTERISTIC TSFAGRF "Fehlersummenzeit: ‹berwachung AGR-FLOW" VALUE 0xFD09FE KwWU8 255.0 dez 0.00 255.0 FORMAT "%5.1" /end CHARACTERISTIC
/begin CHARACTERISTIC TSFANWS "Fehlersummenzeit: Nockenwellensteuerung Auslass Nockenwelle" VALUE 0xFD09FF KwWU8 255.0 DEZ 0.00 255.0 FORMAT "%5.1" /end CHARACTERISTIC
/begin CHARACTERISTIC TSFANWSE "Fehlersummenzeit: Auslaﬂnockenwelle- Endstufe" VALUE 0xFD0A00 KwWU8 255.0 dez 0.00 255.0 FORMAT "%5.1" /end CHARACTERISTIC
/begin CHARACTERISTIC TSFBKVP "" VALUE 0xFD0A02 KwWU8 255.0 dez 0.00 255.0 FORMAT "%5.1" /end CHARACTERISTIC
/begin CHARACTERISTIC TSFDDSS "Fehlersummenzeit: Differenzdrucksensor Saugrohr" VALUE 0xFD0A0D KwWU8 255.0 dez 0.00 255.0 FORMAT "%5.1" /end CHARACTERISTIC
/begin CHARACTERISTIC TSFDMTK "Fehlersummenzeit: Tankentl¸ftungssystem, Feinstleck" VALUE 0xFD0A14 KwWU8 255.0 dez 0.00 255.0 FORMAT "%5.1" /end CHARACTERISTIC
/begin CHARACTERISTIC TSFDMTL "Fehlersummenzeit: Tankentl¸ftungssystem, Modulfehler (Hardware)" VALUE 0xFD0A15 KwWU8 255.0 dez 0.00 255.0 FORMAT "%5.1" /end CHARACTERISTIC
/begin CHARACTERISTIC TSFDSS "Fehlersummenzeit: Saugrohr-Drucksensor" VALUE 0xFD0A16 KwWU8 255.0 dez 0.00 255.0 FORMAT "%5.1" /end CHARACTERISTIC
/begin CHARACTERISTIC TSFENWS "Fehlersummenzeit: Nockenwellensteuerung Einlass Nockenwelle" VALUE 0xFD0A2E KwWU8 255.0 DEZ 0.00 255.0 FORMAT "%5.1" /end CHARACTERISTIC
/begin CHARACTERISTIC TSFENWSE "Fehlersummenzeit: Einlaﬂnockenwelle- Endstufe" VALUE 0xFD0A2F KwWU8 255.0 dez 0.00 255.0 FORMAT "%5.1" /end CHARACTERISTIC
/begin CHARACTERISTIC TSFEV5 "Fehlersummenzeit: EV von Zyl. 5" VALUE 0xFD0A35 KwWU8 255.0 dez 0.00 255.0 FORMAT "%5.1" /end CHARACTERISTIC
/begin CHARACTERISTIC TSFEV6 "Fehlersummenzeit: EV von Zyl. 6" VALUE 0xFD0A36 KwWU8 255.0 dez 0.00 255.0 FORMAT "%5.1" /end CHARACTERISTIC
/begin CHARACTERISTIC TSFEV7 "Fehlersummenzeit: EV von Zyl. 7" VALUE 0xFD0A37 KwWU8 255.0 dez 0.00 255.0 FORMAT "%5.1" /end CHARACTERISTIC
/begin CHARACTERISTIC TSFEV8 "Fehlersummenzeit: EV von Zyl. 8" VALUE 0xFD0A38 KwWU8 255.0 dez 0.00 255.0 FORMAT "%5.1" /end CHARACTERISTIC
/begin CHARACTERISTIC TSFFRAO "Fehlersummenzeit: LR-Adaption oberer Bereich" VALUE 0xFD0A3D KwUb 255.0 dez 0.00 255.0 FORMAT "%5.1" /end CHARACTERISTIC
/begin CHARACTERISTIC TSFFRAU "Fehlersummenzeit: LR-Adaption unterer Bereich" VALUE 0xFD0A3E KwUb 255.0 dez 0.00 255.0 FORMAT "%5.1" /end CHARACTERISTIC
/begin CHARACTERISTIC TSFFRST "Fehlersummenzeit: LR-Abweichung" VALUE 0xFD0A3F KwUb 255.0 dez 0.00 255.0 FORMAT "%5.1" /end CHARACTERISTIC
/begin CHARACTERISTIC TSFFST "Fehlersummenzeit: Tankf¸llstand" VALUE 0xFD0A40 KwWU8 255.0 dez 0.00 255.0 FORMAT "%5.1" /end CHARACTERISTIC
/begin CHARACTERISTIC TSFHSVSA "Fehlersummenzeit: Lambdasonden-Heizung vor Katalysator" VALUE 0xFD0A45 KwWU8 255.0 dez 0.00 255.0 FORMAT "%5.1" /end CHARACTERISTIC
/begin CHARACTERISTIC TSFKATSP "Fehlersummenzeit: Katalysator-Konvertierung" VALUE 0xFD0A47 KwWU8 255.0 dez 0.00 255.0 FORMAT "%5.1" /end CHARACTERISTIC
/begin CHARACTERISTIC TSFKRTP "Fehlersummenzeit: Klopfregelung Testimpuls" VALUE 0xFD0A4D KwUb 255.0 dez 0.00 255.0 FORMAT "%5.1" /end CHARACTERISTIC
/begin CHARACTERISTIC TSFKS1 "Fehlersummenzeit: Klopfsensor 1" VALUE 0xFD0A4E KwUb 255.0 dez 0.00 255.0 FORMAT "%5.1" /end CHARACTERISTIC
/begin CHARACTERISTIC TSFKS2 "Fehlersummenzeit: Klopfsensor 2" VALUE 0xFD0A4F KwUb 255.0 dez 0.00 255.0 FORMAT "%5.1" /end CHARACTERISTIC
/begin CHARACTERISTIC TSFKS3 "Fehlersummenzeit: Klopfsensor 3" VALUE 0xFD0A50 KwUb 255.0 dez 0.00 255.0 FORMAT "%5.1" /end CHARACTERISTIC
/begin CHARACTERISTIC TSFKS4 "Fehlersummenzeit: Klopfsensor 4" VALUE 0xFD0A51 KwUb 255.0 dez 0.00 255.0 FORMAT "%5.1" /end CHARACTERISTIC
/begin CHARACTERISTIC TSFKUPPL "Fehlersummenzeit: Pedalwertgeber Kupplung" VALUE 0xFD0A52 KwUb 255.0 dez 0.00 255.0 FORMAT "%5.1" /end CHARACTERISTIC
/begin CHARACTERISTIC TSFLASH "Fehlersummenzeit: Lambda-Sondenalterung hinter Kat." VALUE 0xFD0A53 KwUb 255.0 dez 0.00 255.0 FORMAT "%5.1" /end CHARACTERISTIC
/begin CHARACTERISTIC TSFLATP "Fehlersummenzeit: Lambda-Sondenalterung TP" VALUE 0xFD0A54 KwWU8 255.0 dez 0.00 255.0 FORMAT "%5.1" /end CHARACTERISTIC
/begin CHARACTERISTIC TSFLATV "Fehlersummenzeit: Lambda-Sondenalterung TV" VALUE 0xFD0A55 KwWU8 255.0 dez 0.00 255.0 FORMAT "%5.1" /end CHARACTERISTIC
/begin CHARACTERISTIC TSFLATV2 "Fehlersummenzeit: Lambda-Sondenalterung TV (Bank 2)" VALUE 0xFD0A56 KwWU8 255.0 dez 0.00 255.0 FORMAT "%5.1" /end CHARACTERISTIC
/begin CHARACTERISTIC TSFLDP "Fehlersummenzeit: Leckdiagnosepumpe" VALUE 0xFD0A58 KwWU8 255.0 dez 0.00 255.0 FORMAT "%5.1" /end CHARACTERISTIC
/begin CHARACTERISTIC TSFLLR "Fehlersummenzeit: Leerlaufregelung am Anschlag" VALUE 0xFD0A5A KwUb 255.0 dez 0.00 255.0 FORMAT "%5.1" /end CHARACTERISTIC
/begin CHARACTERISTIC TSFLSH "Fehlersummenzeit: Lambda-Sonde hinter Kat" VALUE 0xFD0A5C KwUb 255.0 dez 0.00 255.0 FORMAT "%5.1" /end CHARACTERISTIC
/begin CHARACTERISTIC TSFLSV "Fehlersummenzeit: Lambda-Sonde vor Kat" VALUE 0xFD0A5D KwWU8 255.0 dez 0.00 255.0 FORMAT "%5.1" /end CHARACTERISTIC
/begin CHARACTERISTIC TSFLSV2 "Fehlersummenzeit: Lambda-Sonde 2 vor Kat" VALUE 0xFD0A5E KwWU8 255.0 dez 0.00 255.0 FORMAT "%5.1" /end CHARACTERISTIC
/begin CHARACTERISTIC TSFMD "Fehlersummenzeit: Aussetzer, Summenfehler (multiple)" VALUE 0xFD0A61 KwWU8 255.0 dez 0.00 255.0 FORMAT "%5.1" /end CHARACTERISTIC
/begin CHARACTERISTIC TSFMD00 "Fehlersummenzeit: Aussetzer Zyl. 0" VALUE 0xFD0A62 KwWU8 255.0 dez 0.00 255.0 FORMAT "%5.1" /end CHARACTERISTIC
/begin CHARACTERISTIC TSFMD01 "Fehlersummenzeit: Aussetzer Zyl. 1" VALUE 0xFD0A63 KwWU8 255.0 dez 0.00 255.0 FORMAT "%5.1" /end CHARACTERISTIC
/begin CHARACTERISTIC TSFMD02 "Fehlersummenzeit: Aussetzer Zylinder 2" VALUE 0xFD0A64 KwWU8 255.0 dez 0.00 255.0 FORMAT "%5.1" /end CHARACTERISTIC
/begin CHARACTERISTIC TSFMD03 "Fehlersummenzeit: Aussetzer Zylinder 3" VALUE 0xFD0A65 KwWU8 255.0 dez 0.00 255.0 FORMAT "%5.1" /end CHARACTERISTIC
/begin CHARACTERISTIC TSFMD04 "Fehlersummenzeit: Aussetzer Zylinder 4" VALUE 0xFD0A66 KwWU8 255.0 dez 0.00 255.0 FORMAT "%5.1" /end CHARACTERISTIC
/begin CHARACTERISTIC TSFMD05 "Fehlersummenzeit: Aussetzer Zylinder 5" VALUE 0xFD0A67 KwWU8 255.0 dez 0.00 255.0 FORMAT "%5.1" /end CHARACTERISTIC
/begin CHARACTERISTIC TSFMD06 "Fehlersummenzeit: Aussetzer Zylinder 6" VALUE 0xFD0A68 KwWU8 255.0 dez 0.00 255.0 FORMAT "%5.1" /end CHARACTERISTIC
/begin CHARACTERISTIC TSFMD07 "Fehlersummenzeit: Aussetzer Zylinder 7" VALUE 0xFD0A69 KwWU8 255.0 dez 0.00 255.0 FORMAT "%5.1" /end CHARACTERISTIC
/begin CHARACTERISTIC TSFMD08 "Fehlersummenzeit: Aussetzer Zylinder 8" VALUE 0xFD0A6A KwWU8 255.0 dez 0.00 255.0 FORMAT "%5.1" /end CHARACTERISTIC
/begin CHARACTERISTIC TSFMD09 "Fehlersummenzeit: Aussetzer Zylinder 9" VALUE 0xFD0A6B KwWU8 255.0 dez 0.00 255.0 FORMAT "%5.1" /end CHARACTERISTIC
/begin CHARACTERISTIC TSFMD10 "Fehlersummenzeit: Aussetzer Zylinder 10" VALUE 0xFD0A6C KwWU8 255.0 dez 0.00 255.0 FORMAT "%5.1" /end CHARACTERISTIC
/begin CHARACTERISTIC TSFMD11 "Fehlersummenzeit: Aussetzer Zylinder 11" VALUE 0xFD0A6D KwWU8 255.0 dez 0.00 255.0 FORMAT "%5.1" /end CHARACTERISTIC
/begin CHARACTERISTIC TSFMDK "Fehlersummenzeit: Aussetzer, Summenfehler - multiple, kundendienstrelevant" VALUE 0xFD0A6F KwWU8 255.0 dez 0.00 255.0 FORMAT "%5.1" /end CHARACTERISTIC
/begin CHARACTERISTIC TSFMLE "Fehlersummenzeit: L¸fterendstufe" VALUE 0xFD0A71 KwWU8 255.0 dez 0.00 255.0 FORMAT "%5.1" /end CHARACTERISTIC
/begin CHARACTERISTIC TSFNVRBUP "Fehlersummenzeit: NVRAM Backup" VALUE 0xFD0A73 KwUb 255.0 dez 0.00 255.0 FORMAT "%5.1" /end CHARACTERISTIC
/begin CHARACTERISTIC TSFNWKW "Fehlersummenzeit: Zuordnung Nockenwelle zu Kurbelwelle" VALUE 0xFD0A74 KwWU8 255.0 dez 0.00 255.0 FORMAT "%5.1" /end CHARACTERISTIC
/begin CHARACTERISTIC TSFPDDSS "Fehlersummenzeit: Druck Differenzdrucksensor Saugrohr" VALUE 0xFD0A75 KwWU8 255.0 dez 0.00 255.0 FORMAT "%5.1" /end CHARACTERISTIC
/begin CHARACTERISTIC TSFPH "Fehlersummenzeit: Phasensensor" VALUE 0xFD0A76 KwWU8 255.0 DEZ 0.00 255.0 FORMAT "%5.1" /end CHARACTERISTIC
/begin CHARACTERISTIC TSFPH2 "Fehlersummenzeit: Phasensensor 2" VALUE 0xFD0A77 KwWU8 255.0 DEZ 0.00 255.0 FORMAT "%5.1" /end CHARACTERISTIC
/begin CHARACTERISTIC TSFPH3 "Fehlersummenzeit: Phasensensor 3" VALUE 0xFD0A78 KwWU8 255.0 DEZ 0.00 255.0 FORMAT "%5.1" /end CHARACTERISTIC
/begin CHARACTERISTIC TSFPH4 "Fehlersummenzeit: Phasensensor 4" VALUE 0xFD0A79 KwWU8 255.0 DEZ 0.00 255.0 FORMAT "%5.1" /end CHARACTERISTIC
/begin CHARACTERISTIC TSFPHM "Fehlersummenzeit: Phasensensor MIL" VALUE 0xFD0A7A KwWU8 255.0 DEZ 0.00 255.0 FORMAT "%5.1" /end CHARACTERISTIC
/begin CHARACTERISTIC TSFRKAT "Fehlersummenzeit: LR-Adaption additiver Bereich pro Zeit" VALUE 0xFD0A7B KwUb 255.0 dez 0.00 255.0 FORMAT "%5.1" /end CHARACTERISTIC
/begin CHARACTERISTIC TSFRKAZ "Fehlersummenzeit: LR-Adaption additiver Bereich pro Z¸ndung" VALUE 0xFD0A7C KwUb 255.0 dez 0.00 255.0 FORMAT "%5.1" /end CHARACTERISTIC
/begin CHARACTERISTIC TSFSLPE "Fehlersummenzeit: Sekund‰rluftpumpe (Endstufe)" VALUE 0xFD0A7D KwWU8 255.0 dez 0.00 255.0 FORMAT "%5.1" /end CHARACTERISTIC
/begin CHARACTERISTIC TSFSLS "Fehlersummenzeit: Sekund‰rluft-System" VALUE 0xFD0A7E KwUb 255.0 dez 0.00 255.0 FORMAT "%5.1" /end CHARACTERISTIC
/begin CHARACTERISTIC TSFSLV "Fehlersummenzeit: Sekund‰rluftventil" VALUE 0xFD0A7F KwUb 255.0 dez 0.00 255.0 FORMAT "%5.1" /end CHARACTERISTIC
/begin CHARACTERISTIC TSFSLVE "Fehlersummenzeit: Sekund‰rluftventil (Endstufe)" VALUE 0xFD0A80 KwWU8 255.0 dez 0.00 255.0 FORMAT "%5.1" /end CHARACTERISTIC
/begin CHARACTERISTIC TSFSUE "Fehlersummenzeit: Endstufe Saugrohrumschaltung" VALUE 0xFD0A82 KwUb 255.0 dez 0.00 255.0 FORMAT "%5.1" /end CHARACTERISTIC
/begin CHARACTERISTIC TSFTES "Fehlersummenzeit: Tankentl¸ftungssystem" VALUE 0xFD0A85 KwWU8 255.0 dez 0.00 255.0 FORMAT "%5.1" /end CHARACTERISTIC
/begin CHARACTERISTIC TSFTEVE "Fehlersummenzeit: Tankentl¸ftungsventil Endstufe" VALUE 0xFD0A86 KwWU8 255.0 dez 0.00 255.0 FORMAT "%5.1" /end CHARACTERISTIC
/begin CHARACTERISTIC TSFTEVE2 "Fehlersummenzeit: Tankentl¸ftungsventil Endstufe  Bank2" VALUE 0xFD0A87 KwWU8 255.0 dez 0.00 255.0 FORMAT "%5.1" /end CHARACTERISTIC
/begin CHARACTERISTIC TSFTOENS "" VALUE 0xFD0A8A KwWU8 255.0 dez 0.00 255.0 FORMAT "%5.1" /end CHARACTERISTIC
/begin MEASUREMENT B_beanws "Bedingung Bandende-Funktionsanforderung NWS Endstufe (Bank1, Auslaﬂ)" UWORD B_TRUE 1 100 0 1 BIT_MASK 0x20 FORMAT "%13.11" ECU_ADDRESS 0x3FDD1C /end MEASUREMENT
/begin MEASUREMENT B_beanwse "Bedingung Bandende-Funktionsanforderung NWS Endstufe (Bank1, Auslaﬂ)" UWORD B_TRUE 1 100 0 1 BIT_MASK 0x20 FORMAT "%13.11" ECU_ADDRESS 0x3FDD1E /end MEASUREMENT
/begin MEASUREMENT B_beenws "Bedingung Bandende-Funktionsanforderung NWS (Einlass,Bank1)" UWORD B_TRUE 1 100 0 1 BIT_MASK 0x20 FORMAT "%13.11" ECU_ADDRESS 0x3FDD7A /end MEASUREMENT
/begin MEASUREMENT B_beenwse "Bedingung Bandende-Funktionsanforderung NWS Endstufe (Bank1, Einlaﬂ)" UWORD B_TRUE 1 100 0 1 BIT_MASK 0x20 FORMAT "%13.11" ECU_ADDRESS 0x3FDD7C /end MEASUREMENT
/begin MEASUREMENT B_befrao "Bedingung: Bandendefunktionanford. f¸r FRAO" UWORD B_TRUE 1 100 0 1 BIT_MASK 0x20 FORMAT "%13.11" ECU_ADDRESS 0x3FDD98 /end MEASUREMENT
/begin MEASUREMENT B_befrau "Bedingung: Bandendefunktionanford. f¸r FRAU" UWORD B_TRUE 1 100 0 1 BIT_MASK 0x20 FORMAT "%13.11" ECU_ADDRESS 0x3FDD9A /end MEASUREMENT
/begin MEASUREMENT B_befrst "Bedingung: Bandendefunktionanford. f¸r LR- Kurztest" UWORD B_TRUE 1 100 0 1 BIT_MASK 0x20 FORMAT "%13.11" ECU_ADDRESS 0x3FDD9C /end MEASUREMENT
/begin MEASUREMENT B_bekrtp "Bedingung Bandende-Funktionsanforderung Klopfregelung Diagnose Testpuls" UWORD B_TRUE 1 100 0 1 BIT_MASK 0x20 FORMAT "%13.11" ECU_ADDRESS 0x3FDDB8 /end MEASUREMENT
/begin MEASUREMENT B_beks1 "Bedingung Bandende-Funktionsanforderung Diagnose Klopfsensor 1" UWORD B_TRUE 1 100 0 1 BIT_MASK 0x20 FORMAT "%13.11" ECU_ADDRESS 0x3FDDBA /end MEASUREMENT
/begin MEASUREMENT B_beks2 "Bedingung Bandende-Funktionsanforderung Diagnose Klopfsensor 2" UWORD B_TRUE 1 100 0 1 BIT_MASK 0x20 FORMAT "%13.11" ECU_ADDRESS 0x3FDDBC /end MEASUREMENT
/begin MEASUREMENT B_beks3 "Bedingung Bandende-Funktionsanforderung Diagnose Klopfsensor 3" UWORD B_TRUE 1 100 0 1 BIT_MASK 0x20 FORMAT "%13.11" ECU_ADDRESS 0x3FDDBE /end MEASUREMENT
/begin MEASUREMENT B_beks4 "Bedingung Bandende-Funktionsanforderung Diagnose Klopfsensor 1" UWORD B_TRUE 1 100 0 1 BIT_MASK 0x20 FORMAT "%13.11" ECU_ADDRESS 0x3FDDC0 /end MEASUREMENT
/begin MEASUREMENT B_bekuppl "Bedingung Bandende-Funktionsanforderung Kupplungssensor" UWORD B_TRUE 1 100 0 1 BIT_MASK 0x20 FORMAT "%13.11" ECU_ADDRESS 0x3FDDC2 /end MEASUREMENT
/begin MEASUREMENT B_belash "Bedingung Bandende-Funktionsanforderung Schwingungspr¸fung hinter KAT" UWORD B_TRUE 1 100 0 1 BIT_MASK 0x20 FORMAT "%13.11" ECU_ADDRESS 0x3FDDC4 /end MEASUREMENT
/begin MEASUREMENT B_belatp "Bedingung Bandende-Funktionsanforderung Alter.- Diag. Lambda-Sonde vor KAT" UWORD B_TRUE 1 100 0 1 BIT_MASK 0x20 FORMAT "%13.11" ECU_ADDRESS 0x3FDDC6 /end MEASUREMENT
/begin MEASUREMENT B_belatv "Bedingung Bandende-Funktionsanforderung Alter.- Diag. Lambda-Sonde vor KAT" UWORD B_TRUE 1 100 0 1 BIT_MASK 0x20 FORMAT "%13.11" ECU_ADDRESS 0x3FDDC8 /end MEASUREMENT
/begin MEASUREMENT B_belatv2 "Bedingung Bandende-Funktionsanforderung Alter.- Diag. Lambda-Sonde vor KAT Bank2" UWORD B_TRUE 1 100 0 1 BIT_MASK 0x20 FORMAT "%13.11" ECU_ADDRESS 0x3FDDCA /end MEASUREMENT
/begin MEASUREMENT B_bellr "Bedingung Bandende-Funktionsanforderung Leerlaufregelung" UWORD B_TRUE 1 100 0 1 BIT_MASK 0x20 FORMAT "%13.11" ECU_ADDRESS 0x3FDDD2 /end MEASUREMENT
/begin MEASUREMENT B_belsh "Bedingung Bandende-Funktionsanforderung elktr. Diag. Lambda-Sonde hinter KAT" UWORD B_TRUE 1 100 0 1 BIT_MASK 0x20 FORMAT "%13.11" ECU_ADDRESS 0x3FDDD6 /end MEASUREMENT
/begin MEASUREMENT B_belsv "Bedingung Bandende-Funktionsanforderung elktr. Diag. Lambda-Sonde vor KAT" UWORD B_TRUE 1 100 0 1 BIT_MASK 0x20 FORMAT "%13.11" ECU_ADDRESS 0x3FDDD8 /end MEASUREMENT
/begin MEASUREMENT B_belsv2 "Bedingung Bandende-Funktionsanforderung elktr. Diag. Lambda-Sonde vor KAT Bank2" UWORD B_TRUE 1 100 0 1 BIT_MASK 0x20 FORMAT "%13.11" ECU_ADDRESS 0x3FDDDA /end MEASUREMENT
/begin MEASUREMENT B_bemd "Bedingung Bandende-Funktionsanforderung Erkennung mehrfacher Aussetzer" UWORD B_TRUE 1 100 0 1 BIT_MASK 0x20 FORMAT "%13.11" ECU_ADDRESS 0x3FDDE0 /end MEASUREMENT
/begin MEASUREMENT B_bemd00 "Bedingung Bandende-Funktionsanforderung" UWORD B_TRUE 1 100 0 1 BIT_MASK 0x20 FORMAT "%13.11" ECU_ADDRESS 0x3FDDE2 /end MEASUREMENT
/begin MEASUREMENT B_bemd01 "Bedingung Bandende-Funktionsanforderung" UWORD B_TRUE 1 100 0 1 BIT_MASK 0x20 FORMAT "%13.11" ECU_ADDRESS 0x3FDDE4 /end MEASUREMENT
/begin MEASUREMENT B_bemd02 "Bedingung Bandende-Funktionsanforderung" UWORD B_TRUE 1 100 0 1 BIT_MASK 0x20 FORMAT "%13.11" ECU_ADDRESS 0x3FDDE6 /end MEASUREMENT
/begin MEASUREMENT B_bemd03 "Bedingung Bandende-Funktionsanforderung" UWORD B_TRUE 1 100 0 1 BIT_MASK 0x20 FORMAT "%13.11" ECU_ADDRESS 0x3FDDE8 /end MEASUREMENT
/begin MEASUREMENT B_bemd04 "" UWORD B_TRUE 1 100 0 1 BIT_MASK 0x20 FORMAT "%13.11" ECU_ADDRESS 0x3FDDEA /end MEASUREMENT
/begin MEASUREMENT B_bemd05 "" UWORD B_TRUE 1 100 0 1 BIT_MASK 0x20 FORMAT "%13.11" ECU_ADDRESS 0x3FDDEC /end MEASUREMENT
/begin MEASUREMENT B_bemd06 "" UWORD B_TRUE 1 100 0 1 BIT_MASK 0x20 FORMAT "%13.11" ECU_ADDRESS 0x3FDDEE /end MEASUREMENT
/begin MEASUREMENT B_bemd07 "" UWORD B_TRUE 1 100 0 1 BIT_MASK 0x20 FORMAT "%13.11" ECU_ADDRESS 0x3FDDF0 /end MEASUREMENT
/begin MEASUREMENT B_bemd08 "" UWORD B_TRUE 1 100 0 1 BIT_MASK 0x20 FORMAT "%13.11" ECU_ADDRESS 0x3FDDF2 /end MEASUREMENT
/begin MEASUREMENT B_bemd09 "" UWORD B_TRUE 1 100 0 1 BIT_MASK 0x20 FORMAT "%13.11" ECU_ADDRESS 0x3FDDF4 /end MEASUREMENT
/begin MEASUREMENT B_bemd10 "" UWORD B_TRUE 1 100 0 1 BIT_MASK 0x20 FORMAT "%13.11" ECU_ADDRESS 0x3FDDF6 /end MEASUREMENT
/begin MEASUREMENT B_bemd11 "" UWORD B_TRUE 1 100 0 1 BIT_MASK 0x20 FORMAT "%13.11" ECU_ADDRESS 0x3FDDF8 /end MEASUREMENT
/begin MEASUREMENT B_bemle "Bedingung Bandendeanforderung f¸r Fehler Endstufe Motorl¸fter" UWORD B_TRUE 1 100 0 1 BIT_MASK 0x20 FORMAT "%13.11" ECU_ADDRESS 0x3FDE00 /end MEASUREMENT
/begin MEASUREMENT B_benvrbup "Bedingung Bandende-Funktionsanforderung NVRAM-Backup-Diagnose" UWORD B_TRUE 1 100 0 1 BIT_MASK 0x20 FORMAT "%13.11" ECU_ADDRESS 0x3FDE04 /end MEASUREMENT
/begin MEASUREMENT B_beph "Bedingung: Bandendefunktionanford. f¸r Phasengeber" UWORD B_TRUE 1 100 0 1 BIT_MASK 0x20 FORMAT "%13.11" ECU_ADDRESS 0x3FDE0A /end MEASUREMENT
/begin MEASUREMENT B_beph2 "Bedingung: Bandendefunktionanford. f¸r Phasengeber 2" UWORD B_TRUE 1 100 0 1 BIT_MASK 0x20 FORMAT "%13.11" ECU_ADDRESS 0x3FDE0C /end MEASUREMENT
/begin MEASUREMENT B_beph3 "Bedingung: Bandendefunktionanford. f¸r Phasengeber 3" UWORD B_TRUE 1 100 0 1 BIT_MASK 0x20 FORMAT "%13.11" ECU_ADDRESS 0x3FDE0E /end MEASUREMENT
/begin MEASUREMENT B_beph4 "Bedingung: Bandendefunktionanford. f¸r Phasengeber 4" UWORD B_TRUE 1 100 0 1 BIT_MASK 0x20 FORMAT "%13.11" ECU_ADDRESS 0x3FDE10 /end MEASUREMENT
/begin MEASUREMENT B_bephm "Bedingung: Bandendefunktionanford. f¸r Phasengeber MIL" UWORD B_TRUE 1 100 0 1 BIT_MASK 0x20 FORMAT "%13.11" ECU_ADDRESS 0x3FDE12 /end MEASUREMENT
/begin MEASUREMENT B_berkat "Bedingung: Bandendefunktionanford. f¸r RKAT" UWORD B_TRUE 1 100 0 1 BIT_MASK 0x20 FORMAT "%13.11" ECU_ADDRESS 0x3FDE14 /end MEASUREMENT
/begin MEASUREMENT B_berkaz "Bedingung: Bandendefunktionanford. f¸r RKAZ" UWORD B_TRUE 1 100 0 1 BIT_MASK 0x20 FORMAT "%13.11" ECU_ADDRESS 0x3FDE16 /end MEASUREMENT
/begin MEASUREMENT B_beslpe "Bedingung Bandendeanforderung setzt Fehler Sekund‰rluftpumpe Endstufe" UWORD B_TRUE 1 100 0 1 BIT_MASK 0x20 FORMAT "%13.11" ECU_ADDRESS 0x3FDE18 /end MEASUREMENT
/begin MEASUREMENT B_besls "Bedingung Bandende-Funktionsanforderung Sekund‰rluftsystem" UWORD B_TRUE 1 100 0 1 BIT_MASK 0x20 FORMAT "%13.11" ECU_ADDRESS 0x3FDE1A /end MEASUREMENT
/begin MEASUREMENT B_beslv "Bedingung Bandende-Funktionsanforderung SLS" UWORD B_TRUE 1 100 0 1 BIT_MASK 0x20 FORMAT "%13.11" ECU_ADDRESS 0x3FDE1C /end MEASUREMENT
/begin MEASUREMENT B_besue "Bedingung Bandendeanforderung f¸r Endstufe Saugrohrumschaltung" UWORD B_TRUE 1 100 0 1 BIT_MASK 0x20 FORMAT "%13.11" ECU_ADDRESS 0x3FDE22 /end MEASUREMENT
/begin MEASUREMENT B_beteve "Bedingung Bandendeanford. f¸r Fehler Tanentl¸ftungsventil Endstufe" UWORD B_TRUE 1 100 0 1 BIT_MASK 0x20 FORMAT "%13.11" ECU_ADDRESS 0x3FDE2A /end MEASUREMENT
/begin MEASUREMENT B_betoens "" UWORD B_TRUE 1 100 0 1 BIT_MASK 0x20 FORMAT "%13.11" ECU_ADDRESS 0x3FDE32 /end MEASUREMENT
/begin MEASUREMENT B_bkanws "Bedingung Ersatzwert aktiv: NWS (Bank1, Auslaﬂ)" UWORD B_TRUE 1 100 0 1 BIT_MASK 0x40 FORMAT "%13.11" ECU_ADDRESS 0x3FDD1C /end MEASUREMENT
/begin MEASUREMENT B_bkanwse "Bedingung Ersatzwert aktiv: NWS Endstufe (Bank1, Auslaﬂ)" UWORD B_TRUE 1 100 0 1 BIT_MASK 0x40 FORMAT "%13.11" ECU_ADDRESS 0x3FDD1E /end MEASUREMENT
/begin MEASUREMENT B_bkenws "Bedingung Ersatzwert aktiv: NWS (Einlass,Bank1)" UWORD B_TRUE 1 100 0 1 BIT_MASK 0x40 FORMAT "%13.11" ECU_ADDRESS 0x3FDD7A /end MEASUREMENT
/begin MEASUREMENT B_bkenwse "Bedingung Ersatzwert aktiv: NWS Endstufe (Bank1, Einlaﬂ)" UWORD B_TRUE 1 100 0 1 BIT_MASK 0x40 FORMAT "%13.11" ECU_ADDRESS 0x3FDD7C /end MEASUREMENT
/begin MEASUREMENT B_bkfrao "Ersatzwert f¸r FRAO aktiv" UWORD B_TRUE 1 100 0 1 BIT_MASK 0x40 FORMAT "%13.11" ECU_ADDRESS 0x3FDD98 /end MEASUREMENT
/begin MEASUREMENT B_bkfrau "Ersatzwert f¸r FRAU aktiv" UWORD B_TRUE 1 100 0 1 BIT_MASK 0x40 FORMAT "%13.11" ECU_ADDRESS 0x3FDD9A /end MEASUREMENT
/begin MEASUREMENT B_bkfrst "Bedingung: LR-Abweichung" UWORD B_TRUE 1 100 0 1 BIT_MASK 0x40 FORMAT "%13.11" ECU_ADDRESS 0x3FDD9C /end MEASUREMENT
/begin MEASUREMENT B_bkkrtp "Bedingung: Klopfregelung Testimpuls aktiv" UWORD B_TRUE 1 100 0 1 BIT_MASK 0x40 FORMAT "%13.11" ECU_ADDRESS 0x3FDDB8 /end MEASUREMENT
/begin MEASUREMENT B_bkks1 "Bedingung: Klopfsensor 1 aktiv" UWORD B_TRUE 1 100 0 1 BIT_MASK 0x40 FORMAT "%13.11" ECU_ADDRESS 0x3FDDBA /end MEASUREMENT
/begin MEASUREMENT B_bkks2 "Bedingung: Klopfsensor 2 aktiv" UWORD B_TRUE 1 100 0 1 BIT_MASK 0x40 FORMAT "%13.11" ECU_ADDRESS 0x3FDDBC /end MEASUREMENT
/begin MEASUREMENT B_bkks3 "Bedingung: Klopfsensor 3 aktiv" UWORD B_TRUE 1 100 0 1 BIT_MASK 0x40 FORMAT "%13.11" ECU_ADDRESS 0x3FDDBE /end MEASUREMENT
/begin MEASUREMENT B_bkks4 "Bedingung: Klopfsensor 4 aktiv" UWORD B_TRUE 1 100 0 1 BIT_MASK 0x40 FORMAT "%13.11" ECU_ADDRESS 0x3FDDC0 /end MEASUREMENT
/begin MEASUREMENT B_bkkuppl "Ersatzwert aktiv" UWORD B_TRUE 1 100 0 1 BIT_MASK 0x40 FORMAT "%13.11" ECU_ADDRESS 0x3FDDC2 /end MEASUREMENT
/begin MEASUREMENT B_bklash "Bedingung: Lambdasondenalterung hinter Kat." UWORD B_TRUE 1 100 0 1 BIT_MASK 0x40 FORMAT "%13.11" ECU_ADDRESS 0x3FDDC4 /end MEASUREMENT
/begin MEASUREMENT B_bklatp "Bedingung: Lambdasonde Alterungs-Diag. vor Kat. aktiv" UWORD B_TRUE 1 100 0 1 BIT_MASK 0x40 FORMAT "%13.11" ECU_ADDRESS 0x3FDDC6 /end MEASUREMENT
/begin MEASUREMENT B_bklatv "Bedingung: Lambdasonde Alterungs-Diag. vor Kat. aktiv" UWORD B_TRUE 1 100 0 1 BIT_MASK 0x40 FORMAT "%13.11" ECU_ADDRESS 0x3FDDC8 /end MEASUREMENT
/begin MEASUREMENT B_bklatv2 "Bedingung: Lambdasonde Alterungs-Diag. vor Kat. aktiv Bank2" UWORD B_TRUE 1 100 0 1 BIT_MASK 0x40 FORMAT "%13.11" ECU_ADDRESS 0x3FDDCA /end MEASUREMENT
/begin MEASUREMENT B_bkllr "Bedingung: Leerlaufregelung aktiv" UWORD B_TRUE 1 100 0 1 BIT_MASK 0x40 FORMAT "%13.11" ECU_ADDRESS 0x3FDDD2 /end MEASUREMENT
/begin MEASUREMENT B_bklsh "Bedingung: Lambdasonde hinter Kat. aktiv" UWORD B_TRUE 1 100 0 1 BIT_MASK 0x40 FORMAT "%13.11" ECU_ADDRESS 0x3FDDD6 /end MEASUREMENT
/begin MEASUREMENT B_bklsv "Bedingung: Lambdasonde vor Kat. aktiv" UWORD B_TRUE 1 100 0 1 BIT_MASK 0x40 FORMAT "%13.11" ECU_ADDRESS 0x3FDDD8 /end MEASUREMENT
/begin MEASUREMENT B_bklsv2 "Bedingung: Lambdasonde vor Kat. aktiv Bank2" UWORD B_TRUE 1 100 0 1 BIT_MASK 0x40 FORMAT "%13.11" ECU_ADDRESS 0x3FDDDA /end MEASUREMENT
/begin MEASUREMENT B_bkmd "Flag f¸r Ersatzwert: Aussetzer, Summenfehler (multiple)" UWORD B_TRUE 1 100 0 1 BIT_MASK 0x40 FORMAT "%13.11" ECU_ADDRESS 0x3FDDE0 /end MEASUREMENT
/begin MEASUREMENT B_bkmd00 "Flag f¸r Ersatzwert: Aussetzer Z¸ndung 0" UWORD B_TRUE 1 100 0 1 BIT_MASK 0x40 FORMAT "%13.11" ECU_ADDRESS 0x3FDDE2 /end MEASUREMENT
/begin MEASUREMENT B_bkmd01 "Flag f¸r Ersatzwert: Aussetzer Z¸ndung 1" UWORD B_TRUE 1 100 0 1 BIT_MASK 0x40 FORMAT "%13.11" ECU_ADDRESS 0x3FDDE4 /end MEASUREMENT
/begin MEASUREMENT B_bkmd02 "Flag f¸r Ersatzwert: Aussetzer Z¸ndung 2" UWORD B_TRUE 1 100 0 1 BIT_MASK 0x40 FORMAT "%13.11" ECU_ADDRESS 0x3FDDE6 /end MEASUREMENT
/begin MEASUREMENT B_bkmd03 "Flag f¸r Ersatzwert: Aussetzer Z¸ndung 3" UWORD B_TRUE 1 100 0 1 BIT_MASK 0x40 FORMAT "%13.11" ECU_ADDRESS 0x3FDDE8 /end MEASUREMENT
/begin MEASUREMENT B_bkmd04 "Flag f¸r Ersatzwert: Aussetzer Z¸ndung 4" UWORD B_TRUE 1 100 0 1 BIT_MASK 0x40 FORMAT "%13.11" ECU_ADDRESS 0x3FDDEA /end MEASUREMENT
/begin MEASUREMENT B_bkmd05 "Flag f¸r Ersatzwert: Aussetzer Z¸ndung 5" UWORD B_TRUE 1 100 0 1 BIT_MASK 0x40 FORMAT "%13.11" ECU_ADDRESS 0x3FDDEC /end MEASUREMENT
/begin MEASUREMENT B_bkmd06 "Flag f¸r Ersatzwert: Aussetzer Z¸ndung 6" UWORD B_TRUE 1 100 0 1 BIT_MASK 0x40 FORMAT "%13.11" ECU_ADDRESS 0x3FDDEE /end MEASUREMENT
/begin MEASUREMENT B_bkmd07 "Flag f¸r Ersatzwert: Aussetzer Z¸ndung 7" UWORD B_TRUE 1 100 0 1 BIT_MASK 0x40 FORMAT "%13.11" ECU_ADDRESS 0x3FDDF0 /end MEASUREMENT
/begin MEASUREMENT B_bkmd08 "Flag f¸r Ersatzwert: Aussetzer Z¸ndung 8" UWORD B_TRUE 1 100 0 1 BIT_MASK 0x40 FORMAT "%13.11" ECU_ADDRESS 0x3FDDF2 /end MEASUREMENT
/begin MEASUREMENT B_bkmd09 "Flag f¸r Ersatzwert: Aussetzer Z¸ndung 9" UWORD B_TRUE 1 100 0 1 BIT_MASK 0x40 FORMAT "%13.11" ECU_ADDRESS 0x3FDDF4 /end MEASUREMENT
/begin MEASUREMENT B_bkmd10 "Flag f¸r Ersatzwert: Aussetzer Z¸ndung 10" UWORD B_TRUE 1 100 0 1 BIT_MASK 0x40 FORMAT "%13.11" ECU_ADDRESS 0x3FDDF6 /end MEASUREMENT
/begin MEASUREMENT B_bkmd11 "Flag f¸r Ersatzwert: Aussetzer Z¸ndung 11" UWORD B_TRUE 1 100 0 1 BIT_MASK 0x40 FORMAT "%13.11" ECU_ADDRESS 0x3FDDF8 /end MEASUREMENT
/begin MEASUREMENT B_bkmle "Bedingung Ersatzwert aktiv Motorl¸fter" UWORD B_TRUE 1 100 0 1 BIT_MASK 0x40 FORMAT "%13.11" ECU_ADDRESS 0x3FDE00 /end MEASUREMENT
/begin MEASUREMENT B_bknvrbup "Bedingung Ersatzwert aktiv NVRAM-Backup-Diagnose" UWORD B_TRUE 1 100 0 1 BIT_MASK 0x40 FORMAT "%13.11" ECU_ADDRESS 0x3FDE04 /end MEASUREMENT
/begin MEASUREMENT B_bkph "Bedingung: Phasengeber aktiv" UWORD B_TRUE 1 100 0 1 BIT_MASK 0x40 FORMAT "%13.11" ECU_ADDRESS 0x3FDE0A /end MEASUREMENT
/begin MEASUREMENT B_bkph2 "Bedingung: Phasengeber Bank 2 aktiv" UWORD B_TRUE 1 100 0 1 BIT_MASK 0x40 FORMAT "%13.11" ECU_ADDRESS 0x3FDE0C /end MEASUREMENT
/begin MEASUREMENT B_bkph3 "Bedingung: Phasengeber 3 aktiv" UWORD B_TRUE 1 100 0 1 BIT_MASK 0x40 FORMAT "%13.11" ECU_ADDRESS 0x3FDE0E /end MEASUREMENT
/begin MEASUREMENT B_bkph4 "Bedingung: Phasengeber 4 aktiv" UWORD B_TRUE 1 100 0 1 BIT_MASK 0x40 FORMAT "%13.11" ECU_ADDRESS 0x3FDE10 /end MEASUREMENT
/begin MEASUREMENT B_bkphm "Bedingung: Phasengeber MIL aktiv" UWORD B_TRUE 1 100 0 1 BIT_MASK 0x40 FORMAT "%13.11" ECU_ADDRESS 0x3FDE12 /end MEASUREMENT
/begin MEASUREMENT B_bkrkat "Ersatzwert f¸r RKAT aktiv" UWORD B_TRUE 1 100 0 1 BIT_MASK 0x40 FORMAT "%13.11" ECU_ADDRESS 0x3FDE14 /end MEASUREMENT
/begin MEASUREMENT B_bkrkaz "Ersatzwert f¸r RKAZ aktiv" UWORD B_TRUE 1 100 0 1 BIT_MASK 0x40 FORMAT "%13.11" ECU_ADDRESS 0x3FDE16 /end MEASUREMENT
/begin MEASUREMENT B_bkslpe "Bedingung: Sekund‰rluftpumpe ( Endstufe) aktiv" UWORD B_TRUE 1 100 0 1 BIT_MASK 0x40 FORMAT "%13.11" ECU_ADDRESS 0x3FDE18 /end MEASUREMENT
/begin MEASUREMENT B_bksls "Bedingung: Sekund‰rluftsystem aktiv" UWORD B_TRUE 1 100 0 1 BIT_MASK 0x40 FORMAT "%13.11" ECU_ADDRESS 0x3FDE1A /end MEASUREMENT
/begin MEASUREMENT B_bkslv "Bedingung: Sekund‰rluftventil aktiv" UWORD B_TRUE 1 100 0 1 BIT_MASK 0x40 FORMAT "%13.11" ECU_ADDRESS 0x3FDE1C /end MEASUREMENT
/begin MEASUREMENT B_bksue "Bedingung: Ersatzwert Saugrohrumschaltung Endstufe aktiv" UWORD B_TRUE 1 100 0 1 BIT_MASK 0x40 FORMAT "%13.11" ECU_ADDRESS 0x3FDE22 /end MEASUREMENT
/begin MEASUREMENT B_bkteve "Bedingung: Tankentl¸ftungsventil Endstufe aktiv" UWORD B_TRUE 1 100 0 1 BIT_MASK 0x40 FORMAT "%13.11" ECU_ADDRESS 0x3FDE2A /end MEASUREMENT
/begin MEASUREMENT B_bktoens "" UWORD B_TRUE 1 100 0 1 BIT_MASK 0x40 FORMAT "%13.11" ECU_ADDRESS 0x3FDE32 /end MEASUREMENT
/begin MEASUREMENT B_clanws "Bedingung Fehlerpfad Nockenwellensteuerung (Auslaﬂ,Bank1) lˆschen" UWORD B_TRUE 1 100 0 1 BIT_MASK 0x80 FORMAT "%13.11" ECU_ADDRESS 0x3FDD1C /end MEASUREMENT
/begin MEASUREMENT B_clanwse "Bedingung Fehlerpfad Nockenwellensteuerung Endstufe lˆschen (Bank1,Auslaﬂ)" UWORD B_TRUE 1 100 0 1 BIT_MASK 0x80 FORMAT "%13.11" ECU_ADDRESS 0x3FDD1E /end MEASUREMENT
/begin MEASUREMENT B_clenws "Bedingung Fehlerpfad Nockenwellensteuerung (Einlaﬂ,Bank1) lˆschen" UWORD B_TRUE 1 100 0 1 BIT_MASK 0x80 FORMAT "%13.11" ECU_ADDRESS 0x3FDD7A /end MEASUREMENT
/begin MEASUREMENT B_clenwse "Bedingung Fehlerpfad Nockenwellensteuerung Endstufe lˆschen (Bank1,Einlaﬂ)" UWORD B_TRUE 1 100 0 1 BIT_MASK 0x80 FORMAT "%13.11" ECU_ADDRESS 0x3FDD7C /end MEASUREMENT
/begin MEASUREMENT B_clfrao "Bedingung Fehlerpfad FRAO lˆschen (obere Multipl. Bereich)" UWORD B_TRUE 1 100 0 1 BIT_MASK 0x80 FORMAT "%13.11" ECU_ADDRESS 0x3FDD98 /end MEASUREMENT
/begin MEASUREMENT B_clfrau "Bedingung Fehlerpfad FRAU lˆschen (untere Multipl. Bereich)" UWORD B_TRUE 1 100 0 1 BIT_MASK 0x80 FORMAT "%13.11" ECU_ADDRESS 0x3FDD9A /end MEASUREMENT
/begin MEASUREMENT B_clfrst "Bedingung Fehlerpfad FRST lˆschen (Kurztest)" UWORD B_TRUE 1 100 0 1 BIT_MASK 0x80 FORMAT "%13.11" ECU_ADDRESS 0x3FDD9C /end MEASUREMENT
/begin MEASUREMENT B_clkrtp "Bedingung Fehlerpfad KR-Diagnose Testimpuls lˆschen" UWORD B_TRUE 1 100 0 1 BIT_MASK 0x80 FORMAT "%13.11" ECU_ADDRESS 0x3FDDB8 /end MEASUREMENT
/begin MEASUREMENT B_clks1 "Bedingung: Fehlerpfad lˆschen, Klopfsensor 1" UWORD B_TRUE 1 100 0 1 BIT_MASK 0x80 FORMAT "%13.11" ECU_ADDRESS 0x3FDDBA /end MEASUREMENT
/begin MEASUREMENT B_clks2 "Bedingung: Fehlerpfad lˆschen, Klopfsensor 2" UWORD B_TRUE 1 100 0 1 BIT_MASK 0x80 FORMAT "%13.11" ECU_ADDRESS 0x3FDDBC /end MEASUREMENT
/begin MEASUREMENT B_clks3 "Bedingung: Fehlerpfad lˆschen, Klopfsensor 3" UWORD B_TRUE 1 100 0 1 BIT_MASK 0x80 FORMAT "%13.11" ECU_ADDRESS 0x3FDDBE /end MEASUREMENT
/begin MEASUREMENT B_clks4 "Bedingung: Fehlerpfad lˆschen, Klopfsensor 4" UWORD B_TRUE 1 100 0 1 BIT_MASK 0x80 FORMAT "%13.11" ECU_ADDRESS 0x3FDDC0 /end MEASUREMENT
/begin MEASUREMENT B_clkuppl "Bedingung: Fehlerpfad KUPPL (Gebergrˆﬂe Kupplung) lˆschen" UWORD B_TRUE 1 100 0 1 BIT_MASK 0x80 FORMAT "%13.11" ECU_ADDRESS 0x3FDDC2 /end MEASUREMENT
/begin MEASUREMENT B_cllash "Fehlerpfad in DLSAHK lˆschen." UWORD B_TRUE 1 100 0 1 BIT_MASK 0x80 FORMAT "%13.11" ECU_ADDRESS 0x3FDDC4 /end MEASUREMENT
/begin MEASUREMENT B_cllatp "Fehlerpfad in DLSA lˆschen." UWORD B_TRUE 1 100 0 1 BIT_MASK 0x80 FORMAT "%13.11" ECU_ADDRESS 0x3FDDC6 /end MEASUREMENT
/begin MEASUREMENT B_cllatv "Fehlerpfad in DLSA lˆschen." UWORD B_TRUE 1 100 0 1 BIT_MASK 0x80 FORMAT "%13.11" ECU_ADDRESS 0x3FDDC8 /end MEASUREMENT
/begin MEASUREMENT B_cllatv2 "Fehlerpfad in DLSA lˆschen. Bank2" UWORD B_TRUE 1 100 0 1 BIT_MASK 0x80 FORMAT "%13.11" ECU_ADDRESS 0x3FDDCA /end MEASUREMENT
/begin MEASUREMENT B_clllr "Bedingung Fehlerpfad DLLR lˆschen" UWORD B_TRUE 1 100 0 1 BIT_MASK 0x80 FORMAT "%13.11" ECU_ADDRESS 0x3FDDD2 /end MEASUREMENT
/begin MEASUREMENT B_cllsh "Fehlerpfad in DLSH lˆschen" UWORD B_TRUE 1 100 0 1 BIT_MASK 0x80 FORMAT "%13.11" ECU_ADDRESS 0x3FDDD6 /end MEASUREMENT
/begin MEASUREMENT B_cllsv "Fehlerpfad in DLSV lˆschen." UWORD B_TRUE 1 100 0 1 BIT_MASK 0x80 FORMAT "%13.11" ECU_ADDRESS 0x3FDDD8 /end MEASUREMENT
/begin MEASUREMENT B_cllsv2 "Fehlerpfad in DLSV lˆschen.  Bank2" UWORD B_TRUE 1 100 0 1 BIT_MASK 0x80 FORMAT "%13.11" ECU_ADDRESS 0x3FDDDA /end MEASUREMENT
/begin MEASUREMENT B_clmd "Flag f¸r Lˆschung: Aussetzer, Summenfehler (multiple)" UWORD B_TRUE 1 100 0 1 BIT_MASK 0x80 FORMAT "%13.11" ECU_ADDRESS 0x3FDDE0 /end MEASUREMENT
/begin MEASUREMENT B_clmd00 "Flag f¸r Lˆschung: Aussetzer Z¸ndung 0" UWORD B_TRUE 1 100 0 1 BIT_MASK 0x80 FORMAT "%13.11" ECU_ADDRESS 0x3FDDE2 /end MEASUREMENT
/begin MEASUREMENT B_clmd01 "Flag f¸r Lˆschung: Aussetzer Z¸ndung 1" UWORD B_TRUE 1 100 0 1 BIT_MASK 0x80 FORMAT "%13.11" ECU_ADDRESS 0x3FDDE4 /end MEASUREMENT
/begin MEASUREMENT B_clmd02 "Flag f¸r Lˆschung: Aussetzer Z¸ndung 2" UWORD B_TRUE 1 100 0 1 BIT_MASK 0x80 FORMAT "%13.11" ECU_ADDRESS 0x3FDDE6 /end MEASUREMENT
/begin MEASUREMENT B_clmd03 "Flag f¸r Lˆschung: Aussetzer Z¸ndung 3" UWORD B_TRUE 1 100 0 1 BIT_MASK 0x80 FORMAT "%13.11" ECU_ADDRESS 0x3FDDE8 /end MEASUREMENT
/begin MEASUREMENT B_clmd04 "Flag f¸r Lˆschung: Aussetzer Z¸ndung 4" UWORD B_TRUE 1 100 0 1 BIT_MASK 0x80 FORMAT "%13.11" ECU_ADDRESS 0x3FDDEA /end MEASUREMENT
/begin MEASUREMENT B_clmd05 "Flag f¸r Lˆschung: Aussetzer Z¸ndung 5" UWORD B_TRUE 1 100 0 1 BIT_MASK 0x80 FORMAT "%13.11" ECU_ADDRESS 0x3FDDEC /end MEASUREMENT
/begin MEASUREMENT B_clmd06 "Flag f¸r Lˆschung: Aussetzer Z¸ndung 6" UWORD B_TRUE 1 100 0 1 BIT_MASK 0x80 FORMAT "%13.11" ECU_ADDRESS 0x3FDDEE /end MEASUREMENT
/begin MEASUREMENT B_clmd07 "Flag f¸r Lˆschung: Aussetzer Z¸ndung 7" UWORD B_TRUE 1 100 0 1 BIT_MASK 0x80 FORMAT "%13.11" ECU_ADDRESS 0x3FDDF0 /end MEASUREMENT
/begin MEASUREMENT B_clmd08 "Flag f¸r Lˆschung: Aussetzer Z¸ndung 8" UWORD B_TRUE 1 100 0 1 BIT_MASK 0x80 FORMAT "%13.11" ECU_ADDRESS 0x3FDDF2 /end MEASUREMENT
/begin MEASUREMENT B_clmd09 "Flag f¸r Lˆschung: Aussetzer Z¸ndung 9" UWORD B_TRUE 1 100 0 1 BIT_MASK 0x80 FORMAT "%13.11" ECU_ADDRESS 0x3FDDF4 /end MEASUREMENT
/begin MEASUREMENT B_clmd10 "Flag f¸r Lˆschung: Aussetzer Z¸ndung 10" UWORD B_TRUE 1 100 0 1 BIT_MASK 0x80 FORMAT "%13.11" ECU_ADDRESS 0x3FDDF6 /end MEASUREMENT
/begin MEASUREMENT B_clmd11 "Flag f¸r Lˆschung: Aussetzer Z¸ndung 11" UWORD B_TRUE 1 100 0 1 BIT_MASK 0x80 FORMAT "%13.11" ECU_ADDRESS 0x3FDDF8 /end MEASUREMENT
/begin MEASUREMENT B_clmle "Bedingung: Fehlerpfad Endstufe Motor L¸fter lˆschen" UWORD B_TRUE 1 100 0 1 BIT_MASK 0x80 FORMAT "%13.11" ECU_ADDRESS 0x3FDE00 /end MEASUREMENT
/begin MEASUREMENT B_clnvrbup "" UWORD B_TRUE 1 100 0 1 BIT_MASK 0x80 FORMAT "%13.11" ECU_ADDRESS 0x3FDE04 /end MEASUREMENT
/begin MEASUREMENT B_clph "Bedingung Fehlerpfad PH lˆschen" UWORD B_TRUE 1 100 0 1 BIT_MASK 0x80 FORMAT "%13.11" ECU_ADDRESS 0x3FDE0A /end MEASUREMENT
/begin MEASUREMENT B_clph2 "Bedingung Fehlerpfad Phasengeber 2 lˆschen" UWORD B_TRUE 1 100 0 1 BIT_MASK 0x80 FORMAT "%13.11" ECU_ADDRESS 0x3FDE0C /end MEASUREMENT
/begin MEASUREMENT B_clph3 "Bedingung Fehlerpfad Phasengeber 3 lˆschen" UWORD B_TRUE 1 100 0 1 BIT_MASK 0x80 FORMAT "%13.11" ECU_ADDRESS 0x3FDE0E /end MEASUREMENT
/begin MEASUREMENT B_clph4 "Bedingung Fehlerpfad Phasengeber 4 lˆschen" UWORD B_TRUE 1 100 0 1 BIT_MASK 0x80 FORMAT "%13.11" ECU_ADDRESS 0x3FDE10 /end MEASUREMENT
/begin MEASUREMENT B_clphm "Bedingung Fehlerpfad Phasengeber MIL lˆschen" UWORD B_TRUE 1 100 0 1 BIT_MASK 0x80 FORMAT "%13.11" ECU_ADDRESS 0x3FDE12 /end MEASUREMENT
/begin MEASUREMENT B_clrkat "Bedingung Fehlerpfad RKAT lˆschen (add. pro Zeit)" UWORD B_TRUE 1 100 0 1 BIT_MASK 0x80 FORMAT "%13.11" ECU_ADDRESS 0x3FDE14 /end MEASUREMENT
/begin MEASUREMENT B_clrkaz "Bedingung Fehlerpfad RKAZ lˆschen (add. pro Z¸ndung)" UWORD B_TRUE 1 100 0 1 BIT_MASK 0x80 FORMAT "%13.11" ECU_ADDRESS 0x3FDE16 /end MEASUREMENT
/begin MEASUREMENT B_clslpe "Bedingung: Fehlerpfad Endstufe Sekund‰rluftpumpe lˆschen" UWORD B_TRUE 1 100 0 1 BIT_MASK 0x80 FORMAT "%13.11" ECU_ADDRESS 0x3FDE18 /end MEASUREMENT
/begin MEASUREMENT B_clsls "Bedingung: Fehler Sekund‰rluftsystem lˆschen" UWORD B_TRUE 1 100 0 1 BIT_MASK 0x80 FORMAT "%13.11" ECU_ADDRESS 0x3FDE1A /end MEASUREMENT
/begin MEASUREMENT B_clslv "Bedingung: Fehler Sekund‰rluftventil lˆschen" UWORD B_TRUE 1 100 0 1 BIT_MASK 0x80 FORMAT "%13.11" ECU_ADDRESS 0x3FDE1C /end MEASUREMENT
/begin MEASUREMENT B_clsue "Bedingung Fehlerpfad Saugrohrumschaltung-Endstufe lˆschen" UWORD B_TRUE 1 100 0 1 BIT_MASK 0x80 FORMAT "%13.11" ECU_ADDRESS 0x3FDE22 /end MEASUREMENT
/begin MEASUREMENT B_cltes "Bedingung Fehlerflag ""Tankentl¸ftungssystem offen"" lˆschen" UWORD B_TRUE 1 100 0 1 BIT_MASK 0x80 FORMAT "%13.11" ECU_ADDRESS 0x3FDE28 /end MEASUREMENT
/begin MEASUREMENT B_clteve "Bedingung Fehlerphad TEVE lˆschen" UWORD B_TRUE 1 100 0 1 BIT_MASK 0x80 FORMAT "%13.11" ECU_ADDRESS 0x3FDE2A /end MEASUREMENT
/begin MEASUREMENT B_cltoens "" UWORD B_TRUE 1 100 0 1 BIT_MASK 0x80 FORMAT "%13.11" ECU_ADDRESS 0x3FDE32 /end MEASUREMENT
/begin MEASUREMENT B_falash "" UWORD B_TRUE 1 100 0 1 BIT_MASK 0x10 FORMAT "%13.11" ECU_ADDRESS 0x3FDDC4 /end MEASUREMENT
/begin MEASUREMENT B_ftanws "Bedingung: Fehlereintrag durch Tester f¸r NWS (Auslaﬂ, Bank1)" UWORD B_TRUE 1 100 0 1 BIT_MASK 0x10 FORMAT "%13.11" ECU_ADDRESS 0x3FDD1C /end MEASUREMENT
/begin MEASUREMENT B_ftanwse "Bedingung: Fehlereintrag durch Tester f¸r NWS Endstufe (Auslaﬂ, Bank1)" UWORD B_TRUE 1 100 0 1 BIT_MASK 0x10 FORMAT "%13.11" ECU_ADDRESS 0x3FDD1E /end MEASUREMENT
/begin MEASUREMENT B_ftenws "Bedingung: Fehlereintrag durch Tester f¸r NWS (Einlaﬂ, Bank1)" UWORD B_TRUE 1 100 0 1 BIT_MASK 0x10 FORMAT "%13.11" ECU_ADDRESS 0x3FDD7A /end MEASUREMENT
/begin MEASUREMENT B_ftenwse "Bedingung: Fehlereintrag durch Tester f¸r NWS Endstufe (Einlaﬂ, Bank1)" UWORD B_TRUE 1 100 0 1 BIT_MASK 0x10 FORMAT "%13.11" ECU_ADDRESS 0x3FDD7C /end MEASUREMENT
/begin MEASUREMENT B_ftfrao "Bedingung Fehlereintrag durch Tester f¸r FRAO" UWORD B_TRUE 1 100 0 1 BIT_MASK 0x10 FORMAT "%13.11" ECU_ADDRESS 0x3FDD98 /end MEASUREMENT
/begin MEASUREMENT B_ftfrau "Bedingung Fehlereintrag durch Tester f¸r FRAU" UWORD B_TRUE 1 100 0 1 BIT_MASK 0x10 FORMAT "%13.11" ECU_ADDRESS 0x3FDD9A /end MEASUREMENT
/begin MEASUREMENT B_ftfrst "Bedingung Fehlereintrag durch Tester f¸r FRST (FR-Kurztest)" UWORD B_TRUE 1 100 0 1 BIT_MASK 0x10 FORMAT "%13.11" ECU_ADDRESS 0x3FDD9C /end MEASUREMENT
/begin MEASUREMENT B_ftkrtp "" UWORD B_TRUE 1 100 0 1 BIT_MASK 0x10 FORMAT "%13.11" ECU_ADDRESS 0x3FDDB8 /end MEASUREMENT
/begin MEASUREMENT B_ftks1 "" UWORD B_TRUE 1 100 0 1 BIT_MASK 0x10 FORMAT "%13.11" ECU_ADDRESS 0x3FDDBA /end MEASUREMENT
/begin MEASUREMENT B_ftks2 "" UWORD B_TRUE 1 100 0 1 BIT_MASK 0x10 FORMAT "%13.11" ECU_ADDRESS 0x3FDDBC /end MEASUREMENT
/begin MEASUREMENT B_ftks3 "" UWORD B_TRUE 1 100 0 1 BIT_MASK 0x10 FORMAT "%13.11" ECU_ADDRESS 0x3FDDBE /end MEASUREMENT
/begin MEASUREMENT B_ftks4 "" UWORD B_TRUE 1 100 0 1 BIT_MASK 0x10 FORMAT "%13.11" ECU_ADDRESS 0x3FDDC0 /end MEASUREMENT
/begin MEASUREMENT B_ftkuppl "Bedingung: Fehlereintrag durch Tester f¸r Kupplungssensor" UWORD B_TRUE 1 100 0 1 BIT_MASK 0x10 FORMAT "%13.11" ECU_ADDRESS 0x3FDDC2 /end MEASUREMENT
/begin MEASUREMENT B_ftlatp "Bedingung Fehlereintrag durch Tester Lambda Sonde vor KAT" UWORD B_TRUE 1 100 0 1 BIT_MASK 0x10 FORMAT "%13.11" ECU_ADDRESS 0x3FDDC6 /end MEASUREMENT
/begin MEASUREMENT B_ftlatv "Bedingung Fehlereintrag durch Tester Lambda Sonde vor KAT" UWORD B_TRUE 1 100 0 1 BIT_MASK 0x10 FORMAT "%13.11" ECU_ADDRESS 0x3FDDC8 /end MEASUREMENT
/begin MEASUREMENT B_ftlatv2 "Bedingung Fehlereintrag durch Tester Lambda Sonde vor KAT Bank2" UWORD B_TRUE 1 100 0 1 BIT_MASK 0x10 FORMAT "%13.11" ECU_ADDRESS 0x3FDDCA /end MEASUREMENT
/begin MEASUREMENT B_ftllr "" UWORD B_TRUE 1 100 0 1 BIT_MASK 0x10 FORMAT "%13.11" ECU_ADDRESS 0x3FDDD2 /end MEASUREMENT
/begin MEASUREMENT B_ftlsh "Bedingung Fehlereintrag durch Tester Lambda Sonde hinter KAT" UWORD B_TRUE 1 100 0 1 BIT_MASK 0x10 FORMAT "%13.11" ECU_ADDRESS 0x3FDDD6 /end MEASUREMENT
/begin MEASUREMENT B_ftlsv "Bedingung Fehlereintrag durch Tester Lambda Sonde vor KAT" UWORD B_TRUE 1 100 0 1 BIT_MASK 0x10 FORMAT "%13.11" ECU_ADDRESS 0x3FDDD8 /end MEASUREMENT
/begin MEASUREMENT B_ftlsv2 "Bedingung Fehlereintrag durch Tester Lambda Sonde vor KAT Bank2" UWORD B_TRUE 1 100 0 1 BIT_MASK 0x10 FORMAT "%13.11" ECU_ADDRESS 0x3FDDDA /end MEASUREMENT
/begin MEASUREMENT B_ftmd "Bedingung: Fehlereintrag durch Tester f¸r MD" UWORD B_TRUE 1 100 0 1 BIT_MASK 0x10 FORMAT "%13.11" ECU_ADDRESS 0x3FDDE0 /end MEASUREMENT
/begin MEASUREMENT B_ftmd00 "" UWORD B_TRUE 1 100 0 1 BIT_MASK 0x10 FORMAT "%13.11" ECU_ADDRESS 0x3FDDE2 /end MEASUREMENT
/begin MEASUREMENT B_ftmd01 "" UWORD B_TRUE 1 100 0 1 BIT_MASK 0x10 FORMAT "%13.11" ECU_ADDRESS 0x3FDDE4 /end MEASUREMENT
/begin MEASUREMENT B_ftmd02 "" UWORD B_TRUE 1 100 0 1 BIT_MASK 0x10 FORMAT "%13.11" ECU_ADDRESS 0x3FDDE6 /end MEASUREMENT
/begin MEASUREMENT B_ftmd03 "" UWORD B_TRUE 1 100 0 1 BIT_MASK 0x10 FORMAT "%13.11" ECU_ADDRESS 0x3FDDE8 /end MEASUREMENT
/begin MEASUREMENT B_ftmd04 "" UWORD B_TRUE 1 100 0 1 BIT_MASK 0x10 FORMAT "%13.11" ECU_ADDRESS 0x3FDDEA /end MEASUREMENT
/begin MEASUREMENT B_ftmd05 "" UWORD B_TRUE 1 100 0 1 BIT_MASK 0x10 FORMAT "%13.11" ECU_ADDRESS 0x3FDDEC /end MEASUREMENT
/begin MEASUREMENT B_ftmd06 "" UWORD B_TRUE 1 100 0 1 BIT_MASK 0x10 FORMAT "%13.11" ECU_ADDRESS 0x3FDDEE /end MEASUREMENT
/begin MEASUREMENT B_ftmd07 "" UWORD B_TRUE 1 100 0 1 BIT_MASK 0x10 FORMAT "%13.11" ECU_ADDRESS 0x3FDDF0 /end MEASUREMENT
/begin MEASUREMENT B_ftmd08 "" UWORD B_TRUE 1 100 0 1 BIT_MASK 0x10 FORMAT "%13.11" ECU_ADDRESS 0x3FDDF2 /end MEASUREMENT
/begin MEASUREMENT B_ftmd09 "" UWORD B_TRUE 1 100 0 1 BIT_MASK 0x10 FORMAT "%13.11" ECU_ADDRESS 0x3FDDF4 /end MEASUREMENT
/begin MEASUREMENT B_ftmd10 "" UWORD B_TRUE 1 100 0 1 BIT_MASK 0x10 FORMAT "%13.11" ECU_ADDRESS 0x3FDDF6 /end MEASUREMENT
/begin MEASUREMENT B_ftmd11 "" UWORD B_TRUE 1 100 0 1 BIT_MASK 0x10 FORMAT "%13.11" ECU_ADDRESS 0x3FDDF8 /end MEASUREMENT
/begin MEASUREMENT B_ftmle "Bedingung: Fehlereintrag durch Tester f¸r Motorl¸fter" UWORD B_TRUE 1 100 0 1 BIT_MASK 0x10 FORMAT "%13.11" ECU_ADDRESS 0x3FDE00 /end MEASUREMENT
/begin MEASUREMENT B_ftnvrbup "Bedingung Fehlereintrag durch Tester NVRAM-Backup-Diagnose" UWORD B_TRUE 1 100 0 1 BIT_MASK 0x10 FORMAT "%13.11" ECU_ADDRESS 0x3FDE04 /end MEASUREMENT
/begin MEASUREMENT B_ftph "Bedingung Fehlereintrag durch Tester f¸r Phasensensor" UWORD B_TRUE 1 100 0 1 BIT_MASK 0x10 FORMAT "%13.11" ECU_ADDRESS 0x3FDE0A /end MEASUREMENT
/begin MEASUREMENT B_ftph2 "Bedingung: Fehlereintrag durch Tester f¸r Phasengeber 2" UWORD B_TRUE 1 100 0 1 BIT_MASK 0x10 FORMAT "%13.11" ECU_ADDRESS 0x3FDE0C /end MEASUREMENT
/begin MEASUREMENT B_ftph3 "Bedingung: Fehlereintrag durch Tester f¸r Phasengeber 3" UWORD B_TRUE 1 100 0 1 BIT_MASK 0x10 FORMAT "%13.11" ECU_ADDRESS 0x3FDE0E /end MEASUREMENT
/begin MEASUREMENT B_ftph4 "Bedingung: Fehlereintrag durch Tester f¸r Phasengeber 4" UWORD B_TRUE 1 100 0 1 BIT_MASK 0x10 FORMAT "%13.11" ECU_ADDRESS 0x3FDE10 /end MEASUREMENT
/begin MEASUREMENT B_ftphm "Bedingung: Fehlereintrag durch Tester f¸r Phasengeber MIL" UWORD B_TRUE 1 100 0 1 BIT_MASK 0x10 FORMAT "%13.11" ECU_ADDRESS 0x3FDE12 /end MEASUREMENT
/begin MEASUREMENT B_ftrkat "Bedingung Fehlereintrag durch Tester f¸r RKAT" UWORD B_TRUE 1 100 0 1 BIT_MASK 0x10 FORMAT "%13.11" ECU_ADDRESS 0x3FDE14 /end MEASUREMENT
/begin MEASUREMENT B_ftrkaz "Bedingung Fehlereintrag durch Tester f¸r RKAZ" UWORD B_TRUE 1 100 0 1 BIT_MASK 0x10 FORMAT "%13.11" ECU_ADDRESS 0x3FDE16 /end MEASUREMENT
/begin MEASUREMENT B_ftslpe "Bedingung Fehlereintrag durch Tester Sekund‰rluftpumpe Endstufe" UWORD B_TRUE 1 100 0 1 BIT_MASK 0x10 FORMAT "%13.11" ECU_ADDRESS 0x3FDE18 /end MEASUREMENT
/begin MEASUREMENT B_ftsls "Bedingung: Fehlereintrag durch Tester f¸r Katheizen" UWORD B_TRUE 1 100 0 1 BIT_MASK 0x10 FORMAT "%13.11" ECU_ADDRESS 0x3FDE1A /end MEASUREMENT
/begin MEASUREMENT B_ftslv "Bedingung: Fehlereintrag durch Tester f¸r SLV" UWORD B_TRUE 1 100 0 1 BIT_MASK 0x10 FORMAT "%13.11" ECU_ADDRESS 0x3FDE1C /end MEASUREMENT
/begin MEASUREMENT B_ftsue "Bedingung: Fehlereintrag durch Tester f¸r Endstufe Saugrohrumschaltung" UWORD B_TRUE 1 100 0 1 BIT_MASK 0x10 FORMAT "%13.11" ECU_ADDRESS 0x3FDE22 /end MEASUREMENT
/begin MEASUREMENT B_ftteve "Bedingung Fehlereintrag durch Tester Tankentl¸ftungsventil Endstufe" UWORD B_TRUE 1 100 0 1 BIT_MASK 0x10 FORMAT "%13.11" ECU_ADDRESS 0x3FDE2A /end MEASUREMENT
/begin MEASUREMENT B_fttoens "" UWORD B_TRUE 1 100 0 1 BIT_MASK 0x10 FORMAT "%13.11" ECU_ADDRESS 0x3FDE32 /end MEASUREMENT
/begin MEASUREMENT B_mnanws "Bed. Nockenwellenverstellung hat Fr¸hposition nicht erreicht (Auslaﬂ,Bank1)" UWORD B_TRUE 1 100 0 1 BIT_MASK 0x200 FORMAT "%13.11" ECU_ADDRESS 0x3FDD1C /end MEASUREMENT
/begin MEASUREMENT B_mnanwse "Fehlerart: Kurzschluﬂ Masse Nockenwellensteuerungsventil Endstufe (Bank1,Auslaﬂ)" UWORD B_TRUE 1 100 0 1 BIT_MASK 0x200 FORMAT "%13.11" ECU_ADDRESS 0x3FDD1E /end MEASUREMENT
/begin MEASUREMENT B_mnenws "Bed. Nockenwellenverstellung hat Fr¸hposition nicht erreicht (Einlaﬂ,Bank1)" UWORD B_TRUE 1 100 0 1 BIT_MASK 0x200 FORMAT "%13.11" ECU_ADDRESS 0x3FDD7A /end MEASUREMENT
/begin MEASUREMENT B_mnenwse "Fehlerart: Kurzschluﬂ Masse Nockenwellensteuerungsventil Endstufe" UWORD B_TRUE 1 100 0 1 BIT_MASK 0x200 FORMAT "%13.11" ECU_ADDRESS 0x3FDD7C /end MEASUREMENT
/begin MEASUREMENT B_mnfrao "Bedingung untere Plausibilit‰tsschwelle unterschritten (obere Multipl.)" UWORD B_TRUE 1 100 0 1 BIT_MASK 0x200 FORMAT "%13.11" ECU_ADDRESS 0x3FDD98 /end MEASUREMENT
/begin MEASUREMENT B_mnfrau "Bedingung untere Plausibilit‰tsschwelle unterschritten (untere Multipl.)" UWORD B_TRUE 1 100 0 1 BIT_MASK 0x200 FORMAT "%13.11" ECU_ADDRESS 0x3FDD9A /end MEASUREMENT
/begin MEASUREMENT B_mnfrst "Bedingung untere Plausibilit‰tsschwelle unterschritten(short test)" UWORD B_TRUE 1 100 0 1 BIT_MASK 0x200 FORMAT "%13.11" ECU_ADDRESS 0x3FDD9C /end MEASUREMENT
/begin MEASUREMENT B_mnkrtp "Fehlertyp min.: Klopfregelung Testimpuls" UWORD B_TRUE 1 100 0 1 BIT_MASK 0x200 FORMAT "%13.11" ECU_ADDRESS 0x3FDDB8 /end MEASUREMENT
/begin MEASUREMENT B_mnks1 "Bedingung: Min-Fehler Klopfsensor 1" UWORD B_TRUE 1 100 0 1 BIT_MASK 0x200 FORMAT "%13.11" ECU_ADDRESS 0x3FDDBA /end MEASUREMENT
/begin MEASUREMENT B_mnks2 "Bedingung: Min-Fehler Klopfsensor 2" UWORD B_TRUE 1 100 0 1 BIT_MASK 0x200 FORMAT "%13.11" ECU_ADDRESS 0x3FDDBC /end MEASUREMENT
/begin MEASUREMENT B_mnks3 "Bedingung: Min-Fehler Klopfsensor 3" UWORD B_TRUE 1 100 0 1 BIT_MASK 0x200 FORMAT "%13.11" ECU_ADDRESS 0x3FDDBE /end MEASUREMENT
/begin MEASUREMENT B_mnks4 "Bedingung: Min-fehler Klopfsensor 4" UWORD B_TRUE 1 100 0 1 BIT_MASK 0x200 FORMAT "%13.11" ECU_ADDRESS 0x3FDDC0 /end MEASUREMENT
/begin MEASUREMENT B_mnkuppl "Fehlertyp KUPPL: Minimalwert unterschritten" UWORD B_TRUE 1 100 0 1 BIT_MASK 0x200 FORMAT "%13.11" ECU_ADDRESS 0x3FDDC2 /end MEASUREMENT
/begin MEASUREMENT B_mnlash "Fehlertyp 'Minimalwert' f¸r Schwingungspr¸fung hinter KAT erkannt" UWORD B_TRUE 1 100 0 1 BIT_MASK 0x200 FORMAT "%13.11" ECU_ADDRESS 0x3FDDC4 /end MEASUREMENT
/begin MEASUREMENT B_mnlatp "Fehlertyp 'Minimalwert' f¸r Perioden-Dauer vor KAT erkannt" UWORD B_TRUE 1 100 0 1 BIT_MASK 0x200 FORMAT "%13.11" ECU_ADDRESS 0x3FDDC6 /end MEASUREMENT
/begin MEASUREMENT B_mnlatv "Fehlertyp 'Minimalwert' f¸r ATV-Pr¸fung vor KAT erkannt" UWORD B_TRUE 1 100 0 1 BIT_MASK 0x200 FORMAT "%13.11" ECU_ADDRESS 0x3FDDC8 /end MEASUREMENT
/begin MEASUREMENT B_mnlatv2 "Fehlertyp 'Minimalwert' f¸r ATV-Pr¸fung vor KAT erkannt Bank2" UWORD B_TRUE 1 100 0 1 BIT_MASK 0x200 FORMAT "%13.11" ECU_ADDRESS 0x3FDDCA /end MEASUREMENT
/begin MEASUREMENT B_mnllr "Fehler 'Leerlaufdrehzahl zu klein'" UWORD B_TRUE 1 100 0 1 BIT_MASK 0x200 FORMAT "%13.11" ECU_ADDRESS 0x3FDDD2 /end MEASUREMENT
/begin MEASUREMENT B_mnlsh "Fehlertyp 'Minimalwert' hinter KAT erkannt" UWORD B_TRUE 1 100 0 1 BIT_MASK 0x200 FORMAT "%13.11" ECU_ADDRESS 0x3FDDD6 /end MEASUREMENT
/begin MEASUREMENT B_mnlsv "Fehlertyp 'Minimalwert' vor KAT erkannt" UWORD B_TRUE 1 100 0 1 BIT_MASK 0x200 FORMAT "%13.11" ECU_ADDRESS 0x3FDDD8 /end MEASUREMENT
/begin MEASUREMENT B_mnlsv2 "Fehlertyp 'Minimalwert' vor KAT erkannt  Bank2" UWORD B_TRUE 1 100 0 1 BIT_MASK 0x200 FORMAT "%13.11" ECU_ADDRESS 0x3FDDDA /end MEASUREMENT
/begin MEASUREMENT B_mnmd "Fehlertyp min.: Aussetzer, Summenfehler (multiple)" UWORD B_TRUE 1 100 0 1 BIT_MASK 0x200 FORMAT "%13.11" ECU_ADDRESS 0x3FDDE0 /end MEASUREMENT
/begin MEASUREMENT B_mnmd00 "Fehlertyp min.: Aussetzer Z¸ndung 0" UWORD B_TRUE 1 100 0 1 BIT_MASK 0x200 FORMAT "%13.11" ECU_ADDRESS 0x3FDDE2 /end MEASUREMENT
/begin MEASUREMENT B_mnmd01 "Fehlertyp min.: Aussetzer Z¸ndung 1" UWORD B_TRUE 1 100 0 1 BIT_MASK 0x200 FORMAT "%13.11" ECU_ADDRESS 0x3FDDE4 /end MEASUREMENT
/begin MEASUREMENT B_mnmd02 "Fehlertyp min.: Aussetzer Z¸ndung 2" UWORD B_TRUE 1 100 0 1 BIT_MASK 0x200 FORMAT "%13.11" ECU_ADDRESS 0x3FDDE6 /end MEASUREMENT
/begin MEASUREMENT B_mnmd03 "Fehlertyp min.: Aussetzer Z¸ndung 3" UWORD B_TRUE 1 100 0 1 BIT_MASK 0x200 FORMAT "%13.11" ECU_ADDRESS 0x3FDDE8 /end MEASUREMENT
/begin MEASUREMENT B_mnmd04 "Fehlertyp min.: Aussetzer Z¸ndung 4" UWORD B_TRUE 1 100 0 1 BIT_MASK 0x200 FORMAT "%13.11" ECU_ADDRESS 0x3FDDEA /end MEASUREMENT
/begin MEASUREMENT B_mnmd05 "Fehlertyp min.: Aussetzer Z¸ndung 5" UWORD B_TRUE 1 100 0 1 BIT_MASK 0x200 FORMAT "%13.11" ECU_ADDRESS 0x3FDDEC /end MEASUREMENT
/begin MEASUREMENT B_mnmd06 "Fehlertyp min.: Aussetzer Z¸ndung 6" UWORD B_TRUE 1 100 0 1 BIT_MASK 0x200 FORMAT "%13.11" ECU_ADDRESS 0x3FDDEE /end MEASUREMENT
/begin MEASUREMENT B_mnmd07 "Fehlertyp min.: Aussetzer Z¸ndung 7" UWORD B_TRUE 1 100 0 1 BIT_MASK 0x200 FORMAT "%13.11" ECU_ADDRESS 0x3FDDF0 /end MEASUREMENT
/begin MEASUREMENT B_mnmd08 "Fehlertyp min.: Aussetzer Z¸ndung 8" UWORD B_TRUE 1 100 0 1 BIT_MASK 0x200 FORMAT "%13.11" ECU_ADDRESS 0x3FDDF2 /end MEASUREMENT
/begin MEASUREMENT B_mnmd09 "Fehlertyp min.: Aussetzer Z¸ndung 9" UWORD B_TRUE 1 100 0 1 BIT_MASK 0x200 FORMAT "%13.11" ECU_ADDRESS 0x3FDDF4 /end MEASUREMENT
/begin MEASUREMENT B_mnmd10 "Fehlertyp min.: Aussetzer Z¸ndung 10" UWORD B_TRUE 1 100 0 1 BIT_MASK 0x200 FORMAT "%13.11" ECU_ADDRESS 0x3FDDF6 /end MEASUREMENT
/begin MEASUREMENT B_mnmd11 "Fehlertyp min.: Aussetzer Z¸ndung 11" UWORD B_TRUE 1 100 0 1 BIT_MASK 0x200 FORMAT "%13.11" ECU_ADDRESS 0x3FDDF8 /end MEASUREMENT
/begin MEASUREMENT B_mnmle "Fehlertype: Kurzschluﬂ nach Masse Endstufe Motor L¸fter" UWORD B_TRUE 1 100 0 1 BIT_MASK 0x200 FORMAT "%13.11" ECU_ADDRESS 0x3FDE00 /end MEASUREMENT
/begin MEASUREMENT B_mnnvrbup "Fehlerart: NVRAM-Backup Schreib-Fehler erkannt" UWORD B_TRUE 1 100 0 1 BIT_MASK 0x200 FORMAT "%13.11" ECU_ADDRESS 0x3FDE04 /end MEASUREMENT
/begin MEASUREMENT B_mnph "Fehlerart: Kurzschluﬂ Masse Phasengeber" UWORD B_TRUE 1 100 0 1 BIT_MASK 0x200 FORMAT "%13.11" ECU_ADDRESS 0x3FDE0A /end MEASUREMENT
/begin MEASUREMENT B_mnph2 "Fehlerart: Kurzschluﬂ Masse Phasengeber 2" UWORD B_TRUE 1 100 0 1 BIT_MASK 0x200 FORMAT "%13.11" ECU_ADDRESS 0x3FDE0C /end MEASUREMENT
/begin MEASUREMENT B_mnph3 "Fehlerart: Kurzschluﬂ Masse Phasengeber 3" UWORD B_TRUE 1 100 0 1 BIT_MASK 0x200 FORMAT "%13.11" ECU_ADDRESS 0x3FDE0E /end MEASUREMENT
/begin MEASUREMENT B_mnph4 "Fehlerart: Kurzschluﬂ Masse Phasengeber 4" UWORD B_TRUE 1 100 0 1 BIT_MASK 0x200 FORMAT "%13.11" ECU_ADDRESS 0x3FDE10 /end MEASUREMENT
/begin MEASUREMENT B_mnphm "Fehlerart: Minfehler Phasengeber MIL" UWORD B_TRUE 1 100 0 1 BIT_MASK 0x200 FORMAT "%13.11" ECU_ADDRESS 0x3FDE12 /end MEASUREMENT
/begin MEASUREMENT B_mnrkat "Bedingung untere Plausibilit‰tsschwelle unterschritten (add. pro Zeit)" UWORD B_TRUE 1 100 0 1 BIT_MASK 0x200 FORMAT "%13.11" ECU_ADDRESS 0x3FDE14 /end MEASUREMENT
/begin MEASUREMENT B_mnrkaz "Bedingung untere Plausibilit‰tsschwelle unterschritten (add. pro Z¸ndung)" UWORD B_TRUE 1 100 0 1 BIT_MASK 0x200 FORMAT "%13.11" ECU_ADDRESS 0x3FDE16 /end MEASUREMENT
/begin MEASUREMENT B_mnslpe "Fehlertype: Kurzschluﬂ nach Masse Endstufe Sekund‰rluftpumpe" UWORD B_TRUE 1 100 0 1 BIT_MASK 0x200 FORMAT "%13.11" ECU_ADDRESS 0x3FDE18 /end MEASUREMENT
/begin MEASUREMENT B_mnsls "Fehlerart: Sekund‰rluftmasse zu gering" UWORD B_TRUE 1 100 0 1 BIT_MASK 0x200 FORMAT "%13.11" ECU_ADDRESS 0x3FDE1A /end MEASUREMENT
/begin MEASUREMENT B_mnslv "Fehlerart:" UWORD B_TRUE 1 100 0 1 BIT_MASK 0x200 FORMAT "%13.11" ECU_ADDRESS 0x3FDE1C /end MEASUREMENT
/begin MEASUREMENT B_mnsue "Fehlerart: Kurzschluﬂ Masse an Endstufe f¸r Saugrohrumschaltung" UWORD B_TRUE 1 100 0 1 BIT_MASK 0x200 FORMAT "%13.11" ECU_ADDRESS 0x3FDE22 /end MEASUREMENT
/begin MEASUREMENT B_mntes "Fehlertyp 'Minimalwert' erkannt" UWORD B_TRUE 1 100 0 1 BIT_MASK 0x200 FORMAT "%13.11" ECU_ADDRESS 0x3FDE28 /end MEASUREMENT
/begin MEASUREMENT B_mnteve "Fehlertyp: Kurzschluﬂ Masse Tankentl¸ftungsventil Endstufe" UWORD B_TRUE 1 100 0 1 BIT_MASK 0x200 FORMAT "%13.11" ECU_ADDRESS 0x3FDE2A /end MEASUREMENT
/begin MEASUREMENT B_mntoens "" UWORD B_TRUE 1 100 0 1 BIT_MASK 0x200 FORMAT "%13.11" ECU_ADDRESS 0x3FDE32 /end MEASUREMENT
/begin MEASUREMENT B_mxanws "Bed. Nockenwellenverstellung hat Sp‰tposition nicht erreicht (Auslaﬂ,Bank1)" UWORD B_TRUE 1 100 0 1 BIT_MASK 0x100 FORMAT "%13.11" ECU_ADDRESS 0x3FDD1C /end MEASUREMENT
/begin MEASUREMENT B_mxanwse "Fehlerart: Kurzschluﬂ Ubat Nockenwellensteuerungsventil Endstufe (Bank1, Auslaﬂ)" UWORD B_TRUE 1 100 0 1 BIT_MASK 0x100 FORMAT "%13.11" ECU_ADDRESS 0x3FDD1E /end MEASUREMENT
/begin MEASUREMENT B_mxenws "Bed. Nockenwellenverstellung hat Sp‰tposition nicht erreicht (Einlaﬂ,Bank1)" UWORD B_TRUE 1 100 0 1 BIT_MASK 0x100 FORMAT "%13.11" ECU_ADDRESS 0x3FDD7A /end MEASUREMENT
/begin MEASUREMENT B_mxenwse "Fehlerart: Kurzschluﬂ Ubat Nockenwellensteuerungsventil Endstufe" UWORD B_TRUE 1 100 0 1 BIT_MASK 0x100 FORMAT "%13.11" ECU_ADDRESS 0x3FDD7C /end MEASUREMENT
/begin MEASUREMENT B_mxfrao "Bedingung obere Plausibilit‰tsschwelle ¸berschritten (obere Multipl.)" UWORD B_TRUE 1 100 0 1 BIT_MASK 0x100 FORMAT "%13.11" ECU_ADDRESS 0x3FDD98 /end MEASUREMENT
/begin MEASUREMENT B_mxfrau "Bedingung obere Plausiblit‰tsschwelle ¸berschritten (untere Multipl.)" UWORD B_TRUE 1 100 0 1 BIT_MASK 0x100 FORMAT "%13.11" ECU_ADDRESS 0x3FDD9A /end MEASUREMENT
/begin MEASUREMENT B_mxfrst "Bedingung obere Plausiblit‰tsschwelle ¸berschritten (short test" UWORD B_TRUE 1 100 0 1 BIT_MASK 0x100 FORMAT "%13.11" ECU_ADDRESS 0x3FDD9C /end MEASUREMENT
/begin MEASUREMENT B_mxkrtp "Fehlertyp max.: Klopfregelung Testimpuls" UWORD B_TRUE 1 100 0 1 BIT_MASK 0x100 FORMAT "%13.11" ECU_ADDRESS 0x3FDDB8 /end MEASUREMENT
/begin MEASUREMENT B_mxks1 "Bedingung: Max-Fehler Klopfsensor 1" UWORD B_TRUE 1 100 0 1 BIT_MASK 0x100 FORMAT "%13.11" ECU_ADDRESS 0x3FDDBA /end MEASUREMENT
/begin MEASUREMENT B_mxks2 "Bedingung: Max-Fehler Klopfsensor 2" UWORD B_TRUE 1 100 0 1 BIT_MASK 0x100 FORMAT "%13.11" ECU_ADDRESS 0x3FDDBC /end MEASUREMENT
/begin MEASUREMENT B_mxks3 "Bedingung: Max-Fehler Klopfsensor 3" UWORD B_TRUE 1 100 0 1 BIT_MASK 0x100 FORMAT "%13.11" ECU_ADDRESS 0x3FDDBE /end MEASUREMENT
/begin MEASUREMENT B_mxks4 "Bedingung: Max-Fehler Klopfsensor 4" UWORD B_TRUE 1 100 0 1 BIT_MASK 0x100 FORMAT "%13.11" ECU_ADDRESS 0x3FDDC0 /end MEASUREMENT
/begin MEASUREMENT B_mxkuppl "Fehlertyp KUPPL: Maximalwert ¸berschritten" UWORD B_TRUE 1 100 0 1 BIT_MASK 0x100 FORMAT "%13.11" ECU_ADDRESS 0x3FDDC2 /end MEASUREMENT
/begin MEASUREMENT B_mxlash "Fehlertyp 'Maximalwert' f¸r Schwingungs-Pr¸fung hinter KAT erkannt" UWORD B_TRUE 1 100 0 1 BIT_MASK 0x100 FORMAT "%13.11" ECU_ADDRESS 0x3FDDC4 /end MEASUREMENT
/begin MEASUREMENT B_mxlatp "Fehlertyp 'Maximalwert' f¸r Periodendauer-Pr¸fung vor KAT erkannt" UWORD B_TRUE 1 100 0 1 BIT_MASK 0x100 FORMAT "%13.11" ECU_ADDRESS 0x3FDDC6 /end MEASUREMENT
/begin MEASUREMENT B_mxlatv "Fehlertyp 'Maximalwert' f¸r ATV-Pr¸fung vor KAT erkannt" UWORD B_TRUE 1 100 0 1 BIT_MASK 0x100 FORMAT "%13.11" ECU_ADDRESS 0x3FDDC8 /end MEASUREMENT
/begin MEASUREMENT B_mxlatv2 "Fehlertyp 'Maximalwert' f¸r ATV-Pr¸fung vor KAT erkannt Bank2" UWORD B_TRUE 1 100 0 1 BIT_MASK 0x100 FORMAT "%13.11" ECU_ADDRESS 0x3FDDCA /end MEASUREMENT
/begin MEASUREMENT B_mxllr "Fehler 'Leerlaufdrehzahl zu groﬂ'" UWORD B_TRUE 1 100 0 1 BIT_MASK 0x100 FORMAT "%13.11" ECU_ADDRESS 0x3FDDD2 /end MEASUREMENT
/begin MEASUREMENT B_mxlsh "Fehlertyp 'Maximalwert' hinter KAT erkannt" UWORD B_TRUE 1 100 0 1 BIT_MASK 0x100 FORMAT "%13.11" ECU_ADDRESS 0x3FDDD6 /end MEASUREMENT
/begin MEASUREMENT B_mxlsv "Fehlertyp 'Maximalwert' vor KAT erkannt" UWORD B_TRUE 1 100 0 1 BIT_MASK 0x100 FORMAT "%13.11" ECU_ADDRESS 0x3FDDD8 /end MEASUREMENT
/begin MEASUREMENT B_mxlsv2 "Fehlertyp 'Maximalwert' vor KAT erkannt Bank2" UWORD B_TRUE 1 100 0 1 BIT_MASK 0x100 FORMAT "%13.11" ECU_ADDRESS 0x3FDDDA /end MEASUREMENT
/begin MEASUREMENT B_mxmd "Fehlertyp max.: Aussetzer, Summenfehler (multiple)" UWORD B_TRUE 1 100 0 1 BIT_MASK 0x100 FORMAT "%13.11" ECU_ADDRESS 0x3FDDE0 /end MEASUREMENT
/begin MEASUREMENT B_mxmd00 "Fehlertyp max.: Aussetzer Z¸ndung 0" UWORD B_TRUE 1 100 0 1 BIT_MASK 0x100 FORMAT "%13.11" ECU_ADDRESS 0x3FDDE2 /end MEASUREMENT
/begin MEASUREMENT B_mxmd01 "Fehlertyp max.: Aussetzer Z¸ndung 1" UWORD B_TRUE 1 100 0 1 BIT_MASK 0x100 FORMAT "%13.11" ECU_ADDRESS 0x3FDDE4 /end MEASUREMENT
/begin MEASUREMENT B_mxmd02 "Fehlertyp max.: Aussetzer Z¸ndung 2" UWORD B_TRUE 1 100 0 1 BIT_MASK 0x100 FORMAT "%13.11" ECU_ADDRESS 0x3FDDE6 /end MEASUREMENT
/begin MEASUREMENT B_mxmd03 "Fehlertyp max.: Aussetzer Z¸ndung 3" UWORD B_TRUE 1 100 0 1 BIT_MASK 0x100 FORMAT "%13.11" ECU_ADDRESS 0x3FDDE8 /end MEASUREMENT
/begin MEASUREMENT B_mxmd04 "Fehlertyp max.: Aussetzer Z¸ndung 4" UWORD B_TRUE 1 100 0 1 BIT_MASK 0x100 FORMAT "%13.11" ECU_ADDRESS 0x3FDDEA /end MEASUREMENT
/begin MEASUREMENT B_mxmd05 "Fehlertyp max.: Aussetzer Z¸ndung 5" UWORD B_TRUE 1 100 0 1 BIT_MASK 0x100 FORMAT "%13.11" ECU_ADDRESS 0x3FDDEC /end MEASUREMENT
/begin MEASUREMENT B_mxmd06 "Fehlertyp max.: Aussetzer Z¸ndung 6" UWORD B_TRUE 1 100 0 1 BIT_MASK 0x100 FORMAT "%13.11" ECU_ADDRESS 0x3FDDEE /end MEASUREMENT
/begin MEASUREMENT B_mxmd07 "Fehlertyp max.: Aussetzer Z¸ndung 7" UWORD B_TRUE 1 100 0 1 BIT_MASK 0x100 FORMAT "%13.11" ECU_ADDRESS 0x3FDDF0 /end MEASUREMENT
/begin MEASUREMENT B_mxmd08 "Fehlertyp max.: Aussetzer Z¸ndung 8" UWORD B_TRUE 1 100 0 1 BIT_MASK 0x100 FORMAT "%13.11" ECU_ADDRESS 0x3FDDF2 /end MEASUREMENT
/begin MEASUREMENT B_mxmd09 "Fehlertyp max.: Aussetzer Z¸ndung 9" UWORD B_TRUE 1 100 0 1 BIT_MASK 0x100 FORMAT "%13.11" ECU_ADDRESS 0x3FDDF4 /end MEASUREMENT
/begin MEASUREMENT B_mxmd10 "Fehlertyp max.: Aussetzer Z¸ndung 10" UWORD B_TRUE 1 100 0 1 BIT_MASK 0x100 FORMAT "%13.11" ECU_ADDRESS 0x3FDDF6 /end MEASUREMENT
/begin MEASUREMENT B_mxmd11 "Fehlertyp max.: Aussetzer Z¸ndung 11" UWORD B_TRUE 1 100 0 1 BIT_MASK 0x100 FORMAT "%13.11" ECU_ADDRESS 0x3FDDF8 /end MEASUREMENT
/begin MEASUREMENT B_mxmle "Fehlertype: Kurzschluﬂ nach Ubatt Endstufe Motor L¸fter" UWORD B_TRUE 1 100 0 1 BIT_MASK 0x100 FORMAT "%13.11" ECU_ADDRESS 0x3FDE00 /end MEASUREMENT
/begin MEASUREMENT B_mxnvrbup "Fehlerart: NVRAM-Backup Lese-Fehler erkannt" UWORD B_TRUE 1 100 0 1 BIT_MASK 0x100 FORMAT "%13.11" ECU_ADDRESS 0x3FDE04 /end MEASUREMENT
/begin MEASUREMENT B_mxph "Fehlerart: Kurzschluﬂ Ubat Phasengeber" UWORD B_TRUE 1 100 0 1 BIT_MASK 0x100 FORMAT "%13.11" ECU_ADDRESS 0x3FDE0A /end MEASUREMENT
/begin MEASUREMENT B_mxph2 "Fehlerart: Kurzschluﬂ  Ubat Phasengeber 2" UWORD B_TRUE 1 100 0 1 BIT_MASK 0x100 FORMAT "%13.11" ECU_ADDRESS 0x3FDE0C /end MEASUREMENT
/begin MEASUREMENT B_mxph3 "Fehlerart: Kurzschluﬂ  Ubat Phasengeber 3" UWORD B_TRUE 1 100 0 1 BIT_MASK 0x100 FORMAT "%13.11" ECU_ADDRESS 0x3FDE0E /end MEASUREMENT
/begin MEASUREMENT B_mxph4 "Fehlerart: Kurzschluﬂ  Ubat Phasengeber 4" UWORD B_TRUE 1 100 0 1 BIT_MASK 0x100 FORMAT "%13.11" ECU_ADDRESS 0x3FDE10 /end MEASUREMENT
/begin MEASUREMENT B_mxphm "Fehlerart: Maxfehler Phasengeber MIL" UWORD B_TRUE 1 100 0 1 BIT_MASK 0x100 FORMAT "%13.11" ECU_ADDRESS 0x3FDE12 /end MEASUREMENT
/begin MEASUREMENT B_mxrkat "Bedingung obere Plausibilit‰tsschwelle ¸berschritten (add. pro Zeit)" UWORD B_TRUE 1 100 0 1 BIT_MASK 0x100 FORMAT "%13.11" ECU_ADDRESS 0x3FDE14 /end MEASUREMENT
/begin MEASUREMENT B_mxrkaz "Bedingung obere Plausibilit‰tsschwelle ¸berschritten (add. pro Z¸ndung)" UWORD B_TRUE 1 100 0 1 BIT_MASK 0x100 FORMAT "%13.11" ECU_ADDRESS 0x3FDE16 /end MEASUREMENT
/begin MEASUREMENT B_mxslpe "Fehlertype: Kurzschluﬂ nach Ubatt Endstufe Sekund‰rluftpumpe" UWORD B_TRUE 1 100 0 1 BIT_MASK 0x100 FORMAT "%13.11" ECU_ADDRESS 0x3FDE18 /end MEASUREMENT
/begin MEASUREMENT B_mxsls "Fehlerart:Sekund‰rluftsystem" UWORD B_TRUE 1 100 0 1 BIT_MASK 0x100 FORMAT "%13.11" ECU_ADDRESS 0x3FDE1A /end MEASUREMENT
/begin MEASUREMENT B_mxslv "Fehlerart: Sekund‰rluftmasse bei Ventildichtheitspr¸fung zu groﬂ" UWORD B_TRUE 1 100 0 1 BIT_MASK 0x100 FORMAT "%13.11" ECU_ADDRESS 0x3FDE1C /end MEASUREMENT
/begin MEASUREMENT B_mxsue "Fehlerart: Kurzschluﬂ Ubat an Endstufe f¸r Saugrohrumschaltung" UWORD B_TRUE 1 100 0 1 BIT_MASK 0x100 FORMAT "%13.11" ECU_ADDRESS 0x3FDE22 /end MEASUREMENT
/begin MEASUREMENT B_mxteve "Fehlertyp: Kurzschluﬂ Ubat Tankentl¸ftungsventil Endstufe" UWORD B_TRUE 1 100 0 1 BIT_MASK 0x100 FORMAT "%13.11" ECU_ADDRESS 0x3FDE2A /end MEASUREMENT
/begin MEASUREMENT B_mxtoens "" UWORD B_TRUE 1 100 0 1 BIT_MASK 0x100 FORMAT "%13.11" ECU_ADDRESS 0x3FDE32 /end MEASUREMENT
/begin MEASUREMENT B_npanws "Bed. Nockenwellenverstellung hat unplausible Position (Auslaﬂ,Bank1)" UWORD B_TRUE 1 100 0 1 BIT_MASK 0x800 FORMAT "%13.11" ECU_ADDRESS 0x3FDD1C /end MEASUREMENT
/begin MEASUREMENT B_npanwse "Fehlertyp unplaus.: Nockenwellensteuerung Endstufe (Auslaﬂ, Bank1)" UWORD B_TRUE 1 100 0 1 BIT_MASK 0x800 FORMAT "%13.11" ECU_ADDRESS 0x3FDD1E /end MEASUREMENT
/begin MEASUREMENT B_npenws "Bed. Nockenwellenverstellung hat unplausible Position (Einlaﬂ,Bank1)" UWORD B_TRUE 1 100 0 1 BIT_MASK 0x800 FORMAT "%13.11" ECU_ADDRESS 0x3FDD7A /end MEASUREMENT
/begin MEASUREMENT B_npenwse "Fehlertyp unplaus.: Nockenwellensteuerung Endstufe (Einlaﬂ, Bank1)" UWORD B_TRUE 1 100 0 1 BIT_MASK 0x800 FORMAT "%13.11" ECU_ADDRESS 0x3FDD7C /end MEASUREMENT
/begin MEASUREMENT B_npfrao "Bedingung FRAO ist unplausibel" UWORD B_TRUE 1 100 0 1 BIT_MASK 0x800 FORMAT "%13.11" ECU_ADDRESS 0x3FDD98 /end MEASUREMENT
/begin MEASUREMENT B_npfrau "Bedingung FRAU ist unplausibel" UWORD B_TRUE 1 100 0 1 BIT_MASK 0x800 FORMAT "%13.11" ECU_ADDRESS 0x3FDD9A /end MEASUREMENT
/begin MEASUREMENT B_npfrst "Fehlertyp 'unplausibles Pr¸fresultat' erkannt (DKVS Kurztest)" UWORD B_TRUE 1 100 0 1 BIT_MASK 0x800 FORMAT "%13.11" ECU_ADDRESS 0x3FDD9C /end MEASUREMENT
/begin MEASUREMENT B_npkrtp "Bedingung Plausibilit‰tsfehler der KR-Diagnose Testimpuls" UWORD B_TRUE 1 100 0 1 BIT_MASK 0x800 FORMAT "%13.11" ECU_ADDRESS 0x3FDDB8 /end MEASUREMENT
/begin MEASUREMENT B_npks1 "Nicht plausibler Fehler: Klopfsensor 1" UWORD B_TRUE 1 100 0 1 BIT_MASK 0x800 FORMAT "%13.11" ECU_ADDRESS 0x3FDDBA /end MEASUREMENT
/begin MEASUREMENT B_npks2 "Nicht plausibler Fehler: Klopfsensor 2" UWORD B_TRUE 1 100 0 1 BIT_MASK 0x800 FORMAT "%13.11" ECU_ADDRESS 0x3FDDBC /end MEASUREMENT
/begin MEASUREMENT B_npks3 "Nicht plausibler Fehler: Klopfsensor 3" UWORD B_TRUE 1 100 0 1 BIT_MASK 0x800 FORMAT "%13.11" ECU_ADDRESS 0x3FDDBE /end MEASUREMENT
/begin MEASUREMENT B_npks4 "Nicht plausibler Fehler: Klopfsensor 4" UWORD B_TRUE 1 100 0 1 BIT_MASK 0x800 FORMAT "%13.11" ECU_ADDRESS 0x3FDDC0 /end MEASUREMENT
/begin MEASUREMENT B_npkuppl "Fehlertyp KUPPL: Pr¸fresultat nicht plausibel" UWORD B_TRUE 1 100 0 1 BIT_MASK 0x800 FORMAT "%13.11" ECU_ADDRESS 0x3FDDC2 /end MEASUREMENT
/begin MEASUREMENT B_nplash "Fehlertyp 'Wert unplausibel' f¸r Schwingungs-Pr¸fung hinter KAT erkannt" UWORD B_TRUE 1 100 0 1 BIT_MASK 0x800 FORMAT "%13.11" ECU_ADDRESS 0x3FDDC4 /end MEASUREMENT
/begin MEASUREMENT B_nplatp "Fehlertyp nicht spezifiziert" UWORD B_TRUE 1 100 0 1 BIT_MASK 0x800 FORMAT "%13.11" ECU_ADDRESS 0x3FDDC6 /end MEASUREMENT
/begin MEASUREMENT B_nplatv "Fehlertyp nicht spezifiziert" UWORD B_TRUE 1 100 0 1 BIT_MASK 0x800 FORMAT "%13.11" ECU_ADDRESS 0x3FDDC8 /end MEASUREMENT
/begin MEASUREMENT B_nplatv2 "Fehlertyp nicht spezifiziert Bank2" UWORD B_TRUE 1 100 0 1 BIT_MASK 0x800 FORMAT "%13.11" ECU_ADDRESS 0x3FDDCA /end MEASUREMENT
/begin MEASUREMENT B_npllr "Nicht plausibler Fehler: Leerlaufregelung" UWORD B_TRUE 1 100 0 1 BIT_MASK 0x800 FORMAT "%13.11" ECU_ADDRESS 0x3FDDD2 /end MEASUREMENT
/begin MEASUREMENT B_nplsh "Fehlertyp 'Wert unplausibel' hinter KAT erkannt" UWORD B_TRUE 1 100 0 1 BIT_MASK 0x800 FORMAT "%13.11" ECU_ADDRESS 0x3FDDD6 /end MEASUREMENT
/begin MEASUREMENT B_nplsv "Fehlertyp 'Wert unplausibel' erkannt" UWORD B_TRUE 1 100 0 1 BIT_MASK 0x800 FORMAT "%13.11" ECU_ADDRESS 0x3FDDD8 /end MEASUREMENT
/begin MEASUREMENT B_nplsv2 "Fehlertyp 'Wert unplausibel' erkannt Bank2" UWORD B_TRUE 1 100 0 1 BIT_MASK 0x800 FORMAT "%13.11" ECU_ADDRESS 0x3FDDDA /end MEASUREMENT
/begin MEASUREMENT B_npmd "Fehlertyp unplaus.: Aussetzer, Summenfehler (multiple)" UWORD B_TRUE 1 100 0 1 BIT_MASK 0x800 FORMAT "%13.11" ECU_ADDRESS 0x3FDDE0 /end MEASUREMENT
/begin MEASUREMENT B_npmd00 "Fehlertyp unplaus.: Aussetzer Z¸ndung 0" UWORD B_TRUE 1 100 0 1 BIT_MASK 0x800 FORMAT "%13.11" ECU_ADDRESS 0x3FDDE2 /end MEASUREMENT
/begin MEASUREMENT B_npmd01 "Fehlertyp unplaus.: Aussetzer Z¸ndung 1" UWORD B_TRUE 1 100 0 1 BIT_MASK 0x800 FORMAT "%13.11" ECU_ADDRESS 0x3FDDE4 /end MEASUREMENT
/begin MEASUREMENT B_npmd02 "Fehlertyp unplaus.: Aussetzer Z¸ndung 2" UWORD B_TRUE 1 100 0 1 BIT_MASK 0x800 FORMAT "%13.11" ECU_ADDRESS 0x3FDDE6 /end MEASUREMENT
/begin MEASUREMENT B_npmd03 "Fehlertyp unplaus.: Aussetzer Z¸ndung 3" UWORD B_TRUE 1 100 0 1 BIT_MASK 0x800 FORMAT "%13.11" ECU_ADDRESS 0x3FDDE8 /end MEASUREMENT
/begin MEASUREMENT B_npmd04 "Fehlertyp unplaus.: Aussetzer Z¸ndung 4" UWORD B_TRUE 1 100 0 1 BIT_MASK 0x800 FORMAT "%13.11" ECU_ADDRESS 0x3FDDEA /end MEASUREMENT
/begin MEASUREMENT B_npmd05 "Fehlertyp unplaus.: Aussetzer Z¸ndung 5" UWORD B_TRUE 1 100 0 1 BIT_MASK 0x800 FORMAT "%13.11" ECU_ADDRESS 0x3FDDEC /end MEASUREMENT
/begin MEASUREMENT B_npmd06 "Fehlertyp unplaus.: Aussetzer Z¸ndung 6" UWORD B_TRUE 1 100 0 1 BIT_MASK 0x800 FORMAT "%13.11" ECU_ADDRESS 0x3FDDEE /end MEASUREMENT
/begin MEASUREMENT B_npmd07 "Fehlertyp unplaus.: Aussetzer Z¸ndung 7" UWORD B_TRUE 1 100 0 1 BIT_MASK 0x800 FORMAT "%13.11" ECU_ADDRESS 0x3FDDF0 /end MEASUREMENT
/begin MEASUREMENT B_npmd08 "Fehlertyp unplaus.: Aussetzer Z¸ndung 8" UWORD B_TRUE 1 100 0 1 BIT_MASK 0x800 FORMAT "%13.11" ECU_ADDRESS 0x3FDDF2 /end MEASUREMENT
/begin MEASUREMENT B_npmd09 "Fehlertyp unplaus.: Aussetzer Z¸ndung 9" UWORD B_TRUE 1 100 0 1 BIT_MASK 0x800 FORMAT "%13.11" ECU_ADDRESS 0x3FDDF4 /end MEASUREMENT
/begin MEASUREMENT B_npmd10 "Fehlertyp unplaus.: Aussetzer Z¸ndung 10" UWORD B_TRUE 1 100 0 1 BIT_MASK 0x800 FORMAT "%13.11" ECU_ADDRESS 0x3FDDF6 /end MEASUREMENT
/begin MEASUREMENT B_npmd11 "Fehlertyp unplaus.: Aussetzer Z¸ndung 11" UWORD B_TRUE 1 100 0 1 BIT_MASK 0x800 FORMAT "%13.11" ECU_ADDRESS 0x3FDDF8 /end MEASUREMENT
/begin MEASUREMENT B_npmle "Fehlertyp unplaus.: Motorl¸fter" UWORD B_TRUE 1 100 0 1 BIT_MASK 0x800 FORMAT "%13.11" ECU_ADDRESS 0x3FDE00 /end MEASUREMENT
/begin MEASUREMENT B_npnvrbup "Fehlerart NVRAM-Backup nicht plausibel (nicht verwendet)" UWORD B_TRUE 1 100 0 1 BIT_MASK 0x800 FORMAT "%13.11" ECU_ADDRESS 0x3FDE04 /end MEASUREMENT
/begin MEASUREMENT B_npph "Bedingung Phasengebersignal ist unplausibel (ph)" UWORD B_TRUE 1 100 0 1 BIT_MASK 0x800 FORMAT "%13.11" ECU_ADDRESS 0x3FDE0A /end MEASUREMENT
/begin MEASUREMENT B_npph2 "Bedingung Phasengebersignal ist unplausibel (ph2)" UWORD B_TRUE 1 100 0 1 BIT_MASK 0x800 FORMAT "%13.11" ECU_ADDRESS 0x3FDE0C /end MEASUREMENT
/begin MEASUREMENT B_npph3 "Bedingung Phasengebersignal ist unplausibel (ph3)" UWORD B_TRUE 1 100 0 1 BIT_MASK 0x800 FORMAT "%13.11" ECU_ADDRESS 0x3FDE0E /end MEASUREMENT
/begin MEASUREMENT B_npph4 "Bedingung Phasengebersignal ist unplausibel (ph4)" UWORD B_TRUE 1 100 0 1 BIT_MASK 0x800 FORMAT "%13.11" ECU_ADDRESS 0x3FDE10 /end MEASUREMENT
/begin MEASUREMENT B_npphm "Fehlerart: nicht plausibel Phasengeber MIL" UWORD B_TRUE 1 100 0 1 BIT_MASK 0x800 FORMAT "%13.11" ECU_ADDRESS 0x3FDE12 /end MEASUREMENT
/begin MEASUREMENT B_nprkat "Bedingung RKAT ist unplausibel" UWORD B_TRUE 1 100 0 1 BIT_MASK 0x800 FORMAT "%13.11" ECU_ADDRESS 0x3FDE14 /end MEASUREMENT
/begin MEASUREMENT B_nprkaz "Bedingung RKAZ ist unplausibel" UWORD B_TRUE 1 100 0 1 BIT_MASK 0x800 FORMAT "%13.11" ECU_ADDRESS 0x3FDE16 /end MEASUREMENT
/begin MEASUREMENT B_npslpe "Nicht plausibler Fehler: Sekund‰rluftpumpe Endstufe" UWORD B_TRUE 1 100 0 1 BIT_MASK 0x800 FORMAT "%13.11" ECU_ADDRESS 0x3FDE18 /end MEASUREMENT
/begin MEASUREMENT B_npsls "Fehlerart: Offsetwert Sekund‰rluftmasse zu groﬂ" UWORD B_TRUE 1 100 0 1 BIT_MASK 0x800 FORMAT "%13.11" ECU_ADDRESS 0x3FDE1A /end MEASUREMENT
/begin MEASUREMENT B_npslv "Fehlerart: Offsetwert Sekund‰rluftmasse zu groﬂ" UWORD B_TRUE 1 100 0 1 BIT_MASK 0x800 FORMAT "%13.11" ECU_ADDRESS 0x3FDE1C /end MEASUREMENT
/begin MEASUREMENT B_npsue "Nicht plausibler Fehler: Saugrohrumschaltung Endstufe" UWORD B_TRUE 1 100 0 1 BIT_MASK 0x800 FORMAT "%13.11" ECU_ADDRESS 0x3FDE22 /end MEASUREMENT
/begin MEASUREMENT B_npteve "Nicht plausibler Fehler: Tankentl¸ftungsventil Endstufe" UWORD B_TRUE 1 100 0 1 BIT_MASK 0x800 FORMAT "%13.11" ECU_ADDRESS 0x3FDE2A /end MEASUREMENT
/begin MEASUREMENT B_nptoens "" UWORD B_TRUE 1 100 0 1 BIT_MASK 0x800 FORMAT "%13.11" ECU_ADDRESS 0x3FDE32 /end MEASUREMENT
/begin MEASUREMENT B_sianws "Fehlerart: Leitungsabfall Nockenwellensteuerungsventil (Bank1, Auslaﬂ)" UWORD B_TRUE 1 100 0 1 BIT_MASK 0x400 FORMAT "%13.11" ECU_ADDRESS 0x3FDD1C /end MEASUREMENT
/begin MEASUREMENT B_sianwse "Fehlerart: Leitungsabfall Nockenwellensteuerungsventil Endstufe (Bank1, Auslaﬂ)" UWORD B_TRUE 1 100 0 1 BIT_MASK 0x400 FORMAT "%13.11" ECU_ADDRESS 0x3FDD1E /end MEASUREMENT
/begin MEASUREMENT B_sienws "Fehlerart: Leitungsabfall Nockenwellensteuerungsventil (Bank1, Einlaﬂ)" UWORD B_TRUE 1 100 0 1 BIT_MASK 0x400 FORMAT "%13.11" ECU_ADDRESS 0x3FDD7A /end MEASUREMENT
/begin MEASUREMENT B_sienwse "Fehlerart: Leitungsabfall Nockenwellensteuerungsventil Endstufe (Bank1, Einlaﬂ)" UWORD B_TRUE 1 100 0 1 BIT_MASK 0x400 FORMAT "%13.11" ECU_ADDRESS 0x3FDD7C /end MEASUREMENT
/begin MEASUREMENT B_sifrao "Fehlertyp 'Signal fehlt' for FRAO erkannt" UWORD B_TRUE 1 100 0 1 BIT_MASK 0x400 FORMAT "%13.11" ECU_ADDRESS 0x3FDD98 /end MEASUREMENT
/begin MEASUREMENT B_sifrau "Fehlertyp 'Signal fehlt' f¸r FRAU erkannt" UWORD B_TRUE 1 100 0 1 BIT_MASK 0x400 FORMAT "%13.11" ECU_ADDRESS 0x3FDD9A /end MEASUREMENT
/begin MEASUREMENT B_sifrst "Fehlerart: LR-Abweichung" UWORD B_TRUE 1 100 0 1 BIT_MASK 0x400 FORMAT "%13.11" ECU_ADDRESS 0x3FDD9C /end MEASUREMENT
/begin MEASUREMENT B_sikrtp "Fehlertyp: Klopfregelung Testimpuls" UWORD B_TRUE 1 100 0 1 BIT_MASK 0x400 FORMAT "%13.11" ECU_ADDRESS 0x3FDDB8 /end MEASUREMENT
/begin MEASUREMENT B_siks1 "Fehlertyp: Klopfsensor 1" UWORD B_TRUE 1 100 0 1 BIT_MASK 0x400 FORMAT "%13.11" ECU_ADDRESS 0x3FDDBA /end MEASUREMENT
/begin MEASUREMENT B_siks2 "Fehlertyp: Klopfsensor 2" UWORD B_TRUE 1 100 0 1 BIT_MASK 0x400 FORMAT "%13.11" ECU_ADDRESS 0x3FDDBC /end MEASUREMENT
/begin MEASUREMENT B_siks3 "Fehlertyp: Klopfsensor 3" UWORD B_TRUE 1 100 0 1 BIT_MASK 0x400 FORMAT "%13.11" ECU_ADDRESS 0x3FDDBE /end MEASUREMENT
/begin MEASUREMENT B_siks4 "Fehlertyp: Klopfsensor 4" UWORD B_TRUE 1 100 0 1 BIT_MASK 0x400 FORMAT "%13.11" ECU_ADDRESS 0x3FDDC0 /end MEASUREMENT
/begin MEASUREMENT B_sikuppl "Fehlertyp KUPPL: Signal inaktiv" UWORD B_TRUE 1 100 0 1 BIT_MASK 0x400 FORMAT "%13.11" ECU_ADDRESS 0x3FDDC2 /end MEASUREMENT
/begin MEASUREMENT B_silash "Fehlertyp: Lambdasondenalterung hinter Kat." UWORD B_TRUE 1 100 0 1 BIT_MASK 0x400 FORMAT "%13.11" ECU_ADDRESS 0x3FDDC4 /end MEASUREMENT
/begin MEASUREMENT B_silatp "Fehlertyp nicht spezifiziert" UWORD B_TRUE 1 100 0 1 BIT_MASK 0x400 FORMAT "%13.11" ECU_ADDRESS 0x3FDDC6 /end MEASUREMENT
/begin MEASUREMENT B_silatv "Fehlertyp nicht spezifiziert" UWORD B_TRUE 1 100 0 1 BIT_MASK 0x400 FORMAT "%13.11" ECU_ADDRESS 0x3FDDC8 /end MEASUREMENT
/begin MEASUREMENT B_silatv2 "Fehlertyp nicht spezifiziert Bank2" UWORD B_TRUE 1 100 0 1 BIT_MASK 0x400 FORMAT "%13.11" ECU_ADDRESS 0x3FDDCA /end MEASUREMENT
/begin MEASUREMENT B_sillr "Fehlertyp: Leerlaufregelung" UWORD B_TRUE 1 100 0 1 BIT_MASK 0x400 FORMAT "%13.11" ECU_ADDRESS 0x3FDDD2 /end MEASUREMENT
/begin MEASUREMENT B_silsh "Fehlertyp 'Signal fehlt' hinter KAT erkannt" UWORD B_TRUE 1 100 0 1 BIT_MASK 0x400 FORMAT "%13.11" ECU_ADDRESS 0x3FDDD6 /end MEASUREMENT
/begin MEASUREMENT B_silsv "Fehlertyp 'Signal fehlt' vor KAT erkannt" UWORD B_TRUE 1 100 0 1 BIT_MASK 0x400 FORMAT "%13.11" ECU_ADDRESS 0x3FDDD8 /end MEASUREMENT
/begin MEASUREMENT B_silsv2 "Fehlertyp 'Signal fehlt' vor KAT erkannt Bank2" UWORD B_TRUE 1 100 0 1 BIT_MASK 0x400 FORMAT "%13.11" ECU_ADDRESS 0x3FDDDA /end MEASUREMENT
/begin MEASUREMENT B_simd "Fehlertyp sig.: Aussetzer, Summenfehler (multiple)" UWORD B_TRUE 1 100 0 1 BIT_MASK 0x400 FORMAT "%13.11" ECU_ADDRESS 0x3FDDE0 /end MEASUREMENT
/begin MEASUREMENT B_simd00 "Fehlertyp sig.: Aussetzer Z¸ndung 0" UWORD B_TRUE 1 100 0 1 BIT_MASK 0x400 FORMAT "%13.11" ECU_ADDRESS 0x3FDDE2 /end MEASUREMENT
/begin MEASUREMENT B_simd01 "Fehlertyp sig.: Aussetzer Z¸ndung 1" UWORD B_TRUE 1 100 0 1 BIT_MASK 0x400 FORMAT "%13.11" ECU_ADDRESS 0x3FDDE4 /end MEASUREMENT
/begin MEASUREMENT B_simd02 "Fehlertyp sig.: Aussetzer Z¸ndung 2" UWORD B_TRUE 1 100 0 1 BIT_MASK 0x400 FORMAT "%13.11" ECU_ADDRESS 0x3FDDE6 /end MEASUREMENT
/begin MEASUREMENT B_simd03 "Fehlertyp sig.: Aussetzer Z¸ndung 3" UWORD B_TRUE 1 100 0 1 BIT_MASK 0x400 FORMAT "%13.11" ECU_ADDRESS 0x3FDDE8 /end MEASUREMENT
/begin MEASUREMENT B_simd04 "Fehlertyp sig.: Aussetzer Z¸ndung 4" UWORD B_TRUE 1 100 0 1 BIT_MASK 0x400 FORMAT "%13.11" ECU_ADDRESS 0x3FDDEA /end MEASUREMENT
/begin MEASUREMENT B_simd05 "Fehlertyp sig.: Aussetzer Z¸ndung 5" UWORD B_TRUE 1 100 0 1 BIT_MASK 0x400 FORMAT "%13.11" ECU_ADDRESS 0x3FDDEC /end MEASUREMENT
/begin MEASUREMENT B_simd06 "Fehlertyp sig.: Aussetzer Z¸ndung 6" UWORD B_TRUE 1 100 0 1 BIT_MASK 0x400 FORMAT "%13.11" ECU_ADDRESS 0x3FDDEE /end MEASUREMENT
/begin MEASUREMENT B_simd07 "Fehlertyp sig.: Aussetzer Z¸ndung 7" UWORD B_TRUE 1 100 0 1 BIT_MASK 0x400 FORMAT "%13.11" ECU_ADDRESS 0x3FDDF0 /end MEASUREMENT
/begin MEASUREMENT B_simd08 "Fehlertyp sig.: Aussetzer Z¸ndung 8" UWORD B_TRUE 1 100 0 1 BIT_MASK 0x400 FORMAT "%13.11" ECU_ADDRESS 0x3FDDF2 /end MEASUREMENT
/begin MEASUREMENT B_simd09 "Fehlertyp sig.: Aussetzer Z¸ndung 9" UWORD B_TRUE 1 100 0 1 BIT_MASK 0x400 FORMAT "%13.11" ECU_ADDRESS 0x3FDDF4 /end MEASUREMENT
/begin MEASUREMENT B_simd10 "Fehlertyp sig.: Aussetzer Z¸ndung 10" UWORD B_TRUE 1 100 0 1 BIT_MASK 0x400 FORMAT "%13.11" ECU_ADDRESS 0x3FDDF6 /end MEASUREMENT
/begin MEASUREMENT B_simd11 "Fehlertyp sig.: Aussetzer Z¸ndung 11" UWORD B_TRUE 1 100 0 1 BIT_MASK 0x400 FORMAT "%13.11" ECU_ADDRESS 0x3FDDF8 /end MEASUREMENT
/begin MEASUREMENT B_simle "Fehlertype: Leitungsabfall Endstufe Motor L¸fter" UWORD B_TRUE 1 100 0 1 BIT_MASK 0x400 FORMAT "%13.11" ECU_ADDRESS 0x3FDE00 /end MEASUREMENT
/begin MEASUREMENT B_sinvrbup "Fehlertyp NVRAM-Backup Signal (nicht verwendet)" UWORD B_TRUE 1 100 0 1 BIT_MASK 0x400 FORMAT "%13.11" ECU_ADDRESS 0x3FDE04 /end MEASUREMENT
/begin MEASUREMENT B_siph "Bedingung keine alternierende Phasenpegel PG in den Bezugsmarken" UWORD B_TRUE 1 100 0 1 BIT_MASK 0x400 FORMAT "%13.11" ECU_ADDRESS 0x3FDE0A /end MEASUREMENT
/begin MEASUREMENT B_siph2 "Bedingung keine alternierende Phasenpegel PG2 in den Bezugsmarken" UWORD B_TRUE 1 100 0 1 BIT_MASK 0x400 FORMAT "%13.11" ECU_ADDRESS 0x3FDE0C /end MEASUREMENT
/begin MEASUREMENT B_siph3 "Fehlerart: Phasenflanke von PG3 auﬂerhalb Toleranz" UWORD B_TRUE 1 100 0 1 BIT_MASK 0x400 FORMAT "%13.11" ECU_ADDRESS 0x3FDE0E /end MEASUREMENT
/begin MEASUREMENT B_siph4 "Fehlerart: Phasenflanke von PG4 auﬂerhalb Toleranz" UWORD B_TRUE 1 100 0 1 BIT_MASK 0x400 FORMAT "%13.11" ECU_ADDRESS 0x3FDE10 /end MEASUREMENT
/begin MEASUREMENT B_siphm "Fehlerart: Kein Phasengeber im System verf¸gbar" UWORD B_TRUE 1 100 0 1 BIT_MASK 0x400 FORMAT "%13.11" ECU_ADDRESS 0x3FDE12 /end MEASUREMENT
/begin MEASUREMENT B_sirkat "Fehlertyp 'Signal fehlt' for RKAT erkannt" UWORD B_TRUE 1 100 0 1 BIT_MASK 0x400 FORMAT "%13.11" ECU_ADDRESS 0x3FDE14 /end MEASUREMENT
/begin MEASUREMENT B_sirkaz "Fehlertyp 'Signal fehlt' for RKAZ erkannt" UWORD B_TRUE 1 100 0 1 BIT_MASK 0x400 FORMAT "%13.11" ECU_ADDRESS 0x3FDE16 /end MEASUREMENT
/begin MEASUREMENT B_sislpe "Fehlertype: Leitungsabfall Endstufe Sekund‰rluftpumpe" UWORD B_TRUE 1 100 0 1 BIT_MASK 0x400 FORMAT "%13.11" ECU_ADDRESS 0x3FDE18 /end MEASUREMENT
/begin MEASUREMENT B_sisls "Fehlertype: Sekund‰rluftsystem" UWORD B_TRUE 1 100 0 1 BIT_MASK 0x400 FORMAT "%13.11" ECU_ADDRESS 0x3FDE1A /end MEASUREMENT
/begin MEASUREMENT B_sislv "Fehlertyp: Sekund‰rluftventil" UWORD B_TRUE 1 100 0 1 BIT_MASK 0x400 FORMAT "%13.11" ECU_ADDRESS 0x3FDE1C /end MEASUREMENT
/begin MEASUREMENT B_sisue "Fehlerart: Leitungsabfall  an Endstufe f¸r Saugrohrumschaltung" UWORD B_TRUE 1 100 0 1 BIT_MASK 0x400 FORMAT "%13.11" ECU_ADDRESS 0x3FDE22 /end MEASUREMENT
/begin MEASUREMENT B_siteve "Fehlertyp: Leitungsabfall Tankentl¸ftungsventil Endstufe" UWORD B_TRUE 1 100 0 1 BIT_MASK 0x400 FORMAT "%13.11" ECU_ADDRESS 0x3FDE2A /end MEASUREMENT
/begin MEASUREMENT B_sitoens "" UWORD B_TRUE 1 100 0 1 BIT_MASK 0x400 FORMAT "%13.11" ECU_ADDRESS 0x3FDE32 /end MEASUREMENT
/begin MEASUREMENT E_agre "Errorflag: ‹berwachung AGR-Endstufe" UWORD B_TRUE 1 100 0 1 BIT_MASK 0x1 FORMAT "%13.11" ECU_ADDRESS 0x3FDD18 /end MEASUREMENT
/begin MEASUREMENT E_agrf "Errorflag: ‹berwachung AGR-FLOW" UWORD B_TRUE 1 100 0 1 BIT_MASK 0x1 FORMAT "%13.11" ECU_ADDRESS 0x3FDD1A /end MEASUREMENT
/begin MEASUREMENT E_anws "Errorflag: Nockenwellensteuerung (Auslaﬂ,Bank1)" UWORD B_TRUE 1 100 0 1 BIT_MASK 0x1 FORMAT "%13.11" ECU_ADDRESS 0x3FDD1C /end MEASUREMENT
/begin MEASUREMENT E_anwse "Errorflag: Nockenwellensteuerungsventil Endstufe (Bank1,Auslaﬂ)" UWORD B_TRUE 1 100 0 1 BIT_MASK 0x1 FORMAT "%13.11" ECU_ADDRESS 0x3FDD1E /end MEASUREMENT
/begin MEASUREMENT E_bkvp "Fehlerflag: BKV-Pumpe" UWORD B_TRUE 1 100 0 1 BIT_MASK 0x1 FORMAT "%13.11" ECU_ADDRESS 0x3FDD22 /end MEASUREMENT
/begin MEASUREMENT E_ddss "Errorflag: Differenzdrucksensor Saugrohr" UWORD B_TRUE 1 100 0 1 BIT_MASK 0x1 FORMAT "%13.11" ECU_ADDRESS 0x3FDD38 /end MEASUREMENT
/begin MEASUREMENT E_dmtk "Errorflag: Tankentl¸ftungssystem Grob- oder Feinleck" UWORD B_TRUE 1 100 0 1 BIT_MASK 0x1 FORMAT "%13.11" ECU_ADDRESS 0x3FDD46 /end MEASUREMENT
/begin MEASUREMENT E_dmtl "Errorflag: DMTL-Modul" UWORD B_TRUE 1 100 0 1 BIT_MASK 0x1 FORMAT "%13.11" ECU_ADDRESS 0x3FDD48 /end MEASUREMENT
/begin MEASUREMENT E_dss "Errorflag: Saugrohr-Drucksensor" UWORD B_TRUE 1 100 0 1 BIT_MASK 0x1 FORMAT "%13.11" ECU_ADDRESS 0x3FDD4A /end MEASUREMENT
/begin MEASUREMENT E_enws "Errorflag: Nockenwellensteuerung (Einlaﬂ,Bank1)" UWORD B_TRUE 1 100 0 1 BIT_MASK 0x1 FORMAT "%13.11" ECU_ADDRESS 0x3FDD7A /end MEASUREMENT
/begin MEASUREMENT E_enwse "Errorflag: Endstufe Nockenwellensteuerung (Einlaﬂ, Bank1)" UWORD B_TRUE 1 100 0 1 BIT_MASK 0x1 FORMAT "%13.11" ECU_ADDRESS 0x3FDD7C /end MEASUREMENT
/begin MEASUREMENT E_ev5 "Errorflag: EV von Zyl. 5" UWORD B_TRUE 1 100 0 1 BIT_MASK 0x1 FORMAT "%13.11" ECU_ADDRESS 0x3FDD88 /end MEASUREMENT
/begin MEASUREMENT E_ev6 "Errorflag: EV von Zyl. 6" UWORD B_TRUE 1 100 0 1 BIT_MASK 0x1 FORMAT "%13.11" ECU_ADDRESS 0x3FDD8A /end MEASUREMENT
/begin MEASUREMENT E_ev7 "Errorflag: EV von Zyl. 7" UWORD B_TRUE 1 100 0 1 BIT_MASK 0x1 FORMAT "%13.11" ECU_ADDRESS 0x3FDD8C /end MEASUREMENT
/begin MEASUREMENT E_ev8 "Errorflag: EV von Zyl. 8" UWORD B_TRUE 1 100 0 1 BIT_MASK 0x1 FORMAT "%13.11" ECU_ADDRESS 0x3FDD8E /end MEASUREMENT
/begin MEASUREMENT E_frao "Errorflag: LR-Adaption oberer multiplikativer Bereich" UWORD B_TRUE 1 100 0 1 BIT_MASK 0x1 FORMAT "%13.11" ECU_ADDRESS 0x3FDD98 /end MEASUREMENT
/begin MEASUREMENT E_frau "Errorflag: LR-Adaption unterer multiplikativer Bereich" UWORD B_TRUE 1 100 0 1 BIT_MASK 0x1 FORMAT "%13.11" ECU_ADDRESS 0x3FDD9A /end MEASUREMENT
/begin MEASUREMENT E_frst "Errorflag: Fehler aus Diagnose Kraftstoffversorgungssystem (Kurztest)" UWORD B_TRUE 1 100 0 1 BIT_MASK 0x1 FORMAT "%13.11" ECU_ADDRESS 0x3FDD9C /end MEASUREMENT
/begin MEASUREMENT E_fst "Errorflag: Tankf¸llstand" UWORD B_TRUE 1 100 0 1 BIT_MASK 0x1 FORMAT "%13.11" ECU_ADDRESS 0x3FDD9E /end MEASUREMENT
/begin MEASUREMENT E_hsvsa "Errorflag: reduzierte  LSU-Heizung oder LSU-Kennlinie abgeflacht" UWORD B_TRUE 1 100 0 1 BIT_MASK 0x1 FORMAT "%13.11" ECU_ADDRESS 0x3FDDA8 /end MEASUREMENT
/begin MEASUREMENT E_katsp "Errorflag: Katalysator-Konvertierung" UWORD B_TRUE 1 100 0 1 BIT_MASK 0x1 FORMAT "%13.11" ECU_ADDRESS 0x3FDDAC /end MEASUREMENT
/begin MEASUREMENT E_krtp "Errorflag: Klopfregelung Testimpuls" UWORD B_TRUE 1 100 0 1 BIT_MASK 0x1 FORMAT "%13.11" ECU_ADDRESS 0x3FDDB8 /end MEASUREMENT
/begin MEASUREMENT E_ks1 "Errorflag: Klopfsensor 1" UWORD B_TRUE 1 100 0 1 BIT_MASK 0x1 FORMAT "%13.11" ECU_ADDRESS 0x3FDDBA /end MEASUREMENT
/begin MEASUREMENT E_ks2 "Errorflag: Klopfsensor 2" UWORD B_TRUE 1 100 0 1 BIT_MASK 0x1 FORMAT "%13.11" ECU_ADDRESS 0x3FDDBC /end MEASUREMENT
/begin MEASUREMENT E_ks3 "Errorflag: Klopfsensor 3" UWORD B_TRUE 1 100 0 1 BIT_MASK 0x1 FORMAT "%13.11" ECU_ADDRESS 0x3FDDBE /end MEASUREMENT
/begin MEASUREMENT E_ks4 "Errorflag: Klopfsensor 4" UWORD B_TRUE 1 100 0 1 BIT_MASK 0x1 FORMAT "%13.11" ECU_ADDRESS 0x3FDDC0 /end MEASUREMENT
/begin MEASUREMENT E_kuppl "Fehlerflag: Gebergrˆﬂe Kupplung" UWORD B_TRUE 1 100 0 1 BIT_MASK 0x1 FORMAT "%13.11" ECU_ADDRESS 0x3FDDC2 /end MEASUREMENT
/begin MEASUREMENT E_lash "Errorflag: Lambda-Sondenalterung hinter Katalysator" UWORD B_TRUE 1 100 0 1 BIT_MASK 0x1 FORMAT "%13.11" ECU_ADDRESS 0x3FDDC4 /end MEASUREMENT
/begin MEASUREMENT E_latp "Errorflag: Lambda-Sondenalterung TP" UWORD B_TRUE 1 100 0 1 BIT_MASK 0x1 FORMAT "%13.11" ECU_ADDRESS 0x3FDDC6 /end MEASUREMENT
/begin MEASUREMENT E_latv "Errorflag: Lambda-Sondenalterung TV" UWORD B_TRUE 1 100 0 1 BIT_MASK 0x1 FORMAT "%13.11" ECU_ADDRESS 0x3FDDC8 /end MEASUREMENT
/begin MEASUREMENT E_latv2 "Errorflag: Lambda-Sondenalterung TV (Bank 2)" UWORD B_TRUE 1 100 0 1 BIT_MASK 0x1 FORMAT "%13.11" ECU_ADDRESS 0x3FDDCA /end MEASUREMENT
/begin MEASUREMENT E_ldp "Errorflag: Leckdiagnosemodul" UWORD B_TRUE 1 100 0 1 BIT_MASK 0x1 FORMAT "%13.11" ECU_ADDRESS 0x3FDDCE /end MEASUREMENT
/begin MEASUREMENT E_llr "Errorflag: Leerlaufregelung" UWORD B_TRUE 1 100 0 1 BIT_MASK 0x1 FORMAT "%13.11" ECU_ADDRESS 0x3FDDD2 /end MEASUREMENT
/begin MEASUREMENT E_lsh "Errorflag: Lambda-Sonde hinter Kat" UWORD B_TRUE 1 100 0 1 BIT_MASK 0x1 FORMAT "%13.11" ECU_ADDRESS 0x3FDDD6 /end MEASUREMENT
/begin MEASUREMENT E_lsv "Errorflag: Lambda-Sonde vor Kat" UWORD B_TRUE 1 100 0 1 BIT_MASK 0x1 FORMAT "%13.11" ECU_ADDRESS 0x3FDDD8 /end MEASUREMENT
/begin MEASUREMENT E_lsv2 "Errorflag: Lambda-Sonde 2 vor Kat" UWORD B_TRUE 1 100 0 1 BIT_MASK 0x1 FORMAT "%13.11" ECU_ADDRESS 0x3FDDDA /end MEASUREMENT
/begin MEASUREMENT E_md "Errorflag: Aussetzer, Summenfehler (multiple)" UWORD B_TRUE 1 100 0 1 BIT_MASK 0x1 FORMAT "%13.11" ECU_ADDRESS 0x3FDDE0 /end MEASUREMENT
/begin MEASUREMENT E_md00 "Errorflag: Aussetzer Z¸ndung 0" UWORD B_TRUE 1 100 0 1 BIT_MASK 0x1 FORMAT "%13.11" ECU_ADDRESS 0x3FDDE2 /end MEASUREMENT
/begin MEASUREMENT E_md01 "Errorflag: Aussetzer Z¸ndung 1" UWORD B_TRUE 1 100 0 1 BIT_MASK 0x1 FORMAT "%13.11" ECU_ADDRESS 0x3FDDE4 /end MEASUREMENT
/begin MEASUREMENT E_md02 "Errorflag: Aussetzer Z¸ndung 2" UWORD B_TRUE 1 100 0 1 BIT_MASK 0x1 FORMAT "%13.11" ECU_ADDRESS 0x3FDDE6 /end MEASUREMENT
/begin MEASUREMENT E_md03 "Errorflag: Aussetzer Z¸ndung 3" UWORD B_TRUE 1 100 0 1 BIT_MASK 0x1 FORMAT "%13.11" ECU_ADDRESS 0x3FDDE8 /end MEASUREMENT
/begin MEASUREMENT E_md04 "Errorflag: Aussetzer Z¸ndung 4" UWORD B_TRUE 1 100 0 1 BIT_MASK 0x1 FORMAT "%13.11" ECU_ADDRESS 0x3FDDEA /end MEASUREMENT
/begin MEASUREMENT E_md05 "Errorflag: Aussetzer Z¸ndung 5" UWORD B_TRUE 1 100 0 1 BIT_MASK 0x1 FORMAT "%13.11" ECU_ADDRESS 0x3FDDEC /end MEASUREMENT
/begin MEASUREMENT E_md06 "Errorflag: Aussetzer Z¸ndung 6" UWORD B_TRUE 1 100 0 1 BIT_MASK 0x1 FORMAT "%13.11" ECU_ADDRESS 0x3FDDEE /end MEASUREMENT
/begin MEASUREMENT E_md07 "Errorflag: Aussetzer Z¸ndung 7" UWORD B_TRUE 1 100 0 1 BIT_MASK 0x1 FORMAT "%13.11" ECU_ADDRESS 0x3FDDF0 /end MEASUREMENT
/begin MEASUREMENT E_md08 "Errorflag: Aussetzer Z¸ndung 8" UWORD B_TRUE 1 100 0 1 BIT_MASK 0x1 FORMAT "%13.11" ECU_ADDRESS 0x3FDDF2 /end MEASUREMENT
/begin MEASUREMENT E_md09 "Errorflag: Aussetzer Z¸ndung 9" UWORD B_TRUE 1 100 0 1 BIT_MASK 0x1 FORMAT "%13.11" ECU_ADDRESS 0x3FDDF4 /end MEASUREMENT
/begin MEASUREMENT E_md10 "Errorflag: Aussetzer Z¸ndung 10" UWORD B_TRUE 1 100 0 1 BIT_MASK 0x1 FORMAT "%13.11" ECU_ADDRESS 0x3FDDF6 /end MEASUREMENT
/begin MEASUREMENT E_md11 "Errorflag: Aussetzer Z¸ndung 11" UWORD B_TRUE 1 100 0 1 BIT_MASK 0x1 FORMAT "%13.11" ECU_ADDRESS 0x3FDDF8 /end MEASUREMENT
/begin MEASUREMENT E_mdk "Errorflag: Aussetzer, Summenfehler - multiple, kundendienstrelevant" UWORD B_TRUE 1 100 0 1 BIT_MASK 0x1 FORMAT "%13.11" ECU_ADDRESS 0x3FDDFC /end MEASUREMENT
/begin MEASUREMENT E_mle "Errorflag: L¸fterendstufe" UWORD B_TRUE 1 100 0 1 BIT_MASK 0x1 FORMAT "%13.11" ECU_ADDRESS 0x3FDE00 /end MEASUREMENT
/begin MEASUREMENT E_nvrbup "Errorflag: NVRAM-Backup Schreib-/Lese-Fehler" UWORD B_TRUE 1 100 0 1 BIT_MASK 0x1 FORMAT "%13.11" ECU_ADDRESS 0x3FDE04 /end MEASUREMENT
/begin MEASUREMENT E_nwkw "Errorflag: Zuordnung Nockenwelle zu Kurbelwelle" UWORD B_TRUE 1 100 0 1 BIT_MASK 0x1 FORMAT "%13.11" ECU_ADDRESS 0x3FDE06 /end MEASUREMENT
/begin MEASUREMENT E_pddss "Errorflag: Druck Differenzdrucksensor Saugrohr" UWORD B_TRUE 1 100 0 1 BIT_MASK 0x1 FORMAT "%13.11" ECU_ADDRESS 0x3FDE08 /end MEASUREMENT
/begin MEASUREMENT E_ph "Errorflag: Phasensensor" UWORD B_TRUE 1 100 0 1 BIT_MASK 0x1 FORMAT "%13.11" ECU_ADDRESS 0x3FDE0A /end MEASUREMENT
/begin MEASUREMENT E_ph2 "Errorflag: Phasensensor 2" UWORD B_TRUE 1 100 0 1 BIT_MASK 0x1 FORMAT "%13.11" ECU_ADDRESS 0x3FDE0C /end MEASUREMENT
/begin MEASUREMENT E_ph3 "Errorflag: Phasensensor 3" UWORD B_TRUE 1 100 0 1 BIT_MASK 0x1 FORMAT "%13.11" ECU_ADDRESS 0x3FDE0E /end MEASUREMENT
/begin MEASUREMENT E_ph4 "Errorflag: Phasensensor 4" UWORD B_TRUE 1 100 0 1 BIT_MASK 0x1 FORMAT "%13.11" ECU_ADDRESS 0x3FDE10 /end MEASUREMENT
/begin MEASUREMENT E_phm "Master-Errorflag f¸r Phasensensoren" UWORD B_TRUE 1 100 0 1 BIT_MASK 0x1 FORMAT "%13.11" ECU_ADDRESS 0x3FDE12 /end MEASUREMENT
/begin MEASUREMENT E_rkat "Errorflag DKVS (additive Korrektur pro Zeit)" UWORD B_TRUE 1 100 0 1 BIT_MASK 0x1 FORMAT "%13.11" ECU_ADDRESS 0x3FDE14 /end MEASUREMENT
/begin MEASUREMENT E_rkaz "Errorflag DKVS (additive Korrektur pro Z¸ndung)" UWORD B_TRUE 1 100 0 1 BIT_MASK 0x1 FORMAT "%13.11" ECU_ADDRESS 0x3FDE16 /end MEASUREMENT
/begin MEASUREMENT E_slpe "Errorflag: Sekund‰rluftpumpe (Endstufe)" UWORD B_TRUE 1 100 0 1 BIT_MASK 0x1 FORMAT "%13.11" ECU_ADDRESS 0x3FDE18 /end MEASUREMENT
/begin MEASUREMENT E_sls "Errorflag: Sekund‰rluft-System" UWORD B_TRUE 1 100 0 1 BIT_MASK 0x1 FORMAT "%13.11" ECU_ADDRESS 0x3FDE1A /end MEASUREMENT
/begin MEASUREMENT E_slv "Errorflag: Sekund‰rluftventil" UWORD B_TRUE 1 100 0 1 BIT_MASK 0x1 FORMAT "%13.11" ECU_ADDRESS 0x3FDE1C /end MEASUREMENT
/begin MEASUREMENT E_slve "Errorflag: Sekund‰rluftventil (Endstufe)" UWORD B_TRUE 1 100 0 1 BIT_MASK 0x1 FORMAT "%13.11" ECU_ADDRESS 0x3FDE1E /end MEASUREMENT
/begin MEASUREMENT E_sue "Errorflag: Endstufe Saugrohrumschaltung" UWORD B_TRUE 1 100 0 1 BIT_MASK 0x1 FORMAT "%13.11" ECU_ADDRESS 0x3FDE22 /end MEASUREMENT
/begin MEASUREMENT E_tes "Errorflag: Tankentl¸ftungssystem" UWORD B_TRUE 1 100 0 1 BIT_MASK 0x1 FORMAT "%13.11" ECU_ADDRESS 0x3FDE28 /end MEASUREMENT
/begin MEASUREMENT E_teve "Errorflag: Tankentl¸ftungsventil Endstufe" UWORD B_TRUE 1 100 0 1 BIT_MASK 0x1 FORMAT "%13.11" ECU_ADDRESS 0x3FDE2A /end MEASUREMENT
/begin MEASUREMENT E_teve2 "Errorflag: Tankentl¸ftungsventil Endstufe, Bank 2" UWORD B_TRUE 1 100 0 1 BIT_MASK 0x1 FORMAT "%13.11" ECU_ADDRESS 0x3FDE2C /end MEASUREMENT
/begin MEASUREMENT E_toens "Fehlerbedingung TOENS" UWORD B_TRUE 1 100 0 1 BIT_MASK 0x1 FORMAT "%13.11" ECU_ADDRESS 0x3FDE32 /end MEASUREMENT
/begin MEASUREMENT sfpagre "Status Fehlerpfad: AGR-Ventil Endstufe" UWORD dez 1 100 0 65535 FORMAT "%8.2" ECU_ADDRESS 0x3FDD18 /end MEASUREMENT
/begin MEASUREMENT sfpagrf "Status Fehlerpfad: ‹berwachung AGR-Flow" UWORD dez 1 100 0 65535 FORMAT "%8.2" ECU_ADDRESS 0x3FDD1A /end MEASUREMENT
/begin MEASUREMENT sfpanws "Status Fehlerpfad: Nockenwellensteuerung (Auslaﬂ, Bank1)" UWORD dez 1 100 0 65535 FORMAT "%8.2" ECU_ADDRESS 0x3FDD1C /end MEASUREMENT
/begin MEASUREMENT sfpanwse "Status Fehlerpfad: Nockenwellensteuerung Endstufe (Auslaﬂ, Bank1)" UWORD dez 1 100 0 65535 FORMAT "%8.2" ECU_ADDRESS 0x3FDD1E /end MEASUREMENT
/begin MEASUREMENT sfpbkvp "Status Fehlerpfad:  Bremskraftverst‰rker-Pumpe" UWORD dez 1 100 0 65535 FORMAT "%8.2" ECU_ADDRESS 0x3FDD22 /end MEASUREMENT
/begin MEASUREMENT sfpddss "Status Fehlerpfad: Differenzdrucksensor Saugrohr" UWORD dez 1 100 0 65535 FORMAT "%8.2" ECU_ADDRESS 0x3FDD38 /end MEASUREMENT
/begin MEASUREMENT sfpdmtk "Status Fehlerpfad: Modul DMTK" UWORD dez 1 100 0 65535 FORMAT "%8.2" ECU_ADDRESS 0x3FDD46 /end MEASUREMENT
/begin MEASUREMENT sfpdmtl "Status Fehlerpfad: Modul DM-TL" UWORD dez 1 100 0 65535 FORMAT "%8.2" ECU_ADDRESS 0x3FDD48 /end MEASUREMENT
/begin MEASUREMENT sfpdss "Status Fehlerpfad: DSS" UWORD dez 1 100 0 65535 FORMAT "%8.2" ECU_ADDRESS 0x3FDD4A /end MEASUREMENT
/begin MEASUREMENT sfpenws "Status Fehlerpfad: Nockenwellensteuerung (Einlaﬂ, Bank1)" UWORD dez 1 100 0 65535 FORMAT "%8.2" ECU_ADDRESS 0x3FDD7A /end MEASUREMENT
/begin MEASUREMENT sfpenwse "Status Fehlerpfad: Nockenwellensteuerung Endstufe (Einlaﬂ, Bank1)" UWORD dez 1 100 0 65535 FORMAT "%8.2" ECU_ADDRESS 0x3FDD7C /end MEASUREMENT
/begin MEASUREMENT sfpev5 "Status Fehlerpfad: EV5" UWORD dez 1 100 0 65535 FORMAT "%8.2" ECU_ADDRESS 0x3FDD88 /end MEASUREMENT
/begin MEASUREMENT sfpev6 "Status Fehlerpfad: EV6" UWORD dez 1 100 0 65535 FORMAT "%8.2" ECU_ADDRESS 0x3FDD8A /end MEASUREMENT
/begin MEASUREMENT sfpev7 "Status Fehlerpfad: EV7" UWORD dez 1 100 0 65535 FORMAT "%8.2" ECU_ADDRESS 0x3FDD8C /end MEASUREMENT
/begin MEASUREMENT sfpev8 "Status Fehlerpfad: EV8" UWORD dez 1 100 0 65535 FORMAT "%8.2" ECU_ADDRESS 0x3FDD8E /end MEASUREMENT
/begin MEASUREMENT sfpfrao "Status Fehlerpfad: LR-Adaption oberer multiplikativer Bereich" UWORD dez 1 100 0 65535 FORMAT "%8.2" ECU_ADDRESS 0x3FDD98 /end MEASUREMENT
/begin MEASUREMENT sfpfrau "Status Fehlerpfad: LR Adaption unterer multiplikativer Bereich" UWORD dez 1 100 0 65535 FORMAT "%8.2" ECU_ADDRESS 0x3FDD9A /end MEASUREMENT
/begin MEASUREMENT sfpfrst "Status Fehlerpfad: LR-Abweichung" UWORD dez 1 100 0 65535 FORMAT "%8.2" ECU_ADDRESS 0x3FDD9C /end MEASUREMENT
/begin MEASUREMENT sfpfst "Status Fehlerpfad: Tankf¸llstandssensor" UWORD dez 1 100 0 65535 FORMAT "%8.2" ECU_ADDRESS 0x3FDD9E /end MEASUREMENT
/begin MEASUREMENT sfphsvsa "Status Fehlerpfad: Heizung Lambdasonde vor Kat" UWORD dez 1 100 0 65535 FORMAT "%8.2" ECU_ADDRESS 0x3FDDA8 /end MEASUREMENT
/begin MEASUREMENT sfpkatsp "Status Fehlerpfad: Katalysator-‹berwachung" UWORD dez 1 100 0 65535 FORMAT "%8.2" ECU_ADDRESS 0x3FDDAC /end MEASUREMENT
/begin MEASUREMENT sfpkrtp "Status Fehlerpfad: Klopfregelung Testimpuls" UWORD dez 1 100 0 65535 FORMAT "%8.2" ECU_ADDRESS 0x3FDDB8 /end MEASUREMENT
/begin MEASUREMENT sfpks1 "Status Fehlerpfad: Klopfsensor 1" UWORD dez 1 100 0 65535 FORMAT "%8.2" ECU_ADDRESS 0x3FDDBA /end MEASUREMENT
/begin MEASUREMENT sfpks2 "Status Fehlerpfad: Klopfsensor 2" UWORD dez 1 100 0 65535 FORMAT "%8.2" ECU_ADDRESS 0x3FDDBC /end MEASUREMENT
/begin MEASUREMENT sfpks3 "Status Fehlerpfad: Klopfsensor 3" UWORD dez 1 100 0 65535 FORMAT "%8.2" ECU_ADDRESS 0x3FDDBE /end MEASUREMENT
/begin MEASUREMENT sfpks4 "Status Fehlerpfad: Klopfsensor 4" UWORD dez 1 100 0 65535 FORMAT "%8.2" ECU_ADDRESS 0x3FDDC0 /end MEASUREMENT
/begin MEASUREMENT sfpkuppl "Status Fehlerpfad KUPPL: Gebergrˆﬂe Kupplung" UWORD dez 1 100 0 65535 FORMAT "%8.2" ECU_ADDRESS 0x3FDDC2 /end MEASUREMENT
/begin MEASUREMENT sfplash "Status Fehlerpfad: Lambdasondenalterung hinter Kat" UWORD dez 1 100 0 65535 FORMAT "%8.2" ECU_ADDRESS 0x3FDDC4 /end MEASUREMENT
/begin MEASUREMENT sfplatp "Status Fehlerpfad: Diagnose Lambdasondenalterung Tp vor Kat" UWORD dez 1 100 0 65535 FORMAT "%8.2" ECU_ADDRESS 0x3FDDC6 /end MEASUREMENT
/begin MEASUREMENT sfplatv "Status Fehlerpfad: Diagnose Lambdasondenalterung Tv vor Kat" UWORD dez 1 100 0 65535 FORMAT "%8.2" ECU_ADDRESS 0x3FDDC8 /end MEASUREMENT
/begin MEASUREMENT sfplatv2 "Status Fehlerpfad: Diagnose Lambdasondenalterung Tv vor Kat Bank2" UWORD dez 1 100 0 65535 FORMAT "%8.2" ECU_ADDRESS 0x3FDDCA /end MEASUREMENT
/begin MEASUREMENT sfpldp "Status Fehlerpfad:Leckdiagnosemodul" UWORD dez 1 100 0 65535 FORMAT "%8.2" ECU_ADDRESS 0x3FDDCE /end MEASUREMENT
/begin MEASUREMENT sfpllr "Status Fehlerpfad: Leerlaufregelung" UWORD dez 1 100 0 65535 FORMAT "%8.2" ECU_ADDRESS 0x3FDDD2 /end MEASUREMENT
/begin MEASUREMENT sfplsh "Status Fehlerpfad: Diagnose Lambdasonde hinter Kat" UWORD dez 1 100 0 65535 FORMAT "%8.2" ECU_ADDRESS 0x3FDDD6 /end MEASUREMENT
/begin MEASUREMENT sfplsv "Status Fehlerpfad: Diagnose Lambdasonde vor Kat" UWORD dez 1 100 0 65535 FORMAT "%8.2" ECU_ADDRESS 0x3FDDD8 /end MEASUREMENT
/begin MEASUREMENT sfplsv2 "Status Fehlerpfad: Diagnose Lambdasonde vor Kat Bank2" UWORD dez 1 100 0 65535 FORMAT "%8.2" ECU_ADDRESS 0x3FDDDA /end MEASUREMENT
/begin MEASUREMENT sfpmd "Statuswort:  Aussetzer, Summenfehler (multiple)" UWORD dez 1 100 0 65535 FORMAT "%8.2" ECU_ADDRESS 0x3FDDE0 /end MEASUREMENT
/begin MEASUREMENT sfpmd00 "Statuswort:  Aussetzer Z¸ndung 0" UWORD dez 1 100 0 65535 FORMAT "%8.2" ECU_ADDRESS 0x3FDDE2 /end MEASUREMENT
/begin MEASUREMENT sfpmd01 "Statuswort:  Aussetzer Z¸ndung 1" UWORD dez 1 100 0 65535 FORMAT "%8.2" ECU_ADDRESS 0x3FDDE4 /end MEASUREMENT
/begin MEASUREMENT sfpmd02 "Statuswort:  Aussetzer Z¸ndung 2" UWORD dez 1 100 0 65535 FORMAT "%8.2" ECU_ADDRESS 0x3FDDE6 /end MEASUREMENT
/begin MEASUREMENT sfpmd03 "Statuswort:  Aussetzer Z¸ndung 3" UWORD dez 1 100 0 65535 FORMAT "%8.2" ECU_ADDRESS 0x3FDDE8 /end MEASUREMENT
/begin MEASUREMENT sfpmd04 "Statuswort:  Aussetzer Z¸ndung 4" UWORD dez 1 100 0 65535 FORMAT "%8.2" ECU_ADDRESS 0x3FDDEA /end MEASUREMENT
/begin MEASUREMENT sfpmd05 "Statuswort:  Aussetzer Z¸ndung 5" UWORD dez 1 100 0 65535 FORMAT "%8.2" ECU_ADDRESS 0x3FDDEC /end MEASUREMENT
/begin MEASUREMENT sfpmd06 "Statuswort:  Aussetzer Z¸ndung 6" UWORD dez 1 100 0 65535 FORMAT "%8.2" ECU_ADDRESS 0x3FDDEE /end MEASUREMENT
/begin MEASUREMENT sfpmd07 "Statuswort:  Aussetzer Z¸ndung 7" UWORD dez 1 100 0 65535 FORMAT "%8.2" ECU_ADDRESS 0x3FDDF0 /end MEASUREMENT
/begin MEASUREMENT sfpmd08 "Statuswort:  Aussetzer Z¸ndung 8" UWORD dez 1 100 0 65535 FORMAT "%8.2" ECU_ADDRESS 0x3FDDF2 /end MEASUREMENT
/begin MEASUREMENT sfpmd09 "Statuswort:  Aussetzer Z¸ndung 9" UWORD dez 1 100 0 65535 FORMAT "%8.2" ECU_ADDRESS 0x3FDDF4 /end MEASUREMENT
/begin MEASUREMENT sfpmd10 "Statuswort:  Aussetzer Z¸ndung 10" UWORD dez 1 100 0 65535 FORMAT "%8.2" ECU_ADDRESS 0x3FDDF6 /end MEASUREMENT
/begin MEASUREMENT sfpmd11 "Statuswort:  Aussetzer Z¸ndung 11" UWORD dez 1 100 0 65535 FORMAT "%8.2" ECU_ADDRESS 0x3FDDF8 /end MEASUREMENT
/begin MEASUREMENT sfpmdk "Statuswort:  Aussetzer, Summenfehler - multiple, > 4500 U/min" UWORD dez 1 100 0 65535 FORMAT "%8.2" ECU_ADDRESS 0x3FDDFC /end MEASUREMENT
/begin MEASUREMENT sfpmle "Status Fehlerpfad: MLE - Endstufe" UWORD dez 1 100 0 65535 FORMAT "%8.2" ECU_ADDRESS 0x3FDE00 /end MEASUREMENT
/begin MEASUREMENT sfpnvrbup "Status Fehlerpfad: NVRAM-Backup" UWORD dez 1 100 0 65535 FORMAT "%8.2" ECU_ADDRESS 0x3FDE04 /end MEASUREMENT
/begin MEASUREMENT sfpnwkw "Status Fehlerpfad: Zuordnung Nockenwelle zu Kurbelwelle" UWORD dez 1 100 0 65535 FORMAT "%8.2" ECU_ADDRESS 0x3FDE06 /end MEASUREMENT
/begin MEASUREMENT sfppddss "" UWORD dez 1 100 0 65535 FORMAT "%8.2" ECU_ADDRESS 0x3FDE08 /end MEASUREMENT
/begin MEASUREMENT sfpph "Status Fehlerpfad: Phasengeber" UWORD dez 1 100 0 65535 FORMAT "%8.2" ECU_ADDRESS 0x3FDE0A /end MEASUREMENT
/begin MEASUREMENT sfpph2 "Status Fehlerpfad: Phasengeber Bank 2" UWORD dez 1 100 0 65535 FORMAT "%8.2" ECU_ADDRESS 0x3FDE0C /end MEASUREMENT
/begin MEASUREMENT sfpph3 "Status Fehlerpfad: Phasengeber 3" UWORD dez 1 100 0 65535 FORMAT "%8.2" ECU_ADDRESS 0x3FDE0E /end MEASUREMENT
/begin MEASUREMENT sfpph4 "Status Fehlerpfad: Phasengeber 4" UWORD dez 1 100 0 65535 FORMAT "%8.2" ECU_ADDRESS 0x3FDE10 /end MEASUREMENT
/begin MEASUREMENT sfpphm "Status Fehlerpfad: Phasengeber MIL" UWORD dez 1 100 0 65535 FORMAT "%8.2" ECU_ADDRESS 0x3FDE12 /end MEASUREMENT
/begin MEASUREMENT sfprkat "Status Fehlerpfad: LR Adaption additive Korrektur pro Zeit" UWORD dez 1 100 0 65535 FORMAT "%8.2" ECU_ADDRESS 0x3FDE14 /end MEASUREMENT
/begin MEASUREMENT sfprkaz "Status Fehlerpfad: LR Adaption additive Korrektur pro Z¸ndung" UWORD dez 1 100 0 65535 FORMAT "%8.2" ECU_ADDRESS 0x3FDE16 /end MEASUREMENT
/begin MEASUREMENT sfpslpe "Status Fehlerpfad: Sekund‰rluftpumpe Endstufe" UWORD dez 1 100 0 65535 FORMAT "%8.2" ECU_ADDRESS 0x3FDE18 /end MEASUREMENT
/begin MEASUREMENT sfpsls "Status Fehlerpfad: Diagnose Sekund‰rluftsystem" UWORD dez 1 100 0 65535 FORMAT "%8.2" ECU_ADDRESS 0x3FDE1A /end MEASUREMENT
/begin MEASUREMENT sfpslv "Status Fehlerpfad: Diagnose Sekund‰rluftventil" UWORD dez 1 100 0 65535 FORMAT "%8.2" ECU_ADDRESS 0x3FDE1C /end MEASUREMENT
/begin MEASUREMENT sfpslve "Status Fehlerpfad: Sekund‰rluftventil Endstufe" UWORD dez 1 100 0 65535 FORMAT "%8.2" ECU_ADDRESS 0x3FDE1E /end MEASUREMENT
/begin MEASUREMENT sfpsue "Status Fehlerpfad: Endstufe Saugrohrumschaltung" UWORD dez 1 100 0 65535 FORMAT "%8.2" ECU_ADDRESS 0x3FDE22 /end MEASUREMENT
/begin MEASUREMENT sfptes "Status Fehlerpfad: Tankdiagnose, TEV defekt offen" UWORD dez 1 100 0 65535 FORMAT "%8.2" ECU_ADDRESS 0x3FDE28 /end MEASUREMENT
/begin MEASUREMENT sfpteve "Status Fehlerpfad: Tankl¸ftungsventil Endstufe" UWORD dez 1 100 0 65535 FORMAT "%8.2" ECU_ADDRESS 0x3FDE2A /end MEASUREMENT
/begin MEASUREMENT sfpteve2 "Status Fehlerpfad: Tankl¸ftungsventil Endstufe Bank 2" UWORD dez 1 100 0 65535 FORMAT "%8.2" ECU_ADDRESS 0x3FDE2C /end MEASUREMENT
/begin MEASUREMENT sfptoens "" UWORD dez 1 100 0 65535 FORMAT "%8.2" ECU_ADDRESS 0x3FDE32 /end MEASUREMENT
/begin MEASUREMENT TYP_anws "" UWORD B_TRUE 1 100 0 1 BIT_MASK 0xf00 FORMAT "%13.11" ECU_ADDRESS 0x3FDD1C /end MEASUREMENT
/begin MEASUREMENT TYP_anwse "" UWORD B_TRUE 1 100 0 1 BIT_MASK 0xf00 FORMAT "%13.11" ECU_ADDRESS 0x3FDD1E /end MEASUREMENT
/begin MEASUREMENT TYP_enws "" UWORD B_TRUE 1 100 0 1 BIT_MASK 0xf00 FORMAT "%13.11" ECU_ADDRESS 0x3FDD7A /end MEASUREMENT
/begin MEASUREMENT TYP_enwse "" UWORD B_TRUE 1 100 0 1 BIT_MASK 0xf00 FORMAT "%13.11" ECU_ADDRESS 0x3FDD7C /end MEASUREMENT
/begin MEASUREMENT TYP_frao "" UWORD B_TRUE 1 100 0 1 BIT_MASK 0xf00 FORMAT "%13.11" ECU_ADDRESS 0x3FDD98 /end MEASUREMENT
/begin MEASUREMENT TYP_frau "" UWORD B_TRUE 1 100 0 1 BIT_MASK 0xf00 FORMAT "%13.11" ECU_ADDRESS 0x3FDD9A /end MEASUREMENT
/begin MEASUREMENT TYP_frst "" UWORD B_TRUE 1 100 0 1 BIT_MASK 0xf00 FORMAT "%13.11" ECU_ADDRESS 0x3FDD9C /end MEASUREMENT
/begin MEASUREMENT TYP_krtp "" UWORD B_TRUE 1 100 0 1 BIT_MASK 0xf00 FORMAT "%13.11" ECU_ADDRESS 0x3FDDB8 /end MEASUREMENT
/begin MEASUREMENT TYP_ks1 "" UWORD B_TRUE 1 100 0 1 BIT_MASK 0xf00 FORMAT "%13.11" ECU_ADDRESS 0x3FDDBA /end MEASUREMENT
/begin MEASUREMENT TYP_ks2 "" UWORD B_TRUE 1 100 0 1 BIT_MASK 0xf00 FORMAT "%13.11" ECU_ADDRESS 0x3FDDBC /end MEASUREMENT
/begin MEASUREMENT TYP_ks3 "" UWORD B_TRUE 1 100 0 1 BIT_MASK 0xf00 FORMAT "%13.11" ECU_ADDRESS 0x3FDDBE /end MEASUREMENT
/begin MEASUREMENT TYP_ks4 "" UWORD B_TRUE 1 100 0 1 BIT_MASK 0xf00 FORMAT "%13.11" ECU_ADDRESS 0x3FDDC0 /end MEASUREMENT
/begin MEASUREMENT TYP_kuppl "Fehlertyp: Gebergrˆﬂe Kupplungsschalter" UWORD B_TRUE 1 100 0 1 BIT_MASK 0xf00 FORMAT "%13.11" ECU_ADDRESS 0x3FDDC2 /end MEASUREMENT
/begin MEASUREMENT TYP_lash "Fehlertyp: Lambda- Sondenalterung hinter Kat" UWORD B_TRUE 1 100 0 1 BIT_MASK 0xf00 FORMAT "%13.11" ECU_ADDRESS 0x3FDDC4 /end MEASUREMENT
/begin MEASUREMENT TYP_latp "Fehlertyp: Lambda- Sondenalterung Tp vor Kat" UWORD B_TRUE 1 100 0 1 BIT_MASK 0xf00 FORMAT "%13.11" ECU_ADDRESS 0x3FDDC6 /end MEASUREMENT
/begin MEASUREMENT TYP_latv "Fehlertyp: Lambda- Sondenalterung Tv vor Kat" UWORD B_TRUE 1 100 0 1 BIT_MASK 0xf00 FORMAT "%13.11" ECU_ADDRESS 0x3FDDC8 /end MEASUREMENT
/begin MEASUREMENT TYP_latv2 "Fehlertyp: Lambda- Sondenalterung Tv vor Kat Bank2" UWORD B_TRUE 1 100 0 1 BIT_MASK 0xf00 FORMAT "%13.11" ECU_ADDRESS 0x3FDDCA /end MEASUREMENT
/begin MEASUREMENT TYP_LLR "" UWORD B_TRUE 1 100 0 1 BIT_MASK 0xf00 FORMAT "%13.11" ECU_ADDRESS 0x3FDDD2 /end MEASUREMENT
/begin MEASUREMENT TYP_lsh "Fehlertyp: Lambdasonde 1 hinter Kat" UWORD B_TRUE 1 100 0 1 BIT_MASK 0xf00 FORMAT "%13.11" ECU_ADDRESS 0x3FDDD6 /end MEASUREMENT
/begin MEASUREMENT TYP_lsv "Fehlertyp: Lambdasonde 1 vor Kat" UWORD B_TRUE 1 100 0 1 BIT_MASK 0xf00 FORMAT "%13.11" ECU_ADDRESS 0x3FDDD8 /end MEASUREMENT
/begin MEASUREMENT TYP_lsv2 "Fehlertyp: Lambdasonde 2 vor Kat" UWORD B_TRUE 1 100 0 1 BIT_MASK 0xf00 FORMAT "%13.11" ECU_ADDRESS 0x3FDDDA /end MEASUREMENT
/begin MEASUREMENT TYP_md "Fehlertyp:  Aussetzer, Summenfehler (multiple)" UWORD B_TRUE 1 100 0 1 BIT_MASK 0xf00 FORMAT "%13.11" ECU_ADDRESS 0x3FDDE0 /end MEASUREMENT
/begin MEASUREMENT TYP_md00 "Fehlertyp:  Aussetzer Z¸ndung 0" UWORD B_TRUE 1 100 0 1 BIT_MASK 0xf00 FORMAT "%13.11" ECU_ADDRESS 0x3FDDE2 /end MEASUREMENT
/begin MEASUREMENT TYP_md01 "Fehlertyp:  Aussetzer Z¸ndung 1" UWORD B_TRUE 1 100 0 1 BIT_MASK 0xf00 FORMAT "%13.11" ECU_ADDRESS 0x3FDDE4 /end MEASUREMENT
/begin MEASUREMENT TYP_md02 "Fehlertyp:  Aussetzer Z¸ndung 2" UWORD B_TRUE 1 100 0 1 BIT_MASK 0xf00 FORMAT "%13.11" ECU_ADDRESS 0x3FDDE6 /end MEASUREMENT
/begin MEASUREMENT TYP_md03 "Fehlertyp:  Aussetzer Z¸ndung 3" UWORD B_TRUE 1 100 0 1 BIT_MASK 0xf00 FORMAT "%13.11" ECU_ADDRESS 0x3FDDE8 /end MEASUREMENT
/begin MEASUREMENT TYP_md04 "Fehlertyp:  Aussetzer Z¸ndung 4" UWORD B_TRUE 1 100 0 1 BIT_MASK 0xf00 FORMAT "%13.11" ECU_ADDRESS 0x3FDDEA /end MEASUREMENT
/begin MEASUREMENT TYP_md05 "Fehlertyp:  Aussetzer Z¸ndung 5" UWORD B_TRUE 1 100 0 1 BIT_MASK 0xf00 FORMAT "%13.11" ECU_ADDRESS 0x3FDDEC /end MEASUREMENT
/begin MEASUREMENT TYP_md06 "Fehlertyp:  Aussetzer Z¸ndung 6" UWORD B_TRUE 1 100 0 1 BIT_MASK 0xf00 FORMAT "%13.11" ECU_ADDRESS 0x3FDDEE /end MEASUREMENT
/begin MEASUREMENT TYP_md07 "Fehlertyp:  Aussetzer Z¸ndung 7" UWORD B_TRUE 1 100 0 1 BIT_MASK 0xf00 FORMAT "%13.11" ECU_ADDRESS 0x3FDDF0 /end MEASUREMENT
/begin MEASUREMENT TYP_md08 "Fehlertyp:  Aussetzer Z¸ndung 8" UWORD B_TRUE 1 100 0 1 BIT_MASK 0xf00 FORMAT "%13.11" ECU_ADDRESS 0x3FDDF2 /end MEASUREMENT
/begin MEASUREMENT TYP_md09 "Fehlertyp:  Aussetzer Z¸ndung 9" UWORD B_TRUE 1 100 0 1 BIT_MASK 0xf00 FORMAT "%13.11" ECU_ADDRESS 0x3FDDF4 /end MEASUREMENT
/begin MEASUREMENT TYP_md10 "Fehlertyp:  Aussetzer Z¸ndung 10" UWORD B_TRUE 1 100 0 1 BIT_MASK 0xf00 FORMAT "%13.11" ECU_ADDRESS 0x3FDDF6 /end MEASUREMENT
/begin MEASUREMENT TYP_md11 "Fehlertyp:  Aussetzer Z¸ndung 11" UWORD B_TRUE 1 100 0 1 BIT_MASK 0xf00 FORMAT "%13.11" ECU_ADDRESS 0x3FDDF8 /end MEASUREMENT
/begin MEASUREMENT TYP_mle "" UWORD B_TRUE 1 100 0 1 BIT_MASK 0xf00 FORMAT "%13.11" ECU_ADDRESS 0x3FDE00 /end MEASUREMENT
/begin MEASUREMENT TYP_nvrbup "" UWORD B_TRUE 1 100 0 1 BIT_MASK 0xf00 FORMAT "%13.11" ECU_ADDRESS 0x3FDE04 /end MEASUREMENT
/begin MEASUREMENT TYP_ph "" UWORD B_TRUE 1 100 0 1 BIT_MASK 0xf00 FORMAT "%13.11" ECU_ADDRESS 0x3FDE0A /end MEASUREMENT
/begin MEASUREMENT TYP_ph2 "" UWORD B_TRUE 1 100 0 1 BIT_MASK 0xf00 FORMAT "%13.11" ECU_ADDRESS 0x3FDE0C /end MEASUREMENT
/begin MEASUREMENT TYP_ph3 "" UWORD B_TRUE 1 100 0 1 BIT_MASK 0xf00 FORMAT "%13.11" ECU_ADDRESS 0x3FDE0E /end MEASUREMENT
/begin MEASUREMENT TYP_ph4 "" UWORD B_TRUE 1 100 0 1 BIT_MASK 0xf00 FORMAT "%13.11" ECU_ADDRESS 0x3FDE10 /end MEASUREMENT
/begin MEASUREMENT TYP_phm "" UWORD B_TRUE 1 100 0 1 BIT_MASK 0xf00 FORMAT "%13.11" ECU_ADDRESS 0x3FDE12 /end MEASUREMENT
/begin MEASUREMENT TYP_rkat "" UWORD B_TRUE 1 100 0 1 BIT_MASK 0xf00 FORMAT "%13.11" ECU_ADDRESS 0x3FDE14 /end MEASUREMENT
/begin MEASUREMENT TYP_rkaz "" UWORD B_TRUE 1 100 0 1 BIT_MASK 0xf00 FORMAT "%13.11" ECU_ADDRESS 0x3FDE16 /end MEASUREMENT
/begin MEASUREMENT TYP_slpe "" UWORD B_TRUE 1 100 0 1 BIT_MASK 0xf00 FORMAT "%13.11" ECU_ADDRESS 0x3FDE18 /end MEASUREMENT
/begin MEASUREMENT TYP_sls "Fehlertyp: Sekund‰rluftsystem" UWORD B_TRUE 1 100 0 1 BIT_MASK 0xf00 FORMAT "%13.11" ECU_ADDRESS 0x3FDE1A /end MEASUREMENT
/begin MEASUREMENT TYP_slv "Fehlertyp: Dichtheit Sekund‰rluftventil" UWORD B_TRUE 1 100 0 1 BIT_MASK 0xf00 FORMAT "%13.11" ECU_ADDRESS 0x3FDE1C /end MEASUREMENT
/begin MEASUREMENT TYP_sue "" UWORD B_TRUE 1 100 0 1 BIT_MASK 0xf00 FORMAT "%13.11" ECU_ADDRESS 0x3FDE22 /end MEASUREMENT
/begin MEASUREMENT TYP_teve "" UWORD B_TRUE 1 100 0 1 BIT_MASK 0xf00 FORMAT "%13.11" ECU_ADDRESS 0x3FDE2A /end MEASUREMENT
/begin MEASUREMENT TYP_toens "" UWORD B_TRUE 1 100 0 1 BIT_MASK 0xf00 FORMAT "%13.11" ECU_ADDRESS 0x3FDE32 /end MEASUREMENT
/begin MEASUREMENT Z_agre "Zyklusflag: Abgasr¸ckf¸hrungsventil Endstufe" UWORD B_TRUE 1 100 0 1 BIT_MASK 0x2 FORMAT "%13.11" ECU_ADDRESS 0x3FDD18 /end MEASUREMENT
/begin MEASUREMENT Z_agrf "Zyklusflag: ‹berwachung AGR-FLOW" UWORD B_TRUE 1 100 0 1 BIT_MASK 0x2 FORMAT "%13.11" ECU_ADDRESS 0x3FDD1A /end MEASUREMENT
/begin MEASUREMENT Z_anws "Zyklusflag: Nockenwellensteuerung (Auslaﬂ,Bank1)" UWORD B_TRUE 1 100 0 1 BIT_MASK 0x2 FORMAT "%13.11" ECU_ADDRESS 0x3FDD1C /end MEASUREMENT
/begin MEASUREMENT Z_anwse "Zyklusflag: Nockenwellensteuerungsventil Endstufe (Bank1,Auslaﬂ)" UWORD B_TRUE 1 100 0 1 BIT_MASK 0x2 FORMAT "%13.11" ECU_ADDRESS 0x3FDD1E /end MEASUREMENT
/begin MEASUREMENT Z_bkvp "Zyklusflag: Bremskraftverst‰rker-Pumpe" UWORD B_TRUE 1 100 0 1 BIT_MASK 0x2 FORMAT "%13.11" ECU_ADDRESS 0x3FDD22 /end MEASUREMENT
/begin MEASUREMENT Z_ddss "Zyklusflag: Differenzdrucksensor Saugrohr" UWORD B_TRUE 1 100 0 1 BIT_MASK 0x2 FORMAT "%13.11" ECU_ADDRESS 0x3FDD38 /end MEASUREMENT
/begin MEASUREMENT Z_dmtk "Zyklusflag: Tankentl¸ftungssystem Kleinstleck" UWORD B_TRUE 1 100 0 1 BIT_MASK 0x2 FORMAT "%13.11" ECU_ADDRESS 0x3FDD46 /end MEASUREMENT
/begin MEASUREMENT Z_dmtl "Zyklusflag: DMTL-Modul" UWORD B_TRUE 1 100 0 1 BIT_MASK 0x2 FORMAT "%13.11" ECU_ADDRESS 0x3FDD48 /end MEASUREMENT
/begin MEASUREMENT Z_dss "Zyklusflag: Saugrohr-Drucksensor" UWORD B_TRUE 1 100 0 1 BIT_MASK 0x2 FORMAT "%13.11" ECU_ADDRESS 0x3FDD4A /end MEASUREMENT
/begin MEASUREMENT Z_enws "Zyklusflag: Nockenwellensteuerung (Einlaﬂ,Bank1)" UWORD B_TRUE 1 100 0 1 BIT_MASK 0x2 FORMAT "%13.11" ECU_ADDRESS 0x3FDD7A /end MEASUREMENT
/begin MEASUREMENT Z_enwse "Zyklusflag: Nockenwellensteuerungsventil Endstufe (Bank1,Einlaﬂ)" UWORD B_TRUE 1 100 0 1 BIT_MASK 0x2 FORMAT "%13.11" ECU_ADDRESS 0x3FDD7C /end MEASUREMENT
/begin MEASUREMENT Z_ev5 "Zyklusflag:	EV von Zyl. 5" UWORD B_TRUE 1 100 0 1 BIT_MASK 0x2 FORMAT "%13.11" ECU_ADDRESS 0x3FDD88 /end MEASUREMENT
/begin MEASUREMENT Z_ev6 "Zyklusflag:	EV von Zyl. 6" UWORD B_TRUE 1 100 0 1 BIT_MASK 0x2 FORMAT "%13.11" ECU_ADDRESS 0x3FDD8A /end MEASUREMENT
/begin MEASUREMENT Z_ev7 "Zyklusflag:	EV von Zyl. 7" UWORD B_TRUE 1 100 0 1 BIT_MASK 0x2 FORMAT "%13.11" ECU_ADDRESS 0x3FDD8C /end MEASUREMENT
/begin MEASUREMENT Z_ev8 "Zyklusflag:	EV von Zyl. 8" UWORD B_TRUE 1 100 0 1 BIT_MASK 0x2 FORMAT "%13.11" ECU_ADDRESS 0x3FDD8E /end MEASUREMENT
/begin MEASUREMENT Z_frao "Zyklusflag:LR-Adaption oberer multiplikativer Bereich" UWORD B_TRUE 1 100 0 1 BIT_MASK 0x2 FORMAT "%13.11" ECU_ADDRESS 0x3FDD98 /end MEASUREMENT
/begin MEASUREMENT Z_frau "Zyklusflag:LR-Adaption unterer multiplikativer Bereich" UWORD B_TRUE 1 100 0 1 BIT_MASK 0x2 FORMAT "%13.11" ECU_ADDRESS 0x3FDD9A /end MEASUREMENT
/begin MEASUREMENT Z_frst "Zyklusmeldung Diagnose Kraftstoffversorgungssystem (Kurztest)" UWORD B_TRUE 1 100 0 1 BIT_MASK 0x2 FORMAT "%13.11" ECU_ADDRESS 0x3FDD9C /end MEASUREMENT
/begin MEASUREMENT Z_fst "Zyklusflag: Tankf¸llstand" UWORD B_TRUE 1 100 0 1 BIT_MASK 0x2 FORMAT "%13.11" ECU_ADDRESS 0x3FDD9E /end MEASUREMENT
/begin MEASUREMENT Z_hsvsa "Zyklusflag:  reduzierte  LSU-Heizung oder LSU-Kennlinie abgeflacht" UWORD B_TRUE 1 100 0 1 BIT_MASK 0x2 FORMAT "%13.11" ECU_ADDRESS 0x3FDDA8 /end MEASUREMENT
/begin MEASUREMENT Z_katsp "Zyklusflag:	Katalysator-Konvertierung" UWORD B_TRUE 1 100 0 1 BIT_MASK 0x2 FORMAT "%13.11" ECU_ADDRESS 0x3FDDAC /end MEASUREMENT
/begin MEASUREMENT Z_krtp "Zyklusflag: Klopfregelung Testimpuls" UWORD B_TRUE 1 100 0 1 BIT_MASK 0x2 FORMAT "%13.11" ECU_ADDRESS 0x3FDDB8 /end MEASUREMENT
/begin MEASUREMENT Z_ks1 "Zyklusflag: Klopfsensor 1" UWORD B_TRUE 1 100 0 1 BIT_MASK 0x2 FORMAT "%13.11" ECU_ADDRESS 0x3FDDBA /end MEASUREMENT
/begin MEASUREMENT Z_ks2 "Zyklusflag: Klopfsensor 2" UWORD B_TRUE 1 100 0 1 BIT_MASK 0x2 FORMAT "%13.11" ECU_ADDRESS 0x3FDDBC /end MEASUREMENT
/begin MEASUREMENT Z_ks3 "Zyklusflag: Klopfsensor 3" UWORD B_TRUE 1 100 0 1 BIT_MASK 0x2 FORMAT "%13.11" ECU_ADDRESS 0x3FDDBE /end MEASUREMENT
/begin MEASUREMENT Z_ks4 "Zyklusflag: Klopfsensor 4" UWORD B_TRUE 1 100 0 1 BIT_MASK 0x2 FORMAT "%13.11" ECU_ADDRESS 0x3FDDC0 /end MEASUREMENT
/begin MEASUREMENT Z_kuppl "Zyklusflag: Kupplung betaetigt" UWORD B_TRUE 1 100 0 1 BIT_MASK 0x2 FORMAT "%13.11" ECU_ADDRESS 0x3FDDC2 /end MEASUREMENT
/begin MEASUREMENT Z_lash "Zyklusflag:Lambda-Sondenalterung hinter Kat." UWORD B_TRUE 1 100 0 1 BIT_MASK 0x2 FORMAT "%13.11" ECU_ADDRESS 0x3FDDC4 /end MEASUREMENT
/begin MEASUREMENT Z_latp "Zyklusflag:	Lambda-Sondenalterung TP" UWORD B_TRUE 1 100 0 1 BIT_MASK 0x2 FORMAT "%13.11" ECU_ADDRESS 0x3FDDC6 /end MEASUREMENT
/begin MEASUREMENT Z_latv "Zyklusflag:	Lambda-Sondenalterung TV" UWORD B_TRUE 1 100 0 1 BIT_MASK 0x2 FORMAT "%13.11" ECU_ADDRESS 0x3FDDC8 /end MEASUREMENT
/begin MEASUREMENT Z_latv2 "Zyklusflag:	Lambda-Sondenalterung TV (Bank 2)" UWORD B_TRUE 1 100 0 1 BIT_MASK 0x2 FORMAT "%13.11" ECU_ADDRESS 0x3FDDCA /end MEASUREMENT
/begin MEASUREMENT Z_ldp "Zyklusflag: Leckdiagnosemodul" UWORD B_TRUE 1 100 0 1 BIT_MASK 0x2 FORMAT "%13.11" ECU_ADDRESS 0x3FDDCE /end MEASUREMENT
/begin MEASUREMENT Z_llr "Zyklusflag: Diagnose Leerlaufregelung, Steller" UWORD B_TRUE 1 100 0 1 BIT_MASK 0x2 FORMAT "%13.11" ECU_ADDRESS 0x3FDDD2 /end MEASUREMENT
/begin MEASUREMENT Z_lsh "Zyklusflag: Lambda-Sonde hinter Kat" UWORD B_TRUE 1 100 0 1 BIT_MASK 0x2 FORMAT "%13.11" ECU_ADDRESS 0x3FDDD6 /end MEASUREMENT
/begin MEASUREMENT Z_lsv "Zyklusflag: Lambda-Sonde vor Kat" UWORD B_TRUE 1 100 0 1 BIT_MASK 0x2 FORMAT "%13.11" ECU_ADDRESS 0x3FDDD8 /end MEASUREMENT
/begin MEASUREMENT Z_lsv2 "Zyklusflag: Lambda-Sonde 2 vor Kat" UWORD B_TRUE 1 100 0 1 BIT_MASK 0x2 FORMAT "%13.11" ECU_ADDRESS 0x3FDDDA /end MEASUREMENT
/begin MEASUREMENT Z_md "Zyklusflag: Aussetzer, Summenfehler (multiple)" UWORD B_TRUE 1 100 0 1 BIT_MASK 0x2 FORMAT "%13.11" ECU_ADDRESS 0x3FDDE0 /end MEASUREMENT
/begin MEASUREMENT Z_md00 "Zyklusflag: Aussetzer Z¸ndung 0" UWORD B_TRUE 1 100 0 1 BIT_MASK 0x2 FORMAT "%13.11" ECU_ADDRESS 0x3FDDE2 /end MEASUREMENT
/begin MEASUREMENT Z_md01 "Zyklusflag: Aussetzer Z¸ndung 1" UWORD B_TRUE 1 100 0 1 BIT_MASK 0x2 FORMAT "%13.11" ECU_ADDRESS 0x3FDDE4 /end MEASUREMENT
/begin MEASUREMENT Z_md02 "Zyklusflag: Aussetzer Z¸ndung 2" UWORD B_TRUE 1 100 0 1 BIT_MASK 0x2 FORMAT "%13.11" ECU_ADDRESS 0x3FDDE6 /end MEASUREMENT
/begin MEASUREMENT Z_md03 "Zyklusflag: Aussetzer Z¸ndung 3" UWORD B_TRUE 1 100 0 1 BIT_MASK 0x2 FORMAT "%13.11" ECU_ADDRESS 0x3FDDE8 /end MEASUREMENT
/begin MEASUREMENT Z_md04 "Zyklusflag: Aussetzer Z¸ndung 4" UWORD B_TRUE 1 100 0 1 BIT_MASK 0x2 FORMAT "%13.11" ECU_ADDRESS 0x3FDDEA /end MEASUREMENT
/begin MEASUREMENT Z_md05 "Zyklusflag: Aussetzer Z¸ndung 5" UWORD B_TRUE 1 100 0 1 BIT_MASK 0x2 FORMAT "%13.11" ECU_ADDRESS 0x3FDDEC /end MEASUREMENT
/begin MEASUREMENT Z_md06 "Zyklusflag: Aussetzer Z¸ndung 6" UWORD B_TRUE 1 100 0 1 BIT_MASK 0x2 FORMAT "%13.11" ECU_ADDRESS 0x3FDDEE /end MEASUREMENT
/begin MEASUREMENT Z_md07 "Zyklusflag: Aussetzer Z¸ndung 7" UWORD B_TRUE 1 100 0 1 BIT_MASK 0x2 FORMAT "%13.11" ECU_ADDRESS 0x3FDDF0 /end MEASUREMENT
/begin MEASUREMENT Z_md08 "Zyklusflag: Aussetzer Z¸ndung 8" UWORD B_TRUE 1 100 0 1 BIT_MASK 0x2 FORMAT "%13.11" ECU_ADDRESS 0x3FDDF2 /end MEASUREMENT
/begin MEASUREMENT Z_md09 "Zyklusflag: Aussetzer Z¸ndung 9" UWORD B_TRUE 1 100 0 1 BIT_MASK 0x2 FORMAT "%13.11" ECU_ADDRESS 0x3FDDF4 /end MEASUREMENT
/begin MEASUREMENT Z_md10 "Zyklusflag: Aussetzer Z¸ndung 10" UWORD B_TRUE 1 100 0 1 BIT_MASK 0x2 FORMAT "%13.11" ECU_ADDRESS 0x3FDDF6 /end MEASUREMENT
/begin MEASUREMENT Z_md11 "Zyklusflag: Aussetzer Z¸ndung 11" UWORD B_TRUE 1 100 0 1 BIT_MASK 0x2 FORMAT "%13.11" ECU_ADDRESS 0x3FDDF8 /end MEASUREMENT
/begin MEASUREMENT Z_mdk "Zyklusflag: Aussetzer, Summenfehler - multiple, > 4500 U/min" UWORD B_TRUE 1 100 0 1 BIT_MASK 0x2 FORMAT "%13.11" ECU_ADDRESS 0x3FDDFC /end MEASUREMENT
/begin MEASUREMENT Z_mle "Zyklusflag: L¸fterendstufe" UWORD B_TRUE 1 100 0 1 BIT_MASK 0x2 FORMAT "%13.11" ECU_ADDRESS 0x3FDE00 /end MEASUREMENT
/begin MEASUREMENT Z_nvrbup "Zyklusflag: NVRAM-Backup Schreib-/Lese-Fehler" UWORD B_TRUE 1 100 0 1 BIT_MASK 0x2 FORMAT "%13.11" ECU_ADDRESS 0x3FDE04 /end MEASUREMENT
/begin MEASUREMENT Z_nwkw "Zyklusflag: Zuordnung Nockenwelle zu Kurbelwelle" UWORD B_TRUE 1 100 0 1 BIT_MASK 0x2 FORMAT "%13.11" ECU_ADDRESS 0x3FDE06 /end MEASUREMENT
/begin MEASUREMENT Z_pddss "Zyklusflag: Druck Differenzdrucksensor Saugrohr" UWORD B_TRUE 1 100 0 1 BIT_MASK 0x2 FORMAT "%13.11" ECU_ADDRESS 0x3FDE08 /end MEASUREMENT
/begin MEASUREMENT Z_ph "Zyklusflag: Phasensensor" UWORD B_TRUE 1 100 0 1 BIT_MASK 0x2 FORMAT "%13.11" ECU_ADDRESS 0x3FDE0A /end MEASUREMENT
/begin MEASUREMENT Z_ph2 "Zyklusflag: Phasensensor 2" UWORD B_TRUE 1 100 0 1 BIT_MASK 0x2 FORMAT "%13.11" ECU_ADDRESS 0x3FDE0C /end MEASUREMENT
/begin MEASUREMENT Z_ph3 "Zyklusflag: Phasensensor 3" UWORD B_TRUE 1 100 0 1 BIT_MASK 0x2 FORMAT "%13.11" ECU_ADDRESS 0x3FDE0E /end MEASUREMENT
/begin MEASUREMENT Z_ph4 "Zyklusflag: Phasensensor 4" UWORD B_TRUE 1 100 0 1 BIT_MASK 0x2 FORMAT "%13.11" ECU_ADDRESS 0x3FDE10 /end MEASUREMENT
/begin MEASUREMENT Z_phm "Master-Zyklusflag f¸r Phasensensoren" UWORD B_TRUE 1 100 0 1 BIT_MASK 0x2 FORMAT "%13.11" ECU_ADDRESS 0x3FDE12 /end MEASUREMENT
/begin MEASUREMENT Z_rkat "Zyklusflag:LR-Adaption additiv pro Zeit" UWORD B_TRUE 1 100 0 1 BIT_MASK 0x2 FORMAT "%13.11" ECU_ADDRESS 0x3FDE14 /end MEASUREMENT
/begin MEASUREMENT Z_rkaz "Zyklusflag:LR-Adaption additiv pro Einspritzung" UWORD B_TRUE 1 100 0 1 BIT_MASK 0x2 FORMAT "%13.11" ECU_ADDRESS 0x3FDE16 /end MEASUREMENT
/begin MEASUREMENT Z_slpe "Zyklusflag: Sekund‰rluftpumpe (Endstufe)" UWORD B_TRUE 1 100 0 1 BIT_MASK 0x2 FORMAT "%13.11" ECU_ADDRESS 0x3FDE18 /end MEASUREMENT
/begin MEASUREMENT Z_sls "Zyklusflag: Sekund‰rluft-System" UWORD B_TRUE 1 100 0 1 BIT_MASK 0x2 FORMAT "%13.11" ECU_ADDRESS 0x3FDE1A /end MEASUREMENT
/begin MEASUREMENT Z_slv "Zyklusflag: Sekund‰rluftventil" UWORD B_TRUE 1 100 0 1 BIT_MASK 0x2 FORMAT "%13.11" ECU_ADDRESS 0x3FDE1C /end MEASUREMENT
/begin MEASUREMENT Z_slve "Zyklusflag:	Sekund‰rluftventil (Endstufe)" UWORD B_TRUE 1 100 0 1 BIT_MASK 0x2 FORMAT "%13.11" ECU_ADDRESS 0x3FDE1E /end MEASUREMENT
/begin MEASUREMENT Z_sue "Zyklusflag: Endstufe Saugrohrumschaltung" UWORD B_TRUE 1 100 0 1 BIT_MASK 0x2 FORMAT "%13.11" ECU_ADDRESS 0x3FDE22 /end MEASUREMENT
/begin MEASUREMENT Z_tes "Zyklusflag: Tankentl¸ftungssystem" UWORD B_TRUE 1 100 0 1 BIT_MASK 0x2 FORMAT "%13.11" ECU_ADDRESS 0x3FDE28 /end MEASUREMENT
/begin MEASUREMENT Z_teve "Zyklusflag:	Tankentl¸ftungsventil Endstufe" UWORD B_TRUE 1 100 0 1 BIT_MASK 0x2 FORMAT "%13.11" ECU_ADDRESS 0x3FDE2A /end MEASUREMENT
/begin MEASUREMENT Z_teve2 "Zyklusflag: Tankentl¸ftungsventil Endstufe 2" UWORD B_TRUE 1 100 0 1 BIT_MASK 0x2 FORMAT "%13.11" ECU_ADDRESS 0x3FDE2C /end MEASUREMENT
/begin MEASUREMENT Z_toens "" UWORD B_TRUE 1 100 0 1 BIT_MASK 0x2 FORMAT "%13.11" ECU_ADDRESS 0x3FDE32 /end MEASUREMENT
/begin FUNCTION DFPM_DKRS ""
 /begin DEF_CHARACTERISTIC CDCKS1 CDCKS2 CDCKS3 CDCKS4 CDKKS1 CDKKS2 CDKKS3 CDKKS4 CDTKS1 CDTKS2 CDTKS3 CDTKS4 CLAKS1 CLAKS2 CLAKS3 CLAKS4 FFTKS1 FFTKS2 FFTKS3 FFTKS4 TSFKS1 TSFKS2 TSFKS3 TSFKS4 /end DEF_CHARACTERISTIC
 /begin OUT_MEASUREMENT B_beks1 B_beks2 B_beks3 B_beks4 B_bkks1 B_bkks2 B_bkks3 B_bkks4 B_clks1 B_clks2 B_clks3 B_clks4 B_ftks1 B_ftks2 B_ftks3 B_ftks4 B_mnks1 B_mnks2 B_mnks3 B_mnks4 B_mxks1 B_mxks2 B_mxks3 B_mxks4 B_npks1 B_npks2 B_npks3 B_npks4 B_siks1 B_siks2 B_siks3 B_siks4 E_ks1 E_ks2 E_ks3 E_ks4 sfpks1 sfpks2 sfpks3 sfpks4 TYP_ks1 TYP_ks2 TYP_ks3 TYP_ks4 Z_ks1 Z_ks2 Z_ks3 Z_ks4 /end OUT_MEASUREMENT
/end FUNCTION
/begin FUNCTION DFPM_DKRTP "" /begin DEF_CHARACTERISTIC CDCKRTP CDKKRTP CDTKRTP CLAKRTP FFTKRTP TSFKRTP /end DEF_CHARACTERISTIC
 /begin OUT_MEASUREMENT B_bekrtp B_bkkrtp B_clkrtp B_ftkrtp B_mnkrtp B_mxkrtp B_npkrtp B_sikrtp E_krtp sfpkrtp TYP_krtp Z_krtp /end OUT_MEASUREMENT
/end FUNCTION
/begin FUNCTION DFPM_DKUPPL "" /begin DEF_CHARACTERISTIC CDCKUPPL CDKKUPPL CDTKUPPL CLAKUPPL FFTKUPPL TSFKUPPL /end DEF_CHARACTERISTIC
 /begin OUT_MEASUREMENT B_bekuppl B_bkkuppl B_clkuppl B_ftkuppl B_mnkuppl B_mxkuppl B_npkuppl B_sikuppl E_kuppl sfpkuppl TYP_kuppl Z_kuppl /end OUT_MEASUREMENT
/end FUNCTION
/begin FUNCTION DFPM_DKVS ""
 /begin DEF_CHARACTERISTIC CDCFRAO CDCFRAU CDCFRST CDCRKAT CDCRKAZ CDKFRAO CDKFRAU CDKFRST CDKRKAT CDKRKAZ CDTFRAO CDTFRAU CDTFRST CDTRKAT CDTRKAZ CLAFRAO CLAFRAU CLAFRST CLARKAT CLARKAZ FFTFRAO FFTFRAU FFTFRST FFTRKAT FFTRKAZ TSFFRAO TSFFRAU TSFFRST TSFRKAT TSFRKAZ /end DEF_CHARACTERISTIC
 /begin OUT_MEASUREMENT B_befrao B_befrau B_befrst B_berkat B_berkaz B_bkfrao B_bkfrau B_bkfrst B_bkrkat B_bkrkaz B_clfrao B_clfrau B_clfrst B_clrkat B_clrkaz B_ftfrao B_ftfrau B_ftfrst B_ftrkat B_ftrkaz B_mnfrao B_mnfrau B_mnfrst B_mnrkat B_mnrkaz B_mxfrao B_mxfrau B_mxfrst B_mxrkat B_mxrkaz B_npfrao B_npfrau B_npfrst B_nprkat B_nprkaz B_sifrao B_sifrau B_sifrst B_sirkat B_sirkaz E_frao E_frau E_frst E_rkat E_rkaz sfpfrao sfpfrau sfpfrst sfprkat sfprkaz TYP_frao TYP_frau TYP_frst TYP_rkat TYP_rkaz Z_frao Z_frau Z_frst Z_rkat Z_rkaz /end OUT_MEASUREMENT
/end FUNCTION
/begin FUNCTION DFPM_DLLR "" /begin DEF_CHARACTERISTIC CDCLLR CDKLLR CDTLLR CLALLR FFTLLR TSFLLR /end DEF_CHARACTERISTIC
 /begin OUT_MEASUREMENT B_bellr B_bkllr B_clllr B_ftllr B_mnllr B_mxllr B_npllr B_sillr E_llr sfpllr TYP_LLR Z_llr /end OUT_MEASUREMENT
/end FUNCTION
/begin FUNCTION DFPM_DLSA ""
 /begin DEF_CHARACTERISTIC CDCLATP CDCLATV CDCLATV2 CDKLATP CDKLATV CDKLATV2 CDTLATP CDTLATV CDTLATV2 CLALATP CLALATV CLALATV2 FFTLATP FFTLATV FFTLATV2 TSFLATP TSFLATV TSFLATV2 /end DEF_CHARACTERISTIC
 /begin OUT_MEASUREMENT B_belatp B_belatv B_belatv2 B_bklatp B_bklatv B_bklatv2 B_cllatp B_cllatv B_cllatv2 B_ftlatp B_ftlatv B_ftlatv2 B_mnlatp B_mnlatv B_mnlatv2 B_mxlatp B_mxlatv B_mxlatv2 B_nplatp B_nplatv B_nplatv2 B_silatp B_silatv B_silatv2 E_latp E_latv E_latv2 sfplatp sfplatv sfplatv2 TYP_latp TYP_latv TYP_latv2 Z_latp Z_latv Z_latv2 /end OUT_MEASUREMENT
/end FUNCTION
/begin FUNCTION DFPM_DLSAHK "" /begin DEF_CHARACTERISTIC CDCLASH CDKLASH CDTLASH CLALASH FFTLASH TSFLASH /end DEF_CHARACTERISTIC
 /begin OUT_MEASUREMENT B_belash B_bklash B_cllash B_falash B_mnlash B_mxlash B_nplash B_silash E_lash sfplash TYP_lash Z_lash /end OUT_MEASUREMENT
/end FUNCTION
/begin FUNCTION DFPM_DLSH "" /begin DEF_CHARACTERISTIC CDCLSH CDKLSH CDTLSH CLALSH FFTLSH TSFLSH /end DEF_CHARACTERISTIC
 /begin OUT_MEASUREMENT B_belsh B_bklsh B_cllsh B_ftlsh B_mnlsh B_mxlsh B_nplsh B_silsh E_lsh sfplsh TYP_lsh Z_lsh /end OUT_MEASUREMENT
/end FUNCTION
/begin FUNCTION DFPM_DLSV ""
 /begin DEF_CHARACTERISTIC CDCLSV CDCLSV2 CDKLSV CDKLSV2 CDTLSV CDTLSV2 CLALSV CLALSV2 FFTLSV FFTLSV2 TSFLSV TSFLSV2 /end DEF_CHARACTERISTIC
 /begin OUT_MEASUREMENT B_belsv B_belsv2 B_bklsv B_bklsv2 B_cllsv B_cllsv2 B_ftlsv B_ftlsv2 B_mnlsv B_mnlsv2 B_mxlsv B_mxlsv2 B_nplsv B_nplsv2 B_silsv B_silsv2 E_lsv E_lsv2 sfplsv sfplsv2 TYP_lsv TYP_lsv2 Z_lsv Z_lsv2 /end OUT_MEASUREMENT
/end FUNCTION
/begin FUNCTION DFPM_DMDMIL "DMDMIL.exported"
 /begin DEF_CHARACTERISTIC CDCMD CDCMD00 CDCMD01 CDCMD02 CDCMD03 CDCMD04 CDCMD05 CDCMD06 CDCMD07 CDCMD08 CDCMD09 CDCMD10 CDCMD11 CDKMD CDKMD00 CDKMD01 CDKMD02 CDKMD03 CDKMD04 CDKMD05 CDKMD06 CDKMD07 CDKMD08 CDKMD09 CDKMD10 CDKMD11 CDTMD CDTMD00 CDTMD01 CDTMD02 CDTMD03 CDTMD04 CDTMD05 CDTMD06 CDTMD07 CDTMD08 CDTMD09 CDTMD10 CDTMD11 CLAMD CLAMD00 CLAMD01 CLAMD02 CLAMD03 CLAMD04 CLAMD05 CLAMD06 CLAMD07 CLAMD08 CLAMD09 CLAMD10 CLAMD11 FFTMD FFTMD00 FFTMD01 FFTMD02 FFTMD03 FFTMD04 FFTMD05 FFTMD06 FFTMD07 FFTMD08 FFTMD09 FFTMD10 FFTMD11 TSFMD TSFMD00 TSFMD01 TSFMD02 TSFMD03 TSFMD04 TSFMD05 TSFMD06 TSFMD07 TSFMD08 TSFMD09 TSFMD10 TSFMD11 /end DEF_CHARACTERISTIC
 /begin OUT_MEASUREMENT B_bemd B_bemd00 B_bemd01 B_bemd02 B_bemd03 B_bemd04 B_bemd05 B_bemd06 B_bemd07 B_bemd08 B_bemd09 B_bemd10 B_bemd11 B_bkmd B_bkmd00 B_bkmd01 B_bkmd02 B_bkmd03 B_bkmd04 B_bkmd05 B_bkmd06 B_bkmd07 B_bkmd08 B_bkmd09 B_bkmd10 B_bkmd11 B_clmd B_clmd00 B_clmd01 B_clmd02 B_clmd03 B_clmd04 B_clmd05 B_clmd06 B_clmd07 B_clmd08 B_clmd09 B_clmd10 B_clmd11 B_ftmd B_ftmd00 B_ftmd01 B_ftmd02 B_ftmd03 B_ftmd04 B_ftmd05 B_ftmd06 B_ftmd07 B_ftmd08 B_ftmd09 B_ftmd10 B_ftmd11 B_mnmd B_mnmd00 B_mnmd01 B_mnmd02 B_mnmd03 B_mnmd04 B_mnmd05 B_mnmd06 B_mnmd07 B_mnmd08 B_mnmd09 B_mnmd10 B_mnmd11 B_mxmd B_mxmd00 B_mxmd01 B_mxmd02 B_mxmd03 B_mxmd04 B_mxmd05 B_mxmd06 B_mxmd07 B_mxmd08 B_mxmd09 B_mxmd10 B_mxmd11 B_npmd B_npmd00 B_npmd01 B_npmd02 B_npmd03 B_npmd04 B_npmd05 B_npmd06 B_npmd07 B_npmd08 B_npmd09 B_npmd10 B_npmd11 B_simd B_simd00 B_simd01 B_simd02 B_simd03 B_simd04 B_simd05 B_simd06 B_simd07 B_simd08 B_simd09 B_simd10 B_simd11 E_md E_md00 E_md01 E_md02 E_md03 E_md04 E_md05 E_md06 E_md07 E_md08 E_md09 E_md10 E_md11 sfpmd sfpmd00 sfpmd01 sfpmd02 sfpmd03 sfpmd04 sfpmd05 sfpmd06 sfpmd07 sfpmd08 sfpmd09 sfpmd10 sfpmd11 TYP_md TYP_md00 TYP_md01 TYP_md02 TYP_md03 TYP_md04 TYP_md05 TYP_md06 TYP_md07 TYP_md08 TYP_md09 TYP_md10 TYP_md11 Z_md Z_md00 Z_md01 Z_md02 Z_md03 Z_md04 Z_md05 Z_md06 Z_md07 Z_md08 Z_md09 Z_md10 Z_md11 /end OUT_MEASUREMENT
/end FUNCTION
/begin FUNCTION DFPM_DMLSE "" /begin DEF_CHARACTERISTIC CDCMLE CDKMLE CDTMLE CLAMLE FFTMLE TSFMLE /end DEF_CHARACTERISTIC
 /begin OUT_MEASUREMENT B_bemle B_bkmle B_clmle B_ftmle B_mnmle B_mxmle B_npmle B_simle E_mle sfpmle TYP_mle Z_mle /end OUT_MEASUREMENT
/end FUNCTION
/begin FUNCTION DFPM_DMYDFPM ""
 /begin DEF_CHARACTERISTIC CDCAGRE CDCAGRF CDCBKVP CDCDDSS CDCDMTK CDCDMTL CDCDSS CDCEV5 CDCEV6 CDCEV7 CDCEV8 CDCFST CDCHSVSA CDCKATSP CDCLDP CDCMDK CDCNWKW CDCPDDSS CDCSLVE CDCTEVE2 CDKAGRE CDKAGRF CDKBKVP CDKDDSS CDKDMTK CDKDMTL CDKDSS CDKEV5 CDKEV6 CDKEV7 CDKEV8 CDKFST CDKHSVSA CDKKATSP CDKLDP CDKMDK CDKNWKW CDKPDDSS CDKSLVE CDKTEVE2 CDTAGRE CDTAGRF CDTBKVP CDTDDSS CDTDMTK CDTDMTL CDTDSS CDTEV5 CDTEV6 CDTEV7 CDTEV8 CDTFST CDTHSVSA CDTKATSP CDTLDP CDTMDK CDTNWKW CDTPDDSS CDTSLVE CDTTEVE2 CLAAGRE CLAAGRF CLABKVP CLADDSS CLADMTK CLADMTL CLADSS CLAEV5 CLAEV6 CLAEV7 CLAEV8 CLAFST CLAHSVSA CLAKATSP CLALDP CLAMDK CLANWKW CLAPDDSS CLASLVE CLATEVE2 FFTAGRE FFTAGRF FFTBKVP FFTDDSS FFTDMTK FFTDMTL FFTDSS FFTEV5 FFTEV6 FFTEV7 FFTEV8 FFTFST FFTHSVSA FFTKATSP FFTLDP FFTMDK FFTNWKW FFTPDDSS FFTSLVE FFTTEVE2 TSFAGRE TSFAGRF TSFBKVP TSFDDSS TSFDMTK TSFDMTL TSFDSS TSFEV5 TSFEV6 TSFEV7 TSFEV8 TSFFST TSFHSVSA TSFKATSP TSFLDP TSFMDK TSFNWKW TSFPDDSS TSFSLVE TSFTEVE2 /end DEF_CHARACTERISTIC
 /begin OUT_MEASUREMENT E_agre E_agrf E_bkvp E_ddss E_dmtk E_dmtl E_dss E_ev5 E_ev6 E_ev7 E_ev8 E_fst E_hsvsa E_katsp E_ldp E_mdk E_nwkw E_pddss E_slve E_teve2 sfpagre sfpagrf sfpbkvp sfpddss sfpdmtk sfpdmtl sfpdss sfpev5 sfpev6 sfpev7 sfpev8 sfpfst sfphsvsa sfpkatsp sfpldp sfpmdk sfpnwkw sfppddss sfpslve sfpteve2 Z_agre Z_agrf Z_bkvp Z_ddss Z_dmtk Z_dmtl Z_dss Z_ev5 Z_ev6 Z_ev7 Z_ev8 Z_fst Z_hsvsa Z_katsp Z_ldp Z_mdk Z_nwkw Z_pddss Z_slve Z_teve2 /end OUT_MEASUREMENT
/end FUNCTION
/begin FUNCTION DFPM_DNVRBUP ""
 /begin DEF_CHARACTERISTIC CDCNVRBUP CDKNVRBUP CDTNVRBUP CLANVRBUP FFTNVRBUP TSFNVRBUP /end DEF_CHARACTERISTIC
 /begin OUT_MEASUREMENT B_benvrbup B_bknvrbup B_clnvrbup B_ftnvrbup B_mnnvrbup B_mxnvrbup B_npnvrbup B_sinvrbup E_nvrbup sfpnvrbup TYP_nvrbup Z_nvrbup /end OUT_MEASUREMENT
/end FUNCTION
/begin FUNCTION DFPM_DNWSAUS "DNWSAUS.exported" /begin DEF_CHARACTERISTIC CDCANWS CDKANWS CDTANWS CLAANWS FFTANWS TSFANWS /end DEF_CHARACTERISTIC
 /begin OUT_MEASUREMENT B_beanws B_bkanws B_clanws B_ftanws B_mnanws B_mxanws B_npanws B_sianws E_anws sfpanws TYP_anws Z_anws /end OUT_MEASUREMENT
/end FUNCTION
/begin FUNCTION DFPM_DNWSEAUS "" /begin DEF_CHARACTERISTIC CDCANWSE CDKANWSE CDTANWSE CLAANWSE FFTANWSE TSFANWSE /end DEF_CHARACTERISTIC
 /begin OUT_MEASUREMENT B_beanwse B_bkanwse B_clanwse B_ftanwse B_mnanwse B_mxanwse B_npanwse B_sianwse E_anwse sfpanwse TYP_anwse Z_anwse /end OUT_MEASUREMENT
/end FUNCTION
/begin FUNCTION DFPM_DNWSEEIN "" /begin DEF_CHARACTERISTIC CDCENWSE CDKENWSE CDTENWSE CLAENWSE FFTENWSE TSFENWSE /end DEF_CHARACTERISTIC
 /begin OUT_MEASUREMENT B_beenwse B_bkenwse B_clenwse B_ftenwse B_mnenwse B_mxenwse B_npenwse B_sienwse E_enwse sfpenwse TYP_enwse Z_enwse /end OUT_MEASUREMENT
/end FUNCTION
/begin FUNCTION DFPM_DNWSEIN "DNWSEIN.exported" /begin DEF_CHARACTERISTIC CDCENWS CDKENWS CDTENWS CLAENWS FFTENWS TSFENWS /end DEF_CHARACTERISTIC
 /begin OUT_MEASUREMENT B_beenws B_bkenws B_clenws B_ftenws B_mnenws B_mxenws B_npenws B_sienws E_enws sfpenws TYP_enws Z_enws /end OUT_MEASUREMENT
/end FUNCTION
/begin FUNCTION DFPM_DPH "DPH."
 /begin DEF_CHARACTERISTIC CDCPH CDCPH2 CDCPH3 CDCPH4 CDCPHM CDKPH CDKPH2 CDKPH3 CDKPH4 CDKPHM CDTPH CDTPH2 CDTPH3 CDTPH4 CDTPHM CLAPH CLAPH2 CLAPH3 CLAPH4 CLAPHM FFTPH FFTPH2 FFTPH3 FFTPH4 FFTPHM TSFPH TSFPH2 TSFPH3 TSFPH4 TSFPHM /end DEF_CHARACTERISTIC
 /begin OUT_MEASUREMENT B_beph B_beph2 B_beph3 B_beph4 B_bephm B_bkph B_bkph2 B_bkph3 B_bkph4 B_bkphm B_clph B_clph2 B_clph3 B_clph4 B_clphm B_ftph B_ftph2 B_ftph3 B_ftph4 B_ftphm B_mnph B_mnph2 B_mnph3 B_mnph4 B_mnphm B_mxph B_mxph2 B_mxph3 B_mxph4 B_mxphm B_npph B_npph2 B_npph3 B_npph4 B_npphm B_siph B_siph2 B_siph3 B_siph4 B_siphm E_ph E_ph2 E_ph3 E_ph4 E_phm sfpph sfpph2 sfpph3 sfpph4 sfpphm TYP_ph TYP_ph2 TYP_ph3 TYP_ph4 TYP_phm Z_ph Z_ph2 Z_ph3 Z_ph4 Z_phm /end OUT_MEASUREMENT
/end FUNCTION
/begin FUNCTION DFPM_DSLPE "" /begin DEF_CHARACTERISTIC CDCSLPE CDKSLPE CDTSLPE CLASLPE FFTSLPE TSFSLPE /end DEF_CHARACTERISTIC
 /begin OUT_MEASUREMENT B_beslpe B_bkslpe B_clslpe B_ftslpe B_mnslpe B_mxslpe B_npslpe B_sislpe E_slpe sfpslpe TYP_slpe Z_slpe /end OUT_MEASUREMENT
/end FUNCTION
/begin FUNCTION DFPM_DSLSLR ""
 /begin DEF_CHARACTERISTIC CDCSLS CDCSLV CDKSLS CDKSLV CDTSLS CDTSLV CLASLS CLASLV FFTSLS FFTSLV TSFSLS TSFSLV /end DEF_CHARACTERISTIC
 /begin OUT_MEASUREMENT B_besls B_beslv B_bksls B_bkslv B_clsls B_clslv B_ftsls B_ftslv B_mnsls B_mnslv B_mxsls B_mxslv B_npsls B_npslv B_sisls B_sislv E_sls E_slv sfpsls sfpslv TYP_sls TYP_slv Z_sls Z_slv /end OUT_MEASUREMENT
/end FUNCTION
/begin FUNCTION DFPM_DSUE "" /begin DEF_CHARACTERISTIC CDCSUE CDKSUE CDTSUE CLASUE FFTSUE TSFSUE /end DEF_CHARACTERISTIC
 /begin OUT_MEASUREMENT B_besue B_bksue B_clsue B_ftsue B_mnsue B_mxsue B_npsue B_sisue E_sue sfpsue TYP_sue Z_sue /end OUT_MEASUREMENT
/end FUNCTION
/begin FUNCTION DFPM_DTEVE "" /begin DEF_CHARACTERISTIC CDCTEVE CDKTEVE CDTTEVE CLATEVE FFTTEVE TSFTEVE /end DEF_CHARACTERISTIC
 /begin OUT_MEASUREMENT B_beteve B_bkteve B_clteve B_ftteve B_mnteve B_mxteve B_npteve B_siteve E_teve sfpteve TYP_teve Z_teve /end OUT_MEASUREMENT
/end FUNCTION
/begin FUNCTION DFPM_DTEVN "" /begin DEF_CHARACTERISTIC CDCTES CDKTES CDTTES CLATES FFTTES TSFTES /end DEF_CHARACTERISTIC /begin OUT_MEASUREMENT B_cltes B_mntes E_tes sfptes Z_tes /end OUT_MEASUREMENT /end FUNCTION
/begin FUNCTION DFPM_DTOENS "" /begin DEF_CHARACTERISTIC CDCTOENS CDKTOENS CDTTOENS CLATOENS FFTTOENS TSFTOENS /end DEF_CHARACTERISTIC
 /begin OUT_MEASUREMENT B_betoens B_bktoens B_cltoens B_fttoens B_mntoens B_mxtoens B_nptoens B_sitoens E_toens sfptoens TYP_toens Z_toens /end OUT_MEASUREMENT
/end FUNCTION
/begin COMPU_METHOD B_TRUE "boolsche Zust‰nde, positive Logik" TAB_VERB "%6.3" "" COMPU_TAB_REF B_TRUE /end COMPU_METHOD
/begin COMPU_VTAB B_TRUE "boolsche Zust‰nde, positive Logik" TAB_VERB 2 0 "----" 1 "TRUE" /end COMPU_VTAB
/begin COMPU_METHOD DEZ "1 : 1 Umrechnug (dez/hex)" RAT_FUNC "%6.2" "" COEFFS 0 1 0 0 0 1 /end COMPU_METHOD
/begin COMPU_METHOD dez "1 : 1 Umrechnug (dez/hex)" RAT_FUNC "%6.2" "" COEFFS 0 1 0 0 0 1 /end COMPU_METHOD
/begin RECORD_LAYOUT KwbUb FNC_VALUES 1 UBYTE COLUMN_DIR DIRECT /end RECORD_LAYOUT
/begin RECORD_LAYOUT KwbUw FNC_VALUES 1 UWORD COLUMN_DIR DIRECT /end RECORD_LAYOUT
/begin RECORD_LAYOUT KwbWU16 FNC_VALUES 1 UWORD COLUMN_DIR DIRECT /end RECORD_LAYOUT
/begin RECORD_LAYOUT KwbWU8 FNC_VALUES 1 UBYTE COLUMN_DIR DIRECT /end RECORD_LAYOUT
/begin RECORD_LAYOUT KwUb FNC_VALUES 1 UBYTE COLUMN_DIR DIRECT /end RECORD_LAYOUT
/begin RECORD_LAYOUT KwUw FNC_VALUES 1 UWORD COLUMN_DIR DIRECT /end RECORD_LAYOUT
/begin RECORD_LAYOUT KwWU16 FNC_VALUES 1 UWORD COLUMN_DIR DIRECT /end RECORD_LAYOUT
/begin RECORD_LAYOUT KwWU8 FNC_VALUES 1 UBYTE COLUMN_DIR DIRECT /end RECORD_LAYOUT
/end MODULE
/end PROJECT
