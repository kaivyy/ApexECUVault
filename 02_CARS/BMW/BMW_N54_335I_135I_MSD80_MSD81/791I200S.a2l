ASAP2_VERSION 1 41
/begin PROJECT MSD85 "Spray Guided DI-System with Piezo Injectors for 8-Cylinder"
/begin HEADER "_default_HeaderComment" PROJECT_NO _91 /end HEADER
/begin MODULE _default_ModuleName "_default_ModuleLongIdentifier"
/begin MOD_COMMON "_default_ModCommonComment" DEPOSIT ABSOLUTE BYTE_ORDER MSB_LAST ALIGNMENT_BYTE 1 ALIGNMENT_WORD 2 ALIGNMENT_LONG 2 ALIGNMENT_FLOAT32_IEEE 2 ALIGNMENT_FLOAT64_IEEE 4 /end MOD_COMMON
/begin CHARACTERISTIC c_mod_2_pid_5_diag "Calibration byte which defines the PIDs supported by mode 02 (19h -20h)" VALUE 0xa080bed7 _REC_VAL_20_u1 255. _CNV_A_R_LINEAR_____0_CM 0. 255. DISPLAY_IDENTIFIER C_MOD_2_PID_5_DIAG FORMAT "%3.0" /end CHARACTERISTIC
/begin CHARACTERISTIC c_mod_2_pid_6_diag "Calibration byte which defines the PIDs supported by mode 02 (19h -20h)" VALUE 0xa080bed8 _REC_VAL_20_u1 255. _CNV_A_R_LINEAR_____0_CM 0. 255. DISPLAY_IDENTIFIER C_MOD_2_PID_6_DIAG FORMAT "%3.0" /end CHARACTERISTIC
/begin CHARACTERISTIC c_mod_2_pid_7_diag "Calibration byte which defines the PIDs supported by mode 02 (19h -20h)" VALUE 0xa080bed9 _REC_VAL_20_u1 255. _CNV_A_R_LINEAR_____0_CM 0. 255. DISPLAY_IDENTIFIER C_MOD_2_PID_7_DIAG FORMAT "%3.0" /end CHARACTERISTIC
/begin CHARACTERISTIC c_mod_2_pid_8_diag "Calibration byte which defines the PIDs supported by mode 02 (19h -20h)" VALUE 0xa080beda _REC_VAL_20_u1 255. _CNV_A_R_LINEAR_____0_CM 0. 255. DISPLAY_IDENTIFIER C_MOD_2_PID_8_DIAG FORMAT "%3.0" /end CHARACTERISTIC
/begin CHARACTERISTIC c_mod_2_pid_9_diag "Calibration byte which defines the PIDs supported by mode 02 (19h -20h)" VALUE 0xa080bedb _REC_VAL_20_u1 255. _CNV_A_R_LINEAR_____0_CM 0. 255. DISPLAY_IDENTIFIER C_MOD_2_PID_9_DIAG FORMAT "%3.0" /end CHARACTERISTIC
/begin CHARACTERISTIC c_mod_2_pid_A_diag "Calibration byte which defines the PIDs supported by mode 02 (19h -20h)" VALUE 0xa080bedc _REC_VAL_20_u1 255. _CNV_A_R_LINEAR_____0_CM 0. 255. DISPLAY_IDENTIFIER C_MOD_2_PID_A_DIAG FORMAT "%3.0" /end CHARACTERISTIC
/begin CHARACTERISTIC c_mod_2_pid_B_diag "Calibration byte which defines the PIDs supported by mode 02 (19h -20h)" VALUE 0xa080bedd _REC_VAL_20_u1 255. _CNV_A_R_LINEAR_____0_CM 0. 255. DISPLAY_IDENTIFIER C_MOD_2_PID_B_DIAG FORMAT "%3.0" /end CHARACTERISTIC
/begin CHARACTERISTIC c_mod_2_pid_C_diag "Calibration byte which defines the PIDs supported by mode 02 (19h -20h)" VALUE 0xa080bede _REC_VAL_20_u1 255. _CNV_A_R_LINEAR_____0_CM 0. 255. DISPLAY_IDENTIFIER C_MOD_2_PID_C_DIAG FORMAT "%3.0" /end CHARACTERISTIC
/begin CHARACTERISTIC c_clc_ready_obd_1 "Calibration byte to force readiness to 0 without calculation" VALUE 0xa080baae _REC_VAL_20_u1 255. _CNV_A_R_LINEAR_____0_CM 0. 255. DISPLAY_IDENTIFIER C_CLC_READY_OBD_1 FORMAT "%3.0" /end CHARACTERISTIC
/begin CHARACTERISTIC lc_var_obdc_can "Logical switch to activate OBD communication on CAN (=1) / or K-line (=0)" VALUE 0xa080c666 _REC_VAL_20_u1 1. _CNV_A_R_LINEAR_____0_CM 0. 1. DISPLAY_IDENTIFIER LC_VAR_OBDC_CAN FORMAT "%2.0" /end CHARACTERISTIC
/begin CHARACTERISTIC c_mod_5_tid_1_diag "Calibration byte which defines the TIDs supported by mode 05 (01h - 08h)" VALUE 0xa080bee9 _REC_VAL_20_u1 255. _CNV_A_R_LINEAR_____0_CM 0. 255. DISPLAY_IDENTIFIER C_MOD_5_TID_1_DIAG FORMAT "%3.0" /end CHARACTERISTIC
/begin CHARACTERISTIC c_mod_5_tid_2_diag "Calibration byte which defines the TIDs supported by mode 05 (09h - 10h)" VALUE 0xa080beeb _REC_VAL_20_u1 255. _CNV_A_R_LINEAR_____0_CM 0. 255. DISPLAY_IDENTIFIER C_MOD_5_TID_2_DIAG FORMAT "%3.0" /end CHARACTERISTIC
/begin CHARACTERISTIC c_mod_5_tid_3_diag "Calibration byte which defines the TIDs supported by mode 05 (11h - 18h)" VALUE 0xa080beec _REC_VAL_20_u1 255. _CNV_A_R_LINEAR_____0_CM 0. 255. DISPLAY_IDENTIFIER C_MOD_5_TID_3_DIAG FORMAT "%3.0" /end CHARACTERISTIC
/begin CHARACTERISTIC c_mod_5_tid_4_diag "Calibration byte which defines the TIDs supported by mode 05 (19h - 20h)" VALUE 0xa080beed _REC_VAL_20_u1 255. _CNV_A_R_LINEAR_____0_CM 0. 255. DISPLAY_IDENTIFIER C_MOD_5_TID_4_DIAG FORMAT "%3.0" /end CHARACTERISTIC
/begin CHARACTERISTIC c_mod_5_tid_5_diag "Calibration byte which defines the TIDs supported by mode 05 (21h - 28h)" VALUE 0xa080beee _REC_VAL_20_u1 255. _CNV_A_R_LINEAR_____0_CM 0. 255. DISPLAY_IDENTIFIER C_MOD_5_TID_5_DIAG FORMAT "%3.0" /end CHARACTERISTIC
/begin CHARACTERISTIC c_mod_5_tid_6_diag "Calibration byte which defines the TIDs supported by mode 05 (29h - 30h)" VALUE 0xa080beef _REC_VAL_20_u1 255. _CNV_A_R_LINEAR_____0_CM 0. 255. DISPLAY_IDENTIFIER C_MOD_5_TID_6_DIAG FORMAT "%3.0" /end CHARACTERISTIC
/begin CHARACTERISTIC c_mod_5_tid_7_diag "Calibration byte which defines the TIDs supported by mode 05 (31h - 38h)" VALUE 0xa080bef0 _REC_VAL_20_u1 255. _CNV_A_R_LINEAR_____0_CM 0. 255. DISPLAY_IDENTIFIER C_MOD_5_TID_7_DIAG FORMAT "%3.0" /end CHARACTERISTIC
/begin CHARACTERISTIC c_mod_5_tid_8_diag "Calibration byte which defines the TIDs supported by mode 05 (39h - 40h)" VALUE 0xa080bef1 _REC_VAL_20_u1 255. _CNV_A_R_LINEAR_____0_CM 0. 255. DISPLAY_IDENTIFIER C_MOD_5_TID_8_DIAG FORMAT "%3.0" /end CHARACTERISTIC
/begin CHARACTERISTIC c_mod_5_tid_9_diag "Calibration byte which defines the TIDs supported by mode 05 (41h - 48h)" VALUE 0xa080bef2 _REC_VAL_20_u1 255. _CNV_A_R_LINEAR_____0_CM 0. 255. DISPLAY_IDENTIFIER C_MOD_5_TID_9_DIAG FORMAT "%3.0" /end CHARACTERISTIC
/begin CHARACTERISTIC c_mod_5_tid_10_diag "Calibration byte which defines the TIDs supported by mode 05 (49h - 50h)" VALUE 0xa080bedf _REC_VAL_20_u1 255. _CNV_A_R_LINEAR_____0_CM 0. 255. DISPLAY_IDENTIFIER C_MOD_5_TID_10_DIAG FORMAT "%3.0" /end CHARACTERISTIC
/begin CHARACTERISTIC c_mod_5_tid_11_diag "Calibration byte which defines the TIDs supported by mode 05 (51h - 58h)" VALUE 0xa080bee0 _REC_VAL_20_u1 255. _CNV_A_R_LINEAR_____0_CM 0. 255. DISPLAY_IDENTIFIER C_MOD_5_TID_11_DIAG FORMAT "%3.0" /end CHARACTERISTIC
/begin CHARACTERISTIC c_mod_5_tid_12_diag "Calibration byte which defines the TIDs supported by mode 05 (59h - 60h)" VALUE 0xa080bee1 _REC_VAL_20_u1 255. _CNV_A_R_LINEAR_____0_CM 0. 255. DISPLAY_IDENTIFIER C_MOD_5_TID_12_DIAG FORMAT "%3.0" /end CHARACTERISTIC
/begin CHARACTERISTIC c_mod_5_tid_13_diag "Calibration byte which defines the TIDs supported by mode 05 (61h - 68h)" VALUE 0xa080bee2 _REC_VAL_20_u1 255. _CNV_A_R_LINEAR_____0_CM 0. 255. DISPLAY_IDENTIFIER C_MOD_5_TID_13_DIAG FORMAT "%3.0" /end CHARACTERISTIC
/begin CHARACTERISTIC c_mod_5_tid_14_diag "Calibration byte which defines the TIDs supported by mode 05 (69h - 70h)" VALUE 0xa080bee3 _REC_VAL_20_u1 255. _CNV_A_R_LINEAR_____0_CM 0. 255. DISPLAY_IDENTIFIER C_MOD_5_TID_14_DIAG FORMAT "%3.0" /end CHARACTERISTIC
/begin CHARACTERISTIC c_mod_5_tid_15_diag "Calibration byte which defines the TIDs supported by mode 05 (71h - 78h)" VALUE 0xa080bee4 _REC_VAL_20_u1 255. _CNV_A_R_LINEAR_____0_CM 0. 255. DISPLAY_IDENTIFIER C_MOD_5_TID_15_DIAG FORMAT "%3.0" /end CHARACTERISTIC
/begin CHARACTERISTIC c_mod_5_tid_16_diag "Calibration byte which defines the TIDs supported by mode 05 (79h - 80h)" VALUE 0xa080bee5 _REC_VAL_20_u1 255. _CNV_A_R_LINEAR_____0_CM 0. 255. DISPLAY_IDENTIFIER C_MOD_5_TID_16_DIAG FORMAT "%3.0" /end CHARACTERISTIC
/begin CHARACTERISTIC c_mod_5_tid_17_diag "Calibration byte which defines the TIDs supported by mode 05 (81h - 88h)" VALUE 0xa080bee6 _REC_VAL_20_u1 255. _CNV_A_R_LINEAR_____0_CM 0. 255. DISPLAY_IDENTIFIER C_MOD_5_TID_17_DIAG FORMAT "%3.0" /end CHARACTERISTIC
/begin CHARACTERISTIC c_mod_5_tid_18_diag "Calibration byte which defines the TIDs supported by mode 05 (89h - 90h)" VALUE 0xa080bee7 _REC_VAL_20_u1 255. _CNV_A_R_LINEAR_____0_CM 0. 255. DISPLAY_IDENTIFIER C_MOD_5_TID_18_DIAG FORMAT "%3.0" /end CHARACTERISTIC
/begin CHARACTERISTIC c_mod_5_tid_19_diag "Calibration byte which defines the TIDs supported by mode 05 (91h - 98h)" VALUE 0xa080bee8 _REC_VAL_20_u1 255. _CNV_A_R_LINEAR_____0_CM 0. 255. DISPLAY_IDENTIFIER C_MOD_5_TID_19_DIAG FORMAT "%3.0" /end CHARACTERISTIC
/begin CHARACTERISTIC c_mod_5_tid_20_diag "Calibration byte which defines the TIDs supported by mode 05 (99h - A0h)" VALUE 0xa080beea _REC_VAL_20_u1 255. _CNV_A_R_LINEAR_____0_CM 0. 255. DISPLAY_IDENTIFIER C_MOD_5_TID_20_DIAG FORMAT "%3.0" /end CHARACTERISTIC
/begin CHARACTERISTIC c_mod_6_tid_1_diag "Calibration byte which defines the TIDs supported by mode 06 (01h - 08h)" VALUE 0xa080bef3 _REC_VAL_20_u1 255. _CNV_A_R_LINEAR_____0_CM 0. 255. DISPLAY_IDENTIFIER C_MOD_6_TID_1_DIAG FORMAT "%3.0" /end CHARACTERISTIC
/begin CHARACTERISTIC c_mod_6_tid_2_diag "Calibration byte which defines the TIDs supported by mode 06 (09h - 10h)" VALUE 0xa080bef4 _REC_VAL_20_u1 255. _CNV_A_R_LINEAR_____0_CM 0. 255. DISPLAY_IDENTIFIER C_MOD_6_TID_2_DIAG FORMAT "%3.0" /end CHARACTERISTIC
/begin CHARACTERISTIC c_mod_6_tid_3_diag "Calibration byte which defines the TIDs supported by mode 06 (11h - 18h)" VALUE 0xa080bef5 _REC_VAL_20_u1 255. _CNV_A_R_LINEAR_____0_CM 0. 255. DISPLAY_IDENTIFIER C_MOD_6_TID_3_DIAG FORMAT "%3.0" /end CHARACTERISTIC
/begin CHARACTERISTIC c_mod_6_tid_4_diag "Calibration byte which defines the TIDs supported by mode 06 (19h - 20h)" VALUE 0xa080bef6 _REC_VAL_20_u1 255. _CNV_A_R_LINEAR_____0_CM 0. 255. DISPLAY_IDENTIFIER C_MOD_6_TID_4_DIAG FORMAT "%3.0" /end CHARACTERISTIC
/begin CHARACTERISTIC c_mod_9_vit_1_diag "Calibration byte which defines the VITs supported by mode 09 (01h - 08h)" VALUE 0xa080bef7 _REC_VAL_20_u1 255. _CNV_A_R_LINEAR_____0_CM 0. 255. DISPLAY_IDENTIFIER C_MOD_9_VIT_1_DIAG FORMAT "%3.0" /end CHARACTERISTIC
/begin CHARACTERISTIC c_mod_9_vit_2_diag "Calibration byte which defines the VITs supported by mode 09 (09h - 10h)" VALUE 0xa080bef8 _REC_VAL_20_u1 255. _CNV_A_R_LINEAR_____0_CM 0. 255. DISPLAY_IDENTIFIER C_MOD_9_VIT_2_DIAG FORMAT "%3.0" /end CHARACTERISTIC
/begin CHARACTERISTIC c_mod_9_vit_3_diag "Calibration byte which defines the VITs supported by mode 09 (11h - 18h)" VALUE 0xa080bef9 _REC_VAL_20_u1 255. _CNV_A_R_LINEAR_____0_CM 0. 255. DISPLAY_IDENTIFIER C_MOD_9_VIT_3_DIAG FORMAT "%3.0" /end CHARACTERISTIC
/begin CHARACTERISTIC c_mod_9_vit_4_diag "Calibration byte which defines the VITs supported by mode 09 (19h - 20h)" VALUE 0xa080befa _REC_VAL_20_u1 255. _CNV_A_R_LINEAR_____0_CM 0. 255. DISPLAY_IDENTIFIER C_MOD_9_VIT_4_DIAG FORMAT "%3.0" /end CHARACTERISTIC
/begin CHARACTERISTIC lc_sa_swi_acq "logical constant for decision SAF_KGH through model value (=1) SAFM is used" VALUE 0xa080c5ec _REC_VAL_20_u1 1. _CNV_A_R_LINEAR_____0_CM 0. 1. DISPLAY_IDENTIFIER LC_SA_SWI_ACQ FORMAT "%2.0" /end CHARACTERISTIC
/begin CHARACTERISTIC c_sum_afl_vls_min_diag_sa_1 "Lean indication threshold for Monitoring of minimum flow rate" VALUE 0xa080c0fa _REC_VAL_20_u2 65535. _CNV_A_R_LINEAR_____0_CM 0. 65535. DISPLAY_IDENTIFIER C_SUM_AFL_VLS_MIN_DIAG_SA_1 FORMAT "%5.0" /end CHARACTERISTIC
/begin CHARACTERISTIC c_sum_afl_vls_min_diag_sa_2 "Lean indication threshold for Monitoring of minimum flow rate" VALUE 0xa080c0fc _REC_VAL_20_u2 65535. _CNV_A_R_LINEAR_____0_CM 0. 65535. DISPLAY_IDENTIFIER C_SUM_AFL_VLS_MIN_DIAG_SA_2 FORMAT "%5.0" /end CHARACTERISTIC
/begin AXIS_PTS ldp_tco_ip_n_thd_isc_act_ast "" 0xa0802160 tco _REC_AXS_20_u1 190.5 _CNV_A_R_LINEAR_____17_CM 4 -48. 142.5 FORMAT "%6.2" /end AXIS_PTS
/begin CHARACTERISTIC c_n_sp_is_max_clc "Maximum limit for calculation of “Engine speed setpoint calculation" VALUE 0xa08024aa _REC_VAL_20_u2 8160. _CNV_A_R_LINEAR_____14_CM 0. 8160. DISPLAY_IDENTIFIER C_N_SP_IS_MAX_CLC FORMAT "%4.0" /end CHARACTERISTIC
/begin AXIS_PTS ldpm_n_dif_cor_tq_i_dt_is_opm_1 "" 0xa08021c8 n_dif_cor _REC_AXS_20_u2 65535. _CNV_A_R_LINEAR_____193_CM 12 -32768. 32767. FORMAT "%6.0" /end AXIS_PTS
/begin AXIS_PTS ldpm_n_dif_cor_tq_i_dt_is_opm_2 "" 0xa08021e4 n_dif_cor _REC_AXS_20_u2 65535. _CNV_A_R_LINEAR_____193_CM 12 -32768. 32767. FORMAT "%6.0" /end AXIS_PTS
/begin AXIS_PTS ldpm_tco__fac_n_grd_is_2 "" 0xa08022a8 tco _REC_AXS_20_u1 190.5 _CNV_A_R_LINEAR_____17_CM 4 -48. 142.5 FORMAT "%6.2" /end AXIS_PTS
/begin AXIS_PTS ldpm_t_ast__fac_n_grd_is "" 0xa0802290 t_ast _REC_AXS_20_u2 6553.5 _CNV_A_R_LINEAR_____4_CM 8 0. 6553.5 FORMAT "%5.1" /end AXIS_PTS
/begin AXIS_PTS ldpm_n_dif_cor_tq_i_is_1_opm_1 "" 0xa0802200 n_dif_cor _REC_AXS_20_u2 65535. _CNV_A_R_LINEAR_____193_CM 12 -32768. 32767. FORMAT "%6.0" /end AXIS_PTS
/begin AXIS_PTS ldpm_n_dif_cor_tq_i_is_1_opm_2 "" 0xa080221c n_dif_cor _REC_AXS_20_u2 65535. _CNV_A_R_LINEAR_____193_CM 12 -32768. 32767. FORMAT "%6.0" /end AXIS_PTS
/begin AXIS_PTS ldpm_n_grd_tq_i_is_1_opm_1 "" 0xa0802268 n_grd _REC_AXS_20_u1 8160. _CNV_A_R_LINEAR_____29_CM 8 -4096. 4064. FORMAT "%5.0" /end AXIS_PTS
/begin AXIS_PTS ldpm_n_grd_tq_i_is_1_opm_2 "" 0xa0802274 n_grd _REC_AXS_20_u1 8160. _CNV_A_R_LINEAR_____29_CM 8 -4096. 4064. FORMAT "%5.0" /end AXIS_PTS
/begin MEASUREMENT err_state_byte[0] "DTC-Status for UDS (ISO14229)" UBYTE _CNV_A_R_LINEAR_____0_CM 1 100. 0. 255. DISPLAY_IDENTIFIER ERR_STATE_BYTE[0] ECU_ADDRESS 0xd0008188 FORMAT "%3.0" /end MEASUREMENT
/begin MEASUREMENT err_state_byte[1] "DTC-Status for UDS (ISO14229)" UBYTE _CNV_A_R_LINEAR_____0_CM 1 100. 0. 255. DISPLAY_IDENTIFIER ERR_STATE_BYTE[1] ECU_ADDRESS 0xd0008189 FORMAT "%3.0" /end MEASUREMENT
/begin MEASUREMENT err_state_byte[2] "DTC-Status for UDS (ISO14229)" UBYTE _CNV_A_R_LINEAR_____0_CM 1 100. 0. 255. DISPLAY_IDENTIFIER ERR_STATE_BYTE[2] ECU_ADDRESS 0xd000818a FORMAT "%3.0" /end MEASUREMENT
/begin MEASUREMENT err_state_byte[3] "DTC-Status for UDS (ISO14229)" UBYTE _CNV_A_R_LINEAR_____0_CM 1 100. 0. 255. DISPLAY_IDENTIFIER ERR_STATE_BYTE[3] ECU_ADDRESS 0xd000818b FORMAT "%3.0" /end MEASUREMENT
/begin MEASUREMENT err_state_byte[4] "DTC-Status for UDS (ISO14229)" UBYTE _CNV_A_R_LINEAR_____0_CM 1 100. 0. 255. DISPLAY_IDENTIFIER ERR_STATE_BYTE[4] ECU_ADDRESS 0xd000818c FORMAT "%3.0" /end MEASUREMENT
/begin MEASUREMENT err_state_byte[5] "DTC-Status for UDS (ISO14229)" UBYTE _CNV_A_R_LINEAR_____0_CM 1 100. 0. 255. DISPLAY_IDENTIFIER ERR_STATE_BYTE[5] ECU_ADDRESS 0xd000818d FORMAT "%3.0" /end MEASUREMENT
/begin MEASUREMENT err_state_byte[6] "DTC-Status for UDS (ISO14229)" UBYTE _CNV_A_R_LINEAR_____0_CM 1 100. 0. 255. DISPLAY_IDENTIFIER ERR_STATE_BYTE[6] ECU_ADDRESS 0xd000818e FORMAT "%3.0" /end MEASUREMENT
/begin MEASUREMENT err_state_byte[7] "DTC-Status for UDS (ISO14229)" UBYTE _CNV_A_R_LINEAR_____0_CM 1 100. 0. 255. DISPLAY_IDENTIFIER ERR_STATE_BYTE[7] ECU_ADDRESS 0xd000818f FORMAT "%3.0" /end MEASUREMENT
/begin MEASUREMENT err_state_byte[8] "DTC-Status for UDS (ISO14229)" UBYTE _CNV_A_R_LINEAR_____0_CM 1 100. 0. 255. DISPLAY_IDENTIFIER ERR_STATE_BYTE[8] ECU_ADDRESS 0xd0008190 FORMAT "%3.0" /end MEASUREMENT
/begin MEASUREMENT err_state_byte[9] "DTC-Status for UDS (ISO14229)" UBYTE _CNV_A_R_LINEAR_____0_CM 1 100. 0. 255. DISPLAY_IDENTIFIER ERR_STATE_BYTE[9] ECU_ADDRESS 0xd0008191 FORMAT "%3.0" /end MEASUREMENT
/begin CHARACTERISTIC c_t_min_dtc_trm "Minimum time between active DTC reporting via diagnosis job" VALUE 0xa080c21e _REC_VAL_20_u1 15. _CNV_A_R_LINEAR_____36_CM 0. 15. DISPLAY_IDENTIFIER C_T_MIN_DTC_TRM FORMAT "%2.0" /end CHARACTERISTIC
/begin CHARACTERISTIC c_nr_max_dtc_trm "Maximum numbers of DTC's + timestamps reported ina a recurrence (has to be <= NC_NR_MAX_DTC_TRM)" VALUE 0xa080c030 _REC_VAL_20_u1 15. _CNV_A_R_LINEAR_____0_CM 0. 15. DISPLAY_IDENTIFIER C_NR_MAX_DTC_TRM FORMAT "%1.0" /end CHARACTERISTIC
/begin CHARACTERISTIC c_nr_dtc_neg[0] "DTC negative list for DTC which shall not be reported" VALUE 0xa080c008 _REC_VAL_20_u2 65535. _CNV_A_R_LINEAR_____0_CM 0. 65535. DISPLAY_IDENTIFIER C_NR_DTC_NEG[0] FORMAT "%5.0" /end CHARACTERISTIC
/begin CHARACTERISTIC c_nr_dtc_neg[1] "DTC negative list for DTC which shall not be reported" VALUE 0xa080c00a _REC_VAL_20_u2 65535. _CNV_A_R_LINEAR_____0_CM 0. 65535. DISPLAY_IDENTIFIER C_NR_DTC_NEG[1] FORMAT "%5.0" /end CHARACTERISTIC
/begin CHARACTERISTIC c_nr_dtc_neg[2] "DTC negative list for DTC which shall not be reported" VALUE 0xa080c00c _REC_VAL_20_u2 65535. _CNV_A_R_LINEAR_____0_CM 0. 65535. DISPLAY_IDENTIFIER C_NR_DTC_NEG[2] FORMAT "%5.0" /end CHARACTERISTIC
/begin CHARACTERISTIC c_nr_dtc_neg[3] "DTC negative list for DTC which shall not be reported" VALUE 0xa080c00e _REC_VAL_20_u2 65535. _CNV_A_R_LINEAR_____0_CM 0. 65535. DISPLAY_IDENTIFIER C_NR_DTC_NEG[3] FORMAT "%5.0" /end CHARACTERISTIC
/begin CHARACTERISTIC c_nr_dtc_neg[4] "DTC negative list for DTC which shall not be reported" VALUE 0xa080c010 _REC_VAL_20_u2 65535. _CNV_A_R_LINEAR_____0_CM 0. 65535. DISPLAY_IDENTIFIER C_NR_DTC_NEG[4] FORMAT "%5.0" /end CHARACTERISTIC
/begin CHARACTERISTIC c_nr_dtc_neg[5] "DTC negative list for DTC which shall not be reported" VALUE 0xa080c012 _REC_VAL_20_u2 65535. _CNV_A_R_LINEAR_____0_CM 0. 65535. DISPLAY_IDENTIFIER C_NR_DTC_NEG[5] FORMAT "%5.0" /end CHARACTERISTIC
/begin CHARACTERISTIC c_nr_dtc_neg[6] "DTC negative list for DTC which shall not be reported" VALUE 0xa080c014 _REC_VAL_20_u2 65535. _CNV_A_R_LINEAR_____0_CM 0. 65535. DISPLAY_IDENTIFIER C_NR_DTC_NEG[6] FORMAT "%5.0" /end CHARACTERISTIC
/begin CHARACTERISTIC c_nr_dtc_neg[7] "DTC negative list for DTC which shall not be reported" VALUE 0xa080c016 _REC_VAL_20_u2 65535. _CNV_A_R_LINEAR_____0_CM 0. 65535. DISPLAY_IDENTIFIER C_NR_DTC_NEG[7] FORMAT "%5.0" /end CHARACTERISTIC
/begin CHARACTERISTIC c_nr_dtc_neg[8] "DTC negative list for DTC which shall not be reported" VALUE 0xa080c018 _REC_VAL_20_u2 65535. _CNV_A_R_LINEAR_____0_CM 0. 65535. DISPLAY_IDENTIFIER C_NR_DTC_NEG[8] FORMAT "%5.0" /end CHARACTERISTIC
/begin CHARACTERISTIC c_nr_dtc_neg[9] "DTC negative list for DTC which shall not be reported" VALUE 0xa080c01a _REC_VAL_20_u2 65535. _CNV_A_R_LINEAR_____0_CM 0. 65535. DISPLAY_IDENTIFIER C_NR_DTC_NEG[9] FORMAT "%5.0" /end CHARACTERISTIC
/begin CHARACTERISTIC c_nr_dtc_neg[10] "DTC negative list for DTC which shall not be reported" VALUE 0xa080c01c _REC_VAL_20_u2 65535. _CNV_A_R_LINEAR_____0_CM 0. 65535. DISPLAY_IDENTIFIER C_NR_DTC_NEG[10] FORMAT "%5.0" /end CHARACTERISTIC
/begin CHARACTERISTIC c_nr_dtc_neg[11] "DTC negative list for DTC which shall not be reported" VALUE 0xa080c01e _REC_VAL_20_u2 65535. _CNV_A_R_LINEAR_____0_CM 0. 65535. DISPLAY_IDENTIFIER C_NR_DTC_NEG[11] FORMAT "%5.0" /end CHARACTERISTIC
/begin CHARACTERISTIC c_nr_dtc_neg[12] "DTC negative list for DTC which shall not be reported" VALUE 0xa080c020 _REC_VAL_20_u2 65535. _CNV_A_R_LINEAR_____0_CM 0. 65535. DISPLAY_IDENTIFIER C_NR_DTC_NEG[12] FORMAT "%5.0" /end CHARACTERISTIC
/begin CHARACTERISTIC c_nr_dtc_neg[13] "DTC negative list for DTC which shall not be reported" VALUE 0xa080c022 _REC_VAL_20_u2 65535. _CNV_A_R_LINEAR_____0_CM 0. 65535. DISPLAY_IDENTIFIER C_NR_DTC_NEG[13] FORMAT "%5.0" /end CHARACTERISTIC
/begin CHARACTERISTIC c_nr_dtc_neg[14] "DTC negative list for DTC which shall not be reported" VALUE 0xa080c024 _REC_VAL_20_u2 65535. _CNV_A_R_LINEAR_____0_CM 0. 65535. DISPLAY_IDENTIFIER C_NR_DTC_NEG[14] FORMAT "%5.0" /end CHARACTERISTIC
/begin CHARACTERISTIC c_nr_dtc_neg[15] "DTC negative list for DTC which shall not be reported" VALUE 0xa080c026 _REC_VAL_20_u2 65535. _CNV_A_R_LINEAR_____0_CM 0. 65535. DISPLAY_IDENTIFIER C_NR_DTC_NEG[15] FORMAT "%5.0" /end CHARACTERISTIC
/begin CHARACTERISTIC c_nr_dtc_neg[16] "DTC negative list for DTC which shall not be reported" VALUE 0xa080c028 _REC_VAL_20_u2 65535. _CNV_A_R_LINEAR_____0_CM 0. 65535. DISPLAY_IDENTIFIER C_NR_DTC_NEG[16] FORMAT "%5.0" /end CHARACTERISTIC
/begin CHARACTERISTIC c_nr_dtc_neg[17] "DTC negative list for DTC which shall not be reported" VALUE 0xa080c02a _REC_VAL_20_u2 65535. _CNV_A_R_LINEAR_____0_CM 0. 65535. DISPLAY_IDENTIFIER C_NR_DTC_NEG[17] FORMAT "%5.0" /end CHARACTERISTIC
/begin CHARACTERISTIC c_nr_dtc_neg[18] "DTC negative list for DTC which shall not be reported" VALUE 0xa080c02c _REC_VAL_20_u2 65535. _CNV_A_R_LINEAR_____0_CM 0. 65535. DISPLAY_IDENTIFIER C_NR_DTC_NEG[18] FORMAT "%5.0" /end CHARACTERISTIC
/begin CHARACTERISTIC c_nr_dtc_neg[19] "DTC negative list for DTC which shall not be reported" VALUE 0xa080c02e _REC_VAL_20_u2 65535. _CNV_A_R_LINEAR_____0_CM 0. 65535. DISPLAY_IDENTIFIER C_NR_DTC_NEG[19] FORMAT "%5.0" /end CHARACTERISTIC
/begin CHARACTERISTIC c_t_dtc_trm_pres "Maximum time of allowed time for DTC transmitting" VALUE 0xa080c198 _REC_VAL_20_u1 15. _CNV_A_R_LINEAR_____36_CM 0. 15. DISPLAY_IDENTIFIER C_T_DTC_TRM_PRES FORMAT "%2.0" /end CHARACTERISTIC
/begin COMPU_METHOD _CNV_A_R_LINEAR_____0_CM "" RAT_FUNC "%6.3" "-" COEFFS 0 1. 0. 0 0 1 /end COMPU_METHOD
/begin COMPU_METHOD _CNV_A_R_LINEAR_____4_CM "" RAT_FUNC "%6.3" "s" COEFFS 0 10. 0. 0 0 1 /end COMPU_METHOD
/begin COMPU_METHOD _CNV_A_R_LINEAR_____14_CM "" RAT_FUNC "%6.3" "rpm" COEFFS 0 1. 0. 0 0 1 /end COMPU_METHOD
/begin COMPU_METHOD _CNV_A_R_LINEAR_____17_CM "" RAT_FUNC "%6.3" "°C" COEFFS 0 1.333333333333333 64. 0 0 1 /end COMPU_METHOD
/begin COMPU_METHOD _CNV_A_R_LINEAR_____29_CM "" RAT_FUNC "%6.3" "rpm/s" COEFFS 0 3.125e-002 128. 0 0 1 /end COMPU_METHOD
/begin COMPU_METHOD _CNV_A_R_LINEAR_____36_CM "" RAT_FUNC "%6.3" "s" COEFFS 0 1. 0. 0 0 1 /end COMPU_METHOD
/begin COMPU_METHOD _CNV_A_R_LINEAR_____193_CM "" RAT_FUNC "%6.3" "rpm" COEFFS 0 1. 32768. 0 0 1 /end COMPU_METHOD
/begin RECORD_LAYOUT _REC_VAL_20_u1 FNC_VALUES 1 UBYTE COLUMN_DIR DIRECT /end RECORD_LAYOUT
/begin RECORD_LAYOUT _REC_VAL_20_u2 FNC_VALUES 1 UWORD COLUMN_DIR DIRECT /end RECORD_LAYOUT
/begin RECORD_LAYOUT _REC_AXS_20_u1 NO_AXIS_PTS_X 1 UBYTE AXIS_PTS_X 2 UBYTE INDEX_INCR DIRECT /end RECORD_LAYOUT
/begin RECORD_LAYOUT _REC_AXS_20_u2 NO_AXIS_PTS_X 1 UWORD AXIS_PTS_X 2 UWORD INDEX_INCR DIRECT /end RECORD_LAYOUT
/begin FUNCTION __DDS_EXPA2_DEFAULT_FUNC__ "__DDS_EXPA2_DEFAULT_FUNC__"
 /begin DEF_CHARACTERISTIC c_mod_2_pid_5_diag c_mod_2_pid_6_diag c_mod_2_pid_7_diag c_mod_2_pid_8_diag c_mod_2_pid_9_diag c_mod_2_pid_A_diag c_mod_2_pid_B_diag c_mod_2_pid_C_diag c_clc_ready_obd_1 lc_var_obdc_can c_mod_5_tid_1_diag c_mod_5_tid_2_diag c_mod_5_tid_3_diag c_mod_5_tid_4_diag c_mod_5_tid_5_diag c_mod_5_tid_6_diag c_mod_5_tid_7_diag c_mod_5_tid_8_diag c_mod_5_tid_9_diag c_mod_5_tid_10_diag c_mod_5_tid_11_diag c_mod_5_tid_12_diag c_mod_5_tid_13_diag c_mod_5_tid_14_diag c_mod_5_tid_15_diag c_mod_5_tid_16_diag c_mod_5_tid_17_diag c_mod_5_tid_18_diag c_mod_5_tid_19_diag c_mod_5_tid_20_diag c_mod_6_tid_1_diag c_mod_6_tid_2_diag c_mod_6_tid_3_diag c_mod_6_tid_4_diag c_mod_9_vit_1_diag c_mod_9_vit_2_diag c_mod_9_vit_3_diag c_mod_9_vit_4_diag lc_sa_swi_acq c_sum_afl_vls_min_diag_sa_1 c_sum_afl_vls_min_diag_sa_2 ldp_tco_ip_n_thd_isc_act_ast c_n_sp_is_max_clc ldpm_n_dif_cor_tq_i_dt_is_opm_1 ldpm_n_dif_cor_tq_i_dt_is_opm_2 ldpm_tco__fac_n_grd_is_2 ldpm_t_ast__fac_n_grd_is ldpm_n_dif_cor_tq_i_is_1_opm_1 ldpm_n_dif_cor_tq_i_is_1_opm_2 ldpm_n_grd_tq_i_is_1_opm_1 ldpm_n_grd_tq_i_is_1_opm_2 c_t_min_dtc_trm c_nr_max_dtc_trm c_nr_dtc_neg[0] c_nr_dtc_neg[1] c_nr_dtc_neg[2] c_nr_dtc_neg[3] c_nr_dtc_neg[4] c_nr_dtc_neg[5] c_nr_dtc_neg[6] c_nr_dtc_neg[7] c_nr_dtc_neg[8] c_nr_dtc_neg[9] c_nr_dtc_neg[10] c_nr_dtc_neg[11] c_nr_dtc_neg[12] c_nr_dtc_neg[13] c_nr_dtc_neg[14] c_nr_dtc_neg[15] c_nr_dtc_neg[16] c_nr_dtc_neg[17] c_nr_dtc_neg[18] c_nr_dtc_neg[19] c_t_dtc_trm_pres /end DEF_CHARACTERISTIC
/end FUNCTION
/end MODULE
/end PROJECT
