ASAP2_VERSION 1 31
/begin PROJECT MS45 "BMW Motorsteuerung R6"
/begin HEADER "_default_HeaderComment" PROJECT_NO _56 /end HEADER
/begin MODULE _default_ModuleName "_default_ModuleLongIdentifier"
/begin MOD_COMMON "_default_ModCommonComment" DEPOSIT ABSOLUTE BYTE_ORDER MSB_FIRST ALIGNMENT_BYTE 1 ALIGNMENT_WORD 2 ALIGNMENT_LONG 4 ALIGNMENT_FLOAT32_IEEE 4 ALIGNMENT_FLOAT64_IEEE 8 /end MOD_COMMON
/begin CHARACTERISTIC c_v_conv_thd_deac_mon "Threshold for A/D-converter test deactivation" VALUE 0x11da6 _REC_VAL_20_u1 4.998 _CNV_A_R_LINEAR_____44_CM 0. 4.998 DISPLAY_IDENTIFIER C_V_CONV_THD_DEAC_MON FORMAT "%5.3" /end CHARACTERISTIC
/begin CHARACTERISTIC c_v_pvs_2_conv_ratio_hys_mon "Maximum ratio between PVS channel 2 on main controller and on monitoring unit" VALUE 0x11da7 _REC_VAL_20_u1 4.998 _CNV_A_R_LINEAR_____44_CM 0. 4.998 DISPLAY_IDENTIFIER C_V_PVS_2_CONV_RATIO_HYS_MON FORMAT "%5.3" /end CHARACTERISTIC
/begin MEASUREMENT abc_conv_mon "Anti bounce counter ADC error" UBYTE _CNV_A_R_LINEAR_____1_CM 1 100. 0. 255. DISPLAY_IDENTIFIER ABC_CONV_MON ECU_ADDRESS 0x3fe5ea FORMAT "%3.0" /end MEASUREMENT
/begin MEASUREMENT ctr_mis_det_cyl[0] "Number of misfires events on cylinder [0]  in one DC" UWORD _CNV_A_R_LINEAR_____1_CM 1 100. 0. 65535. DISPLAY_IDENTIFIER CTR_MIS_DET_CYL_0 ECU_ADDRESS 0x3fd12c BYTE_ORDER MSB_LAST FORMAT "%5.0" /end MEASUREMENT
/begin MEASUREMENT ctr_mis_det_cyl[1] "Number of misfires events on cylinder [1] in one DC" UWORD _CNV_A_R_LINEAR_____1_CM 1 100. 0. 65535. DISPLAY_IDENTIFIER CTR_MIS_DET_CYL_1 ECU_ADDRESS 0x3fd12e BYTE_ORDER MSB_LAST FORMAT "%5.0" /end MEASUREMENT
/begin MEASUREMENT ctr_mis_det_cyl[2] "Number of misfires events on cylinder [2] in one DC" UWORD _CNV_A_R_LINEAR_____1_CM 1 100. 0. 65535. DISPLAY_IDENTIFIER CTR_MIS_DET_CYL_2 ECU_ADDRESS 0x3fd130 BYTE_ORDER MSB_LAST FORMAT "%5.0" /end MEASUREMENT
/begin MEASUREMENT ctr_mis_det_cyl[3] "Number of misfires events on cylinder [3] in one DC" UWORD _CNV_A_R_LINEAR_____1_CM 1 100. 0. 65535. DISPLAY_IDENTIFIER CTR_MIS_DET_CYL_3 ECU_ADDRESS 0x3fd132 BYTE_ORDER MSB_LAST FORMAT "%5.0" /end MEASUREMENT
/begin MEASUREMENT ctr_mis_det_cyl[4] "Number of misfires events on cylinder [4] in one DC" UWORD _CNV_A_R_LINEAR_____1_CM 1 100. 0. 65535. DISPLAY_IDENTIFIER CTR_MIS_DET_CYL_4 ECU_ADDRESS 0x3fd134 BYTE_ORDER MSB_LAST FORMAT "%5.0" /end MEASUREMENT
/begin MEASUREMENT ctr_mis_det_cyl[5] "Number of misfires events on cylinder [5] in one DC" UWORD _CNV_A_R_LINEAR_____1_CM 1 100. 0. 65535. DISPLAY_IDENTIFIER CTR_MIS_DET_CYL_5 ECU_ADDRESS 0x3fd136 BYTE_ORDER MSB_LAST FORMAT "%5.0" /end MEASUREMENT
/begin MEASUREMENT ctr_mis_det "Number of misfire events of all cylinders in one DC" UWORD _CNV_A_R_LINEAR_____1_CM 1 100. 0. 65535. DISPLAY_IDENTIFIER CTR_MIS_DET ECU_ADDRESS 0x3fd138 BYTE_ORDER MSB_LAST FORMAT "%5.0" /end MEASUREMENT
/begin MEASUREMENT ctr_seg_mis_act "Number of segments with active misfire detection" ULONG _CNV_A_R_LINEAR_____22_CM 1 100. 0. 4294967295. DISPLAY_IDENTIFIER CTR_SEG_MIS_ACT ECU_ADDRESS 0x3fc8c4 BYTE_ORDER MSB_LAST FORMAT "%11.0" /end MEASUREMENT
/begin CHARACTERISTIC c_v_tps_1_lih_mon "Threshold for detection of throttle position 1 outside limp home position" VALUE 0x120fc _REC_VAL_20_u2 4.99511719 _CNV_A_R_LINEAR_____3_CM 0. 4.99511719 DISPLAY_IDENTIFIER C_V_TPS_1_LIH_MON FORMAT "%5.3" /end CHARACTERISTIC
/begin CHARACTERISTIC c_v_tps_2_lih_mon "Threshold for detection of throttle position 2 outside limp home position" VALUE 0x120fe _REC_VAL_20_u2 4.99511719 _CNV_A_R_LINEAR_____3_CM 0. 4.99511719 DISPLAY_IDENTIFIER C_V_TPS_2_LIH_MON FORMAT "%5.3" /end CHARACTERISTIC
/begin MEASUREMENT lv_n_lim_etc_mon "Logical variable for activation of engine speed limitation monitoring" UBYTE _CNV_S_2_RANGE______5_CM 1 100. 0. 1. DISPLAY_IDENTIFIER LV_N_LIM_ETC_MON ECU_ADDRESS 0x3fe66a BIT_MASK 0x1 /end MEASUREMENT
/begin MEASUREMENT lv_tqi_mon_act_mon "Logical variable for torque monitoring active" UBYTE _CNV_S_2_RANGE______5_CM 1 100. 0. 1. DISPLAY_IDENTIFIER LV_TQI_MON_ACT_MON ECU_ADDRESS 0x3fe66b BIT_MASK 0x1 /end MEASUREMENT
/begin MEASUREMENT tq_esp_mon "Engine torgue request of ESP  Checked torque value in monitoring level" SWORD _CNV_A_R_LINEAR_____55_CM 1 100. -1024. 1023.96875 DISPLAY_IDENTIFIER TQ_ESP_MON ECU_ADDRESS 0x3fda4c BYTE_ORDER MSB_LAST FORMAT "%8.2" /end MEASUREMENT
/begin MEASUREMENT lv_brake_mon "Brake active or brake fault present" UBYTE _CNV_S_2_RANGE______5_CM 1 100. 0. 1. DISPLAY_IDENTIFIER LV_BRAKE_MON ECU_ADDRESS 0x3fe66d BIT_MASK 0x1 /end MEASUREMENT
/begin MEASUREMENT lv_im_bts_mon "" UBYTE _CNV_S_2_RANGE______5_CM 1 100. 0. 1. DISPLAY_IDENTIFIER LV_IM_BTS_MON ECU_ADDRESS 0x3fe67b BIT_MASK 0x1 /end MEASUREMENT
/begin MEASUREMENT lv_im_bls_mon "" UBYTE _CNV_S_2_RANGE______5_CM 1 100. 0. 1. DISPLAY_IDENTIFIER LV_IM_BLS_MON ECU_ADDRESS 0x3fe67c BIT_MASK 0x1 /end MEASUREMENT
/begin MEASUREMENT lv_igk_mon "Logical variable for ignition key on" UBYTE _CNV_S_2_RANGE______5_CM 1 100. 0. 1. DISPLAY_IDENTIFIER LV_IGK_MON ECU_ADDRESS 0x3fe66c BIT_MASK 0x1 /end MEASUREMENT
/begin MEASUREMENT n_sp_is_mon "Idle speed setpoint used in level 2" UWORD _CNV_A_R_LINEAR_____11_CM 1 100. 0. 8160. DISPLAY_IDENTIFIER N_SP_IS_MON ECU_ADDRESS 0x3fda48 BYTE_ORDER MSB_LAST FORMAT "%4.0" /end MEASUREMENT
/begin MEASUREMENT tq_egs_mon "Engine torgue request of EGS  Checked torque value in monitoring level" SWORD _CNV_A_R_LINEAR_____55_CM 1 100. -1024. 1023.96875 DISPLAY_IDENTIFIER TQ_EGS_MON ECU_ADDRESS 0x3fda4a BYTE_ORDER MSB_LAST FORMAT "%8.2" /end MEASUREMENT
/begin MEASUREMENT tq_loss_acc_mon "Air conditioning compressor torque losses" SWORD _CNV_A_R_LINEAR_____55_CM 1 100. -1024. 1023.96875 DISPLAY_IDENTIFIER TQ_LOSS_ACC_MON ECU_ADDRESS 0x3fda5a BYTE_ORDER MSB_LAST FORMAT "%8.2" /end MEASUREMENT
/begin MEASUREMENT tq_loss_add_mon "Additional torque losses" SWORD _CNV_A_R_LINEAR_____55_CM 1 100. -1024. 1023.96875 DISPLAY_IDENTIFIER TQ_LOSS_ADD_MON ECU_ADDRESS 0x3fda4e BYTE_ORDER MSB_LAST FORMAT "%8.2" /end MEASUREMENT
/begin MEASUREMENT tq_loss_alter_mon "Additional torque losses" SWORD _CNV_A_R_LINEAR_____55_CM 1 100. -1024. 1023.96875 DISPLAY_IDENTIFIER TQ_LOSS_ALTER_MON ECU_ADDRESS 0x3fda5c BYTE_ORDER MSB_LAST FORMAT "%8.2" /end MEASUREMENT
/begin MEASUREMENT tq_loss_alter_mdl_mon "Modelled alternator torque losses" SWORD _CNV_A_R_LINEAR_____55_CM 1 100. -1024. 1023.96875 DISPLAY_IDENTIFIER TQ_LOSS_ALTER_MDL_MON ECU_ADDRESS 0x3fda5e BYTE_ORDER MSB_LAST FORMAT "%8.2" /end MEASUREMENT
/begin MEASUREMENT tq_loss_ars_mon "Anti roll stabilisation torque losses" SWORD _CNV_A_R_LINEAR_____55_CM 1 100. -1024. 1023.96875 DISPLAY_IDENTIFIER TQ_LOSS_ARS_MON ECU_ADDRESS 0x3fda60 BYTE_ORDER MSB_LAST FORMAT "%8.2" /end MEASUREMENT
/begin MEASUREMENT tq_loss_pste_1_mon "Steering wheel compressor torque losses" SWORD _CNV_A_R_LINEAR_____55_CM 1 100. -1024. 1023.96875 DISPLAY_IDENTIFIER TQ_LOSS_PSTE_1_MON ECU_ADDRESS 0x3fda64 BYTE_ORDER MSB_LAST FORMAT "%8.2" /end MEASUREMENT
/begin MEASUREMENT tq_loss_pste_mon "Steering wheel compressor torque losses" SWORD _CNV_A_R_LINEAR_____55_CM 1 100. -1024. 1023.96875 DISPLAY_IDENTIFIER TQ_LOSS_PSTE_MON ECU_ADDRESS 0x3fda62 BYTE_ORDER MSB_LAST FORMAT "%8.2" /end MEASUREMENT
/begin MEASUREMENT tq_loss_pste_2_mon "Steering wheel compressor torque losses" SWORD _CNV_A_R_LINEAR_____55_CM 1 100. -1024. 1023.96875 DISPLAY_IDENTIFIER TQ_LOSS_PSTE_2_MON ECU_ADDRESS 0x3fda66 BYTE_ORDER MSB_LAST FORMAT "%8.2" /end MEASUREMENT
/begin CHARACTERISTIC c_tq_loss_pste_2_min_mon "minimum additional torque loss for pste 2 active" VALUE 0x11d44 _REC_VAL_20_s2 40.96 _CNV_A_R_LINEAR_____55_CM -1024. 0. DISPLAY_IDENTIFIER C_TQ_LOSS_PSTE_2_MIN_MON FORMAT "%6.2" /end CHARACTERISTIC
/begin CHARACTERISTIC c_tq_loss_pste_1_min_mon "minimum additional torque loss for pste 1 active" VALUE 0x11d42 _REC_VAL_20_s2 40.96 _CNV_A_R_LINEAR_____55_CM -1024. 0. DISPLAY_IDENTIFIER C_TQ_LOSS_PSTE_1_MIN_MON FORMAT "%6.2" /end CHARACTERISTIC
/begin CHARACTERISTIC c_tq_loss_ars_min_mon "minimum additional torque loss for ars active" VALUE 0x11d40 _REC_VAL_20_s2 40.96 _CNV_A_R_LINEAR_____55_CM -1024. 0. DISPLAY_IDENTIFIER C_TQ_LOSS_ARS_MIN_MON FORMAT "%6.2" /end CHARACTERISTIC
/begin CHARACTERISTIC c_tq_loss_add_acc_min_mon "minimum additional torque loss for acc active" VALUE 0x11d3c _REC_VAL_20_s2 40.96 _CNV_A_R_LINEAR_____55_CM -1024. 0. DISPLAY_IDENTIFIER C_TQ_LOSS_ADD_ACC_MIN_MON FORMAT "%6.2" /end CHARACTERISTIC
/begin CHARACTERISTIC c_fac_eff_alter_mon "Alternator torque losses low pass" VALUE 0x11d74 _REC_VAL_20_u1 0.31875 _CNV_A_R_LINEAR_____48_CM 0. 7.96875 DISPLAY_IDENTIFIER C_FAC_EFF_ALTER_MON FORMAT "%5.3" /end CHARACTERISTIC
/begin CHARACTERISTIC c_fac_n_alter_mon "" VALUE 0x11d75 _REC_VAL_20_u1 0.31875 _CNV_A_R_LINEAR_____48_CM 0. 7.96875 DISPLAY_IDENTIFIER C_FAC_N_ALTER_MON FORMAT "%5.3" /end CHARACTERISTIC
/begin CHARACTERISTIC c_tq_loss_alter_lih_mon "minimum torque loss for alter at limp home active" VALUE 0x11d3e _REC_VAL_20_s2 40.96 _CNV_A_R_LINEAR_____55_CM -1024. 0. DISPLAY_IDENTIFIER C_TQ_LOSS_ALTER_LIH_MON FORMAT "%6.2" /end CHARACTERISTIC
/begin CHARACTERISTIC c_crlc_alter_mon "Alternator torque losses low pass" VALUE 0x11d71 _REC_VAL_20_u1 3.984376e-002 _CNV_A_R_LINEAR_____50_CM 0. 0.996094 DISPLAY_IDENTIFIER C_CRLC_ALTER_MON FORMAT "%5.3" /end CHARACTERISTIC
/begin CHARACTERISTIC c_v_tq_alter_mon "Voltage range of monitoring" VALUE 0x11dae _REC_VAL_20_u1 1.04 _CNV_A_R_LINEAR_____60_CM 0. 26. DISPLAY_IDENTIFIER C_V_TQ_ALTER_MON FORMAT "%4.1" /end CHARACTERISTIC
/begin CHARACTERISTIC id_eff_typ_alter_mon "Alternator torque losses" CURVE 0x11db0 _REC_CUR_20_u1_u1 0.9960940000000002 _CNV_A_R_LINEAR_____50_CM 0. 0.996094 DISPLAY_IDENTIFIER ID_EFF_TYP_ALTER_MON FORMAT "%5.3"
 /begin AXIS_DESCR COM_AXIS genawnumm _CNV_A_R_LINEAR_____1_CM 9 0. 255. FORMAT "%3.0" AXIS_PTS_REF ldp_genawnumm__tq_loss_mon /end AXIS_DESCR
/end CHARACTERISTIC
/begin AXIS_PTS ldp_genawnumm__tq_loss_mon "" 0x11fec genawnumm _REC_AXS_20_u1 255. _CNV_A_R_LINEAR_____1_CM 9 0. 255. DISPLAY_IDENTIFIER LDP_GENAWNUMM__TQ_LOSS_MON FORMAT "%3.0" /end AXIS_PTS
/begin AXIS_PTS ldp_dffgen_fil_mon__loss_mon "Alternator torque losses" 0x11fe5 dffgen_fil_mon _REC_AXS_20_u1 99.609375 _CNV_A_R_LINEAR_____10_CM 6 0. 99.609375 DISPLAY_IDENTIFIER LDP_DFFGEN_FIL_MON__LOSS_MON FORMAT "%5.2" /end AXIS_PTS
/begin MEASUREMENT cur_alter_mon "Currency torque losses monitoring" UBYTE _CNV_A_R_LINEAR_____357_CM 1 100. 0. 255. DISPLAY_IDENTIFIER CUR_ALTER_MON ECU_ADDRESS 0x3fe672 FORMAT "%4.1" /end MEASUREMENT
/begin MEASUREMENT n_alter_mon "Currency torque losses monitoring" UWORD _CNV_A_R_LINEAR_____11_CM 1 100. 0. 65535. DISPLAY_IDENTIFIER N_ALTER_MON ECU_ADDRESS 0x3fda52 BYTE_ORDER MSB_LAST FORMAT "%5.0" /end MEASUREMENT
/begin MEASUREMENT dffgen_fil_mon "Currency torque losses monitoring" UBYTE _CNV_A_R_LINEAR_____10_CM 1 100. 0. 99.609375 DISPLAY_IDENTIFIER DFFGEN_FIL_MON ECU_ADDRESS 0x3fe673 FORMAT "%5.2" /end MEASUREMENT
/begin AXIS_PTS ldpm_n_alter_mon__tq_loss_mon "Alternator torque losses" 0x1221c n_alter_mon _REC_AXS_20_u2 65535. _CNV_A_R_LINEAR_____11_CM 6 0. 65535. DISPLAY_IDENTIFIER LDPM_N_ALTER_MON__TQ_LOSS_MON FORMAT "%5.0" /end AXIS_PTS
/begin CHARACTERISTIC ip_cur_alter_mon "Alternator torque losses" MAP 0x11db9 _REC_MAP_20_u1_u1_u2 255. _CNV_A_R_LINEAR_____357_CM 0. 255. DISPLAY_IDENTIFIER IP_CUR_ALTER_MON FORMAT "%4.1"
 /begin AXIS_DESCR COM_AXIS dffgen_fil_mon _CNV_A_R_LINEAR_____10_CM 6 0. 99.609375 FORMAT "%5.2" AXIS_PTS_REF ldp_dffgen_fil_mon__loss_mon /end AXIS_DESCR
 /begin AXIS_DESCR COM_AXIS n_alter_mon _CNV_A_R_LINEAR_____11_CM 6 0. 65535. FORMAT "%5.0" AXIS_PTS_REF ldpm_n_alter_mon__tq_loss_mon /end AXIS_DESCR
/end CHARACTERISTIC
/begin CHARACTERISTIC ip_eff_alter_mon "Alternator torque losses" MAP 0x11ddd _REC_MAP_20_u1_u2_u1 0.9960940000000002 _CNV_A_R_LINEAR_____50_CM 0. 0.996094 DISPLAY_IDENTIFIER IP_EFF_ALTER_MON FORMAT "%5.3"
 /begin AXIS_DESCR COM_AXIS n_alter_mon _CNV_A_R_LINEAR_____11_CM 6 0. 65535. FORMAT "%5.0" AXIS_PTS_REF ldpm_n_alter_mon__tq_loss_mon /end AXIS_DESCR
 /begin AXIS_DESCR COM_AXIS cur_alter_mon _CNV_A_R_LINEAR_____357_CM 6 0. 255. FORMAT "%4.1" AXIS_PTS_REF ldp_cur_alter_mon__tq_loss_mon /end AXIS_DESCR
/end CHARACTERISTIC
/begin AXIS_PTS ldp_cur_alter_mon__tq_loss_mon "" 0x11fde cur_alter_mon _REC_AXS_20_u1 255. _CNV_A_R_LINEAR_____357_CM 6 0. 255. DISPLAY_IDENTIFIER LDP_CUR_ALTER_MON__TQ_LOSS_MON FORMAT "%4.1" /end AXIS_PTS
/begin MEASUREMENT state_n_max_mon "Error indication" UWORD _CNV_A_R_LINEAR_____1_CM 1 100. 0. 65535. DISPLAY_IDENTIFIER STATE_N_MAX_MON ECU_ADDRESS 0x3fa0a8 BYTE_ORDER MSB_LAST FORMAT "%5.0" /end MEASUREMENT
/begin CHARACTERISTIC c_v_pvs_is_thd_1_mon "Thershold for idle speed PVS channel 1" VALUE 0x120f0 _REC_VAL_20_u2 4.99511719 _CNV_A_R_LINEAR_____3_CM 0. 4.99511719 DISPLAY_IDENTIFIER C_V_PVS_IS_THD_1_MON FORMAT "%5.3" /end CHARACTERISTIC
/begin CHARACTERISTIC c_v_pvs_is_thd_2_mon "Thershold for idle speed PVS channel 2" VALUE 0x120f2 _REC_VAL_20_u2 4.99511719 _CNV_A_R_LINEAR_____3_CM 0. 4.99511719 DISPLAY_IDENTIFIER C_V_PVS_IS_THD_2_MON FORMAT "%5.3" /end CHARACTERISTIC
/begin CHARACTERISTIC c_v_pvs_slop_1_mon "Slope of the PVS channel 1" VALUE 0x11da8 _REC_VAL_20_u1 79.6875 _CNV_A_R_LINEAR_____391_CM 0. 79.6875 DISPLAY_IDENTIFIER C_V_PVS_SLOP_1_MON FORMAT "%4.1" /end CHARACTERISTIC
/begin CHARACTERISTIC c_v_pvs_slop_2_mon "Slope of the PVS channel 2" VALUE 0x11da9 _REC_VAL_20_u1 159.375 _CNV_A_R_LINEAR_____396_CM 0. 159.375 DISPLAY_IDENTIFIER C_V_PVS_SLOP_2_MON FORMAT "%5.1" /end CHARACTERISTIC
/begin CHARACTERISTIC c_n_min_pvs_diag_mon "Minimum engine speed for PVS diagnosis" VALUE 0x11d7f _REC_VAL_20_u1 816. _CNV_A_R_LINEAR_____16_CM 0. 8160. DISPLAY_IDENTIFIER C_N_MIN_PVS_DIAG_MON FORMAT "%4.0" /end CHARACTERISTIC
/begin CHARACTERISTIC ip_pv_ratio_hys_mon "Maximum PVS ratio error allowed" CURVE 0x11f83 _REC_CUR_20_u1_u1 99.609375 _CNV_A_R_LINEAR_____10_CM 0. 99.609375 DISPLAY_IDENTIFIER IP_PV_RATIO_HYS_MON FORMAT "%4.1"
 /begin AXIS_DESCR COM_AXIS pv_av_mon _CNV_A_R_LINEAR_____10_CM 6 0. 99.609375 FORMAT "%4.1" AXIS_PTS_REF ldp_pv_av_min_mon_ip_pv_mon /end AXIS_DESCR
/end CHARACTERISTIC
/begin CHARACTERISTIC c_pv_lih_max_mon "Max. pedal position in case of an PVS error" VALUE 0x11d84 _REC_VAL_20_u1 99.609375 _CNV_A_R_LINEAR_____10_CM 0. 99.609375 DISPLAY_IDENTIFIER C_PV_LIH_MAX_MON FORMAT "%5.2" /end CHARACTERISTIC
/begin AXIS_PTS ldp_pv_av_min_mon_ip_pv_mon "" 0x12084 pv_av_mon _REC_AXS_20_u1 99.609375 _CNV_A_R_LINEAR_____10_CM 6 0. 99.609375 DISPLAY_IDENTIFIER LDP_PV_AV_MIN_MON_IP_PV_MON FORMAT "%4.1" /end AXIS_PTS
/begin MEASUREMENT lv_err_pvs_ratio_mon "Logical variable for ratio-error between PVS channel 1 and 2" UBYTE _CNV_S_2_RANGE______2_R_CM 1 100. 0. 255. DISPLAY_IDENTIFIER LV_ERR_PVS_RATIO_MON ECU_ADDRESS 0x3fe689 BIT_MASK 0x1 /end MEASUREMENT
/begin MEASUREMENT lv_err_vcc_pvs_2_mon "Fault in power supply for PVS_2 present" UBYTE _CNV_S_2_RANGE______2_R_CM 1 100. 0. 255. DISPLAY_IDENTIFIER LV_ERR_VCC_PVS_2_MON ECU_ADDRESS 0x3fe66f BIT_MASK 0x1 /end MEASUREMENT
/begin MEASUREMENT lv_err_vcc_pvs_1_mon "Fault in power supply for PVS_1 present" UBYTE _CNV_S_2_RANGE______2_R_CM 1 100. 0. 255. DISPLAY_IDENTIFIER LV_ERR_VCC_PVS_1_MON ECU_ADDRESS 0x3fe66e BIT_MASK 0x1 /end MEASUREMENT
/begin MEASUREMENT lv_err_vcc_pvs_mon "Fault in power supply for PVS present" UBYTE _CNV_S_2_RANGE______2_R_CM 1 100. 0. 255. DISPLAY_IDENTIFIER LV_ERR_VCC_PVS_MON ECU_ADDRESS 0x3fe670 BIT_MASK 0x1 /end MEASUREMENT
/begin MEASUREMENT pv_av_mon "" UBYTE _CNV_A_R_LINEAR_____10_CM 1 100. 0. 99.609375 DISPLAY_IDENTIFIER PV_AV_MON ECU_ADDRESS 0x3fe688 FORMAT "%4.1" /end MEASUREMENT
/begin MEASUREMENT pv_av_1_mon "degree of activation of the accelerator pedal from PVS-channel 1" UBYTE _CNV_A_R_LINEAR_____10_CM 1 100. 0. 99.609375 DISPLAY_IDENTIFIER PV_AV_1_MON ECU_ADDRESS 0x3fe68b FORMAT "%3.1" /end MEASUREMENT
/begin MEASUREMENT pv_av_2_mon "degree of activation of the accelerator pedal from PVS-channel 2" UBYTE _CNV_A_R_LINEAR_____10_CM 1 100. 0. 99.609375 DISPLAY_IDENTIFIER PV_AV_2_MON ECU_ADDRESS 0x3fe68c FORMAT "%3.1" /end MEASUREMENT
/begin MEASUREMENT abc_pvs_ratio_mon "Anti bounce counter PVS ratio error" UBYTE _CNV_A_R_LINEAR_____1_CM 1 100. 0. 255. DISPLAY_IDENTIFIER ABC_PVS_RATIO_MON ECU_ADDRESS 0x3fe68e FORMAT "%3.0" /end MEASUREMENT
/begin CHARACTERISTIC c_t_tco_grd_max_mon "Minimum time before a new change of TCO_MON is allowed" VALUE 0x11d96 _REC_VAL_20_u1 10.2 _CNV_A_R_LINEAR_____41_CM 0. 10.2 DISPLAY_IDENTIFIER C_T_TCO_GRD_MAX_MON FORMAT "%5.2" /end CHARACTERISTIC
/begin CHARACTERISTIC c_tco_grd_max_mon "Maximum negative gradient for the coolant temperature" VALUE 0x11d98 _REC_VAL_20_u1 190.5 _CNV_A_R_LINEAR_____13_CM 0. 190.5 DISPLAY_IDENTIFIER C_TCO_GRD_MAX_MON FORMAT "%5.1" /end CHARACTERISTIC
/begin CHARACTERISTIC c_tco_sub_thd_max_mon "Threshold for the max. TCO_SUB temperature while TCO is lower than C_TCO_THD_MIN_MON" VALUE 0x11d99 _REC_VAL_20_u1 190.5 _CNV_A_R_LINEAR_____12_CM -48. 142.5 DISPLAY_IDENTIFIER C_TCO_SUB_THD_MAX_MON FORMAT "%5.1" /end CHARACTERISTIC
/begin CHARACTERISTIC c_tco_thd_min_mon "Threshold for the min. TCO temperature while TCO_SUB is higher than C_TCO_SUB_THD_MAX_MON" VALUE 0x11d9a _REC_VAL_20_u1 190.5 _CNV_A_R_LINEAR_____12_CM -48. 142.5 DISPLAY_IDENTIFIER C_TCO_THD_MIN_MON FORMAT "%5.1" /end CHARACTERISTIC
/begin MEASUREMENT t_tco_grd_mon "Timer for negative TCO gradient limitation" UBYTE _CNV_A_R_LINEAR_____41_CM 1 100. 0. 10.2 DISPLAY_IDENTIFIER T_TCO_GRD_MON ECU_ADDRESS 0x3fe6a8 FORMAT "%5.2" /end MEASUREMENT
/begin MEASUREMENT tco_mon "Coolant temperature (monitoring level)" UBYTE _CNV_A_R_LINEAR_____12_CM 1 100. -48. 142.5 DISPLAY_IDENTIFIER TCO_MON ECU_ADDRESS 0x3fe6a7 FORMAT "%5.1" /end MEASUREMENT
/begin CHARACTERISTIC ip_tq_dif_p_d_is_max_mon "maximum PD-part depending on speed deviation to idle speed setpoint" CURVE 0x11f89 _REC_CUR_20_u1_u1 510. _CNV_A_R_LINEAR_____101_CM 0. 510. DISPLAY_IDENTIFIER IP_TQ_DIF_P_D_IS_MAX_MON FORMAT "%3.0"
 /begin AXIS_DESCR COM_AXIS n_dif_cor_mon _CNV_A_R_LINEAR_____215_CM 4 -4096. 4064. FORMAT "%5.0" AXIS_PTS_REF ldp_n_dif_cor_mon_ip_tq_mon /end AXIS_DESCR
/end CHARACTERISTIC
/begin CHARACTERISTIC ip_fac_tq_dif_p_d_is_mon "maximum scaling factor due to separation of PD-part" CURVE 0x11e37 _REC_CUR_20_u1_u1 1.9921875 _CNV_A_R_LINEAR_____115_CM 0. 1.9921875 DISPLAY_IDENTIFIER IP_FAC_TQ_DIF_P_D_IS_MON FORMAT "%5.3"
 /begin AXIS_DESCR COM_AXIS tco_mon _CNV_A_R_LINEAR_____12_CM 5 -48. 142.5 FORMAT "%4.0" AXIS_PTS_REF ldp_tco_mon_ip_fac_tq_p_d_mon /end AXIS_DESCR
/end CHARACTERISTIC
/begin CHARACTERISTIC c_n_dif_min_mon "minimum idle speed setpoint deviation for active I-part" VALUE 0x11d7c _REC_VAL_20_u1 8160. _CNV_A_R_LINEAR_____215_CM -4096. 4064. DISPLAY_IDENTIFIER C_N_DIF_MIN_MON FORMAT "%5.0" /end CHARACTERISTIC
/begin CHARACTERISTIC c_tq_dif_i_is_max_mon "maximum I-part" VALUE 0x11d9d _REC_VAL_20_u1 255. _CNV_A_R_LINEAR_____95_CM 0. 255. DISPLAY_IDENTIFIER C_TQ_DIF_I_IS_MAX_MON FORMAT "%3.0" /end CHARACTERISTIC
/begin CHARACTERISTIC c_tq_pas_i_is_mon "target value for monitoring ramp operation due to ISC deactivation" VALUE 0x11d9f _REC_VAL_20_u1 255. _CNV_A_R_LINEAR_____95_CM 0. 255. DISPLAY_IDENTIFIER C_TQ_PAS_I_IS_MON FORMAT "%3.0" /end CHARACTERISTIC
/begin CHARACTERISTIC c_fac_ramp_pos_i_is_mon "Slope for monitoring positive ISC deactivation-ramp operation" VALUE 0x120da _REC_VAL_20_u2 0.9999850000000001 _CNV_A_R_LINEAR_____472_CM 0. 0.999985 DISPLAY_IDENTIFIER C_FAC_RAMP_POS_I_IS_MON FORMAT "%6.4" /end CHARACTERISTIC
/begin CHARACTERISTIC c_fac_ramp_neg_i_is_mon "Slope for monitoring negative ISC deactivation-ramp operation" VALUE 0x120d6 _REC_VAL_20_u2 0.9999850000000001 _CNV_A_R_LINEAR_____472_CM 0. 0.999985 DISPLAY_IDENTIFIER C_FAC_RAMP_NEG_I_IS_MON FORMAT "%6.4" /end CHARACTERISTIC
/begin CHARACTERISTIC c_tq_dif_p_d_is_add_mon "Additive constant for PD-part model value" VALUE 0x11d9e _REC_VAL_20_u1 255. _CNV_A_R_LINEAR_____95_CM 0. 255. DISPLAY_IDENTIFIER C_TQ_DIF_P_D_IS_ADD_MON FORMAT "%3.0" /end CHARACTERISTIC
/begin CHARACTERISTIC c_tq_dif_i_is_add_mon "additive constant for I-part model value" VALUE 0x11d9c _REC_VAL_20_u1 255. _CNV_A_R_LINEAR_____95_CM 0. 255. DISPLAY_IDENTIFIER C_TQ_DIF_I_IS_ADD_MON FORMAT "%3.0" /end CHARACTERISTIC
/begin CHARACTERISTIC c_fac_ramp_neg_p_d_is_mon "Factor for monitoring negative ISC-deactivation-ramp operation of the PD-part" VALUE 0x120d8 _REC_VAL_20_u2 3.1875e-002 _CNV_A_R_LINEAR_____473_CM 0. 3.1875e-002 DISPLAY_IDENTIFIER C_FAC_RAMP_NEG_P_D_IS_MON FORMAT "%7.5" /end CHARACTERISTIC
/begin CHARACTERISTIC ip_n_sp_is_mon_max_mon "maximum idle speed setpoint depending on coolant temperature" CURVE 0x11f3e _REC_CUR_20_u1_u1 8160. _CNV_A_R_LINEAR_____16_CM 0. 8160. DISPLAY_IDENTIFIER IP_N_SP_IS_MON_MAX_MON FORMAT "%4.0"
 /begin AXIS_DESCR COM_AXIS tco_mon _CNV_A_R_LINEAR_____12_CM 5 -48. 142.5 FORMAT "%5.1" AXIS_PTS_REF ldp_tco_mon_ip_n_sp_is_mon /end AXIS_DESCR
/end CHARACTERISTIC
/begin AXIS_PTS ldp_n_dif_cor_mon_ip_tq_mon "maximum PD-part depending on speed deviation to idle speed setpoint" 0x1206a n_dif_cor_mon _REC_AXS_20_u1 8160. _CNV_A_R_LINEAR_____215_CM 4 -4096. 4064. DISPLAY_IDENTIFIER LDP_N_DIF_COR_MON_IP_TQ_MON FORMAT "%5.0" /end AXIS_PTS
/begin AXIS_PTS ldp_tco_mon_ip_fac_tq_p_d_mon "" 0x12098 tco_mon _REC_AXS_20_u1 190.5 _CNV_A_R_LINEAR_____12_CM 5 -48. 142.5 DISPLAY_IDENTIFIER LDP_TCO_MON_IP_FAC_TQ_P_D_MON FORMAT "%4.0" /end AXIS_PTS
/begin AXIS_PTS ldp_tco_mon_ip_n_sp_is_mon "" 0x1209e tco_mon _REC_AXS_20_u1 190.5 _CNV_A_R_LINEAR_____12_CM 5 -48. 142.5 DISPLAY_IDENTIFIER LDP_TCO_MON_IP_N_SP_IS_MON FORMAT "%5.1" /end AXIS_PTS
/begin MEASUREMENT lv_err_tq_dif_p_d_is_mon "Fault currently present in torque generation, symptom 'idle speed controller - PD-part'" UBYTE _CNV_S_2_RANGE______5_CM 1 100. 0. 1. DISPLAY_IDENTIFIER LV_ERR_TQ_DIF_P_D_IS_MON ECU_ADDRESS 0x3fe6bb BIT_MASK 0x1 /end MEASUREMENT
/begin MEASUREMENT lv_err_tq_dif_i_is_mon "Fault currently present in torque generation, symptom 'idle speed controller - I-part'" UBYTE _CNV_S_2_RANGE______5_CM 1 100. 0. 1. DISPLAY_IDENTIFIER LV_ERR_TQ_DIF_I_IS_MON ECU_ADDRESS 0x3fe6bc BIT_MASK 0x1 /end MEASUREMENT
/begin MEASUREMENT n_dif_sp_is_mon "monitored deviation from actual engine speed to idle speed setpoint" UBYTE _CNV_A_R_LINEAR_____215_CM 1 100. -4096. 4064. DISPLAY_IDENTIFIER N_DIF_SP_IS_MON ECU_ADDRESS 0x3fe6b9 FORMAT "%5.0" /end MEASUREMENT
/begin MEASUREMENT tq_dif_i_is_mon "monitored I-part of the idle speed controller" SWORD _CNV_A_R_LINEAR_____55_CM 1 100. -1024. 1023.96875 DISPLAY_IDENTIFIER TQ_DIF_I_IS_MON ECU_ADDRESS 0x3fda6c BYTE_ORDER MSB_LAST FORMAT "%8.2" /end MEASUREMENT
/begin MEASUREMENT tq_dif_i_is_ramp_mon "modelled I-part dring ramp function" SWORD _CNV_A_R_LINEAR_____474_CM 1 100. -256. 255.9921875 DISPLAY_IDENTIFIER TQ_DIF_I_IS_RAMP_MON ECU_ADDRESS 0x3fda80 BYTE_ORDER MSB_LAST FORMAT "%7.1" /end MEASUREMENT
/begin MEASUREMENT tq_dif_p_d_is_dif_mon "difference between monitored and modelled PD-part" SBYTE _CNV_A_R_LINEAR_____101_CM 1 100. -256. 254. DISPLAY_IDENTIFIER TQ_DIF_P_D_IS_DIF_MON ECU_ADDRESS 0x3fe6c6 FORMAT "%3.0" /end MEASUREMENT
/begin MEASUREMENT tq_dif_i_is_dif_mon "difference between monitored and modelled I-part" SBYTE _CNV_A_R_LINEAR_____101_CM 1 100. -256. 254. DISPLAY_IDENTIFIER TQ_DIF_I_IS_DIF_MON ECU_ADDRESS 0x3fe6c7 FORMAT "%3.0" /end MEASUREMENT
/begin MEASUREMENT abc_tq_dif_p_d_is_mon "Anti bounce counter for monitoring of idle speed controller - PD-part" UBYTE _CNV_A_R_LINEAR_____1_CM 1 100. 0. 255. DISPLAY_IDENTIFIER ABC_TQ_DIF_P_D_IS_MON ECU_ADDRESS 0x3fe6c2 FORMAT "%3.0" /end MEASUREMENT
/begin MEASUREMENT abc_tq_dif_i_is_mon "Anti bounce counter for monitoring of idle speed controller" UBYTE _CNV_A_R_LINEAR_____1_CM 1 100. 0. 255. DISPLAY_IDENTIFIER ABC_TQ_DIF_I_IS_MON ECU_ADDRESS 0x3fe6c4 FORMAT "%3.0" /end MEASUREMENT
/begin MEASUREMENT tq_dif_p_d_is_mon "monitored PD-part of the idle speed controller" SWORD _CNV_A_R_LINEAR_____55_CM 1 100. -1024. 1023.96875 DISPLAY_IDENTIFIER TQ_DIF_P_D_IS_MON ECU_ADDRESS 0x3fda6a BYTE_ORDER MSB_LAST FORMAT "%8.2" /end MEASUREMENT
/begin MEASUREMENT tq_dif_p_d_is_ramp_mon "modelled PD-part during ramp function" SWORD _CNV_A_R_LINEAR_____55_CM 1 100. -1024. 1023.96875 DISPLAY_IDENTIFIER TQ_DIF_P_D_IS_RAMP_MON ECU_ADDRESS 0x3fda7a BYTE_ORDER MSB_LAST FORMAT "%8.2" /end MEASUREMENT
/begin MEASUREMENT tq_add_p_d_is_mon "decrement for modelled PD-part during ramp function" SWORD _CNV_A_R_LINEAR_____474_CM 1 100. -256. 255.9921875 DISPLAY_IDENTIFIER TQ_ADD_P_D_IS_MON ECU_ADDRESS 0x3fda6e BYTE_ORDER MSB_LAST FORMAT "%7.1" /end MEASUREMENT
/begin MEASUREMENT tq_add_i_is_mon "Decrement for modelled I-part during ramp function" SWORD _CNV_A_R_LINEAR_____474_CM 1 100. -256. 255.9921875 DISPLAY_IDENTIFIER TQ_ADD_I_IS_MON ECU_ADDRESS 0x3fda72 BYTE_ORDER MSB_LAST FORMAT "%7.1" /end MEASUREMENT
/begin MEASUREMENT state_err_tq_dif_p_d_is_mon "State variable for fault detection in torque generation, symptom 'idle speed controller - PD-part'" UBYTE _CNV_S_3_STATE_ERR__475_CM 1 100. 0. 2. DISPLAY_IDENTIFIER STATE_ERR_TQ_DIF_P_D_IS_MON ECU_ADDRESS 0x3fe6bd /end MEASUREMENT
/begin MEASUREMENT state_err_tq_dif_i_is_mon "State variable for fault detection in torque generation, symptom 'idle speed controller -   I-part'" UBYTE _CNV_S_3_STATE_ERR__475_CM 1 100. 0. 2. DISPLAY_IDENTIFIER STATE_ERR_TQ_DIF_I_IS_MON ECU_ADDRESS 0x3fe6be /end MEASUREMENT
/begin MEASUREMENT n_dif_mmv_mon "N_DIF moving mean value" UBYTE _CNV_A_R_LINEAR_____215_CM 1 100. -4096. 4064. DISPLAY_IDENTIFIER N_DIF_MMV_MON ECU_ADDRESS 0x3fe6c1 FORMAT "%5.0" /end MEASUREMENT
/begin MEASUREMENT n_dif_cor_mon "Idel speed control variable" UBYTE _CNV_A_R_LINEAR_____215_CM 1 100. -4096. 4064. DISPLAY_IDENTIFIER N_DIF_COR_MON ECU_ADDRESS 0x3fe6ba FORMAT "%5.0" /end MEASUREMENT
/begin CHARACTERISTIC c_n_dif_fac_mon "Multiplicative factor for n_dif_cor calculation" VALUE 0x11d7b _REC_VAL_20_u1 0.9960940000000002 _CNV_A_R_LINEAR_____50_CM 0. 0.996094 DISPLAY_IDENTIFIER C_N_DIF_FAC_MON FORMAT "%5.3" /end CHARACTERISTIC
/begin CHARACTERISTIC c_n_dif_crlc_high_mon "Correlation factor for n_dif_mmv calculation" VALUE 0x11d79 _REC_VAL_20_u1 0.9960940000000002 _CNV_A_R_LINEAR_____50_CM 0. 0.996094 DISPLAY_IDENTIFIER C_N_DIF_CRLC_HIGH_MON FORMAT "%5.3" /end CHARACTERISTIC
/begin CHARACTERISTIC c_n_dif_crlc_low_mon "Correlation factor for n_dif_mmv calculation" VALUE 0x11d7a _REC_VAL_20_u1 0.9960940000000002 _CNV_A_R_LINEAR_____50_CM 0. 0.996094 DISPLAY_IDENTIFIER C_N_DIF_CRLC_LOW_MON FORMAT "%5.3" /end CHARACTERISTIC
/begin MEASUREMENT tq_dif_p_d_is_ramp_mon_1 "modelled PD-part during ramp function and in idle" SWORD _CNV_A_R_LINEAR_____55_CM 1 100. -1024. 1023.96875 DISPLAY_IDENTIFIER TQ_DIF_P_D_IS_RAMP_MON_1 ECU_ADDRESS 0x3fda7e BYTE_ORDER MSB_LAST FORMAT "%8.2" /end MEASUREMENT
/begin MEASUREMENT lv_err_tq_loss_mon "Fault currently present in torque generation, symptom 'torque losses'" UBYTE _CNV_S_2_RANGE______5_CM 1 100. 0. 1. DISPLAY_IDENTIFIER LV_ERR_TQ_LOSS_MON ECU_ADDRESS 0x3fe6cf BIT_MASK 0x1 /end MEASUREMENT
/begin MEASUREMENT tq_loss_dif_mon "difference of monitored and modelled torque losses" SBYTE _CNV_A_R_LINEAR_____101_CM 1 100. -256. 254. DISPLAY_IDENTIFIER TQ_LOSS_DIF_MON ECU_ADDRESS 0x3fe6ce FORMAT "%3.0" /end MEASUREMENT
/begin MEASUREMENT abc_tq_loss_mon "Anti bounce counter for monitoring of torque losses" UBYTE _CNV_A_R_LINEAR_____1_CM 1 100. 0. 255. DISPLAY_IDENTIFIER ABC_TQ_LOSS_MON ECU_ADDRESS 0x3fe6d0 FORMAT "%3.0" /end MEASUREMENT
/begin MEASUREMENT tq_loss_mon "Torque losses" SWORD _CNV_A_R_LINEAR_____55_CM 1 100. -1024. 1023.96875 DISPLAY_IDENTIFIER TQ_LOSS_MON ECU_ADDRESS 0x3fda84 BYTE_ORDER MSB_LAST FORMAT "%8.2" /end MEASUREMENT
/begin MEASUREMENT tqfr_add_mon "Torque losses" SWORD _CNV_A_R_LINEAR_____55_CM 1 100. -1024. 1023.96875 DISPLAY_IDENTIFIER TQFR_ADD_MON ECU_ADDRESS 0x3fda88 BYTE_ORDER MSB_LAST FORMAT "%8.2" /end MEASUREMENT
/begin AXIS_PTS ldp_maf_mon__tq_loss_mon "" 0x12008 maf_mon _REC_AXS_20_u1 1389. _CNV_A_R_LINEAR_____27_CM 5 0. 1389. DISPLAY_IDENTIFIER LDP_MAF_MON__TQ_LOSS_MON FORMAT "%4.0" /end AXIS_PTS
/begin CHARACTERISTIC ip_tq_loss_min_mon "modelled speed and maf dependent torque losses" MAP 0x12128 _REC_MAP_20_u2_u1_u1 1024. _CNV_A_R_LINEAR_____186_CM -1024. 0. DISPLAY_IDENTIFIER IP_TQ_LOSS_MIN_MON FORMAT "%6.2"
 /begin AXIS_DESCR COM_AXIS n_32_mon _CNV_A_R_LINEAR_____16_CM 5 0. 8160. FORMAT "%4.0" AXIS_PTS_REF ldp_n_32_mon__tq_loss_mon /end AXIS_DESCR
 /begin AXIS_DESCR COM_AXIS maf_mon _CNV_A_R_LINEAR_____27_CM 5 0. 1389. FORMAT "%4.0" AXIS_PTS_REF ldp_maf_mon__tq_loss_mon /end AXIS_DESCR
/end CHARACTERISTIC
/begin AXIS_PTS ldp_n_32_mon__tq_loss_mon "" 0x1204a n_32_mon _REC_AXS_20_u1 8160. _CNV_A_R_LINEAR_____16_CM 5 0. 8160. DISPLAY_IDENTIFIER LDP_N_32_MON__TQ_LOSS_MON FORMAT "%4.0" /end AXIS_PTS
/begin CHARACTERISTIC ip_tqfr_add_mon "modelled speed and TCO dependent torque losses" CURVE 0x12170 _REC_CUR_20_u2_u1 1024. _CNV_A_R_LINEAR_____186_CM -1024. 0. DISPLAY_IDENTIFIER IP_TQFR_ADD_MON FORMAT "%6.2"
 /begin AXIS_DESCR COM_AXIS tco_mon _CNV_A_R_LINEAR_____12_CM 5 -48. 142.5 FORMAT "%5.1" AXIS_PTS_REF ldp_tco_mon__tq_loss_mon /end AXIS_DESCR
/end CHARACTERISTIC
/begin CHARACTERISTIC ip_tqfr_add_km_mon "modelled mileage dependent torque losses" CURVE 0x12166 _REC_CUR_20_u2_u2 1024. _CNV_A_R_LINEAR_____186_CM -1024. 0. DISPLAY_IDENTIFIER IP_TQFR_ADD_KM_MON FORMAT "%6.2"
 /begin AXIS_DESCR COM_AXIS ctr_km_can _CNV_A_R_LINEAR_____88_CM 5 0. 655350. FORMAT "%7.0" AXIS_PTS_REF ldp_ctr_km_can__tq_loss_mon /end AXIS_DESCR
/end CHARACTERISTIC
/begin AXIS_PTS ldp_tco_mon__tq_loss_mon "" 0x1208b tco_mon _REC_AXS_20_u1 190.5 _CNV_A_R_LINEAR_____12_CM 5 -48. 142.5 DISPLAY_IDENTIFIER LDP_TCO_MON__TQ_LOSS_MON FORMAT "%5.1" /end AXIS_PTS
/begin AXIS_PTS ldp_ctr_km_can__tq_loss_mon "" 0x121f8 ctr_km_can _REC_AXS_20_u2 655350. _CNV_A_R_LINEAR_____88_CM 5 0. 655350. DISPLAY_IDENTIFIER LDP_CTR_KM_CAN__TQ_LOSS_MON FORMAT "%7.0" /end AXIS_PTS
/begin CHARACTERISTIC c_tq_dif_is_ad_min_mon "minimum additional torque loss for isc adaptation active" VALUE 0x11d3a _REC_VAL_20_s2 40.96 _CNV_A_R_LINEAR_____55_CM -1024. 0. DISPLAY_IDENTIFIER C_TQ_DIF_IS_AD_MIN_MON FORMAT "%6.2" /end CHARACTERISTIC
/begin MEASUREMENT if_t_seg_mis "Engine roughness segment time for safety level 2" UWORD _CNV_A_R_LINEAR_____380_CM 1 100. 0. 65535. DISPLAY_IDENTIFIER IF_T_SEG_MIS ECU_ADDRESS 0x3fd38c BYTE_ORDER MSB_LAST FORMAT "%5.0" /end MEASUREMENT
/begin MEASUREMENT cur_seg_cor "Current ER corrected segment time value" UWORD _CNV_A_R_LINEAR_____380_CM 1 100. 0. 65535. DISPLAY_IDENTIFIER CUR_SEG_COR ECU_ADDRESS 0x3fd38e BYTE_ORDER MSB_LAST FORMAT "%5.0" /end MEASUREMENT
/begin MEASUREMENT seg_t_cor_buf[0] "ER corrected segment times buffer (after adaptation)" UWORD _CNV_A_R_LINEAR_____380_CM 1 100. 0. 65535. DISPLAY_IDENTIFIER SEG_T_COR_0 ECU_ADDRESS 0x3fd380 BYTE_ORDER MSB_LAST FORMAT "%5.0" /end MEASUREMENT
/begin MEASUREMENT seg_t_cor_buf[1] "ER corrected segment times buffer (after adaptation)" UWORD _CNV_A_R_LINEAR_____380_CM 1 100. 0. 65535. DISPLAY_IDENTIFIER SEG_T_COR_1 ECU_ADDRESS 0x3fd382 BYTE_ORDER MSB_LAST FORMAT "%5.0" /end MEASUREMENT
/begin MEASUREMENT seg_t_cor_buf[2] "ER corrected segment times buffer (after adaptation)" UWORD _CNV_A_R_LINEAR_____380_CM 1 100. 0. 65535. DISPLAY_IDENTIFIER SEG_T_COR_2 ECU_ADDRESS 0x3fd384 BYTE_ORDER MSB_LAST FORMAT "%5.0" /end MEASUREMENT
/begin MEASUREMENT seg_t_cor_buf[3] "ER corrected segment times buffer (after adaptation)" UWORD _CNV_A_R_LINEAR_____380_CM 1 100. 0. 65535. DISPLAY_IDENTIFIER SEG_T_COR_3 ECU_ADDRESS 0x3fd386 BYTE_ORDER MSB_LAST FORMAT "%5.0" /end MEASUREMENT
/begin MEASUREMENT seg_t_cor_buf[4] "ER corrected segment times buffer (after adaptation)" UWORD _CNV_A_R_LINEAR_____380_CM 1 100. 0. 65535. DISPLAY_IDENTIFIER SEG_T_COR_4 ECU_ADDRESS 0x3fd388 BYTE_ORDER MSB_LAST FORMAT "%5.0" /end MEASUREMENT
/begin MEASUREMENT seg_t_cor_buf[5] "ER corrected segment times buffer (after adaptation)" UWORD _CNV_A_R_LINEAR_____380_CM 1 100. 0. 65535. DISPLAY_IDENTIFIER SEG_T_COR_5 ECU_ADDRESS 0x3fd38a BYTE_ORDER MSB_LAST FORMAT "%5.0" /end MEASUREMENT
/begin MEASUREMENT drv0_er "Engine roughness static component" SLONG _CNV_A_R_LINEAR_____511_CM 1 100. -2147483647. 2147483648. DISPLAY_IDENTIFIER DRV0_ER ECU_ADDRESS 0x3fcc7c BYTE_ORDER MSB_LAST FORMAT "%11.0" /end MEASUREMENT
/begin MEASUREMENT drv2_mmv_er "Averaged engine roughness curvature component" UWORD _CNV_A_R_LINEAR_____380_CM 1 100. 0. 65535. DISPLAY_IDENTIFIER DRV2_MMV_ER ECU_ADDRESS 0x3fd3ae BYTE_ORDER MSB_LAST FORMAT "%5.0" /end MEASUREMENT
/begin MEASUREMENT drv1_er "Engine roughness dynamic component" SWORD _CNV_A_R_LINEAR_____380_CM 1 100. -32768. 32767. DISPLAY_IDENTIFIER DRV1_ER ECU_ADDRESS 0x3fd392 BYTE_ORDER MSB_LAST FORMAT "%6.0" /end MEASUREMENT
/begin MEASUREMENT er_raw "Engine roughness without curvature component" SWORD _CNV_A_R_LINEAR_____380_CM 1 100. -32768. 32767. DISPLAY_IDENTIFIER ER_RAW ECU_ADDRESS 0x3fd394 BYTE_ORDER MSB_LAST FORMAT "%6.0" /end MEASUREMENT
/begin MEASUREMENT lv_ena_er "Engine roughness enable flag" UBYTE _CNV_S_2_RANGE______5_CM 1 100. 0. 1. DISPLAY_IDENTIFIER LV_ENA_ER ECU_ADDRESS 0x3fe215 /end MEASUREMENT
/begin CHARACTERISTIC c_n_min_er "Minimum engine speed for engine roughness calculation" VALUE 0x002c0 _REC_VAL_20_u2 8160. _CNV_A_R_LINEAR_____11_CM 0. 8160. DISPLAY_IDENTIFIER C_N_MIN_ER FORMAT "%4.0" /end CHARACTERISTIC
/begin MEASUREMENT thd_ad_er "Engine roughness threshold correction factor during segment adaptation learning process" UWORD _CNV_A_R_LINEAR_____380_CM 1 100. 0. 65535. DISPLAY_IDENTIFIER THD_AD_ER ECU_ADDRESS 0x3fd396 BYTE_ORDER MSB_LAST FORMAT "%5.0" /end MEASUREMENT
/begin MEASUREMENT seg_t_ad_min_er "Calculated correlation factor for segment adaptation" UWORD _CNV_A_R_LINEAR_____1_CM 1 100. 0. 65535. DISPLAY_IDENTIFIER SEG_T_AD_MIN_ER ECU_ADDRESS 0x3fd39a BYTE_ORDER MSB_LAST FORMAT "%5.0" /end MEASUREMENT
/begin CHARACTERISTIC c_crk_dif_max_er "Limitation of adaptation range ( mechanical tolerance)" VALUE 0x002b6 _REC_VAL_20_u2 7.8125 _CNV_A_R_LINEAR_____512_CM 0. 7.8125 DISPLAY_IDENTIFIER C_CRK_DIF_MAX_ER FORMAT "%4.2" /end CHARACTERISTIC
/begin MEASUREMENT delta_crk_dif_max_er "Limitation of adaptation range (mech. Tolerance)" UWORD _CNV_A_R_LINEAR_____513_CM 1 100. 0. 245.3 DISPLAY_IDENTIFIER DELTA_CRK_DIF_MAX_ER ECU_ADDRESS 0x3fd39c BYTE_ORDER MSB_LAST FORMAT "%7.3" /end MEASUREMENT
/begin MEASUREMENT lv_seg_ad_lim "Segment adaptation values at limit" UBYTE _CNV_S_2_RANGE______5_CM 1 100. 0. 1. DISPLAY_IDENTIFIER LV_SEG_AD_LIM ECU_ADDRESS 0x3fe216 /end MEASUREMENT
/begin MEASUREMENT cur_seg_mes "Current ER raw segment time measurement" UWORD _CNV_A_R_LINEAR_____380_CM 1 100. 0. 65535. DISPLAY_IDENTIFIER CUR_SEG_MES ECU_ADDRESS 0x3fd3aa BYTE_ORDER MSB_LAST FORMAT "%5.0" /end MEASUREMENT
/begin MEASUREMENT seg_t_mes_buf[0] "ER  raw segment times buffer (before adaptation)" UWORD _CNV_A_R_LINEAR_____380_CM 1 100. 0. 65535. DISPLAY_IDENTIFIER SEG_T_MES_0 ECU_ADDRESS 0x3fd39e BYTE_ORDER MSB_LAST FORMAT "%5.0" /end MEASUREMENT
/begin MEASUREMENT seg_t_mes_buf[1] "ER  raw segment times buffer (before adaptation)" UWORD _CNV_A_R_LINEAR_____380_CM 1 100. 0. 65535. DISPLAY_IDENTIFIER SEG_T_MES_1 ECU_ADDRESS 0x3fd3a0 BYTE_ORDER MSB_LAST FORMAT "%5.0" /end MEASUREMENT
/begin MEASUREMENT seg_t_mes_buf[2] "ER  raw segment times buffer (before adaptation)" UWORD _CNV_A_R_LINEAR_____380_CM 1 100. 0. 65535. DISPLAY_IDENTIFIER SEG_T_MES_2 ECU_ADDRESS 0x3fd3a2 BYTE_ORDER MSB_LAST FORMAT "%5.0" /end MEASUREMENT
/begin MEASUREMENT seg_t_mes_buf[3] "ER  raw segment times buffer (before adaptation)" UWORD _CNV_A_R_LINEAR_____380_CM 1 100. 0. 65535. DISPLAY_IDENTIFIER SEG_T_MES_3 ECU_ADDRESS 0x3fd3a4 BYTE_ORDER MSB_LAST FORMAT "%5.0" /end MEASUREMENT
/begin MEASUREMENT seg_t_mes_buf[4] "ER  raw segment times buffer (before adaptation)" UWORD _CNV_A_R_LINEAR_____380_CM 1 100. 0. 65535. DISPLAY_IDENTIFIER SEG_T_MES_4 ECU_ADDRESS 0x3fd3a6 BYTE_ORDER MSB_LAST FORMAT "%5.0" /end MEASUREMENT
/begin MEASUREMENT seg_t_mes_buf[5] "ER  raw segment times buffer (before adaptation)" UWORD _CNV_A_R_LINEAR_____380_CM 1 100. 0. 65535. DISPLAY_IDENTIFIER SEG_T_MES_5 ECU_ADDRESS 0x3fd3a8 BYTE_ORDER MSB_LAST FORMAT "%5.0" /end MEASUREMENT
/begin MEASUREMENT drv2_er "Engine roughness curvature component" UWORD _CNV_A_R_LINEAR_____380_CM 1 100. 0. 65535. DISPLAY_IDENTIFIER DRV2_ER ECU_ADDRESS 0x3fd3ac BYTE_ORDER MSB_LAST FORMAT "%5.0" /end MEASUREMENT
/begin MEASUREMENT seg_t_ad_nr "Counter for segment adaptation" UWORD _CNV_A_R_LINEAR_____1_CM 1 100. 0. 65535. DISPLAY_IDENTIFIER SEG_T_AD_NR ECU_ADDRESS 0x3fd398 BYTE_ORDER MSB_LAST FORMAT "%5.0" /end MEASUREMENT
/begin MEASUREMENT lv_seg_ad_state "Segment adaptation process state : no adaptive process executed (=0) fast adaptive process executed (=1)" UBYTE _CNV_S_2_RANGE______5_CM 1 100. 0. 1. DISPLAY_IDENTIFIER LV_SEG_AD_STATE ECU_ADDRESS 0x3fe217 /end MEASUREMENT
/begin CHARACTERISTIC c_seg_t_ad_cor_drv1_max_er "Maximum value of DRV1_ER (dynamic part of engine roughness) for crankshaft target wheel learning" VALUE 0x002c4 _REC_VAL_20_u2 32767. _CNV_A_R_LINEAR_____380_CM 0. 32767. DISPLAY_IDENTIFIER C_SEG_T_AD_COR_DRV1_MAX_ER FORMAT "%5.0" /end CHARACTERISTIC
/begin CHARACTERISTIC c_nr_seg_ad_act_min "Minimum segments number in fuel cut-off mode before triggering ER segment adaptive learning process" VALUE 0x0024c _REC_VAL_20_u1 255. _CNV_A_R_LINEAR_____1_CM 0. 255. DISPLAY_IDENTIFIER C_NR_SEG_AD_ACT_MIN FORMAT "%3.0" /end CHARACTERISTIC
/begin CHARACTERISTIC c_nr_seg_drv1_er_min "Minimum number of segments for engine roughness dynamic part" VALUE 0x0024e _REC_VAL_20_u1 255. _CNV_A_R_LINEAR_____1_CM 0. 255. DISPLAY_IDENTIFIER C_NR_SEG_DRV1_ER_MIN FORMAT "%3.0" /end CHARACTERISTIC
/begin CHARACTERISTIC c_n_max_er "Maximum engine speed for engine roughness calculation" VALUE 0x002be _REC_VAL_20_u2 8160. _CNV_A_R_LINEAR_____11_CM 0. 8160. DISPLAY_IDENTIFIER C_N_MAX_ER FORMAT "%4.0" /end CHARACTERISTIC
/begin CHARACTERISTIC c_n_32_min_seg "Engine speed threshold to allow IF_T_SEG_MIS calculation during start phase" VALUE 0x00245 _REC_VAL_20_u1 8160. _CNV_A_R_LINEAR_____16_CM 0. 8160. DISPLAY_IDENTIFIER C_N_32_MIN_SEG FORMAT "%4.0" /end CHARACTERISTIC
/begin MEASUREMENT er "Engine roughness " SWORD _CNV_A_R_LINEAR_____380_CM 1 100. -32768. 32767. DISPLAY_IDENTIFIER ER ECU_ADDRESS 0x3fd390 BYTE_ORDER MSB_LAST FORMAT "%6.0" /end MEASUREMENT
/begin MEASUREMENT er_x[0] "Cylinder Engine roughness values" SWORD _CNV_A_R_LINEAR_____380_CM 1 100. -32768. 32767. DISPLAY_IDENTIFIER ER_0 ECU_ADDRESS 0x3fd3b0 BYTE_ORDER MSB_LAST FORMAT "%6.0" /end MEASUREMENT
/begin MEASUREMENT er_x[1] "Cylinder Engine roughness values" SWORD _CNV_A_R_LINEAR_____380_CM 1 100. -32768. 32767. DISPLAY_IDENTIFIER ER_1 ECU_ADDRESS 0x3fd3b2 BYTE_ORDER MSB_LAST FORMAT "%6.0" /end MEASUREMENT
/begin MEASUREMENT er_x[2] "Cylinder Engine roughness values" SWORD _CNV_A_R_LINEAR_____380_CM 1 100. -32768. 32767. DISPLAY_IDENTIFIER ER_2 ECU_ADDRESS 0x3fd3b4 BYTE_ORDER MSB_LAST FORMAT "%6.0" /end MEASUREMENT
/begin MEASUREMENT er_x[3] "Cylinder Engine roughness values" SWORD _CNV_A_R_LINEAR_____380_CM 1 100. -32768. 32767. DISPLAY_IDENTIFIER ER_3 ECU_ADDRESS 0x3fd3b6 BYTE_ORDER MSB_LAST FORMAT "%6.0" /end MEASUREMENT
/begin MEASUREMENT er_x[4] "Cylinder Engine roughness values" SWORD _CNV_A_R_LINEAR_____380_CM 1 100. -32768. 32767. DISPLAY_IDENTIFIER ER_4 ECU_ADDRESS 0x3fd3b8 BYTE_ORDER MSB_LAST FORMAT "%6.0" /end MEASUREMENT
/begin MEASUREMENT er_x[5] "Cylinder Engine roughness values" SWORD _CNV_A_R_LINEAR_____380_CM 1 100. -32768. 32767. DISPLAY_IDENTIFIER ER_5 ECU_ADDRESS 0x3fd3ba BYTE_ORDER MSB_LAST FORMAT "%6.0" /end MEASUREMENT
/begin MEASUREMENT seg_ad_mmv[0] "Filtered adaptive values used for learning process (for each segment)" SWORD _CNV_A_R_LINEAR_____514_CM 1 100. -7.8125 7.8123 DISPLAY_IDENTIFIER SEG_AD_MMV_0 ECU_ADDRESS 0x3fd368 BYTE_ORDER MSB_LAST FORMAT "%7.4" /end MEASUREMENT
/begin MEASUREMENT seg_ad_mmv[1] "Filtered adaptive values used for learning process (for each segment)" SWORD _CNV_A_R_LINEAR_____514_CM 1 100. -7.8125 7.8123 DISPLAY_IDENTIFIER SEG_AD_MMV_1 ECU_ADDRESS 0x3fd36a BYTE_ORDER MSB_LAST FORMAT "%7.4" /end MEASUREMENT
/begin MEASUREMENT seg_ad_mmv[2] "Filtered adaptive values used for learning process (for each segment)" SWORD _CNV_A_R_LINEAR_____514_CM 1 100. -7.8125 7.8123 DISPLAY_IDENTIFIER SEG_AD_MMV_2 ECU_ADDRESS 0x3fd36c BYTE_ORDER MSB_LAST FORMAT "%7.4" /end MEASUREMENT
/begin MEASUREMENT seg_ad_mmv[3] "Filtered adaptive values used for learning process (for each segment)" SWORD _CNV_A_R_LINEAR_____514_CM 1 100. -7.8125 7.8123 DISPLAY_IDENTIFIER SEG_AD_MMV_3 ECU_ADDRESS 0x3fd36e BYTE_ORDER MSB_LAST FORMAT "%7.4" /end MEASUREMENT
/begin MEASUREMENT seg_ad_mmv[4] "Filtered adaptive values used for learning process (for each segment)" SWORD _CNV_A_R_LINEAR_____514_CM 1 100. -7.8125 7.8123 DISPLAY_IDENTIFIER SEG_AD_MMV_4 ECU_ADDRESS 0x3fd370 BYTE_ORDER MSB_LAST FORMAT "%7.4" /end MEASUREMENT
/begin MEASUREMENT seg_ad_mmv[5] "Filtered adaptive values used for learning process (for each segment)" SWORD _CNV_A_R_LINEAR_____514_CM 1 100. -7.8125 7.8123 DISPLAY_IDENTIFIER SEG_AD_MMV_5 ECU_ADDRESS 0x3fd372 BYTE_ORDER MSB_LAST FORMAT "%7.4" /end MEASUREMENT
/begin MEASUREMENT seg_ad_raw_mmv[0] "Filtered adaptive values used for learning process monitoring (for each segment)" SWORD _CNV_A_R_LINEAR_____514_CM 1 100. -7.8125 7.8123 DISPLAY_IDENTIFIER SEG_AD_RAW_MMV_0 ECU_ADDRESS 0x3fd374 BYTE_ORDER MSB_LAST FORMAT "%7.4" /end MEASUREMENT
/begin MEASUREMENT seg_ad_raw_mmv[1] "Filtered adaptive values used for learning process monitoring (for each segment)" SWORD _CNV_A_R_LINEAR_____514_CM 1 100. -7.8125 7.8123 DISPLAY_IDENTIFIER SEG_AD_RAW_MMV_1 ECU_ADDRESS 0x3fd376 BYTE_ORDER MSB_LAST FORMAT "%7.4" /end MEASUREMENT
/begin MEASUREMENT seg_ad_raw_mmv[2] "Filtered adaptive values used for learning process monitoring (for each segment)" SWORD _CNV_A_R_LINEAR_____514_CM 1 100. -7.8125 7.8123 DISPLAY_IDENTIFIER SEG_AD_RAW_MMV_2 ECU_ADDRESS 0x3fd378 BYTE_ORDER MSB_LAST FORMAT "%7.4" /end MEASUREMENT
/begin MEASUREMENT seg_ad_raw_mmv[3] "Filtered adaptive values used for learning process monitoring (for each segment)" SWORD _CNV_A_R_LINEAR_____514_CM 1 100. -7.8125 7.8123 DISPLAY_IDENTIFIER SEG_AD_RAW_MMV_3 ECU_ADDRESS 0x3fd37a BYTE_ORDER MSB_LAST FORMAT "%7.4" /end MEASUREMENT
/begin MEASUREMENT seg_ad_raw_mmv[4] "Filtered adaptive values used for learning process monitoring (for each segment)" SWORD _CNV_A_R_LINEAR_____514_CM 1 100. -7.8125 7.8123 DISPLAY_IDENTIFIER SEG_AD_RAW_MMV_4 ECU_ADDRESS 0x3fd37c BYTE_ORDER MSB_LAST FORMAT "%7.4" /end MEASUREMENT
/begin MEASUREMENT seg_ad_raw_mmv[5] "Filtered adaptive values used for learning process monitoring (for each segment)" SWORD _CNV_A_R_LINEAR_____514_CM 1 100. -7.8125 7.8123 DISPLAY_IDENTIFIER SEG_AD_RAW_MMV_5 ECU_ADDRESS 0x3fd37e BYTE_ORDER MSB_LAST FORMAT "%7.4" /end MEASUREMENT
/begin MEASUREMENT lv_seg_ad_act_state "ER segment adaptation process enable" UBYTE _CNV_S_2_RANGE______5_CM 1 100. 0. 1. DISPLAY_IDENTIFIER LV_SEG_AD_ACT_STATE ECU_ADDRESS 0x3fe218 /end MEASUREMENT
/begin MEASUREMENT lv_seg_ad_raw_act_state "ER segment adaptation process monitoring enable" UBYTE _CNV_S_2_RANGE______5_CM 1 100. 0. 1. DISPLAY_IDENTIFIER LV_SEG_AD_RAW_ACT_STATE ECU_ADDRESS 0x3fe219 /end MEASUREMENT
/begin CHARACTERISTIC c_n_seg_t_ad_raw_min_er "Minimum engine speed threshold for crankshaft target wheel monitoring" VALUE 0x0024b _REC_VAL_20_u1 8160. _CNV_A_R_LINEAR_____16_CM 0. 8160. DISPLAY_IDENTIFIER C_N_SEG_T_AD_RAW_MIN_ER FORMAT "%4.0" /end CHARACTERISTIC
/begin CHARACTERISTIC c_n_seg_t_ad_min_er "Minimum engine speed threshold for crankshaft target wheel learning" VALUE 0x00248 _REC_VAL_20_u1 8160. _CNV_A_R_LINEAR_____16_CM 0. 8160. DISPLAY_IDENTIFIER C_N_SEG_T_AD_MIN_ER FORMAT "%4.0" /end CHARACTERISTIC
/begin CHARACTERISTIC c_n_seg_t_ad_max_er "Maximum engine speed threshold for crankshaft target wheel learning" VALUE 0x00246 _REC_VAL_20_u1 8160. _CNV_A_R_LINEAR_____16_CM 0. 8160. DISPLAY_IDENTIFIER C_N_SEG_T_AD_MAX_ER FORMAT "%4.0" /end CHARACTERISTIC
/begin CHARACTERISTIC c_n_seg_t_ad_raw_max_er "Maximum engine speed threshold for crankshaft target wheel monitoring" VALUE 0x0024a _REC_VAL_20_u1 8160. _CNV_A_R_LINEAR_____16_CM 0. 8160. DISPLAY_IDENTIFIER C_N_SEG_T_AD_RAW_MAX_ER FORMAT "%4.0" /end CHARACTERISTIC
/begin CHARACTERISTIC c_seg_t_ad_raw_crlc_er "ER segment adaptive values filtering coefficient for monitoring process" VALUE 0x002cc _REC_VAL_20_u2 0.99998474 _CNV_A_R_LINEAR_____37_CM 0. 0.99998474 DISPLAY_IDENTIFIER C_SEG_T_AD_RAW_CRLC_ER FORMAT "%7.5" /end CHARACTERISTIC
/begin MEASUREMENT seg_nr_er "ER segment counter for segment identification (0...NC_CYL_NR - 1)" UBYTE _CNV_A_R_LINEAR_____22_CM 1 100. 0. 12. DISPLAY_IDENTIFIER SEG_NR_ER ECU_ADDRESS 0x3fe214 FORMAT "%3.0" /end MEASUREMENT
/begin MEASUREMENT seg_nr_cbk_er "Cylinder bank i identification according actual ER segment NR" UBYTE _CNV_A_R_LINEAR_____22_CM 1 100. 0. 12. DISPLAY_IDENTIFIER SEG_NR_CBK_ER ECU_ADDRESS 0x3fe220 FORMAT "%3.0" /end MEASUREMENT
/begin AXIS_PTS ldp_seg_nr_er "" 0x01121 seg_nr_cbk_er _REC_AXS_20_u1 12. _CNV_A_R_LINEAR_____1_CM 6 0. 12. DISPLAY_IDENTIFIER LDP_SEG_NR_ER FORMAT "%3.0" /end AXIS_PTS
/begin CHARACTERISTIC id_seg_nr_cbk_er "Table for bankwise ER segment cylinder identification" CURVE 0x009e6 _REC_CUR_20_u1_u1 255. _CNV_A_R_LINEAR_____1_CM 0. 255. DISPLAY_IDENTIFIER ID_SEG_NR_CBK_ER FORMAT "%3.0"
 /begin AXIS_DESCR COM_AXIS seg_nr_cbk_er _CNV_A_R_LINEAR_____1_CM 6 0. 12. FORMAT "%3.0" AXIS_PTS_REF ldp_seg_nr_er /end AXIS_DESCR
/end CHARACTERISTIC
/begin CHARACTERISTIC c_tps_grd_dly_er_ad "Fade out duration when maximum throttle gradient has been detected" VALUE 0x002d6 _REC_VAL_20_u2 655.34 _CNV_A_R_LINEAR_____4_CM 1.e-002 655.35 DISPLAY_IDENTIFIER C_TPS_GRD_DLY_ER_AD FORMAT "%5.2" /end CHARACTERISTIC
/begin CHARACTERISTIC c_seg_t_mes_min "ER minimum valid segment time" VALUE 0x002d2 _REC_VAL_20_u2 65535. _CNV_A_R_LINEAR_____380_CM 0. 65535. DISPLAY_IDENTIFIER C_SEG_T_MES_MIN FORMAT "%5.0" /end CHARACTERISTIC
/begin CHARACTERISTIC c_seg_t_mes_max "ER maximum valid segment time" VALUE 0x002d0 _REC_VAL_20_u2 65535. _CNV_A_R_LINEAR_____380_CM 0. 65535. DISPLAY_IDENTIFIER C_SEG_T_MES_MAX FORMAT "%5.0" /end CHARACTERISTIC
/begin CHARACTERISTIC c_seg_t_fast_ad_crlc_er "Fast ER segment adaptive values filtering coefficient (fast learning phase)" VALUE 0x002ce _REC_VAL_20_u2 0.99998474 _CNV_A_R_LINEAR_____37_CM 0. 0.99998474 DISPLAY_IDENTIFIER C_SEG_T_FAST_AD_CRLC_ER FORMAT "%7.5" /end CHARACTERISTIC
/begin CHARACTERISTIC c_seg_t_ad_crlc_er_eol "EOL specific filtering coefficient for ER segment adaptive values learning process" VALUE 0x002ca _REC_VAL_20_u2 0.99998474 _CNV_A_R_LINEAR_____37_CM 0. 0.99998474 DISPLAY_IDENTIFIER C_SEG_T_AD_CRLC_ER_EOL FORMAT "%7.5" /end CHARACTERISTIC
/begin CHARACTERISTIC c_seg_t_ad_crlc_er "Nominal ER segment adaptive values filtering coefficient" VALUE 0x002c8 _REC_VAL_20_u2 0.99998474 _CNV_A_R_LINEAR_____37_CM 0. 0.99998474 DISPLAY_IDENTIFIER C_SEG_T_AD_CRLC_ER FORMAT "%7.5" /end CHARACTERISTIC
/begin CHARACTERISTIC c_seg_t_ad_cor_drv1_max_er_eol "Maximum value of DRV1_ER (dynamic part of engine roughness) for crankshaft target wheel learning for EOL request mode" VALUE 0x002c6 _REC_VAL_20_u2 32767. _CNV_A_R_LINEAR_____380_CM 0. 32767. DISPLAY_IDENTIFIER C_SEG_T_AD_COR_DRV1_MAX_ER_EOL FORMAT "%5.0" /end CHARACTERISTIC
/begin CHARACTERISTIC c_seg_ad_dif_max_er "Maximum range for difference between same physical segment adaptive values" VALUE 0x002c2 _REC_VAL_20_u2 7.8123 _CNV_A_R_LINEAR_____515_CM 0. 7.8123 DISPLAY_IDENTIFIER C_SEG_AD_DIF_MAX_ER FORMAT "%6.4" /end CHARACTERISTIC
/begin CHARACTERISTIC c_nr_seg_drv1_er_min_eol "Minimum number of segments for engine roughness dynamic part for EOL request mode" VALUE 0x0024f _REC_VAL_20_u1 255. _CNV_A_R_LINEAR_____1_CM 0. 255. DISPLAY_IDENTIFIER C_NR_SEG_DRV1_ER_MIN_EOL FORMAT "%3.0" /end CHARACTERISTIC
/begin CHARACTERISTIC c_nr_seg_ad_act_min_eol "Minimum segments number in fuel cut-off mode before triggering ER segment adaptive learning process for EOL request mode" VALUE 0x0024d _REC_VAL_20_u1 255. _CNV_A_R_LINEAR_____1_CM 0. 255. DISPLAY_IDENTIFIER C_NR_SEG_AD_ACT_MIN_EOL FORMAT "%3.0" /end CHARACTERISTIC
/begin CHARACTERISTIC c_n_seg_t_ad_min_er_eol "Minimum engine speed threshold for crankshaft target wheel learning for EOL request mode" VALUE 0x00249 _REC_VAL_20_u1 8160. _CNV_A_R_LINEAR_____16_CM 0. 8160. DISPLAY_IDENTIFIER C_N_SEG_T_AD_MIN_ER_EOL FORMAT "%4.0" /end CHARACTERISTIC
/begin CHARACTERISTIC c_n_seg_t_ad_max_er_eol "Maximum engine speed threshold for crankshaft target wheel learning for EOL request mode" VALUE 0x00247 _REC_VAL_20_u1 8160. _CNV_A_R_LINEAR_____16_CM 0. 8160. DISPLAY_IDENTIFIER C_N_SEG_T_AD_MAX_ER_EOL FORMAT "%4.0" /end CHARACTERISTIC
/begin CHARACTERISTIC c_maf_dif_dly_er_ad "Fade out duration when maximum air-mass gradient has been detected" VALUE 0x002bc _REC_VAL_20_u2 655.34 _CNV_A_R_LINEAR_____4_CM 1.e-002 655.35 DISPLAY_IDENTIFIER C_MAF_DIF_DLY_ER_AD FORMAT "%5.2" /end CHARACTERISTIC
/begin CHARACTERISTIC c_load_mis_dif_dly_er_ad "Fade out duration when maximum actual torque gradient has been detected" VALUE 0x002ba _REC_VAL_20_u2 655.35 _CNV_A_R_LINEAR_____4_CM 0. 655.35 DISPLAY_IDENTIFIER C_LOAD_MIS_DIF_DLY_ER_AD FORMAT "%5.2" /end CHARACTERISTIC
/begin CHARACTERISTIC c_fac_drv2_zdly_er "Weighting factor for engine roughness curvative component calculation (correction amount) after start" VALUE 0x002b8 _REC_VAL_20_u2 4. _CNV_A_R_LINEAR_____516_CM 0. 4. DISPLAY_IDENTIFIER C_FAC_DRV2_ZDLY_ER FORMAT "%6.5" /end CHARACTERISTIC
/begin CHARACTERISTIC c_crlc_drv2_zdly_er "Correlation factor for engine roughness curvature component calculation after start" VALUE 0x00244 _REC_VAL_20_u1 0.9960940000000002 _CNV_A_R_LINEAR_____50_CM 0. 0.996094 DISPLAY_IDENTIFIER C_CRLC_DRV2_ZDLY_ER FORMAT "%5.3" /end CHARACTERISTIC
/begin MEASUREMENT fac_gain_er[0] "ER multiplicative correction components" UWORD _CNV_A_R_LINEAR_____517_CM 1 100. 0. 2. DISPLAY_IDENTIFIER FAC_GAIN_ER_0 ECU_ADDRESS 0x3fd3bc BYTE_ORDER MSB_LAST FORMAT "%6.5" /end MEASUREMENT
/begin MEASUREMENT fac_gain_er[1] "ER multiplicative correction components" UWORD _CNV_A_R_LINEAR_____517_CM 1 100. 0. 2. DISPLAY_IDENTIFIER FAC_GAIN_ER_1 ECU_ADDRESS 0x3fd3be BYTE_ORDER MSB_LAST FORMAT "%6.5" /end MEASUREMENT
/begin MEASUREMENT fac_gain_er[2] "ER multiplicative correction components" UWORD _CNV_A_R_LINEAR_____517_CM 1 100. 0. 2. DISPLAY_IDENTIFIER FAC_GAIN_ER_2 ECU_ADDRESS 0x3fd3c0 BYTE_ORDER MSB_LAST FORMAT "%6.5" /end MEASUREMENT
/begin MEASUREMENT fac_gain_er[3] "ER multiplicative correction components" UWORD _CNV_A_R_LINEAR_____517_CM 1 100. 0. 2. DISPLAY_IDENTIFIER FAC_GAIN_ER_3 ECU_ADDRESS 0x3fd3c2 BYTE_ORDER MSB_LAST FORMAT "%6.5" /end MEASUREMENT
/begin MEASUREMENT fac_gain_er[4] "ER multiplicative correction components" UWORD _CNV_A_R_LINEAR_____517_CM 1 100. 0. 2. DISPLAY_IDENTIFIER FAC_GAIN_ER_4 ECU_ADDRESS 0x3fd3c4 BYTE_ORDER MSB_LAST FORMAT "%6.5" /end MEASUREMENT
/begin MEASUREMENT fac_gain_er[5] "ER multiplicative correction components" UWORD _CNV_A_R_LINEAR_____517_CM 1 100. 0. 2. DISPLAY_IDENTIFIER FAC_GAIN_ER_5 ECU_ADDRESS 0x3fd3c6 BYTE_ORDER MSB_LAST FORMAT "%6.5" /end MEASUREMENT
/begin MEASUREMENT fac_drv2_er "Weighting factor for engine roughness curvative component calculation (correction amount)" UWORD _CNV_A_R_LINEAR_____516_CM 1 100. 0. 4. DISPLAY_IDENTIFIER FAC_DRV2_ER ECU_ADDRESS 0x3fd3d8 BYTE_ORDER MSB_LAST FORMAT "%6.5" /end MEASUREMENT
/begin MEASUREMENT fac_add_er[0] "ER additive correction components" SWORD _CNV_A_R_LINEAR_____380_CM 1 100. -32768. 32767. DISPLAY_IDENTIFIER FAC_ADD_ER_0 ECU_ADDRESS 0x3fd3c8 BYTE_ORDER MSB_LAST FORMAT "%6.0" /end MEASUREMENT
/begin MEASUREMENT fac_add_er[1] "ER additive correction components" SWORD _CNV_A_R_LINEAR_____380_CM 1 100. -32768. 32767. DISPLAY_IDENTIFIER FAC_ADD_ER_1 ECU_ADDRESS 0x3fd3ca BYTE_ORDER MSB_LAST FORMAT "%6.0" /end MEASUREMENT
/begin MEASUREMENT fac_add_er[2] "ER additive correction components" SWORD _CNV_A_R_LINEAR_____380_CM 1 100. -32768. 32767. DISPLAY_IDENTIFIER FAC_ADD_ER_2 ECU_ADDRESS 0x3fd3cc BYTE_ORDER MSB_LAST FORMAT "%6.0" /end MEASUREMENT
/begin MEASUREMENT fac_add_er[3] "ER additive correction components" SWORD _CNV_A_R_LINEAR_____380_CM 1 100. -32768. 32767. DISPLAY_IDENTIFIER FAC_ADD_ER_3 ECU_ADDRESS 0x3fd3ce BYTE_ORDER MSB_LAST FORMAT "%6.0" /end MEASUREMENT
/begin MEASUREMENT fac_add_er[4] "ER additive correction components" SWORD _CNV_A_R_LINEAR_____380_CM 1 100. -32768. 32767. DISPLAY_IDENTIFIER FAC_ADD_ER_4 ECU_ADDRESS 0x3fd3d0 BYTE_ORDER MSB_LAST FORMAT "%6.0" /end MEASUREMENT
/begin MEASUREMENT fac_add_er[5] "ER additive correction components" SWORD _CNV_A_R_LINEAR_____380_CM 1 100. -32768. 32767. DISPLAY_IDENTIFIER FAC_ADD_ER_5 ECU_ADDRESS 0x3fd3d2 BYTE_ORDER MSB_LAST FORMAT "%6.0" /end MEASUREMENT
/begin MEASUREMENT crlc_drv2_er "Correlation factor for engine roughness curvature component calculation" UBYTE _CNV_A_R_LINEAR_____50_CM 1 100. 0. 0.996094 DISPLAY_IDENTIFIER CRLC_DRV2_ER ECU_ADDRESS 0x3fe21f FORMAT "%5.3" /end MEASUREMENT
/begin CHARACTERISTIC ip_seg_2_ad_cor "Adaptive value correction versus engine speed for segment 2 & 5" CURVE 0x03114 _REC_CUR_20_u2_u1 15.6248 _CNV_A_R_LINEAR_____518_CM -7.8125 7.8123 DISPLAY_IDENTIFIER IP_SEG_2_AD_COR FORMAT "%7.4"
 /begin AXIS_DESCR COM_AXIS n_32 _CNV_A_R_LINEAR_____16_CM 6 0. 8160. FORMAT "%4.0" AXIS_PTS_REF ldpm_n_32__seg_ad_cor /end AXIS_DESCR
/end CHARACTERISTIC
/begin CHARACTERISTIC ip_seg_1_ad_cor "Adaptive value correction versus engine speed for segment 1 & 4" CURVE 0x03108 _REC_CUR_20_u2_u1 15.6248 _CNV_A_R_LINEAR_____518_CM -7.8125 7.8123 DISPLAY_IDENTIFIER IP_SEG_1_AD_COR FORMAT "%7.4"
 /begin AXIS_DESCR COM_AXIS n_32 _CNV_A_R_LINEAR_____16_CM 6 0. 8160. FORMAT "%4.0" AXIS_PTS_REF ldpm_n_32__seg_ad_cor /end AXIS_DESCR
/end CHARACTERISTIC
/begin CHARACTERISTIC ip_maf_dif_max_er_ad__maf "Maximum air-mass gradient per SEG for fade out condition" CURVE 0x030fc _REC_CUR_20_u2_u2 1389. _CNV_A_R_LINEAR_____106_CM 0. 1389. DISPLAY_IDENTIFIER IP_MAF_DIF_MAX_ER_AD__MAF FORMAT "%7.2"
 /begin AXIS_DESCR COM_AXIS maf _CNV_A_R_LINEAR_____106_CM 6 0. 1389. FORMAT "%7.2" AXIS_PTS_REF ldp_maf__maf_dif_max_er_ad /end AXIS_DESCR
/end CHARACTERISTIC
/begin CHARACTERISTIC ip_fac_load_drv2_er_mt "Weighting factor for DRV2 component calculation (engine load dependent correction amount) - MT vehicle" CURVE 0x02ca8 _REC_CUR_20_u1_u2 1.99220002 _CNV_A_R_LINEAR_____39_CM 0. 1.99220002 DISPLAY_IDENTIFIER IP_FAC_LOAD_DRV2_ER_MT FORMAT "%5.3"
 /begin AXIS_DESCR COM_AXIS load_mis _CNV_A_R_LINEAR_____519_CM 12 0. 99.99694824 AXIS_PTS_REF ldp_load_ip_fac_load_drv2_er_mt /end AXIS_DESCR
/end CHARACTERISTIC
/begin CHARACTERISTIC ip_fac_load_drv2_er_at "Weighting factor for DRV2 component calculation (engine load dependent correction amount)  - AT vehicle" CURVE 0x02c9c _REC_CUR_20_u1_u2 1.99220002 _CNV_A_R_LINEAR_____39_CM 0. 1.99220002 DISPLAY_IDENTIFIER IP_FAC_LOAD_DRV2_ER_AT FORMAT "%5.3"
 /begin AXIS_DESCR COM_AXIS load_mis _CNV_A_R_LINEAR_____519_CM 12 0. 99.99694824 AXIS_PTS_REF ldp_load_ip_fac_load_drv2_er_at /end AXIS_DESCR
/end CHARACTERISTIC
/begin CHARACTERISTIC ip_fac_gain_er_5_mt "ER cylinder 5 multiplicative segment dependent factor for torsion correction with MT" CURVE 0x030e4 _REC_CUR_20_u2_u1 2. _CNV_A_R_LINEAR_____517_CM 0. 2. DISPLAY_IDENTIFIER IP_FAC_GAIN_ER_5_MT FORMAT "%6.5"
 /begin AXIS_DESCR COM_AXIS n_32 _CNV_A_R_LINEAR_____16_CM 6 0. 8160. FORMAT "%4.0" AXIS_PTS_REF ldpm_n_32__fac_er_5_mt /end AXIS_DESCR
/end CHARACTERISTIC
/begin CHARACTERISTIC ip_fac_gain_er_5_at "ER cylinder 5 multiplicative segment dependent factor for torsion correction with AT" CURVE 0x030d8 _REC_CUR_20_u2_u1 2. _CNV_A_R_LINEAR_____517_CM 0. 2. DISPLAY_IDENTIFIER IP_FAC_GAIN_ER_5_AT FORMAT "%6.5"
 /begin AXIS_DESCR COM_AXIS n_32 _CNV_A_R_LINEAR_____16_CM 6 0. 8160. FORMAT "%4.0" AXIS_PTS_REF ldpm_n_32__fac_er_5_at /end AXIS_DESCR
/end CHARACTERISTIC
/begin CHARACTERISTIC ip_fac_gain_er_4_mt "ER cylinder 4 multiplicative segment dependent factor for torsion correction with MT" CURVE 0x030cc _REC_CUR_20_u2_u1 2. _CNV_A_R_LINEAR_____517_CM 0. 2. DISPLAY_IDENTIFIER IP_FAC_GAIN_ER_4_MT FORMAT "%6.5"
 /begin AXIS_DESCR COM_AXIS n_32 _CNV_A_R_LINEAR_____16_CM 6 0. 8160. FORMAT "%4.0" AXIS_PTS_REF ldpm_n_32__fac_er_4_mt /end AXIS_DESCR
/end CHARACTERISTIC
/begin CHARACTERISTIC ip_fac_gain_er_4_at "ER cylinder 4 multiplicative segment dependent factor for torsion correction with AT" CURVE 0x030c0 _REC_CUR_20_u2_u1 2. _CNV_A_R_LINEAR_____517_CM 0. 2. DISPLAY_IDENTIFIER IP_FAC_GAIN_ER_4_AT FORMAT "%6.5"
 /begin AXIS_DESCR COM_AXIS n_32 _CNV_A_R_LINEAR_____16_CM 6 0. 8160. FORMAT "%4.0" AXIS_PTS_REF ldpm_n_32__fac_er_4_at /end AXIS_DESCR
/end CHARACTERISTIC
/begin CHARACTERISTIC ip_fac_gain_er_3_mt "ER cylinder 3 multiplicative segment dependent factor for torsion correction with MT" CURVE 0x030b4 _REC_CUR_20_u2_u1 2. _CNV_A_R_LINEAR_____517_CM 0. 2. DISPLAY_IDENTIFIER IP_FAC_GAIN_ER_3_MT FORMAT "%6.5"
 /begin AXIS_DESCR COM_AXIS n_32 _CNV_A_R_LINEAR_____16_CM 6 0. 8160. FORMAT "%4.0" AXIS_PTS_REF ldpm_n_32__fac_er_3_mt /end AXIS_DESCR
/end CHARACTERISTIC
/begin CHARACTERISTIC ip_fac_gain_er_3_at "ER cylinder 3 multiplicative segment dependent factor for torsion correction with AT" CURVE 0x030a8 _REC_CUR_20_u2_u1 2. _CNV_A_R_LINEAR_____517_CM 0. 2. DISPLAY_IDENTIFIER IP_FAC_GAIN_ER_3_AT FORMAT "%6.5"
 /begin AXIS_DESCR COM_AXIS n_32 _CNV_A_R_LINEAR_____16_CM 6 0. 8160. FORMAT "%4.0" AXIS_PTS_REF ldpm_n_32__fac_er_3_at /end AXIS_DESCR
/end CHARACTERISTIC
/begin CHARACTERISTIC ip_fac_gain_er_2_mt "ER cylinder 2 multiplicative segment dependent factor for torsion correction with MT" CURVE 0x0309c _REC_CUR_20_u2_u1 2. _CNV_A_R_LINEAR_____517_CM 0. 2. DISPLAY_IDENTIFIER IP_FAC_GAIN_ER_2_MT FORMAT "%6.5"
 /begin AXIS_DESCR COM_AXIS n_32 _CNV_A_R_LINEAR_____16_CM 6 0. 8160. FORMAT "%4.0" AXIS_PTS_REF ldpm_n_32__fac_er_2_mt /end AXIS_DESCR
/end CHARACTERISTIC
/begin CHARACTERISTIC ip_fac_gain_er_2_at "ER cylinder 2 multiplicative segment dependent factor for torsion correction with AT" CURVE 0x03090 _REC_CUR_20_u2_u1 2. _CNV_A_R_LINEAR_____517_CM 0. 2. DISPLAY_IDENTIFIER IP_FAC_GAIN_ER_2_AT FORMAT "%6.5"
 /begin AXIS_DESCR COM_AXIS n_32 _CNV_A_R_LINEAR_____16_CM 6 0. 8160. FORMAT "%4.0" AXIS_PTS_REF ldpm_n_32__fac_er_2_at /end AXIS_DESCR
/end CHARACTERISTIC
/begin CHARACTERISTIC ip_fac_gain_er_1_mt "ER cylinder 1 multiplicative segment dependent factor for torsion correction with MT" CURVE 0x03084 _REC_CUR_20_u2_u1 2. _CNV_A_R_LINEAR_____517_CM 0. 2. DISPLAY_IDENTIFIER IP_FAC_GAIN_ER_1_MT FORMAT "%6.5"
 /begin AXIS_DESCR COM_AXIS n_32 _CNV_A_R_LINEAR_____16_CM 6 0. 8160. FORMAT "%4.0" AXIS_PTS_REF ldpm_n_32__fac_er_1_mt /end AXIS_DESCR
/end CHARACTERISTIC
/begin CHARACTERISTIC ip_fac_gain_er_1_at "ER cylinder 1 multiplicative segment dependent factor for torsion correction with AT" CURVE 0x03078 _REC_CUR_20_u2_u1 2. _CNV_A_R_LINEAR_____517_CM 0. 2. DISPLAY_IDENTIFIER IP_FAC_GAIN_ER_1_AT FORMAT "%6.5"
 /begin AXIS_DESCR COM_AXIS n_32 _CNV_A_R_LINEAR_____16_CM 6 0. 8160. FORMAT "%4.0" AXIS_PTS_REF ldpm_n_32__fac_er_1_at /end AXIS_DESCR
/end CHARACTERISTIC
/begin CHARACTERISTIC ip_fac_gain_er_0_mt "ER cylinder 0 multiplicative segment dependent factor for torsion correction with MT" CURVE 0x0306c _REC_CUR_20_u2_u1 2. _CNV_A_R_LINEAR_____517_CM 0. 2. DISPLAY_IDENTIFIER IP_FAC_GAIN_ER_0_MT FORMAT "%6.5"
 /begin AXIS_DESCR COM_AXIS n_32 _CNV_A_R_LINEAR_____16_CM 6 0. 8160. FORMAT "%4.0" AXIS_PTS_REF ldpm_n_32__fac_er_0_mt /end AXIS_DESCR
/end CHARACTERISTIC
/begin CHARACTERISTIC ip_fac_gain_er_0_at "ER cylinder 0 multiplicative segment dependent factor for torsion correction with AT" CURVE 0x03060 _REC_CUR_20_u2_u1 2. _CNV_A_R_LINEAR_____517_CM 0. 2. DISPLAY_IDENTIFIER IP_FAC_GAIN_ER_0_AT FORMAT "%6.5"
 /begin AXIS_DESCR COM_AXIS n_32 _CNV_A_R_LINEAR_____16_CM 6 0. 8160. FORMAT "%4.0" AXIS_PTS_REF ldpm_n_32__fac_er_0_at /end AXIS_DESCR
/end CHARACTERISTIC
/begin CHARACTERISTIC ip_fac_add_er_4_at "ER cylinder 4 additive segment dependet factor for torsion correction with AT" MAP 0x02f40 _REC_MAP_20_u2_u1_u2 65535. _CNV_A_R_LINEAR_____520_CM -32768. 32767. DISPLAY_IDENTIFIER IP_FAC_ADD_ER_4_AT FORMAT "%6.0"
 /begin AXIS_DESCR COM_AXIS n_32 _CNV_A_R_LINEAR_____16_CM 6 0. 8160. FORMAT "%4.0" AXIS_PTS_REF ldpm_n_32__fac_er_4_at /end AXIS_DESCR
 /begin AXIS_DESCR COM_AXIS load_mis _CNV_A_R_LINEAR_____519_CM 6 0. 99.99694824 AXIS_PTS_REF ldp_load_mis__fac_add_er_4_at /end AXIS_DESCR
/end CHARACTERISTIC
/begin CHARACTERISTIC ip_fac_add_er_4_mt "ER cylinder 4 additive segment dependent factor for torsion correction with MT" MAP 0x02f88 _REC_MAP_20_u2_u1_u2 65535. _CNV_A_R_LINEAR_____520_CM -32768. 32767. DISPLAY_IDENTIFIER IP_FAC_ADD_ER_4_MT FORMAT "%6.0"
 /begin AXIS_DESCR COM_AXIS n_32 _CNV_A_R_LINEAR_____16_CM 6 0. 8160. FORMAT "%4.0" AXIS_PTS_REF ldpm_n_32__fac_er_4_mt /end AXIS_DESCR
 /begin AXIS_DESCR COM_AXIS load_mis _CNV_A_R_LINEAR_____519_CM 6 0. 99.99694824 AXIS_PTS_REF ldp_load_mis__fac_add_er_4_mt /end AXIS_DESCR
/end CHARACTERISTIC
/begin CHARACTERISTIC ip_fac_add_er_3_mt "ER cylinder 3 additive segment dependent factor for torsion correction with MT" MAP 0x02ef8 _REC_MAP_20_u2_u1_u2 65535. _CNV_A_R_LINEAR_____520_CM -32768. 32767. DISPLAY_IDENTIFIER IP_FAC_ADD_ER_3_MT FORMAT "%6.0"
 /begin AXIS_DESCR COM_AXIS n_32 _CNV_A_R_LINEAR_____16_CM 6 0. 8160. FORMAT "%4.0" AXIS_PTS_REF ldpm_n_32__fac_er_3_mt /end AXIS_DESCR
 /begin AXIS_DESCR COM_AXIS load_mis _CNV_A_R_LINEAR_____519_CM 6 0. 99.99694824 AXIS_PTS_REF ldp_load_mis__fac_add_er_3_mt /end AXIS_DESCR
/end CHARACTERISTIC
/begin CHARACTERISTIC ip_fac_add_er_3_at "ER cylinder 3 additive segment dependent factor for torsion correction with AT" MAP 0x02eb0 _REC_MAP_20_u2_u1_u2 65535. _CNV_A_R_LINEAR_____520_CM -32768. 32767. DISPLAY_IDENTIFIER IP_FAC_ADD_ER_3_AT FORMAT "%6.0"
 /begin AXIS_DESCR COM_AXIS n_32 _CNV_A_R_LINEAR_____16_CM 6 0. 8160. FORMAT "%4.0" AXIS_PTS_REF ldpm_n_32__fac_er_3_at /end AXIS_DESCR
 /begin AXIS_DESCR COM_AXIS load_mis _CNV_A_R_LINEAR_____519_CM 6 0. 99.99694824 AXIS_PTS_REF ldp_load_mis__fac_add_er_3_at /end AXIS_DESCR
/end CHARACTERISTIC
/begin CHARACTERISTIC ip_fac_add_er_5_at "ER cylinder 5 additive segment dependent factor for torsion correction with AT" MAP 0x02fd0 _REC_MAP_20_u2_u1_u2 65535. _CNV_A_R_LINEAR_____520_CM -32768. 32767. DISPLAY_IDENTIFIER IP_FAC_ADD_ER_5_AT FORMAT "%6.0"
 /begin AXIS_DESCR COM_AXIS n_32 _CNV_A_R_LINEAR_____16_CM 6 0. 8160. FORMAT "%4.0" AXIS_PTS_REF ldpm_n_32__fac_er_5_at /end AXIS_DESCR
 /begin AXIS_DESCR COM_AXIS load_mis _CNV_A_R_LINEAR_____519_CM 6 0. 99.99694824 AXIS_PTS_REF ldp_load_mis__fac_add_er_5_at /end AXIS_DESCR
/end CHARACTERISTIC
/begin CHARACTERISTIC ip_fac_add_er_5_mt "ER cylinder 5 additive segment dependent factor for torsion correction with MT" MAP 0x03018 _REC_MAP_20_u2_u1_u2 65535. _CNV_A_R_LINEAR_____520_CM -32768. 32767. DISPLAY_IDENTIFIER IP_FAC_ADD_ER_5_MT FORMAT "%6.0"
 /begin AXIS_DESCR COM_AXIS n_32 _CNV_A_R_LINEAR_____16_CM 6 0. 8160. FORMAT "%4.0" AXIS_PTS_REF ldpm_n_32__fac_er_5_mt /end AXIS_DESCR
 /begin AXIS_DESCR COM_AXIS load_mis _CNV_A_R_LINEAR_____519_CM 6 0. 99.99694824 AXIS_PTS_REF ldp_load_mis__fac_add_er_5_mt /end AXIS_DESCR
/end CHARACTERISTIC
/begin CHARACTERISTIC ip_fac_add_er_1_at "ER cylinder 1 additive segment dependent factor for torsion correction with AT" MAP 0x02d90 _REC_MAP_20_u2_u1_u2 65535. _CNV_A_R_LINEAR_____520_CM -32768. 32767. DISPLAY_IDENTIFIER IP_FAC_ADD_ER_1_AT FORMAT "%6.0"
 /begin AXIS_DESCR COM_AXIS n_32 _CNV_A_R_LINEAR_____16_CM 6 0. 8160. FORMAT "%4.0" AXIS_PTS_REF ldpm_n_32__fac_er_1_at /end AXIS_DESCR
 /begin AXIS_DESCR COM_AXIS load_mis _CNV_A_R_LINEAR_____519_CM 6 0. 99.99694824 AXIS_PTS_REF ldp_load_mis__fac_add_er_1_at /end AXIS_DESCR
/end CHARACTERISTIC
/begin CHARACTERISTIC ip_fac_add_er_2_mt "ER cylinder 2 additive segment dependent factor for torsion correction with MT" MAP 0x02e68 _REC_MAP_20_u2_u1_u2 65535. _CNV_A_R_LINEAR_____520_CM -32768. 32767. DISPLAY_IDENTIFIER IP_FAC_ADD_ER_2_MT FORMAT "%6.0"
 /begin AXIS_DESCR COM_AXIS n_32 _CNV_A_R_LINEAR_____16_CM 6 0. 8160. FORMAT "%4.0" AXIS_PTS_REF ldpm_n_32__fac_er_2_mt /end AXIS_DESCR
 /begin AXIS_DESCR COM_AXIS load_mis _CNV_A_R_LINEAR_____519_CM 6 0. 99.99694824 AXIS_PTS_REF ldp_load_mis__fac_add_er_2_mt /end AXIS_DESCR
/end CHARACTERISTIC
/begin CHARACTERISTIC ip_fac_add_er_2_at "ER cylinder 2 additive segment dependent factor for torsion correction with AT" MAP 0x02e20 _REC_MAP_20_u2_u1_u2 65535. _CNV_A_R_LINEAR_____520_CM -32768. 32767. DISPLAY_IDENTIFIER IP_FAC_ADD_ER_2_AT FORMAT "%6.0"
 /begin AXIS_DESCR COM_AXIS n_32 _CNV_A_R_LINEAR_____16_CM 6 0. 8160. FORMAT "%4.0" AXIS_PTS_REF ldpm_n_32__fac_er_2_at /end AXIS_DESCR
 /begin AXIS_DESCR COM_AXIS load_mis _CNV_A_R_LINEAR_____519_CM 6 0. 99.99694824 AXIS_PTS_REF ldp_load_mis__fac_add_er_2_at /end AXIS_DESCR
/end CHARACTERISTIC
/begin CHARACTERISTIC ip_fac_add_er_1_mt "ER cylinder 1 additive segment dependent factor for torsion correction with MT" MAP 0x02dd8 _REC_MAP_20_u2_u1_u2 65535. _CNV_A_R_LINEAR_____520_CM -32768. 32767. DISPLAY_IDENTIFIER IP_FAC_ADD_ER_1_MT FORMAT "%6.0"
 /begin AXIS_DESCR COM_AXIS n_32 _CNV_A_R_LINEAR_____16_CM 6 0. 8160. FORMAT "%4.0" AXIS_PTS_REF ldpm_n_32__fac_er_1_mt /end AXIS_DESCR
 /begin AXIS_DESCR COM_AXIS load_mis _CNV_A_R_LINEAR_____519_CM 6 0. 99.99694824 AXIS_PTS_REF ldp_load_mis__fac_add_er_1_mt /end AXIS_DESCR
/end CHARACTERISTIC
/begin CHARACTERISTIC ip_crlc_drv2_er_at "Correlation factor for engine roughness curvature component calculation (correction duration) - AT vehicle" CURVE 0x02c84 _REC_CUR_20_u1_u1 0.9960940000000002 _CNV_A_R_LINEAR_____50_CM 0. 0.996094 DISPLAY_IDENTIFIER IP_CRLC_DRV2_ER_AT FORMAT "%5.3"
 /begin AXIS_DESCR COM_AXIS n_32 _CNV_A_R_LINEAR_____16_CM 12 0. 8160. FORMAT "%4.0" AXIS_PTS_REF ldp_n_32_ip_crlc_drv2_er_at /end AXIS_DESCR
/end CHARACTERISTIC
/begin CHARACTERISTIC ip_crlc_drv2_er_mt "Correlation factor for engine roughness curvature component calculation (correction duration) - MT vehicle" CURVE 0x02c90 _REC_CUR_20_u1_u1 0.9960940000000002 _CNV_A_R_LINEAR_____50_CM 0. 0.996094 DISPLAY_IDENTIFIER IP_CRLC_DRV2_ER_MT FORMAT "%5.3"
 /begin AXIS_DESCR COM_AXIS n_32 _CNV_A_R_LINEAR_____16_CM 12 0. 8160. FORMAT "%4.0" AXIS_PTS_REF ldp_n_32_ip_crlc_drv2_er_mt /end AXIS_DESCR
/end CHARACTERISTIC
/begin CHARACTERISTIC ip_fac_add_er_0_at "ER cylinder 0 additive segment dependent factor for torsion correction with AT" MAP 0x02d00 _REC_MAP_20_u2_u1_u2 65535. _CNV_A_R_LINEAR_____520_CM -32768. 32767. DISPLAY_IDENTIFIER IP_FAC_ADD_ER_0_AT FORMAT "%6.0"
 /begin AXIS_DESCR COM_AXIS n_32 _CNV_A_R_LINEAR_____16_CM 6 0. 8160. FORMAT "%4.0" AXIS_PTS_REF ldpm_n_32__fac_er_0_at /end AXIS_DESCR
 /begin AXIS_DESCR COM_AXIS load_mis _CNV_A_R_LINEAR_____519_CM 6 0. 99.99694824 AXIS_PTS_REF ldp_load_mis__fac_add_er_0_at /end AXIS_DESCR
/end CHARACTERISTIC
/begin CHARACTERISTIC ip_fac_add_er_0_mt "ER cylinder 0 additive segment dependent factor for torsion correction with MT" MAP 0x02d48 _REC_MAP_20_u2_u1_u2 65535. _CNV_A_R_LINEAR_____520_CM -32768. 32767. DISPLAY_IDENTIFIER IP_FAC_ADD_ER_0_MT FORMAT "%6.0"
 /begin AXIS_DESCR COM_AXIS n_32 _CNV_A_R_LINEAR_____16_CM 6 0. 8160. FORMAT "%4.0" AXIS_PTS_REF ldpm_n_32__fac_er_0_mt /end AXIS_DESCR
 /begin AXIS_DESCR COM_AXIS load_mis _CNV_A_R_LINEAR_____519_CM 6 0. 99.99694824 AXIS_PTS_REF ldp_load_mis__fac_add_er_0_mt /end AXIS_DESCR
/end CHARACTERISTIC
/begin CHARACTERISTIC c_t_drv2_zdly_er "Delay for specific curvative component calculation during after start" VALUE 0x002d4 _REC_VAL_20_u2 655.35 _CNV_A_R_LINEAR_____4_CM 0. 655.35 DISPLAY_IDENTIFIER C_T_DRV2_ZDLY_ER FORMAT "%5.2" /end CHARACTERISTIC
/begin CHARACTERISTIC c_accout_dly_er_ad "Fade out duration when air-conditioning compressor has been switched on or off" VALUE 0x002b4 _REC_VAL_20_u2 655.34 _CNV_A_R_LINEAR_____4_CM 1.e-002 655.35 DISPLAY_IDENTIFIER C_ACCOUT_DLY_ER_AD FORMAT "%5.2" /end CHARACTERISTIC
/begin CHARACTERISTIC ip_tps_grd_max_er_ad__tps_av "Maximum throttle gradient threshold for fade out condition" CURVE 0x00250 _REC_CUR_20_u1_u2 2987.5 _CNV_A_R_LINEAR_____52_CM 0. 2987.5 DISPLAY_IDENTIFIER IP_TPS_GRD_MAX_ER_AD__TPS_AV FORMAT "%6.1"
 /begin AXIS_DESCR COM_AXIS tps_av _CNV_A_R_LINEAR_____53_CM 6 0. 119.5 FORMAT "%7.3" AXIS_PTS_REF ldp_tps_av__tps_grd_max_er_ad /end AXIS_DESCR
/end CHARACTERISTIC
/begin CHARACTERISTIC ip_load_mis_dif_max_er_ad "Maximum actual torque gradient fade out condition" CURVE 0x030f0 _REC_CUR_20_u2_u2 100. _CNV_A_R_LINEAR_____367_CM 0. 100. DISPLAY_IDENTIFIER IP_LOAD_MIS_DIF_MAX_ER_AD FORMAT "%7.3"
 /begin AXIS_DESCR COM_AXIS load_mis _CNV_A_R_LINEAR_____367_CM 6 0. 100. FORMAT "%7.3" AXIS_PTS_REF ldp_load_mis__load_mis_dif_max /end AXIS_DESCR
/end CHARACTERISTIC
/begin MEASUREMENT lv_seg_ad_req_eol "EOL specific request for ER segment adaptive learning process" UBYTE _CNV_S_2_RANGE______5_CM 1 100. 0. 1. DISPLAY_IDENTIFIER LV_SEG_AD_REQ_EOL ECU_ADDRESS 0x3fe225 /end MEASUREMENT
/begin MEASUREMENT lv_seg_ad_rst_eol "EOL specific request to reset ER segment adaptive values" UBYTE _CNV_S_2_RANGE______5_CM 1 100. 0. 1. DISPLAY_IDENTIFIER LV_SEG_AD_RST_EOL ECU_ADDRESS 0x3fe226 /end MEASUREMENT
/begin MEASUREMENT lv_err_det_crk "Crankshaft signal detected error (before debouncing)" UBYTE _CNV_S_2_RANGE______5_CM 1 100. 0. 1. DISPLAY_IDENTIFIER LV_ERR_DET_CRK ECU_ADDRESS 0x3fe223 /end MEASUREMENT
/begin MEASUREMENT seg_t_mes "Engine roughness segment time (Applicative software)" UWORD _CNV_A_R_LINEAR_____380_CM 1 100. 0. 65535. DISPLAY_IDENTIFIER SEG_T_MES ECU_ADDRESS 0x3fd3d6 BYTE_ORDER MSB_LAST FORMAT "%5.0" /end MEASUREMENT
/begin MEASUREMENT lv_ena_seg_t_mes "Engine roughness segment time validity flag" UBYTE _CNV_S_2_RANGE______5_CM 1 100. 0. 1. DISPLAY_IDENTIFIER LV_ENA_SEG_T_MES ECU_ADDRESS 0x3fe221 /end MEASUREMENT
/begin MEASUREMENT lv_seg_ad_fdout "Boolean for segment adaptation fade out condition" UBYTE _CNV_S_2_RANGE______5_CM 1 100. 0. 1. DISPLAY_IDENTIFIER LV_SEG_AD_FDOUT ECU_ADDRESS 0x3fe222 /end MEASUREMENT
/begin MEASUREMENT seg_ad_cor "Segment adaptive values correction versus engine speed (for each segment)" SWORD _CNV_A_R_LINEAR_____514_CM 1 100. -7.8125 7.8123 DISPLAY_IDENTIFIER SEG_AD_COR ECU_ADDRESS 0x3fd3d4 BYTE_ORDER MSB_LAST FORMAT "%7.4" /end MEASUREMENT
/begin MEASUREMENT seg_ad_dif_1 "ER adaptive values difference on same physical segment (Segment 1 & 4)" UWORD _CNV_A_R_LINEAR_____515_CM 1 100. 0. 7.8123 DISPLAY_IDENTIFIER SEG_AD_DIF_1 ECU_ADDRESS 0x3fd3de BYTE_ORDER MSB_LAST FORMAT "%6.4" /end MEASUREMENT
/begin MEASUREMENT seg_ad_dif_0 "ER adaptive values difference on same physical segment (Segment 0 & 3)" UWORD _CNV_A_R_LINEAR_____515_CM 1 100. 0. 7.8123 DISPLAY_IDENTIFIER SEG_AD_DIF_0 ECU_ADDRESS 0x3fd3dc BYTE_ORDER MSB_LAST FORMAT "%6.4" /end MEASUREMENT
/begin MEASUREMENT seg_ad_dif_2 "ER adaptive values difference on same physical segment (Segment 2 & 5)" UWORD _CNV_A_R_LINEAR_____515_CM 1 100. 0. 7.8123 DISPLAY_IDENTIFIER SEG_AD_DIF_2 ECU_ADDRESS 0x3fd3e0 BYTE_ORDER MSB_LAST FORMAT "%6.4" /end MEASUREMENT
/begin MEASUREMENT seg_t_ad_crlc_er "ER segment adaptive values filtering coefficient" UWORD _CNV_A_R_LINEAR_____37_CM 1 100. 0. 0.99998474 DISPLAY_IDENTIFIER SEG_T_AD_CRLC_ER ECU_ADDRESS 0x3fd3da BYTE_ORDER MSB_LAST FORMAT "%7.6" /end MEASUREMENT
/begin CHARACTERISTIC lc_seg_ad_rst_ena_eol "Specific EOL request enable flag to reset ER segment adaptive values & learning process" VALUE 0x00258 _REC_VAL_20_u1 1. _CNV_A_R_LINEAR_____1_CM 0. 1. DISPLAY_IDENTIFIER LC_SEG_AD_RST_ENA_EOL FORMAT "%2.0" /end CHARACTERISTIC
/begin CHARACTERISTIC lc_seg_ad_req_ena_eol "Specific EOL request enable flag for ER segment adaptive value learning process" VALUE 0x00257 _REC_VAL_20_u1 1. _CNV_A_R_LINEAR_____1_CM 0. 1. DISPLAY_IDENTIFIER LC_SEG_AD_REQ_ENA_EOL FORMAT "%2.0" /end CHARACTERISTIC
/begin CHARACTERISTIC lc_conf_gain_add_er "ER gain/additive correction enable flag" VALUE 0x00256 _REC_VAL_20_u1 1. _CNV_A_R_LINEAR_____1_CM 0. 1. DISPLAY_IDENTIFIER LC_CONF_GAIN_ADD_ER FORMAT "%2.0" /end CHARACTERISTIC
/begin AXIS_PTS ldpm_n_32__seg_ad_cor "" 0x002ad n_32 _REC_AXS_20_u1 8160. _CNV_A_R_LINEAR_____16_CM 6 0. 8160. DISPLAY_IDENTIFIER LDPM_N_32__SEG_AD_COR FORMAT "%4.0" /end AXIS_PTS
/begin AXIS_PTS ldp_maf__maf_dif_max_er_ad "" 0x0320a maf _REC_AXS_20_u2 1389. _CNV_A_R_LINEAR_____106_CM 6 0. 1389. DISPLAY_IDENTIFIER LDP_MAF__MAF_DIF_MAX_ER_AD FORMAT "%7.2" /end AXIS_PTS
/begin AXIS_PTS ldp_tps_av__tps_grd_max_er_ad "" 0x03218 tps_av _REC_AXS_20_u2 119.5 _CNV_A_R_LINEAR_____53_CM 6 0. 119.5 DISPLAY_IDENTIFIER LDP_TPS_AV__TPS_GRD_MAX_ER_AD FORMAT "%7.3" /end AXIS_PTS
/begin MEASUREMENT lv_inh_seg_ad "ER segment adaptive process inhibition flag" UBYTE _CNV_S_2_RANGE______5_CM 1 100. 0. 1. DISPLAY_IDENTIFIER LV_INH_SEG_AD ECU_ADDRESS 0x3fe224 /end MEASUREMENT
/begin MEASUREMENT lv_err_seg_t "Prsent failure for segment time adaptive values" UBYTE _CNV_S_2_RANGE______5_CM 1 100. 0. 1. DISPLAY_IDENTIFIER LV_ERR_SEG_T ECU_ADDRESS 0x3fb9d8 /end MEASUREMENT
/begin MEASUREMENT lv_err_seg_t_ad "Prsent failure for segment time adaptive values" UBYTE _CNV_S_2_RANGE______5_CM 1 100. 0. 1. DISPLAY_IDENTIFIER LV_ERR_SEG_T_AD ECU_ADDRESS 0x3fb9d4 /end MEASUREMENT
/begin AXIS_PTS ldp_load_mis__load_mis_dif_max "" 0x031fc load_mis _REC_AXS_20_u2 100. _CNV_A_R_LINEAR_____367_CM 6 0. 100. DISPLAY_IDENTIFIER LDP_LOAD_MIS__LOAD_MIS_DIF_MAX FORMAT "%7.3" /end AXIS_PTS
/begin CHARACTERISTIC ip_fac_n_drv2_er_at "Weighting factor for DRV2 component calculation (engine speed dependent correction amount) - AT vehicle" CURVE 0x02cb4 _REC_CUR_20_u1_u1 1.99220002 _CNV_A_R_LINEAR_____39_CM 0. 1.99220002 DISPLAY_IDENTIFIER IP_FAC_N_DRV2_ER_AT FORMAT "%5.3"
 /begin AXIS_DESCR COM_AXIS n_32 _CNV_A_R_LINEAR_____16_CM 12 0. 8160. FORMAT "%4.0" AXIS_PTS_REF ldp_n_32_ip_fac_n_drv2_er_at /end AXIS_DESCR
/end CHARACTERISTIC
/begin CHARACTERISTIC ip_fac_n_drv2_er_mt "Weighting factor for DRV2 component calculation (engine speed dependent correction amount) - MT vehicle" CURVE 0x02cc0 _REC_CUR_20_u1_u1 1.99220002 _CNV_A_R_LINEAR_____39_CM 0. 1.99220002 DISPLAY_IDENTIFIER IP_FAC_N_DRV2_ER_MT FORMAT "%5.3"
 /begin AXIS_DESCR COM_AXIS n_32 _CNV_A_R_LINEAR_____16_CM 12 0. 8160. FORMAT "%4.0" AXIS_PTS_REF ldp_n_32_ip_fac_n_drv2_er_mt /end AXIS_DESCR
/end CHARACTERISTIC
/begin AXIS_PTS ldp_load_mis__fac_add_er_0_at "" 0x03154 load_mis _REC_AXS_20_u2 99.99694824000001 _CNV_A_R_LINEAR_____519_CM 6 0. 99.99694824 DISPLAY_IDENTIFIER LDP_LOAD_MIS__FAC_ADD_ER_0_AT /end AXIS_PTS
/begin AXIS_PTS ldp_load_mis__fac_add_er_0_mt "" 0x03162 load_mis _REC_AXS_20_u2 99.99694824000001 _CNV_A_R_LINEAR_____519_CM 6 0. 99.99694824 DISPLAY_IDENTIFIER LDP_LOAD_MIS__FAC_ADD_ER_0_MT /end AXIS_PTS
/begin AXIS_PTS ldp_load_mis__fac_add_er_1_at "" 0x03170 load_mis _REC_AXS_20_u2 99.99694824000001 _CNV_A_R_LINEAR_____519_CM 6 0. 99.99694824 DISPLAY_IDENTIFIER LDP_LOAD_MIS__FAC_ADD_ER_1_AT /end AXIS_PTS
/begin AXIS_PTS ldp_load_mis__fac_add_er_1_mt "" 0x0317e load_mis _REC_AXS_20_u2 99.99694824000001 _CNV_A_R_LINEAR_____519_CM 6 0. 99.99694824 DISPLAY_IDENTIFIER LDP_LOAD_MIS__FAC_ADD_ER_1_MT /end AXIS_PTS
/begin AXIS_PTS ldp_load_mis__fac_add_er_2_at "" 0x0318c load_mis _REC_AXS_20_u2 99.99694824000001 _CNV_A_R_LINEAR_____519_CM 6 0. 99.99694824 DISPLAY_IDENTIFIER LDP_LOAD_MIS__FAC_ADD_ER_2_AT /end AXIS_PTS
/begin AXIS_PTS ldp_load_mis__fac_add_er_2_mt "" 0x0319a load_mis _REC_AXS_20_u2 99.99694824000001 _CNV_A_R_LINEAR_____519_CM 6 0. 99.99694824 DISPLAY_IDENTIFIER LDP_LOAD_MIS__FAC_ADD_ER_2_MT /end AXIS_PTS
/begin AXIS_PTS ldp_load_mis__fac_add_er_3_at "" 0x031a8 load_mis _REC_AXS_20_u2 99.99694824000001 _CNV_A_R_LINEAR_____519_CM 6 0. 99.99694824 DISPLAY_IDENTIFIER LDP_LOAD_MIS__FAC_ADD_ER_3_AT /end AXIS_PTS
/begin AXIS_PTS ldp_load_mis__fac_add_er_3_mt "" 0x031b6 load_mis _REC_AXS_20_u2 99.99694824000001 _CNV_A_R_LINEAR_____519_CM 6 0. 99.99694824 DISPLAY_IDENTIFIER LDP_LOAD_MIS__FAC_ADD_ER_3_MT /end AXIS_PTS
/begin AXIS_PTS ldp_load_mis__fac_add_er_4_at "" 0x031c4 load_mis _REC_AXS_20_u2 99.99694824000001 _CNV_A_R_LINEAR_____519_CM 6 0. 99.99694824 DISPLAY_IDENTIFIER LDP_LOAD_MIS__FAC_ADD_ER_4_AT /end AXIS_PTS
/begin AXIS_PTS ldp_load_mis__fac_add_er_4_mt "" 0x031d2 load_mis _REC_AXS_20_u2 99.99694824000001 _CNV_A_R_LINEAR_____519_CM 6 0. 99.99694824 DISPLAY_IDENTIFIER LDP_LOAD_MIS__FAC_ADD_ER_4_MT /end AXIS_PTS
/begin AXIS_PTS ldp_load_mis__fac_add_er_5_at "" 0x031e0 load_mis _REC_AXS_20_u2 99.99694824000001 _CNV_A_R_LINEAR_____519_CM 6 0. 99.99694824 DISPLAY_IDENTIFIER LDP_LOAD_MIS__FAC_ADD_ER_5_AT /end AXIS_PTS
/begin AXIS_PTS ldp_load_mis__fac_add_er_5_mt "" 0x031ee load_mis _REC_AXS_20_u2 99.99694824000001 _CNV_A_R_LINEAR_____519_CM 6 0. 99.99694824 DISPLAY_IDENTIFIER LDP_LOAD_MIS__FAC_ADD_ER_5_MT /end AXIS_PTS
/begin AXIS_PTS ldp_load_ip_fac_load_drv2_er_at "" 0x03120 load_mis _REC_AXS_20_u2 99.99694824000001 _CNV_A_R_LINEAR_____519_CM 12 0. 99.99694824 DISPLAY_IDENTIFIER LDP_LOAD_IP_FAC_LOAD_DRV2_ER_AT /end AXIS_PTS
/begin AXIS_PTS ldp_load_ip_fac_load_drv2_er_mt "" 0x0313a load_mis _REC_AXS_20_u2 99.99694824000001 _CNV_A_R_LINEAR_____519_CM 12 0. 99.99694824 DISPLAY_IDENTIFIER LDP_LOAD_IP_FAC_LOAD_DRV2_ER_MT /end AXIS_PTS
/begin AXIS_PTS ldp_n_32_ip_fac_n_drv2_er_at "" 0x02ce6 n_32 _REC_AXS_20_u1 8160. _CNV_A_R_LINEAR_____16_CM 12 0. 8160. DISPLAY_IDENTIFIER LDP_N_32_IP_FAC_N_DRV2_ER_AT FORMAT "%4.0" /end AXIS_PTS
/begin AXIS_PTS ldp_n_32_ip_fac_n_drv2_er_mt "" 0x02cf3 n_32 _REC_AXS_20_u1 8160. _CNV_A_R_LINEAR_____16_CM 12 0. 8160. DISPLAY_IDENTIFIER LDP_N_32_IP_FAC_N_DRV2_ER_MT FORMAT "%4.0" /end AXIS_PTS
/begin AXIS_PTS ldp_n_32_ip_crlc_drv2_er_at "" 0x02ccc n_32 _REC_AXS_20_u1 8160. _CNV_A_R_LINEAR_____16_CM 12 0. 8160. DISPLAY_IDENTIFIER LDP_N_32_IP_CRLC_DRV2_ER_AT FORMAT "%4.0" /end AXIS_PTS
/begin AXIS_PTS ldp_n_32_ip_crlc_drv2_er_mt "" 0x02cd9 n_32 _REC_AXS_20_u1 8160. _CNV_A_R_LINEAR_____16_CM 12 0. 8160. DISPLAY_IDENTIFIER LDP_N_32_IP_CRLC_DRV2_ER_MT FORMAT "%4.0" /end AXIS_PTS
/begin AXIS_PTS ldpm_n_32__fac_er_0_at "" 0x00259 n_32 _REC_AXS_20_u1 8160. _CNV_A_R_LINEAR_____16_CM 6 0. 8160. DISPLAY_IDENTIFIER LDPM_N_32__FAC_ER_0_AT FORMAT "%4.0" /end AXIS_PTS
/begin AXIS_PTS ldpm_n_32__fac_er_0_mt "" 0x00260 n_32 _REC_AXS_20_u1 8160. _CNV_A_R_LINEAR_____16_CM 6 0. 8160. DISPLAY_IDENTIFIER LDPM_N_32__FAC_ER_0_MT FORMAT "%4.0" /end AXIS_PTS
/begin AXIS_PTS ldpm_n_32__fac_er_1_at "" 0x00267 n_32 _REC_AXS_20_u1 8160. _CNV_A_R_LINEAR_____16_CM 6 0. 8160. DISPLAY_IDENTIFIER LDPM_N_32__FAC_ER_1_AT FORMAT "%4.0" /end AXIS_PTS
/begin AXIS_PTS ldpm_n_32__fac_er_1_mt "" 0x0026e n_32 _REC_AXS_20_u1 8160. _CNV_A_R_LINEAR_____16_CM 6 0. 8160. DISPLAY_IDENTIFIER LDPM_N_32__FAC_ER_1_MT FORMAT "%4.0" /end AXIS_PTS
/begin AXIS_PTS ldpm_n_32__fac_er_2_at "" 0x00275 n_32 _REC_AXS_20_u1 8160. _CNV_A_R_LINEAR_____16_CM 6 0. 8160. DISPLAY_IDENTIFIER LDPM_N_32__FAC_ER_2_AT FORMAT "%4.0" /end AXIS_PTS
/begin AXIS_PTS ldpm_n_32__fac_er_2_mt "" 0x0027c n_32 _REC_AXS_20_u1 8160. _CNV_A_R_LINEAR_____16_CM 6 0. 8160. DISPLAY_IDENTIFIER LDPM_N_32__FAC_ER_2_MT FORMAT "%4.0" /end AXIS_PTS
/begin AXIS_PTS ldpm_n_32__fac_er_3_at "" 0x00283 n_32 _REC_AXS_20_u1 8160. _CNV_A_R_LINEAR_____16_CM 6 0. 8160. DISPLAY_IDENTIFIER LDPM_N_32__FAC_ER_3_AT FORMAT "%4.0" /end AXIS_PTS
/begin AXIS_PTS ldpm_n_32__fac_er_3_mt "" 0x0028a n_32 _REC_AXS_20_u1 8160. _CNV_A_R_LINEAR_____16_CM 6 0. 8160. DISPLAY_IDENTIFIER LDPM_N_32__FAC_ER_3_MT FORMAT "%4.0" /end AXIS_PTS
/begin AXIS_PTS ldpm_n_32__fac_er_4_at "" 0x00291 n_32 _REC_AXS_20_u1 8160. _CNV_A_R_LINEAR_____16_CM 6 0. 8160. DISPLAY_IDENTIFIER LDPM_N_32__FAC_ER_4_AT FORMAT "%4.0" /end AXIS_PTS
/begin AXIS_PTS ldpm_n_32__fac_er_4_mt "" 0x00298 n_32 _REC_AXS_20_u1 8160. _CNV_A_R_LINEAR_____16_CM 6 0. 8160. DISPLAY_IDENTIFIER LDPM_N_32__FAC_ER_4_MT FORMAT "%4.0" /end AXIS_PTS
/begin AXIS_PTS ldpm_n_32__fac_er_5_at "" 0x0029f n_32 _REC_AXS_20_u1 8160. _CNV_A_R_LINEAR_____16_CM 6 0. 8160. DISPLAY_IDENTIFIER LDPM_N_32__FAC_ER_5_AT FORMAT "%4.0" /end AXIS_PTS
/begin AXIS_PTS ldpm_n_32__fac_er_5_mt "" 0x002a6 n_32 _REC_AXS_20_u1 8160. _CNV_A_R_LINEAR_____16_CM 6 0. 8160. DISPLAY_IDENTIFIER LDPM_N_32__FAC_ER_5_MT FORMAT "%4.0" /end AXIS_PTS
/begin CHARACTERISTIC ENAPPLGOFF "Enable Generatorauschaltsteuerung" VALUE 0x1b782 _REC_VAL_20_u1 255. _CNV_R_R_dez_498_CM 0. 255. FORMAT "%8.4" /end CHARACTERISTIC
/begin CHARACTERISTIC ENAPPLRESP "Enable Handsteuerung Loadresponse" VALUE 0x1b783 _REC_VAL_20_u1 255. _CNV_R_R_dez_498_CM 0. 255. FORMAT "%8.4" /end CHARACTERISTIC
/begin CHARACTERISTIC KFLORESP "Kennfeld Loadresponse ueber Motordrehzahl und rel. Luftmasse" MAP 0x1b73e _REC_MAP_52_UBYTE_u1_u1_u1 25.5 _CNV_R_R_t100msxs_u_500_CM 0. 25.5 FORMAT "%8.4"
 /begin AXIS_DESCR STD_AXIS nmot _CNV_R_R_nmot_ub_q4_510_CM 6 0. 10200. FORMAT "%8.4" /end AXIS_DESCR
 /begin AXIS_DESCR STD_AXIS rl _CNV_R_R_rel_ub_q0p_537_CM 6 0. 191.25 FORMAT "%8.4" /end AXIS_DESCR
/end CHARACTERISTIC
/begin CHARACTERISTIC KLLORESPM "Motorabhängiger Loadresponse-Faktor" CURVE 0x1b770 _REC_CUR_52_UBYTE_u1_u1 3.984375 _CNV_R_R_fak_ub_b4_538_CM 0. 3.984375 FORMAT "%8.4"
 /begin AXIS_DESCR STD_AXIS tmot _CNV_R_R_temp_uw_q0_495_CM 6 -48. 143.25 FORMAT "%8.4" /end AXIS_DESCR
/end CHARACTERISTIC
/begin CHARACTERISTIC LRESPAPP "Load-Response Applikation" VALUE 0x1b785 _REC_VAL_20_u1 25.5 _CNV_R_R_t100msxs_u_500_CM 0. 25.5 FORMAT "%8.4" /end CHARACTERISTIC
/begin CHARACTERISTIC RLMXGENOF "relative Luftfüllungschwelle für Generatorzuschaltung" VALUE 0x1b787 _REC_VAL_20_u1 191.25 _CNV_R_R_rel_ub_q0p_537_CM 0. 191.25 FORMAT "%8.4" /end CHARACTERISTIC
/begin CHARACTERISTIC TGENOFVL "Generatorsabschaltzeit bei Vollastbeschleunigung" VALUE 0x1b78a _REC_VAL_20_u1 255. _CNV_R_R_dez_498_CM 0. 255. FORMAT "%8.4" /end CHARACTERISTIC
/begin CHARACTERISTIC TLORESPST "Startloadresponse" VALUE 0x1b78b _REC_VAL_20_u1 25.5 _CNV_R_R_t100msxs_u_500_CM 0. 25.5 FORMAT "%8.4" /end CHARACTERISTIC
/begin CHARACTERISTIC TVLOFHYST "Hysterese Generatorvollastabschaltung" VALUE 0x1b78f _REC_VAL_20_u1 255. _CNV_R_R_dez_498_CM 0. 255. FORMAT "%8.4" /end CHARACTERISTIC
/begin CHARACTERISTIC VGENOFMN "Geschwindigkeitgeneratorabschaltschwelle bei Vollastbeschleunigung" VALUE 0x1b790 _REC_VAL_20_u1 318.75 _CNV_R_R_vfzg_ub_q1_493_CM 0. 318.75 FORMAT "%8.4" /end CHARACTERISTIC
/begin CHARACTERISTIC VGENOGMX "Geschwindigkeitgeneratorzuschaltschwelle bei Vollastbeschleunigung" VALUE 0x1b791 _REC_VAL_20_u1 318.75 _CNV_R_R_vfzg_ub_q1_493_CM 0. 318.75 FORMAT "%8.4" /end CHARACTERISTIC
/begin CHARACTERISTIC NMXGENOF "Motordrehzahlschwelle für Generatorzuschaltung" VALUE 0x1b786 _REC_VAL_20_u1 10200. _CNV_R_R_nmot_ub_q4_510_CM 0. 10200. FORMAT "%8.4" /end CHARACTERISTIC
/begin CHARACTERISTIC S_LORESLL "Schalter Kennlinienausschaltzeit " VALUE 0x1b788 _REC_VAL_20_u1 255. _CNV_A_R_LINEAR_____22_CM 0. 255. BIT_MASK 0x1 /end CHARACTERISTIC
/begin CHARACTERISTIC TATMGENOF "Motordrehzahlschwelle  Katalysatortemperatur" VALUE 0x1b789 _REC_VAL_20_u1 1275. _CNV_R_R_temp_ub_q5_539_CM -50. 1225. FORMAT "%8.4" /end CHARACTERISTIC
/begin CHARACTERISTIC VZLORESOFV "Geschwindigkeitsschwelle für Generatorzuschaltung" VALUE 0x1b792 _REC_VAL_20_u1 318.75 _CNV_R_R_vfzg_ub_q1_493_CM 0. 318.75 FORMAT "%8.4" /end CHARACTERISTIC
/begin MEASUREMENT tlrgen "Sollwert Load- Response- Zeit Generator" UBYTE _CNV_R_R_t100msxs_u_500_CM 1 100. 0. 25.5 DISPLAY_IDENTIFIER TLRGEN ECU_ADDRESS 0x3fa431 FORMAT "%8.4" /end MEASUREMENT
/begin MEASUREMENT loadresp "gerechnete Loadresponse" UBYTE _CNV_R_R_t100msxs_u_500_CM 1 100. 0. 25.5 DISPLAY_IDENTIFIER LOADRESP ECU_ADDRESS 0x3fa430 FORMAT "%8.4" /end MEASUREMENT
/begin MEASUREMENT B_genoffst "Bedingung Generatorabschaltung im Start" UBYTE _CNV_A_R_LINEAR_____22_CM 1 100. 0. 255. DISPLAY_IDENTIFIER B_GENOFFST ECU_ADDRESS 0x3fa42e BIT_MASK 0x1 /end MEASUREMENT
/begin MEASUREMENT B_genoffvl "Bedingung Generatorabschaltung bei Vollast" UBYTE _CNV_A_R_LINEAR_____22_CM 1 100. 0. 255. DISPLAY_IDENTIFIER B_GENOFFVL ECU_ADDRESS 0x3fa42f BIT_MASK 0x1 /end MEASUREMENT
/begin MEASUREMENT nmot "Motordrehzahl" UBYTE _CNV_R_R_nmot_ub_q4_510_CM 1 100. 0. 10200. DISPLAY_IDENTIFIER NMOT ECU_ADDRESS 0x3fdee1 FORMAT "%8.4" /end MEASUREMENT
/begin MEASUREMENT kmstand "Kilometerstand" UWORD _CNV_R_R_nmot_ub_q1_536_CM 1 100. 0. 655350. DISPLAY_IDENTIFIER KMSTAND ECU_ADDRESS 0x3fcefe BYTE_ORDER MSB_LAST FORMAT "%8.4" /end MEASUREMENT
/begin MEASUREMENT tkatm "Katalysatortemperatur aus Modell" UBYTE _CNV_R_R_temp_ub_q5_539_CM 1 100. -50. 1225. DISPLAY_IDENTIFIER TKATM ECU_ADDRESS 0x3fdf07 FORMAT "%8.4" /end MEASUREMENT
/begin MEASUREMENT rl "relative Luftfüllung" UBYTE _CNV_R_R_rel_ub_q0p_537_CM 1 100. 0. 191.25 DISPLAY_IDENTIFIER RL ECU_ADDRESS 0x3fdee3 FORMAT "%8.4" /end MEASUREMENT
/begin MEASUREMENT B_llrein "Bedingung LLR ist aktiv" UBYTE _CNV_A_R_LINEAR_____22_CM 1 100. 0. 255. DISPLAY_IDENTIFIER B_LLREIN ECU_ADDRESS 0x3fdef0 BIT_MASK 0x1 /end MEASUREMENT
/begin MEASUREMENT B_vl "Bedingung Vollast" UBYTE _CNV_A_R_LINEAR_____22_CM 1 100. 0. 255. DISPLAY_IDENTIFIER B_VL ECU_ADDRESS 0x3fdeef BIT_MASK 0x1 /end MEASUREMENT
/begin MEASUREMENT tmst "Motorstarttemperatur" UBYTE _CNV_R_R_temp_uw_q0_495_CM 1 100. -48. 143.25 DISPLAY_IDENTIFIER TMST ECU_ADDRESS 0x3fdef1 FORMAT "%8.4" /end MEASUREMENT
/begin MEASUREMENT B_stend "Bedingung Startende" UBYTE _CNV_A_R_LINEAR_____22_CM 1 100. 0. 255. DISPLAY_IDENTIFIER B_STEND ECU_ADDRESS 0x3fdee4 BIT_MASK 0x1 /end MEASUREMENT
/begin MEASUREMENT tmot "Motortemperatur" UBYTE _CNV_R_R_temp_uw_q0_495_CM 1 100. -48. 143.25 DISPLAY_IDENTIFIER TMOT ECU_ADDRESS 0x3fdee2 FORMAT "%8.4" /end MEASUREMENT
/begin MEASUREMENT tumg "Umgebungstemperatur" UBYTE _CNV_R_R_temp_uw_q0_495_CM 1 100. -48. 143.25 DISPLAY_IDENTIFIER TUMG ECU_ADDRESS 0x3fdf1d FORMAT "%8.4" /end MEASUREMENT
/begin MEASUREMENT vfzg "Fahrzeuggeschwindigkeit" UBYTE _CNV_R_R_vfzg_ub_q1_493_CM 1 100. 0. 318.75 DISPLAY_IDENTIFIER VFZG ECU_ADDRESS 0x3fdeea FORMAT "%8.4" /end MEASUREMENT
/begin MEASUREMENT fho "Wichtungsfaktor fuer minimale HFM-Luftmassen Schwelle in Abhaengigkeit von d.Hoehe" UBYTE _CNV_R_R_fak_ub_b4_538_CM 1 100. 0. 3.984375 DISPLAY_IDENTIFIER FHO ECU_ADDRESS 0x3fdf1c FORMAT "%8.4" /end MEASUREMENT
/begin MEASUREMENT tlrgen2 "Sollwert Load- Response- Zeit Generator2" UBYTE _CNV_R_R_t100msxs_u_500_CM 1 100. 0. 25.5 DISPLAY_IDENTIFIER TLRGEN2 ECU_ADDRESS 0x3faa58 FORMAT "%8.4" /end MEASUREMENT
/begin MEASUREMENT tmotab "Motortemperatur beim Abstellen" UBYTE _CNV_R_R_temp_uw_q0_495_CM 1 100. -48. 143.25 DISPLAY_IDENTIFIER TMOTAB ECU_ADDRESS 0x3fdf1b FORMAT "%8.4" /end MEASUREMENT
/begin CHARACTERISTIC FHOGNMN "minimaler Wichtungsfaktor fuer minimale HFM-Luftmassen Schwelle in Abhaengigkeit von d.Hoehe fuer Generatorreduzierung" VALUE 0x1b784 _REC_VAL_20_u1 3.984375 _CNV_R_R_fak_ub_b4_538_CM 0. 3.984375 FORMAT "%8.4" /end CHARACTERISTIC
/begin CHARACTERISTIC TABSTGNMN "minimale Abstellzeit für Generatorreduzierung" VALUE 0x1b77e _REC_VAL_20_u2 65535. _CNV_R_R_dez_498_CM 0. 65535. FORMAT "%8.4" /end CHARACTERISTIC
/begin CHARACTERISTIC TABSTGNMX "maximale Abstellzeit für Generatorreduzierung" VALUE 0x1b780 _REC_VAL_20_u2 65535. _CNV_R_R_dez_498_CM 0. 65535. FORMAT "%8.4" /end CHARACTERISTIC
/begin CHARACTERISTIC TMOTABGNMN "minimale Motorabstelltemperatur für Generatorreduzierung" VALUE 0x1b78c _REC_VAL_20_u1 191.25 _CNV_R_R_temp_uw_q0_495_CM -48. 143.25 FORMAT "%8.4" /end CHARACTERISTIC
/begin CHARACTERISTIC TUMGGNMN "minimale Umgebungstemperatur für Generatorreduzierung" VALUE 0x1b78d _REC_VAL_20_u1 191.25 _CNV_R_R_temp_uw_q0_495_CM -48. 143.25 FORMAT "%8.4" /end CHARACTERISTIC
/begin CHARACTERISTIC TUMGGNMX "maximale Umgebungstemperatur für Generatorreduzierung" VALUE 0x1b78e _REC_VAL_20_u1 191.25 _CNV_R_R_temp_uw_q0_495_CM -48. 143.25 FORMAT "%8.4" /end CHARACTERISTIC
/begin CHARACTERISTIC KFZLRESOF "Kennfeld Generatorausschaltzeit bei Stillstand" MAP 0x1b6ee _REC_MAP_52_UBYTE_u1_u1_u2 255. _CNV_R_R_dez_498_CM 0. 255. FORMAT "%8.4"
 /begin AXIS_DESCR STD_AXIS tmst _CNV_R_R_temp_uw_q0_495_CM 6 -48. 143.25 FORMAT "%8.4" /end AXIS_DESCR
 /begin AXIS_DESCR STD_AXIS kmstand _CNV_R_R_nmot_ub_q1_536_CM 4 0. 655350. FORMAT "%8.4" /end AXIS_DESCR
/end CHARACTERISTIC
/begin CHARACTERISTIC KFZLRRESOFV "Kennfeld Generatorausschaltzeit bei Fahrt" MAP 0x1b716 _REC_MAP_52_UBYTE_u1_u1_u2 255. _CNV_R_R_dez_498_CM 0. 255. FORMAT "%8.4"
 /begin AXIS_DESCR STD_AXIS tmst _CNV_R_R_temp_uw_q0_495_CM 6 -48. 143.25 FORMAT "%8.4" /end AXIS_DESCR
 /begin AXIS_DESCR STD_AXIS kmstand _CNV_R_R_nmot_ub_q1_536_CM 4 0. 655350. FORMAT "%8.4" /end AXIS_DESCR
/end CHARACTERISTIC
/begin MEASUREMENT tabsmn_w "Abstellzeit in Minuten" UWORD _CNV_A_R_LINEAR_____97_CM 1 100. 0. 65535. DISPLAY_IDENTIFIER TABSMN_W ECU_ADDRESS 0x3fcef4 BYTE_ORDER MSB_LAST FORMAT "%5.0" /end MEASUREMENT
/begin MEASUREMENT tabst_w "Abstellzeit in Sekunden" UWORD _CNV_A_R_LINEAR_____30_CM 1 100. 0. 65535. DISPLAY_IDENTIFIER TABST_W ECU_ADDRESS 0x3fcef2 BYTE_ORDER MSB_LAST FORMAT "%5.0" /end MEASUREMENT
/begin MEASUREMENT lv_det_mis "Single misfire detected (TDC occurence)" UBYTE _CNV_S_2_RANGE______5_CM 1 100. 0. 1. DISPLAY_IDENTIFIER LV_DET_MIS ECU_ADDRESS 0x3fe05c /end MEASUREMENT
/begin MEASUREMENT mis_state_er "Status carrier byte of actual detected misfire through engine roughness index - 1 bit / cylinder." UWORD _CNV_A_R_LINEAR_____1_CM 1 100. 0. 65535. DISPLAY_IDENTIFIER MIS_STATE_ER ECU_ADDRESS 0x3fd13e BYTE_ORDER MSB_LAST FORMAT "%5.0" /end MEASUREMENT
/begin CHARACTERISTIC c_fac_sca_er_stnd "Scaling factor used for normalized engine roughness calculation" VALUE 0x002d8 _REC_VAL_20_u1 255. _CNV_A_R_LINEAR_____1_CM 0. 255. DISPLAY_IDENTIFIER C_FAC_SCA_ER_STND FORMAT "%3.0" /end CHARACTERISTIC
/begin CHARACTERISTIC c_n_max_er_stnd "Maximum engine speed for normalized ER index (ER_STND)" VALUE 0x00358 _REC_VAL_20_u2 8160. _CNV_A_R_LINEAR_____11_CM 0. 8160. DISPLAY_IDENTIFIER C_N_MAX_ER_STND FORMAT "%4.0" /end CHARACTERISTIC
/begin CHARACTERISTIC lc_er_stnd_conf "Selection between classical ER index (=0) & normalized ER index (ER_STND) (=1) to execute misfire detection" VALUE 0x002ff _REC_VAL_20_u1 1. _CNV_S_2_RANGE______5_CM 0. 1. DISPLAY_IDENTIFIER LC_ER_STND_CONF /end CHARACTERISTIC
/begin MEASUREMENT er_stnd "Normalized engine roughness (versus engine speed - including DRV2_MMV component)" SWORD _CNV_A_R_LINEAR_____540_CM 1 100. -32768. 32767. DISPLAY_IDENTIFIER ER_STND ECU_ADDRESS 0x3fd13c BYTE_ORDER MSB_LAST FORMAT "%6.0" /end MEASUREMENT
/begin MEASUREMENT er_stnd_x[0] "Cylinder normalized engine roughness values" SWORD _CNV_A_R_LINEAR_____540_CM 1 100. -32768. 32767. DISPLAY_IDENTIFIER ER_STND_0 ECU_ADDRESS 0x3fd140 BYTE_ORDER MSB_LAST FORMAT "%6.0" /end MEASUREMENT
/begin MEASUREMENT er_stnd_x[1] "Cylinder normalized engine roughness values" SWORD _CNV_A_R_LINEAR_____540_CM 1 100. -32768. 32767. DISPLAY_IDENTIFIER ER_STND_1 ECU_ADDRESS 0x3fd142 BYTE_ORDER MSB_LAST FORMAT "%6.0" /end MEASUREMENT
/begin MEASUREMENT er_stnd_x[2] "Cylinder normalized engine roughness values" SWORD _CNV_A_R_LINEAR_____540_CM 1 100. -32768. 32767. DISPLAY_IDENTIFIER ER_STND_2 ECU_ADDRESS 0x3fd144 BYTE_ORDER MSB_LAST FORMAT "%6.0" /end MEASUREMENT
/begin MEASUREMENT er_stnd_x[3] "Cylinder normalized engine roughness values" SWORD _CNV_A_R_LINEAR_____540_CM 1 100. -32768. 32767. DISPLAY_IDENTIFIER ER_STND_3 ECU_ADDRESS 0x3fd146 BYTE_ORDER MSB_LAST FORMAT "%6.0" /end MEASUREMENT
/begin MEASUREMENT er_stnd_x[4] "Cylinder normalized engine roughness values" SWORD _CNV_A_R_LINEAR_____540_CM 1 100. -32768. 32767. DISPLAY_IDENTIFIER ER_STND_4 ECU_ADDRESS 0x3fd148 BYTE_ORDER MSB_LAST FORMAT "%6.0" /end MEASUREMENT
/begin MEASUREMENT er_stnd_x[5] "Cylinder normalized engine roughness values" SWORD _CNV_A_R_LINEAR_____540_CM 1 100. -32768. 32767. DISPLAY_IDENTIFIER ER_STND_5 ECU_ADDRESS 0x3fd14a BYTE_ORDER MSB_LAST FORMAT "%6.0" /end MEASUREMENT
/begin MEASUREMENT n_mis "Engine speed for misfire detection - delayed for intake phase analysis of actual diagnosed cylinder" UWORD _CNV_A_R_LINEAR_____11_CM 1 100. 0. 8160. DISPLAY_IDENTIFIER N_MIS ECU_ADDRESS 0x3fd0da BYTE_ORDER MSB_LAST FORMAT "%4.0" /end MEASUREMENT
/begin MEASUREMENT load_mis_1 "Normalised engine load for misfire detection - 1 misfire segment before" UWORD _CNV_A_R_LINEAR_____519_CM 1 100. 0. 99.99694824 DISPLAY_IDENTIFIER LOAD_MIS_1 ECU_ADDRESS 0x3fd0e0 BYTE_ORDER MSB_LAST /end MEASUREMENT
/begin MEASUREMENT load_mis_2 "Normalised engine load for misfire detection - 2 misfire segment before" UWORD _CNV_A_R_LINEAR_____519_CM 1 100. 0. 99.99694824 DISPLAY_IDENTIFIER LOAD_MIS_2 ECU_ADDRESS 0x3fd0d4 BYTE_ORDER MSB_LAST /end MEASUREMENT
/begin MEASUREMENT load_mis_3 "Normalised engine load for misfire detection - 3 misfire segment before" UWORD _CNV_A_R_LINEAR_____519_CM 1 100. 0. 99.99694824 DISPLAY_IDENTIFIER LOAD_MIS_3 ECU_ADDRESS 0x3fd0e2 BYTE_ORDER MSB_LAST /end MEASUREMENT
/begin MEASUREMENT load_grd_mis "Normalised engine load gradient for misfire detection " UWORD _CNV_A_R_LINEAR_____519_CM 1 100. 0. 99.99694824 DISPLAY_IDENTIFIER LOAD_GRD_MIS ECU_ADDRESS 0x3fd0d6 BYTE_ORDER MSB_LAST /end MEASUREMENT
/begin MEASUREMENT load_min_mis "Normalised engine \"zero\" load for misfire detection" UWORD _CNV_A_R_LINEAR_____519_CM 1 100. 0. 99.99694824 DISPLAY_IDENTIFIER LOAD_MIN_MIS ECU_ADDRESS 0x3fd0d8 BYTE_ORDER MSB_LAST /end MEASUREMENT
/begin MEASUREMENT load_mis "Normalised engine load for misfire detection - sampled at current misfire segment" UWORD _CNV_A_R_LINEAR_____519_CM 1 100. 0. 99.99694824 DISPLAY_IDENTIFIER LOAD_MIS ECU_ADDRESS 0x3fd0d2 BYTE_ORDER MSB_LAST /end MEASUREMENT
/begin CHARACTERISTIC ip_load_min_afs_mt_mis "Zero load curve vs engine speed in AFS combustion mode, MT vehicle" CURVE 0x034d0 _REC_CUR_20_u2_u2 99.99694824000001 _CNV_A_R_LINEAR_____519_CM 0. 99.99694824 DISPLAY_IDENTIFIER IP_LOAD_MIN_AFS_MT_MIS
 /begin AXIS_DESCR COM_AXIS n _CNV_A_R_LINEAR_____11_CM 12 0. 8160. FORMAT "%4.0" AXIS_PTS_REF ldp_n__load_min_afs_mt_mis /end AXIS_DESCR
/end CHARACTERISTIC
/begin CHARACTERISTIC ip_load_min_afs_at_mis "Zero load curve vs engine speed in AFS combustion mode, AT vehicle" CURVE 0x034b8 _REC_CUR_20_u2_u2 99.99694824000001 _CNV_A_R_LINEAR_____519_CM 0. 99.99694824 DISPLAY_IDENTIFIER IP_LOAD_MIN_AFS_AT_MIS
 /begin AXIS_DESCR COM_AXIS n _CNV_A_R_LINEAR_____11_CM 12 0. 8160. FORMAT "%4.0" AXIS_PTS_REF ldp_n__load_min_afs_at_mis /end AXIS_DESCR
/end CHARACTERISTIC
/begin CHARACTERISTIC ip_load_min_afl_mt_mis "Zero load curve vs engine speed in AFL combustion mode, MT vehicle" CURVE 0x034a0 _REC_CUR_20_u2_u2 99.99694824000001 _CNV_A_R_LINEAR_____519_CM 0. 99.99694824 DISPLAY_IDENTIFIER IP_LOAD_MIN_AFL_MT_MIS
 /begin AXIS_DESCR COM_AXIS n _CNV_A_R_LINEAR_____11_CM 12 0. 8160. FORMAT "%4.0" AXIS_PTS_REF ldp_n__load_min_afl_mt_mis /end AXIS_DESCR
/end CHARACTERISTIC
/begin CHARACTERISTIC ip_load_min_afl_at_mis "Zero load curve vs engine speed in AFL combustion mode, AT vehicle" CURVE 0x03488 _REC_CUR_20_u2_u2 99.99694824000001 _CNV_A_R_LINEAR_____519_CM 0. 99.99694824 DISPLAY_IDENTIFIER IP_LOAD_MIN_AFL_AT_MIS
 /begin AXIS_DESCR COM_AXIS n _CNV_A_R_LINEAR_____11_CM 12 0. 8160. FORMAT "%4.0" AXIS_PTS_REF ldp_n__load_min_afl_at_mis /end AXIS_DESCR
/end CHARACTERISTIC
/begin CHARACTERISTIC ip_load_min_s_mt_mis "Zero load curve vs engine speed in S combustion mode, MT vehicle" CURVE 0x03500 _REC_CUR_20_u2_u2 99.99694824000001 _CNV_A_R_LINEAR_____519_CM 0. 99.99694824 DISPLAY_IDENTIFIER IP_LOAD_MIN_S_MT_MIS
 /begin AXIS_DESCR COM_AXIS n _CNV_A_R_LINEAR_____11_CM 12 0. 8160. FORMAT "%4.0" AXIS_PTS_REF ldp_n__load_min_s_mt_mis /end AXIS_DESCR
/end CHARACTERISTIC
/begin CHARACTERISTIC ip_load_min_s_at_mis "Zero load curve vs engine speed in S combustion mode, AT vehicle" CURVE 0x034e8 _REC_CUR_20_u2_u2 99.99694824000001 _CNV_A_R_LINEAR_____519_CM 0. 99.99694824 DISPLAY_IDENTIFIER IP_LOAD_MIN_S_AT_MIS
 /begin AXIS_DESCR COM_AXIS n _CNV_A_R_LINEAR_____11_CM 12 0. 8160. FORMAT "%4.0" AXIS_PTS_REF ldp_n__load_min_s_at_mis /end AXIS_DESCR
/end CHARACTERISTIC
/begin CHARACTERISTIC ip_amp_ofs_load_afs_mis "Extra load from zero load curve vs AMP in AFS combustion mode" CURVE 0x0340c _REC_CUR_20_u2_u2 99.94 _CNV_A_R_LINEAR_____541_CM -50. 49.94 DISPLAY_IDENTIFIER IP_AMP_OFS_LOAD_AFS_MIS FORMAT "%7.3"
 /begin AXIS_DESCR COM_AXIS amp _CNV_A_R_LINEAR_____49_CM 9 0. 5434. FORMAT "%7.2" AXIS_PTS_REF ldpm_amp__amp_ofs_load_mis /end AXIS_DESCR
/end CHARACTERISTIC
/begin CHARACTERISTIC ip_amp_ofs_load_s_mis "Extra load from zero load curve vs AMP in S combustion mode" CURVE 0x0341e _REC_CUR_20_u2_u2 99.94 _CNV_A_R_LINEAR_____541_CM -50. 49.94 DISPLAY_IDENTIFIER IP_AMP_OFS_LOAD_S_MIS FORMAT "%7.3"
 /begin AXIS_DESCR COM_AXIS amp _CNV_A_R_LINEAR_____49_CM 9 0. 5434. FORMAT "%7.2" AXIS_PTS_REF ldpm_amp__amp_ofs_load_mis /end AXIS_DESCR
/end CHARACTERISTIC
/begin CHARACTERISTIC ip_amp_ofs_load_afl_mis "Extra load from zero load curve vs AMP in AFL combustion mode" CURVE 0x033fa _REC_CUR_20_u2_u2 99.94 _CNV_A_R_LINEAR_____541_CM -50. 49.94 DISPLAY_IDENTIFIER IP_AMP_OFS_LOAD_AFL_MIS FORMAT "%7.3"
 /begin AXIS_DESCR COM_AXIS amp _CNV_A_R_LINEAR_____49_CM 9 0. 5434. FORMAT "%7.2" AXIS_PTS_REF ldpm_amp__amp_ofs_load_mis /end AXIS_DESCR
/end CHARACTERISTIC
/begin CHARACTERISTIC ip_tco_ofs_load_afl_mis "Extra load from zero load curve vs coolant temperature  in AFL combustion mode" CURVE 0x03530 _REC_CUR_20_u2_u1 99.94 _CNV_A_R_LINEAR_____541_CM -50. 49.94 DISPLAY_IDENTIFIER IP_TCO_OFS_LOAD_AFL_MIS FORMAT "%7.3"
 /begin AXIS_DESCR COM_AXIS tco _CNV_A_R_LINEAR_____12_CM 9 -48. 142.5 FORMAT "%5.1" AXIS_PTS_REF ldpm_tco__tco_ofs_load_mis /end AXIS_DESCR
/end CHARACTERISTIC
/begin CHARACTERISTIC ip_tco_ofs_load_s_mis "Extra load from zero load curve vs coolant temperature in S combustion mode" CURVE 0x03554 _REC_CUR_20_u2_u1 99.94 _CNV_A_R_LINEAR_____541_CM -50. 49.94 DISPLAY_IDENTIFIER IP_TCO_OFS_LOAD_S_MIS FORMAT "%7.3"
 /begin AXIS_DESCR COM_AXIS tco _CNV_A_R_LINEAR_____12_CM 9 -48. 142.5 FORMAT "%5.1" AXIS_PTS_REF ldpm_tco__tco_ofs_load_mis /end AXIS_DESCR
/end CHARACTERISTIC
/begin CHARACTERISTIC ip_tco_ofs_load_afs_mis "Extra load from zero load curve vs coolant temperature  in AFS combustion mode" CURVE 0x03542 _REC_CUR_20_u2_u1 99.94 _CNV_A_R_LINEAR_____541_CM -50. 49.94 DISPLAY_IDENTIFIER IP_TCO_OFS_LOAD_AFS_MIS FORMAT "%7.3"
 /begin AXIS_DESCR COM_AXIS tco _CNV_A_R_LINEAR_____12_CM 9 -48. 142.5 FORMAT "%5.1" AXIS_PTS_REF ldpm_tco__tco_ofs_load_mis /end AXIS_DESCR
/end CHARACTERISTIC
/begin AXIS_PTS ldp_n_32__fac_thd_iv_s_er "" 0x00332 n_32 _REC_AXS_20_u1 8160. _CNV_A_R_LINEAR_____16_CM 6 0. 8160. DISPLAY_IDENTIFIER LDP_N_32__FAC_THD_IV_S_ER FORMAT "%4.0" /end AXIS_PTS
/begin AXIS_PTS ldp_n_32__fac_thd_iv_er "" 0x0032b n_32 _REC_AXS_20_u1 8160. _CNV_A_R_LINEAR_____16_CM 6 0. 8160. DISPLAY_IDENTIFIER LDP_N_32__FAC_THD_IV_ER FORMAT "%4.0" /end AXIS_PTS
/begin AXIS_PTS ldp_load_mis__thd_afl_er_is "" 0x039fa load_mis _REC_AXS_20_u2 99.99694824000001 _CNV_A_R_LINEAR_____519_CM 6 0. 99.99694824 DISPLAY_IDENTIFIER LDP_LOAD_MIS__THD_AFL_ER_IS /end AXIS_PTS
/begin AXIS_PTS ldp_load_mis__thd_afs_er_is "" 0x03a08 load_mis _REC_AXS_20_u2 99.99694824000001 _CNV_A_R_LINEAR_____519_CM 6 0. 99.99694824 DISPLAY_IDENTIFIER LDP_LOAD_MIS__THD_AFS_ER_IS /end AXIS_PTS
/begin AXIS_PTS ldp_load_mis__thd_s_er_is "" 0x03a6a load_mis _REC_AXS_20_u2 99.99694824000001 _CNV_A_R_LINEAR_____519_CM 6 0. 99.99694824 DISPLAY_IDENTIFIER LDP_LOAD_MIS__THD_S_ER_IS /end AXIS_PTS
/begin AXIS_PTS ldp_n__thd_afs_er_is "" 0x03b74 n _REC_AXS_20_u2 8159. _CNV_A_R_LINEAR_____11_CM 4 1. 8160. DISPLAY_IDENTIFIER LDP_N__THD_AFS_ER_IS FORMAT "%4.0" /end AXIS_PTS
/begin AXIS_PTS ldp_n__thd_afl_er_is "" 0x03b6a n _REC_AXS_20_u2 8159. _CNV_A_R_LINEAR_____11_CM 4 1. 8160. DISPLAY_IDENTIFIER LDP_N__THD_AFL_ER_IS FORMAT "%4.0" /end AXIS_PTS
/begin AXIS_PTS ldp_n__thd_s_er_is "" 0x03b7e n _REC_AXS_20_u2 8159. _CNV_A_R_LINEAR_____11_CM 4 1. 8160. DISPLAY_IDENTIFIER LDP_N__THD_S_ER_IS FORMAT "%4.0" /end AXIS_PTS
/begin AXIS_PTS ldp_tco__fac_thd_er "" 0x033e7 tco _REC_AXS_20_u1 190.5 _CNV_A_R_LINEAR_____12_CM 8 -48. 142.5 DISPLAY_IDENTIFIER LDP_TCO__FAC_THD_ER FORMAT "%5.1" /end AXIS_PTS
/begin AXIS_PTS ldp_iga_ch_bas__fac_thd_er_ch "" 0x00303 iga_ch_bas _REC_AXS_20_u1 95.625 _CNV_A_R_LINEAR_____203_CM 4 -35.625 60. DISPLAY_IDENTIFIER LDP_IGA_CH_BAS__FAC_THD_ER_CH FORMAT "%5.1" /end AXIS_PTS
/begin CHARACTERISTIC ip_thd_at_afl_er "ER threshold for misfire detection in air fuel lean combustion mode, AT vehicle" MAP 0x035c6 _REC_MAP_20_u2_u2_u1 65535. _CNV_A_R_LINEAR_____520_CM -32768. 32767. DISPLAY_IDENTIFIER IP_THD_AT_AFL_ER FORMAT "%6.0"
 /begin AXIS_DESCR COM_AXIS load_mis _CNV_A_R_LINEAR_____519_CM 6 0. 99.99694824 AXIS_PTS_REF ldp_load_mis__thd_at_afl_er /end AXIS_DESCR
 /begin AXIS_DESCR COM_AXIS n_32 _CNV_A_R_LINEAR_____16_CM 12 0. 8160. FORMAT "%4.0" AXIS_PTS_REF ldp_n_32__thd_at_afl_er /end AXIS_DESCR
/end CHARACTERISTIC
/begin CHARACTERISTIC ip_thd_afl_er_is "ER threshold for misfire detection in air fuel lean combustion mode in idle speed" MAP 0x03566 _REC_MAP_20_u2_u2_u2 65535. _CNV_A_R_LINEAR_____520_CM -32768. 32767. DISPLAY_IDENTIFIER IP_THD_AFL_ER_IS FORMAT "%6.0"
 /begin AXIS_DESCR COM_AXIS load_mis _CNV_A_R_LINEAR_____519_CM 6 0. 99.99694824 AXIS_PTS_REF ldp_load_mis__thd_afl_er_is /end AXIS_DESCR
 /begin AXIS_DESCR COM_AXIS n _CNV_A_R_LINEAR_____11_CM 4 1. 8160. FORMAT "%4.0" AXIS_PTS_REF ldp_n__thd_afl_er_is /end AXIS_DESCR
/end CHARACTERISTIC
/begin CHARACTERISTIC ip_thd_mt_afs_er "ER threshold for misfire detection in air stoichiometric combustion mode, MT vehicle" MAP 0x03806 _REC_MAP_20_u2_u2_u1 65535. _CNV_A_R_LINEAR_____520_CM -32768. 32767. DISPLAY_IDENTIFIER IP_THD_MT_AFS_ER FORMAT "%6.0"
 /begin AXIS_DESCR COM_AXIS load_mis _CNV_A_R_LINEAR_____519_CM 6 0. 99.99694824 AXIS_PTS_REF ldp_load_mis__thd_mt_afs_er /end AXIS_DESCR
 /begin AXIS_DESCR COM_AXIS n_32 _CNV_A_R_LINEAR_____16_CM 12 0. 8160. FORMAT "%4.0" AXIS_PTS_REF ldp_n_32__thd_mt_afs_er /end AXIS_DESCR
/end CHARACTERISTIC
/begin CHARACTERISTIC ip_thd_mt_afl_er "ER threshold for misfire detection in air fuel lean combustion mode, MT vehicle" MAP 0x03776 _REC_MAP_20_u2_u2_u1 65535. _CNV_A_R_LINEAR_____520_CM -32768. 32767. DISPLAY_IDENTIFIER IP_THD_MT_AFL_ER FORMAT "%6.0"
 /begin AXIS_DESCR COM_AXIS load_mis _CNV_A_R_LINEAR_____519_CM 6 0. 99.99694824 AXIS_PTS_REF ldp_load_mis__thd_mt_afl_er /end AXIS_DESCR
 /begin AXIS_DESCR COM_AXIS n_32 _CNV_A_R_LINEAR_____16_CM 12 0. 8160. FORMAT "%4.0" AXIS_PTS_REF ldp_n_32__thd_mt_afl_er /end AXIS_DESCR
/end CHARACTERISTIC
/begin CHARACTERISTIC ip_thd_afs_er_is "ER threshold for misfire detection in air fuel lean combustion mode in idle speed" MAP 0x03596 _REC_MAP_20_u2_u2_u2 65535. _CNV_A_R_LINEAR_____520_CM -32768. 32767. DISPLAY_IDENTIFIER IP_THD_AFS_ER_IS FORMAT "%6.0"
 /begin AXIS_DESCR COM_AXIS load_mis _CNV_A_R_LINEAR_____519_CM 6 0. 99.99694824 AXIS_PTS_REF ldp_load_mis__thd_afs_er_is /end AXIS_DESCR
 /begin AXIS_DESCR COM_AXIS n _CNV_A_R_LINEAR_____11_CM 4 1. 8160. FORMAT "%4.0" AXIS_PTS_REF ldp_n__thd_afs_er_is /end AXIS_DESCR
/end CHARACTERISTIC
/begin CHARACTERISTIC ip_thd_at_afs_er "ER threshold for misfire detection in air stochiometric combustion mode, AT vehicle" MAP 0x03656 _REC_MAP_20_u2_u2_u1 65535. _CNV_A_R_LINEAR_____520_CM -32768. 32767. DISPLAY_IDENTIFIER IP_THD_AT_AFS_ER FORMAT "%6.0"
 /begin AXIS_DESCR COM_AXIS load_mis _CNV_A_R_LINEAR_____519_CM 6 0. 99.99694824 AXIS_PTS_REF ldp_load_mis__thd_at_afs_er /end AXIS_DESCR
 /begin AXIS_DESCR COM_AXIS n_32 _CNV_A_R_LINEAR_____16_CM 12 0. 8160. FORMAT "%4.0" AXIS_PTS_REF ldp_n_32__thd_at_afs_er /end AXIS_DESCR
/end CHARACTERISTIC
/begin CHARACTERISTIC ip_thd_at_s_er "ER threshold for misfire detection in stratified combustion mode, AT vehicle" MAP 0x036e6 _REC_MAP_20_u2_u2_u1 65535. _CNV_A_R_LINEAR_____520_CM -32768. 32767. DISPLAY_IDENTIFIER IP_THD_AT_S_ER FORMAT "%6.0"
 /begin AXIS_DESCR COM_AXIS load_mis _CNV_A_R_LINEAR_____519_CM 6 0. 99.99694824 AXIS_PTS_REF ldp_load_mis__thd_at_s_er /end AXIS_DESCR
 /begin AXIS_DESCR COM_AXIS n_32 _CNV_A_R_LINEAR_____16_CM 12 0. 8160. FORMAT "%4.0" AXIS_PTS_REF ldp_n_32__thd_at_s_er /end AXIS_DESCR
/end CHARACTERISTIC
/begin CHARACTERISTIC ip_thd_mt_s_er "ER threshold for misfire detection in stratified combustion mode, MT vehicle" MAP 0x03896 _REC_MAP_20_u2_u2_u1 65535. _CNV_A_R_LINEAR_____520_CM -32768. 32767. DISPLAY_IDENTIFIER IP_THD_MT_S_ER FORMAT "%6.0"
 /begin AXIS_DESCR COM_AXIS load_mis _CNV_A_R_LINEAR_____519_CM 6 0. 99.99694824 AXIS_PTS_REF ldp_load_mis__thd_mt_s_er /end AXIS_DESCR
 /begin AXIS_DESCR COM_AXIS n_32 _CNV_A_R_LINEAR_____16_CM 12 0. 8160. FORMAT "%4.0" AXIS_PTS_REF ldp_n_32__thd_mt_s_er /end AXIS_DESCR
/end CHARACTERISTIC
/begin CHARACTERISTIC ip_thd_s_er_is "ER threshold for misfire detection in stratified combustion mode in idle speed" MAP 0x03926 _REC_MAP_20_u2_u2_u2 65535. _CNV_A_R_LINEAR_____520_CM -32768. 32767. DISPLAY_IDENTIFIER IP_THD_S_ER_IS FORMAT "%6.0"
 /begin AXIS_DESCR COM_AXIS load_mis _CNV_A_R_LINEAR_____519_CM 6 0. 99.99694824 AXIS_PTS_REF ldp_load_mis__thd_s_er_is /end AXIS_DESCR
 /begin AXIS_DESCR COM_AXIS n _CNV_A_R_LINEAR_____11_CM 4 1. 8160. FORMAT "%4.0" AXIS_PTS_REF ldp_n__thd_s_er_is /end AXIS_DESCR
/end CHARACTERISTIC
/begin CHARACTERISTIC ip_fac_thd_iv_er "Factor for adaptation of the threshold in case of active cylinder cut-off" CURVE 0x03440 _REC_CUR_20_u2_u1 1. _CNV_A_R_LINEAR_____190_CM 0. 1. DISPLAY_IDENTIFIER IP_FAC_THD_IV_ER FORMAT "%7.5"
 /begin AXIS_DESCR COM_AXIS n_32 _CNV_A_R_LINEAR_____16_CM 6 0. 8160. FORMAT "%4.0" AXIS_PTS_REF ldp_n_32__fac_thd_iv_er /end AXIS_DESCR
/end CHARACTERISTIC
/begin CHARACTERISTIC ip_fac_thd_er "Temperature dependent threshold reduction" CURVE 0x03430 _REC_CUR_20_u2_u1 1.9929 _CNV_A_R_LINEAR_____542_CM 0. 1.9929 DISPLAY_IDENTIFIER IP_FAC_THD_ER FORMAT "%6.4"
 /begin AXIS_DESCR COM_AXIS tco _CNV_A_R_LINEAR_____12_CM 8 -48. 142.5 FORMAT "%5.1" AXIS_PTS_REF ldp_tco__fac_thd_er /end AXIS_DESCR
/end CHARACTERISTIC
/begin CHARACTERISTIC ip_fac_thd_er_ch "Threshold correction depending on IGA for catalyst heating" CURVE 0x002ed _REC_CUR_20_u1_u1 1.9921875 _CNV_A_R_LINEAR_____115_CM 0. 1.9921875 DISPLAY_IDENTIFIER IP_FAC_THD_ER_CH FORMAT "%5.3"
 /begin AXIS_DESCR COM_AXIS iga_ch_bas _CNV_A_R_LINEAR_____203_CM 4 -35.625 60. FORMAT "%5.1" AXIS_PTS_REF ldp_iga_ch_bas__fac_thd_er_ch /end AXIS_DESCR
/end CHARACTERISTIC
/begin MEASUREMENT mis_det_cdn_app_inh_nr "Misfiring APP INC detection fade out requests number  (after masking)" UBYTE _CNV_A_R_LINEAR_____1_CM 1 100. 0. 255. DISPLAY_IDENTIFIER MIS_DET_CDN_APP_INH_NR ECU_ADDRESS 0x3fe03a FORMAT "%3.0" /end MEASUREMENT
/begin MEASUREMENT mis_det_cdn_app_inh "Misfiring APP INC detection fade out requests carrier word (before masking)" UWORD _CNV_A_R_LINEAR_____1_CM 1 100. 0. 65535. DISPLAY_IDENTIFIER MIS_DET_CDN_APP_INH ECU_ADDRESS 0x3fd0e4 BYTE_ORDER MSB_LAST FORMAT "%5.0" /end MEASUREMENT
/begin MEASUREMENT mis_det_cdn_app_inh.lv_inh_map_dif_det_mis "Misfire detection fade out request flag due to MAP_DIF condition" UWORD _CNV_A_R_LINEAR_____1_CM 1 100. 0. 65535. DISPLAY_IDENTIFIER LV_INH_MAP_DIF_DET_MIS ECU_ADDRESS 0x3fd0e4 BYTE_ORDER MSB_LAST FORMAT "%5.0" BIT_MASK 0x1 /end MEASUREMENT
/begin MEASUREMENT mis_det_cdn_app_inh.lv_inh_tps_grd_det_mis "Misfire detection fade out request flag due to TPS gradient condition" UWORD _CNV_A_R_LINEAR_____1_CM 1 100. 0. 65535. DISPLAY_IDENTIFIER LV_INH_TPS_GRD_DET_MIS ECU_ADDRESS 0x3fd0e4 BYTE_ORDER MSB_LAST FORMAT "%5.0" BIT_MASK 0x2 /end MEASUREMENT
/begin MEASUREMENT mis_det_cdn_app_inh.lv_inh_load_grd_det_mis "Misfire detection fade out request flag due to LOAD_GRD_MIS condition" UWORD _CNV_A_R_LINEAR_____1_CM 1 100. 0. 65535. DISPLAY_IDENTIFIER LV_INH_LOAD_GRD_DET_MIS ECU_ADDRESS 0x3fd0e4 BYTE_ORDER MSB_LAST FORMAT "%5.0" BIT_MASK 0x4 /end MEASUREMENT
/begin MEASUREMENT mis_det_cdn_app_inh.lv_inh_iga_dif_det_mis "Misfire detection fade out request flag due to IGA_DIF condition" UWORD _CNV_A_R_LINEAR_____1_CM 1 100. 0. 65535. DISPLAY_IDENTIFIER LV_INH_IGA_DIF_DET_MIS ECU_ADDRESS 0x3fd0e4 BYTE_ORDER MSB_LAST FORMAT "%5.0" BIT_MASK 0x8 /end MEASUREMENT
/begin MEASUREMENT mis_det_cdn_app_inh.lv_inh_cmb_tra_mis "Misfire detection fade out request flag due to combustion mode transients" UWORD _CNV_A_R_LINEAR_____1_CM 1 100. 0. 65535. DISPLAY_IDENTIFIER LV_INH_CMB_TRA_MIS ECU_ADDRESS 0x3fd0e4 BYTE_ORDER MSB_LAST FORMAT "%5.0" BIT_MASK 0x10 /end MEASUREMENT
/begin MEASUREMENT mis_det_cdn_app_inh.lv_inh_acc_det_mis "Misfire detection fade out request flag due to Air conditionner transient condition" UWORD _CNV_A_R_LINEAR_____1_CM 1 100. 0. 65535. DISPLAY_IDENTIFIER LV_INH_ACC_DET_MIS ECU_ADDRESS 0x3fd0e4 BYTE_ORDER MSB_LAST FORMAT "%5.0" BIT_MASK 0x20 /end MEASUREMENT
/begin MEASUREMENT mis_det_cdn_app_inh.lv_inh_cdn_obd_mis "Misfire detection fade out request flag due to OBD1 faults" UWORD _CNV_A_R_LINEAR_____1_CM 1 100. 0. 65535. DISPLAY_IDENTIFIER LV_INH_CDN_OBD_MIS ECU_ADDRESS 0x3fd0e4 BYTE_ORDER MSB_LAST FORMAT "%5.0" BIT_MASK 0x100 /end MEASUREMENT
/begin MEASUREMENT mis_det_cdn_app_inh.lv_inh_indx_mis "Misfire detection fade out request flag due to misfire detection index trouble" UWORD _CNV_A_R_LINEAR_____1_CM 1 100. 0. 65535. DISPLAY_IDENTIFIER LV_INH_INDX_MIS ECU_ADDRESS 0x3fd0e4 BYTE_ORDER MSB_LAST FORMAT "%5.0" BIT_MASK 0x200 /end MEASUREMENT
/begin MEASUREMENT mis_det_cdn_app_inh.lv_inh_amt_gs_det_mis "Misfire detection fade out request flag due to AMT - gearbox mode transients" UWORD _CNV_A_R_LINEAR_____1_CM 1 100. 0. 65535. DISPLAY_IDENTIFIER LV_INH_AMT_GS_DET_MIS ECU_ADDRESS 0x3fd0e4 BYTE_ORDER MSB_LAST FORMAT "%5.0" BIT_MASK 0x400 /end MEASUREMENT
/begin MEASUREMENT iga_mis_1 "Ignition angle 1 misfire segment before" SBYTE _CNV_A_R_LINEAR_____82_CM 1 100. -48. 47.625 DISPLAY_IDENTIFIER IGA_MIS_1 ECU_ADDRESS 0x3fe03e FORMAT "%5.1" /end MEASUREMENT
/begin MEASUREMENT iga_mis_2 "Ignition angle 2 misfire segment before" SBYTE _CNV_A_R_LINEAR_____82_CM 1 100. -48. 47.625 DISPLAY_IDENTIFIER IGA_MIS_2 ECU_ADDRESS 0x3fe03d FORMAT "%5.1" /end MEASUREMENT
/begin MEASUREMENT iga_mis "Ignition angle at current misfire segment" SBYTE _CNV_A_R_LINEAR_____82_CM 1 100. -48. 47.625 DISPLAY_IDENTIFIER IGA_MIS ECU_ADDRESS 0x3fe03f FORMAT "%5.1" /end MEASUREMENT
/begin MEASUREMENT lv_req_app_inh_mis "Misfire detection APP INC fade out request flag" UBYTE _CNV_S_2_RANGE______5_CM 1 100. 0. 1. DISPLAY_IDENTIFIER LV_REQ_APP_INH_MIS ECU_ADDRESS 0x3fe039 /end MEASUREMENT
/begin MEASUREMENT ctr_tot_mis "Overall misfire detection counter" ULONG _CNV_A_R_LINEAR_____22_CM 1 100. 0. 4294967295. DISPLAY_IDENTIFIER CTR_TOT_MIS ECU_ADDRESS 0x3fc8c0 BYTE_ORDER MSB_LAST FORMAT "%11.0" /end MEASUREMENT
/begin CHARACTERISTIC c_mask_app_inh_det_zdly_mis "MIS_DET_CDN_APP_INH carrier structure fade out configuration mask (misfire detection zero delay phase)" VALUE 0x00344 _REC_VAL_20_u2 65535. _CNV_A_R_LINEAR_____1_CM 0. 65535. DISPLAY_IDENTIFIER C_MASK_APP_INH_DET_ZDLY_MIS FORMAT "%5.0" /end CHARACTERISTIC
/begin CHARACTERISTIC c_nr_tdc_iga_dif_er "Fade out duration when IGA difference per TDC has been detected" VALUE 0x002e7 _REC_VAL_20_u1 255. _CNV_A_R_LINEAR_____1_CM 0. 255. DISPLAY_IDENTIFIER C_NR_TDC_IGA_DIF_ER FORMAT "%3.0" /end CHARACTERISTIC
/begin CHARACTERISTIC c_nr_tdc_cmb_tra_s_mis "Fade out TDC's duration when engine combustion manager enter or leave stratified combustion mode" VALUE 0x002e6 _REC_VAL_20_u1 255. _CNV_A_R_LINEAR_____543_CM 0. 255. DISPLAY_IDENTIFIER C_NR_TDC_CMB_TRA_S_MIS FORMAT "%3.0" /end CHARACTERISTIC
/begin CHARACTERISTIC c_nr_tdc_cmb_tra_afl_mis "Fade out TDC's duration when engine combustion manager enter or leave air/fuel lean combustion mode" VALUE 0x002e5 _REC_VAL_20_u1 255. _CNV_A_R_LINEAR_____543_CM 0. 255. DISPLAY_IDENTIFIER C_NR_TDC_CMB_TRA_AFL_MIS FORMAT "%3.0" /end CHARACTERISTIC
/begin CHARACTERISTIC ip_tps_grd_max_er "Maximum throttle gradient threshold for fade out condition" CURVE 0x03386 _REC_CUR_20_u1_u2 2987.5 _CNV_A_R_LINEAR_____52_CM 0. 2987.5 DISPLAY_IDENTIFIER IP_TPS_GRD_MAX_ER FORMAT "%6.1"
 /begin AXIS_DESCR COM_AXIS tps_av _CNV_A_R_LINEAR_____53_CM 10 0. 119.5 FORMAT "%7.3" AXIS_PTS_REF ldp_tps_av__tps_grd_max_er /end AXIS_DESCR
/end CHARACTERISTIC
/begin CHARACTERISTIC ip_tps_grd_max_zdly_er "Maximum throttle gradient threshold for fade out condition during zero delay misfire monitoring activation" CURVE 0x002f1 _REC_CUR_20_u1_u2 2987.5 _CNV_A_R_LINEAR_____52_CM 0. 2987.5 DISPLAY_IDENTIFIER IP_TPS_GRD_MAX_ZDLY_ER FORMAT "%6.1"
 /begin AXIS_DESCR COM_AXIS tps_av _CNV_A_R_LINEAR_____53_CM 6 0. 119.5 FORMAT "%7.3" AXIS_PTS_REF ldp_tps_av__tps_grd_max_zdly_er /end AXIS_DESCR
/end CHARACTERISTIC
/begin CHARACTERISTIC ip_load_grd_hom_max_mis "Maximum LOAD_MIS gradient for fade out condition in homogeneous combustion modes" CURVE 0x03458 _REC_CUR_20_u2_u2 99.99694824000001 _CNV_A_R_LINEAR_____519_CM 0. 99.99694824 DISPLAY_IDENTIFIER IP_LOAD_GRD_HOM_MAX_MIS
 /begin AXIS_DESCR COM_AXIS load_mis _CNV_A_R_LINEAR_____519_CM 12 0. 99.99694824 AXIS_PTS_REF ldp_load_mis__load_grd_hom_max /end AXIS_DESCR
/end CHARACTERISTIC
/begin CHARACTERISTIC ip_load_grd_s_max_mis "Maximum LOAD_MIS gradient for fade out condition in stratified combustion mode" CURVE 0x03470 _REC_CUR_20_u2_u2 99.99694824000001 _CNV_A_R_LINEAR_____519_CM 0. 99.99694824 DISPLAY_IDENTIFIER IP_LOAD_GRD_S_MAX_MIS
 /begin AXIS_DESCR COM_AXIS load_mis _CNV_A_R_LINEAR_____519_CM 12 0. 99.99694824 AXIS_PTS_REF ldp_load_mis__load_grd_s_max /end AXIS_DESCR
/end CHARACTERISTIC
/begin AXIS_PTS ldp_map__map_dif_max_er "" 0x03a8a map _REC_AXS_20_u2 5434. _CNV_A_R_LINEAR_____49_CM 12 0. 5434. DISPLAY_IDENTIFIER LDP_MAP__MAP_DIF_MAX_ER FORMAT "%7.2" /end AXIS_PTS
/begin CHARACTERISTIC ip_map_dif_max_er "Maximum MAP gradient (per segment °CRK) for fade out condition" CURVE 0x03518 _REC_CUR_20_u2_u2 5434. _CNV_A_R_LINEAR_____49_CM 0. 5434. DISPLAY_IDENTIFIER IP_MAP_DIF_MAX_ER FORMAT "%7.2"
 /begin AXIS_DESCR COM_AXIS map _CNV_A_R_LINEAR_____49_CM 12 0. 5434. FORMAT "%7.2" AXIS_PTS_REF ldp_map__map_dif_max_er /end AXIS_DESCR
/end CHARACTERISTIC
/begin AXIS_PTS ldp_n_32__delta_iga_mis "" 0x03390 n_32 _REC_AXS_20_u1 8160. _CNV_A_R_LINEAR_____16_CM 8 0. 8160. DISPLAY_IDENTIFIER LDP_N_32__DELTA_IGA_MIS FORMAT "%4.0" /end AXIS_PTS
/begin AXIS_PTS ldp_maf__delta_iga_mis "" 0x03a78 maf _REC_AXS_20_u2 1389. _CNV_A_R_LINEAR_____106_CM 8 0. 1389. DISPLAY_IDENTIFIER LDP_MAF__DELTA_IGA_MIS FORMAT "%7.2" /end AXIS_PTS
/begin CHARACTERISTIC ip_delta_iga_mis "Spark advance angle difference at part load for misfire inhibition" MAP 0x03226 _REC_MAP_20_u1_u1_u2 47.625 _CNV_A_R_LINEAR_____82_CM 0. 47.625 DISPLAY_IDENTIFIER IP_DELTA_IGA_MIS
 /begin AXIS_DESCR COM_AXIS n_32 _CNV_A_R_LINEAR_____16_CM 8 0. 8160. FORMAT "%4.0" AXIS_PTS_REF ldp_n_32__delta_iga_mis /end AXIS_DESCR
 /begin AXIS_DESCR COM_AXIS maf _CNV_A_R_LINEAR_____106_CM 8 0. 1389. FORMAT "%7.2" AXIS_PTS_REF ldp_maf__delta_iga_mis /end AXIS_DESCR
/end CHARACTERISTIC
/begin CHARACTERISTIC ip_fac_thd_iv_s_er "Factor for adaptation of the threshold in case of active cylinder cut-off in stratified combustion mode" CURVE 0x0344c _REC_CUR_20_u2_u1 1. _CNV_A_R_LINEAR_____190_CM 0. 1. DISPLAY_IDENTIFIER IP_FAC_THD_IV_S_ER FORMAT "%7.5"
 /begin AXIS_DESCR COM_AXIS n_32 _CNV_A_R_LINEAR_____16_CM 6 0. 8160. FORMAT "%4.0" AXIS_PTS_REF ldp_n_32__fac_thd_iv_s_er /end AXIS_DESCR
/end CHARACTERISTIC
/begin AXIS_PTS ldpm_amp__amp_ofs_load_mis "" 0x03bac amp _REC_AXS_20_u2 5434. _CNV_A_R_LINEAR_____49_CM 9 0. 5434. DISPLAY_IDENTIFIER LDPM_AMP__AMP_OFS_LOAD_MIS FORMAT "%7.2" /end AXIS_PTS
/begin AXIS_PTS ldpm_tco__tco_ofs_load_mis "" 0x033f0 tco _REC_AXS_20_u1 190.5 _CNV_A_R_LINEAR_____12_CM 9 -48. 142.5 DISPLAY_IDENTIFIER LDPM_TCO__TCO_OFS_LOAD_MIS FORMAT "%5.1" /end AXIS_PTS
/begin CHARACTERISTIC lc_conf_load_mis "LOAD_MIS switch configuration versus engine combustion mode : (=0) LOAD_MIS always relative to TQI_AV (=1) LOAD_MIS relative to MAF in homogeneous combustion modes & relative to TQI_AV in stratified mode" VALUE 0x002f8 _REC_VAL_20_u1 1. _CNV_S_2_RANGE______5_CM 0. 1. DISPLAY_IDENTIFIER LC_CONF_LOAD_MIS /end CHARACTERISTIC
/begin CHARACTERISTIC c_tqi_av_max_mis "Maximum torque value to determine engine load ratio scale" VALUE 0x0037c _REC_VAL_20_u2 1023.984375 _CNV_A_R_LINEAR_____544_CM 0. 1023.984375 DISPLAY_IDENTIFIER C_TQI_AV_MAX_MIS FORMAT "%7.2" /end CHARACTERISTIC
/begin CHARACTERISTIC c_maf_max_mis "Maximum air mass value to determine engine load ratio scale" VALUE 0x0033e _REC_VAL_20_u2 1389. _CNV_A_R_LINEAR_____106_CM 0. 1389. DISPLAY_IDENTIFIER C_MAF_MAX_MIS FORMAT "%7.2" /end CHARACTERISTIC
/begin AXIS_PTS ldp_tps_av__tps_grd_max_er "" 0x03b88 tps_av _REC_AXS_20_u2 119.5 _CNV_A_R_LINEAR_____53_CM 10 0. 119.5 DISPLAY_IDENTIFIER LDP_TPS_AV__TPS_GRD_MAX_ER FORMAT "%7.3" /end AXIS_PTS
/begin AXIS_PTS ldp_tps_av__tps_grd_max_zdly_er "" 0x03b9e tps_av _REC_AXS_20_u2 11.95 _CNV_A_R_LINEAR_____53_CM 6 0. 119.5 DISPLAY_IDENTIFIER LDP_TPS_AV__TPS_GRD_MAX_ZDLY_ER FORMAT "%7.3" /end AXIS_PTS
/begin AXIS_PTS ldp_load_mis__load_grd_hom_max "" 0x039c6 load_mis _REC_AXS_20_u2 99.99694824000001 _CNV_A_R_LINEAR_____519_CM 12 0. 99.99694824 DISPLAY_IDENTIFIER LDP_LOAD_MIS__LOAD_GRD_HOM_MAX /end AXIS_PTS
/begin AXIS_PTS ldp_load_mis__load_grd_s_max "" 0x039e0 load_mis _REC_AXS_20_u2 99.99694824000001 _CNV_A_R_LINEAR_____519_CM 12 0. 99.99694824 DISPLAY_IDENTIFIER LDP_LOAD_MIS__LOAD_GRD_S_MAX /end AXIS_PTS
/begin MEASUREMENT thd_er_buf[0] "Misfire detection threshold stack for ER evaluation" SWORD _CNV_A_R_LINEAR_____380_CM 1 100. -32768. 32767. DISPLAY_IDENTIFIER THD_ER_BUF_0 ECU_ADDRESS 0x3fd0e8 BYTE_ORDER MSB_LAST FORMAT "%6.0" /end MEASUREMENT
/begin MEASUREMENT thd_er_buf[1] "Misfire detection threshold stack for ER evaluation" SWORD _CNV_A_R_LINEAR_____380_CM 1 100. -32768. 32767. DISPLAY_IDENTIFIER THD_ER_BUF_1 ECU_ADDRESS 0x3fd0ea BYTE_ORDER MSB_LAST FORMAT "%6.0" /end MEASUREMENT
/begin MEASUREMENT thd_er_buf[2] "Misfire detection threshold stack for ER evaluation" SWORD _CNV_A_R_LINEAR_____380_CM 1 100. -32768. 32767. DISPLAY_IDENTIFIER THD_ER_BUF_2 ECU_ADDRESS 0x3fd0ec BYTE_ORDER MSB_LAST FORMAT "%6.0" /end MEASUREMENT
/begin MEASUREMENT thd_er_buf[3] "Misfire detection threshold stack for ER evaluation" SWORD _CNV_A_R_LINEAR_____380_CM 1 100. -32768. 32767. DISPLAY_IDENTIFIER THD_ER_BUF_3 ECU_ADDRESS 0x3fd0ee BYTE_ORDER MSB_LAST FORMAT "%6.0" /end MEASUREMENT
/begin MEASUREMENT thd_er_buf[4] "Misfire detection threshold stack for ER evaluation" SWORD _CNV_A_R_LINEAR_____380_CM 1 100. -32768. 32767. DISPLAY_IDENTIFIER THD_ER_BUF_4 ECU_ADDRESS 0x3fd0f0 BYTE_ORDER MSB_LAST FORMAT "%6.0" /end MEASUREMENT
/begin MEASUREMENT thd_er_buf[5] "Misfire detection threshold stack for ER evaluation" SWORD _CNV_A_R_LINEAR_____380_CM 1 100. -32768. 32767. DISPLAY_IDENTIFIER THD_ER_BUF_5 ECU_ADDRESS 0x3fd0f2 BYTE_ORDER MSB_LAST FORMAT "%6.0" /end MEASUREMENT
/begin MEASUREMENT thd_er_stnd_buf[0] "Misfire detection threshold stack for ER_STND evaluation" SWORD _CNV_A_R_LINEAR_____1_CM 1 100. -32768. 32767. DISPLAY_IDENTIFIER THD_ER_STND_BUF_0 ECU_ADDRESS 0x3fd0f6 BYTE_ORDER MSB_LAST FORMAT "%6.0" /end MEASUREMENT
/begin MEASUREMENT thd_er_stnd_buf[1] "Misfire detection threshold stack for ER_STND evaluation" SWORD _CNV_A_R_LINEAR_____1_CM 1 100. -32768. 32767. DISPLAY_IDENTIFIER THD_ER_STND_BUF_1 ECU_ADDRESS 0x3fd0f8 BYTE_ORDER MSB_LAST FORMAT "%6.0" /end MEASUREMENT
/begin MEASUREMENT thd_er_stnd_buf[2] "Misfire detection threshold stack for ER_STND evaluation" SWORD _CNV_A_R_LINEAR_____1_CM 1 100. -32768. 32767. DISPLAY_IDENTIFIER THD_ER_STND_BUF_2 ECU_ADDRESS 0x3fd0fa BYTE_ORDER MSB_LAST FORMAT "%6.0" /end MEASUREMENT
/begin MEASUREMENT thd_er_stnd_buf[3] "Misfire detection threshold stack for ER_STND evaluation" SWORD _CNV_A_R_LINEAR_____1_CM 1 100. -32768. 32767. DISPLAY_IDENTIFIER THD_ER_STND_BUF_3 ECU_ADDRESS 0x3fd0fc BYTE_ORDER MSB_LAST FORMAT "%6.0" /end MEASUREMENT
/begin MEASUREMENT thd_er_stnd_buf[4] "Misfire detection threshold stack for ER_STND evaluation" SWORD _CNV_A_R_LINEAR_____1_CM 1 100. -32768. 32767. DISPLAY_IDENTIFIER THD_ER_STND_BUF_4 ECU_ADDRESS 0x3fd0fe BYTE_ORDER MSB_LAST FORMAT "%6.0" /end MEASUREMENT
/begin MEASUREMENT thd_er_stnd_buf[5] "Misfire detection threshold stack for ER_STND evaluation" SWORD _CNV_A_R_LINEAR_____1_CM 1 100. -32768. 32767. DISPLAY_IDENTIFIER THD_ER_STND_BUF_5 ECU_ADDRESS 0x3fd100 BYTE_ORDER MSB_LAST FORMAT "%6.0" /end MEASUREMENT
/begin MEASUREMENT iga_dif_mis "Ignition angle difference between 2 misfire segment tasks" SBYTE _CNV_A_R_LINEAR_____82_CM 1 100. -48. 47.625 DISPLAY_IDENTIFIER IGA_DIF_MIS ECU_ADDRESS 0x3fe03c FORMAT "%5.1" /end MEASUREMENT
/begin MEASUREMENT map_dif_mis "Manifold air pressure difference between 2 misfire segment tasks" UWORD _CNV_A_R_LINEAR_____49_CM 1 100. 0. 5434. DISPLAY_IDENTIFIER MAP_DIF_MIS ECU_ADDRESS 0x3fd0e6 BYTE_ORDER MSB_LAST FORMAT "%7.2" /end MEASUREMENT
/begin MEASUREMENT thd_er_stnd "Misfire detection threshold for current ER_STND value" SWORD _CNV_A_R_LINEAR_____1_CM 1 100. -32768. 32767. DISPLAY_IDENTIFIER THD_ER_STND ECU_ADDRESS 0x3fd0de BYTE_ORDER MSB_LAST FORMAT "%6.0" /end MEASUREMENT
/begin MEASUREMENT thd_er_stnd_x[0] "Misfire detection thresholds for cylinder ER_STND values" SWORD _CNV_A_R_LINEAR_____1_CM 1 100. -32768. 32767. DISPLAY_IDENTIFIER THD_ER_STND_0 ECU_ADDRESS 0x3fd120 BYTE_ORDER MSB_LAST FORMAT "%6.0" /end MEASUREMENT
/begin MEASUREMENT thd_er_stnd_x[1] "Misfire detection thresholds for cylinder ER_STND values" SWORD _CNV_A_R_LINEAR_____1_CM 1 100. -32768. 32767. DISPLAY_IDENTIFIER THD_ER_STND_1 ECU_ADDRESS 0x3fd122 BYTE_ORDER MSB_LAST FORMAT "%6.0" /end MEASUREMENT
/begin MEASUREMENT thd_er_stnd_x[2] "Misfire detection thresholds for cylinder ER_STND values" SWORD _CNV_A_R_LINEAR_____1_CM 1 100. -32768. 32767. DISPLAY_IDENTIFIER THD_ER_STND_2 ECU_ADDRESS 0x3fd124 BYTE_ORDER MSB_LAST FORMAT "%6.0" /end MEASUREMENT
/begin MEASUREMENT thd_er_stnd_x[3] "Misfire detection thresholds for cylinder ER_STND values" SWORD _CNV_A_R_LINEAR_____1_CM 1 100. -32768. 32767. DISPLAY_IDENTIFIER THD_ER_STND_3 ECU_ADDRESS 0x3fd126 BYTE_ORDER MSB_LAST FORMAT "%6.0" /end MEASUREMENT
/begin MEASUREMENT thd_er_stnd_x[4] "Misfire detection thresholds for cylinder ER_STND values" SWORD _CNV_A_R_LINEAR_____1_CM 1 100. -32768. 32767. DISPLAY_IDENTIFIER THD_ER_STND_4 ECU_ADDRESS 0x3fd128 BYTE_ORDER MSB_LAST FORMAT "%6.0" /end MEASUREMENT
/begin MEASUREMENT thd_er_stnd_x[5] "Misfire detection thresholds for cylinder ER_STND values" SWORD _CNV_A_R_LINEAR_____1_CM 1 100. -32768. 32767. DISPLAY_IDENTIFIER THD_ER_STND_5 ECU_ADDRESS 0x3fd12a BYTE_ORDER MSB_LAST FORMAT "%6.0" /end MEASUREMENT
/begin MEASUREMENT thd_er "Misfire detection threshold for current ER value" SWORD _CNV_A_R_LINEAR_____380_CM 1 100. -32768. 32767. DISPLAY_IDENTIFIER THD_ER ECU_ADDRESS 0x3fd0dc BYTE_ORDER MSB_LAST FORMAT "%6.0" /end MEASUREMENT
/begin MEASUREMENT thd_er_x[0] "Misfire detection thresholds for cylinder ER values" SWORD _CNV_A_R_LINEAR_____380_CM 1 100. -32768. 32767. DISPLAY_IDENTIFIER THD_ER_0 ECU_ADDRESS 0x3fd114 BYTE_ORDER MSB_LAST FORMAT "%6.0" /end MEASUREMENT
/begin MEASUREMENT thd_er_x[1] "Misfire detection thresholds for cylinder ER values" SWORD _CNV_A_R_LINEAR_____380_CM 1 100. -32768. 32767. DISPLAY_IDENTIFIER THD_ER_1 ECU_ADDRESS 0x3fd116 BYTE_ORDER MSB_LAST FORMAT "%6.0" /end MEASUREMENT
/begin MEASUREMENT thd_er_x[2] "Misfire detection thresholds for cylinder ER values" SWORD _CNV_A_R_LINEAR_____380_CM 1 100. -32768. 32767. DISPLAY_IDENTIFIER THD_ER_2 ECU_ADDRESS 0x3fd118 BYTE_ORDER MSB_LAST FORMAT "%6.0" /end MEASUREMENT
/begin MEASUREMENT thd_er_x[3] "Misfire detection thresholds for cylinder ER values" SWORD _CNV_A_R_LINEAR_____380_CM 1 100. -32768. 32767. DISPLAY_IDENTIFIER THD_ER_3 ECU_ADDRESS 0x3fd11a BYTE_ORDER MSB_LAST FORMAT "%6.0" /end MEASUREMENT
/begin MEASUREMENT thd_er_x[4] "Misfire detection thresholds for cylinder ER values" SWORD _CNV_A_R_LINEAR_____380_CM 1 100. -32768. 32767. DISPLAY_IDENTIFIER THD_ER_4 ECU_ADDRESS 0x3fd11c BYTE_ORDER MSB_LAST FORMAT "%6.0" /end MEASUREMENT
/begin MEASUREMENT thd_er_x[5] "Misfire detection thresholds for cylinder ER values" SWORD _CNV_A_R_LINEAR_____380_CM 1 100. -32768. 32767. DISPLAY_IDENTIFIER THD_ER_5 ECU_ADDRESS 0x3fd11e BYTE_ORDER MSB_LAST FORMAT "%6.0" /end MEASUREMENT
/begin AXIS_PTS ldp_n__load_min_s_mt_mis "" 0x03b26 n _REC_AXS_20_u2 8160. _CNV_A_R_LINEAR_____11_CM 12 0. 8160. DISPLAY_IDENTIFIER LDP_N__LOAD_MIN_S_MT_MIS FORMAT "%4.0" /end AXIS_PTS
/begin AXIS_PTS ldp_n__load_min_s_at_mis "" 0x03b0c n _REC_AXS_20_u2 8160. _CNV_A_R_LINEAR_____11_CM 12 0. 8160. DISPLAY_IDENTIFIER LDP_N__LOAD_MIN_S_AT_MIS FORMAT "%4.0" /end AXIS_PTS
/begin AXIS_PTS ldp_n__load_min_afs_mt_mis "" 0x03af2 n _REC_AXS_20_u2 8160. _CNV_A_R_LINEAR_____11_CM 12 0. 8160. DISPLAY_IDENTIFIER LDP_N__LOAD_MIN_AFS_MT_MIS FORMAT "%4.0" /end AXIS_PTS
/begin AXIS_PTS ldp_n__load_min_afs_at_mis "" 0x03ad8 n _REC_AXS_20_u2 8160. _CNV_A_R_LINEAR_____11_CM 12 0. 8160. DISPLAY_IDENTIFIER LDP_N__LOAD_MIN_AFS_AT_MIS FORMAT "%4.0" /end AXIS_PTS
/begin AXIS_PTS ldp_n__load_min_afl_mt_mis "" 0x03abe n _REC_AXS_20_u2 8160. _CNV_A_R_LINEAR_____11_CM 12 0. 8160. DISPLAY_IDENTIFIER LDP_N__LOAD_MIN_AFL_MT_MIS FORMAT "%4.0" /end AXIS_PTS
/begin AXIS_PTS ldp_n__load_min_afl_at_mis "" 0x03aa4 n _REC_AXS_20_u2 8160. _CNV_A_R_LINEAR_____11_CM 12 0. 8160. DISPLAY_IDENTIFIER LDP_N__LOAD_MIN_AFL_AT_MIS FORMAT "%4.0" /end AXIS_PTS
/begin AXIS_PTS ldp_load_mis__thd_mt_afl_er "" 0x03a40 load_mis _REC_AXS_20_u2 99.99694824000001 _CNV_A_R_LINEAR_____519_CM 6 0. 99.99694824 DISPLAY_IDENTIFIER LDP_LOAD_MIS__THD_MT_AFL_ER /end AXIS_PTS
/begin AXIS_PTS ldp_load_mis__thd_at_afl_er "" 0x03a16 load_mis _REC_AXS_20_u2 99.99694824000001 _CNV_A_R_LINEAR_____519_CM 6 0. 99.99694824 DISPLAY_IDENTIFIER LDP_LOAD_MIS__THD_AT_AFL_ER /end AXIS_PTS
/begin AXIS_PTS ldp_n_32__thd_mt_afl_er "" 0x033c0 n_32 _REC_AXS_20_u1 8160. _CNV_A_R_LINEAR_____16_CM 12 0. 8160. DISPLAY_IDENTIFIER LDP_N_32__THD_MT_AFL_ER FORMAT "%4.0" /end AXIS_PTS
/begin AXIS_PTS ldp_n_32__thd_at_afl_er "" 0x03399 n_32 _REC_AXS_20_u1 8160. _CNV_A_R_LINEAR_____16_CM 12 0. 8160. DISPLAY_IDENTIFIER LDP_N_32__THD_AT_AFL_ER FORMAT "%4.0" /end AXIS_PTS
/begin AXIS_PTS ldp_load_mis__thd_mt_afs_er "" 0x03a4e load_mis _REC_AXS_20_u2 99.99694824000001 _CNV_A_R_LINEAR_____519_CM 6 0. 99.99694824 DISPLAY_IDENTIFIER LDP_LOAD_MIS__THD_MT_AFS_ER /end AXIS_PTS
/begin AXIS_PTS ldp_load_mis__thd_at_afs_er "" 0x03a24 load_mis _REC_AXS_20_u2 99.99694824000001 _CNV_A_R_LINEAR_____519_CM 6 0. 99.99694824 DISPLAY_IDENTIFIER LDP_LOAD_MIS__THD_AT_AFS_ER /end AXIS_PTS
/begin AXIS_PTS ldp_load_mis__thd_mt_s_er "" 0x03a5c load_mis _REC_AXS_20_u2 99.99694824000001 _CNV_A_R_LINEAR_____519_CM 6 0. 99.99694824 DISPLAY_IDENTIFIER LDP_LOAD_MIS__THD_MT_S_ER /end AXIS_PTS
/begin AXIS_PTS ldp_load_mis__thd_at_s_er "" 0x03a32 load_mis _REC_AXS_20_u2 99.99694824000001 _CNV_A_R_LINEAR_____519_CM 6 0. 99.99694824 DISPLAY_IDENTIFIER LDP_LOAD_MIS__THD_AT_S_ER /end AXIS_PTS
/begin AXIS_PTS ldp_n_32__thd_mt_s_er "" 0x033da n_32 _REC_AXS_20_u1 8160. _CNV_A_R_LINEAR_____16_CM 12 0. 8160. DISPLAY_IDENTIFIER LDP_N_32__THD_MT_S_ER FORMAT "%4.0" /end AXIS_PTS
/begin AXIS_PTS ldp_n_32__thd_at_s_er "" 0x033b3 n_32 _REC_AXS_20_u1 8160. _CNV_A_R_LINEAR_____16_CM 12 0. 8160. DISPLAY_IDENTIFIER LDP_N_32__THD_AT_S_ER FORMAT "%4.0" /end AXIS_PTS
/begin AXIS_PTS ldp_n_32__thd_mt_afs_er "" 0x033cd n_32 _REC_AXS_20_u1 8160. _CNV_A_R_LINEAR_____16_CM 12 0. 8160. DISPLAY_IDENTIFIER LDP_N_32__THD_MT_AFS_ER FORMAT "%4.0" /end AXIS_PTS
/begin AXIS_PTS ldp_n_32__thd_at_afs_er "" 0x033a6 n_32 _REC_AXS_20_u1 8160. _CNV_A_R_LINEAR_____16_CM 12 0. 8160. DISPLAY_IDENTIFIER LDP_N_32__THD_AT_AFS_ER FORMAT "%4.0" /end AXIS_PTS
/begin CHARACTERISTIC c_t_tps_grd_dly_mis "Fade out duration when maximum throttle gradient has been detected" VALUE 0x00374 _REC_VAL_20_u2 655.35 _CNV_A_R_LINEAR_____4_CM 0. 655.35 DISPLAY_IDENTIFIER C_T_TPS_GRD_DLY_MIS FORMAT "%5.2" /end CHARACTERISTIC
/begin CHARACTERISTIC c_t_tps_grd_dly_zdly_mis "Fade out duration when maximum throttle gradient has been detected during zero delay starting phase" VALUE 0x00376 _REC_VAL_20_u2 655.35 _CNV_A_R_LINEAR_____4_CM 0. 655.35 DISPLAY_IDENTIFIER C_T_TPS_GRD_DLY_ZDLY_MIS FORMAT "%5.2" /end CHARACTERISTIC
/begin CHARACTERISTIC c_t_load_grd_hom_dly_mis "Fade out duration when maximum LOAD_GRD_MIS has been detected in homogeneous combustion  modes" VALUE 0x0036c _REC_VAL_20_u2 655.35 _CNV_A_R_LINEAR_____4_CM 0. 655.35 DISPLAY_IDENTIFIER C_T_LOAD_GRD_HOM_DLY_MIS FORMAT "%5.2" /end CHARACTERISTIC
/begin CHARACTERISTIC c_t_load_grd_s_dly_mis "Fade out duration when maximum LOAD_GRD_MIS has been detected in stratified combustion  mode" VALUE 0x0036e _REC_VAL_20_u2 655.35 _CNV_A_R_LINEAR_____4_CM 0. 655.35 DISPLAY_IDENTIFIER C_T_LOAD_GRD_S_DLY_MIS FORMAT "%5.2" /end CHARACTERISTIC
/begin CHARACTERISTIC c_t_accout_dly_er "Fade out duration when air-conditioning compressor has been switched on" VALUE 0x00364 _REC_VAL_20_u2 655.34 _CNV_A_R_LINEAR_____4_CM 1.e-002 655.35 DISPLAY_IDENTIFIER C_T_ACCOUT_DLY_ER FORMAT "%5.2" /end CHARACTERISTIC
/begin CHARACTERISTIC c_t_map_dif_dly_er "Fade out duration when manifold air pressure gradient has been detected" VALUE 0x00370 _REC_VAL_20_u2 655.35 _CNV_A_R_LINEAR_____4_CM 0. 655.35 DISPLAY_IDENTIFIER C_T_MAP_DIF_DLY_ER FORMAT "%5.2" /end CHARACTERISTIC
/begin CHARACTERISTIC c_t_amt_gs_dly_mis "Fade out duration when gearshift of AMT has been detected" VALUE 0x00366 _REC_VAL_20_u2 655.35 _CNV_A_R_LINEAR_____4_CM 0. 655.35 DISPLAY_IDENTIFIER C_T_AMT_GS_DLY_MIS FORMAT "%5.2" /end CHARACTERISTIC
/begin CHARACTERISTIC c_mask_app_inh_det_mis "MIS_DET_CDN_APP_INH carrier structure fade out configuration mask (misfire detection nominal phase)" VALUE 0x00340 _REC_VAL_20_u2 65535. _CNV_A_R_LINEAR_____1_CM 0. 65535. DISPLAY_IDENTIFIER C_MASK_APP_INH_DET_MIS FORMAT "%5.0" /end CHARACTERISTIC
/begin CHARACTERISTIC c_mask_app_inh_det_mis_is "MIS_DET_CDN_APP_INH carrier structure fade out configuration mask for IS (misfire detection nominal phase)" VALUE 0x00342 _REC_VAL_20_u2 65535. _CNV_A_R_LINEAR_____1_CM 0. 65535. DISPLAY_IDENTIFIER C_MASK_APP_INH_DET_MIS_IS FORMAT "%5.0" /end CHARACTERISTIC
/begin MEASUREMENT state_diag_mis "Misfire detection phase state machine" UBYTE _CNV_S_5_RANGE_STAT_545_CM 1 100. 0. 4. DISPLAY_IDENTIFIER STATE_DIAG_MIS ECU_ADDRESS 0x3fe05e /end MEASUREMENT
/begin MEASUREMENT mis_det_cyl_inh "Cylinder misfiring detection inhibition carrier byte when a fade out condition occurred (after masking & delay)" UWORD _CNV_A_R_LINEAR_____1_CM 1 100. 0. 65535. DISPLAY_IDENTIFIER MIS_DET_CYL_INH ECU_ADDRESS 0x3fd154 BYTE_ORDER MSB_LAST FORMAT "%5.0" /end MEASUREMENT
/begin MEASUREMENT mis_det_cdn_inh_nr "Misfiring detection fade out requests number (after masking)" UBYTE _CNV_A_R_LINEAR_____1_CM 1 100. 0. 255. DISPLAY_IDENTIFIER MIS_DET_CDN_INH_NR ECU_ADDRESS 0x3fe060 FORMAT "%3.0" /end MEASUREMENT
/begin MEASUREMENT ctr_tdc_zdly_mis "TDC decounter for disabled diagnostic" UWORD _CNV_A_R_LINEAR_____543_CM 1 100. 0. 65535. DISPLAY_IDENTIFIER CTR_TDC_ZDLY_MIS ECU_ADDRESS 0x3fd152 BYTE_ORDER MSB_LAST FORMAT "%5.0" /end MEASUREMENT
/begin MEASUREMENT ctr_t_zdly_mis "10 ms decounter for diagnostic fade out (general purpose)" UWORD _CNV_A_R_LINEAR_____4_CM 1 100. 0. 655.35 DISPLAY_IDENTIFIER CTR_T_ZDLY_MIS ECU_ADDRESS 0x3fd14c BYTE_ORDER MSB_LAST FORMAT "%5.2" /end MEASUREMENT
/begin MEASUREMENT lv_diag_mis "Nominal Misfire Monitoring Phase" UBYTE _CNV_S_2_RANGE______5_CM 1 100. 0. 1. DISPLAY_IDENTIFIER LV_DIAG_MIS ECU_ADDRESS 0x3fe062 /end MEASUREMENT
/begin CHARACTERISTIC c_mask_inh_det_zdly_mis "MIS_DET_CDN_INH carrier structure fade out configuration mask (misfire detection zero delay phase)" VALUE 0x002da _REC_VAL_20_u1 255. _CNV_A_R_LINEAR_____1_CM 0. 255. DISPLAY_IDENTIFIER C_MASK_INH_DET_ZDLY_MIS FORMAT "%3.0" /end CHARACTERISTIC
/begin CHARACTERISTIC c_n_min_zdly_mis "Minimum engine speed for zero delay misfire monitoring activation" VALUE 0x00360 _REC_VAL_20_u2 8160. _CNV_A_R_LINEAR_____11_CM 0. 8160. DISPLAY_IDENTIFIER C_N_MIN_ZDLY_MIS FORMAT "%4.0" /end CHARACTERISTIC
/begin CHARACTERISTIC c_t_zdly_mis "Duration for engine start specific misfire monitoring (5s according CARB)" VALUE 0x00378 _REC_VAL_20_u2 655.35 _CNV_A_R_LINEAR_____4_CM 0. 655.35 DISPLAY_IDENTIFIER C_T_ZDLY_MIS FORMAT "%5.2" /end CHARACTERISTIC
/begin CHARACTERISTIC c_nr_tdc_zdly_mis "Standard TDC count disablement tdc number before monitoring (engine start phase)" VALUE 0x002e9 _REC_VAL_20_u1 255. _CNV_A_R_LINEAR_____543_CM 0. 255. DISPLAY_IDENTIFIER C_NR_TDC_ZDLY_MIS FORMAT "%3.0" /end CHARACTERISTIC
/begin CHARACTERISTIC c_n_min_mis "Minimum engine speed for misfire detection" VALUE 0x0035e _REC_VAL_20_u2 8160. _CNV_A_R_LINEAR_____11_CM 0. 8160. DISPLAY_IDENTIFIER C_N_MIN_MIS FORMAT "%4.0" /end CHARACTERISTIC
/begin CHARACTERISTIC c_n_max_mis_at "Maximum engine speed for misfire detection / automatic transmission" VALUE 0x0035a _REC_VAL_20_u2 8160. _CNV_A_R_LINEAR_____11_CM 0. 8160. DISPLAY_IDENTIFIER C_N_MAX_MIS_AT FORMAT "%4.0" /end CHARACTERISTIC
/begin CHARACTERISTIC c_n_max_mis_mt "Maximum engine speed for misfire detection / manual transmission" VALUE 0x0035c _REC_VAL_20_u2 8160. _CNV_A_R_LINEAR_____11_CM 0. 8160. DISPLAY_IDENTIFIER C_N_MAX_MIS_MT FORMAT "%4.0" /end CHARACTERISTIC
/begin MEASUREMENT mis_det_cdn_inh "Misfiring detection fade out requests carrier byte (before masking)" UBYTE _CNV_A_R_LINEAR_____1_CM 1 100. 0. 255. DISPLAY_IDENTIFIER MIS_DET_CDN_INH ECU_ADDRESS 0x3fe05f FORMAT "%3.0" /end MEASUREMENT
/begin MEASUREMENT mis_det_cdn_inh.lv_inh_n_det_mis "Misfire detection fade out request flag due to engine speed condition" UBYTE _CNV_A_R_LINEAR_____1_CM 1 100. 0. 255. DISPLAY_IDENTIFIER LV_INH_N_DET_MIS ECU_ADDRESS 0x3fe05f FORMAT "%3.0" BIT_MASK 0x1 /end MEASUREMENT
/begin MEASUREMENT mis_det_cdn_inh.lv_inh_load_min_det_mis "Misfire detection fade out request flag due to zero load line condition" UBYTE _CNV_A_R_LINEAR_____1_CM 1 100. 0. 255. DISPLAY_IDENTIFIER LV_INH_LOAD_MIN_DET_MIS ECU_ADDRESS 0x3fe05f FORMAT "%3.0" BIT_MASK 0x2 /end MEASUREMENT
/begin MEASUREMENT mis_det_cdn_inh.lv_inh_tco_min_det_mis "Misfire detection fade out request flag due to minimum temperature condition" UBYTE _CNV_A_R_LINEAR_____1_CM 1 100. 0. 255. DISPLAY_IDENTIFIER LV_INH_TCO_MIN_DET_MIS ECU_ADDRESS 0x3fe05f FORMAT "%3.0" BIT_MASK 0x4 /end MEASUREMENT
/begin MEASUREMENT mis_det_cdn_inh.lv_inh_amp_min_det_mis "Misfire detection fade out request flag due to minimum atmospheric pressure condition" UBYTE _CNV_A_R_LINEAR_____1_CM 1 100. 0. 255. DISPLAY_IDENTIFIER LV_INH_AMP_MIN_DET_MIS ECU_ADDRESS 0x3fe05f FORMAT "%3.0" BIT_MASK 0x8 /end MEASUREMENT
/begin MEASUREMENT mis_det_cdn_inh.lv_inh_st_det_mis "Misfire detection fade out request flag due to engine start condition" UBYTE _CNV_A_R_LINEAR_____1_CM 1 100. 0. 255. DISPLAY_IDENTIFIER LV_INH_ST_DET_MIS ECU_ADDRESS 0x3fe05f FORMAT "%3.0" BIT_MASK 0x10 /end MEASUREMENT
/begin MEASUREMENT mis_det_cdn_inh.lv_inh_iv_off_det_mis "Misfire detection fade out request flag due to cylinder shut-off condition" UBYTE _CNV_A_R_LINEAR_____1_CM 1 100. 0. 255. DISPLAY_IDENTIFIER LV_INH_IV_OFF_DET_MIS ECU_ADDRESS 0x3fe05f FORMAT "%3.0" BIT_MASK 0x20 /end MEASUREMENT
/begin MEASUREMENT lv_req_inh_mis "Misfire detection fade out request flag" UBYTE _CNV_S_2_RANGE______5_CM 1 100. 0. 1. DISPLAY_IDENTIFIER LV_REQ_INH_MIS ECU_ADDRESS 0x3fe05d /end MEASUREMENT
/begin CHARACTERISTIC c_mask_inh_det_mis "MIS_DET_CDN_INH carrier structure fade out configuration mask (misfire detection nominal phase)" VALUE 0x002d9 _REC_VAL_20_u1 255. _CNV_A_R_LINEAR_____1_CM 0. 255. DISPLAY_IDENTIFIER C_MASK_INH_DET_MIS FORMAT "%3.0" /end CHARACTERISTIC
/begin CHARACTERISTIC c_nr_tdc_inh_mis "Fade out duration in TDC when engine speed rise up to C_N_MIN_ZDLY_MIS" VALUE 0x002e8 _REC_VAL_20_u1 255. _CNV_A_R_LINEAR_____543_CM 0. 255. DISPLAY_IDENTIFIER C_NR_TDC_INH_MIS FORMAT "%3.0" /end CHARACTERISTIC
/begin CHARACTERISTIC lc_req_zdly_mis "Activation of CARB required 0 delay monitoring" VALUE 0x00302 _REC_VAL_20_u1 1. _CNV_S_2_RANGE______5_CM 0. 1. DISPLAY_IDENTIFIER LC_REQ_ZDLY_MIS /end CHARACTERISTIC
/begin CHARACTERISTIC c_amp_min_mis "Minimum amp for misfire detection" VALUE 0x0033a _REC_VAL_20_u2 5434. _CNV_A_R_LINEAR_____49_CM 0. 5434. DISPLAY_IDENTIFIER C_AMP_MIN_MIS FORMAT "%7.2" /end CHARACTERISTIC
/begin CHARACTERISTIC c_tco_min_mis "Minimum coolant temperature for misfire detection" VALUE 0x002ec _REC_VAL_20_u1 28.575 _CNV_A_R_LINEAR_____12_CM -48. 142.5 DISPLAY_IDENTIFIER C_TCO_MIN_MIS FORMAT "%5.1" /end CHARACTERISTIC
/begin CHARACTERISTIC c_t_dly_st_mis "Fade out duration when engine operating state start LV_ST has been exited" VALUE 0x0036a _REC_VAL_20_u2 655.35 _CNV_A_R_LINEAR_____4_CM 0. 655.35 DISPLAY_IDENTIFIER C_T_DLY_ST_MIS FORMAT "%5.2" /end CHARACTERISTIC
/begin CHARACTERISTIC c_t_dly_iv_off_mis "Fade out duration after injection is back on" VALUE 0x00368 _REC_VAL_20_u2 655.35 _CNV_A_R_LINEAR_____4_CM 0. 655.35 DISPLAY_IDENTIFIER C_T_DLY_IV_OFF_MIS FORMAT "%5.2" /end CHARACTERISTIC
/begin MEASUREMENT lv_zdly_diag_mis "Zero delay misfire monitoring phase" UBYTE _CNV_S_2_RANGE______5_CM 1 100. 0. 1. DISPLAY_IDENTIFIER LV_ZDLY_DIAG_MIS ECU_ADDRESS 0x3fe063 /end MEASUREMENT
/begin MEASUREMENT lv_puc_det_mis "Fuel Cut-Off dedicated to misfire detection, including a delay time for fuel reactivation" UBYTE _CNV_S_2_RANGE______5_CM 1 100. 0. 1. DISPLAY_IDENTIFIER LV_PUC_DET_MIS ECU_ADDRESS 0x3fe064 /end MEASUREMENT
/begin CHARACTERISTIC c_load_mis_ftp "FTP cycle engine load threshold" VALUE 0x0033c _REC_VAL_20_u2 99.99694824000001 _CNV_A_R_LINEAR_____519_CM 0. 99.99694824 DISPLAY_IDENTIFIER C_LOAD_MIS_FTP /end CHARACTERISTIC
/begin CHARACTERISTIC c_n_mis_ftp "FTP cycle engine speed threshold" VALUE 0x00362 _REC_VAL_20_u2 8160. _CNV_A_R_LINEAR_____11_CM 0. 8160. DISPLAY_IDENTIFIER C_N_MIS_FTP FORMAT "%4.0" /end CHARACTERISTIC
/begin CHARACTERISTIC c_mis_a_ind_thd "Cylinder individual threshold used for cylinder shut-off during CARB A criteria window" VALUE 0x00346 _REC_VAL_20_u2 65535. _CNV_A_R_LINEAR_____1_CM 0. 65535. DISPLAY_IDENTIFIER C_MIS_A_IND_THD FORMAT "%5.0" /end CHARACTERISTIC
/begin CHARACTERISTIC c_mis_a_min_nr "Cylinder identification ratio for CARB A criteria detection" VALUE 0x002db _REC_VAL_20_u1 99.609375 _CNV_A_R_LINEAR_____10_CM 0. 99.609375 DISPLAY_IDENTIFIER C_MIS_A_MIN_NR FORMAT "%4.1" /end CHARACTERISTIC
/begin CHARACTERISTIC c_mis_sum_a_thd "Cylinder global threshold for misfire status CARB A detection" VALUE 0x0034a _REC_VAL_20_u2 65535. _CNV_A_R_LINEAR_____1_CM 0. 65535. DISPLAY_IDENTIFIER C_MIS_SUM_A_THD FORMAT "%5.0" /end CHARACTERISTIC
/begin CHARACTERISTIC c_mis_sum_a_cbk_thd "Cylinder bank threshold for misfire status CARB A detection" VALUE 0x00348 _REC_VAL_20_u2 65535. _CNV_A_R_LINEAR_____1_CM 0. 65535. DISPLAY_IDENTIFIER C_MIS_SUM_A_CBK_THD FORMAT "%5.0" /end CHARACTERISTIC
/begin CHARACTERISTIC c_mis_max_nr_off_iv "Maximum number of allowed cylinder to be shut-off after detection of the misfire status CARB A." VALUE 0x002de _REC_VAL_20_u1 4. _CNV_A_R_LINEAR_____546_CM 0. 4. DISPLAY_IDENTIFIER C_MIS_MAX_NR_OFF_IV FORMAT "%2.0" /end CHARACTERISTIC
/begin CHARACTERISTIC c_mis_min_nr_puc "Minimum number of trailing throttle fuel cut-off phases LV_PUC before cancelling cylinder(s) shut-off. " VALUE 0x002df _REC_VAL_20_u1 254. _CNV_A_R_LINEAR_____1_CM 1. 255. DISPLAY_IDENTIFIER C_MIS_MIN_NR_PUC FORMAT "%3.0" /end CHARACTERISTIC
/begin CHARACTERISTIC c_t_mis_min_puc "Minimum duration of trailing throttle fuel cut-off phase to be validated like this." VALUE 0x00372 _REC_VAL_20_u2 99.90000000000001 _CNV_A_R_LINEAR_____24_CM 0.1 100. DISPLAY_IDENTIFIER C_T_MIS_MIN_PUC FORMAT "%5.1" /end CHARACTERISTIC
/begin CHARACTERISTIC c_mis_sum_b1_thd_mt "Global threshold for CARB B1 misfire criteria detection, LV_AT = 0" VALUE 0x00350 _REC_VAL_20_u2 65535. _CNV_A_R_LINEAR_____1_CM 0. 65535. DISPLAY_IDENTIFIER C_MIS_SUM_B1_THD_MT FORMAT "%5.0" /end CHARACTERISTIC
/begin CHARACTERISTIC c_mis_sum_b1_thd_at "Global threshold for  CARB B1 misfire criteria detection, LV_AT = 1" VALUE 0x0034e _REC_VAL_20_u2 65535. _CNV_A_R_LINEAR_____1_CM 0. 65535. DISPLAY_IDENTIFIER C_MIS_SUM_B1_THD_AT FORMAT "%5.0" /end CHARACTERISTIC
/begin CHARACTERISTIC c_mis_sum_b4_thd_mt "Global threshold for CARB B4 misfire criteria detection, LV_AT = 0" VALUE 0x00356 _REC_VAL_20_u2 65535. _CNV_A_R_LINEAR_____1_CM 0. 65535. DISPLAY_IDENTIFIER C_MIS_SUM_B4_THD_MT FORMAT "%5.0" /end CHARACTERISTIC
/begin CHARACTERISTIC c_mis_sum_b4_thd_at "Global hreshold for CARB B4 misfire criteria detection, LV_AT = 1" VALUE 0x00354 _REC_VAL_20_u2 65535. _CNV_A_R_LINEAR_____1_CM 0. 65535. DISPLAY_IDENTIFIER C_MIS_SUM_B4_THD_AT FORMAT "%5.0" /end CHARACTERISTIC
/begin CHARACTERISTIC c_mis_b1_min_nr "Cylinder indentification ratio for CARB B1 criteria detection" VALUE 0x002dc _REC_VAL_20_u1 99.609375 _CNV_A_R_LINEAR_____10_CM 0. 99.609375 DISPLAY_IDENTIFIER C_MIS_B1_MIN_NR FORMAT "%4.1" /end CHARACTERISTIC
/begin CHARACTERISTIC c_mis_b4_min_nr "Cylinder indentification ratio for CARB B4 criteria detection" VALUE 0x002dd _REC_VAL_20_u1 99.609375 _CNV_A_R_LINEAR_____10_CM 0. 99.609375 DISPLAY_IDENTIFIER C_MIS_B4_MIN_NR FORMAT "%4.1" /end CHARACTERISTIC
/begin CHARACTERISTIC c_mis_sum_b1_cbk_thd "Cylinder bank threshold for CARB B1 misfire criteria detection" VALUE 0x0034c _REC_VAL_20_u2 65535. _CNV_A_R_LINEAR_____1_CM 0. 65535. DISPLAY_IDENTIFIER C_MIS_SUM_B1_CBK_THD FORMAT "%5.0" /end CHARACTERISTIC
/begin CHARACTERISTIC c_mis_sum_b4_cbk_thd "Cylinder bank threshold for CARB B4 misfire criteria detection" VALUE 0x00352 _REC_VAL_20_u2 65535. _CNV_A_R_LINEAR_____1_CM 0. 65535. DISPLAY_IDENTIFIER C_MIS_SUM_B4_CBK_THD FORMAT "%5.0" /end CHARACTERISTIC
/begin MEASUREMENT lv_ftp_mis_a "Boolean for FTP emission cycle condition status CARB A" UBYTE _CNV_S_2_RANGE______5_CM 1 100. 0. 1. DISPLAY_IDENTIFIER LV_FTP_MIS_A ECU_ADDRESS 0x3fe079 /end MEASUREMENT
/begin MEASUREMENT inh_iv_mis "Idendification of cylinders shut off by misfire Carb A" UBYTE _CNV_A_R_LINEAR_____1_CM 1 100. 0. 255. DISPLAY_IDENTIFIER INH_IV_MIS ECU_ADDRESS 0x3fe065 FORMAT "%3.0" /end MEASUREMENT
/begin MEASUREMENT mis_nr_tdc_a "TDC counter CARB A window (200 crankshaft revolutions)." UWORD _CNV_A_R_LINEAR_____1_CM 1 100. 0. 65535. DISPLAY_IDENTIFIER MIS_NR_TDC_A ECU_ADDRESS 0x3fd17c BYTE_ORDER MSB_LAST FORMAT "%5.0" /end MEASUREMENT
/begin MEASUREMENT mis_sum_a "CARB A misfire sum (global)" UWORD _CNV_A_R_LINEAR_____1_CM 1 100. 0. 65535. DISPLAY_IDENTIFIER MIS_SUM_A ECU_ADDRESS 0x3fd180 BYTE_ORDER MSB_LAST FORMAT "%5.0" /end MEASUREMENT
/begin MEASUREMENT mis_sum_a_cbk_1 "CARB A misfire sum (dedicated to cylinder bank)" UWORD _CNV_A_R_LINEAR_____1_CM 1 100. 0. 65535. DISPLAY_IDENTIFIER MIS_SUM_A_CBK_1 ECU_ADDRESS 0x3fd16e BYTE_ORDER MSB_LAST FORMAT "%5.0" /end MEASUREMENT
/begin MEASUREMENT mis_sum_a_cbk_2 "CARB A misfire sum (dedicated to cylinder bank)" UWORD _CNV_A_R_LINEAR_____1_CM 1 100. 0. 65535. DISPLAY_IDENTIFIER MIS_SUM_A_CBK_2 ECU_ADDRESS 0x3fd170 BYTE_ORDER MSB_LAST FORMAT "%5.0" /end MEASUREMENT
/begin MEASUREMENT ctr_chk_mis_a "CARB A diagnosis occurence counter" UBYTE _CNV_A_R_LINEAR_____1_CM 1 100. 0. 255. DISPLAY_IDENTIFIER CTR_CHK_MIS_A ECU_ADDRESS 0x3fe075 FORMAT "%3.0" /end MEASUREMENT
/begin MEASUREMENT ctr_ftp_cdn_mis_a "TDC counter for FTP condition detection" UWORD _CNV_A_R_LINEAR_____1_CM 1 100. 0. 65535. DISPLAY_IDENTIFIER CTR_FTP_CDN_MIS_A ECU_ADDRESS 0x3fd184 BYTE_ORDER MSB_LAST FORMAT "%5.0" /end MEASUREMENT
/begin MEASUREMENT mis_ctr_a[0] "Misfire sums (cylinder individual) after combination and weighting in CARB A window." UWORD _CNV_A_R_LINEAR_____1_CM 1 100. 0. 65535. DISPLAY_IDENTIFIER MIS_CTR_A_0 ECU_ADDRESS 0x3fd156 BYTE_ORDER MSB_LAST FORMAT "%5.0" /end MEASUREMENT
/begin MEASUREMENT mis_ctr_a[1] "Misfire sums (cylinder individual) after combination and weighting in CARB A window." UWORD _CNV_A_R_LINEAR_____1_CM 1 100. 0. 65535. DISPLAY_IDENTIFIER MIS_CTR_A_1 ECU_ADDRESS 0x3fd158 BYTE_ORDER MSB_LAST FORMAT "%5.0" /end MEASUREMENT
/begin MEASUREMENT mis_ctr_a[2] "Misfire sums (cylinder individual) after combination and weighting in CARB A window." UWORD _CNV_A_R_LINEAR_____1_CM 1 100. 0. 65535. DISPLAY_IDENTIFIER MIS_CTR_A_2 ECU_ADDRESS 0x3fd15a BYTE_ORDER MSB_LAST FORMAT "%5.0" /end MEASUREMENT
/begin MEASUREMENT mis_ctr_a[3] "Misfire sums (cylinder individual) after combination and weighting in CARB A window." UWORD _CNV_A_R_LINEAR_____1_CM 1 100. 0. 65535. DISPLAY_IDENTIFIER MIS_CTR_A_3 ECU_ADDRESS 0x3fd15c BYTE_ORDER MSB_LAST FORMAT "%5.0" /end MEASUREMENT
/begin MEASUREMENT mis_ctr_a[4] "Misfire sums (cylinder individual) after combination and weighting in CARB A window." UWORD _CNV_A_R_LINEAR_____1_CM 1 100. 0. 65535. DISPLAY_IDENTIFIER MIS_CTR_A_4 ECU_ADDRESS 0x3fd15e BYTE_ORDER MSB_LAST FORMAT "%5.0" /end MEASUREMENT
/begin MEASUREMENT mis_ctr_a[5] "Misfire sums (cylinder individual) after combination and weighting in CARB A window." UWORD _CNV_A_R_LINEAR_____1_CM 1 100. 0. 65535. DISPLAY_IDENTIFIER MIS_CTR_A_5 ECU_ADDRESS 0x3fd160 BYTE_ORDER MSB_LAST FORMAT "%5.0" /end MEASUREMENT
/begin MEASUREMENT mis_ctr_b[0] "Misfire sums (cylinder individual) after combination and weighting in CARB B window." UWORD _CNV_A_R_LINEAR_____1_CM 1 100. 0. 65535. DISPLAY_IDENTIFIER MIS_CTR_B_0 ECU_ADDRESS 0x3fd162 BYTE_ORDER MSB_LAST FORMAT "%5.0" /end MEASUREMENT
/begin MEASUREMENT mis_ctr_b[1] "Misfire sums (cylinder individual) after combination and weighting in CARB B window." UWORD _CNV_A_R_LINEAR_____1_CM 1 100. 0. 65535. DISPLAY_IDENTIFIER MIS_CTR_B_1 ECU_ADDRESS 0x3fd164 BYTE_ORDER MSB_LAST FORMAT "%5.0" /end MEASUREMENT
/begin MEASUREMENT mis_ctr_b[2] "Misfire sums (cylinder individual) after combination and weighting in CARB B window." UWORD _CNV_A_R_LINEAR_____1_CM 1 100. 0. 65535. DISPLAY_IDENTIFIER MIS_CTR_B_2 ECU_ADDRESS 0x3fd166 BYTE_ORDER MSB_LAST FORMAT "%5.0" /end MEASUREMENT
/begin MEASUREMENT mis_ctr_b[3] "Misfire sums (cylinder individual) after combination and weighting in CARB B window." UWORD _CNV_A_R_LINEAR_____1_CM 1 100. 0. 65535. DISPLAY_IDENTIFIER MIS_CTR_B_3 ECU_ADDRESS 0x3fd168 BYTE_ORDER MSB_LAST FORMAT "%5.0" /end MEASUREMENT
/begin MEASUREMENT mis_ctr_b[4] "Misfire sums (cylinder individual) after combination and weighting in CARB B window." UWORD _CNV_A_R_LINEAR_____1_CM 1 100. 0. 65535. DISPLAY_IDENTIFIER MIS_CTR_B_4 ECU_ADDRESS 0x3fd16a BYTE_ORDER MSB_LAST FORMAT "%5.0" /end MEASUREMENT
/begin MEASUREMENT mis_ctr_b[5] "Misfire sums (cylinder individual) after combination and weighting in CARB B window." UWORD _CNV_A_R_LINEAR_____1_CM 1 100. 0. 65535. DISPLAY_IDENTIFIER MIS_CTR_B_5 ECU_ADDRESS 0x3fd16c BYTE_ORDER MSB_LAST FORMAT "%5.0" /end MEASUREMENT
/begin MEASUREMENT mis_nr_tdc_b "TDC counter CARB B window (1000 crankshaft revolutions)." UWORD _CNV_A_R_LINEAR_____1_CM 1 100. 0. 65535. DISPLAY_IDENTIFIER MIS_NR_TDC_B ECU_ADDRESS 0x3fd17e BYTE_ORDER MSB_LAST FORMAT "%5.0" /end MEASUREMENT
/begin MEASUREMENT mis_sum_b "CARB B misfire sum (global)" UWORD _CNV_A_R_LINEAR_____1_CM 1 100. 0. 65535. DISPLAY_IDENTIFIER MIS_SUM_B ECU_ADDRESS 0x3fd182 BYTE_ORDER MSB_LAST FORMAT "%5.0" /end MEASUREMENT
/begin MEASUREMENT mis_sum_b_cbk_1 "CARB B misfire sum (cylinder bank dedicated)" UWORD _CNV_A_R_LINEAR_____1_CM 1 100. 0. 65535. DISPLAY_IDENTIFIER MIS_SUM_B_CBK_1 ECU_ADDRESS 0x3fd172 BYTE_ORDER MSB_LAST FORMAT "%5.0" /end MEASUREMENT
/begin MEASUREMENT mis_sum_b_cbk_2 "CARB B misfire sum (cylinder bank dedicated)" UWORD _CNV_A_R_LINEAR_____1_CM 1 100. 0. 65535. DISPLAY_IDENTIFIER MIS_SUM_B_CBK_2 ECU_ADDRESS 0x3fd174 BYTE_ORDER MSB_LAST FORMAT "%5.0" /end MEASUREMENT
/begin MEASUREMENT ctr_chk_mis_b4 "CARB B4 diagnosis occurence counter" UBYTE _CNV_A_R_LINEAR_____1_CM 1 100. 0. 255. DISPLAY_IDENTIFIER CTR_CHK_MIS_B4 ECU_ADDRESS 0x3fe076 FORMAT "%3.0" /end MEASUREMENT
/begin MEASUREMENT sym_cyl_mis_a "CARB A misfire criteria symptoms" UWORD _CNV_A_R_LINEAR_____1_CM 1 100. 0. 65535. DISPLAY_IDENTIFIER SYM_CYL_MIS_A ECU_ADDRESS 0x3fd176 BYTE_ORDER MSB_LAST FORMAT "%5.0" /end MEASUREMENT
/begin MEASUREMENT sym_cyl_mis_b1 "CARB B1 misfire criteria symptoms" UWORD _CNV_A_R_LINEAR_____1_CM 1 100. 0. 65535. DISPLAY_IDENTIFIER SYM_CYL_MIS_B1 ECU_ADDRESS 0x3fd178 BYTE_ORDER MSB_LAST FORMAT "%5.0" /end MEASUREMENT
/begin MEASUREMENT sym_cyl_mis_b4 "CARB B4 misfire criteria symptoms" UWORD _CNV_A_R_LINEAR_____1_CM 1 100. 0. 65535. DISPLAY_IDENTIFIER SYM_CYL_MIS_B4 ECU_ADDRESS 0x3fd17a BYTE_ORDER MSB_LAST FORMAT "%5.0" /end MEASUREMENT
/begin CHARACTERISTIC lc_mis_inh "Global switch to disable all misfire monitoring related modules" VALUE 0x00301 _REC_VAL_20_u1 1. _CNV_S_2_RANGE______5_CM 0. 1. DISPLAY_IDENTIFIER LC_MIS_INH /end CHARACTERISTIC
/begin CHARACTERISTIC lc_conf_rnd_det_mis_b "Configuration for random cylinder detection when no specific cylinder counter  > C_MIS_B1_MIN_NR * MIS_SUM_B or > C_MIS_B4_MIN_NR * MIS_SUM_B" VALUE 0x002fd _REC_VAL_20_u1 1. _CNV_S_2_RANGE______5_CM 0. 1. DISPLAY_IDENTIFIER LC_CONF_RND_DET_MIS_B /end CHARACTERISTIC
/begin CHARACTERISTIC lc_conf_inh_iv_mis "Cylinder switch back on configuration mode : switch back on at the end of driving cycle  (=0) or after a defined number of fuel cut-off phases (=1)" VALUE 0x002f7 _REC_VAL_20_u1 1. _CNV_S_2_RANGE______5_CM 0. 1. DISPLAY_IDENTIFIER LC_CONF_INH_IV_MIS /end CHARACTERISTIC
/begin CHARACTERISTIC lc_conf_rnd_det_mis_a "Configuration for random cylinder detection when no specific cylinder counter  > C_MIS_A_MIN_NR * MIS_SUM_A : cylinder with the highest MIS_CTR_A value is updated in SYM_CYL_MIS_A (=0) or RND bit is set to 1 in SYM_CYL_MIS_A (=1)" VALUE 0x002fc _REC_VAL_20_u1 1. _CNV_S_2_RANGE______5_CM 0. 1. DISPLAY_IDENTIFIER LC_CONF_RND_DET_MIS_A /end CHARACTERISTIC
/begin CHARACTERISTIC lc_conf_mis_a_lih "Configuration to select MIL mode in case of cylinder shut-off(=0, LV_ERR_MIS_A=0, MIL is not set by cylinder shut-off function), (=1, LV_ERR_MIS_A=1, MIL is ON until end of cylinder shut-off, see mode chosen with LC_CONF_INH_IV_MIS)" VALUE 0x002f9 _REC_VAL_20_u1 1. _CNV_S_2_RANGE______5_CM 0. 1. DISPLAY_IDENTIFIER LC_CONF_MIS_A_LIH /end CHARACTERISTIC
/begin CHARACTERISTIC c_nr_cyl_mpl_mis_a "Number of cylinder in MIS_A to set the multiple misfire CARB A status (typical: 2)" VALUE 0x002e1 _REC_VAL_20_u1 255. _CNV_A_R_LINEAR_____1_CM 0. 255. DISPLAY_IDENTIFIER C_NR_CYL_MPL_MIS_A FORMAT "%3.0" /end CHARACTERISTIC
/begin CHARACTERISTIC c_nr_cyl_mpl_mis_b "Number of cylinder in MIS_Bx to set the multiple misfire CARB Bx status (typical: 2)" VALUE 0x002e2 _REC_VAL_20_u1 255. _CNV_A_R_LINEAR_____1_CM 0. 255. DISPLAY_IDENTIFIER C_NR_CYL_MPL_MIS_B FORMAT "%3.0" /end CHARACTERISTIC
/begin CHARACTERISTIC lc_conf_mpl_det_mis_a "Configuration for multiple cylinder status set in SYM_CYL_MIS_A (multiple misfire pattern Pcode saved) (=1)" VALUE 0x002fa _REC_VAL_20_u1 1. _CNV_S_2_RANGE______5_CM 0. 1. DISPLAY_IDENTIFIER LC_CONF_MPL_DET_MIS_A /end CHARACTERISTIC
/begin CHARACTERISTIC lc_conf_mpl_det_mis_b "Configuration for multiple cylinder status set in SYM_CYL_MIS_Bx (multiple misfire pattern Pcode saved) (=1)" VALUE 0x002fb _REC_VAL_20_u1 1. _CNV_S_2_RANGE______5_CM 0. 1. DISPLAY_IDENTIFIER LC_CONF_MPL_DET_MIS_B /end CHARACTERISTIC
/begin MEASUREMENT lv_det_mis_a "CARB A misfire criteria detected in actual 200 rev. window (not debounced)" UBYTE _CNV_S_2_RANGE______5_CM 1 100. 0. 1. DISPLAY_IDENTIFIER LV_DET_MIS_A ECU_ADDRESS 0x3fe069 /end MEASUREMENT
/begin MEASUREMENT lv_inh_iv_mis_a "At least one cylinder is shut-off by a CARB A misfire criterion confirmed" UBYTE _CNV_S_2_RANGE______5_CM 1 100. 0. 1. DISPLAY_IDENTIFIER LV_INH_IV_MIS_A ECU_ADDRESS 0x3fe06e /end MEASUREMENT
/begin MEASUREMENT ctr_det_mis_a "CARB A misfire criteria detected counter" UBYTE _CNV_A_R_LINEAR_____1_CM 1 100. 0. 255. DISPLAY_IDENTIFIER CTR_DET_MIS_A ECU_ADDRESS 0x3fe066 FORMAT "%3.0" /end MEASUREMENT
/begin CHARACTERISTIC c_nr_det_max_mis_a "Maximum value of CTR_ERR_DET_MIS_A for misfire CARB A status detection (typical: 3)" VALUE 0x002e3 _REC_VAL_20_u1 255. _CNV_A_R_LINEAR_____1_CM 0. 255. DISPLAY_IDENTIFIER C_NR_DET_MAX_MIS_A FORMAT "%3.0" /end CHARACTERISTIC
/begin MEASUREMENT lv_end_win_mis_a "CARB A misfire criteria diagnosis end for similar condition window" UBYTE _CNV_S_2_RANGE______5_CM 1 100. 0. 1. DISPLAY_IDENTIFIER LV_END_WIN_MIS_A ECU_ADDRESS 0x3fe06f /end MEASUREMENT
/begin CHARACTERISTIC c_ratio_ftp_cdn_ind_mis_a "Coverting ratio to detect FTP conditions for short term protection" VALUE 0x002ea _REC_VAL_20_u1 99.609375 _CNV_A_R_LINEAR_____10_CM 0. 99.609375 DISPLAY_IDENTIFIER C_RATIO_FTP_CDN_IND_MIS_A FORMAT "%5.1" /end CHARACTERISTIC
/begin CHARACTERISTIC c_ratio_ftp_cdn_mis_a "Coverting ratio to detect FTP conditions for long term protection" VALUE 0x002eb _REC_VAL_20_u1 99.609375 _CNV_A_R_LINEAR_____10_CM 0. 99.609375 DISPLAY_IDENTIFIER C_RATIO_FTP_CDN_MIS_A FORMAT "%5.1" /end CHARACTERISTIC
/begin MEASUREMENT lv_det_mis_b4 "CARB B4 misfire criteria detected in actual 1000 rev. window, (not debounced)" UBYTE _CNV_S_2_RANGE______5_CM 1 100. 0. 1. DISPLAY_IDENTIFIER LV_DET_MIS_B4 ECU_ADDRESS 0x3fe06d /end MEASUREMENT
/begin MEASUREMENT lv_mis_state_b1 "CARB B1 misfire criterion confirmed" UBYTE _CNV_S_2_RANGE______5_CM 1 100. 0. 1. DISPLAY_IDENTIFIER LV_MIS_STATE_B1 ECU_ADDRESS 0x3fe06b /end MEASUREMENT
/begin MEASUREMENT lv_mis_state_b4 "CARB B4 misfire criterion confirmed (debounced)" UBYTE _CNV_S_2_RANGE______5_CM 1 100. 0. 1. DISPLAY_IDENTIFIER LV_MIS_STATE_B4 ECU_ADDRESS 0x3fe06c /end MEASUREMENT
/begin MEASUREMENT ctr_det_mis_b4 "CARB B4 misfire criteria detected counter" UBYTE _CNV_A_R_LINEAR_____1_CM 1 100. 0. 255. DISPLAY_IDENTIFIER CTR_DET_MIS_B4 ECU_ADDRESS 0x3fe067 FORMAT "%3.0" /end MEASUREMENT
/begin MEASUREMENT lv_end_win_mis_b1 "End of CARB B1 window for similar condition" UBYTE _CNV_S_2_RANGE______5_CM 1 100. 0. 1. DISPLAY_IDENTIFIER LV_END_WIN_MIS_B1 ECU_ADDRESS 0x3fe071 /end MEASUREMENT
/begin MEASUREMENT lv_end_win_mis_b4 "End of CARB B4 window for similar condition" UBYTE _CNV_S_2_RANGE______5_CM 1 100. 0. 1. DISPLAY_IDENTIFIER LV_END_WIN_MIS_B4 ECU_ADDRESS 0x3fe073 /end MEASUREMENT
/begin MEASUREMENT lv_end_mis_b1 "CARB B1 misfire criteria determination end" UBYTE _CNV_S_2_RANGE______5_CM 1 100. 0. 1. DISPLAY_IDENTIFIER LV_END_MIS_B1 ECU_ADDRESS 0x3fe072 /end MEASUREMENT
/begin MEASUREMENT lv_end_mis_a "CARB A misfire criteria determination end" UBYTE _CNV_S_2_RANGE______5_CM 1 100. 0. 1. DISPLAY_IDENTIFIER LV_END_MIS_A ECU_ADDRESS 0x3fe070 /end MEASUREMENT
/begin MEASUREMENT lv_end_mis_b4 "CARB B4 misfire criteria determination end" UBYTE _CNV_S_2_RANGE______5_CM 1 100. 0. 1. DISPLAY_IDENTIFIER LV_END_MIS_B4 ECU_ADDRESS 0x3fe074 /end MEASUREMENT
/begin CHARACTERISTIC c_nr_det_max_mis_b4 "Maximum value of CTR_ERR_DET_MIS_B4 for misfire CARB B4 status detection (typical: 4)" VALUE 0x002e4 _REC_VAL_20_u1 255. _CNV_A_R_LINEAR_____1_CM 0. 255. DISPLAY_IDENTIFIER C_NR_DET_MAX_MIS_B4 FORMAT "%3.0" /end CHARACTERISTIC
/begin MEASUREMENT lv_mis_state_a "Project specific name for misfire carb A detected, debounced" UBYTE _CNV_S_2_RANGE______5_CM 1 100. 0. 1. DISPLAY_IDENTIFIER LV_MIS_STATE_A ECU_ADDRESS 0x3fe06a /end MEASUREMENT
/begin MEASUREMENT sum_fac_diag_mis "Sum of the weighting factor from diagnosis combinations for final misfire decision" UWORD _CNV_A_R_LINEAR_____547_CM 1 100. 0. 6. DISPLAY_IDENTIFIER SUM_FAC_DIAG_MIS ECU_ADDRESS 0x3fd13a BYTE_ORDER MSB_LAST FORMAT "%6.4" /end MEASUREMENT
/begin MEASUREMENT fac_igc_diag_mis "Reliability weighting factor for ignition diagnosis (ignition failure detected)" UBYTE _CNV_A_R_LINEAR_____548_CM 1 100. 0. 2. DISPLAY_IDENTIFIER FAC_IGC_DIAG_MIS ECU_ADDRESS 0x3fe05a FORMAT "%6.4" /end MEASUREMENT
/begin MEASUREMENT fac_er_diag_mis "Reliability weighting factor for detection based on misfire detection index (ER)" UBYTE _CNV_A_R_LINEAR_____548_CM 1 100. 0. 2. DISPLAY_IDENTIFIER FAC_ER_DIAG_MIS ECU_ADDRESS 0x3fe059 FORMAT "%6.4" /end MEASUREMENT
/begin MEASUREMENT fac_iv_diag_mis "Reliability weighting factor for injection valve (injection valve failure detected)" UBYTE _CNV_A_R_LINEAR_____548_CM 1 100. 0. 2. DISPLAY_IDENTIFIER FAC_IV_DIAG_MIS ECU_ADDRESS 0x3fe05b FORMAT "%6.4" /end MEASUREMENT
/begin MEASUREMENT lv_ftl_l_diag_mis "Specific request to allow FTL_L symptom storing (misfire detection with low fuel tank level)" UBYTE _CNV_S_2_RANGE______5_CM 1 100. 0. 1. DISPLAY_IDENTIFIER LV_FTL_L_DIAG_MIS ECU_ADDRESS 0x3fe04a /end MEASUREMENT
/begin MEASUREMENT lv_req_app_ctr_mis_a "Specific request to allow out of FTP counting mode even if we are within FTP area" UBYTE _CNV_S_2_RANGE______5_CM 1 100. 0. 1. DISPLAY_IDENTIFIER LV_REQ_APP_CTR_MIS_A ECU_ADDRESS 0x3fe04b /end MEASUREMENT
/begin AXIS_PTS ldp_n_32__fac_er_afl_diag_mis "" 0x00308 n_32 _REC_AXS_20_u1 8160. _CNV_A_R_LINEAR_____16_CM 6 0. 8160. DISPLAY_IDENTIFIER LDP_N_32__FAC_ER_AFL_DIAG_MIS FORMAT "%4.0" /end AXIS_PTS
/begin AXIS_PTS ldp_n_32__fac_er_s_diag_mis "" 0x00316 n_32 _REC_AXS_20_u1 8160. _CNV_A_R_LINEAR_____16_CM 6 0. 8160. DISPLAY_IDENTIFIER LDP_N_32__FAC_ER_S_DIAG_MIS FORMAT "%4.0" /end AXIS_PTS
/begin AXIS_PTS ldp_n_32__fac_igc_diag_mis "" 0x0031d n_32 _REC_AXS_20_u1 8160. _CNV_A_R_LINEAR_____16_CM 6 0. 8160. DISPLAY_IDENTIFIER LDP_N_32__FAC_IGC_DIAG_MIS FORMAT "%4.0" /end AXIS_PTS
/begin AXIS_PTS ldp_n_32__fac_er_afs_diag_mis "" 0x0030f n_32 _REC_AXS_20_u1 8160. _CNV_A_R_LINEAR_____16_CM 6 0. 8160. DISPLAY_IDENTIFIER LDP_N_32__FAC_ER_AFS_DIAG_MIS FORMAT "%4.0" /end AXIS_PTS
/begin AXIS_PTS ldp_n_32__fac_iv_diag_mis "" 0x00324 n_32 _REC_AXS_20_u1 8160. _CNV_A_R_LINEAR_____16_CM 6 0. 8160. DISPLAY_IDENTIFIER LDP_N_32__FAC_IV_DIAG_MIS FORMAT "%4.0" /end AXIS_PTS
/begin AXIS_PTS ldp_load_mis__fac_er_s_diag_mis "" 0x0399c load_mis _REC_AXS_20_u2 99.99694824000001 _CNV_A_R_LINEAR_____519_CM 6 0. 99.99694824 DISPLAY_IDENTIFIER LDP_LOAD_MIS__FAC_ER_S_DIAG_MIS /end AXIS_PTS
/begin AXIS_PTS ldp_load_mis__fac_igc_diag_mis "" 0x039aa load_mis _REC_AXS_20_u2 99.99694824000001 _CNV_A_R_LINEAR_____519_CM 6 0. 99.99694824 DISPLAY_IDENTIFIER LDP_LOAD_MIS__FAC_IGC_DIAG_MIS /end AXIS_PTS
/begin CHARACTERISTIC ip_fac_er_afl_diag_mis "Weighting factor for irregular engine operation (engine speed analysis)" MAP 0x03266 _REC_MAP_20_u1_u1_u2 2. _CNV_A_R_LINEAR_____548_CM 0. 2. DISPLAY_IDENTIFIER IP_FAC_ER_AFL_DIAG_MIS FORMAT "%6.4"
 /begin AXIS_DESCR COM_AXIS n_32 _CNV_A_R_LINEAR_____16_CM 6 0. 8160. FORMAT "%4.0" AXIS_PTS_REF ldp_n_32__fac_er_afl_diag_mis /end AXIS_DESCR
 /begin AXIS_DESCR COM_AXIS load_mis _CNV_A_R_LINEAR_____519_CM 6 0. 99.99694824 AXIS_PTS_REF ldp_load_mis__fac_er_afl_diag /end AXIS_DESCR
/end CHARACTERISTIC
/begin CHARACTERISTIC ip_fac_er_s_diag_mis "Weighting factor for irregular engine operation (engine speed analysis)" MAP 0x032ae _REC_MAP_20_u1_u1_u2 2. _CNV_A_R_LINEAR_____548_CM 0. 2. DISPLAY_IDENTIFIER IP_FAC_ER_S_DIAG_MIS FORMAT "%6.4"
 /begin AXIS_DESCR COM_AXIS n_32 _CNV_A_R_LINEAR_____16_CM 6 0. 8160. FORMAT "%4.0" AXIS_PTS_REF ldp_n_32__fac_er_s_diag_mis /end AXIS_DESCR
 /begin AXIS_DESCR COM_AXIS load_mis _CNV_A_R_LINEAR_____519_CM 6 0. 99.99694824 AXIS_PTS_REF ldp_load_mis__fac_er_s_diag_mis /end AXIS_DESCR
/end CHARACTERISTIC
/begin CHARACTERISTIC ip_fac_er_afs_diag_mis "Weighting factor for irregular engine operation (engine speed analysis)" MAP 0x0328a _REC_MAP_20_u1_u1_u2 2. _CNV_A_R_LINEAR_____548_CM 0. 2. DISPLAY_IDENTIFIER IP_FAC_ER_AFS_DIAG_MIS FORMAT "%6.4"
 /begin AXIS_DESCR COM_AXIS n_32 _CNV_A_R_LINEAR_____16_CM 6 0. 8160. FORMAT "%4.0" AXIS_PTS_REF ldp_n_32__fac_er_afs_diag_mis /end AXIS_DESCR
 /begin AXIS_DESCR COM_AXIS load_mis _CNV_A_R_LINEAR_____519_CM 6 0. 99.99694824 AXIS_PTS_REF ldp_load_mis__fac_er_afs_diag /end AXIS_DESCR
/end CHARACTERISTIC
/begin CHARACTERISTIC ip_fac_igc_diag_mis "Weighting factor for ignition diagnosis (ignition failure detected)" MAP 0x032d2 _REC_MAP_20_u1_u1_u2 2. _CNV_A_R_LINEAR_____548_CM 0. 2. DISPLAY_IDENTIFIER IP_FAC_IGC_DIAG_MIS FORMAT "%6.4"
 /begin AXIS_DESCR COM_AXIS n_32 _CNV_A_R_LINEAR_____16_CM 6 0. 8160. FORMAT "%4.0" AXIS_PTS_REF ldp_n_32__fac_igc_diag_mis /end AXIS_DESCR
 /begin AXIS_DESCR COM_AXIS load_mis _CNV_A_R_LINEAR_____519_CM 6 0. 99.99694824 AXIS_PTS_REF ldp_load_mis__fac_igc_diag_mis /end AXIS_DESCR
/end CHARACTERISTIC
/begin CHARACTERISTIC ip_fac_iv_diag_mis "Weighting factor for injection valve diagnosis (injection valve failure detected)" MAP 0x032f6 _REC_MAP_20_u1_u1_u2 2. _CNV_A_R_LINEAR_____548_CM 0. 2. DISPLAY_IDENTIFIER IP_FAC_IV_DIAG_MIS FORMAT "%6.4"
 /begin AXIS_DESCR COM_AXIS n_32 _CNV_A_R_LINEAR_____16_CM 6 0. 8160. FORMAT "%4.0" AXIS_PTS_REF ldp_n_32__fac_iv_diag_mis /end AXIS_DESCR
 /begin AXIS_DESCR COM_AXIS load_mis _CNV_A_R_LINEAR_____519_CM 6 0. 99.99694824 AXIS_PTS_REF ldp_load_mis__fac_iv_diag_mis /end AXIS_DESCR
/end CHARACTERISTIC
/begin AXIS_PTS ldp_load_mis__fac_iv_diag_mis "" 0x039b8 load_mis _REC_AXS_20_u2 99.99694824000001 _CNV_A_R_LINEAR_____519_CM 6 0. 99.99694824 DISPLAY_IDENTIFIER LDP_LOAD_MIS__FAC_IV_DIAG_MIS /end AXIS_PTS
/begin AXIS_PTS ldp_load_mis_2__mis_a_fac_afl "" 0x03956 load_mis_2 _REC_AXS_20_u2 99.99694824000001 _CNV_A_R_LINEAR_____519_CM 6 0. 99.99694824 DISPLAY_IDENTIFIER LDP_LOAD_MIS_2__MIS_A_FAC_AFL /end AXIS_PTS
/begin AXIS_PTS ldp_load_mis_2__mis_a_fac_afs "" 0x03964 load_mis_2 _REC_AXS_20_u2 99.99694824000001 _CNV_A_R_LINEAR_____519_CM 6 0. 99.99694824 DISPLAY_IDENTIFIER LDP_LOAD_MIS_2__MIS_A_FAC_AFS /end AXIS_PTS
/begin AXIS_PTS ldp_load_mis_2__mis_a_fac_s "" 0x03972 load_mis_2 _REC_AXS_20_u2 99.99694824000001 _CNV_A_R_LINEAR_____519_CM 6 0. 99.99694824 DISPLAY_IDENTIFIER LDP_LOAD_MIS_2__MIS_A_FAC_S /end AXIS_PTS
/begin CHARACTERISTIC c_mis_nr_off_iv_igcfb "Threshold for number of cylinders shut off due to misfire" VALUE 0x002e0 _REC_VAL_20_u1 6. _CNV_A_R_LINEAR_____1_CM 0. 6. DISPLAY_IDENTIFIER C_MIS_NR_OFF_IV_IGCFB FORMAT "%1.0" /end CHARACTERISTIC
/begin CHARACTERISTIC c_teg_cat_up_mis_a_max "TEG Threshold for misfire A counter management" VALUE 0x0037a _REC_VAL_20_u2 2047. _CNV_A_R_LINEAR_____7_CM 0. 2047. DISPLAY_IDENTIFIER C_TEG_CAT_UP_MIS_A_MAX FORMAT "%7.2" /end CHARACTERISTIC
/begin CHARACTERISTIC lc_ftl_l_diag_mis "Calibration to enable Low Fuel tank level symptom storing in misfire diagnosis symptom carriers" VALUE 0x00300 _REC_VAL_20_u1 1. _CNV_S_2_RANGE______5_CM 0. 1. DISPLAY_IDENTIFIER LC_FTL_L_DIAG_MIS /end CHARACTERISTIC
/begin CHARACTERISTIC lc_ctr_conf_diag_mis "Diagnosis TDC counting mode : counting all TDCs (=0) or only diagnosed TDC's (=1)" VALUE 0x002fe _REC_VAL_20_u1 1. _CNV_S_2_RANGE______5_CM 0. 1. DISPLAY_IDENTIFIER LC_CTR_CONF_DIAG_MIS /end CHARACTERISTIC
/begin CHARACTERISTIC ip_mis_a_fac_afl "Catalyst damage weighting factor used for MIS_A counters increment (AFL combustion mode)" MAP 0x0331a _REC_MAP_20_u1_u2_u2 100. _CNV_A_R_LINEAR_____1_CM 0. 100. DISPLAY_IDENTIFIER IP_MIS_A_FAC_AFL FORMAT "%3.0"
 /begin AXIS_DESCR COM_AXIS n _CNV_A_R_LINEAR_____11_CM 6 0. 8160. FORMAT "%4.0" AXIS_PTS_REF ldp_n__mis_a_fac_afl /end AXIS_DESCR
 /begin AXIS_DESCR COM_AXIS load_mis_2 _CNV_A_R_LINEAR_____519_CM 6 0. 99.99694824 AXIS_PTS_REF ldp_load_mis_2__mis_a_fac_afl /end AXIS_DESCR
/end CHARACTERISTIC
/begin CHARACTERISTIC ip_mis_a_fac_afs "Catalyst damage weighting factor used for MIS_A counters increment (AFS combustion mode)" MAP 0x0333e _REC_MAP_20_u1_u2_u2 100. _CNV_A_R_LINEAR_____1_CM 0. 100. DISPLAY_IDENTIFIER IP_MIS_A_FAC_AFS FORMAT "%3.0"
 /begin AXIS_DESCR COM_AXIS n _CNV_A_R_LINEAR_____11_CM 6 0. 8160. FORMAT "%4.0" AXIS_PTS_REF ldp_n__mis_a_fac_afs /end AXIS_DESCR
 /begin AXIS_DESCR COM_AXIS load_mis_2 _CNV_A_R_LINEAR_____519_CM 6 0. 99.99694824 AXIS_PTS_REF ldp_load_mis_2__mis_a_fac_afs /end AXIS_DESCR
/end CHARACTERISTIC
/begin CHARACTERISTIC ip_mis_a_fac_s "Catalyst damage weighting factor used for MIS_A counters increment (Stratified combustion mode)" MAP 0x03362 _REC_MAP_20_u1_u2_u2 100. _CNV_A_R_LINEAR_____1_CM 0. 100. DISPLAY_IDENTIFIER IP_MIS_A_FAC_S FORMAT "%3.0"
 /begin AXIS_DESCR COM_AXIS n _CNV_A_R_LINEAR_____11_CM 6 0. 8160. FORMAT "%4.0" AXIS_PTS_REF ldp_n__mis_a_fac_s /end AXIS_DESCR
 /begin AXIS_DESCR COM_AXIS load_mis_2 _CNV_A_R_LINEAR_____519_CM 6 0. 99.99694824 AXIS_PTS_REF ldp_load_mis_2__mis_a_fac_s /end AXIS_DESCR
/end CHARACTERISTIC
/begin AXIS_PTS ldp_n__mis_a_fac_afl "" 0x03b40 n _REC_AXS_20_u2 8160. _CNV_A_R_LINEAR_____11_CM 6 0. 8160. DISPLAY_IDENTIFIER LDP_N__MIS_A_FAC_AFL FORMAT "%4.0" /end AXIS_PTS
/begin AXIS_PTS ldp_n__mis_a_fac_afs "" 0x03b4e n _REC_AXS_20_u2 8160. _CNV_A_R_LINEAR_____11_CM 6 0. 8160. DISPLAY_IDENTIFIER LDP_N__MIS_A_FAC_AFS FORMAT "%4.0" /end AXIS_PTS
/begin AXIS_PTS ldp_n__mis_a_fac_s "" 0x03b5c n _REC_AXS_20_u2 8160. _CNV_A_R_LINEAR_____11_CM 6 0. 8160. DISPLAY_IDENTIFIER LDP_N__MIS_A_FAC_S FORMAT "%4.0" /end AXIS_PTS
/begin AXIS_PTS ldp_load_mis__fac_er_afs_diag "" 0x0398e load_mis _REC_AXS_20_u2 99.99694824000001 _CNV_A_R_LINEAR_____519_CM 6 0. 99.99694824 DISPLAY_IDENTIFIER LDP_LOAD_MIS__FAC_ER_AFS_DIAG /end AXIS_PTS
/begin AXIS_PTS ldp_load_mis__fac_er_afl_diag "" 0x03980 load_mis _REC_AXS_20_u2 99.99694824000001 _CNV_A_R_LINEAR_____519_CM 6 0. 99.99694824 DISPLAY_IDENTIFIER LDP_LOAD_MIS__FAC_ER_AFL_DIAG /end AXIS_PTS
/begin MEASUREMENT mis_a_fac "Catalyst damage weighting factor to increment cylinder specific counters when misfire is detected" UBYTE _CNV_A_R_LINEAR_____1_CM 1 100. 0. 100. DISPLAY_IDENTIFIER MIS_A_FAC ECU_ADDRESS 0x3fe044 FORMAT "%3.0" /end MEASUREMENT
/begin MEASUREMENT mis_a_fac_buf[0] "Catalyst damage weighting factor buffer" UBYTE _CNV_A_R_LINEAR_____1_CM 1 100. 0. 100. DISPLAY_IDENTIFIER MIS_A_FAC_BUF_0 ECU_ADDRESS 0x3fe052 FORMAT "%3.0" /end MEASUREMENT
/begin MEASUREMENT mis_a_fac_buf[1] "Catalyst damage weighting factor buffer" UBYTE _CNV_A_R_LINEAR_____1_CM 1 100. 0. 100. DISPLAY_IDENTIFIER MIS_A_FAC_BUF_1 ECU_ADDRESS 0x3fe053 FORMAT "%3.0" /end MEASUREMENT
/begin MEASUREMENT mis_a_fac_buf[2] "Catalyst damage weighting factor buffer" UBYTE _CNV_A_R_LINEAR_____1_CM 1 100. 0. 100. DISPLAY_IDENTIFIER MIS_A_FAC_BUF_2 ECU_ADDRESS 0x3fe054 FORMAT "%3.0" /end MEASUREMENT
/begin MEASUREMENT mis_a_fac_buf[3] "Catalyst damage weighting factor buffer" UBYTE _CNV_A_R_LINEAR_____1_CM 1 100. 0. 100. DISPLAY_IDENTIFIER MIS_A_FAC_BUF_3 ECU_ADDRESS 0x3fe055 FORMAT "%3.0" /end MEASUREMENT
/begin MEASUREMENT mis_a_fac_buf[4] "Catalyst damage weighting factor buffer" UBYTE _CNV_A_R_LINEAR_____1_CM 1 100. 0. 100. DISPLAY_IDENTIFIER MIS_A_FAC_BUF_4 ECU_ADDRESS 0x3fe056 FORMAT "%3.0" /end MEASUREMENT
/begin MEASUREMENT mis_a_fac_buf[5] "Catalyst damage weighting factor buffer" UBYTE _CNV_A_R_LINEAR_____1_CM 1 100. 0. 100. DISPLAY_IDENTIFIER MIS_A_FAC_BUF_5 ECU_ADDRESS 0x3fe057 FORMAT "%3.0" /end MEASUREMENT
/begin MEASUREMENT lv_cdn_mis_b1 "CARB B1  misfire criterion monitoring condition" UBYTE _CNV_S_2_RANGE______5_CM 1 100. 0. 1. DISPLAY_IDENTIFIER LV_CDN_MIS_B1 ECU_ADDRESS 0x3fe046 /end MEASUREMENT
/begin MEASUREMENT lv_cdn_mis_a "CARB A misfire criterion monitoring condition" UBYTE _CNV_S_2_RANGE______5_CM 1 100. 0. 1. DISPLAY_IDENTIFIER LV_CDN_MIS_A ECU_ADDRESS 0x3fe045 /end MEASUREMENT
/begin MEASUREMENT lv_cdn_mis_b4 "CARB B4 misfire criterion monitoring condition" UBYTE _CNV_S_2_RANGE______5_CM 1 100. 0. 1. DISPLAY_IDENTIFIER LV_CDN_MIS_B4 ECU_ADDRESS 0x3fe047 /end MEASUREMENT
/begin MEASUREMENT lv_mis_state_b "Project specific name for misfire carb B detected, debounced" UBYTE _CNV_S_2_RANGE______5_CM 1 100. 0. 1. DISPLAY_IDENTIFIER LV_MIS_STATE_B ECU_ADDRESS 0x3fe048 /end MEASUREMENT
/begin MEASUREMENT lv_det_cfm_mis "Flag for individual confirmed misfire detection after crossed diagnosis" UBYTE _CNV_S_2_RANGE______5_CM 1 100. 0. 1. DISPLAY_IDENTIFIER LV_DET_CFM_MIS ECU_ADDRESS 0x3fe049 /end MEASUREMENT
/begin MEASUREMENT lv_err_mis_mpl "Present error flag multiple cylinder misfire" UBYTE _CNV_S_2_RANGE______2_R_CM 1 100. 0. 255. DISPLAY_IDENTIFIER LV_ERR_MIS_MPL ECU_ADDRESS 0x3fb9f8 /end MEASUREMENT
/begin MEASUREMENT lv_err_mis_1 "Present error flag specific cylinder misfire 1" UBYTE _CNV_S_2_RANGE______2_R_CM 1 100. 0. 255. DISPLAY_IDENTIFIER LV_ERR_MIS_1 ECU_ADDRESS 0x3fb9e0 /end MEASUREMENT
/begin MEASUREMENT lv_err_mis_2 "Present error flag specific cylinder misfire 2" UBYTE _CNV_S_2_RANGE______2_R_CM 1 100. 0. 255. DISPLAY_IDENTIFIER LV_ERR_MIS_2 ECU_ADDRESS 0x3fb9e4 /end MEASUREMENT
/begin MEASUREMENT lv_err_mis_3 "Present error flag specific cylinder misfire 3" UBYTE _CNV_S_2_RANGE______2_R_CM 1 100. 0. 255. DISPLAY_IDENTIFIER LV_ERR_MIS_3 ECU_ADDRESS 0x3fb9e8 /end MEASUREMENT
/begin MEASUREMENT lv_err_mis_4 "Present error flag specific cylinder misfire 4" UBYTE _CNV_S_2_RANGE______2_R_CM 1 100. 0. 255. DISPLAY_IDENTIFIER LV_ERR_MIS_4 ECU_ADDRESS 0x3fb9ec /end MEASUREMENT
/begin MEASUREMENT lv_err_mis_5 "Present error flag specific cylinder misfire 5" UBYTE _CNV_S_2_RANGE______2_R_CM 1 100. 0. 255. DISPLAY_IDENTIFIER LV_ERR_MIS_5 ECU_ADDRESS 0x3fb9f0 /end MEASUREMENT
/begin MEASUREMENT lv_err_mis_0 "Present error flag specific cylinder misfire 0" UBYTE _CNV_S_2_RANGE______2_R_CM 1 100. 0. 255. DISPLAY_IDENTIFIER LV_ERR_MIS_0 ECU_ADDRESS 0x3fb9dc /end MEASUREMENT
/begin MEASUREMENT load_max_scdn_mis "Maximal load of similar condition window for LV_ERR_MIS_x" UBYTE _CNV_A_R_LINEAR_____10_CM 1 100. 0. 99.609375 DISPLAY_IDENTIFIER LOAD_MAX_SCDN_MIS ECU_ADDRESS 0x3fe050 /end MEASUREMENT
/begin MEASUREMENT load_min_scdn_mis "Minimal load of similar condition window for LV_ERR_MIS_x" UBYTE _CNV_A_R_LINEAR_____10_CM 1 100. 0. 99.609375 DISPLAY_IDENTIFIER LOAD_MIN_SCDN_MIS ECU_ADDRESS 0x3fe051 /end MEASUREMENT
/begin MEASUREMENT n_min_scdn_mis "Maximal engine speed of similar condition window for LV_ERR_MIS_x" UWORD _CNV_A_R_LINEAR_____11_CM 1 100. 0. 8160. DISPLAY_IDENTIFIER N_MIN_SCDN_MIS ECU_ADDRESS 0x3fe04e BYTE_ORDER MSB_LAST FORMAT "%4.0" /end MEASUREMENT
/begin MEASUREMENT n_max_scdn_mis "Minimal engine speed of similar condition window for LV_ERR_MIS_x" UWORD _CNV_A_R_LINEAR_____11_CM 1 100. 0. 8160. DISPLAY_IDENTIFIER N_MAX_SCDN_MIS ECU_ADDRESS 0x3fe04c BYTE_ORDER MSB_LAST FORMAT "%4.0" /end MEASUREMENT
/begin MEASUREMENT lv_err_conv_mon "Logical variable for ADC error" UBYTE _CNV_S_2_RANGE______5_CM 1 100. 0. 1. DISPLAY_IDENTIFIER LV_ERR_CONV_MON ECU_ADDRESS 0x3fe5e9 BIT_MASK 0x1 /end MEASUREMENT
/begin MEASUREMENT lv_err_pvs_mon "Logical variable for different PVS diagnosis between L1 and L2" UBYTE _CNV_S_2_RANGE______5_CM 1 100. 0. 1. DISPLAY_IDENTIFIER LV_ERR_PVS_MON ECU_ADDRESS 0x3fe68a BIT_MASK 0x1 /end MEASUREMENT
/begin MEASUREMENT lv_err_tqi_n_max_nvmy_mon "Error location for \"monitoring of engine speed limitation\" stored in non volatile memory" UBYTE _CNV_S_2_RANGE______2_R_CM 1 100. 0. 255. DISPLAY_IDENTIFIER LV_ERR_TQI_N_MAX_NVMY_MON ECU_ADDRESS 0x3fba24 BIT_MASK 0x1 /end MEASUREMENT
/begin MEASUREMENT val_mon_err_ram "Logical variable for fault of RAM in process monitoring present" UBYTE _CNV_S_2_RANGE______5_CM 1 100. 0. 1. DISPLAY_IDENTIFIER VAL_MON_ERR_RAM ECU_ADDRESS 0x3fe692 BIT_MASK 0x1 /end MEASUREMENT
/begin COMPU_METHOD _CNV_A_R_LINEAR_____1_CM "" RAT_FUNC "%6.3" "-" COEFFS 0 1. 0. 0 0 1 /end COMPU_METHOD
/begin COMPU_METHOD _CNV_S_2_RANGE______2_R_CM "" TAB_VERB "%6.3" "[-]" COMPU_TAB_REF _CNV_S_2_RANGE______2_R /end COMPU_METHOD
/begin COMPU_VTAB_RANGE _CNV_S_2_RANGE______2_R "" 2 0 0 "0" 1 255 "1" /end COMPU_VTAB_RANGE
/begin COMPU_METHOD _CNV_A_R_LINEAR_____3_CM "" RAT_FUNC "%6.3" "V" COEFFS 0 204.7999998974999 0. 0 0 1 /end COMPU_METHOD
/begin COMPU_METHOD _CNV_A_R_LINEAR_____4_CM "" RAT_FUNC "%6.3" "s" COEFFS 0 100. 0. 0 0 1 /end COMPU_METHOD
/begin COMPU_METHOD _CNV_S_2_RANGE______5_CM "" TAB_VERB "%6.3" "-" COMPU_TAB_REF _CNV_S_2_RANGE______5 /end COMPU_METHOD
/begin COMPU_VTAB _CNV_S_2_RANGE______5 "" TAB_VERB 2 0 "0" 1 "1" /end COMPU_VTAB
/begin COMPU_METHOD _CNV_A_R_LINEAR_____7_CM "" RAT_FUNC "%6.3" "°C" COEFFS 0 16. 0. 0 0 1 /end COMPU_METHOD
/begin COMPU_METHOD _CNV_A_R_LINEAR_____10_CM "" RAT_FUNC "%6.3" "%" COEFFS 0 2.56 0. 0 0 1 /end COMPU_METHOD
/begin COMPU_METHOD _CNV_A_R_LINEAR_____11_CM "" RAT_FUNC "%6.3" "rpm" COEFFS 0 1. 0. 0 0 1 /end COMPU_METHOD
/begin COMPU_METHOD _CNV_A_R_LINEAR_____12_CM "" RAT_FUNC "%6.3" "°C" COEFFS 0 1.333333333333333 64. 0 0 1 /end COMPU_METHOD
/begin COMPU_METHOD _CNV_A_R_LINEAR_____13_CM "" RAT_FUNC "%6.3" "°C" COEFFS 0 1.333333333333333 0. 0 0 1 /end COMPU_METHOD
/begin COMPU_METHOD _CNV_A_R_LINEAR_____16_CM "" RAT_FUNC "%6.3" "rpm" COEFFS 0 3.125e-002 0. 0 0 1 /end COMPU_METHOD
/begin COMPU_METHOD _CNV_A_R_LINEAR_____22_CM "" RAT_FUNC "%6.3" "[-]" COEFFS 0 1. 0. 0 0 1 /end COMPU_METHOD
/begin COMPU_METHOD _CNV_A_R_LINEAR_____24_CM "" RAT_FUNC "%6.3" "s" COEFFS 0 10. 0. 0 0 1 /end COMPU_METHOD
/begin COMPU_METHOD _CNV_A_R_LINEAR_____27_CM "" RAT_FUNC "%6.3" "mg/stk" COEFFS 0 0.183585313174946 0. 0 0 1 /end COMPU_METHOD
/begin COMPU_METHOD _CNV_A_R_LINEAR_____30_CM "" RAT_FUNC "%6.3" "s" COEFFS 0 1. 0. 0 0 1 /end COMPU_METHOD
/begin COMPU_METHOD _CNV_A_R_LINEAR_____37_CM "" RAT_FUNC "%6.3" "-" COEFFS 0 65536.00007936121 0. 0 0 1 /end COMPU_METHOD
/begin COMPU_METHOD _CNV_A_R_LINEAR_____39_CM "" RAT_FUNC "%6.3" "-" COEFFS 0 127.9991955827809 0. 0 0 1 /end COMPU_METHOD
/begin COMPU_METHOD _CNV_A_R_LINEAR_____41_CM "" RAT_FUNC "%6.3" "s" COEFFS 0 25. 0. 0 0 1 /end COMPU_METHOD
/begin COMPU_METHOD _CNV_A_R_LINEAR_____44_CM "" RAT_FUNC "%6.3" "V" COEFFS 0 51.0204081632653 0. 0 0 1 /end COMPU_METHOD
/begin COMPU_METHOD _CNV_A_R_LINEAR_____48_CM "" RAT_FUNC "%6.3" "[-]" COEFFS 0 32. 0. 0 0 1 /end COMPU_METHOD
/begin COMPU_METHOD _CNV_A_R_LINEAR_____49_CM "" RAT_FUNC "%6.3" "hPa" COEFFS 0 12.06017666543982 0. 0 0 1 /end COMPU_METHOD
/begin COMPU_METHOD _CNV_A_R_LINEAR_____50_CM "" RAT_FUNC "%6.3" "[-]" COEFFS 0 255.9999357490357 0. 0 0 1 /end COMPU_METHOD
/begin COMPU_METHOD _CNV_A_R_LINEAR_____52_CM "" RAT_FUNC "%6.3" "°TPS/s" COEFFS 0 8.535564853556485e-002 0. 0 0 1 /end COMPU_METHOD
/begin COMPU_METHOD _CNV_A_R_LINEAR_____53_CM "" RAT_FUNC "%6.3" "°TPS" COEFFS 0 137.0962343096234 0. 0 0 1 /end COMPU_METHOD
/begin COMPU_METHOD _CNV_A_R_LINEAR_____55_CM "" RAT_FUNC "%6.3" "Nm" COEFFS 0 32. 0. 0 0 1 /end COMPU_METHOD
/begin COMPU_METHOD _CNV_A_R_LINEAR_____60_CM "" RAT_FUNC "%6.3" "V" COEFFS 0 9.807692307692308 0. 0 0 1 /end COMPU_METHOD
/begin COMPU_METHOD _CNV_A_R_LINEAR_____82_CM "" RAT_FUNC "%6.3" "°CRK" COEFFS 0 2.666666666666667 0. 0 0 1 /end COMPU_METHOD
/begin COMPU_METHOD _CNV_A_R_LINEAR_____88_CM "" RAT_FUNC "%6.3" "km" COEFFS 0 0.1 0. 0 0 1 /end COMPU_METHOD
/begin COMPU_METHOD _CNV_A_R_LINEAR_____95_CM "" RAT_FUNC "%6.3" "Nm" COEFFS 0 1. 0. 0 0 1 /end COMPU_METHOD
/begin COMPU_METHOD _CNV_A_R_LINEAR_____97_CM "" RAT_FUNC "%6.3" "min" COEFFS 0 1. 0. 0 0 1 /end COMPU_METHOD
/begin COMPU_METHOD _CNV_A_R_LINEAR_____101_CM "" RAT_FUNC "%6.3" "Nm" COEFFS 0 0.5 0. 0 0 1 /end COMPU_METHOD
/begin COMPU_METHOD _CNV_A_R_LINEAR_____106_CM "" RAT_FUNC "%6.3" "mg/stk" COEFFS 0 47.18142548596112 0. 0 0 1 /end COMPU_METHOD
/begin COMPU_METHOD _CNV_A_R_LINEAR_____115_CM "" RAT_FUNC "%6.3" "-" COEFFS 0 128. 0. 0 0 1 /end COMPU_METHOD
/begin COMPU_METHOD _CNV_A_R_LINEAR_____186_CM "" RAT_FUNC "%6.3" "Nm" COEFFS 0 32. 32768. 0 0 1 /end COMPU_METHOD
/begin COMPU_METHOD _CNV_A_R_LINEAR_____190_CM "" RAT_FUNC "%6.3" "-" COEFFS 0 65535. 0. 0 0 1 /end COMPU_METHOD
/begin COMPU_METHOD _CNV_A_R_LINEAR_____203_CM "" RAT_FUNC "%6.3" "°CRK" COEFFS 0 2.666666666666667 95. 0 0 1 /end COMPU_METHOD
/begin COMPU_METHOD _CNV_A_R_LINEAR_____215_CM "" RAT_FUNC "%6.3" "rpm" COEFFS 0 3.125e-002 128. 0 0 1 /end COMPU_METHOD
/begin COMPU_METHOD _CNV_A_R_LINEAR_____357_CM "" RAT_FUNC "%6.3" "A" COEFFS 0 1. 0. 0 0 1 /end COMPU_METHOD
/begin COMPU_METHOD _CNV_A_R_LINEAR_____367_CM "" RAT_FUNC "%6.3" "%" COEFFS 0 327.67 0. 0 0 1 /end COMPU_METHOD
/begin COMPU_METHOD _CNV_A_R_LINEAR_____380_CM "" RAT_FUNC "%6.3" "µs" COEFFS 0 1. 0. 0 0 1 /end COMPU_METHOD
/begin COMPU_METHOD _CNV_A_R_LINEAR_____391_CM "" RAT_FUNC "%6.3" "%/V" COEFFS 0 3.2 0. 0 0 1 /end COMPU_METHOD
/begin COMPU_METHOD _CNV_A_R_LINEAR_____396_CM "" RAT_FUNC "%6.3" "%/V" COEFFS 0 1.6 0. 0 0 1 /end COMPU_METHOD
/begin COMPU_METHOD _CNV_A_R_LINEAR_____472_CM "" RAT_FUNC "%6.3" "-" COEFFS 0 8000.120001800027 0. 0 0 1 /end COMPU_METHOD
/begin COMPU_METHOD _CNV_A_R_LINEAR_____473_CM "" RAT_FUNC "%6.3" "-" COEFFS 0 8000. 0. 0 0 1 /end COMPU_METHOD
/begin COMPU_METHOD _CNV_A_R_LINEAR_____474_CM "" RAT_FUNC "%6.3" "Nm" COEFFS 0 128. 0. 0 0 1 /end COMPU_METHOD
/begin COMPU_METHOD _CNV_S_3_STATE_ERR__475_CM "" TAB_VERB "%6.3" "[-]" COMPU_TAB_REF _CNV_S_3_STATE_ERR__475 /end COMPU_METHOD
/begin COMPU_VTAB _CNV_S_3_STATE_ERR__475 "" TAB_VERB 3 0 "NO_ERROR" 1 "ERROR_PATH_1" 2 "ERROR_PATH_2" /end COMPU_VTAB
/begin COMPU_METHOD _CNV_R_R_vfzg_ub_q1_493_CM "" RAT_FUNC "%6.3" "[-]" COEFFS 0. 1. 0. 0. 0. 1.25 /end COMPU_METHOD
/begin COMPU_METHOD _CNV_R_R_temp_uw_q0_495_CM "" RAT_FUNC "%6.3" "[-]" COEFFS 0. 1. 48. 0. 0. 0.75 /end COMPU_METHOD
/begin COMPU_METHOD _CNV_R_R_dez_498_CM "" RAT_FUNC "%6.3" "[-]" COEFFS 0. 1. 0. 0. 0. 1. /end COMPU_METHOD
/begin COMPU_METHOD _CNV_R_R_t100msxs_u_500_CM "" RAT_FUNC "%6.3" "[-]" COEFFS 0. 1. 0. 0. 0. 0.1 /end COMPU_METHOD
/begin COMPU_METHOD _CNV_R_R_nmot_ub_q4_510_CM "" RAT_FUNC "%6.3" "[-]" COEFFS 0. 1. 0. 0. 0. 40. /end COMPU_METHOD
/begin COMPU_METHOD _CNV_A_R_LINEAR_____511_CM "" RAT_FUNC "%6.3" "µs" COEFFS 0 1. -1. 0 0 1 /end COMPU_METHOD
/begin COMPU_METHOD _CNV_A_R_LINEAR_____512_CM "" RAT_FUNC "%6.3" "%." COEFFS 0 65.408 0. 0 0 1 /end COMPU_METHOD
/begin COMPU_METHOD _CNV_A_R_LINEAR_____513_CM "" RAT_FUNC "%6.3" "%." COEFFS 0 66.66123114553608 0. 0 0 1 /end COMPU_METHOD
/begin COMPU_METHOD _CNV_A_R_LINEAR_____514_CM "" RAT_FUNC "%6.3" "%." COEFFS 0 4194.293686959193 -8.057063130399911e-002 0 0 1 /end COMPU_METHOD
/begin COMPU_METHOD _CNV_A_R_LINEAR_____515_CM "" RAT_FUNC "%6.3" "%." COEFFS 0 4194.283373654366 0. 0 0 1 /end COMPU_METHOD
/begin COMPU_METHOD _CNV_A_R_LINEAR_____516_CM "" RAT_FUNC "%6.3" "-" COEFFS 0 255. 0. 0 0 1 /end COMPU_METHOD
/begin COMPU_METHOD _CNV_A_R_LINEAR_____517_CM "" RAT_FUNC "%6.3" "-" COEFFS 0 255.5 0. 0 0 1 /end COMPU_METHOD
/begin COMPU_METHOD _CNV_A_R_LINEAR_____518_CM "" RAT_FUNC "%6.3" "%." COEFFS 0 4194.293686959193 32767.9194293687 0 0 1 /end COMPU_METHOD
/begin COMPU_METHOD _CNV_A_R_LINEAR_____519_CM "" RAT_FUNC "%6.3" "%" COEFFS 0 327.6800000071683 0. 0 0 1 /end COMPU_METHOD
/begin COMPU_METHOD _CNV_A_R_LINEAR_____520_CM "" RAT_FUNC "%6.3" "µs" COEFFS 0 1. 32768. 0 0 1 /end COMPU_METHOD
/begin COMPU_METHOD _CNV_R_R_nmot_ub_q1_536_CM "" RAT_FUNC "%6.3" "[-]" COEFFS 0. 1. 0. 0. 0. 10. /end COMPU_METHOD
/begin COMPU_METHOD _CNV_R_R_rel_ub_q0p_537_CM "" RAT_FUNC "%6.3" "[-]" COEFFS 0. 1. 0. 0. 0. 0.75 /end COMPU_METHOD
/begin COMPU_METHOD _CNV_R_R_fak_ub_b4_538_CM "" RAT_FUNC "%6.3" "[-]" COEFFS 0. 256. 0. 0. 0. 4. /end COMPU_METHOD
/begin COMPU_METHOD _CNV_R_R_temp_ub_q5_539_CM "" RAT_FUNC "%6.3" "[-]" COEFFS 0. 1. 50. 0. 0. 5. /end COMPU_METHOD
/begin COMPU_METHOD _CNV_A_R_LINEAR_____540_CM "" RAT_FUNC "%6.3" "1/s^2" COEFFS 0 1. 0. 0 0 1 /end COMPU_METHOD
/begin COMPU_METHOD _CNV_A_R_LINEAR_____541_CM "" RAT_FUNC "%6.3" "%" COEFFS 0 327.8667200320192 16393.33600160096 0 0 1 /end COMPU_METHOD
/begin COMPU_METHOD _CNV_A_R_LINEAR_____542_CM "" RAT_FUNC "%6.3" "-" COEFFS 0 256.4102564102564 0. 0 0 1 /end COMPU_METHOD
/begin COMPU_METHOD _CNV_A_R_LINEAR_____543_CM "" RAT_FUNC "%6.3" "tdc" COEFFS 0 1. 0. 0 0 1 /end COMPU_METHOD
/begin COMPU_METHOD _CNV_A_R_LINEAR_____544_CM "" RAT_FUNC "%6.3" "Nm" COEFFS 0 64. 0. 0 0 1 /end COMPU_METHOD
/begin COMPU_METHOD _CNV_S_5_RANGE_STAT_545_CM "" TAB_VERB "%6.3" "-" COMPU_TAB_REF _CNV_S_5_RANGE_STAT_545 /end COMPU_METHOD
/begin COMPU_VTAB _CNV_S_5_RANGE_STAT_545 "" TAB_VERB 5 0 "Init Phase" 1 "Prepa. 0 delay" 2 "0 delay monit." 3 "Prepa nominal" 4 "Nominal monit." /end COMPU_VTAB
/begin COMPU_METHOD _CNV_A_R_LINEAR_____546_CM "" RAT_FUNC "%6.3" "cyl" COEFFS 0 1. 0. 0 0 1 /end COMPU_METHOD
/begin COMPU_METHOD _CNV_A_R_LINEAR_____547_CM "" RAT_FUNC "%6.3" "-" COEFFS 0 256.3333333333333 0. 0 0 1 /end COMPU_METHOD
/begin COMPU_METHOD _CNV_A_R_LINEAR_____548_CM "" RAT_FUNC "%6.3" "-" COEFFS 0 127.5 0. 0 0 1 /end COMPU_METHOD
/begin RECORD_LAYOUT _REC_VAL_20_u1 FNC_VALUES 1 UBYTE COLUMN_DIR DIRECT /end RECORD_LAYOUT
/begin RECORD_LAYOUT _REC_VAL_20_u2 FNC_VALUES 1 UWORD COLUMN_DIR DIRECT /end RECORD_LAYOUT
/begin RECORD_LAYOUT _REC_CUR_20_u2_u1 FNC_VALUES 1 UWORD COLUMN_DIR DIRECT /end RECORD_LAYOUT
/begin RECORD_LAYOUT _REC_AXS_20_u1 NO_AXIS_PTS_X 1 UBYTE AXIS_PTS_X 2 UBYTE INDEX_INCR DIRECT /end RECORD_LAYOUT
/begin RECORD_LAYOUT _REC_CUR_20_u1_u1 FNC_VALUES 1 UBYTE COLUMN_DIR DIRECT /end RECORD_LAYOUT
/begin RECORD_LAYOUT _REC_AXS_20_u2 NO_AXIS_PTS_X 1 UWORD AXIS_PTS_X 2 UWORD INDEX_INCR DIRECT /end RECORD_LAYOUT
/begin RECORD_LAYOUT _REC_MAP_20_u1_u1_u2 FNC_VALUES 1 UBYTE COLUMN_DIR DIRECT /end RECORD_LAYOUT
/begin RECORD_LAYOUT _REC_MAP_20_u2_u2_u1 FNC_VALUES 1 UWORD COLUMN_DIR DIRECT /end RECORD_LAYOUT
/begin RECORD_LAYOUT _REC_CUR_20_u1_u2 FNC_VALUES 1 UBYTE COLUMN_DIR DIRECT /end RECORD_LAYOUT
/begin RECORD_LAYOUT _REC_MAP_20_u2_u1_u1 FNC_VALUES 1 UWORD COLUMN_DIR DIRECT /end RECORD_LAYOUT
/begin RECORD_LAYOUT _REC_CUR_20_u2_u2 FNC_VALUES 1 UWORD COLUMN_DIR DIRECT /end RECORD_LAYOUT
/begin RECORD_LAYOUT _REC_VAL_20_s2 FNC_VALUES 1 SWORD COLUMN_DIR DIRECT /end RECORD_LAYOUT
/begin RECORD_LAYOUT _REC_MAP_20_u2_u1_u2 FNC_VALUES 1 UWORD COLUMN_DIR DIRECT /end RECORD_LAYOUT
/begin RECORD_LAYOUT _REC_MAP_20_u1_u2_u2 FNC_VALUES 1 UBYTE COLUMN_DIR DIRECT /end RECORD_LAYOUT
/begin RECORD_LAYOUT _REC_MAP_20_u2_u2_u2 FNC_VALUES 1 UWORD COLUMN_DIR DIRECT /end RECORD_LAYOUT
/begin RECORD_LAYOUT _REC_MAP_20_u1_u2_u1 FNC_VALUES 1 UBYTE COLUMN_DIR DIRECT /end RECORD_LAYOUT
/begin RECORD_LAYOUT _REC_MAP_52_UBYTE_u1_u1_u1 NO_AXIS_PTS_X 1 UBYTE NO_AXIS_PTS_Y 2 UBYTE AXIS_PTS_X 3 UBYTE INDEX_INCR DIRECT AXIS_PTS_Y 4 UBYTE INDEX_INCR DIRECT FNC_VALUES 5 UBYTE COLUMN_DIR DIRECT /end RECORD_LAYOUT
/begin RECORD_LAYOUT _REC_CUR_52_UBYTE_u1_u1 NO_AXIS_PTS_X 1 UBYTE AXIS_PTS_X 2 UBYTE INDEX_INCR DIRECT FNC_VALUES 3 UBYTE COLUMN_DIR DIRECT /end RECORD_LAYOUT
/begin RECORD_LAYOUT _REC_MAP_52_UBYTE_u1_u1_u2 NO_AXIS_PTS_X 1 UBYTE NO_AXIS_PTS_Y 2 UBYTE AXIS_PTS_X 3 UBYTE INDEX_INCR DIRECT AXIS_PTS_Y 4 UWORD INDEX_INCR DIRECT FNC_VALUES 5 UBYTE COLUMN_DIR DIRECT /end RECORD_LAYOUT
/begin FUNCTION ENRD_Calculation ""
 /begin DEF_CHARACTERISTIC c_n_min_er c_crk_dif_max_er c_seg_t_ad_cor_drv1_max_er c_nr_seg_ad_act_min c_nr_seg_drv1_er_min c_n_max_er c_n_32_min_seg c_n_seg_t_ad_raw_min_er c_n_seg_t_ad_min_er c_n_seg_t_ad_max_er c_n_seg_t_ad_raw_max_er ldp_seg_nr_er id_seg_nr_cbk_er /end DEF_CHARACTERISTIC
 /begin OUT_MEASUREMENT if_t_seg_mis cur_seg_cor seg_t_cor_buf[0] seg_t_cor_buf[1] seg_t_cor_buf[2] seg_t_cor_buf[3] seg_t_cor_buf[4] seg_t_cor_buf[5] drv0_er drv2_mmv_er drv1_er er_raw lv_ena_er thd_ad_er seg_t_ad_min_er delta_crk_dif_max_er lv_seg_ad_lim cur_seg_mes seg_t_mes_buf[0] seg_t_mes_buf[1] seg_t_mes_buf[2] seg_t_mes_buf[3] seg_t_mes_buf[4] seg_t_mes_buf[5] drv2_er seg_t_ad_nr lv_seg_ad_state er er_x[0] er_x[1] er_x[2] er_x[3] er_x[4] er_x[5] seg_ad_mmv[0] seg_ad_mmv[1] seg_ad_mmv[2] seg_ad_mmv[3] seg_ad_mmv[4] seg_ad_mmv[5] seg_ad_raw_mmv[0] seg_ad_raw_mmv[1] seg_ad_raw_mmv[2] seg_ad_raw_mmv[3] seg_ad_raw_mmv[4] seg_ad_raw_mmv[5] lv_seg_ad_act_state lv_seg_ad_raw_act_state seg_nr_er seg_nr_cbk_er /end OUT_MEASUREMENT
/end FUNCTION
/begin FUNCTION ENRD_Calculation_Appli_Inci ""
 /begin DEF_CHARACTERISTIC c_seg_t_ad_raw_crlc_er c_tps_grd_dly_er_ad c_seg_t_mes_min c_seg_t_mes_max c_seg_t_fast_ad_crlc_er c_seg_t_ad_crlc_er_eol c_seg_t_ad_crlc_er c_seg_t_ad_cor_drv1_max_er_eol c_seg_ad_dif_max_er c_nr_seg_drv1_er_min_eol c_nr_seg_ad_act_min_eol c_n_seg_t_ad_min_er_eol c_n_seg_t_ad_max_er_eol c_maf_dif_dly_er_ad c_load_mis_dif_dly_er_ad c_fac_drv2_zdly_er c_crlc_drv2_zdly_er ip_seg_2_ad_cor ip_seg_1_ad_cor ip_maf_dif_max_er_ad__maf ip_fac_load_drv2_er_mt ip_fac_load_drv2_er_at ip_fac_gain_er_5_mt ip_fac_gain_er_5_at ip_fac_gain_er_4_mt ip_fac_gain_er_4_at ip_fac_gain_er_3_mt ip_fac_gain_er_3_at ip_fac_gain_er_2_mt ip_fac_gain_er_2_at ip_fac_gain_er_1_mt ip_fac_gain_er_1_at ip_fac_gain_er_0_mt ip_fac_gain_er_0_at ip_fac_add_er_4_at ip_fac_add_er_4_mt ip_fac_add_er_3_mt ip_fac_add_er_3_at ip_fac_add_er_5_at ip_fac_add_er_5_mt ip_fac_add_er_1_at ip_fac_add_er_2_mt ip_fac_add_er_2_at ip_fac_add_er_1_mt ip_crlc_drv2_er_at ip_crlc_drv2_er_mt ip_fac_add_er_0_at ip_fac_add_er_0_mt c_t_drv2_zdly_er c_accout_dly_er_ad ip_tps_grd_max_er_ad__tps_av ip_load_mis_dif_max_er_ad lc_seg_ad_rst_ena_eol lc_seg_ad_req_ena_eol lc_conf_gain_add_er ip_fac_n_drv2_er_at ip_fac_n_drv2_er_mt /end DEF_CHARACTERISTIC
 /begin OUT_MEASUREMENT fac_gain_er[0] fac_gain_er[1] fac_gain_er[2] fac_gain_er[3] fac_gain_er[4] fac_gain_er[5] fac_drv2_er fac_add_er[0] fac_add_er[1] fac_add_er[2] fac_add_er[3] fac_add_er[4] fac_add_er[5] crlc_drv2_er lv_seg_ad_req_eol lv_seg_ad_rst_eol lv_err_det_crk seg_t_mes lv_ena_seg_t_mes lv_seg_ad_fdout seg_ad_cor seg_ad_dif_1 seg_ad_dif_0 seg_ad_dif_2 seg_t_ad_crlc_er lv_inh_seg_ad lv_err_seg_t lv_err_seg_t_ad /end OUT_MEASUREMENT
/end FUNCTION
/begin FUNCTION LOADRESP ""
 /begin DEF_CHARACTERISTIC ENAPPLGOFF ENAPPLRESP KFLORESP KLLORESPM LRESPAPP RLMXGENOF TGENOFVL TLORESPST TVLOFHYST VGENOFMN VGENOGMX NMXGENOF S_LORESLL TATMGENOF VZLORESOFV FHOGNMN TABSTGNMN TABSTGNMX TMOTABGNMN TUMGGNMN TUMGGNMX KFZLRESOF KFZLRRESOFV /end DEF_CHARACTERISTIC
 /begin OUT_MEASUREMENT tlrgen loadresp B_genoffst B_genoffvl nmot kmstand tkatm rl B_llrein B_vl tmst B_stend tmot tumg vfzg fho tlrgen2 tmotab tabsmn_w tabst_w /end OUT_MEASUREMENT
/end FUNCTION
/begin FUNCTION MISF ""
 /begin SUB_FUNCTION MISF_Det_ENRD_Based MISF_Legal_Misf_Det_Fade_Out_Cnd MISF_Rate_Err_Mngt MISF_Det_ENRD_Based_Appli_Inci MISF_Rate_Err_Mngt_Appli_Inci /end SUB_FUNCTION
/end FUNCTION
/begin FUNCTION MISF_Det_ENRD_Based "" /begin DEF_CHARACTERISTIC c_fac_sca_er_stnd c_n_max_er_stnd lc_er_stnd_conf /end DEF_CHARACTERISTIC
 /begin OUT_MEASUREMENT lv_det_mis mis_state_er er_stnd er_stnd_x[0] er_stnd_x[1] er_stnd_x[2] er_stnd_x[3] er_stnd_x[4] er_stnd_x[5] /end OUT_MEASUREMENT
/end FUNCTION
/begin FUNCTION MISF_Legal_Misf_Det_Fade_Out_Cnd ""
 /begin DEF_CHARACTERISTIC c_mask_inh_det_zdly_mis c_n_min_zdly_mis c_t_zdly_mis c_nr_tdc_zdly_mis c_n_min_mis c_n_max_mis_at c_n_max_mis_mt c_mask_inh_det_mis c_nr_tdc_inh_mis lc_req_zdly_mis c_amp_min_mis c_tco_min_mis c_t_dly_st_mis c_t_dly_iv_off_mis /end DEF_CHARACTERISTIC
 /begin OUT_MEASUREMENT state_diag_mis mis_det_cyl_inh mis_det_cdn_inh_nr ctr_tdc_zdly_mis ctr_t_zdly_mis lv_diag_mis mis_det_cdn_inh mis_det_cdn_inh.lv_inh_n_det_mis mis_det_cdn_inh.lv_inh_load_min_det_mis mis_det_cdn_inh.lv_inh_tco_min_det_mis mis_det_cdn_inh.lv_inh_amp_min_det_mis mis_det_cdn_inh.lv_inh_st_det_mis mis_det_cdn_inh.lv_inh_iv_off_det_mis lv_req_inh_mis lv_zdly_diag_mis lv_puc_det_mis /end OUT_MEASUREMENT
/end FUNCTION
/begin FUNCTION MISF_Rate_Err_Mngt ""
 /begin DEF_CHARACTERISTIC c_load_mis_ftp c_n_mis_ftp c_mis_a_ind_thd c_mis_a_min_nr c_mis_sum_a_thd c_mis_sum_a_cbk_thd c_mis_max_nr_off_iv c_mis_min_nr_puc c_t_mis_min_puc c_mis_sum_b1_thd_mt c_mis_sum_b1_thd_at c_mis_sum_b4_thd_mt c_mis_sum_b4_thd_at c_mis_b1_min_nr c_mis_b4_min_nr c_mis_sum_b1_cbk_thd c_mis_sum_b4_cbk_thd lc_mis_inh lc_conf_rnd_det_mis_b lc_conf_inh_iv_mis lc_conf_rnd_det_mis_a lc_conf_mis_a_lih c_nr_cyl_mpl_mis_a c_nr_cyl_mpl_mis_b lc_conf_mpl_det_mis_a lc_conf_mpl_det_mis_b c_nr_det_max_mis_a c_ratio_ftp_cdn_ind_mis_a c_ratio_ftp_cdn_mis_a c_nr_det_max_mis_b4 /end DEF_CHARACTERISTIC
 /begin OUT_MEASUREMENT lv_ftp_mis_a inh_iv_mis mis_nr_tdc_a mis_sum_a mis_sum_a_cbk_1 mis_sum_a_cbk_2 ctr_chk_mis_a ctr_ftp_cdn_mis_a mis_ctr_a[0] mis_ctr_a[1] mis_ctr_a[2] mis_ctr_a[3] mis_ctr_a[4] mis_ctr_a[5] mis_ctr_b[0] mis_ctr_b[1] mis_ctr_b[2] mis_ctr_b[3] mis_ctr_b[4] mis_ctr_b[5] mis_nr_tdc_b mis_sum_b mis_sum_b_cbk_1 mis_sum_b_cbk_2 ctr_chk_mis_b4 sym_cyl_mis_a sym_cyl_mis_b1 sym_cyl_mis_b4 lv_det_mis_a lv_inh_iv_mis_a ctr_det_mis_a lv_end_win_mis_a lv_det_mis_b4 lv_mis_state_b1 lv_mis_state_b4 ctr_det_mis_b4 lv_end_win_mis_b1 lv_end_win_mis_b4 lv_end_mis_b1 lv_end_mis_a lv_end_mis_b4 lv_mis_state_a /end OUT_MEASUREMENT
/end FUNCTION
/begin FUNCTION MISF_Det_ENRD_Based_Appli_Inci ""
 /begin DEF_CHARACTERISTIC ip_load_min_afs_mt_mis ip_load_min_afs_at_mis ip_load_min_afl_mt_mis ip_load_min_afl_at_mis ip_load_min_s_mt_mis ip_load_min_s_at_mis ip_amp_ofs_load_afs_mis ip_amp_ofs_load_s_mis ip_amp_ofs_load_afl_mis ip_tco_ofs_load_afl_mis ip_tco_ofs_load_s_mis ip_tco_ofs_load_afs_mis ldp_n_32__fac_thd_iv_s_er ldp_n_32__fac_thd_iv_er ldp_load_mis__thd_afl_er_is ldp_load_mis__thd_afs_er_is ldp_load_mis__thd_s_er_is ldp_n__thd_afs_er_is ldp_n__thd_afl_er_is ldp_n__thd_s_er_is ldp_tco__fac_thd_er ldp_iga_ch_bas__fac_thd_er_ch ip_thd_at_afl_er ip_thd_afl_er_is ip_thd_mt_afs_er ip_thd_mt_afl_er ip_thd_afs_er_is ip_thd_at_afs_er ip_thd_at_s_er ip_thd_mt_s_er ip_thd_s_er_is ip_fac_thd_iv_er ip_fac_thd_er ip_fac_thd_er_ch c_mask_app_inh_det_zdly_mis c_nr_tdc_iga_dif_er c_nr_tdc_cmb_tra_s_mis c_nr_tdc_cmb_tra_afl_mis ip_tps_grd_max_er ip_tps_grd_max_zdly_er ip_load_grd_hom_max_mis ip_load_grd_s_max_mis ldp_map__map_dif_max_er ip_map_dif_max_er ldp_n_32__delta_iga_mis ldp_maf__delta_iga_mis ip_delta_iga_mis ip_fac_thd_iv_s_er ldpm_amp__amp_ofs_load_mis ldpm_tco__tco_ofs_load_mis lc_conf_load_mis c_tqi_av_max_mis c_maf_max_mis ldp_tps_av__tps_grd_max_er ldp_tps_av__tps_grd_max_zdly_er ldp_load_mis__load_grd_hom_max ldp_load_mis__load_grd_s_max ldp_n__load_min_s_mt_mis ldp_n__load_min_s_at_mis ldp_n__load_min_afs_mt_mis ldp_n__load_min_afs_at_mis ldp_n__load_min_afl_mt_mis ldp_n__load_min_afl_at_mis ldp_load_mis__thd_mt_afl_er ldp_load_mis__thd_at_afl_er ldp_n_32__thd_mt_afl_er ldp_n_32__thd_at_afl_er ldp_load_mis__thd_mt_afs_er ldp_load_mis__thd_at_afs_er ldp_load_mis__thd_mt_s_er ldp_load_mis__thd_at_s_er ldp_n_32__thd_mt_s_er ldp_n_32__thd_at_s_er ldp_n_32__thd_mt_afs_er ldp_n_32__thd_at_afs_er c_t_tps_grd_dly_mis c_t_tps_grd_dly_zdly_mis c_t_load_grd_hom_dly_mis c_t_load_grd_s_dly_mis c_t_accout_dly_er c_t_map_dif_dly_er c_t_amt_gs_dly_mis c_mask_app_inh_det_mis c_mask_app_inh_det_mis_is /end DEF_CHARACTERISTIC
 /begin OUT_MEASUREMENT n_mis load_mis_1 load_mis_2 load_mis_3 load_grd_mis load_min_mis load_mis mis_det_cdn_app_inh_nr mis_det_cdn_app_inh mis_det_cdn_app_inh.lv_inh_map_dif_det_mis mis_det_cdn_app_inh.lv_inh_tps_grd_det_mis mis_det_cdn_app_inh.lv_inh_load_grd_det_mis mis_det_cdn_app_inh.lv_inh_iga_dif_det_mis mis_det_cdn_app_inh.lv_inh_cmb_tra_mis mis_det_cdn_app_inh.lv_inh_acc_det_mis mis_det_cdn_app_inh.lv_inh_cdn_obd_mis mis_det_cdn_app_inh.lv_inh_indx_mis mis_det_cdn_app_inh.lv_inh_amt_gs_det_mis iga_mis_1 iga_mis_2 iga_mis lv_req_app_inh_mis ctr_tot_mis thd_er_buf[0] thd_er_buf[1] thd_er_buf[2] thd_er_buf[3] thd_er_buf[4] thd_er_buf[5] thd_er_stnd_buf[0] thd_er_stnd_buf[1] thd_er_stnd_buf[2] thd_er_stnd_buf[3] thd_er_stnd_buf[4] thd_er_stnd_buf[5] iga_dif_mis map_dif_mis thd_er_stnd thd_er_stnd_x[0] thd_er_stnd_x[1] thd_er_stnd_x[2] thd_er_stnd_x[3] thd_er_stnd_x[4] thd_er_stnd_x[5] thd_er thd_er_x[0] thd_er_x[1] thd_er_x[2] thd_er_x[3] thd_er_x[4] thd_er_x[5] /end OUT_MEASUREMENT
/end FUNCTION
/begin FUNCTION MISF_Rate_Err_Mngt_Appli_Inci ""
 /begin DEF_CHARACTERISTIC ldp_n_32__fac_er_afl_diag_mis ldp_n_32__fac_er_s_diag_mis ldp_n_32__fac_igc_diag_mis ldp_n_32__fac_er_afs_diag_mis ldp_n_32__fac_iv_diag_mis ldp_load_mis__fac_er_s_diag_mis ldp_load_mis__fac_igc_diag_mis ip_fac_er_afl_diag_mis ip_fac_er_s_diag_mis ip_fac_er_afs_diag_mis ip_fac_igc_diag_mis ip_fac_iv_diag_mis ldp_load_mis__fac_iv_diag_mis ldp_load_mis_2__mis_a_fac_afl ldp_load_mis_2__mis_a_fac_afs ldp_load_mis_2__mis_a_fac_s c_mis_nr_off_iv_igcfb c_teg_cat_up_mis_a_max lc_ftl_l_diag_mis lc_ctr_conf_diag_mis ip_mis_a_fac_afl ip_mis_a_fac_afs ip_mis_a_fac_s ldp_n__mis_a_fac_afl ldp_n__mis_a_fac_afs ldp_n__mis_a_fac_s ldp_load_mis__fac_er_afs_diag ldp_load_mis__fac_er_afl_diag /end DEF_CHARACTERISTIC
 /begin OUT_MEASUREMENT ctr_mis_det_cyl[0] ctr_mis_det_cyl[1] ctr_mis_det_cyl[2] ctr_mis_det_cyl[3] ctr_mis_det_cyl[4] ctr_mis_det_cyl[5] ctr_mis_det ctr_seg_mis_act sum_fac_diag_mis fac_igc_diag_mis fac_er_diag_mis fac_iv_diag_mis lv_ftl_l_diag_mis lv_req_app_ctr_mis_a mis_a_fac mis_a_fac_buf[0] mis_a_fac_buf[1] mis_a_fac_buf[2] mis_a_fac_buf[3] mis_a_fac_buf[4] mis_a_fac_buf[5] lv_cdn_mis_b1 lv_cdn_mis_a lv_cdn_mis_b4 lv_mis_state_b lv_det_cfm_mis lv_err_mis_mpl lv_err_mis_1 lv_err_mis_2 lv_err_mis_3 lv_err_mis_4 lv_err_mis_5 lv_err_mis_0 load_max_scdn_mis load_min_scdn_mis n_min_scdn_mis n_max_scdn_mis /end OUT_MEASUREMENT
/end FUNCTION
/begin FUNCTION MON_Monitoring "MON"
 /begin SUB_FUNCTION MON_Monitoring_of_pedal_value_si MON_Application_Incidence_and_Co MON_RAM_Test_of_process_monitori MON_Monitoring_of_analog_digital MON_TCO_Monitoring MON_Monitoring_of_torque_demand_ MON_Monitoring_of_torque_losses MON_Monitoring_of_minimum_torque MON_Monitoring_of_maximum_torque MON_Monitoring_of_engine_speed MON_Desired_indicated_engine_tor MON_Actual_indicated_engine_torq MON_Monitoring_of_actual_indicat MON_Monitoring_of_engine_speed_l MON_Fault_reaction_of_process_mo MON_Can_signals MON_Monitoring_of_cruse_control_ MON_Monitoring_of_mass_air_flow_ MON_Errors MON_Processor_Monitoring_by_copy MON_Processor_Monitoring MON_Fault_Reaction_of_Processor_ MON_Monitoring_of_sport_switch /end SUB_FUNCTION
/end FUNCTION
/begin FUNCTION MON_Monitoring_of_pedal_value_si "_Monitoring of pedal value signal"
 /begin DEF_CHARACTERISTIC c_v_pvs_is_thd_1_mon c_v_pvs_is_thd_2_mon c_v_pvs_slop_1_mon c_v_pvs_slop_2_mon c_n_min_pvs_diag_mon ip_pv_ratio_hys_mon c_pv_lih_max_mon /end DEF_CHARACTERISTIC
 /begin OUT_MEASUREMENT lv_err_pvs_ratio_mon pv_av_mon pv_av_1_mon pv_av_2_mon abc_pvs_ratio_mon lv_err_pvs_mon /end OUT_MEASUREMENT
/end FUNCTION
/begin FUNCTION MON_Application_Incidence_and_Co "_Application Incidence and Configuration of Process Monitoring"
 /begin DEF_CHARACTERISTIC c_v_tps_1_lih_mon c_v_tps_2_lih_mon c_tq_loss_pste_2_min_mon c_tq_loss_pste_1_min_mon c_tq_loss_ars_min_mon c_tq_loss_add_acc_min_mon c_fac_eff_alter_mon c_fac_n_alter_mon c_tq_loss_alter_lih_mon c_crlc_alter_mon c_v_tq_alter_mon id_eff_typ_alter_mon ldp_genawnumm__tq_loss_mon ldp_dffgen_fil_mon__loss_mon ldpm_n_alter_mon__tq_loss_mon ip_cur_alter_mon ip_eff_alter_mon ldp_cur_alter_mon__tq_loss_mon /end DEF_CHARACTERISTIC
 /begin OUT_MEASUREMENT lv_n_lim_etc_mon lv_tqi_mon_act_mon tq_esp_mon lv_brake_mon lv_im_bts_mon lv_im_bls_mon lv_igk_mon n_sp_is_mon tq_egs_mon tq_loss_acc_mon tq_loss_add_mon tq_loss_alter_mon tq_loss_alter_mdl_mon tq_loss_ars_mon tq_loss_pste_1_mon tq_loss_pste_mon tq_loss_pste_2_mon cur_alter_mon n_alter_mon dffgen_fil_mon state_n_max_mon lv_err_vcc_pvs_2_mon lv_err_vcc_pvs_1_mon lv_err_vcc_pvs_mon lv_err_tqi_n_max_nvmy_mon /end OUT_MEASUREMENT
/end FUNCTION
/begin FUNCTION MON_RAM_Test_of_process_monitori "_RAM Test of process monitoring" /begin OUT_MEASUREMENT val_mon_err_ram /end OUT_MEASUREMENT /end FUNCTION
/begin FUNCTION MON_Monitoring_of_analog_digital "_Monitoring of analog-digital-conversoin" /begin DEF_CHARACTERISTIC c_v_conv_thd_deac_mon c_v_pvs_2_conv_ratio_hys_mon /end DEF_CHARACTERISTIC /begin OUT_MEASUREMENT abc_conv_mon lv_err_conv_mon /end OUT_MEASUREMENT /end FUNCTION
/begin FUNCTION MON_TCO_Monitoring "_TCO Monitoring"
 /begin DEF_CHARACTERISTIC c_t_tco_grd_max_mon c_tco_grd_max_mon c_tco_sub_thd_max_mon c_tco_thd_min_mon /end DEF_CHARACTERISTIC
 /begin OUT_MEASUREMENT t_tco_grd_mon tco_mon /end OUT_MEASUREMENT
/end FUNCTION
/begin FUNCTION MON_Monitoring_of_torque_demand_ "_Monitoring of torque demand from idle speed controller"
 /begin DEF_CHARACTERISTIC ip_tq_dif_p_d_is_max_mon ip_fac_tq_dif_p_d_is_mon c_n_dif_min_mon c_tq_dif_i_is_max_mon c_tq_pas_i_is_mon c_fac_ramp_pos_i_is_mon c_fac_ramp_neg_i_is_mon c_tq_dif_p_d_is_add_mon c_tq_dif_i_is_add_mon c_fac_ramp_neg_p_d_is_mon ip_n_sp_is_mon_max_mon c_n_dif_fac_mon c_n_dif_crlc_high_mon c_n_dif_crlc_low_mon /end DEF_CHARACTERISTIC
 /begin OUT_MEASUREMENT lv_err_tq_dif_p_d_is_mon lv_err_tq_dif_i_is_mon n_dif_sp_is_mon tq_dif_i_is_mon tq_dif_i_is_ramp_mon tq_dif_p_d_is_dif_mon tq_dif_i_is_dif_mon abc_tq_dif_p_d_is_mon abc_tq_dif_i_is_mon tq_dif_p_d_is_mon tq_dif_p_d_is_ramp_mon tq_add_p_d_is_mon tq_add_i_is_mon state_err_tq_dif_p_d_is_mon state_err_tq_dif_i_is_mon n_dif_mmv_mon n_dif_cor_mon tq_dif_p_d_is_ramp_mon_1 /end OUT_MEASUREMENT
/end FUNCTION
/begin FUNCTION MON_Monitoring_of_torque_losses "_Monitoring of torque losses"
 /begin DEF_CHARACTERISTIC ip_tq_loss_min_mon ip_tqfr_add_mon ip_tqfr_add_km_mon c_tq_dif_is_ad_min_mon /end DEF_CHARACTERISTIC
 /begin OUT_MEASUREMENT lv_err_tq_loss_mon tq_loss_dif_mon abc_tq_loss_mon tq_loss_mon tqfr_add_mon /end OUT_MEASUREMENT
/end FUNCTION
/end MODULE
/end PROJECT
