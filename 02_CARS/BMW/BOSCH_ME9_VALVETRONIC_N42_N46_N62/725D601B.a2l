ASAP2_VERSION 1 3
/begin PROJECT _725D601B "725D601B"
/begin HEADER "" VERSION "_725D601B" PROJECT_NO _725D601B /end HEADER
/begin MODULE DIM ""
/begin MOD_COMMON "" BYTE_ORDER MSB_FIRST ALIGNMENT_BYTE 1 ALIGNMENT_WORD 2 ALIGNMENT_LONG 2 ALIGNMENT_FLOAT32_IEEE 4 /end MOD_COMMON
/begin CHARACTERISTIC AZKRLDYN "Anzahl Z¸ndungen pro Zyl. bei KR-Lastdynamik" CURVE 0xFD2DBC KlAUbSstUbWUb 254.0 dez 1.000 255.0 FORMAT "%5.1"
 /begin AXIS_DESCR STD_AXIS nmot nmot_ub_q40 16 0.00 10200. FORMAT "%5.0" DEPOSIT ABSOLUTE /end AXIS_DESCR
/end CHARACTERISTIC
/begin CHARACTERISTIC AZKRNDYN "Anzahl Z¸ndungen f¸r KR-Drehzahldynamik" CURVE 0xFD2DDD KlAUbSstUbWUb 254.0 dez 1.000 255.0 FORMAT "%5.1"
 /begin AXIS_DESCR STD_AXIS nmot nmot_ub_q40 16 0.00 10200. FORMAT "%5.0" DEPOSIT ABSOLUTE /end AXIS_DESCR
/end CHARACTERISTIC
/begin CHARACTERISTIC CWHLS "Codewort Heizungssteuerung Lambdasonde ¸ber Steuerger‰t" VALUE 0xFD288C KwUb 255.0 dez 0.00 255.0 FORMAT "%5.1" /end CHARACTERISTIC
/begin CHARACTERISTIC CWKHMD "Codewort f¸r Drehmomentenreserve bei Katheizen" VALUE 0xFD288D KwUb 255.0 dez 0.00 255.0 FORMAT "%5.1" /end CHARACTERISTIC
/begin CHARACTERISTIC CWKTM "Codewort zur Steuerung KTM" VALUE 0xFC767E KwWU16 65535.00 default 0.00 65535.00 FORMAT "%8.2" /end CHARACTERISTIC
/begin CHARACTERISTIC CWRQNVRB "Codewort: NVRAM-Backup immer angefordert" VALUE 0xFCC9DA KwWU8 255.0 DEZ 0.00 255.0 FORMAT "%5.1" /end CHARACTERISTIC
/begin CHARACTERISTIC CWZWDYN "CW Anpassung wkr Adaption an KRANN" VALUE 0xFD2DFE KwUb 255.0 dez 0.00 255.0 FORMAT "%5.1" /end CHARACTERISTIC
/begin CHARACTERISTIC CW_KRRA "Codewort zur Umschaltung der Fr¸hverstellung" VALUE 0xFC84DF KwUb 255.0 dez 0.00 255.0 FORMAT "%5.1" /end CHARACTERISTIC
/begin CHARACTERISTIC DIPRFO "obere Schwelle delta Pumpenreferenzstrom" VALUE 0xFD4910 KwWU16 399.9939 i_q6p1035_uA 0.00 399.9939 FORMAT "%8.4" /end CHARACTERISTIC
/begin CHARACTERISTIC DIPRFOCFC "obere Schwelle delta Pumpenreferenzstrom bei Tankdeckel Pr¸fung bei Fahrt" VALUE 0xFD4912 KwWU16 399.9939 i_q6p1035_uA 0.00 399.9939 FORMAT "%8.4" /end CHARACTERISTIC
/begin CHARACTERISTIC DITEDTD "Schwelle Pumpenstromaenderung zur Tankdeckelerkennung" VALUE 0xFD4914 KwWS16 399.9939 i_q6p1035_uA -200.0000 199.9939 FORMAT "%8.4" /end CHARACTERISTIC
/begin CHARACTERISTIC DITEDTK "Schwelle Pumpenstromaenderung zur Betankungserkennung" VALUE 0xFD4916 KwWS16 399.9939 i_q6p1035_uA -200.0000 199.9939 FORMAT "%8.4" /end CHARACTERISTIC
/begin CHARACTERISTIC DPSF "Schwelle Stromabfall w‰hrend Messung" VALUE 0xFD4918 KwWU16 399.9939 i_q6p1035_uA 0.00 399.9939 FORMAT "%8.4" /end CHARACTERISTIC
/begin CHARACTERISTIC DTMOTKFT "" VALUE 0xFCED12 KwWU8 191.3 temp_ub_q0p75_o48 -48.00 143.3 FORMAT "%5.1" /end CHARACTERISTIC
/begin CHARACTERISTIC DUBTES "Delta ub-Schwelle f¸r Tankentl¸ftungsdiagnose" VALUE 0xFD491A KwWU16 25.59961 spg_q0p00039 0.00 25.59961 FORMAT "%8.5" /end CHARACTERISTIC
/begin CHARACTERISTIC DUBTESEO "Delta ub-Schwelle f¸r Tankentl¸ftungsdiagnose (CFC bei Fahrt)" VALUE 0xFD491C KwWU16 25.59961 spg_q0p00039 0.00 25.59961 FORMAT "%8.5" /end CHARACTERISTIC
/begin CHARACTERISTIC DWEKSN "delta Winkel Ersatz-Klopfsensor" CURVE 0xFC84C1 KlAxU8SstxU8WU8 191.3 zw_ub_qn0p75 -191.3 0.00 FORMAT "%5.1"
 /begin AXIS_DESCR STD_AXIS nmot nmot_ub_q40 8 0.00 10200. FORMAT "%5.0" DEPOSIT ABSOLUTE /end AXIS_DESCR
/end CHARACTERISTIC
/begin CHARACTERISTIC DWKRMSN "delta Winkel KR Abstand zur gemittelten Sp‰tverstellung" CURVE 0xFD2EB6 KlAUbSstUbWUb 191.3 zw_ub_qn0p75 -191.3 0.00 FORMAT "%5.1"
 /begin AXIS_DESCR STD_AXIS nmot nmot_ub_q40 16 0.00 10200. FORMAT "%5.0" DEPOSIT ABSOLUTE /end AXIS_DESCR
/end CHARACTERISTIC
/begin CHARACTERISTIC DYADMX "Max. Wert des add. Dynamikvorhalts" VALUE 0xFC84BA KwUb 24.00 zw_ub_qn0p75 -24.00 0.00 FORMAT "%5.2" /end CHARACTERISTIC
/begin CHARACTERISTIC DYAFVS "Stufenhˆhe f¸r Abregelung des Dynamikvorhalts" VALUE 0xFC84BB KwUb 19.50 zw_ub_q0p75 0.7500 20.25 FORMAT "%5.2" /end CHARACTERISTIC
/begin CHARACTERISTIC DYAMNV "Min. Wert des add. Dynamikvorhalts" VALUE 0xFC84BC KwUb 24.00 zw_ub_qn0p75 -24.00 0.00 FORMAT "%5.2" /end CHARACTERISTIC
/begin CHARACTERISTIC DYAVF "Abregelkonstante f¸r Dynamikvorhalt" VALUE 0xFC84BD KwUb 254.0 dez 1.000 255.0 FORMAT "%5.1" /end CHARACTERISTIC
/begin CHARACTERISTIC ENGENTANS "Schwelle Motortemperatur fuer Freigabe Generaturansaugluft" VALUE 0xFCB7A2 KwWU8 191.3 temp_ub_q0p75_o48 -48.00 143.3 FORMAT "%5.1" /end CHARACTERISTIC
/begin CHARACTERISTIC ENGENTANS2 "Schwelle Motortemperatur fuer Freigabe Generaturansaugluft" VALUE 0xFCBE2C KwWU8 191.3 temp_ub_q0p75_o48 -48.00 143.3 FORMAT "%5.1" /end CHARACTERISTIC
/begin CHARACTERISTIC EN_MDGEN "Enable Generatormomenteinrechung" VALUE 0xFCB7A3 KwWU8 255.0 DEZ 0.00 255.0 FORMAT "%5.1" /end CHARACTERISTIC
/begin CHARACTERISTIC EN_MDGEN2 "Enable Generatormomenteinrechung" VALUE 0xFCBE2D KwWU8 255.0 DEZ 0.00 255.0 FORMAT "%5.1" /end CHARACTERISTIC
/begin CHARACTERISTIC FIPTUBF "Faktor Pumpenstrom" CURVE 0xFD48EA KlAxU8SstxU16WU16 1.999969 fak_uw_b2 0.00 1.999969 FORMAT "%8.6"
 /begin AXIS_DESCR STD_AXIS ubtesf_w spg_q0p00039 9 0.00 25.59961 FORMAT "%8.5" DEPOSIT ABSOLUTE /end AXIS_DESCR
/end CHARACTERISTIC
/begin CHARACTERISTIC FKELDY "Korrekturfaktor f¸r Klopferkennungsschwelle bei Lastdynamik" VALUE 0xFC8730 KwUb 2.000 fak_ub_b4 0.00 2.000 FORMAT "%5.3" /end CHARACTERISTIC
/begin CHARACTERISTIC FKELDYA "Korrekturfaktor f¸r Klopferkennungsschwelle bei Lastdynamikadaption" VALUE 0xFC84BE KwUb 0.6250 fak_ub_b4 0.6250 1.250 FORMAT "%5.3" /end CHARACTERISTIC
/begin CHARACTERISTIC FKENDY "Korrekturfaktor f¸r Klopferkennungsschwelle bei Drehzahldynamik" VALUE 0xFC8731 KwUb 2.000 fak_ub_b4 0.00 2.000 FORMAT "%5.3" /end CHARACTERISTIC
/begin CHARACTERISTIC FKETM "Klopferkennungsfaktor unterhalb tmot-Schwelle" CURVE 0xFC8729 KlAxU8SstxU8WU8 3.984 fak_ub_b4 0.00 3.984 FORMAT "%5.3"
 /begin AXIS_DESCR STD_AXIS tmot temp_ub_q0p75_o48 3 -48.00 143.3 FORMAT "%5.1" DEPOSIT ABSOLUTE /end AXIS_DESCR
/end CHARACTERISTIC
/begin CHARACTERISTIC FMDKHFH "Hˆhenkorrektur Drehmomentenreserve f¸r Katheizen" CURVE 0xFD28A4 KlAUwSstUwWUw 1.999969 fak_uw_b2 0.00 1.999969 FORMAT "%8.6"
 /begin AXIS_DESCR STD_AXIS fho_w fak_uw_b4 4 0.00 3.999939 FORMAT "%8.6" DEPOSIT ABSOLUTE /end AXIS_DESCR
/end CHARACTERISTIC
/begin CHARACTERISTIC FMDKHTMST "tmst-Korrektur Drehmomentenresrve f¸r Katheizen" CURVE 0xFD288E KlAUbSstUbWUb 1.992 fak_ub_b2 0.00 1.992 FORMAT "%5.3"
 /begin AXIS_DESCR STD_AXIS tmst temp_ub_q0p75_o48 8 -48.00 143.3 FORMAT "%5.1" DEPOSIT ABSOLUTE /end AXIS_DESCR
/end CHARACTERISTIC
/begin CHARACTERISTIC GENDIFAK0 "Stromfaktor Diode0" VALUE 0xFCB7A4 KwWU8 0.9961 fak_q0p0039 0.00 0.9961 /end CHARACTERISTIC
/begin CHARACTERISTIC GENDIFAK02 "Stromfaktor Diode0" VALUE 0xFCBE2E KwWU8 0.9961 fak_q0p0039 0.00 0.9961 /end CHARACTERISTIC
/begin CHARACTERISTIC GENDIFAK1 "Stromfaktor Diode1" VALUE 0xFCB7A5 KwWU8 0.9961 fak_q0p0039 0.00 0.9961 /end CHARACTERISTIC
/begin CHARACTERISTIC GENDIFAK12 "Stromfaktor Diode1" VALUE 0xFCBE2F KwWU8 0.9961 fak_q0p0039 0.00 0.9961 /end CHARACTERISTIC
/begin CHARACTERISTIC GENDIFAK2 "Stromfaktor Diode2" VALUE 0xFCB7A6 KwWU8 0.9961 fak_q0p0039 0.00 0.9961 /end CHARACTERISTIC
/begin CHARACTERISTIC GENDIFAK22 "Stromfaktor Diode2" VALUE 0xFCBE30 KwWU8 0.9961 fak_q0p0039 0.00 0.9961 /end CHARACTERISTIC
/begin CHARACTERISTIC GENDIFAK3 "Stromfaktor Diode3" VALUE 0xFCB7A7 KwWU8 0.9961 fak_q0p0039 0.00 0.9961 /end CHARACTERISTIC
/begin CHARACTERISTIC GENDIFAK4 "Stromfaktor Diode4" VALUE 0xFCB7A8 KwWU8 0.9961 fak_q0p0039 0.00 0.9961 /end CHARACTERISTIC
/begin CHARACTERISTIC GENDIFAK5 "Stromfaktor Diode" VALUE 0xFCB7A9 KwWU8 0.9961 fak_q0p0039 0.00 0.9961 /end CHARACTERISTIC
/begin CHARACTERISTIC GENDIFAK6 "Stromfaktor Diode6" VALUE 0xFCB7AA KwWU8 0.9961 fak_q0p0039 0.00 0.9961 /end CHARACTERISTIC
/begin CHARACTERISTIC GENDIFAK7 "Stromfaktor Diode7" VALUE 0xFCB7AB KwWU8 0.9961 fak_q0p0039 0.00 0.9961 /end CHARACTERISTIC
/begin CHARACTERISTIC GENITYP "Generatorstrotyp 0=gerechnet / 1=gemessen" VALUE 0xFCB7AC KwWU8 1.000 dez 0.00 1.000 FORMAT "%5.3" /end CHARACTERISTIC
/begin CHARACTERISTIC GENITYP2 "Generatorstrotyp 0=gerechnet / 1=gemessen" VALUE 0xFCBE31 KwWU8 1.000 dez 0.00 1.000 FORMAT "%5.3" /end CHARACTERISTIC
/begin CHARACTERISTIC GENMDOF "Offset des Generatormoments" VALUE 0xFCB722 KwWU16 99.99847 rel_uw_b100 0.00 99.99847 FORMAT "%8.5" /end CHARACTERISTIC
/begin CHARACTERISTIC GENMDOF2 "Offset des Generatormoments" VALUE 0xFCBDF2 KwWU16 99.99847 rel_uw_b100 0.00 99.99847 FORMAT "%8.5" /end CHARACTERISTIC
/begin CHARACTERISTIC GENRS0_0 "Generatorstatorwiderstand0 bei 25∞" VALUE 0xFCB724 KwWU16 0.9999847 genrstator 0.00 0.9999847 FORMAT "%9.7" /end CHARACTERISTIC
/begin CHARACTERISTIC GENRS0_02 "Generatorstatorwiderstand0 bei 25∞" VALUE 0xFCBDF4 KwWU16 0.9999847 genrstator 0.00 0.9999847 FORMAT "%9.7" /end CHARACTERISTIC
/begin CHARACTERISTIC GENRS0_1 "Generatorstatorwiderstand1 bei 25∞" VALUE 0xFCB726 KwWU16 0.9999847 genrstator 0.00 0.9999847 FORMAT "%9.7" /end CHARACTERISTIC
/begin CHARACTERISTIC GENRS0_12 "Generatorstatorwiderstand1 bei 25∞" VALUE 0xFCBDF6 KwWU16 0.9999847 genrstator 0.00 0.9999847 FORMAT "%9.7" /end CHARACTERISTIC
/begin CHARACTERISTIC GENRS0_2 "Generatorstatorwiderstand2 bei 25∞" VALUE 0xFCB728 KwWU16 0.9999847 genrstator 0.00 0.9999847 FORMAT "%9.7" /end CHARACTERISTIC
/begin CHARACTERISTIC GENRS0_22 "Generatorstatorwiderstand2 bei 25∞" VALUE 0xFCBDF8 KwWU16 0.9999847 genrstator 0.00 0.9999847 FORMAT "%9.7" /end CHARACTERISTIC
/begin CHARACTERISTIC GENRS0_3 "Generatorstatorwiderstand3 bei 25∞" VALUE 0xFCB72A KwWU16 0.9999847 genrstator 0.00 0.9999847 FORMAT "%9.7" /end CHARACTERISTIC
/begin CHARACTERISTIC GENRS0_4 "Generatorstatorwiderstand4 bei 25∞" VALUE 0xFCB72C KwWU16 0.9999847 genrstator 0.00 0.9999847 FORMAT "%9.7" /end CHARACTERISTIC
/begin CHARACTERISTIC GENRS0_5 "Generatorstatorwiderstand5 bei 25∞" VALUE 0xFCB72E KwWU16 0.9999847 genrstator 0.00 0.9999847 FORMAT "%9.7" /end CHARACTERISTIC
/begin CHARACTERISTIC GENRS0_6 "Generatorstatorwiderstand6 bei 25∞" VALUE 0xFCB730 KwWU16 0.9999847 genrstator 0.00 0.9999847 FORMAT "%9.7" /end CHARACTERISTIC
/begin CHARACTERISTIC GENRS0_7 "Generatorstatorwiderstand7 bei 25∞" VALUE 0xFCB732 KwWU16 0.9999847 genrstator 0.00 0.9999847 FORMAT "%9.7" /end CHARACTERISTIC
/begin CHARACTERISTIC GENSTFAK0 "Stromfaktor Statorspule0" VALUE 0xFCB7AD KwWU8 0.9961 fak_q0p0039 0.00 0.9961 /end CHARACTERISTIC
/begin CHARACTERISTIC GENSTFAK02 "Stromfaktor Statorspule0" VALUE 0xFCBE32 KwWU8 0.9961 fak_q0p0039 0.00 0.9961 /end CHARACTERISTIC
/begin CHARACTERISTIC GENSTFAK1 "Stromfaktor Statorspule" VALUE 0xFCB7AE KwWU8 0.9961 fak_q0p0039 0.00 0.9961 /end CHARACTERISTIC
/begin CHARACTERISTIC GENSTFAK12 "Stromfaktor Statorspule1" VALUE 0xFCBE33 KwWU8 0.9961 fak_q0p0039 0.00 0.9961 /end CHARACTERISTIC
/begin CHARACTERISTIC GENSTFAK2 "Stromfaktor Statorspule2" VALUE 0xFCB7AF KwWU8 0.9961 fak_q0p0039 0.00 0.9961 /end CHARACTERISTIC
/begin CHARACTERISTIC GENSTFAK22 "Stromfaktor Statorspule2" VALUE 0xFCBE34 KwWU8 0.9961 fak_q0p0039 0.00 0.9961 /end CHARACTERISTIC
/begin CHARACTERISTIC GENSTFAK3 "Stromfaktor Statorspule3" VALUE 0xFCB7B0 KwWU8 0.9961 fak_q0p0039 0.00 0.9961 /end CHARACTERISTIC
/begin CHARACTERISTIC GENSTFAK4 "Stromfaktor Statorspule4" VALUE 0xFCB7B1 KwWU8 0.9961 fak_q0p0039 0.00 0.9961 /end CHARACTERISTIC
/begin CHARACTERISTIC GENSTFAK5 "Stromfaktor Statorspule5" VALUE 0xFCB7B2 KwWU8 0.9961 fak_q0p0039 0.00 0.9961 /end CHARACTERISTIC
/begin CHARACTERISTIC GENSTFAK6 "Stromfaktor Statorspule6" VALUE 0xFCB7B3 KwWU8 0.9961 fak_q0p0039 0.00 0.9961 /end CHARACTERISTIC
/begin CHARACTERISTIC GENSTFAK7 "Stromfaktor Statorspule7" VALUE 0xFCB7B4 KwWU8 0.9961 fak_q0p0039 0.00 0.9961 /end CHARACTERISTIC
/begin CHARACTERISTIC GENTEMPAP2 "Geneeratortemperatur mauelle Vorgabe" VALUE 0xFCBDFA KwWU16 384.0000 temp_uw_q0p75_o48 -48.00000 336.0000 FORMAT "%8.4" /end CHARACTERISTIC
/begin CHARACTERISTIC GENTEMPAPP "Geneeratortemperatur mauelle Vorgabe" VALUE 0xFCB734 KwWU16 384.0000 temp_uw_q0p75_o48 -48.00000 336.0000 FORMAT "%8.4" /end CHARACTERISTIC
/begin CHARACTERISTIC GENTEMPMA2 "Manuelle Generatorvorgabe" VALUE 0xFCBE35 KwWU8 255.0 dez 0.00 255.0 FORMAT "%5.1" /end CHARACTERISTIC
/begin CHARACTERISTIC GENTEMPMAN "Manuelle Generatorvorgabe" VALUE 0xFCB7B5 KwWU8 255.0 dez 0.00 255.0 FORMAT "%5.1" /end CHARACTERISTIC
/begin CHARACTERISTIC GENTMOTDT "Offset Generatorwassertemperatur" VALUE 0xFCB7B6 KwWU8 191.3 temp_ub_q0p75_o48 -48.00 143.3 FORMAT "%5.1" /end CHARACTERISTIC
/begin CHARACTERISTIC GENTMOTDT2 "Offset Generatorwassertemperatur" VALUE 0xFCBE36 KwWU8 191.3 temp_ub_q0p75_o48 -48.00 143.3 FORMAT "%5.1" /end CHARACTERISTIC
/begin CHARACTERISTIC GENTMOTO02 "Offset Generatoransaugluft" VALUE 0xFCBE37 KwWU8 191.3 temp_ub_q0p75_o48 -48.00 143.3 FORMAT "%5.1" /end CHARACTERISTIC
/begin CHARACTERISTIC GENTMOTO12 "Offset Generatoransaugluft" VALUE 0xFCBE38 KwWU8 191.3 temp_ub_q0p75_o48 -48.00 143.3 FORMAT "%5.1" /end CHARACTERISTIC
/begin CHARACTERISTIC GENTMOTO22 "Offset Generatoransaugluft" VALUE 0xFCBE39 KwWU8 191.3 temp_ub_q0p75_o48 -48.00 143.3 FORMAT "%5.1" /end CHARACTERISTIC
/begin CHARACTERISTIC GENTMOTOF0 "" VALUE 0xFCB7B7 KwWU8 191.3 temp_ub_q0p75_o48 -48.00 143.3 FORMAT "%5.1" /end CHARACTERISTIC
/begin CHARACTERISTIC GENTMOTOF1 "" VALUE 0xFCB7B8 KwWU8 191.3 temp_ub_q0p75_o48 -48.00 143.3 FORMAT "%5.1" /end CHARACTERISTIC
/begin CHARACTERISTIC GENTMOTOF2 "" VALUE 0xFCB7B9 KwWU8 191.3 temp_ub_q0p75_o48 -48.00 143.3 FORMAT "%5.1" /end CHARACTERISTIC
/begin CHARACTERISTIC GENTMOTOF3 "" VALUE 0xFCB7BA KwWU8 191.3 temp_ub_q0p75_o48 -48.00 143.3 FORMAT "%5.1" /end CHARACTERISTIC
/begin CHARACTERISTIC GENTMOTOF4 "" VALUE 0xFCB7BB KwWU8 191.3 temp_ub_q0p75_o48 -48.00 143.3 FORMAT "%5.1" /end CHARACTERISTIC
/begin CHARACTERISTIC GENTMOTOF5 "" VALUE 0xFCB7BC KwWU8 191.3 temp_ub_q0p75_o48 -48.00 143.3 FORMAT "%5.1" /end CHARACTERISTIC
/begin CHARACTERISTIC GENTMOTOF6 "" VALUE 0xFCB7BD KwWU8 191.3 temp_ub_q0p75_o48 -48.00 143.3 FORMAT "%5.1" /end CHARACTERISTIC
/begin CHARACTERISTIC GENTMOTOF7 "" VALUE 0xFCB7BE KwWU8 191.3 temp_ub_q0p75_o48 -48.00 143.3 FORMAT "%5.1" /end CHARACTERISTIC
/begin CHARACTERISTIC GENTYP "Generatortyp" VALUE 0xFCB7BF KwWU8 255.0 dez 0.00 255.0 FORMAT "%5.1" /end CHARACTERISTIC
/begin CHARACTERISTIC GENTYP2 "Generatortyp" VALUE 0xFCBE3A KwWU8 255.0 dez 0.00 255.0 FORMAT "%5.1" /end CHARACTERISTIC
/begin CHARACTERISTIC GENTYPFEL2 "Generatorkennfeldzuordnung" VAL_BLK 0xFCBDD1 KwbWU8 255.0 DEZ 0.00 255.0 FORMAT "%5.1" NUMBER 32 /end CHARACTERISTIC
/begin CHARACTERISTIC GENTYPFELD "Generatorkennfeldzuordnung" VAL_BLK 0xFCB702 KwbWU8 255.0 DEZ 0.00 255.0 FORMAT "%5.1" NUMBER 32 /end CHARACTERISTIC
/begin CHARACTERISTIC GENUEBSET02 "" VALUE 0xFCBE3B KwWU8 3.984 genuebsetzung2 0.00 3.984 FORMAT "%5.3" /end CHARACTERISTIC
/begin CHARACTERISTIC GENUEBSET12 "" VALUE 0xFCBE3C KwWU8 3.984 genuebsetzung2 0.00 3.984 FORMAT "%5.3" /end CHARACTERISTIC
/begin CHARACTERISTIC GENUEBSET22 "" VALUE 0xFCBE3D KwWU8 3.984 genuebsetzung2 0.00 3.984 FORMAT "%5.3" /end CHARACTERISTIC
/begin CHARACTERISTIC GENUEBSETZ0 "" VALUE 0xFCB7C0 KwWU8 3.984 genuebsetzung2 0.00 3.984 FORMAT "%5.3" /end CHARACTERISTIC
/begin CHARACTERISTIC GENUEBSETZ1 "" VALUE 0xFCB7C1 KwWU8 3.984 genuebsetzung2 0.00 3.984 FORMAT "%5.3" /end CHARACTERISTIC
/begin CHARACTERISTIC GENUEBSETZ2 "" VALUE 0xFCB7C2 KwWU8 3.984 genuebsetzung2 0.00 3.984 FORMAT "%5.3" /end CHARACTERISTIC
/begin CHARACTERISTIC GENUEBSETZ3 "" VALUE 0xFCB7C3 KwWU8 3.984 genuebsetzung2 0.00 3.984 FORMAT "%5.3" /end CHARACTERISTIC
/begin CHARACTERISTIC GENUEBSETZ4 "" VALUE 0xFCB7C4 KwWU8 3.984 genuebsetzung2 0.00 3.984 FORMAT "%5.3" /end CHARACTERISTIC
/begin CHARACTERISTIC GENUEBSETZ5 "" VALUE 0xFCB7C5 KwWU8 3.984 genuebsetzung2 0.00 3.984 FORMAT "%5.3" /end CHARACTERISTIC
/begin CHARACTERISTIC GENUEBSETZ6 "" VALUE 0xFCB7C6 KwWU8 3.984 genuebsetzung2 0.00 3.984 FORMAT "%5.3" /end CHARACTERISTIC
/begin CHARACTERISTIC GENUEBSETZ7 "" VALUE 0xFCB7C7 KwWU8 3.984 genuebsetzung2 0.00 3.984 FORMAT "%5.3" /end CHARACTERISTIC
/begin CHARACTERISTIC GENUMGTYP "Generatorluftumgebung" VALUE 0xFCB7C8 KwWU8 255.0 dez 0.00 255.0 FORMAT "%5.1" /end CHARACTERISTIC
/begin CHARACTERISTIC GENUMGTYP2 "Generatorluftumgebung" VALUE 0xFCBE3E KwWU8 255.0 dez 0.00 255.0 FORMAT "%5.1" /end CHARACTERISTIC
/begin CHARACTERISTIC GENVFZGSW "geschwindigkeitsabh‰ngige Generatoransaugluftschwelle" VALUE 0xFCB7C9 KwWU8 318.8 vfzg_ub_q1p25 0.00 318.8 FORMAT "%5.1" /end CHARACTERISTIC
/begin CHARACTERISTIC GENVFZGSW2 "geschwindigkeitsabh‰ngige Generatoransaugluftschwelle" VALUE 0xFCBE3F KwWU8 318.8 vfzg_ub_q1p25 0.00 318.8 FORMAT "%5.1" /end CHARACTERISTIC
/begin CHARACTERISTIC GEN_IG_OF "Offsetwert Generatorstrom" VALUE 0xFCB736 KwWU16 254.0000 igen_uw_q0p03125 0.00 254.0000 FORMAT "%8.4" /end CHARACTERISTIC
/begin CHARACTERISTIC GEN_IG_OF2 "Offsetwert Generatorstrom" VALUE 0xFCBDFC KwWU16 254.0000 igen_uw_q0p03125 0.00 254.0000 FORMAT "%8.4" /end CHARACTERISTIC
/begin CHARACTERISTIC GIPTESS "Schwelle f¸r zweite Ableitung des Pumpstroms bei Einbruchserkennung" VALUE 0xFD491E KwWS16 399.9939 i_q6p1035_uA -200.0000 199.9939 FORMAT "%8.4" /end CHARACTERISTIC
/begin CHARACTERISTIC IGBASIS "" VALUE 0xFCB7CA KwWU8 255.0 igen_ub_q1 0.00 255.0 FORMAT "%5.1" /end CHARACTERISTIC
/begin CHARACTERISTIC IGBASIS2 "Generatorgrundstrombedarf FZG" VALUE 0xFCBE40 KwWU8 255.0 igen_ub_q1 0.00 255.0 FORMAT "%5.1" /end CHARACTERISTIC
/begin CHARACTERISTIC IGBASISOF2 "Generatorgrundstrombedarf FZG bei Genred" VALUE 0xFCBE41 KwWU8 255.0 igen_ub_q1 0.00 255.0 FORMAT "%5.1" /end CHARACTERISTIC
/begin CHARACTERISTIC IGBASISOFF "" VALUE 0xFCB7CB KwWU8 255.0 igen_ub_q1 0.00 255.0 FORMAT "%5.1" /end CHARACTERISTIC
/begin CHARACTERISTIC IGNOTWERT "" VALUE 0xFCB7CC KwWU8 255.0 igen_ub_q1 0.00 255.0 FORMAT "%5.1" /end CHARACTERISTIC
/begin CHARACTERISTIC KE1NL "Klopferkennungsschwelle bei Zylinderz‰hler 1 f(n,rl)" MAP 0xFC84E9 GkfWU8 3.984 fak_ub_b4 0.00 3.984 FORMAT "%5.3"
 /begin AXIS_DESCR COM_AXIS nmot nmot_ub_q40 16 0.00 10200. FORMAT "%5.0" AXIS_PTS_REF SNM16KRUB /end AXIS_DESCR
 /begin AXIS_DESCR COM_AXIS rl rel_ub_q0p75 4 0.00 191.3 FORMAT "%5.1" AXIS_PTS_REF SRL04KRUB /end AXIS_DESCR
/end CHARACTERISTIC
/begin CHARACTERISTIC KE2NL "Klopferkennungsschwelle bei Zylinderz‰hler 2 f(n,rl)" MAP 0xFC8529 GkfWU8 3.984 fak_ub_b4 0.00 3.984 FORMAT "%5.3"
 /begin AXIS_DESCR COM_AXIS nmot nmot_ub_q40 16 0.00 10200. FORMAT "%5.0" AXIS_PTS_REF SNM16KRUB /end AXIS_DESCR
 /begin AXIS_DESCR COM_AXIS rl rel_ub_q0p75 4 0.00 191.3 FORMAT "%5.1" AXIS_PTS_REF SRL04KRUB /end AXIS_DESCR
/end CHARACTERISTIC
/begin CHARACTERISTIC KE3NL "Klopferkennungsschwelle bei Zylinderz‰hler 3 f(n,rl)" MAP 0xFC8569 GkfWU8 3.984 fak_ub_b4 0.00 3.984 FORMAT "%5.3"
 /begin AXIS_DESCR COM_AXIS nmot nmot_ub_q40 16 0.00 10200. FORMAT "%5.0" AXIS_PTS_REF SNM16KRUB /end AXIS_DESCR
 /begin AXIS_DESCR COM_AXIS rl rel_ub_q0p75 4 0.00 191.3 FORMAT "%5.1" AXIS_PTS_REF SRL04KRUB /end AXIS_DESCR
/end CHARACTERISTIC
/begin CHARACTERISTIC KE4NL "Klopferkennungsschwelle bei Zylinderz‰hler 4 f(n,rl)" MAP 0xFC85A9 GkfWU8 3.984 fak_ub_b4 0.00 3.984 FORMAT "%5.3"
 /begin AXIS_DESCR COM_AXIS nmot nmot_ub_q40 16 0.00 10200. FORMAT "%5.0" AXIS_PTS_REF SNM16KRUB /end AXIS_DESCR
 /begin AXIS_DESCR COM_AXIS rl rel_ub_q0p75 4 0.00 191.3 FORMAT "%5.1" AXIS_PTS_REF SRL04KRUB /end AXIS_DESCR
/end CHARACTERISTIC
/begin CHARACTERISTIC KE5NL "Klopferkennungsschwelle bei Zylinderz‰hler 5 f(n,rl)" MAP 0xFC85E9 GkfWU8 3.984 fak_ub_b4 0.00 3.984 FORMAT "%5.3"
 /begin AXIS_DESCR COM_AXIS nmot nmot_ub_q40 16 0.00 10200. FORMAT "%5.0" AXIS_PTS_REF SNM16KRUB /end AXIS_DESCR
 /begin AXIS_DESCR COM_AXIS rl rel_ub_q0p75 4 0.00 191.3 FORMAT "%5.1" AXIS_PTS_REF SRL04KRUB /end AXIS_DESCR
/end CHARACTERISTIC
/begin CHARACTERISTIC KE6NL "Klopferkennungsschwelle bei Zylinderz‰hler 6 f(n,rl)" MAP 0xFC8629 GkfWU8 3.984 fak_ub_b4 0.00 3.984 FORMAT "%5.3"
 /begin AXIS_DESCR COM_AXIS nmot nmot_ub_q40 16 0.00 10200. FORMAT "%5.0" AXIS_PTS_REF SNM16KRUB /end AXIS_DESCR
 /begin AXIS_DESCR COM_AXIS rl rel_ub_q0p75 4 0.00 191.3 FORMAT "%5.1" AXIS_PTS_REF SRL04KRUB /end AXIS_DESCR
/end CHARACTERISTIC
/begin CHARACTERISTIC KE7NL "Klopferkennungsschwelle bei Zylinderz‰hler 7 f(n,rl)" MAP 0xFC8669 GkfWU8 3.984 fak_ub_b4 0.00 3.984 FORMAT "%5.3"
 /begin AXIS_DESCR COM_AXIS nmot nmot_ub_q40 16 0.00 10200. FORMAT "%5.0" AXIS_PTS_REF SNM16KRUB /end AXIS_DESCR
 /begin AXIS_DESCR COM_AXIS rl rel_ub_q0p75 4 0.00 191.3 FORMAT "%5.1" AXIS_PTS_REF SRL04KRUB /end AXIS_DESCR
/end CHARACTERISTIC
/begin CHARACTERISTIC KE8NL "Klopferkennungsschwelle bei Zylinderz‰hler 8 f(n,rl)" MAP 0xFC86A9 GkfWU8 3.984 fak_ub_b4 0.00 3.984 FORMAT "%5.3"
 /begin AXIS_DESCR COM_AXIS nmot nmot_ub_q40 16 0.00 10200. FORMAT "%5.0" AXIS_PTS_REF SNM16KRUB /end AXIS_DESCR
 /begin AXIS_DESCR COM_AXIS rl rel_ub_q0p75 4 0.00 191.3 FORMAT "%5.1" AXIS_PTS_REF SRL04KRUB /end AXIS_DESCR
/end CHARACTERISTIC
/begin CHARACTERISTIC KEREFF "Tiefpassverhalten normal" CURVE 0xFD3076 KlAUbSstUbWUb 99.22 rel_ub_b100 0.3906 99.61 FORMAT "%5.2"
 /begin AXIS_DESCR STD_AXIS nmot nmot_ub_q40 6 0.00 10200. FORMAT "%5.0" DEPOSIT ABSOLUTE /end AXIS_DESCR
/end CHARACTERISTIC
/begin CHARACTERISTIC KEREFLDY "Tiefpassverhalten bei Lastdynamik" CURVE 0xFD3083 KlAUbSstUbWUb 99.22 rel_ub_b100 0.3906 99.61 FORMAT "%5.2"
 /begin AXIS_DESCR STD_AXIS nmot nmot_ub_q40 6 0.00 10200. FORMAT "%5.0" DEPOSIT ABSOLUTE /end AXIS_DESCR
/end CHARACTERISTIC
/begin CHARACTERISTIC KEREFNDY "Tiefpassverhalten bei Drehzahldynamik" CURVE 0xFD3090 KlAUbSstUbWUb 99.22 rel_ub_b100 0.3906 99.61 FORMAT "%5.2"
 /begin AXIS_DESCR STD_AXIS nmot nmot_ub_q40 6 0.00 10200. FORMAT "%5.0" DEPOSIT ABSOLUTE /end AXIS_DESCR
/end CHARACTERISTIC
/begin CHARACTERISTIC KFDYES "Lastdynamikerkennungsschwelle" MAP 0xFC833A GkfWS16 799.9756 relDK_q0p02441 0.00 799.9756 FORMAT "%8.4"
 /begin AXIS_DESCR COM_AXIS nmot_w nmot_uw_q0p25 8 0.00 16383.75 FORMAT "%8.2" AXIS_PTS_REF SNM08KRUW /end AXIS_DESCR
 /begin AXIS_DESCR COM_AXIS wdkba_w relDK_q0p02441 6 -800.0000 799.9756 FORMAT "%8.4" AXIS_PTS_REF SWD06KRSW /end AXIS_DESCR
/end CHARACTERISTIC
/begin CHARACTERISTIC KFDYESEH "Lastdynamikerkennungsschwelle" MAP 0xFC839A GkfWS16 32.76700 hub_uw_q0p001 0.00 32.76700 FORMAT "%8.5"
 /begin AXIS_DESCR COM_AXIS nmot_w nmot_uw_q0p25 8 0.00 16383.75 FORMAT "%8.2" AXIS_PTS_REF SNM08KRUW /end AXIS_DESCR
 /begin AXIS_DESCR COM_AXIS evhubi_w hub_uw_q0p001 6 0.00 65.53500 FORMAT "%8.5" AXIS_PTS_REF SEH06KRUW /end AXIS_DESCR
/end CHARACTERISTIC
/begin CHARACTERISTIC KFDYESEHOF "Dynamikvorhalt Offsetschwelle" MAP 0xFC83FA GkfWS16 32.76700 hub_uw_q0p001 0.00 32.76700 FORMAT "%8.5"
 /begin AXIS_DESCR COM_AXIS nmot_w nmot_uw_q0p25 8 0.00 16383.75 FORMAT "%8.2" AXIS_PTS_REF SNM08KRUW /end AXIS_DESCR
 /begin AXIS_DESCR COM_AXIS evhubi_w hub_uw_q0p001 6 0.00 65.53500 FORMAT "%8.5" AXIS_PTS_REF SEH06KRUW /end AXIS_DESCR
/end CHARACTERISTIC
/begin CHARACTERISTIC KFDYESOF "Dynamikvorhalt Offsetschwelle" MAP 0xFC845A GkfWS16 799.9756 relDK_q0p02441 0.00 799.9756 FORMAT "%8.4"
 /begin AXIS_DESCR COM_AXIS nmot_w nmot_uw_q0p25 8 0.00 16383.75 FORMAT "%8.2" AXIS_PTS_REF SNM08KRUW /end AXIS_DESCR
 /begin AXIS_DESCR COM_AXIS wdkba_w relDK_q0p02441 6 -800.0000 799.9756 FORMAT "%8.4" AXIS_PTS_REF SWD06KRSW /end AXIS_DESCR
/end CHARACTERISTIC
/begin CHARACTERISTIC KFDYWVS "vorgesteuerter Dynamikvorhalt" MAP 0xFD2DFF KfAxUbAyUbSstxUbSstyUbWUb 191.3 zw_ub_qn0p75 -191.3 0.00 FORMAT "%5.1"
 /begin AXIS_DESCR STD_AXIS tans temp_ub_q0p75_o48 6 -48.00 143.3 FORMAT "%5.1" DEPOSIT ABSOLUTE /end AXIS_DESCR
 /begin AXIS_DESCR STD_AXIS nmot nmot_ub_q40 6 0.00 10200. FORMAT "%5.0" DEPOSIT ABSOLUTE /end AXIS_DESCR
/end CHARACTERISTIC
/begin CHARACTERISTIC KFGENWET02 "Wirkungsgrad0 Generator mit 2*PI" MAP 0xFCB7DC KfAxU8AyU8SstxU8SstyU16WU8 7.969 geneta_q0p03125 0.00 7.969 FORMAT "%5.3"
 /begin AXIS_DESCR STD_AXIS igm2 igen_ub_q1 8 0.00 255.0 FORMAT "%5.1" DEPOSIT ABSOLUTE /end AXIS_DESCR
 /begin AXIS_DESCR STD_AXIS ngen_w2 ngen_uw_q0p5 8 0.00 32767.50 FORMAT "%8.2" DEPOSIT ABSOLUTE /end AXIS_DESCR
/end CHARACTERISTIC
/begin CHARACTERISTIC KFGENWET12 "Wirkungsgrad1 Generator mit 2*PI" MAP 0xFCB836 KfAxU8AyU8SstxU8SstyU16WU8 7.969 geneta_q0p03125 0.00 7.969 FORMAT "%5.3"
 /begin AXIS_DESCR STD_AXIS igm2 igen_ub_q1 8 0.00 255.0 FORMAT "%5.1" DEPOSIT ABSOLUTE /end AXIS_DESCR
 /begin AXIS_DESCR STD_AXIS ngen_w2 ngen_uw_q0p5 8 0.00 32767.50 FORMAT "%8.2" DEPOSIT ABSOLUTE /end AXIS_DESCR
/end CHARACTERISTIC
/begin CHARACTERISTIC KFGENWET22 "Wirkungsgrad2 Generator mit 2*PI" MAP 0xFCB890 KfAxU8AyU8SstxU8SstyU16WU8 7.969 geneta_q0p03125 0.00 7.969 FORMAT "%5.3"
 /begin AXIS_DESCR STD_AXIS igm2 igen_ub_q1 8 0.00 255.0 FORMAT "%5.1" DEPOSIT ABSOLUTE /end AXIS_DESCR
 /begin AXIS_DESCR STD_AXIS ngen_w2 ngen_uw_q0p5 8 0.00 32767.50 FORMAT "%8.2" DEPOSIT ABSOLUTE /end AXIS_DESCR
/end CHARACTERISTIC
/begin CHARACTERISTIC KFGENWETA0 "Wirkungsgrad0 Generator mit 2*PI" MAP 0xFCA740 KfAxU8AyU8SstxU8SstyU16WU8 7.969 geneta_q0p03125 0.00 7.969 FORMAT "%5.3"
 /begin AXIS_DESCR STD_AXIS igm igen_ub_q1 8 0.00 255.0 FORMAT "%5.1" DEPOSIT ABSOLUTE /end AXIS_DESCR
 /begin AXIS_DESCR STD_AXIS ngen_w ngen_uw_q0p5 8 0.00 32767.50 FORMAT "%8.2" DEPOSIT ABSOLUTE /end AXIS_DESCR
/end CHARACTERISTIC
/begin CHARACTERISTIC KFGENWETA1 "Wirkungsgrad1 Generator mit 2*PI" MAP 0xFCA79A KfAxU8AyU8SstxU8SstyU16WU8 7.969 geneta_q0p03125 0.00 7.969 FORMAT "%5.3"
 /begin AXIS_DESCR STD_AXIS igm igen_ub_q1 8 0.00 255.0 FORMAT "%5.1" DEPOSIT ABSOLUTE /end AXIS_DESCR
 /begin AXIS_DESCR STD_AXIS ngen_w ngen_uw_q0p5 8 0.00 32767.50 FORMAT "%8.2" DEPOSIT ABSOLUTE /end AXIS_DESCR
/end CHARACTERISTIC
/begin CHARACTERISTIC KFGENWETA2 "Wirkungsgrad2 Generator mit 2*PI" MAP 0xFCA7F4 KfAxU8AyU8SstxU8SstyU16WU8 7.969 geneta_q0p03125 0.00 7.969 FORMAT "%5.3"
 /begin AXIS_DESCR STD_AXIS igm igen_ub_q1 8 0.00 255.0 FORMAT "%5.1" DEPOSIT ABSOLUTE /end AXIS_DESCR
 /begin AXIS_DESCR STD_AXIS ngen_w ngen_uw_q0p5 8 0.00 32767.50 FORMAT "%8.2" DEPOSIT ABSOLUTE /end AXIS_DESCR
/end CHARACTERISTIC
/begin CHARACTERISTIC KFGENWETA3 "Wirkungsgrad3 Generator mit 2*PI" MAP 0xFCA84E KfAxU8AyU8SstxU8SstyU16WU8 7.969 geneta_q0p03125 0.00 7.969 FORMAT "%5.3"
 /begin AXIS_DESCR STD_AXIS igm igen_ub_q1 8 0.00 255.0 FORMAT "%5.1" DEPOSIT ABSOLUTE /end AXIS_DESCR
 /begin AXIS_DESCR STD_AXIS ngen_w ngen_uw_q0p5 8 0.00 32767.50 FORMAT "%8.2" DEPOSIT ABSOLUTE /end AXIS_DESCR
/end CHARACTERISTIC
/begin CHARACTERISTIC KFGENWETA4 "Wirkungsgrad4 Generator mit 2*PI" MAP 0xFCA8A8 KfAxU8AyU8SstxU8SstyU16WU8 7.969 geneta_q0p03125 0.00 7.969 FORMAT "%5.3"
 /begin AXIS_DESCR STD_AXIS igm igen_ub_q1 8 0.00 255.0 FORMAT "%5.1" DEPOSIT ABSOLUTE /end AXIS_DESCR
 /begin AXIS_DESCR STD_AXIS ngen_w ngen_uw_q0p5 8 0.00 32767.50 FORMAT "%8.2" DEPOSIT ABSOLUTE /end AXIS_DESCR
/end CHARACTERISTIC
/begin CHARACTERISTIC KFGENWETA5 "Wirkungsgrad5 Generator mit 2*PI" MAP 0xFCA902 KfAxU8AyU8SstxU8SstyU16WU8 7.969 geneta_q0p03125 0.00 7.969 FORMAT "%5.3"
 /begin AXIS_DESCR STD_AXIS igm igen_ub_q1 8 0.00 255.0 FORMAT "%5.1" DEPOSIT ABSOLUTE /end AXIS_DESCR
 /begin AXIS_DESCR STD_AXIS ngen_w ngen_uw_q0p5 8 0.00 32767.50 FORMAT "%8.2" DEPOSIT ABSOLUTE /end AXIS_DESCR
/end CHARACTERISTIC
/begin CHARACTERISTIC KFGENWETA6 "Wirkungsgrad6 Generator mit 2*PI" MAP 0xFCA95C KfAxU8AyU8SstxU8SstyU16WU8 7.969 geneta_q0p03125 0.00 7.969 FORMAT "%5.3"
 /begin AXIS_DESCR STD_AXIS igm igen_ub_q1 8 0.00 255.0 FORMAT "%5.1" DEPOSIT ABSOLUTE /end AXIS_DESCR
 /begin AXIS_DESCR STD_AXIS ngen_w ngen_uw_q0p5 8 0.00 32767.50 FORMAT "%8.2" DEPOSIT ABSOLUTE /end AXIS_DESCR
/end CHARACTERISTIC
/begin CHARACTERISTIC KFGENWETA7 "Wirkungsgrad7 Generator mit 2*PI" MAP 0xFCA9B6 KfAxU8AyU8SstxU8SstyU16WU8 7.969 geneta_q0p03125 0.00 7.969 FORMAT "%5.3"
 /begin AXIS_DESCR STD_AXIS igm igen_ub_q1 8 0.00 255.0 FORMAT "%5.1" DEPOSIT ABSOLUTE /end AXIS_DESCR
 /begin AXIS_DESCR STD_AXIS ngen_w ngen_uw_q0p5 8 0.00 32767.50 FORMAT "%8.2" DEPOSIT ABSOLUTE /end AXIS_DESCR
/end CHARACTERISTIC
/begin CHARACTERISTIC KFIGENDF0 "Generatorstrom0 DF-Kennfeld" MAP 0xFCAEF0 KfAxU8AyU8SstxU8SstyU8WU8 255.0 igen_ub_q1 0.00 255.0 FORMAT "%5.1"
 /begin AXIS_DESCR STD_AXIS dffgen rel_ub_b100 7 0.00 99.61 FORMAT "%5.2" DEPOSIT ABSOLUTE /end AXIS_DESCR
 /begin AXIS_DESCR STD_AXIS genitemp igen_ub_q1 8 0.00 255.0 FORMAT "%5.1" DEPOSIT ABSOLUTE /end AXIS_DESCR
/end CHARACTERISTIC
/begin CHARACTERISTIC KFIGENDF02 "Generatorstrom0 DF-Kennfeld" MAP 0xFCBABE KfAxU8AyU8SstxU8SstyU8WU8 255.0 igen_ub_q1 0.00 255.0 FORMAT "%5.1"
 /begin AXIS_DESCR STD_AXIS dffgen2 rel_ub_b100 7 0.00 99.61 FORMAT "%5.2" DEPOSIT ABSOLUTE /end AXIS_DESCR
 /begin AXIS_DESCR STD_AXIS genitemp_2 igen_ub_q1 8 0.00 255.0 FORMAT "%5.1" DEPOSIT ABSOLUTE /end AXIS_DESCR
/end CHARACTERISTIC
/begin CHARACTERISTIC KFIGENDF1 "Generatorstrom1 DF-Kennfeld" MAP 0xFCAF39 KfAxU8AyU8SstxU8SstyU8WU8 255.0 igen_ub_q1 0.00 255.0 FORMAT "%5.1"
 /begin AXIS_DESCR STD_AXIS dffgen rel_ub_b100 7 0.00 99.61 FORMAT "%5.2" DEPOSIT ABSOLUTE /end AXIS_DESCR
 /begin AXIS_DESCR STD_AXIS genitemp igen_ub_q1 8 0.00 255.0 FORMAT "%5.1" DEPOSIT ABSOLUTE /end AXIS_DESCR
/end CHARACTERISTIC
/begin CHARACTERISTIC KFIGENDF12 "Generatorstrom1 DF-Kennfeld" MAP 0xFCBB07 KfAxU8AyU8SstxU8SstyU8WU8 255.0 igen_ub_q1 0.00 255.0 FORMAT "%5.1"
 /begin AXIS_DESCR STD_AXIS dffgen2 rel_ub_b100 7 0.00 99.61 FORMAT "%5.2" DEPOSIT ABSOLUTE /end AXIS_DESCR
 /begin AXIS_DESCR STD_AXIS genitemp_2 igen_ub_q1 8 0.00 255.0 FORMAT "%5.1" DEPOSIT ABSOLUTE /end AXIS_DESCR
/end CHARACTERISTIC
/begin CHARACTERISTIC KFIGENDF2 "Generatorstrom2 DF-Kennfeld" MAP 0xFCAF82 KfAxU8AyU8SstxU8SstyU8WU8 255.0 igen_ub_q1 0.00 255.0 FORMAT "%5.1"
 /begin AXIS_DESCR STD_AXIS dffgen rel_ub_b100 7 0.00 99.61 FORMAT "%5.2" DEPOSIT ABSOLUTE /end AXIS_DESCR
 /begin AXIS_DESCR STD_AXIS genitemp igen_ub_q1 8 0.00 255.0 FORMAT "%5.1" DEPOSIT ABSOLUTE /end AXIS_DESCR
/end CHARACTERISTIC
/begin CHARACTERISTIC KFIGENDF22 "Generatorstrom2 DF-Kennfeld" MAP 0xFCBB50 KfAxU8AyU8SstxU8SstyU8WU8 255.0 igen_ub_q1 0.00 255.0 FORMAT "%5.1"
 /begin AXIS_DESCR STD_AXIS dffgen2 rel_ub_b100 7 0.00 99.61 FORMAT "%5.2" DEPOSIT ABSOLUTE /end AXIS_DESCR
 /begin AXIS_DESCR STD_AXIS genitemp_2 igen_ub_q1 8 0.00 255.0 FORMAT "%5.1" DEPOSIT ABSOLUTE /end AXIS_DESCR
/end CHARACTERISTIC
/begin CHARACTERISTIC KFIGENDF3 "Generatorstrom3 DF-Kennfeld" MAP 0xFCAFCB KfAxU8AyU8SstxU8SstyU8WU8 255.0 igen_ub_q1 0.00 255.0 FORMAT "%5.1"
 /begin AXIS_DESCR STD_AXIS dffgen rel_ub_b100 7 0.00 99.61 FORMAT "%5.2" DEPOSIT ABSOLUTE /end AXIS_DESCR
 /begin AXIS_DESCR STD_AXIS genitemp igen_ub_q1 8 0.00 255.0 FORMAT "%5.1" DEPOSIT ABSOLUTE /end AXIS_DESCR
/end CHARACTERISTIC
/begin CHARACTERISTIC KFIGENDF4 "Generatorstrom4 DF-Kennfeld" MAP 0xFCB014 KfAxU8AyU8SstxU8SstyU8WU8 255.0 igen_ub_q1 0.00 255.0 FORMAT "%5.1"
 /begin AXIS_DESCR STD_AXIS dffgen rel_ub_b100 7 0.00 99.61 FORMAT "%5.2" DEPOSIT ABSOLUTE /end AXIS_DESCR
 /begin AXIS_DESCR STD_AXIS genitemp igen_ub_q1 8 0.00 255.0 FORMAT "%5.1" DEPOSIT ABSOLUTE /end AXIS_DESCR
/end CHARACTERISTIC
/begin CHARACTERISTIC KFIGENDF5 "Generatorstrom5 DF-Kennfeld" MAP 0xFCB05D KfAxU8AyU8SstxU8SstyU8WU8 255.0 igen_ub_q1 0.00 255.0 FORMAT "%5.1"
 /begin AXIS_DESCR STD_AXIS dffgen rel_ub_b100 7 0.00 99.61 FORMAT "%5.2" DEPOSIT ABSOLUTE /end AXIS_DESCR
 /begin AXIS_DESCR STD_AXIS genitemp igen_ub_q1 8 0.00 255.0 FORMAT "%5.1" DEPOSIT ABSOLUTE /end AXIS_DESCR
/end CHARACTERISTIC
/begin CHARACTERISTIC KFIGENDF6 "Generatorstrom6 DF-Kennfeld" MAP 0xFCB0A6 KfAxU8AyU8SstxU8SstyU8WU8 255.0 igen_ub_q1 0.00 255.0 FORMAT "%5.1"
 /begin AXIS_DESCR STD_AXIS dffgen rel_ub_b100 7 0.00 99.61 FORMAT "%5.2" DEPOSIT ABSOLUTE /end AXIS_DESCR
 /begin AXIS_DESCR STD_AXIS genitemp igen_ub_q1 8 0.00 255.0 FORMAT "%5.1" DEPOSIT ABSOLUTE /end AXIS_DESCR
/end CHARACTERISTIC
/begin CHARACTERISTIC KFIGENDF7 "Generatorstrom7 DF-Kennfeld" MAP 0xFCB0EF KfAxU8AyU8SstxU8SstyU8WU8 255.0 igen_ub_q1 0.00 255.0 FORMAT "%5.1"
 /begin AXIS_DESCR STD_AXIS dffgen rel_ub_b100 7 0.00 99.61 FORMAT "%5.2" DEPOSIT ABSOLUTE /end AXIS_DESCR
 /begin AXIS_DESCR STD_AXIS genitemp igen_ub_q1 8 0.00 255.0 FORMAT "%5.1" DEPOSIT ABSOLUTE /end AXIS_DESCR
/end CHARACTERISTIC
/begin CHARACTERISTIC KFIGENKA0 "" MAP 0xFCAA10 KfAxU8AyU8SstxU8SstyU16WU8 255.0 igen_ub_q1 0.00 255.0 FORMAT "%5.1"
 /begin AXIS_DESCR STD_AXIS ugen spg_ugen 7 10.60 36.10 FORMAT "%5.2" DEPOSIT ABSOLUTE /end AXIS_DESCR
 /begin AXIS_DESCR STD_AXIS ngen_w ngen_uw_q0p5 9 0.00 32767.50 FORMAT "%8.2" DEPOSIT ABSOLUTE /end AXIS_DESCR
/end CHARACTERISTIC
/begin CHARACTERISTIC KFIGENKA02 "Kaltkennfeld 0 Generator" MAP 0xFCB8EA KfAxU8AyU8SstxU8SstyU16WU8 255.0 igen_ub_q1 0.00 255.0 FORMAT "%5.1"
 /begin AXIS_DESCR STD_AXIS ugen2 spg_ugen 7 10.60 36.10 FORMAT "%5.2" DEPOSIT ABSOLUTE /end AXIS_DESCR
 /begin AXIS_DESCR STD_AXIS ngen_w2 ngen_uw_q0p5 9 0.00 32767.50 FORMAT "%8.2" DEPOSIT ABSOLUTE /end AXIS_DESCR
/end CHARACTERISTIC
/begin CHARACTERISTIC KFIGENKA1 "" MAP 0xFCAA6C KfAxU8AyU8SstxU8SstyU16WU8 255.0 igen_ub_q1 0.00 255.0 FORMAT "%5.1"
 /begin AXIS_DESCR STD_AXIS ugen spg_ugen 7 10.60 36.10 FORMAT "%5.2" DEPOSIT ABSOLUTE /end AXIS_DESCR
 /begin AXIS_DESCR STD_AXIS ngen_w ngen_uw_q0p5 9 0.00 32767.50 FORMAT "%8.2" DEPOSIT ABSOLUTE /end AXIS_DESCR
/end CHARACTERISTIC
/begin CHARACTERISTIC KFIGENKA12 "Kaltkennfeld 1 Generator" MAP 0xFCB946 KfAxU8AyU8SstxU8SstyU16WU8 255.0 igen_ub_q1 0.00 255.0 FORMAT "%5.1"
 /begin AXIS_DESCR STD_AXIS ugen2 spg_ugen 7 10.60 36.10 FORMAT "%5.2" DEPOSIT ABSOLUTE /end AXIS_DESCR
 /begin AXIS_DESCR STD_AXIS ngen_w2 ngen_uw_q0p5 9 0.00 32767.50 FORMAT "%8.2" DEPOSIT ABSOLUTE /end AXIS_DESCR
/end CHARACTERISTIC
/begin CHARACTERISTIC KFIGENKA2 "" MAP 0xFCAAC8 KfAxU8AyU8SstxU8SstyU16WU8 255.0 igen_ub_q1 0.00 255.0 FORMAT "%5.1"
 /begin AXIS_DESCR STD_AXIS ugen spg_ugen 7 10.60 36.10 FORMAT "%5.2" DEPOSIT ABSOLUTE /end AXIS_DESCR
 /begin AXIS_DESCR STD_AXIS ngen_w ngen_uw_q0p5 9 0.00 32767.50 FORMAT "%8.2" DEPOSIT ABSOLUTE /end AXIS_DESCR
/end CHARACTERISTIC
/begin CHARACTERISTIC KFIGENKA22 "Kaltkennfeld 2 Generator" MAP 0xFCB9A2 KfAxU8AyU8SstxU8SstyU16WU8 255.0 igen_ub_q1 0.00 255.0 FORMAT "%5.1"
 /begin AXIS_DESCR STD_AXIS ugen2 spg_ugen 7 10.60 36.10 FORMAT "%5.2" DEPOSIT ABSOLUTE /end AXIS_DESCR
 /begin AXIS_DESCR STD_AXIS ngen_w2 ngen_uw_q0p5 9 0.00 32767.50 FORMAT "%8.2" DEPOSIT ABSOLUTE /end AXIS_DESCR
/end CHARACTERISTIC
/begin CHARACTERISTIC KFIGENKA3 "" MAP 0xFCAB24 KfAxU8AyU8SstxU8SstyU16WU8 255.0 igen_ub_q1 0.00 255.0 FORMAT "%5.1"
 /begin AXIS_DESCR STD_AXIS ugen spg_ugen 7 10.60 36.10 FORMAT "%5.2" DEPOSIT ABSOLUTE /end AXIS_DESCR
 /begin AXIS_DESCR STD_AXIS ngen_w ngen_uw_q0p5 9 0.00 32767.50 FORMAT "%8.2" DEPOSIT ABSOLUTE /end AXIS_DESCR
/end CHARACTERISTIC
/begin CHARACTERISTIC KFIGENKA4 "" MAP 0xFCAB80 KfAxU8AyU8SstxU8SstyU16WU8 255.0 igen_ub_q1 0.00 255.0 FORMAT "%5.1"
 /begin AXIS_DESCR STD_AXIS ugen spg_ugen 7 10.60 36.10 FORMAT "%5.2" DEPOSIT ABSOLUTE /end AXIS_DESCR
 /begin AXIS_DESCR STD_AXIS ngen_w ngen_uw_q0p5 9 0.00 32767.50 FORMAT "%8.2" DEPOSIT ABSOLUTE /end AXIS_DESCR
/end CHARACTERISTIC
/begin CHARACTERISTIC KFIGENKA5 "" MAP 0xFCABDC KfAxU8AyU8SstxU8SstyU16WU8 255.0 igen_ub_q1 0.00 255.0 FORMAT "%5.1"
 /begin AXIS_DESCR STD_AXIS ugen spg_ugen 7 10.60 36.10 FORMAT "%5.2" DEPOSIT ABSOLUTE /end AXIS_DESCR
 /begin AXIS_DESCR STD_AXIS ngen_w ngen_uw_q0p5 9 0.00 32767.50 FORMAT "%8.2" DEPOSIT ABSOLUTE /end AXIS_DESCR
/end CHARACTERISTIC
/begin CHARACTERISTIC KFIGENKA6 "" MAP 0xFCAC38 KfAxU8AyU8SstxU8SstyU16WU8 255.0 igen_ub_q1 0.00 255.0 FORMAT "%5.1"
 /begin AXIS_DESCR STD_AXIS ugen spg_ugen 7 10.60 36.10 FORMAT "%5.2" DEPOSIT ABSOLUTE /end AXIS_DESCR
 /begin AXIS_DESCR STD_AXIS ngen_w ngen_uw_q0p5 9 0.00 32767.50 FORMAT "%8.2" DEPOSIT ABSOLUTE /end AXIS_DESCR
/end CHARACTERISTIC
/begin CHARACTERISTIC KFIGENKA7 "" MAP 0xFCAC94 KfAxU8AyU8SstxU8SstyU16WU8 255.0 igen_ub_q1 0.00 255.0 FORMAT "%5.1"
 /begin AXIS_DESCR STD_AXIS ugen spg_ugen 7 10.60 36.10 FORMAT "%5.2" DEPOSIT ABSOLUTE /end AXIS_DESCR
 /begin AXIS_DESCR STD_AXIS ngen_w ngen_uw_q0p5 9 0.00 32767.50 FORMAT "%8.2" DEPOSIT ABSOLUTE /end AXIS_DESCR
/end CHARACTERISTIC
/begin CHARACTERISTIC KFIGENWA0 "" MAP 0xFCACF0 KfAxU8AyU8SstxU8SstyU16WU8 255.0 igen_ub_q1 0.00 255.0 FORMAT "%5.1"
 /begin AXIS_DESCR STD_AXIS genikaltun igen_ub_q1 6 0.00 255.0 FORMAT "%5.1" DEPOSIT ABSOLUTE /end AXIS_DESCR
 /begin AXIS_DESCR STD_AXIS gentempend temp_uw_q0p75_o48 7 -48.00000 336.0000 FORMAT "%8.4" DEPOSIT ABSOLUTE /end AXIS_DESCR
/end CHARACTERISTIC
/begin CHARACTERISTIC KFIGENWA02 "Warmkennfeld 0 Generator" MAP 0xFCB9FE KfAxU8AyU8SstxU8SstyU16WU8 255.0 igen_ub_q1 0.00 255.0 FORMAT "%5.1"
 /begin AXIS_DESCR STD_AXIS genikaltu2 igen_ub_q1 6 0.00 255.0 FORMAT "%5.1" DEPOSIT ABSOLUTE /end AXIS_DESCR
 /begin AXIS_DESCR STD_AXIS gentempen2 temp_uw_q0p75_o48 7 -48.00000 336.0000 FORMAT "%8.4" DEPOSIT ABSOLUTE /end AXIS_DESCR
/end CHARACTERISTIC
/begin CHARACTERISTIC KFIGENWA1 "" MAP 0xFCAD30 KfAxU8AyU8SstxU8SstyU16WU8 255.0 igen_ub_q1 0.00 255.0 FORMAT "%5.1"
 /begin AXIS_DESCR STD_AXIS genikaltun igen_ub_q1 6 0.00 255.0 FORMAT "%5.1" DEPOSIT ABSOLUTE /end AXIS_DESCR
 /begin AXIS_DESCR STD_AXIS gentempend temp_uw_q0p75_o48 7 -48.00000 336.0000 FORMAT "%8.4" DEPOSIT ABSOLUTE /end AXIS_DESCR
/end CHARACTERISTIC
/begin CHARACTERISTIC KFIGENWA12 "Warmkennfeld 1 Generator" MAP 0xFCBA3E KfAxU8AyU8SstxU8SstyU16WU8 255.0 igen_ub_q1 0.00 255.0 FORMAT "%5.1"
 /begin AXIS_DESCR STD_AXIS genikaltu2 igen_ub_q1 6 0.00 255.0 FORMAT "%5.1" DEPOSIT ABSOLUTE /end AXIS_DESCR
 /begin AXIS_DESCR STD_AXIS gentempen2 temp_uw_q0p75_o48 7 -48.00000 336.0000 FORMAT "%8.4" DEPOSIT ABSOLUTE /end AXIS_DESCR
/end CHARACTERISTIC
/begin CHARACTERISTIC KFIGENWA2 "" MAP 0xFCAD70 KfAxU8AyU8SstxU8SstyU16WU8 255.0 igen_ub_q1 0.00 255.0 FORMAT "%5.1"
 /begin AXIS_DESCR STD_AXIS genikaltun igen_ub_q1 6 0.00 255.0 FORMAT "%5.1" DEPOSIT ABSOLUTE /end AXIS_DESCR
 /begin AXIS_DESCR STD_AXIS gentempend temp_uw_q0p75_o48 7 -48.00000 336.0000 FORMAT "%8.4" DEPOSIT ABSOLUTE /end AXIS_DESCR
/end CHARACTERISTIC
/begin CHARACTERISTIC KFIGENWA22 "Warmkennfeld 2 Generator" MAP 0xFCBA7E KfAxU8AyU8SstxU8SstyU16WU8 255.0 igen_ub_q1 0.00 255.0 FORMAT "%5.1"
 /begin AXIS_DESCR STD_AXIS genikaltu2 igen_ub_q1 6 0.00 255.0 FORMAT "%5.1" DEPOSIT ABSOLUTE /end AXIS_DESCR
 /begin AXIS_DESCR STD_AXIS gentempen2 temp_uw_q0p75_o48 7 -48.00000 336.0000 FORMAT "%8.4" DEPOSIT ABSOLUTE /end AXIS_DESCR
/end CHARACTERISTIC
/begin CHARACTERISTIC KFIGENWA3 "" MAP 0xFCADB0 KfAxU8AyU8SstxU8SstyU16WU8 255.0 igen_ub_q1 0.00 255.0 FORMAT "%5.1"
 /begin AXIS_DESCR STD_AXIS genikaltun igen_ub_q1 6 0.00 255.0 FORMAT "%5.1" DEPOSIT ABSOLUTE /end AXIS_DESCR
 /begin AXIS_DESCR STD_AXIS gentempend temp_uw_q0p75_o48 7 -48.00000 336.0000 FORMAT "%8.4" DEPOSIT ABSOLUTE /end AXIS_DESCR
/end CHARACTERISTIC
/begin CHARACTERISTIC KFIGENWA4 "" MAP 0xFCADF0 KfAxU8AyU8SstxU8SstyU16WU8 255.0 igen_ub_q1 0.00 255.0 FORMAT "%5.1"
 /begin AXIS_DESCR STD_AXIS genikaltun igen_ub_q1 6 0.00 255.0 FORMAT "%5.1" DEPOSIT ABSOLUTE /end AXIS_DESCR
 /begin AXIS_DESCR STD_AXIS gentempend temp_uw_q0p75_o48 7 -48.00000 336.0000 FORMAT "%8.4" DEPOSIT ABSOLUTE /end AXIS_DESCR
/end CHARACTERISTIC
/begin CHARACTERISTIC KFIGENWA5 "" MAP 0xFCAE30 KfAxU8AyU8SstxU8SstyU16WU8 255.0 igen_ub_q1 0.00 255.0 FORMAT "%5.1"
 /begin AXIS_DESCR STD_AXIS genikaltun igen_ub_q1 6 0.00 255.0 FORMAT "%5.1" DEPOSIT ABSOLUTE /end AXIS_DESCR
 /begin AXIS_DESCR STD_AXIS gentempend temp_uw_q0p75_o48 7 -48.00000 336.0000 FORMAT "%8.4" DEPOSIT ABSOLUTE /end AXIS_DESCR
/end CHARACTERISTIC
/begin CHARACTERISTIC KFIGENWA6 "" MAP 0xFCAE70 KfAxU8AyU8SstxU8SstyU16WU8 255.0 igen_ub_q1 0.00 255.0 FORMAT "%5.1"
 /begin AXIS_DESCR STD_AXIS genikaltun igen_ub_q1 6 0.00 255.0 FORMAT "%5.1" DEPOSIT ABSOLUTE /end AXIS_DESCR
 /begin AXIS_DESCR STD_AXIS gentempend temp_uw_q0p75_o48 7 -48.00000 336.0000 FORMAT "%8.4" DEPOSIT ABSOLUTE /end AXIS_DESCR
/end CHARACTERISTIC
/begin CHARACTERISTIC KFIGENWA7 "" MAP 0xFCAEB0 KfAxU8AyU8SstxU8SstyU16WU8 255.0 igen_ub_q1 0.00 255.0 FORMAT "%5.1"
 /begin AXIS_DESCR STD_AXIS genikaltun igen_ub_q1 6 0.00 255.0 FORMAT "%5.1" DEPOSIT ABSOLUTE /end AXIS_DESCR
 /begin AXIS_DESCR STD_AXIS gentempend temp_uw_q0p75_o48 7 -48.00000 336.0000 FORMAT "%8.4" DEPOSIT ABSOLUTE /end AXIS_DESCR
/end CHARACTERISTIC
/begin CHARACTERISTIC KFKTM "" MAP 0xFC74CA KfAxU8AyU8SstxU16SstyU16WU16 1.992188 fak_ub_b2 0.00 1.992188 FORMAT "%8.6"
 /begin AXIS_DESCR STD_AXIS tabgmab temp_ub_q5_o50 6 -50.00 1225. FORMAT "%5.0" DEPOSIT ABSOLUTE /end AXIS_DESCR
 /begin AXIS_DESCR STD_AXIS tabst_w t1sxs_uw_q1 6 0.00 65535.00 FORMAT "%8.2" DEPOSIT ABSOLUTE /end AXIS_DESCR
/end CHARACTERISTIC
/begin CHARACTERISTIC KFKTM2 "" MAP 0xFC7592 KfAxU8AyU8SstxU8SstyU8WU8 1.992 fak_ub_b2 0.00 1.992 FORMAT "%5.3"
 /begin AXIS_DESCR STD_AXIS vfzg vfzg_ub_q1p25 6 0.00 318.8 FORMAT "%5.1" DEPOSIT ABSOLUTE /end AXIS_DESCR
 /begin AXIS_DESCR STD_AXIS taml rel_ub_b100 6 0.00 100.0 FORMAT "%5.1" DEPOSIT ABSOLUTE /end AXIS_DESCR
/end CHARACTERISTIC
/begin CHARACTERISTIC KFKWTMP "Kennfeld Drehmomentenreserve f¸r Kat warmhalten, zeitweise" MAP 0xFD28B6 KfAxUwAyUwSstxUwSstyUwWUw 99.99847 rel_uw_b100 0.00 99.99847 FORMAT "%8.5"
 /begin AXIS_DESCR STD_AXIS nmot_w nmot_uw_q0p25 4 0.00 16383.75 FORMAT "%8.2" DEPOSIT ABSOLUTE /end AXIS_DESCR
 /begin AXIS_DESCR STD_AXIS mifakh_w rel_uw_b100 4 0.00 99.99847 FORMAT "%8.5" DEPOSIT ABSOLUTE /end AXIS_DESCR
/end CHARACTERISTIC
/begin CHARACTERISTIC KFMDDSLA "Kennfeld Drehmomentenreserve bei Testereingriff Sekund‰rluftdiagnose" MAP 0xFD28EA KfAxUwAyUwSstxUwSstyUwWUw 99.99847 rel_uw_b100 0.00 99.99847 FORMAT "%8.5"
 /begin AXIS_DESCR STD_AXIS nmot_w nmot_uw_q0p25 4 0.00 16383.75 FORMAT "%8.2" DEPOSIT ABSOLUTE /end AXIS_DESCR
 /begin AXIS_DESCR STD_AXIS mifakh_w rel_uw_b100 4 0.00 99.99847 FORMAT "%8.5" DEPOSIT ABSOLUTE /end AXIS_DESCR
/end CHARACTERISTIC
/begin CHARACTERISTIC KFMDHLS "" MAP 0xFD291E KfAxUwAyUwSstxUwSstyUwWUw 99.99847 rel_uw_b100 0.00 99.99847 FORMAT "%8.5"
 /begin AXIS_DESCR STD_AXIS nmot_w nmot_uw_q0p25 8 0.00 16383.75 FORMAT "%8.2" DEPOSIT ABSOLUTE /end AXIS_DESCR
 /begin AXIS_DESCR STD_AXIS mifakh_w rel_uw_b100 8 0.00 99.99847 FORMAT "%8.5" DEPOSIT ABSOLUTE /end AXIS_DESCR
/end CHARACTERISTIC
/begin CHARACTERISTIC KFMDKH "Kennfeld Drehmomentenreserve f¸r Katheizen" MAP 0xFD29C2 KfAxUwAyUwSstxUwSstyUwWUw 99.99847 rel_uw_b100 0.00 99.99847 FORMAT "%8.5"
 /begin AXIS_DESCR STD_AXIS nmot_w nmot_uw_q0p25 8 0.00 16383.75 FORMAT "%8.2" DEPOSIT ABSOLUTE /end AXIS_DESCR
 /begin AXIS_DESCR STD_AXIS mifakh_w rel_uw_b100 8 0.00 99.99847 FORMAT "%8.5" DEPOSIT ABSOLUTE /end AXIS_DESCR
/end CHARACTERISTIC
/begin CHARACTERISTIC KFMDKHLL "Kennfeld Drehmomentenreserve f¸r Katheizen bei LL" MAP 0xFD2A66 KfAxUwAyUwSstxUwSstyUwWUw 99.99847 rel_uw_b100 0.00 99.99847 FORMAT "%8.5"
 /begin AXIS_DESCR STD_AXIS nmot_w nmot_uw_q0p25 8 0.00 16383.75 FORMAT "%8.2" DEPOSIT ABSOLUTE /end AXIS_DESCR
 /begin AXIS_DESCR STD_AXIS mifakh_w rel_uw_b100 8 0.00 99.99847 FORMAT "%8.5" DEPOSIT ABSOLUTE /end AXIS_DESCR
/end CHARACTERISTIC
/begin CHARACTERISTIC KFTBERGI "" VALUE 0xFCECF4 KwWU16 0.9999847 fak_uw_b1 0.00 0.9999847 FORMAT "%9.7" /end CHARACTERISTIC
/begin CHARACTERISTIC KFTKRI "Integratorsteigung KR" VALUE 0xFCECF6 KwWU16 0.9999847 fak_uw_b1 0.00 0.9999847 FORMAT "%9.7" /end CHARACTERISTIC
/begin CHARACTERISTIC KFTKWS "" MAP 0xFCEBE4 KfAxU8AyU8SstxU16SstyU16WU16 100.0000 fak_q0p1 0.00 100.0000 FORMAT "%8.4"
 /begin AXIS_DESCR STD_AXIS rlsol_w rel_uw_q0p0234 8 0.00 1535.977 FORMAT "%8.3" DEPOSIT ABSOLUTE /end AXIS_DESCR
 /begin AXIS_DESCR STD_AXIS tkws temp_ub_q0p75_o48 8 -48.00 143.3 FORMAT "%5.1" DEPOSIT ABSOLUTE /end AXIS_DESCR
/end CHARACTERISTIC
/begin CHARACTERISTIC KFTLASTI "" VALUE 0xFCECF8 KwWU16 0.9999847 fak_uw_b1 0.00 0.9999847 FORMAT "%9.7" /end CHARACTERISTIC
/begin CHARACTERISTIC KFTMOKOR "" MAP 0xFC75C4 KfAxU8AyU8SstxU8SstyU8WU8 191.3 temp_ub_q0p75_o48 -48.00 143.3 FORMAT "%5.1"
 /begin AXIS_DESCR STD_AXIS tmot temp_ub_q0p75_o48 9 -48.00 143.3 FORMAT "%5.1" DEPOSIT ABSOLUTE /end AXIS_DESCR
 /begin AXIS_DESCR STD_AXIS nmot nmot_ub_q40 9 0.00 10200. FORMAT "%5.0" DEPOSIT ABSOLUTE /end AXIS_DESCR
/end CHARACTERISTIC
/begin CHARACTERISTIC KFTTANSI "" VALUE 0xFCECFA KwWU16 0.9999847 fak_uw_b1 0.00 0.9999847 FORMAT "%9.7" /end CHARACTERISTIC
/begin CHARACTERISTIC KFZKTMTKR "Kennfeld f¸r Zeitkonstante PT1-Filterung tkrst" MAP 0xFC752E KfAxU8AyU8SstxU16SstyU16WU16 6553.500 t100msxs_uw_b6553p5 0.00 6553.500 FORMAT "%8.3"
 /begin AXIS_DESCR STD_AXIS tnse_w t100msxs_uw_b6553p5 6 0.00 655.4000 FORMAT "%8.4" DEPOSIT ABSOLUTE /end AXIS_DESCR
 /begin AXIS_DESCR STD_AXIS vsskrst fuel_ub_q1 6 0.00 65535. FORMAT "%5.0" DEPOSIT ABSOLUTE /end AXIS_DESCR
/end CHARACTERISTIC
/begin CHARACTERISTIC KLFPDIOD02 "Verlustleistungsfaktor eines Diodenpaars0" CURVE 0xFCBB9A KlAxU8SstxU16WU16 1.992188 fak_ub_b2 0.00 1.992188 FORMAT "%8.6"
 /begin AXIS_DESCR STD_AXIS gentemp2 temp_uw_q0p75_o48 5 -48.00000 336.0000 FORMAT "%8.4" DEPOSIT ABSOLUTE /end AXIS_DESCR
/end CHARACTERISTIC
/begin CHARACTERISTIC KLFPDIOD12 "Verlustleistungsfaktor eines Diodenpaars1" CURVE 0xFCBBB0 KlAxU8SstxU16WU16 1.992188 fak_ub_b2 0.00 1.992188 FORMAT "%8.6"
 /begin AXIS_DESCR STD_AXIS gentemp2 temp_uw_q0p75_o48 5 -48.00000 336.0000 FORMAT "%8.4" DEPOSIT ABSOLUTE /end AXIS_DESCR
/end CHARACTERISTIC
/begin CHARACTERISTIC KLFPDIOD22 "Verlustleistungsfaktor eines Diodenpaars2" CURVE 0xFCBBC6 KlAxU8SstxU16WU16 1.992188 fak_ub_b2 0.00 1.992188 FORMAT "%8.6"
 /begin AXIS_DESCR STD_AXIS gentemp2 temp_uw_q0p75_o48 5 -48.00000 336.0000 FORMAT "%8.4" DEPOSIT ABSOLUTE /end AXIS_DESCR
/end CHARACTERISTIC
/begin CHARACTERISTIC KLFPDIODE0 "Verlustleistungsfaktor eines Diodenpaars0" CURVE 0xFCB138 KlAxU8SstxU16WU16 1.992188 fak_ub_b2 0.00 1.992188 FORMAT "%8.6"
 /begin AXIS_DESCR STD_AXIS gentemp temp_uw_q0p75_o48 5 -48.00000 336.0000 FORMAT "%8.4" DEPOSIT ABSOLUTE /end AXIS_DESCR
/end CHARACTERISTIC
/begin CHARACTERISTIC KLFPDIODE1 "Verlustleistungsfaktor eines Diodenpaars1" CURVE 0xFCB14E KlAxU8SstxU16WU16 1.992188 fak_ub_b2 0.00 1.992188 FORMAT "%8.6"
 /begin AXIS_DESCR STD_AXIS gentemp temp_uw_q0p75_o48 5 -48.00000 336.0000 FORMAT "%8.4" DEPOSIT ABSOLUTE /end AXIS_DESCR
/end CHARACTERISTIC
/begin CHARACTERISTIC KLFPDIODE2 "Verlustleistungsfaktor eines Diodenpaars2" CURVE 0xFCB164 KlAxU8SstxU16WU16 1.992188 fak_ub_b2 0.00 1.992188 FORMAT "%8.6"
 /begin AXIS_DESCR STD_AXIS gentemp temp_uw_q0p75_o48 5 -48.00000 336.0000 FORMAT "%8.4" DEPOSIT ABSOLUTE /end AXIS_DESCR
/end CHARACTERISTIC
/begin CHARACTERISTIC KLFPDIODE3 "Verlustleistungsfaktor eines Diodenpaars" CURVE 0xFCB17A KlAxU8SstxU16WU16 1.992188 fak_ub_b2 0.00 1.992188 FORMAT "%8.6"
 /begin AXIS_DESCR STD_AXIS gentemp temp_uw_q0p75_o48 5 -48.00000 336.0000 FORMAT "%8.4" DEPOSIT ABSOLUTE /end AXIS_DESCR
/end CHARACTERISTIC
/begin CHARACTERISTIC KLFPDIODE4 "Verlustleistungsfaktor eines Diodenpaars4" CURVE 0xFCB190 KlAxU8SstxU16WU16 1.992188 fak_ub_b2 0.00 1.992188 FORMAT "%8.6"
 /begin AXIS_DESCR STD_AXIS gentemp temp_uw_q0p75_o48 5 -48.00000 336.0000 FORMAT "%8.4" DEPOSIT ABSOLUTE /end AXIS_DESCR
/end CHARACTERISTIC
/begin CHARACTERISTIC KLFPDIODE5 "Verlustleistungsfaktor eines Diodenpaars5" CURVE 0xFCB1A6 KlAxU8SstxU16WU16 1.992188 fak_ub_b2 0.00 1.992188 FORMAT "%8.6"
 /begin AXIS_DESCR STD_AXIS gentemp temp_uw_q0p75_o48 5 -48.00000 336.0000 FORMAT "%8.4" DEPOSIT ABSOLUTE /end AXIS_DESCR
/end CHARACTERISTIC
/begin CHARACTERISTIC KLFPDIODE6 "Verlustleistungsfaktor eines Diodenpaars6" CURVE 0xFCB1BC KlAxU8SstxU16WU16 1.992188 fak_ub_b2 0.00 1.992188 FORMAT "%8.6"
 /begin AXIS_DESCR STD_AXIS gentemp temp_uw_q0p75_o48 5 -48.00000 336.0000 FORMAT "%8.4" DEPOSIT ABSOLUTE /end AXIS_DESCR
/end CHARACTERISTIC
/begin CHARACTERISTIC KLFPDIODE7 "Verlustleistungsfaktor eines Diodenpaars7" CURVE 0xFCB1D2 KlAxU8SstxU16WU16 1.992188 fak_ub_b2 0.00 1.992188 FORMAT "%8.6"
 /begin AXIS_DESCR STD_AXIS gentemp temp_uw_q0p75_o48 5 -48.00000 336.0000 FORMAT "%8.4" DEPOSIT ABSOLUTE /end AXIS_DESCR
/end CHARACTERISTIC
/begin CHARACTERISTIC KLGENEXP0 "Abk¸hlkurve Generator0" CURVE 0xFCB1E8 KlAxU8SstxU16WU16 1.000000 genexpab_ub_q0p0039 0.00 1.000000 FORMAT "%8.6"
 /begin AXIS_DESCR STD_AXIS tabst_w t1sxs_uw_q1 13 0.00 65535.00 FORMAT "%8.2" DEPOSIT ABSOLUTE /end AXIS_DESCR
/end CHARACTERISTIC
/begin CHARACTERISTIC KLGENEXP02 "Abk¸hlkurve Generator0" CURVE 0xFCBBDC KlAxU8SstxU16WU16 1.000000 genexpab_ub_q0p0039 0.00 1.000000 FORMAT "%8.6"
 /begin AXIS_DESCR STD_AXIS tabst_w t1sxs_uw_q1 13 0.00 65535.00 FORMAT "%8.2" DEPOSIT ABSOLUTE /end AXIS_DESCR
/end CHARACTERISTIC
/begin CHARACTERISTIC KLGENEXP1 "Abk¸hlkurve Generator1" CURVE 0xFCB21E KlAxU8SstxU16WU16 1.000000 genexpab_ub_q0p0039 0.00 1.000000 FORMAT "%8.6"
 /begin AXIS_DESCR STD_AXIS tabst_w t1sxs_uw_q1 13 0.00 65535.00 FORMAT "%8.2" DEPOSIT ABSOLUTE /end AXIS_DESCR
/end CHARACTERISTIC
/begin CHARACTERISTIC KLGENEXP12 "Abk¸hlkurve Generator1" CURVE 0xFCBC12 KlAxU8SstxU16WU16 1.000000 genexpab_ub_q0p0039 0.00 1.000000 FORMAT "%8.6"
 /begin AXIS_DESCR STD_AXIS tabst_w t1sxs_uw_q1 13 0.00 65535.00 FORMAT "%8.2" DEPOSIT ABSOLUTE /end AXIS_DESCR
/end CHARACTERISTIC
/begin CHARACTERISTIC KLGENEXP2 "Abk¸hlkurve Generator2" CURVE 0xFCB254 KlAxU8SstxU16WU16 1.000000 genexpab_ub_q0p0039 0.00 1.000000 FORMAT "%8.6"
 /begin AXIS_DESCR STD_AXIS tabst_w t1sxs_uw_q1 13 0.00 65535.00 FORMAT "%8.2" DEPOSIT ABSOLUTE /end AXIS_DESCR
/end CHARACTERISTIC
/begin CHARACTERISTIC KLGENEXP22 "Abk¸hlkurve Generator2" CURVE 0xFCBC48 KlAxU8SstxU16WU16 1.000000 genexpab_ub_q0p0039 0.00 1.000000 FORMAT "%8.6"
 /begin AXIS_DESCR STD_AXIS tabst_w t1sxs_uw_q1 13 0.00 65535.00 FORMAT "%8.2" DEPOSIT ABSOLUTE /end AXIS_DESCR
/end CHARACTERISTIC
/begin CHARACTERISTIC KLGENEXP3 "Abk¸hlkurve Generator3" CURVE 0xFCB28A KlAxU8SstxU16WU16 1.000000 genexpab_ub_q0p0039 0.00 1.000000 FORMAT "%8.6"
 /begin AXIS_DESCR STD_AXIS tabst_w t1sxs_uw_q1 13 0.00 65535.00 FORMAT "%8.2" DEPOSIT ABSOLUTE /end AXIS_DESCR
/end CHARACTERISTIC
/begin CHARACTERISTIC KLGENEXP4 "Abk¸hlkurve Generator4" CURVE 0xFCB2C0 KlAxU8SstxU16WU16 1.000000 genexpab_ub_q0p0039 0.00 1.000000 FORMAT "%8.6"
 /begin AXIS_DESCR STD_AXIS tabst_w t1sxs_uw_q1 13 0.00 65535.00 FORMAT "%8.2" DEPOSIT ABSOLUTE /end AXIS_DESCR
/end CHARACTERISTIC
/begin CHARACTERISTIC KLGENEXP5 "Abk¸hlkurve Generator5" CURVE 0xFCB2F6 KlAxU8SstxU16WU16 1.000000 genexpab_ub_q0p0039 0.00 1.000000 FORMAT "%8.6"
 /begin AXIS_DESCR STD_AXIS tabst_w t1sxs_uw_q1 13 0.00 65535.00 FORMAT "%8.2" DEPOSIT ABSOLUTE /end AXIS_DESCR
/end CHARACTERISTIC
/begin CHARACTERISTIC KLGENEXP6 "Abk¸hlkurve Generator6" CURVE 0xFCB32C KlAxU8SstxU16WU16 1.000000 genexpab_ub_q0p0039 0.00 1.000000 FORMAT "%8.6"
 /begin AXIS_DESCR STD_AXIS tabst_w t1sxs_uw_q1 13 0.00 65535.00 FORMAT "%8.2" DEPOSIT ABSOLUTE /end AXIS_DESCR
/end CHARACTERISTIC
/begin CHARACTERISTIC KLGENEXP7 "Abk¸hlkurve Generator7" CURVE 0xFCB362 KlAxU8SstxU16WU16 1.000000 genexpab_ub_q0p0039 0.00 1.000000 FORMAT "%8.6"
 /begin AXIS_DESCR STD_AXIS tabst_w t1sxs_uw_q1 13 0.00 65535.00 FORMAT "%8.2" DEPOSIT ABSOLUTE /end AXIS_DESCR
/end CHARACTERISTIC
/begin CHARACTERISTIC KLGENTET02 "Temperatur_eta_faktor Generator0" CURVE 0xFCBC7E KlAxU8SstxU16WU16 2.000000 fak_ub_b1 0.00 2.000000 FORMAT "%8.6"
 /begin AXIS_DESCR STD_AXIS gentemp2 temp_uw_q0p75_o48 3 -48.00000 336.0000 FORMAT "%8.4" DEPOSIT ABSOLUTE /end AXIS_DESCR
/end CHARACTERISTIC
/begin CHARACTERISTIC KLGENTET12 "Temperatur_eta_faktor Generator1" CURVE 0xFCBC8C KlAxU8SstxU16WU16 2.000000 fak_ub_b1 0.00 2.000000 FORMAT "%8.6"
 /begin AXIS_DESCR STD_AXIS gentemp2 temp_uw_q0p75_o48 3 -48.00000 336.0000 FORMAT "%8.4" DEPOSIT ABSOLUTE /end AXIS_DESCR
/end CHARACTERISTIC
/begin CHARACTERISTIC KLGENTET22 "Temperatur_eta_faktor Generator2" CURVE 0xFCBC9A KlAxU8SstxU16WU16 2.000000 fak_ub_b1 0.00 2.000000 FORMAT "%8.6"
 /begin AXIS_DESCR STD_AXIS gentemp2 temp_uw_q0p75_o48 3 -48.00000 336.0000 FORMAT "%8.4" DEPOSIT ABSOLUTE /end AXIS_DESCR
/end CHARACTERISTIC
/begin CHARACTERISTIC KLGENTETA0 "Temperatur_eta_faktor Generator0" CURVE 0xFCB398 KlAxU8SstxU16WU16 2.000000 fak_ub_b1 0.00 2.000000 FORMAT "%8.6"
 /begin AXIS_DESCR STD_AXIS gentemp temp_uw_q0p75_o48 3 -48.00000 336.0000 FORMAT "%8.4" DEPOSIT ABSOLUTE /end AXIS_DESCR
/end CHARACTERISTIC
/begin CHARACTERISTIC KLGENTETA1 "Temperatur_eta_faktor Generator1" CURVE 0xFCB3A6 KlAxU8SstxU16WU16 2.000000 fak_ub_b1 0.00 2.000000 FORMAT "%8.6"
 /begin AXIS_DESCR STD_AXIS gentemp temp_uw_q0p75_o48 3 -48.00000 336.0000 FORMAT "%8.4" DEPOSIT ABSOLUTE /end AXIS_DESCR
/end CHARACTERISTIC
/begin CHARACTERISTIC KLGENTETA2 "Temperatur_eta_faktor Generator2" CURVE 0xFCB3B4 KlAxU8SstxU16WU16 2.000000 fak_ub_b1 0.00 2.000000 FORMAT "%8.6"
 /begin AXIS_DESCR STD_AXIS gentemp temp_uw_q0p75_o48 3 -48.00000 336.0000 FORMAT "%8.4" DEPOSIT ABSOLUTE /end AXIS_DESCR
/end CHARACTERISTIC
/begin CHARACTERISTIC KLGENTETA3 "Temperatur_eta_faktor Generator3" CURVE 0xFCB3C2 KlAxU8SstxU16WU16 2.000000 fak_ub_b1 0.00 2.000000 FORMAT "%8.6"
 /begin AXIS_DESCR STD_AXIS gentemp temp_uw_q0p75_o48 3 -48.00000 336.0000 FORMAT "%8.4" DEPOSIT ABSOLUTE /end AXIS_DESCR
/end CHARACTERISTIC
/begin CHARACTERISTIC KLGENTETA4 "Temperatur_eta_faktor Generator4" CURVE 0xFCB3D0 KlAxU8SstxU16WU16 2.000000 fak_ub_b1 0.00 2.000000 FORMAT "%8.6"
 /begin AXIS_DESCR STD_AXIS gentemp temp_uw_q0p75_o48 3 -48.00000 336.0000 FORMAT "%8.4" DEPOSIT ABSOLUTE /end AXIS_DESCR
/end CHARACTERISTIC
/begin CHARACTERISTIC KLGENTETA5 "Temperatur_eta_faktor Generator5" CURVE 0xFCB3DE KlAxU8SstxU16WU16 2.000000 fak_ub_b1 0.00 2.000000 FORMAT "%8.6"
 /begin AXIS_DESCR STD_AXIS gentemp temp_uw_q0p75_o48 3 -48.00000 336.0000 FORMAT "%8.4" DEPOSIT ABSOLUTE /end AXIS_DESCR
/end CHARACTERISTIC
/begin CHARACTERISTIC KLGENTETA6 "Temperatur_eta_faktor Generator6" CURVE 0xFCB3EC KlAxU8SstxU16WU16 2.000000 fak_ub_b1 0.00 2.000000 FORMAT "%8.6"
 /begin AXIS_DESCR STD_AXIS gentemp temp_uw_q0p75_o48 3 -48.00000 336.0000 FORMAT "%8.4" DEPOSIT ABSOLUTE /end AXIS_DESCR
/end CHARACTERISTIC
/begin CHARACTERISTIC KLGENTETA7 "Temperatur_eta_faktor Generator7" CURVE 0xFCB3FA KlAxU8SstxU16WU16 2.000000 fak_ub_b1 0.00 2.000000 FORMAT "%8.6"
 /begin AXIS_DESCR STD_AXIS gentemp temp_uw_q0p75_o48 3 -48.00000 336.0000 FORMAT "%8.4" DEPOSIT ABSOLUTE /end AXIS_DESCR
/end CHARACTERISTIC
/begin CHARACTERISTIC KLIGENMES2 "Transferfunktion I_Generator" CURVE 0xFCBCA8 KlAxU8SstxU16WU16 511.9922 fak_uw_b512 0.00 511.9922 FORMAT "%8.4"
 /begin AXIS_DESCR STD_AXIS igenmess dez 4 0.00 1024.000 FORMAT "%8.3" DEPOSIT ABSOLUTE /end AXIS_DESCR
/end CHARACTERISTIC
/begin CHARACTERISTIC KLIGENMESS "Transferfunktion I_Generator" CURVE 0xFCB408 KlAxU8SstxU16WU16 511.9922 fak_uw_b512 0.00 511.9922 FORMAT "%8.4"
 /begin AXIS_DESCR STD_AXIS igenmess dez 4 0.00 1024.000 FORMAT "%8.3" DEPOSIT ABSOLUTE /end AXIS_DESCR
/end CHARACTERISTIC
/begin CHARACTERISTIC KLKFTBERG "" CURVE 0xFD54F5 KlAxU8SstxU8WU8 191.3 rel_ub_q0p75 0.00 191.3 FORMAT "%5.1"
 /begin AXIS_DESCR STD_AXIS vfzg vfzg_ub_q1p25 8 0.00 318.8 FORMAT "%5.1" DEPOSIT ABSOLUTE /end AXIS_DESCR
/end CHARACTERISTIC
/begin CHARACTERISTIC KLKFTLAST "" CURVE 0xFD5506 KlAxU8SstxU8WU8 191.3 rel_ub_q0p75 0.00 191.3 FORMAT "%5.1"
 /begin AXIS_DESCR STD_AXIS nmot nmot_ub_q40 8 0.00 10200. FORMAT "%5.0" DEPOSIT ABSOLUTE /end AXIS_DESCR
/end CHARACTERISTIC
/begin CHARACTERISTIC KLKFTTANS "" CURVE 0xFD5517 KlAxU8SstxU8WU8 191.3 temp_ub_q0p75_o48 -48.00 143.3 FORMAT "%5.1"
 /begin AXIS_DESCR STD_AXIS vfzg vfzg_ub_q1p25 8 0.00 318.8 FORMAT "%5.1" DEPOSIT ABSOLUTE /end AXIS_DESCR
/end CHARACTERISTIC
/begin CHARACTERISTIC KLRTH0FA02 "RTHfaktor0 ueber Generatorstrom" CURVE 0xFCBD08 KlAxU8SstxU8WU8 3.984 fak_ub_b4 0.00 3.984 FORMAT "%5.3"
 /begin AXIS_DESCR STD_AXIS geni_end2 igen_ub_q1 11 0.00 254.0 FORMAT "%5.1" DEPOSIT ABSOLUTE /end AXIS_DESCR
/end CHARACTERISTIC
/begin CHARACTERISTIC KLRTH0FA12 "RTHfaktor1 ueber Generatorstrom" CURVE 0xFCBD1F KlAxU8SstxU8WU8 3.984 fak_ub_b4 0.00 3.984 FORMAT "%5.3"
 /begin AXIS_DESCR STD_AXIS geni_end2 igen_ub_q1 11 0.00 254.0 FORMAT "%5.1" DEPOSIT ABSOLUTE /end AXIS_DESCR
/end CHARACTERISTIC
/begin CHARACTERISTIC KLRTH0FA22 "RTHfaktor2 ueber Generatorstrom" CURVE 0xFCBD36 KlAxU8SstxU8WU8 3.969 fak_ub_b4 0.00 3.969 FORMAT "%5.3"
 /begin AXIS_DESCR STD_AXIS geni_end2 igen_ub_q1 11 0.00 254.0 FORMAT "%5.1" DEPOSIT ABSOLUTE /end AXIS_DESCR
/end CHARACTERISTIC
/begin CHARACTERISTIC KLRTH0FAK0 "RTHfaktor0 ueber Generatorstrom" CURVE 0xFCB4EA KlAxU8SstxU8WU8 3.984 fak_ub_b4 0.00 3.984 FORMAT "%5.3"
 /begin AXIS_DESCR STD_AXIS geni_end igen_ub_q1 11 0.00 254.0 FORMAT "%5.1" DEPOSIT ABSOLUTE /end AXIS_DESCR
/end CHARACTERISTIC
/begin CHARACTERISTIC KLRTH0FAK1 "RTHfaktor1 ueber Generatorstrom" CURVE 0xFCB501 KlAxU8SstxU8WU8 3.984 fak_ub_b4 0.00 3.984 FORMAT "%5.3"
 /begin AXIS_DESCR STD_AXIS geni_end igen_ub_q1 11 0.00 254.0 FORMAT "%5.1" DEPOSIT ABSOLUTE /end AXIS_DESCR
/end CHARACTERISTIC
/begin CHARACTERISTIC KLRTH0FAK2 "RTHfaktor 2 ueber Generatorstrom" CURVE 0xFCB518 KlAxU8SstxU8WU8 3.969 fak_ub_b4 0.00 3.969 FORMAT "%5.3"
 /begin AXIS_DESCR STD_AXIS geni_end igen_ub_q1 11 0.00 254.0 FORMAT "%5.1" DEPOSIT ABSOLUTE /end AXIS_DESCR
/end CHARACTERISTIC
/begin CHARACTERISTIC KLRTH0FAK3 "RTHfaktor3 ueber Generatorstrom" CURVE 0xFCB52F KlAxU8SstxU8WU8 3.984 fak_ub_b4 0.00 3.984 FORMAT "%5.3"
 /begin AXIS_DESCR STD_AXIS geni_end igen_ub_q1 11 0.00 254.0 FORMAT "%5.1" DEPOSIT ABSOLUTE /end AXIS_DESCR
/end CHARACTERISTIC
/begin CHARACTERISTIC KLRTH0FAK4 "RTHfaktor4 ueber Generatorstrom" CURVE 0xFCB546 KlAxU8SstxU8WU8 3.984 fak_ub_b4 0.00 3.984 FORMAT "%5.3"
 /begin AXIS_DESCR STD_AXIS geni_end igen_ub_q1 11 0.00 254.0 FORMAT "%5.1" DEPOSIT ABSOLUTE /end AXIS_DESCR
/end CHARACTERISTIC
/begin CHARACTERISTIC KLRTH0FAK5 "RTHfaktor5 ueber Generatorstrom" CURVE 0xFCB55D KlAxU8SstxU8WU8 3.984 fak_ub_b4 0.00 3.984 FORMAT "%5.3"
 /begin AXIS_DESCR STD_AXIS geni_end igen_ub_q1 11 0.00 254.0 FORMAT "%5.1" DEPOSIT ABSOLUTE /end AXIS_DESCR
/end CHARACTERISTIC
/begin CHARACTERISTIC KLRTH0FAK6 "RTHfaktor6 ueber Generatorstrom" CURVE 0xFCB574 KlAxU8SstxU8WU8 3.984 fak_ub_b4 0.00 3.984 FORMAT "%5.3"
 /begin AXIS_DESCR STD_AXIS geni_end igen_ub_q1 11 0.00 254.0 FORMAT "%5.1" DEPOSIT ABSOLUTE /end AXIS_DESCR
/end CHARACTERISTIC
/begin CHARACTERISTIC KLRTH0FAK7 "RTHfaktor7 ueber Generatorstrom" CURVE 0xFCB58B KlAxU8SstxU8WU8 3.984 fak_ub_b4 0.00 3.984 FORMAT "%5.3"
 /begin AXIS_DESCR STD_AXIS geni_end igen_ub_q1 11 0.00 254.0 FORMAT "%5.1" DEPOSIT ABSOLUTE /end AXIS_DESCR
/end CHARACTERISTIC
/begin CHARACTERISTIC KLRTHFAK0 "RTHfaktor ueber Generatorstrom" CURVE 0xFCB5A2 KlAxU8SstxU8WU8 3.984 fak_ub_b4 0.00 3.984 FORMAT "%5.3"
 /begin AXIS_DESCR STD_AXIS geni_end igen_ub_q1 11 0.00 254.0 FORMAT "%5.1" DEPOSIT ABSOLUTE /end AXIS_DESCR
/end CHARACTERISTIC
/begin CHARACTERISTIC KLRTHFAK02 "RTHfaktor0 ueber Generatorstrom Fahrt" CURVE 0xFCBD4D KlAxU8SstxU8WU8 3.984 fak_ub_b4 0.00 3.984 FORMAT "%5.3"
 /begin AXIS_DESCR STD_AXIS geni_end2 igen_ub_q1 11 0.00 254.0 FORMAT "%5.1" DEPOSIT ABSOLUTE /end AXIS_DESCR
/end CHARACTERISTIC
/begin CHARACTERISTIC KLRTHFAK1 "RTHfaktor1 ueber Generatorstrom Fahrt" CURVE 0xFCB5B9 KlAxU8SstxU8WU8 3.984 fak_ub_b4 0.00 3.984 FORMAT "%5.3"
 /begin AXIS_DESCR STD_AXIS geni_end igen_ub_q1 11 0.00 254.0 FORMAT "%5.1" DEPOSIT ABSOLUTE /end AXIS_DESCR
/end CHARACTERISTIC
/begin CHARACTERISTIC KLRTHFAK12 "RTHfaktor1 ueber Generatorstrom Fahrt" CURVE 0xFCBD64 KlAxU8SstxU8WU8 3.984 fak_ub_b4 0.00 3.984 FORMAT "%5.3"
 /begin AXIS_DESCR STD_AXIS geni_end2 igen_ub_q1 11 0.00 254.0 FORMAT "%5.1" DEPOSIT ABSOLUTE /end AXIS_DESCR
/end CHARACTERISTIC
/begin CHARACTERISTIC KLRTHFAK2 "RTHfaktor2 ueber Generatorstrom Fahrt" CURVE 0xFCB5D0 KlAxU8SstxU8WU8 3.984 fak_ub_b4 0.00 3.984 FORMAT "%5.3"
 /begin AXIS_DESCR STD_AXIS geni_end igen_ub_q1 11 0.00 254.0 FORMAT "%5.1" DEPOSIT ABSOLUTE /end AXIS_DESCR
/end CHARACTERISTIC
/begin CHARACTERISTIC KLRTHFAK22 "RTHfaktor2 ueber Generatorstrom Fahrt" CURVE 0xFCBD7B KlAxU8SstxU8WU8 3.984 fak_ub_b4 0.00 3.984 FORMAT "%5.3"
 /begin AXIS_DESCR STD_AXIS geni_end2 igen_ub_q1 11 0.00 254.0 FORMAT "%5.1" DEPOSIT ABSOLUTE /end AXIS_DESCR
/end CHARACTERISTIC
/begin CHARACTERISTIC KLRTHFAK3 "RTHfaktor3 ueber Generatorstrom Fahrt" CURVE 0xFCB5E7 KlAxU8SstxU8WU8 3.984 fak_ub_b4 0.00 3.984 FORMAT "%5.3"
 /begin AXIS_DESCR STD_AXIS geni_end igen_ub_q1 11 0.00 254.0 FORMAT "%5.1" DEPOSIT ABSOLUTE /end AXIS_DESCR
/end CHARACTERISTIC
/begin CHARACTERISTIC KLRTHFAK4 "RTHfaktor4 ueber Generatorstrom Fahrt" CURVE 0xFCB5FE KlAxU8SstxU8WU8 3.984 fak_ub_b4 0.00 3.984 FORMAT "%5.3"
 /begin AXIS_DESCR STD_AXIS geni_end igen_ub_q1 11 0.00 254.0 FORMAT "%5.1" DEPOSIT ABSOLUTE /end AXIS_DESCR
/end CHARACTERISTIC
/begin CHARACTERISTIC KLRTHFAK5 "RTHfaktor5 ueber Generatorstrom Fahrt" CURVE 0xFCB615 KlAxU8SstxU8WU8 3.984 fak_ub_b4 0.00 3.984 FORMAT "%5.3"
 /begin AXIS_DESCR STD_AXIS geni_end igen_ub_q1 11 0.00 254.0 FORMAT "%5.1" DEPOSIT ABSOLUTE /end AXIS_DESCR
/end CHARACTERISTIC
/begin CHARACTERISTIC KLRTHFAK6 "RTHfaktor6 ueber Generatorstrom Fahrt" CURVE 0xFCB62C KlAxU8SstxU8WU8 3.984 fak_ub_b4 0.00 3.984 FORMAT "%5.3"
 /begin AXIS_DESCR STD_AXIS geni_end igen_ub_q1 11 0.00 254.0 FORMAT "%5.1" DEPOSIT ABSOLUTE /end AXIS_DESCR
/end CHARACTERISTIC
/begin CHARACTERISTIC KLRTHFAK7 "RTHfaktor7 ueber Generatorstrom Fahrt" CURVE 0xFCB643 KlAxU8SstxU8WU8 3.984 fak_ub_b4 0.00 3.984 FORMAT "%5.3"
 /begin AXIS_DESCR STD_AXIS geni_end igen_ub_q1 11 0.00 254.0 FORMAT "%5.1" DEPOSIT ABSOLUTE /end AXIS_DESCR
/end CHARACTERISTIC
/begin CHARACTERISTIC KLRTHGEN0 "RTH-Kennfeld Generator0" CURVE 0xFCB41A KlAxU8SstxU16WU16 1.000000 fak_uw_b64 0.00 1.000000 FORMAT "%8.6"
 /begin AXIS_DESCR STD_AXIS ngen_w ngen_uw_q0p5 6 0.00 32767.50 FORMAT "%8.2" DEPOSIT ABSOLUTE /end AXIS_DESCR
/end CHARACTERISTIC
/begin CHARACTERISTIC KLRTHGEN02 "RTH-Kennfeld Generator0" CURVE 0xFCBCBA KlAxU8SstxU16WU16 1.000000 fak_uw_b64 0.00 1.000000 FORMAT "%8.6"
 /begin AXIS_DESCR STD_AXIS ngen_w2 ngen_uw_q0p5 6 0.00 32767.50 FORMAT "%8.2" DEPOSIT ABSOLUTE /end AXIS_DESCR
/end CHARACTERISTIC
/begin CHARACTERISTIC KLRTHGEN1 "RTH-Kennfeld Generator1" CURVE 0xFCB434 KlAxU8SstxU16WU16 1.000000 fak_uw_b64 0.00 1.000000 FORMAT "%8.6"
 /begin AXIS_DESCR STD_AXIS ngen_w ngen_uw_q0p5 6 0.00 32767.50 FORMAT "%8.2" DEPOSIT ABSOLUTE /end AXIS_DESCR
/end CHARACTERISTIC
/begin CHARACTERISTIC KLRTHGEN12 "RTH-Kennfeld Generator1" CURVE 0xFCBCD4 KlAxU8SstxU16WU16 1.000000 fak_uw_b64 0.00 1.000000 FORMAT "%8.6"
 /begin AXIS_DESCR STD_AXIS ngen_w2 ngen_uw_q0p5 6 0.00 32767.50 FORMAT "%8.2" DEPOSIT ABSOLUTE /end AXIS_DESCR
/end CHARACTERISTIC
/begin CHARACTERISTIC KLRTHGEN2 "RTH-Kennfeld Generator2" CURVE 0xFCB44E KlAxU8SstxU16WU16 1.000000 fak_uw_b64 0.00 1.000000 FORMAT "%8.6"
 /begin AXIS_DESCR STD_AXIS ngen_w ngen_uw_q0p5 6 0.00 32767.50 FORMAT "%8.2" DEPOSIT ABSOLUTE /end AXIS_DESCR
/end CHARACTERISTIC
/begin CHARACTERISTIC KLRTHGEN22 "RTH-Kennfeld Generator2" CURVE 0xFCBCEE KlAxU8SstxU16WU16 1.000000 fak_uw_b64 0.00 1.000000 FORMAT "%8.6"
 /begin AXIS_DESCR STD_AXIS ngen_w2 ngen_uw_q0p5 6 0.00 32767.50 FORMAT "%8.2" DEPOSIT ABSOLUTE /end AXIS_DESCR
/end CHARACTERISTIC
/begin CHARACTERISTIC KLRTHGEN3 "RTH-Kennfeld Generator3" CURVE 0xFCB468 KlAxU8SstxU16WU16 1.000000 fak_uw_b64 0.00 1.000000 FORMAT "%8.6"
 /begin AXIS_DESCR STD_AXIS ngen_w ngen_uw_q0p5 6 0.00 32767.50 FORMAT "%8.2" DEPOSIT ABSOLUTE /end AXIS_DESCR
/end CHARACTERISTIC
/begin CHARACTERISTIC KLRTHGEN4 "RTH-Kennfeld Generator4" CURVE 0xFCB482 KlAxU8SstxU16WU16 1.000000 fak_uw_b64 0.00 1.000000 FORMAT "%8.6"
 /begin AXIS_DESCR STD_AXIS ngen_w ngen_uw_q0p5 6 0.00 32767.50 FORMAT "%8.2" DEPOSIT ABSOLUTE /end AXIS_DESCR
/end CHARACTERISTIC
/begin CHARACTERISTIC KLRTHGEN5 "RTH-Kennfeld Generator5" CURVE 0xFCB49C KlAxU8SstxU16WU16 1.000000 fak_uw_b64 0.00 1.000000 FORMAT "%8.6"
 /begin AXIS_DESCR STD_AXIS ngen_w ngen_uw_q0p5 6 0.00 32767.50 FORMAT "%8.2" DEPOSIT ABSOLUTE /end AXIS_DESCR
/end CHARACTERISTIC
/begin CHARACTERISTIC KLRTHGEN6 "RTH-Kennfeld Generator6" CURVE 0xFCB4B6 KlAxU8SstxU16WU16 1.000000 fak_uw_b64 0.00 1.000000 FORMAT "%8.6"
 /begin AXIS_DESCR STD_AXIS ngen_w ngen_uw_q0p5 6 0.00 32767.50 FORMAT "%8.2" DEPOSIT ABSOLUTE /end AXIS_DESCR
/end CHARACTERISTIC
/begin CHARACTERISTIC KLRTHGEN7 "RTH-Kennfeld Generator7" CURVE 0xFCB4D0 KlAxU8SstxU16WU16 1.000000 fak_uw_b64 0.00 1.000000 FORMAT "%8.6"
 /begin AXIS_DESCR STD_AXIS ngen_w ngen_uw_q0p5 6 0.00 32767.50 FORMAT "%8.2" DEPOSIT ABSOLUTE /end AXIS_DESCR
/end CHARACTERISTIC
/begin CHARACTERISTIC KLTANSGE02 "Kennlinie Generatoransaugluft0" CURVE 0xFCBD92 KlAxU8SstxU8WU8 191.3 temp_ub_q0p75_o48 -48.00 143.3 FORMAT "%5.1"
 /begin AXIS_DESCR STD_AXIS vfzg vfzg_ub_q1p25 10 0.00 318.8 FORMAT "%5.1" DEPOSIT ABSOLUTE /end AXIS_DESCR
/end CHARACTERISTIC
/begin CHARACTERISTIC KLTANSGE12 "Kennlinie Generatoransaugluft1" CURVE 0xFCBDA7 KlAxU8SstxU8WU8 191.3 temp_ub_q0p75_o48 -48.00 143.3 FORMAT "%5.1"
 /begin AXIS_DESCR STD_AXIS vfzg vfzg_ub_q1p25 10 0.00 318.8 FORMAT "%5.1" DEPOSIT ABSOLUTE /end AXIS_DESCR
/end CHARACTERISTIC
/begin CHARACTERISTIC KLTANSGE22 "Kennlinie Generatoransaugluft2" CURVE 0xFCBDBC KlAxU8SstxU8WU8 191.3 temp_ub_q0p75_o48 -48.00 143.3 FORMAT "%5.1"
 /begin AXIS_DESCR STD_AXIS vfzg vfzg_ub_q1p25 10 0.00 318.8 FORMAT "%5.1" DEPOSIT ABSOLUTE /end AXIS_DESCR
/end CHARACTERISTIC
/begin CHARACTERISTIC KLTANSGEN0 "Kennlinie Generatoransaugluft0" CURVE 0xFCB65A KlAxU8SstxU8WU8 191.3 temp_ub_q0p75_o48 -48.00 143.3 FORMAT "%5.1"
 /begin AXIS_DESCR STD_AXIS vfzg vfzg_ub_q1p25 10 0.00 318.8 FORMAT "%5.1" DEPOSIT ABSOLUTE /end AXIS_DESCR
/end CHARACTERISTIC
/begin CHARACTERISTIC KLTANSGEN1 "Kennlinie Generatoransaugluft1" CURVE 0xFCB66F KlAxU8SstxU8WU8 191.3 temp_ub_q0p75_o48 -48.00 143.3 FORMAT "%5.1"
 /begin AXIS_DESCR STD_AXIS vfzg vfzg_ub_q1p25 10 0.00 318.8 FORMAT "%5.1" DEPOSIT ABSOLUTE /end AXIS_DESCR
/end CHARACTERISTIC
/begin CHARACTERISTIC KLTANSGEN2 "Kennlinie Generatoransaugluft2" CURVE 0xFCB684 KlAxU8SstxU8WU8 191.3 temp_ub_q0p75_o48 -48.00 143.3 FORMAT "%5.1"
 /begin AXIS_DESCR STD_AXIS vfzg vfzg_ub_q1p25 10 0.00 318.8 FORMAT "%5.1" DEPOSIT ABSOLUTE /end AXIS_DESCR
/end CHARACTERISTIC
/begin CHARACTERISTIC KLTANSGEN3 "Kennlinie Generatoransaugluft3" CURVE 0xFCB699 KlAxU8SstxU8WU8 191.3 temp_ub_q0p75_o48 -48.00 143.3 FORMAT "%5.1"
 /begin AXIS_DESCR STD_AXIS vfzg vfzg_ub_q1p25 10 0.00 318.8 FORMAT "%5.1" DEPOSIT ABSOLUTE /end AXIS_DESCR
/end CHARACTERISTIC
/begin CHARACTERISTIC KLTANSGEN4 "Kennlinie Generatoransaugluft4" CURVE 0xFCB6AE KlAxU8SstxU8WU8 191.3 temp_ub_q0p75_o48 -48.00 143.3 FORMAT "%5.1"
 /begin AXIS_DESCR STD_AXIS vfzg vfzg_ub_q1p25 10 0.00 318.8 FORMAT "%5.1" DEPOSIT ABSOLUTE /end AXIS_DESCR
/end CHARACTERISTIC
/begin CHARACTERISTIC KLTANSGEN5 "Kennlinie Generatoransaugluft5" CURVE 0xFCB6C3 KlAxU8SstxU8WU8 191.3 temp_ub_q0p75_o48 -48.00 143.3 FORMAT "%5.1"
 /begin AXIS_DESCR STD_AXIS vfzg vfzg_ub_q1p25 10 0.00 318.8 FORMAT "%5.1" DEPOSIT ABSOLUTE /end AXIS_DESCR
/end CHARACTERISTIC
/begin CHARACTERISTIC KLTANSGEN6 "Kennlinie Generatoransaugluft6" CURVE 0xFCB6D8 KlAxU8SstxU8WU8 191.3 temp_ub_q0p75_o48 -48.00 143.3 FORMAT "%5.1"
 /begin AXIS_DESCR STD_AXIS vfzg vfzg_ub_q1p25 10 0.00 318.8 FORMAT "%5.1" DEPOSIT ABSOLUTE /end AXIS_DESCR
/end CHARACTERISTIC
/begin CHARACTERISTIC KLTANSGEN7 "Kennlinie Generatoransaugluft7" CURVE 0xFCB6ED KlAxU8SstxU8WU8 191.3 temp_ub_q0p75_o48 -48.00 143.3 FORMAT "%5.1"
 /begin AXIS_DESCR STD_AXIS vfzg vfzg_ub_q1p25 10 0.00 318.8 FORMAT "%5.1" DEPOSIT ABSOLUTE /end AXIS_DESCR
/end CHARACTERISTIC
/begin CHARACTERISTIC KLTKWI "" CURVE 0xFCEC88 KlAxU8SstxS16WS16 200.0000 fak_q0p1 -100.0000 100.0000 FORMAT "%8.4"
 /begin AXIS_DESCR STD_AXIS tkwdiff temp_ub_q0p75_o48 13 -24624.00 24527.25 FORMAT "%8.2" DEPOSIT ABSOLUTE /end AXIS_DESCR
/end CHARACTERISTIC
/begin CHARACTERISTIC KLTKWP "" CURVE 0xFCECBE KlAxU8SstxS16WS16 200.0000 fak_q0p1 -100.0000 100.0000 FORMAT "%8.4"
 /begin AXIS_DESCR STD_AXIS tkwdiff temp_ub_q0p75_o48 13 -24624.00 24527.25 FORMAT "%8.2" DEPOSIT ABSOLUTE /end AXIS_DESCR
/end CHARACTERISTIC
/begin CHARACTERISTIC KLWDMRKHZ "Wichtungskennlinie f¸r Korrekturfaktor OSC" CURVE 0xFD2B0A KlAUbSstUwWUw 0.9999847 fak_uw_b1 0.00 0.9999847 FORMAT "%9.7"
 /begin AXIS_DESCR STD_AXIS fcoschmn_w fak_uw_b2 8 0.00 1.999969 FORMAT "%8.6" DEPOSIT ABSOLUTE /end AXIS_DESCR
/end CHARACTERISTIC
/begin CHARACTERISTIC KRAL1N "Klopfregeladaption Lastbereich 1" CURVE 0xFD2ED7 KlAUbSstUbWUb 191.3 rel_ub_q0p75 0.00 191.3 FORMAT "%5.1"
 /begin AXIS_DESCR STD_AXIS nmot nmot_ub_q40 16 0.00 10200. FORMAT "%5.0" DEPOSIT ABSOLUTE /end AXIS_DESCR
/end CHARACTERISTIC
/begin CHARACTERISTIC KRAL2N "Klopfregeladaption Lastbereich 2" CURVE 0xFD2EF8 KlAUbSstUbWUb 191.3 rel_ub_q0p75 0.00 191.3 FORMAT "%5.1"
 /begin AXIS_DESCR STD_AXIS nmot nmot_ub_q40 16 0.00 10200. FORMAT "%5.0" DEPOSIT ABSOLUTE /end AXIS_DESCR
/end CHARACTERISTIC
/begin CHARACTERISTIC KRALH "Klopfregeladaption Lasthysterese" VALUE 0xFD2F19 KwUb 191.3 rel_ub_q0p75 0.00 191.3 FORMAT "%5.1" /end CHARACTERISTIC
/begin CHARACTERISTIC KRAN1 "Klopfregeladaption Drehzahlbereich, St¸tzstelle 1" VALUE 0xFD2F1A KwUb 10200. nmot_ub_q40 0.00 10200. FORMAT "%5.0" /end CHARACTERISTIC
/begin CHARACTERISTIC KRAN2 "Klopfregeladaption Drehzahlbereich, St¸tzstelle 2" VALUE 0xFD2F1B KwUb 10200. nmot_ub_q40 0.00 10200. FORMAT "%5.0" /end CHARACTERISTIC
/begin CHARACTERISTIC KRAN3 "Klopfregeladaption Drehzahlbereich, St¸tzstelle 3" VALUE 0xFD2F1C KwUb 10200. nmot_ub_q40 0.00 10200. FORMAT "%5.0" /end CHARACTERISTIC
/begin CHARACTERISTIC KRAN4 "Klopfregeladaption Drehzahlbereich, St¸tzstelle 4" VALUE 0xFD2F1D KwUb 10200. nmot_ub_q40 0.00 10200. FORMAT "%5.0" /end CHARACTERISTIC
/begin CHARACTERISTIC KRANH "Klopfregeladaption Drehzahlhysterese" VALUE 0xFD2F1E KwUb 10200. nmot_ub_q40 0.00 10200. FORMAT "%5.0" /end CHARACTERISTIC
/begin CHARACTERISTIC KRDWA "Klopfregelung Differenz aktueller ZW zu Adaptionskennfeld" VALUE 0xFC84E0 KwUb 191.3 zw_ub_q0p75 0.00 191.3 FORMAT "%5.1" /end CHARACTERISTIC
/begin CHARACTERISTIC KRDWKLA "Der SV-Lernbetrag f¸r die KR-Adaption nach einem erkannten Klopfereignis" VALUE 0xFC84E1 KwSb 12.00 zw_ub_qn0p75 -6.000 6.000 FORMAT "%5.3" /end CHARACTERISTIC
/begin CHARACTERISTIC KRDWSA "Der FV-Lernbetrag f¸r die KR-Adaption wenn wkra-wkr > KRDWA" VALUE 0xFC84E2 KwUb 6.000 zw_ub_q0p75 0.00 6.000 FORMAT "%5.3" /end CHARACTERISTIC
/begin CHARACTERISTIC KRDWSN "Klopfregelung delta - Winkel Sicherheit" CURVE 0xFD2F1F KlAUbSstUbWUb 191.3 zw_ub_qn0p75 -191.3 0.00 FORMAT "%5.1"
 /begin AXIS_DESCR STD_AXIS nmot nmot_ub_q40 16 0.00 10200. FORMAT "%5.0" DEPOSIT ABSOLUTE /end AXIS_DESCR
/end CHARACTERISTIC
/begin CHARACTERISTIC KRFKN "Sp‰tverstellung pro Klopfereignis" CURVE 0xFD2F40 KlAUbSstUbWUb 191.3 zw_ub_qn0p75 -191.3 0.00 FORMAT "%5.1"
 /begin AXIS_DESCR STD_AXIS nmot nmot_ub_q40 16 0.00 10200. FORMAT "%5.0" DEPOSIT ABSOLUTE /end AXIS_DESCR
/end CHARACTERISTIC
/begin CHARACTERISTIC KRKFKS "Zuordnung der Kloperkennungskennlinie bei fehlender Zyl.-1-Erkennung" VALUE 0xFC8732 KwUb 255.0 dez 0.00 255.0 FORMAT "%5.1" /end CHARACTERISTIC
/begin CHARACTERISTIC KRLMDY "Lesen bei Lastbereichswechsel: immer oder nur bei Dynamik" VALUE 0xFC84E3 KwUb 1.000 dez 0.00 1.000 FORMAT "%5.3" /end CHARACTERISTIC
/begin CHARACTERISTIC KRMXN "maximale Sp‰tverstellung" CURVE 0xFD2F61 KlAUbSstUbWUb 190.5 zw_ub_qn0p75 -191.3 -0.7500 FORMAT "%5.1"
 /begin AXIS_DESCR STD_AXIS nmot nmot_ub_q40 16 0.00 10200. FORMAT "%5.0" DEPOSIT ABSOLUTE /end AXIS_DESCR
/end CHARACTERISTIC
/begin CHARACTERISTIC KRMXNLL "maximale Sp‰tverstellung im Leerlauf" CURVE 0xFD2F82 KlAUbSstUbWUb 190.5 zw_ub_qn0p75 -191.3 -0.7500 FORMAT "%5.1"
 /begin AXIS_DESCR STD_AXIS nmot nmot_ub_q40 16 0.00 10200. FORMAT "%5.0" DEPOSIT ABSOLUTE /end AXIS_DESCR
/end CHARACTERISTIC
/begin CHARACTERISTIC KRNMDY "Lesen bei Drehzahlbereichswechsel: immer oder nur bei Dynamik" VALUE 0xFC84E4 KwUb 1.000 dez 0.00 1.000 FORMAT "%5.3" /end CHARACTERISTIC
/begin CHARACTERISTIC KRVFLN "Anz. Z¸nd./Zyl., bzw. Zeitangabe von Fr¸hverst. zu Fr¸hverst. (Stufenbreite-KR)" MAP 0xFD2FA3 KfAxUbAyUbSstxUbSstyUbWUb 254.0 dez 1.000 255.0 FORMAT "%5.1"
 /begin AXIS_DESCR STD_AXIS nmot nmot_ub_q40 12 0.00 10200. FORMAT "%5.0" DEPOSIT ABSOLUTE /end AXIS_DESCR
 /begin AXIS_DESCR STD_AXIS rl rel_ub_q0p75 4 0.00 191.3 FORMAT "%5.1" DEPOSIT ABSOLUTE /end AXIS_DESCR
/end CHARACTERISTIC
/begin CHARACTERISTIC KRVFSLN "Anzahl Z¸ndungen/Zyl., oder Zeitangabe f¸r schnelle Fr¸hverstellung der KR" MAP 0xFD2FE5 KfAxUbAyUbSstxUbSstyUbWUb 254.0 dez 1.000 255.0 FORMAT "%5.1"
 /begin AXIS_DESCR STD_AXIS nmot nmot_ub_q40 12 0.00 10200. FORMAT "%5.0" DEPOSIT ABSOLUTE /end AXIS_DESCR
 /begin AXIS_DESCR STD_AXIS rl rel_ub_q0p75 4 0.00 191.3 FORMAT "%5.1" DEPOSIT ABSOLUTE /end AXIS_DESCR
/end CHARACTERISTIC
/begin CHARACTERISTIC KRVST "Verst‰rkung nach Start" VALUE 0xFC8733 KwUb 6.000 dez 0.00 6.000 FORMAT "%5.3" /end CHARACTERISTIC
/begin CHARACTERISTIC KSZA "Anzahl Klopfsensoren" VALUE 0xFC8734 KwUb 3.000 dez 1.000 4.000 FORMAT "%5.3" /end CHARACTERISTIC
/begin CHARACTERISTIC KWBAIMV "Anzahl Geschwindigkeitsimpulse pro km f¸r Normierung v-Signal in Abh. von vmaxid" VAL_BLK 0xFC813C KwbWU32 460799999892.71161 aimv_ul_b4p608e11 107.28836062068315 460800000000.00000 FORMAT "%19.6" NUMBER 8 /end CHARACTERISTIC
/begin CHARACTERISTIC LIMTKOA "Zeitschwelle um den Kompressor unbegrenzt auszuschalten" VALUE 0xFD5550 KwWU8 51.00 t200msxs_ub_b51 0.00 51.00 FORMAT "%5.2" /end CHARACTERISTIC
/begin CHARACTERISTIC LKRALL "Bedingung  Leerlaufadaption aktiv" VALUE 0xFC84DA KwWU8 191.3 rel_ub_q0p75 0.00 191.3 FORMAT "%5.1" /end CHARACTERISTIC
/begin CHARACTERISTIC LKRN "Lastschwelle Klopfregelung" CURVE 0xFD3027 KlAUbSstUbWUb 191.3 rel_ub_q0p75 0.00 191.3 FORMAT "%5.1"
 /begin AXIS_DESCR STD_AXIS nmot nmot_ub_q40 16 0.00 10200. FORMAT "%5.0" DEPOSIT ABSOLUTE /end AXIS_DESCR
/end CHARACTERISTIC
/begin CHARACTERISTIC LKRNNL "" CURVE 0xFD3048 KlAUbSstUbWUb 191.3 rel_ub_q0p75 0.00 191.3 FORMAT "%5.1"
 /begin AXIS_DESCR STD_AXIS nmot nmot_ub_q40 16 0.00 10200. FORMAT "%5.0" DEPOSIT ABSOLUTE /end AXIS_DESCR
/end CHARACTERISTIC
/begin CHARACTERISTIC MANAWNUMM "manuelle Kennfeldauswahlnummeroffset" VALUE 0xFCB7CD KwWU8 255.0 DEZ 0.00 255.0 FORMAT "%5.1" /end CHARACTERISTIC
/begin CHARACTERISTIC MANAWNUMM2 "manuelle Kennfeldauswahlnummeroffset" VALUE 0xFCBE42 KwWU8 255.0 DEZ 0.00 255.0 FORMAT "%5.1" /end CHARACTERISTIC
/begin CHARACTERISTIC MDKOAN "Drehmomentschwelle um den Klimakompressor abzuschalten" CURVE 0xFD5528 GklWU8 99.61 rel_ub_b99p6 0.00 99.61 FORMAT "%5.2"
 /begin AXIS_DESCR COM_AXIS nmot nmot_ub_q40 8 0.00 65520. FORMAT "%5.0" AXIS_PTS_REF SNM08KOUB /end AXIS_DESCR
/end CHARACTERISTIC
/begin CHARACTERISTIC MDKOEN "Drehmomentschwelle um den Klimakompressor einzuschalten" CURVE 0xFD5530 GklWU8 99.61 rel_ub_b99p6 0.00 99.61 FORMAT "%5.2"
 /begin AXIS_DESCR COM_AXIS nmot nmot_ub_q40 8 0.00 65520. FORMAT "%5.0" AXIS_PTS_REF SNM08KOUB /end AXIS_DESCR
/end CHARACTERISTIC
/begin CHARACTERISTIC MKRSTFAK "Kennlinie Umrechnung Kraftstoff Sollvolumen Faktot Abk¸hlung" CURVE 0xFC766A KlAxU8SstxU8WU8 1.992 fak_ub_b2 0.00 1.992 FORMAT "%5.3"
 /begin AXIS_DESCR STD_AXIS vsskrst fuel_ub_q1 9 0.00 255.0 FORMAT "%5.1" DEPOSIT ABSOLUTE /end AXIS_DESCR
/end CHARACTERISTIC
/begin CHARACTERISTIC NFKRAS "Drehzahlschwelle f¸r Schreibfreigabe Klopfregeladaption" VALUE 0xFC84E5 KwUb 10200. nmot_ub_q40 0.00 10200. FORMAT "%5.0" /end CHARACTERISTIC
/begin CHARACTERISTIC NGKRWN "Schwellwert Drehzahlgradient f¸r Dynamikerkennung" CURVE 0xFD2E32 KlAUwSstUwWUw 12799.77 nmotg_nuw_q0p39 0.00 12799.77 FORMAT "%8.2"
 /begin AXIS_DESCR STD_AXIS nmot nmot_ub_q40 16 0.00 10200. FORMAT "%5.0" DEPOSIT ABSOLUTE /end AXIS_DESCR
/end CHARACTERISTIC
/begin CHARACTERISTIC NKRF "Drehzahlschwelle f¸r Klopfregelfreigabe" VALUE 0xFC84E6 KwUb 10200. nmot_ub_q40 0.00 10200. FORMAT "%5.0" /end CHARACTERISTIC
/begin CHARACTERISTIC NNGKRWN "Schwellwert Drehzahlgradient f¸r Dynamikerkennung" CURVE 0xFD2E74 KlAUwSstUwWUw 25599.55 nmotg_nuw_q0p39 -12799.77 12799.77 FORMAT "%8.2"
 /begin AXIS_DESCR STD_AXIS nmot nmot_ub_q40 16 0.00 10200. FORMAT "%5.0" DEPOSIT ABSOLUTE /end AXIS_DESCR
/end CHARACTERISTIC
/begin CHARACTERISTIC NVRBUPMAX "Max.Anzahl abgebrochener NVRAM-Backup's/Flash" VALUE 0xFCC9DB KwWU8 255.0 DEZ 0.00 255.0 FORMAT "%5.1" /end CHARACTERISTIC
/begin CHARACTERISTIC PRELLGTMO2 "Prellzeit f¸r Tmot-Schwelle" VALUE 0xFCBE43 KwWU8 255.0 t1sxs_ub_b255 0.00 255.0 FORMAT "%5.1" /end CHARACTERISTIC
/begin CHARACTERISTIC PRELLGTMOT "Prellzeit f¸r Tmot-Schwelle" VALUE 0xFCB7CE KwWU8 255.0 t1sxs_ub_b255 0.00 255.0 FORMAT "%5.1" /end CHARACTERISTIC
/begin CHARACTERISTIC PZWKRA "Prozentuale H‰ufigkeit der ZW-Ausgabe durch die KR w‰hrend Dynamikadaption" VALUE 0xFC84BF KwUb 99.61 rel_ub_b99p6 0.00 99.61 FORMAT "%5.2" /end CHARACTERISTIC
/begin CHARACTERISTIC REFINI "Startwert Referenzpegel bei Klopfregelung aktiv" VALUE 0xFC8735 KwUb 0.7227 spg_ub_b5 0.2930 1.016 FORMAT "%5.3" /end CHARACTERISTIC
/begin CHARACTERISTIC RKREM1N "" CURVE 0xFC86E9 GklWU8 0.9961 fak_ub_b1 0.00 0.9961
 /begin AXIS_DESCR COM_AXIS nmot nmot_ub_q40 16 0.00 10200. FORMAT "%5.0" AXIS_PTS_REF SN16KR1UB /end AXIS_DESCR
/end CHARACTERISTIC
/begin CHARACTERISTIC RKREM2N "" CURVE 0xFC86F9 GklWU8 0.9961 fak_ub_b1 0.00 0.9961
 /begin AXIS_DESCR COM_AXIS nmot nmot_ub_q40 16 0.00 10200. FORMAT "%5.0" AXIS_PTS_REF SN16KR2UB /end AXIS_DESCR
/end CHARACTERISTIC
/begin CHARACTERISTIC RKRMX1N "Maximaler Referenzpegel f¸r Klopferkennungsschwelle Zyl.-gruppe 1" CURVE 0xFC8709 GklWU8 317.500 spg_ub_b320 1.25000 318.750
 /begin AXIS_DESCR COM_AXIS nmot nmot_ub_q40 16 0.00 10200. FORMAT "%5.0" AXIS_PTS_REF SN16KR1UB /end AXIS_DESCR
/end CHARACTERISTIC
/begin CHARACTERISTIC RKRMX2N "Maximaler Referenzpegel f¸r Klopferkennungsschwelle Zyl.-gruppe 2" CURVE 0xFC8719 GklWU8 317.500 spg_ub_b320 1.25000 318.750
 /begin AXIS_DESCR COM_AXIS nmot nmot_ub_q40 16 0.00 10200. FORMAT "%5.0" AXIS_PTS_REF SN16KR2UB /end AXIS_DESCR
/end CHARACTERISTIC
/begin AXIS_PTS SEH06KRUW "St¸tzstellenverteilung evhubi_w, 6 Sst." 0xFCF8AA evhubi_w SstASwSstSw 65.53500 hub_uw_q0p001 6 0.00 65.53500 FORMAT "%8.5" DEPOSIT ABSOLUTE /end AXIS_PTS
/begin CHARACTERISTIC SENE1 "Sensorersatz f¸r Klopfsensor 1" VALUE 0xFC84DB KwWU8 255.0 dezsub1 1.000 256.0 FORMAT "%5.1" /end CHARACTERISTIC
/begin CHARACTERISTIC SENE2 "Sensorersatz f¸r Klopfsensor 2" VALUE 0xFC84DC KwWU8 255.0 dezsub1 1.000 256.0 FORMAT "%5.1" /end CHARACTERISTIC
/begin CHARACTERISTIC SENE3 "Sensorersatz f¸r Klopfsensor 3" VALUE 0xFC84DD KwWU8 255.0 dezsub1 1.000 256.0 FORMAT "%5.1" /end CHARACTERISTIC
/begin CHARACTERISTIC SENE4 "Sensorersatz f¸r Klopfsensor 4" VALUE 0xFC84DE KwWU8 255.0 dezsub1 1.000 256.0 FORMAT "%5.1" /end CHARACTERISTIC
/begin AXIS_PTS SN16KR1UB "" 0xFC1336 nmot SstAU8SstU8 10200. nmot_ub_q40 16 0.00 10200. FORMAT "%5.0" DEPOSIT ABSOLUTE /end AXIS_PTS
/begin AXIS_PTS SN16KR2UB "" 0xFC1347 nmot SstAU8SstU8 10200. nmot_ub_q40 16 0.00 10200. FORMAT "%5.0" DEPOSIT ABSOLUTE /end AXIS_PTS
/begin AXIS_PTS SNM08KOUB "St¸tzstellenverteilung f¸r Klimakompressorsteuerung  8  nmot" 0xFD5556 nmot SstAU8SstU16 65535. nmot_ub_q40 8 0.00 65520. FORMAT "%5.0" DEPOSIT ABSOLUTE /end AXIS_PTS
/begin AXIS_PTS SNM08KRUW "St¸tzstellenverteilung Drehzahl, 8 Sst." 0xFCF900 nmot_w SstAUwSstUw 16383.75 nmot_uw_q0p25 8 0.00 16383.75 FORMAT "%8.2" DEPOSIT ABSOLUTE /end AXIS_PTS
/begin AXIS_PTS SNM16KRUB "St¸tzstellenverteilung Drehzahl, 16 Sst." 0xFCF831 nmot SstAUbSstUb 10200. nmot_ub_q40 16 0.00 10200. FORMAT "%5.0" DEPOSIT ABSOLUTE /end AXIS_PTS
/begin AXIS_PTS SRL04KRUB "St¸tzstellenverteilung relative F¸llung, 4 Sst." 0xFCF842 rl SstAUbSstUb 191.3 rel_ub_q0p75 4 0.00 191.3 FORMAT "%5.1" DEPOSIT ABSOLUTE /end AXIS_PTS
/begin CHARACTERISTIC STKRLDY "St¸tzstellengrenzwert f¸r KR-Adaption bei Lastdynamik" VALUE 0xFC84E7 KwUb 255.0 dez 0.00 255.0 FORMAT "%5.1" /end CHARACTERISTIC
/begin CHARACTERISTIC STKRNDY "St¸tzstellengrenzwert f¸r KR-Adaption bei Drehzahldynamik" VALUE 0xFC84E8 KwUb 255.0 dez 0.00 255.0 FORMAT "%5.1" /end CHARACTERISTIC
/begin AXIS_PTS SWD06KRSW "St¸tzstellenverteilung DK-Winkel, 6 Sst." 0xFCF91E wdkba_w SstASwSstSw 1599.976 relDK_q0p02441 6 -800.0000 799.9756 FORMAT "%8.4" DEPOSIT ABSOLUTE /end AXIS_PTS
/begin CHARACTERISTIC S_IGMISCH "" VALUE 0xFCB7CF KwWU8 1.000 default 0.00 1.000 FORMAT "%5.3" /end CHARACTERISTIC
/begin CHARACTERISTIC S_IGMISCH2 "Schalter IG-Mischung" VALUE 0xFCBE44 KwWU8 1.000 default 0.00 1.000 FORMAT "%5.3" /end CHARACTERISTIC
/begin CHARACTERISTIC T2GIPTES "Filterkonstante (Zeit) f¸r Berechnung der zweiten Pumpstrom-Ableitung" VALUE 0xFD4920 KwWU16 6553.4999985 zk100msxs_uw_b6553 0.10000152590 6553.6000000 FORMAT "%12.7" /end CHARACTERISTIC
/begin CHARACTERISTIC TABKOR "Kennlinie Korrektur tkrststart ¸ber Abstellzeit" CURVE 0xFC762A KlAxU8SstxU16WU16 1.992188 fak_ub_b2 0.00 1.992188 FORMAT "%8.6"
 /begin AXIS_DESCR STD_AXIS tabst_w t1sxs_uw_q1 9 0.00 65535.00 FORMAT "%8.2" DEPOSIT ABSOLUTE /end AXIS_DESCR
/end CHARACTERISTIC
/begin CHARACTERISTIC TABPM "Zeitschwelle: Zwangsabspeicherung NVRAM im Flash" VALUE 0xFCC9DC KwWU8 253.0 t1sxs_q1 0.00 253.0 FORMAT "%5.1" /end CHARACTERISTIC
/begin CHARACTERISTIC TDDPSF "Verzˆgerung Stromabfallerkennung w‰hrend Messung" VALUE 0xFD4922 KwWU16 6553.500 t_q0p1 0.00 6553.500 FORMAT "%8.3" /end CHARACTERISTIC
/begin CHARACTERISTIC TEEMRDYMAX "Max. Wert Zeitz‰hler f¸r EEPROM-Spiegel-Bereitschaft" VALUE 0xFD27FC KwUb 25.30 t100msxs_ub_b25p5 0.2000 25.50 FORMAT "%5.2" /end CHARACTERISTIC
/begin CHARACTERISTIC TFNVRBUP "Timeout: Testeranforderung ""erzwungenes NVRAM-Backup""" VALUE 0xFCC9D8 KwWU16 6553.500 t100msxs_uw_b6553p5 0.00 6553.500 FORMAT "%8.3" /end CHARACTERISTIC
/begin CHARACTERISTIC TG2IPTESF "Filterzeitkonstante f¸r Tiefpaﬂ-Filterung der zweiten Pumpstrom-Ableitung" VALUE 0xFD4924 KwWU16 6553.4999985 zk100msxs_uw_b6553 0.10000152590 6553.6000000 FORMAT "%12.7" /end CHARACTERISTIC
/begin CHARACTERISTIC TGGLS "Zeitdauer f¸r ADC nach Interrupt im Funktionsrechner (Asic)" VALUE 0xFC813A KwUb 2.000 t1msxms_q1 3.000 5.000 FORMAT "%5.3" /end CHARACTERISTIC
/begin CHARACTERISTIC TGIPTES "Filterkonstante (Zeit) f¸r Berechnung der Pumpstrom-Ableitung" VALUE 0xFD4926 KwWU16 6553.4999985 zk100msxs_uw_b6553 0.10000152590 6553.6000000 FORMAT "%12.7" /end CHARACTERISTIC
/begin CHARACTERISTIC TGIPTESF "Filterzeitkonstante f¸r Tiefpaﬂ-Filterung der Pumpstrom-Ableitung" VALUE 0xFD4928 KwWU16 6553.4999985 zk100msxs_uw_b6553 0.10000152590 6553.6000000 FORMAT "%12.7" /end CHARACTERISTIC
/begin CHARACTERISTIC TIGMISCH "" VALUE 0xFCB7D0 KwWU8 2.550 t10msxs_ub_b2p55 0.00 2.550 FORMAT "%5.3" /end CHARACTERISTIC
/begin CHARACTERISTIC TIGMISCH2 "Verzˆgerungzeit IGMISCH" VALUE 0xFCBE45 KwWU8 2.550 t10msxs_ub_b2p55 0.00 2.550 FORMAT "%5.3" /end CHARACTERISTIC
/begin CHARACTERISTIC TKAKOR "Kennlinie Korrektur" CURVE 0xFC7650 KlAxU8SstxS16WS16 383.2500 temp_sb_q0p75 -192.0000 191.2500 FORMAT "%8.4"
 /begin AXIS_DESCR STD_AXIS tkakor_in temp_sb_q0p75 6 -192.0000 191.2500 FORMAT "%8.4" DEPOSIT ABSOLUTE /end AXIS_DESCR
/end CHARACTERISTIC
/begin CHARACTERISTIC TKOAMNN "Minimale Abschaltzeit des Klimakompressors" CURVE 0xFD5538 GklWU8 51.00 t200msxs_ub_b51 0.00 51.00 FORMAT "%5.2"
 /begin AXIS_DESCR COM_AXIS nmot nmot_ub_q40 8 0.00 65520. FORMAT "%5.0" AXIS_PTS_REF SNM08KOUB /end AXIS_DESCR
/end CHARACTERISTIC
/begin CHARACTERISTIC TKOAMXN "Maximale Abschaltzeit des Klimakompressors" CURVE 0xFD5540 GklWU8 51.00 t200msxs_ub_b51 0.00 51.00 FORMAT "%5.2"
 /begin AXIS_DESCR COM_AXIS nmot nmot_ub_q40 8 0.00 65520. FORMAT "%5.0" AXIS_PTS_REF SNM08KOUB /end AXIS_DESCR
/end CHARACTERISTIC
/begin CHARACTERISTIC TKOEMNN "Minimale Einschaltzeit des Klimakompressors" CURVE 0xFD5548 GklWU8 51.00 t200msxs_ub_b51 0.00 51.00 FORMAT "%5.2"
 /begin AXIS_DESCR COM_AXIS nmot nmot_ub_q40 8 0.00 65520. FORMAT "%5.0" AXIS_PTS_REF SNM08KOUB /end AXIS_DESCR
/end CHARACTERISTIC
/begin CHARACTERISTIC TKRSTINT "Initialisierung tkrstab" VALUE 0xFC7686 KwWU8 191.3 temp_ub_q0p75_o48 -48.00 143.3 FORMAT "%5.1" /end CHARACTERISTIC
/begin CHARACTERISTIC TKWBERGMAX "" VALUE 0xFCECFC KwWU16 127.9961 fak_uw_b256 0.00 127.9961 FORMAT "%8.4" /end CHARACTERISTIC
/begin CHARACTERISTIC TKWBERGMIN "" VALUE 0xFCECFE KwWU16 127.9961 fak_uw_b256 0.00 127.9961 FORMAT "%8.4" /end CHARACTERISTIC
/begin CHARACTERISTIC TKWI "" VALUE 0xFCED00 KwWU16 0.9999847 fak_uw_b1 0.00 0.9999847 FORMAT "%9.7" /end CHARACTERISTIC
/begin CHARACTERISTIC TKWKRMAX "obere Integratorbegrenzung KR" VALUE 0xFCED02 KwWU16 127.9961 fak_uw_b256 0.00 127.9961 FORMAT "%8.4" /end CHARACTERISTIC
/begin CHARACTERISTIC TKWKRMIN "untere Integratorbegrenzung KR" VALUE 0xFCED04 KwWU16 127.9961 fak_uw_b256 0.00 127.9961 FORMAT "%8.4" /end CHARACTERISTIC
/begin CHARACTERISTIC TKWLASTMAX "" VALUE 0xFCED06 KwWU16 127.9961 fak_uw_b256 0.00 127.9961 FORMAT "%8.4" /end CHARACTERISTIC
/begin CHARACTERISTIC TKWLASTMIN "" VALUE 0xFCED08 KwWU16 127.9961 fak_uw_b256 0.00 127.9961 FORMAT "%8.4" /end CHARACTERISTIC
/begin CHARACTERISTIC TKWPWMMN "" VALUE 0xFCED0A KwWS16 3376.800 fak_q0p1 -3276.800 100.0000 FORMAT "%8.3" /end CHARACTERISTIC
/begin CHARACTERISTIC TKWPWMMX "" VALUE 0xFCED0C KwWS16 3376.800 fak_q0p1 -3276.800 100.0000 FORMAT "%8.3" /end CHARACTERISTIC
/begin CHARACTERISTIC TKWSBERG "" VALUE 0xFCED13 KwWU8 191.3 temp_ub_q0p75_o48 -48.00 143.3 FORMAT "%5.1" /end CHARACTERISTIC
/begin CHARACTERISTIC TKWSGOT "" VALUE 0xFCED14 KwWU8 191.3 temp_ub_q0p75_o48 -48.00 143.3 FORMAT "%5.1" /end CHARACTERISTIC
/begin CHARACTERISTIC TKWSKR "Solltemperatur bei B_tkwkr" VALUE 0xFCED15 KwWU8 191.3 temp_ub_q0p75_o48 -48.00 143.3 FORMAT "%5.1" /end CHARACTERISTIC
/begin CHARACTERISTIC TKWSLAST "" VALUE 0xFCED16 KwWU8 191.3 temp_ub_q0p75_o48 -48.00 143.3 FORMAT "%5.1" /end CHARACTERISTIC
/begin CHARACTERISTIC TKWSMAX "" VALUE 0xFCED17 KwWU8 191.3 temp_ub_q0p75_o48 -48.00 143.3 FORMAT "%5.1" /end CHARACTERISTIC
/begin CHARACTERISTIC TKWSNTKW "" VALUE 0xFCED18 KwWU8 191.3 temp_ub_q0p75_o48 -48.00 143.3 FORMAT "%5.1" /end CHARACTERISTIC
/begin CHARACTERISTIC TKWSTANS "" VALUE 0xFCED19 KwWU8 191.3 temp_ub_q0p75_o48 -48.00 143.3 FORMAT "%5.1" /end CHARACTERISTIC
/begin CHARACTERISTIC TKWSUETEMP "" VALUE 0xFCED1A KwWU8 191.3 temp_ub_q0p75_o48 -48.00 143.3 FORMAT "%5.1" /end CHARACTERISTIC
/begin CHARACTERISTIC TKWTANSMAX "" VALUE 0xFCED0E KwWU16 127.9961 fak_uw_b256 0.00 127.9961 FORMAT "%8.4" /end CHARACTERISTIC
/begin CHARACTERISTIC TKWTANSMIN "" VALUE 0xFCED10 KwWU16 127.9961 fak_uw_b256 0.00 127.9961 FORMAT "%8.4" /end CHARACTERISTIC
/begin CHARACTERISTIC TMDYNA "TMOT - Schwelle f¸r Lastdynamikadaption aktiv" VALUE 0xFC84C0 KwUb 191.3 temp_ub_q0p75_o48 -48.00 143.3 FORMAT "%5.1" /end CHARACTERISTIC
/begin CHARACTERISTIC TMKOAO "Obere Motortemperaturschwelle f¸r Kompressorabschaltung" VALUE 0xFD5551 KwWU8 191.3 temp_ub_q0p75_o48 -48.00 143.3 FORMAT "%5.1" /end CHARACTERISTIC
/begin CHARACTERISTIC TMKOAU "Untere Motortemperaturschwelle f¸r Kompressorabschaltung" VALUE 0xFD5552 KwWU8 191.3 temp_ub_q0p75_o48 -48.00 143.3 FORMAT "%5.1" /end CHARACTERISTIC
/begin CHARACTERISTIC TMKR "Motortemperaturschwelle f¸r Klopfregelung aktiv" VALUE 0xFD3069 KwUb 191.3 temp_ub_q0p75_o48 -48.00 143.3 FORMAT "%5.1" /end CHARACTERISTIC
/begin CHARACTERISTIC TMKRA "Motortemperaturschwelle f¸r adaptive Klopfregelung" VALUE 0xFD306A KwUb 191.3 temp_ub_q0p75_o48 -48.00 143.3 FORMAT "%5.1" /end CHARACTERISTIC
/begin CHARACTERISTIC TMOTHLS "" VALUE 0xFD289F KwUb 191.3 temp_ub_q0p75_o48 -48.00 143.3 FORMAT "%5.1" /end CHARACTERISTIC
/begin CHARACTERISTIC TMOTTKWMAX "" VALUE 0xFCED1B KwWU8 191.3 temp_ub_q0p75_o48 -48.00 143.3 FORMAT "%5.1" /end CHARACTERISTIC
/begin CHARACTERISTIC TMOTTKWMIN "" VALUE 0xFCED1C KwWU8 191.3 temp_ub_q0p75_o48 -48.00 143.3 FORMAT "%5.1" /end CHARACTERISTIC
/begin CHARACTERISTIC TNSTKO "Unterdr¸ckungszeit des Kompressors nach dem Start" VALUE 0xFD5553 KwWU8 51.00 t200msxs_ub_b51 0.00 51.00 FORMAT "%5.2" /end CHARACTERISTIC
/begin CHARACTERISTIC TSTCNTEN "Enable TestCounter" VALUE 0xFCB7D1 KwWU8 1.000 DEZ 0.00 1.000 FORMAT "%5.3" /end CHARACTERISTIC
/begin CHARACTERISTIC TSTCNTEN2 "Enable TestCounter" VALUE 0xFCBE46 KwWU8 1.000 DEZ 0.00 1.000 FORMAT "%5.3" /end CHARACTERISTIC
/begin CHARACTERISTIC TSTFIL_II2 "Initialisierung Testfilter" VALUE 0xFCBE47 KwWU8 255.0 dez 0.00 255.0 FORMAT "%5.1" /end CHARACTERISTIC
/begin CHARACTERISTIC TSTFIL_IN "Testfilter Eingang" VALUE 0xFCB738 KwWU16 768.0000 gendt_q0p075 0.00 768.0000 FORMAT "%8.4" /end CHARACTERISTIC
/begin CHARACTERISTIC TSTFIL_IN2 "Testfilter Eingang" VALUE 0xFCBDFE KwWU16 768.0000 gendt_q0p075 0.00 768.0000 FORMAT "%8.4" /end CHARACTERISTIC
/begin CHARACTERISTIC TSTFIL_INI "Initialisierung Testfilter" VALUE 0xFCB7D2 KwWU8 255.0 dez 0.00 255.0 FORMAT "%5.1" /end CHARACTERISTIC
/begin CHARACTERISTIC TUMGHLS "" VALUE 0xFD28A0 KwUb 191.3 temp_ub_q0p75_o48 -48.00 143.3 FORMAT "%5.1" /end CHARACTERISTIC
/begin CHARACTERISTIC TUMGTKWBG "" VALUE 0xFCED1D KwWU8 191.3 temp_ub_q0p75_o48 -48.00 143.3 FORMAT "%5.1" /end CHARACTERISTIC
/begin CHARACTERISTIC TUMGTKWKR "Umgebungstemperaturschwelle KR-Anforderung" VALUE 0xFCED1E KwWU8 191.3 temp_ub_q0p75_o48 -48.00 143.3 FORMAT "%5.1" /end CHARACTERISTIC
/begin CHARACTERISTIC TUMGTKWRL "Umgebungstemperaturschwelle Hohe Last" VALUE 0xFCED1F KwWU8 191.3 temp_ub_q0p75_o48 -48.00 143.3 FORMAT "%5.1" /end CHARACTERISTIC
/begin CHARACTERISTIC TUMGTKWTA "Umgebungstemperaturschwelle Ansauglufttemperatur" VALUE 0xFCED20 KwWU8 191.3 temp_ub_q0p75_o48 -48.00 143.3 FORMAT "%5.1" /end CHARACTERISTIC
/begin CHARACTERISTIC TVKOE "Verzˆgerungszeit f¸r Kompressor EIN" VALUE 0xFD5554 KwWU8 51.00 t_q0p2 0.00 51.00 FORMAT "%5.2" /end CHARACTERISTIC
/begin CHARACTERISTIC TWKL15IP "Wartezeit nach Kl.15 f@r Pumpenstromberechnung" VALUE 0xFD4934 KwWU8 25.50 t_q0p1 0.00 25.50 FORMAT "%5.2" /end CHARACTERISTIC
/begin CHARACTERISTIC TWTEDTA "Wartezeit Betankungserkennung" VALUE 0xFD4935 KwWU8 25.50 t_q0p1 0.00 25.50 FORMAT "%5.2" /end CHARACTERISTIC
/begin CHARACTERISTIC TWTEMV "Wartezeit nach Magnetventilumschaltung" VALUE 0xFD4936 KwWU8 25.50 t_q0p1 0.00 25.50 FORMAT "%5.2" /end CHARACTERISTIC
/begin CHARACTERISTIC TZVER "Z‰hlerzeit f¸r Adaptionsverzˆgerung in KRDY" VALUE 0xFD2E31 KwUb 25.50 t100msxs_ub_b25p5 0.00 25.50 FORMAT "%5.2" /end CHARACTERISTIC
/begin CHARACTERISTIC UDIODERM02 "RMS-Schwellspannung Generatordiode0" VALUE 0xFCBE48 KwWU8 1.992 fak_ub_b2 0.00 1.992 FORMAT "%5.3" /end CHARACTERISTIC
/begin CHARACTERISTIC UDIODERM12 "RMS-Schwellspannung Generatordiode1" VALUE 0xFCBE49 KwWU8 1.992 fak_ub_b2 0.00 1.992 FORMAT "%5.3" /end CHARACTERISTIC
/begin CHARACTERISTIC UDIODERM22 "RMS-Schwellspannung Generatordiode2" VALUE 0xFCBE4A KwWU8 1.992 fak_ub_b2 0.00 1.992 FORMAT "%5.3" /end CHARACTERISTIC
/begin CHARACTERISTIC UDIODERMS0 "RMS-Schwellspannung Generatordiode0" VALUE 0xFCB7D3 KwWU8 1.992 fak_ub_b2 0.00 1.992 FORMAT "%5.3" /end CHARACTERISTIC
/begin CHARACTERISTIC UDIODERMS1 "RMS-Schwellspannung Generatordiode1" VALUE 0xFCB7D4 KwWU8 1.992 fak_ub_b2 0.00 1.992 FORMAT "%5.3" /end CHARACTERISTIC
/begin CHARACTERISTIC UDIODERMS2 "RMS-Schwellspannung Generatordiode2" VALUE 0xFCB7D5 KwWU8 1.992 fak_ub_b2 0.00 1.992 FORMAT "%5.3" /end CHARACTERISTIC
/begin CHARACTERISTIC UDIODERMS3 "RMS-Schwellspannung Generatordiode3" VALUE 0xFCB7D6 KwWU8 1.992 fak_ub_b2 0.00 1.992 FORMAT "%5.3" /end CHARACTERISTIC
/begin CHARACTERISTIC UDIODERMS4 "RMS-Schwellspannung Generatordiode4" VALUE 0xFCB7D7 KwWU8 1.992 fak_ub_b2 0.00 1.992 FORMAT "%5.3" /end CHARACTERISTIC
/begin CHARACTERISTIC UDIODERMS5 "RMS-Schwellspannung Generatordiode5" VALUE 0xFCB7D8 KwWU8 1.992 fak_ub_b2 0.00 1.992 FORMAT "%5.3" /end CHARACTERISTIC
/begin CHARACTERISTIC UDIODERMS6 "RMS-Schwellspannung Generatordiode6" VALUE 0xFCB7D9 KwWU8 1.992 fak_ub_b2 0.00 1.992 FORMAT "%5.3" /end CHARACTERISTIC
/begin CHARACTERISTIC UDIODERMS7 "RMS-Schwellspannung Generatordiode7" VALUE 0xFCB7DA KwWU8 1.992 fak_ub_b2 0.00 1.992 FORMAT "%5.3" /end CHARACTERISTIC
/begin CHARACTERISTIC VKOAO "Obere Geschwindigkeitsschwelle f¸r Kompressorabschaltung" VALUE 0xFD5555 KwWU8 318.8 vfzg_ub_q1p25 0.00 318.8 FORMAT "%5.1" /end CHARACTERISTIC
/begin CHARACTERISTIC VS100ZWKR "Zylinderindividuelle ZW-Verstellung durch VS100" VAL_BLK 0xFC84D2 KwbWS8 190.5 zw_sb_qn0p75 -95.25 95.25 FORMAT "%5.2" NUMBER 8 /end CHARACTERISTIC
/begin CHARACTERISTIC WKRAM "" CURVE 0xFD306B KlAUbSstUbWUb 0.9961 fak_ub_b1 0.00 0.9961
 /begin AXIS_DESCR STD_AXIS tmot temp_ub_q0p75_o48 5 -48.00 143.3 FORMAT "%5.1" DEPOSIT ABSOLUTE /end AXIS_DESCR
/end CHARACTERISTIC
/begin CHARACTERISTIC ZIPTESB "Zeitkonstante iptes-Filterungs Beginn" VALUE 0xFD492A KwWU16 655.34999985 zk10msxs_uw_b655 0.010000152590 655.36000000 FORMAT "%12.8" /end CHARACTERISTIC
/begin CHARACTERISTIC ZIPTESN "Zeitkonstante iptes-Filterung" VALUE 0xFD492C KwWU16 655.34999985 zk10msxs_uw_b655 0.010000152590 655.36000000 FORMAT "%12.8" /end CHARACTERISTIC
/begin CHARACTERISTIC ZIPTKTKN "Zeitkonstante iptes-Filterung" VALUE 0xFD492E KwWU16 655.34999985 zk10msxs_uw_b655 0.010000152590 655.36000000 FORMAT "%12.8" /end CHARACTERISTIC
/begin CHARACTERISTIC ZKBKVAB "Zeitkonstante Absteuerung Momentenreserve Katheizen f¸r BKV" VALUE 0xFD28A1 KwUb 25.4996 zk100msxs_ub_b25p5 0.100392 25.6000 FORMAT "%7.4" /end CHARACTERISTIC
/begin CHARACTERISTIC ZKMDKH "Filterzeitkonstante bei Wechsel von Teillast nach LL und umgekehrt" VALUE 0xFD28A2 KwUb 25.4996 zk100msxs_ub_b25p5 0.100392 25.6000 FORMAT "%7.4" /end CHARACTERISTIC
/begin CHARACTERISTIC ZKTMTKA "Zeitkonstante PT1-Filterung Lufttemperaturanteil" VALUE 0xFC7680 KwWU16 6553.400 t100msxs_uw_b6553p5 0.1000000 6553.500 FORMAT "%8.3" /end CHARACTERISTIC
/begin CHARACTERISTIC ZKTMTMOT "Zeitkonstante PT1-Filterung K¸hlwassertemperaturanteil" VALUE 0xFC7682 KwWU16 6553.400 t100msxs_uw_b6553p5 0.1000000 6553.500 FORMAT "%8.3" /end CHARACTERISTIC
/begin CHARACTERISTIC ZKTMVFZLU "Zeitkonstante PT1-Filterung Lufttemperaturanteil K¸hlung" VALUE 0xFC7684 KwWU16 6553.400 t100msxs_uw_b6553p5 0.1000000 6553.500 FORMAT "%8.3" /end CHARACTERISTIC
/begin CHARACTERISTIC ZMGENIG "Zeitkonstante Generatorstrom" VALUE 0xFCB73A KwWU16 1.999969 genzmig_uw_q0p305em7 0.00 1.999969 FORMAT "%8.6" /end CHARACTERISTIC
/begin CHARACTERISTIC ZMGENIG2 "Zeitkonstante Generatorstrom" VALUE 0xFCBE00 KwWU16 1.999969 genzmig_uw_q0p305em7 0.00 1.999969 FORMAT "%8.6" /end CHARACTERISTIC
/begin CHARACTERISTIC ZMGENS0H02 "Zeitkonstante Generatorstator0 Aufheizung im Stand" VALUE 0xFCBE02 KwWU16 0.9999847 genzmst_uw_q0p152em7 0.00 0.9999847 FORMAT "%9.7" /end CHARACTERISTIC
/begin CHARACTERISTIC ZMGENS0H12 "Zeitkonstante Generatorstator1 Aufheizung im Stand" VALUE 0xFCBE04 KwWU16 0.9999847 genzmst_uw_q0p152em7 0.00 0.9999847 FORMAT "%9.7" /end CHARACTERISTIC
/begin CHARACTERISTIC ZMGENS0H22 "Zeitkonstante Generatorstator2 Aufheizung im Stand" VALUE 0xFCBE06 KwWU16 0.9999847 genzmst_uw_q0p152em7 0.00 0.9999847 FORMAT "%9.7" /end CHARACTERISTIC
/begin CHARACTERISTIC ZMGENS0HZ0 "Zeitkonstante Generatorstator0 Aufheizung im Stand" VALUE 0xFCB73C KwWU16 0.9999847 genzmst_uw_q0p152em7 0.00 0.9999847 FORMAT "%9.7" /end CHARACTERISTIC
/begin CHARACTERISTIC ZMGENS0HZ1 "Zeitkonstante Generatorstator1 Aufheizung im Stand" VALUE 0xFCB73E KwWU16 0.9999847 genzmst_uw_q0p152em7 0.00 0.9999847 FORMAT "%9.7" /end CHARACTERISTIC
/begin CHARACTERISTIC ZMGENS0HZ2 "Zeitkonstante Generatorstator2 Aufheizung im Stand" VALUE 0xFCB740 KwWU16 0.9999847 genzmst_uw_q0p152em7 0.00 0.9999847 FORMAT "%9.7" /end CHARACTERISTIC
/begin CHARACTERISTIC ZMGENS0HZ3 "Zeitkonstante Generatorstator3 Aufheizung im Stand" VALUE 0xFCB742 KwWU16 0.9999847 genzmst_uw_q0p152em7 0.00 0.9999847 FORMAT "%9.7" /end CHARACTERISTIC
/begin CHARACTERISTIC ZMGENS0HZ4 "Zeitkonstante Generatorstator4 Aufheizung im Stand" VALUE 0xFCB744 KwWU16 0.9999847 genzmst_uw_q0p152em7 0.00 0.9999847 FORMAT "%9.7" /end CHARACTERISTIC
/begin CHARACTERISTIC ZMGENS0HZ5 "Zeitkonstante Generatorstator5 Aufheizung im Stand" VALUE 0xFCB746 KwWU16 0.9999847 genzmst_uw_q0p152em7 0.00 0.9999847 FORMAT "%9.7" /end CHARACTERISTIC
/begin CHARACTERISTIC ZMGENS0HZ6 "Zeitkonstante Generatorstator6 Aufheizung im Stand" VALUE 0xFCB748 KwWU16 0.9999847 genzmst_uw_q0p152em7 0.00 0.9999847 FORMAT "%9.7" /end CHARACTERISTIC
/begin CHARACTERISTIC ZMGENS0HZ7 "Zeitkonstante Generatorstator7 Aufheizung im Stand" VALUE 0xFCB74A KwWU16 0.9999847 genzmst_uw_q0p152em7 0.00 0.9999847 FORMAT "%9.7" /end CHARACTERISTIC
/begin CHARACTERISTIC ZMGENS0K0 "Zeitkonstante Abk¸hlung Generator im Stand0" VALUE 0xFCBE08 KwWU16 0.9999847 genzmst_uw_q0p152em7 0.00 0.9999847 FORMAT "%9.7" /end CHARACTERISTIC
/begin CHARACTERISTIC ZMGENS0K1 "Zeitkonstante Abk¸hlung Generator im Stand1" VALUE 0xFCBE0A KwWU16 0.9999847 genzmst_uw_q0p152em7 0.00 0.9999847 FORMAT "%9.7" /end CHARACTERISTIC
/begin CHARACTERISTIC ZMGENS0K2 "Zeitkonstante Abk¸hlung Generator im Stand2" VALUE 0xFCBE0C KwWU16 0.9999847 genzmst_uw_q0p152em7 0.00 0.9999847 FORMAT "%9.7" /end CHARACTERISTIC
/begin CHARACTERISTIC ZMGENS0KL0 "Zeitkonstante Abk¸hlung Generator im Stand0" VALUE 0xFCB74C KwWU16 0.9999847 genzmst_uw_q0p152em7 0.00 0.9999847 FORMAT "%9.7" /end CHARACTERISTIC
/begin CHARACTERISTIC ZMGENS0KL1 "Zeitkonstante Abk¸hlung Generator im Stand1" VALUE 0xFCB74E KwWU16 0.9999847 genzmst_uw_q0p152em7 0.00 0.9999847 FORMAT "%9.7" /end CHARACTERISTIC
/begin CHARACTERISTIC ZMGENS0KL2 "Zeitkonstante Abk¸hlung Generator im Stand2" VALUE 0xFCB750 KwWU16 0.9999847 genzmst_uw_q0p152em7 0.00 0.9999847 FORMAT "%9.7" /end CHARACTERISTIC
/begin CHARACTERISTIC ZMGENS0KL3 "Zeitkonstante Abk¸hlung Generator im Stand3" VALUE 0xFCB752 KwWU16 0.9999847 genzmst_uw_q0p152em7 0.00 0.9999847 FORMAT "%9.7" /end CHARACTERISTIC
/begin CHARACTERISTIC ZMGENS0KL4 "Zeitkonstante Abk¸hlung Generator im Stand4" VALUE 0xFCB754 KwWU16 0.9999847 genzmst_uw_q0p152em7 0.00 0.9999847 FORMAT "%9.7" /end CHARACTERISTIC
/begin CHARACTERISTIC ZMGENS0KL5 "Zeitkonstante Abk¸hlung Generator im Stand5" VALUE 0xFCB756 KwWU16 0.9999847 genzmst_uw_q0p152em7 0.00 0.9999847 FORMAT "%9.7" /end CHARACTERISTIC
/begin CHARACTERISTIC ZMGENS0KL6 "Zeitkonstante Abk¸hlung Generator im Stand6" VALUE 0xFCB758 KwWU16 0.9999847 genzmst_uw_q0p152em7 0.00 0.9999847 FORMAT "%9.7" /end CHARACTERISTIC
/begin CHARACTERISTIC ZMGENS0KL7 "Zeitkonstante Abk¸hlung Generator im Stand7" VALUE 0xFCB75A KwWU16 0.9999847 genzmst_uw_q0p152em7 0.00 0.9999847 FORMAT "%9.7" /end CHARACTERISTIC
/begin CHARACTERISTIC ZMGENSTH02 "Zeitkonstante Generatorstator0 Aufheizung" VALUE 0xFCBE0E KwWU16 0.9999847 genzmst_uw_q0p152em7 0.00 0.9999847 FORMAT "%9.7" /end CHARACTERISTIC
/begin CHARACTERISTIC ZMGENSTH12 "Zeitkonstante Generatorstator1 Aufheizung" VALUE 0xFCBE10 KwWU16 0.9999847 genzmst_uw_q0p152em7 0.00 0.9999847 FORMAT "%9.7" /end CHARACTERISTIC
/begin CHARACTERISTIC ZMGENSTH22 "Zeitkonstante Generatorstator2 Aufheizung" VALUE 0xFCBE12 KwWU16 0.9999847 genzmst_uw_q0p152em7 0.00 0.9999847 FORMAT "%9.7" /end CHARACTERISTIC
/begin CHARACTERISTIC ZMGENSTHZ0 "Zeitkonstante Generatorstator Aufheizung im Stand" VALUE 0xFCB75C KwWU16 0.9999847 genzmst_uw_q0p152em7 0.00 0.9999847 FORMAT "%9.7" /end CHARACTERISTIC
/begin CHARACTERISTIC ZMGENSTHZ1 "Zeitkonstante Generatorstator1 Aufheizung" VALUE 0xFCB75E KwWU16 0.9999847 genzmst_uw_q0p152em7 0.00 0.9999847 FORMAT "%9.7" /end CHARACTERISTIC
/begin CHARACTERISTIC ZMGENSTHZ2 "Zeitkonstante Generatorstator2 Aufheizung" VALUE 0xFCB760 KwWU16 0.9999847 genzmst_uw_q0p152em7 0.00 0.9999847 FORMAT "%9.7" /end CHARACTERISTIC
/begin CHARACTERISTIC ZMGENSTHZ3 "Zeitkonstante Generatorstator3 Aufheizung" VALUE 0xFCB762 KwWU16 0.9999847 genzmst_uw_q0p152em7 0.00 0.9999847 FORMAT "%9.7" /end CHARACTERISTIC
/begin CHARACTERISTIC ZMGENSTHZ4 "Zeitkonstante Generatorstator4 Aufheizung" VALUE 0xFCB764 KwWU16 0.9999847 genzmst_uw_q0p152em7 0.00 0.9999847 FORMAT "%9.7" /end CHARACTERISTIC
/begin CHARACTERISTIC ZMGENSTHZ5 "Zeitkonstante Generatorstator5 Aufheizung" VALUE 0xFCB766 KwWU16 0.9999847 genzmst_uw_q0p152em7 0.00 0.9999847 FORMAT "%9.7" /end CHARACTERISTIC
/begin CHARACTERISTIC ZMGENSTHZ6 "Zeitkonstante Generatorstator6 Aufheizung" VALUE 0xFCB768 KwWU16 0.9999847 genzmst_uw_q0p152em7 0.00 0.9999847 FORMAT "%9.7" /end CHARACTERISTIC
/begin CHARACTERISTIC ZMGENSTHZ7 "Zeitkonstante Generatorstator7 Aufheizung" VALUE 0xFCB76A KwWU16 0.9999847 genzmst_uw_q0p152em7 0.00 0.9999847 FORMAT "%9.7" /end CHARACTERISTIC
/begin CHARACTERISTIC ZMGENSTK02 "Zeitkonstante Abk¸hlung Generator0" VALUE 0xFCBE14 KwWU16 0.9999847 genzmst_uw_q0p152em7 0.00 0.9999847 FORMAT "%9.7" /end CHARACTERISTIC
/begin CHARACTERISTIC ZMGENSTK12 "Zeitkonstante Abk¸hlung Generator1" VALUE 0xFCBE16 KwWU16 0.9999847 genzmst_uw_q0p152em7 0.00 0.9999847 FORMAT "%9.7" /end CHARACTERISTIC
/begin CHARACTERISTIC ZMGENSTK22 "Zeitkonstante Abk¸hlung Generator2" VALUE 0xFCBE18 KwWU16 0.9999847 genzmst_uw_q0p152em7 0.00 0.9999847 FORMAT "%9.7" /end CHARACTERISTIC
/begin CHARACTERISTIC ZMGENSTKL0 "Zeitkonstante Abk¸hlung Generator im Stand" VALUE 0xFCB76C KwWU16 0.9999847 genzmst_uw_q0p152em7 0.00 0.9999847 FORMAT "%9.7" /end CHARACTERISTIC
/begin CHARACTERISTIC ZMGENSTKL1 "Zeitkonstante Abk¸hlung Generator1" VALUE 0xFCB76E KwWU16 0.9999847 genzmst_uw_q0p152em7 0.00 0.9999847 FORMAT "%9.7" /end CHARACTERISTIC
/begin CHARACTERISTIC ZMGENSTKL2 "Zeitkonstante Abk¸hlung Generator2" VALUE 0xFCB770 KwWU16 0.9999847 genzmst_uw_q0p152em7 0.00 0.9999847 FORMAT "%9.7" /end CHARACTERISTIC
/begin CHARACTERISTIC ZMGENSTKL3 "Zeitkonstante Abk¸hlung Generator3" VALUE 0xFCB772 KwWU16 0.9999847 genzmst_uw_q0p152em7 0.00 0.9999847 FORMAT "%9.7" /end CHARACTERISTIC
/begin CHARACTERISTIC ZMGENSTKL4 "Zeitkonstante Abk¸hlung Generator4" VALUE 0xFCB774 KwWU16 0.9999847 genzmst_uw_q0p152em7 0.00 0.9999847 FORMAT "%9.7" /end CHARACTERISTIC
/begin CHARACTERISTIC ZMGENSTKL5 "Zeitkonstante Abk¸hlung Generator5" VALUE 0xFCB776 KwWU16 0.9999847 genzmst_uw_q0p152em7 0.00 0.9999847 FORMAT "%9.7" /end CHARACTERISTIC
/begin CHARACTERISTIC ZMGENSTKL6 "Zeitkonstante Abk¸hlung Generator6" VALUE 0xFCB778 KwWU16 0.9999847 genzmst_uw_q0p152em7 0.00 0.9999847 FORMAT "%9.7" /end CHARACTERISTIC
/begin CHARACTERISTIC ZMGENSTKL7 "Zeitkonstante Abk¸hlung Generator7" VALUE 0xFCB77A KwWU16 0.9999847 genzmst_uw_q0p152em7 0.00 0.9999847 FORMAT "%9.7" /end CHARACTERISTIC
/begin CHARACTERISTIC ZMGENTWA "Zeitkonstante Generatorstatorwasser" VALUE 0xFCB77C KwWU16 0.9999847 fak_uw_b1 0.00 0.9999847 FORMAT "%9.7" /end CHARACTERISTIC
/begin CHARACTERISTIC ZMGENTWA2 "Zeitkonstante Generatorstatorwasser" VALUE 0xFCBE1A KwWU16 0.9999847 fak_uw_b1 0.00 0.9999847 FORMAT "%9.7" /end CHARACTERISTIC
/begin CHARACTERISTIC ZMGN0TAN02 "Zeitkonstante Generatoransaugluft0 bei vfzg = 0" VALUE 0xFCBE1C KwWU16 0.9999847 fak_uw_b1 0.00 0.9999847 FORMAT "%9.7" /end CHARACTERISTIC
/begin CHARACTERISTIC ZMGN0TAN12 "Zeitkonstante Generatoransaugluft1 bei vfzg = 0" VALUE 0xFCBE1E KwWU16 0.9999847 fak_uw_b1 0.00 0.9999847 FORMAT "%9.7" /end CHARACTERISTIC
/begin CHARACTERISTIC ZMGN0TAN22 "Zeitkonstante Generatoransaugluft2 bei vfzg = 0" VALUE 0xFCBE20 KwWU16 0.9999847 fak_uw_b1 0.00 0.9999847 FORMAT "%9.7" /end CHARACTERISTIC
/begin CHARACTERISTIC ZMGN0TANS0 "Zeitkonstante Generatoransaugluft0 bei vfzg = 0" VALUE 0xFCB77E KwWU16 0.9999847 fak_uw_b1 0.00 0.9999847 FORMAT "%9.7" /end CHARACTERISTIC
/begin CHARACTERISTIC ZMGN0TANS1 "Zeitkonstante Generatoransaugluft1 bei vfzg = 0" VALUE 0xFCB780 KwWU16 0.9999847 fak_uw_b1 0.00 0.9999847 FORMAT "%9.7" /end CHARACTERISTIC
/begin CHARACTERISTIC ZMGN0TANS2 "Zeitkonstante Generatoransaugluft2 bei vfzg = 0" VALUE 0xFCB782 KwWU16 0.9999847 fak_uw_b1 0.00 0.9999847 FORMAT "%9.7" /end CHARACTERISTIC
/begin CHARACTERISTIC ZMGN0TANS3 "Zeitkonstante Generatoransaugluft3 bei vfzg = 0" VALUE 0xFCB784 KwWU16 0.9999847 fak_uw_b1 0.00 0.9999847 FORMAT "%9.7" /end CHARACTERISTIC
/begin CHARACTERISTIC ZMGN0TANS4 "Zeitkonstante Generatoransaugluft4 bei vfzg = 0" VALUE 0xFCB786 KwWU16 0.9999847 fak_uw_b1 0.00 0.9999847 FORMAT "%9.7" /end CHARACTERISTIC
/begin CHARACTERISTIC ZMGN0TANS5 "Zeitkonstante Generatoransaugluft5 bei vfzg = 0" VALUE 0xFCB788 KwWU16 0.9999847 fak_uw_b1 0.00 0.9999847 FORMAT "%9.7" /end CHARACTERISTIC
/begin CHARACTERISTIC ZMGN0TANS6 "Zeitkonstante Generatoransaugluft6 bei vfzg = 0" VALUE 0xFCB78A KwWU16 0.9999847 fak_uw_b1 0.00 0.9999847 FORMAT "%9.7" /end CHARACTERISTIC
/begin CHARACTERISTIC ZMGN0TANS7 "Zeitkonstante Generatoransaugluft7 bei vfzg = 0" VALUE 0xFCB78C KwWU16 0.9999847 fak_uw_b1 0.00 0.9999847 FORMAT "%9.7" /end CHARACTERISTIC
/begin CHARACTERISTIC ZMGNTANS0 "Zeitkonstante Generatoransaugluft0" VALUE 0xFCB78E KwWU16 0.9999847 fak_uw_b1 0.00 0.9999847 FORMAT "%9.7" /end CHARACTERISTIC
/begin CHARACTERISTIC ZMGNTANS02 "Zeitkonstante Generatoransaugluft0" VALUE 0xFCBE22 KwWU16 0.9999847 fak_uw_b1 0.00 0.9999847 FORMAT "%9.7" /end CHARACTERISTIC
/begin CHARACTERISTIC ZMGNTANS1 "Zeitkonstante Generatoransaugluft1" VALUE 0xFCB790 KwWU16 0.9999847 fak_uw_b1 0.00 0.9999847 FORMAT "%9.7" /end CHARACTERISTIC
/begin CHARACTERISTIC ZMGNTANS12 "Zeitkonstante Generatoransaugluft1" VALUE 0xFCBE24 KwWU16 0.9999847 fak_uw_b1 0.00 0.9999847 FORMAT "%9.7" /end CHARACTERISTIC
/begin CHARACTERISTIC ZMGNTANS2 "Zeitkonstante Generatoransaugluft2" VALUE 0xFCB792 KwWU16 0.9999847 fak_uw_b1 0.00 0.9999847 FORMAT "%9.7" /end CHARACTERISTIC
/begin CHARACTERISTIC ZMGNTANS22 "Zeitkonstante Generatoransaugluft2" VALUE 0xFCBE26 KwWU16 0.9999847 fak_uw_b1 0.00 0.9999847 FORMAT "%9.7" /end CHARACTERISTIC
/begin CHARACTERISTIC ZMGNTANS3 "Zeitkonstante Generatoransaugluft3" VALUE 0xFCB794 KwWU16 0.9999847 fak_uw_b1 0.00 0.9999847 FORMAT "%9.7" /end CHARACTERISTIC
/begin CHARACTERISTIC ZMGNTANS4 "Zeitkonstante Generatoransaugluft4" VALUE 0xFCB796 KwWU16 0.9999847 fak_uw_b1 0.00 0.9999847 FORMAT "%9.7" /end CHARACTERISTIC
/begin CHARACTERISTIC ZMGNTANS5 "Zeitkonstante Generatoransaugluft5" VALUE 0xFCB798 KwWU16 0.9999847 fak_uw_b1 0.00 0.9999847 FORMAT "%9.7" /end CHARACTERISTIC
/begin CHARACTERISTIC ZMGNTANS6 "Zeitkonstante Generatoransaugluft6" VALUE 0xFCB79A KwWU16 0.9999847 fak_uw_b1 0.00 0.9999847 FORMAT "%9.7" /end CHARACTERISTIC
/begin CHARACTERISTIC ZMGNTANS7 "Zeitkonstante Generatoransaugluft7" VALUE 0xFCB79C KwWU16 0.9999847 fak_uw_b1 0.00 0.9999847 FORMAT "%9.7" /end CHARACTERISTIC
/begin CHARACTERISTIC ZMIGMISCH "" VALUE 0xFCB79E KwWU16 0.9999847 fak_uw_b1 0.00 0.9999847 FORMAT "%9.7" /end CHARACTERISTIC
/begin CHARACTERISTIC ZMIGMISCH2 "Zeitkonstante IG Mischung" VALUE 0xFCBE28 KwWU16 0.9999847 fak_uw_b1 0.00 0.9999847 FORMAT "%9.7" /end CHARACTERISTIC
/begin CHARACTERISTIC ZMTESTFIL "Zeitkonstante Testfilter" VALUE 0xFCB7A0 KwWU16 0.9999847 genzmst_uw_q0p152em7 0.00 0.9999847 FORMAT "%9.7" /end CHARACTERISTIC
/begin CHARACTERISTIC ZMTESTFIL2 "Zeitkonstante Testfilter" VALUE 0xFCBE2A KwWU16 0.9999847 genzmst_uw_q0p152em7 0.00 0.9999847 FORMAT "%9.7" /end CHARACTERISTIC
/begin CHARACTERISTIC ZUPTESB "Zeitkonstante ub-Filterungs-Beginn" VALUE 0xFD4930 KwWU16 6553.4999985 zk100msxs_uw_b6553 0.10000152590 6553.6000000 FORMAT "%12.7" /end CHARACTERISTIC
/begin CHARACTERISTIC ZUPTESN "Zeitkonstante ub-Filterung" VALUE 0xFD4932 KwWU16 6553.4999985 zk100msxs_uw_b6553 0.10000152590 6553.6000000 FORMAT "%12.7" /end CHARACTERISTIC
/begin CHARACTERISTIC ZYRKR "Zylinderzuordnung f¸r maximale Referenzpegelbegrenzung Klopfregelung" VALUE 0xFC8736 KwUb 255.0 dez 0.00 255.0 FORMAT "%5.1" /end CHARACTERISTIC
/begin MEASUREMENT AS_anskl "" UBYTE B_TRUE 1 100 0 1 BIT_MASK 0x1 FORMAT "%13.11" ECU_ADDRESS 0x3FC183 /end MEASUREMENT
/begin MEASUREMENT azkrldy "aktueller Wert der KL AZKRLDYN" UBYTE dez 1 100 0 255 FORMAT "%5.1" ECU_ADDRESS 0x3FB1EC /end MEASUREMENT
/begin MEASUREMENT azkrndy "aktueller Wert der KL AZKRNDYN" UBYTE dez 1 100 0 255 FORMAT "%5.1" ECU_ADDRESS 0x3FB1ED /end MEASUREMENT
/begin MEASUREMENT B_acres "Bedingung f¸r Aufbau einer Drehmomentenreserve bei Klimabereitschaft" UBYTE B_TRUE 1 100 0 1 BIT_MASK 0x1 FORMAT "%13.11" ECU_ADDRESS 0x40374D /end MEASUREMENT
/begin MEASUREMENT B_c95_g0 "Ansteuerung der Verst‰rkerstufe des CC195 (PIN G0)" UBYTE B_TRUE 1 100 0 1 BIT_MASK 0x1 FORMAT "%13.11" ECU_ADDRESS 0x3FC1C4 /end MEASUREMENT
/begin MEASUREMENT B_c95_g1 "Ansteuerung der Verst‰rkerstufe des CC195 (Pin G1)" UBYTE B_TRUE 1 100 0 1 BIT_MASK 0x1 FORMAT "%13.11" ECU_ADDRESS 0x3FC1C5 /end MEASUREMENT
/begin MEASUREMENT B_c95_g2 "Ansteuerung der Verst‰rkerstufe des CC195 (Pin G2)" UBYTE B_TRUE 1 100 0 1 BIT_MASK 0x1 FORMAT "%13.11" ECU_ADDRESS 0x3FC1C6 /end MEASUREMENT
/begin MEASUREMENT B_clwkram "" UBYTE B_TRUE 1 100 0 1 BIT_MASK 0x1 FORMAT "%13.11" ECU_ADDRESS 0x3FC1B9 /end MEASUREMENT
/begin MEASUREMENT B_diprfo "Bedingung delta Referenzstrom ueberschritten" UBYTE B_TRUE 1 100 0 1 BIT_MASK 0x1 FORMAT "%13.11" ECU_ADDRESS 0x3FE2EA /end MEASUREMENT
/begin MEASUREMENT B_dpsf "Bedingung fallender Pumpenstrom w‰hrend Messung" UBYTE B_TRUE 1 100 0 1 BIT_MASK 0x2 FORMAT "%13.11" ECU_ADDRESS 0x3FE2EA /end MEASUREMENT
/begin MEASUREMENT B_dtetd "Bedingung Tankdeckel wurde geoeffnet" UBYTE B_TRUE 1 100 0 1 BIT_MASK 0x4 FORMAT "%13.11" ECU_ADDRESS 0x3FE2EA /end MEASUREMENT
/begin MEASUREMENT B_dtetk "Bedingung Betankung erkannt" UBYTE B_TRUE 1 100 0 1 BIT_MASK 0x8 FORMAT "%13.11" ECU_ADDRESS 0x3FE2EA /end MEASUREMENT
/begin MEASUREMENT B_dubtes "Bedingung grosse Batteriespannungsschwankung Tankdiagnose" UBYTE B_TRUE 1 100 0 1 BIT_MASK 0x10 FORMAT "%13.11" ECU_ADDRESS 0x3FE2EA /end MEASUREMENT
/begin MEASUREMENT B_eemrdy "EEPROM-Spiegel bereit f¸r Speicherung" UBYTE B_TRUE 1 100 0 1 BIT_MASK 0x1 FORMAT "%13.11" ECU_ADDRESS 0x3FC197 /end MEASUREMENT
/begin MEASUREMENT B_eemsav "EEPROM-Spiegel wird gespeichert" UBYTE B_TRUE 1 100 0 1 BIT_MASK 0x1 FORMAT "%13.11" ECU_ADDRESS 0x3FC198 /end MEASUREMENT
/begin MEASUREMENT B_enimmoff "Bedingung: Betriebszustand erlaubt plˆtzliches Abschalten Motronic" UBYTE B_TRUE 1 100 0 1 BIT_MASK 0x1 FORMAT "%13.11" ECU_ADDRESS 0x3FC339 /end MEASUREMENT
/begin MEASUREMENT B_firstemp "Bedingung Generatorstarttemperatur-Berechnung" UBYTE B_TRUE 1 100 0 1 FORMAT "%13.11" ECU_ADDRESS 0x403999 /end MEASUREMENT
/begin MEASUREMENT B_firstemp2 "" UBYTE B_TRUE 1 100 0 1 FORMAT "%13.11" ECU_ADDRESS 0x40399F /end MEASUREMENT
/begin MEASUREMENT B_fnvrbup "Zwangsabspeicherung NVRAM im Flash durch Tester angefordert" UBYTE B_TRUE 1 100 0 1 BIT_MASK 0x1 FORMAT "%13.11" ECU_ADDRESS 0x3FC33A /end MEASUREMENT
/begin MEASUREMENT B_gene "Bedingung f¸r Momentenanforderung Generator" UBYTE B_TRUE 1 100 0 1 FORMAT "%13.11" ECU_ADDRESS 0x40399A /end MEASUREMENT
/begin MEASUREMENT B_gene2 "Generatormoment enable/disable" UBYTE B_TRUE 1 100 0 1 FORMAT "%13.11" ECU_ADDRESS 0x4039A0 /end MEASUREMENT
/begin MEASUREMENT B_generke2 "Anfoderung der Generatorerkennung" UBYTE B_TRUE 1 100 0 1 FORMAT "%13.11" ECU_ADDRESS 0x4039A1 /end MEASUREMENT
/begin MEASUREMENT B_generken "Anfoderung der Generatorerkennung" UBYTE B_TRUE 1 100 0 1 FORMAT "%13.11" ECU_ADDRESS 0x40399B /end MEASUREMENT
/begin MEASUREMENT B_genfkup2 "Generatortyp unplausibel" UBYTE B_TRUE 1 100 0 1 FORMAT "%13.11" ECU_ADDRESS 0x403284 /end MEASUREMENT
/begin MEASUREMENT B_genfkupl "Bedingung Kommunikation unplausibel" UBYTE B_TRUE 1 100 0 1 FORMAT "%13.11" ECU_ADDRESS 0x403228 /end MEASUREMENT
/begin MEASUREMENT B_giptess "Stromeinbruch im DM-TL Pumpstrom" UBYTE B_TRUE 1 100 0 1 BIT_MASK 0x1 FORMAT "%13.11" ECU_ADDRESS 0x40366E /end MEASUREMENT
/begin MEASUREMENT B_heizen "Bedingung Generator in Heizphase" UBYTE B_TRUE 1 100 0 1 FORMAT "%13.11" ECU_ADDRESS 0x40399C /end MEASUREMENT
/begin MEASUREMENT B_heizen2 "Bedingung Generator in Heizphase" UBYTE B_TRUE 1 100 0 1 FORMAT "%13.11" ECU_ADDRESS 0x4039A2 /end MEASUREMENT
/begin MEASUREMENT B_HLSKW "Bedingung Heizleistungsteigerung" UBYTE B_TRUE 1 100 0 1 BIT_MASK 0x1 FORMAT "%13.11" ECU_ADDRESS 0x402FF0 /end MEASUREMENT
/begin MEASUREMENT B_hsve "Bedingung Endstufe Sondenheizung vor Kat angesteuert" UBYTE B_TRUE 1 100 0 1 BIT_MASK 0x1 FORMAT "%13.11" ECU_ADDRESS 0x3FC181 /end MEASUREMENT
/begin MEASUREMENT B_hsve2 "Bedingung Endstufe Sondenheizung2 vor Kat angesteuert" UBYTE B_TRUE 1 100 0 1 BIT_MASK 0x1 FORMAT "%13.11" ECU_ADDRESS 0x3FC182 /end MEASUREMENT
/begin MEASUREMENT B_hsvemn "Bedingung: Kurzschluﬂ Heizer nach Masse" UBYTE B_TRUE 1 100 0 1 BIT_MASK 0x2 FORMAT "%13.11" ECU_ADDRESS 0x402F54 /end MEASUREMENT
/begin MEASUREMENT B_hsvemn2 "Bedingung: Kurzschluﬂ Heizer nach Masse, Bank 2" UBYTE B_TRUE 1 100 0 1 BIT_MASK 0x10 FORMAT "%13.11" ECU_ADDRESS 0x402F54 /end MEASUREMENT
/begin MEASUREMENT B_hsvemx "Bedingung: Kurzschluﬂ Heizer nach Ubat" UBYTE B_TRUE 1 100 0 1 BIT_MASK 0x4 FORMAT "%13.11" ECU_ADDRESS 0x402F54 /end MEASUREMENT
/begin MEASUREMENT B_hsvemx2 "Bedingung: Kurzschluﬂ Heizer nach Ubat, Bank 2" UBYTE B_TRUE 1 100 0 1 BIT_MASK 0x20 FORMAT "%13.11" ECU_ADDRESS 0x402F54 /end MEASUREMENT
/begin MEASUREMENT B_hsvesi "Bedingung: Lastabfall Heizer" UBYTE B_TRUE 1 100 0 1 BIT_MASK 0x1 FORMAT "%13.11" ECU_ADDRESS 0x402F54 /end MEASUREMENT
/begin MEASUREMENT B_hsvesi2 "Bedingung: Lastabfall Heizer, Bank 2" UBYTE B_TRUE 1 100 0 1 BIT_MASK 0x8 FORMAT "%13.11" ECU_ADDRESS 0x402F54 /end MEASUREMENT
/begin MEASUREMENT B_immoff "Bedingung sofortiges Sichern des NVRAM und Abschalten des SG empfangen" UBYTE B_TRUE 1 100 0 1 BIT_MASK 0x1 FORMAT "%13.11" ECU_ADDRESS 0x3FC33B /end MEASUREMENT
/begin MEASUREMENT B_iptesen "Berechnung von Pumpstrom-Korrektur aktiv" UBYTE B_TRUE 1 100 0 1 BIT_MASK 0x2 FORMAT "%13.11" ECU_ADDRESS 0x40366E /end MEASUREMENT
/begin MEASUREMENT B_iptesr "Berechnung von Pumpstrom-Korrektur mˆglich nach Z¸ndung an" UBYTE B_TRUE 1 100 0 1 BIT_MASK 0x1 FORMAT "%13.11" ECU_ADDRESS 0x40366F /end MEASUREMENT
/begin MEASUREMENT B_kalt "K¸hlanforderung von geregeltem Kennfeldthermostat" UBYTE B_TRUE 1 100 0 1 BIT_MASK 0x1 FORMAT "%13.11" ECU_ADDRESS 0x3FC392 /end MEASUREMENT
/begin MEASUREMENT B_kl "Bedingung f¸r erkannte Klopfer" UBYTE B_TRUE 1 100 0 1 BIT_MASK 0x1 FORMAT "%13.11" ECU_ADDRESS 0x3FC1C7 /end MEASUREMENT
/begin MEASUREMENT B_kldynrm "Bedingung normales Klopfen bei adapt. Lastdynamik" UBYTE B_TRUE 1 100 0 1 BIT_MASK 0x1 FORMAT "%13.11" ECU_ADDRESS 0x3FC1B0 /end MEASUREMENT
/begin MEASUREMENT B_kldystk "Bedingung starkes Klopfen bei adapt. Lastdynamik" UBYTE B_TRUE 1 100 0 1 BIT_MASK 0x1 FORMAT "%13.11" ECU_ADDRESS 0x3FC1B1 /end MEASUREMENT
/begin MEASUREMENT B_koe "Bedingung f¸r Kompressoreinschalten" UBYTE B_TRUE 1 100 0 1 BIT_MASK 0x2 FORMAT "%13.11" ECU_ADDRESS 0x40374D /end MEASUREMENT
/begin MEASUREMENT B_koena "Bedingung Kompressor freigegeben" UBYTE B_TRUE 1 100 0 1 BIT_MASK 0x2 FORMAT "%13.11" ECU_ADDRESS 0x40374E /end MEASUREMENT
/begin MEASUREMENT B_komnoff "Bedingung Kompresszor-Mindestabschaltzeit abgelaufen" UBYTE B_TRUE 1 100 0 1 BIT_MASK 0x4 FORMAT "%13.11" ECU_ADDRESS 0x40374E /end MEASUREMENT
/begin MEASUREMENT B_komnon "Bedingung Kompresszor-Mindesteinschaltzeit abgelaufen" UBYTE B_TRUE 1 100 0 1 BIT_MASK 0x8 FORMAT "%13.11" ECU_ADDRESS 0x40374E /end MEASUREMENT
/begin MEASUREMENT B_komxoff "Bedingung Kompresszor-Hˆchstabschaltzeit abgelaufen" UBYTE B_TRUE 1 100 0 1 BIT_MASK 0x10 FORMAT "%13.11" ECU_ADDRESS 0x40374E /end MEASUREMENT
/begin MEASUREMENT B_kooff "Bedingung f¸r hartes Kompressorabschalten" UBYTE B_TRUE 1 100 0 1 BIT_MASK 0x20 FORMAT "%13.11" ECU_ADDRESS 0x40374E /end MEASUREMENT
/begin MEASUREMENT B_kr "Bedingung Klopfregelung aktiv" UBYTE B_TRUE 1 100 0 1 BIT_MASK 0x1 FORMAT "%13.11" ECU_ADDRESS 0x3FC1BA /end MEASUREMENT
/begin MEASUREMENT B_kra "Bedingung KR-Adaption aktiv" UBYTE B_TRUE 1 100 0 1 BIT_MASK 0x1 FORMAT "%13.11" ECU_ADDRESS 0x3FC1BB /end MEASUREMENT
/begin MEASUREMENT B_kras "KR-Adaption schreiben zul‰ssig" UBYTE B_TRUE 1 100 0 1 BIT_MASK 0x1 FORMAT "%13.11" ECU_ADDRESS 0x3FC1BC /end MEASUREMENT
/begin MEASUREMENT B_krldy "Bedingung Lastdynamik f¸r Klopferkennung aktiv" UBYTE B_TRUE 1 100 0 1 BIT_MASK 0x1 FORMAT "%13.11" ECU_ADDRESS 0x3FC1B2 /end MEASUREMENT
/begin MEASUREMENT B_krldya "Bedingung Lastdynamikvorhalt und -adaption aktiv" UBYTE B_TRUE 1 100 0 1 BIT_MASK 0x1 FORMAT "%13.11" ECU_ADDRESS 0x3FC1B3 /end MEASUREMENT
/begin MEASUREMENT B_krldyf "Bedingung Adaption Lastdynamikvorhalt nach fr¸h freigegeben" UBYTE B_TRUE 1 100 0 1 BIT_MASK 0x1 FORMAT "%13.11" ECU_ADDRESS 0x3FC1B4 /end MEASUREMENT
/begin MEASUREMENT B_krldyofok "" UBYTE B_TRUE 1 100 0 1 BIT_MASK 0x1 FORMAT "%13.11" ECU_ADDRESS 0x3FC1B5 /end MEASUREMENT
/begin MEASUREMENT B_krldyok "" UBYTE B_TRUE 1 100 0 1 BIT_MASK 0x1 FORMAT "%13.11" ECU_ADDRESS 0x3FC1B6 /end MEASUREMENT
/begin MEASUREMENT B_krndy "Bedingung Drehzahldynamik f¸r Klopferkennung aktiv" UBYTE B_TRUE 1 100 0 1 BIT_MASK 0x1 FORMAT "%13.11" ECU_ADDRESS 0x3FC1B7 /end MEASUREMENT
/begin MEASUREMENT B_krsadyn "Bedingung Adaptions-Delay nach SA" UBYTE B_TRUE 1 100 0 1 BIT_MASK 0x1 FORMAT "%13.11" ECU_ADDRESS 0x3FC1B8 /end MEASUREMENT
/begin MEASUREMENT B_ksa "Bedingung Ersatzsensor A wird benutzt" UBYTE B_TRUE 1 100 0 1 BIT_MASK 0x1 FORMAT "%13.11" ECU_ADDRESS 0x3FC1BD /end MEASUREMENT
/begin MEASUREMENT B_ksb "Bedingung Ersatzsensor B wird benutzt" UBYTE B_TRUE 1 100 0 1 BIT_MASK 0x1 FORMAT "%13.11" ECU_ADDRESS 0x3FC1BE /end MEASUREMENT
/begin MEASUREMENT B_ktm_ini "Bedingung KTM-Initialisierung" UBYTE B_TRUE 1 100 0 1 FORMAT "%13.11" ECU_ADDRESS 0x4037C7 /end MEASUREMENT
/begin MEASUREMENT B_lkrall "Bedingung  Leerlaufadaption aktiv" UBYTE B_TRUE 1 100 0 1 BIT_MASK 0x1 FORMAT "%13.11" ECU_ADDRESS 0x3FC1BF /end MEASUREMENT
/begin MEASUREMENT B_mn2_hsvetmp "" UBYTE B_TRUE 1 100 0 1 BIT_MASK 0x10 FORMAT "%13.11" ECU_ADDRESS 0x402F55 /end MEASUREMENT
/begin MEASUREMENT B_mn_hsvetmp "" UBYTE B_TRUE 1 100 0 1 BIT_MASK 0x2 FORMAT "%13.11" ECU_ADDRESS 0x402F55 /end MEASUREMENT
/begin MEASUREMENT B_mx2_hsvetmp "" UBYTE B_TRUE 1 100 0 1 BIT_MASK 0x20 FORMAT "%13.11" ECU_ADDRESS 0x402F55 /end MEASUREMENT
/begin MEASUREMENT B_mx_hsvetmp "" UBYTE B_TRUE 1 100 0 1 BIT_MASK 0x4 FORMAT "%13.11" ECU_ADDRESS 0x402F55 /end MEASUREMENT
/begin MEASUREMENT B_nac "Bedingung f¸r erhˆhte LL-Drehzahl bei Klimaanlage" UBYTE B_TRUE 1 100 0 1 BIT_MASK 0x4 FORMAT "%13.11" ECU_ADDRESS 0x40374D /end MEASUREMENT
/begin MEASUREMENT B_pwmloff "Zwangsabspeicherung NVRAM im Flash durch Power Modul angefordert" UBYTE B_TRUE 1 100 0 1 BIT_MASK 0x1 FORMAT "%13.11" ECU_ADDRESS 0x3FC33C /end MEASUREMENT
/begin MEASUREMENT B_rqfnvrbu "Trigger Testeranforderung NVRAM-Backup im Flash" UBYTE B_TRUE 1 100 0 1 BIT_MASK 0x1 FORMAT "%13.11" ECU_ADDRESS 0x3FC33D /end MEASUREMENT
/begin MEASUREMENT B_rqpdn "Trigger Testeranforderung Power Down" UBYTE B_TRUE 1 100 0 1 BIT_MASK 0x1 FORMAT "%13.11" ECU_ADDRESS 0x3FC33E /end MEASUREMENT
/begin MEASUREMENT B_si2_hsvetmp "" UBYTE B_TRUE 1 100 0 1 BIT_MASK 0x8 FORMAT "%13.11" ECU_ADDRESS 0x402F55 /end MEASUREMENT
/begin MEASUREMENT B_si_hsvetmp "" UBYTE B_TRUE 1 100 0 1 BIT_MASK 0x1 FORMAT "%13.11" ECU_ADDRESS 0x402F55 /end MEASUREMENT
/begin MEASUREMENT B_tkwberg "" UBYTE B_TRUE 1 100 0 1 BIT_MASK 0x1 FORMAT "%13.11" ECU_ADDRESS 0x3FC393 /end MEASUREMENT
/begin MEASUREMENT B_tkwkr "" UBYTE B_TRUE 1 100 0 1 BIT_MASK 0x1 FORMAT "%13.11" ECU_ADDRESS 0x3FC394 /end MEASUREMENT
/begin MEASUREMENT B_tkwlast "" UBYTE B_TRUE 1 100 0 1 BIT_MASK 0x1 FORMAT "%13.11" ECU_ADDRESS 0x3FC395 /end MEASUREMENT
/begin MEASUREMENT B_tkwtans "" UBYTE B_TRUE 1 100 0 1 BIT_MASK 0x1 FORMAT "%13.11" ECU_ADDRESS 0x3FC396 /end MEASUREMENT
/begin MEASUREMENT B_tkwwarml "" UBYTE B_TRUE 1 100 0 1 BIT_MASK 0x1 FORMAT "%13.11" ECU_ADDRESS 0x3FC397 /end MEASUREMENT
/begin MEASUREMENT B_tmkr "Bedingung Temperatur (tmot) fuer KR aktiv erreicht" UBYTE B_TRUE 1 100 0 1 BIT_MASK 0x1 FORMAT "%13.11" ECU_ADDRESS 0x3FC1C0 /end MEASUREMENT
/begin MEASUREMENT B_wkral "Bedingung wkr aus KR-Adaptionskennfeld einlesen" UBYTE B_TRUE 1 100 0 1 BIT_MASK 0x1 FORMAT "%13.11" ECU_ADDRESS 0x3FC1C1 /end MEASUREMENT
/begin MEASUREMENT B_zwkraa "Bedingung Z¸ndwinkel der KR wird ausgegeben" UBYTE B_TRUE 1 100 0 1 BIT_MASK 0x1 FORMAT "%13.11" ECU_ADDRESS 0x3FC1C2 /end MEASUREMENT
/begin MEASUREMENT B_zwkrum "Flag: schnelle Fr¸hverstellung" UBYTE B_TRUE 1 100 0 1 BIT_MASK 0x1 FORMAT "%13.11" ECU_ADDRESS 0x3FC1C3 /end MEASUREMENT
/begin MEASUREMENT dhrlsue1_err "" UWORD dez 1 100 0 65535 FORMAT "%8.2" ECU_ADDRESS 0x402F56 /end MEASUREMENT
/begin MEASUREMENT dhrlsue2_err "" UWORD dez 1 100 0 65535 FORMAT "%8.2" ECU_ADDRESS 0x402F58 /end MEASUREMENT
/begin MEASUREMENT dib_ig "" SWORD igen_ub_q1 1 100 -255 255 FORMAT "%8.4" ECU_ADDRESS 0x40322A /end MEASUREMENT
/begin MEASUREMENT dib_ig2 "Delta Ibasis zu genig" SWORD igen_ub_q1 1 100 -255 255 FORMAT "%8.4" ECU_ADDRESS 0x403286 /end MEASUREMENT
/begin MEASUREMENT dmrdsls_w "Momentenreserve f¸r Diagnose Sekund‰rluft" UWORD rel_uw_b100 1 100 0 99.9985 FORMAT "%8.5" ECU_ADDRESS 0x402FF4 /end MEASUREMENT
/begin MEASUREMENT dmrkh "Momenten-Reserve f¸r Katheizen" UBYTE rel_ub_b99p6 1 100 0 99.6094 FORMAT "%5.2" ECU_ADDRESS 0x402FF1 /end MEASUREMENT
/begin MEASUREMENT dmrkhzg_w "Delta-Momentenreserve f¸r Katheizen" UWORD rel_uw_b100 1 100 0 99.9985 FORMAT "%8.5" ECU_ADDRESS 0x402FF6 /end MEASUREMENT
/begin MEASUREMENT dmrkhz_w "Momentenreserve f¸r Katheizen" UWORD rel_uw_b100 1 100 0 99.9985 FORMAT "%8.5" ECU_ADDRESS 0x402FF8 /end MEASUREMENT
/begin MEASUREMENT dmrkh_w "Momentenreserve f¸r Katheizen" UWORD rel_uw_b100 1 100 0 99.9985 FORMAT "%8.5" ECU_ADDRESS 0x402FFA /end MEASUREMENT
/begin MEASUREMENT drkwtmp_w "Momentenreserve f¸r Kat warmhalten, zeitweise" UWORD rel_uw_b100 1 100 0 99.9985 FORMAT "%8.5" ECU_ADDRESS 0x402FFC /end MEASUREMENT
/begin MEASUREMENT dweksw "aktueller KL-Wert delta Winkel Ersatz-Klopfsensor" UBYTE zw_ub_qn0p75 1 100 -191.25 0 FORMAT "%5.1" ECU_ADDRESS 0x403977 /end MEASUREMENT
/begin MEASUREMENT dwkr "zylinderindividuelle Z¸ndwinkelsp‰tverstellung KR" SBYTE zw_sb_q0p75 1 100 -96 95.25 FORMAT "%5.2" ECU_ADDRESS 0x403C45 /end MEASUREMENT
/begin MEASUREMENT dwkrmsw "aktueller Wert f¸r Mittelwertbegrenzung der Sp‰tverstellung" UBYTE zw_ub_qn0p75 1 100 -191.25 0 FORMAT "%5.1" ECU_ADDRESS 0x403C46 /end MEASUREMENT
/begin MEASUREMENT dwkrz "zyl.ind. ZW-Sp‰tverstellung inkl. Dyn.vorhalt" SBYTE zw_sb_q0p75 1 100 -96 95.25 FORMAT "%5.2" ARRAY_SIZE 8 ECU_ADDRESS 0x403C47 /end MEASUREMENT
/begin MEASUREMENT dyesehof_w "aktueller Wert Offset f¸r Lastdynamikerkennungsschwelle" SWORD hub_uw_q0p001 1 100 -32.768 32.767 FORMAT "%8.5" ECU_ADDRESS 0x4040F8 /end MEASUREMENT
/begin MEASUREMENT dyesehv_w "aktueller Wert Lastdynamikerkennungsschwelle" SWORD hub_uw_q0p001 1 100 -32.768 32.767 FORMAT "%8.5" ECU_ADDRESS 0x4040FA /end MEASUREMENT
/begin MEASUREMENT dyesofv_w "aktueller Wert Offset f¸r Lastdynamikerkennungsschwelle" SWORD relDK_q0p02441 1 100 -800 799.976 FORMAT "%8.4" ECU_ADDRESS 0x4040FC /end MEASUREMENT
/begin MEASUREMENT dyesv_w "aktueller Wert Lastdynamikerkennungsschwelle" SWORD relDK_q0p02441 1 100 -800 799.976 FORMAT "%8.4" ECU_ADDRESS 0x4040FE /end MEASUREMENT
/begin MEASUREMENT esst_snm08koub "" ULONG dez 1 100 0 4.29497e+009 FORMAT "%13.2" ECU_ADDRESS 0x404C20 /end MEASUREMENT
/begin MEASUREMENT fdib_ig "" SWORD igen_ub_q1 1 100 -255 255 FORMAT "%8.4" ECU_ADDRESS 0x40322C /end MEASUREMENT
/begin MEASUREMENT fdib_ig2 "Faktor bewerte Delta I" SWORD igen_ub_q1 1 100 -255 255 FORMAT "%8.4" ECU_ADDRESS 0x403288 /end MEASUREMENT
/begin MEASUREMENT fiptes_w "Faktor Pumpenstrom" UWORD fak_uw_b2 1 100 0 1.99997 FORMAT "%8.6" ECU_ADDRESS 0x40365A /end MEASUREMENT
/begin MEASUREMENT fkbkvab "Faktor Reduzierung Reservemoment f¸r Bremskraftverst‰rker" UBYTE fak_ub_b1 1 100 0 0.996094 ECU_ADDRESS 0x402FF2 /end MEASUREMENT
/begin MEASUREMENT fketm "" UBYTE fak_ub_b4 1 100 0 3.98438 FORMAT "%5.3" ECU_ADDRESS 0x40397E /end MEASUREMENT
/begin MEASUREMENT fmkhfho_w "Hˆhenkorrektur der Drehmomentenreserve bei Katheizen" UWORD fak_uw_b2 1 100 0 1.99997 FORMAT "%8.6" ECU_ADDRESS 0x402FFE /end MEASUREMENT
/begin MEASUREMENT fmkhtmst "tmst-Korrektur der Drehmomentreserve bei Katheizen" UBYTE fak_ub_b2 1 100 0 1.99219 FORMAT "%5.3" ECU_ADDRESS 0x402FF3 /end MEASUREMENT
/begin MEASUREMENT fwkram "" UBYTE fak_ub_b1 1 100 0 0.996094 ECU_ADDRESS 0x403C4F /end MEASUREMENT
/begin MEASUREMENT g2iptesf_w "gefilterte zweite zeitliche Ableitung des DM-TL Pumpstroms" SWORD i_q6p1035_uA 1 100 -200 199.994 FORMAT "%8.4" ECU_ADDRESS 0x40365C /end MEASUREMENT
/begin MEASUREMENT g2iptes_w "zweite zeitliche Ableitung des DM-TL Pumpstroms" SWORD i_q6p1035_uA 1 100 -200 199.994 FORMAT "%8.4" ECU_ADDRESS 0x40365E /end MEASUREMENT
/begin MEASUREMENT genalfak2 "Winderstands-Alpha-Faktor" UWORD genalfak_uw_q0p610Em7 1 100 0 2.99994 FORMAT "%8.6" ECU_ADDRESS 0x40322E /end MEASUREMENT
/begin MEASUREMENT genalfak22 "" UWORD genalfak_uw_q0p610Em7 1 100 0 2.99994 FORMAT "%8.6" ECU_ADDRESS 0x40328A /end MEASUREMENT
/begin MEASUREMENT genawnumm "Generatorkennfeldnummer" UBYTE DEZ 1 100 0 255 FORMAT "%5.1" ECU_ADDRESS 0x3FE1FA /end MEASUREMENT
/begin MEASUREMENT genawnumm2 "Generatorkennfeldnummer" UBYTE DEZ 1 100 0 255 FORMAT "%5.1" ECU_ADDRESS 0x3FE1FE /end MEASUREMENT
/begin MEASUREMENT gendi_spv "mittlerer quadratischer Diodenstrom" ULONG genpv_ul 1 100 0 510 FORMAT "%13.9" ECU_ADDRESS 0x403264 /end MEASUREMENT
/begin MEASUREMENT gendi_spv2 "" ULONG genpv_ul 1 100 0 510 FORMAT "%13.9" ECU_ADDRESS 0x4032C0 /end MEASUREMENT
/begin MEASUREMENT gendts "Temperaturerhoehung im Generatorstator" UWORD gendt_q0p075 1 100 0 768 FORMAT "%8.4" ECU_ADDRESS 0x403230 /end MEASUREMENT
/begin MEASUREMENT gendts2 "Temperaturerhoehung im Generatorstator" UWORD gendt_q0p075 1 100 0 768 FORMAT "%8.4" ECU_ADDRESS 0x40328C /end MEASUREMENT
/begin MEASUREMENT gendtsvor "Temp-Variable" UWORD gendt_q0p075 1 100 0 768 FORMAT "%8.4" ECU_ADDRESS 0x403232 /end MEASUREMENT
/begin MEASUREMENT gendtsvor2 "" UWORD gendt_q0p075 1 100 0 768 FORMAT "%8.4" ECU_ADDRESS 0x40328E /end MEASUREMENT
/begin MEASUREMENT gendts_s1 "Temperaturerhˆhung einer Statorspule und Diodenpaar" UWORD gendt_q0p075 1 100 0 192 FORMAT "%8.4" ECU_ADDRESS 0x403234 /end MEASUREMENT
/begin MEASUREMENT gendts_s12 "" UWORD gendt_q0p075 1 100 0 192 FORMAT "%8.4" ECU_ADDRESS 0x403290 /end MEASUREMENT
/begin MEASUREMENT genfeta "Generatorwirkungsgrad Berechnnugsterm" ULONG geneta_q0p03125 1 100 0.03125 8191.88 FORMAT "%13.8" ECU_ADDRESS 0x403268 /end MEASUREMENT
/begin MEASUREMENT genfeta2 "Generatorwirkungsgrad Berechnnugsterm" ULONG geneta_q0p03125 1 100 0.03125 8191.88 FORMAT "%13.8" ECU_ADDRESS 0x4032C4 /end MEASUREMENT
/begin MEASUREMENT geni2_st "mittlerer quadratischer Statorstrom" UWORD dez 1 100 0 65535 FORMAT "%8.2" ECU_ADDRESS 0x403236 /end MEASUREMENT
/begin MEASUREMENT geni2_st2 "" UWORD dez 1 100 0 65535 FORMAT "%8.2" ECU_ADDRESS 0x403292 /end MEASUREMENT
/begin MEASUREMENT genig "Generatorstrom gesamt" UBYTE igen_ub_q1 1 100 0 255 FORMAT "%5.1" ECU_ADDRESS 0x403278 /end MEASUREMENT
/begin MEASUREMENT genig2 "Generatorstrom gesamt" UBYTE igen_ub_q1 1 100 0 255 FORMAT "%5.1" ECU_ADDRESS 0x4032D4 /end MEASUREMENT
/begin MEASUREMENT genikaltu2 "DF korrektiert ueber Generatordrehzahl" UBYTE igen_ub_q1 1 100 0 255 FORMAT "%5.1" ECU_ADDRESS 0x4032D5 /end MEASUREMENT
/begin MEASUREMENT genikaltun "DF korrektiert ueber Generatordrehzahl" UBYTE igen_ub_q1 1 100 0 255 FORMAT "%5.1" ECU_ADDRESS 0x403279 /end MEASUREMENT
/begin MEASUREMENT geninafil "Generatorstrom nach Filter" UWORD igen_uw_q0p03125 1 100 0 256 FORMAT "%8.4" ECU_ADDRESS 0x403238 /end MEASUREMENT
/begin MEASUREMENT geninafil2 "Generatorstrom nach Filter" UWORD igen_uw_q0p03125 1 100 0 256 FORMAT "%8.4" ECU_ADDRESS 0x403294 /end MEASUREMENT
/begin MEASUREMENT genitemp "korrigiertes DF Signal ueber Temperatur, Generatordrehzahl, Generatorspannung" UBYTE igen_ub_q1 1 100 0 255 FORMAT "%5.1" ECU_ADDRESS 0x40327A /end MEASUREMENT
/begin MEASUREMENT genitemp_2 "korrigiertes DF Signal ueber Temperatur, Generatordrehzahl, Generatorspannung" UBYTE igen_ub_q1 1 100 0 255 FORMAT "%5.1" ECU_ADDRESS 0x4032D6 /end MEASUREMENT
/begin MEASUREMENT genivorfi2 "Generatorstrom vor Filter" UWORD igen_uw_q0p03125 1 100 0 256 FORMAT "%8.4" ECU_ADDRESS 0x403296 /end MEASUREMENT
/begin MEASUREMENT genivorfil "Generatorstrom vor Filter" UWORD igen_uw_q0p03125 1 100 0 256 FORMAT "%8.4" ECU_ADDRESS 0x40323A /end MEASUREMENT
/begin MEASUREMENT geni_difk "mittlerer Diodenstrom" UWORD igen_uw_q0p03125 1 100 0 255 FORMAT "%8.4" ECU_ADDRESS 0x40323C /end MEASUREMENT
/begin MEASUREMENT geni_difk2 "" UWORD igen_uw_q0p03125 1 100 0 255 FORMAT "%8.4" ECU_ADDRESS 0x403298 /end MEASUREMENT
/begin MEASUREMENT geni_end "Generatorstrom gemessen / gerechnet" UBYTE igen_ub_q1 1 100 0 254 FORMAT "%5.1" ECU_ADDRESS 0x40327B /end MEASUREMENT
/begin MEASUREMENT geni_end2 "Generatorstrom gemessen / gerechnet" UBYTE igen_ub_q1 1 100 0 254 FORMAT "%5.1" ECU_ADDRESS 0x4032D7 /end MEASUREMENT
/begin MEASUREMENT geni_stfk "mittlerer Statorstrom" UWORD igen_uw_q0p03125 1 100 0 255 FORMAT "%8.4" ECU_ADDRESS 0x40323E /end MEASUREMENT
/begin MEASUREMENT geni_stfk2 "" UWORD igen_uw_q0p03125 1 100 0 255 FORMAT "%8.4" ECU_ADDRESS 0x40329A /end MEASUREMENT
/begin MEASUREMENT gennummer "erkannte Generatornummer" UBYTE DEZ 1 100 0 255 FORMAT "%5.1" ECU_ADDRESS 0x40327C /end MEASUREMENT
/begin MEASUREMENT gennummer2 "erkannte Generatornummer" UBYTE DEZ 1 100 0 255 FORMAT "%5.1" ECU_ADDRESS 0x4032D8 /end MEASUREMENT
/begin MEASUREMENT genrs "Statorwiderstand" UWORD genrstator 1 100 0 0.999985 FORMAT "%9.7" ECU_ADDRESS 0x403240 /end MEASUREMENT
/begin MEASUREMENT genrs2 "Statorwiderstand" UWORD genrstator 1 100 0 0.999985 FORMAT "%9.7" ECU_ADDRESS 0x40329C /end MEASUREMENT
/begin MEASUREMENT genspv "Generatorstatorverlustleistung" UWORD genpv_uw_q0p03125 1 100 0 2047.97 FORMAT "%8.3" ECU_ADDRESS 0x403242 /end MEASUREMENT
/begin MEASUREMENT genspv2 "Generatorstatorverlustleistung" UWORD genpv_uw_q0p03125 1 100 0 2047.97 FORMAT "%8.3" ECU_ADDRESS 0x40329E /end MEASUREMENT
/begin MEASUREMENT genspv_1 "Verlustleistung einer Statorspule" ULONG genpv_ul 1 100 0 0.164978 FORMAT "%13.6" ECU_ADDRESS 0x40326C /end MEASUREMENT
/begin MEASUREMENT genspv_12 "" ULONG genpv_ul 1 100 0 0.164978 FORMAT "%13.6" ECU_ADDRESS 0x4032C8 /end MEASUREMENT
/begin MEASUREMENT genspv_2 "Verlustleistung eines Diodenpaars" ULONG genpv_ul 1 100 0 0.164978 FORMAT "%13.6" ECU_ADDRESS 0x403270 /end MEASUREMENT
/begin MEASUREMENT genspv_22 "" ULONG genpv_ul 1 100 0 0.164978 FORMAT "%13.6" ECU_ADDRESS 0x4032CC /end MEASUREMENT
/begin MEASUREMENT gensttemp "Generatorstarttemperatur" UWORD temp_uw_q0p75_o48 1 100 -48 336 FORMAT "%8.4" ECU_ADDRESS 0x403244 /end MEASUREMENT
/begin MEASUREMENT gensttemp2 "Generatorstarttemperatur" UWORD temp_uw_q0p75_o48 1 100 -48 336 FORMAT "%8.4" ECU_ADDRESS 0x4032A0 /end MEASUREMENT
/begin MEASUREMENT gentans "Generatoransauglufttemperatur" UWORD temp_uw_q0p75_o48 1 100 -48 336 FORMAT "%8.4" ECU_ADDRESS 0x403246 /end MEASUREMENT
/begin MEASUREMENT gentans2 "Generatoransauglufttemperatur" UWORD temp_uw_q0p75_o48 1 100 -48 336 FORMAT "%8.4" ECU_ADDRESS 0x4032A2 /end MEASUREMENT
/begin MEASUREMENT gentansen2 "Generatoransaugluftendwert" UWORD temp_ub_q0p75_o48 1 100 -48 143.25 FORMAT "%8.4" ECU_ADDRESS 0x4032A4 /end MEASUREMENT
/begin MEASUREMENT gentansend "Generatoransaugluftendwert" UWORD temp_ub_q0p75_o48 1 100 -48 143.25 FORMAT "%8.4" ECU_ADDRESS 0x403248 /end MEASUREMENT
/begin MEASUREMENT gentemp "Generatortemperatur" UWORD temp_uw_q0p75_o48 1 100 -48 336 FORMAT "%8.4" ECU_ADDRESS 0x40324A /end MEASUREMENT
/begin MEASUREMENT gentemp2 "Generatortemperatur" UWORD temp_uw_q0p75_o48 1 100 -48 336 FORMAT "%8.4" ECU_ADDRESS 0x4032A6 /end MEASUREMENT
/begin MEASUREMENT gentempab "Abstelltemperatur Generator" UWORD temp_uw_q0p75_o48 1 100 -48 336 FORMAT "%8.4" ECU_ADDRESS 0x3FE1FC /end MEASUREMENT
/begin MEASUREMENT gentempab2 "Abstelltemperatur Generator" UWORD temp_uw_q0p75_o48 1 100 -48 336 FORMAT "%8.4" ECU_ADDRESS 0x3FE200 /end MEASUREMENT
/begin MEASUREMENT gentempdt "Temperaturdifferenz zwischen Abstelltemperatur und Umgebungstemperatur" SWORD temp_sw_q0p75 1 100 -48 384 FORMAT "%8.4" ECU_ADDRESS 0x40324C /end MEASUREMENT
/begin MEASUREMENT gentempdt2 "Temperaturdifferenz zwischen Abstelltemperatur und Umgebungstemperatur" SWORD temp_sw_q0p75 1 100 -48 384 FORMAT "%8.4" ECU_ADDRESS 0x4032A8 /end MEASUREMENT
/begin MEASUREMENT gentempen2 "Generatortemperatur endg¸ltig" UWORD temp_uw_q0p75_o48 1 100 -48 336 FORMAT "%8.4" ECU_ADDRESS 0x4032AA /end MEASUREMENT
/begin MEASUREMENT gentempend "Generatortemperatur endg¸ltig" UWORD temp_uw_q0p75_o48 1 100 -48 336 FORMAT "%8.4" ECU_ADDRESS 0x40324E /end MEASUREMENT
/begin MEASUREMENT gentempex2 "Delta Abk¸hltemperatur" SWORD temp_sw_q0p75 1 100 -48 384 FORMAT "%8.4" ECU_ADDRESS 0x4032AC /end MEASUREMENT
/begin MEASUREMENT gentempexp "Delta Abk¸hltemperatur" SWORD temp_sw_q0p75 1 100 -48 384 FORMAT "%8.4" ECU_ADDRESS 0x403250 /end MEASUREMENT
/begin MEASUREMENT gentempfi2 "gefilterte Generatortemperatur" UWORD gendt_q0p075 1 100 0 768 FORMAT "%8.4" ECU_ADDRESS 0x4047A2 /end MEASUREMENT
/begin MEASUREMENT gentempfil "gefilterte Generatortemperatur" UWORD gendt_q0p075 1 100 0 768 FORMAT "%8.4" ECU_ADDRESS 0x40479E /end MEASUREMENT
/begin MEASUREMENT gen_teta "Wirkungsgrad Generator W*PI temperaturkompensiert" UWORD geneta_q0p03125 1 100 0 32 FORMAT "%8.5" ECU_ADDRESS 0x403252 /end MEASUREMENT
/begin MEASUREMENT gen_teta2 "Wirkungsgrad Generator W*PI temperaturkompensiert" UWORD geneta_q0p03125 1 100 0 32 FORMAT "%8.5" ECU_ADDRESS 0x4032AE /end MEASUREMENT
/begin MEASUREMENT gen_weta "Wirkungsgrad Generator mit Omega*PI" UBYTE geneta_q0p03125 1 100 0 7.96875 FORMAT "%5.3" ECU_ADDRESS 0x40327D /end MEASUREMENT
/begin MEASUREMENT gen_weta2 "Wirkungsgrad Generator mit Omega*PI" UBYTE geneta_q0p03125 1 100 0 7.96875 FORMAT "%5.3" ECU_ADDRESS 0x4032D9 /end MEASUREMENT
/begin MEASUREMENT giptesf_w "gefilterte erste zeitliche Ableitung des DM-TL Pumpstroms" SWORD i_q6p1035_uA 1 100 -200 199.994 FORMAT "%8.4" ECU_ADDRESS 0x403660 /end MEASUREMENT
/begin MEASUREMENT giptes_w "erste zeitliche Ableitung des DM-TL Pumpstroms" SWORD i_q6p1035_uA 1 100 -200 199.994 FORMAT "%8.4" ECU_ADDRESS 0x403662 /end MEASUREMENT
/begin MEASUREMENT ibasis "" UBYTE igen_ub_q1 1 100 0 255 FORMAT "%5.1" ECU_ADDRESS 0x40327E /end MEASUREMENT
/begin MEASUREMENT ibasis2 "Basis Strombedarf FZG mit SLP" UBYTE igen_ub_q1 1 100 0 255 FORMAT "%5.1" ECU_ADDRESS 0x4032DA /end MEASUREMENT
/begin MEASUREMENT igen400A "gemmessener Generatorstrom 400A-Bereich" UWORD fak_uw_b512 1 100 0 511.992 FORMAT "%8.4" ECU_ADDRESS 0x403254 /end MEASUREMENT
/begin MEASUREMENT igen400A2 "gemmessener Generatorstrom 400A-Bereich" UWORD fak_uw_b512 1 100 0 511.992 FORMAT "%8.4" ECU_ADDRESS 0x4032B0 /end MEASUREMENT
/begin MEASUREMENT igm "" UBYTE igen_ub_q1 1 100 0 255 FORMAT "%5.1" ECU_ADDRESS 0x40327F /end MEASUREMENT
/begin MEASUREMENT igm2 "Generatormischstrom" UBYTE igen_ub_q1 1 100 0 255 FORMAT "%5.1" ECU_ADDRESS 0x4032DB /end MEASUREMENT
/begin MEASUREMENT igvor "" UBYTE igen_ub_q1 1 100 0 255 FORMAT "%5.1" ECU_ADDRESS 0x403280 /end MEASUREMENT
/begin MEASUREMENT igvor2 "Stromwert nach ‹berblendung" UBYTE igen_ub_q1 1 100 0 255 FORMAT "%5.1" ECU_ADDRESS 0x4032DC /end MEASUREMENT
/begin MEASUREMENT ikrn_w "Normiertes Klopfintegral rollierend mit Zylinderz‰hler" UWORD spg_uw_b1280 1 100 0 1279.98 FORMAT "%8.3" ECU_ADDRESS 0x404106 /end MEASUREMENT
/begin MEASUREMENT index "Index f¸r Zylinderanzahl" UWORD dez 1 100 0 65535 FORMAT "%8.2" ECU_ADDRESS 0x404766 /end MEASUREMENT
/begin MEASUREMENT integberg "" UWORD fak_uw_b256 1 100 0 255.996 FORMAT "%8.4" ECU_ADDRESS 0x40435E /end MEASUREMENT
/begin MEASUREMENT integkr "" UWORD fak_uw_b256 1 100 0 255.996 FORMAT "%8.4" ECU_ADDRESS 0x404360 /end MEASUREMENT
/begin MEASUREMENT integlast "" UWORD fak_uw_b256 1 100 0 255.996 FORMAT "%8.4" ECU_ADDRESS 0x404362 /end MEASUREMENT
/begin MEASUREMENT integtans "" UWORD fak_uw_b256 1 100 0 255.996 FORMAT "%8.4" ECU_ADDRESS 0x404364 /end MEASUREMENT
/begin MEASUREMENT ipfdmtlAusBits "" UBYTE dez 1 100 0 255 FORMAT "%5.1" ECU_ADDRESS 0x40366E /end MEASUREMENT
/begin MEASUREMENT ipfdmtlAusBitsNov "" UBYTE dez 1 100 0 255 FORMAT "%5.1" ECU_ADDRESS 0x3FE2EA /end MEASUREMENT
/begin MEASUREMENT ipfdmtlLokBits "" UBYTE dez 1 100 0 255 FORMAT "%5.1" ECU_ADDRESS 0x40366F /end MEASUREMENT
/begin MEASUREMENT iprfmn_w "minimaler Pumpenstrom Referenzleck" UWORD i_q6p1035_uA 1 100 0 399.994 FORMAT "%8.4" ECU_ADDRESS 0x3FE2DC /end MEASUREMENT
/begin MEASUREMENT iprfmx_w "maximaler Pumpenstrom Referenzleck" UWORD i_q6p1035_uA 1 100 0 399.994 FORMAT "%8.4" ECU_ADDRESS 0x3FE2DE /end MEASUREMENT
/begin MEASUREMENT ipteskfh_w "Pumpenstrom Tankdiagnose korrigiert und hochpaﬂgefiltert" SWORD i_q6p1035_uA 1 100 -200 199.994 FORMAT "%8.4" ECU_ADDRESS 0x40366A /end MEASUREMENT
/begin MEASUREMENT ipteskfm_w "Max. Pumpenstrom Tankdiagnose korrigiert und gefiltert w‰hrend Messung" UWORD i_q6p1035_uA 1 100 0 399.994 FORMAT "%8.4" ECU_ADDRESS 0x3FE2E0 /end MEASUREMENT
/begin MEASUREMENT ipteskf_w "Pumpenstrom Tankdiagnose korrigiert und gefiltert" UWORD i_q6p1035_uA 1 100 0 399.994 FORMAT "%8.4" ECU_ADDRESS 0x3FE2E2 /end MEASUREMENT
/begin MEASUREMENT iptesk_w "Pumpenstrom Tankdiagnose korrigiert" UWORD i_q6p1035_uA 1 100 0 399.994 FORMAT "%8.4" ECU_ADDRESS 0x40366C /end MEASUREMENT
/begin MEASUREMENT ke "Klopferkennungsschwelle aus Kennfeld" UBYTE fak_ub_b4 1 100 0 3.98438 FORMAT "%5.3" ARRAY_SIZE 8 ECU_ADDRESS 0x403C64 /end MEASUREMENT
/begin MEASUREMENT kek "Klopferkennungsschwelle korrigiert" UBYTE fak_ub_b4 1 100 0 3.98438 FORMAT "%5.3" ARRAY_SIZE 8 ECU_ADDRESS 0x403C6C /end MEASUREMENT
/begin MEASUREMENT kek_tst "Klopferkennungsschwelle korrigiert rollierend mit Zyl.z‰hler" UBYTE fak_ub_b4 1 100 0 3.98438 FORMAT "%5.3" ECU_ADDRESS 0x403C74 /end MEASUREMENT
/begin MEASUREMENT kereffw "Ausgang KEREFF" UBYTE rel_ub_b100 1 100 0.390625 99.6094 FORMAT "%5.2" ECU_ADDRESS 0x40397F /end MEASUREMENT
/begin MEASUREMENT kerefldyw "" UBYTE rel_ub_b100 1 100 0.390625 99.6094 FORMAT "%5.2" ECU_ADDRESS 0x403980 /end MEASUREMENT
/begin MEASUREMENT kerefndyw "" UBYTE rel_ub_b100 1 100 0.390625 99.6094 FORMAT "%5.2" ECU_ADDRESS 0x403981 /end MEASUREMENT
/begin MEASUREMENT kezkkl "zyl.-ind. Z‰hler f¸r nicht klopfende Arbeitsspiele (Z‰hler kein Klopfen)" UWORD dez 1 100 0 65535 FORMAT "%8.2" ARRAY_SIZE 8 ECU_ADDRESS 0x404768 /end MEASUREMENT
/begin MEASUREMENT kezkklmx "zyl.-ind. max. Z‰hlerstand f¸r nicht klopfende Arbeitsspiele" UWORD dez 1 100 0 65535 FORMAT "%8.2" ARRAY_SIZE 8 ECU_ADDRESS 0x404778 /end MEASUREMENT
/begin MEASUREMENT kezmxmit "Mittelwert der max. Z‰hlerst‰nde aller Zylinder (Z‰hler max. Summe)" UWORD dez 1 100 0 65535 FORMAT "%8.2" ECU_ADDRESS 0x404788 /end MEASUREMENT
/begin MEASUREMENT kosAusByte1 "" UBYTE dez 1 100 0 255 FORMAT "%5.1" ECU_ADDRESS 0x40374D /end MEASUREMENT
/begin MEASUREMENT kosLokByte1 "" UBYTE dez 1 100 0 255 FORMAT "%5.1" ECU_ADDRESS 0x40374E /end MEASUREMENT
/begin MEASUREMENT kral1w "aktueller Wert Last-Adaptionsbereich 1" UBYTE rel_ub_q0p75 1 100 0 191.25 FORMAT "%5.1" ECU_ADDRESS 0x40303E /end MEASUREMENT
/begin MEASUREMENT kral2w "aktueller Wert Last-Adaptionsbereich 2" UBYTE rel_ub_q0p75 1 100 0 191.25 FORMAT "%5.1" ECU_ADDRESS 0x40303F /end MEASUREMENT
/begin MEASUREMENT krdwsw "aktueller KL-Wert der Sicherheitssp‰tverstellung" UBYTE zw_ub_qn0p75 1 100 -191.25 0 FORMAT "%5.1" ECU_ADDRESS 0x403C50 /end MEASUREMENT
/begin MEASUREMENT krfkw "Aktueller Wert aus KRFKN" UBYTE zw_ub_qn0p75 1 100 -191.25 0 FORMAT "%5.1" ECU_ADDRESS 0x403C51 /end MEASUREMENT
/begin MEASUREMENT krmxw "aktueller Wert f¸r Sp‰tbegrenzung der Sp‰tverstellung" UBYTE zw_ub_qn0p75 1 100 -191.25 0 FORMAT "%5.1" ECU_ADDRESS 0x403C52 /end MEASUREMENT
/begin MEASUREMENT krvfakt "Initwert f¸r normale bzw. schnelle Fr¸hverstellung" UBYTE dez 1 100 0 255 FORMAT "%5.1" ECU_ADDRESS 0x403C53 /end MEASUREMENT
/begin MEASUREMENT krvfsw "Initwert f¸r schnelle Fr¸hverstellung" UBYTE dez 1 100 0 255 FORMAT "%5.1" ECU_ADDRESS 0x403C54 /end MEASUREMENT
/begin MEASUREMENT krvfw "Initwert f¸r normale Fr¸hverstellung" UBYTE dez 1 100 0 255 FORMAT "%5.1" ECU_ADDRESS 0x403C55 /end MEASUREMENT
/begin MEASUREMENT ksa "Nummer des Klopfsensors" UBYTE dezsub1 1 100 1 256 FORMAT "%5.1" ECU_ADDRESS 0x403978 /end MEASUREMENT
/begin MEASUREMENT ksb "Ersatzklopfsensor B" UBYTE dezsub1 1 100 1 256 FORMAT "%5.1" ECU_ADDRESS 0x403979 /end MEASUREMENT
/begin MEASUREMENT ksdefa "Nummer des defekten Klopfsensors von Ersatzsensor A" UBYTE dezsub1 1 100 1 256 FORMAT "%5.1" ECU_ADDRESS 0x40397A /end MEASUREMENT
/begin MEASUREMENT ksdefb "Nummer des defekten Klopfsensors von Ersatzsensor B" UBYTE dezsub1 1 100 1 256 FORMAT "%5.1" ECU_ADDRESS 0x40397B /end MEASUREMENT
/begin MEASUREMENT kttahrlsu2_w "" UWORD dez 1 100 0 65535 FORMAT "%8.2" ECU_ADDRESS 0x4046F2 /end MEASUREMENT
/begin MEASUREMENT kttahrlsu_w "" UWORD dez 1 100 0 65535 FORMAT "%8.2" ECU_ADDRESS 0x4046F4 /end MEASUREMENT
/begin MEASUREMENT kttphrlsu_w "" UWORD vnstv_q0p01 1 100 0 655.35 FORMAT "%7.3" ECU_ADDRESS 0x4046F6 /end MEASUREMENT
/begin MEASUREMENT lkrw "aktueller Wert der Lastschwelle Klopfregelung" UBYTE rel_ub_q0p75 1 100 0 191.25 FORMAT "%5.1" ECU_ADDRESS 0x403040 /end MEASUREMENT
/begin MEASUREMENT lkrwnl "" UBYTE rel_ub_q0p75 1 100 0 191.25 FORMAT "%5.1" ECU_ADDRESS 0x403041 /end MEASUREMENT
/begin MEASUREMENT mdgenloc_2 "relatives Generatormoment" UWORD rel_uw_b100 1 100 0 99.9985 FORMAT "%8.5" ECU_ADDRESS 0x4032B2 /end MEASUREMENT
/begin MEASUREMENT mdgenloc_w "" UWORD rel_uw_b100 1 100 0 99.9985 FORMAT "%8.5" ECU_ADDRESS 0x403256 /end MEASUREMENT
/begin MEASUREMENT mdgenrel_2 "relatives Generatormoment Ausgang" UWORD rel_uw_b100 1 100 0 99.9985 FORMAT "%8.5" ECU_ADDRESS 0x4032B4 /end MEASUREMENT
/begin MEASUREMENT mdgenrel_w "" UWORD rel_uw_b100 1 100 0 99.9985 FORMAT "%8.5" ECU_ADDRESS 0x403258 /end MEASUREMENT
/begin MEASUREMENT mdgenvf_2w "relatives Generatordrehmoment" UWORD rel_uw_b100 1 100 0 99.9985 FORMAT "%8.5" ECU_ADDRESS 0x4032B6 /end MEASUREMENT
/begin MEASUREMENT mdgenvf_w "gefiltertes Generatormoment absolut" UWORD rel_uw_b100 1 100 0 99.9985 FORMAT "%8.5" ECU_ADDRESS 0x40325A /end MEASUREMENT
/begin MEASUREMENT MDNORMTMP "tempor‰re MDNORM" UBYTE md_ub_q16 1 100 16 1008 FORMAT "%5.0" ECU_ADDRESS 0x40399D /end MEASUREMENT
/begin MEASUREMENT MDNORMTMP2 "" UBYTE md_ub_q16 1 100 16 1008 FORMAT "%5.0" ECU_ADDRESS 0x4039A3 /end MEASUREMENT
/begin MEASUREMENT md_gennm "Generatormoment absolut" UWORD md_ub_q0p025 1 100 0 128 FORMAT "%8.4" ECU_ADDRESS 0x40325C /end MEASUREMENT
/begin MEASUREMENT md_gennm2 "Generatormoment absolut" UWORD md_ub_q0p025 1 100 0 128 FORMAT "%8.4" ECU_ADDRESS 0x4032B8 /end MEASUREMENT
/begin MEASUREMENT mifakh_w "indiziertes Motormoment f¸r Katheizen" UWORD rel_uw_b100 1 100 0 99.9985 FORMAT "%8.5" ECU_ADDRESS 0x403000 /end MEASUREMENT
/begin MEASUREMENT ndiprfo_w "Anzahl abgebrochener Messungen wegen Stromschwankungen" UWORD dez 1 100 0 65535 FORMAT "%8.2" ECU_ADDRESS 0x3FE2E4 /end MEASUREMENT
/begin MEASUREMENT ngen_w "Generatordrehzahl (= UEFNMNG * nmot)" UWORD ngen_uw_q0p5 1 100 0 32767.5 FORMAT "%8.2" ECU_ADDRESS 0x4047A0 /end MEASUREMENT
/begin MEASUREMENT ngen_w2 "Generatordrehzahl" UWORD ngen_uw_q0p5 1 100 0 32767.5 FORMAT "%8.2" ECU_ADDRESS 0x4047A4 /end MEASUREMENT
/begin MEASUREMENT ngkrv_w "aktueller Wert Drehzahldynamikschwelle" SWORD nmotg_sw_q0p39 1 100 -12800.2 12799.8 FORMAT "%8.2" ECU_ADDRESS 0x404100 /end MEASUREMENT
/begin MEASUREMENT nmots "Motordrehzahl U/s" UBYTE nwu_q1 1 100 0 255 FORMAT "%5.1" ECU_ADDRESS 0x403281 /end MEASUREMENT
/begin MEASUREMENT nmots2 "Motordrehzahl U/s" UBYTE nwu_q1 1 100 0 255 FORMAT "%5.1" ECU_ADDRESS 0x4032DD /end MEASUREMENT
/begin MEASUREMENT nngkrv_w "aktueller Wert Drehzahldynamikschwelle" SWORD nmotg_sw_q0p39 1 100 -12800.2 12799.8 FORMAT "%8.2" ECU_ADDRESS 0x404102 /end MEASUREMENT
/begin MEASUREMENT nvrbupctr "Z‰hler: Anzahl abgebrochener NVRAM-Backup's/Flash" UBYTE DEZ 1 100 0 255 FORMAT "%5.1" ECU_ADDRESS 0x3FE966 /end MEASUREMENT
/begin MEASUREMENT pgenab "elektrische Generatorleistung" ULONG genpv_uw_q0p03125 1 100 0 4096 FORMAT "%13.8" ECU_ADDRESS 0x403274 /end MEASUREMENT
/begin MEASUREMENT pgenab2 "elektrische Generatorleistung" ULONG genpv_uw_q0p03125 1 100 0 4096 FORMAT "%13.8" ECU_ADDRESS 0x4032D0 /end MEASUREMENT
/begin MEASUREMENT rkr "Referenzpegel Klopfregelung" UBYTE spg_ub_b5 1 100 0 4.98047 FORMAT "%5.3" ARRAY_SIZE 8 ECU_ADDRESS 0x403C75 /end MEASUREMENT
/begin MEASUREMENT rkrem1w "" UBYTE fak_ub_b1 1 100 0 0.996094 ECU_ADDRESS 0x403982 /end MEASUREMENT
/begin MEASUREMENT rkrem2w "" UBYTE fak_ub_b1 1 100 0 0.996094 ECU_ADDRESS 0x403983 /end MEASUREMENT
/begin MEASUREMENT rkrkor "" UBYTE spg_ub_b5 1 100 0 4.98047 FORMAT "%5.3" ARRAY_SIZE 8 ECU_ADDRESS 0x403984 /end MEASUREMENT
/begin MEASUREMENT rkrmx1w "aktueller Wert der KL RKRMX1N" UBYTE spg_ub_b320 1 100 0 318.75 ECU_ADDRESS 0x403C7D /end MEASUREMENT
/begin MEASUREMENT rkrmx2w "aktueller Wert der KL RKRMX2N" UBYTE spg_ub_b320 1 100 0 318.75 ECU_ADDRESS 0x403C7E /end MEASUREMENT
/begin MEASUREMENT rkr_tst "Referenzpegel Klopfregelung rollierend mit Zyl.z‰hler" UBYTE spg_ub_b5 1 100 0 4.98047 FORMAT "%5.3" ECU_ADDRESS 0x403C7F /end MEASUREMENT
/begin MEASUREMENT stkrlx "Lastst¸tzstelle f¸r die KR-Adaption" UBYTE dez 1 100 0 255 FORMAT "%5.1" ECU_ADDRESS 0x403C56 /end MEASUREMENT
/begin MEASUREMENT stkrnx "Drehzahlst¸tzstelle f¸r die KR-Adaption" UBYTE dez 1 100 0 255 FORMAT "%5.1" ECU_ADDRESS 0x403C57 /end MEASUREMENT
/begin MEASUREMENT st_i_gen "Generatorstrom" UBYTE igen_ub_q1 1 100 0 255 FORMAT "%5.1" ECU_ADDRESS 0x403282 /end MEASUREMENT
/begin MEASUREMENT st_i_gen2 "Generatorstrom" UBYTE igen_ub_q1 1 100 0 255 FORMAT "%5.1" ECU_ADDRESS 0x4032DE /end MEASUREMENT
/begin MEASUREMENT teemrdy "Zeitz‰hler f¸r EEPROM-Spiegel-Bereitschaft" UBYTE t100msxs_ub_b25p5 1 100 0 25.5 FORMAT "%5.2" ECU_ADDRESS 0x402FCD /end MEASUREMENT
/begin MEASUREMENT tfnvr_ctr "Timoutz‰hler: Testeranforderung ""Zwangsabspeicherung NVRAM""" UWORD t100msxs_uw_b6553p5 1 100 0 6553.5 FORMAT "%8.3" ECU_ADDRESS 0x4035D6 /end MEASUREMENT
/begin MEASUREMENT tkakor_in "Temperaturdifferenz tmot-tans" SWORD temp_sb_q0p75 1 100 -192 191.25 FORMAT "%8.4" ECU_ADDRESS 0x404658 /end MEASUREMENT
/begin MEASUREMENT tkosamn "Timer f¸r minimale Abschaltzeit des Klimakompressors" UBYTE t200msxs_ub_b51 1 100 0 51 FORMAT "%5.2" ECU_ADDRESS 0x40374F /end MEASUREMENT
/begin MEASUREMENT tkosamx "Timer f¸r maximale Abschaltzeit des Klimakompressors" UBYTE t200msxs_ub_b51 1 100 0 51 FORMAT "%5.2" ECU_ADDRESS 0x403750 /end MEASUREMENT
/begin MEASUREMENT tkosemn "Timer f¸r minimale Einschaltzeit des Klimakompressors" UBYTE t200msxs_ub_b51 1 100 0 51 FORMAT "%5.2" ECU_ADDRESS 0x403751 /end MEASUREMENT
/begin MEASUREMENT tkrst "Kraftstofftemperatur" UBYTE temp_ub_q0p75_o48 1 100 -48 143.25 FORMAT "%5.1" ECU_ADDRESS 0x403902 /end MEASUREMENT
/begin MEASUREMENT tkrstab "Kraftstofftemperatur beim Abstellen aus Modell" UBYTE temp_ub_q0p75_o48 1 100 -48 143.25 FORMAT "%5.1" ECU_ADDRESS 0x3FE170 /end MEASUREMENT
/begin MEASUREMENT tkrstluft "Offset durch Lufteinfluss auf tkrst" SBYTE temp_sb_q1p5 1 100 -192 190.5 FORMAT "%5.1" ECU_ADDRESS 0x403903 /end MEASUREMENT
/begin MEASUREMENT tkrststart "Startwert f¸r tkrst nach Reset" SWORD temp_sw_q0p75 1 100 -192 191.25 FORMAT "%8.4" ECU_ADDRESS 0x40465A /end MEASUREMENT
/begin MEASUREMENT tkrstvt "Rohwert tkrst" SWORD temp_sw_q0p75 1 100 -192 191.25 FORMAT "%8.4" ECU_ADDRESS 0x40465C /end MEASUREMENT
/begin MEASUREMENT tkrstwand "Einfluss Wandtemperatur Rail tkrst" SBYTE temp_sb_q1p5 1 100 -192 190.5 FORMAT "%5.1" ECU_ADDRESS 0x403904 /end MEASUREMENT
/begin MEASUREMENT tkrstzu "Einfluﬂ Zulaufmassenstrom Kraftstoff mit tumg auf tkrst" SBYTE temp_sb_q1p5 1 100 -192 190.5 FORMAT "%5.1" ECU_ADDRESS 0x403905 /end MEASUREMENT
/begin MEASUREMENT tkwdiff "" SWORD temp_ub_q0p75_o48 1 100 -24624 24527.3 FORMAT "%8.2" ECU_ADDRESS 0x404366 /end MEASUREMENT
/begin MEASUREMENT tkwi "" SWORD fak_q0p1 1 100 -3276.8 3276.7 FORMAT "%8.3" ECU_ADDRESS 0x404368 /end MEASUREMENT
/begin MEASUREMENT tkwp "" SWORD fak_q0p1 1 100 -3276.8 3276.7 FORMAT "%8.3" ECU_ADDRESS 0x40436A /end MEASUREMENT
/begin MEASUREMENT tkwpi "" SWORD fak_q0p1 1 100 -3276.8 3276.7 FORMAT "%8.3" ECU_ADDRESS 0x40436C /end MEASUREMENT
/begin MEASUREMENT tkwpwm "Tastverh‰ltnis Kennfeldthermostat" SWORD fak_q0p1 1 100 -3276.8 3276.7 FORMAT "%8.3" ECU_ADDRESS 0x40436E /end MEASUREMENT
/begin MEASUREMENT tkws "Solltemperatur von geregeltem Kennfeldthermostat" UBYTE temp_ub_q0p75_o48 1 100 -48 143.25 FORMAT "%5.1" ECU_ADDRESS 0x403D5C /end MEASUREMENT
/begin MEASUREMENT tkwv "" SWORD fak_q0p1 1 100 -3276.8 3276.7 FORMAT "%8.3" ECU_ADDRESS 0x404370 /end MEASUREMENT
/begin MEASUREMENT tptmot_out "Einfluss ¸ber K¸hlwassertemperatur auf tkrst" UBYTE temp_ub_q0p75_o48 1 100 -48 143.25 FORMAT "%5.1" ECU_ADDRESS 0x403906 /end MEASUREMENT
/begin MEASUREMENT tstcountv "Testcounter-Wert" UWORD t1sxs_ub_q1 1 100 0 65535 FORMAT "%8.2" ECU_ADDRESS 0x40325E /end MEASUREMENT
/begin MEASUREMENT tstcountv2 "Testcounter-Wert" UWORD t1sxs_ub_q1 1 100 0 65535 FORMAT "%8.2" ECU_ADDRESS 0x4032BA /end MEASUREMENT
/begin MEASUREMENT tstfil_ou2 "Testfilter Ausgang" UWORD gendt_q0p075 1 100 0 768 FORMAT "%8.4" ECU_ADDRESS 0x4032BC /end MEASUREMENT
/begin MEASUREMENT tstfil_out "Testfilter Ausgang" UWORD gendt_q0p075 1 100 0 768 FORMAT "%8.4" ECU_ADDRESS 0x403260 /end MEASUREMENT
/begin MEASUREMENT tstlocini "Temp-Variable" UBYTE B_TRUE 1 100 0 1 FORMAT "%13.11" ECU_ADDRESS 0x40399E /end MEASUREMENT
/begin MEASUREMENT tstlocini2 "" UBYTE B_TRUE 1 100 0 1 FORMAT "%13.11" ECU_ADDRESS 0x4039A4 /end MEASUREMENT
/begin MEASUREMENT twtldtemv "Verbleibende Wartezeit nach Magnetventilumschaltung" UBYTE t_q0p1 1 100 0 25.5 FORMAT "%5.2" ECU_ADDRESS 0x3FE2EB /end MEASUREMENT
/begin MEASUREMENT ubtesf_w "Batteriespannung gefiltert" UWORD spg_q0p00039 1 100 0 25.5996 FORMAT "%8.5" ECU_ADDRESS 0x3FE2E6 /end MEASUREMENT
/begin MEASUREMENT ubtref_w "Batteriespannung bei Referenzleckmessung" UWORD spg_q0p00039 1 100 0 25.5996 FORMAT "%8.5" ECU_ADDRESS 0x3FE2E8 /end MEASUREMENT
/begin MEASUREMENT ugen_tmp "" UWORD spg_ugen 1 100 10.6 16 FORMAT "%8.5" ECU_ADDRESS 0x403262 /end MEASUREMENT
/begin MEASUREMENT ugen_tmp2 "" UWORD spg_ugen 1 100 10.6 16 FORMAT "%8.5" ECU_ADDRESS 0x4032BE /end MEASUREMENT
/begin MEASUREMENT uushk2_w "ADC-Spannung Lambdasonde hinter Katalysator Bank2 (Word)" UWORD spg_uw_q0p00488 1 100 0 319.995 FORMAT "%8.4" ECU_ADDRESS 0x40474E /end MEASUREMENT
/begin MEASUREMENT uushk_w "ADC-Spannung Lambdasonde hinter Katalysator (Word)" UWORD spg_uw_q0p00488 1 100 0 319.995 FORMAT "%8.4" ECU_ADDRESS 0x404750 /end MEASUREMENT
/begin MEASUREMENT valutggls "Wert zum Laden des Timers TGGLS" UBYTE t_q0p001 1 100 0 0.255 FORMAT "%6.4" ECU_ADDRESS 0x3FC3C7 /end MEASUREMENT
/begin MEASUREMENT vfzstate "Status VFZG-Komponententreiber" UBYTE dez 1 100 0 255 FORMAT "%5.1" ECU_ADDRESS 0x40395B /end MEASUREMENT
/begin MEASUREMENT vfz_per_w "Periodendauer VFZ-PWM-Input alt" UWORD t1usxms_q0p001 1 100 0 65.535 FORMAT "%8.5" ECU_ADDRESS 0x404752 /end MEASUREMENT
/begin MEASUREMENT virkr "Verh‰ltnis Integrator / Referenzpegel Klopfregelung" UBYTE fak_ub_b4 1 100 0 3.98438 FORMAT "%5.3" ECU_ADDRESS 0x3FC3D6 /end MEASUREMENT
/begin MEASUREMENT vkr "Verst‰rkungsstufe f¸r Eingangsverst‰rkung Klopf-IC" UBYTE dez 1 100 0 255 FORMAT "%5.1" ARRAY_SIZE 8 ECU_ADDRESS 0x403C80 /end MEASUREMENT
/begin MEASUREMENT vkr_tst "Verst‰rkungsstufe f¸r Eingangsverst‰rkung Klopf-IC rollierend mit Zyl.z‰hler" UBYTE dez 1 100 0 255 FORMAT "%5.1" ECU_ADDRESS 0x403C88 /end MEASUREMENT
/begin MEASUREMENT vroh_w "Fahrzeuggeschwindigkeit ungefiltert" UWORD vfzg_uw_b512 1 100 0 511.992 FORMAT "%8.4" ECU_ADDRESS 0x404754 /end MEASUREMENT
/begin MEASUREMENT vszwm "Mittelwert der ZW-Verstellung ¸ber VS2x" SBYTE zw_sb_q0p75 1 100 -96 95.25 FORMAT "%5.2" ECU_ADDRESS 0x403C58 /end MEASUREMENT
/begin MEASUREMENT wkr "zylinderindividuelle Z¸ndwinkelsp‰tverstellung KR" UBYTE zw_ub_qn0p75 1 100 -191.25 0 FORMAT "%5.1" ARRAY_SIZE 8 ECU_ADDRESS 0x3FC3CC /end MEASUREMENT
/begin MEASUREMENT wkra "last und drehzahlabh. Adaptionskennfeld f. wkr" UBYTE zw_ub_qn0p75 1 100 -191.25 0 FORMAT "%5.1" ARRAY_SIZE 168 ECU_ADDRESS 0x3FDDA4 /end MEASUREMENT
/begin MEASUREMENT wkrasum_w "" UWORD zw_ub_qn0p75 1 100 -49151.3 0 FORMAT "%8.2" ECU_ADDRESS 0x404104 /end MEASUREMENT
/begin MEASUREMENT wkratst "wkra mit Synchro-Raster rollierend" UBYTE zw_ub_qn0p75 1 100 -191.25 0 FORMAT "%5.1" ECU_ADDRESS 0x403C59 /end MEASUREMENT
/begin MEASUREMENT wkrdy "Z¸ndwinkelsp‰tverstellung bei KR-Dynamik" UBYTE zw_ub_qn0p75 1 100 -191.25 0 FORMAT "%5.1" ECU_ADDRESS 0x3FC3C8 /end MEASUREMENT
/begin MEASUREMENT wkrdya "adaptierter Z¸ndwinkel bei KR-Dynamik" UBYTE zw_ub_qn0p75 1 100 -191.25 0 FORMAT "%5.1" ARRAY_SIZE 5 ECU_ADDRESS 0x3FE1C2 /end MEASUREMENT
/begin MEASUREMENT wkrdyvs "vorgesteuerter Z¸ndwinkelsp‰tverstellung bei KR-Dynamik" UBYTE zw_ub_qn0p75 1 100 -191.25 0 FORMAT "%5.1" ECU_ADDRESS 0x3FC3C9 /end MEASUREMENT
/begin MEASUREMENT wkrksa "mittlere KR-Sp‰tverstellung aller Zylinder an Ersatzsensor A" UBYTE zw_ub_qn0p75 1 100 -191.25 0 FORMAT "%5.1" ECU_ADDRESS 0x40397C /end MEASUREMENT
/begin MEASUREMENT wkrksb "mittlere KR-Sp‰tverstellung aller Zylinder an Ersatzsensor B" UBYTE zw_ub_qn0p75 1 100 -191.25 0 FORMAT "%5.1" ECU_ADDRESS 0x40397D /end MEASUREMENT
/begin MEASUREMENT wkrm "Mittelwert der zylinderindividuellen ZW-Sp‰tverstellungen durch KR" UBYTE zw_ub_qn0p75 1 100 -191.25 0 FORMAT "%5.1" ECU_ADDRESS 0x3FC3D4 /end MEASUREMENT
/begin MEASUREMENT wkrma "Mittelwert der ZW-Sp‰tverstellungen KR, allgemein (im Notlauf mit Sicherheit)" UBYTE zw_ub_qn0p75 1 100 -191.25 0 FORMAT "%5.1" ECU_ADDRESS 0x3FC3D5 /end MEASUREMENT
/begin MEASUREMENT wkrmdiv "" UBYTE dez 1 100 0 255 FORMAT "%5.1" ECU_ADDRESS 0x403C5A /end MEASUREMENT
/begin MEASUREMENT wkr_tst "zyl.ind. ZW-Sp‰tverstellung, rollierend" UBYTE zw_ub_qn0p75 1 100 -191.25 0 FORMAT "%5.1" ECU_ADDRESS 0x403C5B /end MEASUREMENT
/begin MEASUREMENT zaldy "Z¸ndungsz‰hler f¸r Abregelung Lastdynamik" UBYTE dez 1 100 0 255 FORMAT "%5.1" ECU_ADDRESS 0x403C44 /end MEASUREMENT
/begin MEASUREMENT zkrvf "Z‰hler, bestimmt die Frequenz der zyl.-individuellen Z¸ndwinkelfr¸hverstellung" UBYTE dez 1 100 0 255 FORMAT "%5.1" ARRAY_SIZE 8 ECU_ADDRESS 0x403C5C /end MEASUREMENT
/begin MEASUREMENT zldy "Z¸ndungsz‰hler f¸r Lastdynamik" UBYTE dez 1 100 0 255 FORMAT "%5.1" ECU_ADDRESS 0x3FC3CA /end MEASUREMENT
/begin MEASUREMENT zndy "Z¸ndungsz‰hler f¸r Drehzahldynamik" UBYTE dez 1 100 0 255 FORMAT "%5.1" ECU_ADDRESS 0x3FC3CB /end MEASUREMENT
/begin MEASUREMENT zzwdykr "Z¸ndungsz‰hler bei gesetztem Bit B_zwkra=1 w‰hrend der KR-Dynamik" UWORD dez 1 100 0 65535 FORMAT "%8.2" ECU_ADDRESS 0x3FC412 /end MEASUREMENT
/begin MEASUREMENT zzwdymd "Z¸ndungsz‰hler bei nicht gesetztem Bit B_zwkra=0 w‰hrend der KR-Dynamik" UWORD dez 1 100 0 65535 FORMAT "%8.2" ECU_ADDRESS 0x3FC414 /end MEASUREMENT
/begin FUNCTION IMDGEN "1.90      Berechnung des Generatorstromes und Generatormomentes"
 /begin DEF_CHARACTERISTIC ENGENTANS EN_MDGEN GENDIFAK0 GENDIFAK1 GENDIFAK2 GENDIFAK3 GENDIFAK4 GENDIFAK5 GENDIFAK6 GENDIFAK7 GENITYP GENMDOF GENRS0_0 GENRS0_1 GENRS0_2 GENRS0_3 GENRS0_4 GENRS0_5 GENRS0_6 GENRS0_7 GENSTFAK0 GENSTFAK1 GENSTFAK2 GENSTFAK3 GENSTFAK4 GENSTFAK5 GENSTFAK6 GENSTFAK7 GENTEMPAPP GENTEMPMAN GENTMOTDT GENTMOTOF0 GENTMOTOF1 GENTMOTOF2 GENTMOTOF3 GENTMOTOF4 GENTMOTOF5 GENTMOTOF6 GENTMOTOF7 GENTYP GENTYPFELD GENUEBSETZ0 GENUEBSETZ1 GENUEBSETZ2 GENUEBSETZ3 GENUEBSETZ4 GENUEBSETZ5 GENUEBSETZ6 GENUEBSETZ7 GENUMGTYP GENVFZGSW GEN_IG_OF IGBASIS IGBASISOFF IGNOTWERT KFGENWETA0 KFGENWETA1 KFGENWETA2 KFGENWETA3 KFGENWETA4 KFGENWETA5 KFGENWETA6 KFGENWETA7 KFIGENDF0 KFIGENDF1 KFIGENDF2 KFIGENDF3 KFIGENDF4 KFIGENDF5 KFIGENDF6 KFIGENDF7 KFIGENKA0 KFIGENKA1 KFIGENKA2 KFIGENKA3 KFIGENKA4 KFIGENKA5 KFIGENKA6 KFIGENKA7 KFIGENWA0 KFIGENWA1 KFIGENWA2 KFIGENWA3 KFIGENWA4 KFIGENWA5 KFIGENWA6 KFIGENWA7 KLFPDIODE0 KLFPDIODE1 KLFPDIODE2 KLFPDIODE3 KLFPDIODE4 KLFPDIODE5 KLFPDIODE6 KLFPDIODE7 KLGENEXP0 KLGENEXP1 KLGENEXP2 KLGENEXP3 KLGENEXP4 KLGENEXP5 KLGENEXP6 KLGENEXP7 KLGENTETA0 KLGENTETA1 KLGENTETA2 KLGENTETA3 KLGENTETA4 KLGENTETA5 KLGENTETA6 KLGENTETA7 KLIGENMESS KLRTH0FAK0 KLRTH0FAK1 KLRTH0FAK2 KLRTH0FAK3 KLRTH0FAK4 KLRTH0FAK5 KLRTH0FAK6 KLRTH0FAK7 KLRTHFAK0 KLRTHFAK1 KLRTHFAK2 KLRTHFAK3 KLRTHFAK4 KLRTHFAK5 KLRTHFAK6 KLRTHFAK7 KLRTHGEN0 KLRTHGEN1 KLRTHGEN2 KLRTHGEN3 KLRTHGEN4 KLRTHGEN5 KLRTHGEN6 KLRTHGEN7 KLTANSGEN0 KLTANSGEN1 KLTANSGEN2 KLTANSGEN3 KLTANSGEN4 KLTANSGEN5 KLTANSGEN6 KLTANSGEN7 MANAWNUMM PRELLGTMOT S_IGMISCH TIGMISCH TSTCNTEN TSTFIL_IN TSTFIL_INI UDIODERMS0 UDIODERMS1 UDIODERMS2 UDIODERMS3 UDIODERMS4 UDIODERMS5 UDIODERMS6 UDIODERMS7 ZMGENIG ZMGENS0HZ0 ZMGENS0HZ1 ZMGENS0HZ2 ZMGENS0HZ3 ZMGENS0HZ4 ZMGENS0HZ5 ZMGENS0HZ6 ZMGENS0HZ7 ZMGENS0KL0 ZMGENS0KL1 ZMGENS0KL2 ZMGENS0KL3 ZMGENS0KL4 ZMGENS0KL5 ZMGENS0KL6 ZMGENS0KL7 ZMGENSTHZ0 ZMGENSTHZ1 ZMGENSTHZ2 ZMGENSTHZ3 ZMGENSTHZ4 ZMGENSTHZ5 ZMGENSTHZ6 ZMGENSTHZ7 ZMGENSTKL0 ZMGENSTKL1 ZMGENSTKL2 ZMGENSTKL3 ZMGENSTKL4 ZMGENSTKL5 ZMGENSTKL6 ZMGENSTKL7 ZMGENTWA ZMGN0TANS0 ZMGN0TANS1 ZMGN0TANS2 ZMGN0TANS3 ZMGN0TANS4 ZMGN0TANS5 ZMGN0TANS6 ZMGN0TANS7 ZMGNTANS0 ZMGNTANS1 ZMGNTANS2 ZMGNTANS3 ZMGNTANS4 ZMGNTANS5 ZMGNTANS6 ZMGNTANS7 ZMIGMISCH ZMTESTFIL /end DEF_CHARACTERISTIC
 /begin REF_CHARACTERISTIC MDNORM S_RDGENTYP /end REF_CHARACTERISTIC
 /begin IN_MEASUREMENT B_genactiv B_genoff B_gfbsupak B_gfelak B_gfmeak B_gfnobsak B_pwf B_stend dffgen genmanufak gentypkenn igenmess i_slp nmot_w st_craweng tabst_w tans tmot tumg ugen vfzg /end IN_MEASUREMENT
 /begin OUT_MEASUREMENT B_firstemp B_gene B_generken B_genfkupl B_heizen dib_ig fdib_ig genawnumm gendts genfeta genig genikaltun geninafil genitemp genivorfil geni_end gennummer genrs genspv gensttemp gentans gentansend gentemp gentempab gentempdt gentempend gentempexp gentempfil gen_teta gen_weta ibasis igen400A igm igvor mdgenloc_w mdgenrel_w mdgenvf_w md_gennm ngen_w nmots pgenab st_i_gen tstcountv tstfil_out /end OUT_MEASUREMENT
 /begin LOC_MEASUREMENT genalfak2 gendi_spv gendtsvor gendts_s1 geni2_st geni_difk geni_stfk genspv_1 genspv_2 MDNORMTMP tstlocini ugen_tmp /end LOC_MEASUREMENT
/end FUNCTION
/begin FUNCTION IMDGEN2 "3.10"
 /begin DEF_CHARACTERISTIC ENGENTANS2 EN_MDGEN2 GENDIFAK02 GENDIFAK12 GENDIFAK22 GENITYP2 GENMDOF2 GENRS0_02 GENRS0_12 GENRS0_22 GENSTFAK02 GENSTFAK12 GENSTFAK22 GENTEMPAP2 GENTEMPMA2 GENTMOTDT2 GENTMOTO02 GENTMOTO12 GENTMOTO22 GENTYP2 GENTYPFEL2 GENUEBSET02 GENUEBSET12 GENUEBSET22 GENUMGTYP2 GENVFZGSW2 GEN_IG_OF2 IGBASIS2 IGBASISOF2 KFGENWET02 KFGENWET12 KFGENWET22 KFIGENDF02 KFIGENDF12 KFIGENDF22 KFIGENKA02 KFIGENKA12 KFIGENKA22 KFIGENWA02 KFIGENWA12 KFIGENWA22 KLFPDIOD02 KLFPDIOD12 KLFPDIOD22 KLGENEXP02 KLGENEXP12 KLGENEXP22 KLGENTET02 KLGENTET12 KLGENTET22 KLIGENMES2 KLRTH0FA02 KLRTH0FA12 KLRTH0FA22 KLRTHFAK02 KLRTHFAK12 KLRTHFAK22 KLRTHGEN02 KLRTHGEN12 KLRTHGEN22 KLTANSGE02 KLTANSGE12 KLTANSGE22 MANAWNUMM2 PRELLGTMO2 S_IGMISCH2 TIGMISCH2 TSTCNTEN2 TSTFIL_II2 TSTFIL_IN2 UDIODERM02 UDIODERM12 UDIODERM22 ZMGENIG2 ZMGENS0H02 ZMGENS0H12 ZMGENS0H22 ZMGENS0K0 ZMGENS0K1 ZMGENS0K2 ZMGENSTH02 ZMGENSTH12 ZMGENSTH22 ZMGENSTK02 ZMGENSTK12 ZMGENSTK22 ZMGENTWA2 ZMGN0TAN02 ZMGN0TAN12 ZMGN0TAN22 ZMGNTANS02 ZMGNTANS12 ZMGNTANS22 ZMIGMISCH2 ZMTESTFIL2 /end DEF_CHARACTERISTIC
 /begin REF_CHARACTERISTIC MDNORM S_RDGENTYP /end REF_CHARACTERISTIC
 /begin IN_MEASUREMENT B_genacti2 B_genoff2 B_gfbsupa2 B_gfelak2 B_gfmeak2 B_gfnobsa2 B_pwf B_stend dffgen2 genmanufa2 gentypken2 igenmess i_slp nmot_w st_craweng tabst_w tans tmot tumg ugen2 vfzg /end IN_MEASUREMENT
 /begin OUT_MEASUREMENT B_firstemp2 B_gene2 B_generke2 B_genfkup2 B_heizen2 dib_ig2 fdib_ig2 genawnumm2 gendts2 genfeta2 genig2 genikaltu2 geninafil2 genitemp_2 genivorfi2 geni_end2 gennummer2 genrs2 genspv2 gensttemp2 gentans2 gentansen2 gentemp2 gentempab2 gentempdt2 gentempen2 gentempex2 gentempfi2 gen_teta2 gen_weta2 ibasis2 igen400A2 igm2 igvor2 mdgenloc_2 mdgenrel_2 mdgenvf_2w md_gennm2 ngen_w2 nmots2 pgenab2 st_i_gen2 tstcountv2 tstfil_ou2 /end OUT_MEASUREMENT
 /begin LOC_MEASUREMENT genalfak22 gendi_spv2 gendtsvor2 gendts_s12 geni2_st2 geni_difk2 geni_stfk2 genspv_12 genspv_22 MDNORMTMP2 tstlocini2 ugen_tmp2 /end LOC_MEASUREMENT
/end FUNCTION
/begin FUNCTION IMMOFF "1.40      Immediate Off; Systemsteuerung SG-Abschaltverhalten" /begin DEF_CHARACTERISTIC CWRQNVRB NVRBUPMAX TABPM TFNVRBUP /end DEF_CHARACTERISTIC
 /begin IN_MEASUREMENT B_nachlauf B_nlEEPR B_nloff B_nmot B_norm B_nvrbuprq B_rqnvrbup B_wakeup nmot_w tabkl50pm /end IN_MEASUREMENT
 /begin OUT_MEASUREMENT B_enimmoff B_fnvrbup B_immoff B_pwmloff B_rqfnvrbu B_rqpdn nvrbupctr tfnvr_ctr /end OUT_MEASUREMENT
/end FUNCTION
/begin FUNCTION INDEX_BGELSV "" /end FUNCTION
/begin FUNCTION INDEX_BGRBS "" /end FUNCTION
/begin FUNCTION INDEX_BGTABST "" /end FUNCTION
/begin FUNCTION INDEX_DAKRE "" /end FUNCTION
/begin FUNCTION INDEX_DANSKLE "" /end FUNCTION
/begin FUNCTION INDEX_DCACC "" /end FUNCTION
/begin FUNCTION INDEX_DCAFS "" /end FUNCTION
/begin FUNCTION INDEX_DCANA "" /end FUNCTION
/begin FUNCTION INDEX_DCANB "" /end FUNCTION
/begin FUNCTION INDEX_DCANBOT "" /end FUNCTION
/begin FUNCTION INDEX_DCARS "" /end FUNCTION
/begin FUNCTION INDEX_DCCAS "" /end FUNCTION
/begin FUNCTION INDEX_DCDSC "" /end FUNCTION
/begin FUNCTION INDEX_DCEGS "" /end FUNCTION
/begin FUNCTION INDEX_DCFCEO "" /end FUNCTION
/begin FUNCTION INDEX_DCINS "" /end FUNCTION
/begin FUNCTION INDEX_DCOD "" /end FUNCTION
/begin FUNCTION INDEX_DCSSG "" /end FUNCTION
/begin FUNCTION INDEX_DCSZL "" /end FUNCTION
/begin FUNCTION INDEX_DDG "" /end FUNCTION
/begin FUNCTION INDEX_DDISA "" /end FUNCTION
/begin FUNCTION INDEX_DDMMVE "" /end FUNCTION
/begin FUNCTION INDEX_DDMPME "" /end FUNCTION
/begin FUNCTION INDEX_DDPMEE "" /end FUNCTION
/begin FUNCTION INDEX_DDVE "" /end FUNCTION
/begin FUNCTION INDEX_DDYLSU "" /end FUNCTION
/begin FUNCTION INDEX_DEKPE "" /end FUNCTION
/begin FUNCTION INDEX_DELSE "" /end FUNCTION
/begin FUNCTION INDEX_DEVE "" /end FUNCTION
/begin FUNCTION INDEX_DFPDMTL "" /end FUNCTION
/begin FUNCTION INDEX_DFPM "" /end FUNCTION
/begin FUNCTION INDEX_DFPMPMDIAG "DFPMPMDIAG." /end FUNCTION
/begin FUNCTION INDEX_DFSTT "" /end FUNCTION
/begin FUNCTION INDEX_DGLFE "" /end FUNCTION
/begin FUNCTION INDEX_DHDMTE "" /end FUNCTION
/begin FUNCTION INDEX_DHELSU "" /end FUNCTION
/begin FUNCTION INDEX_DHFM "" /end FUNCTION
/begin FUNCTION INDEX_DHLSHK "" /end FUNCTION
/begin FUNCTION INDEX_DHRLSU "" /end FUNCTION
/begin FUNCTION INDEX_DHRLSUE "" /end FUNCTION
/begin FUNCTION INDEX_DICLSU "" /end FUNCTION
/begin FUNCTION INDEX_DKATSP "" /end FUNCTION
/begin FUNCTION INDEX_DKFTE "" /end FUNCTION
/begin FUNCTION INDEX_DKOSE "" /end FUNCTION
/begin FUNCTION INDEX_DKRNT "" /end FUNCTION
/begin FUNCTION INDEX_DKRS "" /end FUNCTION
/begin FUNCTION INDEX_DKRTP "" /end FUNCTION
/begin FUNCTION INDEX_DKUPPL "" /end FUNCTION
/begin FUNCTION INDEX_DKVS "" /end FUNCTION
/begin FUNCTION INDEX_DLLR "" /end FUNCTION
/begin FUNCTION INDEX_DLOCVVT "" /end FUNCTION
/begin FUNCTION INDEX_DLSAHK "" /end FUNCTION
/begin FUNCTION INDEX_DLSH "" /end FUNCTION
/begin FUNCTION INDEX_DLSVV "" /end FUNCTION
/begin FUNCTION INDEX_DMDMIL "DMDMIL." /end FUNCTION
/begin FUNCTION INDEX_DMLSE "" /end FUNCTION
/begin FUNCTION INDEX_DNVRBUP "" /end FUNCTION
/begin FUNCTION INDEX_DNWSAUS "DNWSAUS.exported" /end FUNCTION
/begin FUNCTION INDEX_DNWSEAUS "" /end FUNCTION
/begin FUNCTION INDEX_DNWSEEIN "" /end FUNCTION
/begin FUNCTION INDEX_DNWSEIN "DNWSEIN.exported" /end FUNCTION
/begin FUNCTION INDEX_DODSNL "" /end FUNCTION
/begin FUNCTION INDEX_DPH "" /end FUNCTION
/begin FUNCTION INDEX_DPLLSU "" /end FUNCTION
/begin FUNCTION INDEX_DSLPE "" /end FUNCTION
/begin FUNCTION INDEX_DSLSLRS "" /end FUNCTION
/begin FUNCTION INDEX_DSTA "" /end FUNCTION
/begin FUNCTION INDEX_DSTS "" /end FUNCTION
/begin FUNCTION INDEX_DSUE "" /end FUNCTION
/begin FUNCTION INDEX_DTEVE "" /end FUNCTION
/begin FUNCTION INDEX_DTEVN "" /end FUNCTION
/begin FUNCTION INDEX_DTHS "DTHS." /end FUNCTION
/begin FUNCTION INDEX_DUF "" /end FUNCTION
/begin FUNCTION INDEX_DULSU "" /end FUNCTION
/begin FUNCTION INDEX_DUR "" /end FUNCTION
/begin FUNCTION INDEX_DVAT "" /end FUNCTION
/begin FUNCTION INDEX_DVFZ "" /end FUNCTION
/begin FUNCTION INDEX_DVVT "DVVT." /end FUNCTION
/begin FUNCTION INDEX_DVVTE "" /end FUNCTION
/begin FUNCTION INDEX_DZKU "" /end FUNCTION
/begin FUNCTION INDEX_EGFE "" /end FUNCTION
/begin FUNCTION INDEX_EWS3 "" /end FUNCTION
/begin FUNCTION INDEX_FSPVDGEN "FSPVDGEN.exported" /end FUNCTION
/begin FUNCTION INDEX_FSPVDGEN2 "FSPVDGEN2.exported" /end FUNCTION
/begin FUNCTION INDEX_FSPVDIBS "FSPVDIBS.exported" /end FUNCTION
/begin FUNCTION INDEX_FSPVDQLT "" /end FUNCTION
/begin FUNCTION INDEX_GGDDSS "" /end FUNCTION
/begin FUNCTION INDEX_GGDSAS "" /end FUNCTION
/begin FUNCTION INDEX_GGEGAS "" /end FUNCTION
/begin FUNCTION INDEX_GGMFL "" /end FUNCTION
/begin FUNCTION INDEX_GGPED "" /end FUNCTION
/begin FUNCTION INDEX_GGTFA "" /end FUNCTION
/begin FUNCTION INDEX_GGTFM "" /end FUNCTION
/begin FUNCTION INDEX_GGTFUMG "" /end FUNCTION
/begin FUNCTION INDEX_GGTKA "" /end FUNCTION
/begin FUNCTION INDEX_GGUB "" /end FUNCTION
/begin FUNCTION INDEX_MDKOG "" /end FUNCTION
/begin FUNCTION INDEX_MINHUB "" /end FUNCTION
/begin FUNCTION INDEX_MTOEL "" /end FUNCTION
/begin FUNCTION INDEX_NVRMON "" /end FUNCTION
/begin FUNCTION INDEX_SWADP "" /end FUNCTION
/begin FUNCTION IPFDMTL "1.70"
 /begin DEF_CHARACTERISTIC DIPRFO DIPRFOCFC DITEDTD DITEDTK DPSF DUBTES DUBTESEO FIPTUBF GIPTESS T2GIPTES TDDPSF TG2IPTESF TGIPTES TGIPTESF TWKL15IP TWTEDTA TWTEMV ZIPTESB ZIPTESN ZIPTKTKN ZUPTESB ZUPTESN /end DEF_CHARACTERISTIC
 /begin REF_CHARACTERISTIC PRCFCEOSD /end REF_CHARACTERISTIC
 /begin IN_MEASUREMENT aktlauf_w B_admtll B_dmteol B_dmtglm B_dmtklm B_dmtlmv B_dmtlpm B_dmtlrst B_dmtrfm B_kl15 iptes_w ubsq_w /end IN_MEASUREMENT
 /begin OUT_MEASUREMENT B_diprfo B_dpsf B_dtetd B_dtetk B_dubtes B_giptess B_iptesen fiptes_w g2iptesf_w g2iptes_w giptesf_w giptes_w ipfdmtlAusBits ipfdmtlAusBitsNov ipteskfh_w ipteskfm_w ipteskf_w iptesk_w ndiprfo_w /end OUT_MEASUREMENT
 /begin LOC_MEASUREMENT B_iptesr ipfdmtlLokBits iprfmn_w iprfmx_w twtldtemv ubtesf_w ubtref_w /end LOC_MEASUREMENT
/end FUNCTION
/begin FUNCTION KBK2SERVI "" /begin REF_CHARACTERISTIC CODINDEX /end REF_CHARACTERISTIC /begin IN_MEASUREMENT AS_cantdi nmot /end IN_MEASUREMENT /end FUNCTION
/begin FUNCTION KFT "1.60      Kennfeld Thermostat"
 /begin DEF_CHARACTERISTIC DTMOTKFT KFTBERGI KFTKRI KFTKWS KFTLASTI KFTTANSI KLKFTBERG KLKFTLAST KLKFTTANS KLTKWI KLTKWP TKWBERGMAX TKWBERGMIN TKWI TKWKRMAX TKWKRMIN TKWLASTMAX TKWLASTMIN TKWPWMMN TKWPWMMX TKWSBERG TKWSGOT TKWSKR TKWSLAST TKWSMAX TKWSNTKW TKWSTANS TKWSUETEMP TKWTANSMAX TKWTANSMIN TMOTTKWMAX TMOTTKWMIN TUMGTKWBG TUMGTKWKR TUMGTKWRL TUMGTKWTA /end DEF_CHARACTERISTIC
 /begin IN_MEASUREMENT B_etret B_faetr B_got B_got2 B_kftkr B_nachl B_ntkw B_stend nmot rl rlsol_w tans tmot tumg vfzg /end IN_MEASUREMENT
 /begin OUT_MEASUREMENT B_kalt tkwpwm /end OUT_MEASUREMENT
 /begin LOC_MEASUREMENT B_tkwberg B_tkwkr B_tkwlast B_tkwtans B_tkwwarml integberg integkr integlast integtans tkwdiff tkwi tkwp tkwpi tkws tkwv /end LOC_MEASUREMENT
/end FUNCTION
/begin FUNCTION KHMD "9.20      Berechnung Reservemoment f¸r Katheizen"
 /begin DEF_CHARACTERISTIC CWHLS CWKHMD FMDKHFH FMDKHTMST KFKWTMP KFMDDSLA KFMDHLS KFMDKH KFMDKHLL KLWDMRKHZ TMOTHLS TUMGHLS ZKBKVAB ZKMDKH /end DEF_CHARACTERISTIC
 /begin IN_MEASUREMENT B_bkvleer B_fasla B_hls B_kh B_kw B_ll dmllri_w fcoschmn_w fho_w fmdkh mifa_w nmot_w tmot tmst tumg /end IN_MEASUREMENT
 /begin OUT_MEASUREMENT B_HLSKW dmrdsls_w dmrkh dmrkh_w /end OUT_MEASUREMENT
 /begin LOC_MEASUREMENT dmrkhzg_w dmrkhz_w drkwtmp_w fkbkvab fmkhfho_w fmkhtmst mifakh_w /end LOC_MEASUREMENT
/end FUNCTION
/begin FUNCTION KOS "153.20    Klimakompressor - Steuerung"
 /begin DEF_CHARACTERISTIC LIMTKOA MDKOAN MDKOEN SNM08KOUB TKOAMNN TKOAMXN TKOEMNN TMKOAO TMKOAU TNSTKO TVKOE VKOAO /end DEF_CHARACTERISTIC
 /begin IN_MEASUREMENT B_ac B_ko B_stend B_toelh1 B_vl mdko mifal_w nmot tmot vfzg /end IN_MEASUREMENT
 /begin OUT_MEASUREMENT B_acres B_koe B_nac kosAusByte1 /end OUT_MEASUREMENT
 /begin LOC_MEASUREMENT B_koena B_komnoff B_komnon B_komxoff B_kooff esst_snm08koub kosLokByte1 tkosamn tkosamx tkosemn /end LOC_MEASUREMENT
/end FUNCTION
/begin FUNCTION KRDY "34.40     Klopfregelung Dynamik"
 /begin DEF_CHARACTERISTIC AZKRLDYN AZKRNDYN CWZWDYN DYADMX DYAFVS DYAMNV DYAVF FKELDYA KFDYES KFDYESEH KFDYESEHOF KFDYESOF KFDYWVS NGKRWN NNGKRWN PZWKRA TMDYNA TZVER /end DEF_CHARACTERISTIC
 /begin REF_CHARACTERISTIC SEH06KRUW SNM08KRUW SWD06KRSW /end REF_CHARACTERISTIC
 /begin IN_MEASUREMENT B_clradkrd B_gdvhub B_gdvvtueb B_kl B_kr B_ll B_pwf B_sa B_tmkr B_zwdyn B_zwkraa devhubi_w dwdkba_w esst_seh06kruw esst_snm08kruw esst_swd06krsw evhubi_w kek krfkw ngas_w nmot nmot_w stkrnx tans tmot virkr wdkba_w zzylkr /end IN_MEASUREMENT
 /begin OUT_MEASUREMENT azkrldy azkrndy B_krldy B_krldya B_krldyf B_krndy B_krsadyn dyesehof_w dyesehv_w dyesofv_w dyesv_w wkrdy wkrdyvs zaldy zldy zndy zzwdykr zzwdymd /end OUT_MEASUREMENT
 /begin LOC_MEASUREMENT B_kldynrm B_kldystk B_krldyofok B_krldyok ngkrv_w nngkrv_w wkrdya /end LOC_MEASUREMENT
/end FUNCTION
/begin FUNCTION KRKE "15.40     Klopferkennung"
 /begin DEF_CHARACTERISTIC FKELDY FKENDY FKETM KE1NL KE2NL KE3NL KE4NL KE5NL KE6NL KE7NL KE8NL KEREFF KEREFLDY KEREFNDY KRKFKS KRVST KSZA REFINI RKREM1N RKREM2N RKRMX1N RKRMX2N ZYRKR /end DEF_CHARACTERISTIC
 /begin REF_CHARACTERISTIC SN16KR1UB SN16KR2UB SNM16KRUB SRL04KRUB /end REF_CHARACTERISTIC
 /begin IN_MEASUREMENT B_c95ks3 B_dnt B_dntb B_dtp B_dtpb B_kr B_krldy B_krndy B_st B_synph esst_sn16kr1ub esst_sn16kr2ub esst_snm16krub esst_srl04krub ikr ikrma ikrme nmot rl tmot tpnt_aktiv vske zzylkr /end IN_MEASUREMENT
 /begin OUT_MEASUREMENT B_c95_g0 B_c95_g1 B_c95_g2 B_kl fketm ikrn_w ke kek kek_tst kereffw kerefldyw kerefndyw kezkkl kezkklmx kezmxmit rkr rkrem1w rkrem2w rkrkor rkrmx1w rkrmx2w rkr_tst virkr vkr vkr_tst /end OUT_MEASUREMENT
/end FUNCTION
/begin FUNCTION KRRA "32.40     Klopfregelung mit Adaption der zylinderindividuellen Sp‰tverstellung"
 /begin DEF_CHARACTERISTIC CW_KRRA DWEKSN DWKRMSN KRAL1N KRAL2N KRALH KRAN1 KRAN2 KRAN3 KRAN4 KRANH KRDWA KRDWKLA KRDWSA KRDWSN KRFKN KRLMDY KRMXN KRMXNLL KRNMDY KRVFLN KRVFSLN LKRALL LKRN LKRNNL NFKRAS NKRF SENE1 SENE2 SENE3 SENE4 STKRLDY STKRNDY TMKR TMKRA VS100ZWKR WKRAM /end DEF_CHARACTERISTIC
 /begin REF_CHARACTERISTIC KSZA SENZZYL S_ZNDRLP /end REF_CHARACTERISTIC
 /begin IN_MEASUREMENT B_clradkr B_kl B_krdws B_krldy B_krldya B_krndy B_ll B_nmot B_pwf B_stend B_vl B_vvtnlf B_zwdyn evz_aus E_vvt_zw nmot rl rlp rlsolkrvf rlsolkrvft tmot tpnt_aktiv vszwkr zwkrafld zzylkr /end IN_MEASUREMENT
 /begin OUT_MEASUREMENT B_kr B_tmkr B_zwkraa dwkr dwkrz fwkram krfkw krvfakt lkrw lkrwnl stkrnx vszwm wkr wkra wkrasum_w wkratst wkrm wkrma wkr_tst /end OUT_MEASUREMENT
 /begin LOC_MEASUREMENT B_clwkram B_kra B_kras B_ksa B_ksb B_lkrall B_wkral B_zwkrum dweksw dwkrmsw index kral1w kral2w krdwsw krmxw krvfsw krvfw ksa ksb ksdefa ksdefb stkrlx wkrksa wkrksb wkrmdiv zkrvf /end LOC_MEASUREMENT
/end FUNCTION
/begin FUNCTION KTEEP "1.20      Komponententreiber EEPROM" /begin DEF_CHARACTERISTIC TEEMRDYMAX /end DEF_CHARACTERISTIC /begin IN_MEASUREMENT B_nlEEPR /end IN_MEASUREMENT /begin OUT_MEASUREMENT B_eemrdy B_eemsav teemrdy /end OUT_MEASUREMENT /end FUNCTION
/begin FUNCTION KTGGLSH "2.10" /begin DEF_CHARACTERISTIC TGGLS /end DEF_CHARACTERISTIC /begin IN_MEASUREMENT B_priph B_priph2 /end IN_MEASUREMENT /begin OUT_MEASUREMENT uushk2_w uushk_w valutggls /end OUT_MEASUREMENT /end FUNCTION
/begin FUNCTION KTM "1.30      Kraftstofftemperaturmodell"
 /begin DEF_CHARACTERISTIC CWKTM KFKTM KFKTM2 KFTMOKOR KFZKTMTKR MKRSTFAK TABKOR TKAKOR TKRSTINT ZKTMTKA ZKTMTMOT ZKTMVFZLU /end DEF_CHARACTERISTIC
 /begin IN_MEASUREMENT B_nmot B_pwf B_st B_stend nmot tabgmab tabst_w taml tans tka tmot tnse_w tumg vfzg vsskrst /end IN_MEASUREMENT
 /begin OUT_MEASUREMENT B_ktm_ini tkrst tkrstab /end OUT_MEASUREMENT
 /begin LOC_MEASUREMENT tkakor_in tkrstluft tkrststart tkrstvt tkrstwand tkrstzu tptmot_out /end LOC_MEASUREMENT
/end FUNCTION
/begin FUNCTION KTVFZG "2.10" /begin DEF_CHARACTERISTIC KWBAIMV /end DEF_CHARACTERISTIC /begin IN_MEASUREMENT vmaxidx /end IN_MEASUREMENT /begin OUT_MEASUREMENT vfzstate vfz_per_w vroh_w /end OUT_MEASUREMENT /end FUNCTION
/begin FUNCTION KT_ALSU ""
 /begin IN_MEASUREMENT B_bthsv B_bthsv2 B_hsvet B_hsvet2 tahrlsu2_w tahrlsu_w tphrlsu_w /end IN_MEASUREMENT
 /begin OUT_MEASUREMENT B_hsve B_hsve2 kttahrlsu2_w kttahrlsu_w kttphrlsu_w /end OUT_MEASUREMENT
/end FUNCTION
/begin FUNCTION KT_ANSKL "" /begin IN_MEASUREMENT B_anskl /end IN_MEASUREMENT /begin OUT_MEASUREMENT AS_anskl /end OUT_MEASUREMENT /end FUNCTION
/begin FUNCTION KT_CSWITCH "" /begin REF_CHARACTERISTIC CWCODCAN /end REF_CHARACTERISTIC /begin IN_MEASUREMENT B_autget B_ssgvar codcan codget /end IN_MEASUREMENT /end FUNCTION
/begin FUNCTION KT_DHRLSUE ""
 /begin IN_MEASUREMENT B_hrlsaus B_lsuicif B_lsuicif2 B_lsuickf B_lsuickf2 B_nmot B_stend /end IN_MEASUREMENT
 /begin OUT_MEASUREMENT B_hsvemn B_hsvemn2 B_hsvemx B_hsvemx2 B_hsvesi B_hsvesi2 /end OUT_MEASUREMENT
 /begin LOC_MEASUREMENT B_mn2_hsvetmp B_mn_hsvetmp B_mx2_hsvetmp B_mx_hsvetmp B_si2_hsvetmp B_si_hsvetmp dhrlsue1_err dhrlsue2_err /end LOC_MEASUREMENT
/end FUNCTION
/begin COMPU_METHOD aimv_ul_b4p608e11 "" RAT_FUNC "%13.0" "-" COEFFS 0 0 460800000000 0 1 0 /end COMPU_METHOD
/begin COMPU_METHOD B_TRUE "boolsche Zust‰nde, positive Logik" TAB_VERB "%6.3" "" COMPU_TAB_REF B_TRUE /end COMPU_METHOD
/begin COMPU_VTAB B_TRUE "boolsche Zust‰nde, positive Logik" TAB_VERB 2 0 "----" 1 "TRUE" /end COMPU_VTAB
/begin COMPU_METHOD DEZ "1 : 1 Umrechnug (dez/hex)" RAT_FUNC "%6.2" "" COEFFS 0 1 0 0 0 1 /end COMPU_METHOD
/begin COMPU_METHOD dez "1 : 1 Umrechnug (dez/hex)" RAT_FUNC "%6.2" "" COEFFS 0 1 0 0 0 1 /end COMPU_METHOD
/begin COMPU_METHOD dezsub1 "" RAT_FUNC "%6.2" "-" COEFFS 0 1 -1 0 0 1 /end COMPU_METHOD
/begin COMPU_METHOD fak_q0p0039 "" RAT_FUNC "%6.4" "-" COEFFS 0 256 0 0 0 1 /end COMPU_METHOD
/begin COMPU_METHOD fak_q0p1 "" RAT_FUNC "%6.3" "-" COEFFS 0 1 0 0 0 0.1 /end COMPU_METHOD
/begin COMPU_METHOD fak_ub_b1 "" RAT_FUNC "%6.4" "-" COEFFS 0 256 0 0 0 1 /end COMPU_METHOD
/begin COMPU_METHOD fak_ub_b2 "" RAT_FUNC "%6.4" "-" COEFFS 0 256 0 0 0 2 /end COMPU_METHOD
/begin COMPU_METHOD fak_ub_b4 "" RAT_FUNC "%6.4" "-" COEFFS 0 256 0 0 0 4 /end COMPU_METHOD
/begin COMPU_METHOD fak_uw_b1 "" RAT_FUNC "%7.6" "-" COEFFS 0 65536 0 0 0 1 /end COMPU_METHOD
/begin COMPU_METHOD fak_uw_b2 "" RAT_FUNC "%7.6" "-" COEFFS 0 65536 0 0 0 2 /end COMPU_METHOD
/begin COMPU_METHOD fak_uw_b256 "" RAT_FUNC "%6.4" "-" COEFFS 0 65536 0 0 0 256 /end COMPU_METHOD
/begin COMPU_METHOD fak_uw_b4 "" RAT_FUNC "%7.6" "-" COEFFS 0 65536 0 0 0 4 /end COMPU_METHOD
/begin COMPU_METHOD fak_uw_b512 "" RAT_FUNC "%6.4" "-" COEFFS 0 65536 0 0 0 512 /end COMPU_METHOD
/begin COMPU_METHOD fak_uw_b64 "" RAT_FUNC "%6.5" "-" COEFFS 0 65536 0 0 0 64 /end COMPU_METHOD
/begin COMPU_METHOD fuel_ub_q1 "" RAT_FUNC "%6.2" "l" COEFFS 0 1 0 0 0 1 /end COMPU_METHOD
/begin COMPU_METHOD genalfak_uw_q0p610Em7 "" RAT_FUNC "%7.6" "" COEFFS 0 65536 0 0 0 4 /end COMPU_METHOD
/begin COMPU_METHOD gendt_q0p075 "" RAT_FUNC "%6.3" "" COEFFS 0 1 0 0 0 0.75 /end COMPU_METHOD
/begin COMPU_METHOD geneta_q0p03125 "" RAT_FUNC "%6.4" "" COEFFS 0 256 0 0 0 8 /end COMPU_METHOD
/begin COMPU_METHOD genexpab_ub_q0p0039 "" RAT_FUNC "%6.4" "" COEFFS 0 256 0 0 0 1 /end COMPU_METHOD
/begin COMPU_METHOD genpv_ul "" RAT_FUNC "%7.6" "" COEFFS 0 4294970000 0 0 0 262144 /end COMPU_METHOD
/begin COMPU_METHOD genpv_uw_q0p03125 "" RAT_FUNC "%6.4" "" COEFFS 0 65536 0 0 0 2048 /end COMPU_METHOD
/begin COMPU_METHOD genrstator "" RAT_FUNC "%7.6" "" COEFFS 0 65536 0 0 0 1 /end COMPU_METHOD
/begin COMPU_METHOD genuebsetzung2 "" RAT_FUNC "%6.4" "" COEFFS 0 256 0 0 0 4 /end COMPU_METHOD
/begin COMPU_METHOD genzmig_uw_q0p305em7 "" RAT_FUNC "%7.6" "" COEFFS 0 65536 0 0 0 2 /end COMPU_METHOD
/begin COMPU_METHOD genzmst_uw_q0p152em7 "" RAT_FUNC "%7.6" "" COEFFS 0 65536 0 0 0 1 /end COMPU_METHOD
/begin COMPU_METHOD hub_uw_q0p001 "" RAT_FUNC "%6.5" "mm" COEFFS 0 1000 0 0 0 1 /end COMPU_METHOD
/begin COMPU_METHOD igen_ub_q1 "" RAT_FUNC "%6.2" "" COEFFS 0 1 0 0 0 1 /end COMPU_METHOD
/begin COMPU_METHOD igen_uw_q0p03125 "" RAT_FUNC "%6.4" "" COEFFS 0 65536 0 0 0 2048 /end COMPU_METHOD
/begin COMPU_METHOD i_q6p1035_uA "" RAT_FUNC "%6.4" "mA" COEFFS 0 65536 0 0 0 400 /end COMPU_METHOD
/begin COMPU_METHOD md_ub_q0p025 "" RAT_FUNC "%6.3" "Nm" COEFFS 0 1024 0 0 0 256 /end COMPU_METHOD
/begin COMPU_METHOD md_ub_q16 "" RAT_FUNC "%6.1" "Nm" COEFFS 0 1 0 0 0 16 /end COMPU_METHOD
/begin COMPU_METHOD ngen_uw_q0p5 "" RAT_FUNC "%6.3" "" COEFFS 0 1 0 0 0 0.5 /end COMPU_METHOD
/begin COMPU_METHOD nmotg_nuw_q0p39 "" RAT_FUNC "%7.0" "(1/min)/s" COEFFS 0 1 12800.16384 0 0 0.39063 /end COMPU_METHOD
/begin COMPU_METHOD nmotg_sw_q0p39 "" RAT_FUNC "%6.3" "1/min/s" COEFFS 0 1 0 0 0 0.39063 /end COMPU_METHOD
/begin COMPU_METHOD nmot_ub_q40 "" RAT_FUNC "%6.1" "1/min" COEFFS 0 1 0 0 0 40 /end COMPU_METHOD
/begin COMPU_METHOD nmot_uw_q0p25 "" RAT_FUNC "%6.3" "1/min" COEFFS 0 1 0 0 0 0.25 /end COMPU_METHOD
/begin COMPU_METHOD nwu_q1 "" RAT_FUNC "%6.2" "" COEFFS 0 1 0 0 0 1 /end COMPU_METHOD
/begin COMPU_METHOD relDK_q0p02441 "" RAT_FUNC "%6.4" "%DK" COEFFS 0 65536 0 0 0 1600 /end COMPU_METHOD
/begin COMPU_METHOD rel_ub_b100 "" RAT_FUNC "%6.3" "%" COEFFS 0 256 0 0 0 100 /end COMPU_METHOD
/begin COMPU_METHOD rel_ub_b99p6 "" RAT_FUNC "%6.3" "%" COEFFS 0 256 0 0 0 100 /end COMPU_METHOD
/begin COMPU_METHOD rel_ub_q0p75 "" RAT_FUNC "%6.3" "%" COEFFS 0 1 0 0 0 0.75 /end COMPU_METHOD
/begin COMPU_METHOD rel_uw_b100 "" RAT_FUNC "%6.4" "%" COEFFS 0 65536 0 0 0 100 /end COMPU_METHOD
/begin COMPU_METHOD rel_uw_q0p0234 "" RAT_FUNC "%6.4" "%" COEFFS 0 32 0 0 0 0.75 /end COMPU_METHOD
/begin COMPU_METHOD spg_q0p00039 "" RAT_FUNC "%6.5" "V" COEFFS 0 1 0 0 0 0.000390625 /end COMPU_METHOD
/begin COMPU_METHOD spg_ub_b320 "" RAT_FUNC "%7.3" "V" COEFFS 0 1 0 0 0 1.25 /end COMPU_METHOD
/begin COMPU_METHOD spg_ub_b5 "" RAT_FUNC "%6.4" "V" COEFFS 0 256 0 0 0 5 /end COMPU_METHOD
/begin COMPU_METHOD spg_ugen "" RAT_FUNC "%6.2" "V" COEFFS 0 10 -106 0 0 1 /end COMPU_METHOD
/begin COMPU_METHOD spg_uw_b1280 "" RAT_FUNC "%6.4" "V" COEFFS 0 1000 0 0 0 19.5313 /end COMPU_METHOD
/begin COMPU_METHOD spg_uw_q0p00488 "" RAT_FUNC "%6.4" "V" COEFFS 0 1024 0 0 0 5 /end COMPU_METHOD
/begin COMPU_METHOD t100msxs_ub_b25p5 "" RAT_FUNC "%6.3" "s" COEFFS 0 1 0 0 0 0.1 /end COMPU_METHOD
/begin COMPU_METHOD t100msxs_uw_b6553p5 "" RAT_FUNC "%6.3" "s" COEFFS 0 1 0 0 0 0.1 /end COMPU_METHOD
/begin COMPU_METHOD t10msxs_ub_b2p55 "" RAT_FUNC "%6.4" "s" COEFFS 0 1 0 0 0 0.01 /end COMPU_METHOD
/begin COMPU_METHOD t1msxms_q1 "" RAT_FUNC "%6.2" "ms" COEFFS 0 1 0 0 0 1 /end COMPU_METHOD
/begin COMPU_METHOD t1sxs_q1 "" RAT_FUNC "%6.2" "s" COEFFS 0 1 0 0 0 1 /end COMPU_METHOD
/begin COMPU_METHOD t1sxs_ub_b255 "" RAT_FUNC "%6.2" "s" COEFFS 0 1 0 0 0 1 /end COMPU_METHOD
/begin COMPU_METHOD t1sxs_ub_q1 "" RAT_FUNC "%6.2" "s" COEFFS 0 1 0 0 0 1 /end COMPU_METHOD
/begin COMPU_METHOD t1sxs_uw_q1 "" RAT_FUNC "%6.2" "s" COEFFS 0 1 0 0 0 1 /end COMPU_METHOD
/begin COMPU_METHOD t1usxms_q0p001 "" RAT_FUNC "%6.5" "ms" COEFFS 0 1 0 0 0 0.001 /end COMPU_METHOD
/begin COMPU_METHOD t200msxs_ub_b51 "" RAT_FUNC "%6.3" "s" COEFFS 0 1 0 0 0 0.2 /end COMPU_METHOD
/begin COMPU_METHOD temp_sb_q0p75 "" RAT_FUNC "%6.3" "Grad C" COEFFS 0 1 0 0 0 0.75 /end COMPU_METHOD
/begin COMPU_METHOD temp_sb_q1p5 "" RAT_FUNC "%6.2" "Grad C" COEFFS 0 1 0 0 0 1.5 /end COMPU_METHOD
/begin COMPU_METHOD temp_sw_q0p75 "" RAT_FUNC "%6.3" "Grad C" COEFFS 0 4 0 0 0 3 /end COMPU_METHOD
/begin COMPU_METHOD temp_ub_q0p75_o48 "" RAT_FUNC "%6.2" "Grad C" COEFFS 0 1 48 0 0 0.75 /end COMPU_METHOD
/begin COMPU_METHOD temp_ub_q5_o50 "" RAT_FUNC "%6.2" "Grad C" COEFFS 0 1 50 0 0 5 /end COMPU_METHOD
/begin COMPU_METHOD temp_uw_q0p75_o48 "" RAT_FUNC "%6.2" "Grad C" COEFFS 0 1 48 0 0 0.75 /end COMPU_METHOD
/begin COMPU_METHOD t_q0p001 "" RAT_FUNC "%6.5" "s" COEFFS 0 1000 0 0 0 1 /end COMPU_METHOD
/begin COMPU_METHOD t_q0p1 "" RAT_FUNC "%6.3" "s" COEFFS 0 10 0 0 0 1 /end COMPU_METHOD
/begin COMPU_METHOD t_q0p2 "" RAT_FUNC "%6.3" "s" COEFFS 0 10 0 0 0 2 /end COMPU_METHOD
/begin COMPU_METHOD vfzg_ub_q1p25 "" RAT_FUNC "%6.2" "km/h" COEFFS 0 1 0 0 0 1.25 /end COMPU_METHOD
/begin COMPU_METHOD vfzg_uw_b512 "" RAT_FUNC "%6.4" "km/h" COEFFS 0 65536 0 0 0 512 /end COMPU_METHOD
/begin COMPU_METHOD vnstv_q0p01 "" RAT_FUNC "%7.5" "%" COEFFS 0 100 0 0 0 1 /end COMPU_METHOD
/begin COMPU_METHOD zk100msxs_ub_b25p5 "" RAT_FUNC "%6.3" "s" COEFFS 0 0 256 0 10 0 /end COMPU_METHOD
/begin COMPU_METHOD zk100msxs_uw_b6553 "" RAT_FUNC "%6.1" "s" COEFFS 0 0 65536 0 10 0 /end COMPU_METHOD
/begin COMPU_METHOD zk10msxs_uw_b655 "" RAT_FUNC "%6.2" "s" COEFFS 0 0 65536 0 100 0 /end COMPU_METHOD
/begin COMPU_METHOD zw_sb_q0p75 "" RAT_FUNC "%6.3" "Grad KW" COEFFS 0 255 0 0 0 191.25 /end COMPU_METHOD
/begin COMPU_METHOD zw_sb_qn0p75 "" RAT_FUNC "%6.4" "Grad KW" COEFFS 0 1 0 0 0 -0.75 /end COMPU_METHOD
/begin COMPU_METHOD zw_ub_q0p75 "" RAT_FUNC "%6.3" "Grad KW" COEFFS 0 255 0 0 0 191.25 /end COMPU_METHOD
/begin COMPU_METHOD zw_ub_qn0p75 "" RAT_FUNC "%6.4" "Grad KW" COEFFS 0 1 0 0 0 -0.75 /end COMPU_METHOD
/begin COMPU_METHOD default "" RAT_FUNC "%6.2" "" COEFFS 0 1 0 0 0 1 /end COMPU_METHOD
/begin RECORD_LAYOUT GkfWS16 FNC_VALUES 1 SWORD COLUMN_DIR DIRECT /end RECORD_LAYOUT
/begin RECORD_LAYOUT GkfWU8 FNC_VALUES 1 UBYTE COLUMN_DIR DIRECT /end RECORD_LAYOUT
/begin RECORD_LAYOUT GklWU8 FNC_VALUES 1 UBYTE COLUMN_DIR DIRECT /end RECORD_LAYOUT
/begin RECORD_LAYOUT KfAxU8AyU8SstxU16SstyU16WU16 NO_AXIS_PTS_X 1 UWORD NO_AXIS_PTS_Y 2 UWORD AXIS_PTS_X 3 UWORD INDEX_INCR DIRECT AXIS_PTS_Y 4 UWORD INDEX_INCR DIRECT FNC_VALUES 5 UWORD COLUMN_DIR DIRECT /end RECORD_LAYOUT
/begin RECORD_LAYOUT KfAxU8AyU8SstxU8SstyU16WU8 NO_AXIS_PTS_X 1 UBYTE NO_AXIS_PTS_Y 2 UBYTE AXIS_PTS_X 3 UBYTE INDEX_INCR DIRECT AXIS_PTS_Y 4 UWORD INDEX_INCR DIRECT FNC_VALUES 5 UBYTE COLUMN_DIR DIRECT /end RECORD_LAYOUT
/begin RECORD_LAYOUT KfAxU8AyU8SstxU8SstyU8WU8 NO_AXIS_PTS_X 1 UBYTE NO_AXIS_PTS_Y 2 UBYTE AXIS_PTS_X 3 UBYTE INDEX_INCR DIRECT AXIS_PTS_Y 4 UBYTE INDEX_INCR DIRECT FNC_VALUES 5 UBYTE COLUMN_DIR DIRECT /end RECORD_LAYOUT
/begin RECORD_LAYOUT KfAxUbAyUbSstxUbSstyUbWUb NO_AXIS_PTS_X 1 UBYTE NO_AXIS_PTS_Y 2 UBYTE AXIS_PTS_X 3 UBYTE INDEX_INCR DIRECT AXIS_PTS_Y 4 UBYTE INDEX_INCR DIRECT FNC_VALUES 5 UBYTE COLUMN_DIR DIRECT /end RECORD_LAYOUT
/begin RECORD_LAYOUT KfAxUwAyUwSstxUwSstyUwWUw NO_AXIS_PTS_X 1 UWORD NO_AXIS_PTS_Y 2 UWORD AXIS_PTS_X 3 UWORD INDEX_INCR DIRECT AXIS_PTS_Y 4 UWORD INDEX_INCR DIRECT FNC_VALUES 5 UWORD COLUMN_DIR DIRECT /end RECORD_LAYOUT
/begin RECORD_LAYOUT KlAUbSstUbWUb NO_AXIS_PTS_X 1 UBYTE AXIS_PTS_X 2 UBYTE INDEX_INCR DIRECT FNC_VALUES 3 UBYTE COLUMN_DIR DIRECT /end RECORD_LAYOUT
/begin RECORD_LAYOUT KlAUbSstUwWUw NO_AXIS_PTS_X 1 UWORD AXIS_PTS_X 2 UWORD INDEX_INCR DIRECT FNC_VALUES 3 UWORD COLUMN_DIR DIRECT /end RECORD_LAYOUT
/begin RECORD_LAYOUT KlAUwSstUwWUw NO_AXIS_PTS_X 1 UWORD AXIS_PTS_X 2 UWORD INDEX_INCR DIRECT FNC_VALUES 3 UWORD COLUMN_DIR DIRECT /end RECORD_LAYOUT
/begin RECORD_LAYOUT KlAxU8SstxS16WS16 NO_AXIS_PTS_X 1 SWORD AXIS_PTS_X 2 SWORD INDEX_INCR DIRECT FNC_VALUES 3 SWORD COLUMN_DIR DIRECT /end RECORD_LAYOUT
/begin RECORD_LAYOUT KlAxU8SstxU16WU16 NO_AXIS_PTS_X 1 UWORD AXIS_PTS_X 2 UWORD INDEX_INCR DIRECT FNC_VALUES 3 UWORD COLUMN_DIR DIRECT /end RECORD_LAYOUT
/begin RECORD_LAYOUT KlAxU8SstxU8WU8 NO_AXIS_PTS_X 1 UBYTE AXIS_PTS_X 2 UBYTE INDEX_INCR DIRECT FNC_VALUES 3 UBYTE COLUMN_DIR DIRECT /end RECORD_LAYOUT
/begin RECORD_LAYOUT KwbWS8 FNC_VALUES 1 SBYTE COLUMN_DIR DIRECT /end RECORD_LAYOUT
/begin RECORD_LAYOUT KwbWU32 FNC_VALUES 1 ULONG COLUMN_DIR DIRECT /end RECORD_LAYOUT
/begin RECORD_LAYOUT KwbWU8 FNC_VALUES 1 UBYTE COLUMN_DIR DIRECT /end RECORD_LAYOUT
/begin RECORD_LAYOUT KwSb FNC_VALUES 1 SBYTE COLUMN_DIR DIRECT /end RECORD_LAYOUT
/begin RECORD_LAYOUT KwUb FNC_VALUES 1 UBYTE COLUMN_DIR DIRECT /end RECORD_LAYOUT
/begin RECORD_LAYOUT KwWS16 FNC_VALUES 1 SWORD COLUMN_DIR DIRECT /end RECORD_LAYOUT
/begin RECORD_LAYOUT KwWU16 FNC_VALUES 1 UWORD COLUMN_DIR DIRECT /end RECORD_LAYOUT
/begin RECORD_LAYOUT KwWU8 FNC_VALUES 1 UBYTE COLUMN_DIR DIRECT /end RECORD_LAYOUT
/begin RECORD_LAYOUT SstASwSstSw NO_AXIS_PTS_X 1 SWORD AXIS_PTS_X 2 SWORD INDEX_INCR DIRECT /end RECORD_LAYOUT
/begin RECORD_LAYOUT SstAU8SstU16 NO_AXIS_PTS_X 1 UWORD AXIS_PTS_X 2 UWORD INDEX_INCR DIRECT /end RECORD_LAYOUT
/begin RECORD_LAYOUT SstAU8SstU8 NO_AXIS_PTS_X 1 UBYTE AXIS_PTS_X 2 UBYTE INDEX_INCR DIRECT /end RECORD_LAYOUT
/begin RECORD_LAYOUT SstAUbSstUb NO_AXIS_PTS_X 1 UBYTE AXIS_PTS_X 2 UBYTE INDEX_INCR DIRECT /end RECORD_LAYOUT
/begin RECORD_LAYOUT SstAUwSstUw NO_AXIS_PTS_X 1 UWORD AXIS_PTS_X 2 UWORD INDEX_INCR DIRECT /end RECORD_LAYOUT
/end MODULE
/end PROJECT
