ASAP2_VERSION 1 30
/begin PROJECT MSS65-ign "Generiert am 14.10.05 um 09:57:47"
/begin HEADER "" VERSION "R341" /end HEADER
/begin MODULE _MSS65-ign "Generiert am 14.10.05 um 09:57:47"
/begin MOD_COMMON "" BYTE_ORDER MSB_FIRST ALIGNMENT_BYTE 1 ALIGNMENT_WORD 2 ALIGNMENT_LONG 4 ALIGNMENT_FLOAT32_IEEE 4 ALIGNMENT_FLOAT64_IEEE 8 /end MOD_COMMON
/begin CHARACTERISTIC cfg.abgas "Konfigurationsparameter: ABGAS-Variante" VALUE 0x79ECD TKW_VV_VV_UB 100.0 FORMULA_0380 0.0 255.0 /end CHARACTERISTIC
/begin CHARACTERISTIC cfg.baureihe "Konfigurationsparameter: Fz Baureihe" VALUE 0x79ECA TKW_VV_VV_UB 100.0 FORMULA_0377 0.0 255.0 /end CHARACTERISTIC
/begin CHARACTERISTIC cfg.betriebsmode "Konfigurationsparameter: SG Typ" VALUE 0x79ED1 TKW_VV_VV_UB 100.0 FORMULA_0384 0.0 255.0 /end CHARACTERISTIC
/begin CHARACTERISTIC cfg.canmess "Konfigurationsparameter: CAN-Messtechnik" VALUE 0x79ED5 TKW_VV_VV_UB 100.0 FORMULA_0362 0.0 255.0 /end CHARACTERISTIC
/begin CHARACTERISTIC cfg.canstand "Konfigurationsparameter: CAN Stand" VALUE 0x79ED0 TKW_VV_VV_UB 100.0 FORMULA_0383 0.0 255.0 /end CHARACTERISTIC
/begin CHARACTERISTIC cfg.diagnose "Konfigurationsparameter: Diagnose" VALUE 0x79ECE TKW_VV_VV_UB 100.0 FORMULA_0381 0.0 255.0 /end CHARACTERISTIC
/begin CHARACTERISTIC cfg.dsc_typ "Konfigurationsparameter: DSC" VALUE 0x79ED4 TKW_VV_VV_UB 100.0 FORMULA_0386 0.0 255.0 /end CHARACTERISTIC
/begin CHARACTERISTIC cfg.getriebetyp "Konfigurationsparameter: Getriebetyp" VALUE 0x79ECB TKW_VV_VV_UB 100.0 FORMULA_0378 0.0 255.0 /end CHARACTERISTIC
/begin CHARACTERISTIC cfg.hil "Konfigurationsparameter: HIL-Betrieb" VALUE 0x79ED6 TKW_VV_VV_UB 100.0 FORMULA_0387 0.0 255.0 /end CHARACTERISTIC
/begin CHARACTERISTIC cfg.ipm "Konfigurationsparameter: IPM" VALUE 0x79ED7 TKW_VV_VV_UB 100.0 FORMULA_0362 0.0 255.0 /end CHARACTERISTIC
/begin CHARACTERISTIC cfg.la_variante "Konfigurationsparameter: LA-Variante" VALUE 0x79ECC TKW_VV_VV_UB 100.0 FORMULA_0379 0.0 255.0 /end CHARACTERISTIC
/begin CHARACTERISTIC cfg.motortyp "Konfigurationsparameter: Motortyp" VALUE 0x79EC8 TKW_VV_VV_UW 100.0 FORMULA_0376 0.0 65535.0 FORMAT "%5.2" /end CHARACTERISTIC
/begin CHARACTERISTIC cfg.peripherie "Konfigurationsparameter: Motorperipherie" VALUE 0x79ED3 TKW_VV_VV_UB 100.0 FORMULA_0037 0.0 255.0 /end CHARACTERISTIC
/begin CHARACTERISTIC cfg.sg_mode "Steuergeraete Mode" VALUE 0x79ED2 TKW_VV_VV_UB 100.0 FORMULA_0385 0.0 255.0 BIT_MASK 0xF /end CHARACTERISTIC
/begin CHARACTERISTIC cfg.status "Konfigurationsparameter: SG Status" VALUE 0x79ECF TKW_VV_VV_UB 100.0 FORMULA_0382 0.0 255.0 /end CHARACTERISTIC
/begin CHARACTERISTIC GKF_RF_KOR_KOE_A "Polynomkoeffizient fuer die Vanoskorrektur" MAP 0x78548 TGF_VV_VV_SF 3.402823466385289e+038 FORMULA_0044 -3.402823466385289e+038 3.402823466385289e+038 FORMAT "%5.2"
 /begin AXIS_DESCR COM_AXIS n_lw FORMULA_0006 12 0.0 10000.0 AXIS_PTS_REF AXIS_RF_KOR_N_LW12 MAX_GRAD 0.0 /end AXIS_DESCR
 /begin AXIS_DESCR COM_AXIS md_rf_pt FORMULA_0007 8 0.0 2.0 AXIS_PTS_REF AXIS_RF_KOR_MD_RF_PT_SOLL8 MAX_GRAD 0.0 /end AXIS_DESCR
/end CHARACTERISTIC
/begin CHARACTERISTIC GKF_RF_KOR_KOE_B "Polynomkoeffizient fuer die Vanoskorrektur" MAP 0x786C8 TGF_VV_VV_SF 3.402823466385289e+038 FORMULA_0044 -3.402823466385289e+038 3.402823466385289e+038 FORMAT "%5.2"
 /begin AXIS_DESCR COM_AXIS n_lw FORMULA_0006 12 0.0 10000.0 AXIS_PTS_REF AXIS_RF_KOR_N_LW12 MAX_GRAD 0.0 /end AXIS_DESCR
 /begin AXIS_DESCR COM_AXIS md_rf_pt FORMULA_0007 8 0.0 2.0 AXIS_PTS_REF AXIS_RF_KOR_MD_RF_PT_SOLL8 MAX_GRAD 0.0 /end AXIS_DESCR
/end CHARACTERISTIC
/begin CHARACTERISTIC GKF_RF_KOR_KOE_C "Polynomkoeffizient fuer die Vanoskorrektur" MAP 0x78848 TGF_VV_VV_SF 3.402823466385289e+038 FORMULA_0044 -3.402823466385289e+038 3.402823466385289e+038 FORMAT "%5.2"
 /begin AXIS_DESCR COM_AXIS n_lw FORMULA_0006 12 0.0 10000.0 AXIS_PTS_REF AXIS_RF_KOR_N_LW12 MAX_GRAD 0.0 /end AXIS_DESCR
 /begin AXIS_DESCR COM_AXIS md_rf_pt FORMULA_0007 8 0.0 2.0 AXIS_PTS_REF AXIS_RF_KOR_MD_RF_PT_SOLL8 MAX_GRAD 0.0 /end AXIS_DESCR
/end CHARACTERISTIC
/begin CHARACTERISTIC GKF_RF_KOR_KOE_D "Polynomkoeffizient fuer die Vanoskorrektur" MAP 0x789C8 TGF_VV_VV_SF 3.402823466385289e+038 FORMULA_0044 -3.402823466385289e+038 3.402823466385289e+038 FORMAT "%5.2"
 /begin AXIS_DESCR COM_AXIS n_lw FORMULA_0006 12 0.0 10000.0 AXIS_PTS_REF AXIS_RF_KOR_N_LW12 MAX_GRAD 0.0 /end AXIS_DESCR
 /begin AXIS_DESCR COM_AXIS md_rf_pt FORMULA_0007 8 0.0 2.0 AXIS_PTS_REF AXIS_RF_KOR_MD_RF_PT_SOLL8 MAX_GRAD 0.0 /end AXIS_DESCR
/end CHARACTERISTIC
/begin CHARACTERISTIC GKF_RF_KOR_KOE_E "Polynomkoeffizient fuer die Vanoskorrektur" MAP 0x78B48 TGF_VV_VV_SF 3.402823466385289e+038 FORMULA_0044 -3.402823466385289e+038 3.402823466385289e+038 FORMAT "%5.2"
 /begin AXIS_DESCR COM_AXIS n_lw FORMULA_0006 12 0.0 10000.0 AXIS_PTS_REF AXIS_RF_KOR_N_LW12 MAX_GRAD 0.0 /end AXIS_DESCR
 /begin AXIS_DESCR COM_AXIS md_rf_pt FORMULA_0007 8 0.0 2.0 AXIS_PTS_REF AXIS_RF_KOR_MD_RF_PT_SOLL8 MAX_GRAD 0.0 /end AXIS_DESCR
/end CHARACTERISTIC
/begin CHARACTERISTIC GKF_RF_KOR_KOE_F "Polynomkoeffizient fuer die Vanoskorrektur" MAP 0x78CC8 TGF_VV_VV_SF 3.402823466385289e+038 FORMULA_0044 -3.402823466385289e+038 3.402823466385289e+038 FORMAT "%5.2"
 /begin AXIS_DESCR COM_AXIS n_lw FORMULA_0006 12 0.0 10000.0 AXIS_PTS_REF AXIS_RF_KOR_N_LW12 MAX_GRAD 0.0 /end AXIS_DESCR
 /begin AXIS_DESCR COM_AXIS md_rf_pt FORMULA_0007 8 0.0 2.0 AXIS_PTS_REF AXIS_RF_KOR_MD_RF_PT_SOLL8 MAX_GRAD 0.0 /end AXIS_DESCR
/end CHARACTERISTIC
/begin CHARACTERISTIC GKF_RF_KOR_KOE_G "Polynomkoeffizient fuer die Vanoskorrektur" MAP 0x78E48 TGF_VV_VV_SF 3.402823466385289e+038 FORMULA_0044 -3.402823466385289e+038 3.402823466385289e+038 FORMAT "%5.2"
 /begin AXIS_DESCR COM_AXIS n_lw FORMULA_0006 12 0.0 10000.0 AXIS_PTS_REF AXIS_RF_KOR_N_LW12 MAX_GRAD 0.0 /end AXIS_DESCR
 /begin AXIS_DESCR COM_AXIS md_rf_pt FORMULA_0007 8 0.0 2.0 AXIS_PTS_REF AXIS_RF_KOR_MD_RF_PT_SOLL8 MAX_GRAD 0.0 /end AXIS_DESCR
/end CHARACTERISTIC
/begin CHARACTERISTIC GKF_RF_KOR_KOE_H "Polynomkoeffizient fuer die Vanoskorrektur" MAP 0x78FC8 TGF_VV_VV_SF 3.402823466385289e+038 FORMULA_0044 -3.402823466385289e+038 3.402823466385289e+038 FORMAT "%5.2"
 /begin AXIS_DESCR COM_AXIS n_lw FORMULA_0006 12 0.0 10000.0 AXIS_PTS_REF AXIS_RF_KOR_N_LW12 MAX_GRAD 0.0 /end AXIS_DESCR
 /begin AXIS_DESCR COM_AXIS md_rf_pt FORMULA_0007 8 0.0 2.0 AXIS_PTS_REF AXIS_RF_KOR_MD_RF_PT_SOLL8 MAX_GRAD 0.0 /end AXIS_DESCR
/end CHARACTERISTIC
/begin CHARACTERISTIC GKF_RF_KOR_KOE_I "Polynomkoeffizient fuer die Vanoskorrektur" MAP 0x79148 TGF_VV_VV_SF 3.402823466385289e+038 FORMULA_0044 -3.402823466385289e+038 3.402823466385289e+038 FORMAT "%5.2"
 /begin AXIS_DESCR COM_AXIS n_lw FORMULA_0006 12 0.0 10000.0 AXIS_PTS_REF AXIS_RF_KOR_N_LW12 MAX_GRAD 0.0 /end AXIS_DESCR
 /begin AXIS_DESCR COM_AXIS md_rf_pt FORMULA_0007 8 0.0 2.0 AXIS_PTS_REF AXIS_RF_KOR_MD_RF_PT_SOLL8 MAX_GRAD 0.0 /end AXIS_DESCR
/end CHARACTERISTIC
/begin CHARACTERISTIC K_J_AC "Traegheitsmoment AC" VALUE 0x73596 TKW_VV_VV_UW 100.0 FORMULA_0276 0.0 120.0 FORMAT "%5.2" /end CHARACTERISTIC
/begin CHARACTERISTIC K_J_FZG_DKG_1 "Traegheitsmoment Fzg - SMG" VALUE 0x735C0 TKW_VV_VV_UW 100.0 FORMULA_0276 0.0 120.0 FORMAT "%5.2" /end CHARACTERISTIC
/begin CHARACTERISTIC K_J_FZG_DKG_2 "Traegheitsmoment Fzg - SMG" VALUE 0x735C2 TKW_VV_VV_UW 100.0 FORMULA_0276 0.0 120.0 FORMAT "%5.2" /end CHARACTERISTIC
/begin CHARACTERISTIC K_J_FZG_DKG_3 "Traegheitsmoment Fzg - SMG" VALUE 0x735C4 TKW_VV_VV_UW 100.0 FORMULA_0276 0.0 120.0 FORMAT "%5.2" /end CHARACTERISTIC
/begin CHARACTERISTIC K_J_FZG_DKG_4 "Traegheitsmoment Fzg - SMG" VALUE 0x735C6 TKW_VV_VV_UW 100.0 FORMULA_0276 0.0 120.0 FORMAT "%5.2" /end CHARACTERISTIC
/begin CHARACTERISTIC K_J_FZG_DKG_5 "Traegheitsmoment Fzg - SMG" VALUE 0x735C8 TKW_VV_VV_UW 100.0 FORMULA_0276 0.0 120.0 FORMAT "%5.2" /end CHARACTERISTIC
/begin CHARACTERISTIC K_J_FZG_DKG_6 "Traegheitsmoment Fzg - SMG" VALUE 0x735CA TKW_VV_VV_UW 100.0 FORMULA_0276 0.0 120.0 FORMAT "%5.2" /end CHARACTERISTIC
/begin CHARACTERISTIC K_J_FZG_DKG_7 "Traegheitsmoment Fzg - SMG" VALUE 0x735CC TKW_VV_VV_UW 100.0 FORMULA_0276 0.0 120.0 FORMAT "%5.2" /end CHARACTERISTIC
/begin CHARACTERISTIC K_J_FZG_DKG_N "Traegheitsmoment Fzg - SMG" VALUE 0x735BE TKW_VV_VV_UW 100.0 FORMULA_0276 0.0 120.0 FORMAT "%5.2" /end CHARACTERISTIC
/begin CHARACTERISTIC K_J_FZG_DKG_R "Traegheitsmoment Fzg - SMG" VALUE 0x735BC TKW_VV_VV_UW 100.0 FORMULA_0276 0.0 120.0 FORMAT "%5.2" /end CHARACTERISTIC
/begin CHARACTERISTIC K_J_FZG_HSG_1 "Traegheitsmoment Fzg - SMG" VALUE 0x735AE TKW_VV_VV_UW 100.0 FORMULA_0276 0.0 120.0 FORMAT "%5.2" /end CHARACTERISTIC
/begin CHARACTERISTIC K_J_FZG_HSG_2 "Traegheitsmoment Fzg - SMG" VALUE 0x735B0 TKW_VV_VV_UW 100.0 FORMULA_0276 0.0 120.0 FORMAT "%5.2" /end CHARACTERISTIC
/begin CHARACTERISTIC K_J_FZG_HSG_3 "Traegheitsmoment Fzg - SMG" VALUE 0x735B2 TKW_VV_VV_UW 100.0 FORMULA_0276 0.0 120.0 FORMAT "%5.2" /end CHARACTERISTIC
/begin CHARACTERISTIC K_J_FZG_HSG_4 "Traegheitsmoment Fzg - SMG" VALUE 0x735B4 TKW_VV_VV_UW 100.0 FORMULA_0276 0.0 120.0 FORMAT "%5.2" /end CHARACTERISTIC
/begin CHARACTERISTIC K_J_FZG_HSG_5 "Traegheitsmoment Fzg - SMG" VALUE 0x735B6 TKW_VV_VV_UW 100.0 FORMULA_0276 0.0 120.0 FORMAT "%5.2" /end CHARACTERISTIC
/begin CHARACTERISTIC K_J_FZG_HSG_6 "Traegheitsmoment Fzg - SMG" VALUE 0x735B8 TKW_VV_VV_UW 100.0 FORMULA_0276 0.0 120.0 FORMAT "%5.2" /end CHARACTERISTIC
/begin CHARACTERISTIC K_J_FZG_HSG_7 "Traegheitsmoment Fzg - SMG" VALUE 0x735BA TKW_VV_VV_UW 100.0 FORMULA_0276 0.0 120.0 FORMAT "%5.2" /end CHARACTERISTIC
/begin CHARACTERISTIC K_J_FZG_HSG_N "Traegheitsmoment Fzg - SMG" VALUE 0x735AC TKW_VV_VV_UW 100.0 FORMULA_0276 0.0 120.0 FORMAT "%5.2" /end CHARACTERISTIC
/begin CHARACTERISTIC K_J_FZG_HSG_R "Traegheitsmoment Fzg - SMG" VALUE 0x735AA TKW_VV_VV_UW 100.0 FORMULA_0276 0.0 120.0 FORMAT "%5.2" /end CHARACTERISTIC
/begin CHARACTERISTIC K_J_FZG_SMG_1 "Traegheitsmoment Fzg - SMG" VALUE 0x7359C TKW_VV_VV_UW 100.0 FORMULA_0276 0.0 120.0 FORMAT "%5.2" /end CHARACTERISTIC
/begin CHARACTERISTIC K_J_FZG_SMG_2 "Traegheitsmoment Fzg - SMG" VALUE 0x7359E TKW_VV_VV_UW 100.0 FORMULA_0276 0.0 120.0 FORMAT "%5.2" /end CHARACTERISTIC
/begin CHARACTERISTIC K_J_FZG_SMG_3 "Traegheitsmoment Fzg - SMG" VALUE 0x735A0 TKW_VV_VV_UW 100.0 FORMULA_0276 0.0 120.0 FORMAT "%5.2" /end CHARACTERISTIC
/begin CHARACTERISTIC K_J_FZG_SMG_4 "Traegheitsmoment Fzg - SMG" VALUE 0x735A2 TKW_VV_VV_UW 100.0 FORMULA_0276 0.0 120.0 FORMAT "%5.2" /end CHARACTERISTIC
/begin CHARACTERISTIC K_J_FZG_SMG_5 "Traegheitsmoment Fzg - SMG" VALUE 0x735A4 TKW_VV_VV_UW 100.0 FORMULA_0276 0.0 120.0 FORMAT "%5.2" /end CHARACTERISTIC
/begin CHARACTERISTIC K_J_FZG_SMG_6 "Traegheitsmoment Fzg - SMG" VALUE 0x735A6 TKW_VV_VV_UW 100.0 FORMULA_0276 0.0 120.0 FORMAT "%5.2" /end CHARACTERISTIC
/begin CHARACTERISTIC K_J_FZG_SMG_7 "Traegheitsmoment Fzg - SMG" VALUE 0x735A8 TKW_VV_VV_UW 100.0 FORMULA_0276 0.0 120.0 FORMAT "%5.2" /end CHARACTERISTIC
/begin CHARACTERISTIC K_J_FZG_SMG_N "Traegheitsmoment Fzg - SMG" VALUE 0x7359A TKW_VV_VV_UW 100.0 FORMULA_0276 0.0 120.0 FORMAT "%5.2" /end CHARACTERISTIC
/begin CHARACTERISTIC K_J_FZG_SMG_R "Traegheitsmoment Fzg - SMG" VALUE 0x73598 TKW_VV_VV_UW 100.0 FORMULA_0276 0.0 120.0 FORMAT "%5.2" /end CHARACTERISTIC
/begin CHARACTERISTIC K_J_MOTOR "Traegheitsmoment Motor" VALUE 0x73594 TKW_VV_VV_UW 100.0 FORMULA_0276 1.000000047497451e-003 120.0 FORMAT "%5.2" /end CHARACTERISTIC
/begin CHARACTERISTIC K_RF_KOR_CFG "RF_KOR Config-Byte" VALUE 0x78510 TKW_VV_VV_UB 100.0 FORMULA_0884 0.0 255.0 /end CHARACTERISTIC
/begin CHARACTERISTIC K_RF_KOR_VAN_MAX "Maximaler Korrekturfaktor Vanos" VALUE 0x7850C TKW_VV_VV_UW 100.0 FORMULA_0073 0.0 4.0 FORMAT "%6.3" /end CHARACTERISTIC
/begin CHARACTERISTIC K_RF_KOR_VAN_MIN "Minimaler Korrekturfaktor Vanos" VALUE 0x7850E TKW_VV_VV_UW 100.0 FORMULA_0073 0.0 4.0 FORMAT "%6.3" /end CHARACTERISTIC
/begin CHARACTERISTIC K_RF_KOR_VAN_SPR_MAX_Auslass "Maximale Spreizung fuer die RF_KOR Begrenzung" VALUE 0x78514 TKW_VV_VV_SW 100.0 FORMULA_0102 50.0 160.0 FORMAT "%4.1" /end CHARACTERISTIC
/begin CHARACTERISTIC K_RF_KOR_VAN_SPR_MAX_Einlass "Maximale Spreizung fuer die RF_KOR Begrenzung" VALUE 0x78512 TKW_VV_VV_SW 100.0 FORMULA_0102 50.0 160.0 FORMAT "%4.1" /end CHARACTERISTIC
/begin CHARACTERISTIC K_RF_KOR_VAN_SPR_MIN_Auslass "Minimale Spreizung fuer die RF_KOR Begrenzung" VALUE 0x78518 TKW_VV_VV_SW 100.0 FORMULA_0102 50.0 160.0 FORMAT "%4.1" /end CHARACTERISTIC
/begin CHARACTERISTIC K_RF_KOR_VAN_SPR_MIN_Einlass "Minimale Spreizung fuer die RF_KOR Begrenzung" VALUE 0x78516 TKW_VV_VV_SW 100.0 FORMULA_0102 50.0 160.0 FORMAT "%4.1" /end CHARACTERISTIC
/begin CHARACTERISTIC K_SCHALTER_BLS_ENTPRELLUNG_E2 "Fehlerentprellschwelle fuer BLS E2" VALUE 0x7B4E2 TKW_VV_VV_UB 100.0 FORMULA_0003 0.0 255.0 /end CHARACTERISTIC
/begin CHARACTERISTIC K_SCHALTER_KS_M_AUF "Schwelle fuer kein Kraftschluss" VALUE 0x792C8 TKW_VV_VV_SW 100.0 FORMULA_0009 -100.0 1000.0 FORMAT "%4.1" /end CHARACTERISTIC
/begin CHARACTERISTIC K_SCHALTER_KS_M_ZU "Schwelle fuer Kraftschluss" VALUE 0x792CA TKW_VV_VV_SW 100.0 FORMULA_0009 -100.0 1000.0 FORMAT "%4.1" /end CHARACTERISTIC
/begin CHARACTERISTIC K_SERVO_KD "Stromregler D-Anteil" VALUE 0x792DE TKW_VV_VV_UW 100.0 FORMULA_0891 0.0 1310700.0 /end CHARACTERISTIC
/begin CHARACTERISTIC K_SERVO_KP "Stromregler P-Anteil" VALUE 0x792DC TKW_VV_VV_UW 100.0 FORMULA_0890 0.0 65535.0 /end CHARACTERISTIC
/begin CHARACTERISTIC K_SERVO_SCHALT "Kennlinien-Umschaltzeit" VALUE 0x792E0 TKW_VV_VV_UB 100.0 FORMULA_0892 10240.0 40.15679931640625 /end CHARACTERISTIC
/begin CHARACTERISTIC K_SERVO_STROM_DIAG_KS_UB "Min. Servo-Ventilstrom Kurzschluss nach UB" VALUE 0x792D0 TKW_VV_VV_UW 100.0 FORMULA_0886 0.0 910.469970703125 /end CHARACTERISTIC
/begin CHARACTERISTIC K_SERVO_STROM_DIAG_MAX_OFFSET "Neg. Kennlinienoffset f. max. Steigung" VALUE 0x792DA TKW_VV_VV_UW 100.0 FORMULA_0886 0.0 910.469970703125 /end CHARACTERISTIC
/begin CHARACTERISTIC K_SERVO_STROM_DIAG_MAX_TAST "Max. Steigung Kennlinie i=f(Tast*Ub)" VALUE 0x792D8 TKW_VV_VV_UB 100.0 FORMULA_0889 0.0 255.0 /end CHARACTERISTIC
/begin CHARACTERISTIC K_SERVO_STROM_DIAG_MIN_OFFSET "Neg. Kennlinienoffset f. min. Steigung" VALUE 0x792D6 TKW_VV_VV_UW 100.0 FORMULA_0886 0.0 910.469970703125 /end CHARACTERISTIC
/begin CHARACTERISTIC K_SERVO_STROM_DIAG_MIN_TAST "Min. Steigung Kennlinie i=f(Tast*Ub)" VALUE 0x792D4 TKW_VV_VV_UB 100.0 FORMULA_0889 0.0 255.0 /end CHARACTERISTIC
/begin CHARACTERISTIC K_SERVO_STROM_DIAG_OL "Max. Servo-Ventilstrom Openload" VALUE 0x792D2 TKW_VV_VV_UW 100.0 FORMULA_0886 0.0 910.469970703125 /end CHARACTERISTIC
/begin CHARACTERISTIC K_SERVO_STROM_ERSATZ "Ersatzwert Servo-Ventilstrom" VALUE 0x792CE TKW_VV_VV_UW 100.0 FORMULA_0886 0.0 910.469970703125 /end CHARACTERISTIC
/begin CHARACTERISTIC K_SERVO_STROM_SOLL_TAU "Filterkonstante Sollwert Strom Servotronic-Ventil" VALUE 0x792CC TKW_VV_VV_UB 100.0 FORMULA_0455 1.009999960660934e-002 2.559999942779541 /end CHARACTERISTIC
/begin CHARACTERISTIC K_SK_CFG "SK-Cfg" VALUE 0x79338 TKW_VV_VV_UB 100.0 FORMULA_0368 0.0 255.0 /end CHARACTERISTIC
/begin CHARACTERISTIC K_SK_CRC32 "CRC32-Aktivierung" VALUE 0x79346 TKW_VV_VV_UB 100.0 FORMULA_0370 0.0 255.0 /end CHARACTERISTIC
/begin CHARACTERISTIC K_SK_E2_KOMP_ERR_MAX "max. Fehler fuer Komplementvergleich" VALUE 0x79466 TKW_VV_VV_UB 100.0 FORMULA_0003 0.0 255.0 /end CHARACTERISTIC
/begin CHARACTERISTIC K_SK_EGAS_OFF "DK2 DK1 LLS2 LLS1" VAL_BLK 0x79358 TKW_VV_VV_UB 100.0 FORMULA_0003 0.0 255.0 NUMBER 16 /end CHARACTERISTIC
/begin CHARACTERISTIC K_SK_EGAS_OFF_TIME "Zeit bis Egasabschaltung" VALUE 0x79352 TKW_VV_VV_UW 100.0 FORMULA_0021 0.0 5.0 FORMAT "%5.2" /end CHARACTERISTIC
/begin CHARACTERISTIC K_SK_FGR_SPERRE "FGR-Sperre" VALUE 0x7934B TKW_VV_VV_UB 100.0 FORMULA_0003 0.0 255.0 /end CHARACTERISTIC
/begin CHARACTERISTIC K_SK_FM_EGAS_TEST "SK Egastestmaske" VALUE 0x7933B TKW_VV_VV_UB 100.0 FORMULA_0003 0.0 255.0 /end CHARACTERISTIC
/begin CHARACTERISTIC K_SK_FM_FAIL_ZYL_TEST "SK TI-Testmaske (1=Aus)" VALUE 0x7933E TKW_VV_VV_UW 100.0 FORMULA_0010 0.0 65535.0 /end CHARACTERISTIC
/begin CHARACTERISTIC K_SK_FM_GEMISCH_TEST "SK Gemischtestmaske" VALUE 0x7933A TKW_VV_VV_UB 100.0 FORMULA_0003 0.0 255.0 /end CHARACTERISTIC
/begin CHARACTERISTIC K_SK_FM_LAM_TEST "SK LAM-Testmaske" VALUE 0x79342 TKW_VV_VV_UB 100.0 FORMULA_0003 0.0 255.0 /end CHARACTERISTIC
/begin CHARACTERISTIC K_SK_FM_MD_TEST "SK Md-Testmaske" VALUE 0x79341 TKW_VV_VV_UB 100.0 FORMULA_0003 0.0 255.0 /end CHARACTERISTIC
/begin CHARACTERISTIC K_SK_FM_MVAC_TEST "SK MVAC-Testmaske" VALUE 0x79343 TKW_VV_VV_UB 100.0 FORMULA_0369 0.0 255.0 /end CHARACTERISTIC
/begin CHARACTERISTIC K_SK_FM_SMG_TEST "SK SMG-Testmaske" VALUE 0x79340 TKW_VV_VV_UB 100.0 FORMULA_0003 0.0 255.0 /end CHARACTERISTIC
/begin CHARACTERISTIC K_SK_FRA_SPERRE "FRA-Sperre" VALUE 0x79349 TKW_VV_VV_UB 100.0 FORMULA_0003 0.0 255.0 /end CHARACTERISTIC
/begin CHARACTERISTIC K_SK_KH_SPERRE "KH-Sperre" VALUE 0x7934A TKW_VV_VV_UB 100.0 FORMULA_0003 0.0 255.0 /end CHARACTERISTIC
/begin CHARACTERISTIC K_SK_LAM_EINGR "Gemisch Boff Zoff DK LLS" VAL_BLK 0x79438 TKW_VV_VV_UB 100.0 FORMULA_0372 0.0 255.0 NUMBER 32 /end CHARACTERISTIC
/begin CHARACTERISTIC K_SK_LAM_EINGR_TI "LA-Eingriff bei Teilfeuerung" VALUE 0x7934F TKW_VV_VV_UB 100.0 FORMULA_0371 0.0 255.0 /end CHARACTERISTIC
/begin CHARACTERISTIC K_SK_LLRA_SPERRE "LLRA-Sperre" VALUE 0x79348 TKW_VV_VV_UB 100.0 FORMULA_0003 0.0 255.0 /end CHARACTERISTIC
/begin CHARACTERISTIC K_SK_MAX_OS_ERR "erlaubte OS-Fehler bis zum Reset" VALUE 0x79344 TKW_VV_VV_UB 100.0 FORMULA_0003 0.0 255.0 /end CHARACTERISTIC
/begin CHARACTERISTIC K_SK_MAX_RESETS "max. Anzahl von Resets pro SG-Lauf" VALUE 0x79339 TKW_VV_VV_UB 100.0 FORMULA_0003 0.0 255.0 /end CHARACTERISTIC
/begin CHARACTERISTIC K_SK_MAX_RESETS_E2 "max. Anzahl von Resets pro SG-Lauf Ebene 2" VALUE 0x79467 TKW_VV_VV_UB 100.0 FORMULA_0003 0.0 255.0 /end CHARACTERISTIC
/begin CHARACTERISTIC K_SK_MD_BEGR_DK_OFFEN "Begrenzung bei offenen Klappen" VALUE 0x7934E TKW_VV_VV_UB 100.0 FORMULA_0003 0.0 255.0 /end CHARACTERISTIC
/begin CHARACTERISTIC K_SK_MD_BEGR_EGAS "WDK2 WDK1 DK2 DK1 LLS2 LLS1" VAL_BLK 0x79368 TKW_VV_VV_UB 100.0 FORMULA_0003 0.0 255.0 NUMBER 64 /end CHARACTERISTIC
/begin CHARACTERISTIC K_SK_MD_BEGR_GEMISCH "VAN KATS FPLAU LAVK PKS" VAL_BLK 0x79418 TKW_VV_VV_UB 100.0 FORMULA_0003 0.0 255.0 NUMBER 32 /end CHARACTERISTIC
/begin CHARACTERISTIC K_SK_MD_BEGR_MD "SollIst Mdmin EtaRf LLR" VAL_BLK 0x79408 TKW_VV_VV_UB 100.0 FORMULA_0003 0.0 255.0 NUMBER 16 /end CHARACTERISTIC
/begin CHARACTERISTIC K_SK_MD_BEGR_MVAC "ELUP MVAC" VAL_BLK 0x7945E TKW_VV_VV_UB 100.0 FORMULA_0003 0.0 255.0 NUMBER 4 /end CHARACTERISTIC
/begin CHARACTERISTIC K_SK_MD_BEGR_MVAC_SYS "Begrenzung bei MVAC-Systemfehler" VALUE 0x79356 TKW_VV_VV_UB 100.0 FORMULA_0003 0.0 255.0 /end CHARACTERISTIC
/begin CHARACTERISTIC K_SK_MD_BEGR_PWG "pwg_mode" VAL_BLK 0x79458 TKW_VV_VV_UB 100.0 FORMULA_0003 0.0 255.0 NUMBER 6 /end CHARACTERISTIC
/begin CHARACTERISTIC K_SK_MD_BEGR_RESET "Begrenzung ab dem 1.Reset" VALUE 0x79357 TKW_VV_VV_UB 100.0 FORMULA_0003 0.0 255.0 /end CHARACTERISTIC
/begin CHARACTERISTIC K_SK_MD_BEGR_SMG "CANErr CANSk STAT SABR" VAL_BLK 0x793F8 TKW_VV_VV_UB 100.0 FORMULA_0003 0.0 255.0 NUMBER 16 /end CHARACTERISTIC
/begin CHARACTERISTIC K_SK_MD_BEGR_TI "B2 B1 Z2 Z1" VAL_BLK 0x793A8 TKW_VV_VV_UB 100.0 FORMULA_0003 0.0 255.0 NUMBER 16 /end CHARACTERISTIC
/begin CHARACTERISTIC K_SK_MD_TI_EINGR "Freigabe Teilfeuern" VALUE 0x7934C TKW_VV_VV_UB 100.0 FORMULA_0003 0.0 255.0 /end CHARACTERISTIC
/begin CHARACTERISTIC K_SK_MD_VL_SPERRE "VL-Sperre" VALUE 0x7934D TKW_VV_VV_UB 100.0 FORMULA_0003 0.0 255.0 /end CHARACTERISTIC
/begin CHARACTERISTIC K_SK_MVAC_KH "ELUP MVAC" VAL_BLK 0x79462 TKW_VV_VV_UB 100.0 FORMULA_0373 0.0 255.0 NUMBER 4 /end CHARACTERISTIC
/begin CHARACTERISTIC K_SK_PKS_NOTLAUF "PKS-Aktivierung" VALUE 0x79347 TKW_VV_VV_UB 100.0 FORMULA_0003 0.0 255.0 /end CHARACTERISTIC
/begin CHARACTERISTIC K_SK_PROZ_ERR "Maske Prozessueberwachung" VALUE 0x79354 TKW_VV_VV_UW 100.0 FORMULA_0010 0.0 65535.0 /end CHARACTERISTIC
/begin CHARACTERISTIC K_SK_T_RESET_DELAY_OS "Resetdelay fuer Betriebssystem Fehler" VALUE 0x79350 TKW_VV_VV_UB 100.0 FORMULA_0306 0.0 2.0 /end CHARACTERISTIC
/begin CHARACTERISTIC K_SK_TASK_ERR "Maske Taskueberwachung" VALUE 0x79345 TKW_VV_VV_UB 100.0 FORMULA_0003 0.0 255.0 /end CHARACTERISTIC
/begin CHARACTERISTIC K_SK_TI_OFF_EGAS "TI2 TI1 DK2 DK1 LLS2 LLS1" VAL_BLK 0x793B8 TKW_VV_VV_UB 100.0 FORMULA_0003 0.0 255.0 NUMBER 64 /end CHARACTERISTIC
/begin CHARACTERISTIC K_SK_ZYL_OFF_MAX "Anzahl der abg. Zyl. pro Bank" VALUE 0x7933C TKW_VV_VV_UB 100.0 FORMULA_0003 0.0 255.0 /end CHARACTERISTIC
/begin CHARACTERISTIC K_SL_ZWD_TV_MAX "Maximal ausgegebenes Tv" VALUE 0x794F8 TKW_VV_VV_SW 100.0 FORMULA_0142 0.0 100.0 FORMAT "%4.1" /end CHARACTERISTIC
/begin CHARACTERISTIC K_SL_ZWD_TV_MIN "Minimal ausgegebenes Tv" VALUE 0x794F6 TKW_VV_VV_SW 100.0 FORMULA_0142 0.0 100.0 FORMAT "%4.1" /end CHARACTERISTIC
/begin CHARACTERISTIC K_SL_ZWD_TV_SLP_TEST "Testtastverhaeltniss wenn SLP" VALUE 0x794FA TKW_VV_VV_SW 100.0 FORMULA_0142 0.0 100.0 FORMAT "%4.1" /end CHARACTERISTIC
/begin CHARACTERISTIC K_SMG_ADAPT_IHAR_CNT "Counter IHAR-Adaption" VALUE 0x7962A TKW_VV_VV_UB 100.0 FORMULA_0037 0.0 255.0 /end CHARACTERISTIC
/begin CHARACTERISTIC K_SMG_ADAPT_IHAR_DFLT "Default IHAR-Uebersetzung" VALUE 0x79630 TKW_VV_VV_UW 100.0 FORMULA_0073 0.0 4.0 FORMAT "%6.3" /end CHARACTERISTIC
/begin CHARACTERISTIC K_SMG_ADAPT_IHAR_MAX "max. IHAR-Uebersetzung" VALUE 0x7962E TKW_VV_VV_UW 100.0 FORMULA_0073 0.0 4.0 FORMAT "%6.3" /end CHARACTERISTIC
/begin CHARACTERISTIC K_SMG_ADAPT_IHAR_MIN "min. IHAR-Uebersetzung" VALUE 0x7962C TKW_VV_VV_UW 100.0 FORMULA_0073 0.0 4.0 FORMAT "%6.3" /end CHARACTERISTIC
/begin CHARACTERISTIC K_SMG_ADAPT_SP_DM_MAX "zulaessige Abweichung fuer Kupplungsadaption" VALUE 0x795EA TKW_VV_VV_SW 100.0 FORMULA_0009 -100.0 1000.0 FORMAT "%4.1" /end CHARACTERISTIC
/begin CHARACTERISTIC K_SMG_ADAPT_SP_DMD_FW "Gradient-Sperre fuer Kupplungsadaption" VALUE 0x795E8 TKW_VV_VV_SW 100.0 FORMULA_0562 -5000.0 5000.0 /end CHARACTERISTIC
/begin CHARACTERISTIC K_SMG_ADAPT_SP_N_MAX "max. Drehzahl fuer Kupplungsadaption" VALUE 0x795EE TKW_VV_VV_SW 100.0 FORMULA_0006 0.0 10000.0 /end CHARACTERISTIC
/begin CHARACTERISTIC K_SMG_ADAPT_SP_N_MIN "min. Drehzahl fuer Kupplungsadaption" VALUE 0x795EC TKW_VV_VV_SW 100.0 FORMULA_0006 0.0 10000.0 /end CHARACTERISTIC
/begin CHARACTERISTIC K_SMG_ADAPT_SP_TOEL "Toel-Sperre fuer Kupplungsadaption" VALUE 0x795E6 TKW_VV_VV_SW 100.0 FORMULA_0023 -50.0 170.0 FORMAT "%4.1" /end CHARACTERISTIC
/begin CHARACTERISTIC K_SMG_ALIVE_ERR_MAX "max. Zeit für CAN-Alive" VALUE 0x79EBE TKW_VV_VV_UB 100.0 FORMULA_0003 0.0 255.0 /end CHARACTERISTIC
/begin CHARACTERISTIC K_SMG_BERG_MD_KW_SCHW "Md-Schwelle Bergerkennung" VALUE 0x795E4 TKW_VV_VV_SW 100.0 FORMULA_0009 -100.0 1000.0 FORMAT "%4.1" /end CHARACTERISTIC
/begin CHARACTERISTIC K_SMG_BERG_V_MAX_SCHW "max. v-Schwelle Bergerkennung" VALUE 0x795E2 TKW_VV_VV_SW 100.0 FORMULA_0076 -80.0 360.0 FORMAT "%4.1" /end CHARACTERISTIC
/begin CHARACTERISTIC K_SMG_BERG_V_MIN_SCHW "min. v-Schwelle Bergerkennung" VALUE 0x795E0 TKW_VV_VV_SW 100.0 FORMULA_0076 -80.0 360.0 FORMAT "%4.1" /end CHARACTERISTIC
/begin CHARACTERISTIC K_SMG_CAN_ED_TSPERR "max. Zeit für CAN-Chksum" VALUE 0x79EBA TKW_VV_VV_UW 100.0 FORMULA_0109 0.0 325.0 FORMAT "%5.2" /end CHARACTERISTIC
/begin CHARACTERISTIC K_SMG_CAN_ED_UB_MIN "min. Ub fuer CAN-Diagnose" VALUE 0x79EBC TKW_VV_VV_SW 100.0 FORMULA_0008 0.0 28.0 FORMAT "%4.1" /end CHARACTERISTIC
/begin CHARACTERISTIC K_SMG_CAN_KL87_TMAX "KL87-Timeout" VALUE 0x79EC2 TKW_VV_VV_UW 100.0 FORMULA_0071 0.0 6553.5 FORMAT "%4.1" /end CHARACTERISTIC
/begin CHARACTERISTIC K_SMG_CAN_TESTMODE "Vorgabe Testmode" VALUE 0x79EC1 TKW_VV_VV_UB 100.0 FORMULA_0955 0.0 255.0 /end CHARACTERISTIC
/begin CHARACTERISTIC K_SMG_CHKSUM_ERR_MAX "max. Zeit für CAN-Chksum" VALUE 0x79EBF TKW_VV_VV_UB 100.0 FORMULA_0003 0.0 255.0 /end CHARACTERISTIC
/begin CHARACTERISTIC K_SMG_E2_ST_ERR_MAX "max. Fehler fuer Statusvergleich" VALUE 0x7B4E4 TKW_VV_VV_UB 100.0 FORMULA_0003 0.0 12.0 /end CHARACTERISTIC
/begin CHARACTERISTIC K_SMG_I_GANG_1 "Gangübersetzung" VALUE 0x795F6 TKW_VV_VV_UW 100.0 FORMULA_0073 0.0 4.0 FORMAT "%6.3" /end CHARACTERISTIC
/begin CHARACTERISTIC K_SMG_I_GANG_2 "Gangübersetzung" VALUE 0x795F8 TKW_VV_VV_UW 100.0 FORMULA_0073 0.0 4.0 FORMAT "%6.3" /end CHARACTERISTIC
/begin CHARACTERISTIC K_SMG_I_GANG_3 "Gangübersetzung" VALUE 0x795FA TKW_VV_VV_UW 100.0 FORMULA_0073 0.0 4.0 FORMAT "%6.3" /end CHARACTERISTIC
/begin CHARACTERISTIC K_SMG_I_GANG_4 "Gangübersetzung" VALUE 0x795FC TKW_VV_VV_UW 100.0 FORMULA_0073 0.0 4.0 FORMAT "%6.3" /end CHARACTERISTIC
/begin CHARACTERISTIC K_SMG_I_GANG_5 "Gangübersetzung" VALUE 0x795FE TKW_VV_VV_UW 100.0 FORMULA_0073 0.0 4.0 FORMAT "%6.3" /end CHARACTERISTIC
/begin CHARACTERISTIC K_SMG_I_GANG_6 "Gangübersetzung" VALUE 0x79600 TKW_VV_VV_UW 100.0 FORMULA_0073 0.0 4.0 FORMAT "%6.3" /end CHARACTERISTIC
/begin CHARACTERISTIC K_SMG_I_GANG_7 "Gangübersetzung" VALUE 0x79602 TKW_VV_VV_UW 100.0 FORMULA_0073 0.0 4.0 FORMAT "%6.3" /end CHARACTERISTIC
/begin CHARACTERISTIC K_SMG_I_GANG_N "Gangübersetzung" VALUE 0x795F4 TKW_VV_VV_UW 100.0 FORMULA_0073 0.0 4.0 FORMAT "%6.3" /end CHARACTERISTIC
/begin CHARACTERISTIC K_SMG_I_GANG_R "Gangübersetzung" VALUE 0x795F2 TKW_VV_VV_UW 100.0 FORMULA_0073 0.0 4.0 FORMAT "%6.3" /end CHARACTERISTIC
/begin CHARACTERISTIC K_SMG_I_HA "Hinterachsuebersetzung" VALUE 0x79604 TKW_VV_VV_UW 100.0 FORMULA_0073 0.0 4.0 FORMAT "%6.3" /end CHARACTERISTIC
/begin CHARACTERISTIC K_SMG_KI_AKS_AY_MAX "AKS-Sperre bei hohen ay" VALUE 0x79528 TKW_VV_VV_SW 100.0 FORMULA_0123 -20.0 20.0 FORMAT "%5.2" /end CHARACTERISTIC
/begin CHARACTERISTIC K_SMG_KI_AKS_DAY_MAX "AKS-Sperre bei ay-Zunahme" VALUE 0x7952A TKW_VV_VV_SW 100.0 FORMULA_0123 -20.0 20.0 FORMAT "%5.2" /end CHARACTERISTIC
/begin CHARACTERISTIC K_SMG_KI_AUF_DSC "max. Aufregel-Index bei DSC passiv" VALUE 0x79521 TKW_VV_VV_UB 100.0 FORMULA_0003 0.0 12.0 /end CHARACTERISTIC
/begin CHARACTERISTIC K_SMG_KI_AUF_DSC2 "max. Aufregel-Index bei DSC-Sport" VALUE 0x79522 TKW_VV_VV_UB 100.0 FORMULA_0003 0.0 12.0 /end CHARACTERISTIC
/begin CHARACTERISTIC K_SMG_KI_AUF_EINGR "max. Aufregel-Index bei DSC-Eingriff" VALUE 0x79523 TKW_VV_VV_UB 100.0 FORMULA_0003 0.0 12.0 /end CHARACTERISTIC
/begin CHARACTERISTIC K_SMG_KI_AUF_T_EINGR "max. Zeit mit DSC-Eingriff" VALUE 0x79526 TKW_VV_VV_UW 100.0 FORMULA_0021 0.0 655.0 FORMAT "%5.2" /end CHARACTERISTIC
/begin CHARACTERISTIC K_SMG_KI_AUF_ZR "max. Aufregel-Index bei Zugrueck" VALUE 0x79524 TKW_VV_VV_UB 100.0 FORMULA_0003 0.0 12.0 /end CHARACTERISTIC
/begin CHARACTERISTIC K_SMG_KI_CFG "KI-Konfiguration" VALUE 0x7951F TKW_VV_VV_UB 100.0 FORMULA_0930 0.0 255.0 /end CHARACTERISTIC
/begin CHARACTERISTIC K_SMG_KI_DELTA_PWG "Neubestimmung der KIs" VALUE 0x7952E TKW_VV_VV_SW 100.0 FORMULA_0001 -10.0 120.0 FORMAT "%4.1" /end CHARACTERISTIC
/begin CHARACTERISTIC K_SMG_KI_NEU_AY_MAX "kein Aktualisieren der KI bei hohen ay" VALUE 0x7952C TKW_VV_VV_SW 100.0 FORMULA_0123 -20.0 20.0 FORMAT "%5.2" /end CHARACTERISTIC
/begin CHARACTERISTIC K_SMG_KI_SCHALT_DSC "max. Schalt-Index bei DSC aktiv" VALUE 0x79520 TKW_VV_VV_UB 100.0 FORMULA_0003 0.0 14.0 /end CHARACTERISTIC
/begin CHARACTERISTIC K_SMG_KSCHLUPF_AUF "Kupplungsschlupfschwelle beim Aufregeln" VALUE 0x7951C TKW_VV_VV_UB 100.0 FORMULA_0929 0.0 10.0 /end CHARACTERISTIC
/begin CHARACTERISTIC K_SMG_KSCHLUPF_DSC "Kupplungsschlupf bei DSC-Eingr" VALUE 0x7951D TKW_VV_VV_UB 100.0 FORMULA_0929 0.0 10.0 /end CHARACTERISTIC
/begin CHARACTERISTIC K_SMG_KSCHLUPF_N "n-Schwelle Kupplungsschlupf" VALUE 0x7951A TKW_VV_VV_SW 100.0 FORMULA_0006 0.0 10000.0 /end CHARACTERISTIC
/begin CHARACTERISTIC K_SMG_KSCHLUPF_T_SCHW "Zeitschwelle fuer Kupplungsschlupf" VALUE 0x7951E TKW_VV_VV_UB 100.0 FORMULA_0306 0.0 2.549999952316284 /end CHARACTERISTIC
/begin CHARACTERISTIC K_SMG_KUPP_AUF_SCHW_N "n-Schwelle fuer Aufregelschwingen" VALUE 0x79562 TKW_VV_VV_SW 100.0 FORMULA_0006 0.0 10000.0 /end CHARACTERISTIC
/begin CHARACTERISTIC K_SMG_KUPP_DM_ABS "Kupplungsgradient bei ABS-Eingr" VALUE 0x79545 TKW_VV_VV_UB 100.0 FORMULA_0806 0.0 5100.0 /end CHARACTERISTIC
/begin CHARACTERISTIC K_SMG_KUPP_DM_MIN "min. Kupplungsgradient" VALUE 0x79542 TKW_VV_VV_SW 100.0 FORMULA_0562 -5000.0 5000.0 /end CHARACTERISTIC
/begin CHARACTERISTIC K_SMG_KUPP_DM_RAB "Kupplungsgradient bei RAB" VALUE 0x79544 TKW_VV_VV_UB 100.0 FORMULA_0806 0.0 5100.0 /end CHARACTERISTIC
/begin CHARACTERISTIC K_SMG_KUPP_DM_SOLL_F "Faktor auf Kupplungsgradient" VALUE 0x79546 TKW_VV_VV_UB 100.0 FORMULA_0757 0.0 1.99210000038147 /end CHARACTERISTIC
/begin CHARACTERISTIC K_SMG_KUPP_M_MAX_1 "Max. Schubmoment im 1.Gang" VALUE 0x79548 TKW_VV_VV_SW 100.0 FORMULA_0009 -100.0 1000.0 FORMAT "%4.1" /end CHARACTERISTIC
/begin CHARACTERISTIC K_SMG_KUPP_M_MAX_2 "Max. Schubmoment im 2.Gang" VALUE 0x7954A TKW_VV_VV_SW 100.0 FORMULA_0009 -100.0 1000.0 FORMAT "%4.1" /end CHARACTERISTIC
/begin CHARACTERISTIC K_SMG_KUPP_N_KSCHUTZ "Ausloeseschwelle fuer Kupplungsschutz" VALUE 0x79554 TKW_VV_VV_SW 100.0 FORMULA_0006 0.0 10000.0 /end CHARACTERISTIC
/begin CHARACTERISTIC K_SMG_KUPP_RAMPE_DM "Steigung Kupplungsrampe" VALUE 0x79552 TKW_VV_VV_UB 100.0 FORMULA_0932 0.0 0.2549999952316284 /end CHARACTERISTIC
/begin CHARACTERISTIC K_SMG_KUPP_RAMPE_N "Ausloeseschwelle Rampe" VALUE 0x79550 TKW_VV_VV_SW 100.0 FORMULA_0006 0.0 10000.0 /end CHARACTERISTIC
/begin CHARACTERISTIC K_SMG_KUPP_RAMPE_N_ABW "Ausloeseschwelle Rampe - Abwuergen" VALUE 0x7954E TKW_VV_VV_SW 100.0 FORMULA_0006 0.0 10000.0 /end CHARACTERISTIC
/begin CHARACTERISTIC K_SMG_KUPP_RAMPE_UL "Kupplungsrampe bei UL" VALUE 0x7955E TKW_VV_VV_UW 100.0 FORMULA_0933 0.0 6553.5 /end CHARACTERISTIC
/begin CHARACTERISTIC K_SMG_KUPP_REG_T "Einschaltschwelle Regler" VALUE 0x7954C TKW_VV_VV_UW 100.0 FORMULA_0021 0.0 655.0 FORMAT "%5.2" /end CHARACTERISTIC
/begin CHARACTERISTIC K_SMG_KUPP_UL_FW_DM "Fahrerwunschrampe bei UL" VALUE 0x79560 TKW_VV_VV_UB 100.0 FORMULA_0774 0.0 2550.0 /end CHARACTERISTIC
/begin CHARACTERISTIC K_SMG_KUPP_UL_FW_MAX "max. FW-Reduktion bei UL" VALUE 0x7955C TKW_VV_VV_SW 100.0 FORMULA_0009 -100.0 1000.0 FORMAT "%4.1" /end CHARACTERISTIC
/begin CHARACTERISTIC K_SMG_KUPP_UL_FW_SCHW "min. Fahrerwunsch fuer Kupplungsschutz" VALUE 0x79556 TKW_VV_VV_SW 100.0 FORMULA_0009 -100.0 1000.0 FORMAT "%4.1" /end CHARACTERISTIC
/begin CHARACTERISTIC K_SMG_KUPP_UL_MD_SCHW "Offset auf Istmoment" VALUE 0x79558 TKW_VV_VV_SW 100.0 FORMULA_0009 -100.0 1000.0 FORMAT "%4.1" /end CHARACTERISTIC
/begin CHARACTERISTIC K_SMG_KUPP_UL_N_SCHW "Differenz Motor/Getriebe" VALUE 0x7955A TKW_VV_VV_SW 100.0 FORMULA_0006 0.0 10000.0 /end CHARACTERISTIC
/begin CHARACTERISTIC K_SMG_M_NULL "Moment-Nullschwelle" VALUE 0x79518 TKW_VV_VV_SW 100.0 FORMULA_0009 -100.0 1000.0 FORMAT "%4.1" /end CHARACTERISTIC
/begin CHARACTERISTIC K_SMG_MD_FW_HYS_SCH "Hysterese Schuberkennung" VALUE 0x7953C TKW_VV_VV_SW 100.0 FORMULA_0009 -100.0 1000.0 FORMAT "%4.1" /end CHARACTERISTIC
/begin CHARACTERISTIC K_SMG_MD_FW_HYS_ZUG "Hysterese Zugerkennung" VALUE 0x7953A TKW_VV_VV_SW 100.0 FORMULA_0009 -100.0 1000.0 FORMAT "%4.1" /end CHARACTERISTIC
/begin CHARACTERISTIC K_SMG_MD_FW_MIN_AB "min. Abregelmoment" VALUE 0x79536 TKW_VV_VV_SW 100.0 FORMULA_0009 -100.0 1000.0 FORMAT "%4.1" /end CHARACTERISTIC
/begin CHARACTERISTIC K_SMG_MD_FW_MIN_AUF "min. Aufregelmoment" VALUE 0x79538 TKW_VV_VV_SW 100.0 FORMULA_0009 -100.0 1000.0 FORMAT "%4.1" /end CHARACTERISTIC
/begin CHARACTERISTIC K_SMG_MOT_ABS_DM_MAX "Abbau max. Moment bei ABS-Eingriff" VALUE 0x795AA TKW_VV_VV_SW 100.0 FORMULA_0562 -5000.0 5000.0 /end CHARACTERISTIC
/begin CHARACTERISTIC K_SMG_MOT_ABS_M_MAX "max. Moment bei ABS-Eingriff" VALUE 0x795A8 TKW_VV_VV_SW 100.0 FORMULA_0009 -100.0 1000.0 FORMAT "%4.1" /end CHARACTERISTIC
/begin CHARACTERISTIC K_SMG_MOT_ABS_M_MIN "min. Moment bei ABS-Eingriff" VALUE 0x795A6 TKW_VV_VV_SW 100.0 FORMULA_0009 -100.0 1000.0 FORMAT "%4.1" /end CHARACTERISTIC
/begin CHARACTERISTIC K_SMG_MOT_ABS_N_OFF "Offset auf nGetr bei ABS-Eingriff" VALUE 0x795A4 TKW_VV_VV_SW 100.0 FORMULA_0006 -1000.0 10000.0 /end CHARACTERISTIC
/begin CHARACTERISTIC K_SMG_MOT_ABS_T_MAX "Maximalzeit fuer ABS-Eingriff" VALUE 0x795AC TKW_VV_VV_UW 100.0 FORMULA_0021 0.0 655.0 FORMAT "%5.2" /end CHARACTERISTIC
/begin CHARACTERISTIC K_SMG_MOT_AKS_N_SCHW "max. Differenz zu nBegr fuer AKS" VALUE 0x795DA TKW_VV_VV_SW 100.0 FORMULA_0006 0.0 10000.0 /end CHARACTERISTIC
/begin CHARACTERISTIC K_SMG_MOT_ANF_DM_DSC "Rampe bei DSC-Anfahrt" VALUE 0x795C8 TKW_VV_VV_SW 100.0 FORMULA_0562 -5000.0 5000.0 /end CHARACTERISTIC
/begin CHARACTERISTIC K_SMG_MOT_ANF_FW_X "Abregelfaktor Anfahrdrehzahl" VALUE 0x795C4 TKW_VV_VV_SW 100.0 FORMULA_0006 0.0 10000.0 /end CHARACTERISTIC
/begin CHARACTERISTIC K_SMG_MOT_ANF_M_MIN "Erkennung Anfahren aus Schalten" VALUE 0x795C6 TKW_VV_VV_SW 100.0 FORMULA_0009 -100.0 1000.0 FORMAT "%4.1" /end CHARACTERISTIC
/begin CHARACTERISTIC K_SMG_MOT_ANF_N_OFF "Drehzahloffset auf Anfahrdrehzahl" VALUE 0x795C2 TKW_VV_VV_SW 100.0 FORMULA_0006 0.0 10000.0 /end CHARACTERISTIC
/begin CHARACTERISTIC K_SMG_MOT_DN_GANG "DN-Wichtung ueber Gang" VAL_BLK 0x79594 TKW_VV_VV_UB 100.0 FORMULA_0757 0.0 1.99210000038147 NUMBER 3 /end CHARACTERISTIC
/begin CHARACTERISTIC K_SMG_MOT_DN_REG_I_N "I-Anteil Gradientenregler neg." VALUE 0x79598 TKW_VV_VV_UB 100.0 FORMULA_0934 0.0 2.549999952316284e-002 /end CHARACTERISTIC
/begin CHARACTERISTIC K_SMG_MOT_DN_REG_I_P "I-Anteil Gradientenregler pos." VALUE 0x79597 TKW_VV_VV_UB 100.0 FORMULA_0934 0.0 2.549999952316284e-002 /end CHARACTERISTIC
/begin CHARACTERISTIC K_SMG_MOT_DN_REG_I_S "I-Anteil Gradientenregler pos. Schub" VALUE 0x79599 TKW_VV_VV_UB 100.0 FORMULA_0934 0.0 2.549999952316284e-002 /end CHARACTERISTIC
/begin CHARACTERISTIC K_SMG_MOT_DN_REG_T "Einschaltschwelle dn-Regler" VALUE 0x7959A TKW_VV_VV_UW 100.0 FORMULA_0021 9.999999776482582e-003 655.0 FORMAT "%5.2" /end CHARACTERISTIC
/begin CHARACTERISTIC K_SMG_MOT_DN_SOLL_MIN "min. Drehzahlsollgradient" VALUE 0x79590 TKW_VV_VV_SW 100.0 FORMULA_0105 -10000.0 10000.0 /end CHARACTERISTIC
/begin CHARACTERISTIC K_SMG_MOT_DN_SOLL_VOR "Schwelle fuer DN-Umschaltung" VALUE 0x79592 TKW_VV_VV_SW 100.0 FORMULA_0006 0.0 10000.0 /end CHARACTERISTIC
/begin CHARACTERISTIC K_SMG_MOT_J_MOTOR_ZR "Faktor fuer Vorst 2 bei ZR" VALUE 0x79505 TKW_VV_VV_UB 100.0 FORMULA_0926 0.0 1.99210000038147 /end CHARACTERISTIC
/begin CHARACTERISTIC K_SMG_MOT_M_RES_ABW "Momentenreserve Abwuergen" VALUE 0x79588 TKW_VV_VV_SW 100.0 FORMULA_0009 -1.0 1000.0 FORMAT "%4.1" /end CHARACTERISTIC
/begin CHARACTERISTIC K_SMG_MOT_M_RES_AUF "Momentenreserve Aufregeln" VALUE 0x79584 TKW_VV_VV_SW 100.0 FORMULA_0009 -1.0 1000.0 FORMAT "%4.1" /end CHARACTERISTIC
/begin CHARACTERISTIC K_SMG_MOT_M_RES_EXT_MAX "Reserve inaktiv wg. ext. Reserve" VALUE 0x7957E TKW_VV_VV_SW 100.0 FORMULA_0009 -100.0 1000.0 FORMAT "%4.1" /end CHARACTERISTIC
/begin CHARACTERISTIC K_SMG_MOT_M_RES_MAX "max. Momentenreserve" VALUE 0x79580 TKW_VV_VV_SW 100.0 FORMULA_0009 0.0 1000.0 FORMAT "%4.1" /end CHARACTERISTIC
/begin CHARACTERISTIC K_SMG_MOT_M_RES_POS_MAX "Start Moment pos. Reserve" VALUE 0x795DC TKW_VV_VV_SW 100.0 FORMULA_0009 -100.0 1000.0 FORMAT "%4.1" /end CHARACTERISTIC
/begin CHARACTERISTIC K_SMG_MOT_M_RES_POS_N "Start Drehzahl pos. Reserve" VALUE 0x795DE TKW_VV_VV_SW 100.0 FORMULA_0006 0.0 10000.0 /end CHARACTERISTIC
/begin CHARACTERISTIC K_SMG_MOT_M_RES_RAMPE "Reserve-Rampe" VALUE 0x7958A TKW_VV_VV_SW 100.0 FORMULA_0562 -5000.0 5000.0 /end CHARACTERISTIC
/begin CHARACTERISTIC K_SMG_MOT_M_RES_RAMPE_KS "Reserve-Rampe bei Kupplungsschlupf" VALUE 0x7958C TKW_VV_VV_SW 100.0 FORMULA_0562 -5000.0 5000.0 /end CHARACTERISTIC
/begin CHARACTERISTIC K_SMG_MOT_M_RES_RS "Momentenreserve RS" VALUE 0x79586 TKW_VV_VV_SW 100.0 FORMULA_0009 -1.0 1000.0 FORMAT "%4.1" /end CHARACTERISTIC
/begin CHARACTERISTIC K_SMG_MOT_M_RES_SCHA "Momentenreserve Schalten" VALUE 0x79582 TKW_VV_VV_SW 100.0 FORMULA_0009 -1.0 1000.0 FORMAT "%4.1" /end CHARACTERISTIC
/begin CHARACTERISTIC K_SMG_MOT_M_RES_T_MAX "max. Zeit fuer Momentenreserve" VALUE 0x7958E TKW_VV_VV_UW 100.0 FORMULA_0109 0.0 325.0 FORMAT "%5.2" /end CHARACTERISTIC
/begin CHARACTERISTIC K_SMG_MOT_M_VOR_AUF "Vorausschau" VALUE 0x79572 TKW_VV_VV_UB 100.0 FORMULA_0306 0.0 2.549999952316284 /end CHARACTERISTIC
/begin CHARACTERISTIC K_SMG_MOT_N_REG_D_MAX "max. Regeldifferenz fuer D-Anteil" VALUE 0x795BA TKW_VV_VV_SW 100.0 FORMULA_0006 0.0 10000.0 /end CHARACTERISTIC
/begin CHARACTERISTIC K_SMG_MOT_N_REG_D_MIN "min. Regeldifferenz fuer D-Anteil" VALUE 0x795B8 TKW_VV_VV_SW 100.0 FORMULA_0006 0.0 10000.0 /end CHARACTERISTIC
/begin CHARACTERISTIC K_SMG_MOT_N_REG_I_DN "I-Anteil n-Regler Down" VALUE 0x795AF TKW_VV_VV_UB 100.0 FORMULA_0932 0.0 0.2549999952316284 /end CHARACTERISTIC
/begin CHARACTERISTIC K_SMG_MOT_N_REG_I_SCHW "max. Regeldifferenz-Schwelle fuer I-Anteil (n-Regler)" VALUE 0x795B0 TKW_VV_VV_SW 100.0 FORMULA_0006 0.0 10000.0 /end CHARACTERISTIC
/begin CHARACTERISTIC K_SMG_MOT_N_REG_I_T "Einschaltschwelle I-Anteil" VALUE 0x795B2 TKW_VV_VV_UW 100.0 FORMULA_0109 0.0 325.0 FORMAT "%5.2" /end CHARACTERISTIC
/begin CHARACTERISTIC K_SMG_MOT_N_REG_I_T_RAB "Einschaltschwelle I-Anteil bei RAB" VALUE 0x795B4 TKW_VV_VV_UW 100.0 FORMULA_0109 0.0 325.0 FORMAT "%5.2" /end CHARACTERISTIC
/begin CHARACTERISTIC K_SMG_MOT_N_REG_I_UP "I-Anteil n-Regler Up" VALUE 0x795AE TKW_VV_VV_UB 100.0 FORMULA_0932 0.0 0.2549999952316284 /end CHARACTERISTIC
/begin CHARACTERISTIC K_SMG_MOT_N_REG_M_BEGR "v-Schwelle fuer Begrenzung" VALUE 0x795C0 TKW_VV_VV_SW 100.0 FORMULA_0076 -80.0 360.0 FORMAT "%4.1" /end CHARACTERISTIC
/begin CHARACTERISTIC K_SMG_MOT_N_REG_M_MAX "max. Reglermoment im Aufregeln" VALUE 0x795BC TKW_VV_VV_SW 100.0 FORMULA_0009 -100.0 1000.0 FORMAT "%4.1" /end CHARACTERISTIC
/begin CHARACTERISTIC K_SMG_MOT_N_REG_M_STG "max. Moment fuer Stoerrgroessenaufschaltung" VALUE 0x795B6 TKW_VV_VV_SW 100.0 FORMULA_0009 -100.0 1000.0 FORMAT "%4.1" /end CHARACTERISTIC
/begin CHARACTERISTIC K_SMG_MOT_N_REG_T_MAX "Abregelzeit max. Reglermoment" VALUE 0x795BE TKW_VV_VV_UW 100.0 FORMULA_0109 4.999999888241291e-003 325.0 FORMAT "%5.2" /end CHARACTERISTIC
/begin CHARACTERISTIC K_SMG_MOT_NL_DELTA_FW "FW-Abbruchschwelle fuer Rampe" VALUE 0x79578 TKW_VV_VV_UB 100.0 FORMULA_0471 0.0 25.0 /end CHARACTERISTIC
/begin CHARACTERISTIC K_SMG_MOT_NL_ETA "Eta-Abbruchschwelle fuer Rampe" VALUE 0x7957A TKW_VV_VV_UW 100.0 FORMULA_0437 0.0 150.0 FORMAT "%4.1" /end CHARACTERISTIC
/begin CHARACTERISTIC K_SMG_MOT_NL_MD "Md-Abbruchschwelle fuer Rampe" VALUE 0x79579 TKW_VV_VV_UB 100.0 FORMULA_0749 0.0 25.0 /end CHARACTERISTIC
/begin CHARACTERISTIC K_SMG_MOT_NL_MD_MAX "max. Abw. FW TZ-Nachlauf" VALUE 0x79574 TKW_VV_VV_SW 100.0 FORMULA_0009 -100.0 1000.0 FORMAT "%4.1" /end CHARACTERISTIC
/begin CHARACTERISTIC K_SMG_MOT_NL_T_MAX "max. TZ-Nachlaufzeit" VALUE 0x79576 TKW_VV_VV_UW 100.0 FORMULA_0109 0.0 325.0 FORMAT "%5.2" /end CHARACTERISTIC
/begin CHARACTERISTIC K_SMG_MOT_NL_T_MAX_E2 "max. TZ-Nachlaufzeit Ebene 2" VALUE 0x7B4E6 TKW_VV_VV_UW 100.0 FORMULA_0109 0.0 325.0 FORMAT "%5.2" /end CHARACTERISTIC
/begin CHARACTERISTIC K_SMG_MOT_NL_TAU "Filter nach Rampenende" VALUE 0x7957C TKW_VV_VV_UB 100.0 FORMULA_0470 5.100000184029341e-003 1.279999971389771 /end CHARACTERISTIC
/begin CHARACTERISTIC K_SMG_MOT_RAB_DM_MAX "Abbau max. Moment bei Radabriss" VALUE 0x795A0 TKW_VV_VV_SW 100.0 FORMULA_0562 -5000.0 5000.0 /end CHARACTERISTIC
/begin CHARACTERISTIC K_SMG_MOT_RAB_M_MAX "max. Moment bei Radabriss" VALUE 0x7959E TKW_VV_VV_SW 100.0 FORMULA_0009 -100.0 1000.0 FORMAT "%4.1" /end CHARACTERISTIC
/begin CHARACTERISTIC K_SMG_MOT_RAB_M_MIN "min. Moment bei Radabriss" VALUE 0x7959C TKW_VV_VV_SW 100.0 FORMULA_0009 -100.0 1000.0 FORMAT "%4.1" /end CHARACTERISTIC
/begin CHARACTERISTIC K_SMG_MOT_RAB_T_MAX "Maximalzeit fuer Radabriss" VALUE 0x795A2 TKW_VV_VV_UW 100.0 FORMULA_0021 0.0 655.0 FORMAT "%5.2" /end CHARACTERISTIC
/begin CHARACTERISTIC K_SMG_MOT_RS_N_OFF "Offset auf RS-Anfahrdrehzahl" VALUE 0x795CE TKW_VV_VV_SW 100.0 FORMULA_0006 0.0 10000.0 /end CHARACTERISTIC
/begin CHARACTERISTIC K_SMG_MOT_RS_N_SCHW "n-Abbruchschwelle Rennstart" VALUE 0x795CA TKW_VV_VV_SW 100.0 FORMULA_0006 0.0 10000.0 /end CHARACTERISTIC
/begin CHARACTERISTIC K_SMG_MOT_RS_S_SCHW "Schlupf-Abbruchsschwelle Rennstart" VALUE 0x795CC TKW_VV_VV_SW 100.0 FORMULA_0935 -100.0 100.0 /end CHARACTERISTIC
/begin CHARACTERISTIC K_SMG_MOT_RS_T_HI "Highzeit" VALUE 0x795D2 TKW_VV_VV_UW 100.0 FORMULA_0109 4.999999888241291e-003 325.0 FORMAT "%5.2" /end CHARACTERISTIC
/begin CHARACTERISTIC K_SMG_MOT_RS_T_LO "Lowzeit" VALUE 0x795D0 TKW_VV_VV_UW 100.0 FORMULA_0109 4.999999888241291e-003 325.0 FORMAT "%5.2" /end CHARACTERISTIC
/begin CHARACTERISTIC K_SMG_MOT_RS_TI_TABG "max. TABG fuer TI-Eingriff" VALUE 0x795D6 TKW_VV_VV_SW 100.0 FORMULA_0023 -50.0 1000.0 FORMAT "%4.1" /end CHARACTERISTIC
/begin CHARACTERISTIC K_SMG_MOT_RS_TI_TIME "Zeit fuer TI-Eingriff" VALUE 0x795D4 TKW_VV_VV_UW 100.0 FORMULA_0109 0.0 325.0 FORMAT "%5.2" /end CHARACTERISTIC
/begin CHARACTERISTIC K_SMG_MOT_RSS_MD_EINGR "Config-Rennstartschaltung" VALUE 0x795D8 TKW_VV_VV_UB 100.0 FORMULA_0936 0.0 255.0 /end CHARACTERISTIC
/begin CHARACTERISTIC K_SMG_N_ABRISS_ANF "Abrisserkennungschwelle beim Anfahren" VALUE 0x79514 TKW_VV_VV_SW 100.0 FORMULA_0006 0.0 10000.0 /end CHARACTERISTIC
/begin CHARACTERISTIC K_SMG_N_ABRISS_HYS "Hysterese für Abrisserkennung" VALUE 0x79512 TKW_VV_VV_SW 100.0 FORMULA_0006 0.0 10000.0 /end CHARACTERISTIC
/begin CHARACTERISTIC K_SMG_N_EKR_OFF_BEGR "EKR-Offset auf n-Begrenzer" VALUE 0x7956D TKW_VV_VV_UB 100.0 FORMULA_0745 0.0 255.0 /end CHARACTERISTIC
/begin CHARACTERISTIC K_SMG_N_NULL "Drehzahl-Nullschwelle" VALUE 0x79516 TKW_VV_VV_SW 100.0 FORMULA_0006 0.0 10000.0 /end CHARACTERISTIC
/begin CHARACTERISTIC K_SMG_N_ZIEL_ABWUERG "Abwuergsolldrehzahl" VALUE 0x7956E TKW_VV_VV_SW 100.0 FORMULA_0006 0.0 10000.0 /end CHARACTERISTIC
/begin CHARACTERISTIC K_SMG_N_ZIEL_ANF_V_MAX "v-Schwelle fuer Anfahrdrehzahl" VALUE 0x79570 TKW_VV_VV_SW 100.0 FORMULA_0076 -80.0 360.0 FORMAT "%4.1" /end CHARACTERISTIC
/begin CHARACTERISTIC K_SMG_N_ZIEL_HYS "max. Drehzahldifferenz" VALUE 0x7956A TKW_VV_VV_SW 100.0 FORMULA_0006 0.0 10000.0 /end CHARACTERISTIC
/begin CHARACTERISTIC K_SMG_N_ZIEL_OFF_BEGR "Offset auf n-Begrenzer" VALUE 0x7956C TKW_VV_VV_UB 100.0 FORMULA_0745 0.0 255.0 /end CHARACTERISTIC
/begin CHARACTERISTIC K_SMG_N_ZIEL_OFF_SCH "Offset zur EKR-Zieldrehzahl bei Schub" VALUE 0x79568 TKW_VV_VV_SW 100.0 FORMULA_0006 0.0 10000.0 /end CHARACTERISTIC
/begin CHARACTERISTIC K_SMG_N_ZIEL_OFF_ZH "Offset zur EKR-Zieldrehzahl bei ZugHoch" VALUE 0x79566 TKW_VV_VV_SW 100.0 FORMULA_0006 0.0 10000.0 /end CHARACTERISTIC
/begin CHARACTERISTIC K_SMG_NGETR_DIFF_E2 "max. Differenz MotGetr Ebene 2" VALUE 0x7B4EA TKW_VV_VV_SW 100.0 FORMULA_0006 0.0 10000.0 /end CHARACTERISTIC
/begin CHARACTERISTIC K_SMG_NGETR_MAX_E2 "max. Getriebedrehzahl Ebene 2" VALUE 0x7B4E8 TKW_VV_VV_SW 100.0 FORMULA_0006 0.0 20000.0 /end CHARACTERISTIC
/begin CHARACTERISTIC K_SMG_NO_LW_N_SCHW "Ende bei LW" VALUE 0x79534 TKW_VV_VV_UB 100.0 FORMULA_0745 0.0 255.0 /end CHARACTERISTIC
/begin CHARACTERISTIC K_SMG_OHNE_EINGR_OFF "Offset auf sa_n_we" VALUE 0x795F0 TKW_VV_VV_SW 100.0 FORMULA_0006 0.0 10000.0 /end CHARACTERISTIC
/begin CHARACTERISTIC K_SMG_PROG_EINFAHR_WEG "Kilometerstand Einfahr-Begrenzung" VALUE 0x79510 TKW_VV_VV_UW 100.0 FORMULA_0928 0.0 65535.0 /end CHARACTERISTIC
/begin CHARACTERISTIC K_SMG_PROG_FETRAWE_WEG "zul. Kilometerstand fuer SMG-Begrenzung im FeTra-Mode" VALUE 0x7950E TKW_VV_VV_UW 100.0 FORMULA_0928 0.0 65535.0 /end CHARACTERISTIC
/begin CHARACTERISTIC K_SMG_PROG_MAX_ANH "max. Programm mit Anhaenger" VALUE 0x7950A TKW_VV_VV_UB 100.0 FORMULA_0263 1.0 8.0 /end CHARACTERISTIC
/begin CHARACTERISTIC K_SMG_PROG_MAX_EINFAHR "max. Programm beim Einfahren" VALUE 0x7950C TKW_VV_VV_UB 100.0 FORMULA_0263 1.0 8.0 /end CHARACTERISTIC
/begin CHARACTERISTIC K_SMG_PROG_MAX_FETRAWE "max. Programm bei FeTraWe" VALUE 0x7950B TKW_VV_VV_UB 100.0 FORMULA_0263 1.0 8.0 /end CHARACTERISTIC
/begin CHARACTERISTIC K_SMG_PROG_MIN_ANH "min. Programm mit Anhaenger" VALUE 0x79509 TKW_VV_VV_UB 100.0 FORMULA_0263 1.0 8.0 /end CHARACTERISTIC
/begin CHARACTERISTIC K_SMG_PROG_MIN_ZR "min. Programm fuer ZR" VALUE 0x79508 TKW_VV_VV_UB 100.0 FORMULA_0263 1.0 8.0 /end CHARACTERISTIC
/begin CHARACTERISTIC K_SMG_PROG_V_SCHW "v-Schwelle fuer Schub-Programm" VALUE 0x79506 TKW_VV_VV_SW 100.0 FORMULA_0076 -80.0 360.0 FORMAT "%4.1" /end CHARACTERISTIC
/begin CHARACTERISTIC K_SMG_PWG_FW_SCH "Pwg-Schuberkennung" VALUE 0x7953E TKW_VV_VV_SW 100.0 FORMULA_0001 -10.0 120.0 FORMAT "%4.1" /end CHARACTERISTIC
/begin CHARACTERISTIC K_SMG_PWG_FW_SCH_N_OFF "LL-Offset fuer Pwg-Schuberkennung" VALUE 0x79540 TKW_VV_VV_SW 100.0 FORMULA_0006 0.0 10000.0 /end CHARACTERISTIC
/begin CHARACTERISTIC K_SMG_R_DYN "Reifenradius" VALUE 0x79606 TKW_VV_VV_UB 100.0 FORMULA_0937 0.0 100.0 /end CHARACTERISTIC
/begin CHARACTERISTIC K_SMG_SK_CONTROL "SK-Config" VALUE 0x79607 TKW_VV_VV_UB 100.0 FORMULA_0938 0.0 255.0 /end CHARACTERISTIC
/begin CHARACTERISTIC K_SMG_SK_M_KUPP_MIN "max. Kupplungsmoment bei AK" VALUE 0x79620 TKW_VV_VV_SW 100.0 FORMULA_0009 -100.0 1000.0 FORMAT "%4.1" /end CHARACTERISTIC
/begin CHARACTERISTIC K_SMG_SK_MD_SCHW "Md-Diagnoseschwelle" VALUE 0x79628 TKW_VV_VV_SW 100.0 FORMULA_0009 -100.0 1000.0 FORMAT "%4.1" /end CHARACTERISTIC
/begin CHARACTERISTIC K_SMG_SK_NBERCH_MAX "Drehzahlschwelle nBerech" VALUE 0x79614 TKW_VV_VV_SW 100.0 FORMULA_0006 0.0 10000.0 /end CHARACTERISTIC
/begin CHARACTERISTIC K_SMG_SK_NBERCH_T "Zeitschwelle nBerech" VALUE 0x79612 TKW_VV_VV_UB 100.0 FORMULA_0306 0.0 2.549999952316284 /end CHARACTERISTIC
/begin CHARACTERISTIC K_SMG_SK_NGETR_MAX "Drehzahlschwelle nGetr" VALUE 0x7961C TKW_VV_VV_SW 100.0 FORMULA_0006 0.0 10000.0 /end CHARACTERISTIC
/begin CHARACTERISTIC K_SMG_SK_NGETR_T "Zeitschwelle nGetr" VALUE 0x7961A TKW_VV_VV_UB 100.0 FORMULA_0306 0.0 2.549999952316284 /end CHARACTERISTIC
/begin CHARACTERISTIC K_SMG_SK_NMAX_FSP "Nmax-Schwelle innerhalb Schaltung" VALUE 0x79624 TKW_VV_VV_SW 100.0 FORMULA_0006 0.0 10000.0 /end CHARACTERISTIC
/begin CHARACTERISTIC K_SMG_SK_NMAX_FSP_INAKTIV "Nmax-Schwelle ausserhalb Schaltung" VALUE 0x79622 TKW_VV_VV_SW 100.0 FORMULA_0006 0.0 10000.0 /end CHARACTERISTIC
/begin CHARACTERISTIC K_SMG_SK_NZIEL_MAX "Drehzahlschwelle nZiel" VALUE 0x79618 TKW_VV_VV_SW 100.0 FORMULA_0006 0.0 10000.0 /end CHARACTERISTIC
/begin CHARACTERISTIC K_SMG_SK_NZIEL_T "Zeitschwelle nZiel" VALUE 0x79616 TKW_VV_VV_UB 100.0 FORMULA_0306 0.0 2.549999952316284 /end CHARACTERISTIC
/begin CHARACTERISTIC K_SMG_SK_T_DME_ST_MAX "Zeitschwelle Statuscheck" VALUE 0x79611 TKW_VV_VV_UB 100.0 FORMULA_0306 0.0 2.549999952316284 /end CHARACTERISTIC
/begin CHARACTERISTIC K_SMG_SK_T_MAX "Zeitschwelle CAN-Fehlerkennung" VALUE 0x79610 TKW_VV_VV_UB 100.0 FORMULA_0306 0.0 2.549999952316284 /end CHARACTERISTIC
/begin CHARACTERISTIC K_SMG_SK_T_NGETR_MAX "Zeitschwelle max. nGetr" VALUE 0x7961E TKW_VV_VV_UB 100.0 FORMULA_0306 0.0 2.549999952316284 /end CHARACTERISTIC
/begin CHARACTERISTIC K_SMG_SK_T_NZIEL_MAX "Zeitschwelle max. nZiel" VALUE 0x7961F TKW_VV_VV_UB 100.0 FORMULA_0306 0.0 2.549999952316284 /end CHARACTERISTIC
/begin CHARACTERISTIC K_SMG_SK_T_PHASE_MAX_AB "max. Zeit" VALUE 0x79608 TKW_VV_VV_UW 100.0 FORMULA_0021 0.0 655.0 FORMAT "%5.2" /end CHARACTERISTIC
/begin CHARACTERISTIC K_SMG_SK_T_PHASE_MAX_AUF "max. Zeit" VALUE 0x7960C TKW_VV_VV_UW 100.0 FORMULA_0021 0.0 655.0 FORMAT "%5.2" /end CHARACTERISTIC
/begin CHARACTERISTIC K_SMG_SK_T_PHASE_MAX_SCHA "max. Zeit" VALUE 0x7960A TKW_VV_VV_UW 100.0 FORMULA_0021 0.0 655.0 FORMAT "%5.2" /end CHARACTERISTIC
/begin CHARACTERISTIC K_SMG_SK_T_PHASE_N_MAX "max. Zeit Nmax-Ueberschreitung" VALUE 0x7960E TKW_VV_VV_UW 100.0 FORMULA_0021 0.0 655.0 FORMAT "%5.2" /end CHARACTERISTIC
/begin CHARACTERISTIC K_SMG_SK_V_SCHW "v-Diagnoseschwelle" VALUE 0x79626 TKW_VV_VV_SW 100.0 FORMULA_0076 -80.0 360.0 FORMAT "%4.1" /end CHARACTERISTIC
/begin CHARACTERISTIC K_SMG_T_ABREGEL_AKS "Sprung auf Nullmoment" VALUE 0x79530 TKW_VV_VV_UB 100.0 FORMULA_0306 0.0 2.549999952316284 /end CHARACTERISTIC
/begin CHARACTERISTIC K_SMG_T_KORR_AB_FW "Kuerzen wegen Fahreraktion" VALUE 0x79532 TKW_VV_VV_UW 100.0 FORMULA_0009 0.0 6553.5 FORMAT "%4.1" /end CHARACTERISTIC
/begin CHARACTERISTIC K_SMG_T_KORR_AB_MIN "t-Verkuerzung" VALUE 0x79531 TKW_VV_VV_UB 100.0 FORMULA_0306 0.0 2.549999952316284 /end CHARACTERISTIC
/begin CHARACTERISTIC K_SMG_TAU_AX_BERECH "Filter berech. ax" VALUE 0x79500 TKW_VV_VV_UB 100.0 FORMULA_0455 1.009999960660934e-002 2.559999942779541 /end CHARACTERISTIC
/begin CHARACTERISTIC K_SMG_TAU_AX_BERG "Filter Steigung" VALUE 0x79502 TKW_VV_VV_UB 100.0 FORMULA_0455 1.009999960660934e-002 2.559999942779541 /end CHARACTERISTIC
/begin CHARACTERISTIC K_SMG_TAU_AX_MESS "Filter gem. ax" VALUE 0x79501 TKW_VV_VV_UB 100.0 FORMULA_0455 1.009999960660934e-002 2.559999942779541 /end CHARACTERISTIC
/begin CHARACTERISTIC K_SMG_TAU_DN_FILTER "Filter Drehzahlgradient" VALUE 0x794FD TKW_VV_VV_UB 100.0 FORMULA_0455 1.009999960660934e-002 2.559999942779541 /end CHARACTERISTIC
/begin CHARACTERISTIC K_SMG_TAU_DN_GETR "Filter Getriebedrehzahlgradient" VALUE 0x794FE TKW_VV_VV_UB 100.0 FORMULA_0455 1.009999960660934e-002 2.559999942779541 /end CHARACTERISTIC
/begin CHARACTERISTIC K_SMG_TAU_DSC_ABS "Filter DSC-Anforderung" VALUE 0x79504 TKW_VV_VV_UB 100.0 FORMULA_0455 1.009999960660934e-002 2.559999942779541 /end CHARACTERISTIC
/begin CHARACTERISTIC K_SMG_TAU_KSCHLUPF "Filter Kupplungsschlupf" VALUE 0x794FF TKW_VV_VV_UB 100.0 FORMULA_0455 1.009999960660934e-002 2.559999942779541 /end CHARACTERISTIC
/begin CHARACTERISTIC K_SMG_TAU_MD_FAHRER "Filter Fahrerwunsch" VALUE 0x794FC TKW_VV_VV_UB 100.0 FORMULA_0455 1.009999960660934e-002 2.559999942779541 /end CHARACTERISTIC
/begin CHARACTERISTIC K_SMG_TAU_NGETR_ZIEL "Filter Getriebezieldrehzahl" VALUE 0x79EC4 TKW_VV_VV_UB 100.0 FORMULA_0470 5.100000184029341e-003 1.279999971389771 /end CHARACTERISTIC
/begin CHARACTERISTIC K_SMG_TAU_RSCHLUPF "Filter Radschlupf" VALUE 0x79503 TKW_VV_VV_UB 100.0 FORMULA_0455 1.009999960660934e-002 2.559999942779541 /end CHARACTERISTIC
/begin CHARACTERISTIC K_SMG_TESTMODE "Testfunktionen" VALUE 0x79535 TKW_VV_VV_UB 100.0 FORMULA_0931 0.0 255.0 /end CHARACTERISTIC
/begin CHARACTERISTIC K_SMG_TZ_EINGR_T_AB "Schwelle Abregeln mit TZ-Eingr" VALUE 0x79564 TKW_VV_VV_UB 100.0 FORMULA_0306 0.0 2.549999952316284 /end CHARACTERISTIC
/begin CHARACTERISTIC K_SMG_V_KRAFTS_ERSATZ "v-Schwelle fuer Kraftschlussersatzwert" VALUE 0x79EC0 TKW_VV_VV_UB 100.0 FORMULA_0954 0.0 15.9375 /end CHARACTERISTIC
/begin CHARACTERISTIC K_START_RL_BEGINN "Maximale Motordrehzahl beim Anlassbeginn" VALUE 0x79EC6 TKW_VV_VV_SW 100.0 FORMULA_0006 0.0 10000.0 /end CHARACTERISTIC
/begin CHARACTERISTIC K_TDME_DIAG_MAX "Obere Grenze Steuergeraetetemperatur" VALUE 0x7A200 TKW_VV_VV_SW 100.0 FORMULA_0975 -50.0 170.0 FORMAT "%6.3" /end CHARACTERISTIC
/begin CHARACTERISTIC K_TDME_DIAG_MIN "Unter Grenze Steuergeraetetemperatur" VALUE 0x7A1FE TKW_VV_VV_SW 100.0 FORMULA_0975 -50.0 170.0 FORMAT "%6.3" /end CHARACTERISTIC
/begin CHARACTERISTIC K_TDME_SCHWELLE_ZAEHLER "Schwelle fuer Langzeitueberwachung" VALUE 0x7A202 TKW_VV_VV_SW 100.0 FORMULA_0023 -50.0 170.0 FORMAT "%4.1" /end CHARACTERISTIC
/begin CHARACTERISTIC K_TDME_TAU "Filterkonstante fuer die Steuergeraetetemperatur" VALUE 0x7A204 TKW_VV_VV_UB 100.0 FORMULA_0746 0.1004000008106232 25.60000038146973 /end CHARACTERISTIC
/begin CHARACTERISTIC K_TPU_IGN_MIN_SCI_POS "Ini minimalen Winkelabstand vorm Zuendwinkel." VALUE 0x7A602 TKW_VV_VV_SW 100.0 FORMULA_0709 -360.0 359.8999938964844 FORMAT "%4.1" /end CHARACTERISTIC
/begin CHARACTERISTIC K_TPU_IGN_MISS_FIRE_TIME "Ini Schliesszeit fuer die Ausgabe von Fehlzuendungen." VALUE 0x7A600 TKW_VV_VV_UB 100.0 FORMULA_1014 0.0 291.4284973144531 /end CHARACTERISTIC
/begin CHARACTERISTIC K_TPU_KW_N_MIN "Unterdrehzahl." VALUE 0x7A604 TKW_VV_VV_UW 100.0 FORMULA_0418 4.0 10000.0 /end CHARACTERISTIC
/begin CHARACTERISTIC K_TPU_KW_SYNC_ZAHN "KW Interruptzahn zur NW Sync." VALUE 0x7A606 TKW_VV_VV_UB 100.0 FORMULA_0003 0.0 59.0 /end CHARACTERISTIC
/begin CHARACTERISTIC K_TSGRW_CFG "Schalter welches TSGRW" VALUE 0x7A60A TKW_VV_VV_UB 100.0 FORMULA_1016 0.0 1.0 BIT_MASK 0x1 /end CHARACTERISTIC
/begin CHARACTERISTIC K_TSGRW_TAU "Filterkonstante fuer die Saugrohrwandtemperatur" VALUE 0x7A60B TKW_VV_VV_UB 100.0 FORMULA_0746 0.1004000008106232 25.60000038146973 /end CHARACTERISTIC
/begin CHARACTERISTIC K_TSGRW_TAU_MS "Filterkonstante fuer die Saugrohrwandtemperatur bei stehendem Motor" VALUE 0x7A60C TKW_VV_VV_UB 100.0 FORMULA_0746 0.1004000008106232 25.60000038146973 /end CHARACTERISTIC
/begin CHARACTERISTIC K_TSGRW_TU "Tuning Saugrohrwandtemperatur" VALUE 0x7A608 TKW_VV_VV_SW 100.0 FORMULA_1015 -50.0 170.0 FORMAT "%4.1" /end CHARACTERISTIC
/begin CHARACTERISTIC KF_SMG_BW_NULL "Bewertung Nulldurchgang" MAP 0x79CD8 TKF_UB_UB_UB 100.0 FORMULA_0003 0.0 15.0 /begin AXIS_DESCR STD_AXIS KI_AB FORMULA_0003 6 1.0 12.0 MAX_GRAD 0.0 /end AXIS_DESCR /begin AXIS_DESCR STD_AXIS KI_SCHA FORMULA_0003 6 1.0 12.0 MAX_GRAD 0.0 /end AXIS_DESCR /end CHARACTERISTIC
/begin CHARACTERISTIC KF_SMG_KI_AB_K "Abregel-Index Komfort" MAP 0x798EE TKF_SW_SW_UB 100.0 FORMULA_0003 0.0 12.0
 /begin AXIS_DESCR STD_AXIS pwg_soll FORMULA_0001 8 -10.0 120.0 MAX_GRAD 0.0 FORMAT "%4.1" /end AXIS_DESCR
 /begin AXIS_DESCR STD_AXIS n FORMULA_0006 6 0.0 10000.0 MAX_GRAD 0.0 /end AXIS_DESCR
/end CHARACTERISTIC
/begin CHARACTERISTIC KF_SMG_KI_AB_S "Abregel-Index Sport" MAP 0x7993C TKF_SW_SW_UB 100.0 FORMULA_0003 0.0 12.0
 /begin AXIS_DESCR STD_AXIS pwg_soll FORMULA_0001 8 -10.0 120.0 MAX_GRAD 0.0 FORMAT "%4.1" /end AXIS_DESCR
 /begin AXIS_DESCR STD_AXIS n FORMULA_0006 6 0.0 10000.0 MAX_GRAD 0.0 /end AXIS_DESCR
/end CHARACTERISTIC
/begin CHARACTERISTIC KF_SMG_KI_AB_SCH_K "Abregel-Index Schub Komfort" MAP 0x79AC2 TKF_SW_SW_UB 100.0 FORMULA_0003 0.0 12.0
 /begin AXIS_DESCR STD_AXIS can_ax FORMULA_0123 5 -20.0 20.0 MAX_GRAD 0.0 FORMAT "%5.2" /end AXIS_DESCR
 /begin AXIS_DESCR STD_AXIS n FORMULA_0006 6 0.0 10000.0 MAX_GRAD 0.0 /end AXIS_DESCR
/end CHARACTERISTIC
/begin CHARACTERISTIC KF_SMG_KI_AB_SCH_S "Abregel-Index Schub Sport" MAP 0x79AF8 TKF_SW_SW_UB 100.0 FORMULA_0003 0.0 12.0
 /begin AXIS_DESCR STD_AXIS can_ax FORMULA_0123 5 -20.0 20.0 MAX_GRAD 0.0 FORMAT "%5.2" /end AXIS_DESCR
 /begin AXIS_DESCR STD_AXIS n FORMULA_0006 6 0.0 10000.0 MAX_GRAD 0.0 /end AXIS_DESCR
/end CHARACTERISTIC
/begin CHARACTERISTIC KF_SMG_KI_AUF_K "Aufregel-Index Komfort" MAP 0x79A26 TKF_SW_SW_UB 100.0 FORMULA_0003 0.0 12.0
 /begin AXIS_DESCR STD_AXIS pwg_soll FORMULA_0001 8 -10.0 120.0 MAX_GRAD 0.0 FORMAT "%4.1" /end AXIS_DESCR
 /begin AXIS_DESCR STD_AXIS n FORMULA_0006 6 0.0 10000.0 MAX_GRAD 0.0 /end AXIS_DESCR
/end CHARACTERISTIC
/begin CHARACTERISTIC KF_SMG_KI_AUF_S "Aufregel-Index Sport" MAP 0x79A74 TKF_SW_SW_UB 100.0 FORMULA_0003 0.0 12.0
 /begin AXIS_DESCR STD_AXIS pwg_soll FORMULA_0001 8 -10.0 120.0 MAX_GRAD 0.0 FORMAT "%4.1" /end AXIS_DESCR
 /begin AXIS_DESCR STD_AXIS n FORMULA_0006 6 0.0 10000.0 MAX_GRAD 0.0 /end AXIS_DESCR
/end CHARACTERISTIC
/begin CHARACTERISTIC KF_SMG_KI_AUF_SCH_K "Aufregel-Index Schub Komfort" MAP 0x79B9A TKF_SW_SW_UB 100.0 FORMULA_0003 0.0 12.0
 /begin AXIS_DESCR STD_AXIS can_ax FORMULA_0123 5 -20.0 20.0 MAX_GRAD 0.0 FORMAT "%5.2" /end AXIS_DESCR
 /begin AXIS_DESCR STD_AXIS n FORMULA_0006 6 0.0 10000.0 MAX_GRAD 0.0 /end AXIS_DESCR
/end CHARACTERISTIC
/begin CHARACTERISTIC KF_SMG_KI_AUF_SCH_S "Aufregel-Index Schub Sport" MAP 0x79BD0 TKF_SW_SW_UB 100.0 FORMULA_0003 0.0 12.0
 /begin AXIS_DESCR STD_AXIS can_ax FORMULA_0123 5 -20.0 20.0 MAX_GRAD 0.0 FORMAT "%5.2" /end AXIS_DESCR
 /begin AXIS_DESCR STD_AXIS n FORMULA_0006 6 0.0 10000.0 MAX_GRAD 0.0 /end AXIS_DESCR
/end CHARACTERISTIC
/begin CHARACTERISTIC KF_SMG_KI_SCHA_K "Schalt-Index Komfort" MAP 0x7998A TKF_SW_SW_UB 100.0 FORMULA_0003 0.0 14.0
 /begin AXIS_DESCR STD_AXIS pwg_soll FORMULA_0001 8 -10.0 120.0 MAX_GRAD 0.0 FORMAT "%4.1" /end AXIS_DESCR
 /begin AXIS_DESCR STD_AXIS n FORMULA_0006 6 0.0 10000.0 MAX_GRAD 0.0 /end AXIS_DESCR
/end CHARACTERISTIC
/begin CHARACTERISTIC KF_SMG_KI_SCHA_S "Schalt-Index Sport" MAP 0x799D8 TKF_SW_SW_UB 100.0 FORMULA_0003 0.0 14.0
 /begin AXIS_DESCR STD_AXIS pwg_soll FORMULA_0001 8 -10.0 120.0 MAX_GRAD 0.0 FORMAT "%4.1" /end AXIS_DESCR
 /begin AXIS_DESCR STD_AXIS n FORMULA_0006 6 0.0 10000.0 MAX_GRAD 0.0 /end AXIS_DESCR
/end CHARACTERISTIC
/begin CHARACTERISTIC KF_SMG_KI_SCHA_SCH_K "Schalt-Index Schub Komfort" MAP 0x79B2E TKF_SW_SW_UB 100.0 FORMULA_0003 0.0 12.0
 /begin AXIS_DESCR STD_AXIS can_ax FORMULA_0123 5 -20.0 20.0 MAX_GRAD 0.0 FORMAT "%5.2" /end AXIS_DESCR
 /begin AXIS_DESCR STD_AXIS n FORMULA_0006 6 0.0 10000.0 MAX_GRAD 0.0 /end AXIS_DESCR
/end CHARACTERISTIC
/begin CHARACTERISTIC KF_SMG_KI_SCHA_SCH_S "Schalt-Index Schub Sport" MAP 0x79B64 TKF_SW_SW_UB 100.0 FORMULA_0003 0.0 12.0
 /begin AXIS_DESCR STD_AXIS can_ax FORMULA_0123 5 -20.0 20.0 MAX_GRAD 0.0 FORMAT "%5.2" /end AXIS_DESCR
 /begin AXIS_DESCR STD_AXIS n FORMULA_0006 6 0.0 10000.0 MAX_GRAD 0.0 /end AXIS_DESCR
/end CHARACTERISTIC
/begin CHARACTERISTIC KF_SMG_KUPP_LW_RAMPE "Rampe beim Lastwechsel" MAP 0x79E88 TKF_SW_SW_SW 100.0 FORMULA_0948 -5000.0 5000.0
 /begin AXIS_DESCR STD_AXIS pwg_soll FORMULA_0001 4 -10.0 120.0 MAX_GRAD 0.0 FORMAT "%4.1" /end AXIS_DESCR
 /begin AXIS_DESCR STD_AXIS smg_kupp_m_lw_start FORMULA_0009 4 0.0 1000.0 MAX_GRAD 0.0 FORMAT "%4.1" /end AXIS_DESCR
/end CHARACTERISTIC
/begin CHARACTERISTIC KF_SMG_KUPP_REG_I_SCH "Kupplungsregler fuer Schub" MAP 0x79E6C TKF_SW_SW_UB 100.0 FORMULA_0934 0.0 2.549999952316284e-002 /begin AXIS_DESCR STD_AXIS n_diff FORMULA_0006 4 0.0 10000.0 MAX_GRAD 0.0 /end AXIS_DESCR
 /begin AXIS_DESCR STD_AXIS n_grad_diff FORMULA_0105 3 -10000.0 10000.0 MAX_GRAD 0.0 /end AXIS_DESCR
/end CHARACTERISTIC
/begin CHARACTERISTIC KF_SMG_KUPP_REG_I_ZUG "Kupplungsregler fuer Zug" MAP 0x79E50 TKF_SW_SW_UB 100.0 FORMULA_0934 0.0 2.549999952316284e-002 /begin AXIS_DESCR STD_AXIS n_diff FORMULA_0006 4 0.0 10000.0 MAX_GRAD 0.0 /end AXIS_DESCR
 /begin AXIS_DESCR STD_AXIS n_grad_diff FORMULA_0105 3 -10000.0 10000.0 MAX_GRAD 0.0 /end AXIS_DESCR
/end CHARACTERISTIC
/begin CHARACTERISTIC KF_SMG_MOT_ANF_M_RAMPE_1R "Rampe beim Anfahren in 1 und R" MAP 0x79DAE TKF_SW_SW_SW 100.0 FORMULA_0562 0.0 5000.0
 /begin AXIS_DESCR STD_AXIS pwg_soll FORMULA_0001 4 -10.0 120.0 MAX_GRAD 0.0 FORMAT "%4.1" /end AXIS_DESCR
 /begin AXIS_DESCR STD_AXIS smg_ax_berg FORMULA_0123 4 0.0 20.0 MAX_GRAD 0.0 FORMAT "%5.2" /end AXIS_DESCR
/end CHARACTERISTIC
/begin CHARACTERISTIC KF_SMG_MOT_ANF_M_RAMPE_2 "Rampe beim Anfahren in 2" MAP 0x79DE0 TKF_SW_SW_SW 100.0 FORMULA_0562 0.0 5000.0
 /begin AXIS_DESCR STD_AXIS pwg_soll FORMULA_0001 4 -10.0 120.0 MAX_GRAD 0.0 FORMAT "%4.1" /end AXIS_DESCR
 /begin AXIS_DESCR STD_AXIS smg_ax_berg FORMULA_0123 4 0.0 20.0 MAX_GRAD 0.0 FORMAT "%5.2" /end AXIS_DESCR
/end CHARACTERISTIC
/begin CHARACTERISTIC KF_SMG_MOT_N_REG_M_MAX "Max-Begrenzung n-Regler" MAP 0x79D66 TKF_SW_SW_SW 100.0 FORMULA_0009 -100.0 1000.0 FORMAT "%4.1"
 /begin AXIS_DESCR STD_AXIS pwg_soll FORMULA_0001 5 -10.0 120.0 MAX_GRAD 0.0 FORMAT "%4.1" /end AXIS_DESCR
 /begin AXIS_DESCR STD_AXIS canP FORMULA_0010 5 0.0 8.0 MAX_GRAD 0.0 /end AXIS_DESCR
/end CHARACTERISTIC
/begin CHARACTERISTIC KF_SMG_MOT_N_REG_P_KO "Korrektur P-Faktor" MAP 0x79E12 TKF_SW_SW_UB 100.0 FORMULA_0947 1.0 2.99210000038147 /begin AXIS_DESCR STD_AXIS n_diff FORMULA_0006 6 0.0 10000.0 MAX_GRAD 0.0 /end AXIS_DESCR
 /begin AXIS_DESCR STD_AXIS n_grad_asp FORMULA_0105 6 -10000.0 10000.0 MAX_GRAD 0.0 /end AXIS_DESCR
/end CHARACTERISTIC
/begin CHARACTERISTIC KF_SMG_N_ZIEL_OFF_K "Offsetfaktor auf Zieldrehzahl Komfort" MAP 0x79D0A TKF_SW_SW_UB 100.0 FORMULA_0942 0.0 100.0
 /begin AXIS_DESCR STD_AXIS ax FORMULA_0123 4 -20.0 20.0 MAX_GRAD 0.0 FORMAT "%5.2" /end AXIS_DESCR
 /begin AXIS_DESCR STD_AXIS n FORMULA_0006 6 0.0 10000.0 MAX_GRAD 0.0 /end AXIS_DESCR
/end CHARACTERISTIC
/begin CHARACTERISTIC KF_SMG_N_ZIEL_OFF_S "Offsetfaktor auf Zieldrehzahl Sport" MAP 0x79D38 TKF_SW_SW_UB 100.0 FORMULA_0942 0.0 100.0
 /begin AXIS_DESCR STD_AXIS ax FORMULA_0123 4 -20.0 20.0 MAX_GRAD 0.0 FORMAT "%5.2" /end AXIS_DESCR
 /begin AXIS_DESCR STD_AXIS n FORMULA_0006 6 0.0 10000.0 MAX_GRAD 0.0 /end AXIS_DESCR
/end CHARACTERISTIC
/begin CHARACTERISTIC KF_SMG_T_ABREGEL "Abregelzeit" MAP 0x79C06 TKF_UB_UB_UB 100.0 FORMULA_0306 9.999999776482582e-003 2.450000047683716 /begin AXIS_DESCR STD_AXIS Kennung FORMULA_0003 12 0.0 255.0 MAX_GRAD 0.0 /end AXIS_DESCR /begin AXIS_DESCR STD_AXIS Istgang FORMULA_0003 7 0.0 255.0 MAX_GRAD 0.0 /end AXIS_DESCR /end CHARACTERISTIC
/begin CHARACTERISTIC KF_SMG_T_AUFREGEL "Aufregelzeit" MAP 0x79C6F TKF_UB_UB_UB 100.0 FORMULA_0306 9.999999776482582e-003 2.450000047683716 /begin AXIS_DESCR STD_AXIS Kennung FORMULA_0003 12 0.0 255.0 MAX_GRAD 0.0 /end AXIS_DESCR /begin AXIS_DESCR STD_AXIS Istgang FORMULA_0003 7 0.0 255.0 MAX_GRAD 0.0 /end AXIS_DESCR /end CHARACTERISTIC
/begin CHARACTERISTIC KL_SERVO_KOMFORT "SERVO KOMFORT-Kennlinie" CURVE 0x792E4 TKL_SW_VV_UW 100.0 FORMULA_0886 0.0 801.0
 /begin AXIS_DESCR STD_AXIS v_vorne FORMULA_0076 10 -80.0 360.0 MAX_GRAD 0.0 FORMAT "%4.1" /end AXIS_DESCR
/end CHARACTERISTIC
/begin CHARACTERISTIC KL_SERVO_SPORT "SERVO SPORT-Kennlinie" CURVE 0x7930E TKL_SW_VV_UW 100.0 FORMULA_0886 0.0 801.0
 /begin AXIS_DESCR STD_AXIS v_vorne FORMULA_0076 10 -80.0 360.0 MAX_GRAD 0.0 FORMAT "%4.1" /end AXIS_DESCR
/end CHARACTERISTIC
/begin CHARACTERISTIC KL_SK_LLR_N_SOLL "Solldrehzahl durch SK-Stufe" CURVE 0x794E2 TKL_UB_VV_SW 100.0 FORMULA_0006 0.0 10000.0 /begin AXIS_DESCR STD_AXIS Stufe FORMULA_0003 6 0.0 255.0 MAX_GRAD 0.0 /end AXIS_DESCR /end CHARACTERISTIC
/begin CHARACTERISTIC KL_SMG_FW_REL_VIRT "virt. Fahrerwunsch" CURVE 0x7967C TKL_SW_VV_UB 100.0 FORMULA_0757 0.0 1.99210000038147
 /begin AXIS_DESCR STD_AXIS rschlupf FORMULA_0904 4 -100.0 100.0 MAX_GRAD 0.0 FORMAT "%5.2" /end AXIS_DESCR
/end CHARACTERISTIC
/begin CHARACTERISTIC KL_SMG_KI_AKS_GANG "maximale KI ueber Ziel-Gang" CURVE 0x79696 TKL_SB_VV_UB 100.0 FORMULA_0003 0.0 255.0 /begin AXIS_DESCR STD_AXIS istgang FORMULA_0003 7 -128.0 127.0 MAX_GRAD 0.0 /end AXIS_DESCR /end CHARACTERISTIC
/begin CHARACTERISTIC KL_SMG_KI_DAY_MAX "max. Zunahme ay" CURVE 0x7968A TKL_SW_VV_UB 100.0 FORMULA_0003 0.0 15.0
 /begin AXIS_DESCR STD_AXIS day FORMULA_0123 3 -20.0 20.0 MAX_GRAD 0.0 FORMAT "%5.2" /end AXIS_DESCR
/end CHARACTERISTIC
/begin CHARACTERISTIC KL_SMG_KUPP_M_AB_ANF "Abregel-Kennlinie nach Anfahren" CURVE 0x796EE TKL_UB_VV_UB 100.0 FORMULA_0939 0.0 199.2187042236328
 /begin AXIS_DESCR STD_AXIS t_norm FORMULA_0940 6 0.0 199.2187042236328 MAX_GRAD 0.0 /end AXIS_DESCR
/end CHARACTERISTIC
/begin CHARACTERISTIC KL_SMG_KUPP_M_AB_OFF "Offset auf Fahrer beim Abregeln" CURVE 0x7974A TKL_SW_VV_SW 100.0 FORMULA_0009 -100.0 1000.0 FORMAT "%4.1"
 /begin AXIS_DESCR STD_AXIS md_fw FORMULA_0009 3 -100.0 1000.0 MAX_GRAD 0.0 FORMAT "%4.1" /end AXIS_DESCR
/end CHARACTERISTIC
/begin CHARACTERISTIC KL_SMG_KUPP_M_AB_SH "Abregel-Kennlinie SchubHoch" CURVE 0x796CA TKL_UB_VV_UB 100.0 FORMULA_0939 0.0 199.2187042236328
 /begin AXIS_DESCR STD_AXIS t_norm FORMULA_0940 8 0.0 199.2187042236328 MAX_GRAD 0.0 /end AXIS_DESCR
/end CHARACTERISTIC
/begin CHARACTERISTIC KL_SMG_KUPP_M_AB_SR "Abregel-Kennlinie SchubRueck" CURVE 0x796DC TKL_UB_VV_UB 100.0 FORMULA_0939 0.0 199.2187042236328
 /begin AXIS_DESCR STD_AXIS t_norm FORMULA_0940 8 0.0 199.2187042236328 MAX_GRAD 0.0 /end AXIS_DESCR
/end CHARACTERISTIC
/begin CHARACTERISTIC KL_SMG_KUPP_M_AB_ZH "Abregel-Kennlinie ZugHoch" CURVE 0x796A6 TKL_UB_VV_UB 100.0 FORMULA_0939 0.0 199.2187042236328
 /begin AXIS_DESCR STD_AXIS t_norm FORMULA_0940 8 0.0 199.2187042236328 MAX_GRAD 0.0 /end AXIS_DESCR
/end CHARACTERISTIC
/begin CHARACTERISTIC KL_SMG_KUPP_M_AB_ZR "Abregel-Kennlinie ZugRueck" CURVE 0x796B8 TKL_UB_VV_UB 100.0 FORMULA_0939 0.0 199.2187042236328
 /begin AXIS_DESCR STD_AXIS t_norm FORMULA_0940 8 0.0 199.2187042236328 MAX_GRAD 0.0 /end AXIS_DESCR
/end CHARACTERISTIC
/begin CHARACTERISTIC KL_SMG_KUPP_M_AUF_KI "Offset auf Aufregelrampe" CURVE 0x79720 TKL_UB_VV_UB 100.0 FORMULA_0939 0.0 50.0 /begin AXIS_DESCR STD_AXIS ki_auf FORMULA_0003 4 0.0 12.0 MAX_GRAD 0.0 /end AXIS_DESCR /end CHARACTERISTIC
/begin CHARACTERISTIC KL_SMG_KUPP_M_AUF_OFF "Kupplungsoffset beim Aufregeln" CURVE 0x7972A TKL_UB_VV_UB 100.0 FORMULA_0749 0.0 25.5
 /begin AXIS_DESCR STD_AXIS t_norm FORMULA_0940 8 0.0 199.2187042236328 MAX_GRAD 0.0 /end AXIS_DESCR
/end CHARACTERISTIC
/begin CHARACTERISTIC KL_SMG_KUPP_M_AUF_S1 "Aufregel-Kennlinie Schub" CURVE 0x7970E TKL_UB_VV_UB 100.0 FORMULA_0939 0.0 100.0
 /begin AXIS_DESCR STD_AXIS t_norm FORMULA_0940 8 0.0 199.2187042236328 MAX_GRAD 0.0 /end AXIS_DESCR
/end CHARACTERISTIC
/begin CHARACTERISTIC KL_SMG_KUPP_M_AUF_Z1 "Aufregel-Kennlinie Zug" CURVE 0x796FC TKL_UB_VV_UB 100.0 FORMULA_0939 0.0 100.0
 /begin AXIS_DESCR STD_AXIS t_norm FORMULA_0940 8 0.0 199.2187042236328 MAX_GRAD 0.0 /end AXIS_DESCR
/end CHARACTERISTIC
/begin CHARACTERISTIC KL_SMG_KUPP_REG_I_F "Faktor fuer Rampe und Regler" CURVE 0x7973C TKL_SW_VV_UW 100.0 FORMULA_0941 1.0 10.0 FORMAT "%4.1"
 /begin AXIS_DESCR STD_AXIS vor1 FORMULA_0009 3 -100.0 1000.0 MAX_GRAD 0.0 FORMAT "%4.1" /end AXIS_DESCR
/end CHARACTERISTIC
/begin CHARACTERISTIC KL_SMG_KUPP_UL_DN_POS "Gradientenschwelle Ueberlastschutz" CURVE 0x79758 TKL_SW_VV_SW 100.0 FORMULA_0105 0.0 10000.0 /begin AXIS_DESCR STD_AXIS n_diff FORMULA_0006 3 0.0 10000.0 MAX_GRAD 0.0 /end AXIS_DESCR /end CHARACTERISTIC
/begin CHARACTERISTIC KL_SMG_MOT_DN_REG_P "P-Anteil Gradientenreglers" CURVE 0x7984C TKL_SW_VV_UB 100.0 FORMULA_0945 0.0 0.2549999952316284 /begin AXIS_DESCR STD_AXIS n_diff FORMULA_0006 4 0.0 10000.0 MAX_GRAD 0.0 /end AXIS_DESCR /end CHARACTERISTIC
/begin CHARACTERISTIC KL_SMG_MOT_DN_SOLL "Betrag Sollgradient" CURVE 0x79832 TKL_SW_VV_SW 100.0 FORMULA_0105 -10000.0 10000.0 /begin AXIS_DESCR STD_AXIS n_diff FORMULA_0006 6 0.0 10000.0 MAX_GRAD 0.0 /end AXIS_DESCR /end CHARACTERISTIC
/begin CHARACTERISTIC KL_SMG_MOT_J_MOTOR "Faktor fuer Vorst 2" CURVE 0x7985A TKL_SW_VV_UB 100.0 FORMULA_0926 0.0 1.99210000038147 /begin AXIS_DESCR STD_AXIS n_ziel FORMULA_0006 3 0.0 10000.0 MAX_GRAD 0.0 /end AXIS_DESCR /end CHARACTERISTIC
/begin CHARACTERISTIC KL_SMG_MOT_M_AB_SH "Abregel-Kennlinie SchubHoch" CURVE 0x7978A TKL_UB_VV_UB 100.0 FORMULA_0939 0.0 199.2187042236328
 /begin AXIS_DESCR STD_AXIS t_norm FORMULA_0940 8 0.0 199.2187042236328 MAX_GRAD 0.0 /end AXIS_DESCR
/end CHARACTERISTIC
/begin CHARACTERISTIC KL_SMG_MOT_M_AB_SR "Abregel-Kennlinie SchubRueck" CURVE 0x7979C TKL_UB_VV_UB 100.0 FORMULA_0939 0.0 199.2187042236328
 /begin AXIS_DESCR STD_AXIS t_norm FORMULA_0940 8 0.0 199.2187042236328 MAX_GRAD 0.0 /end AXIS_DESCR
/end CHARACTERISTIC
/begin CHARACTERISTIC KL_SMG_MOT_M_AB_ZH "Abregel-Kennlinie ZugHoch" CURVE 0x79766 TKL_UB_VV_UB 100.0 FORMULA_0939 0.0 199.2187042236328
 /begin AXIS_DESCR STD_AXIS t_norm FORMULA_0940 8 0.0 199.2187042236328 MAX_GRAD 0.0 /end AXIS_DESCR
/end CHARACTERISTIC
/begin CHARACTERISTIC KL_SMG_MOT_M_AB_ZR "Abregel-Kennlinie ZugRueck" CURVE 0x79778 TKL_UB_VV_UB 100.0 FORMULA_0939 0.0 199.2187042236328
 /begin AXIS_DESCR STD_AXIS t_norm FORMULA_0940 8 0.0 199.2187042236328 MAX_GRAD 0.0 /end AXIS_DESCR
/end CHARACTERISTIC
/begin CHARACTERISTIC KL_SMG_MOT_M_RES_AUF "Reserve beim Aufregeln" CURVE 0x79894 TKL_SW_VV_SW 100.0 FORMULA_0009 -100.0 1000.0 FORMAT "%4.1"
 /begin AXIS_DESCR STD_AXIS md_kupp_wunsch_ges FORMULA_0009 4 -100.0 1000.0 MAX_GRAD 0.0 FORMAT "%4.1" /end AXIS_DESCR
/end CHARACTERISTIC
/begin CHARACTERISTIC KL_SMG_MOT_M_VOR_AUF "Motor-Vorausschau" CURVE 0x79866 TKL_SW_VV_UB 100.0 FORMULA_0306 0.0 2.549999952316284 /begin AXIS_DESCR STD_AXIS n FORMULA_0006 4 0.0 10000.0 MAX_GRAD 0.0 /end AXIS_DESCR /end CHARACTERISTIC
/begin CHARACTERISTIC KL_SMG_MOT_N_REG_D_DN "D-Anteil DOWN" CURVE 0x7981E TKL_SW_VV_UB 100.0 FORMULA_0944 0.0 25.5 /begin AXIS_DESCR STD_AXIS n_soll FORMULA_0006 6 0.0 10000.0 MAX_GRAD 0.0 /end AXIS_DESCR /end CHARACTERISTIC
/begin CHARACTERISTIC KL_SMG_MOT_N_REG_D_UP "D-Anteil UP" CURVE 0x7980A TKL_SW_VV_UB 100.0 FORMULA_0944 0.0 25.5 /begin AXIS_DESCR STD_AXIS n_soll FORMULA_0006 6 0.0 10000.0 MAX_GRAD 0.0 /end AXIS_DESCR /end CHARACTERISTIC
/begin CHARACTERISTIC KL_SMG_MOT_N_REG_M_LW "Max. Moment beim Lastwechsel" CURVE 0x798C2 TKL_SW_VV_SW 100.0 FORMULA_0009 -100.0 1000.0 FORMAT "%4.1"
 /begin AXIS_DESCR STD_AXIS smg_can_m_kupp_ist_abs FORMULA_0009 4 -100.0 1000.0 MAX_GRAD 0.0 FORMAT "%4.1" /end AXIS_DESCR
/end CHARACTERISTIC
/begin CHARACTERISTIC KL_SMG_MOT_N_REG_P_DN "P-Anteil DOWN" CURVE 0x797F6 TKL_SW_VV_UB 100.0 FORMULA_0943 0.0 2.549999952316284 /begin AXIS_DESCR STD_AXIS n_soll FORMULA_0006 6 0.0 10000.0 MAX_GRAD 0.0 /end AXIS_DESCR /end CHARACTERISTIC
/begin CHARACTERISTIC KL_SMG_MOT_N_REG_P_UP "P-Anteil UP" CURVE 0x797E2 TKL_SW_VV_UB 100.0 FORMULA_0943 0.0 2.549999952316284 /begin AXIS_DESCR STD_AXIS n_soll FORMULA_0006 6 0.0 10000.0 MAX_GRAD 0.0 /end AXIS_DESCR /end CHARACTERISTIC
/begin CHARACTERISTIC KL_SMG_MOT_N_REG_SA_DIFF "Drehzahldifferenz SA-Ausloesung" CURVE 0x798D4 TKL_SW_VV_SW 100.0 FORMULA_0006 0.0 10000.0 /begin AXIS_DESCR STD_AXIS gang FORMULA_0479 6 -1.0 10.0 MAX_GRAD 0.0 /end AXIS_DESCR /end CHARACTERISTIC
/begin CHARACTERISTIC KL_SMG_MOT_VOR_2_KI "Faktor fuer Vorsteuerung 2" CURVE 0x797AE TKL_UB_VV_UB 100.0 FORMULA_0757 0.0 1.99210000038147 /begin AXIS_DESCR STD_AXIS smg_ki_auf FORMULA_0003 4 0.0 12.0 MAX_GRAD 0.0 /end AXIS_DESCR /end CHARACTERISTIC
/begin CHARACTERISTIC KL_SMG_N_ABRISS_SCHW "Schwelle fuer Abriss" CURVE 0x7966A TKL_SW_VV_SW 100.0 FORMULA_0006 0.0 10000.0
 /begin AXIS_DESCR STD_AXIS md_kw FORMULA_0009 4 -100.0 1000.0 MAX_GRAD 0.0 FORMAT "%4.1" /end AXIS_DESCR
/end CHARACTERISTIC
/begin CHARACTERISTIC KL_SMG_N_ZIEL_OFF_ANF "Offset auf n-Anfahr" CURVE 0x797C6 TKL_SW_VV_SW 100.0 FORMULA_0006 0.0 10000.0
 /begin AXIS_DESCR STD_AXIS pwg_soll FORMULA_0001 3 -10.0 120.0 MAX_GRAD 0.0 FORMAT "%4.1" /end AXIS_DESCR
/end CHARACTERISTIC
/begin CHARACTERISTIC KL_SMG_N_ZIEL_OFF_LL "Offset auf nLL" CURVE 0x797D4 TKL_SW_VV_SW 100.0 FORMULA_0006 0.0 10000.0
 /begin AXIS_DESCR STD_AXIS pwg_soll FORMULA_0001 3 -10.0 120.0 MAX_GRAD 0.0 FORMAT "%4.1" /end AXIS_DESCR
/end CHARACTERISTIC
/begin CHARACTERISTIC KL_SMG_N_ZIEL_OFF_MAX "maximaler Offsetfaktor" CURVE 0x797B8 TKL_SW_VV_UB 100.0 FORMULA_0942 0.0 100.0
 /begin AXIS_DESCR STD_AXIS toel FORMULA_0023 4 -50.0 170.0 MAX_GRAD 0.0 FORMAT "%4.1" /end AXIS_DESCR
/end CHARACTERISTIC
/begin CHARACTERISTIC KL_SMG_N_ZIEL_OFF_RAB "Offsetdrehzahl bei Radabriss" CURVE 0x79882 TKL_SW_VV_SW 100.0 FORMULA_0006 0.0 10000.0
 /begin AXIS_DESCR STD_AXIS m_k_1 FORMULA_0009 4 -100.0 1000.0 MAX_GRAD 0.0 FORMAT "%4.1" /end AXIS_DESCR
/end CHARACTERISTIC
/begin CHARACTERISTIC KL_SMG_N_ZIEL_OFF_ZR "Offset bei ZR" CURVE 0x79874 TKL_UW_VV_SW 100.0 FORMULA_0006 0.0 10000.0 /begin AXIS_DESCR STD_AXIS ki FORMULA_0010 3 0.0 65535.0 MAX_GRAD 0.0 /end AXIS_DESCR /end CHARACTERISTIC
/begin CHARACTERISTIC KL_SMG_PROG_AUTOMAT "Automat-Programme" CURVE 0x79640 TKL_UB_VV_UB 100.0 FORMULA_0003 0.0 8.0 /begin AXIS_DESCR STD_AXIS canP FORMULA_0003 6 0.0 6.0 MAX_GRAD 0.0 /end AXIS_DESCR /end CHARACTERISTIC
/begin CHARACTERISTIC KL_SMG_PROG_MANUELL "Manuelle Programme" CURVE 0x79632 TKL_UB_VV_UB 100.0 FORMULA_0003 0.0 8.0 /begin AXIS_DESCR STD_AXIS canP FORMULA_0003 6 0.0 6.0 MAX_GRAD 0.0 /end AXIS_DESCR /end CHARACTERISTIC
/begin CHARACTERISTIC KL_SMG_PROG_MAX_TOEL "maximales Programm ueber Toel" CURVE 0x798A6 TKL_SW_VV_UB 100.0 FORMULA_0946 1.0 12.0
 /begin AXIS_DESCR STD_AXIS toel FORMULA_0023 4 -50.0 170.0 MAX_GRAD 0.0 FORMAT "%4.1" /end AXIS_DESCR
/end CHARACTERISTIC
/begin CHARACTERISTIC KL_SMG_PROG_MIN_BERG "minimales Programm bei Steigung" CURVE 0x798B4 TKL_SW_VV_UB 100.0 FORMULA_0946 1.0 12.0
 /begin AXIS_DESCR STD_AXIS smg_ax_berg FORMULA_0123 4 -20.0 20.0 MAX_GRAD 0.0 FORMAT "%5.2" /end AXIS_DESCR
/end CHARACTERISTIC
/begin CHARACTERISTIC KL_SMG_SK_PROG_MAX "max. Programme bei SK-Begr" CURVE 0x7964E TKL_UB_VV_UB 100.0 FORMULA_0003 0.0 8.0 /begin AXIS_DESCR STD_AXIS sk_stufe FORMULA_0003 6 0.0 6.0 MAX_GRAD 0.0 /end AXIS_DESCR /end CHARACTERISTIC
/begin CHARACTERISTIC KL_SMG_T_KORR_AB "Faktor fuer Korrektur" CURVE 0x7965C TKL_UB_VV_UB 100.0 FORMULA_0913 0.0 199.2187042236328
 /begin AXIS_DESCR STD_AXIS rel_fw FORMULA_0913 6 0.0 199.2187042236328 MAX_GRAD 0.0 /end AXIS_DESCR
/end CHARACTERISTIC
/begin CHARACTERISTIC KL_TDME_NTC "Kennlinie Steuergeraetetemperatur" CURVE 0x7A206 TKL_SW_VV_SW 100.0 FORMULA_0975 -50.0 170.0 FORMAT "%6.3" /begin AXIS_DESCR STD_AXIS tdme_ad FORMULA_0114 8 0.0 1023.0 MAX_GRAD 0.0 /end AXIS_DESCR /end CHARACTERISTIC
/begin CHARACTERISTIC KL_TSGRW_F "Verhaeltnisfaktor" CURVE 0x7A624 TKL_SW_VV_UW 100.0 FORMULA_0024 0.0 1.999899983406067 FORMAT "%7.4"
 /begin AXIS_DESCR STD_AXIS tmot FORMULA_0023 4 -50.0 170.0 MAX_GRAD 0.0 FORMAT "%4.1" /end AXIS_DESCR
/end CHARACTERISTIC
/begin CHARACTERISTIC KL_TSGRW_OFFS "Kennlinie Offset" CURVE 0x7A60E TKL_SW_VV_SW 100.0 FORMULA_1017 -800.0 800.0 FORMAT "%6.3"
 /begin AXIS_DESCR STD_AXIS rf FORMULA_0007 5 0.0 2.0 MAX_GRAD 0.0 FORMAT "%6.3" /end AXIS_DESCR
/end CHARACTERISTIC
/begin CHARACTERISTIC S_SERVO_ABSCHALT "Testschalter Abschaltung Servotronic" VALUE 0x792E2 TKW_VV_VV_UB 100.0 FORMULA_0894 0.0 1.0 /end CHARACTERISTIC
/begin CHARACTERISTIC S_SERVO_KL "Umschalter Kennlinie" VALUE 0x792E1 TKW_VV_VV_UB 100.0 FORMULA_0893 0.0 1.0 /end CHARACTERISTIC
/begin AXIS_PTS AXIS_RF_KOR_MD_RF_PT_SOLL8 "Stuetzstellen ueber md_rf_soll fuer rf_kor" 0x78534 md_rf_pt TAD_UB_VV_SW 2.0 FORMULA_0007 8 0.0 2.0 FORMAT "%6.3" /end AXIS_PTS
/begin AXIS_PTS AXIS_RF_KOR_N_LW12 "Stuetzstellen ueber LW-Drehzahl fuer rf_kor" 0x7851A n_lw TAD_UB_VV_SW 10000.0 FORMULA_0006 12 0.0 10000.0 /end AXIS_PTS
/begin MEASUREMENT cfg_boot_st "Bootstaus" ULONG FORMULA_0000 0 0.0 0.0 4294967295.0 READ_WRITE ECU_ADDRESS 0x3F8010 /end MEASUREMENT
/begin MEASUREMENT j_fzg "Traegheitsmoment Fzg" UWORD FORMULA_0276 0 0.0 0.0 120.0 READ_WRITE ECU_ADDRESS 0x3FBB22 /end MEASUREMENT
/begin MEASUREMENT rf_kor_md_rf_soll_pt_sst8 "Gruppenkennfledstuetzstelle fuer md_rf_soll_pt" ULONG FORMULA_0000 0 0.0 0.0 4294967295.0 READ_WRITE ECU_ADDRESS 0x3FC2E0 /end MEASUREMENT
/begin MEASUREMENT rf_kor_n_lw_sst8 "SST" ULONG FORMULA_0000 0 0.0 0.0 4294967295.0 READ_WRITE ECU_ADDRESS 0x3FC2DC /end MEASUREMENT
/begin MEASUREMENT rf_kor_van_ist_b1 "Korrektur van_ist" UWORD FORMULA_0073 0 0.0 0.0 4.0 READ_WRITE ECU_ADDRESS 0x3FC310 /end MEASUREMENT
/begin MEASUREMENT rf_kor_van_ist_b2 "Korrektur van_ist" UWORD FORMULA_0073 0 0.0 0.0 4.0 READ_WRITE ECU_ADDRESS 0x3FC312 /end MEASUREMENT
/begin MEASUREMENT rf_kor_van_ist_roh_b1 "Korrekturfaktor van_ist" UWORD FORMULA_0073 0 0.0 0.0 4.0 READ_WRITE ECU_ADDRESS 0x3FC30C /end MEASUREMENT
/begin MEASUREMENT rf_kor_van_ist_roh_b2 "Korrekturfaktor van_ist" UWORD FORMULA_0073 0 0.0 0.0 4.0 READ_WRITE ECU_ADDRESS 0x3FC30E /end MEASUREMENT
/begin MEASUREMENT rf_kor_van_koe_a "Polynomkoeffizient rf_kor" FLOAT32_IEEE FORMULA_0044 0 0.0 -3.402823466385289e+038 3.402823466385289e+038 READ_WRITE ECU_ADDRESS 0x3FC2E4 /end MEASUREMENT
/begin MEASUREMENT rf_kor_van_koe_b "Polynomkoeffizient rf_kor" FLOAT32_IEEE FORMULA_0044 0 0.0 -3.402823466385289e+038 3.402823466385289e+038 READ_WRITE ECU_ADDRESS 0x3FC2E8 /end MEASUREMENT
/begin MEASUREMENT rf_kor_van_koe_c "Polynomkoeffizient rf_kor" FLOAT32_IEEE FORMULA_0044 0 0.0 -3.402823466385289e+038 3.402823466385289e+038 READ_WRITE ECU_ADDRESS 0x3FC2EC /end MEASUREMENT
/begin MEASUREMENT rf_kor_van_koe_d "Polynomkoeffizient rf_kor" FLOAT32_IEEE FORMULA_0044 0 0.0 -3.402823466385289e+038 3.402823466385289e+038 READ_WRITE ECU_ADDRESS 0x3FC2F0 /end MEASUREMENT
/begin MEASUREMENT rf_kor_van_koe_e "Polynomkoeffizient rf_kor" FLOAT32_IEEE FORMULA_0044 0 0.0 -3.402823466385289e+038 3.402823466385289e+038 READ_WRITE ECU_ADDRESS 0x3FC2F4 /end MEASUREMENT
/begin MEASUREMENT rf_kor_van_koe_f "Polynomkoeffizient rf_kor" FLOAT32_IEEE FORMULA_0044 0 0.0 -3.402823466385289e+038 3.402823466385289e+038 READ_WRITE ECU_ADDRESS 0x3FC2F8 /end MEASUREMENT
/begin MEASUREMENT rf_kor_van_koe_g "Polynomkoeffizient rf_kor" FLOAT32_IEEE FORMULA_0044 0 0.0 -3.402823466385289e+038 3.402823466385289e+038 READ_WRITE ECU_ADDRESS 0x3FC2FC /end MEASUREMENT
/begin MEASUREMENT rf_kor_van_koe_h "Polynomkoeffizient rf_kor" FLOAT32_IEEE FORMULA_0044 0 0.0 -3.402823466385289e+038 3.402823466385289e+038 READ_WRITE ECU_ADDRESS 0x3FC300 /end MEASUREMENT
/begin MEASUREMENT rf_kor_van_koe_i "Polynomkoeffizient rf_kor" FLOAT32_IEEE FORMULA_0044 0 0.0 -3.402823466385289e+038 3.402823466385289e+038 READ_WRITE ECU_ADDRESS 0x3FC304 /end MEASUREMENT
/begin MEASUREMENT rf_kor_van_soll "Korrektur van_soll" UWORD FORMULA_0073 0 0.0 0.0 4.0 READ_WRITE ECU_ADDRESS 0x3FC30A /end MEASUREMENT
/begin MEASUREMENT rf_kor_van_soll_roh "Korrekturfaktor van_soll" UWORD FORMULA_0073 0 0.0 0.0 4.0 READ_WRITE ECU_ADDRESS 0x3FC308 /end MEASUREMENT
/begin MEASUREMENT schalter_bls_ad_ign "Eingelesener Spannungswert Bremslichtschalter" SWORD FORMULA_0114 0 0.0 0.0 1023.0 READ_WRITE ECU_ADDRESS 0x3FC33E /end MEASUREMENT
/begin MEASUREMENT schalter_bls_entprell_cnt_e2 "Entprell-Zaehler fuer BLS E2" UBYTE FORMULA_0003 0 0.0 0.0 255.0 READ_WRITE ECU_ADDRESS 0x3FC8BE /end MEASUREMENT
/begin MEASUREMENT schalter_kl87_ad "Eingelesener Spannungswert Klemme 87" SWORD FORMULA_0114 0 0.0 0.0 1023.0 READ_WRITE ECU_ADDRESS 0x3FC340 /end MEASUREMENT
/begin MEASUREMENT schalter_st_ign_old "schalter_st_ign_old" UWORD FORMULA_0080 0 0.0 0.0 65535.0 READ_WRITE ARRAY_SIZE 2 ECU_ADDRESS 0x3FC338 MATRIX_DIM 2 1 1 /end MEASUREMENT
/begin MEASUREMENT schalter_wakeup_ad_ign "Eingelesener Spannungswert Wakeup" SWORD FORMULA_0114 0 0.0 0.0 1023.0 READ_WRITE ECU_ADDRESS 0x3FC33C /end MEASUREMENT
/begin MEASUREMENT servo_di "Regelabweichung" SWORD FORMULA_0886 0 0.0 -1023.0 1023.0 READ_WRITE ECU_ADDRESS 0x3FC354 /end MEASUREMENT
/begin MEASUREMENT servo_di_old "Alte Regelabweichung" SWORD FORMULA_0886 0 0.0 -1023.0 1023.0 READ_WRITE ECU_ADDRESS 0x3FC352 /end MEASUREMENT
/begin MEASUREMENT servo_kl_cfg "Konfiguration Kennlinie" UBYTE FORMULA_0885 0 0.0 0.0 255.0 READ_WRITE ECU_ADDRESS 0x3FC344 /end MEASUREMENT
/begin MEASUREMENT servo_s_cnt "Filter_Umschalt_CNT" UWORD FORMULA_0888 0 0.0 0.0 65535.0 READ_WRITE ECU_ADDRESS 0x3FC356 /end MEASUREMENT
/begin MEASUREMENT servo_strom_ist "Servo-Ventilstrom" UWORD FORMULA_0886 0 0.0 0.0 910.469970703125 READ_WRITE ECU_ADDRESS 0x3FC348 /end MEASUREMENT
/begin MEASUREMENT servo_strom_roh "Servo-Ventilstrom Rohwert" UWORD FORMULA_0886 0 0.0 0.0 910.469970703125 READ_WRITE ECU_ADDRESS 0x3FC346 /end MEASUREMENT
/begin MEASUREMENT servo_strom_soll "Sollwert Servo-Ventilstrom aus Kennlinie gefiltert" UWORD FORMULA_0886 0 0.0 0.0 910.469970703125 READ_WRITE ECU_ADDRESS 0x3FC34C /end MEASUREMENT
/begin MEASUREMENT servo_strom_soll_roh "Sollwert Servo-Ventilstrom aus Kennlinie" UWORD FORMULA_0886 0 0.0 0.0 910.469970703125 READ_WRITE ECU_ADDRESS 0x3FC34A /end MEASUREMENT
/begin MEASUREMENT servo_tast "Servo-Tastverhaeltnis" UWORD FORMULA_0887 0 0.0 0.0 100.0 READ_WRITE ECU_ADDRESS 0x3FC34E /end MEASUREMENT
/begin MEASUREMENT sk_e2_byte "Counter Byte-Komplement" UBYTE FORMULA_0003 0 0.0 0.0 255.0 READ_WRITE ECU_ADDRESS 0x3FC8BF /end MEASUREMENT
/begin MEASUREMENT sk_e2_byte_err "Fehler Byte-Komplement" UBYTE FORMULA_0003 0 0.0 0.0 255.0 READ_WRITE ECU_ADDRESS 0x3FC8C2 /end MEASUREMENT
/begin MEASUREMENT sk_e2_fehler "aktueller Ebene2-Fehler" UWORD FORMULA_0374 0 0.0 0.0 65535.0 READ_WRITE ECU_ADDRESS 0x3FE764 /end MEASUREMENT
/begin MEASUREMENT sk_e2_komp_err "Anzahl der Komplement-Fehler" UBYTE FORMULA_0003 0 0.0 0.0 255.0 READ_WRITE ECU_ADDRESS 0x3FC8C5 /end MEASUREMENT
/begin MEASUREMENT sk_e2_long "Counter Long-Komplement" UBYTE FORMULA_0003 0 0.0 0.0 255.0 READ_WRITE ECU_ADDRESS 0x3FC8C1 /end MEASUREMENT
/begin MEASUREMENT sk_e2_long_err "Fehler Long-Komplement" UBYTE FORMULA_0003 0 0.0 0.0 255.0 READ_WRITE ECU_ADDRESS 0x3FC8C4 /end MEASUREMENT
/begin MEASUREMENT sk_e2_word "Counter Word-Komplement" UBYTE FORMULA_0003 0 0.0 0.0 255.0 READ_WRITE ECU_ADDRESS 0x3FC8C0 /end MEASUREMENT
/begin MEASUREMENT sk_e2_word_err "Fehler Word-Komplement" UBYTE FORMULA_0003 0 0.0 0.0 255.0 READ_WRITE ECU_ADDRESS 0x3FC8C3 /end MEASUREMENT
/begin MEASUREMENT sk_egas_off_ni "SK-Egasstufe - no Init" UBYTE FORMULA_0167 0 0.0 0.0 255.0 READ_WRITE ECU_ADDRESS 0x3FE762 /end MEASUREMENT
/begin MEASUREMENT sk_egas_off_time_b1 "Zeit bis Egasabschaltung" UWORD FORMULA_0021 0 0.0 0.0 5.0 READ_WRITE ECU_ADDRESS 0x3FC368 /end MEASUREMENT
/begin MEASUREMENT sk_egas_off_time_b2 "Zeit bis Egasabschaltung" UWORD FORMULA_0021 0 0.0 0.0 5.0 READ_WRITE ECU_ADDRESS 0x3FC36A /end MEASUREMENT
/begin MEASUREMENT sk_fail_st_zyl "Zusammenfassung Ausblender" UWORD FORMULA_0179 0 0.0 0.0 65535.0 READ_WRITE ECU_ADDRESS 0x3FC358 /end MEASUREMENT
/begin MEASUREMENT sk_fm_egas_exd "Abschaltung ueber Exd" UBYTE FORMULA_0367 0 0.0 0.0 255.0 READ_WRITE ECU_ADDRESS 0x3FC35C /end MEASUREMENT
/begin MEASUREMENT sk_fm_gemisch "Eingang Gemisch-Matrix" UBYTE FORMULA_0167 0 0.0 0.0 255.0 READ_WRITE ECU_ADDRESS 0x3FC35A /end MEASUREMENT
/begin MEASUREMENT sk_fm_lam "Eingang LAM-Matrix" UBYTE FORMULA_0167 0 0.0 0.0 255.0 READ_WRITE ARRAY_SIZE 2 ECU_ADDRESS 0x3FC361 MATRIX_DIM 2 1 1 /end MEASUREMENT
/begin MEASUREMENT sk_fm_ti "Eingang TI-Matrix" UBYTE FORMULA_0167 0 0.0 0.0 255.0 READ_WRITE ECU_ADDRESS 0x3FC35B /end MEASUREMENT
/begin MEASUREMENT sk_llr_n_soll_ign "SK-Leerlaufdrehzahl" SWORD FORMULA_0006 0 0.0 0.0 10000.0 READ_WRITE ECU_ADDRESS 0x3FC372 /end MEASUREMENT
/begin MEASUREMENT sk_md_begr_ni "SK-Begrenzungsstufe - no Init" UBYTE FORMULA_0167 0 0.0 0.0 255.0 READ_WRITE ECU_ADDRESS 0x3FE761 /end MEASUREMENT
/begin MEASUREMENT sk_md_begr_st "Ausloeser MD-Begrenzung" UWORD FORMULA_0011 0 0.0 0.0 65535.0 READ_WRITE ECU_ADDRESS 0x3FC364 /end MEASUREMENT
/begin MEASUREMENT sk_reset_cnt "Resetzaehler seit Kl15 ein" UBYTE FORMULA_0003 0 0.0 0.0 10.0 READ_WRITE ECU_ADDRESS 0x3FE760 /end MEASUREMENT
/begin MEASUREMENT sk_reset_cnt_e2 "Resetzaehler Ebene 2" UBYTE FORMULA_0003 0 0.0 0.0 10.0 READ_WRITE ECU_ADDRESS 0x3FE766 /end MEASUREMENT
/begin MEASUREMENT sk_t_reset_delay_os "Timer fuer Verzoegerung sk_reset bei OS Fehlern" UWORD FORMULA_0021 0 0.0 0.0 655.0 READ_WRITE ECU_ADDRESS 0x3FC36E /end MEASUREMENT
/begin MEASUREMENT sk_ti_off_st "Ausloeser TI-Abschaltung" UWORD FORMULA_0011 0 0.0 0.0 65535.0 READ_WRITE ECU_ADDRESS 0x3FC366 /end MEASUREMENT
/begin MEASUREMENT sk_ti_zyl_off_cnt "Anzahl der Ausblender" UBYTE FORMULA_0003 0 0.0 0.0 12.0 READ_WRITE ECU_ADDRESS 0x3FC36C /end MEASUREMENT
/begin MEASUREMENT sk_tr_error_cnt "Fehlerzaehler Testrechnung" UBYTE FORMULA_0003 0 0.0 0.0 255.0 READ_WRITE ECU_ADDRESS 0x3FC360 /end MEASUREMENT
/begin MEASUREMENT sk_tr_retry "Retry-Counter" UBYTE FORMULA_0003 0 0.0 0.0 255.0 READ_WRITE ECU_ADDRESS 0x3FC370 /end MEASUREMENT
/begin MEASUREMENT sk_tr_timeout "Timeout - keine neue TR" UBYTE FORMULA_0306 0 0.0 0.0 2.549999952316284 READ_WRITE ECU_ADDRESS 0x3FC371 /end MEASUREMENT
/begin MEASUREMENT sk_ursache "Urache fuer SK-Eingriff" UWORD FORMULA_0011 0 0.0 0.0 65535.0 READ_WRITE ECU_ADDRESS 0x3FE75E /end MEASUREMENT
/begin MEASUREMENT sl_zwd_st "Status SL-ZWD " UBYTE FORMULA_0895 0 0.0 0.0 255.0 READ_WRITE ECU_ADDRESS 0x3FC374 /end MEASUREMENT
/begin MEASUREMENT sl_zwd_tv_tpu "TPU Tastverh. ZWD fuer SL" SWORD FORMULA_0142 0 0.0 0.0 100.0 READ_WRITE ECU_ADDRESS 0x3FC376 /end MEASUREMENT
/begin MEASUREMENT smg_abbruch_ges "Grund fuer Schaltabbruch - Summe" UBYTE FORMULA_0925 0 0.0 0.0 255.0 READ_WRITE ECU_ADDRESS 0x3FC43E /end MEASUREMENT
/begin MEASUREMENT smg_abbruch_grund "Grund fuer Schaltabbruch" UBYTE FORMULA_0925 0 0.0 0.0 255.0 READ_WRITE ECU_ADDRESS 0x3FC43D /end MEASUREMENT
/begin MEASUREMENT smg_adapt_ihar_cnt "Counter" UBYTE FORMULA_0003 0 0.0 0.0 255.0 READ_WRITE ECU_ADDRESS 0x3FC460 /end MEASUREMENT
/begin MEASUREMENT smg_adapt_ihar_sum "Summenzaehler" ULONG FORMULA_0000 0 0.0 0.0 4294967295.0 READ_WRITE ECU_ADDRESS 0x3FC45C /end MEASUREMENT
/begin MEASUREMENT smg_ax_filter "ax gefilter mit Vorzeichen" SWORD FORMULA_0123 0 0.0 -20.0 20.0 READ_WRITE ECU_ADDRESS 0x3FC444 /end MEASUREMENT
/begin MEASUREMENT smg_ay_zunahme "Zunahme ay" SWORD FORMULA_0123 0 0.0 -20.0 20.0 READ_WRITE ECU_ADDRESS 0x3FC3CC /end MEASUREMENT
/begin MEASUREMENT smg_bw_null "Bewertung Nulldurchgang" UBYTE FORMULA_0003 0 0.0 0.0 255.0 READ_WRITE ECU_ADDRESS 0x3FC43C /end MEASUREMENT
/begin MEASUREMENT smg_can_alive_smg1 "Alive SMG1" UBYTE FORMULA_0003 0 0.0 0.0 255.0 READ_WRITE ECU_ADDRESS 0x3FC467 /end MEASUREMENT
/begin MEASUREMENT smg_can_alive_smg1_cnt "Fehler Alivecounter" UBYTE FORMULA_0003 0 0.0 0.0 255.0 READ_WRITE ECU_ADDRESS 0x3FC476 /end MEASUREMENT
/begin MEASUREMENT smg_can_alive_smg2 "Alive SMG2" UBYTE FORMULA_0003 0 0.0 0.0 255.0 READ_WRITE ECU_ADDRESS 0x3FC468 /end MEASUREMENT
/begin MEASUREMENT smg_can_alive_smg2_cnt "Fehler Alivecounter" UBYTE FORMULA_0003 0 0.0 0.0 255.0 READ_WRITE ECU_ADDRESS 0x3FC478 /end MEASUREMENT
/begin MEASUREMENT smg_can_alive_smg3 "Alive SMG3" UBYTE FORMULA_0003 0 0.0 0.0 255.0 READ_WRITE ECU_ADDRESS 0x3FC469 /end MEASUREMENT
/begin MEASUREMENT smg_can_alive_smg3_cnt "Fehler Alivecounter" UBYTE FORMULA_0003 0 0.0 0.0 255.0 READ_WRITE ECU_ADDRESS 0x3FC47A /end MEASUREMENT
/begin MEASUREMENT smg_can_ax_mess "AX gemessen" SWORD FORMULA_0123 0 0.0 -20.0 20.0 READ_WRITE ECU_ADDRESS 0x3FC48E /end MEASUREMENT
/begin MEASUREMENT smg_can_chksum_smg1_cnt "Fehler Chksum" UBYTE FORMULA_0003 0 0.0 0.0 255.0 READ_WRITE ECU_ADDRESS 0x3FC477 /end MEASUREMENT
/begin MEASUREMENT smg_can_chksum_smg2_cnt "Fehler Chksum" UBYTE FORMULA_0003 0 0.0 0.0 255.0 READ_WRITE ECU_ADDRESS 0x3FC479 /end MEASUREMENT
/begin MEASUREMENT smg_can_chksum_smg3_cnt "Fehler Chksum" UBYTE FORMULA_0003 0 0.0 0.0 255.0 READ_WRITE ECU_ADDRESS 0x3FC47B /end MEASUREMENT
/begin MEASUREMENT smg_can_ed_tsperr "Diagnosesperrzeit" UWORD FORMULA_0109 0 0.0 0.0 325.0 READ_WRITE ECU_ADDRESS 0x3FC46A /end MEASUREMENT
/begin MEASUREMENT smg_can_empf_st "Empfangsstatus" UBYTE FORMULA_0949 0 0.0 0.0 255.0 READ_WRITE ECU_ADDRESS 0x3FC46C /end MEASUREMENT
/begin MEASUREMENT smg_can_empf_st_hys "Empfangsstatus im SG-Zyklus" UBYTE FORMULA_0949 0 0.0 0.0 255.0 READ_WRITE ECU_ADDRESS 0x3FC46D /end MEASUREMENT
/begin MEASUREMENT smg_can_getr_st "Getriebestatus" UBYTE FORMULA_0427 0 0.0 0.0 255.0 READ_WRITE ECU_ADDRESS 0x3FC487 /end MEASUREMENT
/begin MEASUREMENT smg_can_istgang "Istgang" SBYTE FORMULA_0135 0 0.0 -1.0 10.0 READ_WRITE ECU_ADDRESS 0x3FC484 /end MEASUREMENT
/begin MEASUREMENT smg_can_kupp_st "Kupplungsstatus" UBYTE FORMULA_0426 0 0.0 0.0 255.0 READ_WRITE ECU_ADDRESS 0x3FC486 /end MEASUREMENT
/begin MEASUREMENT smg_can_m_kupp_ist "Kupplungsistmoment" UBYTE FORMULA_0914 0 0.0 0.0 99.60929870605469 READ_WRITE ECU_ADDRESS 0x3FC48A /end MEASUREMENT
/begin MEASUREMENT smg_can_m_kupp_ist_abs "absolutes Kupplungsmoment" SWORD FORMULA_0009 0 0.0 -100.0 1000.0 READ_WRITE ECU_ADDRESS 0x3FC48C /end MEASUREMENT
/begin MEASUREMENT smg_can_m_kupp_max "Kupplungsmaximalmoment" SWORD FORMULA_0009 0 0.0 -100.0 1000.0 READ_WRITE ECU_ADDRESS 0x3FC488 /end MEASUREMENT
/begin MEASUREMENT smg_can_n_anfahr "Anfahrdrehzahl" SWORD FORMULA_0006 0 0.0 0.0 10000.0 READ_WRITE ECU_ADDRESS 0x3FC480 /end MEASUREMENT
/begin MEASUREMENT smg_can_n_getr_ziel_roh "Zieldrehzahl ungefiltert" SWORD FORMULA_0006 0 0.0 0.0 10000.0 READ_WRITE ECU_ADDRESS 0x3FC47E /end MEASUREMENT
/begin MEASUREMENT smg_can_pos_kupp_ist "Kupplungsposition" UBYTE FORMULA_0425 0 0.0 0.0 1020.0 READ_WRITE ECU_ADDRESS 0x3FC491 /end MEASUREMENT
/begin MEASUREMENT smg_can_r_testmode "Rueckgabe Testmode" UBYTE FORMULA_0955 0 0.0 0.0 255.0 READ_WRITE ECU_ADDRESS 0x3FC493 /end MEASUREMENT
/begin MEASUREMENT smg_can_s_fgr "FGR-Schalter" UBYTE FORMULA_0952 0 0 0.0 255.0 READ_WRITE BIT_MASK 0x4 ECU_ADDRESS 0x3FC47C /end MEASUREMENT
/begin MEASUREMENT smg_can_s_he "HE-Schalter" UBYTE FORMULA_0953 0 0 0.0 255.0 READ_WRITE BIT_MASK 0x8 ECU_ADDRESS 0x3FC47C /end MEASUREMENT
/begin MEASUREMENT smg_can_s_krafts "Kraftschlusstatus" UBYTE FORMULA_0951 0 0 0.0 255.0 READ_WRITE BIT_MASK 0x2 ECU_ADDRESS 0x3FC47C /end MEASUREMENT
/begin MEASUREMENT smg_can_s_schalt "Schaltwunsch" UBYTE FORMULA_0950 0 0 0.0 255.0 READ_WRITE BIT_MASK 0x1 ECU_ADDRESS 0x3FC47C /end MEASUREMENT
/begin MEASUREMENT smg_can_schalter "CAN-Schalter" UBYTE FORMULA_0003 0 0.0 0.0 255.0 READ_WRITE ECU_ADDRESS 0x3FC47C /end MEASUREMENT
/begin MEASUREMENT smg_can_st_smg "Empfangsstatus SMG" UWORD FORMULA_0116 0 0.0 0.0 65535.0 READ_WRITE ECU_ADDRESS 0x3FC46E /end MEASUREMENT
/begin MEASUREMENT smg_can_st_smg1 "Empfangsstatus SMG1" UWORD FORMULA_0116 0 0.0 0.0 65535.0 READ_WRITE ECU_ADDRESS 0x3FC470 /end MEASUREMENT
/begin MEASUREMENT smg_can_st_smg2 "Empfangsstatus SMG2" UWORD FORMULA_0116 0 0.0 0.0 65535.0 READ_WRITE ECU_ADDRESS 0x3FC472 /end MEASUREMENT
/begin MEASUREMENT smg_can_st_smg3 "Empfangsstatus SMG3" UWORD FORMULA_0116 0 0.0 0.0 65535.0 READ_WRITE ECU_ADDRESS 0x3FC474 /end MEASUREMENT
/begin MEASUREMENT smg_can_t_rest_ekr "Restzeit bis Start Einkuppelrampe" UBYTE FORMULA_0306 0 0.0 0.0 2.549999952316284 READ_WRITE ECU_ADDRESS 0x3FC483 /end MEASUREMENT
/begin MEASUREMENT smg_can_t_rest_se "Restzeit bis Synchro-Ende" UBYTE FORMULA_0306 0 0.0 0.0 2.549999952316284 READ_WRITE ECU_ADDRESS 0x3FC482 /end MEASUREMENT
/begin MEASUREMENT smg_can_testmode "Vorgabe Testmode" UBYTE FORMULA_0955 0 0.0 0.0 255.0 READ_WRITE ECU_ADDRESS 0x3FC492 /end MEASUREMENT
/begin MEASUREMENT smg_can_v_diff "Achsdifferenz" SBYTE FORMULA_0954 0 0.0 -7.900000095367432 7.900000095367432 READ_WRITE ECU_ADDRESS 0x3FC490 /end MEASUREMENT
/begin MEASUREMENT smg_can_zielgang "Zielgang" SBYTE FORMULA_0135 0 0.0 -1.0 10.0 READ_WRITE ECU_ADDRESS 0x3FC485 /end MEASUREMENT
/begin MEASUREMENT smg_dn_filter "gefilt. Drehzahlgradient" SWORD FORMULA_0105 0 0.0 -5000.0 5000.0 READ_WRITE ECU_ADDRESS 0x3FC3B4 /end MEASUREMENT
/begin MEASUREMENT smg_dn_getr_ein_fil "gefilt. Drehzahl am Getriebeeingang" SWORD FORMULA_0105 0 0.0 -10000.0 10000.0 READ_WRITE ECU_ADDRESS 0x3FC3C8 /end MEASUREMENT
/begin MEASUREMENT smg_dn_mot_getr "Gradient Motor/Getriebe" SWORD FORMULA_0105 0 0.0 -10000.0 10000.0 READ_WRITE ECU_ADDRESS 0x3FC3CA /end MEASUREMENT
/begin MEASUREMENT smg_e2_fehler "Fehlerstatus Ebene 2" UBYTE FORMULA_0956 0 0.0 0.0 255.0 READ_WRITE ECU_ADDRESS 0x3FC8E0 /end MEASUREMENT
/begin MEASUREMENT smg_flags_e2 "diverse Flags Ebene 2" UBYTE FORMULA_0003 0 0.0 0.0 255.0 READ_WRITE ECU_ADDRESS 0x3FC8E7 /end MEASUREMENT
/begin MEASUREMENT smg_flags_e2.ekr "EKR-Freigabe" UBYTE FORMULA_0959 0 0 0.0 255.0 READ_WRITE BIT_MASK 0x2 ECU_ADDRESS 0x3FC8E7 /end MEASUREMENT
/begin MEASUREMENT smg_flags_e2.zs "ZugSchubschaltung" UBYTE FORMULA_0958 0 0 0.0 255.0 READ_WRITE BIT_MASK 0x1 ECU_ADDRESS 0x3FC8E7 /end MEASUREMENT
/begin MEASUREMENT smg_fw_rel_virt "Virtueller Fahrerwunsch" UBYTE FORMULA_0757 0 0.0 0.0 1.99210000038147 READ_WRITE ECU_ADDRESS 0x3FC3A4 /end MEASUREMENT
/begin MEASUREMENT smg_gang_e2_err "Anzahl der Vergleichs-Fehler" UBYTE FORMULA_0003 0 0.0 0.0 255.0 READ_WRITE ECU_ADDRESS 0x3FC8E6 /end MEASUREMENT
/begin MEASUREMENT smg_ki_ab "Abregel-Kennung" UBYTE FORMULA_0003 0 0.0 0.0 255.0 READ_WRITE ECU_ADDRESS 0x3FC3B7 /end MEASUREMENT
/begin MEASUREMENT smg_ki_auf "Aufregel-Kennung" UBYTE FORMULA_0003 0 0.0 0.0 255.0 READ_WRITE ECU_ADDRESS 0x3FC3B9 /end MEASUREMENT
/begin MEASUREMENT smg_ki_auf_t_eingr "Zeitzaehler fuer DSC beim Aufregeln" UWORD FORMULA_0021 0 0.0 0.0 655.0 READ_WRITE ECU_ADDRESS 0x3FC44A /end MEASUREMENT
/begin MEASUREMENT smg_ki_scha "Schalt-Kennung" UBYTE FORMULA_0003 0 0.0 0.0 255.0 READ_WRITE ECU_ADDRESS 0x3FC3B8 /end MEASUREMENT
/begin MEASUREMENT smg_kschlupf "Kupplungsschlupf" SWORD FORMULA_0904 0 0.0 -100.0 100.0 READ_WRITE ECU_ADDRESS 0x3FC3BC /end MEASUREMENT
/begin MEASUREMENT smg_kschlupf_st "Kupplungsschlupf-Status" UBYTE FORMULA_0903 0 0.0 0.0 255.0 READ_WRITE ECU_ADDRESS 0x3FC3BB /end MEASUREMENT
/begin MEASUREMENT smg_kupp_array "Arraykennung" UBYTE FORMULA_0003 0 0.0 0.0 255.0 READ_WRITE ECU_ADDRESS 0x3FC3DD /end MEASUREMENT
/begin MEASUREMENT smg_kupp_dm_soll "Kupplungsgradient" SWORD FORMULA_0562 0 0.0 -5000.0 5000.0 READ_WRITE ECU_ADDRESS 0x3FC3DE /end MEASUREMENT
/begin MEASUREMENT smg_kupp_dn_soll "Soll-Drehzahlgradient" SWORD FORMULA_0105 0 0.0 -5000.0 5000.0 READ_WRITE ECU_ADDRESS 0x3FC3F0 /end MEASUREMENT
/begin MEASUREMENT smg_kupp_dn_soll_roh "Soll-Drehzahlgradient (Roh)" SWORD FORMULA_0105 0 0.0 -5000.0 5000.0 READ_WRITE ECU_ADDRESS 0x3FC3EE /end MEASUREMENT
/begin MEASUREMENT smg_kupp_flags "Kupplung-Flags" UBYTE FORMULA_0003 0 0.0 0.0 255.0 READ_WRITE ECU_ADDRESS 0x3FC3CF /end MEASUREMENT
/begin MEASUREMENT smg_kupp_flags_abs "RAB mit ABS-Eingriff" UBYTE FORMULA_0907 0 0 0.0 255.0 READ_WRITE BIT_MASK 0x4 ECU_ADDRESS 0x3FC3CF /end MEASUREMENT
/begin MEASUREMENT smg_kupp_flags_adapt "Adaptionssperre" UBYTE FORMULA_0906 0 0 0.0 255.0 READ_WRITE BIT_MASK 0x2 ECU_ADDRESS 0x3FC3CF /end MEASUREMENT
/begin MEASUREMENT smg_kupp_flags_anf "Schaltung nach Anfahren" UBYTE FORMULA_0912 0 0 0.0 255.0 READ_WRITE BIT_MASK 0x80 ECU_ADDRESS 0x3FC3CF /end MEASUREMENT
/begin MEASUREMENT smg_kupp_flags_dn "Status dn-Soll" UBYTE FORMULA_0909 0 0 0.0 255.0 READ_WRITE BIT_MASK 0x10 ECU_ADDRESS 0x3FC3CF /end MEASUREMENT
/begin MEASUREMENT smg_kupp_flags_ekr "Begrenzung Ekr-Schwelle" UBYTE FORMULA_0911 0 0 0.0 255.0 READ_WRITE BIT_MASK 0x40 ECU_ADDRESS 0x3FC3CF /end MEASUREMENT
/begin MEASUREMENT smg_kupp_flags_ks "Kupplungsschutz" UBYTE FORMULA_0908 0 0 0.0 255.0 READ_WRITE BIT_MASK 0x8 ECU_ADDRESS 0x3FC3CF /end MEASUREMENT
/begin MEASUREMENT smg_kupp_flags_schw "Drehzahlschwinger beim Aufregeln" UBYTE FORMULA_0910 0 0 0.0 255.0 READ_WRITE BIT_MASK 0x20 ECU_ADDRESS 0x3FC3CF /end MEASUREMENT
/begin MEASUREMENT smg_kupp_m_20 "Kupplungssollmomente" UBYTE FORMULA_0914 0 0.0 0.0 99.60929870605469 READ_WRITE ECU_ADDRESS 0x3FC3D8 /end MEASUREMENT
/begin MEASUREMENT smg_kupp_m_40 "Kupplungssollmomente" UBYTE FORMULA_0914 0 0.0 0.0 99.60929870605469 READ_WRITE ECU_ADDRESS 0x3FC3D9 /end MEASUREMENT
/begin MEASUREMENT smg_kupp_m_60 "Kupplungssollmomente" UBYTE FORMULA_0914 0 0.0 0.0 99.60929870605469 READ_WRITE ECU_ADDRESS 0x3FC3DA /end MEASUREMENT
/begin MEASUREMENT smg_kupp_m_80 "Kupplungssollmomente" UBYTE FORMULA_0914 0 0.0 0.0 99.60929870605469 READ_WRITE ECU_ADDRESS 0x3FC3DB /end MEASUREMENT
/begin MEASUREMENT smg_kupp_m_end "Kupplungsendmoment" UBYTE FORMULA_0914 0 0.0 0.0 99.60929870605469 READ_WRITE ECU_ADDRESS 0x3FC3DC /end MEASUREMENT
/begin MEASUREMENT smg_kupp_m_ist_0 "Kupplungsmoment bei Abregelstart" UBYTE FORMULA_0914 0 0.0 0.0 99.60929870605469 READ_WRITE ECU_ADDRESS 0x3FC3D7 /end MEASUREMENT
/begin MEASUREMENT smg_kupp_m_lw_start "Moment beim Lastwechsel" SWORD FORMULA_0009 0 0.0 -100.0 1000.0 READ_WRITE ECU_ADDRESS 0x3FC3F4 /end MEASUREMENT
/begin MEASUREMENT smg_kupp_m_off_ab "Offset auf Fahrerwunsch beim Abregeln" SWORD FORMULA_0009 0 0.0 -100.0 1000.0 READ_WRITE ECU_ADDRESS 0x3FC3EA /end MEASUREMENT
/begin MEASUREMENT smg_kupp_m_rab_start "Moment bei Ausloesung Radabriss" SWORD FORMULA_0009 0 0.0 -100.0 1000.0 READ_WRITE ECU_ADDRESS 0x3FC3F2 /end MEASUREMENT
/begin MEASUREMENT smg_kupp_m_rel_fw "Kupplungssollmoment bzgl. Fahrerwunsch" UBYTE FORMULA_0913 0 0.0 0.0 199.2187042236328 READ_WRITE ECU_ADDRESS 0x3FC3D0 /end MEASUREMENT
/begin MEASUREMENT smg_kupp_m_soll "relatives Kupplungssollmoment" UBYTE FORMULA_0914 0 0.0 0.0 99.60929870605469 READ_WRITE ECU_ADDRESS 0x3FC3D6 /end MEASUREMENT
/begin MEASUREMENT smg_kupp_m_soll_abs "absolutes Kupplungssollmoment" SWORD FORMULA_0009 0 0.0 -100.0 1000.0 READ_WRITE ECU_ADDRESS 0x3FC3D4 /end MEASUREMENT
/begin MEASUREMENT smg_kupp_m_soll_rampe "Kupplungsrampe" ULONG FORMULA_0916 0 0.0 0.0 100.0 READ_WRITE ECU_ADDRESS 0x3FC3E4 /end MEASUREMENT
/begin MEASUREMENT smg_kupp_m_soll_regler "Kupplungsregler" SLONG FORMULA_0915 0 0.0 -200.0 600.0 READ_WRITE ECU_ADDRESS 0x3FC3E0 /end MEASUREMENT
/begin MEASUREMENT smg_kupp_m_voraus "Vorausschau Kupplungssollmoment" UBYTE FORMULA_0913 0 0.0 0.0 199.2187042236328 READ_WRITE ECU_ADDRESS 0x3FC3D1 /end MEASUREMENT
/begin MEASUREMENT smg_kupp_modul "Kupplungs-Modul" UBYTE FORMULA_0905 0 0.0 0.0 255.0 READ_WRITE ECU_ADDRESS 0x3FC3CE /end MEASUREMENT
/begin MEASUREMENT smg_kupp_t_dn_null "Zeit mit konst. Drehzahl" UBYTE FORMULA_0306 0 0.0 0.0 2.549999952316284 READ_WRITE ECU_ADDRESS 0x3FC3E8 /end MEASUREMENT
/begin MEASUREMENT smg_kupp_t_rest "Restzeit bis Kupplungsendmoment" UBYTE FORMULA_0306 0 0.0 0.0 2.549999952316284 READ_WRITE ECU_ADDRESS 0x3FC3D2 /end MEASUREMENT
/begin MEASUREMENT smg_kupp_ul_fw_red "Reduktionsrampe bei Ueberlast" SWORD FORMULA_0009 0 0.0 -100.0 1000.0 READ_WRITE ECU_ADDRESS 0x3FC3F6 /end MEASUREMENT
/begin MEASUREMENT smg_kupp_ul_st "Ueberlaststatus" UBYTE FORMULA_0917 0 0.0 0.0 255.0 READ_WRITE ECU_ADDRESS 0x3FC3F8 /end MEASUREMENT
/begin MEASUREMENT smg_m_kupp_ist_ga "Kupplungs-Moment am Getriebeausgang" SWORD FORMULA_0794 0 0.0 -1000.0 4000.0 READ_WRITE ECU_ADDRESS 0x3FC442 /end MEASUREMENT
/begin MEASUREMENT smg_md_dsc_abs "Betrag der DSC-Anforderung" SWORD FORMULA_0009 0 0.0 -100.0 1000.0 READ_WRITE ECU_ADDRESS 0x3FC3AA /end MEASUREMENT
/begin MEASUREMENT smg_md_fahrer_ab "Wunschmoment fuers Abregeln" SWORD FORMULA_0009 0 0.0 -100.0 1000.0 READ_WRITE ECU_ADDRESS 0x3FC3A6 /end MEASUREMENT
/begin MEASUREMENT smg_md_fahrer_auf "Wunschmoment fuers Aufregeln" SWORD FORMULA_0009 0 0.0 -100.0 1000.0 READ_WRITE ECU_ADDRESS 0x3FC3A8 /end MEASUREMENT
/begin MEASUREMENT smg_md_kw_ga "Motor-Moment am Getriebeausgang" SWORD FORMULA_0794 0 0.0 -1000.0 4000.0 READ_WRITE ECU_ADDRESS 0x3FC440 /end MEASUREMENT
/begin MEASUREMENT smg_mot_dm_soll "Soll-Gradient fuer TZ-Nachlauf" SWORD FORMULA_0562 0 0.0 -5000.0 5000.0 READ_WRITE ECU_ADDRESS 0x3FC42C /end MEASUREMENT
/begin MEASUREMENT smg_mot_flags "Motor-Flags" UBYTE FORMULA_0003 0 0.0 0.0 255.0 READ_WRITE ECU_ADDRESS 0x3FC3FA /end MEASUREMENT
/begin MEASUREMENT smg_mot_flags_begr "Begrenzung auf FW" UBYTE FORMULA_0907 0 0 0.0 255.0 READ_WRITE BIT_MASK 0x4 ECU_ADDRESS 0x3FC3FA /end MEASUREMENT
/begin MEASUREMENT smg_mot_flags_nll "Drehzahlniveau bzgl. nLL" UBYTE FORMULA_0920 0 0 0.0 255.0 READ_WRITE BIT_MASK 0x2 ECU_ADDRESS 0x3FC3FA /end MEASUREMENT
/begin MEASUREMENT smg_mot_flags_nziel "Motor-Flags" UBYTE FORMULA_0919 0 0 0.0 255.0 READ_WRITE BIT_MASK 0x1 ECU_ADDRESS 0x3FC3FA /end MEASUREMENT
/begin MEASUREMENT smg_mot_j_motor "Faktor fuer Vorst 2" UBYTE FORMULA_0926 0 0.0 0.0 1.99210000038147 READ_WRITE ECU_ADDRESS 0x3FC43F /end MEASUREMENT
/begin MEASUREMENT smg_mot_m_begr_max "max. Motorsollmoment" SWORD FORMULA_0009 0 0.0 -100.0 1000.0 READ_WRITE ECU_ADDRESS 0x3FC430 /end MEASUREMENT
/begin MEASUREMENT smg_mot_m_begr_min "min. Motorsollmoment" SWORD FORMULA_0009 0 0.0 -100.0 1000.0 READ_WRITE ECU_ADDRESS 0x3FC42E /end MEASUREMENT
/begin MEASUREMENT smg_mot_m_res "Momentenreserve" SWORD FORMULA_0009 0 0.0 -100.0 1000.0 READ_WRITE ECU_ADDRESS 0x3FC406 /end MEASUREMENT
/begin MEASUREMENT smg_mot_m_res_pos "min. pos. Momentenreserve" SWORD FORMULA_0009 0 0.0 -100.0 1000.0 READ_WRITE ECU_ADDRESS 0x3FC436 /end MEASUREMENT
/begin MEASUREMENT smg_mot_m_res_time "Timer Momentenreserve" UWORD FORMULA_0109 0 0.0 0.0 325.0 READ_WRITE ECU_ADDRESS 0x3FC408 /end MEASUREMENT
/begin MEASUREMENT smg_mot_m_soll "Motorsollmoment" SWORD FORMULA_0009 0 0.0 -100.0 1000.0 READ_WRITE ECU_ADDRESS 0x3FC3FE /end MEASUREMENT
/begin MEASUREMENT smg_mot_m_soll_dA "D-Anteil Drehzahlregler" SLONG FORMULA_0921 0 0.0 -200.0 600.0 READ_WRITE ECU_ADDRESS 0x3FC418 /end MEASUREMENT
/begin MEASUREMENT smg_mot_m_soll_dk "DK-Motorsollmoment" SWORD FORMULA_0009 0 0.0 -100.0 1000.0 READ_WRITE ECU_ADDRESS 0x3FC404 /end MEASUREMENT
/begin MEASUREMENT smg_mot_m_soll_iA "I-Anteil Drehzahlregler" SLONG FORMULA_0916 0 0.0 -200.0 600.0 READ_WRITE ECU_ADDRESS 0x3FC410 /end MEASUREMENT
/begin MEASUREMENT smg_mot_m_soll_iA_2 "I-Anteil Gradientenregler" SLONG FORMULA_0915 0 0.0 -200.0 600.0 READ_WRITE ECU_ADDRESS 0x3FC414 /end MEASUREMENT
/begin MEASUREMENT smg_mot_m_soll_pA "P-Anteil Drehzahlregler" SLONG FORMULA_0921 0 0.0 -200.0 600.0 READ_WRITE ECU_ADDRESS 0x3FC40C /end MEASUREMENT
/begin MEASUREMENT smg_mot_m_soll_regler "Regleranteil" SWORD FORMULA_0009 0 0.0 -100.0 1000.0 READ_WRITE ECU_ADDRESS 0x3FC428 /end MEASUREMENT
/begin MEASUREMENT smg_mot_m_soll_rel "relatives Motorsollmoment" SWORD FORMULA_0896 0 0.0 -25600.0 25599.21875 READ_WRITE ECU_ADDRESS 0x3FC3FC /end MEASUREMENT
/begin MEASUREMENT smg_mot_m_soll_stg "Stoergroessenaufschaltung" SWORD FORMULA_0009 0 0.0 -100.0 1000.0 READ_WRITE ECU_ADDRESS 0x3FC432 /end MEASUREMENT
/begin MEASUREMENT smg_mot_m_soll_tz "TZ-Motorsollmoment" SWORD FORMULA_0009 0 0.0 -100.0 1000.0 READ_WRITE ECU_ADDRESS 0x3FC402 /end MEASUREMENT
/begin MEASUREMENT smg_mot_m_soll_vor_1 "Rampe auf Fahrerwunsch" SWORD FORMULA_0009 0 0.0 -100.0 1000.0 READ_WRITE ECU_ADDRESS 0x3FC424 /end MEASUREMENT
/begin MEASUREMENT smg_mot_m_soll_vor_2 "Anteil aus Gradient und Traegheit" SWORD FORMULA_0009 0 0.0 -100.0 1000.0 READ_WRITE ECU_ADDRESS 0x3FC426 /end MEASUREMENT
/begin MEASUREMENT smg_mot_m_soll_voraus "Motorsollmoment DK-Rohwert" SWORD FORMULA_0009 0 0.0 -100.0 1000.0 READ_WRITE ECU_ADDRESS 0x3FC400 /end MEASUREMENT
/begin MEASUREMENT smg_mot_modul "Motor-Modul" UBYTE FORMULA_0918 0 0.0 0.0 255.0 READ_WRITE ECU_ADDRESS 0x3FC3F9 /end MEASUREMENT
/begin MEASUREMENT smg_mot_n_ekr_schw "EKR-Schwelle" SWORD FORMULA_0006 0 0.0 0.0 10000.0 READ_WRITE ECU_ADDRESS 0x3FC41E /end MEASUREMENT
/begin MEASUREMENT smg_mot_n_offset "Offset auf Zieldrehzahl" SWORD FORMULA_0006 0 0.0 -3000.0 3000.0 READ_WRITE ECU_ADDRESS 0x3FC420 /end MEASUREMENT
/begin MEASUREMENT smg_mot_n_reg_st "Status Drehzahlreglers" UBYTE FORMULA_0922 0 0.0 0.0 255.0 READ_WRITE ECU_ADDRESS 0x3FC422 /end MEASUREMENT
/begin MEASUREMENT smg_mot_n_soll "Solldrehzahl" SWORD FORMULA_0006 0 0.0 0.0 10000.0 READ_WRITE ECU_ADDRESS 0x3FC41C /end MEASUREMENT
/begin MEASUREMENT smg_mot_n_ziel_off "Faktor fuer Schubzieldrehzahl" UBYTE FORMULA_0923 0 0.0 0.0 199.2187042236328 READ_WRITE ECU_ADDRESS 0x3FC423 /end MEASUREMENT
/begin MEASUREMENT smg_mot_t_regler "Regler-Zeit" UWORD FORMULA_0109 0 0.0 0.0 325.0 READ_WRITE ECU_ADDRESS 0x3FC434 /end MEASUREMENT
/begin MEASUREMENT smg_mot_tz_nachl_e2 "Zeit TZ-Nachlauf Ebene 2" UWORD FORMULA_0109 0 0.0 0.0 325.0 READ_WRITE ECU_ADDRESS 0x3FC8E8 /end MEASUREMENT
/begin MEASUREMENT smg_mot_tz_nachlauf "TZ-Nachlaufzeit" UWORD FORMULA_0109 0 0.0 0.0 325.0 READ_WRITE ECU_ADDRESS 0x3FC42A /end MEASUREMENT
/begin MEASUREMENT smg_n_abriss "Abrissdrehzahl" SWORD FORMULA_0006 0 0.0 0.0 10000.0 READ_WRITE ECU_ADDRESS 0x3FC446 /end MEASUREMENT
/begin MEASUREMENT smg_n_abriss_schw "Abriss-Schwelle" SWORD FORMULA_0006 0 0.0 0.0 10000.0 READ_WRITE ECU_ADDRESS 0x3FC448 /end MEASUREMENT
/begin MEASUREMENT smg_n_diff_getr "Differenz Getriebe - Motor" SWORD FORMULA_0006 0 0.0 0.0 10000.0 READ_WRITE ECU_ADDRESS 0x3FC3AC /end MEASUREMENT
/begin MEASUREMENT smg_n_diff_ziel "Differenz Getriebeziel - Motor" SWORD FORMULA_0006 0 0.0 0.0 10000.0 READ_WRITE ECU_ADDRESS 0x3FC3B0 /end MEASUREMENT
/begin MEASUREMENT smg_n_getr_ein "gerechnete Drehzahl am Getriebeeingang" SWORD FORMULA_0006 0 0.0 0.0 10000.0 READ_WRITE ECU_ADDRESS 0x3FC3C4 /end MEASUREMENT
/begin MEASUREMENT smg_n_getr_ziel "gerechnete Ziel-Drehzahl am Getriebeeingang" SWORD FORMULA_0006 0 0.0 0.0 10000.0 READ_WRITE ECU_ADDRESS 0x3FC3C6 /end MEASUREMENT
/begin MEASUREMENT smg_ngetr_e2_err "Anzahl der Vergleichs-Fehler" UBYTE FORMULA_0003 0 0.0 0.0 255.0 READ_WRITE ECU_ADDRESS 0x3FC8E5 /end MEASUREMENT
/begin MEASUREMENT smg_old.flags "diverse Bits" UBYTE FORMULA_0003 0 0.0 0.0 255.0 READ_WRITE ECU_ADDRESS 0x3FC39A /end MEASUREMENT
/begin MEASUREMENT smg_old.flags_anf "Anfahren aus Schalten" UBYTE FORMULA_0899 0 0 0.0 255.0 READ_WRITE BIT_MASK 0x40 ECU_ADDRESS 0x3FC39A /end MEASUREMENT
/begin MEASUREMENT smg_old.flags_nl "NL ueber Rampe" UBYTE FORMULA_0898 0 0 0.0 255.0 READ_WRITE BIT_MASK 0x8 ECU_ADDRESS 0x3FC39A /end MEASUREMENT
/begin MEASUREMENT smg_old.flags_sa "Ausblendfreigabe" UBYTE FORMULA_0897 0 0 0.0 255.0 READ_WRITE BIT_MASK 0x1 ECU_ADDRESS 0x3FC39A /end MEASUREMENT
/begin MEASUREMENT smg_old.modul "Modulstatus - gesichert" UBYTE FORMULA_0900 0 0.0 0.0 255.0 READ_WRITE ECU_ADDRESS 0x3FC394 /end MEASUREMENT
/begin MEASUREMENT smg_old.schaltart "Schaltart - gesichert" UWORD FORMULA_0010 0 0.0 0.0 65535.0 READ_WRITE ECU_ADDRESS 0x3FC39E /end MEASUREMENT
/begin MEASUREMENT smg_old.t_korr "Verkuerzung der Abregelzeit" UWORD FORMULA_0896 0 0.0 0.0 100.0 READ_WRITE ECU_ADDRESS 0x3FC38E /end MEASUREMENT
/begin MEASUREMENT smg_prog_info_intern "internes Programm" UBYTE FORMULA_0263 0 0.0 1.0 255.0 READ_WRITE ECU_ADDRESS 0x3FC3C3 /end MEASUREMENT
/begin MEASUREMENT smg_prog_max_sk "SK-Programmbegrenzung" UBYTE FORMULA_0263 0 0.0 1.0 255.0 READ_WRITE ECU_ADDRESS 0x3FC3C1 /end MEASUREMENT
/begin MEASUREMENT smg_prog_max_toel "Toel-Programmbegrenzung" UBYTE FORMULA_0263 0 0.0 1.0 255.0 READ_WRITE ECU_ADDRESS 0x3FC3C0 /end MEASUREMENT
/begin MEASUREMENT smg_prog_min_berg "Programmanhebung am Berg" UBYTE FORMULA_0263 0 0.0 1.0 255.0 READ_WRITE ECU_ADDRESS 0x3FC3C2 /end MEASUREMENT
/begin MEASUREMENT smg_radschlupf "Radschlupf" SWORD FORMULA_0904 0 0.0 -100.0 100.0 READ_WRITE ECU_ADDRESS 0x3FC3BE /end MEASUREMENT
/begin MEASUREMENT smg_schaltart_lw_cnt "Lastwechsel-Zähler" UBYTE FORMULA_0003 0 0.0 0.0 255.0 READ_WRITE ECU_ADDRESS 0x3FC3B6 /end MEASUREMENT
/begin MEASUREMENT smg_sk_flags "SK-Fehler" UWORD FORMULA_0927 0 0.0 0.0 65535.0 READ_WRITE ECU_ADDRESS 0x3FC44E /end MEASUREMENT
/begin MEASUREMENT smg_sk_t_dme_st "Ueberwachung DME-Status" UBYTE FORMULA_0306 0 0.0 0.0 2.549999952316284 READ_WRITE ECU_ADDRESS 0x3FC450 /end MEASUREMENT
/begin MEASUREMENT smg_sk_t_kupp "Ueberwachung Kupplung" UBYTE FORMULA_0306 0 0.0 0.0 2.549999952316284 READ_WRITE ECU_ADDRESS 0x3FC451 /end MEASUREMENT
/begin MEASUREMENT smg_sk_t_nberech "Ueberwachung nBerech" UBYTE FORMULA_0306 0 0.0 0.0 2.549999952316284 READ_WRITE ECU_ADDRESS 0x3FC454 /end MEASUREMENT
/begin MEASUREMENT smg_sk_t_ngetr "Ueberwachung nGetr" UBYTE FORMULA_0306 0 0.0 0.0 2.549999952316284 READ_WRITE ECU_ADDRESS 0x3FC452 /end MEASUREMENT
/begin MEASUREMENT smg_sk_t_ngetr_max "Ueberwachung max. nGetr" UBYTE FORMULA_0306 0 0.0 0.0 2.549999952316284 READ_WRITE ECU_ADDRESS 0x3FC455 /end MEASUREMENT
/begin MEASUREMENT smg_sk_t_ngetr_plau "Ueberwachung nGetr" UBYTE FORMULA_0306 0 0.0 0.0 2.549999952316284 READ_WRITE ECU_ADDRESS 0x3FC457 /end MEASUREMENT
/begin MEASUREMENT smg_sk_t_nziel "Ueberwachung nZiel" UBYTE FORMULA_0306 0 0.0 0.0 2.549999952316284 READ_WRITE ECU_ADDRESS 0x3FC453 /end MEASUREMENT
/begin MEASUREMENT smg_sk_t_nziel_max "Ueberwachung max. nZiel" UBYTE FORMULA_0306 0 0.0 0.0 2.549999952316284 READ_WRITE ECU_ADDRESS 0x3FC456 /end MEASUREMENT
/begin MEASUREMENT smg_sk_t_nziel_plau "Ueberwachung nZiel" UBYTE FORMULA_0306 0 0.0 0.0 2.549999952316284 READ_WRITE ECU_ADDRESS 0x3FC458 /end MEASUREMENT
/begin MEASUREMENT smg_sk_t_phase "abs. Dauer einer Schaltphase" UWORD FORMULA_0021 0 0.0 0.0 655.0 READ_WRITE ECU_ADDRESS 0x3FC44C /end MEASUREMENT
/begin MEASUREMENT smg_st_dme_e2 "DME-Status Ebene 2" UBYTE FORMULA_0957 0 0.0 0.0 255.0 READ_WRITE ECU_ADDRESS 0x3FC8E1 /end MEASUREMENT
/begin MEASUREMENT smg_st_dme_e2_err "Anzahl der Vergleichs-Fehler" UBYTE FORMULA_0003 0 0.0 0.0 255.0 READ_WRITE ECU_ADDRESS 0x3FC8E3 /end MEASUREMENT
/begin MEASUREMENT smg_st_ekr "Status Einkuppelfreigabe" UBYTE FORMULA_0003 0 0.0 0.0 255.0 READ_WRITE ECU_ADDRESS 0x3FC3BA /end MEASUREMENT
/begin MEASUREMENT smg_st_ekr_n "EKR-Sperre wg. n-Bezug" UBYTE FORMULA_0901 0 0 0.0 255.0 READ_WRITE BIT_MASK 0x1 ECU_ADDRESS 0x3FC3BA /end MEASUREMENT
/begin MEASUREMENT smg_st_ekr_n_max "EKR-Sperre wg. Nmax" UBYTE FORMULA_0902 0 0 0.0 255.0 READ_WRITE BIT_MASK 0x2 ECU_ADDRESS 0x3FC3BA /end MEASUREMENT
/begin MEASUREMENT smg_st_mot_e2 "SMG-Motoreingriff Ebene 2" UBYTE FORMULA_0267 0 0.0 0.0 255.0 READ_WRITE BIT_MASK 0xF ECU_ADDRESS 0x3FC8E2 /end MEASUREMENT
/begin MEASUREMENT smg_st_mot_e2_err "Anzahl der Vergleichs-Fehler" UBYTE FORMULA_0003 0 0.0 0.0 255.0 READ_WRITE ECU_ADDRESS 0x3FC8E4 /end MEASUREMENT
/begin MEASUREMENT smg_t_aktuell "aktuelle Zeit der jeweiligen Schaltphase" UWORD FORMULA_0021 0 0.0 0.0 655.0 READ_WRITE ECU_ADDRESS 0x3FC438 /end MEASUREMENT
/begin MEASUREMENT smg_t_aktuell_korr "korr. Zeit" UWORD FORMULA_0924 0 0.0 0.0 10000.0 READ_WRITE ECU_ADDRESS 0x3FC43A /end MEASUREMENT
/begin MEASUREMENT spim_errorcode "Statusvariable der SPI" UBYTE FORMULA_0002 0 0.0 0.0 255.0 READ_WRITE ECU_ADDRESS 0x3FC497 /end MEASUREMENT
/begin MEASUREMENT spim_errorcounter "Fehlerzaehler der Spi" UBYTE FORMULA_0003 0 0.0 0.0 255.0 READ_WRITE ECU_ADDRESS 0x3FC494 /end MEASUREMENT
/begin MEASUREMENT spim_reqcounter "Anzahl der Auftraege in der Queue" UBYTE FORMULA_0003 0 0.0 0.0 255.0 READ_WRITE ECU_ADDRESS 0x3FC495 /end MEASUREMENT
/begin MEASUREMENT spim_status "Statusvariable der SPI" UBYTE FORMULA_0375 0 0.0 0.0 255.0 READ_WRITE ECU_ADDRESS 0x3FC496 /end MEASUREMENT
/begin MEASUREMENT start_rl_exd_beginn "Beginn der externen Ansteuerung" UWORD FORMULA_0010 0 0.0 0.0 65535.0 READ_WRITE ECU_ADDRESS 0x3FC49C /end MEASUREMENT
/begin MEASUREMENT start_rl_exd_timeout "KWP-Ansteuerzeit" UBYTE FORMULA_0492 0 0.0 0.0 25.5 READ_WRITE ECU_ADDRESS 0x3FC49B /end MEASUREMENT
/begin MEASUREMENT start_rl_st "Status der Startrelaisansteuerung" UBYTE FORMULA_0960 0 0.0 0.0 255.0 READ_WRITE BIT_MASK 0x3 ECU_ADDRESS 0x3FC49A /end MEASUREMENT
/begin MEASUREMENT sys_ed_st "ED Status" UWORD FORMULA_0388 0 0.0 0.0 65535.0 READ_WRITE ECU_ADDRESS 0x3FC4A4 /end MEASUREMENT
/begin MEASUREMENT sys_exc_addr "Exception-Adresse" ULONG FORMULA_0000 0 0.0 0.0 4294967295.0 READ_WRITE ECU_ADDRESS 0x3FE774 /end MEASUREMENT
/begin MEASUREMENT sys_exc_km_ni "Kilometerstand bei Exception" ULONG FORMULA_0027 0 0.0 0.0 16777214.0 READ_WRITE ECU_ADDRESS 0x3FE77C /end MEASUREMENT
/begin MEASUREMENT sys_exc_lr "Linkregister nach Exception" ULONG FORMULA_0000 0 0.0 0.0 4294967295.0 READ_WRITE ECU_ADDRESS 0x3F8018 /end MEASUREMENT
/begin MEASUREMENT sys_exc_n_ni "Drehzahl bei Exception" SWORD FORMULA_0006 0 0.0 0.0 10000.0 READ_WRITE ECU_ADDRESS 0x3FE780 /end MEASUREMENT
/begin MEASUREMENT sys_exc_vec "Exception-Vector" UWORD FORMULA_0015 0 0.0 0.0 65535.0 READ_WRITE ECU_ADDRESS 0x3FE772 /end MEASUREMENT
/begin MEASUREMENT sys_last_reset_st "Letzter Resetstatus" UBYTE FORMULA_0390 0 0.0 0.0 255.0 READ_WRITE ECU_ADDRESS 0x3FC4AC /end MEASUREMENT
/begin MEASUREMENT sys_reset_st "Resetursache" UBYTE FORMULA_0390 0 0.0 0.0 255.0 READ_WRITE ECU_ADDRESS 0x3FE779 /end MEASUREMENT
/begin MEASUREMENT sys_rsr "Reset Status Register" UWORD FORMULA_0010 0 0.0 0.0 65535.0 READ_WRITE ECU_ADDRESS 0x3FE768 /end MEASUREMENT
/begin MEASUREMENT sys_rsr_cnt_sum "Reset-Summenzaehler" UWORD FORMULA_0010 0 0.0 0.0 65535.0 READ_WRITE ECU_ADDRESS 0x3FE76A /end MEASUREMENT
/begin MEASUREMENT sys_rsr_csrs "Checkstop reset" UWORD FORMULA_0395 0 0 0.0 255.0 READ_WRITE BIT_MASK 0x800 ECU_ADDRESS 0x3FE768 /end MEASUREMENT
/begin MEASUREMENT sys_rsr_dbhrs "Debug port hard reset" UWORD FORMULA_0396 0 0 0.0 255.0 READ_WRITE BIT_MASK 0x400 ECU_ADDRESS 0x3FE768 /end MEASUREMENT
/begin MEASUREMENT sys_rsr_dbsrs "Debug port soft reset" UWORD FORMULA_0397 0 0 0.0 255.0 READ_WRITE BIT_MASK 0x200 ECU_ADDRESS 0x3FE768 /end MEASUREMENT
/begin MEASUREMENT sys_rsr_ehrs "External Hreset" UWORD FORMULA_0391 0 0 0.0 255.0 READ_WRITE BIT_MASK 0x8000 ECU_ADDRESS 0x3FE768 /end MEASUREMENT
/begin MEASUREMENT sys_rsr_ersr "External Soft reset" UWORD FORMULA_0392 0 0 0.0 255.0 READ_WRITE BIT_MASK 0x4000 ECU_ADDRESS 0x3FE768 /end MEASUREMENT
/begin MEASUREMENT sys_rsr_ghrst "Glitch detected on HRESET PIN" UWORD FORMULA_0402 0 0 0.0 255.0 READ_WRITE BIT_MASK 0x10 ECU_ADDRESS 0x3FE768 /end MEASUREMENT
/begin MEASUREMENT sys_rsr_gpor "Glitch detected on powern on reset" UWORD FORMULA_0401 0 0 0.0 255.0 READ_WRITE BIT_MASK 0x20 ECU_ADDRESS 0x3FE768 /end MEASUREMENT
/begin MEASUREMENT sys_rsr_gsrst "Glitch detected on SRESET PIN" UWORD FORMULA_0403 0 0 0.0 255.0 READ_WRITE BIT_MASK 0x8 ECU_ADDRESS 0x3FE768 /end MEASUREMENT
/begin MEASUREMENT sys_rsr_ilbc "Illegal bit change reset" UWORD FORMULA_0400 0 0 0.0 255.0 READ_WRITE BIT_MASK 0x40 ECU_ADDRESS 0x3FE768 /end MEASUREMENT
/begin MEASUREMENT sys_rsr_jtrs "Jtag reset" UWORD FORMULA_0398 0 0 0.0 255.0 READ_WRITE BIT_MASK 0x100 ECU_ADDRESS 0x3FE768 /end MEASUREMENT
/begin MEASUREMENT sys_rsr_llrs "Los of lock reset" UWORD FORMULA_0393 0 0 0.0 255.0 READ_WRITE BIT_MASK 0x2000 ECU_ADDRESS 0x3FE768 /end MEASUREMENT
/begin MEASUREMENT sys_rsr_occs "On chip clock reset" UWORD FORMULA_0399 0 0 0.0 255.0 READ_WRITE BIT_MASK 0x80 ECU_ADDRESS 0x3FE768 /end MEASUREMENT
/begin MEASUREMENT sys_rsr_swrs "Software watchdog reset" UWORD FORMULA_0394 0 0 0.0 255.0 READ_WRITE BIT_MASK 0x1000 ECU_ADDRESS 0x3FE768 /end MEASUREMENT
/begin MEASUREMENT sys_sg_fehler "SG internere Fehlernummer" UBYTE FORMULA_0405 0 0.0 0.0 255.0 READ_WRITE ECU_ADDRESS 0x3FE778 /end MEASUREMENT
/begin MEASUREMENT sys_sync_init_t "Hochlauf Zeitmarken" UWORD FORMULA_0406 0 0.0 0.0 16711.42578125 READ_WRITE ARRAY_SIZE 5 ECU_ADDRESS 0x3FE782 MATRIX_DIM 5 1 1 /end MEASUREMENT
/begin MEASUREMENT sys_zust "Betriebszustand des Systems" UWORD FORMULA_0389 0 0.0 0.0 65535.0 READ_WRITE ECU_ADDRESS 0x3FC4A6 /end MEASUREMENT
/begin MEASUREMENT sys_zust_bgnd_cnt "Aufruf Bgnd Task pro 100ms" UWORD FORMULA_0010 0 0.0 0.0 1000.0 READ_WRITE ECU_ADDRESS 0x3FE76E /end MEASUREMENT
/begin MEASUREMENT sys_zust_bgnd_net_min "Background Netto time min" UWORD FORMULA_0404 0 0.0 0.0 2.0 READ_WRITE ECU_ADDRESS 0x3FE770 /end MEASUREMENT
/begin MEASUREMENT sys_zust_cpu_last "CPU Last" UWORD FORMULA_0001 0 0.0 0.0 100.0 READ_WRITE ECU_ADDRESS 0x3FE76C /end MEASUREMENT
/begin MEASUREMENT tdme_ad "Eingelesener Spannungswert fuer Steuergeraetetemperatur" SWORD FORMULA_0114 0 0.0 0.0 1023.0 READ_WRITE ECU_ADDRESS 0x3FC54C /end MEASUREMENT
/begin MEASUREMENT tdme_filter "Gefilterter Messwert der Steuergeraetetemperatur" SWORD FORMULA_0975 0 0.0 -50.0 170.0 READ_WRITE ECU_ADDRESS 0x3FC550 /end MEASUREMENT
/begin MEASUREMENT tdme_roh "Ungefilterter Messwert der Steuergeraetetemperatur" SWORD FORMULA_0975 0 0.0 -50.0 170.0 READ_WRITE ECU_ADDRESS 0x3FC54E /end MEASUREMENT
/begin MEASUREMENT tpu_a.CFSR01 "Channel Funktion Selection Register 0,1." ULONG FORMULA_0000 0 0.0 0.0 4294967295.0 READ_WRITE ECU_ADDRESS 0x30400C /end MEASUREMENT
/begin MEASUREMENT tpu_a.CFSR23 "Channel Funktion Selection Register 2,3." ULONG FORMULA_0000 0 0.0 0.0 4294967295.0 READ_WRITE ECU_ADDRESS 0x304010 /end MEASUREMENT
/begin MEASUREMENT tpu_a.CIER "Channel Interrupt Enable Register." UWORD FORMULA_0010 0 0.0 0.0 65535.0 READ_WRITE ECU_ADDRESS 0x30400A /end MEASUREMENT
/begin MEASUREMENT tpu_a.CISR "Channel Interrupt Status Register." UWORD FORMULA_0010 0 0.0 0.0 65535.0 READ_WRITE ECU_ADDRESS 0x304020 /end MEASUREMENT
/begin MEASUREMENT tpu_a.CPR "Channel Priority Register 0,1." ULONG FORMULA_0000 0 0.0 0.0 4294967295.0 READ_WRITE ECU_ADDRESS 0x30401C /end MEASUREMENT
/begin MEASUREMENT tpu_a.HSQR "Host Sequence Register 0,1." ULONG FORMULA_0000 0 0.0 0.0 4294967295.0 READ_WRITE ECU_ADDRESS 0x304014 /end MEASUREMENT
/begin MEASUREMENT tpu_a.HSRR "Host Service Request Register 0,1." ULONG FORMULA_0000 0 0.0 0.0 4294967295.0 READ_WRITE ECU_ADDRESS 0x304018 /end MEASUREMENT
/begin MEASUREMENT tpu_a.TICR "TPU3 Interrupt Configuration Register." UWORD FORMULA_0010 0 0.0 0.0 65535.0 READ_WRITE ECU_ADDRESS 0x304008 /end MEASUREMENT
/begin MEASUREMENT tpu_a.TPUMCR "TPU3 Module Configuration Register." UWORD FORMULA_0010 0 0.0 0.0 65535.0 READ_WRITE ECU_ADDRESS 0x304000 /end MEASUREMENT
/begin MEASUREMENT tpu_a.TPUMCR2 "TPU Module Configuration Register 2." UWORD FORMULA_0010 0 0.0 0.0 65535.0 READ_WRITE ECU_ADDRESS 0x304028 /end MEASUREMENT
/begin MEASUREMENT tpu_a.TPUMCR3 "TPU Module Configuration Register 3." UWORD FORMULA_0010 0 0.0 0.0 65535.0 READ_WRITE ECU_ADDRESS 0x30402A /end MEASUREMENT
/begin MEASUREMENT tpu_a_pram "Parameter RAM." UWORD FORMULA_0010 0 0.0 0.0 65535.0 READ_WRITE ARRAY_SIZE 128 ECU_ADDRESS 0x304100 MATRIX_DIM 128 1 1 /end MEASUREMENT
/begin MEASUREMENT tpu_b.CFSR01 "Channel Funktion Selection Register 0,1." ULONG FORMULA_0000 0 0.0 0.0 4294967295.0 READ_WRITE ECU_ADDRESS 0x30440C /end MEASUREMENT
/begin MEASUREMENT tpu_b.CFSR23 "Channel Funktion Selection Register 2,3." ULONG FORMULA_0000 0 0.0 0.0 4294967295.0 READ_WRITE ECU_ADDRESS 0x304410 /end MEASUREMENT
/begin MEASUREMENT tpu_b.CIER "Channel Interrupt Enable Register." UWORD FORMULA_0010 0 0.0 0.0 65535.0 READ_WRITE ECU_ADDRESS 0x30440A /end MEASUREMENT
/begin MEASUREMENT tpu_b.CISR "Channel Interrupt Status Register." UWORD FORMULA_0010 0 0.0 0.0 65535.0 READ_WRITE ECU_ADDRESS 0x304420 /end MEASUREMENT
/begin MEASUREMENT tpu_b.CPR "Channel Priority Register 0,1." ULONG FORMULA_0000 0 0.0 0.0 4294967295.0 READ_WRITE ECU_ADDRESS 0x30441C /end MEASUREMENT
/begin MEASUREMENT tpu_b.HSQR "Host Sequence Register 0,1." ULONG FORMULA_0000 0 0.0 0.0 4294967295.0 READ_WRITE ECU_ADDRESS 0x304414 /end MEASUREMENT
/begin MEASUREMENT tpu_b.HSRR "Host Service Request Register 0,1." ULONG FORMULA_0000 0 0.0 0.0 4294967295.0 READ_WRITE ECU_ADDRESS 0x304418 /end MEASUREMENT
/begin MEASUREMENT tpu_b.TICR "TPU3 Interrupt Configuration Register." UWORD FORMULA_0010 0 0.0 0.0 65535.0 READ_WRITE ECU_ADDRESS 0x304408 /end MEASUREMENT
/begin MEASUREMENT tpu_b.TPUMCR "TPU3 Module Configuration Register." UWORD FORMULA_0010 0 0.0 0.0 65535.0 READ_WRITE ECU_ADDRESS 0x304400 /end MEASUREMENT
/begin MEASUREMENT tpu_b.TPUMCR2 "TPU Module Configuration Register 2." UWORD FORMULA_0010 0 0.0 0.0 65535.0 READ_WRITE ECU_ADDRESS 0x304428 /end MEASUREMENT
/begin MEASUREMENT tpu_b.TPUMCR3 "TPU Module Configuration Register 3." UWORD FORMULA_0010 0 0.0 0.0 65535.0 READ_WRITE ECU_ADDRESS 0x30442A /end MEASUREMENT
/begin MEASUREMENT tpu_b_pram "Parameter RAM." UWORD FORMULA_0010 0 0.0 0.0 65535.0 READ_WRITE ARRAY_SIZE 128 ECU_ADDRESS 0x304500 MATRIX_DIM 128 1 1 /end MEASUREMENT
/begin MEASUREMENT tpu_bank "aktuelle Bank" UBYTE FORMULA_0408 0 0.0 1.0 2.0 READ_WRITE ECU_ADDRESS 0x3FC5EE /end MEASUREMENT
/begin MEASUREMENT tpu_code_status "TPU MicroCode Status." UWORD FORMULA_0010 0 0.0 0.0 65535.0 READ_WRITE ECU_ADDRESS 0x3FC5E8 /end MEASUREMENT
/begin MEASUREMENT tpu_idx_a "Segmentindex auf TPU" UBYTE FORMULA_0003 0 0.0 0.0 5.0 READ_WRITE ECU_ADDRESS 0x3FC5F2 /end MEASUREMENT
/begin MEASUREMENT tpu_idx_b "Segmentindex auf TPU" UBYTE FORMULA_0003 0 0.0 0.0 5.0 READ_WRITE ECU_ADDRESS 0x3FC5F3 /end MEASUREMENT
/begin MEASUREMENT tpu_index "Segmentindex fuer den Gesamtmotor" UBYTE FORMULA_0003 0 0.0 0.0 11.0 READ_WRITE ECU_ADDRESS 0x3FC5F0 /end MEASUREMENT
/begin MEASUREMENT tpu_kw_irq_a "Letzte KW Interruptart." UBYTE FORMULA_0409 0 0.0 0.0 255.0 READ_WRITE ECU_ADDRESS 0x3FC5F6 /end MEASUREMENT
/begin MEASUREMENT tpu_kw_irq_b "Letzte KW Interruptart." UBYTE FORMULA_0409 0 0.0 0.0 255.0 READ_WRITE ECU_ADDRESS 0x3FC5F7 /end MEASUREMENT
/begin MEASUREMENT tpu_kw_irq_cnt_a "TPU Interruptzaehler." UBYTE FORMULA_0003 0 0.0 0.0 255.0 READ_WRITE ECU_ADDRESS 0x3FC5FA /end MEASUREMENT
/begin MEASUREMENT tpu_kw_irq_cnt_b "TPU Interruptzaehler." UBYTE FORMULA_0003 0 0.0 0.0 255.0 READ_WRITE ECU_ADDRESS 0x3FC5FB /end MEASUREMENT
/begin MEASUREMENT tpu_kw_irq_error_a "Fehlerinterrupt." UBYTE FORMULA_0414 0 0 0.0 255.0 READ_WRITE BIT_MASK 0x8 ECU_ADDRESS 0x3FC5F6 /end MEASUREMENT
/begin MEASUREMENT tpu_kw_irq_error_b "Fehlerinterrupt." UBYTE FORMULA_0414 0 0 0.0 255.0 READ_WRITE BIT_MASK 0x8 ECU_ADDRESS 0x3FC5F7 /end MEASUREMENT
/begin MEASUREMENT tpu_kw_irq_info_a "Infointerrupt (+/- ein Zahn)." UBYTE FORMULA_0417 0 0 0.0 255.0 READ_WRITE BIT_MASK 0x1 ECU_ADDRESS 0x3FC5F6 /end MEASUREMENT
/begin MEASUREMENT tpu_kw_irq_info_b "Infointerrupt (+/- ein Zahn)." UBYTE FORMULA_0417 0 0 0.0 255.0 READ_WRITE BIT_MASK 0x1 ECU_ADDRESS 0x3FC5F7 /end MEASUREMENT
/begin MEASUREMENT tpu_kw_irq_mess_a "Messfensterinterrupt (LU)." UBYTE FORMULA_0412 0 0 0.0 255.0 READ_WRITE BIT_MASK 0x20 ECU_ADDRESS 0x3FC5F6 /end MEASUREMENT
/begin MEASUREMENT tpu_kw_irq_mess_b "Messfensterinterrupt (LU)." UBYTE FORMULA_0412 0 0 0.0 255.0 READ_WRITE BIT_MASK 0x20 ECU_ADDRESS 0x3FC5F7 /end MEASUREMENT
/begin MEASUREMENT tpu_kw_irq_n_min_a "Unterdrehzahlinterrupt." UBYTE FORMULA_0413 0 0 0.0 255.0 READ_WRITE BIT_MASK 0x10 ECU_ADDRESS 0x3FC5F6 /end MEASUREMENT
/begin MEASUREMENT tpu_kw_irq_n_min_b "Unterdrehzahlinterrupt." UBYTE FORMULA_0413 0 0 0.0 255.0 READ_WRITE BIT_MASK 0x10 ECU_ADDRESS 0x3FC5F7 /end MEASUREMENT
/begin MEASUREMENT tpu_kw_irq_pre_sync_a "Pre-Sync-Interrupt (Start Lueckensuche)." UBYTE FORMULA_0415 0 0 0.0 255.0 READ_WRITE BIT_MASK 0x4 ECU_ADDRESS 0x3FC5F6 /end MEASUREMENT
/begin MEASUREMENT tpu_kw_irq_pre_sync_b "Pre-Sync-Interrupt (Start Lueckensuche)." UBYTE FORMULA_0415 0 0 0.0 255.0 READ_WRITE BIT_MASK 0x4 ECU_ADDRESS 0x3FC5F7 /end MEASUREMENT
/begin MEASUREMENT tpu_kw_irq_segm_a "Segmentinterrupt." UBYTE FORMULA_0411 0 0 0.0 255.0 READ_WRITE BIT_MASK 0x40 ECU_ADDRESS 0x3FC5F6 /end MEASUREMENT
/begin MEASUREMENT tpu_kw_irq_segm_b "Segmentinterrupt." UBYTE FORMULA_0411 0 0 0.0 255.0 READ_WRITE BIT_MASK 0x40 ECU_ADDRESS 0x3FC5F7 /end MEASUREMENT
/begin MEASUREMENT tpu_kw_irq_segm_cnt_a "Anzahl Segmentinterrupts." UBYTE FORMULA_0003 0 0.0 0.0 255.0 READ_WRITE ECU_ADDRESS 0x3FC5FC /end MEASUREMENT
/begin MEASUREMENT tpu_kw_irq_segm_cnt_b "Anzahl Segmentinterrupts." UBYTE FORMULA_0003 0 0.0 0.0 255.0 READ_WRITE ECU_ADDRESS 0x3FC5FD /end MEASUREMENT
/begin MEASUREMENT tpu_kw_irq_sync_a "Sync-Interrupt (Luecke gefunden)." UBYTE FORMULA_0416 0 0 0.0 255.0 READ_WRITE BIT_MASK 0x2 ECU_ADDRESS 0x3FC5F6 /end MEASUREMENT
/begin MEASUREMENT tpu_kw_irq_sync_b "Sync-Interrupt (Luecke gefunden)." UBYTE FORMULA_0416 0 0 0.0 255.0 READ_WRITE BIT_MASK 0x2 ECU_ADDRESS 0x3FC5F7 /end MEASUREMENT
/begin MEASUREMENT tpu_kw_irq_tooth_a "Zahninterrupt." UBYTE FORMULA_0410 0 0 0.0 255.0 READ_WRITE BIT_MASK 0x80 ECU_ADDRESS 0x3FC5F6 /end MEASUREMENT
/begin MEASUREMENT tpu_kw_irq_tooth_b "Zahninterrupt." UBYTE FORMULA_0410 0 0 0.0 255.0 READ_WRITE BIT_MASK 0x80 ECU_ADDRESS 0x3FC5F7 /end MEASUREMENT
/begin MEASUREMENT tpu_kw_irq_tooth_cnt_a "Zahninterruptzaehler." UBYTE FORMULA_0003 0 0.0 0.0 255.0 READ_WRITE ECU_ADDRESS 0x3FC5FE /end MEASUREMENT
/begin MEASUREMENT tpu_kw_irq_tooth_cnt_b "Zahninterruptzaehler." UBYTE FORMULA_0003 0 0.0 0.0 255.0 READ_WRITE ECU_ADDRESS 0x3FC5FF /end MEASUREMENT
/begin MEASUREMENT tpu_kw_irq_zahn_a "Zahnnummer TPU bei Eintritt in ISR." UBYTE FORMULA_0003 0 0.0 0.0 255.0 READ_WRITE ECU_ADDRESS 0x3FC5F8 /end MEASUREMENT
/begin MEASUREMENT tpu_kw_irq_zahn_b "Zahnnummer TPU bei Eintritt in ISR." UBYTE FORMULA_0003 0 0.0 0.0 255.0 READ_WRITE ECU_ADDRESS 0x3FC5F9 /end MEASUREMENT
/begin MEASUREMENT tpu_kw_nw_sync_cnt_a "Umsynchronisationszaehler" UBYTE FORMULA_0003 0 0.0 0.0 255.0 READ_WRITE ECU_ADDRESS 0x3FC5F4 /end MEASUREMENT
/begin MEASUREMENT tpu_kw_nw_sync_cnt_b "Umsynchronisationszaehler" UBYTE FORMULA_0003 0 0.0 0.0 255.0 READ_WRITE ECU_ADDRESS 0x3FC5F5 /end MEASUREMENT
/begin MEASUREMENT tpu_kw_rot "Rotation." UBYTE FORMULA_0003 0 0.0 0.0 1.0 READ_WRITE ECU_ADDRESS 0x3FC5F1 /end MEASUREMENT
/begin MEASUREMENT tpu_st_a "Status TPU Synchronisation" UBYTE FORMULA_0407 0 0.0 0.0 255.0 READ_WRITE ECU_ADDRESS 0x3FC5EA /end MEASUREMENT
/begin MEASUREMENT tpu_st_b "Status TPU Synchronisation" UBYTE FORMULA_0407 0 0.0 0.0 255.0 READ_WRITE ECU_ADDRESS 0x3FC5EB /end MEASUREMENT
/begin MEASUREMENT tpu_zyl "aktueller Zylinder" UBYTE FORMULA_0408 0 0.0 1.0 12.0 READ_WRITE ECU_ADDRESS 0x3FC5EC /end MEASUREMENT
/begin MEASUREMENT tpu_zyl_bank "aktueller Zylinder der Bank" UBYTE FORMULA_0408 0 0.0 1.0 2.0 READ_WRITE ECU_ADDRESS 0x3FC5EF /end MEASUREMENT
/begin MEASUREMENT tpu_zyl_p2 "zwei Zylinder in der Zukunft" UBYTE FORMULA_0408 0 0.0 1.0 12.0 READ_WRITE ECU_ADDRESS 0x3FC5ED /end MEASUREMENT
/begin MEASUREMENT tsgrw_filter_b1 "Gefilterte Saugrohrwandtemperatur" SWORD FORMULA_0975 0 0.0 -50.0 170.0 READ_WRITE ECU_ADDRESS 0x3FC604 /end MEASUREMENT
/begin MEASUREMENT tsgrw_filter_b2 "Gefilterte Saugrohrwandtemperatur" SWORD FORMULA_0975 0 0.0 -50.0 170.0 READ_WRITE ECU_ADDRESS 0x3FC606 /end MEASUREMENT
/begin MEASUREMENT tsgrw_roh_b1 "Ungefilterte Saugrohrwandtemperatur" SWORD FORMULA_0975 0 0.0 -50.0 170.0 READ_WRITE ECU_ADDRESS 0x3FC600 /end MEASUREMENT
/begin MEASUREMENT tsgrw_roh_b2 "Ungefilterte Saugrohrwandtemperatur" SWORD FORMULA_0975 0 0.0 -50.0 170.0 READ_WRITE ECU_ADDRESS 0x3FC602 /end MEASUREMENT
/begin MEASUREMENT v_servo "Geschwindigkeit fuer Servotronic-KL" SWORD FORMULA_0076 0 0.0 -80.0 360.0 READ_WRITE ECU_ADDRESS 0x3FC350 /end MEASUREMENT
/begin MEASUREMENT vers_boot "Booterversion" UWORD FORMULA_0010 0 0.0 0.0 65535.0 READ_WRITE ECU_ADDRESS 0x3F8014 /end MEASUREMENT
/begin MEASUREMENT vers_boot_index "Booterversionsindex" UWORD FORMULA_0010 0 0.0 0.0 65535.0 READ_WRITE ECU_ADDRESS 0x3F8016 /end MEASUREMENT
/begin COMPU_METHOD FORMULA_0000 "FORMULA_0000" RAT_FUNC "%7.0" "-" COEFFS 0 1 0 0 0 1 /end COMPU_METHOD
/begin COMPU_METHOD FORMULA_0001 "FORMULA_0001" RAT_FUNC "%6.1" "%" COEFFS 0 10.0 0.0 0 0.0 1.0 /end COMPU_METHOD
/begin COMPU_METHOD FORMULA_0002 "FORMULA_0002" TAB_VERB "%3.0" "-" COMPU_TAB_REF FORMULA_0002_VTAB /end COMPU_METHOD
/begin COMPU_METHOD FORMULA_0003 "FORMULA_0003" RAT_FUNC "%3.0" "-" COEFFS 0 1 0 0 0 1 /end COMPU_METHOD
/begin COMPU_METHOD FORMULA_0006 "FORMULA_0006" RAT_FUNC "%5.0" "Upm" COEFFS 0 1 0 0 0 1 /end COMPU_METHOD
/begin COMPU_METHOD FORMULA_0007 "FORMULA_0007" RAT_FUNC "%8.3" "-" COEFFS 0 10000.0 0.0 0 0.0 1.0 /end COMPU_METHOD
/begin COMPU_METHOD FORMULA_0008 "FORMULA_0008" RAT_FUNC "%6.1" "V" COEFFS 0 10.0 0.0 0 0.0 1.0 /end COMPU_METHOD
/begin COMPU_METHOD FORMULA_0009 "FORMULA_0009" RAT_FUNC "%6.1" "Nm" COEFFS 0 10.0 0.0 0 0.0 1.0 /end COMPU_METHOD
/begin COMPU_METHOD FORMULA_0010 "FORMULA_0010" RAT_FUNC "%5.0" "-" COEFFS 0 1 0 0 0 1 /end COMPU_METHOD
/begin COMPU_METHOD FORMULA_0011 "FORMULA_0011" TAB_VERB "%5.0" "-" COMPU_TAB_REF FORMULA_0011_VTAB /end COMPU_METHOD
/begin COMPU_METHOD FORMULA_0015 "FORMULA_0015" TAB_VERB "%5.0" "-" COMPU_TAB_REF FORMULA_0015_VTAB /end COMPU_METHOD
/begin COMPU_METHOD FORMULA_0021 "FORMULA_0021" RAT_FUNC "%7.2" "s" COEFFS 0 100.0 0.0 0 0.0 1.0 /end COMPU_METHOD
/begin COMPU_METHOD FORMULA_0023 "FORMULA_0023" RAT_FUNC "%6.1" "°C" COEFFS 0 10.0 2732.0 0 0.0 1.0 /end COMPU_METHOD
/begin COMPU_METHOD FORMULA_0024 "FORMULA_0024" RAT_FUNC "%9.4" "-" COEFFS 0 32768.0 0.0 0 0.0 1.0 /end COMPU_METHOD
/begin COMPU_METHOD FORMULA_0027 "FORMULA_0027" RAT_FUNC "%7.0" "km" COEFFS 0 1 0 0 0 1 /end COMPU_METHOD
/begin COMPU_METHOD FORMULA_0037 "FORMULA_0037" RAT_FUNC "%5.2" "-" COEFFS 0 1 0 0 0 1 /end COMPU_METHOD
/begin COMPU_METHOD FORMULA_0044 "FORMULA_0044" RAT_FUNC "%9.2" "-" COEFFS 0 1 0 0 0 1 /end COMPU_METHOD
/begin COMPU_METHOD FORMULA_0071 "FORMULA_0071" RAT_FUNC "%6.1" "s" COEFFS 0 10.0 0.0 0 0.0 1.0 /end COMPU_METHOD
/begin COMPU_METHOD FORMULA_0073 "FORMULA_0073" RAT_FUNC "%8.3" "-" COEFFS 0 1024.0 0.0 0 0.0 1.0 /end COMPU_METHOD
/begin COMPU_METHOD FORMULA_0076 "FORMULA_0076" RAT_FUNC "%6.1" "km/h" COEFFS 0 16.0 0.0 0 0.0 1.0 /end COMPU_METHOD
/begin COMPU_METHOD FORMULA_0080 "FORMULA_0080" RAT_FUNC "%7.2" "-" COEFFS 0 1 0 0 0 1 /end COMPU_METHOD
/begin COMPU_METHOD FORMULA_0102 "FORMULA_0102" RAT_FUNC "%6.1" "°KW" COEFFS 0 10.0 0.0 0 0.0 1.0 /end COMPU_METHOD
/begin COMPU_METHOD FORMULA_0105 "FORMULA_0105" RAT_FUNC "%5.0" "Upm/s" COEFFS 0 1 0 0 0 1 /end COMPU_METHOD
/begin COMPU_METHOD FORMULA_0109 "FORMULA_0109" RAT_FUNC "%7.2" "s" COEFFS 0 200.0 0.0 0 0.0 1.0 /end COMPU_METHOD
/begin COMPU_METHOD FORMULA_0114 "FORMULA_0114" RAT_FUNC "%5.0" "digit" COEFFS 0 1 0 0 0 1 /end COMPU_METHOD
/begin COMPU_METHOD FORMULA_0116 "FORMULA_0116" TAB_VERB "%5.0" "-" COMPU_TAB_REF FORMULA_0116_VTAB /end COMPU_METHOD
/begin COMPU_METHOD FORMULA_0123 "FORMULA_0123" RAT_FUNC "%7.2" "m/(s*s)" COEFFS 0 40.0 0.0 0 0.0 1.0 /end COMPU_METHOD
/begin COMPU_METHOD FORMULA_0135 "FORMULA_0135" RAT_FUNC "%3.0" ".Gang" COEFFS 0 1 0 0 0 1 /end COMPU_METHOD
/begin COMPU_METHOD FORMULA_0142 "FORMULA_0142" RAT_FUNC "%6.1" "%" COEFFS 0 16.67 0.0 0 0.0 1.0 /end COMPU_METHOD
/begin COMPU_METHOD FORMULA_0167 "FORMULA_0167" TAB_VERB "%3.0" "-" COMPU_TAB_REF FORMULA_0167_VTAB /end COMPU_METHOD
/begin COMPU_METHOD FORMULA_0179 "FORMULA_0179" TAB_VERB "%5.0" "-" COMPU_TAB_REF FORMULA_0179_VTAB /end COMPU_METHOD
/begin COMPU_METHOD FORMULA_0263 "FORMULA_0263" RAT_FUNC "%3.0" ".Prog" COEFFS 0 1 0 0 0 1 /end COMPU_METHOD
/begin COMPU_METHOD FORMULA_0267 "FORMULA_0267" TAB_VERB "%5.2" "-" COMPU_TAB_REF FORMULA_0267_VTAB /end COMPU_METHOD
/begin COMPU_METHOD FORMULA_0276 "FORMULA_0276" RAT_FUNC "%7.2" "Nms2" COEFFS 0 512.0 0.0 0 0.0 1.0 /end COMPU_METHOD
/begin COMPU_METHOD FORMULA_0306 "FORMULA_0306" RAT_FUNC "%5.2" "s" COEFFS 0 100.0 0.0 0 0.0 1.0 /end COMPU_METHOD
/begin COMPU_METHOD FORMULA_0362 "FORMULA_0362" TAB_VERB "%5.2" "-" COMPU_TAB_REF FORMULA_0362_VTAB /end COMPU_METHOD
/begin COMPU_METHOD FORMULA_0367 "FORMULA_0367" TAB_VERB "%3.0" "-" COMPU_TAB_REF FORMULA_0367_VTAB /end COMPU_METHOD
/begin COMPU_METHOD FORMULA_0368 "FORMULA_0368" TAB_VERB "%5.2" "-" COMPU_TAB_REF FORMULA_0368_VTAB /end COMPU_METHOD
/begin COMPU_METHOD FORMULA_0369 "FORMULA_0369" TAB_VERB "%3.0" "-" COMPU_TAB_REF FORMULA_0369_VTAB /end COMPU_METHOD
/begin COMPU_METHOD FORMULA_0370 "FORMULA_0370" TAB_VERB "%3.0" "-" COMPU_TAB_REF FORMULA_0370_VTAB /end COMPU_METHOD
/begin COMPU_METHOD FORMULA_0371 "FORMULA_0371" TAB_VERB "%3.0" "-" COMPU_TAB_REF FORMULA_0371_VTAB /end COMPU_METHOD
/begin COMPU_METHOD FORMULA_0372 "FORMULA_0372" TAB_VERB "%3.0" "-" COMPU_TAB_REF FORMULA_0372_VTAB /end COMPU_METHOD
/begin COMPU_METHOD FORMULA_0373 "FORMULA_0373" TAB_VERB "%3.0" "-" COMPU_TAB_REF FORMULA_0373_VTAB /end COMPU_METHOD
/begin COMPU_METHOD FORMULA_0374 "FORMULA_0374" TAB_VERB "%5.0" "-" COMPU_TAB_REF FORMULA_0374_VTAB /end COMPU_METHOD
/begin COMPU_METHOD FORMULA_0375 "FORMULA_0375" TAB_VERB "%3.0" "-" COMPU_TAB_REF FORMULA_0375_VTAB /end COMPU_METHOD
/begin COMPU_METHOD FORMULA_0376 "FORMULA_0376" TAB_VERB "%7.2" "-" COMPU_TAB_REF FORMULA_0376_VTAB /end COMPU_METHOD
/begin COMPU_METHOD FORMULA_0377 "FORMULA_0377" TAB_VERB "%5.2" "-" COMPU_TAB_REF FORMULA_0377_VTAB /end COMPU_METHOD
/begin COMPU_METHOD FORMULA_0378 "FORMULA_0378" TAB_VERB "%5.2" "-" COMPU_TAB_REF FORMULA_0378_VTAB /end COMPU_METHOD
/begin COMPU_METHOD FORMULA_0379 "FORMULA_0379" TAB_VERB "%5.2" "-" COMPU_TAB_REF FORMULA_0379_VTAB /end COMPU_METHOD
/begin COMPU_METHOD FORMULA_0380 "FORMULA_0380" TAB_VERB "%5.2" "-" COMPU_TAB_REF FORMULA_0380_VTAB /end COMPU_METHOD
/begin COMPU_METHOD FORMULA_0381 "FORMULA_0381" TAB_VERB "%5.2" "-" COMPU_TAB_REF FORMULA_0381_VTAB /end COMPU_METHOD
/begin COMPU_METHOD FORMULA_0382 "FORMULA_0382" TAB_VERB "%5.2" "-" COMPU_TAB_REF FORMULA_0382_VTAB /end COMPU_METHOD
/begin COMPU_METHOD FORMULA_0383 "FORMULA_0383" TAB_VERB "%5.2" "-" COMPU_TAB_REF FORMULA_0383_VTAB /end COMPU_METHOD
/begin COMPU_METHOD FORMULA_0384 "FORMULA_0384" TAB_VERB "%5.2" "-" COMPU_TAB_REF FORMULA_0384_VTAB /end COMPU_METHOD
/begin COMPU_METHOD FORMULA_0385 "FORMULA_0385" TAB_VERB "%5.2" "-" COMPU_TAB_REF FORMULA_0385_VTAB /end COMPU_METHOD
/begin COMPU_METHOD FORMULA_0386 "FORMULA_0386" TAB_VERB "%5.2" "-" COMPU_TAB_REF FORMULA_0386_VTAB /end COMPU_METHOD
/begin COMPU_METHOD FORMULA_0387 "FORMULA_0387" TAB_VERB "%5.2" "-" COMPU_TAB_REF FORMULA_0387_VTAB /end COMPU_METHOD
/begin COMPU_METHOD FORMULA_0388 "FORMULA_0388" TAB_VERB "%7.2" "-" COMPU_TAB_REF FORMULA_0388_VTAB /end COMPU_METHOD
/begin COMPU_METHOD FORMULA_0389 "FORMULA_0389" TAB_VERB "%7.2" "-" COMPU_TAB_REF FORMULA_0389_VTAB /end COMPU_METHOD
/begin COMPU_METHOD FORMULA_0390 "FORMULA_0390" TAB_VERB "%3.0" "-" COMPU_TAB_REF FORMULA_0390_VTAB /end COMPU_METHOD
/begin COMPU_METHOD FORMULA_0391 "FORMULA_0391" TAB_VERB "%7.2" "-" COMPU_TAB_REF FORMULA_0391_VTAB /end COMPU_METHOD
/begin COMPU_METHOD FORMULA_0392 "FORMULA_0392" TAB_VERB "%7.2" "-" COMPU_TAB_REF FORMULA_0392_VTAB /end COMPU_METHOD
/begin COMPU_METHOD FORMULA_0393 "FORMULA_0393" TAB_VERB "%7.2" "-" COMPU_TAB_REF FORMULA_0393_VTAB /end COMPU_METHOD
/begin COMPU_METHOD FORMULA_0394 "FORMULA_0394" TAB_VERB "%7.2" "-" COMPU_TAB_REF FORMULA_0394_VTAB /end COMPU_METHOD
/begin COMPU_METHOD FORMULA_0395 "FORMULA_0395" TAB_VERB "%7.2" "-" COMPU_TAB_REF FORMULA_0395_VTAB /end COMPU_METHOD
/begin COMPU_METHOD FORMULA_0396 "FORMULA_0396" TAB_VERB "%7.2" "-" COMPU_TAB_REF FORMULA_0396_VTAB /end COMPU_METHOD
/begin COMPU_METHOD FORMULA_0397 "FORMULA_0397" TAB_VERB "%7.2" "-" COMPU_TAB_REF FORMULA_0397_VTAB /end COMPU_METHOD
/begin COMPU_METHOD FORMULA_0398 "FORMULA_0398" TAB_VERB "%7.2" "-" COMPU_TAB_REF FORMULA_0398_VTAB /end COMPU_METHOD
/begin COMPU_METHOD FORMULA_0399 "FORMULA_0399" TAB_VERB "%7.2" "-" COMPU_TAB_REF FORMULA_0399_VTAB /end COMPU_METHOD
/begin COMPU_METHOD FORMULA_0400 "FORMULA_0400" TAB_VERB "%7.2" "-" COMPU_TAB_REF FORMULA_0400_VTAB /end COMPU_METHOD
/begin COMPU_METHOD FORMULA_0401 "FORMULA_0401" TAB_VERB "%7.2" "-" COMPU_TAB_REF FORMULA_0401_VTAB /end COMPU_METHOD
/begin COMPU_METHOD FORMULA_0402 "FORMULA_0402" TAB_VERB "%7.2" "-" COMPU_TAB_REF FORMULA_0402_VTAB /end COMPU_METHOD
/begin COMPU_METHOD FORMULA_0403 "FORMULA_0403" TAB_VERB "%7.2" "-" COMPU_TAB_REF FORMULA_0403_VTAB /end COMPU_METHOD
/begin COMPU_METHOD FORMULA_0404 "FORMULA_0404" RAT_FUNC "%8.3" "ms" COEFFS 0 1000.0 0.0 0 0.0 1.0 /end COMPU_METHOD
/begin COMPU_METHOD FORMULA_0405 "FORMULA_0405" TAB_VERB "%3.0" "-" COMPU_TAB_REF FORMULA_0405_VTAB /end COMPU_METHOD
/begin COMPU_METHOD FORMULA_0406 "FORMULA_0406" RAT_FUNC "%6.1" "ms" COEFFS 0 3.92156862745098 0.0 0 0.0 1.0 /end COMPU_METHOD
/begin COMPU_METHOD FORMULA_0407 "FORMULA_0407" TAB_VERB "%3.0" "-" COMPU_TAB_REF FORMULA_0407_VTAB /end COMPU_METHOD
/begin COMPU_METHOD FORMULA_0408 "FORMULA_0408" RAT_FUNC "%3.0" "-" COEFFS 0 1.0 -1.0 0 0.0 1.0 /end COMPU_METHOD
/begin COMPU_METHOD FORMULA_0409 "FORMULA_0409" TAB_VERB "%3.0" "-" COMPU_TAB_REF FORMULA_0409_VTAB /end COMPU_METHOD
/begin COMPU_METHOD FORMULA_0410 "FORMULA_0410" TAB_VERB "%3.0" "-" COMPU_TAB_REF FORMULA_0410_VTAB /end COMPU_METHOD
/begin COMPU_METHOD FORMULA_0411 "FORMULA_0411" TAB_VERB "%3.0" "-" COMPU_TAB_REF FORMULA_0411_VTAB /end COMPU_METHOD
/begin COMPU_METHOD FORMULA_0412 "FORMULA_0412" TAB_VERB "%3.0" "-" COMPU_TAB_REF FORMULA_0412_VTAB /end COMPU_METHOD
/begin COMPU_METHOD FORMULA_0413 "FORMULA_0413" TAB_VERB "%3.0" "-" COMPU_TAB_REF FORMULA_0413_VTAB /end COMPU_METHOD
/begin COMPU_METHOD FORMULA_0414 "FORMULA_0414" TAB_VERB "%3.0" "-" COMPU_TAB_REF FORMULA_0414_VTAB /end COMPU_METHOD
/begin COMPU_METHOD FORMULA_0415 "FORMULA_0415" TAB_VERB "%3.0" "-" COMPU_TAB_REF FORMULA_0415_VTAB /end COMPU_METHOD
/begin COMPU_METHOD FORMULA_0416 "FORMULA_0416" TAB_VERB "%3.0" "-" COMPU_TAB_REF FORMULA_0416_VTAB /end COMPU_METHOD
/begin COMPU_METHOD FORMULA_0417 "FORMULA_0417" TAB_VERB "%3.0" "-" COMPU_TAB_REF FORMULA_0417_VTAB /end COMPU_METHOD
/begin COMPU_METHOD FORMULA_0418 "FORMULA_0418" RAT_FUNC "%5.0" "Upm" COEFFS 0 0 27344 0 1 0 /end COMPU_METHOD
/begin COMPU_METHOD FORMULA_0425 "FORMULA_0425" RAT_FUNC "%3.0" "Bit" COEFFS 0 0.25 0.0 0 0.0 1.0 /end COMPU_METHOD
/begin COMPU_METHOD FORMULA_0426 "FORMULA_0426" TAB_VERB "%5.2" "-" COMPU_TAB_REF FORMULA_0426_VTAB /end COMPU_METHOD
/begin COMPU_METHOD FORMULA_0427 "FORMULA_0427" TAB_VERB "%5.2" "-" COMPU_TAB_REF FORMULA_0427_VTAB /end COMPU_METHOD
/begin COMPU_METHOD FORMULA_0437 "FORMULA_0437" RAT_FUNC "%6.1" "%" COEFFS 0 327.68 0.0 0 0.0 1.0 /end COMPU_METHOD
/begin COMPU_METHOD FORMULA_0455 "FORMULA_0455" RAT_FUNC "%5.2" "s" COEFFS 0 0 2.56 0 1 0 /end COMPU_METHOD
/begin COMPU_METHOD FORMULA_0470 "FORMULA_0470" RAT_FUNC "%6.3" "s" COEFFS 0 0 1.28 0 1 0 /end COMPU_METHOD
/begin COMPU_METHOD FORMULA_0471 "FORMULA_0471" RAT_FUNC "%4.1" "%" COEFFS 0 10.0 0.0 0 0.0 1.0 /end COMPU_METHOD
/begin COMPU_METHOD FORMULA_0479 "FORMULA_0479" RAT_FUNC "%5.0" ".Gang" COEFFS 0 1 0 0 0 1 /end COMPU_METHOD
/begin COMPU_METHOD FORMULA_0492 "FORMULA_0492" RAT_FUNC "%4.1" "s" COEFFS 0 10.0 0.0 0 0.0 1.0 /end COMPU_METHOD
/begin COMPU_METHOD FORMULA_0562 "FORMULA_0562" RAT_FUNC "%5.0" "Nm/s" COEFFS 0 5.e-002 0.0 0 0.0 1.0 /end COMPU_METHOD
/begin COMPU_METHOD FORMULA_0709 "FORMULA_0709" RAT_FUNC "%6.1" "°KW" COEFFS 0 91.02222222222223 0.0 0 0.0 1.0 /end COMPU_METHOD
/begin COMPU_METHOD FORMULA_0745 "FORMULA_0745" RAT_FUNC "%3.0" "Upm" COEFFS 0 1 0 0 0 1 /end COMPU_METHOD
/begin COMPU_METHOD FORMULA_0746 "FORMULA_0746" RAT_FUNC "%5.2" "s" COEFFS 0 0 25.6 0 1 0 /end COMPU_METHOD
/begin COMPU_METHOD FORMULA_0749 "FORMULA_0749" RAT_FUNC "%4.1" "Nm" COEFFS 0 10.0 0.0 0 0.0 1.0 /end COMPU_METHOD
/begin COMPU_METHOD FORMULA_0757 "FORMULA_0757" RAT_FUNC "%5.2" "-" COEFFS 0 128.0 0.0 0 0.0 1.0 /end COMPU_METHOD
/begin COMPU_METHOD FORMULA_0774 "FORMULA_0774" RAT_FUNC "%3.0" "Nm/s" COEFFS 0 0.1 0.0 0 0.0 1.0 /end COMPU_METHOD
/begin COMPU_METHOD FORMULA_0794 "FORMULA_0794" RAT_FUNC "%5.0" "Nm" COEFFS 0 1 0 0 0 1 /end COMPU_METHOD
/begin COMPU_METHOD FORMULA_0806 "FORMULA_0806" RAT_FUNC "%3.0" "Nm/s" COEFFS 0 5.e-002 0.0 0 0.0 1.0 /end COMPU_METHOD
/begin COMPU_METHOD FORMULA_0884 "FORMULA_0884" TAB_VERB "%5.2" "-" COMPU_TAB_REF FORMULA_0884_VTAB /end COMPU_METHOD
/begin COMPU_METHOD FORMULA_0885 "FORMULA_0885" TAB_VERB "%3.0" "-" COMPU_TAB_REF FORMULA_0885_VTAB /end COMPU_METHOD
/begin COMPU_METHOD FORMULA_0886 "FORMULA_0886" RAT_FUNC "%5.0" "mA" COEFFS 0 1.123595505617978 0.0 0 0.0 1.0 /end COMPU_METHOD
/begin COMPU_METHOD FORMULA_0887 "FORMULA_0887" RAT_FUNC "%7.2" "%" COEFFS 0 20.48 0.0 0 0.0 1.0 /end COMPU_METHOD
/begin COMPU_METHOD FORMULA_0888 "FORMULA_0888" RAT_FUNC "%7.2" "Dig" COEFFS 0 1 0 0 0 1 /end COMPU_METHOD
/begin COMPU_METHOD FORMULA_0889 "FORMULA_0889" RAT_FUNC "%3.0" "mA/V*Tast" COEFFS 0 1 0 0 0 1 /end COMPU_METHOD
/begin COMPU_METHOD FORMULA_0890 "FORMULA_0890" RAT_FUNC "%5.0" "Dig/mA" COEFFS 0 1 0 0 0 1 /end COMPU_METHOD
/begin COMPU_METHOD FORMULA_0891 "FORMULA_0891" RAT_FUNC "%5.0" "ms/mA" COEFFS 0 5.e-002 0.0 0 0.0 1.0 /end COMPU_METHOD
/begin COMPU_METHOD FORMULA_0892 "FORMULA_0892" RAT_FUNC "%5.2" "ms" COEFFS 0 0 10240 0 1 0 /end COMPU_METHOD
/begin COMPU_METHOD FORMULA_0893 "FORMULA_0893" TAB_VERB "%5.2" "-" COMPU_TAB_REF FORMULA_0893_VTAB /end COMPU_METHOD
/begin COMPU_METHOD FORMULA_0894 "FORMULA_0894" TAB_VERB "%5.2" "-" COMPU_TAB_REF FORMULA_0894_VTAB /end COMPU_METHOD
/begin COMPU_METHOD FORMULA_0895 "FORMULA_0895" TAB_VERB "%3.0" "-" COMPU_TAB_REF FORMULA_0895_VTAB /end COMPU_METHOD
/begin COMPU_METHOD FORMULA_0896 "FORMULA_0896" RAT_FUNC "%6.1" "%" COEFFS 0 1.28 0.0 0 0.0 1.0 /end COMPU_METHOD
/begin COMPU_METHOD FORMULA_0897 "FORMULA_0897" TAB_VERB "%3.0" "-" COMPU_TAB_REF FORMULA_0897_VTAB /end COMPU_METHOD
/begin COMPU_METHOD FORMULA_0898 "FORMULA_0898" TAB_VERB "%3.0" "-" COMPU_TAB_REF FORMULA_0898_VTAB /end COMPU_METHOD
/begin COMPU_METHOD FORMULA_0899 "FORMULA_0899" TAB_VERB "%3.0" "-" COMPU_TAB_REF FORMULA_0899_VTAB /end COMPU_METHOD
/begin COMPU_METHOD FORMULA_0900 "FORMULA_0900" TAB_VERB "%5.2" "-" COMPU_TAB_REF FORMULA_0900_VTAB /end COMPU_METHOD
/begin COMPU_METHOD FORMULA_0901 "FORMULA_0901" TAB_VERB "%5.2" "-" COMPU_TAB_REF FORMULA_0901_VTAB /end COMPU_METHOD
/begin COMPU_METHOD FORMULA_0902 "FORMULA_0902" TAB_VERB "%5.2" "-" COMPU_TAB_REF FORMULA_0902_VTAB /end COMPU_METHOD
/begin COMPU_METHOD FORMULA_0903 "FORMULA_0903" TAB_VERB "%5.2" "-" COMPU_TAB_REF FORMULA_0903_VTAB /end COMPU_METHOD
/begin COMPU_METHOD FORMULA_0904 "FORMULA_0904" RAT_FUNC "%7.2" "%" COEFFS 0 10.24 0.0 0 0.0 1.0 /end COMPU_METHOD
/begin COMPU_METHOD FORMULA_0905 "FORMULA_0905" TAB_VERB "%5.2" "-" COMPU_TAB_REF FORMULA_0905_VTAB /end COMPU_METHOD
/begin COMPU_METHOD FORMULA_0906 "FORMULA_0906" TAB_VERB "%5.2" "-" COMPU_TAB_REF FORMULA_0906_VTAB /end COMPU_METHOD
/begin COMPU_METHOD FORMULA_0907 "FORMULA_0907" TAB_VERB "%5.2" "-" COMPU_TAB_REF FORMULA_0907_VTAB /end COMPU_METHOD
/begin COMPU_METHOD FORMULA_0908 "FORMULA_0908" TAB_VERB "%5.2" "-" COMPU_TAB_REF FORMULA_0908_VTAB /end COMPU_METHOD
/begin COMPU_METHOD FORMULA_0909 "FORMULA_0909" TAB_VERB "%5.2" "-" COMPU_TAB_REF FORMULA_0909_VTAB /end COMPU_METHOD
/begin COMPU_METHOD FORMULA_0910 "FORMULA_0910" TAB_VERB "%5.2" "-" COMPU_TAB_REF FORMULA_0910_VTAB /end COMPU_METHOD
/begin COMPU_METHOD FORMULA_0911 "FORMULA_0911" TAB_VERB "%5.2" "-" COMPU_TAB_REF FORMULA_0911_VTAB /end COMPU_METHOD
/begin COMPU_METHOD FORMULA_0912 "FORMULA_0912" TAB_VERB "%5.2" "-" COMPU_TAB_REF FORMULA_0912_VTAB /end COMPU_METHOD
/begin COMPU_METHOD FORMULA_0913 "FORMULA_0913" RAT_FUNC "%4.1" "%" COEFFS 0 1.28 0.0 0 0.0 1.0 /end COMPU_METHOD
/begin COMPU_METHOD FORMULA_0914 "FORMULA_0914" RAT_FUNC "%4.1" "%" COEFFS 0 2.56 0.0 0 0.0 1.0 /end COMPU_METHOD
/begin COMPU_METHOD FORMULA_0915 "FORMULA_0915" RAT_FUNC "%10.3" "Nm" COEFFS 0 10000.0 0.0 0 0.0 1.0 /end COMPU_METHOD
/begin COMPU_METHOD FORMULA_0916 "FORMULA_0916" RAT_FUNC "%10.3" "Nm" COEFFS 0 1000.0 0.0 0 0.0 1.0 /end COMPU_METHOD
/begin COMPU_METHOD FORMULA_0917 "FORMULA_0917" TAB_VERB "%5.2" "-" COMPU_TAB_REF FORMULA_0917_VTAB /end COMPU_METHOD
/begin COMPU_METHOD FORMULA_0918 "FORMULA_0918" TAB_VERB "%5.2" "-" COMPU_TAB_REF FORMULA_0918_VTAB /end COMPU_METHOD
/begin COMPU_METHOD FORMULA_0919 "FORMULA_0919" TAB_VERB "%5.2" "-" COMPU_TAB_REF FORMULA_0919_VTAB /end COMPU_METHOD
/begin COMPU_METHOD FORMULA_0920 "FORMULA_0920" TAB_VERB "%5.2" "-" COMPU_TAB_REF FORMULA_0920_VTAB /end COMPU_METHOD
/begin COMPU_METHOD FORMULA_0921 "FORMULA_0921" RAT_FUNC "%8.1" "Nm" COEFFS 0 1000.0 0.0 0 0.0 1.0 /end COMPU_METHOD
/begin COMPU_METHOD FORMULA_0922 "FORMULA_0922" TAB_VERB "%5.2" "-" COMPU_TAB_REF FORMULA_0922_VTAB /end COMPU_METHOD
/begin COMPU_METHOD FORMULA_0923 "FORMULA_0923" RAT_FUNC "%4.1" "%" COEFFS 0 1.28 0.0 0 0.0 1.0 /end COMPU_METHOD
/begin COMPU_METHOD FORMULA_0924 "FORMULA_0924" RAT_FUNC "%5.0" "ms" COEFFS 0 1.6 0.0 0 0.0 1.0 /end COMPU_METHOD
/begin COMPU_METHOD FORMULA_0925 "FORMULA_0925" TAB_VERB "%5.2" "-" COMPU_TAB_REF FORMULA_0925_VTAB /end COMPU_METHOD
/begin COMPU_METHOD FORMULA_0926 "FORMULA_0926" RAT_FUNC "%5.2" "Nms2" COEFFS 0 128.0 0.0 0 0.0 1.0 /end COMPU_METHOD
/begin COMPU_METHOD FORMULA_0927 "FORMULA_0927" TAB_VERB "%7.2" "-" COMPU_TAB_REF FORMULA_0927_VTAB /end COMPU_METHOD
/begin COMPU_METHOD FORMULA_0928 "FORMULA_0928" RAT_FUNC "%5.0" "km" COEFFS 0 1 0 0 0 1 /end COMPU_METHOD
/begin COMPU_METHOD FORMULA_0929 "FORMULA_0929" RAT_FUNC "%4.1" "%" COEFFS 0 10.24 0.0 0 0.0 1.0 /end COMPU_METHOD
/begin COMPU_METHOD FORMULA_0930 "FORMULA_0930" TAB_VERB "%5.2" "-" COMPU_TAB_REF FORMULA_0930_VTAB /end COMPU_METHOD
/begin COMPU_METHOD FORMULA_0931 "FORMULA_0931" TAB_VERB "%5.2" "-" COMPU_TAB_REF FORMULA_0931_VTAB /end COMPU_METHOD
/begin COMPU_METHOD FORMULA_0932 "FORMULA_0932" RAT_FUNC "%6.3" "Nm/Upm" COEFFS 0 1000.0 0.0 0 0.0 1.0 /end COMPU_METHOD
/begin COMPU_METHOD FORMULA_0933 "FORMULA_0933" RAT_FUNC "%5.0" "Nm/s" COEFFS 0 10.0 0.0 0 0.0 1.0 /end COMPU_METHOD
/begin COMPU_METHOD FORMULA_0934 "FORMULA_0934" RAT_FUNC "%7.4" "Nms/Upm" COEFFS 0 10000.0 0.0 0 0.0 1.0 /end COMPU_METHOD
/begin COMPU_METHOD FORMULA_0935 "FORMULA_0935" RAT_FUNC "%5.0" "%" COEFFS 0 10.24 0.0 0 0.0 1.0 /end COMPU_METHOD
/begin COMPU_METHOD FORMULA_0936 "FORMULA_0936" TAB_VERB "%5.2" "-" COMPU_TAB_REF FORMULA_0936_VTAB /end COMPU_METHOD
/begin COMPU_METHOD FORMULA_0937 "FORMULA_0937" RAT_FUNC "%5.2" "cm" COEFFS 0 1 0 0 0 1 /end COMPU_METHOD
/begin COMPU_METHOD FORMULA_0938 "FORMULA_0938" TAB_VERB "%5.2" "-" COMPU_TAB_REF FORMULA_0938_VTAB /end COMPU_METHOD
/begin COMPU_METHOD FORMULA_0939 "FORMULA_0939" RAT_FUNC "%4.1" "%FW" COEFFS 0 1.28 0.0 0 0.0 1.0 /end COMPU_METHOD
/begin COMPU_METHOD FORMULA_0940 "FORMULA_0940" RAT_FUNC "%4.1" "%t_END" COEFFS 0 1.28 0.0 0 0.0 1.0 /end COMPU_METHOD
/begin COMPU_METHOD FORMULA_0941 "FORMULA_0941" RAT_FUNC "%6.1" "2" COEFFS 0 128.0 0.0 0 0.0 1.0 /end COMPU_METHOD
/begin COMPU_METHOD FORMULA_0942 "FORMULA_0942" RAT_FUNC "%3.0" "%" COEFFS 0 1.28 0.0 0 0.0 1.0 /end COMPU_METHOD
/begin COMPU_METHOD FORMULA_0943 "FORMULA_0943" RAT_FUNC "%5.2" "Nm/Upm" COEFFS 0 100.0 0.0 0 0.0 1.0 /end COMPU_METHOD
/begin COMPU_METHOD FORMULA_0944 "FORMULA_0944" RAT_FUNC "%5.2" "Nm/Upm" COEFFS 0 10.0 0.0 0 0.0 1.0 /end COMPU_METHOD
/begin COMPU_METHOD FORMULA_0945 "FORMULA_0945" RAT_FUNC "%6.3" "Nms/Upm" COEFFS 0 1000.0 0.0 0 0.0 1.0 /end COMPU_METHOD
/begin COMPU_METHOD FORMULA_0946 "FORMULA_0946" RAT_FUNC "%3.0" "Prog" COEFFS 0 1 0 0 0 1 /end COMPU_METHOD
/begin COMPU_METHOD FORMULA_0947 "FORMULA_0947" RAT_FUNC "%5.2" "-" COEFFS 0 128.0 -128.0 0 0.0 1.0 /end COMPU_METHOD
/begin COMPU_METHOD FORMULA_0948 "FORMULA_0948" RAT_FUNC "%5.0" "Nm/s" COEFFS 0 0.1 0.0 0 0.0 1.0 /end COMPU_METHOD
/begin COMPU_METHOD FORMULA_0949 "FORMULA_0949" TAB_VERB "%3.0" "-" COMPU_TAB_REF FORMULA_0949_VTAB /end COMPU_METHOD
/begin COMPU_METHOD FORMULA_0950 "FORMULA_0950" TAB_VERB "%5.2" "-" COMPU_TAB_REF FORMULA_0950_VTAB /end COMPU_METHOD
/begin COMPU_METHOD FORMULA_0951 "FORMULA_0951" TAB_VERB "%5.2" "-" COMPU_TAB_REF FORMULA_0951_VTAB /end COMPU_METHOD
/begin COMPU_METHOD FORMULA_0952 "FORMULA_0952" TAB_VERB "%5.2" "-" COMPU_TAB_REF FORMULA_0952_VTAB /end COMPU_METHOD
/begin COMPU_METHOD FORMULA_0953 "FORMULA_0953" TAB_VERB "%5.2" "-" COMPU_TAB_REF FORMULA_0953_VTAB /end COMPU_METHOD
/begin COMPU_METHOD FORMULA_0954 "FORMULA_0954" RAT_FUNC "%4.1" "km/h" COEFFS 0 16.0 0.0 0 0.0 1.0 /end COMPU_METHOD
/begin COMPU_METHOD FORMULA_0955 "FORMULA_0955" TAB_VERB "%3.0" "-" COMPU_TAB_REF FORMULA_0955_VTAB /end COMPU_METHOD
/begin COMPU_METHOD FORMULA_0956 "FORMULA_0956" TAB_VERB "%5.2" "-" COMPU_TAB_REF FORMULA_0956_VTAB /end COMPU_METHOD
/begin COMPU_METHOD FORMULA_0957 "FORMULA_0957" TAB_VERB "%5.2" "-" COMPU_TAB_REF FORMULA_0957_VTAB /end COMPU_METHOD
/begin COMPU_METHOD FORMULA_0958 "FORMULA_0958" TAB_VERB "%3.0" "-" COMPU_TAB_REF FORMULA_0958_VTAB /end COMPU_METHOD
/begin COMPU_METHOD FORMULA_0959 "FORMULA_0959" TAB_VERB "%3.0" "-" COMPU_TAB_REF FORMULA_0959_VTAB /end COMPU_METHOD
/begin COMPU_METHOD FORMULA_0960 "FORMULA_0960" TAB_VERB "%3.0" "-" COMPU_TAB_REF FORMULA_0960_VTAB /end COMPU_METHOD
/begin COMPU_METHOD FORMULA_0975 "FORMULA_0975" RAT_FUNC "%8.3" "°C" COEFFS 0 40.0 10926.0 0 0.0 1.0 /end COMPU_METHOD
/begin COMPU_METHOD FORMULA_1014 "FORMULA_1014" RAT_FUNC "%3.0" "us" COEFFS 0 0.875 0.0 0 0.0 1.0 /end COMPU_METHOD
/begin COMPU_METHOD FORMULA_1015 "FORMULA_1015" RAT_FUNC "%6.1" "°C" COEFFS 0 40.0 10928.0 0 0.0 1.0 /end COMPU_METHOD
/begin COMPU_METHOD FORMULA_1016 "FORMULA_1016" TAB_VERB "%3.0" "-" COMPU_TAB_REF FORMULA_1016_VTAB /end COMPU_METHOD
/begin COMPU_METHOD FORMULA_1017 "FORMULA_1017" RAT_FUNC "%8.3" "Kelvin" COEFFS 0 40.0 0.0 0 0.0 1.0 /end COMPU_METHOD
/begin COMPU_VTAB FORMULA_0002_VTAB "FORMULA_0002_VTAB" TAB_VERB 4 0 "in Ordnung" 128 "queue full" 64 "queue fehler" 32 "IRQ illegal" DEFAULT_VALUE "undefiniert" /end COMPU_VTAB
/begin COMPU_VTAB FORMULA_0011_VTAB "FORMULA_0011_VTAB" TAB_VERB 14 0 "kein Fehler" 1 "Egasueberwachung" 2 "Momentenueberwachung" 4 "Einspritzueberwachung" 8 "SMG-Ueberwachung" 16 "Systemfehler" 32 "Stackueberwachung" 64 "Resetanzahl" 128 "Gemischfehler" 512 "CRC-Check" 1024 "Taskueberwachung" 2048 "Prozessueberwachung" 4096 "Pedalwertgeber" 8192 "Mastervac" DEFAULT_VALUE "undef" /end COMPU_VTAB
/begin COMPU_VTAB FORMULA_0015_VTAB "FORMULA_0015_VTAB" TAB_VERB 6 512 "MCI" 768 "DataAcc" 1024 "IntrAcc" 1536 "Align" 1792 "PrgExc" 8192 "NMI" /end COMPU_VTAB
/begin COMPU_VTAB FORMULA_0116_VTAB "FORMULA_0116_VTAB" TAB_VERB 8 0 "O.K." 1 "BusOff" 2 "DPR" 4 "Timeout" 5 "BusOff+Timeout" 8 "Overflow" 16 "Chksum" 32 "Alive" DEFAULT_VALUE "Mehrfachfehler" /end COMPU_VTAB
/begin COMPU_VTAB FORMULA_0167_VTAB "FORMULA_0167_VTAB" TAB_VERB 1 0 "kein Fehler" /end COMPU_VTAB
/begin COMPU_VTAB FORMULA_0179_VTAB "FORMULA_0179_VTAB" TAB_VERB 1 0 "alle ein" /end COMPU_VTAB
/begin COMPU_VTAB FORMULA_0267_VTAB "FORMULA_0267_VTAB" TAB_VERB 6 0 "Inaktiv" 1 "Aktiv" 3 "Aktiv+SA" 4 "TZ frei" 5 "Aktiv+TZ" 7 "Aktiv+TZ+SA" DEFAULT_VALUE "undef" /end COMPU_VTAB
/begin COMPU_VTAB FORMULA_0362_VTAB "FORMULA_0362_VTAB" TAB_VERB 2 0 "Aus" 1 "Ein" /end COMPU_VTAB
/begin COMPU_VTAB FORMULA_0367_VTAB "FORMULA_0367_VTAB" TAB_VERB 1 0 "Inaktiv" DEFAULT_VALUE "Aktiv" /end COMPU_VTAB
/begin COMPU_VTAB FORMULA_0368_VTAB "FORMULA_0368_VTAB" TAB_VERB 2 0 "SK aus" 1 "SK aktiv" /end COMPU_VTAB
/begin COMPU_VTAB FORMULA_0369_VTAB "FORMULA_0369_VTAB" TAB_VERB 5 0 "Aus" 1 "MVAC" 2 "ELUP" 3 "MVAC+ELUP" 6 "System" /end COMPU_VTAB
/begin COMPU_VTAB FORMULA_0370_VTAB "FORMULA_0370_VTAB" TAB_VERB 8 0 "Inaktiv" 1 "D-CRC" 2 "P-CRC" 3 "PD-CRC" 4 "B-CRC" 5 "BD-CRC" 6 "BP-CRC" 7 "BPD-CRC" /end COMPU_VTAB
/begin COMPU_VTAB FORMULA_0371_VTAB "FORMULA_0371_VTAB" TAB_VERB 8 0 "alle an" 3 "LA" 12 "LAA" 15 "LA+LAA" 48 "Mager" 51 "LA+Mager" 60 "LAA+Mager" 63 "LA+LAA+Mager" /end COMPU_VTAB
/begin COMPU_VTAB FORMULA_0372_VTAB "FORMULA_0372_VTAB" TAB_VERB 8 0 "alle an" 1 "LA" 2 "LAA" 3 "LA+LAA" 4 "Mager" 5 "LA+Mager" 6 "LAA+Mager" 7 "LA+LAA+Mager" /end COMPU_VTAB
/begin COMPU_VTAB FORMULA_0373_VTAB "FORMULA_0373_VTAB" TAB_VERB 2 0 "aktiv" 1 "gesperrt" /end COMPU_VTAB
/begin COMPU_VTAB FORMULA_0374_VTAB "FORMULA_0374_VTAB" TAB_VERB 23 0 "kein Fehler" 5 "Motortemperatur" 6 "Oeltemperatur" 10 "SMG-Schaltablauf" 11 "SMG-Eingriff" 12 "SMG-Sollmoment" 13 "SMG-nGetr" 14 "SMG-Gang" 20 "LLR-Plausi" 21 "Minimalmoment" 22 "Maximalmoment" 23 "Istmoment" 24 "Schleppmoment" 25 "Soll-Istvergleich" 26 "rel. Fahrerwunsch" 30 "Luftmasse" 40 "Drehzahl" 50 "Pedalwert" 60 "Bremslichtschalter" 80 "Komplementvergleich" 85 "Fehler Testrechnung" 86 "Timeout Testrechnung" 90 "Maxdrehzahl" /end COMPU_VTAB
/begin COMPU_VTAB FORMULA_0375_VTAB "FORMULA_0375_VTAB" TAB_VERB 2 0 "frei" 128 "Belegt" DEFAULT_VALUE "undefiniert" /end COMPU_VTAB
/begin COMPU_VTAB FORMULA_0376_VTAB "FORMULA_0376_VTAB" TAB_VERB 5 8192 "S65" 8448 "S65FLACH" 8704 "S65V" 256 "S15" 16384 "S85" DEFAULT_VALUE "undefiniert" /end COMPU_VTAB
/begin COMPU_VTAB FORMULA_0377_VTAB "FORMULA_0377_VTAB" TAB_VERB 7 16 "E60" 17 "E63" 18 "E64" 32 "E65" 64 "E85" 128 "E90" 129 "E91" DEFAULT_VALUE "undefiniert" /end COMPU_VTAB
/begin COMPU_VTAB FORMULA_0378_VTAB "FORMULA_0378_VTAB" TAB_VERB 4 16 "HS" 64 "SMG" 128 "DKG" 255 "CAN_ID" DEFAULT_VALUE "undefiniert" /end COMPU_VTAB
/begin COMPU_VTAB FORMULA_0379_VTAB "FORMULA_0379_VTAB" TAB_VERB 5 1 "ECE" 2 "US" 4 "Golfstaaten" 8 "ZA" 16 "JAPAN" DEFAULT_VALUE "undefiniert" /end COMPU_VTAB
/begin COMPU_VTAB FORMULA_0380_VTAB "FORMULA_0380_VTAB" TAB_VERB 6 16 "EU3" 17 "EU4" 1 "D4" 32 "LEV" 33 "LEV2" 34 "ULEV" DEFAULT_VALUE "undefiniert" /end COMPU_VTAB
/begin COMPU_VTAB FORMULA_0381_VTAB "FORMULA_0381_VTAB" TAB_VERB 3 1 "MIL_OFF" 2 "MIL_FSP" 4 "MIL_ON" DEFAULT_VALUE "undefiniert" /end COMPU_VTAB
/begin COMPU_VTAB FORMULA_0382_VTAB "FORMULA_0382_VTAB" TAB_VERB 2 128 "Serienstand" 1 "Entwicklung" DEFAULT_VALUE "undefiniert" /end COMPU_VTAB
/begin COMPU_VTAB FORMULA_0383_VTAB "FORMULA_0383_VTAB" TAB_VERB 2 1 "CAN 11H" 2 "CAN 12H" DEFAULT_VALUE "undefiniert" /end COMPU_VTAB
/begin COMPU_VTAB FORMULA_0384_VTAB "FORMULA_0384_VTAB" TAB_VERB 3 0 "Fz-Betrieb" 1 "Pruefstand" 2 "Rolle" /end COMPU_VTAB
/begin COMPU_VTAB FORMULA_0385_VTAB "FORMULA_0385_VTAB" TAB_VERB 4 0 "auto Erkennung" 1 "ApplDFlash, rest auto" 2 "ETH aus, rest auto" 3 "ApplDFlash, ETH aus" DEFAULT_VALUE "ungueltig" /end COMPU_VTAB
/begin COMPU_VTAB FORMULA_0386_VTAB "FORMULA_0386_VTAB" TAB_VERB 2 0 "Teves" 1 "Bosch" /end COMPU_VTAB
/begin COMPU_VTAB FORMULA_0387_VTAB "FORMULA_0387_VTAB" TAB_VERB 3 0 "Aus" 1 "dSPACE" 2 "noLoop" /end COMPU_VTAB
/begin COMPU_VTAB FORMULA_0388_VTAB "FORMULA_0388_VTAB" TAB_VERB 2 0 "Dauerbestromung TPU" 1 "Dauerbestromung Treiber" DEFAULT_VALUE "undef" /end COMPU_VTAB
/begin COMPU_VTAB FORMULA_0389_VTAB "FORMULA_0389_VTAB" TAB_VERB 5 1 "Boot" 2 "FpFlash/iD" 4 "FpRAM/iD" 10 "FpFlash/eD" 12 "FpRAM/eD" DEFAULT_VALUE "undefiniert" /end COMPU_VTAB
/begin COMPU_VTAB FORMULA_0390_VTAB "FORMULA_0390_VTAB" TAB_VERB 3 0 "Prozessor" 1 "Selbst" 2 "Kollege" DEFAULT_VALUE "undef" /end COMPU_VTAB
/begin COMPU_VTAB FORMULA_0391_VTAB "FORMULA_0391_VTAB" TAB_VERB 1 0 "no" DEFAULT_VALUE "ja" /end COMPU_VTAB
/begin COMPU_VTAB FORMULA_0392_VTAB "FORMULA_0392_VTAB" TAB_VERB 1 0 "no" DEFAULT_VALUE "ja" /end COMPU_VTAB
/begin COMPU_VTAB FORMULA_0393_VTAB "FORMULA_0393_VTAB" TAB_VERB 1 0 "no" DEFAULT_VALUE "ja" /end COMPU_VTAB
/begin COMPU_VTAB FORMULA_0394_VTAB "FORMULA_0394_VTAB" TAB_VERB 1 0 "no" DEFAULT_VALUE "ja" /end COMPU_VTAB
/begin COMPU_VTAB FORMULA_0395_VTAB "FORMULA_0395_VTAB" TAB_VERB 1 0 "no" DEFAULT_VALUE "ja" /end COMPU_VTAB
/begin COMPU_VTAB FORMULA_0396_VTAB "FORMULA_0396_VTAB" TAB_VERB 1 0 "no" DEFAULT_VALUE "ja" /end COMPU_VTAB
/begin COMPU_VTAB FORMULA_0397_VTAB "FORMULA_0397_VTAB" TAB_VERB 1 0 "no" DEFAULT_VALUE "ja" /end COMPU_VTAB
/begin COMPU_VTAB FORMULA_0398_VTAB "FORMULA_0398_VTAB" TAB_VERB 1 0 "no" DEFAULT_VALUE "ja" /end COMPU_VTAB
/begin COMPU_VTAB FORMULA_0399_VTAB "FORMULA_0399_VTAB" TAB_VERB 1 0 "no" DEFAULT_VALUE "ja" /end COMPU_VTAB
/begin COMPU_VTAB FORMULA_0400_VTAB "FORMULA_0400_VTAB" TAB_VERB 1 0 "no" DEFAULT_VALUE "ja" /end COMPU_VTAB
/begin COMPU_VTAB FORMULA_0401_VTAB "FORMULA_0401_VTAB" TAB_VERB 1 0 "no" DEFAULT_VALUE "ja" /end COMPU_VTAB
/begin COMPU_VTAB FORMULA_0402_VTAB "FORMULA_0402_VTAB" TAB_VERB 1 0 "no" DEFAULT_VALUE "ja" /end COMPU_VTAB
/begin COMPU_VTAB FORMULA_0403_VTAB "FORMULA_0403_VTAB" TAB_VERB 1 0 "no" DEFAULT_VALUE "ja" /end COMPU_VTAB
/begin COMPU_VTAB FORMULA_0405_VTAB "FORMULA_0405_VTAB" TAB_VERB 59 0 "kein Fehler" 1 "Adaptionsdaten CRC32" 2 "Programm CRC32" 3 "Daten CRC32" 4 "undef" 5 "undef" 6 "Watchdog-Reset" 7 "Reset" 8 "CRC Boot" 9 "Reset-MCI" 10 "Reset-Data" 11 "Reset-Instr" 13 "Reset-Align" 14 "Reset-Prog" 15 "Reset-NoFp" 19 "Reset-System" 20 "Reset-Trace" 21 "Reset-FpAss" 22 "Reset-Perform" 23 "Reset-SwEmu" 26 "Reset-InstrProt" 27 "Reset-DataProt" 35 "Reset-DataBrk" 36 "Reset-InstrBrk" 37 "Reset-MaskBrk" 38 "Reset-NMIBrk" 39 "Reset-NMI" 40 "Reset-Reserve" 41 "HW_INDEX zu klein" 42 "ADAPT Loeschen" 43 "ADAPT Schreiben" 44 "ADAPT Hochlauf" 50 "SK-Resetausloesung" 51 "ADC" 52 "TZ-TPU Pin" 53 "TZ-TREIBER Pin" 54 "DSP-Bus" 55 "DSP-Stack" 56 "DSP-Watchdog" 57 "DSP-Programm" 58 "DSP-Daten" 59 "DSP-CRC" 60 "ZUST_NL IGN Timeout" 61 "DSP-Zylinder" 62 "FPGA Init Pin NHigh1" 63 "FPGA Init Pin NHigh2" 64 "FPGA Done Pin NHigh" 65 "FPGA Kennung-CRC32" 66 "RAM" 67 "Register" 68 "TPU RAM" 69 "QADC0 CCW" 70 "QADC1 CCW" 71 "SPI-ATIC39 Chain" 72 "SPI-ATIC35 Chain" 73 "SPI-ATIC29 Chain" 74 "Interne Spannung" 75 "OS-Tasksystem" 76 "OS-Stack" DEFAULT_VALUE "undef" /end COMPU_VTAB
/begin COMPU_VTAB FORMULA_0407_VTAB "FORMULA_0407_VTAB" TAB_VERB 5 0 "sync - 720° Mode" 1 "sync - 360° Mode" 129 "suche Luecke" 161 "Zahnentprellung laeuft" 225 "nicht sync." /end COMPU_VTAB
/begin COMPU_VTAB FORMULA_0409_VTAB "FORMULA_0409_VTAB" TAB_VERB 1 0 "Kein Interrupt." DEFAULT_VALUE "Mind. Einfachinterrupt." /end COMPU_VTAB
/begin COMPU_VTAB FORMULA_0410_VTAB "FORMULA_0410_VTAB" TAB_VERB 1 0 "nein." DEFAULT_VALUE "aktiv." /end COMPU_VTAB
/begin COMPU_VTAB FORMULA_0411_VTAB "FORMULA_0411_VTAB" TAB_VERB 1 0 "nein." DEFAULT_VALUE "aktiv." /end COMPU_VTAB
/begin COMPU_VTAB FORMULA_0412_VTAB "FORMULA_0412_VTAB" TAB_VERB 1 0 "nein." DEFAULT_VALUE "aktiv." /end COMPU_VTAB
/begin COMPU_VTAB FORMULA_0413_VTAB "FORMULA_0413_VTAB" TAB_VERB 1 0 "nein." DEFAULT_VALUE "aktiv." /end COMPU_VTAB
/begin COMPU_VTAB FORMULA_0414_VTAB "FORMULA_0414_VTAB" TAB_VERB 1 0 "nein." DEFAULT_VALUE "aktiv." /end COMPU_VTAB
/begin COMPU_VTAB FORMULA_0415_VTAB "FORMULA_0415_VTAB" TAB_VERB 1 0 "nein." DEFAULT_VALUE "aktiv." /end COMPU_VTAB
/begin COMPU_VTAB FORMULA_0416_VTAB "FORMULA_0416_VTAB" TAB_VERB 1 0 "nein." DEFAULT_VALUE "aktiv." /end COMPU_VTAB
/begin COMPU_VTAB FORMULA_0417_VTAB "FORMULA_0417_VTAB" TAB_VERB 1 0 "nein." DEFAULT_VALUE "aktiv." /end COMPU_VTAB
/begin COMPU_VTAB FORMULA_0426_VTAB "FORMULA_0426_VTAB" TAB_VERB 5 0 "offen" 1 "geschlossen" 2 "oeffnet" 3 "schliesst" 7 "Fehler" /end COMPU_VTAB
/begin COMPU_VTAB FORMULA_0427_VTAB "FORMULA_0427_VTAB" TAB_VERB 11 0 "Geschaltet" 1 "Aktiv" 2 "ZWK aktiv" 3 "synchronisiert" 4 "SW Neutral" 5 "vorspannen" 6 "Init" 7 "Synchron fertig" 8 "vor Synchron" 9 "vor Synchron aktiv" 15 "Fehler" /end COMPU_VTAB
/begin COMPU_VTAB FORMULA_0884_VTAB "FORMULA_0884_VTAB" TAB_VERB 2 0 "Vanos-Fak" 1 "Restgasmdl" /end COMPU_VTAB
/begin COMPU_VTAB FORMULA_0885_VTAB "FORMULA_0885_VTAB" TAB_VERB 2 1 "Komfort" 2 "Sport" DEFAULT_VALUE "undef" /end COMPU_VTAB
/begin COMPU_VTAB FORMULA_0893_VTAB "FORMULA_0893_VTAB" TAB_VERB 2 1 "Komfort" 2 "Sport" /end COMPU_VTAB
/begin COMPU_VTAB FORMULA_0894_VTAB "FORMULA_0894_VTAB" TAB_VERB 2 0 "Servo ein" 1 "Servo aus" /end COMPU_VTAB
/begin COMPU_VTAB FORMULA_0895_VTAB "FORMULA_0895_VTAB" TAB_VERB 5 0 "ZWD aus" 1 "ZWD ein" 2 "OBD anst." 4 "Test mode" 8 "EXD-Tester" DEFAULT_VALUE "ungueltig" /end COMPU_VTAB
/begin COMPU_VTAB FORMULA_0897_VTAB "FORMULA_0897_VTAB" TAB_VERB 1 0 "gesperrt" DEFAULT_VALUE "frei" /end COMPU_VTAB
/begin COMPU_VTAB FORMULA_0898_VTAB "FORMULA_0898_VTAB" TAB_VERB 1 0 "PT1" DEFAULT_VALUE "Rampe" /end COMPU_VTAB
/begin COMPU_VTAB FORMULA_0899_VTAB "FORMULA_0899_VTAB" TAB_VERB 1 0 "nein" DEFAULT_VALUE "erkannt" /end COMPU_VTAB
/begin COMPU_VTAB FORMULA_0900_VTAB "FORMULA_0900_VTAB" TAB_VERB 11 0 "undef" 1 "Anfahren" 2 "Anfahren-KD" 3 "Wait-RS" 4 "Anfahren-RS" 5 "Schalten" 6 "Einkuppeln" 7 "Anhalten" 8 "Abwuergen" 9 "Radabriss" 15 "Fehler" /end COMPU_VTAB
/begin COMPU_VTAB FORMULA_0901_VTAB "FORMULA_0901_VTAB" TAB_VERB 1 0 "EKR frei" DEFAULT_VALUE "EKR gesperrt" /end COMPU_VTAB
/begin COMPU_VTAB FORMULA_0902_VTAB "FORMULA_0902_VTAB" TAB_VERB 1 0 "EKR frei" DEFAULT_VALUE "EKR gesperrt" /end COMPU_VTAB
/begin COMPU_VTAB FORMULA_0903_VTAB "FORMULA_0903_VTAB" TAB_VERB 2 0 "Kupplungsschlupf" 1 "kein Schlupf" DEFAULT_VALUE "undefiniert" /end COMPU_VTAB
/begin COMPU_VTAB FORMULA_0905_VTAB "FORMULA_0905_VTAB" TAB_VERB 11 0 "Inaktiv" 1 "Abregeln" 2 "Schalten" 3 "Aufregeln" 4 "AKS aktiv" 5 "Anfahren" 6 "Auf-LW" 67 "Auf+Ext" 129 "Ab+Korr" 131 "Auf+Korr" 195 "Auf+Korr+Ext" /end COMPU_VTAB
/begin COMPU_VTAB FORMULA_0906_VTAB "FORMULA_0906_VTAB" TAB_VERB 1 0 "inaktiv" DEFAULT_VALUE "aktiv" /end COMPU_VTAB
/begin COMPU_VTAB FORMULA_0907_VTAB "FORMULA_0907_VTAB" TAB_VERB 1 0 "inaktiv" DEFAULT_VALUE "aktiv" /end COMPU_VTAB
/begin COMPU_VTAB FORMULA_0908_VTAB "FORMULA_0908_VTAB" TAB_VERB 1 0 "inaktiv" DEFAULT_VALUE "aktiv" /end COMPU_VTAB
/begin COMPU_VTAB FORMULA_0909_VTAB "FORMULA_0909_VTAB" TAB_VERB 1 0 "Begr." DEFAULT_VALUE "Rohwert" /end COMPU_VTAB
/begin COMPU_VTAB FORMULA_0910_VTAB "FORMULA_0910_VTAB" TAB_VERB 1 0 "nein" DEFAULT_VALUE "ja" /end COMPU_VTAB
/begin COMPU_VTAB FORMULA_0911_VTAB "FORMULA_0911_VTAB" TAB_VERB 1 0 "inaktiv" DEFAULT_VALUE "aktiv" /end COMPU_VTAB
/begin COMPU_VTAB FORMULA_0912_VTAB "FORMULA_0912_VTAB" TAB_VERB 1 0 "Inaktiv" DEFAULT_VALUE "Aktiv" /end COMPU_VTAB
/begin COMPU_VTAB FORMULA_0917_VTAB "FORMULA_0917_VTAB" TAB_VERB 4 0 "Inaktiv" 1 "Rampe" 2 "Reduktion" 3 "Rampe+Red" DEFAULT_VALUE "undef" /end COMPU_VTAB
/begin COMPU_VTAB FORMULA_0918_VTAB "FORMULA_0918_VTAB" TAB_VERB 11 0 "Inaktiv" 1 "Abregeln" 2 "n-Ziel" 3 "n-Regler" 4 "Aufregeln" 5 "Abwuergen" 6 "Radabriss" 7 "Ab-AKS" 9 "Anfahren" 10 "TZ-Nachlauf" 11 "ABS-Eingr" /end COMPU_VTAB
/begin COMPU_VTAB FORMULA_0919_VTAB "FORMULA_0919_VTAB" TAB_VERB 1 0 "gleich" DEFAULT_VALUE "aktualisiert" /end COMPU_VTAB
/begin COMPU_VTAB FORMULA_0920_VTAB "FORMULA_0920_VTAB" TAB_VERB 1 0 "ueber" DEFAULT_VALUE "unter" /end COMPU_VTAB
/begin COMPU_VTAB FORMULA_0922_VTAB "FORMULA_0922_VTAB" TAB_VERB 4 0 "DN/STG-" 1 "UP/STG-" 2 "DN/STG+" 3 "UP/STG+" /end COMPU_VTAB
/begin COMPU_VTAB FORMULA_0925_VTAB "FORMULA_0925_VTAB" TAB_VERB 4 0 "kein Abbruch" 1 "Ablauf-Timeout" 2 "CAN-Timeout" 16 "Doppelschaltung" DEFAULT_VALUE "undefiniert" /end COMPU_VTAB
/begin COMPU_VTAB FORMULA_0927_VTAB "FORMULA_0927_VTAB" TAB_VERB 9 0 "kein Fehler" 1 "DME-St" 2 "mKupp" 4 "nZiel" 8 "nGetr" 16 "nBerech" 32 "Gang" 64 "nZielMax" 128 "nGetrMax" DEFAULT_VALUE "Mehrfach" /end COMPU_VTAB
/begin COMPU_VTAB FORMULA_0930_VTAB "FORMULA_0930_VTAB" TAB_VERB 2 0 "AKS bei Passiv" 1 "AKS bei Sport" /end COMPU_VTAB
/begin COMPU_VTAB FORMULA_0931_VTAB "FORMULA_0931_VTAB" TAB_VERB 3 0 "aus" 1 "n-Regler" 2 "Automat-Prg" /end COMPU_VTAB
/begin COMPU_VTAB FORMULA_0936_VTAB "FORMULA_0936_VTAB" TAB_VERB 1 0 "ohne Eingriff" DEFAULT_VALUE "mit Eingriff" /end COMPU_VTAB
/begin COMPU_VTAB FORMULA_0938_VTAB "FORMULA_0938_VTAB" TAB_VERB 2 0 "SK aus" 1 "SK ein" /end COMPU_VTAB
/begin COMPU_VTAB FORMULA_0949_VTAB "FORMULA_0949_VTAB" TAB_VERB 8 0 "keine" 1 "SMG1" 2 "SMG2" 3 "SMG1+2" 4 "SMG3" 5 "SMG1+3" 6 "SMG2+3" 7 "SMG1+2+3" /end COMPU_VTAB
/begin COMPU_VTAB FORMULA_0950_VTAB "FORMULA_0950_VTAB" TAB_VERB 1 0 "kein Schaltwunsch" DEFAULT_VALUE "Schaltwusch" /end COMPU_VTAB
/begin COMPU_VTAB FORMULA_0951_VTAB "FORMULA_0951_VTAB" TAB_VERB 1 0 "offen" DEFAULT_VALUE "Kraftschluss" /end COMPU_VTAB
/begin COMPU_VTAB FORMULA_0952_VTAB "FORMULA_0952_VTAB" TAB_VERB 1 0 "FGR ein" DEFAULT_VALUE "FGR aus" /end COMPU_VTAB
/begin COMPU_VTAB FORMULA_0953_VTAB "FORMULA_0953_VTAB" TAB_VERB 1 0 "HE aus" DEFAULT_VALUE "HE ein" /end COMPU_VTAB
/begin COMPU_VTAB FORMULA_0955_VTAB "FORMULA_0955_VTAB" TAB_VERB 8 0 "aus" 1 "Getr-Adapt" 2 "Getr-Ausl" 3 "Kupp-Adapt" 4 "GW-Adapt" 5 "a-Laengs" 6 "KKL-Default" 255 "Fehler" DEFAULT_VALUE "undef" /end COMPU_VTAB
/begin COMPU_VTAB FORMULA_0956_VTAB "FORMULA_0956_VTAB" TAB_VERB 5 0 "kein Fehler" 1 "DME-Status" 2 "Motor-Eingr" 4 "nGetr" 8 "Gang" DEFAULT_VALUE "Mehrfachfehler" /end COMPU_VTAB
/begin COMPU_VTAB FORMULA_0957_VTAB "FORMULA_0957_VTAB" TAB_VERB 5 0 "Inaktiv" 1 "Abregeln" 2 "Schalten" 3 "Aufregeln" 4 "Ende" /end COMPU_VTAB
/begin COMPU_VTAB FORMULA_0958_VTAB "FORMULA_0958_VTAB" TAB_VERB 1 0 "Schub" DEFAULT_VALUE "Zug" /end COMPU_VTAB
/begin COMPU_VTAB FORMULA_0959_VTAB "FORMULA_0959_VTAB" TAB_VERB 1 0 "Frei" DEFAULT_VALUE "Sperre" /end COMPU_VTAB
/begin COMPU_VTAB FORMULA_0960_VTAB "FORMULA_0960_VTAB" TAB_VERB 3 0 "aus" 1 "an" 2 "Sperre SH_TO_UB" /end COMPU_VTAB
/begin COMPU_VTAB FORMULA_1016_VTAB "FORMULA_1016_VTAB" TAB_VERB 2 0 "Konstante" 1 "Modell" /end COMPU_VTAB
/begin FUNCTION rf_kor ""
 /begin DEF_CHARACTERISTIC AXIS_RF_KOR_MD_RF_PT_SOLL8 AXIS_RF_KOR_N_LW12 GKF_RF_KOR_KOE_A GKF_RF_KOR_KOE_B GKF_RF_KOR_KOE_C GKF_RF_KOR_KOE_D GKF_RF_KOR_KOE_E GKF_RF_KOR_KOE_F GKF_RF_KOR_KOE_G GKF_RF_KOR_KOE_H GKF_RF_KOR_KOE_I K_RF_KOR_CFG K_RF_KOR_VAN_MAX K_RF_KOR_VAN_MIN K_RF_KOR_VAN_SPR_MAX_Auslass K_RF_KOR_VAN_SPR_MAX_Einlass K_RF_KOR_VAN_SPR_MIN_Auslass K_RF_KOR_VAN_SPR_MIN_Einlass /end DEF_CHARACTERISTIC
 /begin OUT_MEASUREMENT rf_kor_md_rf_soll_pt_sst8 rf_kor_n_lw_sst8 rf_kor_van_ist_b1 rf_kor_van_ist_b2 rf_kor_van_ist_roh_b1 rf_kor_van_ist_roh_b2 rf_kor_van_koe_a rf_kor_van_koe_b rf_kor_van_koe_c rf_kor_van_koe_d rf_kor_van_koe_e rf_kor_van_koe_f rf_kor_van_koe_g rf_kor_van_koe_h rf_kor_van_koe_i rf_kor_van_soll rf_kor_van_soll_roh /end OUT_MEASUREMENT
/end FUNCTION
/begin FUNCTION RTA "" /end FUNCTION
/begin FUNCTION Saugrohtwandtemperatur ""
 /begin DEF_CHARACTERISTIC K_TSGRW_CFG K_TSGRW_TAU K_TSGRW_TAU_MS K_TSGRW_TU KL_TSGRW_F KL_TSGRW_OFFS /end DEF_CHARACTERISTIC
 /begin OUT_MEASUREMENT tsgrw_filter_b1 tsgrw_filter_b2 tsgrw_roh_b1 tsgrw_roh_b2 /end OUT_MEASUREMENT
/end FUNCTION
/begin FUNCTION Schalter ""
 /begin DEF_CHARACTERISTIC K_SCHALTER_BLS_ENTPRELLUNG_E2 K_SCHALTER_KS_M_AUF K_SCHALTER_KS_M_ZU /end DEF_CHARACTERISTIC
 /begin OUT_MEASUREMENT schalter_bls_ad_ign schalter_bls_entprell_cnt_e2 schalter_kl87_ad schalter_st_ign_old schalter_wakeup_ad_ign /end OUT_MEASUREMENT
/end FUNCTION
/begin FUNCTION Servo ""
 /begin DEF_CHARACTERISTIC K_SERVO_KD K_SERVO_KP K_SERVO_SCHALT K_SERVO_STROM_DIAG_KS_UB K_SERVO_STROM_DIAG_MAX_OFFSET K_SERVO_STROM_DIAG_MAX_TAST K_SERVO_STROM_DIAG_MIN_OFFSET K_SERVO_STROM_DIAG_MIN_TAST K_SERVO_STROM_DIAG_OL K_SERVO_STROM_ERSATZ K_SERVO_STROM_SOLL_TAU KL_SERVO_KOMFORT KL_SERVO_SPORT S_SERVO_ABSCHALT S_SERVO_KL /end DEF_CHARACTERISTIC
 /begin OUT_MEASUREMENT servo_di servo_di_old servo_kl_cfg servo_s_cnt servo_strom_ist servo_strom_roh servo_strom_soll servo_strom_soll_roh servo_tast v_servo /end OUT_MEASUREMENT
/end FUNCTION
/begin FUNCTION SG-Konfiguration ""
 /begin DEF_CHARACTERISTIC cfg.abgas cfg.baureihe cfg.betriebsmode cfg.canmess cfg.canstand cfg.diagnose cfg.dsc_typ cfg.getriebetyp cfg.hil cfg.ipm cfg.la_variante cfg.motortyp cfg.peripherie cfg.sg_mode cfg.status /end DEF_CHARACTERISTIC
 /begin OUT_MEASUREMENT cfg_boot_st sys_exc_lr vers_boot vers_boot_index /end OUT_MEASUREMENT
/end FUNCTION
/begin FUNCTION SK-Ebene_2 "" /begin DEF_CHARACTERISTIC K_SK_E2_KOMP_ERR_MAX K_SK_MAX_RESETS_E2 /end DEF_CHARACTERISTIC
 /begin OUT_MEASUREMENT sk_e2_byte sk_e2_byte_err sk_e2_fehler sk_e2_komp_err sk_e2_long sk_e2_long_err sk_e2_word sk_e2_word_err sk_reset_cnt_e2 /end OUT_MEASUREMENT
/end FUNCTION
/begin FUNCTION SK-Manager ""
 /begin DEF_CHARACTERISTIC K_SK_CFG K_SK_CRC32 K_SK_EGAS_OFF K_SK_EGAS_OFF_TIME K_SK_FGR_SPERRE K_SK_FM_EGAS_TEST K_SK_FM_FAIL_ZYL_TEST K_SK_FM_GEMISCH_TEST K_SK_FM_LAM_TEST K_SK_FM_MD_TEST K_SK_FM_MVAC_TEST K_SK_FM_SMG_TEST K_SK_FRA_SPERRE K_SK_KH_SPERRE K_SK_LAM_EINGR K_SK_LAM_EINGR_TI K_SK_LLRA_SPERRE K_SK_MAX_OS_ERR K_SK_MAX_RESETS K_SK_MD_BEGR_DK_OFFEN K_SK_MD_BEGR_EGAS K_SK_MD_BEGR_GEMISCH K_SK_MD_BEGR_MD K_SK_MD_BEGR_MVAC K_SK_MD_BEGR_MVAC_SYS K_SK_MD_BEGR_PWG K_SK_MD_BEGR_RESET K_SK_MD_BEGR_SMG K_SK_MD_BEGR_TI K_SK_MD_TI_EINGR K_SK_MD_VL_SPERRE K_SK_MVAC_KH K_SK_PKS_NOTLAUF K_SK_PROZ_ERR K_SK_T_RESET_DELAY_OS K_SK_TASK_ERR K_SK_TI_OFF_EGAS K_SK_ZYL_OFF_MAX KL_SK_LLR_N_SOLL /end DEF_CHARACTERISTIC
 /begin OUT_MEASUREMENT sk_egas_off_ni sk_egas_off_time_b1 sk_egas_off_time_b2 sk_fail_st_zyl sk_fm_egas_exd sk_fm_gemisch sk_fm_lam sk_fm_ti sk_llr_n_soll_ign sk_md_begr_ni sk_md_begr_st sk_reset_cnt sk_t_reset_delay_os sk_ti_off_st sk_ti_zyl_off_cnt sk_tr_error_cnt sk_tr_retry sk_tr_timeout sk_ursache /end OUT_MEASUREMENT
/end FUNCTION
/begin FUNCTION sl_zwd "" /begin DEF_CHARACTERISTIC K_SL_ZWD_TV_MAX K_SL_ZWD_TV_MIN K_SL_ZWD_TV_SLP_TEST /end DEF_CHARACTERISTIC /begin OUT_MEASUREMENT sl_zwd_st sl_zwd_tv_tpu /end OUT_MEASUREMENT /end FUNCTION
/begin FUNCTION SMG ""
 /begin DEF_CHARACTERISTIC K_SMG_ADAPT_IHAR_CNT K_SMG_ADAPT_IHAR_DFLT K_SMG_ADAPT_IHAR_MAX K_SMG_ADAPT_IHAR_MIN K_SMG_ADAPT_SP_DM_MAX K_SMG_ADAPT_SP_DMD_FW K_SMG_ADAPT_SP_N_MAX K_SMG_ADAPT_SP_N_MIN K_SMG_ADAPT_SP_TOEL K_SMG_ALIVE_ERR_MAX K_SMG_BERG_MD_KW_SCHW K_SMG_BERG_V_MAX_SCHW K_SMG_BERG_V_MIN_SCHW K_SMG_CAN_ED_TSPERR K_SMG_CAN_ED_UB_MIN K_SMG_CAN_KL87_TMAX K_SMG_CAN_TESTMODE K_SMG_CHKSUM_ERR_MAX K_SMG_I_GANG_1 K_SMG_I_GANG_2 K_SMG_I_GANG_3 K_SMG_I_GANG_4 K_SMG_I_GANG_5 K_SMG_I_GANG_6 K_SMG_I_GANG_7 K_SMG_I_GANG_N K_SMG_I_GANG_R K_SMG_I_HA K_SMG_KI_AKS_AY_MAX K_SMG_KI_AKS_DAY_MAX K_SMG_KI_AUF_DSC K_SMG_KI_AUF_DSC2 K_SMG_KI_AUF_EINGR K_SMG_KI_AUF_T_EINGR K_SMG_KI_AUF_ZR K_SMG_KI_CFG K_SMG_KI_DELTA_PWG K_SMG_KI_NEU_AY_MAX K_SMG_KI_SCHALT_DSC K_SMG_KSCHLUPF_AUF K_SMG_KSCHLUPF_DSC K_SMG_KSCHLUPF_N K_SMG_KSCHLUPF_T_SCHW K_SMG_KUPP_AUF_SCHW_N K_SMG_KUPP_DM_ABS K_SMG_KUPP_DM_MIN K_SMG_KUPP_DM_RAB K_SMG_KUPP_DM_SOLL_F K_SMG_KUPP_M_MAX_1 K_SMG_KUPP_M_MAX_2 K_SMG_KUPP_N_KSCHUTZ K_SMG_KUPP_RAMPE_DM K_SMG_KUPP_RAMPE_N K_SMG_KUPP_RAMPE_N_ABW K_SMG_KUPP_RAMPE_UL K_SMG_KUPP_REG_T K_SMG_KUPP_UL_FW_DM K_SMG_KUPP_UL_FW_MAX K_SMG_KUPP_UL_FW_SCHW K_SMG_KUPP_UL_MD_SCHW K_SMG_KUPP_UL_N_SCHW K_SMG_M_NULL K_SMG_MD_FW_HYS_SCH K_SMG_MD_FW_HYS_ZUG K_SMG_MD_FW_MIN_AB K_SMG_MD_FW_MIN_AUF K_SMG_MOT_ABS_DM_MAX K_SMG_MOT_ABS_M_MAX K_SMG_MOT_ABS_M_MIN K_SMG_MOT_ABS_N_OFF K_SMG_MOT_ABS_T_MAX K_SMG_MOT_AKS_N_SCHW K_SMG_MOT_ANF_DM_DSC K_SMG_MOT_ANF_FW_X K_SMG_MOT_ANF_M_MIN K_SMG_MOT_ANF_N_OFF K_SMG_MOT_DN_GANG K_SMG_MOT_DN_REG_I_N K_SMG_MOT_DN_REG_I_P K_SMG_MOT_DN_REG_I_S K_SMG_MOT_DN_REG_T K_SMG_MOT_DN_SOLL_MIN K_SMG_MOT_DN_SOLL_VOR K_SMG_MOT_J_MOTOR_ZR K_SMG_MOT_M_RES_ABW K_SMG_MOT_M_RES_AUF K_SMG_MOT_M_RES_EXT_MAX K_SMG_MOT_M_RES_MAX K_SMG_MOT_M_RES_POS_MAX K_SMG_MOT_M_RES_POS_N K_SMG_MOT_M_RES_RAMPE K_SMG_MOT_M_RES_RAMPE_KS K_SMG_MOT_M_RES_RS K_SMG_MOT_M_RES_SCHA K_SMG_MOT_M_RES_T_MAX K_SMG_MOT_M_VOR_AUF K_SMG_MOT_N_REG_D_MAX K_SMG_MOT_N_REG_D_MIN K_SMG_MOT_N_REG_I_DN K_SMG_MOT_N_REG_I_SCHW K_SMG_MOT_N_REG_I_T K_SMG_MOT_N_REG_I_T_RAB K_SMG_MOT_N_REG_I_UP K_SMG_MOT_N_REG_M_BEGR K_SMG_MOT_N_REG_M_MAX K_SMG_MOT_N_REG_M_STG K_SMG_MOT_N_REG_T_MAX K_SMG_MOT_NL_DELTA_FW K_SMG_MOT_NL_ETA K_SMG_MOT_NL_MD K_SMG_MOT_NL_MD_MAX K_SMG_MOT_NL_T_MAX K_SMG_MOT_NL_TAU K_SMG_MOT_RAB_DM_MAX K_SMG_MOT_RAB_M_MAX K_SMG_MOT_RAB_M_MIN K_SMG_MOT_RAB_T_MAX K_SMG_MOT_RS_N_OFF K_SMG_MOT_RS_N_SCHW K_SMG_MOT_RS_S_SCHW K_SMG_MOT_RS_T_HI K_SMG_MOT_RS_T_LO K_SMG_MOT_RS_TI_TABG K_SMG_MOT_RS_TI_TIME K_SMG_MOT_RSS_MD_EINGR K_SMG_N_ABRISS_ANF K_SMG_N_ABRISS_HYS K_SMG_N_EKR_OFF_BEGR K_SMG_N_NULL K_SMG_N_ZIEL_ABWUERG K_SMG_N_ZIEL_ANF_V_MAX K_SMG_N_ZIEL_HYS K_SMG_N_ZIEL_OFF_BEGR K_SMG_N_ZIEL_OFF_SCH K_SMG_N_ZIEL_OFF_ZH K_SMG_NO_LW_N_SCHW K_SMG_OHNE_EINGR_OFF K_SMG_PROG_EINFAHR_WEG K_SMG_PROG_FETRAWE_WEG K_SMG_PROG_MAX_ANH K_SMG_PROG_MAX_EINFAHR K_SMG_PROG_MAX_FETRAWE K_SMG_PROG_MIN_ANH K_SMG_PROG_MIN_ZR K_SMG_PROG_V_SCHW K_SMG_PWG_FW_SCH K_SMG_PWG_FW_SCH_N_OFF K_SMG_R_DYN K_SMG_SK_CONTROL K_SMG_SK_M_KUPP_MIN K_SMG_SK_MD_SCHW K_SMG_SK_NBERCH_MAX K_SMG_SK_NBERCH_T K_SMG_SK_NGETR_MAX K_SMG_SK_NGETR_T K_SMG_SK_NMAX_FSP K_SMG_SK_NMAX_FSP_INAKTIV K_SMG_SK_NZIEL_MAX K_SMG_SK_NZIEL_T K_SMG_SK_T_DME_ST_MAX K_SMG_SK_T_MAX K_SMG_SK_T_NGETR_MAX K_SMG_SK_T_NZIEL_MAX K_SMG_SK_T_PHASE_MAX_AB K_SMG_SK_T_PHASE_MAX_AUF K_SMG_SK_T_PHASE_MAX_SCHA K_SMG_SK_T_PHASE_N_MAX K_SMG_SK_V_SCHW K_SMG_T_ABREGEL_AKS K_SMG_T_KORR_AB_FW K_SMG_T_KORR_AB_MIN K_SMG_TAU_AX_BERECH K_SMG_TAU_AX_BERG K_SMG_TAU_AX_MESS K_SMG_TAU_DN_FILTER K_SMG_TAU_DN_GETR K_SMG_TAU_DSC_ABS K_SMG_TAU_KSCHLUPF K_SMG_TAU_MD_FAHRER K_SMG_TAU_NGETR_ZIEL K_SMG_TAU_RSCHLUPF K_SMG_TESTMODE K_SMG_TZ_EINGR_T_AB K_SMG_V_KRAFTS_ERSATZ KF_SMG_BW_NULL KF_SMG_KI_AB_K KF_SMG_KI_AB_S KF_SMG_KI_AB_SCH_K KF_SMG_KI_AB_SCH_S KF_SMG_KI_AUF_K KF_SMG_KI_AUF_S KF_SMG_KI_AUF_SCH_K KF_SMG_KI_AUF_SCH_S KF_SMG_KI_SCHA_K KF_SMG_KI_SCHA_S KF_SMG_KI_SCHA_SCH_K KF_SMG_KI_SCHA_SCH_S KF_SMG_KUPP_LW_RAMPE KF_SMG_KUPP_REG_I_SCH KF_SMG_KUPP_REG_I_ZUG KF_SMG_MOT_ANF_M_RAMPE_1R KF_SMG_MOT_ANF_M_RAMPE_2 KF_SMG_MOT_N_REG_M_MAX KF_SMG_MOT_N_REG_P_KO KF_SMG_N_ZIEL_OFF_K KF_SMG_N_ZIEL_OFF_S KF_SMG_T_ABREGEL KF_SMG_T_AUFREGEL KL_SMG_FW_REL_VIRT KL_SMG_KI_AKS_GANG KL_SMG_KI_DAY_MAX KL_SMG_KUPP_M_AB_ANF KL_SMG_KUPP_M_AB_OFF KL_SMG_KUPP_M_AB_SH KL_SMG_KUPP_M_AB_SR KL_SMG_KUPP_M_AB_ZH KL_SMG_KUPP_M_AB_ZR KL_SMG_KUPP_M_AUF_KI KL_SMG_KUPP_M_AUF_OFF KL_SMG_KUPP_M_AUF_S1 KL_SMG_KUPP_M_AUF_Z1 KL_SMG_KUPP_REG_I_F KL_SMG_KUPP_UL_DN_POS KL_SMG_MOT_DN_REG_P KL_SMG_MOT_DN_SOLL KL_SMG_MOT_J_MOTOR KL_SMG_MOT_M_AB_SH KL_SMG_MOT_M_AB_SR KL_SMG_MOT_M_AB_ZH KL_SMG_MOT_M_AB_ZR KL_SMG_MOT_M_RES_AUF KL_SMG_MOT_M_VOR_AUF KL_SMG_MOT_N_REG_D_DN KL_SMG_MOT_N_REG_D_UP KL_SMG_MOT_N_REG_M_LW KL_SMG_MOT_N_REG_P_DN KL_SMG_MOT_N_REG_P_UP KL_SMG_MOT_N_REG_SA_DIFF KL_SMG_MOT_VOR_2_KI KL_SMG_N_ABRISS_SCHW KL_SMG_N_ZIEL_OFF_ANF KL_SMG_N_ZIEL_OFF_LL KL_SMG_N_ZIEL_OFF_MAX KL_SMG_N_ZIEL_OFF_RAB KL_SMG_N_ZIEL_OFF_ZR KL_SMG_PROG_AUTOMAT KL_SMG_PROG_MANUELL KL_SMG_PROG_MAX_TOEL KL_SMG_PROG_MIN_BERG KL_SMG_SK_PROG_MAX KL_SMG_T_KORR_AB /end DEF_CHARACTERISTIC
 /begin OUT_MEASUREMENT smg_abbruch_ges smg_abbruch_grund smg_adapt_ihar_cnt smg_adapt_ihar_sum smg_ax_filter smg_ay_zunahme smg_bw_null smg_can_alive_smg1 smg_can_alive_smg1_cnt smg_can_alive_smg2 smg_can_alive_smg2_cnt smg_can_alive_smg3 smg_can_alive_smg3_cnt smg_can_ax_mess smg_can_chksum_smg1_cnt smg_can_chksum_smg2_cnt smg_can_chksum_smg3_cnt smg_can_ed_tsperr smg_can_empf_st smg_can_empf_st_hys smg_can_getr_st smg_can_istgang smg_can_kupp_st smg_can_m_kupp_ist smg_can_m_kupp_ist_abs smg_can_m_kupp_max smg_can_n_anfahr smg_can_n_getr_ziel_roh smg_can_pos_kupp_ist smg_can_r_testmode smg_can_s_fgr smg_can_s_he smg_can_s_krafts smg_can_s_schalt smg_can_schalter smg_can_st_smg smg_can_st_smg1 smg_can_st_smg2 smg_can_st_smg3 smg_can_t_rest_ekr smg_can_t_rest_se smg_can_testmode smg_can_v_diff smg_can_zielgang smg_dn_filter smg_dn_getr_ein_fil smg_dn_mot_getr smg_fw_rel_virt smg_ki_ab smg_ki_auf smg_ki_auf_t_eingr smg_ki_scha smg_kschlupf smg_kschlupf_st smg_kupp_array smg_kupp_dm_soll smg_kupp_dn_soll smg_kupp_dn_soll_roh smg_kupp_flags smg_kupp_flags_abs smg_kupp_flags_adapt smg_kupp_flags_anf smg_kupp_flags_dn smg_kupp_flags_ekr smg_kupp_flags_ks smg_kupp_flags_schw smg_kupp_m_20 smg_kupp_m_40 smg_kupp_m_60 smg_kupp_m_80 smg_kupp_m_end smg_kupp_m_ist_0 smg_kupp_m_lw_start smg_kupp_m_off_ab smg_kupp_m_rab_start smg_kupp_m_rel_fw smg_kupp_m_soll smg_kupp_m_soll_abs smg_kupp_m_soll_rampe smg_kupp_m_soll_regler smg_kupp_m_voraus smg_kupp_modul smg_kupp_t_dn_null smg_kupp_t_rest smg_kupp_ul_fw_red smg_kupp_ul_st smg_m_kupp_ist_ga smg_md_dsc_abs smg_md_fahrer_ab smg_md_fahrer_auf smg_md_kw_ga smg_mot_dm_soll smg_mot_flags smg_mot_flags_begr smg_mot_flags_nll smg_mot_flags_nziel smg_mot_j_motor smg_mot_m_begr_max smg_mot_m_begr_min smg_mot_m_res smg_mot_m_res_pos smg_mot_m_res_time smg_mot_m_soll smg_mot_m_soll_dA smg_mot_m_soll_dk smg_mot_m_soll_iA smg_mot_m_soll_iA_2 smg_mot_m_soll_pA smg_mot_m_soll_regler smg_mot_m_soll_rel smg_mot_m_soll_stg smg_mot_m_soll_tz smg_mot_m_soll_vor_1 smg_mot_m_soll_vor_2 smg_mot_m_soll_voraus smg_mot_modul smg_mot_n_ekr_schw smg_mot_n_offset smg_mot_n_reg_st smg_mot_n_soll smg_mot_n_ziel_off smg_mot_t_regler smg_mot_tz_nachlauf smg_n_abriss smg_n_abriss_schw smg_n_diff_getr smg_n_diff_ziel smg_n_getr_ein smg_n_getr_ziel smg_old.flags smg_old.flags_anf smg_old.flags_nl smg_old.flags_sa smg_old.modul smg_old.schaltart smg_old.t_korr smg_prog_info_intern smg_prog_max_sk smg_prog_max_toel smg_prog_min_berg smg_radschlupf smg_schaltart_lw_cnt smg_sk_flags smg_sk_t_dme_st smg_sk_t_kupp smg_sk_t_nberech smg_sk_t_ngetr smg_sk_t_ngetr_max smg_sk_t_ngetr_plau smg_sk_t_nziel smg_sk_t_nziel_max smg_sk_t_nziel_plau smg_sk_t_phase smg_st_ekr smg_st_ekr_n smg_st_ekr_n_max smg_t_aktuell smg_t_aktuell_korr /end OUT_MEASUREMENT
/end FUNCTION
/begin FUNCTION SMG-Ebene_2 ""
 /begin DEF_CHARACTERISTIC K_SMG_E2_ST_ERR_MAX K_SMG_MOT_NL_T_MAX_E2 K_SMG_NGETR_DIFF_E2 K_SMG_NGETR_MAX_E2 /end DEF_CHARACTERISTIC
 /begin OUT_MEASUREMENT smg_e2_fehler smg_flags_e2 smg_flags_e2.ekr smg_flags_e2.zs smg_gang_e2_err smg_mot_tz_nachl_e2 smg_ngetr_e2_err smg_st_dme_e2 smg_st_dme_e2_err smg_st_mot_e2 smg_st_mot_e2_err /end OUT_MEASUREMENT
/end FUNCTION
/begin FUNCTION spi ""
 /begin OUT_MEASUREMENT spim_errorcode spim_errorcounter spim_reqcounter spim_status /end OUT_MEASUREMENT
/end FUNCTION
/begin FUNCTION SPI_INJ "" /end FUNCTION
/begin FUNCTION Startrelais "" /begin DEF_CHARACTERISTIC K_START_RL_BEGINN /end DEF_CHARACTERISTIC /begin OUT_MEASUREMENT start_rl_exd_beginn start_rl_exd_timeout start_rl_st /end OUT_MEASUREMENT /end FUNCTION
/begin FUNCTION Steuergeraetetemperatur ""
 /begin DEF_CHARACTERISTIC K_TDME_DIAG_MAX K_TDME_DIAG_MIN K_TDME_SCHWELLE_ZAEHLER K_TDME_TAU KL_TDME_NTC /end DEF_CHARACTERISTIC
 /begin OUT_MEASUREMENT tdme_ad tdme_filter tdme_roh /end OUT_MEASUREMENT
/end FUNCTION
/begin FUNCTION Systemvariablen "" /begin IN_MEASUREMENT sys_sypcr /end IN_MEASUREMENT
 /begin OUT_MEASUREMENT sys_ed_st sys_exc_addr sys_exc_km_ni sys_exc_n_ni sys_exc_vec sys_last_reset_st sys_reset_st sys_rsr sys_rsr_cnt_sum sys_rsr_csrs sys_rsr_dbhrs sys_rsr_dbsrs sys_rsr_ehrs sys_rsr_ersr sys_rsr_ghrst sys_rsr_gpor sys_rsr_gsrst sys_rsr_ilbc sys_rsr_jtrs sys_rsr_llrs sys_rsr_occs sys_rsr_swrs sys_sg_fehler sys_sync_init_t sys_zust sys_zust_bgnd_cnt sys_zust_bgnd_net_min sys_zust_cpu_last /end OUT_MEASUREMENT
/end FUNCTION
/begin FUNCTION TD "" /end FUNCTION
/begin FUNCTION TPU ""
 /begin DEF_CHARACTERISTIC K_TPU_IGN_MIN_SCI_POS K_TPU_IGN_MISS_FIRE_TIME K_TPU_KW_N_MIN K_TPU_KW_SYNC_ZAHN /end DEF_CHARACTERISTIC
 /begin IN_MEASUREMENT tpu_a_htu tpu_a_kw_cnt_720 tpu_a_kw_cnt_cor tpu_a_kw_count tpu_a_kw_irq tpu_a_kw_irq_ack tpu_a_kw_irq_zahn tpu_a_kw_last_event_time tpu_a_kw_last_period_high tpu_a_kw_last_period_low tpu_a_kw_last_trans_time tpu_a_kw_link tpu_a_kw_max_teeth_unsync tpu_a_kw_next_segm_tooth tpu_a_kw_norm_period tpu_a_kw_prev_period tpu_a_kw_segm_length tpu_a_kw_segm_start tpu_a_kw_segm_zeit tpu_a_kw_state tpu_a_kw_time_out tpu_a_kw_wait_teeth tpu_aa_angle_duration_kis tpu_aa_angle_duration_td tpu_aa_angle_period_kis tpu_aa_angle_period_td tpu_aa_angle_start_kis tpu_aa_angle_start_td tpu_aa_max_time_kis tpu_aa_max_time_td tpu_aa_ref_angle_kis tpu_aa_ref_angle_td tpu_aa_start_time_high_kis tpu_aa_start_time_high_td tpu_aa_start_time_low_kis tpu_aa_start_time_low_td tpu_aa_temp_angle_kis tpu_aa_temp_angle_td tpu_apg_angle_period_b1 tpu_apg_angle_period_b2 tpu_apg_channel_b1 tpu_apg_channel_b2 tpu_apg_delta_time_cpu_b1 tpu_apg_delta_time_cpu_b2 tpu_apg_delta_time_tpu_b1 tpu_apg_delta_time_tpu_b2 tpu_apg_ign_time_b1 tpu_apg_ign_time_b2 tpu_apg_min_time_b1 tpu_apg_min_time_b2 tpu_apg_start_angle_b1 tpu_apg_start_angle_b2 tpu_apg_temp_angle_b1 tpu_apg_temp_angle_b2 tpu_b_htu tpu_b_kw_cnt_720 tpu_b_kw_cnt_cor tpu_b_kw_count tpu_b_kw_irq tpu_b_kw_irq_ack tpu_b_kw_irq_zahn tpu_b_kw_last_event_time tpu_b_kw_last_period_high tpu_b_kw_last_period_low tpu_b_kw_last_trans_time tpu_b_kw_link tpu_b_kw_max_teeth_unsync tpu_b_kw_next_segm_tooth tpu_b_kw_norm_period tpu_b_kw_prev_period tpu_b_kw_segm_length tpu_b_kw_segm_start tpu_b_kw_segm_zeit tpu_b_kw_state tpu_b_kw_time_out tpu_b_kw_wait_teeth tpu_b_kw_win_length_1 tpu_b_kw_win_length_2 tpu_b_kw_win_period_1 tpu_b_kw_win_period_2 tpu_b_kw_win_start_1 tpu_b_kw_win_start_2 tpu_b_kw_win_start_time_high_1 tpu_b_kw_win_start_time_high_2 tpu_b_kw_win_start_time_low_1 tpu_b_kw_win_start_time_low_2 tpu_b_kw_win_temp_1 tpu_b_kw_win_temp_2 tpu_b_kw_win_time_1 tpu_b_kw_win_time_2 tpu_dio_config_irq_dsp tpu_dio_irq_cnt_irq_dsp tpu_dio_pin_level_irq_dsp tpu_dio_pulse_time_irq_dsp tpu_fi_no_samples_kw_rot tpu_fi_period_kw_rot tpu_fi_pin_level_kw_rot tpu_fi_sample_cnt_kw_rot tpu_ign_double_fire_ctrl tpu_ign_double_fire_zyl1 tpu_ign_double_fire_zyl10 tpu_ign_double_fire_zyl2 tpu_ign_double_fire_zyl3 tpu_ign_double_fire_zyl4 tpu_ign_double_fire_zyl5 tpu_ign_double_fire_zyl6 tpu_ign_double_fire_zyl7 tpu_ign_double_fire_zyl8 tpu_ign_double_fire_zyl9 tpu_ign_dwell_time_zyl1 tpu_ign_dwell_time_zyl10 tpu_ign_dwell_time_zyl2 tpu_ign_dwell_time_zyl3 tpu_ign_dwell_time_zyl4 tpu_ign_dwell_time_zyl5 tpu_ign_dwell_time_zyl6 tpu_ign_dwell_time_zyl7 tpu_ign_dwell_time_zyl8 tpu_ign_dwell_time_zyl9 tpu_ign_err_cnt_zyl1 tpu_ign_err_cnt_zyl10 tpu_ign_err_cnt_zyl2 tpu_ign_err_cnt_zyl3 tpu_ign_err_cnt_zyl4 tpu_ign_err_cnt_zyl5 tpu_ign_err_cnt_zyl6 tpu_ign_err_cnt_zyl7 tpu_ign_err_cnt_zyl8 tpu_ign_err_cnt_zyl9 tpu_ign_glob_temp_1 tpu_ign_glob_temp_2 tpu_ign_max_sparks tpu_ign_min_msg_pos tpu_ign_miss_fire_active_zyl1 tpu_ign_miss_fire_active_zyl10 tpu_ign_miss_fire_active_zyl2 tpu_ign_miss_fire_active_zyl3 tpu_ign_miss_fire_active_zyl4 tpu_ign_miss_fire_active_zyl5 tpu_ign_miss_fire_active_zyl6 tpu_ign_miss_fire_active_zyl7 tpu_ign_miss_fire_active_zyl8 tpu_ign_miss_fire_active_zyl9 tpu_ign_miss_fire_request_zyl1 tpu_ign_miss_fire_request_zyl10 tpu_ign_miss_fire_request_zyl2 tpu_ign_miss_fire_request_zyl3 tpu_ign_miss_fire_request_zyl4 tpu_ign_miss_fire_request_zyl5 tpu_ign_miss_fire_request_zyl6 tpu_ign_miss_fire_request_zyl7 tpu_ign_miss_fire_request_zyl8 tpu_ign_miss_fire_request_zyl9 tpu_ign_miss_fire_time tpu_ign_msg_err_zyl1 tpu_ign_msg_err_zyl10 tpu_ign_msg_err_zyl2 tpu_ign_msg_err_zyl3 tpu_ign_msg_err_zyl4 tpu_ign_msg_err_zyl5 tpu_ign_msg_err_zyl6 tpu_ign_msg_err_zyl7 tpu_ign_msg_err_zyl8 tpu_ign_msg_err_zyl9 tpu_ign_msg_start_time tpu_ign_msg_zero_time tpu_ign_msg_zyl1 tpu_ign_msg_zyl10 tpu_ign_msg_zyl2 tpu_ign_msg_zyl3 tpu_ign_msg_zyl4 tpu_ign_msg_zyl5 tpu_ign_msg_zyl6 tpu_ign_msg_zyl7 tpu_ign_msg_zyl8 tpu_ign_msg_zyl9 tpu_ign_pin_level_zyl1 tpu_ign_pin_level_zyl10 tpu_ign_pin_level_zyl2 tpu_ign_pin_level_zyl3 tpu_ign_pin_level_zyl4 tpu_ign_pin_level_zyl5 tpu_ign_pin_level_zyl6 tpu_ign_pin_level_zyl7 tpu_ign_pin_level_zyl8 tpu_ign_pin_level_zyl9 tpu_ign_spark_off_time tpu_ign_spark_time tpu_ign_tdc_angle_zyl1 tpu_ign_tdc_angle_zyl10 tpu_ign_tdc_angle_zyl2 tpu_ign_tdc_angle_zyl3 tpu_ign_tdc_angle_zyl4 tpu_ign_tdc_angle_zyl5 tpu_ign_tdc_angle_zyl6 tpu_ign_tdc_angle_zyl7 tpu_ign_tdc_angle_zyl8 tpu_ign_tdc_angle_zyl9 tpu_ign_temp_1_zyl1 tpu_ign_temp_1_zyl10 tpu_ign_temp_1_zyl2 tpu_ign_temp_1_zyl3 tpu_ign_temp_1_zyl4 tpu_ign_temp_1_zyl5 tpu_ign_temp_1_zyl6 tpu_ign_temp_1_zyl7 tpu_ign_temp_1_zyl8 tpu_ign_temp_1_zyl9 tpu_ign_temp_2_zyl1 tpu_ign_temp_2_zyl10 tpu_ign_temp_2_zyl2 tpu_ign_temp_2_zyl3 tpu_ign_temp_2_zyl4 tpu_ign_temp_2_zyl5 tpu_ign_temp_2_zyl6 tpu_ign_temp_2_zyl7 tpu_ign_temp_2_zyl8 tpu_ign_temp_2_zyl9 tpu_ign_temp_3_zyl1 tpu_ign_temp_3_zyl10 tpu_ign_temp_3_zyl2 tpu_ign_temp_3_zyl3 tpu_ign_temp_3_zyl4 tpu_ign_temp_3_zyl5 tpu_ign_temp_3_zyl6 tpu_ign_temp_3_zyl7 tpu_ign_temp_3_zyl8 tpu_ign_temp_3_zyl9 tpu_ign_tz_zyl1 tpu_ign_tz_zyl10 tpu_ign_tz_zyl2 tpu_ign_tz_zyl3 tpu_ign_tz_zyl4 tpu_ign_tz_zyl5 tpu_ign_tz_zyl6 tpu_ign_tz_zyl7 tpu_ign_tz_zyl8 tpu_ign_tz_zyl9 tpu_pwm_active_time_llfso tpu_pwm_active_time_llfss tpu_pwm_passive_time_llfso tpu_pwm_passive_time_llfss tpu_pwm_period_llfso tpu_pwm_period_llfss /end IN_MEASUREMENT
 /begin OUT_MEASUREMENT tpu_a.CFSR01 tpu_a.CFSR23 tpu_a.CIER tpu_a.CISR tpu_a.CPR tpu_a.HSQR tpu_a.HSRR tpu_a.TICR tpu_a.TPUMCR tpu_a.TPUMCR2 tpu_a.TPUMCR3 tpu_a_pram tpu_b.CFSR01 tpu_b.CFSR23 tpu_b.CIER tpu_b.CISR tpu_b.CPR tpu_b.HSQR tpu_b.HSRR tpu_b.TICR tpu_b.TPUMCR tpu_b.TPUMCR2 tpu_b.TPUMCR3 tpu_b_pram tpu_bank tpu_code_status tpu_idx_a tpu_idx_b tpu_index tpu_kw_irq_a tpu_kw_irq_b tpu_kw_irq_cnt_a tpu_kw_irq_cnt_b tpu_kw_irq_error_a tpu_kw_irq_error_b tpu_kw_irq_info_a tpu_kw_irq_info_b tpu_kw_irq_mess_a tpu_kw_irq_mess_b tpu_kw_irq_n_min_a tpu_kw_irq_n_min_b tpu_kw_irq_pre_sync_a tpu_kw_irq_pre_sync_b tpu_kw_irq_segm_a tpu_kw_irq_segm_b tpu_kw_irq_segm_cnt_a tpu_kw_irq_segm_cnt_b tpu_kw_irq_sync_a tpu_kw_irq_sync_b tpu_kw_irq_tooth_a tpu_kw_irq_tooth_b tpu_kw_irq_tooth_cnt_a tpu_kw_irq_tooth_cnt_b tpu_kw_irq_zahn_a tpu_kw_irq_zahn_b tpu_kw_nw_sync_cnt_a tpu_kw_nw_sync_cnt_b tpu_kw_rot tpu_st_a tpu_st_b tpu_zyl tpu_zyl_bank tpu_zyl_p2 /end OUT_MEASUREMENT
/end FUNCTION
/begin FUNCTION Traegheitsmoment ""
 /begin DEF_CHARACTERISTIC K_J_AC K_J_FZG_DKG_1 K_J_FZG_DKG_2 K_J_FZG_DKG_3 K_J_FZG_DKG_4 K_J_FZG_DKG_5 K_J_FZG_DKG_6 K_J_FZG_DKG_7 K_J_FZG_DKG_N K_J_FZG_DKG_R K_J_FZG_HSG_1 K_J_FZG_HSG_2 K_J_FZG_HSG_3 K_J_FZG_HSG_4 K_J_FZG_HSG_5 K_J_FZG_HSG_6 K_J_FZG_HSG_7 K_J_FZG_HSG_N K_J_FZG_HSG_R K_J_FZG_SMG_1 K_J_FZG_SMG_2 K_J_FZG_SMG_3 K_J_FZG_SMG_4 K_J_FZG_SMG_5 K_J_FZG_SMG_6 K_J_FZG_SMG_7 K_J_FZG_SMG_N K_J_FZG_SMG_R K_J_MOTOR /end DEF_CHARACTERISTIC
 /begin OUT_MEASUREMENT j_fzg /end OUT_MEASUREMENT
/end FUNCTION
/begin RECORD_LAYOUT TAD_UB_VV_SW AXIS_PTS_X 3 SWORD INDEX_INCR DIRECT NO_AXIS_PTS_X 1 UBYTE RESERVED 2 BYTE /end RECORD_LAYOUT
/begin RECORD_LAYOUT TGF_VV_VV_SF FNC_VALUES 1 FLOAT32_IEEE COLUMN_DIR DIRECT /end RECORD_LAYOUT
/begin RECORD_LAYOUT TKF_SW_SW_SW FNC_VALUES 5 SWORD COLUMN_DIR DIRECT AXIS_PTS_X 3 SWORD INDEX_INCR DIRECT AXIS_PTS_Y 4 SWORD INDEX_INCR DIRECT NO_AXIS_PTS_X 1 UBYTE NO_AXIS_PTS_Y 2 UBYTE /end RECORD_LAYOUT
/begin RECORD_LAYOUT TKF_SW_SW_UB FNC_VALUES 5 UBYTE COLUMN_DIR DIRECT AXIS_PTS_X 3 SWORD INDEX_INCR DIRECT AXIS_PTS_Y 4 SWORD INDEX_INCR DIRECT NO_AXIS_PTS_X 1 UBYTE NO_AXIS_PTS_Y 2 UBYTE /end RECORD_LAYOUT
/begin RECORD_LAYOUT TKF_UB_UB_UB FNC_VALUES 5 UBYTE COLUMN_DIR DIRECT AXIS_PTS_X 3 UBYTE INDEX_INCR DIRECT AXIS_PTS_Y 4 UBYTE INDEX_INCR DIRECT NO_AXIS_PTS_X 1 UBYTE NO_AXIS_PTS_Y 2 UBYTE /end RECORD_LAYOUT
/begin RECORD_LAYOUT TKL_SB_VV_UB FNC_VALUES 4 UBYTE COLUMN_DIR DIRECT AXIS_PTS_X 3 SBYTE INDEX_INCR DIRECT NO_AXIS_PTS_X 1 UBYTE RESERVED 2 BYTE /end RECORD_LAYOUT
/begin RECORD_LAYOUT TKL_SW_VV_SW FNC_VALUES 4 SWORD COLUMN_DIR DIRECT AXIS_PTS_X 3 SWORD INDEX_INCR DIRECT NO_AXIS_PTS_X 1 UBYTE RESERVED 2 BYTE /end RECORD_LAYOUT
/begin RECORD_LAYOUT TKL_SW_VV_UB FNC_VALUES 4 UBYTE COLUMN_DIR DIRECT AXIS_PTS_X 3 SWORD INDEX_INCR DIRECT NO_AXIS_PTS_X 1 UBYTE RESERVED 2 BYTE /end RECORD_LAYOUT
/begin RECORD_LAYOUT TKL_SW_VV_UW FNC_VALUES 4 UWORD COLUMN_DIR DIRECT AXIS_PTS_X 3 SWORD INDEX_INCR DIRECT NO_AXIS_PTS_X 1 UBYTE RESERVED 2 BYTE /end RECORD_LAYOUT
/begin RECORD_LAYOUT TKL_UB_VV_SW FNC_VALUES 4 SWORD COLUMN_DIR DIRECT AXIS_PTS_X 3 UBYTE INDEX_INCR DIRECT NO_AXIS_PTS_X 1 UBYTE RESERVED 2 BYTE /end RECORD_LAYOUT
/begin RECORD_LAYOUT TKL_UB_VV_UB FNC_VALUES 4 UBYTE COLUMN_DIR DIRECT AXIS_PTS_X 3 UBYTE INDEX_INCR DIRECT NO_AXIS_PTS_X 1 UBYTE RESERVED 2 BYTE /end RECORD_LAYOUT
/begin RECORD_LAYOUT TKL_UW_VV_SW FNC_VALUES 4 SWORD COLUMN_DIR DIRECT AXIS_PTS_X 3 UWORD INDEX_INCR DIRECT NO_AXIS_PTS_X 1 UBYTE RESERVED 2 BYTE /end RECORD_LAYOUT
/begin RECORD_LAYOUT TKW_VV_VV_SW FNC_VALUES 1 SWORD COLUMN_DIR DIRECT /end RECORD_LAYOUT
/begin RECORD_LAYOUT TKW_VV_VV_UB FNC_VALUES 1 UBYTE COLUMN_DIR DIRECT /end RECORD_LAYOUT
/begin RECORD_LAYOUT TKW_VV_VV_UW FNC_VALUES 1 UWORD COLUMN_DIR DIRECT /end RECORD_LAYOUT
/end MODULE
/end PROJECT
