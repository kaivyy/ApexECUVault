ASAP2_VERSION 1 41
/begin PROJECT MSD70 "Spray Guided DI-System with Piezo Injectors for 6-Cylinder"
/begin HEADER "_default_HeaderComment" PROJECT_NO _0B /end HEADER
/begin MODULE _default_ModuleName "_default_ModuleLongIdentifier"
/begin MOD_COMMON "_default_ModCommonComment" DEPOSIT ABSOLUTE BYTE_ORDER MSB_LAST ALIGNMENT_BYTE 1 ALIGNMENT_WORD 2 ALIGNMENT_LONG 2 ALIGNMENT_FLOAT32_IEEE 2 ALIGNMENT_FLOAT64_IEEE 4 /end MOD_COMMON
/begin CHARACTERISTIC c_mis_rate "Misfire rate for regular misfire generator mode" VALUE 0xa100a804 _REC_VAL_20_u1 255. _CNV_A_R_LINEAR_____424_CM 0. 255. DISPLAY_IDENTIFIER C_MIS_RATE FORMAT "%3.0" /end CHARACTERISTIC
/begin MEASUREMENT inh_iv_mis_gen "Idendification of cylinders shut off by injection misifre generator" UBYTE _CNV_A_R_LINEAR_____0_CM 1 100. 0. 255. DISPLAY_IDENTIFIER INH_IV_MIS_GEN ECU_ADDRESS 0xd0002f3b FORMAT "%3.0" /end MEASUREMENT
/begin MEASUREMENT inh_igc_mis_gen "Idendification of cylinders shut off by ignition misifre generator" UBYTE _CNV_A_R_LINEAR_____0_CM 1 100. 0. 255. DISPLAY_IDENTIFIER INH_IGC_MIS_GEN ECU_ADDRESS 0xd0002f39 FORMAT "%3.0" /end MEASUREMENT
/begin MEASUREMENT lv_mis_gen "Flag to indicate the missing ignition and/or injection (current segment)" UBYTE _CNV_S_2_RANGE__0___1_CM 1 100. 0. 1. DISPLAY_IDENTIFIER LV_MIS_GEN ECU_ADDRESS 0xd0002f7c BIT_MASK 0x1 /end MEASUREMENT
/begin CHARACTERISTIC lc_req_mis_gen "Misfire software generator request" VALUE 0xa100a809 _REC_VAL_20_u1 1. _CNV_S_2_RANGE__0___1_CM 0. 1. DISPLAY_IDENTIFIER LC_REQ_MIS_GEN BIT_MASK 0x1 /end CHARACTERISTIC
/begin CHARACTERISTIC lc_mod_mis_gen "Misfire software generator function mode (0 : pseudo random mode / 1 : regular mode)" VALUE 0xa100a808 _REC_VAL_20_u1 1. _CNV_S_2_RANGE__0___1_CM 0. 1. DISPLAY_IDENTIFIER LC_MOD_MIS_GEN BIT_MASK 0x1 /end CHARACTERISTIC
/begin CHARACTERISTIC lc_ign_off_mis_gen "Boolean for misfire genration with ignition cut-off (=1)" VALUE 0xa100a806 _REC_VAL_20_u1 1. _CNV_S_2_RANGE__0___1_CM 0. 1. DISPLAY_IDENTIFIER LC_IGN_OFF_MIS_GEN BIT_MASK 0x1 /end CHARACTERISTIC
/begin CHARACTERISTIC lc_inj_off_mis_gen "Boolean for misfire generation with injection cut-off (=1)" VALUE 0xa100a807 _REC_VAL_20_u1 1. _CNV_S_2_RANGE__0___1_CM 0. 1. DISPLAY_IDENTIFIER LC_INJ_OFF_MIS_GEN BIT_MASK 0x1 /end CHARACTERISTIC
/begin CHARACTERISTIC c_seg_st_mis_gen "Start segment for misfire software generator triggering" VALUE 0xa100a805 _REC_VAL_20_u1 7. _CNV_A_R_LINEAR_____0_CM 0. 7. DISPLAY_IDENTIFIER C_SEG_ST_MIS_GEN FORMAT "%3.0" /end CHARACTERISTIC
/begin AXIS_PTS ldp_x_id_rnd_pat_mis_gen "" 0xa100a6dc NO_INPUT_QUANTITY _REC_AXS_20_u1 255. _CNV_A_R_LINEAR_____0_CM 16 0. 255. FORMAT "%3.0" /end AXIS_PTS
/begin AXIS_PTS ldp_y_id_rnd_pat_mis_gen "" 0xa100a6f0 NO_INPUT_QUANTITY _REC_AXS_20_u1 15. _CNV_A_R_LINEAR_____0_CM 16 0. 15. FORMAT "%3.0" /end AXIS_PTS
/begin CHARACTERISTIC id_rnd_pat_mis_gen "Table of Boolean to define the pseudo random misfire sequence" MAP 0xa100a704 _REC_MAP_20_u1_u1_u1 1. _CNV_A_R_LINEAR_____0_CM 0. 1. DISPLAY_IDENTIFIER ID_RND_PAT_MIS_GEN FORMAT "%1.0"
 /begin AXIS_DESCR COM_AXIS NO_INPUT_QUANTITY _CNV_A_R_LINEAR_____0_CM 16 0. 255. FORMAT "%3.0" AXIS_PTS_REF ldp_x_id_rnd_pat_mis_gen /end AXIS_DESCR
 /begin AXIS_DESCR COM_AXIS NO_INPUT_QUANTITY _CNV_A_R_LINEAR_____0_CM 16 0. 15. FORMAT "%3.0" AXIS_PTS_REF ldp_y_id_rnd_pat_mis_gen /end AXIS_DESCR
/end CHARACTERISTIC
/begin MEASUREMENT lv_mis_a_diag_req_app "Specific request to evaluate CARB A criterion with project specific calibration set according external conditions (bad fuel quality...)" UBYTE _CNV_S_2_RANGE__0___1_CM 1 100. 0. 1. DISPLAY_IDENTIFIER LV_MIS_A_DIAG_REQ_APP ECU_ADDRESS 0xd0002f66 BIT_MASK 0x1 /end MEASUREMENT
/begin MEASUREMENT lv_mis_b_diag_req_app "Specific request to evaluate CARB B1 & B4 criterions" UBYTE _CNV_S_2_RANGE__0___1_CM 1 100. 0. 1. DISPLAY_IDENTIFIER LV_MIS_B_DIAG_REQ_APP ECU_ADDRESS 0xd0002f67 BIT_MASK 0x1 /end MEASUREMENT
/begin MEASUREMENT fac_mis_a_app "Catalyst damage weighting factor used to increment counters for MIS_A criterion pending application specific conditions" UBYTE _CNV_A_R_LINEAR_____0_CM 1 100. 0. 100. DISPLAY_IDENTIFIER FAC_MIS_A_APP ECU_ADDRESS 0xd0002f33 FORMAT "%3.0" /end MEASUREMENT
/begin MEASUREMENT fac_mis_a_thd_ind_app "Cylinder individual threshold used for cylinder shut-off during CARB A criterion window pending application specific conditions" UWORD _CNV_A_R_LINEAR_____27_CM 1 100. 0. 100. DISPLAY_IDENTIFIER FAC_MIS_A_THD_IND_APP ECU_ADDRESS 0xd0002bb6 FORMAT "%5.3" /end MEASUREMENT
/begin MEASUREMENT fac_mis_sum_a_thd_app "Global threshold used for CARB A criterion pending application specific conditions" UWORD _CNV_A_R_LINEAR_____27_CM 1 100. 0. 100. DISPLAY_IDENTIFIER FAC_MIS_SUM_A_THD_APP ECU_ADDRESS 0xd0002bb8 FORMAT "%5.3" /end MEASUREMENT
/begin MEASUREMENT fac_mis_sum_b1_thd_app "Global threshold used for CARB B1 criterion pending application specific conditions" UWORD _CNV_A_R_LINEAR_____27_CM 1 100. 0. 100. DISPLAY_IDENTIFIER FAC_MIS_SUM_B1_THD_APP ECU_ADDRESS 0xd0002bba FORMAT "%5.3" /end MEASUREMENT
/begin MEASUREMENT fac_mis_sum_b4_thd_app "Global threshold used for CARB B4 criterion pending application specific conditions" UWORD _CNV_A_R_LINEAR_____27_CM 1 100. 0. 100. DISPLAY_IDENTIFIER FAC_MIS_SUM_B4_THD_APP ECU_ADDRESS 0xd0002bbc FORMAT "%5.3" /end MEASUREMENT
/begin MEASUREMENT lv_inh_igc_diag_mis "Inhibition of misfire crossed diagnosis with IGC OBD I errors" UBYTE _CNV_S_2_RANGE__0___1_CM 1 100. 0. 1. DISPLAY_IDENTIFIER LV_INH_IGC_DIAG_MIS ECU_ADDRESS 0xd0002f62 BIT_MASK 0x1 /end MEASUREMENT
/begin MEASUREMENT lv_req_app_ctr_mis_a "Specific request to allow out of FTP counting mode even if we are within FTP area" UBYTE _CNV_S_2_RANGE__0___1_CM 1 100. 0. 1. DISPLAY_IDENTIFIER LV_REQ_APP_CTR_MIS_A ECU_ADDRESS 0xd0002f6d BIT_MASK 0x1 /end MEASUREMENT
/begin MEASUREMENT seg_nr_cbk_er "Cylinder bank phasing reference defined according delay introduced by engine roughness index" UBYTE _CNV_A_R_LINEAR_____0_CM 1 100. 0. 255. DISPLAY_IDENTIFIER SEG_NR_CBK_ER ECU_ADDRESS 0xd0002f49 FORMAT "%3.0" /end MEASUREMENT
/begin MEASUREMENT lv_inh_iv_diag_mis "Inhibition of misfire crossed diagnosis with IV OBD I errors" UBYTE _CNV_S_2_RANGE__0___1_CM 1 100. 0. 1. DISPLAY_IDENTIFIER LV_INH_IV_DIAG_MIS ECU_ADDRESS 0xd0002f63 BIT_MASK 0x1 /end MEASUREMENT
/begin MEASUREMENT lv_cdn_mis_b1 "CARB B1 misfire criterion monitoring condition" UBYTE _CNV_S_2_RANGE__0___1_CM 1 100. 0. 1. DISPLAY_IDENTIFIER LV_CDN_MIS_B1 ECU_ADDRESS 0xd0002f4d BIT_MASK 0x1 /end MEASUREMENT
/begin MEASUREMENT lv_cdn_mis_a "CARB A misfire criterion monitoring condition" UBYTE _CNV_S_2_RANGE__0___1_CM 1 100. 0. 1. DISPLAY_IDENTIFIER LV_CDN_MIS_A ECU_ADDRESS 0xd0002f4c BIT_MASK 0x1 /end MEASUREMENT
/begin MEASUREMENT lv_cdn_mis_b4 "CARB B4 misfire criterion monitoring condition" UBYTE _CNV_S_2_RANGE__0___1_CM 1 100. 0. 1. DISPLAY_IDENTIFIER LV_CDN_MIS_B4 ECU_ADDRESS 0xd0002f4e BIT_MASK 0x1 /end MEASUREMENT
/begin CHARACTERISTIC lc_ctr_conf_diag_mis "Diagnosis TDC counting mode : counting all TDCs (=0) or only diagnosed TDC's (=1)" VALUE 0xa1009d6c _REC_VAL_20_u1 1. _CNV_S_2_RANGE__0___1_CM 0. 1. DISPLAY_IDENTIFIER LC_CTR_CONF_DIAG_MIS BIT_MASK 0x1 /end CHARACTERISTIC
/begin CHARACTERISTIC lc_ctr_conf_osc_mis "Diagnosis TDC counting mode when crankshaft oscillations occurs : sotp counting TDCs (=0) or counting allowed TDC's (=1)" VALUE 0xa1009d6d _REC_VAL_20_u1 1. _CNV_S_2_RANGE__0___1_CM 0. 1. DISPLAY_IDENTIFIER LC_CTR_CONF_OSC_MIS BIT_MASK 0x1 /end CHARACTERISTIC
/begin MEASUREMENT lv_err_mis_mpl "Present error flag multiple cylinder misfire" UBYTE _CNV_S_2_RANGE__0___1_CM 1 100. 0. 1. DISPLAY_IDENTIFIER LV_ERR_MIS_MPL ECU_ADDRESS 0xd0003429 BIT_MASK 0x1 /end MEASUREMENT
/begin MEASUREMENT lv_err_mis_ftl_l "Present error flag misfire with low fuel tank level" UBYTE _CNV_S_2_RANGE__0___1_CM 1 100. 0. 1. DISPLAY_IDENTIFIER LV_ERR_MIS_FTL_L ECU_ADDRESS 0xd000342a BIT_MASK 0x1 /end MEASUREMENT
/begin CHARACTERISTIC lc_conf_err_mis_ftl_l "Calibration to enable low fuel tank level detection failure" VALUE 0xa1009d64 _REC_VAL_20_u1 1. _CNV_S_2_RANGE__0___1_CM 0. 1. DISPLAY_IDENTIFIER LC_CONF_ERR_MIS_FTL_L BIT_MASK 0x1 /end CHARACTERISTIC
/begin MEASUREMENT lv_err_mis_1 "Present error flag for Cylinder specific misfire failure" UBYTE _CNV_S_2_RANGE__0___1_CM 1 100. 0. 1. DISPLAY_IDENTIFIER LV_ERR_MIS_1 ECU_ADDRESS 0xd0003424 BIT_MASK 0x1 /end MEASUREMENT
/begin MEASUREMENT lv_err_mis_2 "Present error flag for Cylinder specific misfire failure" UBYTE _CNV_S_2_RANGE__0___1_CM 1 100. 0. 1. DISPLAY_IDENTIFIER LV_ERR_MIS_2 ECU_ADDRESS 0xd0003425 BIT_MASK 0x1 /end MEASUREMENT
/begin MEASUREMENT lv_err_mis_3 "Present error flag for Cylinder specific misfire failure" UBYTE _CNV_S_2_RANGE__0___1_CM 1 100. 0. 1. DISPLAY_IDENTIFIER LV_ERR_MIS_3 ECU_ADDRESS 0xd0003426 BIT_MASK 0x1 /end MEASUREMENT
/begin MEASUREMENT lv_err_mis_4 "Present error flag for Cylinder specific misfire failure" UBYTE _CNV_S_2_RANGE__0___1_CM 1 100. 0. 1. DISPLAY_IDENTIFIER LV_ERR_MIS_4 ECU_ADDRESS 0xd0003427 BIT_MASK 0x1 /end MEASUREMENT
/begin MEASUREMENT lv_err_mis_5 "Present error flag for Cylinder specific misfire failure" UBYTE _CNV_S_2_RANGE__0___1_CM 1 100. 0. 1. DISPLAY_IDENTIFIER LV_ERR_MIS_5 ECU_ADDRESS 0xd0003428 BIT_MASK 0x1 /end MEASUREMENT
/begin CHARACTERISTIC c_teg_cat_up_mis_a_max "TEG Threshold for misfire A counter management" VALUE 0xa1009d5e _REC_VAL_20_u2 2047. _CNV_A_R_LINEAR_____123_CM 0. 2047. DISPLAY_IDENTIFIER C_TEG_CAT_UP_MIS_A_MAX FORMAT "%9.4" /end CHARACTERISTIC
/begin MEASUREMENT lv_err_mis_0 "Present error flag for Cylinder specific misfire failure" UBYTE _CNV_S_2_RANGE__0___1_CM 1 100. 0. 1. DISPLAY_IDENTIFIER LV_ERR_MIS_0 ECU_ADDRESS 0xd0003423 BIT_MASK 0x1 /end MEASUREMENT
/begin MEASUREMENT load_max_scdn_mis "Maximal load of similar condition window for LV_ERR_MIS" UBYTE _CNV_A_R_LINEAR_____5_CM 1 100. 0. 99.609375 DISPLAY_IDENTIFIER LOAD_MAX_SCDN_MIS ECU_ADDRESS 0xd0002f3c /end MEASUREMENT
/begin MEASUREMENT load_min_scdn_mis "Minimal load of similar condition window for LV_ERR_MIS" UBYTE _CNV_A_R_LINEAR_____5_CM 1 100. 0. 99.609375 DISPLAY_IDENTIFIER LOAD_MIN_SCDN_MIS ECU_ADDRESS 0xd0002f3d /end MEASUREMENT
/begin MEASUREMENT n_min_scdn_mis "Maximal engine speed of similar condition window for LV_ERR_MIS" UWORD _CNV_A_R_LINEAR_____13_CM 1 100. 0. 8160. DISPLAY_IDENTIFIER N_MIN_SCDN_MIS ECU_ADDRESS 0xd0002bfc FORMAT "%4.0" /end MEASUREMENT
/begin MEASUREMENT n_max_scdn_mis "Minimal engine speed of similar condition window for LV_ERR_MIS" UWORD _CNV_A_R_LINEAR_____13_CM 1 100. 0. 8160. DISPLAY_IDENTIFIER N_MAX_SCDN_MIS ECU_ADDRESS 0xd0002bfa FORMAT "%4.0" /end MEASUREMENT
/begin MEASUREMENT ctr_mis_det "Number of misfire events of all cylinders in one DC" UWORD _CNV_A_R_LINEAR_____0_CM 1 100. 0. 65535. DISPLAY_IDENTIFIER CTR_MIS_DET ECU_ADDRESS 0xd0002b94 FORMAT "%5.0" /end MEASUREMENT
/begin MEASUREMENT ctr_seg_mis_act "Number of segments with active misfire detection" ULONG _CNV_A_R_LINEAR_____50_CM 1 100. 0. 4294967295. DISPLAY_IDENTIFIER CTR_SEG_MIS_ACT ECU_ADDRESS 0xd0002baa FORMAT "%11.0" /end MEASUREMENT
/begin MEASUREMENT ctr_mis_det_cyl[0] "Number of misfires events on cylinder [0]  in one DC" UWORD _CNV_A_R_LINEAR_____0_CM 1 100. 0. 65535. DISPLAY_IDENTIFIER CTR_MIS_DET_CYL_0 ECU_ADDRESS 0xd0002b98 FORMAT "%5.0" /end MEASUREMENT
/begin MEASUREMENT ctr_mis_det_cyl[1] "Number of misfires events on cylinder [1] in one DC" UWORD _CNV_A_R_LINEAR_____0_CM 1 100. 0. 65535. DISPLAY_IDENTIFIER CTR_MIS_DET_CYL_1 ECU_ADDRESS 0xd0002b9a FORMAT "%5.0" /end MEASUREMENT
/begin MEASUREMENT ctr_mis_det_cyl[2] "Number of misfires events on cylinder [2] in one DC" UWORD _CNV_A_R_LINEAR_____0_CM 1 100. 0. 65535. DISPLAY_IDENTIFIER CTR_MIS_DET_CYL_2 ECU_ADDRESS 0xd0002b9c FORMAT "%5.0" /end MEASUREMENT
/begin MEASUREMENT ctr_mis_det_cyl[3] "Number of misfires events on cylinder [3] in one DC" UWORD _CNV_A_R_LINEAR_____0_CM 1 100. 0. 65535. DISPLAY_IDENTIFIER CTR_MIS_DET_CYL_3 ECU_ADDRESS 0xd0002b9e FORMAT "%5.0" /end MEASUREMENT
/begin MEASUREMENT ctr_mis_det_cyl[4] "Number of misfires events on cylinder [4] in one DC" UWORD _CNV_A_R_LINEAR_____0_CM 1 100. 0. 65535. DISPLAY_IDENTIFIER CTR_MIS_DET_CYL_4 ECU_ADDRESS 0xd0002ba0 FORMAT "%5.0" /end MEASUREMENT
/begin MEASUREMENT ctr_mis_det_cyl[5] "Number of misfires events on cylinder [5] in one DC" UWORD _CNV_A_R_LINEAR_____0_CM 1 100. 0. 65535. DISPLAY_IDENTIFIER CTR_MIS_DET_CYL_5 ECU_ADDRESS 0xd0002ba2 FORMAT "%5.0" /end MEASUREMENT
/begin MEASUREMENT lv_state_crk_osc "Status of crankshaft oscillation condition" UBYTE _CNV_S_2_RANGE__0___1_CM 1 100. 0. 1. DISPLAY_IDENTIFIER LV_STATE_CRK_OSC ECU_ADDRESS 0xd0002f70 BIT_MASK 0x1 /end MEASUREMENT
/begin MEASUREMENT drv0_er_sum_osc "Integrated DRV0_ER value for amplitude criterion reseted evey sign change or DRV0" UWORD _CNV_A_R_LINEAR_____401_CM 1 100. 0. 65535. DISPLAY_IDENTIFIER DRV0_ER_SUM_OSC ECU_ADDRESS 0xd0002c14 FORMAT "%5.0" /end MEASUREMENT
/begin MEASUREMENT drv0_er_sum_thd_osc "Threshold for DRV0_ER_SUM_OSC to fulfill amplitude criteria" UWORD _CNV_A_R_LINEAR_____401_CM 1 100. 0. 65535. DISPLAY_IDENTIFIER DRV0_ER_SUM_THD_OSC ECU_ADDRESS 0xd0002c16 FORMAT "%5.0" /end MEASUREMENT
/begin MEASUREMENT ctr_tdc_crk_osc_act "TDC counter to enable crankshaft oscillation detection after misfiring detection" UBYTE _CNV_A_R_LINEAR_____0_CM 1 100. 0. 255. DISPLAY_IDENTIFIER CTR_TDC_CRK_OSC_ACT ECU_ADDRESS 0xd0002f74 FORMAT "%3.0" /end MEASUREMENT
/begin MEASUREMENT seg_sum_frq_crk_osc "Segment counter for frequency criterion reseted every sign change or DRV0" UBYTE _CNV_A_R_LINEAR_____0_CM 1 100. 0. 255. DISPLAY_IDENTIFIER SEG_SUM_FRQ_CRK_OSC ECU_ADDRESS 0xd0002f76 FORMAT "%3.0" /end MEASUREMENT
/begin MEASUREMENT lv_crk_osc_det_act "Crankshaft oscillation detection active" UBYTE _CNV_S_2_RANGE__0___1_CM 1 100. 0. 1. DISPLAY_IDENTIFIER LV_CRK_OSC_DET_ACT ECU_ADDRESS 0xd0002f79 BIT_MASK 0x1 /end MEASUREMENT
/begin MEASUREMENT lv_frq_crit_crk_osc "Critical crankshaft oscillation frequency detected" UBYTE _CNV_S_2_RANGE__0___1_CM 1 100. 0. 1. DISPLAY_IDENTIFIER LV_FRQ_CRIT_CRK_OSC ECU_ADDRESS 0xd0002f7a BIT_MASK 0x1 /end MEASUREMENT
/begin MEASUREMENT lv_ampl_crit_crk_osc "Critical crankshaft oscillation amplitude detected" UBYTE _CNV_S_2_RANGE__0___1_CM 1 100. 0. 1. DISPLAY_IDENTIFIER LV_AMPL_CRIT_CRK_OSC ECU_ADDRESS 0xd0002f78 BIT_MASK 0x1 /end MEASUREMENT
/begin CHARACTERISTIC c_dly_tdc_crk_osc "Active TDC of crankshaft oscillation status after detection triggering" VALUE 0xa100a240 _REC_VAL_20_u1 255. _CNV_A_R_LINEAR_____0_CM 0. 255. DISPLAY_IDENTIFIER C_DLY_TDC_CRK_OSC FORMAT "%3.0" /end CHARACTERISTIC
/begin CHARACTERISTIC c_n_max_crk_osc "Maximum speed for crankshaft oscillation calculation" VALUE 0xa100a241 _REC_VAL_20_u1 8160. _CNV_A_R_LINEAR_____9_CM 0. 8160. DISPLAY_IDENTIFIER C_N_MAX_CRK_OSC FORMAT "%4.0" /end CHARACTERISTIC
/begin CHARACTERISTIC c_nr_tdc_max_crk_osc "Maximum TDC after detected misfire to activate crankshaft osc. detect. process" VALUE 0xa100a242 _REC_VAL_20_u1 255. _CNV_A_R_LINEAR_____0_CM 0. 255. DISPLAY_IDENTIFIER C_NR_TDC_MAX_CRK_OSC FORMAT "%3.0" /end CHARACTERISTIC
/begin AXIS_PTS ldp_n_32_ip_seg_min_frq_crk_osc "" 0xa100a1ee n_32 _REC_AXS_20_u1 8160. _CNV_A_R_LINEAR_____9_CM 4 0. 8160. FORMAT "%4.0" /end AXIS_PTS
/begin AXIS_PTS ldp_n_32_ip_drv0_er_thd_osc "" 0xa100a1e6 n_32 _REC_AXS_20_u1 8160. _CNV_A_R_LINEAR_____9_CM 6 0. 8160. FORMAT "%4.0" /end AXIS_PTS
/begin AXIS_PTS ldp_load_mis_ip_drv0_er_thd_osc "" 0xa100a1d8 load_mis _REC_AXS_20_u2 99.9969482421875 _CNV_A_R_LINEAR_____201_CM 6 0. 99.9969482421875 FORMAT "%7.3" /end AXIS_PTS
/begin CHARACTERISTIC ip_seg_min_frq_crk_osc "Minimum number of segment after turn of speed direction for detecting critical high freq" CURVE 0xa100a23c _REC_CUR_20_u1_u1 255. _CNV_A_R_LINEAR_____0_CM 0. 255. DISPLAY_IDENTIFIER IP_SEG_MIN_FRQ_CRK_OSC FORMAT "%3.0"
 /begin AXIS_DESCR COM_AXIS n_32 _CNV_A_R_LINEAR_____9_CM 4 0. 8160. FORMAT "%4.0" AXIS_PTS_REF ldp_n_32_ip_seg_min_frq_crk_osc /end AXIS_DESCR
/end CHARACTERISTIC
/begin CHARACTERISTIC ip_drv0_er_thd_osc "DRV0 amplitude threshold to detect critical crankshaft oscillation amplitude" MAP 0xa100a1f4 _REC_MAP_20_u2_u1_u2 65535. _CNV_A_R_LINEAR_____401_CM 0. 65535. DISPLAY_IDENTIFIER IP_DRV0_ER_THD_OSC FORMAT "%5.0"
 /begin AXIS_DESCR COM_AXIS n_32 _CNV_A_R_LINEAR_____9_CM 6 0. 8160. FORMAT "%4.0" AXIS_PTS_REF ldp_n_32_ip_drv0_er_thd_osc /end AXIS_DESCR
 /begin AXIS_DESCR COM_AXIS load_mis _CNV_A_R_LINEAR_____201_CM 6 0. 99.9969482421875 FORMAT "%7.3" AXIS_PTS_REF ldp_load_mis_ip_drv0_er_thd_osc /end AXIS_DESCR
/end CHARACTERISTIC
/begin MEASUREMENT ratio_vs_n_crk_osc "Ratio VS / N for gear area determination" UBYTE _CNV_A_R_MISF_LINEA_432_CM 1 100. 0. 5.e-002 DISPLAY_IDENTIFIER RATIO_VS_N_CRK_OSC ECU_ADDRESS 0xd0002f75 FORMAT "%6.4" /end MEASUREMENT
/begin CHARACTERISTIC c_ratio_vs_n_min_crk_osc "minimum vs/n ratio to active crankshaft oscillation detection" VALUE 0xa100a243 _REC_VAL_20_u1 5.e-002 _CNV_A_R_MISF_LINEA_432_CM 0. 5.e-002 DISPLAY_IDENTIFIER C_RATIO_VS_N_MIN_CRK_OSC FORMAT "%6.4" /end CHARACTERISTIC
/begin MEASUREMENT lv_state_rr "Boolean for state of rough road detection (No : Yes)." UBYTE _CNV_S_2_RANGE__0___1_CM 1 100. 0. 1. DISPLAY_IDENTIFIER LV_STATE_RR ECU_ADDRESS 0xd0002f71 BIT_MASK 0x1 /end MEASUREMENT
/begin MEASUREMENT seg_t_mes_0_rr "Actual segment time measurement from the wheel speed signal." ULONG _CNV_A_R_LINEAR_____433_CM 1 100. 0. 4294967288. DISPLAY_IDENTIFIER SEG_T_MES_0_RR ECU_ADDRESS 0xd0002bfe FORMAT "%10.0" /end MEASUREMENT
/begin MEASUREMENT seg_t_mes_1_rr "Previous segment time measurement from the wheel speed signal." ULONG _CNV_A_R_LINEAR_____433_CM 1 100. 0. 4294967288. DISPLAY_IDENTIFIER SEG_T_MES_1_RR ECU_ADDRESS 0xd0002c02 FORMAT "%10.0" /end MEASUREMENT
/begin MEASUREMENT wheel_grd_mmv "Rough road value." UWORD _CNV_A_R_LINEAR_____434_CM 1 100. 0. 999.985 DISPLAY_IDENTIFIER WHEEL_GRD_MMV ECU_ADDRESS 0xd0002c10 FORMAT "%6.2" /end MEASUREMENT
/begin MEASUREMENT wheel_grd_mmv_thd "Threshold for rough road value" UWORD _CNV_A_R_LINEAR_____434_CM 1 100. 0. 999.985 DISPLAY_IDENTIFIER WHEEL_GRD_MMV_THD ECU_ADDRESS 0xd0002c12 FORMAT "%6.2" /end MEASUREMENT
/begin MEASUREMENT sum_rr "Counter of rough road detection events." UWORD _CNV_A_R_LINEAR_____0_CM 1 100. 0. 65535. DISPLAY_IDENTIFIER SUM_RR ECU_ADDRESS 0xd0002c08 FORMAT "%5.0" /end MEASUREMENT
/begin CHARACTERISTIC c_vs_min_rr "Minimum vehicle speed for rough road detection." VALUE 0xa1009d61 _REC_VAL_20_u1 255. _CNV_A_R_LINEAR_____0_CM 0. 255. DISPLAY_IDENTIFIER C_VS_MIN_RR FORMAT "%3.0" /end CHARACTERISTIC
/begin CHARACTERISTIC c_vs_max_rr "Maximum vehicle speed for rough road detection." VALUE 0xa1009d60 _REC_VAL_20_u1 254. _CNV_A_R_LINEAR_____0_CM 1. 255. DISPLAY_IDENTIFIER C_VS_MAX_RR FORMAT "%3.0" /end CHARACTERISTIC
/begin CHARACTERISTIC c_wheel_grd_crlc_rr "Correlation factor for floating averaging of the rough road raw values" VALUE 0xa1009d62 _REC_VAL_20_u2 0.9999847412109381 _CNV_A_R_LINEAR_____68_CM 0. 0.9999847412109381 DISPLAY_IDENTIFIER C_WHEEL_GRD_CRLC_RR FORMAT "%7.5" /end CHARACTERISTIC
/begin CHARACTERISTIC c_dly_er_rr "Fade out time for engine roughness after rough road detection" VALUE 0xa1009d06 _REC_VAL_20_u2 655350. _CNV_A_R_LINEAR_____18_CM 0. 655350. DISPLAY_IDENTIFIER C_DLY_ER_RR FORMAT "%6.0" /end CHARACTERISTIC
/begin CHARACTERISTIC ip_wheel_grd_mmv_thd_at__vs "Threshold versus vehicle speed for rough road detection, automatic tzransmission" CURVE 0xa1009cdc _REC_CUR_20_u2_u1 255. _CNV_A_R_LINEAR_____435_CM 0. 255. DISPLAY_IDENTIFIER IP_WHEEL_GRD_MMV_THD_AT__VS FORMAT "%6.2"
 /begin AXIS_DESCR COM_AXIS vs _CNV_A_R_LINEAR_____6_CM 9 0. 255. FORMAT "%3.0" AXIS_PTS_REF ldpm_vs_wheel_grd_mmv_thd /end AXIS_DESCR
/end CHARACTERISTIC
/begin CHARACTERISTIC ip_wheel_grd_mmv_thd_mt__vs "Threshold versus vehicle speed for rough road detection, manual transmission" CURVE 0xa1009cf0 _REC_CUR_20_u2_u1 255. _CNV_A_R_LINEAR_____435_CM 0. 255. DISPLAY_IDENTIFIER IP_WHEEL_GRD_MMV_THD_MT__VS FORMAT "%6.2"
 /begin AXIS_DESCR COM_AXIS vs _CNV_A_R_LINEAR_____6_CM 9 0. 255. FORMAT "%3.0" AXIS_PTS_REF ldpm_vs_wheel_grd_mmv_thd /end AXIS_DESCR
/end CHARACTERISTIC
/begin AXIS_PTS ldpm_vs_wheel_grd_mmv_thd "" 0xa1009a38 vs _REC_AXS_20_u1 255. _CNV_A_R_LINEAR_____6_CM 9 0. 255. FORMAT "%3.0" /end AXIS_PTS
/begin MEASUREMENT ang_rel_sp_ecu_vvl "" UWORD _CNV_A_R_LINEAR_____448_CM 1 100. 0. 100. DISPLAY_IDENTIFIER ANG_REL_SP_ECU_VVL ECU_ADDRESS 0xc0002a40 FORMAT "%6.2" /end MEASUREMENT
/begin MEASUREMENT lv_tco_ad_cdn_is "Logical bit \"Coolant temperature in operating range\"" UBYTE _CNV_S_2_RANGE__0___1_CM 1 100. 0. 1. DISPLAY_IDENTIFIER LV_TCO_AD_CDN_IS ECU_ADDRESS 0xd000240c BIT_MASK 0x1 /end MEASUREMENT
/begin MEASUREMENT lv_ad_cdn_is "Adaptation condition" UBYTE _CNV_S_2_RANGE__0___1_CM 1 100. 0. 1. DISPLAY_IDENTIFIER LV_AD_CDN_IS ECU_ADDRESS 0xd0002408 BIT_MASK 0x1 /end MEASUREMENT
/begin MEASUREMENT lv_dly_ad_is "Logical bit \"Idle speed has settled for a given time delay\"" UBYTE _CNV_S_2_RANGE__0___1_CM 1 100. 0. 1. DISPLAY_IDENTIFIER LV_DLY_AD_IS ECU_ADDRESS 0xd0002409 BIT_MASK 0x1 /end MEASUREMENT
/begin CHARACTERISTIC c_tco_ad_max_is "temperature top limit for ISC Adaptation" VALUE 0xa100acbc _REC_VAL_20_u1 28.575 _CNV_A_R_LINEAR_____16_CM -48. 142.5 DISPLAY_IDENTIFIER C_TCO_AD_MAX_IS FORMAT "%6.2" /end CHARACTERISTIC
/begin CHARACTERISTIC c_tco_ad_min_is "temperature bottom limit for ISC Adaptation" VALUE 0xa100acbd _REC_VAL_20_u1 28.575 _CNV_A_R_LINEAR_____16_CM -48. 142.5 DISPLAY_IDENTIFIER C_TCO_AD_MIN_IS FORMAT "%6.2" /end CHARACTERISTIC
/begin CHARACTERISTIC c_n_delta "engine speed threshold for ISC Adaptation" VALUE 0xa100acba _REC_VAL_20_u2 8160. _CNV_A_R_LINEAR_____13_CM 0. 8160. DISPLAY_IDENTIFIER C_N_DELTA FORMAT "%4.0" /end CHARACTERISTIC
/begin CHARACTERISTIC c_dly_ad_is "time delay for ISC Adaptation" VALUE 0xa100acb1 _REC_VAL_20_u1 255. _CNV_A_R_LINEAR_____449_CM 0. 255. DISPLAY_IDENTIFIER C_DLY_AD_IS FORMAT "%3.0" /end CHARACTERISTIC
/begin MEASUREMENT tq_loss_req_clu "Engine torque losses without pumping losses for calculation of TQ_REQ_CLU" SWORD _CNV_A_R_LINEAR_____30_CM 1 100. -1024. 1023.96875 DISPLAY_IDENTIFIER TQ_LOSS_REQ_CLU ECU_ADDRESS 0xd00023f6 FORMAT "%11.5" /end MEASUREMENT
/begin MEASUREMENT tqfr_add "Additive temperature correction of engine friction torque " SWORD _CNV_A_R_LINEAR_____30_CM 1 100. -1024. 1023.96875 DISPLAY_IDENTIFIER TQFR_ADD ECU_ADDRESS 0xd00023fc FORMAT "%11.5" /end MEASUREMENT
/begin MEASUREMENT tqfr_st "Additive start correction of engine friction torque" SWORD _CNV_A_R_LINEAR_____30_CM 1 100. -1024. 1023.96875 DISPLAY_IDENTIFIER TQFR_ST ECU_ADDRESS 0xd0002402 FORMAT "%11.5" /end MEASUREMENT
/begin MEASUREMENT tqfr_mec "Mechanical friction torque of the engine" SWORD _CNV_A_R_LINEAR_____30_CM 1 100. -1024. 1023.96875 DISPLAY_IDENTIFIER TQFR_MEC ECU_ADDRESS 0xd0002400 FORMAT "%11.5" /end MEASUREMENT
/begin CHARACTERISTIC c_maf_cyl_stk_ref "Constant for the determination of the friction losses" VALUE 0xa100ac1e _REC_VAL_20_u2 1389. _CNV_A_R_LINEAR_____108_CM 0. 1389. DISPLAY_IDENTIFIER C_MAF_CYL_STK_REF FORMAT "%7.2" /end CHARACTERISTIC
/begin CHARACTERISTIC c_crlc_tq_loss_req_clu "Correlation constant for TQ_LOSS_REQ_CLU filtering" VALUE 0xa100ac1c _REC_VAL_20_u1 0.99609375 _CNV_A_R_LINEAR_____27_CM 0. 0.99609375 DISPLAY_IDENTIFIER C_CRLC_TQ_LOSS_REQ_CLU FORMAT "%5.3" /end CHARACTERISTIC
/begin AXIS_PTS ldpm_tco_st_1_tqlo "" 0xa100a8b2 tco_st _REC_AXS_20_u1 190.5 _CNV_A_R_LINEAR_____16_CM 4 -48. 142.5 FORMAT "%5.1" /end AXIS_PTS
/begin MEASUREMENT tq_loss "Engine torque losses" SWORD _CNV_A_R_LINEAR_____30_CM 1 100. -1024. 1023.96875 DISPLAY_IDENTIFIER TQ_LOSS ECU_ADDRESS 0xd00023f0 FORMAT "%11.5" /end MEASUREMENT
/begin MEASUREMENT lv_opm_sel_tqlo_1 "Basis engine friction and pumping torque losses" UBYTE _CNV_S_2_RANGE__0___1_CM 1 100. 0. 1. DISPLAY_IDENTIFIER LV_OPM_SEL_TQLO_1 ECU_ADDRESS 0xd00023e8 BIT_MASK 0x1 /end MEASUREMENT
/begin MEASUREMENT lv_opm_sel_tqlo_2 "Basis engine friction and pumping torque losses" UBYTE _CNV_S_2_RANGE__0___1_CM 1 100. 0. 1. DISPLAY_IDENTIFIER LV_OPM_SEL_TQLO_2 ECU_ADDRESS 0xd00023e9 BIT_MASK 0x1 /end MEASUREMENT
/begin MEASUREMENT lv_tq_loss_opm_rls "Basis engine friction and pumping torque losses" UBYTE _CNV_S_2_RANGE__0___1_CM 1 100. 0. 1. DISPLAY_IDENTIFIER LV_TQ_LOSS_OPM_RLS ECU_ADDRESS 0xd00023ea BIT_MASK 0x1 /end MEASUREMENT
/begin MEASUREMENT tqfr "Basis engine friction and pumping torque losses" SWORD _CNV_A_R_LINEAR_____30_CM 1 100. -1024. 1023.96875 DISPLAY_IDENTIFIER TQFR ECU_ADDRESS 0xd00023f8 FORMAT "%11.5" /end MEASUREMENT
/begin AXIS_PTS ldpm_n_ip_tqfr "" 0xa100a88c n _REC_AXS_20_u2 8160. _CNV_A_R_LINEAR_____13_CM 12 0. 8160. FORMAT "%4.0" /end AXIS_PTS
/begin AXIS_PTS ldpm_maf_cyl_stk_ip_tqfr "" 0xa100a850 maf_cyl_stk _REC_AXS_20_u2 1389. _CNV_A_R_LINEAR_____108_CM 10 0. 1389. FORMAT "%7.2" /end AXIS_PTS
/begin CHARACTERISTIC ip_tqfr_vvl "Frictional and pumping torque losses of the engine" MAP 0xa100ab2c _REC_MAP_20_u2_u2_u2 1024. _CNV_A_R_LINEAR_____65_CM -1024. 0. DISPLAY_IDENTIFIER IP_TQFR_VVL FORMAT "%8.2"
 /begin AXIS_DESCR COM_AXIS n _CNV_A_R_LINEAR_____13_CM 12 0. 8160. FORMAT "%4.0" AXIS_PTS_REF ldpm_n_ip_tqfr /end AXIS_DESCR
 /begin AXIS_DESCR COM_AXIS maf_cyl_stk _CNV_A_R_LINEAR_____108_CM 10 0. 1389. FORMAT "%7.2" AXIS_PTS_REF ldpm_maf_cyl_stk_ip_tqfr /end AXIS_DESCR
/end CHARACTERISTIC
/begin CHARACTERISTIC ip_tqfr "Frictional and pumping torque losses of the engine" MAP 0xa100a8e4 _REC_MAP_20_u2_u2_u2 1024. _CNV_A_R_LINEAR_____65_CM -1024. 0. DISPLAY_IDENTIFIER IP_TQFR FORMAT "%8.2"
 /begin AXIS_DESCR COM_AXIS n _CNV_A_R_LINEAR_____13_CM 12 0. 8160. FORMAT "%4.0" AXIS_PTS_REF ldpm_n_ip_tqfr /end AXIS_DESCR
 /begin AXIS_DESCR COM_AXIS maf_cyl_stk _CNV_A_R_LINEAR_____108_CM 10 0. 1389. FORMAT "%7.2" AXIS_PTS_REF ldpm_maf_cyl_stk_ip_tqfr /end AXIS_DESCR
/end CHARACTERISTIC
/begin AXIS_PTS ldp_tco_ip_tqfr_add "" 0xa100a824 tco _REC_AXS_20_u1 190.5 _CNV_A_R_LINEAR_____16_CM 8 -48. 142.5 FORMAT "%5.1" /end AXIS_PTS
/begin AXIS_PTS ldp_opm_av_tqlo "" 0xa100a80c opm_av _REC_AXS_20_u1 8. _CNV_A_R_LINEAR_____0_CM 8 0. 8. FORMAT "%1.0" /end AXIS_PTS
/begin AXIS_PTS ldp_opm_req_tqlo "" 0xa100a818 opm_req _REC_AXS_20_u1 8. _CNV_A_R_LINEAR_____0_CM 8 0. 8. FORMAT "%1.0" /end AXIS_PTS
/begin CHARACTERISTIC id_tq_loss_opm_av "Table of index OPM_AV" CURVE 0xa100a8d4 _REC_CUR_20_u1_u1 7. _CNV_A_R_LINEAR_____0_CM 1. 8. DISPLAY_IDENTIFIER ID_TQ_LOSS_OPM_AV FORMAT "%1.0"
 /begin AXIS_DESCR COM_AXIS opm_av _CNV_A_R_LINEAR_____0_CM 8 0. 8. FORMAT "%1.0" AXIS_PTS_REF ldp_opm_av_tqlo /end AXIS_DESCR
/end CHARACTERISTIC
/begin CHARACTERISTIC id_tq_loss_opm_req "Table of index OPM_REQ" CURVE 0xa100a8dc _REC_CUR_20_u1_u1 7. _CNV_A_R_LINEAR_____0_CM 1. 8. DISPLAY_IDENTIFIER ID_TQ_LOSS_OPM_REQ FORMAT "%1.0"
 /begin AXIS_DESCR COM_AXIS opm_req _CNV_A_R_LINEAR_____0_CM 8 0. 8. FORMAT "%1.0" AXIS_PTS_REF ldp_opm_req_tqlo /end AXIS_DESCR
/end CHARACTERISTIC
/begin CHARACTERISTIC ip_tqfr_add_opm_1 "Coolant and oil temperature correction of friction  losses at OPM_1" MAP 0xa100a9d4 _REC_MAP_20_u2_u1_u1 2047.96875 _CNV_A_R_LINEAR_____65_CM -1024. 1023.96875 DISPLAY_IDENTIFIER IP_TQFR_ADD_OPM_1 FORMAT "%11.5"
 /begin AXIS_DESCR COM_AXIS tco _CNV_A_R_LINEAR_____16_CM 8 -48. 142.5 FORMAT "%5.1" AXIS_PTS_REF ldpm_tco_ip_tqfr_add /end AXIS_DESCR
 /begin AXIS_DESCR COM_AXIS toil _CNV_A_R_LINEAR_____25_CM 8 -40. 160. FORMAT "%3.0" AXIS_PTS_REF ldpm_toil_ip_tqfr_add /end AXIS_DESCR
/end CHARACTERISTIC
/begin CHARACTERISTIC ip_tqfr_add_opm_2 "Coolant and oil temperature correction of friction  losses at OPM_2" MAP 0xa100aa54 _REC_MAP_20_u2_u1_u1 2047.96875 _CNV_A_R_LINEAR_____65_CM -1024. 1023.96875 DISPLAY_IDENTIFIER IP_TQFR_ADD_OPM_2 FORMAT "%11.5"
 /begin AXIS_DESCR COM_AXIS tco _CNV_A_R_LINEAR_____16_CM 8 -48. 142.5 FORMAT "%5.1" AXIS_PTS_REF ldpm_tco_ip_tqfr_add /end AXIS_DESCR
 /begin AXIS_DESCR COM_AXIS toil _CNV_A_R_LINEAR_____25_CM 8 -40. 160. FORMAT "%3.0" AXIS_PTS_REF ldpm_toil_ip_tqfr_add /end AXIS_DESCR
/end CHARACTERISTIC
/begin CHARACTERISTIC ip_tqfr_dec_st_opm_1 "Decrement for start correction of friction losses at OPM_1" CURVE 0xa100aad4 _REC_CUR_20_u2_u1 1024. _CNV_A_R_LINEAR_____65_CM -1024. 0. DISPLAY_IDENTIFIER IP_TQFR_DEC_ST_OPM_1 FORMAT "%8.2"
 /begin AXIS_DESCR COM_AXIS tco_st _CNV_A_R_LINEAR_____16_CM 4 -48. 142.5 FORMAT "%5.1" AXIS_PTS_REF ldpm_tco_st_1_tqlo /end AXIS_DESCR
/end CHARACTERISTIC
/begin CHARACTERISTIC ip_tqfr_dec_st_opm_2 "Decrement for start correction of friction losses at OPM_2" CURVE 0xa100aadc _REC_CUR_20_u2_u1 1024. _CNV_A_R_LINEAR_____65_CM -1024. 0. DISPLAY_IDENTIFIER IP_TQFR_DEC_ST_OPM_2 FORMAT "%8.2"
 /begin AXIS_DESCR COM_AXIS tco_st _CNV_A_R_LINEAR_____16_CM 4 -48. 142.5 FORMAT "%5.1" AXIS_PTS_REF ldpm_tco_st_1_tqlo /end AXIS_DESCR
/end CHARACTERISTIC
/begin CHARACTERISTIC ip_tqfr_st_opm_1 "Friction torque correction after start phase at OPM_1" CURVE 0xa100ab1c _REC_CUR_20_u2_u1 1024. _CNV_A_R_LINEAR_____65_CM -1024. 0. DISPLAY_IDENTIFIER IP_TQFR_ST_OPM_1 FORMAT "%8.2"
 /begin AXIS_DESCR COM_AXIS tco_st _CNV_A_R_LINEAR_____16_CM 4 -48. 142.5 FORMAT "%5.1" AXIS_PTS_REF ldpm_tco_st_1_tqlo /end AXIS_DESCR
/end CHARACTERISTIC
/begin CHARACTERISTIC ip_tqfr_st_opm_2 "Friction torque correction after start phase at OPM_2" CURVE 0xa100ab24 _REC_CUR_20_u2_u1 1024. _CNV_A_R_LINEAR_____65_CM -1024. 0. DISPLAY_IDENTIFIER IP_TQFR_ST_OPM_2 FORMAT "%8.2"
 /begin AXIS_DESCR COM_AXIS tco_st _CNV_A_R_LINEAR_____16_CM 4 -48. 142.5 FORMAT "%5.1" AXIS_PTS_REF ldpm_tco_st_1_tqlo /end AXIS_DESCR
/end CHARACTERISTIC
/begin AXIS_PTS ldpm_tco_ip_tqfr_add "" 0xa100a8a8 tco _REC_AXS_20_u1 190.5 _CNV_A_R_LINEAR_____16_CM 8 -48. 142.5 FORMAT "%5.1" /end AXIS_PTS
/begin AXIS_PTS ldpm_toil_ip_tqfr_add "" 0xa100a8b8 toil _REC_AXS_20_u1 200. _CNV_A_R_LINEAR_____25_CM 8 -40. 160. FORMAT "%3.0" /end AXIS_PTS
/begin CHARACTERISTIC id_idx_opm_tqfr_st "Switch map to choose IP_TQFR_ST_OPM_1  or  ..._OPM_2 in dependance from OPM_AV" CURVE 0xa100a8cc _REC_CUR_20_u1_u1 1. _CNV_A_R_LINEAR_____0_CM 0. 1. DISPLAY_IDENTIFIER ID_IDX_OPM_TQFR_ST FORMAT "%1.0"
 /begin AXIS_DESCR COM_AXIS opm_av _CNV_A_R_LINEAR_____0_CM 8 0. 8. FORMAT "%1.0" AXIS_PTS_REF ldpm_opm_av /end AXIS_DESCR
/end CHARACTERISTIC
/begin MEASUREMENT tqfr_delta_add "Correction of friction and pumping losses" SWORD _CNV_A_R_LINEAR_____30_CM 1 100. -1024. 1023.96875 DISPLAY_IDENTIFIER TQFR_DELTA_ADD ECU_ADDRESS 0xd00023fe FORMAT "%11.5" /end MEASUREMENT
/begin CHARACTERISTIC ip_tqfr_delta_eng_new "Amp Correction" MAP 0xa100aafc _REC_MAP_20_u2_u2_u1 2047.96875 _CNV_A_R_LINEAR_____65_CM -1024. 1023.96875 DISPLAY_IDENTIFIER IP_TQFR_DELTA_ENG_NEW FORMAT "%11.5"
 /begin AXIS_DESCR COM_AXIS ctr_km_can _CNV_A_R_LINEAR_____70_CM 4 0. 655350. FORMAT "%7.0" AXIS_PTS_REF ldp_ctr_km_can__tqfr_add /end AXIS_DESCR
 /begin AXIS_DESCR COM_AXIS toil _CNV_A_R_LINEAR_____25_CM 4 -40. 160. FORMAT "%3.0" AXIS_PTS_REF ldp_toil__tqfr_add /end AXIS_DESCR
/end CHARACTERISTIC
/begin AXIS_PTS ldp_ctr_km_can__tqfr_add "" 0xa100ac20 ctr_km_can _REC_AXS_20_u2 655350. _CNV_A_R_LINEAR_____70_CM 4 0. 655350. FORMAT "%7.0" /end AXIS_PTS
/begin AXIS_PTS ldp_toil__tqfr_add "" 0xa100ac38 toil _REC_AXS_20_u1 200. _CNV_A_R_LINEAR_____25_CM 4 -40. 160. FORMAT "%3.0" /end AXIS_PTS
/begin CHARACTERISTIC ip_tqfr_delta_amp_opm_1 "Amp Correction at operation mode 1" CURVE 0xa100aae4 _REC_CUR_20_u2_u2 2047.96875 _CNV_A_R_LINEAR_____65_CM -1024. 1023.96875 DISPLAY_IDENTIFIER IP_TQFR_DELTA_AMP_OPM_1 FORMAT "%11.5"
 /begin AXIS_DESCR COM_AXIS amp _CNV_A_R_LINEAR_____450_CM 6 -2717. 2717. FORMAT "%7.2" AXIS_PTS_REF ldpm_amp__tqfr_add /end AXIS_DESCR
/end CHARACTERISTIC
/begin CHARACTERISTIC ip_tqfr_delta_amp_opm_2 "Amp Correction at operation mode 2" CURVE 0xa100aaf0 _REC_CUR_20_u2_u2 2047.96875 _CNV_A_R_LINEAR_____65_CM -1024. 1023.96875 DISPLAY_IDENTIFIER IP_TQFR_DELTA_AMP_OPM_2 FORMAT "%11.5"
 /begin AXIS_DESCR COM_AXIS amp _CNV_A_R_LINEAR_____450_CM 6 -2717. 2717. FORMAT "%7.2" AXIS_PTS_REF ldpm_amp__tqfr_add /end AXIS_DESCR
/end CHARACTERISTIC
/begin CHARACTERISTIC id_idx_opm_tqfr_delta_amp "Switch map to choose IP_TQFR_DELTA_AMP_OPM_1  or  ..._OPM_2 in dependance from OPM_AV" CURVE 0xa100a8c4 _REC_CUR_20_u1_u1 1. _CNV_A_R_LINEAR_____0_CM 0. 1. DISPLAY_IDENTIFIER ID_IDX_OPM_TQFR_DELTA_AMP FORMAT "%1.0"
 /begin AXIS_DESCR COM_AXIS opm_av _CNV_A_R_LINEAR_____0_CM 8 0. 8. FORMAT "%1.0" AXIS_PTS_REF ldpm_opm_av /end AXIS_DESCR
/end CHARACTERISTIC
/begin AXIS_PTS ldpm_amp__tqfr_add "AMP Correction" 0xa100ac50 amp _REC_AXS_20_u2 5434. _CNV_A_R_LINEAR_____450_CM 6 -2717. 2717. FORMAT "%7.2" /end AXIS_PTS
/begin CHARACTERISTIC c_tq_dif_is_ad_conv_min "" VALUE 0xa100acc8 _REC_VAL_20_s2 2047.96875 _CNV_A_R_LINEAR_____30_CM -1024. 1023.96875 DISPLAY_IDENTIFIER C_TQ_DIF_IS_AD_CONV_MIN FORMAT "%11.5" /end CHARACTERISTIC
/begin CHARACTERISTIC c_tq_dif_is_ad_acc_max "" VALUE 0xa100acc2 _REC_VAL_20_s2 2047.96875 _CNV_A_R_LINEAR_____30_CM -1024. 1023.96875 DISPLAY_IDENTIFIER C_TQ_DIF_IS_AD_ACC_MAX FORMAT "%11.5" /end CHARACTERISTIC
/begin CHARACTERISTIC c_tq_dif_is_ad_acc_min "" VALUE 0xa100acc4 _REC_VAL_20_s2 2047.96875 _CNV_A_R_LINEAR_____30_CM -1024. 1023.96875 DISPLAY_IDENTIFIER C_TQ_DIF_IS_AD_ACC_MIN FORMAT "%11.5" /end CHARACTERISTIC
/begin CHARACTERISTIC c_tq_dif_is_ad_max "" VALUE 0xa100acca _REC_VAL_20_s2 2047.96875 _CNV_A_R_LINEAR_____30_CM -1024. 1023.96875 DISPLAY_IDENTIFIER C_TQ_DIF_IS_AD_MAX FORMAT "%11.5" /end CHARACTERISTIC
/begin CHARACTERISTIC c_tq_dif_is_ad_min "" VALUE 0xa100accc _REC_VAL_20_s2 2047.96875 _CNV_A_R_LINEAR_____30_CM -1024. 1023.96875 DISPLAY_IDENTIFIER C_TQ_DIF_IS_AD_MIN FORMAT "%11.5" /end CHARACTERISTIC
/begin CHARACTERISTIC c_tq_dif_is_ad_acc_conv_max "" VALUE 0xa100acbe _REC_VAL_20_s2 2047.96875 _CNV_A_R_LINEAR_____30_CM -1024. 1023.96875 DISPLAY_IDENTIFIER C_TQ_DIF_IS_AD_ACC_CONV_MAX FORMAT "%11.5" /end CHARACTERISTIC
/begin CHARACTERISTIC c_tq_dif_is_ad_conv_max "" VALUE 0xa100acc6 _REC_VAL_20_s2 2047.96875 _CNV_A_R_LINEAR_____30_CM -1024. 1023.96875 DISPLAY_IDENTIFIER C_TQ_DIF_IS_AD_CONV_MAX FORMAT "%11.5" /end CHARACTERISTIC
/begin CHARACTERISTIC c_tq_dif_is_ad_acc_conv_min "" VALUE 0xa100acc0 _REC_VAL_20_s2 2047.96875 _CNV_A_R_LINEAR_____30_CM -1024. 1023.96875 DISPLAY_IDENTIFIER C_TQ_DIF_IS_AD_ACC_CONV_MIN FORMAT "%11.5" /end CHARACTERISTIC
/begin CHARACTERISTIC c_crlc_tq_dif_is_ad_acc "Filter constant for LOW_PASS_1" VALUE 0xa100acb0 _REC_VAL_20_u1 0.99609375 _CNV_A_R_LINEAR_____27_CM 0. 0.99609375 DISPLAY_IDENTIFIER C_CRLC_TQ_DIF_IS_AD_ACC FORMAT "%5.3" /end CHARACTERISTIC
/begin CHARACTERISTIC c_fac_tq_dif_is_ad_acc "" VALUE 0xa100acb4 _REC_VAL_20_u2 0.9999847412109381 _CNV_A_R_LINEAR_____68_CM 0. 0.9999847412109381 DISPLAY_IDENTIFIER C_FAC_TQ_DIF_IS_AD_ACC FORMAT "%7.5" /end CHARACTERISTIC
/begin CHARACTERISTIC c_fac_tq_dif_is_ad_conv "" VALUE 0xa100acb8 _REC_VAL_20_u2 0.9999847412109381 _CNV_A_R_LINEAR_____68_CM 0. 0.9999847412109381 DISPLAY_IDENTIFIER C_FAC_TQ_DIF_IS_AD_CONV FORMAT "%7.5" /end CHARACTERISTIC
/begin CHARACTERISTIC c_fac_tq_dif_is_ad_acc_conv "" VALUE 0xa100acb6 _REC_VAL_20_u2 0.9999847412109381 _CNV_A_R_LINEAR_____68_CM 0. 0.9999847412109381 DISPLAY_IDENTIFIER C_FAC_TQ_DIF_IS_AD_ACC_CONV FORMAT "%7.5" /end CHARACTERISTIC
/begin CHARACTERISTIC c_fac_tq_dif_is_ad "" VALUE 0xa100acb2 _REC_VAL_20_u2 0.9999847412109381 _CNV_A_R_LINEAR_____68_CM 0. 0.9999847412109381 DISPLAY_IDENTIFIER C_FAC_TQ_DIF_IS_AD FORMAT "%7.5" /end CHARACTERISTIC
/begin MEASUREMENT tq_dif_is_ad_acc_1 "ACC torque adaptation" SWORD _CNV_A_R_LINEAR_____30_CM 1 100. -1024. 1023.96875 DISPLAY_IDENTIFIER TQ_DIF_IS_AD_ACC_1 ECU_ADDRESS 0xd00023ec FORMAT "%11.5" /end MEASUREMENT
/begin MEASUREMENT tq_dif_is_ad_acc_conv "ACC and Hydraulic converter torque adaptation" SWORD _CNV_A_R_LINEAR_____30_CM 1 100. -1024. 1023.96875 DISPLAY_IDENTIFIER TQ_DIF_IS_AD_ACC_CONV ECU_ADDRESS 0xd00023ee FORMAT "%11.5" /end MEASUREMENT
/begin MEASUREMENT lv_is_ad_inh "Application incidence value (additional adaptation conditions, project specific)" UBYTE _CNV_S_2_RANGE__0___1_CM 1 100. 0. 1. DISPLAY_IDENTIFIER LV_IS_AD_INH ECU_ADDRESS 0xd000240a BIT_MASK 0x1 /end MEASUREMENT
/begin MEASUREMENT lv_is_ad_inh_obd "Application incidence value" UBYTE _CNV_S_2_RANGE__0___1_CM 1 100. 0. 1. DISPLAY_IDENTIFIER LV_IS_AD_INH_OBD ECU_ADDRESS 0xd000240b BIT_MASK 0x1 /end MEASUREMENT
/begin MEASUREMENT tq_loss_add_cus "additional torque losses" SWORD _CNV_A_R_LINEAR_____30_CM 1 100. -1024. 1023.96875 DISPLAY_IDENTIFIER TQ_LOSS_ADD_CUS ECU_ADDRESS 0xd00023f4 FORMAT "%11.5" /end MEASUREMENT
/begin AXIS_PTS ldpm_n_100 "" 0xa100a868 n _REC_AXS_20_u2 8160. _CNV_A_R_LINEAR_____13_CM 16 0. 8160. FORMAT "%4.0" /end AXIS_PTS
/begin AXIS_PTS ldpm_maf_cyl_stk__tqfr "" 0xa100a83c maf _REC_AXS_20_u2 1389. _CNV_A_R_LINEAR_____108_CM 8 0. 1389. FORMAT "%7.2" /end AXIS_PTS
/begin MEASUREMENT nvmy_tqlo.nvmy_dtsysisad.tq_dif_is_ad "" SWORD _CNV_A_R_LINEAR_____30_CM 1 100. -1024. 1023.96875 DISPLAY_IDENTIFIER TQ_DIF_IS_AD ECU_ADDRESS 0xd00023e0 FORMAT "%11.5" /end MEASUREMENT
/begin MEASUREMENT nvmy_tqlo.nvmy_dtsysisad.tq_dif_is_ad_conv "" SWORD _CNV_A_R_LINEAR_____30_CM 1 100. -1024. 1023.96875 DISPLAY_IDENTIFIER TQ_DIF_IS_AD_CONV ECU_ADDRESS 0xd00023e2 FORMAT "%11.5" /end MEASUREMENT
/begin MEASUREMENT nvmy_tqlo.nvmy_dtsysisad.tq_dif_is_ad_acc "" SWORD _CNV_A_R_LINEAR_____30_CM 1 100. -1024. 1023.96875 DISPLAY_IDENTIFIER TQ_DIF_IS_AD_ACC ECU_ADDRESS 0xd00023e4 FORMAT "%11.5" /end MEASUREMENT
/begin MEASUREMENT tco_mes "measured coolant temperature" UBYTE _CNV_A_R_LINEAR_____16_CM 1 100. -48. 142.5 DISPLAY_IDENTIFIER TCO_MES ECU_ADDRESS 0xd0002e3c FORMAT "%6.2" /end MEASUREMENT
/begin MEASUREMENT tco_st "coolant temperature at start" UBYTE _CNV_A_R_LINEAR_____16_CM 1 100. -48. 142.5 DISPLAY_IDENTIFIER TCO_ST ECU_ADDRESS 0xd0002e3d FORMAT "%6.2" /end MEASUREMENT
/begin MEASUREMENT tco "coolant temperature" UBYTE _CNV_A_R_LINEAR_____16_CM 1 100. -48. 142.5 DISPLAY_IDENTIFIER TCO ECU_ADDRESS 0xd0002e37 FORMAT "%6.2" /end MEASUREMENT
/begin MEASUREMENT lv_cdn_ini_tco "Boolean for coolant temperature initialisation conditions" UBYTE _CNV_S_2_RANGE__0___1_CM 1 100. 0. 1. DISPLAY_IDENTIFIER LV_CDN_INI_TCO ECU_ADDRESS 0xc0001c94 BIT_MASK 0x1 /end MEASUREMENT
/begin AXIS_PTS ldp_v_tco_ip_tco_mes "" 0xa1003634 v_tco _REC_AXS_20_u2 4.49560546875 _CNV_A_R_LINEAR_____2_CM 16 0. 4.9951171875 FORMAT "%5.3" /end AXIS_PTS
/begin CHARACTERISTIC ip_tco_mes "Linearization of the coolant temperature sensor voltage for temperature acquisition " CURVE 0xa100372c _REC_CUR_20_u1_u2 28.575 _CNV_A_R_LINEAR_____16_CM -48. 142.5 DISPLAY_IDENTIFIER IP_TCO_MES FORMAT "%6.2"
 /begin AXIS_DESCR COM_AXIS v_tco _CNV_A_R_LINEAR_____2_CM 16 0. 4.9951171875 FORMAT "%5.3" AXIS_PTS_REF ldp_v_tco_ip_tco_mes /end AXIS_DESCR
/end CHARACTERISTIC
/begin CHARACTERISTIC c_tco_mes_grd_max "Maximum permissible temperature gradient for coolant temperature gradient monitoring" VALUE 0xa100383d _REC_VAL_20_u1 190.5 _CNV_A_R_LINEAR_____24_CM 0. 190.5 DISPLAY_IDENTIFIER C_TCO_MES_GRD_MAX FORMAT "%6.2" /end CHARACTERISTIC
/begin CHARACTERISTIC c_tco_ini_tia_im "Coolant temperature initialization value in case of a coolant- and intake air- temperature failure" VALUE 0xa100383c _REC_VAL_20_u1 190.5 _CNV_A_R_LINEAR_____16_CM -48. 142.5 DISPLAY_IDENTIFIER C_TCO_INI_TIA_IM FORMAT "%6.2" /end CHARACTERISTIC
/begin MEASUREMENT tco_stop "Coolant temperature at transition to engine stop ( ES )" UBYTE _CNV_A_R_LINEAR_____16_CM 1 100. -48. 142.5 DISPLAY_IDENTIFIER TCO_STOP ECU_ADDRESS 0xd0002e3e FORMAT "%6.2" /end MEASUREMENT
/begin AXIS_PTS ldp_tia_im_ip_tco_ini_tia_im "" 0xa10035f6 tia _REC_AXS_20_u1 190.5 _CNV_A_R_LINEAR_____16_CM 6 -48. 142.5 FORMAT "%6.2" /end AXIS_PTS
/begin CHARACTERISTIC ip_tco_ini_tia_im "Coolant temperature initialization value in case of a coolant temperature failure" CURVE 0xa1003724 _REC_CUR_20_u1_u1 28.575 _CNV_A_R_LINEAR_____16_CM -48. 142.5 DISPLAY_IDENTIFIER IP_TCO_INI_TIA_IM FORMAT "%6.2"
 /begin AXIS_DESCR COM_AXIS tia _CNV_A_R_LINEAR_____16_CM 6 -48. 142.5 FORMAT "%6.2" AXIS_PTS_REF ldp_tia_im_ip_tco_ini_tia_im /end AXIS_DESCR
/end CHARACTERISTIC
/begin MEASUREMENT v_tco "Coolant temperature sensor raw acquisition." UWORD _CNV_A_R_LINEAR_____2_CM 1 100. 0. 4.9951171875 DISPLAY_IDENTIFIER V_TCO ECU_ADDRESS 0xd00025f0 FORMAT "%5.3" /end MEASUREMENT
/begin CHARACTERISTIC c_t_n_perc_ecf_act "Time condition for electric fan during self diagnostic" VALUE 0xa100382f _REC_VAL_20_u1 51. _CNV_A_R_LINEAR_____78_CM 0. 51. DISPLAY_IDENTIFIER C_T_N_PERC_ECF_ACT FORMAT "%4.1" /end CHARACTERISTIC
/begin CHARACTERISTIC c_n_perc_act_ecf "Set value for N_PERC_ECF" VALUE 0xa100380e _REC_VAL_20_u1 99.609375 _CNV_A_R_LINEAR_____5_CM 0. 99.609375 DISPLAY_IDENTIFIER C_N_PERC_ACT_ECF FORMAT "%9.6" /end CHARACTERISTIC
/begin CHARACTERISTIC c_ecfpwm_ecf_man "Manual ECFPWM_ECF" VALUE 0xa10037f2 _REC_VAL_20_u1 99.609375 _CNV_A_R_LINEAR_____5_CM 0. 99.609375 DISPLAY_IDENTIFIER C_ECFPWM_ECF_MAN FORMAT "%9.6" /end CHARACTERISTIC
/begin CHARACTERISTIC lc_ecfpwm_ecf_man "constant switch to manual ECFPWM_ECF activation" VALUE 0xa100385b _REC_VAL_20_u1 1. _CNV_A_R_LINEAR_____0_CM 0. 1. DISPLAY_IDENTIFIER LC_ECFPWM_ECF_MAN FORMAT "%2.0" /end CHARACTERISTIC
/begin MEASUREMENT ecfpwm_igk_off "Electric fan pulse width modulation in the self-holding phase" UBYTE _CNV_A_R_LINEAR_____5_CM 1 100. 0. 99.609375 DISPLAY_IDENTIFIER ECFPWM_IGK_OFF ECU_ADDRESS 0xd0002e2a FORMAT "%9.6" /end MEASUREMENT
/begin MEASUREMENT ecfpwm[0] "Pulse width modulated output signal for the electric controlled cooling fans" UBYTE _CNV_A_R_LINEAR_____5_CM 1 100. 0. 99.609375 DISPLAY_IDENTIFIER ECFPWM[0] ECU_ADDRESS 0xd0002e29 FORMAT "%9.6" /end MEASUREMENT
/begin MEASUREMENT t_n_perc_ecf_act "Delay for setting ecfpwm in PWL" UBYTE _CNV_A_R_LINEAR_____78_CM 1 100. 0. 51. DISPLAY_IDENTIFIER T_N_PERC_ECF_ACT ECU_ADDRESS 0xc0001c48 FORMAT "%4.1" /end MEASUREMENT
/begin CHARACTERISTIC lc_ectpwm_man "Configuration bit for activation of manual PWM output signal adjustment" VALUE 0xa100385c _REC_VAL_20_u1 1. _CNV_A_R_LINEAR_____0_CM 0. 1. DISPLAY_IDENTIFIER LC_ECTPWM_MAN FORMAT "%1.0" /end CHARACTERISTIC
/begin MEASUREMENT ectpwm "Pulse width modulated output signal for the electronic controlled thermostat" UWORD _CNV_A_R_LINEAR_____7_CM 1 100. 0. 99.99847412109381 DISPLAY_IDENTIFIER ECTPWM ECU_ADDRESS 0xd00025e8 /end MEASUREMENT
/begin CHARACTERISTIC c_ectpwm_man "Manual adjustable PWM output signal for the electronic controlled thermostat" VALUE 0xa10037fe _REC_VAL_20_u2 99.99847412109381 _CNV_A_R_LINEAR_____7_CM 0. 99.99847412109381 DISPLAY_IDENTIFIER C_ECTPWM_MAN /end CHARACTERISTIC
/begin CHARACTERISTIC c_ectpwm_ast "calibratable ECTPWM after start" VALUE 0xa10037fa _REC_VAL_20_u2 99.99847412109381 _CNV_A_R_LINEAR_____7_CM 0. 99.99847412109381 DISPLAY_IDENTIFIER C_ECTPWM_AST /end CHARACTERISTIC
/begin CHARACTERISTIC c_t_ectpwm_ast "time for ECTPWM-calculation after start" VALUE 0xa100382d _REC_VAL_20_u1 255. _CNV_A_R_LINEAR_____35_CM 0. 255. DISPLAY_IDENTIFIER C_T_ECTPWM_AST FORMAT "%3.0" /end CHARACTERISTIC
/begin CHARACTERISTIC c_tco_ectpwm "calibratable TCO-threshold for ECTPWM after start" VALUE 0xa100383b _REC_VAL_20_u1 190.5 _CNV_A_R_LINEAR_____16_CM -48. 142.5 DISPLAY_IDENTIFIER C_TCO_ECTPWM FORMAT "%6.2" /end CHARACTERISTIC
/begin MEASUREMENT lv_err_th "Boolean for coolant thermostat error" UBYTE _CNV_S_2_RANGE__0___1_CM 1 100. 0. 1. DISPLAY_IDENTIFIER LV_ERR_TH ECU_ADDRESS 0xd00033ba BIT_MASK 0x1 /end MEASUREMENT
/begin MEASUREMENT tia_min_diag_th "Minimum Intake air temperature value during coolant thermostat diagnosis" UBYTE _CNV_A_R_LINEAR_____16_CM 1 100. -48. 142.5 DISPLAY_IDENTIFIER TIA_MIN_DIAG_TH ECU_ADDRESS 0xc0001c8b FORMAT "%6.2" /end MEASUREMENT
/begin MEASUREMENT t_tco_de_diag_th "Timer for coolant temperature deviation for coolant thermostat diagnosis" UWORD _CNV_A_R_LINEAR_____35_CM 1 100. 0. 65535. DISPLAY_IDENTIFIER T_TCO_DE_DIAG_TH ECU_ADDRESS 0xc0001c6c FORMAT "%5.0" /end MEASUREMENT
/begin MEASUREMENT tia_de_diag_th "Intake air temperature deviation value for coolant thermostat diagnosis" UBYTE _CNV_A_R_LINEAR_____16_CM 1 100. -48. 142.5 DISPLAY_IDENTIFIER TIA_DE_DIAG_TH ECU_ADDRESS 0xc0001c89 FORMAT "%6.2" /end MEASUREMENT
/begin MEASUREMENT tco_de_ini_diag_th "Initialization value for coolant temperature deviation for coolant thermostat diagnosis" UBYTE _CNV_A_R_LINEAR_____16_CM 1 100. -48. 142.5 DISPLAY_IDENTIFIER TCO_DE_INI_DIAG_TH ECU_ADDRESS 0xc0001c81 FORMAT "%6.2" /end MEASUREMENT
/begin MEASUREMENT lv_tco_de_max_diag_th "Boolean for high coolant temperature deviation for coolant thermostat diagnosis" UBYTE _CNV_S_2_RANGE__0___1_CM 1 100. 0. 1. DISPLAY_IDENTIFIER LV_TCO_DE_MAX_DIAG_TH ECU_ADDRESS 0xc0001c9f BIT_MASK 0x1 /end MEASUREMENT
/begin MEASUREMENT tco_de_diag_th "Coolant temperature deviation value for coolant thermostat diagnosis" UBYTE _CNV_A_R_LINEAR_____16_CM 1 100. -48. 142.5 DISPLAY_IDENTIFIER TCO_DE_DIAG_TH ECU_ADDRESS 0xc0001c80 FORMAT "%6.2" /end MEASUREMENT
/begin MEASUREMENT tco_diag_th "Coolant temperature of the performed coolant thermostat diagnosis" UBYTE _CNV_A_R_LINEAR_____16_CM 1 100. -48. 142.5 DISPLAY_IDENTIFIER TCO_DIAG_TH ECU_ADDRESS 0xc0001c82 FORMAT "%6.2" /end MEASUREMENT
/begin CHARACTERISTIC c_tia_st_min_diag_th "Minimum intake air temperature at start for coolant thermostat diagnosis" VALUE 0xa100384a _REC_VAL_20_u1 190.5 _CNV_A_R_LINEAR_____16_CM -48. 142.5 DISPLAY_IDENTIFIER C_TIA_ST_MIN_DIAG_TH FORMAT "%6.2" /end CHARACTERISTIC
/begin CHARACTERISTIC c_ratio_t_puc_thd_diag_th "\"Pull fuel cut off\" ratio threshold in per cent for coolant thermostat diagnosis" VALUE 0xa1003812 _REC_VAL_20_u1 99.609375 _CNV_A_R_LINEAR_____5_CM 0. 99.609375 DISPLAY_IDENTIFIER C_RATIO_T_PUC_THD_DIAG_TH FORMAT "%9.6" /end CHARACTERISTIC
/begin CHARACTERISTIC c_ratio_t_vs_max_thd_diag_th "\"Vehicle speed maximum\" ratio threshold in per cent for coolant thermostat diagnosis" VALUE 0xa1003813 _REC_VAL_20_u1 99.609375 _CNV_A_R_LINEAR_____5_CM 0. 99.609375 DISPLAY_IDENTIFIER C_RATIO_T_VS_MAX_THD_DIAG_TH FORMAT "%9.6" /end CHARACTERISTIC
/begin CHARACTERISTIC c_ratio_t_vs_min_thd_diag_th "\"Vehicle speed minimum\" ratio threshold in per cent for coolant thermostat diagnosis" VALUE 0xa1003814 _REC_VAL_20_u1 99.609375 _CNV_A_R_LINEAR_____5_CM 0. 99.609375 DISPLAY_IDENTIFIER C_RATIO_T_VS_MIN_THD_DIAG_TH FORMAT "%9.6" /end CHARACTERISTIC
/begin CHARACTERISTIC c_ratio_t_load_min_thd_diag_th " \"Engine load minimum\" ratio threshold in per cent for coolant thermostat diagnosis" VALUE 0xa1003811 _REC_VAL_20_u1 99.609375 _CNV_A_R_LINEAR_____5_CM 0. 99.609375 DISPLAY_IDENTIFIER C_RATIO_T_LOAD_MIN_THD_DIAG_TH FORMAT "%9.6" /end CHARACTERISTIC
/begin CHARACTERISTIC c_n_max_diag_th "Maximum engine speed for high coolant temperature deviation detection for coolant thermostat diagnosis" VALUE 0xa100380a _REC_VAL_20_u2 8160. _CNV_A_R_LINEAR_____13_CM 0. 8160. DISPLAY_IDENTIFIER C_N_MAX_DIAG_TH FORMAT "%4.0" /end CHARACTERISTIC
/begin CHARACTERISTIC c_t_tco_de_diag_th "Time for high coolant temperature deviation detection for coolant thermostat diagnosis" VALUE 0xa1003832 _REC_VAL_20_u2 65535. _CNV_A_R_LINEAR_____35_CM 0. 65535. DISPLAY_IDENTIFIER C_T_TCO_DE_DIAG_TH FORMAT "%5.0" /end CHARACTERISTIC
/begin CHARACTERISTIC c_tco_st_max_diag_th "Maximum coolant temperature at start for coolant thermostat diagnosis" VALUE 0xa1003841 _REC_VAL_20_u1 190.5 _CNV_A_R_LINEAR_____16_CM -48. 142.5 DISPLAY_IDENTIFIER C_TCO_ST_MAX_DIAG_TH FORMAT "%6.2" /end CHARACTERISTIC
/begin CHARACTERISTIC c_tia_de_max_diag_th "Maximum intake air temperature deviation for coolant thermostat diagnosis" VALUE 0xa1003848 _REC_VAL_20_u1 190.5 _CNV_A_R_LINEAR_____16_CM -48. 142.5 DISPLAY_IDENTIFIER C_TIA_DE_MAX_DIAG_TH FORMAT "%6.2" /end CHARACTERISTIC
/begin CHARACTERISTIC c_tco_de_max_diag_th "Maximum coolant temperature deviation for coolant thermostat diagnosis" VALUE 0xa100383a _REC_VAL_20_u1 190.5 _CNV_A_R_LINEAR_____16_CM -48. 142.5 DISPLAY_IDENTIFIER C_TCO_DE_MAX_DIAG_TH FORMAT "%6.2" /end CHARACTERISTIC
/begin CHARACTERISTIC c_tco_th_open_diag_th "Regulation temperature for coolant thermostat opening" VALUE 0xa1003846 _REC_VAL_20_u1 190.5 _CNV_A_R_LINEAR_____16_CM -48. 142.5 DISPLAY_IDENTIFIER C_TCO_TH_OPEN_DIAG_TH FORMAT "%6.2" /end CHARACTERISTIC
/begin CHARACTERISTIC c_tco_st_min_diag_th "Minimum coolant temperature at start for coolant thermostat diagnosis" VALUE 0xa1003843 _REC_VAL_20_u1 190.5 _CNV_A_R_LINEAR_____16_CM -48. 142.5 DISPLAY_IDENTIFIER C_TCO_ST_MIN_DIAG_TH FORMAT "%6.2" /end CHARACTERISTIC
/begin CHARACTERISTIC c_tco_wup_min_diag_th "Minimum coolant warm up temperature for coolant thermostat diagnosis" VALUE 0xa1003847 _REC_VAL_20_u1 190.5 _CNV_A_R_LINEAR_____16_CM -48. 142.5 DISPLAY_IDENTIFIER C_TCO_WUP_MIN_DIAG_TH FORMAT "%6.2" /end CHARACTERISTIC
/begin MEASUREMENT lv_end_diag_rbm_th "Boolean for end of coolant thermostat diagnosis for RBM" UBYTE _CNV_S_2_RANGE__0___1_CM 1 100. 0. 1. DISPLAY_IDENTIFIER LV_END_DIAG_RBM_TH ECU_ADDRESS 0xd0002e45 BIT_MASK 0x1 /end MEASUREMENT
/begin MEASUREMENT lv_act_diag_th "Boolean for coolant thermostat diagnosis activated" UBYTE _CNV_S_2_RANGE__0___1_CM 1 100. 0. 1. DISPLAY_IDENTIFIER LV_ACT_DIAG_TH ECU_ADDRESS 0xd0002e41 BIT_MASK 0x1 /end MEASUREMENT
/begin MEASUREMENT lv_act_diag_rbm_th "Boolean for coolant thermostat diagnosis activated for RBM" UBYTE _CNV_S_2_RANGE__0___1_CM 1 100. 0. 1. DISPLAY_IDENTIFIER LV_ACT_DIAG_RBM_TH ECU_ADDRESS 0xd0002e40 BIT_MASK 0x1 /end MEASUREMENT
/begin MEASUREMENT lv_cnl_diag_th "Boolean for coolant thermostat diagnosis cancelled" UBYTE _CNV_S_2_RANGE__0___1_CM 1 100. 0. 1. DISPLAY_IDENTIFIER LV_CNL_DIAG_TH ECU_ADDRESS 0xc0001c97 BIT_MASK 0x1 /end MEASUREMENT
/begin MEASUREMENT lv_cdn_temp_diag_th "Boolean for coolant thermostat diagnosis cancelled" UBYTE _CNV_S_2_RANGE__0___1_CM 1 100. 0. 1. DISPLAY_IDENTIFIER LV_CDN_TEMP_DIAG_TH ECU_ADDRESS 0xc0001c96 BIT_MASK 0x1 /end MEASUREMENT
/begin CHARACTERISTIC c_abc_inc_th "Debounce counter increment - Thermostat heating mechanical diagnosis" VALUE 0xa10037e3 _REC_VAL_20_u1 255. _CNV_A_R_LINEAR_____0_CM 0. 255. DISPLAY_IDENTIFIER C_ABC_INC_TH FORMAT "%3.0" /end CHARACTERISTIC
/begin CHARACTERISTIC c_abc_max_th "Debounce counter maximum value - Thermostat heating mechanical diagnosis" VALUE 0xa10037ea _REC_VAL_20_u1 254. _CNV_A_R_LINEAR_____0_CM 1. 255. DISPLAY_IDENTIFIER C_ABC_MAX_TH FORMAT "%3.0" /end CHARACTERISTIC
/begin MEASUREMENT state_rbm_th "Interface of thermostat monitoring with the Rate-Based Monitoring statistics" UBYTE _CNV_A_R_LINEAR_____0_CM 1 100. 0. 7. DISPLAY_IDENTIFIER STATE_RBM_TH ECU_ADDRESS 0xd0002e36 FORMAT "%1.0" /end MEASUREMENT
/begin MEASUREMENT lv_inh_diag_th "Boolean for coolant thermostat diagnosis inhibit" UBYTE _CNV_S_2_RANGE__0___1_CM 1 100. 0. 1. DISPLAY_IDENTIFIER LV_INH_DIAG_TH ECU_ADDRESS 0xd0002e5b BIT_MASK 0x1 /end MEASUREMENT
/begin MEASUREMENT lv_inh_diag_rbm_th "Boolean for coolant thermostat diagnosis inhibit due to OBD error" UBYTE _CNV_S_2_RANGE__0___1_CM 1 100. 0. 1. DISPLAY_IDENTIFIER LV_INH_DIAG_RBM_TH ECU_ADDRESS 0xd0002e53 BIT_MASK 0x1 /end MEASUREMENT
/begin MEASUREMENT lv_n_rel_cwp_inh_diag_th "Boolean for coolant thermostat diagnosis inhibit due high cooling water pump speed" UBYTE _CNV_S_2_RANGE__0___1_CM 1 100. 0. 1. DISPLAY_IDENTIFIER LV_N_REL_CWP_INH_DIAG_TH ECU_ADDRESS 0xc0001c9d BIT_MASK 0x1 /end MEASUREMENT
/begin MEASUREMENT lv_tia_de_inh_diag_th "Boolean for coolant thermostat diagnosis inhibit due high intake air temperature deviation" UBYTE _CNV_S_2_RANGE__0___1_CM 1 100. 0. 1. DISPLAY_IDENTIFIER LV_TIA_DE_INH_DIAG_TH ECU_ADDRESS 0xc0001ca0 BIT_MASK 0x1 /end MEASUREMENT
/begin MEASUREMENT mass_vol_cwp_diag_th "Cooling water pump effected coolant mass volume for coolant thermostat diagnosis" UWORD _CNV_A_R_LINEAR_____0_CM 1 100. 0. 65535. DISPLAY_IDENTIFIER MASS_VOL_CWP_DIAG_TH ECU_ADDRESS 0xc0001c54 FORMAT "%5.0" /end MEASUREMENT
/begin MEASUREMENT tia_min_inh_diag_th "Minimum Intake air temperature value during coolant thermostat diagnosis for inhibition" UBYTE _CNV_A_R_LINEAR_____16_CM 1 100. -48. 142.5 DISPLAY_IDENTIFIER TIA_MIN_INH_DIAG_TH ECU_ADDRESS 0xc0001c8c FORMAT "%6.2" /end MEASUREMENT
/begin MEASUREMENT tia_de_inh_diag_th "Intake air temperature deviation value for coolant thermostat diagnosis inhibition" UBYTE _CNV_A_R_LINEAR_____16_CM 1 100. -48. 142.5 DISPLAY_IDENTIFIER TIA_DE_INH_DIAG_TH ECU_ADDRESS 0xc0001c8a FORMAT "%6.2" /end MEASUREMENT
/begin CHARACTERISTIC c_tia_de_max_inh_diag_th "Maximum intake air temperature deviation for coolant thermostat diagnosis inhibition" VALUE 0xa1003849 _REC_VAL_20_u1 190.5 _CNV_A_R_LINEAR_____16_CM -48. 142.5 DISPLAY_IDENTIFIER C_TIA_DE_MAX_INH_DIAG_TH FORMAT "%6.2" /end CHARACTERISTIC
/begin CHARACTERISTIC c_tam_min_diag_th "Minimum TAM for coolant thermostat diagnosis" VALUE 0xa1003834 _REC_VAL_20_u1 190.5 _CNV_A_R_LINEAR_____16_CM -48. 142.5 DISPLAY_IDENTIFIER C_TAM_MIN_DIAG_TH FORMAT "%6.2" /end CHARACTERISTIC
/begin CHARACTERISTIC c_n_rel_cwp_min_diag_th "Minimum cooling water pump speed for coolant thermostat diagnosis" VALUE 0xa100380f _REC_VAL_20_u1 255. _CNV_A_R_LINEAR_____0_CM 0. 255. DISPLAY_IDENTIFIER C_N_REL_CWP_MIN_DIAG_TH FORMAT "%3.0" /end CHARACTERISTIC
/begin CHARACTERISTIC c_mass_vol_cwp_min_diag_th "Minimum cooling water pump effected coolant mass volume for coolant thermostat diagnosis" VALUE 0xa1003808 _REC_VAL_20_u2 65535. _CNV_A_R_LINEAR_____0_CM 0. 65535. DISPLAY_IDENTIFIER C_MASS_VOL_CWP_MIN_DIAG_TH FORMAT "%5.0" /end CHARACTERISTIC
/begin CHARACTERISTIC c_mass_vol_cwp_max "Cooling water pump effected coolant mass volume increment for coolant thermostat diagnosis" VALUE 0xa1003806 _REC_VAL_20_u2 65535. _CNV_A_R_LINEAR_____0_CM 0. 65535. DISPLAY_IDENTIFIER C_MASS_VOL_CWP_MAX FORMAT "%5.0" /end CHARACTERISTIC
/begin MEASUREMENT mass_vol_cwp_diag_th_tmp "Cooling water pump effected coolant mass volume for coolant thermostat diagnosis" UWORD _CNV_A_R_LINEAR_____0_CM 1 100. 0. 65535. DISPLAY_IDENTIFIER MASS_VOL_CWP_DIAG_TH_TMP ECU_ADDRESS 0xc0001c56 FORMAT "%5.0" /end MEASUREMENT
/begin MEASUREMENT t_ectpwm_inh_diag_th "Max.time for ECTPWM exceeding threshold - for coolant thermostat diagnosis" UBYTE _CNV_A_R_LINEAR_____35_CM 1 100. 0. 255. DISPLAY_IDENTIFIER T_ECTPWM_INH_DIAG_TH ECU_ADDRESS 0xc0001c7b FORMAT "%3.0" /end MEASUREMENT
/begin MEASUREMENT t_ecfpwm_inh_diag_th "Max.time for ECFPWM exceeding threshold - for coolant fan diagnosis" UBYTE _CNV_A_R_LINEAR_____35_CM 1 100. 0. 255. DISPLAY_IDENTIFIER T_ECFPWM_INH_DIAG_TH ECU_ADDRESS 0xc0001c7a FORMAT "%3.0" /end MEASUREMENT
/begin MEASUREMENT lv_ectpwm_inh_diag_th "Condition for ECTPWM exceeding threshold - for coolant thermostat diagnosis" UBYTE _CNV_S_2_RANGE__0___1_CM 1 100. 0. 1. DISPLAY_IDENTIFIER LV_ECTPWM_INH_DIAG_TH ECU_ADDRESS 0xc0001c99 BIT_MASK 0x1 /end MEASUREMENT
/begin MEASUREMENT lv_ecfpwm_inh_diag_th "Condition for ECFPWM exceeding threshold - for coolant fan diagnosis" UBYTE _CNV_S_2_RANGE__0___1_CM 1 100. 0. 1. DISPLAY_IDENTIFIER LV_ECFPWM_INH_DIAG_TH ECU_ADDRESS 0xc0001c98 BIT_MASK 0x1 /end MEASUREMENT
/begin CHARACTERISTIC c_t_ectpwm_inh_diag_th "Max.time for ECTPWM exceeding threshold - for coolant thermostat diagnosis" VALUE 0xa100382e _REC_VAL_20_u1 255. _CNV_A_R_LINEAR_____35_CM 0. 255. DISPLAY_IDENTIFIER C_T_ECTPWM_INH_DIAG_TH FORMAT "%3.0" /end CHARACTERISTIC
/begin CHARACTERISTIC c_t_ecfpwm_inh_diag_th "Max.time for ECFPWM exceeding threshold - for coolant fan diagnosis" VALUE 0xa100382c _REC_VAL_20_u1 255. _CNV_A_R_LINEAR_____35_CM 0. 255. DISPLAY_IDENTIFIER C_T_ECFPWM_INH_DIAG_TH FORMAT "%3.0" /end CHARACTERISTIC
/begin CHARACTERISTIC c_ectpwm_inh_diag_th "Max. ECTPWM to deactivate coolant thermostat diagnosis" VALUE 0xa10037fc _REC_VAL_20_u2 99.99847412109381 _CNV_A_R_LINEAR_____7_CM 0. 99.99847412109381 DISPLAY_IDENTIFIER C_ECTPWM_INH_DIAG_TH /end CHARACTERISTIC
/begin CHARACTERISTIC c_ecfpwm_inh_diag_th[0] "Max. ECFPWM to deactivate coolant fan diagnosis" VALUE 0xa10037f3 _REC_VAL_20_u1 99.609375 _CNV_A_R_LINEAR_____5_CM 0. 99.609375 DISPLAY_IDENTIFIER C_ECFPWM_INH_DIAG_TH[0] /end CHARACTERISTIC
/begin AXIS_PTS ldp_tco_sub_id_n_rel_cwp_max "" 0xa10035c8 tco_sub _REC_AXS_20_u2 190.5 _CNV_A_R_LINEAR_____452_CM 6 -48. 142.5 FORMAT "%7.3" /end AXIS_PTS
/begin CHARACTERISTIC id_n_rel_cwp_max_diag_th "Maximum cooling water pump speed for coolant thermostat diagnosis" CURVE 0xa100365e _REC_CUR_20_u1_u2 255. _CNV_A_R_LINEAR_____0_CM 0. 255. DISPLAY_IDENTIFIER ID_N_REL_CWP_MAX_DIAG_TH FORMAT "%3.0"
 /begin AXIS_DESCR COM_AXIS tco_sub _CNV_A_R_LINEAR_____452_CM 6 -48. 142.5 FORMAT "%7.3" AXIS_PTS_REF ldp_tco_sub_id_n_rel_cwp_max /end AXIS_DESCR
/end CHARACTERISTIC
/begin CHARACTERISTIC c_t_n_rel_cwp_max_diag_th "Max. time for CWP speed exceeding threshold before coolant thermostat diagnosis inhibition" VALUE 0xa1003830 _REC_VAL_20_u1 255. _CNV_A_R_LINEAR_____35_CM 0. 255. DISPLAY_IDENTIFIER C_T_N_REL_CWP_MAX_DIAG_TH FORMAT "%3.0" /end CHARACTERISTIC
/begin MEASUREMENT t_n_rel_cwp_max_diag_th "Max. time for CWP speed exceeding threshold before coolant thermostat diagnosis inhibition" UBYTE _CNV_A_R_LINEAR_____35_CM 1 100. 0. 255. DISPLAY_IDENTIFIER T_N_REL_CWP_MAX_DIAG_TH ECU_ADDRESS 0xc0001c7c FORMAT "%3.0" /end MEASUREMENT
/begin MEASUREMENT t_is_ast "\"Idle speed\" activation time since engine start" UWORD _CNV_A_R_LINEAR_____35_CM 1 100. 0. 65535. DISPLAY_IDENTIFIER T_IS_AST ECU_ADDRESS 0xc0001c64 FORMAT "%5.0" /end MEASUREMENT
/begin MEASUREMENT t_load_min_ast "Minimum load time since engine start" UWORD _CNV_A_R_LINEAR_____35_CM 1 100. 0. 65535. DISPLAY_IDENTIFIER T_LOAD_MIN_AST ECU_ADDRESS 0xc0001c66 FORMAT "%5.0" /end MEASUREMENT
/begin MEASUREMENT t_vs_max_ast "Maximum vehicule speed time since engine start" UWORD _CNV_A_R_LINEAR_____35_CM 1 100. 0. 65535. DISPLAY_IDENTIFIER T_VS_MAX_AST ECU_ADDRESS 0xc0001c6e FORMAT "%5.0" /end MEASUREMENT
/begin MEASUREMENT t_vs_min_ast "Minimum vehicule speed time since engine start" UWORD _CNV_A_R_LINEAR_____35_CM 1 100. 0. 65535. DISPLAY_IDENTIFIER T_VS_MIN_AST ECU_ADDRESS 0xc0001c70 FORMAT "%5.0" /end MEASUREMENT
/begin MEASUREMENT ratio_t_vs_max_ast "\"Maximum vehicle speed \" time in percent since engine start" UBYTE _CNV_A_R_LINEAR_____5_CM 1 100. 0. 99.609375 DISPLAY_IDENTIFIER RATIO_T_VS_MAX_AST ECU_ADDRESS 0xd0002e31 FORMAT "%9.6" /end MEASUREMENT
/begin MEASUREMENT ratio_t_vs_min_ast "\"Minimum vehicle speed \" time in percent since engine start" UBYTE _CNV_A_R_LINEAR_____5_CM 1 100. 0. 99.609375 DISPLAY_IDENTIFIER RATIO_T_VS_MIN_AST ECU_ADDRESS 0xd0002e32 FORMAT "%9.6" /end MEASUREMENT
/begin MEASUREMENT ratio_t_load_min_ast "\"Minimum load\" time in percent since engine start" UBYTE _CNV_A_R_LINEAR_____5_CM 1 100. 0. 99.609375 DISPLAY_IDENTIFIER RATIO_T_LOAD_MIN_AST ECU_ADDRESS 0xd0002e2f FORMAT "%9.6" /end MEASUREMENT
/begin MEASUREMENT ratio_t_puc_ast "\"Trailing throttle fuel cut-off\" activation time in percent since engine start" UBYTE _CNV_A_R_LINEAR_____5_CM 1 100. 0. 99.609375 DISPLAY_IDENTIFIER RATIO_T_PUC_AST ECU_ADDRESS 0xd0002e30 FORMAT "%9.6" /end MEASUREMENT
/begin MEASUREMENT ratio_t_is_ast "\"Idle speed\" activation time in percent since engine start" UBYTE _CNV_A_R_LINEAR_____5_CM 1 100. 0. 99.609375 DISPLAY_IDENTIFIER RATIO_T_IS_AST ECU_ADDRESS 0xd0002e2e FORMAT "%9.6" /end MEASUREMENT
/begin MEASUREMENT t_puc_ast "\"Trailing throttle fuel cut-off\" activation time since engine start" UWORD _CNV_A_R_LINEAR_____35_CM 1 100. 0. 65535. DISPLAY_IDENTIFIER T_PUC_AST ECU_ADDRESS 0xc0001c6a FORMAT "%5.0" /end MEASUREMENT
/begin MEASUREMENT t_diag_ast "Time after engine start for diagnosis functions" UWORD _CNV_A_R_LINEAR_____35_CM 1 100. 0. 65535. DISPLAY_IDENTIFIER T_DIAG_AST ECU_ADDRESS 0xd00025ea FORMAT "%5.0" /end MEASUREMENT
/begin AXIS_PTS ldp_tam_ip_maf_kgh_load_min_ast "" 0xa10035a0 tam _REC_AXS_20_u1 190.5 _CNV_A_R_LINEAR_____16_CM 4 -48. 142.5 FORMAT "%6.2" /end AXIS_PTS
/begin CHARACTERISTIC ip_maf_kgh_load_min_ast "Ambient temperature dependent minimum engine load threshold for \"low load\" period calculation after start" CURVE 0xa1003704 _REC_CUR_20_u2_u1 307.1953125 _CNV_A_R_LINEAR_____207_CM 0. 2047.96875 DISPLAY_IDENTIFIER IP_MAF_KGH_LOAD_MIN_AST FORMAT "%10.5"
 /begin AXIS_DESCR COM_AXIS tam _CNV_A_R_LINEAR_____16_CM 4 -48. 142.5 FORMAT "%6.2" AXIS_PTS_REF ldp_tam_ip_maf_kgh_load_min_ast /end AXIS_DESCR
/end CHARACTERISTIC
/begin CHARACTERISTIC c_vs_thd_vs_max_ast "Maximum vehicule speed threshold for high VS period calculation" VALUE 0xa1003859 _REC_VAL_20_u1 255. _CNV_A_R_LINEAR_____6_CM 0. 255. DISPLAY_IDENTIFIER C_VS_THD_VS_MAX_AST FORMAT "%3.0" /end CHARACTERISTIC
/begin CHARACTERISTIC c_vs_thd_vs_min_ast "Minimum vehicule speed threshold for low VS period calculation" VALUE 0xa100385a _REC_VAL_20_u1 255. _CNV_A_R_LINEAR_____6_CM 0. 255. DISPLAY_IDENTIFIER C_VS_THD_VS_MIN_AST FORMAT "%3.0" /end CHARACTERISTIC
/begin MEASUREMENT lv_cdn_ena_ratio_t_ast "boolean for ratio time after engine start enable condition" UBYTE _CNV_S_2_RANGE__0___1_CM 1 100. 0. 1. DISPLAY_IDENTIFIER LV_CDN_ENA_RATIO_T_AST ECU_ADDRESS 0xc0001c90 BIT_MASK 0x1 /end MEASUREMENT
/begin CHARACTERISTIC c_t_dly_tco_sub_is_2 "Delay time after idle speed to activate the coolant temperature substitute value calculation" VALUE 0xa1003822 _REC_VAL_20_u2 65535. _CNV_A_R_LINEAR_____35_CM 0. 65535. DISPLAY_IDENTIFIER C_T_DLY_TCO_SUB_IS_2 FORMAT "%5.0" /end CHARACTERISTIC
/begin CHARACTERISTIC c_t_dly_tco_sub_puc "Delay time after pull fuel cutoff to activate the coolant temperature substitute value calculation" VALUE 0xa1003824 _REC_VAL_20_u2 65535. _CNV_A_R_LINEAR_____35_CM 0. 65535. DISPLAY_IDENTIFIER C_T_DLY_TCO_SUB_PUC FORMAT "%5.0" /end CHARACTERISTIC
/begin CHARACTERISTIC ip_tco_sub_inc "Increment value for the coolant temperature substitute value calculation" MAP 0xa1003794 _REC_MAP_20_u2_u2_u1 38.1 _CNV_A_R_LACO_LINEA_378_CM 0. 190.5 DISPLAY_IDENTIFIER IP_TCO_SUB_INC FORMAT "%7.3"
 /begin AXIS_DESCR COM_AXIS maf_kgh _CNV_A_R_LINEAR_____207_CM 6 0. 2047.96875 FORMAT "%10.5" AXIS_PTS_REF ldp_maf_kgh_ip_tco_sub_inc /end AXIS_DESCR
 /begin AXIS_DESCR COM_AXIS tam _CNV_A_R_LINEAR_____16_CM 6 -48. 142.5 FORMAT "%6.2" AXIS_PTS_REF ldp_tam_ip_tco_sub_inc /end AXIS_DESCR
/end CHARACTERISTIC
/begin MEASUREMENT lv_cdn_ena_tco_sub "Boolean for coolant temperature substitute model initialisation condition" UBYTE _CNV_S_2_RANGE__0___1_CM 1 100. 0. 1. DISPLAY_IDENTIFIER LV_CDN_ENA_TCO_SUB ECU_ADDRESS 0xc0001c93 BIT_MASK 0x1 /end MEASUREMENT
/begin MEASUREMENT tco_sub "Coolant temperature substitute value" UWORD _CNV_A_R_LINEAR_____452_CM 1 100. -48. 142.5 DISPLAY_IDENTIFIER TCO_SUB ECU_ADDRESS 0xd00025ec FORMAT "%7.3" /end MEASUREMENT
/begin MEASUREMENT tco_sub_inc "Coolant temperature substitute increment value" UWORD _CNV_A_R_LINEAR_____452_CM 1 100. -48. 142.5 DISPLAY_IDENTIFIER TCO_SUB_INC ECU_ADDRESS 0xc0001c72 FORMAT "%7.3" /end MEASUREMENT
/begin AXIS_PTS ldp_maf_kgh_ip_tco_sub_inc "" 0xa1003584 maf_kgh _REC_AXS_20_u2 2047.96875 _CNV_A_R_LINEAR_____207_CM 6 0. 2047.96875 FORMAT "%10.5" /end AXIS_PTS
/begin AXIS_PTS ldp_maf_kgh_ip_fac_tco_sub_inc "" 0xa1003574 maf_kgh _REC_AXS_20_u2 2047.96875 _CNV_A_R_LINEAR_____207_CM 6 0. 2047.96875 FORMAT "%10.5" /end AXIS_PTS
/begin CHARACTERISTIC ip_tco_sub_dec "Decrement value for the coolant temperature substitute value calculation" MAP 0xa1003744 _REC_MAP_20_u2_u2_u1 38.1 _CNV_A_R_LACO_LINEA_378_CM 0. 190.5 DISPLAY_IDENTIFIER IP_TCO_SUB_DEC FORMAT "%7.3"
 /begin AXIS_DESCR COM_AXIS tco_sub _CNV_A_R_LINEAR_____452_CM 6 -48. 142.5 FORMAT "%7.3" AXIS_PTS_REF ldp_tco_sub_ip_tco_sub_dec /end AXIS_DESCR
 /begin AXIS_DESCR COM_AXIS tam _CNV_A_R_LINEAR_____16_CM 6 -48. 142.5 FORMAT "%6.2" AXIS_PTS_REF ldp_tam_ip_tco_sub_dec /end AXIS_DESCR
/end CHARACTERISTIC
/begin AXIS_PTS ldp_tco_sub_ip_fac_tco_sub_inc "" 0xa10035d8 tco_sub _REC_AXS_20_u2 190.5 _CNV_A_R_LINEAR_____452_CM 6 -48. 142.5 FORMAT "%7.3" /end AXIS_PTS
/begin AXIS_PTS ldp_tam_ip_tco_sub_inc "" 0xa10035ae tam _REC_AXS_20_u1 190.5 _CNV_A_R_LINEAR_____16_CM 6 -48. 142.5 FORMAT "%6.2" /end AXIS_PTS
/begin AXIS_PTS ldp_tam_ip_tco_sub_dec "" 0xa10035a6 tam _REC_AXS_20_u1 190.5 _CNV_A_R_LINEAR_____16_CM 6 -48. 142.5 FORMAT "%6.2" /end AXIS_PTS
/begin CHARACTERISTIC c_fac_tco_sub_cor "Multiple Coolant temperature substitute value correction factor" VALUE 0xa1003802 _REC_VAL_20_u1 1.9921875 _CNV_A_R_LINEAR_____100_CM 0. 1.9921875 DISPLAY_IDENTIFIER C_FAC_TCO_SUB_COR FORMAT "%8.6" /end CHARACTERISTIC
/begin MEASUREMENT fac_tco_sub_cor_n_rel_cwp "Coolant temperature substitute value correction factor for CWP functionality" UWORD _CNV_A_R_LINEAR_____27_CM 1 100. 0. 255.99609375 DISPLAY_IDENTIFIER FAC_TCO_SUB_COR_N_REL_CWP ECU_ADDRESS 0xc0001c52 FORMAT "%10.6" /end MEASUREMENT
/begin MEASUREMENT fac_tco_sub_cor "Coolant temperature substitute value correction factor" UBYTE _CNV_A_R_LINEAR_____100_CM 1 100. 0. 1.9921875 DISPLAY_IDENTIFIER FAC_TCO_SUB_COR ECU_ADDRESS 0xc0001c77 FORMAT "%5.3" /end MEASUREMENT
/begin MEASUREMENT fac_tco_sub_cor_state_coc "Coolant temperature substitute value correction factor after warm-up" UBYTE _CNV_A_R_LINEAR_____453_CM 1 100. 0. 51. DISPLAY_IDENTIFIER FAC_TCO_SUB_COR_STATE_COC ECU_ADDRESS 0xc0001c78 FORMAT "%4.1" /end MEASUREMENT
/begin MEASUREMENT t_dly_tco_sub "Delay time counter for coolant temperature substitute value calculation during pull fuel cutoff or idle speed" UWORD _CNV_A_R_LINEAR_____35_CM 1 100. 0. 65535. DISPLAY_IDENTIFIER T_DLY_TCO_SUB ECU_ADDRESS 0xc0001c5e FORMAT "%5.0" /end MEASUREMENT
/begin MEASUREMENT t_dly_tco_sub_cor_state_coc "Delay time counter for coolant temperature substitute value calculation after warm-up" UWORD _CNV_A_R_LINEAR_____35_CM 1 100. 0. 65535. DISPLAY_IDENTIFIER T_DLY_TCO_SUB_COR_STATE_COC ECU_ADDRESS 0xc0001c60 FORMAT "%5.0" /end MEASUREMENT
/begin CHARACTERISTIC ip_fac_tco_sub_inc "Increment factor for the coolant temperature substitute value calculation" MAP 0xa10036e0 _REC_MAP_20_u1_u2_u2 0.19921875 _CNV_A_R_LINEAR_____27_CM 0. 0.99609375 DISPLAY_IDENTIFIER IP_FAC_TCO_SUB_INC FORMAT "%5.3"
 /begin AXIS_DESCR COM_AXIS maf_kgh _CNV_A_R_LINEAR_____207_CM 6 0. 2047.96875 FORMAT "%10.5" AXIS_PTS_REF ldp_maf_kgh_ip_fac_tco_sub_inc /end AXIS_DESCR
 /begin AXIS_DESCR COM_AXIS tco_sub _CNV_A_R_LINEAR_____452_CM 6 -48. 142.5 FORMAT "%7.3" AXIS_PTS_REF ldp_tco_sub_ip_fac_tco_sub_inc /end AXIS_DESCR
/end CHARACTERISTIC
/begin AXIS_PTS ldp_tco_sub_ip_tco_sub_dec "" 0xa10035e8 tco_sub _REC_AXS_20_u2 190.5 _CNV_A_R_LINEAR_____452_CM 6 -48. 142.5 FORMAT "%7.3" /end AXIS_PTS
/begin AXIS_PTS ldp_n_rel_cwp_ip_fac_tco_sub "" 0xa1003592 n_rel_cwp _REC_AXS_20_u1 255. _CNV_A_R_LINEAR_____0_CM 4 0. 255. FORMAT "%3.0" /end AXIS_PTS
/begin CHARACTERISTIC ip_fac_tco_sub_cor_n_rel_cwp "Coolant temperature substitute value correction factor dependend on CWP speed" CURVE 0xa10036dc _REC_CUR_20_u1_u1 4.98046 _CNV_A_R_LINEAR_____454_CM 0. 4.98046 DISPLAY_IDENTIFIER IP_FAC_TCO_SUB_COR_N_REL_CWP FORMAT "%5.3"
 /begin AXIS_DESCR COM_AXIS n_rel_cwp _CNV_A_R_LINEAR_____0_CM 4 0. 255. FORMAT "%3.0" AXIS_PTS_REF ldp_n_rel_cwp_ip_fac_tco_sub /end AXIS_DESCR
/end CHARACTERISTIC
/begin CHARACTERISTIC c_t_dly_tco_sub_is_1 "Delay time after idle speed to stop the coolant temperature substitute value calculation" VALUE 0xa1003820 _REC_VAL_20_u2 65535. _CNV_A_R_LINEAR_____35_CM 0. 65535. DISPLAY_IDENTIFIER C_T_DLY_TCO_SUB_IS_1 FORMAT "%5.0" /end CHARACTERISTIC
/begin CHARACTERISTIC c_fac_tco_sub_cor_state_coc "Coolant temperature substitute value calculation factor after warm-up" VALUE 0xa1003803 _REC_VAL_20_u1 51. _CNV_A_R_LINEAR_____453_CM 0. 51. DISPLAY_IDENTIFIER C_FAC_TCO_SUB_COR_STATE_COC FORMAT "%4.1" /end CHARACTERISTIC
/begin CHARACTERISTIC c_t_dly_tco_sub_cor_state_coc "Delay time after warm-up for coolant temperature substitute value calculation factor" VALUE 0xa100381e _REC_VAL_20_u2 65535. _CNV_A_R_LINEAR_____35_CM 0. 65535. DISPLAY_IDENTIFIER C_T_DLY_TCO_SUB_COR_STATE_COC FORMAT "%5.0" /end CHARACTERISTIC
/begin CHARACTERISTIC c_t_dly_tco_sub_st_cwp_off "Delay time after start to activate the coolant temperature substitute value calculation for stopped CWP" VALUE 0xa1003826 _REC_VAL_20_u2 6553.5 _CNV_A_R_LINEAR_____4_CM 0. 6553.5 DISPLAY_IDENTIFIER C_T_DLY_TCO_SUB_ST_CWP_OFF FORMAT "%6.1" /end CHARACTERISTIC
/begin CHARACTERISTIC c_t_dly_tco_sub_st_cwp_on "Delay time after start to activate the coolant temperature substitute value calculation for running CWP" VALUE 0xa1003828 _REC_VAL_20_u2 6553.5 _CNV_A_R_LINEAR_____4_CM 0. 6553.5 DISPLAY_IDENTIFIER C_T_DLY_TCO_SUB_ST_CWP_ON FORMAT "%6.1" /end CHARACTERISTIC
/begin CHARACTERISTIC c_n_rel_cwp_thd_coc "CWP speed threshold for detecting running or stopped CWP" VALUE 0xa1003810 _REC_VAL_20_u1 255. _CNV_A_R_LINEAR_____0_CM 0. 255. DISPLAY_IDENTIFIER C_N_REL_CWP_THD_COC FORMAT "%3.0" /end CHARACTERISTIC
/begin MEASUREMENT t_dly_thd_tco_sub_st "Delay time threshold for coolant temperature substitute value depending on CWP speed" UWORD _CNV_A_R_LINEAR_____4_CM 1 100. 0. 6553.5 DISPLAY_IDENTIFIER T_DLY_THD_TCO_SUB_ST ECU_ADDRESS 0xc0001c62 FORMAT "%6.1" /end MEASUREMENT
/begin CHARACTERISTIC c_abc_max_ecf_el[0] "Debounce counter maximum" VALUE 0xa10037e4 _REC_VAL_20_u1 255. _CNV_A_R_LINEAR_____0_CM 0. 255. DISPLAY_IDENTIFIER C_ABC_MAX_ECF_EL[0] FORMAT "%3.0" /end CHARACTERISTIC
/begin MEASUREMENT err_diag_ecfpwm[0] "Raw value of error symptom for ECFPWM detected on interface ECU and ECF control unit" UBYTE _CNV_A_R_LINEAR_____0_CM 1 100. 0. 7. DISPLAY_IDENTIFIER ERR_DIAG_ECFPWM[0] ECU_ADDRESS 0xd0002e2b FORMAT "%1.0" /end MEASUREMENT
/begin MEASUREMENT lv_ecfpwm_fb_vld[0] "If lv_ecfpwm_fb_vld = 1 the failure number err_ecfpwm_fb(01h) is valid" UBYTE _CNV_S_2_RANGE__0___1_CM 1 100. 0. 1. DISPLAY_IDENTIFIER LV_ECFPWM_FB_VLD[0] ECU_ADDRESS 0xd0002e42 BIT_MASK 0x1 /end MEASUREMENT
/begin MEASUREMENT lv_err_ecfpwm_fb_1 "Error currently present, indicated by failure feedback from ECF control unit" UBYTE _CNV_S_2_RANGE__0___1_CM 1 100. 0. 1. DISPLAY_IDENTIFIER LV_ERR_ECFPWM_FB_1 ECU_ADDRESS 0xd00033b9 BIT_MASK 0x1 /end MEASUREMENT
/begin MEASUREMENT t_act_ecfpwm_fb[0] "Time with ecfpwm > c_ecfpwm_min_fb necessary to have failure feedback from ECF control unit" UWORD _CNV_A_R_LINEAR_____4_CM 1 100. 0. 6553.5 DISPLAY_IDENTIFIER T_ACT_ECFPWM_FB[0] ECU_ADDRESS 0xc0001c58 FORMAT "%5.1" /end MEASUREMENT
/begin MEASUREMENT t_ecfpwm_fb[0] "Timer counting tlow for failure feedback recognition" UBYTE _CNV_A_R_LINEAR_____4_CM 1 100. 0. 25.5 DISPLAY_IDENTIFIER T_ECFPWM_FB[0] ECU_ADDRESS 0xc0001c79 FORMAT "%4.1" /end MEASUREMENT
/begin CHARACTERISTIC c_abc_ecfpwm_fb[0] "If c_abc_ecfpwm_fb times sequentially a failure feedback for the same failure is detected, the failure lv_err_ecfpwm_fb is set" VALUE 0xa10037dc _REC_VAL_20_u1 254. _CNV_A_R_LINEAR_____0_CM 1. 255. DISPLAY_IDENTIFIER C_ABC_ECFPWM_FB[0] FORMAT "%3.0" /end CHARACTERISTIC
/begin CHARACTERISTIC c_ecfpwm_diag_max[0] "Maximum duty cycle threshold of ECF EL for electrical ECF diagnosis" VALUE 0xa10037f0 _REC_VAL_20_u1 99.609375 _CNV_A_R_LINEAR_____5_CM 0. 99.609375 DISPLAY_IDENTIFIER C_ECFPWM_DIAG_MAX[0] /end CHARACTERISTIC
/begin CHARACTERISTIC c_ecfpwm_diag_min[0] "Minimum duty cycle threshold of ECF EL for electrical ECF diagnosis" VALUE 0xa10037f1 _REC_VAL_20_u1 99.609375 _CNV_A_R_LINEAR_____5_CM 0. 99.609375 DISPLAY_IDENTIFIER C_ECFPWM_DIAG_MIN[0] /end CHARACTERISTIC
/begin CHARACTERISTIC c_ecfpwm_min_fb[0] "Minimum duty cycle of ecfpwm to have a failure feedback from ECF control unit" VALUE 0xa10037f4 _REC_VAL_20_u1 99.609375 _CNV_A_R_LINEAR_____5_CM 0. 99.609375 DISPLAY_IDENTIFIER C_ECFPWM_MIN_FB[0] /end CHARACTERISTIC
/begin CHARACTERISTIC c_t_act_ecfpwm_fb[0] "Minimum time necessary to have failure feedback from ECF control unit" VALUE 0xa1003816 _REC_VAL_20_u2 6553.5 _CNV_A_R_LINEAR_____4_CM 0. 6553.5 DISPLAY_IDENTIFIER C_T_ACT_ECFPWM_FB[0] FORMAT "%5.1" /end CHARACTERISTIC
/begin CHARACTERISTIC c_t_ecfpwm_fb_max[0] "Time range necessary for identification of failure feedback maximal value" VALUE 0xa100382a _REC_VAL_20_u1 25.5 _CNV_A_R_LINEAR_____4_CM 0. 25.5 DISPLAY_IDENTIFIER C_T_ECFPWM_FB_MAX[0] FORMAT "%4.1" /end CHARACTERISTIC
/begin CHARACTERISTIC c_t_ecfpwm_fb_min[0] "Time range necessary for identification of failure feedback minimal value" VALUE 0xa100382b _REC_VAL_20_u1 25.5 _CNV_A_R_LINEAR_____4_CM 0. 25.5 DISPLAY_IDENTIFIER C_T_ECFPWM_FB_MIN[0] FORMAT "%4.1" /end CHARACTERISTIC
/begin MEASUREMENT lv_err_ecf_el_1 "Boolean for error currently present on ECF command signal" UBYTE _CNV_S_2_RANGE__0___1_CM 1 100. 0. 1. DISPLAY_IDENTIFIER LV_ERR_ECF_EL_1 ECU_ADDRESS 0xd00033b8 BIT_MASK 0x1 /end MEASUREMENT
/begin CHARACTERISTIC c_abc_inc_ecf_el[0] "Debounce counter increment" VALUE 0xa10037dd _REC_VAL_20_u1 255. _CNV_A_R_LINEAR_____0_CM 0. 255. DISPLAY_IDENTIFIER C_ABC_INC_ECF_EL[0] FORMAT "%3.0" /end CHARACTERISTIC
/begin MEASUREMENT err_ecfpwm_fb[0] "The failure status of the failure feedback coming from the ECF control unit" UBYTE _CNV_A_R_LINEAR_____0_CM 1 100. 0. 255. DISPLAY_IDENTIFIER ERR_ECFPWM_FB[0] ECU_ADDRESS 0xd0002e2c FORMAT "%3.0" /end MEASUREMENT
/begin MEASUREMENT abc_ecfpwm_fb[0] "The failure status of the failure feedback coming from the ECF control unit" UBYTE _CNV_A_R_LINEAR_____0_CM 1 100. 0. 255. DISPLAY_IDENTIFIER ABC_ECFPWM_FB[0] ECU_ADDRESS 0xc0001c74 FORMAT "%3.0" /end MEASUREMENT
/begin MEASUREMENT cdn_diag_ecf_el[0] " Diagnosis condition for each symptom of ECF_EL " UBYTE _CNV_A_R_LINEAR_____0_CM 1 100. 0. 7. DISPLAY_IDENTIFIER CDN_DIAG_ECF_EL[0] ECU_ADDRESS 0xc0001c75 FORMAT "%1.0" /end MEASUREMENT
/begin MEASUREMENT cdn_diag_ecfpwm_bas[0] " Diagnosis condition for each symptom of ECF_EL " UBYTE _CNV_A_R_LINEAR_____0_CM 1 100. 0. 7. DISPLAY_IDENTIFIER CDN_DIAG_ECFPWM_BAS[0] ECU_ADDRESS 0xd0002e28 FORMAT "%1.0" /end MEASUREMENT
/begin CHARACTERISTIC c_tam_min_ecfpwm_fb_diag_th "Minimum TAM for enabling ECFPWM_FB-diagnosis" VALUE 0xa1003835 _REC_VAL_20_u1 190.5 _CNV_A_R_LINEAR_____16_CM -48. 142.5 DISPLAY_IDENTIFIER C_TAM_MIN_ECFPWM_FB_DIAG_TH FORMAT "%6.2" /end CHARACTERISTIC
/begin MEASUREMENT lv_err_ect "Boolean for electronic controlled thermostat error" UBYTE _CNV_S_2_RANGE__0___1_CM 1 100. 0. 1. DISPLAY_IDENTIFIER LV_ERR_ECT ECU_ADDRESS 0xd0002e4b BIT_MASK 0x1 /end MEASUREMENT
/begin CHARACTERISTIC c_abc_inc_ect_el "Antibounce counter increment" VALUE 0xa10037de _REC_VAL_20_u1 255. _CNV_A_R_LINEAR_____0_CM 0. 255. DISPLAY_IDENTIFIER C_ABC_INC_ECT_EL FORMAT "%3.0" /end CHARACTERISTIC
/begin CHARACTERISTIC c_abc_max_ect_el "Maximum value for antibounce counter" VALUE 0xa10037e5 _REC_VAL_20_u1 254. _CNV_A_R_LINEAR_____0_CM 1. 255. DISPLAY_IDENTIFIER C_ABC_MAX_ECT_EL FORMAT "%3.0" /end CHARACTERISTIC
/begin CHARACTERISTIC c_ect_el_pwm_diag_max_scg "Maximum  threshold for SCG diagnosis window" VALUE 0xa10037f7 _REC_VAL_20_u1 99.609375 _CNV_A_R_LINEAR_____5_CM 0. 99.609375 DISPLAY_IDENTIFIER C_ECT_EL_PWM_DIAG_MAX_SCG FORMAT "%9.6" /end CHARACTERISTIC
/begin CHARACTERISTIC c_ect_el_pwm_diag_min_scp "Minimum threshold for SCP diagnosis window" VALUE 0xa10037f9 _REC_VAL_20_u1 99.609375 _CNV_A_R_LINEAR_____5_CM 0. 99.609375 DISPLAY_IDENTIFIER C_ECT_EL_PWM_DIAG_MIN_SCP FORMAT "%9.6" /end CHARACTERISTIC
/begin CHARACTERISTIC c_ect_el_pwm_diag_min_oc "Minimum threshold for OC diagnosis window" VALUE 0xa10037f8 _REC_VAL_20_u1 99.609375 _CNV_A_R_LINEAR_____5_CM 0. 99.609375 DISPLAY_IDENTIFIER C_ECT_EL_PWM_DIAG_MIN_OC FORMAT "%9.6" /end CHARACTERISTIC
/begin MEASUREMENT lv_inh_diag_ect_el "flag for ect electronical  signal range diagnosis inhibition" UBYTE _CNV_S_2_RANGE__0___1_CM 1 100. 0. 1. DISPLAY_IDENTIFIER LV_INH_DIAG_ECT_EL ECU_ADDRESS 0xd0002e50 BIT_MASK 0x1 /end MEASUREMENT
/begin MEASUREMENT tco_mes_min_diag_tco_stuck "Measured coolant temperature minimum value for coolant temperature stuck signal diagnosis" UBYTE _CNV_A_R_LINEAR_____16_CM 1 100. -48. 142.5 DISPLAY_IDENTIFIER TCO_MES_MIN_DIAG_TCO_STUCK ECU_ADDRESS 0xc0001c85 FORMAT "%6.2" /end MEASUREMENT
/begin MEASUREMENT tco_sub_dif_diag_tco_stuck "Difference of substitute coolant temperature values for coolant temperature stuck signal diagnosis" UBYTE _CNV_A_R_LINEAR_____24_CM 1 100. 0. 190.5 DISPLAY_IDENTIFIER TCO_SUB_DIF_DIAG_TCO_STUCK ECU_ADDRESS 0xc0001c86 FORMAT "%6.2" /end MEASUREMENT
/begin MEASUREMENT tco_sub_max_diag_tco_stuck "Substitute coolant temperature maximum value for coolant temperature stuck signal diagnosis" UBYTE _CNV_A_R_LINEAR_____16_CM 1 100. -48. 142.5 DISPLAY_IDENTIFIER TCO_SUB_MAX_DIAG_TCO_STUCK ECU_ADDRESS 0xc0001c87 FORMAT "%6.2" /end MEASUREMENT
/begin MEASUREMENT tco_sub_min_diag_tco_stuck "Substitute coolant temperature minimum value for coolant temperature stuck signal diagnosis" UBYTE _CNV_A_R_LINEAR_____16_CM 1 100. -48. 142.5 DISPLAY_IDENTIFIER TCO_SUB_MIN_DIAG_TCO_STUCK ECU_ADDRESS 0xc0001c88 FORMAT "%6.2" /end MEASUREMENT
/begin CHARACTERISTIC ip_tco_sub_dif_diag_tco_stuck "Minimum increase of the TCO_SUB value for the coolant temperature stuck signal diagnosis" CURVE 0xa100378c _REC_CUR_20_u1_u1 190.5 _CNV_A_R_LINEAR_____24_CM 0. 190.5 DISPLAY_IDENTIFIER IP_TCO_SUB_DIF_DIAG_TCO_STUCK FORMAT "%6.2"
 /begin AXIS_DESCR COM_AXIS tco_st _CNV_A_R_LINEAR_____16_CM 6 -48. 142.5 FORMAT "%6.2" AXIS_PTS_REF ldpm_tco_st_1_ente /end AXIS_DESCR
/end CHARACTERISTIC
/begin MEASUREMENT lv_err_tco_stuck "TCO stuck signal detected" UBYTE _CNV_S_2_RANGE__0___1_CM 1 100. 0. 1. DISPLAY_IDENTIFIER LV_ERR_TCO_STUCK ECU_ADDRESS 0xd00033b2 BIT_MASK 0x1 /end MEASUREMENT
/begin MEASUREMENT tco_mes_max_diag_tco_stuck "Measured coolant temperature maximum value for coolant temperature stuck signal diagnosis" UBYTE _CNV_A_R_LINEAR_____16_CM 1 100. -48. 142.5 DISPLAY_IDENTIFIER TCO_MES_MAX_DIAG_TCO_STUCK ECU_ADDRESS 0xc0001c84 FORMAT "%6.2" /end MEASUREMENT
/begin MEASUREMENT tco_mes_dif_diag_tco_stuck "Difference of measured coolant temperature values for coolant temperature stuck signal diagnosis" UBYTE _CNV_A_R_LINEAR_____24_CM 1 100. 0. 190.5 DISPLAY_IDENTIFIER TCO_MES_DIF_DIAG_TCO_STUCK ECU_ADDRESS 0xc0001c83 FORMAT "%6.2" /end MEASUREMENT
/begin CHARACTERISTIC ip_tco_mes_dif_diag_tco_stuck "Minimum increase of the TCO value for the coolant temperature stuck signal diagnosis" CURVE 0xa100373c _REC_CUR_20_u1_u1 190.5 _CNV_A_R_LINEAR_____24_CM 0. 190.5 DISPLAY_IDENTIFIER IP_TCO_MES_DIF_DIAG_TCO_STUCK FORMAT "%6.2"
 /begin AXIS_DESCR COM_AXIS tco_st _CNV_A_R_LINEAR_____16_CM 6 -48. 142.5 FORMAT "%6.2" AXIS_PTS_REF ldpm_tco_st_1_ente /end AXIS_DESCR
/end CHARACTERISTIC
/begin MEASUREMENT lv_err_tco_plaus "Boolean for coolant temperature plausibility error" UBYTE _CNV_S_2_RANGE__0___1_CM 1 100. 0. 1. DISPLAY_IDENTIFIER LV_ERR_TCO_PLAUS ECU_ADDRESS 0xd00033b3 BIT_MASK 0x1 /end MEASUREMENT
/begin MEASUREMENT t_min_diag_tco_plaus "Minimum time to activate the coolant temperature plausibility diagnosis" UWORD _CNV_A_R_LINEAR_____35_CM 1 100. 0. 65535. DISPLAY_IDENTIFIER T_MIN_DIAG_TCO_PLAUS ECU_ADDRESS 0xc0001c68 FORMAT "%5.0" /end MEASUREMENT
/begin CHARACTERISTIC id_tco_min_diag_tco_plaus "Minimum coolant temperature threshold for coolant temperature plausibility diagnosis" MAP 0xa1003670 _REC_MAP_20_u1_u1_u1 190.5 _CNV_A_R_LINEAR_____16_CM -48. 142.5 DISPLAY_IDENTIFIER ID_TCO_MIN_DIAG_TCO_PLAUS FORMAT "%6.2"
 /begin AXIS_DESCR COM_AXIS tco_st _CNV_A_R_LINEAR_____16_CM 6 -48. 142.5 FORMAT "%6.2" AXIS_PTS_REF ldp_tco_st_id_tco_min_diag_plaus /end AXIS_DESCR
 /begin AXIS_DESCR COM_AXIS ratio_t_is_ast _CNV_A_R_LINEAR_____5_CM 6 0. 99.609375 FORMAT "%9.6" AXIS_PTS_REF ldp_ratio_t_is_ast_id_tco_diag /end AXIS_DESCR
/end CHARACTERISTIC
/begin AXIS_PTS ldp_tco_st_id_tco_min_diag_plaus "" 0xa10035b6 tco_st _REC_AXS_20_u1 190.5 _CNV_A_R_LINEAR_____16_CM 6 -48. 142.5 FORMAT "%6.2" /end AXIS_PTS
/begin CHARACTERISTIC id_t_min_diag_tco_plaus "Minimum time for coolant temperature plausibility diagnosis activation" CURVE 0xa1003664 _REC_CUR_20_u2_u1 65534. _CNV_A_R_LINEAR_____35_CM 1. 65535. DISPLAY_IDENTIFIER ID_T_MIN_DIAG_TCO_PLAUS FORMAT "%6.1"
 /begin AXIS_DESCR COM_AXIS tia_thr_st _CNV_A_R_LINEAR_____16_CM 6 -48. 142.5 FORMAT "%6.2" AXIS_PTS_REF ldp_tia_thr_st_id_t_tco_plaus /end AXIS_DESCR
/end CHARACTERISTIC
/begin AXIS_PTS ldp_tia_thr_st_id_t_tco_plaus "" 0xa10035fe tia_thr_st _REC_AXS_20_u1 190.5 _CNV_A_R_LINEAR_____16_CM 6 -48. 142.5 FORMAT "%6.2" /end AXIS_PTS
/begin MEASUREMENT t_ast_diag_tco_plaus "Time after start of the performed coolant temperature plausibility diagnosis" UWORD _CNV_A_R_LINEAR_____35_CM 1 100. 0. 65535. DISPLAY_IDENTIFIER T_AST_DIAG_TCO_PLAUS ECU_ADDRESS 0xc0001c5a FORMAT "%5.0" /end MEASUREMENT
/begin MEASUREMENT lv_end_diag_rbm_tco_plaus "Boolean for end of coolant temperature plausibility diagnosis for RBM" UBYTE _CNV_S_2_RANGE__0___1_CM 1 100. 0. 1. DISPLAY_IDENTIFIER LV_END_DIAG_RBM_TCO_PLAUS ECU_ADDRESS 0xd0002e44 BIT_MASK 0x1 /end MEASUREMENT
/begin AXIS_PTS ldp_ratio_t_is_ast_id_tco_diag "" 0xa1003598 ratio_t_is_ast _REC_AXS_20_u1 99.609375 _CNV_A_R_LINEAR_____5_CM 6 0. 99.609375 FORMAT "%9.6" /end AXIS_PTS
/begin MEASUREMENT lv_inh_diag_tco_plaus "TCO plausibility diagnosis inhibition" UBYTE _CNV_S_2_RANGE__0___1_CM 1 100. 0. 1. DISPLAY_IDENTIFIER LV_INH_DIAG_TCO_PLAUS ECU_ADDRESS 0xd0002e59 BIT_MASK 0x1 /end MEASUREMENT
/begin MEASUREMENT lv_inh_diag_rbm_tco_plaus "Boolean for coolant temperature plausibility diagnosis inhibit due to OBD error" UBYTE _CNV_S_2_RANGE__0___1_CM 1 100. 0. 1. DISPLAY_IDENTIFIER LV_INH_DIAG_RBM_TCO_PLAUS ECU_ADDRESS 0xd0002e51 BIT_MASK 0x1 /end MEASUREMENT
/begin MEASUREMENT state_rbm_tco_plaus "Interface of TCO_PLAUS monitor with the Rate-Based Monitoring statistics" UBYTE _CNV_A_R_LINEAR_____0_CM 1 100. 0. 7. DISPLAY_IDENTIFIER STATE_RBM_TCO_PLAUS ECU_ADDRESS 0xd0002e34 FORMAT "%1.0" /end MEASUREMENT
/begin MEASUREMENT lv_err_tco_2_plaus "Boolean for coolant temperature (radiator outlet) plausibility error" UBYTE _CNV_S_2_RANGE__0___1_CM 1 100. 0. 1. DISPLAY_IDENTIFIER LV_ERR_TCO_2_PLAUS ECU_ADDRESS 0xd00033b6 BIT_MASK 0x1 /end MEASUREMENT
/begin MEASUREMENT lv_end_diag_rbm_tco_2_plaus "Boolean for end of coolant temperature (radiator outlet) plausibility diagnosis for RBM" UBYTE _CNV_S_2_RANGE__0___1_CM 1 100. 0. 1. DISPLAY_IDENTIFIER LV_END_DIAG_RBM_TCO_2_PLAUS ECU_ADDRESS 0xd0002e43 BIT_MASK 0x1 /end MEASUREMENT
/begin MEASUREMENT lv_tco_2_plaus_ena "Coolant temperature (radiator outlet) plausibility (long) enabled" UBYTE _CNV_S_2_RANGE__0___1_CM 1 100. 0. 1. DISPLAY_IDENTIFIER LV_TCO_2_PLAUS_ENA ECU_ADDRESS 0xc0001c9e BIT_MASK 0x1 /end MEASUREMENT
/begin MEASUREMENT tco_2_dif_tco_2_plaus "Maximum coolant temperature (radiator outlet) gap in diagnosis window" UBYTE _CNV_A_R_LINEAR_____24_CM 1 100. 0. 190.5 DISPLAY_IDENTIFIER TCO_2_DIF_TCO_2_PLAUS ECU_ADDRESS 0xc0001c7d FORMAT "%6.2" /end MEASUREMENT
/begin MEASUREMENT ctr_dly_tco_2_plaus "Delay counter before coolant temperature (radiator outlet) change is expected" UWORD _CNV_A_R_LINEAR_____0_CM 1 100. 0. 65535. DISPLAY_IDENTIFIER CTR_DLY_TCO_2_PLAUS ECU_ADDRESS 0xc0001c50 FORMAT "%5.0" /end MEASUREMENT
/begin MEASUREMENT t_dly_tco_2_plaus "Coolant temperature (radiator outlet) plausibility diagnosis diagnostic window time" UWORD _CNV_A_R_LINEAR_____35_CM 1 100. 0. 65535. DISPLAY_IDENTIFIER T_DLY_TCO_2_PLAUS ECU_ADDRESS 0xc0001c5c FORMAT "%5.0" /end MEASUREMENT
/begin MEASUREMENT tco_2_plaus_h "Maximum latched coolant temperature (radiator outlet) value " UBYTE _CNV_A_R_LINEAR_____16_CM 1 100. -48. 142.5 DISPLAY_IDENTIFIER TCO_2_PLAUS_H ECU_ADDRESS 0xc0001c7e FORMAT "%6.2" /end MEASUREMENT
/begin MEASUREMENT tco_2_plaus_l "Minimum latched coolant temperature (radiator outlet) value " UBYTE _CNV_A_R_LINEAR_____16_CM 1 100. -48. 142.5 DISPLAY_IDENTIFIER TCO_2_PLAUS_L ECU_ADDRESS 0xc0001c7f FORMAT "%6.2" /end MEASUREMENT
/begin AXIS_PTS ldp_tco_st_ip_ctr_tco_2_plaus "" 0xa10035be tco_st _REC_AXS_20_u1 190.5 _CNV_A_R_LINEAR_____16_CM 6 -48. 142.5 FORMAT "%6.2" /end AXIS_PTS
/begin CHARACTERISTIC c_t_dly_tco_2_plaus "Diagnostic window" VALUE 0xa100381c _REC_VAL_20_u2 65535. _CNV_A_R_LINEAR_____35_CM 0. 65535. DISPLAY_IDENTIFIER C_T_DLY_TCO_2_PLAUS FORMAT "%5.0" /end CHARACTERISTIC
/begin CHARACTERISTIC c_tco_2_dif_min_tco_2_plaus "Min. delta TCO_2 for plausibility" VALUE 0xa1003836 _REC_VAL_20_u1 190.5 _CNV_A_R_LINEAR_____24_CM 0. 190.5 DISPLAY_IDENTIFIER C_TCO_2_DIF_MIN_TCO_2_PLAUS FORMAT "%6.2" /end CHARACTERISTIC
/begin CHARACTERISTIC c_vs_min_tco_2_plaus "Min. vehicle speed needed to open thermostat relief valve" VALUE 0xa1003858 _REC_VAL_20_u1 255. _CNV_A_R_LINEAR_____6_CM 0. 255. DISPLAY_IDENTIFIER C_VS_MIN_TCO_2_PLAUS FORMAT "%3.0" /end CHARACTERISTIC
/begin CHARACTERISTIC c_n_min_tco_2_plaus "Min. engine speed needed to open thermostat relief valve" VALUE 0xa100380c _REC_VAL_20_u2 8160. _CNV_A_R_LINEAR_____13_CM 0. 8160. DISPLAY_IDENTIFIER C_N_MIN_TCO_2_PLAUS FORMAT "%4.0" /end CHARACTERISTIC
/begin CHARACTERISTIC c_tco_min_tco_2_plaus "Opening temperature of coolant thermostat" VALUE 0xa100383f _REC_VAL_20_u1 190.5 _CNV_A_R_LINEAR_____16_CM -48. 142.5 DISPLAY_IDENTIFIER C_TCO_MIN_TCO_2_PLAUS FORMAT "%6.2" /end CHARACTERISTIC
/begin CHARACTERISTIC c_tco_st_max_tco_2_plaus "Max. TCO_ST for TCO_2 plausibility check" VALUE 0xa1003842 _REC_VAL_20_u1 190.5 _CNV_A_R_LINEAR_____16_CM -48. 142.5 DISPLAY_IDENTIFIER C_TCO_ST_MAX_TCO_2_PLAUS FORMAT "%6.2" /end CHARACTERISTIC
/begin CHARACTERISTIC c_tco_st_min_tco_2_plaus "Min. TCO_ST for TCO_2 plausibility check" VALUE 0xa1003844 _REC_VAL_20_u1 190.5 _CNV_A_R_LINEAR_____16_CM -48. 142.5 DISPLAY_IDENTIFIER C_TCO_ST_MIN_TCO_2_PLAUS FORMAT "%6.2" /end CHARACTERISTIC
/begin CHARACTERISTIC c_tia_thr_st_max_tco_2_plaus "Max. TIA_THR_ST for TCO_2 plausibility check" VALUE 0xa100384d _REC_VAL_20_u1 190.5 _CNV_A_R_LINEAR_____16_CM -48. 142.5 DISPLAY_IDENTIFIER C_TIA_THR_ST_MAX_TCO_2_PLAUS FORMAT "%6.2" /end CHARACTERISTIC
/begin CHARACTERISTIC c_tia_thr_st_min_tco_2_plaus "Min. TIA_THR_ST for TCO_2 plausibility check" VALUE 0xa100384e _REC_VAL_20_u1 190.5 _CNV_A_R_LINEAR_____16_CM -48. 142.5 DISPLAY_IDENTIFIER C_TIA_THR_ST_MIN_TCO_2_PLAUS FORMAT "%6.2" /end CHARACTERISTIC
/begin CHARACTERISTIC c_tco_st_thd_tco_2_plaus "Max. TCO_ST for additional rationality check" VALUE 0xa1003845 _REC_VAL_20_u1 190.5 _CNV_A_R_LINEAR_____16_CM -48. 142.5 DISPLAY_IDENTIFIER C_TCO_ST_THD_TCO_2_PLAUS FORMAT "%6.2" /end CHARACTERISTIC
/begin CHARACTERISTIC c_tco_st_dif_min_tco_2_plaus "Min. difference between TCO_ST and TCO_2_ST to diagnose fault at engine start" VALUE 0xa1003840 _REC_VAL_20_u1 191.25 _CNV_A_R_ENTE_LINEA_455_CM -96. 95.25 DISPLAY_IDENTIFIER C_TCO_ST_DIF_MIN_TCO_2_PLAUS FORMAT "%6.2" /end CHARACTERISTIC
/begin CHARACTERISTIC c_ctr_dly_inc_tco_2_plaus "Increment for counter if drop out of diagnostic conditions" VALUE 0xa10037ee _REC_VAL_20_u2 65535. _CNV_A_R_LINEAR_____0_CM 0. 65535. DISPLAY_IDENTIFIER C_CTR_DLY_INC_TCO_2_PLAUS FORMAT "%5.0" /end CHARACTERISTIC
/begin AXIS_PTS ldp_tia_thr_st_ip_ctr_tco_plaus "" 0xa1003606 tia_thr_st _REC_AXS_20_u1 190.5 _CNV_A_R_LINEAR_____16_CM 6 -48. 142.5 FORMAT "%6.2" /end AXIS_PTS
/begin CHARACTERISTIC ip_ctr_dly_tco_2_plaus "Coolant system lag time before change in TCO_2 is expected" MAP 0xa1003694 _REC_MAP_20_u2_u1_u1 65535. _CNV_A_R_LINEAR_____0_CM 0. 65535. DISPLAY_IDENTIFIER IP_CTR_DLY_TCO_2_PLAUS FORMAT "%5.0"
 /begin AXIS_DESCR COM_AXIS tco_st _CNV_A_R_LINEAR_____16_CM 6 -48. 142.5 FORMAT "%6.2" AXIS_PTS_REF ldp_tco_st_ip_ctr_tco_2_plaus /end AXIS_DESCR
 /begin AXIS_DESCR COM_AXIS tia_thr_st _CNV_A_R_LINEAR_____16_CM 6 -48. 142.5 FORMAT "%6.2" AXIS_PTS_REF ldp_tia_thr_st_ip_ctr_tco_plaus /end AXIS_DESCR
/end CHARACTERISTIC
/begin MEASUREMENT state_rbm_tco_2_plaus "Interface of TCO_2 monitor with the Rate-Based Monitoring statistics" UBYTE _CNV_A_R_LINEAR_____0_CM 1 100. 0. 7. DISPLAY_IDENTIFIER STATE_RBM_TCO_2_PLAUS ECU_ADDRESS 0xd0002e33 FORMAT "%1.0" /end MEASUREMENT
/begin MEASUREMENT lv_inh_diag_tco_2_plaus "Boolean for coolant temperature (radiator outlet) signal plausibility diagnosis inhibit" UBYTE _CNV_S_2_RANGE__0___1_CM 1 100. 0. 1. DISPLAY_IDENTIFIER LV_INH_DIAG_TCO_2_PLAUS ECU_ADDRESS 0xd0002e56 BIT_MASK 0x1 /end MEASUREMENT
/begin MEASUREMENT lv_inh_diag_rbm_tco_2_plaus "Boolean for coolant temperature (radiator outlet) signal plausibility diagnosis inhibit due to OBD error" UBYTE _CNV_S_2_RANGE__0___1_CM 1 100. 0. 1. DISPLAY_IDENTIFIER LV_INH_DIAG_RBM_TCO_2_PLAUS ECU_ADDRESS 0xc0001c9c BIT_MASK 0x1 /end MEASUREMENT
/begin MEASUREMENT lv_tco_2_plaus_ena_ext "Boolean for coolant temperature (radiator outlet) signal plausibility diagnosis external enable" UBYTE _CNV_S_2_RANGE__0___1_CM 1 100. 0. 1. DISPLAY_IDENTIFIER LV_TCO_2_PLAUS_ENA_EXT ECU_ADDRESS 0xd0002e5c BIT_MASK 0x1 /end MEASUREMENT
/begin CHARACTERISTIC c_ectpwm_min_tco_2_plaus "Minimum ECTPWM to expect a change in TCO_2" VALUE 0xa1003800 _REC_VAL_20_u2 99.99847412109381 _CNV_A_R_LINEAR_____7_CM 0. 99.99847412109381 DISPLAY_IDENTIFIER C_ECTPWM_MIN_TCO_2_PLAUS /end CHARACTERISTIC
/begin MEASUREMENT tq_loss_ecf "Engine torque losses electric cooling fan" SWORD _CNV_A_R_LINEAR_____30_CM 1 100. -1024. 1023.96875 DISPLAY_IDENTIFIER TQ_LOSS_ECF ECU_ADDRESS 0xd00025ee FORMAT "%6.2" /end MEASUREMENT
/begin CHARACTERISTIC ip_pow_loss_ecf "" CURVE 0xa100370c _REC_CUR_20_u1_u1 -5100. _CNV_A_R_LINEAR_____456_CM 0. -5100. DISPLAY_IDENTIFIER IP_POW_LOSS_ECF FORMAT "%5.0"
 /begin AXIS_DESCR COM_AXIS ecfpwm[0] _CNV_A_R_LINEAR_____5_CM 8 0. 99.609375 FORMAT "%9.6" AXIS_PTS_REF ldp_ecfpwm /end AXIS_DESCR
/end CHARACTERISTIC
/begin CHARACTERISTIC c_lgrd_tq_loss_ecf "ECF-torque loss limitation gradient" VALUE 0xa1003804 _REC_VAL_20_u2 1023.96875 _CNV_A_R_LINEAR_____30_CM 0. 1023.96875 DISPLAY_IDENTIFIER C_LGRD_TQ_LOSS_ECF FORMAT "%10.5" /end CHARACTERISTIC
/begin AXIS_PTS ldp_ecfpwm "" 0xa1003568 ecfpwm[0] _REC_AXS_20_u1 99.609375 _CNV_A_R_LINEAR_____5_CM 8 0. 99.609375 FORMAT "%9.6" /end AXIS_PTS
/begin MEASUREMENT tco_2_mes "Measured coolant temperature (radiator outlet)" UBYTE _CNV_A_R_LINEAR_____16_CM 1 100. -48. 142.5 DISPLAY_IDENTIFIER TCO_2_MES ECU_ADDRESS 0xd0002e3a FORMAT "%6.2" /end MEASUREMENT
/begin MEASUREMENT tco_2_st "Coolant temperature (radiator outlet) at start" UBYTE _CNV_A_R_LINEAR_____16_CM 1 100. -48. 142.5 DISPLAY_IDENTIFIER TCO_2_ST ECU_ADDRESS 0xd0002e3b FORMAT "%6.2" /end MEASUREMENT
/begin MEASUREMENT tco_2 "Coolant temperature (radiator outlet)" UBYTE _CNV_A_R_LINEAR_____16_CM 1 100. -48. 142.5 DISPLAY_IDENTIFIER TCO_2 ECU_ADDRESS 0xd0002e39 FORMAT "%6.2" /end MEASUREMENT
/begin MEASUREMENT tco_1_2 "Coolant temperature difference between the TCO- and the TCO_2 sensor" SBYTE _CNV_A_R_LINEAR_____24_CM 1 100. -96. 95.25 DISPLAY_IDENTIFIER TCO_1_2 ECU_ADDRESS 0xd0002e38 FORMAT "%6.2" /end MEASUREMENT
/begin MEASUREMENT lv_cdn_ini_tco_2 "Boolean for coolant temperature (radiator outlet) initialisation conditions" UBYTE _CNV_S_2_RANGE__0___1_CM 1 100. 0. 1. DISPLAY_IDENTIFIER LV_CDN_INI_TCO_2 ECU_ADDRESS 0xc0001c95 BIT_MASK 0x1 /end MEASUREMENT
/begin AXIS_PTS ldp_v_tco_2_ip_tco_2_mes "" 0xa1003610 v_tco_2 _REC_AXS_20_u2 4.49560546875 _CNV_A_R_LINEAR_____2_CM 16 0. 4.9951171875 FORMAT "%5.3" /end AXIS_PTS
/begin CHARACTERISTIC ip_tco_2_mes "Linearization of the coolant temperature (radiator outlet) sensor voltage for temperature acquisition " CURVE 0xa1003714 _REC_CUR_20_u1_u2 28.575 _CNV_A_R_LINEAR_____16_CM -48. 142.5 DISPLAY_IDENTIFIER IP_TCO_2_MES FORMAT "%6.2"
 /begin AXIS_DESCR COM_AXIS v_tco_2 _CNV_A_R_LINEAR_____2_CM 16 0. 4.9951171875 FORMAT "%5.3" AXIS_PTS_REF ldp_v_tco_2_ip_tco_2_mes /end AXIS_DESCR
/end CHARACTERISTIC
/begin CHARACTERISTIC c_tco_2_mes_grd_max "Maximum permissible temperature gradient for coolant temperature (radiator outlet) gradient monitoring" VALUE 0xa1003838 _REC_VAL_20_u1 38.1 _CNV_A_R_LINEAR_____24_CM 0. 190.5 DISPLAY_IDENTIFIER C_TCO_2_MES_GRD_MAX FORMAT "%6.2" /end CHARACTERISTIC
/begin CHARACTERISTIC c_tco_2_dif_tco "Temperature difference to the TCO-value in case of a coolant temperature (radiator outlet) failure" VALUE 0xa1003837 _REC_VAL_20_s1 191.25 _CNV_A_R_LINEAR_____24_CM -96. 95.25 DISPLAY_IDENTIFIER C_TCO_2_DIF_TCO FORMAT "%6.2" /end CHARACTERISTIC
/begin MEASUREMENT v_tco_2 "Coolant temperature sensor (radiator outlet) raw acquisition" UWORD _CNV_A_R_LINEAR_____2_CM 1 100. 0. 4.9951171875 DISPLAY_IDENTIFIER V_TCO_2 ECU_ADDRESS 0xd00025f2 FORMAT "%5.3" /end MEASUREMENT
/begin MEASUREMENT lv_err_tco_grd "Boolean for coolant temperature signal gradient error" UBYTE _CNV_S_2_RANGE__0___1_CM 1 100. 0. 1. DISPLAY_IDENTIFIER LV_ERR_TCO_GRD ECU_ADDRESS 0xd00033b1 BIT_MASK 0x1 /end MEASUREMENT
/begin CHARACTERISTIC c_tia_thr_min_diag_tco_el "Minimum intake air temperature value for the coolant temperature electrical diagnosis" VALUE 0xa100384c _REC_VAL_20_u1 190.5 _CNV_A_R_LINEAR_____16_CM -48. 142.5 DISPLAY_IDENTIFIER C_TIA_THR_MIN_DIAG_TCO_EL FORMAT "%6.2" /end CHARACTERISTIC
/begin MEASUREMENT lv_err_tco_el "Boolean for coolant temperature signal range error" UBYTE _CNV_S_2_RANGE__0___1_CM 1 100. 0. 1. DISPLAY_IDENTIFIER LV_ERR_TCO_EL ECU_ADDRESS 0xd00033b0 BIT_MASK 0x1 /end MEASUREMENT
/begin MEASUREMENT lv_err_tco "Boolean for error currently present on coolant temperature acquisition" UBYTE _CNV_S_2_RANGE__0___1_CM 1 100. 0. 1. DISPLAY_IDENTIFIER LV_ERR_TCO ECU_ADDRESS 0xd0002e4c BIT_MASK 0x1 /end MEASUREMENT
/begin MEASUREMENT lv_err_tco_prel "Boolean for preliminary error currently present on coolant temperature acquisition" UBYTE _CNV_S_2_RANGE__0___1_CM 1 100. 0. 1. DISPLAY_IDENTIFIER LV_ERR_TCO_PREL ECU_ADDRESS 0xd0002e4f BIT_MASK 0x1 /end MEASUREMENT
/begin MEASUREMENT lv_err_tco_prel_det "Boolean for preliminary error present on coolant temperature acquisition during driving cycle" UBYTE _CNV_S_2_RANGE__0___1_CM 1 100. 0. 1. DISPLAY_IDENTIFIER LV_ERR_TCO_PREL_DET ECU_ADDRESS 0xc0001c9b BIT_MASK 0x1 /end MEASUREMENT
/begin MEASUREMENT lv_cdn_ena_tco_prel "Boolean for preliminary coolant temperature error enable conditions" UBYTE _CNV_S_2_RANGE__0___1_CM 1 100. 0. 1. DISPLAY_IDENTIFIER LV_CDN_ENA_TCO_PREL ECU_ADDRESS 0xc0001c92 BIT_MASK 0x1 /end MEASUREMENT
/begin CHARACTERISTIC c_t_ast_min_diag_tco_el "Minimum time delay after start for the coolant temperature electrical diagnosis" VALUE 0xa100381a _REC_VAL_20_u2 65535. _CNV_A_R_LINEAR_____35_CM 0. 65535. DISPLAY_IDENTIFIER C_T_AST_MIN_DIAG_TCO_EL FORMAT "%5.0" /end CHARACTERISTIC
/begin CHARACTERISTIC c_ctr_abc_thd_tco_prel "Threshold for anti-bounce counter value for preliminary coolant temperature error detection" VALUE 0xa10037ec _REC_VAL_20_u1 255. _CNV_A_R_LINEAR_____0_CM 0. 255. DISPLAY_IDENTIFIER C_CTR_ABC_THD_TCO_PREL FORMAT "%3.0" /end CHARACTERISTIC
/begin CHARACTERISTIC c_v_tco_max_diag_tco_el "Maximum raw sensor signal voltage  for the coolant temperature electrical diagnosis" VALUE 0xa1003854 _REC_VAL_20_u2 4.9951171875 _CNV_A_R_LINEAR_____2_CM 0. 4.9951171875 DISPLAY_IDENTIFIER C_V_TCO_MAX_DIAG_TCO_EL FORMAT "%5.3" /end CHARACTERISTIC
/begin CHARACTERISTIC c_v_tco_min_diag_tco_el "Minimum raw sensor signal voltage  for the coolant temperature electrical diagnosis" VALUE 0xa1003856 _REC_VAL_20_u2 4.9951171875 _CNV_A_R_LINEAR_____2_CM 0. 4.9951171875 DISPLAY_IDENTIFIER C_V_TCO_MIN_DIAG_TCO_EL FORMAT "%5.3" /end CHARACTERISTIC
/begin CHARACTERISTIC c_tco_mes_grd_max_diag_tco_grd "Maximum coolant temperature gradient for the coolant temperature gradient diagnosis" VALUE 0xa100383e _REC_VAL_20_u1 190.5 _CNV_A_R_LINEAR_____24_CM 0. 190.5 DISPLAY_IDENTIFIER C_TCO_MES_GRD_MAX_DIAG_TCO_GRD FORMAT "%6.2" /end CHARACTERISTIC
/begin CHARACTERISTIC c_abc_max_tco_el "Debounce counter maximum value - TCO diagnosis" VALUE 0xa10037e8 _REC_VAL_20_u1 254. _CNV_A_R_LINEAR_____0_CM 1. 255. DISPLAY_IDENTIFIER C_ABC_MAX_TCO_EL FORMAT "%3.0" /end CHARACTERISTIC
/begin CHARACTERISTIC c_abc_inc_tco_grd "Debounce counter increment - TCO Signal gradient diagnosis" VALUE 0xa10037e2 _REC_VAL_20_u1 255. _CNV_A_R_LINEAR_____0_CM 0. 255. DISPLAY_IDENTIFIER C_ABC_INC_TCO_GRD FORMAT "%3.0" /end CHARACTERISTIC
/begin CHARACTERISTIC c_abc_max_tco_grd "Debounce counter maximum value - TCO Signal gradient diagnosis" VALUE 0xa10037e9 _REC_VAL_20_u1 254. _CNV_A_R_LINEAR_____0_CM 1. 255. DISPLAY_IDENTIFIER C_ABC_MAX_TCO_GRD FORMAT "%3.0" /end CHARACTERISTIC
/begin MEASUREMENT lv_inh_diag_tco_el "TCO Signal range diagnosis inhibition" UBYTE _CNV_S_2_RANGE__0___1_CM 1 100. 0. 1. DISPLAY_IDENTIFIER LV_INH_DIAG_TCO_EL ECU_ADDRESS 0xd0002e57 BIT_MASK 0x1 /end MEASUREMENT
/begin CHARACTERISTIC c_abc_inc_tco_el "Debounce counter increment- TCO diagnosis" VALUE 0xa10037e1 _REC_VAL_20_u1 255. _CNV_A_R_LINEAR_____0_CM 0. 255. DISPLAY_IDENTIFIER C_ABC_INC_TCO_EL FORMAT "%3.0" /end CHARACTERISTIC
/begin MEASUREMENT lv_inh_diag_tco_stuck "TCO Signal stuck diagnosis inhibition" UBYTE _CNV_S_2_RANGE__0___1_CM 1 100. 0. 1. DISPLAY_IDENTIFIER LV_INH_DIAG_TCO_STUCK ECU_ADDRESS 0xd0002e5a BIT_MASK 0x1 /end MEASUREMENT
/begin MEASUREMENT lv_inh_diag_tco_grd "TCO Signal gradiant diagnosis inhibition" UBYTE _CNV_S_2_RANGE__0___1_CM 1 100. 0. 1. DISPLAY_IDENTIFIER LV_INH_DIAG_TCO_GRD ECU_ADDRESS 0xd0002e58 BIT_MASK 0x1 /end MEASUREMENT
/begin MEASUREMENT state_rbm_tco_stuck "Interface of TCO_STUCK monitor with the Rate-Based Monitoring statistics" UBYTE _CNV_A_R_LINEAR_____0_CM 1 100. 0. 7. DISPLAY_IDENTIFIER STATE_RBM_TCO_STUCK ECU_ADDRESS 0xd0002e35 FORMAT "%1.0" /end MEASUREMENT
/begin MEASUREMENT lv_inh_diag_rbm_tco_stuck "Temperature stuck signal diagnosis inhibition due to OBD error" UBYTE _CNV_S_2_RANGE__0___1_CM 1 100. 0. 1. DISPLAY_IDENTIFIER LV_INH_DIAG_RBM_TCO_STUCK ECU_ADDRESS 0xd0002e52 BIT_MASK 0x1 /end MEASUREMENT
/begin MEASUREMENT lv_err_tco_2_el "Boolean for coolant temperature (radiator outlet) signal range error" UBYTE _CNV_S_2_RANGE__0___1_CM 1 100. 0. 1. DISPLAY_IDENTIFIER LV_ERR_TCO_2_EL ECU_ADDRESS 0xd00033b4 BIT_MASK 0x1 /end MEASUREMENT
/begin MEASUREMENT lv_err_tco_2_grd "Boolean for coolant temperature (radiator outlet) signal gradient error" UBYTE _CNV_S_2_RANGE__0___1_CM 1 100. 0. 1. DISPLAY_IDENTIFIER LV_ERR_TCO_2_GRD ECU_ADDRESS 0xd00033b5 BIT_MASK 0x1 /end MEASUREMENT
/begin CHARACTERISTIC c_tia_thr_min_diag_tco_2_el "Minimum intake air temperature value for the coolant temperature (radiator outlet) electrical diagnosis" VALUE 0xa100384b _REC_VAL_20_u1 190.5 _CNV_A_R_LINEAR_____16_CM -48. 142.5 DISPLAY_IDENTIFIER C_TIA_THR_MIN_DIAG_TCO_2_EL FORMAT "%6.2" /end CHARACTERISTIC
/begin CHARACTERISTIC c_t_ast_min_diag_tco_2_el "Minimum time delay after start for the coolant temperature (radiator outlet) electrical diagnosis" VALUE 0xa1003818 _REC_VAL_20_u2 65535. _CNV_A_R_LINEAR_____35_CM 0. 65535. DISPLAY_IDENTIFIER C_T_AST_MIN_DIAG_TCO_2_EL FORMAT "%5.0" /end CHARACTERISTIC
/begin MEASUREMENT lv_err_tco_2_prel "Boolean for preliminary error currently present on coolant temperature (radiator outlet) acquisition" UBYTE _CNV_S_2_RANGE__0___1_CM 1 100. 0. 1. DISPLAY_IDENTIFIER LV_ERR_TCO_2_PREL ECU_ADDRESS 0xd0002e4e BIT_MASK 0x1 /end MEASUREMENT
/begin CHARACTERISTIC c_v_tco_2_max_diag_tco_2_el "Maximum raw sensor signal voltage for the coolant temperature (radiator outlet) electrical diagnosis" VALUE 0xa1003850 _REC_VAL_20_u2 4.9951171875 _CNV_A_R_LINEAR_____2_CM 0. 4.9951171875 DISPLAY_IDENTIFIER C_V_TCO_2_MAX_DIAG_TCO_2_EL FORMAT "%5.3" /end CHARACTERISTIC
/begin MEASUREMENT lv_err_tco_2 "Boolean for error currently present on coolant temperature (radiator outlet) acquisition" UBYTE _CNV_S_2_RANGE__0___1_CM 1 100. 0. 1. DISPLAY_IDENTIFIER LV_ERR_TCO_2 ECU_ADDRESS 0xd0002e4d BIT_MASK 0x1 /end MEASUREMENT
/begin MEASUREMENT lv_err_tco_2_prel_det "Boolean for preliminary error present on coolant temperature (radiator outlet) acquisition during driving cycle" UBYTE _CNV_S_2_RANGE__0___1_CM 1 100. 0. 1. DISPLAY_IDENTIFIER LV_ERR_TCO_2_PREL_DET ECU_ADDRESS 0xc0001c9a BIT_MASK 0x1 /end MEASUREMENT
/begin MEASUREMENT lv_cdn_ena_tco_2_prel "Boolean for preliminary coolant temperature (radiator outlet) error enable conditions" UBYTE _CNV_S_2_RANGE__0___1_CM 1 100. 0. 1. DISPLAY_IDENTIFIER LV_CDN_ENA_TCO_2_PREL ECU_ADDRESS 0xc0001c91 BIT_MASK 0x1 /end MEASUREMENT
/begin CHARACTERISTIC c_v_tco_2_min_diag_tco_2_el "Minimum raw sensor signal voltage for the coolant temperature (radiator outlet) electrical diagnosis" VALUE 0xa1003852 _REC_VAL_20_u2 4.9951171875 _CNV_A_R_LINEAR_____2_CM 0. 4.9951171875 DISPLAY_IDENTIFIER C_V_TCO_2_MIN_DIAG_TCO_2_EL FORMAT "%5.3" /end CHARACTERISTIC
/begin CHARACTERISTIC c_ctr_abc_thd_tco_2_prel "Threshold for anti-bounce counter value for preliminary coolant temperature (radiator outlet) error detection" VALUE 0xa10037eb _REC_VAL_20_u1 255. _CNV_A_R_LINEAR_____0_CM 0. 255. DISPLAY_IDENTIFIER C_CTR_ABC_THD_TCO_2_PREL FORMAT "%3.0" /end CHARACTERISTIC
/begin CHARACTERISTIC c_tco_2_mes_grd_max_diag_tco_2 "Maximum coolant temperature gradient for the coolant temperature (radiator outlet) gradient diagnosis" VALUE 0xa1003839 _REC_VAL_20_u1 190.5 _CNV_A_R_LINEAR_____24_CM 0. 190.5 DISPLAY_IDENTIFIER C_TCO_2_MES_GRD_MAX_DIAG_TCO_2 FORMAT "%6.2" /end CHARACTERISTIC
/begin MEASUREMENT lv_inh_diag_tco_2_el "TCO Signal range diagnosis inhibition" UBYTE _CNV_S_2_RANGE__0___1_CM 1 100. 0. 1. DISPLAY_IDENTIFIER LV_INH_DIAG_TCO_2_EL ECU_ADDRESS 0xd0002e54 BIT_MASK 0x1 /end MEASUREMENT
/begin MEASUREMENT lv_inh_diag_tco_2_grd "TCO Signal range diagnosis inhibition" UBYTE _CNV_S_2_RANGE__0___1_CM 1 100. 0. 1. DISPLAY_IDENTIFIER LV_INH_DIAG_TCO_2_GRD ECU_ADDRESS 0xd0002e55 BIT_MASK 0x1 /end MEASUREMENT
/begin CHARACTERISTIC c_abc_inc_tco_2_el "Debounce counter increment- TCO 2 diagnosis" VALUE 0xa10037df _REC_VAL_20_u1 255. _CNV_A_R_LINEAR_____0_CM 0. 255. DISPLAY_IDENTIFIER C_ABC_INC_TCO_2_EL FORMAT "%3.0" /end CHARACTERISTIC
/begin CHARACTERISTIC c_abc_inc_tco_2_grd "Debounce counter increment- TCO 2 diagnosis" VALUE 0xa10037e0 _REC_VAL_20_u1 255. _CNV_A_R_LINEAR_____0_CM 0. 255. DISPLAY_IDENTIFIER C_ABC_INC_TCO_2_GRD FORMAT "%3.0" /end CHARACTERISTIC
/begin CHARACTERISTIC c_abc_max_tco_2_grd "Debounce counter max- TCO 2 diagnosis" VALUE 0xa10037e7 _REC_VAL_20_u1 254. _CNV_A_R_LINEAR_____0_CM 1. 255. DISPLAY_IDENTIFIER C_ABC_MAX_TCO_2_GRD FORMAT "%3.0" /end CHARACTERISTIC
/begin CHARACTERISTIC c_abc_max_tco_2_el "Debounce counter max- TCO 2 diagnosis" VALUE 0xa10037e6 _REC_VAL_20_u1 254. _CNV_A_R_LINEAR_____0_CM 1. 255. DISPLAY_IDENTIFIER C_ABC_MAX_TCO_2_EL FORMAT "%3.0" /end CHARACTERISTIC
/begin AXIS_PTS ldpm_tco_st_1_ente "" 0xa1003656 tco_st _REC_AXS_20_u1 190.5 _CNV_A_R_LINEAR_____16_CM 6 -48. 142.5 FORMAT "%6.2" /end AXIS_PTS
/begin CHARACTERISTIC c_cpu_load_per "Time between two measurement session" VALUE 0xa1029e4c _REC_VAL_20_u2 65535. _CNV_A_R_LINEAR_____0_CM 0. 65535. DISPLAY_IDENTIFIER C_CPU_LOAD_PER FORMAT "%5.0" /end CHARACTERISTIC
/begin CHARACTERISTIC c_cpu_load_ses_t_begin "Beginning of measurement session" VALUE 0xa1029e4e _REC_VAL_20_u2 65535. _CNV_A_R_LINEAR_____0_CM 0. 65535. DISPLAY_IDENTIFIER C_CPU_LOAD_SES_T_BEGIN FORMAT "%5.0" /end CHARACTERISTIC
/begin CHARACTERISTIC c_cpu_load_ses_t_end "End of measurement session" VALUE 0xa1029e50 _REC_VAL_20_u2 65535. _CNV_A_R_LINEAR_____0_CM 0. 65535. DISPLAY_IDENTIFIER C_CPU_LOAD_SES_T_END FORMAT "%5.0" /end CHARACTERISTIC
/begin CHARACTERISTIC c_cpu_load_tsk_mes_dly "Calibration for acting on measurement task period" VALUE 0xa1029e52 _REC_VAL_20_u2 65535. _CNV_A_R_LINEAR_____0_CM 0. 65535. DISPLAY_IDENTIFIER C_CPU_LOAD_TSK_MES_DLY FORMAT "%5.0" /end CHARACTERISTIC
/begin CHARACTERISTIC lc_cpu_load_max_rst "Flag for reset of variable cpu_load_max" VALUE 0xa1029e54 _REC_VAL_20_u1 1. _CNV_A_R_LINEAR_____0_CM 0. 1. DISPLAY_IDENTIFIER LC_CPU_LOAD_MAX_RST FORMAT "%1.0" /end CHARACTERISTIC
/begin CHARACTERISTIC lc_cpu_load_tsk_per_min_rst "Flag for reset variable cpu_load_tsk_per_min" VALUE 0xa1029e55 _REC_VAL_20_u1 1. _CNV_A_R_LINEAR_____0_CM 0. 1. DISPLAY_IDENTIFIER LC_CPU_LOAD_TSK_PER_MIN_RST FORMAT "%1.0" /end CHARACTERISTIC
/begin CHARACTERISTIC lc_cpu_load_tsk_per_min_upd "Flag for authorizing update of cpu_load_tsk_per_min_save with cpu_load_tsk_per_min" VALUE 0xa1029e56 _REC_VAL_20_u1 1. _CNV_A_R_LINEAR_____0_CM 0. 1. DISPLAY_IDENTIFIER LC_CPU_LOAD_TSK_PER_MIN_UPD FORMAT "%1.0" /end CHARACTERISTIC
/begin MEASUREMENT cpu_load_tsk_per_ctr "Counter of TASK_BG_MES instances" UWORD _CNV_A_R_LINEAR_____0_CM 1 100. 0. 65535. DISPLAY_IDENTIFIER CPU_LOAD_TSK_PER_CTR ECU_ADDRESS 0xc0002000 FORMAT "%5.0" /end MEASUREMENT
/begin MEASUREMENT cpu_load "CPU load above measurement level" UWORD _CNV_A_R_CPULOAD__0_461_CM 1 100. 0. 100. DISPLAY_IDENTIFIER CPU_LOAD ECU_ADDRESS 0xc0001ffc FORMAT "%3.1" /end MEASUREMENT
/begin MEASUREMENT cpu_load_max "Maximum detected CPU load above measurement level" UWORD _CNV_A_R_CPULOAD__0_461_CM 1 100. 0. 100. DISPLAY_IDENTIFIER CPU_LOAD_MAX ECU_ADDRESS 0xc0001ffe FORMAT "%3.1" /end MEASUREMENT
/begin MEASUREMENT cpu_load_tsk_per "Time between2 instances of TASK_BG_MES" ULONG _CNV_A_R_CPULOAD____462_CM 1 100. 0. 4294967295. DISPLAY_IDENTIFIER CPU_LOAD_TSK_PER ECU_ADDRESS 0xc000200c FORMAT "%10.0" /end MEASUREMENT
/begin MEASUREMENT cpu_load_tsk_per_min_save "Saved minimum time between 2 instances of TASK_BG_MES" ULONG _CNV_A_R_CPULOAD____462_CM 1 100. 0. 4294967295. DISPLAY_IDENTIFIER CPU_LOAD_TSK_PER_MIN_SAVE ECU_ADDRESS 0xd0006300 FORMAT "%10.0" /end MEASUREMENT
/begin MEASUREMENT cpu_load_tsk_per_min "Minimum time between 2 instances of TASK_BG_MES" ULONG _CNV_A_R_CPULOAD____462_CM 1 100. 0. 4294967295. DISPLAY_IDENTIFIER CPU_LOAD_TSK_PER_MIN ECU_ADDRESS 0xc0002008 FORMAT "%10.0" /end MEASUREMENT
/begin MEASUREMENT tq_loss_add "total torque losses for additive engine devices" SWORD _CNV_A_R_LINEAR_____30_CM 1 100. -1024. 1023.96875 DISPLAY_IDENTIFIER TQ_LOSS_ADD ECU_ADDRESS 0xd00023f2 FORMAT "%11.5" /end MEASUREMENT
/begin MEASUREMENT lv_ti_lim_act "1: injection time limited by cycle time (720°crk)" UBYTE _CNV_S_2_RANGE__0___1_CM 1 100. 0. 1. DISPLAY_IDENTIFIER LV_TI_LIM_ACT ECU_ADDRESS 0xd00037fd BIT_MASK 0x1 /end MEASUREMENT
/begin MEASUREMENT fac_eoi_opm_sel "injection phasing correction interpolation factor for operation switch manager" UBYTE _CNV_A_R_LINEAR_____27_CM 1 100. 0. 0.99609375 DISPLAY_IDENTIFIER FAC_EOI_OPM_SEL ECU_ADDRESS 0xd00037fc FORMAT "%5.3" /end MEASUREMENT
/begin MEASUREMENT lv_mplp_ena "Enable post injection " UBYTE _CNV_S_2_RANGE__0___1_CM 1 100. 0. 1. DISPLAY_IDENTIFIER LV_MPLP_ENA ECU_ADDRESS 0xd00037ff BIT_MASK 0x1 /end MEASUREMENT
/begin MEASUREMENT lv_mplp_act "Indicates if stratified mode with post injection is active" UBYTE _CNV_S_2_RANGE__0___1_CM 1 100. 0. 1. DISPLAY_IDENTIFIER LV_MPLP_ACT ECU_ADDRESS 0xd00037fe BIT_MASK 0x1 /end MEASUREMENT
/begin MEASUREMENT lv_mplh_act "Indicates if homogeneous mode with split injection is active" UBYTE _CNV_S_2_RANGE__0___1_CM 1 100. 0. 1. DISPLAY_IDENTIFIER LV_MPLH_ACT ECU_ADDRESS 0xd0003800 BIT_MASK 0x1 /end MEASUREMENT
/begin MEASUREMENT lv_eoi_2_delta_hom_cus "Switch between EOI_2_HOM_CUS (LV... = 0) or EOI_2_DELTA_HOM_CUS (LV = 1) for phasing of second hom. Injection pulse" UBYTE _CNV_S_2_RANGE__0___1_CM 1 100. 0. 1. DISPLAY_IDENTIFIER LV_EOI_2_DELTA_HOM_CUS ECU_ADDRESS 0xd0003801 BIT_MASK 0x1 /end MEASUREMENT
/begin AXIS_PTS ldpm_opm_av "" 0xa102218c opm_av _REC_AXS_20_u1 8. _CNV_A_R_LINEAR_____0_CM 8 0. 8. FORMAT "%1.0" /end AXIS_PTS
/begin MEASUREMENT state_clc_red "Calculation reduction state for runtime optimization" UBYTE _CNV_A_R_LINEAR_____0_CM 1 100. 0. 255. DISPLAY_IDENTIFIER STATE_CLC_RED ECU_ADDRESS 0xd0002ed8 FORMAT "%3.0" /end MEASUREMENT
/begin MEASUREMENT ctr_cyl_nr_st_clc "Number of first cylinder in calculation order " UBYTE _CNV_A_R_LINEAR_____0_CM 1 100. 0. 255. DISPLAY_IDENTIFIER CTR_CYL_NR_ST_CLC ECU_ADDRESS 0xd0002ed0 FORMAT "%3.0" /end MEASUREMENT
/begin MEASUREMENT ctr_cyl_nr_stop_clc "Number of last cylinder in calculation order" UBYTE _CNV_A_R_LINEAR_____0_CM 1 100. 0. 255. DISPLAY_IDENTIFIER CTR_CYL_NR_STOP_CLC ECU_ADDRESS 0xd0002ed1 FORMAT "%3.0" /end MEASUREMENT
/begin MEASUREMENT ctr_cbk_in_nr_st_clc "Start number of intake bank for calculations" UBYTE _CNV_A_R_LINEAR_____0_CM 1 100. 0. 255. DISPLAY_IDENTIFIER CTR_CBK_IN_NR_ST_CLC ECU_ADDRESS 0xd0002ece FORMAT "%3.0" /end MEASUREMENT
/begin MEASUREMENT ctr_cbk_in_nr_stop_clc "Stop number of intake bank for calculations" UBYTE _CNV_A_R_LINEAR_____0_CM 1 100. 0. 255. DISPLAY_IDENTIFIER CTR_CBK_IN_NR_STOP_CLC ECU_ADDRESS 0xd0002ecf FORMAT "%3.0" /end MEASUREMENT
/begin MEASUREMENT ctr_cbk_ex_nr_st_clc "Start number of exhaust bank for calculations" UBYTE _CNV_A_R_LINEAR_____0_CM 1 100. 0. 255. DISPLAY_IDENTIFIER CTR_CBK_EX_NR_ST_CLC ECU_ADDRESS 0xd0002ecc FORMAT "%3.0" /end MEASUREMENT
/begin MEASUREMENT ctr_cbk_ex_nr_stop_clc "Stop number of exhaust bank for calculations" UBYTE _CNV_A_R_LINEAR_____0_CM 1 100. 0. 255. DISPLAY_IDENTIFIER CTR_CBK_EX_NR_STOP_CLC ECU_ADDRESS 0xd0002ecd FORMAT "%3.0" /end MEASUREMENT
/begin CHARACTERISTIC c_n_32_thd_clc_red "engine speed threshold for activation of runtime reaction" VALUE 0xa100813b _REC_VAL_20_u1 8160. _CNV_A_R_LINEAR_____9_CM 0. 8160. DISPLAY_IDENTIFIER C_N_32_THD_CLC_RED FORMAT "%4.0" /end CHARACTERISTIC
/begin CHARACTERISTIC c_n_32_hys_clc_red "engine speed hysteresis for deactivation of runtime reaction" VALUE 0xa100813a _REC_VAL_20_u1 2016. _CNV_A_R_LINEAR_____9_CM 0. 2016. DISPLAY_IDENTIFIER C_N_32_HYS_CLC_RED FORMAT "%4.0" /end CHARACTERISTIC
/begin CHARACTERISTIC c_seg_nr_st_clc_red "start segment number for runtime reduction activation" VALUE 0xa100813c _REC_VAL_20_u1 7. _CNV_A_R_LINEAR_____0_CM 0. 7. DISPLAY_IDENTIFIER C_SEG_NR_ST_CLC_RED FORMAT "%1.0" /end CHARACTERISTIC
/begin CHARACTERISTIC id_ctr_cyl_nr_clc "cylinder and segment relation for runtime reduction" CURVE 0xa100812e _REC_CUR_20_u1_u1 7. _CNV_A_R_LINEAR_____0_CM 0. 7. DISPLAY_IDENTIFIER ID_CTR_CYL_NR_CLC FORMAT "%1.0"
 /begin AXIS_DESCR COM_AXIS seg_nr _CNV_A_R_LINEAR_____0_CM 6 0. 7. FORMAT "%1.0" AXIS_PTS_REF ldp_seg_nr_id_ctr_cyl_nr_clc /end AXIS_DESCR
/end CHARACTERISTIC
/begin AXIS_PTS ldp_seg_nr_id_ctr_cyl_nr_clc "" 0xa1008126 seg_nr _REC_AXS_20_u1 7. _CNV_A_R_LINEAR_____0_CM 6 0. 7. FORMAT "%1.0" /end AXIS_PTS
/begin MEASUREMENT fac_st_amp "Injection correction at start upon AMP" UBYTE _CNV_A_R_LINEAR_____100_CM 1 100. 0. 1.9921875 DISPLAY_IDENTIFIER FAC_ST_AMP ECU_ADDRESS 0xd0002ed3 FORMAT "%8.6" /end MEASUREMENT
/begin AXIS_PTS ldp_amp_ip_fac_st_amp "Cranking injection time correction upon ambient pressure" 0xa1008118 amp _REC_AXS_20_u2 5434. _CNV_A_R_LINEAR_____26_CM 6 0. 5434. FORMAT "%7.2" /end AXIS_PTS
/begin CHARACTERISTIC ip_fac_st_amp "Cranking injection time correction upon ambient pressure" CURVE 0xa1008134 _REC_CUR_20_u1_u2 1.9921875 _CNV_A_R_LINEAR_____100_CM 0. 1.9921875 DISPLAY_IDENTIFIER IP_FAC_ST_AMP FORMAT "%8.6"
 /begin AXIS_DESCR COM_AXIS amp _CNV_A_R_LINEAR_____26_CM 6 0. 5434. FORMAT "%7.2" AXIS_PTS_REF ldp_amp_ip_fac_st_amp /end AXIS_DESCR
/end CHARACTERISTIC
/begin AXIS_PTS ldpm_prs_dec_inj_1_injr "" 0xa1008314 prs_dec_inj_1_hom _REC_AXS_20_u2 347776. _CNV_A_R_LINEAR_____152_CM 6 0. 347776. FORMAT "%8.1" /end AXIS_PTS
/begin MEASUREMENT inh_iv_ext "Shut off pattern for cylinder shut off (cylinder allocated)" UBYTE _CNV_A_R_LINEAR_____0_CM 1 100. 0. 255. DISPLAY_IDENTIFIER INH_IV_EXT ECU_ADDRESS 0xd0002ee4 FORMAT "%3.0" /end MEASUREMENT
/begin MEASUREMENT inh_iv_swi_man "Manual shut off request" UBYTE _CNV_A_R_LINEAR_____0_CM 1 100. 0. 255. DISPLAY_IDENTIFIER INH_IV_SWI_MAN ECU_ADDRESS 0xc0002400 FORMAT "%3.0" /end MEASUREMENT
/begin CHARACTERISTIC c_inh_iv_swi_man "Application constant for manual shut off request" VALUE 0xa1008a28 _REC_VAL_20_u1 255. _CNV_A_R_LINEAR_____0_CM 0. 255. DISPLAY_IDENTIFIER C_INH_IV_SWI_MAN FORMAT "%3.0" /end CHARACTERISTIC
/begin MEASUREMENT lv_scc "even one cylinder bank is shut off" UBYTE _CNV_S_2_RANGE__0___1_CM 1 100. 0. 1. DISPLAY_IDENTIFIER LV_SCC ECU_ADDRESS 0xd0002f13 /end MEASUREMENT
/begin AXIS_PTS ldpm_mff_sp_1_injr "" 0xa10082f0 online_dummy _REC_AXS_20_u2 1389. _CNV_A_R_LINEAR_____108_CM 16 0. 1389. FORMAT "%7.2" /end AXIS_PTS
/begin AXIS_PTS ldp_mff_sp_ip_fac_ti_2_s "" 0xa10081fc mff_sp_1_s[0] _REC_AXS_20_u2 1389. _CNV_A_R_LINEAR_____108_CM 12 0. 1389. FORMAT "%7.2" /end AXIS_PTS
/begin MEASUREMENT t_dly_1_2_s_ext[0] "Interval between first and second pulse of stratified injection - base value from MSD70 layer" UWORD _CNV_A_R_LINEAR_____233_CM 1 100. 0. 65.535 DISPLAY_IDENTIFIER T_DLY_1_2_S_EXT[0] ECU_ADDRESS 0xd0002b4c /end MEASUREMENT
/begin MEASUREMENT t_dly_1_2_s_ext[1] "Interval between first and second pulse of stratified injection - base value from MSD70 layer" UWORD _CNV_A_R_LINEAR_____233_CM 1 100. 0. 65.535 DISPLAY_IDENTIFIER T_DLY_1_2_S_EXT[1] ECU_ADDRESS 0xd0002b4e /end MEASUREMENT
/begin MEASUREMENT t_dly_1_2_s_ext[2] "Interval between first and second pulse of stratified injection - base value from MSD70 layer" UWORD _CNV_A_R_LINEAR_____233_CM 1 100. 0. 65.535 DISPLAY_IDENTIFIER T_DLY_1_2_S_EXT[2] ECU_ADDRESS 0xd0002b50 /end MEASUREMENT
/begin MEASUREMENT t_dly_1_2_s_ext[3] "Interval between first and second pulse of stratified injection - base value from MSD70 layer" UWORD _CNV_A_R_LINEAR_____233_CM 1 100. 0. 65.535 DISPLAY_IDENTIFIER T_DLY_1_2_S_EXT[3] ECU_ADDRESS 0xd0002b52 /end MEASUREMENT
/begin MEASUREMENT t_dly_1_2_s_ext[4] "Interval between first and second pulse of stratified injection - base value from MSD70 layer" UWORD _CNV_A_R_LINEAR_____233_CM 1 100. 0. 65.535 DISPLAY_IDENTIFIER T_DLY_1_2_S_EXT[4] ECU_ADDRESS 0xd0002b54 /end MEASUREMENT
/begin MEASUREMENT t_dly_1_2_s_ext[5] "Interval between first and second pulse of stratified injection - base value from MSD70 layer" UWORD _CNV_A_R_LINEAR_____233_CM 1 100. 0. 65.535 DISPLAY_IDENTIFIER T_DLY_1_2_S_EXT[5] ECU_ADDRESS 0xd0002b56 /end MEASUREMENT
/begin CHARACTERISTIC c_t_dly_1_2_s_ext_man "Manual setpoint for time interval between first and second pulse of stratified injection" VALUE 0xa1008a40 _REC_VAL_20_u2 65.535 _CNV_A_R_LINEAR_____233_CM 0. 65.535 DISPLAY_IDENTIFIER C_T_DLY_1_2_S_EXT_MAN /end CHARACTERISTIC
/begin MEASUREMENT mff_add_reac[0] "Additive fuel amount at reactivation of fuel feed" UWORD _CNV_A_R_LINEAR_____108_CM 1 100. 0. 1389. DISPLAY_IDENTIFIER MFF_ADD_REAC[0] ECU_ADDRESS 0xd0002b18 FORMAT "%7.2" /end MEASUREMENT
/begin MEASUREMENT mff_add_reac[1] "Additive fuel amount at reactivation of fuel feed" UWORD _CNV_A_R_LINEAR_____108_CM 1 100. 0. 1389. DISPLAY_IDENTIFIER MFF_ADD_REAC[1] ECU_ADDRESS 0xd0002b1a FORMAT "%7.2" /end MEASUREMENT
/begin MEASUREMENT mff_add_reac[2] "Additive fuel amount at reactivation of fuel feed" UWORD _CNV_A_R_LINEAR_____108_CM 1 100. 0. 1389. DISPLAY_IDENTIFIER MFF_ADD_REAC[2] ECU_ADDRESS 0xd0002b1c FORMAT "%7.2" /end MEASUREMENT
/begin MEASUREMENT mff_add_reac[3] "Additive fuel amount at reactivation of fuel feed" UWORD _CNV_A_R_LINEAR_____108_CM 1 100. 0. 1389. DISPLAY_IDENTIFIER MFF_ADD_REAC[3] ECU_ADDRESS 0xd0002b1e FORMAT "%7.2" /end MEASUREMENT
/begin MEASUREMENT mff_add_reac[4] "Additive fuel amount at reactivation of fuel feed" UWORD _CNV_A_R_LINEAR_____108_CM 1 100. 0. 1389. DISPLAY_IDENTIFIER MFF_ADD_REAC[4] ECU_ADDRESS 0xd0002b20 FORMAT "%7.2" /end MEASUREMENT
/begin MEASUREMENT mff_add_reac[5] "Additive fuel amount at reactivation of fuel feed" UWORD _CNV_A_R_LINEAR_____108_CM 1 100. 0. 1389. DISPLAY_IDENTIFIER MFF_ADD_REAC[5] ECU_ADDRESS 0xd0002b22 FORMAT "%7.2" /end MEASUREMENT
/begin AXIS_PTS ldp_mff_sp_hom_ip_mff_add_reac "Additive fuel amount at reactivation of fuel feed" 0xa10081e8 mff_sp_1_hom[0] _REC_AXS_20_u2 1389. _CNV_A_R_LINEAR_____108_CM 8 0. 1389. FORMAT "%7.2" /end AXIS_PTS
/begin AXIS_PTS ldp_n_ip_mff_add_reac "Additive fuel amount at reactivation of fuel feed" 0xa100823c n _REC_AXS_20_u2 8160. _CNV_A_R_LINEAR_____13_CM 8 0. 8160. FORMAT "%4.0" /end AXIS_PTS
/begin CHARACTERISTIC ip_mff_add_reac "Additive fuel amount at reactivation of fuel feed" MAP 0xa1008600 _REC_MAP_20_u2_u2_u2 1389. _CNV_A_R_LINEAR_____108_CM 0. 1389. DISPLAY_IDENTIFIER IP_MFF_ADD_REAC FORMAT "%7.2"
 /begin AXIS_DESCR COM_AXIS mff_sp_1_hom[0] _CNV_A_R_LINEAR_____108_CM 8 0. 1389. FORMAT "%7.2" AXIS_PTS_REF ldp_mff_sp_hom_ip_mff_add_reac /end AXIS_DESCR
 /begin AXIS_DESCR COM_AXIS n _CNV_A_R_LINEAR_____13_CM 8 0. 8160. FORMAT "%4.0" AXIS_PTS_REF ldp_n_ip_mff_add_reac /end AXIS_DESCR
/end CHARACTERISTIC
/begin MEASUREMENT fac_n "Factor for conversion of EOI to SOI or SOI to EOI" UWORD _CNV_A_R_INJR_LINEA_473_CM 1 100. 0. 48.96 DISPLAY_IDENTIFIER FAC_N ECU_ADDRESS 0xd0002b04 /end MEASUREMENT
/begin MEASUREMENT tfu_inj "Fuel temperature for injection system" UBYTE _CNV_A_R_LINEAR_____16_CM 1 100. -48. 142.5 DISPLAY_IDENTIFIER TFU_INJ ECU_ADDRESS 0xd0002efd FORMAT "%6.2" /end MEASUREMENT
/begin CHARACTERISTIC lc_t_dly_1_2_s_ext_man_ena "Switch to enable manual setpoint for time interval between first and second pulse of stratified injection" VALUE 0xa1008a86 _REC_VAL_20_u1 1. _CNV_A_R_LINEAR_____0_CM 0. 1. DISPLAY_IDENTIFIER LC_T_DLY_1_2_S_EXT_MAN_ENA FORMAT "%1.0" /end CHARACTERISTIC
/begin MEASUREMENT lv_iv_test_mod_auth "Flag to authorize the injection valve actuator test" UBYTE _CNV_S_2_RANGE__0___1_CM 1 100. 0. 1. DISPLAY_IDENTIFIER LV_IV_TEST_MOD_AUTH ECU_ADDRESS 0xd0002f10 BIT_MASK 0x1 /end MEASUREMENT
/begin MEASUREMENT lv_n_tooth_end_act "Flag for  indication that engine speed is over N_TOOTH_END" UBYTE _CNV_S_2_RANGE__0___1_CM 1 100. 0. 1. DISPLAY_IDENTIFIER LV_N_TOOTH_END_ACT ECU_ADDRESS 0xd0002f11 BIT_MASK 0x1 /end MEASUREMENT
/begin MEASUREMENT state_inj_mod_req "Injection mode request for all cylinders" UBYTE _CNV_A_R_LINEAR_____0_CM 1 100. 0. 255. DISPLAY_IDENTIFIER STATE_INJ_MOD_REQ ECU_ADDRESS 0xd0002eee FORMAT "%3.0" /end MEASUREMENT
/begin MEASUREMENT nr_cyl_iv_test_mod "Logical cylinder number of that cylinder for which the actuator test is in progress" UBYTE _CNV_A_R_LINEAR_____0_CM 1 100. 0. 7. DISPLAY_IDENTIFIER NR_CYL_IV_TEST_MOD ECU_ADDRESS 0xd0002ee9 FORMAT "%3.0" /end MEASUREMENT
/begin CHARACTERISTIC c_inj_mod_sp_man "Injection mode set-point for manual selection" VALUE 0xa1008a29 _REC_VAL_20_u1 7. _CNV_S_8_C_INJ_MOD__474_CM 0. 7. DISPLAY_IDENTIFIER C_INJ_MOD_SP_MAN /end CHARACTERISTIC
/begin CHARACTERISTIC lc_inj_mod_sp_man_ena "Logical constant to enable manual injection mode selection" VALUE 0xa1008a80 _REC_VAL_20_u1 1. _CNV_A_R_LINEAR_____0_CM 0. 1. DISPLAY_IDENTIFIER LC_INJ_MOD_SP_MAN_ENA FORMAT "%1.0" /end CHARACTERISTIC
/begin MEASUREMENT ti_add_dly_hom "Injector dead time correction, homogeneous mode" SWORD _CNV_A_R_LINEAR_____233_CM 1 100. -32.768 32.767 DISPLAY_IDENTIFIER TI_ADD_DLY_HOM ECU_ADDRESS 0xd0002b60 FORMAT "%8.3" /end MEASUREMENT
/begin MEASUREMENT ti_add_dly "Injector dead time correction, homogeneous mode (to basic software)" SWORD _CNV_A_R_LINEAR_____233_CM 1 100. -32.768 32.767 DISPLAY_IDENTIFIER TI_ADD_DLY ECU_ADDRESS 0xd0002b5e FORMAT "%8.3" /end MEASUREMENT
/begin CHARACTERISTIC ip_ti_add_dly_hpdi_egy_l "Injector dead time correction for low energy range of the injector" CURVE 0xa10089d8 _REC_CUR_20_u2_u2 65.535 _CNV_A_R_INJR_LINEA_476_CM -32.768 32.767 DISPLAY_IDENTIFIER IP_TI_ADD_DLY_HPDI_EGY_L FORMAT "%8.3"
 /begin AXIS_DESCR COM_AXIS prs_dec_inj_1_hom _CNV_A_R_LINEAR_____152_CM 6 0. 347776. FORMAT "%8.1" AXIS_PTS_REF ldpm_prs_dec_inj_1_injr /end AXIS_DESCR
/end CHARACTERISTIC
/begin CHARACTERISTIC ip_ti_add_dly_hpdi_egy_h "Injector dead time correction for high energy range of the injector" CURVE 0xa10089cc _REC_CUR_20_u2_u2 65.535 _CNV_A_R_INJR_LINEA_476_CM -32.768 32.767 DISPLAY_IDENTIFIER IP_TI_ADD_DLY_HPDI_EGY_H FORMAT "%8.3"
 /begin AXIS_DESCR COM_AXIS prs_dec_inj_1_hom _CNV_A_R_LINEAR_____152_CM 6 0. 347776. FORMAT "%8.1" AXIS_PTS_REF ldpm_prs_dec_inj_1_injr /end AXIS_DESCR
/end CHARACTERISTIC
/begin MEASUREMENT ti_1_add_dly_s "Injector dead time correction, stratified mode first pulse" SWORD _CNV_A_R_LINEAR_____233_CM 1 100. -32.768 32.767 DISPLAY_IDENTIFIER TI_1_ADD_DLY_S ECU_ADDRESS 0xd0002b58 FORMAT "%8.3" /end MEASUREMENT
/begin MEASUREMENT ti_2_add_dly_s "Injector dead time correction, stratified mode second pulse" SWORD _CNV_A_R_LINEAR_____233_CM 1 100. -32.768 32.767 DISPLAY_IDENTIFIER TI_2_ADD_DLY_S ECU_ADDRESS 0xd0002b5c FORMAT "%8.3" /end MEASUREMENT
/begin AXIS_PTS ldp_prs_dec_inj_ip_fac_ti_prs "" 0xa100825c prs_dec_inj_1_hom _REC_AXS_20_u2 347776. _CNV_A_R_LINEAR_____152_CM 12 0. 347776. FORMAT "%8.1" /end AXIS_PTS
/begin CHARACTERISTIC ip_fac_ti_prs "correction factor to compensate the influence of the varying pressure difference at the injector" CURVE 0xa10085d0 _REC_CUR_20_u2_u2 15.999755859375 _CNV_A_R_LINEAR_____115_CM 0. 15.999755859375 DISPLAY_IDENTIFIER IP_FAC_TI_PRS FORMAT "%7.4"
 /begin AXIS_DESCR COM_AXIS prs_dec_inj_1_hom _CNV_A_R_LINEAR_____152_CM 12 0. 347776. FORMAT "%8.1" AXIS_PTS_REF ldp_prs_dec_inj_ip_fac_ti_prs /end AXIS_DESCR
/end CHARACTERISTIC
/begin MEASUREMENT prs_dec_inj_1_hom "pressure difference at the injector, 1. pulse" UWORD _CNV_A_R_LINEAR_____152_CM 1 100. 0. 347776. DISPLAY_IDENTIFIER PRS_DEC_INJ_1_HOM ECU_ADDRESS 0xd0002b28 FORMAT "%8.1" /end MEASUREMENT
/begin MEASUREMENT fac_ti_1_prs_hom "correction factor to compensate the influence of the varying pressure difference at the injector, 1. pulse" UWORD _CNV_A_R_LINEAR_____115_CM 1 100. 0. 15.999755859375 DISPLAY_IDENTIFIER FAC_TI_1_PRS_HOM ECU_ADDRESS 0xd0002b06 FORMAT "%7.4" /end MEASUREMENT
/begin MEASUREMENT injr.STR_INJR_ISPCLEGYIV0.egy_add_ad[0] "Adaptive piezo energy correction depending on CYBL + CILC corrections" SWORD _CNV_A_R_INJR_LINEA_480_CM 1 100. -50. 50. DISPLAY_IDENTIFIER EGY_ADD_AD[0] ECU_ADDRESS 0xd0002a38 /end MEASUREMENT
/begin MEASUREMENT injr.STR_INJR_ISPCLEGYIV0.egy_add_ad[1] "Adaptive piezo energy correction depending on CYBL + CILC corrections" SWORD _CNV_A_R_INJR_LINEA_480_CM 1 100. -50. 50. DISPLAY_IDENTIFIER EGY_ADD_AD[1] ECU_ADDRESS 0xd0002a3a /end MEASUREMENT
/begin MEASUREMENT injr.STR_INJR_ISPCLEGYIV0.egy_add_ad[2] "Adaptive piezo energy correction depending on CYBL + CILC corrections" SWORD _CNV_A_R_INJR_LINEA_480_CM 1 100. -50. 50. DISPLAY_IDENTIFIER EGY_ADD_AD[2] ECU_ADDRESS 0xd0002a3c /end MEASUREMENT
/begin MEASUREMENT injr.STR_INJR_ISPCLEGYIV0.egy_add_ad[3] "Adaptive piezo energy correction depending on CYBL + CILC corrections" SWORD _CNV_A_R_INJR_LINEA_480_CM 1 100. -50. 50. DISPLAY_IDENTIFIER EGY_ADD_AD[3] ECU_ADDRESS 0xd0002a3e /end MEASUREMENT
/begin MEASUREMENT injr.STR_INJR_ISPCLEGYIV0.egy_add_ad[4] "Adaptive piezo energy correction depending on CYBL + CILC corrections" SWORD _CNV_A_R_INJR_LINEA_480_CM 1 100. -50. 50. DISPLAY_IDENTIFIER EGY_ADD_AD[4] ECU_ADDRESS 0xd0002a40 /end MEASUREMENT
/begin MEASUREMENT injr.STR_INJR_ISPCLEGYIV0.egy_add_ad[5] "Adaptive piezo energy correction depending on CYBL + CILC corrections" SWORD _CNV_A_R_INJR_LINEA_480_CM 1 100. -50. 50. DISPLAY_IDENTIFIER EGY_ADD_AD[5] ECU_ADDRESS 0xd0002a42 /end MEASUREMENT
/begin MEASUREMENT maf_egr "" UWORD _CNV_A_R_LINEAR_____207_CM 1 100. 0. 2047.96875 DISPLAY_IDENTIFIER MAF_EGR ECU_ADDRESS 0xd0002c64 FORMAT "%7.2" /end MEASUREMENT
/begin MEASUREMENT maf_mdl_mv "" UWORD _CNV_A_R_LINEAR_____207_CM 1 100. 0. 2047.96875 DISPLAY_IDENTIFIER MAF_MDL_MV ECU_ADDRESS 0xd0002c68 FORMAT "%7.2" /end MEASUREMENT
/begin MEASUREMENT maf_cyl_stk "air mass flow to cylinder" UWORD _CNV_A_R_LINEAR_____108_CM 1 100. 0. 1389. DISPLAY_IDENTIFIER MAF_CYL_STK ECU_ADDRESS 0xd0002c6c FORMAT "%7.2" /end MEASUREMENT
/begin MEASUREMENT map_mes "" UWORD _CNV_A_R_LINEAR_____26_CM 1 100. 0. 5434. DISPLAY_IDENTIFIER MAP_MES ECU_ADDRESS 0xd0002c70 FORMAT "%7.2" /end MEASUREMENT
/begin MEASUREMENT pq "" UWORD _CNV_A_R_LINEAR_____181_CM 1 100. 0. 0.9999847 DISPLAY_IDENTIFIER PQ ECU_ADDRESS 0xd0002c72 FORMAT "%7.5" /end MEASUREMENT
/begin MEASUREMENT maf_max_cor "" UWORD _CNV_A_R_LINEAR_____108_CM 1 100. 0. 1389. DISPLAY_IDENTIFIER MAF_MAX_COR ECU_ADDRESS 0xd0002c76 FORMAT "%7.2" /end MEASUREMENT
/begin MEASUREMENT maf_kgh_fg_pred "" UWORD _CNV_A_R_LINEAR_____207_CM 1 100. 0. 2047.96875 DISPLAY_IDENTIFIER MAF_KGH_FG_PRED ECU_ADDRESS 0xd0002c66 FORMAT "%7.2" /end MEASUREMENT
/begin MEASUREMENT pq_sp "PQ-setpoint" UWORD _CNV_A_R_LINEAR_____181_CM 1 100. 0. 0.9999847 DISPLAY_IDENTIFIER PQ_SP ECU_ADDRESS 0xd0002c88 FORMAT "%7.5" /end MEASUREMENT
/begin MEASUREMENT fac_ti_2_prs_hom "correction factor to compensate the influence of the varying pressure difference at the injector, 2. Pulse" UWORD _CNV_A_R_LINEAR_____115_CM 1 100. 0. 15.999755859375 DISPLAY_IDENTIFIER FAC_TI_2_PRS_HOM ECU_ADDRESS 0xd0002b0a FORMAT "%7.4" /end MEASUREMENT
/begin MEASUREMENT prs_inj_mv_2_hom "mean cylinder pressure during injection, 2. Pulse" UWORD _CNV_A_R_LINEAR_____152_CM 1 100. 0. 347776. DISPLAY_IDENTIFIER PRS_INJ_MV_2_HOM ECU_ADDRESS 0xc00023de FORMAT "%8.1" /end MEASUREMENT
/begin MEASUREMENT crk_inj_2_hom "rough value for injection angle (EOI-SOI), 2. pulse " UWORD _CNV_A_R_LINEAR_____168_CM 1 100. 0. 720. DISPLAY_IDENTIFIER CRK_INJ_2_HOM ECU_ADDRESS 0xc000236e FORMAT "%7.3" /end MEASUREMENT
/begin MEASUREMENT prs_dec_inj_2_hom "pressure difference at the injector, 2. pulse " UWORD _CNV_A_R_LINEAR_____152_CM 1 100. 0. 347776. DISPLAY_IDENTIFIER PRS_DEC_INJ_2_HOM ECU_ADDRESS 0xd0002b2c FORMAT "%8.1" /end MEASUREMENT
/begin AXIS_PTS ldp_eoi_ip_prs_inc_cmp "" 0xa10081a4 injr.STR_INJR_REQGNHOM2P0.eoi_2_hom[0] _REC_AXS_20_u2 720. _CNV_A_R_LINEAR_____168_CM 12 0. 720. FORMAT "%7.3" /end AXIS_PTS
/begin AXIS_PTS ldp_crk_inj_ip_prs_inc_cmp "" 0xa1008164 crk_inj_2_hom _REC_AXS_20_u2 720. _CNV_A_R_LINEAR_____168_CM 16 0. 720. FORMAT "%7.3" /end AXIS_PTS
/begin CHARACTERISTIC ip_prs_inc_cmp "Mean pressure increase in cylinder due to compression" MAP 0xa10086c0 _REC_MAP_20_u2_u2_u2 31.99951171875 _CNV_A_R_LINEAR_____243_CM 0. 31.99951171875 DISPLAY_IDENTIFIER IP_PRS_INC_CMP FORMAT "%9.6"
 /begin AXIS_DESCR COM_AXIS injr.STR_INJR_REQGNHOM2P0.eoi_2_hom[0] _CNV_A_R_LINEAR_____168_CM 12 0. 720. FORMAT "%7.3" AXIS_PTS_REF ldp_eoi_ip_prs_inc_cmp /end AXIS_DESCR
 /begin AXIS_DESCR COM_AXIS crk_inj_2_hom _CNV_A_R_LINEAR_____168_CM 16 0. 720. FORMAT "%7.3" AXIS_PTS_REF ldp_crk_inj_ip_prs_inc_cmp /end AXIS_DESCR
/end CHARACTERISTIC
/begin MEASUREMENT ti_2_hom_prs_tmp "fuel injection time without fuel pressure correction for homogeneous mode, 2. Pulse" UWORD _CNV_A_R_LINEAR_____233_CM 1 100. 0. 65.535 DISPLAY_IDENTIFIER TI_2_HOM_PRS_TMP ECU_ADDRESS 0xc00023f4 /end MEASUREMENT
/begin MEASUREMENT prs_dec_inj_1_s "pressure decrease at the injector, stratified mode 1. pulse " UWORD _CNV_A_R_LINEAR_____152_CM 1 100. 0. 347776. DISPLAY_IDENTIFIER PRS_DEC_INJ_1_S ECU_ADDRESS 0xd0002b2a FORMAT "%8.1" /end MEASUREMENT
/begin MEASUREMENT fac_ti_1_prs_s "factor  for correction of fuel injection time due to a change of press. decrease at the injector, strat. mode 1. pulse" UWORD _CNV_A_R_LINEAR_____115_CM 1 100. 0. 15.999755859375 DISPLAY_IDENTIFIER FAC_TI_1_PRS_S ECU_ADDRESS 0xd0002b08 FORMAT "%7.4" /end MEASUREMENT
/begin MEASUREMENT prs_inj_mv_1_s "mean cylinder pressure during injection, stratified mode 1. pulse" UWORD _CNV_A_R_LINEAR_____152_CM 1 100. 0. 347776. DISPLAY_IDENTIFIER PRS_INJ_MV_1_S ECU_ADDRESS 0xc00023dc FORMAT "%8.1" /end MEASUREMENT
/begin MEASUREMENT crk_inj_1_s "rough value for injection angle (EOI-SOI), stratified mode 1. pulse" UWORD _CNV_A_R_LINEAR_____168_CM 1 100. 0. 720. DISPLAY_IDENTIFIER CRK_INJ_1_S ECU_ADDRESS 0xc000236c FORMAT "%7.3" /end MEASUREMENT
/begin CHARACTERISTIC ip_prs_inc_cmp_s "Mean pressure increase in cylinder due to compression" MAP 0xa1008840 _REC_MAP_20_u2_u2_u2 31.99951171875 _CNV_A_R_LINEAR_____243_CM 0. 31.99951171875 DISPLAY_IDENTIFIER IP_PRS_INC_CMP_S FORMAT "%9.6"
 /begin AXIS_DESCR COM_AXIS injr.STR_INJR_REQGNS1P0.eoi_1_s[0] _CNV_A_R_LINEAR_____168_CM 12 0. 720. FORMAT "%7.3" AXIS_PTS_REF ldp_eoi_1_s_0_ip_prs_inc_cmp_s /end AXIS_DESCR
 /begin AXIS_DESCR COM_AXIS crk_inj_1_s _CNV_A_R_LINEAR_____168_CM 16 0. 720. FORMAT "%7.3" AXIS_PTS_REF ldp_crk_inj_1_s_ip_prs_inc_cmp /end AXIS_DESCR
/end CHARACTERISTIC
/begin AXIS_PTS ldp_crk_inj_1_s_ip_prs_inc_cmp "" 0xa1008140 crk_inj_1_s _REC_AXS_20_u2 720. _CNV_A_R_LINEAR_____168_CM 16 0. 720. FORMAT "%7.3" /end AXIS_PTS
/begin AXIS_PTS ldp_eoi_1_s_0_ip_prs_inc_cmp_s "" 0xa1008188 injr.STR_INJR_REQGNS1P0.eoi_1_s[0] _REC_AXS_20_u2 720. _CNV_A_R_LINEAR_____168_CM 12 0. 720. FORMAT "%7.3" /end AXIS_PTS
/begin MEASUREMENT fac_ti_2_prs_s "factor  for correction of fuel injection time due to a change of press. decrease at the injector, strat. mode 2. pulse" UWORD _CNV_A_R_LINEAR_____115_CM 1 100. 0. 15.999755859375 DISPLAY_IDENTIFIER FAC_TI_2_PRS_S ECU_ADDRESS 0xd0002b0c FORMAT "%7.4" /end MEASUREMENT
/begin MEASUREMENT prs_inj_mv_2_s "mean cylinder pressure during injection, stratified mode 2. pulse" UWORD _CNV_A_R_LINEAR_____152_CM 1 100. 0. 347776. DISPLAY_IDENTIFIER PRS_INJ_MV_2_S ECU_ADDRESS 0xc00023e0 FORMAT "%8.1" /end MEASUREMENT
/begin MEASUREMENT crk_inj_2_s "rough value for injection angle (EOI-SOI), stratified mode 2. pulse " UWORD _CNV_A_R_LINEAR_____168_CM 1 100. 0. 720. DISPLAY_IDENTIFIER CRK_INJ_2_S ECU_ADDRESS 0xc0002370 FORMAT "%7.3" /end MEASUREMENT
/begin MEASUREMENT prs_dec_inj_2_s "pressure decrease at the injector, stratified mode 2. pulse " UWORD _CNV_A_R_LINEAR_____152_CM 1 100. 0. 347776. DISPLAY_IDENTIFIER PRS_DEC_INJ_2_S ECU_ADDRESS 0xd0002b2e FORMAT "%8.1" /end MEASUREMENT
/begin MEASUREMENT tq_loss_alter "Torque losses by alternator" SWORD _CNV_A_R_LINEAR_____30_CM 1 100. -1024. 1023.96875 DISPLAY_IDENTIFIER TQ_LOSS_ALTER ECU_ADDRESS 0xd0004a54 FORMAT "%8.2" /end MEASUREMENT
/begin CHARACTERISTIC ip_tq_loss_alter "Corrected TQ_LOSS_ALTER of power management request" MAP 0xa100ac68 _REC_MAP_20_u2_u2_u1 2047.96875 _CNV_A_R_LINEAR_____65_CM -1024. 1023.96875 DISPLAY_IDENTIFIER IP_TQ_LOSS_ALTER FORMAT "%6.2"
 /begin AXIS_DESCR COM_AXIS tq_loss_alter_1 _CNV_A_R_LINEAR_____65_CM 6 -1024. 1023.96875 FORMAT "%6.2" AXIS_PTS_REF ldp_tq_loss_alter_1__tq_alter /end AXIS_DESCR
 /begin AXIS_DESCR COM_AXIS n_32 _CNV_A_R_LINEAR_____9_CM 6 0. 8160. FORMAT "%4.0" AXIS_PTS_REF ldp_n_32__tq_alter /end AXIS_DESCR
/end CHARACTERISTIC
/begin AXIS_PTS ldp_tq_loss_alter_1__tq_alter "" 0xa100ac40 tq_loss_alter_1 _REC_AXS_20_u2 2047.96875 _CNV_A_R_LINEAR_____65_CM 6 -1024. 1023.96875 FORMAT "%6.2" /end AXIS_PTS
/begin AXIS_PTS ldp_n_32__tq_alter "" 0xa100ac2a n_32 _REC_AXS_20_u1 816. _CNV_A_R_LINEAR_____9_CM 6 0. 8160. FORMAT "%4.0" /end AXIS_PTS
/begin CHARACTERISTIC c_tq_loss_alter_lih "Default-value in case of generator-error" VALUE 0xa100acce _REC_VAL_20_s2 2047.96875 _CNV_A_R_LINEAR_____30_CM -1024. 1023.96875 DISPLAY_IDENTIFIER C_TQ_LOSS_ALTER_LIH FORMAT "%7.1" /end CHARACTERISTIC
/begin MEASUREMENT ecraspwm "pwm for electrical radiator shutter" UBYTE _CNV_A_R_LINEAR_____5_CM 1 100. 0. 99.609375 DISPLAY_IDENTIFIER ECRASPWM ECU_ADDRESS 0xd0003897 FORMAT "%9.6" /end MEASUREMENT
/begin CHARACTERISTIC c_ecraspwm_max "PWM for radiator shutter in state ON" VALUE 0xa10037f5 _REC_VAL_20_u1 9.9609375 _CNV_A_R_LINEAR_____5_CM 0. 99.609375 DISPLAY_IDENTIFIER C_ECRASPWM_MAX FORMAT "%9.6" /end CHARACTERISTIC
/begin CHARACTERISTIC c_ecraspwm_min "PWM for radiator shutter in state OFF" VALUE 0xa10037f6 _REC_VAL_20_u1 9.9609375 _CNV_A_R_LINEAR_____5_CM 0. 99.609375 DISPLAY_IDENTIFIER C_ECRASPWM_MIN FORMAT "%9.6" /end CHARACTERISTIC
/begin MEASUREMENT tps_sp_mdl "Desired throttle angle based on customer intake model" UWORD _CNV_A_R_LINEAR_____221_CM 1 100. 0. 119.5 DISPLAY_IDENTIFIER TPS_SP_MDL ECU_ADDRESS 0xd0004bc4 FORMAT "%7.3" /end MEASUREMENT
/begin MEASUREMENT tps_sub_diag "Calculated Throttle Angle" UWORD _CNV_A_R_LINEAR_____221_CM 1 100. 0. 119.5 DISPLAY_IDENTIFIER TPS_SUB_DIAG ECU_ADDRESS 0xd0004bc6 FORMAT "%7.3" /end MEASUREMENT
/begin MEASUREMENT map_ctr "" UBYTE _CNV_A_R_LINEAR_____0_CM 1 100. 0. 255. DISPLAY_IDENTIFIER MAP_CTR ECU_ADDRESS 0xd0003bb4 FORMAT "%3.0" /end MEASUREMENT
/begin MEASUREMENT map_ctr_1 "" UBYTE _CNV_A_R_LINEAR_____0_CM 1 100. 0. 255. DISPLAY_IDENTIFIER MAP_CTR_1 ECU_ADDRESS 0xd0003bb5 FORMAT "%3.0" /end MEASUREMENT
/begin MEASUREMENT map_sum "" ULONG _CNV_A_R_LINEAR_____50_CM 1 100. 0. 4294967295. DISPLAY_IDENTIFIER MAP_SUM ECU_ADDRESS 0xd00057a4 FORMAT "%11.0" /end MEASUREMENT
/begin MEASUREMENT map_sum_1 "" ULONG _CNV_A_R_LINEAR_____50_CM 1 100. 0. 4294967295. DISPLAY_IDENTIFIER MAP_SUM_1 ECU_ADDRESS 0xd00057a8 FORMAT "%11.0" /end MEASUREMENT
/begin MEASUREMENT lv_map_seg "" UBYTE _CNV_S_2_RANGE__0___1_CM 1 100. 0. 1. DISPLAY_IDENTIFIER LV_MAP_SEG ECU_ADDRESS 0xd0003bb6 BIT_MASK 0x1 /end MEASUREMENT
/begin MEASUREMENT put_sum "Acquisition sum pressure up throttle, buffer " ULONG _CNV_A_R_LINEAR_____50_CM 1 100. 0. 4294967295. DISPLAY_IDENTIFIER PUT_SUM ECU_ADDRESS 0xd00057b4 FORMAT "%11.0" /end MEASUREMENT
/begin MEASUREMENT put_sum_1 "Acquisition sum pressure up throttle, buffer 1" ULONG _CNV_A_R_LINEAR_____50_CM 1 100. 0. 4294967295. DISPLAY_IDENTIFIER PUT_SUM_1 ECU_ADDRESS 0xd00057b8 FORMAT "%11.0" /end MEASUREMENT
/begin MEASUREMENT put_ctr "Number of PUT samples in buffer" UWORD _CNV_A_R_LINEAR_____0_CM 1 100. 0. 65535. DISPLAY_IDENTIFIER PUT_CTR ECU_ADDRESS 0xd0005026 FORMAT "%5.0" /end MEASUREMENT
/begin MEASUREMENT put_ctr_1 "Number of PUT samples in buffer 1" UWORD _CNV_A_R_LINEAR_____0_CM 1 100. 0. 65535. DISPLAY_IDENTIFIER PUT_CTR_1 ECU_ADDRESS 0xd0005028 FORMAT "%5.0" /end MEASUREMENT
/begin MEASUREMENT ptcha_1_ctr "Number of PTCHA_1 samples in buffer" UWORD _CNV_A_R_LINEAR_____0_CM 1 100. 0. 65535. DISPLAY_IDENTIFIER PTCHA_1_CTR ECU_ADDRESS 0xd000502a FORMAT "%5.0" /end MEASUREMENT
/begin MEASUREMENT ptcha_1_ctr_1 "Number of PTCHA_1 samples in buffer 1" UWORD _CNV_A_R_LINEAR_____0_CM 1 100. 0. 65535. DISPLAY_IDENTIFIER PTCHA_1_CTR_1 ECU_ADDRESS 0xd000502c FORMAT "%5.0" /end MEASUREMENT
/begin MEASUREMENT ptcha_1_sum "Acquisition sum pressure up charger 1, buffer" ULONG _CNV_A_R_LINEAR_____50_CM 1 100. 0. 4294967295. DISPLAY_IDENTIFIER PTCHA_1_SUM ECU_ADDRESS 0xd00057bc FORMAT "%11.0" /end MEASUREMENT
/begin MEASUREMENT ptcha_1_sum_1 "Acquisition sum pressure up charger 1, buffer1" ULONG _CNV_A_R_LINEAR_____50_CM 1 100. 0. 4294967295. DISPLAY_IDENTIFIER PTCHA_1_SUM_1 ECU_ADDRESS 0xd00057c0 FORMAT "%11.0" /end MEASUREMENT
/begin MEASUREMENT ptcha_2_ctr "Number of PTCHA_2 samples in buffer" UWORD _CNV_A_R_LINEAR_____0_CM 1 100. 0. 65535. DISPLAY_IDENTIFIER PTCHA_2_CTR ECU_ADDRESS 0xd000502e FORMAT "%5.0" /end MEASUREMENT
/begin MEASUREMENT ptcha_2_ctr_1 "Number of PTCHA_2 samples in buffer 1" UWORD _CNV_A_R_LINEAR_____0_CM 1 100. 0. 65535. DISPLAY_IDENTIFIER PTCHA_2_CTR_1 ECU_ADDRESS 0xd0005030 FORMAT "%5.0" /end MEASUREMENT
/begin MEASUREMENT ptcha_2_sum "Acquisition sum pressure up charger 2, buffer" ULONG _CNV_A_R_LINEAR_____50_CM 1 100. 0. 4294967295. DISPLAY_IDENTIFIER PTCHA_2_SUM ECU_ADDRESS 0xd00057c4 FORMAT "%11.0" /end MEASUREMENT
/begin MEASUREMENT ptcha_2_sum_1 "Acquisition sum pressure up charger 2, buffer1" ULONG _CNV_A_R_LINEAR_____50_CM 1 100. 0. 4294967295. DISPLAY_IDENTIFIER PTCHA_2_SUM_1 ECU_ADDRESS 0xd00057c8 FORMAT "%11.0" /end MEASUREMENT
/begin COMPU_METHOD _CNV_A_R_LINEAR_____0_CM "" RAT_FUNC "%6.3" "-" COEFFS 0 1. 0. 0 0 1 /end COMPU_METHOD
/begin COMPU_METHOD _CNV_S_2_RANGE__0___1_CM "" TAB_VERB "%6.3" "-" COMPU_TAB_REF _CNV_S_2_RANGE__0___1 /end COMPU_METHOD
/begin COMPU_VTAB _CNV_S_2_RANGE__0___1 "" TAB_VERB 2 0 "0" 1 "1" /end COMPU_VTAB
/begin COMPU_METHOD _CNV_A_R_LINEAR_____2_CM "" RAT_FUNC "%6.3" "V" COEFFS 0 204.8 0. 0 0 1 /end COMPU_METHOD
/begin COMPU_METHOD _CNV_A_R_LINEAR_____4_CM "" RAT_FUNC "%6.3" "s" COEFFS 0 10. 0. 0 0 1 /end COMPU_METHOD
/begin COMPU_METHOD _CNV_A_R_LINEAR_____5_CM "" RAT_FUNC "%6.3" "%" COEFFS 0 2.56 0. 0 0 1 /end COMPU_METHOD
/begin COMPU_METHOD _CNV_A_R_LINEAR_____6_CM "" RAT_FUNC "%6.3" "km/h" COEFFS 0 1. 0. 0 0 1 /end COMPU_METHOD
/begin COMPU_METHOD _CNV_A_R_LINEAR_____7_CM "" RAT_FUNC "%6.3" "%" COEFFS 0 655.3599999999997 0. 0 0 1 /end COMPU_METHOD
/begin COMPU_METHOD _CNV_A_R_LINEAR_____9_CM "" RAT_FUNC "%6.3" "rpm" COEFFS 0 3.125e-002 0. 0 0 1 /end COMPU_METHOD
/begin COMPU_METHOD _CNV_A_R_LINEAR_____13_CM "" RAT_FUNC "%6.3" "rpm" COEFFS 0 1. 0. 0 0 1 /end COMPU_METHOD
/begin COMPU_METHOD _CNV_A_R_LINEAR_____16_CM "" RAT_FUNC "%6.3" "°C" COEFFS 0 1.333333333333333 64. 0 0 1 /end COMPU_METHOD
/begin COMPU_METHOD _CNV_A_R_LINEAR_____18_CM "" RAT_FUNC "%6.3" "ms" COEFFS 0 0.1 0. 0 0 1 /end COMPU_METHOD
/begin COMPU_METHOD _CNV_A_R_LINEAR_____24_CM "" RAT_FUNC "%6.3" "°C" COEFFS 0 1.333333333333333 0. 0 0 1 /end COMPU_METHOD
/begin COMPU_METHOD _CNV_A_R_LINEAR_____25_CM "" RAT_FUNC "%6.3" "°C" COEFFS 0 1. 40. 0 0 1 /end COMPU_METHOD
/begin COMPU_METHOD _CNV_A_R_LINEAR_____26_CM "" RAT_FUNC "%6.3" "hPa" COEFFS 0 12.06017666543982 0. 0 0 1 /end COMPU_METHOD
/begin COMPU_METHOD _CNV_A_R_LINEAR_____27_CM "" RAT_FUNC "%6.3" "-" COEFFS 0 256. 0. 0 0 1 /end COMPU_METHOD
/begin COMPU_METHOD _CNV_A_R_LINEAR_____30_CM "" RAT_FUNC "%6.3" "Nm" COEFFS 0 32. 0. 0 0 1 /end COMPU_METHOD
/begin COMPU_METHOD _CNV_A_R_LINEAR_____35_CM "" RAT_FUNC "%6.3" "s" COEFFS 0 1. 0. 0 0 1 /end COMPU_METHOD
/begin COMPU_METHOD _CNV_A_R_LINEAR_____50_CM "" RAT_FUNC "%6.3" "" COEFFS 0 1. 0. 0 0 1 /end COMPU_METHOD
/begin COMPU_METHOD _CNV_A_R_LINEAR_____65_CM "" RAT_FUNC "%6.3" "Nm" COEFFS 0 32. 32768. 0 0 1 /end COMPU_METHOD
/begin COMPU_METHOD _CNV_A_R_LINEAR_____68_CM "" RAT_FUNC "%6.3" "-" COEFFS 0 65535.99999999996 0. 0 0 1 /end COMPU_METHOD
/begin COMPU_METHOD _CNV_A_R_LINEAR_____70_CM "" RAT_FUNC "%6.3" "km" COEFFS 0 0.1 0. 0 0 1 /end COMPU_METHOD
/begin COMPU_METHOD _CNV_A_R_LINEAR_____78_CM "" RAT_FUNC "%6.3" "s" COEFFS 0 5. 0. 0 0 1 /end COMPU_METHOD
/begin COMPU_METHOD _CNV_A_R_LINEAR_____100_CM "" RAT_FUNC "%6.3" "-" COEFFS 0 128. 0. 0 0 1 /end COMPU_METHOD
/begin COMPU_METHOD _CNV_A_R_LINEAR_____108_CM "" RAT_FUNC "%6.3" "mg/stk" COEFFS 0 47.18142548596112 0. 0 0 1 /end COMPU_METHOD
/begin COMPU_METHOD _CNV_A_R_LINEAR_____115_CM "" RAT_FUNC "%6.3" "-" COEFFS 0 4096. 0. 0 0 1 /end COMPU_METHOD
/begin COMPU_METHOD _CNV_A_R_LINEAR_____123_CM "" RAT_FUNC "%6.3" "°C" COEFFS 0 16. 0. 0 0 1 /end COMPU_METHOD
/begin COMPU_METHOD _CNV_A_R_LINEAR_____152_CM "" RAT_FUNC "%6.3" "hPa" COEFFS 0 0.1884402603974972 0. 0 0 1 /end COMPU_METHOD
/begin COMPU_METHOD _CNV_A_R_LINEAR_____168_CM "" RAT_FUNC "%6.3" "°CRK" COEFFS 0 2.666666666666667 0. 0 0 1 /end COMPU_METHOD
/begin COMPU_METHOD _CNV_A_R_LINEAR_____181_CM "" RAT_FUNC "%6.3" "-" COEFFS 0 65536.00270084133 0. 0 0 1 /end COMPU_METHOD
/begin COMPU_METHOD _CNV_A_R_LINEAR_____201_CM "" RAT_FUNC "%6.3" "%" COEFFS 0 327.68 0. 0 0 1 /end COMPU_METHOD
/begin COMPU_METHOD _CNV_A_R_LINEAR_____207_CM "" RAT_FUNC "%6.3" "kg/h" COEFFS 0 32. 0. 0 0 1 /end COMPU_METHOD
/begin COMPU_METHOD _CNV_A_R_LINEAR_____221_CM "" RAT_FUNC "%6.3" "°TPS" COEFFS 0 137.0962343096234 0. 0 0 1 /end COMPU_METHOD
/begin COMPU_METHOD _CNV_A_R_LINEAR_____233_CM "" RAT_FUNC "%6.3" "ms" COEFFS 0 1000. 0. 0 0 1 /end COMPU_METHOD
/begin COMPU_METHOD _CNV_A_R_LINEAR_____243_CM "" RAT_FUNC "%6.3" "-" COEFFS 0 2048. 0. 0 0 1 /end COMPU_METHOD
/begin COMPU_METHOD _CNV_A_R_LACO_LINEA_378_CM "" RAT_FUNC "%6.3" "°C" COEFFS 0 341.3333333333333 0. 0 0 1 /end COMPU_METHOD
/begin COMPU_METHOD _CNV_A_R_LINEAR_____401_CM "" RAT_FUNC "%6.3" "µs" COEFFS 0 1. 0. 0 0 1 /end COMPU_METHOD
/begin COMPU_METHOD _CNV_A_R_LINEAR_____424_CM "" RAT_FUNC "%6.3" "1/tdc" COEFFS 0 1. 0. 0 0 1 /end COMPU_METHOD
/begin COMPU_METHOD _CNV_A_R_MISF_LINEA_432_CM "" RAT_FUNC "%6.3" "km/h/rpm" COEFFS 0 5100. 0. 0 0 1 /end COMPU_METHOD
/begin COMPU_METHOD _CNV_A_R_LINEAR_____433_CM "" RAT_FUNC "%6.3" "µs" COEFFS 0 0.125 0. 0 0 1 /end COMPU_METHOD
/begin COMPU_METHOD _CNV_A_R_LINEAR_____434_CM "" RAT_FUNC "%6.3" "%." COEFFS 0 65.5359830397456 0. 0 0 1 /end COMPU_METHOD
/begin COMPU_METHOD _CNV_A_R_LINEAR_____435_CM "" RAT_FUNC "%6.3" "%." COEFFS 0 65.77254901960784 0. 0 0 1 /end COMPU_METHOD
/begin COMPU_METHOD _CNV_A_R_LINEAR_____448_CM "" RAT_FUNC "%6.3" "%" COEFFS 0 81.92 0. 0 0 1 /end COMPU_METHOD
/begin COMPU_METHOD _CNV_A_R_LINEAR_____449_CM "" RAT_FUNC "%6.3" "*100ms" COEFFS 0 1. 0. 0 0 1 /end COMPU_METHOD
/begin COMPU_METHOD _CNV_A_R_LINEAR_____450_CM "" RAT_FUNC "%6.3" "hPa" COEFFS 0 12.06017666543982 32767.5 0 0 1 /end COMPU_METHOD
/begin COMPU_METHOD _CNV_A_R_LINEAR_____452_CM "" RAT_FUNC "%6.3" "°C" COEFFS 0 341.3333333333333 16384. 0 0 1 /end COMPU_METHOD
/begin COMPU_METHOD _CNV_A_R_LINEAR_____453_CM "" RAT_FUNC "%6.3" "-" COEFFS 0 5. 0. 0 0 1 /end COMPU_METHOD
/begin COMPU_METHOD _CNV_A_R_LINEAR_____454_CM "" RAT_FUNC "%6.3" "-" COEFFS 0 51.20008995153059 0. 0 0 1 /end COMPU_METHOD
/begin COMPU_METHOD _CNV_A_R_ENTE_LINEA_455_CM "" RAT_FUNC "%6.3" "°C" COEFFS 0 1.333333333333333 128. 0 0 1 /end COMPU_METHOD
/begin COMPU_METHOD _CNV_A_R_LINEAR_____456_CM "" RAT_FUNC "%6.3" "W" COEFFS 0 -5.e-002 0. 0 0 1 /end COMPU_METHOD
/begin COMPU_METHOD _CNV_A_R_CPULOAD__0_461_CM "" RAT_FUNC "%6.3" "%" COEFFS 0 10.24 0. 0 0 1 /end COMPU_METHOD
/begin COMPU_METHOD _CNV_A_R_CPULOAD____462_CM "" RAT_FUNC "%6.3" "ticks" COEFFS 0 1. 0. 0 0 1 /end COMPU_METHOD
/begin COMPU_METHOD _CNV_A_R_INJR_LINEA_473_CM "" RAT_FUNC "%6.3" "°CRK/ms" COEFFS 0 166.6666666666667 0. 0 0 1 /end COMPU_METHOD
/begin COMPU_METHOD _CNV_S_8_C_INJ_MOD__474_CM "" TAB_VERB "%6.3" "-" COMPU_TAB_REF _CNV_S_8_C_INJ_MOD__474 /end COMPU_METHOD
/begin COMPU_VTAB _CNV_S_8_C_INJ_MOD__474 "" TAB_VERB 8 0 "C_INJ_MOD_SP_MAN__SNGH" 1 "C_INJ_MOD_SP_MAN__MPLH" 2 "C_INJ_MOD_SP_MAN__HOMS" 3 "C_INJ_MOD_SP_MAN__HOMS_MPLP" 4 "C_INJ_MOD_SP_MAN__SNGS" 5 "C_INJ_MOD_SP_MAN__MPLS" 6 "C_INJ_MOD_SP_MAN__SNGS_MPLP" 7 "C_INJ_MOD_SP_MAN__MPLS_MPLP" /end COMPU_VTAB
/begin COMPU_METHOD _CNV_A_R_INJR_LINEA_476_CM "" RAT_FUNC "%6.3" "ms" COEFFS 0 1000. 32768. 0 0 1 /end COMPU_METHOD
/begin COMPU_METHOD _CNV_A_R_INJR_LINEA_480_CM "" RAT_FUNC "%6.3" "%" COEFFS 0 163.84 0. 0 0 1 /end COMPU_METHOD
/begin RECORD_LAYOUT _REC_VAL_20_u1 FNC_VALUES 1 UBYTE COLUMN_DIR DIRECT /end RECORD_LAYOUT
/begin RECORD_LAYOUT _REC_VAL_20_u2 FNC_VALUES 1 UWORD COLUMN_DIR DIRECT /end RECORD_LAYOUT
/begin RECORD_LAYOUT _REC_AXS_20_u1 NO_AXIS_PTS_X 1 UBYTE AXIS_PTS_X 2 UBYTE INDEX_INCR DIRECT /end RECORD_LAYOUT
/begin RECORD_LAYOUT _REC_MAP_20_u2_u1_u1 FNC_VALUES 1 UWORD COLUMN_DIR DIRECT /end RECORD_LAYOUT
/begin RECORD_LAYOUT _REC_CUR_20_u1_u1 FNC_VALUES 1 UBYTE COLUMN_DIR DIRECT /end RECORD_LAYOUT
/begin RECORD_LAYOUT _REC_VAL_20_s2 FNC_VALUES 1 SWORD COLUMN_DIR DIRECT /end RECORD_LAYOUT
/begin RECORD_LAYOUT _REC_MAP_20_u2_u2_u1 FNC_VALUES 1 UWORD COLUMN_DIR DIRECT /end RECORD_LAYOUT
/begin RECORD_LAYOUT _REC_AXS_20_u2 NO_AXIS_PTS_X 1 UWORD AXIS_PTS_X 2 UWORD INDEX_INCR DIRECT /end RECORD_LAYOUT
/begin RECORD_LAYOUT _REC_CUR_20_u2_u1 FNC_VALUES 1 UWORD COLUMN_DIR DIRECT /end RECORD_LAYOUT
/begin RECORD_LAYOUT _REC_CUR_20_u2_u2 FNC_VALUES 1 UWORD COLUMN_DIR DIRECT /end RECORD_LAYOUT
/begin RECORD_LAYOUT _REC_VAL_20_s1 FNC_VALUES 1 SBYTE COLUMN_DIR DIRECT /end RECORD_LAYOUT
/begin RECORD_LAYOUT _REC_MAP_20_u2_u1_u2 FNC_VALUES 1 UWORD COLUMN_DIR DIRECT /end RECORD_LAYOUT
/begin RECORD_LAYOUT _REC_CUR_20_u1_u2 FNC_VALUES 1 UBYTE COLUMN_DIR DIRECT /end RECORD_LAYOUT
/begin RECORD_LAYOUT _REC_MAP_20_u2_u2_u2 FNC_VALUES 1 UWORD COLUMN_DIR DIRECT /end RECORD_LAYOUT
/begin RECORD_LAYOUT _REC_MAP_20_u1_u2_u2 FNC_VALUES 1 UBYTE COLUMN_DIR DIRECT /end RECORD_LAYOUT
/begin RECORD_LAYOUT _REC_MAP_20_u1_u1_u1 FNC_VALUES 1 UBYTE COLUMN_DIR DIRECT /end RECORD_LAYOUT
/begin FUNCTION MISF__Misf_Rate_Det_ERRM_Inci ""
 /begin DEF_CHARACTERISTIC lc_ctr_conf_diag_mis lc_ctr_conf_osc_mis lc_conf_err_mis_ftl_l c_teg_cat_up_mis_a_max /end DEF_CHARACTERISTIC
 /begin OUT_MEASUREMENT lv_mis_a_diag_req_app lv_mis_b_diag_req_app fac_mis_a_app fac_mis_a_thd_ind_app fac_mis_sum_a_thd_app fac_mis_sum_b1_thd_app fac_mis_sum_b4_thd_app lv_inh_igc_diag_mis lv_req_app_ctr_mis_a seg_nr_cbk_er lv_inh_iv_diag_mis lv_cdn_mis_b1 lv_cdn_mis_a lv_cdn_mis_b4 lv_err_mis_mpl lv_err_mis_ftl_l lv_err_mis_1 lv_err_mis_2 lv_err_mis_3 lv_err_mis_4 lv_err_mis_5 lv_err_mis_0 load_max_scdn_mis load_min_scdn_mis n_min_scdn_mis n_max_scdn_mis ctr_mis_det ctr_seg_mis_act ctr_mis_det_cyl[0] ctr_mis_det_cyl[1] ctr_mis_det_cyl[2] ctr_mis_det_cyl[3] ctr_mis_det_cyl[4] ctr_mis_det_cyl[5] /end OUT_MEASUREMENT
/end FUNCTION
/begin FUNCTION MISF__Crankshaft_Oscil_Detect ""
 /begin DEF_CHARACTERISTIC c_dly_tdc_crk_osc c_n_max_crk_osc c_nr_tdc_max_crk_osc ldp_n_32_ip_seg_min_frq_crk_osc ldp_n_32_ip_drv0_er_thd_osc ldp_load_mis_ip_drv0_er_thd_osc ip_seg_min_frq_crk_osc ip_drv0_er_thd_osc c_ratio_vs_n_min_crk_osc /end DEF_CHARACTERISTIC
 /begin OUT_MEASUREMENT lv_state_crk_osc drv0_er_sum_osc drv0_er_sum_thd_osc ctr_tdc_crk_osc_act seg_sum_frq_crk_osc lv_crk_osc_det_act lv_frq_crit_crk_osc lv_ampl_crit_crk_osc ratio_vs_n_crk_osc /end OUT_MEASUREMENT
/end FUNCTION
/begin FUNCTION MISF__Rough_Road_Inter_For_Misf ""
 /begin DEF_CHARACTERISTIC c_vs_min_rr c_vs_max_rr c_wheel_grd_crlc_rr c_dly_er_rr ip_wheel_grd_mmv_thd_at__vs ip_wheel_grd_mmv_thd_mt__vs /end DEF_CHARACTERISTIC
 /begin OUT_MEASUREMENT lv_state_rr seg_t_mes_0_rr seg_t_mes_1_rr wheel_grd_mmv wheel_grd_mmv_thd sum_rr /end OUT_MEASUREMENT
/end FUNCTION
/begin FUNCTION C_F_MISF "" /begin SUB_FUNCTION MISF__Misfire_Tuning_Functions /end SUB_FUNCTION /end FUNCTION
/begin FUNCTION MISF__Misfire_Tuning_Functions ""
 /begin DEF_CHARACTERISTIC c_mis_rate lc_req_mis_gen lc_mod_mis_gen lc_ign_off_mis_gen lc_inj_off_mis_gen c_seg_st_mis_gen ldp_x_id_rnd_pat_mis_gen ldp_y_id_rnd_pat_mis_gen id_rnd_pat_mis_gen /end DEF_CHARACTERISTIC
 /begin OUT_MEASUREMENT inh_iv_mis_gen inh_igc_mis_gen lv_mis_gen /end OUT_MEASUREMENT
/end FUNCTION
/begin FUNCTION VVTLAYER ""
 /begin OUT_MEASUREMENT ang_rel_sp_ecu_vvl lv_ti_lim_act fac_eoi_opm_sel lv_mplp_ena lv_mplp_act lv_mplh_act lv_eoi_2_delta_hom_cus maf_egr maf_mdl_mv maf_cyl_stk map_mes pq maf_max_cor maf_kgh_fg_pred pq_sp tps_sp_mdl tps_sub_diag map_ctr map_ctr_1 map_sum map_sum_1 lv_map_seg put_sum put_sum_1 put_ctr put_ctr_1 ptcha_1_ctr ptcha_1_ctr_1 ptcha_1_sum ptcha_1_sum_1 ptcha_2_ctr ptcha_2_ctr_1 ptcha_2_sum ptcha_2_sum_1 /end OUT_MEASUREMENT
/end FUNCTION
/begin FUNCTION C_D_TQLO "C_D_TQLO" /begin DEF_CHARACTERISTIC ldpm_n_100 ldpm_maf_cyl_stk__tqfr /end DEF_CHARACTERISTIC
 /begin SUB_FUNCTION TQLO_Coordination_of_additional_torque_losses TQLO_Torque_Losses /end SUB_FUNCTION
/end FUNCTION
/begin FUNCTION TQLO_Coordination_of_additional_torque_losses "_Coordination_of_additional_torque_losses"
 /begin DEF_CHARACTERISTIC ip_tqfr_delta_eng_new ip_tqfr_delta_amp_opm_1 ip_tqfr_delta_amp_opm_2 /end DEF_CHARACTERISTIC
 /begin OUT_MEASUREMENT tq_loss_add_cus tq_loss_add /end OUT_MEASUREMENT
/end FUNCTION
/begin FUNCTION TQLO_Torque_Losses "_Torque_Losses"
 /begin DEF_CHARACTERISTIC c_maf_cyl_stk_ref c_crlc_tq_loss_req_clu ldpm_tco_st_1_tqlo ldpm_n_ip_tqfr ldpm_maf_cyl_stk_ip_tqfr ip_tqfr_vvl ip_tqfr ldp_tco_ip_tqfr_add ldp_opm_av_tqlo ldp_opm_req_tqlo id_tq_loss_opm_av id_tq_loss_opm_req ip_tqfr_add_opm_1 ip_tqfr_add_opm_2 ip_tqfr_dec_st_opm_1 ip_tqfr_dec_st_opm_2 ip_tqfr_st_opm_1 ip_tqfr_st_opm_2 ldpm_tco_ip_tqfr_add id_idx_opm_tqfr_st id_idx_opm_tqfr_delta_amp ip_tq_loss_alter c_tq_loss_alter_lih /end DEF_CHARACTERISTIC
 /begin OUT_MEASUREMENT tq_loss_req_clu tqfr_add tqfr_st tqfr_mec tq_loss lv_opm_sel_tqlo_1 lv_opm_sel_tqlo_2 lv_tq_loss_opm_rls tqfr tqfr_delta_add tq_loss_alter /end OUT_MEASUREMENT
/end FUNCTION
/begin FUNCTION C_8_TQLO "C_8_TQLO"
 /begin SUB_FUNCTION TQLO_Adaptation_Algorithm TQLO_Adaption_Condition TQLO_Application_Incidence /end SUB_FUNCTION
/end FUNCTION
/begin FUNCTION TQLO_Adaptation_Algorithm "_Adaptation_Algorithm"
 /begin DEF_CHARACTERISTIC c_tq_dif_is_ad_conv_min c_tq_dif_is_ad_acc_max c_tq_dif_is_ad_acc_min c_tq_dif_is_ad_max c_tq_dif_is_ad_min c_tq_dif_is_ad_acc_conv_max c_tq_dif_is_ad_conv_max c_tq_dif_is_ad_acc_conv_min c_crlc_tq_dif_is_ad_acc c_fac_tq_dif_is_ad_acc c_fac_tq_dif_is_ad_conv c_fac_tq_dif_is_ad_acc_conv c_fac_tq_dif_is_ad /end DEF_CHARACTERISTIC
 /begin OUT_MEASUREMENT tq_dif_is_ad_acc_1 tq_dif_is_ad_acc_conv nvmy_tqlo.nvmy_dtsysisad.tq_dif_is_ad nvmy_tqlo.nvmy_dtsysisad.tq_dif_is_ad_conv nvmy_tqlo.nvmy_dtsysisad.tq_dif_is_ad_acc /end OUT_MEASUREMENT
/end FUNCTION
/begin FUNCTION TQLO_Adaption_Condition "_Adaption_Condition" /begin DEF_CHARACTERISTIC c_tco_ad_max_is c_tco_ad_min_is c_n_delta c_dly_ad_is /end DEF_CHARACTERISTIC /begin OUT_MEASUREMENT lv_tco_ad_cdn_is lv_ad_cdn_is lv_dly_ad_is /end OUT_MEASUREMENT /end FUNCTION
/begin FUNCTION TQLO_Application_Incidence "_Application_Incidence" /begin OUT_MEASUREMENT lv_is_ad_inh lv_is_ad_inh_obd /end OUT_MEASUREMENT /end FUNCTION
/begin FUNCTION C_4_ENTE ""
 /begin SUB_FUNCTION ENTE_coolant_temp ENTE_coolant_temp_radiat_outlet ENTE_coolant_temp_subs_model /end SUB_FUNCTION
/end FUNCTION
/begin FUNCTION ENTE_coolant_temp "coolant_temp"
 /begin DEF_CHARACTERISTIC ldp_v_tco_ip_tco_mes ip_tco_mes c_tco_mes_grd_max c_tco_ini_tia_im ldp_tia_im_ip_tco_ini_tia_im ip_tco_ini_tia_im /end DEF_CHARACTERISTIC
 /begin OUT_MEASUREMENT tco_mes tco_st tco lv_cdn_ini_tco tco_stop v_tco /end OUT_MEASUREMENT
/end FUNCTION
/begin FUNCTION ENTE_coolant_temp_radiat_outlet "coolant_temp_radiat_outlet"
 /begin DEF_CHARACTERISTIC ldp_v_tco_2_ip_tco_2_mes ip_tco_2_mes c_tco_2_mes_grd_max c_tco_2_dif_tco /end DEF_CHARACTERISTIC
 /begin OUT_MEASUREMENT tco_2_mes tco_2_st tco_2 tco_1_2 lv_cdn_ini_tco_2 v_tco_2 /end OUT_MEASUREMENT
/end FUNCTION
/begin FUNCTION ENTE_coolant_temp_subs_model "coolant_temp_subs_model"
 /begin DEF_CHARACTERISTIC c_t_dly_tco_sub_is_2 c_t_dly_tco_sub_puc ip_tco_sub_inc ldp_maf_kgh_ip_tco_sub_inc ldp_maf_kgh_ip_fac_tco_sub_inc ip_tco_sub_dec ldp_tco_sub_ip_fac_tco_sub_inc ldp_tam_ip_tco_sub_inc ldp_tam_ip_tco_sub_dec c_fac_tco_sub_cor ip_fac_tco_sub_inc ldp_tco_sub_ip_tco_sub_dec ldp_n_rel_cwp_ip_fac_tco_sub ip_fac_tco_sub_cor_n_rel_cwp c_t_dly_tco_sub_is_1 c_fac_tco_sub_cor_state_coc c_t_dly_tco_sub_cor_state_coc c_t_dly_tco_sub_st_cwp_off c_t_dly_tco_sub_st_cwp_on c_n_rel_cwp_thd_coc /end DEF_CHARACTERISTIC
 /begin OUT_MEASUREMENT lv_cdn_ena_tco_sub tco_sub tco_sub_inc fac_tco_sub_cor_n_rel_cwp fac_tco_sub_cor fac_tco_sub_cor_state_coc t_dly_tco_sub t_dly_tco_sub_cor_state_coc t_dly_thd_tco_sub_st /end OUT_MEASUREMENT
/end FUNCTION
/begin FUNCTION C_9_ENTE "" /begin DEF_CHARACTERISTIC ldpm_tco_st_1_ente /end DEF_CHARACTERISTIC
 /begin SUB_FUNCTION ENTE_cooling_fan_control ENTE_coolant_temp_setpoint ENTE_coolant_temp_setpoint_AI ENTE_coolant_temp_gradient ENTE_elect_ctrl_therm ENTE_elect_ctrl_therm_AI /end SUB_FUNCTION
/end FUNCTION
/begin FUNCTION ENTE_cooling_fan_control "cooling_fan_control"
 /begin DEF_CHARACTERISTIC c_t_n_perc_ecf_act c_n_perc_act_ecf c_ecfpwm_ecf_man lc_ecfpwm_ecf_man /end DEF_CHARACTERISTIC
 /begin OUT_MEASUREMENT ecfpwm_igk_off ecfpwm[0] t_n_perc_ecf_act /end OUT_MEASUREMENT
/end FUNCTION
/begin FUNCTION ENTE_coolant_temp_setpoint "coolant_temp_setpoint" /end FUNCTION
/begin FUNCTION ENTE_coolant_temp_setpoint_AI "coolant_temp_setpoint_AI" /end FUNCTION
/begin FUNCTION ENTE_coolant_temp_gradient "coolant_temp_gradient" /end FUNCTION
/begin FUNCTION ENTE_elect_ctrl_therm "elect_ctrl_therm"
 /begin DEF_CHARACTERISTIC lc_ectpwm_man c_ectpwm_man c_ectpwm_ast c_t_ectpwm_ast c_tco_ectpwm c_ecraspwm_max c_ecraspwm_min /end DEF_CHARACTERISTIC
 /begin OUT_MEASUREMENT ectpwm ecraspwm /end OUT_MEASUREMENT
/end FUNCTION
/begin FUNCTION ENTE_elect_ctrl_therm_AI "elect_ctrl_therm_AI" /end FUNCTION
/begin FUNCTION C_B_ENTE "C_B_ENTE"
 /begin SUB_FUNCTION ENTE_coolant_temp_plaus_diag ENTE_coolant_therm_monitoring ENTE_elec_ctl_therm_ratio_chk ENTE_coolant_temp_plaus_diag_AI ENTE_coolant_therm_monitoring_AI ENTE_elec_ctl_therm_ratio_chk_AI ENTE_TCO_sensor_plaus_diag ENTE_TCO_sensor_plaus_diag_AI ENTE_coolant_temp_low_rat_chk /end SUB_FUNCTION
/end FUNCTION
/begin FUNCTION ENTE_coolant_temp_plaus_diag "coolant_temp_plaus_diag"
 /begin DEF_CHARACTERISTIC id_tco_min_diag_tco_plaus ldp_tco_st_id_tco_min_diag_plaus id_t_min_diag_tco_plaus ldp_tia_thr_st_id_t_tco_plaus ldp_ratio_t_is_ast_id_tco_diag /end DEF_CHARACTERISTIC
 /begin OUT_MEASUREMENT lv_err_tco_plaus t_min_diag_tco_plaus t_ast_diag_tco_plaus lv_end_diag_rbm_tco_plaus lv_inh_diag_tco_plaus lv_inh_diag_rbm_tco_plaus state_rbm_tco_plaus /end OUT_MEASUREMENT
/end FUNCTION
/begin FUNCTION ENTE_coolant_therm_monitoring "coolant_therm_monitoring"
 /begin DEF_CHARACTERISTIC c_tia_st_min_diag_th c_ratio_t_puc_thd_diag_th c_ratio_t_vs_max_thd_diag_th c_ratio_t_vs_min_thd_diag_th c_ratio_t_load_min_thd_diag_th c_n_max_diag_th c_t_tco_de_diag_th c_tco_st_max_diag_th c_tia_de_max_diag_th c_tco_de_max_diag_th c_tco_th_open_diag_th c_tco_st_min_diag_th c_tco_wup_min_diag_th /end DEF_CHARACTERISTIC
 /begin OUT_MEASUREMENT lv_err_th tia_min_diag_th t_tco_de_diag_th tia_de_diag_th tco_de_ini_diag_th lv_tco_de_max_diag_th tco_de_diag_th tco_diag_th lv_end_diag_rbm_th lv_act_diag_th lv_act_diag_rbm_th lv_cnl_diag_th lv_cdn_temp_diag_th /end OUT_MEASUREMENT
/end FUNCTION
/begin FUNCTION ENTE_elec_ctl_therm_ratio_chk "elec_ctl_therm_ratio_chk" /end FUNCTION
/begin FUNCTION ENTE_coolant_temp_plaus_diag_AI "coolant_temp_plaus_diag_AI" /end FUNCTION
/begin FUNCTION ENTE_coolant_therm_monitoring_AI "coolant_therm_monitoring_AI" /end FUNCTION
/begin FUNCTION ENTE_elec_ctl_therm_ratio_chk_AI "elec_ctl_therm_ratio_chk_AI"
 /begin DEF_CHARACTERISTIC c_abc_inc_th c_abc_max_th c_tia_de_max_inh_diag_th c_tam_min_diag_th c_n_rel_cwp_min_diag_th c_mass_vol_cwp_min_diag_th c_mass_vol_cwp_max c_t_ectpwm_inh_diag_th c_t_ecfpwm_inh_diag_th c_ectpwm_inh_diag_th c_ecfpwm_inh_diag_th[0] ldp_tco_sub_id_n_rel_cwp_max id_n_rel_cwp_max_diag_th c_t_n_rel_cwp_max_diag_th /end DEF_CHARACTERISTIC
 /begin OUT_MEASUREMENT state_rbm_th lv_inh_diag_th lv_inh_diag_rbm_th lv_n_rel_cwp_inh_diag_th lv_tia_de_inh_diag_th mass_vol_cwp_diag_th tia_min_inh_diag_th tia_de_inh_diag_th mass_vol_cwp_diag_th_tmp t_ectpwm_inh_diag_th t_ecfpwm_inh_diag_th lv_ectpwm_inh_diag_th lv_ecfpwm_inh_diag_th t_n_rel_cwp_max_diag_th /end OUT_MEASUREMENT
/end FUNCTION
/begin FUNCTION ENTE_TCO_sensor_plaus_diag "TCO_sensor_plaus_diag"
 /begin DEF_CHARACTERISTIC ldp_tco_st_ip_ctr_tco_2_plaus c_t_dly_tco_2_plaus c_tco_2_dif_min_tco_2_plaus c_vs_min_tco_2_plaus c_n_min_tco_2_plaus c_tco_min_tco_2_plaus c_tco_st_max_tco_2_plaus c_tco_st_min_tco_2_plaus c_tia_thr_st_max_tco_2_plaus c_tia_thr_st_min_tco_2_plaus c_tco_st_thd_tco_2_plaus c_tco_st_dif_min_tco_2_plaus c_ctr_dly_inc_tco_2_plaus ldp_tia_thr_st_ip_ctr_tco_plaus ip_ctr_dly_tco_2_plaus /end DEF_CHARACTERISTIC
 /begin OUT_MEASUREMENT lv_err_tco_2_plaus lv_end_diag_rbm_tco_2_plaus lv_tco_2_plaus_ena tco_2_dif_tco_2_plaus ctr_dly_tco_2_plaus t_dly_tco_2_plaus tco_2_plaus_h tco_2_plaus_l /end OUT_MEASUREMENT
/end FUNCTION
/begin FUNCTION ENTE_TCO_sensor_plaus_diag_AI "TCO_sensor_plaus_diag_AI" /end FUNCTION
/begin FUNCTION ENTE_coolant_temp_low_rat_chk "coolant_temp_low_rat_chk"
 /begin DEF_CHARACTERISTIC ip_tco_sub_dif_diag_tco_stuck ip_tco_mes_dif_diag_tco_stuck /end DEF_CHARACTERISTIC
 /begin OUT_MEASUREMENT tco_mes_min_diag_tco_stuck tco_sub_dif_diag_tco_stuck tco_sub_max_diag_tco_stuck tco_sub_min_diag_tco_stuck lv_err_tco_stuck tco_mes_max_diag_tco_stuck tco_mes_dif_diag_tco_stuck /end OUT_MEASUREMENT
/end FUNCTION
/begin FUNCTION C_2_ENTE "" /begin SUB_FUNCTION ENTE_require_to_infra_interf /end SUB_FUNCTION /end FUNCTION
/begin FUNCTION ENTE_require_to_infra_interf "require_to_infra_interf" /end FUNCTION
/begin FUNCTION C_D_ENTE "" /begin SUB_FUNCTION ENTE_torque_loss /end SUB_FUNCTION /end FUNCTION
/begin FUNCTION ENTE_torque_loss "torque_loss" /begin DEF_CHARACTERISTIC ip_pow_loss_ecf c_lgrd_tq_loss_ecf /end DEF_CHARACTERISTIC /begin OUT_MEASUREMENT tq_loss_ecf /end OUT_MEASUREMENT /end FUNCTION
/begin FUNCTION C_A_ENTE ""
 /begin SUB_FUNCTION ENTE_coolant_temp_sensor_diag ENTE_coolant_temp_radiator_diag ENTE_elect_ctrl_therm_diag ENTE_coolant_temp_diag_interface ENTE_coolant_temp_sensor_diag_AI ENTE_coolant_temp_radiator_dg_AI ENTE_elect_ctrl_therm_diag_AI ENTE_cooling_fan_diag ENTE_cooling_fan_diag_AI /end SUB_FUNCTION
/end FUNCTION
/begin FUNCTION ENTE_coolant_temp_sensor_diag "coolant_temp_sensor_diag"
 /begin DEF_CHARACTERISTIC c_tia_thr_min_diag_tco_el c_t_ast_min_diag_tco_el c_ctr_abc_thd_tco_prel c_v_tco_max_diag_tco_el c_v_tco_min_diag_tco_el c_tco_mes_grd_max_diag_tco_grd /end DEF_CHARACTERISTIC
 /begin OUT_MEASUREMENT lv_err_tco_grd lv_err_tco_el lv_err_tco lv_err_tco_prel lv_err_tco_prel_det lv_cdn_ena_tco_prel /end OUT_MEASUREMENT
/end FUNCTION
/begin FUNCTION ENTE_coolant_temp_radiator_diag "coolant_temp_radiator_diag"
 /begin DEF_CHARACTERISTIC c_tia_thr_min_diag_tco_2_el c_t_ast_min_diag_tco_2_el c_v_tco_2_max_diag_tco_2_el c_v_tco_2_min_diag_tco_2_el c_ctr_abc_thd_tco_2_prel c_tco_2_mes_grd_max_diag_tco_2 /end DEF_CHARACTERISTIC
 /begin OUT_MEASUREMENT lv_err_tco_2_el lv_err_tco_2_grd lv_err_tco_2_prel lv_err_tco_2 lv_err_tco_2_prel_det lv_cdn_ena_tco_2_prel /end OUT_MEASUREMENT
/end FUNCTION
/begin FUNCTION ENTE_elect_ctrl_therm_diag "elect_ctrl_therm_diag"
 /begin DEF_CHARACTERISTIC c_abc_inc_ect_el c_abc_max_ect_el c_ect_el_pwm_diag_max_scg c_ect_el_pwm_diag_min_scp c_ect_el_pwm_diag_min_oc /end DEF_CHARACTERISTIC
 /begin OUT_MEASUREMENT lv_err_ect /end OUT_MEASUREMENT
/end FUNCTION
/begin FUNCTION ENTE_coolant_temp_diag_interface "coolant_temp_diag_interface"
 /begin DEF_CHARACTERISTIC ldp_tam_ip_maf_kgh_load_min_ast ip_maf_kgh_load_min_ast c_vs_thd_vs_max_ast c_vs_thd_vs_min_ast /end DEF_CHARACTERISTIC
 /begin OUT_MEASUREMENT t_is_ast t_load_min_ast t_vs_max_ast t_vs_min_ast ratio_t_vs_max_ast ratio_t_vs_min_ast ratio_t_load_min_ast ratio_t_puc_ast ratio_t_is_ast t_puc_ast t_diag_ast lv_cdn_ena_ratio_t_ast /end OUT_MEASUREMENT
/end FUNCTION
/begin FUNCTION ENTE_coolant_temp_sensor_diag_AI "coolant_temp_sensor_diag_AI"
 /begin DEF_CHARACTERISTIC c_ectpwm_min_tco_2_plaus c_abc_max_tco_el c_abc_inc_tco_grd c_abc_max_tco_grd c_abc_inc_tco_el /end DEF_CHARACTERISTIC
 /begin OUT_MEASUREMENT state_rbm_tco_2_plaus lv_inh_diag_tco_2_plaus lv_inh_diag_rbm_tco_2_plaus lv_tco_2_plaus_ena_ext lv_inh_diag_tco_el lv_inh_diag_tco_stuck lv_inh_diag_tco_grd state_rbm_tco_stuck lv_inh_diag_rbm_tco_stuck /end OUT_MEASUREMENT
/end FUNCTION
/begin FUNCTION ENTE_coolant_temp_radiator_dg_AI "coolant_temp_radiator_dg_AI"
 /begin DEF_CHARACTERISTIC c_abc_inc_tco_2_el c_abc_inc_tco_2_grd c_abc_max_tco_2_grd c_abc_max_tco_2_el /end DEF_CHARACTERISTIC
 /begin OUT_MEASUREMENT lv_inh_diag_tco_2_el lv_inh_diag_tco_2_grd /end OUT_MEASUREMENT
/end FUNCTION
/begin FUNCTION ENTE_elect_ctrl_therm_diag_AI "elect_ctrl_therm_diag_AI" /begin OUT_MEASUREMENT lv_inh_diag_ect_el /end OUT_MEASUREMENT /end FUNCTION
/begin FUNCTION ENTE_cooling_fan_diag "cooling_fan_diag"
 /begin DEF_CHARACTERISTIC c_abc_max_ecf_el[0] c_abc_ecfpwm_fb[0] c_ecfpwm_diag_max[0] c_ecfpwm_diag_min[0] c_ecfpwm_min_fb[0] c_t_act_ecfpwm_fb[0] c_t_ecfpwm_fb_max[0] c_t_ecfpwm_fb_min[0] c_abc_inc_ecf_el[0] c_tam_min_ecfpwm_fb_diag_th /end DEF_CHARACTERISTIC
 /begin OUT_MEASUREMENT err_diag_ecfpwm[0] lv_ecfpwm_fb_vld[0] lv_err_ecfpwm_fb_1 t_act_ecfpwm_fb[0] t_ecfpwm_fb[0] lv_err_ecf_el_1 err_ecfpwm_fb[0] abc_ecfpwm_fb[0] cdn_diag_ecf_el[0] cdn_diag_ecfpwm_bas[0] /end OUT_MEASUREMENT
/end FUNCTION
/begin FUNCTION ENTE_cooling_fan_diag_AI "cooling_fan_diag_AI" /end FUNCTION
/begin FUNCTION CPULOAD ""
 /begin DEF_CHARACTERISTIC c_cpu_load_per c_cpu_load_ses_t_begin c_cpu_load_ses_t_end c_cpu_load_tsk_mes_dly lc_cpu_load_max_rst lc_cpu_load_tsk_per_min_rst lc_cpu_load_tsk_per_min_upd /end DEF_CHARACTERISTIC
 /begin OUT_MEASUREMENT cpu_load_tsk_per_ctr cpu_load cpu_load_max cpu_load_tsk_per cpu_load_tsk_per_min_save cpu_load_tsk_per_min /end OUT_MEASUREMENT
/end FUNCTION
/begin FUNCTION C_5_FMSP "" /begin SUB_FUNCTION FMSP_Admin_of_Calc_Opt /end SUB_FUNCTION /end FUNCTION
/begin FUNCTION FMSP_Admin_of_Calc_Opt ""
 /begin DEF_CHARACTERISTIC c_n_32_thd_clc_red c_n_32_hys_clc_red c_seg_nr_st_clc_red id_ctr_cyl_nr_clc ldp_seg_nr_id_ctr_cyl_nr_clc /end DEF_CHARACTERISTIC
 /begin OUT_MEASUREMENT state_clc_red ctr_cyl_nr_st_clc ctr_cyl_nr_stop_clc ctr_cbk_in_nr_st_clc ctr_cbk_in_nr_stop_clc ctr_cbk_ex_nr_st_clc ctr_cbk_ex_nr_stop_clc /end OUT_MEASUREMENT
/end FUNCTION
/begin FUNCTION C_7_FMSP ""
 /begin SUB_FUNCTION FMSP_Manag FMSP_Configuration_Data FMSP_Combustion_Chamber FMSP_Ambient_Pressure_Cor FMSP_Warm_Up_Correction FMSP_Basic_Injection FMSP_Cold_Post_Start_Cor FMSP_Restart_Function FMSP_Restart_Function_Appl_Inc FMSP_Start_Injection_Time FMSP_Conversion_MFF_to_TI FMSP_Wall_Film_Compensation FMSP_Conversion_TI_to_MFF FMSP_Injection_Time_At_Restart FMSP_Predef_for_Single_Inj FMSP_Inj_Setpoint_Hom_Mode FMSP_Cal_of_MFF_Setpoint FMSP_Cal_of_Cyl_Indiv_Mff_Setp FMSP_Application_Incidences FMSP_FQA_Appl_Inc FMSP_Fuel_Quality_Adapt_at_ES /end SUB_FUNCTION
/end FUNCTION
/begin FUNCTION FMSP_Manag "" /end FUNCTION
/begin FUNCTION FMSP_Configuration_Data "" /end FUNCTION
/begin FUNCTION FMSP_Combustion_Chamber "" /end FUNCTION
/begin FUNCTION FMSP_Ambient_Pressure_Cor "" /begin DEF_CHARACTERISTIC ldp_amp_ip_fac_st_amp ip_fac_st_amp /end DEF_CHARACTERISTIC /begin OUT_MEASUREMENT fac_st_amp /end OUT_MEASUREMENT /end FUNCTION
/begin FUNCTION FMSP_Warm_Up_Correction "" /end FUNCTION
/begin FUNCTION FMSP_Basic_Injection "" /end FUNCTION
/begin FUNCTION FMSP_Cold_Post_Start_Cor "" /end FUNCTION
/begin FUNCTION FMSP_Restart_Function "" /end FUNCTION
/begin FUNCTION FMSP_Restart_Function_Appl_Inc "" /end FUNCTION
/begin FUNCTION FMSP_Start_Injection_Time "" /end FUNCTION
/begin FUNCTION FMSP_Conversion_MFF_to_TI "" /end FUNCTION
/begin FUNCTION FMSP_Wall_Film_Compensation "" /end FUNCTION
/begin FUNCTION FMSP_Conversion_TI_to_MFF "" /end FUNCTION
/begin FUNCTION FMSP_Injection_Time_At_Restart "" /end FUNCTION
/begin FUNCTION FMSP_Predef_for_Single_Inj "" /end FUNCTION
/begin FUNCTION FMSP_Inj_Setpoint_Hom_Mode "" /end FUNCTION
/begin FUNCTION FMSP_Cal_of_MFF_Setpoint "" /end FUNCTION
/begin FUNCTION FMSP_Cal_of_Cyl_Indiv_Mff_Setp "" /end FUNCTION
/begin FUNCTION FMSP_Application_Incidences "" /end FUNCTION
/begin FUNCTION FMSP_FQA_Appl_Inc "" /end FUNCTION
/begin FUNCTION FMSP_Fuel_Quality_Adapt_at_ES "" /end FUNCTION
/begin FUNCTION C_7_INJR "" /begin DEF_CHARACTERISTIC ldpm_mff_sp_1_injr ldp_mff_sp_ip_fac_ti_2_s /end DEF_CHARACTERISTIC
 /begin OUT_MEASUREMENT injr.STR_INJR_ISPCLEGYIV0.egy_add_ad[0] injr.STR_INJR_ISPCLEGYIV0.egy_add_ad[1] injr.STR_INJR_ISPCLEGYIV0.egy_add_ad[2] injr.STR_INJR_ISPCLEGYIV0.egy_add_ad[3] injr.STR_INJR_ISPCLEGYIV0.egy_add_ad[4] injr.STR_INJR_ISPCLEGYIV0.egy_add_ad[5] /end OUT_MEASUREMENT
 /begin SUB_FUNCTION INJR_Pressure_Corr_strat_2nd_pulse INJR_Injector_current_control INJR_Application_Incidences INJR_Pressure_Corr_hom_1st_pulse INJR_Pressure_Corr_hom_2nd_pulse INJR_Pressure_Corr_strat_1st_pulse INJR_Injector_dead_time_correction INJR_Cylinder_Shut_Off_Appl_Inc INJR_Final_Injection_Timing INJR_Injection_phase_Appl_Inc INJR_Injection_phase_strat_1st_pulse INJR_Injection_phase_strat_2nd_pulse INJR_Transfer_to_basic_sw INJR_Injection_phase_1st_pulse INJR_Fuel_temperature_correction INJR_Correction_via_Appl_System INJR_Cylinder_Shut_Off INJR_Injection_phase_2nd_pulse INJR_Comp_of_temp_influence INJR_Injector_needle_lift_adj INJR_Injector_needle_lift_control INJR_Comp_of_fuel_pres_influence INJR_Inj_phase_hom_strat_mode /end SUB_FUNCTION
/end FUNCTION
/begin FUNCTION INJR_Pressure_Corr_strat_2nd_pulse "" /begin OUT_MEASUREMENT fac_ti_2_prs_s prs_inj_mv_2_s crk_inj_2_s prs_dec_inj_2_s /end OUT_MEASUREMENT /end FUNCTION
/begin FUNCTION INJR_Injector_current_control "" /end FUNCTION
/begin FUNCTION INJR_Application_Incidences ""
 /begin DEF_CHARACTERISTIC c_t_dly_1_2_s_ext_man ldp_mff_sp_hom_ip_mff_add_reac ldp_n_ip_mff_add_reac ip_mff_add_reac lc_t_dly_1_2_s_ext_man_ena c_inj_mod_sp_man lc_inj_mod_sp_man_ena /end DEF_CHARACTERISTIC
 /begin OUT_MEASUREMENT t_dly_1_2_s_ext[0] t_dly_1_2_s_ext[1] t_dly_1_2_s_ext[2] t_dly_1_2_s_ext[3] t_dly_1_2_s_ext[4] t_dly_1_2_s_ext[5] mff_add_reac[0] mff_add_reac[1] mff_add_reac[2] mff_add_reac[3] mff_add_reac[4] mff_add_reac[5] fac_n tfu_inj lv_iv_test_mod_auth lv_n_tooth_end_act state_inj_mod_req nr_cyl_iv_test_mod /end OUT_MEASUREMENT
/end FUNCTION
/begin FUNCTION INJR_Pressure_Corr_hom_1st_pulse "" /begin DEF_CHARACTERISTIC ldp_prs_dec_inj_ip_fac_ti_prs ip_fac_ti_prs /end DEF_CHARACTERISTIC /begin OUT_MEASUREMENT prs_dec_inj_1_hom fac_ti_1_prs_hom /end OUT_MEASUREMENT /end FUNCTION
/begin FUNCTION INJR_Pressure_Corr_hom_2nd_pulse ""
 /begin DEF_CHARACTERISTIC ldp_eoi_ip_prs_inc_cmp ldp_crk_inj_ip_prs_inc_cmp ip_prs_inc_cmp /end DEF_CHARACTERISTIC
 /begin OUT_MEASUREMENT fac_ti_2_prs_hom prs_inj_mv_2_hom crk_inj_2_hom prs_dec_inj_2_hom ti_2_hom_prs_tmp /end OUT_MEASUREMENT
/end FUNCTION
/begin FUNCTION INJR_Pressure_Corr_strat_1st_pulse ""
 /begin DEF_CHARACTERISTIC ip_prs_inc_cmp_s ldp_crk_inj_1_s_ip_prs_inc_cmp ldp_eoi_1_s_0_ip_prs_inc_cmp_s /end DEF_CHARACTERISTIC
 /begin OUT_MEASUREMENT prs_dec_inj_1_s fac_ti_1_prs_s prs_inj_mv_1_s crk_inj_1_s /end OUT_MEASUREMENT
/end FUNCTION
/begin FUNCTION INJR_Injector_dead_time_correction ""
 /begin DEF_CHARACTERISTIC ldpm_prs_dec_inj_1_injr ip_ti_add_dly_hpdi_egy_l ip_ti_add_dly_hpdi_egy_h /end DEF_CHARACTERISTIC
 /begin OUT_MEASUREMENT ti_add_dly_hom ti_add_dly ti_1_add_dly_s ti_2_add_dly_s /end OUT_MEASUREMENT
/end FUNCTION
/begin FUNCTION INJR_Cylinder_Shut_Off_Appl_Inc "" /begin DEF_CHARACTERISTIC c_inh_iv_swi_man /end DEF_CHARACTERISTIC /begin OUT_MEASUREMENT inh_iv_ext inh_iv_swi_man lv_scc /end OUT_MEASUREMENT /end FUNCTION
/end MODULE
/end PROJECT
