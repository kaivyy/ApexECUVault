ASAP2_VERSION 1 31
/begin PROJECT MS45 "BMW Motorsteuerung R6"
/begin HEADER "_default_HeaderComment" PROJECT_NO _56 /end HEADER
/begin MODULE _default_ModuleName "_default_ModuleLongIdentifier"
/begin MOD_COMMON "_default_ModCommonComment" DEPOSIT ABSOLUTE BYTE_ORDER MSB_FIRST ALIGNMENT_BYTE 1 ALIGNMENT_WORD 2 ALIGNMENT_LONG 4 ALIGNMENT_FLOAT32_IEEE 4 ALIGNMENT_FLOAT64_IEEE 8 /end MOD_COMMON
/begin CHARACTERISTIC c_t_cyc_disp_icl_can "recurrence for transmission of  check control message" VALUE 0x007e8 _REC_VAL_20_u1 15. _CNV_A_R_LINEAR_____30_CM 0. 15. DISPLAY_IDENTIFIER C_T_CYC_DISP_ICL_CAN FORMAT "%2.0" /end CHARACTERISTIC
/begin MEASUREMENT ctl_acin_eng_typ "special function for air conditioning control - not used with engine type M54" UBYTE _CNV_A_R_LINEAR_____1_CM 1 100. 0. 3. DISPLAY_IDENTIFIER CTL_ACIN_ENG_TYP ECU_ADDRESS 0x3fdbee FORMAT "%1.0" /end MEASUREMENT
/begin MEASUREMENT state_swi_off_vb "state switch off battery voltage (kl30)" UBYTE _CNV_A_R_LINEAR_____1_CM 1 100. 0. 3. DISPLAY_IDENTIFIER STATE_SWI_OFF_VB ECU_ADDRESS 0x3fdbf3 FORMAT "%1.0" /end MEASUREMENT
/begin MEASUREMENT cks_can_tq_dcc "Checksum TQ_DCC from CAN" UBYTE _CNV_A_R_LINEAR_____1_CM 1 100. 0. 255. DISPLAY_IDENTIFIER CKS_CAN_TQ_DCC ECU_ADDRESS 0x3fdbca FORMAT "%3.0" /end MEASUREMENT
/begin MEASUREMENT cks_can_tq_tcs "checksum traction control system TQ_TCS from CAN" UBYTE _CNV_A_R_LINEAR_____1_CM 1 100. 0. 255. DISPLAY_IDENTIFIER CKS_CAN_TQ_TCS ECU_ADDRESS 0x3fdbde FORMAT "%3.0" /end MEASUREMENT
/begin MEASUREMENT cks_can_tq_etcu "check sum TQ_ETCU from CAN" UBYTE _CNV_A_R_LINEAR_____1_CM 1 100. 0. 255. DISPLAY_IDENTIFIER CKS_CAN_TQ_ETCU ECU_ADDRESS 0x3fdbe2 FORMAT "%3.0" /end MEASUREMENT
/begin MEASUREMENT cks_can_tq_amt "check sum TQ_AMT from CAN" UBYTE _CNV_A_R_LINEAR_____1_CM 1 100. 0. 255. DISPLAY_IDENTIFIER CKS_CAN_TQ_AMT ECU_ADDRESS 0x3fdbe6 FORMAT "%3.0" /end MEASUREMENT
/begin MEASUREMENT cks_can_msw "checksum MSW - SZL" UBYTE _CNV_A_R_LINEAR_____1_CM 1 100. 0. 255. DISPLAY_IDENTIFIER CKS_CAN_MSW ECU_ADDRESS 0x3fdbea FORMAT "%3.0" /end MEASUREMENT
/begin MEASUREMENT lv_temp_eng_1 "engine temperature - pre-indication overtemperature" UBYTE _CNV_S_2_RANGE______0_CM 1 100. 0. 1. DISPLAY_IDENTIFIER LV_TEMP_ENG_1 ECU_ADDRESS 0x3fdc01 /end MEASUREMENT
/begin MEASUREMENT lv_temp_eng_2 "engine temperature - indication overtemperature" UBYTE _CNV_S_2_RANGE______0_CM 1 100. 0. 1. DISPLAY_IDENTIFIER LV_TEMP_ENG_2 ECU_ADDRESS 0x3fdc02 /end MEASUREMENT
/begin MEASUREMENT lv_toil_gs "Request GS due to high TOIL" UBYTE _CNV_S_2_RANGE______0_CM 1 100. 0. 1. DISPLAY_IDENTIFIER LV_TOIL_GS ECU_ADDRESS 0x3fdc03 /end MEASUREMENT
/begin MEASUREMENT tcc_can_ecu "free running test cycle counter ECU1 (alive counter)" UBYTE _CNV_A_R_LINEAR_____22_CM 1 100. 0. 14. DISPLAY_IDENTIFIER TCC_CAN_ECU ECU_ADDRESS 0x3fdbf5 FORMAT "%2.0" /end MEASUREMENT
/begin MEASUREMENT tcc_can_ecu1 "free running test cycle counter ECU1 (alive counter)" UBYTE _CNV_A_R_LINEAR_____22_CM 1 100. 0. 14. DISPLAY_IDENTIFIER TCC_CAN_ECU1 ECU_ADDRESS 0x3fdbf6 FORMAT "%2.0" /end MEASUREMENT
/begin MEASUREMENT tcc_can_ecu2 "free running test cycle counter ECU2 (alive counter)" UBYTE _CNV_A_R_LINEAR_____22_CM 1 100. 0. 14. DISPLAY_IDENTIFIER TCC_CAN_ECU2 ECU_ADDRESS 0x3fdbf7 FORMAT "%2.0" /end MEASUREMENT
/begin MEASUREMENT tcc_can_ecu3 "free running test cycle counter ECU3 (alive counter)" UBYTE _CNV_A_R_LINEAR_____22_CM 1 100. 0. 14. DISPLAY_IDENTIFIER TCC_CAN_ECU3 ECU_ADDRESS 0x3fdbf8 FORMAT "%2.0" /end MEASUREMENT
/begin CHARACTERISTIC c_icl_disp_frq "calibratable constant for display messages on ICL" VALUE 0x006f3 _REC_VAL_20_u1 3. _CNV_A_R_LINEAR_____1_CM 0. 3. DISPLAY_IDENTIFIER C_ICL_DISP_FRQ FORMAT "%2.0" /end CHARACTERISTIC
/begin CHARACTERISTIC c_toil_gs_max "Temperature threshold for actuating the pre-warning light (orange) for overtemperature " VALUE 0x008de _REC_VAL_20_u1 200. _CNV_A_R_LINEAR_____15_CM -40. 160. DISPLAY_IDENTIFIER C_TOIL_GS_MAX FORMAT "%3.0" /end CHARACTERISTIC
/begin CHARACTERISTIC c_tco_chk_ctl_1 "Temperature threshold for actuating the pre-warning light (orange) for overtemperature " VALUE 0x0085f _REC_VAL_20_u1 190.5 _CNV_A_R_LINEAR_____12_CM -48. 142.5 DISPLAY_IDENTIFIER C_TCO_CHK_CTL_1 FORMAT "%5.1" /end CHARACTERISTIC
/begin CHARACTERISTIC c_tco_chk_ctl_2 "Temperature threshold for actuating the warning light (red) for overtemperature " VALUE 0x00860 _REC_VAL_20_u1 190.5 _CNV_A_R_LINEAR_____12_CM -48. 142.5 DISPLAY_IDENTIFIER C_TCO_CHK_CTL_2 FORMAT "%5.1" /end CHARACTERISTIC
/begin CHARACTERISTIC c_tco_sum_hys_1 "Hysteresis for temperature threshold C_TCO_CHK_CTL_1" VALUE 0x008a2 _REC_VAL_20_u1 190.5 _CNV_A_R_LINEAR_____13_CM 0. 190.5 DISPLAY_IDENTIFIER C_TCO_SUM_HYS_1 FORMAT "%5.1" /end CHARACTERISTIC
/begin CHARACTERISTIC c_tco_sum_hys_2 "Hysteresis for temperature threshold C_TCO_CHK_CTL_2" VALUE 0x008a3 _REC_VAL_20_u1 190.5 _CNV_A_R_LINEAR_____13_CM 0. 190.5 DISPLAY_IDENTIFIER C_TCO_SUM_HYS_2 FORMAT "%5.1" /end CHARACTERISTIC
/begin MEASUREMENT cks_can_cas "check sum CAS from CAN" UBYTE _CNV_A_R_LINEAR_____1_CM 1 100. 0. 255. DISPLAY_IDENTIFIER CKS_CAN_CAS ECU_ADDRESS 0x3fdbd5 FORMAT "%3.0" /end MEASUREMENT
/begin MEASUREMENT cks_clc_cas "check sum CAS" UBYTE _CNV_A_R_LINEAR_____1_CM 1 100. 0. 255. DISPLAY_IDENTIFIER CKS_CLC_CAS ECU_ADDRESS 0x3fdbd6 FORMAT "%3.0" /end MEASUREMENT
/begin MEASUREMENT cks_clc_tq_dcc "check sum TQ_DCC" UBYTE _CNV_A_R_LINEAR_____1_CM 1 100. 0. 255. DISPLAY_IDENTIFIER CKS_CLC_TQ_DCC ECU_ADDRESS 0x3fdbcb FORMAT "%3.0" /end MEASUREMENT
/begin MEASUREMENT cks_clc_tq_tcs "check sum TQ_TCS" UBYTE _CNV_A_R_LINEAR_____1_CM 1 100. 0. 255. DISPLAY_IDENTIFIER CKS_CLC_TQ_TCS ECU_ADDRESS 0x3fdbdf FORMAT "%3.0" /end MEASUREMENT
/begin MEASUREMENT cks_clc_tq_etcu "check sum TQ_ETCU" UBYTE _CNV_A_R_LINEAR_____1_CM 1 100. 0. 255. DISPLAY_IDENTIFIER CKS_CLC_TQ_ETCU ECU_ADDRESS 0x3fdbe3 FORMAT "%3.0" /end MEASUREMENT
/begin MEASUREMENT cks_clc_tq_amt "check sum TQ_AMT" UBYTE _CNV_A_R_LINEAR_____1_CM 1 100. 0. 255. DISPLAY_IDENTIFIER CKS_CLC_TQ_AMT ECU_ADDRESS 0x3fdbe7 FORMAT "%3.0" /end MEASUREMENT
/begin MEASUREMENT cks_clc_msw "check sum CRU (SZL)" UBYTE _CNV_A_R_LINEAR_____1_CM 1 100. 0. 255. DISPLAY_IDENTIFIER CKS_CLC_MSW ECU_ADDRESS 0x3fdbeb FORMAT "%3.0" /end MEASUREMENT
/begin MEASUREMENT cks_clc_ecu1 "check sum ECU 1" UBYTE _CNV_A_R_LINEAR_____1_CM 1 100. 0. 255. DISPLAY_IDENTIFIER CKS_CLC_ECU1 ECU_ADDRESS 0x3fdbf9 FORMAT "%3.0" /end MEASUREMENT
/begin MEASUREMENT cks_clc_ecu2 "check sum ECU 2" UBYTE _CNV_A_R_LINEAR_____1_CM 1 100. 0. 255. DISPLAY_IDENTIFIER CKS_CLC_ECU2 ECU_ADDRESS 0x3fdbfa FORMAT "%3.0" /end MEASUREMENT
/begin MEASUREMENT cks_clc_ecu3 "check sum ECU 3" UBYTE _CNV_A_R_LINEAR_____1_CM 1 100. 0. 255. DISPLAY_IDENTIFIER CKS_CLC_ECU3 ECU_ADDRESS 0x3fdbfb FORMAT "%3.0" /end MEASUREMENT
/begin CHARACTERISTIC c_tq_max_acc "torque limitation for torque loss ACC" VALUE 0x008fd _REC_VAL_20_u1 127. _CNV_A_R_LINEAR_____78_CM 0. 127. DISPLAY_IDENTIFIER C_TQ_MAX_ACC FORMAT "%5.1" /end CHARACTERISTIC
/begin CHARACTERISTIC c_cc_mess "ID2 check-control message standard ID2_CC_MESS_STD (Standard CC-report)" VALUE 0x00605 _REC_VAL_20_u1 255. _CNV_A_R_LINEAR_____1_CM 0. 255. DISPLAY_IDENTIFIER C_CC_MESS FORMAT "%3.0" /end CHARACTERISTIC
/begin MEASUREMENT cks_can_veh_mod "check sum VEH_MOD from CAN" UBYTE _CNV_A_R_LINEAR_____1_CM 1 100. 0. 255. DISPLAY_IDENTIFIER CKS_CAN_VEH_MOD ECU_ADDRESS 0x3fdbd9 FORMAT "%3.0" /end MEASUREMENT
/begin MEASUREMENT cc_id "Checkcontrol ID" UWORD _CNV_A_R_LINEAR_____1_CM 1 100. 0. 65535. DISPLAY_IDENTIFIER CC_ID ECU_ADDRESS 0x3fcde4 BYTE_ORDER MSB_LAST FORMAT "%5.0" /end MEASUREMENT
/begin MEASUREMENT lv_mil_fll "bit for MIL flash light" UBYTE _CNV_S_2_RANGE______0_CM 1 100. 0. 1. DISPLAY_IDENTIFIER LV_MIL_FLL ECU_ADDRESS 0x3fdc06 /end MEASUREMENT
/begin MEASUREMENT tq_ems_bn "actual engine torque - driver's choice (converted for BN)" SWORD _CNV_A_R_LINEAR_____55_CM 1 100. -1024. 1023.96875 DISPLAY_IDENTIFIER TQ_EMS_BN ECU_ADDRESS 0x3fcddc BYTE_ORDER MSB_LAST FORMAT "%8.2" /end MEASUREMENT
/begin MEASUREMENT tq_maf "actual engine torque - spare, positive (converted for BN)" SWORD _CNV_A_R_LINEAR_____55_CM 1 100. -1024. 1023.96875 DISPLAY_IDENTIFIER TQ_MAF ECU_ADDRESS 0x3fcdd6 BYTE_ORDER MSB_LAST FORMAT "%8.2" /end MEASUREMENT
/begin CHARACTERISTIC c_n_32_thd_cc_poil_swi "N_32-Threshold for activating CC-message LV_POIL_SWI" VALUE 0x00753 _REC_VAL_20_u1 8160. _CNV_A_R_LINEAR_____16_CM 0. 8160. DISPLAY_IDENTIFIER C_N_32_THD_CC_POIL_SWI FORMAT "%4.0" /end CHARACTERISTIC
/begin CHARACTERISTIC ip_t_dly_poil_swi_can__toil "Delay-time for first activation of CC-message LV_POIL_SWI" CURVE 0x0dffe _REC_CUR_20_u2_u1 6553.5 _CNV_A_R_LINEAR_____24_CM 0. 6553.5 DISPLAY_IDENTIFIER IP_T_DLY_POIL_SWI_CAN__TOIL FORMAT "%6.1"
 /begin AXIS_DESCR COM_AXIS toil _CNV_A_R_LINEAR_____15_CM 6 -40. 160. FORMAT "%3.0" AXIS_PTS_REF ldp_toil__t_dly_poil_swi_can /end AXIS_DESCR
/end CHARACTERISTIC
/begin AXIS_PTS ldp_toil__t_dly_poil_swi_can "" 0x0123b toil _REC_AXS_20_u1 200. _CNV_A_R_LINEAR_____15_CM 6 -40. 160. DISPLAY_IDENTIFIER LDP_TOIL__T_DLY_POIL_SWI_CAN FORMAT "%3.0" /end AXIS_PTS
/begin CHARACTERISTIC c_n_sp_is_thd_can "engine speed setpoint threshold for reconition of ST_SW_LEV_RPM condition" VALUE 0x0171a _REC_VAL_20_u2 8159. _CNV_A_R_LINEAR_____11_CM 1. 8160. DISPLAY_IDENTIFIER C_N_SP_IS_THD_CAN FORMAT "%4.0" /end CHARACTERISTIC
/begin MEASUREMENT cks_can_tq_pste_2 "Checksum TQ_PSTE_2 from CAN" UBYTE _CNV_A_R_LINEAR_____1_CM 1 100. 0. 255. DISPLAY_IDENTIFIER CKS_CAN_TQ_PSTE_2 ECU_ADDRESS 0x3fdbce FORMAT "%3.0" /end MEASUREMENT
/begin MEASUREMENT cks_clc_tq_pste_2 "check sum TQ_PSTE_2" UBYTE _CNV_A_R_LINEAR_____1_CM 1 100. 0. 255. DISPLAY_IDENTIFIER CKS_CLC_TQ_PSTE_2 ECU_ADDRESS 0x3fdbcf FORMAT "%3.0" /end MEASUREMENT
/begin MEASUREMENT tq_amt_fast_dec_bn "fast torque decreased intervention due to AMT" SWORD _CNV_A_R_LINEAR_____55_CM 1 100. -1024. 1023.96875 DISPLAY_IDENTIFIER TQ_AMT_FAST_DEC_BN ECU_ADDRESS 0x3fcdf4 BYTE_ORDER MSB_LAST FORMAT "%8.2" /end MEASUREMENT
/begin MEASUREMENT tq_amt_slow_dec_bn "slow torque decreased intervention due to AMT" SWORD _CNV_A_R_LINEAR_____55_CM 1 100. -1024. 1023.96875 DISPLAY_IDENTIFIER TQ_AMT_SLOW_DEC_BN ECU_ADDRESS 0x3fcdf6 BYTE_ORDER MSB_LAST FORMAT "%8.2" /end MEASUREMENT
/begin MEASUREMENT tq_amt_fast_inc_bn "fast torque increased intervention due to AMT" SWORD _CNV_A_R_LINEAR_____55_CM 1 100. -1024. 1023.96875 DISPLAY_IDENTIFIER TQ_AMT_FAST_INC_BN ECU_ADDRESS 0x3fcdf0 BYTE_ORDER MSB_LAST FORMAT "%8.2" /end MEASUREMENT
/begin MEASUREMENT tq_amt_slow_inc_bn "slow torque increased intervention due to AMT" SWORD _CNV_A_R_LINEAR_____55_CM 1 100. -1024. 1023.96875 DISPLAY_IDENTIFIER TQ_AMT_SLOW_INC_BN ECU_ADDRESS 0x3fcdf2 BYTE_ORDER MSB_LAST FORMAT "%8.2" /end MEASUREMENT
/begin MEASUREMENT tq_dcc_fast_inc_bn "fast torque increased intervention due to DCC" SWORD _CNV_A_R_LINEAR_____55_CM 1 100. -1024. 1023.96875 DISPLAY_IDENTIFIER TQ_DCC_FAST_INC_BN ECU_ADDRESS 0x3fcdf8 BYTE_ORDER MSB_LAST FORMAT "%8.2" /end MEASUREMENT
/begin MEASUREMENT tq_dcc_slow_inc_bn "slow torque increased intervention due to DCC" SWORD _CNV_A_R_LINEAR_____55_CM 1 100. -1024. 1023.96875 DISPLAY_IDENTIFIER TQ_DCC_SLOW_INC_BN ECU_ADDRESS 0x3fcdfa BYTE_ORDER MSB_LAST FORMAT "%8.2" /end MEASUREMENT
/begin MEASUREMENT tq_gs_fast_dec_bn "fast torque decreased intervention due to GS" SWORD _CNV_A_R_LINEAR_____55_CM 1 100. -1024. 1023.96875 DISPLAY_IDENTIFIER TQ_GS_FAST_DEC_BN ECU_ADDRESS 0x3fcdec BYTE_ORDER MSB_LAST FORMAT "%8.2" /end MEASUREMENT
/begin MEASUREMENT tq_gs_fast_inc_bn "fast torque increased intervention due to GS" SWORD _CNV_A_R_LINEAR_____55_CM 1 100. -1024. 1023.96875 DISPLAY_IDENTIFIER TQ_GS_FAST_INC_BN ECU_ADDRESS 0x3fcde8 BYTE_ORDER MSB_LAST FORMAT "%8.2" /end MEASUREMENT
/begin MEASUREMENT tq_gs_slow_dec_bn "slow torque decreased intervention due to GS" SWORD _CNV_A_R_LINEAR_____55_CM 1 100. -1024. 1023.96875 DISPLAY_IDENTIFIER TQ_GS_SLOW_DEC_BN ECU_ADDRESS 0x3fcdee BYTE_ORDER MSB_LAST FORMAT "%8.2" /end MEASUREMENT
/begin MEASUREMENT tq_gs_slow_inc_bn "slow torque increased intervention due to GS" SWORD _CNV_A_R_LINEAR_____55_CM 1 100. -1024. 1023.96875 DISPLAY_IDENTIFIER TQ_GS_SLOW_INC_BN ECU_ADDRESS 0x3fcdea BYTE_ORDER MSB_LAST FORMAT "%8.2" /end MEASUREMENT
/begin MEASUREMENT tq_msr_fast_inc_bn "fast torque increased intervention due to TCS" SWORD _CNV_A_R_LINEAR_____55_CM 1 100. -1024. 1023.96875 DISPLAY_IDENTIFIER TQ_MSR_FAST_INC_BN ECU_ADDRESS 0x3fcdfc BYTE_ORDER MSB_LAST FORMAT "%8.2" /end MEASUREMENT
/begin MEASUREMENT tq_msr_slow_inc_bn "slow torque increased intervention due to TCS" SWORD _CNV_A_R_LINEAR_____55_CM 1 100. -1024. 1023.96875 DISPLAY_IDENTIFIER TQ_MSR_SLOW_INC_BN ECU_ADDRESS 0x3fcdfe BYTE_ORDER MSB_LAST FORMAT "%8.2" /end MEASUREMENT
/begin MEASUREMENT tq_asr_fast_dec_bn "fast torque decreased intervention due to TCS" SWORD _CNV_A_R_LINEAR_____55_CM 1 100. -1024. 1023.96875 DISPLAY_IDENTIFIER TQ_ASR_FAST_DEC_BN ECU_ADDRESS 0x3fce00 BYTE_ORDER MSB_LAST FORMAT "%8.2" /end MEASUREMENT
/begin MEASUREMENT tq_asr_slow_dec_bn "slow torque decreased intervention due to TCS" SWORD _CNV_A_R_LINEAR_____55_CM 1 100. -1024. 1023.96875 DISPLAY_IDENTIFIER TQ_ASR_SLOW_DEC_BN ECU_ADDRESS 0x3fce02 BYTE_ORDER MSB_LAST FORMAT "%8.2" /end MEASUREMENT
/begin CHARACTERISTIC c_max_msg_miss_asr_can "maximum number of mised ASC messages (default value 10)" VALUE 0x0072b _REC_VAL_20_u1 255. _CNV_A_R_LINEAR_____1_CM 0. 255. DISPLAY_IDENTIFIER C_MAX_MSG_MISS_ASR_CAN FORMAT "%3.0" /end CHARACTERISTIC
/begin CHARACTERISTIC c_tmot_sum_hys "Hysteresis for temperature threshold C_TCO_TMOT_STA" VALUE 0x008dc _REC_VAL_20_u1 190.5 _CNV_A_R_LINEAR_____13_CM 0. 190.5 DISPLAY_IDENTIFIER C_TMOT_SUM_HYS FORMAT "%5.1" /end CHARACTERISTIC
/begin CHARACTERISTIC c_t_tco_can_ast "Time condition for transmitting the coolant temperature to the CAN" VALUE 0x018aa _REC_VAL_20_u2 6553.5 _CNV_A_R_LINEAR_____24_CM 0. 6553.5 DISPLAY_IDENTIFIER C_T_TCO_CAN_AST FORMAT "%6.1" /end CHARACTERISTIC
/begin CHARACTERISTIC c_tco_swi_wup "TCO condition for setting the bit S_WL" VALUE 0x008a4 _REC_VAL_20_u1 190.5 _CNV_A_R_LINEAR_____12_CM -48. 142.5 DISPLAY_IDENTIFIER C_TCO_SWI_WUP FORMAT "%5.1" /end CHARACTERISTIC
/begin MEASUREMENT lv_ack_tcs "Logical variable TCS acknowledge" UBYTE _CNV_S_2_RANGE______0_CM 1 100. 0. 1. DISPLAY_IDENTIFIER LV_ACK_TCS ECU_ADDRESS 0x3fde22 BIT_MASK 0x1 /end MEASUREMENT
/begin CHARACTERISTIC c_t_ctr_max_asr_can "maximum value timeout counter ASC message (default value 10)" VALUE 0x007e2 _REC_VAL_20_u1 2.55 _CNV_A_R_LINEAR_____4_CM 0. 2.55 DISPLAY_IDENTIFIER C_T_CTR_MAX_ASR_CAN FORMAT "%4.2" /end CHARACTERISTIC
/begin CHARACTERISTIC c_tco_tmot_sta "Temperature threshold for actuating the overtemperature warning light" VALUE 0x008ab _REC_VAL_20_u1 190.5 _CNV_A_R_LINEAR_____12_CM -48. 142.5 DISPLAY_IDENTIFIER C_TCO_TMOT_STA FORMAT "%5.1" /end CHARACTERISTIC
/begin CHARACTERISTIC c_fac_mff_fco "Transition factor MFF to FCO" VALUE 0x0157e _REC_VAL_20_u2 0.99998474 _CNV_A_R_LINEAR_____37_CM 0. 0.99998474 DISPLAY_IDENTIFIER C_FAC_MFF_FCO FORMAT "%7.5" /end CHARACTERISTIC
/begin MEASUREMENT fco "integrated fuel consumption" ULONG _CNV_A_R_LINEAR_____87_CM 1 100. 0. 4294967295. DISPLAY_IDENTIFIER FCO ECU_ADDRESS 0x3fbeb0 BYTE_ORDER MSB_LAST FORMAT "%11.0" /end MEASUREMENT
/begin MEASUREMENT lv_wup_can "Indication for CAT heating ended" UBYTE _CNV_S_2_RANGE______5_CM 1 100. 0. 1. DISPLAY_IDENTIFIER LV_WUP_CAN ECU_ADDRESS 0x3fde17 /end MEASUREMENT
/begin CHARACTERISTIC ip_t_ast_swi_wup__ctr_km_can "time condition for setting the bit S_WL" CURVE 0x01b3c _REC_CUR_20_u2_u2 6553.5 _CNV_A_R_LINEAR_____24_CM 0. 6553.5 DISPLAY_IDENTIFIER IP_T_AST_SWI_WUP__CTR_KM_CAN FORMAT "%6.1"
 /begin AXIS_DESCR COM_AXIS ctr_km_can _CNV_A_R_LINEAR_____88_CM 4 0. 655340. FORMAT "%6.0" AXIS_PTS_REF ldpm_ctr_km_can /end AXIS_DESCR
/end CHARACTERISTIC
/begin CHARACTERISTIC c_pv_can_diag "limitation of PV_CAN at MTC error is active" VALUE 0x007ad _REC_VAL_20_u1 99.609375 _CNV_A_R_LINEAR_____10_CM 0. 99.609375 DISPLAY_IDENTIFIER C_PV_CAN_DIAG FORMAT "%4.1" /end CHARACTERISTIC
/begin CHARACTERISTIC c_eng_etcu "?????" VALUE 0x006b8 _REC_VAL_20_u1 255. _CNV_A_R_LINEAR_____1_CM 0. 255. DISPLAY_IDENTIFIER C_ENG_ETCU FORMAT "%3.0" /end CHARACTERISTIC
/begin MEASUREMENT ctl_shift_lock_can "control shift-lock" UBYTE _CNV_A_R_LINEAR_____1_CM 1 100. 0. 3. DISPLAY_IDENTIFIER CTL_SHIFT_LOCK_CAN ECU_ADDRESS 0x3fde16 FORMAT "%1.0" /end MEASUREMENT
/begin MEASUREMENT lv_level_is "status switch level rpm" UBYTE _CNV_S_2_RANGE______0_CM 1 100. 0. 1. DISPLAY_IDENTIFIER LV_LEVEL_IS ECU_ADDRESS 0x3fde18 /end MEASUREMENT
/begin AXIS_PTS ldpm_ctr_km_can "" 0x115ce ctr_km_can _REC_AXS_20_u2 655340. _CNV_A_R_LINEAR_____88_CM 4 0. 655340. DISPLAY_IDENTIFIER LDPM_CTR_KM_CAN FORMAT "%6.0" /end AXIS_PTS
/begin MEASUREMENT tqi_maf "indicated engine torque after charging interventions (converted for CAN)" SWORD _CNV_A_R_LINEAR_____55_CM 1 100. -1024. 1023.96875 DISPLAY_IDENTIFIER TQI_MAF ECU_ADDRESS 0x3fce08 BYTE_ORDER MSB_LAST FORMAT "%8.2" /end MEASUREMENT
/begin MEASUREMENT tqi_av_can "actual indicated engine torque (converted for CAN)" UBYTE _CNV_A_R_LINEAR_____10_CM 1 100. 0. 99.609375 DISPLAY_IDENTIFIER TQI_AV_CAN ECU_ADDRESS 0x3fde1e FORMAT "%4.1" /end MEASUREMENT
/begin MEASUREMENT tqi_ems_can "requested indicated engine torque without external interventions (converted for CAN)" UBYTE _CNV_A_R_LINEAR_____10_CM 1 100. 0. 99.609375 DISPLAY_IDENTIFIER TQI_EMS_CAN ECU_ADDRESS 0x3fde1f FORMAT "%4.1" /end MEASUREMENT
/begin MEASUREMENT tqi_maf_can "indicated engine torque after charging interventions (converted for CAN)" UBYTE _CNV_A_R_LINEAR_____10_CM 1 100. 0. 99.609375 DISPLAY_IDENTIFIER TQI_MAF_CAN ECU_ADDRESS 0x3fde20 FORMAT "%4.1" /end MEASUREMENT
/begin MEASUREMENT lv_crul_ack "LV indicating if L_FGR-signal has been sent - for KWP-Service" UBYTE _CNV_S_2_RANGE______0_CM 1 100. 0. 1. DISPLAY_IDENTIFIER LV_CRUL_ACK ECU_ADDRESS 0x3fde19 /end MEASUREMENT
/begin MEASUREMENT fco_av_mmv "Moving mean value of the integrated fuel consumption" UWORD _CNV_A_R_LINEAR_____87_CM 1 100. 0. 65535. DISPLAY_IDENTIFIER FCO_AV_MMV ECU_ADDRESS 0x3fce14 BYTE_ORDER MSB_LAST FORMAT "%5.0" /end MEASUREMENT
/begin CHARACTERISTIC c_crlc_fco_av "Correlation constant for moving mean value calculation of FCO" VALUE 0x0062b _REC_VAL_20_u1 0.99610001 _CNV_A_R_LINEAR_____29_CM 0. 0.99610001 DISPLAY_IDENTIFIER C_CRLC_FCO_AV FORMAT "%5.3" /end CHARACTERISTIC
/begin MEASUREMENT n_dyw_cp "N average value for dynamic window" UWORD _CNV_A_R_LINEAR_____11_CM 1 100. 0. 8160. DISPLAY_IDENTIFIER N_DYW_CP ECU_ADDRESS 0x3fce40 BYTE_ORDER MSB_LAST FORMAT "%4.0" /end MEASUREMENT
/begin MEASUREMENT maf_dyw_cp "MAF  average value for dynamic window" UWORD _CNV_A_R_LINEAR_____106_CM 1 100. 0. 1389. DISPLAY_IDENTIFIER MAF_DYW_CP ECU_ADDRESS 0x3fce42 BYTE_ORDER MSB_LAST FORMAT "%7.2" /end MEASUREMENT
/begin MEASUREMENT cdn_state_cp "Activation conditions for evaporative emission control function" UBYTE _CNV_S_6_RANGE_CDN__107_CM 1 100. 0. 5. DISPLAY_IDENTIFIER CDN_STATE_CP ECU_ADDRESS 0x3fde8c /end MEASUREMENT
/begin MEASUREMENT lv_cp_act_req "Request to inhib Catalyst and  O2 sensor diagnosis for allowing purge canister activation" UBYTE _CNV_S_2_RANGE______5_CM 1 100. 0. 1. DISPLAY_IDENTIFIER LV_CP_ACT_REQ ECU_ADDRESS 0x3fde8f BIT_MASK 0x1 /end MEASUREMENT
/begin MEASUREMENT lv_pu_cp "Flag to interrupt the purge in PU mode" UBYTE _CNV_S_2_RANGE______5_CM 1 100. 0. 1. DISPLAY_IDENTIFIER LV_PU_CP ECU_ADDRESS 0x3fde90 BIT_MASK 0x1 /end MEASUREMENT
/begin MEASUREMENT prs_cps "Pressure difference at CPS" SWORD _CNV_A_R_LINEAR_____108_CM 1 100. -2717.04 2716.96 DISPLAY_IDENTIFIER PRS_CPS ECU_ADDRESS 0x3fce3c BYTE_ORDER MSB_LAST FORMAT "%8.2" /end MEASUREMENT
/begin CHARACTERISTIC c_t_dly_pu_cps "" VALUE 0x01806 _REC_VAL_20_u2 6553.400000000001 _CNV_A_R_LINEAR_____24_CM 0.1 6553.5 DISPLAY_IDENTIFIER C_T_DLY_PU_CPS FORMAT "%6.1" /end CHARACTERISTIC
/begin CHARACTERISTIC c_prs_max_cps "" VALUE 0x00450 _REC_VAL_20_s2 5434. _CNV_A_R_LINEAR_____108_CM -2717.04 2716.96 DISPLAY_IDENTIFIER C_PRS_MAX_CPS FORMAT "%8.2" /end CHARACTERISTIC
/begin CHARACTERISTIC c_n_cp_tol "" VALUE 0x00762 _REC_VAL_20_u1 8160. _CNV_A_R_LINEAR_____16_CM 0. 8160. DISPLAY_IDENTIFIER C_N_CP_TOL FORMAT "%4.0" /end CHARACTERISTIC
/begin CHARACTERISTIC c_maf_cp_bol "" VALUE 0x00720 _REC_VAL_20_u1 1389. _CNV_A_R_LINEAR_____27_CM 0. 1389. DISPLAY_IDENTIFIER C_MAF_CP_BOL FORMAT "%4.0" /end CHARACTERISTIC
/begin CHARACTERISTIC c_maf_cp_tol "" VALUE 0x00721 _REC_VAL_20_u1 1389. _CNV_A_R_LINEAR_____27_CM 0. 1389. DISPLAY_IDENTIFIER C_MAF_CP_TOL FORMAT "%4.0" /end CHARACTERISTIC
/begin CHARACTERISTIC c_t_lam_lim_cp "" VALUE 0x0185a _REC_VAL_20_u2 6553.5 _CNV_A_R_LINEAR_____24_CM 0. 6553.5 DISPLAY_IDENTIFIER C_T_LAM_LIM_CP FORMAT "%5.1" /end CHARACTERISTIC
/begin CHARACTERISTIC c_cl_mmv_req "" VALUE 0x014b8 _REC_VAL_20_u2 1.99996948 _CNV_A_R_LINEAR_____21_CM 0. 1.99996948 DISPLAY_IDENTIFIER C_CL_MMV_REQ FORMAT "%7.5" /end CHARACTERISTIC
/begin CHARACTERISTIC c_t_lam_cp_dly "" VALUE 0x01858 _REC_VAL_20_u2 65534. _CNV_A_R_LINEAR_____30_CM 1. 65535. DISPLAY_IDENTIFIER C_T_LAM_CP_DLY FORMAT "%5.0" /end CHARACTERISTIC
/begin CHARACTERISTIC c_lam_cp_bol "" VALUE 0x00400 _REC_VAL_20_s2 99.99847412 _CNV_A_R_LINEAR_____109_CM -50. 49.99847412 DISPLAY_IDENTIFIER C_LAM_CP_BOL FORMAT "%5.4" /end CHARACTERISTIC
/begin CHARACTERISTIC c_lam_cp_tol "" VALUE 0x00402 _REC_VAL_20_s2 99.99847412 _CNV_A_R_LINEAR_____109_CM -50. 49.99847412 DISPLAY_IDENTIFIER C_LAM_CP_TOL FORMAT "%5.4" /end CHARACTERISTIC
/begin CHARACTERISTIC c_dly_n_maf_dyw_cp "" VALUE 0x0152e _REC_VAL_20_u2 655.35 _CNV_A_R_LINEAR_____4_CM 0. 655.35 DISPLAY_IDENTIFIER C_DLY_N_MAF_DYW_CP FORMAT "%5.2" /end CHARACTERISTIC
/begin CHARACTERISTIC c_maf_dyw_cp "" VALUE 0x01650 _REC_VAL_20_u2 1389. _CNV_A_R_LINEAR_____106_CM 0. 1389. DISPLAY_IDENTIFIER C_MAF_DYW_CP FORMAT "%7.2" /end CHARACTERISTIC
/begin CHARACTERISTIC c_n_dyw_cp "" VALUE 0x016e8 _REC_VAL_20_u2 8159. _CNV_A_R_LINEAR_____11_CM 1. 8160. DISPLAY_IDENTIFIER C_N_DYW_CP FORMAT "%4.0" /end CHARACTERISTIC
/begin CHARACTERISTIC c_tco_min_cp "" VALUE 0x0087f _REC_VAL_20_u1 28.575 _CNV_A_R_LINEAR_____12_CM -48. 142.5 DISPLAY_IDENTIFIER C_TCO_MIN_CP FORMAT "%5.1" /end CHARACTERISTIC
/begin MEASUREMENT lv_n_max_cp "Canister purge inhibition by engine speed limitation" UBYTE _CNV_S_2_RANGE______0_CM 1 100. 0. 1. DISPLAY_IDENTIFIER LV_N_MAX_CP ECU_ADDRESS 0x3fde91 BIT_MASK 0x1 /end MEASUREMENT
/begin MEASUREMENT lv_n_maf_dyw_cp "Dynamic windows on engine speed and maf" UBYTE _CNV_S_2_RANGE______0_CM 1 100. 0. 1. DISPLAY_IDENTIFIER LV_N_MAF_DYW_CP ECU_ADDRESS 0x3fde8e BIT_MASK 0x1 /end MEASUREMENT
/begin CHARACTERISTIC c_n_cp_bol "" VALUE 0x00761 _REC_VAL_20_u1 8160. _CNV_A_R_LINEAR_____16_CM 0. 8160. DISPLAY_IDENTIFIER C_N_CP_BOL FORMAT "%4.0" /end CHARACTERISTIC
/begin CHARACTERISTIC c_n_max_cp "" VALUE 0x016f4 _REC_VAL_20_u2 8160. _CNV_A_R_LINEAR_____11_CM 0. 8160. DISPLAY_IDENTIFIER C_N_MAX_CP FORMAT "%4.0" /end CHARACTERISTIC
/begin CHARACTERISTIC c_n_hys_max_cp "" VALUE 0x016ec _REC_VAL_20_u2 8160. _CNV_A_R_LINEAR_____11_CM 0. 8160. DISPLAY_IDENTIFIER C_N_HYS_MAX_CP FORMAT "%4.0" /end CHARACTERISTIC
/begin MEASUREMENT lv_cp_act "Logical value for EVAP-Control active" UBYTE _CNV_S_2_RANGE______5_CM 1 100. 0. 1. DISPLAY_IDENTIFIER LV_CP_ACT ECU_ADDRESS 0x3fde8d BIT_MASK 0x1 /end MEASUREMENT
/begin MEASUREMENT lv_lam_out_cp "" UBYTE _CNV_S_2_RANGE______5_CM 1 100. 0. 1. DISPLAY_IDENTIFIER LV_LAM_OUT_CP ECU_ADDRESS 0x3fde94 BIT_MASK 0x1 /end MEASUREMENT
/begin MEASUREMENT lv_lam_lim_cp "" UBYTE _CNV_S_2_RANGE______5_CM 1 100. 0. 1. DISPLAY_IDENTIFIER LV_LAM_LIM_CP ECU_ADDRESS 0x3fde93 BIT_MASK 0x1 /end MEASUREMENT
/begin MEASUREMENT lv_win_cp "" UBYTE _CNV_S_2_RANGE______5_CM 1 100. 0. 1. DISPLAY_IDENTIFIER LV_WIN_CP ECU_ADDRESS 0x3fde96 BIT_MASK 0x1 /end MEASUREMENT
/begin CHARACTERISTIC c_tia_min_cp "" VALUE 0x008d3 _REC_VAL_20_u1 190.5 _CNV_A_R_LINEAR_____12_CM -48. 142.5 DISPLAY_IDENTIFIER C_TIA_MIN_CP FORMAT "%5.1" /end CHARACTERISTIC
/begin CHARACTERISTIC c_state_win_cp_not "" VALUE 0x007c2 _REC_VAL_20_u1 2. _CNV_S_3_RANGE_C_ST_110_CM 0. 2. DISPLAY_IDENTIFIER C_STATE_WIN_CP_NOT /end CHARACTERISTIC
/begin MEASUREMENT lv_etcu_disable "Logical variable for disabling GS intervention due to EMS error" UBYTE _CNV_S_2_RANGE______0_CM 1 100. 0. 1. DISPLAY_IDENTIFIER LV_ETCU_DISABLE ECU_ADDRESS 0x3fe53e /end MEASUREMENT
/begin MEASUREMENT lv_etcu_disable_can "logical variable for disabling GS intervention due to CAN error" UBYTE _CNV_S_2_RANGE______0_CM 1 100. 0. 1. DISPLAY_IDENTIFIER LV_ETCU_DISABLE_CAN ECU_ADDRESS 0x3fe53f BIT_MASK 0x1 /end MEASUREMENT
/begin MEASUREMENT lv_gs_ena_dec "logical variable for decreased torque intervention due to gear shift" UBYTE _CNV_S_2_RANGE______0_CM 1 100. 0. 1. DISPLAY_IDENTIFIER LV_GS_ENA_DEC ECU_ADDRESS 0x3fe540 BIT_MASK 0x1 /end MEASUREMENT
/begin MEASUREMENT lv_gs_ena "Logical variable for GS intervention enabling" UBYTE _CNV_S_2_RANGE______0_CM 1 100. 0. 1. DISPLAY_IDENTIFIER LV_GS_ENA ECU_ADDRESS 0x3fe547 BIT_MASK 0x1 /end MEASUREMENT
/begin CHARACTERISTIC c_t_max_tqr_gs_intv "Maximum duration of torque reduction due gear shift intervention" VALUE 0x0186e _REC_VAL_20_u2 655.35 _CNV_A_R_LINEAR_____4_CM 0. 655.35 DISPLAY_IDENTIFIER C_T_MAX_TQR_GS_INTV FORMAT "%6.2" /end CHARACTERISTIC
/begin MEASUREMENT tqi_gs_fast_dec_req_1 "Torque decrement for fast torque intervention during gear shift" SWORD _CNV_A_R_LINEAR_____55_CM 1 100. -1024. 1023.96875 DISPLAY_IDENTIFIER TQI_GS_FAST_DEC_REQ_1 ECU_ADDRESS 0x3fd82a BYTE_ORDER MSB_LAST FORMAT "%8.2" /end MEASUREMENT
/begin MEASUREMENT tqi_gs_slow_dec_req "Torque decrement for slow torque intervention during gear shift" SWORD _CNV_A_R_LINEAR_____55_CM 1 100. -1024. 1023.96875 DISPLAY_IDENTIFIER TQI_GS_SLOW_DEC_REQ ECU_ADDRESS 0x3fd824 BYTE_ORDER MSB_LAST FORMAT "%8.2" /end MEASUREMENT
/begin MEASUREMENT tqi_gs_fast_inc_req_1 "torque increase for fast torque intervention during gear shift" SWORD _CNV_A_R_LINEAR_____55_CM 1 100. -1024. 1023.96875 DISPLAY_IDENTIFIER TQI_GS_FAST_INC_REQ_1 ECU_ADDRESS 0x3fd82e BYTE_ORDER MSB_LAST FORMAT "%8.2" /end MEASUREMENT
/begin MEASUREMENT tqi_gs_slow_inc_req "torque increase for slow torque intervention during gear shift" SWORD _CNV_A_R_LINEAR_____55_CM 1 100. -1024. 1023.96875 DISPLAY_IDENTIFIER TQI_GS_SLOW_INC_REQ ECU_ADDRESS 0x3fd828 BYTE_ORDER MSB_LAST FORMAT "%8.2" /end MEASUREMENT
/begin MEASUREMENT t_tqr_gs_intv "duration of gear shift torque intervention" UWORD _CNV_A_R_LINEAR_____4_CM 1 100. 0. 655.35 DISPLAY_IDENTIFIER T_TQR_GS_INTV ECU_ADDRESS 0x3fd820 BYTE_ORDER MSB_LAST FORMAT "%6.2" /end MEASUREMENT
/begin MEASUREMENT tqi_gs_fast_dec_req "Torque decrement for fast torque intervention during gear shift" SWORD _CNV_A_R_LINEAR_____55_CM 1 100. -1024. 1023.96875 DISPLAY_IDENTIFIER TQI_GS_FAST_DEC_REQ ECU_ADDRESS 0x3fd822 BYTE_ORDER MSB_LAST FORMAT "%8.2" /end MEASUREMENT
/begin MEASUREMENT tqi_gs_fast_dec "torque decrement for fast torque intervention during gear shift" SWORD _CNV_A_R_LINEAR_____55_CM 1 100. -1024. 1023.96875 DISPLAY_IDENTIFIER TQI_GS_FAST_DEC ECU_ADDRESS 0x3fd832 BYTE_ORDER MSB_LAST FORMAT "%8.2" /end MEASUREMENT
/begin MEASUREMENT tqi_gs_slow_dec_req_1 "Torque decrement for slow torque intervention during gear shift" SWORD _CNV_A_R_LINEAR_____55_CM 1 100. -1024. 1023.96875 DISPLAY_IDENTIFIER TQI_GS_SLOW_DEC_REQ_1 ECU_ADDRESS 0x3fd82c BYTE_ORDER MSB_LAST FORMAT "%8.2" /end MEASUREMENT
/begin MEASUREMENT tqi_gs_slow_dec "Torque decrement for slow torque intervention during gear shift" SWORD _CNV_A_R_LINEAR_____55_CM 1 100. -1024. 1023.96875 DISPLAY_IDENTIFIER TQI_GS_SLOW_DEC ECU_ADDRESS 0x3fd834 BYTE_ORDER MSB_LAST FORMAT "%8.2" /end MEASUREMENT
/begin MEASUREMENT lv_gs_ena_inc "logical variable for increased torque intervention due to gear shift" UBYTE _CNV_S_2_RANGE______0_CM 1 100. 0. 1. DISPLAY_IDENTIFIER LV_GS_ENA_INC ECU_ADDRESS 0x3fe541 BIT_MASK 0x1 /end MEASUREMENT
/begin MEASUREMENT lv_gs_dec_lih "logical variable for torque intervention LIH due to gear shift" UBYTE _CNV_S_2_RANGE______0_CM 1 100. 0. 1. DISPLAY_IDENTIFIER LV_GS_DEC_LIH ECU_ADDRESS 0x3fe548 /end MEASUREMENT
/begin CHARACTERISTIC c_gs_ena_inc_dec "Enable switch GS intervention" VALUE 0x006ef _REC_VAL_20_u1 3. _CNV_S_4_STATE_AMT__201_CM 0. 3. DISPLAY_IDENTIFIER C_GS_ENA_INC_DEC /end CHARACTERISTIC
/begin MEASUREMENT tqi_gs_fast_inc_req "torque increase for fast torque intervention during gear shift" SWORD _CNV_A_R_LINEAR_____55_CM 1 100. -1024. 1023.96875 DISPLAY_IDENTIFIER TQI_GS_FAST_INC_REQ ECU_ADDRESS 0x3fd826 BYTE_ORDER MSB_LAST FORMAT "%8.2" /end MEASUREMENT
/begin MEASUREMENT tqi_gs_fast_inc "torque increase for fast torque intervention during gear shift" SWORD _CNV_A_R_LINEAR_____55_CM 1 100. -1024. 1023.96875 DISPLAY_IDENTIFIER TQI_GS_FAST_INC ECU_ADDRESS 0x3fd836 BYTE_ORDER MSB_LAST FORMAT "%8.2" /end MEASUREMENT
/begin MEASUREMENT tqi_gs_slow_inc_req_1 "torque increase for slow torque intervention during gear shift" SWORD _CNV_A_R_LINEAR_____55_CM 1 100. -1024. 1023.96875 DISPLAY_IDENTIFIER TQI_GS_SLOW_INC_REQ_1 ECU_ADDRESS 0x3fd830 BYTE_ORDER MSB_LAST FORMAT "%8.2" /end MEASUREMENT
/begin MEASUREMENT tqi_gs_slow_inc "torque increase for slow torque intervention during gear shift" SWORD _CNV_A_R_LINEAR_____55_CM 1 100. -1024. 1023.96875 DISPLAY_IDENTIFIER TQI_GS_SLOW_INC ECU_ADDRESS 0x3fd838 BYTE_ORDER MSB_LAST FORMAT "%8.2" /end MEASUREMENT
/begin MEASUREMENT lv_gs_dec_act "logical variable for torque intervention due to gear shift" UBYTE _CNV_S_2_RANGE______0_CM 1 100. 0. 1. DISPLAY_IDENTIFIER LV_GS_DEC_ACT ECU_ADDRESS 0x3fe542 /end MEASUREMENT
/begin MEASUREMENT lv_gs_inc_lih "logical variable for torque intervention LIH due to gear shift" UBYTE _CNV_S_2_RANGE______0_CM 1 100. 0. 1. DISPLAY_IDENTIFIER LV_GS_INC_LIH ECU_ADDRESS 0x3fe544 /end MEASUREMENT
/begin CHARACTERISTIC c_lgrd_lih_gs_dec "limiting gradient for GS emergency ramp function (default  0.6 Nm/10ms)" VALUE 0x01630 _REC_VAL_20_u2 1023.96875 _CNV_A_R_LINEAR_____202_CM 0. 1023.96875 DISPLAY_IDENTIFIER C_LGRD_LIH_GS_DEC FORMAT "%7.2" /end CHARACTERISTIC
/begin CHARACTERISTIC c_lgrd_lih_gs_inc "limiting gradient for GS emergency ramp function (default  0.6 Nm/10ms)" VALUE 0x01632 _REC_VAL_20_u2 1023.96875 _CNV_A_R_LINEAR_____202_CM 0. 1023.96875 DISPLAY_IDENTIFIER C_LGRD_LIH_GS_INC FORMAT "%7.2" /end CHARACTERISTIC
/begin CHARACTERISTIC c_t_dly_lih_gs_dec "delay time for activation of GS emergency ramp function (default 0s)" VALUE 0x007fd _REC_VAL_20_u1 2.55 _CNV_A_R_LINEAR_____4_CM 0. 2.55 DISPLAY_IDENTIFIER C_T_DLY_LIH_GS_DEC FORMAT "%4.2" /end CHARACTERISTIC
/begin CHARACTERISTIC c_t_dly_lih_gs_inc "delay time for activation of GS emergency ramp function (default 0s)" VALUE 0x007fe _REC_VAL_20_u1 2.55 _CNV_A_R_LINEAR_____4_CM 0. 2.55 DISPLAY_IDENTIFIER C_T_DLY_LIH_GS_INC FORMAT "%4.2" /end CHARACTERISTIC
/begin MEASUREMENT lv_gs_inc_act "logical variable for torque intervention due to gear shift" UBYTE _CNV_S_2_RANGE______0_CM 1 100. 0. 1. DISPLAY_IDENTIFIER LV_GS_INC_ACT ECU_ADDRESS 0x3fe543 /end MEASUREMENT
/begin MEASUREMENT t_gs_inc_lih_ctr "delay time for activation of GS emergency ramp function " UBYTE _CNV_A_R_LINEAR_____4_CM 1 100. 0. 2.55 DISPLAY_IDENTIFIER T_GS_INC_LIH_CTR ECU_ADDRESS 0x3fe546 FORMAT "%4.2" /end MEASUREMENT
/begin MEASUREMENT t_gs_dec_lih_ctr "delay time for activation of GS emergency ramp function" UBYTE _CNV_A_R_LINEAR_____4_CM 1 100. 0. 2.55 DISPLAY_IDENTIFIER T_GS_DEC_LIH_CTR ECU_ADDRESS 0x3fe545 FORMAT "%4.2" /end MEASUREMENT
/begin MEASUREMENT eff_lamb_bas_cor "Basic lambda efficiency" UWORD _CNV_A_R_LINEAR_____21_CM 1 100. 0. 1.99996948 DISPLAY_IDENTIFIER EFF_LAMB_BAS_COR ECU_ADDRESS 0x3fd056 BYTE_ORDER MSB_LAST FORMAT "%7.5" /end MEASUREMENT
/begin MEASUREMENT lamb_ref_cor "Corrected lambda reference value" UWORD _CNV_A_R_LINEAR_____164_CM 1 100. 0. 31.99902344 DISPLAY_IDENTIFIER LAMB_REF_COR ECU_ADDRESS 0x3fd05c BYTE_ORDER MSB_LAST FORMAT "%7.4" /end MEASUREMENT
/begin MEASUREMENT lamb_dif_bas "Basic lambda difference to corrected reference lambda" SWORD _CNV_A_R_LINEAR_____306_CM 1 100. -32.00000000125 31.99902343875 DISPLAY_IDENTIFIER LAMB_DIF_BAS ECU_ADDRESS 0x3fd064 BYTE_ORDER MSB_LAST /end MEASUREMENT
/begin MEASUREMENT lamb_dif_av "Actual lambda difference to corrected reference lambda" SWORD _CNV_A_R_LINEAR_____306_CM 1 100. -32.00000000125 31.99902343875 DISPLAY_IDENTIFIER LAMB_DIF_AV ECU_ADDRESS 0x3fd066 BYTE_ORDER MSB_LAST /end MEASUREMENT
/begin MEASUREMENT lamb_ref_add_tco "Additive correction of reference lambda value " SWORD _CNV_A_R_LINEAR_____306_CM 1 100. -32.00000000125 31.99902343875 DISPLAY_IDENTIFIER LAMB_REF_ADD_TCO ECU_ADDRESS 0x3fd062 BYTE_ORDER MSB_LAST /end MEASUREMENT
/begin MEASUREMENT lamb_dif_max "Maximum lambda difference to corrected reference lambda" SWORD _CNV_A_R_LINEAR_____306_CM 1 100. -32.00000000125 31.99902343875 DISPLAY_IDENTIFIER LAMB_DIF_MAX ECU_ADDRESS 0x3fd068 BYTE_ORDER MSB_LAST /end MEASUREMENT
/begin MEASUREMENT eff_lamb_av "Actual lambda efficiency" UWORD _CNV_A_R_LINEAR_____21_CM 1 100. 0. 1.99996948 DISPLAY_IDENTIFIER EFF_LAMB_AV ECU_ADDRESS 0x3fd058 BYTE_ORDER MSB_LAST FORMAT "%7.5" /end MEASUREMENT
/begin MEASUREMENT eff_lamb_min "Minimum lambda efficiency" UWORD _CNV_A_R_LINEAR_____21_CM 1 100. 0. 1.99996948 DISPLAY_IDENTIFIER EFF_LAMB_MIN ECU_ADDRESS 0x3fd05a BYTE_ORDER MSB_LAST FORMAT "%7.5" /end MEASUREMENT
/begin CHARACTERISTIC ip_lamb_ref_add__tco "Additive lambda correction versus coolant temperature" CURVE 0x0c266 _REC_CUR_20_u2_u1 63.99902344 _CNV_A_R_LINEAR_____266_CM -32. 31.99902344 DISPLAY_IDENTIFIER IP_LAMB_REF_ADD FORMAT "%8.4"
 /begin AXIS_DESCR COM_AXIS tco _CNV_A_R_LINEAR_____12_CM 6 -48. 142.5 FORMAT "%5.1" AXIS_PTS_REF ldp_tco__lamb_ref_add /end AXIS_DESCR
/end CHARACTERISTIC
/begin CHARACTERISTIC ip_lamb_ref__n__maf "Reference lambda" MAP 0x0c21e _REC_MAP_20_u2_u1_u1 31.99902344 _CNV_A_R_LINEAR_____164_CM 0. 31.99902344 DISPLAY_IDENTIFIER IP_LAMB_REF FORMAT "%7.4"
 /begin AXIS_DESCR COM_AXIS n_32 _CNV_A_R_LINEAR_____16_CM 6 0. 8160. FORMAT "%4.0" AXIS_PTS_REF ldp_n__lamb_ref /end AXIS_DESCR
 /begin AXIS_DESCR COM_AXIS maf _CNV_A_R_LINEAR_____27_CM 6 0. 1389. FORMAT "%4.0" AXIS_PTS_REF ldp_maf__lamb_ref /end AXIS_DESCR
/end CHARACTERISTIC
/begin MEASUREMENT eff_lamb_sp_bas "Basic lambda setpoint efficiency" UWORD _CNV_A_R_LINEAR_____21_CM 1 100. 0. 1.99996948 DISPLAY_IDENTIFIER EFF_LAMB_SP_BAS ECU_ADDRESS 0x3fd05e BYTE_ORDER MSB_LAST FORMAT "%7.5" /end MEASUREMENT
/begin MEASUREMENT lamb_ref "Lambda reference valua" UWORD _CNV_A_R_LINEAR_____164_CM 1 100. 0. 31.99902344 DISPLAY_IDENTIFIER LAMB_REF ECU_ADDRESS 0x3fd060 BYTE_ORDER MSB_LAST FORMAT "%7.4" /end MEASUREMENT
/begin MEASUREMENT lamb_dif_sp_bas "Basic lambda setpoint difference to corrected reference lambda" SWORD _CNV_A_R_LINEAR_____306_CM 1 100. -32.00000000125 31.99902343875 DISPLAY_IDENTIFIER LAMB_DIF_SP_BAS ECU_ADDRESS 0x3fd06a BYTE_ORDER MSB_LAST /end MEASUREMENT
/begin AXIS_PTS ldp_tco__lamb_ref_add "" 0x01164 tco _REC_AXS_20_u1 190.5 _CNV_A_R_LINEAR_____12_CM 6 -48. 142.5 DISPLAY_IDENTIFIER LDP_TCO__LAMB_REF_ADD FORMAT "%5.1" /end AXIS_PTS
/begin AXIS_PTS ldp_n__lamb_ref "" 0x010b9 n_32 _REC_AXS_20_u1 816. _CNV_A_R_LINEAR_____16_CM 6 0. 8160. DISPLAY_IDENTIFIER LDP_N__LAMB_REF FORMAT "%4.0" /end AXIS_PTS
/begin AXIS_PTS ldp_maf__lamb_ref "" 0x00fe4 maf _REC_AXS_20_u1 1389. _CNV_A_R_LINEAR_____27_CM 6 0. 1389. DISPLAY_IDENTIFIER LDP_MAF__LAMB_REF FORMAT "%4.0" /end AXIS_PTS
/begin CHARACTERISTIC ip_eff_lamb__lamb_dif "Lambda Efficiency" CURVE 0x09c9e _REC_CUR_20_u2_u2 1.99996948 _CNV_A_R_LINEAR_____21_CM 0. 1.99996948 DISPLAY_IDENTIFIER IP_EFF_LAMB__LAMB_DIF FORMAT "%7.5"
 /begin AXIS_DESCR COM_AXIS online_dummy _CNV_A_R_LINEAR_____266_CM 16 -32. 31.99902344 FORMAT "%8.4" AXIS_PTS_REF ldp_lamb_dif__eff_lamb /end AXIS_DESCR
/end CHARACTERISTIC
/begin AXIS_PTS ldp_lamb_dif__eff_lamb "" 0x10b38 online_dummy _REC_AXS_20_u2 63.99902344 _CNV_A_R_LINEAR_____266_CM 16 -32. 31.99902344 DISPLAY_IDENTIFIER LDP_LAMB_DIF__EFF_LAMB FORMAT "%8.4" /end AXIS_PTS
/begin MEASUREMENT lv_inh_r_down_ls_1 "Boolean flag indicating that downstream sensor internal resistance determiantion shall be inhibited when set" UBYTE _CNV_S_2_RANGE______5_CM 1 100. 0. 1. DISPLAY_IDENTIFIER LV_INH_R_DOWN_LS_1 ECU_ADDRESS 0x3fdfe5 /end MEASUREMENT
/begin MEASUREMENT lv_inh_r_down_ls_2 "Boolean flag indicating that downstream sensor internal resistance determiantion shall be inhibited when set" UBYTE _CNV_S_2_RANGE______5_CM 1 100. 0. 1. DISPLAY_IDENTIFIER LV_INH_R_DOWN_LS_2 ECU_ADDRESS 0x3fdfe6 /end MEASUREMENT
/begin MEASUREMENT lv_inh_r_up_ls_2 "Boolean flag indicating that upstrem sensor internal resistance determination shall be inhibited when set" UBYTE _CNV_S_2_RANGE______5_CM 1 100. 0. 1. DISPLAY_IDENTIFIER LV_INH_R_UP_LS_2 ECU_ADDRESS 0x3fe01b /end MEASUREMENT
/begin MEASUREMENT lv_inh_r_up_ls_1 "Boolean flag indicating that upstrem sensor internal resistance determination shall be inhibited when set" UBYTE _CNV_S_2_RANGE______5_CM 1 100. 0. 1. DISPLAY_IDENTIFIER LV_INH_R_UP_LS_1 ECU_ADDRESS 0x3fe01a /end MEASUREMENT
/begin MEASUREMENT maf_max_cor "Maximum intake air depending on engine speed an air density" UWORD _CNV_A_R_LINEAR_____106_CM 1 100. 0. 1389. DISPLAY_IDENTIFIER MAF_MAX_COR ECU_ADDRESS 0x3fcf66 BYTE_ORDER MSB_LAST FORMAT "%6.2" /end MEASUREMENT
/begin MEASUREMENT eff_maf_s "Air efficiency in stratified combustion" UWORD _CNV_A_R_LINEAR_____21_CM 1 100. 0. 1.99996948 DISPLAY_IDENTIFIER EFF_MAF_S ECU_ADDRESS 0x3fcf24 BYTE_ORDER MSB_LAST FORMAT "%7.5" /end MEASUREMENT
/begin MEASUREMENT iga_igc_0_5 "Ignition angle applied on the respective cylinder (0 to 5)" UBYTE _CNV_A_R_LINEAR_____203_CM 1 100. -35.625 60. DISPLAY_IDENTIFIER IGA_IGC_0_5 ECU_ADDRESS 0x3fe22b FORMAT "%5.1" /end MEASUREMENT
/begin MEASUREMENT iga_knk_0_5 "Spark retard due to knocking combustion of the respective cylinder (0 to 5)" UBYTE _CNV_A_R_LINEAR_____205_CM 1 100. -48. 0. DISPLAY_IDENTIFIER IGA_KNK_0_5 ECU_ADDRESS 0x3fe22c FORMAT "%5.1" /end MEASUREMENT
/begin MEASUREMENT knk_thd_0_5 "Knock threshold of the respective cylinder (0 to 5)" UBYTE _CNV_A_R_LINEAR_____44_CM 1 100. 0. 4.998 DISPLAY_IDENTIFIER KNK_THD_0_5 ECU_ADDRESS 0x3fe22d FORMAT "%6.4" /end MEASUREMENT
/begin MEASUREMENT nl_0_5 "Noise level of the respective cylinder (0 to 5)" UWORD _CNV_A_R_LINEAR_____250_CM 1 100. 0. 4.99992371 DISPLAY_IDENTIFIER NL_0_5 ECU_ADDRESS 0x3fd3f2 BYTE_ORDER MSB_LAST FORMAT "%7.5" /end MEASUREMENT
/begin MEASUREMENT ti_cyl_0_5 "fuel injection time for the respective cylinder (0 to 5)" UWORD _CNV_A_R_LINEAR_____198_CM 1 100. 0. 262.14 DISPLAY_IDENTIFIER TI_CYL_0_5 ECU_ADDRESS 0x3fd3f4 BYTE_ORDER MSB_LAST FORMAT "%7.3" /end MEASUREMENT
/begin MEASUREMENT knks_0_5 "Knock control signal of the respective cylinder (0 to 5)" UWORD _CNV_A_R_LINEAR_____250_CM 1 100. 0. 4.99992371 DISPLAY_IDENTIFIER KNKS_0_5 ECU_ADDRESS 0x3fd3f0 BYTE_ORDER MSB_LAST FORMAT "%7.5" /end MEASUREMENT
/begin MEASUREMENT acp "AC-fluid presssure" UBYTE _CNV_A_R_LINEAR_____381_CM 1 100. 0. 127.5 DISPLAY_IDENTIFIER ACP ECU_ADDRESS 0x3fe1f4 FORMAT "%6.2" /end MEASUREMENT
/begin CHARACTERISTIC ip_fac_tq_loss_acc_on "TQ_LOSS_ACC weighting factor at ACC activation" MAP 0x055ac _REC_MAP_20_u1_u1_u1 1.99220002 _CNV_A_R_LINEAR_____39_CM 0. 1.99220002 DISPLAY_IDENTIFIER IP_FAC_TQ_LOSS_ACC_ON FORMAT "%5.3"
 /begin AXIS_DESCR COM_AXIS t_acc _CNV_A_R_LINEAR_____4_CM 8 0. 2.55 FORMAT "%4.2" AXIS_PTS_REF ldp_t_acc_ip_fac_tq_loss_acc_on /end AXIS_DESCR
 /begin AXIS_DESCR COM_AXIS n_32 _CNV_A_R_LINEAR_____16_CM 8 0. 8160. FORMAT "%4.0" AXIS_PTS_REF ldp_n_32_ip_fac_tq_loss_acc_on /end AXIS_DESCR
/end CHARACTERISTIC
/begin CHARACTERISTIC ip_fac_tq_loss_acc_off "TQ_LOSS_ACC weighting factor at ACC deactivation" CURVE 0x00bec _REC_CUR_20_u1_u1 1.99220002 _CNV_A_R_LINEAR_____39_CM 0. 1.99220002 DISPLAY_IDENTIFIER IP_FAC_TQ_LOSS_ACC_OFF FORMAT "%5.3"
 /begin AXIS_DESCR COM_AXIS t_acc _CNV_A_R_LINEAR_____4_CM 8 0. 2.55 FORMAT "%4.2" AXIS_PTS_REF ldp_t_acc_fac_tq_loss_acc /end AXIS_DESCR
/end CHARACTERISTIC
/begin MEASUREMENT tq_add_acc "Torque reserve for switching on air conditioning compressor" SWORD _CNV_A_R_LINEAR_____55_CM 1 100. -1024. 1023.96875 DISPLAY_IDENTIFIER TQ_ADD_ACC ECU_ADDRESS 0x3fd8f2 BYTE_ORDER MSB_LAST FORMAT "%7.1" /end MEASUREMENT
/begin MEASUREMENT tq_loss_acc "Engine torque losses air conditioning compressor" SWORD _CNV_A_R_LINEAR_____55_CM 1 100. -1024. 1023.96875 DISPLAY_IDENTIFIER TQ_LOSS_ACC ECU_ADDRESS 0x3fd8f0 BYTE_ORDER MSB_LAST FORMAT "%8.2" /end MEASUREMENT
/begin MEASUREMENT tq_add_heat_acc "Torque reserve for switching on additional heating by ACC" SWORD _CNV_A_R_LINEAR_____55_CM 1 100. -1024. 1023.96875 DISPLAY_IDENTIFIER TQ_ADD_HEAT_ACC ECU_ADDRESS 0x3fd8f4 BYTE_ORDER MSB_LAST FORMAT "%8.2" /end MEASUREMENT
/begin MEASUREMENT lv_tout_acc "logical variable to start deactivation of torque reserve and condition for switch off TQ_LOSS_ACC calculation" UBYTE _CNV_S_2_RANGE______0_CM 1 100. 0. 1. DISPLAY_IDENTIFIER LV_TOUT_ACC ECU_ADDRESS 0x3fe3b1 /end MEASUREMENT
/begin MEASUREMENT lv_req_heat_acc_ena "LV indicating that the conditions for additional heating are fulfilled" UBYTE _CNV_S_2_RANGE______0_CM 1 100. 0. 1. DISPLAY_IDENTIFIER LV_REQ_HEAT_ACC_ENA ECU_ADDRESS 0x3fe561 /end MEASUREMENT
/begin MEASUREMENT lv_tout_req_heat_acc "logical variable to start deactivation of torque reserve TQ_ADD_HEAT_ACC" UBYTE _CNV_S_2_RANGE______0_CM 1 100. 0. 1. DISPLAY_IDENTIFIER LV_TOUT_REQ_HEAT_ACC ECU_ADDRESS 0x3fe562 /end MEASUREMENT
/begin MEASUREMENT t_req_heat_acc "timer for duration of torque reserve TQ_ADD_HEAT_ACC calculation" UBYTE _CNV_A_R_LINEAR_____4_CM 1 100. 0. 2.55 DISPLAY_IDENTIFIER T_REQ_HEAT_ACC ECU_ADDRESS 0x3fe560 FORMAT "%4.2" /end MEASUREMENT
/begin CHARACTERISTIC ip_tq_add_acc "Torque reserve for switching on air conditioning compressor" MAP 0x0f862 _REC_MAP_20_u2_u1_u2 2047.96875 _CNV_A_R_LINEAR_____186_CM -1024. 1023.96875 DISPLAY_IDENTIFIER IP_TQ_ADD_ACC FORMAT "%6.2"
 /begin AXIS_DESCR COM_AXIS n_32 _CNV_A_R_LINEAR_____16_CM 6 0. 8160. FORMAT "%4.0" AXIS_PTS_REF ldp_n_32__tq_add_acc /end AXIS_DESCR
 /begin AXIS_DESCR COM_AXIS tq_loss_acc_inp _CNV_A_R_LINEAR_____186_CM 6 -1024. 1023.96875 FORMAT "%6.2" AXIS_PTS_REF ldp_tq_loss_acc_inp__tq_add_acc /end AXIS_DESCR
/end CHARACTERISTIC
/begin CHARACTERISTIC ip_tq_add_heat_acc "Torque reserve for switching on additional heating" CURVE 0x0f99a _REC_CUR_20_u2_u1 2047.96875 _CNV_A_R_LINEAR_____186_CM -1024. 1023.96875 DISPLAY_IDENTIFIER IP_TQ_ADD_HEAT_ACC FORMAT "%6.2"
 /begin AXIS_DESCR COM_AXIS n_32 _CNV_A_R_LINEAR_____16_CM 6 0. 8160. FORMAT "%4.0" AXIS_PTS_REF ldp_n_32__tq_add_heat_acc /end AXIS_DESCR
/end CHARACTERISTIC
/begin CHARACTERISTIC c_tq_add_acc_lgrd "Limitation gradiant for TQ_ADD_ACC decrease after deactivation" VALUE 0x0196e _REC_VAL_20_u2 1023.96875 _CNV_A_R_LINEAR_____55_CM 0. 1023.96875 DISPLAY_IDENTIFIER C_TQ_ADD_ACC_LGRD FORMAT "%7.2" /end CHARACTERISTIC
/begin CHARACTERISTIC c_tq_add_heat_acc_lgrd "Limitation gradient for TQ_ADD_HEAT_ACC decrease after deactivation" VALUE 0x01976 _REC_VAL_20_u2 1023.96875 _CNV_A_R_LINEAR_____55_CM 0. 1023.96875 DISPLAY_IDENTIFIER C_TQ_ADD_HEAT_ACC_LGRD FORMAT "%7.2" /end CHARACTERISTIC
/begin CHARACTERISTIC c_tco_min_req_heat_acc "TCO threshold for enabling additional heat request" VALUE 0x0088f _REC_VAL_20_u1 190.5 _CNV_A_R_LINEAR_____12_CM -48. 142.5 DISPLAY_IDENTIFIER C_TCO_MIN_REQ_HEAT_ACC FORMAT "%5.1" /end CHARACTERISTIC
/begin CHARACTERISTIC c_tam_min_req_heat_acc "TAM threshold for enabling additional heat request" VALUE 0x0084f _REC_VAL_20_u1 190.5 _CNV_A_R_LINEAR_____12_CM -48. 142.5 DISPLAY_IDENTIFIER C_TAM_MIN_REQ_HEAT_ACC FORMAT "%5.1" /end CHARACTERISTIC
/begin CHARACTERISTIC c_tq_loss_max_acc "Maximum TQ_LOSS_ACC" VALUE 0x004a6 _REC_VAL_20_s2 2047.96875 _CNV_A_R_LINEAR_____55_CM -1024. 1023.96875 DISPLAY_IDENTIFIER C_TQ_LOSS_MAX_ACC FORMAT "%8.2" /end CHARACTERISTIC
/begin AXIS_PTS ldp_t_acc_ip_fac_tq_loss_acc_on "" 0x07d5f t_acc _REC_AXS_20_u1 2.55 _CNV_A_R_LINEAR_____4_CM 8 0. 2.55 DISPLAY_IDENTIFIER LDP_T_ACC_IP_FAC_TQ_LOSS_ACC_ON FORMAT "%4.2" /end AXIS_PTS
/begin AXIS_PTS ldp_n_32_ip_fac_tq_loss_acc_on "" 0x07c6d n_32 _REC_AXS_20_u1 8160. _CNV_A_R_LINEAR_____16_CM 8 0. 8160. DISPLAY_IDENTIFIER LDP_N_32_IP_FAC_TQ_LOSS_ACC_ON FORMAT "%4.0" /end AXIS_PTS
/begin AXIS_PTS ldp_n_32__tq_add_acc "" 0x01050 n_32 _REC_AXS_20_u1 8160. _CNV_A_R_LINEAR_____16_CM 6 0. 8160. DISPLAY_IDENTIFIER LDP_N_32__TQ_ADD_ACC FORMAT "%4.0" /end AXIS_PTS
/begin AXIS_PTS ldp_t_acc_fac_tq_loss_acc "" 0x07d56 t_acc _REC_AXS_20_u1 2.55 _CNV_A_R_LINEAR_____4_CM 8 0. 2.55 DISPLAY_IDENTIFIER LDP_T_ACC_FAC_TQ_LOSS_ACC FORMAT "%4.2" /end AXIS_PTS
/begin AXIS_PTS ldp_n_32__tq_add_heat_acc "" 0x01057 n_32 _REC_AXS_20_u1 8160. _CNV_A_R_LINEAR_____16_CM 6 0. 8160. DISPLAY_IDENTIFIER LDP_N_32__TQ_ADD_HEAT_ACC FORMAT "%4.0" /end AXIS_PTS
/begin MEASUREMENT tq_loss_acc_inp "ACC-torque for torque function" SWORD _CNV_A_R_LINEAR_____55_CM 1 100. -1024. 1023.96875 DISPLAY_IDENTIFIER TQ_LOSS_ACC_INP ECU_ADDRESS 0x3fd8f6 BYTE_ORDER MSB_LAST FORMAT "%8.2" /end MEASUREMENT
/begin CHARACTERISTIC c_crlc_tq_loss_acc_inp "Correlation factor for TQ_ACCIN_CAN calculation" VALUE 0x0063c _REC_VAL_20_u1 0.9960940000000002 _CNV_A_R_LINEAR_____50_CM 0. 0.996094 DISPLAY_IDENTIFIER C_CRLC_TQ_LOSS_ACC_INP FORMAT "%5.3" /end CHARACTERISTIC
/begin AXIS_PTS ldp_tq_loss_acc_inp__tq_add_acc "" 0x11310 tq_loss_acc_inp _REC_AXS_20_u2 2047.96875 _CNV_A_R_LINEAR_____186_CM 6 -1024. 1023.96875 DISPLAY_IDENTIFIER LDP_TQ_LOSS_ACC_INP__TQ_ADD_ACC FORMAT "%6.2" /end AXIS_PTS
/begin CHARACTERISTIC c_tq_add_acc_lgrd_on "Limitation gradiant for TQ_ADD_ACC increase at activation" VALUE 0x01970 _REC_VAL_20_u2 1023.96875 _CNV_A_R_LINEAR_____55_CM 0. 1023.96875 DISPLAY_IDENTIFIER C_TQ_ADD_ACC_LGRD_ON FORMAT "%7.2" /end CHARACTERISTIC
/begin CHARACTERISTIC c_fil_aj_inp_0 "Filter constant 0 applied on input value of second order low pass filter" VALUE 0x003f4 _REC_VAL_20_s2 3.125e-002 _CNV_A_R_LINEAR_____456_CM -1.5625e-002 1.5625e-002 DISPLAY_IDENTIFIER C_FIL_AJ_INP_0 FORMAT "%6.5" /end CHARACTERISTIC
/begin CHARACTERISTIC c_fil_aj_inp_1 "Filter constant 1 applied on input value of second order low pass filter" VALUE 0x003f6 _REC_VAL_20_s2 3.125e-002 _CNV_A_R_LINEAR_____456_CM -1.5625e-002 1.5625e-002 DISPLAY_IDENTIFIER C_FIL_AJ_INP_1 FORMAT "%6.5" /end CHARACTERISTIC
/begin CHARACTERISTIC c_fil_aj_inp_2 "Filter constant 2 applied on input value of second order low pass filter" VALUE 0x003f8 _REC_VAL_20_s2 3.125e-002 _CNV_A_R_LINEAR_____456_CM -1.5625e-002 1.5625e-002 DISPLAY_IDENTIFIER C_FIL_AJ_INP_2 FORMAT "%6.5" /end CHARACTERISTIC
/begin CHARACTERISTIC c_fil_aj_out_1 "Filter constant 1 applied in output value of second order low pass filter" VALUE 0x003fa _REC_VAL_20_s2 3.999938965 _CNV_A_R_LINEAR_____265_CM -2. 1.999938965 DISPLAY_IDENTIFIER C_FIL_AJ_OUT_1 FORMAT "%8.4" /end CHARACTERISTIC
/begin CHARACTERISTIC c_fil_aj_out_2 "Filter constant 2 applied on output value of second order low pass filter" VALUE 0x003fc _REC_VAL_20_s2 3.999938965 _CNV_A_R_LINEAR_____265_CM -2. 1.999938965 DISPLAY_IDENTIFIER C_FIL_AJ_OUT_2 FORMAT "%8.4" /end CHARACTERISTIC
/begin CHARACTERISTIC id_fac_inv_veh_mass_at "Inverse vehicle mass equivalent for automatic transmission" CURVE 0x082f0 _REC_CUR_20_u2_u1 0.99998474 _CNV_A_R_LINEAR_____457_CM 0. 0.99998474 DISPLAY_IDENTIFIER ID_FAC_INV_VEH_MASS_AT FORMAT "%6.4"
 /begin AXIS_DESCR COM_AXIS gr_at _CNV_A_R_LINEAR_____1_CM 13 0. 255. FORMAT "%3.0" AXIS_PTS_REF ldpm_gr_at_100 /end AXIS_DESCR
/end CHARACTERISTIC
/begin CHARACTERISTIC id_fac_inv_veh_mass_mt "Inverse vehicle mass equivalent for manual transmission" CURVE 0x0830a _REC_CUR_20_u2_u1 0.99998474 _CNV_A_R_LINEAR_____457_CM 0. 0.99998474 DISPLAY_IDENTIFIER ID_FAC_INV_VEH_MASS_MT FORMAT "%6.4"
 /begin AXIS_DESCR COM_AXIS gr_mt _CNV_A_R_LINEAR_____1_CM 13 0. 255. FORMAT "%3.0" AXIS_PTS_REF ldpm_gr_mt_100 /end AXIS_DESCR
/end CHARACTERISTIC
/begin CHARACTERISTIC id_fac_tq_de_aj_at "Torque deviation compensation factor for AJ  N_DIF_REF determination" CURVE 0x08368 _REC_CUR_20_u2_u1 7.99987793 _CNV_A_R_LINEAR_____376_CM 0. 7.99987793 DISPLAY_IDENTIFIER ID_FAC_TQ_DE_AJ_AT FORMAT "%6.4"
 /begin AXIS_DESCR COM_AXIS gr_at _CNV_A_R_LINEAR_____1_CM 13 0. 255. FORMAT "%3.0" AXIS_PTS_REF ldpm_gr_at_100 /end AXIS_DESCR
/end CHARACTERISTIC
/begin CHARACTERISTIC id_fac_tq_de_aj_mt "Engine speed difference threshold for acitvation anti jerk function" CURVE 0x08382 _REC_CUR_20_u2_u1 7.99987793 _CNV_A_R_LINEAR_____376_CM 0. 7.99987793 DISPLAY_IDENTIFIER ID_FAC_TQ_DE_AJ_MT FORMAT "%6.4"
 /begin AXIS_DESCR COM_AXIS gr_mt _CNV_A_R_LINEAR_____1_CM 13 0. 255. FORMAT "%3.0" AXIS_PTS_REF ldpm_gr_mt_100 /end AXIS_DESCR
/end CHARACTERISTIC
/begin MEASUREMENT n_dif_aj "engine-speed deviation at jerking vehicle" SWORD _CNV_A_R_LINEAR_____11_CM 1 100. -32768. 32767. DISPLAY_IDENTIFIER N_DIF_AJ ECU_ADDRESS 0x3fda1a BYTE_ORDER MSB_LAST FORMAT "%6.0" /end MEASUREMENT
/begin MEASUREMENT n_dif_ref_lpf_aj "low-pass filtered N_DIF_REF_AJ for AJ function " SWORD _CNV_A_R_LINEAR_____458_CM 1 100. -512. 511.98 DISPLAY_IDENTIFIER N_DIF_REF_LPF_AJ ECU_ADDRESS 0x3fda1e BYTE_ORDER MSB_LAST FORMAT "%7.2" /end MEASUREMENT
/begin MEASUREMENT tq_dif_aj "Torque output for anti  jerk " SWORD _CNV_A_R_LINEAR_____55_CM 1 100. -1024. 1023.96875 DISPLAY_IDENTIFIER TQ_DIF_AJ ECU_ADDRESS 0x3fda18 BYTE_ORDER MSB_LAST FORMAT "%6.2" /end MEASUREMENT
/begin MEASUREMENT tq_fast_clu "fast torque request at clutch" SWORD _CNV_A_R_LINEAR_____55_CM 1 100. -1024. 1023.96875 DISPLAY_IDENTIFIER TQ_FAST_CLU ECU_ADDRESS 0x3fda20 BYTE_ORDER MSB_LAST FORMAT "%6.2" /end MEASUREMENT
/begin MEASUREMENT tq_mdl_de_aj "torque deviation compensation for AJ" SWORD _CNV_A_R_LINEAR_____55_CM 1 100. -1024. 1023.96875 DISPLAY_IDENTIFIER TQ_MDL_DE_AJ ECU_ADDRESS 0x3fda22 BYTE_ORDER MSB_LAST FORMAT "%6.2" /end MEASUREMENT
/begin MEASUREMENT n_ref_aj "reference engine-speed for anti-jerk function" SWORD _CNV_A_R_LINEAR_____11_CM 1 100. -32768. 32767. DISPLAY_IDENTIFIER N_REF_AJ ECU_ADDRESS 0x3fcd24 BYTE_ORDER MSB_LAST FORMAT "%6.0" /end MEASUREMENT
/begin CHARACTERISTIC c_n_dif_ref_aj_max "Maximum limitation of N_DIF_REF_AJ" VALUE 0x00446 _REC_VAL_20_s2 65535. _CNV_A_R_LINEAR_____11_CM -32768. 32767. DISPLAY_IDENTIFIER C_N_DIF_REF_AJ_MAX FORMAT "%6.0" /end CHARACTERISTIC
/begin CHARACTERISTIC c_n_dif_ref_aj_min "Minimum limitation of N_DIF_REF_AJ" VALUE 0x00448 _REC_VAL_20_s2 65535. _CNV_A_R_LINEAR_____11_CM -32768. 32767. DISPLAY_IDENTIFIER C_N_DIF_REF_AJ_MIN FORMAT "%6.0" /end CHARACTERISTIC
/begin MEASUREMENT n_dif_ref_aj "limited reference engine-speed deviation for anti-jerk function" SWORD _CNV_A_R_LINEAR_____11_CM 1 100. -32768. 32767. DISPLAY_IDENTIFIER N_DIF_REF_AJ ECU_ADDRESS 0x3fda1c BYTE_ORDER MSB_LAST FORMAT "%6.0" /end MEASUREMENT
/begin MEASUREMENT n_dif_ref_aj_inter "reference engine-speed deviation for anti-jerk function without limitation" SWORD _CNV_A_R_LINEAR_____11_CM 1 100. -32768. 32767. DISPLAY_IDENTIFIER N_DIF_REF_AJ_INTER ECU_ADDRESS 0x3fda24 BYTE_ORDER MSB_LAST FORMAT "%6.0" /end MEASUREMENT
/begin CHARACTERISTIC ip_fac_tq_aj "Torque conversion factor for anti-jerk funktion" MAP 0x0b33e _REC_MAP_20_u2_u1_u1 4. _CNV_A_R_LINEAR_____264_CM -2. 2. DISPLAY_IDENTIFIER IP_FAC_TQ_AJ FORMAT "%8.5"
 /begin AXIS_DESCR COM_AXIS n_32 _CNV_A_R_LINEAR_____16_CM 8 0. 8160. FORMAT "%4.0" AXIS_PTS_REF ldp_n_32__fac_tq_aj /end AXIS_DESCR
 /begin AXIS_DESCR COM_AXIS gear _CNV_A_R_LINEAR_____1_CM 6 0. 6. FORMAT "%1.0" AXIS_PTS_REF ldp_gear__fac_tq_aj /end AXIS_DESCR
/end CHARACTERISTIC
/begin AXIS_PTS ldpm_gr_at_100 "" 0x07f4c gr_at _REC_AXS_20_u1 255. _CNV_A_R_LINEAR_____1_CM 13 0. 255. DISPLAY_IDENTIFIER LDPM_GR_AT_100 FORMAT "%3.0" /end AXIS_PTS
/begin AXIS_PTS ldpm_gr_mt_100 "" 0x07f68 gr_mt _REC_AXS_20_u1 255. _CNV_A_R_LINEAR_____1_CM 13 0. 255. DISPLAY_IDENTIFIER LDPM_GR_MT_100 FORMAT "%3.0" /end AXIS_PTS
/begin AXIS_PTS ldp_n_32__fac_tq_aj "" 0x07bd6 n_32 _REC_AXS_20_u1 8160. _CNV_A_R_LINEAR_____16_CM 8 0. 8160. DISPLAY_IDENTIFIER LDP_N_32__FAC_TQ_AJ FORMAT "%4.0" /end AXIS_PTS
/begin AXIS_PTS ldp_gear__fac_tq_aj "" 0x00fdd gear _REC_AXS_20_u1 6. _CNV_A_R_LINEAR_____1_CM 6 0. 6. DISPLAY_IDENTIFIER LDP_GEAR__FAC_TQ_AJ FORMAT "%1.0" /end AXIS_PTS
/begin CHARACTERISTIC c_t_pas_aj_dly "Delay time after closed drivetrain determination for PT2 filter actualisation" VALUE 0x00835 _REC_VAL_20_u1 2.55 _CNV_A_R_LINEAR_____4_CM 0. 2.55 DISPLAY_IDENTIFIER C_T_PAS_AJ_DLY FORMAT "%3.2" /end CHARACTERISTIC
/begin MEASUREMENT tq_conv_can_1 "converter torque of CAN" SWORD _CNV_A_R_LINEAR_____55_CM 1 100. -1024. 1023.96875 DISPLAY_IDENTIFIER TQ_CONV_CAN_1 ECU_ADDRESS 0x3fd8fc BYTE_ORDER MSB_LAST FORMAT "%6.2" /end MEASUREMENT
/begin MEASUREMENT tq_add_conv "Torque reserve for switching converter Torque" SWORD _CNV_A_R_LINEAR_____55_CM 1 100. -1024. 1023.96875 DISPLAY_IDENTIFIER TQ_ADD_CONV ECU_ADDRESS 0x3fd8fe BYTE_ORDER MSB_LAST FORMAT "%6.2" /end MEASUREMENT
/begin MEASUREMENT lv_tout_conv "logical variable to start deactivation of torque reserve and condition for switch off TQ_CONV calculation" UBYTE _CNV_S_2_RANGE______0_CM 1 100. 0. 1. DISPLAY_IDENTIFIER LV_TOUT_CONV ECU_ADDRESS 0x3fe573 /end MEASUREMENT
/begin MEASUREMENT t_conv "timer for duration of transient TQ_LOSS_CONV correction" UWORD _CNV_A_R_LINEAR_____4_CM 1 100. 0. 5.1 DISPLAY_IDENTIFIER T_CONV ECU_ADDRESS 0x3fd908 BYTE_ORDER MSB_LAST FORMAT "%4.2" /end MEASUREMENT
/begin CHARACTERISTIC c_tq_add_conv_lgrd "Limitation gradient for TQ_ADD_CONV decrease after deactivation" VALUE 0x01974 _REC_VAL_20_u2 1023.96875 _CNV_A_R_LINEAR_____55_CM 0. 1023.96875 DISPLAY_IDENTIFIER C_TQ_ADD_CONV_LGRD FORMAT "%7.2" /end CHARACTERISTIC
/begin MEASUREMENT tq_add_trans "Torque reserve for Transmission" SWORD _CNV_A_R_LINEAR_____55_CM 1 100. -1024. 1023.96875 DISPLAY_IDENTIFIER TQ_ADD_TRANS ECU_ADDRESS 0x3fd902 BYTE_ORDER MSB_LAST FORMAT "%8.2" /end MEASUREMENT
/begin CHARACTERISTIC ip_tq_add_conv "Torque reserve for switch GS" MAP 0x0f8b6 _REC_MAP_20_u2_u1_u1 2047.96875 _CNV_A_R_LINEAR_____186_CM -1024. 1023.96875 DISPLAY_IDENTIFIER IP_TQ_ADD_CONV FORMAT "%6.2"
 /begin AXIS_DESCR COM_AXIS n_32 _CNV_A_R_LINEAR_____16_CM 6 0. 8160. FORMAT "%4.0" AXIS_PTS_REF ldp_n_32_ip_tq_add_conv /end AXIS_DESCR
 /begin AXIS_DESCR COM_AXIS toil _CNV_A_R_LINEAR_____15_CM 6 -40. 160. FORMAT "%3.0" AXIS_PTS_REF ldpm_toil_tq_add_conv /end AXIS_DESCR
/end CHARACTERISTIC
/begin MEASUREMENT lv_dly_n_sp_is "Flag for idle speed setpoint change" UBYTE _CNV_S_2_RANGE______5_CM 1 100. 0. 1. DISPLAY_IDENTIFIER LV_DLY_N_SP_IS ECU_ADDRESS 0x3fe572 BIT_MASK 0x1 /end MEASUREMENT
/begin MEASUREMENT tq_conv_stn "Stationary Converter Torque" SWORD _CNV_A_R_LINEAR_____55_CM 1 100. -1024. 1023.96875 DISPLAY_IDENTIFIER TQ_CONV_STN ECU_ADDRESS 0x3fd910 BYTE_ORDER MSB_LAST FORMAT "%6.2" /end MEASUREMENT
/begin CHARACTERISTIC lc_tq_conv_dri_inh "logical constant converter torque calculation at LV_DRI = 0 inhibit" VALUE 0x00f7f _REC_VAL_20_u1 1. _CNV_A_R_LINEAR_____1_CM 0. 1. DISPLAY_IDENTIFIER LC_TQ_CONV_DRI_INH FORMAT "%2.0" /end CHARACTERISTIC
/begin CHARACTERISTIC lc_tq_conv_can_inh "logical constant converter torque by CAN-interface inhibit" VALUE 0x00f7e _REC_VAL_20_u1 1. _CNV_A_R_LINEAR_____1_CM 0. 1. DISPLAY_IDENTIFIER LC_TQ_CONV_CAN_INH FORMAT "%2.0" /end CHARACTERISTIC
/begin CHARACTERISTIC ip_fac_conv__toil "Converter characteristic" CURVE 0x0aa4e _REC_CUR_20_u2_u1 4.88e-004 _CNV_A_R_LINEAR_____459_CM 0. 4.88e-004 DISPLAY_IDENTIFIER IP_FAC_CONV__TOIL FORMAT "%8.7"
 /begin AXIS_DESCR COM_AXIS toil _CNV_A_R_LINEAR_____15_CM 8 -40. 160. FORMAT "%3.0" AXIS_PTS_REF ldp_toil_fac_conv /end AXIS_DESCR
/end CHARACTERISTIC
/begin CHARACTERISTIC ip_fac_conv_dri__toil "Converter characteristic" CURVE 0x0aa5e _REC_CUR_20_u2_u1 4.88e-004 _CNV_A_R_LINEAR_____459_CM 0. 4.88e-004 DISPLAY_IDENTIFIER IP_FAC_CONV_DRI__TOIL FORMAT "%8.7"
 /begin AXIS_DESCR COM_AXIS toil _CNV_A_R_LINEAR_____15_CM 8 -40. 160. FORMAT "%3.0" AXIS_PTS_REF ldp_toil_fac_conv /end AXIS_DESCR
/end CHARACTERISTIC
/begin CHARACTERISTIC ip_t_dly_conv__toil "Time delay for TQ_CONV activation" CURVE 0x00de9 _REC_CUR_20_u1_u1 2550. _CNV_A_R_LINEAR_____31_CM 0. 2550. DISPLAY_IDENTIFIER IP_T_DLY_CONV__TOIL FORMAT "%4.0"
 /begin AXIS_DESCR COM_AXIS toil _CNV_A_R_LINEAR_____15_CM 8 -40. 160. FORMAT "%3.0" AXIS_PTS_REF ldp_toil_t_dly_conv /end AXIS_DESCR
/end CHARACTERISTIC
/begin CHARACTERISTIC ip_t_dly_n_sp_is__toil "Time delay for change of idle speed setpoint " CURVE 0x00df1 _REC_CUR_20_u1_u1 2550. _CNV_A_R_LINEAR_____31_CM 0. 2550. DISPLAY_IDENTIFIER IP_T_DLY_N_SP_IS__TOIL FORMAT "%4.0"
 /begin AXIS_DESCR COM_AXIS toil _CNV_A_R_LINEAR_____15_CM 8 -40. 160. FORMAT "%3.0" AXIS_PTS_REF ldp_toil_t_dly_n_sp_is /end AXIS_DESCR
/end CHARACTERISTIC
/begin CHARACTERISTIC ip_fac_tq_conv__n_ratio_conv "Torque request factor" CURVE 0x0b39e _REC_CUR_20_u2_u1 1.99996948 _CNV_A_R_LINEAR_____21_CM 0. 1.99996948 DISPLAY_IDENTIFIER IP_FAC_TQ_CONV__N_RATIO_CONV FORMAT "%7.5"
 /begin AXIS_DESCR COM_AXIS n_ratio_conv _CNV_A_R_LINEAR_____50_CM 8 0. 0.996094 FORMAT "%5.3" AXIS_PTS_REF ldp_n_ratio_conv_fac_tq_conv /end AXIS_DESCR
/end CHARACTERISTIC
/begin MEASUREMENT tq_conv "Converter Torque" SWORD _CNV_A_R_LINEAR_____55_CM 1 100. -1024. 1023.96875 DISPLAY_IDENTIFIER TQ_CONV ECU_ADDRESS 0x3fd8fa BYTE_ORDER MSB_LAST FORMAT "%6.2" /end MEASUREMENT
/begin CHARACTERISTIC ip_n_tur__gr_at__vs "Turbine speed" MAP 0x0cf7e _REC_MAP_20_u2_u1_u1 65535. _CNV_A_R_LINEAR_____11_CM 0. 65535. DISPLAY_IDENTIFIER IP_N_TUR__GR_AT__VS FORMAT "%5.0"
 /begin AXIS_DESCR COM_AXIS gr_at _CNV_A_R_LINEAR_____1_CM 13 0. 8. FORMAT "%1.0" AXIS_PTS_REF ldp_gr_at_n_tur /end AXIS_DESCR
 /begin AXIS_DESCR COM_AXIS vs _CNV_A_R_LINEAR_____23_CM 2 0. 255. FORMAT "%3.0" AXIS_PTS_REF ldp_vs_n_tur /end AXIS_DESCR
/end CHARACTERISTIC
/begin CHARACTERISTIC ip_tq_conv_can "Corrected Converter tourque via N_32" MAP 0x0faba _REC_MAP_20_u2_u1_u2 2047.96875 _CNV_A_R_LINEAR_____186_CM -1024. 1023.96875 DISPLAY_IDENTIFIER IP_TQ_CONV_CAN FORMAT "%6.2"
 /begin AXIS_DESCR COM_AXIS n_32 _CNV_A_R_LINEAR_____16_CM 8 0. 8160. FORMAT "%4.0" AXIS_PTS_REF ldp_n_32__tq_conv /end AXIS_DESCR
 /begin AXIS_DESCR COM_AXIS tq_conv_can _CNV_A_R_LINEAR_____186_CM 8 -1024. 1023.96875 FORMAT "%6.2" AXIS_PTS_REF ldp_tq_conv_can__tq_conv /end AXIS_DESCR
/end CHARACTERISTIC
/begin AXIS_PTS ldp_n_32_ip_tq_add_conv "" 0x0109f n_32 _REC_AXS_20_u1 8160. _CNV_A_R_LINEAR_____16_CM 6 0. 8160. DISPLAY_IDENTIFIER LDP_N_32_IP_TQ_ADD_CONV FORMAT "%4.0" /end AXIS_PTS
/begin AXIS_PTS ldp_n_ratio_conv_fac_tq_conv "" 0x07d11 n_ratio_conv _REC_AXS_20_u1 0.9960940000000002 _CNV_A_R_LINEAR_____50_CM 8 0. 0.996094 DISPLAY_IDENTIFIER LDP_N_RATIO_CONV_FAC_TQ_CONV FORMAT "%5.3" /end AXIS_PTS
/begin AXIS_PTS ldp_toil_t_dly_n_sp_is "" 0x07e7a toil _REC_AXS_20_u1 200. _CNV_A_R_LINEAR_____15_CM 8 -40. 160. DISPLAY_IDENTIFIER LDP_TOIL_T_DLY_N_SP_IS FORMAT "%3.0" /end AXIS_PTS
/begin AXIS_PTS ldp_toil_t_dly_conv "" 0x07e71 toil _REC_AXS_20_u1 200. _CNV_A_R_LINEAR_____15_CM 8 -40. 160. DISPLAY_IDENTIFIER LDP_TOIL_T_DLY_CONV FORMAT "%3.0" /end AXIS_PTS
/begin AXIS_PTS ldp_toil_fac_conv "" 0x07e5d toil _REC_AXS_20_u1 200. _CNV_A_R_LINEAR_____15_CM 8 -40. 160. DISPLAY_IDENTIFIER LDP_TOIL_FAC_CONV FORMAT "%3.0" /end AXIS_PTS
/begin AXIS_PTS ldp_gr_at_n_tur "" 0x07af2 gr_at _REC_AXS_20_u1 8. _CNV_A_R_LINEAR_____1_CM 13 0. 8. DISPLAY_IDENTIFIER LDP_GR_AT_N_TUR FORMAT "%1.0" /end AXIS_PTS
/begin AXIS_PTS ldp_n_32__tq_conv "" 0x07c64 n_32 _REC_AXS_20_u1 8160. _CNV_A_R_LINEAR_____16_CM 8 0. 8160. DISPLAY_IDENTIFIER LDP_N_32__TQ_CONV FORMAT "%4.0" /end AXIS_PTS
/begin AXIS_PTS ldp_vs_n_tur "" 0x012b6 vs _REC_AXS_20_u1 255. _CNV_A_R_LINEAR_____23_CM 2 0. 255. DISPLAY_IDENTIFIER LDP_VS_N_TUR FORMAT "%3.0" /end AXIS_PTS
/begin AXIS_PTS ldp_tq_conv_can__tq_conv "" 0x112fe tq_conv_can _REC_AXS_20_u2 2047.96875 _CNV_A_R_LINEAR_____186_CM 8 -1024. 1023.96875 DISPLAY_IDENTIFIER LDP_TQ_CONV_CAN__TQ_CONV FORMAT "%6.2" /end AXIS_PTS
/begin AXIS_PTS ldpm_toil_tq_add_conv "" 0x0141c toil _REC_AXS_20_u1 200. _CNV_A_R_LINEAR_____15_CM 6 -40. 160. DISPLAY_IDENTIFIER LDPM_TOIL_TQ_ADD_CONV FORMAT "%3.0" /end AXIS_PTS
/begin AXIS_PTS ldpm_vs_tq_add_conv "" 0x01438 vs _REC_AXS_20_u1 255. _CNV_A_R_LINEAR_____23_CM 6 0. 255. DISPLAY_IDENTIFIER LDPM_VS_TQ_ADD_CONV FORMAT "%3.0" /end AXIS_PTS
/begin AXIS_PTS ldp_n_grd_tq_add_conv "" 0x010d5 n_grd _REC_AXS_20_u1 8160. _CNV_A_R_LINEAR_____54_CM 6 -4096. 4064. DISPLAY_IDENTIFIER LDP_N_GRD_TQ_ADD_CONV FORMAT "%5.0" /end AXIS_PTS
/begin AXIS_PTS ldp_ac_cru_tq_add_conv "" 0x1087c ac_cru _REC_AXS_20_u2 31.43952 _CNV_A_R_LINEAR_____460_CM 6 -15.72 15.71952 DISPLAY_IDENTIFIER LDP_AC_CRU_TQ_ADD_CONV FORMAT "%8.4" /end AXIS_PTS
/begin CHARACTERISTIC ip_tq_add_conv_ac "Torque reserve for switch GS by AC_CRU" MAP 0x0f8fe _REC_MAP_20_u2_u2_u1 2047.96875 _CNV_A_R_LINEAR_____186_CM -1024. 1023.96875 DISPLAY_IDENTIFIER IP_TQ_ADD_CONV_AC FORMAT "%6.2"
 /begin AXIS_DESCR COM_AXIS ac_cru _CNV_A_R_LINEAR_____460_CM 6 -15.72 15.71952 FORMAT "%8.4" AXIS_PTS_REF ldp_ac_cru_tq_add_conv /end AXIS_DESCR
 /begin AXIS_DESCR COM_AXIS vs _CNV_A_R_LINEAR_____23_CM 6 0. 255. FORMAT "%3.0" AXIS_PTS_REF ldpm_vs_tq_add_conv /end AXIS_DESCR
/end CHARACTERISTIC
/begin CHARACTERISTIC ip_tq_add_conv_n_grd "Torque reserve for switch GS by N_GRD" MAP 0x0f946 _REC_MAP_20_u2_u1_u1 2047.96875 _CNV_A_R_LINEAR_____186_CM -1024. 1023.96875 DISPLAY_IDENTIFIER IP_TQ_ADD_CONV_N_GRD FORMAT "%6.2"
 /begin AXIS_DESCR COM_AXIS n_grd _CNV_A_R_LINEAR_____54_CM 6 -4096. 4064. FORMAT "%5.0" AXIS_PTS_REF ldp_n_grd_tq_add_conv /end AXIS_DESCR
 /begin AXIS_DESCR COM_AXIS vs _CNV_A_R_LINEAR_____23_CM 6 0. 255. FORMAT "%3.0" AXIS_PTS_REF ldpm_vs_tq_add_conv /end AXIS_DESCR
/end CHARACTERISTIC
/begin CHARACTERISTIC ip_fac_tq_add_conv_toil "Torque reserve for switch GS" CURVE 0x0b332 _REC_CUR_20_u2_u1 1. _CNV_A_R_LINEAR_____461_CM 0. 1. DISPLAY_IDENTIFIER IP_FAC_TQ_ADD_CONV_TOIL FORMAT "%6.4"
 /begin AXIS_DESCR COM_AXIS toil _CNV_A_R_LINEAR_____15_CM 6 -40. 160. FORMAT "%3.0" AXIS_PTS_REF ldpm_toil_tq_add_conv /end AXIS_DESCR
/end CHARACTERISTIC
/begin MEASUREMENT tq_add_conv_2 "Torque reserve for switching converter Torque" SWORD _CNV_A_R_LINEAR_____55_CM 1 100. -1024. 1023.96875 DISPLAY_IDENTIFIER TQ_ADD_CONV_2 ECU_ADDRESS 0x3fd900 BYTE_ORDER MSB_LAST FORMAT "%6.2" /end MEASUREMENT
/begin MEASUREMENT tq_loss "Engine torque losses" SWORD _CNV_A_R_LINEAR_____55_CM 1 100. -1024. 1023.96875 DISPLAY_IDENTIFIER TQ_LOSS ECU_ADDRESS 0x3fd918 BYTE_ORDER MSB_LAST FORMAT "%6.2" /end MEASUREMENT
/begin MEASUREMENT tq_loss_1 "Engine torque losses before limiting" SWORD _CNV_A_R_LINEAR_____55_CM 1 100. -1024. 1023.96875 DISPLAY_IDENTIFIER TQ_LOSS_1 ECU_ADDRESS 0x3fd922 BYTE_ORDER MSB_LAST FORMAT "%6.2" /end MEASUREMENT
/begin MEASUREMENT tq_loss_req_clu "Engine torque losses without pumping losses for calculation of TQ_REQ_CLU" SWORD _CNV_A_R_LINEAR_____55_CM 1 100. -1024. 1023.96875 DISPLAY_IDENTIFIER TQ_LOSS_REQ_CLU ECU_ADDRESS 0x3fd91a BYTE_ORDER MSB_LAST FORMAT "%6.2" /end MEASUREMENT
/begin MEASUREMENT tqfr_mec "Mechanical friction torque of the engine" SWORD _CNV_A_R_LINEAR_____55_CM 1 100. -1024. 1023.96875 DISPLAY_IDENTIFIER TQFR_MEC ECU_ADDRESS 0x3fd924 BYTE_ORDER MSB_LAST FORMAT "%6.2" /end MEASUREMENT
/begin MEASUREMENT lv_tq_loss_lim_act "Flag for limiting torque losses is active" UBYTE _CNV_S_2_RANGE______0_CM 1 100. 0. 1. DISPLAY_IDENTIFIER LV_TQ_LOSS_LIM_ACT ECU_ADDRESS 0x3fe582 /end MEASUREMENT
/begin MEASUREMENT tqfr "Basis engine friction torque {visible is high word TQFR^sword(1)}" SWORD _CNV_A_R_LINEAR_____55_CM 1 100. -1024. 1023.96875 DISPLAY_IDENTIFIER TQFR ECU_ADDRESS 0x3fd926 BYTE_ORDER MSB_LAST FORMAT "%6.2" /end MEASUREMENT
/begin MEASUREMENT tqfr_bas "Basis engine friction torque inclusive Adaptation value" SWORD _CNV_A_R_LINEAR_____55_CM 1 100. -1024. 1023.96875 DISPLAY_IDENTIFIER TQFR_BAS ECU_ADDRESS 0x3fd928 BYTE_ORDER MSB_LAST FORMAT "%6.2" /end MEASUREMENT
/begin MEASUREMENT tqfr_add "Additive temperature correction of engine friction torque " SWORD _CNV_A_R_LINEAR_____55_CM 1 100. -1024. 1023.96875 DISPLAY_IDENTIFIER TQFR_ADD ECU_ADDRESS 0x3fd92a BYTE_ORDER MSB_LAST FORMAT "%6.2" /end MEASUREMENT
/begin MEASUREMENT tqfr_st "Additive start correction of engine friction torque" SWORD _CNV_A_R_LINEAR_____55_CM 1 100. -1024. 1023.96875 DISPLAY_IDENTIFIER TQFR_ST ECU_ADDRESS 0x3fd92c BYTE_ORDER MSB_LAST FORMAT "%6.2" /end MEASUREMENT
/begin CHARACTERISTIC ip_tqfr "Base friction torque and pumping losses" MAP 0x10116 _REC_MAP_20_u2_u2_u2 1024. _CNV_A_R_LINEAR_____186_CM -1024. 0. DISPLAY_IDENTIFIER IP_TQFR FORMAT "%6.2"
 /begin AXIS_DESCR COM_AXIS n _CNV_A_R_LINEAR_____11_CM 16 0. 8160. FORMAT "%4.0" AXIS_PTS_REF ldpm_n_100 /end AXIS_DESCR
 /begin AXIS_DESCR COM_AXIS maf _CNV_A_R_LINEAR_____106_CM 8 0. 1389. FORMAT "%7.2" AXIS_PTS_REF ldp_maf_cyl_stk__tqfr /end AXIS_DESCR
/end CHARACTERISTIC
/begin CHARACTERISTIC ip_tqfr_add "Coolant and oil temperature correction of friction  torque" MAP 0x10216 _REC_MAP_20_u2_u1_u1 2047.96875 _CNV_A_R_LINEAR_____186_CM -1024. 1023.96875 DISPLAY_IDENTIFIER IP_TQFR_ADD FORMAT "%6.2"
 /begin AXIS_DESCR COM_AXIS tco _CNV_A_R_LINEAR_____12_CM 8 -48. 142.5 FORMAT "%5.1" AXIS_PTS_REF ldp_tco__tqfr_add /end AXIS_DESCR
 /begin AXIS_DESCR COM_AXIS toil _CNV_A_R_LINEAR_____15_CM 8 -40. 160. FORMAT "%3.0" AXIS_PTS_REF ldp_toil_tqfr_add /end AXIS_DESCR
/end CHARACTERISTIC
/begin CHARACTERISTIC ip_tq_loss_lim "Torque losses limitation for safety" MAP 0x0feba _REC_MAP_20_u2_u2_u1 2047.96875 _CNV_A_R_LINEAR_____186_CM -1024. 1023.96875 DISPLAY_IDENTIFIER IP_TQ_LOSS_LIM FORMAT "%6.2"
 /begin AXIS_DESCR COM_AXIS n _CNV_A_R_LINEAR_____11_CM 6 0. 8160. FORMAT "%4.0" AXIS_PTS_REF ldp_n_tq_loss_lim /end AXIS_DESCR
 /begin AXIS_DESCR COM_AXIS tco _CNV_A_R_LINEAR_____12_CM 6 -48. 142.5 FORMAT "%5.1" AXIS_PTS_REF ldp_tco_tq_loss_lim /end AXIS_DESCR
/end CHARACTERISTIC
/begin CHARACTERISTIC ip_tqfr_st "Friction torque increase after start" CURVE 0x01b84 _REC_CUR_20_u2_u1 1024. _CNV_A_R_LINEAR_____186_CM -1024. 0. DISPLAY_IDENTIFIER IP_TQFR_ST FORMAT "%6.2"
 /begin AXIS_DESCR COM_AXIS tco_st _CNV_A_R_LINEAR_____12_CM 4 -48. 142.5 FORMAT "%5.1" AXIS_PTS_REF ldp_tco_st__tqfr_st /end AXIS_DESCR
/end CHARACTERISTIC
/begin CHARACTERISTIC ip_tqfr_dec_st "Decrement for start correction of friction torque" CURVE 0x01b7c _REC_CUR_20_u2_u1 1024. _CNV_A_R_LINEAR_____186_CM -1024. 0. DISPLAY_IDENTIFIER IP_TQFR_DEC_ST FORMAT "%6.2"
 /begin AXIS_DESCR COM_AXIS tco_st _CNV_A_R_LINEAR_____12_CM 4 -48. 142.5 FORMAT "%5.1" AXIS_PTS_REF ldp_tco_st__tqfr_dec_st /end AXIS_DESCR
/end CHARACTERISTIC
/begin CHARACTERISTIC c_maf_cyl_stk_ref "Constant for the determination of the friction losses" VALUE 0x01644 _REC_VAL_20_u2 1389. _CNV_A_R_LINEAR_____106_CM 0. 1389. DISPLAY_IDENTIFIER C_MAF_CYL_STK_REF FORMAT "%7.2" /end CHARACTERISTIC
/begin CHARACTERISTIC c_crlc_tq_loss_req_clu "Correlation constant for TQ_LOSS_REQ_CLU filtering" VALUE 0x0063d _REC_VAL_20_u1 0.9960940000000002 _CNV_A_R_LINEAR_____50_CM 0. 0.996094 DISPLAY_IDENTIFIER C_CRLC_TQ_LOSS_REQ_CLU FORMAT "%5.3" /end CHARACTERISTIC
/begin AXIS_PTS ldpm_n_100 "" 0x11820 n _REC_AXS_20_u2 8160. _CNV_A_R_LINEAR_____11_CM 16 0. 8160. DISPLAY_IDENTIFIER LDPM_N_100 FORMAT "%4.0" /end AXIS_PTS
/begin AXIS_PTS ldp_maf_cyl_stk__tqfr "" 0x10c22 maf _REC_AXS_20_u2 1389. _CNV_A_R_LINEAR_____106_CM 8 0. 1389. DISPLAY_IDENTIFIER LDP_MAF_CYL_STK__TQFR FORMAT "%7.2" /end AXIS_PTS
/begin AXIS_PTS ldp_tco__tqfr_add "" 0x07dcb tco _REC_AXS_20_u1 190.5 _CNV_A_R_LINEAR_____12_CM 8 -48. 142.5 DISPLAY_IDENTIFIER LDP_TCO__TQFR_ADD FORMAT "%5.1" /end AXIS_PTS
/begin AXIS_PTS ldp_toil_tqfr_add "" 0x07e95 toil _REC_AXS_20_u1 200. _CNV_A_R_LINEAR_____15_CM 8 -40. 160. DISPLAY_IDENTIFIER LDP_TOIL_TQFR_ADD FORMAT "%3.0" /end AXIS_PTS
/begin AXIS_PTS ldp_n_tq_loss_lim "" 0x11026 n _REC_AXS_20_u2 8160. _CNV_A_R_LINEAR_____11_CM 6 0. 8160. DISPLAY_IDENTIFIER LDP_N_TQ_LOSS_LIM FORMAT "%4.0" /end AXIS_PTS
/begin AXIS_PTS ldp_tco_tq_loss_lim "" 0x011d4 tco _REC_AXS_20_u1 190.5 _CNV_A_R_LINEAR_____12_CM 6 -48. 142.5 DISPLAY_IDENTIFIER LDP_TCO_TQ_LOSS_LIM FORMAT "%5.1" /end AXIS_PTS
/begin AXIS_PTS ldp_tco_st__tqfr_st "" 0x011ab tco_st _REC_AXS_20_u1 190.5 _CNV_A_R_LINEAR_____12_CM 4 -48. 142.5 DISPLAY_IDENTIFIER LDP_TCO_ST__TQFR_ST FORMAT "%5.1" /end AXIS_PTS
/begin AXIS_PTS ldp_tco_st__tqfr_dec_st "" 0x011a6 tco_st _REC_AXS_20_u1 190.5 _CNV_A_R_LINEAR_____12_CM 4 -48. 142.5 DISPLAY_IDENTIFIER LDP_TCO_ST__TQFR_DEC_ST FORMAT "%5.1" /end AXIS_PTS
/begin MEASUREMENT tqfr_req_clu "Engine Friction torque without pumping losses for calculation of TQ_MIN_CLU" SWORD _CNV_A_R_LINEAR_____55_CM 1 100. -1024. 1023.96875 DISPLAY_IDENTIFIER TQFR_REQ_CLU ECU_ADDRESS 0x3fd91c BYTE_ORDER MSB_LAST FORMAT "%8.2" /end MEASUREMENT
/begin MEASUREMENT tq_loss_clu_add "Engine  torque losses without pumping and friction losses for calculation of TQ_MIN_CLU" SWORD _CNV_A_R_LINEAR_____55_CM 1 100. -1024. 1023.96875 DISPLAY_IDENTIFIER TQ_LOSS_CLU_ADD ECU_ADDRESS 0x3fd91e BYTE_ORDER MSB_LAST FORMAT "%8.2" /end MEASUREMENT
/begin AXIS_PTS ldpm_tco__tqfr_add "" 0x013e1 tco _REC_AXS_20_u1 190.5 _CNV_A_R_LINEAR_____12_CM 4 -48. 142.5 DISPLAY_IDENTIFIER LDPM_TCO__TQFR_ADD FORMAT "%5.1" /end AXIS_PTS
/begin AXIS_PTS ldpm_ctr_km_can__tqfr_add "" 0x115e2 ctr_km_can _REC_AXS_20_u2 655350. _CNV_A_R_LINEAR_____88_CM 4 0. 655350. DISPLAY_IDENTIFIER LDPM_CTR_KM_CAN__TQFR_ADD FORMAT "%6.0" /end AXIS_PTS
/begin CHARACTERISTIC ip_tqfr_add_km_mt "Correction of friction torque of running in phase engine" MAP 0x102b6 _REC_MAP_20_u2_u1_u2 2047.96875 _CNV_A_R_LINEAR_____186_CM -1024. 1023.96875 DISPLAY_IDENTIFIER IP_TQFR_ADD_KM_MT FORMAT "%6.2"
 /begin AXIS_DESCR COM_AXIS tco _CNV_A_R_LINEAR_____12_CM 4 -48. 142.5 FORMAT "%5.1" AXIS_PTS_REF ldpm_tco__tqfr_add /end AXIS_DESCR
 /begin AXIS_DESCR COM_AXIS ctr_km_can _CNV_A_R_LINEAR_____88_CM 4 0. 655350. FORMAT "%6.0" AXIS_PTS_REF ldpm_ctr_km_can__tqfr_add /end AXIS_DESCR
/end CHARACTERISTIC
/begin CHARACTERISTIC ip_tqfr_add_km_at "Correction of friction torque of running in phase engine and transmission" MAP 0x10296 _REC_MAP_20_u2_u1_u2 2047.96875 _CNV_A_R_LINEAR_____186_CM -1024. 1023.96875 DISPLAY_IDENTIFIER IP_TQFR_ADD_KM_AT FORMAT "%6.2"
 /begin AXIS_DESCR COM_AXIS tco _CNV_A_R_LINEAR_____12_CM 4 -48. 142.5 FORMAT "%5.1" AXIS_PTS_REF ldpm_tco__tqfr_add /end AXIS_DESCR
 /begin AXIS_DESCR COM_AXIS ctr_km_can _CNV_A_R_LINEAR_____88_CM 4 0. 655350. FORMAT "%6.0" AXIS_PTS_REF ldpm_ctr_km_can__tqfr_add /end AXIS_DESCR
/end CHARACTERISTIC
/begin MEASUREMENT tqfr_add_km "Temperature correction of engine friction losses depending on mileage" SWORD _CNV_A_R_LINEAR_____55_CM 1 100. -1024. 1023.96875 DISPLAY_IDENTIFIER TQFR_ADD_KM ECU_ADDRESS 0x3fd92e BYTE_ORDER MSB_LAST FORMAT "%8.2" /end MEASUREMENT
/begin MEASUREMENT tqfr_delta_amp "AMP friction losses dependency" SWORD _CNV_A_R_LINEAR_____55_CM 1 100. -1024. 1023.96875 DISPLAY_IDENTIFIER TQFR_DELTA_AMP ECU_ADDRESS 0x3fd920 BYTE_ORDER MSB_LAST FORMAT "%8.2" /end MEASUREMENT
/begin AXIS_PTS ldp_amp_dif__tqfr_amp "AMP correction of friction  torque" 0x1089c online_dummy _REC_AXS_20_u2 5434. _CNV_A_R_LINEAR_____114_CM 4 -2717. 2717. DISPLAY_IDENTIFIER LDP_AMP_DIF__TQFR_AMP FORMAT "%7.2" /end AXIS_PTS
/begin AXIS_PTS ldp_pq__tqfr_amp "AMP correction of friction  torque" 0x110c6 online_dummy _REC_AXS_20_u2 0.99998474 _CNV_A_R_LINEAR_____37_CM 4 0. 0.99998474 DISPLAY_IDENTIFIER LDP_PQ__TQFR_AMP FORMAT "%7.5" /end AXIS_PTS
/begin CHARACTERISTIC ip_tqfr_delta_amp "AMP correction of friction  torque" MAP 0x1217a _REC_MAP_20_u2_u2_u2 2047.96875 _CNV_A_R_LINEAR_____186_CM -1024. 1023.96875 DISPLAY_IDENTIFIER IP_TQFR_DELTA_AMP FORMAT "%6.2"
 /begin AXIS_DESCR COM_AXIS online_dummy _CNV_A_R_LINEAR_____114_CM 4 -2717. 2717. FORMAT "%7.2" AXIS_PTS_REF ldp_amp_dif__tqfr_amp /end AXIS_DESCR
 /begin AXIS_DESCR COM_AXIS online_dummy _CNV_A_R_LINEAR_____37_CM 4 0. 0.99998474 FORMAT "%7.5" AXIS_PTS_REF ldp_pq__tqfr_amp /end AXIS_DESCR
/end CHARACTERISTIC
/begin MEASUREMENT eff_scc_av "Actual efficiency fuel cut-off" UWORD _CNV_A_R_LINEAR_____21_CM 1 100. 0. 1.99996948 DISPLAY_IDENTIFIER EFF_SCC_AV ECU_ADDRESS 0x3fd944 BYTE_ORDER MSB_LAST FORMAT "%7.5" /end MEASUREMENT
/begin MEASUREMENT eff_scc_av_can "Actual efficiency fuel cut-off for CAN" UWORD _CNV_A_R_LINEAR_____21_CM 1 100. 0. 1.99996948 DISPLAY_IDENTIFIER EFF_SCC_AV_CAN ECU_ADDRESS 0x3fd946 BYTE_ORDER MSB_LAST FORMAT "%7.5" /end MEASUREMENT
/begin MEASUREMENT eff_scc_sp_hys "Setpoint efficiency fuel cut-off pattern with hysteresis" UWORD _CNV_A_R_LINEAR_____21_CM 1 100. 0. 1.99996948 DISPLAY_IDENTIFIER EFF_SCC_SP_HYS ECU_ADDRESS 0x3fd954 BYTE_ORDER MSB_LAST FORMAT "%7.5" /end MEASUREMENT
/begin MEASUREMENT eff_scc_bas "Basic efficiency fuel  cut-off" UWORD _CNV_A_R_LINEAR_____21_CM 1 100. 0. 1.99996948 DISPLAY_IDENTIFIER EFF_SCC_BAS ECU_ADDRESS 0x3fd942 BYTE_ORDER MSB_LAST FORMAT "%7.5" /end MEASUREMENT
/begin MEASUREMENT eff_scc_sp "Setpoint efficiency fuel cut-off pattern" UWORD _CNV_A_R_LINEAR_____21_CM 1 100. 0. 1.99996948 DISPLAY_IDENTIFIER EFF_SCC_SP ECU_ADDRESS 0x3fd94a BYTE_ORDER MSB_LAST FORMAT "%7.5" /end MEASUREMENT
/begin MEASUREMENT tqi_ref_iga_min_scc "indicated reference torque for single cylinder cut-off " SWORD _CNV_A_R_LINEAR_____55_CM 1 100. -1024. 1023.96875 DISPLAY_IDENTIFIER TQI_REF_IGA_MIN_SCC ECU_ADDRESS 0x3fd948 BYTE_ORDER MSB_LAST FORMAT "%8.2" /end MEASUREMENT
/begin MEASUREMENT eff_iga_min_scc "minimum reference efficiency for single cylinder cut-off " UWORD _CNV_A_R_LINEAR_____21_CM 1 100. 0. 1.99996948 DISPLAY_IDENTIFIER EFF_IGA_MIN_SCC ECU_ADDRESS 0x3fd94c BYTE_ORDER MSB_LAST FORMAT "%7.5" /end MEASUREMENT
/begin MEASUREMENT fac_iga_min_teg_iga_bas "scaling factor for efficiency calculation with EFF_IGA_MIN_TEG and EFF_IGA_BAS_COR" UWORD _CNV_A_R_LINEAR_____21_CM 1 100. 0. 1.99996948 DISPLAY_IDENTIFIER FAC_IGA_MIN_TEG_IGA_BAS ECU_ADDRESS 0x3fd956 BYTE_ORDER MSB_LAST FORMAT "%7.5" /end MEASUREMENT
/begin MEASUREMENT lv_auth_tq_pat "Logical variable for authorizing fuel cut-off pattern" UBYTE _CNV_S_2_RANGE______0_CM 1 100. 0. 1. DISPLAY_IDENTIFIER LV_AUTH_TQ_PAT ECU_ADDRESS 0x3fe584 /end MEASUREMENT
/begin MEASUREMENT nr_pat_scc "Selected index of fuel cut-off pattern" UBYTE _CNV_A_R_LINEAR_____1_CM 1 100. 0. 255. DISPLAY_IDENTIFIER NR_PAT_SCC ECU_ADDRESS 0x3fe583 FORMAT "%3.0" /end MEASUREMENT
/begin CHARACTERISTIC lc_eff_scc_sp_man "flag for setting EFF_SCC_SP by application system" VALUE 0x00f15 _REC_VAL_20_u1 1. _CNV_A_R_LINEAR_____1_CM 0. 1. DISPLAY_IDENTIFIER LC_EFF_SCC_SP_MAN FORMAT "%2.0" /end CHARACTERISTIC
/begin CHARACTERISTIC lc_inh_fcut_fast "inhibition flag for fuel cut-off due fast fuel cut-off" VALUE 0x00f32 _REC_VAL_20_u1 1. _CNV_A_R_LINEAR_____1_CM 0. 1. DISPLAY_IDENTIFIER LC_INH_FCUT_FAST FORMAT "%2.0" /end CHARACTERISTIC
/begin CHARACTERISTIC lc_ena_eff_scc_bas_man "logical variable for manually adjusting basic efficiency fuel cut-off" VALUE 0x00f16 _REC_VAL_20_u1 1. _CNV_A_R_LINEAR_____1_CM 0. 1. DISPLAY_IDENTIFIER LC_ENA_EFF_SCC_BAS_MAN FORMAT "%2.0" /end CHARACTERISTIC
/begin CHARACTERISTIC c_eff_scc_sp_hys "Hysteresis applied on EFF_SCC_SP for NR_PAT_SCC calculation" VALUE 0x0153e _REC_VAL_20_u2 1.99996948 _CNV_A_R_LINEAR_____21_CM 0. 1.99996948 DISPLAY_IDENTIFIER C_EFF_SCC_SP_HYS FORMAT "%7.5" /end CHARACTERISTIC
/begin CHARACTERISTIC c_eff_scc_bas_man "manually adjusted basic efficiency fuel cut-off" VALUE 0x0153c _REC_VAL_20_u2 1.99996948 _CNV_A_R_LINEAR_____21_CM 0. 1.99996948 DISPLAY_IDENTIFIER C_EFF_SCC_BAS_MAN FORMAT "%7.5" /end CHARACTERISTIC
/begin CHARACTERISTIC lc_ena_fcut_tot_gs "logical variable for setting scaling factor due to gear shift intervention" VALUE 0x00f1d _REC_VAL_20_u1 1. _CNV_A_R_LINEAR_____1_CM 0. 1. DISPLAY_IDENTIFIER LC_ENA_FCUT_TOT_GS FORMAT "%2.0" /end CHARACTERISTIC
/begin CHARACTERISTIC lc_inh_fcut_gs_iga "inhibition flag for fuel cut-off due to gear shift intervention with spark retarding" VALUE 0x00f34 _REC_VAL_20_u1 1. _CNV_A_R_LINEAR_____1_CM 0. 1. DISPLAY_IDENTIFIER LC_INH_FCUT_GS_IGA FORMAT "%2.0" /end CHARACTERISTIC
/begin CHARACTERISTIC lc_inh_fcut_asr "inhibition flag for fuel cut-off due to ASR" VALUE 0x00f30 _REC_VAL_20_u1 1. _CNV_A_R_LINEAR_____1_CM 0. 1. DISPLAY_IDENTIFIER LC_INH_FCUT_ASR FORMAT "%2.0" /end CHARACTERISTIC
/begin CHARACTERISTIC lc_ena_fcut_tot_asr "logical variable for setting scaling factor due to ASR" VALUE 0x00f1a _REC_VAL_20_u1 1. _CNV_A_R_LINEAR_____1_CM 0. 1. DISPLAY_IDENTIFIER LC_ENA_FCUT_TOT_ASR FORMAT "%2.0" /end CHARACTERISTIC
/begin CHARACTERISTIC lc_inh_fcut_n_max "inhibition flag for fuel cut-off due to speed limitation" VALUE 0x00f35 _REC_VAL_20_u1 1. _CNV_A_R_LINEAR_____1_CM 0. 1. DISPLAY_IDENTIFIER LC_INH_FCUT_N_MAX FORMAT "%2.0" /end CHARACTERISTIC
/begin CHARACTERISTIC lc_tq_scc_inh_man "inhibition flag for fuel cut-off due to torque management" VALUE 0x00f92 _REC_VAL_20_u1 1. _CNV_A_R_LINEAR_____1_CM 0. 1. DISPLAY_IDENTIFIER LC_TQ_SCC_INH_MAN FORMAT "%2.0" /end CHARACTERISTIC
/begin CHARACTERISTIC lc_ena_fcut_tot_fast "logical variable for setting scaling factor due to fast fuel cut-off" VALUE 0x00f1c _REC_VAL_20_u1 1. _CNV_A_R_LINEAR_____1_CM 0. 1. DISPLAY_IDENTIFIER LC_ENA_FCUT_TOT_FAST FORMAT "%2.0" /end CHARACTERISTIC
/begin CHARACTERISTIC lc_tq_scc_ena_man "flag for enabling SCC by application system" VALUE 0x00f91 _REC_VAL_20_u1 1. _CNV_A_R_LINEAR_____1_CM 0. 1. DISPLAY_IDENTIFIER LC_TQ_SCC_ENA_MAN FORMAT "%2.0" /end CHARACTERISTIC
/begin CHARACTERISTIC c_eff_scc_sp_man "setpoint for efficiency of fuel cut-off set by application intervention" VALUE 0x01540 _REC_VAL_20_u2 1.99996948 _CNV_A_R_LINEAR_____21_CM 0. 1.99996948 DISPLAY_IDENTIFIER C_EFF_SCC_SP_MAN FORMAT "%7.5" /end CHARACTERISTIC
/begin CHARACTERISTIC c_fac_iga_min_teg_iga_bas "manually adjusted scaling factor for efficiency calculation with EFF_IGA_MIN_TEG and EFF_IGA_BAS_COR" VALUE 0x01576 _REC_VAL_20_u2 1. _CNV_A_R_LINEAR_____463_CM 0. 1. DISPLAY_IDENTIFIER C_FAC_IGA_MIN_TEG_IGA_BAS FORMAT "%6.4" /end CHARACTERISTIC
/begin CHARACTERISTIC c_hys_eff_iga_min_teg "hysteresis in falling direction for IGA_MIN_TEG correction" VALUE 0x015d2 _REC_VAL_20_u2 1.99996948 _CNV_A_R_LINEAR_____21_CM 0. 1.99996948 DISPLAY_IDENTIFIER C_HYS_EFF_IGA_MIN_TEG FORMAT "%7.5" /end CHARACTERISTIC
/begin CHARACTERISTIC c_min_dec_eff_iga_min_teg_1 "minimum decrement for first decrease phase " VALUE 0x016cc _REC_VAL_20_u2 1.99996948 _CNV_A_R_LINEAR_____21_CM 0. 1.99996948 DISPLAY_IDENTIFIER C_MIN_DEC_EFF_IGA_MIN_TEG_1 FORMAT "%7.5" /end CHARACTERISTIC
/begin CHARACTERISTIC c_min_dec_eff_iga_min_teg_2 "minimum decrement for second decrease phase " VALUE 0x016ce _REC_VAL_20_u2 1.99996948 _CNV_A_R_LINEAR_____21_CM 0. 1.99996948 DISPLAY_IDENTIFIER C_MIN_DEC_EFF_IGA_MIN_TEG_2 FORMAT "%7.5" /end CHARACTERISTIC
/begin CHARACTERISTIC id_nr_pat_scc "SCC pattern depending on SCC efficiency" CURVE 0x03e7c _REC_CUR_20_u1_u2 255. _CNV_A_R_LINEAR_____1_CM 0. 255. DISPLAY_IDENTIFIER ID_NR_PAT_SCC FORMAT "%3.0"
 /begin AXIS_DESCR COM_AXIS eff_scc_sp _CNV_A_R_LINEAR_____21_CM 13 0. 1.99996948 FORMAT "%7.5" AXIS_PTS_REF ldp_eff_scc_sp__nr_pat_scc /end AXIS_DESCR
/end CHARACTERISTIC
/begin CHARACTERISTIC lc_inh_fcut_gs "inhibition flag for fuel cut-off due to gear shift intervention" VALUE 0x00f33 _REC_VAL_20_u1 1. _CNV_A_R_LINEAR_____1_CM 0. 1. DISPLAY_IDENTIFIER LC_INH_FCUT_GS FORMAT "%2.0" /end CHARACTERISTIC
/begin CHARACTERISTIC lc_ena_fcut_tot_n_max "logical variable for setting scaling factor due to engine speed limitation" VALUE 0x00f1e _REC_VAL_20_u1 1. _CNV_A_R_LINEAR_____1_CM 0. 1. DISPLAY_IDENTIFIER LC_ENA_FCUT_TOT_N_MAX FORMAT "%2.0" /end CHARACTERISTIC
/begin AXIS_PTS ldp_eff_scc_sp__nr_pat_scc "" 0x10a54 eff_scc_sp _REC_AXS_20_u2 1.99996948 _CNV_A_R_LINEAR_____21_CM 13 0. 1.99996948 DISPLAY_IDENTIFIER LDP_EFF_SCC_SP__NR_PAT_SCC FORMAT "%7.5" /end AXIS_PTS
/begin CHARACTERISTIC lc_inh_fcut_amt "inhibition flag for fuel cut-off due to AMT intervention" VALUE 0x00f2f _REC_VAL_20_u1 1. _CNV_A_R_LINEAR_____1_CM 0. 1. DISPLAY_IDENTIFIER LC_INH_FCUT_AMT FORMAT "%2.0" /end CHARACTERISTIC
/begin CHARACTERISTIC lc_inh_fcut_dcc "inhibition flag for fuel cut-off due to DCC intervention" VALUE 0x00f31 _REC_VAL_20_u1 1. _CNV_A_R_LINEAR_____1_CM 0. 1. DISPLAY_IDENTIFIER LC_INH_FCUT_DCC FORMAT "%2.0" /end CHARACTERISTIC
/begin CHARACTERISTIC lc_ena_fcut_tot_amt "logical variable for setting scaling factor due AMT" VALUE 0x00f19 _REC_VAL_20_u1 1. _CNV_A_R_LINEAR_____1_CM 0. 1. DISPLAY_IDENTIFIER LC_ENA_FCUT_TOT_AMT FORMAT "%2.0" /end CHARACTERISTIC
/begin CHARACTERISTIC lc_ena_fcut_tot_dcc "logical variable for setting scaling factor due DCC" VALUE 0x00f1b _REC_VAL_20_u1 1. _CNV_A_R_LINEAR_____1_CM 0. 1. DISPLAY_IDENTIFIER LC_ENA_FCUT_TOT_DCC FORMAT "%2.0" /end CHARACTERISTIC
/begin MEASUREMENT t_max_fcut_fast "time counter for clutch switch observation fast fuel cut off" UBYTE _CNV_A_R_LINEAR_____4_CM 1 100. 0. 2.55 DISPLAY_IDENTIFIER T_MAX_FCUT_FAST ECU_ADDRESS 0x3fe587 FORMAT "%4.2" /end MEASUREMENT
/begin MEASUREMENT tq_st "Engine Start Torque" SWORD _CNV_A_R_LINEAR_____55_CM 1 100. -1024. 1023.96875 DISPLAY_IDENTIFIER TQ_ST ECU_ADDRESS 0x3fd95a BYTE_ORDER MSB_LAST FORMAT "%6.2" /end MEASUREMENT
/begin MEASUREMENT tq_st_1 "Engine Start Torque raw value" SWORD _CNV_A_R_LINEAR_____55_CM 1 100. -1024. 1023.96875 DISPLAY_IDENTIFIER TQ_ST_1 ECU_ADDRESS 0x3fd95c BYTE_ORDER MSB_LAST FORMAT "%6.2" /end MEASUREMENT
/begin CHARACTERISTIC c_crlc_tq_st "" VALUE 0x0063e _REC_VAL_20_u1 0.9960940000000002 _CNV_A_R_LINEAR_____50_CM 0. 0.996094 DISPLAY_IDENTIFIER C_CRLC_TQ_ST FORMAT "%5.3" /end CHARACTERISTIC
/begin CHARACTERISTIC ip_tq_st_mt "Engine torque at start for manual transmission" MAP 0x1004e _REC_MAP_20_u2_u2_u1 2047.96875 _CNV_A_R_LINEAR_____186_CM -1024. 1023.96875 DISPLAY_IDENTIFIER IP_TQ_ST_MT FORMAT "%6.2"
 /begin AXIS_DESCR COM_AXIS n_dif _CNV_A_R_LINEAR_____206_CM 8 -32768. 32767. FORMAT "%6.0" AXIS_PTS_REF ldpm_n_dif_ip_tq_st /end AXIS_DESCR
 /begin AXIS_DESCR COM_AXIS tco _CNV_A_R_LINEAR_____12_CM 8 -48. 142.5 FORMAT "%5.1" AXIS_PTS_REF ldpm_tco_ip_tq_st /end AXIS_DESCR
/end CHARACTERISTIC
/begin CHARACTERISTIC ip_tq_st_at "Engine torque at start for automatic transmission" MAP 0x0ffce _REC_MAP_20_u2_u2_u1 2047.96875 _CNV_A_R_LINEAR_____186_CM -1024. 1023.96875 DISPLAY_IDENTIFIER IP_TQ_ST_AT FORMAT "%6.2"
 /begin AXIS_DESCR COM_AXIS n_dif _CNV_A_R_LINEAR_____206_CM 8 -32768. 32767. FORMAT "%6.0" AXIS_PTS_REF ldpm_n_dif_ip_tq_st /end AXIS_DESCR
 /begin AXIS_DESCR COM_AXIS tco _CNV_A_R_LINEAR_____12_CM 8 -48. 142.5 FORMAT "%5.1" AXIS_PTS_REF ldpm_tco_ip_tq_st /end AXIS_DESCR
/end CHARACTERISTIC
/begin AXIS_PTS ldpm_tco_ip_tq_st "" 0x0820b tco _REC_AXS_20_u1 190.5 _CNV_A_R_LINEAR_____12_CM 8 -48. 142.5 DISPLAY_IDENTIFIER LDPM_TCO_IP_TQ_ST FORMAT "%5.1" /end AXIS_PTS
/begin AXIS_PTS ldpm_n_dif_ip_tq_st "" 0x119a4 n_dif _REC_AXS_20_u2 65535. _CNV_A_R_LINEAR_____206_CM 8 -32768. 32767. DISPLAY_IDENTIFIER LDPM_N_DIF_IP_TQ_ST FORMAT "%6.0" /end AXIS_PTS
/begin MEASUREMENT fac_tq_req_cru "Torque factor request for cruise control" UWORD _CNV_A_R_LINEAR_____21_CM 1 100. 0. 1.99996948 DISPLAY_IDENTIFIER FAC_TQ_REQ_CRU ECU_ADDRESS 0x3fd9b0 BYTE_ORDER MSB_LAST FORMAT "%7.5" /end MEASUREMENT
/begin MEASUREMENT fac_tq_req_dcc "Scaling factor of inverse  DCC model" UWORD _CNV_A_R_LINEAR_____21_CM 1 100. 0. 1.99996948 DISPLAY_IDENTIFIER FAC_TQ_REQ_DCC ECU_ADDRESS 0x3fd9b2 BYTE_ORDER MSB_LAST FORMAT "%7.5" /end MEASUREMENT
/begin MEASUREMENT state_tq_dcc "State of DCC torque intervention" UBYTE _CNV_S_6_STATE_TQ_D_464_CM 1 100. 0. 11. DISPLAY_IDENTIFIER STATE_TQ_DCC ECU_ADDRESS 0x3fe5ad /end MEASUREMENT
/begin MEASUREMENT lv_tq_dcc_act "Torque structure leaded by DCC intervention" UBYTE _CNV_S_2_RANGE______0_CM 1 100. 0. 1. DISPLAY_IDENTIFIER LV_TQ_DCC_ACT ECU_ADDRESS 0x3fe5ae /end MEASUREMENT
/begin MEASUREMENT tq_delta_max_clu "Difference between TQ_MAX_CLU and TQ_MIN_CLU" SWORD _CNV_A_R_LINEAR_____55_CM 1 100. -1024. 1023.96875 DISPLAY_IDENTIFIER TQ_DELTA_MAX_CLU ECU_ADDRESS 0x3fd9b4 BYTE_ORDER MSB_LAST FORMAT "%8.2" /end MEASUREMENT
/begin CHARACTERISTIC c_lgrd_tq_cru_inc_1 "Change limitation for cruise control request out of lower vehicle speed" VALUE 0x01636 _REC_VAL_20_u2 1.99996948 _CNV_A_R_LINEAR_____21_CM 0. 1.99996948 DISPLAY_IDENTIFIER C_LGRD_TQ_CRU_INC_1 FORMAT "%7.5" /end CHARACTERISTIC
/begin CHARACTERISTIC c_lgrd_tq_cru_inc_2 "Change limitation for cruise control request out of higher vehicle speed" VALUE 0x01638 _REC_VAL_20_u2 1.99996948 _CNV_A_R_LINEAR_____21_CM 0. 1.99996948 DISPLAY_IDENTIFIER C_LGRD_TQ_CRU_INC_2 FORMAT "%7.5" /end CHARACTERISTIC
/begin CHARACTERISTIC ip_fac_tq_req_driv_rng_l "Scaling factor for requested torque at clutch from driver in low range mode" MAP 0x0b5f8 _REC_MAP_20_u2_u2_u1 1.99996948 _CNV_A_R_LINEAR_____21_CM 0. 1.99996948 DISPLAY_IDENTIFIER IP_FAC_TQ_REQ_DRIV_RNG_L FORMAT "%7.5"
 /begin AXIS_DESCR COM_AXIS n _CNV_A_R_LINEAR_____11_CM 12 0. 8160. FORMAT "%4.0" AXIS_PTS_REF ldpm_n_fac_tq_req_driv /end AXIS_DESCR
 /begin AXIS_DESCR COM_AXIS pv_av _CNV_A_R_LINEAR_____10_CM 12 0. 99.609375 FORMAT "%4.1" AXIS_PTS_REF ldpm_pv_av_fac_tq_req_driv /end AXIS_DESCR
/end CHARACTERISTIC
/begin CHARACTERISTIC ip_fac_tq_req_driv "Scaling factor for requested torque at clutch from driver" MAP 0x0b4d8 _REC_MAP_20_u2_u2_u1 1.99996948 _CNV_A_R_LINEAR_____21_CM 0. 1.99996948 DISPLAY_IDENTIFIER IP_FAC_TQ_REQ_DRIV FORMAT "%7.5"
 /begin AXIS_DESCR COM_AXIS n _CNV_A_R_LINEAR_____11_CM 12 0. 8160. FORMAT "%4.0" AXIS_PTS_REF ldpm_n_fac_tq_req_driv /end AXIS_DESCR
 /begin AXIS_DESCR COM_AXIS pv_av _CNV_A_R_LINEAR_____10_CM 12 0. 99.609375 FORMAT "%4.1" AXIS_PTS_REF ldpm_pv_av_fac_tq_req_driv /end AXIS_DESCR
/end CHARACTERISTIC
/begin CHARACTERISTIC c_pv_av_sof_min "PV_AV threshold for activation IP_FAC_TQ_REQ_DRIV_RNG_L" VALUE 0x007ac _REC_VAL_20_u1 99.609375 _CNV_A_R_LINEAR_____10_CM 0. 99.609375 DISPLAY_IDENTIFIER C_PV_AV_SOF_MIN FORMAT "%4.1" /end CHARACTERISTIC
/begin CHARACTERISTIC c_fac_tq_req_driv_sof_max "Scaling factor threshold for activation IP_FAC_TQ_REQ_DRIV_RNG_L" VALUE 0x015ac _REC_VAL_20_u2 1.99996948 _CNV_A_R_LINEAR_____21_CM 0. 1.99996948 DISPLAY_IDENTIFIER C_FAC_TQ_REQ_DRIV_SOF_MAX FORMAT "%7.5" /end CHARACTERISTIC
/begin CHARACTERISTIC c_pv_av_grd_sof_max "Pedal value gradient rheshold for recognition of LV_RNG_L" VALUE 0x007a8 _REC_VAL_20_u1 2490.234 _CNV_A_R_LINEAR_____40_CM -1250. 1240.234 DISPLAY_IDENTIFIER C_PV_AV_GRD_SOF_MAX FORMAT "%6.1" /end CHARACTERISTIC
/begin CHARACTERISTIC c_t_pv_av_grd_sof_max "Minimum time for pedal value gradient for recognition of LV_RNG_L" VALUE 0x0188c _REC_VAL_20_u2 655.35 _CNV_A_R_LINEAR_____4_CM 0. 655.35 DISPLAY_IDENTIFIER C_T_PV_AV_GRD_SOF_MAX FORMAT "%6.2" /end CHARACTERISTIC
/begin MEASUREMENT fac_tq_req_driv "Scaling factor for requested torque at clutch from driver" UWORD _CNV_A_R_LINEAR_____21_CM 1 100. 0. 1.99996948 DISPLAY_IDENTIFIER FAC_TQ_REQ_DRIV ECU_ADDRESS 0x3fd9b8 BYTE_ORDER MSB_LAST FORMAT "%7.5" /end MEASUREMENT
/begin MEASUREMENT lv_rng_l_req "Activation condition for low-range-mode" UBYTE _CNV_S_2_RANGE______0_CM 1 100. 0. 1. DISPLAY_IDENTIFIER LV_RNG_L_REQ ECU_ADDRESS 0x3fe5b1 /end MEASUREMENT
/begin AXIS_PTS ldpm_n_fac_tq_req_driv "" 0x119c8 n _REC_AXS_20_u2 8160. _CNV_A_R_LINEAR_____11_CM 12 0. 8160. DISPLAY_IDENTIFIER LDPM_N_FAC_TQ_REQ_DRIV FORMAT "%4.0" /end AXIS_PTS
/begin AXIS_PTS ldpm_pv_av_fac_tq_req_driv "" 0x0816b pv_av _REC_AXS_20_u1 99.609375 _CNV_A_R_LINEAR_____10_CM 12 0. 99.609375 DISPLAY_IDENTIFIER LDPM_PV_AV_FAC_TQ_REQ_DRIV FORMAT "%4.1" /end AXIS_PTS
/begin CHARACTERISTIC lc_rng_l_man_as "logical constant for to activate IP_FAC_TQ_REQ_DRIV_RNG_L (low range mode) in case if LV_RNG_L = 0 (default value = 0)" VALUE 0x00f6b _REC_VAL_20_u1 1. _CNV_A_R_LINEAR_____1_CM 0. 1. DISPLAY_IDENTIFIER LC_RNG_L_MAN_AS FORMAT "%2.0" /end CHARACTERISTIC
/begin MEASUREMENT tqi_ref_max "Maximum indicated torque from IP_TQI_REF" SWORD _CNV_A_R_LINEAR_____55_CM 1 100. -1024. 1023.96875 DISPLAY_IDENTIFIER TQI_REF_MAX ECU_ADDRESS 0x3fd840 BYTE_ORDER MSB_LAST FORMAT "%6.2" /end MEASUREMENT
/begin MEASUREMENT tq_max_clu "Maximum torque at clutch" SWORD _CNV_A_R_LINEAR_____55_CM 1 100. -1024. 1023.96875 DISPLAY_IDENTIFIER TQ_MAX_CLU ECU_ADDRESS 0x3fd83c BYTE_ORDER MSB_LAST FORMAT "%6.2" /end MEASUREMENT
/begin MEASUREMENT tqi_max "Maximum indicated torque " SWORD _CNV_A_R_LINEAR_____55_CM 1 100. -1024. 1023.96875 DISPLAY_IDENTIFIER TQI_MAX ECU_ADDRESS 0x3fd83e BYTE_ORDER MSB_LAST FORMAT "%6.2" /end MEASUREMENT
/begin CHARACTERISTIC c_tqi_fac_fl "Maximum torque series variation factor" VALUE 0x0198e _REC_VAL_20_u2 1.99996948 _CNV_A_R_LINEAR_____21_CM 0. 1.99996948 DISPLAY_IDENTIFIER C_TQI_FAC_FL FORMAT "%7.5" /end CHARACTERISTIC
/begin CHARACTERISTIC ip_tqi_ref__n__maf "Indicated engine torque at reference conditions" MAP 0x10336 _REC_MAP_20_u2_u1_u2 1023.96875 _CNV_A_R_LINEAR_____55_CM 0. 1023.96875 DISPLAY_IDENTIFIER IP_TQI_REF__N__MAF FORMAT "%7.2"
 /begin AXIS_DESCR COM_AXIS n_32 _CNV_A_R_LINEAR_____16_CM 16 0. 8160. FORMAT "%4.0" AXIS_PTS_REF ldpm_n_32_100 /end AXIS_DESCR
 /begin AXIS_DESCR COM_AXIS maf _CNV_A_R_LINEAR_____106_CM 12 0. 1389. FORMAT "%7.2" AXIS_PTS_REF ldpm_maf_100 /end AXIS_DESCR
/end CHARACTERISTIC
/begin AXIS_PTS ldpm_n_32_100 "" 0x07ffc n_32 _REC_AXS_20_u1 8160. _CNV_A_R_LINEAR_____16_CM 16 0. 8160. DISPLAY_IDENTIFIER LDPM_N_32_100 FORMAT "%4.0" /end AXIS_PTS
/begin AXIS_PTS ldpm_maf_100 "" 0x116a2 maf _REC_AXS_20_u2 1389. _CNV_A_R_LINEAR_____106_CM 12 0. 1389. DISPLAY_IDENTIFIER LDPM_MAF_100 FORMAT "%7.2" /end AXIS_PTS
/begin MEASUREMENT tq_min_clu "Minimum  torque at clutch " SWORD _CNV_A_R_LINEAR_____55_CM 1 100. -1024. 1023.96875 DISPLAY_IDENTIFIER TQ_MIN_CLU ECU_ADDRESS 0x3fd842 BYTE_ORDER MSB_LAST FORMAT "%6.2" /end MEASUREMENT
/begin MEASUREMENT tq_min_clu_1 "Minimum  torque at clutch intermitted value 1" SWORD _CNV_A_R_LINEAR_____55_CM 1 100. -1024. 1023.96875 DISPLAY_IDENTIFIER TQ_MIN_CLU_1 ECU_ADDRESS 0x3fd846 BYTE_ORDER MSB_LAST FORMAT "%6.2" /end MEASUREMENT
/begin MEASUREMENT tq_min_clu_2 "Minimum  torque at clutch intermitted value 2" SWORD _CNV_A_R_LINEAR_____55_CM 1 100. -1024. 1023.96875 DISPLAY_IDENTIFIER TQ_MIN_CLU_2 ECU_ADDRESS 0x3fd848 BYTE_ORDER MSB_LAST FORMAT "%6.2" /end MEASUREMENT
/begin MEASUREMENT fac_n_dif_is "Control factor for the engine self stabilizing" SWORD _CNV_A_R_LINEAR_____25_CM 1 100. -8. 7.99975586 DISPLAY_IDENTIFIER FAC_N_DIF_IS ECU_ADDRESS 0x3fd84a BYTE_ORDER MSB_LAST FORMAT "%7.4" /end MEASUREMENT
/begin MEASUREMENT lv_tq_min_clu "Logical variable for coordination engine start torque and minimum torque and clutch" UBYTE _CNV_S_2_RANGE______0_CM 1 100. 0. 1. DISPLAY_IDENTIFIER LV_TQ_MIN_CLU ECU_ADDRESS 0x3fe549 BIT_MASK 0x1 /end MEASUREMENT
/begin MEASUREMENT tqi_min_req_pu "Minimum requested indicated torque in PU phase" SWORD _CNV_A_R_LINEAR_____55_CM 1 100. -1024. 1023.96875 DISPLAY_IDENTIFIER TQI_MIN_REQ_PU ECU_ADDRESS 0x3fd844 BYTE_ORDER MSB_LAST FORMAT "%6.2" /end MEASUREMENT
/begin MEASUREMENT tq_min_req_pu "Minimum requested torque at clutch in PU phase" SWORD _CNV_A_R_LINEAR_____55_CM 1 100. -1024. 1023.96875 DISPLAY_IDENTIFIER TQ_MIN_REQ_PU ECU_ADDRESS 0x3fd84c BYTE_ORDER MSB_LAST FORMAT "%6.2" /end MEASUREMENT
/begin CHARACTERISTIC c_n_dif_tq_st_1 "N_DIF threshold 1 for deactivating TQ_ST" VALUE 0x0044a _REC_VAL_20_s2 65535. _CNV_A_R_LINEAR_____11_CM -32768. 32767. DISPLAY_IDENTIFIER C_N_DIF_TQ_ST_1 FORMAT "%5.0" /end CHARACTERISTIC
/begin CHARACTERISTIC c_n_dif_tq_st_2 "N_DIF threshold 2 for deactivating TQ_ST" VALUE 0x0044c _REC_VAL_20_s2 65535. _CNV_A_R_LINEAR_____11_CM -32768. 32767. DISPLAY_IDENTIFIER C_N_DIF_TQ_ST_2 FORMAT "%5.0" /end CHARACTERISTIC
/begin CHARACTERISTIC ip_fac_n_dif_is "Idle self stabilizing factor" CURVE 0x0ad4a _REC_CUR_20_u2_u2 15.999756 _CNV_A_R_LINEAR_____465_CM -8. 7.999756 DISPLAY_IDENTIFIER IP_FAC_N_DIF_IS FORMAT "%7.5"
 /begin AXIS_DESCR COM_AXIS n_sp_is_ratio _CNV_A_R_LINEAR_____345_CM 8 0. 7.99987793 FORMAT "%6.4" AXIS_PTS_REF ldp_n_sp_is_ratio /end AXIS_DESCR
/end CHARACTERISTIC
/begin CHARACTERISTIC ip_tqi_min_req_pu "Minimum requested indicated torque in PU phase" MAP 0x102d6 _REC_MAP_20_u2_u1_u1 1023.96875 _CNV_A_R_LINEAR_____55_CM 0. 1023.96875 DISPLAY_IDENTIFIER IP_TQI_MIN_REQ_PU FORMAT "%7.2"
 /begin AXIS_DESCR COM_AXIS n_32 _CNV_A_R_LINEAR_____16_CM 12 0. 8160. FORMAT "%4.0" AXIS_PTS_REF ldpm_n_32__tqi_min_pu /end AXIS_DESCR
 /begin AXIS_DESCR COM_AXIS tco _CNV_A_R_LINEAR_____12_CM 4 -48. 142.5 FORMAT "%5.1" AXIS_PTS_REF ldpm_tco__tqi_min_pu /end AXIS_DESCR
/end CHARACTERISTIC
/begin AXIS_PTS ldp_n_sp_is_ratio "" 0x11006 n_sp_is_ratio _REC_AXS_20_u2 7.99987793 _CNV_A_R_LINEAR_____345_CM 8 0. 7.99987793 DISPLAY_IDENTIFIER LDP_N_SP_IS_RATIO FORMAT "%6.4" /end AXIS_PTS
/begin CHARACTERISTIC lc_tq_loss_min_clu "Change of  TQ_MIN_CLU_1 calculation" VALUE 0x00f8c _REC_VAL_20_u1 1. _CNV_A_R_LINEAR_____22_CM 0. 1. DISPLAY_IDENTIFIER LC_TQ_LOSS_MIN_CLU FORMAT "%1.0" /end CHARACTERISTIC
/begin CHARACTERISTIC lc_tq_loss_min_clu_1 "Change of  TQ_MIN_CLU_1 calculation addional TQ lossses" VALUE 0x00f8d _REC_VAL_20_u1 1. _CNV_A_R_LINEAR_____22_CM 0. 1. DISPLAY_IDENTIFIER LC_TQ_LOSS_MIN_CLU_1 FORMAT "%1.0" /end CHARACTERISTIC
/begin CHARACTERISTIC lc_tq_loss_min_clu_is "Change of  TQ_MIN_CLU_1 calculation addional switch at LV_IS " VALUE 0x00f8e _REC_VAL_20_u1 1. _CNV_A_R_LINEAR_____22_CM 0. 1. DISPLAY_IDENTIFIER LC_TQ_LOSS_MIN_CLU_IS FORMAT "%1.0" /end CHARACTERISTIC
/begin CHARACTERISTIC lc_inh_pu_req "Manual inhibition to consider LV_PU for TQ_MIN_CLU calculation" VALUE 0x00f3d _REC_VAL_20_u1 1. _CNV_A_R_LINEAR_____1_CM 0. 1. DISPLAY_IDENTIFIER LC_INH_PU_REQ FORMAT "%2.0" /end CHARACTERISTIC
/begin CHARACTERISTIC lc_inh_puc_req "Manual inhibition to consider LV_PUC for TQ_MIN_CLU calculation" VALUE 0x00f3e _REC_VAL_20_u1 1. _CNV_A_R_LINEAR_____1_CM 0. 1. DISPLAY_IDENTIFIER LC_INH_PUC_REQ FORMAT "%2.0" /end CHARACTERISTIC
/begin MEASUREMENT fac_tq_req_clu "Torque scaling factor for calculation requested torque at clutch" UWORD _CNV_A_R_LINEAR_____21_CM 1 100. 0. 1.99996948 DISPLAY_IDENTIFIER FAC_TQ_REQ_CLU ECU_ADDRESS 0x3fd9be BYTE_ORDER MSB_LAST FORMAT "%7.5" /end MEASUREMENT
/begin MEASUREMENT lv_tq_cru_act "Logical variable cruise control active" UBYTE _CNV_S_2_RANGE______0_CM 1 100. 0. 1. DISPLAY_IDENTIFIER LV_TQ_CRU_ACT ECU_ADDRESS 0x3fe5b5 /end MEASUREMENT
/begin MEASUREMENT tq_req_clu "Requested torque at clutch" SWORD _CNV_A_R_LINEAR_____55_CM 1 100. -1024. 1023.96875 DISPLAY_IDENTIFIER TQ_REQ_CLU ECU_ADDRESS 0x3fd9c0 BYTE_ORDER MSB_LAST FORMAT "%6.2" /end MEASUREMENT
/begin MEASUREMENT tqi_min_req "Minimum indicated engine torque which can be requested from driver or cruise control" SWORD _CNV_A_R_LINEAR_____55_CM 1 100. -1024. 1023.96875 DISPLAY_IDENTIFIER TQI_MIN_REQ ECU_ADDRESS 0x3fd9c2 BYTE_ORDER MSB_LAST FORMAT "%8.2" /end MEASUREMENT
/begin MEASUREMENT fac_tq_req "Torque factor from pedal value interpretation and cruise control" UWORD _CNV_A_R_LINEAR_____21_CM 1 100. 0. 1.99996948 DISPLAY_IDENTIFIER FAC_TQ_REQ ECU_ADDRESS 0x3fd9bc BYTE_ORDER MSB_LAST FORMAT "%7.5" /end MEASUREMENT
/begin MEASUREMENT tqi_vs_max "???" SWORD _CNV_A_R_LINEAR_____55_CM 1 100. -1024. 1023.96875 DISPLAY_IDENTIFIER TQI_VS_MAX ECU_ADDRESS 0x3fd9e4 BYTE_ORDER MSB_LAST FORMAT "%6.2" /end MEASUREMENT
/begin MEASUREMENT tq_loss_scha "Torque losses super-charger" SWORD _CNV_A_R_LINEAR_____55_CM 1 100. -1024. 1023.96875 DISPLAY_IDENTIFIER TQ_LOSS_SCHA ECU_ADDRESS 0x3fd9dc BYTE_ORDER MSB_LAST FORMAT "%8.2" /end MEASUREMENT
/begin MEASUREMENT lv_tq_loss_acc_inp_orng "???" UBYTE _CNV_S_2_RANGE______0_CM 1 100. 0. 1. DISPLAY_IDENTIFIER LV_TQ_LOSS_ACC_INP_ORNG ECU_ADDRESS 0x3fe5bd BIT_MASK 0x1 /end MEASUREMENT
/begin MEASUREMENT lamb_bas_cor_max "Maximum value basic lambda value" UWORD _CNV_A_R_LINEAR_____164_CM 1 100. 0. 31.99902344 DISPLAY_IDENTIFIER LAMB_BAS_COR_MAX ECU_ADDRESS 0x3fd9c6 BYTE_ORDER MSB_LAST FORMAT "%7.4" /end MEASUREMENT
/begin MEASUREMENT lv_can_gs_ack "???" UBYTE _CNV_S_2_RANGE______0_CM 1 100. 0. 1. DISPLAY_IDENTIFIER LV_CAN_GS_ACK ECU_ADDRESS 0x3fe5bc BIT_MASK 0x1 /end MEASUREMENT
/begin MEASUREMENT lv_acp_orng "???" UBYTE _CNV_S_2_RANGE______5_CM 1 100. 0. 1. DISPLAY_IDENTIFIER LV_ACP_ORNG ECU_ADDRESS 0x3fe5be /end MEASUREMENT
/begin MEASUREMENT eff_egr_s "???" UWORD _CNV_A_R_LINEAR_____21_CM 1 100. 0. 1.99996948 DISPLAY_IDENTIFIER EFF_EGR_S ECU_ADDRESS 0x3fd9c8 BYTE_ORDER MSB_LAST FORMAT "%7.5" /end MEASUREMENT
/begin MEASUREMENT eff_pha_s "???" UWORD _CNV_A_R_LINEAR_____21_CM 1 100. 0. 1.99996948 DISPLAY_IDENTIFIER EFF_PHA_S ECU_ADDRESS 0x3fd9ca BYTE_ORDER MSB_LAST FORMAT "%7.5" /end MEASUREMENT
/begin MEASUREMENT tq_ad_add_s_swi "Adaptive engine torque value for switch between hom. and strat." SWORD _CNV_A_R_LINEAR_____55_CM 1 100. -1024. 1023.96875 DISPLAY_IDENTIFIER TQ_AD_ADD_S_SWI ECU_ADDRESS 0x3fd9e8 BYTE_ORDER MSB_LAST FORMAT "%7.1" /end MEASUREMENT
/begin MEASUREMENT tqi_cat_prot "???" SWORD _CNV_A_R_LINEAR_____55_CM 1 100. -1024. 1023.96875 DISPLAY_IDENTIFIER TQI_CAT_PROT ECU_ADDRESS 0x3fd9e6 BYTE_ORDER MSB_LAST FORMAT "%6.2" /end MEASUREMENT
/begin MEASUREMENT tq_loss_sa "Torque losses power steering" SWORD _CNV_A_R_LINEAR_____55_CM 1 100. -1024. 1023.96875 DISPLAY_IDENTIFIER TQ_LOSS_SA ECU_ADDRESS 0x3fd9da BYTE_ORDER MSB_LAST FORMAT "%6.2" /end MEASUREMENT
/begin MEASUREMENT tq_loss_thermo "Engine torque losses thermostat" SWORD _CNV_A_R_LINEAR_____55_CM 1 100. -1024. 1023.96875 DISPLAY_IDENTIFIER TQ_LOSS_THERMO ECU_ADDRESS 0x3fd9de BYTE_ORDER MSB_LAST FORMAT "%8.2" /end MEASUREMENT
/begin MEASUREMENT tq_loss_win_heat "Engine torque losses rar window heater" SWORD _CNV_A_R_LINEAR_____55_CM 1 100. -1024. 1023.96875 DISPLAY_IDENTIFIER TQ_LOSS_WIN_HEAT ECU_ADDRESS 0x3fd9e0 BYTE_ORDER MSB_LAST FORMAT "%8.2" /end MEASUREMENT
/begin CHARACTERISTIC c_tq_ad_add_s_swi "Adaptive engine torque Adaptation value for switch between hom and strat" VALUE 0x00472 _REC_VAL_20_s2 2047.96875 _CNV_A_R_LINEAR_____55_CM -1024. 1023.96875 DISPLAY_IDENTIFIER C_TQ_AD_ADD_S_SWI FORMAT "%7.1" /end CHARACTERISTIC
/begin MEASUREMENT tq_loss_ecf "Engine torque losses electric cooling fan" SWORD _CNV_A_R_LINEAR_____55_CM 1 100. -1024. 1023.96875 DISPLAY_IDENTIFIER TQ_LOSS_ECF ECU_ADDRESS 0x3fd9ee BYTE_ORDER MSB_LAST FORMAT "%6.2" /end MEASUREMENT
/begin CHARACTERISTIC c_lgrd_tq_loss_ecf "ECF-torque loss limitation gradient" VALUE 0x0163a _REC_VAL_20_u2 1023.96875 _CNV_A_R_LINEAR_____466_CM 0. 1023.96875 DISPLAY_IDENTIFIER C_LGRD_TQ_LOSS_ECF FORMAT "%7.2" /end CHARACTERISTIC
/begin CHARACTERISTIC ip_pow_loss_ecf "" CURVE 0x00d5c _REC_CUR_20_u1_u1 -5100. _CNV_A_R_LINEAR_____467_CM 0. -5100. DISPLAY_IDENTIFIER IP_POW_LOSS_ECF FORMAT "%5.0"
 /begin AXIS_DESCR COM_AXIS ecfpwm_ecf _CNV_A_R_LINEAR_____10_CM 8 0. 99.609375 FORMAT "%4.1" AXIS_PTS_REF ldp_ecfpwm_ecf__pow_loss_ecf /end AXIS_DESCR
/end CHARACTERISTIC
/begin AXIS_PTS ldp_ecfpwm_ecf__pow_loss_ecf "" 0x07ae0 ecfpwm_ecf _REC_AXS_20_u1 99.609375 _CNV_A_R_LINEAR_____10_CM 8 0. 99.609375 DISPLAY_IDENTIFIER LDP_ECFPWM_ECF__POW_LOSS_ECF FORMAT "%4.1" /end AXIS_PTS
/begin CHARACTERISTIC c_fac_tqe "Effective engine torque at clutch" VALUE 0x006e0 _REC_VAL_20_u1 0.24902344 _CNV_A_R_LINEAR_____468_CM 0. 0.24902344 DISPLAY_IDENTIFIER C_FAC_TQE FORMAT "%6.4" /end CHARACTERISTIC
/begin MEASUREMENT tqi_av_hom "Actual indicated engine torque for homogeneous mode" SWORD _CNV_A_R_LINEAR_____55_CM 1 100. -1024. 1023.96875 DISPLAY_IDENTIFIER TQI_AV_HOM ECU_ADDRESS 0x3fd878 BYTE_ORDER MSB_LAST FORMAT "%6.2" /end MEASUREMENT
/begin MEASUREMENT tq_av "Actual engine torque static at clutch" SWORD _CNV_A_R_LINEAR_____55_CM 1 100. -1024. 1023.96875 DISPLAY_IDENTIFIER TQ_AV ECU_ADDRESS 0x3fd872 BYTE_ORDER MSB_LAST FORMAT "%6.2" /end MEASUREMENT
/begin MEASUREMENT tqe "Effective engine torque at clutch" SWORD _CNV_A_R_LINEAR_____55_CM 1 100. -1024. 1023.96875 DISPLAY_IDENTIFIER TQE ECU_ADDRESS 0x3fd874 BYTE_ORDER MSB_LAST FORMAT "%6.2" /end MEASUREMENT
/begin MEASUREMENT tqi_av "Actual indicated engine torque" SWORD _CNV_A_R_LINEAR_____55_CM 1 100. -1024. 1023.96875 DISPLAY_IDENTIFIER TQI_AV ECU_ADDRESS 0x3fd870 BYTE_ORDER MSB_LAST FORMAT "%6.2" /end MEASUREMENT
/begin MEASUREMENT tqe_dif "Difference effective engine torque at clutch" SWORD _CNV_A_R_LINEAR_____55_CM 1 100. -1024. 1023.96875 DISPLAY_IDENTIFIER TQE_DIF ECU_ADDRESS 0x3fd87a BYTE_ORDER MSB_LAST FORMAT "%6.2" /end MEASUREMENT
/begin MEASUREMENT eff_tot_av "Total actual efficiency (in homogeneous mode)" UWORD _CNV_A_R_LINEAR_____21_CM 1 100. 0. 1.99996948 DISPLAY_IDENTIFIER EFF_TOT_AV ECU_ADDRESS 0x3fd876 BYTE_ORDER MSB_LAST FORMAT "%7.5" /end MEASUREMENT
/begin MEASUREMENT tqi_av_s "Actual indicated engine torque for stratified mode" SWORD _CNV_A_R_LINEAR_____55_CM 1 100. -1024. 1023.96875 DISPLAY_IDENTIFIER TQI_AV_S ECU_ADDRESS 0x3fd87c BYTE_ORDER MSB_LAST FORMAT "%6.2" /end MEASUREMENT
/begin MEASUREMENT eff_tot_av_s "Total actual efficiency in stratified mode" UWORD _CNV_A_R_LINEAR_____21_CM 1 100. 0. 1.99996948 DISPLAY_IDENTIFIER EFF_TOT_AV_S ECU_ADDRESS 0x3fd87e BYTE_ORDER MSB_LAST FORMAT "%7.5" /end MEASUREMENT
/begin MEASUREMENT tqi_ref_s "Indicated  reference engine torque for stratified mode" SWORD _CNV_A_R_LINEAR_____55_CM 1 100. -1024. 1023.96875 DISPLAY_IDENTIFIER TQI_REF_S ECU_ADDRESS 0x3fd88c BYTE_ORDER MSB_LAST FORMAT "%8.2" /end MEASUREMENT
/begin CHARACTERISTIC ip_tqi_ref_s "Referenced indicated engine torque for stratified mode" MAP 0x104b6 _REC_MAP_20_u2_u1_u2 2047.96875 _CNV_A_R_LINEAR_____186_CM -1024. 1023.96875 DISPLAY_IDENTIFIER IP_TQI_REF_S FORMAT "%6.2"
 /begin AXIS_DESCR COM_AXIS n_32 _CNV_A_R_LINEAR_____16_CM 16 0. 8160. FORMAT "%4.0" AXIS_PTS_REF ldpm_n_32_s /end AXIS_DESCR
 /begin AXIS_DESCR COM_AXIS mff_sp_s _CNV_A_R_LINEAR_____106_CM 12 0. 1389. FORMAT "%7.2" AXIS_PTS_REF ldp_mff_sp_s__tqi_ref_s /end AXIS_DESCR
/end CHARACTERISTIC
/begin AXIS_PTS ldp_mff_sp_s__tqi_ref_s "" 0x10e70 mff_sp_s _REC_AXS_20_u2 1389. _CNV_A_R_LINEAR_____106_CM 12 0. 1389. DISPLAY_IDENTIFIER LDP_MFF_SP_S__TQI_REF_S FORMAT "%7.2" /end AXIS_PTS
/begin MEASUREMENT tqi_bas "Basic indicated engine torque" SWORD _CNV_A_R_LINEAR_____55_CM 1 100. -1024. 1023.96875 DISPLAY_IDENTIFIER TQI_BAS ECU_ADDRESS 0x3fd894 BYTE_ORDER MSB_LAST FORMAT "%6.2" /end MEASUREMENT
/begin MEASUREMENT tqi_ref_iga "Indicated engine torque corrected by EFF_IGA_BAS_COR" SWORD _CNV_A_R_LINEAR_____55_CM 1 100. -1024. 1023.96875 DISPLAY_IDENTIFIER TQI_REF_IGA ECU_ADDRESS 0x3fd89c BYTE_ORDER MSB_LAST FORMAT "%6.2" /end MEASUREMENT
/begin MEASUREMENT tqi_ref_iga_lamb "Indicated engine torque corrected by EFF_IGA_BAS_COR and EFF_LAMB_BAS" SWORD _CNV_A_R_LINEAR_____55_CM 1 100. -1024. 1023.96875 DISPLAY_IDENTIFIER TQI_REF_IGA_LAMB ECU_ADDRESS 0x3fd89a BYTE_ORDER MSB_LAST FORMAT "%6.2" /end MEASUREMENT
/begin MEASUREMENT tqi_ref_iga_min_lamb "Indicated engine torque corrected by EFF_IGA_MIN and EFF_LAMB_BAS" SWORD _CNV_A_R_LINEAR_____55_CM 1 100. -1024. 1023.96875 DISPLAY_IDENTIFIER TQI_REF_IGA_MIN_LAMB ECU_ADDRESS 0x3fd8a2 BYTE_ORDER MSB_LAST FORMAT "%6.2" /end MEASUREMENT
/begin MEASUREMENT tqi_ref_iga_scc "Indicated engine torque corrected by EFF_IGA_BAS_COR and EFF_SCC_BAS" SWORD _CNV_A_R_LINEAR_____55_CM 1 100. -1024. 1023.96875 DISPLAY_IDENTIFIER TQI_REF_IGA_SCC ECU_ADDRESS 0x3fd8a0 BYTE_ORDER MSB_LAST FORMAT "%6.2" /end MEASUREMENT
/begin MEASUREMENT tqi_ref_lamb "Indicated engine torque corrected by EFF_LAMB_BAS" SWORD _CNV_A_R_LINEAR_____55_CM 1 100. -1024. 1023.96875 DISPLAY_IDENTIFIER TQI_REF_LAMB ECU_ADDRESS 0x3fd898 BYTE_ORDER MSB_LAST FORMAT "%6.2" /end MEASUREMENT
/begin MEASUREMENT tqi_ref_lamb_scc "Indicated engine torque corrected by EFF_LAMB_BAS and EFF_SCC_BAS" SWORD _CNV_A_R_LINEAR_____55_CM 1 100. -1024. 1023.96875 DISPLAY_IDENTIFIER TQI_REF_LAMB_SCC ECU_ADDRESS 0x3fd896 BYTE_ORDER MSB_LAST FORMAT "%6.2" /end MEASUREMENT
/begin MEASUREMENT tqi_ref_scc "Indicated engine torque corrected by EFF_SCC_BAS" SWORD _CNV_A_R_LINEAR_____55_CM 1 100. -1024. 1023.96875 DISPLAY_IDENTIFIER TQI_REF_SCC ECU_ADDRESS 0x3fd89e BYTE_ORDER MSB_LAST FORMAT "%6.2" /end MEASUREMENT
/begin MEASUREMENT tqi_ref "Reference indicated engine torque" SWORD _CNV_A_R_LINEAR_____55_CM 1 100. -1024. 1023.96875 DISPLAY_IDENTIFIER TQI_REF ECU_ADDRESS 0x3fd892 BYTE_ORDER MSB_LAST FORMAT "%8.2" /end MEASUREMENT
/begin MEASUREMENT eff_tot_bas "Total basic efficiency" UWORD _CNV_A_R_LINEAR_____21_CM 1 100. 0. 1.99996948 DISPLAY_IDENTIFIER EFF_TOT_BAS ECU_ADDRESS 0x3fd88e BYTE_ORDER MSB_LAST FORMAT "%7.5" /end MEASUREMENT
/begin MEASUREMENT eff_tot_bas_slow "Total basic efficiency for feedback to slow torque path" UWORD _CNV_A_R_LINEAR_____21_CM 1 100. 0. 1.99996948 DISPLAY_IDENTIFIER EFF_TOT_BAS_SLOW ECU_ADDRESS 0x3fd890 BYTE_ORDER MSB_LAST FORMAT "%7.5" /end MEASUREMENT
/begin CHARACTERISTIC lc_mod_eff_av "Logical variable switch to EFF_LAMB_AV and EFF_SCC_AV calculation mode for TQI_BAS" VALUE 0x00f5d _REC_VAL_20_u1 1. _CNV_A_R_LINEAR_____22_CM 0. 1. DISPLAY_IDENTIFIER LC_MOD_EFF_AV FORMAT "%1.0" /end CHARACTERISTIC
/begin MEASUREMENT lv_tq_inc "Logical variable torque increase active" UBYTE _CNV_S_2_RANGE______0_CM 1 100. 0. 1. DISPLAY_IDENTIFIER LV_TQ_INC ECU_ADDRESS 0x3fe555 /end MEASUREMENT
/begin MEASUREMENT tqi_ems "Requested indicated engine torque without external interventions" SWORD _CNV_A_R_LINEAR_____55_CM 1 100. -1024. 1023.96875 DISPLAY_IDENTIFIER TQI_EMS ECU_ADDRESS 0x3fd8a8 BYTE_ORDER MSB_LAST FORMAT "%6.2" /end MEASUREMENT
/begin MEASUREMENT tqi_req_fast_dec "Fast torque decrease request" SWORD _CNV_A_R_LINEAR_____55_CM 1 100. -1024. 1023.96875 DISPLAY_IDENTIFIER TQI_REQ_FAST_DEC ECU_ADDRESS 0x3fd8b2 BYTE_ORDER MSB_LAST FORMAT "%6.2" /end MEASUREMENT
/begin MEASUREMENT tqi_inter_fast "Intermitted value fast torque request after minimum selection" SWORD _CNV_A_R_LINEAR_____55_CM 1 100. -1024. 1023.96875 DISPLAY_IDENTIFIER TQI_INTER_FAST ECU_ADDRESS 0x3fd8ae BYTE_ORDER MSB_LAST FORMAT "%6.2" /end MEASUREMENT
/begin MEASUREMENT tqi_req_fast_inc "Fast torque increase request" SWORD _CNV_A_R_LINEAR_____55_CM 1 100. -1024. 1023.96875 DISPLAY_IDENTIFIER TQI_REQ_FAST_INC ECU_ADDRESS 0x3fd8b0 BYTE_ORDER MSB_LAST FORMAT "%6.2" /end MEASUREMENT
/begin MEASUREMENT tqi_inter_slow "Intermitted value slow torque request after minimum selection" SWORD _CNV_A_R_LINEAR_____55_CM 1 100. -1024. 1023.96875 DISPLAY_IDENTIFIER TQI_INTER_SLOW ECU_ADDRESS 0x3fd8ac BYTE_ORDER MSB_LAST FORMAT "%6.2" /end MEASUREMENT
/begin MEASUREMENT tqi_req_slow_sel "Slow indicated engine torque request selected" SWORD _CNV_A_R_LINEAR_____55_CM 1 100. -1024. 1023.96875 DISPLAY_IDENTIFIER TQI_REQ_SLOW_SEL ECU_ADDRESS 0x3fd8a4 BYTE_ORDER MSB_LAST FORMAT "%6.2" /end MEASUREMENT
/begin MEASUREMENT tqi_req_fast_sel "Fast indicated engine torque request selected" SWORD _CNV_A_R_LINEAR_____55_CM 1 100. -1024. 1023.96875 DISPLAY_IDENTIFIER TQI_REQ_FAST_SEL ECU_ADDRESS 0x3fd8a6 BYTE_ORDER MSB_LAST FORMAT "%6.2" /end MEASUREMENT
/begin MEASUREMENT tqi_req_fast_sel_can "Requested indicated engine torque without external interventions for CAN" SWORD _CNV_A_R_LINEAR_____55_CM 1 100. -1024. 1023.96875 DISPLAY_IDENTIFIER TQI_REQ_FAST_SEL_CAN ECU_ADDRESS 0x3fd8aa BYTE_ORDER MSB_LAST FORMAT "%6.2" /end MEASUREMENT
/begin MEASUREMENT state_tq_intv_slow "Air paph external torque intervention" UBYTE _CNV_S_8_RANGE_STAT_469_CM 1 100. 0. 7. DISPLAY_IDENTIFIER STATE_TQ_INTV_SLOW ECU_ADDRESS 0x3fe553 /end MEASUREMENT
/begin MEASUREMENT state_tq_intv_fast "Fast external torque intervention" UBYTE _CNV_S_8_RANGE_STAT_469_CM 1 100. 0. 7. DISPLAY_IDENTIFIER STATE_TQ_INTV_FAST ECU_ADDRESS 0x3fe554 /end MEASUREMENT
/begin MEASUREMENT t_tra "Actual time value for torque ramps" UBYTE _CNV_A_R_LINEAR_____4_CM 1 100. 0. 2.55 DISPLAY_IDENTIFIER T_TRA ECU_ADDRESS 0x3fe5e0 FORMAT "%4.2" /end MEASUREMENT
/begin MEASUREMENT tq_req_dif_tra "Deviation of TQ_REQ_CLU and TQ_REQ_TRA_CLU limited to \"0\" Nm" SWORD _CNV_A_R_LINEAR_____55_CM 1 100. -1024. 1023.96875 DISPLAY_IDENTIFIER TQ_REQ_DIF_TRA ECU_ADDRESS 0x3fda10 BYTE_ORDER MSB_LAST FORMAT "%6.2" /end MEASUREMENT
/begin MEASUREMENT tq_range "Range of TQ_REQ_TRA_CLU" ULONG _CNV_S_3_STATE_TQ_R_470_CM 1 100. 1. 3. DISPLAY_IDENTIFIER TQ_RANGE ECU_ADDRESS 0x3fe5dc BYTE_ORDER MSB_LAST /end MEASUREMENT
/begin MEASUREMENT tq_req_tra_clu "Torque request at clutch after transient torque function" SWORD _CNV_A_R_LINEAR_____55_CM 1 100. -1024. 1023.96875 DISPLAY_IDENTIFIER TQ_REQ_TRA_CLU ECU_ADDRESS 0x3fda0e BYTE_ORDER MSB_LAST FORMAT "%6.2" /end MEASUREMENT
/begin MEASUREMENT tq_req_tra_old_clu "Old torque value at steady state conditions" SWORD _CNV_A_R_LINEAR_____55_CM 1 100. -1024. 1023.96875 DISPLAY_IDENTIFIER TQ_REQ_TRA_OLD_CLU ECU_ADDRESS 0x3fda14 BYTE_ORDER MSB_LAST FORMAT "%6.2" /end MEASUREMENT
/begin MEASUREMENT tqi_req_tra "Indicated torque request after transient torque function" SWORD _CNV_A_R_LINEAR_____55_CM 1 100. -1024. 1023.96875 DISPLAY_IDENTIFIER TQI_REQ_TRA ECU_ADDRESS 0x3fda0c BYTE_ORDER MSB_LAST FORMAT "%6.2" /end MEASUREMENT
/begin MEASUREMENT tq_req_tra_state "State of torque transient phase" ULONG _CNV_S_3_STATE_TQ_R_471_CM 1 100. 0. 2. DISPLAY_IDENTIFIER TQ_REQ_TRA_STATE ECU_ADDRESS 0x3fe5d8 BYTE_ORDER MSB_LAST /end MEASUREMENT
/begin CHARACTERISTIC c_tq_tra_thd_up_2 "Torque threshold 2 for increasing torque" VALUE 0x004b6 _REC_VAL_20_s2 2047.96875 _CNV_A_R_LINEAR_____55_CM -1024. 1023.96875 DISPLAY_IDENTIFIER C_TQ_TRA_THD_UP_2 FORMAT "%7.1" /end CHARACTERISTIC
/begin CHARACTERISTIC c_n_grd_thd_neg "Engine speed gradient for torque increase" VALUE 0x0038f _REC_VAL_20_s1 8160. _CNV_A_R_LINEAR_____51_CM -4096. 4064. DISPLAY_IDENTIFIER C_N_GRD_THD_NEG FORMAT "%5.0" /end CHARACTERISTIC
/begin CHARACTERISTIC c_n_grd_thd_pos "Engine speed gradient for torque decrease" VALUE 0x00390 _REC_VAL_20_s1 8160. _CNV_A_R_LINEAR_____51_CM -4096. 4064. DISPLAY_IDENTIFIER C_N_GRD_THD_POS FORMAT "%5.0" /end CHARACTERISTIC
/begin CHARACTERISTIC lc_tq_tra_inh "Logical parameter inhibition torque transient (0 ... torque transient active, 1... torque transient passive)" VALUE 0x00f93 _REC_VAL_20_u1 1. _CNV_A_R_LINEAR_____22_CM 0. 1. DISPLAY_IDENTIFIER LC_TQ_TRA_INH FORMAT "%1.0" /end CHARACTERISTIC
/begin CHARACTERISTIC c_tq_tra_thd_down_1 "Torque threshold 1 for decreasing torque" VALUE 0x004b0 _REC_VAL_20_s2 2047.96875 _CNV_A_R_LINEAR_____55_CM -1024. 1023.96875 DISPLAY_IDENTIFIER C_TQ_TRA_THD_DOWN_1 FORMAT "%7.1" /end CHARACTERISTIC
/begin CHARACTERISTIC c_tq_tra_thd_down_2 "Torque threshold 2 for decreasing torque" VALUE 0x004b2 _REC_VAL_20_s2 2047.96875 _CNV_A_R_LINEAR_____55_CM -1024. 1023.96875 DISPLAY_IDENTIFIER C_TQ_TRA_THD_DOWN_2 FORMAT "%7.1" /end CHARACTERISTIC
/begin CHARACTERISTIC c_tq_tra_thd_up_1 "Torque threshold 1 for increasing torque" VALUE 0x004b4 _REC_VAL_20_s2 2047.96875 _CNV_A_R_LINEAR_____55_CM -1024. 1023.96875 DISPLAY_IDENTIFIER C_TQ_TRA_THD_UP_1 FORMAT "%7.1" /end CHARACTERISTIC
/begin MEASUREMENT lv_tq_tra "Logical variable transient torque function acitve" UBYTE _CNV_S_2_RANGE______0_CM 1 100. 0. 1. DISPLAY_IDENTIFIER LV_TQ_TRA ECU_ADDRESS 0x3fe5e1 BIT_MASK 0x1 /end MEASUREMENT
/begin MEASUREMENT lv_tq_tra_dyn "Logical variable spark retard requested due to driver dynamics" UBYTE _CNV_S_2_RANGE______0_CM 1 100. 0. 1. DISPLAY_IDENTIFIER LV_TQ_TRA_DYN ECU_ADDRESS 0x3fe5d4 /end MEASUREMENT
/begin MEASUREMENT tqi_req_slow "Slow indicated engine torque request" SWORD _CNV_A_R_LINEAR_____55_CM 1 100. -1024. 1023.96875 DISPLAY_IDENTIFIER TQI_REQ_SLOW ECU_ADDRESS 0x3fd850 BYTE_ORDER MSB_LAST FORMAT "%6.2" /end MEASUREMENT
/begin MEASUREMENT tqi_req_fast "Fast indicated engine torque request" SWORD _CNV_A_R_LINEAR_____55_CM 1 100. -1024. 1023.96875 DISPLAY_IDENTIFIER TQI_REQ_FAST ECU_ADDRESS 0x3fd852 BYTE_ORDER MSB_LAST FORMAT "%6.2" /end MEASUREMENT
/begin MEASUREMENT tqi_req_fast_can "Limited torque request for fast path to CAN" SWORD _CNV_A_R_LINEAR_____55_CM 1 100. -1024. 1023.96875 DISPLAY_IDENTIFIER TQI_REQ_FAST_CAN ECU_ADDRESS 0x3fd854 BYTE_ORDER MSB_LAST FORMAT "%6.2" /end MEASUREMENT
/begin MEASUREMENT tqi_bas_cor_ch "Corrected indicated basic engine torque at active torque lead with TQI_ADD_CH_FIL" SWORD _CNV_A_R_LINEAR_____55_CM 1 100. -1024. 1023.96875 DISPLAY_IDENTIFIER TQI_BAS_COR_CH ECU_ADDRESS 0x3fd86a BYTE_ORDER MSB_LAST FORMAT "%8.2" /end MEASUREMENT
/begin MEASUREMENT tqi_sp "Setpoint indicated engine torque" SWORD _CNV_A_R_LINEAR_____55_CM 1 100. -1024. 1023.96875 DISPLAY_IDENTIFIER TQI_SP ECU_ADDRESS 0x3fd858 BYTE_ORDER MSB_LAST FORMAT "%6.2" /end MEASUREMENT
/begin MEASUREMENT tqi_sp_1 "Non smoothed setpoint indicated engine torque" SWORD _CNV_A_R_LINEAR_____55_CM 1 100. -1024. 1023.96875 DISPLAY_IDENTIFIER TQI_SP_1 ECU_ADDRESS 0x3fd860 BYTE_ORDER MSB_LAST FORMAT "%6.2" /end MEASUREMENT
/begin MEASUREMENT tqi_sp_2 "Smooth setpoint indicated engine torque" SWORD _CNV_A_R_LINEAR_____55_CM 1 100. -1024. 1023.96875 DISPLAY_IDENTIFIER TQI_SP_2 ECU_ADDRESS 0x3fd862 BYTE_ORDER MSB_LAST FORMAT "%6.2" /end MEASUREMENT
/begin MEASUREMENT tqi_sp_3 "Intermitted setpoint indicated engine torque after selection" SWORD _CNV_A_R_LINEAR_____55_CM 1 100. -1024. 1023.96875 DISPLAY_IDENTIFIER TQI_SP_3 ECU_ADDRESS 0x3fd864 BYTE_ORDER MSB_LAST FORMAT "%6.2" /end MEASUREMENT
/begin MEASUREMENT tqi_sp_maf "Indicated engine torque set-point has to realized by mass air flow control" SWORD _CNV_A_R_LINEAR_____55_CM 1 100. -1024. 1023.96875 DISPLAY_IDENTIFIER TQI_SP_MAF ECU_ADDRESS 0x3fd866 BYTE_ORDER MSB_LAST FORMAT "%6.2" /end MEASUREMENT
/begin MEASUREMENT tqi_bas_cor "Corrected indicated basic engine torque at active torque lead" SWORD _CNV_A_R_LINEAR_____55_CM 1 100. -1024. 1023.96875 DISPLAY_IDENTIFIER TQI_BAS_COR ECU_ADDRESS 0x3fd85c BYTE_ORDER MSB_LAST FORMAT "%6.2" /end MEASUREMENT
/begin MEASUREMENT maf_sp_tqi "MAF setpoint for torque interventions" UWORD _CNV_A_R_LINEAR_____106_CM 1 100. 0. 1389. DISPLAY_IDENTIFIER MAF_SP_TQI ECU_ADDRESS 0x3fd84e BYTE_ORDER MSB_LAST FORMAT "%6.2" /end MEASUREMENT
/begin MEASUREMENT tqi_fast "Indicated engine torque fast request" SWORD _CNV_A_R_LINEAR_____55_CM 1 100. -1024. 1023.96875 DISPLAY_IDENTIFIER TQI_FAST ECU_ADDRESS 0x3fd856 BYTE_ORDER MSB_LAST FORMAT "%6.2" /end MEASUREMENT
/begin MEASUREMENT tqi_sp_maf_1 "Indicated engine torque set-point has to realized by mass air flow control intermediate 1" SWORD _CNV_A_R_LINEAR_____55_CM 1 100. -1024. 1023.96875 DISPLAY_IDENTIFIER TQI_SP_MAF_1 ECU_ADDRESS 0x3fd85e BYTE_ORDER MSB_LAST FORMAT "%6.2" /end MEASUREMENT
/begin MEASUREMENT lv_tq_intv "Logical variable fast torque intervention allowed" UBYTE _CNV_S_2_RANGE______0_CM 1 100. 0. 1. DISPLAY_IDENTIFIER LV_TQ_INTV ECU_ADDRESS 0x3fe551 BIT_MASK 0x1 /end MEASUREMENT
/begin MEASUREMENT tqi_sp_maf_2 "Indicated engine torque set-point has to realized by mass air flow control intermediate 2" SWORD _CNV_A_R_LINEAR_____55_CM 1 100. -1024. 1023.96875 DISPLAY_IDENTIFIER TQI_SP_MAF_2 ECU_ADDRESS 0x3fd868 BYTE_ORDER MSB_LAST FORMAT "%6.2" /end MEASUREMENT
/begin MEASUREMENT lv_tq_intv_req "Logical variable fast torque intervention requested" UBYTE _CNV_S_2_RANGE______0_CM 1 100. 0. 1. DISPLAY_IDENTIFIER LV_TQ_INTV_REQ ECU_ADDRESS 0x3fe550 BIT_MASK 0x1 /end MEASUREMENT
/begin CHARACTERISTIC c_tq_dif_1 "Torque threshold 1 for bottom level offset of smoothing zone" VALUE 0x00482 _REC_VAL_20_s2 2047.96875 _CNV_A_R_LINEAR_____55_CM -1024. 1023.96875 DISPLAY_IDENTIFIER C_TQ_DIF_1 FORMAT "%7.1" /end CHARACTERISTIC
/begin CHARACTERISTIC c_tq_dif_2 "Torque threshold 2 for top level offset of smoothing zone" VALUE 0x00484 _REC_VAL_20_s2 2047.96875 _CNV_A_R_LINEAR_____55_CM -1024. 1023.96875 DISPLAY_IDENTIFIER C_TQ_DIF_2 FORMAT "%7.1" /end CHARACTERISTIC
/begin CHARACTERISTIC c_tq_dif_hys_1 "Torque hysteresis 1 for bottom level offset of smoothing zone" VALUE 0x00486 _REC_VAL_20_s2 2047.96875 _CNV_A_R_LINEAR_____55_CM -1024. 1023.96875 DISPLAY_IDENTIFIER C_TQ_DIF_HYS_1 FORMAT "%7.1" /end CHARACTERISTIC
/begin CHARACTERISTIC lc_tq_intv_ena_as "Logical constant fast torque intervention enabled by application system" VALUE 0x00f88 _REC_VAL_20_u1 1. _CNV_A_R_LINEAR_____22_CM 0. 1. DISPLAY_IDENTIFIER LC_TQ_INTV_ENA_AS FORMAT "%1.0" /end CHARACTERISTIC
/begin CHARACTERISTIC c_tq_dif_hys_2 "Torque hysteresis 2 for top level offset of smoothing zone" VALUE 0x00488 _REC_VAL_20_s2 2047.96875 _CNV_A_R_LINEAR_____55_CM -1024. 1023.96875 DISPLAY_IDENTIFIER C_TQ_DIF_HYS_2 FORMAT "%7.1" /end CHARACTERISTIC
/begin CHARACTERISTIC lc_tq_intv_inh_as "Logical constant fast torque intervention inhibited by application system" VALUE 0x00f89 _REC_VAL_20_u1 1. _CNV_A_R_LINEAR_____22_CM 0. 1. DISPLAY_IDENTIFIER LC_TQ_INTV_INH_AS FORMAT "%1.0" /end CHARACTERISTIC
/begin CHARACTERISTIC c_tq_dif_hys_is_1 "Torque hysteresis 1 for bottom level offset of smoothing zone during idle speed control " VALUE 0x0048a _REC_VAL_20_s2 2047.96875 _CNV_A_R_LINEAR_____55_CM -1024. 1023.96875 DISPLAY_IDENTIFIER C_TQ_DIF_HYS_IS_1 FORMAT "%7.1" /end CHARACTERISTIC
/begin CHARACTERISTIC c_tq_dif_hys_is_2 "Torque hysteresis 2 for top level offset of smoothing zone during idle speed control" VALUE 0x0048c _REC_VAL_20_s2 2047.96875 _CNV_A_R_LINEAR_____55_CM -1024. 1023.96875 DISPLAY_IDENTIFIER C_TQ_DIF_HYS_IS_2 FORMAT "%7.1" /end CHARACTERISTIC
/begin CHARACTERISTIC lc_tqi_sp_man_act "Logical constant manual torque active" VALUE 0x00f97 _REC_VAL_20_u1 1. _CNV_A_R_LINEAR_____22_CM 0. 1. DISPLAY_IDENTIFIER LC_TQI_SP_MAN_ACT FORMAT "%1.0" /end CHARACTERISTIC
/begin CHARACTERISTIC c_tq_dif_is_1 "Torque threshold 1 for bottom level offset of smoothing zone during idle speed control" VALUE 0x0048e _REC_VAL_20_s2 2047.96875 _CNV_A_R_LINEAR_____55_CM -1024. 1023.96875 DISPLAY_IDENTIFIER C_TQ_DIF_IS_1 FORMAT "%7.1" /end CHARACTERISTIC
/begin CHARACTERISTIC c_tq_dif_is_2 "Torque threshold 2 for top level offset of smoothing zone during idle speed control" VALUE 0x00490 _REC_VAL_20_s2 2047.96875 _CNV_A_R_LINEAR_____55_CM -1024. 1023.96875 DISPLAY_IDENTIFIER C_TQ_DIF_IS_2 FORMAT "%7.1" /end CHARACTERISTIC
/begin CHARACTERISTIC c_tqi_sp_man "Manual torque setpoint request by application tool" VALUE 0x004be _REC_VAL_20_s2 2047.96875 _CNV_A_R_LINEAR_____55_CM -1024. 1023.96875 DISPLAY_IDENTIFIER C_TQI_SP_MAN FORMAT "%7.1" /end CHARACTERISTIC
/begin MEASUREMENT tqi_sp_can "Setpoint indicated engine torque for CAN calculations" SWORD _CNV_A_R_LINEAR_____55_CM 1 100. -1024. 1023.96875 DISPLAY_IDENTIFIER TQI_SP_CAN ECU_ADDRESS 0x3fd85a BYTE_ORDER MSB_LAST FORMAT "%6.2" /end MEASUREMENT
/begin MEASUREMENT tqi_fast_can "Indicated engine torque fast request for CAN" SWORD _CNV_A_R_LINEAR_____55_CM 1 100. -1024. 1023.96875 DISPLAY_IDENTIFIER TQI_FAST_CAN ECU_ADDRESS 0x3fd86c BYTE_ORDER MSB_LAST FORMAT "%6.2" /end MEASUREMENT
/begin MEASUREMENT tqi_sp_1_can "Non smoothed setpoint indicated engine torque for CAN" SWORD _CNV_A_R_LINEAR_____55_CM 1 100. -1024. 1023.96875 DISPLAY_IDENTIFIER TQI_SP_1_CAN ECU_ADDRESS 0x3fd86e BYTE_ORDER MSB_LAST FORMAT "%6.2" /end MEASUREMENT
/begin CHARACTERISTIC ip_maf_sp "Setpoint mass air flow depending on slow torque setpoint" MAP 0x0c7a6 _REC_MAP_20_u2_u1_u2 1389. _CNV_A_R_LINEAR_____106_CM 0. 1389. DISPLAY_IDENTIFIER IP_MAF_SP FORMAT "%7.2"
 /begin AXIS_DESCR COM_AXIS n_32 _CNV_A_R_LINEAR_____16_CM 16 0. 8160. FORMAT "%4.0" AXIS_PTS_REF ldpm_n_32_100 /end AXIS_DESCR
 /begin AXIS_DESCR COM_AXIS tqi_sp_maf _CNV_A_R_LINEAR_____55_CM 12 0. 1023.96875 FORMAT "%7.2" AXIS_PTS_REF ldp_tqi_sp_maf__maf_sp /end AXIS_DESCR
/end CHARACTERISTIC
/begin AXIS_PTS ldp_tqi_sp_maf__maf_sp "" 0x113d8 tqi_sp_maf _REC_AXS_20_u2 1023.96875 _CNV_A_R_LINEAR_____55_CM 12 0. 1023.96875 DISPLAY_IDENTIFIER LDP_TQI_SP_MAF__MAF_SP FORMAT "%7.2" /end AXIS_PTS
/begin MEASUREMENT tq_add_req_ch "Requested torque reserve for catalyt-heating" SWORD _CNV_A_R_LINEAR_____55_CM 1 100. -1024. 1023.96875 DISPLAY_IDENTIFIER TQ_ADD_REQ_CH ECU_ADDRESS 0x3fd8d2 BYTE_ORDER MSB_LAST FORMAT "%6.2" /end MEASUREMENT
/begin MEASUREMENT tq_add_max "Maximum possible torque reserve" SWORD _CNV_A_R_LINEAR_____55_CM 1 100. -1024. 1023.96875 DISPLAY_IDENTIFIER TQ_ADD_MAX ECU_ADDRESS 0x3fd8c2 BYTE_ORDER MSB_LAST FORMAT "%6.2" /end MEASUREMENT
/begin MEASUREMENT tq_add_req_max_teg "Maximum possible torque reserve request due to EFF_IGA_MIN_TEG" SWORD _CNV_A_R_LINEAR_____55_CM 1 100. -1024. 1023.96875 DISPLAY_IDENTIFIER TQ_ADD_REQ_MAX_TEG ECU_ADDRESS 0x3fd8d0 BYTE_ORDER MSB_LAST FORMAT "%6.2" /end MEASUREMENT
/begin MEASUREMENT maf_kgh_add_max "Maximum possible engine load for catalyst heating - kg/h" UWORD _CNV_A_R_LINEAR_____113_CM 1 100. 0. 2047.96875 DISPLAY_IDENTIFIER MAF_KGH_ADD_MAX ECU_ADDRESS 0x3fd8b4 BYTE_ORDER MSB_LAST FORMAT "%7.2" /end MEASUREMENT
/begin MEASUREMENT maf_add_max "Maximum possible engine load for catalyst heating - mg/Stk" UWORD _CNV_A_R_LINEAR_____106_CM 1 100. 0. 1389. DISPLAY_IDENTIFIER MAF_ADD_MAX ECU_ADDRESS 0x3fd8b6 BYTE_ORDER MSB_LAST FORMAT "%7.2" /end MEASUREMENT
/begin MEASUREMENT tqi_add_act "Active indicated engine torque inclusive torque reserve" SWORD _CNV_A_R_LINEAR_____55_CM 1 100. -1024. 1023.96875 DISPLAY_IDENTIFIER TQI_ADD_ACT ECU_ADDRESS 0x3fd8ba BYTE_ORDER MSB_LAST FORMAT "%6.2" /end MEASUREMENT
/begin MEASUREMENT eff_iga_min_add_max "Minimum possible ignition efficiency for catalyst heating" UWORD _CNV_A_R_LINEAR_____21_CM 1 100. 0. 1.99996948 DISPLAY_IDENTIFIER EFF_IGA_MIN_ADD_MAX ECU_ADDRESS 0x3fd8b8 BYTE_ORDER MSB_LAST FORMAT "%7.5" /end MEASUREMENT
/begin MEASUREMENT tqi_add_max "Maximum possible indicated engine torque inclusive torque reserve" SWORD _CNV_A_R_LINEAR_____55_CM 1 100. -1024. 1023.96875 DISPLAY_IDENTIFIER TQI_ADD_MAX ECU_ADDRESS 0x3fd8bc BYTE_ORDER MSB_LAST FORMAT "%6.2" /end MEASUREMENT
/begin MEASUREMENT lv_tq_add_req "Logical variable torque reserve request can be applied" UBYTE _CNV_S_2_RANGE______0_CM 1 100. 0. 1. DISPLAY_IDENTIFIER LV_TQ_ADD_REQ ECU_ADDRESS 0x3fe556 /end MEASUREMENT
/begin MEASUREMENT tq_add_act "Active clutch torque inclusive torque reserve" SWORD _CNV_A_R_LINEAR_____55_CM 1 100. -1024. 1023.96875 DISPLAY_IDENTIFIER TQ_ADD_ACT ECU_ADDRESS 0x3fd8be BYTE_ORDER MSB_LAST FORMAT "%7.1" /end MEASUREMENT
/begin MEASUREMENT tqi_add_act_tmp_1 "Temporary indicated engine-torque request inclusive torque reserve - for slow torque coordination input" SWORD _CNV_A_R_LINEAR_____55_CM 1 100. -1024. 1023.96875 DISPLAY_IDENTIFIER TQI_ADD_ACT_TMP_1 ECU_ADDRESS 0x3fd8c8 BYTE_ORDER MSB_LAST FORMAT "%6.2" /end MEASUREMENT
/begin MEASUREMENT tq_add_req "Requested torque reserve after max.coordination" SWORD _CNV_A_R_LINEAR_____55_CM 1 100. -1024. 1023.96875 DISPLAY_IDENTIFIER TQ_ADD_REQ ECU_ADDRESS 0x3fd8c6 BYTE_ORDER MSB_LAST FORMAT "%6.2" /end MEASUREMENT
/begin MEASUREMENT tqi_add_act_tmp_2 "Indicated engine-torque request inclusive torque reserve - for general torque-reserve request" SWORD _CNV_A_R_LINEAR_____55_CM 1 100. -1024. 1023.96875 DISPLAY_IDENTIFIER TQI_ADD_ACT_TMP_2 ECU_ADDRESS 0x3fd8ca BYTE_ORDER MSB_LAST FORMAT "%6.2" /end MEASUREMENT
/begin MEASUREMENT tqi_add_act_tmp_3 "Indicated engine-torque request inclusive torque reserve - for catalyst-heating torque-reserve request" SWORD _CNV_A_R_LINEAR_____55_CM 1 100. -1024. 1023.96875 DISPLAY_IDENTIFIER TQI_ADD_ACT_TMP_3 ECU_ADDRESS 0x3fd8cc BYTE_ORDER MSB_LAST FORMAT "%6.2" /end MEASUREMENT
/begin MEASUREMENT tqi_add_max_tol "Maximum possible indicated engine torque inclusive torque reserve at IGA_MIN" SWORD _CNV_A_R_LINEAR_____55_CM 1 100. -1024. 1023.96875 DISPLAY_IDENTIFIER TQI_ADD_MAX_TOL ECU_ADDRESS 0x3fd8c4 BYTE_ORDER MSB_LAST FORMAT "%6.2" /end MEASUREMENT
/begin MEASUREMENT tqi_add_max_teg "Maximum possible indicated engine torque inclusive torque reserve at IGA_MIN_TEG" SWORD _CNV_A_R_LINEAR_____55_CM 1 100. -1024. 1023.96875 DISPLAY_IDENTIFIER TQI_ADD_MAX_TEG ECU_ADDRESS 0x3fd8ce BYTE_ORDER MSB_LAST FORMAT "%6.2" /end MEASUREMENT
/begin MEASUREMENT lv_tq_add_req_1 "Logical variable torque reserve request can be applied" UBYTE _CNV_S_2_RANGE______5_CM 1 100. 0. 1. DISPLAY_IDENTIFIER LV_TQ_ADD_REQ_1 ECU_ADDRESS 0x3fe557 /end MEASUREMENT
/begin MEASUREMENT tq_add_req_act "Actual realized torque-reserve-request for slow torque coordination input" SWORD _CNV_A_R_LINEAR_____55_CM 1 100. -1024. 1023.96875 DISPLAY_IDENTIFIER TQ_ADD_REQ_ACT ECU_ADDRESS 0x3fd8c0 BYTE_ORDER MSB_LAST FORMAT "%6.2" /end MEASUREMENT
/begin MEASUREMENT lv_tq_add_req_2 "Logical variable torque reserve request can be applied" UBYTE _CNV_S_2_RANGE______5_CM 1 100. 0. 1. DISPLAY_IDENTIFIER LV_TQ_ADD_REQ_2 ECU_ADDRESS 0x3fe558 /end MEASUREMENT
/begin CHARACTERISTIC lc_inh_tq_add_ch "Logical constant for deactivation torque-reserve request for catalyst heating" VALUE 0x00f44 _REC_VAL_20_u1 1. _CNV_A_R_LINEAR_____1_CM 0. 1. DISPLAY_IDENTIFIER LC_INH_TQ_ADD_CH FORMAT "%2.0" /end CHARACTERISTIC
/begin CHARACTERISTIC lc_inh_tq_add "Logical constant for deactivation general torque-reserve request" VALUE 0x00f43 _REC_VAL_20_u1 1. _CNV_A_R_LINEAR_____1_CM 0. 1. DISPLAY_IDENTIFIER LC_INH_TQ_ADD FORMAT "%2.0" /end CHARACTERISTIC
/begin CHARACTERISTIC c_tq_add_min_ch "Minimum threshold for authorizing torque request for catalyst heating" VALUE 0x0047a _REC_VAL_20_s2 2047.96875 _CNV_A_R_LINEAR_____55_CM -1024. 1023.96875 DISPLAY_IDENTIFIER C_TQ_ADD_MIN_CH FORMAT "%7.1" /end CHARACTERISTIC
/begin CHARACTERISTIC c_tq_add_hys "Torque lead hysteresis for deactivation torque lead request" VALUE 0x00474 _REC_VAL_20_s2 2047.96875 _CNV_A_R_LINEAR_____55_CM -1024. 1023.96875 DISPLAY_IDENTIFIER C_TQ_ADD_HYS FORMAT "%7.1" /end CHARACTERISTIC
/begin CHARACTERISTIC c_tq_add_hys_cru "Torque lead hysteresis for deactivation torque lead request at active cruise control" VALUE 0x00476 _REC_VAL_20_s2 2047.96875 _CNV_A_R_LINEAR_____55_CM -1024. 1023.96875 DISPLAY_IDENTIFIER C_TQ_ADD_HYS_CRU FORMAT "%7.1" /end CHARACTERISTIC
/begin CHARACTERISTIC c_tq_add_min "Minimum threshold for authorizing torque lead request" VALUE 0x00478 _REC_VAL_20_s2 2047.96875 _CNV_A_R_LINEAR_____55_CM -1024. 1023.96875 DISPLAY_IDENTIFIER C_TQ_ADD_MIN FORMAT "%7.1" /end CHARACTERISTIC
/begin CHARACTERISTIC c_tq_add_min_cru "Minimum threshold for authorizing torque lead request at active cruise control" VALUE 0x0047c _REC_VAL_20_s2 2047.96875 _CNV_A_R_LINEAR_____55_CM -1024. 1023.96875 DISPLAY_IDENTIFIER C_TQ_ADD_MIN_CRU FORMAT "%7.1" /end CHARACTERISTIC
/begin MEASUREMENT tq_add_st "Torque reserve at engine start" SWORD _CNV_A_R_LINEAR_____55_CM 1 100. -1024. 1023.96875 DISPLAY_IDENTIFIER TQ_ADD_ST ECU_ADDRESS 0x3fd95e BYTE_ORDER MSB_LAST FORMAT "%6.2" /end MEASUREMENT
/begin MEASUREMENT lv_tq_add_st "Logical variable torque reserve at engine start" UBYTE _CNV_S_2_RANGE______0_CM 1 100. 0. 1. DISPLAY_IDENTIFIER LV_TQ_ADD_ST ECU_ADDRESS 0x3fe58c BIT_MASK 0x1 /end MEASUREMENT
/begin CHARACTERISTIC c_t_tq_add_dly_st "Time delay for deactivation torque lead" VALUE 0x018c0 _REC_VAL_20_u2 655.35 _CNV_A_R_LINEAR_____4_CM 0. 655.35 DISPLAY_IDENTIFIER C_T_TQ_ADD_DLY_ST FORMAT "%5.2" /end CHARACTERISTIC
/begin CHARACTERISTIC c_tq_add_crlc_st "Correlation constant for torque  lead" VALUE 0x008fb _REC_VAL_20_u1 0.9960940000000002 _CNV_A_R_LINEAR_____50_CM 0. 0.996094 DISPLAY_IDENTIFIER C_TQ_ADD_CRLC_ST FORMAT "%5.3" /end CHARACTERISTIC
/begin AXIS_PTS ldp_n_tq_add_st "" 0x07d1a n_32 _REC_AXS_20_u1 8160. _CNV_A_R_LINEAR_____16_CM 8 0. 8160. DISPLAY_IDENTIFIER LDP_N_TQ_ADD_ST FORMAT "%4.0" /end AXIS_PTS
/begin AXIS_PTS ldp_tco_tq_add_st "" 0x011cf tco _REC_AXS_20_u1 190.5 _CNV_A_R_LINEAR_____12_CM 4 -48. 142.5 DISPLAY_IDENTIFIER LDP_TCO_TQ_ADD_ST FORMAT "%5.1" /end AXIS_PTS
/begin CHARACTERISTIC ip_tq_add_st "Torque lead at engine start" MAP 0x0fa5e _REC_MAP_20_u2_u1_u1 2047.96875 _CNV_A_R_LINEAR_____186_CM -1024. 1023.96875 DISPLAY_IDENTIFIER IP_TQ_ADD_ST FORMAT "%6.2"
 /begin AXIS_DESCR COM_AXIS n_32 _CNV_A_R_LINEAR_____16_CM 8 0. 8160. FORMAT "%4.0" AXIS_PTS_REF ldp_n_tq_add_st /end AXIS_DESCR
 /begin AXIS_DESCR COM_AXIS tco _CNV_A_R_LINEAR_____12_CM 4 -48. 142.5 FORMAT "%5.1" AXIS_PTS_REF ldp_tco_tq_add_st /end AXIS_DESCR
/end CHARACTERISTIC
/begin MEASUREMENT tqi_p_max "???" SWORD _CNV_A_R_LINEAR_____55_CM 1 100. -1024. 1023.96875 DISPLAY_IDENTIFIER TQI_P_MAX ECU_ADDRESS 0x3fda16 BYTE_ORDER MSB_LAST FORMAT "%6.2" /end MEASUREMENT
/begin CHARACTERISTIC ip_tq_lim_amt "Maximum allowed torque at clutch due to torque limitation depending on gear ratio by AMT" CURVE 0x0fc12 _REC_CUR_20_u2_u2 1023.96875 _CNV_A_R_LINEAR_____55_CM 0. 1023.96875 DISPLAY_IDENTIFIER IP_TQ_LIM_AMT FORMAT "%7.2"
 /begin AXIS_DESCR COM_AXIS vs_fil _CNV_A_R_LINEAR_____85_CM 6 0. 511.99218 FORMAT "%7.3" AXIS_PTS_REF ldpm_vs_fil__tq_p_max /end AXIS_DESCR
/end CHARACTERISTIC
/begin CHARACTERISTIC ip_tq_lim_at "Maximum allowed torque at clutch due to torque limitation depending on gear ratio by AT" CURVE 0x0fc1e _REC_CUR_20_u2_u2 1023.96875 _CNV_A_R_LINEAR_____55_CM 0. 1023.96875 DISPLAY_IDENTIFIER IP_TQ_LIM_AT FORMAT "%7.2"
 /begin AXIS_DESCR COM_AXIS vs_fil _CNV_A_R_LINEAR_____85_CM 6 0. 511.99218 FORMAT "%7.3" AXIS_PTS_REF ldpm_vs_fil__tq_p_max /end AXIS_DESCR
/end CHARACTERISTIC
/begin CHARACTERISTIC c_t_tq_lim "Time delay vehicle speed activation" VALUE 0x018c2 _REC_VAL_20_u2 20.47 _CNV_A_R_LINEAR_____4_CM 0. 20.47 DISPLAY_IDENTIFIER C_T_TQ_LIM FORMAT "%5.3" /end CHARACTERISTIC
/begin CHARACTERISTIC lc_tqi_p_max_inh_as "Logical constant for torque limitation ON/OFF (0=ON)" VALUE 0x00f94 _REC_VAL_20_u1 1. _CNV_A_R_LINEAR_____22_CM 0. 1. DISPLAY_IDENTIFIER LC_TQI_P_MAX_INH_AS FORMAT "%1.0" /end CHARACTERISTIC
/begin CHARACTERISTIC id_tq_p_max_mt "Maximum allowed torque at clutch due to torque limitation depending on gear ratio" CURVE 0x08a3a _REC_CUR_20_u2_u1 1023.96875 _CNV_A_R_LINEAR_____55_CM 0. 1023.96875 DISPLAY_IDENTIFIER ID_TQ_P_MAX_MT FORMAT "%7.2"
 /begin AXIS_DESCR COM_AXIS gear _CNV_A_R_LINEAR_____22_CM 13 0. 12. FORMAT "%3.0" AXIS_PTS_REF ldpm_gear__tq_p_max /end AXIS_DESCR
/end CHARACTERISTIC
/begin CHARACTERISTIC id_tq_p_max_at "Minimum allowed torque at clutch due to torque limitation depending on gear ratio" CURVE 0x08a20 _REC_CUR_20_u2_u1 1023.96875 _CNV_A_R_LINEAR_____55_CM 0. 1023.96875 DISPLAY_IDENTIFIER ID_TQ_P_MAX_AT FORMAT "%7.2"
 /begin AXIS_DESCR COM_AXIS gear _CNV_A_R_LINEAR_____22_CM 13 0. 12. FORMAT "%3.0" AXIS_PTS_REF ldpm_gear__tq_p_max /end AXIS_DESCR
/end CHARACTERISTIC
/begin AXIS_PTS ldpm_gear__tq_p_max "" 0x07f30 gear _REC_AXS_20_u1 12. _CNV_A_R_LINEAR_____22_CM 13 0. 12. DISPLAY_IDENTIFIER LDPM_GEAR__TQ_P_MAX FORMAT "%3.0" /end AXIS_PTS
/begin AXIS_PTS ldpm_vs_fil__tq_p_max "" 0x11cf8 vs_fil _REC_AXS_20_u2 511.99218 _CNV_A_R_LINEAR_____85_CM 6 0. 511.99218 DISPLAY_IDENTIFIER LDPM_VS_FIL__TQ_P_MAX FORMAT "%7.3" /end AXIS_PTS
/begin CHARACTERISTIC lc_var_bn2000 "" VALUE 0x00f9c _REC_VAL_20_u1 1. _CNV_A_R_LINEAR_____1_CM 0. 1. DISPLAY_IDENTIFIER LC_VAR_BN FORMAT "%2.0" /end CHARACTERISTIC
/begin CHARACTERISTIC lc_var_veh "Vehicle Variant (E60/E65) - BN2000" VALUE 0x00fa0 _REC_VAL_20_u1 1. _CNV_A_R_LINEAR_____1_CM 0. 1. DISPLAY_IDENTIFIER LC_VAR_VEH FORMAT "%2.0" /end CHARACTERISTIC
/begin MEASUREMENT state_lrn_amp "Predicted variant for ambient pressure sensor recognition" UBYTE _CNV_S_3_STATE_LRN__484_CM 1 100. 0. 2. DISPLAY_IDENTIFIER STATE_LRN_AMP ECU_ADDRESS 0x3fe1ba /end MEASUREMENT
/begin CHARACTERISTIC DOLNIV "" VALUE 0x1b812 _REC_VAL_20_u1 127.5 _CNV_R_R_tog_ub_q0p_521_CM 0. 127.5 FORMAT "%5.1" /end CHARACTERISTIC
/begin CHARACTERISTIC ORIVERZ "" VALUE 0x1b813 _REC_VAL_20_u1 255. _CNV_R_R_dez_498_CM 0. 255. FORMAT "%5.1" /end CHARACTERISTIC
/begin CHARACTERISTIC PT1NMOT "" VALUE 0x1b814 _REC_VAL_20_u1 100. _CNV_R_R_rel_ub_b10_522_CM 0. 100. FORMAT "%5.1" /end CHARACTERISTIC
/begin CHARACTERISTIC PT1TOEL "" VALUE 0x1b80a _REC_VAL_20_u2 99.99847 _CNV_R_R_rel_uw_b10_523_CM 0. 99.99847 FORMAT "%8.5" /end CHARACTERISTIC
/begin CHARACTERISTIC TOGANZ "" VALUE 0x1b80c _REC_VAL_20_u2 2999. _CNV_R_R_dez_498_CM 1. 3000. FORMAT "%8.3" /end CHARACTERISTIC
/begin CHARACTERISTIC TOGKURZANZ "" VALUE 0x1b80e _REC_VAL_20_u2 999. _CNV_A_R_LINEAR_____22_CM 1. 1000. FORMAT "%5.0" /end CHARACTERISTIC
/begin CHARACTERISTIC TOGMWK "" VALUE 0x1b815 _REC_VAL_20_u1 99. _CNV_R_R_dez_498_CM 1. 100. FORMAT "%5.1" /end CHARACTERISTIC
/begin CHARACTERISTIC TOGNMOT "" VALUE 0x1b816 _REC_VAL_20_u1 10200. _CNV_R_R_nmot_ub_q4_524_CM 0. 10200. FORMAT "%5.0" /end CHARACTERISTIC
/begin CHARACTERISTIC TOGORIANZ "" VALUE 0x1b817 _REC_VAL_20_u1 254. _CNV_R_R_dez_498_CM 1. 255. FORMAT "%5.1" /end CHARACTERISTIC
/begin CHARACTERISTIC TOGTMOT "" VALUE 0x1b818 _REC_VAL_20_u1 191.3 _CNV_R_R_temp_uw_q0_525_CM -48. 143.3 FORMAT "%5.1" /end CHARACTERISTIC
/begin CHARACTERISTIC TOGTMOTORI "" VALUE 0x1b819 _REC_VAL_20_u1 191.3 _CNV_R_R_temp_uw_q0_525_CM -48. 143.3 FORMAT "%5.1" /end CHARACTERISTIC
/begin CHARACTERISTIC TOGVERBKZ "" VALUE 0x1b81a _REC_VAL_20_u1 127.5 _CNV_R_R_tog_ub_q0p_521_CM 0. 127.5 FORMAT "%5.1" /end CHARACTERISTIC
/begin CHARACTERISTIC TOGVERBNOR "" VALUE 0x1b81b _REC_VAL_20_u1 127.5 _CNV_R_R_tog_ub_q0p_521_CM 0. 127.5 FORMAT "%5.1" /end CHARACTERISTIC
/begin CHARACTERISTIC TOGVERLKZ "" VALUE 0x1b81c _REC_VAL_20_u1 127.5 _CNV_R_R_tog_ub_q0p_521_CM 0. 127.5 FORMAT "%5.1" /end CHARACTERISTIC
/begin CHARACTERISTIC TOGVERLNOR "" VALUE 0x1b81d _REC_VAL_20_u1 127.5 _CNV_R_R_tog_ub_q0p_521_CM 0. 127.5 FORMAT "%5.1" /end CHARACTERISTIC
/begin CHARACTERISTIC TOGVERLORI "" VALUE 0x1b81e _REC_VAL_20_u1 127.5 _CNV_R_R_tog_ub_q0p_521_CM 0. 127.5 FORMAT "%5.1" /end CHARACTERISTIC
/begin CHARACTERISTIC TRTYP "" VALUE 0x1b810 _REC_VAL_20_u2 6553.5 _CNV_R_R_t_q0p1ms_526_CM 0. 6553.5 FORMAT "%8.3" /end CHARACTERISTIC
/begin CHARACTERISTIC KLTOGNKOR "" CURVE 0x1b7e8 _REC_CUR_52_UBYTE_s1_u1 127.5 _CNV_R_R_tog_ub_q0p_521_CM -64. 63.5 FORMAT "%5.2"
 /begin AXIS_DESCR STD_AXIS nmotfm _CNV_R_R_nmot_ub_q4_524_CM 16 0. 10200. FORMAT "%6.1" /end AXIS_DESCR
/end CHARACTERISTIC
/begin CHARACTERISTIC KLTKTOENIV "" CURVE 0x1b7ac _REC_CUR_52_UWORD_u2_u2 127.5 _CNV_R_R_tog_ub_q0p_527_CM 0. 127.5 FORMAT "%5.2"
 /begin AXIS_DESCR STD_AXIS Tog_tk _CNV_A_R_LINEAR_____528_CM 7 0. 6553.5 FORMAT "%6.1" /end AXIS_DESCR
/end CHARACTERISTIC
/begin CHARACTERISTIC KLTVTOEL "" CURVE 0x1b7ca _REC_CUR_52_u2_u2 208. _CNV_A_R_LINEAR_____529_CM -48. 160. FORMAT "%5.1"
 /begin AXIS_DESCR STD_AXIS Toel_t _CNV_A_R_LINEAR_____528_CM 7 0.1 6553.5 FORMAT "%7.2" /end AXIS_DESCR
/end CHARACTERISTIC
/begin MEASUREMENT B_oelverb "" UBYTE _CNV_S_2_B_TRUE_530_CM 1 100. 0. 1. DISPLAY_IDENTIFIER B_OELVERB ECU_ADDRESS 0x3faa69 /end MEASUREMENT
/begin MEASUREMENT nmotf "" UBYTE _CNV_R_R_nmot_ub_q4_524_CM 1 100. 0. 10200. DISPLAY_IDENTIFIER NMOTF ECU_ADDRESS 0x3faa70 FORMAT "%5.0" /end MEASUREMENT
/begin MEASUREMENT nmotfm "" UBYTE _CNV_R_R_nmot_ub_q4_524_CM 1 100. 0. 10200. DISPLAY_IDENTIFIER NMOTFM ECU_ADDRESS 0x3faa71 FORMAT "%6.1" /end MEASUREMENT
/begin MEASUREMENT nmotfsum "" UWORD _CNV_A_R_LINEAR_____531_CM 1 100. 0. 2621400. DISPLAY_IDENTIFIER NMOTFSUM ECU_ADDRESS 0x3faa6c BYTE_ORDER MSB_LAST FORMAT "%8.0" /end MEASUREMENT
/begin MEASUREMENT Oelnivak "" UBYTE _CNV_R_R_tog_ub_q0p_521_CM 1 100. 0. 127.5 DISPLAY_IDENTIFIER OELNIVAK ECU_ADDRESS 0x3fa444 FORMAT "%5.1" /end MEASUREMENT
/begin MEASUREMENT Oelnivaknk "" UBYTE _CNV_R_R_tog_ub_q0p_521_CM 1 100. 0. 127.5 DISPLAY_IDENTIFIER OELNIVAKNK ECU_ADDRESS 0x3faa72 FORMAT "%5.1" /end MEASUREMENT
/begin MEASUREMENT Oelnivnksm "" UWORD _CNV_R_R_tog_ub_q0p_521_CM 1 100. 0. 32767.5 DISPLAY_IDENTIFIER OELNIVNKSM ECU_ADDRESS 0x3faa6e BYTE_ORDER MSB_LAST FORMAT "%8.2" /end MEASUREMENT
/begin MEASUREMENT Oelnivnorm "" UBYTE _CNV_R_R_tog_ub_q0p_521_CM 1 100. 0. 127.5 DISPLAY_IDENTIFIER OELNIVNORM ECU_ADDRESS 0x3fa447 FORMAT "%5.1" /end MEASUREMENT
/begin MEASUREMENT Oelnivori "" UBYTE _CNV_R_R_tog_ub_q0p_521_CM 1 100. 0. 127.5 DISPLAY_IDENTIFIER OELNIVORI ECU_ADDRESS 0x3fa448 FORMAT "%5.1" /end MEASUREMENT
/begin MEASUREMENT Oelnivsum "" ULONG _CNV_A_R_LINEAR_____532_CM 1 100. 0. 2147483647.5 DISPLAY_IDENTIFIER OELNIVSUM ECU_ADDRESS 0x3fa43c BYTE_ORDER MSB_LAST FORMAT "%13.2" /end MEASUREMENT
/begin MEASUREMENT Oelnivsumw "" ULONG _CNV_A_R_LINEAR_____532_CM 1 100. 0. 2147483647.5 DISPLAY_IDENTIFIER OELNIVSUMW ECU_ADDRESS 0x3fa440 BYTE_ORDER MSB_LAST FORMAT "%13.2" /end MEASUREMENT
/begin MEASUREMENT Oriverzz "" UBYTE _CNV_R_R_dez_498_CM 1 100. 0. 255. DISPLAY_IDENTIFIER ORIVERZZ ECU_ADDRESS 0x3faa73 FORMAT "%5.1" /end MEASUREMENT
/begin MEASUREMENT Toel_t "" UWORD _CNV_R_R_t_q0p1ms_526_CM 1 100. 0. 6553.5 DISPLAY_IDENTIFIER TOEL_T ECU_ADDRESS 0x3fa438 BYTE_ORDER MSB_LAST FORMAT "%8.3" /end MEASUREMENT
/begin MEASUREMENT togbw_i "" UWORD _CNV_R_R_dez_498_CM 1 100. 0. 255. DISPLAY_IDENTIFIER TOGBW_I ECU_ADDRESS 0x3fa43a BYTE_ORDER MSB_LAST FORMAT "%8.4" /end MEASUREMENT
/begin MEASUREMENT togk_i "" UBYTE _CNV_R_R_dez_498_CM 1 100. 0. 255. DISPLAY_IDENTIFIER TOGK_I ECU_ADDRESS 0x3fa449 FORMAT "%5.1" /end MEASUREMENT
/begin MEASUREMENT tog_i "" UBYTE _CNV_R_R_dez_498_CM 1 100. 0. 255. DISPLAY_IDENTIFIER TOG_I ECU_ADDRESS 0x3faa74 FORMAT "%5.1" /end MEASUREMENT
/begin MEASUREMENT tog_k "" UBYTE _CNV_S_2_B_TRUE_530_CM 1 100. 0. 1. DISPLAY_IDENTIFIER TOG_K ECU_ADDRESS 0x3faa6b /end MEASUREMENT
/begin MEASUREMENT B_oelverl "" UBYTE _CNV_S_2_B_TRUE_530_CM 1 100. 0. 1. DISPLAY_IDENTIFIER B_OELVERL ECU_ADDRESS 0x3faa6a /end MEASUREMENT
/begin MEASUREMENT Oelnivkurz "" UBYTE _CNV_R_R_tog_ub_q0p_521_CM 1 100. 0. 127.5 DISPLAY_IDENTIFIER OELNIVKURZ ECU_ADDRESS 0x3fa445 FORMAT "%5.1" /end MEASUREMENT
/begin MEASUREMENT Oelnivm "" UBYTE _CNV_R_R_tog_ub_q0p_521_CM 1 100. 0. 127.5 DISPLAY_IDENTIFIER OELNIVM ECU_ADDRESS 0x3fa446 FORMAT "%5.1" /end MEASUREMENT
/begin MEASUREMENT lv_rng_l_req_mon2 "Activation condition for low-range-mode by process monitoring" UBYTE _CNV_S_2_RANGE______0_CM 1 100. 0. 1. DISPLAY_IDENTIFIER LV_RNG_L_REQ_MON2 ECU_ADDRESS 0x3fe6fb /end MEASUREMENT
/begin AXIS_PTS ldpm_n_32__tqi_min_pu "" 0x080b6 n_32 _REC_AXS_20_u1 8160. _CNV_A_R_LINEAR_____16_CM 12 0. 8160. DISPLAY_IDENTIFIER LDPM_N_32__TQI_MIN_PU FORMAT "%4.0" /end AXIS_PTS
/begin AXIS_PTS ldpm_tco__tqi_min_pu "" 0x013e6 tco _REC_AXS_20_u1 190.5 _CNV_A_R_LINEAR_____12_CM 4 -48. 142.5 DISPLAY_IDENTIFIER LDPM_TCO__TQI_MIN_PU FORMAT "%5.1" /end AXIS_PTS
/begin AXIS_PTS ldpm_n_32_s "" 0x08113 n_32 _REC_AXS_20_u1 8160. _CNV_A_R_LINEAR_____16_CM 16 0. 8160. DISPLAY_IDENTIFIER LDPM_N_32_S FORMAT "%4.0" /end AXIS_PTS
/begin CHARACTERISTIC ip_t_inc_tra_3_mt "Time constant for torque increase 3 for manual transmission" MAP 0x071c3 _REC_MAP_20_u1_u1_u1 2.55 _CNV_A_R_LINEAR_____4_CM 0. 2.55 DISPLAY_IDENTIFIER IP_T_INC_TRA_3_MT FORMAT "%4.2"
 /begin AXIS_DESCR COM_AXIS n_32 _CNV_A_R_LINEAR_____16_CM 8 0. 8160. FORMAT "%4.0" AXIS_PTS_REF ldpm_n_110 /end AXIS_DESCR
 /begin AXIS_DESCR COM_AXIS gr_mt _CNV_A_R_LINEAR_____1_CM 8 0. 255. FORMAT "%3.0" AXIS_PTS_REF ldpm_gr_tra_mt_2 /end AXIS_DESCR
/end CHARACTERISTIC
/begin CHARACTERISTIC ip_t_dec_tra_rng_l_3_at "Time constant for torque decrease 3 for automatic transmission" MAP 0x06fab _REC_MAP_20_u1_u1_u1 2.55 _CNV_A_R_LINEAR_____4_CM 0. 2.55 DISPLAY_IDENTIFIER IP_T_DEC_TRA_RNG_L_3_AT FORMAT "%3.2"
 /begin AXIS_DESCR COM_AXIS n_32 _CNV_A_R_LINEAR_____16_CM 8 0. 8160. FORMAT "%4.0" AXIS_PTS_REF ldpm_n_110 /end AXIS_DESCR
 /begin AXIS_DESCR COM_AXIS gr_at _CNV_A_R_LINEAR_____1_CM 7 0. 255. FORMAT "%3.0" AXIS_PTS_REF ldpm_gr_tra_at_2 /end AXIS_DESCR
/end CHARACTERISTIC
/begin CHARACTERISTIC ip_t_inc_tra_rng_l_3_mt "Time constant for torque increase 3 for manual transmission" MAP 0x073a3 _REC_MAP_20_u1_u1_u1 2.55 _CNV_A_R_LINEAR_____4_CM 0. 2.55 DISPLAY_IDENTIFIER IP_T_INC_TRA_RNG_L_3_MT FORMAT "%3.2"
 /begin AXIS_DESCR COM_AXIS n_32 _CNV_A_R_LINEAR_____16_CM 8 0. 8160. FORMAT "%4.0" AXIS_PTS_REF ldpm_n_110 /end AXIS_DESCR
 /begin AXIS_DESCR COM_AXIS gr_mt _CNV_A_R_LINEAR_____1_CM 8 0. 255. FORMAT "%3.0" AXIS_PTS_REF ldpm_gr_tra_mt_2 /end AXIS_DESCR
/end CHARACTERISTIC
/begin CHARACTERISTIC ip_t_dec_tra_2_mt "Time constant for torque decrease 2 for manual transmission" MAP 0x06d8b _REC_MAP_20_u1_u1_u1 2.55 _CNV_A_R_LINEAR_____4_CM 0. 2.55 DISPLAY_IDENTIFIER IP_T_DEC_TRA_2_MT FORMAT "%4.2"
 /begin AXIS_DESCR COM_AXIS n_32 _CNV_A_R_LINEAR_____16_CM 8 0. 8160. FORMAT "%4.0" AXIS_PTS_REF ldpm_n_110 /end AXIS_DESCR
 /begin AXIS_DESCR COM_AXIS gr_mt _CNV_A_R_LINEAR_____1_CM 8 0. 255. FORMAT "%3.0" AXIS_PTS_REF ldpm_gr_tra_mt_2 /end AXIS_DESCR
/end CHARACTERISTIC
/begin CHARACTERISTIC ip_t_inc_tra_is_mt "Time constant for torque increase at idle for manual transmission" MAP 0x0723b _REC_MAP_20_u1_u1_u1 2.55 _CNV_A_R_LINEAR_____4_CM 0. 2.55 DISPLAY_IDENTIFIER IP_T_INC_TRA_IS_MT FORMAT "%4.2"
 /begin AXIS_DESCR COM_AXIS n_32 _CNV_A_R_LINEAR_____16_CM 8 0. 8160. FORMAT "%4.0" AXIS_PTS_REF ldpm_n_110 /end AXIS_DESCR
 /begin AXIS_DESCR COM_AXIS gr_mt _CNV_A_R_LINEAR_____1_CM 8 0. 255. FORMAT "%3.0" AXIS_PTS_REF ldpm_gr_tra_mt_2 /end AXIS_DESCR
/end CHARACTERISTIC
/begin CHARACTERISTIC ip_t_dec_tra_3_mt "Time constant for torque decrease 3 for manual transmission" MAP 0x06e03 _REC_MAP_20_u1_u1_u1 2.55 _CNV_A_R_LINEAR_____4_CM 0. 2.55 DISPLAY_IDENTIFIER IP_T_DEC_TRA_3_MT FORMAT "%4.2"
 /begin AXIS_DESCR COM_AXIS n_32 _CNV_A_R_LINEAR_____16_CM 8 0. 8160. FORMAT "%4.0" AXIS_PTS_REF ldpm_n_110 /end AXIS_DESCR
 /begin AXIS_DESCR COM_AXIS gr_mt _CNV_A_R_LINEAR_____1_CM 8 0. 255. FORMAT "%3.0" AXIS_PTS_REF ldpm_gr_tra_mt_2 /end AXIS_DESCR
/end CHARACTERISTIC
/begin CHARACTERISTIC ip_t_dec_tra_rng_l_3_mt "Time constant for torque decrease 3 for manual transmission" MAP 0x06fe3 _REC_MAP_20_u1_u1_u1 2.55 _CNV_A_R_LINEAR_____4_CM 0. 2.55 DISPLAY_IDENTIFIER IP_T_DEC_TRA_RNG_L_3_MT FORMAT "%3.2"
 /begin AXIS_DESCR COM_AXIS n_32 _CNV_A_R_LINEAR_____16_CM 8 0. 8160. FORMAT "%4.0" AXIS_PTS_REF ldpm_n_110 /end AXIS_DESCR
 /begin AXIS_DESCR COM_AXIS gr_mt _CNV_A_R_LINEAR_____1_CM 8 0. 255. FORMAT "%3.0" AXIS_PTS_REF ldpm_gr_tra_mt_2 /end AXIS_DESCR
/end CHARACTERISTIC
/begin CHARACTERISTIC ip_t_inc_tra_rng_l_is_at "Time constant for torque increase at idle for automatic transmission" MAP 0x073e3 _REC_MAP_20_u1_u1_u1 2.55 _CNV_A_R_LINEAR_____4_CM 0. 2.55 DISPLAY_IDENTIFIER IP_T_INC_TRA_RNG_L_IS_AT FORMAT "%3.2"
 /begin AXIS_DESCR COM_AXIS n_32 _CNV_A_R_LINEAR_____16_CM 8 0. 8160. FORMAT "%4.0" AXIS_PTS_REF ldpm_n_110 /end AXIS_DESCR
 /begin AXIS_DESCR COM_AXIS gr_at _CNV_A_R_LINEAR_____1_CM 7 0. 255. FORMAT "%3.0" AXIS_PTS_REF ldpm_gr_tra_at_2 /end AXIS_DESCR
/end CHARACTERISTIC
/begin CHARACTERISTIC ip_t_dec_tra_is_mt "Time constant for torque decrease at idle for manual transmission" MAP 0x06e7b _REC_MAP_20_u1_u1_u1 2.55 _CNV_A_R_LINEAR_____4_CM 0. 2.55 DISPLAY_IDENTIFIER IP_T_DEC_TRA_IS_MT FORMAT "%4.2"
 /begin AXIS_DESCR COM_AXIS n_32 _CNV_A_R_LINEAR_____16_CM 8 0. 8160. FORMAT "%4.0" AXIS_PTS_REF ldpm_n_110 /end AXIS_DESCR
 /begin AXIS_DESCR COM_AXIS gr_mt _CNV_A_R_LINEAR_____1_CM 8 0. 255. FORMAT "%3.0" AXIS_PTS_REF ldpm_gr_tra_mt_2 /end AXIS_DESCR
/end CHARACTERISTIC
/begin CHARACTERISTIC ip_t_dec_tra_rng_l_is_at "Time constant for torque decrease at idle for automatic transmission" MAP 0x07023 _REC_MAP_20_u1_u1_u1 2.55 _CNV_A_R_LINEAR_____4_CM 0. 2.55 DISPLAY_IDENTIFIER IP_T_DEC_TRA_RNG_L_IS_AT FORMAT "%3.2"
 /begin AXIS_DESCR COM_AXIS n_32 _CNV_A_R_LINEAR_____16_CM 8 0. 8160. FORMAT "%4.0" AXIS_PTS_REF ldpm_n_110 /end AXIS_DESCR
 /begin AXIS_DESCR COM_AXIS gr_at _CNV_A_R_LINEAR_____1_CM 7 0. 255. FORMAT "%3.0" AXIS_PTS_REF ldpm_gr_tra_at_2 /end AXIS_DESCR
/end CHARACTERISTIC
/begin CHARACTERISTIC ip_t_inc_tra_1_at "Time constant for torque increase 1 for automatic transmission" MAP 0x0709b _REC_MAP_20_u1_u1_u1 2.55 _CNV_A_R_LINEAR_____4_CM 0. 2.55 DISPLAY_IDENTIFIER IP_T_INC_TRA_1_AT FORMAT "%4.2"
 /begin AXIS_DESCR COM_AXIS n_32 _CNV_A_R_LINEAR_____16_CM 8 0. 8160. FORMAT "%4.0" AXIS_PTS_REF ldpm_n_110 /end AXIS_DESCR
 /begin AXIS_DESCR COM_AXIS gr_at _CNV_A_R_LINEAR_____1_CM 7 0. 255. FORMAT "%3.0" AXIS_PTS_REF ldpm_gr_tra_at_2 /end AXIS_DESCR
/end CHARACTERISTIC
/begin CHARACTERISTIC ip_t_inc_tra_rng_l_is_mt "Time constant for torque increase at idle for manual transmission" MAP 0x0741b _REC_MAP_20_u1_u1_u1 2.55 _CNV_A_R_LINEAR_____4_CM 0. 2.55 DISPLAY_IDENTIFIER IP_T_INC_TRA_RNG_L_IS_MT FORMAT "%3.2"
 /begin AXIS_DESCR COM_AXIS n_32 _CNV_A_R_LINEAR_____16_CM 8 0. 8160. FORMAT "%4.0" AXIS_PTS_REF ldpm_n_110 /end AXIS_DESCR
 /begin AXIS_DESCR COM_AXIS gr_mt _CNV_A_R_LINEAR_____1_CM 8 0. 255. FORMAT "%3.0" AXIS_PTS_REF ldpm_gr_tra_mt_2 /end AXIS_DESCR
/end CHARACTERISTIC
/begin CHARACTERISTIC ip_t_inc_tra_2_at "Time constant for torque increase 2 for automatic transmission" MAP 0x07113 _REC_MAP_20_u1_u1_u1 2.55 _CNV_A_R_LINEAR_____4_CM 0. 2.55 DISPLAY_IDENTIFIER IP_T_INC_TRA_2_AT FORMAT "%4.2"
 /begin AXIS_DESCR COM_AXIS n_32 _CNV_A_R_LINEAR_____16_CM 8 0. 8160. FORMAT "%4.0" AXIS_PTS_REF ldpm_n_110 /end AXIS_DESCR
 /begin AXIS_DESCR COM_AXIS gr_at _CNV_A_R_LINEAR_____1_CM 7 0. 255. FORMAT "%3.0" AXIS_PTS_REF ldpm_gr_tra_at_2 /end AXIS_DESCR
/end CHARACTERISTIC
/begin CHARACTERISTIC ip_t_dec_tra_rng_l_is_mt "Time constant for torque decrease at idle for manual transmission" MAP 0x0705b _REC_MAP_20_u1_u1_u1 2.55 _CNV_A_R_LINEAR_____4_CM 0. 2.55 DISPLAY_IDENTIFIER IP_T_DEC_TRA_RNG_L_IS_MT FORMAT "%3.2"
 /begin AXIS_DESCR COM_AXIS n_32 _CNV_A_R_LINEAR_____16_CM 8 0. 8160. FORMAT "%4.0" AXIS_PTS_REF ldpm_n_110 /end AXIS_DESCR
 /begin AXIS_DESCR COM_AXIS gr_mt _CNV_A_R_LINEAR_____1_CM 8 0. 255. FORMAT "%3.0" AXIS_PTS_REF ldpm_gr_tra_mt_2 /end AXIS_DESCR
/end CHARACTERISTIC
/begin CHARACTERISTIC ip_t_inc_tra_3_at "Time constant for torque increase 3 for automatic transmission" MAP 0x0718b _REC_MAP_20_u1_u1_u1 2.55 _CNV_A_R_LINEAR_____4_CM 0. 2.55 DISPLAY_IDENTIFIER IP_T_INC_TRA_3_AT FORMAT "%4.2"
 /begin AXIS_DESCR COM_AXIS n_32 _CNV_A_R_LINEAR_____16_CM 8 0. 8160. FORMAT "%4.0" AXIS_PTS_REF ldpm_n_110 /end AXIS_DESCR
 /begin AXIS_DESCR COM_AXIS gr_at _CNV_A_R_LINEAR_____1_CM 7 0. 255. FORMAT "%3.0" AXIS_PTS_REF ldpm_gr_tra_at_2 /end AXIS_DESCR
/end CHARACTERISTIC
/begin CHARACTERISTIC ip_t_dec_tra_1_at "Time constant for torquedecrease 1 for automatic transmission" MAP 0x06cdb _REC_MAP_20_u1_u1_u1 2.55 _CNV_A_R_LINEAR_____4_CM 0. 2.55 DISPLAY_IDENTIFIER IP_T_DEC_TRA_1_AT FORMAT "%4.2"
 /begin AXIS_DESCR COM_AXIS n_32 _CNV_A_R_LINEAR_____16_CM 8 0. 8160. FORMAT "%4.0" AXIS_PTS_REF ldpm_n_110 /end AXIS_DESCR
 /begin AXIS_DESCR COM_AXIS gr_at _CNV_A_R_LINEAR_____1_CM 7 0. 255. FORMAT "%3.0" AXIS_PTS_REF ldpm_gr_tra_at_2 /end AXIS_DESCR
/end CHARACTERISTIC
/begin CHARACTERISTIC ip_t_dec_tra_2_at "Time constant for torquedecrease 2 for automatic transmission" MAP 0x06d53 _REC_MAP_20_u1_u1_u1 2.55 _CNV_A_R_LINEAR_____4_CM 0. 2.55 DISPLAY_IDENTIFIER IP_T_DEC_TRA_2_AT FORMAT "%4.2"
 /begin AXIS_DESCR COM_AXIS n_32 _CNV_A_R_LINEAR_____16_CM 8 0. 8160. FORMAT "%4.0" AXIS_PTS_REF ldpm_n_110 /end AXIS_DESCR
 /begin AXIS_DESCR COM_AXIS gr_at _CNV_A_R_LINEAR_____1_CM 7 0. 255. FORMAT "%3.0" AXIS_PTS_REF ldpm_gr_tra_at_2 /end AXIS_DESCR
/end CHARACTERISTIC
/begin CHARACTERISTIC ip_t_inc_tra_rng_l_1_at "Time constant for torque increase 1 for automatic transmission" MAP 0x0727b _REC_MAP_20_u1_u1_u1 2.55 _CNV_A_R_LINEAR_____4_CM 0. 2.55 DISPLAY_IDENTIFIER IP_T_INC_TRA_RNG_L_1_AT FORMAT "%3.2"
 /begin AXIS_DESCR COM_AXIS n_32 _CNV_A_R_LINEAR_____16_CM 8 0. 8160. FORMAT "%4.0" AXIS_PTS_REF ldpm_n_110 /end AXIS_DESCR
 /begin AXIS_DESCR COM_AXIS gr_at _CNV_A_R_LINEAR_____1_CM 7 0. 255. FORMAT "%3.0" AXIS_PTS_REF ldpm_gr_tra_at_2 /end AXIS_DESCR
/end CHARACTERISTIC
/begin CHARACTERISTIC ip_t_dec_tra_3_at "Time constant for torquedecrease 3 for automatic transmission" MAP 0x06dcb _REC_MAP_20_u1_u1_u1 2.55 _CNV_A_R_LINEAR_____4_CM 0. 2.55 DISPLAY_IDENTIFIER IP_T_DEC_TRA_3_AT FORMAT "%4.2"
 /begin AXIS_DESCR COM_AXIS n_32 _CNV_A_R_LINEAR_____16_CM 8 0. 8160. FORMAT "%4.0" AXIS_PTS_REF ldpm_n_110 /end AXIS_DESCR
 /begin AXIS_DESCR COM_AXIS gr_at _CNV_A_R_LINEAR_____1_CM 7 0. 255. FORMAT "%3.0" AXIS_PTS_REF ldpm_gr_tra_at_2 /end AXIS_DESCR
/end CHARACTERISTIC
/begin CHARACTERISTIC ip_t_dec_tra_rng_l_1_at "Time constant for torque decrease 1 for automatic transmission" MAP 0x06ebb _REC_MAP_20_u1_u1_u1 2.55 _CNV_A_R_LINEAR_____4_CM 0. 2.55 DISPLAY_IDENTIFIER IP_T_DEC_TRA_RNG_L_1_AT FORMAT "%3.2"
 /begin AXIS_DESCR COM_AXIS n_32 _CNV_A_R_LINEAR_____16_CM 8 0. 8160. FORMAT "%4.0" AXIS_PTS_REF ldpm_n_110 /end AXIS_DESCR
 /begin AXIS_DESCR COM_AXIS gr_at _CNV_A_R_LINEAR_____1_CM 7 0. 255. FORMAT "%3.0" AXIS_PTS_REF ldpm_gr_tra_at_2 /end AXIS_DESCR
/end CHARACTERISTIC
/begin CHARACTERISTIC ip_t_dec_tra_is_at "Time constant for torque decrease at idle for automatic transmission" MAP 0x06e43 _REC_MAP_20_u1_u1_u1 2.55 _CNV_A_R_LINEAR_____4_CM 0. 2.55 DISPLAY_IDENTIFIER IP_T_DEC_TRA_IS_AT FORMAT "%4.2"
 /begin AXIS_DESCR COM_AXIS n_32 _CNV_A_R_LINEAR_____16_CM 8 0. 8160. FORMAT "%4.0" AXIS_PTS_REF ldpm_n_110 /end AXIS_DESCR
 /begin AXIS_DESCR COM_AXIS gr_at _CNV_A_R_LINEAR_____1_CM 7 0. 255. FORMAT "%3.0" AXIS_PTS_REF ldpm_gr_tra_at_2 /end AXIS_DESCR
/end CHARACTERISTIC
/begin CHARACTERISTIC ip_t_inc_tra_rng_l_1_mt "Time constant for torque increase 1 for manual transmission" MAP 0x072b3 _REC_MAP_20_u1_u1_u1 2.55 _CNV_A_R_LINEAR_____4_CM 0. 2.55 DISPLAY_IDENTIFIER IP_T_INC_TRA_RNG_L_1_MT FORMAT "%3.2"
 /begin AXIS_DESCR COM_AXIS n_32 _CNV_A_R_LINEAR_____16_CM 8 0. 8160. FORMAT "%4.0" AXIS_PTS_REF ldpm_n_110 /end AXIS_DESCR
 /begin AXIS_DESCR COM_AXIS gr_mt _CNV_A_R_LINEAR_____1_CM 8 0. 255. FORMAT "%3.0" AXIS_PTS_REF ldpm_gr_tra_mt_2 /end AXIS_DESCR
/end CHARACTERISTIC
/begin CHARACTERISTIC ip_t_inc_tra_is_at "Time constant for torque increase at idle for automatic transmission" MAP 0x07203 _REC_MAP_20_u1_u1_u1 2.55 _CNV_A_R_LINEAR_____4_CM 0. 2.55 DISPLAY_IDENTIFIER IP_T_INC_TRA_IS_AT FORMAT "%4.2"
 /begin AXIS_DESCR COM_AXIS n_32 _CNV_A_R_LINEAR_____16_CM 8 0. 8160. FORMAT "%4.0" AXIS_PTS_REF ldpm_n_110 /end AXIS_DESCR
 /begin AXIS_DESCR COM_AXIS gr_at _CNV_A_R_LINEAR_____1_CM 7 0. 255. FORMAT "%3.0" AXIS_PTS_REF ldpm_gr_tra_at_2 /end AXIS_DESCR
/end CHARACTERISTIC
/begin CHARACTERISTIC ip_t_dec_tra_rng_l_1_mt "Time constant for torque decrease 1 for manual transmission" MAP 0x06ef3 _REC_MAP_20_u1_u1_u1 2.55 _CNV_A_R_LINEAR_____4_CM 0. 2.55 DISPLAY_IDENTIFIER IP_T_DEC_TRA_RNG_L_1_MT FORMAT "%3.2"
 /begin AXIS_DESCR COM_AXIS n_32 _CNV_A_R_LINEAR_____16_CM 8 0. 8160. FORMAT "%4.0" AXIS_PTS_REF ldpm_n_110 /end AXIS_DESCR
 /begin AXIS_DESCR COM_AXIS gr_mt _CNV_A_R_LINEAR_____1_CM 8 0. 255. FORMAT "%3.0" AXIS_PTS_REF ldpm_gr_tra_mt_2 /end AXIS_DESCR
/end CHARACTERISTIC
/begin CHARACTERISTIC ip_t_inc_tra_rng_l_2_at "Time constant for torque increase 2 for automatic transmission" MAP 0x072f3 _REC_MAP_20_u1_u1_u1 2.55 _CNV_A_R_LINEAR_____4_CM 0. 2.55 DISPLAY_IDENTIFIER IP_T_INC_TRA_RNG_L_2_AT FORMAT "%3.2"
 /begin AXIS_DESCR COM_AXIS n_32 _CNV_A_R_LINEAR_____16_CM 8 0. 8160. FORMAT "%4.0" AXIS_PTS_REF ldpm_n_110 /end AXIS_DESCR
 /begin AXIS_DESCR COM_AXIS gr_at _CNV_A_R_LINEAR_____1_CM 7 0. 255. FORMAT "%3.0" AXIS_PTS_REF ldpm_gr_tra_at_2 /end AXIS_DESCR
/end CHARACTERISTIC
/begin CHARACTERISTIC ip_t_dec_tra_rng_l_2_at "Time constant for torque decrease 2 for automatic transmission" MAP 0x06f33 _REC_MAP_20_u1_u1_u1 2.55 _CNV_A_R_LINEAR_____4_CM 0. 2.55 DISPLAY_IDENTIFIER IP_T_DEC_TRA_RNG_L_2_AT FORMAT "%3.2"
 /begin AXIS_DESCR COM_AXIS n_32 _CNV_A_R_LINEAR_____16_CM 8 0. 8160. FORMAT "%4.0" AXIS_PTS_REF ldpm_n_110 /end AXIS_DESCR
 /begin AXIS_DESCR COM_AXIS gr_at _CNV_A_R_LINEAR_____1_CM 7 0. 255. FORMAT "%3.0" AXIS_PTS_REF ldpm_gr_tra_at_2 /end AXIS_DESCR
/end CHARACTERISTIC
/begin CHARACTERISTIC ip_t_inc_tra_rng_l_2_mt "Time constant for torque increase 2 for manual transmission" MAP 0x0732b _REC_MAP_20_u1_u1_u1 2.55 _CNV_A_R_LINEAR_____4_CM 0. 2.55 DISPLAY_IDENTIFIER IP_T_INC_TRA_RNG_L_2_MT FORMAT "%3.2"
 /begin AXIS_DESCR COM_AXIS n_32 _CNV_A_R_LINEAR_____16_CM 8 0. 8160. FORMAT "%4.0" AXIS_PTS_REF ldpm_n_110 /end AXIS_DESCR
 /begin AXIS_DESCR COM_AXIS gr_mt _CNV_A_R_LINEAR_____1_CM 8 0. 255. FORMAT "%3.0" AXIS_PTS_REF ldpm_gr_tra_mt_2 /end AXIS_DESCR
/end CHARACTERISTIC
/begin CHARACTERISTIC ip_t_inc_tra_1_mt "Time constant for torque increase 1 for manual transmission" MAP 0x070d3 _REC_MAP_20_u1_u1_u1 2.55 _CNV_A_R_LINEAR_____4_CM 0. 2.55 DISPLAY_IDENTIFIER IP_T_INC_TRA_1_MT FORMAT "%4.2"
 /begin AXIS_DESCR COM_AXIS n_32 _CNV_A_R_LINEAR_____16_CM 8 0. 8160. FORMAT "%4.0" AXIS_PTS_REF ldpm_n_110 /end AXIS_DESCR
 /begin AXIS_DESCR COM_AXIS gr_mt _CNV_A_R_LINEAR_____1_CM 8 0. 255. FORMAT "%3.0" AXIS_PTS_REF ldpm_gr_tra_mt_2 /end AXIS_DESCR
/end CHARACTERISTIC
/begin CHARACTERISTIC ip_t_dec_tra_rng_l_2_mt "Time constant for torque decrease 2 for manual transmission" MAP 0x06f6b _REC_MAP_20_u1_u1_u1 2.55 _CNV_A_R_LINEAR_____4_CM 0. 2.55 DISPLAY_IDENTIFIER IP_T_DEC_TRA_RNG_L_2_MT FORMAT "%3.2"
 /begin AXIS_DESCR COM_AXIS n_32 _CNV_A_R_LINEAR_____16_CM 8 0. 8160. FORMAT "%4.0" AXIS_PTS_REF ldpm_n_110 /end AXIS_DESCR
 /begin AXIS_DESCR COM_AXIS gr_mt _CNV_A_R_LINEAR_____1_CM 8 0. 255. FORMAT "%3.0" AXIS_PTS_REF ldpm_gr_tra_mt_2 /end AXIS_DESCR
/end CHARACTERISTIC
/begin CHARACTERISTIC ip_t_inc_tra_2_mt "Time constant for torque increase 2 for manual transmission" MAP 0x0714b _REC_MAP_20_u1_u1_u1 2.55 _CNV_A_R_LINEAR_____4_CM 0. 2.55 DISPLAY_IDENTIFIER IP_T_INC_TRA_2_MT FORMAT "%4.2"
 /begin AXIS_DESCR COM_AXIS n_32 _CNV_A_R_LINEAR_____16_CM 8 0. 8160. FORMAT "%4.0" AXIS_PTS_REF ldpm_n_110 /end AXIS_DESCR
 /begin AXIS_DESCR COM_AXIS gr_mt _CNV_A_R_LINEAR_____1_CM 8 0. 255. FORMAT "%3.0" AXIS_PTS_REF ldpm_gr_tra_mt_2 /end AXIS_DESCR
/end CHARACTERISTIC
/begin CHARACTERISTIC ip_t_inc_tra_rng_l_3_at "Time constant for torque increase 3 for automatic transmission" MAP 0x0736b _REC_MAP_20_u1_u1_u1 2.55 _CNV_A_R_LINEAR_____4_CM 0. 2.55 DISPLAY_IDENTIFIER IP_T_INC_TRA_RNG_L_3_AT FORMAT "%3.2"
 /begin AXIS_DESCR COM_AXIS n_32 _CNV_A_R_LINEAR_____16_CM 8 0. 8160. FORMAT "%4.0" AXIS_PTS_REF ldpm_n_110 /end AXIS_DESCR
 /begin AXIS_DESCR COM_AXIS gr_at _CNV_A_R_LINEAR_____1_CM 7 0. 255. FORMAT "%3.0" AXIS_PTS_REF ldpm_gr_tra_at_2 /end AXIS_DESCR
/end CHARACTERISTIC
/begin CHARACTERISTIC ip_t_dec_tra_1_mt "Time constant for torque decrease 1 for manual transmission" MAP 0x06d13 _REC_MAP_20_u1_u1_u1 2.55 _CNV_A_R_LINEAR_____4_CM 0. 2.55 DISPLAY_IDENTIFIER IP_T_DEC_TRA_1_MT FORMAT "%4.2"
 /begin AXIS_DESCR COM_AXIS n_32 _CNV_A_R_LINEAR_____16_CM 8 0. 8160. FORMAT "%4.0" AXIS_PTS_REF ldpm_n_110 /end AXIS_DESCR
 /begin AXIS_DESCR COM_AXIS gr_mt _CNV_A_R_LINEAR_____1_CM 8 0. 255. FORMAT "%3.0" AXIS_PTS_REF ldpm_gr_tra_mt_2 /end AXIS_DESCR
/end CHARACTERISTIC
/begin CHARACTERISTIC ip_t_ramp_conv_neg__toil "Ramp after shift disengaging" CURVE 0x00e25 _REC_CUR_20_u1_u1 2550. _CNV_A_R_LINEAR_____31_CM 0. 2550. DISPLAY_IDENTIFIER IP_T_RAMP_CONV_NEG__TOIL FORMAT "%4.0"
 /begin AXIS_DESCR COM_AXIS toil _CNV_A_R_LINEAR_____15_CM 8 -40. 160. FORMAT "%3.0" AXIS_PTS_REF ldp_toil_t_ramp_conv_neg /end AXIS_DESCR
/end CHARACTERISTIC
/begin CHARACTERISTIC ip_t_ramp_conv_pos__toil "Ramp after shift engaging" CURVE 0x00e2d _REC_CUR_20_u1_u1 2550. _CNV_A_R_LINEAR_____31_CM 0. 2550. DISPLAY_IDENTIFIER IP_T_RAMP_CONV_POS__TOIL FORMAT "%4.0"
 /begin AXIS_DESCR COM_AXIS toil _CNV_A_R_LINEAR_____15_CM 8 -40. 160. FORMAT "%3.0" AXIS_PTS_REF ldp_toil_t_ramp_conv_pos /end AXIS_DESCR
/end CHARACTERISTIC
/begin AXIS_PTS ldpm_n_110 "" 0x07fd9 n_32 _REC_AXS_20_u1 8160. _CNV_A_R_LINEAR_____16_CM 8 0. 8160. DISPLAY_IDENTIFIER LDPM_N_110 FORMAT "%4.0" /end AXIS_PTS
/begin AXIS_PTS ldpm_gr_tra_at_2 "" 0x012eb gr_at _REC_AXS_20_u1 255. _CNV_A_R_LINEAR_____1_CM 7 0. 255. DISPLAY_IDENTIFIER LDPM_GR_TRA_AT_2 FORMAT "%3.0" /end AXIS_PTS
/begin AXIS_PTS ldpm_gr_tra_mt_2 "" 0x07f8d gr_mt _REC_AXS_20_u1 255. _CNV_A_R_LINEAR_____1_CM 8 0. 255. DISPLAY_IDENTIFIER LDPM_GR_TRA_MT_2 FORMAT "%3.0" /end AXIS_PTS
/begin AXIS_PTS ldp_toil_t_ramp_conv_pos "" 0x07e8c toil _REC_AXS_20_u1 200. _CNV_A_R_LINEAR_____15_CM 8 -40. 160. DISPLAY_IDENTIFIER LDP_TOIL_T_RAMP_CONV_POS FORMAT "%3.0" /end AXIS_PTS
/begin AXIS_PTS ldp_toil_t_ramp_conv_neg "" 0x07e83 toil _REC_AXS_20_u1 200. _CNV_A_R_LINEAR_____15_CM 8 -40. 160. DISPLAY_IDENTIFIER LDP_TOIL_T_RAMP_CONV_NEG FORMAT "%3.0" /end AXIS_PTS
/begin MEASUREMENT tq_add_pl_drof "TQ reserve for drive off support" UWORD _CNV_A_R_LINEAR_____55_CM 1 100. 0. 1023.96875 DISPLAY_IDENTIFIER TQ_ADD_PL_DROF ECU_ADDRESS 0x3fd414 BYTE_ORDER MSB_LAST FORMAT "%7.2" /end MEASUREMENT
/begin MEASUREMENT n_dif_pred_pl_drof "Predicted idle speed control variable at drive-off-support" SWORD _CNV_A_R_LINEAR_____11_CM 1 100. -32768. 32767. DISPLAY_IDENTIFIER N_DIF_PRED_PL_DROF ECU_ADDRESS 0x3fd416 BYTE_ORDER MSB_LAST FORMAT "%6.0" /end MEASUREMENT
/begin MEASUREMENT lv_fast_load_im "Fast Manifold Filling enabled" UBYTE _CNV_S_2_RANGE______0_CM 1 100. 0. 1. DISPLAY_IDENTIFIER LV_FAST_LOAD_IM ECU_ADDRESS 0x3fe243 /end MEASUREMENT
/begin CHARACTERISTIC ip_t_n_dif_ofs_pred_drof "Time constant for calculation of predicted engine speed deviation at drive-off-support (PL)" CURVE 0x00e1d _REC_CUR_20_u1_u2 7.96875 _CNV_A_R_LINEAR_____217_CM 0. 7.96875 DISPLAY_IDENTIFIER IP_T_N_DIF_OFS_PRED_DROF FORMAT "%4.2"
 /begin AXIS_DESCR COM_AXIS n _CNV_A_R_LINEAR_____11_CM 8 0. 8160. FORMAT "%4.0" AXIS_PTS_REF ldpm_n_t_n_dif_ofs_pred /end AXIS_DESCR
/end CHARACTERISTIC
/begin AXIS_PTS ldpm_n_dif_pred_fac_tq_add_is "" 0x119b6 n_dif_pred_pl_drof _REC_AXS_20_u2 65535. _CNV_A_R_LINEAR_____206_CM 8 -32768. 32767. DISPLAY_IDENTIFIER LDPM_N_DIF_PRED_FAC_TQ_ADD_IS FORMAT "%6.0" /end AXIS_PTS
/begin AXIS_PTS ldpm_n_t_n_dif_ofs_pred "" 0x11a0a n _REC_AXS_20_u2 8160. _CNV_A_R_LINEAR_____11_CM 8 0. 8160. DISPLAY_IDENTIFIER LDPM_N_T_N_DIF_OFS_PRED FORMAT "%4.0" /end AXIS_PTS
/begin AXIS_PTS ldpm_fac_tq_req_drof "" 0x11664 fac_tq_req _REC_AXS_20_u2 1.99996948 _CNV_A_R_LINEAR_____21_CM 6 0. 1.99996948 DISPLAY_IDENTIFIER LDPM_FAC_TQ_REQ_DROF FORMAT "%7.5" /end AXIS_PTS
/begin CHARACTERISTIC ip_tq_add_pl_drof "Torque reserve at part load for drive off support" MAP 0x0f9ee _REC_MAP_20_u2_u2_u2 1023.96875 _CNV_A_R_LINEAR_____55_CM 0. 1023.96875 DISPLAY_IDENTIFIER IP_TQ_ADD_PL_DROF FORMAT "%7.2"
 /begin AXIS_DESCR COM_AXIS n_dif_pred_pl_drof _CNV_A_R_LINEAR_____206_CM 8 -32768. 32767. FORMAT "%6.0" AXIS_PTS_REF ldpm_n_dif_pred_fac_tq_add_is /end AXIS_DESCR
 /begin AXIS_DESCR COM_AXIS fac_tq_req _CNV_A_R_LINEAR_____21_CM 6 0. 1.99996948 FORMAT "%7.5" AXIS_PTS_REF ldpm_fac_tq_req_drof /end AXIS_DESCR
/end CHARACTERISTIC
/begin CHARACTERISTIC ip_fac_tq_req_fast_load_im "Factor for TQI_SP_MAF_1-difference for trigger of Fast Manifold Filling" CURVE 0x00bfc _REC_CUR_20_u1_u2 1.9921875 _CNV_A_R_LINEAR_____115_CM 0. 1.9921875 DISPLAY_IDENTIFIER IP_FAC_TQ_REQ_FAST_LOAD_IM FORMAT "%5.3"
 /begin AXIS_DESCR COM_AXIS fac_tq_req _CNV_A_R_LINEAR_____21_CM 6 0. 1.99996948 FORMAT "%7.5" AXIS_PTS_REF ldpm_fac_tq_req_drof /end AXIS_DESCR
/end CHARACTERISTIC
/begin CHARACTERISTIC c_gear_max_fast_load_im "Highest gear for Fast Manifold Filling" VALUE 0x006ee _REC_VAL_20_u1 255. _CNV_A_R_LINEAR_____1_CM 0. 255. DISPLAY_IDENTIFIER C_GEAR_MAX_FAST_LOAD_IM FORMAT "%3.0" /end CHARACTERISTIC
/begin CHARACTERISTIC c_vs_max_fast_load_im "Highest vehicle speed  for Fast Manifold Filling" VALUE 0x0094f _REC_VAL_20_u1 255. _CNV_A_R_LINEAR_____23_CM 0. 255. DISPLAY_IDENTIFIER C_VS_MAX_FAST_LOAD_IM FORMAT "%3.0" /end CHARACTERISTIC
/begin CHARACTERISTIC c_n_max_fast_load_im "Highest engine speed  for Fast Manifold Filling" VALUE 0x016f8 _REC_VAL_20_u2 8160. _CNV_A_R_LINEAR_____11_CM 0. 8160. DISPLAY_IDENTIFIER C_N_MAX_FAST_LOAD_IM FORMAT "%4.0" /end CHARACTERISTIC
/begin CHARACTERISTIC c_n_max_fast_load_im_dt_1 "Max. engine speed for request of Fast Manifold Filling due to AFS when drive train is engaged" VALUE 0x016fc _REC_VAL_20_u2 8160. _CNV_A_R_LINEAR_____11_CM 0. 8160. DISPLAY_IDENTIFIER C_N_MAX_FAST_LOAD_IM_DT_1 FORMAT "%4.0" /end CHARACTERISTIC
/begin CHARACTERISTIC c_n_max_fast_load_im_dt_0 "Max. engine speed for request of Fast Manifold Filling due to AFS when drive train is not engaged" VALUE 0x016fa _REC_VAL_20_u2 8160. _CNV_A_R_LINEAR_____11_CM 0. 8160. DISPLAY_IDENTIFIER C_N_MAX_FAST_LOAD_IM_DT_0 FORMAT "%4.0" /end CHARACTERISTIC
/begin CHARACTERISTIC c_t_ast_min_fast_load_im "Minimum time after start before enabling Fast Manifold Filling" VALUE 0x017ba _REC_VAL_20_u2 6553.5 _CNV_A_R_LINEAR_____24_CM 0. 6553.5 DISPLAY_IDENTIFIER C_T_AST_MIN_FAST_LOAD_IM FORMAT "%6.1" /end CHARACTERISTIC
/begin CHARACTERISTIC lc_fast_load_im_is "0: Fast Manifold Filling possible only during 'idle'" VALUE 0x00f24 _REC_VAL_20_u1 1. _CNV_A_R_LINEAR_____1_CM 0. 1. DISPLAY_IDENTIFIER LC_FAST_LOAD_IM_IS FORMAT "%2.0" /end CHARACTERISTIC
/begin CHARACTERISTIC lc_ena_fast_load_im "1: Fast Manifold Filling is always requested" VALUE 0x00f17 _REC_VAL_20_u1 1. _CNV_A_R_LINEAR_____1_CM 0. 1. DISPLAY_IDENTIFIER LC_ENA_FAST_LOAD_IM FORMAT "%2.0" /end CHARACTERISTIC
/begin CHARACTERISTIC lc_ena_fast_load_im_n_sp "1: Fast Manifold Filling can be requested by LV_N_SP_IS_CS = 1" VALUE 0x00f18 _REC_VAL_20_u1 1. _CNV_A_R_LINEAR_____1_CM 0. 1. DISPLAY_IDENTIFIER LC_ENA_FAST_LOAD_IM_N_SP FORMAT "%2.0" /end CHARACTERISTIC
/begin CHARACTERISTIC c_tqi_dif_fast_load_min_pos "Trigger threshold for Fast Manifold Filling, positive load change" VALUE 0x004ba _REC_VAL_20_s2 2047.96875 _CNV_A_R_LINEAR_____55_CM -1024. 1023.96875 DISPLAY_IDENTIFIER C_TQI_DIF_FAST_LOAD_MIN_POS FORMAT "%8.2" /end CHARACTERISTIC
/begin CHARACTERISTIC c_tqi_dif_fast_load_min_neg "Trigger threshold for Fast Manifold Filling, negative load change" VALUE 0x004b8 _REC_VAL_20_s2 2047.96875 _CNV_A_R_LINEAR_____55_CM -1024. 1023.96875 DISPLAY_IDENTIFIER C_TQI_DIF_FAST_LOAD_MIN_NEG FORMAT "%8.2" /end CHARACTERISTIC
/begin CHARACTERISTIC c_map_dif_max_fast_load_im "maximum difference of MAP - MAP_SP for disabling Fast Manifold Filling" VALUE 0x016bc _REC_VAL_20_u2 5434. _CNV_A_R_LINEAR_____49_CM 0. 5434. DISPLAY_IDENTIFIER C_MAP_DIF_MAX_FAST_LOAD_IM FORMAT "%7.2" /end CHARACTERISTIC
/begin COMPU_METHOD _CNV_S_2_RANGE______0_CM "" TAB_VERB "%6.3" "[-]" COMPU_TAB_REF _CNV_S_2_RANGE______0 /end COMPU_METHOD
/begin COMPU_VTAB _CNV_S_2_RANGE______0 "" TAB_VERB 2 0 "0" 1 "1" /end COMPU_VTAB
/begin COMPU_METHOD _CNV_A_R_LINEAR_____1_CM "" RAT_FUNC "%6.3" "-" COEFFS 0 1. 0. 0 0 1 /end COMPU_METHOD
/begin COMPU_METHOD _CNV_A_R_LINEAR_____4_CM "" RAT_FUNC "%6.3" "s" COEFFS 0 100. 0. 0 0 1 /end COMPU_METHOD
/begin COMPU_METHOD _CNV_S_2_RANGE______5_CM "" TAB_VERB "%6.3" "-" COMPU_TAB_REF _CNV_S_2_RANGE______5 /end COMPU_METHOD
/begin COMPU_VTAB _CNV_S_2_RANGE______5 "" TAB_VERB 2 0 "0" 1 "1" /end COMPU_VTAB
/begin COMPU_METHOD _CNV_A_R_LINEAR_____10_CM "" RAT_FUNC "%6.3" "%" COEFFS 0 2.56 0. 0 0 1 /end COMPU_METHOD
/begin COMPU_METHOD _CNV_A_R_LINEAR_____11_CM "" RAT_FUNC "%6.3" "rpm" COEFFS 0 1. 0. 0 0 1 /end COMPU_METHOD
/begin COMPU_METHOD _CNV_A_R_LINEAR_____12_CM "" RAT_FUNC "%6.3" "°C" COEFFS 0 1.333333333333333 64. 0 0 1 /end COMPU_METHOD
/begin COMPU_METHOD _CNV_A_R_LINEAR_____13_CM "" RAT_FUNC "%6.3" "°C" COEFFS 0 1.333333333333333 0. 0 0 1 /end COMPU_METHOD
/begin COMPU_METHOD _CNV_A_R_LINEAR_____15_CM "" RAT_FUNC "%6.3" "°C" COEFFS 0 1. 40. 0 0 1 /end COMPU_METHOD
/begin COMPU_METHOD _CNV_A_R_LINEAR_____16_CM "" RAT_FUNC "%6.3" "rpm" COEFFS 0 3.125e-002 0. 0 0 1 /end COMPU_METHOD
/begin COMPU_METHOD _CNV_A_R_LINEAR_____21_CM "" RAT_FUNC "%6.3" "-" COEFFS 0 32768.00003968061 0. 0 0 1 /end COMPU_METHOD
/begin COMPU_METHOD _CNV_A_R_LINEAR_____22_CM "" RAT_FUNC "%6.3" "[-]" COEFFS 0 1. 0. 0 0 1 /end COMPU_METHOD
/begin COMPU_METHOD _CNV_A_R_LINEAR_____23_CM "" RAT_FUNC "%6.3" "km/h" COEFFS 0 1. 0. 0 0 1 /end COMPU_METHOD
/begin COMPU_METHOD _CNV_A_R_LINEAR_____24_CM "" RAT_FUNC "%6.3" "s" COEFFS 0 10. 0. 0 0 1 /end COMPU_METHOD
/begin COMPU_METHOD _CNV_A_R_LINEAR_____25_CM "" RAT_FUNC "%6.3" "-" COEFFS 0 4095.999999839998 -1.280019205296412e-006 0 0 1 /end COMPU_METHOD
/begin COMPU_METHOD _CNV_A_R_LINEAR_____27_CM "" RAT_FUNC "%6.3" "mg/stk" COEFFS 0 0.183585313174946 0. 0 0 1 /end COMPU_METHOD
/begin COMPU_METHOD _CNV_A_R_LINEAR_____29_CM "" RAT_FUNC "%6.3" "-" COEFFS 0 255.9983911655618 0. 0 0 1 /end COMPU_METHOD
/begin COMPU_METHOD _CNV_A_R_LINEAR_____30_CM "" RAT_FUNC "%6.3" "s" COEFFS 0 1. 0. 0 0 1 /end COMPU_METHOD
/begin COMPU_METHOD _CNV_A_R_LINEAR_____31_CM "" RAT_FUNC "%6.3" "ms" COEFFS 0 0.1 0. 0 0 1 /end COMPU_METHOD
/begin COMPU_METHOD _CNV_A_R_LINEAR_____37_CM "" RAT_FUNC "%6.3" "-" COEFFS 0 65536.00007936121 0. 0 0 1 /end COMPU_METHOD
/begin COMPU_METHOD _CNV_A_R_LINEAR_____39_CM "" RAT_FUNC "%6.3" "-" COEFFS 0 127.9991955827809 0. 0 0 1 /end COMPU_METHOD
/begin COMPU_METHOD _CNV_A_R_LINEAR_____40_CM "" RAT_FUNC "%6.3" "%/s" COEFFS 0 0.1024000154202376 128.000019275297 0 0 1 /end COMPU_METHOD
/begin COMPU_METHOD _CNV_A_R_LINEAR_____44_CM "" RAT_FUNC "%6.3" "V" COEFFS 0 51.0204081632653 0. 0 0 1 /end COMPU_METHOD
/begin COMPU_METHOD _CNV_A_R_LINEAR_____49_CM "" RAT_FUNC "%6.3" "hPa" COEFFS 0 12.06017666543982 0. 0 0 1 /end COMPU_METHOD
/begin COMPU_METHOD _CNV_A_R_LINEAR_____50_CM "" RAT_FUNC "%6.3" "[-]" COEFFS 0 255.9999357490357 0. 0 0 1 /end COMPU_METHOD
/begin COMPU_METHOD _CNV_A_R_LINEAR_____51_CM "" RAT_FUNC "%6.3" "rpm/s" COEFFS 0 3.125e-002 0. 0 0 1 /end COMPU_METHOD
/begin COMPU_METHOD _CNV_A_R_LINEAR_____54_CM "" RAT_FUNC "%6.3" "rpm/s" COEFFS 0 3.125e-002 128. 0 0 1 /end COMPU_METHOD
/begin COMPU_METHOD _CNV_A_R_LINEAR_____55_CM "" RAT_FUNC "%6.3" "Nm" COEFFS 0 32. 0. 0 0 1 /end COMPU_METHOD
/begin COMPU_METHOD _CNV_A_R_LINEAR_____78_CM "" RAT_FUNC "%6.3" "Nm" COEFFS 0 2. 0. 0 0 1 /end COMPU_METHOD
/begin COMPU_METHOD _CNV_A_R_LINEAR_____85_CM "" RAT_FUNC "%6.3" "km/h" COEFFS 0 128.0000018750286 0. 0 0 1 /end COMPU_METHOD
/begin COMPU_METHOD _CNV_A_R_LINEAR_____87_CM "" RAT_FUNC "%6.3" "µl" COEFFS 0 1. 0. 0 0 1 /end COMPU_METHOD
/begin COMPU_METHOD _CNV_A_R_LINEAR_____88_CM "" RAT_FUNC "%6.3" "km" COEFFS 0 0.1 0. 0 0 1 /end COMPU_METHOD
/begin COMPU_METHOD _CNV_A_R_LINEAR_____106_CM "" RAT_FUNC "%6.3" "mg/stk" COEFFS 0 47.18142548596112 0. 0 0 1 /end COMPU_METHOD
/begin COMPU_METHOD _CNV_S_6_RANGE_CDN__107_CM "" TAB_VERB "%6.3" "-" COMPU_TAB_REF _CNV_S_6_RANGE_CDN__107 /end COMPU_METHOD
/begin COMPU_VTAB _CNV_S_6_RANGE_CDN__107 "" TAB_VERB 6 0 "NO_CDN" 1 "CDN_NO_PURGE" 2 "CDN_MIN_PURGE" 3 "CDN_RAMP_OPEN" 4 "CDN_RAMP_OPEN_FAST" 5 "CDN_PURGE" /end COMPU_VTAB
/begin COMPU_METHOD _CNV_A_R_LINEAR_____108_CM "" RAT_FUNC "%6.3" "hPa" COEFFS 0 12.06017666543982 -1.759293338545831e-002 0 0 1 /end COMPU_METHOD
/begin COMPU_METHOD _CNV_A_R_LINEAR_____109_CM "" RAT_FUNC "%6.3" "%" COEFFS 0 655.3600000071681 3.584063961170614e-007 0 0 1 /end COMPU_METHOD
/begin COMPU_METHOD _CNV_S_3_RANGE_C_ST_110_CM "" TAB_VERB "%6.3" "-" COMPU_TAB_REF _CNV_S_3_RANGE_C_ST_110 /end COMPU_METHOD
/begin COMPU_VTAB _CNV_S_3_RANGE_C_ST_110 "" TAB_VERB 3 0 "NONE" 1 "NO_PURGE" 2 "MIN_PURGE" /end COMPU_VTAB
/begin COMPU_METHOD _CNV_A_R_LINEAR_____113_CM "" RAT_FUNC "%6.3" "kg/h" COEFFS 0 32. 0. 0 0 1 /end COMPU_METHOD
/begin COMPU_METHOD _CNV_A_R_LINEAR_____114_CM "" RAT_FUNC "%6.3" "hPa" COEFFS 0 12.06017666543982 32767.5 0 0 1 /end COMPU_METHOD
/begin COMPU_METHOD _CNV_A_R_LINEAR_____115_CM "" RAT_FUNC "%6.3" "-" COEFFS 0 128. 0. 0 0 1 /end COMPU_METHOD
/begin COMPU_METHOD _CNV_A_R_LINEAR_____164_CM "" RAT_FUNC "%6.3" "-" COEFFS 0 1023.999999919998 0. 0 0 1 /end COMPU_METHOD
/begin COMPU_METHOD _CNV_A_R_LINEAR_____186_CM "" RAT_FUNC "%6.3" "Nm" COEFFS 0 32. 32768. 0 0 1 /end COMPU_METHOD
/begin COMPU_METHOD _CNV_A_R_LINEAR_____198_CM "" RAT_FUNC "%6.3" "ms" COEFFS 0 250. 0. 0 0 1 /end COMPU_METHOD
/begin COMPU_METHOD _CNV_S_4_STATE_AMT__201_CM "" TAB_VERB "%6.3" "[-]" COMPU_TAB_REF _CNV_S_4_STATE_AMT__201 /end COMPU_METHOD
/begin COMPU_VTAB _CNV_S_4_STATE_AMT__201 "" TAB_VERB 4 0 "NO" 1 "DEC" 2 "INC" 3 "DEC_INC" /end COMPU_VTAB
/begin COMPU_METHOD _CNV_A_R_LINEAR_____202_CM "" RAT_FUNC "%6.3" "Nm/10ms" COEFFS 0 32. 0. 0 0 1 /end COMPU_METHOD
/begin COMPU_METHOD _CNV_A_R_LINEAR_____203_CM "" RAT_FUNC "%6.3" "°CRK" COEFFS 0 2.666666666666667 95. 0 0 1 /end COMPU_METHOD
/begin COMPU_METHOD _CNV_A_R_LINEAR_____205_CM "" RAT_FUNC "%6.3" "°CRK" COEFFS 0 2.666666666666667 128. 0 0 1 /end COMPU_METHOD
/begin COMPU_METHOD _CNV_A_R_LINEAR_____206_CM "" RAT_FUNC "%6.3" "rpm" COEFFS 0 1. 32768. 0 0 1 /end COMPU_METHOD
/begin COMPU_METHOD _CNV_A_R_LINEAR_____217_CM "" RAT_FUNC "%6.3" "s" COEFFS 0 32. 0. 0 0 1 /end COMPU_METHOD
/begin COMPU_METHOD _CNV_A_R_LINEAR_____250_CM "" RAT_FUNC "%6.3" "V" COEFFS 0 13107.19998965744 0. 0 0 1 /end COMPU_METHOD
/begin COMPU_METHOD _CNV_A_R_LINEAR_____264_CM "" RAT_FUNC "%6.3" "-" COEFFS 0 16383.75 32767.5 0 0 1 /end COMPU_METHOD
/begin COMPU_METHOD _CNV_A_R_LINEAR_____265_CM "" RAT_FUNC "%6.3" "-" COEFFS 0 16383.99999935999 -1.280019205296412e-006 0 0 1 /end COMPU_METHOD
/begin COMPU_METHOD _CNV_A_R_LINEAR_____266_CM "" RAT_FUNC "%6.3" "[-]" COEFFS 0 1023.999999959999 32767.99999871998 0 0 1 /end COMPU_METHOD
/begin COMPU_METHOD _CNV_A_R_LINEAR_____306_CM "" RAT_FUNC "%6.3" "-" COEFFS 0 1023.999999959999 -1.818989403545857e-011 0 0 1 /end COMPU_METHOD
/begin COMPU_METHOD _CNV_A_R_LINEAR_____345_CM "" RAT_FUNC "%6.3" "-" COEFFS 0 8191.999999679995 0. 0 0 1 /end COMPU_METHOD
/begin COMPU_METHOD _CNV_A_R_LINEAR_____376_CM "" RAT_FUNC "%6.3" "Nm/rpm" COEFFS 0 8191.999999679995 0. 0 0 1 /end COMPU_METHOD
/begin COMPU_METHOD _CNV_A_R_LINEAR_____381_CM "" RAT_FUNC "%6.3" "hPa" COEFFS 0 2. 0. 0 0 1 /end COMPU_METHOD
/begin COMPU_METHOD _CNV_A_R_LINEAR_____456_CM "" RAT_FUNC "%6.3" "-" COEFFS 0 1048576. 0. 0 0 1 /end COMPU_METHOD
/begin COMPU_METHOD _CNV_A_R_LINEAR_____457_CM "" RAT_FUNC "%6.3" "rpm/Nm" COEFFS 0 65536.00007936121 0. 0 0 1 /end COMPU_METHOD
/begin COMPU_METHOD _CNV_A_R_LINEAR_____458_CM "" RAT_FUNC "%6.3" "rpm" COEFFS 0 64.00027344284068 0.1400027344279806 0 0 1 /end COMPU_METHOD
/begin COMPU_METHOD _CNV_A_R_LINEAR_____459_CM "" RAT_FUNC "%6.3" "Nm/rpm*rpm" COEFFS 0 134293032.7868853 0. 0 0 1 /end COMPU_METHOD
/begin COMPU_METHOD _CNV_A_R_LINEAR_____460_CM "" RAT_FUNC "%6.3" "m/s²" COEFFS 0 2084.478388983038 32768.00027481336 0 0 1 /end COMPU_METHOD
/begin COMPU_METHOD _CNV_A_R_LINEAR_____461_CM "" RAT_FUNC "%6.3" "[-]" COEFFS 0 65535. 0. 0 0 1 /end COMPU_METHOD
/begin COMPU_METHOD _CNV_A_R_LINEAR_____463_CM "" RAT_FUNC "%6.3" "-" COEFFS 0 32768. 0. 0 0 1 /end COMPU_METHOD
/begin COMPU_METHOD _CNV_S_6_STATE_TQ_D_464_CM "" TAB_VERB "%6.3" "[-]" COMPU_TAB_REF _CNV_S_6_STATE_TQ_D_464 /end COMPU_METHOD
/begin COMPU_VTAB _CNV_S_6_STATE_TQ_D_464 "" TAB_VERB 6 0 "0" 1 "1" 8 "2" 9 "3" 10 "4" 11 "5" /end COMPU_VTAB
/begin COMPU_METHOD _CNV_A_R_LINEAR_____465_CM "" RAT_FUNC "%6.3" "-" COEFFS 0 4095.999963999451 32767.99971199561 0 0 1 /end COMPU_METHOD
/begin COMPU_METHOD _CNV_A_R_LINEAR_____466_CM "" RAT_FUNC "%6.3" "Nm/100ms" COEFFS 0 32. 0. 0 0 1 /end COMPU_METHOD
/begin COMPU_METHOD _CNV_A_R_LINEAR_____467_CM "" RAT_FUNC "%6.3" "W" COEFFS 0 -5.e-002 0. 0 0 1 /end COMPU_METHOD
/begin COMPU_METHOD _CNV_A_R_LINEAR_____468_CM "" RAT_FUNC "%6.3" "[-]" COEFFS 0 1023.999989719843 0. 0 0 1 /end COMPU_METHOD
/begin COMPU_METHOD _CNV_S_8_RANGE_STAT_469_CM "" TAB_VERB "%6.3" "-" COMPU_TAB_REF _CNV_S_8_RANGE_STAT_469 /end COMPU_METHOD
/begin COMPU_VTAB _CNV_S_8_RANGE_STAT_469 "" TAB_VERB 8 0 "no" 1 "ASR" 2 "MSR" 3 "GS_DEC" 4 "GS_INC" 5 "AMT_DEC" 6 "AMT_INC" 7 "DCC" /end COMPU_VTAB
/begin COMPU_METHOD _CNV_S_3_STATE_TQ_R_470_CM "" TAB_VERB "%6.3" "Nm" COMPU_TAB_REF _CNV_S_3_STATE_TQ_R_470 /end COMPU_METHOD
/begin COMPU_VTAB _CNV_S_3_STATE_TQ_R_470 "" TAB_VERB 3 1 "RANGE_1" 2 "RANGE_2" 3 "RANGE_3" /end COMPU_VTAB
/begin COMPU_METHOD _CNV_S_3_STATE_TQ_R_471_CM "" TAB_VERB "%6.3" "[-]" COMPU_TAB_REF _CNV_S_3_STATE_TQ_R_471 /end COMPU_METHOD
/begin COMPU_VTAB _CNV_S_3_STATE_TQ_R_471 "" TAB_VERB 3 0 "CONST" 1 "INC" 2 "DEC" /end COMPU_VTAB
/begin COMPU_METHOD _CNV_S_3_STATE_LRN__484_CM "" TAB_VERB "%6.3" "[-]" COMPU_TAB_REF _CNV_S_3_STATE_LRN__484 /end COMPU_METHOD
/begin COMPU_VTAB _CNV_S_3_STATE_LRN__484 "" TAB_VERB 3 0 "Variant unknown" 1 "Motorola sensor" 2 "KP120 - sensor" /end COMPU_VTAB
/begin COMPU_METHOD _CNV_R_R_dez_498_CM "" RAT_FUNC "%6.3" "[-]" COEFFS 0. 1. 0. 0. 0. 1. /end COMPU_METHOD
/begin COMPU_METHOD _CNV_R_R_tog_ub_q0p_521_CM "" RAT_FUNC "%6.3" "[-]" COEFFS 0. 2. 0. 0. 0. 1. /end COMPU_METHOD
/begin COMPU_METHOD _CNV_R_R_rel_ub_b10_522_CM "" RAT_FUNC "%6.3" "%" COEFFS 0. 255. 0. 0. 0. 100. /end COMPU_METHOD
/begin COMPU_METHOD _CNV_R_R_rel_uw_b10_523_CM "" RAT_FUNC "%6.3" "%" COEFFS 0. 65536. 0. 0. 0. 100. /end COMPU_METHOD
/begin COMPU_METHOD _CNV_R_R_nmot_ub_q4_524_CM "" RAT_FUNC "%6.3" "1/min" COEFFS 0. 1. 0. 0. 0. 40. /end COMPU_METHOD
/begin COMPU_METHOD _CNV_R_R_temp_uw_q0_525_CM "" RAT_FUNC "%6.3" "Grad C" COEFFS 0. 1. 48. 0. 0. 0.75 /end COMPU_METHOD
/begin COMPU_METHOD _CNV_R_R_t_q0p1ms_526_CM "" RAT_FUNC "%6.3" "ms" COEFFS 0. 10. 0. 0. 0. 1. /end COMPU_METHOD
/begin COMPU_METHOD _CNV_R_R_tog_ub_q0p_527_CM "" RAT_FUNC "%6.3" "mm" COEFFS 0. 2. 0. 0. 0. 1. /end COMPU_METHOD
/begin COMPU_METHOD _CNV_A_R_LINEAR_____528_CM "" RAT_FUNC "%6.3" "ms" COEFFS 0 10. 0. 0 0 1 /end COMPU_METHOD
/begin COMPU_METHOD _CNV_A_R_LINEAR_____529_CM "" RAT_FUNC "%6.3" "°C" COEFFS 0 1.331730769230769 63.92307692307692 0 0 1 /end COMPU_METHOD
/begin COMPU_METHOD _CNV_S_2_B_TRUE_530_CM "" TAB_VERB "%6.3" "[-]" COMPU_TAB_REF _CNV_S_2_B_TRUE_530 /end COMPU_METHOD
/begin COMPU_VTAB _CNV_S_2_B_TRUE_530 "" TAB_VERB 2 0 "----" 1 "TRUE" /end COMPU_VTAB
/begin COMPU_METHOD _CNV_A_R_LINEAR_____531_CM "" RAT_FUNC "%6.3" "1/min" COEFFS 0 2.5e-002 0. 0 0 1 /end COMPU_METHOD
/begin COMPU_METHOD _CNV_A_R_LINEAR_____532_CM "" RAT_FUNC "%6.3" "mm" COEFFS 0 2. 0. 0 0 1 /end COMPU_METHOD
/begin RECORD_LAYOUT _REC_VAL_20_u1 FNC_VALUES 1 UBYTE COLUMN_DIR DIRECT /end RECORD_LAYOUT
/begin RECORD_LAYOUT _REC_VAL_20_u2 FNC_VALUES 1 UWORD COLUMN_DIR DIRECT /end RECORD_LAYOUT
/begin RECORD_LAYOUT _REC_CUR_20_u2_u1 FNC_VALUES 1 UWORD COLUMN_DIR DIRECT /end RECORD_LAYOUT
/begin RECORD_LAYOUT _REC_AXS_20_u1 NO_AXIS_PTS_X 1 UBYTE AXIS_PTS_X 2 UBYTE INDEX_INCR DIRECT /end RECORD_LAYOUT
/begin RECORD_LAYOUT _REC_MAP_20_u1_u1_u1 FNC_VALUES 1 UBYTE COLUMN_DIR DIRECT /end RECORD_LAYOUT
/begin RECORD_LAYOUT _REC_CUR_20_u1_u1 FNC_VALUES 1 UBYTE COLUMN_DIR DIRECT /end RECORD_LAYOUT
/begin RECORD_LAYOUT _REC_AXS_20_u2 NO_AXIS_PTS_X 1 UWORD AXIS_PTS_X 2 UWORD INDEX_INCR DIRECT /end RECORD_LAYOUT
/begin RECORD_LAYOUT _REC_MAP_20_u2_u2_u1 FNC_VALUES 1 UWORD COLUMN_DIR DIRECT /end RECORD_LAYOUT
/begin RECORD_LAYOUT _REC_CUR_20_u1_u2 FNC_VALUES 1 UBYTE COLUMN_DIR DIRECT /end RECORD_LAYOUT
/begin RECORD_LAYOUT _REC_MAP_20_u2_u1_u1 FNC_VALUES 1 UWORD COLUMN_DIR DIRECT /end RECORD_LAYOUT
/begin RECORD_LAYOUT _REC_CUR_20_u2_u2 FNC_VALUES 1 UWORD COLUMN_DIR DIRECT /end RECORD_LAYOUT
/begin RECORD_LAYOUT _REC_VAL_20_s1 FNC_VALUES 1 SBYTE COLUMN_DIR DIRECT /end RECORD_LAYOUT
/begin RECORD_LAYOUT _REC_VAL_20_s2 FNC_VALUES 1 SWORD COLUMN_DIR DIRECT /end RECORD_LAYOUT
/begin RECORD_LAYOUT _REC_MAP_20_u2_u1_u2 FNC_VALUES 1 UWORD COLUMN_DIR DIRECT /end RECORD_LAYOUT
/begin RECORD_LAYOUT _REC_MAP_20_u2_u2_u2 FNC_VALUES 1 UWORD COLUMN_DIR DIRECT /end RECORD_LAYOUT
/begin RECORD_LAYOUT _REC_CUR_52_u2_u2 NO_AXIS_PTS_X 1 UWORD AXIS_PTS_X 2 UWORD INDEX_INCR DIRECT FNC_VALUES 3 UWORD COLUMN_DIR DIRECT /end RECORD_LAYOUT
/begin RECORD_LAYOUT _REC_CUR_52_UBYTE_s1_u1 NO_AXIS_PTS_X 1 UBYTE AXIS_PTS_X 2 UBYTE INDEX_INCR DIRECT FNC_VALUES 3 SBYTE COLUMN_DIR DIRECT /end RECORD_LAYOUT
/begin RECORD_LAYOUT _REC_CUR_52_UWORD_u2_u2 NO_AXIS_PTS_X 1 UWORD AXIS_PTS_X 2 UWORD INDEX_INCR DIRECT FNC_VALUES 3 UWORD COLUMN_DIR DIRECT /end RECORD_LAYOUT
/begin FUNCTION SYS_Output_signals_of_the_DME_to "_Output signals of the DME to the CAN bus"
 /begin DEF_CHARACTERISTIC c_t_cyc_disp_icl_can c_icl_disp_frq c_toil_gs_max c_tco_chk_ctl_1 c_tco_chk_ctl_2 c_tco_sum_hys_1 c_tco_sum_hys_2 c_tq_max_acc c_cc_mess c_n_32_thd_cc_poil_swi ip_t_dly_poil_swi_can__toil c_n_sp_is_thd_can c_max_msg_miss_asr_can c_tmot_sum_hys c_t_tco_can_ast c_tco_swi_wup c_t_ctr_max_asr_can c_tco_tmot_sta c_fac_mff_fco ip_t_ast_swi_wup__ctr_km_can c_pv_can_diag c_eng_etcu c_crlc_fco_av lc_var_bn2000 lc_var_veh /end DEF_CHARACTERISTIC
 /begin OUT_MEASUREMENT lv_temp_eng_1 lv_temp_eng_2 lv_toil_gs tcc_can_ecu tcc_can_ecu1 tcc_can_ecu2 tcc_can_ecu3 cc_id lv_mil_fll tq_ems_bn tq_maf lv_ack_tcs fco lv_wup_can ctl_shift_lock_can lv_level_is tqi_maf tqi_av_can tqi_ems_can tqi_maf_can lv_crul_ack fco_av_mmv state_lrn_amp /end OUT_MEASUREMENT
/end FUNCTION
/begin FUNCTION SYS_Check_Sum_Calculation "_Check Sum Calculation"
 /begin OUT_MEASUREMENT ctl_acin_eng_typ state_swi_off_vb cks_can_tq_dcc cks_can_tq_tcs cks_can_tq_etcu cks_can_tq_amt cks_can_msw cks_can_cas cks_clc_cas cks_clc_tq_dcc cks_clc_tq_tcs cks_clc_tq_etcu cks_clc_tq_amt cks_clc_msw cks_clc_ecu1 cks_clc_ecu2 cks_clc_ecu3 cks_can_veh_mod cks_can_tq_pste_2 cks_clc_tq_pste_2 /end OUT_MEASUREMENT
/end FUNCTION
/begin FUNCTION SYS_Multiplexed_segment_synchron "_Multiplexed segment-synchronous output variables"
 /begin OUT_MEASUREMENT iga_igc_0_5 iga_knk_0_5 knk_thd_0_5 nl_0_5 ti_cyl_0_5 knks_0_5 /end OUT_MEASUREMENT
/end FUNCTION
/begin FUNCTION SYS_Oil_temperature_and_level_se "_Oil temperature and level sensor (GGTOENS)"
 /begin DEF_CHARACTERISTIC DOLNIV ORIVERZ PT1NMOT PT1TOEL TOGANZ TOGKURZANZ TOGMWK TOGNMOT TOGORIANZ TOGTMOT TOGTMOTORI TOGVERBKZ TOGVERBNOR TOGVERLKZ TOGVERLNOR TOGVERLORI TRTYP KLTOGNKOR KLTKTOENIV KLTVTOEL /end DEF_CHARACTERISTIC
 /begin OUT_MEASUREMENT B_oelverb nmotf nmotfm nmotfsum Oelnivak Oelnivaknk Oelnivnksm Oelnivnorm Oelnivori Oelnivsum Oelnivsumw Oriverzz Toel_t togbw_i togk_i tog_i tog_k B_oelverl Oelnivkurz Oelnivm /end OUT_MEASUREMENT
/end FUNCTION
/begin FUNCTION SYS_Evaporative_Emission_Control "_Evaporative Emission Control activation conditions variables"
 /begin DEF_CHARACTERISTIC c_t_dly_pu_cps c_prs_max_cps c_n_cp_tol c_maf_cp_bol c_maf_cp_tol c_t_lam_lim_cp c_cl_mmv_req c_t_lam_cp_dly c_lam_cp_bol c_lam_cp_tol c_dly_n_maf_dyw_cp c_maf_dyw_cp c_n_dyw_cp c_tco_min_cp c_n_cp_bol c_n_max_cp c_n_hys_max_cp c_tia_min_cp c_state_win_cp_not /end DEF_CHARACTERISTIC
 /begin OUT_MEASUREMENT n_dyw_cp maf_dyw_cp cdn_state_cp lv_cp_act_req lv_pu_cp prs_cps lv_n_max_cp lv_n_maf_dyw_cp lv_cp_act lv_lam_out_cp lv_lam_lim_cp lv_win_cp /end OUT_MEASUREMENT
/end FUNCTION
/begin FUNCTION SYS_BN2000_interface_torque_dist "_BN2000 interface torque distribution"
 /begin OUT_MEASUREMENT tq_amt_fast_dec_bn tq_amt_slow_dec_bn tq_amt_fast_inc_bn tq_amt_slow_inc_bn tq_dcc_fast_inc_bn tq_dcc_slow_inc_bn tq_gs_fast_dec_bn tq_gs_fast_inc_bn tq_gs_slow_dec_bn tq_gs_slow_inc_bn tq_msr_fast_inc_bn tq_msr_slow_inc_bn tq_asr_fast_dec_bn tq_asr_slow_dec_bn /end OUT_MEASUREMENT
/end FUNCTION
/begin FUNCTION SYS_Application_incidences_for_o "_Application incidences for oxygen sensor internal resistance"
 /begin OUT_MEASUREMENT lv_inh_r_down_ls_1 lv_inh_r_down_ls_2 lv_inh_r_up_ls_2 lv_inh_r_up_ls_1 /end OUT_MEASUREMENT
/end FUNCTION
/begin FUNCTION SYS_Driving_off_assistance "_Driving off assistance"
 /begin DEF_CHARACTERISTIC ip_t_n_dif_ofs_pred_drof ip_tq_add_pl_drof ip_fac_tq_req_fast_load_im c_gear_max_fast_load_im c_vs_max_fast_load_im c_n_max_fast_load_im c_n_max_fast_load_im_dt_1 c_n_max_fast_load_im_dt_0 c_t_ast_min_fast_load_im lc_fast_load_im_is lc_ena_fast_load_im lc_ena_fast_load_im_n_sp c_tqi_dif_fast_load_min_pos c_tqi_dif_fast_load_min_neg c_map_dif_max_fast_load_im /end DEF_CHARACTERISTIC
 /begin OUT_MEASUREMENT tq_add_pl_drof n_dif_pred_pl_drof lv_fast_load_im /end OUT_MEASUREMENT
/end FUNCTION
/begin FUNCTION TQM_Torque_Managment "TQM"
 /begin SUB_FUNCTION TQM_Torque_request_for_gear_shif TQM_Initialization_module TQM_Torque_control_at_engine_sta TQM_Reference_and_basic_torque TQM_Torque_losses TQM_Torque_loss_and_reserve_for_ TQM_Torque_based_pattern_calcula TQM_Minimum_torque_at_clutch TQM_Converter_torque TQM_Torque_Transient TQM_Torque_reserve_coordination TQM_Torque_Monitoring_Limitation TQM_Torque_based_anti_jerk_funct TQM_Basic__actual_and_minimum_la TQM_Pedal_value_interpretation TQM_Maximum_torque_at_clutch TQM_Characteristic_quantity_stra TQM_Reference_and_basic_torque_f TQM_Torque_Request_at_Clutch_Gen TQM_Minimum_Maximum_Torque_Reque TQM_Torque_setpoint_for_stratifi TQM_Actual_Engine_Torque TQM_Actual_indicated_engine_torq TQM_Characteristic_quantity_homo TQM_Engine_torque_limitation TQM_Torque_Request_for_Cruise_Co TQM_Torque_Request_for_safety TQM_Torque_based_lambda_setpoint TQM_Dynamic_torque_intervention_ TQM_Torque_loss_for_power_steeri TQM_Appl_IncTorque_loss_and_rese TQM_Application_incidences_for_t TQM_Torque_Reserve_for_Torque_Tr TQM_Dynamic_Torque_request_coord TQM_Separation_for_slow_and_fast TQM_Anti_Jerk_Controller_Activat TQM_Minimum_indicated_engine_tor TQM_Coordination_of_additional_t TQM_Torque_request_for_AMT_inter TQM_AMT_Clutch_torque TQM_Torque_request_for_distance_ TQM_Torque_Request_for_Traction_ TQM_Torque_Loss___Anti_Roll_Stab TQM_Alternator_torque_losses /end SUB_FUNCTION
/end FUNCTION
/begin FUNCTION TQM_Torque_request_for_gear_shif "_Torque request for gear shift intervention"
 /begin DEF_CHARACTERISTIC c_t_max_tqr_gs_intv c_gs_ena_inc_dec c_lgrd_lih_gs_dec c_lgrd_lih_gs_inc c_t_dly_lih_gs_dec c_t_dly_lih_gs_inc /end DEF_CHARACTERISTIC
 /begin OUT_MEASUREMENT lv_etcu_disable lv_etcu_disable_can lv_gs_ena_dec lv_gs_ena tqi_gs_fast_dec_req_1 tqi_gs_slow_dec_req tqi_gs_fast_inc_req_1 tqi_gs_slow_inc_req t_tqr_gs_intv tqi_gs_fast_dec_req tqi_gs_fast_dec tqi_gs_slow_dec_req_1 tqi_gs_slow_dec lv_gs_ena_inc lv_gs_dec_lih tqi_gs_fast_inc_req tqi_gs_fast_inc tqi_gs_slow_inc_req_1 tqi_gs_slow_inc lv_gs_dec_act lv_gs_inc_lih lv_gs_inc_act t_gs_inc_lih_ctr t_gs_dec_lih_ctr /end OUT_MEASUREMENT
/end FUNCTION
/begin FUNCTION TQM_Initialization_module "_Initialization module"
 /begin OUT_MEASUREMENT eff_maf_s acp tqi_vs_max tq_loss_scha lv_tq_loss_acc_inp_orng lamb_bas_cor_max lv_can_gs_ack lv_acp_orng eff_egr_s eff_pha_s tq_ad_add_s_swi tqi_cat_prot tq_loss_sa tq_loss_thermo tq_loss_win_heat tqi_p_max /end OUT_MEASUREMENT
/end FUNCTION
/begin FUNCTION TQM_Torque_control_at_engine_sta "_Torque control at engine start"
 /begin DEF_CHARACTERISTIC c_crlc_tq_st ip_tq_st_mt ip_tq_st_at c_t_tq_add_dly_st c_tq_add_crlc_st ip_tq_add_st /end DEF_CHARACTERISTIC
 /begin OUT_MEASUREMENT tq_st tq_st_1 tq_add_st lv_tq_add_st /end OUT_MEASUREMENT
/end FUNCTION
/begin FUNCTION TQM_Reference_and_basic_torque "_Reference and basic torque" /begin DEF_CHARACTERISTIC ip_tqi_ref__n__maf lc_mod_eff_av /end DEF_CHARACTERISTIC
 /begin OUT_MEASUREMENT tqi_bas tqi_ref_iga tqi_ref_iga_lamb tqi_ref_iga_min_lamb tqi_ref_iga_scc tqi_ref_lamb tqi_ref_lamb_scc tqi_ref_scc tqi_ref eff_tot_bas eff_tot_bas_slow /end OUT_MEASUREMENT
/end FUNCTION
/begin FUNCTION TQM_Torque_losses "_Torque losses"
 /begin DEF_CHARACTERISTIC ip_tqfr ip_tqfr_add ip_tq_loss_lim ip_tqfr_st ip_tqfr_dec_st c_maf_cyl_stk_ref c_crlc_tq_loss_req_clu ldpm_tco__tqfr_add ldpm_ctr_km_can__tqfr_add ip_tqfr_add_km_mt ip_tqfr_add_km_at ip_tqfr_delta_amp c_lgrd_tq_loss_ecf ip_pow_loss_ecf /end DEF_CHARACTERISTIC
 /begin OUT_MEASUREMENT tq_loss tq_loss_1 tq_loss_req_clu tqfr_mec lv_tq_loss_lim_act tqfr tqfr_bas tqfr_add tqfr_st tqfr_req_clu tq_loss_clu_add tqfr_add_km tqfr_delta_amp tq_loss_ecf /end OUT_MEASUREMENT
/end FUNCTION
/begin FUNCTION TQM_Torque_loss_and_reserve_for_ "_Torque loss and reserve for ACC"
 /begin DEF_CHARACTERISTIC ip_fac_tq_loss_acc_on ip_fac_tq_loss_acc_off ip_tq_add_acc ip_tq_add_heat_acc c_tq_add_acc_lgrd c_tq_add_heat_acc_lgrd c_tco_min_req_heat_acc c_tam_min_req_heat_acc c_tq_loss_max_acc c_crlc_tq_loss_acc_inp c_tq_add_acc_lgrd_on /end DEF_CHARACTERISTIC
 /begin OUT_MEASUREMENT tq_add_acc tq_loss_acc tq_add_heat_acc lv_tout_acc lv_req_heat_acc_ena lv_tout_req_heat_acc t_req_heat_acc tq_loss_acc_inp /end OUT_MEASUREMENT
/end FUNCTION
/begin FUNCTION TQM_Torque_based_pattern_calcula "_Torque based pattern calculation"
 /begin DEF_CHARACTERISTIC lc_eff_scc_sp_man lc_inh_fcut_fast lc_ena_eff_scc_bas_man c_eff_scc_sp_hys c_eff_scc_bas_man lc_ena_fcut_tot_gs lc_inh_fcut_gs_iga lc_inh_fcut_asr lc_ena_fcut_tot_asr lc_inh_fcut_n_max lc_tq_scc_inh_man lc_ena_fcut_tot_fast lc_tq_scc_ena_man c_eff_scc_sp_man c_fac_iga_min_teg_iga_bas c_hys_eff_iga_min_teg c_min_dec_eff_iga_min_teg_1 c_min_dec_eff_iga_min_teg_2 id_nr_pat_scc lc_inh_fcut_gs lc_ena_fcut_tot_n_max lc_inh_fcut_amt lc_inh_fcut_dcc lc_ena_fcut_tot_amt lc_ena_fcut_tot_dcc /end DEF_CHARACTERISTIC
 /begin OUT_MEASUREMENT eff_scc_av eff_scc_av_can eff_scc_sp_hys eff_scc_bas eff_scc_sp tqi_ref_iga_min_scc eff_iga_min_scc fac_iga_min_teg_iga_bas lv_auth_tq_pat nr_pat_scc t_max_fcut_fast /end OUT_MEASUREMENT
/end FUNCTION
/begin FUNCTION TQM_Minimum_torque_at_clutch "_Minimum torque at clutch"
 /begin DEF_CHARACTERISTIC c_n_dif_tq_st_1 c_n_dif_tq_st_2 ip_fac_n_dif_is ip_tqi_min_req_pu lc_tq_loss_min_clu lc_tq_loss_min_clu_1 lc_tq_loss_min_clu_is lc_inh_pu_req lc_inh_puc_req /end DEF_CHARACTERISTIC
 /begin OUT_MEASUREMENT tq_min_clu tq_min_clu_1 tq_min_clu_2 fac_n_dif_is lv_tq_min_clu tqi_min_req_pu tq_min_req_pu /end OUT_MEASUREMENT
/end FUNCTION
/begin FUNCTION TQM_Converter_torque "_Converter torque"
 /begin DEF_CHARACTERISTIC c_tq_add_conv_lgrd ip_tq_add_conv lc_tq_conv_dri_inh lc_tq_conv_can_inh ip_fac_conv__toil ip_fac_conv_dri__toil ip_t_dly_conv__toil ip_t_dly_n_sp_is__toil ip_fac_tq_conv__n_ratio_conv ip_n_tur__gr_at__vs ip_tq_conv_can ip_tq_add_conv_ac ip_tq_add_conv_n_grd ip_fac_tq_add_conv_toil ip_t_ramp_conv_neg__toil ip_t_ramp_conv_pos__toil /end DEF_CHARACTERISTIC
 /begin OUT_MEASUREMENT tq_conv_can_1 tq_add_conv lv_tout_conv t_conv tq_add_trans lv_dly_n_sp_is tq_conv_stn tq_conv tq_add_conv_2 /end OUT_MEASUREMENT
/end FUNCTION
/begin FUNCTION TQM_Torque_Transient "_Torque Transient"
 /begin DEF_CHARACTERISTIC c_tq_tra_thd_up_2 c_n_grd_thd_neg c_n_grd_thd_pos lc_tq_tra_inh c_tq_tra_thd_down_1 c_tq_tra_thd_down_2 c_tq_tra_thd_up_1 ip_t_inc_tra_3_mt ip_t_dec_tra_rng_l_3_at ip_t_inc_tra_rng_l_3_mt ip_t_dec_tra_2_mt ip_t_inc_tra_is_mt ip_t_dec_tra_3_mt ip_t_dec_tra_rng_l_3_mt ip_t_inc_tra_rng_l_is_at ip_t_dec_tra_is_mt ip_t_dec_tra_rng_l_is_at ip_t_inc_tra_1_at ip_t_inc_tra_rng_l_is_mt ip_t_inc_tra_2_at ip_t_dec_tra_rng_l_is_mt ip_t_inc_tra_3_at ip_t_dec_tra_1_at ip_t_dec_tra_2_at ip_t_inc_tra_rng_l_1_at ip_t_dec_tra_3_at ip_t_dec_tra_rng_l_1_at ip_t_dec_tra_is_at ip_t_inc_tra_rng_l_1_mt ip_t_inc_tra_is_at ip_t_dec_tra_rng_l_1_mt ip_t_inc_tra_rng_l_2_at ip_t_dec_tra_rng_l_2_at ip_t_inc_tra_rng_l_2_mt ip_t_inc_tra_1_mt ip_t_dec_tra_rng_l_2_mt ip_t_inc_tra_2_mt ip_t_inc_tra_rng_l_3_at ip_t_dec_tra_1_mt /end DEF_CHARACTERISTIC
 /begin OUT_MEASUREMENT t_tra tq_req_dif_tra tq_range tq_req_tra_clu tq_req_tra_old_clu tqi_req_tra tq_req_tra_state lv_tq_tra lv_tq_tra_dyn /end OUT_MEASUREMENT
/end FUNCTION
/begin FUNCTION TQM_Torque_reserve_coordination "_Torque reserve coordination"
 /begin DEF_CHARACTERISTIC lc_inh_tq_add_ch lc_inh_tq_add c_tq_add_min_ch c_tq_add_hys c_tq_add_hys_cru c_tq_add_min c_tq_add_min_cru /end DEF_CHARACTERISTIC
 /begin OUT_MEASUREMENT tq_add_req_ch tq_add_max tq_add_req_max_teg maf_kgh_add_max maf_add_max tqi_add_act eff_iga_min_add_max tqi_add_max lv_tq_add_req tq_add_act tqi_add_act_tmp_1 tq_add_req tqi_add_act_tmp_2 tqi_add_act_tmp_3 tqi_add_max_tol tqi_add_max_teg lv_tq_add_req_1 tq_add_req_act lv_tq_add_req_2 /end OUT_MEASUREMENT
/end FUNCTION
/begin FUNCTION TQM_Torque_Monitoring_Limitation "_Torque Monitoring Limitation and Coordination"
 /begin DEF_CHARACTERISTIC c_tq_ad_add_s_swi c_tq_dif_1 c_tq_dif_2 c_tq_dif_hys_1 lc_tq_intv_ena_as c_tq_dif_hys_2 lc_tq_intv_inh_as c_tq_dif_hys_is_1 c_tq_dif_hys_is_2 lc_tqi_sp_man_act c_tq_dif_is_1 c_tq_dif_is_2 c_tqi_sp_man ip_maf_sp /end DEF_CHARACTERISTIC
 /begin OUT_MEASUREMENT tqi_req_slow tqi_req_fast tqi_req_fast_can tqi_bas_cor_ch tqi_sp tqi_sp_1 tqi_sp_2 tqi_sp_3 tqi_sp_maf tqi_bas_cor maf_sp_tqi tqi_fast tqi_sp_maf_1 lv_tq_intv tqi_sp_maf_2 lv_tq_intv_req tqi_sp_can tqi_fast_can tqi_sp_1_can /end OUT_MEASUREMENT
/end FUNCTION
/begin FUNCTION TQM_Torque_based_anti_jerk_funct "_Torque based anti jerk function"
 /begin DEF_CHARACTERISTIC c_fil_aj_inp_0 c_fil_aj_inp_1 c_fil_aj_inp_2 c_fil_aj_out_1 c_fil_aj_out_2 id_fac_inv_veh_mass_at id_fac_inv_veh_mass_mt id_fac_tq_de_aj_at id_fac_tq_de_aj_mt c_n_dif_ref_aj_max c_n_dif_ref_aj_min ip_fac_tq_aj c_t_pas_aj_dly /end DEF_CHARACTERISTIC
 /begin OUT_MEASUREMENT n_dif_aj n_dif_ref_lpf_aj tq_dif_aj tq_fast_clu tq_mdl_de_aj n_ref_aj n_dif_ref_aj n_dif_ref_aj_inter /end OUT_MEASUREMENT
/end FUNCTION
/begin FUNCTION TQM_Basic__actual_and_minimum_la "_Basic, actual and minimum lambda efficiency"
 /begin DEF_CHARACTERISTIC ip_lamb_ref_add__tco ip_lamb_ref__n__maf ip_eff_lamb__lamb_dif /end DEF_CHARACTERISTIC
 /begin OUT_MEASUREMENT eff_lamb_bas_cor lamb_ref_cor lamb_dif_bas lamb_dif_av lamb_ref_add_tco lamb_dif_max eff_lamb_av eff_lamb_min eff_lamb_sp_bas lamb_ref lamb_dif_sp_bas /end OUT_MEASUREMENT
/end FUNCTION
/begin FUNCTION TQM_Pedal_value_interpretation "_Pedal value interpretation"
 /begin DEF_CHARACTERISTIC ip_fac_tq_req_driv_rng_l ip_fac_tq_req_driv c_pv_av_sof_min c_fac_tq_req_driv_sof_max c_pv_av_grd_sof_max c_t_pv_av_grd_sof_max lc_rng_l_man_as /end DEF_CHARACTERISTIC
 /begin OUT_MEASUREMENT fac_tq_req_driv lv_rng_l_req lv_rng_l_req_mon2 /end OUT_MEASUREMENT
/end FUNCTION
/begin FUNCTION TQM_Maximum_torque_at_clutch "_Maximum torque at clutch" /begin DEF_CHARACTERISTIC c_tqi_fac_fl /end DEF_CHARACTERISTIC /begin OUT_MEASUREMENT maf_max_cor tqi_ref_max tq_max_clu tqi_max /end OUT_MEASUREMENT /end FUNCTION
/begin FUNCTION TQM_Characteristic_quantity_stra "_Characteristic quantity stratified mode" /end FUNCTION
/begin FUNCTION TQM_Reference_and_basic_torque_f "_Reference and basic torque for stratified mode" /begin DEF_CHARACTERISTIC ip_tqi_ref_s /end DEF_CHARACTERISTIC /begin OUT_MEASUREMENT tqi_ref_s /end OUT_MEASUREMENT /end FUNCTION
/begin FUNCTION TQM_Torque_Request_at_Clutch_Gen "_Torque Request at Clutch General"
 /begin OUT_MEASUREMENT fac_tq_req_clu lv_tq_cru_act tq_req_clu tqi_min_req fac_tq_req /end OUT_MEASUREMENT
/end FUNCTION
/begin FUNCTION TQM_Minimum_Maximum_Torque_Reque "_Minimum/Maximum Torque Request Selection"
 /begin OUT_MEASUREMENT lv_tq_inc tqi_ems tqi_req_fast_dec tqi_inter_fast tqi_req_fast_inc tqi_inter_slow tqi_req_slow_sel tqi_req_fast_sel tqi_req_fast_sel_can state_tq_intv_slow state_tq_intv_fast /end OUT_MEASUREMENT
/end FUNCTION
/begin FUNCTION TQM_Torque_setpoint_for_stratifi "_Torque setpoint for stratified mode" /end FUNCTION
/begin FUNCTION TQM_Actual_Engine_Torque "_Actual Engine Torque" /begin DEF_CHARACTERISTIC c_fac_tqe /end DEF_CHARACTERISTIC /begin OUT_MEASUREMENT tqi_av_hom tq_av tqe tqi_av tqe_dif eff_tot_av /end OUT_MEASUREMENT /end FUNCTION
/begin FUNCTION TQM_Actual_indicated_engine_torq "_Actual indicated engine torque for stratified" /begin OUT_MEASUREMENT tqi_av_s eff_tot_av_s /end OUT_MEASUREMENT /end FUNCTION
/begin FUNCTION TQM_Characteristic_quantity_homo "_Characteristic quantity homogeneous mode" /end FUNCTION
/begin FUNCTION TQM_Engine_torque_limitation "_Engine torque limitation"
 /begin DEF_CHARACTERISTIC ip_tq_lim_amt ip_tq_lim_at c_t_tq_lim lc_tqi_p_max_inh_as id_tq_p_max_mt id_tq_p_max_at /end DEF_CHARACTERISTIC
/end FUNCTION
/begin FUNCTION TQM_Torque_Request_for_Cruise_Co "_Torque Request for Cruise Control" /begin DEF_CHARACTERISTIC c_lgrd_tq_cru_inc_1 c_lgrd_tq_cru_inc_2 /end DEF_CHARACTERISTIC
 /begin OUT_MEASUREMENT fac_tq_req_cru fac_tq_req_dcc state_tq_dcc lv_tq_dcc_act tq_delta_max_clu /end OUT_MEASUREMENT
/end FUNCTION
/end MODULE
/end PROJECT
