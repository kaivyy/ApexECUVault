ASAP2_VERSION 1 31
/begin PROJECT MS45 "BMW Motorsteuerung R6"
/begin HEADER "_default_HeaderComment" PROJECT_NO _57 /end HEADER
/begin MODULE _default_ModuleName "_default_ModuleLongIdentifier"
/begin MOD_COMMON "_default_ModCommonComment" DEPOSIT ABSOLUTE BYTE_ORDER MSB_FIRST ALIGNMENT_BYTE 1 ALIGNMENT_WORD 2 ALIGNMENT_LONG 4 ALIGNMENT_FLOAT32_IEEE 4 ALIGNMENT_FLOAT64_IEEE 8 /end MOD_COMMON
/begin CHARACTERISTIC ip_teg_cop_sp_dif "Temperature offset launching overheat protection" CURVE 0xffe4ec2a _REC_CUR_20_u2_u1 753.641 _CNV_A_R_LINEAR_____278_CM 0. 753.641 DISPLAY_IDENTIFIER IP_TEG_COP_SP_DIF FORMAT "%7.3"
 /begin AXIS_DESCR COM_AXIS online_dummy _CNV_A_R_LINEAR_____279_CM 6 0. 127.5 FORMAT "%5.1" AXIS_PTS_REF ldp_t_cop_i__teg_cop /end AXIS_DESCR
/end CHARACTERISTIC
/begin CHARACTERISTIC ip_lamb_cop "Lambda setpoint for overheat protection" CURVE 0xffe4c702 _REC_CUR_20_u2_u2 31.99902344 _CNV_A_R_LINEAR_____206_CM 0. 31.99902344 DISPLAY_IDENTIFIER IP_LAMB_COP FORMAT "%7.4"
 /begin AXIS_DESCR COM_AXIS online_dummy _CNV_A_R_LINEAR_____20_CM 16 0. 1.99996948 FORMAT "%7.5" AXIS_PTS_REF ldp_fac_cop_i__teg_cop /end AXIS_DESCR
/end CHARACTERISTIC
/begin CHARACTERISTIC ip_teg_cop_sp "Catalyst overheat protection setpoint" CURVE 0xffe41cc0 _REC_CUR_20_u2_u2 1507.3 _CNV_A_R_LINEAR_____280_CM -48. 1459.3 DISPLAY_IDENTIFIER IP_TEG_COP_SP FORMAT "%7.2"
 /begin AXIS_DESCR COM_AXIS online_dummy _CNV_A_R_LINEAR_____20_CM 4 0. 1.99996948 FORMAT "%7.5" AXIS_PTS_REF ldpm_eff_iga_av_teg_i__teg_cop /end AXIS_DESCR
/end CHARACTERISTIC
/begin CHARACTERISTIC c_lgrd_lamb_cop_inc "Change limitation for the lambda catalyst overheating prevention" VALUE 0xffe4170c _REC_VAL_20_u2 31.99902344 _CNV_A_R_LINEAR_____206_CM 0. 31.99902344 DISPLAY_IDENTIFIER C_LGRD_LAMB_COP_INC FORMAT "%7.4" /end CHARACTERISTIC
/begin CHARACTERISTIC c_lgrd_lamb_cop_dec "Decrementation for the lambda catalyst overheating prevention" VALUE 0xffe4170a _REC_VAL_20_u2 31.99902344 _CNV_A_R_LINEAR_____206_CM 0. 31.99902344 DISPLAY_IDENTIFIER C_LGRD_LAMB_COP_DEC FORMAT "%7.4" /end CHARACTERISTIC
/begin CHARACTERISTIC ip_teg_cop_sp_lim "Catalyst overheat protection at ewrror" CURVE 0xffe41cc8 _REC_CUR_20_u2_u2 1507.3 _CNV_A_R_LINEAR_____280_CM -48. 1459.3 DISPLAY_IDENTIFIER IP_TEG_COP_SP_LIM FORMAT "%7.2"
 /begin AXIS_DESCR COM_AXIS online_dummy _CNV_A_R_LINEAR_____20_CM 4 0. 1.99996948 FORMAT "%7.5" AXIS_PTS_REF ldpm_eff_iga_av_teg_i__teg_cop /end AXIS_DESCR
/end CHARACTERISTIC
/begin AXIS_PTS ldp_t_cop_i__teg_cop "" 0xffe4119d online_dummy _REC_AXS_20_u1 127.5 _CNV_A_R_LINEAR_____279_CM 6 0. 127.5 DISPLAY_IDENTIFIER LDP_T_COP_I__TEG_COP FORMAT "%5.1" /end AXIS_PTS
/begin AXIS_PTS ldp_fac_cop_i__teg_cop "" 0xffe50b8a online_dummy _REC_AXS_20_u2 1.99996948 _CNV_A_R_LINEAR_____20_CM 16 0. 1.99996948 DISPLAY_IDENTIFIER LDP_FAC_COP_I__TEG_COP FORMAT "%7.5" /end AXIS_PTS
/begin AXIS_PTS ldpm_eff_iga_av_teg_i__teg_cop "" 0xffe51814 online_dummy _REC_AXS_20_u2 1.99996948 _CNV_A_R_LINEAR_____20_CM 4 0. 1.99996948 DISPLAY_IDENTIFIER LDPM_EFF_IGA_AV_TEG_I__TEG_COP FORMAT "%7.5" /end AXIS_PTS
/begin CHARACTERISTIC c_lamb_cop_sp_pas "passive value for the lambda catalyst overheating prevention" VALUE 0xffe416ae _REC_VAL_20_u2 31.99902344 _CNV_A_R_LINEAR_____206_CM 0. 31.99902344 DISPLAY_IDENTIFIER C_LAMB_COP_SP_PAS FORMAT "%7.4" /end CHARACTERISTIC
/begin CHARACTERISTIC c_teg_cop_dif_lim "offset for cat overheat protection in error limitation" VALUE 0xffe41a44 _REC_VAL_20_u2 753.641 _CNV_A_R_LINEAR_____278_CM 0. 753.641 DISPLAY_IDENTIFIER C_TEG_COP_DIF_LIM FORMAT "%7.3" /end CHARACTERISTIC
/begin MEASUREMENT lam_bank_1.cat_prev.lamb_cop "lambda for catalyst overheating prevention" UWORD _CNV_A_R_LINEAR_____206_CM 1 100. 0. 31.99902344 DISPLAY_IDENTIFIER LAMB_COP_1 ECU_ADDRESS 0x3fc270 BYTE_ORDER MSB_LAST FORMAT "%7.4" /end MEASUREMENT
/begin MEASUREMENT lam_bank_1.cat_prev.lv_lamb_cop "boolean for catalyst overheating prevention" UBYTE _CNV_S_2_RANGE______2_CM 1 100. 0. 1. DISPLAY_IDENTIFIER LV_LAMB_COP_1 ECU_ADDRESS 0x3fc272 /end MEASUREMENT
/begin MEASUREMENT lam_bank_1.cat_prev.fac_cop "Inverse lambda depency of exhaust gas temperature model" UWORD _CNV_A_R_LINEAR_____20_CM 1 100. 0. 1.99996948 DISPLAY_IDENTIFIER FAC_COP_1 ECU_ADDRESS 0x3fc274 BYTE_ORDER MSB_LAST FORMAT "%7.5" /end MEASUREMENT
/begin MEASUREMENT lam_bank_1.cat_prev.teg_cop_sp "Temperature threshold for overhea protection" UWORD _CNV_A_R_LINEAR_____280_CM 1 100. -48. 1459.3 DISPLAY_IDENTIFIER TEG_COP_SP_1 ECU_ADDRESS 0x3fc278 BYTE_ORDER MSB_LAST FORMAT "%7.2" /end MEASUREMENT
/begin MEASUREMENT lam_bank_1.cat_prev.t_cop "Time catalyst overheat protection active" UBYTE _CNV_A_R_LINEAR_____279_CM 1 100. 0. 127.5 DISPLAY_IDENTIFIER T_COP_1 ECU_ADDRESS 0x3fc27a FORMAT "%5.1" /end MEASUREMENT
/begin MEASUREMENT lam_bank_1.lamb_rgn.lamb_rgn "lambda setpoint for catalyst regeneration" UWORD _CNV_A_R_LINEAR_____206_CM 1 100. 0. 31.99902344 DISPLAY_IDENTIFIER LAMB_RGN_1 ECU_ADDRESS 0x3fc314 BYTE_ORDER MSB_LAST FORMAT "%7.4" /end MEASUREMENT
/begin MEASUREMENT lam_bank_2.cat_prev.lamb_cop "lambda for catalyst overheating prevention" UWORD _CNV_A_R_LINEAR_____206_CM 1 100. 0. 31.99902344 DISPLAY_IDENTIFIER LAMB_COP_2 ECU_ADDRESS 0x3fc728 BYTE_ORDER MSB_LAST FORMAT "%7.4" /end MEASUREMENT
/begin MEASUREMENT lam_bank_2.cat_prev.lv_lamb_cop "boolean for catalyst overheating prevention" UBYTE _CNV_S_2_RANGE______2_CM 1 100. 0. 1. DISPLAY_IDENTIFIER LV_LAMB_COP_2 ECU_ADDRESS 0x3fc72a /end MEASUREMENT
/begin MEASUREMENT lam_bank_2.cat_prev.fac_cop "Inverse lambda depency of exhaust gas temperature model" UWORD _CNV_A_R_LINEAR_____20_CM 1 100. 0. 1.99996948 DISPLAY_IDENTIFIER FAC_COP_2 ECU_ADDRESS 0x3fc72c BYTE_ORDER MSB_LAST FORMAT "%7.5" /end MEASUREMENT
/begin MEASUREMENT lam_bank_2.cat_prev.teg_cop_sp "Temperature threshold for overhea protection" UWORD _CNV_A_R_LINEAR_____280_CM 1 100. -48. 1459.3 DISPLAY_IDENTIFIER TEG_COP_SP_2 ECU_ADDRESS 0x3fc730 BYTE_ORDER MSB_LAST FORMAT "%7.2" /end MEASUREMENT
/begin MEASUREMENT lam_bank_2.cat_prev.t_cop "Time catalyst overheat protection active" UBYTE _CNV_A_R_LINEAR_____279_CM 1 100. 0. 127.5 DISPLAY_IDENTIFIER T_COP_2 ECU_ADDRESS 0x3fc732 FORMAT "%5.1" /end MEASUREMENT
/begin MEASUREMENT lam_bank_2.lamb_rgn.lamb_rgn "lambda setpoint for catalyst regeneration" UWORD _CNV_A_R_LINEAR_____206_CM 1 100. 0. 31.99902344 DISPLAY_IDENTIFIER LAMB_RGN_2 ECU_ADDRESS 0x3fc7cc BYTE_ORDER MSB_LAST FORMAT "%7.4" /end MEASUREMENT
/begin MEASUREMENT lv_lamb_rgn_fac_sens "Flag determining the mode of lambda variation" UBYTE _CNV_S_2_RANGE______21_CM 1 100. 0. 1. DISPLAY_IDENTIFIER LV_LAMB_RGN_FAC_SENS ECU_ADDRESS 0x3fe53e BIT_MASK 0x1 /end MEASUREMENT
/begin CHARACTERISTIC lc_lamb_rgn_fac_sens "Logical constant determining the mode of lambda correction" VALUE 0xffe40f94 _REC_VAL_20_u1 1. _CNV_S_2_RANGE______2_CM 0. 1. DISPLAY_IDENTIFIER LC_LAMB_RGN_FAC_SENS /end CHARACTERISTIC
/begin CHARACTERISTIC ip_lamb_rgn_afr__maf__n_32 "lambda setpoint for catalyst regeneration" MAP 0xffe4c9ee _REC_MAP_20_u2_u1_u1 31.99902344 _CNV_A_R_LINEAR_____206_CM 0. 31.99902344 DISPLAY_IDENTIFIER IP_LAMB_RGN_AFR__MAF__N_32 FORMAT "%7.4"
 /begin AXIS_DESCR COM_AXIS maf _CNV_A_R_LINEAR_____27_CM 8 0. 1389. FORMAT "%4.0" AXIS_PTS_REF ldp_maf_ip_lamb_rgn_afr /end AXIS_DESCR
 /begin AXIS_DESCR COM_AXIS n_32 _CNV_A_R_LINEAR_____15_CM 8 0. 8160. FORMAT "%4.0" AXIS_PTS_REF ldp_n_32_ip_lamb_rgn_afr /end AXIS_DESCR
/end CHARACTERISTIC
/begin CHARACTERISTIC ip_lamb_rgn_fac_sens "lambda setpoint correction factor depending on sensor signal" CURVE 0xffe4ca7e _REC_CUR_20_u2_u2 0.99 _CNV_A_R_LINEAR_____349_CM 1. 1.99 DISPLAY_IDENTIFIER IP_LAMB_RGN_FAC_SENS FORMAT "%6.4"
 /begin AXIS_DESCR COM_AXIS online_dummy _CNV_A_R_LINEAR_____3_CM 8 0. 4.99511719 FORMAT "%5.3" AXIS_PTS_REF ldp_vls_down_ip_lamb_rgn /end AXIS_DESCR
/end CHARACTERISTIC
/begin CHARACTERISTIC ip_lamb_rgn_fac_mdl "lambda setpoint correction factor depending on remaining modelled loading" CURVE 0xffe4ca6e _REC_CUR_20_u2_u2 0.99 _CNV_A_R_LINEAR_____349_CM 1. 1.99 DISPLAY_IDENTIFIER IP_LAMB_RGN_FAC_MDL FORMAT "%6.4"
 /begin AXIS_DESCR COM_AXIS ntl _CNV_A_R_LINEAR_____350_CM 8 0. 10485.6 FORMAT "%7.1" AXIS_PTS_REF ldp_ntl_ip_lamb_rgn_fac_mdl /end AXIS_DESCR
/end CHARACTERISTIC
/begin CHARACTERISTIC c_lamb_rgn_pas "passive value for catalyst regeneration" VALUE 0xffe416da _REC_VAL_20_u2 31.99902344 _CNV_A_R_LINEAR_____206_CM 0. 31.99902344 DISPLAY_IDENTIFIER C_LAMB_RGN_PAS FORMAT "%7.4" /end CHARACTERISTIC
/begin CHARACTERISTIC c_lamb_rgn_max "maximum value for regeneration lambda value" VALUE 0xffe416d8 _REC_VAL_20_u2 31.99902344 _CNV_A_R_LINEAR_____206_CM 0. 31.99902344 DISPLAY_IDENTIFIER C_LAMB_RGN_MAX FORMAT "%7.4" /end CHARACTERISTIC
/begin CHARACTERISTIC c_t_rgn_lamb_con "time to stay on base map lambda value" VALUE 0xffe419ee _REC_VAL_20_u2 655.35 _CNV_A_R_LINEAR_____4_CM 0. 655.35 DISPLAY_IDENTIFIER C_T_RGN_LAMB_CON FORMAT "%6.2" /end CHARACTERISTIC
/begin MEASUREMENT t_rgn "Time counter for active regeneration" UWORD _CNV_A_R_LINEAR_____4_CM 1 100. 0. 655.35 DISPLAY_IDENTIFIER T_RGN ECU_ADDRESS 0x3fd4b6 BYTE_ORDER MSB_LAST FORMAT "%5.2" /end MEASUREMENT
/begin AXIS_PTS ldp_ntl_ip_lamb_rgn_fac_mdl "" 0xffe51164 ntl _REC_AXS_20_u2 10485.6 _CNV_A_R_LINEAR_____350_CM 8 0. 10485.6 DISPLAY_IDENTIFIER LDP_NTL_IP_LAMB_RGN_FAC_MDL FORMAT "%7.1" /end AXIS_PTS
/begin AXIS_PTS ldp_vls_down_ip_lamb_rgn "" 0xffe516a2 online_dummy _REC_AXS_20_u2 4.99511719 _CNV_A_R_LINEAR_____3_CM 8 0. 4.99511719 DISPLAY_IDENTIFIER LDP_VLS_DOWN_IP_LAMB_RGN FORMAT "%5.3" /end AXIS_PTS
/begin AXIS_PTS ldp_n_32_ip_lamb_rgn_afr "" 0xffe480d9 n_32 _REC_AXS_20_u1 8160. _CNV_A_R_LINEAR_____15_CM 8 0. 8160. DISPLAY_IDENTIFIER LDP_N_32_IP_LAMB_RGN_AFR FORMAT "%4.0" /end AXIS_PTS
/begin AXIS_PTS ldp_maf_ip_lamb_rgn_afr "" 0xffe47fca maf _REC_AXS_20_u1 1389. _CNV_A_R_LINEAR_____27_CM 8 0. 1389. DISPLAY_IDENTIFIER LDP_MAF_IP_LAMB_RGN_AFR FORMAT "%4.0" /end AXIS_PTS
/begin MEASUREMENT lamb_sawup "Basis lambda (pre-control)" UWORD _CNV_A_R_LINEAR_____206_CM 1 100. 0. 31.99902344 DISPLAY_IDENTIFIER LAMB_SAWUP ECU_ADDRESS 0x3fd4b8 BYTE_ORDER MSB_LAST FORMAT "%7.4" /end MEASUREMENT
/begin MEASUREMENT fac_lamb_de_sa "Lambda deviation through secondary air" UWORD _CNV_A_R_LINEAR_____272_CM 1 100. 0. 3.999939 DISPLAY_IDENTIFIER FAC_LAMB_DE_SA ECU_ADDRESS 0x3fd4ba BYTE_ORDER MSB_LAST FORMAT "%7.5" /end MEASUREMENT
/begin MEASUREMENT lamb_sa_ch "Lambda for secondary air catalyst heating" UWORD _CNV_A_R_LINEAR_____206_CM 1 100. 0. 31.99902344 DISPLAY_IDENTIFIER LAMB_SA_CH ECU_ADDRESS 0x3fd4bc BYTE_ORDER MSB_LAST FORMAT "%7.4" /end MEASUREMENT
/begin CHARACTERISTIC ip_lamb_sawup "basic lambda correction for rich catalyst heating" MAP 0xffe4ca8e _REC_MAP_20_u2_u2_u1 31.99902344 _CNV_A_R_LINEAR_____206_CM 0. 31.99902344 DISPLAY_IDENTIFIER IP_LAMB_SAWUP FORMAT "%7.4"
 /begin AXIS_DESCR COM_AXIS tqi_req_slow _CNV_A_R_LINEAR_____187_CM 8 -1024. 1023.96875 FORMAT "%6.2" AXIS_PTS_REF ldp_tqi_req_slow__lamb_sawup /end AXIS_DESCR
 /begin AXIS_DESCR COM_AXIS n_32 _CNV_A_R_LINEAR_____15_CM 8 0. 8160. FORMAT "%4.0" AXIS_PTS_REF ldp_n_32__lamb_sawup /end AXIS_DESCR
/end CHARACTERISTIC
/begin CHARACTERISTIC ip_lamb_sawup_is "basic lambda correction for rich catalyst heating during idle speed" MAP 0xffe4cb0e _REC_MAP_20_u2_u2_u1 31.99902344 _CNV_A_R_LINEAR_____206_CM 0. 31.99902344 DISPLAY_IDENTIFIER IP_LAMB_SAWUP_IS FORMAT "%7.4"
 /begin AXIS_DESCR COM_AXIS tqi_req_slow _CNV_A_R_LINEAR_____187_CM 8 -1024. 1023.96875 FORMAT "%6.2" AXIS_PTS_REF ldp_tqi_req_slow__lamb_sawup_is /end AXIS_DESCR
 /begin AXIS_DESCR COM_AXIS n_32 _CNV_A_R_LINEAR_____15_CM 8 0. 8160. FORMAT "%4.0" AXIS_PTS_REF ldp_n_32__lamb_sawup_is /end AXIS_DESCR
/end CHARACTERISTIC
/begin CHARACTERISTIC ip_lamb_add_sawup "additive correction of the basic lambda heating correction" MAP 0xffe4c382 _REC_MAP_20_u2_u2_u1 63.99902344 _CNV_A_R_LINEAR_____277_CM -32. 31.99902344 DISPLAY_IDENTIFIER IP_LAMB_ADD_SAWUP FORMAT "%8.4"
 /begin AXIS_DESCR COM_AXIS t_ast _CNV_A_R_LINEAR_____24_CM 8 0. 6553.5 FORMAT "%6.1" AXIS_PTS_REF ldp_t_ast__lamb_add_sawup /end AXIS_DESCR
 /begin AXIS_DESCR COM_AXIS tco _CNV_A_R_LINEAR_____11_CM 8 -48. 142.5 FORMAT "%5.1" AXIS_PTS_REF ldp_tco__lamb_add_sawup /end AXIS_DESCR
/end CHARACTERISTIC
/begin CHARACTERISTIC lc_sa_swi_cmb "Logical constant to switch between Lambda-combustion / Lambda pre-cat" VALUE 0xffe40fd3 _REC_VAL_20_u1 1. _CNV_A_R_LINEAR_____0_CM 0. 1. DISPLAY_IDENTIFIER LC_SA_SWI_CMB FORMAT "%2.0" /end CHARACTERISTIC
/begin AXIS_PTS ldp_tqi_req_slow__lamb_sawup "" 0xffe514dc tqi_req_slow _REC_AXS_20_u2 2047.96875 _CNV_A_R_LINEAR_____187_CM 8 -1024. 1023.96875 DISPLAY_IDENTIFIER LDP_TQI_REQ_SLOW__LAMB_SAWUP FORMAT "%6.2" /end AXIS_PTS
/begin AXIS_PTS ldp_tqi_req_slow__lamb_sawup_is "" 0xffe514ee tqi_req_slow _REC_AXS_20_u2 2047.96875 _CNV_A_R_LINEAR_____187_CM 8 -1024. 1023.96875 DISPLAY_IDENTIFIER LDP_TQI_REQ_SLOW__LAMB_SAWUP_IS FORMAT "%6.2" /end AXIS_PTS
/begin AXIS_PTS ldp_n_32__lamb_sawup "" 0xffe4805c n_32 _REC_AXS_20_u1 8160. _CNV_A_R_LINEAR_____15_CM 8 0. 8160. DISPLAY_IDENTIFIER LDP_N_32__LAMB_SAWUP FORMAT "%4.0" /end AXIS_PTS
/begin AXIS_PTS ldp_n_32__lamb_sawup_is "" 0xffe48065 n_32 _REC_AXS_20_u1 8160. _CNV_A_R_LINEAR_____15_CM 8 0. 8160. DISPLAY_IDENTIFIER LDP_N_32__LAMB_SAWUP_IS FORMAT "%4.0" /end AXIS_PTS
/begin AXIS_PTS ldp_t_ast__lamb_add_sawup "" 0xffe512a0 t_ast _REC_AXS_20_u2 6553.5 _CNV_A_R_LINEAR_____24_CM 8 0. 6553.5 DISPLAY_IDENTIFIER LDP_T_AST__LAMB_ADD_SAWUP FORMAT "%6.1" /end AXIS_PTS
/begin AXIS_PTS ldp_tco__lamb_add_sawup "" 0xffe481d4 tco _REC_AXS_20_u1 190.5 _CNV_A_R_LINEAR_____11_CM 8 -48. 142.5 DISPLAY_IDENTIFIER LDP_TCO__LAMB_ADD_SAWUP FORMAT "%5.1" /end AXIS_PTS
/begin MEASUREMENT lamb_sp_sa_eol "Lambda for secondary air EOL test" UWORD _CNV_A_R_LINEAR_____206_CM 1 100. 0. 31.99902344 DISPLAY_IDENTIFIER LAMB_SP_SA_EOL ECU_ADDRESS 0x3fd4be BYTE_ORDER MSB_LAST FORMAT "%7.4" /end MEASUREMENT
/begin CHARACTERISTIC c_lamb_sp_sa_eol "Lambda setpoint for EOL test" VALUE 0xffe416f4 _REC_VAL_20_u2 31.99902344 _CNV_A_R_LINEAR_____206_CM 0. 31.99902344 DISPLAY_IDENTIFIER C_LAMB_SP_SA_EOL FORMAT "%7.4" /end CHARACTERISTIC
/begin MEASUREMENT lamb_ratio "Current Lambda ratio for interpolation factor" UWORD _CNV_A_R_LINEAR_____275_CM 1 100. -2. 2. DISPLAY_IDENTIFIER LAMB_RATIO ECU_ADDRESS 0x3fd35a BYTE_ORDER MSB_LAST FORMAT "%8.5" /end MEASUREMENT
/begin CHARACTERISTIC ip_lamb_iga_afl__n_32__maf_hb "Lambda map for interpolation on ignition angle corrected with maps IGA_xxx_AFL" MAP 0xffe4c81a _REC_MAP_20_u2_u1_u1 31.99902344 _CNV_A_R_LINEAR_____206_CM 0. 31.99902344 DISPLAY_IDENTIFIER IP_LAMB_IGA_AFL__N_32__MAF_HB FORMAT "%7.4"
 /begin AXIS_DESCR COM_AXIS n_32 _CNV_A_R_LINEAR_____15_CM 16 0. 8160. FORMAT "%4.0" AXIS_PTS_REF ldp_n_32__lamb_iga_afl /end AXIS_DESCR
 /begin AXIS_DESCR COM_AXIS maf _CNV_A_R_LINEAR_____27_CM 12 0. 1389. FORMAT "%4.0" AXIS_PTS_REF ldp_maf_hb__lamb_iga_afl /end AXIS_DESCR
/end CHARACTERISTIC
/begin CHARACTERISTIC c_lamb_iga_afr "Lambdavalue for ignition angle interpolation correlated with maps IP_IGA_xxx_AFR" VALUE 0xffe416b6 _REC_VAL_20_u2 31.99902344 _CNV_A_R_LINEAR_____206_CM 0. 31.99902344 DISPLAY_IDENTIFIER C_LAMB_IGA_AFR FORMAT "%7.4" /end CHARACTERISTIC
/begin AXIS_PTS ldp_n_32__lamb_iga_afl "" 0xffe4804b n_32 _REC_AXS_20_u1 8160. _CNV_A_R_LINEAR_____15_CM 16 0. 8160. DISPLAY_IDENTIFIER LDP_N_32__LAMB_IGA_AFL FORMAT "%4.0" /end AXIS_PTS
/begin AXIS_PTS ldp_maf_hb__lamb_iga_afl "" 0xffe47fbd maf _REC_AXS_20_u1 1389. _CNV_A_R_LINEAR_____27_CM 12 0. 1389. DISPLAY_IDENTIFIER LDP_MAF_HB__LAMB_IGA_AFL FORMAT "%4.0" /end AXIS_PTS
/begin MEASUREMENT tqi_sp_mff "Engine torque in stratified combustion for injection setpoint." SWORD _CNV_A_R_LINEAR_____55_CM 1 100. -1024. 1023.96875 DISPLAY_IDENTIFIER TQI_SP_MFF ECU_ADDRESS 0x3fd92a BYTE_ORDER MSB_LAST FORMAT "%8.2" /end MEASUREMENT
/begin MEASUREMENT tqi_sp_mff_1 "Engine torque in stratified combustion for injection setpoint before manual switch." UWORD _CNV_A_R_LINEAR_____55_CM 1 100. 0. 1023.96875 DISPLAY_IDENTIFIER TQI_SP_MFF_1 ECU_ADDRESS 0x3fd92c BYTE_ORDER MSB_LAST FORMAT "%7.2" /end MEASUREMENT
/begin MEASUREMENT mff_sp_s_1 "fuel mass flow setpoint intermitted value for stratified mode" UWORD _CNV_A_R_LINEAR_____108_CM 1 100. 0. 1389. DISPLAY_IDENTIFIER MFF_SP_S_1 ECU_ADDRESS 0x3fd928 BYTE_ORDER MSB_LAST FORMAT "%7.2" /end MEASUREMENT
/begin MEASUREMENT mff_sp_s "Fuel mass in stratified combustion." UWORD _CNV_A_R_LINEAR_____108_CM 1 100. 0. 1389. DISPLAY_IDENTIFIER MFF_SP_S ECU_ADDRESS 0x3fd924 BYTE_ORDER MSB_LAST FORMAT "%7.2" /end MEASUREMENT
/begin MEASUREMENT mff_sp_s_eng "calculated mass fuel flow output for canister purge" UWORD _CNV_A_R_LINEAR_____108_CM 1 100. 0. 1389. DISPLAY_IDENTIFIER MFF_SP_S_ENG ECU_ADDRESS 0x3fd926 BYTE_ORDER MSB_LAST FORMAT "%7.2" /end MEASUREMENT
/begin MEASUREMENT eff_tot_bas_s "Total basic efficiency for stratified mode" UWORD _CNV_A_R_LINEAR_____20_CM 1 100. 0. 1.99996948 DISPLAY_IDENTIFIER EFF_TOT_BAS_S ECU_ADDRESS 0x3fd92e BYTE_ORDER MSB_LAST FORMAT "%7.5" /end MEASUREMENT
/begin CHARACTERISTIC ip_mff_sp_s "Fuel mass stratified mode" MAP 0xffe4d46a _REC_MAP_20_u2_u1_u2 1389. _CNV_A_R_LINEAR_____108_CM 0. 1389. DISPLAY_IDENTIFIER IP_MFF_SP_S FORMAT "%7.2"
 /begin AXIS_DESCR COM_AXIS n_32 _CNV_A_R_LINEAR_____15_CM 16 0. 8160. FORMAT "%4.0" AXIS_PTS_REF ldpm_n_32_s /end AXIS_DESCR
 /begin AXIS_DESCR COM_AXIS tqi_sp_mff _CNV_A_R_LINEAR_____55_CM 12 0. 1023.96875 FORMAT "%7.2" AXIS_PTS_REF ldpm_tqi_sp_mff_s /end AXIS_DESCR
/end CHARACTERISTIC
/begin CHARACTERISTIC lc_tqi_sp_mff_man_act "Logiacl constant for manual torque-switch" VALUE 0xffe41002 _REC_VAL_20_u1 1. _CNV_A_R_LINEAR_____0_CM 0. 1. DISPLAY_IDENTIFIER LC_TQI_SP_MFF_MAN_ACT FORMAT "%2.0" /end CHARACTERISTIC
/begin CHARACTERISTIC c_tqi_sp_mff_man "manual torque switch value" VALUE 0xffe41aea _REC_VAL_20_u2 1023.96875 _CNV_A_R_LINEAR_____55_CM 0. 1023.96875 DISPLAY_IDENTIFIER C_TQI_SP_MFF_MAN FORMAT "%7.2" /end CHARACTERISTIC
/begin CHARACTERISTIC lc_mff_sp_s_man_act "Logical constant for manual MFF-switch" VALUE 0xffe40fab _REC_VAL_20_u1 1. _CNV_A_R_LINEAR_____0_CM 0. 1. DISPLAY_IDENTIFIER LC_MFF_SP_S_MAN_ACT FORMAT "%2.0" /end CHARACTERISTIC
/begin CHARACTERISTIC c_mff_sp_s_man "Manual fuel mass flow setpoint for stratified mode" VALUE 0xffe417dc _REC_VAL_20_u2 1389. _CNV_A_R_LINEAR_____108_CM 0. 1389. DISPLAY_IDENTIFIER C_MFF_SP_S_MAN FORMAT "%7.2" /end CHARACTERISTIC
/begin CHARACTERISTIC c_mff_sp_s_ofs_as "Manual fuel mass flow setpoint for application" VALUE 0xffe417de _REC_VAL_20_u2 1389. _CNV_A_R_LINEAR_____108_CM 0. 1389. DISPLAY_IDENTIFIER C_MFF_SP_S_OFS_AS FORMAT "%7.2" /end CHARACTERISTIC
/begin AXIS_PTS ldpm_tqi_sp_mff_s "" 0xffe51e68 tqi_sp_mff _REC_AXS_20_u2 1023.96875 _CNV_A_R_LINEAR_____55_CM 12 0. 1023.96875 DISPLAY_IDENTIFIER LDPM_TQI_SP_MFF_S FORMAT "%7.2" /end AXIS_PTS
/begin MEASUREMENT teg_1.gas_up_struct.teg_stat_eng_up "Exhaust temp. pre-control pre catalyst" UWORD _CNV_A_R_LINEAR_____280_CM 1 100. -48. 1459.3 DISPLAY_IDENTIFIER TEG_STAT_ENG_UP_1 ECU_ADDRESS 0x3fcbfc BYTE_ORDER MSB_LAST FORMAT "%7.2" /end MEASUREMENT
/begin MEASUREMENT teg_1.gas_up_struct.teg_cor_eff_iga_up "Temp. correction power loss by ignition angle difference" UWORD _CNV_A_R_LINEAR_____468_CM 1 100. 0. 983.025 DISPLAY_IDENTIFIER TEG_COR_EFF_IGA_UP_1 ECU_ADDRESS 0x3fcc02 BYTE_ORDER MSB_LAST FORMAT "%6.2" /end MEASUREMENT
/begin MEASUREMENT teg_1.gas_up_struct.teg_stat_bas_up "Exhaust temp. based on load level pre-control pre catalyst" UWORD _CNV_A_R_LINEAR_____280_CM 1 100. -48. 1459.3 DISPLAY_IDENTIFIER TEG_STAT_BAS_UP_1 ECU_ADDRESS 0x3fcc00 BYTE_ORDER MSB_LAST FORMAT "%7.2" /end MEASUREMENT
/begin MEASUREMENT teg_1.gas_up_struct.eff_iga_av_teg_cor "Reference ignition angle for   temperature" UWORD _CNV_A_R_LINEAR_____20_CM 1 100. 0. 1.99996948 DISPLAY_IDENTIFIER EFF_IGA_AV_TEG_COR_1 ECU_ADDRESS 0x3fcc0a BYTE_ORDER MSB_LAST FORMAT "%7.5" /end MEASUREMENT
/begin MEASUREMENT teg_1.gas_up_struct.fac_scc_teg "Multipicative Single cylinder shut off correction" UWORD _CNV_A_R_LINEAR_____37_CM 1 100. 0. 0.99998474 DISPLAY_IDENTIFIER FAC_SCC_TEG_1 ECU_ADDRESS 0x3fcc06 BYTE_ORDER MSB_LAST FORMAT "%7.5" /end MEASUREMENT
/begin MEASUREMENT teg_1.gas_up_struct.fac_cor_lamb_sp_teg_up "Lambda set -point correction" UWORD _CNV_A_R_LINEAR_____20_CM 1 100. 0. 1.99996948 DISPLAY_IDENTIFIER FAC_COR_LAMB_SP_TEG_UP_1 ECU_ADDRESS 0x3fcc08 BYTE_ORDER MSB_LAST FORMAT "%7.5" /end MEASUREMENT
/begin MEASUREMENT teg_1.gas_up_struct.teg_stat_up "Pre control exhaust temperature  pre catalyst" UWORD _CNV_A_R_LINEAR_____280_CM 1 100. -48. 1459.3 DISPLAY_IDENTIFIER TEG_STAT_UP_1 ECU_ADDRESS 0x3fcc0c BYTE_ORDER MSB_LAST FORMAT "%7.2" /end MEASUREMENT
/begin MEASUREMENT teg_1.gas_up_struct.teg_cat_up_mdl_bas "Model of exhaust temperature pre catalyst" UWORD _CNV_A_R_LINEAR_____280_CM 1 100. -48. 1459.3 DISPLAY_IDENTIFIER TEG_CAT_UP_MDL_1_BAS ECU_ADDRESS 0x3fcc16 BYTE_ORDER MSB_LAST FORMAT "%7.2" /end MEASUREMENT
/begin MEASUREMENT teg_1.gas_up_struct.teg_dif_up "Difference between steady to model temperature pre catalyst" UWORD _CNV_A_R_LINEAR_____469_CM 1 100. -1507.328 1507.282 DISPLAY_IDENTIFIER TEG_DIF_UP_1 ECU_ADDRESS 0x3fcc18 BYTE_ORDER MSB_LAST FORMAT "%8.2" /end MEASUREMENT
/begin MEASUREMENT teg_1.gas_up_struct.teg_cat_up_mdl_stop "Model of exhaust temperature pre catalyst" UWORD _CNV_A_R_LINEAR_____280_CM 1 100. -48. 1459.3 DISPLAY_IDENTIFIER TEG_CAT_UP_MDL_STOP_1 ECU_ADDRESS 0x3fcc30 BYTE_ORDER MSB_LAST FORMAT "%7.2" /end MEASUREMENT
/begin MEASUREMENT teg_1.gas_up_struct.crlc_teg_grad_up "Exhaust Temperature gradient" UWORD _CNV_A_R_LINEAR_____394_CM 1 100. 0. 7.99987793 DISPLAY_IDENTIFIER CRLC_TEG_GRAD_UP_1 ECU_ADDRESS 0x3fcc1a BYTE_ORDER MSB_LAST FORMAT "%6.4" /end MEASUREMENT
/begin MEASUREMENT teg_1.gas_up_struct.crlc_teg_level_up "Exhaust temperature level" UWORD _CNV_A_R_LINEAR_____394_CM 1 100. 0. 7.99987793 DISPLAY_IDENTIFIER CRLC_TEG_LEVEL_UP_1 ECU_ADDRESS 0x3fcc1c BYTE_ORDER MSB_LAST FORMAT "%6.4" /end MEASUREMENT
/begin MEASUREMENT teg_1.gas_up_struct.crlc_teg_up "Entire correlation constant of TEG dynamic change limitation" UWORD _CNV_A_R_LINEAR_____37_CM 1 100. 0. 0.99998474 DISPLAY_IDENTIFIER CRLC_TEG_UP_1 ECU_ADDRESS 0x3fcc20 BYTE_ORDER MSB_LAST FORMAT "%7.5" /end MEASUREMENT
/begin MEASUREMENT teg_1.gas_up_struct.crlc_teg_toil_tco_up "Corelation constant received at TCO TOIL calculation" UWORD _CNV_A_R_LINEAR_____37_CM 1 100. 0. 0.99998474 DISPLAY_IDENTIFIER CRLC_TEG_TOIL_TCO_UP_1 ECU_ADDRESS 0x3fcc22 BYTE_ORDER MSB_LAST FORMAT "%7.5" /end MEASUREMENT
/begin MEASUREMENT teg_1.gas_up_struct.crlc_teg_egy_up "Corelation constant received at energy calculation" UWORD _CNV_A_R_LINEAR_____394_CM 1 100. 0. 7.99987793 DISPLAY_IDENTIFIER CRLC_TEG_EGY_UP_1 ECU_ADDRESS 0x3fcc24 BYTE_ORDER MSB_LAST FORMAT "%6.4" /end MEASUREMENT
/begin MEASUREMENT teg_1.gas_up_struct.egy_teg_end_sp_up "Energy setpoint  for Temperature Model beginning from start" ULONG _CNV_A_R_LINEAR_____470_CM 1 100. 0. 7456.426 DISPLAY_IDENTIFIER EGY_TEG_END_SP_UP_1 ECU_ADDRESS 0x3fcc28 BYTE_ORDER MSB_LAST FORMAT "%12.7" /end MEASUREMENT
/begin MEASUREMENT teg_1.gas_up_struct.egy_teg_end_av_up "Actual value Energy for Temperature Model beginning from start" ULONG _CNV_A_R_LINEAR_____470_CM 1 100. 0. 7456.426 DISPLAY_IDENTIFIER EGY_TEG_END_AV_UP_1 ECU_ADDRESS 0x3fcc2c BYTE_ORDER MSB_LAST FORMAT "%12.7" /end MEASUREMENT
/begin MEASUREMENT teg_1.gas_up_struct.lv_teg_ast_up "Temperature model after start condition" UBYTE _CNV_S_2_RANGE______21_CM 1 100. 0. 1. DISPLAY_IDENTIFIER LV_TEG_AST_UP_1 ECU_ADDRESS 0x3fcc26 /end MEASUREMENT
/begin MEASUREMENT teg_1.gas_up_struct.crlc_teg_bas_up "Entire correlation constant of TEG dynamic change limitation" UWORD _CNV_A_R_LINEAR_____37_CM 1 100. 0. 0.99998474 DISPLAY_IDENTIFIER CRLC_TEG_BAS_UP_1 ECU_ADDRESS 0x3fcc1e BYTE_ORDER MSB_LAST FORMAT "%7.5" /end MEASUREMENT
/begin MEASUREMENT teg_1.gas_up_struct.teg_add_egr_up "EGR influence temperature" UWORD _CNV_A_R_LINEAR_____471_CM 1 100. -491.52 491.505 DISPLAY_IDENTIFIER TEG_ADD_EGR_UP_1 ECU_ADDRESS 0x3fcbfe BYTE_ORDER MSB_LAST FORMAT "%7.2" /end MEASUREMENT
/begin MEASUREMENT teg_1.gas_up_struct.teg_cor_veh_up "Entire vehicle influences correction" SWORD _CNV_A_R_LINEAR_____472_CM 1 100. -491.519999999553 491.5 DISPLAY_IDENTIFIER TEG_COR_VEH_UP_1 ECU_ADDRESS 0x3fcc0e BYTE_ORDER MSB_LAST FORMAT "%7.2" /end MEASUREMENT
/begin MEASUREMENT teg_1.gas_up_struct.teg_cor_tco_ex_up "Cooling temperature outlet correction" SWORD _CNV_A_R_LINEAR_____473_CM 1 100. -202. 202. DISPLAY_IDENTIFIER TEG_COR_TCO_EX_UP_1 ECU_ADDRESS 0x3fcc12 BYTE_ORDER MSB_LAST FORMAT "%7.3" /end MEASUREMENT
/begin MEASUREMENT teg_1.gas_up_struct.fac_cor_vs_teg_up "Vehicle speed correction" SWORD _CNV_A_R_LINEAR_____276_CM 1 100. -2. 1.999938965 DISPLAY_IDENTIFIER FAC_COR_VS_TEG_UP_1 ECU_ADDRESS 0x3fcc10 BYTE_ORDER MSB_LAST FORMAT "%8.4" /end MEASUREMENT
/begin MEASUREMENT teg_1.gas_up_struct.teg_scc_tco_up "Additive single cyl. shut off temp. correction" UBYTE _CNV_A_R_LINEAR_____11_CM 1 100. -48. 142.5 DISPLAY_IDENTIFIER TEG_SCC_TCO_UP_1 ECU_ADDRESS 0x3fcc04 FORMAT "%5.1" /end MEASUREMENT
/begin MEASUREMENT teg_1.gas_up_struct.vs_cor_ecf_teg_up "Electric cooling fan correction" UBYTE _CNV_A_R_LINEAR_____23_CM 1 100. 0. 255. DISPLAY_IDENTIFIER VS_COR_ECF_TEG_UP_1 ECU_ADDRESS 0x3fcc14 FORMAT "%3.0" /end MEASUREMENT
/begin MEASUREMENT teg_1.gas_up_struct.vs_cor_teg_up "VS temperature correction" UBYTE _CNV_A_R_LINEAR_____23_CM 1 100. 0. 255. DISPLAY_IDENTIFIER VS_COR_TEG_UP_1 ECU_ADDRESS 0x3fcc15 FORMAT "%3.0" /end MEASUREMENT
/begin MEASUREMENT teg_1.gas_down_struct.teg_stat_eng_down "Exhaust temp. pre-control pre catalyst" UWORD _CNV_A_R_LINEAR_____280_CM 1 100. -48. 1459.3 DISPLAY_IDENTIFIER TEG_STAT_ENG_DOWN_1 ECU_ADDRESS 0x3fcc38 BYTE_ORDER MSB_LAST FORMAT "%7.2" /end MEASUREMENT
/begin MEASUREMENT teg_1.gas_down_struct.teg_stat_bas_down "Exhaust temp. based on load level pre-control pre catalyst" UWORD _CNV_A_R_LINEAR_____280_CM 1 100. -48. 1459.3 DISPLAY_IDENTIFIER TEG_STAT_BAS_DOWN_1 ECU_ADDRESS 0x3fcc3a BYTE_ORDER MSB_LAST FORMAT "%7.2" /end MEASUREMENT
/begin MEASUREMENT teg_1.gas_down_struct.fac_cor_lamb_sp_teg_down "Lambda set -point correction" UWORD _CNV_A_R_LINEAR_____20_CM 1 100. 0. 1.99996948 DISPLAY_IDENTIFIER FAC_COR_LAMB_SP_TEG_DOWN_1 ECU_ADDRESS 0x3fcc3e BYTE_ORDER MSB_LAST FORMAT "%7.5" /end MEASUREMENT
/begin MEASUREMENT teg_1.gas_down_struct.teg_stat_down "Pre control exhaust temperature  pre catalyst" UWORD _CNV_A_R_LINEAR_____280_CM 1 100. -48. 1459.3 DISPLAY_IDENTIFIER TEG_STAT_DOWN_1 ECU_ADDRESS 0x3fcc42 BYTE_ORDER MSB_LAST FORMAT "%7.2" /end MEASUREMENT
/begin MEASUREMENT teg_1.gas_down_struct.teg_cat_down_mdl_bas "Model of exhaust temperature pre catalyst" UWORD _CNV_A_R_LINEAR_____280_CM 1 100. -48. 1459.3 DISPLAY_IDENTIFIER TEG_CAT_DOWN_MDL_1_BAS ECU_ADDRESS 0x3fcc4c BYTE_ORDER MSB_LAST FORMAT "%7.2" /end MEASUREMENT
/begin MEASUREMENT teg_1.gas_down_struct.teg_dif_down "Difference between steady to model temperature pre catalyst" UWORD _CNV_A_R_LINEAR_____469_CM 1 100. -1507.328 1507.282 DISPLAY_IDENTIFIER TEG_DIF_DOWN_1 ECU_ADDRESS 0x3fcc4e BYTE_ORDER MSB_LAST FORMAT "%8.2" /end MEASUREMENT
/begin MEASUREMENT teg_1.gas_down_struct.teg_cat_down_mdl_stop "Model of exhaust temperature pre catalyst" UWORD _CNV_A_R_LINEAR_____280_CM 1 100. -48. 1459.3 DISPLAY_IDENTIFIER TEG_CAT_DOWN_MDL_STOP_1 ECU_ADDRESS 0x3fcc68 BYTE_ORDER MSB_LAST FORMAT "%7.2" /end MEASUREMENT
/begin MEASUREMENT teg_1.gas_down_struct.crlc_teg_grad_down "Exhaust Temperature gradient" UWORD _CNV_A_R_LINEAR_____394_CM 1 100. 0. 7.99987793 DISPLAY_IDENTIFIER CRLC_TEG_GRAD_DOWN_1 ECU_ADDRESS 0x3fcc50 BYTE_ORDER MSB_LAST FORMAT "%6.4" /end MEASUREMENT
/begin MEASUREMENT teg_1.gas_down_struct.crlc_teg_level_down "Exhaust temperature level" UWORD _CNV_A_R_LINEAR_____394_CM 1 100. 0. 7.99987793 DISPLAY_IDENTIFIER CRLC_TEG_LEVEL_DOWN_1 ECU_ADDRESS 0x3fcc52 BYTE_ORDER MSB_LAST FORMAT "%6.4" /end MEASUREMENT
/begin MEASUREMENT teg_1.gas_down_struct.crlc_teg_down "Entire correlation constant of TEG dynamic change limitation" UWORD _CNV_A_R_LINEAR_____37_CM 1 100. 0. 0.99998474 DISPLAY_IDENTIFIER CRLC_TEG_DOWN_1 ECU_ADDRESS 0x3fcc56 BYTE_ORDER MSB_LAST FORMAT "%7.5" /end MEASUREMENT
/begin MEASUREMENT teg_1.gas_down_struct.crlc_teg_toil_tco_down "Corelation constant received at TCO TOIL calculation" UWORD _CNV_A_R_LINEAR_____37_CM 1 100. 0. 0.99998474 DISPLAY_IDENTIFIER CRLC_TEG_TOIL_TCO_DOWN_1 ECU_ADDRESS 0x3fcc58 BYTE_ORDER MSB_LAST FORMAT "%7.5" /end MEASUREMENT
/begin MEASUREMENT teg_1.gas_down_struct.crlc_teg_egy_down "Corelation constant received at energy calculation" UWORD _CNV_A_R_LINEAR_____394_CM 1 100. 0. 7.99987793 DISPLAY_IDENTIFIER CRLC_TEG_EGY_DOWN_1 ECU_ADDRESS 0x3fcc5a BYTE_ORDER MSB_LAST FORMAT "%6.4" /end MEASUREMENT
/begin MEASUREMENT teg_1.gas_down_struct.egy_teg_end_sp_down "Energy setpoint  for Temperature Model beginning from start" ULONG _CNV_A_R_LINEAR_____470_CM 1 100. 0. 7456.426 DISPLAY_IDENTIFIER EGY_TEG_END_SP_DOWN_1 ECU_ADDRESS 0x3fcc60 BYTE_ORDER MSB_LAST FORMAT "%12.7" /end MEASUREMENT
/begin MEASUREMENT teg_1.gas_down_struct.egy_teg_end_av_down "Actual value Energy for Temperature Model beginning from start" ULONG _CNV_A_R_LINEAR_____470_CM 1 100. 0. 7456.426 DISPLAY_IDENTIFIER EGY_TEG_END_AV_DOWN_1 ECU_ADDRESS 0x3fcc64 BYTE_ORDER MSB_LAST FORMAT "%12.7" /end MEASUREMENT
/begin MEASUREMENT teg_1.gas_down_struct.lv_teg_ast_down "Temperature model after start condition" UBYTE _CNV_S_2_RANGE______21_CM 1 100. 0. 1. DISPLAY_IDENTIFIER LV_TEG_AST_DOWN_1 ECU_ADDRESS 0x3fcc5c /end MEASUREMENT
/begin MEASUREMENT teg_1.gas_down_struct.crlc_teg_bas_down "Entire correlation constant of TEG dynamic change limitation" UWORD _CNV_A_R_LINEAR_____37_CM 1 100. 0. 0.99998474 DISPLAY_IDENTIFIER CRLC_TEG_BAS_DOWN_1 ECU_ADDRESS 0x3fcc54 BYTE_ORDER MSB_LAST FORMAT "%7.5" /end MEASUREMENT
/begin MEASUREMENT teg_1.gas_down_struct.teg_cor_eff_iga_down "Temp. correction power loss by ignition angle difference" UWORD _CNV_A_R_LINEAR_____468_CM 1 100. 0. 983.025 DISPLAY_IDENTIFIER TEG_COR_EFF_IGA_DOWN_1 ECU_ADDRESS 0x3fcc3c BYTE_ORDER MSB_LAST FORMAT "%6.2" /end MEASUREMENT
/begin MEASUREMENT teg_1.gas_down_struct.teg_scc_tco_down "Additive Single cylinder shut off temp. correction" UBYTE _CNV_A_R_LINEAR_____11_CM 1 100. -48. 142.5 DISPLAY_IDENTIFIER TEG_SCC_TCO_DOWN_1 ECU_ADDRESS 0x3fcc40 FORMAT "%5.1" /end MEASUREMENT
/begin MEASUREMENT teg_1.gas_down_struct.teg_cor_veh_down "Entire vehicle influences correction" SWORD _CNV_A_R_LINEAR_____472_CM 1 100. -491.519999999553 491.5 DISPLAY_IDENTIFIER TEG_COR_VEH_DOWN_1 ECU_ADDRESS 0x3fcc44 BYTE_ORDER MSB_LAST FORMAT "%7.2" /end MEASUREMENT
/begin MEASUREMENT teg_1.gas_down_struct.fac_cor_vs_teg_down "Vehicle speed correction" SWORD _CNV_A_R_LINEAR_____276_CM 1 100. -2. 1.999938965 DISPLAY_IDENTIFIER FAC_COR_VS_TEG_DOWN_1 ECU_ADDRESS 0x3fcc46 BYTE_ORDER MSB_LAST FORMAT "%8.4" /end MEASUREMENT
/begin MEASUREMENT teg_1.gas_down_struct.teg_cor_tco_ex_down "Cooling temperature outlet correction" SWORD _CNV_A_R_LINEAR_____473_CM 1 100. -202. 202. DISPLAY_IDENTIFIER TEG_COR_TCO_EX_DOWN_1 ECU_ADDRESS 0x3fcc48 BYTE_ORDER MSB_LAST FORMAT "%7.3" /end MEASUREMENT
/begin MEASUREMENT teg_1.gas_down_struct.vs_cor_ecf_teg_down "Vehicle speed correction ecf" UBYTE _CNV_A_R_LINEAR_____23_CM 1 100. 0. 255. DISPLAY_IDENTIFIER VS_COR_ECF_TEG_DOWN_1 ECU_ADDRESS 0x3fcc4a FORMAT "%3.0" /end MEASUREMENT
/begin MEASUREMENT teg_1.gas_down_struct.vs_cor_teg_down "Vehicle speed correction" UBYTE _CNV_A_R_LINEAR_____23_CM 1 100. 0. 255. DISPLAY_IDENTIFIER VS_COR_TEG_DOWN_1 ECU_ADDRESS 0x3fcc4b FORMAT "%3.0" /end MEASUREMENT
/begin MEASUREMENT teg_1.wall_up_struct.teg_wall_stat_bas_up "Exhaust temp. based on load level pre-control pre catalyst" UWORD _CNV_A_R_LINEAR_____280_CM 1 100. -48. 1459.3 DISPLAY_IDENTIFIER TEG_WALL_STAT_BAS_UP_1 ECU_ADDRESS 0x3fcc72 BYTE_ORDER MSB_LAST FORMAT "%7.2" /end MEASUREMENT
/begin MEASUREMENT teg_1.wall_up_struct.fac_scc_teg_wall "Multipicative Single cylinder shut off correction" UWORD _CNV_A_R_LINEAR_____37_CM 1 100. 0. 0.99998474 DISPLAY_IDENTIFIER FAC_SCC_TEG_WALL_1 ECU_ADDRESS 0x3fcc78 BYTE_ORDER MSB_LAST FORMAT "%7.5" /end MEASUREMENT
/begin MEASUREMENT teg_1.wall_up_struct.fac_cor_lamb_sp_teg_wall_up "Lambda set -point correction" UWORD _CNV_A_R_LINEAR_____20_CM 1 100. 0. 1.99996948 DISPLAY_IDENTIFIER FAC_COR_LAMB_SP_TEG_WALL_UP_1 ECU_ADDRESS 0x3fcc7a BYTE_ORDER MSB_LAST FORMAT "%7.5" /end MEASUREMENT
/begin MEASUREMENT teg_1.wall_up_struct.teg_wall_stat_up "Pre control exhaust temperature  pre catalyst" UWORD _CNV_A_R_LINEAR_____280_CM 1 100. -48. 1459.3 DISPLAY_IDENTIFIER TEG_WALL_STAT_UP_1 ECU_ADDRESS 0x3fcc7c BYTE_ORDER MSB_LAST FORMAT "%7.2" /end MEASUREMENT
/begin MEASUREMENT teg_1.wall_up_struct.teg_wall_cat_up_mdl "Model of exhaust temperature pre catalyst" UWORD _CNV_A_R_LINEAR_____280_CM 1 100. -48. 1459.3 DISPLAY_IDENTIFIER TEG_WALL_CAT_UP_MDL_1 ECU_ADDRESS 0x3fcc86 BYTE_ORDER MSB_LAST FORMAT "%7.2" /end MEASUREMENT
/begin MEASUREMENT teg_1.wall_up_struct.teg_wall_dif_up "Difference between steady to model temperature pre catalyst" UWORD _CNV_A_R_LINEAR_____469_CM 1 100. -1507.328 1507.282 DISPLAY_IDENTIFIER TEG_WALL_DIF_UP_1 ECU_ADDRESS 0x3fcc88 BYTE_ORDER MSB_LAST FORMAT "%8.2" /end MEASUREMENT
/begin MEASUREMENT teg_1.wall_up_struct.teg_wall_cat_up_mdl_stop "Model of exhaust temperature pre catalyst" UWORD _CNV_A_R_LINEAR_____280_CM 1 100. -48. 1459.3 DISPLAY_IDENTIFIER TEG_WALL_CAT_UP_MDL_STOP_1 ECU_ADDRESS 0x3fcc9c BYTE_ORDER MSB_LAST FORMAT "%7.2" /end MEASUREMENT
/begin MEASUREMENT teg_1.wall_up_struct.crlc_teg_wall_up "Entire correlation constant of TEG_WALL dynamic change limitation" UWORD _CNV_A_R_LINEAR_____37_CM 1 100. 0. 0.99998474 DISPLAY_IDENTIFIER CRLC_TEG_WALL_UP_1 ECU_ADDRESS 0x3fcc8c BYTE_ORDER MSB_LAST FORMAT "%7.5" /end MEASUREMENT
/begin MEASUREMENT teg_1.wall_up_struct.crlc_teg_wall_toil_tco_up "Corelation constant received at TCO TOIL calculation" UWORD _CNV_A_R_LINEAR_____37_CM 1 100. 0. 0.99998474 DISPLAY_IDENTIFIER CRLC_TEG_WALL_TOIL_TCO_UP_1 ECU_ADDRESS 0x3fcc8e BYTE_ORDER MSB_LAST FORMAT "%7.5" /end MEASUREMENT
/begin MEASUREMENT teg_1.wall_up_struct.crlc_teg_wall_egy_up "Corelation constant received at energy calculation" UWORD _CNV_A_R_LINEAR_____37_CM 1 100. 0. 0.99998474 DISPLAY_IDENTIFIER CRLC_TEG_WALL_EGY_UP_1 ECU_ADDRESS 0x3fcc90 BYTE_ORDER MSB_LAST FORMAT "%7.5" /end MEASUREMENT
/begin MEASUREMENT teg_1.wall_up_struct.egy_teg_wall_end_sp_up "Energy setpoint  for Temperature Model beginning from start" ULONG _CNV_A_R_LINEAR_____470_CM 1 100. 0. 7456.426 DISPLAY_IDENTIFIER EGY_TEG_WALL_END_SP_UP_1 ECU_ADDRESS 0x3fcc94 BYTE_ORDER MSB_LAST FORMAT "%12.7" /end MEASUREMENT
/begin MEASUREMENT teg_1.wall_up_struct.egy_teg_wall_end_av_up "Actual value Energy for Temperature Model beginning from start" ULONG _CNV_A_R_LINEAR_____470_CM 1 100. 0. 7456.426 DISPLAY_IDENTIFIER EGY_TEG_WALL_END_AV_UP_1 ECU_ADDRESS 0x3fcc98 BYTE_ORDER MSB_LAST FORMAT "%12.7" /end MEASUREMENT
/begin MEASUREMENT teg_1.wall_up_struct.crlc_teg_wall_bas_up "Entire correlation constant of TEG_WALL dynamic change limitation" UWORD _CNV_A_R_LINEAR_____37_CM 1 100. 0. 0.99998474 DISPLAY_IDENTIFIER CRLC_TEG_WALL_BAS_UP_1 ECU_ADDRESS 0x3fcc8a BYTE_ORDER MSB_LAST FORMAT "%7.5" /end MEASUREMENT
/begin MEASUREMENT teg_1.wall_up_struct.teg_wall_stat_eng_up "" UWORD _CNV_A_R_LINEAR_____280_CM 1 100. -48. 1459.3 DISPLAY_IDENTIFIER TEG_WALL_STAT_ENG_UP_1 ECU_ADDRESS 0x3fcc70 BYTE_ORDER MSB_LAST FORMAT "%7.2" /end MEASUREMENT
/begin MEASUREMENT teg_1.wall_up_struct.teg_wall_cor_eff_iga_up "Temp. correction power loss by ignition angle difference" UWORD _CNV_A_R_LINEAR_____468_CM 1 100. 0. 983.025 DISPLAY_IDENTIFIER TEG_WALL_COR_EFF_IGA_UP_1 ECU_ADDRESS 0x3fcc74 BYTE_ORDER MSB_LAST FORMAT "%6.2" /end MEASUREMENT
/begin MEASUREMENT teg_1.wall_up_struct.teg_wall_scc_tco_up "Additive Single cylinder shut off temp. correction" UBYTE _CNV_A_R_LINEAR_____11_CM 1 100. -48. 142.5 DISPLAY_IDENTIFIER TEG_WALL_SCC_TCO_UP_1 ECU_ADDRESS 0x3fcc76 FORMAT "%5.1" /end MEASUREMENT
/begin MEASUREMENT teg_1.wall_up_struct.teg_wall_cor_veh_up "Entire vehicle influences correction" SWORD _CNV_A_R_LINEAR_____472_CM 1 100. -491.519999999553 491.5 DISPLAY_IDENTIFIER TEG_WALL_COR_VEH_UP_1 ECU_ADDRESS 0x3fcc7e BYTE_ORDER MSB_LAST FORMAT "%7.2" /end MEASUREMENT
/begin MEASUREMENT teg_1.wall_up_struct.fac_cor_vs_teg_wall_up "Vehicle speed correction" SWORD _CNV_A_R_LINEAR_____276_CM 1 100. -2. 1.999938965 DISPLAY_IDENTIFIER FAC_COR_VS_TEG_WALL_UP_1 ECU_ADDRESS 0x3fcc80 BYTE_ORDER MSB_LAST FORMAT "%8.4" /end MEASUREMENT
/begin MEASUREMENT teg_1.wall_up_struct.teg_wall_cor_tco_ex_up "Cooling temperature outlet correction" SWORD _CNV_A_R_LINEAR_____473_CM 1 100. -202. 202. DISPLAY_IDENTIFIER TEG_WALL_COR_TCO_EX_UP_1 ECU_ADDRESS 0x3fcc82 BYTE_ORDER MSB_LAST FORMAT "%7.3" /end MEASUREMENT
/begin MEASUREMENT teg_1.wall_up_struct.vs_cor_ecf_teg_wall_up "Vehicle speed correction ecf" UBYTE _CNV_A_R_LINEAR_____23_CM 1 100. 0. 255. DISPLAY_IDENTIFIER VS_COR_ECF_TEG_WALL_UP_1 ECU_ADDRESS 0x3fcc84 FORMAT "%3.0" /end MEASUREMENT
/begin MEASUREMENT teg_1.wall_up_struct.vs_cor_teg_wall_up "Vehicle speed correction" UBYTE _CNV_A_R_LINEAR_____23_CM 1 100. 0. 255. DISPLAY_IDENTIFIER VS_COR_TEG_WALL_UP_1 ECU_ADDRESS 0x3fcc85 FORMAT "%3.0" /end MEASUREMENT
/begin MEASUREMENT teg_1.wall_down_struct.teg_wall_stat_eng_down "Exhaust temp. pre-control pre catalyst" UWORD _CNV_A_R_LINEAR_____280_CM 1 100. -48. 1459.3 DISPLAY_IDENTIFIER TEG_WALL_STAT_ENG_DOWN_1 ECU_ADDRESS 0x3fcca4 BYTE_ORDER MSB_LAST FORMAT "%7.2" /end MEASUREMENT
/begin MEASUREMENT teg_1.wall_down_struct.teg_wall_stat_bas_down "Exhaust temp. based on load level pre-control pre catalyst" UWORD _CNV_A_R_LINEAR_____280_CM 1 100. -48. 1459.3 DISPLAY_IDENTIFIER TEG_WALL_STAT_BAS_DOWN_1 ECU_ADDRESS 0x3fcca6 BYTE_ORDER MSB_LAST FORMAT "%7.2" /end MEASUREMENT
/begin MEASUREMENT teg_1.wall_down_struct.fac_cor_lamb_sp_teg_wall_down "Lambda set -point correction" UWORD _CNV_A_R_LINEAR_____20_CM 1 100. 0. 1.99996948 DISPLAY_IDENTIFIER FAC_COR_LAMB_SP_TEG_WALL_DOWN_1 ECU_ADDRESS 0x3fccaa BYTE_ORDER MSB_LAST FORMAT "%7.5" /end MEASUREMENT
/begin MEASUREMENT teg_1.wall_down_struct.teg_wall_stat_down "Pre control exhaust temperature  pre catalyst" UWORD _CNV_A_R_LINEAR_____280_CM 1 100. -48. 1459.3 DISPLAY_IDENTIFIER TEG_WALL_STAT_DOWN_1 ECU_ADDRESS 0x3fccae BYTE_ORDER MSB_LAST FORMAT "%7.2" /end MEASUREMENT
/begin MEASUREMENT teg_1.wall_down_struct.teg_wall_cat_down_mdl "Model of exhaust temperature pre catalyst" UWORD _CNV_A_R_LINEAR_____280_CM 1 100. -48. 1459.3 DISPLAY_IDENTIFIER TEG_WALL_CAT_DOWN_MDL_1 ECU_ADDRESS 0x3fccb8 BYTE_ORDER MSB_LAST FORMAT "%7.2" /end MEASUREMENT
/begin MEASUREMENT teg_1.wall_down_struct.teg_wall_dif_down "Difference between steady to model temperature pre catalyst" UWORD _CNV_A_R_LINEAR_____469_CM 1 100. -1507.328 1507.282 DISPLAY_IDENTIFIER TEG_WALL_DIF_DOWN_1 ECU_ADDRESS 0x3fccba BYTE_ORDER MSB_LAST FORMAT "%8.2" /end MEASUREMENT
/begin MEASUREMENT teg_1.wall_down_struct.teg_wall_cat_down_mdl_stop "Model of exhaust temperature pre catalyst" UWORD _CNV_A_R_LINEAR_____280_CM 1 100. -48. 1459.3 DISPLAY_IDENTIFIER TEG_WALL_CAT_DOWN_MDL_STOP_1 ECU_ADDRESS 0x3fcccc BYTE_ORDER MSB_LAST FORMAT "%7.2" /end MEASUREMENT
/begin MEASUREMENT teg_1.wall_down_struct.crlc_teg_wall_down "Entire correlation constant of TEG_WALL dynamic change limitation" UWORD _CNV_A_R_LINEAR_____37_CM 1 100. 0. 0.99998474 DISPLAY_IDENTIFIER CRLC_TEG_WALL_DOWN_1 ECU_ADDRESS 0x3fccbe BYTE_ORDER MSB_LAST FORMAT "%7.5" /end MEASUREMENT
/begin MEASUREMENT teg_1.wall_down_struct.crlc_teg_wall_toil_tco_down "Corelation constant received at TCO TOIL calculation" UWORD _CNV_A_R_LINEAR_____37_CM 1 100. 0. 0.99998474 DISPLAY_IDENTIFIER CRLC_TEG_WALL_TOIL_TCO_DOWN_1 ECU_ADDRESS 0x3fccc0 BYTE_ORDER MSB_LAST FORMAT "%7.5" /end MEASUREMENT
/begin MEASUREMENT teg_1.wall_down_struct.crlc_teg_wall_egy_down "Corelation constant received at energy calculation" UWORD _CNV_A_R_LINEAR_____37_CM 1 100. 0. 0.99998474 DISPLAY_IDENTIFIER CRLC_TEG_WALL_EGY_DOWN_1 ECU_ADDRESS 0x3fccc2 BYTE_ORDER MSB_LAST FORMAT "%7.5" /end MEASUREMENT
/begin MEASUREMENT teg_1.wall_down_struct.egy_teg_wall_end_sp_down "Energy setpoint  for Temperature Model beginning from start" ULONG _CNV_A_R_LINEAR_____470_CM 1 100. 0. 7456.426 DISPLAY_IDENTIFIER EGY_TEG_WALL_END_SP_DOWN_1 ECU_ADDRESS 0x3fccc4 BYTE_ORDER MSB_LAST FORMAT "%12.7" /end MEASUREMENT
/begin MEASUREMENT teg_1.wall_down_struct.egy_teg_wall_end_av_down "Actual value Energy for Temperature Model beginning from start" ULONG _CNV_A_R_LINEAR_____470_CM 1 100. 0. 7456.426 DISPLAY_IDENTIFIER EGY_TEG_WALL_END_AV_DOWN_1 ECU_ADDRESS 0x3fccc8 BYTE_ORDER MSB_LAST FORMAT "%12.7" /end MEASUREMENT
/begin MEASUREMENT teg_1.wall_down_struct.crlc_teg_wall_bas_down "" UWORD _CNV_A_R_LINEAR_____37_CM 1 100. 0. 0.99998474 DISPLAY_IDENTIFIER CRLC_TEG_WALL_BAS_DOWN_1 ECU_ADDRESS 0x3fccbc BYTE_ORDER MSB_LAST FORMAT "%7.5" /end MEASUREMENT
/begin MEASUREMENT teg_1.wall_down_struct.teg_wall_cor_eff_iga_down "Temp. correction power loss by ignition angle difference" UWORD _CNV_A_R_LINEAR_____468_CM 1 100. 0. 983.025 DISPLAY_IDENTIFIER TEG_WALL_COR_EFF_IGA_DOWN_1 ECU_ADDRESS 0x3fcca8 BYTE_ORDER MSB_LAST FORMAT "%6.2" /end MEASUREMENT
/begin MEASUREMENT teg_1.wall_down_struct.teg_wall_scc_tco_down "Additive Single cylinder shut off temp. correction" UBYTE _CNV_A_R_LINEAR_____11_CM 1 100. -48. 142.5 DISPLAY_IDENTIFIER TEG_WALL_SCC_TCO_DOWN_1 ECU_ADDRESS 0x3fccac FORMAT "%5.1" /end MEASUREMENT
/begin MEASUREMENT teg_1.wall_down_struct.teg_wall_cor_veh_down "Entire vehicle influences correction" SWORD _CNV_A_R_LINEAR_____472_CM 1 100. -491.519999999553 491.5 DISPLAY_IDENTIFIER TEG_WALL_COR_VEH_DOWN_1 ECU_ADDRESS 0x3fccb0 BYTE_ORDER MSB_LAST FORMAT "%7.2" /end MEASUREMENT
/begin MEASUREMENT teg_1.wall_down_struct.fac_cor_vs_teg_wall_down "Vehicle speed correction" SWORD _CNV_A_R_LINEAR_____276_CM 1 100. -2. 1.999938965 DISPLAY_IDENTIFIER FAC_COR_VS_TEG_WALL_DOWN_1 ECU_ADDRESS 0x3fccb2 BYTE_ORDER MSB_LAST FORMAT "%8.4" /end MEASUREMENT
/begin MEASUREMENT teg_1.wall_down_struct.teg_wall_cor_tco_ex_down "Cooling temperature outlet correction" SWORD _CNV_A_R_LINEAR_____473_CM 1 100. -202. 202. DISPLAY_IDENTIFIER TEG_WALL_COR_TCO_EX_DOWN_1 ECU_ADDRESS 0x3fccb4 BYTE_ORDER MSB_LAST FORMAT "%7.3" /end MEASUREMENT
/begin MEASUREMENT teg_1.wall_down_struct.vs_cor_ecf_teg_wall_down "Vehicle speed correction ecf" UBYTE _CNV_A_R_LINEAR_____23_CM 1 100. 0. 255. DISPLAY_IDENTIFIER VS_COR_ECF_TEG_WALL_DOWN_1 ECU_ADDRESS 0x3fccb6 FORMAT "%3.0" /end MEASUREMENT
/begin MEASUREMENT teg_1.wall_down_struct.vs_cor_teg_wall_down "Vehicle speed correction" UBYTE _CNV_A_R_LINEAR_____23_CM 1 100. 0. 255. DISPLAY_IDENTIFIER VS_COR_TEG_WALL_DOWN_1 ECU_ADDRESS 0x3fccb7 FORMAT "%3.0" /end MEASUREMENT
/begin MEASUREMENT teg_1.dew_point_struct.lv_teg_min_thd "dew point has been reached" UBYTE _CNV_S_2_RANGE______2_CM 1 100. 0. 1. DISPLAY_IDENTIFIER LV_TEG_MIN_THD_1 ECU_ADDRESS 0x3fccd4 /end MEASUREMENT
/begin MEASUREMENT teg_1.dew_point_struct.lv_teg_cat_down_min_thd "dew point has been reached bat and pre/post cat. specific" UBYTE _CNV_S_2_RANGE______2_CM 1 100. 0. 1. DISPLAY_IDENTIFIER LV_TEG_CAT_DOWN_MIN_THD_1 ECU_ADDRESS 0x3fccd6 /end MEASUREMENT
/begin MEASUREMENT teg_1.dew_point_struct.lv_teg_cat_up_min_thd "dew point has been reached bat and pre/post cat. specific" UBYTE _CNV_S_2_RANGE______2_CM 1 100. 0. 1. DISPLAY_IDENTIFIER LV_TEG_CAT_UP_MIN_THD_1 ECU_ADDRESS 0x3fccd5 /end MEASUREMENT
/begin MEASUREMENT teg_2.gas_up_struct.teg_stat_eng_up "Exhaust temp. pre-control pre catalyst" UWORD _CNV_A_R_LINEAR_____280_CM 1 100. -48. 1459.3 DISPLAY_IDENTIFIER TEG_STAT_ENG_UP_2 ECU_ADDRESS 0x3fccf0 BYTE_ORDER MSB_LAST FORMAT "%7.2" /end MEASUREMENT
/begin MEASUREMENT teg_2.gas_up_struct.teg_cor_eff_iga_up "Temp. correction power loss by ignition angle difference" UWORD _CNV_A_R_LINEAR_____468_CM 1 100. 0. 983.025 DISPLAY_IDENTIFIER TEG_COR_EFF_IGA_UP_2 ECU_ADDRESS 0x3fccf6 BYTE_ORDER MSB_LAST FORMAT "%6.2" /end MEASUREMENT
/begin MEASUREMENT teg_2.gas_up_struct.teg_stat_bas_up "Exhaust temp. based on load level pre-control pre catalyst" UWORD _CNV_A_R_LINEAR_____280_CM 1 100. -48. 1459.3 DISPLAY_IDENTIFIER TEG_STAT_BAS_UP_2 ECU_ADDRESS 0x3fccf4 BYTE_ORDER MSB_LAST FORMAT "%7.2" /end MEASUREMENT
/begin MEASUREMENT teg_2.gas_up_struct.eff_iga_av_teg_cor "Reference ignition angle for   temperature" UWORD _CNV_A_R_LINEAR_____20_CM 1 100. 0. 1.99996948 DISPLAY_IDENTIFIER EFF_IGA_AV_TEG_COR_2 ECU_ADDRESS 0x3fccfe BYTE_ORDER MSB_LAST FORMAT "%7.5" /end MEASUREMENT
/begin MEASUREMENT teg_2.gas_up_struct.fac_scc_teg "Multipicative Single cylinder shut off correction" UWORD _CNV_A_R_LINEAR_____37_CM 1 100. 0. 0.99998474 DISPLAY_IDENTIFIER FAC_SCC_TEG_2 ECU_ADDRESS 0x3fccfa BYTE_ORDER MSB_LAST FORMAT "%7.5" /end MEASUREMENT
/begin MEASUREMENT teg_2.gas_up_struct.fac_cor_lamb_sp_teg_up "Lambda set -point correction" UWORD _CNV_A_R_LINEAR_____20_CM 1 100. 0. 1.99996948 DISPLAY_IDENTIFIER FAC_COR_LAMB_SP_TEG_UP_2 ECU_ADDRESS 0x3fccfc BYTE_ORDER MSB_LAST FORMAT "%7.5" /end MEASUREMENT
/begin MEASUREMENT teg_2.gas_up_struct.teg_stat_up "Pre control exhaust temperature  pre catalyst" UWORD _CNV_A_R_LINEAR_____280_CM 1 100. -48. 1459.3 DISPLAY_IDENTIFIER TEG_STAT_UP_2 ECU_ADDRESS 0x3fcd00 BYTE_ORDER MSB_LAST FORMAT "%7.2" /end MEASUREMENT
/begin MEASUREMENT teg_2.gas_up_struct.teg_cat_up_mdl_bas "Model of exhaust temperature pre catalyst" UWORD _CNV_A_R_LINEAR_____280_CM 1 100. -48. 1459.3 DISPLAY_IDENTIFIER TEG_CAT_UP_MDL_2_BAS ECU_ADDRESS 0x3fcd0a BYTE_ORDER MSB_LAST FORMAT "%7.2" /end MEASUREMENT
/begin MEASUREMENT teg_2.gas_up_struct.teg_dif_up "Difference between steady to model temperature pre catalyst" UWORD _CNV_A_R_LINEAR_____469_CM 1 100. -1507.328 1507.282 DISPLAY_IDENTIFIER TEG_DIF_UP_2 ECU_ADDRESS 0x3fcd0c BYTE_ORDER MSB_LAST FORMAT "%8.2" /end MEASUREMENT
/begin MEASUREMENT teg_2.gas_up_struct.teg_cat_up_mdl_stop "Model of exhaust temperature pre catalyst" UWORD _CNV_A_R_LINEAR_____280_CM 1 100. -48. 1459.3 DISPLAY_IDENTIFIER TEG_CAT_UP_MDL_STOP_2 ECU_ADDRESS 0x3fcd24 BYTE_ORDER MSB_LAST FORMAT "%7.2" /end MEASUREMENT
/begin MEASUREMENT teg_2.gas_up_struct.crlc_teg_grad_up "Exhaust Temperature gradient" UWORD _CNV_A_R_LINEAR_____394_CM 1 100. 0. 7.99987793 DISPLAY_IDENTIFIER CRLC_TEG_GRAD_UP_2 ECU_ADDRESS 0x3fcd0e BYTE_ORDER MSB_LAST FORMAT "%6.4" /end MEASUREMENT
/begin MEASUREMENT teg_2.gas_up_struct.crlc_teg_level_up "Exhaust temperature level" UWORD _CNV_A_R_LINEAR_____394_CM 1 100. 0. 7.99987793 DISPLAY_IDENTIFIER CRLC_TEG_LEVEL_UP_2 ECU_ADDRESS 0x3fcd10 BYTE_ORDER MSB_LAST FORMAT "%6.4" /end MEASUREMENT
/begin MEASUREMENT teg_2.gas_up_struct.crlc_teg_up "Entire correlation constant of TEG dynamic change limitation" UWORD _CNV_A_R_LINEAR_____37_CM 1 100. 0. 0.99998474 DISPLAY_IDENTIFIER CRLC_TEG_UP_2 ECU_ADDRESS 0x3fcd14 BYTE_ORDER MSB_LAST FORMAT "%7.5" /end MEASUREMENT
/begin MEASUREMENT teg_2.gas_up_struct.crlc_teg_toil_tco_up "Corelation constant received at TCO TOIL calculation" UWORD _CNV_A_R_LINEAR_____37_CM 1 100. 0. 0.99998474 DISPLAY_IDENTIFIER CRLC_TEG_TOIL_TCO_UP_2 ECU_ADDRESS 0x3fcd16 BYTE_ORDER MSB_LAST FORMAT "%7.5" /end MEASUREMENT
/begin MEASUREMENT teg_2.gas_up_struct.crlc_teg_egy_up "Corelation constant received at energy calculation" UWORD _CNV_A_R_LINEAR_____394_CM 1 100. 0. 7.99987793 DISPLAY_IDENTIFIER CRLC_TEG_EGY_UP_2 ECU_ADDRESS 0x3fcd18 BYTE_ORDER MSB_LAST FORMAT "%6.4" /end MEASUREMENT
/begin MEASUREMENT teg_2.gas_up_struct.egy_teg_end_sp_up "Energy setpoint  for Temperature Model beginning from start" ULONG _CNV_A_R_LINEAR_____470_CM 1 100. 0. 7456.426 DISPLAY_IDENTIFIER EGY_TEG_END_SP_UP_2 ECU_ADDRESS 0x3fcd1c BYTE_ORDER MSB_LAST FORMAT "%12.7" /end MEASUREMENT
/begin MEASUREMENT teg_2.gas_up_struct.egy_teg_end_av_up "Actual value Energy for Temperature Model beginning from start" ULONG _CNV_A_R_LINEAR_____470_CM 1 100. 0. 7456.426 DISPLAY_IDENTIFIER EGY_TEG_END_AV_UP_2 ECU_ADDRESS 0x3fcd20 BYTE_ORDER MSB_LAST FORMAT "%12.7" /end MEASUREMENT
/begin MEASUREMENT teg_2.gas_up_struct.lv_teg_ast_up "Temperature model after start condition" UBYTE _CNV_S_2_RANGE______21_CM 1 100. 0. 1. DISPLAY_IDENTIFIER LV_TEG_AST_UP_2 ECU_ADDRESS 0x3fcd1a /end MEASUREMENT
/begin MEASUREMENT teg_2.gas_up_struct.crlc_teg_bas_up "Entire correlation constant of TEG dynamic change limitation" UWORD _CNV_A_R_LINEAR_____37_CM 1 100. 0. 0.99998474 DISPLAY_IDENTIFIER CRLC_TEG_BAS_UP_2 ECU_ADDRESS 0x3fcd12 BYTE_ORDER MSB_LAST FORMAT "%7.5" /end MEASUREMENT
/begin MEASUREMENT teg_2.gas_up_struct.teg_add_egr_up "EGR influence temperature" UWORD _CNV_A_R_LINEAR_____471_CM 1 100. -491.52 491.505 DISPLAY_IDENTIFIER TEG_ADD_EGR_UP_2 ECU_ADDRESS 0x3fccf2 BYTE_ORDER MSB_LAST FORMAT "%7.2" /end MEASUREMENT
/begin MEASUREMENT teg_2.gas_up_struct.teg_cor_veh_up "Entire vehicle influences correction" SWORD _CNV_A_R_LINEAR_____472_CM 1 100. -491.519999999553 491.5 DISPLAY_IDENTIFIER TEG_COR_VEH_UP_2 ECU_ADDRESS 0x3fcd02 BYTE_ORDER MSB_LAST FORMAT "%7.2" /end MEASUREMENT
/begin MEASUREMENT teg_2.gas_up_struct.teg_cor_tco_ex_up "Cooling temperature outlet correction" SWORD _CNV_A_R_LINEAR_____473_CM 1 100. -202. 202. DISPLAY_IDENTIFIER TEG_COR_TCO_EX_UP_2 ECU_ADDRESS 0x3fcd06 BYTE_ORDER MSB_LAST FORMAT "%7.3" /end MEASUREMENT
/begin MEASUREMENT teg_2.gas_up_struct.fac_cor_vs_teg_up "Vehicle speed correction" SWORD _CNV_A_R_LINEAR_____276_CM 1 100. -2. 1.999938965 DISPLAY_IDENTIFIER FAC_COR_VS_TEG_UP_2 ECU_ADDRESS 0x3fcd04 BYTE_ORDER MSB_LAST FORMAT "%8.4" /end MEASUREMENT
/begin MEASUREMENT teg_2.gas_up_struct.teg_scc_tco_up "Additive single cyl. shut off temp. correction" UBYTE _CNV_A_R_LINEAR_____11_CM 1 100. -48. 142.5 DISPLAY_IDENTIFIER TEG_SCC_TCO_UP_2 ECU_ADDRESS 0x3fccf8 FORMAT "%5.1" /end MEASUREMENT
/begin MEASUREMENT teg_2.gas_up_struct.vs_cor_ecf_teg_up "Electric cooling fan correction" UBYTE _CNV_A_R_LINEAR_____23_CM 1 100. 0. 255. DISPLAY_IDENTIFIER VS_COR_ECF_TEG_UP_2 ECU_ADDRESS 0x3fcd08 FORMAT "%3.0" /end MEASUREMENT
/begin MEASUREMENT teg_2.gas_up_struct.vs_cor_teg_up "VS temperature correction" UBYTE _CNV_A_R_LINEAR_____23_CM 1 100. 0. 255. DISPLAY_IDENTIFIER VS_COR_TEG_UP_2 ECU_ADDRESS 0x3fcd09 FORMAT "%3.0" /end MEASUREMENT
/begin MEASUREMENT teg_2.gas_down_struct.teg_stat_eng_down "Exhaust temp. pre-control pre catalyst" UWORD _CNV_A_R_LINEAR_____280_CM 1 100. -48. 1459.3 DISPLAY_IDENTIFIER TEG_STAT_ENG_DOWN_2 ECU_ADDRESS 0x3fcd2c BYTE_ORDER MSB_LAST FORMAT "%7.2" /end MEASUREMENT
/begin MEASUREMENT teg_2.gas_down_struct.teg_stat_bas_down "Exhaust temp. based on load level pre-control pre catalyst" UWORD _CNV_A_R_LINEAR_____280_CM 1 100. -48. 1459.3 DISPLAY_IDENTIFIER TEG_STAT_BAS_DOWN_2 ECU_ADDRESS 0x3fcd2e BYTE_ORDER MSB_LAST FORMAT "%7.2" /end MEASUREMENT
/begin MEASUREMENT teg_2.gas_down_struct.fac_cor_lamb_sp_teg_down "Lambda set -point correction" UWORD _CNV_A_R_LINEAR_____20_CM 1 100. 0. 1.99996948 DISPLAY_IDENTIFIER FAC_COR_LAMB_SP_TEG_DOWN_2 ECU_ADDRESS 0x3fcd32 BYTE_ORDER MSB_LAST FORMAT "%7.5" /end MEASUREMENT
/begin MEASUREMENT teg_2.gas_down_struct.teg_stat_down "Pre control exhaust temperature  pre catalyst" UWORD _CNV_A_R_LINEAR_____280_CM 1 100. -48. 1459.3 DISPLAY_IDENTIFIER TEG_STAT_DOWN_2 ECU_ADDRESS 0x3fcd36 BYTE_ORDER MSB_LAST FORMAT "%7.2" /end MEASUREMENT
/begin MEASUREMENT teg_2.gas_down_struct.teg_cat_down_mdl_bas "Model of exhaust temperature pre catalyst" UWORD _CNV_A_R_LINEAR_____280_CM 1 100. -48. 1459.3 DISPLAY_IDENTIFIER TEG_CAT_DOWN_MDL_2_BAS ECU_ADDRESS 0x3fcd40 BYTE_ORDER MSB_LAST FORMAT "%7.2" /end MEASUREMENT
/begin MEASUREMENT teg_2.gas_down_struct.teg_dif_down "Difference between steady to model temperature pre catalyst" UWORD _CNV_A_R_LINEAR_____469_CM 1 100. -1507.328 1507.282 DISPLAY_IDENTIFIER TEG_DIF_DOWN_2 ECU_ADDRESS 0x3fcd42 BYTE_ORDER MSB_LAST FORMAT "%8.2" /end MEASUREMENT
/begin MEASUREMENT teg_2.gas_down_struct.teg_cat_down_mdl_stop "Model of exhaust temperature pre catalyst" UWORD _CNV_A_R_LINEAR_____280_CM 1 100. -48. 1459.3 DISPLAY_IDENTIFIER TEG_CAT_DOWN_MDL_STOP_2 ECU_ADDRESS 0x3fcd5c BYTE_ORDER MSB_LAST FORMAT "%7.2" /end MEASUREMENT
/begin MEASUREMENT teg_2.gas_down_struct.crlc_teg_grad_down "Exhaust Temperature gradient" UWORD _CNV_A_R_LINEAR_____394_CM 1 100. 0. 7.99987793 DISPLAY_IDENTIFIER CRLC_TEG_GRAD_DOWN_2 ECU_ADDRESS 0x3fcd44 BYTE_ORDER MSB_LAST FORMAT "%6.4" /end MEASUREMENT
/begin MEASUREMENT teg_2.gas_down_struct.crlc_teg_level_down "Exhaust temperature level" UWORD _CNV_A_R_LINEAR_____394_CM 1 100. 0. 7.99987793 DISPLAY_IDENTIFIER CRLC_TEG_LEVEL_DOWN_2 ECU_ADDRESS 0x3fcd46 BYTE_ORDER MSB_LAST FORMAT "%6.4" /end MEASUREMENT
/begin MEASUREMENT teg_2.gas_down_struct.crlc_teg_down "Entire correlation constant of TEG dynamic change limitation" UWORD _CNV_A_R_LINEAR_____37_CM 1 100. 0. 0.99998474 DISPLAY_IDENTIFIER CRLC_TEG_DOWN_2 ECU_ADDRESS 0x3fcd4a BYTE_ORDER MSB_LAST FORMAT "%7.5" /end MEASUREMENT
/begin MEASUREMENT teg_2.gas_down_struct.crlc_teg_toil_tco_down "Corelation constant received at TCO TOIL calculation" UWORD _CNV_A_R_LINEAR_____37_CM 1 100. 0. 0.99998474 DISPLAY_IDENTIFIER CRLC_TEG_TOIL_TCO_DOWN_2 ECU_ADDRESS 0x3fcd4c BYTE_ORDER MSB_LAST FORMAT "%7.5" /end MEASUREMENT
/begin MEASUREMENT teg_2.gas_down_struct.crlc_teg_egy_down "Corelation constant received at energy calculation" UWORD _CNV_A_R_LINEAR_____394_CM 1 100. 0. 7.99987793 DISPLAY_IDENTIFIER CRLC_TEG_EGY_DOWN_2 ECU_ADDRESS 0x3fcd4e BYTE_ORDER MSB_LAST FORMAT "%6.4" /end MEASUREMENT
/begin MEASUREMENT teg_2.gas_down_struct.egy_teg_end_sp_down "Energy setpoint  for Temperature Model beginning from start" ULONG _CNV_A_R_LINEAR_____470_CM 1 100. 0. 7456.426 DISPLAY_IDENTIFIER EGY_TEG_END_SP_DOWN_2 ECU_ADDRESS 0x3fcd54 BYTE_ORDER MSB_LAST FORMAT "%12.7" /end MEASUREMENT
/begin MEASUREMENT teg_2.gas_down_struct.egy_teg_end_av_down "Actual value Energy for Temperature Model beginning from start" ULONG _CNV_A_R_LINEAR_____470_CM 1 100. 0. 7456.426 DISPLAY_IDENTIFIER EGY_TEG_END_AV_DOWN_2 ECU_ADDRESS 0x3fcd58 BYTE_ORDER MSB_LAST FORMAT "%12.7" /end MEASUREMENT
/begin MEASUREMENT teg_2.gas_down_struct.lv_teg_ast_down "Temperature model after start condition" UBYTE _CNV_S_2_RANGE______21_CM 1 100. 0. 1. DISPLAY_IDENTIFIER LV_TEG_AST_DOWN_2 ECU_ADDRESS 0x3fcd50 /end MEASUREMENT
/begin MEASUREMENT teg_2.gas_down_struct.crlc_teg_bas_down "Entire correlation constant of TEG dynamic change limitation" UWORD _CNV_A_R_LINEAR_____37_CM 1 100. 0. 0.99998474 DISPLAY_IDENTIFIER CRLC_TEG_BAS_DOWN_2 ECU_ADDRESS 0x3fcd48 BYTE_ORDER MSB_LAST FORMAT "%7.5" /end MEASUREMENT
/begin MEASUREMENT teg_2.gas_down_struct.teg_cor_eff_iga_down "Temp. correction power loss by ignition angle difference" UWORD _CNV_A_R_LINEAR_____468_CM 1 100. 0. 983.025 DISPLAY_IDENTIFIER TEG_COR_EFF_IGA_DOWN_2 ECU_ADDRESS 0x3fcd30 BYTE_ORDER MSB_LAST FORMAT "%6.2" /end MEASUREMENT
/begin MEASUREMENT teg_2.gas_down_struct.teg_scc_tco_down "Additive Single cylinder shut off temp. correction" UBYTE _CNV_A_R_LINEAR_____11_CM 1 100. -48. 142.5 DISPLAY_IDENTIFIER TEG_SCC_TCO_DOWN_2 ECU_ADDRESS 0x3fcd34 FORMAT "%5.1" /end MEASUREMENT
/begin MEASUREMENT teg_2.gas_down_struct.teg_cor_veh_down "Entire vehicle influences correction" SWORD _CNV_A_R_LINEAR_____472_CM 1 100. -491.519999999553 491.5 DISPLAY_IDENTIFIER TEG_COR_VEH_DOWN_2 ECU_ADDRESS 0x3fcd38 BYTE_ORDER MSB_LAST FORMAT "%7.2" /end MEASUREMENT
/begin MEASUREMENT teg_2.gas_down_struct.fac_cor_vs_teg_down "Vehicle speed correction" SWORD _CNV_A_R_LINEAR_____276_CM 1 100. -2. 1.999938965 DISPLAY_IDENTIFIER FAC_COR_VS_TEG_DOWN_2 ECU_ADDRESS 0x3fcd3a BYTE_ORDER MSB_LAST FORMAT "%8.4" /end MEASUREMENT
/begin MEASUREMENT teg_2.gas_down_struct.teg_cor_tco_ex_down "Cooling temperature outlet correction" SWORD _CNV_A_R_LINEAR_____473_CM 1 100. -202. 202. DISPLAY_IDENTIFIER TEG_COR_TCO_EX_DOWN_2 ECU_ADDRESS 0x3fcd3c BYTE_ORDER MSB_LAST FORMAT "%7.3" /end MEASUREMENT
/begin MEASUREMENT teg_2.gas_down_struct.vs_cor_ecf_teg_down "Vehicle speed correction ecf" UBYTE _CNV_A_R_LINEAR_____23_CM 1 100. 0. 255. DISPLAY_IDENTIFIER VS_COR_ECF_TEG_DOWN_2 ECU_ADDRESS 0x3fcd3e FORMAT "%3.0" /end MEASUREMENT
/begin MEASUREMENT teg_2.gas_down_struct.vs_cor_teg_down "Vehicle speed correction" UBYTE _CNV_A_R_LINEAR_____23_CM 1 100. 0. 255. DISPLAY_IDENTIFIER VS_COR_TEG_DOWN_2 ECU_ADDRESS 0x3fcd3f FORMAT "%3.0" /end MEASUREMENT
/begin MEASUREMENT teg_2.wall_up_struct.teg_wall_stat_bas_up "Exhaust temp. based on load level pre-control pre catalyst" UWORD _CNV_A_R_LINEAR_____280_CM 1 100. -48. 1459.3 DISPLAY_IDENTIFIER TEG_WALL_STAT_BAS_UP_2 ECU_ADDRESS 0x3fcd66 BYTE_ORDER MSB_LAST FORMAT "%7.2" /end MEASUREMENT
/begin MEASUREMENT teg_2.wall_up_struct.fac_scc_teg_wall "Multipicative Single cylinder shut off correction" UWORD _CNV_A_R_LINEAR_____37_CM 1 100. 0. 0.99998474 DISPLAY_IDENTIFIER FAC_SCC_TEG_WALL_2 ECU_ADDRESS 0x3fcd6c BYTE_ORDER MSB_LAST FORMAT "%7.5" /end MEASUREMENT
/begin MEASUREMENT teg_2.wall_up_struct.fac_cor_lamb_sp_teg_wall_up "Lambda set -point correction" UWORD _CNV_A_R_LINEAR_____20_CM 1 100. 0. 1.99996948 DISPLAY_IDENTIFIER FAC_COR_LAMB_SP_TEG_WALL_UP_2 ECU_ADDRESS 0x3fcd6e BYTE_ORDER MSB_LAST FORMAT "%7.5" /end MEASUREMENT
/begin MEASUREMENT teg_2.wall_up_struct.teg_wall_stat_up "Pre control exhaust temperature  pre catalyst" UWORD _CNV_A_R_LINEAR_____280_CM 1 100. -48. 1459.3 DISPLAY_IDENTIFIER TEG_WALL_STAT_UP_2 ECU_ADDRESS 0x3fcd70 BYTE_ORDER MSB_LAST FORMAT "%7.2" /end MEASUREMENT
/begin MEASUREMENT teg_2.wall_up_struct.teg_wall_cat_up_mdl "Model of exhaust temperature pre catalyst" UWORD _CNV_A_R_LINEAR_____280_CM 1 100. -48. 1459.3 DISPLAY_IDENTIFIER TEG_WALL_CAT_UP_MDL_2 ECU_ADDRESS 0x3fcd7a BYTE_ORDER MSB_LAST FORMAT "%7.2" /end MEASUREMENT
/begin MEASUREMENT teg_2.wall_up_struct.teg_wall_dif_up "Difference between steady to model temperature pre catalyst" UWORD _CNV_A_R_LINEAR_____469_CM 1 100. -1507.328 1507.282 DISPLAY_IDENTIFIER TEG_WALL_DIF_UP_2 ECU_ADDRESS 0x3fcd7c BYTE_ORDER MSB_LAST FORMAT "%8.2" /end MEASUREMENT
/begin MEASUREMENT teg_2.wall_up_struct.teg_wall_cat_up_mdl_stop "Model of exhaust temperature pre catalyst" UWORD _CNV_A_R_LINEAR_____280_CM 1 100. -48. 1459.3 DISPLAY_IDENTIFIER TEG_WALL_CAT_UP_MDL_STOP_2 ECU_ADDRESS 0x3fcd90 BYTE_ORDER MSB_LAST FORMAT "%7.2" /end MEASUREMENT
/begin MEASUREMENT teg_2.wall_up_struct.crlc_teg_wall_up "Entire correlation constant of TEG_WALL dynamic change limitation" UWORD _CNV_A_R_LINEAR_____37_CM 1 100. 0. 0.99998474 DISPLAY_IDENTIFIER CRLC_TEG_WALL_UP_2 ECU_ADDRESS 0x3fcd80 BYTE_ORDER MSB_LAST FORMAT "%7.5" /end MEASUREMENT
/begin MEASUREMENT teg_2.wall_up_struct.crlc_teg_wall_toil_tco_up "Corelation constant received at TCO TOIL calculation" UWORD _CNV_A_R_LINEAR_____37_CM 1 100. 0. 0.99998474 DISPLAY_IDENTIFIER CRLC_TEG_WALL_TOIL_TCO_UP_2 ECU_ADDRESS 0x3fcd82 BYTE_ORDER MSB_LAST FORMAT "%7.5" /end MEASUREMENT
/begin MEASUREMENT teg_2.wall_up_struct.crlc_teg_wall_egy_up "Corelation constant received at energy calculation" UWORD _CNV_A_R_LINEAR_____37_CM 1 100. 0. 0.99998474 DISPLAY_IDENTIFIER CRLC_TEG_WALL_EGY_UP_2 ECU_ADDRESS 0x3fcd84 BYTE_ORDER MSB_LAST FORMAT "%7.5" /end MEASUREMENT
/begin MEASUREMENT teg_2.wall_up_struct.egy_teg_wall_end_sp_up "Energy setpoint  for Temperature Model beginning from start" ULONG _CNV_A_R_LINEAR_____470_CM 1 100. 0. 7456.426 DISPLAY_IDENTIFIER EGY_TEG_WALL_END_SP_UP_2 ECU_ADDRESS 0x3fcd88 BYTE_ORDER MSB_LAST FORMAT "%12.7" /end MEASUREMENT
/begin MEASUREMENT teg_2.wall_up_struct.egy_teg_wall_end_av_up "Actual value Energy for Temperature Model beginning from start" ULONG _CNV_A_R_LINEAR_____470_CM 1 100. 0. 7456.426 DISPLAY_IDENTIFIER EGY_TEG_WALL_END_AV_UP_2 ECU_ADDRESS 0x3fcd8c BYTE_ORDER MSB_LAST FORMAT "%12.7" /end MEASUREMENT
/begin MEASUREMENT teg_2.wall_up_struct.crlc_teg_wall_bas_up "Entire correlation constant of TEG_WALL dynamic change limitation" UWORD _CNV_A_R_LINEAR_____37_CM 1 100. 0. 0.99998474 DISPLAY_IDENTIFIER CRLC_TEG_WALL_BAS_UP_2 ECU_ADDRESS 0x3fcd7e BYTE_ORDER MSB_LAST FORMAT "%7.5" /end MEASUREMENT
/begin MEASUREMENT teg_2.wall_up_struct.teg_wall_stat_eng_up "" UWORD _CNV_A_R_LINEAR_____280_CM 1 100. -48. 1459.3 DISPLAY_IDENTIFIER TEG_WALL_STAT_ENG_UP_2 ECU_ADDRESS 0x3fcd64 BYTE_ORDER MSB_LAST FORMAT "%7.2" /end MEASUREMENT
/begin MEASUREMENT teg_2.wall_up_struct.teg_wall_cor_eff_iga_up "Temp. correction power loss by ignition angle difference" UWORD _CNV_A_R_LINEAR_____468_CM 1 100. 0. 983.025 DISPLAY_IDENTIFIER TEG_WALL_COR_EFF_IGA_UP_2 ECU_ADDRESS 0x3fcd68 BYTE_ORDER MSB_LAST FORMAT "%6.2" /end MEASUREMENT
/begin MEASUREMENT teg_2.wall_up_struct.teg_wall_scc_tco_up "Additive Single cylinder shut off temp. correction" UBYTE _CNV_A_R_LINEAR_____11_CM 1 100. -48. 142.5 DISPLAY_IDENTIFIER TEG_WALL_SCC_TCO_UP_2 ECU_ADDRESS 0x3fcd6a FORMAT "%5.1" /end MEASUREMENT
/begin MEASUREMENT teg_2.wall_up_struct.teg_wall_cor_veh_up "Entire vehicle influences correction" SWORD _CNV_A_R_LINEAR_____472_CM 1 100. -491.519999999553 491.5 DISPLAY_IDENTIFIER TEG_WALL_COR_VEH_UP_2 ECU_ADDRESS 0x3fcd72 BYTE_ORDER MSB_LAST FORMAT "%7.2" /end MEASUREMENT
/begin MEASUREMENT teg_2.wall_up_struct.fac_cor_vs_teg_wall_up "Vehicle speed correction" SWORD _CNV_A_R_LINEAR_____276_CM 1 100. -2. 1.999938965 DISPLAY_IDENTIFIER FAC_COR_VS_TEG_WALL_UP_2 ECU_ADDRESS 0x3fcd74 BYTE_ORDER MSB_LAST FORMAT "%8.4" /end MEASUREMENT
/begin MEASUREMENT teg_2.wall_up_struct.teg_wall_cor_tco_ex_up "Cooling temperature outlet correction" SWORD _CNV_A_R_LINEAR_____473_CM 1 100. -202. 202. DISPLAY_IDENTIFIER TEG_WALL_COR_TCO_EX_UP_2 ECU_ADDRESS 0x3fcd76 BYTE_ORDER MSB_LAST FORMAT "%7.3" /end MEASUREMENT
/begin MEASUREMENT teg_2.wall_up_struct.vs_cor_ecf_teg_wall_up "Vehicle speed correction ecf" UBYTE _CNV_A_R_LINEAR_____23_CM 1 100. 0. 255. DISPLAY_IDENTIFIER VS_COR_ECF_TEG_WALL_UP_2 ECU_ADDRESS 0x3fcd78 FORMAT "%3.0" /end MEASUREMENT
/begin MEASUREMENT teg_2.wall_up_struct.vs_cor_teg_wall_up "Vehicle speed correction" UBYTE _CNV_A_R_LINEAR_____23_CM 1 100. 0. 255. DISPLAY_IDENTIFIER VS_COR_TEG_WALL_UP_2 ECU_ADDRESS 0x3fcd79 FORMAT "%3.0" /end MEASUREMENT
/begin MEASUREMENT teg_2.wall_down_struct.teg_wall_stat_eng_down "Exhaust temp. pre-control pre catalyst" UWORD _CNV_A_R_LINEAR_____280_CM 1 100. -48. 1459.3 DISPLAY_IDENTIFIER TEG_WALL_STAT_ENG_DOWN_2 ECU_ADDRESS 0x3fcd98 BYTE_ORDER MSB_LAST FORMAT "%7.2" /end MEASUREMENT
/begin MEASUREMENT teg_2.wall_down_struct.teg_wall_stat_bas_down "Exhaust temp. based on load level pre-control pre catalyst" UWORD _CNV_A_R_LINEAR_____280_CM 1 100. -48. 1459.3 DISPLAY_IDENTIFIER TEG_WALL_STAT_BAS_DOWN_2 ECU_ADDRESS 0x3fcd9a BYTE_ORDER MSB_LAST FORMAT "%7.2" /end MEASUREMENT
/begin MEASUREMENT teg_2.wall_down_struct.fac_cor_lamb_sp_teg_wall_down "Lambda set -point correction" UWORD _CNV_A_R_LINEAR_____20_CM 1 100. 0. 1.99996948 DISPLAY_IDENTIFIER FAC_COR_LAMB_SP_TEG_WALL_DOWN_2 ECU_ADDRESS 0x3fcd9e BYTE_ORDER MSB_LAST FORMAT "%7.5" /end MEASUREMENT
/begin MEASUREMENT teg_2.wall_down_struct.teg_wall_stat_down "Pre control exhaust temperature  pre catalyst" UWORD _CNV_A_R_LINEAR_____280_CM 1 100. -48. 1459.3 DISPLAY_IDENTIFIER TEG_WALL_STAT_DOWN_2 ECU_ADDRESS 0x3fcda2 BYTE_ORDER MSB_LAST FORMAT "%7.2" /end MEASUREMENT
/begin MEASUREMENT teg_2.wall_down_struct.teg_wall_cat_down_mdl "Model of exhaust temperature pre catalyst" UWORD _CNV_A_R_LINEAR_____280_CM 1 100. -48. 1459.3 DISPLAY_IDENTIFIER TEG_WALL_CAT_DOWN_MDL_2 ECU_ADDRESS 0x3fcdac BYTE_ORDER MSB_LAST FORMAT "%7.2" /end MEASUREMENT
/begin MEASUREMENT teg_2.wall_down_struct.teg_wall_dif_down "Difference between steady to model temperature pre catalyst" UWORD _CNV_A_R_LINEAR_____469_CM 1 100. -1507.328 1507.282 DISPLAY_IDENTIFIER TEG_WALL_DIF_DOWN_2 ECU_ADDRESS 0x3fcdae BYTE_ORDER MSB_LAST FORMAT "%8.2" /end MEASUREMENT
/begin MEASUREMENT teg_2.wall_down_struct.teg_wall_cat_down_mdl_stop "Model of exhaust temperature pre catalyst" UWORD _CNV_A_R_LINEAR_____280_CM 1 100. -48. 1459.3 DISPLAY_IDENTIFIER TEG_WALL_CAT_DOWN_MDL_STOP_2 ECU_ADDRESS 0x3fcdc0 BYTE_ORDER MSB_LAST FORMAT "%7.2" /end MEASUREMENT
/begin MEASUREMENT teg_2.wall_down_struct.crlc_teg_wall_down "Entire correlation constant of TEG_WALL dynamic change limitation" UWORD _CNV_A_R_LINEAR_____37_CM 1 100. 0. 0.99998474 DISPLAY_IDENTIFIER CRLC_TEG_WALL_DOWN_2 ECU_ADDRESS 0x3fcdb2 BYTE_ORDER MSB_LAST FORMAT "%7.5" /end MEASUREMENT
/begin MEASUREMENT teg_2.wall_down_struct.crlc_teg_wall_toil_tco_down "Corelation constant received at TCO TOIL calculation" UWORD _CNV_A_R_LINEAR_____37_CM 1 100. 0. 0.99998474 DISPLAY_IDENTIFIER CRLC_TEG_WALL_TOIL_TCO_DOWN_2 ECU_ADDRESS 0x3fcdb4 BYTE_ORDER MSB_LAST FORMAT "%7.5" /end MEASUREMENT
/begin MEASUREMENT teg_2.wall_down_struct.crlc_teg_wall_egy_down "Corelation constant received at energy calculation" UWORD _CNV_A_R_LINEAR_____37_CM 1 100. 0. 0.99998474 DISPLAY_IDENTIFIER CRLC_TEG_WALL_EGY_DOWN_2 ECU_ADDRESS 0x3fcdb6 BYTE_ORDER MSB_LAST FORMAT "%7.5" /end MEASUREMENT
/begin MEASUREMENT teg_2.wall_down_struct.egy_teg_wall_end_sp_down "Energy setpoint  for Temperature Model beginning from start" ULONG _CNV_A_R_LINEAR_____470_CM 1 100. 0. 7456.426 DISPLAY_IDENTIFIER EGY_TEG_WALL_END_SP_DOWN_2 ECU_ADDRESS 0x3fcdb8 BYTE_ORDER MSB_LAST FORMAT "%12.7" /end MEASUREMENT
/begin MEASUREMENT teg_2.wall_down_struct.egy_teg_wall_end_av_down "Actual value Energy for Temperature Model beginning from start" ULONG _CNV_A_R_LINEAR_____470_CM 1 100. 0. 7456.426 DISPLAY_IDENTIFIER EGY_TEG_WALL_END_AV_DOWN_2 ECU_ADDRESS 0x3fcdbc BYTE_ORDER MSB_LAST FORMAT "%12.7" /end MEASUREMENT
/begin MEASUREMENT teg_2.wall_down_struct.crlc_teg_wall_bas_down "" UWORD _CNV_A_R_LINEAR_____37_CM 1 100. 0. 0.99998474 DISPLAY_IDENTIFIER CRLC_TEG_WALL_BAS_DOWN_2 ECU_ADDRESS 0x3fcdb0 BYTE_ORDER MSB_LAST FORMAT "%7.5" /end MEASUREMENT
/begin MEASUREMENT teg_2.wall_down_struct.teg_wall_cor_eff_iga_down "Temp. correction power loss by ignition angle difference" UWORD _CNV_A_R_LINEAR_____468_CM 1 100. 0. 983.025 DISPLAY_IDENTIFIER TEG_WALL_COR_EFF_IGA_DOWN_2 ECU_ADDRESS 0x3fcd9c BYTE_ORDER MSB_LAST FORMAT "%6.2" /end MEASUREMENT
/begin MEASUREMENT teg_2.wall_down_struct.teg_wall_scc_tco_down "Additive Single cylinder shut off temp. correction" UBYTE _CNV_A_R_LINEAR_____11_CM 1 100. -48. 142.5 DISPLAY_IDENTIFIER TEG_WALL_SCC_TCO_DOWN_2 ECU_ADDRESS 0x3fcda0 FORMAT "%5.1" /end MEASUREMENT
/begin MEASUREMENT teg_2.wall_down_struct.teg_wall_cor_veh_down "Entire vehicle influences correction" SWORD _CNV_A_R_LINEAR_____472_CM 1 100. -491.519999999553 491.5 DISPLAY_IDENTIFIER TEG_WALL_COR_VEH_DOWN_2 ECU_ADDRESS 0x3fcda4 BYTE_ORDER MSB_LAST FORMAT "%7.2" /end MEASUREMENT
/begin MEASUREMENT teg_2.wall_down_struct.fac_cor_vs_teg_wall_down "Vehicle speed correction" SWORD _CNV_A_R_LINEAR_____276_CM 1 100. -2. 1.999938965 DISPLAY_IDENTIFIER FAC_COR_VS_TEG_WALL_DOWN_2 ECU_ADDRESS 0x3fcda6 BYTE_ORDER MSB_LAST FORMAT "%8.4" /end MEASUREMENT
/begin MEASUREMENT teg_2.wall_down_struct.teg_wall_cor_tco_ex_down "Cooling temperature outlet correction" SWORD _CNV_A_R_LINEAR_____473_CM 1 100. -202. 202. DISPLAY_IDENTIFIER TEG_WALL_COR_TCO_EX_DOWN_2 ECU_ADDRESS 0x3fcda8 BYTE_ORDER MSB_LAST FORMAT "%7.3" /end MEASUREMENT
/begin MEASUREMENT teg_2.wall_down_struct.vs_cor_ecf_teg_wall_down "Vehicle speed correction ecf" UBYTE _CNV_A_R_LINEAR_____23_CM 1 100. 0. 255. DISPLAY_IDENTIFIER VS_COR_ECF_TEG_WALL_DOWN_2 ECU_ADDRESS 0x3fcdaa FORMAT "%3.0" /end MEASUREMENT
/begin MEASUREMENT teg_2.wall_down_struct.vs_cor_teg_wall_down "Vehicle speed correction" UBYTE _CNV_A_R_LINEAR_____23_CM 1 100. 0. 255. DISPLAY_IDENTIFIER VS_COR_TEG_WALL_DOWN_2 ECU_ADDRESS 0x3fcdab FORMAT "%3.0" /end MEASUREMENT
/begin MEASUREMENT teg_2.dew_point_struct.lv_teg_min_thd "dew point has been reached" UBYTE _CNV_S_2_RANGE______2_CM 1 100. 0. 1. DISPLAY_IDENTIFIER LV_TEG_MIN_THD_2 ECU_ADDRESS 0x3fcdc8 /end MEASUREMENT
/begin MEASUREMENT teg_2.dew_point_struct.lv_teg_cat_down_min_thd "dew point has been reached bat and pre/post cat. specific" UBYTE _CNV_S_2_RANGE______2_CM 1 100. 0. 1. DISPLAY_IDENTIFIER LV_TEG_CAT_DOWN_MIN_THD_2 ECU_ADDRESS 0x3fcdca /end MEASUREMENT
/begin MEASUREMENT teg_2.dew_point_struct.lv_teg_cat_up_min_thd "dew point has been reached bat and pre/post cat. specific" UBYTE _CNV_S_2_RANGE______2_CM 1 100. 0. 1. DISPLAY_IDENTIFIER LV_TEG_CAT_UP_MIN_THD_2 ECU_ADDRESS 0x3fcdc9 /end MEASUREMENT
/begin MEASUREMENT teg_cor_vo_up "Valve overlap temp. correction" SWORD _CNV_A_R_LINEAR_____472_CM 1 100. -491.519999999553 491.5 DISPLAY_IDENTIFIER TEG_COR_VO_UP ECU_ADDRESS 0x3fd6ec BYTE_ORDER MSB_LAST FORMAT "%7.2" /end MEASUREMENT
/begin MEASUREMENT temp_toil_dif "Oil temperature  difference" SWORD _CNV_A_R_LINEAR_____474_CM 1 100. -202. 202. DISPLAY_IDENTIFIER TEMP_TOIL_DIF ECU_ADDRESS 0x3fd6f4 BYTE_ORDER MSB_LAST FORMAT "%8.3" /end MEASUREMENT
/begin MEASUREMENT temp_tco_ex_dif "Coolant outlet temperature difference" SWORD _CNV_A_R_LINEAR_____475_CM 1 100. -202. 202. DISPLAY_IDENTIFIER TEMP_TCO_EX_DIF ECU_ADDRESS 0x3fd6fa BYTE_ORDER MSB_LAST FORMAT "%6.1" /end MEASUREMENT
/begin MEASUREMENT crlc_teg_toil_dif_up "Correlation constant by TOIL_DIF" UWORD _CNV_A_R_LINEAR_____394_CM 1 100. 0. 7.99987793 DISPLAY_IDENTIFIER CRLC_TEG_TOIL_DIF_UP ECU_ADDRESS 0x3fd6fe BYTE_ORDER MSB_LAST FORMAT "%6.4" /end MEASUREMENT
/begin MEASUREMENT crlc_teg_tco_dif_up "Correlation constant by TCO_DIF" UWORD _CNV_A_R_LINEAR_____394_CM 1 100. 0. 7.99987793 DISPLAY_IDENTIFIER CRLC_TEG_TCO_DIF_UP ECU_ADDRESS 0x3fd700 BYTE_ORDER MSB_LAST FORMAT "%6.4" /end MEASUREMENT
/begin MEASUREMENT crlc_teg_toil_dif_down "Correlation constant by TOIL_DIF post cat." UWORD _CNV_A_R_LINEAR_____394_CM 1 100. 0. 7.99987793 DISPLAY_IDENTIFIER CRLC_TEG_TOIL_DIF_DOWN ECU_ADDRESS 0x3fd70c BYTE_ORDER MSB_LAST FORMAT "%6.4" /end MEASUREMENT
/begin MEASUREMENT crlc_teg_tco_dif_down "Correlation constant by TCO_DIF post cat." UWORD _CNV_A_R_LINEAR_____394_CM 1 100. 0. 7.99987793 DISPLAY_IDENTIFIER CRLC_TEG_TCO_DIF_DOWN ECU_ADDRESS 0x3fd70e BYTE_ORDER MSB_LAST FORMAT "%6.4" /end MEASUREMENT
/begin MEASUREMENT crlc_teg_wall_toil_dif_up "Correlation constant by TOIL_DIF" UWORD _CNV_A_R_LINEAR_____394_CM 1 100. 0. 7.99987793 DISPLAY_IDENTIFIER CRLC_TEG_WALL_TOIL_DIF_UP ECU_ADDRESS 0x3fd718 BYTE_ORDER MSB_LAST FORMAT "%6.4" /end MEASUREMENT
/begin MEASUREMENT crlc_teg_wall_tco_dif_up "Correlation constant by TCO_DIF" UWORD _CNV_A_R_LINEAR_____394_CM 1 100. 0. 7.99987793 DISPLAY_IDENTIFIER CRLC_TEG_WALL_TCO_DIF_UP ECU_ADDRESS 0x3fd71a BYTE_ORDER MSB_LAST FORMAT "%6.4" /end MEASUREMENT
/begin MEASUREMENT teg_wall_cor_vo_down "Valve overlap temp. correction " SWORD _CNV_A_R_LINEAR_____472_CM 1 100. -491.519999999553 491.5 DISPLAY_IDENTIFIER TEG_WALL_COR_VO_DOWN ECU_ADDRESS 0x3fd71c BYTE_ORDER MSB_LAST FORMAT "%7.2" /end MEASUREMENT
/begin MEASUREMENT teg_stat_max "Maximum avalible steady state exhaust gas temperature for Nox-Cat. desulfation" UWORD _CNV_A_R_LINEAR_____6_CM 1 100. 0. 2047. DISPLAY_IDENTIFIER TEG_STAT_MAX ECU_ADDRESS 0x3fd728 BYTE_ORDER MSB_LAST FORMAT "%7.2" /end MEASUREMENT
/begin CHARACTERISTIC ip_temp_sp_toil "Reference engine oil temperature" MAP 0xffe47a1f _REC_MAP_20_u1_u2_u2 200. _CNV_A_R_LINEAR_____14_CM -40. 160. DISPLAY_IDENTIFIER IP_TEMP_SP_TOIL FORMAT "%3.0"
 /begin AXIS_DESCR COM_AXIS maf_teg _CNV_A_R_LINEAR_____108_CM 8 0. 1389. FORMAT "%7.2" AXIS_PTS_REF ldpm_maf_teg__teg_stat /end AXIS_DESCR
 /begin AXIS_DESCR COM_AXIS n_teg _CNV_A_R_LINEAR_____10_CM 8 0. 8160. FORMAT "%4.0" AXIS_PTS_REF ldpm_n_teg__teg_stat /end AXIS_DESCR
/end CHARACTERISTIC
/begin CHARACTERISTIC ip_fac_cor_lamb_sp_up "Lambda influences correction" CURVE 0xffe4aea2 _REC_CUR_20_u2_u2 1.99996948 _CNV_A_R_LINEAR_____20_CM 0. 1.99996948 DISPLAY_IDENTIFIER IP_FAC_COR_LAMB_SP_UP FORMAT "%7.5"
 /begin AXIS_DESCR COM_AXIS teg_1.appl_inc_struct.lamb_sp_teg _CNV_A_R_LINEAR_____206_CM 16 0. 31.99902344 FORMAT "%7.4" AXIS_PTS_REF ldpm_lamb_sp_teg__fac_cor /end AXIS_DESCR
/end CHARACTERISTIC
/begin CHARACTERISTIC ip_fac_scc_teg "Single cylinder shut off influence of exhaust temperature " CURVE 0xffe4b3a6 _REC_CUR_20_u2_u1 0.99998474 _CNV_A_R_LINEAR_____37_CM 0. 0.99998474 DISPLAY_IDENTIFIER IP_FAC_SCC_TEG FORMAT "%7.5"
 /begin AXIS_DESCR COM_AXIS teg_1.appl_inc_struct.nr_cyl_scc_teg _CNV_A_R_LINEAR_____441_CM 14 0. 13. FORMAT "%4.1" AXIS_PTS_REF ldpm_nr_cyl_scc_teg__fac_scc /end AXIS_DESCR
/end CHARACTERISTIC
/begin CHARACTERISTIC ip_fac_toil_vs "Vs influence of oil temeperature" CURVE 0xffe4b732 _REC_CUR_20_u2_u1 1.99996948 _CNV_A_R_LINEAR_____20_CM 0. 1.99996948 DISPLAY_IDENTIFIER IP_FAC_TOIL_VS FORMAT "%7.5"
 /begin AXIS_DESCR COM_AXIS vs _CNV_A_R_LINEAR_____23_CM 6 0. 255. FORMAT "%3.0" AXIS_PTS_REF ldpm_vs__fac_cor_vs_teg /end AXIS_DESCR
/end CHARACTERISTIC
/begin CHARACTERISTIC ip_temp_sp_tco_ex "Reference TCO_EX temperature" MAP 0xffe479df _REC_MAP_20_u1_u2_u2 190.5 _CNV_A_R_LINEAR_____11_CM -48. 142.5 DISPLAY_IDENTIFIER IP_TEMP_SP_TCO_EX FORMAT "%5.1"
 /begin AXIS_DESCR COM_AXIS maf_teg _CNV_A_R_LINEAR_____108_CM 8 0. 1389. FORMAT "%7.2" AXIS_PTS_REF ldpm_maf_teg__teg_stat /end AXIS_DESCR
 /begin AXIS_DESCR COM_AXIS n_teg _CNV_A_R_LINEAR_____10_CM 8 0. 8160. FORMAT "%4.0" AXIS_PTS_REF ldpm_n_teg__teg_stat /end AXIS_DESCR
/end CHARACTERISTIC
/begin CHARACTERISTIC ip_teg_stat_up_1 "Basic pre control engine temperature" MAP 0xffe4eec6 _REC_MAP_20_u2_u2_u2 1507.3 _CNV_A_R_LINEAR_____280_CM -48. 1459.3 DISPLAY_IDENTIFIER IP_TEG_STAT_UP_1 FORMAT "%7.2"
 /begin AXIS_DESCR COM_AXIS maf_teg _CNV_A_R_LINEAR_____108_CM 8 0. 1389. FORMAT "%7.2" AXIS_PTS_REF ldpm_maf_teg__teg_stat /end AXIS_DESCR
 /begin AXIS_DESCR COM_AXIS n_teg _CNV_A_R_LINEAR_____10_CM 8 0. 8160. FORMAT "%4.0" AXIS_PTS_REF ldpm_n_teg__teg_stat /end AXIS_DESCR
/end CHARACTERISTIC
/begin CHARACTERISTIC ip_teg_wall_stat_up_1 "Basic pre control engine temperature " MAP 0xffe4f28e _REC_MAP_20_u2_u2_u2 1507.3 _CNV_A_R_LINEAR_____280_CM -48. 1459.3 DISPLAY_IDENTIFIER IP_TEG_WALL_STAT_UP_1 FORMAT "%7.2"
 /begin AXIS_DESCR COM_AXIS maf_teg _CNV_A_R_LINEAR_____108_CM 8 0. 1389. FORMAT "%7.2" AXIS_PTS_REF ldpm_maf_teg__teg_stat /end AXIS_DESCR
 /begin AXIS_DESCR COM_AXIS n_teg _CNV_A_R_LINEAR_____10_CM 8 0. 8160. FORMAT "%4.0" AXIS_PTS_REF ldpm_n_teg__teg_stat /end AXIS_DESCR
/end CHARACTERISTIC
/begin CHARACTERISTIC ip_fac_teg_wall_cor_lamb_sp_up "Lambda influences correction depending on load engine" MAP 0xffe4b5aa _REC_MAP_20_u2_u2_u2 1.99996948 _CNV_A_R_LINEAR_____20_CM 0. 1.99996948 DISPLAY_IDENTIFIER IP_FAC_TEG_WALL_COR_LAMB_SP_UP FORMAT "%7.5"
 /begin AXIS_DESCR COM_AXIS maf_teg _CNV_A_R_LINEAR_____108_CM 8 0. 1389. FORMAT "%7.2" AXIS_PTS_REF ldpm_maf_teg__teg_stat /end AXIS_DESCR
 /begin AXIS_DESCR COM_AXIS n_teg _CNV_A_R_LINEAR_____10_CM 8 0. 8160. FORMAT "%4.0" AXIS_PTS_REF ldpm_n_teg__teg_stat /end AXIS_DESCR
/end CHARACTERISTIC
/begin CHARACTERISTIC ip_teg_add_egr "EGR influence Temperature" MAP 0xffe4ebe2 _REC_MAP_20_u2_u2_u2 983.025 _CNV_A_R_LINEAR_____471_CM -491.52 491.505 DISPLAY_IDENTIFIER IP_TEG_ADD_EGR FORMAT "%7.2"
 /begin AXIS_DESCR COM_AXIS online_dummy _CNV_A_R_LINEAR_____280_CM 6 -48. 1459.3 FORMAT "%7.2" AXIS_PTS_REF ldpm_teg_stat_eng_pre /end AXIS_DESCR
 /begin AXIS_DESCR COM_AXIS egr_ratio _CNV_A_R_LINEAR_____8_CM 6 0. 99.99847412 AXIS_PTS_REF ldpm_egr_ratio__teg /end AXIS_DESCR
/end CHARACTERISTIC
/begin CHARACTERISTIC ip_teg_wall_add_egr "EGR influence Temperature" MAP 0xffe4efc6 _REC_MAP_20_u2_u2_u2 983.025 _CNV_A_R_LINEAR_____471_CM -491.52 491.505 DISPLAY_IDENTIFIER IP_TEG_WALL_ADD_EGR FORMAT "%7.2"
 /begin AXIS_DESCR COM_AXIS online_dummy _CNV_A_R_LINEAR_____280_CM 6 -48. 1459.3 FORMAT "%7.2" AXIS_PTS_REF ldpm_teg_stat_eng_pre /end AXIS_DESCR
 /begin AXIS_DESCR COM_AXIS egr_ratio _CNV_A_R_LINEAR_____8_CM 6 0. 99.99847412 AXIS_PTS_REF ldpm_egr_ratio__teg /end AXIS_DESCR
/end CHARACTERISTIC
/begin CHARACTERISTIC ip_fac_cor_lamb_sp_wall_up "Lambda influences correction" CURVE 0xffe4aec2 _REC_CUR_20_u2_u2 1.99996948 _CNV_A_R_LINEAR_____20_CM 0. 1.99996948 DISPLAY_IDENTIFIER IP_FAC_COR_LAMB_SP_WALL_UP FORMAT "%7.5"
 /begin AXIS_DESCR COM_AXIS teg_1.appl_inc_struct.lamb_sp_teg _CNV_A_R_LINEAR_____206_CM 16 0. 31.99902344 FORMAT "%7.4" AXIS_PTS_REF ldpm_lamb_sp_teg__fac_cor /end AXIS_DESCR
/end CHARACTERISTIC
/begin CHARACTERISTIC ip_crlc_teg_dec_puc_up_1 "Map of correlation constant by fuel cut off" CURVE 0xffe49364 _REC_CUR_20_u2_u2 0.99998474 _CNV_A_R_LINEAR_____37_CM 0. 0.99998474 DISPLAY_IDENTIFIER IP_CRLC_TEG_DEC_PUC_UP_1 FORMAT "%7.5"
 /begin AXIS_DESCR COM_AXIS online_dummy _CNV_A_R_LINEAR_____287_CM 8 0. 1820.398 FORMAT "%7.2" AXIS_PTS_REF ldpm_maf_int_puc__crlc_teg /end AXIS_DESCR
/end CHARACTERISTIC
/begin CHARACTERISTIC ip_crlc_teg_wall_dec_puc_up_1 "Map of correlation constant by fuel cut off" CURVE 0xffe499e4 _REC_CUR_20_u2_u2 0.99998474 _CNV_A_R_LINEAR_____37_CM 0. 0.99998474 DISPLAY_IDENTIFIER IP_CRLC_TEG_WALL_DEC_PUC_UP_1 FORMAT "%7.5"
 /begin AXIS_DESCR COM_AXIS online_dummy _CNV_A_R_LINEAR_____287_CM 8 0. 1820.398 FORMAT "%7.2" AXIS_PTS_REF ldpm_maf_int_puc__crlc_teg /end AXIS_DESCR
/end CHARACTERISTIC
/begin CHARACTERISTIC ip_crlc_teg_inc_up_1 "Map of correlation constant by heating" MAP 0xffe49684 _REC_MAP_20_u2_u2_u2 0.99998474 _CNV_A_R_LINEAR_____37_CM 0. 0.99998474 DISPLAY_IDENTIFIER IP_CRLC_TEG_INC_UP_1 FORMAT "%7.5"
 /begin AXIS_DESCR COM_AXIS online_dummy _CNV_A_R_LINEAR_____280_CM 12 -48. 1459.3 FORMAT "%7.2" AXIS_PTS_REF ldpm_teg_stat__crlc_inc /end AXIS_DESCR
 /begin AXIS_DESCR COM_AXIS n_teg _CNV_A_R_LINEAR_____10_CM 8 0. 8160. FORMAT "%4.0" AXIS_PTS_REF ldpm_n_teg__crlc_teg /end AXIS_DESCR
/end CHARACTERISTIC
/begin CHARACTERISTIC ip_crlc_teg_wall_inc_up_1 "Map of correlation constant by heating" MAP 0xffe49d04 _REC_MAP_20_u2_u2_u2 0.99998474 _CNV_A_R_LINEAR_____37_CM 0. 0.99998474 DISPLAY_IDENTIFIER IP_CRLC_TEG_WALL_INC_UP_1 FORMAT "%7.5"
 /begin AXIS_DESCR COM_AXIS online_dummy _CNV_A_R_LINEAR_____280_CM 12 -48. 1459.3 FORMAT "%7.2" AXIS_PTS_REF ldpm_teg_wall_stat__crlc_inc /end AXIS_DESCR
 /begin AXIS_DESCR COM_AXIS n_teg _CNV_A_R_LINEAR_____10_CM 8 0. 8160. FORMAT "%4.0" AXIS_PTS_REF ldpm_n_teg__crlc_teg /end AXIS_DESCR
/end CHARACTERISTIC
/begin CHARACTERISTIC ip_crlc_teg_dec_up_1 "Map of correlation constant by cooling" MAP 0xffe49384 _REC_MAP_20_u2_u2_u2 0.99998474 _CNV_A_R_LINEAR_____37_CM 0. 0.99998474 DISPLAY_IDENTIFIER IP_CRLC_TEG_DEC_UP_1 FORMAT "%7.5"
 /begin AXIS_DESCR COM_AXIS online_dummy _CNV_A_R_LINEAR_____280_CM 12 -48. 1459.3 FORMAT "%7.2" AXIS_PTS_REF ldpm_teg_stat__crlc_dec /end AXIS_DESCR
 /begin AXIS_DESCR COM_AXIS n_teg _CNV_A_R_LINEAR_____10_CM 8 0. 8160. FORMAT "%4.0" AXIS_PTS_REF ldpm_n_teg__crlc_teg /end AXIS_DESCR
/end CHARACTERISTIC
/begin CHARACTERISTIC ip_crlc_teg_wall_dec_up_1 "Map of correlation constant by cooling" MAP 0xffe49a04 _REC_MAP_20_u2_u2_u2 0.99998474 _CNV_A_R_LINEAR_____37_CM 0. 0.99998474 DISPLAY_IDENTIFIER IP_CRLC_TEG_WALL_DEC_UP_1 FORMAT "%7.5"
 /begin AXIS_DESCR COM_AXIS online_dummy _CNV_A_R_LINEAR_____280_CM 12 -48. 1459.3 FORMAT "%7.2" AXIS_PTS_REF ldpm_teg_wall_stat__crlc_dec /end AXIS_DESCR
 /begin AXIS_DESCR COM_AXIS n_teg _CNV_A_R_LINEAR_____10_CM 8 0. 8160. FORMAT "%4.0" AXIS_PTS_REF ldpm_n_teg__crlc_teg /end AXIS_DESCR
/end CHARACTERISTIC
/begin CHARACTERISTIC ip_teg_stat_down_1 "Basic pre control engine temperature " MAP 0xffe4edc6 _REC_MAP_20_u2_u2_u2 1507.3 _CNV_A_R_LINEAR_____280_CM -48. 1459.3 DISPLAY_IDENTIFIER IP_TEG_STAT_DOWN_1 FORMAT "%7.2"
 /begin AXIS_DESCR COM_AXIS maf_teg _CNV_A_R_LINEAR_____108_CM 8 0. 1389. FORMAT "%7.2" AXIS_PTS_REF ldpm_maf_teg__teg_stat /end AXIS_DESCR
 /begin AXIS_DESCR COM_AXIS n_teg _CNV_A_R_LINEAR_____10_CM 8 0. 8160. FORMAT "%4.0" AXIS_PTS_REF ldpm_n_teg__teg_stat /end AXIS_DESCR
/end CHARACTERISTIC
/begin CHARACTERISTIC ip_teg_wall_stat_down_1 "Basic pre control engine temperature " MAP 0xffe4f18e _REC_MAP_20_u2_u2_u2 1507.3 _CNV_A_R_LINEAR_____280_CM -48. 1459.3 DISPLAY_IDENTIFIER IP_TEG_WALL_STAT_DOWN_1 FORMAT "%7.2"
 /begin AXIS_DESCR COM_AXIS maf_teg _CNV_A_R_LINEAR_____108_CM 8 0. 1389. FORMAT "%7.2" AXIS_PTS_REF ldpm_maf_teg__teg_stat /end AXIS_DESCR
 /begin AXIS_DESCR COM_AXIS n_teg _CNV_A_R_LINEAR_____10_CM 8 0. 8160. FORMAT "%4.0" AXIS_PTS_REF ldpm_n_teg__teg_stat /end AXIS_DESCR
/end CHARACTERISTIC
/begin CHARACTERISTIC ip_crlc_teg_toil_dif_down "Map of correlation constant depending on TOIL difference post cat" CURVE 0xffe49824 _REC_CUR_20_u2_u2 7.99987793 _CNV_A_R_LINEAR_____394_CM 0. 7.99987793 DISPLAY_IDENTIFIER IP_CRLC_TEG_TOIL_DIF_DOWN FORMAT "%6.4"
 /begin AXIS_DESCR COM_AXIS temp_toil_dif _CNV_A_R_LINEAR_____476_CM 8 -202. 202. FORMAT "%6.1" AXIS_PTS_REF ldpm_temp_toil_dif__crlc_teg /end AXIS_DESCR
/end CHARACTERISTIC
/begin CHARACTERISTIC ip_crlc_teg_wall_toil_dif_down "Map of correlation constant depending on TOIL difference post cat" CURVE 0xffe49ea4 _REC_CUR_20_u2_u2 7.99987793 _CNV_A_R_LINEAR_____394_CM 0. 7.99987793 DISPLAY_IDENTIFIER IP_CRLC_TEG_WALL_TOIL_DIF_DOWN FORMAT "%6.4"
 /begin AXIS_DESCR COM_AXIS temp_toil_dif _CNV_A_R_LINEAR_____476_CM 8 -202. 202. FORMAT "%6.1" AXIS_PTS_REF ldpm_temp_toil_dif__crlc_teg /end AXIS_DESCR
/end CHARACTERISTIC
/begin CHARACTERISTIC ip_crlc_teg_tco_dif_down "Map of correlation constant depending on TCO difference post cat" CURVE 0xffe49804 _REC_CUR_20_u2_u2 7.99987793 _CNV_A_R_LINEAR_____394_CM 0. 7.99987793 DISPLAY_IDENTIFIER IP_CRLC_TEG_TCO_DIF_DOWN FORMAT "%6.4"
 /begin AXIS_DESCR COM_AXIS temp_tco_dif _CNV_A_R_LINEAR_____477_CM 8 -202. 202. FORMAT "%6.1" AXIS_PTS_REF ldpm_temp_tco_dif__crlc_teg /end AXIS_DESCR
/end CHARACTERISTIC
/begin CHARACTERISTIC ip_crlc_teg_wall_tco_dif_down "Map of correlation constant depending on TCO difference post cat" CURVE 0xffe49e84 _REC_CUR_20_u2_u2 7.99987793 _CNV_A_R_LINEAR_____394_CM 0. 7.99987793 DISPLAY_IDENTIFIER IP_CRLC_TEG_WALL_TCO_DIF_DOWN FORMAT "%6.4"
 /begin AXIS_DESCR COM_AXIS temp_tco_dif _CNV_A_R_LINEAR_____477_CM 8 -202. 202. FORMAT "%6.1" AXIS_PTS_REF ldpm_temp_tco_dif__crlc_teg /end AXIS_DESCR
/end CHARACTERISTIC
/begin CHARACTERISTIC ip_crlc_teg_dec_puc_down_1 "Map of correlation constant by fuel cut off post cat." CURVE 0xffe49344 _REC_CUR_20_u2_u2 0.99998474 _CNV_A_R_LINEAR_____37_CM 0. 0.99998474 DISPLAY_IDENTIFIER IP_CRLC_TEG_DEC_PUC_DOWN_1 FORMAT "%7.5"
 /begin AXIS_DESCR COM_AXIS online_dummy _CNV_A_R_LINEAR_____287_CM 8 0. 1820.398 FORMAT "%7.2" AXIS_PTS_REF ldpm_maf_int_puc__crlc_teg /end AXIS_DESCR
/end CHARACTERISTIC
/begin CHARACTERISTIC ip_crlc_teg_wall_dec_puc_down_1 "Map of correlation constant by fuel cut off post cat." CURVE 0xffe499c4 _REC_CUR_20_u2_u2 0.99998474 _CNV_A_R_LINEAR_____37_CM 0. 0.99998474 DISPLAY_IDENTIFIER IP_CRLC_TEG_WALL_DEC_PUC_DOWN_1 FORMAT "%7.5"
 /begin AXIS_DESCR COM_AXIS online_dummy _CNV_A_R_LINEAR_____287_CM 8 0. 1820.398 FORMAT "%7.2" AXIS_PTS_REF ldpm_maf_int_puc__crlc_teg /end AXIS_DESCR
/end CHARACTERISTIC
/begin CHARACTERISTIC ip_crlc_teg_dec_down_1 "Map of correlation constant by cooling post cat." MAP 0xffe491c4 _REC_MAP_20_u2_u2_u2 0.99998474 _CNV_A_R_LINEAR_____37_CM 0. 0.99998474 DISPLAY_IDENTIFIER IP_CRLC_TEG_DEC_DOWN_1 FORMAT "%7.5"
 /begin AXIS_DESCR COM_AXIS online_dummy _CNV_A_R_LINEAR_____280_CM 12 -48. 1459.3 FORMAT "%7.2" AXIS_PTS_REF ldpm_teg_stat__crlc_dec /end AXIS_DESCR
 /begin AXIS_DESCR COM_AXIS n_teg _CNV_A_R_LINEAR_____10_CM 8 0. 8160. FORMAT "%4.0" AXIS_PTS_REF ldpm_n_teg__crlc_teg /end AXIS_DESCR
/end CHARACTERISTIC
/begin CHARACTERISTIC ip_crlc_teg_wall_dec_down_1 "Map of correlation constant by cooling post cat." MAP 0xffe49844 _REC_MAP_20_u2_u2_u2 0.99998474 _CNV_A_R_LINEAR_____37_CM 0. 0.99998474 DISPLAY_IDENTIFIER IP_CRLC_TEG_WALL_DEC_DOWN_1 FORMAT "%7.5"
 /begin AXIS_DESCR COM_AXIS online_dummy _CNV_A_R_LINEAR_____280_CM 12 -48. 1459.3 FORMAT "%7.2" AXIS_PTS_REF ldpm_teg_wall_stat__crlc_dec /end AXIS_DESCR
 /begin AXIS_DESCR COM_AXIS n_teg _CNV_A_R_LINEAR_____10_CM 8 0. 8160. FORMAT "%4.0" AXIS_PTS_REF ldpm_n_teg__crlc_teg /end AXIS_DESCR
/end CHARACTERISTIC
/begin CHARACTERISTIC ip_crlc_teg_inc_down_1 "Map of correlation constant by heating post cat." MAP 0xffe49504 _REC_MAP_20_u2_u2_u2 0.99998474 _CNV_A_R_LINEAR_____37_CM 0. 0.99998474 DISPLAY_IDENTIFIER IP_CRLC_TEG_INC_DOWN_1 FORMAT "%7.5"
 /begin AXIS_DESCR COM_AXIS online_dummy _CNV_A_R_LINEAR_____280_CM 12 -48. 1459.3 FORMAT "%7.2" AXIS_PTS_REF ldpm_teg_stat__crlc_inc /end AXIS_DESCR
 /begin AXIS_DESCR COM_AXIS n_teg _CNV_A_R_LINEAR_____10_CM 8 0. 8160. FORMAT "%4.0" AXIS_PTS_REF ldpm_n_teg__crlc_teg /end AXIS_DESCR
/end CHARACTERISTIC
/begin CHARACTERISTIC ip_crlc_teg_wall_inc_down_1 "Map of correlation constant by heating post cat." MAP 0xffe49b84 _REC_MAP_20_u2_u2_u2 0.99998474 _CNV_A_R_LINEAR_____37_CM 0. 0.99998474 DISPLAY_IDENTIFIER IP_CRLC_TEG_WALL_INC_DOWN_1 FORMAT "%7.5"
 /begin AXIS_DESCR COM_AXIS online_dummy _CNV_A_R_LINEAR_____280_CM 12 -48. 1459.3 FORMAT "%7.2" AXIS_PTS_REF ldpm_teg_wall_stat__crlc_inc /end AXIS_DESCR
 /begin AXIS_DESCR COM_AXIS n_teg _CNV_A_R_LINEAR_____10_CM 8 0. 8160. FORMAT "%4.0" AXIS_PTS_REF ldpm_n_teg__crlc_teg /end AXIS_DESCR
/end CHARACTERISTIC
/begin CHARACTERISTIC c_tam_ref "Reference ambient temperature" VALUE 0xffe408e0 _REC_VAL_20_u1 190.5 _CNV_A_R_LINEAR_____11_CM -48. 142.5 DISPLAY_IDENTIFIER C_TAM_REF FORMAT "%5.1" /end CHARACTERISTIC
/begin CHARACTERISTIC c_maf_int_teg_st_up "Correlation constant at start" VALUE 0xffe41792 _REC_VAL_20_u2 1820.398 _CNV_A_R_LINEAR_____287_CM 0. 1820.398 DISPLAY_IDENTIFIER C_MAF_INT_TEG_ST_UP FORMAT "%7.2" /end CHARACTERISTIC
/begin CHARACTERISTIC c_crlc_teg_st_up "Correlation constant at start" VALUE 0xffe41572 _REC_VAL_20_u2 0.999755 _CNV_A_R_LINEAR_____126_CM 0. 0.999755 DISPLAY_IDENTIFIER C_CRLC_TEG_ST_UP FORMAT "%7.5" /end CHARACTERISTIC
/begin CHARACTERISTIC c_egy_teg_end_sp_up_1 "Threshold of energy setpoint after start" VALUE 0xffe415d8 _REC_VAL_20_u2 9.83 _CNV_A_R_LINEAR_____478_CM 0. 9.83 DISPLAY_IDENTIFIER C_EGY_TEG_END_SP_UP_1 FORMAT "%6.4" /end CHARACTERISTIC
/begin CHARACTERISTIC c_egy_teg_end_sp_up_2 "Threshold of energy setpoint after start" VALUE 0xffe415da _REC_VAL_20_u2 9.83 _CNV_A_R_LINEAR_____478_CM 0. 9.83 DISPLAY_IDENTIFIER C_EGY_TEG_END_SP_UP_2 FORMAT "%6.4" /end CHARACTERISTIC
/begin CHARACTERISTIC c_teg_wall_st_off "Temperature until temperature start  detection" VALUE 0xffe41a60 _REC_VAL_20_u2 1507.3 _CNV_A_R_LINEAR_____280_CM -48. 1459.3 DISPLAY_IDENTIFIER C_TEG_WALL_ST_OFF FORMAT "%7.2" /end CHARACTERISTIC
/begin CHARACTERISTIC c_crlc_teg_wall_st_end_up "Correlation constant at start" VALUE 0xffe41578 _REC_VAL_20_u2 0.999755 _CNV_A_R_LINEAR_____126_CM 0. 0.999755 DISPLAY_IDENTIFIER C_CRLC_TEG_WALL_ST_END_UP FORMAT "%7.5" /end CHARACTERISTIC
/begin CHARACTERISTIC c_crlc_teg_wall_st_up "Correlation constant at start" VALUE 0xffe4157a _REC_VAL_20_u2 0.999755 _CNV_A_R_LINEAR_____126_CM 0. 0.999755 DISPLAY_IDENTIFIER C_CRLC_TEG_WALL_ST_UP FORMAT "%7.5" /end CHARACTERISTIC
/begin CHARACTERISTIC c_egy_teg_wall_end_sp_up "Threshold of energy setpoint after start" VALUE 0xffe415de _REC_VAL_20_u2 9.83 _CNV_A_R_LINEAR_____478_CM 0. 9.83 DISPLAY_IDENTIFIER C_EGY_TEG_WALL_END_SP_UP FORMAT "%6.4" /end CHARACTERISTIC
/begin CHARACTERISTIC c_fac_cor_vo_teg_down "Valve overlap correction depending on load engine post cat" VALUE 0xffe415fe _REC_VAL_20_u2 1.99996948 _CNV_A_R_LINEAR_____20_CM 0. 1.99996948 DISPLAY_IDENTIFIER C_FAC_COR_VO_TEG_DOWN FORMAT "%7.5" /end CHARACTERISTIC
/begin CHARACTERISTIC c_fac_cor_vo_teg_wall_down "Valve overlap correction depending on load engine post cat" VALUE 0xffe41600 _REC_VAL_20_u2 1.99996948 _CNV_A_R_LINEAR_____20_CM 0. 1.99996948 DISPLAY_IDENTIFIER C_FAC_COR_VO_TEG_WALL_DOWN FORMAT "%7.5" /end CHARACTERISTIC
/begin CHARACTERISTIC c_fac_cor_lamb_sp_teg_down "Lambda influences correction depending on load engine post cat." VALUE 0xffe415f6 _REC_VAL_20_u2 1.99996948 _CNV_A_R_LINEAR_____20_CM 0. 1.99996948 DISPLAY_IDENTIFIER C_FAC_COR_LAMB_SP_TEG_DOWN FORMAT "%7.5" /end CHARACTERISTIC
/begin CHARACTERISTIC c_fac_cor_lamb_sp_teg_wall_down "Lambda influences correction depending on load engine post cat." VALUE 0xffe415f8 _REC_VAL_20_u2 1.99996948 _CNV_A_R_LINEAR_____20_CM 0. 1.99996948 DISPLAY_IDENTIFIER C_FAC_COR_LAMB_SP_TEG_WALL_DOWN FORMAT "%7.5" /end CHARACTERISTIC
/begin CHARACTERISTIC c_fac_cor_saf_teg_down "Secondary air influences correction post cat" VALUE 0xffe415fa _REC_VAL_20_u2 1.99996948 _CNV_A_R_LINEAR_____20_CM 0. 1.99996948 DISPLAY_IDENTIFIER C_FAC_COR_SAF_TEG_DOWN FORMAT "%7.5" /end CHARACTERISTIC
/begin CHARACTERISTIC c_fac_cor_saf_teg_wall_down "SAF influences correction depending on load engine post cat." VALUE 0xffe415fc _REC_VAL_20_u2 1.99996948 _CNV_A_R_LINEAR_____20_CM 0. 1.99996948 DISPLAY_IDENTIFIER C_FAC_COR_SAF_TEG_WALL_DOWN FORMAT "%7.5" /end CHARACTERISTIC
/begin CHARACTERISTIC c_fac_vs_teg_down "Vehicle speed correction depending on load Engine post cat" VALUE 0xffe41650 _REC_VAL_20_u2 1.99996948 _CNV_A_R_LINEAR_____20_CM 0. 1.99996948 DISPLAY_IDENTIFIER C_FAC_VS_TEG_DOWN FORMAT "%7.5" /end CHARACTERISTIC
/begin CHARACTERISTIC c_fac_vs_teg_wall_down "Vehicle speed correction depending on load Engine post cat" VALUE 0xffe41652 _REC_VAL_20_u2 1.99996948 _CNV_A_R_LINEAR_____20_CM 0. 1.99996948 DISPLAY_IDENTIFIER C_FAC_VS_TEG_WALL_DOWN FORMAT "%7.5" /end CHARACTERISTIC
/begin CHARACTERISTIC c_crlc_teg_wall_st_end_down "Correlation constant at start" VALUE 0xffe41576 _REC_VAL_20_u2 0.999755 _CNV_A_R_LINEAR_____126_CM 0. 0.999755 DISPLAY_IDENTIFIER C_CRLC_TEG_WALL_ST_END_DOWN FORMAT "%7.5" /end CHARACTERISTIC
/begin CHARACTERISTIC c_maf_int_teg_st_down "Threshold of mass air post cat." VALUE 0xffe41790 _REC_VAL_20_u2 1820.398 _CNV_A_R_LINEAR_____287_CM 0. 1820.398 DISPLAY_IDENTIFIER C_MAF_INT_TEG_ST_DOWN FORMAT "%7.2" /end CHARACTERISTIC
/begin CHARACTERISTIC c_maf_int_teg_wall_st_down "Threshold of mass air" VALUE 0xffe41794 _REC_VAL_20_u2 1820.398 _CNV_A_R_LINEAR_____287_CM 0. 1820.398 DISPLAY_IDENTIFIER C_MAF_INT_TEG_WALL_ST_DOWN FORMAT "%7.2" /end CHARACTERISTIC
/begin CHARACTERISTIC c_crlc_teg_st_down "Correlation constant at start post cat." VALUE 0xffe4156c _REC_VAL_20_u2 0.999755 _CNV_A_R_LINEAR_____126_CM 0. 0.999755 DISPLAY_IDENTIFIER C_CRLC_TEG_ST_DOWN FORMAT "%7.5" /end CHARACTERISTIC
/begin CHARACTERISTIC c_crlc_teg_wall_st_down "Correlation constant at start" VALUE 0xffe41574 _REC_VAL_20_u2 0.999755 _CNV_A_R_LINEAR_____126_CM 0. 0.999755 DISPLAY_IDENTIFIER C_CRLC_TEG_WALL_ST_DOWN FORMAT "%7.5" /end CHARACTERISTIC
/begin CHARACTERISTIC c_egy_teg_end_sp_down_1 "Threshold of energy setpoint after start post cat." VALUE 0xffe415d4 _REC_VAL_20_u2 9.83 _CNV_A_R_LINEAR_____478_CM 0. 9.83 DISPLAY_IDENTIFIER C_EGY_TEG_END_SP_DOWN_1 FORMAT "%6.4" /end CHARACTERISTIC
/begin CHARACTERISTIC c_egy_teg_end_sp_down_2 "Threshold of energy setpoint after start post cat." VALUE 0xffe415d6 _REC_VAL_20_u2 9.83 _CNV_A_R_LINEAR_____478_CM 0. 9.83 DISPLAY_IDENTIFIER C_EGY_TEG_END_SP_DOWN_2 FORMAT "%6.4" /end CHARACTERISTIC
/begin CHARACTERISTIC c_egy_teg_wall_end_sp_down "Threshold of energy setpoint after start" VALUE 0xffe415dc _REC_VAL_20_u2 9.83 _CNV_A_R_LINEAR_____478_CM 0. 9.83 DISPLAY_IDENTIFIER C_EGY_TEG_WALL_END_SP_DOWN FORMAT "%6.4" /end CHARACTERISTIC
/begin MEASUREMENT pow_dif_max "Maximum power loss for active Nox desulfation" UWORD _CNV_A_R_LINEAR_____479_CM 1 100. 0. 434.0555 DISPLAY_IDENTIFIER POW_DIF_MAX ECU_ADDRESS 0x3fd702 BYTE_ORDER MSB_LAST FORMAT "%7.3" /end MEASUREMENT
/begin MEASUREMENT tam_dew "Ambient temperature for the end of dew point module" UBYTE _CNV_A_R_LINEAR_____11_CM 1 100. -48. 142.5 DISPLAY_IDENTIFIER TAM_DEW ECU_ADDRESS 0x3fe67c FORMAT "%5.1" /end MEASUREMENT
/begin MEASUREMENT t_es_dew "Engine shut-off duration" UWORD _CNV_A_R_LINEAR_____97_CM 1 100. 0. 65535. DISPLAY_IDENTIFIER T_ES_DEW ECU_ADDRESS 0x3fd72a BYTE_ORDER MSB_LAST FORMAT "%5.0" /end MEASUREMENT
/begin MEASUREMENT egy_dew_stop_up "Additional amount of heat if dew point has not been reached" ULONG _CNV_A_R_LINEAR_____470_CM 1 100. 0. 7456.426 DISPLAY_IDENTIFIER EGY_DEW_STOP_UP ECU_ADDRESS 0x3fcdd4 BYTE_ORDER MSB_LAST FORMAT "%12.7" /end MEASUREMENT
/begin MEASUREMENT egy_dew_stop_down "Additional amount of heat if dew point has not been reached" ULONG _CNV_A_R_LINEAR_____470_CM 1 100. 0. 7456.426 DISPLAY_IDENTIFIER EGY_DEW_STOP_DOWN ECU_ADDRESS 0x3fcdd8 BYTE_ORDER MSB_LAST FORMAT "%12.7" /end MEASUREMENT
/begin MEASUREMENT egy_dew_end_down "Total amount of energy until end of dew point" ULONG _CNV_A_R_LINEAR_____470_CM 1 100. 0. 7456.426 DISPLAY_IDENTIFIER EGY_DEW_END_DOWN ECU_ADDRESS 0x3fcde0 BYTE_ORDER MSB_LAST FORMAT "%12.7" /end MEASUREMENT
/begin MEASUREMENT egy_dew_end_up "Total amount of energy until end of dew point" ULONG _CNV_A_R_LINEAR_____470_CM 1 100. 0. 7456.426 DISPLAY_IDENTIFIER EGY_DEW_END_UP ECU_ADDRESS 0x3fcddc BYTE_ORDER MSB_LAST FORMAT "%12.7" /end MEASUREMENT
/begin MEASUREMENT egy_dew_up "Energy which is converted in the exhaust gas until reaching the dew point" ULONG _CNV_A_R_LINEAR_____470_CM 1 100. 0. 7456.426 DISPLAY_IDENTIFIER EGY_DEW_UP ECU_ADDRESS 0x3fcde4 BYTE_ORDER MSB_LAST FORMAT "%12.7" /end MEASUREMENT
/begin MEASUREMENT egy_dew_down "Energy which is converted in the exhaust gas until reaching the dew point" ULONG _CNV_A_R_LINEAR_____470_CM 1 100. 0. 7456.426 DISPLAY_IDENTIFIER EGY_DEW_DOWN ECU_ADDRESS 0x3fcde8 BYTE_ORDER MSB_LAST FORMAT "%12.7" /end MEASUREMENT
/begin CHARACTERISTIC c_fac_lamb_teg_stat_max "temperature influence by lambda adjustments" VALUE 0xffe4160c _REC_VAL_20_u2 3.999939 _CNV_A_R_LINEAR_____272_CM 0. 3.999939 DISPLAY_IDENTIFIER C_FAC_LAMB_TEG_STAT_MAX FORMAT "%7.5" /end CHARACTERISTIC
/begin CHARACTERISTIC c_delta_tia "Differential temperature to Intake air temperature" VALUE 0xffe406e9 _REC_VAL_20_u1 190.5 _CNV_A_R_LINEAR_____11_CM -48. 142.5 DISPLAY_IDENTIFIER C_DELTA_TIA FORMAT "%5.1" /end CHARACTERISTIC
/begin CHARACTERISTIC c_t_es_dew_min "Minimum shut-off time for end of dew point calculation" VALUE 0xffe41966 _REC_VAL_20_u2 65535. _CNV_A_R_LINEAR_____97_CM 0. 65535. DISPLAY_IDENTIFIER C_T_ES_DEW_MIN FORMAT "%5.0" /end CHARACTERISTIC
/begin CHARACTERISTIC c_t_es_dew_max "Maximum shut-off time for end of dew point calculation" VALUE 0xffe41964 _REC_VAL_20_u2 65535. _CNV_A_R_LINEAR_____97_CM 0. 65535. DISPLAY_IDENTIFIER C_T_ES_DEW_MAX FORMAT "%5.0" /end CHARACTERISTIC
/begin CHARACTERISTIC ip_fac_cor_vo_up "Valve overlap correction" CURVE 0xffe4af42 _REC_CUR_20_u2_u2 4. _CNV_A_R_LINEAR_____275_CM -2. 2. DISPLAY_IDENTIFIER IP_FAC_COR_VO_UP FORMAT "%8.5"
 /begin AXIS_DESCR COM_AXIS vo_dif_teg _CNV_A_R_LINEAR_____480_CM 6 -95.625 95.625 FORMAT "%5.1" AXIS_PTS_REF ldpm_vo_dif_teg__teg_stat /end AXIS_DESCR
/end CHARACTERISTIC
/begin CHARACTERISTIC ip_fac_cor_vo_wall_up "Valve overlap correction" CURVE 0xffe4af4e _REC_CUR_20_u2_u2 4. _CNV_A_R_LINEAR_____275_CM -2. 2. DISPLAY_IDENTIFIER IP_FAC_COR_VO_WALL_UP FORMAT "%8.5"
 /begin AXIS_DESCR COM_AXIS vo_dif_teg _CNV_A_R_LINEAR_____480_CM 6 -95.625 95.625 FORMAT "%5.1" AXIS_PTS_REF ldpm_vo_dif_teg__teg_stat /end AXIS_DESCR
/end CHARACTERISTIC
/begin CHARACTERISTIC ip_fac_cor_saf_wall "SAF_KGH correktion" CURVE 0xffe4aeee _REC_CUR_20_u2_u2 1.99996948 _CNV_A_R_LINEAR_____20_CM 0. 1.99996948 DISPLAY_IDENTIFIER IP_FAC_COR_SAF_WALL FORMAT "%7.5"
 /begin AXIS_DESCR COM_AXIS saf_kgh _CNV_A_R_LINEAR_____47_CM 6 0. 1023.984375 FORMAT "%7.2" AXIS_PTS_REF ldpm_saf_kgh__fac_cor_saf /end AXIS_DESCR
/end CHARACTERISTIC
/begin CHARACTERISTIC ip_fac_scc_teg_wall "Single cylinder shut off influence of exhaust temperature " CURVE 0xffe4b3c2 _REC_CUR_20_u2_u1 0.99998474 _CNV_A_R_LINEAR_____37_CM 0. 0.99998474 DISPLAY_IDENTIFIER IP_FAC_SCC_TEG_WALL FORMAT "%7.5"
 /begin AXIS_DESCR COM_AXIS teg_1.appl_inc_struct.nr_cyl_scc_teg _CNV_A_R_LINEAR_____441_CM 14 0. 13. FORMAT "%4.1" AXIS_PTS_REF ldpm_nr_cyl_scc_teg__fac_scc /end AXIS_DESCR
/end CHARACTERISTIC
/begin CHARACTERISTIC ip_crlc_teg_tco_dif_up "Map of correlation constant depending on TCO difference" CURVE 0xffe49814 _REC_CUR_20_u2_u2 7.99987793 _CNV_A_R_LINEAR_____394_CM 0. 7.99987793 DISPLAY_IDENTIFIER IP_CRLC_TEG_TCO_DIF_UP FORMAT "%6.4"
 /begin AXIS_DESCR COM_AXIS temp_tco_dif _CNV_A_R_LINEAR_____477_CM 8 -202. 202. FORMAT "%6.1" AXIS_PTS_REF ldpm_temp_tco_dif__crlc_teg /end AXIS_DESCR
/end CHARACTERISTIC
/begin CHARACTERISTIC ip_crlc_teg_toil_dif_up "Map of correlation constant depending on TOIL difference" CURVE 0xffe49834 _REC_CUR_20_u2_u2 7.99987793 _CNV_A_R_LINEAR_____394_CM 0. 7.99987793 DISPLAY_IDENTIFIER IP_CRLC_TEG_TOIL_DIF_UP FORMAT "%6.4"
 /begin AXIS_DESCR COM_AXIS temp_toil_dif _CNV_A_R_LINEAR_____476_CM 8 -202. 202. FORMAT "%6.1" AXIS_PTS_REF ldpm_temp_toil_dif__crlc_teg /end AXIS_DESCR
/end CHARACTERISTIC
/begin CHARACTERISTIC c_crlc_teg_st_end_down "Correlation constant at start post cat." VALUE 0xffe4156e _REC_VAL_20_u2 7.99987793 _CNV_A_R_LINEAR_____394_CM 0. 7.99987793 DISPLAY_IDENTIFIER C_CRLC_TEG_ST_END_DOWN FORMAT "%6.4" /end CHARACTERISTIC
/begin CHARACTERISTIC c_crlc_teg_st_end_up "Correlation constant at start post cat." VALUE 0xffe41570 _REC_VAL_20_u2 7.99987793 _CNV_A_R_LINEAR_____394_CM 0. 7.99987793 DISPLAY_IDENTIFIER C_CRLC_TEG_ST_END_UP FORMAT "%6.4" /end CHARACTERISTIC
/begin CHARACTERISTIC ip_crlc_teg_wall_toil_dif_up "Map of correlation constant depending on TOIL difference" CURVE 0xffe49eb4 _REC_CUR_20_u2_u2 7.99987793 _CNV_A_R_LINEAR_____394_CM 0. 7.99987793 DISPLAY_IDENTIFIER IP_CRLC_TEG_WALL_TOIL_DIF_UP FORMAT "%6.4"
 /begin AXIS_DESCR COM_AXIS temp_toil_dif _CNV_A_R_LINEAR_____476_CM 8 -202. 202. FORMAT "%6.1" AXIS_PTS_REF ldpm_temp_toil_dif__crlc_teg /end AXIS_DESCR
/end CHARACTERISTIC
/begin CHARACTERISTIC c_tco_st "Temperature threshold for coolant at start" VALUE 0xffe40926 _REC_VAL_20_u1 190.5 _CNV_A_R_LINEAR_____11_CM -48. 142.5 DISPLAY_IDENTIFIER C_TCO_ST FORMAT "%5.1" /end CHARACTERISTIC
/begin CHARACTERISTIC c_tco_es_dew "TCO differential threshold for long engine shut-off times" VALUE 0xffe408f6 _REC_VAL_20_u1 190.5 _CNV_A_R_LINEAR_____12_CM 0. 190.5 DISPLAY_IDENTIFIER C_TCO_ES_DEW FORMAT "%5.1" /end CHARACTERISTIC
/begin CHARACTERISTIC c_t_es_dif_dew "Minimum differential time for engine shut-off time" VALUE 0xffe4196a _REC_VAL_20_u2 65535. _CNV_A_R_LINEAR_____97_CM 0. 65535. DISPLAY_IDENTIFIER C_T_ES_DIF_DEW FORMAT "%5.0" /end CHARACTERISTIC
/begin CHARACTERISTIC c_fac_egy_dew_stop "Weighting factor on restart" VALUE 0xffe40736 _REC_VAL_20_u1 0.99610001 _CNV_A_R_LINEAR_____29_CM 0. 0.99610001 DISPLAY_IDENTIFIER C_FAC_EGY_DEW_STOP FORMAT "%5.3" /end CHARACTERISTIC
/begin CHARACTERISTIC ip_crlc_teg_wall_tco_dif_up "Map of correlation constant depending on TCO difference" CURVE 0xffe49e94 _REC_CUR_20_u2_u2 7.99987793 _CNV_A_R_LINEAR_____394_CM 0. 7.99987793 DISPLAY_IDENTIFIER IP_CRLC_TEG_WALL_TCO_DIF_UP FORMAT "%6.4"
 /begin AXIS_DESCR COM_AXIS temp_tco_dif _CNV_A_R_LINEAR_____477_CM 8 -202. 202. FORMAT "%6.1" AXIS_PTS_REF ldpm_temp_tco_dif__crlc_teg /end AXIS_DESCR
/end CHARACTERISTIC
/begin CHARACTERISTIC ip_egy_dew_end_st_up "Pre-catalyst amount of heat depending on start temperature and manifold wall temperature" MAP 0xffe4abd2 _REC_MAP_20_u2_u1_u2 7456.426000000001 _CNV_A_R_LINEAR_____481_CM 0. 7456.426 DISPLAY_IDENTIFIER IP_EGY_DEW_END_ST_UP FORMAT "%6.1"
 /begin AXIS_DESCR COM_AXIS tco_st _CNV_A_R_LINEAR_____11_CM 8 -48. 142.5 FORMAT "%5.1" AXIS_PTS_REF ldpm_tco_st__dew /end AXIS_DESCR
 /begin AXIS_DESCR COM_AXIS online_dummy _CNV_A_R_LINEAR_____280_CM 8 -48. 1459.3 FORMAT "%7.2" AXIS_PTS_REF ldpm_teg_wall_cat_up_mdl_1 /end AXIS_DESCR
/end CHARACTERISTIC
/begin CHARACTERISTIC ip_egy_dew_end_st_down "Post-catalyst amount of heat depending on start temperature and manifold wall temperature" MAP 0xffe4ab52 _REC_MAP_20_u2_u1_u2 7456.426000000001 _CNV_A_R_LINEAR_____481_CM 0. 7456.426 DISPLAY_IDENTIFIER IP_EGY_DEW_END_ST_DOWN FORMAT "%6.1"
 /begin AXIS_DESCR COM_AXIS tco_st _CNV_A_R_LINEAR_____11_CM 8 -48. 142.5 FORMAT "%5.1" AXIS_PTS_REF ldpm_tco_st__dew /end AXIS_DESCR
 /begin AXIS_DESCR COM_AXIS online_dummy _CNV_A_R_LINEAR_____280_CM 8 -48. 1459.3 FORMAT "%7.2" AXIS_PTS_REF ldpm_teg_wall_cat_down_mdl_1 /end AXIS_DESCR
/end CHARACTERISTIC
/begin CHARACTERISTIC lc_puc_teg_ena "logical constant for PUC_TEG" VALUE 0xffe40fcd _REC_VAL_20_u1 1. _CNV_A_R_LINEAR_____0_CM 0. 1. DISPLAY_IDENTIFIER LC_PUC_TEG_ENA FORMAT "%2.0" /end CHARACTERISTIC
/begin MEASUREMENT crlc_teg_wall_tco_dif_down "Correlation constant by TOIL_DIF" UWORD _CNV_A_R_LINEAR_____394_CM 1 100. 0. 7.99987793 DISPLAY_IDENTIFIER CRLC_TEG_WALL_TCO_DIF_DOWN ECU_ADDRESS 0x3fd726 BYTE_ORDER MSB_LAST FORMAT "%6.4" /end MEASUREMENT
/begin MEASUREMENT crlc_teg_wall_toil_dif_down "Correlation constant by TOIL_DIF" UWORD _CNV_A_R_LINEAR_____394_CM 1 100. 0. 7.99987793 DISPLAY_IDENTIFIER CRLC_TEG_WALL_TOIL_DIF_DOWN ECU_ADDRESS 0x3fd724 BYTE_ORDER MSB_LAST FORMAT "%6.4" /end MEASUREMENT
/begin CHARACTERISTIC ip_fac_vs_teg_stat_max "temperature influence by the vehicle speed" CURVE 0xffe40c63 _REC_CUR_20_u1_u1 3.984375 _CNV_A_R_LINEAR_____129_CM 0. 3.984375 DISPLAY_IDENTIFIER IP_FAC_VS_TEG_STAT_MAX FORMAT "%4.2"
 /begin AXIS_DESCR COM_AXIS vs _CNV_A_R_LINEAR_____23_CM 6 0. 255. FORMAT "%3.0" AXIS_PTS_REF ldp_vs__fac_vs_teg /end AXIS_DESCR
/end CHARACTERISTIC
/begin CHARACTERISTIC ip_add_teg_iga "temperature influence by ignition angle adjustments" CURVE 0xffe48edc _REC_CUR_20_u2_u2 2047. _CNV_A_R_LINEAR_____6_CM 0. 2047. DISPLAY_IDENTIFIER IP_ADD_TEG_IGA FORMAT "%7.2"
 /begin AXIS_DESCR COM_AXIS pow_dif_max _CNV_A_R_LINEAR_____479_CM 6 0. 434.0555 FORMAT "%7.3" AXIS_PTS_REF ldp_pow_dif_max__add_teg_iga /end AXIS_DESCR
/end CHARACTERISTIC
/begin CHARACTERISTIC ip_teg_cor_vo_up "Valve overlap correction depending on load engine" MAP 0xffe4ecb6 _REC_MAP_20_u2_u2_u2 983.025 _CNV_A_R_LINEAR_____471_CM -491.52 491.505 DISPLAY_IDENTIFIER IP_TEG_COR_VO_UP FORMAT "%7.2"
 /begin AXIS_DESCR COM_AXIS maf_teg _CNV_A_R_LINEAR_____108_CM 8 0. 1389. FORMAT "%7.2" AXIS_PTS_REF ldpm_maf_teg__teg_stat /end AXIS_DESCR
 /begin AXIS_DESCR COM_AXIS n_teg _CNV_A_R_LINEAR_____10_CM 8 0. 8160. FORMAT "%4.0" AXIS_PTS_REF ldpm_n_teg__teg_stat /end AXIS_DESCR
/end CHARACTERISTIC
/begin MEASUREMENT vo_dif_teg "Difference of valve overlap for temperature influence" UWORD _CNV_A_R_LINEAR_____480_CM 1 100. -95.625 95.625 DISPLAY_IDENTIFIER VO_DIF_TEG ECU_ADDRESS 0x3fd72c BYTE_ORDER MSB_LAST FORMAT "%5.1" /end MEASUREMENT
/begin CHARACTERISTIC ip_eff_iga_av_teg_cor "Basic pre control engine temperature" MAP 0xffe4a012 _REC_MAP_20_u2_u2_u2 4. _CNV_A_R_LINEAR_____275_CM -2. 2. DISPLAY_IDENTIFIER IP_EFF_IGA_AV_TEG_COR FORMAT "%8.5"
 /begin AXIS_DESCR COM_AXIS maf_teg _CNV_A_R_LINEAR_____108_CM 8 0. 1389. FORMAT "%7.2" AXIS_PTS_REF ldpm_maf_teg__teg_stat /end AXIS_DESCR
 /begin AXIS_DESCR COM_AXIS n_teg _CNV_A_R_LINEAR_____10_CM 8 0. 8160. FORMAT "%4.0" AXIS_PTS_REF ldpm_n_teg__teg_stat /end AXIS_DESCR
/end CHARACTERISTIC
/begin CHARACTERISTIC ip_teg_cor_eff_iga_up "Power loss influences by IGA temperature correction depending on load engine" MAP 0xffe4ec36 _REC_MAP_20_u2_u2_u2 983.025 _CNV_A_R_LINEAR_____468_CM 0. 983.025 DISPLAY_IDENTIFIER IP_TEG_COR_EFF_IGA_UP FORMAT "%6.2"
 /begin AXIS_DESCR COM_AXIS maf_teg _CNV_A_R_LINEAR_____108_CM 8 0. 1389. FORMAT "%7.2" AXIS_PTS_REF ldpm_maf_teg__teg_stat /end AXIS_DESCR
 /begin AXIS_DESCR COM_AXIS n_teg _CNV_A_R_LINEAR_____10_CM 8 0. 8160. FORMAT "%4.0" AXIS_PTS_REF ldpm_n_teg__teg_stat /end AXIS_DESCR
/end CHARACTERISTIC
/begin CHARACTERISTIC ip_temp_sp_tco "Reference engine TCO temperature" MAP 0xffe4799f _REC_MAP_20_u1_u2_u2 190.5 _CNV_A_R_LINEAR_____11_CM -48. 142.5 DISPLAY_IDENTIFIER IP_TEMP_SP_TCO FORMAT "%5.1"
 /begin AXIS_DESCR COM_AXIS maf_teg _CNV_A_R_LINEAR_____108_CM 8 0. 1389. FORMAT "%7.2" AXIS_PTS_REF ldpm_maf_teg__teg_stat /end AXIS_DESCR
 /begin AXIS_DESCR COM_AXIS n_teg _CNV_A_R_LINEAR_____10_CM 8 0. 8160. FORMAT "%4.0" AXIS_PTS_REF ldpm_n_teg__teg_stat /end AXIS_DESCR
/end CHARACTERISTIC
/begin CHARACTERISTIC ip_fac_cor_eff_iga_up "influences by IGA temperature correction" CURVE 0xffe4ae82 _REC_CUR_20_u2_u2 1.99996948 _CNV_A_R_LINEAR_____20_CM 0. 1.99996948 DISPLAY_IDENTIFIER IP_FAC_COR_EFF_IGA_UP FORMAT "%7.5"
 /begin AXIS_DESCR COM_AXIS online_dummy _CNV_A_R_LINEAR_____20_CM 8 0. 1.99996948 FORMAT "%7.5" AXIS_PTS_REF ldpm_eff_iga_av_teg_cor /end AXIS_DESCR
/end CHARACTERISTIC
/begin CHARACTERISTIC c_fac_ref_tco_up "Reference correction TCO" VALUE 0xffe40742 _REC_VAL_20_u1 1.99220002 _CNV_A_R_LINEAR_____39_CM 0. 1.99220002 DISPLAY_IDENTIFIER C_FAC_REF_TCO_UP FORMAT "%5.3" /end CHARACTERISTIC
/begin CHARACTERISTIC c_fac_ref_scc_tco_up "Reference correction TCO for SCC" VALUE 0xffe4073e _REC_VAL_20_u1 1.99220002 _CNV_A_R_LINEAR_____39_CM 0. 1.99220002 DISPLAY_IDENTIFIER C_FAC_REF_SCC_TCO_UP FORMAT "%5.3" /end CHARACTERISTIC
/begin CHARACTERISTIC c_fac_tco_ex_teg_up_1 "Temperature TEMP_TCO_EX_DIF correction" VALUE 0xffe41624 _REC_VAL_20_u2 1.99996948 _CNV_A_R_LINEAR_____20_CM 0. 1.99996948 DISPLAY_IDENTIFIER C_FAC_TCO_EX_TEG_UP_1 FORMAT "%7.5" /end CHARACTERISTIC
/begin CHARACTERISTIC c_fac_tco_ex_teg_up_2 "Temperature TEMP_TCO_EX_DIF correction" VALUE 0xffe41626 _REC_VAL_20_u2 1.99996948 _CNV_A_R_LINEAR_____20_CM 0. 1.99996948 DISPLAY_IDENTIFIER C_FAC_TCO_EX_TEG_UP_2 FORMAT "%7.5" /end CHARACTERISTIC
/begin CHARACTERISTIC ip_fac_teg_stop_down "Factor for engine off duration time" MAP 0xffe4b4ea _REC_MAP_20_u2_u1_u2 7.99987793 _CNV_A_R_LINEAR_____394_CM 0. 7.99987793 DISPLAY_IDENTIFIER IP_FAC_TEG_STOP_DOWN FORMAT "%6.4"
 /begin AXIS_DESCR COM_AXIS tam_dew _CNV_A_R_LINEAR_____11_CM 6 -48. 142.5 FORMAT "%5.1" AXIS_PTS_REF ldpm_tam_dew__fac_teg /end AXIS_DESCR
 /begin AXIS_DESCR COM_AXIS t_es_dew _CNV_A_R_LINEAR_____97_CM 8 0. 65535. FORMAT "%5.0" AXIS_PTS_REF ldpm_t_es_dew__fac_teg /end AXIS_DESCR
/end CHARACTERISTIC
/begin CHARACTERISTIC c_teg_st_on_up "Duct temperature threshold after start " VALUE 0xffe41a56 _REC_VAL_20_u2 1507.3 _CNV_A_R_LINEAR_____280_CM -48. 1459.3 DISPLAY_IDENTIFIER C_TEG_ST_ON_UP FORMAT "%7.2" /end CHARACTERISTIC
/begin CHARACTERISTIC c_teg_st_on_down "Duct temperature threshold after start " VALUE 0xffe41a54 _REC_VAL_20_u2 1507.3 _CNV_A_R_LINEAR_____280_CM -48. 1459.3 DISPLAY_IDENTIFIER C_TEG_ST_ON_DOWN FORMAT "%7.2" /end CHARACTERISTIC
/begin CHARACTERISTIC c_teg_egy_sp_end "Temperature threshold of energy setpoint after start" VALUE 0xffe41a4e _REC_VAL_20_u2 1507.3 _CNV_A_R_LINEAR_____280_CM -48. 1459.3 DISPLAY_IDENTIFIER C_TEG_EGY_SP_END FORMAT "%7.2" /end CHARACTERISTIC
/begin CHARACTERISTIC c_maf_int_teg_wall_st_up "Threshold of mass air" VALUE 0xffe41796 _REC_VAL_20_u2 1820.398 _CNV_A_R_LINEAR_____287_CM 0. 1820.398 DISPLAY_IDENTIFIER C_MAF_INT_TEG_WALL_ST_UP FORMAT "%7.2" /end CHARACTERISTIC
/begin MEASUREMENT teg_cor_vo_down "Valve overlap temp. correction " SWORD _CNV_A_R_LINEAR_____472_CM 1 100. -491.519999999553 491.5 DISPLAY_IDENTIFIER TEG_COR_VO_DOWN ECU_ADDRESS 0x3fd704 BYTE_ORDER MSB_LAST FORMAT "%7.2" /end MEASUREMENT
/begin CHARACTERISTIC c_fac_cor_eff_iga_teg_down "EFF_ IGA temperature correction depending on load engine" VALUE 0xffe415f2 _REC_VAL_20_u2 1.99996948 _CNV_A_R_LINEAR_____20_CM 0. 1.99996948 DISPLAY_IDENTIFIER C_FAC_COR_EFF_IGA_TEG_DOWN FORMAT "%7.5" /end CHARACTERISTIC
/begin CHARACTERISTIC c_fac_ref_scc_tco_down "Reference correction TCO for SCC" VALUE 0xffe4073d _REC_VAL_20_u1 1.99220002 _CNV_A_R_LINEAR_____39_CM 0. 1.99220002 DISPLAY_IDENTIFIER C_FAC_REF_SCC_TCO_DOWN FORMAT "%5.3" /end CHARACTERISTIC
/begin CHARACTERISTIC c_fac_tco_ex_teg_down_1 "TCO outlet correction post cat" VALUE 0xffe41620 _REC_VAL_20_u2 1.99996948 _CNV_A_R_LINEAR_____20_CM 0. 1.99996948 DISPLAY_IDENTIFIER C_FAC_TCO_EX_TEG_DOWN_1 FORMAT "%7.5" /end CHARACTERISTIC
/begin CHARACTERISTIC c_fac_tco_ex_teg_down_2 "TCO outlet correction post cat" VALUE 0xffe41622 _REC_VAL_20_u2 1.99996948 _CNV_A_R_LINEAR_____20_CM 0. 1.99996948 DISPLAY_IDENTIFIER C_FAC_TCO_EX_TEG_DOWN_2 FORMAT "%7.5" /end CHARACTERISTIC
/begin MEASUREMENT teg_wall_cor_tco_up "TCO temp. correction" SWORD _CNV_A_R_LINEAR_____475_CM 1 100. -202. 202. DISPLAY_IDENTIFIER TEG_WALL_COR_TCO_UP ECU_ADDRESS 0x3fd712 BYTE_ORDER MSB_LAST FORMAT "%6.1" /end MEASUREMENT
/begin CHARACTERISTIC ip_teg_wall_cor_eff_iga_up "Power loss influences by IGA temperature correction depending on load engine" MAP 0xffe4f00e _REC_MAP_20_u2_u2_u2 983.025 _CNV_A_R_LINEAR_____468_CM 0. 983.025 DISPLAY_IDENTIFIER IP_TEG_WALL_COR_EFF_IGA_UP FORMAT "%6.2"
 /begin AXIS_DESCR COM_AXIS maf_teg _CNV_A_R_LINEAR_____108_CM 8 0. 1389. FORMAT "%7.2" AXIS_PTS_REF ldpm_maf_teg__teg_stat /end AXIS_DESCR
 /begin AXIS_DESCR COM_AXIS n_teg _CNV_A_R_LINEAR_____10_CM 8 0. 8160. FORMAT "%4.0" AXIS_PTS_REF ldpm_n_teg__teg_stat /end AXIS_DESCR
/end CHARACTERISTIC
/begin CHARACTERISTIC ip_fac_cor_eff_iga_wall_up "Power loss influences by IGA temperature correction" CURVE 0xffe4ae92 _REC_CUR_20_u2_u2 1.99996948 _CNV_A_R_LINEAR_____20_CM 0. 1.99996948 DISPLAY_IDENTIFIER IP_FAC_COR_EFF_IGA_WALL_UP FORMAT "%7.5"
 /begin AXIS_DESCR COM_AXIS online_dummy _CNV_A_R_LINEAR_____20_CM 8 0. 1.99996948 FORMAT "%7.5" AXIS_PTS_REF ldpm_eff_iga_av_teg_cor /end AXIS_DESCR
/end CHARACTERISTIC
/begin CHARACTERISTIC c_fac_ref_tco_down "Reference correction TCO" VALUE 0xffe40741 _REC_VAL_20_u1 1.99220002 _CNV_A_R_LINEAR_____39_CM 0. 1.99220002 DISPLAY_IDENTIFIER C_FAC_REF_TCO_DOWN FORMAT "%5.3" /end CHARACTERISTIC
/begin CHARACTERISTIC ip_teg_wall_cor_vo_up "Valve overlap correction depending on load engine" MAP 0xffe4f08e _REC_MAP_20_u2_u2_u2 983.025 _CNV_A_R_LINEAR_____471_CM -491.52 491.505 DISPLAY_IDENTIFIER IP_TEG_WALL_COR_VO_UP FORMAT "%7.2"
 /begin AXIS_DESCR COM_AXIS maf_teg _CNV_A_R_LINEAR_____108_CM 8 0. 1389. FORMAT "%7.2" AXIS_PTS_REF ldpm_maf_teg__teg_stat /end AXIS_DESCR
 /begin AXIS_DESCR COM_AXIS n_teg _CNV_A_R_LINEAR_____10_CM 8 0. 8160. FORMAT "%4.0" AXIS_PTS_REF ldpm_n_teg__teg_stat /end AXIS_DESCR
/end CHARACTERISTIC
/begin CHARACTERISTIC ip_teg_wall_cor_vs_up "Vehicle speed correction depending on load Engine" MAP 0xffe4f10e _REC_MAP_20_u2_u2_u2 983.025 _CNV_A_R_LINEAR_____471_CM -491.52 491.505 DISPLAY_IDENTIFIER IP_TEG_WALL_COR_VS_UP FORMAT "%7.2"
 /begin AXIS_DESCR COM_AXIS maf_teg _CNV_A_R_LINEAR_____108_CM 8 0. 1389. FORMAT "%7.2" AXIS_PTS_REF ldpm_maf_teg__vs_teg /end AXIS_DESCR
 /begin AXIS_DESCR COM_AXIS n_teg _CNV_A_R_LINEAR_____10_CM 8 0. 8160. FORMAT "%4.0" AXIS_PTS_REF ldpm_n_teg__vs_teg /end AXIS_DESCR
/end CHARACTERISTIC
/begin CHARACTERISTIC c_fac_tco_ex_teg_wall_up_2 "TCO_EX correction" VALUE 0xffe4162e _REC_VAL_20_u2 1.99996948 _CNV_A_R_LINEAR_____20_CM 0. 1.99996948 DISPLAY_IDENTIFIER C_FAC_TCO_EX_TEG_WALL_UP_2 FORMAT "%7.5" /end CHARACTERISTIC
/begin CHARACTERISTIC ip_fac_teg_wall_stop_up "Factor for engine off duration time" MAP 0xffe4b68a _REC_MAP_20_u2_u1_u2 7.99987793 _CNV_A_R_LINEAR_____394_CM 0. 7.99987793 DISPLAY_IDENTIFIER IP_FAC_TEG_WALL_STOP_UP FORMAT "%6.4"
 /begin AXIS_DESCR COM_AXIS tam_dew _CNV_A_R_LINEAR_____11_CM 6 -48. 142.5 FORMAT "%5.1" AXIS_PTS_REF ldpm_tam_dew__fac_teg /end AXIS_DESCR
 /begin AXIS_DESCR COM_AXIS t_es_dew _CNV_A_R_LINEAR_____97_CM 8 0. 65535. FORMAT "%5.0" AXIS_PTS_REF ldpm_t_es_dew__fac_teg /end AXIS_DESCR
/end CHARACTERISTIC
/begin CHARACTERISTIC c_teg_wall_egy_sp_end "Temperature threshold of energy setpoint after start" VALUE 0xffe41a5a _REC_VAL_20_u2 1507.3 _CNV_A_R_LINEAR_____280_CM -48. 1459.3 DISPLAY_IDENTIFIER C_TEG_WALL_EGY_SP_END FORMAT "%7.2" /end CHARACTERISTIC
/begin MEASUREMENT teg_wall_cor_vo_up "Valve overlap temp. correction" SWORD _CNV_A_R_LINEAR_____472_CM 1 100. -491.519999999553 491.5 DISPLAY_IDENTIFIER TEG_WALL_COR_VO_UP ECU_ADDRESS 0x3fd710 BYTE_ORDER MSB_LAST FORMAT "%7.2" /end MEASUREMENT
/begin MEASUREMENT teg_wall_cor_tco_down "TCO temp. correction" SWORD _CNV_A_R_LINEAR_____475_CM 1 100. -202. 202. DISPLAY_IDENTIFIER TEG_WALL_COR_TCO_DOWN ECU_ADDRESS 0x3fd71e BYTE_ORDER MSB_LAST FORMAT "%6.1" /end MEASUREMENT
/begin CHARACTERISTIC c_fac_cor_eff_iga_teg_wall_down "Power loss influences by IGA temperature correction depending on load engine" VALUE 0xffe415f4 _REC_VAL_20_u2 1.99996948 _CNV_A_R_LINEAR_____20_CM 0. 1.99996948 DISPLAY_IDENTIFIER C_FAC_COR_EFF_IGA_TEG_WALL_DOWN FORMAT "%7.5" /end CHARACTERISTIC
/begin CHARACTERISTIC c_fac_ref_scc_tco_wall_up "Referenz TCO correction for SCC" VALUE 0xffe40740 _REC_VAL_20_u1 1.99220002 _CNV_A_R_LINEAR_____39_CM 0. 1.99220002 DISPLAY_IDENTIFIER C_FAC_REF_SCC_TCO_WALL_UP FORMAT "%5.3" /end CHARACTERISTIC
/begin CHARACTERISTIC c_fac_ref_scc_tco_wall_down "Referenz TCO correction for SCC" VALUE 0xffe4073f _REC_VAL_20_u1 1.99220002 _CNV_A_R_LINEAR_____39_CM 0. 1.99220002 DISPLAY_IDENTIFIER C_FAC_REF_SCC_TCO_WALL_DOWN FORMAT "%5.3" /end CHARACTERISTIC
/begin CHARACTERISTIC c_fac_ref_tco_wall_up "Referenz TCO correction" VALUE 0xffe40744 _REC_VAL_20_u1 1.99220002 _CNV_A_R_LINEAR_____39_CM 0. 1.99220002 DISPLAY_IDENTIFIER C_FAC_REF_TCO_WALL_UP FORMAT "%5.3" /end CHARACTERISTIC
/begin CHARACTERISTIC c_fac_ref_tco_wall_down "Referenz TCO correction" VALUE 0xffe40743 _REC_VAL_20_u1 1.99220002 _CNV_A_R_LINEAR_____39_CM 0. 1.99220002 DISPLAY_IDENTIFIER C_FAC_REF_TCO_WALL_DOWN FORMAT "%5.3" /end CHARACTERISTIC
/begin CHARACTERISTIC c_teg_wall_red "Reference temperature, by_reduced temperature" VALUE 0xffe41a5e _REC_VAL_20_u2 1507.3 _CNV_A_R_LINEAR_____280_CM -48. 1459.3 DISPLAY_IDENTIFIER C_TEG_WALL_RED FORMAT "%7.2" /end CHARACTERISTIC
/begin CHARACTERISTIC c_teg_wall_dew_st "Reference temperature, condensation on start" VALUE 0xffe41a58 _REC_VAL_20_u2 1507.3 _CNV_A_R_LINEAR_____280_CM -48. 1459.3 DISPLAY_IDENTIFIER C_TEG_WALL_DEW_ST FORMAT "%7.2" /end CHARACTERISTIC
/begin CHARACTERISTIC c_teg_wall_hys "Reference temperature, by reduced temperature" VALUE 0xffe41a5c _REC_VAL_20_u2 188.39 _CNV_A_R_LINEAR_____482_CM 0. 188.39 DISPLAY_IDENTIFIER C_TEG_WALL_HYS FORMAT "%6.2" /end CHARACTERISTIC
/begin CHARACTERISTIC c_teg_dif_grad_min "temperature range limit" VALUE 0xffe41a46 _REC_VAL_20_u2 1507.3 _CNV_A_R_LINEAR_____483_CM 0. 1507.3 DISPLAY_IDENTIFIER C_TEG_DIF_GRAD_MIN FORMAT "%7.3" /end CHARACTERISTIC
/begin CHARACTERISTIC c_teg_dif_level_min "temperature range limit" VALUE 0xffe41a48 _REC_VAL_20_u2 1507.3 _CNV_A_R_LINEAR_____483_CM 0. 1507.3 DISPLAY_IDENTIFIER C_TEG_DIF_LEVEL_MIN FORMAT "%7.3" /end CHARACTERISTIC
/begin CHARACTERISTIC c_fac_tco_ex_teg_wall_up_1 "TCO_EX correction" VALUE 0xffe4162c _REC_VAL_20_u2 1.99996948 _CNV_A_R_LINEAR_____20_CM 0. 1.99996948 DISPLAY_IDENTIFIER C_FAC_TCO_EX_TEG_WALL_UP_1 FORMAT "%7.5" /end CHARACTERISTIC
/begin CHARACTERISTIC c_fac_tco_ex_teg_wall_down_1 "TCO_EX correction" VALUE 0xffe41628 _REC_VAL_20_u2 1.99996948 _CNV_A_R_LINEAR_____20_CM 0. 1.99996948 DISPLAY_IDENTIFIER C_FAC_TCO_EX_TEG_WALL_DOWN_1 FORMAT "%7.5" /end CHARACTERISTIC
/begin CHARACTERISTIC c_fac_tco_ex_teg_wall_down_2 "TCO_EX correction" VALUE 0xffe4162a _REC_VAL_20_u2 1.99996948 _CNV_A_R_LINEAR_____20_CM 0. 1.99996948 DISPLAY_IDENTIFIER C_FAC_TCO_EX_TEG_WALL_DOWN_2 FORMAT "%7.5" /end CHARACTERISTIC
/begin MEASUREMENT temp_tco_dif "Coolant  temperature  difference" SWORD _CNV_A_R_LINEAR_____475_CM 1 100. -202. 202. DISPLAY_IDENTIFIER TEMP_TCO_DIF ECU_ADDRESS 0x3fd6f6 BYTE_ORDER MSB_LAST FORMAT "%6.1" /end MEASUREMENT
/begin MEASUREMENT teg_cor_tco_up "TCO temperature  correction" SWORD _CNV_A_R_LINEAR_____475_CM 1 100. -202. 202. DISPLAY_IDENTIFIER TEG_COR_TCO_UP ECU_ADDRESS 0x3fd6ee BYTE_ORDER MSB_LAST FORMAT "%6.1" /end MEASUREMENT
/begin MEASUREMENT teg_cor_tco_down "TCO temperature  correction" SWORD _CNV_A_R_LINEAR_____475_CM 1 100. -202. 202. DISPLAY_IDENTIFIER TEG_COR_TCO_DOWN ECU_ADDRESS 0x3fd706 BYTE_ORDER MSB_LAST FORMAT "%6.1" /end MEASUREMENT
/begin MEASUREMENT teg_cor_vs_down "Vehicle speed correction depending on load engine" SWORD _CNV_A_R_LINEAR_____472_CM 1 100. -491.519999999553 491.5 DISPLAY_IDENTIFIER TEG_COR_VS_DOWN ECU_ADDRESS 0x3fd70a BYTE_ORDER MSB_LAST FORMAT "%7.2" /end MEASUREMENT
/begin MEASUREMENT teg_cor_vs_up "Vehicle speed correction depending on load engine" SWORD _CNV_A_R_LINEAR_____472_CM 1 100. -491.519999999553 491.5 DISPLAY_IDENTIFIER TEG_COR_VS_UP ECU_ADDRESS 0x3fd6f8 BYTE_ORDER MSB_LAST FORMAT "%7.2" /end MEASUREMENT
/begin MEASUREMENT teg_wall_cor_vs_down "Vehicle speed correction depending on load engine" SWORD _CNV_A_R_LINEAR_____472_CM 1 100. -491.519999999553 491.5 DISPLAY_IDENTIFIER TEG_WALL_COR_VS_DOWN ECU_ADDRESS 0x3fd722 BYTE_ORDER MSB_LAST FORMAT "%7.2" /end MEASUREMENT
/begin MEASUREMENT teg_wall_cor_vs_up "Vehicle speed correction depending on load engine" SWORD _CNV_A_R_LINEAR_____472_CM 1 100. -491.519999999553 491.5 DISPLAY_IDENTIFIER TEG_WALL_COR_VS_UP ECU_ADDRESS 0x3fd716 BYTE_ORDER MSB_LAST FORMAT "%7.2" /end MEASUREMENT
/begin CHARACTERISTIC ip_teg_stat_up_2 "Basic pre control engine temperature" MAP 0xffe4ef46 _REC_MAP_20_u2_u2_u2 1507.3 _CNV_A_R_LINEAR_____280_CM -48. 1459.3 DISPLAY_IDENTIFIER IP_TEG_STAT_UP_2 FORMAT "%7.2"
 /begin AXIS_DESCR COM_AXIS maf_teg _CNV_A_R_LINEAR_____108_CM 8 0. 1389. FORMAT "%7.2" AXIS_PTS_REF ldpm_maf_teg__teg_stat /end AXIS_DESCR
 /begin AXIS_DESCR COM_AXIS n_teg _CNV_A_R_LINEAR_____10_CM 8 0. 8160. FORMAT "%4.0" AXIS_PTS_REF ldpm_n_teg__teg_stat /end AXIS_DESCR
/end CHARACTERISTIC
/begin CHARACTERISTIC ip_teg_wall_stat_up_2 "Basic pre control engine temperature " MAP 0xffe4f30e _REC_MAP_20_u2_u2_u2 1507.3 _CNV_A_R_LINEAR_____280_CM -48. 1459.3 DISPLAY_IDENTIFIER IP_TEG_WALL_STAT_UP_2 FORMAT "%7.2"
 /begin AXIS_DESCR COM_AXIS maf_teg _CNV_A_R_LINEAR_____108_CM 8 0. 1389. FORMAT "%7.2" AXIS_PTS_REF ldpm_maf_teg__teg_stat /end AXIS_DESCR
 /begin AXIS_DESCR COM_AXIS n_teg _CNV_A_R_LINEAR_____10_CM 8 0. 8160. FORMAT "%4.0" AXIS_PTS_REF ldpm_n_teg__teg_stat /end AXIS_DESCR
/end CHARACTERISTIC
/begin CHARACTERISTIC ip_crlc_teg_dec_puc_up_2 "Map of correlation constant by fuel cut off" CURVE 0xffe49374 _REC_CUR_20_u2_u2 0.99998474 _CNV_A_R_LINEAR_____37_CM 0. 0.99998474 DISPLAY_IDENTIFIER IP_CRLC_TEG_DEC_PUC_UP_2 FORMAT "%7.5"
 /begin AXIS_DESCR COM_AXIS online_dummy _CNV_A_R_LINEAR_____287_CM 8 0. 1820.398 FORMAT "%7.2" AXIS_PTS_REF ldpm_maf_int_puc__crlc_teg /end AXIS_DESCR
/end CHARACTERISTIC
/begin CHARACTERISTIC ip_crlc_teg_wall_dec_puc_up_2 "Map of correlation constant by fuel cut off" CURVE 0xffe499f4 _REC_CUR_20_u2_u2 0.99998474 _CNV_A_R_LINEAR_____37_CM 0. 0.99998474 DISPLAY_IDENTIFIER IP_CRLC_TEG_WALL_DEC_PUC_UP_2 FORMAT "%7.5"
 /begin AXIS_DESCR COM_AXIS online_dummy _CNV_A_R_LINEAR_____287_CM 8 0. 1820.398 FORMAT "%7.2" AXIS_PTS_REF ldpm_maf_int_puc__crlc_teg /end AXIS_DESCR
/end CHARACTERISTIC
/begin CHARACTERISTIC ip_crlc_teg_inc_up_2 "Map of correlation constant by heating" MAP 0xffe49744 _REC_MAP_20_u2_u2_u2 0.99998474 _CNV_A_R_LINEAR_____37_CM 0. 0.99998474 DISPLAY_IDENTIFIER IP_CRLC_TEG_INC_UP_2 FORMAT "%7.5"
 /begin AXIS_DESCR COM_AXIS online_dummy _CNV_A_R_LINEAR_____280_CM 12 -48. 1459.3 FORMAT "%7.2" AXIS_PTS_REF ldpm_teg_stat__crlc_inc /end AXIS_DESCR
 /begin AXIS_DESCR COM_AXIS n_teg _CNV_A_R_LINEAR_____10_CM 8 0. 8160. FORMAT "%4.0" AXIS_PTS_REF ldpm_n_teg__crlc_teg /end AXIS_DESCR
/end CHARACTERISTIC
/begin CHARACTERISTIC ip_crlc_teg_wall_inc_up_2 "Map of correlation constant by heating" MAP 0xffe49dc4 _REC_MAP_20_u2_u2_u2 0.99998474 _CNV_A_R_LINEAR_____37_CM 0. 0.99998474 DISPLAY_IDENTIFIER IP_CRLC_TEG_WALL_INC_UP_2 FORMAT "%7.5"
 /begin AXIS_DESCR COM_AXIS online_dummy _CNV_A_R_LINEAR_____280_CM 12 -48. 1459.3 FORMAT "%7.2" AXIS_PTS_REF ldpm_teg_wall_stat__crlc_inc /end AXIS_DESCR
 /begin AXIS_DESCR COM_AXIS n_teg _CNV_A_R_LINEAR_____10_CM 8 0. 8160. FORMAT "%4.0" AXIS_PTS_REF ldpm_n_teg__crlc_teg /end AXIS_DESCR
/end CHARACTERISTIC
/begin CHARACTERISTIC ip_crlc_teg_dec_up_2 "Map of correlation constant by cooling" MAP 0xffe49444 _REC_MAP_20_u2_u2_u2 0.99998474 _CNV_A_R_LINEAR_____37_CM 0. 0.99998474 DISPLAY_IDENTIFIER IP_CRLC_TEG_DEC_UP_2 FORMAT "%7.5"
 /begin AXIS_DESCR COM_AXIS online_dummy _CNV_A_R_LINEAR_____280_CM 12 -48. 1459.3 FORMAT "%7.2" AXIS_PTS_REF ldpm_teg_stat__crlc_dec /end AXIS_DESCR
 /begin AXIS_DESCR COM_AXIS n_teg _CNV_A_R_LINEAR_____10_CM 8 0. 8160. FORMAT "%4.0" AXIS_PTS_REF ldpm_n_teg__crlc_teg /end AXIS_DESCR
/end CHARACTERISTIC
/begin CHARACTERISTIC ip_crlc_teg_wall_dec_up_2 "Map of correlation constant by cooling" MAP 0xffe49ac4 _REC_MAP_20_u2_u2_u2 0.99998474 _CNV_A_R_LINEAR_____37_CM 0. 0.99998474 DISPLAY_IDENTIFIER IP_CRLC_TEG_WALL_DEC_UP_2 FORMAT "%7.5"
 /begin AXIS_DESCR COM_AXIS online_dummy _CNV_A_R_LINEAR_____280_CM 12 -48. 1459.3 FORMAT "%7.2" AXIS_PTS_REF ldpm_teg_wall_stat__crlc_dec /end AXIS_DESCR
 /begin AXIS_DESCR COM_AXIS n_teg _CNV_A_R_LINEAR_____10_CM 8 0. 8160. FORMAT "%4.0" AXIS_PTS_REF ldpm_n_teg__crlc_teg /end AXIS_DESCR
/end CHARACTERISTIC
/begin CHARACTERISTIC ip_teg_stat_down_2 "Basic pre control engine temperature " MAP 0xffe4ee46 _REC_MAP_20_u2_u2_u2 1507.3 _CNV_A_R_LINEAR_____280_CM -48. 1459.3 DISPLAY_IDENTIFIER IP_TEG_STAT_DOWN_2 FORMAT "%7.2"
 /begin AXIS_DESCR COM_AXIS maf_teg _CNV_A_R_LINEAR_____108_CM 8 0. 1389. FORMAT "%7.2" AXIS_PTS_REF ldpm_maf_teg__teg_stat /end AXIS_DESCR
 /begin AXIS_DESCR COM_AXIS n_teg _CNV_A_R_LINEAR_____10_CM 8 0. 8160. FORMAT "%4.0" AXIS_PTS_REF ldpm_n_teg__teg_stat /end AXIS_DESCR
/end CHARACTERISTIC
/begin CHARACTERISTIC ip_teg_wall_stat_down_2 "Basic pre control engine temperature " MAP 0xffe4f20e _REC_MAP_20_u2_u2_u2 1507.3 _CNV_A_R_LINEAR_____280_CM -48. 1459.3 DISPLAY_IDENTIFIER IP_TEG_WALL_STAT_DOWN_2 FORMAT "%7.2"
 /begin AXIS_DESCR COM_AXIS maf_teg _CNV_A_R_LINEAR_____108_CM 8 0. 1389. FORMAT "%7.2" AXIS_PTS_REF ldpm_maf_teg__teg_stat /end AXIS_DESCR
 /begin AXIS_DESCR COM_AXIS n_teg _CNV_A_R_LINEAR_____10_CM 8 0. 8160. FORMAT "%4.0" AXIS_PTS_REF ldpm_n_teg__teg_stat /end AXIS_DESCR
/end CHARACTERISTIC
/begin CHARACTERISTIC ip_crlc_teg_dec_puc_down_2 "Map of correlation constant by fuel cut off post cat." CURVE 0xffe49354 _REC_CUR_20_u2_u2 0.99998474 _CNV_A_R_LINEAR_____37_CM 0. 0.99998474 DISPLAY_IDENTIFIER IP_CRLC_TEG_DEC_PUC_DOWN_2 FORMAT "%7.5"
 /begin AXIS_DESCR COM_AXIS online_dummy _CNV_A_R_LINEAR_____287_CM 8 0. 1820.398 FORMAT "%7.2" AXIS_PTS_REF ldpm_maf_int_puc__crlc_teg /end AXIS_DESCR
/end CHARACTERISTIC
/begin CHARACTERISTIC ip_crlc_teg_wall_dec_puc_down_2 "Map of correlation constant by fuel cut off post cat." CURVE 0xffe499d4 _REC_CUR_20_u2_u2 0.99998474 _CNV_A_R_LINEAR_____37_CM 0. 0.99998474 DISPLAY_IDENTIFIER IP_CRLC_TEG_WALL_DEC_PUC_DOWN_2 FORMAT "%7.5"
 /begin AXIS_DESCR COM_AXIS online_dummy _CNV_A_R_LINEAR_____287_CM 8 0. 1820.398 FORMAT "%7.2" AXIS_PTS_REF ldpm_maf_int_puc__crlc_teg /end AXIS_DESCR
/end CHARACTERISTIC
/begin CHARACTERISTIC ip_crlc_teg_dec_down_2 "Map of correlation constant by cooling post cat." MAP 0xffe49284 _REC_MAP_20_u2_u2_u2 0.99998474 _CNV_A_R_LINEAR_____37_CM 0. 0.99998474 DISPLAY_IDENTIFIER IP_CRLC_TEG_DEC_DOWN_2 FORMAT "%7.5"
 /begin AXIS_DESCR COM_AXIS online_dummy _CNV_A_R_LINEAR_____280_CM 12 -48. 1459.3 FORMAT "%7.2" AXIS_PTS_REF ldpm_teg_stat__crlc_dec /end AXIS_DESCR
 /begin AXIS_DESCR COM_AXIS n_teg _CNV_A_R_LINEAR_____10_CM 8 0. 8160. FORMAT "%4.0" AXIS_PTS_REF ldpm_n_teg__crlc_teg /end AXIS_DESCR
/end CHARACTERISTIC
/begin CHARACTERISTIC ip_crlc_teg_wall_dec_down_2 "Map of correlation constant by cooling post cat." MAP 0xffe49904 _REC_MAP_20_u2_u2_u2 0.99998474 _CNV_A_R_LINEAR_____37_CM 0. 0.99998474 DISPLAY_IDENTIFIER IP_CRLC_TEG_WALL_DEC_DOWN_2 FORMAT "%7.5"
 /begin AXIS_DESCR COM_AXIS online_dummy _CNV_A_R_LINEAR_____280_CM 12 -48. 1459.3 FORMAT "%7.2" AXIS_PTS_REF ldpm_teg_wall_stat__crlc_dec /end AXIS_DESCR
 /begin AXIS_DESCR COM_AXIS n_teg _CNV_A_R_LINEAR_____10_CM 8 0. 8160. FORMAT "%4.0" AXIS_PTS_REF ldpm_n_teg__crlc_teg /end AXIS_DESCR
/end CHARACTERISTIC
/begin CHARACTERISTIC ip_crlc_teg_inc_down_2 "Map of correlation constant by heating post cat." MAP 0xffe495c4 _REC_MAP_20_u2_u2_u2 0.99998474 _CNV_A_R_LINEAR_____37_CM 0. 0.99998474 DISPLAY_IDENTIFIER IP_CRLC_TEG_INC_DOWN_2 FORMAT "%7.5"
 /begin AXIS_DESCR COM_AXIS online_dummy _CNV_A_R_LINEAR_____280_CM 12 -48. 1459.3 FORMAT "%7.2" AXIS_PTS_REF ldpm_teg_stat__crlc_inc /end AXIS_DESCR
 /begin AXIS_DESCR COM_AXIS n_teg _CNV_A_R_LINEAR_____10_CM 8 0. 8160. FORMAT "%4.0" AXIS_PTS_REF ldpm_n_teg__crlc_teg /end AXIS_DESCR
/end CHARACTERISTIC
/begin CHARACTERISTIC ip_crlc_teg_wall_inc_down_2 "Map of correlation constant by heating post cat." MAP 0xffe49c44 _REC_MAP_20_u2_u2_u2 0.99998474 _CNV_A_R_LINEAR_____37_CM 0. 0.99998474 DISPLAY_IDENTIFIER IP_CRLC_TEG_WALL_INC_DOWN_2 FORMAT "%7.5"
 /begin AXIS_DESCR COM_AXIS online_dummy _CNV_A_R_LINEAR_____280_CM 12 -48. 1459.3 FORMAT "%7.2" AXIS_PTS_REF ldpm_teg_wall_stat__crlc_inc /end AXIS_DESCR
 /begin AXIS_DESCR COM_AXIS n_teg _CNV_A_R_LINEAR_____10_CM 8 0. 8160. FORMAT "%4.0" AXIS_PTS_REF ldpm_n_teg__crlc_teg /end AXIS_DESCR
/end CHARACTERISTIC
/begin CHARACTERISTIC ip_fac_teg_stop_up "Factor for engine off duration time" MAP 0xffe4b54a _REC_MAP_20_u2_u1_u2 7.99987793 _CNV_A_R_LINEAR_____394_CM 0. 7.99987793 DISPLAY_IDENTIFIER IP_FAC_TEG_STOP_UP FORMAT "%6.4"
 /begin AXIS_DESCR COM_AXIS tam_dew _CNV_A_R_LINEAR_____11_CM 6 -48. 142.5 FORMAT "%5.1" AXIS_PTS_REF ldpm_tam_dew__fac_teg /end AXIS_DESCR
 /begin AXIS_DESCR COM_AXIS t_es_dew _CNV_A_R_LINEAR_____97_CM 8 0. 65535. FORMAT "%5.0" AXIS_PTS_REF ldpm_t_es_dew__fac_teg /end AXIS_DESCR
/end CHARACTERISTIC
/begin CHARACTERISTIC ip_fac_teg_wall_stop_down "Factor for engine off duration time" MAP 0xffe4b62a _REC_MAP_20_u2_u1_u2 7.99987793 _CNV_A_R_LINEAR_____394_CM 0. 7.99987793 DISPLAY_IDENTIFIER IP_FAC_TEG_WALL_STOP_DOWN FORMAT "%6.4"
 /begin AXIS_DESCR COM_AXIS tam_dew _CNV_A_R_LINEAR_____11_CM 6 -48. 142.5 FORMAT "%5.1" AXIS_PTS_REF ldpm_tam_dew__fac_teg /end AXIS_DESCR
 /begin AXIS_DESCR COM_AXIS t_es_dew _CNV_A_R_LINEAR_____97_CM 8 0. 65535. FORMAT "%5.0" AXIS_PTS_REF ldpm_t_es_dew__fac_teg /end AXIS_DESCR
/end CHARACTERISTIC
/begin AXIS_PTS ldpm_teg_stat_eng_pre "" 0xffe51daa online_dummy _REC_AXS_20_u2 1507.3 _CNV_A_R_LINEAR_____280_CM 6 -48. 1459.3 DISPLAY_IDENTIFIER LDPM_TEG_STAT_ENG_PRE FORMAT "%7.2" /end AXIS_PTS
/begin AXIS_PTS ldpm_egr_ratio__teg "" 0xffe5181e egr_ratio _REC_AXS_20_u2 99.99847412 _CNV_A_R_LINEAR_____8_CM 6 0. 99.99847412 DISPLAY_IDENTIFIER LDPM_EGR_RATIO__TEG /end AXIS_PTS
/begin AXIS_PTS ldpm_temp_toil_dif__fac_temp "" 0xffe51e50 temp_toil_dif _REC_AXS_20_u2 404. _CNV_A_R_LINEAR_____476_CM 6 -202. 202. DISPLAY_IDENTIFIER LDPM_TEMP_TOIL_DIF__FAC_TEMP FORMAT "%6.1" /end AXIS_PTS
/begin AXIS_PTS ldpm_lamb_sp_teg__fac_cor "" 0xffe5188a teg_1.appl_inc_struct.lamb_sp_teg _REC_AXS_20_u2 31.99902344 _CNV_A_R_LINEAR_____206_CM 16 0. 31.99902344 DISPLAY_IDENTIFIER LDPM_LAMB_SP_TEG__FAC_COR FORMAT "%7.4" /end AXIS_PTS
/begin AXIS_PTS ldpm_nr_cyl_scc_teg__fac_scc "" 0xffe485b6 teg_1.appl_inc_struct.nr_cyl_scc_teg _REC_AXS_20_u1 13. _CNV_A_R_LINEAR_____441_CM 14 0. 13. DISPLAY_IDENTIFIER LDPM_NR_CYL_SCC_TEG__FAC_SCC FORMAT "%4.1" /end AXIS_PTS
/begin AXIS_PTS ldpm_ecfpwm_ecf__fac_cor "" 0xffe41349 ecfpwm_ecf _REC_AXS_20_u1 99.609375 _CNV_A_R_LINEAR_____9_CM 6 0. 99.609375 DISPLAY_IDENTIFIER LDPM_ECFPWM_ECF__FAC_COR FORMAT "%4.1" /end AXIS_PTS
/begin AXIS_PTS ldpm_tam_dew__fac_teg "" 0xffe4141b tam_dew _REC_AXS_20_u1 190.5 _CNV_A_R_LINEAR_____11_CM 6 -48. 142.5 DISPLAY_IDENTIFIER LDPM_TAM_DEW__FAC_TEG FORMAT "%5.1" /end AXIS_PTS
/begin AXIS_PTS ldpm_t_es_dew__fac_teg "" 0xffe51d28 t_es_dew _REC_AXS_20_u2 65535. _CNV_A_R_LINEAR_____97_CM 8 0. 65535. DISPLAY_IDENTIFIER LDPM_T_ES_DEW__FAC_TEG FORMAT "%5.0" /end AXIS_PTS
/begin AXIS_PTS ldpm_temp_toil_dif__crlc_teg "" 0xffe51e3e temp_toil_dif _REC_AXS_20_u2 404. _CNV_A_R_LINEAR_____476_CM 8 -202. 202. DISPLAY_IDENTIFIER LDPM_TEMP_TOIL_DIF__CRLC_TEG FORMAT "%6.1" /end AXIS_PTS
/begin AXIS_PTS ldpm_temp_tco_dif__crlc_teg "" 0xffe51e2c temp_tco_dif _REC_AXS_20_u2 404. _CNV_A_R_LINEAR_____477_CM 8 -202. 202. DISPLAY_IDENTIFIER LDPM_TEMP_TCO_DIF__CRLC_TEG FORMAT "%6.1" /end AXIS_PTS
/begin AXIS_PTS ldpm_maf_int_puc__crlc_teg "" 0xffe51964 online_dummy _REC_AXS_20_u2 1820.398 _CNV_A_R_LINEAR_____287_CM 8 0. 1820.398 DISPLAY_IDENTIFIER LDPM_MAF_INT_PUC__CRLC_TEG FORMAT "%7.2" /end AXIS_PTS
/begin AXIS_PTS ldpm_n_teg__vs_teg "" 0xffe51c28 n_teg _REC_AXS_20_u2 8160. _CNV_A_R_LINEAR_____10_CM 8 0. 8160. DISPLAY_IDENTIFIER LDPM_N_TEG__VS_TEG FORMAT "%4.0" /end AXIS_PTS
/begin AXIS_PTS ldpm_tco_st__dew "" 0xffe486b6 tco_st _REC_AXS_20_u1 190.5 _CNV_A_R_LINEAR_____11_CM 8 -48. 142.5 DISPLAY_IDENTIFIER LDPM_TCO_ST__DEW FORMAT "%5.1" /end AXIS_PTS
/begin AXIS_PTS ldpm_teg_wall_cat_up_mdl_1 "" 0xffe51dca online_dummy _REC_AXS_20_u2 1507.3 _CNV_A_R_LINEAR_____280_CM 8 -48. 1459.3 DISPLAY_IDENTIFIER LDPM_TEG_WALL_CAT_UP_MDL_1 FORMAT "%7.2" /end AXIS_PTS
/begin AXIS_PTS ldpm_teg_wall_cat_down_mdl_1 "" 0xffe51db8 online_dummy _REC_AXS_20_u2 1507.3 _CNV_A_R_LINEAR_____280_CM 8 -48. 1459.3 DISPLAY_IDENTIFIER LDPM_TEG_WALL_CAT_DOWN_MDL_1 FORMAT "%7.2" /end AXIS_PTS
/begin AXIS_PTS ldp_vs__fac_vs_teg "" 0xffe412f9 vs _REC_AXS_20_u1 255. _CNV_A_R_LINEAR_____23_CM 6 0. 255. DISPLAY_IDENTIFIER LDP_VS__FAC_VS_TEG FORMAT "%3.0" /end AXIS_PTS
/begin AXIS_PTS ldp_pow_dif_max__add_teg_iga "" 0xffe511a2 pow_dif_max _REC_AXS_20_u2 434.0555000000001 _CNV_A_R_LINEAR_____479_CM 6 0. 434.0555 DISPLAY_IDENTIFIER LDP_POW_DIF_MAX__ADD_TEG_IGA FORMAT "%7.3" /end AXIS_PTS
/begin AXIS_PTS ldpm_vo_dif_teg__teg_stat "" 0xffe51eb6 vo_dif_teg _REC_AXS_20_u2 191.25 _CNV_A_R_LINEAR_____480_CM 6 -95.625 95.625 DISPLAY_IDENTIFIER LDPM_VO_DIF_TEG__TEG_STAT FORMAT "%5.1" /end AXIS_PTS
/begin AXIS_PTS ldpm_eff_iga_av_teg_cor "" 0xffe51802 online_dummy _REC_AXS_20_u2 1.99996948 _CNV_A_R_LINEAR_____20_CM 8 0. 1.99996948 DISPLAY_IDENTIFIER LDPM_EFF_IGA_AV_TEG_COR FORMAT "%7.5" /end AXIS_PTS
/begin AXIS_PTS ldpm_teg_stat__crlc_dec "" 0xffe51d76 online_dummy _REC_AXS_20_u2 1507.3 _CNV_A_R_LINEAR_____280_CM 12 -48. 1459.3 DISPLAY_IDENTIFIER LDPM_TEG_STAT__CRLC_DEC FORMAT "%7.2" /end AXIS_PTS
/begin AXIS_PTS ldpm_teg_wall_stat__crlc_dec "" 0xffe51ddc online_dummy _REC_AXS_20_u2 1507.3 _CNV_A_R_LINEAR_____280_CM 12 -48. 1459.3 DISPLAY_IDENTIFIER LDPM_TEG_WALL_STAT__CRLC_DEC FORMAT "%7.2" /end AXIS_PTS
/begin AXIS_PTS ldpm_teg_stat__crlc_inc "" 0xffe51d90 online_dummy _REC_AXS_20_u2 1507.3 _CNV_A_R_LINEAR_____280_CM 12 -48. 1459.3 DISPLAY_IDENTIFIER LDPM_TEG_STAT__CRLC_INC FORMAT "%7.2" /end AXIS_PTS
/begin AXIS_PTS ldpm_teg_wall_stat__crlc_inc "" 0xffe51df6 online_dummy _REC_AXS_20_u2 1507.3 _CNV_A_R_LINEAR_____280_CM 12 -48. 1459.3 DISPLAY_IDENTIFIER LDPM_TEG_WALL_STAT__CRLC_INC FORMAT "%7.2" /end AXIS_PTS
/begin CHARACTERISTIC ip_fac_temp_toil_dif_up "Reference Oil temperature correction" CURVE 0xffe4b6f6 _REC_CUR_20_u2_u2 1.99996948 _CNV_A_R_LINEAR_____20_CM 0. 1.99996948 DISPLAY_IDENTIFIER IP_FAC_TEMP_TOIL_DIF_UP FORMAT "%7.5"
 /begin AXIS_DESCR COM_AXIS temp_toil_dif _CNV_A_R_LINEAR_____476_CM 6 -202. 202. FORMAT "%6.1" AXIS_PTS_REF ldpm_temp_toil_dif__fac_temp /end AXIS_DESCR
/end CHARACTERISTIC
/begin AXIS_PTS ldpm_maf_teg__vs_teg "" 0xffe519ec maf_teg _REC_AXS_20_u2 1389. _CNV_A_R_LINEAR_____108_CM 8 0. 1389. DISPLAY_IDENTIFIER LDPM_MAF_TEG__VS_TEG FORMAT "%7.2" /end AXIS_PTS
/begin CHARACTERISTIC ip_teg_cor_vs_up "Vehicle speed correction depending on load Engine" MAP 0xffe4ed36 _REC_MAP_20_u2_u2_u2 983.025 _CNV_A_R_LINEAR_____471_CM -491.52 491.505 DISPLAY_IDENTIFIER IP_TEG_COR_VS_UP FORMAT "%7.2"
 /begin AXIS_DESCR COM_AXIS maf_teg _CNV_A_R_LINEAR_____108_CM 8 0. 1389. FORMAT "%7.2" AXIS_PTS_REF ldpm_maf_teg__vs_teg /end AXIS_DESCR
 /begin AXIS_DESCR COM_AXIS n_teg _CNV_A_R_LINEAR_____10_CM 8 0. 8160. FORMAT "%4.0" AXIS_PTS_REF ldpm_n_teg__vs_teg /end AXIS_DESCR
/end CHARACTERISTIC
/begin AXIS_PTS ldpm_vs__fac_cor_vs_teg_ecf "" 0xffe4148f vs _REC_AXS_20_u1 255. _CNV_A_R_LINEAR_____23_CM 6 0. 255. DISPLAY_IDENTIFIER LDPM_VS__FAC_COR_VS_TEG_ECF FORMAT "%3.0" /end AXIS_PTS
/begin CHARACTERISTIC ip_vs_ecf_teg_up_2 "Electric cooling fan correction" CURVE 0xffe40ef9 _REC_CUR_20_u1_u1 255. _CNV_A_R_LINEAR_____23_CM 0. 255. DISPLAY_IDENTIFIER IP_VS_ECF_TEG_UP_2 FORMAT "%3.0"
 /begin AXIS_DESCR COM_AXIS ecfpwm_ecf _CNV_A_R_LINEAR_____9_CM 6 0. 99.609375 FORMAT "%4.1" AXIS_PTS_REF ldpm_ecfpwm_ecf__fac_cor /end AXIS_DESCR
/end CHARACTERISTIC
/begin CHARACTERISTIC ip_fac_tco_ex_vs "VS influence of TCO_EX temperature" CURVE 0xffe4b45e _REC_CUR_20_u2_u1 7.99987793 _CNV_A_R_LINEAR_____484_CM -4. 3.99987793 DISPLAY_IDENTIFIER IP_FAC_TCO_EX_VS FORMAT "%6.4"
 /begin AXIS_DESCR COM_AXIS teg_1.gas_up_struct.vs_cor_teg_up _CNV_A_R_LINEAR_____23_CM 6 0. 255. FORMAT "%3.0" AXIS_PTS_REF ldp_vs_cor_teg_up_1__fac_cor /end AXIS_DESCR
/end CHARACTERISTIC
/begin MEASUREMENT fac_cor_toil_dif_teg_up "TOIL difference correction" UWORD _CNV_A_R_LINEAR_____20_CM 1 100. 0. 1.99996948 DISPLAY_IDENTIFIER FAC_COR_TOIL_DIF_TEG_UP ECU_ADDRESS 0x3fd6f2 BYTE_ORDER MSB_LAST FORMAT "%7.5" /end MEASUREMENT
/begin MEASUREMENT fac_cor_toil_dif_teg_down "Lambda setpoint correction" UWORD _CNV_A_R_LINEAR_____20_CM 1 100. 0. 1.99996948 DISPLAY_IDENTIFIER FAC_COR_TOIL_DIF_TEG_DOWN ECU_ADDRESS 0x3fd708 BYTE_ORDER MSB_LAST FORMAT "%7.5" /end MEASUREMENT
/begin AXIS_PTS ldpm_vs_cor_teg__fac_cor "" 0xffe41496 online_dummy _REC_AXS_20_u1 255. _CNV_A_R_LINEAR_____23_CM 6 0. 255. DISPLAY_IDENTIFIER LDPM_VS_COR_TEG__FAC_COR FORMAT "%3.0" /end AXIS_PTS
/begin CHARACTERISTIC ip_fac_cor_tco_ex_vs_up "VS correction of TCO_EX venicle influence" CURVE 0xffe4af06 _REC_CUR_20_u2_u1 0.9998700000000002 _CNV_A_R_LINEAR_____485_CM 0. 0.99987 DISPLAY_IDENTIFIER IP_FAC_COR_TCO_EX_VS_UP FORMAT "%8.6"
 /begin AXIS_DESCR COM_AXIS online_dummy _CNV_A_R_LINEAR_____23_CM 6 0. 255. FORMAT "%3.0" AXIS_PTS_REF ldpm_vs_cor_teg__fac_cor /end AXIS_DESCR
/end CHARACTERISTIC
/begin CHARACTERISTIC ip_fac_cor_tco_ex_vs_down "VS correction TCO_EX down" CURVE 0xffe4aefa _REC_CUR_20_u2_u1 0.9998700000000002 _CNV_A_R_LINEAR_____485_CM 0. 0.99987 DISPLAY_IDENTIFIER IP_FAC_COR_TCO_EX_VS_DOWN FORMAT "%8.6"
 /begin AXIS_DESCR COM_AXIS online_dummy _CNV_A_R_LINEAR_____23_CM 6 0. 255. FORMAT "%3.0" AXIS_PTS_REF ldpm_vs_cor_teg__fac_cor /end AXIS_DESCR
/end CHARACTERISTIC
/begin CHARACTERISTIC ip_vs_ecf_teg_up_1 "Electric cooling fan correction" CURVE 0xffe40ef3 _REC_CUR_20_u1_u1 255. _CNV_A_R_LINEAR_____23_CM 0. 255. DISPLAY_IDENTIFIER IP_VS_ECF_TEG_UP_1 FORMAT "%3.0"
 /begin AXIS_DESCR COM_AXIS ecfpwm_ecf _CNV_A_R_LINEAR_____9_CM 6 0. 99.609375 FORMAT "%4.1" AXIS_PTS_REF ldpm_ecfpwm_ecf__fac_cor /end AXIS_DESCR
/end CHARACTERISTIC
/begin CHARACTERISTIC ip_vs_ecf_teg_down_2 "VS correction TCO_EX down" CURVE 0xffe40eed _REC_CUR_20_u1_u1 255. _CNV_A_R_LINEAR_____23_CM 0. 255. DISPLAY_IDENTIFIER IP_VS_ECF_TEG_DOWN_2 FORMAT "%3.0"
 /begin AXIS_DESCR COM_AXIS ecfpwm_ecf _CNV_A_R_LINEAR_____9_CM 6 0. 99.609375 FORMAT "%4.1" AXIS_PTS_REF ldpm_ecfpwm_ecf__fac_cor /end AXIS_DESCR
/end CHARACTERISTIC
/begin CHARACTERISTIC ip_fac_temp_toil_dif_wall_up "Reference Oil temperature correction" CURVE 0xffe4b70e _REC_CUR_20_u2_u2 1.99996948 _CNV_A_R_LINEAR_____20_CM 0. 1.99996948 DISPLAY_IDENTIFIER IP_FAC_TEMP_TOIL_DIF_WALL_UP FORMAT "%7.5"
 /begin AXIS_DESCR COM_AXIS temp_toil_dif _CNV_A_R_LINEAR_____476_CM 6 -202. 202. FORMAT "%6.1" AXIS_PTS_REF ldpm_temp_toil_dif__fac_temp /end AXIS_DESCR
/end CHARACTERISTIC
/begin CHARACTERISTIC ip_fac_cor_ecf_vs_teg "Vehicle speed correction" CURVE 0xffe4ae6a _REC_CUR_20_u2_u1 4. _CNV_A_R_LINEAR_____275_CM -2. 2. DISPLAY_IDENTIFIER IP_FAC_COR_ECF_VS_TEG FORMAT "%8.5"
 /begin AXIS_DESCR COM_AXIS vs _CNV_A_R_LINEAR_____23_CM 6 0. 255. FORMAT "%3.0" AXIS_PTS_REF ldpm_vs__fac_cor_vs_teg_ecf /end AXIS_DESCR
/end CHARACTERISTIC
/begin CHARACTERISTIC ip_fac_cor_ecf_vs_teg_wall "Vehicle speed correction" CURVE 0xffe4ae76 _REC_CUR_20_u2_u1 4. _CNV_A_R_LINEAR_____275_CM -2. 2. DISPLAY_IDENTIFIER IP_FAC_COR_ECF_VS_TEG_WALL FORMAT "%8.5"
 /begin AXIS_DESCR COM_AXIS vs _CNV_A_R_LINEAR_____23_CM 6 0. 255. FORMAT "%3.0" AXIS_PTS_REF ldpm_vs__fac_cor_vs_teg_ecf /end AXIS_DESCR
/end CHARACTERISTIC
/begin CHARACTERISTIC ip_vs_ecf_teg_down_1 "VS correction TCO_EX down" CURVE 0xffe40ee7 _REC_CUR_20_u1_u1 255. _CNV_A_R_LINEAR_____23_CM 0. 255. DISPLAY_IDENTIFIER IP_VS_ECF_TEG_DOWN_1 FORMAT "%3.0"
 /begin AXIS_DESCR COM_AXIS ecfpwm_ecf _CNV_A_R_LINEAR_____9_CM 6 0. 99.609375 FORMAT "%4.1" AXIS_PTS_REF ldpm_ecfpwm_ecf__fac_cor /end AXIS_DESCR
/end CHARACTERISTIC
/begin CHARACTERISTIC ip_vs_ecf_teg_wall_up_2 "VS correction TCO_EX down" CURVE 0xffe40f11 _REC_CUR_20_u1_u1 255. _CNV_A_R_LINEAR_____23_CM 0. 255. DISPLAY_IDENTIFIER IP_VS_ECF_TEG_WALL_UP_2 FORMAT "%3.0"
 /begin AXIS_DESCR COM_AXIS ecfpwm_ecf _CNV_A_R_LINEAR_____9_CM 6 0. 99.609375 FORMAT "%4.1" AXIS_PTS_REF ldpm_ecfpwm_ecf__fac_cor /end AXIS_DESCR
/end CHARACTERISTIC
/begin MEASUREMENT fac_cor_toil_dif_teg_wall_up "TOIL difference correction" UWORD _CNV_A_R_LINEAR_____20_CM 1 100. 0. 1.99996948 DISPLAY_IDENTIFIER FAC_COR_TOIL_DIF_TEG_WALL_UP ECU_ADDRESS 0x3fd714 BYTE_ORDER MSB_LAST FORMAT "%7.5" /end MEASUREMENT
/begin MEASUREMENT fac_cor_toil_dif_teg_wall_down "TOIL difference correction" UWORD _CNV_A_R_LINEAR_____20_CM 1 100. 0. 1.99996948 DISPLAY_IDENTIFIER FAC_COR_TOIL_DIF_TEG_WALL_DOWN ECU_ADDRESS 0x3fd720 BYTE_ORDER MSB_LAST FORMAT "%7.5" /end MEASUREMENT
/begin CHARACTERISTIC ip_fac_temp_toil_dif_down "Reference Oil temperature correction" CURVE 0xffe4b6ea _REC_CUR_20_u2_u2 1.99996948 _CNV_A_R_LINEAR_____20_CM 0. 1.99996948 DISPLAY_IDENTIFIER IP_FAC_TEMP_TOIL_DIF_DOWN FORMAT "%7.5"
 /begin AXIS_DESCR COM_AXIS temp_toil_dif _CNV_A_R_LINEAR_____476_CM 6 -202. 202. FORMAT "%6.1" AXIS_PTS_REF ldpm_temp_toil_dif__fac_temp /end AXIS_DESCR
/end CHARACTERISTIC
/begin CHARACTERISTIC ip_fac_temp_toil_dif_wall_down "Reference Oil temperature correction" CURVE 0xffe4b702 _REC_CUR_20_u2_u2 1.99996948 _CNV_A_R_LINEAR_____20_CM 0. 1.99996948 DISPLAY_IDENTIFIER IP_FAC_TEMP_TOIL_DIF_WALL_DOWN FORMAT "%7.5"
 /begin AXIS_DESCR COM_AXIS temp_toil_dif _CNV_A_R_LINEAR_____476_CM 6 -202. 202. FORMAT "%6.1" AXIS_PTS_REF ldpm_temp_toil_dif__fac_temp /end AXIS_DESCR
/end CHARACTERISTIC
/begin CHARACTERISTIC ip_vs_ecf_teg_wall_up_1 "VS correction TCO_EX down" CURVE 0xffe40f0b _REC_CUR_20_u1_u1 255. _CNV_A_R_LINEAR_____23_CM 0. 255. DISPLAY_IDENTIFIER IP_VS_ECF_TEG_WALL_UP_1 FORMAT "%3.0"
 /begin AXIS_DESCR COM_AXIS ecfpwm_ecf _CNV_A_R_LINEAR_____9_CM 6 0. 99.609375 FORMAT "%4.1" AXIS_PTS_REF ldpm_ecfpwm_ecf__fac_cor /end AXIS_DESCR
/end CHARACTERISTIC
/begin CHARACTERISTIC ip_vs_ecf_teg_wall_down_1 "VS correction TCO_EX down" CURVE 0xffe40eff _REC_CUR_20_u1_u1 255. _CNV_A_R_LINEAR_____23_CM 0. 255. DISPLAY_IDENTIFIER IP_VS_ECF_TEG_WALL_DOWN_1 FORMAT "%3.0"
 /begin AXIS_DESCR COM_AXIS ecfpwm_ecf _CNV_A_R_LINEAR_____9_CM 6 0. 99.609375 FORMAT "%4.1" AXIS_PTS_REF ldpm_ecfpwm_ecf__fac_cor /end AXIS_DESCR
/end CHARACTERISTIC
/begin CHARACTERISTIC ip_vs_ecf_teg_wall_down_2 "VS correction TCO_EX down" CURVE 0xffe40f05 _REC_CUR_20_u1_u1 255. _CNV_A_R_LINEAR_____23_CM 0. 255. DISPLAY_IDENTIFIER IP_VS_ECF_TEG_WALL_DOWN_2 FORMAT "%3.0"
 /begin AXIS_DESCR COM_AXIS ecfpwm_ecf _CNV_A_R_LINEAR_____9_CM 6 0. 99.609375 FORMAT "%4.1" AXIS_PTS_REF ldpm_ecfpwm_ecf__fac_cor /end AXIS_DESCR
/end CHARACTERISTIC
/begin CHARACTERISTIC c_crlc_dif_teg_level "Correlation constant max. difference one step of Level calculation" VALUE 0xffe41542 _REC_VAL_20_u2 0.99998474 _CNV_A_R_LINEAR_____37_CM 0. 0.99998474 DISPLAY_IDENTIFIER C_CRLC_DIF_TEG_LEVEL FORMAT "%7.5" /end CHARACTERISTIC
/begin CHARACTERISTIC c_crlc_dif_teg_grad "Correlation constant max. difference one step of grad calculation" VALUE 0xffe41540 _REC_VAL_20_u2 0.99998474 _CNV_A_R_LINEAR_____37_CM 0. 0.99998474 DISPLAY_IDENTIFIER C_CRLC_DIF_TEG_GRAD FORMAT "%7.5" /end CHARACTERISTIC
/begin CHARACTERISTIC ip_fac_cor_vs_teg_up_1 "Vehicle speed correction" CURVE 0xffe4af72 _REC_CUR_20_u2_u1 4. _CNV_A_R_LINEAR_____275_CM -2. 2. DISPLAY_IDENTIFIER IP_FAC_COR_VS_TEG_UP_1 FORMAT "%8.5"
 /begin AXIS_DESCR COM_AXIS online_dummy _CNV_A_R_LINEAR_____23_CM 6 0. 255. FORMAT "%3.0" AXIS_PTS_REF ldpm_vs_cor_teg__fac_cor /end AXIS_DESCR
/end CHARACTERISTIC
/begin CHARACTERISTIC ip_fac_cor_vs_teg_up_2 "Vehicle speed correction" CURVE 0xffe4af7e _REC_CUR_20_u2_u1 4. _CNV_A_R_LINEAR_____275_CM -2. 2. DISPLAY_IDENTIFIER IP_FAC_COR_VS_TEG_UP_2 FORMAT "%8.5"
 /begin AXIS_DESCR COM_AXIS online_dummy _CNV_A_R_LINEAR_____23_CM 6 0. 255. FORMAT "%3.0" AXIS_PTS_REF ldpm_vs_cor_teg__fac_cor /end AXIS_DESCR
/end CHARACTERISTIC
/begin CHARACTERISTIC ip_fac_cor_vs_teg_down_1 "VS correction TCO_EX down" CURVE 0xffe4af5a _REC_CUR_20_u2_u1 4. _CNV_A_R_LINEAR_____275_CM -2. 2. DISPLAY_IDENTIFIER IP_FAC_COR_VS_TEG_DOWN_1 FORMAT "%8.5"
 /begin AXIS_DESCR COM_AXIS online_dummy _CNV_A_R_LINEAR_____23_CM 6 0. 255. FORMAT "%3.0" AXIS_PTS_REF ldpm_vs_cor_teg__fac_cor /end AXIS_DESCR
/end CHARACTERISTIC
/begin CHARACTERISTIC ip_fac_cor_vs_teg_down_2 "VS correction TCO_EX down" CURVE 0xffe4af66 _REC_CUR_20_u2_u1 4. _CNV_A_R_LINEAR_____275_CM -2. 2. DISPLAY_IDENTIFIER IP_FAC_COR_VS_TEG_DOWN_2 FORMAT "%8.5"
 /begin AXIS_DESCR COM_AXIS online_dummy _CNV_A_R_LINEAR_____23_CM 6 0. 255. FORMAT "%3.0" AXIS_PTS_REF ldpm_vs_cor_teg__fac_cor /end AXIS_DESCR
/end CHARACTERISTIC
/begin CHARACTERISTIC ip_fac_cor_vs_teg_wall_up_1 "VS correction TCO_EX down" CURVE 0xffe4afa2 _REC_CUR_20_u2_u1 4. _CNV_A_R_LINEAR_____275_CM -2. 2. DISPLAY_IDENTIFIER IP_FAC_COR_VS_TEG_WALL_UP_1 FORMAT "%8.5"
 /begin AXIS_DESCR COM_AXIS online_dummy _CNV_A_R_LINEAR_____23_CM 6 0. 255. FORMAT "%3.0" AXIS_PTS_REF ldpm_vs_cor_teg__fac_cor /end AXIS_DESCR
/end CHARACTERISTIC
/begin CHARACTERISTIC ip_fac_cor_vs_teg_wall_up_2 "VS correction TCO_EX down" CURVE 0xffe4afae _REC_CUR_20_u2_u1 4. _CNV_A_R_LINEAR_____275_CM -2. 2. DISPLAY_IDENTIFIER IP_FAC_COR_VS_TEG_WALL_UP_2 FORMAT "%8.5"
 /begin AXIS_DESCR COM_AXIS online_dummy _CNV_A_R_LINEAR_____23_CM 6 0. 255. FORMAT "%3.0" AXIS_PTS_REF ldpm_vs_cor_teg__fac_cor /end AXIS_DESCR
/end CHARACTERISTIC
/begin CHARACTERISTIC ip_fac_cor_vs_teg_wall_down_1 "VS correction TCO_EX down" CURVE 0xffe4af8a _REC_CUR_20_u2_u1 4. _CNV_A_R_LINEAR_____275_CM -2. 2. DISPLAY_IDENTIFIER IP_FAC_COR_VS_TEG_WALL_DOWN_1 FORMAT "%8.5"
 /begin AXIS_DESCR COM_AXIS online_dummy _CNV_A_R_LINEAR_____23_CM 6 0. 255. FORMAT "%3.0" AXIS_PTS_REF ldpm_vs_cor_teg__fac_cor /end AXIS_DESCR
/end CHARACTERISTIC
/begin CHARACTERISTIC ip_fac_cor_vs_teg_wall_down_2 "VS correction TCO_EX down" CURVE 0xffe4af96 _REC_CUR_20_u2_u1 4. _CNV_A_R_LINEAR_____275_CM -2. 2. DISPLAY_IDENTIFIER IP_FAC_COR_VS_TEG_WALL_DOWN_2 FORMAT "%8.5"
 /begin AXIS_DESCR COM_AXIS online_dummy _CNV_A_R_LINEAR_____23_CM 6 0. 255. FORMAT "%3.0" AXIS_PTS_REF ldpm_vs_cor_teg__fac_cor /end AXIS_DESCR
/end CHARACTERISTIC
/begin AXIS_PTS ldp_vs_cor_teg_up_1__fac_cor "" 0xffe41306 teg_1.gas_up_struct.vs_cor_teg_up _REC_AXS_20_u1 255. _CNV_A_R_LINEAR_____23_CM 6 0. 255. DISPLAY_IDENTIFIER LDP_VS_COR_TEG_UP_1__FAC_COR FORMAT "%3.0" /end AXIS_PTS
/begin AXIS_PTS ldpm_vs__fac_cor_vs_teg "" 0xffe41488 vs _REC_AXS_20_u1 255. _CNV_A_R_LINEAR_____23_CM 6 0. 255. DISPLAY_IDENTIFIER LDPM_VS__FAC_COR_VS_TEG FORMAT "%3.0" /end AXIS_PTS
/begin CHARACTERISTIC c_toil_teg_grad_min_up "Minimum condition of  Oil temperature for TEG gradient" VALUE 0xffe40980 _REC_VAL_20_u1 200. _CNV_A_R_LINEAR_____14_CM -40. 160. DISPLAY_IDENTIFIER C_TOIL_TEG_GRAD_MIN_UP FORMAT "%3.0" /end CHARACTERISTIC
/begin CHARACTERISTIC c_toil_teg_grad_min_down "Minimum condition of  Oil temperature for TEG gradient" VALUE 0xffe4097f _REC_VAL_20_u1 200. _CNV_A_R_LINEAR_____14_CM -40. 160. DISPLAY_IDENTIFIER C_TOIL_TEG_GRAD_MIN_DOWN FORMAT "%3.0" /end CHARACTERISTIC
/begin CHARACTERISTIC c_toil_teg_level_min_up "Minimum condition of Oil temperature for TEG level" VALUE 0xffe40982 _REC_VAL_20_u1 200. _CNV_A_R_LINEAR_____14_CM -40. 160. DISPLAY_IDENTIFIER C_TOIL_TEG_LEVEL_MIN_UP FORMAT "%3.0" /end CHARACTERISTIC
/begin CHARACTERISTIC c_toil_teg_level_min_down "Minimum condition of Oil temperature for TEG level" VALUE 0xffe40981 _REC_VAL_20_u1 200. _CNV_A_R_LINEAR_____14_CM -40. 160. DISPLAY_IDENTIFIER C_TOIL_TEG_LEVEL_MIN_DOWN FORMAT "%3.0" /end CHARACTERISTIC
/begin CHARACTERISTIC ip_fac_teg_cor_lamb_sp_up "Lambda influences correction depending on load engine" MAP 0xffe4b46a _REC_MAP_20_u2_u2_u2 1.99996948 _CNV_A_R_LINEAR_____20_CM 0. 1.99996948 DISPLAY_IDENTIFIER IP_FAC_TEG_COR_LAMB_SP_UP FORMAT "%7.5"
 /begin AXIS_DESCR COM_AXIS maf_teg _CNV_A_R_LINEAR_____108_CM 8 0. 1389. FORMAT "%7.2" AXIS_PTS_REF ldpm_maf_teg__teg_stat /end AXIS_DESCR
 /begin AXIS_DESCR COM_AXIS n_teg _CNV_A_R_LINEAR_____10_CM 8 0. 8160. FORMAT "%4.0" AXIS_PTS_REF ldpm_n_teg__teg_stat /end AXIS_DESCR
/end CHARACTERISTIC
/begin AXIS_PTS ldpm_maf_teg__teg_stat "" 0xffe519da maf_teg _REC_AXS_20_u2 1389. _CNV_A_R_LINEAR_____108_CM 8 0. 1389. DISPLAY_IDENTIFIER LDPM_MAF_TEG__TEG_STAT FORMAT "%7.2" /end AXIS_PTS
/begin AXIS_PTS ldpm_n_teg__teg_stat "" 0xffe51c16 n_teg _REC_AXS_20_u2 8160. _CNV_A_R_LINEAR_____10_CM 8 0. 8160. DISPLAY_IDENTIFIER LDPM_N_TEG__TEG_STAT FORMAT "%4.0" /end AXIS_PTS
/begin CHARACTERISTIC ip_fac_cor_saf "SAF_KGH correktion" CURVE 0xffe4aee2 _REC_CUR_20_u2_u2 1.99996948 _CNV_A_R_LINEAR_____20_CM 0. 1.99996948 DISPLAY_IDENTIFIER IP_FAC_COR_SAF FORMAT "%7.5"
 /begin AXIS_DESCR COM_AXIS saf_kgh _CNV_A_R_LINEAR_____47_CM 6 0. 1023.984375 FORMAT "%7.2" AXIS_PTS_REF ldpm_saf_kgh__fac_cor_saf /end AXIS_DESCR
/end CHARACTERISTIC
/begin AXIS_PTS ldpm_saf_kgh__fac_cor_saf "" 0xffe51cb6 saf_kgh _REC_AXS_20_u2 1023.984375 _CNV_A_R_LINEAR_____47_CM 6 0. 1023.984375 DISPLAY_IDENTIFIER LDPM_SAF_KGH__FAC_COR_SAF FORMAT "%7.2" /end AXIS_PTS
/begin CHARACTERISTIC ip_eff_iga_add_tco_teg "TCO correction" CURVE 0xffe4a006 _REC_CUR_20_u2_u1 1.99996948 _CNV_A_R_LINEAR_____449_CM -1. 0.99996948 DISPLAY_IDENTIFIER IP_EFF_IGA_ADD_TCO_TEG FORMAT "%8.5"
 /begin AXIS_DESCR COM_AXIS tco _CNV_A_R_LINEAR_____11_CM 6 -48. 142.5 FORMAT "%5.1" AXIS_PTS_REF ldpm_tco__tco_eff_iga_teg /end AXIS_DESCR
/end CHARACTERISTIC
/begin AXIS_PTS ldpm_tco__fac_cor_tco_teg "" 0xffe41433 tco _REC_AXS_20_u1 190.5 _CNV_A_R_LINEAR_____11_CM 6 -48. 142.5 DISPLAY_IDENTIFIER LDPM_TCO__FAC_COR_TCO_TEG FORMAT "%5.1" /end AXIS_PTS
/begin AXIS_PTS ldpm_tco__tco_eff_iga_teg "" 0xffe41446 tco _REC_AXS_20_u1 190.5 _CNV_A_R_LINEAR_____11_CM 6 -48. 142.5 DISPLAY_IDENTIFIER LDPM_TCO__TCO_EFF_IGA_TEG FORMAT "%5.1" /end AXIS_PTS
/begin MEASUREMENT tam_ref_teg "Reference ambient temperature for TEG model" UWORD _CNV_A_R_LINEAR_____280_CM 1 100. -48. 1459.3 DISPLAY_IDENTIFIER TAM_REF_TEG ECU_ADDRESS 0x3fd6fc BYTE_ORDER MSB_LAST FORMAT "%7.2" /end MEASUREMENT
/begin AXIS_PTS ldpm_n_teg__crlc_teg "" 0xffe51c04 n_teg _REC_AXS_20_u2 8160. _CNV_A_R_LINEAR_____10_CM 8 0. 8160. DISPLAY_IDENTIFIER LDPM_N_TEG__CRLC_TEG FORMAT "%4.0" /end AXIS_PTS
/begin CHARACTERISTIC c_crlc_teg_grad_min "Min range limit of level calculation" VALUE 0xffe4156a _REC_VAL_20_u2 0.999755 _CNV_A_R_LINEAR_____126_CM 0. 0.999755 DISPLAY_IDENTIFIER C_CRLC_TEG_GRAD_MIN FORMAT "%7.5" /end CHARACTERISTIC
/begin CHARACTERISTIC c_fac_level_grad "Scaling factor" VALUE 0xffe4073b _REC_VAL_20_u1 1. _CNV_A_R_LINEAR_____0_CM 1. 2. DISPLAY_IDENTIFIER C_FAC_LEVEL_GRAD FORMAT "%2.0" /end CHARACTERISTIC
/begin MEASUREMENT fac_cor_tco_teg_up "Correction TCO for temperature influence" UWORD _CNV_A_R_LINEAR_____20_CM 1 100. 0. 1.99996948 DISPLAY_IDENTIFIER FAC_COR_TCO_TEG_UP ECU_ADDRESS 0x3fd6f0 BYTE_ORDER MSB_LAST FORMAT "%7.5" /end MEASUREMENT
/begin MEASUREMENT fac_cor_tco_teg_wall_up "Correction TCO for temperature influence" UWORD _CNV_A_R_LINEAR_____20_CM 1 100. 0. 1.99996948 DISPLAY_IDENTIFIER FAC_COR_TCO_TEG_WALL_UP ECU_ADDRESS 0x3fd72e BYTE_ORDER MSB_LAST FORMAT "%7.5" /end MEASUREMENT
/begin CHARACTERISTIC ip_fac_cor_tco_teg_up "TCO correction" CURVE 0xffe4af1e _REC_CUR_20_u2_u1 1.99996948 _CNV_A_R_LINEAR_____20_CM 0. 1.99996948 DISPLAY_IDENTIFIER IP_FAC_COR_TCO_TEG_UP FORMAT "%7.5"
 /begin AXIS_DESCR COM_AXIS tco _CNV_A_R_LINEAR_____11_CM 6 -48. 142.5 FORMAT "%5.1" AXIS_PTS_REF ldpm_tco__fac_cor_tco_teg /end AXIS_DESCR
/end CHARACTERISTIC
/begin CHARACTERISTIC ip_fac_cor_tco_teg_wall_up "TCO correction" CURVE 0xffe4af36 _REC_CUR_20_u2_u1 1.99996948 _CNV_A_R_LINEAR_____20_CM 0. 1.99996948 DISPLAY_IDENTIFIER IP_FAC_COR_TCO_TEG_WALL_UP FORMAT "%7.5"
 /begin AXIS_DESCR COM_AXIS tco _CNV_A_R_LINEAR_____11_CM 6 -48. 142.5 FORMAT "%5.1" AXIS_PTS_REF ldpm_tco__fac_cor_tco_teg /end AXIS_DESCR
/end CHARACTERISTIC
/begin MEASUREMENT fac_cor_tco_teg_down "Correction TCO for temperature influence" UWORD _CNV_A_R_LINEAR_____20_CM 1 100. 0. 1.99996948 DISPLAY_IDENTIFIER FAC_COR_TCO_TEG_DOWN ECU_ADDRESS 0x3fd730 BYTE_ORDER MSB_LAST FORMAT "%7.5" /end MEASUREMENT
/begin MEASUREMENT fac_cor_tco_teg_wall_down "Correction TCO for temperature influence" UWORD _CNV_A_R_LINEAR_____20_CM 1 100. 0. 1.99996948 DISPLAY_IDENTIFIER FAC_COR_TCO_TEG_WALL_DOWN ECU_ADDRESS 0x3fd732 BYTE_ORDER MSB_LAST FORMAT "%7.5" /end MEASUREMENT
/begin CHARACTERISTIC ip_fac_cor_tco_teg_down "TCO correction" CURVE 0xffe4af12 _REC_CUR_20_u2_u1 1.99996948 _CNV_A_R_LINEAR_____20_CM 0. 1.99996948 DISPLAY_IDENTIFIER IP_FAC_COR_TCO_TEG_DOWN FORMAT "%7.5"
 /begin AXIS_DESCR COM_AXIS tco _CNV_A_R_LINEAR_____11_CM 6 -48. 142.5 FORMAT "%5.1" AXIS_PTS_REF ldpm_tco__fac_cor_tco_teg /end AXIS_DESCR
/end CHARACTERISTIC
/begin CHARACTERISTIC ip_fac_cor_tco_teg_wall_down "TCO correction" CURVE 0xffe4af2a _REC_CUR_20_u2_u1 1.99996948 _CNV_A_R_LINEAR_____20_CM 0. 1.99996948 DISPLAY_IDENTIFIER IP_FAC_COR_TCO_TEG_WALL_DOWN FORMAT "%7.5"
 /begin AXIS_DESCR COM_AXIS tco _CNV_A_R_LINEAR_____11_CM 6 -48. 142.5 FORMAT "%5.1" AXIS_PTS_REF ldpm_tco__fac_cor_tco_teg /end AXIS_DESCR
/end CHARACTERISTIC
/begin CHARACTERISTIC c_ti_min_post_pulse "minimum duration of ti post pulses" VALUE 0xffe41a82 _REC_VAL_20_u2 0.5 _CNV_A_R_LINEAR_____165_CM 0. 5. DISPLAY_IDENTIFIER C_TI_MIN_POST_PULSE FORMAT "%5.3" /end CHARACTERISTIC
/begin MEASUREMENT bios_ti[0] "injection time cylinder logical " UWORD _CNV_A_R_LINEAR_____165_CM 1 100. 0. 262.14 DISPLAY_IDENTIFIER BIOS_TI_0 ECU_ADDRESS 0x3fd98c BYTE_ORDER MSB_LAST FORMAT "%7.3" /end MEASUREMENT
/begin MEASUREMENT bios_ti[1] "injection time cylinder logical " UWORD _CNV_A_R_LINEAR_____165_CM 1 100. 0. 262.14 DISPLAY_IDENTIFIER BIOS_TI_1 ECU_ADDRESS 0x3fd98e BYTE_ORDER MSB_LAST FORMAT "%7.3" /end MEASUREMENT
/begin MEASUREMENT bios_ti[2] "injection time cylinder logical " UWORD _CNV_A_R_LINEAR_____165_CM 1 100. 0. 262.14 DISPLAY_IDENTIFIER BIOS_TI_2 ECU_ADDRESS 0x3fd990 BYTE_ORDER MSB_LAST FORMAT "%7.3" /end MEASUREMENT
/begin MEASUREMENT bios_ti[3] "injection time cylinder logical " UWORD _CNV_A_R_LINEAR_____165_CM 1 100. 0. 262.14 DISPLAY_IDENTIFIER BIOS_TI_3 ECU_ADDRESS 0x3fd992 BYTE_ORDER MSB_LAST FORMAT "%7.3" /end MEASUREMENT
/begin MEASUREMENT bios_ti[4] "injection time cylinder logical " UWORD _CNV_A_R_LINEAR_____165_CM 1 100. 0. 262.14 DISPLAY_IDENTIFIER BIOS_TI_4 ECU_ADDRESS 0x3fd994 BYTE_ORDER MSB_LAST FORMAT "%7.3" /end MEASUREMENT
/begin MEASUREMENT bios_ti[5] "injection time cylinder logical " UWORD _CNV_A_R_LINEAR_____165_CM 1 100. 0. 262.14 DISPLAY_IDENTIFIER BIOS_TI_5 ECU_ADDRESS 0x3fd996 BYTE_ORDER MSB_LAST FORMAT "%7.3" /end MEASUREMENT
/begin MEASUREMENT bios_ti_ofs "offset injection time for dead time correction" SWORD _CNV_A_R_LINEAR_____165_CM 1 100. 0. 131.068 DISPLAY_IDENTIFIER BIOS_TI_OFS ECU_ADDRESS 0x3fd9a8 BYTE_ORDER MSB_LAST FORMAT "%7.3" /end MEASUREMENT
/begin MEASUREMENT bios_ti_min_post_pulse_inj "minimum duration of ti post pulses" UWORD _CNV_A_R_LINEAR_____165_CM 1 100. 0. 5. DISPLAY_IDENTIFIER BIOS_TI_MIN_POST_PULSE_INJ ECU_ADDRESS 0x3fd9a4 BYTE_ORDER MSB_LAST FORMAT "%5.3" /end MEASUREMENT
/begin MEASUREMENT bios_eoi_lim "latest possible end of injection before TDC" UWORD _CNV_A_R_LINEAR_____228_CM 1 100. 0. 720. DISPLAY_IDENTIFIER BIOS_EOI_LIM ECU_ADDRESS 0x3fd9a6 BYTE_ORDER MSB_LAST FORMAT "%6.2" /end MEASUREMENT
/begin MEASUREMENT bios_lv_post_puls_inj "logical variable to enable post pulses" UBYTE _CNV_S_2_RANGE______21_CM 1 100. 0. 1. DISPLAY_IDENTIFIER BIOS_LV_POST_PULS_INJ ECU_ADDRESS 0x3fe8b0 BIT_MASK 0x1 /end MEASUREMENT
/begin MEASUREMENT bios_eoi[0] "end of injection in °crk before BIOS_EOI_LIM" UWORD _CNV_A_R_LINEAR_____228_CM 1 100. 0. 720. DISPLAY_IDENTIFIER BIOS_EOI_0 ECU_ADDRESS 0x3fd998 BYTE_ORDER MSB_LAST FORMAT "%6.2" /end MEASUREMENT
/begin MEASUREMENT bios_eoi[1] "end of injection in °crk before BIOS_EOI_LIM" UWORD _CNV_A_R_LINEAR_____228_CM 1 100. 0. 720. DISPLAY_IDENTIFIER BIOS_EOI_1 ECU_ADDRESS 0x3fd99a BYTE_ORDER MSB_LAST FORMAT "%6.2" /end MEASUREMENT
/begin MEASUREMENT bios_eoi[2] "end of injection in °crk before BIOS_EOI_LIM" UWORD _CNV_A_R_LINEAR_____228_CM 1 100. 0. 720. DISPLAY_IDENTIFIER BIOS_EOI_2 ECU_ADDRESS 0x3fd99c BYTE_ORDER MSB_LAST FORMAT "%6.2" /end MEASUREMENT
/begin MEASUREMENT bios_eoi[3] "end of injection in °crk before BIOS_EOI_LIM" UWORD _CNV_A_R_LINEAR_____228_CM 1 100. 0. 720. DISPLAY_IDENTIFIER BIOS_EOI_3 ECU_ADDRESS 0x3fd99e BYTE_ORDER MSB_LAST FORMAT "%6.2" /end MEASUREMENT
/begin MEASUREMENT bios_eoi[4] "end of injection in °crk before BIOS_EOI_LIM" UWORD _CNV_A_R_LINEAR_____228_CM 1 100. 0. 720. DISPLAY_IDENTIFIER BIOS_EOI_4 ECU_ADDRESS 0x3fd9a0 BYTE_ORDER MSB_LAST FORMAT "%6.2" /end MEASUREMENT
/begin MEASUREMENT bios_eoi[5] "end of injection in °crk before BIOS_EOI_LIM" UWORD _CNV_A_R_LINEAR_____228_CM 1 100. 0. 720. DISPLAY_IDENTIFIER BIOS_EOI_5 ECU_ADDRESS 0x3fd9a2 BYTE_ORDER MSB_LAST FORMAT "%6.2" /end MEASUREMENT
/begin CHARACTERISTIC lc_post_puls_inj_ena "Logical constant for enabling post pulse" VALUE 0xffe40fc6 _REC_VAL_20_u1 1. _CNV_A_R_LINEAR_____22_CM 0. 1. DISPLAY_IDENTIFIER LC_POST_PULS_INJ_ENA FORMAT "%1.0" /end CHARACTERISTIC
/begin CHARACTERISTIC c_ti_as_cyl[0] "injection time factor to correct cylinder injection value cyl. 0" VALUE 0xffe4094e _REC_VAL_20_u1 1.99220002 _CNV_A_R_LINEAR_____39_CM 0. 1.99220002 DISPLAY_IDENTIFIER C_TI_AS_CYL_0 FORMAT "%5.3" /end CHARACTERISTIC
/begin CHARACTERISTIC c_ti_as_cyl[1] "injection time factor to correct cylinder injection value cyl. 1" VALUE 0xffe4094f _REC_VAL_20_u1 1.99220002 _CNV_A_R_LINEAR_____39_CM 0. 1.99220002 DISPLAY_IDENTIFIER C_TI_AS_CYL_1 FORMAT "%5.3" /end CHARACTERISTIC
/begin CHARACTERISTIC c_ti_as_cyl[2] "injection time factor to correct cylinder injection value cyl. 2" VALUE 0xffe40950 _REC_VAL_20_u1 1.99220002 _CNV_A_R_LINEAR_____39_CM 0. 1.99220002 DISPLAY_IDENTIFIER C_TI_AS_CYL_2 FORMAT "%5.3" /end CHARACTERISTIC
/begin CHARACTERISTIC c_ti_as_cyl[3] "injection time factor to correct cylinder injection value cyl. 3" VALUE 0xffe40951 _REC_VAL_20_u1 1.99220002 _CNV_A_R_LINEAR_____39_CM 0. 1.99220002 DISPLAY_IDENTIFIER C_TI_AS_CYL_3 FORMAT "%5.3" /end CHARACTERISTIC
/begin CHARACTERISTIC c_ti_as_cyl[4] "injection time factor to correct cylinder injection value cyl. 4" VALUE 0xffe40952 _REC_VAL_20_u1 1.99220002 _CNV_A_R_LINEAR_____39_CM 0. 1.99220002 DISPLAY_IDENTIFIER C_TI_AS_CYL_4 FORMAT "%5.3" /end CHARACTERISTIC
/begin CHARACTERISTIC c_ti_as_cyl[5] "injection time factor to correct cylinder injection value cyl. 5" VALUE 0xffe40953 _REC_VAL_20_u1 1.99220002 _CNV_A_R_LINEAR_____39_CM 0. 1.99220002 DISPLAY_IDENTIFIER C_TI_AS_CYL_5 FORMAT "%5.3" /end CHARACTERISTIC
/begin CHARACTERISTIC c_ti_as "global injection time correction" VALUE 0xffe4094d _REC_VAL_20_u1 1.99220002 _CNV_A_R_LINEAR_____39_CM 0. 1.99220002 DISPLAY_IDENTIFIER C_TI_AS FORMAT "%5.3" /end CHARACTERISTIC
/begin MEASUREMENT inj_hom_req "homogeneous injection requested, binary coded" UBYTE _CNV_A_R_LINEAR_____0_CM 1 100. 0. 255. DISPLAY_IDENTIFIER INJ_HOM_REQ ECU_ADDRESS 0x3fe8af FORMAT "%3.0" /end MEASUREMENT
/begin CHARACTERISTIC ip_eoi_min_tipr "Latest permitted predicted end of injection for pre-injection" CURVE 0xffe4ae0a _REC_CUR_20_u2_u1 720. _CNV_A_R_LINEAR_____82_CM 0. 720. DISPLAY_IDENTIFIER IP_EOI_MIN_TIPR FORMAT "%6.2"
 /begin AXIS_DESCR COM_AXIS tco _CNV_A_R_LINEAR_____11_CM 8 -48. 142.5 FORMAT "%5.1" AXIS_PTS_REF ldp_tco__eoi_min_tipr /end AXIS_DESCR
/end CHARACTERISTIC
/begin CHARACTERISTIC c_nr_max_tooth_tipr "Maximum tooth number till preliminary synchronisation for preinjection" VALUE 0xffe40810 _REC_VAL_20_u1 63. _CNV_A_R_LINEAR_____0_CM 1. 64. DISPLAY_IDENTIFIER C_NR_MAX_TOOTH_TIPR FORMAT "%3.0" /end CHARACTERISTIC
/begin AXIS_PTS ldp_tco__eoi_min_tipr "" 0xffe481b0 tco _REC_AXS_20_u1 190.5 _CNV_A_R_LINEAR_____11_CM 8 -48. 142.5 DISPLAY_IDENTIFIER LDP_TCO__EOI_MIN_TIPR FORMAT "%5.1" /end AXIS_PTS
/begin CHARACTERISTIC c_fac_mff_ti_stnd_1 "Injectionvalve characteristic for fuel mass flow to injection time at standard conditions" VALUE 0xffe41618 _REC_VAL_20_u2 0.37745 _CNV_A_R_LINEAR_____493_CM 0. 0.37745 DISPLAY_IDENTIFIER C_FAC_MFF_TI_STND_1 FORMAT "%7.5" /end CHARACTERISTIC
/begin AXIS_PTS ldpm_n_32_s "" 0xffe4856d n_32 _REC_AXS_20_u1 8160. _CNV_A_R_LINEAR_____15_CM 16 0. 8160. DISPLAY_IDENTIFIER LDPM_N_32_S FORMAT "%4.0" /end AXIS_PTS
/begin COMPU_METHOD _CNV_A_R_LINEAR_____0_CM "" RAT_FUNC "%6.3" "-" COEFFS 0 1. 0. 0 0 1 /end COMPU_METHOD
/begin COMPU_METHOD _CNV_S_2_RANGE______2_CM "" TAB_VERB "%6.3" "[-]" COMPU_TAB_REF _CNV_S_2_RANGE______2 /end COMPU_METHOD
/begin COMPU_VTAB _CNV_S_2_RANGE______2 "" TAB_VERB 2 0 "0" 1 "1" /end COMPU_VTAB
/begin COMPU_METHOD _CNV_A_R_LINEAR_____3_CM "" RAT_FUNC "%6.3" "V" COEFFS 0 204.7999998974999 0. 0 0 1 /end COMPU_METHOD
/begin COMPU_METHOD _CNV_A_R_LINEAR_____4_CM "" RAT_FUNC "%6.3" "s" COEFFS 0 100. 0. 0 0 1 /end COMPU_METHOD
/begin COMPU_METHOD _CNV_A_R_LINEAR_____6_CM "" RAT_FUNC "%6.3" "°C" COEFFS 0 16. 0. 0 0 1 /end COMPU_METHOD
/begin COMPU_METHOD _CNV_A_R_LINEAR_____8_CM "" RAT_FUNC "%6.3" "%" COEFFS 0 655.3600000071681 0. 0 0 1 /end COMPU_METHOD
/begin COMPU_METHOD _CNV_A_R_LINEAR_____9_CM "" RAT_FUNC "%6.3" "%" COEFFS 0 2.56 0. 0 0 1 /end COMPU_METHOD
/begin COMPU_METHOD _CNV_A_R_LINEAR_____10_CM "" RAT_FUNC "%6.3" "rpm" COEFFS 0 1. 0. 0 0 1 /end COMPU_METHOD
/begin COMPU_METHOD _CNV_A_R_LINEAR_____11_CM "" RAT_FUNC "%6.3" "°C" COEFFS 0 1.333333333333333 64. 0 0 1 /end COMPU_METHOD
/begin COMPU_METHOD _CNV_A_R_LINEAR_____12_CM "" RAT_FUNC "%6.3" "°C" COEFFS 0 1.333333333333333 0. 0 0 1 /end COMPU_METHOD
/begin COMPU_METHOD _CNV_A_R_LINEAR_____14_CM "" RAT_FUNC "%6.3" "°C" COEFFS 0 1. 40. 0 0 1 /end COMPU_METHOD
/begin COMPU_METHOD _CNV_A_R_LINEAR_____15_CM "" RAT_FUNC "%6.3" "rpm" COEFFS 0 3.125e-002 0. 0 0 1 /end COMPU_METHOD
/begin COMPU_METHOD _CNV_A_R_LINEAR_____20_CM "" RAT_FUNC "%6.3" "-" COEFFS 0 32768.00003968061 0. 0 0 1 /end COMPU_METHOD
/begin COMPU_METHOD _CNV_S_2_RANGE______21_CM "" TAB_VERB "%6.3" "-" COMPU_TAB_REF _CNV_S_2_RANGE______21 /end COMPU_METHOD
/begin COMPU_VTAB _CNV_S_2_RANGE______21 "" TAB_VERB 2 0 "0" 1 "1" /end COMPU_VTAB
/begin COMPU_METHOD _CNV_A_R_LINEAR_____22_CM "" RAT_FUNC "%6.3" "[-]" COEFFS 0 1. 0. 0 0 1 /end COMPU_METHOD
/begin COMPU_METHOD _CNV_A_R_LINEAR_____23_CM "" RAT_FUNC "%6.3" "km/h" COEFFS 0 1. 0. 0 0 1 /end COMPU_METHOD
/begin COMPU_METHOD _CNV_A_R_LINEAR_____24_CM "" RAT_FUNC "%6.3" "s" COEFFS 0 10. 0. 0 0 1 /end COMPU_METHOD
/begin COMPU_METHOD _CNV_A_R_LINEAR_____27_CM "" RAT_FUNC "%6.3" "mg/stk" COEFFS 0 0.183585313174946 0. 0 0 1 /end COMPU_METHOD
/begin COMPU_METHOD _CNV_A_R_LINEAR_____29_CM "" RAT_FUNC "%6.3" "-" COEFFS 0 255.9983911655618 0. 0 0 1 /end COMPU_METHOD
/begin COMPU_METHOD _CNV_A_R_LINEAR_____37_CM "" RAT_FUNC "%6.3" "-" COEFFS 0 65536.00007936121 0. 0 0 1 /end COMPU_METHOD
/begin COMPU_METHOD _CNV_A_R_LINEAR_____39_CM "" RAT_FUNC "%6.3" "-" COEFFS 0 127.9991955827809 0. 0 0 1 /end COMPU_METHOD
/begin COMPU_METHOD _CNV_A_R_LINEAR_____47_CM "" RAT_FUNC "%6.3" "kg/h" COEFFS 0 64. 0. 0 0 1 /end COMPU_METHOD
/begin COMPU_METHOD _CNV_A_R_LINEAR_____55_CM "" RAT_FUNC "%6.3" "Nm" COEFFS 0 32. 0. 0 0 1 /end COMPU_METHOD
/begin COMPU_METHOD _CNV_A_R_LINEAR_____82_CM "" RAT_FUNC "%6.3" "°CRK" COEFFS 0 2.666666666666667 0. 0 0 1 /end COMPU_METHOD
/begin COMPU_METHOD _CNV_A_R_LINEAR_____97_CM "" RAT_FUNC "%6.3" "min" COEFFS 0 1. 0. 0 0 1 /end COMPU_METHOD
/begin COMPU_METHOD _CNV_A_R_LINEAR_____108_CM "" RAT_FUNC "%6.3" "mg/stk" COEFFS 0 47.18142548596112 0. 0 0 1 /end COMPU_METHOD
/begin COMPU_METHOD _CNV_A_R_LINEAR_____126_CM "" RAT_FUNC "%6.3" "-" COEFFS 0 65551.06000970239 0. 0 0 1 /end COMPU_METHOD
/begin COMPU_METHOD _CNV_A_R_LINEAR_____129_CM "" RAT_FUNC "%6.3" "[-]" COEFFS 0 64. 0. 0 0 1 /end COMPU_METHOD
/begin COMPU_METHOD _CNV_A_R_LINEAR_____165_CM "" RAT_FUNC "%6.3" "ms" COEFFS 0 250. 0. 0 0 1 /end COMPU_METHOD
/begin COMPU_METHOD _CNV_A_R_LINEAR_____187_CM "" RAT_FUNC "%6.3" "Nm" COEFFS 0 32. 32768. 0 0 1 /end COMPU_METHOD
/begin COMPU_METHOD _CNV_A_R_LINEAR_____206_CM "" RAT_FUNC "%6.3" "-" COEFFS 0 1023.999999919998 0. 0 0 1 /end COMPU_METHOD
/begin COMPU_METHOD _CNV_A_R_LINEAR_____228_CM "" RAT_FUNC "%6.3" "°CRK" COEFFS 0 42.66666666666666 0. 0 0 1 /end COMPU_METHOD
/begin COMPU_METHOD _CNV_A_R_LINEAR_____272_CM "" RAT_FUNC "%6.3" "-" COEFFS 0 16383.99985599781 0. 0 0 1 /end COMPU_METHOD
/begin COMPU_METHOD _CNV_A_R_LINEAR_____275_CM "" RAT_FUNC "%6.3" "-" COEFFS 0 16383.75 32767.5 0 0 1 /end COMPU_METHOD
/begin COMPU_METHOD _CNV_A_R_LINEAR_____276_CM "" RAT_FUNC "%6.3" "-" COEFFS 0 16383.99999935999 -1.280019205296412e-006 0 0 1 /end COMPU_METHOD
/begin COMPU_METHOD _CNV_A_R_LINEAR_____277_CM "" RAT_FUNC "%6.3" "[-]" COEFFS 0 1023.999999959999 32767.99999871998 0 0 1 /end COMPU_METHOD
/begin COMPU_METHOD _CNV_A_R_LINEAR_____278_CM "" RAT_FUNC "%6.3" "°C" COEFFS 0 43.47826086956522 0. 0 0 1 /end COMPU_METHOD
/begin COMPU_METHOD _CNV_A_R_LINEAR_____279_CM "" RAT_FUNC "%6.3" "s" COEFFS 0 2. 0. 0 0 1 /end COMPU_METHOD
/begin COMPU_METHOD _CNV_A_R_LINEAR_____280_CM "" RAT_FUNC "%6.3" "°C" COEFFS 0 43.47840509520334 2086.96344456976 0 0 1 /end COMPU_METHOD
/begin COMPU_METHOD _CNV_A_R_LINEAR_____287_CM "" RAT_FUNC "%6.3" "g" COEFFS 0 36.00036915004301 0. 0 0 1 /end COMPU_METHOD
/begin COMPU_METHOD _CNV_A_R_LINEAR_____349_CM "" RAT_FUNC "%6.3" "-" COEFFS 0 33097.9797979798 -329.979797979795 0 0 1 /end COMPU_METHOD
/begin COMPU_METHOD _CNV_A_R_LINEAR_____350_CM "" RAT_FUNC "%6.3" "mg" COEFFS 0 6.25 0. 0 0 1 /end COMPU_METHOD
/begin COMPU_METHOD _CNV_A_R_LINEAR_____394_CM "" RAT_FUNC "%6.3" "-" COEFFS 0 8191.999999679995 0. 0 0 1 /end COMPU_METHOD
/begin COMPU_METHOD _CNV_A_R_LINEAR_____441_CM "" RAT_FUNC "%6.3" "-" COEFFS 0 2. 0. 0 0 1 /end COMPU_METHOD
/begin COMPU_METHOD _CNV_A_R_LINEAR_____449_CM "" RAT_FUNC "%6.3" "-" COEFFS 0 32768.00003968061 32768.00003968061 0 0 1 /end COMPU_METHOD
/begin COMPU_METHOD _CNV_A_R_LINEAR_____468_CM "" RAT_FUNC "%6.3" "°C" COEFFS 0 66.66666666666667 0. 0 0 1 /end COMPU_METHOD
/begin COMPU_METHOD _CNV_A_R_LINEAR_____469_CM "" RAT_FUNC "%6.3" "°C" COEFFS 0 21.73913043478261 32768. 0 0 1 /end COMPU_METHOD
/begin COMPU_METHOD _CNV_A_R_LINEAR_____470_CM "" RAT_FUNC "%6.3" "kJ" COEFFS 0 576008.8405624894 0. 0 0 1 /end COMPU_METHOD
/begin COMPU_METHOD _CNV_A_R_LINEAR_____471_CM "" RAT_FUNC "%6.3" "°C" COEFFS 0 66.66666666666667 32768. 0 0 1 /end COMPU_METHOD
/begin COMPU_METHOD _CNV_A_R_LINEAR_____472_CM "" RAT_FUNC "%6.3" "°C" COEFFS 0 66.6670057577972 0.1666700426794705 0 0 1 /end COMPU_METHOD
/begin COMPU_METHOD _CNV_A_R_LINEAR_____473_CM "" RAT_FUNC "%6.3" "°C" COEFFS 0 85.33168316831683 0. 0 0 1 /end COMPU_METHOD
/begin COMPU_METHOD _CNV_A_R_LINEAR_____474_CM "" RAT_FUNC "%6.3" "°C" COEFFS 0 1.262376237623762 0. 0 0 1 /end COMPU_METHOD
/begin COMPU_METHOD _CNV_A_R_LINEAR_____475_CM "" RAT_FUNC "%6.3" "°C" COEFFS 0 1.331683168316832 0. 0 0 1 /end COMPU_METHOD
/begin COMPU_METHOD _CNV_A_R_LINEAR_____476_CM "" RAT_FUNC "%6.3" "°C" COEFFS 0 1.262376237623762 255. 0 0 1 /end COMPU_METHOD
/begin COMPU_METHOD _CNV_A_R_LINEAR_____477_CM "" RAT_FUNC "%6.3" "°C" COEFFS 0 1.331683168316832 269. 0 0 1 /end COMPU_METHOD
/begin COMPU_METHOD _CNV_A_R_LINEAR_____478_CM "" RAT_FUNC "%6.3" "kJ/K" COEFFS 0 6666.836215666328 0. 0 0 1 /end COMPU_METHOD
/begin COMPU_METHOD _CNV_A_R_LINEAR_____479_CM "" RAT_FUNC "%6.3" "KW" COEFFS 0 149.2228528379436 0. 0 0 1 /end COMPU_METHOD
/begin COMPU_METHOD _CNV_A_R_LINEAR_____480_CM "" RAT_FUNC "%6.3" "°CRK" COEFFS 0 2.666666666666667 255. 0 0 1 /end COMPU_METHOD
/begin COMPU_METHOD _CNV_A_R_LINEAR_____481_CM "" RAT_FUNC "%6.3" "kJ" COEFFS 0 8.789063285815482 0. 0 0 1 /end COMPU_METHOD
/begin COMPU_METHOD _CNV_A_R_LINEAR_____482_CM "" RAT_FUNC "%6.3" "°C" COEFFS 0 43.47895323530973 0. 0 0 1 /end COMPU_METHOD
/begin COMPU_METHOD _CNV_A_R_LINEAR_____483_CM "" RAT_FUNC "%6.3" "°C" COEFFS 0 43.47840509520334 0. 0 0 1 /end COMPU_METHOD
/begin COMPU_METHOD _CNV_A_R_LINEAR_____484_CM "" RAT_FUNC "%6.3" "-" COEFFS 0 8191.999999679995 32767.99999871998 0 0 1 /end COMPU_METHOD
/begin COMPU_METHOD _CNV_A_R_LINEAR_____485_CM "" RAT_FUNC "%6.3" "-" COEFFS 0 8192.064968445899 0. 0 0 1 /end COMPU_METHOD
/begin COMPU_METHOD _CNV_A_R_LINEAR_____493_CM "" RAT_FUNC "%6.3" "ms/(mg/stk)" COEFFS 0 173625.6457808981 0. 0 0 1 /end COMPU_METHOD
/begin RECORD_LAYOUT _REC_VAL_20_u1 FNC_VALUES 1 UBYTE COLUMN_DIR DIRECT /end RECORD_LAYOUT
/begin RECORD_LAYOUT _REC_VAL_20_u2 FNC_VALUES 1 UWORD COLUMN_DIR DIRECT /end RECORD_LAYOUT
/begin RECORD_LAYOUT _REC_CUR_20_u2_u1 FNC_VALUES 1 UWORD COLUMN_DIR DIRECT /end RECORD_LAYOUT
/begin RECORD_LAYOUT _REC_AXS_20_u1 NO_AXIS_PTS_X 1 UBYTE AXIS_PTS_X 2 UBYTE INDEX_INCR DIRECT /end RECORD_LAYOUT
/begin RECORD_LAYOUT _REC_CUR_20_u1_u1 FNC_VALUES 1 UBYTE COLUMN_DIR DIRECT /end RECORD_LAYOUT
/begin RECORD_LAYOUT _REC_AXS_20_u2 NO_AXIS_PTS_X 1 UWORD AXIS_PTS_X 2 UWORD INDEX_INCR DIRECT /end RECORD_LAYOUT
/begin RECORD_LAYOUT _REC_MAP_20_u2_u2_u1 FNC_VALUES 1 UWORD COLUMN_DIR DIRECT /end RECORD_LAYOUT
/begin RECORD_LAYOUT _REC_MAP_20_u2_u1_u1 FNC_VALUES 1 UWORD COLUMN_DIR DIRECT /end RECORD_LAYOUT
/begin RECORD_LAYOUT _REC_CUR_20_u2_u2 FNC_VALUES 1 UWORD COLUMN_DIR DIRECT /end RECORD_LAYOUT
/begin RECORD_LAYOUT _REC_MAP_20_u2_u1_u2 FNC_VALUES 1 UWORD COLUMN_DIR DIRECT /end RECORD_LAYOUT
/begin RECORD_LAYOUT _REC_MAP_20_u1_u2_u2 FNC_VALUES 1 UBYTE COLUMN_DIR DIRECT /end RECORD_LAYOUT
/begin RECORD_LAYOUT _REC_MAP_20_u2_u2_u2 FNC_VALUES 1 UWORD COLUMN_DIR DIRECT /end RECORD_LAYOUT
/begin FUNCTION INJ_Lambda_Catalyst_overheating_ "_Lambda Catalyst overheating prevention"
 /begin DEF_CHARACTERISTIC ip_teg_cop_sp_dif ip_lamb_cop ip_teg_cop_sp c_lgrd_lamb_cop_inc c_lgrd_lamb_cop_dec ip_teg_cop_sp_lim c_lamb_cop_sp_pas c_teg_cop_dif_lim /end DEF_CHARACTERISTIC
 /begin OUT_MEASUREMENT lam_bank_1.cat_prev.lamb_cop lam_bank_1.cat_prev.lv_lamb_cop lam_bank_1.cat_prev.fac_cop lam_bank_1.cat_prev.teg_cop_sp lam_bank_1.cat_prev.t_cop lam_bank_2.cat_prev.lamb_cop lam_bank_2.cat_prev.lv_lamb_cop lam_bank_2.cat_prev.fac_cop lam_bank_2.cat_prev.teg_cop_sp lam_bank_2.cat_prev.t_cop /end OUT_MEASUREMENT
/end FUNCTION
/begin FUNCTION INJ_Conversion_MFF_to_TI "_Conversion MFF to TI" /begin DEF_CHARACTERISTIC c_fac_mff_ti_stnd_1 /end DEF_CHARACTERISTIC /end FUNCTION
/begin FUNCTION INJ_Basic_lambda_setpoint "_Basic lambda setpoint" /end FUNCTION
/begin FUNCTION INJ_Ambient_pressure_correction "_Ambient pressure correction" /end FUNCTION
/begin FUNCTION INJ_Injection_phase_for_stratifi "_Injection phase for stratified mode" /end FUNCTION
/begin FUNCTION INJ_Lambda_setpoint_for_catalyst "_Lambda setpoint for catalyst regeneration"
 /begin DEF_CHARACTERISTIC lc_lamb_rgn_fac_sens ip_lamb_rgn_afr__maf__n_32 ip_lamb_rgn_fac_sens ip_lamb_rgn_fac_mdl c_lamb_rgn_pas c_lamb_rgn_max c_t_rgn_lamb_con /end DEF_CHARACTERISTIC
 /begin OUT_MEASUREMENT lam_bank_1.lamb_rgn.lamb_rgn lam_bank_2.lamb_rgn.lamb_rgn lv_lamb_rgn_fac_sens t_rgn /end OUT_MEASUREMENT
/end FUNCTION
/begin FUNCTION INJ_Injection_press_correction_s "_Injection press correction stratified" /end FUNCTION
/begin FUNCTION INJ_Injection_setpoint_for_strat "_Injection setpoint for stratified mode" /end FUNCTION
/begin FUNCTION INJ_Mass_Fuel_Flow_Setpoint_for_ "_Mass Fuel Flow Setpoint for Stratified Mode"
 /begin DEF_CHARACTERISTIC ip_mff_sp_s lc_tqi_sp_mff_man_act c_tqi_sp_mff_man lc_mff_sp_s_man_act c_mff_sp_s_man c_mff_sp_s_ofs_as /end DEF_CHARACTERISTIC
 /begin OUT_MEASUREMENT tqi_sp_mff tqi_sp_mff_1 mff_sp_s_1 mff_sp_s mff_sp_s_eng eff_tot_bas_s /end OUT_MEASUREMENT
/end FUNCTION
/begin FUNCTION INJ_LAMB_RATIO_calculation "_LAMB_RATIO calculation" /begin DEF_CHARACTERISTIC ip_lamb_iga_afl__n_32__maf_hb c_lamb_iga_afr /end DEF_CHARACTERISTIC /begin OUT_MEASUREMENT lamb_ratio /end OUT_MEASUREMENT /end FUNCTION
/begin FUNCTION INJ_Catalyst_heating_with_second "_Catalyst heating with secondary air"
 /begin DEF_CHARACTERISTIC ip_lamb_sawup ip_lamb_sawup_is ip_lamb_add_sawup lc_sa_swi_cmb c_lamb_sp_sa_eol /end DEF_CHARACTERISTIC
 /begin OUT_MEASUREMENT lamb_sawup fac_lamb_de_sa lamb_sa_ch lamb_sp_sa_eol /end OUT_MEASUREMENT
/end FUNCTION
/begin FUNCTION INJ_Injection_Time_Correction_by "_Injection Time Correction by the Application System"
 /begin DEF_CHARACTERISTIC c_ti_as_cyl[0] c_ti_as_cyl[1] c_ti_as_cyl[2] c_ti_as_cyl[3] c_ti_as_cyl[4] c_ti_as_cyl[5] c_ti_as ip_eoi_min_tipr c_nr_max_tooth_tipr /end DEF_CHARACTERISTIC
 /begin OUT_MEASUREMENT bios_ti[0] bios_ti[1] bios_ti[2] bios_ti[3] bios_ti[4] bios_ti[5] inj_hom_req /end OUT_MEASUREMENT
/end FUNCTION
/begin FUNCTION INJ_Transformation_layer_for_bas "_Transformation layer for basic software" /begin DEF_CHARACTERISTIC c_ti_min_post_pulse lc_post_puls_inj_ena /end DEF_CHARACTERISTIC
 /begin OUT_MEASUREMENT bios_ti_ofs bios_ti_min_post_pulse_inj bios_eoi_lim bios_lv_post_puls_inj bios_eoi[0] bios_eoi[1] bios_eoi[2] bios_eoi[3] bios_eoi[4] bios_eoi[5] /end OUT_MEASUREMENT
/end FUNCTION
/begin FUNCTION INJ_Injection_mode_management "_Injection mode management" /end FUNCTION
/begin FUNCTION INJ_Exhaust_Gas_temperature_mode "_Exhaust Gas temperature model"
 /begin DEF_CHARACTERISTIC ip_temp_sp_toil ip_fac_cor_lamb_sp_up ip_fac_scc_teg ip_fac_toil_vs ip_temp_sp_tco_ex ip_teg_stat_up_1 ip_teg_wall_stat_up_1 ip_fac_teg_wall_cor_lamb_sp_up ip_teg_add_egr ip_teg_wall_add_egr ip_fac_cor_lamb_sp_wall_up ip_crlc_teg_dec_puc_up_1 ip_crlc_teg_wall_dec_puc_up_1 ip_crlc_teg_inc_up_1 ip_crlc_teg_wall_inc_up_1 ip_crlc_teg_dec_up_1 ip_crlc_teg_wall_dec_up_1 ip_teg_stat_down_1 ip_teg_wall_stat_down_1 ip_crlc_teg_toil_dif_down ip_crlc_teg_wall_toil_dif_down ip_crlc_teg_tco_dif_down ip_crlc_teg_wall_tco_dif_down ip_crlc_teg_dec_puc_down_1 ip_crlc_teg_wall_dec_puc_down_1 ip_crlc_teg_dec_down_1 ip_crlc_teg_wall_dec_down_1 ip_crlc_teg_inc_down_1 ip_crlc_teg_wall_inc_down_1 c_tam_ref c_maf_int_teg_st_up c_crlc_teg_st_up c_egy_teg_end_sp_up_1 c_egy_teg_end_sp_up_2 c_teg_wall_st_off c_crlc_teg_wall_st_end_up c_crlc_teg_wall_st_up c_egy_teg_wall_end_sp_up c_fac_cor_vo_teg_down c_fac_cor_vo_teg_wall_down c_fac_cor_lamb_sp_teg_down c_fac_cor_lamb_sp_teg_wall_down c_fac_cor_saf_teg_down c_fac_cor_saf_teg_wall_down c_fac_vs_teg_down c_fac_vs_teg_wall_down c_crlc_teg_wall_st_end_down c_maf_int_teg_st_down c_maf_int_teg_wall_st_down c_crlc_teg_st_down c_crlc_teg_wall_st_down c_egy_teg_end_sp_down_1 c_egy_teg_end_sp_down_2 c_egy_teg_wall_end_sp_down c_fac_lamb_teg_stat_max ip_fac_cor_vo_up ip_fac_cor_vo_wall_up ip_fac_cor_saf_wall ip_fac_scc_teg_wall ip_crlc_teg_tco_dif_up ip_crlc_teg_toil_dif_up c_crlc_teg_st_end_down c_crlc_teg_st_end_up ip_crlc_teg_wall_toil_dif_up ip_crlc_teg_wall_tco_dif_up lc_puc_teg_ena ip_fac_vs_teg_stat_max ip_add_teg_iga ip_teg_cor_vo_up ip_eff_iga_av_teg_cor ip_teg_cor_eff_iga_up ip_temp_sp_tco ip_fac_cor_eff_iga_up c_fac_ref_tco_up c_fac_ref_scc_tco_up c_fac_tco_ex_teg_up_1 c_fac_tco_ex_teg_up_2 ip_fac_teg_stop_down c_teg_st_on_up c_teg_st_on_down c_teg_egy_sp_end c_maf_int_teg_wall_st_up c_fac_cor_eff_iga_teg_down c_fac_ref_scc_tco_down c_fac_tco_ex_teg_down_1 c_fac_tco_ex_teg_down_2 ip_teg_wall_cor_eff_iga_up ip_fac_cor_eff_iga_wall_up c_fac_ref_tco_down ip_teg_wall_cor_vo_up ip_teg_wall_cor_vs_up c_fac_tco_ex_teg_wall_up_2 ip_fac_teg_wall_stop_up c_teg_wall_egy_sp_end c_fac_cor_eff_iga_teg_wall_down c_fac_ref_scc_tco_wall_up c_fac_ref_scc_tco_wall_down c_fac_ref_tco_wall_up c_fac_ref_tco_wall_down c_teg_dif_grad_min c_teg_dif_level_min c_fac_tco_ex_teg_wall_up_1 c_fac_tco_ex_teg_wall_down_1 c_fac_tco_ex_teg_wall_down_2 ip_teg_stat_up_2 ip_teg_wall_stat_up_2 ip_crlc_teg_dec_puc_up_2 ip_crlc_teg_wall_dec_puc_up_2 ip_crlc_teg_inc_up_2 ip_crlc_teg_wall_inc_up_2 ip_crlc_teg_dec_up_2 ip_crlc_teg_wall_dec_up_2 ip_teg_stat_down_2 ip_teg_wall_stat_down_2 ip_crlc_teg_dec_puc_down_2 ip_crlc_teg_wall_dec_puc_down_2 ip_crlc_teg_dec_down_2 ip_crlc_teg_wall_dec_down_2 ip_crlc_teg_inc_down_2 ip_crlc_teg_wall_inc_down_2 ip_fac_teg_stop_up ip_fac_teg_wall_stop_down ip_fac_temp_toil_dif_up ip_teg_cor_vs_up ip_vs_ecf_teg_up_2 ip_fac_tco_ex_vs ip_fac_cor_tco_ex_vs_up ip_fac_cor_tco_ex_vs_down ip_vs_ecf_teg_up_1 ip_vs_ecf_teg_down_2 ip_fac_temp_toil_dif_wall_up ip_fac_cor_ecf_vs_teg ip_fac_cor_ecf_vs_teg_wall ip_vs_ecf_teg_down_1 ip_vs_ecf_teg_wall_up_2 ip_fac_temp_toil_dif_down ip_fac_temp_toil_dif_wall_down ip_vs_ecf_teg_wall_up_1 ip_vs_ecf_teg_wall_down_1 ip_vs_ecf_teg_wall_down_2 c_crlc_dif_teg_level c_crlc_dif_teg_grad ip_fac_cor_vs_teg_up_1 ip_fac_cor_vs_teg_up_2 ip_fac_cor_vs_teg_down_1 ip_fac_cor_vs_teg_down_2 ip_fac_cor_vs_teg_wall_up_1 ip_fac_cor_vs_teg_wall_up_2 ip_fac_cor_vs_teg_wall_down_1 ip_fac_cor_vs_teg_wall_down_2 c_toil_teg_grad_min_up c_toil_teg_grad_min_down c_toil_teg_level_min_up c_toil_teg_level_min_down ip_fac_teg_cor_lamb_sp_up ip_fac_cor_saf ip_eff_iga_add_tco_teg c_crlc_teg_grad_min c_fac_level_grad ip_fac_cor_tco_teg_up ip_fac_cor_tco_teg_wall_up ip_fac_cor_tco_teg_down ip_fac_cor_tco_teg_wall_down /end DEF_CHARACTERISTIC
 /begin OUT_MEASUREMENT teg_1.gas_up_struct.teg_stat_eng_up teg_1.gas_up_struct.teg_cor_eff_iga_up teg_1.gas_up_struct.teg_stat_bas_up teg_1.gas_up_struct.eff_iga_av_teg_cor teg_1.gas_up_struct.fac_scc_teg teg_1.gas_up_struct.fac_cor_lamb_sp_teg_up teg_1.gas_up_struct.teg_stat_up teg_1.gas_up_struct.teg_cat_up_mdl_bas teg_1.gas_up_struct.teg_dif_up teg_1.gas_up_struct.teg_cat_up_mdl_stop teg_1.gas_up_struct.crlc_teg_grad_up teg_1.gas_up_struct.crlc_teg_level_up teg_1.gas_up_struct.crlc_teg_up teg_1.gas_up_struct.crlc_teg_toil_tco_up teg_1.gas_up_struct.crlc_teg_egy_up teg_1.gas_up_struct.egy_teg_end_sp_up teg_1.gas_up_struct.egy_teg_end_av_up teg_1.gas_up_struct.lv_teg_ast_up teg_1.gas_up_struct.crlc_teg_bas_up teg_1.gas_up_struct.teg_add_egr_up teg_1.gas_up_struct.teg_cor_veh_up teg_1.gas_up_struct.teg_cor_tco_ex_up teg_1.gas_up_struct.fac_cor_vs_teg_up teg_1.gas_up_struct.teg_scc_tco_up teg_1.gas_up_struct.vs_cor_ecf_teg_up teg_1.gas_up_struct.vs_cor_teg_up teg_1.gas_down_struct.teg_stat_eng_down teg_1.gas_down_struct.teg_stat_bas_down teg_1.gas_down_struct.fac_cor_lamb_sp_teg_down teg_1.gas_down_struct.teg_stat_down teg_1.gas_down_struct.teg_cat_down_mdl_bas teg_1.gas_down_struct.teg_dif_down teg_1.gas_down_struct.teg_cat_down_mdl_stop teg_1.gas_down_struct.crlc_teg_grad_down teg_1.gas_down_struct.crlc_teg_level_down teg_1.gas_down_struct.crlc_teg_down teg_1.gas_down_struct.crlc_teg_toil_tco_down teg_1.gas_down_struct.crlc_teg_egy_down teg_1.gas_down_struct.egy_teg_end_sp_down teg_1.gas_down_struct.egy_teg_end_av_down teg_1.gas_down_struct.lv_teg_ast_down teg_1.gas_down_struct.crlc_teg_bas_down teg_1.gas_down_struct.teg_cor_eff_iga_down teg_1.gas_down_struct.teg_scc_tco_down teg_1.gas_down_struct.teg_cor_veh_down teg_1.gas_down_struct.fac_cor_vs_teg_down teg_1.gas_down_struct.teg_cor_tco_ex_down teg_1.gas_down_struct.vs_cor_ecf_teg_down teg_1.gas_down_struct.vs_cor_teg_down teg_1.wall_up_struct.teg_wall_stat_bas_up teg_1.wall_up_struct.fac_scc_teg_wall teg_1.wall_up_struct.fac_cor_lamb_sp_teg_wall_up teg_1.wall_up_struct.teg_wall_stat_up teg_1.wall_up_struct.teg_wall_cat_up_mdl teg_1.wall_up_struct.teg_wall_dif_up teg_1.wall_up_struct.teg_wall_cat_up_mdl_stop teg_1.wall_up_struct.crlc_teg_wall_up teg_1.wall_up_struct.crlc_teg_wall_toil_tco_up teg_1.wall_up_struct.crlc_teg_wall_egy_up teg_1.wall_up_struct.egy_teg_wall_end_sp_up teg_1.wall_up_struct.egy_teg_wall_end_av_up teg_1.wall_up_struct.crlc_teg_wall_bas_up teg_1.wall_up_struct.teg_wall_stat_eng_up teg_1.wall_up_struct.teg_wall_cor_eff_iga_up teg_1.wall_up_struct.teg_wall_scc_tco_up teg_1.wall_up_struct.teg_wall_cor_veh_up teg_1.wall_up_struct.fac_cor_vs_teg_wall_up teg_1.wall_up_struct.teg_wall_cor_tco_ex_up teg_1.wall_up_struct.vs_cor_ecf_teg_wall_up teg_1.wall_up_struct.vs_cor_teg_wall_up teg_1.wall_down_struct.teg_wall_stat_eng_down teg_1.wall_down_struct.teg_wall_stat_bas_down teg_1.wall_down_struct.fac_cor_lamb_sp_teg_wall_down teg_1.wall_down_struct.teg_wall_stat_down teg_1.wall_down_struct.teg_wall_cat_down_mdl teg_1.wall_down_struct.teg_wall_dif_down teg_1.wall_down_struct.teg_wall_cat_down_mdl_stop teg_1.wall_down_struct.crlc_teg_wall_down teg_1.wall_down_struct.crlc_teg_wall_toil_tco_down teg_1.wall_down_struct.crlc_teg_wall_egy_down teg_1.wall_down_struct.egy_teg_wall_end_sp_down teg_1.wall_down_struct.egy_teg_wall_end_av_down teg_1.wall_down_struct.crlc_teg_wall_bas_down teg_1.wall_down_struct.teg_wall_cor_eff_iga_down teg_1.wall_down_struct.teg_wall_scc_tco_down teg_1.wall_down_struct.teg_wall_cor_veh_down teg_1.wall_down_struct.fac_cor_vs_teg_wall_down teg_1.wall_down_struct.teg_wall_cor_tco_ex_down teg_1.wall_down_struct.vs_cor_ecf_teg_wall_down teg_1.wall_down_struct.vs_cor_teg_wall_down teg_2.gas_up_struct.teg_stat_eng_up teg_2.gas_up_struct.teg_cor_eff_iga_up teg_2.gas_up_struct.teg_stat_bas_up teg_2.gas_up_struct.eff_iga_av_teg_cor teg_2.gas_up_struct.fac_scc_teg teg_2.gas_up_struct.fac_cor_lamb_sp_teg_up teg_2.gas_up_struct.teg_stat_up teg_2.gas_up_struct.teg_cat_up_mdl_bas teg_2.gas_up_struct.teg_dif_up teg_2.gas_up_struct.teg_cat_up_mdl_stop teg_2.gas_up_struct.crlc_teg_grad_up teg_2.gas_up_struct.crlc_teg_level_up teg_2.gas_up_struct.crlc_teg_up teg_2.gas_up_struct.crlc_teg_toil_tco_up teg_2.gas_up_struct.crlc_teg_egy_up teg_2.gas_up_struct.egy_teg_end_sp_up teg_2.gas_up_struct.egy_teg_end_av_up teg_2.gas_up_struct.lv_teg_ast_up teg_2.gas_up_struct.crlc_teg_bas_up teg_2.gas_up_struct.teg_add_egr_up teg_2.gas_up_struct.teg_cor_veh_up teg_2.gas_up_struct.teg_cor_tco_ex_up teg_2.gas_up_struct.fac_cor_vs_teg_up teg_2.gas_up_struct.teg_scc_tco_up teg_2.gas_up_struct.vs_cor_ecf_teg_up teg_2.gas_up_struct.vs_cor_teg_up teg_2.gas_down_struct.teg_stat_eng_down teg_2.gas_down_struct.teg_stat_bas_down teg_2.gas_down_struct.fac_cor_lamb_sp_teg_down teg_2.gas_down_struct.teg_stat_down teg_2.gas_down_struct.teg_cat_down_mdl_bas teg_2.gas_down_struct.teg_dif_down teg_2.gas_down_struct.teg_cat_down_mdl_stop teg_2.gas_down_struct.crlc_teg_grad_down teg_2.gas_down_struct.crlc_teg_level_down teg_2.gas_down_struct.crlc_teg_down teg_2.gas_down_struct.crlc_teg_toil_tco_down teg_2.gas_down_struct.crlc_teg_egy_down teg_2.gas_down_struct.egy_teg_end_sp_down teg_2.gas_down_struct.egy_teg_end_av_down teg_2.gas_down_struct.lv_teg_ast_down teg_2.gas_down_struct.crlc_teg_bas_down teg_2.gas_down_struct.teg_cor_eff_iga_down teg_2.gas_down_struct.teg_scc_tco_down teg_2.gas_down_struct.teg_cor_veh_down teg_2.gas_down_struct.fac_cor_vs_teg_down teg_2.gas_down_struct.teg_cor_tco_ex_down teg_2.gas_down_struct.vs_cor_ecf_teg_down teg_2.gas_down_struct.vs_cor_teg_down teg_2.wall_up_struct.teg_wall_stat_bas_up teg_2.wall_up_struct.fac_scc_teg_wall teg_2.wall_up_struct.fac_cor_lamb_sp_teg_wall_up teg_2.wall_up_struct.teg_wall_stat_up teg_2.wall_up_struct.teg_wall_cat_up_mdl teg_2.wall_up_struct.teg_wall_dif_up teg_2.wall_up_struct.teg_wall_cat_up_mdl_stop teg_2.wall_up_struct.crlc_teg_wall_up teg_2.wall_up_struct.crlc_teg_wall_toil_tco_up teg_2.wall_up_struct.crlc_teg_wall_egy_up teg_2.wall_up_struct.egy_teg_wall_end_sp_up teg_2.wall_up_struct.egy_teg_wall_end_av_up teg_2.wall_up_struct.crlc_teg_wall_bas_up teg_2.wall_up_struct.teg_wall_stat_eng_up teg_2.wall_up_struct.teg_wall_cor_eff_iga_up teg_2.wall_up_struct.teg_wall_scc_tco_up teg_2.wall_up_struct.teg_wall_cor_veh_up teg_2.wall_up_struct.fac_cor_vs_teg_wall_up teg_2.wall_up_struct.teg_wall_cor_tco_ex_up teg_2.wall_up_struct.vs_cor_ecf_teg_wall_up teg_2.wall_up_struct.vs_cor_teg_wall_up teg_2.wall_down_struct.teg_wall_stat_eng_down teg_2.wall_down_struct.teg_wall_stat_bas_down teg_2.wall_down_struct.fac_cor_lamb_sp_teg_wall_down teg_2.wall_down_struct.teg_wall_stat_down teg_2.wall_down_struct.teg_wall_cat_down_mdl teg_2.wall_down_struct.teg_wall_dif_down teg_2.wall_down_struct.teg_wall_cat_down_mdl_stop teg_2.wall_down_struct.crlc_teg_wall_down teg_2.wall_down_struct.crlc_teg_wall_toil_tco_down teg_2.wall_down_struct.crlc_teg_wall_egy_down teg_2.wall_down_struct.egy_teg_wall_end_sp_down teg_2.wall_down_struct.egy_teg_wall_end_av_down teg_2.wall_down_struct.crlc_teg_wall_bas_down teg_2.wall_down_struct.teg_wall_cor_eff_iga_down teg_2.wall_down_struct.teg_wall_scc_tco_down teg_2.wall_down_struct.teg_wall_cor_veh_down teg_2.wall_down_struct.fac_cor_vs_teg_wall_down teg_2.wall_down_struct.teg_wall_cor_tco_ex_down teg_2.wall_down_struct.vs_cor_ecf_teg_wall_down teg_2.wall_down_struct.vs_cor_teg_wall_down teg_cor_vo_up temp_toil_dif temp_tco_ex_dif crlc_teg_toil_dif_up crlc_teg_tco_dif_up crlc_teg_toil_dif_down crlc_teg_tco_dif_down crlc_teg_wall_toil_dif_up crlc_teg_wall_tco_dif_up teg_wall_cor_vo_down teg_stat_max pow_dif_max crlc_teg_wall_tco_dif_down crlc_teg_wall_toil_dif_down vo_dif_teg teg_cor_vo_down teg_wall_cor_tco_up teg_wall_cor_vo_up teg_wall_cor_tco_down temp_tco_dif teg_cor_tco_up teg_cor_tco_down teg_cor_vs_down teg_cor_vs_up teg_wall_cor_vs_down teg_wall_cor_vs_up fac_cor_toil_dif_teg_up fac_cor_toil_dif_teg_down fac_cor_toil_dif_teg_wall_up fac_cor_toil_dif_teg_wall_down fac_cor_tco_teg_up fac_cor_tco_teg_wall_up fac_cor_tco_teg_down fac_cor_tco_teg_wall_down /end OUT_MEASUREMENT
/end FUNCTION
/begin FUNCTION INJ_Detection_of_dew_point "_Detection of dew point"
 /begin DEF_CHARACTERISTIC c_delta_tia c_t_es_dew_min c_t_es_dew_max c_tco_st c_tco_es_dew c_t_es_dif_dew c_fac_egy_dew_stop ip_egy_dew_end_st_up ip_egy_dew_end_st_down c_teg_wall_red c_teg_wall_dew_st c_teg_wall_hys /end DEF_CHARACTERISTIC
 /begin OUT_MEASUREMENT teg_1.dew_point_struct.lv_teg_min_thd teg_1.dew_point_struct.lv_teg_cat_down_min_thd teg_1.dew_point_struct.lv_teg_cat_up_min_thd teg_2.dew_point_struct.lv_teg_min_thd teg_2.dew_point_struct.lv_teg_cat_down_min_thd teg_2.dew_point_struct.lv_teg_cat_up_min_thd tam_dew t_es_dew egy_dew_stop_up egy_dew_stop_down egy_dew_end_down egy_dew_end_up egy_dew_up egy_dew_down tam_ref_teg /end OUT_MEASUREMENT
/end FUNCTION
/begin FUNCTION INJ_Cylinder_individual_injectio "_Cylinder individual injection time at restart fuel feed" /end FUNCTION
/end MODULE
/end PROJECT
