ASAP2_VERSION 1 41
/begin PROJECT MSD85 "Spray Guided DI-System with Piezo Injectors for 8-Cylinder"
/begin HEADER "_default_HeaderComment" PROJECT_NO _91 /end HEADER
/begin MODULE _default_ModuleName "_default_ModuleLongIdentifier"
/begin MOD_COMMON "_default_ModCommonComment" DEPOSIT ABSOLUTE BYTE_ORDER MSB_LAST ALIGNMENT_BYTE 1 ALIGNMENT_WORD 2 ALIGNMENT_LONG 2 ALIGNMENT_FLOAT32_IEEE 2 ALIGNMENT_FLOAT64_IEEE 4 /end MOD_COMMON
/begin MEASUREMENT Acc_psabs_off "Accumulator für D_psabs_pu" SLONG _CNV_R_R_Def_dez_sl_551_CM 1 100. -2147483648. 2147483647. DISPLAY_IDENTIFIER ACC_PSABS_OFF ECU_ADDRESS 0xc000082c FORMAT "%7.0" /end MEASUREMENT
/begin MEASUREMENT Acc_pvdkds_off "Accumulator für D_pvdkds_pu/ps" SLONG _CNV_R_R_Def_dez_sl_551_CM 1 100. -2147483648. 2147483647. DISPLAY_IDENTIFIER ACC_PVDKDS_OFF ECU_ADDRESS 0xc0000828 FORMAT "%7.0" /end MEASUREMENT
/begin MEASUREMENT Agrreg_out "Reglerausgang AGR-Regler" SWORD _CNV_R_R_Def_f_sw_b_556_CM 1 100. -32. 31.999 DISPLAY_IDENTIFIER AGRREG_OUT ECU_ADDRESS 0xd000d5de FORMAT "%9.4" /end MEASUREMENT
/begin MEASUREMENT B_hfm_dkerr2pot_i "" UBYTE _CNV_S_2_Def_bool_564_CM 1 100. 0. 1. DISPLAY_IDENTIFIER B_HFM_DKERR2POT_I ECU_ADDRESS 0xd000d4c0 ARRAY_SIZE 2 MATRIX_DIM 2 1 1 /end MEASUREMENT
/begin MEASUREMENT B_hfmpuls "" UBYTE _CNV_S_2_Def_bool_564_CM 1 100. 0. 1. DISPLAY_IDENTIFIER B_HFMPULS ECU_ADDRESS 0xd000d4b4 /end MEASUREMENT
/begin MEASUREMENT B_hfmpuls1_i "" UBYTE _CNV_S_2_Def_bool_564_CM 1 100. 0. 1. DISPLAY_IDENTIFIER B_HFMPULS1_I ECU_ADDRESS 0xd000d4b8 ARRAY_SIZE 2 MATRIX_DIM 2 1 1 /end MEASUREMENT
/begin MEASUREMENT B_hfmpuls2_i "" UBYTE _CNV_S_2_Def_bool_564_CM 1 100. 0. 1. DISPLAY_IDENTIFIER B_HFMPULS2_I ECU_ADDRESS 0xd000d4ba ARRAY_SIZE 2 MATRIX_DIM 2 1 1 /end MEASUREMENT
/begin MEASUREMENT B_hfmpuls3_i "" UBYTE _CNV_S_2_Def_bool_564_CM 1 100. 0. 1. DISPLAY_IDENTIFIER B_HFMPULS3_I ECU_ADDRESS 0xd000d4bc ARRAY_SIZE 2 MATRIX_DIM 2 1 1 /end MEASUREMENT
/begin MEASUREMENT B_hfmpuls5_i "" UBYTE _CNV_S_2_Def_bool_564_CM 1 100. 0. 1. DISPLAY_IDENTIFIER B_HFMPULS5_I ECU_ADDRESS 0xd000d4be ARRAY_SIZE 2 MATRIX_DIM 2 1 1 /end MEASUREMENT
/begin MEASUREMENT B_hfmpuls_i "" UBYTE _CNV_S_2_Def_bool_564_CM 1 100. 0. 1. DISPLAY_IDENTIFIER B_HFMPULS_I ECU_ADDRESS 0xd000d4b6 ARRAY_SIZE 2 MATRIX_DIM 2 1 1 /end MEASUREMENT
/begin MEASUREMENT B_mareg_dkmn_i "Bedingung KNN Drosselklappe MIN" UBYTE _CNV_S_2_Def_bool_564_CM 1 100. 0. 1. DISPLAY_IDENTIFIER B_MAREG_DKMN_I ECU_ADDRESS 0xd000d4f0 ARRAY_SIZE 2 MATRIX_DIM 2 1 1 /end MEASUREMENT
/begin MEASUREMENT B_mareg_dkmx_i "Bedingung KNN Drosselklappe MAX" UBYTE _CNV_S_2_Def_bool_564_CM 1 100. 0. 1. DISPLAY_IDENTIFIER B_MAREG_DKMX_I ECU_ADDRESS 0xd000d4f2 ARRAY_SIZE 2 MATRIX_DIM 2 1 1 /end MEASUREMENT
/begin MEASUREMENT B_maregdk1_i "Bedingung Regler Drosselklappe freigegeben" UBYTE _CNV_S_2_Def_bool_564_CM 1 100. 0. 1. DISPLAY_IDENTIFIER B_MAREGDK1_I ECU_ADDRESS 0xd000d4c4 ARRAY_SIZE 2 MATRIX_DIM 2 1 1 /end MEASUREMENT
/begin MEASUREMENT B_maregdk2_i "Bedingung KNN Drosselklappe freigegeben" UBYTE _CNV_S_2_Def_bool_564_CM 1 100. 0. 1. DISPLAY_IDENTIFIER B_MAREGDK2_I ECU_ADDRESS 0xd000d4c6 ARRAY_SIZE 2 MATRIX_DIM 2 1 1 /end MEASUREMENT
/begin MEASUREMENT B_mraddk_akt_i "" UBYTE _CNV_S_2_Def_bool_564_CM 1 100. 0. 1. DISPLAY_IDENTIFIER B_MRADDK_AKT_I ECU_ADDRESS 0xd000d4ce ARRAY_SIZE 2 MATRIX_DIM 2 1 1 /end MEASUREMENT
/begin MEASUREMENT B_mradon_i "Bedingung KNN Adaption freigegeben" UBYTE _CNV_S_2_Def_bool_564_CM 1 100. 0. 1. DISPLAY_IDENTIFIER B_MRADON_I ECU_ADDRESS 0xd000d4c8 ARRAY_SIZE 2 MATRIX_DIM 2 1 1 /end MEASUREMENT
/begin MEASUREMENT B_mron "Bedingung MR freigegeben" UBYTE _CNV_S_2_Def_bool_564_CM 1 100. 0. 1. DISPLAY_IDENTIFIER B_MRON ECU_ADDRESS 0xd000d4cc /end MEASUREMENT
/begin MEASUREMENT B_mron_i "Bedingung MR freigegeben" UBYTE _CNV_S_2_Def_bool_564_CM 1 100. 0. 1. DISPLAY_IDENTIFIER B_MRON_I ECU_ADDRESS 0xd000d4ca ARRAY_SIZE 2 MATRIX_DIM 2 1 1 /end MEASUREMENT
/begin MEASUREMENT B_nplms_reset "Reset of adaption values for next restart" UBYTE _CNV_R_R_Def_dez_sl_551_CM 1 100. 0. 255. DISPLAY_IDENTIFIER B_NPLMS_RESET ECU_ADDRESS 0xc0004364 FORMAT "%3.0" /end MEASUREMENT
/begin MEASUREMENT B_psintmx_i "" UBYTE _CNV_S_2_Def_bool_564_CM 1 100. 0. 1. DISPLAY_IDENTIFIER B_PSINTMX_I ECU_ADDRESS 0xd000d640 ARRAY_SIZE 2 MATRIX_DIM 2 1 1 /end MEASUREMENT
/begin MEASUREMENT Ctr_drdiag "Zeit erlaubt für Drucksensorabgleich" UWORD _CNV_R_R_Def_td_ub__574_CM 1 100. 0. 6553.5 DISPLAY_IDENTIFIER CTR_DRDIAG ECU_ADDRESS 0xc0000826 FORMAT "%6.1" /end MEASUREMENT
/begin MEASUREMENT D_psabs_pu "Deltadrucksensor Ps_abs-Pu" SWORD _CNV_R_R_Def_p_sw_q_576_CM 1 100. -1280. 1279.9609 DISPLAY_IDENTIFIER D_PSABS_PU ECU_ADDRESS 0xc0000820 FORMAT "%7.2" /end MEASUREMENT
/begin MEASUREMENT D_pvdkds_ps "Deltadrucksensor Pvdkds-Ps" SWORD _CNV_R_R_Def_p_sw_q_576_CM 1 100. -1280. 1279.9609 DISPLAY_IDENTIFIER D_PVDKDS_PS ECU_ADDRESS 0xc000081e FORMAT "%7.2" /end MEASUREMENT
/begin MEASUREMENT D_pvdkds_pu "Deltadrucksensor Pvdkds-Pu" SWORD _CNV_R_R_Def_p_sw_q_576_CM 1 100. -1280. 1279.9609 DISPLAY_IDENTIFIER D_PVDKDS_PU ECU_ADDRESS 0xc000081c FORMAT "%7.2" /end MEASUREMENT
/begin MEASUREMENT Diag_mso "Obere Diagnose-Schwelle Massenstrom" UWORD _CNV_R_R_Def_f_uw_b_590_CM 1 100. 0. 1.9999 DISPLAY_IDENTIFIER DIAG_MSO ECU_ADDRESS 0xc0000850 FORMAT "%14.5" /end MEASUREMENT
/begin MEASUREMENT Diag_mso2 "Obere Diagnose-Schwelle Massenstrom (Bank2)" UWORD _CNV_R_R_Def_f_uw_b_590_CM 1 100. 0. 1.9999 DISPLAY_IDENTIFIER DIAG_MSO2 ECU_ADDRESS 0xc0000854 FORMAT "%14.5" /end MEASUREMENT
/begin MEASUREMENT Diag_mso2_f "Obere Diagnose-Schwelle Massenstrom (Bank2) gefiltert" UWORD _CNV_R_R_Def_f_uw_b_590_CM 1 100. 0. 1.9999 DISPLAY_IDENTIFIER DIAG_MSO2_F ECU_ADDRESS 0xc000085c FORMAT "%14.5" /end MEASUREMENT
/begin MEASUREMENT Diag_mso_f "Obere Diagnose-Schwelle Massenstrom (Bank1) gefiltert" UWORD _CNV_R_R_Def_f_uw_b_590_CM 1 100. 0. 1.9999 DISPLAY_IDENTIFIER DIAG_MSO_F ECU_ADDRESS 0xc0000858 FORMAT "%14.5" /end MEASUREMENT
/begin MEASUREMENT Diag_mso_off "Offset obere Diagnoseschwelle" SWORD _CNV_R_R_Def_f_uw_b_590_CM 1 100. -1. 0.9999 DISPLAY_IDENTIFIER DIAG_MSO_OFF ECU_ADDRESS 0xc0000860 FORMAT "%14.5" /end MEASUREMENT
/begin MEASUREMENT Diag_msu "Untere Diagnose-Schwelle Massenstrom" UWORD _CNV_R_R_Def_f_uw_b_590_CM 1 100. 0. 1.9999 DISPLAY_IDENTIFIER DIAG_MSU ECU_ADDRESS 0xc000084e FORMAT "%14.5" /end MEASUREMENT
/begin MEASUREMENT Diag_msu2 "Untere Diagnose-Schwelle Massenstrom (Bank2)" UWORD _CNV_R_R_Def_f_uw_b_590_CM 1 100. 0. 1.9999 DISPLAY_IDENTIFIER DIAG_MSU2 ECU_ADDRESS 0xc0000852 FORMAT "%14.5" /end MEASUREMENT
/begin MEASUREMENT Diag_msu2_f "Untere Diagnose-Schwelle Massenstrom (Bank2) gefiltert" UWORD _CNV_R_R_Def_f_uw_b_590_CM 1 100. 0. 1.9999 DISPLAY_IDENTIFIER DIAG_MSU2_F ECU_ADDRESS 0xc000085a FORMAT "%14.5" /end MEASUREMENT
/begin MEASUREMENT Diag_msu_f "Untere Diagnose-Schwelle Massenstrom (Bank1) gefiltert" UWORD _CNV_R_R_Def_f_uw_b_590_CM 1 100. 0. 1.9999 DISPLAY_IDENTIFIER DIAG_MSU_F ECU_ADDRESS 0xc0000856 FORMAT "%14.5" /end MEASUREMENT
/begin MEASUREMENT Diag_msu_off "Offset untere Diagnoseschwelle" SWORD _CNV_R_R_Def_f_uw_b_590_CM 1 100. -1. 0.9999 DISPLAY_IDENTIFIER DIAG_MSU_OFF ECU_ADDRESS 0xc000085e FORMAT "%14.5" /end MEASUREMENT
/begin MEASUREMENT Diag_pso "Obergrenze DPSR-Diagnose gefiltert" SWORD _CNV_R_R_Def_f_sw_b_591_CM 1 100. -4. 3.9998 DISPLAY_IDENTIFIER DIAG_PSO ECU_ADDRESS 0xc000084a FORMAT "%9.4" /end MEASUREMENT
/begin MEASUREMENT Diag_pso_f "Obergrenze DPSR-Diagnose gefiltert" SWORD _CNV_R_R_Def_f_sw_b_591_CM 1 100. -4. 3.9998 DISPLAY_IDENTIFIER DIAG_PSO_F ECU_ADDRESS 0xc0000846 FORMAT "%9.4" /end MEASUREMENT
/begin MEASUREMENT Diag_psu "Untergrenze DPSR-Diagnose gefiltert" SWORD _CNV_R_R_Def_f_sw_b_591_CM 1 100. -4. 3.9998 DISPLAY_IDENTIFIER DIAG_PSU ECU_ADDRESS 0xc000084c FORMAT "%9.4" /end MEASUREMENT
/begin MEASUREMENT Diag_psu_f "Untergrenze DPSR-Diagnose gefiltert" SWORD _CNV_R_R_Def_f_sw_b_591_CM 1 100. -4. 3.9998 DISPLAY_IDENTIFIER DIAG_PSU_F ECU_ADDRESS 0xc0000848 FORMAT "%9.4" /end MEASUREMENT
/begin MEASUREMENT Disa_bereich "Bereich DISA Umschaltung" UBYTE _CNV_R_R_Def_dez_sl_551_CM 1 100. 0. 255. DISPLAY_IDENTIFIER DISA_BEREICH ECU_ADDRESS 0xd000d38e FORMAT "%3.0" /end MEASUREMENT
/begin MEASUREMENT Dkaus_timer_i "VVT-DK Adaptionsumschaltungstimer" UBYTE _CNV_R_R_Def_dez_sl_551_CM 1 100. 0. 255. DISPLAY_IDENTIFIER DKAUS_TIMER_I ECU_ADDRESS 0xd000d4fa FORMAT "%3.0" ARRAY_SIZE 2 MATRIX_DIM 2 1 1 /end MEASUREMENT
/begin MEASUREMENT Dmszyl_spuel_i "Mszyl Anteil ueberspuel" UWORD _CNV_R_R_Def_ms_uw__594_CM 1 100. 0. 2047.9687 DISPLAY_IDENTIFIER DMSZYL_SPUEL_I ECU_ADDRESS 0xd000d33a FORMAT "%8.3" ARRAY_SIZE 2 MATRIX_DIM 2 1 1 /end MEASUREMENT
/begin MEASUREMENT Dmszyl_uk_i "Mszyl Anteil unkritisches" UWORD _CNV_R_R_Def_ms_uw__594_CM 1 100. 0. 2047.9687 DISPLAY_IDENTIFIER DMSZYL_UK_I ECU_ADDRESS 0xd000d336 FORMAT "%8.3" ARRAY_SIZE 2 MATRIX_DIM 2 1 1 /end MEASUREMENT
/begin MEASUREMENT Dnkw_eisyd "Differenzdrehzahl für Eisy Diagnose Dynamikerkennung" SWORD _CNV_R_R_Def_n_sw_q_595_CM 1 100. -32768. 32767. DISPLAY_IDENTIFIER DNKW_EISYD ECU_ADDRESS 0xc0000814 FORMAT "%5.0" /end MEASUREMENT
/begin MEASUREMENT Dpirgn_i "1013 mbar - Pirg" UWORD _CNV_R_R_Def_p_sw_q_576_CM 1 100. 0. 2559.9609 DISPLAY_IDENTIFIER DPIRGN_I ECU_ADDRESS 0xd000d36c FORMAT "%7.2" ARRAY_SIZE 2 MATRIX_DIM 2 1 1 /end MEASUREMENT
/begin MEASUREMENT Dps_abs "" SWORD _CNV_R_R_Def_p_sw_q_576_CM 1 100. -1280. 1279.9609 DISPLAY_IDENTIFIER DPS_ABS ECU_ADDRESS 0xc0000822 FORMAT "%7.2" /end MEASUREMENT
/begin MEASUREMENT Dps_i "Druckdifferenz zwischen Saugrohr und Umgebung" SWORD _CNV_R_R_Def_p_sw_q_576_CM 1 100. -1280. 1279.9609 DISPLAY_IDENTIFIER DPS_I ECU_ADDRESS 0xd000d64a FORMAT "%7.2" ARRAY_SIZE 2 MATRIX_DIM 2 1 1 /end MEASUREMENT
/begin MEASUREMENT Dpsr_pk "Druckdifferenz, Pulsationskorrektiertwert" SWORD _CNV_R_R_Def_p_sw_q_576_CM 1 100. -1280. 1279.9609 DISPLAY_IDENTIFIER DPSR_PK ECU_ADDRESS 0xd000d5e6 FORMAT "%7.2" /end MEASUREMENT
/begin MEASUREMENT Dpsrseg_puls "Puls-Amplitude auf Differenzdruck Saugrohr" SWORD _CNV_R_R_Def_p_sw_q_576_CM 1 100. -1280. 1279.9609 DISPLAY_IDENTIFIER DPSRSEG_PULS ECU_ADDRESS 0xd000d68c FORMAT "%7.2" /end MEASUREMENT
/begin MEASUREMENT Dpvdkds "" SWORD _CNV_R_R_Def_p_sw_q_576_CM 1 100. -1280. 1279.9609 DISPLAY_IDENTIFIER DPVDKDS ECU_ADDRESS 0xc0000824 FORMAT "%7.2" /end MEASUREMENT
/begin MEASUREMENT Drdiag_state "Status Drucksensordiagnose für Turbo" UBYTE _CNV_R_R_Def_dez_sl_551_CM 1 100. 0. 255. DISPLAY_IDENTIFIER DRDIAG_STATE ECU_ADDRESS 0xc0000867 FORMAT "%3.0" /end MEASUREMENT
/begin MEASUREMENT Drf_eisyd "Differenzlast für Eisy Diagnose Dynamikerkennung" SWORD _CNV_R_R_Def_rf_sw__598_CM 1 100. -327.68 327.67 DISPLAY_IDENTIFIER DRF_EISYD ECU_ADDRESS 0xc0000818 FORMAT "%9.4" /end MEASUREMENT
/begin MEASUREMENT Drf_spuel "Rf Anteil ueberspuel" SWORD _CNV_R_R_Def_rf_sw__598_CM 1 100. -327.68 327.67 DISPLAY_IDENTIFIER DRF_SPUEL ECU_ADDRESS 0xd000d346 FORMAT "%9.4" /end MEASUREMENT
/begin MEASUREMENT Drf_spuel_i "Rf Anteil ueberspuel" SWORD _CNV_R_R_Def_rf_sw__598_CM 1 100. -327.68 327.67 DISPLAY_IDENTIFIER DRF_SPUEL_I ECU_ADDRESS 0xd000d342 FORMAT "%9.4" ARRAY_SIZE 2 MATRIX_DIM 2 1 1 /end MEASUREMENT
/begin MEASUREMENT Drf_spuel_tmp_i "" SWORD _CNV_R_R_Def_rf_sw__598_CM 1 100. -327.68 327.67 DISPLAY_IDENTIFIER DRF_SPUEL_TMP_I ECU_ADDRESS 0xd000d3de FORMAT "%9.4" ARRAY_SIZE 2 MATRIX_DIM 2 1 1 /end MEASUREMENT
/begin MEASUREMENT Drf_uk_i "Rf Anteil unkritisches" SWORD _CNV_R_R_Def_rf_sw__598_CM 1 100. -327.68 327.67 DISPLAY_IDENTIFIER DRF_UK_I ECU_ADDRESS 0xd000d33e FORMAT "%9.4" ARRAY_SIZE 2 MATRIX_DIM 2 1 1 /end MEASUREMENT
/begin MEASUREMENT Drf_uk_tmp_i "" SWORD _CNV_R_R_Def_rf_sw__598_CM 1 100. -327.68 327.67 DISPLAY_IDENTIFIER DRF_UK_TMP_I ECU_ADDRESS 0xd000d3e2 FORMAT "%9.4" ARRAY_SIZE 2 MATRIX_DIM 2 1 1 /end MEASUREMENT
/begin MEASUREMENT Drf_zylvol_i "" SWORD _CNV_R_R_Def_rf_sw__598_CM 1 100. -327.68 327.67 DISPLAY_IDENTIFIER DRF_ZYLVOL_I ECU_ADDRESS 0xd000d386 FORMAT "%9.4" ARRAY_SIZE 2 MATRIX_DIM 2 1 1 /end MEASUREMENT
/begin MEASUREMENT Drfnorm_spuel_i "Rf Anteil ueberspuel, norm" SWORD _CNV_R_R_Def_rf_sw__598_CM 1 100. -327.68 327.67 DISPLAY_IDENTIFIER DRFNORM_SPUEL_I ECU_ADDRESS 0xd000d37a FORMAT "%9.4" ARRAY_SIZE 2 MATRIX_DIM 2 1 1 /end MEASUREMENT
/begin MEASUREMENT Drfnorm_uk_i "Rf Anteil unkritisches, norm" SWORD _CNV_R_R_Def_rf_sw__598_CM 1 100. -327.68 327.67 DISPLAY_IDENTIFIER DRFNORM_UK_I ECU_ADDRESS 0xd000d3da FORMAT "%9.4" ARRAY_SIZE 2 MATRIX_DIM 2 1 1 /end MEASUREMENT
/begin MEASUREMENT F_agrad "Überblendfaktor" UBYTE _CNV_R_R_Def_f_ub_b_613_CM 1 100. 0. 1.9921 DISPLAY_IDENTIFIER F_AGRAD ECU_ADDRESS 0xd000d5d9 /end MEASUREMENT
/begin MEASUREMENT F_dms2dps_i "Faktor Deltamassenstroem -> Deltasaugrohrdruck" UWORD _CNV_R_R_Def_f_uw_b_618_CM 1 100. 0. 9.999800000000001 DISPLAY_IDENTIFIER F_DMS2DPS_I ECU_ADDRESS 0xd000d64e FORMAT "%9.4" ARRAY_SIZE 2 MATRIX_DIM 2 1 1 /end MEASUREMENT
/begin MEASUREMENT F_dms2dps_max_i "Faktor Deltamassenstroem -> Deltasaugrohrdruck (max)" UWORD _CNV_R_R_Def_f_uw_b_618_CM 1 100. 0. 9.999800000000001 DISPLAY_IDENTIFIER F_DMS2DPS_MAX_I ECU_ADDRESS 0xd000d682 FORMAT "%9.4" ARRAY_SIZE 2 MATRIX_DIM 2 1 1 /end MEASUREMENT
/begin MEASUREMENT F_dms2dps_ur_i "Faktor Deltamassenstroem -> Deltasaugrohrdruck (umr)" UWORD _CNV_R_R_Def_f_uw_b_618_CM 1 100. 0. 9.999800000000001 DISPLAY_IDENTIFIER F_DMS2DPS_UR_I ECU_ADDRESS 0xd000d67e FORMAT "%9.4" ARRAY_SIZE 2 MATRIX_DIM 2 1 1 /end MEASUREMENT
/begin MEASUREMENT F_mr_ramp "Ramp faktor" UWORD _CNV_R_R_Def_f_uw_b_571_CM 1 100. 0. 0.9999 DISPLAY_IDENTIFIER F_MR_RAMP ECU_ADDRESS 0xd000d542 FORMAT "%14.5" /end MEASUREMENT
/begin MEASUREMENT F_mshfm_kor_i "Korrektur Faktor HFM" UWORD _CNV_R_R_Def_f_uw_b_590_CM 1 100. 0. 1.9999 DISPLAY_IDENTIFIER F_MSHFM_KOR_I ECU_ADDRESS 0xd000d558 FORMAT "%14.5" ARRAY_SIZE 2 MATRIX_DIM 2 1 1 /end MEASUREMENT
/begin MEASUREMENT F_mskor_npsp_i "Korrektur Faktor HFM Psp Abhaengigkeit" UWORD _CNV_R_R_Def_f_uw_b_590_CM 1 100. 0. 1.9999 DISPLAY_IDENTIFIER F_MSKOR_NPSP_I ECU_ADDRESS 0xd000d554 FORMAT "%14.5" ARRAY_SIZE 2 MATRIX_DIM 2 1 1 /end MEASUREMENT
/begin MEASUREMENT F_mskor_nrf_i "Korrektur Faktor HFM Rf Abhaengigkeit" UWORD _CNV_R_R_Def_f_uw_b_590_CM 1 100. 0. 1.9999 DISPLAY_IDENTIFIER F_MSKOR_NRF_I ECU_ADDRESS 0xd000d550 FORMAT "%14.5" ARRAY_SIZE 2 MATRIX_DIM 2 1 1 /end MEASUREMENT
/begin MEASUREMENT F_pspu_i "Faktor Ps/Pu" UWORD _CNV_R_R_Def_f_uw_b_590_CM 1 100. 0. 1.9999 DISPLAY_IDENTIFIER F_PSPU_I ECU_ADDRESS 0xd000d3a2 FORMAT "%14.5" ARRAY_SIZE 2 MATRIX_DIM 2 1 1 /end MEASUREMENT
/begin MEASUREMENT F_psr_kor_i "Korrekturfaktor PSR" UWORD _CNV_R_R_Def_f_uw_b_559_CM 1 100. 0. 15.9997 DISPLAY_IDENTIFIER F_PSR_KOR_I ECU_ADDRESS 0xd000d608 FORMAT "%9.4" ARRAY_SIZE 2 MATRIX_DIM 2 1 1 /end MEASUREMENT
/begin MEASUREMENT F_pssolverh "Soll-druck Verhältnis" UWORD _CNV_R_R_Def_f_uw_b_618_CM 1 100. 0. 9.999800000000001 DISPLAY_IDENTIFIER F_PSSOLVERH ECU_ADDRESS 0xd000d50c FORMAT "%9.4" /end MEASUREMENT
/begin MEASUREMENT F_quotdiagh "Quotient von Mshfm_ist und Mszyl_diag" UWORD _CNV_R_R_Def_f_uw_b_590_CM 1 100. 0. 1.9999 DISPLAY_IDENTIFIER F_QUOTDIAGH ECU_ADDRESS 0xc0000834 FORMAT "%14.5" /end MEASUREMENT
/begin MEASUREMENT F_quotdiaghf "Quotient von Mshfm_ist und Mszyl_diag (gefiltert)" UWORD _CNV_R_R_Def_f_uw_b_590_CM 1 100. 0. 1.9999 DISPLAY_IDENTIFIER F_QUOTDIAGHF ECU_ADDRESS 0xc0000836 FORMAT "%14.5" /end MEASUREMENT
/begin MEASUREMENT F_quotdiagl "Quotient von Mslam und Mszyl_diagf" UWORD _CNV_R_R_Def_f_uw_b_590_CM 1 100. 0. 1.9999 DISPLAY_IDENTIFIER F_QUOTDIAGL ECU_ADDRESS 0xc0000838 FORMAT "%14.5" /end MEASUREMENT
/begin MEASUREMENT F_quotdiagl2 "Quotient von Mslam2 und Mszyl_diagf" UWORD _CNV_R_R_Def_f_uw_b_590_CM 1 100. 0. 1.9999 DISPLAY_IDENTIFIER F_QUOTDIAGL2 ECU_ADDRESS 0xc000083c FORMAT "%14.5" /end MEASUREMENT
/begin MEASUREMENT F_quotdiaglf "Quotient von Mslam und Mszyl_diagf (gefiltert)" UWORD _CNV_R_R_Def_f_uw_b_590_CM 1 100. 0. 1.9999 DISPLAY_IDENTIFIER F_QUOTDIAGLF ECU_ADDRESS 0xc000083a FORMAT "%14.5" /end MEASUREMENT
/begin MEASUREMENT F_quotdiaglf2 "Quotient von Mslam2 und Mszyl_diagf (gefiltert)" UWORD _CNV_R_R_Def_f_uw_b_590_CM 1 100. 0. 1.9999 DISPLAY_IDENTIFIER F_QUOTDIAGLF2 ECU_ADDRESS 0xc000083e FORMAT "%14.5" /end MEASUREMENT
/begin MEASUREMENT F_stend_trans "Faktor Start" UWORD _CNV_R_R_Def_f_uw_b_571_CM 1 100. 0. 0.9999 DISPLAY_IDENTIFIER F_STEND_TRANS ECU_ADDRESS 0xd000d394 FORMAT "%14.5" /end MEASUREMENT
/begin MEASUREMENT F_tans0_i "Faktor normalisierte Ansaugtemperatur" UWORD _CNV_R_R_Def_f_uw_b_590_CM 1 100. 0. 1.9999 DISPLAY_IDENTIFIER F_TANS0_I ECU_ADDRESS 0xd000d67a FORMAT "%14.5" ARRAY_SIZE 2 MATRIX_DIM 2 1 1 /end MEASUREMENT
/begin MEASUREMENT F_tzkorbls_i "Faktor Temperaturkorrektur im Brennraum/Vor Drosselklappe" UWORD _CNV_R_R_Def_f_uw_b_590_CM 1 100. 0. 1.9999 DISPLAY_IDENTIFIER F_TZKORBLS_I ECU_ADDRESS 0xd000d368 FORMAT "%14.5" ARRAY_SIZE 2 MATRIX_DIM 2 1 1 /end MEASUREMENT
/begin MEASUREMENT F_tzylkor "Faktor Temperaturkorrektur im Brennraum/Vor Drosselklappe" UWORD _CNV_R_R_Def_f_uw_b_590_CM 1 100. 0. 1.9999 DISPLAY_IDENTIFIER F_TZYLKOR ECU_ADDRESS 0xd000d366 FORMAT "%14.5" /end MEASUREMENT
/begin MEASUREMENT F_tzylkor_i "Faktor Temperaturkorrektur im Brennraum/Vor Drosselklappe" UWORD _CNV_R_R_Def_f_uw_b_590_CM 1 100. 0. 1.9999 DISPLAY_IDENTIFIER F_TZYLKOR_I ECU_ADDRESS 0xd000d362 FORMAT "%14.5" ARRAY_SIZE 2 MATRIX_DIM 2 1 1 /end MEASUREMENT
/begin MEASUREMENT F_umsrfn "Faktor Massenstrom in relative Luftfuellung" UWORD _CNV_R_R_Def_umr_uw_625_CM 1 100. 0. 3999.9389 DISPLAY_IDENTIFIER F_UMSRFN ECU_ADDRESS 0xd000d334 FORMAT "%7.2" /end MEASUREMENT
/begin MEASUREMENT Fupsms_bas_i "Faktor systembezogene Umrechung Druck auf Luftmasse, bas" UWORD _CNV_R_R_Def_f_uw_b_590_CM 1 100. 0. 1.9999 DISPLAY_IDENTIFIER FUPSMS_BAS_I ECU_ADDRESS 0xd000d39e FORMAT "%14.5" ARRAY_SIZE 2 MATRIX_DIM 2 1 1 /end MEASUREMENT
/begin MEASUREMENT Fupsms_i "Faktor systembezogene Umrechung Druck auf Luftmasse" UWORD _CNV_R_R_Def_f_uw_b_590_CM 1 100. 0. 1.9999 DISPLAY_IDENTIFIER FUPSMS_I ECU_ADDRESS 0xd000d34e FORMAT "%14.5" ARRAY_SIZE 2 MATRIX_DIM 2 1 1 /end MEASUREMENT
/begin MEASUREMENT Fupsrf "Faktor systembezogene Umrechung Druck auf Füllung" UWORD _CNV_R_R_Def_f_uw_b_629_CM 1 100. 0. 0.2999 DISPLAY_IDENTIFIER FUPSRF ECU_ADDRESS 0xd000d34c FORMAT "%14.6" /end MEASUREMENT
/begin MEASUREMENT Fupsrf_i "Faktor systembezogene Umrechung Druck auf Füllung" UWORD _CNV_R_R_Def_f_uw_b_629_CM 1 100. 0. 0.2999 DISPLAY_IDENTIFIER FUPSRF_I ECU_ADDRESS 0xd000d348 FORMAT "%14.6" ARRAY_SIZE 2 MATRIX_DIM 2 1 1 /end MEASUREMENT
/begin MEASUREMENT Hubev_ist_m "Ist-Hub Mittelwert Bank1/2" UWORD _CNV_R_R_Def_hub_uw_589_CM 1 100. 0. 65.535 DISPLAY_IDENTIFIER HUBEV_IST_M ECU_ADDRESS 0xd000d390 FORMAT "%8.3" /end MEASUREMENT
/begin MEASUREMENT Hubev_mareg "Istwert Einlassventilhub plus Korrektur von Regler" UWORD _CNV_R_R_Def_hub_uw_589_CM 1 100. 0. 65.535 DISPLAY_IDENTIFIER HUBEV_MAREG ECU_ADDRESS 0xd000d32a FORMAT "%8.3" /end MEASUREMENT
/begin MEASUREMENT Kl_vsaug_aus "Faktor Deltamassenstroem -> Deltasaugrohrdruck (max)" UWORD _CNV_R_R_Def_f_uw_b_618_CM 1 100. 0. 9.999800000000001 DISPLAY_IDENTIFIER KL_VSAUG_AUS ECU_ADDRESS 0xd000d686 FORMAT "%9.4" /end MEASUREMENT
/begin MEASUREMENT Klaf_outdk "Ausgang Ausflusskennlinie" UWORD _CNV_R_R_Def_f_uw_b_571_CM 1 100. 0. 0.9999 DISPLAY_IDENTIFIER KLAF_OUTDK ECU_ADDRESS 0xd000d31c FORMAT "%14.5" /end MEASUREMENT
/begin MEASUREMENT Klaf_outdk_i "Ausgang Ausflusskennlinie" UWORD _CNV_R_R_Def_f_uw_b_571_CM 1 100. 0. 0.9999 DISPLAY_IDENTIFIER KLAF_OUTDK_I ECU_ADDRESS 0xd000d318 FORMAT "%14.5" ARRAY_SIZE 2 MATRIX_DIM 2 1 1 /end MEASUREMENT
/begin MEASUREMENT Klaf_outwdkdiag "" UWORD _CNV_R_R_Def_f_uw_b_571_CM 1 100. 0. 0.9999 DISPLAY_IDENTIFIER KLAF_OUTWDKDIAG ECU_ADDRESS 0xc0000864 FORMAT "%14.5" /end MEASUREMENT
/begin MEASUREMENT Klafout_spuel_i "" UWORD _CNV_R_R_Def_f_uw_b_571_CM 1 100. 0. 0.9999 DISPLAY_IDENTIFIER KLAFOUT_SPUEL_I ECU_ADDRESS 0xd000d3e6 FORMAT "%14.5" ARRAY_SIZE 2 MATRIX_DIM 2 1 1 /end MEASUREMENT
/begin MEASUREMENT Klafout_uk_i "" UWORD _CNV_R_R_Def_f_uw_b_571_CM 1 100. 0. 0.9999 DISPLAY_IDENTIFIER KLAFOUT_UK_I ECU_ADDRESS 0xd000d38a FORMAT "%14.5" ARRAY_SIZE 2 MATRIX_DIM 2 1 1 /end MEASUREMENT
/begin MEASUREMENT La_ist1 "Lambda-Istwert" UWORD _CNV_R_R_Def_f_uw_b_559_CM 1 100. 0. 15.9997 DISPLAY_IDENTIFIER LA_IST1 ECU_ADDRESS 0xd000dc64 FORMAT "%9.4" /end MEASUREMENT
/begin MEASUREMENT La_ist2 "Lambda-Istwert Bank2" UWORD _CNV_R_R_Def_f_uw_b_559_CM 1 100. 0. 15.9997 DISPLAY_IDENTIFIER LA_IST2 ECU_ADDRESS 0xd000dc68 FORMAT "%9.4" /end MEASUREMENT
/begin MEASUREMENT La_ist_m "Mittelwert der Lambda-Istwerte" UWORD _CNV_R_R_Def_f_uw_b_559_CM 1 100. 0. 15.9997 DISPLAY_IDENTIFIER LA_IST_M ECU_ADDRESS 0xd000dc6a FORMAT "%9.4" /end MEASUREMENT
/begin MEASUREMENT Lolimot_dkaus_i "" FLOAT32_IEEE _CNV_R_R_Def_dez_sl_551_CM 1 100. -1000000000000. 10000000000000. DISPLAY_IDENTIFIER LOLIMOT_DKAUS_I ECU_ADDRESS 0xc0000778 FORMAT "%14.7" ARRAY_SIZE 2 MATRIX_DIM 2 1 1 /end MEASUREMENT
/begin MEASUREMENT Lolimot_dkein_i "" FLOAT32_IEEE _CNV_R_R_Def_dez_sl_551_CM 1 100. -1000000000000. 10000000000000. DISPLAY_IDENTIFIER LOLIMOT_DKEIN_I ECU_ADDRESS 0xc0000770 FORMAT "%14.7" ARRAY_SIZE 2 MATRIX_DIM 2 1 1 /end MEASUREMENT
/begin MEASUREMENT Lolimot_dklern_i "" FLOAT32_IEEE _CNV_R_R_Def_dez_sl_551_CM 1 100. -1000000000000. 10000000000000. DISPLAY_IDENTIFIER LOLIMOT_DKLERN_I ECU_ADDRESS 0xc0000768 FORMAT "%14.7" ARRAY_SIZE 2 MATRIX_DIM 2 1 1 /end MEASUREMENT
/begin MEASUREMENT Lst_turb "Turbinenleistung" UWORD _CNV_R_R_Def_lst_uw_648_CM 1 100. 0. 131070. DISPLAY_IDENTIFIER LST_TURB ECU_ADDRESS 0xd000d6f2 FORMAT "%5.0" /end MEASUREMENT
/begin MEASUREMENT Lst_verd "Verdichterleistung" UWORD _CNV_R_R_Def_lst_uw_648_CM 1 100. 0. 131070. DISPLAY_IDENTIFIER LST_VERD ECU_ADDRESS 0xd000d6f4 FORMAT "%5.0" /end MEASUREMENT
/begin MEASUREMENT Lst_verd_f "Verdichterleistung gefiltert" UWORD _CNV_R_R_Def_lst_uw_648_CM 1 100. 0. 131070. DISPLAY_IDENTIFIER LST_VERD_F ECU_ADDRESS 0xd000d6f6 FORMAT "%5.0" /end MEASUREMENT
/begin MEASUREMENT Mareg_dk_i "Massenstromregler, Ausgang Offset, DK-Teil" SWORD _CNV_R_R_Def_f_uw_b_590_CM 1 100. -1. 0.9999 DISPLAY_IDENTIFIER MAREG_DK_I ECU_ADDRESS 0xd000d4d8 FORMAT "%14.5" ARRAY_SIZE 2 MATRIX_DIM 2 1 1 /end MEASUREMENT
/begin MEASUREMENT Mareg_dkaus_i "Ausgang KNN Drosselklappe" SWORD _CNV_R_R_Def_f_uw_b_590_CM 1 100. -1. 0.9999 DISPLAY_IDENTIFIER MAREG_DKAUS_I ECU_ADDRESS 0xd000d53a FORMAT "%14.5" ARRAY_SIZE 2 MATRIX_DIM 2 1 1 /end MEASUREMENT
/begin MEASUREMENT Mareg_dkdiff_i "Regeldifferenz Regler Drosselklappe" SWORD _CNV_R_R_Def_f_uw_b_590_CM 1 100. -1. 0.9999 DISPLAY_IDENTIFIER MAREG_DKDIFF_I ECU_ADDRESS 0xd000d51c FORMAT "%14.5" ARRAY_SIZE 2 MATRIX_DIM 2 1 1 /end MEASUREMENT
/begin MEASUREMENT Mareg_dki_i "Ausgangswert Regler Drosselklappe Integralanteil" SWORD _CNV_R_R_Def_f_uw_b_590_CM 1 100. -1. 0.9999 DISPLAY_IDENTIFIER MAREG_DKI_I ECU_ADDRESS 0xd000d524 FORMAT "%14.5" ARRAY_SIZE 2 MATRIX_DIM 2 1 1 /end MEASUREMENT
/begin MEASUREMENT Mareg_dknn_i "Ausgang KNN Drosselklappe" SWORD _CNV_R_R_Def_f_uw_b_590_CM 1 100. -1. 0.9999 DISPLAY_IDENTIFIER MAREG_DKNN_I ECU_ADDRESS 0xd000d536 FORMAT "%14.5" ARRAY_SIZE 2 MATRIX_DIM 2 1 1 /end MEASUREMENT
/begin MEASUREMENT Mareg_dknn_out_i "Ausgang KNN Drosselklappe, rampe" SWORD _CNV_R_R_Def_f_uw_b_590_CM 1 100. -1. 0.9999 DISPLAY_IDENTIFIER MAREG_DKNN_OUT_I ECU_ADDRESS 0xd000d53e FORMAT "%14.5" ARRAY_SIZE 2 MATRIX_DIM 2 1 1 /end MEASUREMENT
/begin MEASUREMENT Mareg_dkp_i "Ausgangswert Regler Drosselklappe Proportionalanteil" SWORD _CNV_R_R_Def_f_uw_b_590_CM 1 100. -1. 0.9999 DISPLAY_IDENTIFIER MAREG_DKP_I ECU_ADDRESS 0xd000d520 FORMAT "%14.5" ARRAY_SIZE 2 MATRIX_DIM 2 1 1 /end MEASUREMENT
/begin MEASUREMENT Mareg_dkst_i "Statuswert Regler Drosselklappe" UBYTE _CNV_R_R_Def_dez_sl_551_CM 1 100. 0. 255. DISPLAY_IDENTIFIER MAREG_DKST_I ECU_ADDRESS 0xd000d4f6 FORMAT "%3.0" ARRAY_SIZE 2 MATRIX_DIM 2 1 1 /end MEASUREMENT
/begin MEASUREMENT Mareg_er_dk_i "Fehler KNN DK-Adaption" SWORD _CNV_R_R_Def_f_uw_b_590_CM 1 100. -1. 0.9999 DISPLAY_IDENTIFIER MAREG_ER_DK_I ECU_ADDRESS 0xc0000762 FORMAT "%14.5" ARRAY_SIZE 2 MATRIX_DIM 2 1 1 /end MEASUREMENT
/begin MEASUREMENT Mareg_er_vvt "Fehler KNN Hubadaption" SWORD _CNV_R_R_Def_f_uw_b_590_CM 1 100. -1. 0.9999 DISPLAY_IDENTIFIER MAREG_ER_VVT ECU_ADDRESS 0xd000d530 FORMAT "%14.5" /end MEASUREMENT
/begin MEASUREMENT Mareg_pidk_i "Ausgang Drosselklappenregler" SWORD _CNV_R_R_Def_f_uw_b_590_CM 1 100. -1. 0.9999 DISPLAY_IDENTIFIER MAREG_PIDK_I ECU_ADDRESS 0xd000d532 FORMAT "%14.5" ARRAY_SIZE 2 MATRIX_DIM 2 1 1 /end MEASUREMENT
/begin MEASUREMENT Mareg_pivvt "Ausgang Hubregler" SWORD _CNV_R_R_Def_f_uw_b_590_CM 1 100. -1. 0.9999 DISPLAY_IDENTIFIER MAREG_PIVVT ECU_ADDRESS 0xd000d528 FORMAT "%14.5" /end MEASUREMENT
/begin MEASUREMENT Mareg_vvt "" SWORD _CNV_R_R_Def_f_uw_b_590_CM 1 100. -1. 0.9999 DISPLAY_IDENTIFIER MAREG_VVT ECU_ADDRESS 0xd000d4d6 FORMAT "%14.5" /end MEASUREMENT
/begin MEASUREMENT Mareg_vvtaus "Ausgang KNN Hubadaption" SWORD _CNV_R_R_Def_f_uw_b_590_CM 1 100. -1. 0.9999 DISPLAY_IDENTIFIER MAREG_VVTAUS ECU_ADDRESS 0xd000d52c FORMAT "%14.5" /end MEASUREMENT
/begin MEASUREMENT Mareg_vvtdiff "Regeldifferenz Regler Hub" SWORD _CNV_R_R_Def_f_uw_b_590_CM 1 100. -1. 0.9999 DISPLAY_IDENTIFIER MAREG_VVTDIFF ECU_ADDRESS 0xd000d516 FORMAT "%14.5" /end MEASUREMENT
/begin MEASUREMENT Mareg_vvti "Ausgangswert Regler Hub Integralanteil" SWORD _CNV_R_R_Def_f_uw_b_590_CM 1 100. -1. 0.9999 DISPLAY_IDENTIFIER MAREG_VVTI ECU_ADDRESS 0xd000d51a FORMAT "%14.5" /end MEASUREMENT
/begin MEASUREMENT Mareg_vvtnn "Ausgang KNN Hubadaption" SWORD _CNV_R_R_Def_f_uw_b_590_CM 1 100. -1. 0.9999 DISPLAY_IDENTIFIER MAREG_VVTNN ECU_ADDRESS 0xd000d52a FORMAT "%14.5" /end MEASUREMENT
/begin MEASUREMENT Mareg_vvtnn_out "Ausgang KNN Hubadaption, rampe" SWORD _CNV_R_R_Def_f_uw_b_590_CM 1 100. -1. 0.9999 DISPLAY_IDENTIFIER MAREG_VVTNN_OUT ECU_ADDRESS 0xd000d52e FORMAT "%14.5" /end MEASUREMENT
/begin MEASUREMENT Mareg_vvtp "Ausgangswert Regler Hub Proportionalanteil" SWORD _CNV_R_R_Def_f_uw_b_590_CM 1 100. -1. 0.9999 DISPLAY_IDENTIFIER MAREG_VVTP ECU_ADDRESS 0xd000d518 FORMAT "%14.5" /end MEASUREMENT
/begin MEASUREMENT Mareg_vvtst "Statuswert Regler Hub" UBYTE _CNV_R_R_Def_dez_sl_551_CM 1 100. 0. 255. DISPLAY_IDENTIFIER MAREG_VVTST ECU_ADDRESS 0xd000d4f4 FORMAT "%3.0" /end MEASUREMENT
/begin MEASUREMENT Modab_fak "Modell-abgleich regler, Ausgang Faktor" UWORD _CNV_R_R_Def_f_uw_b_590_CM 1 100. 0. 1.9999 DISPLAY_IDENTIFIER MODAB_FAK ECU_ADDRESS 0xd000d4d4 FORMAT "%14.5" /end MEASUREMENT
/begin MEASUREMENT Modab_off "Modell-abgleich regler, Ausgang Offset" SWORD _CNV_R_R_Def_ms_uw__594_CM 1 100. -1024. 1023.9687 DISPLAY_IDENTIFIER MODAB_OFF ECU_ADDRESS 0xd000d4d0 FORMAT "%8.3" /end MEASUREMENT
/begin MEASUREMENT Modab_off_adp "" SWORD _CNV_R_R_Def_ms_uw__594_CM 1 100. -1024. 1023.9687 DISPLAY_IDENTIFIER MODAB_OFF_ADP ECU_ADDRESS 0xd000d4d2 FORMAT "%8.3" /end MEASUREMENT
/begin MEASUREMENT Modab_reg_diff "Modell-abgleich regler differenz" SWORD _CNV_R_R_Def_ms_uw__594_CM 1 100. -1024. 1023.9687 DISPLAY_IDENTIFIER MODAB_REG_DIFF ECU_ADDRESS 0xd000d502 FORMAT "%8.3" /end MEASUREMENT
/begin MEASUREMENT Modab_reg_in "Modell-abgleich regler, Eingang" SWORD _CNV_R_R_Def_f_uw_b_590_CM 1 100. -1. 0.9999 DISPLAY_IDENTIFIER MODAB_REG_IN ECU_ADDRESS 0xd000d504 FORMAT "%14.5" /end MEASUREMENT
/begin MEASUREMENT Modab_reg_out "Modell-abgleich regler, Ausgang" UWORD _CNV_R_R_Def_f_uw_b_590_CM 1 100. 0. 1.9999 DISPLAY_IDENTIFIER MODAB_REG_OUT ECU_ADDRESS 0xd000d506 FORMAT "%14.5" /end MEASUREMENT
/begin MEASUREMENT Modab_reg_outadp "Modell-abgleich regler adp, Ausgang" SWORD _CNV_R_R_Def_f_sw_b_616_CM 1 100. -2. 1.9999 DISPLAY_IDENTIFIER MODAB_REG_OUTADP ECU_ADDRESS 0xd000d508 FORMAT "%14.5" /end MEASUREMENT
/begin MEASUREMENT Modab_reg_vl "Modell-abgleich Eingang bei Vollast" SWORD _CNV_R_R_Def_f_uw_b_590_CM 1 100. -1. 0.9999 DISPLAY_IDENTIFIER MODAB_REG_VL ECU_ADDRESS 0xd000d500 FORMAT "%14.5" /end MEASUREMENT
/begin MEASUREMENT Modelle "Modellzähler, nur dummy, keine Funktion" UBYTE _CNV_R_R_Def_dez_sl_551_CM 1 100. 0. 255. DISPLAY_IDENTIFIER MODELLE ECU_ADDRESS 0xd000d4f8 FORMAT "%3.0" /end MEASUREMENT
/begin MEASUREMENT Mr_pskor_fak "Linearisierungsfaktor für Massentromregler" UWORD _CNV_R_R_Def_f_uw_b_618_CM 1 100. 0. 9.999800000000001 DISPLAY_IDENTIFIER MR_PSKOR_FAK ECU_ADDRESS 0xd000d50a FORMAT "%9.4" /end MEASUREMENT
/begin MEASUREMENT Mrd_ms_fak_i "Massenstromregler, Ausgang Faktor DK-Teil" UWORD _CNV_R_R_Def_f_uw_b_590_CM 1 100. 0. 1.9999 DISPLAY_IDENTIFIER MRD_MS_FAK_I ECU_ADDRESS 0xd000d4e2 FORMAT "%14.5" ARRAY_SIZE 2 MATRIX_DIM 2 1 1 /end MEASUREMENT
/begin MEASUREMENT Mrd_ms_off_i "Massenstromregler, Ausgang Offset DK-Teil" SWORD _CNV_R_R_Def_ms_uw__594_CM 1 100. -1024. 1023.9687 DISPLAY_IDENTIFIER MRD_MS_OFF_I ECU_ADDRESS 0xd000d4de FORMAT "%8.3" ARRAY_SIZE 2 MATRIX_DIM 2 1 1 /end MEASUREMENT
/begin MEASUREMENT Mrnn_test_dk "Ausgang KNN Drosselklappe" SWORD _CNV_R_R_Def_f_uw_b_590_CM 1 100. -1. 0.9999 DISPLAY_IDENTIFIER MRNN_TEST_DK ECU_ADDRESS 0xc0000760 FORMAT "%14.5" /end MEASUREMENT
/begin MEASUREMENT Mrnn_test_pr "Ausgang KNN Psreg" SWORD _CNV_R_R_Def_f_sw_b_616_CM 1 100. -2. 1.9999 DISPLAY_IDENTIFIER MRNN_TEST_PR ECU_ADDRESS 0xc00007fc FORMAT "%14.5" /end MEASUREMENT
/begin MEASUREMENT Mrv_ms_fak "Massenstromregler, Ausgang Faktor Hub-Teil" UWORD _CNV_R_R_Def_f_uw_b_590_CM 1 100. 0. 1.9999 DISPLAY_IDENTIFIER MRV_MS_FAK ECU_ADDRESS 0xc0007a14 FORMAT "%14.5" /end MEASUREMENT
/begin MEASUREMENT Mrv_ms_off "Massenstromregler, Ausgang Offset Hub-Teil" SWORD _CNV_R_R_Def_ms_uw__594_CM 1 100. -1024. 1023.9687 DISPLAY_IDENTIFIER MRV_MS_OFF ECU_ADDRESS 0xd000d4dc FORMAT "%8.3" /end MEASUREMENT
/begin MEASUREMENT Ms_diff_i "Differenz Massenstrom gemessen zu Modellgröße" SWORD _CNV_R_R_Def_ms_uw__594_CM 1 100. -1024. 1023.9687 DISPLAY_IDENTIFIER MS_DIFF_I ECU_ADDRESS 0xd000d4e6 FORMAT "%8.3" ARRAY_SIZE 2 MATRIX_DIM 2 1 1 /end MEASUREMENT
/begin MEASUREMENT Msdk_diff_i "Differenz Massenstrom HFM zu Massenstrom Drosselklappe (Modellgröße)" SWORD _CNV_R_R_Def_ms_uw__594_CM 1 100. -1024. 1023.9687 DISPLAY_IDENTIFIER MSDK_DIFF_I ECU_ADDRESS 0xd000d50e FORMAT "%8.3" ARRAY_SIZE 2 MATRIX_DIM 2 1 1 /end MEASUREMENT
/begin MEASUREMENT Msdk_f_i "Massenstrom gefiltert" UWORD _CNV_R_R_Def_ms_uw__594_CM 1 100. 0. 2047.9687 DISPLAY_IDENTIFIER MSDK_F_I ECU_ADDRESS 0xd000d4ea FORMAT "%8.3" ARRAY_SIZE 2 MATRIX_DIM 2 1 1 /end MEASUREMENT
/begin MEASUREMENT Msdk_ur_i "Massenstrom DK vor Umschaltung B_psintmx" UWORD _CNV_R_R_Def_ms_uw__594_CM 1 100. 0. 2047.9687 DISPLAY_IDENTIFIER MSDK_UR_I ECU_ADDRESS 0xd000d312 FORMAT "%8.3" ARRAY_SIZE 2 MATRIX_DIM 2 1 1 /end MEASUREMENT
/begin MEASUREMENT Msdksr_bersr_i "Massenstrom DK fuer Saugrohr Wert für EISY_SR Berechnung" UWORD _CNV_R_R_Def_ms_uw__594_CM 1 100. 0. 2047.9687 DISPLAY_IDENTIFIER MSDKSR_BERSR_I ECU_ADDRESS 0xd000d672 FORMAT "%8.3" ARRAY_SIZE 2 MATRIX_DIM 2 1 1 /end MEASUREMENT
/begin MEASUREMENT Msdksr_i "Massenstrom DK fuer Saugrohr" UWORD _CNV_R_R_Def_ms_uw__594_CM 1 100. 0. 2047.9687 DISPLAY_IDENTIFIER MSDKSR_I ECU_ADDRESS 0xd000d652 FORMAT "%8.3" ARRAY_SIZE 2 MATRIX_DIM 2 1 1 /end MEASUREMENT
/begin MEASUREMENT Mshfm_kor_i "Korrigierter Massenstrom HFM" UWORD _CNV_R_R_Def_ms_uw__594_CM 1 100. 0. 2047.9687 DISPLAY_IDENTIFIER MSHFM_KOR_I ECU_ADDRESS 0xd000d548 FORMAT "%8.3" ARRAY_SIZE 2 MATRIX_DIM 2 1 1 /end MEASUREMENT
/begin MEASUREMENT Mshfm_pspkor_i "Korrigierter Massenstrom HFM" UWORD _CNV_R_R_Def_ms_uw__594_CM 1 100. 0. 2047.9687 DISPLAY_IDENTIFIER MSHFM_PSPKOR_I ECU_ADDRESS 0xd000d54c FORMAT "%8.3" ARRAY_SIZE 2 MATRIX_DIM 2 1 1 /end MEASUREMENT
/begin MEASUREMENT Mslam "Massenstrom aus Lambda und Kraftstoffmasse berechnet" UWORD _CNV_R_R_Def_ms_uw__594_CM 1 100. 0. 2047.9687 DISPLAY_IDENTIFIER MSLAM ECU_ADDRESS 0xd000dc60 FORMAT "%8.3" /end MEASUREMENT
/begin MEASUREMENT Mslam1 "Massenstrom aus Lambda und Kraftstoffmasse berechnet Bank 1" UWORD _CNV_R_R_Def_ms_uw__594_CM 1 100. 0. 2047.9687 DISPLAY_IDENTIFIER MSLAM1 ECU_ADDRESS 0xd000dc62 FORMAT "%8.3" /end MEASUREMENT
/begin MEASUREMENT Mslam2 "Massenstrom aus Lambda und Kraftstoffmasse berechnet Bank 2" UWORD _CNV_R_R_Def_ms_uw__594_CM 1 100. 0. 2047.9687 DISPLAY_IDENTIFIER MSLAM2 ECU_ADDRESS 0xd000dc66 FORMAT "%8.3" /end MEASUREMENT
/begin MEASUREMENT Msn_mrad_i "" SWORD _CNV_R_R_Def_ms_uw__594_CM 1 100. -1024. 1023.9687 DISPLAY_IDENTIFIER MSN_MRAD_I ECU_ADDRESS 0xd000d4fc FORMAT "%8.3" ARRAY_SIZE 2 MATRIX_DIM 2 1 1 /end MEASUREMENT
/begin MEASUREMENT Msndk_i "Normierte Massenstrom" UWORD _CNV_R_R_Def_ms_uw__594_CM 1 100. 0. 2047.9687 DISPLAY_IDENTIFIER MSNDK_I ECU_ADDRESS 0xd000d31e FORMAT "%8.3" ARRAY_SIZE 2 MATRIX_DIM 2 1 1 /end MEASUREMENT
/begin MEASUREMENT Msndk_oma_i "Normierte Massenstrom ohne ablgeleich" UWORD _CNV_R_R_Def_ms_uw__594_CM 1 100. 0. 2047.9687 DISPLAY_IDENTIFIER MSNDK_OMA_I ECU_ADDRESS 0xd000d30e FORMAT "%8.3" ARRAY_SIZE 2 MATRIX_DIM 2 1 1 /end MEASUREMENT
/begin MEASUREMENT Msndk_roh_i "Unkorrigiert Norm Massenstrom uber DK" UWORD _CNV_R_R_Def_ms_uw__655_CM 1 100. 0. 8191.875 DISPLAY_IDENTIFIER MSNDK_ROH_I ECU_ADDRESS 0xd000d322 FORMAT "%7.2" ARRAY_SIZE 2 MATRIX_DIM 2 1 1 /end MEASUREMENT
/begin MEASUREMENT Msnlg_off_i "" SWORD _CNV_R_R_Def_ms_uw__594_CM 1 100. -1024. 1023.9687 DISPLAY_IDENTIFIER MSNLG_OFF_I ECU_ADDRESS 0xd000d604 FORMAT "%8.3" ARRAY_SIZE 2 MATRIX_DIM 2 1 1 /end MEASUREMENT
/begin MEASUREMENT Msnlgoff_mr_i "Drosselklappe Leckluft Adaption" SWORD _CNV_R_R_Def_ms_uw__594_CM 1 100. -1024. 1023.9687 DISPLAY_IDENTIFIER MSNLGOFF_MR_I ECU_ADDRESS 0xc0004366 FORMAT "%8.3" ARRAY_SIZE 2 MATRIX_DIM 2 1 1 /end MEASUREMENT
/begin MEASUREMENT Msnlgofs_tmp "" SWORD _CNV_R_R_Def_ms_uw__594_CM 1 100. -1024. 1023.9687 DISPLAY_IDENTIFIER MSNLGOFS_TMP ECU_ADDRESS 0xc000436c FORMAT "%8.3" /end MEASUREMENT
/begin MEASUREMENT Msnlgofs_tmp_i "" SWORD _CNV_R_R_Def_ms_uw__594_CM 1 100. -1024. 1023.9687 DISPLAY_IDENTIFIER MSNLGOFS_TMP_I ECU_ADDRESS 0xc000436e FORMAT "%8.3" ARRAY_SIZE 2 MATRIX_DIM 2 1 1 /end MEASUREMENT
/begin MEASUREMENT Msnzyl "Massenstrom Zylinder ungedrosselt" UWORD _CNV_R_R_Def_ms_uw__594_CM 1 100. 0. 2047.9687 DISPLAY_IDENTIFIER MSNZYL ECU_ADDRESS 0xd000d378 FORMAT "%8.3" /end MEASUREMENT
/begin MEASUREMENT Msnzyl_i "Massenstrom Zylinder ungedrosselt" UWORD _CNV_R_R_Def_ms_uw__594_CM 1 100. 0. 2047.9687 DISPLAY_IDENTIFIER MSNZYL_I ECU_ADDRESS 0xd000d374 FORMAT "%8.3" ARRAY_SIZE 2 MATRIX_DIM 2 1 1 /end MEASUREMENT
/begin MEASUREMENT Msnzyl_k_i "Massenstrom Zylinder normalisiert mit Reglereingriffe" UWORD _CNV_R_R_Def_ms_uw__594_CM 1 100. 0. 2047.9687 DISPLAY_IDENTIFIER MSNZYL_K_I ECU_ADDRESS 0xd000d3a6 FORMAT "%8.3" ARRAY_SIZE 2 MATRIX_DIM 2 1 1 /end MEASUREMENT
/begin MEASUREMENT Mssr_diff_i "Massenstrom differenz" SWORD _CNV_R_R_Def_ms_uw__594_CM 1 100. -1024. 1023.9687 DISPLAY_IDENTIFIER MSSR_DIFF_I ECU_ADDRESS 0xd000d656 FORMAT "%8.3" ARRAY_SIZE 2 MATRIX_DIM 2 1 1 /end MEASUREMENT
/begin MEASUREMENT Mssrzu_i "Massenstrom zum Saugrohr" SWORD _CNV_R_R_Def_ms_uw__594_CM 1 100. -1024. 1023.9687 DISPLAY_IDENTIFIER MSSRZU_I ECU_ADDRESS 0xd000d65a FORMAT "%8.3" ARRAY_SIZE 2 MATRIX_DIM 2 1 1 /end MEASUREMENT
/begin MEASUREMENT Msverd "Verdichtermassenstrom" UWORD _CNV_R_R_Def_ms_uw__594_CM 1 100. 0. 2047.9687 DISPLAY_IDENTIFIER MSVERD ECU_ADDRESS 0xd000d6f0 FORMAT "%8.3" /end MEASUREMENT
/begin MEASUREMENT Mszyl "Massenstrom Zylinder" UWORD _CNV_R_R_Def_ms_uw__594_CM 1 100. 0. 2047.9687 DISPLAY_IDENTIFIER MSZYL ECU_ADDRESS 0xd000d356 FORMAT "%8.3" /end MEASUREMENT
/begin MEASUREMENT Mszyl_bersr_i "Massenstrom Zylinder Wert für EISY_SR Berechnung" UWORD _CNV_R_R_Def_ms_uw__594_CM 1 100. 0. 2047.9687 DISPLAY_IDENTIFIER MSZYL_BERSR_I ECU_ADDRESS 0xd000d676 FORMAT "%8.3" ARRAY_SIZE 2 MATRIX_DIM 2 1 1 /end MEASUREMENT
/begin MEASUREMENT Mszyl_diag "Massenstrom in Zylinder (Modell)" UWORD _CNV_R_R_Def_ms_uw__594_CM 1 100. 0. 2047.9687 DISPLAY_IDENTIFIER MSZYL_DIAG ECU_ADDRESS 0xc000080e FORMAT "%8.3" /end MEASUREMENT
/begin MEASUREMENT Mszyl_diagf "Massenstrom in Zylinder (Modell) (gefiltert)" UWORD _CNV_R_R_Def_ms_uw__594_CM 1 100. 0. 2047.9687 DISPLAY_IDENTIFIER MSZYL_DIAGF ECU_ADDRESS 0xc0000810 FORMAT "%8.3" /end MEASUREMENT
/begin MEASUREMENT Mszyl_diff_i "Differenz Massenstrom Lambda zu Massenstrom über Einspritzung (Modellgröße)" SWORD _CNV_R_R_Def_ms_uw__594_CM 1 100. -1024. 1023.9687 DISPLAY_IDENTIFIER MSZYL_DIFF_I ECU_ADDRESS 0xd000d512 FORMAT "%8.3" ARRAY_SIZE 2 MATRIX_DIM 2 1 1 /end MEASUREMENT
/begin MEASUREMENT Mszyl_ges_i "Angesaugte Luftmasse incl. AGR" UWORD _CNV_R_R_Def_ml_uw__653_CM 1 100. 0. 6553.5 DISPLAY_IDENTIFIER MSZYL_GES_I ECU_ADDRESS 0xd000d35e FORMAT "%6.1" ARRAY_SIZE 2 MATRIX_DIM 2 1 1 /end MEASUREMENT
/begin MEASUREMENT Mszyl_i "Massenstrom Zylinder" UWORD _CNV_R_R_Def_ms_uw__594_CM 1 100. 0. 2047.9687 DISPLAY_IDENTIFIER MSZYL_I ECU_ADDRESS 0xd000d352 FORMAT "%8.3" ARRAY_SIZE 2 MATRIX_DIM 2 1 1 /end MEASUREMENT
/begin MEASUREMENT Mszyl_nn_i "Massenstrom Zylinder, aus Neuronales Netz" UWORD _CNV_R_R_Def_ms_uw__594_CM 1 100. 0. 2047.9687 DISPLAY_IDENTIFIER MSZYL_NN_I ECU_ADDRESS 0xd000d3aa FORMAT "%8.3" ARRAY_SIZE 2 MATRIX_DIM 2 1 1 /end MEASUREMENT
/begin MEASUREMENT Nkw_eisydf "Drehzahl für Eisy Diagnose gefiltert Dynamikerkennung" SWORD _CNV_R_R_Def_n_sw_q_595_CM 1 100. -32768. 32767. DISPLAY_IDENTIFIER NKW_EISYDF ECU_ADDRESS 0xc0000812 FORMAT "%5.0" /end MEASUREMENT
/begin MEASUREMENT Pakps_kor_i "" UWORD _CNV_R_R_Def_f_uw_b_590_CM 1 100. 0. 1.9999 DISPLAY_IDENTIFIER PAKPS_KOR_I ECU_ADDRESS 0xd000d382 FORMAT "%14.5" ARRAY_SIZE 2 MATRIX_DIM 2 1 1 /end MEASUREMENT
/begin MEASUREMENT Pakps_offs_i "" SWORD _CNV_R_R_Def_f_uw_b_590_CM 1 100. -1. 0.9999 DISPLAY_IDENTIFIER PAKPS_OFFS_I ECU_ADDRESS 0xd000d37e FORMAT "%14.5" ARRAY_SIZE 2 MATRIX_DIM 2 1 1 /end MEASUREMENT
/begin MEASUREMENT Pirg "Partialdruck Restgas internes AGR" UWORD _CNV_R_R_Def_p_sw_q_576_CM 1 100. 0. 2559.9609 DISPLAY_IDENTIFIER PIRG ECU_ADDRESS 0xd000d35c FORMAT "%7.2" /end MEASUREMENT
/begin MEASUREMENT Pirg_abgd_i "Pirg: Altitude korrigiert" UWORD _CNV_R_R_Def_p_sw_q_576_CM 1 100. 0. 2559.9609 DISPLAY_IDENTIFIER PIRG_ABGD_I ECU_ADDRESS 0xd000d370 FORMAT "%7.2" ARRAY_SIZE 2 MATRIX_DIM 2 1 1 /end MEASUREMENT
/begin MEASUREMENT Pirg_fho "Pirg: Fho korrigiert" UWORD _CNV_R_R_Def_p_sw_q_576_CM 1 100. 0. 2559.9609 DISPLAY_IDENTIFIER PIRG_FHO ECU_ADDRESS 0xd000d328 FORMAT "%7.2" /end MEASUREMENT
/begin MEASUREMENT Pirg_i "Partialdruck Restgas internes AGR" UWORD _CNV_R_R_Def_p_sw_q_576_CM 1 100. 0. 2559.9609 DISPLAY_IDENTIFIER PIRG_I ECU_ADDRESS 0xd000d358 FORMAT "%7.2" ARRAY_SIZE 2 MATRIX_DIM 2 1 1 /end MEASUREMENT
/begin MEASUREMENT Pirg_nn_i "Partialdruck Restgas internes AGR aus N.N." UWORD _CNV_R_R_Def_p_sw_q_576_CM 1 100. 0. 2559.9609 DISPLAY_IDENTIFIER PIRG_NN_I ECU_ADDRESS 0xd000d3be FORMAT "%7.2" ARRAY_SIZE 2 MATRIX_DIM 2 1 1 /end MEASUREMENT
/begin MEASUREMENT Pirg_nnbeg_i "Partialdruck Restgas Begrenzt" UWORD _CNV_R_R_Def_p_sw_q_576_CM 1 100. 0. 2559.9609 DISPLAY_IDENTIFIER PIRG_NNBEG_I ECU_ADDRESS 0xd000d3c6 FORMAT "%7.2" ARRAY_SIZE 2 MATRIX_DIM 2 1 1 /end MEASUREMENT
/begin MEASUREMENT Pirg_nnbegf_i "Partialdruck Restgas begrenzt und gefiltert" UWORD _CNV_R_R_Def_p_sw_q_576_CM 1 100. 0. 2559.9609 DISPLAY_IDENTIFIER PIRG_NNBEGF_I ECU_ADDRESS 0xd000d3ca FORMAT "%7.2" ARRAY_SIZE 2 MATRIX_DIM 2 1 1 /end MEASUREMENT
/begin MEASUREMENT Pirg_nnf_i "Partialdruck Restgas internes AGR aus N.N. (filt)" UWORD _CNV_R_R_Def_p_sw_q_576_CM 1 100. 0. 2559.9609 DISPLAY_IDENTIFIER PIRG_NNF_I ECU_ADDRESS 0xd000d3c2 FORMAT "%7.2" ARRAY_SIZE 2 MATRIX_DIM 2 1 1 /end MEASUREMENT
/begin MEASUREMENT Pllk "" UWORD _CNV_R_R_Def_p_sw_q_576_CM 1 100. 0. 2559.9609 DISPLAY_IDENTIFIER PLLK ECU_ADDRESS 0xd000d6ec FORMAT "%7.2" /end MEASUREMENT
/begin MEASUREMENT Pr_ms_fak_i "Druckreglerausgang, Faktor" UWORD _CNV_R_R_Def_f_uw_b_590_CM 1 100. 0. 1.9999 DISPLAY_IDENTIFIER PR_MS_FAK_I ECU_ADDRESS 0xd000d5f0 FORMAT "%14.5" ARRAY_SIZE 2 MATRIX_DIM 2 1 1 /end MEASUREMENT
/begin MEASUREMENT Pr_ms_off_i "Druckreglerausgang, Offset" SWORD _CNV_R_R_Def_ms_uw__594_CM 1 100. -1024. 1023.9687 DISPLAY_IDENTIFIER PR_MS_OFF_I ECU_ADDRESS 0xd000d5f4 FORMAT "%8.3" ARRAY_SIZE 2 MATRIX_DIM 2 1 1 /end MEASUREMENT
/begin MEASUREMENT Ps "Absolut Druck im Saugrohr" UWORD _CNV_R_R_Def_p_sw_q_576_CM 1 100. 0. 2559.9609 DISPLAY_IDENTIFIER PS ECU_ADDRESS 0xd000d648 FORMAT "%7.2" /end MEASUREMENT
/begin MEASUREMENT Ps_abs_kor "Absolut Sammler druck vom Sensor (korrigiert)" UWORD _CNV_R_R_Def_p_sw_q_576_CM 1 100. 0. 2559.9609 DISPLAY_IDENTIFIER PS_ABS_KOR ECU_ADDRESS 0xc000080c FORMAT "%7.2" /end MEASUREMENT
/begin MEASUREMENT Ps_abs_offset "Offset, Ps_abs Sensor" SWORD _CNV_R_R_Def_p_sw_q_576_CM 1 100. -1280. 1279.9609 DISPLAY_IDENTIFIER PS_ABS_OFFSET ECU_ADDRESS 0xc0004378 FORMAT "%7.2" /end MEASUREMENT
/begin MEASUREMENT Ps_alt_i "Druck im Saugrohr alt" UWORD _CNV_R_R_Def_p_sw_q_576_CM 1 100. 0. 2559.9609 DISPLAY_IDENTIFIER PS_ALT_I ECU_ADDRESS 0xd000d666 FORMAT "%7.2" ARRAY_SIZE 2 MATRIX_DIM 2 1 1 /end MEASUREMENT
/begin MEASUREMENT Ps_diff_i "Differenz Druck im Saugrohr" SWORD _CNV_R_R_Def_p_sw_q_576_CM 1 100. -1280. 1279.9609 DISPLAY_IDENTIFIER PS_DIFF_I ECU_ADDRESS 0xd000d65e FORMAT "%7.2" ARRAY_SIZE 2 MATRIX_DIM 2 1 1 /end MEASUREMENT
/begin MEASUREMENT Ps_f_i "Absolut Druck im Saugrohr (gefiltert)" UWORD _CNV_R_R_Def_p_sw_q_576_CM 1 100. 0. 2559.9609 DISPLAY_IDENTIFIER PS_F_I ECU_ADDRESS 0xd000d620 FORMAT "%7.2" ARRAY_SIZE 2 MATRIX_DIM 2 1 1 /end MEASUREMENT
/begin MEASUREMENT Ps_i "Absolut Druck im Saugrohr" UWORD _CNV_R_R_Def_p_sw_q_576_CM 1 100. 0. 2559.9609 DISPLAY_IDENTIFIER PS_I ECU_ADDRESS 0xd000d644 FORMAT "%7.2" ARRAY_SIZE 2 MATRIX_DIM 2 1 1 /end MEASUREMENT
/begin MEASUREMENT Ps_int_i "Differenz Druck im Saugrohr intern" UWORD _CNV_R_R_Def_p_sw_q_576_CM 1 100. 0. 2559.9609 DISPLAY_IDENTIFIER PS_INT_I ECU_ADDRESS 0xd000d662 FORMAT "%7.2" ARRAY_SIZE 2 MATRIX_DIM 2 1 1 /end MEASUREMENT
/begin MEASUREMENT Ps_ist "Delta Differenzdruck Saugrohr" UWORD _CNV_R_R_Def_p_sw_q_576_CM 1 100. 0. 2559.9609 DISPLAY_IDENTIFIER PS_IST ECU_ADDRESS 0xd000d5e0 FORMAT "%7.2" /end MEASUREMENT
/begin MEASUREMENT Ps_ist_i "Delta Differenzdruck Saugrohr" UWORD _CNV_R_R_Def_p_sw_q_576_CM 1 100. 0. 2559.9609 DISPLAY_IDENTIFIER PS_IST_I ECU_ADDRESS 0xd000d5e2 FORMAT "%7.2" ARRAY_SIZE 2 MATRIX_DIM 2 1 1 /end MEASUREMENT
/begin MEASUREMENT Ps_mx_i "Maximal möglicher Druck" UWORD _CNV_R_R_Def_p_sw_q_576_CM 1 100. 0. 2559.9609 DISPLAY_IDENTIFIER PS_MX_I ECU_ADDRESS 0xd000d66a FORMAT "%7.2" ARRAY_SIZE 2 MATRIX_DIM 2 1 1 /end MEASUREMENT
/begin MEASUREMENT Ps_ok_i "Druck im Saugrohr nicht korrigiert" UWORD _CNV_R_R_Def_p_sw_q_576_CM 1 100. 0. 2559.9609 DISPLAY_IDENTIFIER PS_OK_I ECU_ADDRESS 0xd000d66e FORMAT "%7.2" ARRAY_SIZE 2 MATRIX_DIM 2 1 1 /end MEASUREMENT
/begin MEASUREMENT Psabs_off_ubeg "Gemittelte Abweichung Ps_abs zu Pu/Ps" SWORD _CNV_R_R_Def_p_sw_q_576_CM 1 100. -1280. 1279.9609 DISPLAY_IDENTIFIER PSABS_OFF_UBEG ECU_ADDRESS 0xc0000832 FORMAT "%7.2" /end MEASUREMENT
/begin MEASUREMENT Pspvdk "Druck verhaeltnis vor Drosselklappe" UWORD _CNV_R_R_Def_f_uw_b_571_CM 1 100. 0. 0.9999 DISPLAY_IDENTIFIER PSPVDK ECU_ADDRESS 0xd000d30c FORMAT "%14.5" /end MEASUREMENT
/begin MEASUREMENT Pspvdk_i "Druck verhaeltnis vor Drosselklappe" UWORD _CNV_R_R_Def_f_uw_b_571_CM 1 100. 0. 0.9999 DISPLAY_IDENTIFIER PSPVDK_I ECU_ADDRESS 0xd000d308 FORMAT "%14.5" ARRAY_SIZE 2 MATRIX_DIM 2 1 1 /end MEASUREMENT
/begin MEASUREMENT Psreg_diag "" SWORD _CNV_R_R_Def_f_sw_b_591_CM 1 100. -4. 3.9998 DISPLAY_IDENTIFIER PSREG_DIAG ECU_ADDRESS 0xc0000842 FORMAT "%9.4" /end MEASUREMENT
/begin MEASUREMENT Psreg_diag_f "" SWORD _CNV_R_R_Def_f_sw_b_591_CM 1 100. -4. 3.9998 DISPLAY_IDENTIFIER PSREG_DIAG_F ECU_ADDRESS 0xc0000844 FORMAT "%9.4" /end MEASUREMENT
/begin MEASUREMENT Psreg_diff_i "Delta Differenzdruck Saugrohr" SWORD _CNV_R_R_Def_p_sw_q_576_CM 1 100. -1280. 1279.9609 DISPLAY_IDENTIFIER PSREG_DIFF_I ECU_ADDRESS 0xd000d60c FORMAT "%7.2" ARRAY_SIZE 2 MATRIX_DIM 2 1 1 /end MEASUREMENT
/begin MEASUREMENT Psreg_diff_in_i "Reglereingang" SWORD _CNV_R_R_Def_p_sw_q_576_CM 1 100. -1280. 1279.9609 DISPLAY_IDENTIFIER PSREG_DIFF_IN_I ECU_ADDRESS 0xd000d5ec FORMAT "%7.2" ARRAY_SIZE 2 MATRIX_DIM 2 1 1 /end MEASUREMENT
/begin MEASUREMENT Psreg_diff_lin_i "Linearisierter Reglereingang" SWORD _CNV_R_R_Def_p_sw_q_576_CM 1 100. -1280. 1279.9609 DISPLAY_IDENTIFIER PSREG_DIFF_LIN_I ECU_ADDRESS 0xd000d5e8 FORMAT "%7.2" ARRAY_SIZE 2 MATRIX_DIM 2 1 1 /end MEASUREMENT
/begin MEASUREMENT Psreg_i_i "Ps-regler I-Reglerausgang" SWORD _CNV_R_R_Def_f_sw_b_616_CM 1 100. -2. 1.9999 DISPLAY_IDENTIFIER PSREG_I_I ECU_ADDRESS 0xd000d618 FORMAT "%14.5" ARRAY_SIZE 2 MATRIX_DIM 2 1 1 /end MEASUREMENT
/begin MEASUREMENT Psreg_out_i "Reglerausgang PS-Regler" SWORD _CNV_R_R_Def_f_sw_b_616_CM 1 100. -2. 1.9999 DISPLAY_IDENTIFIER PSREG_OUT_I ECU_ADDRESS 0xd000d5da FORMAT "%14.5" ARRAY_SIZE 2 MATRIX_DIM 2 1 1 /end MEASUREMENT
/begin MEASUREMENT Psreg_p_i "Ps-regler P-Reglerausgang" SWORD _CNV_R_R_Def_f_sw_b_616_CM 1 100. -2. 1.9999 DISPLAY_IDENTIFIER PSREG_P_I ECU_ADDRESS 0xd000d61c FORMAT "%14.5" ARRAY_SIZE 2 MATRIX_DIM 2 1 1 /end MEASUREMENT
/begin MEASUREMENT Psreg_pi_i "Ps-regler PI-Reglerausgang" SWORD _CNV_R_R_Def_f_sw_b_616_CM 1 100. -2. 1.9999 DISPLAY_IDENTIFIER PSREG_PI_I ECU_ADDRESS 0xd000d614 FORMAT "%14.5" ARRAY_SIZE 2 MATRIX_DIM 2 1 1 /end MEASUREMENT
/begin MEASUREMENT Psreg_st_i "Statuswert Ps-Regler" UBYTE _CNV_R_R_Def_dez_sl_551_CM 1 100. 0. 255. DISPLAY_IDENTIFIER PSREG_ST_I ECU_ADDRESS 0xd000d602 FORMAT "%3.0" ARRAY_SIZE 2 MATRIX_DIM 2 1 1 /end MEASUREMENT
/begin MEASUREMENT Psreg_tmp "Reglerausgang PS-Regler" SWORD _CNV_R_R_Def_f_sw_b_616_CM 1 100. -2. 1.9999 DISPLAY_IDENTIFIER PSREG_TMP ECU_ADDRESS 0xd000d5fc FORMAT "%14.5" /end MEASUREMENT
/begin MEASUREMENT Psreg_tmp_i "Reglerausgang PS-Regler" SWORD _CNV_R_R_Def_f_sw_b_616_CM 1 100. -2. 1.9999 DISPLAY_IDENTIFIER PSREG_TMP_I ECU_ADDRESS 0xd000d5f8 FORMAT "%14.5" ARRAY_SIZE 2 MATRIX_DIM 2 1 1 /end MEASUREMENT
/begin MEASUREMENT Psregi_i "Differenzdruck Saugrohr Adaption I-Anteil" UWORD _CNV_R_R_Def_f_uw_b_590_CM 1 100. 0. 1.9999 DISPLAY_IDENTIFIER PSREGI_I ECU_ADDRESS 0xd000d5fe FORMAT "%14.5" ARRAY_SIZE 2 MATRIX_DIM 2 1 1 /end MEASUREMENT
/begin MEASUREMENT Psregp_i "Differenzdruck Saugrohr Adaption P-Anteil" UWORD _CNV_R_R_Def_f_uw_b_617_CM 1 100. 0. 63.999 DISPLAY_IDENTIFIER PSREGP_I ECU_ADDRESS 0xd000d610 FORMAT "%9.4" ARRAY_SIZE 2 MATRIX_DIM 2 1 1 /end MEASUREMENT
/begin MEASUREMENT Pu_kor "Umgebungsdruck korrigiert" UWORD _CNV_R_R_Def_p_sw_q_576_CM 1 100. 0. 2559.9609 DISPLAY_IDENTIFIER PU_KOR ECU_ADDRESS 0xc0000808 FORMAT "%7.2" /end MEASUREMENT
/begin MEASUREMENT Pu_offset "Offset, Pu Sensor" SWORD _CNV_R_R_Def_p_sw_q_576_CM 1 100. -1280. 1279.9609 DISPLAY_IDENTIFIER PU_OFFSET ECU_ADDRESS 0xc000437a FORMAT "%7.2" /end MEASUREMENT
/begin MEASUREMENT Pvdkds_kor "Druck vor Drosselklappe v. Drucksensor (korrigiert)" UWORD _CNV_R_R_Def_p_sw_q_576_CM 1 100. 0. 2559.9609 DISPLAY_IDENTIFIER PVDKDS_KOR ECU_ADDRESS 0xc000080a FORMAT "%7.2" /end MEASUREMENT
/begin MEASUREMENT Pvdkds_off_ubeg "Gemittelte Abweichung Pvdkds zu Pu/Ps" SWORD _CNV_R_R_Def_p_sw_q_576_CM 1 100. -1280. 1279.9609 DISPLAY_IDENTIFIER PVDKDS_OFF_UBEG ECU_ADDRESS 0xc0000830 FORMAT "%7.2" /end MEASUREMENT
/begin MEASUREMENT Pvdkds_offset "Offset, Pvdkds Sensor" SWORD _CNV_R_R_Def_p_sw_q_576_CM 1 100. -1280. 1279.9609 DISPLAY_IDENTIFIER PVDKDS_OFFSET ECU_ADDRESS 0xc0004376 FORMAT "%7.2" /end MEASUREMENT
/begin MEASUREMENT Rf_eisydf "Last für Eisy Diagnose gefiltert Dynamikerkennung" SWORD _CNV_R_R_Def_rf_sw__598_CM 1 100. -327.68 327.67 DISPLAY_IDENTIFIER RF_EISYDF ECU_ADDRESS 0xc0000816 FORMAT "%9.4" /end MEASUREMENT
/begin MEASUREMENT Rf_hfm_ist_i "Mshfm_ist als Rf berechnet" SWORD _CNV_R_R_Def_rf_sw__598_CM 1 100. -327.68 327.67 DISPLAY_IDENTIFIER RF_HFM_IST_I ECU_ADDRESS 0xd000d544 FORMAT "%9.4" ARRAY_SIZE 2 MATRIX_DIM 2 1 1 /end MEASUREMENT
/begin MEASUREMENT Rf_zylvol_i "Normalisiert Volumetrisches Zylinder-Fuellung" SWORD _CNV_R_R_Def_rf_sw__598_CM 1 100. -327.68 327.67 DISPLAY_IDENTIFIER RF_ZYLVOL_I ECU_ADDRESS 0xd000d3d2 FORMAT "%9.4" ARRAY_SIZE 2 MATRIX_DIM 2 1 1 /end MEASUREMENT
/begin MEASUREMENT Rflam "Relative Füllung aus Lambda und Kraftstoffmasse berechnet" UWORD _CNV_R_R_Def_rf_sw__598_CM 1 100. 0. 655.35 DISPLAY_IDENTIFIER RFLAM ECU_ADDRESS 0xd000dc74 FORMAT "%9.4" /end MEASUREMENT
/begin MEASUREMENT Rflam2 "Relative Füllung aus Lambda und Kraftstoffmasse berechnet Bank 2" UWORD _CNV_R_R_Def_rf_sw__598_CM 1 100. 0. 655.35 DISPLAY_IDENTIFIER RFLAM2 ECU_ADDRESS 0xd000dc7a FORMAT "%9.4" /end MEASUREMENT
/begin MEASUREMENT Rfv_ist_hub "" SWORD _CNV_R_R_Def_rf_sw__598_CM 1 100. -327.68 327.67 DISPLAY_IDENTIFIER RFV_IST_HUB ECU_ADDRESS 0xd000d392 FORMAT "%9.4" /end MEASUREMENT
/begin MEASUREMENT Rfv_ist_i "Modellierter Ungedrosselt Rf begrenzt" SWORD _CNV_R_R_Def_rf_sw__598_CM 1 100. -327.68 327.67 DISPLAY_IDENTIFIER RFV_IST_I ECU_ADDRESS 0xd000d3ba FORMAT "%9.4" ARRAY_SIZE 2 MATRIX_DIM 2 1 1 /end MEASUREMENT
/begin MEASUREMENT Rfv_ist_nn_i "Modellierter Ungedrosselt Rf aus N.N." SWORD _CNV_R_R_Def_rf_sw__598_CM 1 100. -327.68 327.67 DISPLAY_IDENTIFIER RFV_IST_NN_I ECU_ADDRESS 0xd000d3ae FORMAT "%9.4" ARRAY_SIZE 2 MATRIX_DIM 2 1 1 /end MEASUREMENT
/begin MEASUREMENT Rfv_ist_nnbeg_i "Modellierter Ungedrosselt Rf aus N.N. (begr.)" SWORD _CNV_R_R_Def_rf_sw__598_CM 1 100. -327.68 327.67 DISPLAY_IDENTIFIER RFV_IST_NNBEG_I ECU_ADDRESS 0xd000d3b6 FORMAT "%9.4" ARRAY_SIZE 2 MATRIX_DIM 2 1 1 /end MEASUREMENT
/begin MEASUREMENT Rfv_ist_nnf_i "Modellierter Ungedrosselt Rf aus N.N. (filt)" SWORD _CNV_R_R_Def_rf_sw__598_CM 1 100. -327.68 327.67 DISPLAY_IDENTIFIER RFV_IST_NNF_I ECU_ADDRESS 0xd000d3b2 FORMAT "%9.4" ARRAY_SIZE 2 MATRIX_DIM 2 1 1 /end MEASUREMENT
/begin MEASUREMENT Rfv_zylvol_i "Normalisiert Volumetrisches Zylinder-Fuellung" SWORD _CNV_R_R_Def_rf_sw__598_CM 1 100. -327.68 327.67 DISPLAY_IDENTIFIER RFV_ZYLVOL_I ECU_ADDRESS 0xd000d3ce FORMAT "%9.4" ARRAY_SIZE 2 MATRIX_DIM 2 1 1 /end MEASUREMENT
/begin MEASUREMENT Rfzyl_nn_i "" SWORD _CNV_R_R_Def_rf_sw__598_CM 1 100. -327.68 327.67 DISPLAY_IDENTIFIER RFZYL_NN_I ECU_ADDRESS 0xd000d3d6 FORMAT "%9.4" ARRAY_SIZE 2 MATRIX_DIM 2 1 1 /end MEASUREMENT
/begin MEASUREMENT Rk_1_td "rel Kraftstoffmasse Bank 1 verzögert" UWORD _CNV_R_R_Def_rk_sw__600_CM 1 100. 0. 3199.9511 DISPLAY_IDENTIFIER RK_1_TD ECU_ADDRESS 0xd000dc76 FORMAT "%8.3" /end MEASUREMENT
/begin MEASUREMENT Rk_1_tdf "rel Kraftstoffmasse Bank 1 verzögert gefiltert" UWORD _CNV_R_R_Def_rk_sw__600_CM 1 100. 0. 3199.9511 DISPLAY_IDENTIFIER RK_1_TDF ECU_ADDRESS 0xd000dc78 FORMAT "%8.3" /end MEASUREMENT
/begin MEASUREMENT Rk_2_td "rel Kraftstoffmasse Bank 2 verzögert" UWORD _CNV_R_R_Def_rk_sw__600_CM 1 100. 0. 3199.9511 DISPLAY_IDENTIFIER RK_2_TD ECU_ADDRESS 0xd000dc7c FORMAT "%8.3" /end MEASUREMENT
/begin MEASUREMENT Rk_2_tdf "rel Kraftstoffmasse Bank 2 verzögert gefiltert" UWORD _CNV_R_R_Def_rk_sw__600_CM 1 100. 0. 3199.9511 DISPLAY_IDENTIFIER RK_2_TDF ECU_ADDRESS 0xd000dc7e FORMAT "%8.3" /end MEASUREMENT
/begin MEASUREMENT Spr_diff_i "Differenz der Spreizungen" SWORD _CNV_R_R_Def_spr_sw_561_CM 1 100. -3276.8 3276.7 DISPLAY_IDENTIFIER SPR_DIFF_I ECU_ADDRESS 0xd000d3f2 FORMAT "%7.2" ARRAY_SIZE 2 MATRIX_DIM 2 1 1 /end MEASUREMENT
/begin MEASUREMENT Spr_sum_f_i "Summe Spreizungen gefiltert" UWORD _CNV_R_R_Def_spr_sw_561_CM 1 100. 0. 6553.5 DISPLAY_IDENTIFIER SPR_SUM_F_I ECU_ADDRESS 0xd000d3ee FORMAT "%7.2" ARRAY_SIZE 2 MATRIX_DIM 2 1 1 /end MEASUREMENT
/begin MEASUREMENT Spr_sum_i "Summe Spreizungen" UWORD _CNV_R_R_Def_spr_sw_561_CM 1 100. 0. 6553.5 DISPLAY_IDENTIFIER SPR_SUM_I ECU_ADDRESS 0xd000d3ea FORMAT "%7.2" ARRAY_SIZE 2 MATRIX_DIM 2 1 1 /end MEASUREMENT
/begin MEASUREMENT Spr_swp_i "Schwerpunkt der Spreizung" SWORD _CNV_R_R_Def_spr_sw_561_CM 1 100. -3276.8 3276.7 DISPLAY_IDENTIFIER SPR_SWP_I ECU_ADDRESS 0xd000d3f6 FORMAT "%7.2" ARRAY_SIZE 2 MATRIX_DIM 2 1 1 /end MEASUREMENT
/begin MEASUREMENT St_disa_umschalt "Statuswort" UBYTE _CNV_R_R_Def_dez_sl_551_CM 1 100. 0. 255. DISPLAY_IDENTIFIER ST_DISA_UMSCHALT ECU_ADDRESS 0xd000d38f FORMAT "%3.0" /end MEASUREMENT
/begin MEASUREMENT St_disa_umschalt.B_disa_deak "Bedingung DISA umschaltung bereit" UBYTE _CNV_S_2_Def_bit_ub_563_CM 1 100. 0. 1. DISPLAY_IDENTIFIER B_DISA_DEAK ECU_ADDRESS 0xd000d38f BIT_MASK 0x1 /end MEASUREMENT
/begin MEASUREMENT St_disa_umschalt.B_evnnumsch "Bedingung DISA umschaltung bereit" UBYTE _CNV_S_2_Def_bit_ub_563_CM 1 100. 0. 1. DISPLAY_IDENTIFIER B_EVNNUMSCH ECU_ADDRESS 0xd000d38f BIT_MASK 0x2 /end MEASUREMENT
/begin MEASUREMENT St_drdiag "Statuswort" UBYTE _CNV_R_R_Def_dez_sl_551_CM 1 100. 0. 255. DISPLAY_IDENTIFIER ST_DRDIAG ECU_ADDRESS 0xc0000800 FORMAT "%3.0" /end MEASUREMENT
/begin MEASUREMENT St_drdiag.B_drdiag_akt "B_drdiag_akt" UBYTE _CNV_S_2_Def_bit_ub_563_CM 1 100. 0. 1. DISPLAY_IDENTIFIER B_DRDIAG_AKT ECU_ADDRESS 0xc0000800 BIT_MASK 0x1 /end MEASUREMENT
/begin MEASUREMENT St_drdiag.B_drdiag_vst "B_drdiag_vst" UBYTE _CNV_S_2_Def_bit_ub_563_CM 1 100. 0. 1. DISPLAY_IDENTIFIER B_DRDIAG_VST ECU_ADDRESS 0xc0000800 BIT_MASK 0x2 /end MEASUREMENT
/begin MEASUREMENT St_drdiag.B_drdiag_vst_old "B_drdiag_vst_old" UBYTE _CNV_S_2_Def_bit_ub_563_CM 1 100. 0. 1. DISPLAY_IDENTIFIER B_DRDIAG_VST_OLD ECU_ADDRESS 0xc0000800 BIT_MASK 0x4 /end MEASUREMENT
/begin MEASUREMENT St_drdiag.B_psabs_pl "B_psabs_pl" UBYTE _CNV_S_2_Def_bit_ub_563_CM 1 100. 0. 1. DISPLAY_IDENTIFIER B_PSABS_PL ECU_ADDRESS 0xc0000800 BIT_MASK 0x10 /end MEASUREMENT
/begin MEASUREMENT St_drdiag.B_pvdkds_pl "B_pvdkds_pl" UBYTE _CNV_S_2_Def_bit_ub_563_CM 1 100. 0. 1. DISPLAY_IDENTIFIER B_PVDKDS_PL ECU_ADDRESS 0xc0000800 BIT_MASK 0x8 /end MEASUREMENT
/begin MEASUREMENT St_drdiag_nv "Statuswort Eisy_diag Diff-Drucksensor Diagnose NvRAM" UBYTE _CNV_R_R_Def_dez_sl_551_CM 1 100. 0. 255. DISPLAY_IDENTIFIER ST_DRDIAG_NV ECU_ADDRESS 0xc0004374 FORMAT "%3.0" /end MEASUREMENT
/begin MEASUREMENT St_drdiag_nv.B_psabs_npl "Ps_abs-Sensor nicht plausibel" UBYTE _CNV_S_2_Def_bit_ub_563_CM 1 100. 0. 1. DISPLAY_IDENTIFIER B_PSABS_NPL ECU_ADDRESS 0xc0004374 BIT_MASK 0x4 /end MEASUREMENT
/begin MEASUREMENT St_drdiag_nv.B_pu_npl "Pu-Sensor nicht plausibel" UBYTE _CNV_S_2_Def_bit_ub_563_CM 1 100. 0. 1. DISPLAY_IDENTIFIER B_PU_NPL ECU_ADDRESS 0xc0004374 BIT_MASK 0x1 /end MEASUREMENT
/begin MEASUREMENT St_drdiag_nv.B_pvdkds_npl "Pvdks-Sensor nicht plausibel" UBYTE _CNV_S_2_Def_bit_ub_563_CM 1 100. 0. 1. DISPLAY_IDENTIFIER B_PVDKDS_NPL ECU_ADDRESS 0xc0004374 BIT_MASK 0x2 /end MEASUREMENT
/begin MEASUREMENT St_eisy_psreg "Statuswort" UBYTE _CNV_R_R_Def_dez_sl_551_CM 1 100. 0. 255. DISPLAY_IDENTIFIER ST_EISY_PSREG ECU_ADDRESS 0xd000d5d8 FORMAT "%3.0" /end MEASUREMENT
/begin MEASUREMENT St_eisy_psreg.B_pddssmn "Bedingung Adaption Differenzdruck auf unterer Schwelle" UBYTE _CNV_S_2_Def_bit_ub_563_CM 1 100. 0. 1. DISPLAY_IDENTIFIER B_PDDSSMN ECU_ADDRESS 0xd000d5d8 BIT_MASK 0x1 /end MEASUREMENT
/begin MEASUREMENT St_eisy_psreg.B_pddssmx "Bedingung Adaption Differenzdruck auf oberer Schwelle" UBYTE _CNV_S_2_Def_bit_ub_563_CM 1 100. 0. 1. DISPLAY_IDENTIFIER B_PDDSSMX ECU_ADDRESS 0xd000d5d8 BIT_MASK 0x2 /end MEASUREMENT
/begin MEASUREMENT St_eisy_psreg.B_psreg_akt "Bedingung Druckregler freigegeben" UBYTE _CNV_S_2_Def_bit_ub_563_CM 1 100. 0. 1. DISPLAY_IDENTIFIER B_PSREG_AKT ECU_ADDRESS 0xd000d5d8 BIT_MASK 0x8 /end MEASUREMENT
/begin MEASUREMENT St_eisy_psreg.B_psreg_off "Bedingung Druckregler ausgeschalten" UBYTE _CNV_S_2_Def_bit_ub_563_CM 1 100. 0. 1. DISPLAY_IDENTIFIER B_PSREG_OFF ECU_ADDRESS 0xd000d5d8 BIT_MASK 0x4 /end MEASUREMENT
/begin MEASUREMENT St_eisyad_read "" UBYTE _CNV_R_R_Def_dez_sl_551_CM 1 100. 0. 255. DISPLAY_IDENTIFIER ST_EISYAD_READ ECU_ADDRESS 0xc0004108 FORMAT "%3.0" /end MEASUREMENT
/begin MEASUREMENT St_eisyad_read.B_maregdk_ad "Adaption Massenstromregler auf DK erstmalig erfolgt" UBYTE _CNV_S_2_Def_bit_ub_563_CM 1 100. 0. 1. DISPLAY_IDENTIFIER B_MAREGDK_AD ECU_ADDRESS 0xc0004108 BIT_MASK 0x4 /end MEASUREMENT
/begin MEASUREMENT St_eisyad_read.B_psrhub_ad "Adaption Druckregler auf Hub erstmalig erfolgt" UBYTE _CNV_S_2_Def_bit_ub_563_CM 1 100. 0. 1. DISPLAY_IDENTIFIER B_PSRHUB_AD ECU_ADDRESS 0xc0004108 BIT_MASK 0x1 /end MEASUREMENT
/begin MEASUREMENT St_eisyd_rbm "Statuswort" UBYTE _CNV_R_R_Def_dez_sl_551_CM 1 100. 0. 255. DISPLAY_IDENTIFIER ST_EISYD_RBM ECU_ADDRESS 0xd000d68a FORMAT "%3.0" /end MEASUREMENT
/begin MEASUREMENT St_eisyd_rbm.B_eisyd_rbmsc "Eisy-Diag RBM-Special Condition Bit gesetzt" UBYTE _CNV_S_2_Def_bit_ub_563_CM 1 100. 0. 1. DISPLAY_IDENTIFIER B_EISYD_RBMSC ECU_ADDRESS 0xd000d68a BIT_MASK 0x20 /end MEASUREMENT
/begin MEASUREMENT St_eisyd_rbm.B_pend_allg "Globales Pending Bit" UBYTE _CNV_S_2_Def_bit_ub_563_CM 1 100. 0. 1. DISPLAY_IDENTIFIER B_PEND_ALLG ECU_ADDRESS 0xd000d68a BIT_MASK 0x1 /end MEASUREMENT
/begin MEASUREMENT St_eisyd_rbm.B_pend_dpsr "DPSR Pending Bit" UBYTE _CNV_S_2_Def_bit_ub_563_CM 1 100. 0. 1. DISPLAY_IDENTIFIER B_PEND_DPSR ECU_ADDRESS 0xd000d68a BIT_MASK 0x4 /end MEASUREMENT
/begin MEASUREMENT St_eisyd_rbm.B_pend_hfm "HFM Pending Bit" UBYTE _CNV_S_2_Def_bit_ub_563_CM 1 100. 0. 1. DISPLAY_IDENTIFIER B_PEND_HFM ECU_ADDRESS 0xd000d68a BIT_MASK 0x2 /end MEASUREMENT
/begin MEASUREMENT St_eisyd_rbm.B_rbmcompl_dpsr "DPSR Diag completed Bit" UBYTE _CNV_S_2_Def_bit_ub_563_CM 1 100. 0. 1. DISPLAY_IDENTIFIER B_RBMCOMPL_DPSR ECU_ADDRESS 0xd000d68a BIT_MASK 0x8 /end MEASUREMENT
/begin MEASUREMENT St_eisyd_rbm.B_rbmcompl_hfm "HFM Diag completed Bit" UBYTE _CNV_S_2_Def_bit_ub_563_CM 1 100. 0. 1. DISPLAY_IDENTIFIER B_RBMCOMPL_HFM ECU_ADDRESS 0xd000d68a BIT_MASK 0x10 /end MEASUREMENT
/begin MEASUREMENT St_eisydiag1 "Statuswort" UBYTE _CNV_R_R_Def_dez_sl_551_CM 1 100. 0. 255. DISPLAY_IDENTIFIER ST_EISYDIAG1 ECU_ADDRESS 0xc0000801 FORMAT "%3.0" /end MEASUREMENT
/begin MEASUREMENT St_eisydiag1.B_disa_diag "Freigabe Disa-Diagnose" UBYTE _CNV_S_2_Def_bit_ub_563_CM 1 100. 0. 1. DISPLAY_IDENTIFIER B_DISA_DIAG ECU_ADDRESS 0xc0000801 BIT_MASK 0x2 /end MEASUREMENT
/begin MEASUREMENT St_eisydiag1.B_dpsr_diag "Freigabe Dpsr-Diagnose" UBYTE _CNV_S_2_Def_bit_ub_563_CM 1 100. 0. 1. DISPLAY_IDENTIFIER B_DPSR_DIAG ECU_ADDRESS 0xc0000801 BIT_MASK 0x4 /end MEASUREMENT
/begin MEASUREMENT St_eisydiag1.B_eisy_diag "Freigabe Eisy-Diagnose (Globales Freigabe-Bit)" UBYTE _CNV_S_2_Def_bit_ub_563_CM 1 100. 0. 1. DISPLAY_IDENTIFIER B_EISY_DIAG ECU_ADDRESS 0xc0000801 BIT_MASK 0x20 /end MEASUREMENT
/begin MEASUREMENT St_eisydiag1.B_eisyd_on "B_eisyd_on" UBYTE _CNV_S_2_Def_bit_ub_563_CM 1 100. 0. 1. DISPLAY_IDENTIFIER B_EISYD_ON ECU_ADDRESS 0xc0000801 BIT_MASK 0x80 /end MEASUREMENT
/begin MEASUREMENT St_eisydiag1.B_hfm_diag "Freigabe Eisy-Diag" UBYTE _CNV_S_2_Def_bit_ub_563_CM 1 100. 0. 1. DISPLAY_IDENTIFIER B_HFM_DIAG ECU_ADDRESS 0xc0000801 BIT_MASK 0x1 /end MEASUREMENT
/begin MEASUREMENT St_eisydiag1.B_mslam2_diag "Freigabe Mslam2-Diagnose" UBYTE _CNV_S_2_Def_bit_ub_563_CM 1 100. 0. 1. DISPLAY_IDENTIFIER B_MSLAM2_DIAG ECU_ADDRESS 0xc0000801 BIT_MASK 0x10 /end MEASUREMENT
/begin MEASUREMENT St_eisydiag1.B_mslam_diag "Freigabe Mslam-Diagnose" UBYTE _CNV_S_2_Def_bit_ub_563_CM 1 100. 0. 1. DISPLAY_IDENTIFIER B_MSLAM_DIAG ECU_ADDRESS 0xc0000801 BIT_MASK 0x8 /end MEASUREMENT
/begin MEASUREMENT St_eisydiag1.B_mszyldiag_mod "=1: Mszyl_diag wird mit Ps berechnet, sonst mit Ps_ist" UBYTE _CNV_S_2_Def_bit_ub_563_CM 1 100. 0. 1. DISPLAY_IDENTIFIER B_MSZYLDIAG_MOD ECU_ADDRESS 0xc0000801 BIT_MASK 0x40 /end MEASUREMENT
/begin MEASUREMENT St_eisydiag2 "Statuswort" UBYTE _CNV_R_R_Def_dez_sl_551_CM 1 100. 0. 255. DISPLAY_IDENTIFIER ST_EISYDIAG2 ECU_ADDRESS 0xc0000802 FORMAT "%3.0" /end MEASUREMENT
/begin MEASUREMENT St_eisydiag2.B_npl_mshfm "Statuswort" UBYTE _CNV_S_2_Def_bit_ub_563_CM 1 100. 0. 1. DISPLAY_IDENTIFIER B_NPL_MSHFM ECU_ADDRESS 0xc0000802 BIT_MASK 0x10 /end MEASUREMENT
/begin MEASUREMENT St_eisydiag2.B_nplhfm_mn "Statuswort" UBYTE _CNV_S_2_Def_bit_ub_563_CM 1 100. 0. 1. DISPLAY_IDENTIFIER B_NPLHFM_MN ECU_ADDRESS 0xc0000802 BIT_MASK 0x20 /end MEASUREMENT
/begin MEASUREMENT St_eisydiag2.B_nplhfm_mx "Statuswort" UBYTE _CNV_S_2_Def_bit_ub_563_CM 1 100. 0. 1. DISPLAY_IDENTIFIER B_NPLHFM_MX ECU_ADDRESS 0xc0000802 BIT_MASK 0x40 /end MEASUREMENT
/begin MEASUREMENT St_eisydiag2.B_nplmslam2_mn "Statuswort" UBYTE _CNV_S_2_Def_bit_ub_563_CM 1 100. 0. 1. DISPLAY_IDENTIFIER B_NPLMSLAM2_MN ECU_ADDRESS 0xc0000802 BIT_MASK 0x4 /end MEASUREMENT
/begin MEASUREMENT St_eisydiag2.B_nplmslam2_mx "Statuswort" UBYTE _CNV_S_2_Def_bit_ub_563_CM 1 100. 0. 1. DISPLAY_IDENTIFIER B_NPLMSLAM2_MX ECU_ADDRESS 0xc0000802 BIT_MASK 0x8 /end MEASUREMENT
/begin MEASUREMENT St_eisydiag2.B_nplmslam_mn "Statuswort" UBYTE _CNV_S_2_Def_bit_ub_563_CM 1 100. 0. 1. DISPLAY_IDENTIFIER B_NPLMSLAM_MN ECU_ADDRESS 0xc0000802 BIT_MASK 0x1 /end MEASUREMENT
/begin MEASUREMENT St_eisydiag2.B_nplmslam_mx "Statuswort" UBYTE _CNV_S_2_Def_bit_ub_563_CM 1 100. 0. 1. DISPLAY_IDENTIFIER B_NPLMSLAM_MX ECU_ADDRESS 0xc0000802 BIT_MASK 0x2 /end MEASUREMENT
/begin MEASUREMENT St_eisydiag3 "Statuswort" UBYTE _CNV_R_R_Def_dez_sl_551_CM 1 100. 0. 255. DISPLAY_IDENTIFIER ST_EISYDIAG3 ECU_ADDRESS 0xc0000803 FORMAT "%3.0" /end MEASUREMENT
/begin MEASUREMENT St_eisydiag3.B_agr_diag "AGR-Diagnose aktiv" UBYTE _CNV_S_2_Def_bit_ub_563_CM 1 100. 0. 1. DISPLAY_IDENTIFIER B_AGR_DIAG ECU_ADDRESS 0xc0000803 BIT_MASK 0x80 /end MEASUREMENT
/begin MEASUREMENT St_eisydiag3.B_dpsrdiag_allg "Freigabebedingung für DPSR/AGR-Diagnose" UBYTE _CNV_S_2_Def_bit_ub_563_CM 1 100. 0. 1. DISPLAY_IDENTIFIER B_DPSRDIAG_ALLG ECU_ADDRESS 0xc0000803 BIT_MASK 0x40 /end MEASUREMENT
/begin MEASUREMENT St_eisydiag3.B_npl_agr "Statuswort" UBYTE _CNV_S_2_Def_bit_ub_563_CM 1 100. 0. 1. DISPLAY_IDENTIFIER B_NPL_AGR ECU_ADDRESS 0xc0000803 BIT_MASK 0x8 /end MEASUREMENT
/begin MEASUREMENT St_eisydiag3.B_npl_dpsr "Statuswort" UBYTE _CNV_S_2_Def_bit_ub_563_CM 1 100. 0. 1. DISPLAY_IDENTIFIER B_NPL_DPSR ECU_ADDRESS 0xc0000803 BIT_MASK 0x1 /end MEASUREMENT
/begin MEASUREMENT St_eisydiag3.B_nplagr_mn "Statuswort" UBYTE _CNV_S_2_Def_bit_ub_563_CM 1 100. 0. 1. DISPLAY_IDENTIFIER B_NPLAGR_MN ECU_ADDRESS 0xc0000803 BIT_MASK 0x10 /end MEASUREMENT
/begin MEASUREMENT St_eisydiag3.B_nplagr_mx "Statuswort" UBYTE _CNV_S_2_Def_bit_ub_563_CM 1 100. 0. 1. DISPLAY_IDENTIFIER B_NPLAGR_MX ECU_ADDRESS 0xc0000803 BIT_MASK 0x20 /end MEASUREMENT
/begin MEASUREMENT St_eisydiag3.B_npldpsr_mn "Statuswort" UBYTE _CNV_S_2_Def_bit_ub_563_CM 1 100. 0. 1. DISPLAY_IDENTIFIER B_NPLDPSR_MN ECU_ADDRESS 0xc0000803 BIT_MASK 0x2 /end MEASUREMENT
/begin MEASUREMENT St_eisydiag3.B_npldpsr_mx "Statuswort" UBYTE _CNV_S_2_Def_bit_ub_563_CM 1 100. 0. 1. DISPLAY_IDENTIFIER B_NPLDPSR_MX ECU_ADDRESS 0xc0000803 BIT_MASK 0x4 /end MEASUREMENT
/begin MEASUREMENT St_eisydiag4 "Statuswort" UBYTE _CNV_R_R_Def_dez_sl_551_CM 1 100. 0. 255. DISPLAY_IDENTIFIER ST_EISYDIAG4 ECU_ADDRESS 0xd000d688 FORMAT "%3.0" /end MEASUREMENT
/begin MEASUREMENT St_eisydiag4.B_disad_b1 "Statuswort" UBYTE _CNV_S_2_Def_bit_ub_563_CM 1 100. 0. 1. DISPLAY_IDENTIFIER B_DISAD_B1 ECU_ADDRESS 0xd000d688 BIT_MASK 0x2 /end MEASUREMENT
/begin MEASUREMENT St_eisydiag4.B_disad_b2 "Statuswort" UBYTE _CNV_S_2_Def_bit_ub_563_CM 1 100. 0. 1. DISPLAY_IDENTIFIER B_DISAD_B2 ECU_ADDRESS 0xd000d688 BIT_MASK 0x4 /end MEASUREMENT
/begin MEASUREMENT St_eisydiag4.B_disad_b3 "Statuswort" UBYTE _CNV_S_2_Def_bit_ub_563_CM 1 100. 0. 1. DISPLAY_IDENTIFIER B_DISAD_B3 ECU_ADDRESS 0xd000d688 BIT_MASK 0x8 /end MEASUREMENT
/begin MEASUREMENT St_eisydiag4.B_disad_b4 "Statuswort" UBYTE _CNV_S_2_Def_bit_ub_563_CM 1 100. 0. 1. DISPLAY_IDENTIFIER B_DISAD_B4 ECU_ADDRESS 0xd000d688 BIT_MASK 0x10 /end MEASUREMENT
/begin MEASUREMENT St_eisydiag4.B_dpsr_puls "Statuswort" UBYTE _CNV_S_2_Def_bit_ub_563_CM 1 100. 0. 1. DISPLAY_IDENTIFIER B_DPSR_PULS ECU_ADDRESS 0xd000d688 BIT_MASK 0x20 /end MEASUREMENT
/begin MEASUREMENT St_eisydiag4.B_npl_disa "Statuswort" UBYTE _CNV_S_2_Def_bit_ub_563_CM 1 100. 0. 1. DISPLAY_IDENTIFIER B_NPL_DISA ECU_ADDRESS 0xd000d688 BIT_MASK 0x1 /end MEASUREMENT
/begin MEASUREMENT St_eisydiag5 "Statuswort" UBYTE _CNV_R_R_Def_dez_sl_551_CM 1 100. 0. 255. DISPLAY_IDENTIFIER ST_EISYDIAG5 ECU_ADDRESS 0xd000d689 FORMAT "%3.0" /end MEASUREMENT
/begin MEASUREMENT St_eisydiag5.B_disab1_f "Disa Fehler in Bereich 1" UBYTE _CNV_S_2_Def_bit_ub_563_CM 1 100. 0. 1. DISPLAY_IDENTIFIER B_DISAB1_F ECU_ADDRESS 0xd000d689 BIT_MASK 0x1 /end MEASUREMENT
/begin MEASUREMENT St_eisydiag5.B_disab2_f "Disa Fehler in Bereich 2" UBYTE _CNV_S_2_Def_bit_ub_563_CM 1 100. 0. 1. DISPLAY_IDENTIFIER B_DISAB2_F ECU_ADDRESS 0xd000d689 BIT_MASK 0x2 /end MEASUREMENT
/begin MEASUREMENT St_eisydiag5.B_disab3_f "Disa Fehler in Bereich 3" UBYTE _CNV_S_2_Def_bit_ub_563_CM 1 100. 0. 1. DISPLAY_IDENTIFIER B_DISAB3_F ECU_ADDRESS 0xd000d689 BIT_MASK 0x4 /end MEASUREMENT
/begin MEASUREMENT St_eisydiag5.B_disab4_f "Disa Fehler in Bereich 4" UBYTE _CNV_S_2_Def_bit_ub_563_CM 1 100. 0. 1. DISPLAY_IDENTIFIER B_DISAB4_F ECU_ADDRESS 0xd000d689 BIT_MASK 0x8 /end MEASUREMENT
/begin MEASUREMENT St_eisydrabgl "Statuswort" UWORD _CNV_R_R_Def_dez_sl_551_CM 1 100. 0. 65535. DISPLAY_IDENTIFIER ST_EISYDRABGL ECU_ADDRESS 0xc000081a FORMAT "%5.0" /end MEASUREMENT
/begin MEASUREMENT St_eisydrabgl.B_drdiag_errll "Statuswort" UWORD _CNV_S_2_Def_bit_ub_563_CM 1 100. 0. 1. DISPLAY_IDENTIFIER B_DRDIAG_ERRLL ECU_ADDRESS 0xc000081a BIT_MASK 0x2 /end MEASUREMENT
/begin MEASUREMENT St_eisydrabgl.B_drdiag_errvl "Statuswort" UWORD _CNV_S_2_Def_bit_ub_563_CM 1 100. 0. 1. DISPLAY_IDENTIFIER B_DRDIAG_ERRVL ECU_ADDRESS 0xc000081a BIT_MASK 0x8 /end MEASUREMENT
/begin MEASUREMENT St_eisydrabgl.B_drdiagll "Statuswort" UWORD _CNV_S_2_Def_bit_ub_563_CM 1 100. 0. 1. DISPLAY_IDENTIFIER B_DRDIAGLL ECU_ADDRESS 0xc000081a BIT_MASK 0x800 /end MEASUREMENT
/begin MEASUREMENT St_eisydrabgl.B_drdiagll_done "Statuswort" UWORD _CNV_S_2_Def_bit_ub_563_CM 1 100. 0. 1. DISPLAY_IDENTIFIER B_DRDIAGLL_DONE ECU_ADDRESS 0xc000081a BIT_MASK 0x4 /end MEASUREMENT
/begin MEASUREMENT St_eisydrabgl.B_drdiagvl "Statuswort" UWORD _CNV_S_2_Def_bit_ub_563_CM 1 100. 0. 1. DISPLAY_IDENTIFIER B_DRDIAGVL ECU_ADDRESS 0xc000081a BIT_MASK 0x1000 /end MEASUREMENT
/begin MEASUREMENT St_eisydrabgl.B_drdiagvl_done "Statuswort" UWORD _CNV_S_2_Def_bit_ub_563_CM 1 100. 0. 1. DISPLAY_IDENTIFIER B_DRDIAGVL_DONE ECU_ADDRESS 0xc000081a BIT_MASK 0x10 /end MEASUREMENT
/begin MEASUREMENT St_eisydrabgl.B_drdiagvst "Statuswort" UWORD _CNV_S_2_Def_bit_ub_563_CM 1 100. 0. 1. DISPLAY_IDENTIFIER B_DRDIAGVST ECU_ADDRESS 0xc000081a BIT_MASK 0x1 /end MEASUREMENT
/begin MEASUREMENT St_eisydrabgl.B_psabspu_npl "Statuswort" UWORD _CNV_S_2_Def_bit_ub_563_CM 1 100. 0. 1. DISPLAY_IDENTIFIER B_PSABSPU_NPL ECU_ADDRESS 0xc000081a BIT_MASK 0x80 /end MEASUREMENT
/begin MEASUREMENT St_eisydrabgl.B_pvdkdsps_npl "Statuswort" UWORD _CNV_S_2_Def_bit_ub_563_CM 1 100. 0. 1. DISPLAY_IDENTIFIER B_PVDKDSPS_NPL ECU_ADDRESS 0xc000081a BIT_MASK 0x40 /end MEASUREMENT
/begin MEASUREMENT St_eisydrabgl.B_pvdkdspu_npl "Statuswort" UWORD _CNV_S_2_Def_bit_ub_563_CM 1 100. 0. 1. DISPLAY_IDENTIFIER B_PVDKDSPU_NPL ECU_ADDRESS 0xc000081a BIT_MASK 0x20 /end MEASUREMENT
/begin MEASUREMENT St_eisydyn "Statuswort" UBYTE _CNV_R_R_Def_dez_sl_551_CM 1 100. 0. 255. DISPLAY_IDENTIFIER ST_EISYDYN ECU_ADDRESS 0xc0000866 FORMAT "%3.0" /end MEASUREMENT
/begin MEASUREMENT St_eisydyn.B_eisyd_stat "Dynamik für Diagnsoe Eisy erkannt" UBYTE _CNV_S_2_Def_bit_ub_563_CM 1 100. 0. 1. DISPLAY_IDENTIFIER B_EISYD_STAT ECU_ADDRESS 0xc0000866 BIT_MASK 0x1 /end MEASUREMENT
/begin MEASUREMENT St_eisydyn.B_eisyd_statn "Drehzaldynamik für Diagnose Eisy erkannt" UBYTE _CNV_S_2_Def_bit_ub_563_CM 1 100. 0. 1. DISPLAY_IDENTIFIER B_EISYD_STATN ECU_ADDRESS 0xc0000866 BIT_MASK 0x4 /end MEASUREMENT
/begin MEASUREMENT St_eisydyn.B_eisyd_statrf "Lastdynamik für Diagnose Eisy erkannt" UBYTE _CNV_S_2_Def_bit_ub_563_CM 1 100. 0. 1. DISPLAY_IDENTIFIER B_EISYD_STATRF ECU_ADDRESS 0xc0000866 BIT_MASK 0x8 /end MEASUREMENT
/begin MEASUREMENT St_eisydyn.B_eisyd_stattmp "Dynamik für Diagnose Eisy erkannt temporär" UBYTE _CNV_S_2_Def_bit_ub_563_CM 1 100. 0. 1. DISPLAY_IDENTIFIER B_EISYD_STATTMP ECU_ADDRESS 0xc0000866 BIT_MASK 0x2 /end MEASUREMENT
/begin MEASUREMENT St_eisysr_i "Statuswort Eisy_sr" UBYTE _CNV_R_R_Def_dez_sl_551_CM 1 100. 0. 255. DISPLAY_IDENTIFIER ST_EISYSR_I ECU_ADDRESS 0xd000d642 FORMAT "%3.0" ARRAY_SIZE 2 MATRIX_DIM 2 1 1 /end MEASUREMENT
/begin MEASUREMENT St_mareg "Statusbyte EISY_MR" UBYTE _CNV_R_R_Def_dez_sl_551_CM 1 100. 0. 255. DISPLAY_IDENTIFIER ST_MAREG ECU_ADDRESS 0xd000d4cd FORMAT "%3.0" /end MEASUREMENT
/begin MEASUREMENT St_mareg.B_maregaddk "Bedingung Adaption aus DK-NN lesen" UBYTE _CNV_S_2_Def_bit_ub_563_CM 1 100. 0. 1. DISPLAY_IDENTIFIER B_MAREGADDK ECU_ADDRESS 0xd000d4cd BIT_MASK 0x80 /end MEASUREMENT
/begin MEASUREMENT St_mareg.B_maregadvvt "Bedingung Adaption aus VVT-NN lesen" UBYTE _CNV_S_2_Def_bit_ub_563_CM 1 100. 0. 1. DISPLAY_IDENTIFIER B_MAREGADVVT ECU_ADDRESS 0xd000d4cd BIT_MASK 0x40 /end MEASUREMENT
/begin MEASUREMENT St_mareg.B_mareghub1 "Bedingung Regler Hub freigegeben" UBYTE _CNV_S_2_Def_bit_ub_563_CM 1 100. 0. 1. DISPLAY_IDENTIFIER B_MAREGHUB1 ECU_ADDRESS 0xd000d4cd BIT_MASK 0x1 /end MEASUREMENT
/begin MEASUREMENT St_mareg.B_mareghub2 "Bedingung KNN Hub freigegeben" UBYTE _CNV_S_2_Def_bit_ub_563_CM 1 100. 0. 1. DISPLAY_IDENTIFIER B_MAREGHUB2 ECU_ADDRESS 0xd000d4cd BIT_MASK 0x2 /end MEASUREMENT
/begin MEASUREMENT St_mareg_lim "Statusbyte EISY_MR Limitierung" UBYTE _CNV_R_R_Def_dez_sl_551_CM 1 100. 0. 255. DISPLAY_IDENTIFIER ST_MAREG_LIM ECU_ADDRESS 0xd000d4ee FORMAT "%3.0" /end MEASUREMENT
/begin MEASUREMENT St_mareg_lim.B_mareg_vvtmn "Bedingung KNN Hub MIN" UBYTE _CNV_S_2_Def_bit_ub_563_CM 1 100. 0. 1. DISPLAY_IDENTIFIER B_MAREG_VVTMN ECU_ADDRESS 0xd000d4ee BIT_MASK 0x1 /end MEASUREMENT
/begin MEASUREMENT St_mareg_lim.B_mareg_vvtmx "Bedingung KNN Hub MAX" UBYTE _CNV_S_2_Def_bit_ub_563_CM 1 100. 0. 1. DISPLAY_IDENTIFIER B_MAREG_VVTMX ECU_ADDRESS 0xd000d4ee BIT_MASK 0x2 /end MEASUREMENT
/begin MEASUREMENT St_modab "Statusbyte MODAB regler" UBYTE _CNV_R_R_Def_dez_sl_551_CM 1 100. 0. 255. DISPLAY_IDENTIFIER ST_MODAB ECU_ADDRESS 0xd000d4c2 FORMAT "%3.0" /end MEASUREMENT
/begin MEASUREMENT St_modab.B_eisy_clrad "Statusbyte MODAB regler" UBYTE _CNV_S_2_Def_bit_ub_563_CM 1 100. 0. 1. DISPLAY_IDENTIFIER B_EISY_CLRAD ECU_ADDRESS 0xd000d4c2 BIT_MASK 0x40 /end MEASUREMENT
/begin MEASUREMENT St_modab.B_llk_mr "Statusbyte MODAB regler" UBYTE _CNV_S_2_Def_bit_ub_563_CM 1 100. 0. 1. DISPLAY_IDENTIFIER B_LLK_MR ECU_ADDRESS 0xd000d4c2 BIT_MASK 0x20 /end MEASUREMENT
/begin MEASUREMENT St_modab.B_modab_on "MODAB regler aktiviert" UBYTE _CNV_S_2_Def_bit_ub_563_CM 1 100. 0. 1. DISPLAY_IDENTIFIER B_MODAB_ON ECU_ADDRESS 0xd000d4c2 BIT_MASK 0x1 /end MEASUREMENT
/begin MEASUREMENT St_modab.B_modab_zul "MODAB regler zulässig" UBYTE _CNV_S_2_Def_bit_ub_563_CM 1 100. 0. 1. DISPLAY_IDENTIFIER B_MODAB_ZUL ECU_ADDRESS 0xd000d4c2 BIT_MASK 0x2 /end MEASUREMENT
/begin MEASUREMENT St_modab.B_startende_verz "Statusbyte MODAB regler" UBYTE _CNV_S_2_Def_bit_ub_563_CM 1 100. 0. 1. DISPLAY_IDENTIFIER B_STARTENDE_VERZ ECU_ADDRESS 0xd000d4c2 BIT_MASK 0x80 /end MEASUREMENT
/begin MEASUREMENT St_modab.B_timsallv "Statusbyte MODAB regler" UBYTE _CNV_S_2_Def_bit_ub_563_CM 1 100. 0. 1. DISPLAY_IDENTIFIER B_TIMSALLV ECU_ADDRESS 0xd000d4c2 BIT_MASK 0x10 /end MEASUREMENT
/begin MEASUREMENT St_modab.B_timsavvt "Statusbyte MODAB regler" UBYTE _CNV_S_2_Def_bit_ub_563_CM 1 100. 0. 1. DISPLAY_IDENTIFIER B_TIMSAVVT ECU_ADDRESS 0xd000d4c2 BIT_MASK 0x8 /end MEASUREMENT
/begin MEASUREMENT St_modab.B_timsvvt "Statusbyte MODAB regler" UBYTE _CNV_S_2_Def_bit_ub_563_CM 1 100. 0. 1. DISPLAY_IDENTIFIER B_TIMSVVT ECU_ADDRESS 0xd000d4c2 BIT_MASK 0x4 /end MEASUREMENT
/begin MEASUREMENT St_modab2 "Statusbyte2 MODAB regler" UBYTE _CNV_R_R_Def_dez_sl_551_CM 1 100. 0. 255. DISPLAY_IDENTIFIER ST_MODAB2 ECU_ADDRESS 0xd000d4c3 FORMAT "%3.0" /end MEASUREMENT
/begin MEASUREMENT St_modab2.B_modab_off "Statusbyte2 MODAB regler" UBYTE _CNV_S_2_Def_bit_ub_563_CM 1 100. 0. 1. DISPLAY_IDENTIFIER B_MODAB_OFF ECU_ADDRESS 0xd000d4c3 BIT_MASK 0x1 /end MEASUREMENT
/begin MEASUREMENT St_modab2.B_modabst_on "Statusbyte2 MODAB regler" UBYTE _CNV_S_2_Def_bit_ub_563_CM 1 100. 0. 1. DISPLAY_IDENTIFIER B_MODABST_ON ECU_ADDRESS 0xd000d4c3 BIT_MASK 0x2 /end MEASUREMENT
/begin MEASUREMENT St_modab2.B_mradonte "Statusbyte2 MODAB regler" UBYTE _CNV_S_2_Def_bit_ub_563_CM 1 100. 0. 1. DISPLAY_IDENTIFIER B_MRADONTE ECU_ADDRESS 0xd000d4c3 BIT_MASK 0x4 /end MEASUREMENT
/begin MEASUREMENT St_mslam "Status MSLAM" UBYTE _CNV_R_R_Def_dez_sl_551_CM 1 100. 0. 255. DISPLAY_IDENTIFIER ST_MSLAM ECU_ADDRESS 0xd000dc5c FORMAT "%3.0" /end MEASUREMENT
/begin MEASUREMENT St_mslam.B_emslam "Status MSLAM" UBYTE _CNV_S_2_Def_bit_ub_563_CM 1 100. 0. 1. DISPLAY_IDENTIFIER B_EMSLAM ECU_ADDRESS 0xd000dc5c BIT_MASK 0x4 /end MEASUREMENT
/begin MEASUREMENT St_mslam.B_emslam2 "Status MSLAM" UBYTE _CNV_S_2_Def_bit_ub_563_CM 1 100. 0. 1. DISPLAY_IDENTIFIER B_EMSLAM2 ECU_ADDRESS 0xd000dc5c BIT_MASK 0x8 /end MEASUREMENT
/begin MEASUREMENT St_mslam.B_emslam2_tmp "Status MSLAM" UBYTE _CNV_S_2_Def_bit_ub_563_CM 1 100. 0. 1. DISPLAY_IDENTIFIER B_EMSLAM2_TMP ECU_ADDRESS 0xd000dc5c BIT_MASK 0x20 /end MEASUREMENT
/begin MEASUREMENT St_mslam.B_emslam_tmp "Status MSLAM" UBYTE _CNV_S_2_Def_bit_ub_563_CM 1 100. 0. 1. DISPLAY_IDENTIFIER B_EMSLAM_TMP ECU_ADDRESS 0xd000dc5c BIT_MASK 0x10 /end MEASUREMENT
/begin MEASUREMENT St_mslam.B_lamsonden_ok "Status MSLAM" UBYTE _CNV_S_2_Def_bit_ub_563_CM 1 100. 0. 1. DISPLAY_IDENTIFIER B_LAMSONDEN_OK ECU_ADDRESS 0xd000dc5c BIT_MASK 0x40 /end MEASUREMENT
/begin MEASUREMENT St_mslam.B_mslam_fg "Status MSLAM" UBYTE _CNV_S_2_Def_bit_ub_563_CM 1 100. 0. 1. DISPLAY_IDENTIFIER B_MSLAM_FG ECU_ADDRESS 0xd000dc5c BIT_MASK 0x80 /end MEASUREMENT
/begin MEASUREMENT St_mslam.B_mslam_on "Status MSLAM" UBYTE _CNV_S_2_Def_bit_ub_563_CM 1 100. 0. 1. DISPLAY_IDENTIFIER B_MSLAM_ON ECU_ADDRESS 0xd000dc5c BIT_MASK 0x2 /end MEASUREMENT
/begin MEASUREMENT St_mslam.B_sa_fe "Status MSLAM" UBYTE _CNV_S_2_Def_bit_ub_563_CM 1 100. 0. 1. DISPLAY_IDENTIFIER B_SA_FE ECU_ADDRESS 0xd000dc5c BIT_MASK 0x1 /end MEASUREMENT
/begin MEASUREMENT St_mslam2 "Status2 MSLAM" UBYTE _CNV_R_R_Def_dez_sl_551_CM 1 100. 0. 255. DISPLAY_IDENTIFIER ST_MSLAM2 ECU_ADDRESS 0xd000dc5d FORMAT "%3.0" /end MEASUREMENT
/begin MEASUREMENT St_mslam2.B_drfsoll_dyn "Rf_soll Dynamik" UBYTE _CNV_S_2_Def_bit_ub_563_CM 1 100. 0. 1. DISPLAY_IDENTIFIER B_DRFSOLL_DYN ECU_ADDRESS 0xd000dc5d BIT_MASK 0x10 /end MEASUREMENT
/begin MEASUREMENT St_mslam2.B_mdarv_latched "Status2 MSLAM" UBYTE _CNV_S_2_Def_bit_ub_563_CM 1 100. 0. 1. DISPLAY_IDENTIFIER B_MDARV_LATCHED ECU_ADDRESS 0xd000dc5d BIT_MASK 0x1 /end MEASUREMENT
/begin MEASUREMENT St_mslam2.B_mslamstp_md "Status2 MSLAM" UBYTE _CNV_S_2_Def_bit_ub_563_CM 1 100. 0. 1. DISPLAY_IDENTIFIER B_MSLAMSTP_MD ECU_ADDRESS 0xd000dc5d BIT_MASK 0x2 /end MEASUREMENT
/begin MEASUREMENT St_mslam2.B_mslamstp_md2 "Status2 MSLAM" UBYTE _CNV_S_2_Def_bit_ub_563_CM 1 100. 0. 1. DISPLAY_IDENTIFIER B_MSLAMSTP_MD2 ECU_ADDRESS 0xd000dc5d BIT_MASK 0x4 /end MEASUREMENT
/begin MEASUREMENT St_mslam2.B_sasmg "Status2 MSLAM" UBYTE _CNV_S_2_Def_bit_ub_563_CM 1 100. 0. 1. DISPLAY_IDENTIFIER B_SASMG ECU_ADDRESS 0xd000dc5d BIT_MASK 0x8 /end MEASUREMENT
/begin MEASUREMENT St_mslam2.B_spuelmslam_off "Status2 MSLAM" UBYTE _CNV_S_2_Def_bit_ub_563_CM 1 100. 0. 1. DISPLAY_IDENTIFIER B_SPUELMSLAM_OFF ECU_ADDRESS 0xd000dc5d BIT_MASK 0x20 /end MEASUREMENT
/begin MEASUREMENT St_wdkdiag "Statuswort" UBYTE _CNV_R_R_Def_dez_sl_551_CM 1 100. 0. 255. DISPLAY_IDENTIFIER ST_WDKDIAG ECU_ADDRESS 0xc0000804 FORMAT "%3.0" /end MEASUREMENT
/begin MEASUREMENT St_wdkdiag.B_wdkdiag_ugd "Statuswort" UBYTE _CNV_S_2_Def_bit_ub_563_CM 1 100. 0. 1. DISPLAY_IDENTIFIER B_WDKDIAG_UGD ECU_ADDRESS 0xc0000804 BIT_MASK 0x2 /end MEASUREMENT
/begin MEASUREMENT Td_mslam "Zeitverzögerung Rk_1 und Rk_2" UBYTE _CNV_R_R_Def_td_ub__717_CM 1 100. 0. 2550. DISPLAY_IDENTIFIER TD_MSLAM ECU_ADDRESS 0xd000dc71 FORMAT "%4.1" /end MEASUREMENT
/begin MEASUREMENT Td_mslampt1 "Zeitkonstante für PT1 Filter für Zeitverzögerung Rk_1 und Rk_2" UWORD _CNV_R_R_Def_zk10ms_715_CM 1 100. 1.e-002 655.36 DISPLAY_IDENTIFIER TD_MSLAMPT1 ECU_ADDRESS 0xd000dc6e FORMAT "%9.4" /end MEASUREMENT
/begin MEASUREMENT Td_mszyl "Zeitverzögerung Rk_1 und Rk_2" UBYTE _CNV_R_R_Def_td_ub__717_CM 1 100. 0. 2550. DISPLAY_IDENTIFIER TD_MSZYL ECU_ADDRESS 0xd000dc6c FORMAT "%4.1" /end MEASUREMENT
/begin MEASUREMENT Td_mszyl_kw "Zeitverzögerung Rk_1 und Rk_2" UBYTE _CNV_R_R_Def_td_ub__717_CM 1 100. 0. 2550. DISPLAY_IDENTIFIER TD_MSZYL_KW ECU_ADDRESS 0xd000dc70 FORMAT "%4.1" /end MEASUREMENT
/begin MEASUREMENT Td_mszylpt1 "Zeitkonstante PT1-Glied" UWORD _CNV_R_R_Def_zk10ms_715_CM 1 100. 1.e-002 655.36 DISPLAY_IDENTIFIER TD_MSZYLPT1 ECU_ADDRESS 0xc0000840 FORMAT "%9.4" /end MEASUREMENT
/begin MEASUREMENT Td_vwl "Zeitverzögerung Wese" UBYTE _CNV_R_R_Def_td_ub__717_CM 1 100. 0. 2550. DISPLAY_IDENTIFIER TD_VWL ECU_ADDRESS 0xd000dc72 FORMAT "%4.1" /end MEASUREMENT
/begin MEASUREMENT Uefl_spuel_i "Überschneidungsfläche, Ueberspuel" UWORD _CNV_R_R_Def_a_uw_q_725_CM 1 100. 0. 1048.56 DISPLAY_IDENTIFIER UEFL_SPUEL_I ECU_ADDRESS 0xd000d39a FORMAT "%8.3" ARRAY_SIZE 2 MATRIX_DIM 2 1 1 /end MEASUREMENT
/begin MEASUREMENT Uefl_uk_i "Überschneidungsfläche, Unterkritisches" UWORD _CNV_R_R_Def_a_uw_q_725_CM 1 100. 0. 1048.56 DISPLAY_IDENTIFIER UEFL_UK_I ECU_ADDRESS 0xd000d396 FORMAT "%8.3" ARRAY_SIZE 2 MATRIX_DIM 2 1 1 /end MEASUREMENT
/begin MEASUREMENT Vsa_spri_i "Mittelwert Auslassspreizung variable NWS, Bank1/2" UWORD _CNV_R_R_Def_spr_sw_561_CM 1 100. 0. 6553.5 DISPLAY_IDENTIFIER VSA_SPRI_I ECU_ADDRESS 0xd000d330 FORMAT "%7.2" ARRAY_SIZE 2 MATRIX_DIM 2 1 1 /end MEASUREMENT
/begin MEASUREMENT Vse_spri_i "Mittelwert Einlassspreizung variable NWS, Bank1/2" UWORD _CNV_R_R_Def_spr_sw_561_CM 1 100. 0. 6553.5 DISPLAY_IDENTIFIER VSE_SPRI_I ECU_ADDRESS 0xd000d32c FORMAT "%7.2" ARRAY_SIZE 2 MATRIX_DIM 2 1 1 /end MEASUREMENT
/begin MEASUREMENT Vvtaus_timer "DK-VVT Adaptionsumschaltungstimer" UBYTE _CNV_R_R_Def_dez_sl_551_CM 1 100. 0. 255. DISPLAY_IDENTIFIER VVTAUS_TIMER ECU_ADDRESS 0xd000d4f9 FORMAT "%3.0" /end MEASUREMENT
/begin MEASUREMENT Wdk_diag "Aus Hauptfüllungssignal berechneter Drosselklappenwinkel" UWORD _CNV_R_R_Def_wdk_sw_683_CM 1 100. 0. 1599.9755 DISPLAY_IDENTIFIER WDK_DIAG ECU_ADDRESS 0xc0000806 FORMAT "%7.2" /end MEASUREMENT
/begin MEASUREMENT Wdk_ug "Drosselklappe winkel UG" UWORD _CNV_R_R_Def_wdk_sw_683_CM 1 100. 0. 1599.9755 DISPLAY_IDENTIFIER WDK_UG ECU_ADDRESS 0xd000d316 FORMAT "%7.2" /end MEASUREMENT
/begin MEASUREMENT Z_norm_dk_i "" FLOAT32_IEEE _CNV_R_R_Def_dez_sl_551_CM 1 100. -1000000000000. 10000000000000. DISPLAY_IDENTIFIER Z_NORM_DK_I ECU_ADDRESS 0xc0000780 FORMAT "%14.7" ARRAY_SIZE 30 MATRIX_DIM 2 15 1 /end MEASUREMENT
/begin MEASUREMENT Zk_diag_mss "Zeitkonstante zur Filterung Diagnoseschwellen Massenstrom" UWORD _CNV_R_R_Def_zk100m_739_CM 1 100. 0.1 6553.6 DISPLAY_IDENTIFIER ZK_DIAG_MSS ECU_ADDRESS 0xc0000862 FORMAT "%6.1" /end MEASUREMENT
/begin MEASUREMENT Zyl_misfire_diag "Status MISFIRE" UBYTE _CNV_R_R_Def_dez_sl_551_CM 1 100. 0. 255. DISPLAY_IDENTIFIER ZYL_MISFIRE_DIAG ECU_ADDRESS 0xd000dc5e FORMAT "%3.0" /end MEASUREMENT
/begin MEASUREMENT w_dknn_N "" FLOAT32_IEEE _CNV_R_R_Def_dez_sl_551_CM 1 100. -1000000000000. 10000000000000. DISPLAY_IDENTIFIER W_DKNN_N ECU_ADDRESS 0xc0004184 FORMAT "%14.7" ARRAY_SIZE 30 MATRIX_DIM 2 15 1 /end MEASUREMENT
/begin MEASUREMENT w_dknn_Vsa_spri_i "" FLOAT32_IEEE _CNV_R_R_Def_dez_sl_551_CM 1 100. -1000000000000. 10000000000000. DISPLAY_IDENTIFIER W_DKNN_VSA_SPRI_I ECU_ADDRESS 0xc0004274 FORMAT "%14.7" ARRAY_SIZE 30 MATRIX_DIM 2 15 1 /end MEASUREMENT
/begin MEASUREMENT w_dknn_Vse_spri_i "" FLOAT32_IEEE _CNV_R_R_Def_dez_sl_551_CM 1 100. -1000000000000. 10000000000000. DISPLAY_IDENTIFIER W_DKNN_VSE_SPRI_I ECU_ADDRESS 0xc00041fc FORMAT "%14.7" ARRAY_SIZE 30 MATRIX_DIM 2 15 1 /end MEASUREMENT
/begin MEASUREMENT w_dknn_Wdk_ist_i "" FLOAT32_IEEE _CNV_R_R_Def_dez_sl_551_CM 1 100. -1000000000000. 10000000000000. DISPLAY_IDENTIFIER W_DKNN_WDK_IST_I ECU_ADDRESS 0xc00042ec FORMAT "%14.7" ARRAY_SIZE 30 MATRIX_DIM 2 15 1 /end MEASUREMENT
/begin MEASUREMENT w_dknn_bias "" FLOAT32_IEEE _CNV_R_R_Def_dez_sl_551_CM 1 100. -1000000000000. 10000000000000. DISPLAY_IDENTIFIER W_DKNN_BIAS ECU_ADDRESS 0xc000410c FORMAT "%14.7" ARRAY_SIZE 30 MATRIX_DIM 2 15 1 /end MEASUREMENT
/begin AXIS_PTS GAX_15MODELLE "Modelle eines LOLIMOT-KNN mit 15 Neuronen (Zähler)" 0xa081f734 NO_INPUT_QUANTITY _REC_AXS_20_u1 255. _CNV_R_R_Def_dez_sl_551_CM 15 0. 255. FORMAT "%3.0" /end AXIS_PTS
/begin AXIS_PTS GAX_6MODELLE "Modelle eines LOLIMOT-KNN mit 6 Neuronen (Zähler)" 0xa081f748 NO_INPUT_QUANTITY _REC_AXS_20_u1 255. _CNV_R_R_Def_dez_sl_551_CM 6 0. 255. FORMAT "%3.0" /end AXIS_PTS
/begin AXIS_PTS GAX_PIRGNN "Neuronen des PIRG NN-MLP" 0xa081ed40 NO_INPUT_QUANTITY _REC_AXS_20_u1 255. _CNV_R_R_Def_dez_sl_551_CM 20 0. 255. FORMAT "%3.0" /end AXIS_PTS
/begin AXIS_PTS GAX_RFVISTNN "Neuronen des RFVISTNN-MLP" 0xa081eb98 NO_INPUT_QUANTITY _REC_AXS_20_u1 255. _CNV_R_R_Def_dez_sl_551_CM 20 0. 255. FORMAT "%3.0" /end AXIS_PTS
/begin CHARACTERISTIC CW_EISYD_RUNTIME "Codewort zur LZ Optimierung" VALUE 0xa081fe6c _REC_VAL_20_u2 0. _CNV_R_R_Def_dez_sl_551_CM 0. 65535. FORMAT "%5.0" /end CHARACTERISTIC
/begin CHARACTERISTIC CW_EISY_DFSPE "Schaltet zwischen ent- und unentprellter FSP-Abfrage um" VALUE 0xa081fe72 _REC_VAL_20_u2 0. _CNV_R_R_Def_dez_sl_551_CM 0. 65535. FORMAT "%5.0" /end CHARACTERISTIC
/begin CHARACTERISTIC CW_EISY_DIAG "Aktiviert Freigabebedingungen Eisy-Diag" VALUE 0xa081fe6e _REC_VAL_20_u2 0. _CNV_R_R_Def_dez_sl_551_CM 0. 65535. FORMAT "%5.0" /end CHARACTERISTIC
/begin CHARACTERISTIC CW_EISY_DRBM "Aktiviert RBM Freigabebedingungen Eisy-Diag" VALUE 0xa081fe70 _REC_VAL_20_u2 0. _CNV_R_R_Def_dez_sl_551_CM 0. 65535. FORMAT "%5.0" /end CHARACTERISTIC
/begin CHARACTERISTIC CW_EISY_TURBO "Turbo Berechnung" VALUE 0xa081ea78 _REC_VAL_20_u1 99.45 _CNV_R_R_Def_dez_sl_551_CM 0. 255. FORMAT "%3.0" /end CHARACTERISTIC
/begin CHARACTERISTIC CW_MDMSLAM_CONFB1 "Configuration, Misfireerkennung, Bank1" VALUE 0xa0826fd4 _REC_VAL_20_u1 99.45 _CNV_R_R_Def_dez_sl_551_CM 0. 255. FORMAT "%3.0" /end CHARACTERISTIC
/begin CHARACTERISTIC CW_MDMSLAM_CONFB2 "Configuration, Misfireerkennung, Bank2" VALUE 0xa0826fd5 _REC_VAL_20_u1 99.45 _CNV_R_R_Def_dez_sl_551_CM 0. 255. FORMAT "%3.0" /end CHARACTERISTIC
/begin CHARACTERISTIC CW_PSRDIAG_OFF "Druckreglersperren bei Fehlerorte" VALUE 0xa081fc2e _REC_VAL_20_u2 0. _CNV_R_R_Def_dez_sl_551_CM 0. 65535. FORMAT "%5.0" /end CHARACTERISTIC
/begin CHARACTERISTIC CW_TZKBLS "(0: F_tvdk) (1: Ftev) (else: Ftbr_kor)" VALUE 0xa081eae4 _REC_VAL_20_u1 99.45 _CNV_R_R_Def_dez_sl_551_CM 0. 255. FORMAT "%3.0" /end CHARACTERISTIC
/begin CHARACTERISTIC CW_TZYLKOR "(0: F_tvdk) (1: Ftev) (else: Ftbr)" VALUE 0xa081eae3 _REC_VAL_20_u1 99.45 _CNV_R_R_Def_dez_sl_551_CM 0. 255. FORMAT "%3.0" /end CHARACTERISTIC
/begin CHARACTERISTIC KF_DIAGDPSRD_O "Obere Diagnose-Schwelle DPSR: Delta zu K_PSREGMN" MAP 0xa0820060 _REC_MAP_52_UBYTE_s2_s2_s2 7.999800000000001 _CNV_R_R_Def_f_sw_b_591_CM -4. 3.9998 FORMAT "%7.4"
 /begin AXIS_DESCR STD_AXIS Nkw _CNV_R_R_Def_n_sw_q_595_CM 4 -32768. 32767. FORMAT "%5.0" /end AXIS_DESCR
 /begin AXIS_DESCR STD_AXIS Rf_soll _CNV_R_R_Def_rf_sw__598_CM 4 -327.68 327.67 FORMAT "%7.4" /end AXIS_DESCR
/end CHARACTERISTIC
/begin CHARACTERISTIC KF_DIAGDPSRD_U "Untere Diagnose-Schwelle DPSR: Delta zu K_PSREGMN" MAP 0xa082002c _REC_MAP_52_UBYTE_s2_s2_s2 7.999800000000001 _CNV_R_R_Def_f_sw_b_591_CM -4. 3.9998 FORMAT "%7.4"
 /begin AXIS_DESCR STD_AXIS Nkw _CNV_R_R_Def_n_sw_q_595_CM 4 -32768. 32767. FORMAT "%5.0" /end AXIS_DESCR
 /begin AXIS_DESCR STD_AXIS Rf_soll _CNV_R_R_Def_rf_sw__598_CM 4 -327.68 327.67 FORMAT "%7.4" /end AXIS_DESCR
/end CHARACTERISTIC
/begin CHARACTERISTIC KF_DIAG_MSO "Maximaler Massenstrom" MAP 0xa081ff5c _REC_MAP_52_UBYTE_u2_s2_s2 1.9999 _CNV_R_R_Def_f_uw_b_590_CM 0. 1.9999 FORMAT "%14.5"
 /begin AXIS_DESCR STD_AXIS Nkw _CNV_R_R_Def_n_sw_q_595_CM 4 -32768. 32767. FORMAT "%5.0" /end AXIS_DESCR
 /begin AXIS_DESCR STD_AXIS Rf_soll _CNV_R_R_Def_rf_sw__598_CM 4 -327.68 327.67 FORMAT "%7.4" /end AXIS_DESCR
/end CHARACTERISTIC
/begin CHARACTERISTIC KF_DIAG_MSO2 "Maximaler Massenstrom" MAP 0xa081ffc4 _REC_MAP_52_UBYTE_u2_s2_s2 1.9999 _CNV_R_R_Def_f_uw_b_590_CM 0. 1.9999 FORMAT "%14.5"
 /begin AXIS_DESCR STD_AXIS Nkw _CNV_R_R_Def_n_sw_q_595_CM 4 -32768. 32767. FORMAT "%5.0" /end AXIS_DESCR
 /begin AXIS_DESCR STD_AXIS Rf_soll _CNV_R_R_Def_rf_sw__598_CM 4 -327.68 327.67 FORMAT "%7.4" /end AXIS_DESCR
/end CHARACTERISTIC
/begin CHARACTERISTIC KF_DIAG_MSU "Minimaler Massenstrom" MAP 0xa081ff28 _REC_MAP_52_UBYTE_u2_s2_s2 1.9999 _CNV_R_R_Def_f_uw_b_590_CM 0. 1.9999 FORMAT "%14.5"
 /begin AXIS_DESCR STD_AXIS Nkw _CNV_R_R_Def_n_sw_q_595_CM 4 -32768. 32767. FORMAT "%5.0" /end AXIS_DESCR
 /begin AXIS_DESCR STD_AXIS Rf_soll _CNV_R_R_Def_rf_sw__598_CM 4 -327.68 327.67 FORMAT "%7.4" /end AXIS_DESCR
/end CHARACTERISTIC
/begin CHARACTERISTIC KF_DIAG_MSU2 "Minimaler Massenstrom" MAP 0xa081ff90 _REC_MAP_52_UBYTE_u2_s2_s2 1.9999 _CNV_R_R_Def_f_uw_b_590_CM 0. 1.9999 FORMAT "%14.5"
 /begin AXIS_DESCR STD_AXIS Nkw _CNV_R_R_Def_n_sw_q_595_CM 4 -32768. 32767. FORMAT "%5.0" /end AXIS_DESCR
 /begin AXIS_DESCR STD_AXIS Rf_soll _CNV_R_R_Def_rf_sw__598_CM 4 -327.68 327.67 FORMAT "%7.4" /end AXIS_DESCR
/end CHARACTERISTIC
/begin CHARACTERISTIC KF_DRFV_SPUEL "Ueberspuel Rf Anteil" MAP 0xa081f494 _REC_MAP_52_UBYTE_s2_u2_s2 98.30250000000001 _CNV_R_R_Def_rf_sw__598_CM -327.68 327.67 FORMAT "%7.4"
 /begin AXIS_DESCR STD_AXIS NO_INPUT_QUANTITY _CNV_R_R_Def_a_uw_q_725_CM 8 0. 1048.56 /end AXIS_DESCR
 /begin AXIS_DESCR STD_AXIS Nkw _CNV_R_R_Def_n_sw_q_595_CM 8 -32768. 32767. FORMAT "%5.0" /end AXIS_DESCR
/end CHARACTERISTIC
/begin CHARACTERISTIC KF_DRFV_UK "Unkritisches Rf Anteil" MAP 0xa081f3f0 _REC_MAP_52_UBYTE_s2_u2_s2 98.30250000000001 _CNV_R_R_Def_rf_sw__598_CM -327.68 327.67 FORMAT "%7.4"
 /begin AXIS_DESCR STD_AXIS NO_INPUT_QUANTITY _CNV_R_R_Def_a_uw_q_725_CM 8 0. 1048.56 /end AXIS_DESCR
 /begin AXIS_DESCR STD_AXIS Nkw _CNV_R_R_Def_n_sw_q_595_CM 8 -32768. 32767. FORMAT "%5.0" /end AXIS_DESCR
/end CHARACTERISTIC
/begin CHARACTERISTIC KF_ETA_TURBO "Kennfeld Turboladerwirkungsgrad" MAP 0xa0820628 _REC_MAP_52_UBYTE_u2_s2_s2 3.9999 _CNV_R_R_Def_f_sw_b_616_CM 0. 3.9999 FORMAT "%14.5"
 /begin AXIS_DESCR STD_AXIS Nkw _CNV_R_R_Def_n_sw_q_595_CM 8 -32768. 32767. FORMAT "%5.0" /end AXIS_DESCR
 /begin AXIS_DESCR STD_AXIS NO_INPUT_QUANTITY _CNV_R_R_Def_rf_sw__598_CM 8 -327.68 327.67 FORMAT "%7.4" /end AXIS_DESCR
/end CHARACTERISTIC
/begin CHARACTERISTIC KF_MAREGDKI "I-Anteil PI-Regler Mareg DK" MAP 0xa081f6cc _REC_MAP_52_UBYTE_u2_s2_s2 1.9999 _CNV_R_R_Def_f_uw_b_590_CM 0. 1.9999 FORMAT "%14.5"
 /begin AXIS_DESCR STD_AXIS Nkw _CNV_R_R_Def_n_sw_q_595_CM 4 -32768. 32767. FORMAT "%5.0" /end AXIS_DESCR
 /begin AXIS_DESCR STD_AXIS Rfv_soll _CNV_R_R_Def_rf_sw__598_CM 4 -327.68 327.67 FORMAT "%7.4" /end AXIS_DESCR
/end CHARACTERISTIC
/begin CHARACTERISTIC KF_MAREGDKI_TE "I-Anteil PI-Regler Mareg DK bei Tankentlüftung" MAP 0xa081f700 _REC_MAP_52_UBYTE_u2_s2_s2 1.9999 _CNV_R_R_Def_f_uw_b_590_CM 0. 1.9999 FORMAT "%14.5"
 /begin AXIS_DESCR STD_AXIS Nkw _CNV_R_R_Def_n_sw_q_595_CM 4 -32768. 32767. FORMAT "%5.0" /end AXIS_DESCR
 /begin AXIS_DESCR STD_AXIS Rfv_soll _CNV_R_R_Def_rf_sw__598_CM 4 -327.68 327.67 FORMAT "%7.4" /end AXIS_DESCR
/end CHARACTERISTIC
/begin CHARACTERISTIC KF_MAREGDKP "P-Anteil PI-Regler Mareg DK" MAP 0xa081f664 _REC_MAP_52_UBYTE_u2_s2_s2 63.99900000000001 _CNV_R_R_Def_f_uw_b_617_CM 0. 63.999 FORMAT "%7.4"
 /begin AXIS_DESCR STD_AXIS Nkw _CNV_R_R_Def_n_sw_q_595_CM 4 -32768. 32767. FORMAT "%5.0" /end AXIS_DESCR
 /begin AXIS_DESCR STD_AXIS Rfv_soll _CNV_R_R_Def_rf_sw__598_CM 4 -327.68 327.67 FORMAT "%7.4" /end AXIS_DESCR
/end CHARACTERISTIC
/begin CHARACTERISTIC KF_MAREGDKP_TE "P-Anteil PI-Regler Mareg DK bei Tankentlüftung" MAP 0xa081f698 _REC_MAP_52_UBYTE_u2_s2_s2 63.99900000000001 _CNV_R_R_Def_f_uw_b_617_CM 0. 63.999 FORMAT "%7.4"
 /begin AXIS_DESCR STD_AXIS Nkw _CNV_R_R_Def_n_sw_q_595_CM 4 -32768. 32767. FORMAT "%5.0" /end AXIS_DESCR
 /begin AXIS_DESCR STD_AXIS Rfv_soll _CNV_R_R_Def_rf_sw__598_CM 4 -327.68 327.67 FORMAT "%7.4" /end AXIS_DESCR
/end CHARACTERISTIC
/begin CHARACTERISTIC KF_MSKOR_NPSP "" MAP 0xa081fab4 _REC_MAP_52_UBYTE_u2_s2_u2 1.9999 _CNV_R_R_Def_f_uw_b_590_CM 0. 1.9999 FORMAT "%14.5"
 /begin AXIS_DESCR STD_AXIS Nkw _CNV_R_R_Def_n_sw_q_595_CM 12 -32768. 32767. FORMAT "%5.0" /end AXIS_DESCR
 /begin AXIS_DESCR STD_AXIS Pspvdk _CNV_R_R_Def_f_uw_b_571_CM 12 0. 0.9999 FORMAT "%14.5" /end AXIS_DESCR
/end CHARACTERISTIC
/begin CHARACTERISTIC KF_MSKOR_NRF "" MAP 0xa081f960 _REC_MAP_52_UBYTE_u2_s2_s2 1.9999 _CNV_R_R_Def_f_uw_b_590_CM 0. 1.9999 FORMAT "%14.5"
 /begin AXIS_DESCR STD_AXIS Nkw _CNV_R_R_Def_n_sw_q_595_CM 12 -32768. 32767. FORMAT "%5.0" /end AXIS_DESCR
 /begin AXIS_DESCR STD_AXIS NO_INPUT_QUANTITY _CNV_R_R_Def_rf_sw__598_CM 12 -327.68 327.67 FORMAT "%7.4" /end AXIS_DESCR
/end CHARACTERISTIC
/begin CHARACTERISTIC KF_MSNDK "Normierter Massenstrom ueber Drosselklappe" MAP 0xa081e974 _REC_MAP_52_UBYTE_u2_s2_s2 81.91875 _CNV_R_R_Def_ms_uw__655_CM 0. 8191.875 FORMAT "%5.2"
 /begin AXIS_DESCR STD_AXIS Wdk_ist _CNV_R_R_Def_wdk_sw_683_CM 16 -800. 799.9755 FORMAT "%5.2" /end AXIS_DESCR
 /begin AXIS_DESCR STD_AXIS Nkw _CNV_R_R_Def_n_sw_q_595_CM 6 -32768. 32767. FORMAT "%5.0" /end AXIS_DESCR
/end CHARACTERISTIC
/begin CHARACTERISTIC KF_NLEV "Sollwert Einlassventilhub im Start" MAP 0xa081ef20 _REC_MAP_52_UBYTE_u2_u2_u2 1.9999 _CNV_R_R_Def_f_uw_b_590_CM 0. 1.9999 FORMAT "%14.5"
 /begin AXIS_DESCR STD_AXIS NO_INPUT_QUANTITY _CNV_R_R_Def_f_uw_b_590_CM 12 0. 1.9999 FORMAT "%14.5" /end AXIS_DESCR
 /begin AXIS_DESCR STD_AXIS Pirg_abgd_i _CNV_R_R_Def_p_sw_q_576_CM 8 0. 2559.9609 FORMAT "%5.2" /end AXIS_DESCR
/end CHARACTERISTIC
/begin CHARACTERISTIC KF_PAKPSOFFS "" MAP 0xa081f0b0 _REC_MAP_52_UBYTE_s2_s2_u2 1.9999 _CNV_R_R_Def_f_uw_b_590_CM -1. 0.9999 FORMAT "%14.5"
 /begin AXIS_DESCR STD_AXIS Nkw _CNV_R_R_Def_n_sw_q_595_CM 8 -32768. 32767. FORMAT "%5.0" /end AXIS_DESCR
 /begin AXIS_DESCR STD_AXIS NO_INPUT_QUANTITY _CNV_R_R_Def_a_uw_q_725_CM 8 0. 1048.56 /end AXIS_DESCR
/end CHARACTERISTIC
/begin CHARACTERISTIC KF_PSPAKOFFS "" MAP 0xa081f00c _REC_MAP_52_UBYTE_s2_s2_u2 1.9999 _CNV_R_R_Def_f_uw_b_590_CM -1. 0.9999 FORMAT "%14.5"
 /begin AXIS_DESCR STD_AXIS Nkw _CNV_R_R_Def_n_sw_q_595_CM 8 -32768. 32767. FORMAT "%5.0" /end AXIS_DESCR
 /begin AXIS_DESCR STD_AXIS NO_INPUT_QUANTITY _CNV_R_R_Def_a_uw_q_725_CM 8 0. 1048.56 /end AXIS_DESCR
/end CHARACTERISTIC
/begin CHARACTERISTIC KF_PSREG_I "Ps regler I-Anteil" MAP 0xa081fd4c _REC_MAP_52_UBYTE_u2_s2_u2 1.9999 _CNV_R_R_Def_f_uw_b_590_CM 0. 1.9999 FORMAT "%14.5"
 /begin AXIS_DESCR STD_AXIS Nkw _CNV_R_R_Def_n_sw_q_595_CM 4 -32768. 32767. FORMAT "%5.0" /end AXIS_DESCR
 /begin AXIS_DESCR STD_AXIS Pspvdk_soll _CNV_R_R_Def_f_sw_b_616_CM 4 0. 3.9999 FORMAT "%14.5" /end AXIS_DESCR
/end CHARACTERISTIC
/begin CHARACTERISTIC KF_PSREG_P "Ps regler P-Anteil" MAP 0xa081fd18 _REC_MAP_52_UBYTE_u2_s2_u2 63.99900000000001 _CNV_R_R_Def_f_uw_b_617_CM 0. 63.999 FORMAT "%7.4"
 /begin AXIS_DESCR STD_AXIS Nkw _CNV_R_R_Def_n_sw_q_595_CM 4 -32768. 32767. FORMAT "%5.0" /end AXIS_DESCR
 /begin AXIS_DESCR STD_AXIS Pspvdk_soll _CNV_R_R_Def_f_sw_b_616_CM 4 0. 3.9999 FORMAT "%14.5" /end AXIS_DESCR
/end CHARACTERISTIC
/begin CHARACTERISTIC KF_PSR_KOR "Korrekturfaktor PSR" MAP 0xa081fc74 _REC_MAP_52_UBYTE_u2_u2_u2 15.9997 _CNV_R_R_Def_f_uw_b_559_CM 0. 15.9997 FORMAT "%7.4"
 /begin AXIS_DESCR STD_AXIS Pspvdk_soll _CNV_R_R_Def_f_sw_b_616_CM 8 0. 3.9999 FORMAT "%14.5" /end AXIS_DESCR
 /begin AXIS_DESCR STD_AXIS Pvdkds _CNV_R_R_Def_p_sw_q_576_CM 8 0. 2559.9609 FORMAT "%5.2" /end AXIS_DESCR
/end CHARACTERISTIC
/begin CHARACTERISTIC KF_RFVZYLVOL "Volumetrisches Zylinder-Fuellung" MAP 0xa081f29c _REC_MAP_52_UBYTE_s2_s2_u2 98.30250000000001 _CNV_R_R_Def_rf_sw__598_CM -327.68 327.67 FORMAT "%7.4"
 /begin AXIS_DESCR STD_AXIS Nkw _CNV_R_R_Def_n_sw_q_595_CM 12 -32768. 32767. FORMAT "%5.0" /end AXIS_DESCR
 /begin AXIS_DESCR STD_AXIS Vse_spri _CNV_R_R_Def_spr_sw_561_CM 12 0. 6553.5 FORMAT "%5.2" /end AXIS_DESCR
/end CHARACTERISTIC
/begin CHARACTERISTIC KF_RKLAM_KOR "Korrekturkennfeld" MAP 0xa08271b8 _REC_MAP_52_UBYTE_u2_u2_s2 1.9999 _CNV_R_R_Def_f_uw_b_590_CM 0. 1.9999 FORMAT "%14.5"
 /begin AXIS_DESCR STD_AXIS NO_INPUT_QUANTITY _CNV_R_R_Def_rk_uw__746_CM 8 0. 31.9995 FORMAT "%7.4" /end AXIS_DESCR
 /begin AXIS_DESCR STD_AXIS Nkw _CNV_R_R_Def_n_sw_q_595_CM 8 -32768. 32767. FORMAT "%5.0" /end AXIS_DESCR
/end CHARACTERISTIC
/begin CHARACTERISTIC KF_TDMSZYL "Kennfeld zur Filterung der Variablen Verzögerung von Mszyl_diag" MAP 0xa081fff8 _REC_MAP_52_UBYTE_u2_s2_s2 655.35 _CNV_R_R_Def_zk10ms_715_CM 1.e-002 655.36 FORMAT "%7.4"
 /begin AXIS_DESCR STD_AXIS Nkw _CNV_R_R_Def_n_sw_q_595_CM 4 -32768. 32767. FORMAT "%5.0" /end AXIS_DESCR
 /begin AXIS_DESCR STD_AXIS Rf _CNV_R_R_Def_rf_sw__598_CM 4 -327.68 327.67 FORMAT "%7.4" /end AXIS_DESCR
/end CHARACTERISTIC
/begin CHARACTERISTIC KF_TDRKLAM "Kennfeld zur Variablen Verzögerung von Rk_1 und Rk_2" MAP 0xa08270b0 _REC_MAP_52_u1_s2_s2 102. _CNV_R_R_Def_td_ub__717_CM 0. 2550. FORMAT "%4.1"
 /begin AXIS_DESCR STD_AXIS Nkw _CNV_R_R_Def_n_sw_q_595_CM 8 -32768. 32767. FORMAT "%5.0" /end AXIS_DESCR
 /begin AXIS_DESCR STD_AXIS Rf _CNV_R_R_Def_rf_sw__598_CM 8 -327.68 327.67 FORMAT "%7.4" /end AXIS_DESCR
/end CHARACTERISTIC
/begin CHARACTERISTIC KF_TDRKLAMF "Kennfeld zur Fiulterung der Variablen Verzögerung von Rk_1 und Rk_2" MAP 0xa0827114 _REC_MAP_52_UBYTE_u2_s2_s2 655.35 _CNV_R_R_Def_zk10ms_715_CM 1.e-002 655.36 FORMAT "%7.4"
 /begin AXIS_DESCR STD_AXIS Nkw _CNV_R_R_Def_n_sw_q_595_CM 8 -32768. 32767. FORMAT "%5.0" /end AXIS_DESCR
 /begin AXIS_DESCR STD_AXIS Rf _CNV_R_R_Def_rf_sw__598_CM 8 -327.68 327.67 FORMAT "%7.4" /end AXIS_DESCR
/end CHARACTERISTIC
/begin CHARACTERISTIC KF_THFMOD "Filterkonstante fuer Massenstromfilter" MAP 0xa081f898 _REC_MAP_52_UBYTE_u2_s2_s2 655.35 _CNV_R_R_Def_zk10ms_715_CM 1.e-002 655.36 FORMAT "%7.4"
 /begin AXIS_DESCR STD_AXIS Nkw _CNV_R_R_Def_n_sw_q_595_CM 6 -32768. 32767. FORMAT "%5.0" /end AXIS_DESCR
 /begin AXIS_DESCR STD_AXIS Rf_soll _CNV_R_R_Def_rf_sw__598_CM 6 -327.68 327.67 FORMAT "%7.4" /end AXIS_DESCR
/end CHARACTERISTIC
/begin CHARACTERISTIC KF_UEF_SPUEL "Kennfeld für Überschneidungsfläche" MAP 0xa081f1f8 _REC_MAP_52_UBYTE_u2_u2_s2 104.856 _CNV_R_R_Def_a_uw_q_725_CM 0. 1048.56
 /begin AXIS_DESCR STD_AXIS NO_INPUT_QUANTITY _CNV_R_R_Def_spr_sw_561_CM 8 0. 6553.5 FORMAT "%5.2" /end AXIS_DESCR
 /begin AXIS_DESCR STD_AXIS NO_INPUT_QUANTITY _CNV_R_R_Def_spr_sw_561_CM 8 -3276.8 3276.7 FORMAT "%5.2" /end AXIS_DESCR
/end CHARACTERISTIC
/begin CHARACTERISTIC KF_UEF_UK "Kennfeld für Überschneidungsfläche" MAP 0xa081f154 _REC_MAP_52_UBYTE_u2_u2_s2 104.856 _CNV_R_R_Def_a_uw_q_725_CM 0. 1048.56
 /begin AXIS_DESCR STD_AXIS NO_INPUT_QUANTITY _CNV_R_R_Def_spr_sw_561_CM 8 0. 6553.5 FORMAT "%5.2" /end AXIS_DESCR
 /begin AXIS_DESCR STD_AXIS NO_INPUT_QUANTITY _CNV_R_R_Def_spr_sw_561_CM 8 -3276.8 3276.7 FORMAT "%5.2" /end AXIS_DESCR
/end CHARACTERISTIC
/begin CHARACTERISTIC KF_ZK_MSKOR "Filterkonstante fuer HFM-Massenstromfilter" MAP 0xa081f8fc _REC_MAP_52_UBYTE_u2_s2_s2 655.35 _CNV_R_R_Def_zk10ms_715_CM 1.e-002 655.36 FORMAT "%7.4"
 /begin AXIS_DESCR STD_AXIS Rfv_soll _CNV_R_R_Def_rf_sw__598_CM 6 -327.68 327.67 FORMAT "%7.4" /end AXIS_DESCR
 /begin AXIS_DESCR STD_AXIS Nkw _CNV_R_R_Def_n_sw_q_595_CM 6 -32768. 32767. FORMAT "%5.0" /end AXIS_DESCR
/end CHARACTERISTIC
/begin CHARACTERISTIC KL_AF "Ausflusskennlinie" CURVE 0xa081e910 _REC_CUR_TKL_UW_VV__u2_u2 0.9999 _CNV_R_R_Def_f_uw_b_571_CM 0. 0.9999 FORMAT "%14.5"
 /begin AXIS_DESCR STD_AXIS Pspvdk _CNV_R_R_Def_f_uw_b_571_CM 24 0. 0.9999 FORMAT "%14.5" /end AXIS_DESCR
/end CHARACTERISTIC
/begin CHARACTERISTIC KL_AF_SPUEL "Ausflusskennlinie" CURVE 0xa081ea80 _REC_CUR_TKL_UW_VV__u2_u2 0.9999 _CNV_R_R_Def_f_uw_b_571_CM 0. 0.9999 FORMAT "%14.5"
 /begin AXIS_DESCR STD_AXIS NO_INPUT_QUANTITY _CNV_R_R_Def_f_uw_b_590_CM 24 0. 1.9999 FORMAT "%14.5" /end AXIS_DESCR
/end CHARACTERISTIC
/begin CHARACTERISTIC KL_CDK_N "Zentren Lolimot-Modelle Eingang Nkw, DK-Zweig" CURVE 0xa081f750 _REC_CUR_20_s2_u1 65535. _CNV_R_R_Def_n_sw_q_595_CM -32768. 32767. FORMAT "%5.0"
 /begin AXIS_DESCR COM_AXIS NO_INPUT_QUANTITY _CNV_R_R_Def_dez_sl_551_CM 15 0. 255. FORMAT "%3.0" AXIS_PTS_REF GAX_15MODELLE /end AXIS_DESCR
/end CHARACTERISTIC
/begin CHARACTERISTIC KL_CDK_VSA_SPRI "Zentren Lolimot-Modelle Eingang Vsa_spri, DK-Zweig" CURVE 0xa081f790 _REC_CUR_20_u2_u1 6553.5 _CNV_R_R_Def_spr_sw_561_CM 0. 6553.5 FORMAT "%5.2"
 /begin AXIS_DESCR COM_AXIS NO_INPUT_QUANTITY _CNV_R_R_Def_dez_sl_551_CM 15 0. 255. FORMAT "%3.0" AXIS_PTS_REF GAX_15MODELLE /end AXIS_DESCR
/end CHARACTERISTIC
/begin CHARACTERISTIC KL_CDK_VSE_SPRI "Zentren Lolimot-Modelle Eingang Vse_spri, DK-Zweig" CURVE 0xa081f770 _REC_CUR_20_u2_u1 6553.5 _CNV_R_R_Def_spr_sw_561_CM 0. 6553.5 FORMAT "%5.2"
 /begin AXIS_DESCR COM_AXIS NO_INPUT_QUANTITY _CNV_R_R_Def_dez_sl_551_CM 15 0. 255. FORMAT "%3.0" AXIS_PTS_REF GAX_15MODELLE /end AXIS_DESCR
/end CHARACTERISTIC
/begin CHARACTERISTIC KL_CDK_WDK_IST "Zentren Lolimot-Modelle Eingang Wdk_ist, DK-Zweig" CURVE 0xa081f7b0 _REC_CUR_20_s2_u1 1599.9755 _CNV_R_R_Def_wdk_sw_683_CM -800. 799.9755 FORMAT "%5.2"
 /begin AXIS_DESCR COM_AXIS NO_INPUT_QUANTITY _CNV_R_R_Def_dez_sl_551_CM 15 0. 255. FORMAT "%3.0" AXIS_PTS_REF GAX_15MODELLE /end AXIS_DESCR
/end CHARACTERISTIC
/begin CHARACTERISTIC KL_DPLF "Druckverlust über Luftfilter" CURVE 0xa0820598 _REC_CUR_TKL_UW_VV__u2_s2 102.398436 _CNV_R_R_Def_p_sw_q_576_CM 0. 2559.9609
 /begin AXIS_DESCR STD_AXIS Nkw _CNV_R_R_Def_n_sw_q_595_CM 8 -32768. 32767. FORMAT "%5.0" /end AXIS_DESCR
/end CHARACTERISTIC
/begin CHARACTERISTIC KL_DRFSOLL_MSLAM "Maximal zulässiges Drf_soll für FG MSLAM" CURVE 0xa0827000 _REC_CUR_TKL_UW_VV__s2_s2 98.30250000000001 _CNV_R_R_Def_rf_sw__598_CM -327.68 327.67 FORMAT "%7.4"
 /begin AXIS_DESCR STD_AXIS Tmot _CNV_R_R_Def_t_sw_q_579_CM 6 -327.68 327.67 FORMAT "%5.2" /end AXIS_DESCR
/end CHARACTERISTIC
/begin CHARACTERISTIC KL_ETADK "Lernfaktor für DK-Lolimot-KNN" CURVE 0xa081f850 _REC_CUR_TKL_UW_VV__S4_S4 0. _CNV_R_R_Def_dez_sl_551_CM 0. 10000000000000. FORMAT "%14.7"
 /begin AXIS_DESCR STD_AXIS NO_INPUT_QUANTITY _CNV_R_R_Def_dez_sl_551_CM 6 -1000000000000. 10000000000000. FORMAT "%14.7" /end AXIS_DESCR
/end CHARACTERISTIC
/begin CHARACTERISTIC KL_HUBFMAON "" CURVE 0xa081f5f8 _REC_CUR_TKL_UW_VV__u2_s2 65.535 _CNV_R_R_Def_hub_uw_589_CM 0. 65.535
 /begin AXIS_DESCR STD_AXIS Nkw _CNV_R_R_Def_n_sw_q_595_CM 8 -32768. 32767. FORMAT "%5.0" /end AXIS_DESCR
/end CHARACTERISTIC
/begin CHARACTERISTIC KL_HUBFMAUN "" CURVE 0xa081f61c _REC_CUR_TKL_UW_VV__u2_s2 65.535 _CNV_R_R_Def_hub_uw_589_CM 0. 65.535
 /begin AXIS_DESCR STD_AXIS Nkw _CNV_R_R_Def_n_sw_q_595_CM 8 -32768. 32767. FORMAT "%5.0" /end AXIS_DESCR
/end CHARACTERISTIC
/begin CHARACTERISTIC KL_HUBMSON "" CURVE 0xa081f640 _REC_CUR_TKL_UW_VV__u2_s2 65.535 _CNV_R_R_Def_hub_uw_589_CM 0. 65.535
 /begin AXIS_DESCR STD_AXIS Nkw _CNV_R_R_Def_n_sw_q_595_CM 8 -32768. 32767. FORMAT "%5.0" /end AXIS_DESCR
/end CHARACTERISTIC
/begin CHARACTERISTIC KL_KORRKFVST "" CURVE 0xa0826fec _REC_CUR_TKL_UW_VV__u2_u2 63.99900000000001 _CNV_R_R_Def_f_uw_b_617_CM 0. 63.999 FORMAT "%7.4"
 /begin AXIS_DESCR STD_AXIS F_vst _CNV_R_R_Def_f_uw_b_617_CM 4 0. 63.999 FORMAT "%7.4" /end AXIS_DESCR
/end CHARACTERISTIC
/begin CHARACTERISTIC KL_LALIUS "Lambdalinearisierung, LSU-Sonde vor Katalysator" CURVE 0xa0827054 _REC_CUR_TKL_UW_VV__u2_u2 15.9997 _CNV_R_R_Def_f_uw_b_559_CM 0. 15.9997 FORMAT "%7.4"
 /begin AXIS_DESCR STD_AXIS Ulams_1 _CNV_R_R_Def_u_sw_q_580_CM 22 0. 9.995100000000001 /end AXIS_DESCR
/end CHARACTERISTIC
/begin CHARACTERISTIC KL_PIRG_MX "Kennlinie MAX-Grenze Pirg aus N.N." CURVE 0xa081eee8 _REC_CUR_TKL_UW_VV__u2_s2 102.398436 _CNV_R_R_Def_p_sw_q_576_CM 0. 2559.9609 FORMAT "%5.2"
 /begin AXIS_DESCR STD_AXIS Nkw _CNV_R_R_Def_n_sw_q_595_CM 6 -32768. 32767. FORMAT "%5.0" /end AXIS_DESCR
/end CHARACTERISTIC
/begin CHARACTERISTIC KL_PIRG_START "Pirg während Start" CURVE 0xa081eb20 _REC_CUR_TKL_UW_VV__u2_s2 102.398436 _CNV_R_R_Def_p_sw_q_576_CM 0. 2559.9609 FORMAT "%5.2"
 /begin AXIS_DESCR STD_AXIS Nkw _CNV_R_R_Def_n_sw_q_595_CM 8 -32768. 32767. FORMAT "%5.0" /end AXIS_DESCR
/end CHARACTERISTIC
/begin CHARACTERISTIC KL_PRAT2FLOW_TURB "Turbinengleichung" CURVE 0xa0820604 _REC_CUR_TKL_UW_VV__u2_u2 0.9999847412109381 _CNV_R_R_Def_f_uw_b_571_CM 0. 0.9999847412109381 FORMAT "%14.5"
 /begin AXIS_DESCR STD_AXIS NO_INPUT_QUANTITY _CNV_R_R_Def_f_sw_b_616_CM 8 0. 3.9999 FORMAT "%14.5" /end AXIS_DESCR
/end CHARACTERISTIC
/begin CHARACTERISTIC KL_PRAT2FLOW_VERD "Verdichtergleichung" CURVE 0xa08205e0 _REC_CUR_TKL_UW_VV__u2_u2 0.9999694824218756 _CNV_R_R_Def_f_uw_b_571_CM 1.52587890625e-005 0.9999847412109381 FORMAT "%14.5"
 /begin AXIS_DESCR STD_AXIS NO_INPUT_QUANTITY _CNV_R_R_Def_f_sw_b_616_CM 8 0. 3.9999 FORMAT "%14.5" /end AXIS_DESCR
/end CHARACTERISTIC
/begin CHARACTERISTIC KL_RFVIST_MN "Minimales Rfv_ist aus N.N" CURVE 0xa081eb7c _REC_CUR_TKL_UW_VV__s2_s2 98.30250000000001 _CNV_R_R_Def_rf_sw__598_CM -327.68 327.67 FORMAT "%7.4"
 /begin AXIS_DESCR STD_AXIS Nkw _CNV_R_R_Def_n_sw_q_595_CM 6 -32768. 32767. FORMAT "%5.0" /end AXIS_DESCR
/end CHARACTERISTIC
/begin CHARACTERISTIC KL_RFVIST_MX "Kennlinie MIN-Grenze Pirg aus N.N." CURVE 0xa081ef04 _REC_CUR_TKL_UW_VV__s2_s2 98.30250000000001 _CNV_R_R_Def_rf_sw__598_CM -327.68 327.67 FORMAT "%7.4"
 /begin AXIS_DESCR STD_AXIS Nkw _CNV_R_R_Def_n_sw_q_595_CM 6 -32768. 32767. FORMAT "%5.0" /end AXIS_DESCR
/end CHARACTERISTIC
/begin CHARACTERISTIC KL_RFVIST_START "Pirg während Start" CURVE 0xa081eb58 _REC_CUR_TKL_UW_VV__s2_s2 98.30250000000001 _CNV_R_R_Def_rf_sw__598_CM -327.68 327.67 FORMAT "%7.4"
 /begin AXIS_DESCR STD_AXIS Nkw _CNV_R_R_Def_n_sw_q_595_CM 8 -32768. 32767. FORMAT "%5.0" /end AXIS_DESCR
/end CHARACTERISTIC
/begin CHARACTERISTIC KL_RFVSOLL "Schwelle für Rfv_soll zur Aktivierung Disadiagnose" CURVE 0xa081ff04 _REC_CUR_TKL_UW_VV__s2_s2 98.30250000000001 _CNV_R_R_Def_rf_sw__598_CM -327.68 327.67 FORMAT "%7.4"
 /begin AXIS_DESCR STD_AXIS Nkw _CNV_R_R_Def_n_sw_q_595_CM 8 -32768. 32767. FORMAT "%5.0" /end AXIS_DESCR
/end CHARACTERISTIC
/begin CHARACTERISTIC KL_RKUKG_MSLAM "" CURVE 0xa0827038 _REC_CUR_TKL_UW_VV__u2_s2 1.9999 _CNV_R_R_Def_f_uw_b_590_CM 0. 1.9999 FORMAT "%14.5"
 /begin AXIS_DESCR STD_AXIS Tmot _CNV_R_R_Def_t_sw_q_579_CM 6 -327.68 327.67 FORMAT "%5.2" /end AXIS_DESCR
/end CHARACTERISTIC
/begin CHARACTERISTIC KL_SDK_N "Breiten Lolimot-Modelle Eingang Nkw, DK-Zweig" CURVE 0xa081f7d0 _REC_CUR_20_s2_u1 65535. _CNV_R_R_Def_n_sw_q_595_CM -32768. 32767. FORMAT "%5.0"
 /begin AXIS_DESCR COM_AXIS NO_INPUT_QUANTITY _CNV_R_R_Def_dez_sl_551_CM 15 0. 255. FORMAT "%3.0" AXIS_PTS_REF GAX_15MODELLE /end AXIS_DESCR
/end CHARACTERISTIC
/begin CHARACTERISTIC KL_SDK_VSA_SPRI "Breiten Lolimot-Modelle Eingang Vsa_spri, DK-Zweig" CURVE 0xa081f810 _REC_CUR_20_u2_u1 6553.5 _CNV_R_R_Def_spr_sw_561_CM 0. 6553.5 FORMAT "%5.2"
 /begin AXIS_DESCR COM_AXIS NO_INPUT_QUANTITY _CNV_R_R_Def_dez_sl_551_CM 15 0. 255. FORMAT "%3.0" AXIS_PTS_REF GAX_15MODELLE /end AXIS_DESCR
/end CHARACTERISTIC
/begin CHARACTERISTIC KL_SDK_VSE_SPRI "Breiten Lolimot-Modelle Eingang Vse_spri, DK-Zweig" CURVE 0xa081f7f0 _REC_CUR_20_u2_u1 6553.5 _CNV_R_R_Def_spr_sw_561_CM 0. 6553.5 FORMAT "%5.2"
 /begin AXIS_DESCR COM_AXIS NO_INPUT_QUANTITY _CNV_R_R_Def_dez_sl_551_CM 15 0. 255. FORMAT "%3.0" AXIS_PTS_REF GAX_15MODELLE /end AXIS_DESCR
/end CHARACTERISTIC
/begin CHARACTERISTIC KL_SDK_WDK_IST "Breiten Lolimot-Modelle Eingang Wdk_ist, DK-Zweig" CURVE 0xa081f830 _REC_CUR_20_s2_u1 1599.9755 _CNV_R_R_Def_wdk_sw_683_CM -800. 799.9755 FORMAT "%5.2"
 /begin AXIS_DESCR COM_AXIS NO_INPUT_QUANTITY _CNV_R_R_Def_dez_sl_551_CM 15 0. 255. FORMAT "%3.0" AXIS_PTS_REF GAX_15MODELLE /end AXIS_DESCR
/end CHARACTERISTIC
/begin CHARACTERISTIC KL_SRSTAB_SPUEL "SR Stabilisierungsfaktor" CURVE 0xa081fd88 _REC_CUR_TKL_UW_VV__u2_u2 1.9999 _CNV_R_R_Def_f_uw_b_590_CM 0. 1.9999 FORMAT "%14.5"
 /begin AXIS_DESCR STD_AXIS NO_INPUT_QUANTITY _CNV_R_R_Def_f_uw_b_590_CM 10 0. 1.9999 FORMAT "%14.5" /end AXIS_DESCR
/end CHARACTERISTIC
/begin CHARACTERISTIC KL_STEND_TRANS "Start Faktor" CURVE 0xa081eb44 _REC_CUR_TKL_UW_VV__u2_s2 0.9999 _CNV_R_R_Def_f_uw_b_571_CM 0. 0.9999 FORMAT "%14.5"
 /begin AXIS_DESCR STD_AXIS Nkw _CNV_R_R_Def_n_sw_q_595_CM 4 -32768. 32767. FORMAT "%5.0" /end AXIS_DESCR
/end CHARACTERISTIC
/begin CHARACTERISTIC KL_TDRFSOLL_MSLAM "Verzögerungszeit Drf_soll für FG MSLAM" CURVE 0xa082701c _REC_CUR_TKL_UW_VV__u2_s2 98.30250000000001 _CNV_R_R_Def_td_uw__673_CM 0. 655.35 FORMAT "%5.2"
 /begin AXIS_DESCR STD_AXIS Tmot _CNV_R_R_Def_t_sw_q_579_CM 6 -327.68 327.67 FORMAT "%5.2" /end AXIS_DESCR
/end CHARACTERISTIC
/begin CHARACTERISTIC KL_TD_MRONST "" CURVE 0xa081f5d4 _REC_CUR_TKL_UW_VV__u2_s2 131.07 _CNV_R_R_Def_td_ub__574_CM 0. 6553.5 FORMAT "%4.1"
 /begin AXIS_DESCR STD_AXIS Tmot_start _CNV_R_R_Def_t_sw_q_579_CM 8 -327.68 327.67 FORMAT "%5.2" /end AXIS_DESCR
/end CHARACTERISTIC
/begin CHARACTERISTIC KL_VSAUG_GDN "Faktor Maximal Saugrohrdruck, Gedrosselt Neg" CURVE 0xa081fe1c _REC_CUR_TKL_UW_VV__u2_s2 9.999800000000001 _CNV_R_R_Def_f_uw_b_618_CM 0. 9.999800000000001 FORMAT "%7.4"
 /begin AXIS_DESCR STD_AXIS Nkw _CNV_R_R_Def_n_sw_q_595_CM 12 -32768. 32767. FORMAT "%5.0" /end AXIS_DESCR
/end CHARACTERISTIC
/begin CHARACTERISTIC KL_VSAUG_GDP "Faktor Maximal Saugrohrdruck, Gedrosselt Pos" CURVE 0xa081fde8 _REC_CUR_TKL_UW_VV__u2_s2 9.999800000000001 _CNV_R_R_Def_f_uw_b_618_CM 0. 9.999800000000001 FORMAT "%7.4"
 /begin AXIS_DESCR STD_AXIS Nkw _CNV_R_R_Def_n_sw_q_595_CM 12 -32768. 32767. FORMAT "%5.0" /end AXIS_DESCR
/end CHARACTERISTIC
/begin CHARACTERISTIC KL_VSAUG_UG "Faktor Maximal Saugrohrdruck, Un-gedrosselt" CURVE 0xa081fdb4 _REC_CUR_TKL_UW_VV__u2_s2 9.999800000000001 _CNV_R_R_Def_f_uw_b_618_CM 0. 9.999800000000001 FORMAT "%7.4"
 /begin AXIS_DESCR STD_AXIS Nkw _CNV_R_R_Def_n_sw_q_595_CM 12 -32768. 32767. FORMAT "%5.0" /end AXIS_DESCR
/end CHARACTERISTIC
/begin CHARACTERISTIC KL_WBIAS_PIRG "Gewichte der Neuronen für Bias, PIRGNN" CURVE 0xa081ee48 _REC_CUR_20_S4_u1 11000000000000. _CNV_R_R_Def_dez_sl_551_CM -1000000000000. 10000000000000. FORMAT "%14.7"
 /begin AXIS_DESCR COM_AXIS NO_INPUT_QUANTITY _CNV_R_R_Def_dez_sl_551_CM 20 0. 255. FORMAT "%3.0" AXIS_PTS_REF GAX_PIRGNN /end AXIS_DESCR
/end CHARACTERISTIC
/begin CHARACTERISTIC KL_WBIAS_RF "Gewichte der Neuronen für Bias, RFVISTNN" CURVE 0xa081eca0 _REC_CUR_20_S4_u1 11000000000000. _CNV_R_R_Def_dez_sl_551_CM -1000000000000. 10000000000000. FORMAT "%14.7"
 /begin AXIS_DESCR COM_AXIS NO_INPUT_QUANTITY _CNV_R_R_Def_dez_sl_551_CM 20 0. 255. FORMAT "%3.0" AXIS_PTS_REF GAX_RFVISTNN /end AXIS_DESCR
/end CHARACTERISTIC
/begin CHARACTERISTIC KL_WDK_UG "Minimal DK Winkel UG" CURVE 0xa081ea64 _REC_CUR_TKL_UW_VV__u2_s2 95.99852999999999 _CNV_R_R_Def_wdk_sw_683_CM 0. 1599.9755 FORMAT "%5.2"
 /begin AXIS_DESCR STD_AXIS Nkw _CNV_R_R_Def_n_sw_q_595_CM 4 -32768. 32767. FORMAT "%5.0" /end AXIS_DESCR
/end CHARACTERISTIC
/begin CHARACTERISTIC KL_WNKW_PIRG "Gewichte der Neuronen für Eingang Nkw, PIRGNN" CURVE 0xa081edf8 _REC_CUR_20_S4_u1 11000000000000. _CNV_R_R_Def_dez_sl_551_CM -1000000000000. 10000000000000. FORMAT "%14.7"
 /begin AXIS_DESCR COM_AXIS NO_INPUT_QUANTITY _CNV_R_R_Def_dez_sl_551_CM 20 0. 255. FORMAT "%3.0" AXIS_PTS_REF GAX_PIRGNN /end AXIS_DESCR
/end CHARACTERISTIC
/begin CHARACTERISTIC KL_WNKW_RF "Gewichte der Neuronen für Eingang Nkw, RFVISTNN" CURVE 0xa081ec50 _REC_CUR_20_S4_u1 11000000000000. _CNV_R_R_Def_dez_sl_551_CM -1000000000000. 10000000000000. FORMAT "%14.7"
 /begin AXIS_DESCR COM_AXIS NO_INPUT_QUANTITY _CNV_R_R_Def_dez_sl_551_CM 20 0. 255. FORMAT "%3.0" AXIS_PTS_REF GAX_RFVISTNN /end AXIS_DESCR
/end CHARACTERISTIC
/begin CHARACTERISTIC KL_WOUT_PIRG "Gewichte der Neuronen für Ausgang, PIRGNN" CURVE 0xa081ee98 _REC_CUR_20_S4_u1 11000000000000. _CNV_R_R_Def_dez_sl_551_CM -1000000000000. 10000000000000. FORMAT "%14.7"
 /begin AXIS_DESCR COM_AXIS NO_INPUT_QUANTITY _CNV_R_R_Def_dez_sl_551_CM 20 0. 255. FORMAT "%3.0" AXIS_PTS_REF GAX_PIRGNN /end AXIS_DESCR
/end CHARACTERISTIC
/begin CHARACTERISTIC KL_WOUT_RF "Gewichte der Neuronen für Ausgang, RFVISTNN" CURVE 0xa081ecf0 _REC_CUR_20_S4_u1 11000000000000. _CNV_R_R_Def_dez_sl_551_CM -1000000000000. 10000000000000. FORMAT "%14.7"
 /begin AXIS_DESCR COM_AXIS NO_INPUT_QUANTITY _CNV_R_R_Def_dez_sl_551_CM 20 0. 255. FORMAT "%3.0" AXIS_PTS_REF GAX_RFVISTNN /end AXIS_DESCR
/end CHARACTERISTIC
/begin CHARACTERISTIC KL_WVSA_PIRG "Gewichte der Neuronen für Eingang Vsa_spri, PIRGNN" CURVE 0xa081eda8 _REC_CUR_20_S4_u1 11000000000000. _CNV_R_R_Def_dez_sl_551_CM -1000000000000. 10000000000000. FORMAT "%14.7"
 /begin AXIS_DESCR COM_AXIS NO_INPUT_QUANTITY _CNV_R_R_Def_dez_sl_551_CM 20 0. 255. FORMAT "%3.0" AXIS_PTS_REF GAX_PIRGNN /end AXIS_DESCR
/end CHARACTERISTIC
/begin CHARACTERISTIC KL_WVSA_RF "Gewichte der Neuronen für Eingang Vsa_spri, RFVISTNN" CURVE 0xa081ec00 _REC_CUR_20_S4_u1 11000000000000. _CNV_R_R_Def_dez_sl_551_CM -1000000000000. 10000000000000. FORMAT "%14.7"
 /begin AXIS_DESCR COM_AXIS NO_INPUT_QUANTITY _CNV_R_R_Def_dez_sl_551_CM 20 0. 255. FORMAT "%3.0" AXIS_PTS_REF GAX_RFVISTNN /end AXIS_DESCR
/end CHARACTERISTIC
/begin CHARACTERISTIC KL_WVSE_PIRG "Gewichte der Neuronen für Eingang Vse_spri, PIRGNN" CURVE 0xa081ed58 _REC_CUR_20_S4_u1 11000000000000. _CNV_R_R_Def_dez_sl_551_CM -1000000000000. 10000000000000. FORMAT "%14.7"
 /begin AXIS_DESCR COM_AXIS NO_INPUT_QUANTITY _CNV_R_R_Def_dez_sl_551_CM 20 0. 255. FORMAT "%3.0" AXIS_PTS_REF GAX_PIRGNN /end AXIS_DESCR
/end CHARACTERISTIC
/begin CHARACTERISTIC KL_WVSE_RF "Gewichte der Neuronen für Eingang Vse_spri, RFVISTNN" CURVE 0xa081ebb0 _REC_CUR_20_S4_u1 11000000000000. _CNV_R_R_Def_dez_sl_551_CM -1000000000000. 10000000000000. FORMAT "%14.7"
 /begin AXIS_DESCR COM_AXIS NO_INPUT_QUANTITY _CNV_R_R_Def_dez_sl_551_CM 20 0. 255. FORMAT "%3.0" AXIS_PTS_REF GAX_RFVISTNN /end AXIS_DESCR
/end CHARACTERISTIC
/begin CHARACTERISTIC KL_ZKMSKOR_PSP "Filterkonstante fuer HFM-Massenstromfilter" CURVE 0xa081f884 _REC_CUR_TKL_UW_VV__u2_u2 655.35 _CNV_R_R_Def_zk10ms_715_CM 1.e-002 655.36 FORMAT "%7.4"
 /begin AXIS_DESCR STD_AXIS Pspvdk_soll _CNV_R_R_Def_f_sw_b_616_CM 4 0. 3.9999 FORMAT "%14.5" /end AXIS_DESCR
/end CHARACTERISTIC
/begin CHARACTERISTIC KL_ZK_PSSMOD "" CURVE 0xa081fc60 _REC_CUR_TKL_UW_VV__u2_s2 0.9999 _CNV_R_R_Def_f_uw_b_571_CM 0. 0.9999 FORMAT "%14.5"
 /begin AXIS_DESCR STD_AXIS Nkw _CNV_R_R_Def_n_sw_q_595_CM 4 -32768. 32767. FORMAT "%5.0" /end AXIS_DESCR
/end CHARACTERISTIC
/begin CHARACTERISTIC KL_ZK_TURBINE "" CURVE 0xa08205bc _REC_CUR_TKL_UW_VV__u2_s2 0.9999847412109381 _CNV_R_R_Def_f_uw_b_571_CM 0. 0.9999847412109381 FORMAT "%14.5"
 /begin AXIS_DESCR STD_AXIS Nkw _CNV_R_R_Def_n_sw_q_595_CM 8 -32768. 32767. FORMAT "%5.0" /end AXIS_DESCR
/end CHARACTERISTIC
/begin CHARACTERISTIC K_AGRREGIMN "AGR-Regler I-Anteil Minimalwert" VALUE 0xa081fc48 _REC_VAL_20_s2 63.999 _CNV_R_R_Def_f_sw_b_556_CM -32. 31.999 FORMAT "%7.4" /end CHARACTERISTIC
/begin CHARACTERISTIC K_AGRREGIMX "AGR-Regler I-Anteil Maximalwert" VALUE 0xa081fc4a _REC_VAL_20_s2 63.999 _CNV_R_R_Def_f_sw_b_556_CM -32. 31.999 FORMAT "%7.4" /end CHARACTERISTIC
/begin CHARACTERISTIC K_ANZ_DKNN "Anzahl Modelle für DK-Lolimot-KNN" VALUE 0xa081f540 _REC_VAL_20_u1 15. _CNV_R_R_Def_dez_sl_551_CM 0. 15. FORMAT "%3.0" /end CHARACTERISTIC
/begin CHARACTERISTIC K_AVGCTR_MN "Min Erlaubter Zeit für Drucksensorabgleich" VALUE 0xa081fed2 _REC_VAL_20_u2 131.07 _CNV_R_R_Def_td_ub__574_CM 0. 6553.5 FORMAT "%4.1" /end CHARACTERISTIC
/begin CHARACTERISTIC K_AVGCTR_MX "Max Erlaubter Zeit für Drucksensorabgleich" VALUE 0xa081fed0 _REC_VAL_20_u2 131.07 _CNV_R_R_Def_td_ub__574_CM 0. 6553.5 FORMAT "%4.1" /end CHARACTERISTIC
/begin CHARACTERISTIC K_BGMSVVTDPS "" VALUE 0xa081f562 _REC_VAL_20_u1 0.996 _CNV_R_R_Def_f_ub_b_553_CM 0. 0.996 /end CHARACTERISTIC
/begin CHARACTERISTIC K_BGWDKDPSGR "" VALUE 0xa081fec4 _REC_VAL_20_s2 102.398436 _CNV_R_R_Def_p_sw_q_576_CM -1280. 1279.9609 FORMAT "%5.2" /end CHARACTERISTIC
/begin CHARACTERISTIC K_DIAGHFM_GANGI "Gangi zur Aufweitung der HFM-Diagnoseschwellen" VALUE 0xa081fe6a _REC_VAL_20_u1 99.45 _CNV_R_R_Def_dez_sl_551_CM 0. 255. FORMAT "%3.0" /end CHARACTERISTIC
/begin CHARACTERISTIC K_DIAGHFM_NKW "Max Nkw zur Aufweitung der HFM-Diagnoseschwellen" VALUE 0xa081fefe _REC_VAL_20_s2 0. _CNV_R_R_Def_n_sw_q_595_CM -32768. 32767. FORMAT "%5.0" /end CHARACTERISTIC
/begin CHARACTERISTIC K_DIAGHFM_RF "Max Rf_soll zur Aufweitung der HFM-Diagnoseschwellen" VALUE 0xa081fefc _REC_VAL_20_s2 98.30250000000001 _CNV_R_R_Def_rf_sw__598_CM -327.68 327.67 FORMAT "%7.4" /end CHARACTERISTIC
/begin CHARACTERISTIC K_DIAGHFM_VFZG "Min Vfzg zur Aufweitung der HFM-Diagnoseschwellen" VALUE 0xa081fefa _REC_VAL_20_u2 100.8 _CNV_R_R_Def_v_uw_q_726_CM 0. 360. FORMAT "%5.0" /end CHARACTERISTIC
/begin CHARACTERISTIC K_DIAG_MSO_OFFGD "Offset obere Diagnoseschwelle gedrosselter Betrieb" VALUE 0xa081feb2 _REC_VAL_20_s2 1.9999 _CNV_R_R_Def_f_uw_b_590_CM -1. 0.9999 FORMAT "%14.5" /end CHARACTERISTIC
/begin CHARACTERISTIC K_DIAG_MSO_OFFTD "Offset obere Diagnoseschwelle teilgedrosselter Betrieb" VALUE 0xa081feb6 _REC_VAL_20_s2 1.9999 _CNV_R_R_Def_f_uw_b_590_CM -1. 0.9999 FORMAT "%14.5" /end CHARACTERISTIC
/begin CHARACTERISTIC K_DIAG_MSO_OFFV "Offset auf obere HFM-Diagnoseschwelle bei Gangi=0 und V>Schwelle" VALUE 0xa081ff02 _REC_VAL_20_s2 1.9999 _CNV_R_R_Def_f_uw_b_590_CM -1. 0.9999 FORMAT "%14.5" /end CHARACTERISTIC
/begin CHARACTERISTIC K_DIAG_MSU_OFFGD "Offset untere Diagnoseschwelle gedrosselter Betrieb" VALUE 0xa081feb0 _REC_VAL_20_s2 1.9999 _CNV_R_R_Def_f_uw_b_590_CM -1. 0.9999 FORMAT "%14.5" /end CHARACTERISTIC
/begin CHARACTERISTIC K_DIAG_MSU_OFFTD "Offset untere Diagnoseschwelle teilgedrosselter Betrieb" VALUE 0xa081feb4 _REC_VAL_20_s2 1.9999 _CNV_R_R_Def_f_uw_b_590_CM -1. 0.9999 FORMAT "%14.5" /end CHARACTERISTIC
/begin CHARACTERISTIC K_DIAG_MSU_OFFV "Offset auf untere HFM-Diagnoseschwelle bei Gangi=0 und V>Schwelle" VALUE 0xa081ff00 _REC_VAL_20_s2 1.9999 _CNV_R_R_Def_f_uw_b_590_CM -1. 0.9999 FORMAT "%14.5" /end CHARACTERISTIC
/begin CHARACTERISTIC K_DISAB1_MN "Min Nkw Wert für DISA-Bereich 1" VALUE 0xa081fe9e _REC_VAL_20_s2 0. _CNV_R_R_Def_n_sw_q_595_CM -32768. 32767. FORMAT "%5.0" /end CHARACTERISTIC
/begin CHARACTERISTIC K_DISAB1_MX "Max Nkw Wert für DISA-Bereich 1" VALUE 0xa081fe9c _REC_VAL_20_s2 0. _CNV_R_R_Def_n_sw_q_595_CM -32768. 32767. FORMAT "%5.0" /end CHARACTERISTIC
/begin CHARACTERISTIC K_DISAB2_MN "Min Nkw Wert für DISA-Bereich 2" VALUE 0xa081fea2 _REC_VAL_20_s2 0. _CNV_R_R_Def_n_sw_q_595_CM -32768. 32767. FORMAT "%5.0" /end CHARACTERISTIC
/begin CHARACTERISTIC K_DISAB2_MX "Max Nkw Wert für DISA-Bereich 2" VALUE 0xa081fea0 _REC_VAL_20_s2 0. _CNV_R_R_Def_n_sw_q_595_CM -32768. 32767. FORMAT "%5.0" /end CHARACTERISTIC
/begin CHARACTERISTIC K_DISAB3_MN "Min Nkw Wert für DISA-Bereich 3" VALUE 0xa081fea6 _REC_VAL_20_s2 0. _CNV_R_R_Def_n_sw_q_595_CM -32768. 32767. FORMAT "%5.0" /end CHARACTERISTIC
/begin CHARACTERISTIC K_DISAB3_MX "Max Nkw Wert für DISA-Bereich 3" VALUE 0xa081fea4 _REC_VAL_20_s2 0. _CNV_R_R_Def_n_sw_q_595_CM -32768. 32767. FORMAT "%5.0" /end CHARACTERISTIC
/begin CHARACTERISTIC K_DISAB4_MN "Min Nkw Wert für DISA-Bereich 4" VALUE 0xa081feaa _REC_VAL_20_s2 0. _CNV_R_R_Def_n_sw_q_595_CM -32768. 32767. FORMAT "%5.0" /end CHARACTERISTIC
/begin CHARACTERISTIC K_DISAB4_MX "Max Nkw Wert für DISA-Bereich 4" VALUE 0xa081fea8 _REC_VAL_20_s2 0. _CNV_R_R_Def_n_sw_q_595_CM -32768. 32767. FORMAT "%5.0" /end CHARACTERISTIC
/begin CHARACTERISTIC K_DISADTAMN "Minwert Tans für Disadiagnose" VALUE 0xa081feae _REC_VAL_20_s2 131.07 _CNV_R_R_Def_t_sw_q_578_CM -3276.8 3276.7 FORMAT "%4.1" /end CHARACTERISTIC
/begin CHARACTERISTIC K_DISADTAMX "Maxwert Tans für Disadiagnose" VALUE 0xa081feac _REC_VAL_20_s2 131.07 _CNV_R_R_Def_t_sw_q_578_CM -3276.8 3276.7 FORMAT "%4.1" /end CHARACTERISTIC
/begin CHARACTERISTIC K_DISAIST_B1 "Deak. Schwelle DISA" VALUE 0xa081eb02 _REC_VAL_20_u2 99.9984 _CNV_R_R_Def_f_uw_b_555_CM 0. 99.9984 /end CHARACTERISTIC
/begin CHARACTERISTIC K_DISAIST_B2 "Obererschwelle DISA" VALUE 0xa081eb00 _REC_VAL_20_u2 99.9984 _CNV_R_R_Def_f_uw_b_555_CM 0. 99.9984 /end CHARACTERISTIC
/begin CHARACTERISTIC K_DISAIST_B3 "Unterschwelle DISA" VALUE 0xa081eafe _REC_VAL_20_u2 99.9984 _CNV_R_R_Def_f_uw_b_555_CM 0. 99.9984 /end CHARACTERISTIC
/begin CHARACTERISTIC K_DISATD "Wartezeit nach Disa-Umschaltung bis Bereich erkannt wird" VALUE 0xa081fe67 _REC_VAL_20_u1 25.5 _CNV_R_R_Def_td_ub__574_CM 0. 25.5 FORMAT "%4.1" /end CHARACTERISTIC
/begin CHARACTERISTIC K_DKMX "Maximalwert für Gewichte für DK-Lolimot-KNN" VALUE 0xa081f558 _REC_VAL_20_S4 0. _CNV_R_R_Def_dez_sl_551_CM -1000000000000. 10000000000000. FORMAT "%14.7" /end CHARACTERISTIC
/begin CHARACTERISTIC K_DNKW_DISA1 "Delta Hysterese-schwelle DISA (Übergang Disabereich 2->1)" VALUE 0xa081eb0c _REC_VAL_20_s2 0. _CNV_R_R_Def_n_sw_q_595_CM -32768. 32767. FORMAT "%5.0" /end CHARACTERISTIC
/begin CHARACTERISTIC K_DNKW_DISA2 "Delta Hysterese-schwelle DISA (Übergang Disabereich 3->2)" VALUE 0xa081eb0e _REC_VAL_20_s2 0. _CNV_R_R_Def_n_sw_q_595_CM -32768. 32767. FORMAT "%5.0" /end CHARACTERISTIC
/begin CHARACTERISTIC K_DNKW_EISYDMN "Minschwelle für Drehzahldynamik Eisy Diagnose" VALUE 0xa081febe _REC_VAL_20_s2 0. _CNV_R_R_Def_n_sw_q_595_CM -32768. 32767. FORMAT "%5.0" /end CHARACTERISTIC
/begin CHARACTERISTIC K_DNKW_EISYDMX "Maxschwelle für Drehzahldynamik Eisy Diagnose" VALUE 0xa081febc _REC_VAL_20_s2 0. _CNV_R_R_Def_n_sw_q_595_CM -32768. 32767. FORMAT "%5.0" /end CHARACTERISTIC
/begin CHARACTERISTIC K_DPSMN "Minwert Dpssol für Freigabe Dps Adaption" VALUE 0xa081fc30 _REC_VAL_20_s2 102.398436 _CNV_R_R_Def_p_sw_q_576_CM -1280. 1279.9609 FORMAT "%5.2" /end CHARACTERISTIC
/begin CHARACTERISTIC K_DPSMX "Maxwert Dpssol für Freigabe Dps Adaption" VALUE 0xa081fc32 _REC_VAL_20_s2 102.398436 _CNV_R_R_Def_p_sw_q_576_CM -1280. 1279.9609 FORMAT "%5.2" /end CHARACTERISTIC
/begin CHARACTERISTIC K_DPSRP_MN1 "Min Amplitude des Dpsr-Jitters (Disa-Bereich 1)" VALUE 0xa081fe94 _REC_VAL_20_s2 102.398436 _CNV_R_R_Def_p_sw_q_576_CM -1280. 1279.9609 FORMAT "%5.2" /end CHARACTERISTIC
/begin CHARACTERISTIC K_DPSRP_MN2 "Min Amplitude des Dpsr-Jitters (Disa-Bereich 2)" VALUE 0xa081fe96 _REC_VAL_20_s2 102.398436 _CNV_R_R_Def_p_sw_q_576_CM -1280. 1279.9609 FORMAT "%5.2" /end CHARACTERISTIC
/begin CHARACTERISTIC K_DPSRP_MN3 "Min Amplitude des Dpsr-Jitters (Disa-Bereich 3)" VALUE 0xa081fe98 _REC_VAL_20_s2 102.398436 _CNV_R_R_Def_p_sw_q_576_CM -1280. 1279.9609 FORMAT "%5.2" /end CHARACTERISTIC
/begin CHARACTERISTIC K_DPSRP_MN4 "Min Amplitude des Dpsr-Jitters (Disa-Bereich 4)" VALUE 0xa081fe9a _REC_VAL_20_s2 102.398436 _CNV_R_R_Def_p_sw_q_576_CM -1280. 1279.9609 FORMAT "%5.2" /end CHARACTERISTIC
/begin CHARACTERISTIC K_DPS_INTMN "Offset für Pvdkds" VALUE 0xa081fd82 _REC_VAL_20_u2 102.398436 _CNV_R_R_Def_p_sw_q_576_CM 0. 2559.9609 FORMAT "%5.2" /end CHARACTERISTIC
/begin CHARACTERISTIC K_DRDIAGLL_TOL "Druck differenz Toleranz, LL" VALUE 0xa081fedc _REC_VAL_20_u2 102.398436 _CNV_R_R_Def_p_sw_q_576_CM 0. 2559.9609 FORMAT "%5.2" /end CHARACTERISTIC
/begin CHARACTERISTIC K_DRDIAGRFMX "" VALUE 0xa081fed8 _REC_VAL_20_s2 98.30250000000001 _CNV_R_R_Def_rf_sw__598_CM -327.68 327.67 FORMAT "%7.4" /end CHARACTERISTIC
/begin CHARACTERISTIC K_DRDIAGTANS_MN "Min Tans-Schwelle für Druckangleich-Vorstart" VALUE 0xa081fee2 _REC_VAL_20_s2 131.07 _CNV_R_R_Def_t_sw_q_578_CM -3276.8 3276.7 FORMAT "%4.1" /end CHARACTERISTIC
/begin CHARACTERISTIC K_DRDIAGTANS_MX "Max Tans-Schwelle für Druckangleich-Vorstart" VALUE 0xa081fee4 _REC_VAL_20_s2 131.07 _CNV_R_R_Def_t_sw_q_578_CM -3276.8 3276.7 FORMAT "%4.1" /end CHARACTERISTIC
/begin CHARACTERISTIC K_DRDIAGTOL "Druck differenz Toleranz" VALUE 0xa081feda _REC_VAL_20_u2 102.398436 _CNV_R_R_Def_p_sw_q_576_CM 0. 2559.9609 FORMAT "%5.2" /end CHARACTERISTIC
/begin CHARACTERISTIC K_DRDIAGTSG_MN "Min Tsg-Schwelle für Druckangleich-Vorstart" VALUE 0xa081feec _REC_VAL_20_s2 98.30250000000001 _CNV_R_R_Def_t_sw_q_579_CM -327.68 327.67 FORMAT "%5.2" /end CHARACTERISTIC
/begin CHARACTERISTIC K_DRDIAGTSG_MX "Max Tsg-Schwelle für Druckangleich-Vorstart" VALUE 0xa081feee _REC_VAL_20_s2 98.30250000000001 _CNV_R_R_Def_t_sw_q_579_CM -327.68 327.67 FORMAT "%5.2" /end CHARACTERISTIC
/begin CHARACTERISTIC K_DRDIAGVL_TOL "Druck differenz Toleranz, VL" VALUE 0xa081fede _REC_VAL_20_u2 102.398436 _CNV_R_R_Def_p_sw_q_576_CM 0. 2559.9609 FORMAT "%5.2" /end CHARACTERISTIC
/begin CHARACTERISTIC K_DRDIAG_OFFSMN "Druck Begrenzer" VALUE 0xa081fed4 _REC_VAL_20_s2 102.398436 _CNV_R_R_Def_p_sw_q_576_CM -1280. 1279.9609 FORMAT "%5.2" /end CHARACTERISTIC
/begin CHARACTERISTIC K_DRDIAG_OFFSMX "Druck Begrenzer" VALUE 0xa081fed6 _REC_VAL_20_s2 102.398436 _CNV_R_R_Def_p_sw_q_576_CM -1280. 1279.9609 FORMAT "%5.2" /end CHARACTERISTIC
/begin CHARACTERISTIC K_DRDIAG_PUMIN "Minimalumgebungsdruck für Drucksensor-Diagnose vor Start" VALUE 0xa081feea _REC_VAL_20_u2 102.398436 _CNV_R_R_Def_p_sw_q_576_CM 0. 2559.9609 FORMAT "%5.2" /end CHARACTERISTIC
/begin CHARACTERISTIC K_DRDIAG_TNABST "Min Abstellzeit, Drucksensorabgleich zu erlauben" VALUE 0xa081fee0 _REC_VAL_20_u2 0. _CNV_R_R_Def_dez_sl_551_CM 0. 65535. FORMAT "%5.0" /end CHARACTERISTIC
/begin CHARACTERISTIC K_DRDIAG_WDKVL "" VALUE 0xa081fece _REC_VAL_20_s2 95.99852999999999 _CNV_R_R_Def_wdk_sw_683_CM -800. 799.9755 FORMAT "%5.2" /end CHARACTERISTIC
/begin CHARACTERISTIC K_DRFSPUELMN_MSLAM "" VALUE 0xa0826fd8 _REC_VAL_20_s2 98.30250000000001 _CNV_R_R_Def_rf_sw__598_CM -327.68 327.67 FORMAT "%7.4" /end CHARACTERISTIC
/begin CHARACTERISTIC K_DRF_EISYDMN "Minschwelle für Lastdynamik Eisy Diagnose" VALUE 0xa081fec2 _REC_VAL_20_s2 98.30250000000001 _CNV_R_R_Def_rf_sw__598_CM -327.68 327.67 FORMAT "%7.4" /end CHARACTERISTIC
/begin CHARACTERISTIC K_DRF_EISYDMX "Maxschwelle für Lastdynamik Eisy Diagnose" VALUE 0xa081fec0 _REC_VAL_20_s2 98.30250000000001 _CNV_R_R_Def_rf_sw__598_CM -327.68 327.67 FORMAT "%7.4" /end CHARACTERISTIC
/begin CHARACTERISTIC K_EINGANG_DK "Anzahl Eingänge für DK-Lolimot-KNN" VALUE 0xa081f541 _REC_VAL_20_u1 4. _CNV_R_R_Def_dez_sl_551_CM 0. 4. FORMAT "%3.0" /end CHARACTERISTIC
/begin CHARACTERISTIC K_ETAZYLAUS_MSLAM "" VALUE 0xa0826fda _REC_VAL_20_s2 100. _CNV_R_R_Def_eta_sw_606_CM 0. 100. /end CHARACTERISTIC
/begin CHARACTERISTIC K_ETA_M_TURBO "Wirkungsgrad Turbolader" VALUE 0xa082058c _REC_VAL_20_u2 3.9999 _CNV_R_R_Def_f_sw_b_616_CM 0. 3.9999 FORMAT "%14.5" /end CHARACTERISTIC
/begin CHARACTERISTIC K_FAGRAD "Schrittweite für Überblendfaktor F_agrad" VALUE 0xa081fc2b _REC_VAL_20_u1 1.9921 _CNV_R_R_Def_f_ub_b_613_CM 0. 1.9921 /end CHARACTERISTIC
/begin CHARACTERISTIC K_FMSLAMON "Grenzwert für Faktor Vorsteuerung" VALUE 0xa0826fe4 _REC_VAL_20_u2 63.99900000000001 _CNV_R_R_Def_f_uw_b_617_CM 0. 63.999 FORMAT "%7.4" /end CHARACTERISTIC
/begin CHARACTERISTIC K_FU_LST_TURB "Faktor Umrechnung Turbinenleistung" VALUE 0xa082058e _REC_VAL_20_u2 0.9999847412109381 _CNV_R_R_Def_f_uw_b_571_CM 0. 0.9999847412109381 FORMAT "%14.5" /end CHARACTERISTIC
/begin CHARACTERISTIC K_FU_MSVERD "Faktor Umrechnung Verdichterleistung" VALUE 0xa0820590 _REC_VAL_20_u2 3.9999 _CNV_R_R_Def_f_sw_b_616_CM 0. 3.9999 FORMAT "%14.5" /end CHARACTERISTIC
/begin CHARACTERISTIC K_HUBMN_DIAG "Minimalhub für Freigabe HFM-Diagnose" VALUE 0xa081fec6 _REC_VAL_20_u2 65.535 _CNV_R_R_Def_hub_uw_589_CM 0. 65.535 /end CHARACTERISTIC
/begin CHARACTERISTIC K_HUBOFF "" VALUE 0xa081eaf0 _REC_VAL_20_u2 65.535 _CNV_R_R_Def_hub_uw_589_CM 0. 65.535 /end CHARACTERISTIC
/begin CHARACTERISTIC K_LAMMNMSLAM "La_ist MIN Schwelle" VALUE 0xa0826fdc _REC_VAL_20_u2 15.9997 _CNV_R_R_Def_f_uw_b_559_CM 0. 15.9997 FORMAT "%7.4" /end CHARACTERISTIC
/begin CHARACTERISTIC K_LAMMXMSLAM "La_ist MAX Schwelle" VALUE 0xa0826fde _REC_VAL_20_u2 15.9997 _CNV_R_R_Def_f_uw_b_559_CM 0. 15.9997 FORMAT "%7.4" /end CHARACTERISTIC
/begin CHARACTERISTIC K_LOLIDK_MN "Lolimot Mingrenze VVT" VALUE 0xa081f5ce _REC_VAL_20_S4 0. _CNV_R_R_Def_dez_sl_551_CM -1000000000000. 10000000000000. FORMAT "%14.7" /end CHARACTERISTIC
/begin CHARACTERISTIC K_LOLIDK_MX "Lolimot Maxgrenze VVT" VALUE 0xa081f5ca _REC_VAL_20_S4 0. _CNV_R_R_Def_dez_sl_551_CM -1000000000000. 10000000000000. FORMAT "%14.7" /end CHARACTERISTIC
/begin CHARACTERISTIC K_MAREGDKIMN "Minimalbegrenzung I-Anteil Mareg Drosselklappe" VALUE 0xa081f54a _REC_VAL_20_s2 1.9999 _CNV_R_R_Def_f_uw_b_590_CM -1. 0.9999 FORMAT "%14.5" /end CHARACTERISTIC
/begin CHARACTERISTIC K_MAREGDKIMX "Maximalbegrenzung I-Anteil Mareg Drosselklappe" VALUE 0xa081f54c _REC_VAL_20_s2 1.9999 _CNV_R_R_Def_f_uw_b_590_CM -1. 0.9999 FORMAT "%14.5" /end CHARACTERISTIC
/begin CHARACTERISTIC K_MAREGDKMN "Minimalbegrenzung Reglerausgang Mareg Drosselklappe" VALUE 0xa081f546 _REC_VAL_20_s2 1.9999 _CNV_R_R_Def_f_uw_b_590_CM -1. 0.9999 FORMAT "%14.5" /end CHARACTERISTIC
/begin CHARACTERISTIC K_MAREGDKMX "Maximalbegrenzung Reglerausgang Mareg Drosselklappe" VALUE 0xa081f548 _REC_VAL_20_s2 1.9999 _CNV_R_R_Def_f_uw_b_590_CM -1. 0.9999 FORMAT "%14.5" /end CHARACTERISTIC
/begin CHARACTERISTIC K_MAREGDKNN_MN "Minimalbegrenzung Lolimot-Lern Mareg Drosselklappe" VALUE 0xa081f54e _REC_VAL_20_s2 1.9999 _CNV_R_R_Def_f_uw_b_590_CM -1. 0.9999 FORMAT "%14.5" /end CHARACTERISTIC
/begin CHARACTERISTIC K_MAREGDKNN_MX "Maximalbegrenzung Lolimot-Lern Mareg Drosselklappe" VALUE 0xa081f550 _REC_VAL_20_s2 1.9999 _CNV_R_R_Def_f_uw_b_590_CM -1. 0.9999 FORMAT "%14.5" /end CHARACTERISTIC
/begin CHARACTERISTIC K_MRAD_MSN "" VALUE 0xa081f568 _REC_VAL_20_s2 102.398435 _CNV_R_R_Def_ms_uw__594_CM -1024. 1023.9687 /end CHARACTERISTIC
/begin CHARACTERISTIC K_MRDVH_MN "Schwellwert für Freigabe Mareg DK-Adaption abh. von Dhubra" VALUE 0xa081f556 _REC_VAL_20_u2 65.535 _CNV_R_R_Def_hub_uw_589_CM 0. 65.535 /end CHARACTERISTIC
/begin CHARACTERISTIC K_MRD_MN "Schwellwert für Freigabe Mareg DK-Teil abhängig von Dpsfak" VALUE 0xa081f543 _REC_VAL_20_u1 0.996 _CNV_R_R_Def_f_ub_b_553_CM 0. 0.996 /end CHARACTERISTIC
/begin CHARACTERISTIC K_MRD_MS_FAK "Voreinstellung Faktor DK-Regler-Ausgang" VALUE 0xa081f554 _REC_VAL_20_s2 1.9999 _CNV_R_R_Def_f_uw_b_590_CM -1. 0.9999 FORMAT "%14.5" /end CHARACTERISTIC
/begin CHARACTERISTIC K_MRD_MS_OFF "Voreinstellung Offset Hub-Regler-Ausgang" VALUE 0xa081f552 _REC_VAL_20_s2 102.398435 _CNV_R_R_Def_ms_uw__594_CM -1024. 1023.9687 /end CHARACTERISTIC
/begin CHARACTERISTIC K_MRGES_DKMN "" VALUE 0xa081f5ae _REC_VAL_20_s2 1.9999 _CNV_R_R_Def_f_uw_b_590_CM -1. 0.9999 FORMAT "%14.5" /end CHARACTERISTIC
/begin CHARACTERISTIC K_MRGES_DKMX "" VALUE 0xa081f5ac _REC_VAL_20_s2 1.9999 _CNV_R_R_Def_f_uw_b_590_CM -1. 0.9999 FORMAT "%14.5" /end CHARACTERISTIC
/begin CHARACTERISTIC K_MRLINDK_MN "" VALUE 0xa081f5c2 _REC_VAL_20_u2 0.9999 _CNV_R_R_Def_f_uw_b_571_CM 0. 0.9999 FORMAT "%14.5" /end CHARACTERISTIC
/begin CHARACTERISTIC K_MRV_MX "Schwellwert für Freigabe Mareg VVT-Teil abhängig von Dpsfak" VALUE 0xa081f542 _REC_VAL_20_u1 0.996 _CNV_R_R_Def_f_ub_b_553_CM 0. 0.996 /end CHARACTERISTIC
/begin CHARACTERISTIC K_MSBKV_LGMAX "" VALUE 0xa081fc14 _REC_VAL_20_u2 131.07 _CNV_R_R_Def_ml_uw__653_CM 0. 6553.5 FORMAT "%4.1" /end CHARACTERISTIC
/begin CHARACTERISTIC K_MSNLGOFS_MN "" VALUE 0xa081fc0e _REC_VAL_20_s2 102.398435 _CNV_R_R_Def_ms_uw__594_CM -1024. 1023.9687 /end CHARACTERISTIC
/begin CHARACTERISTIC K_MSNLGOFS_MX "" VALUE 0xa081fc10 _REC_VAL_20_s2 102.398435 _CNV_R_R_Def_ms_uw__594_CM -1024. 1023.9687 /end CHARACTERISTIC
/begin CHARACTERISTIC K_MSTE_LGMAX "" VALUE 0xa081fc16 _REC_VAL_20_u2 25.5996 _CNV_R_R_Def_ms_uw__656_CM 0. 25.5996 FORMAT "%7.4" /end CHARACTERISTIC
/begin CHARACTERISTIC K_NADONN "Mareg enable Schwelle, Motordrehzahl" VALUE 0xa081f5b8 _REC_VAL_20_s2 0. _CNV_R_R_Def_n_sw_q_595_CM -32768. 32767. FORMAT "%5.0" /end CHARACTERISTIC
/begin CHARACTERISTIC K_NEDIAGMN "" VALUE 0xa081fe7e _REC_VAL_20_s2 0. _CNV_R_R_Def_n_sw_q_595_CM -32768. 32767. FORMAT "%5.0" /end CHARACTERISTIC
/begin CHARACTERISTIC K_NEDIAGMX "" VALUE 0xa081fe80 _REC_VAL_20_s2 0. _CNV_R_R_Def_n_sw_q_595_CM -32768. 32767. FORMAT "%5.0" /end CHARACTERISTIC
/begin CHARACTERISTIC K_NKWDISADEAK "Deak. Schwelle DISA" VALUE 0xa081eb04 _REC_VAL_20_s2 0. _CNV_R_R_Def_n_sw_q_595_CM -32768. 32767. FORMAT "%5.0" /end CHARACTERISTIC
/begin CHARACTERISTIC K_NKWMAX_LGADA "" VALUE 0xa081fc1c _REC_VAL_20_s2 0. _CNV_R_R_Def_n_sw_q_595_CM -32768. 32767. FORMAT "%5.0" /end CHARACTERISTIC
/begin CHARACTERISTIC K_NKWMIN_LGADA "" VALUE 0xa081fc1a _REC_VAL_20_s2 0. _CNV_R_R_Def_n_sw_q_595_CM -32768. 32767. FORMAT "%5.0" /end CHARACTERISTIC
/begin CHARACTERISTIC K_NKWMIN_MR "Minimaldrehzahl Massenstromregler" VALUE 0xa081f5c4 _REC_VAL_20_s2 0. _CNV_R_R_Def_n_sw_q_595_CM -32768. 32767. FORMAT "%5.0" /end CHARACTERISTIC
/begin CHARACTERISTIC K_NKWMRNN_RAMP "Nkw ramp enable" VALUE 0xa081f5a6 _REC_VAL_20_s2 0. _CNV_R_R_Def_n_sw_q_595_CM -32768. 32767. FORMAT "%5.0" /end CHARACTERISTIC
/begin CHARACTERISTIC K_NKWPSADNN_RAMP "Nkw ramp enable" VALUE 0xa081fc58 _REC_VAL_20_s2 0. _CNV_R_R_Def_n_sw_q_595_CM -32768. 32767. FORMAT "%5.0" /end CHARACTERISTIC
/begin CHARACTERISTIC K_NKW_DISA1 "Obere Hysterese-schwelle DISA (Übergang Disabereich 1->2)" VALUE 0xa081eb08 _REC_VAL_20_s2 0. _CNV_R_R_Def_n_sw_q_595_CM -32768. 32767. FORMAT "%5.0" /end CHARACTERISTIC
/begin CHARACTERISTIC K_NKW_DISA2 "Obere Hysterese-schwelle DISA (Übergang Disabereich 2->3)" VALUE 0xa081eb0a _REC_VAL_20_s2 0. _CNV_R_R_Def_n_sw_q_595_CM -32768. 32767. FORMAT "%5.0" /end CHARACTERISTIC
/begin CHARACTERISTIC K_NMIN_RF_START "min. Drehzahl fuer konst. RF im Start." VALUE 0xa081ea7e _REC_VAL_20_s2 0. _CNV_R_R_Def_n_sw_q_595_CM -32768. 32767. FORMAT "%5.0" /end CHARACTERISTIC
/begin CHARACTERISTIC K_NMN_HFMDPERM "Drehzahl über der B_hfm_diag durch S_HFM_DIAG_PERM gesetzt wird" VALUE 0xa081fef8 _REC_VAL_20_s2 0. _CNV_R_R_Def_n_sw_q_595_CM -32768. 32767. FORMAT "%5.0" /end CHARACTERISTIC
/begin CHARACTERISTIC K_NMSNVTO "" VALUE 0xa081f5c0 _REC_VAL_20_s2 0. _CNV_R_R_Def_n_sw_q_595_CM -32768. 32767. FORMAT "%5.0" /end CHARACTERISTIC
/begin CHARACTERISTIC K_NNADQUOT_DK "Aufteilungsfaktor für DK-Lolimot-KNN" VALUE 0xa081f55c _REC_VAL_20_S4 0. _CNV_R_R_Def_dez_sl_551_CM -1000000000000. 10000000000000. FORMAT "%14.7" /end CHARACTERISTIC
/begin CHARACTERISTIC K_NPK "Schwelle für Pulsationskorrektierung" VALUE 0xa081fc3c _REC_VAL_20_s2 0. _CNV_R_R_Def_n_sw_q_595_CM -32768. 32767. FORMAT "%5.0" /end CHARACTERISTIC
/begin CHARACTERISTIC K_NWASB "Bereich Nockenwellen-Auslassspreizung" VALUE 0xa081eb14 _REC_VAL_20_u2 131.07 _CNV_R_R_Def_spr_sw_561_CM 0. 6553.5 FORMAT "%5.2" /end CHARACTERISTIC
/begin CHARACTERISTIC K_NWESB "Bereich Nockenwellen-Einlassspreizung" VALUE 0xa081eb12 _REC_VAL_20_u2 131.07 _CNV_R_R_Def_spr_sw_561_CM 0. 6553.5 FORMAT "%5.2" /end CHARACTERISTIC
/begin CHARACTERISTIC K_PIRGNN_ANZ "Anzahl Neuronen für PIRG NN" VALUE 0xa081eaea _REC_VAL_20_u1 20. _CNV_R_R_Def_dez_sl_551_CM 0. 20. FORMAT "%3.0" /end CHARACTERISTIC
/begin CHARACTERISTIC K_PIRGWOUT_BIAS "Gewichte des Biasterms der Ausgangschicht, PIRG NN" VALUE 0xa081eb1a _REC_VAL_20_S4 0. _CNV_R_R_Def_dez_sl_551_CM -1000000000000. 10000000000000. FORMAT "%14.7" /end CHARACTERISTIC
/begin CHARACTERISTIC K_PIRG_MN "Kennwert MIN-Grenze Pirg aus N.N." VALUE 0xa081eb10 _REC_VAL_20_u2 102.398436 _CNV_R_R_Def_p_sw_q_576_CM 0. 2559.9609 FORMAT "%5.2" /end CHARACTERISTIC
/begin CHARACTERISTIC K_PKATPAK_MN "" VALUE 0xa0820592 _REC_VAL_20_u2 3.9999 _CNV_R_R_Def_f_sw_b_616_CM 0. 3.9999 FORMAT "%14.5" /end CHARACTERISTIC
/begin CHARACTERISTIC K_PROUT2MS_F "Konvertierungsfaktor Ms to Faktor" VALUE 0xa081fc42 _REC_VAL_20_s2 102.398435 _CNV_R_R_Def_ms_uw__594_CM -1024. 1023.9687 /end CHARACTERISTIC
/begin CHARACTERISTIC K_PR_MS_FAK "Ps-Regler Faktor Ersatzwert" VALUE 0xa081fc3e _REC_VAL_20_u2 1.9999 _CNV_R_R_Def_f_uw_b_590_CM 0. 1.9999 FORMAT "%14.5" /end CHARACTERISTIC
/begin CHARACTERISTIC K_PR_MS_OFF "Ps-Regler Offset Ersatzwert" VALUE 0xa081fc40 _REC_VAL_20_s2 102.398435 _CNV_R_R_Def_ms_uw__594_CM -1024. 1023.9687 /end CHARACTERISTIC
/begin CHARACTERISTIC K_PSMIN "Minimalwert für Ps" VALUE 0xa081fd86 _REC_VAL_20_u2 102.398436 _CNV_R_R_Def_p_sw_q_576_CM 0. 2559.9609 FORMAT "%5.2" /end CHARACTERISTIC
/begin CHARACTERISTIC K_PSOFFMAN "Ps-Sensoroffset wenn S_PSOFFMAN==1" VALUE 0xa081fef4 _REC_VAL_20_s2 102.398436 _CNV_R_R_Def_p_sw_q_576_CM -1280. 1279.9609 FORMAT "%5.2" /end CHARACTERISTIC
/begin CHARACTERISTIC K_PSPVDK_ADONMX "Pspvdk_soll Max Schwelle für Mareg Adaption Freigabe (DK)" VALUE 0xa081f56a _REC_VAL_20_u2 3.9999 _CNV_R_R_Def_f_sw_b_616_CM 0. 3.9999 FORMAT "%14.5" /end CHARACTERISTIC
/begin CHARACTERISTIC K_PSPVDK_INTMN "" VALUE 0xa081fd84 _REC_VAL_20_u2 0.9999 _CNV_R_R_Def_f_uw_b_571_CM 0. 0.9999 FORMAT "%14.5" /end CHARACTERISTIC
/begin CHARACTERISTIC K_PSPVDK_LGMAX "" VALUE 0xa081fc18 _REC_VAL_20_u2 0.9999 _CNV_R_R_Def_f_uw_b_571_CM 0. 0.9999 FORMAT "%14.5" /end CHARACTERISTIC
/begin CHARACTERISTIC K_PSPVDK_MN "Pspvdk_soll Min Schwelle für Druckreglerfreigabe" VALUE 0xa081fc36 _REC_VAL_20_u2 3.9999 _CNV_R_R_Def_f_sw_b_616_CM 0. 3.9999 FORMAT "%14.5" /end CHARACTERISTIC
/begin CHARACTERISTIC K_PSPVDK_MX "Pspvdk_soll Max Schwelle für Druckreglerfreigabe" VALUE 0xa081fc38 _REC_VAL_20_u2 3.9999 _CNV_R_R_Def_f_sw_b_616_CM 0. 3.9999 FORMAT "%14.5" /end CHARACTERISTIC
/begin CHARACTERISTIC K_PSPVK_SOLLMN1 "" VALUE 0xa081f594 _REC_VAL_20_u2 3.9999 _CNV_R_R_Def_f_sw_b_616_CM 0. 3.9999 FORMAT "%14.5" /end CHARACTERISTIC
/begin CHARACTERISTIC K_PSPVK_SOLLMN2 "" VALUE 0xa081f596 _REC_VAL_20_u2 3.9999 _CNV_R_R_Def_f_sw_b_616_CM 0. 3.9999 FORMAT "%14.5" /end CHARACTERISTIC
/begin CHARACTERISTIC K_PSPVK_SOLLMN3 "" VALUE 0xa081f598 _REC_VAL_20_u2 3.9999 _CNV_R_R_Def_f_sw_b_616_CM 0. 3.9999 FORMAT "%14.5" /end CHARACTERISTIC
/begin CHARACTERISTIC K_PSPVK_SOLLMN4 "" VALUE 0xa081f59a _REC_VAL_20_u2 3.9999 _CNV_R_R_Def_f_sw_b_616_CM 0. 3.9999 FORMAT "%14.5" /end CHARACTERISTIC
/begin CHARACTERISTIC K_PSPVK_SOLLMN5 "" VALUE 0xa081f59c _REC_VAL_20_u2 3.9999 _CNV_R_R_Def_f_sw_b_616_CM 0. 3.9999 FORMAT "%14.5" /end CHARACTERISTIC
/begin CHARACTERISTIC K_PSREGIMN "PS-Regler I-Anteil Minimalwert" VALUE 0xa081fc44 _REC_VAL_20_s2 3.9999 _CNV_R_R_Def_f_sw_b_616_CM -2. 1.9999 FORMAT "%14.5" /end CHARACTERISTIC
/begin CHARACTERISTIC K_PSREGIMX "PS-Regler I-Anteil Maximalwert" VALUE 0xa081fc46 _REC_VAL_20_s2 3.9999 _CNV_R_R_Def_f_sw_b_616_CM -2. 1.9999 FORMAT "%14.5" /end CHARACTERISTIC
/begin CHARACTERISTIC K_PSREGMN "PS-Regler Minimalwert" VALUE 0xa081fc08 _REC_VAL_20_s2 3.9999 _CNV_R_R_Def_f_sw_b_616_CM -2. 1.9999 FORMAT "%14.5" /end CHARACTERISTIC
/begin CHARACTERISTIC K_PSREGMX "PS-Regler Maximalwert" VALUE 0xa081fc0a _REC_VAL_20_s2 3.9999 _CNV_R_R_Def_f_sw_b_616_CM -2. 1.9999 FORMAT "%14.5" /end CHARACTERISTIC
/begin CHARACTERISTIC K_PSRON_MSAGRMN "Min. AGR Wert für Freigabe Druckregler" VALUE 0xa081fc4c _REC_VAL_20_u2 102.398435 _CNV_R_R_Def_ms_uw__594_CM 0. 2047.9687 /end CHARACTERISTIC
/begin CHARACTERISTIC K_PSRON_MSAGRMX "Max. AGR Wert für Freigabe Druckregler" VALUE 0xa081fc4e _REC_VAL_20_u2 102.398435 _CNV_R_R_Def_ms_uw__594_CM 0. 2047.9687 /end CHARACTERISTIC
/begin CHARACTERISTIC K_PSRON_NMN "Min. Drehzahl für Freigabe Druckregler" VALUE 0xa081fc50 _REC_VAL_20_s2 0. _CNV_R_R_Def_n_sw_q_595_CM -32768. 32767. FORMAT "%5.0" /end CHARACTERISTIC
/begin CHARACTERISTIC K_PSRON_NMX "Max. Drehzahl für Freigabe Druckregler" VALUE 0xa081fc52 _REC_VAL_20_s2 0. _CNV_R_R_Def_n_sw_q_595_CM -32768. 32767. FORMAT "%5.0" /end CHARACTERISTIC
/begin CHARACTERISTIC K_PSRON_TMMN "Min. Motortemperatur für Freigabe Druckregler" VALUE 0xa081fc54 _REC_VAL_20_s2 98.30250000000001 _CNV_R_R_Def_t_sw_q_579_CM -327.68 327.67 FORMAT "%5.2" /end CHARACTERISTIC
/begin CHARACTERISTIC K_PSSOL_PSREGMX "" VALUE 0xa081fc34 _REC_VAL_20_u2 102.398436 _CNV_R_R_Def_p_sw_q_576_CM 0. 2559.9609 FORMAT "%5.2" /end CHARACTERISTIC
/begin CHARACTERISTIC K_PULSNMN1 "" VALUE 0xa081f576 _REC_VAL_20_s2 0. _CNV_R_R_Def_n_sw_q_595_CM -32768. 32767. FORMAT "%5.0" /end CHARACTERISTIC
/begin CHARACTERISTIC K_PULSNMN2 "" VALUE 0xa081f578 _REC_VAL_20_s2 0. _CNV_R_R_Def_n_sw_q_595_CM -32768. 32767. FORMAT "%5.0" /end CHARACTERISTIC
/begin CHARACTERISTIC K_PULSNMN3 "" VALUE 0xa081f57a _REC_VAL_20_s2 0. _CNV_R_R_Def_n_sw_q_595_CM -32768. 32767. FORMAT "%5.0" /end CHARACTERISTIC
/begin CHARACTERISTIC K_PULSNMN4 "" VALUE 0xa081f57c _REC_VAL_20_s2 0. _CNV_R_R_Def_n_sw_q_595_CM -32768. 32767. FORMAT "%5.0" /end CHARACTERISTIC
/begin CHARACTERISTIC K_PULSNMN5 "" VALUE 0xa081f57e _REC_VAL_20_s2 0. _CNV_R_R_Def_n_sw_q_595_CM -32768. 32767. FORMAT "%5.0" /end CHARACTERISTIC
/begin CHARACTERISTIC K_PULSNMX1 "" VALUE 0xa081f56c _REC_VAL_20_s2 0. _CNV_R_R_Def_n_sw_q_595_CM -32768. 32767. FORMAT "%5.0" /end CHARACTERISTIC
/begin CHARACTERISTIC K_PULSNMX2 "" VALUE 0xa081f56e _REC_VAL_20_s2 0. _CNV_R_R_Def_n_sw_q_595_CM -32768. 32767. FORMAT "%5.0" /end CHARACTERISTIC
/begin CHARACTERISTIC K_PULSNMX3 "" VALUE 0xa081f570 _REC_VAL_20_s2 0. _CNV_R_R_Def_n_sw_q_595_CM -32768. 32767. FORMAT "%5.0" /end CHARACTERISTIC
/begin CHARACTERISTIC K_PULSNMX4 "" VALUE 0xa081f572 _REC_VAL_20_s2 0. _CNV_R_R_Def_n_sw_q_595_CM -32768. 32767. FORMAT "%5.0" /end CHARACTERISTIC
/begin CHARACTERISTIC K_PULSNMX5 "" VALUE 0xa081f574 _REC_VAL_20_s2 0. _CNV_R_R_Def_n_sw_q_595_CM -32768. 32767. FORMAT "%5.0" /end CHARACTERISTIC
/begin CHARACTERISTIC K_PULSRFVMN1 "" VALUE 0xa081f58a _REC_VAL_20_s2 98.30250000000001 _CNV_R_R_Def_rf_sw__598_CM -327.68 327.67 FORMAT "%7.4" /end CHARACTERISTIC
/begin CHARACTERISTIC K_PULSRFVMN2 "" VALUE 0xa081f58c _REC_VAL_20_s2 98.30250000000001 _CNV_R_R_Def_rf_sw__598_CM -327.68 327.67 FORMAT "%7.4" /end CHARACTERISTIC
/begin CHARACTERISTIC K_PULSRFVMN3 "" VALUE 0xa081f58e _REC_VAL_20_s2 98.30250000000001 _CNV_R_R_Def_rf_sw__598_CM -327.68 327.67 FORMAT "%7.4" /end CHARACTERISTIC
/begin CHARACTERISTIC K_PULSRFVMN4 "" VALUE 0xa081f590 _REC_VAL_20_s2 98.30250000000001 _CNV_R_R_Def_rf_sw__598_CM -327.68 327.67 FORMAT "%7.4" /end CHARACTERISTIC
/begin CHARACTERISTIC K_PULSRFVMN5 "" VALUE 0xa081f592 _REC_VAL_20_s2 98.30250000000001 _CNV_R_R_Def_rf_sw__598_CM -327.68 327.67 FORMAT "%7.4" /end CHARACTERISTIC
/begin CHARACTERISTIC K_PULSRFVMX1 "" VALUE 0xa081f580 _REC_VAL_20_s2 98.30250000000001 _CNV_R_R_Def_rf_sw__598_CM -327.68 327.67 FORMAT "%7.4" /end CHARACTERISTIC
/begin CHARACTERISTIC K_PULSRFVMX2 "" VALUE 0xa081f582 _REC_VAL_20_s2 98.30250000000001 _CNV_R_R_Def_rf_sw__598_CM -327.68 327.67 FORMAT "%7.4" /end CHARACTERISTIC
/begin CHARACTERISTIC K_PULSRFVMX3 "" VALUE 0xa081f584 _REC_VAL_20_s2 98.30250000000001 _CNV_R_R_Def_rf_sw__598_CM -327.68 327.67 FORMAT "%7.4" /end CHARACTERISTIC
/begin CHARACTERISTIC K_PULSRFVMX4 "" VALUE 0xa081f586 _REC_VAL_20_s2 98.30250000000001 _CNV_R_R_Def_rf_sw__598_CM -327.68 327.67 FORMAT "%7.4" /end CHARACTERISTIC
/begin CHARACTERISTIC K_PULSRFVMX5 "" VALUE 0xa081f588 _REC_VAL_20_s2 98.30250000000001 _CNV_R_R_Def_rf_sw__598_CM -327.68 327.67 FORMAT "%7.4" /end CHARACTERISTIC
/begin CHARACTERISTIC K_PULSV5 "Fz-Geschwindigkeit" VALUE 0xa081f59e _REC_VAL_20_u2 100.8 _CNV_R_R_Def_v_uw_q_726_CM 0. 360. FORMAT "%5.0" /end CHARACTERISTIC
/begin CHARACTERISTIC K_PUMN_DIAG "Minimal Umgebungsdruck für Freigabe Diagnose" VALUE 0xa081fec8 _REC_VAL_20_u2 102.398436 _CNV_R_R_Def_p_sw_q_576_CM 0. 2559.9609 FORMAT "%5.2" /end CHARACTERISTIC
/begin CHARACTERISTIC K_PUOFFMAN "Pu-Sensoroffset wenn S_PUOFFMAN==1" VALUE 0xa081fef2 _REC_VAL_20_s2 102.398436 _CNV_R_R_Def_p_sw_q_576_CM -1280. 1279.9609 FORMAT "%5.2" /end CHARACTERISTIC
/begin CHARACTERISTIC K_PVDKOFFMAN "Pvdk-Sensoroffset wenn S_PVDKOFFMAN==1" VALUE 0xa081fef0 _REC_VAL_20_s2 102.398436 _CNV_R_R_Def_p_sw_q_576_CM -1280. 1279.9609 FORMAT "%5.2" /end CHARACTERISTIC
/begin CHARACTERISTIC K_RFEDIAGMN "Minimale Rf für Eisy-Diagnose" VALUE 0xa081fe82 _REC_VAL_20_s2 98.30250000000001 _CNV_R_R_Def_rf_sw__598_CM -327.68 327.67 FORMAT "%7.4" /end CHARACTERISTIC
/begin CHARACTERISTIC K_RFEDIAGMX "Maximale Rf für Eisy-Diagnose" VALUE 0xa081fe84 _REC_VAL_20_s2 98.30250000000001 _CNV_R_R_Def_rf_sw__598_CM -327.68 327.67 FORMAT "%7.4" /end CHARACTERISTIC
/begin CHARACTERISTIC K_RFVISTNN_ANZ "Anzahl Neuronen für RFVISTNN" VALUE 0xa081eae9 _REC_VAL_20_u1 20. _CNV_R_R_Def_dez_sl_551_CM 0. 20. FORMAT "%3.0" /end CHARACTERISTIC
/begin CHARACTERISTIC K_RFVISTWOUT_BIAS "Gewichte des Biasterms der Ausgangschicht, RFVISTNN" VALUE 0xa081eb16 _REC_VAL_20_S4 0. _CNV_R_R_Def_dez_sl_551_CM -1000000000000. 10000000000000. FORMAT "%14.7" /end CHARACTERISTIC
/begin CHARACTERISTIC K_TADONTM "Mareg enable Schwelle, Motortemperatur" VALUE 0xa081f5b2 _REC_VAL_20_s2 98.30250000000001 _CNV_R_R_Def_t_sw_q_579_CM -327.68 327.67 FORMAT "%5.2" /end CHARACTERISTIC
/begin CHARACTERISTIC K_TADONTNS "Mareg enable Schwelle, Zeit Nach Start" VALUE 0xa081f5b0 _REC_VAL_20_u2 98.30250000000001 _CNV_R_R_Def_td_uw__673_CM 0. 655.35 FORMAT "%5.2" /end CHARACTERISTIC
/begin CHARACTERISTIC K_TAEDIAGMN "Minimal-Ansauglufttemperatur für Eisy-Diagnose" VALUE 0xa081fe88 _REC_VAL_20_s2 131.07 _CNV_R_R_Def_t_sw_q_578_CM -3276.8 3276.7 FORMAT "%4.1" /end CHARACTERISTIC
/begin CHARACTERISTIC K_TAEDIAGMX "Maximal-Ansauglufttemperatur für Eisy-Diagnose" VALUE 0xa081fe86 _REC_VAL_20_s2 131.07 _CNV_R_R_Def_t_sw_q_578_CM -3276.8 3276.7 FORMAT "%4.1" /end CHARACTERISTIC
/begin CHARACTERISTIC K_TANSMAX_LGADA "" VALUE 0xa081fc20 _REC_VAL_20_s2 131.07 _CNV_R_R_Def_t_sw_q_578_CM -3276.8 3276.7 FORMAT "%4.1" /end CHARACTERISTIC
/begin CHARACTERISTIC K_TANSMIN_LGADA "" VALUE 0xa081fc1e _REC_VAL_20_s2 131.07 _CNV_R_R_Def_t_sw_q_578_CM -3276.8 3276.7 FORMAT "%4.1" /end CHARACTERISTIC
/begin CHARACTERISTIC K_TDADONTAMN "Mareg enable Schwelle, Ansauglufttemperatur" VALUE 0xa081f5b4 _REC_VAL_20_s2 98.30250000000001 _CNV_R_R_Def_t_sw_q_579_CM -327.68 327.67 FORMAT "%5.2" /end CHARACTERISTIC
/begin CHARACTERISTIC K_TDADONTAMX "Mareg enable Schwelle, Ansauglufttemperatur" VALUE 0xa081f5b6 _REC_VAL_20_s2 98.30250000000001 _CNV_R_R_Def_t_sw_q_579_CM -327.68 327.67 FORMAT "%5.2" /end CHARACTERISTIC
/begin CHARACTERISTIC K_TD_DRDIAGLL "" VALUE 0xa081fee6 _REC_VAL_20_u2 131.07 _CNV_R_R_Def_td_ub__574_CM 0. 6553.5 FORMAT "%4.1" /end CHARACTERISTIC
/begin CHARACTERISTIC K_TD_DRDIAGVL "" VALUE 0xa081fee8 _REC_VAL_20_u2 131.07 _CNV_R_R_Def_td_ub__574_CM 0. 6553.5 FORMAT "%4.1" /end CHARACTERISTIC
/begin CHARACTERISTIC K_TD_DRDKWDREHT "Turn-Off-Delay für B_kwdreht" VALUE 0xa081fe69 _REC_VAL_20_u1 25.5 _CNV_R_R_Def_td_ub__574_CM 0. 25.5 FORMAT "%4.1" /end CHARACTERISTIC
/begin CHARACTERISTIC K_TD_EISYD "Zeitkonstante Verzögerung Freigabe Eisy Diagnose durch Dynamikerkennung" VALUE 0xa081fe68 _REC_VAL_20_u1 25.5 _CNV_R_R_Def_td_ub__574_CM 0. 25.5 FORMAT "%4.1" /end CHARACTERISTIC
/begin CHARACTERISTIC K_TD_EVNNUMSCH "DISA umschaltungzeit (segment)" VALUE 0xa081eaf2 _REC_VAL_20_u2 0. _CNV_R_R_Def_dez_sl_551_CM 0. 65535. FORMAT "%5.0" /end CHARACTERISTIC
/begin CHARACTERISTIC K_TD_MODABST "Time Delay Modab-Regler nach Start Ende" VALUE 0xa081f5c6 _REC_VAL_20_u2 131.07 _CNV_R_R_Def_td_ub__574_CM 0. 6553.5 FORMAT "%4.1" /end CHARACTERISTIC
/begin CHARACTERISTIC K_TD_MRADONTE "Time Delay Adapation Start nach Wechsel B_te auf 0" VALUE 0xa081f5c8 _REC_VAL_20_u2 131.07 _CNV_R_R_Def_td_ub__574_CM 0. 6553.5 FORMAT "%4.1" /end CHARACTERISTIC
/begin CHARACTERISTIC K_TD_MSLAMKW "Delta-Winkel für Verzögerungszeitberechnung Rk-Filter" VALUE 0xa0826fe6 _REC_VAL_20_u2 107.518355 _CNV_R_R_Def_kw_sw__603_CM 0. 1535.9765 /end CHARACTERISTIC
/begin CHARACTERISTIC K_TD_NNOFF "Zeit für Filterung des NN Ausgang" VALUE 0xa081f564 _REC_VAL_20_u1 99.45 _CNV_R_R_Def_dez_sl_551_CM 0. 255. FORMAT "%3.0" /end CHARACTERISTIC
/begin CHARACTERISTIC K_TD_NNON "Zeit für Filterung des NN Ausgang" VALUE 0xa081f563 _REC_VAL_20_u1 99.45 _CNV_R_R_Def_dez_sl_551_CM 0. 255. FORMAT "%3.0" /end CHARACTERISTIC
/begin CHARACTERISTIC K_TD_PSRON "" VALUE 0xa081fc3a _REC_VAL_20_u2 0. _CNV_R_R_Def_dez_sl_551_CM 0. 65535. FORMAT "%5.0" /end CHARACTERISTIC
/begin CHARACTERISTIC K_TD_SPUELSPERR "Mslam-Sperrzeit" VALUE 0xa0826fd6 _REC_VAL_20_u1 2.55 _CNV_R_R_Def_td_uw__673_CM 0. 2.55 FORMAT "%5.2" /end CHARACTERISTIC
/begin CHARACTERISTIC K_TIMSALLVT "Turn-on delay B_timsllv" VALUE 0xa081f5be _REC_VAL_20_u2 131.07 _CNV_R_R_Def_td_ub__574_CM 0. 6553.5 FORMAT "%4.1" /end CHARACTERISTIC
/begin CHARACTERISTIC K_TIMSAON "Turn-on delay B_timsvvt" VALUE 0xa081f5ba _REC_VAL_20_u2 131.07 _CNV_R_R_Def_td_ub__574_CM 0. 6553.5 FORMAT "%4.1" /end CHARACTERISTIC
/begin CHARACTERISTIC K_TIMSAVT "Turn-on delay B_timsavvt" VALUE 0xa081f5bc _REC_VAL_20_u2 131.07 _CNV_R_R_Def_td_ub__574_CM 0. 6553.5 FORMAT "%4.1" /end CHARACTERISTIC
/begin CHARACTERISTIC K_TMDMSLMD_OFF "" VALUE 0xa0826fe8 _REC_VAL_20_u2 98.30250000000001 _CNV_R_R_Def_td_uw__673_CM 0. 655.35 FORMAT "%5.2" /end CHARACTERISTIC
/begin CHARACTERISTIC K_TMEDIAGMN "" VALUE 0xa081fe7c _REC_VAL_20_s2 98.30250000000001 _CNV_R_R_Def_t_sw_q_579_CM -327.68 327.67 FORMAT "%5.2" /end CHARACTERISTIC
/begin CHARACTERISTIC K_TMMRNN_RAMP "Tmot ramp enable" VALUE 0xa081f5a4 _REC_VAL_20_s2 98.30250000000001 _CNV_R_R_Def_t_sw_q_579_CM -327.68 327.67 FORMAT "%5.2" /end CHARACTERISTIC
/begin CHARACTERISTIC K_TMOTMAX_LGADA "" VALUE 0xa081fc24 _REC_VAL_20_s2 98.30250000000001 _CNV_R_R_Def_t_sw_q_579_CM -327.68 327.67 FORMAT "%5.2" /end CHARACTERISTIC
/begin CHARACTERISTIC K_TMOTMIN_LGADA "" VALUE 0xa081fc22 _REC_VAL_20_s2 98.30250000000001 _CNV_R_R_Def_t_sw_q_579_CM -327.68 327.67 FORMAT "%5.2" /end CHARACTERISTIC
/begin CHARACTERISTIC K_TMPSADNN_RAMP "Tmot ramp enable" VALUE 0xa081fc56 _REC_VAL_20_s2 98.30250000000001 _CNV_R_R_Def_t_sw_q_579_CM -327.68 327.67 FORMAT "%5.2" /end CHARACTERISTIC
/begin CHARACTERISTIC K_TNSEDIAGMN "" VALUE 0xa081fe7a _REC_VAL_20_u2 98.30250000000001 _CNV_R_R_Def_td_uw__673_CM 0. 655.35 FORMAT "%5.2" /end CHARACTERISTIC
/begin CHARACTERISTIC K_TNSMN_HFMPERM "Zeit nach Start nach der B_hfm_diag durch S_HFM_DIAG_PERM gesetzt wird" VALUE 0xa081fef6 _REC_VAL_20_u2 98.30250000000001 _CNV_R_R_Def_td_uw__673_CM 0. 655.35 FORMAT "%5.2" /end CHARACTERISTIC
/begin CHARACTERISTIC K_TNSMRNN_RAMP "Zeit nach Start ramp enable" VALUE 0xa081f5a8 _REC_VAL_20_u2 98.30250000000001 _CNV_R_R_Def_td_uw__673_CM 0. 655.35 FORMAT "%5.2" /end CHARACTERISTIC
/begin CHARACTERISTIC K_TNSPSADNN_RAMP "Zeit nach Start ramp enable" VALUE 0xa081fc5a _REC_VAL_20_u2 98.30250000000001 _CNV_R_R_Def_td_uw__673_CM 0. 655.35 FORMAT "%5.2" /end CHARACTERISTIC
/begin CHARACTERISTIC K_TVSAMSLAM "Verzögerungszeit für B_sa" VALUE 0xa0826fe0 _REC_VAL_20_u2 98.30250000000001 _CNV_R_R_Def_td_uw__673_CM 0. 655.35 FORMAT "%5.2" /end CHARACTERISTIC
/begin CHARACTERISTIC K_TVSAVMSLAM "Verzögerungszeit für B_sa, im LL" VALUE 0xa0826fe2 _REC_VAL_20_u2 98.30250000000001 _CNV_R_R_Def_td_uw__673_CM 0. 655.35 FORMAT "%5.2" /end CHARACTERISTIC
/begin CHARACTERISTIC K_UBATTMIN_DIAGPL "Minimale Batteriespannung für Eisy Diagnose" VALUE 0xa081fe74 _REC_VAL_20_u2 123.46794 _CNV_R_R_Def_u_sb_q_583_CM 0. 6173.397 FORMAT "%4.1" /end CHARACTERISTIC
/begin CHARACTERISTIC K_UBATTMIN_DPSRDIAG "Minimale Batteriespannung für DPSR und Disa Diagnose" VALUE 0xa081fe76 _REC_VAL_20_u2 123.46794 _CNV_R_R_Def_u_sb_q_583_CM 0. 6173.397 FORMAT "%4.1" /end CHARACTERISTIC
/begin CHARACTERISTIC K_UBATTMIN_HFMDIAG "Minimale Batteriespannung für HFM-Diagnose" VALUE 0xa081fe78 _REC_VAL_20_u2 123.46794 _CNV_R_R_Def_u_sb_q_583_CM 0. 6173.397 FORMAT "%4.1" /end CHARACTERISTIC
/begin CHARACTERISTIC K_UFAK_MS_RF "Faktor Massenstrom in relative Luftfuellung" VALUE 0xa081ea7c _REC_VAL_20_u2 0.2441 _CNV_R_R_Def_umr_uw_776_CM 0. 0.2441 FORMAT "%14.6" /end CHARACTERISTIC
/begin CHARACTERISTIC K_VSAOFF "" VALUE 0xa081eaee _REC_VAL_20_u2 131.07 _CNV_R_R_Def_spr_sw_561_CM 0. 6553.5 FORMAT "%5.2" /end CHARACTERISTIC
/begin CHARACTERISTIC K_VSEOFF "" VALUE 0xa081eaec _REC_VAL_20_u2 131.07 _CNV_R_R_Def_spr_sw_561_CM 0. 6553.5 FORMAT "%5.2" /end CHARACTERISTIC
/begin CHARACTERISTIC K_WDKIST_LGMAX "" VALUE 0xa081fc12 _REC_VAL_20_s2 95.99852999999999 _CNV_R_R_Def_wdk_sw_683_CM -800. 799.9755 FORMAT "%5.2" /end CHARACTERISTIC
/begin CHARACTERISTIC K_WDKMN_DDPSR "Minimal DK-Winkel für Freigabe DPSR-Diagnose" VALUE 0xa081feca _REC_VAL_20_s2 95.99852999999999 _CNV_R_R_Def_wdk_sw_683_CM -800. 799.9755 FORMAT "%5.2" /end CHARACTERISTIC
/begin CHARACTERISTIC K_ZKDIAG_HQ "" VALUE 0xa081fe8a _REC_VAL_20_u2 6553.5 _CNV_R_R_Def_zk100m_739_CM 0.1 6553.6 FORMAT "%4.1" /end CHARACTERISTIC
/begin CHARACTERISTIC K_ZKDIAG_MSLQ "" VALUE 0xa081fe8e _REC_VAL_20_u2 6553.5 _CNV_R_R_Def_zk100m_739_CM 0.1 6553.6 FORMAT "%4.1" /end CHARACTERISTIC
/begin CHARACTERISTIC K_ZKDIAG_PS "" VALUE 0xa081fe90 _REC_VAL_20_u2 6553.5 _CNV_R_R_Def_zk100m_739_CM 0.1 6553.6 FORMAT "%4.1" /end CHARACTERISTIC
/begin CHARACTERISTIC K_ZKDIAG_WDKPS "" VALUE 0xa081fe92 _REC_VAL_20_u2 6553.5 _CNV_R_R_Def_zk100m_739_CM 0.1 6553.6 FORMAT "%4.1" /end CHARACTERISTIC
/begin CHARACTERISTIC K_ZK_DIAGPSREG "Zeitkonstante Filterung AGR-Diag" VALUE 0xa081fe8c _REC_VAL_20_u2 6553.5 _CNV_R_R_Def_zk100m_739_CM 0.1 6553.6 FORMAT "%4.1" /end CHARACTERISTIC
/begin CHARACTERISTIC K_ZK_EISYDSTN "Filterkonstante Drehzahlfilterung für Dynamikerkennung Eisy Diagnose" VALUE 0xa081feb8 _REC_VAL_20_u2 0.9999 _CNV_R_R_Def_f_uw_b_571_CM 0. 0.9999 FORMAT "%14.5" /end CHARACTERISTIC
/begin CHARACTERISTIC K_ZK_EISYDSTRF "Filterkonstante Lastfilterung für Dynamikerkennung Eisy Diagnose" VALUE 0xa081feba _REC_VAL_20_u2 0.9999 _CNV_R_R_Def_f_uw_b_571_CM 0. 0.9999 FORMAT "%14.5" /end CHARACTERISTIC
/begin CHARACTERISTIC K_ZK_EVMRASPR "Zeitkonstante fuer 10ms Filterzyklus" VALUE 0xa081eafc _REC_VAL_20_u2 655.35 _CNV_R_R_Def_zk10ms_715_CM 1.e-002 655.36 FORMAT "%7.4" /end CHARACTERISTIC
/begin CHARACTERISTIC K_ZK_EVMRESPR "Zeitkonstante fuer 10ms Filterzyklus" VALUE 0xa081eafa _REC_VAL_20_u2 655.35 _CNV_R_R_Def_zk10ms_715_CM 1.e-002 655.36 FORMAT "%7.4" /end CHARACTERISTIC
/begin CHARACTERISTIC K_ZK_EVMRHUB "Zeitkonstante fuer 10ms Filterzyklus" VALUE 0xa081eaf8 _REC_VAL_20_u2 655.35 _CNV_R_R_Def_zk10ms_715_CM 1.e-002 655.36 FORMAT "%7.4" /end CHARACTERISTIC
/begin CHARACTERISTIC K_ZK_EVNNUMSCH "Zeitkonstante fuer 10ms Filterzyklus" VALUE 0xa081eaf4 _REC_VAL_20_u2 655.35 _CNV_R_R_Def_zk10ms_715_CM 1.e-002 655.36 FORMAT "%7.4" /end CHARACTERISTIC
/begin CHARACTERISTIC K_ZK_MRDKOFF "Massenstromregler Aus" VALUE 0xa081f544 _REC_VAL_20_u2 31.99950000000001 _CNV_R_R_Def_f_uw_b_588_CM 0. 31.9995 FORMAT "%7.4" /end CHARACTERISTIC
/begin CHARACTERISTIC K_ZK_MRRAMP "Ramp gradient" VALUE 0xa081f5aa _REC_VAL_20_u2 0.9999 _CNV_R_R_Def_f_uw_b_571_CM 0. 0.9999 FORMAT "%14.5" /end CHARACTERISTIC
/begin CHARACTERISTIC K_ZK_MSNLGOFS "" VALUE 0xa081fc0c _REC_VAL_20_u2 0.9999 _CNV_R_R_Def_f_uw_b_571_CM 0. 0.9999 FORMAT "%14.5" /end CHARACTERISTIC
/begin CHARACTERISTIC K_ZK_NNOFF "" VALUE 0xa081f5a2 _REC_VAL_20_u2 0.9999 _CNV_R_R_Def_f_uw_b_571_CM 0. 0.9999 FORMAT "%14.5" /end CHARACTERISTIC
/begin CHARACTERISTIC K_ZK_NNON "" VALUE 0xa081f5a0 _REC_VAL_20_u2 0.9999 _CNV_R_R_Def_f_uw_b_571_CM 0. 0.9999 FORMAT "%14.5" /end CHARACTERISTIC
/begin CHARACTERISTIC K_ZK_PIRGF "Zeitkonstante fuer 10ms Filterzyklus" VALUE 0xa081eaf6 _REC_VAL_20_u2 655.35 _CNV_R_R_Def_zk10ms_715_CM 1.e-002 655.36 FORMAT "%7.4" /end CHARACTERISTIC
/begin CHARACTERISTIC K_ZK_PSADRAMP "Ramp gradient" VALUE 0xa081fc5c _REC_VAL_20_u2 1.9999 _CNV_R_R_Def_f_uw_b_590_CM 0. 1.9999 FORMAT "%14.5" /end CHARACTERISTIC
/begin CHARACTERISTIC K_ZK_PSROFF "Faktor zur Gegenkopplung AGR-Regler" VALUE 0xa081fc2c _REC_VAL_20_u1 1.9921 _CNV_R_R_Def_f_ub_b_613_CM 0. 1.9921 /end CHARACTERISTIC
/begin CHARACTERISTIC K_ZK_SPRUEF "Zeitkonstante fuer 10ms Filterzyklus" VALUE 0xa081eb06 _REC_VAL_20_u2 655.35 _CNV_R_R_Def_zk10ms_715_CM 1.e-002 655.36 FORMAT "%7.4" /end CHARACTERISTIC
/begin CHARACTERISTIC K_ZK_TURBINE "Zeitkonstante Turbolader" VALUE 0xa0820594 _REC_VAL_20_u2 0.9999847412109381 _CNV_R_R_Def_f_uw_b_571_CM 0. 0.9999847412109381 FORMAT "%14.5" /end CHARACTERISTIC
/begin CHARACTERISTIC S_ADP_RESET "Reset Adaptionswerte" VALUE 0xa081f53b _REC_VAL_20_u1 99.45 _CNV_R_R_Def_dez_sl_551_CM 0. 255. FORMAT "%3.0" /end CHARACTERISTIC
/begin CHARACTERISTIC S_BERMSLAMON "Schalter MSLAM berechnen erzwingen" VALUE 0xa0826fcd _REC_VAL_20_u1 99.45 _CNV_R_R_Def_dez_sl_551_CM 0. 255. FORMAT "%3.0" /end CHARACTERISTIC
/begin CHARACTERISTIC S_BTE_EDIAG "Schaltet B_te abfrage zu B_eisyd_on zu" VALUE 0xa081fe64 _REC_VAL_20_u1 99.45 _CNV_R_R_Def_dez_sl_551_CM 0. 255. FORMAT "%3.0" /end CHARACTERISTIC
/begin CHARACTERISTIC S_BTE_MR "Schaltet !B_te zu B_mradon zu" VALUE 0xa081f561 _REC_VAL_20_u1 99.45 _CNV_R_R_Def_dez_sl_551_CM 0. 255. FORMAT "%3.0" /end CHARACTERISTIC
/begin CHARACTERISTIC S_DISADIAGST_ON "Freigabe Einrechnung Dynamikerkennung in Eisy Diagnose DISA" VALUE 0xa081fe59 _REC_VAL_20_u1 1. _CNV_R_R_Def_dez_sl_551_CM 0. 1. FORMAT "%3.0" /end CHARACTERISTIC
/begin CHARACTERISTIC S_DISAD_APP "Wenn ==1, dann ist B_disa_diag == TRUE" VALUE 0xa081fe63 _REC_VAL_20_u1 99.45 _CNV_R_R_Def_dez_sl_551_CM 0. 255. FORMAT "%3.0" /end CHARACTERISTIC
/begin CHARACTERISTIC S_DISA_DIAG "" VALUE 0xa081fe5f _REC_VAL_20_u1 99.45 _CNV_R_R_Def_dez_sl_551_CM 0. 255. FORMAT "%3.0" /end CHARACTERISTIC
/begin CHARACTERISTIC S_DKNNON "Schalter Lolimot-KNN DK-Zweig ein/aus" VALUE 0xa081f53c _REC_VAL_20_u1 99.45 _CNV_R_R_Def_dez_sl_551_CM 0. 255. FORMAT "%3.0" /end CHARACTERISTIC
/begin CHARACTERISTIC S_DPSRDIAGST_ON "Freigabe Einrechnung Dynamikerkennung in Eisy Diagnose DPSR" VALUE 0xa081fe56 _REC_VAL_20_u1 1. _CNV_R_R_Def_dez_sl_551_CM 0. 1. FORMAT "%3.0" /end CHARACTERISTIC
/begin CHARACTERISTIC S_DPSR_DIAG "" VALUE 0xa081fe5d _REC_VAL_20_u1 99.45 _CNV_R_R_Def_dez_sl_551_CM 0. 255. FORMAT "%3.0" /end CHARACTERISTIC
/begin CHARACTERISTIC S_DRDIAG_ON "Schalter Drucksensorabgleich auszufuhren" VALUE 0xa081fe50 _REC_VAL_20_u1 1. _CNV_R_R_Def_dez_sl_551_CM 0. 1. FORMAT "%3.0" /end CHARACTERISTIC
/begin CHARACTERISTIC S_DRDIAG_PSREF "Schalter Ps-Sensor als Refferenz für Drucksensorabgleich" VALUE 0xa081fe51 _REC_VAL_20_u1 1. _CNV_R_R_Def_dez_sl_551_CM 0. 1. FORMAT "%3.0" /end CHARACTERISTIC
/begin CHARACTERISTIC S_DRDIAG_RESET "Schalter" VALUE 0xa081fecc _REC_VAL_20_u2 0. _CNV_R_R_Def_dez_sl_551_CM 0. 65535. FORMAT "%5.0" /end CHARACTERISTIC
/begin CHARACTERISTIC S_EISYAD_TST "" VALUE 0xa081f538 _REC_VAL_20_u1 99.45 _CNV_R_R_Def_dez_sl_551_CM 0. 255. FORMAT "%3.0" /end CHARACTERISTIC
/begin CHARACTERISTIC S_EISYD_APP "Wenn ==1, dann ist B_eisy_diag == TRUE" VALUE 0xa081fe62 _REC_VAL_20_u1 99.45 _CNV_R_R_Def_dez_sl_551_CM 0. 255. FORMAT "%3.0" /end CHARACTERISTIC
/begin CHARACTERISTIC S_EISYD_RF "Schalter zum Wechseln Rf Eingang für Rf Dynamikerkennung Eisy Diagnose" VALUE 0xa081fe55 _REC_VAL_20_u1 1. _CNV_R_R_Def_dez_sl_551_CM 0. 1. FORMAT "%3.0" /end CHARACTERISTIC
/begin CHARACTERISTIC S_EISYEV_DISAISTON "Umschaltung DISA Bereiche auf Disa_ist" VALUE 0xa081eae6 _REC_VAL_20_u1 1. _CNV_R_R_Def_dez_sl_551_CM 0. 1. FORMAT "%3.0" /end CHARACTERISTIC
/begin CHARACTERISTIC S_EVNN_AUS "Schalter N.N. zum ausschalten" VALUE 0xa081ea79 _REC_VAL_20_u1 99.45 _CNV_R_R_Def_dez_sl_551_CM 0. 255. FORMAT "%3.0" /end CHARACTERISTIC
/begin CHARACTERISTIC S_HFMDIAGST_ON "Freigabe Einrechnung Dynamikerkennung in Eisy Diagnose HFM" VALUE 0xa081fe57 _REC_VAL_20_u1 1. _CNV_R_R_Def_dez_sl_551_CM 0. 1. FORMAT "%3.0" /end CHARACTERISTIC
/begin CHARACTERISTIC S_HFMDIAGTE_OFF "Freigabe Einrechnung TE erkennung in Eisy Diagnose HFM" VALUE 0xa081fe5a _REC_VAL_20_u1 1. _CNV_R_R_Def_dez_sl_551_CM 0. 1. FORMAT "%3.0" /end CHARACTERISTIC
/begin CHARACTERISTIC S_HFMD_SAON "Schaltet !B_sa zu Bildung B_hfm_diag zu" VALUE 0xa081fe66 _REC_VAL_20_u1 99.45 _CNV_R_R_Def_dez_sl_551_CM 0. 255. FORMAT "%3.0" /end CHARACTERISTIC
/begin CHARACTERISTIC S_HFM_DIAG "" VALUE 0xa081fe5c _REC_VAL_20_u1 99.45 _CNV_R_R_Def_dez_sl_551_CM 0. 255. FORMAT "%3.0" /end CHARACTERISTIC
/begin CHARACTERISTIC S_HFM_DIAG_PERM "" VALUE 0xa081fe5b _REC_VAL_20_u1 99.45 _CNV_R_R_Def_dez_sl_551_CM 0. 255. FORMAT "%3.0" /end CHARACTERISTIC
/begin CHARACTERISTIC S_LAM_SON "Schalter Zulieferer-Lambda oder Kennfeld-Lambda" VALUE 0xa0826fcc _REC_VAL_20_u1 99.45 _CNV_R_R_Def_dez_sl_551_CM 0. 255. FORMAT "%3.0" /end CHARACTERISTIC
/begin CHARACTERISTIC S_MAREGOFF "Schalter Mareg Ausgang komplett ein/aus" VALUE 0xa081f53d _REC_VAL_20_u1 99.45 _CNV_R_R_Def_dez_sl_551_CM 0. 255. FORMAT "%3.0" /end CHARACTERISTIC
/begin CHARACTERISTIC S_MDARV_AKT "Schalter Misfirediagnose zu aktivieren" VALUE 0xa0826fd2 _REC_VAL_20_u1 99.45 _CNV_R_R_Def_dez_sl_551_CM 0. 255. FORMAT "%3.0" /end CHARACTERISTIC
/begin CHARACTERISTIC S_MODABLLTD_OFF "Deaktivieren Modabreglerauschaltung bei Teildrosselung" VALUE 0xa081f566 _REC_VAL_20_u1 99.45 _CNV_R_R_Def_dez_sl_551_CM 0. 255. FORMAT "%3.0" /end CHARACTERISTIC
/begin CHARACTERISTIC S_MODABTE_OFF "Schaltet !B_te bei Berechnung B_modab_on hinzu" VALUE 0xa081f565 _REC_VAL_20_u1 99.45 _CNV_R_R_Def_dez_sl_551_CM 0. 255. FORMAT "%3.0" /end CHARACTERISTIC
/begin CHARACTERISTIC S_MRD_MS_FAK "Umschalter DK-Regler Faktor oder Offset" VALUE 0xa081f53f _REC_VAL_20_u1 99.45 _CNV_R_R_Def_dez_sl_551_CM 0. 255. FORMAT "%3.0" /end CHARACTERISTIC
/begin CHARACTERISTIC S_MROFF_KSD "Schaltet KSD ein/aus Mareg auszuschalten" VALUE 0xa081f560 _REC_VAL_20_u1 99.45 _CNV_R_R_Def_dez_sl_551_CM 0. 255. FORMAT "%3.0" /end CHARACTERISTIC
/begin CHARACTERISTIC S_MR_MS_FAK "Umschalter Hub-Regler Faktor oder Offset" VALUE 0xa081f53e _REC_VAL_20_u1 99.45 _CNV_R_R_Def_dez_sl_551_CM 0. 255. FORMAT "%3.0" /end CHARACTERISTIC
/begin CHARACTERISTIC S_MSDIAGST_ON "Freigabe Einrechnung Dynamikerkennung in Eisy Diagnose MSLAM" VALUE 0xa081fe58 _REC_VAL_20_u1 1. _CNV_R_R_Def_dez_sl_551_CM 0. 1. FORMAT "%3.0" /end CHARACTERISTIC
/begin CHARACTERISTIC S_MSLAMMDSTP_ENTP "Schalter Entprellterfehler zu nutzen" VALUE 0xa0826fd3 _REC_VAL_20_u1 99.45 _CNV_R_R_Def_dez_sl_551_CM 0. 255. FORMAT "%3.0" /end CHARACTERISTIC
/begin CHARACTERISTIC S_MSLAM_DIAG "" VALUE 0xa081fe5e _REC_VAL_20_u1 99.45 _CNV_R_R_Def_dez_sl_551_CM 0. 255. FORMAT "%3.0" /end CHARACTERISTIC
/begin CHARACTERISTIC S_MSTE_KOR "Schalter Korrektur Massenstrom über Mste" VALUE 0xa0826fcf _REC_VAL_20_u1 99.45 _CNV_R_R_Def_dez_sl_551_CM 0. 255. FORMAT "%3.0" /end CHARACTERISTIC
/begin CHARACTERISTIC S_MSZYLDIAG_MOD "Wenn = 1, dann Mszyl Diagnose über Modelwert Ps" VALUE 0xa081fe60 _REC_VAL_20_u1 99.45 _CNV_R_R_Def_dez_sl_551_CM 0. 255. FORMAT "%3.0" /end CHARACTERISTIC
/begin CHARACTERISTIC S_MSZYL_3MOD "" VALUE 0xa081ea7a _REC_VAL_20_u1 99.45 _CNV_R_R_Def_dez_sl_551_CM 0. 255. FORMAT "%3.0" /end CHARACTERISTIC
/begin CHARACTERISTIC S_NPL_RESET "Reset Adaptionswerte, NPL" VALUE 0xa081f53a _REC_VAL_20_u1 99.45 _CNV_R_R_Def_dez_sl_551_CM 0. 255. FORMAT "%3.0" /end CHARACTERISTIC
/begin CHARACTERISTIC S_PIRGKON "Pirg Korrigierung vom Massenstromregler" VALUE 0xa081eae8 _REC_VAL_20_u1 99.45 _CNV_R_R_Def_dez_sl_551_CM 0. 255. FORMAT "%3.0" /end CHARACTERISTIC
/begin CHARACTERISTIC S_PIRG_NLEV "Schalter Steigungskorrektur Schluckgerade" VALUE 0xa081eae2 _REC_VAL_20_u1 1. _CNV_R_R_Def_dez_sl_551_CM 0. 1. FORMAT "%3.0" /end CHARACTERISTIC
/begin CHARACTERISTIC S_PREGSOL "Schalter Regelung mit Ps oder Pssol" VALUE 0xa081fc28 _REC_VAL_20_u1 1. _CNV_R_R_Def_dez_sl_551_CM 0. 1. FORMAT "%3.0" /end CHARACTERISTIC
/begin CHARACTERISTIC S_PR_MS_FAK "Schalter Regler Ausgang Berechnung Modus" VALUE 0xa081fc29 _REC_VAL_20_u1 1. _CNV_R_R_Def_dez_sl_551_CM 0. 1. FORMAT "%3.0" /end CHARACTERISTIC
/begin CHARACTERISTIC S_PSOFFMAN "Schalter Ps-Sensoroffset über Applikation" VALUE 0xa081fe53 _REC_VAL_20_u1 1. _CNV_R_R_Def_dez_sl_551_CM 0. 1. FORMAT "%3.0" /end CHARACTERISTIC
/begin CHARACTERISTIC S_PSPN_OFF "Pspn Korrigierung Auschaltung" VALUE 0xa081eae7 _REC_VAL_20_u1 1. _CNV_R_R_Def_dez_sl_551_CM 0. 1. FORMAT "%3.0" /end CHARACTERISTIC
/begin CHARACTERISTIC S_PSREGOFF "Schalter Differenzdruck Saugrohr Adaption ausgeschaltet" VALUE 0xa081fc27 _REC_VAL_20_u1 1. _CNV_R_R_Def_dez_sl_551_CM 0. 1. FORMAT "%3.0" /end CHARACTERISTIC
/begin CHARACTERISTIC S_PSRVLOFF "Schaltet !B_vl zu B_psreg_akt (bei CW_MPR_KOORD = 0x1)" VALUE 0xa081fc2a _REC_VAL_20_u1 1. _CNV_R_R_Def_dez_sl_551_CM 0. 1. FORMAT "%3.0" /end CHARACTERISTIC
/begin CHARACTERISTIC S_PUOFFMAN "Schalter Pu-Sensoroffset über Applikation" VALUE 0xa081fe54 _REC_VAL_20_u1 1. _CNV_R_R_Def_dez_sl_551_CM 0. 1. FORMAT "%3.0" /end CHARACTERISTIC
/begin CHARACTERISTIC S_PVDKOFFMAN "Schalter Pvdk-Sensoroffset über Applikation" VALUE 0xa081fe52 _REC_VAL_20_u1 1. _CNV_R_R_Def_dez_sl_551_CM 0. 1. FORMAT "%3.0" /end CHARACTERISTIC
/begin CHARACTERISTIC S_RFVISTHUB "Umschaltung" VALUE 0xa081eae5 _REC_VAL_20_u1 1. _CNV_R_R_Def_dez_sl_551_CM 0. 1. FORMAT "%3.0" /end CHARACTERISTIC
/begin CHARACTERISTIC S_RKTEV_KOR "Schalter Korrektur Massenstrom über Rktev" VALUE 0xa0826fce _REC_VAL_20_u1 99.45 _CNV_R_R_Def_dez_sl_551_CM 0. 255. FORMAT "%3.0" /end CHARACTERISTIC
/begin CHARACTERISTIC S_SDF_ABS "Schalter Absolutdrucksensor eingebaut" VALUE 0xa081fc26 _REC_VAL_20_u1 1. _CNV_R_R_Def_dez_sl_551_CM 0. 1. FORMAT "%3.0" /end CHARACTERISTIC
/begin CHARACTERISTIC S_SRSTAB_PIRG "SR Stabilisierung mit Pirg eingeschaltet" VALUE 0xa081fd80 _REC_VAL_20_u1 99.45 _CNV_R_R_Def_dez_sl_551_CM 0. 255. FORMAT "%3.0" /end CHARACTERISTIC
/begin CHARACTERISTIC S_TALEER_DIS "Wenn = 1, Tank leer Diagnose ausgeschaltet" VALUE 0xa081fe61 _REC_VAL_20_u1 99.45 _CNV_R_R_Def_dez_sl_551_CM 0. 255. FORMAT "%3.0" /end CHARACTERISTIC
/begin CHARACTERISTIC S_TALEER_MR "B_taleer sperrt Adaption" VALUE 0xa081f539 _REC_VAL_20_u1 99.45 _CNV_R_R_Def_dez_sl_551_CM 0. 255. FORMAT "%3.0" /end CHARACTERISTIC
/begin CHARACTERISTIC S_TEMSLAM "Schalter Freigabe MSLAM über B_te" VALUE 0xa0826fd1 _REC_VAL_20_u1 99.45 _CNV_R_R_Def_dez_sl_551_CM 0. 255. FORMAT "%3.0" /end CHARACTERISTIC
/begin CHARACTERISTIC S_TEMXMSLAM "Schalter Freigabe MSLAM über B_temson" VALUE 0xa0826fd0 _REC_VAL_20_u1 99.45 _CNV_R_R_Def_dez_sl_551_CM 0. 255. FORMAT "%3.0" /end CHARACTERISTIC
/begin CHARACTERISTIC S_WDKDIAG_PSMOD "Schaltet zwischen Klaf_outdk und Klaf_outwdkdiag um" VALUE 0xa081fe65 _REC_VAL_20_u1 99.45 _CNV_R_R_Def_dez_sl_551_CM 0. 255. FORMAT "%3.0" /end CHARACTERISTIC
/begin COMPU_METHOD _CNV_R_R_Def_dez_sl_551_CM "Def_dez_sl_q1" RAT_FUNC "%6.3" "-" COEFFS 0. 1. 0. 0. 0. 1. /end COMPU_METHOD
/begin COMPU_METHOD _CNV_R_R_Def_f_ub_b_553_CM "Def_f_ub_b1" RAT_FUNC "%6.3" "-" COEFFS 0. 256. 0. 0. 0. 1. /end COMPU_METHOD
/begin COMPU_METHOD _CNV_R_R_Def_f_uw_b_555_CM "Def_f_uw_b100" RAT_FUNC "%6.3" "%" COEFFS 0. 65536. 0. 0. 0. 100. /end COMPU_METHOD
/begin COMPU_METHOD _CNV_R_R_Def_f_sw_b_556_CM "Def_f_sw_b32" RAT_FUNC "%6.3" "-" COEFFS 0. 32768. 0. 0. 0. 32. /end COMPU_METHOD
/begin COMPU_METHOD _CNV_R_R_Def_f_uw_b_559_CM "Def_f_uw_b16" RAT_FUNC "%6.3" "-" COEFFS 0. 65536. 0. 0. 0. 16. /end COMPU_METHOD
/begin COMPU_METHOD _CNV_R_R_Def_spr_sw_561_CM "Def_spr_sw_q0p1" RAT_FUNC "%6.3" "° KW" COEFFS 0. 10. 0. 0. 0. 1. /end COMPU_METHOD
/begin COMPU_METHOD _CNV_S_2_Def_bit_ub_563_CM "Def_bit_ub_0" TAB_VERB "%6.3" "-" COMPU_TAB_REF _CNV_S_2_Def_bit_ub_563 /end COMPU_METHOD
/begin COMPU_VTAB _CNV_S_2_Def_bit_ub_563 "Def_bit_ub_0" TAB_VERB 2 0 "FALSE" 1 "TRUE" /end COMPU_VTAB
/begin COMPU_METHOD _CNV_S_2_Def_bool_564_CM "Def_bool" TAB_VERB "%6.3" "-" COMPU_TAB_REF _CNV_S_2_Def_bool_564 /end COMPU_METHOD
/begin COMPU_VTAB _CNV_S_2_Def_bool_564 "Def_bool" TAB_VERB 2 0 "false" 1 "true" /end COMPU_VTAB
/begin COMPU_METHOD _CNV_R_R_Def_f_uw_b_571_CM "Def_f_uw_b1" RAT_FUNC "%6.3" "-" COEFFS 0. 65536. 0. 0. 0. 1. /end COMPU_METHOD
/begin COMPU_METHOD _CNV_R_R_Def_td_ub__574_CM "Def_td_ub_q0p1" RAT_FUNC "%6.3" "s" COEFFS 0. 10. 0. 0. 0. 1. /end COMPU_METHOD
/begin COMPU_METHOD _CNV_R_R_Def_p_sw_q_576_CM "Def_p_sw_q0p039" RAT_FUNC "%6.3" "hPa" COEFFS 0. 256. 0. 0. 0. 10. /end COMPU_METHOD
/begin COMPU_METHOD _CNV_R_R_Def_t_sw_q_578_CM "Def_t_sw_q0p1" RAT_FUNC "%6.3" "°C" COEFFS 0. 10. 0. 0. 0. 1. /end COMPU_METHOD
/begin COMPU_METHOD _CNV_R_R_Def_t_sw_q_579_CM "Def_t_sw_q0p01" RAT_FUNC "%6.3" "°C" COEFFS 0. 100. 0. 0. 0. 1. /end COMPU_METHOD
/begin COMPU_METHOD _CNV_R_R_Def_u_sw_q_580_CM "Def_u_sw_q0p00488" RAT_FUNC "%6.3" "V" COEFFS 0. 1024. 0. 0. 0. 5. /end COMPU_METHOD
/begin COMPU_METHOD _CNV_R_R_Def_u_sb_q_583_CM "Def_u_sb_q0p0942" RAT_FUNC "%6.3" "V" COEFFS 0. 1. 0. 0. 0. 9.420000000000001e-002 /end COMPU_METHOD
/begin COMPU_METHOD _CNV_R_R_Def_f_uw_b_588_CM "Def_f_uw_b32" RAT_FUNC "%6.3" "-" COEFFS 0. 65536. 0. 0. 0. 32. /end COMPU_METHOD
/begin COMPU_METHOD _CNV_R_R_Def_hub_uw_589_CM "Def_hub_uw_q0p001" RAT_FUNC "%6.3" "mm" COEFFS 0. 1000. 0. 0. 0. 1. /end COMPU_METHOD
/begin COMPU_METHOD _CNV_R_R_Def_f_uw_b_590_CM "Def_f_uw_b2" RAT_FUNC "%6.3" "-" COEFFS 0. 65536. 0. 0. 0. 2. /end COMPU_METHOD
/begin COMPU_METHOD _CNV_R_R_Def_f_sw_b_591_CM "Def_f_sw_b4" RAT_FUNC "%6.3" "-" COEFFS 0. 32768. 0. 0. 0. 4. /end COMPU_METHOD
/begin COMPU_METHOD _CNV_R_R_Def_ms_uw__594_CM "Def_ms_uw_q0p03125" RAT_FUNC "%6.3" "kg/h" COEFFS 0. 32. 0. 0. 0. 1. /end COMPU_METHOD
/begin COMPU_METHOD _CNV_R_R_Def_n_sw_q_595_CM "Def_n_sw_q1p0" RAT_FUNC "%6.3" "Upm" COEFFS 0. 1. 0. 0. 0. 1. /end COMPU_METHOD
/begin COMPU_METHOD _CNV_R_R_Def_rf_sw__598_CM "Def_rf_sw_q0p01" RAT_FUNC "%6.3" "%" COEFFS 0. 100. 0. 0. 0. 1. /end COMPU_METHOD
/begin COMPU_METHOD _CNV_R_R_Def_rk_sw__600_CM "Def_rk_sw_b1600" RAT_FUNC "%6.3" "%" COEFFS 0. 2048. 0. 0. 0. 100. /end COMPU_METHOD
/begin COMPU_METHOD _CNV_R_R_Def_kw_sw__603_CM "Def_kw_sw_q0p0234" RAT_FUNC "%6.3" "°KW" COEFFS 0. 256. 0. 0. 0. 6. /end COMPU_METHOD
/begin COMPU_METHOD _CNV_R_R_Def_eta_sw_606_CM "Def_eta_sw_q0p00305" RAT_FUNC "%6.3" "%" COEFFS 0. 32767. 0. 0. 0. 100. /end COMPU_METHOD
/begin COMPU_METHOD _CNV_R_R_Def_f_ub_b_613_CM "Def_f_ub_b2" RAT_FUNC "%6.3" "-" COEFFS 0. 256. 0. 0. 0. 2. /end COMPU_METHOD
/begin COMPU_METHOD _CNV_R_R_Def_f_sw_b_616_CM "Def_f_sw_b2" RAT_FUNC "%6.3" "-" COEFFS 0. 65536. 0. 0. 0. 4. /end COMPU_METHOD
/begin COMPU_METHOD _CNV_R_R_Def_f_uw_b_617_CM "Def_f_uw_b64" RAT_FUNC "%6.3" "-" COEFFS 0. 65536. 0. 0. 0. 64. /end COMPU_METHOD
/begin COMPU_METHOD _CNV_R_R_Def_f_uw_b_618_CM "Def_f_uw_b10" RAT_FUNC "%6.3" "%" COEFFS 0. 65536. 0. 0. 0. 10. /end COMPU_METHOD
/begin COMPU_METHOD _CNV_R_R_Def_umr_uw_625_CM "Def_umr_uw_b4000" RAT_FUNC "%6.3" "-" COEFFS 0. 65536. 0. 0. 0. 4000. /end COMPU_METHOD
/begin COMPU_METHOD _CNV_R_R_Def_f_uw_b_629_CM "Def_f_uw_b0p3" RAT_FUNC "%6.3" "%/hPa" COEFFS 0. 65536. 0. 0. 0. 0.3 /end COMPU_METHOD
/begin COMPU_METHOD _CNV_R_R_Def_lst_uw_648_CM "Def_lst_uw_b131072" RAT_FUNC "%6.3" "W" COEFFS 0. 1. 0. 0. 0. 2. /end COMPU_METHOD
/begin COMPU_METHOD _CNV_R_R_Def_ml_uw__653_CM "Def_ml_uw_q0p1" RAT_FUNC "%6.3" "kg/h" COEFFS 0. 10. 0. 0. 0. 1. /end COMPU_METHOD
/begin COMPU_METHOD _CNV_R_R_Def_ms_uw__655_CM "Def_ms_uw_b8192" RAT_FUNC "%6.3" "kg/h" COEFFS 0. 8. 0. 0. 0. 1. /end COMPU_METHOD
/begin COMPU_METHOD _CNV_R_R_Def_ms_uw__656_CM "Def_ms_uw_q0p00039" RAT_FUNC "%6.3" "kg/h" COEFFS 0. 65536. 0. 0. 0. 25.6 /end COMPU_METHOD
/begin COMPU_METHOD _CNV_R_R_Def_td_uw__673_CM "Def_td_uw_q0p01" RAT_FUNC "%6.3" "s" COEFFS 0. 100. 0. 0. 0. 1. /end COMPU_METHOD
/begin COMPU_METHOD _CNV_R_R_Def_wdk_sw_683_CM "Def_wdk_sw_q0p0244" RAT_FUNC "%6.3" "%" COEFFS 0. 4096. 0. 0. 0. 100. /end COMPU_METHOD
/begin COMPU_METHOD _CNV_R_R_Def_zk10ms_715_CM "Def_zk10ms_uw_b655p36" RAT_FUNC "%6.3" "s" COEFFS 0. 0. 655.36 0. 1. 0. /end COMPU_METHOD
/begin COMPU_METHOD _CNV_R_R_Def_td_ub__717_CM "Def_td_ub_b2550" RAT_FUNC "%6.3" "ms" COEFFS 0. 1. 0. 0. 0. 10. /end COMPU_METHOD
/begin COMPU_METHOD _CNV_R_R_Def_a_uw_q_725_CM "Def_a_uw_q0p1" RAT_FUNC "%6.3" "mm/gKW" COEFFS 0. 1. 0. 0. 0. 1.6e-002 /end COMPU_METHOD
/begin COMPU_METHOD _CNV_R_R_Def_v_uw_q_726_CM "Def_v_uw_q1p0" RAT_FUNC "%6.3" "km/h" COEFFS 0. 1. 0. 0. 0. 1. /end COMPU_METHOD
/begin COMPU_METHOD _CNV_R_R_Def_zk100m_739_CM "Def_zk100ms_uw_b6553p6" RAT_FUNC "%6.3" "s" COEFFS 0. 0. 6553.6 0. 1. 0. /end COMPU_METHOD
/begin COMPU_METHOD _CNV_R_R_Def_rk_uw__746_CM "Def_rk_uw_b16" RAT_FUNC "%6.3" "-" COEFFS 0. 2048. 0. 0. 0. 1. /end COMPU_METHOD
/begin COMPU_METHOD _CNV_R_R_Def_umr_uw_776_CM "Def_umr_uw_b0p244" RAT_FUNC "%6.3" "-" COEFFS 0. 33554432. 0. 0. 0. 125. /end COMPU_METHOD
/begin RECORD_LAYOUT _REC_VAL_20_u1 FNC_VALUES 1 UBYTE COLUMN_DIR DIRECT /end RECORD_LAYOUT
/begin RECORD_LAYOUT _REC_VAL_20_u2 FNC_VALUES 1 UWORD COLUMN_DIR DIRECT /end RECORD_LAYOUT
/begin RECORD_LAYOUT _REC_AXS_20_u1 NO_AXIS_PTS_X 1 UBYTE AXIS_PTS_X 2 UBYTE INDEX_INCR DIRECT /end RECORD_LAYOUT
/begin RECORD_LAYOUT _REC_VAL_20_s2 FNC_VALUES 1 SWORD COLUMN_DIR DIRECT /end RECORD_LAYOUT
/begin RECORD_LAYOUT _REC_CUR_20_u2_u1 FNC_VALUES 1 UWORD COLUMN_DIR DIRECT /end RECORD_LAYOUT
/begin RECORD_LAYOUT _REC_CUR_20_s2_u1 FNC_VALUES 1 SWORD COLUMN_DIR DIRECT /end RECORD_LAYOUT
/begin RECORD_LAYOUT _REC_MAP_52_UBYTE_s2_s2_u2 NO_AXIS_PTS_X 1 UBYTE NO_AXIS_PTS_Y 2 UBYTE AXIS_PTS_X 3 SWORD INDEX_INCR DIRECT AXIS_PTS_Y 4 UWORD INDEX_INCR DIRECT FNC_VALUES 5 SWORD COLUMN_DIR DIRECT /end RECORD_LAYOUT
/begin RECORD_LAYOUT _REC_MAP_52_u1_s2_s2 NO_AXIS_PTS_X 1 UBYTE NO_AXIS_PTS_Y 2 UBYTE AXIS_PTS_X 3 SWORD INDEX_INCR DIRECT AXIS_PTS_Y 4 SWORD INDEX_INCR DIRECT FNC_VALUES 5 UBYTE COLUMN_DIR DIRECT /end RECORD_LAYOUT
/begin RECORD_LAYOUT _REC_MAP_52_UBYTE_u2_s2_u2 NO_AXIS_PTS_X 1 UBYTE NO_AXIS_PTS_Y 2 UBYTE AXIS_PTS_X 3 SWORD INDEX_INCR DIRECT AXIS_PTS_Y 4 UWORD INDEX_INCR DIRECT FNC_VALUES 5 UWORD COLUMN_DIR DIRECT /end RECORD_LAYOUT
/begin RECORD_LAYOUT _REC_MAP_52_UBYTE_u2_s2_s2 NO_AXIS_PTS_X 1 UBYTE NO_AXIS_PTS_Y 2 UBYTE AXIS_PTS_X 3 SWORD INDEX_INCR DIRECT AXIS_PTS_Y 4 SWORD INDEX_INCR DIRECT FNC_VALUES 5 UWORD COLUMN_DIR DIRECT /end RECORD_LAYOUT
/begin RECORD_LAYOUT _REC_MAP_52_UBYTE_s2_s2_s2 NO_AXIS_PTS_X 1 UBYTE NO_AXIS_PTS_Y 2 UBYTE AXIS_PTS_X 3 SWORD INDEX_INCR DIRECT AXIS_PTS_Y 4 SWORD INDEX_INCR DIRECT FNC_VALUES 5 SWORD COLUMN_DIR DIRECT /end RECORD_LAYOUT
/begin RECORD_LAYOUT _REC_MAP_52_UBYTE_u2_u2_u2 NO_AXIS_PTS_X 1 UBYTE NO_AXIS_PTS_Y 2 UBYTE AXIS_PTS_X 3 UWORD INDEX_INCR DIRECT AXIS_PTS_Y 4 UWORD INDEX_INCR DIRECT FNC_VALUES 5 UWORD COLUMN_DIR DIRECT /end RECORD_LAYOUT
/begin RECORD_LAYOUT _REC_MAP_52_UBYTE_u2_u2_s2 NO_AXIS_PTS_X 1 UBYTE NO_AXIS_PTS_Y 2 UBYTE AXIS_PTS_X 3 UWORD INDEX_INCR DIRECT AXIS_PTS_Y 4 SWORD INDEX_INCR DIRECT FNC_VALUES 5 UWORD COLUMN_DIR DIRECT /end RECORD_LAYOUT
/begin RECORD_LAYOUT _REC_MAP_52_UBYTE_s2_u2_s2 NO_AXIS_PTS_X 1 UBYTE NO_AXIS_PTS_Y 2 UBYTE AXIS_PTS_X 3 UWORD INDEX_INCR DIRECT AXIS_PTS_Y 4 SWORD INDEX_INCR DIRECT FNC_VALUES 5 SWORD COLUMN_DIR DIRECT /end RECORD_LAYOUT
/begin RECORD_LAYOUT _REC_CUR_TKL_UW_VV__u2_u2 NO_AXIS_PTS_X 1 UBYTE RESERVED 2 BYTE AXIS_PTS_X 3 UWORD INDEX_INCR DIRECT FNC_VALUES 4 UWORD COLUMN_DIR DIRECT /end RECORD_LAYOUT
/begin RECORD_LAYOUT _REC_CUR_TKL_UW_VV__u2_s2 NO_AXIS_PTS_X 1 UBYTE RESERVED 2 BYTE AXIS_PTS_X 3 SWORD INDEX_INCR DIRECT FNC_VALUES 4 UWORD COLUMN_DIR DIRECT /end RECORD_LAYOUT
/begin RECORD_LAYOUT _REC_CUR_TKL_UW_VV__s2_s2 NO_AXIS_PTS_X 1 UBYTE RESERVED 2 BYTE AXIS_PTS_X 3 SWORD INDEX_INCR DIRECT FNC_VALUES 4 SWORD COLUMN_DIR DIRECT /end RECORD_LAYOUT
/begin RECORD_LAYOUT _REC_CUR_TKL_UW_VV__S4_S4 NO_AXIS_PTS_X 1 UBYTE RESERVED 2 BYTE AXIS_PTS_X 3 FLOAT32_IEEE INDEX_INCR DIRECT FNC_VALUES 4 FLOAT32_IEEE COLUMN_DIR DIRECT /end RECORD_LAYOUT
/begin RECORD_LAYOUT _REC_CUR_20_S4_u1 FNC_VALUES 1 FLOAT32_IEEE COLUMN_DIR DIRECT /end RECORD_LAYOUT
/begin RECORD_LAYOUT _REC_VAL_20_S4 FNC_VALUES 1 FLOAT32_IEEE COLUMN_DIR DIRECT /end RECORD_LAYOUT
/begin FUNCTION EISY_DIAG ""
 /begin DEF_CHARACTERISTIC CW_EISYD_RUNTIME CW_EISY_DFSPE CW_EISY_DIAG CW_EISY_DRBM KF_DIAGDPSRD_O KF_DIAGDPSRD_U KF_DIAG_MSO KF_DIAG_MSO2 KF_DIAG_MSU KF_DIAG_MSU2 KF_TDMSZYL KL_RFVSOLL K_AVGCTR_MN K_AVGCTR_MX K_BGWDKDPSGR K_DIAGHFM_GANGI K_DIAGHFM_NKW K_DIAGHFM_RF K_DIAGHFM_VFZG K_DIAG_MSO_OFFGD K_DIAG_MSO_OFFTD K_DIAG_MSO_OFFV K_DIAG_MSU_OFFGD K_DIAG_MSU_OFFTD K_DIAG_MSU_OFFV K_DISAB1_MN K_DISAB1_MX K_DISAB2_MN K_DISAB2_MX K_DISAB3_MN K_DISAB3_MX K_DISAB4_MN K_DISAB4_MX K_DISADTAMN K_DISADTAMX K_DISATD K_DNKW_EISYDMN K_DNKW_EISYDMX K_DPSRP_MN1 K_DPSRP_MN2 K_DPSRP_MN3 K_DPSRP_MN4 K_DRDIAGLL_TOL K_DRDIAGRFMX K_DRDIAGTANS_MN K_DRDIAGTANS_MX K_DRDIAGTOL K_DRDIAGTSG_MN K_DRDIAGTSG_MX K_DRDIAGVL_TOL K_DRDIAG_OFFSMN K_DRDIAG_OFFSMX K_DRDIAG_PUMIN K_DRDIAG_TNABST K_DRDIAG_WDKVL K_DRF_EISYDMN K_DRF_EISYDMX K_HUBMN_DIAG K_NEDIAGMN K_NEDIAGMX K_NMN_HFMDPERM K_PSOFFMAN K_PUMN_DIAG K_PUOFFMAN K_PVDKOFFMAN K_RFEDIAGMN K_RFEDIAGMX K_TAEDIAGMN K_TAEDIAGMX K_TD_DRDIAGLL K_TD_DRDIAGVL K_TD_DRDKWDREHT K_TD_EISYD K_TMEDIAGMN K_TNSEDIAGMN K_TNSMN_HFMPERM K_UBATTMIN_DIAGPL K_UBATTMIN_DPSRDIAG K_UBATTMIN_HFMDIAG K_WDKMN_DDPSR K_ZKDIAG_HQ K_ZKDIAG_MSLQ K_ZKDIAG_PS K_ZKDIAG_WDKPS K_ZK_DIAGPSREG K_ZK_EISYDSTN K_ZK_EISYDSTRF S_BTE_EDIAG S_DISADIAGST_ON S_DISAD_APP S_DISA_DIAG S_DPSRDIAGST_ON S_DPSR_DIAG S_DRDIAG_ON S_DRDIAG_PSREF S_DRDIAG_RESET S_EISYD_APP S_EISYD_RF S_HFMDIAGST_ON S_HFMDIAGTE_OFF S_HFMD_SAON S_HFM_DIAG S_HFM_DIAG_PERM S_MSDIAGST_ON S_MSLAM_DIAG S_MSZYLDIAG_MOD S_PSOFFMAN S_PUOFFMAN S_PVDKOFFMAN S_TALEER_DIS S_WDKDIAG_PSMOD /end DEF_CHARACTERISTIC
 /begin REF_CHARACTERISTIC CW_EISY /end REF_CHARACTERISTIC
 /begin OUT_MEASUREMENT Acc_psabs_off Acc_pvdkds_off Ctr_drdiag D_psabs_pu D_pvdkds_ps D_pvdkds_pu Diag_mso Diag_mso2 Diag_mso2_f Diag_mso_f Diag_mso_off Diag_msu Diag_msu2 Diag_msu2_f Diag_msu_f Diag_msu_off Diag_pso Diag_pso_f Diag_psu Diag_psu_f Dnkw_eisyd Dps_abs Dpsrseg_puls Dpvdkds Drdiag_state Drf_eisyd F_quotdiagh F_quotdiaghf F_quotdiagl F_quotdiagl2 F_quotdiaglf F_quotdiaglf2 Klaf_outwdkdiag Mszyl_diag Mszyl_diagf Nkw_eisydf Ps_abs_kor Ps_abs_offset Psabs_off_ubeg Psreg_diag Psreg_diag_f Pu_kor Pu_offset Pvdkds_kor Pvdkds_off_ubeg Pvdkds_offset Rf_eisydf St_drdiag St_drdiag.B_drdiag_akt St_drdiag.B_drdiag_vst St_drdiag.B_drdiag_vst_old St_drdiag.B_psabs_pl St_drdiag.B_pvdkds_pl St_drdiag_nv St_drdiag_nv.B_psabs_npl St_drdiag_nv.B_pu_npl St_drdiag_nv.B_pvdkds_npl St_eisyd_rbm St_eisyd_rbm.B_eisyd_rbmsc St_eisyd_rbm.B_pend_allg St_eisyd_rbm.B_pend_dpsr St_eisyd_rbm.B_pend_hfm St_eisyd_rbm.B_rbmcompl_dpsr St_eisyd_rbm.B_rbmcompl_hfm St_eisydiag1 St_eisydiag1.B_disa_diag St_eisydiag1.B_dpsr_diag St_eisydiag1.B_eisy_diag St_eisydiag1.B_eisyd_on St_eisydiag1.B_hfm_diag St_eisydiag1.B_mslam2_diag St_eisydiag1.B_mslam_diag St_eisydiag1.B_mszyldiag_mod St_eisydiag2 St_eisydiag2.B_npl_mshfm St_eisydiag2.B_nplhfm_mn St_eisydiag2.B_nplhfm_mx St_eisydiag2.B_nplmslam2_mn St_eisydiag2.B_nplmslam2_mx St_eisydiag2.B_nplmslam_mn St_eisydiag2.B_nplmslam_mx St_eisydiag3 St_eisydiag3.B_agr_diag St_eisydiag3.B_dpsrdiag_allg St_eisydiag3.B_npl_agr St_eisydiag3.B_npl_dpsr St_eisydiag3.B_nplagr_mn St_eisydiag3.B_nplagr_mx St_eisydiag3.B_npldpsr_mn St_eisydiag3.B_npldpsr_mx St_eisydiag4 St_eisydiag4.B_disad_b1 St_eisydiag4.B_disad_b2 St_eisydiag4.B_disad_b3 St_eisydiag4.B_disad_b4 St_eisydiag4.B_dpsr_puls St_eisydiag4.B_npl_disa St_eisydiag5 St_eisydiag5.B_disab1_f St_eisydiag5.B_disab2_f St_eisydiag5.B_disab3_f St_eisydiag5.B_disab4_f St_eisydrabgl St_eisydrabgl.B_drdiag_errll St_eisydrabgl.B_drdiag_errvl St_eisydrabgl.B_drdiagll St_eisydrabgl.B_drdiagll_done St_eisydrabgl.B_drdiagvl St_eisydrabgl.B_drdiagvl_done St_eisydrabgl.B_drdiagvst St_eisydrabgl.B_psabspu_npl St_eisydrabgl.B_pvdkdsps_npl St_eisydrabgl.B_pvdkdspu_npl St_eisydyn St_eisydyn.B_eisyd_stat St_eisydyn.B_eisyd_statn St_eisydyn.B_eisyd_statrf St_eisydyn.B_eisyd_stattmp St_wdkdiag St_wdkdiag.B_wdkdiag_ugd Td_mszylpt1 Wdk_diag Zk_diag_mss /end OUT_MEASUREMENT
 /begin IN_MEASUREMENT Dpssol F_tvdkho F_tzylkor Fho Hubev_ist Klaf_outdk Msbkv Mshfm_f Mslam Mslam1 Mslam2 Msnzyl Mste Nkw Pirg Ps Ps_ist Psreg_tmp Pu Pvdkds Rf Rf_soll Rfv_soll St_bgkuppl1 St_bgkuppl1.B_ll St_blstd St_blstd.B_lltd St_blstd.B_lltd_old St_blstd.B_lltd_vz St_blstd.B_pssolnl_akt St_dps St_dps.B_dpsadp St_dps.B_gd St_dps.B_gdst St_dps.B_gdvhub St_eisy_hfm St_eisy_hfm.B_mrmslam St_eisy_psreg St_eisy_psreg.B_pddssmn St_eisy_psreg.B_pddssmx St_eisy_psreg.B_psreg_akt St_eisy_psreg.B_psreg_off St_minhubad0 St_minhubad0.B_dtes St_minhubad0.B_mdarv St_mkwchn St_mkwchn.B_kwdreht St_motzustd St_motzustd.B_ll_roh St_motzustd.B_vl St_mslam St_mslam.B_emslam St_mslam.B_emslam2 St_mslam.B_emslam2_tmp St_mslam.B_emslam_tmp St_mslam.B_lamsonden_ok St_mslam.B_mslam_fg St_mslam.B_mslam_on St_mslam.B_sa_fe St_pwf St_pwf.B_pwf St_sawe St_sawe.B_sa St_sawe.B_sae St_sawe.B_safast Tans Tmot Tn_start_10 Ub V Wdk_soll Wdk_ug /end IN_MEASUREMENT
/end FUNCTION
/begin FUNCTION EISY_DK "" /begin DEF_CHARACTERISTIC KF_MSNDK KL_AF KL_WDK_UG /end DEF_CHARACTERISTIC
 /begin OUT_MEASUREMENT Klaf_outdk Klaf_outdk_i Msdk_ur_i Msndk_i Msndk_oma_i Msndk_roh_i Pspvdk Pspvdk_i Wdk_ug /end OUT_MEASUREMENT
 /begin IN_MEASUREMENT Bank_eisy Eisydk_kor_fak_i Eisydk_kor_off_i F_t_pvdkpn_i Nkw Ps_i Pvdkds_f_i St_bank_eisy St_bank_eisy.B_bankselek_eisy St_eisy_segment St_eisy_segment.B_eisy_dkseg St_eisy_segment.B_eisy_evseg Tmot /end IN_MEASUREMENT
/end FUNCTION
/begin FUNCTION EISY_EV ""
 /begin DEF_CHARACTERISTIC GAX_PIRGNN GAX_RFVISTNN CW_EISY_TURBO CW_TZKBLS CW_TZYLKOR KF_DRFV_SPUEL KF_DRFV_UK KF_NLEV KF_PAKPSOFFS KF_PSPAKOFFS KF_RFVZYLVOL KF_UEF_SPUEL KF_UEF_UK KL_AF_SPUEL KL_PIRG_MX KL_PIRG_START KL_RFVIST_MN KL_RFVIST_MX KL_RFVIST_START KL_STEND_TRANS KL_WBIAS_PIRG KL_WBIAS_RF KL_WNKW_PIRG KL_WNKW_RF KL_WOUT_PIRG KL_WOUT_RF KL_WVSA_PIRG KL_WVSA_RF KL_WVSE_PIRG KL_WVSE_RF K_DISAIST_B1 K_DISAIST_B2 K_DISAIST_B3 K_DNKW_DISA1 K_DNKW_DISA2 K_HUBOFF K_NKWDISADEAK K_NKW_DISA1 K_NKW_DISA2 K_NMIN_RF_START K_NWASB K_NWESB K_PIRGNN_ANZ K_PIRGWOUT_BIAS K_PIRG_MN K_RFVISTNN_ANZ K_RFVISTWOUT_BIAS K_TD_EVNNUMSCH K_UFAK_MS_RF K_VSAOFF K_VSEOFF K_ZK_EVMRASPR K_ZK_EVMRESPR K_ZK_EVMRHUB K_ZK_EVNNUMSCH K_ZK_PIRGF K_ZK_SPRUEF S_EISYEV_DISAISTON S_EVNN_AUS S_MSZYL_3MOD S_PIRGKON S_PIRG_NLEV S_PSPN_OFF S_RFVISTHUB /end DEF_CHARACTERISTIC
 /begin REF_CHARACTERISTIC CW_EISY /end REF_CHARACTERISTIC
 /begin OUT_MEASUREMENT Disa_bereich Dmszyl_spuel_i Dmszyl_uk_i Dpirgn_i Drf_spuel Drf_spuel_i Drf_spuel_tmp_i Drf_uk_i Drf_uk_tmp_i Drf_zylvol_i Drfnorm_spuel_i Drfnorm_uk_i F_pspu_i F_stend_trans F_tzkorbls_i F_tzylkor F_tzylkor_i F_umsrfn Fupsms_bas_i Fupsms_i Fupsrf Fupsrf_i Hubev_ist_m Hubev_mareg Klafout_spuel_i Klafout_uk_i Msnzyl Msnzyl_i Msnzyl_k_i Mszyl Mszyl_ges_i Mszyl_i Mszyl_nn_i Pakps_kor_i Pakps_offs_i Pirg Pirg_abgd_i Pirg_fho Pirg_i Pirg_nn_i Pirg_nnbeg_i Pirg_nnbegf_i Pirg_nnf_i Rf_zylvol_i Rfv_ist_hub Rfv_ist_i Rfv_ist_nn_i Rfv_ist_nnbeg_i Rfv_ist_nnf_i Rfv_zylvol_i Rfzyl_nn_i Spr_diff_i Spr_sum_f_i Spr_sum_i Spr_swp_i St_disa_umschalt St_disa_umschalt.B_disa_deak St_disa_umschalt.B_evnnumsch Uefl_spuel_i Uefl_uk_i Vsa_spri_i Vse_spri_i /end OUT_MEASUREMENT
 /begin IN_MEASUREMENT Bank_eisy Eisy_segtoggle Eisyev_kor_fak_i Eisyev_kor_off_i F_tevpstnorm_i F_tnzyl F_tvdk_i Fho Ftbr_kor Ftev_i Nkw Pakpn Pakps Ps_i Ps_ist_i Pspak Pspn Pu St_bank_eisy St_bank_eisy.B_bankselek_eisy St_eisy_segment St_eisy_segment.B_eisy_dkseg St_eisy_segment.B_eisy_evseg St_start St_start.B_jumpstart St_start.B_sta St_start.B_start St_start.B_startende St_start.B_wst Vsa2_spri Vsa_spri Vse2_spri Vse_spri /end IN_MEASUREMENT
/end FUNCTION
/begin FUNCTION EISY_LLK "" /begin OUT_MEASUREMENT Pllk /end OUT_MEASUREMENT /end FUNCTION
/begin FUNCTION EISY_MR ""
 /begin DEF_CHARACTERISTIC GAX_15MODELLE GAX_6MODELLE KF_MAREGDKI KF_MAREGDKI_TE KF_MAREGDKP KF_MAREGDKP_TE KF_MSKOR_NPSP KF_MSKOR_NRF KF_THFMOD KF_ZK_MSKOR KL_CDK_N KL_CDK_VSA_SPRI KL_CDK_VSE_SPRI KL_CDK_WDK_IST KL_ETADK KL_HUBFMAON KL_HUBFMAUN KL_HUBMSON KL_SDK_N KL_SDK_VSA_SPRI KL_SDK_VSE_SPRI KL_SDK_WDK_IST KL_TD_MRONST KL_ZKMSKOR_PSP K_ANZ_DKNN K_BGMSVVTDPS K_DKMX K_EINGANG_DK K_LOLIDK_MN K_LOLIDK_MX K_MAREGDKIMN K_MAREGDKIMX K_MAREGDKMN K_MAREGDKMX K_MAREGDKNN_MN K_MAREGDKNN_MX K_MRAD_MSN K_MRDVH_MN K_MRD_MN K_MRD_MS_FAK K_MRD_MS_OFF K_MRGES_DKMN K_MRGES_DKMX K_MRLINDK_MN K_MRV_MX K_NADONN K_NKWMIN_MR K_NKWMRNN_RAMP K_NMSNVTO K_NNADQUOT_DK K_PSPVDK_ADONMX K_PSPVK_SOLLMN1 K_PSPVK_SOLLMN2 K_PSPVK_SOLLMN3 K_PSPVK_SOLLMN4 K_PSPVK_SOLLMN5 K_PULSNMN1 K_PULSNMN2 K_PULSNMN3 K_PULSNMN4 K_PULSNMN5 K_PULSNMX1 K_PULSNMX2 K_PULSNMX3 K_PULSNMX4 K_PULSNMX5 K_PULSRFVMN1 K_PULSRFVMN2 K_PULSRFVMN3 K_PULSRFVMN4 K_PULSRFVMN5 K_PULSRFVMX1 K_PULSRFVMX2 K_PULSRFVMX3 K_PULSRFVMX4 K_PULSRFVMX5 K_PULSV5 K_TADONTM K_TADONTNS K_TDADONTAMN K_TDADONTAMX K_TD_MODABST K_TD_MRADONTE K_TD_NNOFF K_TD_NNON K_TIMSALLVT K_TIMSAON K_TIMSAVT K_TMMRNN_RAMP K_TNSMRNN_RAMP K_ZK_MRDKOFF K_ZK_MRRAMP K_ZK_NNOFF K_ZK_NNON S_ADP_RESET S_BTE_MR S_DKNNON S_EISYAD_TST S_MAREGOFF S_MODABLLTD_OFF S_MODABTE_OFF S_MRD_MS_FAK S_MROFF_KSD S_MR_MS_FAK S_NPL_RESET S_TALEER_MR /end DEF_CHARACTERISTIC
 /begin REF_CHARACTERISTIC CW_EISY CW_MPR_KOORD /end REF_CHARACTERISTIC
 /begin OUT_MEASUREMENT B_hfm_dkerr2pot_i B_hfmpuls B_hfmpuls1_i B_hfmpuls2_i B_hfmpuls3_i B_hfmpuls5_i B_hfmpuls_i B_mareg_dkmn_i B_mareg_dkmx_i B_maregdk1_i B_maregdk2_i B_mraddk_akt_i B_mradon_i B_mron B_mron_i B_nplms_reset Dkaus_timer_i F_mr_ramp F_mshfm_kor_i F_mskor_npsp_i F_mskor_nrf_i F_pssolverh Lolimot_dkaus_i Lolimot_dkein_i Lolimot_dklern_i Mareg_dk_i Mareg_dkaus_i Mareg_dkdiff_i Mareg_dki_i Mareg_dknn_i Mareg_dknn_out_i Mareg_dkp_i Mareg_dkst_i Mareg_er_dk_i Mareg_er_vvt Mareg_pidk_i Mareg_pivvt Mareg_vvt Mareg_vvtaus Mareg_vvtdiff Mareg_vvti Mareg_vvtnn Mareg_vvtnn_out Mareg_vvtp Mareg_vvtst Modab_fak Modab_off Modab_off_adp Modab_reg_diff Modab_reg_in Modab_reg_out Modab_reg_outadp Modab_reg_vl Modelle Mr_pskor_fak Mrd_ms_fak_i Mrd_ms_off_i Mrnn_test_dk Mrv_ms_fak Mrv_ms_off Ms_diff_i Msdk_diff_i Msdk_f_i Mshfm_kor_i Mshfm_pspkor_i Msn_mrad_i Msnlgoff_mr_i Mszyl_diff_i Rf_hfm_ist_i St_eisyad_read St_eisyad_read.B_maregdk_ad St_eisyad_read.B_psrhub_ad St_mareg St_mareg.B_maregaddk St_mareg.B_maregadvvt St_mareg.B_mareghub1 St_mareg.B_mareghub2 St_mareg_lim St_mareg_lim.B_mareg_vvtmn St_mareg_lim.B_mareg_vvtmx St_modab St_modab.B_eisy_clrad St_modab.B_llk_mr St_modab.B_modab_on St_modab.B_modab_zul St_modab.B_startende_verz St_modab.B_timsallv St_modab.B_timsavvt St_modab.B_timsvvt St_modab2 St_modab2.B_modab_off St_modab2.B_modabst_on St_modab2.B_mradonte Vvtaus_timer Z_norm_dk_i w_dknn_N w_dknn_Vsa_spri_i w_dknn_Vse_spri_i w_dknn_Wdk_ist_i w_dknn_bias /end OUT_MEASUREMENT
 /begin IN_MEASUREMENT Bank_eisy Dhubra Dpsfak Eisy_segtoggle F_umsrfn Gangi Msbkv Msdk Msdk_ur_i Mshfm_f_i Mshfm_ist_i Mslam Mssol Mssol_i Mste Mszyl_f_i Mszyl_i Nkw Pspvdk_i Pspvdk_soll_i Rf_soll Rfv_hub Rfv_soll_i St_bank_eisy St_bank_eisy.B_bankselek_eisy St_bgkuppl1 St_bgkuppl1.B_ll St_blshub St_blshub.B_fhubvnsi_ini St_blshub.B_hubst St_blshub.B_llk St_blshub.B_nwe St_blshub.B_vns_spron St_blshub.B_vsean_loc St_blshub.B_vvtclose St_blstd St_blstd.B_lltd St_blstd.B_lltd_old St_blstd.B_lltd_vz St_blstd.B_pssolnl_akt St_dk_diag St_dk_diag.B_dk2err_2pot St_dk_diag.B_dkerr_2pot St_dk_diag.B_nlf St_dk_diag.B_ska St_eisy_hfm St_eisy_hfm.B_mrmslam St_eisydiag2 St_eisydiag2.B_npl_mshfm St_eisydiag2.B_nplhfm_mn St_eisydiag2.B_nplhfm_mx St_eisydiag2.B_nplmslam2_mn St_eisydiag2.B_nplmslam2_mx St_eisydiag2.B_nplmslam_mn St_eisydiag2.B_nplmslam_mx St_eisysr_i St_kl15 St_kl15.B_kl15_ep St_kl15.B_kl15_vorab St_mslam St_mslam.B_emslam St_mslam.B_emslam2 St_mslam.B_emslam2_tmp St_mslam.B_emslam_tmp St_mslam.B_lamsonden_ok St_mslam.B_mslam_fg St_mslam.B_mslam_on St_mslam.B_sa_fe St_pwf St_pwf.B_pwf St_start St_start.B_jumpstart St_start.B_sta St_start.B_start St_start.B_startende St_start.B_wst St_tank St_tank.B_taleer St_tevein St_tevein.B_te St_tevein.B_te_la1 St_tevein.B_teblg St_tevein.B_tev_erf St_varkat St_varkat.B_varkat Tans_i Tmot Tmot_start Tn_start_10 V Vsa_spri_i Vse_spri_i Wdk_ist_i /end IN_MEASUREMENT
/end FUNCTION
/begin FUNCTION EISY_PSREG ""
 /begin DEF_CHARACTERISTIC CW_PSRDIAG_OFF KF_PSREG_I KF_PSREG_P KF_PSR_KOR KL_ZK_PSSMOD K_AGRREGIMN K_AGRREGIMX K_DPSMN K_DPSMX K_FAGRAD K_MSBKV_LGMAX K_MSNLGOFS_MN K_MSNLGOFS_MX K_MSTE_LGMAX K_NKWMAX_LGADA K_NKWMIN_LGADA K_NKWPSADNN_RAMP K_NPK K_PROUT2MS_F K_PR_MS_FAK K_PR_MS_OFF K_PSPVDK_LGMAX K_PSPVDK_MN K_PSPVDK_MX K_PSREGIMN K_PSREGIMX K_PSREGMN K_PSREGMX K_PSRON_MSAGRMN K_PSRON_MSAGRMX K_PSRON_NMN K_PSRON_NMX K_PSRON_TMMN K_PSSOL_PSREGMX K_TANSMAX_LGADA K_TANSMIN_LGADA K_TD_PSRON K_TMOTMAX_LGADA K_TMOTMIN_LGADA K_TMPSADNN_RAMP K_TNSPSADNN_RAMP K_WDKIST_LGMAX K_ZK_MSNLGOFS K_ZK_PSADRAMP K_ZK_PSROFF S_PREGSOL S_PR_MS_FAK S_PSREGOFF S_PSRVLOFF S_SDF_ABS /end DEF_CHARACTERISTIC
 /begin REF_CHARACTERISTIC CW_EISY CW_MPR_KOORD /end REF_CHARACTERISTIC
 /begin OUT_MEASUREMENT Agrreg_out Dpsr_pk F_agrad F_psr_kor_i Mrnn_test_pr Msnlg_off_i Msnlgofs_tmp Msnlgofs_tmp_i Pr_ms_fak_i Pr_ms_off_i Ps_f_i Ps_ist Ps_ist_i Psreg_diff_i Psreg_diff_in_i Psreg_diff_lin_i Psreg_i_i Psreg_out_i Psreg_p_i Psreg_pi_i Psreg_st_i Psreg_tmp Psreg_tmp_i Psregi_i Psregp_i St_eisy_psreg St_eisy_psreg.B_pddssmn St_eisy_psreg.B_pddssmx St_eisy_psreg.B_psreg_akt St_eisy_psreg.B_psreg_off /end OUT_MEASUREMENT
 /begin IN_MEASUREMENT Bank_eisy Dpsr Dpsr_seg Eisy_segtoggle Mssol_i Nkw Ps_i Pspvdk_soll Pspvdk_soll_i Pssol Pssol_i Pu Pvdkds_f_i St_bank_eisy St_bank_eisy.B_bankselek_eisy St_dk_diag St_dk_diag.B_dk2err_2pot St_dk_diag.B_dkerr_2pot St_dk_diag.B_nlf St_dk_diag.B_ska St_eisydiag3 St_eisydiag3.B_agr_diag St_eisydiag3.B_dpsrdiag_allg St_eisydiag3.B_npl_agr St_eisydiag3.B_npl_dpsr St_eisydiag3.B_nplagr_mn St_eisydiag3.B_nplagr_mx St_eisydiag3.B_npldpsr_mn St_eisydiag3.B_npldpsr_mx St_motzustd St_motzustd.B_ll_roh St_motzustd.B_vl St_start St_start.B_jumpstart St_start.B_sta St_start.B_start St_start.B_startende St_start.B_wst /end IN_MEASUREMENT
/end FUNCTION
/begin FUNCTION EISY_SR ""
 /begin DEF_CHARACTERISTIC KL_SRSTAB_SPUEL KL_VSAUG_GDN KL_VSAUG_GDP KL_VSAUG_UG K_DPS_INTMN K_PSMIN K_PSPVDK_INTMN S_SRSTAB_PIRG /end DEF_CHARACTERISTIC
 /begin REF_CHARACTERISTIC CW_EISY /end REF_CHARACTERISTIC
 /begin OUT_MEASUREMENT B_psintmx_i Dps_i F_dms2dps_i F_dms2dps_max_i F_dms2dps_ur_i F_tans0_i Kl_vsaug_aus Msdksr_bersr_i Msdksr_i Mssr_diff_i Mssrzu_i Mszyl_bersr_i Ps Ps_alt_i Ps_diff_i Ps_i Ps_int_i Ps_mx_i Ps_ok_i St_eisysr_i /end OUT_MEASUREMENT
 /begin IN_MEASUREMENT Bank_eisy Drf_soll Drfnorm_spuel_i F_umsrfn Msbkv Msdk_ur_i Mshfm_f_i Mste Mszyl_i Nkw Pakps_kor_i Pirg_abgd_i Psev_i Pu Pvdkds_f_i St_bank_eisy St_bank_eisy.B_bankselek_eisy St_dps St_dps.B_dpsadp St_dps.B_gd St_dps.B_gdst St_dps.B_gdvhub Tans_i /end IN_MEASUREMENT
/end FUNCTION
/begin FUNCTION EISY_VERD ""
 /begin DEF_CHARACTERISTIC KF_ETA_TURBO KL_DPLF KL_PRAT2FLOW_TURB KL_PRAT2FLOW_VERD KL_ZK_TURBINE K_ETA_M_TURBO K_FU_LST_TURB K_FU_MSVERD K_PKATPAK_MN K_ZK_TURBINE /end DEF_CHARACTERISTIC
 /begin OUT_MEASUREMENT Lst_turb Lst_verd Lst_verd_f Msverd /end OUT_MEASUREMENT
 /begin IN_MEASUREMENT Msturbine Nkw Pak Pkat Pu Pvdkds Rf Tabg_mw Tans /end IN_MEASUREMENT
/end FUNCTION
/begin FUNCTION MSLAM ""
 /begin DEF_CHARACTERISTIC CW_MDMSLAM_CONFB1 CW_MDMSLAM_CONFB2 KF_RKLAM_KOR KF_TDRKLAM KF_TDRKLAMF KL_DRFSOLL_MSLAM KL_KORRKFVST KL_LALIUS KL_RKUKG_MSLAM KL_TDRFSOLL_MSLAM K_DRFSPUELMN_MSLAM K_ETAZYLAUS_MSLAM K_FMSLAMON K_LAMMNMSLAM K_LAMMXMSLAM K_TD_MSLAMKW K_TD_SPUELSPERR K_TMDMSLMD_OFF K_TVSAMSLAM K_TVSAVMSLAM S_BERMSLAMON S_LAM_SON S_MDARV_AKT S_MSLAMMDSTP_ENTP S_MSTE_KOR S_RKTEV_KOR S_TEMSLAM S_TEMXMSLAM /end DEF_CHARACTERISTIC
 /begin OUT_MEASUREMENT La_ist1 La_ist2 La_ist_m Mslam Mslam1 Mslam2 Rflam Rflam2 Rk_1_td Rk_1_tdf Rk_2_td Rk_2_tdf St_mslam St_mslam.B_emslam St_mslam.B_emslam2 St_mslam.B_emslam2_tmp St_mslam.B_emslam_tmp St_mslam.B_lamsonden_ok St_mslam.B_mslam_fg St_mslam.B_mslam_on St_mslam.B_sa_fe St_mslam2 St_mslam2.B_drfsoll_dyn St_mslam2.B_mdarv_latched St_mslam2.B_mslamstp_md St_mslam2.B_mslamstp_md2 St_mslam2.B_sasmg St_mslam2.B_spuelmslam_off Td_mslam Td_mslampt1 Td_mszyl Td_mszyl_kw Td_vwl Zyl_misfire_diag /end OUT_MEASUREMENT
 /begin IN_MEASUREMENT Drf_soll Drf_spuel Eta_zyl_aus F_umsrfn F_vst Hubev_ist Lam_son1 Lam_son2 Mste Nkw Rf Rk_1 Rk_2 Rktev St_bgkuppl1 St_bgkuppl1.B_ll St_dk_diag St_dk_diag.B_dk2err_2pot St_dk_diag.B_dkerr_2pot St_dk_diag.B_nlf St_dk_diag.B_ska St_eisy_hfm St_eisy_hfm.B_mrmslam St_ekp St_ekp.B_dkpu St_gglsu2 St_gglsu2.B_sbblsu St_gglsu2.B_sbblsu2 St_minhubad0 St_minhubad0.B_dtes St_minhubad0.B_mdarv St_sawe St_sawe.B_sa St_sawe.B_sae St_sawe.B_safast St_sls St_sls.B_sls St_tevein St_tevein.B_te St_tevein.B_te_la1 St_tevein.B_teblg St_tevein.B_tev_erf St_ti_b St_ti_b.B_temxon St_varkat St_varkat.B_varkat Tmot Ulams_1 Ulams_2 Vsa_spri Vse_spri Wese /end IN_MEASUREMENT
/end FUNCTION
/begin FUNCTION ls_51_55_ "" /begin SUB_FUNCTION BLS BLSATL BLSDK BLSHUB /end SUB_FUNCTION /end FUNCTION
/end MODULE
/end PROJECT
