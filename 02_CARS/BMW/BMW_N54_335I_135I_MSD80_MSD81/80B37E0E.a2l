ASAP2_VERSION 1 41
/begin PROJECT MSD70 "Spray Guided DI-System with Piezo Injectors for 6-Cylinder"
/begin HEADER "_default_HeaderComment" PROJECT_NO _0B /end HEADER
/begin MODULE _default_ModuleName "_default_ModuleLongIdentifier"
/begin MOD_COMMON "_default_ModCommonComment" DEPOSIT ABSOLUTE BYTE_ORDER MSB_LAST ALIGNMENT_BYTE 1 ALIGNMENT_WORD 2 ALIGNMENT_LONG 2 ALIGNMENT_FLOAT32_IEEE 2 ALIGNMENT_FLOAT64_IEEE 4 /end MOD_COMMON
/begin AXIS_PTS ldpm_n_32_ls_up_dyn "" 0xa1001ae0 n_32 _REC_AXS_20_u1 8160. _CNV_A_R_LINEAR_____9_CM 8 0. 8160. FORMAT "%4.0" /end AXIS_PTS
/begin AXIS_PTS ldpm_maf_hb_ls_up_dyn "" 0xa1001a94 NO_INPUT_QUANTITY _REC_AXS_20_u1 1389. _CNV_A_R_LINEAR_____14_CM 8 0. 1389. FORMAT "%4.0" /end AXIS_PTS
/begin MEASUREMENT egcp[0].egcp_struct_sigcvridi0.lv_inh_r_it_ls_down "Boolean flag indicating that downstream sensor internal resistance determination shall be inhibited when set" UBYTE _CNV_S_2_RANGE__0___1_CM 1 100. 0. 1. DISPLAY_IDENTIFIER LV_INH_R_IT_LS_DOWN[1] ECU_ADDRESS 0xd0001a38 BIT_MASK 0x1 /end MEASUREMENT
/begin MEASUREMENT egcp[0].egcp_struct_sigdglsl2.lamb_mmv_act_lsl_up "Lambda moving mean value during the time the forced stimulation is active" UWORD _CNV_A_R_LINEAR_____8_CM 1 100. 0. 1.99996948242188 DISPLAY_IDENTIFIER LAMB_MMV_ACT_LSL_UP[1] ECU_ADDRESS 0xd0001b20 FORMAT "%7.5" /end MEASUREMENT
/begin MEASUREMENT egcp[0].egcp_struct_sigdglsl2.lamb_de_tot_act_lsl_up "Total cumulated lambda deviation" UWORD _CNV_A_R_EGCP_LINEA_330_CM 1 100. 0. 63.999023 DISPLAY_IDENTIFIER LAMB_DE_TOT_ACT_LSL_UP[1] ECU_ADDRESS 0xd0001b22 FORMAT "%7.4" /end MEASUREMENT
/begin MEASUREMENT egcp[0].egcp_struct_sigdglsl2.lamb_de_int_act_lsl_up "Cumulating value of the lambda deviation" UWORD _CNV_A_R_EGCP_LINEA_330_CM 1 100. 0. 63.999023 DISPLAY_IDENTIFIER LAMB_DE_INT_ACT_LSL_UP[1] ECU_ADDRESS 0xd0001b24 FORMAT "%7.4" /end MEASUREMENT
/begin MEASUREMENT egcp[0].egcp_struct_sigdglsl2.ctr_sum_raw_act_lsl_up "Counter to set the raw symptom of sensor non-activity" UWORD _CNV_A_R_LINEAR_____0_CM 1 100. 0. 65535. DISPLAY_IDENTIFIER CTR_SUM_RAW_ACT_LSL_UP[1] ECU_ADDRESS 0xd0001b26 FORMAT "%5.0" /end MEASUREMENT
/begin MEASUREMENT egcp[0].egcp_struct_sigdglsl2.vls_up_diag_save_puc_lsl_up "Upstream sensor voltage - value used during the diagnosis and transmitted to the Scan Tool in mode06" SWORD _CNV_A_R_LINEAR_____2_CM 1 100. -160. 159.9951171875 DISPLAY_IDENTIFIER VLS_UP_SAVE_DIAG_PUC_LSL_UP[1] ECU_ADDRESS 0xd0001b28 FORMAT "%8.3" /end MEASUREMENT
/begin MEASUREMENT egcp[0].egcp_struct_sigdglsl2.t_max_diag_end_puc_lsl_up "Time to set the END_DIAG bit " UWORD _CNV_A_R_LINEAR_____4_CM 1 100. 0. 6553.5 DISPLAY_IDENTIFIER T_MAX_DIAG_END_PUC_LSL_UP[1] ECU_ADDRESS 0xd0001b2a FORMAT "%6.1" /end MEASUREMENT
/begin MEASUREMENT egcp[0].egcp_struct_sigdglsl2.t_max_diag_sym_puc_lsl_up "Symptom debouncer time" UWORD _CNV_A_R_LINEAR_____4_CM 1 100. 0. 6553.5 DISPLAY_IDENTIFIER T_MAX_DIAG_SYM_PUC_LSL_UP[1] ECU_ADDRESS 0xd0001b2c FORMAT "%6.1" /end MEASUREMENT
/begin MEASUREMENT egcp[0].egcp_struct_sigdglsl2.lamb_de_lsl "Deviation of the instantaneous lambda value from the mean moving value " UWORD _CNV_A_R_EGCP_LINEA_330_CM 1 100. 0. 63.999023 DISPLAY_IDENTIFIER LAMB_DE_LSL[1] ECU_ADDRESS 0xd0001b2e FORMAT "%7.4" /end MEASUREMENT
/begin MEASUREMENT egcp[0].egcp_struct_sigdglsl2.t_max_dly_diag_puc_lsl_up "Maximimum delay time to activate the diagnosis" UWORD _CNV_A_R_LINEAR_____4_CM 1 100. 0. 6553.5 DISPLAY_IDENTIFIER T_MAX_DLY_DIAG_PUC_LSL_UP[1] ECU_ADDRESS 0xd0001b30 FORMAT "%6.1" /end MEASUREMENT
/begin MEASUREMENT egcp[0].egcp_struct_sigdglsl2.lamb_lpf_diag_dyn_lsl_up "Lambda value filtered with a Low Pass Filter" UWORD _CNV_A_R_LINEAR_____122_CM 1 100. 0. 31.9990234375 DISPLAY_IDENTIFIER LAMB_LPF_DIAG_DYN_LSL_UP[1] ECU_ADDRESS 0xd0001b32 FORMAT "%7.4" /end MEASUREMENT
/begin MEASUREMENT egcp[0].egcp_struct_sigdglsl2.t_diag_plaus_end_lsl_up "Timer to have a diagnostic available" UWORD _CNV_A_R_LINEAR_____4_CM 1 100. 0. 6553.5 DISPLAY_IDENTIFIER T_DIAG_PLAUS_END_LSL_UP[1] ECU_ADDRESS 0xd0001b34 FORMAT "%6.1" /end MEASUREMENT
/begin MEASUREMENT egcp[0].egcp_struct_sigdglsl2.t_sym_diag_air_lsl_up "Timer to debounce an error" UWORD _CNV_A_R_LINEAR_____4_CM 1 100. 0. 6553.5 DISPLAY_IDENTIFIER T_SYM_DIAG_AIR_LSL_UP[1] ECU_ADDRESS 0xd0001b36 FORMAT "%6.1" /end MEASUREMENT
/begin MEASUREMENT egcp[0].egcp_struct_sigdglsl2.t_end_diag_air_lsl_up "Timer to have a diagnostic available" UWORD _CNV_A_R_LINEAR_____4_CM 1 100. 0. 6553.5 DISPLAY_IDENTIFIER T_END_DIAG_AIR_LSL_UP[1] ECU_ADDRESS 0xd0001b38 FORMAT "%6.1" /end MEASUREMENT
/begin MEASUREMENT egcp[0].egcp_struct_sigdglsl2.t_sym_afs_plaus_lsl_up "Time for the plausibility symptom (compensation of the catalyst delay)" UWORD _CNV_A_R_LINEAR_____4_CM 1 100. 0. 6553.5 DISPLAY_IDENTIFIER T_SYM_AFS_PLAUS_LSL_UP[1] ECU_ADDRESS 0xd0001b3a FORMAT "%6.1" /end MEASUREMENT
/begin MEASUREMENT egcp[0].egcp_struct_sigdglsl2.t_diag_end_puc_lsl_up "Timer to have a diagnostic available" UWORD _CNV_A_R_LINEAR_____4_CM 1 100. 0. 6553.5 DISPLAY_IDENTIFIER T_DIAG_END_PUC_LSL_UP[1] ECU_ADDRESS 0xd0001b3c FORMAT "%6.1" /end MEASUREMENT
/begin MEASUREMENT egcp[0].egcp_struct_sigdglsl2.t_dly_diag_puc_lsl_up "Delay Time to activate the diagnosis" UWORD _CNV_A_R_LINEAR_____4_CM 1 100. 0. 6553.5 DISPLAY_IDENTIFIER T_DLY_DIAG_PUC_LSL_UP[1] ECU_ADDRESS 0xd0001b3e FORMAT "%6.1" /end MEASUREMENT
/begin MEASUREMENT egcp[0].egcp_struct_sigdglsl2.t_diag_sym_puc_lsl_up "Symptom debouncer timer" UWORD _CNV_A_R_LINEAR_____4_CM 1 100. 0. 6553.5 DISPLAY_IDENTIFIER T_DIAG_SYM_PUC_LSL_UP[1] ECU_ADDRESS 0xd0001b40 FORMAT "%6.1" /end MEASUREMENT
/begin MEASUREMENT egcp[0].egcp_struct_sigdglsl2.t_sym_afr_afl_plaus_lsl_up "Time for the plausibility symptom (compensation of the catalyst delay)" UWORD _CNV_A_R_LINEAR_____4_CM 1 100. 0. 6553.5 DISPLAY_IDENTIFIER T_SYM_AFR_AFL_PLAUS_LSL_UP[1] ECU_ADDRESS 0xd0001b42 FORMAT "%6.1" /end MEASUREMENT
/begin MEASUREMENT egcp[0].egcp_struct_sigdglsl2.lamb_min_diag_dyn_lsl_up "Minimum value of the lambda sensor signal (per sample period)" UWORD _CNV_A_R_LINEAR_____122_CM 1 100. 0. 31.9990234375 DISPLAY_IDENTIFIER LAMB_MIN_DIAG_DYN_LSL_UP[1] ECU_ADDRESS 0xd0001b44 FORMAT "%7.4" /end MEASUREMENT
/begin MEASUREMENT egcp[0].egcp_struct_sigdglsl2.lamb_max_diag_dyn_lsl_up "Maximum value of the lambda sensor signal (per sample period)" UWORD _CNV_A_R_LINEAR_____122_CM 1 100. 0. 31.9990234375 DISPLAY_IDENTIFIER LAMB_MAX_DIAG_DYN_LSL_UP[1] ECU_ADDRESS 0xd0001b46 FORMAT "%7.4" /end MEASUREMENT
/begin MEASUREMENT egcp[0].egcp_struct_sigdglsl2.lamb_ampl_int_diag_dyn_lsl_up "Integral over carried out single sensor signal amplitude measurement" UWORD _CNV_A_R_LINEAR_____122_CM 1 100. 0. 31.9990234375 DISPLAY_IDENTIFIER LAMB_AMPL_INT_DIAG_DYN_LSL_UP[1] ECU_ADDRESS 0xd0001b48 FORMAT "%7.4" /end MEASUREMENT
/begin MEASUREMENT egcp[0].egcp_struct_sigdglsl2.fac_value_diag_dyn_lsl_up "Normalized single sensor signal amplitude" UWORD _CNV_A_R_LINEAR_____122_CM 1 100. 0. 31.9990234375 DISPLAY_IDENTIFIER FAC_VALUE_DIAG_DYN_LSL_UP[1] ECU_ADDRESS 0xd0001b4a FORMAT "%7.4" /end MEASUREMENT
/begin MEASUREMENT egcp[0].egcp_struct_sigdglsl2.fac_sum_diag_dyn_lsl_up "Summation over all normalized single sensor signal amplitude" UWORD _CNV_A_R_EGCP_LINEA_330_CM 1 100. 0. 63.999023 DISPLAY_IDENTIFIER FAC_SUM_DIAG_DYN_LSL_UP[1] ECU_ADDRESS 0xd0001b4c FORMAT "%7.4" /end MEASUREMENT
/begin MEASUREMENT egcp[0].egcp_struct_sigdglsl2.fac_mv_diag_dyn_lsl_up "Mean value of normalized single sensor signal amplitude" UWORD _CNV_A_R_LINEAR_____122_CM 1 100. 0. 31.9990234375 DISPLAY_IDENTIFIER FAC_MV_DIAG_DYN_LSL_UP[1] ECU_ADDRESS 0xd0001b4e FORMAT "%7.4" /end MEASUREMENT
/begin MEASUREMENT egcp[0].egcp_struct_sigdglsl2.fac_diag_dyn_lsl_up "Adaption factor to the modeled sensor time constant" UWORD _CNV_A_R_LINEAR_____122_CM 1 100. 0. 1. DISPLAY_IDENTIFIER FAC_DIAG_DYN_LSL_UP[1] ECU_ADDRESS 0xd0001b50 FORMAT "%6.4" /end MEASUREMENT
/begin MEASUREMENT egcp[0].egcp_struct_sigdglsl2.t_dyn_diag_afl "Timer for maximum amplitude measurement duration after LV_AFL 0 -> 1" UWORD _CNV_A_R_LINEAR_____107_CM 1 100. 0. 1310.7 DISPLAY_IDENTIFIER T_DYN_DIAG_AFL[1] ECU_ADDRESS 0xd0001b52 FORMAT "%7.2" /end MEASUREMENT
/begin MEASUREMENT egcp[0].egcp_struct_sigdglsl2.t_dyn_diag_afr "Timer for maximum amplitude measurement duration after LV_AFL 1 -> 0" UWORD _CNV_A_R_LINEAR_____107_CM 1 100. 0. 1310.7 DISPLAY_IDENTIFIER T_DYN_DIAG_AFR[1] ECU_ADDRESS 0xd0001b54 FORMAT "%7.2" /end MEASUREMENT
/begin MEASUREMENT egcp[0].egcp_struct_sigdglsl2.ctr_diag_plaus_lsl_up "Oxygen Sensor Plausibility Check Debounce counter" UBYTE _CNV_A_R_LINEAR_____0_CM 1 100. 0. 255. DISPLAY_IDENTIFIER CTR_DIAG_PLAUS_LSL_UP[1] ECU_ADDRESS 0xd0001b56 FORMAT "%3.0" /end MEASUREMENT
/begin MEASUREMENT egcp[0].egcp_struct_sigdglsl2.lamb_ampl_diag_dyn_lsl_up "Carried out single sensor signal amplitude measurement" UBYTE _CNV_A_R_EGCP_LINEA_363_CM 1 100. 0. 0.124023 DISPLAY_IDENTIFIER LAMB_AMPL_DIAG_DYN_LSL_UP[1] ECU_ADDRESS 0xd0001b57 FORMAT "%6.4" /end MEASUREMENT
/begin MEASUREMENT egcp[0].egcp_struct_sigdglsl2.lamb_ampl_min_diag_dyn_lsl_up "Minimun acceptable carried out single sensor signal amplitude measurement" UBYTE _CNV_A_R_EGCP_LINEA_363_CM 1 100. 0. 0.124023 DISPLAY_IDENTIFIER LAMB_AMPL_MIN_DIAG_DYN_LSL_UP[1] ECU_ADDRESS 0xd0001b58 FORMAT "%6.4" /end MEASUREMENT
/begin MEASUREMENT egcp[0].egcp_struct_sigdglsl2.lamb_ampl_max_diag_dyn_lsl_up "Maximun acceptable carried out single sensor signal amplitude measurement" UBYTE _CNV_A_R_EGCP_LINEA_363_CM 1 100. 0. 0.124023 DISPLAY_IDENTIFIER LAMB_AMPL_MAX_DIAG_DYN_LSL_UP[1] ECU_ADDRESS 0xd0001b59 FORMAT "%6.4" /end MEASUREMENT
/begin MEASUREMENT egcp[0].egcp_struct_sigdglsl2.lamb_ampl_mv_diag_dyn_lsl_up "Sensor signal amplitude mean value" UBYTE _CNV_A_R_EGCP_LINEA_363_CM 1 100. 0. 0.124023 DISPLAY_IDENTIFIER LAMB_AMPL_MV_DIAG_DYN_LSL_UP[1] ECU_ADDRESS 0xd0001b5a FORMAT "%6.4" /end MEASUREMENT
/begin MEASUREMENT egcp[0].egcp_struct_sigdglsl2.ctr_diag_dyn_lsl_up "Number of  carried out single valid amplitude measurements" UBYTE _CNV_A_R_LINEAR_____0_CM 1 100. 0. 255. DISPLAY_IDENTIFIER CTR_DIAG_DYN_LSL_UP[1] ECU_ADDRESS 0xd0001b5b FORMAT "%3.0" /end MEASUREMENT
/begin MEASUREMENT egcp[0].egcp_struct_sigdglsl2.ctr_wait_diag_dyn_lsl_up "Number of forced stimulation periods before carrying out amplitude measurements" UBYTE _CNV_A_R_LINEAR_____0_CM 1 100. 0. 255. DISPLAY_IDENTIFIER CTR_WAIT_DIAG_DYN_LSL_UP[1] ECU_ADDRESS 0xd0001b5c FORMAT "%3.0" /end MEASUREMENT
/begin MEASUREMENT egcp[0].egcp_struct_sigdglsl2.cycnr_diag_dyn_lsl_up "Number of cycles necessary to finish the diagnosis" UBYTE _CNV_A_R_LINEAR_____0_CM 1 100. 0. 255. DISPLAY_IDENTIFIER CYCNR_DIAG_DYN_LSL_UP[1] ECU_ADDRESS 0xd0001b5d FORMAT "%3.0" /end MEASUREMENT
/begin MEASUREMENT egcp[0].egcp_struct_sigdglsl2.ctr_sym_act_lsl_up "Debounce counter of the sensor non-activity symptom" UBYTE _CNV_A_R_LINEAR_____0_CM 1 100. 0. 255. DISPLAY_IDENTIFIER CTR_SYM_ACT_LSL_UP[1] ECU_ADDRESS 0xd0001b5e FORMAT "%3.0" /end MEASUREMENT
/begin MEASUREMENT egcp[0].egcp_struct_sigdglsl2.ctr_lamb_de_int_act_lsl_up "Counter of forced stimulation periods" UBYTE _CNV_A_R_LINEAR_____0_CM 1 100. 0. 255. DISPLAY_IDENTIFIER CTR_LAMB_DE_INT_ACT_LSL_UP[1] ECU_ADDRESS 0xd0001b5f FORMAT "%3.0" /end MEASUREMENT
/begin MEASUREMENT egcp[0].egcp_struct_sigdglsl2.state_sym_diag_plaus_lsl_up "Oxygen Sensor Plausibility Check Symptom " UBYTE _CNV_S_4_EGCP_RANGE_364_CM 1 100. 0. 4. DISPLAY_IDENTIFIER STATE_SYM_DIAG_PLAUS_LSL_UP[1] ECU_ADDRESS 0xd0001b60 /end MEASUREMENT
/begin MEASUREMENT egcp[0].egcp_struct_sigdglsl2.state_sym_diag_puc_lsl_up "Symptom of of the signal plausibility from the upstraem sensor during PUC" UBYTE _CNV_S_4_EGCP_RANGE_365_CM 1 100. 0. 3. DISPLAY_IDENTIFIER STATE_SYM_DIAG_PUC_LSL_UP[1] ECU_ADDRESS 0xd0001b61 /end MEASUREMENT
/begin MEASUREMENT egcp[0].egcp_struct_sigdglsl2.state_dyn_diag "State shows the condition of the forced stimulation " UBYTE _CNV_S_4_EGCP_RANGE_366_CM 1 100. 0. 3. DISPLAY_IDENTIFIER STATE_DYN_DIAG[1] ECU_ADDRESS 0xd0001b62 /end MEASUREMENT
/begin MEASUREMENT egcp[0].egcp_struct_sigdglsl2.lv_diag_plaus_sym_lsl_up "Debounced diagnosis result of the signal plausibility for the wide range A/F sensor" UBYTE _CNV_S_2_RANGE__0___1_CM 1 100. 0. 1. DISPLAY_IDENTIFIER LV_DIAG_PLAUS_SYM_LSL_UP[1] ECU_ADDRESS 0xd0001b63 BIT_MASK 0x1 /end MEASUREMENT
/begin MEASUREMENT egcp[0].egcp_struct_sigdglsl2.lv_diag_cdn_plaus_lsl_up "Diagnosis condition" UBYTE _CNV_S_2_RANGE__0___1_CM 1 100. 0. 1. DISPLAY_IDENTIFIER LV_DIAG_CDN_PLAUS_LSL_UP[1] ECU_ADDRESS 0xd0001b64 BIT_MASK 0x1 /end MEASUREMENT
/begin MEASUREMENT egcp[0].egcp_struct_sigdglsl2.lv_diag_plaus_end_lsl_up "Result of diagnosis exists" UBYTE _CNV_S_2_RANGE__0___1_CM 1 100. 0. 1. DISPLAY_IDENTIFIER LV_DIAG_PLAUS_END_LSL_UP[1] ECU_ADDRESS 0xd0001b65 BIT_MASK 0x1 /end MEASUREMENT
/begin MEASUREMENT egcp[0].egcp_struct_sigdglsl2.lv_diag_dyn_sym_lsl_up "Debounce diagnosis value of the sensor dynamics" UBYTE _CNV_S_2_RANGE__0___1_CM 1 100. 0. 1. DISPLAY_IDENTIFIER LV_DIAG_DYN_SYM_LSL_UP[1] ECU_ADDRESS 0xd0001b66 BIT_MASK 0x1 /end MEASUREMENT
/begin MEASUREMENT egcp[0].egcp_struct_sigdglsl2.lv_diag_dyn_end_lsl_up "Result of diagnosis exists" UBYTE _CNV_S_2_RANGE__0___1_CM 1 100. 0. 1. DISPLAY_IDENTIFIER LV_DIAG_DYN_END_LSL_UP[1] ECU_ADDRESS 0xd0001b67 BIT_MASK 0x1 /end MEASUREMENT
/begin MEASUREMENT egcp[0].egcp_struct_sigdglsl2.lv_diag_dyn_cdn_lsl_up "Diagnosis condition" UBYTE _CNV_S_2_RANGE__0___1_CM 1 100. 0. 1. DISPLAY_IDENTIFIER LV_DIAG_DYN_CDN_LSL_UP[1] ECU_ADDRESS 0xd0001b68 BIT_MASK 0x1 /end MEASUREMENT
/begin MEASUREMENT egcp[0].egcp_struct_sigdglsl2.lv_diag_puc_sym_lsl_up "Debounced diagnosis result of the signal plausibility from the upstream sensor during PUC" UBYTE _CNV_S_2_RANGE__0___1_CM 1 100. 0. 1. DISPLAY_IDENTIFIER LV_DIAG_PUC_SYM_LSL_UP[1] ECU_ADDRESS 0xd0001b69 BIT_MASK 0x1 /end MEASUREMENT
/begin MEASUREMENT egcp[0].egcp_struct_sigdglsl2.lv_diag_cdn_puc_lsl_up "Diagnosis condition" UBYTE _CNV_S_2_RANGE__0___1_CM 1 100. 0. 1. DISPLAY_IDENTIFIER LV_DIAG_CDN_PUC_LSL_UP[1] ECU_ADDRESS 0xd0001b6a BIT_MASK 0x1 /end MEASUREMENT
/begin MEASUREMENT egcp[0].egcp_struct_sigdglsl2.lv_diag_puc_end_lsl_up "Result of diagnosis exists" UBYTE _CNV_S_2_RANGE__0___1_CM 1 100. 0. 1. DISPLAY_IDENTIFIER LV_DIAG_PUC_END_LSL_UP[1] ECU_ADDRESS 0xd0001b6b BIT_MASK 0x1 /end MEASUREMENT
/begin MEASUREMENT egcp[0].egcp_struct_sigdglsl2.lv_lamb_pls_req_dyn_lsl_up "Request forced stimulation parameters specific for the WRAF sensor dynamic" UBYTE _CNV_S_2_RANGE__0___1_CM 1 100. 0. 1. DISPLAY_IDENTIFIER LV_LAMB_PLS_REQ_DYN_LSL_UP[1] ECU_ADDRESS 0xd0001b6c BIT_MASK 0x1 /end MEASUREMENT
/begin MEASUREMENT egcp[0].egcp_struct_sigdglsl2.lv_lam_adj_req_dyn_lsl_up "Request dynamic trim controller parameters specific for the WRAF sensor dynamic" UBYTE _CNV_S_2_RANGE__0___1_CM 1 100. 0. 1. DISPLAY_IDENTIFIER LV_LAM_ADJ_REQ_DYN_LSL_UP[1] ECU_ADDRESS 0xd0001b6d BIT_MASK 0x1 /end MEASUREMENT
/begin MEASUREMENT egcp[0].egcp_struct_sigdglsl2.lv_diag_afr_sym_plaus_lsl_up "Oxygen Sensor Plausibility Check - not debounced symptom \"SENS_AFR\"  " UBYTE _CNV_S_2_RANGE__0___1_CM 1 100. 0. 1. DISPLAY_IDENTIFIER LV_DIAG_AFR_SYM_PLAUS_LSL_UP[1] ECU_ADDRESS 0xd0001b6e BIT_MASK 0x1 /end MEASUREMENT
/begin MEASUREMENT egcp[0].egcp_struct_sigdglsl2.lv_diag_afl_sym_plaus_lsl_up "Oxygen Sensor Plausibility Check - not debounced symptom \"SENS_AFL\"" UBYTE _CNV_S_2_RANGE__0___1_CM 1 100. 0. 1. DISPLAY_IDENTIFIER LV_DIAG_AFL_SYM_PLAUS_LSL_UP[1] ECU_ADDRESS 0xd0001b6f BIT_MASK 0x1 /end MEASUREMENT
/begin MEASUREMENT egcp[0].egcp_struct_sigdglsl2.lv_diag_raw_act_sym_lsl_up "Boolean flag indicating a detected raw symptom of sensor non-activity (from first test)" UBYTE _CNV_S_2_RANGE__0___1_CM 1 100. 0. 1. DISPLAY_IDENTIFIER LV_DIAG_RAW_ACT_SYM_LSL_UP[1] ECU_ADDRESS 0xd0001b70 BIT_MASK 0x1 /end MEASUREMENT
/begin MEASUREMENT egcp[0].egcp_struct_sigdglsl2.lv_diag_act_sym_lsl_up "Boolean flag indicating a detected poor upstream sensor activity  (from second test)" UBYTE _CNV_S_2_RANGE__0___1_CM 1 100. 0. 1. DISPLAY_IDENTIFIER LV_DIAG_ACT_SYM_LSL_UP[1] ECU_ADDRESS 0xd0001b71 BIT_MASK 0x1 /end MEASUREMENT
/begin MEASUREMENT egcp[0].egcp_struct_sigdglsl2.lv_diag_act_cdn_lsl_up "Boolean flag indicating the conditions to activate the second test  for sensor non-activity are fulfilled" UBYTE _CNV_S_2_RANGE__0___1_CM 1 100. 0. 1. DISPLAY_IDENTIFIER LV_DIAG_ACT_CDN_LSL_UP[1] ECU_ADDRESS 0xd0001b72 BIT_MASK 0x1 /end MEASUREMENT
/begin MEASUREMENT egcp[0].egcp_struct_sigdglsl2.lv_diag_act_sho_cdn_lsl_up "Boolean flag indicating the short term conditions to activate the second test  for sensor non-activity are fulfilled" UBYTE _CNV_S_2_RANGE__0___1_CM 1 100. 0. 1. DISPLAY_IDENTIFIER LV_DIAG_ACT_SHO_CDN_LSL_UP[1] ECU_ADDRESS 0xd0001b73 BIT_MASK 0x1 /end MEASUREMENT
/begin MEASUREMENT egcp[0].egcp_struct_sigdglsli2.lv_inh_diag_rbm_air_lsl_up "Deactivation of Rate Based Monitoring of ¿Monitoring Upstream Sensor Signal  by malfunction" UBYTE _CNV_S_2_RANGE__0___1_CM 1 100. 0. 1. DISPLAY_IDENTIFIER LV_INH_DIAG_RBM_AIR_LSL_UP[1] ECU_ADDRESS 0xd0001b74 BIT_MASK 0x1 /end MEASUREMENT
/begin MEASUREMENT egcp[0].egcp_struct_sigdglsli2.lv_diag_plaus_inh_lsl_up "Deactivation of \"Plausibility check of the sensor signal\"" UBYTE _CNV_S_2_RANGE__0___1_CM 1 100. 0. 1. DISPLAY_IDENTIFIER LV_DIAG_PLAUS_INH_LSL_UP[1] ECU_ADDRESS 0xd0001b75 BIT_MASK 0x1 /end MEASUREMENT
/begin MEASUREMENT egcp[0].egcp_struct_sigdglsli2.lv_diag_dyn_inh_lsl_up "Deactivation of \"Diagnosis of the WRAF Sensor Dynamic\"" UBYTE _CNV_S_2_RANGE__0___1_CM 1 100. 0. 1. DISPLAY_IDENTIFIER LV_DIAG_DYN_INH_LSL_UP[1] ECU_ADDRESS 0xd0001b76 BIT_MASK 0x1 /end MEASUREMENT
/begin MEASUREMENT egcp[0].egcp_struct_sigdglsli2.lv_inh_diag_air_lsl_up "Deactivation of \"Monitoring Upstream Sensor Signal \"" UBYTE _CNV_S_2_RANGE__0___1_CM 1 100. 0. 1. DISPLAY_IDENTIFIER LV_INH_DIAG_AIR_LSL_UP[1] ECU_ADDRESS 0xd0001b77 BIT_MASK 0x1 /end MEASUREMENT
/begin MEASUREMENT egcp[0].egcp_struct_sigdglsli2.lv_inh_diag_puc_lsl_up "Deactivation of \"Monitoring Upstream Sensor Signal during PUC\"" UBYTE _CNV_S_2_RANGE__0___1_CM 1 100. 0. 1. DISPLAY_IDENTIFIER LV_INH_DIAG_PUC_LSL_UP[1] ECU_ADDRESS 0xd0001b78 BIT_MASK 0x1 /end MEASUREMENT
/begin MEASUREMENT egcp[0].egcp_struct_sigdglsli2.lv_diag_eol_dyn_ls_up "Status variable for activaton of lambda sensor diagnosis function via short trip" UBYTE _CNV_S_2_RANGE__0___1_CM 1 100. 0. 1. DISPLAY_IDENTIFIER LV_DIAG_EOL_DYN_LS_UP[1] ECU_ADDRESS 0xd0001b79 BIT_MASK 0x1 /end MEASUREMENT
/begin MEASUREMENT egcp[0].egcp_struct_sigdglsli2.lv_diag_eol_puc_lsl_up "Activation of short trip for Monitoring Upstream Sensor during PUC" UBYTE _CNV_S_2_RANGE__0___1_CM 1 100. 0. 1. DISPLAY_IDENTIFIER LV_DIAG_EOL_PUC_LSL_UP[1] ECU_ADDRESS 0xd0001b7a BIT_MASK 0x1 /end MEASUREMENT
/begin MEASUREMENT egcp[0].egcp_struct_sigdglsli2.lv_inh_diag_rbm_dyn_vld_ls_up "Inhibition of false start recognition  diagnosis" UBYTE _CNV_S_2_RANGE__0___1_CM 1 100. 0. 1. DISPLAY_IDENTIFIER LV_INH_DIAG_RBM_DYN_VLD_LS_UP[1] ECU_ADDRESS 0xd0001b7b BIT_MASK 0x1 /end MEASUREMENT
/begin MEASUREMENT egcp[0].egcp_struct_sigdglsli2.state_rbm_dyn_vld_ls_up "Interface of DYN_VLD_LS_UP[NC_CBK_EX_NR] monitor with the Rate-Based Monitoring statistics" UBYTE _CNV_A_R_LINEAR_____0_CM 1 100. 0. 7. DISPLAY_IDENTIFIER STATE_RBM_DYN_VLD_LS_UP[1] ECU_ADDRESS 0xd0001b7c FORMAT "%1.0" /end MEASUREMENT
/begin MEASUREMENT egcp[0].egcp_struct_sigdglsli2.state_rbm_air_lsl_up "Interface of DYN_VLD_LS_UP[NC_CBK_EX_NR] monitor with the Rate-Based Monitoring statistics" UBYTE _CNV_A_R_LINEAR_____0_CM 1 100. 0. 7. DISPLAY_IDENTIFIER STATE_RBM_AIR_LSL_UP[1] ECU_ADDRESS 0xd0001b7d FORMAT "%1.0" /end MEASUREMENT
/begin MEASUREMENT egcp[0].egcp_struct_sigdglsli2.lv_inh_diag_rbm_puc_lsl_up "Deactivation of Monitoring Upstream Sensor Signal during PUC by other failures" UBYTE _CNV_S_2_RANGE__0___1_CM 1 100. 0. 1. DISPLAY_IDENTIFIER LV_INH_DIAG_RBM_PUC_LSL_UP[1] ECU_ADDRESS 0xd0001b7e BIT_MASK 0x1 /end MEASUREMENT
/begin MEASUREMENT egcp[0].egcp_struct_sigdglsli2.lv_diag_eol_air_lsl_up "Deactivation of Monitoring Upstream Sensor Signal during PUC by other failures" UBYTE _CNV_S_2_RANGE__0___1_CM 1 100. 0. 1. DISPLAY_IDENTIFIER LV_DIAG_EOL_AIR_LSL_UP ECU_ADDRESS 0xd0001b7f BIT_MASK 0x1 /end MEASUREMENT
/begin MEASUREMENT egcp[0].egcp_struct_sigdglsli2.state_rbm_puc_vld_ls_up "Interface of PUC_VLD_LSL_UP[NC_CBK_EX_NR] monitor with the Rate-Based Monitoring statistics" UBYTE _CNV_A_R_LINEAR_____0_CM 1 100. 0. 255. DISPLAY_IDENTIFIER STATE_RBM_PUC_VLD_LS_UP[1] ECU_ADDRESS 0xd0001b80 FORMAT "%3.0" /end MEASUREMENT
/begin MEASUREMENT egcp[0].egcp_struct_pladglsli1.lv_diag_act_inh_ls_up_down "Inhibit sensor signal plausibility active test" UBYTE _CNV_S_2_RANGE__0___1_CM 1 100. 0. 1. DISPLAY_IDENTIFIER LV_DIAG_ACT_INH_LS_UP_DOWN[1] ECU_ADDRESS 0xd0001b82 BIT_MASK 0x1 /end MEASUREMENT
/begin MEASUREMENT egcp[0].egcp_struct_pladglsli1.lv_diag_afr_afl_inh_ls_up_down "Inhibit sensor signal plausibility active test under air-fuel rich conditons" UBYTE _CNV_S_2_RANGE__0___1_CM 1 100. 0. 1. DISPLAY_IDENTIFIER LV_DIAG_AFR_AFL_INH_LS_UP_DOWN[1] ECU_ADDRESS 0xd0001b83 BIT_MASK 0x1 /end MEASUREMENT
/begin MEASUREMENT egcp[0].egcp_struct_pladglsli1.lv_diag_eol_req_ls_up_down "Start EOL active test " UBYTE _CNV_S_2_RANGE__0___1_CM 1 100. 0. 1. DISPLAY_IDENTIFIER LV_DIAG_EOL_REQ_LS_UP_DOWN[1] ECU_ADDRESS 0xd0001b84 BIT_MASK 0x1 /end MEASUREMENT
/begin MEASUREMENT egcp[0].egcp_struct_sigdglsl3.lamb_delta_rise_lpf "Mean value for heater coupling (rising edge)" SWORD _CNV_A_R_LINEAR_____23_CM 1 100. -2. 1.99993896484375 DISPLAY_IDENTIFIER LAMB_DELTA_RISE_LPF[1] ECU_ADDRESS 0xd0001b88 FORMAT "%8.5" /end MEASUREMENT
/begin MEASUREMENT egcp[0].egcp_struct_sigdglsl3.lamb_delta_fall_lpf "Mean value for heater coupling (falling edge)" SWORD _CNV_A_R_LINEAR_____23_CM 1 100. -2. 1.99993896484375 DISPLAY_IDENTIFIER LAMB_DELTA_FALL_LPF[1] ECU_ADDRESS 0xd0001b8a FORMAT "%8.5" /end MEASUREMENT
/begin MEASUREMENT egcp[0].egcp_struct_sigdglsl3.lamb_syn_lshpwm_fall "Lambda value acquied after lshpwm signal falling edge" UWORD _CNV_A_R_LINEAR_____23_CM 1 100. 0. 1.99993896484375 DISPLAY_IDENTIFIER LAMB_SYN_LSHPWM_FALL[1] ECU_ADDRESS 0xd0001b8c FORMAT "%7.5" /end MEASUREMENT
/begin MEASUREMENT egcp[0].egcp_struct_sigdglsl3.lamb_syn_lshpwm_rise "Lambda value acquied after lshpwm signal rising edge" UWORD _CNV_A_R_LINEAR_____23_CM 1 100. 0. 1.99993896484375 DISPLAY_IDENTIFIER LAMB_SYN_LSHPWM_RISE[1] ECU_ADDRESS 0xd0001b8e FORMAT "%7.5" /end MEASUREMENT
/begin MEASUREMENT egcp[0].egcp_struct_sigdglsl3.lamb_delta_rise "Variation of lambda value before and after lshpwm signal rising edge" SWORD _CNV_A_R_LINEAR_____23_CM 1 100. -2. 1.99993896484375 DISPLAY_IDENTIFIER LAMB_DELTA_RISE[1] ECU_ADDRESS 0xd0001b90 FORMAT "%8.5" /end MEASUREMENT
/begin MEASUREMENT egcp[0].egcp_struct_sigdglsl3.lamb_delta_fall "Variation of lambda value before and after lshpwm signal falling edge" SWORD _CNV_A_R_LINEAR_____23_CM 1 100. -2. 1.99993896484375 DISPLAY_IDENTIFIER LAMB_DELTA_FALL[1] ECU_ADDRESS 0xd0001b92 FORMAT "%8.5" /end MEASUREMENT
/begin MEASUREMENT egcp[0].egcp_struct_sigdglsl3.ctr_sym_diag_lsh_lsl_up "Counter of forced stimulation periods with a present symptom" UBYTE _CNV_A_R_LINEAR_____0_CM 1 100. 0. 255. DISPLAY_IDENTIFIER CTR_SYM_DIAG_LSH_LSL_UP[1] ECU_ADDRESS 0xd0001b94 FORMAT "%3.0" /end MEASUREMENT
/begin MEASUREMENT egcp[0].egcp_struct_sigdglsl3.cycnr_diag_lsh_lsl_up "Counter of forced stimulation periods investigated" UBYTE _CNV_A_R_LINEAR_____0_CM 1 100. 0. 255. DISPLAY_IDENTIFIER CYCNR_DIAG_LSH_LSL_UP[1] ECU_ADDRESS 0xd0001b95 FORMAT "%3.0" /end MEASUREMENT
/begin MEASUREMENT egcp[0].egcp_struct_sigdglsl3.t_dly_trig_lsh_up "Time delay for acquisition of oxygen sensor signal and lambda model" UBYTE _CNV_A_R_EGCP_LINEA_367_CM 1 100. 0. 0.255 DISPLAY_IDENTIFIER T_DLY_TRIG_LSH_UP[1] ECU_ADDRESS 0xd0001b96 FORMAT "%5.3" /end MEASUREMENT
/begin MEASUREMENT egcp[0].egcp_struct_sigdglsli3.lv_inh_diag_lsh_lsl_up "Deactivation of \"Diagnosis of the Heater Coupling in the Sensor Signal\"" UBYTE _CNV_S_2_RANGE__0___1_CM 1 100. 0. 1. DISPLAY_IDENTIFIER LV_INH_DIAG_LSH_LSL_UP[1] ECU_ADDRESS 0xd0001b98 BIT_MASK 0x1 /end MEASUREMENT
/begin MEASUREMENT egcp[0].egcp_struct_sigdglsd3.vls_down_rgn_nt_end "Monitor sensor voltage at the time of leaving regeneration phase of NOx trap, Bank i (i=1.2)" UWORD _CNV_A_R_LINEAR_____2_CM 1 100. 0. 4.9951171875 DISPLAY_IDENTIFIER VLS_DOWN_RGN_NT_END[1] ECU_ADDRESS 0xd0001be0 FORMAT "%5.3" /end MEASUREMENT
/begin MEASUREMENT egcp[0].egcp_struct_sigdglsd3.maf_int_rgn_nt_s_act "Mass air flow which has passed since activation of stratified mode" UWORD _CNV_A_R_LINEAR_____329_CM 1 100. 0. 2912.66666666667 DISPLAY_IDENTIFIER MAF_INT_RGN_NT_S_ACT[1] ECU_ADDRESS 0xd0001be2 FORMAT "%7.2" /end MEASUREMENT
/begin MEASUREMENT egcp[0].egcp_struct_sigdglsd3.maf_int_rgn_nt_end "Mass air flow which has passed since last regeneration cycle" UWORD _CNV_A_R_LINEAR_____329_CM 1 100. 0. 2912.66666666667 DISPLAY_IDENTIFIER MAF_INT_RGN_NT_END[1] ECU_ADDRESS 0xd0001be4 FORMAT "%7.2" /end MEASUREMENT
/begin MEASUREMENT egcp[0].egcp_struct_sigdglsd3.t_rgn_nt_end "Time which has passed after leaving last regeneration cycle" UWORD _CNV_A_R_LINEAR_____107_CM 1 100. 0. 1310.7 DISPLAY_IDENTIFIER T_RGN_NT_END[1] ECU_ADDRESS 0xd0001be6 FORMAT "%7.2" /end MEASUREMENT
/begin MEASUREMENT egcp[0].egcp_struct_sigdglsd3.ctr_sym_diag_rgn_nt_ls_down "Counter for internal anti-bounce of error symptom" UWORD _CNV_A_R_LINEAR_____0_CM 1 100. 0. 65535. DISPLAY_IDENTIFIER CTR_SYM_DIAG_RGN_NT_LS_DOWN[1] ECU_ADDRESS 0xd0001be8 FORMAT "%5.0" /end MEASUREMENT
/begin MEASUREMENT egcp[0].egcp_struct_sigdglsd3.vls_down_rgn_nt_dif "Measured Voltage difference used for error detection" SWORD _CNV_A_R_LINEAR_____369_CM 1 100. -5.00000000000182 4.99511718999747 DISPLAY_IDENTIFIER VLS_DOWN_RGN_NT_DIF[1] ECU_ADDRESS 0xd0001bea /end MEASUREMENT
/begin MEASUREMENT egcp[0].egcp_struct_sigdglsd3.ctr_end_diag_rgn_nt_ls_down "Counter for end bit calculation" UBYTE _CNV_A_R_LINEAR_____0_CM 1 100. 0. 255. DISPLAY_IDENTIFIER CTR_END_DIAG_RGN_NT_LS_DOWN[1] ECU_ADDRESS 0xd0001bec FORMAT "%3.0" /end MEASUREMENT
/begin MEASUREMENT egcp[0].egcp_struct_sigdglsd3.lv_diag_act_rgn_nt_ls_down "Logical variable indicating that diagnosis conditions are fulfilled" UBYTE _CNV_S_2_RANGE__0___1_CM 1 100. 0. 1. DISPLAY_IDENTIFIER LV_DIAG_ACT_RGN_NT_LS_DOWN[1] ECU_ADDRESS 0xd0001bed BIT_MASK 0x1 /end MEASUREMENT
/begin MEASUREMENT egcp[0].egcp_struct_sigdglsdi3.lv_inh_diag_rgn_nt_ls_down "Logical variable indicating inhibition of downstream oxygen sensor diagnosis after NOx cat regeneration" UBYTE _CNV_S_2_RANGE__0___1_CM 1 100. 0. 1. DISPLAY_IDENTIFIER LV_INH_DIAG_RGN_NT_LS_DOWN[1] ECU_ADDRESS 0xd0001bee BIT_MASK 0x1 /end MEASUREMENT
/begin MEASUREMENT egcp[1].egcp_struct_sigcvridi0.lv_inh_r_it_ls_down "Boolean flag indicating that downstream sensor internal resistance determination shall be inhibited when set" UBYTE _CNV_S_2_RANGE__0___1_CM 1 100. 0. 1. DISPLAY_IDENTIFIER LV_INH_R_IT_LS_DOWN[2] ECU_ADDRESS 0xd0001d28 BIT_MASK 0x1 /end MEASUREMENT
/begin MEASUREMENT egcp[1].egcp_struct_sigdglsl2.lamb_mmv_act_lsl_up "Lambda moving mean value during the time the forced stimulation is active" UWORD _CNV_A_R_LINEAR_____8_CM 1 100. 0. 1.99996948242188 DISPLAY_IDENTIFIER LAMB_MMV_ACT_LSL_UP[2] ECU_ADDRESS 0xd0001e10 FORMAT "%7.5" /end MEASUREMENT
/begin MEASUREMENT egcp[1].egcp_struct_sigdglsl2.lamb_de_tot_act_lsl_up "Total cumulated lambda deviation" UWORD _CNV_A_R_EGCP_LINEA_330_CM 1 100. 0. 63.999023 DISPLAY_IDENTIFIER LAMB_DE_TOT_ACT_LSL_UP[2] ECU_ADDRESS 0xd0001e12 FORMAT "%7.4" /end MEASUREMENT
/begin MEASUREMENT egcp[1].egcp_struct_sigdglsl2.lamb_de_int_act_lsl_up "Cumulating value of the lambda deviation" UWORD _CNV_A_R_EGCP_LINEA_330_CM 1 100. 0. 63.999023 DISPLAY_IDENTIFIER LAMB_DE_INT_ACT_LSL_UP[2] ECU_ADDRESS 0xd0001e14 FORMAT "%7.4" /end MEASUREMENT
/begin MEASUREMENT egcp[1].egcp_struct_sigdglsl2.ctr_sum_raw_act_lsl_up "Counter to set the raw symptom of sensor non-activity" UWORD _CNV_A_R_LINEAR_____0_CM 1 100. 0. 65535. DISPLAY_IDENTIFIER CTR_SUM_RAW_ACT_LSL_UP[2] ECU_ADDRESS 0xd0001e16 FORMAT "%5.0" /end MEASUREMENT
/begin MEASUREMENT egcp[1].egcp_struct_sigdglsl2.vls_up_diag_save_puc_lsl_up "Upstream sensor voltage - value used during the diagnosis and transmitted to the Scan Tool in mode06" SWORD _CNV_A_R_LINEAR_____2_CM 1 100. -160. 159.9951171875 DISPLAY_IDENTIFIER VLS_UP_SAVE_DIAG_PUC_LSL_UP[2] ECU_ADDRESS 0xd0001e18 FORMAT "%8.3" /end MEASUREMENT
/begin MEASUREMENT egcp[1].egcp_struct_sigdglsl2.t_max_diag_end_puc_lsl_up "Time to set the END_DIAG bit " UWORD _CNV_A_R_LINEAR_____4_CM 1 100. 0. 6553.5 DISPLAY_IDENTIFIER T_MAX_DIAG_END_PUC_LSL_UP[2] ECU_ADDRESS 0xd0001e1a FORMAT "%6.1" /end MEASUREMENT
/begin MEASUREMENT egcp[1].egcp_struct_sigdglsl2.t_max_diag_sym_puc_lsl_up "Symptom debouncer time" UWORD _CNV_A_R_LINEAR_____4_CM 1 100. 0. 6553.5 DISPLAY_IDENTIFIER T_MAX_DIAG_SYM_PUC_LSL_UP[2] ECU_ADDRESS 0xd0001e1c FORMAT "%6.1" /end MEASUREMENT
/begin MEASUREMENT egcp[1].egcp_struct_sigdglsl2.lamb_de_lsl "Deviation of the instantaneous lambda value from the mean moving value " UWORD _CNV_A_R_EGCP_LINEA_330_CM 1 100. 0. 63.999023 DISPLAY_IDENTIFIER LAMB_DE_LSL[2] ECU_ADDRESS 0xd0001e1e FORMAT "%7.4" /end MEASUREMENT
/begin MEASUREMENT egcp[1].egcp_struct_sigdglsl2.t_max_dly_diag_puc_lsl_up "Maximimum delay time to activate the diagnosis" UWORD _CNV_A_R_LINEAR_____4_CM 1 100. 0. 6553.5 DISPLAY_IDENTIFIER T_MAX_DLY_DIAG_PUC_LSL_UP[2] ECU_ADDRESS 0xd0001e20 FORMAT "%6.1" /end MEASUREMENT
/begin MEASUREMENT egcp[1].egcp_struct_sigdglsl2.lamb_lpf_diag_dyn_lsl_up "Lambda value filtered with a Low Pass Filter" UWORD _CNV_A_R_LINEAR_____122_CM 1 100. 0. 31.9990234375 DISPLAY_IDENTIFIER LAMB_LPF_DIAG_DYN_LSL_UP[2] ECU_ADDRESS 0xd0001e22 FORMAT "%7.4" /end MEASUREMENT
/begin MEASUREMENT egcp[1].egcp_struct_sigdglsl2.t_diag_plaus_end_lsl_up "Timer to have a diagnostic available" UWORD _CNV_A_R_LINEAR_____4_CM 1 100. 0. 6553.5 DISPLAY_IDENTIFIER T_DIAG_PLAUS_END_LSL_UP[2] ECU_ADDRESS 0xd0001e24 FORMAT "%6.1" /end MEASUREMENT
/begin MEASUREMENT egcp[1].egcp_struct_sigdglsl2.t_sym_diag_air_lsl_up "Timer to debounce an error" UWORD _CNV_A_R_LINEAR_____4_CM 1 100. 0. 6553.5 DISPLAY_IDENTIFIER T_SYM_DIAG_AIR_LSL_UP[2] ECU_ADDRESS 0xd0001e26 FORMAT "%6.1" /end MEASUREMENT
/begin MEASUREMENT egcp[1].egcp_struct_sigdglsl2.t_end_diag_air_lsl_up "Timer to have a diagnostic available" UWORD _CNV_A_R_LINEAR_____4_CM 1 100. 0. 6553.5 DISPLAY_IDENTIFIER T_END_DIAG_AIR_LSL_UP[2] ECU_ADDRESS 0xd0001e28 FORMAT "%6.1" /end MEASUREMENT
/begin MEASUREMENT egcp[1].egcp_struct_sigdglsl2.t_sym_afs_plaus_lsl_up "Time for the plausibility symptom (compensation of the catalyst delay)" UWORD _CNV_A_R_LINEAR_____4_CM 1 100. 0. 6553.5 DISPLAY_IDENTIFIER T_SYM_AFS_PLAUS_LSL_UP[2] ECU_ADDRESS 0xd0001e2a FORMAT "%6.1" /end MEASUREMENT
/begin MEASUREMENT egcp[1].egcp_struct_sigdglsl2.t_diag_end_puc_lsl_up "Timer to have a diagnostic available" UWORD _CNV_A_R_LINEAR_____4_CM 1 100. 0. 6553.5 DISPLAY_IDENTIFIER T_DIAG_END_PUC_LSL_UP[2] ECU_ADDRESS 0xd0001e2c FORMAT "%6.1" /end MEASUREMENT
/begin MEASUREMENT egcp[1].egcp_struct_sigdglsl2.t_dly_diag_puc_lsl_up "Delay Time to activate the diagnosis" UWORD _CNV_A_R_LINEAR_____4_CM 1 100. 0. 6553.5 DISPLAY_IDENTIFIER T_DLY_DIAG_PUC_LSL_UP[2] ECU_ADDRESS 0xd0001e2e FORMAT "%6.1" /end MEASUREMENT
/begin MEASUREMENT egcp[1].egcp_struct_sigdglsl2.t_diag_sym_puc_lsl_up "Symptom debouncer timer" UWORD _CNV_A_R_LINEAR_____4_CM 1 100. 0. 6553.5 DISPLAY_IDENTIFIER T_DIAG_SYM_PUC_LSL_UP[2] ECU_ADDRESS 0xd0001e30 FORMAT "%6.1" /end MEASUREMENT
/begin MEASUREMENT egcp[1].egcp_struct_sigdglsl2.t_sym_afr_afl_plaus_lsl_up "Time for the plausibility symptom (compensation of the catalyst delay)" UWORD _CNV_A_R_LINEAR_____4_CM 1 100. 0. 6553.5 DISPLAY_IDENTIFIER T_SYM_AFR_AFL_PLAUS_LSL_UP[2] ECU_ADDRESS 0xd0001e32 FORMAT "%6.1" /end MEASUREMENT
/begin MEASUREMENT egcp[1].egcp_struct_sigdglsl2.lamb_min_diag_dyn_lsl_up "Minimum value of the lambda sensor signal (per sample period)" UWORD _CNV_A_R_LINEAR_____122_CM 1 100. 0. 31.9990234375 DISPLAY_IDENTIFIER LAMB_MIN_DIAG_DYN_LSL_UP[2] ECU_ADDRESS 0xd0001e34 FORMAT "%7.4" /end MEASUREMENT
/begin MEASUREMENT egcp[1].egcp_struct_sigdglsl2.lamb_max_diag_dyn_lsl_up "Maximum value of the lambda sensor signal (per sample period)" UWORD _CNV_A_R_LINEAR_____122_CM 1 100. 0. 31.9990234375 DISPLAY_IDENTIFIER LAMB_MAX_DIAG_DYN_LSL_UP[2] ECU_ADDRESS 0xd0001e36 FORMAT "%7.4" /end MEASUREMENT
/begin MEASUREMENT egcp[1].egcp_struct_sigdglsl2.lamb_ampl_int_diag_dyn_lsl_up "Integral over carried out single sensor signal amplitude measurement" UWORD _CNV_A_R_LINEAR_____122_CM 1 100. 0. 31.9990234375 DISPLAY_IDENTIFIER LAMB_AMPL_INT_DIAG_DYN_LSL_UP[2] ECU_ADDRESS 0xd0001e38 FORMAT "%7.4" /end MEASUREMENT
/begin MEASUREMENT egcp[1].egcp_struct_sigdglsl2.fac_value_diag_dyn_lsl_up "Normalized single sensor signal amplitude" UWORD _CNV_A_R_LINEAR_____122_CM 1 100. 0. 31.9990234375 DISPLAY_IDENTIFIER FAC_VALUE_DIAG_DYN_LSL_UP[2] ECU_ADDRESS 0xd0001e3a FORMAT "%7.4" /end MEASUREMENT
/begin MEASUREMENT egcp[1].egcp_struct_sigdglsl2.fac_sum_diag_dyn_lsl_up "Summation over all normalized single sensor signal amplitude" UWORD _CNV_A_R_EGCP_LINEA_330_CM 1 100. 0. 63.999023 DISPLAY_IDENTIFIER FAC_SUM_DIAG_DYN_LSL_UP[2] ECU_ADDRESS 0xd0001e3c FORMAT "%7.4" /end MEASUREMENT
/begin MEASUREMENT egcp[1].egcp_struct_sigdglsl2.fac_mv_diag_dyn_lsl_up "Mean value of normalized single sensor signal amplitude" UWORD _CNV_A_R_LINEAR_____122_CM 1 100. 0. 31.9990234375 DISPLAY_IDENTIFIER FAC_MV_DIAG_DYN_LSL_UP[2] ECU_ADDRESS 0xd0001e3e FORMAT "%7.4" /end MEASUREMENT
/begin MEASUREMENT egcp[1].egcp_struct_sigdglsl2.fac_diag_dyn_lsl_up "Adaption factor to the modeled sensor time constant" UWORD _CNV_A_R_LINEAR_____122_CM 1 100. 0. 1. DISPLAY_IDENTIFIER FAC_DIAG_DYN_LSL_UP[2] ECU_ADDRESS 0xd0001e40 FORMAT "%6.4" /end MEASUREMENT
/begin MEASUREMENT egcp[1].egcp_struct_sigdglsl2.t_dyn_diag_afl "Timer for maximum amplitude measurement duration after LV_AFL 0 -> 1" UWORD _CNV_A_R_LINEAR_____107_CM 1 100. 0. 1310.7 DISPLAY_IDENTIFIER T_DYN_DIAG_AFL[2] ECU_ADDRESS 0xd0001e42 FORMAT "%7.2" /end MEASUREMENT
/begin MEASUREMENT egcp[1].egcp_struct_sigdglsl2.t_dyn_diag_afr "Timer for maximum amplitude measurement duration after LV_AFL 1 -> 0" UWORD _CNV_A_R_LINEAR_____107_CM 1 100. 0. 1310.7 DISPLAY_IDENTIFIER T_DYN_DIAG_AFR[2] ECU_ADDRESS 0xd0001e44 FORMAT "%7.2" /end MEASUREMENT
/begin MEASUREMENT egcp[1].egcp_struct_sigdglsl2.ctr_diag_plaus_lsl_up "Oxygen Sensor Plausibility Check Debounce counter" UBYTE _CNV_A_R_LINEAR_____0_CM 1 100. 0. 255. DISPLAY_IDENTIFIER CTR_DIAG_PLAUS_LSL_UP[2] ECU_ADDRESS 0xd0001e46 FORMAT "%3.0" /end MEASUREMENT
/begin MEASUREMENT egcp[1].egcp_struct_sigdglsl2.lamb_ampl_diag_dyn_lsl_up "Carried out single sensor signal amplitude measurement" UBYTE _CNV_A_R_EGCP_LINEA_363_CM 1 100. 0. 0.124023 DISPLAY_IDENTIFIER LAMB_AMPL_DIAG_DYN_LSL_UP[2] ECU_ADDRESS 0xd0001e47 FORMAT "%6.4" /end MEASUREMENT
/begin MEASUREMENT egcp[1].egcp_struct_sigdglsl2.lamb_ampl_min_diag_dyn_lsl_up "Minimun acceptable carried out single sensor signal amplitude measurement" UBYTE _CNV_A_R_EGCP_LINEA_363_CM 1 100. 0. 0.124023 DISPLAY_IDENTIFIER LAMB_AMPL_MIN_DIAG_DYN_LSL_UP[2] ECU_ADDRESS 0xd0001e48 FORMAT "%6.4" /end MEASUREMENT
/begin MEASUREMENT egcp[1].egcp_struct_sigdglsl2.lamb_ampl_max_diag_dyn_lsl_up "Maximun acceptable carried out single sensor signal amplitude measurement" UBYTE _CNV_A_R_EGCP_LINEA_363_CM 1 100. 0. 0.124023 DISPLAY_IDENTIFIER LAMB_AMPL_MAX_DIAG_DYN_LSL_UP[2] ECU_ADDRESS 0xd0001e49 FORMAT "%6.4" /end MEASUREMENT
/begin MEASUREMENT egcp[1].egcp_struct_sigdglsl2.lamb_ampl_mv_diag_dyn_lsl_up "Sensor signal amplitude mean value" UBYTE _CNV_A_R_EGCP_LINEA_363_CM 1 100. 0. 0.124023 DISPLAY_IDENTIFIER LAMB_AMPL_MV_DIAG_DYN_LSL_UP[2] ECU_ADDRESS 0xd0001e4a FORMAT "%6.4" /end MEASUREMENT
/begin MEASUREMENT egcp[1].egcp_struct_sigdglsl2.ctr_diag_dyn_lsl_up "Number of  carried out single valid amplitude measurements" UBYTE _CNV_A_R_LINEAR_____0_CM 1 100. 0. 255. DISPLAY_IDENTIFIER CTR_DIAG_DYN_LSL_UP[2] ECU_ADDRESS 0xd0001e4b FORMAT "%3.0" /end MEASUREMENT
/begin MEASUREMENT egcp[1].egcp_struct_sigdglsl2.ctr_wait_diag_dyn_lsl_up "Number of forced stimulation periods before carrying out amplitude measurements" UBYTE _CNV_A_R_LINEAR_____0_CM 1 100. 0. 255. DISPLAY_IDENTIFIER CTR_WAIT_DIAG_DYN_LSL_UP[2] ECU_ADDRESS 0xd0001e4c FORMAT "%3.0" /end MEASUREMENT
/begin MEASUREMENT egcp[1].egcp_struct_sigdglsl2.cycnr_diag_dyn_lsl_up "Number of cycles necessary to finish the diagnosis" UBYTE _CNV_A_R_LINEAR_____0_CM 1 100. 0. 255. DISPLAY_IDENTIFIER CYCNR_DIAG_DYN_LSL_UP[2] ECU_ADDRESS 0xd0001e4d FORMAT "%3.0" /end MEASUREMENT
/begin MEASUREMENT egcp[1].egcp_struct_sigdglsl2.ctr_sym_act_lsl_up "Debounce counter of the sensor non-activity symptom" UBYTE _CNV_A_R_LINEAR_____0_CM 1 100. 0. 255. DISPLAY_IDENTIFIER CTR_SYM_ACT_LSL_UP[2] ECU_ADDRESS 0xd0001e4e FORMAT "%3.0" /end MEASUREMENT
/begin MEASUREMENT egcp[1].egcp_struct_sigdglsl2.ctr_lamb_de_int_act_lsl_up "Counter of forced stimulation periods" UBYTE _CNV_A_R_LINEAR_____0_CM 1 100. 0. 255. DISPLAY_IDENTIFIER CTR_LAMB_DE_INT_ACT_LSL_UP[2] ECU_ADDRESS 0xd0001e4f FORMAT "%3.0" /end MEASUREMENT
/begin MEASUREMENT egcp[1].egcp_struct_sigdglsl2.state_sym_diag_plaus_lsl_up "Oxygen Sensor Plausibility Check Symptom " UBYTE _CNV_S_4_EGCP_RANGE_364_CM 1 100. 0. 4. DISPLAY_IDENTIFIER STATE_SYM_DIAG_PLAUS_LSL_UP[2] ECU_ADDRESS 0xd0001e50 /end MEASUREMENT
/begin MEASUREMENT egcp[1].egcp_struct_sigdglsl2.state_sym_diag_puc_lsl_up "Symptom of of the signal plausibility from the upstraem sensor during PUC" UBYTE _CNV_S_4_EGCP_RANGE_365_CM 1 100. 0. 3. DISPLAY_IDENTIFIER STATE_SYM_DIAG_PUC_LSL_UP[2] ECU_ADDRESS 0xd0001e51 /end MEASUREMENT
/begin MEASUREMENT egcp[1].egcp_struct_sigdglsl2.state_dyn_diag "State shows the condition of the forced stimulation " UBYTE _CNV_S_4_EGCP_RANGE_366_CM 1 100. 0. 3. DISPLAY_IDENTIFIER STATE_DYN_DIAG[2] ECU_ADDRESS 0xd0001e52 /end MEASUREMENT
/begin MEASUREMENT egcp[1].egcp_struct_sigdglsl2.lv_diag_plaus_sym_lsl_up "Debounced diagnosis result of the signal plausibility for the wide range A/F sensor" UBYTE _CNV_S_2_RANGE__0___1_CM 1 100. 0. 1. DISPLAY_IDENTIFIER LV_DIAG_PLAUS_SYM_LSL_UP[2] ECU_ADDRESS 0xd0001e53 BIT_MASK 0x1 /end MEASUREMENT
/begin MEASUREMENT egcp[1].egcp_struct_sigdglsl2.lv_diag_cdn_plaus_lsl_up "Diagnosis condition" UBYTE _CNV_S_2_RANGE__0___1_CM 1 100. 0. 1. DISPLAY_IDENTIFIER LV_DIAG_CDN_PLAUS_LSL_UP[2] ECU_ADDRESS 0xd0001e54 BIT_MASK 0x1 /end MEASUREMENT
/begin MEASUREMENT egcp[1].egcp_struct_sigdglsl2.lv_diag_plaus_end_lsl_up "Result of diagnosis exists" UBYTE _CNV_S_2_RANGE__0___1_CM 1 100. 0. 1. DISPLAY_IDENTIFIER LV_DIAG_PLAUS_END_LSL_UP[2] ECU_ADDRESS 0xd0001e55 BIT_MASK 0x1 /end MEASUREMENT
/begin MEASUREMENT egcp[1].egcp_struct_sigdglsl2.lv_diag_dyn_sym_lsl_up "Debounce diagnosis value of the sensor dynamics" UBYTE _CNV_S_2_RANGE__0___1_CM 1 100. 0. 1. DISPLAY_IDENTIFIER LV_DIAG_DYN_SYM_LSL_UP[2] ECU_ADDRESS 0xd0001e56 BIT_MASK 0x1 /end MEASUREMENT
/begin MEASUREMENT egcp[1].egcp_struct_sigdglsl2.lv_diag_dyn_end_lsl_up "Result of diagnosis exists" UBYTE _CNV_S_2_RANGE__0___1_CM 1 100. 0. 1. DISPLAY_IDENTIFIER LV_DIAG_DYN_END_LSL_UP[2] ECU_ADDRESS 0xd0001e57 BIT_MASK 0x1 /end MEASUREMENT
/begin MEASUREMENT egcp[1].egcp_struct_sigdglsl2.lv_diag_dyn_cdn_lsl_up "Diagnosis condition" UBYTE _CNV_S_2_RANGE__0___1_CM 1 100. 0. 1. DISPLAY_IDENTIFIER LV_DIAG_DYN_CDN_LSL_UP[2] ECU_ADDRESS 0xd0001e58 BIT_MASK 0x1 /end MEASUREMENT
/begin MEASUREMENT egcp[1].egcp_struct_sigdglsl2.lv_diag_puc_sym_lsl_up "Debounced diagnosis result of the signal plausibility from the upstream sensor during PUC" UBYTE _CNV_S_2_RANGE__0___1_CM 1 100. 0. 1. DISPLAY_IDENTIFIER LV_DIAG_PUC_SYM_LSL_UP[2] ECU_ADDRESS 0xd0001e59 BIT_MASK 0x1 /end MEASUREMENT
/begin MEASUREMENT egcp[1].egcp_struct_sigdglsl2.lv_diag_cdn_puc_lsl_up "Diagnosis condition" UBYTE _CNV_S_2_RANGE__0___1_CM 1 100. 0. 1. DISPLAY_IDENTIFIER LV_DIAG_CDN_PUC_LSL_UP[2] ECU_ADDRESS 0xd0001e5a BIT_MASK 0x1 /end MEASUREMENT
/begin MEASUREMENT egcp[1].egcp_struct_sigdglsl2.lv_diag_puc_end_lsl_up "Result of diagnosis exists" UBYTE _CNV_S_2_RANGE__0___1_CM 1 100. 0. 1. DISPLAY_IDENTIFIER LV_DIAG_PUC_END_LSL_UP[2] ECU_ADDRESS 0xd0001e5b BIT_MASK 0x1 /end MEASUREMENT
/begin MEASUREMENT egcp[1].egcp_struct_sigdglsl2.lv_lamb_pls_req_dyn_lsl_up "Request forced stimulation parameters specific for the WRAF sensor dynamic" UBYTE _CNV_S_2_RANGE__0___1_CM 1 100. 0. 1. DISPLAY_IDENTIFIER LV_LAMB_PLS_REQ_DYN_LSL_UP[2] ECU_ADDRESS 0xd0001e5c BIT_MASK 0x1 /end MEASUREMENT
/begin MEASUREMENT egcp[1].egcp_struct_sigdglsl2.lv_lam_adj_req_dyn_lsl_up "Request dynamic trim controller parameters specific for the WRAF sensor dynamic" UBYTE _CNV_S_2_RANGE__0___1_CM 1 100. 0. 1. DISPLAY_IDENTIFIER LV_LAM_ADJ_REQ_DYN_LSL_UP[2] ECU_ADDRESS 0xd0001e5d BIT_MASK 0x1 /end MEASUREMENT
/begin MEASUREMENT egcp[1].egcp_struct_sigdglsl2.lv_diag_afr_sym_plaus_lsl_up "Oxygen Sensor Plausibility Check - not debounced symptom \"SENS_AFR\"  " UBYTE _CNV_S_2_RANGE__0___1_CM 1 100. 0. 1. DISPLAY_IDENTIFIER LV_DIAG_AFR_SYM_PLAUS_LSL_UP[2] ECU_ADDRESS 0xd0001e5e BIT_MASK 0x1 /end MEASUREMENT
/begin MEASUREMENT egcp[1].egcp_struct_sigdglsl2.lv_diag_afl_sym_plaus_lsl_up "Oxygen Sensor Plausibility Check - not debounced symptom \"SENS_AFL\"" UBYTE _CNV_S_2_RANGE__0___1_CM 1 100. 0. 1. DISPLAY_IDENTIFIER LV_DIAG_AFL_SYM_PLAUS_LSL_UP[2] ECU_ADDRESS 0xd0001e5f BIT_MASK 0x1 /end MEASUREMENT
/begin MEASUREMENT egcp[1].egcp_struct_sigdglsl2.lv_diag_raw_act_sym_lsl_up "Boolean flag indicating a detected raw symptom of sensor non-activity (from first test)" UBYTE _CNV_S_2_RANGE__0___1_CM 1 100. 0. 1. DISPLAY_IDENTIFIER LV_DIAG_RAW_ACT_SYM_LSL_UP[2] ECU_ADDRESS 0xd0001e60 BIT_MASK 0x1 /end MEASUREMENT
/begin MEASUREMENT egcp[1].egcp_struct_sigdglsl2.lv_diag_act_sym_lsl_up "Boolean flag indicating a detected poor upstream sensor activity  (from second test)" UBYTE _CNV_S_2_RANGE__0___1_CM 1 100. 0. 1. DISPLAY_IDENTIFIER LV_DIAG_ACT_SYM_LSL_UP[2] ECU_ADDRESS 0xd0001e61 BIT_MASK 0x1 /end MEASUREMENT
/begin MEASUREMENT egcp[1].egcp_struct_sigdglsl2.lv_diag_act_cdn_lsl_up "Boolean flag indicating the conditions to activate the second test  for sensor non-activity are fulfilled" UBYTE _CNV_S_2_RANGE__0___1_CM 1 100. 0. 1. DISPLAY_IDENTIFIER LV_DIAG_ACT_CDN_LSL_UP[2] ECU_ADDRESS 0xd0001e62 BIT_MASK 0x1 /end MEASUREMENT
/begin MEASUREMENT egcp[1].egcp_struct_sigdglsl2.lv_diag_act_sho_cdn_lsl_up "Boolean flag indicating the short term conditions to activate the second test  for sensor non-activity are fulfilled" UBYTE _CNV_S_2_RANGE__0___1_CM 1 100. 0. 1. DISPLAY_IDENTIFIER LV_DIAG_ACT_SHO_CDN_LSL_UP[2] ECU_ADDRESS 0xd0001e63 BIT_MASK 0x1 /end MEASUREMENT
/begin MEASUREMENT egcp[1].egcp_struct_sigdglsli2.lv_inh_diag_rbm_air_lsl_up "Deactivation of Rate Based Monitoring of ¿Monitoring Upstream Sensor Signal  by malfunction" UBYTE _CNV_S_2_RANGE__0___1_CM 1 100. 0. 1. DISPLAY_IDENTIFIER LV_INH_DIAG_RBM_AIR_LSL_UP[2] ECU_ADDRESS 0xd0001e64 BIT_MASK 0x1 /end MEASUREMENT
/begin MEASUREMENT egcp[1].egcp_struct_sigdglsli2.lv_diag_plaus_inh_lsl_up "Deactivation of \"Plausibility check of the sensor signal\"" UBYTE _CNV_S_2_RANGE__0___1_CM 1 100. 0. 1. DISPLAY_IDENTIFIER LV_DIAG_PLAUS_INH_LSL_UP[2] ECU_ADDRESS 0xd0001e65 BIT_MASK 0x1 /end MEASUREMENT
/begin MEASUREMENT egcp[1].egcp_struct_sigdglsli2.lv_diag_dyn_inh_lsl_up "Deactivation of \"Diagnosis of the WRAF Sensor Dynamic\"" UBYTE _CNV_S_2_RANGE__0___1_CM 1 100. 0. 1. DISPLAY_IDENTIFIER LV_DIAG_DYN_INH_LSL_UP[2] ECU_ADDRESS 0xd0001e66 BIT_MASK 0x1 /end MEASUREMENT
/begin MEASUREMENT egcp[1].egcp_struct_sigdglsli2.lv_inh_diag_air_lsl_up "Deactivation of \"Monitoring Upstream Sensor Signal \"" UBYTE _CNV_S_2_RANGE__0___1_CM 1 100. 0. 1. DISPLAY_IDENTIFIER LV_INH_DIAG_AIR_LSL_UP[2] ECU_ADDRESS 0xd0001e67 BIT_MASK 0x1 /end MEASUREMENT
/begin MEASUREMENT egcp[1].egcp_struct_sigdglsli2.lv_inh_diag_puc_lsl_up "Deactivation of \"Monitoring Upstream Sensor Signal during PUC\"" UBYTE _CNV_S_2_RANGE__0___1_CM 1 100. 0. 1. DISPLAY_IDENTIFIER LV_INH_DIAG_PUC_LSL_UP[2] ECU_ADDRESS 0xd0001e68 BIT_MASK 0x1 /end MEASUREMENT
/begin MEASUREMENT egcp[1].egcp_struct_sigdglsli2.lv_diag_eol_dyn_ls_up "Status variable for activaton of lambda sensor diagnosis function via short trip" UBYTE _CNV_S_2_RANGE__0___1_CM 1 100. 0. 1. DISPLAY_IDENTIFIER LV_DIAG_EOL_DYN_LS_UP[2] ECU_ADDRESS 0xd0001e69 BIT_MASK 0x1 /end MEASUREMENT
/begin MEASUREMENT egcp[1].egcp_struct_sigdglsli2.lv_diag_eol_puc_lsl_up "Activation of short trip for Monitoring Upstream Sensor during PUC" UBYTE _CNV_S_2_RANGE__0___1_CM 1 100. 0. 1. DISPLAY_IDENTIFIER LV_DIAG_EOL_PUC_LSL_UP[2] ECU_ADDRESS 0xd0001e6a BIT_MASK 0x1 /end MEASUREMENT
/begin MEASUREMENT egcp[1].egcp_struct_sigdglsli2.lv_inh_diag_rbm_dyn_vld_ls_up "Inhibition of false start recognition  diagnosis" UBYTE _CNV_S_2_RANGE__0___1_CM 1 100. 0. 1. DISPLAY_IDENTIFIER LV_INH_DIAG_RBM_DYN_VLD_LS_UP[2] ECU_ADDRESS 0xd0001e6b BIT_MASK 0x1 /end MEASUREMENT
/begin MEASUREMENT egcp[1].egcp_struct_sigdglsli2.state_rbm_dyn_vld_ls_up "Interface of DYN_VLD_LS_UP[NC_CBK_EX_NR] monitor with the Rate-Based Monitoring statistics" UBYTE _CNV_A_R_LINEAR_____0_CM 1 100. 0. 7. DISPLAY_IDENTIFIER STATE_RBM_DYN_VLD_LS_UP[2] ECU_ADDRESS 0xd0001e6c FORMAT "%1.0" /end MEASUREMENT
/begin MEASUREMENT egcp[1].egcp_struct_sigdglsli2.state_rbm_air_lsl_up "Interface of DYN_VLD_LS_UP[NC_CBK_EX_NR] monitor with the Rate-Based Monitoring statistics" UBYTE _CNV_A_R_LINEAR_____0_CM 1 100. 0. 7. DISPLAY_IDENTIFIER STATE_RBM_AIR_LSL_UP[2] ECU_ADDRESS 0xd0001e6d FORMAT "%1.0" /end MEASUREMENT
/begin MEASUREMENT egcp[1].egcp_struct_sigdglsli2.lv_inh_diag_rbm_puc_lsl_up "Deactivation of Monitoring Upstream Sensor Signal during PUC by other failures" UBYTE _CNV_S_2_RANGE__0___1_CM 1 100. 0. 1. DISPLAY_IDENTIFIER LV_INH_DIAG_RBM_PUC_LSL_UP[2] ECU_ADDRESS 0xd0001e6e BIT_MASK 0x1 /end MEASUREMENT
/begin MEASUREMENT egcp[1].egcp_struct_sigdglsli2.lv_diag_eol_air_lsl_up "Deactivation of Monitoring Upstream Sensor Signal during PUC by other failures" UBYTE _CNV_S_2_RANGE__0___1_CM 1 100. 0. 1. DISPLAY_IDENTIFIER LV_DIAG_EOL_AIR_LSL_UP ECU_ADDRESS 0xd0001e6f BIT_MASK 0x1 /end MEASUREMENT
/begin MEASUREMENT egcp[1].egcp_struct_sigdglsli2.state_rbm_puc_vld_ls_up "Interface of PUC_VLD_LSL_UP[NC_CBK_EX_NR] monitor with the Rate-Based Monitoring statistics" UBYTE _CNV_A_R_LINEAR_____0_CM 1 100. 0. 255. DISPLAY_IDENTIFIER STATE_RBM_PUC_VLD_LS_UP[2] ECU_ADDRESS 0xd0001e70 FORMAT "%3.0" /end MEASUREMENT
/begin MEASUREMENT egcp[1].egcp_struct_pladglsli1.lv_diag_act_inh_ls_up_down "Inhibit sensor signal plausibility active test" UBYTE _CNV_S_2_RANGE__0___1_CM 1 100. 0. 1. DISPLAY_IDENTIFIER LV_DIAG_ACT_INH_LS_UP_DOWN[2] ECU_ADDRESS 0xd0001e72 BIT_MASK 0x1 /end MEASUREMENT
/begin MEASUREMENT egcp[1].egcp_struct_pladglsli1.lv_diag_afr_afl_inh_ls_up_down "Inhibit sensor signal plausibility active test under air-fuel rich conditons" UBYTE _CNV_S_2_RANGE__0___1_CM 1 100. 0. 1. DISPLAY_IDENTIFIER LV_DIAG_AFR_AFL_INH_LS_UP_DOWN[2] ECU_ADDRESS 0xd0001e73 BIT_MASK 0x1 /end MEASUREMENT
/begin MEASUREMENT egcp[1].egcp_struct_pladglsli1.lv_diag_eol_req_ls_up_down "Start EOL active test " UBYTE _CNV_S_2_RANGE__0___1_CM 1 100. 0. 1. DISPLAY_IDENTIFIER LV_DIAG_EOL_REQ_LS_UP_DOWN[2] ECU_ADDRESS 0xd0001e74 BIT_MASK 0x1 /end MEASUREMENT
/begin MEASUREMENT egcp[1].egcp_struct_sigdglsl3.lamb_delta_rise_lpf "Mean value for heater coupling (rising edge)" SWORD _CNV_A_R_LINEAR_____23_CM 1 100. -2. 1.99993896484375 DISPLAY_IDENTIFIER LAMB_DELTA_RISE_LPF[2] ECU_ADDRESS 0xd0001e78 FORMAT "%8.5" /end MEASUREMENT
/begin MEASUREMENT egcp[1].egcp_struct_sigdglsl3.lamb_delta_fall_lpf "Mean value for heater coupling (falling edge)" SWORD _CNV_A_R_LINEAR_____23_CM 1 100. -2. 1.99993896484375 DISPLAY_IDENTIFIER LAMB_DELTA_FALL_LPF[2] ECU_ADDRESS 0xd0001e7a FORMAT "%8.5" /end MEASUREMENT
/begin MEASUREMENT egcp[1].egcp_struct_sigdglsl3.lamb_syn_lshpwm_fall "Lambda value acquied after lshpwm signal falling edge" UWORD _CNV_A_R_LINEAR_____23_CM 1 100. 0. 1.99993896484375 DISPLAY_IDENTIFIER LAMB_SYN_LSHPWM_FALL[2] ECU_ADDRESS 0xd0001e7c FORMAT "%7.5" /end MEASUREMENT
/begin MEASUREMENT egcp[1].egcp_struct_sigdglsl3.lamb_syn_lshpwm_rise "Lambda value acquied after lshpwm signal rising edge" UWORD _CNV_A_R_LINEAR_____23_CM 1 100. 0. 1.99993896484375 DISPLAY_IDENTIFIER LAMB_SYN_LSHPWM_RISE[2] ECU_ADDRESS 0xd0001e7e FORMAT "%7.5" /end MEASUREMENT
/begin MEASUREMENT egcp[1].egcp_struct_sigdglsl3.lamb_delta_rise "Variation of lambda value before and after lshpwm signal rising edge" SWORD _CNV_A_R_LINEAR_____23_CM 1 100. -2. 1.99993896484375 DISPLAY_IDENTIFIER LAMB_DELTA_RISE[2] ECU_ADDRESS 0xd0001e80 FORMAT "%8.5" /end MEASUREMENT
/begin MEASUREMENT egcp[1].egcp_struct_sigdglsl3.lamb_delta_fall "Variation of lambda value before and after lshpwm signal falling edge" SWORD _CNV_A_R_LINEAR_____23_CM 1 100. -2. 1.99993896484375 DISPLAY_IDENTIFIER LAMB_DELTA_FALL[2] ECU_ADDRESS 0xd0001e82 FORMAT "%8.5" /end MEASUREMENT
/begin MEASUREMENT egcp[1].egcp_struct_sigdglsl3.ctr_sym_diag_lsh_lsl_up "Counter of forced stimulation periods with a present symptom" UBYTE _CNV_A_R_LINEAR_____0_CM 1 100. 0. 255. DISPLAY_IDENTIFIER CTR_SYM_DIAG_LSH_LSL_UP[2] ECU_ADDRESS 0xd0001e84 FORMAT "%3.0" /end MEASUREMENT
/begin MEASUREMENT egcp[1].egcp_struct_sigdglsl3.cycnr_diag_lsh_lsl_up "Counter of forced stimulation periods investigated" UBYTE _CNV_A_R_LINEAR_____0_CM 1 100. 0. 255. DISPLAY_IDENTIFIER CYCNR_DIAG_LSH_LSL_UP[2] ECU_ADDRESS 0xd0001e85 FORMAT "%3.0" /end MEASUREMENT
/begin MEASUREMENT egcp[1].egcp_struct_sigdglsl3.t_dly_trig_lsh_up "Time delay for acquisition of oxygen sensor signal and lambda model" UBYTE _CNV_A_R_EGCP_LINEA_367_CM 1 100. 0. 0.255 DISPLAY_IDENTIFIER T_DLY_TRIG_LSH_UP[2] ECU_ADDRESS 0xd0001e86 FORMAT "%5.3" /end MEASUREMENT
/begin MEASUREMENT egcp[1].egcp_struct_sigdglsli3.lv_inh_diag_lsh_lsl_up "Deactivation of \"Diagnosis of the Heater Coupling in the Sensor Signal\"" UBYTE _CNV_S_2_RANGE__0___1_CM 1 100. 0. 1. DISPLAY_IDENTIFIER LV_INH_DIAG_LSH_LSL_UP[2] ECU_ADDRESS 0xd0001e88 BIT_MASK 0x1 /end MEASUREMENT
/begin MEASUREMENT egcp[1].egcp_struct_sigdglsd3.vls_down_rgn_nt_end "Monitor sensor voltage at the time of leaving regeneration phase of NOx trap, Bank i (i=1.2)" UWORD _CNV_A_R_LINEAR_____2_CM 1 100. 0. 4.9951171875 DISPLAY_IDENTIFIER VLS_DOWN_RGN_NT_END[2] ECU_ADDRESS 0xd0001ed0 FORMAT "%5.3" /end MEASUREMENT
/begin MEASUREMENT egcp[1].egcp_struct_sigdglsd3.maf_int_rgn_nt_s_act "Mass air flow which has passed since activation of stratified mode" UWORD _CNV_A_R_LINEAR_____329_CM 1 100. 0. 2912.66666666667 DISPLAY_IDENTIFIER MAF_INT_RGN_NT_S_ACT[2] ECU_ADDRESS 0xd0001ed2 FORMAT "%7.2" /end MEASUREMENT
/begin MEASUREMENT egcp[1].egcp_struct_sigdglsd3.maf_int_rgn_nt_end "Mass air flow which has passed since last regeneration cycle" UWORD _CNV_A_R_LINEAR_____329_CM 1 100. 0. 2912.66666666667 DISPLAY_IDENTIFIER MAF_INT_RGN_NT_END[2] ECU_ADDRESS 0xd0001ed4 FORMAT "%7.2" /end MEASUREMENT
/begin MEASUREMENT egcp[1].egcp_struct_sigdglsd3.t_rgn_nt_end "Time which has passed after leaving last regeneration cycle" UWORD _CNV_A_R_LINEAR_____107_CM 1 100. 0. 1310.7 DISPLAY_IDENTIFIER T_RGN_NT_END[2] ECU_ADDRESS 0xd0001ed6 FORMAT "%7.2" /end MEASUREMENT
/begin MEASUREMENT egcp[1].egcp_struct_sigdglsd3.ctr_sym_diag_rgn_nt_ls_down "Counter for internal anti-bounce of error symptom" UWORD _CNV_A_R_LINEAR_____0_CM 1 100. 0. 65535. DISPLAY_IDENTIFIER CTR_SYM_DIAG_RGN_NT_LS_DOWN[2] ECU_ADDRESS 0xd0001ed8 FORMAT "%5.0" /end MEASUREMENT
/begin MEASUREMENT egcp[1].egcp_struct_sigdglsd3.vls_down_rgn_nt_dif "Measured Voltage difference used for error detection" SWORD _CNV_A_R_LINEAR_____369_CM 1 100. -5.00000000000182 4.99511718999747 DISPLAY_IDENTIFIER VLS_DOWN_RGN_NT_DIF[2] ECU_ADDRESS 0xd0001eda /end MEASUREMENT
/begin MEASUREMENT egcp[1].egcp_struct_sigdglsd3.ctr_end_diag_rgn_nt_ls_down "Counter for end bit calculation" UBYTE _CNV_A_R_LINEAR_____0_CM 1 100. 0. 255. DISPLAY_IDENTIFIER CTR_END_DIAG_RGN_NT_LS_DOWN[2] ECU_ADDRESS 0xd0001edc FORMAT "%3.0" /end MEASUREMENT
/begin MEASUREMENT egcp[1].egcp_struct_sigdglsd3.lv_diag_act_rgn_nt_ls_down "Logical variable indicating that diagnosis conditions are fulfilled" UBYTE _CNV_S_2_RANGE__0___1_CM 1 100. 0. 1. DISPLAY_IDENTIFIER LV_DIAG_ACT_RGN_NT_LS_DOWN[2] ECU_ADDRESS 0xd0001edd BIT_MASK 0x1 /end MEASUREMENT
/begin MEASUREMENT egcp[1].egcp_struct_sigdglsdi3.lv_inh_diag_rgn_nt_ls_down "Logical variable indicating inhibition of downstream oxygen sensor diagnosis after NOx cat regeneration" UBYTE _CNV_S_2_RANGE__0___1_CM 1 100. 0. 1. DISPLAY_IDENTIFIER LV_INH_DIAG_RGN_NT_LS_DOWN[2] ECU_ADDRESS 0xd0001ede BIT_MASK 0x1 /end MEASUREMENT
/begin CHARACTERISTIC c_tco_cur_on_ls_down_min "TCO-threshold for detection of R_IT_LS_DOWN" VALUE 0xa1002216 _REC_VAL_20_u1 190.5 _CNV_A_R_LINEAR_____16_CM -48. 142.5 DISPLAY_IDENTIFIER C_TCO_CUR_ON_LS_DOWN_MIN FORMAT "%5.1" /end CHARACTERISTIC
/begin CHARACTERISTIC c_tco_min_diag_rgn_nt_ls_down "Minimum coolant temperature for activation of RGN_NT_LS_DOWN[i] diagnosis" VALUE 0xa1002219 _REC_VAL_20_u1 190.5 _CNV_A_R_LINEAR_____16_CM -48. 142.5 DISPLAY_IDENTIFIER C_TCO_MIN_DIAG_RGN_NT_LS_DOWN FORMAT "%6.2" /end CHARACTERISTIC
/begin CHARACTERISTIC c_maf_min_diag_rgn_nt_ls_down "Minimum mass air flow for activation of RGN_NT_LS_DOWN[i] diagnosis" VALUE 0xa1002152 _REC_VAL_20_u2 2047.96875 _CNV_A_R_LINEAR_____207_CM 0. 2047.96875 DISPLAY_IDENTIFIER C_MAF_MIN_DIAG_RGN_NT_LS_DOWN FORMAT "%10.5" /end CHARACTERISTIC
/begin CHARACTERISTIC c_maf_max_diag_rgn_nt_ls_down "Maximum mass air flow for activation of RGN_NT_LS_DOWN[i] diagnosis" VALUE 0xa100214e _REC_VAL_20_u2 2047.96875 _CNV_A_R_LINEAR_____207_CM 0. 2047.96875 DISPLAY_IDENTIFIER C_MAF_MAX_DIAG_RGN_NT_LS_DOWN FORMAT "%10.5" /end CHARACTERISTIC
/begin CHARACTERISTIC c_temp_min_diag_rgn_nt_ls_down "Catalyst temperature threshold for activation of RGN_NT_LS_DOWN[i] diagnosis" VALUE 0xa1002238 _REC_VAL_20_u2 2047.9375 _CNV_A_R_LINEAR_____204_CM -273.15 1774.7875 DISPLAY_IDENTIFIER C_TEMP_MIN_DIAG_RGN_NT_LS_DOWN FORMAT "%9.4" /end CHARACTERISTIC
/begin CHARACTERISTIC lc_state_rgn_l_ampl_deac "Logical calibration data to skip check of STATE_RGN[i] depending on regeneration strategy" VALUE 0xa1002314 _REC_VAL_20_u1 1. _CNV_A_R_LINEAR_____0_CM 0. 1. DISPLAY_IDENTIFIER LC_STATE_RGN_L_AMPL_DEAC FORMAT "%1.0" /end CHARACTERISTIC
/begin CHARACTERISTIC c_vls_down_rgn_nt_dif_min "Measured Voltage difference used for error detection" VALUE 0xa10022a2 _REC_VAL_20_u2 4.9951171875 _CNV_A_R_LINEAR_____2_CM 0. 4.9951171875 DISPLAY_IDENTIFIER C_VLS_DOWN_RGN_NT_DIF_MIN FORMAT "%5.3" /end CHARACTERISTIC
/begin CHARACTERISTIC c_vls_min_diag_rgn_ls_down "Minimum voltage during regeneration phase to enable diagnosis" VALUE 0xa10022ac _REC_VAL_20_u2 4.9951171875 _CNV_A_R_LINEAR_____2_CM 0. 4.9951171875 DISPLAY_IDENTIFIER C_VLS_MIN_DIAG_RGN_LS_DOWN FORMAT "%5.3" /end CHARACTERISTIC
/begin CHARACTERISTIC c_maf_int_rgn_nt_s_act "Mass air flow which has passed since activation of stratified mode" VALUE 0xa1002136 _REC_VAL_20_u2 2912.666666666671 _CNV_A_R_LINEAR_____329_CM 0. 2912.66666666667 DISPLAY_IDENTIFIER C_MAF_INT_RGN_NT_S_ACT FORMAT "%7.2" /end CHARACTERISTIC
/begin CHARACTERISTIC c_maf_int_rgn_nt_end "Mass air flow which has passed since last regeneration cycle" VALUE 0xa1002134 _REC_VAL_20_u2 2912.666666666671 _CNV_A_R_LINEAR_____329_CM 0. 2912.66666666667 DISPLAY_IDENTIFIER C_MAF_INT_RGN_NT_END FORMAT "%7.2" /end CHARACTERISTIC
/begin CHARACTERISTIC c_t_rgn_nt_end "Threshold for time which has passed after leaving last regeneration cycle" VALUE 0xa10021f0 _REC_VAL_20_u2 1310.7 _CNV_A_R_LINEAR_____107_CM 0. 1310.7 DISPLAY_IDENTIFIER C_T_RGN_NT_END FORMAT "%7.2" /end CHARACTERISTIC
/begin CHARACTERISTIC c_ctr_sym_max_rgn_nt_ls_down "Threshold for setting of LV_ERR_RGN_NT_LS_DOWN[i]" VALUE 0xa1002070 _REC_VAL_20_u2 65535. _CNV_A_R_LINEAR_____0_CM 0. 65535. DISPLAY_IDENTIFIER C_CTR_SYM_MAX_RGN_NT_LS_DOWN FORMAT "%5.0" /end CHARACTERISTIC
/begin CHARACTERISTIC c_ctr_inc_diag_rgn_nt_ls_down "Counter increment for present error symptom" VALUE 0xa1002053 _REC_VAL_20_u1 255. _CNV_A_R_LINEAR_____0_CM 0. 255. DISPLAY_IDENTIFIER C_CTR_INC_DIAG_RGN_NT_LS_DOWN FORMAT "%3.0" /end CHARACTERISTIC
/begin CHARACTERISTIC c_ctr_end_diag_rgn_nt_ls_down "Counter threshold for setting of diagnosis end bit" VALUE 0xa100204c _REC_VAL_20_u1 255. _CNV_A_R_LINEAR_____0_CM 0. 255. DISPLAY_IDENTIFIER C_CTR_END_DIAG_RGN_NT_LS_DOWN FORMAT "%3.0" /end CHARACTERISTIC
/begin MEASUREMENT lv_err_rgn_nt_ls_down_1 "Debounced diagnosis result for monitoring lean to rich switching times after Nox cat regeneration" UBYTE _CNV_S_2_RANGE__0___1_CM 1 100. 0. 1. DISPLAY_IDENTIFIER LV_ERR_RGN_NT_LS_DOWN[1] ECU_ADDRESS 0xd00034a9 BIT_MASK 0x1 /end MEASUREMENT
/begin MEASUREMENT lv_err_rgn_nt_ls_down_2 "Debounced diagnosis result for monitoring lean to rich switching times after Nox cat regeneration" UBYTE _CNV_S_2_RANGE__0___1_CM 1 100. 0. 1. DISPLAY_IDENTIFIER LV_ERR_RGN_NT_LS_DOWN[2] ECU_ADDRESS 0xd00034c2 BIT_MASK 0x1 /end MEASUREMENT
/begin CHARACTERISTIC c_maf_kgh_max_diag_plaus_lsl_up "Maximum mass air flow to carry out the plausibility" VALUE 0xa100213e _REC_VAL_20_u2 2047.96875 _CNV_A_R_LINEAR_____207_CM 0. 2047.96875 DISPLAY_IDENTIFIER C_MAF_KGH_MAX_DIAG_PLAUS_LSL_UP FORMAT "%10.5" /end CHARACTERISTIC
/begin CHARACTERISTIC c_vls_down_afl_plaus_lsl_up "Lean-mixture threshold of the downstream sensor voltage" VALUE 0xa1002282 _REC_VAL_20_u2 4.9951171875 _CNV_A_R_LINEAR_____2_CM 0. 4.9951171875 DISPLAY_IDENTIFIER C_VLS_DOWN_AFL_PLAUS_LSL_UP FORMAT "%5.3" /end CHARACTERISTIC
/begin CHARACTERISTIC c_vls_down_afr_plaus_lsl_up "Rich-mixture threshold of the downstream sensor voltage" VALUE 0xa1002286 _REC_VAL_20_u2 4.9951171875 _CNV_A_R_LINEAR_____2_CM 0. 4.9951171875 DISPLAY_IDENTIFIER C_VLS_DOWN_AFR_PLAUS_LSL_UP FORMAT "%5.3" /end CHARACTERISTIC
/begin CHARACTERISTIC c_tco_min_diag_plaus_lsl_up "Minimum threshold of the cooling-water temperature to activate the function" VALUE 0xa1002218 _REC_VAL_20_u1 190.5 _CNV_A_R_LINEAR_____16_CM -48. 142.5 DISPLAY_IDENTIFIER C_TCO_MIN_DIAG_PLAUS_LSL_UP FORMAT "%6.2" /end CHARACTERISTIC
/begin CHARACTERISTIC c_ctr_dec_diag_plaus_lsl_up "Second anti-bounce filter: counter decrement" VALUE 0xa1002048 _REC_VAL_20_u1 255. _CNV_A_R_LINEAR_____0_CM 0. 255. DISPLAY_IDENTIFIER C_CTR_DEC_DIAG_PLAUS_LSL_UP FORMAT "%3.0" /end CHARACTERISTIC
/begin CHARACTERISTIC c_ctr_thd_diag_plaus_lsl_up "Second anti-bounce filter: max. counter threshold" VALUE 0xa1002072 _REC_VAL_20_u1 255. _CNV_A_R_LINEAR_____0_CM 0. 255. DISPLAY_IDENTIFIER C_CTR_THD_DIAG_PLAUS_LSL_UP FORMAT "%3.0" /end CHARACTERISTIC
/begin CHARACTERISTIC c_t_sym_diag_air_lsl_up "Time filter to detect a symptom" VALUE 0xa1002202 _REC_VAL_20_u2 6553.5 _CNV_A_R_LINEAR_____4_CM 0. 6553.5 DISPLAY_IDENTIFIER C_T_SYM_DIAG_AIR_LSL_UP FORMAT "%6.1" /end CHARACTERISTIC
/begin CHARACTERISTIC c_t_end_diag_air_lsl_up "Time to have a diagnostic available" VALUE 0xa10021c6 _REC_VAL_20_u2 6553.5 _CNV_A_R_LINEAR_____4_CM 0. 6553.5 DISPLAY_IDENTIFIER C_T_END_DIAG_AIR_LSL_UP FORMAT "%6.1" /end CHARACTERISTIC
/begin MEASUREMENT lv_err_air_lsl_up_2 "Debounced diagnosis result of upstream sensor signal monitoring" UBYTE _CNV_S_2_RANGE__0___1_CM 1 100. 0. 1. DISPLAY_IDENTIFIER LV_ERR_AIR_LSL_UP[2] ECU_ADDRESS 0xd00034b6 BIT_MASK 0x1 /end MEASUREMENT
/begin MEASUREMENT lv_err_air_lsl_up_1 "Debounced diagnosis result of upstream sensor signal monitoring" UBYTE _CNV_S_2_RANGE__0___1_CM 1 100. 0. 1. DISPLAY_IDENTIFIER LV_ERR_AIR_LSL_UP[1] ECU_ADDRESS 0xd000349d BIT_MASK 0x1 /end MEASUREMENT
/begin CHARACTERISTIC c_ctr_min_diag_dyn_lsl_up "Number of  forced stimulation periods needed to calculate the short term mean value" VALUE 0xa100205e _REC_VAL_20_u1 255. _CNV_A_R_LINEAR_____0_CM 0. 255. DISPLAY_IDENTIFIER C_CTR_MIN_DIAG_DYN_LSL_UP FORMAT "%3.0" /end CHARACTERISTIC
/begin CHARACTERISTIC c_ctr_min_diag_eol_dyn_lsl_up "Number of  forced stimulation periods needed to calculate the short term mean value (EOL test)" VALUE 0xa100205f _REC_VAL_20_u1 255. _CNV_A_R_LINEAR_____0_CM 0. 255. DISPLAY_IDENTIFIER C_CTR_MIN_DIAG_EOL_DYN_LSL_UP FORMAT "%3.0" /end CHARACTERISTIC
/begin CHARACTERISTIC c_ctr_wait_diag_dyn_lsl_up "Number of  forced stimulation cycles to wait until begin calculation of sensor signal amplitude" VALUE 0xa1002073 _REC_VAL_20_u1 255. _CNV_A_R_LINEAR_____0_CM 0. 255. DISPLAY_IDENTIFIER C_CTR_WAIT_DIAG_DYN_LSL_UP FORMAT "%3.0" /end CHARACTERISTIC
/begin CHARACTERISTIC c_lamb_min_diag_dyn_lsl_up "Lowest allowed sensor signal min value" VALUE 0xa10020ec _REC_VAL_20_u2 31.9990234375 _CNV_A_R_LINEAR_____122_CM 0. 31.9990234375 DISPLAY_IDENTIFIER C_LAMB_MIN_DIAG_DYN_LSL_UP FORMAT "%7.4" /end CHARACTERISTIC
/begin CHARACTERISTIC c_lamb_max_diag_dyn_lsl_up "Highest allowed sensor signal max value" VALUE 0xa10020e8 _REC_VAL_20_u2 31.9990234375 _CNV_A_R_LINEAR_____122_CM 0. 31.9990234375 DISPLAY_IDENTIFIER C_LAMB_MAX_DIAG_DYN_LSL_UP FORMAT "%7.4" /end CHARACTERISTIC
/begin CHARACTERISTIC lc_t1_ad_diag_dyn_lsl_up "Boolean switch to allow the adaptation of the sensor time constant model T1_LSL_UP[i]" VALUE 0xa1002315 _REC_VAL_20_u1 1. _CNV_A_R_LINEAR_____0_CM 0. 1. DISPLAY_IDENTIFIER LC_T1_AD_DIAG_DYN_LSL_UP FORMAT "%1.0" /end CHARACTERISTIC
/begin CHARACTERISTIC c_lamb_ampl_max_dyn_lsl_up "Calibration data for adjust the expected amplitude:  high range" VALUE 0xa10020d0 _REC_VAL_20_u1 0.124023 _CNV_A_R_EGCP_LINEA_363_CM 0. 0.124023 DISPLAY_IDENTIFIER C_LAMB_AMPL_MAX_DYN_LSL_UP FORMAT "%6.4" /end CHARACTERISTIC
/begin CHARACTERISTIC c_lamb_ampl_min_dyn_lsl_up "Calibration data for adjust the expected amplitude:  low range" VALUE 0xa10020d1 _REC_VAL_20_u1 0.124023 _CNV_A_R_EGCP_LINEA_363_CM 0. 0.124023 DISPLAY_IDENTIFIER C_LAMB_AMPL_MIN_DYN_LSL_UP FORMAT "%6.4" /end CHARACTERISTIC
/begin CHARACTERISTIC ip_lamb_ampl_max_dyn_lsl_up "Nominal sensor expected amplitude during the Dynamic Diagnosis" MAP 0xa1001d14 _REC_MAP_20_u1_u1_u1 0.124023 _CNV_A_R_EGCP_LINEA_363_CM 0. 0.124023 DISPLAY_IDENTIFIER IP_LAMB_AMPL_MAX_DYN_LSL_UP FORMAT "%6.4"
 /begin AXIS_DESCR COM_AXIS n_32 _CNV_A_R_LINEAR_____9_CM 8 0. 8160. FORMAT "%4.0" AXIS_PTS_REF ldpm_n_32_ls_up_dyn /end AXIS_DESCR
 /begin AXIS_DESCR COM_AXIS NO_INPUT_QUANTITY _CNV_A_R_LINEAR_____14_CM 8 0. 1389. FORMAT "%4.0" AXIS_PTS_REF ldpm_maf_hb_ls_up_dyn /end AXIS_DESCR
/end CHARACTERISTIC
/begin CHARACTERISTIC ip_lamb_ampl_min_dyn_lsl_up "Limit sensor expected amplitude during the Dynamic Diagnosis" MAP 0xa1001d54 _REC_MAP_20_u1_u1_u1 0.124023 _CNV_A_R_EGCP_LINEA_363_CM 0. 0.124023 DISPLAY_IDENTIFIER IP_LAMB_AMPL_MIN_DYN_LSL_UP FORMAT "%6.4"
 /begin AXIS_DESCR COM_AXIS n_32 _CNV_A_R_LINEAR_____9_CM 8 0. 8160. FORMAT "%4.0" AXIS_PTS_REF ldpm_n_32_ls_up_dyn /end AXIS_DESCR
 /begin AXIS_DESCR COM_AXIS NO_INPUT_QUANTITY _CNV_A_R_LINEAR_____14_CM 8 0. 1389. FORMAT "%4.0" AXIS_PTS_REF ldpm_maf_hb_ls_up_dyn /end AXIS_DESCR
/end CHARACTERISTIC
/begin MEASUREMENT ctr_min_diag_dyn_lsl_up "Minimum number of  carried out single valid amplitude measurements" UBYTE _CNV_A_R_LINEAR_____0_CM 1 100. 0. 255. DISPLAY_IDENTIFIER CTR_MIN_DIAG_DYN_LSL_UP ECU_ADDRESS 0xc0001964 FORMAT "%3.0" /end MEASUREMENT
/begin CHARACTERISTIC c_vls_down_afs_max_plaus_lsl_up "Maximum voltage of the oxygen sensor to carry out the plausibility" VALUE 0xa100228a _REC_VAL_20_u2 4.9951171875 _CNV_A_R_LINEAR_____2_CM 0. 4.9951171875 DISPLAY_IDENTIFIER C_VLS_DOWN_AFS_MAX_PLAUS_LSL_UP FORMAT "%5.3" /end CHARACTERISTIC
/begin CHARACTERISTIC c_n_min_diag_plaus_lsl_up "Lower engine speed admitted to carry out the plausibility" VALUE 0xa1002163 _REC_VAL_20_u1 8160. _CNV_A_R_LINEAR_____9_CM 0. 8160. DISPLAY_IDENTIFIER C_N_MIN_DIAG_PLAUS_LSL_UP FORMAT "%4.0" /end CHARACTERISTIC
/begin CHARACTERISTIC c_lamb_afr_plaus_lsl_up "Rich-mixture threshold of the upstream sensor voltage" VALUE 0xa10020cc _REC_VAL_20_u2 31.9990234375 _CNV_A_R_LINEAR_____122_CM 0. 31.9990234375 DISPLAY_IDENTIFIER C_LAMB_AFR_PLAUS_LSL_UP FORMAT "%7.4" /end CHARACTERISTIC
/begin CHARACTERISTIC c_vls_down_afs_min_plaus_lsl_up "Minimum voltage of the oxygen sensor to carry out the plausibility" VALUE 0xa100228c _REC_VAL_20_u2 4.9951171875 _CNV_A_R_LINEAR_____2_CM 0. 4.9951171875 DISPLAY_IDENTIFIER C_VLS_DOWN_AFS_MIN_PLAUS_LSL_UP FORMAT "%5.3" /end CHARACTERISTIC
/begin CHARACTERISTIC c_vls_up_afs_min_plaus_lsl_up "Lower limit of upstream sensor signal window to detect the sensor non-activity" VALUE 0xa10022c0 _REC_VAL_20_s2 319.9951171875 _CNV_A_R_LINEAR_____2_CM -160. 159.9951171875 DISPLAY_IDENTIFIER C_VLS_UP_AFS_MIN_PLAUS_LSL_UP FORMAT "%8.3" /end CHARACTERISTIC
/begin CHARACTERISTIC c_vls_up_afs_max_plaus_lsl_up "Upper limit of upstream sensor signal window to detect the sensor non-activity" VALUE 0xa10022be _REC_VAL_20_s2 319.9951171875 _CNV_A_R_LINEAR_____2_CM -160. 159.9951171875 DISPLAY_IDENTIFIER C_VLS_UP_AFS_MAX_PLAUS_LSL_UP FORMAT "%8.3" /end CHARACTERISTIC
/begin CHARACTERISTIC c_t_diag_plaus_end_lsl_up "Time to have a diagnostic available" VALUE 0xa1002194 _REC_VAL_20_u2 6553.5 _CNV_A_R_LINEAR_____4_CM 0. 6553.5 DISPLAY_IDENTIFIER C_T_DIAG_PLAUS_END_LSL_UP FORMAT "%6.1" /end CHARACTERISTIC
/begin CHARACTERISTIC ip_t_sym_afr_afl_plaus_lsl_up "First anti-bounce filter: Time to debounce a plausibility error (compensation of the catalyst delay)" CURVE 0xa1001f7c _REC_CUR_20_u2_u2 6553.5 _CNV_A_R_LINEAR_____4_CM 0. 6553.5 DISPLAY_IDENTIFIER IP_T_SYM_AFR_AFL_PLAUS_LSL_UP FORMAT "%6.1"
 /begin AXIS_DESCR COM_AXIS maf_kgh _CNV_A_R_LINEAR_____207_CM 4 0. 2047.96875 FORMAT "%10.5" AXIS_PTS_REF ldpm_maf_kgh_ip_t_diag_lsl_up /end AXIS_DESCR
/end CHARACTERISTIC
/begin CHARACTERISTIC ip_t_sym_afs_plaus_lsl_up "First anti-bounce filter: Time to debounce a plausibility error (compensation of the catalyst delay)" CURVE 0xa1001f84 _REC_CUR_20_u2_u2 6553.5 _CNV_A_R_LINEAR_____4_CM 0. 6553.5 DISPLAY_IDENTIFIER IP_T_SYM_AFS_PLAUS_LSL_UP FORMAT "%6.1"
 /begin AXIS_DESCR COM_AXIS maf_kgh _CNV_A_R_LINEAR_____207_CM 4 0. 2047.96875 FORMAT "%10.5" AXIS_PTS_REF ldpm_maf_kgh_ip_t_diag_lsl_up /end AXIS_DESCR
/end CHARACTERISTIC
/begin CHARACTERISTIC c_cycnr_min_diag_dyn_lsl_up "Minimum number of short term mean values to calculate the long term mean value" VALUE 0xa1002077 _REC_VAL_20_u1 255. _CNV_A_R_LINEAR_____0_CM 0. 255. DISPLAY_IDENTIFIER C_CYCNR_MIN_DIAG_DYN_LSL_UP FORMAT "%3.0" /end CHARACTERISTIC
/begin CHARACTERISTIC c_cycnr_end_diag_dyn_lsl_up "Number of long term mean values to deliver the sensor dynamic diagnostic" VALUE 0xa1002074 _REC_VAL_20_u1 255. _CNV_A_R_LINEAR_____0_CM 0. 255. DISPLAY_IDENTIFIER C_CYCNR_END_DIAG_DYN_LSL_UP FORMAT "%3.0" /end CHARACTERISTIC
/begin CHARACTERISTIC c_cycnr_eol_diag_dyn_lsl_up "Number of long term mean values to deliver the sensor dynamic diagnostic (EOL test)" VALUE 0xa1002075 _REC_VAL_20_u1 255. _CNV_A_R_LINEAR_____0_CM 0. 255. DISPLAY_IDENTIFIER C_CYCNR_EOL_DIAG_DYN_LSL_UP FORMAT "%3.0" /end CHARACTERISTIC
/begin CHARACTERISTIC c_n_max_diag_dyn_lsl_up "Maximum engine speed to activate the diagnosis" VALUE 0xa1002160 _REC_VAL_20_u1 8160. _CNV_A_R_LINEAR_____9_CM 0. 8160. DISPLAY_IDENTIFIER C_N_MAX_DIAG_DYN_LSL_UP FORMAT "%4.0" /end CHARACTERISTIC
/begin CHARACTERISTIC c_maf_max_diag_dyn_lsl_up "Maximum mass airflow rate to activate the diagnosis function" VALUE 0xa100214c _REC_VAL_20_u2 1389. _CNV_A_R_LINEAR_____108_CM 0. 1389. DISPLAY_IDENTIFIER C_MAF_MAX_DIAG_DYN_LSL_UP FORMAT "%7.2" /end CHARACTERISTIC
/begin CHARACTERISTIC c_maf_min_diag_dyn_lsl_up "Minimum mass airflow rate to activate the diagnosis function" VALUE 0xa1002150 _REC_VAL_20_u2 1389. _CNV_A_R_LINEAR_____108_CM 0. 1389. DISPLAY_IDENTIFIER C_MAF_MIN_DIAG_DYN_LSL_UP FORMAT "%7.2" /end CHARACTERISTIC
/begin CHARACTERISTIC c_fac_mv_thd_diag_dyn_lsl_up "Limited diagnosis value for the error diagnosis" VALUE 0xa100209a _REC_VAL_20_u2 31.9990234375 _CNV_A_R_LINEAR_____122_CM 0. 31.9990234375 DISPLAY_IDENTIFIER C_FAC_MV_THD_DIAG_DYN_LSL_UP FORMAT "%7.4" /end CHARACTERISTIC
/begin CHARACTERISTIC c_fac_ad_thd_diag_dyn_lsl_up "Diagnosis value threshold for begin adaptation of sensor time constant model" VALUE 0xa100207a _REC_VAL_20_u2 31.9990234375 _CNV_A_R_LINEAR_____122_CM 0. 31.9990234375 DISPLAY_IDENTIFIER C_FAC_AD_THD_DIAG_DYN_LSL_UP FORMAT "%7.4" /end CHARACTERISTIC
/begin CHARACTERISTIC c_crlc_lpf_fac_ad_dyn_lsl_up "Correlation factor for low pass filtered (sensor time constant) adaptation factor" VALUE 0xa1002035 _REC_VAL_20_u1 0.99609375 _CNV_A_R_LINEAR_____27_CM 0. 0.99609375 DISPLAY_IDENTIFIER C_CRLC_LPF_FAC_AD_DYN_LSL_UP FORMAT "%5.3" /end CHARACTERISTIC
/begin CHARACTERISTIC c_t_diag_sym_puc_lsl_up "Time filter to detect a symptom" VALUE 0xa1002198 _REC_VAL_20_u2 6553.5 _CNV_A_R_LINEAR_____4_CM 0. 6553.5 DISPLAY_IDENTIFIER C_T_DIAG_SYM_PUC_LSL_UP FORMAT "%6.1" /end CHARACTERISTIC
/begin CHARACTERISTIC c_t_diag_sym_eol_puc_lsl_up "Time filter to detect a symptom (EOL test)" VALUE 0xa1002196 _REC_VAL_20_u2 6553.5 _CNV_A_R_LINEAR_____4_CM 0. 6553.5 DISPLAY_IDENTIFIER C_T_DIAG_SYM_EOL_PUC_LSL_UP FORMAT "%6.1" /end CHARACTERISTIC
/begin CHARACTERISTIC c_t_dly_diag_puc_lsl_up "Waiting time after beginning of PUC to test sensor signal " VALUE 0xa10021a4 _REC_VAL_20_u2 6553.5 _CNV_A_R_LINEAR_____4_CM 0. 6553.5 DISPLAY_IDENTIFIER C_T_DLY_DIAG_PUC_LSL_UP FORMAT "%6.1" /end CHARACTERISTIC
/begin CHARACTERISTIC c_t_dly_diag_eol_puc_lsl_up "Waiting time after beginning of PUC to test sensor signal (EOL test)" VALUE 0xa10021a0 _REC_VAL_20_u2 6553.5 _CNV_A_R_LINEAR_____4_CM 0. 6553.5 DISPLAY_IDENTIFIER C_T_DLY_DIAG_EOL_PUC_LSL_UP FORMAT "%6.1" /end CHARACTERISTIC
/begin CHARACTERISTIC c_t_diag_end_puc_lsl_up "Time to have a diagnostic available" VALUE 0xa100218a _REC_VAL_20_u2 6553.5 _CNV_A_R_LINEAR_____4_CM 0. 6553.5 DISPLAY_IDENTIFIER C_T_DIAG_END_PUC_LSL_UP FORMAT "%6.1" /end CHARACTERISTIC
/begin CHARACTERISTIC c_lamb_min_raw_act_lsl_up "Lower limit of lambda window to detect the upstream sensor activity" VALUE 0xa10020ee _REC_VAL_20_u2 63.999023 _CNV_A_R_EGCP_LINEA_330_CM 0. 63.999023 DISPLAY_IDENTIFIER C_LAMB_MIN_RAW_ACT_LSL_UP FORMAT "%7.4" /end CHARACTERISTIC
/begin CHARACTERISTIC c_lamb_max_raw_act_lsl_up "Upper limit of lambda window to detect the upstream sensor activity" VALUE 0xa10020ea _REC_VAL_20_u2 63.999023 _CNV_A_R_EGCP_LINEA_330_CM 0. 63.999023 DISPLAY_IDENTIFIER C_LAMB_MAX_RAW_ACT_LSL_UP FORMAT "%7.4" /end CHARACTERISTIC
/begin CHARACTERISTIC c_ctr_sum_raw_act_lsl_up "Counter threshold to set the raw symptom of sensor non-activity" VALUE 0xa1002062 _REC_VAL_20_u2 65535. _CNV_A_R_LINEAR_____0_CM 0. 65535. DISPLAY_IDENTIFIER C_CTR_SUM_RAW_ACT_LSL_UP FORMAT "%5.0" /end CHARACTERISTIC
/begin CHARACTERISTIC c_fac_dyn_int_act_lsl_up "Relative sensor signal damping admitted to monitor the sensor activity" VALUE 0xa100207e _REC_VAL_20_u2 31.9990234375 _CNV_A_R_LINEAR_____122_CM 0. 31.9990234375 DISPLAY_IDENTIFIER C_FAC_DYN_INT_ACT_LSL_UP FORMAT "%7.4" /end CHARACTERISTIC
/begin CHARACTERISTIC c_n_min_diag_dyn_lsl_up "Minimum engine speed to activate the diagnosis" VALUE 0xa1002162 _REC_VAL_20_u1 8160. _CNV_A_R_LINEAR_____9_CM 0. 8160. DISPLAY_IDENTIFIER C_N_MIN_DIAG_DYN_LSL_UP FORMAT "%4.0" /end CHARACTERISTIC
/begin CHARACTERISTIC c_n_min_act_lsl_up "Lower engine speed admitted to monitor the sensor activity " VALUE 0xa1002161 _REC_VAL_20_u1 8160. _CNV_A_R_LINEAR_____9_CM 0. 8160. DISPLAY_IDENTIFIER C_N_MIN_ACT_LSL_UP FORMAT "%4.0" /end CHARACTERISTIC
/begin CHARACTERISTIC c_t_diag_end_eol_puc_lsl_up "Time to have a diagnostic available (EOL test) " VALUE 0xa1002188 _REC_VAL_20_u2 6553.5 _CNV_A_R_LINEAR_____4_CM 0. 6553.5 DISPLAY_IDENTIFIER C_T_DIAG_END_EOL_PUC_LSL_UP FORMAT "%6.1" /end CHARACTERISTIC
/begin CHARACTERISTIC c_t_sum_afl_afr_act_lsl_up "Lower forced stimulation period admitted to monitor the sensor activity" VALUE 0xa10021f6 _REC_VAL_20_u2 655.35 _CNV_A_R_LINEAR_____3_CM 0. 655.35 DISPLAY_IDENTIFIER C_T_SUM_AFL_AFR_ACT_LSL_UP FORMAT "%6.2" /end CHARACTERISTIC
/begin CHARACTERISTIC c_lamb_afl_plaus_lsl_up "Lean-mixture threshold of the upstream sensor voltage" VALUE 0xa10020c4 _REC_VAL_20_u2 31.9990234375 _CNV_A_R_LINEAR_____122_CM 0. 31.9990234375 DISPLAY_IDENTIFIER C_LAMB_AFL_PLAUS_LSL_UP FORMAT "%7.4" /end CHARACTERISTIC
/begin CHARACTERISTIC c_lamb_sp_de_pls_act_lsl_up "Lower forced stimulation amplitude admitted to monitor the sensor activity" VALUE 0xa10020fa _REC_VAL_20_u2 0.124939 _CNV_A_R_EGCP_LINEA_374_CM 0. 0.124939 DISPLAY_IDENTIFIER C_LAMB_SP_DE_PLS_ACT_LSL_UP FORMAT "%7.5" /end CHARACTERISTIC
/begin CHARACTERISTIC c_maf_kgh_min_diag_plaus_lsl_up "Minimum mass air flow to carry out the plausibility" VALUE 0xa1002144 _REC_VAL_20_u2 2047.96875 _CNV_A_R_LINEAR_____207_CM 0. 2047.96875 DISPLAY_IDENTIFIER C_MAF_KGH_MIN_DIAG_PLAUS_LSL_UP FORMAT "%10.5" /end CHARACTERISTIC
/begin CHARACTERISTIC c_maf_kgh_min_act_lsl_up "Lower mass airflow in Kg/h admitted to monitor the sensor activity" VALUE 0xa1002142 _REC_VAL_20_u2 2047.96875 _CNV_A_R_LINEAR_____207_CM 0. 2047.96875 DISPLAY_IDENTIFIER C_MAF_KGH_MIN_ACT_LSL_UP FORMAT "%10.5" /end CHARACTERISTIC
/begin CHARACTERISTIC c_ctr_inc_diag_plaus_lsl_up "Second anti-bounce filter: counter increment" VALUE 0xa1002052 _REC_VAL_20_u1 255. _CNV_A_R_LINEAR_____0_CM 0. 255. DISPLAY_IDENTIFIER C_CTR_INC_DIAG_PLAUS_LSL_UP FORMAT "%3.0" /end CHARACTERISTIC
/begin CHARACTERISTIC c_lamb_de_tot_act_lsl_up "Threshold of the total cumulated lambda deviation to debounce the sensor non-activity symptom " VALUE 0xa10020d4 _REC_VAL_20_u2 63.999023 _CNV_A_R_EGCP_LINEA_330_CM 0. 63.999023 DISPLAY_IDENTIFIER C_LAMB_DE_TOT_ACT_LSL_UP FORMAT "%7.4" /end CHARACTERISTIC
/begin CHARACTERISTIC c_ctr_lamb_de_int_act_lsl_up "Number of forced stimulation periods to calculate the total cumulated lambda deviation" VALUE 0xa100205a _REC_VAL_20_u1 255. _CNV_A_R_LINEAR_____0_CM 0. 255. DISPLAY_IDENTIFIER C_CTR_LAMB_DE_INT_ACT_LSL_UP FORMAT "%3.0" /end CHARACTERISTIC
/begin CHARACTERISTIC c_ctr_sym_max_act_lsl_up "Counter threshold to set the sensor non-activity symptom flag" VALUE 0xa100206e _REC_VAL_20_u1 255. _CNV_A_R_LINEAR_____0_CM 0. 255. DISPLAY_IDENTIFIER C_CTR_SYM_MAX_ACT_LSL_UP FORMAT "%3.0" /end CHARACTERISTIC
/begin CHARACTERISTIC c_ctr_sym_inc_act_lsl_up "Counter increment to set the sensor non-activity symptom flag" VALUE 0xa100206c _REC_VAL_20_u1 255. _CNV_A_R_LINEAR_____0_CM 0. 255. DISPLAY_IDENTIFIER C_CTR_SYM_INC_ACT_LSL_UP FORMAT "%3.0" /end CHARACTERISTIC
/begin CHARACTERISTIC c_ctr_sym_dec_act_lsl_up "Counter decrement to set the sensor non-activity symptom flag" VALUE 0xa100206a _REC_VAL_20_u1 255. _CNV_A_R_LINEAR_____0_CM 0. 255. DISPLAY_IDENTIFIER C_CTR_SYM_DEC_ACT_LSL_UP FORMAT "%3.0" /end CHARACTERISTIC
/begin CHARACTERISTIC c_crlc_lpf_lamb_diag_dyn_lsl_up "Correlation factor for low pass filtered lambda value" VALUE 0xa1002038 _REC_VAL_20_u2 0.9999847412109381 _CNV_A_R_LINEAR_____68_CM 0. 0.9999847412109381 DISPLAY_IDENTIFIER C_CRLC_LPF_LAMB_DIAG_DYN_LSL_UP FORMAT "%7.5" /end CHARACTERISTIC
/begin CHARACTERISTIC c_crlc_act_lsl_up "Correlation factor for the moving mean value" VALUE 0xa100202e _REC_VAL_20_u2 0.9999847412109381 _CNV_A_R_LINEAR_____68_CM 0. 0.9999847412109381 DISPLAY_IDENTIFIER C_CRLC_ACT_LSL_UP FORMAT "%7.5" /end CHARACTERISTIC
/begin CHARACTERISTIC lc_diag_dyn_lsl_up_cat_syn "Boolean switch to synchronise the dynamic diagnosis with the catalyst efficiency diagnosis" VALUE 0xa10022d8 _REC_VAL_20_u1 1. _CNV_A_R_LINEAR_____0_CM 0. 1. DISPLAY_IDENTIFIER LC_DIAG_DYN_LSL_UP_CAT_SYN FORMAT "%1.0" /end CHARACTERISTIC
/begin CHARACTERISTIC lc_diag_act_lsl_up "Boolean calibrateable constant allowing the second upstream sensor activity test " VALUE 0xa10022d6 _REC_VAL_20_u1 1. _CNV_A_R_LINEAR_____0_CM 0. 1. DISPLAY_IDENTIFIER LC_DIAG_ACT_LSL_UP FORMAT "%1.0" /end CHARACTERISTIC
/begin AXIS_PTS ldpm_maf_kgh_ip_t_diag_lsl_up "" 0xa1001ac4 maf_kgh _REC_AXS_20_u2 2047.96875 _CNV_A_R_LINEAR_____207_CM 4 0. 2047.96875 FORMAT "%10.5" /end AXIS_PTS
/begin CHARACTERISTIC id_ctr_inc_raw_act_lsl_up "Counter increment to detect raw symptom of upstream sensor non-activity" CURVE 0xa1001b68 _REC_CUR_20_u1_u2 255. _CNV_A_R_LINEAR_____0_CM 0. 255. DISPLAY_IDENTIFIER ID_CTR_INC_RAW_ACT_LSL_UP FORMAT "%3.0"
 /begin AXIS_DESCR COM_AXIS maf_kgh _CNV_A_R_LINEAR_____207_CM 8 0. 2047.96875 FORMAT "%10.5" AXIS_PTS_REF ldp_maf_kgh_id_ctr_act_lsl_up /end AXIS_DESCR
/end CHARACTERISTIC
/begin CHARACTERISTIC id_lamb_gain_act_lsl_up "Gain/Damping factor to calculate the integral of lambda deviation from the moving mean value " CURVE 0xa1001b70 _REC_CUR_20_u1_u2 1.9921875 _CNV_A_R_LINEAR_____100_CM 0. 1.9921875 DISPLAY_IDENTIFIER ID_LAMB_GAIN_ACT_LSL_UP FORMAT "%8.6"
 /begin AXIS_DESCR COM_AXIS online_dummy _CNV_A_R_EGCP_LINEA_330_CM 8 0. 63.999023 FORMAT "%7.4" AXIS_PTS_REF ldp_lamb_de_lsl_id_lamb_lsl_up /end AXIS_DESCR
/end CHARACTERISTIC
/begin AXIS_PTS ldp_maf_kgh_id_ctr_act_lsl_up "" 0xa1001920 maf_kgh _REC_AXS_20_u2 2047.96875 _CNV_A_R_LINEAR_____207_CM 8 0. 2047.96875 FORMAT "%10.5" /end AXIS_PTS
/begin AXIS_PTS ldp_lamb_de_lsl_id_lamb_lsl_up "" 0xa10018dc online_dummy _REC_AXS_20_u2 63.999023 _CNV_A_R_EGCP_LINEA_330_CM 8 0. 63.999023 FORMAT "%7.4" /end AXIS_PTS
/begin AXIS_PTS ldp_fac_diag_dyn_lsl_up_id_lamb "" 0xa10018b8 online_dummy _REC_AXS_20_u2 1. _CNV_A_R_EGCP_LINEA_330_CM 8 0. 1. FORMAT "%7.4" /end AXIS_PTS
/begin CHARACTERISTIC id_lamb_gain_ls_up_dyn "Gain factor to consider an aged linear lambda sensor " CURVE 0xa1001b78 _REC_CUR_20_u1_u2 31.875 _CNV_A_R_EGCP_LINEA_370_CM 0. 31.875 DISPLAY_IDENTIFIER ID_LAMB_GAIN_LS_UP_DYN
 /begin AXIS_DESCR COM_AXIS online_dummy _CNV_A_R_EGCP_LINEA_330_CM 8 0. 1. FORMAT "%7.4" AXIS_PTS_REF ldp_fac_diag_dyn_lsl_up_id_lamb /end AXIS_DESCR
/end CHARACTERISTIC
/begin CHARACTERISTIC c_fac_ad_rst_diag_dyn_lsl_up "Diagnosis value threshold to reset adaptation of sensor time constant model" VALUE 0xa1002078 _REC_VAL_20_u2 31.9990234375 _CNV_A_R_LINEAR_____122_CM 0. 31.9990234375 DISPLAY_IDENTIFIER C_FAC_AD_RST_DIAG_DYN_LSL_UP FORMAT "%7.4" /end CHARACTERISTIC
/begin CHARACTERISTIC c_vls_up_diag_max_air_lsl_up "Upstream sensor signal max. threshold during engine operation (PUC excepted)" VALUE 0xa10022c4 _REC_VAL_20_s2 319.9951171875 _CNV_A_R_LINEAR_____2_CM -160. 159.9951171875 DISPLAY_IDENTIFIER C_VLS_UP_DIAG_MAX_AIR_LSL_UP FORMAT "%8.3" /end CHARACTERISTIC
/begin MEASUREMENT lv_err_puc_vld_ls_up_1 "Debounced failure of the signal plausibility from the upstream sensor during PUC" UBYTE _CNV_S_2_RANGE__0___1_CM 1 100. 0. 1. DISPLAY_IDENTIFIER LV_ERR_PUC_VLD_LS_UP[1] ECU_ADDRESS 0xd00034a2 BIT_MASK 0x1 /end MEASUREMENT
/begin MEASUREMENT lv_err_puc_vld_ls_up_2 "Debounced failure of the signal plausibility from the upstream sensor during PUC" UBYTE _CNV_S_2_RANGE__0___1_CM 1 100. 0. 1. DISPLAY_IDENTIFIER LV_ERR_PUC_VLD_LS_UP[2] ECU_ADDRESS 0xd00034bb BIT_MASK 0x1 /end MEASUREMENT
/begin CHARACTERISTIC c_vls_up_diag_afs_puc_lsl_up "Upstream sensor output voltage in PUC corresponding to Open Circuit on WRAF Sensor" VALUE 0xa10022c2 _REC_VAL_20_s2 319.9951171875 _CNV_A_R_LINEAR_____2_CM -160. 159.9951171875 DISPLAY_IDENTIFIER C_VLS_UP_DIAG_AFS_PUC_LSL_UP FORMAT "%8.3" /end CHARACTERISTIC
/begin CHARACTERISTIC c_vls_up_diag_min_puc_lsl_up "Minimum admissible upstream sensor output voltage in PUC" VALUE 0xa10022ca _REC_VAL_20_s2 319.9951171875 _CNV_A_R_LINEAR_____2_CM -160. 159.9951171875 DISPLAY_IDENTIFIER C_VLS_UP_DIAG_MIN_PUC_LSL_UP FORMAT "%8.3" /end CHARACTERISTIC
/begin CHARACTERISTIC c_vls_up_diag_max_puc_lsl_up "Upstream sensor output voltage in PUC corresponding to Open Circuit on WRAF Sensor" VALUE 0xa10022c6 _REC_VAL_20_s2 319.9951171875 _CNV_A_R_LINEAR_____2_CM -160. 159.9951171875 DISPLAY_IDENTIFIER C_VLS_UP_DIAG_MAX_PUC_LSL_UP FORMAT "%8.3" /end CHARACTERISTIC
/begin CHARACTERISTIC c_teg_min_plaus_lsl_up "Minimum temperature of the catalyst to carry out the plausibility" VALUE 0xa1002234 _REC_VAL_20_u2 2047.9375 _CNV_A_R_LINEAR_____204_CM -273.15 1774.7875 DISPLAY_IDENTIFIER C_TEG_MIN_PLAUS_LSL_UP FORMAT "%9.4" /end CHARACTERISTIC
/begin CHARACTERISTIC c_teg_max_plaus_lsl_up "Maximum temperature of the catalyst to carry out the plausibility" VALUE 0xa100222c _REC_VAL_20_u2 2047.9375 _CNV_A_R_LINEAR_____204_CM -273.15 1774.7875 DISPLAY_IDENTIFIER C_TEG_MAX_PLAUS_LSL_UP FORMAT "%9.4" /end CHARACTERISTIC
/begin CHARACTERISTIC ip_t_dyn_diag "Amplitude measurement time: same points than in LDPM_N_32_2_EGTR and LDPM_MAF_HB_2_EGTR shall be used" MAP 0xa1001efc _REC_MAP_20_u2_u1_u1 1310.7 _CNV_A_R_LINEAR_____107_CM 0. 1310.7 DISPLAY_IDENTIFIER IP_T_DYN_DIAG FORMAT "%7.2"
 /begin AXIS_DESCR COM_AXIS n_32 _CNV_A_R_LINEAR_____9_CM 8 0. 8160. FORMAT "%4.0" AXIS_PTS_REF ldpm_n_32_ls_up_dyn /end AXIS_DESCR
 /begin AXIS_DESCR COM_AXIS NO_INPUT_QUANTITY _CNV_A_R_LINEAR_____14_CM 8 0. 1389. FORMAT "%4.0" AXIS_PTS_REF ldpm_maf_hb_ls_up_dyn /end AXIS_DESCR
/end CHARACTERISTIC
/begin CHARACTERISTIC c_teg_min_diag_puc_lsl_up "Minimum admissible exhaust gas temperature in PUC" VALUE 0xa1002232 _REC_VAL_20_u2 2047.9375 _CNV_A_R_LINEAR_____204_CM -273.15 1774.7875 DISPLAY_IDENTIFIER C_TEG_MIN_DIAG_PUC_LSL_UP FORMAT "%9.4" /end CHARACTERISTIC
/begin MEASUREMENT maf_int_diag_lsh_lsl_up "Integral of the air flow, for the activation of the heater coupling diagnosis" UWORD _CNV_A_R_LINEAR_____356_CM 1 100. 0. 1820.42 DISPLAY_IDENTIFIER MAF_INT_DIAG_LSH_LSL_UP ECU_ADDRESS 0xc0001958 FORMAT "%7.2" /end MEASUREMENT
/begin CHARACTERISTIC c_lamb_delta_lpf_thd "Threshold for the maximum transition of the sensor signal" VALUE 0xa10020da _REC_VAL_20_u2 1.99993896484375 _CNV_A_R_LINEAR_____23_CM 0. 1.99993896484375 DISPLAY_IDENTIFIER C_LAMB_DELTA_LPF_THD FORMAT "%7.5" /end CHARACTERISTIC
/begin CHARACTERISTIC c_cycnr_max_diag_lsh_lsl_up "Quantity of valid diagnosis values in one function cycle" VALUE 0xa1002076 _REC_VAL_20_u1 255. _CNV_A_R_LINEAR_____0_CM 0. 255. DISPLAY_IDENTIFIER C_CYCNR_MAX_DIAG_LSH_LSL_UP FORMAT "%3.0" /end CHARACTERISTIC
/begin CHARACTERISTIC c_ctr_sym_diag_lsh_lsl_up "Limit value of the diagnosis results to diagnose the heater coupling" VALUE 0xa100206b _REC_VAL_20_u1 255. _CNV_A_R_LINEAR_____0_CM 0. 255. DISPLAY_IDENTIFIER C_CTR_SYM_DIAG_LSH_LSL_UP FORMAT "%3.0" /end CHARACTERISTIC
/begin CHARACTERISTIC c_lamb_sp_de_diag_lsh_lsl_up "Maximum value of the forced excitation amplitude to activate the diagnosis" VALUE 0xa10020f8 _REC_VAL_20_u1 0.124023 _CNV_A_R_EGCP_LINEA_363_CM 0. 0.124023 DISPLAY_IDENTIFIER C_LAMB_SP_DE_DIAG_LSH_LSL_UP FORMAT "%6.4" /end CHARACTERISTIC
/begin CHARACTERISTIC c_maf_int_diag_lsh_lsl_up "Threshold for the activation of the MAF-Integral" VALUE 0xa100211c _REC_VAL_20_u2 1820.42 _CNV_A_R_LINEAR_____356_CM 0. 1820.42 DISPLAY_IDENTIFIER C_MAF_INT_DIAG_LSH_LSL_UP FORMAT "%7.2" /end CHARACTERISTIC
/begin CHARACTERISTIC c_crlc_lpf_fall_diag_lsh_lsl_up "Filter constant for Fall" VALUE 0xa1002036 _REC_VAL_20_u1 0.99609375 _CNV_A_R_LINEAR_____27_CM 0. 0.99609375 DISPLAY_IDENTIFIER C_CRLC_LPF_FALL_DIAG_LSH_LSL_UP FORMAT "%5.3" /end CHARACTERISTIC
/begin CHARACTERISTIC c_crlc_lpf_rise_diag_lsh_lsl_up "Filter constant for Rise" VALUE 0xa100203a _REC_VAL_20_u1 0.99609375 _CNV_A_R_LINEAR_____27_CM 0. 0.99609375 DISPLAY_IDENTIFIER C_CRLC_LPF_RISE_DIAG_LSH_LSL_UP FORMAT "%5.3" /end CHARACTERISTIC
/begin CHARACTERISTIC c_lshpwm_min_diag_lsh_lsl_up "Minimum heater PWM value allowed to carry out the heater coupling diagnosis" VALUE 0xa100210f _REC_VAL_20_u1 99.609375 _CNV_A_R_LINEAR_____5_CM 0. 99.609375 DISPLAY_IDENTIFIER C_LSHPWM_MIN_DIAG_LSH_LSL_UP FORMAT "%9.6" /end CHARACTERISTIC
/begin CHARACTERISTIC c_lshpwm_max_diag_lsh_lsl_up "Maximum heater PWM value allowed to carry out the heater coupling diagnosis" VALUE 0xa100210b _REC_VAL_20_u1 99.609375 _CNV_A_R_LINEAR_____5_CM 0. 99.609375 DISPLAY_IDENTIFIER C_LSHPWM_MAX_DIAG_LSH_LSL_UP FORMAT "%9.6" /end CHARACTERISTIC
/begin MEASUREMENT lv_err_lsh_lsl_up_1 "Debounced heater coupling failure " UBYTE _CNV_S_2_RANGE__0___1_CM 1 100. 0. 1. DISPLAY_IDENTIFIER LV_ERR_LSH_LSL_UP[1] ECU_ADDRESS 0xd000349c BIT_MASK 0x1 /end MEASUREMENT
/begin MEASUREMENT lv_err_lsh_lsl_up_2 "Debounced heater coupling failure " UBYTE _CNV_S_2_RANGE__0___1_CM 1 100. 0. 1. DISPLAY_IDENTIFIER LV_ERR_LSH_LSL_UP[2] ECU_ADDRESS 0xd00034b5 BIT_MASK 0x1 /end MEASUREMENT
/begin AXIS_PTS ldp_lshpwm_up_ip_t_dly_acq_vls "" 0xa100191a online_dummy _REC_AXS_20_u1 99.609375 _CNV_A_R_LINEAR_____5_CM 4 0. 99.609375 FORMAT "%9.6" /end AXIS_PTS
/begin CHARACTERISTIC ip_t_dly_trig_lsh_up "Time delay to trigger oxygen sensor signal and lambda model" CURVE 0xa1001ef8 _REC_CUR_20_u1_u1 0.255 _CNV_A_R_EGCP_LINEA_367_CM 0. 0.255 DISPLAY_IDENTIFIER IP_T_DLY_TRIG_LSH_UP FORMAT "%5.3"
 /begin AXIS_DESCR COM_AXIS online_dummy _CNV_A_R_LINEAR_____5_CM 4 0. 99.609375 FORMAT "%9.6" AXIS_PTS_REF ldp_lshpwm_up_ip_t_dly_acq_vls /end AXIS_DESCR
/end CHARACTERISTIC
/begin CHARACTERISTIC c_t_afl_afr_diag_lsh_lsl_up "Threshold of the MAF-Integral to activate the heater-coupling diagnosis" VALUE 0xa100217c _REC_VAL_20_u2 655.35 _CNV_A_R_LINEAR_____3_CM 0. 655.35 DISPLAY_IDENTIFIER C_T_AFL_AFR_DIAG_LSH_LSL_UP FORMAT "%6.2" /end CHARACTERISTIC
/begin CHARACTERISTIC c_teg_min_diag_lsh_lsl_up "Minimum value of the exhaust temperature to activate  the function" VALUE 0xa1002230 _REC_VAL_20_u2 2047.9375 _CNV_A_R_LINEAR_____204_CM -273.15 1774.7875 DISPLAY_IDENTIFIER C_TEG_MIN_DIAG_LSH_LSL_UP FORMAT "%9.4" /end CHARACTERISTIC
/begin CHARACTERISTIC c_cl_mmv_ls_up_diag_max "Maximum degree of saturation of the evaporative canister to activate the function" VALUE 0xa100202c _REC_VAL_20_u2 1.99996948242188 _CNV_A_R_LINEAR_____8_CM 0. 1.99996948242188 DISPLAY_IDENTIFIER C_CL_MMV_LS_UP_DIAG_MAX FORMAT "%7.5" /end CHARACTERISTIC
/begin MEASUREMENT lv_diag_eol_dyn_ls_up_dc[0] "Logical Value as reminder for End of Line test within this driving cycle" UBYTE _CNV_S_2_RANGE__0___1_CM 1 100. 0. 1. DISPLAY_IDENTIFIER LV_DIAG_EOL_DYN_LS_UP_DC[1] ECU_ADDRESS 0xc0001968 BIT_MASK 0x1 /end MEASUREMENT
/begin MEASUREMENT lv_diag_eol_dyn_ls_up_dc[1] "Logical Value as reminder for End of Line test within this driving cycle" UBYTE _CNV_S_2_RANGE__0___1_CM 1 100. 0. 1. DISPLAY_IDENTIFIER LV_DIAG_EOL_DYN_LS_UP_DC[2] ECU_ADDRESS 0xc0001969 BIT_MASK 0x1 /end MEASUREMENT
/begin MEASUREMENT lv_diag_eol_air_lsl_up_dc[0] "Logical Value as reminder for End of Line test within this driving cycle" UBYTE _CNV_S_2_RANGE__0___1_CM 1 100. 0. 1. DISPLAY_IDENTIFIER LV_DIAG_EOL_AIR_LSL_UP_DC[1] ECU_ADDRESS 0xc0001966 BIT_MASK 0x1 /end MEASUREMENT
/begin MEASUREMENT lv_diag_eol_air_lsl_up_dc[1] "Logical Value as reminder for End of Line test within this driving cycle" UBYTE _CNV_S_2_RANGE__0___1_CM 1 100. 0. 1. DISPLAY_IDENTIFIER LV_DIAG_EOL_AIR_LSL_UP_DC[2] ECU_ADDRESS 0xc0001967 BIT_MASK 0x1 /end MEASUREMENT
/begin MEASUREMENT lv_inh_diag_ls_up_dyn_cp "Canister Purge Load too high" UBYTE _CNV_S_2_RANGE__0___1_CM 1 100. 0. 1. DISPLAY_IDENTIFIER LV_INH_DIAG_LS_UP_DYN_CP ECU_ADDRESS 0xd0002da2 BIT_MASK 0x1 /end MEASUREMENT
/begin MEASUREMENT lv_inh_diag_rbm_plaus_lsl_up[0] "Deactivation of  Rate Base Monitoring of  \"Plausibility check of the sensor signal\"" UBYTE _CNV_S_2_RANGE__0___1_CM 1 100. 0. 1. DISPLAY_IDENTIFIER LV_INH_DIAG_RBM_PLAUS_LSL_UP[0] ECU_ADDRESS 0xd0002da4 BIT_MASK 0x1 /end MEASUREMENT
/begin MEASUREMENT lv_inh_diag_rbm_plaus_lsl_up[1] "Deactivation of  Rate Base Monitoring of  \"Plausibility check of the sensor signal\"" UBYTE _CNV_S_2_RANGE__0___1_CM 1 100. 0. 1. DISPLAY_IDENTIFIER LV_INH_DIAG_RBM_PLAUS_LSL_UP[1] ECU_ADDRESS 0xd0002da5 BIT_MASK 0x1 /end MEASUREMENT
/begin CHARACTERISTIC lc_lsl_diag_lsh_lsl_up_deac "Logical calibration data for manual deactivation of heater coupling diagnosis" VALUE 0xa1002306 _REC_VAL_20_u1 1. _CNV_A_R_LINEAR_____0_CM 0. 1. DISPLAY_IDENTIFIER LC_LSL_DIAG_LSH_LSL_UP_DEAC FORMAT "%1.0" /end CHARACTERISTIC
/begin MEASUREMENT lv_lsl_diag_lsh_lsl_up_deac "Manual Deactivation of \"Diagnosis of the Heater Coupling in the Sensor Signal\"" UBYTE _CNV_S_2_RANGE__0___1_CM 1 100. 0. 1. DISPLAY_IDENTIFIER LV_LSL_DIAG_LSH_LSL_UP_DEAC ECU_ADDRESS 0xd0002da6 BIT_MASK 0x1 /end MEASUREMENT
/begin AXIS_PTS ldpm_n_32_4_laco "" 0xa1008c0a n_32 _REC_AXS_20_u1 8160. _CNV_A_R_LINEAR_____9_CM 6 0. 8160. FORMAT "%4.0" /end AXIS_PTS
/begin AXIS_PTS ldpm_n_32_2_laco "" 0xa1008c02 n_32 _REC_AXS_20_u1 8160. _CNV_A_R_LINEAR_____9_CM 6 0. 8160. FORMAT "%4.0" /end AXIS_PTS
/begin AXIS_PTS ldpm_maf_1_laco "" 0xa1008bc0 maf _REC_AXS_20_u2 1389. _CNV_A_R_LINEAR_____108_CM 8 0. 1389. FORMAT "%7.2" /end AXIS_PTS
/begin AXIS_PTS ldpm_maf_cyl_1_laco "" 0xa1008bd4 maf_cyl _REC_AXS_20_u2 2047.96875 _CNV_A_R_LINEAR_____207_CM 6 0. 2047.96875 FORMAT "%10.5" /end AXIS_PTS
/begin AXIS_PTS ldpm_eff_cat_diag_1_laco "" 0xa1008ba0 online_dummy _REC_AXS_20_u1 1.9921875 _CNV_A_R_LINEAR_____100_CM 8 0. 1.9921875 FORMAT "%8.6" /end AXIS_PTS
/begin AXIS_PTS ldpm_tco_2_laco "" 0xa1008c66 tco _REC_AXS_20_u1 190.5 _CNV_A_R_LINEAR_____16_CM 5 -48. 142.5 FORMAT "%6.2" /end AXIS_PTS
/begin AXIS_PTS ldpm_n_1_laco "" 0xa1008bf0 n _REC_AXS_20_u2 8160. _CNV_A_R_LINEAR_____13_CM 8 0. 8160. FORMAT "%4.0" /end AXIS_PTS
/begin AXIS_PTS ldpm_t1_lsl_up_1_laco "" 0xa1008c20 online_dummy _REC_AXS_20_u2 1.99996948242188 _CNV_A_R_LINEAR_____117_CM 8 0. 1.99996948242188 FORMAT "%7.5" /end AXIS_PTS
/begin AXIS_PTS ldpm_t1_lsl_up_2_laco "" 0xa1008c34 online_dummy _REC_AXS_20_u2 1.99996948242188 _CNV_A_R_LINEAR_____117_CM 4 0. 1.99996948242188 FORMAT "%7.5" /end AXIS_PTS
/begin AXIS_PTS ldpm_tco_1_laco "" 0xa1008c5e tco _REC_AXS_20_u1 190.5 _CNV_A_R_LINEAR_____16_CM 6 -48. 142.5 FORMAT "%6.2" /end AXIS_PTS
/begin AXIS_PTS ldpm_tco_st_1_laco "" 0xa1008c6c tco_st _REC_AXS_20_u1 190.5 _CNV_A_R_LINEAR_____16_CM 6 -48. 142.5 FORMAT "%6.2" /end AXIS_PTS
/begin AXIS_PTS ldpm_fac_lam_mv_1_laco "" 0xa1008bac online_dummy _REC_AXS_20_u2 99.99847412 _CNV_A_R_LINEAR_____159_CM 8 -50. 49.99847412 FORMAT "%7.3" /end AXIS_PTS
/begin AXIS_PTS ldpm_t_dly_soi_lsl_pos_1_laco "" 0xa1008c40 online_dummy _REC_AXS_20_u2 1.023984 _CNV_A_R_LINEAR_____375_CM 8 0. 1.023984 FORMAT "%7.5" /end AXIS_PTS
/begin AXIS_PTS ldpm_t_dly_soi_lsl_pos_2_laco "" 0xa1008c54 online_dummy _REC_AXS_20_u2 1.023984 _CNV_A_R_LINEAR_____375_CM 4 0. 1.023984 FORMAT "%7.5" /end AXIS_PTS
/begin AXIS_PTS ldpm_vls_dif_lam_adj_1_laco "" 0xa1008c74 online_dummy _REC_AXS_20_u2 9.99511719 _CNV_A_R_LACO_LINEA_376_CM 16 -5. 4.99511719 /end AXIS_PTS
/begin AXIS_PTS ldpm_vls_dif_lam_adj_2_laco "" 0xa1008c98 online_dummy _REC_AXS_20_u2 9.99511719 _CNV_A_R_LACO_LINEA_376_CM 16 -5. 4.99511719 /end AXIS_PTS
/begin AXIS_PTS ldpm_n_32_5_laco "" 0xa1008c14 n_32 _REC_AXS_20_u1 8160. _CNV_A_R_LINEAR_____9_CM 8 0. 8160. FORMAT "%4.0" /end AXIS_PTS
/begin MEASUREMENT lv_lam_ad_cdn "flag for time scheduler indicating good conditions for lambda adaptation" UBYTE _CNV_S_2_RANGE__0___1_CM 1 100. 0. 1. DISPLAY_IDENTIFIER LV_LAM_AD_CDN ECU_ADDRESS 0xd0002f1d BIT_MASK 0x1 /end MEASUREMENT
/begin AXIS_PTS ldp_mff_delta_add_lam_ad_t_pri "" 0xa1008af8 online_dummy _REC_AXS_20_u2 1389. _CNV_A_R_LACO_LINEA_377_CM 8 -694.510597 694.489403 FORMAT "%7.2" /end AXIS_PTS
/begin AXIS_PTS ldp_fac_delta_l_rng_lam_ad_pri "" 0xa1008aa0 online_dummy _REC_AXS_20_u2 99.99847412 _CNV_A_R_LINEAR_____159_CM 8 -50. 49.99847412 FORMAT "%7.3" /end AXIS_PTS
/begin AXIS_PTS ldp_fac_delta_h_rng_lam_ad_pri "" 0xa1008a8c online_dummy _REC_AXS_20_u2 99.99847412 _CNV_A_R_LINEAR_____159_CM 8 -50. 49.99847412 FORMAT "%7.3" /end AXIS_PTS
/begin CHARACTERISTIC c_t_pri_max_lam_ad "maximum priority time to set temporary end of adaptation flag" VALUE 0xa1009612 _REC_VAL_20_u2 6553.5 _CNV_A_R_LINEAR_____4_CM 0. 6553.5 DISPLAY_IDENTIFIER C_T_PRI_MAX_LAM_AD FORMAT "%6.1" /end CHARACTERISTIC
/begin CHARACTERISTIC c_n_tol_add_rng_lam_ad "maximum engine speed for offset lambda adaptation" VALUE 0xa1009603 _REC_VAL_20_u1 8160. _CNV_A_R_LINEAR_____9_CM 0. 8160. DISPLAY_IDENTIFIER C_N_TOL_ADD_RNG_LAM_AD FORMAT "%4.0" /end CHARACTERISTIC
/begin CHARACTERISTIC c_n_tol_fac_l_rng_lam_ad "maximum engine speed for lower area factor lambda adaptation" VALUE 0xa1009605 _REC_VAL_20_u1 8160. _CNV_A_R_LINEAR_____9_CM 0. 8160. DISPLAY_IDENTIFIER C_N_TOL_FAC_L_RNG_LAM_AD FORMAT "%4.0" /end CHARACTERISTIC
/begin CHARACTERISTIC c_n_bol_fac_l_rng_lam_ad "minimum engine speed for lower area factor lambda adaptation" VALUE 0xa10095f7 _REC_VAL_20_u1 8160. _CNV_A_R_LINEAR_____9_CM 0. 8160. DISPLAY_IDENTIFIER C_N_BOL_FAC_L_RNG_LAM_AD FORMAT "%4.0" /end CHARACTERISTIC
/begin CHARACTERISTIC c_n_bol_fac_h_rng_lam_ad "minimum engine speed for upper area factor lambda adaptation" VALUE 0xa10095f6 _REC_VAL_20_u1 8160. _CNV_A_R_LINEAR_____9_CM 0. 8160. DISPLAY_IDENTIFIER C_N_BOL_FAC_H_RNG_LAM_AD FORMAT "%4.0" /end CHARACTERISTIC
/begin CHARACTERISTIC c_n_tol_fac_h_rng_lam_ad "maximum engine speed for upper area factor lambda adaptation" VALUE 0xa1009604 _REC_VAL_20_u1 8160. _CNV_A_R_LINEAR_____9_CM 0. 8160. DISPLAY_IDENTIFIER C_N_TOL_FAC_H_RNG_LAM_AD FORMAT "%4.0" /end CHARACTERISTIC
/begin CHARACTERISTIC id_t_pri_fac_l_rng_lam_ad "priority time for next requested lambda adaptation according to factor difference or lower area" CURVE 0xa1008d40 _REC_CUR_20_u2_u2 6553.5 _CNV_A_R_LINEAR_____4_CM 0. 6553.5 DISPLAY_IDENTIFIER ID_T_PRI_FAC_L_RNG_LAM_AD FORMAT "%6.1"
 /begin AXIS_DESCR COM_AXIS online_dummy _CNV_A_R_LINEAR_____159_CM 8 -50. 49.99847412 FORMAT "%7.3" AXIS_PTS_REF ldp_fac_delta_l_rng_lam_ad_pri /end AXIS_DESCR
/end CHARACTERISTIC
/begin CHARACTERISTIC id_t_pri_mff_add_rng_lam_ad "priority time for next requested lambda adaptation according to offset difference" CURVE 0xa1008d50 _REC_CUR_20_u2_u2 6553.5 _CNV_A_R_LINEAR_____4_CM 0. 6553.5 DISPLAY_IDENTIFIER ID_T_PRI_MFF_ADD_RNG_LAM_AD FORMAT "%6.1"
 /begin AXIS_DESCR COM_AXIS online_dummy _CNV_A_R_LACO_LINEA_377_CM 8 -694.510597 694.489403 FORMAT "%7.2" AXIS_PTS_REF ldp_mff_delta_add_lam_ad_t_pri /end AXIS_DESCR
/end CHARACTERISTIC
/begin CHARACTERISTIC ip_fac_n_mff_add_lam_ad "factor on lambda adaptation offset depending on engine speed" CURVE 0xa10090ee _REC_CUR_20_u1_u1 1. _CNV_A_R_LINEAR_____100_CM 0. 1. DISPLAY_IDENTIFIER IP_FAC_N_MFF_ADD_LAM_AD FORMAT "%8.6"
 /begin AXIS_DESCR COM_AXIS n_32 _CNV_A_R_LINEAR_____9_CM 6 0. 8160. FORMAT "%4.0" AXIS_PTS_REF ldpm_n_32_4_laco /end AXIS_DESCR
/end CHARACTERISTIC
/begin CHARACTERISTIC ip_fac_n_fac_lam_ad "factor on lambda adaptation factor depending on engine speed" CURVE 0xa10090e8 _REC_CUR_20_u1_u1 1. _CNV_A_R_LINEAR_____100_CM 0. 1. DISPLAY_IDENTIFIER IP_FAC_N_FAC_LAM_AD FORMAT "%8.6"
 /begin AXIS_DESCR COM_AXIS n_32 _CNV_A_R_LINEAR_____9_CM 6 0. 8160. FORMAT "%4.0" AXIS_PTS_REF ldpm_n_32_4_laco /end AXIS_DESCR
/end CHARACTERISTIC
/begin CHARACTERISTIC ip_fac_wup_fac_lam_ad "factor on lambda adaptation offset during warm up" MAP 0xa100910c _REC_MAP_20_u1_u1_u2 1. _CNV_A_R_LINEAR_____100_CM 0. 1. DISPLAY_IDENTIFIER IP_FAC_WUP_FAC_LAM_AD FORMAT "%8.6"
 /begin AXIS_DESCR COM_AXIS tco _CNV_A_R_LINEAR_____16_CM 5 -48. 142.5 FORMAT "%6.2" AXIS_PTS_REF ldpm_tco_2_laco /end AXIS_DESCR
 /begin AXIS_DESCR COM_AXIS online_dummy _CNV_A_R_LINEAR_____159_CM 5 -50. 49.99847412 FORMAT "%7.3" AXIS_PTS_REF ldp_fac_lam_ad_ip_fac_wup_fac /end AXIS_DESCR
/end CHARACTERISTIC
/begin AXIS_PTS ldp_fac_lam_ad_ip_fac_wup_fac "" 0xa1008ab4 online_dummy _REC_AXS_20_u2 99.99847412 _CNV_A_R_LINEAR_____159_CM 5 -50. 49.99847412 FORMAT "%7.3" /end AXIS_PTS
/begin CHARACTERISTIC c_mff_sp_tol_add_rng_lam_ad "maximum fuel mass set point for offset lambda adaptation" VALUE 0xa10095f4 _REC_VAL_20_u2 1389. _CNV_A_R_LINEAR_____108_CM 0. 1389. DISPLAY_IDENTIFIER C_MFF_SP_TOL_ADD_RNG_LAM_AD FORMAT "%7.2" /end CHARACTERISTIC
/begin CHARACTERISTIC c_fac_min_l_rng_lam_ad "maximum value of lower area lambda adaptation factor" VALUE 0xa1009580 _REC_VAL_20_s2 99.99847412109381 _CNV_A_R_LINEAR_____110_CM -50. 49.9984741210938 DISPLAY_IDENTIFIER C_FAC_MIN_L_RNG_LAM_AD FORMAT "%7.3" /end CHARACTERISTIC
/begin CHARACTERISTIC c_fac_max_l_rng_lam_ad "minimum value of lower area lambda adaptation factor" VALUE 0xa100957c _REC_VAL_20_s2 99.99847412109381 _CNV_A_R_LINEAR_____110_CM -50. 49.9984741210938 DISPLAY_IDENTIFIER C_FAC_MAX_L_RNG_LAM_AD FORMAT "%7.3" /end CHARACTERISTIC
/begin CHARACTERISTIC c_fac_max_h_rng_lam_ad "maximum value of upper area lambda adaptation factor" VALUE 0xa100957a _REC_VAL_20_s2 99.99847412109381 _CNV_A_R_LINEAR_____110_CM -50. 49.9984741210938 DISPLAY_IDENTIFIER C_FAC_MAX_H_RNG_LAM_AD FORMAT "%7.3" /end CHARACTERISTIC
/begin CHARACTERISTIC c_mff_min_add_rng_lam_ad "minimum value of lambda adaptation offset" VALUE 0xa10095f2 _REC_VAL_20_s2 1389. _CNV_A_R_LINEAR_____202_CM -694.510597390707 694.4894026092931 DISPLAY_IDENTIFIER C_MFF_MIN_ADD_RNG_LAM_AD FORMAT "%7.2" /end CHARACTERISTIC
/begin CHARACTERISTIC c_mff_max_add_rng_lam_ad "maximum value of lambda adaptation offset" VALUE 0xa10095f0 _REC_VAL_20_s2 1389. _CNV_A_R_LINEAR_____202_CM -694.510597390707 694.4894026092931 DISPLAY_IDENTIFIER C_MFF_MAX_ADD_RNG_LAM_AD FORMAT "%7.2" /end CHARACTERISTIC
/begin CHARACTERISTIC lc_fac_l_rng_afs_req_lam_ad "logical calibration to allow forced lambda eq. 1 conditions for factor adaptation at upper area" VALUE 0xa100962b _REC_VAL_20_u1 1. _CNV_A_R_LINEAR_____0_CM 0. 1. DISPLAY_IDENTIFIER LC_FAC_L_RNG_AFS_REQ_LAM_AD FORMAT "%1.0" /end CHARACTERISTIC
/begin CHARACTERISTIC lc_fac_h_rng_afs_req_lam_ad "logical calibration to allow forced lambda eq. 1 conditions for factor adaptation at upper area" VALUE 0xa100962a _REC_VAL_20_u1 1. _CNV_A_R_LINEAR_____0_CM 0. 1. DISPLAY_IDENTIFIER LC_FAC_H_RNG_AFS_REQ_LAM_AD FORMAT "%1.0" /end CHARACTERISTIC
/begin CHARACTERISTIC lc_mff_add_rng_afs_req_lam_ad "logical calibration to allow forced lambda eq. 1 conditions for offset adaptation" VALUE 0xa1009636 _REC_VAL_20_u1 1. _CNV_A_R_LINEAR_____0_CM 0. 1. DISPLAY_IDENTIFIER LC_MFF_ADD_RNG_AFS_REQ_LAM_AD FORMAT "%1.0" /end CHARACTERISTIC
/begin CHARACTERISTIC c_fac_min_h_rng_lam_ad "minimum value of upper area lambda adaptation factor" VALUE 0xa100957e _REC_VAL_20_s2 99.99847412109381 _CNV_A_R_LINEAR_____110_CM -50. 49.9984741210938 DISPLAY_IDENTIFIER C_FAC_MIN_H_RNG_LAM_AD FORMAT "%7.3" /end CHARACTERISTIC
/begin CHARACTERISTIC ip_fac_wup_mff_add_lam_ad "factor on lambda adaptation factor during warm up" MAP 0xa1009128 _REC_MAP_20_u1_u1_u2 1. _CNV_A_R_LINEAR_____100_CM 0. 1. DISPLAY_IDENTIFIER IP_FAC_WUP_MFF_ADD_LAM_AD FORMAT "%8.6"
 /begin AXIS_DESCR COM_AXIS tco _CNV_A_R_LINEAR_____16_CM 5 -48. 142.5 FORMAT "%6.2" AXIS_PTS_REF ldpm_tco_2_laco /end AXIS_DESCR
 /begin AXIS_DESCR COM_AXIS online_dummy _CNV_A_R_LACO_LINEA_377_CM 5 -694.510597 694.489403 FORMAT "%7.2" AXIS_PTS_REF ldp_mff_add_lam_ad_ip_fac_wup /end AXIS_DESCR
/end CHARACTERISTIC
/begin AXIS_PTS ldp_mff_add_lam_ad_ip_fac_wup "" 0xa1008aec online_dummy _REC_AXS_20_u2 1389. _CNV_A_R_LACO_LINEA_377_CM 5 -694.510597 694.489403 FORMAT "%7.2" /end AXIS_PTS
/begin MEASUREMENT t_pri_tot_lam_ad "min. priority time of all exhaust cylinder banks for next requested lambda adaptation" UWORD _CNV_A_R_LINEAR_____4_CM 1 100. 0. 6553.5 DISPLAY_IDENTIFIER T_PRI_TOT_LAM_AD ECU_ADDRESS 0xd0002b70 FORMAT "%6.1" /end MEASUREMENT
/begin CHARACTERISTIC id_t_pri_fac_h_rng_lam_ad "priority time for next requested lambda adaptation according to factor difference or upper area" CURVE 0xa1008d30 _REC_CUR_20_u2_u2 6553.5 _CNV_A_R_LINEAR_____4_CM 0. 6553.5 DISPLAY_IDENTIFIER ID_T_PRI_FAC_H_RNG_LAM_AD FORMAT "%6.1"
 /begin AXIS_DESCR COM_AXIS online_dummy _CNV_A_R_LINEAR_____159_CM 8 -50. 49.99847412 FORMAT "%7.3" AXIS_PTS_REF ldp_fac_delta_h_rng_lam_ad_pri /end AXIS_DESCR
/end CHARACTERISTIC
/begin MEASUREMENT lv_lam_ad_end "logical value indicating temporary end of lambda adaptation" UBYTE _CNV_S_2_RANGE__0___1_CM 1 100. 0. 1. DISPLAY_IDENTIFIER LV_LAM_AD_END ECU_ADDRESS 0xd0002f1e BIT_MASK 0x1 /end MEASUREMENT
/begin MEASUREMENT lv_lam_ad_afs_req "request flag for combustion manager to force lambda eq. 1 conditions for lambda adaptation" UBYTE _CNV_S_2_RANGE__0___1_CM 1 100. 0. 1. DISPLAY_IDENTIFIER LV_LAM_AD_AFS_REQ ECU_ADDRESS 0xd0002f1c BIT_MASK 0x1 /end MEASUREMENT
/begin MEASUREMENT lv_lam_ad_stop_cbk_ex "logical variable indicating stop of at least one bank of the lambda adaptation cycle" UBYTE _CNV_S_2_RANGE__0___1_CM 1 100. 0. 1. DISPLAY_IDENTIFIER LV_LAM_AD_STOP_CBK_EX ECU_ADDRESS 0xc0002584 BIT_MASK 0x1 /end MEASUREMENT
/begin CHARACTERISTIC ip_mff_sp_max_fac_l_rng_lam_ad "fuel mass set point threshold for consideration of only lower field lambda adaptation factor" CURVE 0xa1009364 _REC_CUR_20_u2_u1 1389. _CNV_A_R_LINEAR_____108_CM 0. 1389. DISPLAY_IDENTIFIER IP_MFF_SP_MAX_FAC_L_RNG_LAM_AD FORMAT "%7.2"
 /begin AXIS_DESCR COM_AXIS n_32 _CNV_A_R_LINEAR_____9_CM 8 0. 8160. FORMAT "%4.0" AXIS_PTS_REF ldpm_n_32_5_laco /end AXIS_DESCR
/end CHARACTERISTIC
/begin CHARACTERISTIC ip_mff_sp_min_fac_h_rng_lam_ad "fuel mass set point threshold for consideration of only upper field lambda adaptation factor" CURVE 0xa1009374 _REC_CUR_20_u2_u1 1389. _CNV_A_R_LINEAR_____108_CM 0. 1389. DISPLAY_IDENTIFIER IP_MFF_SP_MIN_FAC_H_RNG_LAM_AD FORMAT "%7.2"
 /begin AXIS_DESCR COM_AXIS n_32 _CNV_A_R_LINEAR_____9_CM 8 0. 8160. FORMAT "%4.0" AXIS_PTS_REF ldpm_n_32_5_laco /end AXIS_DESCR
/end CHARACTERISTIC
/begin AXIS_PTS ldp_n_32_id_mff_sp_bol_h_rng "" 0xa1008b0c n_32 _REC_AXS_20_u1 8160. _CNV_A_R_LINEAR_____9_CM 8 0. 8160. FORMAT "%4.0" /end AXIS_PTS
/begin AXIS_PTS ldp_n_32_id_mff_sp_bol_l_rng "" 0xa1008b18 n_32 _REC_AXS_20_u1 8160. _CNV_A_R_LINEAR_____9_CM 8 0. 8160. FORMAT "%4.0" /end AXIS_PTS
/begin AXIS_PTS ldp_n_32_id_mff_sp_tol_l_rng "" 0xa1008b30 n_32 _REC_AXS_20_u1 8160. _CNV_A_R_LINEAR_____9_CM 8 0. 8160. FORMAT "%4.0" /end AXIS_PTS
/begin AXIS_PTS ldp_n_32_id_mff_sp_tol_h_rng "" 0xa1008b24 n_32 _REC_AXS_20_u1 8160. _CNV_A_R_LINEAR_____9_CM 8 0. 8160. FORMAT "%4.0" /end AXIS_PTS
/begin CHARACTERISTIC id_mff_sp_bol_fac_h_rng_lam_ad "minimum fuel mass set point for upper area factor lambda adaptation" CURVE 0xa1008cc0 _REC_CUR_20_u2_u1 1389. _CNV_A_R_LINEAR_____108_CM 0. 1389. DISPLAY_IDENTIFIER ID_MFF_SP_BOL_FAC_H_RNG_LAM_AD FORMAT "%7.2"
 /begin AXIS_DESCR COM_AXIS n_32 _CNV_A_R_LINEAR_____9_CM 8 0. 8160. FORMAT "%4.0" AXIS_PTS_REF ldp_n_32_id_mff_sp_bol_h_rng /end AXIS_DESCR
/end CHARACTERISTIC
/begin CHARACTERISTIC id_mff_sp_bol_fac_l_rng_lam_ad "minimum fuel mass set point for lower area factor lambda adaptation" CURVE 0xa1008cd0 _REC_CUR_20_u2_u1 1389. _CNV_A_R_LINEAR_____108_CM 0. 1389. DISPLAY_IDENTIFIER ID_MFF_SP_BOL_FAC_L_RNG_LAM_AD FORMAT "%7.2"
 /begin AXIS_DESCR COM_AXIS n_32 _CNV_A_R_LINEAR_____9_CM 8 0. 8160. FORMAT "%4.0" AXIS_PTS_REF ldp_n_32_id_mff_sp_bol_l_rng /end AXIS_DESCR
/end CHARACTERISTIC
/begin CHARACTERISTIC id_mff_sp_tol_fac_l_rng_lam_ad "maximum fuel mass set point for lower area factor lambda adaptation" CURVE 0xa1008cf0 _REC_CUR_20_u2_u1 1389. _CNV_A_R_LINEAR_____108_CM 0. 1389. DISPLAY_IDENTIFIER ID_MFF_SP_TOL_FAC_L_RNG_LAM_AD FORMAT "%7.2"
 /begin AXIS_DESCR COM_AXIS n_32 _CNV_A_R_LINEAR_____9_CM 8 0. 8160. FORMAT "%4.0" AXIS_PTS_REF ldp_n_32_id_mff_sp_tol_l_rng /end AXIS_DESCR
/end CHARACTERISTIC
/begin CHARACTERISTIC id_mff_sp_tol_fac_h_rng_lam_ad "maximum fuel mass set point for upper area factor lambda adaptation" CURVE 0xa1008ce0 _REC_CUR_20_u2_u1 1389. _CNV_A_R_LINEAR_____108_CM 0. 1389. DISPLAY_IDENTIFIER ID_MFF_SP_TOL_FAC_H_RNG_LAM_AD FORMAT "%7.2"
 /begin AXIS_DESCR COM_AXIS n_32 _CNV_A_R_LINEAR_____9_CM 8 0. 8160. FORMAT "%4.0" AXIS_PTS_REF ldp_n_32_id_mff_sp_tol_h_rng /end AXIS_DESCR
/end CHARACTERISTIC
/begin CHARACTERISTIC c_crlc_fac_dif_lam_ad_wup_mv "Correlation constant for calculation of the controller deviation in warm up phase" VALUE 0xa1009530 _REC_VAL_20_u1 1. _CNV_A_R_LINEAR_____100_CM 0. 1. DISPLAY_IDENTIFIER C_CRLC_FAC_DIF_LAM_AD_WUP_MV FORMAT "%8.6" /end CHARACTERISTIC
/begin CHARACTERISTIC c_crlc_global_fac_lam_ad_wup "Correlation constant for calculation of adaptation value in warm up phase" VALUE 0xa1009536 _REC_VAL_20_u1 1. _CNV_A_R_LINEAR_____100_CM 0. 1. DISPLAY_IDENTIFIER C_CRLC_GLOBAL_FAC_LAM_AD_WUP FORMAT "%8.6" /end CHARACTERISTIC
/begin CHARACTERISTIC c_ctr_tco_min_inter "Counter threshold for detecting minimum temperature for valid learning of adapatation value in warm up phase for current driving cycle" VALUE 0xa1009546 _REC_VAL_20_u2 8191. _CNV_A_R_LINEAR_____0_CM 0. 8191. DISPLAY_IDENTIFIER C_CTR_TCO_MIN_INTER FORMAT "%5.0" /end CHARACTERISTIC
/begin CHARACTERISTIC c_fac_lam_ad_wup_delta "Delta of applied adaptation value in warm up phase to ramp the signal to new value" VALUE 0xa100954a _REC_VAL_20_u2 49.9984741210938 _CNV_A_R_LINEAR_____7_CM 0. 49.9984741210938 DISPLAY_IDENTIFIER C_FAC_LAM_AD_WUP_DELTA /end CHARACTERISTIC
/begin CHARACTERISTIC c_fac_lam_ad_wup_min_gap "Minimum (absolute) gap between old and new adaptation value in warm up phase necessary to update adaptation values" VALUE 0xa1009554 _REC_VAL_20_u2 49.9984741210938 _CNV_A_R_LINEAR_____7_CM 0. 49.9984741210938 DISPLAY_IDENTIFIER C_FAC_LAM_AD_WUP_MIN_GAP /end CHARACTERISTIC
/begin CHARACTERISTIC c_fac_lam_ad_wup_max "maximum value for adaptation value in warm up phase" VALUE 0xa100954c _REC_VAL_20_s2 99.99847412109381 _CNV_A_R_LINEAR_____110_CM -50. 49.9984741210938 DISPLAY_IDENTIFIER C_FAC_LAM_AD_WUP_MAX FORMAT "%7.3" /end CHARACTERISTIC
/begin CHARACTERISTIC c_fac_lam_ad_wup_min "Minimum value for adaptation value in warm up phase" VALUE 0xa1009552 _REC_VAL_20_s2 99.99847412109381 _CNV_A_R_LINEAR_____110_CM -50. 49.9984741210938 DISPLAY_IDENTIFIER C_FAC_LAM_AD_WUP_MIN FORMAT "%7.3" /end CHARACTERISTIC
/begin CHARACTERISTIC c_fac_lam_ad_wup_max_inter "Maximum value for adaptation value in warm up phase while in transient phase before valid learning is possible" VALUE 0xa100954e _REC_VAL_20_s2 99.99847412109381 _CNV_A_R_LINEAR_____110_CM -50. 49.9984741210938 DISPLAY_IDENTIFIER C_FAC_LAM_AD_WUP_MAX_INTER FORMAT "%7.3" /end CHARACTERISTIC
/begin CHARACTERISTIC c_fac_lam_ad_wup_min_inter "Minimum value for adaptation value in warm up phase while in transient phase before valid learning is possible" VALUE 0xa1009556 _REC_VAL_20_s2 99.99847412109381 _CNV_A_R_LINEAR_____110_CM -50. 49.9984741210938 DISPLAY_IDENTIFIER C_FAC_LAM_AD_WUP_MIN_INTER FORMAT "%7.3" /end CHARACTERISTIC
/begin CHARACTERISTIC c_fac_lam_ad_wup_max_lscl_off "Maximum value for adaptation value in warm up phase while Lambda controller is off" VALUE 0xa1009550 _REC_VAL_20_s2 99.99847412109381 _CNV_A_R_LINEAR_____110_CM -50. 49.9984741210938 DISPLAY_IDENTIFIER C_FAC_LAM_AD_WUP_MAX_LSCL_OFF FORMAT "%7.3" /end CHARACTERISTIC
/begin CHARACTERISTIC c_fac_lam_ad_wup_min_lscl_off "Miniimum value for adaptation value in warm up phase while Lambda controller is off" VALUE 0xa1009558 _REC_VAL_20_s2 99.99847412109381 _CNV_A_R_LINEAR_____110_CM -50. 49.9984741210938 DISPLAY_IDENTIFIER C_FAC_LAM_AD_WUP_MIN_LSCL_OFF FORMAT "%7.3" /end CHARACTERISTIC
/begin CHARACTERISTIC c_tco_a_lam_ad_wup "Coolant temperature of point A for Lambda adaptation in warm up phase" VALUE 0xa1009614 _REC_VAL_20_u1 190.5 _CNV_A_R_LINEAR_____16_CM -48. 142.5 DISPLAY_IDENTIFIER C_TCO_A_LAM_AD_WUP FORMAT "%6.2" /end CHARACTERISTIC
/begin CHARACTERISTIC c_tco_b_lam_ad_wup "Coolant temperature of point B for Lambda adaptation in warm up phase" VALUE 0xa1009615 _REC_VAL_20_u1 190.5 _CNV_A_R_LINEAR_____16_CM -48. 142.5 DISPLAY_IDENTIFIER C_TCO_B_LAM_AD_WUP FORMAT "%6.2" /end CHARACTERISTIC
/begin CHARACTERISTIC c_tco_c_lam_ad_wup "Coolant temperature of point C for Lambda adaptation in warm up phase" VALUE 0xa1009616 _REC_VAL_20_u1 190.5 _CNV_A_R_LINEAR_____16_CM -48. 142.5 DISPLAY_IDENTIFIER C_TCO_C_LAM_AD_WUP FORMAT "%6.2" /end CHARACTERISTIC
/begin CHARACTERISTIC c_tco_d_lam_ad_wup "Coolant temperature of point D for Lambda adaptation in warm up phase" VALUE 0xa1009617 _REC_VAL_20_u1 190.5 _CNV_A_R_LINEAR_____16_CM -48. 142.5 DISPLAY_IDENTIFIER C_TCO_D_LAM_AD_WUP FORMAT "%6.2" /end CHARACTERISTIC
/begin CHARACTERISTIC c_tco_e_lam_ad_wup "Coolant temperature of point E for Lambda adaptation in warm up phase" VALUE 0xa1009618 _REC_VAL_20_u1 190.5 _CNV_A_R_LINEAR_____16_CM -48. 142.5 DISPLAY_IDENTIFIER C_TCO_E_LAM_AD_WUP FORMAT "%6.2" /end CHARACTERISTIC
/begin CHARACTERISTIC c_tco_f_lam_ad_wup "Coolant temperature of point F for Lambda adaptation in warm up phase" VALUE 0xa1009619 _REC_VAL_20_u1 190.5 _CNV_A_R_LINEAR_____16_CM -48. 142.5 DISPLAY_IDENTIFIER C_TCO_F_LAM_AD_WUP FORMAT "%6.2" /end CHARACTERISTIC
/begin CHARACTERISTIC c_temp_dif_tco_st_tco_min_estim "Estimated temperature difference between TCO_ST and lowest temperature valid for learning adaptation value in warm up phase" VALUE 0xa1009622 _REC_VAL_20_u1 190.5 _CNV_A_R_LINEAR_____16_CM -48. 142.5 DISPLAY_IDENTIFIER C_TEMP_DIF_TCO_ST_TCO_MIN_ESTIM FORMAT "%6.2" /end CHARACTERISTIC
/begin CHARACTERISTIC c_tco_lam_ad_wup_rng "Temperature window for learning of adaptations value in warm up pahse" VALUE 0xa100961a _REC_VAL_20_u2 190.5 _CNV_A_R_LACO_LINEA_378_CM 0. 190.5 DISPLAY_IDENTIFIER C_TCO_LAM_AD_WUP_RNG FORMAT "%7.3" /end CHARACTERISTIC
/begin CHARACTERISTIC c_t_max_lam_ad_wup_is "Thrshold for elasped time spent in engine idle speed state for learning of adaptation value in warm up phase" VALUE 0xa100960e _REC_VAL_20_u2 6553.5 _CNV_A_R_LINEAR_____4_CM 0. 6553.5 DISPLAY_IDENTIFIER C_T_MAX_LAM_AD_WUP_IS FORMAT "%6.1" /end CHARACTERISTIC
/begin MEASUREMENT n_delta_ldc "difference between N and moving mean value of N for limited dynamics detection" SWORD _CNV_A_R_LINEAR_____13_CM 1 100. -8160. 8160. DISPLAY_IDENTIFIER N_DELTA_LDC ECU_ADDRESS 0xd0002b6e FORMAT "%5.0" /end MEASUREMENT
/begin MEASUREMENT maf_delta_ldc "difference between MAF and moving mean value of MAF for limited dynamics detection" SWORD _CNV_A_R_LINEAR_____202_CM 1 100. -694.510597390707 694.4894026092931 DISPLAY_IDENTIFIER MAF_DELTA_LDC ECU_ADDRESS 0xd0002b6a FORMAT "%7.2" /end MEASUREMENT
/begin MEASUREMENT maf_mmv_ldc "moving mean value of MAF for limited dynamics detection" UWORD _CNV_A_R_LINEAR_____108_CM 1 100. 0. 1389. DISPLAY_IDENTIFIER MAF_MMV_LDC ECU_ADDRESS 0xc0002576 FORMAT "%7.2" /end MEASUREMENT
/begin MEASUREMENT pv_av_delta_ldc "difference between pedal value and moving mean value of pedal value for limited dynamics detection" SBYTE _CNV_A_R_LINEAR_____5_CM 1 100. -50. 49.609375 DISPLAY_IDENTIFIER PV_AV_DELTA_LDC ECU_ADDRESS 0xd0002f28 FORMAT "%10.6" /end MEASUREMENT
/begin MEASUREMENT pv_av_mmv_ldc "moving mean value of pedal value for limited dynamics detection" UBYTE _CNV_A_R_LINEAR_____5_CM 1 100. 0. 99.609375 DISPLAY_IDENTIFIER PV_AV_MMV_LDC ECU_ADDRESS 0xc0002580 FORMAT "%9.6" /end MEASUREMENT
/begin CHARACTERISTIC c_crlc_n_mmv_ldc "correlation constant for moving mean value calculation of N for limited dynamics" VALUE 0xa1009540 _REC_VAL_20_u2 0.9999847412109381 _CNV_A_R_LINEAR_____68_CM 0. 0.9999847412109381 DISPLAY_IDENTIFIER C_CRLC_N_MMV_LDC FORMAT "%7.5" /end CHARACTERISTIC
/begin CHARACTERISTIC c_crlc_maf_mmv_ldc "correlation constant for moving mean value calculation of MAF for limited dynamics" VALUE 0xa100953e _REC_VAL_20_u2 0.9999847412109381 _CNV_A_R_LINEAR_____68_CM 0. 0.9999847412109381 DISPLAY_IDENTIFIER C_CRLC_MAF_MMV_LDC FORMAT "%7.5" /end CHARACTERISTIC
/begin CHARACTERISTIC c_crlc_pv_av_mmv_ldc "correlation constant for moving mean value calculation of pedal value for limited dynamics" VALUE 0xa1009542 _REC_VAL_20_u2 0.9999847412109381 _CNV_A_R_LINEAR_____68_CM 0. 0.9999847412109381 DISPLAY_IDENTIFIER C_CRLC_PV_AV_MMV_LDC FORMAT "%7.5" /end CHARACTERISTIC
/begin MEASUREMENT n_mmv_ldc "moving mean value of N for limited dynamics detection" UWORD _CNV_A_R_LINEAR_____13_CM 1 100. 0. 8160. DISPLAY_IDENTIFIER N_MMV_LDC ECU_ADDRESS 0xc000257a FORMAT "%4.0" /end MEASUREMENT
/begin MEASUREMENT laco[0].laco_struct_ispclada0.mff_lam_add_lam_ad_out "fuel mass set point offset, output from lambda adaptation, input into lamda controller" SWORD _CNV_A_R_LINEAR_____202_CM 1 100. -694.510597390707 694.4894026092931 DISPLAY_IDENTIFIER MFF_LAM_ADD_LAM_AD_OUT[1] ECU_ADDRESS 0xd00020e0 FORMAT "%7.2" /end MEASUREMENT
/begin MEASUREMENT laco[0].laco_struct_ispclada0.fac_lam_ad_lam_out "fuel mass set point factor, output from lambda adaptation, input into lamda controller" SWORD _CNV_A_R_LINEAR_____110_CM 1 100. -50. 49.9984741210938 DISPLAY_IDENTIFIER FAC_LAM_AD_LAM_OUT[1] ECU_ADDRESS 0xd00020e2 FORMAT "%7.3" /end MEASUREMENT
/begin MEASUREMENT laco[0].laco_struct_ispclada0.fac_mff_add_lam_ad_out "relative lambda adaptation offset quotient" SWORD _CNV_A_R_LINEAR_____201_CM 1 100. -100. 99.9969482421875 DISPLAY_IDENTIFIER FAC_MFF_ADD_LAM_AD_OUT[1] ECU_ADDRESS 0xd00020e4 FORMAT "%8.3" /end MEASUREMENT
/begin MEASUREMENT laco[0].laco_struct_ispclada0.mff_add_lam_ad "fuel mass set point offset, stored value of lambda adaptation" SWORD _CNV_A_R_LINEAR_____202_CM 1 100. -694.510597390707 694.4894026092931 DISPLAY_IDENTIFIER MFF_ADD_LAM_AD[1] ECU_ADDRESS 0xd00020e6 FORMAT "%7.2" /end MEASUREMENT
/begin MEASUREMENT laco[0].laco_struct_ispclada0.mff_delta_add_lam_ad "difference of lambda adaptation offset to previous adaptation" SWORD _CNV_A_R_LINEAR_____202_CM 1 100. -694.510597390707 694.4894026092931 DISPLAY_IDENTIFIER MFF_DELTA_ADD_LAM_AD[1] ECU_ADDRESS 0xd00020e8 FORMAT "%7.2" /end MEASUREMENT
/begin MEASUREMENT laco[0].laco_struct_ispclada0.mff_delta_add_lam_ad_h_res "difference integral with high resolution of lambda adaptation offset" SWORD _CNV_A_R_LACO_LINEA_379_CM 1 100. -10.851728 10.851397 DISPLAY_IDENTIFIER MFF_DELTA_ADD_LAM_AD_H_RES[1] ECU_ADDRESS 0xd00020ea FORMAT "%8.4" /end MEASUREMENT
/begin MEASUREMENT laco[0].laco_struct_ispclada0.fac_lam_ad "fuel mass set point factor of lambda adaptation, interpolation of both factor areas" SWORD _CNV_A_R_LINEAR_____110_CM 1 100. -50. 49.9984741210938 DISPLAY_IDENTIFIER FAC_LAM_AD[1] ECU_ADDRESS 0xd00020ec FORMAT "%7.3" /end MEASUREMENT
/begin MEASUREMENT laco[0].laco_struct_ispclada0.fac_l_rng_lam_ad "fuel mass set point factor of low field, stored value of lambda adaptation" SWORD _CNV_A_R_LINEAR_____110_CM 1 100. -50. 49.9984741210938 DISPLAY_IDENTIFIER FAC_L_RNG_LAM_AD[1] ECU_ADDRESS 0xd00020ee FORMAT "%7.3" /end MEASUREMENT
/begin MEASUREMENT laco[0].laco_struct_ispclada0.fac_h_rng_lam_ad "fuel mass set point factor of high field, stored value of lambda adaptation" SWORD _CNV_A_R_LINEAR_____110_CM 1 100. -50. 49.9984741210938 DISPLAY_IDENTIFIER FAC_H_RNG_LAM_AD[1] ECU_ADDRESS 0xd00020f0 FORMAT "%7.3" /end MEASUREMENT
/begin MEASUREMENT laco[0].laco_struct_ispclada0.fac_delta_l_rng_lam_ad "difference of lambda adaptation factor of low field to previous adaptation" SWORD _CNV_A_R_LINEAR_____110_CM 1 100. -50. 49.9984741210938 DISPLAY_IDENTIFIER FAC_DELTA_L_RNG_LAM_AD[1] ECU_ADDRESS 0xd00020f2 FORMAT "%7.3" /end MEASUREMENT
/begin MEASUREMENT laco[0].laco_struct_ispclada0.fac_delta_h_rng_lam_ad "difference of lambda adaptation factor of high field to previous adaptation" SWORD _CNV_A_R_LINEAR_____110_CM 1 100. -50. 49.9984741210938 DISPLAY_IDENTIFIER FAC_DELTA_H_RNG_LAM_AD[1] ECU_ADDRESS 0xd00020f4 FORMAT "%7.3" /end MEASUREMENT
/begin MEASUREMENT laco[0].laco_struct_ispclada0.fac_lam_adj_lam_ad "output value from lambda adaptation for the lambda controller shift" SWORD _CNV_A_R_LINEAR_____110_CM 1 100. -50. 49.9984741210938 DISPLAY_IDENTIFIER FAC_LAM_ADJ_LAM_AD[1] ECU_ADDRESS 0xd00020f6 FORMAT "%7.3" /end MEASUREMENT
/begin MEASUREMENT laco[0].laco_struct_ispclada0.fac_mff_add_fac_lam_ad "lambda adaptation correction for scan tool" SWORD _CNV_A_R_LINEAR_____201_CM 1 100. -100. 99.9969482421875 DISPLAY_IDENTIFIER FAC_MFF_ADD_FAC_LAM_AD[1] ECU_ADDRESS 0xd00020f8 FORMAT "%8.3" /end MEASUREMENT
/begin MEASUREMENT laco[0].laco_struct_ispclada0.fac_lam_tco_min "Lambda controller output at TCO_MIN_LAM_AD_WUP" SWORD _CNV_A_R_LINEAR_____110_CM 1 100. -50. 49.9984741210938 DISPLAY_IDENTIFIER FAC_LAM_TCO_MIN[1] ECU_ADDRESS 0xd00020fa FORMAT "%7.3" /end MEASUREMENT
/begin MEASUREMENT laco[0].laco_struct_ispclada0.fac_lam_ad_wup "Fuel mass set point factor of lambda adaptation in warm up phase" SWORD _CNV_A_R_LINEAR_____110_CM 1 100. -50. 49.9984741210938 DISPLAY_IDENTIFIER FAC_LAM_AD_WUP[1] ECU_ADDRESS 0xd00020fc FORMAT "%7.3" /end MEASUREMENT
/begin MEASUREMENT laco[0].laco_struct_ispclada0.fac_lam_adj_lam_ad_wup "Output value from lambda adaptation in warm up phase for the lambda controller shift" SWORD _CNV_A_R_LINEAR_____110_CM 1 100. -50. 49.9984741210938 DISPLAY_IDENTIFIER FAC_LAM_ADJ_LAM_AD_WUP[1] ECU_ADDRESS 0xd00020fe FORMAT "%7.3" /end MEASUREMENT
/begin MEASUREMENT laco[0].laco_struct_ispclada0.fac_lam_dif_lam_ad_wup_mv "Average value of Lambda controller output for Lambda adaptation in warm up phase" SWORD _CNV_A_R_LINEAR_____110_CM 1 100. -50. 49.9984741210938 DISPLAY_IDENTIFIER FAC_LAM_DIF_LAM_AD_WUP_MV[1] ECU_ADDRESS 0xd0002100 FORMAT "%7.3" /end MEASUREMENT
/begin MEASUREMENT laco[0].laco_struct_ispclada0.fac_lam_tco_a "Lambda controller output at C_TCO_A_LAM_AD_WUP" SWORD _CNV_A_R_LINEAR_____110_CM 1 100. -50. 49.9984741210938 DISPLAY_IDENTIFIER FAC_LAM_TCO_A[1] ECU_ADDRESS 0xd0002102 FORMAT "%7.3" /end MEASUREMENT
/begin MEASUREMENT laco[0].laco_struct_ispclada0.fac_lam_tco_b "Lambda controller output at C_TCO_B_LAM_AD_WUP" SWORD _CNV_A_R_LINEAR_____110_CM 1 100. -50. 49.9984741210938 DISPLAY_IDENTIFIER FAC_LAM_TCO_B[1] ECU_ADDRESS 0xd0002104 FORMAT "%7.3" /end MEASUREMENT
/begin MEASUREMENT laco[0].laco_struct_ispclada0.fac_lam_tco_c "Lambda controller output at C_TCO_C_LAM_AD_WUP" SWORD _CNV_A_R_LINEAR_____110_CM 1 100. -50. 49.9984741210938 DISPLAY_IDENTIFIER FAC_LAM_TCO_C[1] ECU_ADDRESS 0xd0002106 FORMAT "%7.3" /end MEASUREMENT
/begin MEASUREMENT laco[0].laco_struct_ispclada0.fac_lam_tco_d "Lambda controller output at C_TCO_D_LAM_AD_WUP" SWORD _CNV_A_R_LINEAR_____110_CM 1 100. -50. 49.9984741210938 DISPLAY_IDENTIFIER FAC_LAM_TCO_D[1] ECU_ADDRESS 0xd0002108 FORMAT "%7.3" /end MEASUREMENT
/begin MEASUREMENT laco[0].laco_struct_ispclada0.fac_lam_tco_e "Lambda controller output at C_TCO_E_LAM_AD_WUP" SWORD _CNV_A_R_LINEAR_____110_CM 1 100. -50. 49.9984741210938 DISPLAY_IDENTIFIER FAC_LAM_TCO_E[1] ECU_ADDRESS 0xd000210a FORMAT "%7.3" /end MEASUREMENT
/begin MEASUREMENT laco[0].laco_struct_ispclada0.t_pri_lam_ad "priority time for next requested lambda adaptation" UWORD _CNV_A_R_LINEAR_____4_CM 1 100. 0. 6553.5 DISPLAY_IDENTIFIER T_PRI_LAM_AD[1] ECU_ADDRESS 0xd000210c FORMAT "%6.1" /end MEASUREMENT
/begin MEASUREMENT laco[0].laco_struct_ispclada0.t_lam_ad_wup_is "Timer to have valid engine idle state phase for Lambda adaptation in warm up phase" UWORD _CNV_A_R_LINEAR_____4_CM 1 100. 0. 6553.5 DISPLAY_IDENTIFIER T_LAM_AD_WUP_IS[1] ECU_ADDRESS 0xd000210e FORMAT "%6.1" /end MEASUREMENT
/begin MEASUREMENT laco[0].laco_struct_ispclada0.ctr_raf_chg_lam_ad "counter indicating the number lean rich changes" UBYTE _CNV_A_R_LINEAR_____0_CM 1 100. 0. 255. DISPLAY_IDENTIFIER CTR_RAF_CHG_LAM_AD[1] ECU_ADDRESS 0xd0002110 FORMAT "%3.0" /end MEASUREMENT
/begin MEASUREMENT laco[0].laco_struct_ispclada0.ctr_tco_min_inter "Counter for detection of TCO_MIN_INTER_LAM_AD_WUP" UBYTE _CNV_A_R_LINEAR_____0_CM 1 100. 0. 255. DISPLAY_IDENTIFIER CTR_TCO_MIN_INTER[1] ECU_ADDRESS 0xd0002111 FORMAT "%3.0" /end MEASUREMENT
/begin MEASUREMENT laco[0].laco_struct_ispclada0.tco_min_lam_ad_wup "Minimum TCO of all driving cycles where learning conditions for Lambda adaptation in warm up phase are fulfilled" UBYTE _CNV_A_R_LINEAR_____16_CM 1 100. -48. 142.5 DISPLAY_IDENTIFIER TCO_MIN_LAM_AD_WUP[1] ECU_ADDRESS 0xd0002112 FORMAT "%6.2" /end MEASUREMENT
/begin MEASUREMENT laco[0].laco_struct_ispclada0.tco_min_inter_lam_ad_wup "Minimum TCO of current driving cycles where learning conditions for Lambda adaptation in warm up phase are fulfilled" UBYTE _CNV_A_R_LINEAR_____16_CM 1 100. -48. 142.5 DISPLAY_IDENTIFIER TCO_MIN_INTER_LAM_AD_WUP[1] ECU_ADDRESS 0xd0002113 FORMAT "%6.2" /end MEASUREMENT
/begin MEASUREMENT laco[0].laco_struct_ispclada0.state_lam_ad "state of lambda adaptation" UBYTE _CNV_S_8_LACO_RANGE_380_CM 1 100. 0. 7. DISPLAY_IDENTIFIER STATE_LAM_AD[1] ECU_ADDRESS 0xd0002114 /end MEASUREMENT
/begin MEASUREMENT laco[0].laco_struct_ispclada0.lv_fac_lam_adj_lam_ad "flag to request lambda controller shift" UBYTE _CNV_S_2_RANGE__0___1_CM 1 100. 0. 1. DISPLAY_IDENTIFIER LV_FAC_LAM_ADJ_LAM_AD[1] ECU_ADDRESS 0xd0002115 BIT_MASK 0x1 /end MEASUREMENT
/begin MEASUREMENT laco[0].laco_struct_ispclada0.lv_lam_ad_stop "logical varialble indicating stop of the lambda adaptation cycle" UBYTE _CNV_S_2_RANGE__0___1_CM 1 100. 0. 1. DISPLAY_IDENTIFIER LV_LAM_AD_STOP[1] ECU_ADDRESS 0xd0002116 BIT_MASK 0x1 /end MEASUREMENT
/begin MEASUREMENT laco[0].laco_struct_ispclada0.lv_fac_l_rng_lim_max_lam_ad "flag indicating top limitation of lambda adaptation factor of lower area" UBYTE _CNV_S_2_RANGE__0___1_CM 1 100. 0. 1. DISPLAY_IDENTIFIER LV_FAC_L_RNG_LIM_MAX_LAM_AD[1] ECU_ADDRESS 0xd0002117 BIT_MASK 0x1 /end MEASUREMENT
/begin MEASUREMENT laco[0].laco_struct_ispclada0.lv_fac_l_rng_lim_min_lam_ad "flag indicating bottom limitation of lambda adaptation factor of lower area" UBYTE _CNV_S_2_RANGE__0___1_CM 1 100. 0. 1. DISPLAY_IDENTIFIER LV_FAC_L_RNG_LIM_MIN_LAM_AD[1] ECU_ADDRESS 0xd0002118 BIT_MASK 0x1 /end MEASUREMENT
/begin MEASUREMENT laco[0].laco_struct_ispclada0.lv_fac_h_rng_lim_max_lam_ad "flag indicating top limitation of lambda adaptation factor of upper area" UBYTE _CNV_S_2_RANGE__0___1_CM 1 100. 0. 1. DISPLAY_IDENTIFIER LV_FAC_H_RNG_LIM_MAX_LAM_AD[1] ECU_ADDRESS 0xd0002119 BIT_MASK 0x1 /end MEASUREMENT
/begin MEASUREMENT laco[0].laco_struct_ispclada0.lv_fac_h_rng_lim_min_lam_ad "flag indicating bottom limitation of lambda adaptation factor of upper area" UBYTE _CNV_S_2_RANGE__0___1_CM 1 100. 0. 1. DISPLAY_IDENTIFIER LV_FAC_H_RNG_LIM_MIN_LAM_AD[1] ECU_ADDRESS 0xd000211a BIT_MASK 0x1 /end MEASUREMENT
/begin MEASUREMENT laco[0].laco_struct_ispclada0.lv_mff_add_lim_max_lam_ad "flag indicating top limitation of lambda adaptation offset" UBYTE _CNV_S_2_RANGE__0___1_CM 1 100. 0. 1. DISPLAY_IDENTIFIER LV_MFF_ADD_LIM_MAX_LAM_AD[1] ECU_ADDRESS 0xd000211b BIT_MASK 0x1 /end MEASUREMENT
/begin MEASUREMENT laco[0].laco_struct_ispclada0.lv_mff_add_lim_min_lam_ad "flag indicating bottom limitation of lambda adaptation offset" UBYTE _CNV_S_2_RANGE__0___1_CM 1 100. 0. 1. DISPLAY_IDENTIFIER LV_MFF_ADD_LIM_MIN_LAM_AD[1] ECU_ADDRESS 0xd000211c BIT_MASK 0x1 /end MEASUREMENT
/begin MEASUREMENT laco[0].laco_struct_ispclada0.lv_fac_h_rng_lam_ad "flag indicating that lambda adaptation in factor learning upper field is active" UBYTE _CNV_S_2_RANGE__0___1_CM 1 100. 0. 1. DISPLAY_IDENTIFIER LV_FAC_H_RNG_LAM_AD[1] ECU_ADDRESS 0xd000211d BIT_MASK 0x1 /end MEASUREMENT
/begin MEASUREMENT laco[0].laco_struct_ispclada0.lv_fac_l_rng_lam_ad "flag indicating that lambda adaptation in factor learning lower field is active" UBYTE _CNV_S_2_RANGE__0___1_CM 1 100. 0. 1. DISPLAY_IDENTIFIER LV_FAC_L_RNG_LAM_AD[1] ECU_ADDRESS 0xd000211e BIT_MASK 0x1 /end MEASUREMENT
/begin MEASUREMENT laco[0].laco_struct_ispclada0.lv_mff_add_rng_lam_ad "flag indicating that lambda adaptation in offset learning field is active" UBYTE _CNV_S_2_RANGE__0___1_CM 1 100. 0. 1. DISPLAY_IDENTIFIER LV_MFF_ADD_RNG_LAM_AD[1] ECU_ADDRESS 0xd000211f BIT_MASK 0x1 /end MEASUREMENT
/begin MEASUREMENT laco[0].laco_struct_ispclada0.lv_tco_min_inter_lam_ad_wup "Flag indicating that learning conditions for Lambda adaptation value in warm up phase are fulfilled" UBYTE _CNV_S_2_RANGE__0___1_CM 1 100. 0. 1. DISPLAY_IDENTIFIER LV_TCO_MIN_INTER_LAM_AD_WUP[1] ECU_ADDRESS 0xd0002120 BIT_MASK 0x1 /end MEASUREMENT
/begin MEASUREMENT laco[0].laco_struct_ispclada0.lv_tco_min_lam_ad_wup "Flag indicating that Lambda adaptation value in warm up phase at TCO_MIN_LAM_AD_WUP was updated" UBYTE _CNV_S_2_RANGE__0___1_CM 1 100. 0. 1. DISPLAY_IDENTIFIER LV_TCO_MIN_LAM_AD_WUP[1] ECU_ADDRESS 0xd0002121 BIT_MASK 0x1 /end MEASUREMENT
/begin MEASUREMENT laco[0].laco_struct_ispclada0.lv_lam_ad_wup_stop "Logical variable indicating need of Lambda controller shift to mirror shift in Lambda adaptation in warm up phase" UBYTE _CNV_S_2_RANGE__0___1_CM 1 100. 0. 1. DISPLAY_IDENTIFIER LV_LAM_AD_WUP_STOP[1] ECU_ADDRESS 0xd0002122 BIT_MASK 0x1 /end MEASUREMENT
/begin MEASUREMENT laco[0].laco_struct_ispclada0.lv_tco_d_lam_ad_wup "Flag indicating that Lambda adaptation value in warm up phase at C_TCO_D_LAM_AD_WUP was updated" UBYTE _CNV_A_R_LINEAR_____0_CM 1 100. 0. 1. DISPLAY_IDENTIFIER LV_TCO_D_LAM_AD_WUP[1] ECU_ADDRESS 0xd0002123 FORMAT "%1.0" BIT_MASK 0x1 /end MEASUREMENT
/begin MEASUREMENT laco[0].laco_struct_ispclada0.lv_tco_c_lam_ad_wup "Flag indicating that Lambda adaptation value in warm up phase at C_TCO_C_LAM_AD_WUP was updated" UBYTE _CNV_A_R_LINEAR_____0_CM 1 100. 0. 1. DISPLAY_IDENTIFIER LV_TCO_C_LAM_AD_WUP[1] ECU_ADDRESS 0xd0002124 FORMAT "%1.0" BIT_MASK 0x1 /end MEASUREMENT
/begin MEASUREMENT laco[0].laco_struct_ispclada0.lv_tco_b_lam_ad_wup "Flag indicating that Lambda adaptation value in warm up phase at C_TCO_B_LAM_AD_WUP was updated" UBYTE _CNV_A_R_LINEAR_____0_CM 1 100. 0. 1. DISPLAY_IDENTIFIER LV_TCO_B_LAM_AD_WUP[1] ECU_ADDRESS 0xd0002125 FORMAT "%1.0" BIT_MASK 0x1 /end MEASUREMENT
/begin MEASUREMENT laco[0].laco_struct_ispclada0.lv_tco_a_lam_ad_wup "Flag indicating that Lambda adaptation value in warm up phase at C_TCO_A_LAM_AD_WUP was updated" UBYTE _CNV_A_R_LINEAR_____0_CM 1 100. 0. 1. DISPLAY_IDENTIFIER LV_TCO_A_LAM_AD_WUP[1] ECU_ADDRESS 0xd0002126 FORMAT "%1.0" BIT_MASK 0x1 /end MEASUREMENT
/begin MEASUREMENT laco[0].laco_struct_ispclada0.lv_tco_e_lam_ad_wup "Flag indicating that Lambda adaptation value in warm up phase at C_TCO_E_LAM_AD_WUP was updated" UBYTE _CNV_A_R_LINEAR_____0_CM 1 100. 0. 1. DISPLAY_IDENTIFIER LV_TCO_E_LAM_AD_WUP[1] ECU_ADDRESS 0xd0002127 FORMAT "%1.0" BIT_MASK 0x1 /end MEASUREMENT
/begin MEASUREMENT laco[0].laco_struct_ispclada0.lv_fac_lam_adj_lam_ad_wup "Flag to request lambda controller shift from Lambda adaptation in warm up phase" UBYTE _CNV_S_2_RANGE__0___1_CM 1 100. 0. 1. DISPLAY_IDENTIFIER LV_FAC_LAM_ADJ_LAM_AD_WUP[1] ECU_ADDRESS 0xd0002128 BIT_MASK 0x1 /end MEASUREMENT
/begin MEASUREMENT laco[0].laco_struct_ispclmvldc0.fac_lam_mv_delta_ldc "difference between FAC_LAM_MV[i] and moving mean value of FAC_LAM_MV[i] for limited dynamics detection" SWORD _CNV_A_R_LINEAR_____110_CM 1 100. -50. 49.9984741210938 DISPLAY_IDENTIFIER FAC_LAM_MV_DELTA_LDC[1] ECU_ADDRESS 0xd000213c FORMAT "%7.3" /end MEASUREMENT
/begin MEASUREMENT laco[1].laco_struct_ispclada0.mff_lam_add_lam_ad_out "fuel mass set point offset, output from lambda adaptation, input into lamda controller" SWORD _CNV_A_R_LINEAR_____202_CM 1 100. -694.510597390707 694.4894026092931 DISPLAY_IDENTIFIER MFF_LAM_ADD_LAM_AD_OUT[2] ECU_ADDRESS 0xd0002258 FORMAT "%7.2" /end MEASUREMENT
/begin MEASUREMENT laco[1].laco_struct_ispclada0.fac_lam_ad_lam_out "fuel mass set point factor, output from lambda adaptation, input into lamda controller" SWORD _CNV_A_R_LINEAR_____110_CM 1 100. -50. 49.9984741210938 DISPLAY_IDENTIFIER FAC_LAM_AD_LAM_OUT[2] ECU_ADDRESS 0xd000225a FORMAT "%7.3" /end MEASUREMENT
/begin MEASUREMENT laco[1].laco_struct_ispclada0.fac_mff_add_lam_ad_out "relative lambda adaptation offset quotient" SWORD _CNV_A_R_LINEAR_____201_CM 1 100. -100. 99.9969482421875 DISPLAY_IDENTIFIER FAC_MFF_ADD_LAM_AD_OUT[2] ECU_ADDRESS 0xd000225c FORMAT "%8.3" /end MEASUREMENT
/begin MEASUREMENT laco[1].laco_struct_ispclada0.mff_add_lam_ad "fuel mass set point offset, stored value of lambda adaptation" SWORD _CNV_A_R_LINEAR_____202_CM 1 100. -694.510597390707 694.4894026092931 DISPLAY_IDENTIFIER MFF_ADD_LAM_AD[2] ECU_ADDRESS 0xd000225e FORMAT "%7.2" /end MEASUREMENT
/begin MEASUREMENT laco[1].laco_struct_ispclada0.mff_delta_add_lam_ad "difference of lambda adaptation offset to previous adaptation" SWORD _CNV_A_R_LINEAR_____202_CM 1 100. -694.510597390707 694.4894026092931 DISPLAY_IDENTIFIER MFF_DELTA_ADD_LAM_AD[2] ECU_ADDRESS 0xd0002260 FORMAT "%7.2" /end MEASUREMENT
/begin MEASUREMENT laco[1].laco_struct_ispclada0.mff_delta_add_lam_ad_h_res "difference integral with high resolution of lambda adaptation offset" SWORD _CNV_A_R_LACO_LINEA_379_CM 1 100. -10.851728 10.851397 DISPLAY_IDENTIFIER MFF_DELTA_ADD_LAM_AD_H_RES[2] ECU_ADDRESS 0xd0002262 FORMAT "%8.4" /end MEASUREMENT
/begin MEASUREMENT laco[1].laco_struct_ispclada0.fac_lam_ad "fuel mass set point factor of lambda adaptation, interpolation of both factor areas" SWORD _CNV_A_R_LINEAR_____110_CM 1 100. -50. 49.9984741210938 DISPLAY_IDENTIFIER FAC_LAM_AD[2] ECU_ADDRESS 0xd0002264 FORMAT "%7.3" /end MEASUREMENT
/begin MEASUREMENT laco[1].laco_struct_ispclada0.fac_l_rng_lam_ad "fuel mass set point factor of low field, stored value of lambda adaptation" SWORD _CNV_A_R_LINEAR_____110_CM 1 100. -50. 49.9984741210938 DISPLAY_IDENTIFIER FAC_L_RNG_LAM_AD[2] ECU_ADDRESS 0xd0002266 FORMAT "%7.3" /end MEASUREMENT
/begin MEASUREMENT laco[1].laco_struct_ispclada0.fac_h_rng_lam_ad "fuel mass set point factor of high field, stored value of lambda adaptation" SWORD _CNV_A_R_LINEAR_____110_CM 1 100. -50. 49.9984741210938 DISPLAY_IDENTIFIER FAC_H_RNG_LAM_AD[2] ECU_ADDRESS 0xd0002268 FORMAT "%7.3" /end MEASUREMENT
/begin MEASUREMENT laco[1].laco_struct_ispclada0.fac_delta_l_rng_lam_ad "difference of lambda adaptation factor of low field to previous adaptation" SWORD _CNV_A_R_LINEAR_____110_CM 1 100. -50. 49.9984741210938 DISPLAY_IDENTIFIER FAC_DELTA_L_RNG_LAM_AD[2] ECU_ADDRESS 0xd000226a FORMAT "%7.3" /end MEASUREMENT
/begin MEASUREMENT laco[1].laco_struct_ispclada0.fac_delta_h_rng_lam_ad "difference of lambda adaptation factor of high field to previous adaptation" SWORD _CNV_A_R_LINEAR_____110_CM 1 100. -50. 49.9984741210938 DISPLAY_IDENTIFIER FAC_DELTA_H_RNG_LAM_AD[2] ECU_ADDRESS 0xd000226c FORMAT "%7.3" /end MEASUREMENT
/begin MEASUREMENT laco[1].laco_struct_ispclada0.fac_lam_adj_lam_ad "output value from lambda adaptation for the lambda controller shift" SWORD _CNV_A_R_LINEAR_____110_CM 1 100. -50. 49.9984741210938 DISPLAY_IDENTIFIER FAC_LAM_ADJ_LAM_AD[2] ECU_ADDRESS 0xd000226e FORMAT "%7.3" /end MEASUREMENT
/begin MEASUREMENT laco[1].laco_struct_ispclada0.fac_mff_add_fac_lam_ad "lambda adaptation correction for scan tool" SWORD _CNV_A_R_LINEAR_____201_CM 1 100. -100. 99.9969482421875 DISPLAY_IDENTIFIER FAC_MFF_ADD_FAC_LAM_AD[2] ECU_ADDRESS 0xd0002270 FORMAT "%8.3" /end MEASUREMENT
/begin MEASUREMENT laco[1].laco_struct_ispclada0.fac_lam_tco_min "Lambda controller output at TCO_MIN_LAM_AD_WUP" SWORD _CNV_A_R_LINEAR_____110_CM 1 100. -50. 49.9984741210938 DISPLAY_IDENTIFIER FAC_LAM_TCO_MIN[2] ECU_ADDRESS 0xd0002272 FORMAT "%7.3" /end MEASUREMENT
/begin MEASUREMENT laco[1].laco_struct_ispclada0.fac_lam_ad_wup "Fuel mass set point factor of lambda adaptation in warm up phase" SWORD _CNV_A_R_LINEAR_____110_CM 1 100. -50. 49.9984741210938 DISPLAY_IDENTIFIER FAC_LAM_AD_WUP[2] ECU_ADDRESS 0xd0002274 FORMAT "%7.3" /end MEASUREMENT
/begin MEASUREMENT laco[1].laco_struct_ispclada0.fac_lam_adj_lam_ad_wup "Output value from lambda adaptation in warm up phase for the lambda controller shift" SWORD _CNV_A_R_LINEAR_____110_CM 1 100. -50. 49.9984741210938 DISPLAY_IDENTIFIER FAC_LAM_ADJ_LAM_AD_WUP[2] ECU_ADDRESS 0xd0002276 FORMAT "%7.3" /end MEASUREMENT
/begin MEASUREMENT laco[1].laco_struct_ispclada0.fac_lam_dif_lam_ad_wup_mv "Average value of Lambda controller output for Lambda adaptation in warm up phase" SWORD _CNV_A_R_LINEAR_____110_CM 1 100. -50. 49.9984741210938 DISPLAY_IDENTIFIER FAC_LAM_DIF_LAM_AD_WUP_MV[2] ECU_ADDRESS 0xd0002278 FORMAT "%7.3" /end MEASUREMENT
/begin MEASUREMENT laco[1].laco_struct_ispclada0.fac_lam_tco_a "Lambda controller output at C_TCO_A_LAM_AD_WUP" SWORD _CNV_A_R_LINEAR_____110_CM 1 100. -50. 49.9984741210938 DISPLAY_IDENTIFIER FAC_LAM_TCO_A[2] ECU_ADDRESS 0xd000227a FORMAT "%7.3" /end MEASUREMENT
/begin MEASUREMENT laco[1].laco_struct_ispclada0.fac_lam_tco_b "Lambda controller output at C_TCO_B_LAM_AD_WUP" SWORD _CNV_A_R_LINEAR_____110_CM 1 100. -50. 49.9984741210938 DISPLAY_IDENTIFIER FAC_LAM_TCO_B[2] ECU_ADDRESS 0xd000227c FORMAT "%7.3" /end MEASUREMENT
/begin MEASUREMENT laco[1].laco_struct_ispclada0.fac_lam_tco_c "Lambda controller output at C_TCO_C_LAM_AD_WUP" SWORD _CNV_A_R_LINEAR_____110_CM 1 100. -50. 49.9984741210938 DISPLAY_IDENTIFIER FAC_LAM_TCO_C[2] ECU_ADDRESS 0xd000227e FORMAT "%7.3" /end MEASUREMENT
/begin MEASUREMENT laco[1].laco_struct_ispclada0.fac_lam_tco_d "Lambda controller output at C_TCO_D_LAM_AD_WUP" SWORD _CNV_A_R_LINEAR_____110_CM 1 100. -50. 49.9984741210938 DISPLAY_IDENTIFIER FAC_LAM_TCO_D[2] ECU_ADDRESS 0xd0002280 FORMAT "%7.3" /end MEASUREMENT
/begin MEASUREMENT laco[1].laco_struct_ispclada0.fac_lam_tco_e "Lambda controller output at C_TCO_E_LAM_AD_WUP" SWORD _CNV_A_R_LINEAR_____110_CM 1 100. -50. 49.9984741210938 DISPLAY_IDENTIFIER FAC_LAM_TCO_E[2] ECU_ADDRESS 0xd0002282 FORMAT "%7.3" /end MEASUREMENT
/begin MEASUREMENT laco[1].laco_struct_ispclada0.t_pri_lam_ad "priority time for next requested lambda adaptation" UWORD _CNV_A_R_LINEAR_____4_CM 1 100. 0. 6553.5 DISPLAY_IDENTIFIER T_PRI_LAM_AD[2] ECU_ADDRESS 0xd0002284 FORMAT "%6.1" /end MEASUREMENT
/begin MEASUREMENT laco[1].laco_struct_ispclada0.t_lam_ad_wup_is "Timer to have valid engine idle state phase for Lambda adaptation in warm up phase" UWORD _CNV_A_R_LINEAR_____4_CM 1 100. 0. 6553.5 DISPLAY_IDENTIFIER T_LAM_AD_WUP_IS[2] ECU_ADDRESS 0xd0002286 FORMAT "%6.1" /end MEASUREMENT
/begin MEASUREMENT laco[1].laco_struct_ispclada0.ctr_raf_chg_lam_ad "counter indicating the number lean rich changes" UBYTE _CNV_A_R_LINEAR_____0_CM 1 100. 0. 255. DISPLAY_IDENTIFIER CTR_RAF_CHG_LAM_AD[2] ECU_ADDRESS 0xd0002288 FORMAT "%3.0" /end MEASUREMENT
/begin MEASUREMENT laco[1].laco_struct_ispclada0.ctr_tco_min_inter "Counter for detection of TCO_MIN_INTER_LAM_AD_WUP" UBYTE _CNV_A_R_LINEAR_____0_CM 1 100. 0. 255. DISPLAY_IDENTIFIER CTR_TCO_MIN_INTER[2] ECU_ADDRESS 0xd0002289 FORMAT "%3.0" /end MEASUREMENT
/begin MEASUREMENT laco[1].laco_struct_ispclada0.tco_min_lam_ad_wup "Minimum TCO of all driving cycles where learning conditions for Lambda adaptation in warm up phase are fulfilled" UBYTE _CNV_A_R_LINEAR_____16_CM 1 100. -48. 142.5 DISPLAY_IDENTIFIER TCO_MIN_LAM_AD_WUP[2] ECU_ADDRESS 0xd000228a FORMAT "%6.2" /end MEASUREMENT
/begin MEASUREMENT laco[1].laco_struct_ispclada0.tco_min_inter_lam_ad_wup "Minimum TCO of current driving cycles where learning conditions for Lambda adaptation in warm up phase are fulfilled" UBYTE _CNV_A_R_LINEAR_____16_CM 1 100. -48. 142.5 DISPLAY_IDENTIFIER TCO_MIN_INTER_LAM_AD_WUP[2] ECU_ADDRESS 0xd000228b FORMAT "%6.2" /end MEASUREMENT
/begin MEASUREMENT laco[1].laco_struct_ispclada0.state_lam_ad "state of lambda adaptation" UBYTE _CNV_S_8_LACO_RANGE_380_CM 1 100. 0. 7. DISPLAY_IDENTIFIER STATE_LAM_AD[2] ECU_ADDRESS 0xd000228c /end MEASUREMENT
/begin MEASUREMENT laco[1].laco_struct_ispclada0.lv_fac_lam_adj_lam_ad "flag to request lambda controller shift" UBYTE _CNV_S_2_RANGE__0___1_CM 1 100. 0. 1. DISPLAY_IDENTIFIER LV_FAC_LAM_ADJ_LAM_AD[2] ECU_ADDRESS 0xd000228d BIT_MASK 0x1 /end MEASUREMENT
/begin MEASUREMENT laco[1].laco_struct_ispclada0.lv_lam_ad_stop "logical varialble indicating stop of the lambda adaptation cycle" UBYTE _CNV_S_2_RANGE__0___1_CM 1 100. 0. 1. DISPLAY_IDENTIFIER LV_LAM_AD_STOP[2] ECU_ADDRESS 0xd000228e BIT_MASK 0x1 /end MEASUREMENT
/begin MEASUREMENT laco[1].laco_struct_ispclada0.lv_fac_l_rng_lim_max_lam_ad "flag indicating top limitation of lambda adaptation factor of lower area" UBYTE _CNV_S_2_RANGE__0___1_CM 1 100. 0. 1. DISPLAY_IDENTIFIER LV_FAC_L_RNG_LIM_MAX_LAM_AD[2] ECU_ADDRESS 0xd000228f BIT_MASK 0x1 /end MEASUREMENT
/begin MEASUREMENT laco[1].laco_struct_ispclada0.lv_fac_l_rng_lim_min_lam_ad "flag indicating bottom limitation of lambda adaptation factor of lower area" UBYTE _CNV_S_2_RANGE__0___1_CM 1 100. 0. 1. DISPLAY_IDENTIFIER LV_FAC_L_RNG_LIM_MIN_LAM_AD[2] ECU_ADDRESS 0xd0002290 BIT_MASK 0x1 /end MEASUREMENT
/begin MEASUREMENT laco[1].laco_struct_ispclada0.lv_fac_h_rng_lim_max_lam_ad "flag indicating top limitation of lambda adaptation factor of upper area" UBYTE _CNV_S_2_RANGE__0___1_CM 1 100. 0. 1. DISPLAY_IDENTIFIER LV_FAC_H_RNG_LIM_MAX_LAM_AD[2] ECU_ADDRESS 0xd0002291 BIT_MASK 0x1 /end MEASUREMENT
/begin MEASUREMENT laco[1].laco_struct_ispclada0.lv_fac_h_rng_lim_min_lam_ad "flag indicating bottom limitation of lambda adaptation factor of upper area" UBYTE _CNV_S_2_RANGE__0___1_CM 1 100. 0. 1. DISPLAY_IDENTIFIER LV_FAC_H_RNG_LIM_MIN_LAM_AD[2] ECU_ADDRESS 0xd0002292 BIT_MASK 0x1 /end MEASUREMENT
/begin MEASUREMENT laco[1].laco_struct_ispclada0.lv_mff_add_lim_max_lam_ad "flag indicating top limitation of lambda adaptation offset" UBYTE _CNV_S_2_RANGE__0___1_CM 1 100. 0. 1. DISPLAY_IDENTIFIER LV_MFF_ADD_LIM_MAX_LAM_AD[2] ECU_ADDRESS 0xd0002293 BIT_MASK 0x1 /end MEASUREMENT
/begin MEASUREMENT laco[1].laco_struct_ispclada0.lv_mff_add_lim_min_lam_ad "flag indicating bottom limitation of lambda adaptation offset" UBYTE _CNV_S_2_RANGE__0___1_CM 1 100. 0. 1. DISPLAY_IDENTIFIER LV_MFF_ADD_LIM_MIN_LAM_AD[2] ECU_ADDRESS 0xd0002294 BIT_MASK 0x1 /end MEASUREMENT
/begin MEASUREMENT laco[1].laco_struct_ispclada0.lv_fac_h_rng_lam_ad "flag indicating that lambda adaptation in factor learning upper field is active" UBYTE _CNV_S_2_RANGE__0___1_CM 1 100. 0. 1. DISPLAY_IDENTIFIER LV_FAC_H_RNG_LAM_AD[2] ECU_ADDRESS 0xd0002295 BIT_MASK 0x1 /end MEASUREMENT
/begin MEASUREMENT laco[1].laco_struct_ispclada0.lv_fac_l_rng_lam_ad "flag indicating that lambda adaptation in factor learning lower field is active" UBYTE _CNV_S_2_RANGE__0___1_CM 1 100. 0. 1. DISPLAY_IDENTIFIER LV_FAC_L_RNG_LAM_AD[2] ECU_ADDRESS 0xd0002296 BIT_MASK 0x1 /end MEASUREMENT
/begin MEASUREMENT laco[1].laco_struct_ispclada0.lv_mff_add_rng_lam_ad "flag indicating that lambda adaptation in offset learning field is active" UBYTE _CNV_S_2_RANGE__0___1_CM 1 100. 0. 1. DISPLAY_IDENTIFIER LV_MFF_ADD_RNG_LAM_AD[2] ECU_ADDRESS 0xd0002297 BIT_MASK 0x1 /end MEASUREMENT
/begin MEASUREMENT laco[1].laco_struct_ispclada0.lv_tco_min_inter_lam_ad_wup "Flag indicating that learning conditions for Lambda adaptation value in warm up phase are fulfilled" UBYTE _CNV_S_2_RANGE__0___1_CM 1 100. 0. 1. DISPLAY_IDENTIFIER LV_TCO_MIN_INTER_LAM_AD_WUP[2] ECU_ADDRESS 0xd0002298 BIT_MASK 0x1 /end MEASUREMENT
/begin MEASUREMENT laco[1].laco_struct_ispclada0.lv_tco_min_lam_ad_wup "Flag indicating that Lambda adaptation value in warm up phase at TCO_MIN_LAM_AD_WUP was updated" UBYTE _CNV_S_2_RANGE__0___1_CM 1 100. 0. 1. DISPLAY_IDENTIFIER LV_TCO_MIN_LAM_AD_WUP[2] ECU_ADDRESS 0xd0002299 BIT_MASK 0x1 /end MEASUREMENT
/begin MEASUREMENT laco[1].laco_struct_ispclada0.lv_lam_ad_wup_stop "Logical variable indicating need of Lambda controller shift to mirror shift in Lambda adaptation in warm up phase" UBYTE _CNV_S_2_RANGE__0___1_CM 1 100. 0. 1. DISPLAY_IDENTIFIER LV_LAM_AD_WUP_STOP[2] ECU_ADDRESS 0xd000229a BIT_MASK 0x1 /end MEASUREMENT
/begin MEASUREMENT laco[1].laco_struct_ispclada0.lv_tco_d_lam_ad_wup "Flag indicating that Lambda adaptation value in warm up phase at C_TCO_D_LAM_AD_WUP was updated" UBYTE _CNV_A_R_LINEAR_____0_CM 1 100. 0. 1. DISPLAY_IDENTIFIER LV_TCO_D_LAM_AD_WUP[2] ECU_ADDRESS 0xd000229b FORMAT "%1.0" BIT_MASK 0x1 /end MEASUREMENT
/begin MEASUREMENT laco[1].laco_struct_ispclada0.lv_tco_c_lam_ad_wup "Flag indicating that Lambda adaptation value in warm up phase at C_TCO_C_LAM_AD_WUP was updated" UBYTE _CNV_A_R_LINEAR_____0_CM 1 100. 0. 1. DISPLAY_IDENTIFIER LV_TCO_C_LAM_AD_WUP[2] ECU_ADDRESS 0xd000229c FORMAT "%1.0" BIT_MASK 0x1 /end MEASUREMENT
/begin MEASUREMENT laco[1].laco_struct_ispclada0.lv_tco_b_lam_ad_wup "Flag indicating that Lambda adaptation value in warm up phase at C_TCO_B_LAM_AD_WUP was updated" UBYTE _CNV_A_R_LINEAR_____0_CM 1 100. 0. 1. DISPLAY_IDENTIFIER LV_TCO_B_LAM_AD_WUP[2] ECU_ADDRESS 0xd000229d FORMAT "%1.0" BIT_MASK 0x1 /end MEASUREMENT
/begin MEASUREMENT laco[1].laco_struct_ispclada0.lv_tco_a_lam_ad_wup "Flag indicating that Lambda adaptation value in warm up phase at C_TCO_A_LAM_AD_WUP was updated" UBYTE _CNV_A_R_LINEAR_____0_CM 1 100. 0. 1. DISPLAY_IDENTIFIER LV_TCO_A_LAM_AD_WUP[2] ECU_ADDRESS 0xd000229e FORMAT "%1.0" BIT_MASK 0x1 /end MEASUREMENT
/begin MEASUREMENT laco[1].laco_struct_ispclada0.lv_tco_e_lam_ad_wup "Flag indicating that Lambda adaptation value in warm up phase at C_TCO_E_LAM_AD_WUP was updated" UBYTE _CNV_A_R_LINEAR_____0_CM 1 100. 0. 1. DISPLAY_IDENTIFIER LV_TCO_E_LAM_AD_WUP[2] ECU_ADDRESS 0xd000229f FORMAT "%1.0" BIT_MASK 0x1 /end MEASUREMENT
/begin MEASUREMENT laco[1].laco_struct_ispclada0.lv_fac_lam_adj_lam_ad_wup "Flag to request lambda controller shift from Lambda adaptation in warm up phase" UBYTE _CNV_S_2_RANGE__0___1_CM 1 100. 0. 1. DISPLAY_IDENTIFIER LV_FAC_LAM_ADJ_LAM_AD_WUP[2] ECU_ADDRESS 0xd00022a0 BIT_MASK 0x1 /end MEASUREMENT
/begin MEASUREMENT laco[1].laco_struct_ispclmvldc0.fac_lam_mv_delta_ldc "difference between FAC_LAM_MV[i] and moving mean value of FAC_LAM_MV[i] for limited dynamics detection" SWORD _CNV_A_R_LINEAR_____110_CM 1 100. -50. 49.9984741210938 DISPLAY_IDENTIFIER FAC_LAM_MV_DELTA_LDC[2] ECU_ADDRESS 0xd00022b4 FORMAT "%7.3" /end MEASUREMENT
/begin COMPU_METHOD _CNV_A_R_LINEAR_____0_CM "" RAT_FUNC "%6.3" "-" COEFFS 0 1. 0. 0 0 1 /end COMPU_METHOD
/begin COMPU_METHOD _CNV_S_2_RANGE__0___1_CM "" TAB_VERB "%6.3" "-" COMPU_TAB_REF _CNV_S_2_RANGE__0___1 /end COMPU_METHOD
/begin COMPU_VTAB _CNV_S_2_RANGE__0___1 "" TAB_VERB 2 0 "0" 1 "1" /end COMPU_VTAB
/begin COMPU_METHOD _CNV_A_R_LINEAR_____2_CM "" RAT_FUNC "%6.3" "V" COEFFS 0 204.8 0. 0 0 1 /end COMPU_METHOD
/begin COMPU_METHOD _CNV_A_R_LINEAR_____3_CM "" RAT_FUNC "%6.3" "s" COEFFS 0 100. 0. 0 0 1 /end COMPU_METHOD
/begin COMPU_METHOD _CNV_A_R_LINEAR_____4_CM "" RAT_FUNC "%6.3" "s" COEFFS 0 10. 0. 0 0 1 /end COMPU_METHOD
/begin COMPU_METHOD _CNV_A_R_LINEAR_____5_CM "" RAT_FUNC "%6.3" "%" COEFFS 0 2.56 0. 0 0 1 /end COMPU_METHOD
/begin COMPU_METHOD _CNV_A_R_LINEAR_____7_CM "" RAT_FUNC "%6.3" "%" COEFFS 0 655.3599999999997 0. 0 0 1 /end COMPU_METHOD
/begin COMPU_METHOD _CNV_A_R_LINEAR_____8_CM "" RAT_FUNC "%6.3" "-" COEFFS 0 32767.99999999992 0. 0 0 1 /end COMPU_METHOD
/begin COMPU_METHOD _CNV_A_R_LINEAR_____9_CM "" RAT_FUNC "%6.3" "rpm" COEFFS 0 3.125e-002 0. 0 0 1 /end COMPU_METHOD
/begin COMPU_METHOD _CNV_A_R_LINEAR_____13_CM "" RAT_FUNC "%6.3" "rpm" COEFFS 0 1. 0. 0 0 1 /end COMPU_METHOD
/begin COMPU_METHOD _CNV_A_R_LINEAR_____14_CM "" RAT_FUNC "%6.3" "mg/stk" COEFFS 0 0.183585313174946 0. 0 0 1 /end COMPU_METHOD
/begin COMPU_METHOD _CNV_A_R_LINEAR_____16_CM "" RAT_FUNC "%6.3" "°C" COEFFS 0 1.333333333333333 64. 0 0 1 /end COMPU_METHOD
/begin COMPU_METHOD _CNV_A_R_LINEAR_____23_CM "" RAT_FUNC "%6.3" "-" COEFFS 0 16384. 0. 0 0 1 /end COMPU_METHOD
/begin COMPU_METHOD _CNV_A_R_LINEAR_____27_CM "" RAT_FUNC "%6.3" "-" COEFFS 0 256. 0. 0 0 1 /end COMPU_METHOD
/begin COMPU_METHOD _CNV_A_R_LINEAR_____68_CM "" RAT_FUNC "%6.3" "-" COEFFS 0 65535.99999999996 0. 0 0 1 /end COMPU_METHOD
/begin COMPU_METHOD _CNV_A_R_LINEAR_____100_CM "" RAT_FUNC "%6.3" "-" COEFFS 0 128. 0. 0 0 1 /end COMPU_METHOD
/begin COMPU_METHOD _CNV_A_R_LINEAR_____107_CM "" RAT_FUNC "%6.3" "s" COEFFS 0 50. 0. 0 0 1 /end COMPU_METHOD
/begin COMPU_METHOD _CNV_A_R_LINEAR_____108_CM "" RAT_FUNC "%6.3" "mg/stk" COEFFS 0 47.18142548596112 0. 0 0 1 /end COMPU_METHOD
/begin COMPU_METHOD _CNV_A_R_LINEAR_____110_CM "" RAT_FUNC "%6.3" "%" COEFFS 0 655.3599999999997 -1.455191522836685e-011 0 0 1 /end COMPU_METHOD
/begin COMPU_METHOD _CNV_A_R_LINEAR_____117_CM "" RAT_FUNC "%6.3" "s" COEFFS 0 32767.99999999992 0. 0 0 1 /end COMPU_METHOD
/begin COMPU_METHOD _CNV_A_R_LINEAR_____122_CM "" RAT_FUNC "%6.3" "-" COEFFS 0 1024. 0. 0 0 1 /end COMPU_METHOD
/begin COMPU_METHOD _CNV_A_R_LINEAR_____159_CM "" RAT_FUNC "%6.3" "%" COEFFS 0 655.3600000071681 32768.00000035841 0 0 1 /end COMPU_METHOD
/begin COMPU_METHOD _CNV_A_R_LINEAR_____201_CM "" RAT_FUNC "%6.3" "%" COEFFS 0 327.68 0. 0 0 1 /end COMPU_METHOD
/begin COMPU_METHOD _CNV_A_R_LINEAR_____202_CM "" RAT_FUNC "%6.3" "mg/stk" COEFFS 0 47.18142548596112 -1.455191522836685e-011 0 0 1 /end COMPU_METHOD
/begin COMPU_METHOD _CNV_A_R_LINEAR_____204_CM "" RAT_FUNC "%6.3" "°C" COEFFS 0 16. 4370.4 0 0 1 /end COMPU_METHOD
/begin COMPU_METHOD _CNV_A_R_LINEAR_____207_CM "" RAT_FUNC "%6.3" "kg/h" COEFFS 0 32. 0. 0 0 1 /end COMPU_METHOD
/begin COMPU_METHOD _CNV_A_R_LINEAR_____329_CM "" RAT_FUNC "%6.3" "g" COEFFS 0 22.49999999999997 0. 0 0 1 /end COMPU_METHOD
/begin COMPU_METHOD _CNV_A_R_EGCP_LINEA_330_CM "Battery voltage" RAT_FUNC "%6.3" "-" COEFFS 0 1024.000007000107 0. 0 0 1 /end COMPU_METHOD
/begin COMPU_METHOD _CNV_A_R_LINEAR_____356_CM "" RAT_FUNC "%6.3" "g" COEFFS 0 35.99993408114611 0. 0 0 1 /end COMPU_METHOD
/begin COMPU_METHOD _CNV_A_R_EGCP_LINEA_363_CM "" RAT_FUNC "%6.3" "-" COEFFS 0 1024.003612233215 0. 0 0 1 /end COMPU_METHOD
/begin COMPU_METHOD _CNV_S_4_EGCP_RANGE_364_CM "" TAB_VERB "%6.3" "-" COMPU_TAB_REF _CNV_S_4_EGCP_RANGE_364 /end COMPU_METHOD
/begin COMPU_VTAB _CNV_S_4_EGCP_RANGE_364 "" TAB_VERB 4 0 "SENS_OK" 1 "SENS_AFL" 2 "SENS_AFR" 4 "SENS_NOT_ACT" /end COMPU_VTAB
/begin COMPU_METHOD _CNV_S_4_EGCP_RANGE_365_CM "" TAB_VERB "%6.3" "-" COMPU_TAB_REF _CNV_S_4_EGCP_RANGE_365 /end COMPU_METHOD
/begin COMPU_VTAB _CNV_S_4_EGCP_RANGE_365 "" TAB_VERB 4 0 "VLS_OK" 1 "VLS_L" 2 "VLS_H_OC" 3 "VLS_AFS_OC" /end COMPU_VTAB
/begin COMPU_METHOD _CNV_S_4_EGCP_RANGE_366_CM "" TAB_VERB "%6.3" "-" COMPU_TAB_REF _CNV_S_4_EGCP_RANGE_366 /end COMPU_METHOD
/begin COMPU_VTAB _CNV_S_4_EGCP_RANGE_366 "" TAB_VERB 4 0 "PASSIVE" 1 "WAIT" 2 "ACQUISITION" 3 "END" /end COMPU_VTAB
/begin COMPU_METHOD _CNV_A_R_EGCP_LINEA_367_CM "" RAT_FUNC "%6.3" "s" COEFFS 0 1000. 0. 0 0 1 /end COMPU_METHOD
/begin COMPU_METHOD _CNV_A_R_LINEAR_____369_CM "" RAT_FUNC "%6.3" "V" COEFFS 0 204.7999999487896 -2.556795379859977e-007 0 0 1 /end COMPU_METHOD
/begin COMPU_METHOD _CNV_A_R_EGCP_LINEA_370_CM "" RAT_FUNC "%6.3" "-" COEFFS 0 8. 0. 0 0 1 /end COMPU_METHOD
/begin COMPU_METHOD _CNV_A_R_EGCP_LINEA_374_CM "" RAT_FUNC "%6.3" "-" COEFFS 0 16383.9953897502 0. 0 0 1 /end COMPU_METHOD
/begin COMPU_METHOD _CNV_A_R_LINEAR_____375_CM "" RAT_FUNC "%6.3" "s" COEFFS 0 64000.02343786621 0. 0 0 1 /end COMPU_METHOD
/begin COMPU_METHOD _CNV_A_R_LACO_LINEA_376_CM "" RAT_FUNC "%6.3" "V" COEFFS 0 204.799999948775 1023.999999743875 0 0 1 /end COMPU_METHOD
/begin COMPU_METHOD _CNV_A_R_LACO_LINEA_377_CM "" RAT_FUNC "%6.3" "mg/stk" COEFFS 0 47.18142548596112 32767.99998156587 0 0 1 /end COMPU_METHOD
/begin COMPU_METHOD _CNV_A_R_LACO_LINEA_378_CM "" RAT_FUNC "%6.3" "°C" COEFFS 0 341.3333333333333 0. 0 0 1 /end COMPU_METHOD
/begin COMPU_METHOD _CNV_A_R_LACO_LINEA_379_CM "" RAT_FUNC "%6.3" "mg/stk" COEFFS 0 3019.611231101512 -2.543412556406111e-004 0 0 1 /end COMPU_METHOD
/begin COMPU_METHOD _CNV_S_8_LACO_RANGE_380_CM "" TAB_VERB "%6.3" "-" COMPU_TAB_REF _CNV_S_8_LACO_RANGE_380 /end COMPU_METHOD
/begin COMPU_VTAB _CNV_S_8_LACO_RANGE_380 "" TAB_VERB 8 0 "INIT" 1 "WAIT" 2 "CDN_FAC_L" 3 "CDN_FAC_H" 4 "CDN_ADD" 5 "ADAPT_FAC_L" 6 "ADAPT_FAC_H" 7 "ADAPT_ADD" /end COMPU_VTAB
/begin RECORD_LAYOUT _REC_VAL_20_u1 FNC_VALUES 1 UBYTE COLUMN_DIR DIRECT /end RECORD_LAYOUT
/begin RECORD_LAYOUT _REC_VAL_20_u2 FNC_VALUES 1 UWORD COLUMN_DIR DIRECT /end RECORD_LAYOUT
/begin RECORD_LAYOUT _REC_AXS_20_u1 NO_AXIS_PTS_X 1 UBYTE AXIS_PTS_X 2 UBYTE INDEX_INCR DIRECT /end RECORD_LAYOUT
/begin RECORD_LAYOUT _REC_MAP_20_u2_u1_u1 FNC_VALUES 1 UWORD COLUMN_DIR DIRECT /end RECORD_LAYOUT
/begin RECORD_LAYOUT _REC_CUR_20_u1_u1 FNC_VALUES 1 UBYTE COLUMN_DIR DIRECT /end RECORD_LAYOUT
/begin RECORD_LAYOUT _REC_VAL_20_s2 FNC_VALUES 1 SWORD COLUMN_DIR DIRECT /end RECORD_LAYOUT
/begin RECORD_LAYOUT _REC_AXS_20_u2 NO_AXIS_PTS_X 1 UWORD AXIS_PTS_X 2 UWORD INDEX_INCR DIRECT /end RECORD_LAYOUT
/begin RECORD_LAYOUT _REC_CUR_20_u2_u1 FNC_VALUES 1 UWORD COLUMN_DIR DIRECT /end RECORD_LAYOUT
/begin RECORD_LAYOUT _REC_CUR_20_u2_u2 FNC_VALUES 1 UWORD COLUMN_DIR DIRECT /end RECORD_LAYOUT
/begin RECORD_LAYOUT _REC_CUR_20_u1_u2 FNC_VALUES 1 UBYTE COLUMN_DIR DIRECT /end RECORD_LAYOUT
/begin RECORD_LAYOUT _REC_MAP_20_u1_u1_u1 FNC_VALUES 1 UBYTE COLUMN_DIR DIRECT /end RECORD_LAYOUT
/begin RECORD_LAYOUT _REC_MAP_20_u1_u1_u2 FNC_VALUES 1 UBYTE COLUMN_DIR DIRECT /end RECORD_LAYOUT
/begin FUNCTION EGCP_Linear_O2_sensor_diag "Linear_O2_sensor_diag"
 /begin DEF_CHARACTERISTIC c_maf_kgh_max_diag_plaus_lsl_up c_vls_down_afl_plaus_lsl_up c_vls_down_afr_plaus_lsl_up c_tco_min_diag_plaus_lsl_up c_ctr_dec_diag_plaus_lsl_up c_ctr_thd_diag_plaus_lsl_up c_t_sym_diag_air_lsl_up c_t_end_diag_air_lsl_up c_ctr_min_diag_dyn_lsl_up c_ctr_min_diag_eol_dyn_lsl_up c_ctr_wait_diag_dyn_lsl_up c_lamb_min_diag_dyn_lsl_up c_lamb_max_diag_dyn_lsl_up lc_t1_ad_diag_dyn_lsl_up c_lamb_ampl_max_dyn_lsl_up c_lamb_ampl_min_dyn_lsl_up ip_lamb_ampl_max_dyn_lsl_up ip_lamb_ampl_min_dyn_lsl_up c_vls_down_afs_max_plaus_lsl_up c_n_min_diag_plaus_lsl_up c_lamb_afr_plaus_lsl_up c_vls_down_afs_min_plaus_lsl_up c_vls_up_afs_min_plaus_lsl_up c_vls_up_afs_max_plaus_lsl_up c_t_diag_plaus_end_lsl_up ip_t_sym_afr_afl_plaus_lsl_up ip_t_sym_afs_plaus_lsl_up c_cycnr_min_diag_dyn_lsl_up c_cycnr_end_diag_dyn_lsl_up c_cycnr_eol_diag_dyn_lsl_up c_n_max_diag_dyn_lsl_up c_maf_max_diag_dyn_lsl_up c_maf_min_diag_dyn_lsl_up c_fac_mv_thd_diag_dyn_lsl_up c_fac_ad_thd_diag_dyn_lsl_up c_crlc_lpf_fac_ad_dyn_lsl_up c_t_diag_sym_puc_lsl_up c_t_diag_sym_eol_puc_lsl_up c_t_dly_diag_puc_lsl_up c_t_dly_diag_eol_puc_lsl_up c_t_diag_end_puc_lsl_up c_lamb_min_raw_act_lsl_up c_lamb_max_raw_act_lsl_up c_ctr_sum_raw_act_lsl_up c_fac_dyn_int_act_lsl_up c_n_min_diag_dyn_lsl_up c_n_min_act_lsl_up c_t_diag_end_eol_puc_lsl_up c_t_sum_afl_afr_act_lsl_up c_lamb_afl_plaus_lsl_up c_lamb_sp_de_pls_act_lsl_up c_maf_kgh_min_diag_plaus_lsl_up c_maf_kgh_min_act_lsl_up c_ctr_inc_diag_plaus_lsl_up c_lamb_de_tot_act_lsl_up c_ctr_lamb_de_int_act_lsl_up c_ctr_sym_max_act_lsl_up c_ctr_sym_inc_act_lsl_up c_ctr_sym_dec_act_lsl_up c_crlc_lpf_lamb_diag_dyn_lsl_up c_crlc_act_lsl_up lc_diag_dyn_lsl_up_cat_syn lc_diag_act_lsl_up ldpm_maf_kgh_ip_t_diag_lsl_up id_ctr_inc_raw_act_lsl_up id_lamb_gain_act_lsl_up ldp_maf_kgh_id_ctr_act_lsl_up ldp_lamb_de_lsl_id_lamb_lsl_up ldp_fac_diag_dyn_lsl_up_id_lamb id_lamb_gain_ls_up_dyn c_fac_ad_rst_diag_dyn_lsl_up c_vls_up_diag_max_air_lsl_up c_vls_up_diag_afs_puc_lsl_up c_vls_up_diag_min_puc_lsl_up c_vls_up_diag_max_puc_lsl_up c_teg_min_plaus_lsl_up c_teg_max_plaus_lsl_up ip_t_dyn_diag c_teg_min_diag_puc_lsl_up /end DEF_CHARACTERISTIC
 /begin OUT_MEASUREMENT egcp[0].egcp_struct_sigdglsl2.lamb_mmv_act_lsl_up egcp[0].egcp_struct_sigdglsl2.lamb_de_tot_act_lsl_up egcp[0].egcp_struct_sigdglsl2.lamb_de_int_act_lsl_up egcp[0].egcp_struct_sigdglsl2.ctr_sum_raw_act_lsl_up egcp[0].egcp_struct_sigdglsl2.vls_up_diag_save_puc_lsl_up egcp[0].egcp_struct_sigdglsl2.t_max_diag_end_puc_lsl_up egcp[0].egcp_struct_sigdglsl2.t_max_diag_sym_puc_lsl_up egcp[0].egcp_struct_sigdglsl2.lamb_de_lsl egcp[0].egcp_struct_sigdglsl2.t_max_dly_diag_puc_lsl_up egcp[0].egcp_struct_sigdglsl2.lamb_lpf_diag_dyn_lsl_up egcp[0].egcp_struct_sigdglsl2.t_diag_plaus_end_lsl_up egcp[0].egcp_struct_sigdglsl2.t_sym_diag_air_lsl_up egcp[0].egcp_struct_sigdglsl2.t_end_diag_air_lsl_up egcp[0].egcp_struct_sigdglsl2.t_sym_afs_plaus_lsl_up egcp[0].egcp_struct_sigdglsl2.t_diag_end_puc_lsl_up egcp[0].egcp_struct_sigdglsl2.t_dly_diag_puc_lsl_up egcp[0].egcp_struct_sigdglsl2.t_diag_sym_puc_lsl_up egcp[0].egcp_struct_sigdglsl2.t_sym_afr_afl_plaus_lsl_up egcp[0].egcp_struct_sigdglsl2.lamb_min_diag_dyn_lsl_up egcp[0].egcp_struct_sigdglsl2.lamb_max_diag_dyn_lsl_up egcp[0].egcp_struct_sigdglsl2.lamb_ampl_int_diag_dyn_lsl_up egcp[0].egcp_struct_sigdglsl2.fac_value_diag_dyn_lsl_up egcp[0].egcp_struct_sigdglsl2.fac_sum_diag_dyn_lsl_up egcp[0].egcp_struct_sigdglsl2.fac_mv_diag_dyn_lsl_up egcp[0].egcp_struct_sigdglsl2.fac_diag_dyn_lsl_up egcp[0].egcp_struct_sigdglsl2.t_dyn_diag_afl egcp[0].egcp_struct_sigdglsl2.t_dyn_diag_afr egcp[0].egcp_struct_sigdglsl2.ctr_diag_plaus_lsl_up egcp[0].egcp_struct_sigdglsl2.lamb_ampl_diag_dyn_lsl_up egcp[0].egcp_struct_sigdglsl2.lamb_ampl_min_diag_dyn_lsl_up egcp[0].egcp_struct_sigdglsl2.lamb_ampl_max_diag_dyn_lsl_up egcp[0].egcp_struct_sigdglsl2.lamb_ampl_mv_diag_dyn_lsl_up egcp[0].egcp_struct_sigdglsl2.ctr_diag_dyn_lsl_up egcp[0].egcp_struct_sigdglsl2.ctr_wait_diag_dyn_lsl_up egcp[0].egcp_struct_sigdglsl2.cycnr_diag_dyn_lsl_up egcp[0].egcp_struct_sigdglsl2.ctr_sym_act_lsl_up egcp[0].egcp_struct_sigdglsl2.ctr_lamb_de_int_act_lsl_up egcp[0].egcp_struct_sigdglsl2.state_sym_diag_plaus_lsl_up egcp[0].egcp_struct_sigdglsl2.state_sym_diag_puc_lsl_up egcp[0].egcp_struct_sigdglsl2.state_dyn_diag egcp[0].egcp_struct_sigdglsl2.lv_diag_plaus_sym_lsl_up egcp[0].egcp_struct_sigdglsl2.lv_diag_cdn_plaus_lsl_up egcp[0].egcp_struct_sigdglsl2.lv_diag_plaus_end_lsl_up egcp[0].egcp_struct_sigdglsl2.lv_diag_dyn_sym_lsl_up egcp[0].egcp_struct_sigdglsl2.lv_diag_dyn_end_lsl_up egcp[0].egcp_struct_sigdglsl2.lv_diag_dyn_cdn_lsl_up egcp[0].egcp_struct_sigdglsl2.lv_diag_puc_sym_lsl_up egcp[0].egcp_struct_sigdglsl2.lv_diag_cdn_puc_lsl_up egcp[0].egcp_struct_sigdglsl2.lv_diag_puc_end_lsl_up egcp[0].egcp_struct_sigdglsl2.lv_lamb_pls_req_dyn_lsl_up egcp[0].egcp_struct_sigdglsl2.lv_lam_adj_req_dyn_lsl_up egcp[0].egcp_struct_sigdglsl2.lv_diag_afr_sym_plaus_lsl_up egcp[0].egcp_struct_sigdglsl2.lv_diag_afl_sym_plaus_lsl_up egcp[0].egcp_struct_sigdglsl2.lv_diag_raw_act_sym_lsl_up egcp[0].egcp_struct_sigdglsl2.lv_diag_act_sym_lsl_up egcp[0].egcp_struct_sigdglsl2.lv_diag_act_cdn_lsl_up egcp[0].egcp_struct_sigdglsl2.lv_diag_act_sho_cdn_lsl_up egcp[1].egcp_struct_sigdglsl2.lamb_mmv_act_lsl_up egcp[1].egcp_struct_sigdglsl2.lamb_de_tot_act_lsl_up egcp[1].egcp_struct_sigdglsl2.lamb_de_int_act_lsl_up egcp[1].egcp_struct_sigdglsl2.ctr_sum_raw_act_lsl_up egcp[1].egcp_struct_sigdglsl2.vls_up_diag_save_puc_lsl_up egcp[1].egcp_struct_sigdglsl2.t_max_diag_end_puc_lsl_up egcp[1].egcp_struct_sigdglsl2.t_max_diag_sym_puc_lsl_up egcp[1].egcp_struct_sigdglsl2.lamb_de_lsl egcp[1].egcp_struct_sigdglsl2.t_max_dly_diag_puc_lsl_up egcp[1].egcp_struct_sigdglsl2.lamb_lpf_diag_dyn_lsl_up egcp[1].egcp_struct_sigdglsl2.t_diag_plaus_end_lsl_up egcp[1].egcp_struct_sigdglsl2.t_sym_diag_air_lsl_up egcp[1].egcp_struct_sigdglsl2.t_end_diag_air_lsl_up egcp[1].egcp_struct_sigdglsl2.t_sym_afs_plaus_lsl_up egcp[1].egcp_struct_sigdglsl2.t_diag_end_puc_lsl_up egcp[1].egcp_struct_sigdglsl2.t_dly_diag_puc_lsl_up egcp[1].egcp_struct_sigdglsl2.t_diag_sym_puc_lsl_up egcp[1].egcp_struct_sigdglsl2.t_sym_afr_afl_plaus_lsl_up egcp[1].egcp_struct_sigdglsl2.lamb_min_diag_dyn_lsl_up egcp[1].egcp_struct_sigdglsl2.lamb_max_diag_dyn_lsl_up egcp[1].egcp_struct_sigdglsl2.lamb_ampl_int_diag_dyn_lsl_up egcp[1].egcp_struct_sigdglsl2.fac_value_diag_dyn_lsl_up egcp[1].egcp_struct_sigdglsl2.fac_sum_diag_dyn_lsl_up egcp[1].egcp_struct_sigdglsl2.fac_mv_diag_dyn_lsl_up egcp[1].egcp_struct_sigdglsl2.fac_diag_dyn_lsl_up egcp[1].egcp_struct_sigdglsl2.t_dyn_diag_afl egcp[1].egcp_struct_sigdglsl2.t_dyn_diag_afr egcp[1].egcp_struct_sigdglsl2.ctr_diag_plaus_lsl_up egcp[1].egcp_struct_sigdglsl2.lamb_ampl_diag_dyn_lsl_up egcp[1].egcp_struct_sigdglsl2.lamb_ampl_min_diag_dyn_lsl_up egcp[1].egcp_struct_sigdglsl2.lamb_ampl_max_diag_dyn_lsl_up egcp[1].egcp_struct_sigdglsl2.lamb_ampl_mv_diag_dyn_lsl_up egcp[1].egcp_struct_sigdglsl2.ctr_diag_dyn_lsl_up egcp[1].egcp_struct_sigdglsl2.ctr_wait_diag_dyn_lsl_up egcp[1].egcp_struct_sigdglsl2.cycnr_diag_dyn_lsl_up egcp[1].egcp_struct_sigdglsl2.ctr_sym_act_lsl_up egcp[1].egcp_struct_sigdglsl2.ctr_lamb_de_int_act_lsl_up egcp[1].egcp_struct_sigdglsl2.state_sym_diag_plaus_lsl_up egcp[1].egcp_struct_sigdglsl2.state_sym_diag_puc_lsl_up egcp[1].egcp_struct_sigdglsl2.state_dyn_diag egcp[1].egcp_struct_sigdglsl2.lv_diag_plaus_sym_lsl_up egcp[1].egcp_struct_sigdglsl2.lv_diag_cdn_plaus_lsl_up egcp[1].egcp_struct_sigdglsl2.lv_diag_plaus_end_lsl_up egcp[1].egcp_struct_sigdglsl2.lv_diag_dyn_sym_lsl_up egcp[1].egcp_struct_sigdglsl2.lv_diag_dyn_end_lsl_up egcp[1].egcp_struct_sigdglsl2.lv_diag_dyn_cdn_lsl_up egcp[1].egcp_struct_sigdglsl2.lv_diag_puc_sym_lsl_up egcp[1].egcp_struct_sigdglsl2.lv_diag_cdn_puc_lsl_up egcp[1].egcp_struct_sigdglsl2.lv_diag_puc_end_lsl_up egcp[1].egcp_struct_sigdglsl2.lv_lamb_pls_req_dyn_lsl_up egcp[1].egcp_struct_sigdglsl2.lv_lam_adj_req_dyn_lsl_up egcp[1].egcp_struct_sigdglsl2.lv_diag_afr_sym_plaus_lsl_up egcp[1].egcp_struct_sigdglsl2.lv_diag_afl_sym_plaus_lsl_up egcp[1].egcp_struct_sigdglsl2.lv_diag_raw_act_sym_lsl_up egcp[1].egcp_struct_sigdglsl2.lv_diag_act_sym_lsl_up egcp[1].egcp_struct_sigdglsl2.lv_diag_act_cdn_lsl_up egcp[1].egcp_struct_sigdglsl2.lv_diag_act_sho_cdn_lsl_up lv_err_air_lsl_up_2 lv_err_air_lsl_up_1 ctr_min_diag_dyn_lsl_up lv_err_puc_vld_ls_up_1 lv_err_puc_vld_ls_up_2 /end OUT_MEASUREMENT
/end FUNCTION
/begin FUNCTION EGCP_Linear_O2_sensor_diag_inci "Linear_O2_sensor_diag_inci" /begin DEF_CHARACTERISTIC c_cl_mmv_ls_up_diag_max /end DEF_CHARACTERISTIC
 /begin OUT_MEASUREMENT egcp[0].egcp_struct_sigdglsli2.lv_inh_diag_rbm_air_lsl_up egcp[0].egcp_struct_sigdglsli2.lv_diag_plaus_inh_lsl_up egcp[0].egcp_struct_sigdglsli2.lv_diag_dyn_inh_lsl_up egcp[0].egcp_struct_sigdglsli2.lv_inh_diag_air_lsl_up egcp[0].egcp_struct_sigdglsli2.lv_inh_diag_puc_lsl_up egcp[0].egcp_struct_sigdglsli2.lv_diag_eol_dyn_ls_up egcp[0].egcp_struct_sigdglsli2.lv_diag_eol_puc_lsl_up egcp[0].egcp_struct_sigdglsli2.lv_inh_diag_rbm_dyn_vld_ls_up egcp[0].egcp_struct_sigdglsli2.state_rbm_dyn_vld_ls_up egcp[0].egcp_struct_sigdglsli2.state_rbm_air_lsl_up egcp[0].egcp_struct_sigdglsli2.lv_inh_diag_rbm_puc_lsl_up egcp[0].egcp_struct_sigdglsli2.lv_diag_eol_air_lsl_up egcp[0].egcp_struct_sigdglsli2.state_rbm_puc_vld_ls_up egcp[1].egcp_struct_sigdglsli2.lv_inh_diag_rbm_air_lsl_up egcp[1].egcp_struct_sigdglsli2.lv_diag_plaus_inh_lsl_up egcp[1].egcp_struct_sigdglsli2.lv_diag_dyn_inh_lsl_up egcp[1].egcp_struct_sigdglsli2.lv_inh_diag_air_lsl_up egcp[1].egcp_struct_sigdglsli2.lv_inh_diag_puc_lsl_up egcp[1].egcp_struct_sigdglsli2.lv_diag_eol_dyn_ls_up egcp[1].egcp_struct_sigdglsli2.lv_diag_eol_puc_lsl_up egcp[1].egcp_struct_sigdglsli2.lv_inh_diag_rbm_dyn_vld_ls_up egcp[1].egcp_struct_sigdglsli2.state_rbm_dyn_vld_ls_up egcp[1].egcp_struct_sigdglsli2.state_rbm_air_lsl_up egcp[1].egcp_struct_sigdglsli2.lv_inh_diag_rbm_puc_lsl_up egcp[1].egcp_struct_sigdglsli2.lv_diag_eol_air_lsl_up egcp[1].egcp_struct_sigdglsli2.state_rbm_puc_vld_ls_up lv_diag_eol_dyn_ls_up_dc[0] lv_diag_eol_dyn_ls_up_dc[1] lv_diag_eol_air_lsl_up_dc[0] lv_diag_eol_air_lsl_up_dc[1] lv_inh_diag_ls_up_dyn_cp lv_inh_diag_rbm_plaus_lsl_up[0] lv_inh_diag_rbm_plaus_lsl_up[1] /end OUT_MEASUREMENT
/end FUNCTION
/begin FUNCTION EGCP_O2_sensor_temperature_inci "O2_sensor_temperature" /end FUNCTION
/begin FUNCTION EGCP_O2_sensor_diag_manag_inci "O2_sensor_diag_manag_inci" /end FUNCTION
/begin FUNCTION EGCP_O2_sensor_probe_diag_inci "O2_sensor_probe_diag_inci"
 /begin OUT_MEASUREMENT egcp[0].egcp_struct_pladglsli1.lv_diag_act_inh_ls_up_down egcp[0].egcp_struct_pladglsli1.lv_diag_afr_afl_inh_ls_up_down egcp[0].egcp_struct_pladglsli1.lv_diag_eol_req_ls_up_down egcp[1].egcp_struct_pladglsli1.lv_diag_act_inh_ls_up_down egcp[1].egcp_struct_pladglsli1.lv_diag_afr_afl_inh_ls_up_down egcp[1].egcp_struct_pladglsli1.lv_diag_eol_req_ls_up_down /end OUT_MEASUREMENT
/end FUNCTION
/begin FUNCTION EGCP_Down_O2_sensor_resist_inci "" /begin DEF_CHARACTERISTIC c_tco_cur_on_ls_down_min /end DEF_CHARACTERISTIC
 /begin OUT_MEASUREMENT egcp[0].egcp_struct_sigcvridi0.lv_inh_r_it_ls_down egcp[1].egcp_struct_sigcvridi0.lv_inh_r_it_ls_down /end OUT_MEASUREMENT
/end FUNCTION
/begin FUNCTION EGCP_Linear_O2_sensor_hea_diag "Linear_O2_sensor_hea_diag"
 /begin DEF_CHARACTERISTIC c_lamb_delta_lpf_thd c_cycnr_max_diag_lsh_lsl_up c_ctr_sym_diag_lsh_lsl_up c_lamb_sp_de_diag_lsh_lsl_up c_maf_int_diag_lsh_lsl_up c_crlc_lpf_fall_diag_lsh_lsl_up c_crlc_lpf_rise_diag_lsh_lsl_up c_lshpwm_min_diag_lsh_lsl_up c_lshpwm_max_diag_lsh_lsl_up ldp_lshpwm_up_ip_t_dly_acq_vls ip_t_dly_trig_lsh_up c_t_afl_afr_diag_lsh_lsl_up c_teg_min_diag_lsh_lsl_up lc_lsl_diag_lsh_lsl_up_deac /end DEF_CHARACTERISTIC
 /begin OUT_MEASUREMENT egcp[0].egcp_struct_sigdglsl3.lamb_delta_rise_lpf egcp[0].egcp_struct_sigdglsl3.lamb_delta_fall_lpf egcp[0].egcp_struct_sigdglsl3.lamb_syn_lshpwm_fall egcp[0].egcp_struct_sigdglsl3.lamb_syn_lshpwm_rise egcp[0].egcp_struct_sigdglsl3.lamb_delta_rise egcp[0].egcp_struct_sigdglsl3.lamb_delta_fall egcp[0].egcp_struct_sigdglsl3.ctr_sym_diag_lsh_lsl_up egcp[0].egcp_struct_sigdglsl3.cycnr_diag_lsh_lsl_up egcp[0].egcp_struct_sigdglsl3.t_dly_trig_lsh_up egcp[1].egcp_struct_sigdglsl3.lamb_delta_rise_lpf egcp[1].egcp_struct_sigdglsl3.lamb_delta_fall_lpf egcp[1].egcp_struct_sigdglsl3.lamb_syn_lshpwm_fall egcp[1].egcp_struct_sigdglsl3.lamb_syn_lshpwm_rise egcp[1].egcp_struct_sigdglsl3.lamb_delta_rise egcp[1].egcp_struct_sigdglsl3.lamb_delta_fall egcp[1].egcp_struct_sigdglsl3.ctr_sym_diag_lsh_lsl_up egcp[1].egcp_struct_sigdglsl3.cycnr_diag_lsh_lsl_up egcp[1].egcp_struct_sigdglsl3.t_dly_trig_lsh_up maf_int_diag_lsh_lsl_up lv_err_lsh_lsl_up_1 lv_err_lsh_lsl_up_2 /end OUT_MEASUREMENT
/end FUNCTION
/begin FUNCTION EGCP_Linear_O2_sens_hea_diag_AI "Linear_O2_sens_hea_diag_AI"
 /begin OUT_MEASUREMENT egcp[0].egcp_struct_sigdglsli3.lv_inh_diag_lsh_lsl_up egcp[1].egcp_struct_sigdglsli3.lv_inh_diag_lsh_lsl_up lv_lsl_diag_lsh_lsl_up_deac /end OUT_MEASUREMENT
/end FUNCTION
/begin FUNCTION EGCP_O2_down_diag_NOx_rgn "O2_down_diag_NOx_rgn"
 /begin DEF_CHARACTERISTIC c_tco_min_diag_rgn_nt_ls_down c_maf_min_diag_rgn_nt_ls_down c_maf_max_diag_rgn_nt_ls_down c_temp_min_diag_rgn_nt_ls_down lc_state_rgn_l_ampl_deac c_vls_down_rgn_nt_dif_min c_vls_min_diag_rgn_ls_down c_maf_int_rgn_nt_s_act c_maf_int_rgn_nt_end c_t_rgn_nt_end c_ctr_sym_max_rgn_nt_ls_down c_ctr_inc_diag_rgn_nt_ls_down c_ctr_end_diag_rgn_nt_ls_down /end DEF_CHARACTERISTIC
 /begin OUT_MEASUREMENT egcp[0].egcp_struct_sigdglsd3.vls_down_rgn_nt_end egcp[0].egcp_struct_sigdglsd3.maf_int_rgn_nt_s_act egcp[0].egcp_struct_sigdglsd3.maf_int_rgn_nt_end egcp[0].egcp_struct_sigdglsd3.t_rgn_nt_end egcp[0].egcp_struct_sigdglsd3.ctr_sym_diag_rgn_nt_ls_down egcp[0].egcp_struct_sigdglsd3.vls_down_rgn_nt_dif egcp[0].egcp_struct_sigdglsd3.ctr_end_diag_rgn_nt_ls_down egcp[0].egcp_struct_sigdglsd3.lv_diag_act_rgn_nt_ls_down egcp[1].egcp_struct_sigdglsd3.vls_down_rgn_nt_end egcp[1].egcp_struct_sigdglsd3.maf_int_rgn_nt_s_act egcp[1].egcp_struct_sigdglsd3.maf_int_rgn_nt_end egcp[1].egcp_struct_sigdglsd3.t_rgn_nt_end egcp[1].egcp_struct_sigdglsd3.ctr_sym_diag_rgn_nt_ls_down egcp[1].egcp_struct_sigdglsd3.vls_down_rgn_nt_dif egcp[1].egcp_struct_sigdglsd3.ctr_end_diag_rgn_nt_ls_down egcp[1].egcp_struct_sigdglsd3.lv_diag_act_rgn_nt_ls_down lv_err_rgn_nt_ls_down_1 lv_err_rgn_nt_ls_down_2 /end OUT_MEASUREMENT
/end FUNCTION
/begin FUNCTION EGCP_O2_down_diag_NOx_rgn_AI "O2_down_diag_NOx_rgn_AI"
 /begin OUT_MEASUREMENT egcp[0].egcp_struct_sigdglsdi3.lv_inh_diag_rgn_nt_ls_down egcp[1].egcp_struct_sigdglsdi3.lv_inh_diag_rgn_nt_ls_down /end OUT_MEASUREMENT
/end FUNCTION
/begin FUNCTION C_7_LACO "C_7_LACO"
 /begin DEF_CHARACTERISTIC ldpm_n_32_4_laco ldpm_n_32_2_laco ldpm_maf_1_laco ldpm_maf_cyl_1_laco ldpm_eff_cat_diag_1_laco ldpm_tco_2_laco ldpm_n_1_laco ldpm_t1_lsl_up_1_laco ldpm_t1_lsl_up_2_laco ldpm_tco_1_laco ldpm_tco_st_1_laco ldpm_fac_lam_mv_1_laco ldpm_t_dly_soi_lsl_pos_1_laco ldpm_t_dly_soi_lsl_pos_2_laco ldpm_vls_dif_lam_adj_1_laco ldpm_vls_dif_lam_adj_2_laco ldpm_n_32_5_laco /end DEF_CHARACTERISTIC
 /begin SUB_FUNCTION LACO_Lambda_adaptation LACO_MV_CLC_limited_dynamics LACO_Lambda_CTL_WRAF_SENS LACO_Trim_CTL_lin_lambda_CTL LACO_Linear_lambda_CTL__AI LACO_Trim_CTL_lin_lambda_CTL__AI LACO_Lambda_adaptation__AI LACO_Lambda_control_conditions LACO_Vld_cdn_chk_WRAF_char_ad LACO_WRAF_sens_char_ad_trim_ctl /end SUB_FUNCTION
/end FUNCTION
/begin FUNCTION LACO_Lambda_adaptation "Lambda_adaptation"
 /begin DEF_CHARACTERISTIC ldp_mff_delta_add_lam_ad_t_pri ldp_fac_delta_l_rng_lam_ad_pri ldp_fac_delta_h_rng_lam_ad_pri c_t_pri_max_lam_ad c_n_tol_add_rng_lam_ad c_n_tol_fac_l_rng_lam_ad c_n_bol_fac_l_rng_lam_ad c_n_bol_fac_h_rng_lam_ad c_n_tol_fac_h_rng_lam_ad id_t_pri_fac_l_rng_lam_ad id_t_pri_mff_add_rng_lam_ad ip_fac_n_mff_add_lam_ad ip_fac_n_fac_lam_ad ip_fac_wup_fac_lam_ad ldp_fac_lam_ad_ip_fac_wup_fac c_mff_sp_tol_add_rng_lam_ad c_fac_min_l_rng_lam_ad c_fac_max_l_rng_lam_ad c_fac_max_h_rng_lam_ad c_mff_min_add_rng_lam_ad c_mff_max_add_rng_lam_ad lc_fac_l_rng_afs_req_lam_ad lc_fac_h_rng_afs_req_lam_ad lc_mff_add_rng_afs_req_lam_ad c_fac_min_h_rng_lam_ad ip_fac_wup_mff_add_lam_ad ldp_mff_add_lam_ad_ip_fac_wup id_t_pri_fac_h_rng_lam_ad ip_mff_sp_max_fac_l_rng_lam_ad ip_mff_sp_min_fac_h_rng_lam_ad ldp_n_32_id_mff_sp_bol_h_rng ldp_n_32_id_mff_sp_bol_l_rng ldp_n_32_id_mff_sp_tol_l_rng ldp_n_32_id_mff_sp_tol_h_rng id_mff_sp_bol_fac_h_rng_lam_ad id_mff_sp_bol_fac_l_rng_lam_ad id_mff_sp_tol_fac_l_rng_lam_ad id_mff_sp_tol_fac_h_rng_lam_ad c_crlc_fac_dif_lam_ad_wup_mv c_crlc_global_fac_lam_ad_wup c_ctr_tco_min_inter c_fac_lam_ad_wup_delta c_fac_lam_ad_wup_min_gap c_fac_lam_ad_wup_max c_fac_lam_ad_wup_min c_fac_lam_ad_wup_max_inter c_fac_lam_ad_wup_min_inter c_fac_lam_ad_wup_max_lscl_off c_fac_lam_ad_wup_min_lscl_off c_tco_a_lam_ad_wup c_tco_b_lam_ad_wup c_tco_c_lam_ad_wup c_tco_d_lam_ad_wup c_tco_e_lam_ad_wup c_tco_f_lam_ad_wup c_temp_dif_tco_st_tco_min_estim c_tco_lam_ad_wup_rng c_t_max_lam_ad_wup_is /end DEF_CHARACTERISTIC
 /begin OUT_MEASUREMENT lv_lam_ad_cdn t_pri_tot_lam_ad lv_lam_ad_end lv_lam_ad_afs_req lv_lam_ad_stop_cbk_ex laco[0].laco_struct_ispclada0.mff_lam_add_lam_ad_out laco[0].laco_struct_ispclada0.fac_lam_ad_lam_out laco[0].laco_struct_ispclada0.fac_mff_add_lam_ad_out laco[0].laco_struct_ispclada0.mff_add_lam_ad laco[0].laco_struct_ispclada0.mff_delta_add_lam_ad laco[0].laco_struct_ispclada0.mff_delta_add_lam_ad_h_res laco[0].laco_struct_ispclada0.fac_lam_ad laco[0].laco_struct_ispclada0.fac_l_rng_lam_ad laco[0].laco_struct_ispclada0.fac_h_rng_lam_ad laco[0].laco_struct_ispclada0.fac_delta_l_rng_lam_ad laco[0].laco_struct_ispclada0.fac_delta_h_rng_lam_ad laco[0].laco_struct_ispclada0.fac_lam_adj_lam_ad laco[0].laco_struct_ispclada0.fac_mff_add_fac_lam_ad laco[0].laco_struct_ispclada0.fac_lam_tco_min laco[0].laco_struct_ispclada0.fac_lam_ad_wup laco[0].laco_struct_ispclada0.fac_lam_adj_lam_ad_wup laco[0].laco_struct_ispclada0.fac_lam_dif_lam_ad_wup_mv laco[0].laco_struct_ispclada0.fac_lam_tco_a laco[0].laco_struct_ispclada0.fac_lam_tco_b laco[0].laco_struct_ispclada0.fac_lam_tco_c laco[0].laco_struct_ispclada0.fac_lam_tco_d laco[0].laco_struct_ispclada0.fac_lam_tco_e laco[0].laco_struct_ispclada0.t_pri_lam_ad laco[0].laco_struct_ispclada0.t_lam_ad_wup_is laco[0].laco_struct_ispclada0.ctr_raf_chg_lam_ad laco[0].laco_struct_ispclada0.ctr_tco_min_inter laco[0].laco_struct_ispclada0.tco_min_lam_ad_wup laco[0].laco_struct_ispclada0.tco_min_inter_lam_ad_wup laco[0].laco_struct_ispclada0.state_lam_ad laco[0].laco_struct_ispclada0.lv_fac_lam_adj_lam_ad laco[0].laco_struct_ispclada0.lv_lam_ad_stop laco[0].laco_struct_ispclada0.lv_fac_l_rng_lim_max_lam_ad laco[0].laco_struct_ispclada0.lv_fac_l_rng_lim_min_lam_ad laco[0].laco_struct_ispclada0.lv_fac_h_rng_lim_max_lam_ad laco[0].laco_struct_ispclada0.lv_fac_h_rng_lim_min_lam_ad laco[0].laco_struct_ispclada0.lv_mff_add_lim_max_lam_ad laco[0].laco_struct_ispclada0.lv_mff_add_lim_min_lam_ad laco[0].laco_struct_ispclada0.lv_fac_h_rng_lam_ad laco[0].laco_struct_ispclada0.lv_fac_l_rng_lam_ad laco[0].laco_struct_ispclada0.lv_mff_add_rng_lam_ad laco[0].laco_struct_ispclada0.lv_tco_min_inter_lam_ad_wup laco[0].laco_struct_ispclada0.lv_tco_min_lam_ad_wup laco[0].laco_struct_ispclada0.lv_lam_ad_wup_stop laco[0].laco_struct_ispclada0.lv_tco_d_lam_ad_wup laco[0].laco_struct_ispclada0.lv_tco_c_lam_ad_wup laco[0].laco_struct_ispclada0.lv_tco_b_lam_ad_wup laco[0].laco_struct_ispclada0.lv_tco_a_lam_ad_wup laco[0].laco_struct_ispclada0.lv_tco_e_lam_ad_wup laco[0].laco_struct_ispclada0.lv_fac_lam_adj_lam_ad_wup laco[1].laco_struct_ispclada0.mff_lam_add_lam_ad_out laco[1].laco_struct_ispclada0.fac_lam_ad_lam_out laco[1].laco_struct_ispclada0.fac_mff_add_lam_ad_out laco[1].laco_struct_ispclada0.mff_add_lam_ad laco[1].laco_struct_ispclada0.mff_delta_add_lam_ad laco[1].laco_struct_ispclada0.mff_delta_add_lam_ad_h_res laco[1].laco_struct_ispclada0.fac_lam_ad laco[1].laco_struct_ispclada0.fac_l_rng_lam_ad laco[1].laco_struct_ispclada0.fac_h_rng_lam_ad laco[1].laco_struct_ispclada0.fac_delta_l_rng_lam_ad laco[1].laco_struct_ispclada0.fac_delta_h_rng_lam_ad laco[1].laco_struct_ispclada0.fac_lam_adj_lam_ad laco[1].laco_struct_ispclada0.fac_mff_add_fac_lam_ad laco[1].laco_struct_ispclada0.fac_lam_tco_min laco[1].laco_struct_ispclada0.fac_lam_ad_wup laco[1].laco_struct_ispclada0.fac_lam_adj_lam_ad_wup laco[1].laco_struct_ispclada0.fac_lam_dif_lam_ad_wup_mv laco[1].laco_struct_ispclada0.fac_lam_tco_a laco[1].laco_struct_ispclada0.fac_lam_tco_b laco[1].laco_struct_ispclada0.fac_lam_tco_c laco[1].laco_struct_ispclada0.fac_lam_tco_d laco[1].laco_struct_ispclada0.fac_lam_tco_e laco[1].laco_struct_ispclada0.t_pri_lam_ad laco[1].laco_struct_ispclada0.t_lam_ad_wup_is laco[1].laco_struct_ispclada0.ctr_raf_chg_lam_ad laco[1].laco_struct_ispclada0.ctr_tco_min_inter laco[1].laco_struct_ispclada0.tco_min_lam_ad_wup laco[1].laco_struct_ispclada0.tco_min_inter_lam_ad_wup laco[1].laco_struct_ispclada0.state_lam_ad laco[1].laco_struct_ispclada0.lv_fac_lam_adj_lam_ad laco[1].laco_struct_ispclada0.lv_lam_ad_stop laco[1].laco_struct_ispclada0.lv_fac_l_rng_lim_max_lam_ad laco[1].laco_struct_ispclada0.lv_fac_l_rng_lim_min_lam_ad laco[1].laco_struct_ispclada0.lv_fac_h_rng_lim_max_lam_ad laco[1].laco_struct_ispclada0.lv_fac_h_rng_lim_min_lam_ad laco[1].laco_struct_ispclada0.lv_mff_add_lim_max_lam_ad laco[1].laco_struct_ispclada0.lv_mff_add_lim_min_lam_ad laco[1].laco_struct_ispclada0.lv_fac_h_rng_lam_ad laco[1].laco_struct_ispclada0.lv_fac_l_rng_lam_ad laco[1].laco_struct_ispclada0.lv_mff_add_rng_lam_ad laco[1].laco_struct_ispclada0.lv_tco_min_inter_lam_ad_wup laco[1].laco_struct_ispclada0.lv_tco_min_lam_ad_wup laco[1].laco_struct_ispclada0.lv_lam_ad_wup_stop laco[1].laco_struct_ispclada0.lv_tco_d_lam_ad_wup laco[1].laco_struct_ispclada0.lv_tco_c_lam_ad_wup laco[1].laco_struct_ispclada0.lv_tco_b_lam_ad_wup laco[1].laco_struct_ispclada0.lv_tco_a_lam_ad_wup laco[1].laco_struct_ispclada0.lv_tco_e_lam_ad_wup laco[1].laco_struct_ispclada0.lv_fac_lam_adj_lam_ad_wup /end OUT_MEASUREMENT
/end FUNCTION
/begin FUNCTION LACO_MV_CLC_limited_dynamics "MV_CLC_limited_dynamics" /begin DEF_CHARACTERISTIC c_crlc_n_mmv_ldc c_crlc_maf_mmv_ldc c_crlc_pv_av_mmv_ldc /end DEF_CHARACTERISTIC
 /begin OUT_MEASUREMENT n_delta_ldc maf_delta_ldc maf_mmv_ldc pv_av_delta_ldc pv_av_mmv_ldc n_mmv_ldc laco[0].laco_struct_ispclmvldc0.fac_lam_mv_delta_ldc laco[1].laco_struct_ispclmvldc0.fac_lam_mv_delta_ldc /end OUT_MEASUREMENT
/end FUNCTION
/end MODULE
/end PROJECT
