ASAP2_VERSION 1 3
/begin PROJECT P383 "BMW DDE6.3 8-Zylinder V9E.3 11.10.2004 CAN12H"
/begin HEADER "" VERSION "V9E.3_8Z_CAN12H" PROJECT_NO P383 /end HEADER
/begin MODULE DIM ""
/begin MOD_COMMON "" BYTE_ORDER MSB_FIRST ALIGNMENT_BYTE 1 ALIGNMENT_WORD 2 ALIGNMENT_LONG 4 ALIGNMENT_FLOAT32_IEEE 4 /end MOD_COMMON
/begin CHARACTERISTIC BypEtk_dNsyncStimuli64_C "Bypass, nicht ändern. Anzahl der winkelsynchron übertragenen Acht-Byte-Größen von ASCET zur ECU." VALUE 0xC99B4 Kw_Wu8 255.0 OneToOne 0.00 255.0 FORMAT "%5.1" /end CHARACTERISTIC
/begin CHARACTERISTIC BypEtk_dNsyncStimuli32_C "Bypass, nicht ändern. Anzahl der winkelsynchron übertragenen Vier-Byte-Größen von ASCET zur ECU." VALUE 0xC99B5 Kw_Wu8 255.0 OneToOne 0.00 255.0 FORMAT "%5.1" /end CHARACTERISTIC
/begin CHARACTERISTIC BypEtk_dNsyncStimuli16_C "Bypass, nicht ändern. Anzahl der winkelsynchron übertragenen Zwei-Byte-Größen von ASCET zur ECU." VALUE 0xC99B6 Kw_Wu8 255.0 OneToOne 0.00 255.0 FORMAT "%5.1" /end CHARACTERISTIC
/begin CHARACTERISTIC BypEtk_dNsyncStimuli8_C "Bypass, nicht ändern. Anzahl der winkelsynchron übertragenen Ein-Byte-Größen von ASCET zur ECU." VALUE 0xC99B7 Kw_Wu8 255.0 OneToOne 0.00 255.0 FORMAT "%5.1" /end CHARACTERISTIC
/begin CHARACTERISTIC BypEtk_stAscet_C "Status ASCET ETK Bypass (0: deaktiviert; 1: ETK-Bypass starten, wenn Wert vorher 0; 2: sofort starten)" VALUE 0xC99B8 Kw_Wu8 2.000 OneToOne 0.00 2.000 FORMAT "%5.3" EXTENDED_LIMITS 0.00 255.0 /end CHARACTERISTIC
/begin CHARACTERISTIC BypEtk_dTsyncStimuli64_C "Bypass, nicht ändern. Anzahl der zeitsynchron übertragenen Acht-Byte-Größen von ASCET zur ECU." VALUE 0xC99B9 Kw_Wu8 255.0 OneToOne 0.00 255.0 FORMAT "%5.1" /end CHARACTERISTIC
/begin CHARACTERISTIC BypEtk_dTsyncStimuli32_C "Bypass, nicht ändern. Anzahl der zeitsynchron übertragenen Vier-Byte-Größen von ASCET zur ECU." VALUE 0xC99BA Kw_Wu8 255.0 OneToOne 0.00 255.0 FORMAT "%5.1" /end CHARACTERISTIC
/begin CHARACTERISTIC BypEtk_dTsyncStimuli16_C "Bypass, nicht ändern. Anzahl der zeitsynchron übertragenen Zwei-Byte-Größen von ASCET zur ECU." VALUE 0xC99BB Kw_Wu8 255.0 OneToOne 0.00 255.0 FORMAT "%5.1" /end CHARACTERISTIC
/begin CHARACTERISTIC BypEtk_dTsyncStimuli8_C "Bypass, nicht ändern. Anzahl der zeitsynchron übertragenen Ein-Byte-Größen von ASCET zur ECU." VALUE 0xC99BC Kw_Wu8 255.0 OneToOne 0.00 255.0 FORMAT "%5.1" /end CHARACTERISTIC
/begin CHARACTERISTIC BypInt_adFunc_C "Feld von Funktionszeigern auf interne Bypass Funktionen" VAL_BLK 0xC99C0 Kwb_Wu32 4294967295.00 OneToOne 0.00 4294967295.00 FORMAT "%13.2" NUMBER 11 /end CHARACTERISTIC
/begin CHARACTERISTIC BypInt_stAscet_C "Status interner ASCET Bypass (0: deaktiviert; 1: internen Bypass starten, wenn Wert vorher 0; 2: sofort starten)" VALUE 0xC99EC Kw_Wu8 2.000 OneToOne 0.00 2.000 FORMAT "%5.3" EXTENDED_LIMITS 0.00 255.0 /end CHARACTERISTIC
/begin CHARACTERISTIC Carb_Mode1PID_CA "Feld von unterstützen Carb Mode $1 PID's" VAL_BLK 0xC0498 Kwb_Wu8 254.0 OneToOne 1.000 255.0 FORMAT "%5.1" EXTENDED_LIMITS 0.00 255.0 NUMBER 9 /end CHARACTERISTIC
/begin CHARACTERISTIC Carb_Mode1Signal_CA "Feld der Signale von Carb Mode $1 welche mit den PID's verbunden sind" VAL_BLK 0xC04A2 Kwb_Wu16 255.000000000 SigName 0.00 255.000000000 FORMAT "%13.9" NUMBER 9 /end CHARACTERISTIC
/begin CHARACTERISTIC Carb_Mode2PID_CA "Feld von unterstützen Carb Mode $2 PID's" VAL_BLK 0xC04B4 Kwb_Wu8 254.0 OneToOne 1.000 255.0 FORMAT "%5.1" EXTENDED_LIMITS 0.00 255.0 NUMBER 9 /end CHARACTERISTIC
/begin CHARACTERISTIC Carb_Mode2Signal_CA "Feld der Signale von Carb Mode $2 welche mit den PID's verbunden sind" VAL_BLK 0xC04BE Kwb_Wu16 255.000000000 SigName 0.00 255.000000000 FORMAT "%13.9" NUMBER 9 /end CHARACTERISTIC
/begin CHARACTERISTIC Carb_Mode3SwtDia_C "Anzeigen der Fehler nur für Carb Mode 3(0) oder für Carb Mode 3 und 7 (1)" VALUE 0xC04D0 Kw_Wu8 255.0 OneToOne 0.00 255.0 FORMAT "%5.1" /end CHARACTERISTIC
/begin CHARACTERISTIC Carb_Mode4RefVal_C "Ist Carb_Mode4SigNum_C größer als dieser Referenzwert erfolgt kein Reset" VALUE 0xC04D4 Kw_Ws32 4294967295.00 OneToOne -2147483648.00 2147483647.00 FORMAT "%13.2" /end CHARACTERISTIC
/begin CHARACTERISTIC Carb_Mode4SigNum_C "Vergleiche Carb_Mode4SigNum_C mit dem Referenzwert Carb_Mode4RefVal_C" VALUE 0xC04D8 Kw_Wu16 65535.00 OneToOne 0.00 65535.00 FORMAT "%8.2" /end CHARACTERISTIC
/begin CHARACTERISTIC Carb_Mode6TstComp_CUR "Komponente des Carb Mode 6 Subtests" VAL_BLK 0xC04DA Kwb_Wu8 255.0 OneToOne 0.00 255.0 FORMAT "%5.1" NUMBER 10 /end CHARACTERISTIC
/begin CHARACTERISTIC Carb_Mode6TstNum_CUR "Test Nummer des Carb Mode 6 Subtests" VAL_BLK 0xC04E4 Kwb_Wu8 254.0 OneToOne 1.000 255.0 FORMAT "%5.1" EXTENDED_LIMITS 0.00 255.0 NUMBER 10 /end CHARACTERISTIC
/begin CHARACTERISTIC Carb_Mode6TstRefMax_CUR "Maximaler Referenzwert des Carb Mode 6 Subtest" VAL_BLK 0xC04EE Kwb_Wu16 65534.00 OneToOne 1.000000 65535.00 FORMAT "%8.2" EXTENDED_LIMITS 0.00 65535.00 NUMBER 10 /end CHARACTERISTIC
/begin CHARACTERISTIC Carb_Mode6TstRefMin_CUR "Minimaler Referenzwert des Carb Mode 6 Subtest" VAL_BLK 0xC0502 Kwb_Wu16 65534.00 OneToOne 1.000000 65535.00 FORMAT "%8.2" EXTENDED_LIMITS 0.00 65535.00 NUMBER 10 /end CHARACTERISTIC
/begin CHARACTERISTIC Carb_Mode6TstTestId_CUR "Test Identifier für OBD über CAN" VAL_BLK 0xC0516 Kwb_Wu8 255.0 OneToOne 0.00 255.0 FORMAT "%5.1" NUMBER 10 /end CHARACTERISTIC
/begin CHARACTERISTIC Carb_Mode6TstUnitId_CUR "Einheits und Skalierungs Identifier der Datenbytes" VAL_BLK 0xC0520 Kwb_Wu8 255.0 OneToOne 0.00 255.0 FORMAT "%5.1" NUMBER 10 /end CHARACTERISTIC
/begin CHARACTERISTIC Carb_Mode6TstVal_CUR "Testwert des Carb Mode 6 Subtests" VAL_BLK 0xC052A Kwb_Wu16 65534.00 OneToOne 1.000000 65535.00 FORMAT "%8.2" EXTENDED_LIMITS 0.00 65535.00 NUMBER 10 /end CHARACTERISTIC
/begin CHARACTERISTIC Carb_Mode9PID0_C "Support-Status des Infotype 0x00. Liefert alle ünterstützten Infotypes ( immer 0 für supported)" VALUE 0xC053E Kw_Wu8 255.0 OneToOne 0.00 255.0 FORMAT "%5.1" /end CHARACTERISTIC
/begin CHARACTERISTIC Carb_Mode9PID1_C "Support-Status des Infotype 0x01 (1 für supported, 0 für nicht supported)" VALUE 0xC053F Kw_Wu8 255.0 OneToOne 0.00 255.0 FORMAT "%5.1" /end CHARACTERISTIC
/begin CHARACTERISTIC Carb_Mode9PID2_C "Support-Status des Infotype 0x02 ""Vehicle Identification"" ( 2 für supported, 0 für nicht supported)" VALUE 0xC0540 Kw_Wu8 255.0 OneToOne 0.00 255.0 FORMAT "%5.1" /end CHARACTERISTIC
/begin CHARACTERISTIC Carb_Mode9PID3_C "Support-Status des Infotype 0x03 ( 3 für supported, 0 für nicht supported)" VALUE 0xC0541 Kw_Wu8 255.0 OneToOne 0.00 255.0 FORMAT "%5.1" /end CHARACTERISTIC
/begin CHARACTERISTIC Carb_Mode9PID4_C "Support-Status des Infotype 0x04 ""Calibration Identification"" ( 4 für supported, 0 für nicht supported)" VALUE 0xC0542 Kw_Wu8 255.0 OneToOne 0.00 255.0 FORMAT "%5.1" /end CHARACTERISTIC
/begin CHARACTERISTIC Carb_Mode9PID5_C "Support-Status des Infotype 0x05 ( 5 für supported, 0 für nicht supported)" VALUE 0xC0543 Kw_Wu8 255.0 OneToOne 0.00 255.0 FORMAT "%5.1" /end CHARACTERISTIC
/begin CHARACTERISTIC Carb_Mode9PID6_C "Support-Status des Infotype 0x06 ""Calibration Verification Number"" ( 6 für supported, 0 für nicht supported)" VALUE 0xC0544 Kw_Wu8 6.000 OneToOne 0.00 6.000 FORMAT "%5.3" EXTENDED_LIMITS 0.00 255.0 /end CHARACTERISTIC
/begin CHARACTERISTIC CaSCD_ctAddTooth_C "Anzahl der tolerierbaren zusätzlichen Zähne im Nockenwellensignal" VALUE 0xC99F0 Kw_Wu8 255.0 OneToOne 0.00 255.0 FORMAT "%5.1" /end CHARACTERISTIC
/begin CHARACTERISTIC CaSCD_ctEdgOfs_C "Anzahl von Nockenwellenflanken mit erkannter CaS/CrS Verdrehung" VALUE 0xC99F1 Kw_Wu8 255.0 OneToOne 0.00 255.0 FORMAT "%5.1" /end CHARACTERISTIC
/begin CHARACTERISTIC CaSCD_ctErrSegLen2Pos_C "Anzahl der tolerierbaren Fehler, Segmentlänge paßt nicht zur gefundenen Absolutposition des Nockenwellensignals" VALUE 0xC99F2 Kw_Wu8 255.0 OneToOne 0.00 255.0 FORMAT "%5.1" /end CHARACTERISTIC
/begin CHARACTERISTIC CaSCD_ctErrSync_C "maximale Anzahl von Störungen auf dem Phasengebersystem während einer Nockenwellenumdrehung" VALUE 0xC99F3 Kw_Wu8 255.0 OneToOne 0.00 255.0 FORMAT "%5.1" /end CHARACTERISTIC
/begin CHARACTERISTIC CaSCD_ctMissTooth_C "Anzahl der tolerierbaren fehlenden Zähne im Nockenwellensignal" VALUE 0xC99F4 Kw_Wu8 255.0 OneToOne 0.00 255.0 FORMAT "%5.1" /end CHARACTERISTIC
/begin CHARACTERISTIC CaSCD_ctShftSync_C "Anzahl falscher Nockenwellenflanken bis neue Positionssuche" VALUE 0xC99F5 Kw_Wu8 255.0 OneToOne 0.00 255.0 FORMAT "%5.1" /end CHARACTERISTIC
/begin CHARACTERISTIC CaSCD_dSegSeries_C "Segmentfolge der Phasengebersegmente" VAL_BLK 0xC0545 Kwb_Wu8 31.00 OneToOne 0.00 31.00 FORMAT "%5.2" EXTENDED_LIMITS 0.00 255.0 NUMBER 16 /end CHARACTERISTIC
/begin CHARACTERISTIC CaSCD_dTrigMsk_C "Triggermaske für vorlaeufige Segmenterkennung" VALUE 0xC0555 Kw_Wu8 255.0 OneToOne 0.00 255.0 FORMAT "%5.1" /end CHARACTERISTIC
/begin CHARACTERISTIC CaSCD_dTrigRslt_C "Triggerergebnis der vorlaeufigen Segmenterkennung" VALUE 0xC0556 Kw_Wu8 255.0 OneToOne 0.00 255.0 FORMAT "%5.1" /end CHARACTERISTIC
/begin CHARACTERISTIC CaSCD_facPlausHigh_CUR "Obere Grenze der Plausibilitätsprüfung des Phasengebersignals" CURVE 0xC99F6 Kl_Xs16_Ws16 19.00000 Fact1 1.000000 20.00000 FORMAT "%8.5" EXTENDED_LIMITS -256.0000 255.9922
 /begin AXIS_DESCR STD_AXIS CaSCD_tiPeriodRev Period_ms 12 0.00 3276.700 FORMAT "%8.3" EXTENDED_LIMITS -3276.800 3276.700 DEPOSIT ABSOLUTE /end AXIS_DESCR
/end CHARACTERISTIC
/begin CHARACTERISTIC CaSCD_facPlausLow_CUR "Untere Grenze der Plausibilitätsprüfung des Phasengebersignals" CURVE 0xC9A28 Kl_Xs16_Ws16 1.000000 Fact1 0.00 1.000000 FORMAT "%8.6" EXTENDED_LIMITS -256.0000 255.9922
 /begin AXIS_DESCR STD_AXIS CaSCD_tiPeriodRevHold Period_ms 12 0.00 3276.700 FORMAT "%8.3" EXTENDED_LIMITS -3276.800 3276.700 DEPOSIT ABSOLUTE /end AXIS_DESCR
/end CHARACTERISTIC
/begin CHARACTERISTIC CaSCD_nMinSpeed_C "Kleinster Wert für Phasengeberraddrehzahl" VALUE 0xC0558 Kw_Ws16 5960.000 EngN 40.00000 6000.000 FORMAT "%8.3" EXTENDED_LIMITS -32768.00 32767.00 /end CHARACTERISTIC
/begin CHARACTERISTIC CaSCD_phiPosTolc_C "Toleranzen der Absolutpositionen des Nockenwellensignals" VAL_BLK 0xC9A5A Kwb_Ws16 360.0000 AngleCaS 0.00 360.0000 FORMAT "%8.4" EXTENDED_LIMITS -384.0000 383.9883 NUMBER 16 /end CHARACTERISTIC
/begin CHARACTERISTIC CaSCD_phiSegLenTolc_C "Toleranz für jede Segmentlänge" VAL_BLK 0xC055A Kwb_Ws16 360.0000 AngleCaS 0.00 360.0000 FORMAT "%8.4" EXTENDED_LIMITS -384.0000 383.9883 NUMBER 16 /end CHARACTERISTIC
/begin CHARACTERISTIC CaSCD_phiSegLen_C "Länge der Phasensegmente" VAL_BLK 0xC057A Kwb_Ws16 360.0000 AngleCaS 0.00 360.0000 FORMAT "%8.4" EXTENDED_LIMITS -384.0000 383.9883 NUMBER 16 /end CHARACTERISTIC
/begin CHARACTERISTIC CaSCD_phiSegOfs_C "Winkel zwischen physikalischer Nulllage und Beginn Referenztabelle" VALUE 0xC059A Kw_Ws16 360.0000 AngleCaS 0.00 360.0000 FORMAT "%8.4" EXTENDED_LIMITS -384.0000 383.9883 /end CHARACTERISTIC
/begin CHARACTERISTIC CaSCD_phiSpeedCalcTolc_C "Toleranzwinkel für Segmenterkennung bei der Berechnung der Phasengeberdrehzahl" VALUE 0xC059C Kw_Ws16 360.0000 AngleCaS 0.00 360.0000 FORMAT "%8.4" EXTENDED_LIMITS -384.0000 383.9883 /end CHARACTERISTIC
/begin CHARACTERISTIC CaSCD_phiSpeedSegLen_C "Winkel einer Segmentlänge zur Berechnung der Phasengeberraddrehzahl" VALUE 0xC059E Kw_Ws16 360.0000 AngleCaS 0.00 360.0000 FORMAT "%8.4" EXTENDED_LIMITS -384.0000 383.9883 /end CHARACTERISTIC
/begin CHARACTERISTIC CaSCD_phiSpeedSegOfs_C "Winkel zwischen phys. Nullposition und dem Beginn der Segmente zur Phasenraddrehzahlberechnung" VALUE 0xC05A0 Kw_Ws16 360.0000 AngleCaS 0.00 360.0000 FORMAT "%8.4" EXTENDED_LIMITS -384.0000 383.9883 /end CHARACTERISTIC
/begin CHARACTERISTIC CaSCD_phiTrig_C "Triggerwinkel für vorlaeufige Segmenterkennung" VALUE 0xC05A2 Kw_Ws16 360.0000 AngleCaS 0.00 360.0000 FORMAT "%8.4" EXTENDED_LIMITS -384.0000 383.9883 /end CHARACTERISTIC
/begin CHARACTERISTIC CaSCD_stCalc_C "Abschalten von unterschiedlichen Funktionen des Phasensystems" VALUE 0xC05A4 Kw_Wu8 255.0 OneToOne 0.00 255.0 FORMAT "%5.1" /end CHARACTERISTIC
/begin CHARACTERISTIC CaSCD_stEdgeTrig_C "Triggerbedingung für die Phasenflankenerfassung" VALUE 0xC05A5 Kw_Wu8 2.000 OneToOne 1.000 3.000 FORMAT "%5.3" EXTENDED_LIMITS 0.00 255.0 /end CHARACTERISTIC
/begin CHARACTERISTIC CaSCD_stPinState_C "Signalpegel zur Auswertung der Phasensegmente verwenden" VALUE 0xC05A6 Kw_Wu8 1.000 OneToOne 0.00 1.000 FORMAT "%5.3" EXTENDED_LIMITS 0.00 255.0 /end CHARACTERISTIC
/begin CHARACTERISTIC CaSCD_stTPO_C "True Power On Funktion des Phasengebersensors" VALUE 0xC05A7 Kw_Wu8 1.000 OneToOne 0.00 1.000 FORMAT "%5.3" EXTENDED_LIMITS 0.00 255.0 /end CHARACTERISTIC
/begin CHARACTERISTIC CaSCD_swtSegLenPin2Pos_C "Variantenschalter zur Überprüfung der Segmentlänge und Pin Status zur Verifikation des Nockenwellensignals" VALUE 0xC9A7A Kw_Wu8 1.000 OneToOne 0.00 1.000 FORMAT "%5.3" EXTENDED_LIMITS 0.00 255.0 /end CHARACTERISTIC
/begin CHARACTERISTIC CaSCD_tiPeriodRev1Max_C "Max. Zeit der vorletzten Periode einer Phasengeberradumdrehung" VALUE 0xC05A8 Kw_Ws16 3276.700 Period_ms 0.00 3276.700 FORMAT "%8.3" EXTENDED_LIMITS -3276.800 3276.700 /end CHARACTERISTIC
/begin CHARACTERISTIC CaSCD_tiPeriodRev2Max_C "Max. Zeit der letzten Periode einer Phasengeberradumdrehung" VALUE 0xC05AA Kw_Ws16 3276.700 Period_ms 0.00 3276.700 FORMAT "%8.3" EXTENDED_LIMITS -3276.800 3276.700 /end CHARACTERISTIC
/begin CHARACTERISTIC CaSCD_tiTimOutOfs_C "Offset zur Berechnung des Timeout-Wertes der Plausibilitätsprüfung" VALUE 0xC05AC Kw_Ws16 3276.700 Period_ms 0.00 3276.700 FORMAT "%8.3" EXTENDED_LIMITS -3276.800 3276.700 /end CHARACTERISTIC
/begin CHARACTERISTIC CBACD_ctPwrStgOnMax_C "Maximal Einschalt Anzahl der Endstufe bei SCB oder Übertemperaturfehler" VALUE 0xC9A7C Kw_Wu16 65535.00 OneToOne 0.00 65535.00 FORMAT "%8.2" /end CHARACTERISTIC
/begin CHARACTERISTIC CBACD_numDia_C "Parameter fuer Hardware Diagnose-Pin Auswahl" VALUE 0xC9A7E Kw_Wu8 33.0000000000 NumPinDia 0.00 33.0000000000 FORMAT "%13.10" /end CHARACTERISTIC
/begin CHARACTERISTIC CBACD_numDioOut_C "Parameter fuer Hardware Digitalausgang-Pin Auswahl" VALUE 0xC9A7F Kw_Wu8 15.0000000000 NumPinDioOut 0.00 15.0000000000 FORMAT "%13.10" /end CHARACTERISTIC
/begin CHARACTERISTIC CBACD_stInvOut_C "Invertierung des Digitalausgangs ja/nein" VALUE 0xC9A80 Kw_Wu8 1.000 OneToOne 0.00 1.000 FORMAT "%5.3" EXTENDED_LIMITS 0.00 255.0 /end CHARACTERISTIC
/begin CHARACTERISTIC CBACD_stPwrStgActv_C "Spezifikation des Abschaltverhaltens der Endstufe" VALUE 0xC9A81 Kw_Wu8 255.0 OneToOne 0.00 255.0 FORMAT "%5.1" /end CHARACTERISTIC
/begin CHARACTERISTIC CBACD_stPwrStgDia_C "Spezifikation des Diagnoseverhaltens der Endstufe" VALUE 0xC9A82 Kw_Wu8 255.0 OneToOne 0.00 255.0 FORMAT "%5.1" /end CHARACTERISTIC
/begin CHARACTERISTIC CBACD_stSPICtl_C "Parameter zur Kennzeichnung ob Endstufe SPI oder nicht SPI fähig ( 1 = SPI Endstufe, 0 = Nicht SPI Endstufe )" VALUE 0xC9A83 Kw_Wu8 1.000 OneToOne 0.00 1.000 FORMAT "%5.3" EXTENDED_LIMITS 0.00 255.0 /end CHARACTERISTIC
/begin CHARACTERISTIC CBACD_tiBtwTst_C "Zeit zwischen zwei Test wenn Endstufe defekt" VALUE 0xC9A84 Kw_Wu16 29980.00 Time_ms 20.00000 30000.00 FORMAT "%8.2" EXTENDED_LIMITS 0.00 655350.0 /end CHARACTERISTIC
/begin CHARACTERISTIC CBACD_tiDebExcTempDef_C "Fehlerentprellzeit Uebertemperatur" VALUE 0xC9A86 Kw_Wu16 655350.0 Time_ms 0.00 655350.0 FORMAT "%8.1" /end CHARACTERISTIC
/begin CHARACTERISTIC CBACD_tiDebExcTempOk_C "Heilungsentprellzeit Uebertemperatur" VALUE 0xC9A88 Kw_Wu16 655350.0 Time_ms 0.00 655350.0 FORMAT "%8.1" /end CHARACTERISTIC
/begin CHARACTERISTIC CBACD_tiDebNoLoadDef_C "Fehlerentprellzeit keine Last" VALUE 0xC9A8A Kw_Wu16 655350.0 Time_ms 0.00 655350.0 FORMAT "%8.1" /end CHARACTERISTIC
/begin CHARACTERISTIC CBACD_tiDebNoLoadOk_C "Heilungsentprellzeit keine Last" VALUE 0xC9A8C Kw_Wu16 655350.0 Time_ms 0.00 655350.0 FORMAT "%8.1" /end CHARACTERISTIC
/begin CHARACTERISTIC CBACD_tiDebShortCircBatDef_C "Fehlerentprellzzeit Kurzschluss nach UBatt" VALUE 0xC9A8E Kw_Wu16 655350.0 Time_ms 0.00 655350.0 FORMAT "%8.1" /end CHARACTERISTIC
/begin CHARACTERISTIC CBACD_tiDebShortCircBatOk_C "Heilungsentprellzeit Kurzschluss nach UBatt" VALUE 0xC9A90 Kw_Wu16 655350.0 Time_ms 0.00 655350.0 FORMAT "%8.1" /end CHARACTERISTIC
/begin CHARACTERISTIC CBACD_tiDebShortCircGndDef_C "Fehlerentprellzeit Kurzschluss nach Masse" VALUE 0xC9A92 Kw_Wu16 655350.0 Time_ms 0.00 655350.0 FORMAT "%8.1" /end CHARACTERISTIC
/begin CHARACTERISTIC CBACD_tiDebShortCircGndOk_C "Heilungsentprellzeit Kurzschluss nach Masse" VALUE 0xC9A94 Kw_Wu16 655350.0 Time_ms 0.00 655350.0 FORMAT "%8.1" /end CHARACTERISTIC
/begin CHARACTERISTIC CBACD_tiPwrStgOn_C "Zeit für welche die Endstufe eingeschalten wird bei nicht SPI Endstufen" VALUE 0xC9A96 Kw_Wu16 655140.0 Time_ms 0.00 655140.0 FORMAT "%8.1" EXTENDED_LIMITS 0.00 655350.0 /end CHARACTERISTIC
/begin CHARACTERISTIC Clg_dtMinDynTst_C "Minimaler Anstieg der Wassertemperatur zur Verifizierung derPlausibilität der Wassertemperatur" VALUE 0xC9A98 Kw_Ws16 6553.500 TempDiff_Cels -3276.800 3276.700 FORMAT "%8.3" /end CHARACTERISTIC
/begin CHARACTERISTIC Clg_nMinEnaDynTst_C "Minimale Drehzahl zur Aktivierung des dynamischen Plausibilitätstests" VALUE 0xC9A9A Kw_Ws16 65535.00 EngN -32768.00 32767.00 FORMAT "%8.2" /end CHARACTERISTIC
/begin CHARACTERISTIC Clg_qMinEnaDynTst_C "Minimale Einspritzmenge zur Aktivierung des dynamischen Plausibilitätstests" VALUE 0xC9A9C Kw_Ws16 655.3500 InjMass -327.6800 327.6700 FORMAT "%8.4" /end CHARACTERISTIC
/begin CHARACTERISTIC Clg_tiInitTmr_C "Zeitspanne nach Motorstatrt bis die Wassertemperatur erfasst wird" VALUE 0xC9A9E Kw_Ws16 655.3500 Time_s -327.6800 327.6700 FORMAT "%8.4" /end CHARACTERISTIC
/begin CHARACTERISTIC Clg_tiMaxDynTst_CUR "Kennlinie der maximal zulässigen Testzeit des dynamischen Plausibilitätstest" CURVE 0xC9AA0 Kl_Xs16_Ws16 167769.6 Time_DynTst -83886.08 83883.52 FORMAT "%8.2"
 /begin AXIS_DESCR STD_AXIS Clg_tClntStrtVal_mp Temp_Cels 10 -50.140 899.860 FORMAT "%8.3" EXTENDED_LIMITS -3549.940 3003.560 DEPOSIT ABSOLUTE /end AXIS_DESCR
/end CHARACTERISTIC
/begin CHARACTERISTIC Clg_tMinClntDynTst_C "Minimale Wassertemperatur zur Verifizierung der Plausibilitäts der Wassertemperatur" VALUE 0xC9ACA Kw_Ws16 950.000 Temp_Cels -50.140 899.860 FORMAT "%8.3" EXTENDED_LIMITS -3549.940 3003.560 /end CHARACTERISTIC
/begin CHARACTERISTIC CmbChb_facAPSCor_CUR "Kennlinie für Korrekturwert aus Luftdruck" CURVE 0xC9AE8 Kl_Xs16_Ws16 1.000000 Fact 0.00 1.000000 FORMAT "%8.6" EXTENDED_LIMITS -4.000000 3.999878
 /begin AXIS_DESCR STD_AXIS APSCD_pVal Pres_hPa 8 0.00 3500.000 FORMAT "%8.3" EXTENDED_LIMITS -32768.00 32767.00 DEPOSIT ABSOLUTE /end AXIS_DESCR
/end CHARACTERISTIC
/begin CHARACTERISTIC CmbChb_facIATSCor_CUR "Kennlinie für Korrekturwert aus Lufttemperatur" CURVE 0xC9B0A Kl_Xs16_Ws16 1.000000 Fact 0.00 1.000000 FORMAT "%8.6" EXTENDED_LIMITS -4.000000 3.999878
 /begin AXIS_DESCR STD_AXIS IATSCD_tAir Temp_Cels 8 -50.14000 199.8600 FORMAT "%8.4" EXTENDED_LIMITS -3549.940 3003.560 DEPOSIT ABSOLUTE /end AXIS_DESCR
/end CHARACTERISTIC
/begin CHARACTERISTIC CmbChb_nAvrgThrHi_C "maximale Drehzahl fuer Ueberwachung" VALUE 0xC9ACC Kw_Ws16 6000.000 EngN 0.00 6000.000 FORMAT "%8.3" EXTENDED_LIMITS -32768.00 32767.00 /end CHARACTERISTIC
/begin CHARACTERISTIC CmbChb_nAvrgThrLo_C "minimale Drehzahl fuer Ueberwachung" VALUE 0xC9ACE Kw_Ws16 6000.000 EngN 0.00 6000.000 FORMAT "%8.3" EXTENDED_LIMITS -32768.00 32767.00 /end CHARACTERISTIC
/begin CHARACTERISTIC CmbChb_qRawThrHi_C "maximale Menge fuer Ueberwachung" VALUE 0xC9AD0 Kw_Ws16 655.3500 InjMass -327.6800 327.6700 FORMAT "%8.4" /end CHARACTERISTIC
/begin CHARACTERISTIC CmbChb_qRawThrLo_C "minimale Menge fuer Ueberwachung" VALUE 0xC9AD2 Kw_Ws16 655.3500 InjMass -327.6800 327.6700 FORMAT "%8.4" /end CHARACTERISTIC
/begin CHARACTERISTIC CmbChb_tClntThrLo_C "minimale Wassertemperatur fuer Ueberwachung" VALUE 0xC9AD4 Kw_Ws16 950.000 Temp_Cels -50.140 899.860 FORMAT "%8.3" EXTENDED_LIMITS -3549.940 3003.560 /end CHARACTERISTIC
/begin CHARACTERISTIC CmbChb_vThrHi_C "maximale Geschwindigkeit fuer Ueberwachung" VALUE 0xC9AD6 Kw_Ws16 327.6700 Vel 0.00 327.6700 FORMAT "%8.4" EXTENDED_LIMITS -327.6800 327.6700 /end CHARACTERISTIC
/begin CHARACTERISTIC CmbChb_tiDebClutchChng_C "Entprellzeit für die Zustandsänderung des Kupplungssignals" VALUE 0xC9AD8 Kw_Wu16 655350.0 Time_ms 0.00 655350.0 FORMAT "%8.1" /end CHARACTERISTIC
/begin CHARACTERISTIC CmbChb_tiDlyStr_C "Startausblendezeit" VALUE 0xC9ADA Kw_Wu16 655350.0 Time_ms 0.00 655350.0 FORMAT "%8.1" /end CHARACTERISTIC
/begin CHARACTERISTIC CmbChb_ctEngRevPerBlk_C "Blockgroesse (UpM) f. Ausbl./Test/Ausw.verz." VALUE 0xC9ADC Kw_Wu16 65535.00 OneToOne 0.00 65535.00 FORMAT "%8.2" /end CHARACTERISTIC
/begin CHARACTERISTIC CmbChb_ctSegTDC1_C "Offset für internen Segmentzähler in Aussetzererkennung" VALUE 0xC9ADE Kw_Wu16 0.00 OneToOne 0.00 0.00 FORMAT "%8.2" EXTENDED_LIMITS 0.00 65535.00 /end CHARACTERISTIC
/begin CHARACTERISTIC CmbChb_numBlk_C "Blockanzahl fuer Test" VALUE 0xC9AE0 Kw_Wu16 65535.00 OneToOne 0.00 65535.00 FORMAT "%8.2" /end CHARACTERISTIC
/begin CHARACTERISTIC CmbChb_dnSegMin_C "Prozentuelle Komponente des durchschnittlichen minimalen Drehzahlanstieges" VALUE 0xC9AE2 Kw_Ws16 799.9878 Prc -400.0000 399.9878 FORMAT "%8.4" /end CHARACTERISTIC
/begin CHARACTERISTIC CmbChb_ctMisfireMax_C "maximale Anzahl von Aussetzern pro Test" VALUE 0xC9AE4 Kw_Wu16 65535.00 OneToOne 0.00 65535.00 FORMAT "%8.2" /end CHARACTERISTIC
/begin CHARACTERISTIC CmbChb_nThres_C "Drehzahlschwelle für Schuberkennung" VALUE 0xC9B2C Kw_Ws16 6000.000 EngN 0.00 6000.000 FORMAT "%8.3" EXTENDED_LIMITS -32768.00 32767.00 /end CHARACTERISTIC
/begin CHARACTERISTIC CmbChb_qThres_C "Mengenschwelle für Schuberkennung" VALUE 0xC9B2E Kw_Ws16 327.6700 InjMassCyc 0.00 327.6700 FORMAT "%8.4" EXTENDED_LIMITS -327.6800 327.6700 /end CHARACTERISTIC
/begin CHARACTERISTIC CmbChb_rCorMax_C "Maximalwert, der Korrekturwert in Schubphase begrenzt" VALUE 0xC9B30 Kw_Ws16 100.0000 Prc 0.00 100.0000 FORMAT "%8.4" EXTENDED_LIMITS -400.0000 399.9878 /end CHARACTERISTIC
/begin CHARACTERISTIC CmbChb_rTempCor_MAP "Kennfeld für Brennraumkorrekturwertberechnung nach Schub" MAP 0xC9B32 Kf_Xs16_Ys16_Ws16 100.0000 Prc 0.00 100.0000 FORMAT "%8.4" EXTENDED_LIMITS -400.0000 399.9878
 /begin AXIS_DESCR STD_AXIS CmbChb_rEnvCor Prc 12 0.00 100.0000 FORMAT "%8.4" EXTENDED_LIMITS -400.0000 399.9878 DEPOSIT ABSOLUTE /end AXIS_DESCR
 /begin AXIS_DESCR STD_AXIS CmbChb_tiDwn_mp TimeRed 12 0.00 3600.000 FORMAT "%8.3" EXTENDED_LIMITS -5242.880 5242.720 DEPOSIT ABSOLUTE /end AXIS_DESCR
/end CHARACTERISTIC
/begin CHARACTERISTIC CmbChb_rTiUpCor_CUR "Kennlinie für Timerkorrekturwert bei ansteigender Rampe" CURVE 0xC9C86 Kl_Xs16_Ws16 100.0000 Prc 0.00 100.0000 FORMAT "%8.4" EXTENDED_LIMITS -400.0000 399.9878
 /begin AXIS_DESCR STD_AXIS CmbChb_tiUp_mp TimeRed 8 0.00 3600.000 FORMAT "%8.3" EXTENDED_LIMITS -5242.880 5242.720 DEPOSIT ABSOLUTE /end AXIS_DESCR
/end CHARACTERISTIC
/begin CHARACTERISTIC CmbChb_swtMonClutchVal_C "DS-Wert für SW-Schalter CmbChb_swtMonClutch, De/Aktivierung Überwachung Zündaussetzererkennung" VALUE 0xC9AE6 Kw_Wu8 3.000 OneToOne 0.00 3.000 FORMAT "%5.3" EXTENDED_LIMITS 0.00 255.0 /end CHARACTERISTIC
/begin CHARACTERISTIC CmbChb_swtMonClutchType_C "Typ SW-Schalter CmbChb_swtMonClutch (1: EEPROM, 2: DS-Wert CrCCD_swtMonClutchVal_C)" VALUE 0xC9AE7 Kw_Wu8 1.000 OneToOne 1.000 2.000 FORMAT "%5.3" EXTENDED_LIMITS 0.00 255.0 /end CHARACTERISTIC
/begin CHARACTERISTIC CoDT_tiChkGrpDT1_C "Time delay for DT1 filter" VALUE 0xC9D04 Kw_Wu32 4294.9673 TimeDelay_s 0.0000010000000 4294.9673 FORMAT "%9.4" /end CHARACTERISTIC
/begin CHARACTERISTIC CoDT_dChkGrpDT1Kd_C "Kd value for DT1 fliter" VALUE 0xC9D08 Kw_Ws32 65535.9999847 Kd -32768.0000000 32767.9999847 FORMAT "%13.7" /end CHARACTERISTIC
/begin CHARACTERISTIC CoDT_tiChkGrpPT1_C "Time delay for PT1 filter" VALUE 0xC9D0C Kw_Wu32 4294.9673 TimeDelay_s 0.0000010000000 4294.9673 FORMAT "%9.4" /end CHARACTERISTIC
/begin CHARACTERISTIC CoDT_dOfsGripDet_C "Offset for dn/dt calculation for grip detection" VALUE 0xC9D10 Kw_Ws16 65535.00 dn_dZfine -32768.00 32767.00 FORMAT "%8.2" /end CHARACTERISTIC
/begin CHARACTERISTIC CoDT_dOfsNoGripDet_C "Offset for dn/dt calculation for no grip detection" VALUE 0xC9D12 Kw_Ws16 65535.00 dn_dZfine -32768.00 32767.00 FORMAT "%8.2" /end CHARACTERISTIC
/begin CHARACTERISTIC CoDT_tiDT1_C "T factor for evaluation of the CoDT_trqDes gradient" VALUE 0xC9CC0 Kw_Wu32 4294.9673 TimeDelay_s 0.0000010000000 4294.9673 FORMAT "%9.4" /end CHARACTERISTIC
/begin CHARACTERISTIC CoDT_dDT1Kd_C "Kd Faktor für die Ermittlung des Gradienten von CoDT_trqDes" VALUE 0xC9CC4 Kw_Ws32 65535.9999847 Kd -32768.0000000 32767.9999847 FORMAT "%13.7" /end CHARACTERISTIC
/begin CHARACTERISTIC CoDT_dThetaGripDet_C "Theta for dn/dt calculation for grip detection" VALUE 0xC9D14 Kw_Ws16 655.3500 Moment_Inertia -327.6800 327.6700 FORMAT "%8.4" /end CHARACTERISTIC
/begin CHARACTERISTIC CoDT_dThetaNoGripDet_C "Theta for dn/dt calculation for no grip detection" VALUE 0xC9D16 Kw_Ws16 655.3500 Moment_Inertia -327.6800 327.6700 FORMAT "%8.4" /end CHARACTERISTIC
/begin CHARACTERISTIC CoDT_dtrqLimDwnCurr_C "negative Steigung für einen Rampenschalter im Curr-Pfad" VALUE 0xC9CA8 Kw_Wu32 6553599.99847 RmpTrq 0.00 6553599.99847 FORMAT "%13.5" /end CHARACTERISTIC
/begin CHARACTERISTIC CoDT_dtrqLimDwnLead_C "negative Steigung für einen Rampenschalter im Lead-Pfad" VALUE 0xC9CAC Kw_Wu32 6553599.99847 RmpTrq 0.00 6553599.99847 FORMAT "%13.5" /end CHARACTERISTIC
/begin CHARACTERISTIC CoDT_dtrqLimUpCurr_C "positive Steigung für einen Rampenschalter im Curr-Pfad" VALUE 0xC9CB0 Kw_Wu32 6553599.99847 RmpTrq 0.00 6553599.99847 FORMAT "%13.5" /end CHARACTERISTIC
/begin CHARACTERISTIC CoDT_dtrqLimUpLead_C "positive Steigung für Rampenschalter im Lead-Pfad" VALUE 0xC9CB4 Kw_Wu32 6553599.99847 RmpTrq 0.00 6553599.99847 FORMAT "%13.5" /end CHARACTERISTIC
/begin CHARACTERISTIC CoDT_swtAcsFltEna_C "Schalter um Filterwert zu aktivieren (1 = Filterung, 0 = keine Filterung)" VALUE 0xC9D24 Kw_Wu8 1.000 OneToOne 0.00 1.000 FORMAT "%5.3" EXTENDED_LIMITS 0.00 255.0 /end CHARACTERISTIC
/begin CHARACTERISTIC CoDT_swtCoTypeVal_C "Sollmoment im Schub über Fahrpedalstellung (0: conventional; 1: mastershift)" VALUE 0xC9CB8 Kw_Wu8 1.000 OneToOne 0.00 1.000 FORMAT "%5.3" EXTENDED_LIMITS 0.00 255.0 /end CHARACTERISTIC
/begin CHARACTERISTIC CoDT_swtCoTypeType_C "CoDT_swtCoType 0: bed. Spez. ; 1: form E2PROM; 2: Applikation" VALUE 0xC9CB9 Kw_Wu8 1.000 OneToOne 1.000 2.000 FORMAT "%5.3" EXTENDED_LIMITS 0.00 255.0 /end CHARACTERISTIC
/begin CHARACTERISTIC CoDT_swtNoGripDet_C "Schalter zur deaktivierung der Kraftschlusserkennung mittels Trägheitsmoment (1 = deaktiviert, 0 = aktiviert)" VALUE 0xC9D18 Kw_Wu8 255.0 OneToOne 0.00 255.0 FORMAT "%5.1" /end CHARACTERISTIC
/begin CHARACTERISTIC CoDT_tiDebGearUnVal_C "Delay time for debouncing neutral condition" VALUE 0xC9D1A Kw_Wu16 655350.0 Time_ms 0.00 655350.0 FORMAT "%8.1" /end CHARACTERISTIC
/begin CHARACTERISTIC CoDT_tiDebNoGrip_C "Delay time for debouncing No Grip" VALUE 0xC9D1C Kw_Wu16 655350.0 Time_ms 0.00 655350.0 FORMAT "%8.1" /end CHARACTERISTIC
/begin CHARACTERISTIC CoDT_tiFltPT1_C "Parameter für Filterung des Momentenbands" VALUE 0xC9D28 Kw_Wu32 4294.9673 TimeDelay_s 0.0000010000000 4294.9673 FORMAT "%9.4" /end CHARACTERISTIC
/begin CHARACTERISTIC CoDT_tiGripDeb_C "Entprellzeit für die Kraftschlußerkennung im Triebstrang" VALUE 0xC9D1E Kw_Wu16 655350.0 Time_ms 0.00 655350.0 FORMAT "%8.1" /end CHARACTERISTIC
/begin CHARACTERISTIC CoDT_tiTrqRedMaxCurr_C "Zeitschwelle für ""langen"" Getriebeeingriff im Curr-Pfad" VALUE 0xC9CBA Kw_Wu16 655350.0 Time_ms 0.00 655350.0 FORMAT "%8.1" /end CHARACTERISTIC
/begin CHARACTERISTIC CoDT_tiTrqRedMaxLead_C "Zeitschwell für ""langen"" Getriebeeingriff im Lead-Pfad" VALUE 0xC9CBC Kw_Wu16 655350.0 Time_ms 0.00 655350.0 FORMAT "%8.1" /end CHARACTERISTIC
/begin CHARACTERISTIC CoDT_tiTrqDesDebDef_C "Fehlerentprellzeit für Momentanforderung" VALUE 0xC9CC8 Kw_Wu16 655350.0 Time_ms 0.00 655350.0 FORMAT "%8.1" /end CHARACTERISTIC
/begin CHARACTERISTIC CoDT_tiTrqDesDebOk_C "Fehlerheilungszeit für Momentanforderung" VALUE 0xC9CCA Kw_Wu16 655350.0 Time_ms 0.00 655350.0 FORMAT "%8.1" /end CHARACTERISTIC
/begin CHARACTERISTIC CoDT_trqDiffMaxDes_CUR "Kennlinie von CoDT_trqDiffMaxDes" CURVE 0xC9CCC Kl_Xs16_Ws16 130.0000 Trq 20.00000 150.0000 FORMAT "%8.4" EXTENDED_LIMITS -3276.800 3276.700
 /begin AXIS_DESCR STD_AXIS CoDT_dtrqDes_mp dTrq 6 0.00 3000.000 FORMAT "%8.3" EXTENDED_LIMITS -3276.800 3276.700 DEPOSIT ABSOLUTE /end AXIS_DESCR
/end CHARACTERISTIC
/begin CHARACTERISTIC CoDT_trqDiffMaxLead_CUR "Kennlinie von CoDT_trqDiffMaxLead" CURVE 0xC9CE6 Kl_Xs16_Ws16 130.0000 Trq 20.00000 150.0000 FORMAT "%8.4" EXTENDED_LIMITS -3276.800 3276.700
 /begin AXIS_DESCR STD_AXIS CoDT_dtrqLead_mp dTrq 6 0.00 3000.000 FORMAT "%8.3" EXTENDED_LIMITS -3276.800 3276.700 DEPOSIT ABSOLUTE /end AXIS_DESCR
/end CHARACTERISTIC
/begin CHARACTERISTIC CoDT_tiTrqLeadDebDef_C "Fehlerentprellzeit für Momentanforderung" VALUE 0xC9D00 Kw_Wu16 655350.0 Time_ms 0.00 655350.0 FORMAT "%8.1" /end CHARACTERISTIC
/begin CHARACTERISTIC CoDT_tiTrqLeadDebOk_C "Fehlerheilungszeit für Momentanforderung" VALUE 0xC9D02 Kw_Wu16 655350.0 Time_ms 0.00 655350.0 FORMAT "%8.1" /end CHARACTERISTIC
/begin CHARACTERISTIC CoDT_trqMinInit_C "Initialwert für minimales Vortriebsmoment" VALUE 0xC9D2C Kw_Ws16 11000.00 TrqPrp -5000.000 6000.000 FORMAT "%8.3" EXTENDED_LIMITS -6553.600 6553.400 /end CHARACTERISTIC
/begin CHARACTERISTIC CoDT_vGrip_C "Geschwindigkeitsschwelle für Kraftschlußerkennung im Triebstrang" VALUE 0xC9D20 Kw_Ws16 400.0000 Vel -100.0000 300.0000 FORMAT "%8.4" EXTENDED_LIMITS -327.6800 327.6700 /end CHARACTERISTIC
/begin CHARACTERISTIC CoEng_dnOvrFulMin_C "untere Hysteresegrenze für Overfueling Drehzahlgradienten" VALUE 0xCA0D0 Kw_Ws16 655350.0 dn_dZ20 -327680.0 327670.0 FORMAT "%8.1" /end CHARACTERISTIC
/begin CHARACTERISTIC CoEng_dnOvrFulMax_C "obere Hysteresegrenze für Overfueling Drehzahlgradienten" VALUE 0xCA0D2 Kw_Ws16 655350.0 dn_dZ20 -327680.0 327670.0 FORMAT "%8.1" /end CHARACTERISTIC
/begin CHARACTERISTIC CoEng_stdnOvrFulLow_C "Status für Overfueling Drehzahlgradienten Hysterese aus" VALUE 0xCA0D4 Kw_Ws16 65535.00 OneToOne -32768.00 32767.00 FORMAT "%8.2" READ_ONLY /end CHARACTERISTIC
/begin CHARACTERISTIC CoEng_stdnOvrFulHigh_C "Status für Overfueling Drehzahlgradienten Hysterese ein" VALUE 0xCA0D6 Kw_Ws16 65535.00 OneToOne -32768.00 32767.00 FORMAT "%8.2" READ_ONLY /end CHARACTERISTIC
/begin CHARACTERISTIC CoEng_dqSubsRgnRmpUp_C "Rampensteigung zur Umschaltung" VALUE 0xC9D4C Kw_Wu32 655359.999847 RmpInjMassCyc 0.00 655359.999847 FORMAT "%13.6" /end CHARACTERISTIC
/begin CHARACTERISTIC CoEng_dqSubsRgnRmpDwn_C "Rampensteigung zur Umschaltung" VALUE 0xC9D50 Kw_Wu32 655359.999847 RmpInjMassCyc 0.00 655359.999847 FORMAT "%13.6" /end CHARACTERISTIC
/begin CHARACTERISTIC CoEng_dtrqEngPrtRgnMonUp_C "Steigung zur Aufwärtsrampung im Fehlerfall" VALUE 0xCA0D8 Kw_Wu32 6553599.99847 RmpTrq 0.00 6553599.99847 FORMAT "%13.5" /end CHARACTERISTIC
/begin CHARACTERISTIC CoEng_dtrqEngPrtRgnMonDwn_C "Steigung zur Abwärtsrampung im Fehlerfall" VALUE 0xCA0DC Kw_Wu32 6553599.99847 RmpTrq 0.00 6553599.99847 FORMAT "%13.5" /end CHARACTERISTIC
/begin CHARACTERISTIC CoEng_dtrqLimUp_C "pos. Rampenanstieg bei Umschaltung auf Begrenzungsmoment bei Systemfehler" VALUE 0xCA0E0 Kw_Wu32 6553599.99847 RmpTrq 0.00 6553599.99847 FORMAT "%13.5" /end CHARACTERISTIC
/begin CHARACTERISTIC CoEng_dtrqLimDwn_C "neg. Rampenanstieg bei Rückkehr von dem Begrenzungsmoment bei Systemfehler" VALUE 0xCA0E4 Kw_Wu32 6553599.99847 RmpTrq 0.00 6553599.99847 FORMAT "%13.5" /end CHARACTERISTIC
/begin CHARACTERISTIC CoEng_dtrqLimUp1_C "positive Rampensteigung für Rampenschalter" VALUE 0xCA0E8 Kw_Wu32 6553599.99847 RmpTrq 0.00 6553599.99847 FORMAT "%13.5" /end CHARACTERISTIC
/begin CHARACTERISTIC CoEng_dtrqLimDwn1_C "negative Steigung für einen Rampenschalter" VALUE 0xCA0EC Kw_Wu32 6553599.99847 RmpTrq 0.00 6553599.99847 FORMAT "%13.5" /end CHARACTERISTIC
/begin CHARACTERISTIC CoEng_dtrqLimUp2_C "positive Steigung für Rampenschalter 2" VALUE 0xCA0F0 Kw_Wu32 6553599.99847 RmpTrq 0.00 6553599.99847 FORMAT "%13.5" /end CHARACTERISTIC
/begin CHARACTERISTIC CoEng_dtrqLimDwn2_C "negative Steigung für Rampenschalter 2" VALUE 0xCA0F4 Kw_Wu32 6553599.99847 RmpTrq 0.00 6553599.99847 FORMAT "%13.5" /end CHARACTERISTIC
/begin CHARACTERISTIC CoEng_dtrqLimUp3_C "positive Rampensteigung für Rampenschalter" VALUE 0xCA0F8 Kw_Wu32 6553599.99847 RmpTrq 0.00 6553599.99847 FORMAT "%13.5" /end CHARACTERISTIC
/begin CHARACTERISTIC CoEng_dtrqLimDwn3_C "negative Rampensteigung für Rampenschalter" VALUE 0xCA0FC Kw_Wu32 6553599.99847 RmpTrq 0.00 6553599.99847 FORMAT "%13.5" /end CHARACTERISTIC
/begin CHARACTERISTIC CoEng_dtrqLimUp4_C "positive Rampensteigung für Rampenschalter" VALUE 0xCA100 Kw_Wu32 6553599.99847 RmpTrq 0.00 6553599.99847 FORMAT "%13.5" /end CHARACTERISTIC
/begin CHARACTERISTIC CoEng_dtrqLimDwn4_C "negative Rampensteigung für Rampenschalter" VALUE 0xCA104 Kw_Wu32 6553599.99847 RmpTrq 0.00 6553599.99847 FORMAT "%13.5" /end CHARACTERISTIC
/begin CHARACTERISTIC CoEng_dtrqPFltOvldUp_C "Steigung für Partikelfilter uberladen Rampe(up)" VALUE 0xCA108 Kw_Wu32 6553599.99847 RmpTrq 0.00 6553599.99847 FORMAT "%13.5" /end CHARACTERISTIC
/begin CHARACTERISTIC CoEng_dtrqPFltOvldDwn_C "Steigung für Partikelfilter uberladen Rampe(down)" VALUE 0xCA10C Kw_Wu32 6553599.99847 RmpTrq 0.00 6553599.99847 FORMAT "%13.5" /end CHARACTERISTIC
/begin CHARACTERISTIC CoEng_tiOvrFulDT1_C "Zeit für Overfueling DT1" VALUE 0xCA110 Kw_Wu32 4294.9673 TimeDelay_s 0.0000010000000 4294.9673 FORMAT "%9.4" /end CHARACTERISTIC
/begin CHARACTERISTIC CoEng_facOvrFulDKd_C "Kd für overfueling DT1" VALUE 0xCA114 Kw_Ws32 32767.9999924 Kd_rpm2dndt -16384.0000000 16383.9999924 FORMAT "%13.7" /end CHARACTERISTIC
/begin CHARACTERISTIC CoEng_ExtWaitMsk2_C "Bitmaske für externe Ereignisse vor Öffnen des Hauptrelais" VALUE 0xC9D3C Kw_Wu8 255.0 OneToOne 0.00 255.0 FORMAT "%5.1" /end CHARACTERISTIC
/begin CHARACTERISTIC CoEng_ExtWaitMsk_C "Bitmaske für externe Ereignisse for Schreiben des EEPROM" VALUE 0xC9D3D Kw_Wu8 255.0 OneToOne 0.00 255.0 FORMAT "%5.1" /end CHARACTERISTIC
/begin CHARACTERISTIC CoEng_facAdjDfl_C "Defaultwert für Abgleich Momentenbegrenzung" VALUE 0xCA118 Kw_Ws16 2.000000 Fact 0.00 2.000000 FORMAT "%8.6" EXTENDED_LIMITS -4.000000 3.999878 /end CHARACTERISTIC
/begin CHARACTERISTIC CoEng_facAdjMax_C "Maximaler Abgleichwert für Abgleich Momentenbegrenzung" VALUE 0xCA11A Kw_Ws16 7.999878 Fact -4.000000 3.999878 FORMAT "%8.6" /end CHARACTERISTIC
/begin CHARACTERISTIC CoEng_facAdjMin_C "Minimaler Abgleichwert für Abgleich Momentenbegrenzung" VALUE 0xCA11C Kw_Ws16 7.999878 Fact -4.000000 3.999878 FORMAT "%8.6" /end CHARACTERISTIC
/begin CHARACTERISTIC CoEng_facFlConsumAdjDfl_C "Ersatzwert für den Kraftstoffverbrauchsabgleich" VALUE 0xC9D54 Kw_Ws16 2.000000 Fact 0.00 2.000000 FORMAT "%8.6" EXTENDED_LIMITS -4.000000 3.999878 /end CHARACTERISTIC
/begin CHARACTERISTIC CoEng_facFlConsumAdjMax_C "Maximalwert des Kraftstoffverbrauch-Abgleichwerts" VALUE 0xC9D56 Kw_Ws16 2.000000 Fact 0.00 2.000000 FORMAT "%8.6" EXTENDED_LIMITS -4.000000 3.999878 /end CHARACTERISTIC
/begin CHARACTERISTIC CoEng_facFlConsumAdjMin_C "Minumumwert des Kraftstoffverbrauch-Abgleichwerts" VALUE 0xC9D58 Kw_Ws16 2.000000 Fact 0.00 2.000000 FORMAT "%8.6" EXTENDED_LIMITS -4.000000 3.999878 /end CHARACTERISTIC
/begin CHARACTERISTIC CoEng_DebDef_GbxRpmRduc_C "Defekt Entprellzeit für Momentenbegrenzung von Partikelfilter" VALUE 0xCA11E Kw_Wu16 655350.0 Time_ms 0.00 655350.0 FORMAT "%8.1" /end CHARACTERISTIC
/begin CHARACTERISTIC CoEng_DebOk_GbxRpmRduc_C "Heilungs entprellung für Momentenreduktion durch Partikelfilter" VALUE 0xCA120 Kw_Wu16 655350.0 Time_ms 0.00 655350.0 FORMAT "%8.1" /end CHARACTERISTIC
/begin CHARACTERISTIC CoEng_lSumFuncPref_C "Schwelle für gefahrene Strecke" VALUE 0xCA000 Kw_Wu32 1000000.00000 Length 0.00 1000000.00000 FORMAT "%13.5" EXTENDED_LIMITS 0.00 4294967295.00 /end CHARACTERISTIC
/begin CHARACTERISTIC CoEng_nActrRelease_C "Mindestdrehzahl für Stellerfreigabe" VALUE 0xC9D30 Kw_Ws16 32727.00 EngN 40.00000 32767.00 FORMAT "%8.2" EXTENDED_LIMITS -32768.00 32767.00 /end CHARACTERISTIC
/begin CHARACTERISTIC CoEng_nOvrFulMax_C "obere Hysteresegrenze für Overfueling Motordrehzahl" VALUE 0xCA122 Kw_Ws16 5960.000 EngN 40.00000 6000.000 FORMAT "%8.3" EXTENDED_LIMITS -32768.00 32767.00 /end CHARACTERISTIC
/begin CHARACTERISTIC CoEng_nOvrFulMin_C "untere Hysteresegrenze für Overfueling Motordrehzahl" VALUE 0xCA124 Kw_Ws16 5960.000 EngN 40.00000 6000.000 FORMAT "%8.3" EXTENDED_LIMITS -32768.00 32767.00 /end CHARACTERISTIC
/begin CHARACTERISTIC CoEng_nShOffTstMax_C "maximale Drehzahlschwelle für Abstelltest" VALUE 0xCA068 Kw_Ws16 32767.00 EngN 0.00 32767.00 FORMAT "%8.2" EXTENDED_LIMITS -32768.00 32767.00 /end CHARACTERISTIC
/begin CHARACTERISTIC CoEng_nShOffTstMin_C "minimale Drehzahlschwelle für Abstelltest" VALUE 0xCA06A Kw_Ws16 32767.00 EngN 0.00 32767.00 FORMAT "%8.2" EXTENDED_LIMITS -32768.00 32767.00 /end CHARACTERISTIC
/begin CHARACTERISTIC CoEng_nSlpLimMin_C "Drehzahlschwelle f. Aktivierung Tuboschubbegrenzung" VALUE 0xCA560 Kw_Ws16 32767.00 EngN 0.00 32767.00 FORMAT "%8.2" EXTENDED_LIMITS -32768.00 32767.00 /end CHARACTERISTIC
/begin CHARACTERISTIC CoEng_nSoftShOffMax_C "engine speed limit for soft shutoff" VALUE 0xCA030 Kw_Ws16 32727.00 EngN 40.00000 32767.00 FORMAT "%8.2" EXTENDED_LIMITS -32768.00 32767.00 /end CHARACTERISTIC
/begin CHARACTERISTIC CoEng_nSoftShOffMin_C "minimale Drehzahlschwelle für Komfortabstellung" VALUE 0xCA032 Kw_Ws16 32727.00 EngN 40.00000 32767.00 FORMAT "%8.2" EXTENDED_LIMITS -32768.00 32767.00 /end CHARACTERISTIC
/begin CHARACTERISTIC CoEng_nThresNrml2Strt_C "Motordrehzahlschwelle für Zustandsübergang von NORMAL nach START" VALUE 0xCA070 Kw_Ws16 8000.000 EngN 0.00 8000.000 FORMAT "%8.3" EXTENDED_LIMITS -32768.00 32767.00 /end CHARACTERISTIC
/begin CHARACTERISTIC CoEng_numSelFuncPref_C "Auswahl Funktion mit uneingeschränkter Priorität" VALUE 0xCA004 Kw_Wu8 7.000 OneToOne 0.00 7.000 FORMAT "%5.3" EXTENDED_LIMITS 0.00 255.0 /end CHARACTERISTIC
/begin CHARACTERISTIC CoEng_facActvFunc2_1_C "Gewichtungsfaktor für Schubphasenzähler für Funktion1" VALUE 0xCA005 Kw_Wu8 10.00 OneToOne 0.00 10.00 FORMAT "%5.2" EXTENDED_LIMITS 0.00 255.0 /end CHARACTERISTIC
/begin CHARACTERISTIC CoEng_facActvFunc2_2_C "Gewichtungsfaktor für Schubphasenzähler für Funktion 2" VALUE 0xCA006 Kw_Wu8 10.00 OneToOne 0.00 10.00 FORMAT "%5.2" EXTENDED_LIMITS 0.00 255.0 /end CHARACTERISTIC
/begin CHARACTERISTIC CoEng_facActvFunc2_3_C "Gewichtungsfaktor für Schubphasenzähler für Funktion 3" VALUE 0xCA007 Kw_Wu8 10.00 OneToOne 0.00 10.00 FORMAT "%5.2" EXTENDED_LIMITS 0.00 255.0 /end CHARACTERISTIC
/begin CHARACTERISTIC CoEng_facActvFunc2_4_C "Gewichtungsfaktor für Schubphasenzähler für Funktion 4" VALUE 0xCA008 Kw_Wu8 10.00 OneToOne 0.00 10.00 FORMAT "%5.2" EXTENDED_LIMITS 0.00 255.0 /end CHARACTERISTIC
/begin CHARACTERISTIC CoEng_facActvFunc2_5_C "Gewichtungsfaktor für Schubphasenzähler für Funktion 5" VALUE 0xCA009 Kw_Wu8 10.00 OneToOne 0.00 10.00 FORMAT "%5.2" EXTENDED_LIMITS 0.00 255.0 /end CHARACTERISTIC
/begin CHARACTERISTIC CoEng_facActvFunc2_6_C "Gewichtungsfaktor für Schubphasenzähler für Funktion 6" VALUE 0xCA00A Kw_Wu8 10.00 OneToOne 0.00 10.00 FORMAT "%5.2" EXTENDED_LIMITS 0.00 255.0 /end CHARACTERISTIC
/begin CHARACTERISTIC CoEng_facActvFunc2_7_C "Gewichtungsfaktor für Schubphasenzähler für Funktion 7" VALUE 0xCA00B Kw_Wu8 10.00 OneToOne 0.00 10.00 FORMAT "%5.2" EXTENDED_LIMITS 0.00 255.0 /end CHARACTERISTIC
/begin CHARACTERISTIC CoEng_facActvFunc2_8_C "Gewichtungsfaktor für Schubphasenzähler für reservierte Funktion 8" VALUE 0xCA00C Kw_Wu8 0.00 OneToOne 0.00 0.00 FORMAT "%5.2" EXTENDED_LIMITS 0.00 255.0 /end CHARACTERISTIC
/begin CHARACTERISTIC CoEng_facActvFunc1_C "Gewichtungsfaktor für Schubphasenzähler für Funktion 1" VALUE 0xCA00D Kw_Wu8 10.00 OneToOne 0.00 10.00 FORMAT "%5.2" EXTENDED_LIMITS 0.00 255.0 /end CHARACTERISTIC
/begin CHARACTERISTIC CoEng_facActvFunc2_C "Gewichtungsfaktor für Schubphasenzähler für Funktion 2" VALUE 0xCA00E Kw_Wu8 10.00 OneToOne 0.00 10.00 FORMAT "%5.2" EXTENDED_LIMITS 0.00 255.0 /end CHARACTERISTIC
/begin CHARACTERISTIC CoEng_facActvFunc3_C "Gewichtungsfaktor für Schubphasenzähler für Funktion 3" VALUE 0xCA00F Kw_Wu8 10.00 OneToOne 0.00 10.00 FORMAT "%5.2" EXTENDED_LIMITS 0.00 255.0 /end CHARACTERISTIC
/begin CHARACTERISTIC CoEng_facActvFunc4_C "Gewichtungsfaktor für Schubphasenzähler für Funktion 4" VALUE 0xCA010 Kw_Wu8 10.00 OneToOne 0.00 10.00 FORMAT "%5.2" EXTENDED_LIMITS 0.00 255.0 /end CHARACTERISTIC
/begin CHARACTERISTIC CoEng_facActvFunc5_C "Gewichtungsfaktor für Schubphasenzähler für Funktion 5" VALUE 0xCA011 Kw_Wu8 10.00 OneToOne 0.00 10.00 FORMAT "%5.2" EXTENDED_LIMITS 0.00 255.0 /end CHARACTERISTIC
/begin CHARACTERISTIC CoEng_facActvFunc6_C "Gewichtungsfaktor für Schubphasenzähler für Funktion 6" VALUE 0xCA012 Kw_Wu8 10.00 OneToOne 0.00 10.00 FORMAT "%5.2" EXTENDED_LIMITS 0.00 255.0 /end CHARACTERISTIC
/begin CHARACTERISTIC CoEng_facActvFunc7_C "Gewichtungsfaktor für Schubphasenzähler für Funktion 7" VALUE 0xCA013 Kw_Wu8 10.00 OneToOne 0.00 10.00 FORMAT "%5.2" EXTENDED_LIMITS 0.00 255.0 /end CHARACTERISTIC
/begin CHARACTERISTIC CoEng_facActvFunc8_C "Gewichtungsfaktor für Schubphasenzähler für Funktion 8" VALUE 0xCA014 Kw_Wu8 0.00 OneToOne 0.00 0.00 FORMAT "%5.2" EXTENDED_LIMITS 0.00 255.0 /end CHARACTERISTIC
/begin CHARACTERISTIC CoEng_dtrqRmpUp_C "Rampensteigung aufwärts für Schubabschaltung( nicht applizierbar da nie in Gebrauch)" VALUE 0xCA074 Kw_Wu32 6553584.99908 RmpTrq 14.9993896484 6553599.99847 FORMAT "%13.5" EXTENDED_LIMITS 0.00 6553599.99847 READ_ONLY /end CHARACTERISTIC
/begin CHARACTERISTIC CoEng_dtrqRmpDwn_C "Rampensteigung bei Schubabschaltung" VALUE 0xCA078 Kw_Wu32 6553584.99908 RmpTrq 14.9993896484 6553599.99847 FORMAT "%13.5" EXTENDED_LIMITS 0.00 6553599.99847 /end CHARACTERISTIC
/begin CHARACTERISTIC CoEng_tiPFltdVolPT1_C "Filterzeitkonstante für Volumenstrom" VALUE 0xCA128 Kw_Wu32 4294.9673 TimeDelay_s 0.0000010000000 4294.9673 FORMAT "%9.4" /end CHARACTERISTIC
/begin CHARACTERISTIC CoEng_tiPFltResFlowPT1_C "Filterzeitkonstante für Strömungswiderstand" VALUE 0xCA12C Kw_Wu32 4294.9673 TimeDelay_s 0.0000010000000 4294.9673 FORMAT "%9.4" /end CHARACTERISTIC
/begin CHARACTERISTIC CoEng_qSoftShOffMax_C "injection quantity limit for soft shutoff" VALUE 0xCA034 Kw_Ws16 327.6700 InjMassCyc 0.00 327.6700 FORMAT "%8.4" EXTENDED_LIMITS -327.6800 327.6700 /end CHARACTERISTIC
/begin CHARACTERISTIC CoEng_qSubs_MAP "Kennfeld für Ersatzmenge im Regenerationsfall" MAP 0xC9D5A Kf_Xs16_Ys16_Ws16 80.00000 InjMassCyc 0.00 80.00000 FORMAT "%8.5" EXTENDED_LIMITS -327.6800 327.6700
 /begin AXIS_DESCR STD_AXIS Eng_nAvrg EngN 16 0.00 8000.000 FORMAT "%8.3" EXTENDED_LIMITS -32768.00 32767.00 DEPOSIT ABSOLUTE /end AXIS_DESCR
 /begin AXIS_DESCR STD_AXIS CoEng_trq Trq 16 0.00 200.0000 FORMAT "%8.4" EXTENDED_LIMITS -3276.800 3276.700 DEPOSIT ABSOLUTE /end AXIS_DESCR
/end CHARACTERISTIC
/begin CHARACTERISTIC CoEng_rhoFuel_C "Kraftstoffdichte" VALUE 0xC9F9E Kw_Ws16 1500.000 RhoFuel 0.00 1500.000 FORMAT "%8.3" EXTENDED_LIMITS -3276.800 3276.700 /end CHARACTERISTIC
/begin CHARACTERISTIC CoEng_dtrqOvrFulUp_C "Steigung des Drehmoments (Nm/s) für Overfueling ramp switch" VALUE 0xCA130 Kw_Wu32 6553594.99817 RmpTrq 5.00030517578 6553599.99847 FORMAT "%13.5" EXTENDED_LIMITS 0.00 6553599.99847 /end CHARACTERISTIC
/begin CHARACTERISTIC CoEng_dtrqOvrFulDown_C "Steigung des Drehmoments (Nm/s) für Overfueling ramp switch" VALUE 0xCA134 Kw_Wu32 6553594.99817 RmpTrq 5.00030517578 6553599.99847 FORMAT "%13.5" EXTENDED_LIMITS 0.00 6553599.99847 /end CHARACTERISTIC
/begin CHARACTERISTIC CoEng_rOvrFulMin_C "untere Hysteresegrenze für Overfueling Gaspedalposition" VALUE 0xCA138 Kw_Ws16 100.0000 Prc 0.00 100.0000 FORMAT "%8.4" EXTENDED_LIMITS -400.0000 399.9878 /end CHARACTERISTIC
/begin CHARACTERISTIC CoEng_rOvrFulMax_C "obere Hysteresegrenze für Overfueling Gaspedalposition" VALUE 0xCA13A Kw_Ws16 100.0000 Prc 0.00 100.0000 FORMAT "%8.4" EXTENDED_LIMITS -400.0000 399.9878 /end CHARACTERISTIC
/begin CHARACTERISTIC CoEng_strOvrFulLow_C "status for overfueling acceleration pedale position hysteresis off" VALUE 0xCA13C Kw_Ws16 65535.00 OneToOne -32768.00 32767.00 FORMAT "%8.2" READ_ONLY /end CHARACTERISTIC
/begin CHARACTERISTIC CoEng_strOvrFulHigh_C "status for overfueling acceleration pedale position hysteresis on" VALUE 0xCA13E Kw_Ws16 65535.00 OneToOne -32768.00 32767.00 FORMAT "%8.2" READ_ONLY /end CHARACTERISTIC
/begin CHARACTERISTIC CoEng_dtrqSlpLimUpdef_C "Anstiegsbegrenzung f. Rauchgrenze ""Turboschubbegrenzung"" bei unbekannter Ganginformation" VALUE 0xCA564 Kw_Wu32 6553599.99847 RmpTrq 0.00 6553599.99847 FORMAT "%13.5" /end CHARACTERISTIC
/begin CHARACTERISTIC CoEng_dtrqSlpLimDwndef_C "Abwärts-Momentenbegrenzung für Rauchbegrenzung/Turboschubbegrenzung (fest auf maximalem Abstieg) bei unbekannter Ganginformation" VALUE 0xCA568 Kw_Wu32 6553599.99847 RmpTrq 0.00 6553599.99847 FORMAT "%13.5" READ_ONLY /end CHARACTERISTIC
/begin CHARACTERISTIC CoEng_dtrqSlpLimUp1_C "Anstiegsbegrenzung f. Rauchgrenze ""Turboschubbegrenzung"" bei Gang 1" VALUE 0xCA56C Kw_Wu32 6553599.99847 RmpTrq 0.00 6553599.99847 FORMAT "%13.5" /end CHARACTERISTIC
/begin CHARACTERISTIC CoEng_dtrqSlpLimDwn1_C "Abwärts-Momentenbegrenzung für Rauchbegrenzung/Turboschubbegrenzung (fest auf maximalem Abstieg) bei Gang 1" VALUE 0xCA570 Kw_Wu32 6553599.99847 RmpTrq 0.00 6553599.99847 FORMAT "%13.5" READ_ONLY /end CHARACTERISTIC
/begin CHARACTERISTIC CoEng_dtrqSlpLimUp2_C "Anstiegsbegrenzung f. Rauchgrenze ""Turboschubbegrenzung"" bei Gang 2" VALUE 0xCA574 Kw_Wu32 6553599.99847 RmpTrq 0.00 6553599.99847 FORMAT "%13.5" /end CHARACTERISTIC
/begin CHARACTERISTIC CoEng_dtrqSlpLimDwn2_C "Abwärts-Momentenbegrenzung für Rauchbegrenzung/Turboschubbegrenzung (fest auf maximalem Abstieg) bei Gang 2" VALUE 0xCA578 Kw_Wu32 6553599.99847 RmpTrq 0.00 6553599.99847 FORMAT "%13.5" READ_ONLY /end CHARACTERISTIC
/begin CHARACTERISTIC CoEng_dtrqSlpLimUp3_C "Anstiegsbegrenzung f. Rauchgrenze ""Turboschubbegrenzung"" bei Gang 3" VALUE 0xCA57C Kw_Wu32 6553599.99847 RmpTrq 0.00 6553599.99847 FORMAT "%13.5" /end CHARACTERISTIC
/begin CHARACTERISTIC CoEng_dtrqSlpLimDwn3_C "Abwärts-Momentenbegrenzung für Rauchbegrenzung/Turboschubbegrenzung (fest auf maximalem Abstieg) bei Gang 3" VALUE 0xCA580 Kw_Wu32 6553599.99847 RmpTrq 0.00 6553599.99847 FORMAT "%13.5" READ_ONLY /end CHARACTERISTIC
/begin CHARACTERISTIC CoEng_dtrqSlpLimUp4_C "Anstiegsbegrenzung f. Rauchgrenze ""Turboschubbegrenzung"" bei Gang 4" VALUE 0xCA584 Kw_Wu32 6553599.99847 RmpTrq 0.00 6553599.99847 FORMAT "%13.5" /end CHARACTERISTIC
/begin CHARACTERISTIC CoEng_dtrqSlpLimDwn4_C "Abwärts-Momentenbegrenzung für Rauchbegrenzung/Turboschubbegrenzung (fest auf maximalem Abstieg) bei Gang 4" VALUE 0xCA588 Kw_Wu32 6553599.99847 RmpTrq 0.00 6553599.99847 FORMAT "%13.5" READ_ONLY /end CHARACTERISTIC
/begin CHARACTERISTIC CoEng_dtrqSlpLimUp5_C "Anstiegsbegrenzung f. Rauchgrenze ""Turboschubbegrenzung"" bei Gang 5" VALUE 0xCA58C Kw_Wu32 6553599.99847 RmpTrq 0.00 6553599.99847 FORMAT "%13.5" /end CHARACTERISTIC
/begin CHARACTERISTIC CoEng_dtrqSlpLimDwn5_C "Abwärts-Momentenbegrenzung für Rauchbegrenzung/Turboschubbegrenzung (fest auf maximalem Abstieg) bei Gang 5" VALUE 0xCA590 Kw_Wu32 6553599.99847 RmpTrq 0.00 6553599.99847 FORMAT "%13.5" READ_ONLY /end CHARACTERISTIC
/begin CHARACTERISTIC CoEng_dtrqSlpLimUp6_C "Anstiegsbegrenzung f. Rauchgrenze ""Turboschubbegrenzung"" bei Gang 6" VALUE 0xCA594 Kw_Wu32 6553599.99847 RmpTrq 0.00 6553599.99847 FORMAT "%13.5" /end CHARACTERISTIC
/begin CHARACTERISTIC CoEng_dtrqSlpLimDwn6_C "Abwärts-Momentenbegrenzung für Rauchbegrenzung/Turboschubbegrenzung (fest auf maximalem Abstieg) bei Gang 6" VALUE 0xCA598 Kw_Wu32 6553599.99847 RmpTrq 0.00 6553599.99847 FORMAT "%13.5" READ_ONLY /end CHARACTERISTIC
/begin CHARACTERISTIC CoEng_dtrqSlpLimUpREV_C "Anstiegsbegrenzung f. Rauchgrenze ""Turboschubbegrenzung"" bei Rückwärtsgang" VALUE 0xCA59C Kw_Wu32 6553599.99847 RmpTrq 0.00 6553599.99847 FORMAT "%13.5" /end CHARACTERISTIC
/begin CHARACTERISTIC CoEng_dtrqSlpLimDwnREV_C "Abwärts-Momentenbegrenzung für Rauchbegrenzung/Turboschubbegrenzung (fest auf maximalem Abstieg) bei Rückwärtsgang" VALUE 0xCA5A0 Kw_Wu32 6553599.99847 RmpTrq 0.00 6553599.99847 FORMAT "%13.5" READ_ONLY /end CHARACTERISTIC
/begin CHARACTERISTIC CoEng_stAftRunSel_C "Schalterauswahl für den Nachlauf" VALUE 0xC9D34 Kw_Wu8 255.0 OneToOne 0.00 255.0 FORMAT "%5.1" /end CHARACTERISTIC
/begin CHARACTERISTIC CoEng_stCoopCapbl_C "Kooperationsattribute zu koordinierender Funktionen im Schubkoordinator (bitcodiert)" VALUE 0xCA015 Kw_Wu8 127.0 OneToOne 0.00 127.0 FORMAT "%5.1" EXTENDED_LIMITS 0.00 255.0 /end CHARACTERISTIC
/begin CHARACTERISTIC CoEng_stHealRDucDoc_MAP "Status zur Freigabe der Heilung einer Momentenbegrenzung durch den Partikelfilter" MAP 0xCA140 Kf_Xs16_Ys16_Ws16 1.000000 OneToOne 0.00 1.000000 FORMAT "%8.6" EXTENDED_LIMITS -32768.00 32767.00
 /begin AXIS_DESCR STD_AXIS Eng_nAvrg EngN 6 0.00 6000.000 FORMAT "%8.3" EXTENDED_LIMITS -32768.00 32767.00 DEPOSIT ABSOLUTE /end AXIS_DESCR
 /begin AXIS_DESCR STD_AXIS CoEng_trqInrSet Trq 6 -500.0000 1000.000 FORMAT "%8.3" EXTENDED_LIMITS -3276.800 3276.700 DEPOSIT ABSOLUTE /end AXIS_DESCR
/end CHARACTERISTIC
/begin CHARACTERISTIC CoEng_stIRevShutOff_C "Maske für irreversible Abschaltursachen" VALUE 0xC9FA4 Kw_Wu32 4294967295.00 OneToOne 0.00 4294967295.00 FORMAT "%13.2" /end CHARACTERISTIC
/begin CHARACTERISTIC CoEng_stOvrRunRgnMsk_C "Maske zur Erkennung der Regenerationsart" VALUE 0xCA018 Kw_Wu32 4294967295.00 OneToOne 0.00 4294967295.00 FORMAT "%13.2" /end CHARACTERISTIC
/begin CHARACTERISTIC CoEng_stPFltLimMsk_C "Bitmaske zur selektiven Ausblendung von Bits in EGT_st" VALUE 0xCA1A4 Kw_Wu32 4294967295.00 OneToOne 0.00 4294967295.00 FORMAT "%13.2" /end CHARACTERISTIC
/begin CHARACTERISTIC CoEng_stRevShutOff_C "Maske für reversible Abschaltursachen" VALUE 0xC9FA8 Kw_Wu32 4294967295.00 OneToOne 0.00 4294967295.00 FORMAT "%13.2" /end CHARACTERISTIC
/begin CHARACTERISTIC CoEng_stShOffAddReqIRev_C "Abstellpfade für kundenspezifische irreversible Abschaltanforderung" VALUE 0xC9FAC Kw_Wu32 4294967295.00 OneToOne 0.00 4294967295.00 FORMAT "%13.2" /end CHARACTERISTIC
/begin CHARACTERISTIC CoEng_stShOffAddReqRev_C "Abstellpfade für kundenspezifische reversible Abschaltanforderung" VALUE 0xC9FB0 Kw_Wu32 4294967295.00 OneToOne 0.00 4294967295.00 FORMAT "%13.2" /end CHARACTERISTIC
/begin CHARACTERISTIC CoEng_stShOffAftRun_C "Abschaltanforderungen im Nachlauf" VALUE 0xCA038 Kw_Wu32 4294967295.00 OneToOne 0.00 4294967295.00 FORMAT "%13.2" /end CHARACTERISTIC
/begin CHARACTERISTIC CoEng_stShOffAirbFrnt_C "Abstellpfade für Airbag Frontalaufprall aktiv" VALUE 0xC9FB4 Kw_Wu32 4294967295.00 OneToOne 0.00 4294967295.00 FORMAT "%13.2" /end CHARACTERISTIC
/begin CHARACTERISTIC CoEng_stShOffAirbRear_C "Abstellpfade für Airbag Heckaufprall aktiv" VALUE 0xC9FB8 Kw_Wu32 4294967295.00 OneToOne 0.00 4294967295.00 FORMAT "%13.2" /end CHARACTERISTIC
/begin CHARACTERISTIC CoEng_stShOffAirbSide_C "Abstellpfade für Airbag Seitenaufprall aktiv" VALUE 0xC9FBC Kw_Wu32 4294967295.00 OneToOne 0.00 4294967295.00 FORMAT "%13.2" /end CHARACTERISTIC
/begin CHARACTERISTIC CoEng_stShOffDblCtl_C "Abstellpfade für unzulässigen Hochdruck-Reglerbetrieb (nur 2-Reglerkonzept)" VALUE 0xC9FC0 Kw_Wu32 4294967295.00 OneToOne 0.00 4294967295.00 FORMAT "%13.2" /end CHARACTERISTIC
/begin CHARACTERISTIC CoEng_stShOffDiaReqFI_C "Abstellantwort von Diagnose-Schnittstelle fuer Kraftstoffzusatz" VALUE 0xC9FC4 Kw_Wu32 4294967295.00 OneToOne 0.00 4294967295.00 FORMAT "%13.2" /end CHARACTERISTIC
/begin CHARACTERISTIC CoEng_stShOffExtReq_C "Abstellpfade bei externer Anforderung" VALUE 0xCA03C Kw_Wu32 4294967295.00 OneToOne 0.00 4294967295.00 FORMAT "%13.2" /end CHARACTERISTIC
/begin CHARACTERISTIC CoEng_stShOffInit_C "Abstellpfade, die nach der Initialisierung im Eingriff sind" VALUE 0xC9FC8 Kw_Wu32 4294967295.00 OneToOne 0.00 4294967295.00 FORMAT "%13.2" /end CHARACTERISTIC
/begin CHARACTERISTIC CoEng_stShOffInjMon_C "Abstellpfade für mehrfache Injektorlastabfälle" VALUE 0xC9FCC Kw_Wu32 4294967295.00 OneToOne 0.00 4294967295.00 FORMAT "%13.2" /end CHARACTERISTIC
/begin CHARACTERISTIC CoEng_stShOffInjShCir_C "Abstellpfade bei Injektorkurzschluss" VALUE 0xC9FD0 Kw_Wu32 4294967295.00 OneToOne 0.00 4294967295.00 FORMAT "%13.2" /end CHARACTERISTIC
/begin CHARACTERISTIC CoEng_stShOffIRevSys1_C "Abstellpfade für irreversible Systemfehler 1" VALUE 0xC9FD4 Kw_Wu32 4294967295.00 OneToOne 0.00 4294967295.00 FORMAT "%13.2" /end CHARACTERISTIC
/begin CHARACTERISTIC CoEng_stShOffIRevSys2_C "Abstellpfade für irreversible Systemfehler 2" VALUE 0xC9FD8 Kw_Wu32 4294967295.00 OneToOne 0.00 4294967295.00 FORMAT "%13.2" /end CHARACTERISTIC
/begin CHARACTERISTIC CoEng_stShOffIRevVeh_C "Abstellpfade für irreversible Fahrzeugfehler" VALUE 0xC9FDC Kw_Wu32 4294967295.00 OneToOne 0.00 4294967295.00 FORMAT "%13.2" /end CHARACTERISTIC
/begin CHARACTERISTIC CoEng_stShOffIrrCmb_C "Abstellpfade bei irregulärer Verbrennung" VALUE 0xC9FE0 Kw_Wu32 4294967295.00 OneToOne 0.00 4294967295.00 FORMAT "%13.2" /end CHARACTERISTIC
/begin CHARACTERISTIC CoEng_stShOffOvrSpd_C "Abstellpfade aufgrund Überdrehzahl" VALUE 0xC9FE4 Kw_Wu32 4294967295.00 OneToOne 0.00 4294967295.00 FORMAT "%13.2" /end CHARACTERISTIC
/begin CHARACTERISTIC CoEng_stShOffPresMin_C "Abstellpfade bei Mindestraildruck unteschritten" VALUE 0xC9FE8 Kw_Wu32 4294967295.00 OneToOne 0.00 4294967295.00 FORMAT "%13.2" /end CHARACTERISTIC
/begin CHARACTERISTIC CoEng_stShOffRevSys1_C "Abstellpfade für reversible Systemfehler 1" VALUE 0xC9FEC Kw_Wu32 4294967295.00 OneToOne 0.00 4294967295.00 FORMAT "%13.2" /end CHARACTERISTIC
/begin CHARACTERISTIC CoEng_stShOffRevSys2_C "Abstellpfade für reversible Systemfehler 2" VALUE 0xC9FF0 Kw_Wu32 4294967295.00 OneToOne 0.00 4294967295.00 FORMAT "%13.2" /end CHARACTERISTIC
/begin CHARACTERISTIC CoEng_stShOffRevVeh_C "Abstellpfade für reversible Fahrzeugfehler" VALUE 0xC9FF4 Kw_Wu32 4294967295.00 OneToOne 0.00 4294967295.00 FORMAT "%13.2" /end CHARACTERISTIC
/begin CHARACTERISTIC CoEng_stShOffRlOvrBar_C "Abstellpfade für Überrollbügel aktiv" VALUE 0xC9FF8 Kw_Wu32 4294967295.00 OneToOne 0.00 4294967295.00 FORMAT "%13.2" /end CHARACTERISTIC
/begin CHARACTERISTIC CoEng_stShOffSV_C "Abstellpfade aufgrund dauerbestromtem Magnetventil" VALUE 0xC9FFC Kw_Wu32 4294967295.00 OneToOne 0.00 4294967295.00 FORMAT "%13.2" /end CHARACTERISTIC
/begin CHARACTERISTIC CoEng_stShOffTstSel_C "Auswahl der möglichen Abstelltests (Bit 0: ESD/PSP, 1:PCV)" VALUE 0xCA040 Kw_Wu16 65535.00 OneToOne 0.00 65535.00 FORMAT "%8.2" /end CHARACTERISTIC
/begin CHARACTERISTIC CoEng_stSoftShOffAR_C "Abschaltanforderung im Nachlauf für Komfortabstellung" VALUE 0xCA044 Kw_Wu32 4294967295.00 OneToOne 0.00 4294967295.00 FORMAT "%13.2" /end CHARACTERISTIC
/begin CHARACTERISTIC CoEng_stSubsRgnMsk_C "Maske für Umschaltung auf Ersatzkennfeld" VALUE 0xC9FA0 Kw_Wu32 4294967295.00 OneToOne 0.00 4294967295.00 FORMAT "%13.2" /end CHARACTERISTIC
/begin CHARACTERISTIC CoEng_swtPPreCat_C "Schalter zur Auswahl zwischen Drücken" VALUE 0xCA1A8 Kw_Wu8 1.000 OneToOne 0.00 1.000 FORMAT "%5.3" EXTENDED_LIMITS 0.00 255.0 /end CHARACTERISTIC
/begin CHARACTERISTIC CoEng_swtSelOvRMonSync_C "Schalter zur Auswahl der Aktivierungsbedingung der Schubüberwachung" VALUE 0xCA07C Kw_Wu8 1.000 OneToOne 0.00 1.000 FORMAT "%5.3" EXTENDED_LIMITS 0.00 255.0 /end CHARACTERISTIC
/begin CHARACTERISTIC CoEng_swtSensOvld_C "" VALUE 0xCA1A9 Kw_Wu8 1.000 OneToOne 0.00 1.000 FORMAT "%5.3" EXTENDED_LIMITS 0.00 255.0 /end CHARACTERISTIC
/begin CHARACTERISTIC CoEng_tiActrPrt_C "maximale Zeit für Stellerbestromung" VALUE 0xC9D32 Kw_Wu16 655350.0 Time_ms 0.00 655350.0 FORMAT "%8.1" /end CHARACTERISTIC
/begin CHARACTERISTIC CoEng_tiDebnAvrgZero_C "Entprellzeit (fallende Flanke) für die Motordrehzahl" VALUE 0xC9D36 Kw_Wu16 655140.0 Time_ms 0.00 655140.0 FORMAT "%8.1" EXTENDED_LIMITS 0.00 655350.0 /end CHARACTERISTIC
/begin CHARACTERISTIC CoEng_tiDlyT15_C "Zeit für Fehlerausblendung nach Klemme15 Ein (Abwarten der Init-Zeit anderer Steuergeräte)" VALUE 0xCA024 Kw_Wu16 5000.000 Time_ms 0.00 5000.000 FORMAT "%8.3" EXTENDED_LIMITS 0.00 655350.0 /end CHARACTERISTIC
/begin CHARACTERISTIC CoEng_tiMinAftRun_C "minimale Nachlaufzeit" VALUE 0xC9D40 Kw_Wu32 42949672950.0 Time_ms 0.00 42949672950.0 FORMAT "%13.1" /end CHARACTERISTIC
/begin CHARACTERISTIC CoEng_tiMRlyShutOffDel_C "delaytime for afterrun" VALUE 0xC9D44 Kw_Wu16 655350.0 Time_ms 0.00 655350.0 FORMAT "%8.1" /end CHARACTERISTIC
/begin CHARACTERISTIC CoEng_tiNrml2Strt_C "Entprellzeit für Zustandsübergang von NORMAL nach START" VALUE 0xCA072 Kw_Wu16 655350.0 Time_ms 0.00 655350.0 FORMAT "%8.1" /end CHARACTERISTIC
/begin CHARACTERISTIC CoEng_tiOvrRunCoordDebPos_C "Entprellzeit für den Übergang ""Kein Schub -> Schub"" im Schubkoordinator" VALUE 0xCA01C Kw_Wu16 1000.000 Time_ms 0.00 1000.000 FORMAT "%8.3" EXTENDED_LIMITS 0.00 655350.0 /end CHARACTERISTIC
/begin CHARACTERISTIC CoEng_tiPFltOvldOk_C "Wert während der debounce Zeit, zum O.K. zu ändern" VALUE 0xCA1AA Kw_Wu16 655350.0 TimeDeb 0.00 655350.0 FORMAT "%8.1" /end CHARACTERISTIC
/begin CHARACTERISTIC CoEng_tiPwrStgDiaRdy_C "Verzoegerungszeit, um im Nachlauf abgeschaltete Steller zu diagnostizieren" VALUE 0xC9D38 Kw_Wu16 655350.0 Time_ms 0.00 655350.0 FORMAT "%8.1" /end CHARACTERISTIC
/begin CHARACTERISTIC CoEng_tiRepOvrFul_C "Sperrzeit für Overfueling timer" VALUE 0xCA1AC Kw_Wu32 21474836.4700 Time_s 0.00 21474836.4700 FORMAT "%13.4" EXTENDED_LIMITS 0.00 42949672.9500 /end CHARACTERISTIC
/begin CHARACTERISTIC CoEng_tiRmpStrtDfl_C "Default Wartezeit nach Schuberkennung bis Rampe startet" VALUE 0xCA07E Kw_Wu16 655350.0 Time_ms 0.00 655350.0 FORMAT "%8.1" /end CHARACTERISTIC
/begin CHARACTERISTIC CoEng_tiRmpStrt_CUR "Wartezeit nach Schuberkennung bei Grip bis Rampe startet" CURVE 0xCA080 Kl_Xs16_Ws16 10000.00 Time_ms 0.00 10000.00 FORMAT "%8.2" EXTENDED_LIMITS -327680.0 327670.0
 /begin AXIS_DESCR STD_AXIS DrvTrn_rTransDT TransR 7 0.00 10.00000 FORMAT "%8.5" EXTENDED_LIMITS -327.6800 327.6700 DEPOSIT ABSOLUTE /end AXIS_DESCR
/end CHARACTERISTIC
/begin CHARACTERISTIC CoEng_tiShOffTstFlSys_C "Zeit bis Ansteuerdauer == 0 beim Test des niederdruckseitigen Abstellpfades" VALUE 0xCA048 Kw_Wu16 655350.0 Time_ms 0.00 655350.0 FORMAT "%8.1" /end CHARACTERISTIC
/begin CHARACTERISTIC CoEng_tiSoftShOff_CUR "Curve to calculate time delay for soft shutoff" CURVE 0xCA04A Kl_Xs16_Ws16 600.0000 Time_ms 0.00 600.0000 FORMAT "%8.4" EXTENDED_LIMITS -327680.0 327670.0
 /begin AXIS_DESCR STD_AXIS Eng_nAvrg EngN 6 0.00 6000.000 FORMAT "%8.3" EXTENDED_LIMITS -32768.00 32767.00 DEPOSIT ABSOLUTE /end AXIS_DESCR
/end CHARACTERISTIC
/begin CHARACTERISTIC CoEng_tiSwtOffDfl_C "Default Wartezeit nach Schuberkennung bis Abschaltung" VALUE 0xCA09E Kw_Wu16 655350.0 Time_ms 0.00 655350.0 FORMAT "%8.1" /end CHARACTERISTIC
/begin CHARACTERISTIC CoEng_tiSwtOff_CUR "Wartezeit nach Schuberkennung bei Grip bis Abschaltung" CURVE 0xCA0A0 Kl_Xs16_Ws16 10000.00 Time_ms 0.00 10000.00 FORMAT "%8.2" EXTENDED_LIMITS -327680.0 327670.0
 /begin AXIS_DESCR STD_AXIS DrvTrn_rTransDT TransR 7 0.00 10.00000 FORMAT "%8.5" EXTENDED_LIMITS -327.6800 327.6700 DEPOSIT ABSOLUTE /end AXIS_DESCR
/end CHARACTERISTIC
/begin CHARACTERISTIC CoEng_tiThresFuncPref_C "Schwelle für Betriebszeit Motor ein" VALUE 0xCA020 Kw_Wu32 100000.000000 TimeEngOn 0.00 100000.000000 FORMAT "%13.6" EXTENDED_LIMITS 0.00 4294967295.00 /end CHARACTERISTIC
/begin CHARACTERISTIC CoEng_tiTstMax_C "Maximale Zeit zwischen zwei Testanforderungen" VALUE 0xCA5A4 Kw_Wu16 655350.0 Time_ms 0.00 655350.0 FORMAT "%8.1" /end CHARACTERISTIC
/begin CHARACTERISTIC CoEng_tiWakeUp_C "delaytime for afterrun caused hidden pre glow" VALUE 0xC9D48 Kw_Wu32 42949672950.0 Time_ms 0.00 42949672950.0 FORMAT "%13.1" /end CHARACTERISTIC
/begin CHARACTERISTIC CoEng_tPFltOvldLim_C "" VALUE 0xCA1B0 Kw_Ws16 950.000 Temp_Cels -50.140 899.860 FORMAT "%8.3" EXTENDED_LIMITS -3549.940 3003.560 /end CHARACTERISTIC
/begin CHARACTERISTIC CoEng_trqCorGearbxRgn_CUR "Kennlinie zur Korrektur der Getriebeschaltschwellen während der Regeneration, drehzahlabhängig ( weniger Moment zur Verfügung )" CURVE 0xCA1B2 Kl_Xs16_Ws16 1000.000 Trq 0.00 1000.000 FORMAT "%8.3" EXTENDED_LIMITS -3276.800 3276.700
 /begin AXIS_DESCR STD_AXIS Eng_nAvrg EngN 16 0.00 6000.000 FORMAT "%8.3" EXTENDED_LIMITS -32768.00 32767.00 DEPOSIT ABSOLUTE /end AXIS_DESCR
/end CHARACTERISTIC
/begin CHARACTERISTIC CoEng_trqInrSetLim_CUR "Sollwert des inneren Moments wenn Schub erkannt wurde und die Schubüberwachung aktiv ist" CURVE 0xCA0BE Kl_Xs16_Ws16 3276.700 Trq 0.00 3276.700 FORMAT "%8.3" EXTENDED_LIMITS -3276.800 3276.700
 /begin AXIS_DESCR STD_AXIS CoEng_tiOvRMon_mp Time_ms 3 0.00 327670.0 FORMAT "%8.1" EXTENDED_LIMITS -327680.0 327670.0 DEPOSIT ABSOLUTE /end AXIS_DESCR
/end CHARACTERISTIC
/begin CHARACTERISTIC CoEng_trqLimErr1_CUR "Kennlinie für Begrenzungsmoment abhängig von der Drehzahl im Fehlerfall" CURVE 0xCA1F4 Kl_Xs16_Ws16 1000.000 Trq 0.00 1000.000 FORMAT "%8.3" EXTENDED_LIMITS -3276.800 3276.700
 /begin AXIS_DESCR STD_AXIS Eng_nAvrg EngN 10 0.00 6000.000 FORMAT "%8.3" EXTENDED_LIMITS -32768.00 32767.00 DEPOSIT ABSOLUTE /end AXIS_DESCR
/end CHARACTERISTIC
/begin CHARACTERISTIC CoEng_trqLimErr2_CUR "Kennlinie für Begrenzungsmoment abhängig von der Drehzahl im Fehlerfall 2" CURVE 0xCA21E Kl_Xs16_Ws16 1000.000 Trq 0.00 1000.000 FORMAT "%8.3" EXTENDED_LIMITS -3276.800 3276.700
 /begin AXIS_DESCR STD_AXIS Eng_nAvrg EngN 10 0.00 6000.000 FORMAT "%8.3" EXTENDED_LIMITS -32768.00 32767.00 DEPOSIT ABSOLUTE /end AXIS_DESCR
/end CHARACTERISTIC
/begin CHARACTERISTIC CoEng_trqLimErr3_CUR "Kennlinie für Begrenzungsmoment abhängig von der Drehzahl im Fehlerfall 3" CURVE 0xCA248 Kl_Xs16_Ws16 1000.000 Trq 0.00 1000.000 FORMAT "%8.3" EXTENDED_LIMITS -3276.800 3276.700
 /begin AXIS_DESCR STD_AXIS Eng_nAvrg EngN 10 0.00 6000.000 FORMAT "%8.3" EXTENDED_LIMITS -32768.00 32767.00 DEPOSIT ABSOLUTE /end AXIS_DESCR
/end CHARACTERISTIC
/begin CHARACTERISTIC CoEng_trqLimErr4_CUR "Kennlinie für Begrenzungsmoment abhängig von der Drehzahl im Fehlerfall 4" CURVE 0xCA272 Kl_Xs16_Ws16 1000.000 Trq 0.00 1000.000 FORMAT "%8.3" EXTENDED_LIMITS -3276.800 3276.700
 /begin AXIS_DESCR STD_AXIS Eng_nAvrg EngN 10 0.00 6000.000 FORMAT "%8.3" EXTENDED_LIMITS -32768.00 32767.00 DEPOSIT ABSOLUTE /end AXIS_DESCR
/end CHARACTERISTIC
/begin CHARACTERISTIC CoEng_trqLimErr_CUR "Kennlinie für das Begrenzungsmoment bei Systemfehlern" CURVE 0xCA29C Kl_Xs16_Ws16 1000.000 Trq 0.00 1000.000 FORMAT "%8.3" EXTENDED_LIMITS -3276.800 3276.700
 /begin AXIS_DESCR STD_AXIS Eng_nAvrg EngN 10 0.00 6000.000 FORMAT "%8.3" EXTENDED_LIMITS -32768.00 32767.00 DEPOSIT ABSOLUTE /end AXIS_DESCR
/end CHARACTERISTIC
/begin CHARACTERISTIC CoEng_trqLimPDiff1_CUR "Begrenzunsmoment aufgrund abasgegendruck" CURVE 0xCA2C6 Kl_Xs16_Ws16 1500.000 Trq -500.0000 1000.000 FORMAT "%8.3" EXTENDED_LIMITS -3276.800 3276.700
 /begin AXIS_DESCR STD_AXIS PFlt_pDiff Pres_hPa 8 0.00 5000.000 FORMAT "%8.3" EXTENDED_LIMITS -32768.00 32767.00 DEPOSIT ABSOLUTE /end AXIS_DESCR
/end CHARACTERISTIC
/begin CHARACTERISTIC CoEng_trqLimPDiffNOffs_CUR "Begrenzungswert im Fall des pflt-Systemfehlers, Startmoment ansteigen" CURVE 0xCA2E8 Kl_Xs16_Ws16 1000.000 Trq 0.00 1000.000 FORMAT "%8.3" EXTENDED_LIMITS -3276.800 3276.700
 /begin AXIS_DESCR STD_AXIS Eng_nAvrg EngN 16 0.00 6000.000 FORMAT "%8.3" EXTENDED_LIMITS -32768.00 32767.00 DEPOSIT ABSOLUTE /end AXIS_DESCR
/end CHARACTERISTIC
/begin CHARACTERISTIC CoEng_trqLimPDiff_MAP "Limit für differentialdruck des Partikelfilters" MAP 0xCA32A Kf_Xs16_Ys16_Ws16 1500.000 Trq -500.0000 1000.000 FORMAT "%8.3" EXTENDED_LIMITS -3276.800 3276.700
 /begin AXIS_DESCR STD_AXIS CoEng_pDiffPFltPrdc2_mp Pres_hPa 16 0.00 3500.000 FORMAT "%8.3" EXTENDED_LIMITS -32768.00 32767.00 DEPOSIT ABSOLUTE /end AXIS_DESCR
 /begin AXIS_DESCR STD_AXIS Eng_nAvrg EngN 8 0.00 6000.000 FORMAT "%8.3" EXTENDED_LIMITS -32768.00 32767.00 DEPOSIT ABSOLUTE /end AXIS_DESCR
/end CHARACTERISTIC
/begin CHARACTERISTIC CoEng_trqLimPFltOvld_MAP "Begrenzungsmoment aufgrund von CSf Überladung" MAP 0xCA45E Kf_Xs16_Ys16_Ws16 1500.000 Trq -500.0000 1000.000 FORMAT "%8.3" EXTENDED_LIMITS -3276.800 3276.700
 /begin AXIS_DESCR STD_AXIS Eng_nAvrg EngN 10 0.00 6000.000 FORMAT "%8.3" EXTENDED_LIMITS -32768.00 32767.00 DEPOSIT ABSOLUTE /end AXIS_DESCR
 /begin AXIS_DESCR STD_AXIS CoEng_tPFltCDMax_mp Temp_Cels 10 -50.140 899.860 FORMAT "%8.3" EXTENDED_LIMITS -3549.940 3003.560 DEPOSIT ABSOLUTE /end AXIS_DESCR
/end CHARACTERISTIC
/begin CHARACTERISTIC CoEng_trqOffs_C "Offset auf Begrenzungsmoment, um Arbeitsbereich f. ARDsr zu schaffen" VALUE 0xCA0CC Kw_Ws16 100.0000 Trq 0.00 100.0000 FORMAT "%8.4" EXTENDED_LIMITS -3276.800 3276.700 /end CHARACTERISTIC
/begin CHARACTERISTIC CoEng_trqOvrFulMax_C "oberer Wert für Overfueling Rampe" VALUE 0xCA552 Kw_Ws16 1000.000 Trq 0.00 1000.000 FORMAT "%8.3" EXTENDED_LIMITS -3276.800 3276.700 /end CHARACTERISTIC
/begin CHARACTERISTIC CoEng_trqOvrFulMin_C "unterer Wert für Overfueling Rampe" VALUE 0xCA554 Kw_Ws16 1000.000 Trq 0.00 1000.000 FORMAT "%8.3" EXTENDED_LIMITS -3276.800 3276.700 /end CHARACTERISTIC
/begin CHARACTERISTIC CoEng_trqOvrRunThres_C "Momentenschwelle zur Schuberkennung" VALUE 0xCA0CE Kw_Ws16 10.00000 Trq 0.00 10.00000 FORMAT "%8.5" EXTENDED_LIMITS -3276.800 3276.700 /end CHARACTERISTIC
/begin CHARACTERISTIC CoEng_trqSlpLim_Vector "Bypass Label for CoEng_trqSlpLim (nicht verändern !)" VALUE 0xC38E0 Kw_Wu8 255.0 OneToOne 0.00 255.0 FORMAT "%5.1" /end CHARACTERISTIC
/begin CHARACTERISTIC CoEng_trqSlpLim_Channel "Bypass Label für CoEng_trqSlpLim (nicht verändern !)" VALUE 0xC38E1 Kw_Wu8 255.0 OneToOne 0.00 255.0 FORMAT "%5.1" /end CHARACTERISTIC
/begin CHARACTERISTIC CoEng_tShOffTstMin_C "minimale Wassertemperaturschwelle für Abstelltests" VALUE 0xCA06C Kw_Ws16 950.000 Temp_Cels -50.140 899.860 FORMAT "%8.3" EXTENDED_LIMITS -3549.940 3003.560 /end CHARACTERISTIC
/begin CHARACTERISTIC CoEng_uHighBattPwrStgHysHi_C "Oberen schwelle der Hysterese für Höhere Grenze der Batteriespannung" VALUE 0xCA026 Kw_Ws16 20000.00 Volt_Batt 0.00 20000.00 FORMAT "%8.2" EXTENDED_LIMITS -640625.6 640606.1 /end CHARACTERISTIC
/begin CHARACTERISTIC CoEng_uHighBattPwrStgHysLo_C "Unteren schwelle der Hysterese für Höhere Grenze der Batteriespannung" VALUE 0xCA028 Kw_Ws16 20000.00 Volt_Batt 0.00 20000.00 FORMAT "%8.2" EXTENDED_LIMITS -640625.6 640606.1 /end CHARACTERISTIC
/begin CHARACTERISTIC CoEng_uLowBattPwrStgHysHi_C "Oberen schwelle der Hysterese für Untere Grenze der Batteriespannung" VALUE 0xCA02A Kw_Ws16 15992.18 Volt_Batt 0.00 15992.18 FORMAT "%8.2" EXTENDED_LIMITS -640625.6 640606.1 /end CHARACTERISTIC
/begin CHARACTERISTIC CoEng_uLowBattPwrStgHysLo_C "Unteren schwelle der Hysterese für Untere Grenze der Batteriespannung" VALUE 0xCA02C Kw_Ws16 15992.18 Volt_Batt 0.00 15992.18 FORMAT "%8.2" EXTENDED_LIMITS -640625.6 640606.1 /end CHARACTERISTIC
/begin CHARACTERISTIC CoEng_vOvrFulMin_C "untere Hysteresegrenze für Overfueling Fahrgeschwindigkeit" VALUE 0xCA556 Kw_Ws16 300.0000 Vel 0.00 300.0000 FORMAT "%8.4" EXTENDED_LIMITS -327.6800 327.6700 /end CHARACTERISTIC
/begin CHARACTERISTIC CoEng_vOvrFulMax_C "obere Hysteresegrenze für Overfueling Fahrgeschwindigkeit" VALUE 0xCA558 Kw_Ws16 300.0000 Vel 0.00 300.0000 FORMAT "%8.4" EXTENDED_LIMITS -327.6800 327.6700 /end CHARACTERISTIC
/begin CHARACTERISTIC CoEng_stvOvrFulLow_C "Status für Overfueling Fahrgeschwindigkeit Hysterese aus" VALUE 0xCA55A Kw_Ws16 65535.00 OneToOne -32768.00 32767.00 FORMAT "%8.2" READ_ONLY /end CHARACTERISTIC
/begin CHARACTERISTIC CoEng_stvOvrFulHigh_C "Status für Overfueling Fahrgeschwindigkeit Hysterese ein" VALUE 0xCA55C Kw_Ws16 65535.00 OneToOne -32768.00 32767.00 FORMAT "%8.2" READ_ONLY /end CHARACTERISTIC
/begin CHARACTERISTIC CoEng_vShOffTstMin_C "minimale Fahrgeschwindigkeits-Schwelle für Abstelltests" VALUE 0xCA06E Kw_Ws16 327.6700 Vel 0.00 327.6700 FORMAT "%8.4" EXTENDED_LIMITS -327.6800 327.6700 /end CHARACTERISTIC
/begin CHARACTERISTIC CoEng_vSoftShOffMax_C "vehicle speed limit for soft shutoff" VALUE 0xCA064 Kw_Ws16 327.6700 Vel 0.00 327.6700 FORMAT "%8.4" EXTENDED_LIMITS -327.6800 327.6700 /end CHARACTERISTIC
/begin CHARACTERISTIC ConvCD_DebPlaDef_C "Zählerwert zur Defektentprellung (PLA)" VALUE 0xCA5A6 Kw_Wu16 65535.00 OneToOne 0.00 65535.00 FORMAT "%8.2" /end CHARACTERISTIC
/begin CHARACTERISTIC ConvCD_DebPlaOk_C "Zählerwert zur Heilungsentprellung (PLA)" VALUE 0xCA5A8 Kw_Wu16 65535.00 OneToOne 0.00 65535.00 FORMAT "%8.2" /end CHARACTERISTIC
/begin CHARACTERISTIC ConvCD_tiDebPos_C "Entprellzeit für pos. Flanke des Kupplungssignals" VALUE 0xCA5AA Kw_Wu16 2000.000 TimeDeb 0.00 2000.000 FORMAT "%8.3" EXTENDED_LIMITS 0.00 655350.0 /end CHARACTERISTIC
/begin CHARACTERISTIC ConvCD_tiDebNeg_C "Entprellzeit für neg. Flanke des Kupplungssignals." VALUE 0xCA5AC Kw_Wu16 2000.000 TimeDeb 0.00 2000.000 FORMAT "%8.3" EXTENDED_LIMITS 0.00 655350.0 /end CHARACTERISTIC
/begin CHARACTERISTIC ConvCD_DebSigDef_C "Entprellzeit bis CAN-Botschaftsfehler defekt" VALUE 0xCA5AE Kw_Wu16 655350.0 Time_ms 0.00 655350.0 FORMAT "%8.1" /end CHARACTERISTIC
/begin CHARACTERISTIC ConvCD_DebSigOk_C "Entprellzeit bis CAN-Botschaftsfehler geheilt" VALUE 0xCA5B0 Kw_Wu16 655350.0 Time_ms 0.00 655350.0 FORMAT "%8.1" /end CHARACTERISTIC
/begin CHARACTERISTIC ConvCD_nNoGearShftDet_C "Grenzwert unter dem die Gangerkennung für die Plausibilitätsprüfung abgeschaltet werden muss" VALUE 0xCA5B2 Kw_Ws16 6000.000 EngN 0.00 6000.000 FORMAT "%8.3" EXTENDED_LIMITS -32768.00 32767.00 /end CHARACTERISTIC
/begin CHARACTERISTIC ConvCD_numDioIn_C "Applikationsparameter für den Pin des Kupplungssignals" VALUE 0xCA5B4 Kw_Wu8 12.0000000000 NumPinDioIn 0.00 12.0000000000 FORMAT "%13.10" /end CHARACTERISTIC
/begin CHARACTERISTIC ConvCD_numStepDef_C "Zählschrittweite für Aufwärtszählen zur Defektentprellung" VALUE 0xCA5B5 Kw_Wu8 3.000 OneToOne 0.00 3.000 FORMAT "%5.3" EXTENDED_LIMITS 0.00 255.0 /end CHARACTERISTIC
/begin CHARACTERISTIC ConvCD_numStepOK_C "Zählschrittweite für Abwärtszählen zur Heilungsentprellung" VALUE 0xCA5B6 Kw_Wu8 3.000 OneToOne 0.00 3.000 FORMAT "%5.3" EXTENDED_LIMITS 0.00 255.0 /end CHARACTERISTIC
/begin CHARACTERISTIC ConvCD_stDflVal_C "Kupplungssignal Vorgabewert" VALUE 0xCA5B7 Kw_Wu8 1.000 OneToOne 0.00 1.000 FORMAT "%5.3" EXTENDED_LIMITS 0.00 255.0 /end CHARACTERISTIC
/begin CHARACTERISTIC ConvCD_stGripCtlAST_C "Vorgabewert für autom. Schaltgetriebe bei fehlendem Kraftschluß (""rutschende Kupplung"")" VALUE 0xCA5B8 Kw_Wu8 1.000 OneToOne 0.00 1.000 FORMAT "%5.3" EXTENDED_LIMITS 0.00 255.0 /end CHARACTERISTIC
/begin CHARACTERISTIC ConvCD_swtInv_C "Schalter zum invertieren  des Kupplungsignals (0=nichtinvertiert,1=invertiert), Einfluss auf Digitaleingang und CAN" VALUE 0xCA5B9 Kw_Wu8 1.000 OneToOne 0.00 1.000 FORMAT "%5.3" EXTENDED_LIMITS 0.00 255.0 /end CHARACTERISTIC
/begin CHARACTERISTIC ConvCD_swtSigVal_C "Schalter für Signalquellenauswahl (0=HW-Eingang, 1=CAN)" VALUE 0xCA5BA Kw_Wu8 2.000 OneToOne 0.00 2.000 FORMAT "%5.3" EXTENDED_LIMITS 0.00 255.0 /end CHARACTERISTIC
/begin CHARACTERISTIC ConvCD_tiGearShft_C "Zeit für Entprellung zum Gangwechsel Erkennung." VALUE 0xCA5BC Kw_Wu16 655350.0 Time_ms 0.00 655350.0 FORMAT "%8.1" /end CHARACTERISTIC
/begin CHARACTERISTIC ConvCD_vNoGearShftDet_C "Grenzwert unter dem die Gangerkennung für die Plausibilitätsprüfung abgeschaltet werden muss" VALUE 0xCA5BE Kw_Ws16 300.0000 Vel 0.00 300.0000 FORMAT "%8.4" EXTENDED_LIMITS -327.6800 327.6700 /end CHARACTERISTIC
/begin CHARACTERISTIC CoVeh_dnLI_C "unterer Schwellenwert der Motordrehzahl die zur Leistung/Moment Umrechnung verwendet wird" VALUE 0xCA5C0 Kw_Ws16 1000.000 EngN 0.00 1000.000 FORMAT "%8.3" EXTENDED_LIMITS -32768.00 32767.00 /end CHARACTERISTIC
/begin CHARACTERISTIC CoVeh_dtrqLimDwn_C "Rampe für Systemfehler Drehmoment" VALUE 0xCA5C2 Kw_Ws16 327660.0 dTrqPrp_20ms 10.00000 327670.0 FORMAT "%8.1" EXTENDED_LIMITS -327680.0 327670.0 /end CHARACTERISTIC
/begin CHARACTERISTIC CoVeh_dtrqLimUp_C "Rampe für Heilung Systemfehler Drehmoment" VALUE 0xCA5C4 Kw_Ws16 327660.0 dTrqPrp_20ms 10.00000 327670.0 FORMAT "%8.1" EXTENDED_LIMITS -327680.0 327670.0 /end CHARACTERISTIC
/begin CHARACTERISTIC CoVeh_trqLim_CUR "Begrenzungswert bei Systemfehler Drehmoment" CURVE 0xCA5C6 Kl_Xs16_Ws16 11000.00 TrqPrp -5000.000 6000.000 FORMAT "%8.3" EXTENDED_LIMITS -6553.600 6553.400
 /begin AXIS_DESCR STD_AXIS Eng_nAvrg EngN 10 0.00 6000.000 FORMAT "%8.3" EXTENDED_LIMITS -32768.00 32767.00 DEPOSIT ABSOLUTE /end AXIS_DESCR
/end CHARACTERISTIC
/begin CHARACTERISTIC CoVeh_trqPrpDes_Vector "Bypass-Label für CoVeh_trqPrpDes (Nicht verstellen!)" VALUE 0xC38E2 Kw_Wu8 255.0 OneToOne 0.00 255.0 FORMAT "%5.1" /end CHARACTERISTIC
/begin CHARACTERISTIC CoVeh_trqPrpDes_Channel "Bypass label, nicht editieren" VALUE 0xC38E3 Kw_Wu8 255.0 OneToOne 0.00 255.0 FORMAT "%5.1" /end CHARACTERISTIC
/begin CHARACTERISTIC CoVeh_trqPrpLead_Vector "Bypass label, nicht editieren!" VALUE 0xC38E4 Kw_Wu8 255.0 OneToOne 0.00 255.0 FORMAT "%5.1" /end CHARACTERISTIC
/begin CHARACTERISTIC CoVeh_trqPrpLead_Channel "Bypass label, nicht editieren!" VALUE 0xC38E5 Kw_Wu8 255.0 OneToOne 0.00 255.0 FORMAT "%5.1" /end CHARACTERISTIC
/begin CHARACTERISTIC CoVM_amMAX_C "Grenzwert zur Erkennung der physikalischen Unplausibilität des MSR (DCS) Eingriffs" VALUE 0xCA5F0 Kw_Wu16 327675.0 TrqPrpDT 0.00 327675.0 FORMAT "%8.1" /end CHARACTERISTIC
/begin CHARACTERISTIC CoVM_dtrqLeadCorUp_C "Rampe zum Aufbau ASR-Vorhalt" VALUE 0xCA5FC Kw_Wu32 13107199.9969 RmpTrqPrp 0.00 13107199.9969 FORMAT "%13.4" /end CHARACTERISTIC
/begin CHARACTERISTIC CoVM_dtrqLeadCorDwn_C "Rampe zum Abbau ASR-Vorhalt" VALUE 0xCA600 Kw_Wu32 13107199.9969 RmpTrqPrp 0.00 13107199.9969 FORMAT "%13.4" /end CHARACTERISTIC
/begin CHARACTERISTIC CoVM_swtIntvPrio_C "Priorisierung der Fahrdynamikeingriffe über die Getriebeeingriffe (1:keine Begrenzung der Getriebeeingriffe, 0: Begrenzung)" VALUE 0xCA604 Kw_Wu8 1.000 OneToOne 0.00 1.000 FORMAT "%5.3" EXTENDED_LIMITS 0.00 255.0 /end CHARACTERISTIC
/begin CHARACTERISTIC CoVM_swtPlausChkVal_C "Konfigurationsschalter MSR-Momentenüberschussintegral (1: ein/ 0:aus)." VALUE 0xCA5F2 Kw_Wu8 1.000 OneToOne 0.00 1.000 FORMAT "%5.3" EXTENDED_LIMITS 0.00 255.0 /end CHARACTERISTIC
/begin CHARACTERISTIC CoVM_swtPlausChkType_C "Softwareschalter Type für CoVM_swtSlipCtlVal_C" VALUE 0xCA5F3 Kw_Wu8 2.000 OneToOne 0.00 2.000 FORMAT "%5.3" EXTENDED_LIMITS 0.00 255.0 /end CHARACTERISTIC
/begin CHARACTERISTIC CoVM_swtSlipCtlVal_C "Fahrdynamik-Konfiguration (0: ASR aus & MSR aus; 1: ASR an & MSR aus;  2: ASR aus & MSR an;  3: ASR an & MSR an)" VALUE 0xCA5F4 Kw_Wu8 3.000 OneToOne 0.00 3.000 FORMAT "%5.3" EXTENDED_LIMITS 0.00 255.0 /end CHARACTERISTIC
/begin CHARACTERISTIC CoVM_swtSlipCtlType_C "Softwareschalter Type für CoVM_swtSlipCtlVal_C" VALUE 0xCA5F5 Kw_Wu8 2.000 OneToOne 0.00 2.000 FORMAT "%5.3" EXTENDED_LIMITS 0.00 255.0 /end CHARACTERISTIC
/begin CHARACTERISTIC CoVM_swtTrqDesSel_C "Schalter zur Auswahl des Wunschdrehmoments über CAN bei Max. Geschwindigkeitsbegrenzung" VALUE 0xCA605 Kw_Wu8 1.000 OneToOne 0.00 1.000 FORMAT "%5.3" EXTENDED_LIMITS 0.00 255.0 /end CHARACTERISTIC
/begin CHARACTERISTIC CoVM_swttrqDVCH_C "Schalter zur Korrektur von CoVM_trqDVCH mit Gearbx_trqFrc (1 = Korrektur, 0 = keine Korrektur)" VALUE 0xCA606 Kw_Wu8 255.0 OneToOne 0.00 255.0 FORMAT "%5.1" /end CHARACTERISTIC
/begin CHARACTERISTIC CoVM_tiDebMaxOk_C "Heilungsentprellzeit der physikalischen Unplausibilität" VALUE 0xCA5F6 Kw_Wu16 655350.0 TimeDeb 0.00 655350.0 FORMAT "%8.1" /end CHARACTERISTIC
/begin CHARACTERISTIC CoVM_tiDebMaxDef_C "Fehlerentprellzeit der physikalischen Unplausibilität" VALUE 0xCA5F8 Kw_Wu16 655350.0 TimeDeb 0.00 655350.0 FORMAT "%8.1" /end CHARACTERISTIC
/begin CHARACTERISTIC CoVM_tiTrqRedMax_C "Zeitschwelle für ""langen"" ASR-Eingriff" VALUE 0xCA608 Kw_Wu16 655.3500 Time_s 0.00 655.3500 FORMAT "%8.4" /end CHARACTERISTIC
/begin CHARACTERISTIC CoVM_trqDecMax_C "Maximum replacement value for torque decrement" VALUE 0xCA60C Kw_Ws16 1000.000 TrqPrp -500.0000 500.0000 FORMAT "%8.4" EXTENDED_LIMITS -6553.600 6553.400 /end CHARACTERISTIC
/begin CHARACTERISTIC CoVM_dtrqLimUpDec_C "torque ramp up at decrease in torque" VALUE 0xCA610 Kw_Wu32 13107199.9969 RmpTrqPrp 0.00 13107199.9969 FORMAT "%13.4" /end CHARACTERISTIC
/begin CHARACTERISTIC CoVM_dtrqLimDwnDec_C "torque ramp down at decrease in torque" VALUE 0xCA614 Kw_Wu32 13107199.9969 RmpTrqPrp 0.00 13107199.9969 FORMAT "%13.4" /end CHARACTERISTIC
/begin CHARACTERISTIC CoVM_trqIncMin_C "Replacement value for torque increment" VALUE 0xCA618 Kw_Ws16 1000.000 TrqPrp -500.0000 500.0000 FORMAT "%8.4" EXTENDED_LIMITS -6553.600 6553.400 /end CHARACTERISTIC
/begin CHARACTERISTIC CoVM_dtrqLimUpInc_C "torque ramp up for increase in torque" VALUE 0xCA61C Kw_Wu32 13107199.9969 RmpTrqPrp 0.00 13107199.9969 FORMAT "%13.4" /end CHARACTERISTIC
/begin CHARACTERISTIC CoVM_dtrqLimDwnInc_C "torque ramp down increase in torque" VALUE 0xCA620 Kw_Wu32 13107199.9969 RmpTrqPrp 0.00 13107199.9969 FORMAT "%13.4" /end CHARACTERISTIC
/begin CHARACTERISTIC CpBVlv_numGear_C "Gang schwellwert" VALUE 0xCA624 Kw_Ws8 7.000 OneToOne -1.000 6.000 FORMAT "%5.3" EXTENDED_LIMITS -128.0 127.0 /end CHARACTERISTIC
/begin CHARACTERISTIC CpBVlv_qCloseRgn_MAP "Kennfeld für unteren Schwellwert der Kraftstoffmenge bei Regeneration" MAP 0xCA626 Kf_Xs16_Ys16_Ws16 327.6700 InjMass 0.00 327.6700 FORMAT "%8.4" EXTENDED_LIMITS -327.6800 327.6700
 /begin AXIS_DESCR STD_AXIS Eng_nAvrg EngN 12 0.00 6000.000 FORMAT "%8.3" EXTENDED_LIMITS -32768.00 32767.00 DEPOSIT ABSOLUTE /end AXIS_DESCR
 /begin AXIS_DESCR STD_AXIS APSCD_pVal Pres_hPa 6 0.00 3500.000 FORMAT "%8.3" EXTENDED_LIMITS -32768.00 32767.00 DEPOSIT ABSOLUTE /end AXIS_DESCR
/end CHARACTERISTIC
/begin CHARACTERISTIC CpBVlv_qClose_MAP "MAP unterer schwellwert Kraftstoffmenge" MAP 0xCA6DE Kf_Xs16_Ys16_Ws16 327.6700 InjMass 0.00 327.6700 FORMAT "%8.4" EXTENDED_LIMITS -327.6800 327.6700
 /begin AXIS_DESCR STD_AXIS Eng_nAvrg EngN 12 0.00 6000.000 FORMAT "%8.3" EXTENDED_LIMITS -32768.00 32767.00 DEPOSIT ABSOLUTE /end AXIS_DESCR
 /begin AXIS_DESCR STD_AXIS APSCD_pVal Pres_hPa 6 0.00 3500.000 FORMAT "%8.3" EXTENDED_LIMITS -32768.00 32767.00 DEPOSIT ABSOLUTE /end AXIS_DESCR
/end CHARACTERISTIC
/begin CHARACTERISTIC CpBVlv_qOpnRgn_MAP "Kennfeld für einen höheren Schwellenwert der Kraftstoffmenge" MAP 0xCA796 Kf_Xs16_Ys16_Ws16 327.6700 InjMass 0.00 327.6700 FORMAT "%8.4" EXTENDED_LIMITS -327.6800 327.6700
 /begin AXIS_DESCR STD_AXIS Eng_nAvrg EngN 12 0.00 6000.000 FORMAT "%8.3" EXTENDED_LIMITS -32768.00 32767.00 DEPOSIT ABSOLUTE /end AXIS_DESCR
 /begin AXIS_DESCR STD_AXIS APSCD_pVal Pres_hPa 6 0.00 3500.000 FORMAT "%8.3" EXTENDED_LIMITS -32768.00 32767.00 DEPOSIT ABSOLUTE /end AXIS_DESCR
/end CHARACTERISTIC
/begin CHARACTERISTIC CpBVlv_qOpn_MAP "MAP oberer schwellwert Kraftstoffmenge" MAP 0xCA84E Kf_Xs16_Ys16_Ws16 327.6700 InjMass 0.00 327.6700 FORMAT "%8.4" EXTENDED_LIMITS -327.6800 327.6700
 /begin AXIS_DESCR STD_AXIS Eng_nAvrg EngN 12 0.00 6000.000 FORMAT "%8.3" EXTENDED_LIMITS -32768.00 32767.00 DEPOSIT ABSOLUTE /end AXIS_DESCR
 /begin AXIS_DESCR STD_AXIS APSCD_pVal Pres_hPa 6 0.00 3500.000 FORMAT "%8.3" EXTENDED_LIMITS -32768.00 32767.00 DEPOSIT ABSOLUTE /end AXIS_DESCR
/end CHARACTERISTIC
/begin CHARACTERISTIC CpBVlv_stClose_C "Kompressor-Bypassventil geschlossen" VALUE 0xCA906 Kw_Wu8 1.000 OneToOne 0.00 1.000 FORMAT "%5.3" EXTENDED_LIMITS 0.00 255.0 /end CHARACTERISTIC
/begin CHARACTERISTIC CpBVlv_stOpn_C "Kompressor-Bypassventil offen" VALUE 0xCA907 Kw_Wu8 1.000 OneToOne 0.00 1.000 FORMAT "%5.3" EXTENDED_LIMITS 0.00 255.0 /end CHARACTERISTIC
/begin CHARACTERISTIC CpBVlv_stRgnMsk_C "Bit mask for switching off at regeneration" VALUE 0xCA908 Kw_Wu32 4294967295.00 OneToOne 0.00 4294967295.00 FORMAT "%13.2" /end CHARACTERISTIC
/begin CHARACTERISTIC CpBVlv_swtErrOff_C "mask für shutoff" VALUE 0xCA90C Kw_Wu8 255.0 OneToOne 0.00 255.0 FORMAT "%5.1" /end CHARACTERISTIC
/begin CHARACTERISTIC CpBVlv_swtQDesVal_C "Auswahlschalter Mengenreferenz (0: derzeitige Menge, 1: Rohmenge)" VALUE 0xCA90D Kw_Wu8 1.000 OneToOne 0.00 1.000 FORMAT "%5.3" EXTENDED_LIMITS 0.00 255.0 /end CHARACTERISTIC
/begin CHARACTERISTIC CpBVlv_tiRmpSlp_C "Neigungswert für Rampe" VALUE 0xCA910 Kw_Wu32 31.775030303030302 TimeEGTRmp 0.99296969696969695 32.768000000000001 FORMAT "%19.16" EXTENDED_LIMITS 0.000000015258789066052715 65.536000000000001 /end CHARACTERISTIC
/begin CHARACTERISTIC CrCCD_tiDebMaxMFLDef_C "Defektentprellung Togglebittimeout" VALUE 0xCA914 Kw_Wu16 655350.0 Time_ms 0.00 655350.0 FORMAT "%8.1" /end CHARACTERISTIC
/begin CHARACTERISTIC CrCCD_tiDebMaxMFLOk_C "Heilentprellung Togglebittimeout" VALUE 0xCA916 Kw_Wu16 655350.0 Time_ms 0.00 655350.0 FORMAT "%8.1" /end CHARACTERISTIC
/begin CHARACTERISTIC CrCCD_tiDebMinMFLDef_C "Defektentprellung Framelänge außerhalb der Toleranz" VALUE 0xCA918 Kw_Wu16 655350.0 Time_ms 0.00 655350.0 FORMAT "%8.1" /end CHARACTERISTIC
/begin CHARACTERISTIC CrCCD_tiDebMinMFLOk_C "Heilentprellung Framelänge außerhalb der Toleranz" VALUE 0xCA91A Kw_Wu16 655350.0 Time_ms 0.00 655350.0 FORMAT "%8.1" /end CHARACTERISTIC
/begin CHARACTERISTIC CrCCD_tiDebNplMFLDef_C "Defektentprellung MFL-Signal nicht plausibel (Biterror)" VALUE 0xCA91C Kw_Wu16 655350.0 Time_ms 0.00 655350.0 FORMAT "%8.1" /end CHARACTERISTIC
/begin CHARACTERISTIC CrCCD_tiDebNplMFLOk_C "Heilentprellung MFL-Signal nicht plausibel (Biterror)" VALUE 0xCA91E Kw_Wu16 655350.0 Time_ms 0.00 655350.0 FORMAT "%8.1" /end CHARACTERISTIC
/begin CHARACTERISTIC CrCCD_tiDebSigMFLDef_C "Defektentprellung MFL-Signal Timeout" VALUE 0xCA920 Kw_Wu16 655350.0 Time_ms 0.00 655350.0 FORMAT "%8.1" /end CHARACTERISTIC
/begin CHARACTERISTIC CrCCD_tiDebSigMFLOk_C "Heilentprellung MFL-Signal Timeout" VALUE 0xCA922 Kw_Wu16 655350.0 Time_ms 0.00 655350.0 FORMAT "%8.1" /end CHARACTERISTIC
/begin CHARACTERISTIC CrCCD_stMSWModeAdjMax_C "Maximalwert vom Abgleichwert Mainswitch Mode" VALUE 0xCA924 Kw_Wu8 1.000 OneToOne 0.00 1.000 FORMAT "%5.3" EXTENDED_LIMITS 0.00 255.0 /end CHARACTERISTIC
/begin CHARACTERISTIC CrCCD_stMSWModeAdjMin_C "Minimalwert vom Abgleichwert Mainswitch Mode" VALUE 0xCA925 Kw_Wu8 1.000 OneToOne 0.00 1.000 FORMAT "%5.3" EXTENDED_LIMITS 0.00 255.0 /end CHARACTERISTIC
/begin CHARACTERISTIC CrCCD_stMSWModeDflt_C "Vorgabewert für Abgleichwert Mainswitch Mode bei fehlgeschlagener EEPROM Kommunikation" VALUE 0xCA926 Kw_Wu8 1.000 OneToOne 0.00 1.000 FORMAT "%5.3" EXTENDED_LIMITS 0.00 255.0 /end CHARACTERISTIC
/begin CHARACTERISTIC CrCCD_swtDevType_C "SW-Schalter Typ für CrCCD_swtDev" VALUE 0xCA927 Kw_Wu8 1.000 OneToOne 0.00 1.000 FORMAT "%5.3" EXTENDED_LIMITS 0.00 255.0 /end CHARACTERISTIC
/begin CHARACTERISTIC CrCCD_swtDevVal_C "Datensatzwert für SW-Schalter CrCCD_swtDev, eingebauter FGR-Bedienteiltyp (0: kein bedienteil, 1: TPU, 2: CAN)" VALUE 0xCA928 Kw_Wu8 2.000 OneToOne 0.00 2.000 FORMAT "%5.3" EXTENDED_LIMITS 0.00 255.0 /end CHARACTERISTIC
/begin CHARACTERISTIC CrCCD_swtMSWType_C "MSW Mode vom EEPROM (1) oder Applikation (0)" VALUE 0xCA929 Kw_Wu8 1.000 OneToOne 0.00 1.000 FORMAT "%5.3" EXTENDED_LIMITS 0.00 255.0 /end CHARACTERISTIC
/begin CHARACTERISTIC CrCCD_swtMSWVal_C "MSW Mode von der Applikation (1: MSW aktiviert, 0: MSW deaktiviert)" VALUE 0xCA92A Kw_Wu8 1.000 OneToOne 0.00 1.000 FORMAT "%5.3" EXTENDED_LIMITS 0.00 255.0 /end CHARACTERISTIC
/begin CHARACTERISTIC CrCCD_tiDebSetMn_C "time for SET- detection" VALUE 0xCA92C Kw_Wu16 1500.000 Time_ms 0.00 1500.000 FORMAT "%8.3" EXTENDED_LIMITS 0.00 655350.0 /end CHARACTERISTIC
/begin CHARACTERISTIC CrCCD_tiDebSetPl_C "time for SET+ detection" VALUE 0xCA92E Kw_Wu16 1500.000 Time_ms 0.00 1500.000 FORMAT "%8.3" EXTENDED_LIMITS 0.00 655350.0 /end CHARACTERISTIC
/begin CHARACTERISTIC CrCCD_tiToggleMax_C "Maximalzeit bis Togglebitwechsel erfolgt sein muß" VALUE 0xCA930 Kw_Wu16 1500.000 Time_ms 0.00 1500.000 FORMAT "%8.3" EXTENDED_LIMITS 0.00 655350.0 /end CHARACTERISTIC
/begin CHARACTERISTIC CrCtl_aAccMax_C "Fahrzeugbeschleunigungsschwelle für CrCtl-Abschaltbedingung ""zu große Fahrzeugbeschleunigung""" VALUE 0xCA934 Kw_Ws16 42.76800 Acc -32.76800 10.00000 FORMAT "%8.5" EXTENDED_LIMITS -32.76800 32.76700 /end CHARACTERISTIC
/begin CHARACTERISTIC CrCtl_aDecMax_C "max. zulässige neg. Beschleunigung für Abschaltung FGR" VALUE 0xCA936 Kw_Ws16 32.76800 Acc -32.76800 0.00 FORMAT "%8.5" EXTENDED_LIMITS -32.76800 32.76700 /end CHARACTERISTIC
/begin CHARACTERISTIC CrCtl_nMaxAlw_C "Obere Drehzahlschwelle Abschaltung FGR" VALUE 0xCA938 Kw_Ws16 6000.000 EngN 0.00 6000.000 FORMAT "%8.3" EXTENDED_LIMITS -32768.00 32767.00 /end CHARACTERISTIC
/begin CHARACTERISTIC CrCtl_nMinAlw_C "untere Drehzahlschwelle Abschaltung FGR" VALUE 0xCA93A Kw_Ws16 6000.000 EngN 0.00 6000.000 FORMAT "%8.3" EXTENDED_LIMITS -32768.00 32767.00 /end CHARACTERISTIC
/begin CHARACTERISTIC CrCtl_rVnDvtShutOff_C "Abweichung v/n-Verhältnis Abschalten FGR" VALUE 0xCA93C Kw_Ws16 0.3276700 VelToN 0.00 0.3276700 FORMAT "%9.7" EXTENDED_LIMITS -0.3276800 0.3276700 /end CHARACTERISTIC
/begin CHARACTERISTIC CrCtl_stShutOffCodeMsk_C "Bitmaske zum Ausmaskieren von FGR-Abschaltbedingungen" VALUE 0xCA940 Kw_Wu32 4294967295.00 OneToOne 0.00 4294967295.00 FORMAT "%13.2" /end CHARACTERISTIC
/begin CHARACTERISTIC CrCtl_stShutOffHDC_C "Shutoff of Hill descent Control" VALUE 0xCA944 Kw_Wu8 255.0 OneToOne 0.00 255.0 FORMAT "%5.1" /end CHARACTERISTIC
/begin CHARACTERISTIC CrCtl_stShutOffInfoLR_C "informationswert zum ausschalten bei zu geringem abstand" VALUE 0xCA945 Kw_Wu8 255.0 OneToOne 0.00 255.0 FORMAT "%5.1" /end CHARACTERISTIC
/begin CHARACTERISTIC CrCtl_stShutOffLR_C "Application data for shutoff of LR" VALUE 0xCA946 Kw_Wu8 255.0 OneToOne 0.00 255.0 FORMAT "%5.1" /end CHARACTERISTIC
/begin CHARACTERISTIC CrCtl_swtSelKombi_C "Schalter zur Auswahl des Kombi-Typs (1: standard, 0: alte version)" VALUE 0xCA947 Kw_Wu8 255.0 OneToOne 0.00 255.0 FORMAT "%5.1" /end CHARACTERISTIC
/begin CHARACTERISTIC CrCtl_swtShutOffOpt_C "Optionen Abschaltung FGR (bit 0: 1: Ansteuerung der Bremse vor Fahrgeschwindigkeitstest, 0: kein Ansteuern; bit1-7: ungebraucht)" VALUE 0xCA948 Kw_Wu8 255.0 OneToOne 0.00 255.0 FORMAT "%5.1" /end CHARACTERISTIC
/begin CHARACTERISTIC CrCtl_tiAcc_C "Maximalzeit für Abschaltbedingung ""zu große Beschleunigung""" VALUE 0xCA94A Kw_Wu16 655350.0 TimeDeb 0.00 655350.0 FORMAT "%8.1" /end CHARACTERISTIC
/begin CHARACTERISTIC CrCtl_tiAqpl_C "Maximalzeit für Aquaplaningerkennung" VALUE 0xCA94C Kw_Wu16 655350.0 TimeDeb 0.00 655350.0 FORMAT "%8.1" /end CHARACTERISTIC
/begin CHARACTERISTIC CrCtl_tiClCtrDelayABS_C "Entprellung der FGR-Abschaltung bei ABS-Eingriff" VALUE 0xCA94E Kw_Wu16 655350.0 TimeDeb 0.00 655350.0 FORMAT "%8.1" /end CHARACTERISTIC
/begin CHARACTERISTIC CrCtl_tiClCtrDelayASC_C "debounce time for ASC intervention" VALUE 0xCA950 Kw_Wu16 655350.0 TimeDeb 0.00 655350.0 FORMAT "%8.1" /end CHARACTERISTIC
/begin CHARACTERISTIC CrCtl_tiClCtrDelayDSC_C "debounce time for DSC intervention" VALUE 0xCA952 Kw_Wu16 655350.0 TimeDeb 0.00 655350.0 FORMAT "%8.1" /end CHARACTERISTIC
/begin CHARACTERISTIC CrCtl_tiClCtrDelayEBV_C "Entprellung der FGR-Abschaltung bei EBV-Eingriff" VALUE 0xCA954 Kw_Wu16 655350.0 TimeDeb 0.00 655350.0 FORMAT "%8.1" /end CHARACTERISTIC
/begin CHARACTERISTIC CrCtl_tiClCtrDelayHBA_C "Entprellung der FGR-Abschaltung bei HBA-Eingriff" VALUE 0xCA956 Kw_Wu16 655350.0 TimeDeb 0.00 655350.0 FORMAT "%8.1" /end CHARACTERISTIC
/begin CHARACTERISTIC CrCtl_tiClCtrDelayMSR_C "debounce time for MSR intervention" VALUE 0xCA958 Kw_Wu16 655350.0 TimeDeb 0.00 655350.0 FORMAT "%8.1" /end CHARACTERISTIC
/begin CHARACTERISTIC CrCtl_tiDec_C "Entprellzeit zu große Fahrzeugverzögerung für Abschaltung FGR" VALUE 0xCA95A Kw_Wu16 655350.0 TimeDeb 0.00 655350.0 FORMAT "%8.1" /end CHARACTERISTIC
/begin CHARACTERISTIC CrCtl_tiGearDeb_C "Entprellzeit neuer Gang für FGR" VALUE 0xCA95C Kw_Wu16 655350.0 TimeDeb 0.00 655350.0 FORMAT "%8.1" /end CHARACTERISTIC
/begin CHARACTERISTIC CrCtl_tiNegDvtTi_C "Entprellzeit zu große neg. Geschwindigkeitsabweichung für Abschaltung FGR" VALUE 0xCA95E Kw_Wu16 655350.0 TimeDeb 0.00 655350.0 FORMAT "%8.1" /end CHARACTERISTIC
/begin CHARACTERISTIC CrCtl_vDiffAqpl_C "Geschwindigkeitsdifferenz für Aquaplaningerkennung" VALUE 0xCA960 Kw_Ws16 300.0000 Vel 0.00 300.0000 FORMAT "%8.4" EXTENDED_LIMITS -327.6800 327.6700 /end CHARACTERISTIC
/begin CHARACTERISTIC CrCtl_vMaxShutOff_C "obere Grenze Fahrgeschwindigkeit Abschaltung FGR" VALUE 0xCA962 Kw_Ws16 300.0000 Vel 0.00 300.0000 FORMAT "%8.4" EXTENDED_LIMITS -327.6800 327.6700 /end CHARACTERISTIC
/begin CHARACTERISTIC CrCtl_vMinShutOff_C "untere Grenze Fahrgeschwindigkeit Abschaltung FGR" VALUE 0xCA964 Kw_Ws16 300.0000 Vel 0.00 300.0000 FORMAT "%8.4" EXTENDED_LIMITS -327.6800 327.6700 /end CHARACTERISTIC
/begin CHARACTERISTIC CrCtl_vNegDvtTi_C "negative Geschwindigkeitsabweichung Abschaltung FGR nach Entprellzeit" VALUE 0xCA966 Kw_Ws16 300.0000 Vel 0.00 300.0000 FORMAT "%8.4" EXTENDED_LIMITS -327.6800 327.6700 /end CHARACTERISTIC
/begin CHARACTERISTIC CrCtl_vNegDvt_C "negative Geschwindigkeitsabweichung Abschaltung FGR" VALUE 0xCA968 Kw_Ws16 300.0000 Vel 0.00 300.0000 FORMAT "%8.4" EXTENDED_LIMITS -327.6800 327.6700 /end CHARACTERISTIC
/begin CHARACTERISTIC CrCtl_vPosDvt_C "positive Geschwindigkeitsabweichung Abschaltung FGR" VALUE 0xCA96A Kw_Ws16 300.0000 Vel 0.00 300.0000 FORMAT "%8.4" EXTENDED_LIMITS -327.6800 327.6700 /end CHARACTERISTIC
/begin CHARACTERISTIC TMSGSGTMN "min zeit zwischen zwei botschaften" VALUE 0xC05AE KwWU8 5.100 t20msxs_ub_b5p1 0.00 5.100 FORMAT "%5.3" /end CHARACTERISTIC
/begin MEASUREMENT BypEtk_ctStepDelayNsync_u8 "ETK Bypass Schritt drehzahlsynchron" UBYTE OneToOne 1 100 0.00 255.0 FORMAT "%5.1" ECU_ADDRESS 0x7FDED6 /end MEASUREMENT
/begin MEASUREMENT BypEtk_ctStepDelayTsync_u8 "ETK Bypass Schritt zeitsynchron" UBYTE OneToOne 1 100 0.00 255.0 FORMAT "%5.1" ECU_ADDRESS 0x7FDED7 /end MEASUREMENT
/begin MEASUREMENT BypEtk_stEcu_u8 "Status ETK-Bypass in SG (0: inaktiv im SG; 1: aktiv im SG; 2: wartet auf Kommunikation)" UBYTE OneToOne 1 100 0.00 255.0 FORMAT "%5.1" ECU_ADDRESS 0x7FDED5 /end MEASUREMENT
/begin MEASUREMENT BypInt_stEcu_u8 "Status interner Bypass in SG (0: inaktiv im SG; 1: aktiv im SG; 2: wartet auf Kommunikation)" UBYTE OneToOne 1 100 0.00 255.0 FORMAT "%5.1" ECU_ADDRESS 0x7FDEE1 /end MEASUREMENT
/begin MEASUREMENT B_acmsggts "Bed. Min. Zeit in der keine Bit gesendet wurde ist verstrichen + Ereignis aufgetreten" UBYTE B_TRUE 1 100 0.00 1.00000000000 BIT_MASK 0x1 FORMAT "%13.11" ECU_ADDRESS 0x7F87E2 /end MEASUREMENT
/begin MEASUREMENT B_cmsggts "Trigger Bit zum Senden der Botschaft" UBYTE B_TRUE 1 100 0.00 1.00000000000 BIT_MASK 0x1 FORMAT "%13.11" ECU_ADDRESS 0x7F87E7 /end MEASUREMENT
/begin MEASUREMENT B_ergacgt "Bedingung Ereignis (Änderung) bei Stufentempomat aufgetreten" UBYTE B_TRUE 1 100 0.00 1.00000000000 BIT_MASK 0x1 FORMAT "%13.11" ECU_ADDRESS 0x7F87E9 /end MEASUREMENT
/begin MEASUREMENT B_mrkvff "Bedingung Merker das B:_mrkv (Marker Veränderung) gesetzt war" UBYTE B_TRUE 1 100 0.00 1.00000000000 BIT_MASK 0x1 FORMAT "%13.11" ECU_ADDRESS 0x7F87FB /end MEASUREMENT
/begin MEASUREMENT CaSCD_ctAddTooth_mp "Anzahl der zusätzlichen Zähne im Nockenwellensignal" UBYTE OneToOne 1 100 0.00 255.0 FORMAT "%5.1" ECU_ADDRESS 0x8FD518 /end MEASUREMENT
/begin MEASUREMENT CaSCD_ctEdgCaSRev_mp "Anzahl sämtlicher Phasensignale während einer Nockenwellenumdrehung" UBYTE OneToOne 1 100 0.00 255.0 FORMAT "%5.1" ECU_ADDRESS 0x8FD519 /end MEASUREMENT
/begin MEASUREMENT CaSCD_ctEdgOfs_mp "Zähler erkannter Nockenwellenflanken mit Verdrehung" UBYTE OneToOne 1 100 0.00 255.0 FORMAT "%5.1" ECU_ADDRESS 0x8FD51A /end MEASUREMENT
/begin MEASUREMENT CaSCD_ctEdgOrd_mp "Zähler erkannter Nockenwellenflanken in korrekter Reihenfolge" UBYTE OneToOne 1 100 0.00 255.0 FORMAT "%5.1" ECU_ADDRESS 0x8FD51B /end MEASUREMENT
/begin MEASUREMENT CaSCD_ctErrEdg_mp "Anzahl erkannter Störungen auf einer Nockenwellenumdrehung" UBYTE OneToOne 1 100 0.00 255.0 FORMAT "%5.1" ECU_ADDRESS 0x8FD51C /end MEASUREMENT
/begin MEASUREMENT CaSCD_ctErrSegLen2Pos_mp "Anzahl der Flankenpositionen im Nockenwellensignal mit falscher zugeordneter Segmentlänge" UBYTE OneToOne 1 100 0.00 255.0 FORMAT "%5.1" ECU_ADDRESS 0x8FD51D /end MEASUREMENT
/begin MEASUREMENT CaSCD_ctMissTooth_mp "Anzahl der fehlenden Zähne im Nockenwellensignal" UBYTE OneToOne 1 100 0.00 255.0 FORMAT "%5.1" ECU_ADDRESS 0x8FD51E /end MEASUREMENT
/begin MEASUREMENT CaSCD_ctPhRevEdges_mp "Zähler der Phasengeberflanken über einer Phasengeberradumdrehung" UBYTE OneToOne 1 100 0.00 255.0 FORMAT "%5.1" ECU_ADDRESS 0x8FD51F /end MEASUREMENT
/begin MEASUREMENT CaSCD_ctPhRev_mp "Umdrehungszähler des Phasengeberrades" UBYTE OneToOne 1 100 0.00 255.0 FORMAT "%5.1" ECU_ADDRESS 0x8FD520 /end MEASUREMENT
/begin MEASUREMENT CaSCD_ctSegEdg_mp "Anzahl erkannter SEG Flanken" UBYTE OneToOne 1 100 0.00 255.0 FORMAT "%5.1" ECU_ADDRESS 0x8FD521 /end MEASUREMENT
/begin MEASUREMENT CaSCD_ctSegLenOrd_mp "Anzahl der Segmentlängen, die in Reihenfolge erkannt wurden" UBYTE OneToOne 1 100 0.00 255.0 FORMAT "%5.1" ECU_ADDRESS 0x8FD522 /end MEASUREMENT
/begin MEASUREMENT CaSCD_ctShftPos_mp "Zähler verschobene Nockenwellenflanken" UBYTE OneToOne 1 100 0.00 255.0 FORMAT "%5.1" ECU_ADDRESS 0x8FD523 /end MEASUREMENT
/begin MEASUREMENT CaSCD_ctSyncEdg_mp "Anzahl erkannter SYNC Flanken" UBYTE OneToOne 1 100 0.00 255.0 FORMAT "%5.1" ECU_ADDRESS 0x8FD524 /end MEASUREMENT
/begin MEASUREMENT CaSCD_nPeriod "Phasengeberraddrehzahl basierent auf einer konstanten Phasengebersegmentlänge" SWORD EngN 1 100 -32768.00 32767.00 FORMAT "%8.2" ECU_ADDRESS 0x7F8B72 /end MEASUREMENT
/begin MEASUREMENT CaSCD_nSeg "Die aktuelle Nockenwellensegmentdrehzahl im BackUp-Modus" SWORD EngN 1 100 -32768.00 32767.00 FORMAT "%8.2" ECU_ADDRESS 0x7F8B74 /end MEASUREMENT
/begin MEASUREMENT CaSCD_numFrstInt_mp "Interruptart bei Start der Verifikation CaS/CrS" UBYTE OneToOne 1 100 0.00 255.0 FORMAT "%5.1" ECU_ADDRESS 0x8FD525 /end MEASUREMENT
/begin MEASUREMENT CaSCD_numFrstTDC_mp "Zylinderzählerstand bei Start der Verifikation CaS/CrS" UBYTE OneToOne 1 100 0.00 255.0 FORMAT "%5.1" ECU_ADDRESS 0x8FD526 /end MEASUREMENT
/begin MEASUREMENT CaSCD_phiCurr_mp "Aktuelle Winkelposition des Phasengebers" SWORD AngleCrS 1 100 -768.0000 767.9766 FORMAT "%8.4" ECU_ADDRESS 0x8FD528 /end MEASUREMENT
/begin MEASUREMENT CaSCD_phiLstEdge_mp "Position der letzten Phasengeberflanke" SWORD AngleCrS 1 100 -768.0000 767.9766 FORMAT "%8.4" ECU_ADDRESS 0x8FD52A /end MEASUREMENT
/begin MEASUREMENT CaSCD_stPhaseErr_mp "Fehlerstatus des Phasensystems" UWORD OneToOne 1 100 0.00 65535.00 FORMAT "%8.2" ECU_ADDRESS 0x8FD52C /end MEASUREMENT
/begin MEASUREMENT CaSCD_stPhaseSig_mp "Status des Phasengebersignals (Signalgüte)" UWORD OneToOne 1 100 0.00 65535.00 FORMAT "%8.2" ECU_ADDRESS 0x8FD52E /end MEASUREMENT
/begin MEASUREMENT CaSCD_stPhaseSync_mp "Status der Phasengebersynchronisation (Signalformerkennung)" UWORD OneToOne 1 100 0.00 65535.00 FORMAT "%8.2" ECU_ADDRESS 0x8FD530 /end MEASUREMENT
/begin MEASUREMENT CaSCD_stSegCylEdg_mp "Status erkannter SEG Flanken" UWORD OneToOne 1 100 0.00 65535.00 FORMAT "%8.2" ECU_ADDRESS 0x8FD532 /end MEASUREMENT
/begin MEASUREMENT CaSCD_stSyncCylEdg_mp "Status erkannter SYNC Flanken" UWORD OneToOne 1 100 0.00 65535.00 FORMAT "%8.2" ECU_ADDRESS 0x8FD534 /end MEASUREMENT
/begin MEASUREMENT CaSCD_tiPeriodRev "Periodendauer einer Umdrehung des Phasengeberrades" SWORD Period_ms 1 100 -3276.800 3276.700 FORMAT "%8.3" ECU_ADDRESS 0x7F8B76 /end MEASUREMENT
/begin MEASUREMENT CaSCD_tiPeriodRevHold "Vorletzte Periodendauer einer Umdrehung des Phasengeberrades" SWORD Period_ms 1 100 -3276.800 3276.700 FORMAT "%8.3" ECU_ADDRESS 0x7F8B78 /end MEASUREMENT
/begin MEASUREMENT CaSCD_tiSeg "aktuelle Segmentzeit der Nockenwelle im Backup Mode" ULONG Per_Dur 1 100 0.00 4294967295.00 FORMAT "%13.2" ECU_ADDRESS 0x7F933C /end MEASUREMENT
/begin MEASUREMENT CaSCD_tiSigTimOut_mp "Timeoutwert des Phasengebersignals" SWORD Period_ms 1 100 -3276.800 3276.700 FORMAT "%8.3" ECU_ADDRESS 0x8FD536 /end MEASUREMENT
/begin MEASUREMENT CBACD_stLogicOut_mp "duty-cycle given to the actuator" UBYTE OneToOne 1 100 0.00 255.0 FORMAT "%5.1" ECU_ADDRESS 0x6F800C /end MEASUREMENT
/begin MEASUREMENT Clg_dtDynTst "Ansteig der Wassertemperatur seit start" SWORD TempDiff_Cels 1 100 -3276.800 3276.700 FORMAT "%8.3" ECU_ADDRESS 0x7F8B7A /end MEASUREMENT
/begin MEASUREMENT Clg_dtMinDynTst "Kopie von Clg_dtMinDynTst_C fuer Tester" SWORD TempDiff_Cels 1 100 -3276.800 3276.700 FORMAT "%8.3" ECU_ADDRESS 0x7F8B7C /end MEASUREMENT
/begin MEASUREMENT Clg_tClntStrtVal_mp "Wassertemperatur zu Beginn des dynamischen Plausibilitätstests" SWORD Temp_Cels 1 100 -50.140 899.860 FORMAT "%8.3" ECU_ADDRESS 0x8FD538 /end MEASUREMENT
/begin MEASUREMENT Clg_tEndDynTst "CTSCD_tClnt am Ende des Tests" SWORD Temp_Cels 1 100 -50.140 899.860 FORMAT "%8.3" ECU_ADDRESS 0x7F8B7E /end MEASUREMENT
/begin MEASUREMENT Clg_tiDynTst "Abgelaufene Zeit, seit der der dynamische plausibilitätstest aktiv ist" ULONG Time_s 1 100 0.00 42949672.9500 FORMAT "%13.4" ECU_ADDRESS 0x7F9340 /end MEASUREMENT
/begin MEASUREMENT Clg_tiMaxDynTst "Maximal zulässige Testzeit des dynamischen Plausibilitätstest" UWORD Time_s 1 100 0.00 655.3500 FORMAT "%8.4" ECU_ADDRESS 0x7F8B82 /end MEASUREMENT
/begin MEASUREMENT Clg_tMinClntDynTst "Kopie von Clg_tMinClntDynTst_C fuer Tester" SWORD Temp_Cels 1 100 -50.140 899.860 FORMAT "%8.3" ECU_ADDRESS 0x7F8B80 /end MEASUREMENT
/begin MEASUREMENT CmbChb_ctEngRevLogBuf1_mp "Meßpunkt für die Anzahl bewerteten Motorumdrehungen der Kurbelwelle des Puffer1" UWORD OneToOne 1 100 0.00 65535.00 FORMAT "%8.2" ECU_ADDRESS 0x8FD570 /end MEASUREMENT
/begin MEASUREMENT CmbChb_ctEngRevLogBuf2_mp "Meßpunkt für die Anzahl bewerteten Motorumdrehungen der Kurbelwelle des Puffer2" UWORD OneToOne 1 100 0.00 65535.00 FORMAT "%8.2" ECU_ADDRESS 0x8FD572 /end MEASUREMENT
/begin MEASUREMENT CmbChb_ctEngRevLogMem_mp "Kurbelwellen-Umdrehungszähler" UWORD OneToOne 1 100 0.00 65535.00 FORMAT "%8.2" ECU_ADDRESS 0x8FD574 /end MEASUREMENT
/begin MEASUREMENT CmbChb_ctEngRevPerBlk_mp "Meßpunkt für die Anzahl der Blockgroesse für die bewerteten Motorumdrehungen der Kurbelwelle" UWORD OneToOne 1 100 0.00 65535.00 FORMAT "%8.2" ECU_ADDRESS 0x8FD576 /end MEASUREMENT
/begin MEASUREMENT CmbChb_ctMifBuf1_mp "Meßpunkt für die Erkennung der Fehlzündungen der einzelnen Zylinder, Puffer1" UWORD OneToOne 1 100 0.00 65535.00 FORMAT "%8.2" ARRAY_SIZE 9 ECU_ADDRESS 0x8FD53A /end MEASUREMENT
/begin MEASUREMENT CmbChb_ctMifBuf2_mp "Meßpunkt für die Erkennung der Fehlzündungen der einzelnen Zylinder, Puffer2" UWORD OneToOne 1 100 0.00 65535.00 FORMAT "%8.2" ARRAY_SIZE 9 ECU_ADDRESS 0x8FD54C /end MEASUREMENT
/begin MEASUREMENT CmbChb_ctMifMem_mp "Meßpunkt für die Erkennung der Fehlzündungen der einzelnen Zylinder, Logging Speicher" UWORD OneToOne 1 100 0.00 65535.00 FORMAT "%8.2" ARRAY_SIZE 9 ECU_ADDRESS 0x8FD55E /end MEASUREMENT
/begin MEASUREMENT CmbChb_dnSegMinPerCyl_mp "minimaler Drehzahlanstiege pro Zylinder" SWORD EngN 1 100 -32768.00 32767.00 FORMAT "%8.2" ECU_ADDRESS 0x8FD578 /end MEASUREMENT
/begin MEASUREMENT CmbChb_facAPSCor_mp "Meßpunkt für atmosphärendruckabhängigen Korrekturwert" SWORD Fact 1 100 -4.000000 3.999878 FORMAT "%8.6" ECU_ADDRESS 0x8FD57E /end MEASUREMENT
/begin MEASUREMENT CmbChb_facEnvCor "gesamter Korrekturfaktor" SWORD Fact 1 100 -4.000000 3.999878 FORMAT "%8.6" ECU_ADDRESS 0x7F8B84 /end MEASUREMENT
/begin MEASUREMENT CmbChb_facIATSCor_mp "Meßpunkt für lufttemperaturabhängigen Korrekturwert" SWORD Fact 1 100 -4.000000 3.999878 FORMAT "%8.6" ECU_ADDRESS 0x8FD580 /end MEASUREMENT
/begin MEASUREMENT CmbChb_nSegEven_mp "Summe der Drehzahl fuer jede gerade Segmentnummer (von zwei Umdrehungen)" SWORD EngN 1 100 -32768.00 32767.00 FORMAT "%8.2" ECU_ADDRESS 0x8FD57A /end MEASUREMENT
/begin MEASUREMENT CmbChb_nSegOdd_mp "Summe der Drehzahl fuer jede ungerade Segmentnummer (von zwei Umdrehungen)" SWORD EngN 1 100 -32768.00 32767.00 FORMAT "%8.2" ECU_ADDRESS 0x8FD57C /end MEASUREMENT
/begin MEASUREMENT CmbChb_rEnvCor "Korrekurwert in Abhängigkeit von Zeit, Lufttemperatur und -druck" SWORD Prc 1 100 -400.0000 399.9878 FORMAT "%8.4" ECU_ADDRESS 0x7F8B88 /end MEASUREMENT
/begin MEASUREMENT CmbChb_rIniTiUp_mp "Eingangswert für die inverse Berechnung der Kennlinie für Timerkorrekturwert bei ansteigender Rampe" SWORD Prc 1 100 -400.0000 399.9878 FORMAT "%8.4" ECU_ADDRESS 0x8FD582 /end MEASUREMENT
/begin MEASUREMENT CmbChb_rTempCor "Korrekturwert für ausgekühlten Brennraum" SWORD Prc 1 100 -400.0000 399.9878 FORMAT "%8.4" ECU_ADDRESS 0x7F8B8A /end MEASUREMENT
/begin MEASUREMENT CmbChb_rTiUpCor_mp "Meßpunkt für timerabhängigen Korrekturwert bei ansteigender Rampe" SWORD Prc 1 100 -400.0000 399.9878 FORMAT "%8.4" ECU_ADDRESS 0x8FD584 /end MEASUREMENT
/begin MEASUREMENT CmbChb_st "Status der Fehlzündungserkennung" UBYTE OneToOne 1 100 0.00 255.0 FORMAT "%5.1" ECU_ADDRESS 0x7F880C /end MEASUREMENT
/begin MEASUREMENT CmbChb_stTempCor "Statusvariable für Zustandsraumdiagramm" UBYTE OneToOne 1 100 0.00 255.0 FORMAT "%5.1" ECU_ADDRESS 0x7F880D /end MEASUREMENT
/begin MEASUREMENT CmbChb_swtMonClutch "SW-Schalter Aktivierung/Deaktivierung Überwachung Zündaussetzererkennung" UBYTE OneToOne 1 100 0.00 3.000 FORMAT "%5.3" ECU_ADDRESS 0x7F880E /end MEASUREMENT
/begin MEASUREMENT CmbChb_tiDwn_mp "Timer für fallende Rampe bei Schub" SWORD TimeRed 1 100 -5242.880 5242.720 FORMAT "%8.3" ECU_ADDRESS 0x8FD586 /end MEASUREMENT
/begin MEASUREMENT CmbChb_tiUp_mp "Timer für ansteigende Rampe bei Schub" SWORD TimeRed 1 100 -5242.880 5242.720 FORMAT "%8.3" ECU_ADDRESS 0x8FD588 /end MEASUREMENT
/begin MEASUREMENT CoDT_dnAbsEng_mp "Absolute value of DT1 filtered engine speed" SWORD dn_dZfine 1 100 -32768.00 32767.00 FORMAT "%8.2" ECU_ADDRESS 0x8FD59C /end MEASUREMENT
/begin MEASUREMENT CoDT_dnEng_mp "DT1 filtered Engine speed" SWORD dn_dZfine 1 100 -32768.00 32767.00 FORMAT "%8.2" ECU_ADDRESS 0x8FD59E /end MEASUREMENT
/begin MEASUREMENT CoDT_dnGrip_mp "Expected change in torque" SWORD dn_dZfine 1 100 -32768.00 32767.00 FORMAT "%8.2" ECU_ADDRESS 0x8FD5A0 /end MEASUREMENT
/begin MEASUREMENT CoDT_dnNoGrip_mp "Expected change in engine speed" SWORD dn_dZfine 1 100 -32768.00 32767.00 FORMAT "%8.2" ECU_ADDRESS 0x8FD5A2 /end MEASUREMENT
/begin MEASUREMENT CoDT_dtrqDes_mp "torque difference between Master a. Slave" SWORD dTrq 1 100 -3276.800 3276.700 FORMAT "%8.3" ECU_ADDRESS 0x8FD590 /end MEASUREMENT
/begin MEASUREMENT CoDT_dtrqLead_mp "torque difference between Master a. Slave" SWORD dTrq 1 100 -3276.800 3276.700 FORMAT "%8.3" ECU_ADDRESS 0x8FD592 /end MEASUREMENT
/begin MEASUREMENT CoDT_Grip "Kraftschluß innerhalb Antrieb" UBYTE OneToOne 1 100 0.00 255.0 FORMAT "%5.1" ECU_ADDRESS 0x7F880F /end MEASUREMENT
/begin MEASUREMENT CoDT_nMax "Drehzahlforderung Maximalwert Triebstrangkoordinator" SWORD EngN 1 100 -32768.00 32767.00 FORMAT "%8.2" ECU_ADDRESS 0x7F8B8C /end MEASUREMENT
/begin MEASUREMENT CoDT_nMin "Drehzahlforderung Minimalwert Triebstrangkoordinator" SWORD EngN 1 100 -32768.00 32767.00 FORMAT "%8.2" ECU_ADDRESS 0x7F8B8E /end MEASUREMENT
/begin MEASUREMENT CoDT_stGripDeb "Zustand der Kraftschlußentprellung" UBYTE OneToOne 1 100 0.00 255.0 FORMAT "%5.1" ECU_ADDRESS 0x7F8810 /end MEASUREMENT
/begin MEASUREMENT CoDT_stNoGripDet_mp "Bit coded status message" UBYTE OneToOne 1 100 0.00 255.0 FORMAT "%5.1" ECU_ADDRESS 0x8FD5A4 /end MEASUREMENT
/begin MEASUREMENT CoDT_stOrd "Randbedingungen für physikalischen Auftrag" UBYTE OneToOne 1 100 0.00 255.0 FORMAT "%5.1" ECU_ADDRESS 0x7F8811 /end MEASUREMENT
/begin MEASUREMENT CoDT_swtCoType "0: conventional; 1: mastershift" UBYTE OneToOne 1 100 0.00 255.0 FORMAT "%5.1" ECU_ADDRESS 0x7F8812 /end MEASUREMENT
/begin MEASUREMENT CoDT_trq "aktuelles Getriebeausgangsmoment" SWORD TrqPrp 1 100 -6553.600 6553.400 FORMAT "%8.3" ECU_ADDRESS 0x7F8B90 /end MEASUREMENT
/begin MEASUREMENT CoDT_trqAbsGbxPT1_mp "Absolute value of delayed gearbox torque input" SWORD Trq 1 100 -3276.800 3276.700 FORMAT "%8.3" ECU_ADDRESS 0x8FD5A6 /end MEASUREMENT
/begin MEASUREMENT CoDT_trqAcsDes "torque electrical components" SWORD Trq 1 100 -3276.800 3276.700 FORMAT "%8.3" ECU_ADDRESS 0x7F8B92 /end MEASUREMENT
/begin MEASUREMENT CoDT_trqAcsMax_mp "maximales Nebenaggregatmoment" SWORD Trq 1 100 -3276.800 3276.700 FORMAT "%8.3" ECU_ADDRESS 0x8FD5AC /end MEASUREMENT
/begin MEASUREMENT CoDT_trqAcsMin "minimaler Momentenbedarf der Nebenaggregate" SWORD Trq 1 100 -3276.800 3276.700 FORMAT "%8.3" ECU_ADDRESS 0x7F8B94 /end MEASUREMENT
/begin MEASUREMENT CoDT_trqAcs_mp "ungefilterter Momentenbedarf der Nebenaggregate" SWORD Trq 1 100 -3276.800 3276.700 FORMAT "%8.3" ECU_ADDRESS 0x8FD5AE /end MEASUREMENT
/begin MEASUREMENT CoDT_trqActAcs_mp "aktuelle Momentenanforderung der Nebenaggregate" SWORD Trq 1 100 -3276.800 3276.700 FORMAT "%8.3" ECU_ADDRESS 0x8FD5AA /end MEASUREMENT
/begin MEASUREMENT CoDT_trqCurr "Momentenanforderung Triebstrang Vorhaltewert" SWORD Trq 1 100 -3276.800 3276.700 FORMAT "%8.3" ECU_ADDRESS 0x7F8B96 /end MEASUREMENT
/begin MEASUREMENT CoDT_trqCurrLim "Minimum aller Begrenzungen im Getriebeausgangsmoment" SWORD TrqPrp 1 100 -6553.600 6553.400 FORMAT "%8.3" ECU_ADDRESS 0x7F8B98 /end MEASUREMENT
/begin MEASUREMENT CoDT_trqDes "Momentenanforderung Triebstrangkoordinator Wunschwert" SWORD Trq 1 100 -3276.800 3276.700 FORMAT "%8.3" ECU_ADDRESS 0x7F8BA0 /end MEASUREMENT
/begin MEASUREMENT CoDT_trqDesDiff_mp "Differenz Momentanforderung zwischen Master und Slave" SWORD Trq 1 100 -3276.800 3276.700 FORMAT "%8.3" ECU_ADDRESS 0x8FD594 /end MEASUREMENT
/begin MEASUREMENT CoDT_trqDiffMaxDes_mp "DT1 filter" SWORD Trq 1 100 -3276.800 3276.700 FORMAT "%8.3" ECU_ADDRESS 0x8FD596 /end MEASUREMENT
/begin MEASUREMENT CoDT_trqDiffMaxLead_mp "torque difference between Master a. Slave" SWORD Trq 1 100 -3276.800 3276.700 FORMAT "%8.3" ECU_ADDRESS 0x8FD598 /end MEASUREMENT
/begin MEASUREMENT CoDT_trqDTInCurr "Momentenanforderung Vorhalt Triebstrangkoordinator (Kupplungseingang) (curr-Pfad)" SWORD Trq 1 100 -3276.800 3276.700 FORMAT "%8.3" ECU_ADDRESS 0x7F8B9A /end MEASUREMENT
/begin MEASUREMENT CoDT_trqDTInDecLead_mp "Momentenanforderung Triebstrang nach reduzierenden Getriebeeingriffen" SWORD Trq 1 100 -3276.800 3276.700 FORMAT "%8.3" ECU_ADDRESS 0x8FD58A /end MEASUREMENT
/begin MEASUREMENT CoDT_trqDTInDes "Momentenanforderung Triebstrang (Kupplungseingang) Wunschwert" SWORD Trq 1 100 -3276.800 3276.700 FORMAT "%8.3" ECU_ADDRESS 0x7F8B9C /end MEASUREMENT
/begin MEASUREMENT CoDT_trqDTInIncLead_mp "Momentenanforderung Triebstrang nach erhöhenden Getriebeeingriffen" SWORD Trq 1 100 -3276.800 3276.700 FORMAT "%8.3" ECU_ADDRESS 0x8FD58C /end MEASUREMENT
/begin MEASUREMENT CoDT_trqDTInLead "Momentenanforderung Triebstrang (Kupplungseingang) Vorhaltewert" SWORD Trq 1 100 -3276.800 3276.700 FORMAT "%8.3" ECU_ADDRESS 0x7F8B9E /end MEASUREMENT
/begin MEASUREMENT CoDT_trqGbx "aktuelles Eingangsmoment Getriebe" SWORD Trq 1 100 -3276.800 3276.700 FORMAT "%8.3" ECU_ADDRESS 0x7F8BA2 /end MEASUREMENT
/begin MEASUREMENT CoDT_trqGbxMax "maximales Getriebeeingangsmoment" SWORD Trq 1 100 -3276.800 3276.700 FORMAT "%8.3" ECU_ADDRESS 0x7F8BA4 /end MEASUREMENT
/begin MEASUREMENT CoDT_trqGbxMin "minimales Getriebeeingangsmoment" SWORD Trq 1 100 -3276.800 3276.700 FORMAT "%8.3" ECU_ADDRESS 0x7F8BA6 /end MEASUREMENT
/begin MEASUREMENT CoDT_trqGbxPT1_mp "Delayed gearbox torque input" SWORD Trq 1 100 -3276.800 3276.700 FORMAT "%8.3" ECU_ADDRESS 0x8FD5A8 /end MEASUREMENT
/begin MEASUREMENT CoDT_trqGearbxDes "Getriebeeingangsmoment Fahrerwunsch" SWORD Trq 1 100 -3276.800 3276.700 FORMAT "%8.3" ECU_ADDRESS 0x7F8BA8 /end MEASUREMENT
/begin MEASUREMENT CoDT_trqGearbxLead_mp "Getriebeeingangsmoment Vorhaltewert" SWORD Trq 1 100 -3276.800 3276.700 FORMAT "%8.3" ECU_ADDRESS 0x8FD58E /end MEASUREMENT
/begin MEASUREMENT CoDT_trqLead "Momentenanforderung Vorhaltewert" SWORD Trq 1 100 -3276.800 3276.700 FORMAT "%8.3" ECU_ADDRESS 0x7F8BAA /end MEASUREMENT
/begin MEASUREMENT CoDT_trqLeadDiff_mp "Differenz Vorhaltemoment zwischen Master und Slave" SWORD Trq 1 100 -3276.800 3276.700 FORMAT "%8.3" ECU_ADDRESS 0x8FD59A /end MEASUREMENT
/begin MEASUREMENT CoDT_trqMax "maximal mögliches Antriebsmoment (Getriebeausgang)" SWORD TrqPrp 1 100 -6553.600 6553.400 FORMAT "%8.3" ECU_ADDRESS 0x7F8BAC /end MEASUREMENT
/begin MEASUREMENT CoDT_trqMin "minimal mögliches Antriebsmoment (Getriebeausgang)" SWORD TrqPrp 1 100 -6553.600 6553.400 FORMAT "%8.3" ECU_ADDRESS 0x7F8BAE /end MEASUREMENT
/begin MEASUREMENT CoEng_CoordPrioFld_mp "Messpunktarray zur Darstellung der dynamische Priorität" UWORD OneToOne 1 100 0.00 65535.00 FORMAT "%8.2" ARRAY_SIZE 3 ECU_ADDRESS 0x8FD5C0 /end MEASUREMENT
/begin MEASUREMENT CoEng_ctUnpla "Zähler für Überwachungsebene 1 und 2 Unplausibilität" UBYTE OneToOne 1 100 0.00 255.0 FORMAT "%5.1" ECU_ADDRESS 0x7F8813 /end MEASUREMENT
/begin MEASUREMENT CoEng_dnEngnAvrg_mp "Meßpunkt für Overfueling Drehzahlgradienten" SWORD dn_dZ20 1 100 -327680.0 327670.0 FORMAT "%8.1" ECU_ADDRESS 0x8FD5F4 /end MEASUREMENT
/begin MEASUREMENT CoEng_dvolFlConsum "Kraftstoffverbrauch" SWORD FlConsum_l_h 1 100 -327.6800 327.6700 FORMAT "%8.4" ECU_ADDRESS 0x7F8BB0 /end MEASUREMENT
/begin MEASUREMENT CoEng_dVolFlt_mp "Gefilterter Volumenstrom für Berechnung" SWORD CubMtrPerHr 1 100 -3276.800 3276.700 FORMAT "%8.3" ECU_ADDRESS 0x8FD5F6 /end MEASUREMENT
/begin MEASUREMENT CoEng_dvolPerStroke_mp "Kraftstoffverbrauch" SWORD InjQnt 1 100 -3276.800 3276.700 FORMAT "%8.3" ECU_ADDRESS 0x8FD5B2 /end MEASUREMENT
/begin MEASUREMENT CoEng_facAdj "EEPROM Abgleichwert zur Korrektur des Begrenzungsmomentes" SWORD Fact 1 100 -4.000000 3.999878 FORMAT "%8.6" ECU_ADDRESS 0x7F8BB2 /end MEASUREMENT
/begin MEASUREMENT CoEng_facFlConsumAdj_mp "Abgleichwert - Krafstoffverbrauchsabgleich" SWORD Fact 1 100 -4.000000 3.999878 FORMAT "%8.6" ECU_ADDRESS 0x8FD5B4 /end MEASUREMENT
/begin MEASUREMENT CoEng_nMax "Drehzahlintervall Maximum" SWORD EngN 1 100 -32768.00 32767.00 FORMAT "%8.2" ECU_ADDRESS 0x7F8BB4 /end MEASUREMENT
/begin MEASUREMENT CoEng_nMin "Drehzahlintervall Minimum" SWORD EngN 1 100 -32768.00 32767.00 FORMAT "%8.2" ECU_ADDRESS 0x7F8BB6 /end MEASUREMENT
/begin MEASUREMENT CoEng_numShOffTstNewSel "ausgewählter Abstelltest des gegenwaertigen Fahrzyklus" UBYTE OneToOne 1 100 0.00 255.0 FORMAT "%5.1" ECU_ADDRESS 0x7F8814 /end MEASUREMENT
/begin MEASUREMENT CoEng_pDiffPFltPrdc2_mp "Vorhergesagter Differenzdruck über Partikelfilter oder OxiCat" SWORD Pres_hPa 1 100 -32768.00 32767.00 FORMAT "%8.2" ECU_ADDRESS 0x8FD5F8 /end MEASUREMENT
/begin MEASUREMENT CoEng_pDiffPFltPrdc_mp "Vorhergesagter Differenzdruck über Partikelfilter" SWORD Pres_hPa 1 100 -32768.00 32767.00 FORMAT "%8.2" ECU_ADDRESS 0x8FD5FA /end MEASUREMENT
/begin MEASUREMENT CoEng_pRailT15Off "Raildruck bei Klemme 15 aus" SWORD Pres_Rail 1 100 -3276.800 3276.700 FORMAT "%5.3" ECU_ADDRESS 0x7F8BB8 /end MEASUREMENT
/begin MEASUREMENT CoEng_qSubs_mp "Ersatzeinspritzmenge für KVA Berechnung" SWORD InjMassCyc 1 100 -327.6800 327.6700 FORMAT "%8.4" ECU_ADDRESS 0x8FD5B6 /end MEASUREMENT
/begin MEASUREMENT CoEng_qSum_mp "tatsächlicher Kraftstoffverbrauch" SWORD InjMassCyc 1 100 -327.6800 327.6700 FORMAT "%8.4" ECU_ADDRESS 0x8FD5B8 /end MEASUREMENT
/begin MEASUREMENT CoEng_resFlowFlt_mp "Gefilterter Strömungswiderstand für Berechnung" SWORD Res_hPaHrPerCM 1 100 -32.76800 32.76700 FORMAT "%8.5" ECU_ADDRESS 0x8FD5FC /end MEASUREMENT
/begin MEASUREMENT CoEng_rTrq "Verhältnis aktuelles Moment zu Maximalmoment" SWORD Prc 1 100 -400.0000 399.9878 FORMAT "%8.4" ECU_ADDRESS 0x7F8BBA /end MEASUREMENT
/begin MEASUREMENT CoEng_stAftRun "nachlauf-interner Nachlauf-Zustand" UBYTE OneToOne 1 100 0.00 255.0 FORMAT "%5.1" ECU_ADDRESS 0x7F8815 /end MEASUREMENT
/begin MEASUREMENT CoEng_stAftRunPath "Abschaltpfade aufgrund Motorzustand Nachlauf" ULONG OneToOne 1 100 0.00 4294967295.00 FORMAT "%13.2" ECU_ADDRESS 0x7F9344 /end MEASUREMENT
/begin MEASUREMENT CoEng_stCoordFuncFld_mp "Messpunktarray zur Statusanzeige Schubkoordinator" UWORD OneToOne 1 100 0.00 65535.00 FORMAT "%8.2" ARRAY_SIZE 3 ECU_ADDRESS 0x8FD5C6 /end MEASUREMENT
/begin MEASUREMENT CoEng_stCoordFuncPref_mp "Status Zustand Koordinator" UBYTE OneToOne 1 100 0.00 255.0 FORMAT "%5.1" ECU_ADDRESS 0x8FD5CC /end MEASUREMENT
/begin MEASUREMENT CoEng_stCurrLim "Statuswort zur Markierung der niedrigsten Begrenzungsmomente" ULONG OneToOne 1 100 0.00 4294967295.00 FORMAT "%13.2" ECU_ADDRESS 0x7F9348 /end MEASUREMENT
/begin MEASUREMENT CoEng_stCurrLimActive "Statusword zur Markierung der wirksamen niedrigsten Begrenzungsmomente" ULONG OneToOne 1 100 0.00 4294967295.00 FORMAT "%13.2" ECU_ADDRESS 0x7F934C /end MEASUREMENT
/begin MEASUREMENT CoEng_stDisable "Status Schubabschaltung: 1: abgeschalten; 0: nicht abgeschalten" UBYTE OneToOne 1 100 0.00 255.0 FORMAT "%5.1" ECU_ADDRESS 0x7F8816 /end MEASUREMENT
/begin MEASUREMENT CoEng_stDlyT15_mp "Status Variable für Verzögerungszeti nach Klemme 15 ein" UBYTE OneToOne 1 100 0.00 255.0 FORMAT "%5.1" ECU_ADDRESS 0x8FD5CE /end MEASUREMENT
/begin MEASUREMENT CoEng_stEEPStore_mp "Speicherstatus für EEPROM während Nachlauf" UBYTE OneToOne 1 100 0.00 255.0 FORMAT "%5.1" ECU_ADDRESS 0x8FD5B0 /end MEASUREMENT
/begin MEASUREMENT CoEng_stEng "aktueller Motorzustand" UBYTE OneToOne 1 100 0.00 255.0 FORMAT "%5.1" ECU_ADDRESS 0x7F8817 /end MEASUREMENT
/begin MEASUREMENT CoEng_stEngOld "Motorstatus vor aktuellem Status" UBYTE OneToOne 1 100 0.00 255.0 FORMAT "%5.1" ECU_ADDRESS 0x7F8818 /end MEASUREMENT
/begin MEASUREMENT CoEng_stExtWait "Zustand ""warten auf externe Ereignisse vor Schreiben des EEPROM""" UBYTE OneToOne 1 100 0.00 255.0 FORMAT "%5.1" ECU_ADDRESS 0x7F8819 /end MEASUREMENT
/begin MEASUREMENT CoEng_stExtWait2 "Zustand ""Warten auf externe Ereignisse vor Öffnen des Hauptrelais""" UBYTE OneToOne 1 100 0.00 255.0 FORMAT "%5.1" ECU_ADDRESS 0x7F881A /end MEASUREMENT
/begin MEASUREMENT CoEng_stIRevShutOff "irreversible Abschaltursachen (nach Maskierung)" ULONG OneToOne 1 100 0.00 4294967295.00 FORMAT "%13.2" ECU_ADDRESS 0x7F9350 /end MEASUREMENT
/begin MEASUREMENT CoEng_stLayer12 "Indikator für Ebene 1 und 2 Unplausibilität" UBYTE OneToOne 1 100 0.00 255.0 FORMAT "%5.1" ECU_ADDRESS 0x7F881B /end MEASUREMENT
/begin MEASUREMENT CoEng_stMonActrPrt "Zustand der Steuerung Stellerschutz" UBYTE OneToOne 1 100 0.00 255.0 FORMAT "%5.1" ECU_ADDRESS 0x7F881C /end MEASUREMENT
/begin MEASUREMENT CoEng_stMonShOff "aktueller Zustand der Abstellsteuerung im Nachlauf" UBYTE OneToOne 1 100 0.00 255.0 FORMAT "%5.1" ECU_ADDRESS 0x7F881D /end MEASUREMENT
/begin MEASUREMENT CoEng_stnAvrgZero_mp "Entprellte Motordrehzahl für den Zustandsübergang im Nachlauf" UBYTE OneToOne 1 100 0.00 255.0 FORMAT "%5.1" ECU_ADDRESS 0x8FD5B1 /end MEASUREMENT
/begin MEASUREMENT CoEng_stOvrFul "" UBYTE OneToOne 1 100 0.00 255.0 FORMAT "%5.1" ECU_ADDRESS 0x7F881E /end MEASUREMENT
/begin MEASUREMENT CoEng_stOvrRun "Zustand Schuberkennung (0: kein Schub, 1: Schub)" UBYTE OneToOne 1 100 0.00 255.0 FORMAT "%5.1" ECU_ADDRESS 0x7F881F /end MEASUREMENT
/begin MEASUREMENT CoEng_stOvrRunCoord "Status Schuberkennung des Schubkoordinators (0: kein Schub; 1: Schub)" UBYTE OneToOne 1 100 0.00 255.0 FORMAT "%5.1" ECU_ADDRESS 0x7F8820 /end MEASUREMENT
/begin MEASUREMENT CoEng_stOvrRunEGT_mp "Status Regenerationsanforderung Abgasnachbehandlung im Sinne des Schubkoordinators, 1:keine Freigabe für Funktionen" UBYTE OneToOne 1 100 0.00 255.0 FORMAT "%5.1" ECU_ADDRESS 0x8FD5CD /end MEASUREMENT
/begin MEASUREMENT CoEng_stPwrDwn "Status des Diagnose Modus Power-down" UBYTE OneToOne 1 100 0.00 255.0 FORMAT "%5.1" ECU_ADDRESS 0x7F8821 /end MEASUREMENT
/begin MEASUREMENT CoEng_stPwrStgEnaCond "Steuergerätestatus, der für die Abschaltung der Endstufe/Endstufenfehlerdiagnose relevant ist" UBYTE OneToOne 1 100 0.00 255.0 FORMAT "%5.1" ECU_ADDRESS 0x7F8822 /end MEASUREMENT
/begin MEASUREMENT CoEng_stRevShutOff "reversible Abschaltursachen (nach Maskierung)" ULONG OneToOne 1 100 0.00 4294967295.00 FORMAT "%13.2" ECU_ADDRESS 0x7F9354 /end MEASUREMENT
/begin MEASUREMENT CoEng_stRmp_mp "Status: Rampe der Schubabschaltung, 0: inaktiv, 1: aktiv" UBYTE OneToOne 1 100 0.00 255.0 FORMAT "%5.1" ECU_ADDRESS 0x8FD5D6 /end MEASUREMENT
/begin MEASUREMENT CoEng_stShOffAddReqIRev "Kundenspezifische irreversible Abschaltanforderung" UBYTE OneToOne 1 100 0.00 255.0 FORMAT "%5.1" ECU_ADDRESS 0x7F8823 /end MEASUREMENT
/begin MEASUREMENT CoEng_stShOffAddReqRev "Kundenspezifische reversible Abschaltanforderung" UBYTE OneToOne 1 100 0.00 255.0 FORMAT "%5.1" ECU_ADDRESS 0x7F8824 /end MEASUREMENT
/begin MEASUREMENT CoEng_stShOffTst "Status des Abstelltest" UBYTE OneToOne 1 100 0.00 255.0 FORMAT "%5.1" ECU_ADDRESS 0x7F8825 /end MEASUREMENT
/begin MEASUREMENT CoEng_stShOffTstOldRes_mp "Testergebnis des letzten Fahrzyklus" UBYTE OneToOne 1 100 0.00 255.0 FORMAT "%5.1" ECU_ADDRESS 0x8FD5CF /end MEASUREMENT
/begin MEASUREMENT CoEng_stShutOff "Typ der wirksamen Abschaltursache (0: Nachlauf; 1: reversibel; 2: irreversibel)" UBYTE OneToOne 1 100 0.00 255.0 FORMAT "%5.1" ECU_ADDRESS 0x7F8826 /end MEASUREMENT
/begin MEASUREMENT CoEng_stShutOffPath "aktive Abstellpfade resultierend aus aktiven reversiblen, irreversiblen und Nachlauf-Abstellpfaden" ULONG OneToOne 1 100 0.00 4294967295.00 FORMAT "%13.2" ECU_ADDRESS 0x7F9358 /end MEASUREMENT
/begin MEASUREMENT CoEng_stTrqLimErr "Status Begrenzungsmoment im Systemfehlerfall. Bit0: Begrenzung aktiv; Bit1: Rampe von/zu Begrenzungswert aktiv" UBYTE OneToOne 1 100 0.00 255.0 FORMAT "%5.1" ECU_ADDRESS 0x7F8827 /end MEASUREMENT
/begin MEASUREMENT CoEng_stTrqLimErr1 "Begrenzungsmoment im Fehlerfall" UBYTE OneToOne 1 100 0.00 255.0 FORMAT "%5.1" ECU_ADDRESS 0x7F8828 /end MEASUREMENT
/begin MEASUREMENT CoEng_stTrqLimErr2 "Begrenzungsmoment im Fehlerfall 2" UBYTE OneToOne 1 100 0.00 255.0 FORMAT "%5.1" ECU_ADDRESS 0x7F8829 /end MEASUREMENT
/begin MEASUREMENT CoEng_stTrqLimErr3 "Begrenzungsmoment im Fehlerfall" UBYTE OneToOne 1 100 0.00 255.0 FORMAT "%5.1" ECU_ADDRESS 0x7F882A /end MEASUREMENT
/begin MEASUREMENT CoEng_stTrqLimErr4 "Begrenzungsmoment im Fehlerfall" UBYTE OneToOne 1 100 0.00 255.0 FORMAT "%5.1" ECU_ADDRESS 0x7F882B /end MEASUREMENT
/begin MEASUREMENT CoEng_stTrqLimPFltErr "Status der Momentenbegrenzung bei pflt-Fehlern" UBYTE OneToOne 1 100 0.00 255.0 FORMAT "%5.1" ECU_ADDRESS 0x7F882C /end MEASUREMENT
/begin MEASUREMENT CoEng_stTrqLimPFltOvldErr "Statusmessage f. Ersatzmoment bei Systemfehler_Partikelfilter überladen" UBYTE OneToOne 1 100 0.00 255.0 FORMAT "%5.1" ECU_ADDRESS 0x7F882D /end MEASUREMENT
/begin MEASUREMENT CoEng_stTst "Zustand des Motortestkoordinators (= aktiver Testmodus)" UBYTE OneToOne 1 100 0.00 255.0 FORMAT "%5.1" ECU_ADDRESS 0x7F882E /end MEASUREMENT
/begin MEASUREMENT CoEng_stZFCEmissionRoll "Freigabe Status der ZFC am Rollentester" UBYTE OneToOne 1 100 0.00 255.0 FORMAT "%5.1" ECU_ADDRESS 0x7F882F /end MEASUREMENT
/begin MEASUREMENT CoEng_tiAfterrun "Zeit seit Erreichen des Motorzustands Nachlauf (COENG_STAFTERRUN)" ULONG Time_ms 1 100 0.00 42949672950.0 FORMAT "%13.1" ECU_ADDRESS 0x7F935C /end MEASUREMENT
/begin MEASUREMENT CoEng_tiAfterrunRed "Zeit seit Erreichen des Motorzustands Nachlauf (COENG_STAFTERRUN, 0x30) mit reduzierter Auflösung als KL/KF Eingang" SWORD TimeRed 1 100 -5242.880 5242.720 FORMAT "%8.3" ECU_ADDRESS 0x7F8BBC /end MEASUREMENT
/begin MEASUREMENT CoEng_tiMinAftRun "Minimale Zeitdauer für die Verbindung vom elektronischen Steuergerät zum Hauptrelais" ULONG Time_ms 1 100 0.00 42949672950.0 FORMAT "%13.1" ECU_ADDRESS 0x7F9360 /end MEASUREMENT
/begin MEASUREMENT CoEng_tiNormal "Zeit seit Erreichen des Zustands NORMAL" ULONG Time_ms 1 100 0.00 42949672950.0 FORMAT "%13.1" ECU_ADDRESS 0x7F9364 /end MEASUREMENT
/begin MEASUREMENT CoEng_tiNormalRed "Zeit seit Erreichen Motorzustand NORMAL (0x04), mit reduzierter Auflösung als KL/KF Eingang" SWORD TimeRed 1 100 -5242.880 5242.720 FORMAT "%8.3" ECU_ADDRESS 0x7F8BBE /end MEASUREMENT
/begin MEASUREMENT CoEng_tiOvRMon_mp "Zeit seit Schub erkannt wurde und die Schubüberwachung aktiv ist" SWORD Time_ms 1 100 -327680.0 327670.0 FORMAT "%8.1" ECU_ADDRESS 0x8FD5D8 /end MEASUREMENT
/begin MEASUREMENT CoEng_tiRmpStrt "Time for Ramp Start" UWORD Time_ms 1 100 0.00 655350.0 FORMAT "%8.1" ECU_ADDRESS 0x7F8BC0 /end MEASUREMENT
/begin MEASUREMENT CoEng_tiSoftShOff_mp "time delay for soft shutoff" UWORD Time_ms 1 100 0.00 655350.0 FORMAT "%8.1" ECU_ADDRESS 0x8FD5D0 /end MEASUREMENT
/begin MEASUREMENT CoEng_tiStart "Zeit seit Erreichen Motorzustand START (0x02)" ULONG Time_ms 1 100 0.00 42949672950.0 FORMAT "%13.1" ECU_ADDRESS 0x7F9368 /end MEASUREMENT
/begin MEASUREMENT CoEng_tiStartRed "Zeit seit Erreichen Motorzustand START (0x02), mit reduzierter Auflösung als KL/KF Eingang" SWORD TimeRed 1 100 -5242.880 5242.720 FORMAT "%8.3" ECU_ADDRESS 0x7F8BC2 /end MEASUREMENT
/begin MEASUREMENT CoEng_tiSwtOff "Time for Switch Off" UWORD Time_ms 1 100 0.00 655350.0 FORMAT "%8.1" ECU_ADDRESS 0x7F8BC4 /end MEASUREMENT
/begin MEASUREMENT CoEng_tiWakeUp "Zeit seit Erreichen Zustand WAKEUP" ULONG Time_ms 1 100 0.00 42949672950.0 FORMAT "%13.1" ECU_ADDRESS 0x7F936C /end MEASUREMENT
/begin MEASUREMENT CoEng_tOvldMax_mp "" SWORD Temp_Cels 1 100 -50.140 899.860 FORMAT "%8.3" ECU_ADDRESS 0x8FD5FE /end MEASUREMENT
/begin MEASUREMENT CoEng_tPFltCDMax_mp "Maximalwert von Abgastemp. vor Partikelfilter erster sensor" SWORD Temp_Cels 1 100 -50.140 899.860 FORMAT "%8.3" ECU_ADDRESS 0x8FD600 /end MEASUREMENT
/begin MEASUREMENT CoEng_trq "aktuelles Motorausgangsmoment" SWORD Trq 1 100 -3276.800 3276.700 FORMAT "%8.3" ECU_ADDRESS 0x7F8BC6 /end MEASUREMENT
/begin MEASUREMENT CoEng_trqASDdcInit "Initialisierungswert  Störungsregler bei Aufhebung Schubabschaltung" SWORD Trq 1 100 -3276.800 3276.700 FORMAT "%8.3" ECU_ADDRESS 0x7F8BC8 /end MEASUREMENT
/begin MEASUREMENT CoEng_trqASDrfInit "Initialisierungswert  Führungsformer bei Aufhebung Schubabschaltung" SWORD Trq 1 100 -3276.800 3276.700 FORMAT "%8.3" ECU_ADDRESS 0x7F8BCA /end MEASUREMENT
/begin MEASUREMENT CoEng_trqBefRmp_mp "Sollmoment nach zweiter Begrenzung, vor Schubabschaltung in CoEng (als inneres Motormoment)" SWORD Trq 1 100 -3276.800 3276.700 FORMAT "%8.3" ECU_ADDRESS 0x8FD5DA /end MEASUREMENT
/begin MEASUREMENT CoEng_trqCorGearbxRgn "Message für die Korrektur der Getriebeschaltschwellen, während der Regeneration steht weniger Moment zur Verfügung" SWORD Trq 1 100 -3276.800 3276.700 FORMAT "%8.3" ECU_ADDRESS 0x7F8BCC /end MEASUREMENT
/begin MEASUREMENT CoEng_trqCurrLim "Minimum aller Begrenzungen als aktuelles Motorausgangsmoment" SWORD Trq 1 100 -3276.800 3276.700 FORMAT "%8.3" ECU_ADDRESS 0x7F8BCE /end MEASUREMENT
/begin MEASUREMENT CoEng_trqInrCurr "inneres Moment aktueller Wert" SWORD Trq 1 100 -3276.800 3276.700 FORMAT "%8.3" ECU_ADDRESS 0x7F8BD0 /end MEASUREMENT
/begin MEASUREMENT CoEng_trqInrCurrFast "inneres Wunschmoment (schneller Pfad) erzeugt aus CoDT_trqCurr" SWORD Trq 1 100 -3276.800 3276.700 FORMAT "%8.3" ECU_ADDRESS 0x7F8BD2 /end MEASUREMENT
/begin MEASUREMENT CoEng_trqInrCurrFastBase_mp "inneres schnelles Wunschmoment im Curr-Pfad" SWORD Trq 1 100 -3276.800 3276.700 FORMAT "%8.3" ECU_ADDRESS 0x8FD5EE /end MEASUREMENT
/begin MEASUREMENT CoEng_trqInrCurrLim "aktuell kleinstes Begrenzungsmoment (inneres Motormoment)" SWORD Trq 1 100 -3276.800 3276.700 FORMAT "%8.3" ECU_ADDRESS 0x7F8BD4 /end MEASUREMENT
/begin MEASUREMENT CoEng_trqInrCurrPre_mp "aktuelles inneres Moment ahne Leerlaufreglerstellgrösse" SWORD Trq 1 100 -3276.800 3276.700 FORMAT "%8.3" ECU_ADDRESS 0x8FD5DC /end MEASUREMENT
/begin MEASUREMENT CoEng_trqInrDes "Wunschmoment (inneres Motormoment)" SWORD Trq 1 100 -3276.800 3276.700 FORMAT "%8.3" ECU_ADDRESS 0x7F8BD6 /end MEASUREMENT
/begin MEASUREMENT CoEng_trqInrDesFast "Wunschmoment (inneres Motormoment) (schneller Pfad) erzeugt aus CoDT_trqLead" SWORD Trq 1 100 -3276.800 3276.700 FORMAT "%8.3" ECU_ADDRESS 0x7F8BD8 /end MEASUREMENT
/begin MEASUREMENT CoEng_trqInrDesFastBase_mp "inneres schnelles Wunschmoment ohne Veränderung" SWORD Trq 1 100 -3276.800 3276.700 FORMAT "%8.3" ECU_ADDRESS 0x8FD5F0 /end MEASUREMENT
/begin MEASUREMENT CoEng_trqInrDesFastUnLim_mp "inneres schnelles Wunschmoment vor Begrenzung" SWORD Trq 1 100 -3276.800 3276.700 FORMAT "%8.3" ECU_ADDRESS 0x8FD5F2 /end MEASUREMENT
/begin MEASUREMENT CoEng_trqInrDesSlow "inneres Moment Wunschwert (normaler Pfad) erzeugt aus CoDT_trqDes" SWORD Trq 1 100 -3276.800 3276.700 FORMAT "%8.3" ECU_ADDRESS 0x7F8BDA /end MEASUREMENT
/begin MEASUREMENT CoEng_trqInrDesSlowBase_mp "inneres langsames Wunschmoment ohne Veränderung" SWORD Trq 1 100 -3276.800 3276.700 FORMAT "%8.3" ECU_ADDRESS 0x8FD5DE /end MEASUREMENT
/begin MEASUREMENT CoEng_trqInrDesSlowUnLim_mp "inneres langsames Wunschmoment vor Begrenzung" SWORD Trq 1 100 -3276.800 3276.700 FORMAT "%8.3" ECU_ADDRESS 0x8FD5E0 /end MEASUREMENT
/begin MEASUREMENT CoEng_trqInrGearbxInMax_mp "maximales Getriebeeingangsmoment als inneres Motormoment" SWORD Trq 1 100 -3276.800 3276.700 FORMAT "%8.3" ECU_ADDRESS 0x8FD5D2 /end MEASUREMENT
/begin MEASUREMENT CoEng_trqInrLiDesSlw "Momentenführungswert mit LiGov Ausgngswert beaufschlagt" SWORD Trq 1 100 -3276.800 3276.700 FORMAT "%8.3" ECU_ADDRESS 0x7F8BDC /end MEASUREMENT
/begin MEASUREMENT CoEng_trqInrLim "Begrenzungsmoment (inneres Motormoment)" SWORD Trq 1 100 -3276.800 3276.700 FORMAT "%8.3" ECU_ADDRESS 0x7F8BDE /end MEASUREMENT
/begin MEASUREMENT CoEng_trqInrLimDes "Begrenzungsmoment als inneres Motormoment, korrigiert um Leerlaufreglerstellgröße" SWORD Trq 1 100 -3276.800 3276.700 FORMAT "%8.3" ECU_ADDRESS 0x7F8BE0 /end MEASUREMENT
/begin MEASUREMENT CoEng_trqInrLimLead "Begrenzungsmoment mit lang anhaltenden Begrenzungen" SWORD Trq 1 100 -3276.800 3276.700 FORMAT "%8.3" ECU_ADDRESS 0x7F8BE2 /end MEASUREMENT
/begin MEASUREMENT CoEng_trqInrLimLead0_mp "Torque lead limitation after error condition #0" SWORD Trq 1 100 -3276.800 3276.700 FORMAT "%8.3" ECU_ADDRESS 0x8FD602 /end MEASUREMENT
/begin MEASUREMENT CoEng_trqInrLimLead1_mp "Torque lead limitation after error condition #1" SWORD Trq 1 100 -3276.800 3276.700 FORMAT "%8.3" ECU_ADDRESS 0x8FD604 /end MEASUREMENT
/begin MEASUREMENT CoEng_trqInrLimLead2_mp "Torque lead limitation after error condition #2" SWORD Trq 1 100 -3276.800 3276.700 FORMAT "%8.3" ECU_ADDRESS 0x8FD606 /end MEASUREMENT
/begin MEASUREMENT CoEng_trqInrLtd "inneres Moment Sollwert nach Begrenzung, vor Eingriff ARD-Störungsregler" SWORD Trq 1 100 -3276.800 3276.700 FORMAT "%8.3" ECU_ADDRESS 0x7F8BE4 /end MEASUREMENT
/begin MEASUREMENT CoEng_trqInrPrpLimErr_mp "Begrenzungsmoment für Vortrieb im Falle eines Systemfehlers als inneres Motormoment" SWORD Trq 1 100 -3276.800 3276.700 FORMAT "%8.3" ECU_ADDRESS 0x8FD5D4 /end MEASUREMENT
/begin MEASUREMENT CoEng_trqInrRaw "inneres Moment Rohwert" SWORD Trq 1 100 -3276.800 3276.700 FORMAT "%8.3" ECU_ADDRESS 0x7F8BE6 /end MEASUREMENT
/begin MEASUREMENT CoEng_trqInrRawPre_mp "Rohwet inneres Moment ohne Leerlaufreglerstellgrösse" SWORD Trq 1 100 -3276.800 3276.700 FORMAT "%8.3" ECU_ADDRESS 0x8FD5E2 /end MEASUREMENT
/begin MEASUREMENT CoEng_trqInrSet "inneres Moment Sollwert (>Mengenberechnung)" SWORD Trq 1 100 -3276.800 3276.700 FORMAT "%8.3" ECU_ADDRESS 0x7F8BE8 /end MEASUREMENT
/begin MEASUREMENT CoEng_trqInrSetLim_mp "Begrenzter Sollwert des inneren Moments, wenn Schub erkannt wurde und die Schubüberwachung aktiv ist" SWORD Trq 1 100 -3276.800 3276.700 FORMAT "%8.3" ECU_ADDRESS 0x8FD5E4 /end MEASUREMENT
/begin MEASUREMENT CoEng_trqInrSetUnLtd_mp "Unbegrenzter Sollwert des inneren Moments bei erkanntem Schub" SWORD Trq 1 100 -3276.800 3276.700 FORMAT "%8.3" ECU_ADDRESS 0x8FD5E6 /end MEASUREMENT
/begin MEASUREMENT CoEng_trqLiLtd "begrenztes Leerlaufreglermoment" SWORD Trq 1 100 -3276.800 3276.700 FORMAT "%8.3" ECU_ADDRESS 0x7F8BEA /end MEASUREMENT
/begin MEASUREMENT CoEng_trqLimErr "Begrenzungsmoment im Falle eines Systemfehlers" SWORD Trq 1 100 -3276.800 3276.700 FORMAT "%8.3" ECU_ADDRESS 0x7F8BEC /end MEASUREMENT
/begin MEASUREMENT CoEng_trqLimErr1 "Begrenzungsmoment im Falle Systemfehler 1" SWORD Trq 1 100 -3276.800 3276.700 FORMAT "%8.3" ECU_ADDRESS 0x7F8BEE /end MEASUREMENT
/begin MEASUREMENT CoEng_trqLimErr2 "Begrenzungsmoment im Fall Systemfahler 2" SWORD Trq 1 100 -3276.800 3276.700 FORMAT "%8.3" ECU_ADDRESS 0x7F8BF0 /end MEASUREMENT
/begin MEASUREMENT CoEng_trqLimErr3 "Begrenzungsmoment im Falle Systemfehler3" SWORD Trq 1 100 -3276.800 3276.700 FORMAT "%8.3" ECU_ADDRESS 0x7F8BF2 /end MEASUREMENT
/begin MEASUREMENT CoEng_trqLimErr4 "Begrenzungsmoment im Fall Systemfehler 4" SWORD Trq 1 100 -3276.800 3276.700 FORMAT "%8.3" ECU_ADDRESS 0x7F8BF4 /end MEASUREMENT
/begin MEASUREMENT CoEng_trqLimMinEEPVal_mp "Stored in EEPROM in case of errors in particle filter" SWORD Trq 1 100 -3276.800 3276.700 FORMAT "%8.3" ECU_ADDRESS 0x8FD608 /end MEASUREMENT
/begin MEASUREMENT CoEng_trqLimMin_mp "Begrenzungsmoment, falls kein momentenbegrenzender Systemfehler vorliegt (Minimum aus Rauchgrenze un Motormech.schutz)" SWORD Trq 1 100 -3276.800 3276.700 FORMAT "%8.3" ECU_ADDRESS 0x6F800E /end MEASUREMENT
/begin MEASUREMENT CoEng_trqLimOffs "current torque limitation with offset for ASDdc" SWORD Trq 1 100 -3276.800 3276.700 FORMAT "%8.3" ECU_ADDRESS 0x7F8BF6 /end MEASUREMENT
/begin MEASUREMENT CoEng_trqLimOffs_mp "aktueller Momentgrenzwert mit Offset f. ARD" SWORD Trq 1 100 -3276.800 3276.700 FORMAT "%8.3" ECU_ADDRESS 0x8FD5E8 /end MEASUREMENT
/begin MEASUREMENT CoEng_trqLimPDiff "Momentenbegrenzung aufgrund Druckdifferenz über Partikelfilter" SWORD Trq 1 100 -3276.800 3276.700 FORMAT "%8.3" ECU_ADDRESS 0x7F8BF8 /end MEASUREMENT
/begin MEASUREMENT CoEng_trqLimPDiffNOffs_mp "n-Teil des Moments zur Verbesserung des Motorstarts" SWORD Trq 1 100 -3276.800 3276.700 FORMAT "%8.3" ECU_ADDRESS 0x8FD60A /end MEASUREMENT
/begin MEASUREMENT CoEng_trqLimPFlt1_mp "Pressure difference conversion to torque" SWORD Trq 1 100 -3276.800 3276.700 FORMAT "%8.3" ECU_ADDRESS 0x8FD60C /end MEASUREMENT
/begin MEASUREMENT CoEng_trqLimPFltErr "Ersatzmoment bei Systemfehler_Partikelfilter" SWORD Trq 1 100 -3276.800 3276.700 FORMAT "%8.3" ECU_ADDRESS 0x7F8BFA /end MEASUREMENT
/begin MEASUREMENT CoEng_trqLimPFltOvldErr "Ersatzmoment bei Systemfehler_Partikelfilter überladen" SWORD Trq 1 100 -3276.800 3276.700 FORMAT "%8.3" ECU_ADDRESS 0x7F8BFC /end MEASUREMENT
/begin MEASUREMENT CoEng_trqLimPFltOvld_mp "Begrenzungsmoment aufgrund von CSf Überladung" SWORD Trq 1 100 -3276.800 3276.700 FORMAT "%8.3" ECU_ADDRESS 0x8FD60E /end MEASUREMENT
/begin MEASUREMENT CoEng_trqLimSwt "Ausgang des RampSwitch-Block zur Momentbegrenzung im Systemfehlerfall" SWORD Trq 1 100 -3276.800 3276.700 FORMAT "%8.3" ECU_ADDRESS 0x7F8BFE /end MEASUREMENT
/begin MEASUREMENT CoEng_trqLimSwt1_mp "Begrenzungsmoment im Fehlerfall" SWORD Trq 1 100 -3276.800 3276.700 FORMAT "%8.3" ECU_ADDRESS 0x8FD610 /end MEASUREMENT
/begin MEASUREMENT CoEng_trqLimSwt2_mp "Begrenzungsmoment im Fehlerfall 2" SWORD Trq 1 100 -3276.800 3276.700 FORMAT "%8.3" ECU_ADDRESS 0x8FD612 /end MEASUREMENT
/begin MEASUREMENT CoEng_trqLimSwt3_mp "Begrenzungsmoment im Fehlerfall" SWORD Trq 1 100 -3276.800 3276.700 FORMAT "%8.3" ECU_ADDRESS 0x8FD614 /end MEASUREMENT
/begin MEASUREMENT CoEng_trqLimSwt4_mp "Begrenzungsmoment im Fehlerfall" SWORD Trq 1 100 -3276.800 3276.700 FORMAT "%8.3" ECU_ADDRESS 0x8FD616 /end MEASUREMENT
/begin MEASUREMENT CoEng_trqMax "Momentintervall Maximum" SWORD Trq 1 100 -3276.800 3276.700 FORMAT "%8.3" ECU_ADDRESS 0x7F8C00 /end MEASUREMENT
/begin MEASUREMENT CoEng_trqMin "Schleppmoment" SWORD Trq 1 100 -3276.800 3276.700 FORMAT "%8.3" ECU_ADDRESS 0x7F8C02 /end MEASUREMENT
/begin MEASUREMENT CoEng_trqOvrFul "Overfueling Menge nach Rampe" SWORD Trq 1 100 -3276.800 3276.700 FORMAT "%8.3" ECU_ADDRESS 0x7F8C04 /end MEASUREMENT
/begin MEASUREMENT CoEng_trqRmp_mp "Ausgangsmoment Rampe der Schubabschaltung" SWORD Trq 1 100 -3276.800 3276.700 FORMAT "%8.3" ECU_ADDRESS 0x8FD5EA /end MEASUREMENT
/begin MEASUREMENT CoEng_trqSetASDdc_mp "Sollmoment nach Eingriff Ruckeldämfer vor zweiter Begrenzung (mit Offset)" SWORD Trq 1 100 -3276.800 3276.700 FORMAT "%8.3" ECU_ADDRESS 0x8FD5EC /end MEASUREMENT
/begin MEASUREMENT CoEng_trqSlpLim "Begrenzungsmoment für Rauchbegrenzung nach Turboschubbegrenzung" SWORD Trq 1 100 -3276.800 3276.700 FORMAT "%8.3" ECU_ADDRESS 0x7F8C08 /end MEASUREMENT
/begin MEASUREMENT CoEng_volFlConsum "absoluter Verbrauch" SLONG FlConsum_ul_20ms 1 100 -2147483648.00 2147483647.00 FORMAT "%13.2" ECU_ADDRESS 0x7F9370 /end MEASUREMENT
/begin MEASUREMENT CoEng_volFlConsumAdj_mp "abgeglicher Kraftstoffverbrauch" SLONG FlConsum_ul_20ms 1 100 -2147483648.00 2147483647.00 FORMAT "%13.2" ECU_ADDRESS 0x8FD5BC /end MEASUREMENT
/begin MEASUREMENT CoEng_voltotFlConsum "Absoluter Kraftstoffverbrauch" SLONG FlConsum_ul 1 100 -2147483648.00 2147483647.00 FORMAT "%13.2" ECU_ADDRESS 0x7F9374 /end MEASUREMENT
/begin MEASUREMENT ComBas_stDiaReq "Message: Antwort von der Diagnose-Schnittstelle" UBYTE OneToOne 1 100 0.00 255.0 FORMAT "%5.1" ECU_ADDRESS 0x7F8838 /end MEASUREMENT
/begin MEASUREMENT ConvCD_ctClutchDfct_mp "Defektzähler von Plausibitätfehler des Kupplungssignals" UWORD OneToOne 1 100 0.00 65535.00 FORMAT "%8.2" ECU_ADDRESS 0x8FD618 /end MEASUREMENT
/begin MEASUREMENT ConvCD_stClth "Kupplungszustand" UBYTE OneToOne 1 100 0.00 255.0 FORMAT "%5.1" ECU_ADDRESS 0x7F8839 /end MEASUREMENT
/begin MEASUREMENT ConvCD_stClthRaw "Kupplungszustand nicht überwacht" UBYTE OneToOne 1 100 0.00 255.0 FORMAT "%5.1" ECU_ADDRESS 0x7F883A /end MEASUREMENT
/begin MEASUREMENT ConvCD_stClutchRecord "Message zur Kupplungsstatus Wechsel ( 0 --> 1)" UBYTE OneToOne 1 100 0.00 255.0 FORMAT "%5.1" ECU_ADDRESS 0x7F883B /end MEASUREMENT
/begin MEASUREMENT ConvCD_stDebVal "entprelltes Kupplungssignal" UBYTE OneToOne 1 100 0.00 255.0 FORMAT "%5.1" ECU_ADDRESS 0x7F883C /end MEASUREMENT
/begin MEASUREMENT ConvCD_stIntDebVal "Entprellt Kupplung Status zur internen Verwendung" UBYTE OneToOne 1 100 0.00 255.0 FORMAT "%5.1" ECU_ADDRESS 0x7F883D /end MEASUREMENT
/begin MEASUREMENT ConvCD_stLastDebVal "Letzter Kupplungssignalstatus." UBYTE OneToOne 1 100 0.00 255.0 FORMAT "%5.1" ECU_ADDRESS 0x7F883E /end MEASUREMENT
/begin MEASUREMENT ConvCD_stLastGear "Gang von den letzten Zyklus" SBYTE OneToOne 1 100 -128.0 127.0 FORMAT "%5.1" ECU_ADDRESS 0x7F883F /end MEASUREMENT
/begin MEASUREMENT ConvCD_stOldGear "Letzte gültigen Gang" SBYTE OneToOne 1 100 -128.0 127.0 FORMAT "%5.1" ECU_ADDRESS 0x7F8840 /end MEASUREMENT
/begin MEASUREMENT ConvCD_stRawVal "Kupplungssignal Rohwert" UBYTE OneToOne 1 100 0.00 255.0 FORMAT "%5.1" ECU_ADDRESS 0x7F8841 /end MEASUREMENT
/begin MEASUREMENT ConvCD_swtSig "Schalter für Kupplungssignalquelle (DIO/CAN)." UBYTE OneToOne 1 100 0.00 255.0 FORMAT "%5.1" ECU_ADDRESS 0x7F8842 /end MEASUREMENT
/begin MEASUREMENT Conv_rTrans "Übertragungsverhältins Momentenwandler (Kupplung)" SWORD TransR 1 100 -327.6800 327.6700 FORMAT "%8.4" ECU_ADDRESS 0x7F8C36 /end MEASUREMENT
/begin MEASUREMENT CoVeh_nAcsMax "maximale Drehzahl Nebenaggregate" SWORD EngN 1 100 -32768.00 32767.00 FORMAT "%8.2" ECU_ADDRESS 0x7F8C18 /end MEASUREMENT
/begin MEASUREMENT CoVeh_nAcsMin "minimale Drehzahl Nebenaggregate" SWORD EngN 1 100 -32768.00 32767.00 FORMAT "%8.2" ECU_ADDRESS 0x7F8C1A /end MEASUREMENT
/begin MEASUREMENT CoVeh_nLimEngSpd "limitierte Motordrehzahl für die Drehmomentenberechnung" SWORD EngN 1 100 -32768.00 32767.00 FORMAT "%8.2" ECU_ADDRESS 0x7F8C1C /end MEASUREMENT
/begin MEASUREMENT CoVeh_nMax "Auftrag maximale Motordrehzahl" SWORD EngN 1 100 -32768.00 32767.00 FORMAT "%8.2" ECU_ADDRESS 0x7F8C1E /end MEASUREMENT
/begin MEASUREMENT CoVeh_nMin "Auftrag minimale Motordrehzahl" SWORD EngN 1 100 -32768.00 32767.00 FORMAT "%8.2" ECU_ADDRESS 0x7F8C20 /end MEASUREMENT
/begin MEASUREMENT CoVeh_pwrAcsDes "Nebenaggregatleistung Auftrag" SWORD Pwr 1 100 -308831.1 308821.7 FORMAT "%8.1" ECU_ADDRESS 0x7F8C22 /end MEASUREMENT
/begin MEASUREMENT CoVeh_pwrAcsLead "Vorhalt Nebenaggregatleistung Auftrag" SWORD Pwr 1 100 -308831.1 308821.7 FORMAT "%8.1" ECU_ADDRESS 0x7F8C24 /end MEASUREMENT
/begin MEASUREMENT CoVeh_pwrAcsTempLim_mp "Power demand for all temporary accessories - limited based on PrpBrk_trqDes" SWORD Pwr 1 100 -308831.1 308821.7 FORMAT "%8.1" ECU_ADDRESS 0x8FD61A /end MEASUREMENT
/begin MEASUREMENT CoVeh_stOrd "Randbedingungen für physikalischen Auftrag" UBYTE OneToOne 1 100 0.00 255.0 FORMAT "%5.1" ECU_ADDRESS 0x7F8836 /end MEASUREMENT
/begin MEASUREMENT CoVeh_trqAcs "Momentenanforderung der Nebenaggregate" SWORD Trq 1 100 -3276.800 3276.700 FORMAT "%8.3" ECU_ADDRESS 0x7F8C26 /end MEASUREMENT
/begin MEASUREMENT CoVeh_trqAcsDes "Momentenanforderung Nebenaggregate Wunschwert" SWORD Trq 1 100 -3276.800 3276.700 FORMAT "%8.3" ECU_ADDRESS 0x7F8C28 /end MEASUREMENT
/begin MEASUREMENT CoVeh_trqAcsLead "Momentenanforderung Nebenaggregate Vorhaltewert" SWORD Trq 1 100 -3276.800 3276.700 FORMAT "%8.3" ECU_ADDRESS 0x7F8C2A /end MEASUREMENT
/begin MEASUREMENT CoVeh_trqAcsLimCrSDes_mp "Torque demand" SWORD Trq 1 100 -3276.800 3276.700 FORMAT "%8.3" ECU_ADDRESS 0x8FD61C /end MEASUREMENT
/begin MEASUREMENT CoVeh_trqAcsPerm "Momentenbedarf permanente Nebenaggregate" SWORD Trq 1 100 -3276.800 3276.700 FORMAT "%8.3" ECU_ADDRESS 0x7F8C2C /end MEASUREMENT
/begin MEASUREMENT CoVeh_trqAcsTemp "Momentenbedarf zuschaltbare Nebenaggregate" SWORD Trq 1 100 -3276.800 3276.700 FORMAT "%8.3" ECU_ADDRESS 0x7F8C2E /end MEASUREMENT
/begin MEASUREMENT CoVeh_trqPrpDes "Vortriebsmoment Wunschwert" SWORD TrqPrp 1 100 -6553.600 6553.400 FORMAT "%8.3" ECU_ADDRESS 0x7F8C30 /end MEASUREMENT
/begin MEASUREMENT CoVeh_trqPrpLead "Vortriebsmoment Vorhaltewert" SWORD TrqPrp 1 100 -6553.600 6553.400 FORMAT "%8.3" ECU_ADDRESS 0x7F8C32 /end MEASUREMENT
/begin MEASUREMENT CoVeh_trqPrpLimErr "Begrenzungsmoment für Vortrieb im Falle eines Systemfehlers" SWORD TrqPrp 1 100 -6553.600 6553.400 FORMAT "%8.3" ECU_ADDRESS 0x7F8C34 /end MEASUREMENT
/begin MEASUREMENT CoVM_amAct_mp "Aktueller Integrationswert des  MSR-Momentenüberschußintegrals" SWORD TrqPrpDT 1 100 -163840.0 163835.0 FORMAT "%8.1" ECU_ADDRESS 0x8FD61E /end MEASUREMENT
/begin MEASUREMENT CoVM_stActDem "Status aktiv wirkender Fahrdynamikeingriffe" UBYTE OneToOne 1 100 0.00 255.0 FORMAT "%5.1" ECU_ADDRESS 0x7F8830 /end MEASUREMENT
/begin MEASUREMENT CoVM_stDCSh_mp "unentprellter Status der Plausibilitätsprüfung des erhöhenden Fahrdynamikeingriffs" UBYTE OneToOne 1 100 0.00 255.0 FORMAT "%5.1" ECU_ADDRESS 0x8FD620 /end MEASUREMENT
/begin MEASUREMENT CoVM_stDemCheck "Steuerbits der Abschaltsteuerung der Fahrdynamikeingriffe" UBYTE OneToOne 1 100 0.00 255.0 FORMAT "%5.1" ECU_ADDRESS 0x7F8831 /end MEASUREMENT
/begin MEASUREMENT CoVM_stDemUnplaus_mp "Status der DCS Überwachung" UBYTE OneToOne 1 100 0.00 255.0 FORMAT "%5.1" ECU_ADDRESS 0x8FD621 /end MEASUREMENT
/begin MEASUREMENT CoVM_stOrd "Randbedingungen für physikalischen Auftrag" UBYTE OneToOne 1 100 0.00 255.0 FORMAT "%5.1" ECU_ADDRESS 0x7F8832 /end MEASUREMENT
/begin MEASUREMENT CoVM_stTrqLeadFrz "current status if SW timer running" UBYTE OneToOne 1 100 0.00 255.0 FORMAT "%5.1" ECU_ADDRESS 0x7F8833 /end MEASUREMENT
/begin MEASUREMENT CoVM_swtSlipCtl "Fahrdynamik-Konfiguration (0: ASR aus, MSR aus; 1: ASR an, MSR aus;  2: ASR aus, MSR an;  3: ASR an, MSR an)" UBYTE OneToOne 1 100 0.00 255.0 FORMAT "%5.1" ECU_ADDRESS 0x7F8835 /end MEASUREMENT
/begin MEASUREMENT CoVM_trqDec "Momenteneingriff von ASR" SWORD TrqPrp 1 100 -6553.600 6553.400 FORMAT "%8.3" ECU_ADDRESS 0x7F8C0C /end MEASUREMENT
/begin MEASUREMENT CoVM_trqDecSetVal_mp "decreasing  torque set value wheel-torque" SWORD TrqPrp 1 100 -6553.600 6553.400 FORMAT "%8.3" ECU_ADDRESS 0x8FD62A /end MEASUREMENT
/begin MEASUREMENT CoVM_trqDesIncMax_mp "Messpunkt des Maximumwertes zwischen PrpBrk_trqDes & CoVM_trqInc" SWORD TrqPrp 1 100 -6553.600 6553.400 FORMAT "%8.3" ECU_ADDRESS 0x8FD624 /end MEASUREMENT
/begin MEASUREMENT CoVM_trqDVCH "Fahrerwunschmoment für DSC, EGS" SWORD Trq 1 100 -3276.800 3276.700 FORMAT "%8.3" ECU_ADDRESS 0x7F8C0A /end MEASUREMENT
/begin MEASUREMENT CoVM_trqGearbxMax "Momentbegrenzung reduzierender Getriebeeingriff" SWORD Trq 1 100 -3276.800 3276.700 FORMAT "%8.3" ECU_ADDRESS 0x7F8C0E /end MEASUREMENT
/begin MEASUREMENT CoVM_trqGearbxMin "Momentbegrenzung erhöhender Getriebeeingriff" SWORD Trq 1 100 -3276.800 3276.700 FORMAT "%8.3" ECU_ADDRESS 0x7F8C10 /end MEASUREMENT
/begin MEASUREMENT CoVM_trqInc "Momenteneingriff von MSR" SWORD TrqPrp 1 100 -6553.600 6553.400 FORMAT "%8.3" ECU_ADDRESS 0x7F8C12 /end MEASUREMENT
/begin MEASUREMENT CoVM_trqIncSetVal_mp "increasing  torque set value  of wheel-torque" SWORD TrqPrp 1 100 -6553.600 6553.400 FORMAT "%8.3" ECU_ADDRESS 0x8FD62C /end MEASUREMENT
/begin MEASUREMENT CoVM_trqInt_mp "Aktuelles  Integrationsmoment des MSR-Momentenüberschußintegrals" SWORD TrqPrp 1 100 -6553.600 6553.400 FORMAT "%8.3" ECU_ADDRESS 0x8FD622 /end MEASUREMENT
/begin MEASUREMENT CoVM_trqLeadIncMax_mp "Messpunkt des Maximumwertes zwischen PrpBrk_trqLead & CoVM_trqInc" SWORD TrqPrp 1 100 -6553.600 6553.400 FORMAT "%8.3" ECU_ADDRESS 0x8FD628 /end MEASUREMENT
/begin MEASUREMENT CoVM_trqPrpDes "Wunsch Vortriebsmoment" SWORD TrqPrp 1 100 -6553.600 6553.400 FORMAT "%8.3" ECU_ADDRESS 0x7F8C14 /end MEASUREMENT
/begin MEASUREMENT CoVM_trqPrpLead "Vorhalt Vortriebsmoment" SWORD TrqPrp 1 100 -6553.600 6553.400 FORMAT "%8.3" ECU_ADDRESS 0x7F8C16 /end MEASUREMENT
/begin MEASUREMENT CpBVlv_qClose_mp "mp für niedrigeren Schwellenwert der Einspriztmenge (Schließung)" SWORD InjMassCyc 1 100 -327.6800 327.6700 FORMAT "%8.4" ECU_ADDRESS 0x8FD62E /end MEASUREMENT
/begin MEASUREMENT CpBVlv_qOpn_mp "mp für höheren Schwellenwert der der Einspriztmenge  (Eröffnung)" SWORD InjMassCyc 1 100 -327.6800 327.6700 FORMAT "%8.4" ECU_ADDRESS 0x8FD630 /end MEASUREMENT
/begin MEASUREMENT CpBVlv_stLogic "Logikstatus fuer Verdichterbypass" UBYTE OneToOne 1 100 0.00 255.0 FORMAT "%5.1" ECU_ADDRESS 0x7F8843 /end MEASUREMENT
/begin MEASUREMENT CpBVlv_stOff_mp "mp für shutoff" UBYTE OneToOne 1 100 0.00 255.0 FORMAT "%5.1" ECU_ADDRESS 0x8FD632 /end MEASUREMENT
/begin MEASUREMENT CpBVlv_stOpn "Zustand Kompressorbypass-Ventil" UBYTE OneToOne 1 100 0.00 255.0 FORMAT "%5.1" ECU_ADDRESS 0x7F8844 /end MEASUREMENT
/begin MEASUREMENT CrCCD_dMFLData_mp "Rohdaten vom MFL" UBYTE OneToOne 1 100 0.00 255.0 FORMAT "%5.1" ECU_ADDRESS 0x8FD633 /end MEASUREMENT
/begin MEASUREMENT CrCCD_stDev "Status FGR-Bedienteil (zusätzliche Abschaltbedingungen)" UBYTE OneToOne 1 100 0.00 255.0 FORMAT "%5.1" ECU_ADDRESS 0x7F8845 /end MEASUREMENT
/begin MEASUREMENT CrCCD_stKey "Rückgabewert ""Taste gedrückt""" UBYTE OneToOne 1 100 0.00 255.0 FORMAT "%5.1" ECU_ADDRESS 0x7F8846 /end MEASUREMENT
/begin MEASUREMENT CrCCD_stKeyOff "tip up und tip down Taste bei deaktivierten CrCtl Hauptschalter" UBYTE OneToOne 1 100 0.00 255.0 FORMAT "%5.1" ECU_ADDRESS 0x7F8847 /end MEASUREMENT
/begin MEASUREMENT CrCCD_swtDev "SW-Schalter eingebauter Typ FGR Bedienteil" UBYTE OneToOne 1 100 0.00 255.0 FORMAT "%5.1" ECU_ADDRESS 0x7F8848 /end MEASUREMENT
/begin MEASUREMENT CrCCD_swtMSW "Schalterstellung vom MSW (1...MSW ein/0...MSW aus)" UBYTE OneToOne 1 100 0.00 255.0 FORMAT "%5.1" ECU_ADDRESS 0x7F8849 /end MEASUREMENT
/begin MEASUREMENT CrCtl_numGear "Gang FGR" SBYTE OneToOne 1 100 -128.0 127.0 FORMAT "%5.1" ECU_ADDRESS 0x7F884A /end MEASUREMENT
/begin MEASUREMENT CrCtl_stActive "Flag aktiver FGR" UBYTE OneToOne 1 100 0.00 255.0 FORMAT "%5.1" ECU_ADDRESS 0x7F884D /end MEASUREMENT
/begin MEASUREMENT CrCtl_stBrkBeforeCruise_mp "Meßpunkt für Bremsenanforderung" UBYTE OneToOne 1 100 0.00 255.0 FORMAT "%5.1" ECU_ADDRESS 0x8FD634 /end MEASUREMENT
/begin MEASUREMENT CrCtl_stClCtr_mp "Status nach DSC, ASC & MSR Eingriffen" UWORD OneToOne 1 100 0.00 65535.00 FORMAT "%8.2" ECU_ADDRESS 0x8FD636 /end MEASUREMENT
/begin MEASUREMENT CrCtl_stRecFGR "Status ob FGR im Fahrzeug verbaut ist" UBYTE OneToOne 1 100 0.00 255.0 FORMAT "%5.1" ECU_ADDRESS 0x7F8851 /end MEASUREMENT
/begin MEASUREMENT CrCtl_stShutOffCode "Abschaltgrund FGR" ULONG OneToOne 1 100 0.00 4294967295.00 FORMAT "%13.2" ECU_ADDRESS 0x7F9378 /end MEASUREMENT
/begin MEASUREMENT CrCtl_stShutOffCode1_mp "Low Byte von CrCtl_shutOffCode (Verwendung als Signal)" UWORD OneToOne 1 100 0.00 65535.00 FORMAT "%8.2" ECU_ADDRESS 0x6F8010 /end MEASUREMENT
/begin MEASUREMENT CrCtl_stShutOffCode2_mp "Low Byte von CrCtl_shutOffCode (Verwendung als Signal)" UWORD OneToOne 1 100 0.00 65535.00 FORMAT "%8.2" ECU_ADDRESS 0x6F8012 /end MEASUREMENT
/begin MEASUREMENT CrCtl_stShutOffFrz1_mp "latched shutoff reason" UWORD OneToOne 1 100 0.00 65535.00 FORMAT "%8.2" ECU_ADDRESS 0x6F8014 /end MEASUREMENT
/begin MEASUREMENT CrCtl_stShutOffFrz2_mp "latched shutoff reason" UWORD OneToOne 1 100 0.00 65535.00 FORMAT "%8.2" ECU_ADDRESS 0x6F8016 /end MEASUREMENT
/begin MEASUREMENT CrCtl_stShutOffFrz_mp "eingefrorener Abschaltgrund FGR" ULONG OneToOne 1 100 0.00 4294967295.00 FORMAT "%13.2" ECU_ADDRESS 0x6F8018 /end MEASUREMENT
/begin MEASUREMENT CrCtl_trqDes "Momentenanforderung FGR" SWORD TrqPrp 1 100 -6553.600 6553.400 FORMAT "%8.3" ECU_ADDRESS 0x7F8C3A /end MEASUREMENT
/begin MEASUREMENT CrCtl_trqLead "Vorhaltmoment des FGR" SWORD TrqPrp 1 100 -6553.600 6553.400 FORMAT "%8.3" ECU_ADDRESS 0x7F8C3C /end MEASUREMENT
/begin MEASUREMENT indexmrst "Index für vmrki..." UBYTE dez 1 100 0.00 255.0 FORMAT "%5.1" ECU_ADDRESS 0x7F8A3A /end MEASUREMENT
/begin MEASUREMENT Prp_trqMaxDes_mp "Maximales Wunschmoment über CAN im Fall von Max. Geschwindigkeitsbeschränkung" SWORD TrqPrp 1 100 -6553.600 6553.400 FORMAT "%8.3" ECU_ADDRESS 0x8FD626 /end MEASUREMENT
/begin MEASUREMENT tnomgs60ms "Zeit in der keine CAN-Botschaft G_T versendet wurde" UBYTE t20msxs_ub_b5p1 1 100 0.00 5.100 FORMAT "%5.3" ECU_ADDRESS 0x7F8A41 /end MEASUREMENT
/begin MEASUREMENT vmrki1_w "v-Marke 1 für Botschaft" UWORD Vel 1 100 0.00 655.3500 FORMAT "%8.4" ECU_ADDRESS 0x7F930A /end MEASUREMENT
/begin MEASUREMENT vmrki2_w "v-Marke 2 für Botschaft" UWORD Vel 1 100 0.00 655.3500 FORMAT "%8.4" ECU_ADDRESS 0x7F930C /end MEASUREMENT
/begin MEASUREMENT vmrki3_w "v-Marke 3 für Botschaft" UWORD Vel 1 100 0.00 655.3500 FORMAT "%8.4" ECU_ADDRESS 0x7F930E /end MEASUREMENT
/begin FUNCTION bypetk ""
 /begin DEF_CHARACTERISTIC BypEtk_dNsyncStimuli64_C BypEtk_dNsyncStimuli32_C BypEtk_dNsyncStimuli16_C BypEtk_dNsyncStimuli8_C BypEtk_stAscet_C BypEtk_dTsyncStimuli64_C BypEtk_dTsyncStimuli32_C BypEtk_dTsyncStimuli16_C BypEtk_dTsyncStimuli8_C /end DEF_CHARACTERISTIC
/end FUNCTION
/begin FUNCTION bypetk_msg ""
 /begin OUT_MEASUREMENT BypEtk_ctStepDelayNsync_u8 BypEtk_ctStepDelayTsync_u8 BypEtk_stEcu_u8 /end OUT_MEASUREMENT
/end FUNCTION
/begin FUNCTION bypint "" /begin DEF_CHARACTERISTIC BypInt_adFunc_C BypInt_stAscet_C /end DEF_CHARACTERISTIC /end FUNCTION
/begin FUNCTION bypint_msg "" /begin OUT_MEASUREMENT BypInt_stEcu_u8 /end OUT_MEASUREMENT /end FUNCTION
/begin FUNCTION carb "CARB Einstellungen"
 /begin DEF_CHARACTERISTIC Carb_Mode1PID_CA Carb_Mode1Signal_CA Carb_Mode2PID_CA Carb_Mode2Signal_CA Carb_Mode3SwtDia_C Carb_Mode4RefVal_C Carb_Mode4SigNum_C Carb_Mode6TstComp_CUR Carb_Mode6TstNum_CUR Carb_Mode6TstRefMax_CUR Carb_Mode6TstRefMin_CUR Carb_Mode6TstTestId_CUR Carb_Mode6TstUnitId_CUR Carb_Mode6TstVal_CUR Carb_Mode9PID0_C Carb_Mode9PID1_C Carb_Mode9PID2_C Carb_Mode9PID3_C Carb_Mode9PID4_C Carb_Mode9PID5_C Carb_Mode9PID6_C /end DEF_CHARACTERISTIC
/end FUNCTION
/begin FUNCTION cascd "Komponententreiber Nockenwelle"
 /begin DEF_CHARACTERISTIC CaSCD_ctAddTooth_C CaSCD_ctEdgOfs_C CaSCD_ctErrSegLen2Pos_C CaSCD_ctErrSync_C CaSCD_ctMissTooth_C CaSCD_ctShftSync_C CaSCD_dSegSeries_C CaSCD_dTrigMsk_C CaSCD_dTrigRslt_C CaSCD_facPlausHigh_CUR CaSCD_facPlausLow_CUR CaSCD_nMinSpeed_C CaSCD_phiPosTolc_C CaSCD_phiSegLenTolc_C CaSCD_phiSegLen_C CaSCD_phiSegOfs_C CaSCD_phiSpeedCalcTolc_C CaSCD_phiSpeedSegLen_C CaSCD_phiSpeedSegOfs_C CaSCD_phiTrig_C CaSCD_stCalc_C CaSCD_stEdgeTrig_C CaSCD_stPinState_C CaSCD_stTPO_C CaSCD_swtSegLenPin2Pos_C CaSCD_tiPeriodRev1Max_C CaSCD_tiPeriodRev2Max_C CaSCD_tiTimOutOfs_C /end DEF_CHARACTERISTIC
 /begin IN_MEASUREMENT CaSCD_tiPeriodRev CaSCD_tiPeriodRevHold /end IN_MEASUREMENT
/end FUNCTION
/begin FUNCTION cascd_backup "" /end FUNCTION
/begin FUNCTION cascd_msg ""
 /begin OUT_MEASUREMENT CaSCD_nPeriod CaSCD_nSeg CaSCD_tiPeriodRev CaSCD_tiPeriodRevHold CaSCD_tiSeg /end OUT_MEASUREMENT
/end FUNCTION
/begin FUNCTION cascd_uic ""
 /begin OUT_MEASUREMENT CaSCD_ctAddTooth_mp CaSCD_ctEdgCaSRev_mp CaSCD_ctEdgOfs_mp CaSCD_ctEdgOrd_mp CaSCD_ctErrEdg_mp CaSCD_ctErrSegLen2Pos_mp CaSCD_ctMissTooth_mp CaSCD_ctPhRevEdges_mp CaSCD_ctPhRev_mp CaSCD_ctSegEdg_mp CaSCD_ctSegLenOrd_mp CaSCD_ctShftPos_mp CaSCD_ctSyncEdg_mp CaSCD_numFrstInt_mp CaSCD_numFrstTDC_mp CaSCD_phiCurr_mp CaSCD_phiLstEdge_mp CaSCD_stPhaseErr_mp CaSCD_stPhaseSig_mp CaSCD_stPhaseSync_mp CaSCD_stSegCylEdg_mp CaSCD_stSyncCylEdg_mp CaSCD_tiSigTimOut_mp /end OUT_MEASUREMENT
/end FUNCTION
/begin FUNCTION cas_syncnocas "Synchronisation ohne Nockenwellensignal für 3 Zylinder Motoren" /end FUNCTION
/begin FUNCTION cas_syncnocas_msg "" /end FUNCTION
/begin FUNCTION cas_syncnocas_uic "" /end FUNCTION
/begin FUNCTION cbacd ""
 /begin DEF_CHARACTERISTIC CBACD_ctPwrStgOnMax_C CBACD_numDia_C CBACD_numDioOut_C CBACD_stInvOut_C CBACD_stPwrStgActv_C CBACD_stPwrStgDia_C CBACD_stSPICtl_C CBACD_tiBtwTst_C CBACD_tiDebExcTempDef_C CBACD_tiDebExcTempOk_C CBACD_tiDebNoLoadDef_C CBACD_tiDebNoLoadOk_C CBACD_tiDebShortCircBatDef_C CBACD_tiDebShortCircBatOk_C CBACD_tiDebShortCircGndDef_C CBACD_tiDebShortCircGndOk_C CBACD_tiPwrStgOn_C /end DEF_CHARACTERISTIC
/end FUNCTION
/begin FUNCTION cbacd_uic "" /begin OUT_MEASUREMENT CBACD_stLogicOut_mp /end OUT_MEASUREMENT /end FUNCTION
/begin FUNCTION clg "Kühlung"
 /begin DEF_CHARACTERISTIC Clg_dtMinDynTst_C Clg_nMinEnaDynTst_C Clg_qMinEnaDynTst_C Clg_tiInitTmr_C Clg_tiMaxDynTst_CUR Clg_tMinClntDynTst_C /end DEF_CHARACTERISTIC
 /begin IN_MEASUREMENT Clg_tClntStrtVal_mp /end IN_MEASUREMENT
/end FUNCTION
/begin FUNCTION clg_msg ""
 /begin OUT_MEASUREMENT Clg_dtDynTst Clg_dtMinDynTst Clg_tEndDynTst Clg_tiDynTst Clg_tiMaxDynTst Clg_tMinClntDynTst /end OUT_MEASUREMENT
/end FUNCTION
/begin FUNCTION clg_uic "" /begin OUT_MEASUREMENT Clg_tClntStrtVal_mp /end OUT_MEASUREMENT /end FUNCTION
/begin FUNCTION cmbchb_misfire "Brennräume Fehlzündungserkennung"
 /begin DEF_CHARACTERISTIC CmbChb_nAvrgThrHi_C CmbChb_nAvrgThrLo_C CmbChb_qRawThrHi_C CmbChb_qRawThrLo_C CmbChb_tClntThrLo_C CmbChb_vThrHi_C CmbChb_tiDebClutchChng_C CmbChb_tiDlyStr_C CmbChb_ctEngRevPerBlk_C CmbChb_ctSegTDC1_C CmbChb_numBlk_C CmbChb_dnSegMin_C CmbChb_ctMisfireMax_C CmbChb_swtMonClutchVal_C CmbChb_swtMonClutchType_C /end DEF_CHARACTERISTIC
 /begin OUT_MEASUREMENT CmbChb_ctMifBuf1_mp CmbChb_ctMifBuf2_mp CmbChb_ctMifMem_mp /end OUT_MEASUREMENT
/end FUNCTION
/begin FUNCTION cmbchb_misfire_msg "" /begin OUT_MEASUREMENT CmbChb_st CmbChb_swtMonClutch /end OUT_MEASUREMENT /end FUNCTION
/begin FUNCTION cmbchb_misfire_uic ""
 /begin OUT_MEASUREMENT CmbChb_ctEngRevLogBuf1_mp CmbChb_ctEngRevLogBuf2_mp CmbChb_ctEngRevLogMem_mp CmbChb_ctEngRevPerBlk_mp CmbChb_dnSegMinPerCyl_mp CmbChb_nSegEven_mp CmbChb_nSegOdd_mp /end OUT_MEASUREMENT
/end FUNCTION
/begin FUNCTION cmbchb_tempcor "Brennraumtemperaturkorrektur"
 /begin DEF_CHARACTERISTIC CmbChb_facAPSCor_CUR CmbChb_facIATSCor_CUR CmbChb_nThres_C CmbChb_qThres_C CmbChb_rCorMax_C CmbChb_rTempCor_MAP CmbChb_rTiUpCor_CUR /end DEF_CHARACTERISTIC
 /begin IN_MEASUREMENT APSCD_pVal CmbChb_rEnvCor CmbChb_tiDwn_mp CmbChb_tiUp_mp IATSCD_tAir /end IN_MEASUREMENT
/end FUNCTION
/begin FUNCTION cmbchb_tempcor_msg ""
 /begin OUT_MEASUREMENT CmbChb_facEnvCor CmbChb_rEnvCor CmbChb_rTempCor CmbChb_stTempCor /end OUT_MEASUREMENT
/end FUNCTION
/begin FUNCTION cmbchb_tempcor_uic ""
 /begin OUT_MEASUREMENT CmbChb_facAPSCor_mp CmbChb_facIATSCor_mp CmbChb_rIniTiUp_mp CmbChb_rTiUpCor_mp CmbChb_tiDwn_mp CmbChb_tiUp_mp /end OUT_MEASUREMENT
/end FUNCTION
/begin FUNCTION codt_drvtrncord "Antriebs-Koordination"
 /begin DEF_CHARACTERISTIC CoDT_dtrqLimDwnCurr_C CoDT_dtrqLimDwnLead_C CoDT_dtrqLimUpCurr_C CoDT_dtrqLimUpLead_C CoDT_swtCoTypeVal_C CoDT_swtCoTypeType_C CoDT_tiTrqRedMaxCurr_C CoDT_tiTrqRedMaxLead_C /end DEF_CHARACTERISTIC
/end FUNCTION
/begin FUNCTION codt_drvtrncordlead_uic ""
 /begin OUT_MEASUREMENT CoDT_trqDTInDecLead_mp CoDT_trqDTInIncLead_mp CoDT_trqGearbxLead_mp /end OUT_MEASUREMENT
/end FUNCTION
/begin FUNCTION codt_drvtrncord_msg ""
 /begin OUT_MEASUREMENT CoDT_nMax CoDT_nMin CoDT_stOrd CoDT_swtCoType CoDT_trqAcsDes CoDT_trqCurr CoDT_trqDes CoDT_trqDTInCurr CoDT_trqDTInDes CoDT_trqDTInLead CoDT_trqGearbxDes CoDT_trqLead /end OUT_MEASUREMENT
/end FUNCTION
/begin FUNCTION codt_drvtrncord_uic "" /end FUNCTION
/begin FUNCTION codt_drvtrnmon ""
 /begin DEF_CHARACTERISTIC CoDT_tiDT1_C CoDT_dDT1Kd_C CoDT_tiTrqDesDebDef_C CoDT_tiTrqDesDebOk_C CoDT_trqDiffMaxDes_CUR CoDT_trqDiffMaxLead_CUR CoDT_tiTrqLeadDebDef_C CoDT_tiTrqLeadDebOk_C /end DEF_CHARACTERISTIC
 /begin IN_MEASUREMENT CoDT_dtrqDes_mp CoDT_dtrqLead_mp /end IN_MEASUREMENT
/end FUNCTION
/begin FUNCTION codt_drvtrnmon_uic ""
 /begin OUT_MEASUREMENT CoDT_dtrqDes_mp CoDT_dtrqLead_mp CoDT_trqDesDiff_mp CoDT_trqDiffMaxDes_mp CoDT_trqDiffMaxLead_mp CoDT_trqLeadDiff_mp /end OUT_MEASUREMENT
/end FUNCTION
/begin FUNCTION codt_grip "Kraftschluß innerhalb Antrieb"
 /begin DEF_CHARACTERISTIC CoDT_tiChkGrpDT1_C CoDT_dChkGrpDT1Kd_C CoDT_tiChkGrpPT1_C CoDT_dOfsGripDet_C CoDT_dOfsNoGripDet_C CoDT_dThetaGripDet_C CoDT_dThetaNoGripDet_C CoDT_swtNoGripDet_C CoDT_tiDebGearUnVal_C CoDT_tiDebNoGrip_C CoDT_tiGripDeb_C CoDT_vGrip_C /end DEF_CHARACTERISTIC
/end FUNCTION
/begin FUNCTION codt_grip_msg "" /begin OUT_MEASUREMENT CoDT_Grip CoDT_stGripDeb /end OUT_MEASUREMENT /end FUNCTION
/begin FUNCTION codt_grip_uic ""
 /begin OUT_MEASUREMENT CoDT_dnAbsEng_mp CoDT_dnEng_mp CoDT_dnGrip_mp CoDT_dnNoGrip_mp CoDT_stNoGripDet_mp CoDT_trqAbsGbxPT1_mp CoDT_trqGbxPT1_mp /end OUT_MEASUREMENT
/end FUNCTION
/begin FUNCTION codt_prptrqcurrcalc "Antriebsmoment-Berechnung" /end FUNCTION
/begin FUNCTION codt_prptrqcurrcalc_msg "" /begin OUT_MEASUREMENT CoDT_trq CoDT_trqCurrLim CoDT_trqGbx /end OUT_MEASUREMENT /end FUNCTION
/begin FUNCTION codt_prptrqcurrcalc_uic "" /begin OUT_MEASUREMENT CoDT_trqActAcs_mp /end OUT_MEASUREMENT /end FUNCTION
/begin FUNCTION codt_prptrqrngcalc "Bereitstellung Momentenintervall" /begin DEF_CHARACTERISTIC CoDT_swtAcsFltEna_C CoDT_tiFltPT1_C CoDT_trqMinInit_C /end DEF_CHARACTERISTIC /end FUNCTION
/begin FUNCTION codt_prptrqrngcalc_msg ""
 /begin OUT_MEASUREMENT CoDT_trqAcsMin CoDT_trqGbxMax CoDT_trqGbxMin CoDT_trqMax CoDT_trqMin /end OUT_MEASUREMENT
/end FUNCTION
/begin FUNCTION codt_prptrqrngcalc_uic "" /begin OUT_MEASUREMENT CoDT_trqAcsMax_mp CoDT_trqAcs_mp /end OUT_MEASUREMENT /end FUNCTION
/begin FUNCTION coeng_actrprt "Steuerung Stellerschutz" /begin DEF_CHARACTERISTIC CoEng_nActrRelease_C CoEng_tiActrPrt_C /end DEF_CHARACTERISTIC /end FUNCTION
/begin FUNCTION coeng_actrprt_uic "" /end FUNCTION
/begin FUNCTION coeng_aftrun ""
 /begin DEF_CHARACTERISTIC CoEng_stAftRunSel_C CoEng_tiDebnAvrgZero_C CoEng_tiPwrStgDiaRdy_C /end DEF_CHARACTERISTIC
/end FUNCTION
/begin FUNCTION coeng_aftrunextwait "Warten auf externe Ereignisse während Nachlauf"
 /begin DEF_CHARACTERISTIC CoEng_ExtWaitMsk2_C CoEng_ExtWaitMsk_C CoEng_tiMinAftRun_C CoEng_tiMRlyShutOffDel_C CoEng_tiWakeUp_C /end DEF_CHARACTERISTIC
/end FUNCTION
/begin FUNCTION coeng_aftrunextwait_msg "" /begin OUT_MEASUREMENT CoEng_stExtWait CoEng_stExtWait2 CoEng_tiMinAftRun /end OUT_MEASUREMENT /end FUNCTION
/begin FUNCTION coeng_aftrunextwait_uic "" /end FUNCTION
/begin FUNCTION coeng_aftrun_msg "" /begin OUT_MEASUREMENT CoEng_stAftRun CoEng_stAftRunPath /end OUT_MEASUREMENT /end FUNCTION
/begin FUNCTION coeng_aftrun_uic "" /begin OUT_MEASUREMENT CoEng_stEEPStore_mp CoEng_stnAvrgZero_mp /end OUT_MEASUREMENT /end FUNCTION
/begin FUNCTION coeng_flconsum "Verbrauchsberechnung"
 /begin DEF_CHARACTERISTIC CoEng_dqSubsRgnRmpUp_C CoEng_dqSubsRgnRmpDwn_C CoEng_facFlConsumAdjDfl_C CoEng_facFlConsumAdjMax_C CoEng_facFlConsumAdjMin_C CoEng_qSubs_MAP CoEng_rhoFuel_C CoEng_stSubsRgnMsk_C /end DEF_CHARACTERISTIC
 /begin IN_MEASUREMENT CoEng_trq Eng_nAvrg /end IN_MEASUREMENT
/end FUNCTION
/begin FUNCTION coeng_flconsum_uic ""
 /begin OUT_MEASUREMENT CoEng_dvolPerStroke_mp CoEng_facFlConsumAdj_mp CoEng_qSubs_mp CoEng_qSum_mp CoEng_volFlConsumAdj_mp /end OUT_MEASUREMENT
/end FUNCTION
/begin FUNCTION coeng_flconsum_var "" /end FUNCTION
/begin FUNCTION coeng_flconsum_var_msg "" /end FUNCTION
/begin FUNCTION coeng_mon "Abschaltkoordinator"
 /begin DEF_CHARACTERISTIC CoEng_stIRevShutOff_C CoEng_stRevShutOff_C CoEng_stShOffAddReqIRev_C CoEng_stShOffAddReqRev_C CoEng_stShOffAirbFrnt_C CoEng_stShOffAirbRear_C CoEng_stShOffAirbSide_C CoEng_stShOffDblCtl_C CoEng_stShOffDiaReqFI_C CoEng_stShOffInit_C CoEng_stShOffInjMon_C CoEng_stShOffInjShCir_C CoEng_stShOffIRevSys1_C CoEng_stShOffIRevSys2_C CoEng_stShOffIRevVeh_C CoEng_stShOffIrrCmb_C CoEng_stShOffOvrSpd_C CoEng_stShOffPresMin_C CoEng_stShOffRevSys1_C CoEng_stShOffRevSys2_C CoEng_stShOffRevVeh_C CoEng_stShOffRlOvrBar_C CoEng_stShOffSV_C /end DEF_CHARACTERISTIC
/end FUNCTION
/begin FUNCTION coeng_monaddreq "Kundenspezifische Abschaltanforderungen an Abschaltkoordinator" /end FUNCTION
/begin FUNCTION coeng_monaddreq_msg "" /begin OUT_MEASUREMENT CoEng_stShOffAddReqIRev CoEng_stShOffAddReqRev /end OUT_MEASUREMENT /end FUNCTION
/begin FUNCTION coeng_monaddreq_uic "" /end FUNCTION
/begin FUNCTION coeng_mon_uic "" /end FUNCTION
/begin FUNCTION coeng_msg ""
 /begin OUT_MEASUREMENT CoEng_dvolFlConsum CoEng_facAdj CoEng_nMax CoEng_nMin CoEng_stDisable CoEng_stIRevShutOff CoEng_stMonActrPrt CoEng_stMonShOff CoEng_stOvrFul CoEng_stOvrRun CoEng_stPwrDwn CoEng_stPwrStgEnaCond CoEng_stRevShutOff CoEng_stShutOff CoEng_stShutOffPath CoEng_stTrqLimErr CoEng_stTrqLimErr1 CoEng_stTrqLimErr2 CoEng_stTrqLimErr3 CoEng_stTrqLimErr4 CoEng_stTrqLimPFltErr CoEng_stTrqLimPFltOvldErr CoEng_tiWakeUp CoEng_trq CoEng_trqCorGearbxRgn CoEng_trqCurrLim CoEng_trqInrCurr CoEng_trqInrCurrFast CoEng_trqInrDes CoEng_trqInrDesFast CoEng_trqInrDesSlow CoEng_trqInrLim CoEng_trqInrLimDes CoEng_trqInrLimLead CoEng_trqInrLtd CoEng_trqInrRaw CoEng_trqInrSet CoEng_trqLiLtd CoEng_trqLimErr CoEng_trqLimErr1 CoEng_trqLimErr2 CoEng_trqLimErr3 CoEng_trqLimErr4 CoEng_trqLimPDiff CoEng_trqLimPFltErr CoEng_trqLimPFltOvldErr CoEng_trqLimSwt CoEng_trqMax CoEng_trqMin CoEng_trqOvrFul CoEng_trqSlpLim CoEng_volFlConsum CoEng_voltotFlConsum /end OUT_MEASUREMENT
/end FUNCTION
/begin FUNCTION coeng_ovrruncoord "Schubkoordinator"
 /begin DEF_CHARACTERISTIC CoEng_lSumFuncPref_C CoEng_numSelFuncPref_C CoEng_facActvFunc2_1_C CoEng_facActvFunc2_2_C CoEng_facActvFunc2_3_C CoEng_facActvFunc2_4_C CoEng_facActvFunc2_5_C CoEng_facActvFunc2_6_C CoEng_facActvFunc2_7_C CoEng_facActvFunc2_8_C CoEng_facActvFunc1_C CoEng_facActvFunc2_C CoEng_facActvFunc3_C CoEng_facActvFunc4_C CoEng_facActvFunc5_C CoEng_facActvFunc6_C CoEng_facActvFunc7_C CoEng_facActvFunc8_C CoEng_stCoopCapbl_C CoEng_stOvrRunRgnMsk_C CoEng_tiOvrRunCoordDebPos_C CoEng_tiThresFuncPref_C /end DEF_CHARACTERISTIC
/end FUNCTION
/begin FUNCTION coeng_ovrruncoord_msg "" /begin OUT_MEASUREMENT CoEng_stOvrRunCoord CoEng_stZFCEmissionRoll /end OUT_MEASUREMENT /end FUNCTION
/begin FUNCTION coeng_ovrruncoord_uic ""
 /begin OUT_MEASUREMENT CoEng_CoordPrioFld_mp CoEng_stCoordFuncFld_mp CoEng_stCoordFuncPref_mp CoEng_stOvrRunEGT_mp /end OUT_MEASUREMENT
/end FUNCTION
/begin FUNCTION coeng_pwrstgstatecalc "Endstufenkoordinator"
 /begin DEF_CHARACTERISTIC CoEng_tiDlyT15_C CoEng_uHighBattPwrStgHysHi_C CoEng_uHighBattPwrStgHysLo_C CoEng_uLowBattPwrStgHysHi_C CoEng_uLowBattPwrStgHysLo_C /end DEF_CHARACTERISTIC
/end FUNCTION
/begin FUNCTION coeng_pwrstgstatecalc_uic "" /begin OUT_MEASUREMENT CoEng_stDlyT15_mp /end OUT_MEASUREMENT /end FUNCTION
/begin FUNCTION coeng_shoff "Abstellsteuerung im Nachlauf"
 /begin DEF_CHARACTERISTIC CoEng_nSoftShOffMax_C CoEng_nSoftShOffMin_C CoEng_qSoftShOffMax_C CoEng_stShOffAftRun_C CoEng_stShOffExtReq_C CoEng_stShOffTstSel_C CoEng_stSoftShOffAR_C CoEng_tiShOffTstFlSys_C CoEng_tiSoftShOff_CUR CoEng_vSoftShOffMax_C /end DEF_CHARACTERISTIC
 /begin IN_MEASUREMENT Eng_nAvrg /end IN_MEASUREMENT
/end FUNCTION
/begin FUNCTION coeng_shofflib ""
 /begin DEF_CHARACTERISTIC CoEng_nShOffTstMax_C CoEng_nShOffTstMin_C CoEng_tShOffTstMin_C CoEng_vShOffTstMin_C /end DEF_CHARACTERISTIC
/end FUNCTION
/begin FUNCTION coeng_shofflib_uic "" /end FUNCTION
/begin FUNCTION coeng_shoff_msg "" /begin OUT_MEASUREMENT CoEng_numShOffTstNewSel CoEng_pRailT15Off CoEng_stShOffTst /end OUT_MEASUREMENT /end FUNCTION
/begin FUNCTION coeng_shoff_uic "" /begin OUT_MEASUREMENT CoEng_stShOffTstOldRes_mp CoEng_tiSoftShOff_mp /end OUT_MEASUREMENT /end FUNCTION
/begin FUNCTION coeng_steng "aktueller Motorzustand [-]" /begin DEF_CHARACTERISTIC CoEng_nThresNrml2Strt_C CoEng_tiNrml2Strt_C /end DEF_CHARACTERISTIC /end FUNCTION
/begin FUNCTION coeng_steng_msg ""
 /begin OUT_MEASUREMENT CoEng_stEng CoEng_stEngOld CoEng_tiAfterrun CoEng_tiAfterrunRed CoEng_tiNormal CoEng_tiNormalRed CoEng_tiStart CoEng_tiStartRed /end OUT_MEASUREMENT
/end FUNCTION
/begin FUNCTION coeng_steng_uic "" /end FUNCTION
/begin FUNCTION coeng_sttrqlimcalc "" /end FUNCTION
/begin FUNCTION coeng_sttrqlimcalc_msg ""
 /begin OUT_MEASUREMENT CoEng_rTrq CoEng_stCurrLim CoEng_stCurrLimActive CoEng_trqInrCurrLim /end OUT_MEASUREMENT
/end FUNCTION
/begin FUNCTION coeng_sttrqlimcalc_uic "" /begin OUT_MEASUREMENT CoEng_trqInrGearbxInMax_mp CoEng_trqInrPrpLimErr_mp /end OUT_MEASUREMENT /end FUNCTION
/begin FUNCTION coeng_trqcalc "Motormomentenberechnung"
 /begin DEF_CHARACTERISTIC CoEng_dtrqRmpUp_C CoEng_dtrqRmpDwn_C CoEng_swtSelOvRMonSync_C CoEng_tiRmpStrtDfl_C CoEng_tiRmpStrt_CUR CoEng_tiSwtOffDfl_C CoEng_tiSwtOff_CUR CoEng_trqInrSetLim_CUR CoEng_trqOffs_C CoEng_trqOvrRunThres_C /end DEF_CHARACTERISTIC
 /begin IN_MEASUREMENT CoEng_tiOvRMon_mp DrvTrn_rTransDT /end IN_MEASUREMENT
/end FUNCTION
/begin FUNCTION coeng_trqcalclead "" /end FUNCTION
/begin FUNCTION coeng_trqcalclead_uic ""
 /begin OUT_MEASUREMENT CoEng_trqInrCurrFastBase_mp CoEng_trqInrDesFastBase_mp CoEng_trqInrDesFastUnLim_mp /end OUT_MEASUREMENT
/end FUNCTION
/begin FUNCTION coeng_trqcalc_msg ""
 /begin OUT_MEASUREMENT CoEng_ctUnpla CoEng_stLayer12 CoEng_tiRmpStrt CoEng_tiSwtOff CoEng_trqASDdcInit CoEng_trqASDrfInit CoEng_trqInrLiDesSlw CoEng_trqLimOffs /end OUT_MEASUREMENT
/end FUNCTION
/begin FUNCTION coeng_trqcalc_uic ""
 /begin OUT_MEASUREMENT CoEng_stRmp_mp CoEng_tiOvRMon_mp CoEng_trqBefRmp_mp CoEng_trqInrCurrPre_mp CoEng_trqInrDesSlowBase_mp CoEng_trqInrDesSlowUnLim_mp CoEng_trqInrRawPre_mp CoEng_trqInrSetLim_mp CoEng_trqInrSetUnLtd_mp CoEng_trqLimOffs_mp CoEng_trqRmp_mp CoEng_trqSetASDdc_mp /end OUT_MEASUREMENT
/end FUNCTION
/begin FUNCTION coeng_trqcalc_var "" /end FUNCTION
/begin FUNCTION coeng_trqcalc_var_uic "" /end FUNCTION
/begin FUNCTION coeng_trqlim "Momentenbegrenzung als Motormoment"
 /begin DEF_CHARACTERISTIC CoEng_dnOvrFulMin_C CoEng_dnOvrFulMax_C CoEng_stdnOvrFulLow_C CoEng_stdnOvrFulHigh_C CoEng_dtrqEngPrtRgnMonUp_C CoEng_dtrqEngPrtRgnMonDwn_C CoEng_dtrqLimUp_C CoEng_dtrqLimDwn_C CoEng_dtrqLimUp1_C CoEng_dtrqLimDwn1_C CoEng_dtrqLimUp2_C CoEng_dtrqLimDwn2_C CoEng_dtrqLimUp3_C CoEng_dtrqLimDwn3_C CoEng_dtrqLimUp4_C CoEng_dtrqLimDwn4_C CoEng_dtrqPFltOvldUp_C CoEng_dtrqPFltOvldDwn_C CoEng_tiOvrFulDT1_C CoEng_facOvrFulDKd_C CoEng_facAdjDfl_C CoEng_facAdjMax_C CoEng_facAdjMin_C CoEng_DebDef_GbxRpmRduc_C CoEng_DebOk_GbxRpmRduc_C CoEng_nOvrFulMax_C CoEng_nOvrFulMin_C CoEng_tiPFltdVolPT1_C CoEng_tiPFltResFlowPT1_C CoEng_dtrqOvrFulUp_C CoEng_dtrqOvrFulDown_C CoEng_rOvrFulMin_C CoEng_rOvrFulMax_C CoEng_strOvrFulLow_C CoEng_strOvrFulHigh_C CoEng_stHealRDucDoc_MAP CoEng_stPFltLimMsk_C CoEng_swtPPreCat_C CoEng_swtSensOvld_C CoEng_tiPFltOvldOk_C CoEng_tiRepOvrFul_C CoEng_tPFltOvldLim_C CoEng_trqCorGearbxRgn_CUR CoEng_trqLimErr1_CUR CoEng_trqLimErr2_CUR CoEng_trqLimErr3_CUR CoEng_trqLimErr4_CUR CoEng_trqLimErr_CUR CoEng_trqLimPDiff1_CUR CoEng_trqLimPDiffNOffs_CUR CoEng_trqLimPDiff_MAP CoEng_trqLimPFltOvld_MAP CoEng_trqOvrFulMax_C CoEng_trqOvrFulMin_C CoEng_vOvrFulMin_C CoEng_vOvrFulMax_C CoEng_stvOvrFulLow_C CoEng_stvOvrFulHigh_C /end DEF_CHARACTERISTIC
 /begin IN_MEASUREMENT CoEng_pDiffPFltPrdc2_mp CoEng_tPFltCDMax_mp CoEng_trqInrSet Eng_nAvrg PFlt_pDiff /end IN_MEASUREMENT
/end FUNCTION
/begin FUNCTION coeng_trqlim_uic ""
 /begin OUT_MEASUREMENT CoEng_dnEngnAvrg_mp CoEng_dVolFlt_mp CoEng_pDiffPFltPrdc2_mp CoEng_pDiffPFltPrdc_mp CoEng_resFlowFlt_mp CoEng_tOvldMax_mp CoEng_tPFltCDMax_mp CoEng_trqInrLimLead0_mp CoEng_trqInrLimLead1_mp CoEng_trqInrLimLead2_mp CoEng_trqLimMinEEPVal_mp CoEng_trqLimMin_mp CoEng_trqLimPDiffNOffs_mp CoEng_trqLimPFlt1_mp CoEng_trqLimPFltOvld_mp CoEng_trqLimSwt1_mp CoEng_trqLimSwt2_mp CoEng_trqLimSwt3_mp CoEng_trqLimSwt4_mp /end OUT_MEASUREMENT
/end FUNCTION
/begin FUNCTION coeng_trqslplim "Begrenzungsmoment für Rauchbegrenzung nach Turboschubbegrenzung"
 /begin DEF_CHARACTERISTIC CoEng_nSlpLimMin_C CoEng_dtrqSlpLimUpdef_C CoEng_dtrqSlpLimDwndef_C CoEng_dtrqSlpLimUp1_C CoEng_dtrqSlpLimDwn1_C CoEng_dtrqSlpLimUp2_C CoEng_dtrqSlpLimDwn2_C CoEng_dtrqSlpLimUp3_C CoEng_dtrqSlpLimDwn3_C CoEng_dtrqSlpLimUp4_C CoEng_dtrqSlpLimDwn4_C CoEng_dtrqSlpLimUp5_C CoEng_dtrqSlpLimDwn5_C CoEng_dtrqSlpLimUp6_C CoEng_dtrqSlpLimDwn6_C CoEng_dtrqSlpLimUpREV_C CoEng_dtrqSlpLimDwnREV_C /end DEF_CHARACTERISTIC
/end FUNCTION
/begin FUNCTION coeng_trqslplim_uic "" /begin DEF_CHARACTERISTIC CoEng_trqSlpLim_Vector CoEng_trqSlpLim_Channel /end DEF_CHARACTERISTIC /end FUNCTION
/begin FUNCTION coeng_tstco "Motortestkoordinator" /begin DEF_CHARACTERISTIC CoEng_tiTstMax_C /end DEF_CHARACTERISTIC /end FUNCTION
/begin FUNCTION coeng_tstco_msg "" /begin OUT_MEASUREMENT CoEng_stTst /end OUT_MEASUREMENT /end FUNCTION
/begin FUNCTION coeng_var "" /end FUNCTION
/begin FUNCTION coeng_var_ers "" /end FUNCTION
/begin FUNCTION coeng_var_ers_msg "" /end FUNCTION
/begin FUNCTION coeng_var_ers_uic "" /end FUNCTION
/begin FUNCTION combas_msg "" /begin OUT_MEASUREMENT ComBas_stDiaReq /end OUT_MEASUREMENT /end FUNCTION
/begin FUNCTION conf_proj "" /end FUNCTION
/begin FUNCTION convcd_co "Komponententreiber zur Mapping Funktion auf Struktur"
 /begin DEF_CHARACTERISTIC ConvCD_DebPlaDef_C ConvCD_DebPlaOk_C ConvCD_tiDebPos_C ConvCD_tiDebNeg_C ConvCD_DebSigDef_C ConvCD_DebSigOk_C ConvCD_nNoGearShftDet_C ConvCD_numDioIn_C ConvCD_numStepDef_C ConvCD_numStepOK_C ConvCD_stDflVal_C ConvCD_stGripCtlAST_C ConvCD_swtInv_C ConvCD_swtSigVal_C ConvCD_tiGearShft_C ConvCD_vNoGearShftDet_C /end DEF_CHARACTERISTIC
/end FUNCTION
/begin FUNCTION convcd_co_uic "" /begin OUT_MEASUREMENT ConvCD_ctClutchDfct_mp /end OUT_MEASUREMENT /end FUNCTION
/begin FUNCTION convcd_msg ""
 /begin OUT_MEASUREMENT ConvCD_stClth ConvCD_stClthRaw ConvCD_stClutchRecord ConvCD_stDebVal ConvCD_stIntDebVal ConvCD_stLastDebVal ConvCD_stLastGear ConvCD_stOldGear ConvCD_stRawVal ConvCD_swtSig /end OUT_MEASUREMENT
/end FUNCTION
/begin FUNCTION conv_grip "Function to calculate converter amplification factor" /end FUNCTION
/begin FUNCTION conv_grip_msg "" /begin OUT_MEASUREMENT Conv_rTrans /end OUT_MEASUREMENT /end FUNCTION
/begin FUNCTION coveh_acsmng "Koordination Nebenaggregate" /begin DEF_CHARACTERISTIC CoVeh_dnLI_C /end DEF_CHARACTERISTIC /end FUNCTION
/begin FUNCTION coveh_acsmng_msg ""
 /begin OUT_MEASUREMENT CoVeh_nAcsMax CoVeh_nAcsMin CoVeh_nLimEngSpd CoVeh_pwrAcsDes CoVeh_pwrAcsLead CoVeh_trqAcs CoVeh_trqAcsDes CoVeh_trqAcsLead CoVeh_trqAcsPerm CoVeh_trqAcsTemp /end OUT_MEASUREMENT
/end FUNCTION
/begin FUNCTION coveh_acsmng_uic "" /begin OUT_MEASUREMENT CoVeh_pwrAcsTempLim_mp CoVeh_trqAcsLimCrSDes_mp /end OUT_MEASUREMENT /end FUNCTION
/begin FUNCTION coveh_drvtrnord "Auftrag für Antrieb" /begin DEF_CHARACTERISTIC CoVeh_dtrqLimDwn_C CoVeh_dtrqLimUp_C CoVeh_trqLim_CUR /end DEF_CHARACTERISTIC /begin IN_MEASUREMENT Eng_nAvrg /end IN_MEASUREMENT /end FUNCTION
/begin FUNCTION coveh_drvtrnordlead_uic "" /begin DEF_CHARACTERISTIC CoVeh_trqPrpLead_Vector CoVeh_trqPrpLead_Channel /end DEF_CHARACTERISTIC /end FUNCTION
/begin FUNCTION coveh_drvtrnord_msg ""
 /begin OUT_MEASUREMENT CoVeh_nMax CoVeh_nMin CoVeh_stOrd CoVeh_trqPrpDes CoVeh_trqPrpLead CoVeh_trqPrpLimErr /end OUT_MEASUREMENT
/end FUNCTION
/begin FUNCTION coveh_drvtrnord_uic "" /begin DEF_CHARACTERISTIC CoVeh_trqPrpDes_Vector CoVeh_trqPrpDes_Channel /end DEF_CHARACTERISTIC /end FUNCTION
/begin FUNCTION covm_demcheck "Vortriebsstabilisierungsprüfung"
 /begin DEF_CHARACTERISTIC CoVM_amMAX_C CoVM_swtPlausChkVal_C CoVM_swtPlausChkType_C CoVM_swtSlipCtlVal_C CoVM_swtSlipCtlType_C CoVM_tiDebMaxOk_C CoVM_tiDebMaxDef_C /end DEF_CHARACTERISTIC
/end FUNCTION
/begin FUNCTION covm_demcheck_msg "" /begin OUT_MEASUREMENT CoVM_stDemCheck CoVM_swtSlipCtl /end OUT_MEASUREMENT /end FUNCTION
/begin FUNCTION covm_demcheck_uic ""
 /begin OUT_MEASUREMENT CoVM_amAct_mp CoVM_stDCSh_mp CoVM_stDemUnplaus_mp CoVM_trqInt_mp /end OUT_MEASUREMENT
/end FUNCTION
/begin FUNCTION covm_demcord "Anforderungskoordination"
 /begin DEF_CHARACTERISTIC CoVM_dtrqLeadCorUp_C CoVM_dtrqLeadCorDwn_C CoVM_swtIntvPrio_C CoVM_swtTrqDesSel_C CoVM_swttrqDVCH_C CoVM_tiTrqRedMax_C /end DEF_CHARACTERISTIC
/end FUNCTION
/begin FUNCTION covm_demcordlead_uic "" /begin OUT_MEASUREMENT CoVM_trqLeadIncMax_mp /end OUT_MEASUREMENT /end FUNCTION
/begin FUNCTION covm_demcord_msg ""
 /begin OUT_MEASUREMENT CoVM_stActDem CoVM_stOrd CoVM_stTrqLeadFrz CoVM_trqDVCH CoVM_trqGearbxMax CoVM_trqGearbxMin CoVM_trqPrpDes CoVM_trqPrpLead /end OUT_MEASUREMENT
/end FUNCTION
/begin FUNCTION covm_demcord_uic "" /begin OUT_MEASUREMENT CoVM_trqDesIncMax_mp Prp_trqMaxDes_mp /end OUT_MEASUREMENT /end FUNCTION
/begin FUNCTION covm_stabdem "Vortriebsstabilisierung"
 /begin DEF_CHARACTERISTIC CoVM_trqDecMax_C CoVM_dtrqLimUpDec_C CoVM_dtrqLimDwnDec_C CoVM_trqIncMin_C CoVM_dtrqLimUpInc_C CoVM_dtrqLimDwnInc_C /end DEF_CHARACTERISTIC
/end FUNCTION
/begin FUNCTION covm_stabdem_msg "" /begin OUT_MEASUREMENT CoVM_trqDec CoVM_trqInc /end OUT_MEASUREMENT /end FUNCTION
/begin FUNCTION covm_stabdem_uic "" /begin OUT_MEASUREMENT CoVM_trqDecSetVal_mp CoVM_trqIncSetVal_mp /end OUT_MEASUREMENT /end FUNCTION
/begin FUNCTION cpbvlv_logic ""
 /begin DEF_CHARACTERISTIC CpBVlv_numGear_C CpBVlv_qCloseRgn_MAP CpBVlv_qClose_MAP CpBVlv_qOpnRgn_MAP CpBVlv_qOpn_MAP CpBVlv_stClose_C CpBVlv_stOpn_C CpBVlv_stRgnMsk_C CpBVlv_swtErrOff_C CpBVlv_swtQDesVal_C CpBVlv_tiRmpSlp_C /end DEF_CHARACTERISTIC
 /begin IN_MEASUREMENT APSCD_pVal Eng_nAvrg /end IN_MEASUREMENT
/end FUNCTION
/begin FUNCTION cpbvlv_logic_msg "" /begin OUT_MEASUREMENT CpBVlv_stLogic CpBVlv_stOpn /end OUT_MEASUREMENT /end FUNCTION
/begin FUNCTION cpbvlv_logic_uic "" /begin OUT_MEASUREMENT CpBVlv_qClose_mp CpBVlv_qOpn_mp CpBVlv_stOff_mp /end OUT_MEASUREMENT /end FUNCTION
/begin FUNCTION crccd_keydet "Bedienteilerfassung Fahrgeschwindigkeitsregler"
 /begin DEF_CHARACTERISTIC CrCCD_tiDebMaxMFLDef_C CrCCD_tiDebMaxMFLOk_C CrCCD_tiDebMinMFLDef_C CrCCD_tiDebMinMFLOk_C CrCCD_tiDebNplMFLDef_C CrCCD_tiDebNplMFLOk_C CrCCD_tiDebSigMFLDef_C CrCCD_tiDebSigMFLOk_C CrCCD_stMSWModeAdjMax_C CrCCD_stMSWModeAdjMin_C CrCCD_stMSWModeDflt_C CrCCD_swtDevType_C CrCCD_swtDevVal_C CrCCD_swtMSWType_C CrCCD_swtMSWVal_C CrCCD_tiDebSetMn_C CrCCD_tiDebSetPl_C CrCCD_tiToggleMax_C /end DEF_CHARACTERISTIC
/end FUNCTION
/begin FUNCTION crccd_keydet_msg ""
 /begin OUT_MEASUREMENT CrCCD_stDev CrCCD_stKey CrCCD_stKeyOff CrCCD_swtDev CrCCD_swtMSW /end OUT_MEASUREMENT
/end FUNCTION
/begin FUNCTION crccd_keydet_uic "" /begin OUT_MEASUREMENT CrCCD_dMFLData_mp /end OUT_MEASUREMENT /end FUNCTION
/begin FUNCTION crctl_detcrctl "" /end FUNCTION
/begin FUNCTION crctl_detcrctl_msg "" /begin OUT_MEASUREMENT CrCtl_stRecFGR /end OUT_MEASUREMENT /end FUNCTION
/begin FUNCTION crctl_detcrctl_uic "" /end FUNCTION
/begin FUNCTION crctl_msg "" /begin OUT_MEASUREMENT CrCtl_stActive CrCtl_trqDes CrCtl_trqLead /end OUT_MEASUREMENT /end FUNCTION
/begin FUNCTION crctl_sendvmrk "Aufbereitung Stufentempomatinformation für Kombi" /begin DEF_CHARACTERISTIC TMSGSGTMN /end DEF_CHARACTERISTIC /end FUNCTION
/begin FUNCTION crctl_sendvmrk_msg ""
 /begin OUT_MEASUREMENT B_acmsggts B_cmsggts B_ergacgt B_mrkvff indexmrst tnomgs60ms vmrki1_w vmrki2_w vmrki3_w /end OUT_MEASUREMENT
/end FUNCTION
/begin FUNCTION crctl_sendvmrk_uic "" /end FUNCTION
/begin FUNCTION crctl_shutoff "FGR-Abschaltung"
 /begin DEF_CHARACTERISTIC CrCtl_aAccMax_C CrCtl_aDecMax_C CrCtl_nMaxAlw_C CrCtl_nMinAlw_C CrCtl_rVnDvtShutOff_C CrCtl_stShutOffCodeMsk_C CrCtl_stShutOffHDC_C CrCtl_stShutOffInfoLR_C CrCtl_stShutOffLR_C CrCtl_swtSelKombi_C CrCtl_swtShutOffOpt_C CrCtl_tiAcc_C CrCtl_tiAqpl_C CrCtl_tiClCtrDelayABS_C CrCtl_tiClCtrDelayASC_C CrCtl_tiClCtrDelayDSC_C CrCtl_tiClCtrDelayEBV_C CrCtl_tiClCtrDelayHBA_C CrCtl_tiClCtrDelayMSR_C CrCtl_tiDec_C CrCtl_tiGearDeb_C CrCtl_tiNegDvtTi_C CrCtl_vDiffAqpl_C CrCtl_vMaxShutOff_C CrCtl_vMinShutOff_C CrCtl_vNegDvtTi_C CrCtl_vNegDvt_C CrCtl_vPosDvt_C /end DEF_CHARACTERISTIC
/end FUNCTION
/begin FUNCTION crctl_shutoff_msg "" /begin OUT_MEASUREMENT CrCtl_numGear CrCtl_stShutOffCode /end OUT_MEASUREMENT /end FUNCTION
/begin FUNCTION crctl_shutoff_uic ""
 /begin OUT_MEASUREMENT CrCtl_stBrkBeforeCruise_mp CrCtl_stClCtr_mp CrCtl_stShutOffCode1_mp CrCtl_stShutOffCode2_mp CrCtl_stShutOffFrz1_mp CrCtl_stShutOffFrz2_mp CrCtl_stShutOffFrz_mp /end OUT_MEASUREMENT
/end FUNCTION
/begin COMPU_METHOD Acc "Fahrzeugbeschleunigung" RAT_FUNC "%6.5" "m/s^2" COEFFS 0 1000 0 0 0 1 /end COMPU_METHOD
/begin COMPU_METHOD AngleCaS "Winkel Nockenwelle" RAT_FUNC "%6.4" "deg CaS" COEFFS 0 85.3333333333334 0 0 0 1 /end COMPU_METHOD
/begin COMPU_METHOD AngleCrS "Winkel Kurbelwelle" RAT_FUNC "%6.4" "deg CrS" COEFFS 0 42.6666666666667 0 0 0 1 /end COMPU_METHOD
/begin COMPU_METHOD B_TRUE "Umrechnung   ----> FALSE;    TRUE = TRUE" TAB_VERB "%6.3" "-" COMPU_TAB_REF B_TRUE /end COMPU_METHOD
/begin COMPU_VTAB B_TRUE "Umrechnung   ----> FALSE;    TRUE = TRUE" TAB_VERB 2 0 "----" 1 "TRUE" /end COMPU_VTAB
/begin COMPU_METHOD CubMtrPerHr "Volumsstrom in m^3/h" RAT_FUNC "%6.3" "m^3/h" COEFFS 0 10 0 0 0 1 /end COMPU_METHOD
/begin COMPU_METHOD Curr_10mA "Spannung in mA" RAT_FUNC "%6.1" "mA" COEFFS 0 0.1 0 0 0 1 /end COMPU_METHOD
/begin COMPU_METHOD dez "K3 Umwandlungen" RAT_FUNC "%6.2" "-" COEFFS 0 1 0 0 0 1 /end COMPU_METHOD
/begin COMPU_METHOD dFlConsum "Ableitung des Kraftstoffverbrauchs" RAT_FUNC "%6.4" "l/h/s" COEFFS 0 100 0 0 0 1 /end COMPU_METHOD
/begin COMPU_METHOD Dia "Durchmesser des Rades" RAT_FUNC "%7.6" "m" COEFFS 0 10000 0 0 0 1 /end COMPU_METHOD
/begin COMPU_METHOD dn_dZ20 "Motorbeschleunigung pro Zeit (dn/dt) (im 20 ms Raster)" RAT_FUNC "%6.1" "rpm/s" COEFFS 0 0.1 0 0 0 1 /end COMPU_METHOD
/begin COMPU_METHOD dn_dZfine "Engine acceleration per time (dn/dt) fine resolution" RAT_FUNC "%6.2" "rpm/s" COEFFS 0 1 0 0 0 1 /end COMPU_METHOD
/begin COMPU_METHOD dTrq "Umrtechnungsformel dTrq/dTime" RAT_FUNC "%6.3" "Nm/s" COEFFS 0 10 0 0 0 1 /end COMPU_METHOD
/begin COMPU_METHOD dTrqPrp_20ms "Anstieg Vortriebsmoment im 20 ms Raster" RAT_FUNC "%6.1" "Nm/s" COEFFS 0 0.1 0 0 0 1 /end COMPU_METHOD
/begin COMPU_METHOD EngN "Motordrehzahl" RAT_FUNC "%6.2" "rpm" COEFFS 0 1 0 0 0 1 /end COMPU_METHOD
/begin COMPU_METHOD Fact "Faktor mit Auflösung 1 / 8192, hauptsächlich für einen Faktorenbereich 0...1 verwendet" RAT_FUNC "%6.5" "-" COEFFS 0 8192 0 0 0 1 /end COMPU_METHOD
/begin COMPU_METHOD Fact1 "Faktor mit Auflösung 0,01 (100 mal höherer Bereich als Fact)" RAT_FUNC "%6.4" "-" COEFFS 0 128 0 0 0 1 /end COMPU_METHOD
/begin COMPU_METHOD FlConsum_l_h "Kraftstoffverbrauch" RAT_FUNC "%6.4" "l/h" COEFFS 0 100 0 0 0 1 /end COMPU_METHOD
/begin COMPU_METHOD FlConsum_ul "Verbrauchsintegral (in Mikroliter)" RAT_FUNC "%6.2" "ul" COEFFS 0 1 0 0 0 1 /end COMPU_METHOD
/begin COMPU_METHOD FlConsum_ul_20ms "Verbrauchsintegral (in Mikroliter pro 20ms)" RAT_FUNC "%6.2" "ul/20ms" COEFFS 0 1 0 0 0 1 /end COMPU_METHOD
/begin COMPU_METHOD InjMass "Einspritzmenge" RAT_FUNC "%6.4" "mg/hub" COEFFS 0 100 0 0 0 1 /end COMPU_METHOD
/begin COMPU_METHOD InjMassCyc "Einspritzmenge pro Zyklus (mg/Zyklus)" RAT_FUNC "%6.4" "mg/cyc" COEFFS 0 100 0 0 0 1 /end COMPU_METHOD
/begin COMPU_METHOD InjQnt "Einspritzvolumen/Hub" RAT_FUNC "%6.3" "mm^3/hub" COEFFS 0 10 0 0 0 1 /end COMPU_METHOD
/begin COMPU_METHOD Kd "Differentialverstärkung Kd (gleiche Einheit/Umrechnungsformel an Ein- und Ausgang)" RAT_FUNC "%7.6" "1/1" COEFFS 0 65536 0 0 0 1 /end COMPU_METHOD
/begin COMPU_METHOD Kd_rpm2dndt "differential gain(engine speed to rate of change of engine speed)" RAT_FUNC "%8.7" "rmp/sec/rpm" COEFFS 0 131072 0 0 0 1 /end COMPU_METHOD
/begin COMPU_METHOD Length "Länge in Meter" RAT_FUNC "%6.2" "m" COEFFS 0 1 0 0 0 1 /end COMPU_METHOD
/begin COMPU_METHOD Moment_Inertia "Moment of Inertia" RAT_FUNC "%6.4" "kg * m^2" COEFFS 0 100 0 0 0 1 /end COMPU_METHOD
/begin COMPU_METHOD NumPinDia "Verbale Umrechnung für Diagnose Signale" TAB_VERB "%6.3" "-" COMPU_TAB_REF NumPinDia /end COMPU_METHOD
/begin COMPU_VTAB NumPinDia "Verbale Umrechnung für Diagnose Signale" TAB_VERB 34 0 "CJ945_Diagnostic_Signal" 1 "AC_Compressor_DiaSig" 2 "Fuel_Pump_DiaSig" 3 "Starter_234" 4 "Radiator_Blind_Control_Diagnostic_Signal" 5 "Engine_Bay_Air_Flaps/Compressor_Bypass_123" 6 "Glow_Relay_Diagnostic_Signal1" 7 "EngM_Bearing_Actuator_Diagnostic_Signal_124" 8 "reserved Glow_Relay_Diagnostic_Signal2" 9 "Ebox_Fan_Actuator_Diagnostic_Signal_219" 10 "Shutter_Actuator_SW_DiaSig" 11 "Twostage_TurboLoading_SW_DiaSig" 12 "DIO_OUT_DIAGNOSTIC_DUMMY_NOT_USED" 13 "1st_Pressure_Control_Valve_Diagnostic_Signal_172" 14 "2nd_Pressure_Control_Valve_Diagnostic_Signal_172" 15 "1st_Metering_Unit_Diagnostic_Signal_171" 16 "2nd_Metering_Unit_Diagnostic_Signal_171" 17 "Boost_Pressure_Actuator_Diagnostic_Signal_193" 18 "Boost_Pressure_Actuator_Diagnostic_Signal_193_2" 19 "EGR_Actuator_Diagnostic_Signal_194" 20 "EGR_Actuator_Diagnostic_Signal2" 21 "Variable_Swirl_Actuator_Diagnostic_Signal_195" 22 "Throttle_Valve_Diagnostic_Signal_196" 23 "Throttle_Valve2_Diagnostic_Signal_196" 24 "FAN_240" 25 "Add_On_Heater_244" 26 "Low pressure stage BPA_Diagnostic_Signal_117" 27 "PWM_DIAGNOSTIC_DUMMY_NOT_USED" 28 "1st_Sensor_Supply_Voltage_DiaSig" 29 "2nd_Sensor_Supply_Voltage_DiaSig" 30 "3rd_Sensor_Supply_Voltage_DiaSig" 31 "4th_Sensor_Supply_Voltage_DiaSig" 32 "5th_Sensor_Supply_Voltage_DiaSig" 33 "6th_Sensor_Supply_Voltage_DiaSig" /end COMPU_VTAB
/begin COMPU_METHOD NumPinDioIn "Verbale Umrechnung für Digitaleingang Signale" TAB_VERB "%6.3" "-" COMPU_TAB_REF NumPinDioIn /end COMPU_METHOD
/begin COMPU_VTAB NumPinDioIn "Verbale Umrechnung für Digitaleingang Signale" TAB_VERB 13 0 "Terminal_15_207" 1 "Main_Brake_Switch_236" 2 "Redundant_Brake_Switch_223" 3 "Clutch_Switch" 4 "Terminal_50_224" 5 "ECU_selection_Switch_251" 6 "Coolant-heater_212" 7 "Redundant_Terminal_15_209(118)" 8 "AC-compressor_overboost_213" 9 "1st_Lambda_Regeneration" 10 "Oil_Level_sensor_138" 11 "Diagnostic_Pin_VSA_137" 12 "DIO_IN_DUMMY_NOT_USED" /end COMPU_VTAB
/begin COMPU_METHOD NumPinDioOut "Verbale Umrechnung für Digitalausgang Signale" TAB_VERB "%6.3" "-" COMPU_TAB_REF NumPinDioOut /end COMPU_METHOD
/begin COMPU_VTAB NumPinDioOut "Verbale Umrechnung für Digitalausgang Signale" TAB_VERB 16 0 "Main_Relay_220(144)" 1 "AC_Compressor" 2 "Fuel_Pump_232" 3 "Glow_Relay" 4 "Starter_234" 5 "Radiator_Blind_Control" 6 "EBAF/Compressor_Bypass_123" 7 "Glow_Relay_1" 8 "EngM_Bearing_Actuator_124" 9 "Glow_Relay_2" 10 "Ebox_Fan_Actuator_219" 11 "STATREG_PSOFF_Bit" 12 "Shutter_Actuator_216" 13 "Twostage_TurboLoading_120" 14 "TD_Signal_253" 15 "DIO_OUT_DUMMY_NOT_USED" /end COMPU_VTAB
/begin COMPU_METHOD OneToOne "eins zu eins (physikalischer Wert ist gleich dem internen Wert)" RAT_FUNC "%6.2" "-" COEFFS 0 1 0 0 0 1 /end COMPU_METHOD
/begin COMPU_METHOD Period_ms "Periodendauer in ms" RAT_FUNC "%6.3" "ms" COEFFS 0 10 0 0 0 1 /end COMPU_METHOD
/begin COMPU_METHOD Per_Dur "Periodendauer Segmentzeit" RAT_FUNC "%6.2" "usec" COEFFS 0 1 0 0 0 1 /end COMPU_METHOD
/begin COMPU_METHOD Prc "Prozent, gleiche interne Auflösung wie Fact, aber Darstellung in Prozent (0...100%)" RAT_FUNC "%6.4" "%" COEFFS 0 81.92 0 0 0 1 /end COMPU_METHOD
/begin COMPU_METHOD Pres_hPa "Druck (angezeigt in [hPa])" RAT_FUNC "%6.2" "hPa" COEFFS 0 1 0 0 0 1 /end COMPU_METHOD
/begin COMPU_METHOD Pres_Rail "Raildruck in hPa" RAT_FUNC "%4.3" "bar" COEFFS 0 10.000000 0 0 0 1 /end COMPU_METHOD
/begin COMPU_METHOD Pwr "Leistung" RAT_FUNC "%6.2" "W" COEFFS 0 0.10610329539459 0 0 0 1 /end COMPU_METHOD
/begin COMPU_METHOD Res_hPaHrPerCM "Strömungswiderstand [hPa h/m3]" RAT_FUNC "%6.5" "hPa/(m^3/h)" COEFFS 0 1000 0 0 0 1 /end COMPU_METHOD
/begin COMPU_METHOD RhoFuel "Kraftstoffdichte" RAT_FUNC "%6.3" "kg/m^3" COEFFS 0 10 0 0 0 1 /end COMPU_METHOD
/begin COMPU_METHOD RmpInjMassCyc "DT1 of Injection mass" RAT_FUNC "%6.5" "(mg/cyc)/s" COEFFS 0 6553.6 0 0 0 1 /end COMPU_METHOD
/begin COMPU_METHOD RmpTrq "Rampengradient für Motormoment" RAT_FUNC "%6.4" "Nm/s" COEFFS 0 655.36 0 0 0 1 /end COMPU_METHOD
/begin COMPU_METHOD RmpTrqPrp "Rampenanstieg für Vortriebsmoment [Nm/s]" RAT_FUNC "%6.4" "Nm/s" COEFFS 0 327.68 0 0 0 1 /end COMPU_METHOD
/begin COMPU_METHOD SigName "Verbale Umrechnung für Signal Referenz Nummern" TAB_VERB "%6.3" "-" COMPU_TAB_REF SigName /end COMPU_METHOD
/begin COMPU_VTAB SigName "Verbale Umrechnung für Signal Referenz Nummern" TAB_VERB 136 0 "Sig_unused" 4 "CoEng_rTrq__Carb_r_DLen1" 5 "CTSCD_tClntLin__Carb_t_DLen1" 11 "BPSCD_pLin__Carb_p_DLen1" 12 "Eng_nAvrg__Carb_n_DLen2" 13 "VSSCD_vSensVal__Carb_v_DLen1" 15 "AFSCD_tAir_mp__Carb_t_DLen1" 16 "AFSCD_dmAirRawPerTime__Carb_mAirTim_DLen2" 28 "Signals_PID0x1C_C__OneToOne_DLen1" 33 "DSMDur_ctDfctDur1__Carb_l_DLen2" 128 "AFSCD_dmAirPerTime__mAirTim_DLen2" 129 "AFSCD_mAirPerCyl__mAirCyl_DLen2" 130 "AFSCD_mAirPerCyl2__mAirCyl_DLen2" 131 "AFSCD_rAir__dcyc_DLen2" 132 "AFSCD_rAir2__dcyc_DLen2" 133 "AOHtCD_rOut_mp__dcyc_DLen2" 134 "APPCD_rFlt__r_DLen2" 135 "PFlt_pPreCorrB2_mp__p_DLen2" 137 "APPCD_uRawAPP1__u_DLen2" 138 "APPCD_uRawAPP2__u_DLen2" 139 "APSCD_pVal__p_DLen2" 140 "APSCD_uRaw__u_DLen2" 141 "AirCtl_mDesVal__mAirCyl_DLen2" 142 "AltCD_rAltLoad__r_DLen2" 143 "BPACD_rOut__dcyc_DLen2" 144 "BPACD_rOut2__dcyc_DLen2" 145 "BPSCD_pOutVal__p_DLen2" 146 "BPSCD_uRawVal__u_DLen2" 147 "BattCD_u__uBatt_DLen2" 148 "CBACD_stLogicOut_mp__OneToOne_DLen1" 149 "CTSCD_tClnt__t_DLen2" 150 "CTSCD_uRaw__u_DLen2" 151 "CoEng_trq__trq_DLen2" 152 "EBAFCD_stSigOut__OneToOne_DLen1" 153 "EGRCD_rOut__dcyc_DLen2" 154 "EGRCD_rOut2__dcyc_DLen2" 155 "EGT_st__ShftRght0Byte_DLen2" 156 "EngM_stOut__OneToOne_DLen1" 157 "EngM_stSync__OneToOne_DLen1" 158 "Eng_nAvrg__n_DLen2" 159 "FMTC_trqInr__trq_DLen2" 160 "FTSCD_tFuel__t_DLen2" 161 "FTSCD_uRaw__u_DLen2" 162 "FanCD_dcycRaw_mp__dcyc_DLen2" 163 "FlFCD_stFlFltRawVal__OneToOne_DLen1" 164 "FrmMng_nPSP__nPSPSpd_DLen2" 165 "FrmMng_rPSPSetPoint__r_DLen2" 166 "GlwCtl_rPwrOut__OneToOne_DLen1" 167 "GlwCtl_stLampOut__OneToOne_DLen1" 168 "HWEMon_numRecovery__ShftRght0Byte_DLen2" 169 "HWEMon_numRecovery__ShftRght1Byte_DLen2" 170 "HWEMon_recLocLow_mp__ShftRght0Byte_DLen2" 171 "HWEMon_recLocLow_mp__ShftRght1Byte_DLen2" 172 "HWEMon_recLocHigh_mp__ShftRght0Byte_DLen2" 173 "IATSCD_tAir__t_DLen2" 174 "IATSCD_tAirCats__t_DLen2" 175 "IATSCD_tAirCatsSec__t_DLen2" 176 "IATSCD_uRawCats__u_DLen2" 177 "IATSCD_uRawCatsSec__u_DLen2" 178 "Tn_abstell__DezUwQ1_DLen2" 179 "U_gen__UUwQ0p1_DLen2" 180 "HWEMon_numEEPBlockfailed__OneToOne_DLen1" 181 "InjCtl_qCurr__qInjMassCyc_DLen2" 182 "InjCtl_qSetUnBal__qInjMassCyc_DLen2" 183 "LIGov_nSetpoint__n_DLen2" 184 "LIGov_trq__trq_DLen2" 185 "LPACD_rOut__dcyc_DLen2" 186 "AFSCD_tAir1__t_DLen2" 187 "AFSCD_tAir2__t_DLen2" 188 "CoEng_stEng__OneToOne_DLen1" 189 "LSU_rO2Adpt[0]__O2_DLen2" 190 "MeUnCD_dcycOut_mp__dcyc_DLen2" 191 "OPSCD_stSigOut__OneToOne_DLen1" 192 "PFlt_pDiffB2__p_DLen2" 193 "OTSCD_tEngOil__t_DLen2" 194 "OxiCCD_tPreB1__tExhaustgas_DLen2" 195 "OxiCCD_tPreB2__tExhaustgas_DLen2" 196 "OxiCCD_uRawTempPreB1__u_DLen2" 197 "OxiCCD_uRawTempPreB2__u_DLen2" 198 "PCR_pDesVal__p_DLen2" 199 "PCVCD_dcycOut_mp__dcyc_DLen2" 200 "PFltCD_pPreB1__p_DLen2" 201 "PFltCD_pPreB2__p_DLen2" 202 "PFltCD_tPreB1__tExhaustgas_DLen2" 203 "PFltCD_tPreB2__tExhaustgas_DLen2" 204 "PFltCD_uRawPresPreB1__u_DLen2" 205 "PFltCD_uRawPresPreB2__u_DLen2" 206 "PFltCD_uRawTempPreB1__u_DLen2" 207 "PFltCD_uRawTempPreB2__u_DLen2" 208 "PFlt_dvol__volph_DLen2" 209 "PFlt_lSnceRgnu16B1_mp__lenrgnu16PFlt_DLen2" 210 "PFlt_lSnceRgnu16B2_mp__lenrgnu16PFlt_DLen2" 211 "PFlt_mAshOilB1__mSoot_DLen2" 212 "PFlt_mSotB1__mSoot_DLen2" 213 "PFlt_mSotSimB1__mSoot_DLen2" 214 "PFlt_dvolB1__volph_DLen2" 215 "PFlt_dvolB2__volph_DLen2" 216 "PFlt_pDiffB1__p_DLen2" 217 "PFlt_qFlB1_mp__FlConPFlt_DLen2" 218 "PFlt_qFlB2_mp__FlConPFlt_DLen2" 219 "AFSCD_mAirPerCyl1__mAirCyl_DLen2" 221 "PFlt_stLck_mp__OneToOne_DLen1" 222 "PSPCD_dvolOut__FlCon_DLen2" 223 "RailCD_pPeak__pRail_DLen2" 224 "RailCD_uPeakRaw__u_DLen2" 225 "Rail_pSetPoint__pRail_DLen2" 226 "TVACD_rOut__dcyc_DLen2" 227 "TVACD_rOut2__dcyc_DLen2" 228 "VSACD_rOut__dcyc_DLen2" 229 "VSSCD_v__v_DLen2" 230 "VehDa_tiEngOn__timEng_DLen2" 231 "PFlt_pPreCorrB1_mp__p_DLen2" 232 "PFlt_stPresPlaus_mp__OneToOne_DLen1" 233 "PFlt_mAshOilB2__mSoot_DLen2" 234 "EGPpCD_stActrOut__OneToOne_DLen1" 235 "PFlt_mSotSimB2__mSoot_DLen2" 236 "OvRMon_tiTDCAvrg__InjTim_DLen2" 237 "OvRMon_tiOvRMonActive_mp__tims_DLen2" 238 "CoEng_trqInrSet__trq_DLen2" 239 "InjCtl_qSet__qInjMassCyc_DLen2" 240 "Absch_korr__FSwQ0p00153_DLen2" 241 "D_soc__FSwB100_DLen2" 242 "I_batt__IUwQ0p08O200_DLen2" 243 "Oz_oelkm__KmUwQ10_DLen2" 244 "Oz_oelnivkurz__TdUbQ0p5_DLen1" 245 "Oz_oelnivnorm__TdUbQ0p5_DLen1" 246 "Oz_oelnivori__TdUbQ0p5_DLen1" 247 "PFlt_mSotB2__mSoot_DLen2" 248 "Stat_sv_reg1__DezUbQ1_DLen1" 249 "Stat_sv_reg2__DezUbQ1_DLen1" 250 "T2histshort__TdUbQ14p9333_DLen1" 251 "T3histshort__TdUbQ14p9333_DLen1" 252 "T4histshort__TdUbQ14p9333_DLen1" 253 "Toel__TSwQ0p1_DLen2" 254 "T_batt__TSwQ0p1_DLen2" 255 "U_batt__UUwQ0p25em3_DLen2" /end COMPU_VTAB
/begin COMPU_METHOD t20msxs_ub_b5p1 "K3 Umwandlungen" RAT_FUNC "%6.4" "s" COEFFS 0 1 0 0 0 0.02 /end COMPU_METHOD
/begin COMPU_METHOD TempDiff_Cels "difference/offset temperature displayed in degree celcius" RAT_FUNC "%6.3" "deg C" COEFFS 0 10 0 0 0 1 /end COMPU_METHOD
/begin COMPU_METHOD Temp_Cels "Temperatur dargestellt in °C (gleiche interne Darstellung wie Temp_Kelv)" RAT_FUNC "%6.1" "deg C" COEFFS 0 10 2731.4 0 0 1 /end COMPU_METHOD
/begin COMPU_METHOD TimeDeb "Entprellzeit in Millisekunden für Libraryfunktion Debounce" RAT_FUNC "%6.1" "ms" COEFFS 0 0.1 0 0 0 1 /end COMPU_METHOD
/begin COMPU_METHOD TimeDelay_s "Zeitkonstante T1 (in s) für PT1, DT1, etc." RAT_FUNC "%9.3" "s" COEFFS 0 0 1 0 0.00023283064365387 0 /end COMPU_METHOD
/begin COMPU_METHOD TimeEGTRmp "Umrechnung  Zeit in Rampensteigung,  Verwendet in EGT-Bibliothek" RAT_FUNC "%6.3" "s" COEFFS 0 0 1 0 0.0152587890625 0 /end COMPU_METHOD
/begin COMPU_METHOD TimeEngOn "Motorbetriebszeit in Sekunden" RAT_FUNC "%6.2" "s" COEFFS 0 1 0 0 0 1 /end COMPU_METHOD
/begin COMPU_METHOD TimeRed "Zeit in Sekunden mit reduzierter Auflösung für Ein/Ausgänge von KL/KF (sint16)" RAT_FUNC "%6.3" "s" COEFFS 0 6.25 0 0 0 1 /end COMPU_METHOD
/begin COMPU_METHOD Time_DynTst "Zeitumrechung für dynamischen test mit geringerer Auflösung, damit es für KL Ausgang passt" RAT_FUNC "%6.2" "s" COEFFS 0 0.390625 0 0 0 1 /end COMPU_METHOD
/begin COMPU_METHOD Time_ms "Zeit in ms für Fehlerentprellung (DSM) und SW-Timer" RAT_FUNC "%6.1" "ms" COEFFS 0 0.1 0 0 0 1 /end COMPU_METHOD
/begin COMPU_METHOD Time_s "Zeit in s für Fehlerentprellung (DSM) und SW-Timer" RAT_FUNC "%6.4" "s" COEFFS 0 100 0 0 0 1 /end COMPU_METHOD
/begin COMPU_METHOD TransR "Übersetzungsverhältnis (Getriebe etc.)" RAT_FUNC "%6.4" "-" COEFFS 0 100 0 0 0 1 /end COMPU_METHOD
/begin COMPU_METHOD Trq "Motormoment" RAT_FUNC "%6.3" "Nm" COEFFS 0 10 0 0 0 1 /end COMPU_METHOD
/begin COMPU_METHOD TrqPrp "Vortriebsmoment" RAT_FUNC "%6.3" "Nm" COEFFS 0 5 0 0 0 1 /end COMPU_METHOD
/begin COMPU_METHOD TrqPrpDT "zeitlich aufintegriertes Vortriebsmoment" RAT_FUNC "%6.2" "Nm*s" COEFFS 0 0.2 0 0 0 1 /end COMPU_METHOD
/begin COMPU_METHOD Vel "Fahrzeuggeschwindigkeit, gleiche interne Auflösung wie Vel_SI" RAT_FUNC "%6.4" "km/h" COEFFS 0 100 0 0 0 1 /end COMPU_METHOD
/begin COMPU_METHOD VelToN "Verhältnis Fahrzeuggeschwindigkeit zu Motordrehzahl v/n" RAT_FUNC "%8.7" "(km/h)/rpm" COEFFS 0 100000 0 0 0 1 /end COMPU_METHOD
/begin COMPU_METHOD Volt_Batt "Batteriespannung" RAT_FUNC "%6.1" "mV" COEFFS 0 0.05115 0 0 0 1 /end COMPU_METHOD
/begin RECORD_LAYOUT Kf_Xs16_Ys16_Ws16 NO_AXIS_PTS_X 1 SWORD NO_AXIS_PTS_Y 2 SWORD AXIS_PTS_X 3 SWORD INDEX_INCR DIRECT AXIS_PTS_Y 4 SWORD INDEX_INCR DIRECT FNC_VALUES 5 SWORD COLUMN_DIR DIRECT /end RECORD_LAYOUT
/begin RECORD_LAYOUT Kl_Xs16_Ws16 NO_AXIS_PTS_X 1 SWORD AXIS_PTS_X 2 SWORD INDEX_INCR DIRECT FNC_VALUES 3 SWORD COLUMN_DIR DIRECT /end RECORD_LAYOUT
/begin RECORD_LAYOUT Kwb_Ws16 FNC_VALUES 1 SWORD COLUMN_DIR DIRECT /end RECORD_LAYOUT
/begin RECORD_LAYOUT Kwb_Wu16 FNC_VALUES 1 UWORD COLUMN_DIR DIRECT /end RECORD_LAYOUT
/begin RECORD_LAYOUT Kwb_Wu32 FNC_VALUES 1 ULONG COLUMN_DIR DIRECT /end RECORD_LAYOUT
/begin RECORD_LAYOUT Kwb_Wu8 FNC_VALUES 1 UBYTE COLUMN_DIR DIRECT /end RECORD_LAYOUT
/begin RECORD_LAYOUT KwWU8 FNC_VALUES 1 UBYTE COLUMN_DIR DIRECT /end RECORD_LAYOUT
/begin RECORD_LAYOUT Kw_Ws16 FNC_VALUES 1 SWORD COLUMN_DIR DIRECT /end RECORD_LAYOUT
/begin RECORD_LAYOUT Kw_Ws32 FNC_VALUES 1 SLONG COLUMN_DIR DIRECT /end RECORD_LAYOUT
/begin RECORD_LAYOUT Kw_Ws8 FNC_VALUES 1 SBYTE COLUMN_DIR DIRECT /end RECORD_LAYOUT
/begin RECORD_LAYOUT Kw_Wu16 FNC_VALUES 1 UWORD COLUMN_DIR DIRECT /end RECORD_LAYOUT
/begin RECORD_LAYOUT Kw_Wu32 FNC_VALUES 1 ULONG COLUMN_DIR DIRECT /end RECORD_LAYOUT
/begin RECORD_LAYOUT Kw_Wu8 FNC_VALUES 1 UBYTE COLUMN_DIR DIRECT /end RECORD_LAYOUT
/end MODULE
/end PROJECT
