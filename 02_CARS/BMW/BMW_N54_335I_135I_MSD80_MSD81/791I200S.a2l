ASAP2_VERSION 1 41
/begin PROJECT MSD85 "Spray Guided DI-System with Piezo Injectors for 8-Cylinder"
/begin HEADER "_default_HeaderComment" PROJECT_NO _91 /end HEADER
/begin MODULE _default_ModuleName "_default_ModuleLongIdentifier"
/begin MOD_COMMON "_default_ModCommonComment" DEPOSIT ABSOLUTE BYTE_ORDER MSB_LAST ALIGNMENT_BYTE 1 ALIGNMENT_WORD 2 ALIGNMENT_LONG 2 ALIGNMENT_FLOAT32_IEEE 2 ALIGNMENT_FLOAT64_IEEE 4 /end MOD_COMMON
/begin CHARACTERISTIC ip_tqi_maf_sp_cus "Minimum additional torque losses for PSTE_2 active" MAP 0xa0816fcc _REC_MAP_20_u2_u1_u2 1023.96875 _CNV_A_R_LINEAR_____31_CM 0. 1023.96875 DISPLAY_IDENTIFIER IP_TQI_MAF_SP_CUS FORMAT "%7.2"
 /begin AXIS_DESCR COM_AXIS n_32 _CNV_A_R_LINEAR_____10_CM 16 0. 8160. FORMAT "%4.0" AXIS_PTS_REF ldp_n_32_ip_tqi_maf_sp_cus /end AXIS_DESCR
 /begin AXIS_DESCR COM_AXIS maf_sp_tqi _CNV_A_R_LINEAR_____111_CM 12 0. 1389. FORMAT "%4.0" AXIS_PTS_REF ldp_maf_ip_tqi_maf_sp_cus /end AXIS_DESCR
/end CHARACTERISTIC
/begin AXIS_PTS ldp_n_32_ip_tqi_maf_sp_cus "" 0xa0808a60 n_32 _REC_AXS_20_u1 8160. _CNV_A_R_LINEAR_____10_CM 16 0. 8160. FORMAT "%4.0" /end AXIS_PTS
/begin AXIS_PTS ldp_maf_ip_tqi_maf_sp_cus "" 0xa0808844 maf_sp_tqi _REC_AXS_20_u2 1389. _CNV_A_R_LINEAR_____111_CM 12 0. 1389. FORMAT "%4.0" /end AXIS_PTS
/begin MEASUREMENT lv_err_tqi_av_mon "fault currently present in torque generation" UBYTE _CNV_S_2_RANGE__0___1_CM 1 100. 0. 1. DISPLAY_IDENTIFIER LV_ERR_TQI_AV_MON ECU_ADDRESS 0xd0007438 BIT_MASK 0x1 /end MEASUREMENT
/begin MEASUREMENT lv_swi_afs_tqi_mon "Switch to AFS (TQI_DIF above allowed threshold)" UBYTE _CNV_S_2_RANGE__0___1_CM 1 100. 0. 1. DISPLAY_IDENTIFIER LV_SWI_AFS_TQI_MON ECU_ADDRESS 0xd000745a BIT_MASK 0x1 /end MEASUREMENT
/begin MEASUREMENT tqi_dif_sp_mon "deviation between torque setpoint and desired indicated engine torque" UBYTE _CNV_A_R_LINEAR_____262_CM 1 100. 0. 510. DISPLAY_IDENTIFIER TQI_DIF_SP_MON ECU_ADDRESS 0xd0001e31 FORMAT "%3.0" /end MEASUREMENT
/begin MEASUREMENT tqi_dif_max_mon "permitted deviation between actual and desired indicated engine torque" UBYTE _CNV_A_R_LINEAR_____262_CM 1 100. 0. 510. DISPLAY_IDENTIFIER TQI_DIF_MAX_MON ECU_ADDRESS 0xd0001e2f FORMAT "%3.0" /end MEASUREMENT
/begin MEASUREMENT abc_tqi_av_not_afs_mon "Anti bounce counter for fault in torque generation (not AFS mode)" UBYTE _CNV_A_R_LINEAR_____0_CM 1 100. 0. 255. DISPLAY_IDENTIFIER ABC_TQI_AV_NOT_AFS_MON ECU_ADDRESS 0xd0001deb FORMAT "%3.0" /end MEASUREMENT
/begin MEASUREMENT abc_swi_afs_tqi_mon "Anit bounce counter for request to AFS (TQI_DIF above allowed threshold)" UBYTE _CNV_A_R_LINEAR_____0_CM 1 100. 0. 255. DISPLAY_IDENTIFIER ABC_SWI_AFS_TQI_MON ECU_ADDRESS 0xd0001de1 FORMAT "%3.0" /end MEASUREMENT
/begin CHARACTERISTIC c_abc_inc_tqi_av_not_afs_mon "ABC increment at TQI_DIF above allowed treshold (not AFS-mode)" VALUE 0xa080cc56 _REC_VAL_20_u1 255. _CNV_A_R_LINEAR_____0_CM 0. 255. DISPLAY_IDENTIFIER C_ABC_INC_TQI_AV_NOT_AFS_MON FORMAT "%3.0" /end CHARACTERISTIC
/begin CHARACTERISTIC c_abc_inc_swi_afs_tqi_mon "ABC increment for request to AFS (TQ_DIF above allowed threshold)" VALUE 0xa080cc4e _REC_VAL_20_u1 255. _CNV_A_R_LINEAR_____0_CM 0. 255. DISPLAY_IDENTIFIER C_ABC_INC_SWI_AFS_TQI_MON FORMAT "%3.0" /end CHARACTERISTIC
/begin CHARACTERISTIC c_abc_max_tqi_av_not_afs_mon "Value at which TQI_AV_MON error is recognized. when reached (not AFS-mode)" VALUE 0xa080cc71 _REC_VAL_20_u1 254. _CNV_A_R_LINEAR_____0_CM 1. 255. DISPLAY_IDENTIFIER C_ABC_MAX_TQI_AV_NOT_AFS_MON FORMAT "%3.0" /end CHARACTERISTIC
/begin CHARACTERISTIC c_abc_max_swi_afs_tqi_mon "Value at which OPM will be switched to AFS at TQI_DIF above allowed treshold" VALUE 0xa080cc69 _REC_VAL_20_u1 254. _CNV_A_R_LINEAR_____0_CM 1. 255. DISPLAY_IDENTIFIER C_ABC_MAX_SWI_AFS_TQI_MON FORMAT "%3.0" /end CHARACTERISTIC
/begin MEASUREMENT abc_tqi_av_afs_mon "Anti bounce counter for fault in torque generation (AFS mode)" UBYTE _CNV_A_R_LINEAR_____0_CM 1 100. 0. 255. DISPLAY_IDENTIFIER ABC_TQI_AV_AFS_MON ECU_ADDRESS 0xd0001de9 FORMAT "%3.0" /end MEASUREMENT
/begin MEASUREMENT tqi_dif_av_mon "deviation between actual and desired indicated engine torque" UBYTE _CNV_A_R_LINEAR_____262_CM 1 100. 0. 510. DISPLAY_IDENTIFIER TQI_DIF_AV_MON ECU_ADDRESS 0xd0001e2d FORMAT "%3.0" /end MEASUREMENT
/begin CHARACTERISTIC c_abc_inc_tqi_av_afs_mon "ABC increment at TQI_DIF above allowed threshold (AFS mode)" VALUE 0xa080cc55 _REC_VAL_20_u1 255. _CNV_A_R_LINEAR_____0_CM 0. 255. DISPLAY_IDENTIFIER C_ABC_INC_TQI_AV_AFS_MON FORMAT "%3.0" /end CHARACTERISTIC
/begin CHARACTERISTIC c_abc_max_tqi_av_afs_mon "Value at which TQI_AV_MON error is recognized. when reached (AFS-mode)" VALUE 0xa080cc70 _REC_VAL_20_u1 254. _CNV_A_R_LINEAR_____0_CM 1. 255. DISPLAY_IDENTIFIER C_ABC_MAX_TQI_AV_AFS_MON FORMAT "%3.0" /end CHARACTERISTIC
/begin CHARACTERISTIC ip_tqi_dif_max_mon "threshold for diagnosis of engine torque overflow" MAP 0xa080cbdc _REC_MAP_20_u1_u1_u1 510. _CNV_A_R_LINEAR_____262_CM 0. 510. DISPLAY_IDENTIFIER IP_TQI_DIF_MAX_MON FORMAT "%3.0"
 /begin AXIS_DESCR COM_AXIS n_32_mon _CNV_A_R_LINEAR_____10_CM 4 0. 8160. FORMAT "%4.0" AXIS_PTS_REF ldp_n_32_ip_tqi_dif_max_mon /end AXIS_DESCR
 /begin AXIS_DESCR COM_AXIS tqi_sp_mon _CNV_A_R_LINEAR_____262_CM 4 0. 510. FORMAT "%3.0" AXIS_PTS_REF ldp_tqi_sp_ip_tqi_dif_max_mon /end AXIS_DESCR
/end CHARACTERISTIC
/begin CHARACTERISTIC c_gain_tqi_dif_max_mon "factor for threshold diagnosis with TQI_SP" VALUE 0xa080cc8a _REC_VAL_20_u1 63.75 _CNV_A_R_EGCP_LINEA_334_CM 0. 63.75 DISPLAY_IDENTIFIER C_GAIN_TQI_DIF_MAX_MON FORMAT "%4.1" /end CHARACTERISTIC
/begin AXIS_PTS ldp_n_32_ip_tqi_dif_max_mon "" 0xa080c78a n_32_mon _REC_AXS_20_u1 8160. _CNV_A_R_LINEAR_____10_CM 4 0. 8160. FORMAT "%4.0" /end AXIS_PTS
/begin AXIS_PTS ldp_tqi_sp_ip_tqi_dif_max_mon "" 0xa080c894 tqi_sp_mon _REC_AXS_20_u1 510. _CNV_A_R_LINEAR_____262_CM 4 0. 510. FORMAT "%3.0" /end AXIS_PTS
/begin AXIS_PTS ldpm_test_rec_idx_mon2 "" 0xa08009b4 test_rec_idx_mon2 _REC_AXS_20_u1 15. _CNV_A_R_LINEAR_____0_CM 15 0. 15. FORMAT "%3.0" /end AXIS_PTS
/begin AXIS_PTS ldpm_iga_dif_av_mon_ip_eff_mon "" 0xa080c8c8 online_dummy _REC_AXS_20_u2 -180. _CNV_A_R_LINEAR_____189_CM 8 0. -180. FORMAT "%8.4" /end AXIS_PTS
/begin AXIS_PTS ldpm_n_32_mon__fac_cha_mon "" 0xa080c8dc n_32 _REC_AXS_20_u1 8160. _CNV_A_R_LINEAR_____10_CM 11 0. 8160. FORMAT "%4.0" /end AXIS_PTS
/begin AXIS_PTS ldpm_n_32_mon_ip_iga_ref_mon "" 0xa080c8f4 n_32 _REC_AXS_20_u1 8160. _CNV_A_R_LINEAR_____10_CM 8 0. 8160. FORMAT "%4.0" /end AXIS_PTS
/begin AXIS_PTS ldpm_n_32_mon_ip_fac_tq_mon "" 0xa080c8e8 n_32_mon _REC_AXS_20_u1 8160. _CNV_A_R_LINEAR_____10_CM 8 0. 8160. FORMAT "%4.0" /end AXIS_PTS
/begin AXIS_PTS ldpm_pv_av_ad_mon_ip_fac_mon "" 0xa080c910 pv_av_ad_mon _REC_AXS_20_u1 99.609375 _CNV_A_R_LINEAR_____5_CM 8 0. 99.609375 FORMAT "%9.6" /end AXIS_PTS
/begin AXIS_PTS ldpm_iga_dif_av_mon2_ip_mon2 "" 0xa080097c online_dummy _REC_AXS_20_u2 -180. _CNV_A_R_LINEAR_____189_CM 8 0. -180. FORMAT "%8.4" /end AXIS_PTS
/begin AXIS_PTS ldpm_n_32_mon2_ip_fac_tq_mon2 "" 0xa0800990 n_32_mon2 _REC_AXS_20_u1 8160. _CNV_A_R_LINEAR_____10_CM 8 0. 8160. FORMAT "%4.0" /end AXIS_PTS
/begin AXIS_PTS ldpm_n_32_mon2_ip_iga_ref_mon2 "" 0xa080099c n_32_mon2 _REC_AXS_20_u1 8160. _CNV_A_R_LINEAR_____10_CM 8 0. 8160. FORMAT "%4.0" /end AXIS_PTS
/begin AXIS_PTS ldpm_pv_av_ad_mon2_ip_fac_mon2 "" 0xa08009a8 pv_av_ad_mon2 _REC_AXS_20_u1 99.609375 _CNV_A_R_LINEAR_____5_CM 8 0. 99.609375 FORMAT "%9.6" /end AXIS_PTS
/begin MEASUREMENT state_err_det_tq_min_mon "Error-detection-state for monitoring of minimum torque at clutch" UBYTE _CNV_S_3_ECM2_RANGE_831_CM 1 100. 0. 2. DISPLAY_IDENTIFIER STATE_ERR_DET_TQ_MIN_MON ECU_ADDRESS 0xd0007406 /end MEASUREMENT
/begin MEASUREMENT opm_av_mon "Engine speed deviation N_SP_IS - N" UBYTE _CNV_S_5_ECM2_RANGE_832_CM 1 100. 0. 8. DISPLAY_IDENTIFIER OPM_AV_MON ECU_ADDRESS 0xd0007403 /end MEASUREMENT
/begin MEASUREMENT n_dif_sp_is_mon "Deviation of actual engine speed to idle speed setpoint" SBYTE _CNV_A_R_LINEAR_____10_CM 1 100. -4096. 4064. DISPLAY_IDENTIFIER N_DIF_SP_IS_MON ECU_ADDRESS 0xd0007401 FORMAT "%5.0" /end MEASUREMENT
/begin MEASUREMENT lv_ls_up_act_mon[0] "Logical variable for activation of engine speed limitation monitoring" UBYTE _CNV_S_2_RANGE__0___1_CM 1 100. 0. 1. DISPLAY_IDENTIFIER LV_LS_UP_ACT_MON[0] ECU_ADDRESS 0xd0007448 BIT_MASK 0x1 /end MEASUREMENT
/begin MEASUREMENT lv_ls_up_act_mon[1] "Logical variable for activation of engine speed limitation monitoring" UBYTE _CNV_S_2_RANGE__0___1_CM 1 100. 0. 1. DISPLAY_IDENTIFIER LV_LS_UP_ACT_MON[1] ECU_ADDRESS 0xd0007449 BIT_MASK 0x1 /end MEASUREMENT
/begin CHARACTERISTIC c_n_dif_crlc_low_mon "Correlation factor for n_dif_mmv calculation" VALUE 0xa080cc9b _REC_VAL_20_u1 0.99609375 _CNV_A_R_LINEAR_____185_CM 0. 0.99609375 DISPLAY_IDENTIFIER C_N_DIF_CRLC_LOW_MON FORMAT "%5.3" /end CHARACTERISTIC
/begin MEASUREMENT lv_lamb_ls_up_vld_mon[0] "Logical variable for activation of engine speed limitation monitoring" UBYTE _CNV_S_2_RANGE__0___1_CM 1 100. 0. 1. DISPLAY_IDENTIFIER LV_LAMB_LS_UP_VLD_MON[0] ECU_ADDRESS 0xd0007442 BIT_MASK 0x1 /end MEASUREMENT
/begin MEASUREMENT lv_lamb_ls_up_vld_mon[1] "Logical variable for activation of engine speed limitation monitoring" UBYTE _CNV_S_2_RANGE__0___1_CM 1 100. 0. 1. DISPLAY_IDENTIFIER LV_LAMB_LS_UP_VLD_MON[1] ECU_ADDRESS 0xd0007443 BIT_MASK 0x1 /end MEASUREMENT
/begin MEASUREMENT state_req_isc_mon "State of idle speed controller monitoring" UBYTE _CNV_S_4_ECM2_RANGE_833_CM 1 100. 0. 3. DISPLAY_IDENTIFIER STATE_REQ_ISC_MON ECU_ADDRESS 0xd000740c /end MEASUREMENT
/begin CHARACTERISTIC c_n_dif_max_is_mon "Maximum idle speed setpoint deviation for active PD-part" VALUE 0xa080cca0 _REC_VAL_20_s1 8160. _CNV_A_R_LINEAR_____10_CM -4096. 4064. DISPLAY_IDENTIFIER C_N_DIF_MAX_IS_MON FORMAT "%5.0" /end CHARACTERISTIC
/begin CHARACTERISTIC c_iga_ref_temp_cor_lim_mon "Correction of reference ignition angle limitation TEMP" VALUE 0xa080cc8e _REC_VAL_20_u2 180. _CNV_A_R_LINEAR_____132_CM -90. 90. DISPLAY_IDENTIFIER C_IGA_REF_TEMP_COR_LIM_MON FORMAT "%8.4" /end CHARACTERISTIC
/begin CHARACTERISTIC c_iga_ref_lamb_cor_lim_mon "Correction of reference ignition angle limitation LAMB_SP" VALUE 0xa080cc8c _REC_VAL_20_u2 180. _CNV_A_R_LINEAR_____132_CM -90. 90. DISPLAY_IDENTIFIER C_IGA_REF_LAMB_COR_LIM_MON FORMAT "%8.4" /end CHARACTERISTIC
/begin CHARACTERISTIC c_abc_max_sof_mon "Maximum value of anti-bounce counter" VALUE 0xa080cc67 _REC_VAL_20_u1 254. _CNV_A_R_LINEAR_____0_CM 1. 255. DISPLAY_IDENTIFIER C_ABC_MAX_SOF_MON FORMAT "%3.0" /end CHARACTERISTIC
/begin CHARACTERISTIC c_abc_inc_sof_mon "Anti bounce counter increment" VALUE 0xa080cc4c _REC_VAL_20_u1 255. _CNV_A_R_LINEAR_____0_CM 0. 255. DISPLAY_IDENTIFIER C_ABC_INC_SOF_MON FORMAT "%3.0" /end CHARACTERISTIC
/begin MEASUREMENT lv_n_lim_etc_mon "Logical variable for activation of engine speed limitation monitoring" UBYTE _CNV_S_2_RANGE__0___1_CM 1 100. 0. 1. DISPLAY_IDENTIFIER LV_N_LIM_ETC_MON ECU_ADDRESS 0xd000744b BIT_MASK 0x1 /end MEASUREMENT
/begin MEASUREMENT lv_tqi_mon_act_mon "Logical variable for torque monitoring active" UBYTE _CNV_S_2_RANGE__0___1_CM 1 100. 0. 1. DISPLAY_IDENTIFIER LV_TQI_MON_ACT_MON ECU_ADDRESS 0xd000745d BIT_MASK 0x1 /end MEASUREMENT
/begin CHARACTERISTIC c_v_tps_1_lih_mon "Threshold for detection of throttle position 1 outside limp home position" VALUE 0xa080cd08 _REC_VAL_20_u2 4.9951171875 _CNV_A_R_LINEAR_____2_CM 0. 4.9951171875 DISPLAY_IDENTIFIER C_V_TPS_1_LIH_MON FORMAT "%5.3" /end CHARACTERISTIC
/begin CHARACTERISTIC c_v_tps_2_lih_mon "Threshold for detection of throttle position 2 outside limp home position" VALUE 0xa080cd0a _REC_VAL_20_u2 4.9951171875 _CNV_A_R_LINEAR_____2_CM 0. 4.9951171875 DISPLAY_IDENTIFIER C_V_TPS_2_LIH_MON FORMAT "%5.3" /end CHARACTERISTIC
/begin CHARACTERISTIC c_n_thd_fcut_n_lim_etc_mon "Engine speed threshold for forced injection cut off in SAS mode " VALUE 0xa080ccad _REC_VAL_20_u1 8160. _CNV_A_R_LINEAR_____10_CM 0. 8160. DISPLAY_IDENTIFIER C_N_THD_FCUT_N_LIM_ETC_MON FORMAT "%4.0" /end CHARACTERISTIC
/begin MEASUREMENT lv_brake_mon "Brake active or brake fault present" UBYTE _CNV_S_2_RANGE__0___1_CM 1 100. 0. 1. DISPLAY_IDENTIFIER LV_BRAKE_MON ECU_ADDRESS 0xd0007415 BIT_MASK 0x1 /end MEASUREMENT
/begin MEASUREMENT lv_err_vcc_pvs_1_mon "Fault in power supply for PVS_1 present" UBYTE _CNV_S_2_RANGE__0___1_CM 1 100. 0. 1. DISPLAY_IDENTIFIER LV_ERR_VCC_PVS_1_MON ECU_ADDRESS 0xd000743c BIT_MASK 0x1 /end MEASUREMENT
/begin MEASUREMENT tq_loss_ars_mon "Anti roll stabilisation torque losses" SWORD _CNV_A_R_LINEAR_____31_CM 1 100. -1024. 1023.96875 DISPLAY_IDENTIFIER TQ_LOSS_ARS_MON ECU_ADDRESS 0xd0001d9e FORMAT "%8.2" /end MEASUREMENT
/begin MEASUREMENT tq_loss_pste_1_mon "Steering wheel compressor torque losses" SWORD _CNV_A_R_LINEAR_____31_CM 1 100. -1024. 1023.96875 DISPLAY_IDENTIFIER TQ_LOSS_PSTE_1_MON ECU_ADDRESS 0xd0001da8 FORMAT "%8.2" /end MEASUREMENT
/begin MEASUREMENT tq_loss_pste_2_mon "Steering wheel compressor torque losses" SWORD _CNV_A_R_LINEAR_____31_CM 1 100. -1024. 1023.96875 DISPLAY_IDENTIFIER TQ_LOSS_PSTE_2_MON ECU_ADDRESS 0xd0001daa FORMAT "%8.2" /end MEASUREMENT
/begin MEASUREMENT cur_alter_mon "Currency torque losses monitoring" UBYTE _CNV_A_R_LINEAR_____446_CM 1 100. 0. 255. DISPLAY_IDENTIFIER CUR_ALTER_MON ECU_ADDRESS 0xd0001df0 FORMAT "%4.1" /end MEASUREMENT
/begin MEASUREMENT tq_loss_sa_mon "Secondary air torque losses" SWORD _CNV_A_R_LINEAR_____31_CM 1 100. -1024. 1023.96875 DISPLAY_IDENTIFIER TQ_LOSS_SA_MON ECU_ADDRESS 0xd0001dae FORMAT "%8.2" /end MEASUREMENT
/begin MEASUREMENT n_alter_mon "Currency torque losses monitoring" UWORD _CNV_A_R_LINEAR_____14_CM 1 100. 0. 65535. DISPLAY_IDENTIFIER N_ALTER_MON ECU_ADDRESS 0xd0001d76 FORMAT "%5.0" /end MEASUREMENT
/begin MEASUREMENT dffgen_fil_mon "Currency torque losses monitoring" UBYTE _CNV_A_R_LINEAR_____5_CM 1 100. 0. 99.609375 DISPLAY_IDENTIFIER DFFGEN_FIL_MON ECU_ADDRESS 0xd0001df1 FORMAT "%5.2" /end MEASUREMENT
/begin MEASUREMENT lv_err_vcc_pvs_2_mon "Fault in power supply for PVS_2 present" UBYTE _CNV_S_2_RANGE__0___1_CM 1 100. 0. 1. DISPLAY_IDENTIFIER LV_ERR_VCC_PVS_2_MON ECU_ADDRESS 0xd000743d BIT_MASK 0x1 /end MEASUREMENT
/begin MEASUREMENT lv_err_vcc_pvs_mon "Fault of any PVS power supply detected by level 2 diagnosis" UBYTE _CNV_S_2_RANGE__0___1_CM 1 100. 0. 1. DISPLAY_IDENTIFIER LV_ERR_VCC_PVS_MON ECU_ADDRESS 0xd000743e BIT_MASK 0x1 /end MEASUREMENT
/begin MEASUREMENT tq_loss_acc_mon "Air conditioning compressor torque losses" SWORD _CNV_A_R_LINEAR_____31_CM 1 100. -1024. 1023.96875 DISPLAY_IDENTIFIER TQ_LOSS_ACC_MON ECU_ADDRESS 0xd0001d98 FORMAT "%11.5" /end MEASUREMENT
/begin CHARACTERISTIC c_vs_dif_max_mon "Maximum possible difference between VS_FIL and VS_SENS" VALUE 0xa080cd12 _REC_VAL_20_u2 511.99218 _CNV_A_R_LINEAR_____86_CM 0. 511.99218 DISPLAY_IDENTIFIER C_VS_DIF_MAX_MON FORMAT "%7.3" /end CHARACTERISTIC
/begin CHARACTERISTIC c_tq_loss_add_acc_min_mon "minimum additional torque loss for acc active" VALUE 0xa080cce4 _REC_VAL_20_s2 40.96 _CNV_A_R_LINEAR_____31_CM -1024. 0. DISPLAY_IDENTIFIER C_TQ_LOSS_ADD_ACC_MIN_MON FORMAT "%6.2" /end CHARACTERISTIC
/begin CHARACTERISTIC c_tq_loss_alter_min_mon "minimum additional torque loss for alternator active" VALUE 0xa080cce6 _REC_VAL_20_s2 40.96 _CNV_A_R_LINEAR_____31_CM -1024. 0. DISPLAY_IDENTIFIER C_TQ_LOSS_ALTER_MIN_MON FORMAT "%6.2" /end CHARACTERISTIC
/begin CHARACTERISTIC c_tq_loss_pste_1_min_mon "minimum additional torque loss for pste 1 active" VALUE 0xa080ccec _REC_VAL_20_s2 40.96 _CNV_A_R_LINEAR_____31_CM -1024. 0. DISPLAY_IDENTIFIER C_TQ_LOSS_PSTE_1_MIN_MON FORMAT "%6.2" /end CHARACTERISTIC
/begin CHARACTERISTIC c_tq_loss_sa_min_mon "minimum additional torque loss for secondary air active" VALUE 0xa080ccee _REC_VAL_20_s2 40.96 _CNV_A_R_LINEAR_____31_CM -1024. 0. DISPLAY_IDENTIFIER C_TQ_LOSS_SA_MIN_MON FORMAT "%6.2" /end CHARACTERISTIC
/begin CHARACTERISTIC c_crlc_alter_mon "Alternator torque losses low pass" VALUE 0xa080cc74 _REC_VAL_20_u1 3.984375e-002 _CNV_A_R_LINEAR_____185_CM 0. 0.99609375 DISPLAY_IDENTIFIER C_CRLC_ALTER_MON FORMAT "%5.3" /end CHARACTERISTIC
/begin CHARACTERISTIC c_fac_eff_alter_mon "Alternator torque losses low pass" VALUE 0xa080cc78 _REC_VAL_20_u1 0.31875 _CNV_A_R_LINEAR_____834_CM 0. 7.96875 DISPLAY_IDENTIFIER C_FAC_EFF_ALTER_MON FORMAT "%5.3" /end CHARACTERISTIC
/begin CHARACTERISTIC c_tq_loss_ars_min_mon "minimum additional torque loss for ars active" VALUE 0xa080cce8 _REC_VAL_20_s2 40.96 _CNV_A_R_LINEAR_____31_CM -1024. 0. DISPLAY_IDENTIFIER C_TQ_LOSS_ARS_MIN_MON FORMAT "%6.2" /end CHARACTERISTIC
/begin CHARACTERISTIC c_fac_n_alter_mon "" VALUE 0xa080cc80 _REC_VAL_20_u1 0.31875 _CNV_A_R_LINEAR_____834_CM 0. 7.96875 DISPLAY_IDENTIFIER C_FAC_N_ALTER_MON FORMAT "%5.3" /end CHARACTERISTIC
/begin CHARACTERISTIC c_v_tq_alter_mon "Voltage range of monitoring" VALUE 0xa080cd0d _REC_VAL_20_u1 1.04 _CNV_A_R_LINEAR_____37_CM 0. 26. DISPLAY_IDENTIFIER C_V_TQ_ALTER_MON FORMAT "%4.1" /end CHARACTERISTIC
/begin CHARACTERISTIC lc_inh_pu_req_mon "Logical bit to inhibit LV_PU in calculation of TQ_MIN_CLU_MDL_MON" VALUE 0xa080cd1b _REC_VAL_20_u1 1. _CNV_A_R_LINEAR_____0_CM 0. 1. DISPLAY_IDENTIFIER LC_INH_PU_REQ_MON FORMAT "%1.0" /end CHARACTERISTIC
/begin CHARACTERISTIC ip_cur_alter_mon "Alternator torque losses" MAP 0xa080c930 _REC_MAP_20_u1_u1_u2 255. _CNV_A_R_LINEAR_____446_CM 0. 255. DISPLAY_IDENTIFIER IP_CUR_ALTER_MON FORMAT "%4.1"
 /begin AXIS_DESCR COM_AXIS dffgen_fil_mon _CNV_A_R_LINEAR_____5_CM 6 0. 99.609375 FORMAT "%9.6" AXIS_PTS_REF ldp_dffgen_fil_mon__loss_mon /end AXIS_DESCR
 /begin AXIS_DESCR COM_AXIS n_alter_mon _CNV_A_R_LINEAR_____14_CM 6 0. 65535. FORMAT "%5.0" AXIS_PTS_REF ldpm_n_alter_mon__tq_loss_mon /end AXIS_DESCR
/end CHARACTERISTIC
/begin CHARACTERISTIC ip_eff_alter_mon "Alternator torque losses" MAP 0xa080c954 _REC_MAP_20_u1_u2_u1 0.99609375 _CNV_A_R_LINEAR_____185_CM 0. 0.99609375 DISPLAY_IDENTIFIER IP_EFF_ALTER_MON FORMAT "%5.3"
 /begin AXIS_DESCR COM_AXIS n_alter_mon _CNV_A_R_LINEAR_____14_CM 6 0. 65535. FORMAT "%5.0" AXIS_PTS_REF ldpm_n_alter_mon__tq_loss_mon /end AXIS_DESCR
 /begin AXIS_DESCR COM_AXIS cur_alter_mon _CNV_A_R_LINEAR_____446_CM 6 0. 255. FORMAT "%4.1" AXIS_PTS_REF ldp_cur_alter_mon__tq_loss_mon /end AXIS_DESCR
/end CHARACTERISTIC
/begin AXIS_PTS ldp_cur_alter_mon__tq_loss_mon "" 0xa080c6be cur_alter_mon _REC_AXS_20_u1 255. _CNV_A_R_LINEAR_____446_CM 6 0. 255. FORMAT "%4.1" /end AXIS_PTS
/begin MEASUREMENT vs_mon "Vehicle speed for monitoring PSTE_2" UWORD _CNV_A_R_LINEAR_____86_CM 1 100. 0. 511.99218 DISPLAY_IDENTIFIER VS_MON ECU_ADDRESS 0xd0001dcc FORMAT "%7.3" /end MEASUREMENT
/begin AXIS_PTS ldp_ang_pste_stnd__tq_loss_mon "" 0xa080c66c ang_pste_stnd _REC_AXS_20_u2 199.99694824 _CNV_A_R_LINEAR_____263_CM 6 -100. 99.99694824 FORMAT "%8.3" /end AXIS_PTS
/begin MEASUREMENT pv_av_ad_mon "Modified pedal value signal" UBYTE _CNV_A_R_LINEAR_____5_CM 1 100. 0. 99.609375 DISPLAY_IDENTIFIER PV_AV_AD_MON ECU_ADDRESS 0xd0007404 FORMAT "%9.6" /end MEASUREMENT
/begin MEASUREMENT n_sp_is_ratio_mon "Ratio between actual engine speed and idle speed setpoint" UWORD _CNV_A_R_LINEAR_____115_CM 1 100. 0. 7.9998779296875 DISPLAY_IDENTIFIER N_SP_IS_RATIO_MON ECU_ADDRESS 0xd00065b8 FORMAT "%6.4" /end MEASUREMENT
/begin MEASUREMENT n_sp_is_mon "Monitored value of idle speed setpoint" UBYTE _CNV_A_R_LINEAR_____10_CM 1 100. 0. 8160. DISPLAY_IDENTIFIER N_SP_IS_MON ECU_ADDRESS 0xd0007402 FORMAT "%4.0" /end MEASUREMENT
/begin MEASUREMENT n_dif_mmv_mon "n_dif moving mean value" UBYTE _CNV_A_R_LINEAR_____240_CM 1 100. -4096. 4064. DISPLAY_IDENTIFIER N_DIF_MMV_MON ECU_ADDRESS 0xd0001e0b FORMAT "%5.0" /end MEASUREMENT
/begin MEASUREMENT n_dif_cor_mon "Idle speed control variable" UBYTE _CNV_A_R_LINEAR_____240_CM 1 100. -4096. 4064. DISPLAY_IDENTIFIER N_DIF_COR_MON ECU_ADDRESS 0xd0001e09 FORMAT "%5.0" /end MEASUREMENT
/begin CHARACTERISTIC ip_fac_conv_mon "Converter torque characteristics" CURVE 0xa080c9dc _REC_CUR_20_u2_u1 4.88e-004 _CNV_A_R_ECM2_LINEA_835_CM 0. 4.88e-004 DISPLAY_IDENTIFIER IP_FAC_CONV_MON FORMAT "%7.6"
 /begin AXIS_DESCR COM_AXIS tco_mon _CNV_A_R_LINEAR_____17_CM 6 -48. 142.5 FORMAT "%6.2" AXIS_PTS_REF ldp_tco_mon_ip_fac_conv_mon /end AXIS_DESCR
/end CHARACTERISTIC
/begin MEASUREMENT fac_ramp_neg_p_d_is_mon "Factor for monitoring negative PD deactivation-ramp operations" UWORD _CNV_A_R_ECM2_LINEA_836_CM 1 100. 0. 0.5 DISPLAY_IDENTIFIER FAC_RAMP_NEG_P_D_IS_MON ECU_ADDRESS 0xd00065a8 FORMAT "%8.6" /end MEASUREMENT
/begin MEASUREMENT n_dif_mon "Engine speed deviation N_SP_IS - N" SBYTE _CNV_A_R_LINEAR_____10_CM 1 100. -4096. 4064. DISPLAY_IDENTIFIER N_DIF_MON ECU_ADDRESS 0xd0007400 FORMAT "%5.0" /end MEASUREMENT
/begin MEASUREMENT n_dif_drof_mon "Engine speed difference effective for TQ_DROF" UBYTE _CNV_A_R_LINEAR_____240_CM 1 100. -4096. 4064. DISPLAY_IDENTIFIER N_DIF_DROF_MON ECU_ADDRESS 0xd0001e0a FORMAT "%5.0" /end MEASUREMENT
/begin CHARACTERISTIC c_fac_ramp_p_d_mon "Factor for monitoring negative DROF deactivation-ramp operation" VALUE 0xa080cc84 _REC_VAL_20_u2 0.5 _CNV_A_R_ECM2_LINEA_836_CM 0. 0.5 DISPLAY_IDENTIFIER C_FAC_RAMP_P_D_MON FORMAT "%8.6" /end CHARACTERISTIC
/begin AXIS_PTS ldp_tco_mon_ip_n_sp_is_mon "" 0xa080c824 tco_mon _REC_AXS_20_u1 190.5 _CNV_A_R_LINEAR_____17_CM 5 -48. 142.5 FORMAT "%6.2" /end AXIS_PTS
/begin CHARACTERISTIC ip_n_sp_is_bas_max_mon "maximum idle speed setpoint depending on coolant temperature" CURVE 0xa080cb68 _REC_CUR_20_u1_u1 8160. _CNV_A_R_LINEAR_____10_CM 0. 8160. DISPLAY_IDENTIFIER IP_N_SP_IS_BAS_MAX_MON FORMAT "%4.0"
 /begin AXIS_DESCR COM_AXIS tco_mon _CNV_A_R_LINEAR_____17_CM 5 -48. 142.5 FORMAT "%6.2" AXIS_PTS_REF ldp_tco_mon_ip_n_sp_is_mon /end AXIS_DESCR
/end CHARACTERISTIC
/begin AXIS_PTS ldp_tco_mon_ip_fac_conv_mon "" 0xa080c816 tco_mon _REC_AXS_20_u1 190.5 _CNV_A_R_LINEAR_____17_CM 6 -48. 142.5 FORMAT "%6.2" /end AXIS_PTS
/begin CHARACTERISTIC ip_fac_tq_dif_p_d_is_mon "maximum scaling factor due to separation of PD-part" CURVE 0xa080ca58 _REC_CUR_20_u1_u1 1.9921875 _CNV_A_R_LINEAR_____103_CM 0. 1.9921875 DISPLAY_IDENTIFIER IP_FAC_TQ_DIF_P_D_IS_MON FORMAT "%8.6"
 /begin AXIS_DESCR COM_AXIS tco_mon _CNV_A_R_LINEAR_____17_CM 5 -48. 142.5 FORMAT "%6.2" AXIS_PTS_REF ldp_tco_mon_ip_fac_tq_p_d_mon /end AXIS_DESCR
/end CHARACTERISTIC
/begin CHARACTERISTIC ip_tq_dif_p_d_is_max_mon "maximum PD-part depending on speed deviation to idle speed setpoint" CURVE 0xa080cb6e _REC_CUR_20_u1_u1 510. _CNV_A_R_LINEAR_____262_CM 0. 510. DISPLAY_IDENTIFIER IP_TQ_DIF_P_D_IS_MAX_MON FORMAT "%3.0"
 /begin AXIS_DESCR COM_AXIS n_dif_sp_is_mon _CNV_A_R_LINEAR_____240_CM 6 -4096. 4064. FORMAT "%5.0" AXIS_PTS_REF ldp_n_dif_sp_is_mon_ip_tq_mon /end AXIS_DESCR
/end CHARACTERISTIC
/begin AXIS_PTS ldp_n_dif_sp_is_mon_ip_tq_mon "" 0xa080c7d8 n_dif_sp_is_mon _REC_AXS_20_u1 8160. _CNV_A_R_LINEAR_____240_CM 6 -4096. 4064. FORMAT "%5.0" /end AXIS_PTS
/begin AXIS_PTS ldp_tco_mon_ip_fac_tq_p_d_mon "" 0xa080c81e tco_mon _REC_AXS_20_u1 190.5 _CNV_A_R_LINEAR_____17_CM 5 -48. 142.5 FORMAT "%6.2" /end AXIS_PTS
/begin MEASUREMENT tq_dif_p_d_is_mon "Monitored PD-part of the idle speed controller" SWORD _CNV_A_R_LINEAR_____31_CM 1 100. -1024. 1023.96875 DISPLAY_IDENTIFIER TQ_DIF_P_D_IS_MON ECU_ADDRESS 0xd00065c6 FORMAT "%11.5" /end MEASUREMENT
/begin CHARACTERISTIC c_n_dif_crlc_high_mon "Correlation factor for n_dif_mmv calculation" VALUE 0xa080cc9a _REC_VAL_20_u1 0.99609375 _CNV_A_R_LINEAR_____185_CM 0. 0.99609375 DISPLAY_IDENTIFIER C_N_DIF_CRLC_HIGH_MON FORMAT "%5.3" /end CHARACTERISTIC
/begin CHARACTERISTIC lc_n_sp_is_clc_inh_mon "Logical bit for switching between two engine-speed-deviation calculation paths (N_DIF_COR_x_MON)" VALUE 0xa080cd1d _REC_VAL_20_u1 1. _CNV_A_R_LINEAR_____0_CM 0. 1. DISPLAY_IDENTIFIER LC_N_SP_IS_CLC_INH_MON FORMAT "%1.0" /end CHARACTERISTIC
/begin CHARACTERISTIC c_n_sp_is_bas_dif_max_mon "Idle speed gradient limitation" VALUE 0xa080cca7 _REC_VAL_20_u1 4064. _CNV_A_R_LINEAR_____10_CM 0. 4064. DISPLAY_IDENTIFIER C_N_SP_IS_BAS_DIF_MAX_MON FORMAT "%4.0" /end CHARACTERISTIC
/begin MEASUREMENT tq_dif_p_d_is_max_mon "Maximum value of PD-part" UWORD _CNV_A_R_LINEAR_____31_CM 1 100. 0. 1023.96875 DISPLAY_IDENTIFIER TQ_DIF_P_D_IS_MAX_MON ECU_ADDRESS 0xd00065c4 FORMAT "%10.5" /end MEASUREMENT
/begin MEASUREMENT tq_dif_p_d_is_max_2_mon "Temporary variable" UWORD _CNV_A_R_LINEAR_____31_CM 1 100. 0. 1023.96875 DISPLAY_IDENTIFIER TQ_DIF_P_D_IS_MAX_2_MON ECU_ADDRESS 0xd0001d8e FORMAT "%10.5" /end MEASUREMENT
/begin MEASUREMENT state_pas_ramp_act_i_is_mon "Circular buffer indicating statuts of I-part deactivation ramp" UBYTE _CNV_A_R_LINEAR_____0_CM 1 100. 0. 255. DISPLAY_IDENTIFIER STATE_PAS_RAMP_ACT_I_IS_MON ECU_ADDRESS 0xd000740a FORMAT "%3.0" /end MEASUREMENT
/begin MEASUREMENT lv_pas_ramp_act_p_d_chg_mon "Activation bit  for initialisation of PD-ramp" UBYTE _CNV_S_2_RANGE__0___1_CM 1 100. 0. 1. DISPLAY_IDENTIFIER LV_PAS_RAMP_ACT_P_D_CHG_MON ECU_ADDRESS 0xd0007451 BIT_MASK 0x1 /end MEASUREMENT
/begin MEASUREMENT lv_pas_ramp_act_i_chg_mon "Activation bit  for initialisation of I-ramp" UBYTE _CNV_S_2_RANGE__0___1_CM 1 100. 0. 1. DISPLAY_IDENTIFIER LV_PAS_RAMP_ACT_I_CHG_MON ECU_ADDRESS 0xd0007450 BIT_MASK 0x1 /end MEASUREMENT
/begin CHARACTERISTIC c_fil_tq_p_d_is_max_mon "Filter correlation constant for PD-part torque threshold" VALUE 0xa080cc88 _REC_VAL_20_u2 0.9999847412109381 _CNV_A_R_LINEAR_____89_CM 0. 0.9999847412109381 DISPLAY_IDENTIFIER C_FIL_TQ_P_D_IS_MAX_MON FORMAT "%7.5" /end CHARACTERISTIC
/begin MEASUREMENT lv_off_iv_n_lim_etc_mon "Reversible fuel Cut Off Switch for all cylinders" UBYTE _CNV_S_2_RANGE__0___1_CM 1 100. 0. 1. DISPLAY_IDENTIFIER LV_OFF_IV_N_LIM_ETC_MON ECU_ADDRESS 0xd000744e BIT_MASK 0x1 /end MEASUREMENT
/begin MEASUREMENT tq_drof_mon "Torque request for drive off assistance" SWORD _CNV_A_R_LINEAR_____31_CM 1 100. -1024. 1023.96875 DISPLAY_IDENTIFIER TQ_DROF_MON ECU_ADDRESS 0xd00065c8 FORMAT "%8.2" /end MEASUREMENT
/begin MEASUREMENT tq_drof_mdl_mon "Drive off model value" SWORD _CNV_A_R_LINEAR_____31_CM 1 100. -1024. 1023.96875 DISPLAY_IDENTIFIER TQ_DROF_MDL_MON ECU_ADDRESS 0xd0001d94 FORMAT "%8.2" /end MEASUREMENT
/begin MEASUREMENT lv_tq_drof_act_mon "Function active" UBYTE _CNV_S_2_RANGE__0___1_CM 1 100. 0. 1. DISPLAY_IDENTIFIER LV_TQ_DROF_ACT_MON ECU_ADDRESS 0xd0001e5b BIT_MASK 0x1 /end MEASUREMENT
/begin MEASUREMENT lv_cs_mon "Clutch switch level 2" UBYTE _CNV_S_2_RANGE__0___1_CM 1 100. 0. 1. DISPLAY_IDENTIFIER LV_CS_MON ECU_ADDRESS 0xd0001e3b BIT_MASK 0x1 /end MEASUREMENT
/begin CHARACTERISTIC ip_fac_tq_drof_fac_tq_req_mon "Correction FAC_TQ_REQ_MON" CURVE 0xa080ca5e _REC_CUR_20_u1_u1 1.9921875 _CNV_A_R_LINEAR_____103_CM 0. 1.9921875 DISPLAY_IDENTIFIER IP_FAC_TQ_DROF_FAC_TQ_REQ_MON FORMAT "%5.3"
 /begin AXIS_DESCR COM_AXIS fac_tq_req_mon _CNV_A_R_LINEAR_____103_CM 6 0. 1.9921875 FORMAT "%5.3" AXIS_PTS_REF ldp_fac_tq_req_mon__tq_drof /end AXIS_DESCR
/end CHARACTERISTIC
/begin CHARACTERISTIC c_n_dif_drof_max_mon "Maximum threshold N_DIF_DROF_MON" VALUE 0xa080cc9c _REC_VAL_20_u1 326.4 _CNV_A_R_LINEAR_____240_CM -4096. 4064. DISPLAY_IDENTIFIER C_N_DIF_DROF_MAX_MON FORMAT "%5.0" /end CHARACTERISTIC
/begin CHARACTERISTIC c_n_dif_drof_min_mon "Minimum threshold N_DIF_DROF_MON" VALUE 0xa080cc9d _REC_VAL_20_u1 326.4 _CNV_A_R_LINEAR_____240_CM -4096. 4064. DISPLAY_IDENTIFIER C_N_DIF_DROF_MIN_MON FORMAT "%5.0" /end CHARACTERISTIC
/begin CHARACTERISTIC c_n_dif_add_drof_mon "Offset threshold N_DIF_DROF_MON" VALUE 0xa080cc99 _REC_VAL_20_u1 326.4 _CNV_A_R_LINEAR_____240_CM -4096. 4064. DISPLAY_IDENTIFIER C_N_DIF_ADD_DROF_MON FORMAT "%5.0" /end CHARACTERISTIC
/begin CHARACTERISTIC ip_tq_drof_mon "Drive off torque request" CURVE 0xa080cb7c _REC_CUR_20_u2_u1 2047.96875 _CNV_A_R_LINEAR_____87_CM -1024. 1023.96875 DISPLAY_IDENTIFIER IP_TQ_DROF_MON FORMAT "%6.2"
 /begin AXIS_DESCR COM_AXIS n_dif_drof_mon _CNV_A_R_LINEAR_____240_CM 6 -4096. 4064. FORMAT "%5.0" AXIS_PTS_REF ldp_n_dif_drof_mon__tq_drof /end AXIS_DESCR
/end CHARACTERISTIC
/begin AXIS_PTS ldp_vs_mon__tq_drof "" 0xa080c8a8 vs_mon _REC_AXS_20_u2 511.99218 _CNV_A_R_LINEAR_____86_CM 6 0. 511.99218 FORMAT "%7.3" /end AXIS_PTS
/begin AXIS_PTS ldp_n_32_mon__tq_drof "" 0xa080c790 n_32_mon _REC_AXS_20_u1 816. _CNV_A_R_LINEAR_____10_CM 6 0. 8160. FORMAT "%4.0" /end AXIS_PTS
/begin CHARACTERISTIC ip_fac_tq_drof_vs_mon "Correction depending on N_32 and VS" MAP 0xa080ca64 _REC_MAP_20_u1_u2_u1 1.9921875 _CNV_A_R_LINEAR_____103_CM 0. 1.9921875 DISPLAY_IDENTIFIER IP_FAC_TQ_DROF_VS_MON FORMAT "%5.3"
 /begin AXIS_DESCR COM_AXIS vs_mon _CNV_A_R_LINEAR_____86_CM 6 0. 511.99218 FORMAT "%7.3" AXIS_PTS_REF ldp_vs_mon__tq_drof /end AXIS_DESCR
 /begin AXIS_DESCR COM_AXIS n_32_mon _CNV_A_R_LINEAR_____10_CM 6 0. 8160. FORMAT "%4.0" AXIS_PTS_REF ldp_n_32_mon__tq_drof /end AXIS_DESCR
/end CHARACTERISTIC
/begin CHARACTERISTIC c_n_32_tq_drof_max_mon "Minimum threshold N_DIF_DROF_MON" VALUE 0xa080cc98 _REC_VAL_20_u1 326.4 _CNV_A_R_LINEAR_____10_CM 0. 8160. DISPLAY_IDENTIFIER C_N_32_TQ_DROF_MAX_MON FORMAT "%4.0" /end CHARACTERISTIC
/begin MEASUREMENT tq_av_mon "Effective torque" SWORD _CNV_A_R_LINEAR_____31_CM 1 100. -1024. 1023.96875 DISPLAY_IDENTIFIER TQ_AV_MON ECU_ADDRESS 0xd0001d8a FORMAT "%8.2" /end MEASUREMENT
/begin CHARACTERISTIC c_v_sof_swi_min_mon "Input voltage threshold min" VALUE 0xa080cd02 _REC_VAL_20_u2 4.9951171875 _CNV_A_R_LINEAR_____2_CM 0. 4.9951171875 DISPLAY_IDENTIFIER C_V_SOF_SWI_MIN_MON FORMAT "%5.3" /end CHARACTERISTIC
/begin CHARACTERISTIC c_v_sof_swi_max_mon "Input voltage threshold max" VALUE 0xa080cd00 _REC_VAL_20_u2 4.9951171875 _CNV_A_R_LINEAR_____2_CM 0. 4.9951171875 DISPLAY_IDENTIFIER C_V_SOF_SWI_MAX_MON FORMAT "%5.3" /end CHARACTERISTIC
/begin MEASUREMENT state_pas_ramp_act_p_d_is_mon "Circular buffer indicating statuts of PD-part deactivation ramp" UBYTE _CNV_A_R_LINEAR_____0_CM 1 100. 0. 255. DISPLAY_IDENTIFIER STATE_PAS_RAMP_ACT_P_D_IS_MON ECU_ADDRESS 0xd000740b FORMAT "%3.0" /end MEASUREMENT
/begin CHARACTERISTIC c_pv_av_sof_min_mon "PV_AV threshold for activation IP_FAC_TQ_REQ_DRIV_RNG_L_MON" VALUE 0xa080ccb1 _REC_VAL_20_u1 99.609375 _CNV_A_R_LINEAR_____5_CM 0. 99.609375 DISPLAY_IDENTIFIER C_PV_AV_SOF_MIN_MON FORMAT "%4.1" /end CHARACTERISTIC
/begin CHARACTERISTIC c_fac_tq_req_driv_sof_max_mon "Scaling factor threshold for activation IP_FAC_TQ_REQ_DRIV_RNG_L_MON" VALUE 0xa080cc87 _REC_VAL_20_u1 1.99220002 _CNV_A_R_LINEAR_____100_CM 0. 1.99220002 DISPLAY_IDENTIFIER C_FAC_TQ_REQ_DRIV_SOF_MAX_MON FORMAT "%5.3" /end CHARACTERISTIC
/begin CHARACTERISTIC c_pv_av_grd_sof_max_mon "Pedal value gradient rheshold for recognition of LV_RNG_L_MON" VALUE 0xa080ccb0 _REC_VAL_20_u1 2490.234 _CNV_A_R_LINEAR_____535_CM -1250. 1240.234 DISPLAY_IDENTIFIER C_PV_AV_GRD_SOF_MAX_MON FORMAT "%6.1" /end CHARACTERISTIC
/begin CHARACTERISTIC c_t_pv_av_grd_sof_max_mon "Minimum time for pedal value gradient for recognition of LV_RNG_L_MON" VALUE 0xa080ccc5 _REC_VAL_20_u1 10.2 _CNV_A_R_LINEAR_____261_CM 0. 10.2 DISPLAY_IDENTIFIER C_T_PV_AV_GRD_SOF_MAX_MON FORMAT "%5.2" /end CHARACTERISTIC
/begin CHARACTERISTIC lc_rng_l_man_as_mon "Calibration constant for to activate IP_FAC_TQ_REQ_DRIV_RNG_L (low range mode) in case if LV_RNG_L = 0 (default value = 0)" VALUE 0xa080cd1e _REC_VAL_20_u1 1. _CNV_A_R_LINEAR_____0_CM 0. 1. DISPLAY_IDENTIFIER LC_RNG_L_MAN_AS_MON FORMAT "%2.0" /end CHARACTERISTIC
/begin AXIS_PTS ldp_n_dif_drof_mon__tq_drof "" 0xa080c7d0 n_dif_drof_mon _REC_AXS_20_u1 8160. _CNV_A_R_LINEAR_____240_CM 6 -4096. 4064. FORMAT "%5.0" /end AXIS_PTS
/begin AXIS_PTS ldp_dffgen_fil_mon__loss_mon "" 0xa080c6c6 dffgen_fil_mon _REC_AXS_20_u1 99.609375 _CNV_A_R_LINEAR_____5_CM 6 0. 99.609375 FORMAT "%9.6" /end AXIS_PTS
/begin AXIS_PTS ldpm_n_alter_mon__tq_loss_mon "" 0xa080c900 n_alter_mon _REC_AXS_20_u2 65535. _CNV_A_R_LINEAR_____14_CM 6 0. 65535. FORMAT "%5.0" /end AXIS_PTS
/begin MEASUREMENT v_tps_1_mon[0] "Channel 1 of TPS for monitoring" UWORD _CNV_A_R_LINEAR_____2_CM 1 100. 0. 4.9951171875 DISPLAY_IDENTIFIER V_TPS_1_MON[1] ECU_ADDRESS 0xd00065e4 FORMAT "%5.3" /end MEASUREMENT
/begin MEASUREMENT v_tps_1_mon[1] "Channel 1 of TPS for monitoring" UWORD _CNV_A_R_LINEAR_____2_CM 1 100. 0. 4.9951171875 DISPLAY_IDENTIFIER V_TPS_1_MON[2] ECU_ADDRESS 0xd00065e6 FORMAT "%5.3" /end MEASUREMENT
/begin MEASUREMENT v_tps_2_mon[0] "Channel 2 of TPS for monitoring" UWORD _CNV_A_R_LINEAR_____2_CM 1 100. 0. 4.9951171875 DISPLAY_IDENTIFIER V_TPS_2_MON[1] ECU_ADDRESS 0xd00065e8 FORMAT "%5.3" /end MEASUREMENT
/begin MEASUREMENT v_tps_2_mon[1] "Channel 2 of TPS for monitoring" UWORD _CNV_A_R_LINEAR_____2_CM 1 100. 0. 4.9951171875 DISPLAY_IDENTIFIER V_TPS_2_MON[2] ECU_ADDRESS 0xd00065ea FORMAT "%5.3" /end MEASUREMENT
/begin MEASUREMENT tq_loss_pste_mon "Power steering torque losses" SWORD _CNV_A_R_LINEAR_____31_CM 1 100. -1024. 1023.96875 DISPLAY_IDENTIFIER TQ_LOSS_PSTE_MON ECU_ADDRESS 0xd0001dac FORMAT "%11.5" /end MEASUREMENT
/begin MEASUREMENT tq_conv_max_mon "Monitored value of converter torque losses" UBYTE _CNV_A_R_LINEAR_____262_CM 1 100. 0. 510. DISPLAY_IDENTIFIER TQ_CONV_MAX_MON ECU_ADDRESS 0xd000740e FORMAT "%3.0" /end MEASUREMENT
/begin MEASUREMENT tq_conv_max_mdl_mon "Maximum converter torque losses" UBYTE _CNV_A_R_LINEAR_____262_CM 1 100. 0. 510. DISPLAY_IDENTIFIER TQ_CONV_MAX_MDL_MON ECU_ADDRESS 0xd0001e28 FORMAT "%3.0" /end MEASUREMENT
/begin CHARACTERISTIC c_tq_dif_is_ad_conv_max_mon "Max.limitation for converter torque adaptation" VALUE 0xa080ccdc _REC_VAL_20_u1 510. _CNV_A_R_LINEAR_____262_CM 0. 510. DISPLAY_IDENTIFIER C_TQ_DIF_IS_AD_CONV_MAX_MON FORMAT "%3.0" /end CHARACTERISTIC
/begin CHARACTERISTIC c_n_dif_fac_mon "Multiplicative factor for n_dif_cor calculation" VALUE 0xa080cc9e _REC_VAL_20_u1 0.99609375 _CNV_A_R_LINEAR_____185_CM 0. 0.99609375 DISPLAY_IDENTIFIER C_N_DIF_FAC_MON FORMAT "%5.3" /end CHARACTERISTIC
/begin CHARACTERISTIC c_n_dif_hys_is_pu_mon "N_DIF_MON hysteresis before state PU" VALUE 0xa080cc9f _REC_VAL_20_s1 8160. _CNV_A_R_LINEAR_____10_CM -4096. 4064. DISPLAY_IDENTIFIER C_N_DIF_HYS_IS_PU_MON FORMAT "%5.0" /end CHARACTERISTIC
/begin CHARACTERISTIC lc_tq_drof_isc_off_mon "N_DIF_MON hysteresis before state PU" VALUE 0xa080cd22 _REC_VAL_20_u1 1. _CNV_A_R_LINEAR_____0_CM 0. 1. DISPLAY_IDENTIFIER LC_TQ_DROF_ISC_OFF_MON FORMAT "%1.0" /end CHARACTERISTIC
/begin CHARACTERISTIC lc_swi_opm_av_mon "N_DIF_MON hysteresis before state PU" VALUE 0xa080cd21 _REC_VAL_20_u1 1. _CNV_A_R_LINEAR_____0_CM 0. 1. DISPLAY_IDENTIFIER LC_SWI_OPM_AV_MON FORMAT "%1.0" /end CHARACTERISTIC
/begin CHARACTERISTIC c_swi_opm_av_mon "N_DIF_MON hysteresis before state PU" VALUE 0xa080ccb5 _REC_VAL_20_u1 3. _CNV_A_R_LINEAR_____0_CM 0. 3. DISPLAY_IDENTIFIER C_SWI_OPM_AV_MON FORMAT "%1.0" /end CHARACTERISTIC
/begin MEASUREMENT lv_igk_mon "Logical variable for ignition key on" UBYTE _CNV_S_2_RANGE__0___1_CM 1 100. 0. 1. DISPLAY_IDENTIFIER LV_IGK_MON ECU_ADDRESS 0xd0007440 BIT_MASK 0x1 /end MEASUREMENT
/begin MEASUREMENT lv_sf_tqd_mon "Logical variable for ignition key on" UBYTE _CNV_S_2_RANGE__0___1_CM 1 100. 0. 1. DISPLAY_IDENTIFIER LV_SF_TQD_MON ECU_ADDRESS 0xd0007454 BIT_MASK 0x1 /end MEASUREMENT
/begin MEASUREMENT gr_dt_mdl_mon "Logical variable for ignition key on" UWORD _CNV_A_R_LINEAR_____116_CM 1 100. 0. 63.99902344 DISPLAY_IDENTIFIER GR_DT_MDL_MON ECU_ADDRESS 0xd00065aa FORMAT "%7.4" /end MEASUREMENT
/begin CHARACTERISTIC c_vs_lih_mon "Vehicle speed monitoring value in case of error" VALUE 0xa080cd16 _REC_VAL_20_u2 511.99218 _CNV_A_R_LINEAR_____86_CM 0. 511.99218 DISPLAY_IDENTIFIER C_VS_LIH_MON FORMAT "%7.3" /end CHARACTERISTIC
/begin CHARACTERISTIC c_fac_rax_mon "Vehicle speed monitoring value in case of error" VALUE 0xa080cc86 _REC_VAL_20_u1 7.96875 _CNV_A_R_LINEAR_____834_CM 0. 7.96875 DISPLAY_IDENTIFIER C_FAC_RAX_MON FORMAT "%5.3" /end CHARACTERISTIC
/begin CHARACTERISTIC c_fac_gr_dif_mon "Vehicle speed monitoring value in case of error" VALUE 0xa080cc79 _REC_VAL_20_u1 1.9921875 _CNV_A_R_LINEAR_____103_CM 0. 1.9921875 DISPLAY_IDENTIFIER C_FAC_GR_DIF_MON FORMAT "%5.3" /end CHARACTERISTIC
/begin CHARACTERISTIC c_fac_gr_min_mon "Vehicle speed monitoring value in case of error" VALUE 0xa080cc7b _REC_VAL_20_u1 31.99 _CNV_A_R_LINEAR_____837_CM 0. 31.99 DISPLAY_IDENTIFIER C_FAC_GR_MIN_MON FORMAT "%4.1" /end CHARACTERISTIC
/begin MEASUREMENT tq_add_min_clu_mon "Additional torque request from external sources " SWORD _CNV_A_R_LINEAR_____31_CM 1 100. -1024. 1023.96875 DISPLAY_IDENTIFIER TQ_ADD_MIN_CLU_MON ECU_ADDRESS 0xd00065bc FORMAT "%11.5" /end MEASUREMENT
/begin MEASUREMENT lv_swi_tq_min_clu_mon "Idle speed setpoint from external influences" UBYTE _CNV_S_2_RANGE__0___1_CM 1 100. 0. 1. DISPLAY_IDENTIFIER LV_SWI_TQ_MIN_CLU_MON ECU_ADDRESS 0xd000745c BIT_MASK 0x1 /end MEASUREMENT
/begin MEASUREMENT lv_sof_swi_req_mon "Idle speed setpoint from external influences" UBYTE _CNV_S_2_RANGE__0___1_CM 1 100. 0. 1. DISPLAY_IDENTIFIER LV_SOF_SWI_REQ_MON ECU_ADDRESS 0xd0007455 BIT_MASK 0x1 /end MEASUREMENT
/begin MEASUREMENT lv_sof_swi_mon "Idle speed setpoint from external influences" UBYTE _CNV_S_2_RANGE__0___1_CM 1 100. 0. 1. DISPLAY_IDENTIFIER LV_SOF_SWI_MON ECU_ADDRESS 0xd0001e58 BIT_MASK 0x1 /end MEASUREMENT
/begin CHARACTERISTIC c_fac_gr_max_mon "Vehicle speed monitoring value in case of error" VALUE 0xa080cc7a _REC_VAL_20_u1 31.99 _CNV_A_R_LINEAR_____837_CM 0. 31.99 DISPLAY_IDENTIFIER C_FAC_GR_MAX_MON FORMAT "%4.1" /end CHARACTERISTIC
/begin CHARACTERISTIC c_v_sof_swi_on_tol_mon "Vehicle speed monitoring value in case of error" VALUE 0xa080cd06 _REC_VAL_20_u2 4.9951171875 _CNV_A_R_LINEAR_____2_CM 0. 4.9951171875 DISPLAY_IDENTIFIER C_V_SOF_SWI_ON_TOL_MON FORMAT "%5.3" /end CHARACTERISTIC
/begin CHARACTERISTIC lc_var_sof_swi_mon "Vehicle speed monitoring value in case of error" VALUE 0xa080cd23 _REC_VAL_20_u1 1. _CNV_A_R_LINEAR_____0_CM 0. 1. DISPLAY_IDENTIFIER LC_VAR_SOF_SWI_MON FORMAT "%1.0" /end CHARACTERISTIC
/begin CHARACTERISTIC lc_rng_l_mon "Vehicle speed monitoring value in case of error" VALUE 0xa080cd1f _REC_VAL_20_u1 1. _CNV_A_R_LINEAR_____0_CM 0. 1. DISPLAY_IDENTIFIER LC_RNG_L_MON FORMAT "%1.0" /end CHARACTERISTIC
/begin CHARACTERISTIC lc_conf_city_ena_mon "Vehicle speed monitoring value in case of error" VALUE 0xa080cd1a _REC_VAL_20_u1 1. _CNV_A_R_LINEAR_____0_CM 0. 1. DISPLAY_IDENTIFIER LC_CONF_CITY_ENA_MON FORMAT "%1.0" /end CHARACTERISTIC
/begin MEASUREMENT lv_swi_fac_tq_req_mon "Idle speed setpoint from external influences" UBYTE _CNV_S_2_RANGE__0___1_CM 1 100. 0. 1. DISPLAY_IDENTIFIER LV_SWI_FAC_TQ_REQ_MON ECU_ADDRESS 0xd000745b BIT_MASK 0x1 /end MEASUREMENT
/begin MEASUREMENT lv_err_sof_inh_mon "Idle speed setpoint from external influences" UBYTE _CNV_S_2_RANGE__0___1_CM 1 100. 0. 1. DISPLAY_IDENTIFIER LV_ERR_SOF_INH_MON ECU_ADDRESS 0xd000742d BIT_MASK 0x1 /end MEASUREMENT
/begin MEASUREMENT abc_sof_inh_mon "Idle speed setpoint from external influences" UBYTE _CNV_A_R_LINEAR_____0_CM 1 100. 0. 255. DISPLAY_IDENTIFIER ABC_SOF_INH_MON ECU_ADDRESS 0xd0001ddf FORMAT "%3.0" BIT_MASK 0x1 /end MEASUREMENT
/begin MEASUREMENT lv_err_cru_inh_mon "Logical variable for ignition key on" UBYTE _CNV_S_2_RANGE__0___1_CM 1 100. 0. 1. DISPLAY_IDENTIFIER LV_ERR_CRU_INH_MON ECU_ADDRESS 0xd000741c BIT_MASK 0x1 /end MEASUREMENT
/begin MEASUREMENT lv_msr_inh_mon "Logical variable for ignition key on" UBYTE _CNV_S_2_RANGE__0___1_CM 1 100. 0. 1. DISPLAY_IDENTIFIER LV_MSR_INH_MON ECU_ADDRESS 0xd000744a BIT_MASK 0x1 /end MEASUREMENT
/begin MEASUREMENT lv_gs_inh_mon "Logical variable for ignition key on" UBYTE _CNV_S_2_RANGE__0___1_CM 1 100. 0. 1. DISPLAY_IDENTIFIER LV_GS_INH_MON ECU_ADDRESS 0xd000743f BIT_MASK 0x1 /end MEASUREMENT
/begin MEASUREMENT gr_dt_mon "Logical variable for ignition key on" UWORD _CNV_A_R_LINEAR_____116_CM 1 100. 0. 63.99902344 DISPLAY_IDENTIFIER GR_DT_MON ECU_ADDRESS 0xd00065ac FORMAT "%7.4" /end MEASUREMENT
/begin MEASUREMENT tqi_inc_can_mon "Logical variable for ignition key on" UWORD _CNV_A_R_LINEAR_____31_CM 1 100. 0. 1023.96875 DISPLAY_IDENTIFIER TQI_INC_CAN_MON ECU_ADDRESS 0xd00065da FORMAT "%7.2" /end MEASUREMENT
/begin MEASUREMENT tq_loss_alter_mon "Alternator torque losses" SWORD _CNV_A_R_LINEAR_____31_CM 1 100. -1024. 1023.96875 DISPLAY_IDENTIFIER TQ_LOSS_ALTER_MON ECU_ADDRESS 0xd0001d9c FORMAT "%11.5" /end MEASUREMENT
/begin MEASUREMENT tq_loss_alter_mdl_mon "Alternator torque losses" SWORD _CNV_A_R_LINEAR_____31_CM 1 100. -1024. 1023.96875 DISPLAY_IDENTIFIER TQ_LOSS_ALTER_MDL_MON ECU_ADDRESS 0xd0001d9a FORMAT "%11.5" /end MEASUREMENT
/begin MEASUREMENT n_sp_is_bas_mon "Plausiblised basis idle-speed setpoint" UBYTE _CNV_A_R_LINEAR_____10_CM 1 100. 0. 8160. DISPLAY_IDENTIFIER N_SP_IS_BAS_MON ECU_ADDRESS 0xd0001e0c FORMAT "%4.0" /end MEASUREMENT
/begin MEASUREMENT n_sp_is_cs_mon "Idle-speed setpoint given by DROF" UBYTE _CNV_A_R_LINEAR_____10_CM 1 100. 0. 8160. DISPLAY_IDENTIFIER N_SP_IS_CS_MON ECU_ADDRESS 0xd0001e0d FORMAT "%4.0" /end MEASUREMENT
/begin MEASUREMENT n_sp_is_ext_adj_mon "Idle-speed setpoint given by external tester demand" UBYTE _CNV_A_R_LINEAR_____10_CM 1 100. 0. 8160. DISPLAY_IDENTIFIER N_SP_IS_EXT_ADJ_MON ECU_ADDRESS 0xd0001e0e FORMAT "%4.0" /end MEASUREMENT
/begin MEASUREMENT gr_mt_mon "Monitored value of manual transmission gear" UBYTE _CNV_A_R_LINEAR_____0_CM 1 100. 0. 255. DISPLAY_IDENTIFIER GR_MT_MON ECU_ADDRESS 0xd0001e04 FORMAT "%3.0" /end MEASUREMENT
/begin MEASUREMENT n_vs_ratio_mon "Monitored engine speed / vehicle speed ratio" UBYTE _CNV_A_R_LINEAR_____838_CM 1 100. 0. 255. DISPLAY_IDENTIFIER N_VS_RATIO_MON ECU_ADDRESS 0xd0001e10 FORMAT "%5.0" /end MEASUREMENT
/begin MEASUREMENT lv_ct_mon "Logical bit for detection of driver request passive" UBYTE _CNV_S_2_RANGE__0___1_CM 1 100. 0. 1. DISPLAY_IDENTIFIER LV_CT_MON ECU_ADDRESS 0xd0007417 BIT_MASK 0x1 /end MEASUREMENT
/begin MEASUREMENT lv_act_n_sp_is_ext_adj_mon "Logical bit for detection of driver request passive" UBYTE _CNV_S_2_RANGE__0___1_CM 1 100. 0. 1. DISPLAY_IDENTIFIER LV_ACT_N_SP_IS_EXT_ADJ_MON ECU_ADDRESS 0xd0001e38 BIT_MASK 0x1 /end MEASUREMENT
/begin CHARACTERISTIC c_n_sp_is_lih_max_mon "Multiplicative factor for n_dif_cor calculation" VALUE 0xa080cca9 _REC_VAL_20_u1 8160. _CNV_A_R_LINEAR_____10_CM 0. 8160. DISPLAY_IDENTIFIER C_N_SP_IS_LIH_MAX_MON FORMAT "%4.0" /end CHARACTERISTIC
/begin CHARACTERISTIC c_n_sp_dec_cs_mon "Decrement for idle speed SP while DROF is active" VALUE 0xa080cca5 _REC_VAL_20_u1 8160. _CNV_A_R_LINEAR_____10_CM 0. 8160. DISPLAY_IDENTIFIER C_N_SP_DEC_CS_MON FORMAT "%4.0" /end CHARACTERISTIC
/begin CHARACTERISTIC c_n_sp_lgrd_is_mon "Increment / decrement for idle speed SP while external tester demand is active" VALUE 0xa080ccab _REC_VAL_20_u1 8160. _CNV_A_R_LINEAR_____10_CM 0. 8160. DISPLAY_IDENTIFIER C_N_SP_LGRD_IS_MON FORMAT "%4.0" /end CHARACTERISTIC
/begin CHARACTERISTIC c_n_sp_is_max_ext_adj_mon "Maximum idle-speed setpoint when external Tester demand is active" VALUE 0xa080ccaa _REC_VAL_20_u1 8160. _CNV_A_R_LINEAR_____10_CM 0. 8160. DISPLAY_IDENTIFIER C_N_SP_IS_MAX_EXT_ADJ_MON FORMAT "%4.0" /end CHARACTERISTIC
/begin CHARACTERISTIC c_n_max_kwp_mon "Maximum engine speed for accepting the EOL- N_SP_IS_MON displace service" VALUE 0xa080cca1 _REC_VAL_20_u1 8160. _CNV_A_R_LINEAR_____10_CM 0. 8160. DISPLAY_IDENTIFIER C_N_MAX_KWP_MON FORMAT "%4.0" /end CHARACTERISTIC
/begin CHARACTERISTIC c_vs_max_kwp_mon "Maximum vehicle speed for accepting the EOL- N_SP_IS_MON displace service" VALUE 0xa080cd18 _REC_VAL_20_u1 255. _CNV_A_R_LINEAR_____6_CM 0. 255. DISPLAY_IDENTIFIER C_VS_MAX_KWP_MON FORMAT "%3.0" /end CHARACTERISTIC
/begin CHARACTERISTIC c_min_vs_ratio_mon "Minimum engine speed for the calculation of the monitored engine speed / vehicle speed ratio " VALUE 0xa080cc92 _REC_VAL_20_u1 255. _CNV_A_R_LINEAR_____6_CM 0. 255. DISPLAY_IDENTIFIER C_MIN_VS_RATIO_MON FORMAT "%3.0" /end CHARACTERISTIC
/begin MEASUREMENT n_sp_is_ext_req_mon "Plausible basis idle-speed setpoint while DROF or external tester demand active" UBYTE _CNV_A_R_LINEAR_____10_CM 1 100. 0. 8160. DISPLAY_IDENTIFIER N_SP_IS_EXT_REQ_MON ECU_ADDRESS 0xd0001e0f FORMAT "%4.0" /end MEASUREMENT
/begin AXIS_PTS ldp_n_dif_drof_mon__id_tq_drof "" 0xa080c7cc n_dif_drof_mon _REC_AXS_20_u1 8160. _CNV_A_R_LINEAR_____240_CM 3 -4096. 4064. FORMAT "%5.0" /end AXIS_PTS
/begin AXIS_PTS ldp_n_vs_ratio_mon_gr_mt_mon "" 0xa080c7ec n_vs_ratio_mon _REC_AXS_20_u1 255. _CNV_A_R_LINEAR_____838_CM 13 0. 255. FORMAT "%5.0" /end AXIS_PTS
/begin CHARACTERISTIC id_tq_drof_ena_mon "Correction depending on VS and N_32" CURVE 0xa080c92a _REC_CUR_20_u1_u1 1. _CNV_A_R_LINEAR_____0_CM 0. 1. DISPLAY_IDENTIFIER ID_TQ_DROF_ENA_MON FORMAT "%2.0"
 /begin AXIS_DESCR COM_AXIS n_dif_drof_mon _CNV_A_R_LINEAR_____240_CM 3 -4096. 4064. FORMAT "%5.0" AXIS_PTS_REF ldp_n_dif_drof_mon__id_tq_drof /end AXIS_DESCR
/end CHARACTERISTIC
/begin CHARACTERISTIC id_gr_mt_mon "Index table for Gear Ratio detection in the monitoring level" CURVE 0xa080c91c _REC_CUR_20_u1_u1 255. _CNV_A_R_LINEAR_____0_CM 0. 255. DISPLAY_IDENTIFIER ID_GR_MT_MON FORMAT "%3.0"
 /begin AXIS_DESCR COM_AXIS n_vs_ratio_mon _CNV_A_R_LINEAR_____838_CM 13 0. 255. FORMAT "%5.0" AXIS_PTS_REF ldp_n_vs_ratio_mon_gr_mt_mon /end AXIS_DESCR
/end CHARACTERISTIC
/begin CHARACTERISTIC c_fac_mff_add_cp_min_mon "Vehicle speed monitoring value in case of error" VALUE 0xa080cc7d _REC_VAL_20_u1 1.9921875 _CNV_A_R_LINEAR_____103_CM 0. 1.9921875 DISPLAY_IDENTIFIER C_FAC_MFF_ADD_CP_MIN_MON FORMAT "%8.6" /end CHARACTERISTIC
/begin MEASUREMENT tq_loss_add_mon "Additional torque losses" SWORD _CNV_A_R_LINEAR_____31_CM 1 100. -1024. 1023.96875 DISPLAY_IDENTIFIER TQ_LOSS_ADD_MON ECU_ADDRESS 0xd00065cc FORMAT "%11.5" /end MEASUREMENT
/begin MEASUREMENT eff_mff_tq_cor_mon "efficiency on torque relevant mass fuel flow " UBYTE _CNV_A_R_LINEAR_____103_CM 1 100. 0. 1.9921875 DISPLAY_IDENTIFIER EFF_MFF_TQ_COR_MON ECU_ADDRESS 0xd00073d0 FORMAT "%8.6" /end MEASUREMENT
/begin MEASUREMENT lv_rng_l_mon "Idle speed setpoint from external influences" UBYTE _CNV_S_2_RANGE__0___1_CM 1 100. 0. 1. DISPLAY_IDENTIFIER LV_RNG_L_MON ECU_ADDRESS 0xd0007453 BIT_MASK 0x1 /end MEASUREMENT
/begin MEASUREMENT lv_rng_l_at_mon "logical variable for engaged low range AT monitoring" UBYTE _CNV_S_2_RANGE__0___1_CM 1 100. 0. 1. DISPLAY_IDENTIFIER LV_RNG_L_AT_MON ECU_ADDRESS 0xd0007452 BIT_MASK 0x1 /end MEASUREMENT
/begin CHARACTERISTIC c_v_sof_swi_on_bol_mon "Vehicle speed monitoring value in case of error" VALUE 0xa080cd04 _REC_VAL_20_u2 4.9951171875 _CNV_A_R_LINEAR_____2_CM 0. 4.9951171875 DISPLAY_IDENTIFIER C_V_SOF_SWI_ON_BOL_MON FORMAT "%5.3" /end CHARACTERISTIC
/begin CHARACTERISTIC c_state_etcu_prog_info_mon "Manual activation of low range mode AT" VALUE 0xa080ccb4 _REC_VAL_20_u1 15. _CNV_A_R_LINEAR_____0_CM 0. 15. DISPLAY_IDENTIFIER C_STATE_ETCU_PROG_INFO_MON FORMAT "%2.0" /end CHARACTERISTIC
/begin CHARACTERISTIC c_n_sp_inc_cs_mon "Increment for idle speed SP while DROF is active" VALUE 0xa080cca6 _REC_VAL_20_u1 8160. _CNV_A_R_LINEAR_____10_CM 0. 8160. DISPLAY_IDENTIFIER C_N_SP_INC_CS_MON FORMAT "%4.0" /end CHARACTERISTIC
/begin CHARACTERISTIC c_n_sp_is_cs_max_mon "Max. selection of Idle speed setpoint for drive-off-support" VALUE 0xa080cca8 _REC_VAL_20_u1 8160. _CNV_A_R_LINEAR_____10_CM 0. 8160. DISPLAY_IDENTIFIER C_N_SP_IS_CS_MAX_MON FORMAT "%4.0" /end CHARACTERISTIC
/begin AXIS_PTS ldp_tq_av_mon__tq_drof "" 0xa080c880 tq_av_mon _REC_AXS_20_u2 2047.96875 _CNV_A_R_LINEAR_____87_CM 4 -1024. 1023.96875 FORMAT "%6.2" /end AXIS_PTS
/begin AXIS_PTS ldp_tq_drof_mdl_mon_1 "" 0xa080c88c tq_drof_mdl_mon _REC_AXS_20_u2 2047.96875 _CNV_A_R_LINEAR_____87_CM 3 -1024. 1023.96875 FORMAT "%11.5" /end AXIS_PTS
/begin CHARACTERISTIC ip_fac_n_grd_tq_av_mon "N_DIF correction" CURVE 0xa080ca30 _REC_CUR_20_u1_u2 1.9921875 _CNV_A_R_LINEAR_____103_CM 0. 1.9921875 DISPLAY_IDENTIFIER IP_FAC_N_GRD_TQ_AV_MON FORMAT "%5.3"
 /begin AXIS_DESCR COM_AXIS tq_av_mon _CNV_A_R_LINEAR_____87_CM 4 -1024. 1023.96875 FORMAT "%6.2" AXIS_PTS_REF ldp_tq_av_mon__tq_drof /end AXIS_DESCR
/end CHARACTERISTIC
/begin AXIS_PTS ldp_fac_tq_req_mon__tq_drof "" 0xa080c6fe fac_tq_req_mon _REC_AXS_20_u1 1.9921875 _CNV_A_R_LINEAR_____103_CM 6 0. 1.9921875 FORMAT "%5.3" /end AXIS_PTS
/begin AXIS_PTS ldp_n_32_mon_ip_tqi_pu_max_mon "" 0xa080c7c4 n_32_mon _REC_AXS_20_u1 8160. _CNV_A_R_LINEAR_____10_CM 6 0. 8160. FORMAT "%4.0" /end AXIS_PTS
/begin CHARACTERISTIC ip_tq_drof_grd_deac_mon "Decrement for the termination ramp of TQ_DROF_MDL_MON" CURVE 0xa080cb74 _REC_CUR_20_u2_u2 1023.96875 _CNV_A_R_LINEAR_____31_CM 0. 1023.96875 DISPLAY_IDENTIFIER IP_TQ_DROF_GRD_DEAC_MON FORMAT "%7.2"
 /begin AXIS_DESCR COM_AXIS tq_drof_mdl_mon _CNV_A_R_LINEAR_____87_CM 3 -1024. 1023.96875 FORMAT "%11.5" AXIS_PTS_REF ldp_tq_drof_mdl_mon_1 /end AXIS_DESCR
/end CHARACTERISTIC
/begin CHARACTERISTIC ip_tqi_min_pu_max_mon "Monitoring threshold for minimum indicated torque in PU phase" CURVE 0xa080cbec _REC_CUR_20_u2_u1 1023.96875 _CNV_A_R_LINEAR_____31_CM 0. 1023.96875 DISPLAY_IDENTIFIER IP_TQI_MIN_PU_MAX_MON FORMAT "%7.2"
 /begin AXIS_DESCR COM_AXIS n_32_mon _CNV_A_R_LINEAR_____10_CM 6 0. 8160. FORMAT "%4.0" AXIS_PTS_REF ldp_n_32_mon_ip_tqi_pu_max_mon /end AXIS_DESCR
/end CHARACTERISTIC
/begin MEASUREMENT tqi_inc_ext_mon "Monitored external torque demands" SWORD _CNV_A_R_LINEAR_____31_CM 1 100. -1024. 1023.96875 DISPLAY_IDENTIFIER TQI_INC_EXT_MON ECU_ADDRESS 0xd00065dc FORMAT "%11.5" /end MEASUREMENT
/begin MEASUREMENT tqi_min_pu_mon "Plausiblized L2 value of Minimum indicated torque in PU phase" UWORD _CNV_A_R_LINEAR_____31_CM 1 100. 0. 1023.96875 DISPLAY_IDENTIFIER TQI_MIN_PU_MON ECU_ADDRESS 0xd00065de FORMAT "%10.5" /end MEASUREMENT
/begin MEASUREMENT tqi_min_pu_max_mon "Monitoring threshold for minimum indicated torque in PU phase" UWORD _CNV_A_R_LINEAR_____31_CM 1 100. 0. 1023.96875 DISPLAY_IDENTIFIER TQI_MIN_PU_MAX_MON ECU_ADDRESS 0xd0001dc2 FORMAT "%10.5" /end MEASUREMENT
/begin MEASUREMENT lv_swi_afs_lamb_mon "Logical variable for torque monitoring active" UBYTE _CNV_S_2_RANGE__0___1_CM 1 100. 0. 1. DISPLAY_IDENTIFIER LV_SWI_AFS_LAMB_MON ECU_ADDRESS 0xd0007456 BIT_MASK 0x1 /end MEASUREMENT
/begin MEASUREMENT lv_swi_afs_post_inj_mon "Logical variable for torque monitoring active" UBYTE _CNV_S_2_RANGE__0___1_CM 1 100. 0. 1. DISPLAY_IDENTIFIER LV_SWI_AFS_POST_INJ_MON ECU_ADDRESS 0xd0007459 BIT_MASK 0x1 /end MEASUREMENT
/begin MEASUREMENT iga_ref_hom_cor_ext_mon "Additional torque request from external sources " SWORD _CNV_A_R_LINEAR_____188_CM 1 100. -90. 90. DISPLAY_IDENTIFIER IGA_REF_HOM_COR_EXT_MON ECU_ADDRESS 0xd00073fa FORMAT "%8.4" /end MEASUREMENT
/begin MEASUREMENT iga_ref_homs_cor_ext_mon "Additional torque request from external sources " SWORD _CNV_A_R_LINEAR_____188_CM 1 100. -90. 90. DISPLAY_IDENTIFIER IGA_REF_HOMS_COR_EXT_MON ECU_ADDRESS 0xd00073fc FORMAT "%8.4" /end MEASUREMENT
/begin AXIS_PTS ldp_vs_mon__tq_loss_mon "" 0xa080c8b8 vs_mon _REC_AXS_20_u2 511.99218 _CNV_A_R_LINEAR_____86_CM 6 0. 511.99218 FORMAT "%7.3" /end AXIS_PTS
/begin CHARACTERISTIC c_fac_gr_mon "Vehicle speed monitoring value in case of error" VALUE 0xa080cc7c _REC_VAL_20_u1 2.55 _CNV_A_R_EGCP_LINEA_354_CM 0. 2.55 DISPLAY_IDENTIFIER C_FAC_GR_MON /end CHARACTERISTIC
/begin CHARACTERISTIC c_vp_acq_conv_hys_mon "Maximum allowed difference between the voltage on main controller and on monitoring unit" VALUE 0xa080cd10 _REC_VAL_20_u2 4.99984741210938 _CNV_A_R_ECM2_LINEA_839_CM 0. 4.99984741210938 DISPLAY_IDENTIFIER C_VP_ACQ_CONV_HYS_MON FORMAT "%6.4" /end CHARACTERISTIC
/begin CHARACTERISTIC c_abc_inc_conv_mon "Anti bounce counter increment (additive value in case of ADC error)" VALUE 0xa080cc3e _REC_VAL_20_u1 255. _CNV_A_R_LINEAR_____0_CM 0. 255. DISPLAY_IDENTIFIER C_ABC_INC_CONV_MON FORMAT "%3.0" /end CHARACTERISTIC
/begin CHARACTERISTIC c_abc_max_conv_mon "Value at which ADC error is recognized, when reached" VALUE 0xa080cc59 _REC_VAL_20_u1 254. _CNV_A_R_LINEAR_____0_CM 1. 255. DISPLAY_IDENTIFIER C_ABC_MAX_CONV_MON FORMAT "%3.0" /end CHARACTERISTIC
/begin MEASUREMENT abc_conv_mon "Anti bounce counter ADC error" UBYTE _CNV_A_R_LINEAR_____0_CM 1 100. 0. 255. DISPLAY_IDENTIFIER ABC_CONV_MON ECU_ADDRESS 0xd0001dd5 FORMAT "%3.0" /end MEASUREMENT
/begin MEASUREMENT lv_err_conv_mon "Logical variable for ADC error" UBYTE _CNV_S_2_RANGE__0___1_CM 1 100. 0. 1. DISPLAY_IDENTIFIER LV_ERR_CONV_MON ECU_ADDRESS 0xd000741a BIT_MASK 0x1 /end MEASUREMENT
/begin CHARACTERISTIC c_state_an_dig_err_act_mon "Calibratable value used for provoking an error of the A/D conversion" VALUE 0xa080ccb3 _REC_VAL_20_u1 255. _CNV_A_R_LINEAR_____0_CM 0. 255. DISPLAY_IDENTIFIER C_STATE_AN_DIG_ERR_ACT_MON FORMAT "%3.0" /end CHARACTERISTIC
/begin CHARACTERISTIC c_can_vb_min_diag_mon "Threshold of battery voltage for CAN diagnosis" VALUE 0xa080cc73 _REC_VAL_20_u1 25.8984375 _CNV_A_R_LINEAR_____272_CM 0. 25.8984375 DISPLAY_IDENTIFIER C_CAN_VB_MIN_DIAG_MON FORMAT "%9.6" /end CHARACTERISTIC
/begin MEASUREMENT lv_can_inh_msr_mon "Logical variable to inhibit MSR due to CAN fault" UBYTE _CNV_S_2_RANGE__0___1_CM 1 100. 0. 1. DISPLAY_IDENTIFIER LV_CAN_INH_MSR_MON ECU_ADDRESS 0xd0001e3a BIT_MASK 0x1 /end MEASUREMENT
/begin MEASUREMENT lv_can_inh_gs_mon "Logical variable to inhibit GS due to CAN fault" UBYTE _CNV_S_2_RANGE__0___1_CM 1 100. 0. 1. DISPLAY_IDENTIFIER LV_CAN_INH_GS_MON ECU_ADDRESS 0xd0001e39 BIT_MASK 0x1 /end MEASUREMENT
/begin MEASUREMENT t_gs_inh_mon "Timer for inhibition of GS torque demand in monitoring level" UBYTE _CNV_A_R_LINEAR_____261_CM 1 100. 0. 10.2 DISPLAY_IDENTIFIER T_GS_INH_MON ECU_ADDRESS 0xd0001e1c FORMAT "%5.2" /end MEASUREMENT
/begin MEASUREMENT tqi_gs_mon "Torque demand for Gear Shift" UBYTE _CNV_A_R_LINEAR_____262_CM 1 100. 0. 510. DISPLAY_IDENTIFIER TQI_GS_MON ECU_ADDRESS 0xd0007411 FORMAT "%3.0" /end MEASUREMENT
/begin CHARACTERISTIC c_t_msr_inh_mon "Delay time for disable of MSR torque demand in monitoring level" VALUE 0xa080ccc4 _REC_VAL_20_u1 10.2 _CNV_A_R_LINEAR_____261_CM 0. 10.2 DISPLAY_IDENTIFIER C_T_MSR_INH_MON FORMAT "%5.2" /end CHARACTERISTIC
/begin MEASUREMENT abc_msr_inh_mon "Value of the Gear Shift anti - bounce counter" UBYTE _CNV_A_R_LINEAR_____0_CM 1 100. 0. 255. DISPLAY_IDENTIFIER ABC_MSR_INH_MON ECU_ADDRESS 0xd0001ddc FORMAT "%3.0" /end MEASUREMENT
/begin MEASUREMENT abc_ldm_inh_mon "Value of the Gear Shift anti - bounce counter" UBYTE _CNV_A_R_LINEAR_____0_CM 1 100. 0. 255. DISPLAY_IDENTIFIER ABC_LDM_INH_MON ECU_ADDRESS 0xd0001dda FORMAT "%3.0" /end MEASUREMENT
/begin MEASUREMENT abc_dcc_inh_mon "Value of the Gear Shift anti - bounce counter" UBYTE _CNV_A_R_LINEAR_____0_CM 1 100. 0. 255. DISPLAY_IDENTIFIER ABC_DCC_INH_MON ECU_ADDRESS 0xd0001dd7 FORMAT "%3.0" /end MEASUREMENT
/begin MEASUREMENT abc_gs_inh_mon "Value of the Gear Shift anti - bounce counter" UBYTE _CNV_A_R_LINEAR_____0_CM 1 100. 0. 255. DISPLAY_IDENTIFIER ABC_GS_INH_MON ECU_ADDRESS 0xd0001dd8 FORMAT "%3.0" /end MEASUREMENT
/begin MEASUREMENT t_ldm_inh_mon "Timer for inhibition of MSR torque demand in monitoring level" UBYTE _CNV_A_R_LINEAR_____261_CM 1 100. 0. 10.2 DISPLAY_IDENTIFIER T_LDM_INH_MON ECU_ADDRESS 0xd0001e1e FORMAT "%5.2" /end MEASUREMENT
/begin MEASUREMENT t_ldm_brake_det_mon "Timer for inhibition of MSR torque demand in monitoring level" UBYTE _CNV_A_R_LINEAR_____261_CM 1 100. 0. 10.2 DISPLAY_IDENTIFIER T_LDM_BRAKE_DET_MON ECU_ADDRESS 0xd0001e1d FORMAT "%5.2" /end MEASUREMENT
/begin MEASUREMENT t_dcc_inh_mon "Timer for inhibition of MSR torque demand in monitoring level" UBYTE _CNV_A_R_LINEAR_____261_CM 1 100. 0. 10.2 DISPLAY_IDENTIFIER T_DCC_INH_MON ECU_ADDRESS 0xd0001e1b FORMAT "%5.2" /end MEASUREMENT
/begin MEASUREMENT t_dcc_brake_det_mon "Timer for inhibition of MSR torque demand in monitoring level" UBYTE _CNV_A_R_LINEAR_____261_CM 1 100. 0. 10.2 DISPLAY_IDENTIFIER T_DCC_BRAKE_DET_MON ECU_ADDRESS 0xd0001e1a FORMAT "%5.2" /end MEASUREMENT
/begin MEASUREMENT t_state_amt_2_diag_mon "Timer for inhibition of MSR torque demand in monitoring level" UBYTE _CNV_A_R_LINEAR_____261_CM 1 100. 0. 10.2 DISPLAY_IDENTIFIER T_STATE_AMT_2_DIAG_MON ECU_ADDRESS 0xd0001e21 FORMAT "%5.2" /end MEASUREMENT
/begin MEASUREMENT t_state_amt_3_diag_mon "Timer for inhibition of MSR torque demand in monitoring level" UBYTE _CNV_A_R_LINEAR_____261_CM 1 100. 0. 10.2 DISPLAY_IDENTIFIER T_STATE_AMT_3_DIAG_MON ECU_ADDRESS 0xd0001e22 FORMAT "%5.2" /end MEASUREMENT
/begin MEASUREMENT t_state_clu_amt_diag_mon "Timer for inhibition of MSR torque demand in monitoring level" UBYTE _CNV_A_R_LINEAR_____261_CM 1 100. 0. 10.2 DISPLAY_IDENTIFIER T_STATE_CLU_AMT_DIAG_MON ECU_ADDRESS 0xd0001e23 FORMAT "%5.2" /end MEASUREMENT
/begin MEASUREMENT tqi_amt_plaus_mon "Timer for inhibition of MSR torque demand in monitoring level" UBYTE _CNV_A_R_LINEAR_____261_CM 1 100. 0. 10.2 DISPLAY_IDENTIFIER TQI_AMT_PLAUS_MON ECU_ADDRESS 0xd0001e2b FORMAT "%5.2" /end MEASUREMENT
/begin MEASUREMENT tqi_msr_mon "Torque demand from drag control" UBYTE _CNV_A_R_LINEAR_____262_CM 1 100. 0. 510. DISPLAY_IDENTIFIER TQI_MSR_MON ECU_ADDRESS 0xd0007412 FORMAT "%3.0" /end MEASUREMENT
/begin MEASUREMENT tqi_amt_mon "Torque demand from drag control" UBYTE _CNV_A_R_LINEAR_____262_CM 1 100. 0. 510. DISPLAY_IDENTIFIER TQI_AMT_MON ECU_ADDRESS 0xd000740f FORMAT "%3.0" /end MEASUREMENT
/begin MEASUREMENT t_msr_inh_mon "Timer for inhibition of MSR torque demand in monitoring level" UBYTE _CNV_A_R_LINEAR_____261_CM 1 100. 0. 10.2 DISPLAY_IDENTIFIER T_MSR_INH_MON ECU_ADDRESS 0xd0001e1f FORMAT "%5.2" /end MEASUREMENT
/begin MEASUREMENT t_amt_inh_mon "Timer for inhibition of MSR torque demand in monitoring level" UBYTE _CNV_A_R_LINEAR_____261_CM 1 100. 0. 10.2 DISPLAY_IDENTIFIER T_AMT_INH_MON ECU_ADDRESS 0xd0001e18 FORMAT "%5.2" /end MEASUREMENT
/begin MEASUREMENT lv_err_msr_inh_mon "Fault in MSR present" UBYTE _CNV_S_2_RANGE__0___1_CM 1 100. 0. 1. DISPLAY_IDENTIFIER LV_ERR_MSR_INH_MON ECU_ADDRESS 0xd0007427 BIT_MASK 0x1 /end MEASUREMENT
/begin MEASUREMENT lv_err_ldm_inh_mon "Fault in MSR present" UBYTE _CNV_S_2_RANGE__0___1_CM 1 100. 0. 1. DISPLAY_IDENTIFIER LV_ERR_LDM_INH_MON ECU_ADDRESS 0xd0007423 BIT_MASK 0x1 /end MEASUREMENT
/begin MEASUREMENT lv_err_ldm_mon "Fault in MSR present" UBYTE _CNV_S_2_RANGE__0___1_CM 1 100. 0. 1. DISPLAY_IDENTIFIER LV_ERR_LDM_MON ECU_ADDRESS 0xd0007424 BIT_MASK 0x1 /end MEASUREMENT
/begin MEASUREMENT lv_ldm_off_ecu_mon "Fault in MSR present" UBYTE _CNV_S_2_RANGE__0___1_CM 1 100. 0. 1. DISPLAY_IDENTIFIER LV_LDM_OFF_ECU_MON ECU_ADDRESS 0xd0007446 BIT_MASK 0x1 /end MEASUREMENT
/begin MEASUREMENT lv_ldm_off_ecu_1_mon "Fault in MSR present" UBYTE _CNV_S_2_RANGE__0___1_CM 1 100. 0. 1. DISPLAY_IDENTIFIER LV_LDM_OFF_ECU_1_MON ECU_ADDRESS 0xd0007444 BIT_MASK 0x1 /end MEASUREMENT
/begin MEASUREMENT lv_ldm_off_ecu_2_mon "Fault in MSR present" UBYTE _CNV_S_2_RANGE__0___1_CM 1 100. 0. 1. DISPLAY_IDENTIFIER LV_LDM_OFF_ECU_2_MON ECU_ADDRESS 0xd0007445 BIT_MASK 0x1 /end MEASUREMENT
/begin MEASUREMENT lv_err_dcc_inh_mon "Fault in MSR present" UBYTE _CNV_S_2_RANGE__0___1_CM 1 100. 0. 1. DISPLAY_IDENTIFIER LV_ERR_DCC_INH_MON ECU_ADDRESS 0xd000741f BIT_MASK 0x1 /end MEASUREMENT
/begin MEASUREMENT lv_err_dcc_rev_mon "Fault in MSR present" UBYTE _CNV_S_2_RANGE__0___1_CM 1 100. 0. 1. DISPLAY_IDENTIFIER LV_ERR_DCC_REV_MON ECU_ADDRESS 0xd0007421 BIT_MASK 0x1 /end MEASUREMENT
/begin MEASUREMENT lv_err_dcc_irrev_mon "Fault in MSR present" UBYTE _CNV_S_2_RANGE__0___1_CM 1 100. 0. 1. DISPLAY_IDENTIFIER LV_ERR_DCC_IRREV_MON ECU_ADDRESS 0xd0007420 BIT_MASK 0x1 /end MEASUREMENT
/begin MEASUREMENT lv_dcc_off_ecu_mon "Fault in MSR present" UBYTE _CNV_S_2_RANGE__0___1_CM 1 100. 0. 1. DISPLAY_IDENTIFIER LV_DCC_OFF_ECU_MON ECU_ADDRESS 0xd0007418 BIT_MASK 0x1 /end MEASUREMENT
/begin MEASUREMENT lv_err_amt_inh_mon "Fault in MSR present" UBYTE _CNV_S_2_RANGE__0___1_CM 1 100. 0. 1. DISPLAY_IDENTIFIER LV_ERR_AMT_INH_MON ECU_ADDRESS 0xd0007419 BIT_MASK 0x1 /end MEASUREMENT
/begin MEASUREMENT lv_err_gs_inh_mon "Fault in MSR present" UBYTE _CNV_S_2_RANGE__0___1_CM 1 100. 0. 1. DISPLAY_IDENTIFIER LV_ERR_GS_INH_MON ECU_ADDRESS 0xd0007422 BIT_MASK 0x1 /end MEASUREMENT
/begin MEASUREMENT tq_msr_mon "Fault in MSR present" SWORD _CNV_A_R_LINEAR_____31_CM 1 100. -1024. 1023.96875 DISPLAY_IDENTIFIER TQ_MSR_MON ECU_ADDRESS 0xd00065d6 FORMAT "%8.2" /end MEASUREMENT
/begin MEASUREMENT tq_dcc_mon "Fault in MSR present" SWORD _CNV_A_R_LINEAR_____31_CM 1 100. -1024. 1023.96875 DISPLAY_IDENTIFIER TQ_DCC_MON ECU_ADDRESS 0xd00065c0 FORMAT "%8.2" /end MEASUREMENT
/begin MEASUREMENT tq_amt_mon "Fault in MSR present" SWORD _CNV_A_R_LINEAR_____31_CM 1 100. -1024. 1023.96875 DISPLAY_IDENTIFIER TQ_AMT_MON ECU_ADDRESS 0xd00065be FORMAT "%8.2" /end MEASUREMENT
/begin MEASUREMENT tq_gs_mon "Fault in MSR present" SWORD _CNV_A_R_LINEAR_____31_CM 1 100. -1024. 1023.96875 DISPLAY_IDENTIFIER TQ_GS_MON ECU_ADDRESS 0xd00065ca FORMAT "%8.2" /end MEASUREMENT
/begin MEASUREMENT tq_wheel_ldm_mon "Fault in MSR present" SWORD _CNV_A_R_LINEAR_____64_CM 1 100. -32768. 32767. DISPLAY_IDENTIFIER TQ_WHEEL_LDM_MON ECU_ADDRESS 0xd00065d8 FORMAT "%6.0" /end MEASUREMENT
/begin CHARACTERISTIC c_abc_inc_dcc_rev_mon "Anti bounce counter increment" VALUE 0xa080cc42 _REC_VAL_20_u1 255. _CNV_A_R_LINEAR_____0_CM 0. 255. DISPLAY_IDENTIFIER C_ABC_INC_DCC_REV_MON FORMAT "%3.0" /end CHARACTERISTIC
/begin CHARACTERISTIC c_abc_inc_dcc_irrev_mon "Anti bounce counter increment" VALUE 0xa080cc41 _REC_VAL_20_u1 255. _CNV_A_R_LINEAR_____0_CM 0. 255. DISPLAY_IDENTIFIER C_ABC_INC_DCC_IRREV_MON FORMAT "%3.0" /end CHARACTERISTIC
/begin CHARACTERISTIC c_abc_inc_ldm_inh_mon "Anti bounce counter increment" VALUE 0xa080cc45 _REC_VAL_20_u1 255. _CNV_A_R_LINEAR_____0_CM 0. 255. DISPLAY_IDENTIFIER C_ABC_INC_LDM_INH_MON FORMAT "%3.0" /end CHARACTERISTIC
/begin CHARACTERISTIC c_abc_inc_ldm_mon "Anti bounce counter increment" VALUE 0xa080cc46 _REC_VAL_20_u1 255. _CNV_A_R_LINEAR_____0_CM 0. 255. DISPLAY_IDENTIFIER C_ABC_INC_LDM_MON FORMAT "%3.0" /end CHARACTERISTIC
/begin CHARACTERISTIC c_abc_inc_gs_inh_mon "Anti bounce counter increment" VALUE 0xa080cc43 _REC_VAL_20_u1 255. _CNV_A_R_LINEAR_____0_CM 0. 255. DISPLAY_IDENTIFIER C_ABC_INC_GS_INH_MON FORMAT "%3.0" /end CHARACTERISTIC
/begin CHARACTERISTIC c_abc_max_gs_inh_mon "Maximum value of anti-bounce counter" VALUE 0xa080cc5e _REC_VAL_20_u1 254. _CNV_A_R_LINEAR_____0_CM 1. 255. DISPLAY_IDENTIFIER C_ABC_MAX_GS_INH_MON FORMAT "%3.0" /end CHARACTERISTIC
/begin CHARACTERISTIC c_abc_max_amt_inh_mon "Maximum value of anti-bounce counter" VALUE 0xa080cc58 _REC_VAL_20_u1 254. _CNV_A_R_LINEAR_____0_CM 1. 255. DISPLAY_IDENTIFIER C_ABC_MAX_AMT_INH_MON FORMAT "%3.0" /end CHARACTERISTIC
/begin CHARACTERISTIC c_abc_max_ldm_mon "Maximum value of anti-bounce counter" VALUE 0xa080cc61 _REC_VAL_20_u1 254. _CNV_A_R_LINEAR_____0_CM 1. 255. DISPLAY_IDENTIFIER C_ABC_MAX_LDM_MON FORMAT "%3.0" /end CHARACTERISTIC
/begin CHARACTERISTIC c_abc_max_ldm_inh_mon "Maximum value of anti-bounce counter" VALUE 0xa080cc60 _REC_VAL_20_u1 254. _CNV_A_R_LINEAR_____0_CM 1. 255. DISPLAY_IDENTIFIER C_ABC_MAX_LDM_INH_MON FORMAT "%3.0" /end CHARACTERISTIC
/begin CHARACTERISTIC c_abc_max_dcc_rev_mon "Maximum value of anti-bounce counter" VALUE 0xa080cc5d _REC_VAL_20_u1 254. _CNV_A_R_LINEAR_____0_CM 1. 255. DISPLAY_IDENTIFIER C_ABC_MAX_DCC_REV_MON FORMAT "%3.0" /end CHARACTERISTIC
/begin CHARACTERISTIC c_abc_max_dcc_irrev_mon "Maximum value of anti-bounce counter" VALUE 0xa080cc5c _REC_VAL_20_u1 254. _CNV_A_R_LINEAR_____0_CM 1. 255. DISPLAY_IDENTIFIER C_ABC_MAX_DCC_IRREV_MON FORMAT "%3.0" /end CHARACTERISTIC
/begin CHARACTERISTIC c_abc_max_dcc_inh_mon "Maximum value of anti-bounce counter" VALUE 0xa080cc5b _REC_VAL_20_u1 254. _CNV_A_R_LINEAR_____0_CM 1. 255. DISPLAY_IDENTIFIER C_ABC_MAX_DCC_INH_MON FORMAT "%3.0" /end CHARACTERISTIC
/begin CHARACTERISTIC c_abc_max_msr_inh_mon "Maximum value of anti-bounce counter" VALUE 0xa080cc63 _REC_VAL_20_u1 254. _CNV_A_R_LINEAR_____0_CM 1. 255. DISPLAY_IDENTIFIER C_ABC_MAX_MSR_INH_MON FORMAT "%3.0" /end CHARACTERISTIC
/begin CHARACTERISTIC c_abc_inc_msr_inh_mon "Anti bounce counter increment" VALUE 0xa080cc48 _REC_VAL_20_u1 255. _CNV_A_R_LINEAR_____0_CM 0. 255. DISPLAY_IDENTIFIER C_ABC_INC_MSR_INH_MON FORMAT "%3.0" /end CHARACTERISTIC
/begin CHARACTERISTIC c_abc_inc_dcc_inh_mon "Anti bounce counter increment" VALUE 0xa080cc40 _REC_VAL_20_u1 255. _CNV_A_R_LINEAR_____0_CM 0. 255. DISPLAY_IDENTIFIER C_ABC_INC_DCC_INH_MON FORMAT "%3.0" /end CHARACTERISTIC
/begin CHARACTERISTIC c_t_gs_inh_mon "Delay time for disable of GS torque demand in monitoring level" VALUE 0xa080ccbb _REC_VAL_20_u1 10.2 _CNV_A_R_LINEAR_____261_CM 0. 10.2 DISPLAY_IDENTIFIER C_T_GS_INH_MON FORMAT "%5.2" /end CHARACTERISTIC
/begin CHARACTERISTIC c_t_dcc_inh_mon "Delay time for disable of GS torque demand in monitoring level" VALUE 0xa080ccb8 _REC_VAL_20_u1 10.2 _CNV_A_R_LINEAR_____261_CM 0. 10.2 DISPLAY_IDENTIFIER C_T_DCC_INH_MON FORMAT "%5.2" /end CHARACTERISTIC
/begin CHARACTERISTIC c_t_max_brake_det_dcc_mon "Delay time for disable of GS torque demand in monitoring level" VALUE 0xa080ccbd _REC_VAL_20_u1 10.2 _CNV_A_R_LINEAR_____261_CM 0. 10.2 DISPLAY_IDENTIFIER C_T_MAX_BRAKE_DET_DCC_MON FORMAT "%5.2" /end CHARACTERISTIC
/begin CHARACTERISTIC c_t_ldm_inh_mon "Delay time for disable of GS torque demand in monitoring level" VALUE 0xa080ccbc _REC_VAL_20_u1 10.2 _CNV_A_R_LINEAR_____261_CM 0. 10.2 DISPLAY_IDENTIFIER C_T_LDM_INH_MON FORMAT "%5.2" /end CHARACTERISTIC
/begin CHARACTERISTIC c_t_max_brake_det_ldm_mon "Delay time for disable of GS torque demand in monitoring level" VALUE 0xa080ccbe _REC_VAL_20_u1 10.2 _CNV_A_R_LINEAR_____261_CM 0. 10.2 DISPLAY_IDENTIFIER C_T_MAX_BRAKE_DET_LDM_MON FORMAT "%5.2" /end CHARACTERISTIC
/begin CHARACTERISTIC c_t_amt_inh_mon "Delay time for disable of GS torque demand in monitoring level" VALUE 0xa080ccb6 _REC_VAL_20_u1 10.2 _CNV_A_R_LINEAR_____261_CM 0. 10.2 DISPLAY_IDENTIFIER C_T_AMT_INH_MON FORMAT "%5.2" /end CHARACTERISTIC
/begin CHARACTERISTIC c_t_dly_amt_inh_mon "Delay time for disable of GS torque demand in monitoring level" VALUE 0xa080ccb9 _REC_VAL_20_u1 10.2 _CNV_A_R_LINEAR_____261_CM 0. 10.2 DISPLAY_IDENTIFIER C_T_DLY_AMT_INH_MON FORMAT "%5.2" /end CHARACTERISTIC
/begin CHARACTERISTIC c_t_max_state_amt_1_diag_mon "Delay time for disable of GS torque demand in monitoring level" VALUE 0xa080ccbf _REC_VAL_20_u1 10.2 _CNV_A_R_LINEAR_____261_CM 0. 10.2 DISPLAY_IDENTIFIER C_T_MAX_STATE_AMT_1_DIAG_MON FORMAT "%5.2" /end CHARACTERISTIC
/begin CHARACTERISTIC c_t_max_state_amt_2_diag_mon "Delay time for disable of GS torque demand in monitoring level" VALUE 0xa080ccc0 _REC_VAL_20_u1 10.2 _CNV_A_R_LINEAR_____261_CM 0. 10.2 DISPLAY_IDENTIFIER C_T_MAX_STATE_AMT_2_DIAG_MON FORMAT "%5.2" /end CHARACTERISTIC
/begin CHARACTERISTIC c_t_max_state_amt_3_diag_mon "Delay time for disable of GS torque demand in monitoring level" VALUE 0xa080ccc1 _REC_VAL_20_u1 10.2 _CNV_A_R_LINEAR_____261_CM 0. 10.2 DISPLAY_IDENTIFIER C_T_MAX_STATE_AMT_3_DIAG_MON FORMAT "%5.2" /end CHARACTERISTIC
/begin CHARACTERISTIC c_t_max_tqi_amt_diag_mon "Delay time for disable of GS torque demand in monitoring level" VALUE 0xa080ccc3 _REC_VAL_20_u1 10.2 _CNV_A_R_LINEAR_____261_CM 0. 10.2 DISPLAY_IDENTIFIER C_T_MAX_TQI_AMT_DIAG_MON FORMAT "%5.2" /end CHARACTERISTIC
/begin CHARACTERISTIC c_t_max_state_clu_amt_diag_mon "Delay time for disable of GS torque demand in monitoring level" VALUE 0xa080ccc2 _REC_VAL_20_u1 10.2 _CNV_A_R_LINEAR_____261_CM 0. 10.2 DISPLAY_IDENTIFIER C_T_MAX_STATE_CLU_AMT_DIAG_MON FORMAT "%5.2" /end CHARACTERISTIC
/begin CHARACTERISTIC c_t_dly_gs_inh_mon "Delay time for disable of GS torque demand in monitoring level" VALUE 0xa080ccba _REC_VAL_20_u1 10.2 _CNV_A_R_LINEAR_____261_CM 0. 10.2 DISPLAY_IDENTIFIER C_T_DLY_GS_INH_MON FORMAT "%5.2" /end CHARACTERISTIC
/begin CHARACTERISTIC c_tqi_stnd_mon "Maximum indicated engine torque (scaling factor for torque demands from CAN)" VALUE 0xa080ccf8 _REC_VAL_20_u1 510. _CNV_A_R_LINEAR_____262_CM 0. 510. DISPLAY_IDENTIFIER C_TQI_STND_MON FORMAT "%3.0" /end CHARACTERISTIC
/begin CHARACTERISTIC c_tqi_amt_diag_mon "Maximum indicated engine torque (scaling factor for torque demands from CAN)" VALUE 0xa080ccf7 _REC_VAL_20_u1 510. _CNV_A_R_LINEAR_____262_CM 0. 510. DISPLAY_IDENTIFIER C_TQI_AMT_DIAG_MON FORMAT "%3.0" /end CHARACTERISTIC
/begin CHARACTERISTIC c_tqi_amt_cond_diag_mon "Maximum indicated engine torque (scaling factor for torque demands from CAN)" VALUE 0xa080ccf6 _REC_VAL_20_u1 510. _CNV_A_R_LINEAR_____262_CM 0. 510. DISPLAY_IDENTIFIER C_TQI_AMT_COND_DIAG_MON FORMAT "%3.0" /end CHARACTERISTIC
/begin CHARACTERISTIC c_tqi_amt_can_es_mon "Maximum indicated engine torque (scaling factor for torque demands from CAN)" VALUE 0xa080ccf5 _REC_VAL_20_u1 510. _CNV_A_R_LINEAR_____262_CM 0. 510. DISPLAY_IDENTIFIER C_TQI_AMT_CAN_ES_MON FORMAT "%3.0" /end CHARACTERISTIC
/begin MEASUREMENT t_state_amt_1_diag_mon "Timer for inhibition of MSR torque demand in monitoring level" UBYTE _CNV_A_R_LINEAR_____261_CM 1 100. 0. 10.2 DISPLAY_IDENTIFIER T_STATE_AMT_1_DIAG_MON ECU_ADDRESS 0xd0001e20 FORMAT "%5.2" /end MEASUREMENT
/begin MEASUREMENT t_tqi_amt_diag_mon "Timer for inhibition of MSR torque demand in monitoring level" UBYTE _CNV_A_R_LINEAR_____261_CM 1 100. 0. 10.2 DISPLAY_IDENTIFIER T_TQI_AMT_DIAG_MON ECU_ADDRESS 0xd0001e25 FORMAT "%5.2" /end MEASUREMENT
/begin MEASUREMENT abc_amt_inh_mon "Value of the Gear Shift anti - bounce counter" UBYTE _CNV_A_R_LINEAR_____0_CM 1 100. 0. 255. DISPLAY_IDENTIFIER ABC_AMT_INH_MON ECU_ADDRESS 0xd0001dd4 FORMAT "%3.0" /end MEASUREMENT
/begin MEASUREMENT state_err_amt_mon "Value of the Gear Shift anti - bounce counter" UBYTE _CNV_A_R_LINEAR_____0_CM 1 100. 0. 255. DISPLAY_IDENTIFIER STATE_ERR_AMT_MON ECU_ADDRESS 0xd0001e17 FORMAT "%3.0" /end MEASUREMENT
/begin MEASUREMENT state_amt_old_mon "Value of the Gear Shift anti - bounce counter" UBYTE _CNV_A_R_LINEAR_____0_CM 1 100. 0. 255. DISPLAY_IDENTIFIER STATE_AMT_OLD_MON ECU_ADDRESS 0xd0001e16 FORMAT "%3.0" /end MEASUREMENT
/begin CHARACTERISTIC c_abc_inc_amt_inh_mon "Anti bounce counter increment" VALUE 0xa080cc3d _REC_VAL_20_u1 255. _CNV_A_R_LINEAR_____0_CM 0. 255. DISPLAY_IDENTIFIER C_ABC_INC_AMT_INH_MON FORMAT "%3.0" /end CHARACTERISTIC
/begin CHARACTERISTIC c_vs_fil_amt_mon "Timer for inhibition of MSR torque demand in monitoring level" VALUE 0xa080cd14 _REC_VAL_20_u2 511.99218 _CNV_A_R_LINEAR_____86_CM 0. 511.99218 DISPLAY_IDENTIFIER C_VS_FIL_AMT_MON FORMAT "%7.3" /end CHARACTERISTIC
/begin MEASUREMENT lamb_mon2 "Modeled Lambda" UWORD _CNV_A_R_LINEAR_____129_CM 1 100. 0. 31.9990234375 DISPLAY_IDENTIFIER LAMB_MON2 ECU_ADDRESS 0xd0001d6a FORMAT "%7.4" /end MEASUREMENT
/begin MEASUREMENT t_tqi_mon2 "Dead time for delay of desired indicated engine torque" UBYTE _CNV_A_R_LINEAR_____261_CM 1 100. 0. 10.2 DISPLAY_IDENTIFIER T_TQI_MON2 ECU_ADDRESS 0xd0001e27 FORMAT "%5.2" /end MEASUREMENT
/begin CHARACTERISTIC c_t_tqi_mon2 "Dead time for torque decrease" VALUE 0xa0800dad _REC_VAL_20_u1 10.2 _CNV_A_R_LINEAR_____261_CM 0. 10.2 DISPLAY_IDENTIFIER C_T_TQI_MON2 FORMAT "%5.2" /end CHARACTERISTIC
/begin CHARACTERISTIC c_gain_tqi_dif_max_mon2 "Factor for threshold diagnosis with TQI_SP" VALUE 0xa0800dab _REC_VAL_20_u1 63.75 _CNV_A_R_EGCP_LINEA_334_CM 0. 63.75 DISPLAY_IDENTIFIER C_GAIN_TQI_DIF_MAX_MON2 FORMAT "%4.1" /end CHARACTERISTIC
/begin MEASUREMENT fac_tq_req_cru_mon2 "Torque demand from cruise control" UBYTE _CNV_A_R_LINEAR_____103_CM 1 100. 0. 1.9921875 DISPLAY_IDENTIFIER FAC_TQ_REQ_CRU_MON2 ECU_ADDRESS 0xd0001e00 FORMAT "%8.6" /end MEASUREMENT
/begin MEASUREMENT prev_state_iv_mon2 "State of injection valves at previous cycle" UBYTE _CNV_A_R_LINEAR_____0_CM 1 100. 0. 255. DISPLAY_IDENTIFIER PREV_STATE_IV_MON2 ECU_ADDRESS 0xd0001e12 FORMAT "%3.0" /end MEASUREMENT
/begin MEASUREMENT lv_err_conv_mon2 "Fault in A/D-conversion present" UBYTE _CNV_S_2_RANGE__0___1_CM 1 100. 0. 1. DISPLAY_IDENTIFIER LV_ERR_CONV_MON2 ECU_ADDRESS 0xd0001e3d BIT_MASK 0x1 /end MEASUREMENT
/begin MEASUREMENT lv_err_n_32_mon2 "Fault in engine speed present" UBYTE _CNV_S_2_RANGE__0___1_CM 1 100. 0. 1. DISPLAY_IDENTIFIER LV_ERR_N_32_MON2 ECU_ADDRESS 0xd0001e40 BIT_MASK 0x1 /end MEASUREMENT
/begin MEASUREMENT lv_err_pvs_mon2 "Fault in pedal value signal present" UBYTE _CNV_S_2_RANGE__0___1_CM 1 100. 0. 1. DISPLAY_IDENTIFIER LV_ERR_PVS_MON2 ECU_ADDRESS 0xd0001e42 BIT_MASK 0x1 /end MEASUREMENT
/begin MEASUREMENT lv_err_tps_mon2 "Fault in TPS present" UBYTE _CNV_S_2_RANGE__0___1_CM 1 100. 0. 1. DISPLAY_IDENTIFIER LV_ERR_TPS_MON2 ECU_ADDRESS 0xd0001e44 BIT_MASK 0x1 /end MEASUREMENT
/begin MEASUREMENT lv_err_tq_dif_p_d_is_mon2 "Fault currently present in torque generation, symptom 'idle speed controller - PD-part'" UBYTE _CNV_S_2_RANGE__0___1_CM 1 100. 0. 1. DISPLAY_IDENTIFIER LV_ERR_TQ_DIF_P_D_IS_MON2 ECU_ADDRESS 0xd0001e46 BIT_MASK 0x1 /end MEASUREMENT
/begin MEASUREMENT lv_err_tq_dif_i_is_mon2 "Fault currently present in torque generation, symptom 'idle speed controller - I-part'" UBYTE _CNV_S_2_RANGE__0___1_CM 1 100. 0. 1. DISPLAY_IDENTIFIER LV_ERR_TQ_DIF_I_IS_MON2 ECU_ADDRESS 0xd0001e45 BIT_MASK 0x1 /end MEASUREMENT
/begin MEASUREMENT lv_err_tq_loss_mon2 "Fault in torque losses present" UBYTE _CNV_S_2_RANGE__0___1_CM 1 100. 0. 1. DISPLAY_IDENTIFIER LV_ERR_TQ_LOSS_MON2 ECU_ADDRESS 0xd0001e47 BIT_MASK 0x1 /end MEASUREMENT
/begin MEASUREMENT lv_err_tq_min_clu_mon2 "Fault currently present in torque generation, symptom 'minimum torque at clutch'" UBYTE _CNV_S_2_RANGE__0___1_CM 1 100. 0. 1. DISPLAY_IDENTIFIER LV_ERR_TQ_MIN_CLU_MON2 ECU_ADDRESS 0xd0001e49 BIT_MASK 0x1 /end MEASUREMENT
/begin MEASUREMENT lv_err_tq_max_clu_mon2 "Fault currently present in torque generation, symptom 'maximum torque at clutch'" UBYTE _CNV_S_2_RANGE__0___1_CM 1 100. 0. 1. DISPLAY_IDENTIFIER LV_ERR_TQ_MAX_CLU_MON2 ECU_ADDRESS 0xd0001e48 BIT_MASK 0x1 /end MEASUREMENT
/begin MEASUREMENT lv_n_lim_etc_mon2 "Engine speed limitation request" UBYTE _CNV_S_2_RANGE__0___1_CM 1 100. 0. 1. DISPLAY_IDENTIFIER LV_N_LIM_ETC_MON2 ECU_ADDRESS 0xd0001e50 BIT_MASK 0x1 /end MEASUREMENT
/begin MEASUREMENT lv_tqi_mon_act_mon2 "Logical variable for torque monitoring active" UBYTE _CNV_S_2_RANGE__0___1_CM 1 100. 0. 1. DISPLAY_IDENTIFIER LV_TQI_MON_ACT_MON2 ECU_ADDRESS 0xd0001e5c BIT_MASK 0x1 /end MEASUREMENT
/begin MEASUREMENT n_32_mon2 "Engine speed" UBYTE _CNV_A_R_LINEAR_____10_CM 1 100. 0. 8160. DISPLAY_IDENTIFIER N_32_MON2 ECU_ADDRESS 0xd0001e07 FORMAT "%4.0" /end MEASUREMENT
/begin MEASUREMENT tq_loss_mon2 "Torque losses" SWORD _CNV_A_R_LINEAR_____31_CM 1 100. -1024. 1023.96875 DISPLAY_IDENTIFIER TQ_LOSS_MON2 ECU_ADDRESS 0xd0001da6 FORMAT "%11.5" /end MEASUREMENT
/begin MEASUREMENT tq_min_clu_mon2 "Monitored minimum torque at clutch" SWORD _CNV_A_R_LINEAR_____31_CM 1 100. -1024. 1023.96875 DISPLAY_IDENTIFIER TQ_MIN_CLU_MON2 ECU_ADDRESS 0xd0001dbc FORMAT "%11.5" /end MEASUREMENT
/begin MEASUREMENT tq_max_clu_mon2 "Monitored maximum torque at clutch" SWORD _CNV_A_R_LINEAR_____31_CM 1 100. -1024. 1023.96875 DISPLAY_IDENTIFIER TQ_MAX_CLU_MON2 ECU_ADDRESS 0xd0001db4 FORMAT "%11.5" /end MEASUREMENT
/begin MEASUREMENT tq_dif_p_d_is_mon2 "P- and D- controller output for idle speed" SWORD _CNV_A_R_LINEAR_____31_CM 1 100. -1024. 1023.96875 DISPLAY_IDENTIFIER TQ_DIF_P_D_IS_MON2 ECU_ADDRESS 0xd0001d90 FORMAT "%11.5" /end MEASUREMENT
/begin MEASUREMENT tqi_sp_mon2 "Setpoint indicated engine torque (function level)" SWORD _CNV_A_R_LINEAR_____31_CM 1 100. -1024. 1023.96875 DISPLAY_IDENTIFIER TQI_SP_MON2 ECU_ADDRESS 0xd0001dc6 FORMAT "%11.5" /end MEASUREMENT
/begin MEASUREMENT resp_mon2 "Answer of copy of process monitoring (Level 2')" UWORD _CNV_A_R_LINEAR_____0_CM 1 100. 0. 65535. DISPLAY_IDENTIFIER RESP_MON2 ECU_ADDRESS 0xd00065ba FORMAT "%5.0" /end MEASUREMENT
/begin MEASUREMENT fac_tq_req_driv_mon2 "Scaling factor for requested torque at clutch from driver" UBYTE _CNV_A_R_LINEAR_____103_CM 1 100. 0. 1.9921875 DISPLAY_IDENTIFIER FAC_TQ_REQ_DRIV_MON2 ECU_ADDRESS 0xd0001e01 FORMAT "%8.6" /end MEASUREMENT
/begin MEASUREMENT fac_tq_req_mon2 "Scaling factor for requested torque at clutch from driver and cruise control" UBYTE _CNV_A_R_LINEAR_____103_CM 1 100. 0. 1.9921875 DISPLAY_IDENTIFIER FAC_TQ_REQ_MON2 ECU_ADDRESS 0xd0001e02 FORMAT "%8.6" /end MEASUREMENT
/begin MEASUREMENT tqi_req_tot_mon2 "Desired non-delayed indicated engine torque" UBYTE _CNV_A_R_LINEAR_____262_CM 1 100. 0. 510. DISPLAY_IDENTIFIER TQI_REQ_TOT_MON2 ECU_ADDRESS 0xd0001e34 FORMAT "%3.0" /end MEASUREMENT
/begin MEASUREMENT tqi_sp_mon_mon2 "desired indicated engine torque" UBYTE _CNV_A_R_LINEAR_____262_CM 1 100. 0. 510. DISPLAY_IDENTIFIER TQI_SP_MON_MON2 ECU_ADDRESS 0xd0001e35 FORMAT "%3.0" /end MEASUREMENT
/begin MEASUREMENT tqi_av_mon2 "Actual indicated engine torque (process monitoring)" UBYTE _CNV_A_R_LINEAR_____262_CM 1 100. 0. 510. DISPLAY_IDENTIFIER TQI_AV_MON2 ECU_ADDRESS 0xd0001e2c FORMAT "%3.0" /end MEASUREMENT
/begin MEASUREMENT lv_err_tqi_av_mon2 "Fault currently present in torque generation" UBYTE _CNV_S_2_RANGE__0___1_CM 1 100. 0. 1. DISPLAY_IDENTIFIER LV_ERR_TQI_AV_MON2 ECU_ADDRESS 0xd0001e4a BIT_MASK 0x1 /end MEASUREMENT
/begin MEASUREMENT lv_swi_afs_tqi_mon2 "Switch to AFS (TQI_DIF above allowed threshold)" UBYTE _CNV_S_2_RANGE__0___1_CM 1 100. 0. 1. DISPLAY_IDENTIFIER LV_SWI_AFS_TQI_MON2 ECU_ADDRESS 0xd0001e59 BIT_MASK 0x1 /end MEASUREMENT
/begin MEASUREMENT tqi_dif_sp_mon2 "deviation between torque setpoint and desired indicated engine torque" UBYTE _CNV_A_R_LINEAR_____262_CM 1 100. 0. 510. DISPLAY_IDENTIFIER TQI_DIF_SP_MON2 ECU_ADDRESS 0xd0001e32 FORMAT "%3.0" /end MEASUREMENT
/begin MEASUREMENT tqi_dif_max_mon2 "Permitted deviation between actual and desired indicated engine torque" UBYTE _CNV_A_R_LINEAR_____262_CM 1 100. 0. 510. DISPLAY_IDENTIFIER TQI_DIF_MAX_MON2 ECU_ADDRESS 0xd0001e30 FORMAT "%3.0" /end MEASUREMENT
/begin MEASUREMENT abc_tqi_av_not_afs_mon2 "Anti-bounce-counter for fault in torque generation (not AFS-mode)" UBYTE _CNV_A_R_LINEAR_____0_CM 1 100. 0. 255. DISPLAY_IDENTIFIER ABC_TQI_AV_NOT_AFS_MON2 ECU_ADDRESS 0xd0001dec FORMAT "%3.0" /end MEASUREMENT
/begin MEASUREMENT abc_swi_afs_tqi_mon2 "Anit-bounce-counter for request to AFS (TQI_DIF above allowed threshold)" UBYTE _CNV_A_R_LINEAR_____0_CM 1 100. 0. 255. DISPLAY_IDENTIFIER ABC_SWI_AFS_TQI_MON2 ECU_ADDRESS 0xd0001de2 FORMAT "%3.0" /end MEASUREMENT
/begin CHARACTERISTIC c_abc_inc_tqi_av_not_afs_mon2 "ABC increment at TQI_DIF above allowed treshold (not AFS-mode)" VALUE 0xa0800da3 _REC_VAL_20_u1 255. _CNV_A_R_LINEAR_____0_CM 0. 255. DISPLAY_IDENTIFIER C_ABC_INC_TQI_AV_NOT_AFS_MON2 FORMAT "%3.0" /end CHARACTERISTIC
/begin CHARACTERISTIC c_abc_inc_swi_afs_tqi_mon2 "ABC increment for request to AFS (TQI_DIF above allowed threshold)" VALUE 0xa0800da1 _REC_VAL_20_u1 255. _CNV_A_R_LINEAR_____0_CM 0. 255. DISPLAY_IDENTIFIER C_ABC_INC_SWI_AFS_TQI_MON2 FORMAT "%3.0" /end CHARACTERISTIC
/begin CHARACTERISTIC c_abc_max_tqi_av_not_afs_mon2 "Value at which TQI_AV_MON error is recognized. when reached (not AFS-mode)" VALUE 0xa0800da8 _REC_VAL_20_u1 254. _CNV_A_R_LINEAR_____0_CM 1. 255. DISPLAY_IDENTIFIER C_ABC_MAX_TQI_AV_NOT_AFS_MON2 FORMAT "%3.0" /end CHARACTERISTIC
/begin CHARACTERISTIC c_abc_max_swi_afs_tqi_mon2 "Value at which OPM will be switched to AFS at TQI_DIF above allowed treshold" VALUE 0xa0800da6 _REC_VAL_20_u1 254. _CNV_A_R_LINEAR_____0_CM 1. 255. DISPLAY_IDENTIFIER C_ABC_MAX_SWI_AFS_TQI_MON2 FORMAT "%3.0" /end CHARACTERISTIC
/begin MEASUREMENT abc_tqi_av_afs_mon2 "Anti-bounce-counter for fault in torque generation (AFS-mode)" UBYTE _CNV_A_R_LINEAR_____0_CM 1 100. 0. 255. DISPLAY_IDENTIFIER ABC_TQI_AV_AFS_MON2 ECU_ADDRESS 0xd0001dea FORMAT "%3.0" /end MEASUREMENT
/begin MEASUREMENT tqi_dif_av_mon2 "Deviation between actual and desired indicated engine torque" UBYTE _CNV_A_R_LINEAR_____262_CM 1 100. 0. 510. DISPLAY_IDENTIFIER TQI_DIF_AV_MON2 ECU_ADDRESS 0xd0001e2e FORMAT "%3.0" /end MEASUREMENT
/begin CHARACTERISTIC c_abc_inc_tqi_av_afs_mon2 "ABC increment at TQI_DIF above allowed treshold (AFS-mode)" VALUE 0xa0800da2 _REC_VAL_20_u1 255. _CNV_A_R_LINEAR_____0_CM 0. 255. DISPLAY_IDENTIFIER C_ABC_INC_TQI_AV_AFS_MON2 FORMAT "%3.0" /end CHARACTERISTIC
/begin CHARACTERISTIC c_abc_max_tqi_av_afs_mon2 "Value at which TQI_AV_MON error is recognized. when reached (AFS-mode)" VALUE 0xa0800da7 _REC_VAL_20_u1 254. _CNV_A_R_LINEAR_____0_CM 1. 255. DISPLAY_IDENTIFIER C_ABC_MAX_TQI_AV_AFS_MON2 FORMAT "%3.0" /end CHARACTERISTIC
/begin AXIS_PTS ldp_tqi_sp_mon_mon2_ip_mon2 "" 0xa0800974 tqi_sp_mon_mon2 _REC_AXS_20_u1 510. _CNV_A_R_LINEAR_____262_CM 4 0. 510. FORMAT "%3.0" /end AXIS_PTS
/begin AXIS_PTS ldp_n_32_mon2_ip_tqi_dif_mon2 "" 0xa080096e n_32_mon2 _REC_AXS_20_u1 8160. _CNV_A_R_LINEAR_____10_CM 4 0. 8160. FORMAT "%4.0" /end AXIS_PTS
/begin MEASUREMENT abc_tqi_n_max_mon2 "Anti-bounce-counter for fault in engine speed limitation" UBYTE _CNV_A_R_LINEAR_____0_CM 1 100. 0. 255. DISPLAY_IDENTIFIER ABC_TQI_N_MAX_MON2 ECU_ADDRESS 0xd0001dee FORMAT "%3.0" /end MEASUREMENT
/begin MEASUREMENT lv_err_tqi_n_max_mon2 "Fault currently present in engine speed limitation" UBYTE _CNV_S_2_RANGE__0___1_CM 1 100. 0. 1. DISPLAY_IDENTIFIER LV_ERR_TQI_N_MAX_MON2 ECU_ADDRESS 0xd0001e4b BIT_MASK 0x1 /end MEASUREMENT
/begin CHARACTERISTIC c_n_max_mtc_lih_thd_mon2 "Speed threshold for the detection of a fault in the engine speed limitation" VALUE 0xa0800dac _REC_VAL_20_u1 8160. _CNV_A_R_LINEAR_____10_CM 0. 8160. DISPLAY_IDENTIFIER C_N_MAX_MTC_LIH_THD_MON2 FORMAT "%4.0" /end CHARACTERISTIC
/begin CHARACTERISTIC c_abc_inc_tqi_n_max_mon2 "Anti bounce counter increment" VALUE 0xa0800da4 _REC_VAL_20_u1 255. _CNV_A_R_LINEAR_____0_CM 0. 255. DISPLAY_IDENTIFIER C_ABC_INC_TQI_N_MAX_MON2 FORMAT "%3.0" /end CHARACTERISTIC
/begin CHARACTERISTIC c_abc_max_tqi_n_max_mon2 "Maximum value of anti-bounce counter" VALUE 0xa0800da9 _REC_VAL_20_u1 254. _CNV_A_R_LINEAR_____0_CM 1. 255. DISPLAY_IDENTIFIER C_ABC_MAX_TQI_N_MAX_MON2 FORMAT "%3.0" /end CHARACTERISTIC
/begin MEASUREMENT lv_n_lim_req_mon2 "Request for engine speed limitation" UBYTE _CNV_S_2_RANGE__0___1_CM 1 100. 0. 1. DISPLAY_IDENTIFIER LV_N_LIM_REQ_MON2 ECU_ADDRESS 0xd0001e51 BIT_MASK 0x1 /end MEASUREMENT
/begin MEASUREMENT lv_dr_off_mu_mon2 "Request for wrong answers of the level 2' test calculations to the monitoring unit in order to disable MTC and IV" UBYTE _CNV_S_2_RANGE__0___1_CM 1 100. 0. 1. DISPLAY_IDENTIFIER LV_DR_OFF_MU_MON2 ECU_ADDRESS 0xd0001e3c BIT_MASK 0x1 /end MEASUREMENT
/begin MEASUREMENT lv_off_mtc_mon2 "Request for disable of MTC power stage by main controller" UBYTE _CNV_S_2_RANGE__0___1_CM 1 100. 0. 1. DISPLAY_IDENTIFIER LV_OFF_MTC_MON2 ECU_ADDRESS 0xd0001e56 BIT_MASK 0x1 /end MEASUREMENT
/begin MEASUREMENT lv_off_iv_mon2 "Request for disable of IV power stage by main controller" UBYTE _CNV_S_2_RANGE__0___1_CM 1 100. 0. 1. DISPLAY_IDENTIFIER LV_OFF_IV_MON2 ECU_ADDRESS 0xd0001e52 BIT_MASK 0x1 /end MEASUREMENT
/begin MEASUREMENT lv_off_iv_n_lim_etc_mon2 "Reversible fuel Cut Off Switch for all cylinders" UBYTE _CNV_S_2_RANGE__0___1_CM 1 100. 0. 1. DISPLAY_IDENTIFIER LV_OFF_IV_N_LIM_ETC_MON2 ECU_ADDRESS 0xd0001e53 BIT_MASK 0x1 /end MEASUREMENT
/begin MEASUREMENT lv_off_iv_n_lim_etc_tmp_mon2 "Flag for temporary injection cut off during last recurrency" UBYTE _CNV_S_2_RANGE__0___1_CM 1 100. 0. 1. DISPLAY_IDENTIFIER LV_OFF_IV_N_LIM_ETC_TMP_MON2 ECU_ADDRESS 0xd0001e55 BIT_MASK 0x1 /end MEASUREMENT
/begin MEASUREMENT pv_av_ad_mon2 "Pedal value adaptation" UBYTE _CNV_A_R_LINEAR_____5_CM 1 100. 0. 99.609375 DISPLAY_IDENTIFIER PV_AV_AD_MON2 ECU_ADDRESS 0xd0001e15 FORMAT "%9.6" /end MEASUREMENT
/begin CHARACTERISTIC ip_fac_tq_req_driv_mon2 "scaling factor for requested torque at clutch from driver" MAP 0xa0800d20 _REC_MAP_20_u1_u1_u1 1.9921875 _CNV_A_R_LINEAR_____103_CM 0. 1.9921875 DISPLAY_IDENTIFIER IP_FAC_TQ_REQ_DRIV_MON2 FORMAT "%8.6"
 /begin AXIS_DESCR COM_AXIS n_32_mon2 _CNV_A_R_LINEAR_____10_CM 8 0. 8160. FORMAT "%4.0" AXIS_PTS_REF ldpm_n_32_mon2_ip_fac_tq_mon2 /end AXIS_DESCR
 /begin AXIS_DESCR COM_AXIS pv_av_ad_mon2 _CNV_A_R_LINEAR_____5_CM 8 0. 99.609375 FORMAT "%9.6" AXIS_PTS_REF ldpm_pv_av_ad_mon2_ip_fac_mon2 /end AXIS_DESCR
/end CHARACTERISTIC
/begin CHARACTERISTIC id_tq_min_clu_mon2 "Monitored minimum torque at clutch" CURVE 0xa0800c04 _REC_CUR_20_s2_u1 2047.96875 _CNV_A_R_LINEAR_____31_CM -1024. 1023.96875 DISPLAY_IDENTIFIER ID_TQ_MIN_CLU_MON2 FORMAT "%11.5"
 /begin AXIS_DESCR COM_AXIS test_rec_idx_mon2 _CNV_A_R_LINEAR_____0_CM 15 0. 15. FORMAT "%3.0" AXIS_PTS_REF ldpm_test_rec_idx_mon2 /end AXIS_DESCR
/end CHARACTERISTIC
/begin CHARACTERISTIC id_tq_max_clu_mon2 "Monitored maximum torque at clutch" CURVE 0xa0800be4 _REC_CUR_20_s2_u1 2047.96875 _CNV_A_R_LINEAR_____31_CM -1024. 1023.96875 DISPLAY_IDENTIFIER ID_TQ_MAX_CLU_MON2 FORMAT "%11.5"
 /begin AXIS_DESCR COM_AXIS test_rec_idx_mon2 _CNV_A_R_LINEAR_____0_CM 15 0. 15. FORMAT "%3.0" AXIS_PTS_REF ldpm_test_rec_idx_mon2 /end AXIS_DESCR
/end CHARACTERISTIC
/begin CHARACTERISTIC id_tq_loss_mon2 "Torque losses" CURVE 0xa0800bc4 _REC_CUR_20_s2_u1 2047.96875 _CNV_A_R_LINEAR_____31_CM -1024. 1023.96875 DISPLAY_IDENTIFIER ID_TQ_LOSS_MON2 FORMAT "%11.5"
 /begin AXIS_DESCR COM_AXIS test_rec_idx_mon2 _CNV_A_R_LINEAR_____0_CM 15 0. 15. FORMAT "%3.0" AXIS_PTS_REF ldpm_test_rec_idx_mon2 /end AXIS_DESCR
/end CHARACTERISTIC
/begin CHARACTERISTIC id_n_32_mon2 "Engine speed (monitoring level)" CURVE 0xa0800b14 _REC_CUR_20_u1_u1 8160. _CNV_A_R_LINEAR_____10_CM 0. 8160. DISPLAY_IDENTIFIER ID_N_32_MON2 FORMAT "%4.0"
 /begin AXIS_DESCR COM_AXIS test_rec_idx_mon2 _CNV_A_R_LINEAR_____0_CM 15 0. 15. FORMAT "%3.0" AXIS_PTS_REF ldpm_test_rec_idx_mon2 /end AXIS_DESCR
/end CHARACTERISTIC
/begin CHARACTERISTIC id_lamb_mon2 "Modeled Lambda" CURVE 0xa0800a84 _REC_CUR_20_u2_u1 31.9990234375 _CNV_A_R_LINEAR_____129_CM 0. 31.9990234375 DISPLAY_IDENTIFIER ID_LAMB_MON2 FORMAT "%7.4"
 /begin AXIS_DESCR COM_AXIS test_rec_idx_mon2 _CNV_A_R_LINEAR_____0_CM 15 0. 15. FORMAT "%3.0" AXIS_PTS_REF ldpm_test_rec_idx_mon2 /end AXIS_DESCR
/end CHARACTERISTIC
/begin CHARACTERISTIC id_prev_state_iv_mon2 "state of injection valves at previous cycle" CURVE 0xa0800b34 _REC_CUR_20_u1_u1 255. _CNV_A_R_LINEAR_____0_CM 0. 255. DISPLAY_IDENTIFIER ID_PREV_STATE_IV_MON2 FORMAT "%3.0"
 /begin AXIS_DESCR COM_AXIS test_rec_idx_mon2 _CNV_A_R_LINEAR_____0_CM 15 0. 15. FORMAT "%3.0" AXIS_PTS_REF ldpm_test_rec_idx_mon2 /end AXIS_DESCR
/end CHARACTERISTIC
/begin CHARACTERISTIC id_tqi_sp_mon2 "Setpoint indicated engine torque" CURVE 0xa0800c64 _REC_CUR_20_s2_u1 2047.96875 _CNV_A_R_LINEAR_____31_CM -1024. 1023.96875 DISPLAY_IDENTIFIER ID_TQI_SP_MON2 FORMAT "%11.5"
 /begin AXIS_DESCR COM_AXIS test_rec_idx_mon2 _CNV_A_R_LINEAR_____0_CM 15 0. 15. FORMAT "%3.0" AXIS_PTS_REF ldpm_test_rec_idx_mon2 /end AXIS_DESCR
/end CHARACTERISTIC
/begin CHARACTERISTIC id_abc_tqi_av_afs_mon2 "Anti-bounce-counter for fault in torque generation (AFS-mode)" CURVE 0xa08009d4 _REC_CUR_20_u1_u1 255. _CNV_A_R_LINEAR_____0_CM 0. 255. DISPLAY_IDENTIFIER ID_ABC_TQI_AV_AFS_MON2 FORMAT "%3.0"
 /begin AXIS_DESCR COM_AXIS test_rec_idx_mon2 _CNV_A_R_LINEAR_____0_CM 15 0. 15. FORMAT "%3.0" AXIS_PTS_REF ldpm_test_rec_idx_mon2 /end AXIS_DESCR
/end CHARACTERISTIC
/begin CHARACTERISTIC id_abc_tqi_av_not_afs_mon2 "Anti-bounce-counter for fault in torque generation (not AFS-mode)" CURVE 0xa08009e4 _REC_CUR_20_u1_u1 255. _CNV_A_R_LINEAR_____0_CM 0. 255. DISPLAY_IDENTIFIER ID_ABC_TQI_AV_NOT_AFS_MON2 FORMAT "%3.0"
 /begin AXIS_DESCR COM_AXIS test_rec_idx_mon2 _CNV_A_R_LINEAR_____0_CM 15 0. 15. FORMAT "%3.0" AXIS_PTS_REF ldpm_test_rec_idx_mon2 /end AXIS_DESCR
/end CHARACTERISTIC
/begin CHARACTERISTIC id_abc_tqi_n_max_mon2 "Anti-bounce counter for monitoring of engine speed limitation" CURVE 0xa08009f4 _REC_CUR_20_u1_u1 255. _CNV_A_R_LINEAR_____0_CM 0. 255. DISPLAY_IDENTIFIER ID_ABC_TQI_N_MAX_MON2 FORMAT "%3.0"
 /begin AXIS_DESCR COM_AXIS test_rec_idx_mon2 _CNV_A_R_LINEAR_____0_CM 15 0. 15. FORMAT "%3.0" AXIS_PTS_REF ldpm_test_rec_idx_mon2 /end AXIS_DESCR
/end CHARACTERISTIC
/begin CHARACTERISTIC id_tqi_sp_mon_mon2 "Resulting desired indicated engine torque, old value" CURVE 0xa0800c84 _REC_CUR_20_u1_u1 510. _CNV_A_R_LINEAR_____262_CM 0. 510. DISPLAY_IDENTIFIER ID_TQI_SP_MON_MON2 FORMAT "%3.0"
 /begin AXIS_DESCR COM_AXIS test_rec_idx_mon2 _CNV_A_R_LINEAR_____0_CM 15 0. 15. FORMAT "%3.0" AXIS_PTS_REF ldpm_test_rec_idx_mon2 /end AXIS_DESCR
/end CHARACTERISTIC
/begin CHARACTERISTIC id_t_tqi_mon2 "Dead time for delay of desired indicated engine torque, old value" CURVE 0xa0800b74 _REC_CUR_20_u1_u1 10.2 _CNV_A_R_LINEAR_____261_CM 0. 10.2 DISPLAY_IDENTIFIER ID_T_TQI_MON2 FORMAT "%5.2"
 /begin AXIS_DESCR COM_AXIS test_rec_idx_mon2 _CNV_A_R_LINEAR_____0_CM 15 0. 15. FORMAT "%3.0" AXIS_PTS_REF ldpm_test_rec_idx_mon2 /end AXIS_DESCR
/end CHARACTERISTIC
/begin CHARACTERISTIC id_resp_mon2 "Assignment table for answer decoder of copy of process monitoring" CURVE 0xa0800b54 _REC_CUR_20_u2_u1 65535. _CNV_A_R_LINEAR_____0_CM 0. 65535. DISPLAY_IDENTIFIER ID_RESP_MON2 FORMAT "%5.0"
 /begin AXIS_DESCR COM_AXIS test_rec_idx_mon2 _CNV_A_R_LINEAR_____0_CM 15 0. 15. FORMAT "%3.0" AXIS_PTS_REF ldpm_test_rec_idx_mon2 /end AXIS_DESCR
/end CHARACTERISTIC
/begin CHARACTERISTIC id_pv_av_ad_mon2 "Pedal value adaptation" CURVE 0xa0800b44 _REC_CUR_20_u1_u1 99.609375 _CNV_A_R_LINEAR_____5_CM 0. 99.609375 DISPLAY_IDENTIFIER ID_PV_AV_AD_MON2 FORMAT "%9.6"
 /begin AXIS_DESCR COM_AXIS test_rec_idx_mon2 _CNV_A_R_LINEAR_____0_CM 15 0. 15. FORMAT "%3.0" AXIS_PTS_REF ldpm_test_rec_idx_mon2 /end AXIS_DESCR
/end CHARACTERISTIC
/begin MEASUREMENT lv_err_mu_mc_mon2 "Fault detected by processor monitoring(continuous)" UBYTE _CNV_S_2_RANGE__0___1_CM 1 100. 0. 1. DISPLAY_IDENTIFIER LV_ERR_MU_MC_MON2 ECU_ADDRESS 0xd0001e3f BIT_MASK 0x1 /end MEASUREMENT
/begin MEASUREMENT lv_err_tmp_mu_mc_mon2 "Fault detected by processor monitoring(temporary)" UBYTE _CNV_S_2_RANGE__0___1_CM 1 100. 0. 1. DISPLAY_IDENTIFIER LV_ERR_TMP_MU_MC_MON2 ECU_ADDRESS 0xd0001e43 BIT_MASK 0x1 /end MEASUREMENT
/begin MEASUREMENT tqi_min_pu_mon2 "Torque for trailing throttle" UWORD _CNV_A_R_LINEAR_____31_CM 1 100. 0. 1023.96875 DISPLAY_IDENTIFIER TQI_MIN_PU_MON2 ECU_ADDRESS 0xd0001dc4 FORMAT "%10.5" /end MEASUREMENT
/begin MEASUREMENT tqi_inc_ext_mon2 "External torque request" SWORD _CNV_A_R_LINEAR_____31_CM 1 100. -1024. 1023.96875 DISPLAY_IDENTIFIER TQI_INC_EXT_MON2 ECU_ADDRESS 0xd0001dc0 FORMAT "%11.5" /end MEASUREMENT
/begin CHARACTERISTIC id_tqi_inc_ext_mon2 "External torque request" CURVE 0xa0800c24 _REC_CUR_20_s2_u1 2047.96875 _CNV_A_R_LINEAR_____31_CM -1024. 1023.96875 DISPLAY_IDENTIFIER ID_TQI_INC_EXT_MON2 FORMAT "%11.5"
 /begin AXIS_DESCR COM_AXIS test_rec_idx_mon2 _CNV_A_R_LINEAR_____0_CM 15 0. 15. FORMAT "%3.0" AXIS_PTS_REF ldpm_test_rec_idx_mon2 /end AXIS_DESCR
/end CHARACTERISTIC
/begin CHARACTERISTIC id_tqi_min_pu_mon2 "Torque for trailing throttle" CURVE 0xa0800c44 _REC_CUR_20_u2_u1 1023.96875 _CNV_A_R_LINEAR_____31_CM 0. 1023.96875 DISPLAY_IDENTIFIER ID_TQI_MIN_PU_MON2 FORMAT "%10.5"
 /begin AXIS_DESCR COM_AXIS test_rec_idx_mon2 _CNV_A_R_LINEAR_____0_CM 15 0. 15. FORMAT "%3.0" AXIS_PTS_REF ldpm_test_rec_idx_mon2 /end AXIS_DESCR
/end CHARACTERISTIC
/begin MEASUREMENT eff_iga_hom_mon2 "ignition efficiency in homogeneous (process monitoring)" UBYTE _CNV_A_R_LINEAR_____103_CM 1 100. 0. 1.9921875 DISPLAY_IDENTIFIER EFF_IGA_HOM_MON2 ECU_ADDRESS 0xd0001df3 FORMAT "%8.6" /end MEASUREMENT
/begin MEASUREMENT eff_iga_s_mon2 "ignition efficiency in stratified (process monitoring)" UBYTE _CNV_A_R_LINEAR_____103_CM 1 100. 0. 1.9921875 DISPLAY_IDENTIFIER EFF_IGA_S_MON2 ECU_ADDRESS 0xd0001df7 FORMAT "%8.6" /end MEASUREMENT
/begin MEASUREMENT eff_iga_homs_mon2 "ignition efficiency in multiple homogeneous-stratified (process monitoring)" UBYTE _CNV_A_R_LINEAR_____103_CM 1 100. 0. 1.9921875 DISPLAY_IDENTIFIER EFF_IGA_HOMS_MON2 ECU_ADDRESS 0xd0001df5 FORMAT "%8.6" /end MEASUREMENT
/begin MEASUREMENT eff_lamb_homs_mon2 "lambda efficiency in homogeneous-stratified (process monitoring)" UBYTE _CNV_A_R_LINEAR_____103_CM 1 100. 0. 1.9921875 DISPLAY_IDENTIFIER EFF_LAMB_HOMS_MON2 ECU_ADDRESS 0xd0001dfb FORMAT "%8.6" /end MEASUREMENT
/begin MEASUREMENT eff_lamb_hom_mon2 "lambda efficiency in homogeneous (process monitoring)" UBYTE _CNV_A_R_LINEAR_____103_CM 1 100. 0. 1.9921875 DISPLAY_IDENTIFIER EFF_LAMB_HOM_MON2 ECU_ADDRESS 0xd0001df9 FORMAT "%8.6" /end MEASUREMENT
/begin MEASUREMENT eff_lamb_s_mon2 "lambda efficiency in stratified homogeneous (process monitoring)" UBYTE _CNV_A_R_LINEAR_____103_CM 1 100. 0. 1.9921875 DISPLAY_IDENTIFIER EFF_LAMB_S_MON2 ECU_ADDRESS 0xd0001dfd FORMAT "%8.6" /end MEASUREMENT
/begin MEASUREMENT eff_tot_mon2 "total actual efficiencies" UBYTE _CNV_A_R_LINEAR_____103_CM 1 100. 0. 1.9921875 DISPLAY_IDENTIFIER EFF_TOT_MON2 ECU_ADDRESS 0xd0001dff FORMAT "%8.6" /end MEASUREMENT
/begin MEASUREMENT eff_mff_tq_cor_mon2 "efficiency on torque relevant mass fuel flow" UBYTE _CNV_A_R_LINEAR_____103_CM 1 100. 0. 1.9921875 DISPLAY_IDENTIFIER EFF_MFF_TQ_COR_MON2 ECU_ADDRESS 0xd0001dfe FORMAT "%8.6" /end MEASUREMENT
/begin MEASUREMENT lf_4_mon2 "Byte of logical starting values 4" UBYTE _CNV_A_R_LINEAR_____0_CM 1 100. 0. 255. DISPLAY_IDENTIFIER LF_4_MON2 ECU_ADDRESS 0xd0001e05 FORMAT "%3.0" /end MEASUREMENT
/begin MEASUREMENT tq_drof_mon2 "Torque demand from drive off assistant" SWORD _CNV_A_R_LINEAR_____31_CM 1 100. -1024. 1023.96875 DISPLAY_IDENTIFIER TQ_DROF_MON2 ECU_ADDRESS 0xd0001d96 FORMAT "%11.5" /end MEASUREMENT
/begin MEASUREMENT iga_igc_h_rng_mon2[0] "Actual ignition angle high range" SWORD _CNV_A_R_LINEAR_____188_CM 1 100. -90. 90. DISPLAY_IDENTIFIER IGA_IGC_H_RNG_MON2_1 ECU_ADDRESS 0xd0001d50 FORMAT "%8.4" /end MEASUREMENT
/begin MEASUREMENT iga_igc_h_rng_mon2[1] "Actual ignition angle high range" SWORD _CNV_A_R_LINEAR_____188_CM 1 100. -90. 90. DISPLAY_IDENTIFIER IGA_IGC_H_RNG_MON2_2 ECU_ADDRESS 0xd0001d52 FORMAT "%8.4" /end MEASUREMENT
/begin MEASUREMENT iga_igc_h_rng_mon2[2] "Actual ignition angle high range" SWORD _CNV_A_R_LINEAR_____188_CM 1 100. -90. 90. DISPLAY_IDENTIFIER IGA_IGC_H_RNG_MON2_3 ECU_ADDRESS 0xd0001d54 FORMAT "%8.4" /end MEASUREMENT
/begin MEASUREMENT iga_igc_h_rng_mon2[3] "Actual ignition angle high range" SWORD _CNV_A_R_LINEAR_____188_CM 1 100. -90. 90. DISPLAY_IDENTIFIER IGA_IGC_H_RNG_MON2_4 ECU_ADDRESS 0xd0001d56 FORMAT "%8.4" /end MEASUREMENT
/begin MEASUREMENT iga_igc_h_rng_mon2[4] "Actual ignition angle high range" SWORD _CNV_A_R_LINEAR_____188_CM 1 100. -90. 90. DISPLAY_IDENTIFIER IGA_IGC_H_RNG_MON2_5 ECU_ADDRESS 0xd0001d58 FORMAT "%8.4" /end MEASUREMENT
/begin MEASUREMENT iga_igc_h_rng_mon2[5] "Actual ignition angle high range" SWORD _CNV_A_R_LINEAR_____188_CM 1 100. -90. 90. DISPLAY_IDENTIFIER IGA_IGC_H_RNG_MON2_6 ECU_ADDRESS 0xd0001d5a FORMAT "%8.4" /end MEASUREMENT
/begin MEASUREMENT iga_igc_h_rng_mon2[6] "Actual ignition angle high range" SWORD _CNV_A_R_LINEAR_____188_CM 1 100. -90. 90. DISPLAY_IDENTIFIER IGA_IGC_H_RNG_MON2_7 ECU_ADDRESS 0xd0001d5c FORMAT "%8.4" /end MEASUREMENT
/begin MEASUREMENT iga_igc_h_rng_mon2[7] "Actual ignition angle high range" SWORD _CNV_A_R_LINEAR_____188_CM 1 100. -90. 90. DISPLAY_IDENTIFIER IGA_IGC_H_RNG_MON2_8 ECU_ADDRESS 0xd0001d5e FORMAT "%8.4" /end MEASUREMENT
/begin MEASUREMENT mff_tq_mon2 "Torque relevant Mass Fuel Flow" UWORD _CNV_A_R_LINEAR_____111_CM 1 100. 0. 1389. DISPLAY_IDENTIFIER MFF_TQ_MON2 ECU_ADDRESS 0xd0001d72 FORMAT "%7.2" /end MEASUREMENT
/begin MEASUREMENT maf_mon2 "Mass air flow signal used monitoring level" UBYTE _CNV_A_R_LINEAR_____15_CM 1 100. 0. 1389. DISPLAY_IDENTIFIER MAF_MON2 ECU_ADDRESS 0xd0001e06 FORMAT "%4.0" /end MEASUREMENT
/begin MEASUREMENT iga_ref_hom_cor_ext_mon2 "Correction of reference ignition angle in homogeneous (for external functions e.g. VVT, EGR...)" SWORD _CNV_A_R_LINEAR_____188_CM 1 100. -90. 90. DISPLAY_IDENTIFIER IGA_REF_HOM_COR_EXT_MON2 ECU_ADDRESS 0xd0001d60 FORMAT "%8.4" /end MEASUREMENT
/begin MEASUREMENT iga_ref_homs_cor_ext_mon2 "Correction of reference ignition angle in homogeneous stratified (for external functions e.g. VVT, EGR...)" SWORD _CNV_A_R_LINEAR_____188_CM 1 100. -90. 90. DISPLAY_IDENTIFIER IGA_REF_HOMS_COR_EXT_MON2 ECU_ADDRESS 0xd0001d62 FORMAT "%8.4" /end MEASUREMENT
/begin MEASUREMENT lv_err_mff_mon2 "Logical variable for error in mass fuel flow signal" UBYTE _CNV_S_2_RANGE__0___1_CM 1 100. 0. 1. DISPLAY_IDENTIFIER LV_ERR_MFF_MON2 ECU_ADDRESS 0xd0001e3e BIT_MASK 0x1 /end MEASUREMENT
/begin MEASUREMENT lv_swi_fac_tq_req_mon2 "logical variable for switching to other factors for requested torque at clutch" UBYTE _CNV_S_2_RANGE__0___1_CM 1 100. 0. 1. DISPLAY_IDENTIFIER LV_SWI_FAC_TQ_REQ_MON2 ECU_ADDRESS 0xd0001e5a BIT_MASK 0x1 /end MEASUREMENT
/begin MEASUREMENT iga_dif_av_h_rng_hom_mon2 "difference from reference to actual ignition angle in homogeneous (process monitoring)" UWORD _CNV_A_R_LINEAR_____189_CM 1 100. 0. -180. DISPLAY_IDENTIFIER IGA_DIF_AV_H_RNG_HOM_MON2 ECU_ADDRESS 0xd0001d4a FORMAT "%8.4" /end MEASUREMENT
/begin MEASUREMENT iga_dif_av_h_rng_homs_mon2 "difference from reference to actual ignition angle in homogeneous-stratified (process monitoring)" UWORD _CNV_A_R_LINEAR_____189_CM 1 100. 0. -180. DISPLAY_IDENTIFIER IGA_DIF_AV_H_RNG_HOMS_MON2 ECU_ADDRESS 0xd0001d4e FORMAT "%8.4" /end MEASUREMENT
/begin MEASUREMENT opm_av_mon2 "actual engine operation mode (process monitoring)" UBYTE _CNV_S_5_ECM2_RANGE_832_CM 1 100. 0. 8. DISPLAY_IDENTIFIER OPM_AV_MON2 ECU_ADDRESS 0xd0001e11 /end MEASUREMENT
/begin CHARACTERISTIC c_crlc_tqi_sp_mon2 "Filter constant for realization of first order filter" VALUE 0xa0800daa _REC_VAL_20_u1 0.99609375 _CNV_A_R_LINEAR_____28_CM 0. 0.99609375 DISPLAY_IDENTIFIER C_CRLC_TQI_SP_MON2 FORMAT "%5.3" /end CHARACTERISTIC
/begin CHARACTERISTIC id_iga_igc_h_rng_mon2 "Actual ignition angle" CURVE 0xa0800a24 _REC_CUR_20_s2_u1 180. _CNV_A_R_LINEAR_____188_CM -90. 90. DISPLAY_IDENTIFIER ID_IGA_IGC_H_RNG_MON2 FORMAT "%8.4"
 /begin AXIS_DESCR COM_AXIS test_rec_idx_mon2 _CNV_A_R_LINEAR_____0_CM 15 0. 15. FORMAT "%3.0" AXIS_PTS_REF ldpm_test_rec_idx_mon2 /end AXIS_DESCR
/end CHARACTERISTIC
/begin CHARACTERISTIC id_iga_ref_homs_cor_ext_mon2 "Correction of reference ignition angle in homogeneous stratified (for external functions e.g. VVT, EGR...)" CURVE 0xa0800a64 _REC_CUR_20_s2_u1 180. _CNV_A_R_LINEAR_____188_CM -90. 90. DISPLAY_IDENTIFIER ID_IGA_REF_HOMS_COR_EXT_MON2 FORMAT "%8.4"
 /begin AXIS_DESCR COM_AXIS test_rec_idx_mon2 _CNV_A_R_LINEAR_____0_CM 15 0. 15. FORMAT "%3.0" AXIS_PTS_REF ldpm_test_rec_idx_mon2 /end AXIS_DESCR
/end CHARACTERISTIC
/begin CHARACTERISTIC id_iga_ref_hom_cor_ext_mon2 "Correction of reference ignition angle in homogeneous (for external functions e.g. VVT, EGR...)" CURVE 0xa0800a44 _REC_CUR_20_s2_u1 180. _CNV_A_R_LINEAR_____188_CM -90. 90. DISPLAY_IDENTIFIER ID_IGA_REF_HOM_COR_EXT_MON2 FORMAT "%8.4"
 /begin AXIS_DESCR COM_AXIS test_rec_idx_mon2 _CNV_A_R_LINEAR_____0_CM 15 0. 15. FORMAT "%3.0" AXIS_PTS_REF ldpm_test_rec_idx_mon2 /end AXIS_DESCR
/end CHARACTERISTIC
/begin CHARACTERISTIC id_fac_tq_req_cru_mon2 "Torque demand from cruise control" CURVE 0xa0800a14 _REC_CUR_20_u1_u1 1.9921875 _CNV_A_R_LINEAR_____103_CM 0. 1.9921875 DISPLAY_IDENTIFIER ID_FAC_TQ_REQ_CRU_MON2 FORMAT "%8.6"
 /begin AXIS_DESCR COM_AXIS test_rec_idx_mon2 _CNV_A_R_LINEAR_____0_CM 15 0. 15. FORMAT "%3.0" AXIS_PTS_REF ldpm_test_rec_idx_mon2 /end AXIS_DESCR
/end CHARACTERISTIC
/begin CHARACTERISTIC id_eff_mff_tq_cor_mon2 "efficiency on torque relevant mass fuel flow" CURVE 0xa0800a04 _REC_CUR_20_u1_u1 1.9921875 _CNV_A_R_LINEAR_____103_CM 0. 1.9921875 DISPLAY_IDENTIFIER ID_EFF_MFF_TQ_COR_MON2 FORMAT "%8.6"
 /begin AXIS_DESCR COM_AXIS test_rec_idx_mon2 _CNV_A_R_LINEAR_____0_CM 15 0. 15. FORMAT "%3.0" AXIS_PTS_REF ldpm_test_rec_idx_mon2 /end AXIS_DESCR
/end CHARACTERISTIC
/begin CHARACTERISTIC id_abc_swi_afs_tqi_mon2 "Anit-bounce-counter for request to AFS (TQI_DIF above allowed threshold)" CURVE 0xa08009c4 _REC_CUR_20_u1_u1 255. _CNV_A_R_LINEAR_____0_CM 0. 255. DISPLAY_IDENTIFIER ID_ABC_SWI_AFS_TQI_MON2 FORMAT "%3.0"
 /begin AXIS_DESCR COM_AXIS test_rec_idx_mon2 _CNV_A_R_LINEAR_____0_CM 15 0. 15. FORMAT "%3.0" AXIS_PTS_REF ldpm_test_rec_idx_mon2 /end AXIS_DESCR
/end CHARACTERISTIC
/begin CHARACTERISTIC id_maf_mon2 "Actual fuel mass flow (torque monitoring)" CURVE 0xa0800ae4 _REC_CUR_20_u1_u1 1389. _CNV_A_R_LINEAR_____15_CM 0. 1389. DISPLAY_IDENTIFIER ID_MAF_MON2 FORMAT "%4.0"
 /begin AXIS_DESCR COM_AXIS test_rec_idx_mon2 _CNV_A_R_LINEAR_____0_CM 15 0. 15. FORMAT "%3.0" AXIS_PTS_REF ldpm_test_rec_idx_mon2 /end AXIS_DESCR
/end CHARACTERISTIC
/begin CHARACTERISTIC id_mff_tq_mon2 "Torque relevant Mass Fuel Flow" CURVE 0xa0800af4 _REC_CUR_20_u2_u1 1389. _CNV_A_R_LINEAR_____111_CM 0. 1389. DISPLAY_IDENTIFIER ID_MFF_TQ_MON2 FORMAT "%7.2"
 /begin AXIS_DESCR COM_AXIS test_rec_idx_mon2 _CNV_A_R_LINEAR_____0_CM 15 0. 15. FORMAT "%3.0" AXIS_PTS_REF ldpm_test_rec_idx_mon2 /end AXIS_DESCR
/end CHARACTERISTIC
/begin CHARACTERISTIC id_opm_av_mon2 "actual engine operation mode (process monitioring)" CURVE 0xa0800b24 _REC_CUR_20_u1_u1 8. _CNV_S_5_ECM2_RANGE_832_CM 0. 8. DISPLAY_IDENTIFIER ID_OPM_AV_MON2
 /begin AXIS_DESCR COM_AXIS test_rec_idx_mon2 _CNV_A_R_LINEAR_____0_CM 15 0. 15. FORMAT "%3.0" AXIS_PTS_REF ldpm_test_rec_idx_mon2 /end AXIS_DESCR
/end CHARACTERISTIC
/begin CHARACTERISTIC id_tq_dif_p_d_is_mon2 "P- and D- controller output for idle speed" CURVE 0xa0800b84 _REC_CUR_20_s2_u1 2047.96875 _CNV_A_R_LINEAR_____31_CM -1024. 1023.96875 DISPLAY_IDENTIFIER ID_TQ_DIF_P_D_IS_MON2 FORMAT "%11.5"
 /begin AXIS_DESCR COM_AXIS test_rec_idx_mon2 _CNV_A_R_LINEAR_____0_CM 15 0. 15. FORMAT "%3.0" AXIS_PTS_REF ldpm_test_rec_idx_mon2 /end AXIS_DESCR
/end CHARACTERISTIC
/begin CHARACTERISTIC id_tq_drof_mon2 "TQ request for drive off assistance" CURVE 0xa0800ba4 _REC_CUR_20_s2_u1 2047.96875 _CNV_A_R_LINEAR_____31_CM -1024. 1023.96875 DISPLAY_IDENTIFIER ID_TQ_DROF_MON2 FORMAT "%11.5"
 /begin AXIS_DESCR COM_AXIS test_rec_idx_mon2 _CNV_A_R_LINEAR_____0_CM 15 0. 15. FORMAT "%3.0" AXIS_PTS_REF ldpm_test_rec_idx_mon2 /end AXIS_DESCR
/end CHARACTERISTIC
/begin CHARACTERISTIC ip_eff_iga_hom_mon2 "actual ignition efficiency in homogeneous (process monitoring)" CURVE 0xa0800c94 _REC_CUR_20_u1_u2 99.609375 _CNV_A_R_LINEAR_____5_CM 0. 99.609375 DISPLAY_IDENTIFIER IP_EFF_IGA_HOM_MON2 FORMAT "%9.6"
 /begin AXIS_DESCR COM_AXIS online_dummy _CNV_A_R_LINEAR_____189_CM 8 0. -180. FORMAT "%8.4" AXIS_PTS_REF ldpm_iga_dif_av_mon2_ip_mon2 /end AXIS_DESCR
/end CHARACTERISTIC
/begin AXIS_PTS ldp_lamb_homs_mon2_ip_eff_mon2 "" 0xa08008fc online_dummy _REC_AXS_20_u2 31.9990234375 _CNV_A_R_LINEAR_____129_CM 8 0. 31.9990234375 FORMAT "%7.4" /end AXIS_PTS
/begin AXIS_PTS ldp_lamb_hom_mon2_ip_eff_mon2 "" 0xa08008e8 online_dummy _REC_AXS_20_u2 31.9990234375 _CNV_A_R_LINEAR_____129_CM 8 0. 31.9990234375 FORMAT "%7.4" /end AXIS_PTS
/begin AXIS_PTS ldp_lamb_s_mon2_ip_eff_mon2 "" 0xa0800910 online_dummy _REC_AXS_20_u2 31.9990234375 _CNV_A_R_LINEAR_____129_CM 8 0. 31.9990234375 FORMAT "%7.4" /end AXIS_PTS
/begin AXIS_PTS ldp_n_32_mon2_ip_tqi_cus_mon2 "" 0xa0800966 n_32_mon2 _REC_AXS_20_u1 8160. _CNV_A_R_LINEAR_____10_CM 6 0. 8160. FORMAT "%4.0" /end AXIS_PTS
/begin AXIS_PTS ldp_n_32_mon2_ip_fac_eff_mon2 "" 0xa080095e n_32_mon2 _REC_AXS_20_u1 8160. _CNV_A_R_LINEAR_____10_CM 6 0. 8160. FORMAT "%4.0" /end AXIS_PTS
/begin AXIS_PTS ldp_maf_mon2_ip_fac_eff_mon2 "" 0xa0800922 online_dummy _REC_AXS_20_u1 1389. _CNV_A_R_LINEAR_____15_CM 6 0. 1389. FORMAT "%4.0" /end AXIS_PTS
/begin AXIS_PTS ldp_mff_mon2_ip_iga_ref_mon2 "" 0xa0800938 online_dummy _REC_AXS_20_u2 1389. _CNV_A_R_LINEAR_____111_CM 8 0. 1389. FORMAT "%7.2" /end AXIS_PTS
/begin AXIS_PTS ldp_mff_mon2_ip_tqi_cus_mon2 "" 0xa080094c online_dummy _REC_AXS_20_u2 1389. _CNV_A_R_LINEAR_____111_CM 8 0. 1389. FORMAT "%7.2" /end AXIS_PTS
/begin CHARACTERISTIC ip_eff_iga_homs_mon2 "actual ignition efficiency in homogeneous_stratified (process monitoring)" CURVE 0xa0800c9c _REC_CUR_20_u1_u2 1.9921875 _CNV_A_R_LINEAR_____103_CM 0. 1.9921875 DISPLAY_IDENTIFIER IP_EFF_IGA_HOMS_MON2 FORMAT "%8.6"
 /begin AXIS_DESCR COM_AXIS online_dummy _CNV_A_R_LINEAR_____189_CM 8 0. -180. FORMAT "%8.4" AXIS_PTS_REF ldpm_iga_dif_av_mon2_ip_mon2 /end AXIS_DESCR
/end CHARACTERISTIC
/begin CHARACTERISTIC ip_eff_lamb_homs_mon2 "lambda efficiency in homogeneous-stratified (process monitoring)" CURVE 0xa0800cac _REC_CUR_20_u1_u2 1.9921875 _CNV_A_R_LINEAR_____103_CM 0. 1.9921875 DISPLAY_IDENTIFIER IP_EFF_LAMB_HOMS_MON2 FORMAT "%8.6"
 /begin AXIS_DESCR COM_AXIS online_dummy _CNV_A_R_LINEAR_____129_CM 8 0. 31.9990234375 FORMAT "%7.4" AXIS_PTS_REF ldp_lamb_homs_mon2_ip_eff_mon2 /end AXIS_DESCR
/end CHARACTERISTIC
/begin CHARACTERISTIC ip_eff_lamb_hom_mon2 "lambda efficiency in homogeneous (process monitoring)" CURVE 0xa0800ca4 _REC_CUR_20_u1_u2 1.9921875 _CNV_A_R_LINEAR_____103_CM 0. 1.9921875 DISPLAY_IDENTIFIER IP_EFF_LAMB_HOM_MON2 FORMAT "%8.6"
 /begin AXIS_DESCR COM_AXIS online_dummy _CNV_A_R_LINEAR_____129_CM 8 0. 31.9990234375 FORMAT "%7.4" AXIS_PTS_REF ldp_lamb_hom_mon2_ip_eff_mon2 /end AXIS_DESCR
/end CHARACTERISTIC
/begin CHARACTERISTIC ip_eff_lamb_s_mon2 "lambda efficiency in stratified (process monitoring)" CURVE 0xa0800cb4 _REC_CUR_20_u1_u2 1.9921875 _CNV_A_R_LINEAR_____103_CM 0. 1.9921875 DISPLAY_IDENTIFIER IP_EFF_LAMB_S_MON2 FORMAT "%8.6"
 /begin AXIS_DESCR COM_AXIS online_dummy _CNV_A_R_LINEAR_____129_CM 8 0. 31.9990234375 FORMAT "%7.4" AXIS_PTS_REF ldp_lamb_s_mon2_ip_eff_mon2 /end AXIS_DESCR
/end CHARACTERISTIC
/begin CHARACTERISTIC ip_fac_eff_iga_mon2 "Factor ignition efficiency (process monitoring)" MAP 0xa0800cbc _REC_MAP_20_u1_u1_u1 15.9375 _CNV_A_R_EVAC_LINEA_298_CM 0. 15.9375 DISPLAY_IDENTIFIER IP_FAC_EFF_IGA_MON2 FORMAT "%7.4"
 /begin AXIS_DESCR COM_AXIS n_32_mon2 _CNV_A_R_LINEAR_____10_CM 6 0. 8160. FORMAT "%4.0" AXIS_PTS_REF ldp_n_32_mon2_ip_fac_eff_mon2 /end AXIS_DESCR
 /begin AXIS_DESCR COM_AXIS online_dummy _CNV_A_R_LINEAR_____15_CM 6 0. 1389. FORMAT "%4.0" AXIS_PTS_REF ldp_maf_mon2_ip_fac_eff_mon2 /end AXIS_DESCR
/end CHARACTERISTIC
/begin CHARACTERISTIC ip_fac_tq_req_driv_1_mon2 "Scaling factor for requested torque at clutch from driver in other mode" MAP 0xa0800ce0 _REC_MAP_20_u1_u1_u1 1.9921875 _CNV_A_R_LINEAR_____103_CM 0. 1.9921875 DISPLAY_IDENTIFIER IP_FAC_TQ_REQ_DRIV_1_MON2 FORMAT "%8.6"
 /begin AXIS_DESCR COM_AXIS n_32_mon2 _CNV_A_R_LINEAR_____10_CM 8 0. 8160. FORMAT "%4.0" AXIS_PTS_REF ldpm_n_32_mon2_ip_fac_tq_mon2 /end AXIS_DESCR
 /begin AXIS_DESCR COM_AXIS pv_av_ad_mon2 _CNV_A_R_LINEAR_____5_CM 8 0. 99.609375 FORMAT "%9.6" AXIS_PTS_REF ldpm_pv_av_ad_mon2_ip_fac_mon2 /end AXIS_DESCR
/end CHARACTERISTIC
/begin CHARACTERISTIC ip_iga_ref_homs_mon2 "reference ignition angle in homogeneous-stratified (process monitoring)" MAP 0xa080d4cc _REC_MAP_20_u2_u1_u2 180. _CNV_A_R_LINEAR_____132_CM -90. 90. DISPLAY_IDENTIFIER IP_IGA_REF_HOMS_MON2 FORMAT "%8.4"
 /begin AXIS_DESCR COM_AXIS n_32_mon2 _CNV_A_R_LINEAR_____10_CM 8 0. 8160. FORMAT "%4.0" AXIS_PTS_REF ldpm_n_32_mon2_ip_iga_ref_mon2 /end AXIS_DESCR
 /begin AXIS_DESCR COM_AXIS online_dummy _CNV_A_R_LINEAR_____111_CM 8 0. 1389. FORMAT "%7.2" AXIS_PTS_REF ldp_mff_mon2_ip_iga_ref_mon2 /end AXIS_DESCR
/end CHARACTERISTIC
/begin CHARACTERISTIC ip_iga_ref_hom_mon2 "reference ignition angle in homogeneous(process monitoring)" MAP 0xa080d44c _REC_MAP_20_u2_u1_u1 180. _CNV_A_R_LINEAR_____132_CM -90. 90. DISPLAY_IDENTIFIER IP_IGA_REF_HOM_MON2 FORMAT "%8.4"
 /begin AXIS_DESCR COM_AXIS n_32_mon2 _CNV_A_R_LINEAR_____10_CM 8 0. 8160. FORMAT "%4.0" AXIS_PTS_REF ldpm_n_32_mon2_ip_iga_ref_mon2 /end AXIS_DESCR
 /begin AXIS_DESCR COM_AXIS online_dummy _CNV_A_R_LINEAR_____15_CM 8 0. 1389. FORMAT "%4.0" AXIS_PTS_REF ldp_maf_mon2_ip_iga_ref_mon2 /end AXIS_DESCR
/end CHARACTERISTIC
/begin AXIS_PTS ldp_maf_mon2_ip_iga_ref_mon2 "" 0xa080092c online_dummy _REC_AXS_20_u1 1389. _CNV_A_R_LINEAR_____15_CM 8 0. 1389. FORMAT "%4.0" /end AXIS_PTS
/begin CHARACTERISTIC ip_tqi_dif_max_mon2 "Threshold for diagnosis of engine torque overflow" MAP 0xa0800d90 _REC_MAP_20_u1_u1_u1 510. _CNV_A_R_LINEAR_____262_CM 0. 510. DISPLAY_IDENTIFIER IP_TQI_DIF_MAX_MON2 FORMAT "%3.0"
 /begin AXIS_DESCR COM_AXIS n_32_mon2 _CNV_A_R_LINEAR_____10_CM 4 0. 8160. FORMAT "%4.0" AXIS_PTS_REF ldp_n_32_mon2_ip_tqi_dif_mon2 /end AXIS_DESCR
 /begin AXIS_DESCR COM_AXIS tqi_sp_mon_mon2 _CNV_A_R_LINEAR_____262_CM 4 0. 510. FORMAT "%3.0" AXIS_PTS_REF ldp_tqi_sp_mon_mon2_ip_mon2 /end AXIS_DESCR
/end CHARACTERISTIC
/begin CHARACTERISTIC ip_tqi_cus_mon2 "Customer specific engine torque (process monitoring)" MAP 0xa0800d60 _REC_MAP_20_u1_u1_u2 510. _CNV_A_R_LINEAR_____262_CM 0. 510. DISPLAY_IDENTIFIER IP_TQI_CUS_MON2 FORMAT "%3.0"
 /begin AXIS_DESCR COM_AXIS n_32_mon2 _CNV_A_R_LINEAR_____10_CM 6 0. 8160. FORMAT "%4.0" AXIS_PTS_REF ldp_n_32_mon2_ip_tqi_cus_mon2 /end AXIS_DESCR
 /begin AXIS_DESCR COM_AXIS online_dummy _CNV_A_R_LINEAR_____111_CM 8 0. 1389. FORMAT "%7.2" AXIS_PTS_REF ldp_mff_mon2_ip_tqi_cus_mon2 /end AXIS_DESCR
/end CHARACTERISTIC
/begin MEASUREMENT lv_err_tran_1_mon2 "Flag for temporary fault 1 (exclusive fault of L3) during last recurrency" UBYTE _CNV_S_2_RANGE__0___1_CM 1 100. 0. 1. DISPLAY_IDENTIFIER LV_ERR_TRAN_1_MON2 ECU_ADDRESS 0xd0001e4d BIT_MASK 0x1 /end MEASUREMENT
/begin MEASUREMENT lv_err_tran_2_mon2 "Flag for temporary fault 2 (together with fault of L2) during last recurrency" UBYTE _CNV_S_2_RANGE__0___1_CM 1 100. 0. 1. DISPLAY_IDENTIFIER LV_ERR_TRAN_2_MON2 ECU_ADDRESS 0xd0001e4f BIT_MASK 0x1 /end MEASUREMENT
/begin CHARACTERISTIC id_lf_1_mon2 "Table of logical starting values 1" CURVE 0xa0800aa4 _REC_CUR_20_u1_u1 255. _CNV_A_R_LINEAR_____0_CM 0. 255. DISPLAY_IDENTIFIER ID_LF_1_MON2 FORMAT "%3.0"
 /begin AXIS_DESCR COM_AXIS test_rec_idx_mon2 _CNV_A_R_LINEAR_____0_CM 15 0. 15. FORMAT "%3.0" AXIS_PTS_REF ldpm_test_rec_idx_mon2 /end AXIS_DESCR
/end CHARACTERISTIC
/begin CHARACTERISTIC id_lf_2_mon2 "Table of logical starting values 2" CURVE 0xa0800ab4 _REC_CUR_20_u1_u1 255. _CNV_A_R_LINEAR_____0_CM 0. 255. DISPLAY_IDENTIFIER ID_LF_2_MON2 FORMAT "%3.0"
 /begin AXIS_DESCR COM_AXIS test_rec_idx_mon2 _CNV_A_R_LINEAR_____0_CM 15 0. 15. FORMAT "%3.0" AXIS_PTS_REF ldpm_test_rec_idx_mon2 /end AXIS_DESCR
/end CHARACTERISTIC
/begin CHARACTERISTIC id_lf_3_mon2 "Table of logical starting values 3" CURVE 0xa0800ac4 _REC_CUR_20_u1_u1 255. _CNV_A_R_LINEAR_____0_CM 0. 255. DISPLAY_IDENTIFIER ID_LF_3_MON2 FORMAT "%3.0"
 /begin AXIS_DESCR COM_AXIS test_rec_idx_mon2 _CNV_A_R_LINEAR_____0_CM 15 0. 15. FORMAT "%3.0" AXIS_PTS_REF ldpm_test_rec_idx_mon2 /end AXIS_DESCR
/end CHARACTERISTIC
/begin CHARACTERISTIC id_lf_4_mon2 "Table of logical starting values 4" CURVE 0xa0800ad4 _REC_CUR_20_u1_u1 255. _CNV_A_R_LINEAR_____0_CM 0. 255. DISPLAY_IDENTIFIER ID_LF_4_MON2 FORMAT "%3.0"
 /begin AXIS_DESCR COM_AXIS test_rec_idx_mon2 _CNV_A_R_LINEAR_____0_CM 15 0. 15. FORMAT "%3.0" AXIS_PTS_REF ldpm_test_rec_idx_mon2 /end AXIS_DESCR
/end CHARACTERISTIC
/begin MEASUREMENT fac_tq_req_cru_mon "Charge demand from cruise control" UBYTE _CNV_A_R_LINEAR_____103_CM 1 100. 0. 1.9921875 DISPLAY_IDENTIFIER FAC_TQ_REQ_CRU_MON ECU_ADDRESS 0xd00073f6 FORMAT "%8.6" /end MEASUREMENT
/begin MEASUREMENT t_cru_inh_mon "Delay time for disable of GS torque demand in monitoring level" UBYTE _CNV_A_R_LINEAR_____261_CM 1 100. 0. 10.2 DISPLAY_IDENTIFIER T_CRU_INH_MON ECU_ADDRESS 0xd0001e19 FORMAT "%5.2" /end MEASUREMENT
/begin CHARACTERISTIC c_t_cru_inh_mon "Delay time for disable of GS torque demand in monitoring level" VALUE 0xa080ccb7 _REC_VAL_20_u1 10.2 _CNV_A_R_LINEAR_____261_CM 0. 10.2 DISPLAY_IDENTIFIER C_T_CRU_INH_MON FORMAT "%5.2" /end CHARACTERISTIC
/begin CHARACTERISTIC c_vs_min_cru_mon "Minimum threshold for vehicle speed control active" VALUE 0xa080cd19 _REC_VAL_20_u1 510. _CNV_A_R_ECM2_LINEA_840_CM 0. 510. DISPLAY_IDENTIFIER C_VS_MIN_CRU_MON FORMAT "%3.0" /end CHARACTERISTIC
/begin MEASUREMENT lv_cru_inh_mon "Inhibition of Cruise Control by Monitoring" UBYTE _CNV_S_2_RANGE__0___1_CM 1 100. 0. 1. DISPLAY_IDENTIFIER LV_CRU_INH_MON ECU_ADDRESS 0xd0007416 BIT_MASK 0x1 /end MEASUREMENT
/begin MEASUREMENT lv_err_cru_mon "Fault in Cruise Control present" UBYTE _CNV_S_2_RANGE__0___1_CM 1 100. 0. 1. DISPLAY_IDENTIFIER LV_ERR_CRU_MON ECU_ADDRESS 0xd000741e BIT_MASK 0x1 /end MEASUREMENT
/begin MEASUREMENT abc_cru_tq_mon "Value of the anti - bounce counter" UBYTE _CNV_A_R_LINEAR_____0_CM 1 100. 0. 255. DISPLAY_IDENTIFIER ABC_CRU_TQ_MON ECU_ADDRESS 0xd0001dd6 FORMAT "%3.0" /end MEASUREMENT
/begin CHARACTERISTIC c_abc_inc_cru_tq_mon "Anti bounce counter increment" VALUE 0xa080cc3f _REC_VAL_20_u1 255. _CNV_A_R_LINEAR_____0_CM 0. 255. DISPLAY_IDENTIFIER C_ABC_INC_CRU_TQ_MON FORMAT "%3.0" /end CHARACTERISTIC
/begin CHARACTERISTIC c_abc_max_cru_tq_mon "Maximum value of anti-bounce counter" VALUE 0xa080cc5a _REC_VAL_20_u1 254. _CNV_A_R_LINEAR_____0_CM 1. 255. DISPLAY_IDENTIFIER C_ABC_MAX_CRU_TQ_MON FORMAT "%3.0" /end CHARACTERISTIC
/begin MEASUREMENT lv_err_n_32_mon_1 "General monitoring error debounced" UBYTE _CNV_S_2_RANGE__0___1_CM 1 100. 0. 1. DISPLAY_IDENTIFIER LV_ERR_N_32_MON_1 ECU_ADDRESS 0xd0007429 BIT_MASK 0x1 /end MEASUREMENT
/begin MEASUREMENT lv_err_pvs_mon_1 "General monitoring error debounced" UBYTE _CNV_S_2_RANGE__0___1_CM 1 100. 0. 1. DISPLAY_IDENTIFIER LV_ERR_PVS_MON_1 ECU_ADDRESS 0xd000742b BIT_MASK 0x1 /end MEASUREMENT
/begin MEASUREMENT lv_err_tqi_av_mon_1 "General monitoring error debounced" UBYTE _CNV_S_2_RANGE__0___1_CM 1 100. 0. 1. DISPLAY_IDENTIFIER LV_ERR_TQI_AV_MON_1 ECU_ADDRESS 0xd0007439 BIT_MASK 0x1 /end MEASUREMENT
/begin MEASUREMENT lv_err_tqi_n_max_mon_1 "General monitoring error debounced" UBYTE _CNV_S_2_RANGE__0___1_CM 1 100. 0. 1. DISPLAY_IDENTIFIER LV_ERR_TQI_N_MAX_MON_1 ECU_ADDRESS 0xd000743b BIT_MASK 0x1 /end MEASUREMENT
/begin MEASUREMENT lv_err_mff_mon_1 "General monitoring error debounced" UBYTE _CNV_S_2_RANGE__0___1_CM 1 100. 0. 1. DISPLAY_IDENTIFIER LV_ERR_MFF_MON_1 ECU_ADDRESS 0xd0007426 BIT_MASK 0x1 /end MEASUREMENT
/begin MEASUREMENT lv_err_tq_dif_isc_mon_1 "General monitoring error debounced" UBYTE _CNV_S_2_RANGE__0___1_CM 1 100. 0. 1. DISPLAY_IDENTIFIER LV_ERR_TQ_DIF_ISC_MON_1 ECU_ADDRESS 0xd0007431 BIT_MASK 0x1 /end MEASUREMENT
/begin MEASUREMENT lv_err_tq_req_mon_1 "General monitoring error debounced" UBYTE _CNV_S_2_RANGE__0___1_CM 1 100. 0. 1. DISPLAY_IDENTIFIER LV_ERR_TQ_REQ_MON_1 ECU_ADDRESS 0xd0007437 BIT_MASK 0x1 /end MEASUREMENT
/begin MEASUREMENT lv_err_tq_ext_mon_1 "General monitoring error debounced" UBYTE _CNV_S_2_RANGE__0___1_CM 1 100. 0. 1. DISPLAY_IDENTIFIER LV_ERR_TQ_EXT_MON_1 ECU_ADDRESS 0xd0007433 BIT_MASK 0x1 /end MEASUREMENT
/begin CHARACTERISTIC c_vb_min_mon_diag "Battery Voltage" VALUE 0xa080cd0e _REC_VAL_20_u1 25.8984375 _CNV_A_R_LINEAR_____272_CM 0. 25.8984375 DISPLAY_IDENTIFIER C_VB_MIN_MON_DIAG FORMAT "%9.6" /end CHARACTERISTIC
/begin MEASUREMENT lv_err_conv_mon_1 "General monitoring error debounced" UBYTE _CNV_S_2_RANGE__0___1_CM 1 100. 0. 1. DISPLAY_IDENTIFIER LV_ERR_CONV_MON_1 ECU_ADDRESS 0xd000741b BIT_MASK 0x1 /end MEASUREMENT
/begin MEASUREMENT lv_err_swi_afs_mon "General monitoring error debounced" UBYTE _CNV_S_2_RANGE__0___1_CM 1 100. 0. 1. DISPLAY_IDENTIFIER LV_ERR_SWI_AFS_MON ECU_ADDRESS 0xd000742e BIT_MASK 0x1 /end MEASUREMENT
/begin MEASUREMENT ctr_swi_afs_mon "General monitoring error debounced" UBYTE _CNV_A_R_LINEAR_____0_CM 1 100. 0. 255. DISPLAY_IDENTIFIER CTR_SWI_AFS_MON ECU_ADDRESS 0xd0005484 FORMAT "%3.0" BIT_MASK 0x1 /end MEASUREMENT
/begin MEASUREMENT lv_err_cru_inh_mon_1 "General monitoring error debounced" UBYTE _CNV_S_2_RANGE__0___1_CM 1 100. 0. 1. DISPLAY_IDENTIFIER LV_ERR_CRU_INH_MON_1 ECU_ADDRESS 0xd000741d BIT_MASK 0x1 /end MEASUREMENT
/begin MEASUREMENT lv_n_lim_req_mon "Request for engine speed limitation" UBYTE _CNV_S_2_RANGE__0___1_CM 1 100. 0. 1. DISPLAY_IDENTIFIER LV_N_LIM_REQ_MON ECU_ADDRESS 0xd000744c BIT_MASK 0x1 /end MEASUREMENT
/begin MEASUREMENT lv_off_mtc_mon "Request for disable of MTC power stage by main controller" UBYTE _CNV_S_2_RANGE__0___1_CM 1 100. 0. 1. DISPLAY_IDENTIFIER LV_OFF_MTC_MON ECU_ADDRESS 0xd000744f BIT_MASK 0x1 /end MEASUREMENT
/begin MEASUREMENT lv_off_iv_mon "Request for disable of IV power stage by main controller" UBYTE _CNV_S_2_RANGE__0___1_CM 1 100. 0. 1. DISPLAY_IDENTIFIER LV_OFF_IV_MON ECU_ADDRESS 0xd000744d BIT_MASK 0x1 /end MEASUREMENT
/begin MEASUREMENT lv_off_iv_n_lim_etc_tmp_mon "Flag for temporary injection cut off  during last recurrency" UBYTE _CNV_S_2_RANGE__0___1_CM 1 100. 0. 1. DISPLAY_IDENTIFIER LV_OFF_IV_N_LIM_ETC_TMP_MON ECU_ADDRESS 0xd0001e54 BIT_MASK 0x1 /end MEASUREMENT
/begin MEASUREMENT lv_err_tran_1_mon "Flag for temporary fault 1 (exclusive fault of L3) during last recurrency" UBYTE _CNV_S_2_RANGE__0___1_CM 1 100. 0. 1. DISPLAY_IDENTIFIER LV_ERR_TRAN_1_MON ECU_ADDRESS 0xd0001e4c BIT_MASK 0x1 /end MEASUREMENT
/begin MEASUREMENT lv_err_tran_2_mon "Flag for temporary fault 2 (together with fault of L2) during last recurrency" UBYTE _CNV_S_2_RANGE__0___1_CM 1 100. 0. 1. DISPLAY_IDENTIFIER LV_ERR_TRAN_2_MON ECU_ADDRESS 0xd0001e4e BIT_MASK 0x1 /end MEASUREMENT
/begin MEASUREMENT tq_dif_p_d_is_dif_mon "Difference between monitored and modelled PD-part" SBYTE _CNV_A_R_LINEAR_____262_CM 1 100. -256. 254. DISPLAY_IDENTIFIER TQ_DIF_P_D_IS_DIF_MON ECU_ADDRESS 0xd0001e2a FORMAT "%4.0" /end MEASUREMENT
/begin MEASUREMENT tq_dif_p_d_is_ramp_mon "Modelled PD-part during ramp function" UWORD _CNV_A_R_LINEAR_____31_CM 1 100. 0. 1023.96875 DISPLAY_IDENTIFIER TQ_DIF_P_D_IS_RAMP_MON ECU_ADDRESS 0xd0001d92 FORMAT "%10.5" /end MEASUREMENT
/begin MEASUREMENT state_err_tq_dif_p_d_is_mon "State variable for fault detection in torque generation, symptom 'idle speed controller - PD-part'" UBYTE _CNV_S_5_ECM2_RANGE_841_CM 1 100. 0. 4. DISPLAY_IDENTIFIER STATE_ERR_TQ_DIF_P_D_IS_MON ECU_ADDRESS 0xd0007408 /end MEASUREMENT
/begin MEASUREMENT tq_dif_i_is_ramp_mon "Modelled I-part dring ramp function" SWORD _CNV_A_R_ECM2_LINEA_842_CM 1 100. -256. 255.9921875 DISPLAY_IDENTIFIER TQ_DIF_I_IS_RAMP_MON ECU_ADDRESS 0xd0001d8c FORMAT "%9.4" /end MEASUREMENT
/begin MEASUREMENT tq_dif_i_is_dif_mon "Difference between monitored and modelled I-part" SBYTE _CNV_A_R_LINEAR_____262_CM 1 100. -256. 254. DISPLAY_IDENTIFIER TQ_DIF_I_IS_DIF_MON ECU_ADDRESS 0xd0001e29 FORMAT "%4.0" /end MEASUREMENT
/begin CHARACTERISTIC c_fac_ramp_neg_i_is_mon "Factor for monitoring negative ISC deactivation-ramp of I-part" VALUE 0xa080cc82 _REC_VAL_20_u2 0.5 _CNV_A_R_ECM2_LINEA_836_CM 0. 0.5 DISPLAY_IDENTIFIER C_FAC_RAMP_NEG_I_IS_MON FORMAT "%8.6" /end CHARACTERISTIC
/begin MEASUREMENT state_err_tq_dif_i_is_mon "State variable for fault detection in torque generation, symptom 'idle speed controller -   I-part'" UBYTE _CNV_S_5_ECM2_RANGE_841_CM 1 100. 0. 4. DISPLAY_IDENTIFIER STATE_ERR_TQ_DIF_I_IS_MON ECU_ADDRESS 0xd0007407 /end MEASUREMENT
/begin CHARACTERISTIC c_tq_dif_i_is_max_mon "Maximum I-part" VALUE 0xa080ccdb _REC_VAL_20_u1 255. _CNV_A_R_LINEAR_____64_CM 0. 255. DISPLAY_IDENTIFIER C_TQ_DIF_I_IS_MAX_MON FORMAT "%3.0" /end CHARACTERISTIC
/begin CHARACTERISTIC c_tq_dif_i_is_add_mon "Additive constant for I-part model value" VALUE 0xa080ccda _REC_VAL_20_u1 255. _CNV_A_R_LINEAR_____64_CM 0. 255. DISPLAY_IDENTIFIER C_TQ_DIF_I_IS_ADD_MON FORMAT "%3.0" /end CHARACTERISTIC
/begin CHARACTERISTIC c_tq_pas_i_is_mon "Target value for monitoring ISC deactivation-ramp operation" VALUE 0xa080ccf4 _REC_VAL_20_u1 255. _CNV_A_R_LINEAR_____64_CM 0. 255. DISPLAY_IDENTIFIER C_TQ_PAS_I_IS_MON FORMAT "%3.0" /end CHARACTERISTIC
/begin MEASUREMENT lv_err_tq_dif_p_d_is_mon "Fault currently present in torque generation, symptom 'idle speed controller - PD-part'" UBYTE _CNV_S_2_RANGE__0___1_CM 1 100. 0. 1. DISPLAY_IDENTIFIER LV_ERR_TQ_DIF_P_D_IS_MON ECU_ADDRESS 0xd0007432 BIT_MASK 0x1 /end MEASUREMENT
/begin MEASUREMENT tq_add_p_d_is_mon "Decrement for modelled PD-part during ramp function" SWORD _CNV_A_R_LINEAR_____31_CM 1 100. -1024. 1023.96875 DISPLAY_IDENTIFIER TQ_ADD_P_D_IS_MON ECU_ADDRESS 0xd0001d88 FORMAT "%11.5" /end MEASUREMENT
/begin MEASUREMENT abc_tq_dif_p_d_is_mon "Anti bounce counter for monitoring of idle speed controller - PD-part" UBYTE _CNV_A_R_LINEAR_____0_CM 1 100. 0. 255. DISPLAY_IDENTIFIER ABC_TQ_DIF_P_D_IS_MON ECU_ADDRESS 0xd0001de5 FORMAT "%3.0" /end MEASUREMENT
/begin CHARACTERISTIC c_abc_inc_tq_dif_p_d_is_mon "Anti bounce counter increment" VALUE 0xa080cc51 _REC_VAL_20_u1 255. _CNV_A_R_LINEAR_____0_CM 0. 255. DISPLAY_IDENTIFIER C_ABC_INC_TQ_DIF_P_D_IS_MON FORMAT "%3.0" /end CHARACTERISTIC
/begin CHARACTERISTIC c_abc_max_tq_dif_p_d_is_mon "Maximum of anti bounce counter" VALUE 0xa080cc6c _REC_VAL_20_u1 254. _CNV_A_R_LINEAR_____0_CM 1. 255. DISPLAY_IDENTIFIER C_ABC_MAX_TQ_DIF_P_D_IS_MON FORMAT "%3.0" /end CHARACTERISTIC
/begin CHARACTERISTIC c_tq_p_d_isc_not_act_max_mon "Maximum PD-part allowed when ISC not active" VALUE 0xa080ccf2 _REC_VAL_20_s2 2047.96875 _CNV_A_R_LINEAR_____31_CM -1024. 1023.96875 DISPLAY_IDENTIFIER C_TQ_P_D_ISC_NOT_ACT_MAX_MON FORMAT "%11.5" /end CHARACTERISTIC
/begin MEASUREMENT tq_dif_i_is_mon "Monitored I-part of the idle speed controller" SWORD _CNV_A_R_LINEAR_____31_CM 1 100. -1024. 1023.96875 DISPLAY_IDENTIFIER TQ_DIF_I_IS_MON ECU_ADDRESS 0xd00065c2 FORMAT "%11.5" /end MEASUREMENT
/begin MEASUREMENT tq_add_i_is_mon "Decrement for modelled I-part during ramp function" SWORD _CNV_A_R_LINEAR_____31_CM 1 100. -1024. 1023.96875 DISPLAY_IDENTIFIER TQ_ADD_I_IS_MON ECU_ADDRESS 0xd0001d86 FORMAT "%11.5" /end MEASUREMENT
/begin MEASUREMENT abc_tq_dif_i_is_mon "Anti bounce counter for monitoring of I-part idle speed controller" UBYTE _CNV_A_R_LINEAR_____0_CM 1 100. 0. 255. DISPLAY_IDENTIFIER ABC_TQ_DIF_I_IS_MON ECU_ADDRESS 0xd0001de4 FORMAT "%3.0" /end MEASUREMENT
/begin CHARACTERISTIC c_abc_inc_tq_dif_i_is_mon "Anti bounce counter increment" VALUE 0xa080cc50 _REC_VAL_20_u1 255. _CNV_A_R_LINEAR_____0_CM 0. 255. DISPLAY_IDENTIFIER C_ABC_INC_TQ_DIF_I_IS_MON FORMAT "%3.0" /end CHARACTERISTIC
/begin CHARACTERISTIC c_abc_max_tq_dif_i_is_mon "Maximum of anti bounce counter" VALUE 0xa080cc6b _REC_VAL_20_u1 254. _CNV_A_R_LINEAR_____0_CM 1. 255. DISPLAY_IDENTIFIER C_ABC_MAX_TQ_DIF_I_IS_MON FORMAT "%3.0" /end CHARACTERISTIC
/begin CHARACTERISTIC c_tq_i_isc_not_act_max_mon "maximum I-part allowed when ISC not active" VALUE 0xa080cce0 _REC_VAL_20_s2 2047.96875 _CNV_A_R_LINEAR_____31_CM -1024. 1023.96875 DISPLAY_IDENTIFIER C_TQ_I_ISC_NOT_ACT_MAX_MON FORMAT "%11.5" /end CHARACTERISTIC
/begin MEASUREMENT lv_err_tq_dif_i_is_mon "Fault currently present in torque generation, symptom 'idle speed controller - I-part'" UBYTE _CNV_S_2_RANGE__0___1_CM 1 100. 0. 1. DISPLAY_IDENTIFIER LV_ERR_TQ_DIF_I_IS_MON ECU_ADDRESS 0xd0007430 BIT_MASK 0x1 /end MEASUREMENT
/begin CHARACTERISTIC c_tq_dif_p_d_is_add_mon "Additive constant for PD-part model value" VALUE 0xa080ccdd _REC_VAL_20_u1 255. _CNV_A_R_LINEAR_____64_CM 0. 255. DISPLAY_IDENTIFIER C_TQ_DIF_P_D_IS_ADD_MON FORMAT "%3.0" /end CHARACTERISTIC
/begin CHARACTERISTIC c_tq_dif_p_d_ramp_chk_ofs_mon "Offset for monitoring ramp start value" VALUE 0xa080ccde _REC_VAL_20_u1 255. _CNV_A_R_LINEAR_____64_CM 0. 255. DISPLAY_IDENTIFIER C_TQ_DIF_P_D_RAMP_CHK_OFS_MON FORMAT "%3.0" /end CHARACTERISTIC
/begin MEASUREMENT lv_ramp_p_d_beg_value_wrg_mon "Logical bit indicating wrong start-value of PD-ramp" UBYTE _CNV_S_2_RANGE__0___1_CM 1 100. 0. 1. DISPLAY_IDENTIFIER LV_RAMP_P_D_BEG_VALUE_WRG_MON ECU_ADDRESS 0xd0001e57 BIT_MASK 0x1 /end MEASUREMENT
/begin MEASUREMENT abc_n_32_mon "Anti bounce counter N_32 ratio error" UBYTE _CNV_A_R_LINEAR_____0_CM 1 100. 0. 255. DISPLAY_IDENTIFIER ABC_N_32_MON ECU_ADDRESS 0xd0001ddd FORMAT "%3.0" /end MEASUREMENT
/begin MEASUREMENT lv_err_n_32_mon "Logical variable for ratio error between N_32 and N_32_SUB_MON" UBYTE _CNV_S_2_RANGE__0___1_CM 1 100. 0. 1. DISPLAY_IDENTIFIER LV_ERR_N_32_MON ECU_ADDRESS 0xd0007428 BIT_MASK 0x1 /end MEASUREMENT
/begin MEASUREMENT n_32_dif_rel_mon "Relative engine speed deviation monitoring level" UWORD _CNV_A_R_ECM2_LINEA_843_CM 1 100. 0. 255. DISPLAY_IDENTIFIER N_32_DIF_REL_MON ECU_ADDRESS 0xd0001d74 FORMAT "%8.4" /end MEASUREMENT
/begin MEASUREMENT n_32_sub_mon "Engine speed substitute monitoring level" UBYTE _CNV_A_R_LINEAR_____10_CM 1 100. 0. 8160. DISPLAY_IDENTIFIER N_32_SUB_MON ECU_ADDRESS 0xd0001e08 FORMAT "%4.0" /end MEASUREMENT
/begin CHARACTERISTIC c_abc_inc_n_32_mon "Anti bounce counter increment (additive value in case of N_32 ratio error)" VALUE 0xa080cc49 _REC_VAL_20_u1 255. _CNV_A_R_LINEAR_____0_CM 0. 255. DISPLAY_IDENTIFIER C_ABC_INC_N_32_MON FORMAT "%3.0" /end CHARACTERISTIC
/begin CHARACTERISTIC c_abc_max_n_32_mon "Value at which N_32 ratio error is recognized, when reached" VALUE 0xa080cc64 _REC_VAL_20_u1 254. _CNV_A_R_LINEAR_____0_CM 1. 255. DISPLAY_IDENTIFIER C_ABC_MAX_N_32_MON FORMAT "%3.0" /end CHARACTERISTIC
/begin CHARACTERISTIC c_n_32_lim_mon "Lower limit  of denominator for relative error calculation (initial value: 32)" VALUE 0xa080cc96 _REC_VAL_20_u1 8128. _CNV_A_R_LINEAR_____10_CM 32. 8160. DISPLAY_IDENTIFIER C_N_32_LIM_MON FORMAT "%4.0" /end CHARACTERISTIC
/begin CHARACTERISTIC c_n_32_min_mon "Lower limit for using the relative error concept" VALUE 0xa080cc97 _REC_VAL_20_u1 8160. _CNV_A_R_LINEAR_____10_CM 0. 8160. DISPLAY_IDENTIFIER C_N_32_MIN_MON FORMAT "%4.0" /end CHARACTERISTIC
/begin CHARACTERISTIC c_n_32_dif_rel_max_mon "Maximum relative difference between N_32 and N_32_SUB_MON" VALUE 0xa080cc94 _REC_VAL_20_u2 255. _CNV_A_R_ECM2_LINEA_843_CM 0. 255. DISPLAY_IDENTIFIER C_N_32_DIF_REL_MAX_MON FORMAT "%8.4" /end CHARACTERISTIC
/begin MEASUREMENT n_32_mon "Engine speed (monitoring level)" UBYTE _CNV_A_R_LINEAR_____10_CM 1 100. 0. 8160. DISPLAY_IDENTIFIER N_32_MON ECU_ADDRESS 0xd00073ff FORMAT "%4.0" /end MEASUREMENT
/begin MEASUREMENT t_seg_sw_mon "Segment time determined by means of a software timer" ULONG _CNV_A_R_LINEAR_____410_CM 1 100. 0. 268435455. DISPLAY_IDENTIFIER T_SEG_SW_MON ECU_ADDRESS 0xd0001dd0 FORMAT "%9.0" /end MEASUREMENT
/begin MEASUREMENT abc_tqi_n_max_mon "Anti-bounce-counter for fault in engine speed limitation" UBYTE _CNV_A_R_LINEAR_____0_CM 1 100. 0. 255. DISPLAY_IDENTIFIER ABC_TQI_N_MAX_MON ECU_ADDRESS 0xd0001ded FORMAT "%3.0" /end MEASUREMENT
/begin MEASUREMENT lv_err_tqi_n_max_mon "Fault currently present in engine speed limitation" UBYTE _CNV_S_2_RANGE__0___1_CM 1 100. 0. 1. DISPLAY_IDENTIFIER LV_ERR_TQI_N_MAX_MON ECU_ADDRESS 0xd000743a BIT_MASK 0x1 /end MEASUREMENT
/begin CHARACTERISTIC c_n_max_mtc_lih_thd_mon "Speed threshold for the detection of a fault in the engine speed limitation" VALUE 0xa080cca2 _REC_VAL_20_u1 8160. _CNV_A_R_LINEAR_____10_CM 0. 8160. DISPLAY_IDENTIFIER C_N_MAX_MTC_LIH_THD_MON FORMAT "%4.0" /end CHARACTERISTIC
/begin CHARACTERISTIC c_abc_inc_tqi_n_max_mon "Anti bounce counter increment" VALUE 0xa080cc57 _REC_VAL_20_u1 255. _CNV_A_R_LINEAR_____0_CM 0. 255. DISPLAY_IDENTIFIER C_ABC_INC_TQI_N_MAX_MON FORMAT "%3.0" /end CHARACTERISTIC
/begin CHARACTERISTIC c_abc_max_tqi_n_max_mon "Maximum value of anti-bounce counter" VALUE 0xa080cc72 _REC_VAL_20_u1 254. _CNV_A_R_LINEAR_____0_CM 1. 255. DISPLAY_IDENTIFIER C_ABC_MAX_TQI_N_MAX_MON FORMAT "%3.0" /end CHARACTERISTIC
/begin MEASUREMENT tqi_av_mon "Actual indicated engine torque (process monitoring)" UBYTE _CNV_A_R_LINEAR_____262_CM 1 100. 0. 510. DISPLAY_IDENTIFIER TQI_AV_MON ECU_ADDRESS 0xd0007410 FORMAT "%3.0" /end MEASUREMENT
/begin AXIS_PTS ldp_n_32_mon_ip_tqi_cus_mon "" 0xa080c7ac n_32_mon _REC_AXS_20_u1 8160. _CNV_A_R_LINEAR_____10_CM 6 0. 8160. FORMAT "%4.0" /end AXIS_PTS
/begin AXIS_PTS ldp_mff_mon_ip_tqi_cus_mon "" 0xa080c778 online_dummy _REC_AXS_20_u2 1389. _CNV_A_R_LINEAR_____111_CM 8 0. 1389. FORMAT "%7.2" /end AXIS_PTS
/begin CHARACTERISTIC ip_tqi_cus_mon "Customer specific engine torque (process monitoring)" MAP 0xa080cbac _REC_MAP_20_u1_u1_u2 510. _CNV_A_R_LINEAR_____262_CM 0. 510. DISPLAY_IDENTIFIER IP_TQI_CUS_MON FORMAT "%3.0"
 /begin AXIS_DESCR COM_AXIS n_32_mon _CNV_A_R_LINEAR_____10_CM 6 0. 8160. FORMAT "%4.0" AXIS_PTS_REF ldp_n_32_mon_ip_tqi_cus_mon /end AXIS_DESCR
 /begin AXIS_DESCR COM_AXIS online_dummy _CNV_A_R_LINEAR_____111_CM 8 0. 1389. FORMAT "%7.2" AXIS_PTS_REF ldp_mff_mon_ip_tqi_cus_mon /end AXIS_DESCR
/end CHARACTERISTIC
/begin MEASUREMENT t_tqi_mon "dead time counter for torque decrease" UBYTE _CNV_A_R_LINEAR_____261_CM 1 100. 0. 10.2 DISPLAY_IDENTIFIER T_TQI_MON ECU_ADDRESS 0xd0001e26 FORMAT "%5.2" /end MEASUREMENT
/begin CHARACTERISTIC c_t_tqi_mon "Dead time for torque decrease" VALUE 0xa080ccc7 _REC_VAL_20_u1 10.2 _CNV_A_R_LINEAR_____261_CM 0. 10.2 DISPLAY_IDENTIFIER C_T_TQI_MON FORMAT "%5.2" /end CHARACTERISTIC
/begin MEASUREMENT fac_tq_req_mon "scaling factor for requested torque at clutch from driver and cruise control" UBYTE _CNV_A_R_LINEAR_____103_CM 1 100. 0. 1.9921875 DISPLAY_IDENTIFIER FAC_TQ_REQ_MON ECU_ADDRESS 0xd00073f8 FORMAT "%8.6" /end MEASUREMENT
/begin MEASUREMENT tqi_req_tot_mon "desired non-filtered indicated engine torque" UBYTE _CNV_A_R_LINEAR_____262_CM 1 100. 0. 510. DISPLAY_IDENTIFIER TQI_REQ_TOT_MON ECU_ADDRESS 0xd0001e33 FORMAT "%3.0" /end MEASUREMENT
/begin MEASUREMENT tqi_sp_mon "desired indicated engine torque" UBYTE _CNV_A_R_LINEAR_____262_CM 1 100. 0. 510. DISPLAY_IDENTIFIER TQI_SP_MON ECU_ADDRESS 0xd0007413 FORMAT "%3.0" /end MEASUREMENT
/begin MEASUREMENT fac_tq_req_driv_mon "scaling factor for requested torque at clutch from driver" UBYTE _CNV_A_R_LINEAR_____103_CM 1 100. 0. 1.9921875 DISPLAY_IDENTIFIER FAC_TQ_REQ_DRIV_MON ECU_ADDRESS 0xd00073f7 FORMAT "%8.6" /end MEASUREMENT
/begin CHARACTERISTIC ip_fac_tq_req_driv_mon "Scaling factor for requested torque at clutch from driver" MAP 0xa080cac8 _REC_MAP_20_u1_u1_u1 1.9921875 _CNV_A_R_LINEAR_____103_CM 0. 1.9921875 DISPLAY_IDENTIFIER IP_FAC_TQ_REQ_DRIV_MON FORMAT "%8.6"
 /begin AXIS_DESCR COM_AXIS n_32_mon _CNV_A_R_LINEAR_____10_CM 8 0. 8160. FORMAT "%4.0" AXIS_PTS_REF ldpm_n_32_mon_ip_fac_tq_mon /end AXIS_DESCR
 /begin AXIS_DESCR COM_AXIS pv_av_ad_mon _CNV_A_R_LINEAR_____5_CM 8 0. 99.609375 FORMAT "%9.6" AXIS_PTS_REF ldpm_pv_av_ad_mon_ip_fac_mon /end AXIS_DESCR
/end CHARACTERISTIC
/begin CHARACTERISTIC c_crlc_tqi_sp_mon "filter constant for realization of first order filter" VALUE 0xa080cc76 _REC_VAL_20_u1 0.99609375 _CNV_A_R_LINEAR_____28_CM 0. 0.99609375 DISPLAY_IDENTIFIER C_CRLC_TQI_SP_MON FORMAT "%5.3" /end CHARACTERISTIC
/begin CHARACTERISTIC ip_fac_tq_req_driv_1_mon "Scaling factor for requested torque at clutch from driver in other mode" MAP 0xa080ca88 _REC_MAP_20_u1_u1_u1 1.9921875 _CNV_A_R_LINEAR_____103_CM 0. 1.9921875 DISPLAY_IDENTIFIER IP_FAC_TQ_REQ_DRIV_1_MON FORMAT "%8.6"
 /begin AXIS_DESCR COM_AXIS n_32_mon _CNV_A_R_LINEAR_____10_CM 8 0. 8160. FORMAT "%4.0" AXIS_PTS_REF ldpm_n_32_mon_ip_fac_tq_mon /end AXIS_DESCR
 /begin AXIS_DESCR COM_AXIS pv_av_ad_mon _CNV_A_R_LINEAR_____5_CM 8 0. 99.609375 FORMAT "%9.6" AXIS_PTS_REF ldpm_pv_av_ad_mon_ip_fac_mon /end AXIS_DESCR
/end CHARACTERISTIC
/begin MEASUREMENT abc_tq_loss_mon "Anti bounce counter for monitoring of torque losses" UBYTE _CNV_A_R_LINEAR_____0_CM 1 100. 0. 255. DISPLAY_IDENTIFIER ABC_TQ_LOSS_MON ECU_ADDRESS 0xd0001de6 FORMAT "%3.0" /end MEASUREMENT
/begin MEASUREMENT lv_err_tq_loss_mon "Fault currently present in torque generation, symptom 'torque losses'" UBYTE _CNV_S_2_RANGE__0___1_CM 1 100. 0. 1. DISPLAY_IDENTIFIER LV_ERR_TQ_LOSS_MON ECU_ADDRESS 0xd0007434 BIT_MASK 0x1 /end MEASUREMENT
/begin MEASUREMENT tq_loss_mon "Torque losses" SWORD _CNV_A_R_LINEAR_____31_CM 1 100. -1024. 1023.96875 DISPLAY_IDENTIFIER TQ_LOSS_MON ECU_ADDRESS 0xd00065ce FORMAT "%11.5" /end MEASUREMENT
/begin MEASUREMENT tq_loss_req_clu_mon "Torque losses without pumping losses" SWORD _CNV_A_R_LINEAR_____31_CM 1 100. -1024. 1023.96875 DISPLAY_IDENTIFIER TQ_LOSS_REQ_CLU_MON ECU_ADDRESS 0xd00065d0 FORMAT "%11.5" /end MEASUREMENT
/begin MEASUREMENT tq_loss_mmv_mon "filtered TQ_LOSS" SWORD _CNV_A_R_LINEAR_____31_CM 1 100. -1024. 1023.96875 DISPLAY_IDENTIFIER TQ_LOSS_MMV_MON ECU_ADDRESS 0xd0001da4 FORMAT "%11.5" /end MEASUREMENT
/begin MEASUREMENT tq_loss_dif_mon "difference of monitored and modelled torque losses" SWORD _CNV_A_R_LINEAR_____31_CM 1 100. -1024. 1023.96875 DISPLAY_IDENTIFIER TQ_LOSS_DIF_MON ECU_ADDRESS 0xd0001da0 FORMAT "%11.5" /end MEASUREMENT
/begin MEASUREMENT tq_loss_mdl_mon "modelled torque losses" SWORD _CNV_A_R_LINEAR_____31_CM 1 100. -1024. 1023.96875 DISPLAY_IDENTIFIER TQ_LOSS_MDL_MON ECU_ADDRESS 0xd0001da2 FORMAT "%11.5" /end MEASUREMENT
/begin AXIS_PTS ldp_maf_mon_ip_tqfr_mon "" 0xa080c75e maf_mon _REC_AXS_20_u1 1389. _CNV_A_R_LINEAR_____15_CM 5 0. 1389. FORMAT "%4.0" /end AXIS_PTS
/begin AXIS_PTS ldp_n_32_mon_ip_tqfr_mon "" 0xa080c7a6 n_32_mon _REC_AXS_20_u1 8160. _CNV_A_R_LINEAR_____10_CM 5 0. 8160. FORMAT "%4.0" /end AXIS_PTS
/begin AXIS_PTS ldp_tco_mon_ip_tqfr_add_mon "" 0xa080c82a tco_mon _REC_AXS_20_u1 190.5 _CNV_A_R_LINEAR_____17_CM 5 -48. 142.5 FORMAT "%6.2" /end AXIS_PTS
/begin CHARACTERISTIC ip_tqfr_mon "base friction torque and pumping losses" MAP 0xa080cb90 _REC_MAP_20_u1_u1_u1 510. _CNV_A_R_LINEAR_____262_CM 0. 510. DISPLAY_IDENTIFIER IP_TQFR_MON FORMAT "%3.0"
 /begin AXIS_DESCR COM_AXIS n_32_mon _CNV_A_R_LINEAR_____10_CM 5 0. 8160. FORMAT "%4.0" AXIS_PTS_REF ldp_n_32_mon_ip_tqfr_mon /end AXIS_DESCR
 /begin AXIS_DESCR COM_AXIS maf_mon _CNV_A_R_LINEAR_____15_CM 5 0. 1389. FORMAT "%4.0" AXIS_PTS_REF ldp_maf_mon_ip_tqfr_mon /end AXIS_DESCR
/end CHARACTERISTIC
/begin CHARACTERISTIC ip_tqfr_add_mon "coolant temperature correction of friction torque" CURVE 0xa080cb88 _REC_CUR_20_u1_u1 510. _CNV_A_R_LINEAR_____262_CM 0. 510. DISPLAY_IDENTIFIER IP_TQFR_ADD_MON FORMAT "%3.0"
 /begin AXIS_DESCR COM_AXIS tco_mon _CNV_A_R_LINEAR_____17_CM 5 -48. 142.5 FORMAT "%6.2" AXIS_PTS_REF ldp_tco_mon_ip_tqfr_add_mon /end AXIS_DESCR
/end CHARACTERISTIC
/begin CHARACTERISTIC c_abc_inc_tq_loss_mon "anti bounce counter increment" VALUE 0xa080cc52 _REC_VAL_20_u1 255. _CNV_A_R_LINEAR_____0_CM 0. 255. DISPLAY_IDENTIFIER C_ABC_INC_TQ_LOSS_MON FORMAT "%3.0" /end CHARACTERISTIC
/begin CHARACTERISTIC c_abc_max_tq_loss_mon "maximum of anti bounce counter" VALUE 0xa080cc6d _REC_VAL_20_u1 254. _CNV_A_R_LINEAR_____0_CM 1. 255. DISPLAY_IDENTIFIER C_ABC_MAX_TQ_LOSS_MON FORMAT "%3.0" /end CHARACTERISTIC
/begin CHARACTERISTIC c_crlc_tq_loss_req_clu_mon "correlation constant for TQ_LOSS  filtering" VALUE 0xa080cc75 _REC_VAL_20_u1 0.99609375 _CNV_A_R_LINEAR_____28_CM 0. 0.99609375 DISPLAY_IDENTIFIER C_CRLC_TQ_LOSS_REQ_CLU_MON FORMAT "%5.3" /end CHARACTERISTIC
/begin CHARACTERISTIC c_tq_loss_dif_max_mon "threshold for tq_loss deviation" VALUE 0xa080ccea _REC_VAL_20_s1 510. _CNV_A_R_LINEAR_____262_CM -256. 254. DISPLAY_IDENTIFIER C_TQ_LOSS_DIF_MAX_MON FORMAT "%4.0" /end CHARACTERISTIC
/begin CHARACTERISTIC c_tq_is_ad_min_mon "min. limitation of engine torque losses adaptation" VALUE 0xa080cce2 _REC_VAL_20_s1 510. _CNV_A_R_LINEAR_____262_CM -256. 254. DISPLAY_IDENTIFIER C_TQ_IS_AD_MIN_MON FORMAT "%4.0" /end CHARACTERISTIC
/begin MEASUREMENT lv_err_tq_max_clu_mon "Fault currently present in torque generation, symptom 'maximum torque at clutch'" UBYTE _CNV_S_2_RANGE__0___1_CM 1 100. 0. 1. DISPLAY_IDENTIFIER LV_ERR_TQ_MAX_CLU_MON ECU_ADDRESS 0xd0007435 BIT_MASK 0x1 /end MEASUREMENT
/begin MEASUREMENT abc_tq_max_clu_mon "Anti bounce counter for monitoring of maximum torque at clutch" UBYTE _CNV_A_R_LINEAR_____0_CM 1 100. 0. 255. DISPLAY_IDENTIFIER ABC_TQ_MAX_CLU_MON ECU_ADDRESS 0xd0001de7 FORMAT "%3.0" /end MEASUREMENT
/begin MEASUREMENT tq_max_clu_max_mon "model value for maximum torque at clutch" SWORD _CNV_A_R_LINEAR_____31_CM 1 100. -1024. 1023.96875 DISPLAY_IDENTIFIER TQ_MAX_CLU_MAX_MON ECU_ADDRESS 0xd0001db2 FORMAT "%11.5" /end MEASUREMENT
/begin CHARACTERISTIC c_abc_max_tq_max_clu_mon "Maximum of anti bounce counter" VALUE 0xa080cc6e _REC_VAL_20_u1 254. _CNV_A_R_LINEAR_____0_CM 1. 255. DISPLAY_IDENTIFIER C_ABC_MAX_TQ_MAX_CLU_MON FORMAT "%3.0" /end CHARACTERISTIC
/begin MEASUREMENT tq_max_clu_mon "monitored maximum torque at clutch" SWORD _CNV_A_R_LINEAR_____31_CM 1 100. -1024. 1023.96875 DISPLAY_IDENTIFIER TQ_MAX_CLU_MON ECU_ADDRESS 0xd00065d2 FORMAT "%11.5" /end MEASUREMENT
/begin MEASUREMENT tq_max_clu_dif_mon "Difference between monitored and modelled maximum torque at clutch" SWORD _CNV_A_R_LINEAR_____31_CM 1 100. -1024. 1023.96875 DISPLAY_IDENTIFIER TQ_MAX_CLU_DIF_MON ECU_ADDRESS 0xd0001db0 FORMAT "%11.5" /end MEASUREMENT
/begin MEASUREMENT fac_cha_max_mon "Ratio between the optimal and real air efficiency" UWORD _CNV_A_R_LINEAR_____9_CM 1 100. 0. 1.99996948242188 DISPLAY_IDENTIFIER FAC_CHA_MAX_MON ECU_ADDRESS 0xd0001d40 FORMAT "%7.5" /end MEASUREMENT
/begin MEASUREMENT fac_cus_tq_max_mon "Model value of the output factor from the crossfade calculation" UWORD _CNV_A_R_LINEAR_____9_CM 1 100. 0. 1.99996948242188 DISPLAY_IDENTIFIER FAC_CUS_TQ_MAX_MON ECU_ADDRESS 0xd0001d42 FORMAT "%7.5" /end MEASUREMENT
/begin CHARACTERISTIC c_abc_inc_tq_max_clu_mon "Anti bounce counter increment" VALUE 0xa080cc53 _REC_VAL_20_u1 255. _CNV_A_R_LINEAR_____0_CM 0. 255. DISPLAY_IDENTIFIER C_ABC_INC_TQ_MAX_CLU_MON FORMAT "%3.0" /end CHARACTERISTIC
/begin CHARACTERISTIC c_ofs_tia_mon "Offset reflecting the sound velocity influence" VALUE 0xa080ccae _REC_VAL_20_u2 1.99996948242188 _CNV_A_R_LINEAR_____9_CM 0. 1.99996948242188 DISPLAY_IDENTIFIER C_OFS_TIA_MON FORMAT "%7.5" /end CHARACTERISTIC
/begin AXIS_PTS ldp_n_32_mon_ip_tqi_max_mon "" 0xa080c7b4 n_32_mon _REC_AXS_20_u1 8160. _CNV_A_R_LINEAR_____10_CM 7 0. 8160. FORMAT "%4.0" /end AXIS_PTS
/begin AXIS_PTS ldp_fac_tq_req_mon__tq_max_mon "" 0xa080c706 fac_tq_req_mon _REC_AXS_20_u1 1.9921875 _CNV_A_R_LINEAR_____103_CM 6 0. 1.9921875 FORMAT "%8.6" /end AXIS_PTS
/begin CHARACTERISTIC ip_tqi_ref_max_mon "Maximum reference indicated engine torque" CURVE 0xa080cc28 _REC_CUR_20_u2_u1 1023.96875 _CNV_A_R_LINEAR_____31_CM 0. 1023.96875 DISPLAY_IDENTIFIER IP_TQI_REF_MAX_MON FORMAT "%10.5"
 /begin AXIS_DESCR COM_AXIS n_32_mon _CNV_A_R_LINEAR_____10_CM 7 0. 8160. FORMAT "%4.0" AXIS_PTS_REF ldp_n_32_mon_ip_tqi_max_mon /end AXIS_DESCR
/end CHARACTERISTIC
/begin CHARACTERISTIC ip_fac_cha_max_fac_tq_req_mon "Weighting factor for TQ_MAX_MON correction" CURVE 0xa080c9d6 _REC_CUR_20_u1_u1 0.99609375 _CNV_A_R_LINEAR_____28_CM 0. 0.99609375 DISPLAY_IDENTIFIER IP_FAC_CHA_MAX_FAC_TQ_REQ_MON FORMAT "%5.3"
 /begin AXIS_DESCR COM_AXIS fac_tq_req_mon _CNV_A_R_LINEAR_____103_CM 6 0. 1.9921875 FORMAT "%8.6" AXIS_PTS_REF ldp_fac_tq_req_mon__tq_max_mon /end AXIS_DESCR
/end CHARACTERISTIC
/begin CHARACTERISTIC ip_fac_cha_max_1_mon "Maximum relative cylinder filling by full load under normal conditions" CURVE 0xa080c9a8 _REC_CUR_20_u2_u1 655.35 _CNV_A_R_ECM2_LINEA_845_CM -327.68 327.67 DISPLAY_IDENTIFIER IP_FAC_CHA_MAX_1_MON FORMAT "%7.2"
 /begin AXIS_DESCR COM_AXIS n_32 _CNV_A_R_LINEAR_____10_CM 11 0. 8160. FORMAT "%4.0" AXIS_PTS_REF ldpm_n_32_mon__fac_cha_mon /end AXIS_DESCR
/end CHARACTERISTIC
/begin CHARACTERISTIC ip_fac_cha_max_2_mon "Maximum relative cylinder filling" CURVE 0xa080c9c0 _REC_CUR_20_u2_u1 655.35 _CNV_A_R_ECM2_LINEA_845_CM -327.68 327.67 DISPLAY_IDENTIFIER IP_FAC_CHA_MAX_2_MON FORMAT "%7.2"
 /begin AXIS_DESCR COM_AXIS n_32 _CNV_A_R_LINEAR_____10_CM 11 0. 8160. FORMAT "%4.0" AXIS_PTS_REF ldpm_n_32_mon__fac_cha_mon /end AXIS_DESCR
/end CHARACTERISTIC
/begin MEASUREMENT fac_n_sp_is_ratio_mon "Model of control factor for engine self-stabilising effect" SWORD _CNV_A_R_LINEAR_____119_CM 1 100. -8. 7.999755859375 DISPLAY_IDENTIFIER FAC_N_SP_IS_RATIO_MON ECU_ADDRESS 0xd0001d44 FORMAT "%7.4" /end MEASUREMENT
/begin MEASUREMENT tq_st_mon "modelled value of start torque" UWORD _CNV_A_R_LINEAR_____31_CM 1 100. 0. 1023.96875 DISPLAY_IDENTIFIER TQ_ST_MON ECU_ADDRESS 0xd0001dbe FORMAT "%10.5" /end MEASUREMENT
/begin MEASUREMENT state_err_tq_min_clu_mon "State variable indicating origin of error resulting from monitoring of L1 torque value" UBYTE _CNV_S_3_ECM2_RANGE_846_CM 1 100. 0. 2. DISPLAY_IDENTIFIER STATE_ERR_TQ_MIN_CLU_MON ECU_ADDRESS 0xd0007409 /end MEASUREMENT
/begin MEASUREMENT lv_err_tq_min_clu_mon "Fault currently present in torque generation, symptom 'minimum torque at clutch'" UBYTE _CNV_S_2_RANGE__0___1_CM 1 100. 0. 1. DISPLAY_IDENTIFIER LV_ERR_TQ_MIN_CLU_MON ECU_ADDRESS 0xd0007436 BIT_MASK 0x1 /end MEASUREMENT
/begin MEASUREMENT abc_tq_min_clu_mon "Anti bounce counter for monitoring of minimum torque at clutch" UBYTE _CNV_A_R_LINEAR_____0_CM 1 100. 0. 255. DISPLAY_IDENTIFIER ABC_TQ_MIN_CLU_MON ECU_ADDRESS 0xd0001de8 FORMAT "%3.0" /end MEASUREMENT
/begin MEASUREMENT tq_min_clu_mdl_2_mon "Temporary variable 2 for calculation of modelled minimum torque at clutch" SWORD _CNV_A_R_LINEAR_____31_CM 1 100. -1024. 1023.96875 DISPLAY_IDENTIFIER TQ_MIN_CLU_MDL_2_MON ECU_ADDRESS 0xd0001db8 FORMAT "%11.5" /end MEASUREMENT
/begin AXIS_PTS ldp_n_sp_is_ratio_mon_ip_mon "" 0xa080c7e0 n_sp_is_ratio_mon _REC_AXS_20_u2 7.9998779296875 _CNV_A_R_LINEAR_____115_CM 5 0. 7.9998779296875 FORMAT "%6.4" /end AXIS_PTS
/begin CHARACTERISTIC ip_fac_n_sp_is_ratio_mon "Idle self stabilising factor" CURVE 0xa080ca34 _REC_CUR_20_u2_u2 15.999755859375 _CNV_A_R_ECM2_LINEA_847_CM -8. 7.999755859375 DISPLAY_IDENTIFIER IP_FAC_N_SP_IS_RATIO_MON FORMAT "%6.5"
 /begin AXIS_DESCR COM_AXIS n_sp_is_ratio_mon _CNV_A_R_LINEAR_____115_CM 5 0. 7.9998779296875 FORMAT "%6.4" AXIS_PTS_REF ldp_n_sp_is_ratio_mon_ip_mon /end AXIS_DESCR
/end CHARACTERISTIC
/begin AXIS_PTS ldp_n_32_mon_ip_tqi_min_mon "" 0xa080c7bc n_32_mon _REC_AXS_20_u1 8160. _CNV_A_R_LINEAR_____10_CM 6 0. 8160. FORMAT "%4.0" /end AXIS_PTS
/begin AXIS_PTS ldp_tco_mon_ip_tqi_min_pu_mon "" 0xa080c830 tco_mon _REC_AXS_20_u1 190.5 _CNV_A_R_LINEAR_____17_CM 4 -48. 142.5 FORMAT "%6.2" /end AXIS_PTS
/begin CHARACTERISTIC ip_tqi_min_req_pu_mon "Minimum requested indicated torque in PU phase" MAP 0xa080cbf8 _REC_MAP_20_u2_u1_u1 1023.96875 _CNV_A_R_LINEAR_____31_CM 0. 1023.96875 DISPLAY_IDENTIFIER IP_TQI_MIN_REQ_PU_MON FORMAT "%10.5"
 /begin AXIS_DESCR COM_AXIS n_32_mon _CNV_A_R_LINEAR_____10_CM 6 0. 8160. FORMAT "%4.0" AXIS_PTS_REF ldp_n_32_mon_ip_tqi_min_mon /end AXIS_DESCR
 /begin AXIS_DESCR COM_AXIS tco_mon _CNV_A_R_LINEAR_____17_CM 4 -48. 142.5 FORMAT "%6.2" AXIS_PTS_REF ldp_tco_mon_ip_tqi_min_pu_mon /end AXIS_DESCR
/end CHARACTERISTIC
/begin CHARACTERISTIC c_n_st_max_mon "maximum start end speed" VALUE 0xa080ccac _REC_VAL_20_u1 8160. _CNV_A_R_LINEAR_____10_CM 0. 8160. DISPLAY_IDENTIFIER C_N_ST_MAX_MON FORMAT "%4.0" /end CHARACTERISTIC
/begin CHARACTERISTIC c_abc_inc_tq_min_clu_mon "Anti bounce counter increment" VALUE 0xa080cc54 _REC_VAL_20_u1 255. _CNV_A_R_LINEAR_____0_CM 0. 255. DISPLAY_IDENTIFIER C_ABC_INC_TQ_MIN_CLU_MON FORMAT "%3.0" /end CHARACTERISTIC
/begin MEASUREMENT tq_min_clu_dif_mon "difference of monitored and modelled minimum torque at clutch" SWORD _CNV_A_R_LINEAR_____31_CM 1 100. -1024. 1023.96875 DISPLAY_IDENTIFIER TQ_MIN_CLU_DIF_MON ECU_ADDRESS 0xd0001db6 FORMAT "%11.5" /end MEASUREMENT
/begin MEASUREMENT tq_min_clu_mon "monitored minimum torque at clutch" SWORD _CNV_A_R_LINEAR_____31_CM 1 100. -1024. 1023.96875 DISPLAY_IDENTIFIER TQ_MIN_CLU_MON ECU_ADDRESS 0xd00065d4 FORMAT "%11.5" /end MEASUREMENT
/begin MEASUREMENT tq_min_clu_mdl_5_mon "Temporary variable 4 for calculation of modelled minimum torque at clutch" SWORD _CNV_A_R_LINEAR_____31_CM 1 100. -1024. 1023.96875 DISPLAY_IDENTIFIER TQ_MIN_CLU_MDL_5_MON ECU_ADDRESS 0xd0001dba FORMAT "%11.5" /end MEASUREMENT
/begin CHARACTERISTIC c_abc_max_tq_min_clu_mon "Maximum of anti bounce counter" VALUE 0xa080cc6f _REC_VAL_20_u1 254. _CNV_A_R_LINEAR_____0_CM 1. 255. DISPLAY_IDENTIFIER C_ABC_MAX_TQ_MIN_CLU_MON FORMAT "%3.0" /end CHARACTERISTIC
/begin CHARACTERISTIC c_tq_min_clu_mdl_ofs_mon "Offset for L2 model value of minimum torque at clutch" VALUE 0xa080ccf0 _REC_VAL_20_s2 2047.96875 _CNV_A_R_LINEAR_____31_CM -1024. 1023.96875 DISPLAY_IDENTIFIER C_TQ_MIN_CLU_MDL_OFS_MON FORMAT "%11.5" /end CHARACTERISTIC
/begin MEASUREMENT ctr_dly_tq_st_mon "Delay time counter for holding start torque influence" UBYTE _CNV_A_R_LINEAR_____261_CM 1 100. 0. 10.2 DISPLAY_IDENTIFIER CTR_DLY_TQ_ST_MON ECU_ADDRESS 0xd0001def FORMAT "%5.2" /end MEASUREMENT
/begin CHARACTERISTIC c_dly_tq_st_mon "Time delay to hold influence of start torque on TQ_MIN_CLU model value" VALUE 0xa080cc77 _REC_VAL_20_u1 10.2 _CNV_A_R_LINEAR_____261_CM 0. 10.2 DISPLAY_IDENTIFIER C_DLY_TQ_ST_MON FORMAT "%5.2" /end CHARACTERISTIC
/begin MEASUREMENT lv_swi_afs_mon "flag for switching to HOM_AFS due to non-HOM_AFS" UBYTE _CNV_S_2_RANGE__0___1_CM 1 100. 0. 1. DISPLAY_IDENTIFIER LV_SWI_AFS_MON ECU_ADDRESS 0xd0007458 BIT_MASK 0x1 /end MEASUREMENT
/begin CHARACTERISTIC lc_swi_afs_mon "Switch to force engine into AFS mode (process monitoring)" VALUE 0xa080cd20 _REC_VAL_20_u1 1. _CNV_A_R_LINEAR_____0_CM 0. 1. DISPLAY_IDENTIFIER LC_SWI_AFS_MON FORMAT "%1.0" /end CHARACTERISTIC
/begin MEASUREMENT eff_tot_mon "total actual efficiencies" UBYTE _CNV_A_R_LINEAR_____103_CM 1 100. 0. 1.9921875 DISPLAY_IDENTIFIER EFF_TOT_MON ECU_ADDRESS 0xd00073d1 FORMAT "%8.6" /end MEASUREMENT
/begin MEASUREMENT eff_iga_hom_mon "ignition efficiency in homogeneous (process monitoring)" UBYTE _CNV_A_R_LINEAR_____103_CM 1 100. 0. 1.9921875 DISPLAY_IDENTIFIER EFF_IGA_HOM_MON ECU_ADDRESS 0xd0001df2 FORMAT "%8.6" /end MEASUREMENT
/begin MEASUREMENT eff_iga_s_mon "ignition efficiency in stratified (process monitoring)" UBYTE _CNV_A_R_LINEAR_____103_CM 1 100. 0. 1.9921875 DISPLAY_IDENTIFIER EFF_IGA_S_MON ECU_ADDRESS 0xd0001df6 FORMAT "%8.6" /end MEASUREMENT
/begin MEASUREMENT eff_lamb_hom_mon "lambda efficiency in homogeneous (process monitoring)" UBYTE _CNV_A_R_LINEAR_____103_CM 1 100. 0. 1.9921875 DISPLAY_IDENTIFIER EFF_LAMB_HOM_MON ECU_ADDRESS 0xd0001df8 FORMAT "%8.6" /end MEASUREMENT
/begin MEASUREMENT eff_lamb_s_mon "lambda efficiency in stratified homogeneous (process monitoring)" UBYTE _CNV_A_R_LINEAR_____103_CM 1 100. 0. 1.9921875 DISPLAY_IDENTIFIER EFF_LAMB_S_MON ECU_ADDRESS 0xd0001dfc FORMAT "%8.6" /end MEASUREMENT
/begin CHARACTERISTIC ip_eff_iga_hom_mon "actual ignition efficiency in homogeneous (process monitoring)" CURVE 0xa080c978 _REC_CUR_20_u1_u2 99.609375 _CNV_A_R_LINEAR_____5_CM 0. 99.609375 DISPLAY_IDENTIFIER IP_EFF_IGA_HOM_MON FORMAT "%9.6"
 /begin AXIS_DESCR COM_AXIS online_dummy _CNV_A_R_LINEAR_____189_CM 8 0. -180. FORMAT "%8.4" AXIS_PTS_REF ldpm_iga_dif_av_mon_ip_eff_mon /end AXIS_DESCR
/end CHARACTERISTIC
/begin CHARACTERISTIC ip_eff_lamb_hom_mon "lambda efficiency in homogeneous (process monitoring)" CURVE 0xa080c988 _REC_CUR_20_u1_u2 1.9921875 _CNV_A_R_LINEAR_____103_CM 0. 1.9921875 DISPLAY_IDENTIFIER IP_EFF_LAMB_HOM_MON FORMAT "%8.6"
 /begin AXIS_DESCR COM_AXIS lamb_mon _CNV_A_R_LINEAR_____129_CM 8 0. 31.9990234375 FORMAT "%7.4" AXIS_PTS_REF ldp_lamb_hom_mon_ip_eff_mon /end AXIS_DESCR
/end CHARACTERISTIC
/begin CHARACTERISTIC ip_eff_lamb_s_mon "lambda efficiency in stratified (process monitoring)" CURVE 0xa080c998 _REC_CUR_20_u1_u2 1.9921875 _CNV_A_R_LINEAR_____103_CM 0. 1.9921875 DISPLAY_IDENTIFIER IP_EFF_LAMB_S_MON FORMAT "%8.6"
 /begin AXIS_DESCR COM_AXIS lamb_mon _CNV_A_R_LINEAR_____129_CM 8 0. 31.9990234375 FORMAT "%7.4" AXIS_PTS_REF ldp_lamb_s_mon_ip_eff_mon /end AXIS_DESCR
/end CHARACTERISTIC
/begin CHARACTERISTIC ip_iga_ref_hom_mon "reference ignition angle in homogeneous (process monitoring)" MAP 0xa080cd24 _REC_MAP_20_u2_u1_u1 180. _CNV_A_R_LINEAR_____132_CM -90. 90. DISPLAY_IDENTIFIER IP_IGA_REF_HOM_MON FORMAT "%8.4"
 /begin AXIS_DESCR COM_AXIS n_32 _CNV_A_R_LINEAR_____10_CM 8 0. 8160. FORMAT "%4.0" AXIS_PTS_REF ldpm_n_32_mon_ip_iga_ref_mon /end AXIS_DESCR
 /begin AXIS_DESCR COM_AXIS maf_mon _CNV_A_R_LINEAR_____15_CM 8 0. 1389. FORMAT "%4.0" AXIS_PTS_REF ldp_maf_mon_ip_iga_ref_mon /end AXIS_DESCR
/end CHARACTERISTIC
/begin MEASUREMENT eff_iga_homs_mon "ignition efficiency in multiple homogeneous_stratified (process monitoring)" UBYTE _CNV_A_R_LINEAR_____103_CM 1 100. 0. 1.9921875 DISPLAY_IDENTIFIER EFF_IGA_HOMS_MON ECU_ADDRESS 0xd0001df4 FORMAT "%8.6" /end MEASUREMENT
/begin MEASUREMENT eff_lamb_homs_mon "lambda efficiency in multiple homogeneous_stratified (process monitoring)" UBYTE _CNV_A_R_LINEAR_____103_CM 1 100. 0. 1.9921875 DISPLAY_IDENTIFIER EFF_LAMB_HOMS_MON ECU_ADDRESS 0xd0001dfa FORMAT "%8.6" /end MEASUREMENT
/begin CHARACTERISTIC ip_eff_iga_homs_mon "actual ignition efficiency in homogeneous_stratified (process monitoring)" CURVE 0xa080c980 _REC_CUR_20_u1_u2 1.9921875 _CNV_A_R_LINEAR_____103_CM 0. 1.9921875 DISPLAY_IDENTIFIER IP_EFF_IGA_HOMS_MON FORMAT "%8.6"
 /begin AXIS_DESCR COM_AXIS online_dummy _CNV_A_R_LINEAR_____189_CM 8 0. -180. FORMAT "%8.4" AXIS_PTS_REF ldpm_iga_dif_av_mon_ip_eff_mon /end AXIS_DESCR
/end CHARACTERISTIC
/begin AXIS_PTS ldp_mff_mon_ip_iga_ref_mon "" 0xa080c764 mff_tq_mon _REC_AXS_20_u2 1389. _CNV_A_R_LINEAR_____111_CM 8 0. 1389. FORMAT "%7.2" /end AXIS_PTS
/begin AXIS_PTS ldp_lamb_homs_mon_ip_eff_mon "" 0xa080c724 lamb_mon _REC_AXS_20_u2 31.9990234375 _CNV_A_R_LINEAR_____129_CM 8 0. 31.9990234375 FORMAT "%7.4" /end AXIS_PTS
/begin CHARACTERISTIC ip_eff_lamb_homs_mon "lambda efficiency in homogeneous_stratified (process monitoring)" CURVE 0xa080c990 _REC_CUR_20_u1_u2 1.9921875 _CNV_A_R_LINEAR_____103_CM 0. 1.9921875 DISPLAY_IDENTIFIER IP_EFF_LAMB_HOMS_MON FORMAT "%8.6"
 /begin AXIS_DESCR COM_AXIS lamb_mon _CNV_A_R_LINEAR_____129_CM 8 0. 31.9990234375 FORMAT "%7.4" AXIS_PTS_REF ldp_lamb_homs_mon_ip_eff_mon /end AXIS_DESCR
/end CHARACTERISTIC
/begin AXIS_PTS ldp_maf_mon_ip_iga_ref_mon "" 0xa080c754 maf_mon _REC_AXS_20_u1 1389. _CNV_A_R_LINEAR_____15_CM 8 0. 1389. FORMAT "%4.0" /end AXIS_PTS
/begin AXIS_PTS ldp_maf_mon_ip_fac_eff_iga_mon "" 0xa080c74a maf_mon _REC_AXS_20_u1 1389. _CNV_A_R_LINEAR_____15_CM 6 0. 1389. FORMAT "%4.0" /end AXIS_PTS
/begin AXIS_PTS ldp_n_32_mon_ip_fac_eff_iga_mon "" 0xa080c798 n_32_mon _REC_AXS_20_u1 8160. _CNV_A_R_LINEAR_____10_CM 6 0. 8160. FORMAT "%4.0" /end AXIS_PTS
/begin CHARACTERISTIC ip_iga_ref_homs_mon "reference ignition angle in multiple homogeneous (process monitoring)" MAP 0xa080cda4 _REC_MAP_20_u2_u1_u2 180. _CNV_A_R_LINEAR_____132_CM -90. 90. DISPLAY_IDENTIFIER IP_IGA_REF_HOMS_MON FORMAT "%8.4"
 /begin AXIS_DESCR COM_AXIS n_32 _CNV_A_R_LINEAR_____10_CM 8 0. 8160. FORMAT "%4.0" AXIS_PTS_REF ldpm_n_32_mon_ip_iga_ref_mon /end AXIS_DESCR
 /begin AXIS_DESCR COM_AXIS mff_tq_mon _CNV_A_R_LINEAR_____111_CM 8 0. 1389. FORMAT "%7.2" AXIS_PTS_REF ldp_mff_mon_ip_iga_ref_mon /end AXIS_DESCR
/end CHARACTERISTIC
/begin CHARACTERISTIC ip_fac_eff_iga_mon "factor ignition efficiency (process monitoring)" MAP 0xa080ca0c _REC_MAP_20_u1_u1_u1 15.9375 _CNV_A_R_EVAC_LINEA_298_CM 0. 15.9375 DISPLAY_IDENTIFIER IP_FAC_EFF_IGA_MON FORMAT "%7.4"
 /begin AXIS_DESCR COM_AXIS n_32_mon _CNV_A_R_LINEAR_____10_CM 6 0. 8160. FORMAT "%4.0" AXIS_PTS_REF ldp_n_32_mon_ip_fac_eff_iga_mon /end AXIS_DESCR
 /begin AXIS_DESCR COM_AXIS maf_mon _CNV_A_R_LINEAR_____15_CM 6 0. 1389. FORMAT "%4.0" AXIS_PTS_REF ldp_maf_mon_ip_fac_eff_iga_mon /end AXIS_DESCR
/end CHARACTERISTIC
/begin AXIS_PTS ldp_lamb_hom_mon_ip_eff_mon "" 0xa080c710 lamb_mon _REC_AXS_20_u2 31.9990234375 _CNV_A_R_LINEAR_____129_CM 8 0. 31.9990234375 FORMAT "%7.4" /end AXIS_PTS
/begin AXIS_PTS ldp_lamb_s_mon_ip_eff_mon "" 0xa080c738 lamb_mon _REC_AXS_20_u2 31.9990234375 _CNV_A_R_LINEAR_____129_CM 8 0. 31.9990234375 FORMAT "%7.4" /end AXIS_PTS
/begin MEASUREMENT iga_dif_av_h_rng_hom_mon "difference from reference to actual ignition angle in homogeneous (process monitoring)" UWORD _CNV_A_R_LINEAR_____189_CM 1 100. 0. -180. DISPLAY_IDENTIFIER IGA_DIF_AV_H_RNG_HOM_MON ECU_ADDRESS 0xd0001d48 FORMAT "%8.4" /end MEASUREMENT
/begin MEASUREMENT iga_dif_av_h_rng_homs_mon "difference from reference to actual ignition angle in homogeneous_stratified (process monitoring)" UWORD _CNV_A_R_LINEAR_____189_CM 1 100. 0. -180. DISPLAY_IDENTIFIER IGA_DIF_AV_H_RNG_HOMS_MON ECU_ADDRESS 0xd0001d4c FORMAT "%8.4" /end MEASUREMENT
/begin MEASUREMENT lamb_dif_mon "Deviation between actual and modeled Lambda" SWORD _CNV_A_R_LINEAR_____129_CM 1 100. -32. 31.9990234375 DISPLAY_IDENTIFIER LAMB_DIF_MON ECU_ADDRESS 0xd00065ae FORMAT "%8.4" /end MEASUREMENT
/begin MEASUREMENT maf_mon "Mass air flow signal used monitoring level" UBYTE _CNV_A_R_LINEAR_____15_CM 1 100. 0. 1389. DISPLAY_IDENTIFIER MAF_MON ECU_ADDRESS 0xd00073fe FORMAT "%4.0" /end MEASUREMENT
/begin MEASUREMENT lamb_mon "Modeled Lambda" UWORD _CNV_A_R_LINEAR_____129_CM 1 100. 0. 31.9990234375 DISPLAY_IDENTIFIER LAMB_MON ECU_ADDRESS 0xd00065b0 FORMAT "%7.4" /end MEASUREMENT
/begin MEASUREMENT lamb_mdl_dly_mon "Modeled Lambda signal after delay" UWORD _CNV_A_R_LINEAR_____129_CM 1 100. 0. 31.9990234375 DISPLAY_IDENTIFIER LAMB_MDL_DLY_MON ECU_ADDRESS 0xd0001d64 FORMAT "%7.4" /end MEASUREMENT
/begin MEASUREMENT lamb_mdl_sens_mon "Modeled Lambda sensor signal" UWORD _CNV_A_R_LINEAR_____129_CM 1 100. 0. 31.9990234375 DISPLAY_IDENTIFIER LAMB_MDL_SENS_MON ECU_ADDRESS 0xd0001d68 FORMAT "%7.4" /end MEASUREMENT
/begin CHARACTERISTIC c_thd_mff_min_mon "treshold for minimum injected fuel mass" VALUE 0xa080ccd6 _REC_VAL_20_u2 1389. _CNV_A_R_LINEAR_____111_CM 0. 1389. DISPLAY_IDENTIFIER C_THD_MFF_MIN_MON FORMAT "%7.2" /end CHARACTERISTIC
/begin CHARACTERISTIC c_fac_mff_maf_mon "Stoichiometric Constant for Lambda calculation" VALUE 0xa080cc7e _REC_VAL_20_u2 15.999755859375 _CNV_A_R_LINEAR_____119_CM 0. 15.999755859375 DISPLAY_IDENTIFIER C_FAC_MFF_MAF_MON FORMAT "%7.4" /end CHARACTERISTIC
/begin CHARACTERISTIC c_lamb_ref_mon "adjustable lambda reference" VALUE 0xa080cc90 _REC_VAL_20_u2 31.9990234375 _CNV_A_R_LINEAR_____129_CM 0. 31.9990234375 DISPLAY_IDENTIFIER C_LAMB_REF_MON FORMAT "%7.4" /end CHARACTERISTIC
/begin CHARACTERISTIC lc_lamb_ref_mon "lambda reference selection" VALUE 0xa080cd1c _REC_VAL_20_u1 1. _CNV_A_R_LINEAR_____0_CM 0. 1. DISPLAY_IDENTIFIER LC_LAMB_REF_MON FORMAT "%1.0" /end CHARACTERISTIC
/begin MEASUREMENT lamb_mdl_ref_mon "Modeled lambda at reference conditions" UWORD _CNV_A_R_LINEAR_____129_CM 1 100. 0. 31.9990234375 DISPLAY_IDENTIFIER LAMB_MDL_REF_MON ECU_ADDRESS 0xd0001d66 FORMAT "%7.4" /end MEASUREMENT
/begin CHARACTERISTIC c_thd_max_lamb_mon "Maximum threshold for modeled lambda" VALUE 0xa080ccd0 _REC_VAL_20_s2 63.9990234375 _CNV_A_R_LINEAR_____129_CM -32. 31.9990234375 DISPLAY_IDENTIFIER C_THD_MAX_LAMB_MON FORMAT "%8.4" /end CHARACTERISTIC
/begin MEASUREMENT mff_tq_mon "torque relevant mass fuel flow" UWORD _CNV_A_R_LINEAR_____111_CM 1 100. 0. 1389. DISPLAY_IDENTIFIER MFF_TQ_MON ECU_ADDRESS 0xd00065b6 FORMAT "%7.2" /end MEASUREMENT
/begin MEASUREMENT mff_lamb_mon "lambda relevant mass fuel flow" UWORD _CNV_A_R_LINEAR_____111_CM 1 100. 0. 1389. DISPLAY_IDENTIFIER MFF_LAMB_MON ECU_ADDRESS 0xd00065b2 FORMAT "%7.2" /end MEASUREMENT
/begin MEASUREMENT mff_lamb_ref_mon "lambda relevant mass fuel flow for stoichometric conditions" UWORD _CNV_A_R_LINEAR_____111_CM 1 100. 0. 1389. DISPLAY_IDENTIFIER MFF_LAMB_REF_MON ECU_ADDRESS 0xd00065b4 FORMAT "%7.2" /end MEASUREMENT
/begin MEASUREMENT mff_iv_1_mon "mass fuel flow, first pulse" UWORD _CNV_A_R_LINEAR_____111_CM 1 100. 0. 1389. DISPLAY_IDENTIFIER MFF_IV_1_MON ECU_ADDRESS 0xd0001d6c FORMAT "%7.2" /end MEASUREMENT
/begin MEASUREMENT mff_iv_2_mon "mass fuel flow, second pulse" UWORD _CNV_A_R_LINEAR_____111_CM 1 100. 0. 1389. DISPLAY_IDENTIFIER MFF_IV_2_MON ECU_ADDRESS 0xd0001d6e FORMAT "%7.2" /end MEASUREMENT
/begin MEASUREMENT mff_iv_post_mon "mass fuel flow, post pulse" UWORD _CNV_A_R_LINEAR_____111_CM 1 100. 0. 1389. DISPLAY_IDENTIFIER MFF_IV_POST_MON ECU_ADDRESS 0xd0001d70 FORMAT "%7.2" /end MEASUREMENT
/begin MEASUREMENT egy_level_iv_2_mon "energy at injector for second pulse" UWORD _CNV_A_R_INJR_LINEA_432_CM 1 100. 0. 255. DISPLAY_IDENTIFIER EGY_LEVEL_IV_2_MON ECU_ADDRESS 0xd0001d3a FORMAT "%7.3" /end MEASUREMENT
/begin MEASUREMENT egy_level_iv_post_mon "energy at injector for post pulse" UWORD _CNV_A_R_INJR_LINEA_432_CM 1 100. 0. 255. DISPLAY_IDENTIFIER EGY_LEVEL_IV_POST_MON ECU_ADDRESS 0xd0001d3e FORMAT "%7.3" /end MEASUREMENT
/begin MEASUREMENT egy_level_iv_1_mon "energy at injector for first pulse" UWORD _CNV_A_R_INJR_LINEA_432_CM 1 100. 0. 255. DISPLAY_IDENTIFIER EGY_LEVEL_IV_1_MON ECU_ADDRESS 0xd0001d38 FORMAT "%7.3" /end MEASUREMENT
/begin MEASUREMENT egy_level_iv_bal_mv_mon "mean value of energy corrections due to cyl. balancing" SWORD _CNV_A_R_LINEAR_____113_CM 1 100. -50. 49.9984741210938 DISPLAY_IDENTIFIER EGY_LEVEL_IV_BAL_MV_MON ECU_ADDRESS 0xd0001d3c FORMAT "%7.3" /end MEASUREMENT
/begin MEASUREMENT ti_add_mv_mon "mean value of additive corrections" SWORD _CNV_A_R_LINEAR_____410_CM 1 100. -32768. 32767. DISPLAY_IDENTIFIER TI_ADD_MV_MON ECU_ADDRESS 0xd0001d7e FORMAT "%6.0" /end MEASUREMENT
/begin MEASUREMENT ti_iv_1_cor_mon "standardized injection time for first pulse" UWORD _CNV_A_R_LINEAR_____228_CM 1 100. 0. 65.535 DISPLAY_IDENTIFIER TI_IV_1_COR_MON ECU_ADDRESS 0xd0001d80 /end MEASUREMENT
/begin MEASUREMENT ti_iv_2_cor_mon "standardized injection time for second pulse" UWORD _CNV_A_R_LINEAR_____228_CM 1 100. 0. 65.535 DISPLAY_IDENTIFIER TI_IV_2_COR_MON ECU_ADDRESS 0xd0001d82 /end MEASUREMENT
/begin MEASUREMENT ti_iv_post_cor_mon "standardized injection time for post pulse" UWORD _CNV_A_R_LINEAR_____228_CM 1 100. 0. 65.535 DISPLAY_IDENTIFIER TI_IV_POST_COR_MON ECU_ADDRESS 0xd0001d84 /end MEASUREMENT
/begin MEASUREMENT fac_ti_mv_mon "mean value of multiplicative corrections" UWORD _CNV_A_R_LINEAR_____9_CM 1 100. 0. 1.99996948242188 DISPLAY_IDENTIFIER FAC_TI_MV_MON ECU_ADDRESS 0xd0001d46 FORMAT "%7.5" /end MEASUREMENT
/begin CHARACTERISTIC c_thd_high_egy_level_mon "treshold for determination of high energy level" VALUE 0xa080ccce _REC_VAL_20_u2 255. _CNV_A_R_INJR_LINEA_432_CM 0. 255. DISPLAY_IDENTIFIER C_THD_HIGH_EGY_LEVEL_MON FORMAT "%7.3" /end CHARACTERISTIC
/begin CHARACTERISTIC c_thd_min_egy_level_mon "treshold for determination of low energy level" VALUE 0xa080ccd8 _REC_VAL_20_u2 255. _CNV_A_R_INJR_LINEA_432_CM 0. 255. DISPLAY_IDENTIFIER C_THD_MIN_EGY_LEVEL_MON FORMAT "%7.3" /end CHARACTERISTIC
/begin CHARACTERISTIC c_thd_mff_ad_fac_max_mon "treshold for offset from lambda adaptation" VALUE 0xa080ccd4 _REC_VAL_20_s2 99.99847412109381 _CNV_A_R_LINEAR_____848_CM -50. 49.9984741210938 DISPLAY_IDENTIFIER C_THD_MFF_AD_FAC_MAX_MON FORMAT "%8.3" /end CHARACTERISTIC
/begin CHARACTERISTIC c_thd_mff_ad_add_max_mon "treshold for offset from lamba adaptation" VALUE 0xa080ccd2 _REC_VAL_20_s2 1389. _CNV_A_R_LINEAR_____128_CM -694.510597390707 694.4894026092931 DISPLAY_IDENTIFIER C_THD_MFF_AD_ADD_MAX_MON FORMAT "%7.2" /end CHARACTERISTIC
/begin AXIS_PTS ldp_egy_level_ip_egy_cor_mon "" 0xa080c6d0 egy_level_iv_bal_mv_mon _REC_AXS_20_u2 99.99847412 _CNV_A_R_LINEAR_____178_CM 8 -50. 49.99847412 FORMAT "%7.3" /end AXIS_PTS
/begin CHARACTERISTIC ip_fac_ti_prs_mon "injection inlet ratio through valve due to pressure drop" CURVE 0xa080ca40 _REC_CUR_20_u2_u2 15.999755859375 _CNV_A_R_LINEAR_____119_CM 0. 15.999755859375 DISPLAY_IDENTIFIER IP_FAC_TI_PRS_MON FORMAT "%7.4"
 /begin AXIS_DESCR COM_AXIS online_dummy _CNV_A_R_LINEAR_____171_CM 12 0. 347776. FORMAT "%6.0" AXIS_PTS_REF ldp_prs_dec_inj_mon /end AXIS_DESCR
/end CHARACTERISTIC
/begin CHARACTERISTIC ip_mff_ti_stnd_egy_h_mon "inverse standad injector characteristic at high energy level" CURVE 0xa080cb28 _REC_CUR_20_u2_u2 1389. _CNV_A_R_LINEAR_____111_CM 0. 1389. DISPLAY_IDENTIFIER IP_MFF_TI_STND_EGY_H_MON FORMAT "%7.2"
 /begin AXIS_DESCR COM_AXIS online_dummy _CNV_A_R_LINEAR_____228_CM 16 0. 65.535 AXIS_PTS_REF ldp_ti_ip_mff_stnd_egy_h_mon /end AXIS_DESCR
/end CHARACTERISTIC
/begin CHARACTERISTIC ip_mff_ti_stnd_egy_l_mon "inverse standad injector characteristic at low energy level" CURVE 0xa080cb48 _REC_CUR_20_u2_u2 1389. _CNV_A_R_LINEAR_____111_CM 0. 1389. DISPLAY_IDENTIFIER IP_MFF_TI_STND_EGY_L_MON FORMAT "%7.2"
 /begin AXIS_DESCR COM_AXIS online_dummy _CNV_A_R_LINEAR_____228_CM 16 0. 65.535 AXIS_PTS_REF ldp_ti_ip_mff_stnd_egy_l_mon /end AXIS_DESCR
/end CHARACTERISTIC
/begin AXIS_PTS ldp_ti_ip_mff_stnd_egy_l_mon "" 0xa080c85c online_dummy _REC_AXS_20_u2 65.535 _CNV_A_R_LINEAR_____228_CM 16 0. 65.535 /end AXIS_PTS
/begin CHARACTERISTIC ip_egy_iv_cor_mon "additive energy correction from PWM  percentage" CURVE 0xa080c9a0 _REC_CUR_20_u1_u2 255. _CNV_A_R_ECM2_LINEA_849_CM -128. 127. DISPLAY_IDENTIFIER IP_EGY_IV_COR_MON FORMAT "%7.3"
 /begin AXIS_DESCR COM_AXIS egy_level_iv_bal_mv_mon _CNV_A_R_LINEAR_____178_CM 8 -50. 49.99847412 FORMAT "%7.3" AXIS_PTS_REF ldp_egy_level_ip_egy_cor_mon /end AXIS_DESCR
/end CHARACTERISTIC
/begin AXIS_PTS ldp_ti_ip_mff_stnd_egy_h_mon "" 0xa080c838 online_dummy _REC_AXS_20_u2 65.535 _CNV_A_R_LINEAR_____228_CM 16 0. 65.535 /end AXIS_PTS
/begin AXIS_PTS ldp_crk_dif_iga_soi_post_mon "" 0xa080c67c online_dummy _REC_AXS_20_u2 2880. _CNV_A_R_ECM2_LINEA_850_CM 6 -1440. 1440. FORMAT "%7.1" /end AXIS_PTS
/begin CHARACTERISTIC ip_fac_cor_mff_post_mon "Factor for correction of valve temperature influence on injection" MAP 0xa080c9e8 _REC_MAP_20_u1_u2_u2 1.9921875 _CNV_A_R_LINEAR_____103_CM 0. 1.9921875 DISPLAY_IDENTIFIER IP_FAC_COR_MFF_POST_MON FORMAT "%8.6"
 /begin AXIS_DESCR COM_AXIS online_dummy _CNV_A_R_LINEAR_____200_CM 6 0. 720. FORMAT "%7.3" AXIS_PTS_REF ldp_crk_soi_post_mon /end AXIS_DESCR
 /begin AXIS_DESCR COM_AXIS online_dummy _CNV_A_R_ECM2_LINEA_850_CM 6 -1440. 1440. FORMAT "%7.1" AXIS_PTS_REF ldp_crk_dif_iga_soi_post_mon /end AXIS_DESCR
/end CHARACTERISTIC
/begin CHARACTERISTIC ip_prs_inc_cmp_mon "influence of the varying pressure increase inside the cylinder" MAP 0xa080ce24 _REC_MAP_20_u2_u2_u2 31.99951171875 _CNV_A_R_LINEAR_____241_CM 0. 31.99951171875 DISPLAY_IDENTIFIER IP_PRS_INC_CMP_MON FORMAT "%9.6"
 /begin AXIS_DESCR COM_AXIS online_dummy _CNV_A_R_LINEAR_____200_CM 12 0. 720. FORMAT "%7.3" AXIS_PTS_REF ldp_eoi_ip_prs_inc_cmp_mon /end AXIS_DESCR
 /begin AXIS_DESCR COM_AXIS online_dummy _CNV_A_R_LINEAR_____200_CM 16 0. 720. FORMAT "%7.3" AXIS_PTS_REF ldp_crk_inj_ip_prs_inc_cmp_mon /end AXIS_DESCR
/end CHARACTERISTIC
/begin AXIS_PTS ldp_crk_soi_post_mon "" 0xa080c6b0 online_dummy _REC_AXS_20_u2 720. _CNV_A_R_LINEAR_____200_CM 6 0. 720. FORMAT "%7.3" /end AXIS_PTS
/begin AXIS_PTS ldp_crk_inj_ip_prs_inc_cmp_mon "" 0xa080c68c online_dummy _REC_AXS_20_u2 720. _CNV_A_R_LINEAR_____200_CM 16 0. 720. FORMAT "%7.3" /end AXIS_PTS
/begin AXIS_PTS ldp_eoi_ip_prs_inc_cmp_mon "" 0xa080c6e4 online_dummy _REC_AXS_20_u2 720. _CNV_A_R_LINEAR_____200_CM 12 0. 720. FORMAT "%7.3" /end AXIS_PTS
/begin AXIS_PTS ldp_prs_dec_inj_mon "" 0xa080c7fc online_dummy _REC_AXS_20_u2 347776. _CNV_A_R_LINEAR_____171_CM 12 0. 347776. FORMAT "%6.0" /end AXIS_PTS
/begin MEASUREMENT prs_dif_iv_1_mon "pressure difference at injector for first pulse" UWORD _CNV_A_R_LINEAR_____171_CM 1 100. 0. 347776. DISPLAY_IDENTIFIER PRS_DIF_IV_1_MON ECU_ADDRESS 0xd0001d78 FORMAT "%6.0" /end MEASUREMENT
/begin MEASUREMENT prs_dif_iv_2_mon "pressure difference at injector for second pulse" UWORD _CNV_A_R_LINEAR_____171_CM 1 100. 0. 347776. DISPLAY_IDENTIFIER PRS_DIF_IV_2_MON ECU_ADDRESS 0xd0001d7a FORMAT "%6.0" /end MEASUREMENT
/begin MEASUREMENT prs_dif_iv_post_mon "pressure difference at injector for post pulse" UWORD _CNV_A_R_LINEAR_____171_CM 1 100. 0. 347776. DISPLAY_IDENTIFIER PRS_DIF_IV_POST_MON ECU_ADDRESS 0xd0001d7c FORMAT "%6.0" /end MEASUREMENT
/begin COMPU_METHOD _CNV_A_R_LINEAR_____0_CM "" RAT_FUNC "%6.3" "-" COEFFS 0 1. 0. 0 0 1 /end COMPU_METHOD
/begin COMPU_METHOD _CNV_S_2_RANGE__0___1_CM "" TAB_VERB "%6.3" "-" COMPU_TAB_REF _CNV_S_2_RANGE__0___1 /end COMPU_METHOD
/begin COMPU_VTAB _CNV_S_2_RANGE__0___1 "" TAB_VERB 2 0 "0" 1 "1" /end COMPU_VTAB
/begin COMPU_METHOD _CNV_A_R_LINEAR_____2_CM "" RAT_FUNC "%6.3" "V" COEFFS 0 204.8 0. 0 0 1 /end COMPU_METHOD
/begin COMPU_METHOD _CNV_A_R_LINEAR_____5_CM "" RAT_FUNC "%6.3" "%" COEFFS 0 2.56 0. 0 0 1 /end COMPU_METHOD
/begin COMPU_METHOD _CNV_A_R_LINEAR_____6_CM "" RAT_FUNC "%6.3" "km/h" COEFFS 0 1. 0. 0 0 1 /end COMPU_METHOD
/begin COMPU_METHOD _CNV_A_R_LINEAR_____9_CM "" RAT_FUNC "%6.3" "-" COEFFS 0 32767.99999999992 0. 0 0 1 /end COMPU_METHOD
/begin COMPU_METHOD _CNV_A_R_LINEAR_____10_CM "" RAT_FUNC "%6.3" "rpm" COEFFS 0 3.125e-002 0. 0 0 1 /end COMPU_METHOD
/begin COMPU_METHOD _CNV_A_R_LINEAR_____14_CM "" RAT_FUNC "%6.3" "rpm" COEFFS 0 1. 0. 0 0 1 /end COMPU_METHOD
/begin COMPU_METHOD _CNV_A_R_LINEAR_____15_CM "" RAT_FUNC "%6.3" "mg/stk" COEFFS 0 0.183585313174946 0. 0 0 1 /end COMPU_METHOD
/begin COMPU_METHOD _CNV_A_R_LINEAR_____17_CM "" RAT_FUNC "%6.3" "°C" COEFFS 0 1.333333333333333 64. 0 0 1 /end COMPU_METHOD
/begin COMPU_METHOD _CNV_A_R_LINEAR_____28_CM "" RAT_FUNC "%6.3" "-" COEFFS 0 256. 0. 0 0 1 /end COMPU_METHOD
/begin COMPU_METHOD _CNV_A_R_LINEAR_____31_CM "" RAT_FUNC "%6.3" "Nm" COEFFS 0 32. 0. 0 0 1 /end COMPU_METHOD
/begin COMPU_METHOD _CNV_A_R_LINEAR_____37_CM "" RAT_FUNC "%6.3" "V" COEFFS 0 9.807692307692308 0. 0 0 1 /end COMPU_METHOD
/begin COMPU_METHOD _CNV_A_R_LINEAR_____64_CM "" RAT_FUNC "%6.3" "Nm" COEFFS 0 1. 0. 0 0 1 /end COMPU_METHOD
/begin COMPU_METHOD _CNV_A_R_LINEAR_____86_CM "" RAT_FUNC "%6.3" "km/h" COEFFS 0 128.0000018750286 0. 0 0 1 /end COMPU_METHOD
/begin COMPU_METHOD _CNV_A_R_LINEAR_____87_CM "" RAT_FUNC "%6.3" "Nm" COEFFS 0 32. 32768. 0 0 1 /end COMPU_METHOD
/begin COMPU_METHOD _CNV_A_R_LINEAR_____89_CM "" RAT_FUNC "%6.3" "-" COEFFS 0 65535.99999999996 0. 0 0 1 /end COMPU_METHOD
/begin COMPU_METHOD _CNV_A_R_LINEAR_____100_CM "" RAT_FUNC "%6.3" "-" COEFFS 0 127.9991955827809 0. 0 0 1 /end COMPU_METHOD
/begin COMPU_METHOD _CNV_A_R_LINEAR_____103_CM "" RAT_FUNC "%6.3" "-" COEFFS 0 128. 0. 0 0 1 /end COMPU_METHOD
/begin COMPU_METHOD _CNV_A_R_LINEAR_____111_CM "" RAT_FUNC "%6.3" "mg/stk" COEFFS 0 47.18142548596112 0. 0 0 1 /end COMPU_METHOD
/begin COMPU_METHOD _CNV_A_R_LINEAR_____113_CM "" RAT_FUNC "%6.3" "%" COEFFS 0 655.3599999999997 -1.455191522836685e-011 0 0 1 /end COMPU_METHOD
/begin COMPU_METHOD _CNV_A_R_LINEAR_____115_CM "" RAT_FUNC "%6.3" "-" COEFFS 0 8192. 0. 0 0 1 /end COMPU_METHOD
/begin COMPU_METHOD _CNV_A_R_LINEAR_____116_CM "" RAT_FUNC "%6.3" "-" COEFFS 0 1023.999999959999 0. 0 0 1 /end COMPU_METHOD
/begin COMPU_METHOD _CNV_A_R_LINEAR_____119_CM "" RAT_FUNC "%6.3" "-" COEFFS 0 4096. 0. 0 0 1 /end COMPU_METHOD
/begin COMPU_METHOD _CNV_A_R_LINEAR_____128_CM "" RAT_FUNC "%6.3" "mg/stk" COEFFS 0 47.18142548596112 -1.455191522836685e-011 0 0 1 /end COMPU_METHOD
/begin COMPU_METHOD _CNV_A_R_LINEAR_____129_CM "" RAT_FUNC "%6.3" "-" COEFFS 0 1024. 0. 0 0 1 /end COMPU_METHOD
/begin COMPU_METHOD _CNV_A_R_LINEAR_____132_CM "" RAT_FUNC "%6.3" "°CRK" COEFFS 0 16. 1440. 0 0 1 /end COMPU_METHOD
/begin COMPU_METHOD _CNV_A_R_LINEAR_____171_CM "" RAT_FUNC "%6.3" "hPa" COEFFS 0 0.1884402603974972 0. 0 0 1 /end COMPU_METHOD
/begin COMPU_METHOD _CNV_A_R_LINEAR_____178_CM "" RAT_FUNC "%6.3" "%" COEFFS 0 655.3600000071681 32768.00000035841 0 0 1 /end COMPU_METHOD
/begin COMPU_METHOD _CNV_A_R_LINEAR_____185_CM "" RAT_FUNC "%6.3" "" COEFFS 0 256. 0. 0 0 1 /end COMPU_METHOD
/begin COMPU_METHOD _CNV_A_R_LINEAR_____188_CM "" RAT_FUNC "%6.3" "°CRK" COEFFS 0 16. 0. 0 0 1 /end COMPU_METHOD
/begin COMPU_METHOD _CNV_A_R_LINEAR_____189_CM "" RAT_FUNC "%6.3" "°CRK" COEFFS 0 -16. 0. 0 0 1 /end COMPU_METHOD
/begin COMPU_METHOD _CNV_A_R_LINEAR_____200_CM "" RAT_FUNC "%6.3" "°CRK" COEFFS 0 2.666666666666667 0. 0 0 1 /end COMPU_METHOD
/begin COMPU_METHOD _CNV_A_R_LINEAR_____228_CM "" RAT_FUNC "%6.3" "ms" COEFFS 0 1000. 0. 0 0 1 /end COMPU_METHOD
/begin COMPU_METHOD _CNV_A_R_LINEAR_____240_CM "" RAT_FUNC "%6.3" "rpm" COEFFS 0 3.125e-002 128. 0 0 1 /end COMPU_METHOD
/begin COMPU_METHOD _CNV_A_R_LINEAR_____241_CM "" RAT_FUNC "%6.3" "-" COEFFS 0 2048. 0. 0 0 1 /end COMPU_METHOD
/begin COMPU_METHOD _CNV_A_R_LINEAR_____261_CM "" RAT_FUNC "%6.3" "s" COEFFS 0 25. 0. 0 0 1 /end COMPU_METHOD
/begin COMPU_METHOD _CNV_A_R_LINEAR_____262_CM "" RAT_FUNC "%6.3" "Nm" COEFFS 0 0.5 0. 0 0 1 /end COMPU_METHOD
/begin COMPU_METHOD _CNV_A_R_LINEAR_____263_CM "" RAT_FUNC "%6.3" "%" COEFFS 0 327.680000003584 32768.00000035841 0 0 1 /end COMPU_METHOD
/begin COMPU_METHOD _CNV_A_R_LINEAR_____272_CM "Battery voltage" RAT_FUNC "%6.3" "V" COEFFS 0 9.846153846153847 0. 0 0 1 /end COMPU_METHOD
/begin COMPU_METHOD _CNV_A_R_EVAC_LINEA_298_CM "" RAT_FUNC "%6.3" "-" COEFFS 0 16. 0. 0 0 1 /end COMPU_METHOD
/begin COMPU_METHOD _CNV_A_R_EGCP_LINEA_334_CM "" RAT_FUNC "%6.3" "-" COEFFS 0 4. 0. 0 0 1 /end COMPU_METHOD
/begin COMPU_METHOD _CNV_A_R_EGCP_LINEA_354_CM "" RAT_FUNC "%6.3" "-" COEFFS 0 100. 0. 0 0 1 /end COMPU_METHOD
/begin COMPU_METHOD _CNV_A_R_LINEAR_____410_CM "" RAT_FUNC "%6.3" "µs" COEFFS 0 1. 0. 0 0 1 /end COMPU_METHOD
/begin COMPU_METHOD _CNV_A_R_INJR_LINEA_432_CM "" RAT_FUNC "%6.3" "mJ" COEFFS 0 257. 0. 0 0 1 /end COMPU_METHOD
/begin COMPU_METHOD _CNV_A_R_LINEAR_____446_CM "" RAT_FUNC "%6.3" "A" COEFFS 0 1. 0. 0 0 1 /end COMPU_METHOD
/begin COMPU_METHOD _CNV_A_R_LINEAR_____535_CM "" RAT_FUNC "%6.3" "%/s" COEFFS 0 0.1024000154202376 128.000019275297 0 0 1 /end COMPU_METHOD
/begin COMPU_METHOD _CNV_S_3_ECM2_RANGE_831_CM "" TAB_VERB "%6.3" "-" COMPU_TAB_REF _CNV_S_3_ECM2_RANGE_831 /end COMPU_METHOD
/begin COMPU_VTAB _CNV_S_3_ECM2_RANGE_831 "" TAB_VERB 3 0 "PU" 1 "NON_PU" 2 "PASSIVE" /end COMPU_VTAB
/begin COMPU_METHOD _CNV_S_5_ECM2_RANGE_832_CM "" TAB_VERB "%6.3" "-" COMPU_TAB_REF _CNV_S_5_ECM2_RANGE_832 /end COMPU_METHOD
/begin COMPU_VTAB _CNV_S_5_ECM2_RANGE_832 "" TAB_VERB 5 0 "-" 1 "S" 2 "AFS" 3 "AFL" 8 "LIH" /end COMPU_VTAB
/begin COMPU_METHOD _CNV_S_4_ECM2_RANGE_833_CM "" TAB_VERB "%6.3" "-" COMPU_TAB_REF _CNV_S_4_ECM2_RANGE_833 /end COMPU_METHOD
/begin COMPU_VTAB _CNV_S_4_ECM2_RANGE_833 "" TAB_VERB 4 0 "NOT_ACTIVE" 1 "IDLE" 2 "TRAILING_THR" 3 "PART_LOAD" /end COMPU_VTAB
/begin COMPU_METHOD _CNV_A_R_LINEAR_____834_CM "" RAT_FUNC "%6.3" "" COEFFS 0 32. 0. 0 0 1 /end COMPU_METHOD
/begin COMPU_METHOD _CNV_A_R_ECM2_LINEA_835_CM "" RAT_FUNC "%6.3" "Nm/rpm²" COEFFS 0 134293032.7868853 0. 0 0 1 /end COMPU_METHOD
/begin COMPU_METHOD _CNV_A_R_ECM2_LINEA_836_CM "" RAT_FUNC "%6.3" "-" COEFFS 0 8000. 0. 0 0 1 /end COMPU_METHOD
/begin COMPU_METHOD _CNV_A_R_LINEAR_____837_CM "" RAT_FUNC "%6.3" "-" COEFFS 0 7.971241012816505 0. 0 0 1 /end COMPU_METHOD
/begin COMPU_METHOD _CNV_A_R_LINEAR_____838_CM "" RAT_FUNC "%6.3" "rpm/(km/h)" COEFFS 0 1. 0. 0 0 1 /end COMPU_METHOD
/begin COMPU_METHOD _CNV_A_R_ECM2_LINEA_839_CM "" RAT_FUNC "%6.3" "V" COEFFS 0 6553.599999999993 0. 0 0 1 /end COMPU_METHOD
/begin COMPU_METHOD _CNV_A_R_ECM2_LINEA_840_CM "" RAT_FUNC "%6.3" "km/h" COEFFS 0 0.5 0. 0 0 1 /end COMPU_METHOD
/begin COMPU_METHOD _CNV_S_5_ECM2_RANGE_841_CM "" TAB_VERB "%6.3" "-" COMPU_TAB_REF _CNV_S_5_ECM2_RANGE_841 /end COMPU_METHOD
/begin COMPU_VTAB _CNV_S_5_ECM2_RANGE_841 "" TAB_VERB 5 0 "NO_ERROR" 1 "ERROR_PATH_1" 2 "ERROR_PATH_2" 3 "ERROR_PATH_3" 4 "ERROR_PATH_4" /end COMPU_VTAB
/begin COMPU_METHOD _CNV_A_R_ECM2_LINEA_842_CM "" RAT_FUNC "%6.3" "Nm" COEFFS 0 128. 0. 0 0 1 /end COMPU_METHOD
/begin COMPU_METHOD _CNV_A_R_ECM2_LINEA_843_CM "" RAT_FUNC "%6.3" "-" COEFFS 0 257. 0. 0 0 1 /end COMPU_METHOD
/begin COMPU_METHOD _CNV_A_R_ECM2_LINEA_845_CM "" RAT_FUNC "%6.3" "%" COEFFS 0 100. 32768. 0 0 1 /end COMPU_METHOD
/begin COMPU_METHOD _CNV_S_3_ECM2_RANGE_846_CM "" TAB_VERB "%6.3" "-" COMPU_TAB_REF _CNV_S_3_ECM2_RANGE_846 /end COMPU_METHOD
/begin COMPU_VTAB _CNV_S_3_ECM2_RANGE_846 "" TAB_VERB 3 0 "NO_ERROR" 1 "ERROR_PATH_1" 2 "ERROR_PATH_2" /end COMPU_VTAB
/begin COMPU_METHOD _CNV_A_R_ECM2_LINEA_847_CM "" RAT_FUNC "%6.3" "-" COEFFS 0 4096. 32768. 0 0 1 /end COMPU_METHOD
/begin COMPU_METHOD _CNV_A_R_LINEAR_____848_CM "" RAT_FUNC "%6.3" "-" COEFFS 0 655.3599999999997 -1.455191522836685e-011 0 0 1 /end COMPU_METHOD
/begin COMPU_METHOD _CNV_A_R_ECM2_LINEA_849_CM "" RAT_FUNC "%6.3" "mJ" COEFFS 0 1. 128. 0 0 1 /end COMPU_METHOD
/begin COMPU_METHOD _CNV_A_R_ECM2_LINEA_850_CM "" RAT_FUNC "%6.3" "°CRK" COEFFS 0 2.666666666666667 3840. 0 0 1 /end COMPU_METHOD
/begin RECORD_LAYOUT _REC_VAL_20_u1 FNC_VALUES 1 UBYTE COLUMN_DIR DIRECT /end RECORD_LAYOUT
/begin RECORD_LAYOUT _REC_VAL_20_u2 FNC_VALUES 1 UWORD COLUMN_DIR DIRECT /end RECORD_LAYOUT
/begin RECORD_LAYOUT _REC_AXS_20_u1 NO_AXIS_PTS_X 1 UBYTE AXIS_PTS_X 2 UBYTE INDEX_INCR DIRECT /end RECORD_LAYOUT
/begin RECORD_LAYOUT _REC_MAP_20_u2_u1_u1 FNC_VALUES 1 UWORD COLUMN_DIR DIRECT /end RECORD_LAYOUT
/begin RECORD_LAYOUT _REC_CUR_20_u1_u1 FNC_VALUES 1 UBYTE COLUMN_DIR DIRECT /end RECORD_LAYOUT
/begin RECORD_LAYOUT _REC_VAL_20_s2 FNC_VALUES 1 SWORD COLUMN_DIR DIRECT /end RECORD_LAYOUT
/begin RECORD_LAYOUT _REC_AXS_20_u2 NO_AXIS_PTS_X 1 UWORD AXIS_PTS_X 2 UWORD INDEX_INCR DIRECT /end RECORD_LAYOUT
/begin RECORD_LAYOUT _REC_CUR_20_u2_u1 FNC_VALUES 1 UWORD COLUMN_DIR DIRECT /end RECORD_LAYOUT
/begin RECORD_LAYOUT _REC_CUR_20_u2_u2 FNC_VALUES 1 UWORD COLUMN_DIR DIRECT /end RECORD_LAYOUT
/begin RECORD_LAYOUT _REC_VAL_20_s1 FNC_VALUES 1 SBYTE COLUMN_DIR DIRECT /end RECORD_LAYOUT
/begin RECORD_LAYOUT _REC_CUR_20_u1_u2 FNC_VALUES 1 UBYTE COLUMN_DIR DIRECT /end RECORD_LAYOUT
/begin RECORD_LAYOUT _REC_MAP_20_u2_u2_u2 FNC_VALUES 1 UWORD COLUMN_DIR DIRECT /end RECORD_LAYOUT
/begin RECORD_LAYOUT _REC_MAP_20_u2_u1_u2 FNC_VALUES 1 UWORD COLUMN_DIR DIRECT /end RECORD_LAYOUT
/begin RECORD_LAYOUT _REC_MAP_20_u1_u2_u2 FNC_VALUES 1 UBYTE COLUMN_DIR DIRECT /end RECORD_LAYOUT
/begin RECORD_LAYOUT _REC_MAP_20_u1_u1_u1 FNC_VALUES 1 UBYTE COLUMN_DIR DIRECT /end RECORD_LAYOUT
/begin RECORD_LAYOUT _REC_CUR_20_s2_u1 FNC_VALUES 1 SWORD COLUMN_DIR DIRECT /end RECORD_LAYOUT
/begin RECORD_LAYOUT _REC_MAP_20_u1_u2_u1 FNC_VALUES 1 UBYTE COLUMN_DIR DIRECT /end RECORD_LAYOUT
/begin RECORD_LAYOUT _REC_MAP_20_u1_u1_u2 FNC_VALUES 1 UBYTE COLUMN_DIR DIRECT /end RECORD_LAYOUT
/begin FUNCTION ECM2_Monitoring_CAN_signals "Monitoring_CAN_signals"
 /begin DEF_CHARACTERISTIC c_abc_max_sof_mon c_abc_inc_sof_mon c_can_vb_min_diag_mon c_t_msr_inh_mon c_abc_inc_dcc_rev_mon c_abc_inc_dcc_irrev_mon c_abc_inc_ldm_inh_mon c_abc_inc_ldm_mon c_abc_inc_gs_inh_mon c_abc_max_gs_inh_mon c_abc_max_amt_inh_mon c_abc_max_ldm_mon c_abc_max_ldm_inh_mon c_abc_max_dcc_rev_mon c_abc_max_dcc_irrev_mon c_abc_max_dcc_inh_mon c_abc_max_msr_inh_mon c_abc_inc_msr_inh_mon c_abc_inc_dcc_inh_mon c_t_gs_inh_mon c_t_dcc_inh_mon c_t_max_brake_det_dcc_mon c_t_ldm_inh_mon c_t_max_brake_det_ldm_mon c_t_amt_inh_mon c_t_dly_amt_inh_mon c_t_max_state_amt_1_diag_mon c_t_max_state_amt_2_diag_mon c_t_max_state_amt_3_diag_mon c_t_max_tqi_amt_diag_mon c_t_max_state_clu_amt_diag_mon c_t_dly_gs_inh_mon c_tqi_stnd_mon c_tqi_amt_diag_mon c_tqi_amt_cond_diag_mon c_tqi_amt_can_es_mon c_abc_inc_amt_inh_mon c_vs_fil_amt_mon /end DEF_CHARACTERISTIC
 /begin OUT_MEASUREMENT lv_can_inh_msr_mon lv_can_inh_gs_mon t_gs_inh_mon tqi_gs_mon abc_msr_inh_mon abc_ldm_inh_mon abc_dcc_inh_mon abc_gs_inh_mon t_ldm_inh_mon t_ldm_brake_det_mon t_dcc_inh_mon t_dcc_brake_det_mon t_state_amt_2_diag_mon t_state_amt_3_diag_mon t_state_clu_amt_diag_mon tqi_amt_plaus_mon tqi_msr_mon tqi_amt_mon t_msr_inh_mon t_amt_inh_mon lv_err_msr_inh_mon lv_err_ldm_inh_mon lv_err_ldm_mon lv_ldm_off_ecu_mon lv_ldm_off_ecu_1_mon lv_ldm_off_ecu_2_mon lv_err_dcc_inh_mon lv_err_dcc_rev_mon lv_err_dcc_irrev_mon lv_dcc_off_ecu_mon lv_err_amt_inh_mon lv_err_gs_inh_mon tq_msr_mon tq_dcc_mon tq_amt_mon tq_gs_mon tq_wheel_ldm_mon t_state_amt_1_diag_mon t_tqi_amt_diag_mon abc_amt_inh_mon state_err_amt_mon state_amt_old_mon /end OUT_MEASUREMENT
/end FUNCTION
/begin FUNCTION ECM2_Fault_reaction_process_mon "Fault_reaction_process_mon"
 /begin OUT_MEASUREMENT lv_n_lim_req_mon lv_off_mtc_mon lv_off_iv_mon lv_off_iv_n_lim_etc_tmp_mon lv_err_tran_1_mon lv_err_tran_2_mon /end OUT_MEASUREMENT
/end FUNCTION
/begin FUNCTION ECM2_Mon_engine_speed_limitation "Mon_engine_speed_limitation"
 /begin DEF_CHARACTERISTIC c_n_max_mtc_lih_thd_mon c_abc_inc_tqi_n_max_mon c_abc_max_tqi_n_max_mon /end DEF_CHARACTERISTIC
 /begin OUT_MEASUREMENT abc_tqi_n_max_mon lv_err_tqi_n_max_mon /end OUT_MEASUREMENT
/end FUNCTION
/begin FUNCTION ECM2_Mon_cruise_ctl_conditions "Mon_cruise_ctl_conditions"
 /begin DEF_CHARACTERISTIC c_t_cru_inh_mon c_vs_min_cru_mon c_abc_inc_cru_tq_mon c_abc_max_cru_tq_mon /end DEF_CHARACTERISTIC
 /begin OUT_MEASUREMENT fac_tq_req_cru_mon t_cru_inh_mon lv_cru_inh_mon lv_err_cru_mon abc_cru_tq_mon /end OUT_MEASUREMENT
/end FUNCTION
/begin FUNCTION ECM2_Desired_indicated_eng_tq "Desired_indicated_eng_tq"
 /begin DEF_CHARACTERISTIC c_t_tqi_mon ip_fac_tq_req_driv_mon c_crlc_tqi_sp_mon ip_fac_tq_req_driv_1_mon /end DEF_CHARACTERISTIC
 /begin OUT_MEASUREMENT t_tqi_mon fac_tq_req_mon tqi_req_tot_mon tqi_sp_mon fac_tq_req_driv_mon /end OUT_MEASUREMENT
/end FUNCTION
/begin FUNCTION ECM2_Actual_indicated_eng_tq "Actual_indicated_eng_tq"
 /begin DEF_CHARACTERISTIC ldp_n_32_mon_ip_tqi_cus_mon ldp_mff_mon_ip_tqi_cus_mon ip_tqi_cus_mon /end DEF_CHARACTERISTIC
 /begin OUT_MEASUREMENT tqi_av_mon /end OUT_MEASUREMENT
/end FUNCTION
/begin FUNCTION ECM2_Mon_actual_indicated_eng_tq "Mon_actual_indicated_eng_tq"
 /begin DEF_CHARACTERISTIC c_abc_inc_tqi_av_not_afs_mon c_abc_inc_swi_afs_tqi_mon c_abc_max_tqi_av_not_afs_mon c_abc_max_swi_afs_tqi_mon c_abc_inc_tqi_av_afs_mon c_abc_max_tqi_av_afs_mon ip_tqi_dif_max_mon c_gain_tqi_dif_max_mon ldp_n_32_ip_tqi_dif_max_mon ldp_tqi_sp_ip_tqi_dif_max_mon /end DEF_CHARACTERISTIC
 /begin OUT_MEASUREMENT lv_err_tqi_av_mon lv_swi_afs_tqi_mon tqi_dif_sp_mon tqi_dif_max_mon abc_tqi_av_not_afs_mon abc_swi_afs_tqi_mon abc_tqi_av_afs_mon tqi_dif_av_mon /end OUT_MEASUREMENT
/end FUNCTION
/begin FUNCTION ECM2_Processor_monitoring_MON2 "Processor_monitoring_MON2"
 /begin DEF_CHARACTERISTIC c_t_tqi_mon2 c_gain_tqi_dif_max_mon2 c_abc_inc_tqi_av_not_afs_mon2 c_abc_inc_swi_afs_tqi_mon2 c_abc_max_tqi_av_not_afs_mon2 c_abc_max_swi_afs_tqi_mon2 c_abc_inc_tqi_av_afs_mon2 c_abc_max_tqi_av_afs_mon2 ldp_tqi_sp_mon_mon2_ip_mon2 ldp_n_32_mon2_ip_tqi_dif_mon2 c_n_max_mtc_lih_thd_mon2 c_abc_inc_tqi_n_max_mon2 c_abc_max_tqi_n_max_mon2 ip_fac_tq_req_driv_mon2 id_tq_min_clu_mon2 id_tq_max_clu_mon2 id_tq_loss_mon2 id_n_32_mon2 id_lamb_mon2 id_prev_state_iv_mon2 id_tqi_sp_mon2 id_abc_tqi_av_afs_mon2 id_abc_tqi_av_not_afs_mon2 id_abc_tqi_n_max_mon2 id_tqi_sp_mon_mon2 id_t_tqi_mon2 id_resp_mon2 id_pv_av_ad_mon2 id_tqi_inc_ext_mon2 id_tqi_min_pu_mon2 c_crlc_tqi_sp_mon2 id_iga_igc_h_rng_mon2 id_iga_ref_homs_cor_ext_mon2 id_iga_ref_hom_cor_ext_mon2 id_fac_tq_req_cru_mon2 id_eff_mff_tq_cor_mon2 id_abc_swi_afs_tqi_mon2 id_maf_mon2 id_mff_tq_mon2 id_opm_av_mon2 id_tq_dif_p_d_is_mon2 id_tq_drof_mon2 ip_eff_iga_hom_mon2 ldp_lamb_homs_mon2_ip_eff_mon2 ldp_lamb_hom_mon2_ip_eff_mon2 ldp_lamb_s_mon2_ip_eff_mon2 ldp_n_32_mon2_ip_tqi_cus_mon2 ldp_n_32_mon2_ip_fac_eff_mon2 ldp_maf_mon2_ip_fac_eff_mon2 ldp_mff_mon2_ip_iga_ref_mon2 ip_eff_iga_homs_mon2 ip_eff_lamb_homs_mon2 ip_eff_lamb_hom_mon2 ip_eff_lamb_s_mon2 ip_fac_eff_iga_mon2 ip_fac_tq_req_driv_1_mon2 ip_iga_ref_homs_mon2 ip_iga_ref_hom_mon2 ip_tqi_dif_max_mon2 ip_tqi_cus_mon2 id_lf_1_mon2 id_lf_2_mon2 id_lf_3_mon2 id_lf_4_mon2 /end DEF_CHARACTERISTIC
 /begin OUT_MEASUREMENT lamb_mon2 t_tqi_mon2 fac_tq_req_cru_mon2 prev_state_iv_mon2 lv_err_conv_mon2 lv_err_n_32_mon2 lv_err_pvs_mon2 lv_err_tps_mon2 lv_err_tq_dif_p_d_is_mon2 lv_err_tq_dif_i_is_mon2 lv_err_tq_loss_mon2 lv_err_tq_min_clu_mon2 lv_err_tq_max_clu_mon2 lv_n_lim_etc_mon2 lv_tqi_mon_act_mon2 n_32_mon2 tq_loss_mon2 tq_min_clu_mon2 tq_max_clu_mon2 tq_dif_p_d_is_mon2 tqi_sp_mon2 resp_mon2 fac_tq_req_driv_mon2 fac_tq_req_mon2 tqi_req_tot_mon2 tqi_sp_mon_mon2 tqi_av_mon2 lv_err_tqi_av_mon2 lv_swi_afs_tqi_mon2 tqi_dif_sp_mon2 tqi_dif_max_mon2 abc_tqi_av_not_afs_mon2 abc_swi_afs_tqi_mon2 abc_tqi_av_afs_mon2 tqi_dif_av_mon2 abc_tqi_n_max_mon2 lv_err_tqi_n_max_mon2 lv_n_lim_req_mon2 lv_dr_off_mu_mon2 lv_off_mtc_mon2 lv_off_iv_mon2 lv_off_iv_n_lim_etc_mon2 lv_off_iv_n_lim_etc_tmp_mon2 pv_av_ad_mon2 lv_err_mu_mc_mon2 lv_err_tmp_mu_mc_mon2 tqi_min_pu_mon2 tqi_inc_ext_mon2 eff_iga_hom_mon2 eff_iga_s_mon2 eff_iga_homs_mon2 eff_lamb_homs_mon2 eff_lamb_hom_mon2 eff_lamb_s_mon2 eff_tot_mon2 eff_mff_tq_cor_mon2 lf_4_mon2 tq_drof_mon2 iga_igc_h_rng_mon2[0] iga_igc_h_rng_mon2[1] iga_igc_h_rng_mon2[2] iga_igc_h_rng_mon2[3] iga_igc_h_rng_mon2[4] iga_igc_h_rng_mon2[5] iga_igc_h_rng_mon2[6] iga_igc_h_rng_mon2[7] mff_tq_mon2 maf_mon2 iga_ref_hom_cor_ext_mon2 iga_ref_homs_cor_ext_mon2 lv_err_mff_mon2 lv_swi_fac_tq_req_mon2 iga_dif_av_h_rng_hom_mon2 iga_dif_av_h_rng_homs_mon2 opm_av_mon2 lv_err_tran_1_mon2 lv_err_tran_2_mon2 /end OUT_MEASUREMENT
/end FUNCTION
/begin FUNCTION ECM2_Conf_process_mon_AI "Conf_process_mon_AI"
 /begin DEF_CHARACTERISTIC ip_tqi_maf_sp_cus ldp_n_32_ip_tqi_maf_sp_cus ldp_maf_ip_tqi_maf_sp_cus c_n_dif_crlc_low_mon c_n_dif_max_is_mon c_iga_ref_temp_cor_lim_mon c_iga_ref_lamb_cor_lim_mon c_v_tps_1_lih_mon c_v_tps_2_lih_mon c_n_thd_fcut_n_lim_etc_mon c_vs_dif_max_mon c_tq_loss_add_acc_min_mon c_tq_loss_alter_min_mon c_tq_loss_pste_1_min_mon c_tq_loss_sa_min_mon c_crlc_alter_mon c_fac_eff_alter_mon c_tq_loss_ars_min_mon c_fac_n_alter_mon c_v_tq_alter_mon lc_inh_pu_req_mon ip_cur_alter_mon ip_eff_alter_mon ldp_cur_alter_mon__tq_loss_mon ldp_ang_pste_stnd__tq_loss_mon ip_fac_conv_mon c_fac_ramp_p_d_mon ldp_tco_mon_ip_n_sp_is_mon ip_n_sp_is_bas_max_mon ldp_tco_mon_ip_fac_conv_mon ip_fac_tq_dif_p_d_is_mon ip_tq_dif_p_d_is_max_mon ldp_n_dif_sp_is_mon_ip_tq_mon ldp_tco_mon_ip_fac_tq_p_d_mon c_n_dif_crlc_high_mon lc_n_sp_is_clc_inh_mon c_n_sp_is_bas_dif_max_mon c_fil_tq_p_d_is_max_mon ip_fac_tq_drof_fac_tq_req_mon c_n_dif_drof_max_mon c_n_dif_drof_min_mon c_n_dif_add_drof_mon ip_tq_drof_mon ldp_vs_mon__tq_drof ldp_n_32_mon__tq_drof ip_fac_tq_drof_vs_mon c_n_32_tq_drof_max_mon c_v_sof_swi_min_mon c_v_sof_swi_max_mon c_pv_av_sof_min_mon c_fac_tq_req_driv_sof_max_mon c_pv_av_grd_sof_max_mon c_t_pv_av_grd_sof_max_mon lc_rng_l_man_as_mon ldp_n_dif_drof_mon__tq_drof ldp_dffgen_fil_mon__loss_mon ldpm_n_alter_mon__tq_loss_mon c_tq_dif_is_ad_conv_max_mon c_n_dif_fac_mon c_n_dif_hys_is_pu_mon lc_tq_drof_isc_off_mon lc_swi_opm_av_mon c_swi_opm_av_mon c_vs_lih_mon c_fac_rax_mon c_fac_gr_dif_mon c_fac_gr_min_mon c_fac_gr_max_mon c_v_sof_swi_on_tol_mon lc_var_sof_swi_mon lc_rng_l_mon lc_conf_city_ena_mon c_n_sp_is_lih_max_mon c_n_sp_dec_cs_mon c_n_sp_lgrd_is_mon c_n_sp_is_max_ext_adj_mon c_n_max_kwp_mon c_vs_max_kwp_mon c_min_vs_ratio_mon ldp_n_dif_drof_mon__id_tq_drof ldp_n_vs_ratio_mon_gr_mt_mon id_tq_drof_ena_mon id_gr_mt_mon c_fac_mff_add_cp_min_mon c_v_sof_swi_on_bol_mon c_state_etcu_prog_info_mon c_n_sp_inc_cs_mon c_n_sp_is_cs_max_mon ldp_tq_av_mon__tq_drof ldp_tq_drof_mdl_mon_1 ip_fac_n_grd_tq_av_mon ldp_fac_tq_req_mon__tq_drof ldp_n_32_mon_ip_tqi_pu_max_mon ip_tq_drof_grd_deac_mon ip_tqi_min_pu_max_mon ldp_vs_mon__tq_loss_mon c_fac_gr_mon c_vb_min_mon_diag /end DEF_CHARACTERISTIC
 /begin OUT_MEASUREMENT state_err_det_tq_min_mon opm_av_mon n_dif_sp_is_mon lv_ls_up_act_mon[0] lv_ls_up_act_mon[1] lv_lamb_ls_up_vld_mon[0] lv_lamb_ls_up_vld_mon[1] state_req_isc_mon lv_n_lim_etc_mon lv_tqi_mon_act_mon lv_brake_mon lv_err_vcc_pvs_1_mon tq_loss_ars_mon tq_loss_pste_1_mon tq_loss_pste_2_mon cur_alter_mon tq_loss_sa_mon n_alter_mon dffgen_fil_mon lv_err_vcc_pvs_2_mon lv_err_vcc_pvs_mon tq_loss_acc_mon vs_mon pv_av_ad_mon n_sp_is_ratio_mon n_sp_is_mon n_dif_mmv_mon n_dif_cor_mon fac_ramp_neg_p_d_is_mon n_dif_mon n_dif_drof_mon tq_dif_p_d_is_mon tq_dif_p_d_is_max_mon tq_dif_p_d_is_max_2_mon state_pas_ramp_act_i_is_mon lv_pas_ramp_act_p_d_chg_mon lv_pas_ramp_act_i_chg_mon lv_off_iv_n_lim_etc_mon tq_drof_mon tq_drof_mdl_mon lv_tq_drof_act_mon lv_cs_mon tq_av_mon state_pas_ramp_act_p_d_is_mon v_tps_1_mon[0] v_tps_1_mon[1] v_tps_2_mon[0] v_tps_2_mon[1] tq_loss_pste_mon tq_conv_max_mon tq_conv_max_mdl_mon lv_igk_mon lv_sf_tqd_mon gr_dt_mdl_mon tq_add_min_clu_mon lv_swi_tq_min_clu_mon lv_sof_swi_req_mon lv_sof_swi_mon lv_swi_fac_tq_req_mon lv_err_sof_inh_mon abc_sof_inh_mon lv_err_cru_inh_mon lv_msr_inh_mon lv_gs_inh_mon gr_dt_mon tqi_inc_can_mon tq_loss_alter_mon tq_loss_alter_mdl_mon n_sp_is_bas_mon n_sp_is_cs_mon n_sp_is_ext_adj_mon gr_mt_mon n_vs_ratio_mon lv_ct_mon lv_act_n_sp_is_ext_adj_mon n_sp_is_ext_req_mon tq_loss_add_mon eff_mff_tq_cor_mon lv_rng_l_mon lv_rng_l_at_mon tqi_inc_ext_mon tqi_min_pu_mon tqi_min_pu_max_mon lv_swi_afs_lamb_mon lv_swi_afs_post_inj_mon iga_ref_hom_cor_ext_mon iga_ref_homs_cor_ext_mon /end OUT_MEASUREMENT
/end FUNCTION
/begin FUNCTION ECM2_Mon_analog_dig_conversion "Mon_analog_dig_conversion"
 /begin DEF_CHARACTERISTIC c_vp_acq_conv_hys_mon c_abc_inc_conv_mon c_abc_max_conv_mon c_state_an_dig_err_act_mon /end DEF_CHARACTERISTIC
 /begin OUT_MEASUREMENT abc_conv_mon lv_err_conv_mon /end OUT_MEASUREMENT
/end FUNCTION
/begin FUNCTION ECM2_Mon_N_32_using_sw_timer "Mon_N_32_using_sw_timer"
 /begin DEF_CHARACTERISTIC c_abc_inc_n_32_mon c_abc_max_n_32_mon c_n_32_lim_mon c_n_32_min_mon c_n_32_dif_rel_max_mon /end DEF_CHARACTERISTIC
 /begin OUT_MEASUREMENT abc_n_32_mon lv_err_n_32_mon n_32_dif_rel_mon n_32_sub_mon n_32_mon t_seg_sw_mon /end OUT_MEASUREMENT
/end FUNCTION
/begin FUNCTION ECM2_Mon_tq_demand_is_controller "Mon_tq_demand_is_controller"
 /begin DEF_CHARACTERISTIC c_fac_ramp_neg_i_is_mon c_tq_dif_i_is_max_mon c_tq_dif_i_is_add_mon c_tq_pas_i_is_mon c_abc_inc_tq_dif_p_d_is_mon c_abc_max_tq_dif_p_d_is_mon c_tq_p_d_isc_not_act_max_mon c_abc_inc_tq_dif_i_is_mon c_abc_max_tq_dif_i_is_mon c_tq_i_isc_not_act_max_mon c_tq_dif_p_d_is_add_mon c_tq_dif_p_d_ramp_chk_ofs_mon /end DEF_CHARACTERISTIC
 /begin OUT_MEASUREMENT tq_dif_p_d_is_dif_mon tq_dif_p_d_is_ramp_mon state_err_tq_dif_p_d_is_mon tq_dif_i_is_ramp_mon tq_dif_i_is_dif_mon state_err_tq_dif_i_is_mon lv_err_tq_dif_p_d_is_mon tq_add_p_d_is_mon abc_tq_dif_p_d_is_mon tq_dif_i_is_mon tq_add_i_is_mon abc_tq_dif_i_is_mon lv_err_tq_dif_i_is_mon lv_ramp_p_d_beg_value_wrg_mon /end OUT_MEASUREMENT
/end FUNCTION
/begin FUNCTION ECM2_Monitoring_torque_losses "Monitoring_torque_losses"
 /begin DEF_CHARACTERISTIC ldp_maf_mon_ip_tqfr_mon ldp_n_32_mon_ip_tqfr_mon ldp_tco_mon_ip_tqfr_add_mon ip_tqfr_mon ip_tqfr_add_mon c_abc_inc_tq_loss_mon c_abc_max_tq_loss_mon c_crlc_tq_loss_req_clu_mon c_tq_loss_dif_max_mon c_tq_is_ad_min_mon /end DEF_CHARACTERISTIC
 /begin OUT_MEASUREMENT abc_tq_loss_mon lv_err_tq_loss_mon tq_loss_mon tq_loss_req_clu_mon tq_loss_mmv_mon tq_loss_dif_mon tq_loss_mdl_mon /end OUT_MEASUREMENT
/end FUNCTION
/begin FUNCTION ECM2_Monitoring_min_tq_clutch "Monitoring_min_tq_clutch"
 /begin DEF_CHARACTERISTIC ldp_n_sp_is_ratio_mon_ip_mon ip_fac_n_sp_is_ratio_mon ldp_n_32_mon_ip_tqi_min_mon ldp_tco_mon_ip_tqi_min_pu_mon ip_tqi_min_req_pu_mon c_n_st_max_mon c_abc_inc_tq_min_clu_mon c_abc_max_tq_min_clu_mon c_tq_min_clu_mdl_ofs_mon c_dly_tq_st_mon /end DEF_CHARACTERISTIC
 /begin OUT_MEASUREMENT fac_n_sp_is_ratio_mon tq_st_mon state_err_tq_min_clu_mon lv_err_tq_min_clu_mon abc_tq_min_clu_mon tq_min_clu_mdl_2_mon tq_min_clu_dif_mon tq_min_clu_mon tq_min_clu_mdl_5_mon ctr_dly_tq_st_mon /end OUT_MEASUREMENT
/end FUNCTION
/begin FUNCTION ECM2_Monitoring_max_tq_clutch "Monitoring_max_tq_clutch"
 /begin DEF_CHARACTERISTIC c_abc_max_tq_max_clu_mon c_abc_inc_tq_max_clu_mon c_ofs_tia_mon ldp_n_32_mon_ip_tqi_max_mon ldp_fac_tq_req_mon__tq_max_mon ip_tqi_ref_max_mon ip_fac_cha_max_fac_tq_req_mon ip_fac_cha_max_1_mon ip_fac_cha_max_2_mon /end DEF_CHARACTERISTIC
 /begin OUT_MEASUREMENT lv_err_tq_max_clu_mon abc_tq_max_clu_mon tq_max_clu_max_mon tq_max_clu_mon tq_max_clu_dif_mon fac_cha_max_mon fac_cus_tq_max_mon /end OUT_MEASUREMENT
/end FUNCTION
/begin FUNCTION ECM2_Err_mem_mng_process_mon "Err_mem_mng_process_mon"
 /begin OUT_MEASUREMENT lv_err_n_32_mon_1 lv_err_pvs_mon_1 lv_err_tqi_av_mon_1 lv_err_tqi_n_max_mon_1 lv_err_mff_mon_1 lv_err_tq_dif_isc_mon_1 lv_err_tq_req_mon_1 lv_err_tq_ext_mon_1 lv_err_conv_mon_1 lv_err_swi_afs_mon ctr_swi_afs_mon lv_err_cru_inh_mon_1 /end OUT_MEASUREMENT
/end FUNCTION
/begin FUNCTION ECM2_Actual_efficiencies "Actual_efficiencies"
 /begin DEF_CHARACTERISTIC ip_eff_iga_hom_mon ip_eff_lamb_hom_mon ip_eff_lamb_s_mon ip_iga_ref_hom_mon ip_eff_iga_homs_mon ldp_mff_mon_ip_iga_ref_mon ldp_lamb_homs_mon_ip_eff_mon ip_eff_lamb_homs_mon ldp_maf_mon_ip_iga_ref_mon ldp_maf_mon_ip_fac_eff_iga_mon ldp_n_32_mon_ip_fac_eff_iga_mon ip_iga_ref_homs_mon ip_fac_eff_iga_mon ldp_lamb_hom_mon_ip_eff_mon ldp_lamb_s_mon_ip_eff_mon /end DEF_CHARACTERISTIC
 /begin OUT_MEASUREMENT eff_tot_mon eff_iga_hom_mon eff_iga_s_mon eff_lamb_hom_mon eff_lamb_s_mon eff_iga_homs_mon eff_lamb_homs_mon iga_dif_av_h_rng_hom_mon iga_dif_av_h_rng_homs_mon /end OUT_MEASUREMENT
/end FUNCTION
/begin FUNCTION ECM2_Actual_lambda_deviation "Actual_lambda_deviation"
 /begin DEF_CHARACTERISTIC c_thd_mff_min_mon c_fac_mff_maf_mon c_lamb_ref_mon lc_lamb_ref_mon c_thd_max_lamb_mon /end DEF_CHARACTERISTIC
 /begin OUT_MEASUREMENT lamb_dif_mon maf_mon lamb_mon lamb_mdl_dly_mon lamb_mdl_sens_mon lamb_mdl_ref_mon /end OUT_MEASUREMENT
/end FUNCTION
/begin FUNCTION ECM2_Actual_fuel_mass_flow "Actual_fuel_mass_flow"
 /begin DEF_CHARACTERISTIC c_thd_high_egy_level_mon c_thd_min_egy_level_mon c_thd_mff_ad_fac_max_mon c_thd_mff_ad_add_max_mon ldp_egy_level_ip_egy_cor_mon ip_fac_ti_prs_mon ip_mff_ti_stnd_egy_h_mon ip_mff_ti_stnd_egy_l_mon ldp_ti_ip_mff_stnd_egy_l_mon ip_egy_iv_cor_mon ldp_ti_ip_mff_stnd_egy_h_mon ldp_crk_dif_iga_soi_post_mon ip_fac_cor_mff_post_mon ip_prs_inc_cmp_mon ldp_crk_soi_post_mon ldp_crk_inj_ip_prs_inc_cmp_mon ldp_eoi_ip_prs_inc_cmp_mon ldp_prs_dec_inj_mon /end DEF_CHARACTERISTIC
 /begin OUT_MEASUREMENT mff_tq_mon mff_lamb_mon mff_lamb_ref_mon mff_iv_1_mon mff_iv_2_mon mff_iv_post_mon egy_level_iv_2_mon egy_level_iv_post_mon egy_level_iv_1_mon egy_level_iv_bal_mv_mon ti_add_mv_mon ti_iv_1_cor_mon ti_iv_2_cor_mon ti_iv_post_cor_mon fac_ti_mv_mon prs_dif_iv_1_mon prs_dif_iv_2_mon prs_dif_iv_post_mon /end OUT_MEASUREMENT
/end FUNCTION
/begin FUNCTION ECM2_Cmb_mode_switch_requests "Cmb_mode_switch_requests" /begin DEF_CHARACTERISTIC lc_swi_afs_mon /end DEF_CHARACTERISTIC /begin OUT_MEASUREMENT lv_swi_afs_mon /end OUT_MEASUREMENT /end FUNCTION
/end MODULE
/end PROJECT
