ASAP2_VERSION 1 41
/begin PROJECT MSD85 "Spray Guided DI-System with Piezo Injectors for 8-Cylinder"
/begin HEADER "_default_HeaderComment" PROJECT_NO _91 /end HEADER
/begin MODULE _default_ModuleName "_default_ModuleLongIdentifier"
/begin MOD_COMMON "_default_ModCommonComment" DEPOSIT ABSOLUTE BYTE_ORDER MSB_LAST ALIGNMENT_BYTE 1 ALIGNMENT_WORD 2 ALIGNMENT_LONG 2 ALIGNMENT_FLOAT32_IEEE 2 ALIGNMENT_FLOAT64_IEEE 4 /end MOD_COMMON
/begin MEASUREMENT Ag_ewp_help_1 "Hilfsgrösse Berechnung Volumenstrom A-Getriebe" UBYTE _CNV_R_R_Def_f_ub_b_553_CM 1 100. 0. 0.996 DISPLAY_IDENTIFIER AG_EWP_HELP_1 ECU_ADDRESS 0xc0007978 /end MEASUREMENT
/begin MEASUREMENT Ag_ewp_help_2 "Hilfsgrösse Berechnung Volumenstrom A-Getriebe" SWORD _CNV_R_R_Def_m_sw_q_554_CM 1 100. -3276.8 3276.7 DISPLAY_IDENTIFIER AG_EWP_HELP_2 ECU_ADDRESS 0xc000796a FORMAT "%7.2" /end MEASUREMENT
/begin MEASUREMENT Ag_ewp_help_3 "Hilfsgrösse Berechnung Volumenstrom A-Getriebe" SWORD _CNV_R_R_Def_m_sw_q_554_CM 1 100. -3276.8 3276.7 DISPLAY_IDENTIFIER AG_EWP_HELP_3 ECU_ADDRESS 0xc000796c FORMAT "%7.2" /end MEASUREMENT
/begin MEASUREMENT Ag_ewp_help_4 "Hilfsgrösse Berechnung Volumenstrom A-Getriebe" SLONG _CNV_R_R_Def_dez_sl_551_CM 1 100. -7483648. 7483647. DISPLAY_IDENTIFIER AG_EWP_HELP_4 ECU_ADDRESS 0xc0007962 FORMAT "%7.0" /end MEASUREMENT
/begin MEASUREMENT Ag_ewp_help_5 "Hilfsgrösse Berechnung Volumenstrom A-Getriebe" UWORD _CNV_R_R_Def_dez_sl_551_CM 1 100. 0. 65535. DISPLAY_IDENTIFIER AG_EWP_HELP_5 ECU_ADDRESS 0xc000796e FORMAT "%5.0" /end MEASUREMENT
/begin MEASUREMENT Amo_05 "Hier könnte Ihr Langbezeichner stehen" UWORD _CNV_R_R_Def_f_uw_b_559_CM 1 100. 0. 15.9997 DISPLAY_IDENTIFIER AMO_05 ECU_ADDRESS 0xc000407c FORMAT "%9.4" /end MEASUREMENT
/begin MEASUREMENT Amo_05gr "Grenzwert 0,5 Motorordnung" UWORD _CNV_R_R_Def_f_uw_b_559_CM 1 100. 0. 15.9997 DISPLAY_IDENTIFIER AMO_05GR ECU_ADDRESS 0xd000cdfc FORMAT "%9.4" /end MEASUREMENT
/begin MEASUREMENT Amo_10 "Hier könnte Ihr Langbezeichner stehen" UWORD _CNV_R_R_Def_f_uw_b_559_CM 1 100. 0. 15.9997 DISPLAY_IDENTIFIER AMO_10 ECU_ADDRESS 0xc000407e FORMAT "%9.4" /end MEASUREMENT
/begin MEASUREMENT Amo_10gr "Grenzwert 1,0 Motorordnung" UWORD _CNV_R_R_Def_f_uw_b_559_CM 1 100. 0. 15.9997 DISPLAY_IDENTIFIER AMO_10GR ECU_ADDRESS 0xd000cdfe FORMAT "%9.4" /end MEASUREMENT
/begin MEASUREMENT Amo_15 "Hier könnte Ihr Langbezeichner stehen" UWORD _CNV_R_R_Def_f_uw_b_559_CM 1 100. 0. 15.9997 DISPLAY_IDENTIFIER AMO_15 ECU_ADDRESS 0xc0004080 FORMAT "%9.4" /end MEASUREMENT
/begin MEASUREMENT Amo_15gr "Grenzwert 1,5 Motorordnung" UWORD _CNV_R_R_Def_f_uw_b_559_CM 1 100. 0. 15.9997 DISPLAY_IDENTIFIER AMO_15GR ECU_ADDRESS 0xd000ce00 FORMAT "%9.4" /end MEASUREMENT
/begin MEASUREMENT Amo_20 "Hier könnte Ihr Langbezeichner stehen" UWORD _CNV_R_R_Def_f_uw_b_559_CM 1 100. 0. 15.9997 DISPLAY_IDENTIFIER AMO_20 ECU_ADDRESS 0xc0004082 FORMAT "%9.4" /end MEASUREMENT
/begin MEASUREMENT Amo_20gr "Grenzwert 2,0 Motorordnung" UWORD _CNV_R_R_Def_f_uw_b_559_CM 1 100. 0. 15.9997 DISPLAY_IDENTIFIER AMO_20GR ECU_ADDRESS 0xd000ce02 FORMAT "%9.4" /end MEASUREMENT
/begin MEASUREMENT Amo_25 "Hier könnte Ihr Langbezeichner stehen" UWORD _CNV_R_R_Def_f_uw_b_559_CM 1 100. 0. 15.9997 DISPLAY_IDENTIFIER AMO_25 ECU_ADDRESS 0xc0004084 FORMAT "%9.4" /end MEASUREMENT
/begin MEASUREMENT Amo_30 "Hier könnte Ihr Langbezeichner stehen" UWORD _CNV_R_R_Def_f_uw_b_559_CM 1 100. 0. 15.9997 DISPLAY_IDENTIFIER AMO_30 ECU_ADDRESS 0xc0004086 FORMAT "%9.4" /end MEASUREMENT
/begin MEASUREMENT Amo_35 "Hier könnte Ihr Langbezeichner stehen" UWORD _CNV_R_R_Def_f_uw_b_559_CM 1 100. 0. 15.9997 DISPLAY_IDENTIFIER AMO_35 ECU_ADDRESS 0xc0004088 FORMAT "%9.4" /end MEASUREMENT
/begin MEASUREMENT Amo_40 "Hier könnte Ihr Langbezeichner stehen" UWORD _CNV_R_R_Def_f_uw_b_559_CM 1 100. 0. 15.9997 DISPLAY_IDENTIFIER AMO_40 ECU_ADDRESS 0xc000408a FORMAT "%9.4" /end MEASUREMENT
/begin MEASUREMENT Amocos05 "Hier könnte Ihr Langbezeichner stehen" SWORD _CNV_R_R_Def_f_sw_q_560_CM 1 100. -3276.8 3276.7 DISPLAY_IDENTIFIER AMOCOS05 ECU_ADDRESS 0xd000cd50 FORMAT "%7.2" /end MEASUREMENT
/begin MEASUREMENT Amocos10 "Hier könnte Ihr Langbezeichner stehen" SWORD _CNV_R_R_Def_f_sw_q_560_CM 1 100. -3276.8 3276.7 DISPLAY_IDENTIFIER AMOCOS10 ECU_ADDRESS 0xd000cd52 FORMAT "%7.2" /end MEASUREMENT
/begin MEASUREMENT Amocos15 "Hier könnte Ihr Langbezeichner stehen" SWORD _CNV_R_R_Def_f_sw_q_560_CM 1 100. -3276.8 3276.7 DISPLAY_IDENTIFIER AMOCOS15 ECU_ADDRESS 0xd000cd54 FORMAT "%7.2" /end MEASUREMENT
/begin MEASUREMENT Amocos20 "Hier könnte Ihr Langbezeichner stehen" SWORD _CNV_R_R_Def_f_sw_q_560_CM 1 100. -3276.8 3276.7 DISPLAY_IDENTIFIER AMOCOS20 ECU_ADDRESS 0xd000cd56 FORMAT "%7.2" /end MEASUREMENT
/begin MEASUREMENT Amocos25 "Hier könnte Ihr Langbezeichner stehen" SWORD _CNV_R_R_Def_f_sw_q_560_CM 1 100. -3276.8 3276.7 DISPLAY_IDENTIFIER AMOCOS25 ECU_ADDRESS 0xd000cd58 FORMAT "%7.2" /end MEASUREMENT
/begin MEASUREMENT Amocos30 "Hier könnte Ihr Langbezeichner stehen" SWORD _CNV_R_R_Def_f_sw_q_560_CM 1 100. -3276.8 3276.7 DISPLAY_IDENTIFIER AMOCOS30 ECU_ADDRESS 0xd000cd5a FORMAT "%7.2" /end MEASUREMENT
/begin MEASUREMENT Amocos35 "Hier könnte Ihr Langbezeichner stehen" SWORD _CNV_R_R_Def_f_sw_q_560_CM 1 100. -3276.8 3276.7 DISPLAY_IDENTIFIER AMOCOS35 ECU_ADDRESS 0xd000cd5c FORMAT "%7.2" /end MEASUREMENT
/begin MEASUREMENT Amocos40 "Hier könnte Ihr Langbezeichner stehen" SWORD _CNV_R_R_Def_f_sw_q_560_CM 1 100. -3276.8 3276.7 DISPLAY_IDENTIFIER AMOCOS40 ECU_ADDRESS 0xd000cd5e FORMAT "%7.2" /end MEASUREMENT
/begin MEASUREMENT Amocosx11 "Hier könnte Ihr Langbezeichner stehen" SWORD _CNV_R_R_Def_f_sw_q_560_CM 1 100. -3276.8 3276.7 DISPLAY_IDENTIFIER AMOCOSX11 ECU_ADDRESS 0xd000cd60 FORMAT "%7.2" /end MEASUREMENT
/begin MEASUREMENT Amocosx12 "Hier könnte Ihr Langbezeichner stehen" SWORD _CNV_R_R_Def_f_sw_q_560_CM 1 100. -3276.8 3276.7 DISPLAY_IDENTIFIER AMOCOSX12 ECU_ADDRESS 0xd000cd62 FORMAT "%7.2" /end MEASUREMENT
/begin MEASUREMENT Amocosx21 "Hier könnte Ihr Langbezeichner stehen" SWORD _CNV_R_R_Def_f_sw_q_560_CM 1 100. -3276.8 3276.7 DISPLAY_IDENTIFIER AMOCOSX21 ECU_ADDRESS 0xd000cd64 FORMAT "%7.2" /end MEASUREMENT
/begin MEASUREMENT Amocosx22 "Hier könnte Ihr Langbezeichner stehen" SWORD _CNV_R_R_Def_f_sw_q_560_CM 1 100. -3276.8 3276.7 DISPLAY_IDENTIFIER AMOCOSX22 ECU_ADDRESS 0xd000cd66 FORMAT "%7.2" /end MEASUREMENT
/begin MEASUREMENT Amocosx23 "Hier könnte Ihr Langbezeichner stehen" SWORD _CNV_R_R_Def_f_sw_q_560_CM 1 100. -3276.8 3276.7 DISPLAY_IDENTIFIER AMOCOSX23 ECU_ADDRESS 0xd000cd68 FORMAT "%7.2" /end MEASUREMENT
/begin MEASUREMENT Amocosx24 "Hier könnte Ihr Langbezeichner stehen" SWORD _CNV_R_R_Def_f_sw_q_560_CM 1 100. -3276.8 3276.7 DISPLAY_IDENTIFIER AMOCOSX24 ECU_ADDRESS 0xd000cd6a FORMAT "%7.2" /end MEASUREMENT
/begin MEASUREMENT Amocosx5 "Hier könnte Ihr Langbezeichner stehen" SWORD _CNV_R_R_Def_f_sw_q_560_CM 1 100. -3276.8 3276.7 DISPLAY_IDENTIFIER AMOCOSX5 ECU_ADDRESS 0xd000cd6c FORMAT "%7.2" ARRAY_SIZE 6 MATRIX_DIM 6 1 1 /end MEASUREMENT
/begin MEASUREMENT Amosin05 "Hier könnte Ihr Langbezeichner stehen" SWORD _CNV_R_R_Def_f_sw_q_560_CM 1 100. -3276.8 3276.7 DISPLAY_IDENTIFIER AMOSIN05 ECU_ADDRESS 0xd000cd78 FORMAT "%7.2" /end MEASUREMENT
/begin MEASUREMENT Amosin10 "Hier könnte Ihr Langbezeichner stehen" SWORD _CNV_R_R_Def_f_sw_q_560_CM 1 100. -3276.8 3276.7 DISPLAY_IDENTIFIER AMOSIN10 ECU_ADDRESS 0xd000cd7a FORMAT "%7.2" /end MEASUREMENT
/begin MEASUREMENT Amosin15 "Hier könnte Ihr Langbezeichner stehen" SWORD _CNV_R_R_Def_f_sw_q_560_CM 1 100. -3276.8 3276.7 DISPLAY_IDENTIFIER AMOSIN15 ECU_ADDRESS 0xd000cd7c FORMAT "%7.2" /end MEASUREMENT
/begin MEASUREMENT Amosin20 "Hier könnte Ihr Langbezeichner stehen" SWORD _CNV_R_R_Def_f_sw_q_560_CM 1 100. -3276.8 3276.7 DISPLAY_IDENTIFIER AMOSIN20 ECU_ADDRESS 0xd000cd7e FORMAT "%7.2" /end MEASUREMENT
/begin MEASUREMENT Amosin25 "Hier könnte Ihr Langbezeichner stehen" SWORD _CNV_R_R_Def_f_sw_q_560_CM 1 100. -3276.8 3276.7 DISPLAY_IDENTIFIER AMOSIN25 ECU_ADDRESS 0xd000cd80 FORMAT "%7.2" /end MEASUREMENT
/begin MEASUREMENT Amosin30 "Hier könnte Ihr Langbezeichner stehen" SWORD _CNV_R_R_Def_f_sw_q_560_CM 1 100. -3276.8 3276.7 DISPLAY_IDENTIFIER AMOSIN30 ECU_ADDRESS 0xd000cd82 FORMAT "%7.2" /end MEASUREMENT
/begin MEASUREMENT Amosin35 "Hier könnte Ihr Langbezeichner stehen" SWORD _CNV_R_R_Def_f_sw_q_560_CM 1 100. -3276.8 3276.7 DISPLAY_IDENTIFIER AMOSIN35 ECU_ADDRESS 0xd000cd84 FORMAT "%7.2" /end MEASUREMENT
/begin MEASUREMENT Amosin40 "Hier könnte Ihr Langbezeichner stehen" SWORD _CNV_R_R_Def_f_sw_q_560_CM 1 100. -3276.8 3276.7 DISPLAY_IDENTIFIER AMOSIN40 ECU_ADDRESS 0xd000cd86 FORMAT "%7.2" /end MEASUREMENT
/begin MEASUREMENT Amosinx11 "Hier könnte Ihr Langbezeichner stehen" SWORD _CNV_R_R_Def_f_sw_q_560_CM 1 100. -3276.8 3276.7 DISPLAY_IDENTIFIER AMOSINX11 ECU_ADDRESS 0xd000cd88 FORMAT "%7.2" /end MEASUREMENT
/begin MEASUREMENT Amosinx12 "Hier könnte Ihr Langbezeichner stehen" SWORD _CNV_R_R_Def_f_sw_q_560_CM 1 100. -3276.8 3276.7 DISPLAY_IDENTIFIER AMOSINX12 ECU_ADDRESS 0xd000cd8a FORMAT "%7.2" /end MEASUREMENT
/begin MEASUREMENT Amosinx21 "Hier könnte Ihr Langbezeichner stehen" SWORD _CNV_R_R_Def_f_sw_q_560_CM 1 100. -3276.8 3276.7 DISPLAY_IDENTIFIER AMOSINX21 ECU_ADDRESS 0xd000cd8c FORMAT "%7.2" /end MEASUREMENT
/begin MEASUREMENT Amosinx22 "Hier könnte Ihr Langbezeichner stehen" SWORD _CNV_R_R_Def_f_sw_q_560_CM 1 100. -3276.8 3276.7 DISPLAY_IDENTIFIER AMOSINX22 ECU_ADDRESS 0xd000cd8e FORMAT "%7.2" /end MEASUREMENT
/begin MEASUREMENT Amosinx5 "Hier könnte Ihr Langbezeichner stehen" SWORD _CNV_R_R_Def_f_sw_q_560_CM 1 100. -3276.8 3276.7 DISPLAY_IDENTIFIER AMOSINX5 ECU_ADDRESS 0xd000cd90 FORMAT "%7.2" ARRAY_SIZE 6 MATRIX_DIM 6 1 1 /end MEASUREMENT
/begin MEASUREMENT Anzzykl_espr "Anzahl Zyklen mit Einspritzung" UWORD _CNV_R_R_Def_dez_sl_551_CM 1 100. 0. 65535. DISPLAY_IDENTIFIER ANZZYKL_ESPR ECU_ADDRESS 0xd000df72 FORMAT "%5.0" /end MEASUREMENT
/begin MEASUREMENT Anzzykl_hd "Anzahl Zyklen für Hochdruckaufbau" UWORD _CNV_R_R_Def_dez_sl_551_CM 1 100. 0. 65535. DISPLAY_IDENTIFIER ANZZYKL_HD ECU_ADDRESS 0xd000dfa4 FORMAT "%5.0" /end MEASUREMENT
/begin MEASUREMENT Ba_wm_ist "Ist Betriebsart Wärmemanagement" UBYTE _CNV_S_11_Def_ba_wm_569_CM 1 100. 0. 10. DISPLAY_IDENTIFIER BA_WM_IST ECU_ADDRESS 0xc0007984 BIT_MASK 0xFF /end MEASUREMENT
/begin MEASUREMENT Ba_wm_prio "Priorisierte Betriebsart Wärmemanagement" UBYTE _CNV_S_11_Def_ba_wm_569_CM 1 100. 0. 10. DISPLAY_IDENTIFIER BA_WM_PRIO ECU_ADDRESS 0xc0007985 BIT_MASK 0xFF /end MEASUREMENT
/begin MEASUREMENT Ba_wm_soll "Soll Betriebsart Wärmemanagement" UBYTE _CNV_S_11_Def_ba_wm_569_CM 1 100. 0. 10. DISPLAY_IDENTIFIER BA_WM_SOLL ECU_ADDRESS 0xc0007986 BIT_MASK 0xFF /end MEASUREMENT
/begin MEASUREMENT Bank_akt "Anzeige Aktuelle Bank bei VBR" UBYTE _CNV_R_R_Def_dez_sl_551_CM 1 100. 0. 255. DISPLAY_IDENTIFIER BANK_AKT ECU_ADDRESS 0xd000ce0a FORMAT "%3.0" /end MEASUREMENT
/begin MEASUREMENT Bapr_wm_appl "Hilfsgrösse" UWORD _CNV_R_R_Def_dez_sl_551_CM 1 100. 0. 65535. DISPLAY_IDENTIFIER BAPR_WM_APPL ECU_ADDRESS 0xc0007988 FORMAT "%5.0" /end MEASUREMENT
/begin MEASUREMENT Bapr_wm_bfel "Hilfsgrösse" UWORD _CNV_R_R_Def_dez_sl_551_CM 1 100. 0. 65535. DISPLAY_IDENTIFIER BAPR_WM_BFEL ECU_ADDRESS 0xc000798a FORMAT "%5.0" /end MEASUREMENT
/begin MEASUREMENT Bapr_wm_bs "Hilfsgrösse" UWORD _CNV_R_R_Def_dez_sl_551_CM 1 100. 0. 65535. DISPLAY_IDENTIFIER BAPR_WM_BS ECU_ADDRESS 0xc000798c FORMAT "%5.0" /end MEASUREMENT
/begin MEASUREMENT Bapr_wm_gbtr "Hilfsgrösse" UWORD _CNV_R_R_Def_dez_sl_551_CM 1 100. 0. 65535. DISPLAY_IDENTIFIER BAPR_WM_GBTR ECU_ADDRESS 0xc000798e FORMAT "%5.0" /end MEASUREMENT
/begin MEASUREMENT Bapr_wm_heizl "Hilfsgrösse" UWORD _CNV_R_R_Def_dez_sl_551_CM 1 100. 0. 65535. DISPLAY_IDENTIFIER BAPR_WM_HEIZL ECU_ADDRESS 0xc0007990 FORMAT "%5.0" /end MEASUREMENT
/begin MEASUREMENT Bapr_wm_nfks "Hilfsgrösse" UWORD _CNV_R_R_Def_dez_sl_551_CM 1 100. 0. 65535. DISPLAY_IDENTIFIER BAPR_WM_NFKS ECU_ADDRESS 0xc0007992 FORMAT "%5.0" /end MEASUREMENT
/begin MEASUREMENT Bapr_wm_warm "Hilfsgrösse" UWORD _CNV_R_R_Def_dez_sl_551_CM 1 100. 0. 65535. DISPLAY_IDENTIFIER BAPR_WM_WARM ECU_ADDRESS 0xc0007994 FORMAT "%5.0" /end MEASUREMENT
/begin MEASUREMENT Baw_wm_heizl "Hilfsgrösse" UBYTE _CNV_R_R_Def_dez_sl_551_CM 1 100. 0. 255. DISPLAY_IDENTIFIER BAW_WM_HEIZL ECU_ADDRESS 0xc00079a0 FORMAT "%3.0" /end MEASUREMENT
/begin MEASUREMENT Dlasoll_stat12 "Diff. Solllambda im Brennraum ohne Pulsation Bank 1/2 (homogen)" SWORD _CNV_R_R_Def_f_sw_b_592_CM 1 100. -8. 7.9997 DISPLAY_IDENTIFIER DLASOLL_STAT12 ECU_ADDRESS 0xd000df4e FORMAT "%9.4" /end MEASUREMENT
/begin MEASUREMENT Drf_soll "Delta Soll Rf im 10ms-Raster" SWORD _CNV_R_R_Def_rf_sw__598_CM 1 100. -327.68 327.67 DISPLAY_IDENTIFIER DRF_SOLL ECU_ADDRESS 0xd000de3a FORMAT "%9.4" /end MEASUREMENT
/begin MEASUREMENT Drf_te_s "Delta Rf wegen TE im Schicht" SWORD _CNV_R_R_Def_rf_sw__598_CM 1 100. -327.68 327.67 DISPLAY_IDENTIFIER DRF_TE_S ECU_ADDRESS 0xd000df96 FORMAT "%9.4" /end MEASUREMENT
/begin MEASUREMENT Drfopt_hs "Quotient zwichen Rf und Rfopt (homogen-schicht)" SWORD _CNV_R_R_Def_eta_sw_599_CM 1 100. -200. 199.9938 DISPLAY_IDENTIFIER DRFOPT_HS ECU_ADDRESS 0xd000dfea FORMAT "%8.3" /end MEASUREMENT
/begin MEASUREMENT Drfopt_s "Quotient zwichen Rf und Rfopt (schicht)" SWORD _CNV_R_R_Def_eta_sw_599_CM 1 100. -200. 199.9938 DISPLAY_IDENTIFIER DRFOPT_S ECU_ADDRESS 0xd000df4c FORMAT "%8.3" /end MEASUREMENT
/begin MEASUREMENT Drfoptres_hs "Quotient zwichen Rf_soll_s und Rf_opt_s (homogen-schicht)" SWORD _CNV_R_R_Def_eta_sw_599_CM 1 100. -200. 199.9938 DISPLAY_IDENTIFIER DRFOPTRES_HS ECU_ADDRESS 0xd000dfee FORMAT "%8.3" /end MEASUREMENT
/begin MEASUREMENT Drfoptres_s "Quotient zwichen Rf_soll_s und Rf_opt_s (schicht)" SWORD _CNV_R_R_Def_eta_sw_599_CM 1 100. -200. 199.9938 DISPLAY_IDENTIFIER DRFOPTRES_S ECU_ADDRESS 0xd000dfec FORMAT "%8.3" /end MEASUREMENT
/begin MEASUREMENT Drk_soll "Delta Soll Rk(Rf wennn HOMOGEN) im 10ms-Raster" SWORD _CNV_R_R_Def_rk_sw__600_CM 1 100. -1600. 1599.9511 DISPLAY_IDENTIFIER DRK_SOLL ECU_ADDRESS 0xd000df76 FORMAT "%8.3" /end MEASUREMENT
/begin MEASUREMENT Dtkwsoll "Regeldifferenz KFT" SWORD _CNV_R_R_Def_t_sw_q_579_CM 1 100. -327.68 327.67 DISPLAY_IDENTIFIER DTKWSOLL ECU_ADDRESS 0xc0000734 FORMAT "%7.2" /end MEASUREMENT
/begin MEASUREMENT Eta_bas_s "" UWORD _CNV_R_R_Def_eta_uw_615_CM 1 100. 0. 199.9969 DISPLAY_IDENTIFIER ETA_BAS_S ECU_ADDRESS 0xd000ddf8 FORMAT "%8.3" /end MEASUREMENT
/begin MEASUREMENT Eta_hs "Gesamtwirkungsgrad (homogen-schicht)" UWORD _CNV_R_R_Def_eta_uw_615_CM 1 100. 0. 199.9969 DISPLAY_IDENTIFIER ETA_HS ECU_ADDRESS 0xd000ddfe FORMAT "%8.3" /end MEASUREMENT
/begin MEASUREMENT Eta_labas "Basis Lambda Wirkungsgrad für Zulieferer" SWORD _CNV_R_R_Def_eta_sw_599_CM 1 100. -200. 199.9938 DISPLAY_IDENTIFIER ETA_LABAS ECU_ADDRESS 0xd000df68 FORMAT "%8.3" /end MEASUREMENT
/begin MEASUREMENT Eta_labas_sol "Basis Lambda Wirkungsgrad für Zulieferer" SWORD _CNV_R_R_Def_eta_sw_599_CM 1 100. -200. 199.9938 DISPLAY_IDENTIFIER ETA_LABAS_SOL ECU_ADDRESS 0xd000df6a FORMAT "%8.3" /end MEASUREMENT
/begin MEASUREMENT Eta_laber_h "Berechneter Lambdawirkungsgrad für Homogen nach BMW Def" SWORD _CNV_R_R_Def_eta_sw_599_CM 1 100. -200. 199.9938 DISPLAY_IDENTIFIER ETA_LABER_H ECU_ADDRESS 0xd000e00e FORMAT "%8.3" /end MEASUREMENT
/begin MEASUREMENT Eta_laber_h1 "Berechneter Lambdawirkungsgrad für Homogen nach BMW Def Bank 1" SWORD _CNV_R_R_Def_eta_sw_599_CM 1 100. -200. 199.9938 DISPLAY_IDENTIFIER ETA_LABER_H1 ECU_ADDRESS 0xd000e010 FORMAT "%8.3" /end MEASUREMENT
/begin MEASUREMENT Eta_laber_h2 "Berechneter Lambdawirkungsgrad für Homogen nach BMW Def Bank 2" SWORD _CNV_R_R_Def_eta_sw_599_CM 1 100. -200. 199.9938 DISPLAY_IDENTIFIER ETA_LABER_H2 ECU_ADDRESS 0xd000e012 FORMAT "%8.3" /end MEASUREMENT
/begin MEASUREMENT Eta_lamb_ist "Ist Lambda Wirkungsgrad im Homogenen nach BMW Def" SWORD _CNV_R_R_Def_eta_sw_599_CM 1 100. -200. 199.9938 DISPLAY_IDENTIFIER ETA_LAMB_IST ECU_ADDRESS 0xd000df60 FORMAT "%8.3" /end MEASUREMENT
/begin MEASUREMENT Eta_lamb_ist1 "Kein Langbezeichner vergeben" SWORD _CNV_R_R_Def_eta_sw_599_CM 1 100. -200. 199.9938 DISPLAY_IDENTIFIER ETA_LAMB_IST1 ECU_ADDRESS 0xd000e014 FORMAT "%8.3" /end MEASUREMENT
/begin MEASUREMENT Eta_lamb_ist2 "Kein Langbezeichner vergeben" SWORD _CNV_R_R_Def_eta_sw_599_CM 1 100. -200. 199.9938 DISPLAY_IDENTIFIER ETA_LAMB_IST2 ECU_ADDRESS 0xd000e016 FORMAT "%8.3" /end MEASUREMENT
/begin MEASUREMENT Eta_lamb_soll "Solllambdawirkungsgrad gemittelt" SWORD _CNV_R_R_Def_eta_sw_599_CM 1 100. -200. 199.9938 DISPLAY_IDENTIFIER ETA_LAMB_SOLL ECU_ADDRESS 0xd000e008 FORMAT "%8.3" /end MEASUREMENT
/begin MEASUREMENT Eta_lamb_soll1 "Solllambdawirkungsgrad Bank 1" SWORD _CNV_R_R_Def_eta_sw_599_CM 1 100. -200. 199.9938 DISPLAY_IDENTIFIER ETA_LAMB_SOLL1 ECU_ADDRESS 0xd000e00a FORMAT "%8.3" /end MEASUREMENT
/begin MEASUREMENT Eta_lamb_soll2 "Solllambdawirkungsgrad Bank 2" SWORD _CNV_R_R_Def_eta_sw_599_CM 1 100. -200. 199.9938 DISPLAY_IDENTIFIER ETA_LAMB_SOLL2 ECU_ADDRESS 0xd000e00c FORMAT "%8.3" /end MEASUREMENT
/begin MEASUREMENT Eta_lambda "Ist Lambda Wirkungsgrad im Homogenen für den Zulieferer" SWORD _CNV_R_R_Def_eta_sw_599_CM 1 100. -200. 199.9938 DISPLAY_IDENTIFIER ETA_LAMBDA ECU_ADDRESS 0xd000df62 FORMAT "%8.3" /end MEASUREMENT
/begin MEASUREMENT Eta_lambda_1 "Ist Lambda Wirkungsgrad im Homogenen für den Zulieferer Bank 1" SWORD _CNV_R_R_Def_eta_sw_599_CM 1 100. -200. 199.9938 DISPLAY_IDENTIFIER ETA_LAMBDA_1 ECU_ADDRESS 0xd000df64 FORMAT "%8.3" /end MEASUREMENT
/begin MEASUREMENT Eta_lambda_2 "Ist Lambda Wirkungsgrad im Homogenen für den Zulieferer Bank 2" SWORD _CNV_R_R_Def_eta_sw_599_CM 1 100. -200. 199.9938 DISPLAY_IDENTIFIER ETA_LAMBDA_2 ECU_ADDRESS 0xd000df66 FORMAT "%8.3" /end MEASUREMENT
/begin MEASUREMENT Eta_lamte_s "Wirkungsgrad des Lamda in Brennraum durch TE" UWORD _CNV_R_R_Def_eta_uw_615_CM 1 100. 0. 199.9969 DISPLAY_IDENTIFIER ETA_LAMTE_S ECU_ADDRESS 0xd000dff4 FORMAT "%8.3" /end MEASUREMENT
/begin MEASUREMENT Eta_lasoll "Sollambdawirkungsgrad Rf-basiert" SWORD _CNV_R_R_Def_eta_sw_599_CM 1 100. -200. 199.9938 DISPLAY_IDENTIFIER ETA_LASOLL ECU_ADDRESS 0xd000e018 FORMAT "%8.3" /end MEASUREMENT
/begin MEASUREMENT Eta_rkte_s "Volumenwirkungsgrad der eingespritzten Kraftstoffmenge" UWORD _CNV_R_R_Def_eta_uw_615_CM 1 100. 0. 199.9969 DISPLAY_IDENTIFIER ETA_RKTE_S ECU_ADDRESS 0xd000dff2 FORMAT "%8.3" /end MEASUREMENT
/begin MEASUREMENT Eta_te_s "Wirkungsgrad TE in Schicht" UWORD _CNV_R_R_Def_eta_uw_615_CM 1 100. 0. 199.9969 DISPLAY_IDENTIFIER ETA_TE_S ECU_ADDRESS 0xd000dff0 FORMAT "%8.3" /end MEASUREMENT
/begin MEASUREMENT Eta_zwsoll "Eta_zwsoll" SWORD _CNV_R_R_Def_eta_sw_599_CM 1 100. -200. 199.9938 DISPLAY_IDENTIFIER ETA_ZWSOLL ECU_ADDRESS 0xd000dffc FORMAT "%8.3" /end MEASUREMENT
/begin MEASUREMENT Etarf_hs "Wirkungsgrad auf Rk_kor_s (homogen-schicht)" UWORD _CNV_R_R_Def_eta_uw_615_CM 1 100. 0. 199.9969 DISPLAY_IDENTIFIER ETARF_HS ECU_ADDRESS 0xd000ddfc FORMAT "%8.3" /end MEASUREMENT
/begin MEASUREMENT Etarf_s "Wirkungsgrad auf Rk_kor_s (schicht)" UWORD _CNV_R_R_Def_eta_uw_615_CM 1 100. 0. 199.9969 DISPLAY_IDENTIFIER ETARF_S ECU_ADDRESS 0xd000ddfa FORMAT "%8.3" /end MEASUREMENT
/begin MEASUREMENT Etarfres_hs "Wirkungsgrad auf Rfoptres (homogen-schicht)" UWORD _CNV_R_R_Def_eta_uw_615_CM 1 100. 0. 199.9969 DISPLAY_IDENTIFIER ETARFRES_HS ECU_ADDRESS 0xd000dff8 FORMAT "%8.3" /end MEASUREMENT
/begin MEASUREMENT Etarfres_s "Wirkungsgrad auf Rfoptres (schicht)" UWORD _CNV_R_R_Def_eta_uw_615_CM 1 100. 0. 199.9969 DISPLAY_IDENTIFIER ETARFRES_S ECU_ADDRESS 0xd000dff6 FORMAT "%8.3" /end MEASUREMENT
/begin MEASUREMENT F_amogrenz "Korrekturfaktor für Grenze" UWORD _CNV_R_R_Def_f_uw_b_559_CM 1 100. 0. 15.9997 DISPLAY_IDENTIFIER F_AMOGRENZ ECU_ADDRESS 0xd000ce0c FORMAT "%9.4" /end MEASUREMENT
/begin MEASUREMENT F_dpsvr "Überblendfaktor Dpseinfluss aus Verbrennungsregelung" UBYTE _CNV_R_R_Def_f_ub_b_553_CM 1 100. 0. 0.996 DISPLAY_IDENTIFIER F_DPSVR ECU_ADDRESS 0xd000cee4 /end MEASUREMENT
/begin MEASUREMENT F_drfte_s "Faktor TE im Schicht" SWORD _CNV_R_R_Def_f_uw_b_590_CM 1 100. -1. 0.9999 DISPLAY_IDENTIFIER F_DRFTE_S ECU_ADDRESS 0xd000df8e FORMAT "%14.5" /end MEASUREMENT
/begin MEASUREMENT F_dzwkrvr "Überblendfaktor Klopfregelungseinfluss aus Verbrennungsregelung " UBYTE _CNV_R_R_Def_f_ub_b_553_CM 1 100. 0. 0.996 DISPLAY_IDENTIFIER F_DZWKRVR ECU_ADDRESS 0xd000cee6 /end MEASUREMENT
/begin MEASUREMENT F_errvr "Überblendfaktor bei HFM/DPS-Sensorfehler aus Verbrennungsregelung " UBYTE _CNV_R_R_Def_f_ub_b_553_CM 1 100. 0. 0.996 DISPLAY_IDENTIFIER F_ERRVR ECU_ADDRESS 0xd000cee7 /end MEASUREMENT
/begin MEASUREMENT F_etatemin_s "Gewichtungsfaktor minimal Eta_te zu aktuellem" UWORD _CNV_R_R_Def_eta_uw_615_CM 1 100. 0. 199.9969 DISPLAY_IDENTIFIER F_ETATEMIN_S ECU_ADDRESS 0xd000ddf6 FORMAT "%8.3" /end MEASUREMENT
/begin MEASUREMENT F_ewp_co "Faktor Wärmeeintrag" UBYTE _CNV_R_R_Def_f_ub_b_553_CM 1 100. 0. 0.996 DISPLAY_IDENTIFIER F_EWP_CO ECU_ADDRESS 0xc0007979 /end MEASUREMENT
/begin MEASUREMENT F_frk2_3h "Überblendfaktor wichtung Aufteilungsfaktor 2te Einspritzung bei Dreifacheinspritzung kalt(F=1) warm(F=0)" UBYTE _CNV_R_R_Def_f_ub_b_619_CM 1 100. 0. 1. DISPLAY_IDENTIFIER F_FRK2_3H ECU_ADDRESS 0xd000df7b /end MEASUREMENT
/begin MEASUREMENT F_frk2_h "Überblendfaktor wichtung Aufteilungsfaktor Doppeleinspritzung kalt(F=1) warm(F=0)" UBYTE _CNV_R_R_Def_f_ub_b_619_CM 1 100. 0. 1. DISPLAY_IDENTIFIER F_FRK2_H ECU_ADDRESS 0xd000df7a /end MEASUREMENT
/begin MEASUREMENT F_frk3_3h "Überblendfaktor wichtung Aufteilungsfaktor 3te Einspritzung bei Dreifacheinspritzung kalt(F=1) warm(F=0)" UBYTE _CNV_R_R_Def_f_ub_b_619_CM 1 100. 0. 1. DISPLAY_IDENTIFIER F_FRK3_3H ECU_ADDRESS 0xd000df7c /end MEASUREMENT
/begin MEASUREMENT F_lurmdi "Wichtung der Lur-Werte bei Laständerungen" UWORD _CNV_R_R_Def_f_uw_b_590_CM 1 100. 0. 1.9999 DISPLAY_IDENTIFIER F_LURMDI ECU_ADDRESS 0xd000ce58 FORMAT "%14.5" /end MEASUREMENT
/begin MEASUREMENT F_mdresvr "Überblendfaktor Momentenreserve aus Verbrennungsregelung" UBYTE _CNV_R_R_Def_f_ub_b_553_CM 1 100. 0. 0.996 DISPLAY_IDENTIFIER F_MDRESVR ECU_ADDRESS 0xd000cee5 /end MEASUREMENT
/begin MEASUREMENT F_rfbas_s "Überblendfaktor Soll-Luft (S) warm/kalt" UBYTE _CNV_R_R_Def_f_ub_b_553_CM 1 100. 0. 0.996 DISPLAY_IDENTIFIER F_RFBAS_S ECU_ADDRESS 0xd000df79 /end MEASUREMENT
/begin MEASUREMENT F_rk2_3h "Aufteilungsfaktor 2te Einspritzung bei 3fach Einspritzung" UWORD _CNV_R_R_Def_f_uw_b_622_CM 1 100. 0. 1. DISPLAY_IDENTIFIER F_RK2_3H ECU_ADDRESS 0xd000de52 FORMAT "%9.4" /end MEASUREMENT
/begin MEASUREMENT F_rk2_h "Aufteilungsfaktor 2te Einspritzung bei 2fach Einspritzung" UWORD _CNV_R_R_Def_f_uw_b_622_CM 1 100. 0. 1. DISPLAY_IDENTIFIER F_RK2_H ECU_ADDRESS 0xd000de50 FORMAT "%9.4" /end MEASUREMENT
/begin MEASUREMENT F_rk2korkh_h "Warmlaufkorrektur Katheizmenge" UWORD _CNV_R_R_Def_f_uw_b_590_CM 1 100. 0. 1.9999 DISPLAY_IDENTIFIER F_RK2KORKH_H ECU_ADDRESS 0xd000de5a FORMAT "%14.5" /end MEASUREMENT
/begin MEASUREMENT F_rk3_3h "Aufteilungsfaktor 3te Einspritzung bei 3fach Einspritzung" UWORD _CNV_R_R_Def_f_uw_b_622_CM 1 100. 0. 1. DISPLAY_IDENTIFIER F_RK3_3H ECU_ADDRESS 0xd000de54 FORMAT "%9.4" /end MEASUREMENT
/begin MEASUREMENT F_rkkorrf "Vorsteuerungkorrektur" UWORD _CNV_R_R_Def_f_uw_b_590_CM 1 100. 0. 1.9999 DISPLAY_IDENTIFIER F_RKKORRF ECU_ADDRESS 0xd000de56 FORMAT "%14.5" ARRAY_SIZE 2 MATRIX_DIM 2 1 1 /end MEASUREMENT
/begin MEASUREMENT F_rkkorwl_hs "Rk Warmlaufkorrektur HS" UWORD _CNV_R_R_Def_f_sw_b_616_CM 1 100. 0. 3.9999 DISPLAY_IDENTIFIER F_RKKORWL_HS ECU_ADDRESS 0xd000df5a FORMAT "%14.5" /end MEASUREMENT
/begin MEASUREMENT F_rkkorwl_s "Rk Warmlaufkorrektur S" UWORD _CNV_R_R_Def_f_sw_b_616_CM 1 100. 0. 3.9999 DISPLAY_IDENTIFIER F_RKKORWL_S ECU_ADDRESS 0xd000df5c FORMAT "%14.5" /end MEASUREMENT
/begin MEASUREMENT F_rstgvr "Überblendfaktor VVT-Sicher aus Laufruhe" UBYTE _CNV_R_R_Def_f_ub_b_553_CM 1 100. 0. 0.996 DISPLAY_IDENTIFIER F_RSTGVR ECU_ADDRESS 0xd000cee2 /end MEASUREMENT
/begin MEASUREMENT F_sicher_mem "Startwert für Überblender VVT-Sicher aus Laufunruhe" SLONG _CNV_R_R_Def_f_uw_b_571_CM 1 100. -32768. 32767.9999 DISPLAY_IDENTIFIER F_SICHER_MEM ECU_ADDRESS 0xd000cefc FORMAT "%14.5" /end MEASUREMENT
/begin MEASUREMENT F_tikorzsk "Zylinderselektive Gemischkorrektur / Laufruhegleichstellung" SWORD _CNV_R_R_Def_frel_s_624_CM 1 100. -50. 49.9984 DISPLAY_IDENTIFIER F_TIKORZSK ECU_ADDRESS 0xd000cee8 FORMAT "%8.3" ARRAY_SIZE 8 MATRIX_DIM 8 1 1 /end MEASUREMENT
/begin MEASUREMENT F_tizsk_mn "Grenzwert zylinderselektive Gemischkorrektur /Laufruhegleichstellung" SWORD _CNV_R_R_Def_frel_s_624_CM 1 100. -50. 49.9984 DISPLAY_IDENTIFIER F_TIZSK_MN ECU_ADDRESS 0xd000cf22 FORMAT "%8.3" /end MEASUREMENT
/begin MEASUREMENT F_tizsk_mx "Grenzwert zylinderselektive Gemischkorrektur /Laufruhegleichstellung" SWORD _CNV_R_R_Def_frel_s_624_CM 1 100. -50. 49.9984 DISPLAY_IDENTIFIER F_TIZSK_MX ECU_ADDRESS 0xd000cf20 FORMAT "%8.3" /end MEASUREMENT
/begin MEASUREMENT F_tmotvr "Überblendfaktor Tmoteinfluss aus Verbrennungsregelung" UBYTE _CNV_R_R_Def_f_ub_b_553_CM 1 100. 0. 0.996 DISPLAY_IDENTIFIER F_TMOTVR ECU_ADDRESS 0xd000cee3 /end MEASUREMENT
/begin MEASUREMENT Gangi_alt "Aktueller Gang intern" UBYTE _CNV_R_R_Def_dez_sl_551_CM 1 100. 0. 255. DISPLAY_IDENTIFIER GANGI_ALT ECU_ADDRESS 0xd000e072 FORMAT "%3.0" /end MEASUREMENT
/begin MEASUREMENT Gangi_buf "gemerkter Gangi" UBYTE _CNV_R_R_Def_dez_sl_551_CM 1 100. 0. 255. DISPLAY_IDENTIFIER GANGI_BUF ECU_ADDRESS 0xd000e074 FORMAT "%3.0" /end MEASUREMENT
/begin MEASUREMENT Gangi_entpr "Entprellter Gang" UBYTE _CNV_R_R_Def_dez_sl_551_CM 1 100. 0. 255. DISPLAY_IDENTIFIER GANGI_ENTPR ECU_ADDRESS 0xd000e057 FORMAT "%3.0" /end MEASUREMENT
/begin MEASUREMENT Gangi_entpr_alt "Aktueller Gang intern" UBYTE _CNV_R_R_Def_dez_sl_551_CM 1 100. 0. 255. DISPLAY_IDENTIFIER GANGI_ENTPR_ALT ECU_ADDRESS 0xd000e073 FORMAT "%3.0" /end MEASUREMENT
/begin MEASUREMENT Kft_d "Ausgangswert KFT-Regler Differentialanteil" SWORD _CNV_R_R_Def_rel_sw_562_CM 1 100. -100. 99.9969 DISPLAY_IDENTIFIER KFT_D ECU_ADDRESS 0xc000073c FORMAT "%8.3" /end MEASUREMENT
/begin MEASUREMENT Kft_i "Ausgangswert KFT-Regler Integralanteil" SWORD _CNV_R_R_Def_rel_sw_562_CM 1 100. -100. 99.9969 DISPLAY_IDENTIFIER KFT_I ECU_ADDRESS 0xc000073a FORMAT "%8.3" /end MEASUREMENT
/begin MEASUREMENT Kft_p "Ausgangswert KFT-Regler Proportionalanteil" SWORD _CNV_R_R_Def_rel_sw_562_CM 1 100. -100. 99.9969 DISPLAY_IDENTIFIER KFT_P ECU_ADDRESS 0xc0000738 FORMAT "%8.3" /end MEASUREMENT
/begin MEASUREMENT Kft_p_loc "Eingangswert KFT-Regler Proportionalanteil" UWORD _CNV_R_R_Def_f_uw_b_617_CM 1 100. 0. 63.999 DISPLAY_IDENTIFIER KFT_P_LOC ECU_ADDRESS 0xc000072e FORMAT "%9.4" /end MEASUREMENT
/begin MEASUREMENT Kft_status "Statuswert KFT-Regler" UBYTE _CNV_R_R_Def_dez_sl_551_CM 1 100. 0. 255. DISPLAY_IDENTIFIER KFT_STATUS ECU_ADDRESS 0xc000072c FORMAT "%3.0" /end MEASUREMENT
/begin MEASUREMENT Kvaverbr_h "Hilfsgrösse Berechnung Kraftstoffmassenstrom" ULONG _CNV_R_R_Def_dez_sl_551_CM 1 100. 0. 4294967295. DISPLAY_IDENTIFIER KVAVERBR_H ECU_ADDRESS 0xc0007966 FORMAT "%7.0" /end MEASUREMENT
/begin MEASUREMENT Kvaverbr_h1 "Hilfsgrösse Berechnung Kraftstoffmassenstrom" UWORD _CNV_R_R_Def_dez_sl_551_CM 1 100. 0. 65535. DISPLAY_IDENTIFIER KVAVERBR_H1 ECU_ADDRESS 0xc0007970 FORMAT "%5.0" /end MEASUREMENT
/begin MEASUREMENT Kvaverbr_h2 "Hilfsgrösse Berechnung Kraftstoffmassenstrom" UWORD _CNV_R_R_Def_dez_sl_551_CM 1 100. 0. 65535. DISPLAY_IDENTIFIER KVAVERBR_H2 ECU_ADDRESS 0xc0007972 FORMAT "%5.0" /end MEASUREMENT
/begin MEASUREMENT Kvaverbr_old "Hilfsgrösse Berechnung Kraftstoffmassenstrom" UWORD _CNV_R_R_Def_dez_sl_551_CM 1 100. 0. 65535. DISPLAY_IDENTIFIER KVAVERBR_OLD ECU_ADDRESS 0xc0007974 FORMAT "%5.0" /end MEASUREMENT
/begin MEASUREMENT La_bas_h "Basis Lambda (homogen)" UWORD _CNV_R_R_Def_f_uw_b_559_CM 1 100. 0. 15.9997 DISPLAY_IDENTIFIER LA_BAS_H ECU_ADDRESS 0xd000df58 FORMAT "%9.4" /end MEASUREMENT
/begin MEASUREMENT La_ber_h1 "Lambdawert berechnet Homogen Bank 1" UWORD _CNV_R_R_Def_f_uw_b_559_CM 1 100. 0. 15.9997 DISPLAY_IDENTIFIER LA_BER_H1 ECU_ADDRESS 0xd000e004 FORMAT "%9.4" /end MEASUREMENT
/begin MEASUREMENT La_ber_h2 "Lambdawert berechnet Homogen Bank 1" UWORD _CNV_R_R_Def_f_uw_b_559_CM 1 100. 0. 15.9997 DISPLAY_IDENTIFIER LA_BER_H2 ECU_ADDRESS 0xd000e006 FORMAT "%9.4" /end MEASUREMENT
/begin MEASUREMENT La_soll "Lambda-Sollwert" UWORD _CNV_R_R_Def_f_uw_b_559_CM 1 100. 0. 15.9997 DISPLAY_IDENTIFIER LA_SOLL ECU_ADDRESS 0xd000df6c FORMAT "%9.4" /end MEASUREMENT
/begin MEASUREMENT La_soll_konv "Lambda konvertiert auf F_tikorzsk" SWORD _CNV_R_R_Def_frel_s_624_CM 1 100. -50. 49.9984 DISPLAY_IDENTIFIER LA_SOLL_KONV ECU_ADDRESS 0xd000cef8 FORMAT "%8.3" /end MEASUREMENT
/begin MEASUREMENT La_sollreg1 "Solllambda für Lambdaregler Bank 1 (homogen)" UWORD _CNV_R_R_Def_f_uw_b_559_CM 1 100. 0. 15.9997 DISPLAY_IDENTIFIER LA_SOLLREG1 ECU_ADDRESS 0xd000df50 FORMAT "%9.4" /end MEASUREMENT
/begin MEASUREMENT La_sollreg2 "Solllambda für Lambdaregler Bank 2 (homogen)" UWORD _CNV_R_R_Def_f_uw_b_559_CM 1 100. 0. 15.9997 DISPLAY_IDENTIFIER LA_SOLLREG2 ECU_ADDRESS 0xd000df52 FORMAT "%9.4" /end MEASUREMENT
/begin MEASUREMENT Lamb_es_s "Lambda vom Einspritzung in Schicht" UWORD _CNV_R_R_Def_f_uw_b_559_CM 1 100. 0. 15.9997 DISPLAY_IDENTIFIER LAMB_ES_S ECU_ADDRESS 0xd000dfa8 FORMAT "%9.4" /end MEASUREMENT
/begin MEASUREMENT Lamb_te "Lambda im Brennraum durch TE" UWORD _CNV_R_R_Def_f_uw_b_559_CM 1 100. 0. 15.9997 DISPLAY_IDENTIFIER LAMB_TE ECU_ADDRESS 0xd000dfa6 FORMAT "%9.4" /end MEASUREMENT
/begin MEASUREMENT Lur_alt "alter Laufunruhewert" SWORD _CNV_R_R_Def_dez_sl_551_CM 1 100. -32768. 32767. DISPLAY_IDENTIFIER LUR_ALT ECU_ADDRESS 0xd000ce38 FORMAT "%5.0" ARRAY_SIZE 8 MATRIX_DIM 8 1 1 /end MEASUREMENT
/begin MEASUREMENT Lur_ko "Korrektur auf normierten Laufunruhewert" SWORD _CNV_R_R_Def_dez_sl_551_CM 1 100. -32768. 32767. DISPLAY_IDENTIFIER LUR_KO ECU_ADDRESS 0xd000ce48 FORMAT "%5.0" ARRAY_SIZE 8 MATRIX_DIM 8 1 1 /end MEASUREMENT
/begin MEASUREMENT Lur_mw "Mittelwert aus den letzten Lur-Werten" SWORD _CNV_R_R_Def_dez_sl_551_CM 1 100. -32768. 32767. DISPLAY_IDENTIFIER LUR_MW ECU_ADDRESS 0xd000ce14 FORMAT "%5.0" /end MEASUREMENT
/begin MEASUREMENT Lurabs_f "gefilterte Laufunruhedeltas eines Zylinders" SWORD _CNV_R_R_Def_f_sw_q_560_CM 1 100. -3276.8 3276.7 DISPLAY_IDENTIFIER LURABS_F ECU_ADDRESS 0xd000cdec FORMAT "%7.2" ARRAY_SIZE 8 MATRIX_DIM 8 1 1 /end MEASUREMENT
/begin MEASUREMENT Lurabs_mx "Maximalwert aus den letzten Lurabs_f Werten" SWORD _CNV_R_R_Def_f_sw_q_560_CM 1 100. -3276.8 3276.7 DISPLAY_IDENTIFIER LURABS_MX ECU_ADDRESS 0xd000ce16 FORMAT "%7.2" /end MEASUREMENT
/begin MEASUREMENT Lurabs_mx1 "Maximalwert aus den letzten Lurabs_f Werten Bank 1" SWORD _CNV_R_R_Def_f_sw_q_560_CM 1 100. -3276.8 3276.7 DISPLAY_IDENTIFIER LURABS_MX1 ECU_ADDRESS 0xd000ce06 FORMAT "%7.2" /end MEASUREMENT
/begin MEASUREMENT Lurabs_mx2 "Maximalwert aus den letzten Lurabs_f Werten Bank 2" SWORD _CNV_R_R_Def_f_sw_q_560_CM 1 100. -3276.8 3276.7 DISPLAY_IDENTIFIER LURABS_MX2 ECU_ADDRESS 0xd000ce08 FORMAT "%7.2" /end MEASUREMENT
/begin MEASUREMENT Lurabsgr "Eingriffsgrenze für Stochastikkorrektur" SWORD _CNV_R_R_Def_f_sw_q_560_CM 1 100. -3276.8 3276.7 DISPLAY_IDENTIFIER LURABSGR ECU_ADDRESS 0xd000ce04 FORMAT "%7.2" /end MEASUREMENT
/begin MEASUREMENT Lurdif_f "gefilterte mittlere Abweichung des Lur-Wertes" SWORD _CNV_R_R_Def_f_sw_q_560_CM 1 100. -3276.8 3276.7 DISPLAY_IDENTIFIER LURDIF_F ECU_ADDRESS 0xd000cddc FORMAT "%7.2" ARRAY_SIZE 8 MATRIX_DIM 8 1 1 /end MEASUREMENT
/begin MEASUREMENT Lurdifmw "Abweichung des Lur-Wertes zum Mittelwert über alle Zylinder" SWORD _CNV_R_R_Def_dez_sl_551_CM 1 100. -32768. 32767. DISPLAY_IDENTIFIER LURDIFMW ECU_ADDRESS 0xd000ce18 FORMAT "%5.0" ARRAY_SIZE 8 MATRIX_DIM 8 1 1 /end MEASUREMENT
/begin MEASUREMENT Lurgrd "Delta zum vorherigen Lur-Wert vom gleicher Zylinder" SWORD _CNV_R_R_Def_dez_sl_551_CM 1 100. -32768. 32767. DISPLAY_IDENTIFIER LURGRD ECU_ADDRESS 0xd000ce28 FORMAT "%5.0" ARRAY_SIZE 8 MATRIX_DIM 8 1 1 /end MEASUREMENT
/begin MEASUREMENT Md_rad_ist "Ist-Radmoment" SLONG _CNV_R_R_Def_m_sw_q_554_CM 1 100. -214748364.8 214748364.7 DISPLAY_IDENTIFIER MD_RAD_IST ECU_ADDRESS 0xd000e06c FORMAT "%9.2" /end MEASUREMENT
/begin MEASUREMENT Md_rad_max "max Radmoment" SLONG _CNV_R_R_Def_m_sw_q_554_CM 1 100. -214748364.8 214748364.7 DISPLAY_IDENTIFIER MD_RAD_MAX ECU_ADDRESS 0xd000e068 FORMAT "%9.2" /end MEASUREMENT
/begin MEASUREMENT Md_rad_min "min Radmoment" SLONG _CNV_R_R_Def_m_sw_q_554_CM 1 100. -214748364.8 214748364.7 DISPLAY_IDENTIFIER MD_RAD_MIN ECU_ADDRESS 0xd000e064 FORMAT "%9.2" /end MEASUREMENT
/begin MEASUREMENT Md_rad_minti "min Radmoment mit Temperatureinfluss" SLONG _CNV_R_R_Def_m_sw_q_554_CM 1 100. -214748364.8 214748364.7 DISPLAY_IDENTIFIER MD_RAD_MINTI ECU_ADDRESS 0xd000e060 FORMAT "%9.2" /end MEASUREMENT
/begin MEASUREMENT Mdi_bas_hs "Basis-Moment in HS max. moegl. MDI bei aktuellem Rf" SWORD _CNV_R_R_Def_m_sw_q_554_CM 1 100. -3276.8 3276.7 DISPLAY_IDENTIFIER MDI_BAS_HS ECU_ADDRESS 0xd000de40 FORMAT "%7.2" /end MEASUREMENT
/begin MEASUREMENT Mdi_bas_s "Basis-Moment in S max. moegl. MDI bei aktuellem Rf" SWORD _CNV_R_R_Def_m_sw_q_554_CM 1 100. -3276.8 3276.7 DISPLAY_IDENTIFIER MDI_BAS_S ECU_ADDRESS 0xd000de3e FORMAT "%7.2" /end MEASUREMENT
/begin MEASUREMENT Mdi_dif "Differenz Ist Moment" SWORD _CNV_R_R_Def_m_sw_q_554_CM 1 100. -3276.8 3276.7 DISPLAY_IDENTIFIER MDI_DIF ECU_ADDRESS 0xd000ce10 FORMAT "%7.2" /end MEASUREMENT
/begin MEASUREMENT Mdi_dif_vz "Differenz Ist Moment verzögert" SWORD _CNV_R_R_Def_m_sw_q_554_CM 1 100. -3276.8 3276.7 DISPLAY_IDENTIFIER MDI_DIF_VZ ECU_ADDRESS 0xd000ce12 FORMAT "%7.2" /end MEASUREMENT
/begin MEASUREMENT Mdi_diftmp "Verzögertes Istmoment" SWORD _CNV_R_R_Def_m_sw_q_554_CM 1 100. -3276.8 3276.7 DISPLAY_IDENTIFIER MDI_DIFTMP ECU_ADDRESS 0xd000ce0e FORMAT "%7.2" /end MEASUREMENT
/begin MEASUREMENT Mdi_max_hs "max. moegl. MDI bei Sollfüllung in HS" SWORD _CNV_R_R_Def_m_sw_q_554_CM 1 100. -3276.8 3276.7 DISPLAY_IDENTIFIER MDI_MAX_HS ECU_ADDRESS 0xd000df7e FORMAT "%7.2" /end MEASUREMENT
/begin MEASUREMENT Mdi_max_s "Basis-Moment in S max. moegl. MDI bei aktuellem Rf" SWORD _CNV_R_R_Def_m_sw_q_554_CM 1 100. -3276.8 3276.7 DISPLAY_IDENTIFIER MDI_MAX_S ECU_ADDRESS 0xd000df80 FORMAT "%7.2" /end MEASUREMENT
/begin MEASUREMENT Mdi_min_ba "minimal mögliches MDI in HS bzw. S (abh. von BA_IST)" SWORD _CNV_R_R_Def_m_sw_q_554_CM 1 100. -3276.8 3276.7 DISPLAY_IDENTIFIER MDI_MIN_BA ECU_ADDRESS 0xd000df8c FORMAT "%7.2" /end MEASUREMENT
/begin MEASUREMENT Mdi_min_hs "minimal mögliches MDI in HS" SWORD _CNV_R_R_Def_m_sw_q_554_CM 1 100. -3276.8 3276.7 DISPLAY_IDENTIFIER MDI_MIN_HS ECU_ADDRESS 0xd000df5e FORMAT "%7.2" /end MEASUREMENT
/begin MEASUREMENT Mdi_min_s "minimal mögliches MDI in S" SWORD _CNV_R_R_Def_m_sw_q_554_CM 1 100. -3276.8 3276.7 DISPLAY_IDENTIFIER MDI_MIN_S ECU_ADDRESS 0xd000ddf4 FORMAT "%7.2" /end MEASUREMENT
/begin MEASUREMENT Mdi_minti "Moment bei Rf_min" SWORD _CNV_R_R_Def_m_sw_q_554_CM 1 100. -3276.8 3276.7 DISPLAY_IDENTIFIER MDI_MINTI ECU_ADDRESS 0xd000e05e FORMAT "%7.2" /end MEASUREMENT
/begin MEASUREMENT Mdi_ressoll "" SWORD _CNV_R_R_Def_m_sw_q_554_CM 1 100. -3276.8 3276.7 DISPLAY_IDENTIFIER MDI_RESSOLL ECU_ADDRESS 0xd000de3c FORMAT "%7.2" /end MEASUREMENT
/begin MEASUREMENT Mdi_zw_min "Minimales Zündwinkel, gefiltert" SWORD _CNV_R_R_Def_m_sw_q_554_CM 1 100. -3276.8 3276.7 DISPLAY_IDENTIFIER MDI_ZW_MIN ECU_ADDRESS 0xd000df94 FORMAT "%7.2" /end MEASUREMENT
/begin MEASUREMENT Mdi_zw_sollf "Minimales Zündwinkel, aus dem Filter" SWORD _CNV_R_R_Def_m_sw_q_554_CM 1 100. -3276.8 3276.7 DISPLAY_IDENTIFIER MDI_ZW_SOLLF ECU_ADDRESS 0xd000df90 FORMAT "%7.2" /end MEASUREMENT
/begin MEASUREMENT Mdi_zwmin_fil "Mdi_ist_m -> 0.0 Filter" SWORD _CNV_R_R_Def_m_sw_q_554_CM 1 100. -3276.8 3276.7 DISPLAY_IDENTIFIER MDI_ZWMIN_FIL ECU_ADDRESS 0xd000df92 FORMAT "%7.2" /end MEASUREMENT
/begin MEASUREMENT Mdk_ewp "Berechnetes Nutzmoment" SWORD _CNV_R_R_Def_m_sw_q_554_CM 1 100. -3276.8 3276.7 DISPLAY_IDENTIFIER MDK_EWP ECU_ADDRESS 0xc0007950 FORMAT "%7.2" /end MEASUREMENT
/begin MEASUREMENT Mdk_ewp_help "Hilfsgrösse für KF_GBTR" SWORD _CNV_R_R_Def_m_sw_q_554_CM 1 100. -3276.8 3276.7 DISPLAY_IDENTIFIER MDK_EWP_HELP ECU_ADDRESS 0xc0007980 FORMAT "%7.2" /end MEASUREMENT
/begin MEASUREMENT Mk_hom_soll_1 "Soll-Kraftstoffmasse Bank1 homogen" UWORD _CNV_R_R_Def_mk_uw__652_CM 1 100. 0. 1389. DISPLAY_IDENTIFIER MK_HOM_SOLL_1 ECU_ADDRESS 0xd000def8 FORMAT "%7.2" ARRAY_SIZE 3 MATRIX_DIM 3 1 1 /end MEASUREMENT
/begin MEASUREMENT Mk_hom_soll_2 "Soll-Kraftstoffmasse Bank2 homogen" UWORD _CNV_R_R_Def_mk_uw__652_CM 1 100. 0. 1389. DISPLAY_IDENTIFIER MK_HOM_SOLL_2 ECU_ADDRESS 0xd000defe FORMAT "%7.2" ARRAY_SIZE 3 MATRIX_DIM 3 1 1 /end MEASUREMENT
/begin MEASUREMENT Mk_soll_h "Soll-Kraftstoffmasse homogen zylinderindividuell" UWORD _CNV_R_R_Def_mk_uw__652_CM 1 100. 0. 1389. DISPLAY_IDENTIFIER MK_SOLL_H ECU_ADDRESS 0xd000df04 FORMAT "%7.2" ARRAY_SIZE 24 MATRIX_DIM 8 3 1 /end MEASUREMENT
/begin MEASUREMENT Mk_soll_s "Soll-Kraftstoffmasse schicht" UWORD _CNV_R_R_Def_mk_uw__652_CM 1 100. 0. 1389. DISPLAY_IDENTIFIER MK_SOLL_S ECU_ADDRESS 0xd000de5c FORMAT "%7.2" /end MEASUREMENT
/begin MEASUREMENT Mkzyl_soll_hs "Soll-Kraftstoffmasse homogen-schicht zylinderindividuell" UWORD _CNV_R_R_Def_mk_uw__652_CM 1 100. 0. 1389. DISPLAY_IDENTIFIER MKZYL_SOLL_HS ECU_ADDRESS 0xd000de90 FORMAT "%7.2" ARRAY_SIZE 16 MATRIX_DIM 8 2 1 /end MEASUREMENT
/begin MEASUREMENT Mkzyl_soll_s "Soll-Kraftstoffmasse schicht zylinderindividuell" UWORD _CNV_R_R_Def_mk_uw__652_CM 1 100. 0. 1389. DISPLAY_IDENTIFIER MKZYL_SOLL_S ECU_ADDRESS 0xd000de60 FORMAT "%7.2" ARRAY_SIZE 24 MATRIX_DIM 8 3 1 /end MEASUREMENT
/begin MEASUREMENT N5z_mw "Hier könnte Ihr Langbezeichner stehen" SWORD _CNV_R_R_Def_n_sw_b_658_CM 1 100. -256. 255.9921 DISPLAY_IDENTIFIER N5Z_MW ECU_ADDRESS 0xd000cd9c FORMAT "%5.0" /end MEASUREMENT
/begin MEASUREMENT Nd5z_f "Hier könnte Ihr Langbezeichner stehen" SWORD _CNV_R_R_Def_n_sw_b_658_CM 1 100. -256. 255.9921 DISPLAY_IDENTIFIER ND5Z_F ECU_ADDRESS 0xd000cda0 FORMAT "%5.0" ARRAY_SIZE 24 MATRIX_DIM 24 1 1 /end MEASUREMENT
/begin MEASUREMENT Nd5z_fil "Interne Filtergröße für Filter" SLONG _CNV_R_R_Def_n_sl_q_660_CM 1 100. -2147483.648 2147483.647 DISPLAY_IDENTIFIER ND5Z_FIL ECU_ADDRESS 0xd000ccf0 FORMAT "%7.0" ARRAY_SIZE 24 MATRIX_DIM 24 1 1 /end MEASUREMENT
/begin MEASUREMENT Nkw_grad_fpt1 "Nkw-Gradient PT1 gefiltert" SBYTE _CNV_R_R_Def_ngrd_s_661_CM 1 100. -4096. 4064. DISPLAY_IDENTIFIER NKW_GRAD_FPT1 ECU_ADDRESS 0xd000e051 FORMAT "%5.2" /end MEASUREMENT
/begin MEASUREMENT Nkw_help_pe "Hilfsgrösse für Pe Berechnung" UWORD _CNV_R_R_Def_f_uw_b_571_CM 1 100. 0. 0.9999847412109381 DISPLAY_IDENTIFIER NKW_HELP_PE ECU_ADDRESS 0xc0007996 FORMAT "%14.5" /end MEASUREMENT
/begin MEASUREMENT Pe "Effektive Motorleistung" UWORD _CNV_R_R_Def_pe_uw__678_CM 1 100. 0. 999.9847 DISPLAY_IDENTIFIER PE ECU_ADDRESS 0xc0007998 FORMAT "%8.3" /end MEASUREMENT
/begin MEASUREMENT Prail_h "Sollwert Raildruck aus KF_PRAIL_H" UWORD _CNV_R_R_Def_p_uw_q_676_CM 1 100. 0. 39.9993 DISPLAY_IDENTIFIER PRAIL_H ECU_ADDRESS 0xd000e70a FORMAT "%9.4" /end MEASUREMENT
/begin MEASUREMENT Prail_hs "Sollwert Raildruck aus KF_PRAIL_HS" UWORD _CNV_R_R_Def_p_uw_q_676_CM 1 100. 0. 39.9993 DISPLAY_IDENTIFIER PRAIL_HS ECU_ADDRESS 0xd000e70c FORMAT "%9.4" /end MEASUREMENT
/begin MEASUREMENT Prail_hs_min "Untere Raildruckgrenze zu Umschaltung in HS" UWORD _CNV_R_R_Def_p_uw_q_676_CM 1 100. 0. 39.9993 DISPLAY_IDENTIFIER PRAIL_HS_MIN ECU_ADDRESS 0xd000e710 FORMAT "%9.4" /end MEASUREMENT
/begin MEASUREMENT Prail_out_s "Raildruck setpoint for stratified mode,high range" UWORD _CNV_R_R_Def_p_uw_q_676_CM 1 100. 0. 39.9993 DISPLAY_IDENTIFIER PRAIL_OUT_S ECU_ADDRESS 0xd000e706 FORMAT "%9.4" /end MEASUREMENT
/begin MEASUREMENT Prail_s "Sollwert Raildruck aus KF_PRAIL_S" UWORD _CNV_R_R_Def_p_uw_q_676_CM 1 100. 0. 39.9993 DISPLAY_IDENTIFIER PRAIL_S ECU_ADDRESS 0xd000e70e FORMAT "%9.4" /end MEASUREMENT
/begin MEASUREMENT Prail_s_min "Untere Raildruckgrenze zu Umschaltung in Schicht" UWORD _CNV_R_R_Def_p_uw_q_676_CM 1 100. 0. 39.9993 DISPLAY_IDENTIFIER PRAIL_S_MIN ECU_ADDRESS 0xd000e712 FORMAT "%9.4" /end MEASUREMENT
/begin MEASUREMENT Prail_schalt "Ausgang Umschalter Raildruck" UWORD _CNV_R_R_Def_p_uw_q_676_CM 1 100. 0. 39.9993 DISPLAY_IDENTIFIER PRAIL_SCHALT ECU_ADDRESS 0xd000e714 FORMAT "%9.4" /end MEASUREMENT
/begin MEASUREMENT Prail_soll "Sollwert für Raildruckregler" UWORD _CNV_R_R_Def_p_uw_q_676_CM 1 100. 0. 39.9993 DISPLAY_IDENTIFIER PRAIL_SOLL ECU_ADDRESS 0xd000e704 FORMAT "%9.4" /end MEASUREMENT
/begin MEASUREMENT Prail_sw "Sollwert für Raildruckregler" UWORD _CNV_R_R_Def_p_uw_q_676_CM 1 100. 0. 39.9993 DISPLAY_IDENTIFIER PRAIL_SW ECU_ADDRESS 0xd000e702 FORMAT "%9.4" /end MEASUREMENT
/begin MEASUREMENT Rf_agr_s "Reletive Füllung Androsseln wegen AGR in Schicht" SWORD _CNV_R_R_Def_rf_sw__598_CM 1 100. -327.68 327.67 DISPLAY_IDENTIFIER RF_AGR_S ECU_ADDRESS 0xd000dffe FORMAT "%9.4" /end MEASUREMENT
/begin MEASUREMENT Rf_bas_hs "Soll-Luftmasse (homogen-schicht)" SWORD _CNV_R_R_Def_rf_sw__598_CM 1 100. -327.68 327.67 DISPLAY_IDENTIFIER RF_BAS_HS ECU_ADDRESS 0xd000df88 FORMAT "%9.4" /end MEASUREMENT
/begin MEASUREMENT Rf_bas_s "Soll-Rf (schicht)" SWORD _CNV_R_R_Def_rf_sw__598_CM 1 100. -327.68 327.67 DISPLAY_IDENTIFIER RF_BAS_S ECU_ADDRESS 0xd000dfd2 FORMAT "%9.4" /end MEASUREMENT
/begin MEASUREMENT Rf_kh_s "Soll-Luftmasse durch KH (schicht)" SWORD _CNV_R_R_Def_rf_sw__598_CM 1 100. -327.68 327.67 DISPLAY_IDENTIFIER RF_KH_S ECU_ADDRESS 0xd000df86 FORMAT "%9.4" /end MEASUREMENT
/begin MEASUREMENT Rf_lasoll_h "Sollfüllung Lambda prio Pfad" SWORD _CNV_R_R_Def_rf_sw__598_CM 1 100. -327.68 327.67 DISPLAY_IDENTIFIER RF_LASOLL_H ECU_ADDRESS 0xd000e01c FORMAT "%9.4" /end MEASUREMENT
/begin MEASUREMENT Rf_max "max. mögliche Füllung zur Rf_soll Begrenzung" SWORD _CNV_R_R_Def_rf_sw__598_CM 1 100. -327.68 327.67 DISPLAY_IDENTIFIER RF_MAX ECU_ADDRESS 0xd000e01e FORMAT "%9.4" /end MEASUREMENT
/begin MEASUREMENT Rf_mdsoll_h "Sollfüllung MD prio Pfad" SWORD _CNV_R_R_Def_rf_sw__598_CM 1 100. -327.68 327.67 DISPLAY_IDENTIFIER RF_MDSOLL_H ECU_ADDRESS 0xd000e01a FORMAT "%9.4" /end MEASUREMENT
/begin MEASUREMENT Rf_min "minimales Rf" SWORD _CNV_R_R_Def_rf_sw__598_CM 1 100. -327.68 327.67 DISPLAY_IDENTIFIER RF_MIN ECU_ADDRESS 0xd000de38 FORMAT "%9.4" /end MEASUREMENT
/begin MEASUREMENT Rf_opt_hs "Optimales Rf (homogen-schicht)" SWORD _CNV_R_R_Def_rf_sw__598_CM 1 100. -327.68 327.67 DISPLAY_IDENTIFIER RF_OPT_HS ECU_ADDRESS 0xd000dfe2 FORMAT "%9.4" /end MEASUREMENT
/begin MEASUREMENT Rf_opt_s "Optimales Rf (schicht)" SWORD _CNV_R_R_Def_rf_sw__598_CM 1 100. -327.68 327.67 DISPLAY_IDENTIFIER RF_OPT_S ECU_ADDRESS 0xd000dfd0 FORMAT "%9.4" /end MEASUREMENT
/begin MEASUREMENT Rf_optres_hs "Optimales Rf (homogen-schicht)" SWORD _CNV_R_R_Def_rf_sw__598_CM 1 100. -327.68 327.67 DISPLAY_IDENTIFIER RF_OPTRES_HS ECU_ADDRESS 0xd000dfe6 FORMAT "%9.4" /end MEASUREMENT
/begin MEASUREMENT Rf_optres_s "Optimales Rf (schicht)" SWORD _CNV_R_R_Def_rf_sw__598_CM 1 100. -327.68 327.67 DISPLAY_IDENTIFIER RF_OPTRES_S ECU_ADDRESS 0xd000dfe4 FORMAT "%9.4" /end MEASUREMENT
/begin MEASUREMENT Rf_res_hs "Sollfüllung wg. MD-Reserve in HS" SWORD _CNV_R_R_Def_rf_sw__598_CM 1 100. -327.68 327.67 DISPLAY_IDENTIFIER RF_RES_HS ECU_ADDRESS 0xd000dfde FORMAT "%9.4" /end MEASUREMENT
/begin MEASUREMENT Rf_res_s "Sollfüllung wg. MD-Reserve in S" SWORD _CNV_R_R_Def_rf_sw__598_CM 1 100. -327.68 327.67 DISPLAY_IDENTIFIER RF_RES_S ECU_ADDRESS 0xd000dfd8 FORMAT "%9.4" /end MEASUREMENT
/begin MEASUREMENT Rf_resmax_ba "Maximale zulaessige Fuellung BA abhängig" SWORD _CNV_R_R_Def_rf_sw__598_CM 1 100. -327.68 327.67 DISPLAY_IDENTIFIER RF_RESMAX_BA ECU_ADDRESS 0xd000dfe8 FORMAT "%9.4" /end MEASUREMENT
/begin MEASUREMENT Rf_resmax_hs "Max zul. Füllung um MD noch stellen zu können in HS" SWORD _CNV_R_R_Def_rf_sw__598_CM 1 100. -327.68 327.67 DISPLAY_IDENTIFIER RF_RESMAX_HS ECU_ADDRESS 0xd000dfdc FORMAT "%9.4" /end MEASUREMENT
/begin MEASUREMENT Rf_resmax_s "Max zul. Füllung um MD noch stellen zu können in S" SWORD _CNV_R_R_Def_rf_sw__598_CM 1 100. -327.68 327.67 DISPLAY_IDENTIFIER RF_RESMAX_S ECU_ADDRESS 0xd000dfd6 FORMAT "%9.4" /end MEASUREMENT
/begin MEASUREMENT Rf_resmin_hs "notwendige Füllung um MDRES zu stellen in HS" SWORD _CNV_R_R_Def_rf_sw__598_CM 1 100. -327.68 327.67 DISPLAY_IDENTIFIER RF_RESMIN_HS ECU_ADDRESS 0xd000dfda FORMAT "%9.4" /end MEASUREMENT
/begin MEASUREMENT Rf_resmin_s "notwendige Füllung um MDRES zu stellen in S" SWORD _CNV_R_R_Def_rf_sw__598_CM 1 100. -327.68 327.67 DISPLAY_IDENTIFIER RF_RESMIN_S ECU_ADDRESS 0xd000dfd4 FORMAT "%9.4" /end MEASUREMENT
/begin MEASUREMENT Rf_soll "Soll Rf des Momentenmanagers" SWORD _CNV_R_R_Def_rf_sw__598_CM 1 100. -327.68 327.67 DISPLAY_IDENTIFIER RF_SOLL ECU_ADDRESS 0xd000de36 FORMAT "%9.4" /end MEASUREMENT
/begin MEASUREMENT Rf_soll_h "Soll Rf des Momentenmanagers (homogen)" SWORD _CNV_R_R_Def_rf_sw__598_CM 1 100. -327.68 327.67 DISPLAY_IDENTIFIER RF_SOLL_H ECU_ADDRESS 0xd000de4e FORMAT "%9.4" /end MEASUREMENT
/begin MEASUREMENT Rf_soll_hs "Soll Rf des Momentenmanagers (homogen-schicht)" SWORD _CNV_R_R_Def_rf_sw__598_CM 1 100. -327.68 327.67 DISPLAY_IDENTIFIER RF_SOLL_HS ECU_ADDRESS 0xd000de4c FORMAT "%9.4" /end MEASUREMENT
/begin MEASUREMENT Rf_soll_s "Soll Rf des Momentenmanagers (schicht)" SWORD _CNV_R_R_Def_rf_sw__598_CM 1 100. -327.68 327.67 DISPLAY_IDENTIFIER RF_SOLL_S ECU_ADDRESS 0xd000de4a FORMAT "%9.4" /end MEASUREMENT
/begin MEASUREMENT Rf_te_s "Rf wegen TE im Schicht" SWORD _CNV_R_R_Def_rf_sw__598_CM 1 100. -327.68 327.67 DISPLAY_IDENTIFIER RF_TE_S ECU_ADDRESS 0xd000df98 FORMAT "%9.4" /end MEASUREMENT
/begin MEASUREMENT Rfgrdmax "Rf_soll Filterung Gradient" SWORD _CNV_R_R_Def_rf_sw__598_CM 1 100. -327.68 327.67 DISPLAY_IDENTIFIER RFGRDMAX ECU_ADDRESS 0xd000e000 FORMAT "%9.4" /end MEASUREMENT
/begin MEASUREMENT Rfmin_kh_s "Minimale Soll-Luftmasse durch KH (schicht)" SWORD _CNV_R_R_Def_rf_sw__598_CM 1 100. -327.68 327.67 DISPLAY_IDENTIFIER RFMIN_KH_S ECU_ADDRESS 0xd000df84 FORMAT "%9.4" /end MEASUREMENT
/begin MEASUREMENT Rfmin_te_s "Minimales Rf wegen TE im Schicht" SWORD _CNV_R_R_Def_rf_sw__598_CM 1 100. -327.68 327.67 DISPLAY_IDENTIFIER RFMIN_TE_S ECU_ADDRESS 0xd000df9a FORMAT "%9.4" /end MEASUREMENT
/begin MEASUREMENT Rk1_hs "rel. Kraftstoffmenge erste Einspritzung HS" SWORD _CNV_R_R_Def_rk_sw__600_CM 1 100. -1600. 1599.9511 DISPLAY_IDENTIFIER RK1_HS ECU_ADDRESS 0xd000dfb8 FORMAT "%8.3" /end MEASUREMENT
/begin MEASUREMENT Rk1_s "rel. Kraftstoffmenge erste Einspritzung S" SWORD _CNV_R_R_Def_rk_sw__600_CM 1 100. -1600. 1599.9511 DISPLAY_IDENTIFIER RK1_S ECU_ADDRESS 0xd000dfb2 FORMAT "%8.3" /end MEASUREMENT
/begin MEASUREMENT Rk1_tmp_hs "rel. Kraftstoffmenge erste Einspritzung ohne Rktev Berücksichtigung HS" SWORD _CNV_R_R_Def_rk_sw__600_CM 1 100. -1600. 1599.9511 DISPLAY_IDENTIFIER RK1_TMP_HS ECU_ADDRESS 0xd000dfba FORMAT "%8.3" /end MEASUREMENT
/begin MEASUREMENT Rk1_tmp_s "rel. Kraftstoffmenge erste Einspritzung ohne Rktev Berücksichtigung S" SWORD _CNV_R_R_Def_rk_sw__600_CM 1 100. -1600. 1599.9511 DISPLAY_IDENTIFIER RK1_TMP_S ECU_ADDRESS 0xd000dfb4 FORMAT "%8.3" /end MEASUREMENT
/begin MEASUREMENT Rk2_hs "rel. Kraftstoffmenge zweite Einspritzung HS" SWORD _CNV_R_R_Def_rk_sw__600_CM 1 100. -1600. 1599.9511 DISPLAY_IDENTIFIER RK2_HS ECU_ADDRESS 0xd000dfbc FORMAT "%8.3" /end MEASUREMENT
/begin MEASUREMENT Rk2_s "rel. Kraftstoffmenge zweite Einspritzung S" SWORD _CNV_R_R_Def_rk_sw__600_CM 1 100. -1600. 1599.9511 DISPLAY_IDENTIFIER RK2_S ECU_ADDRESS 0xd000dfb6 FORMAT "%8.3" /end MEASUREMENT
/begin MEASUREMENT Rk2_soll_2h "Kraftstoffmenge 2te Einspritzung bei 2fach Einspritzung" SWORD _CNV_R_R_Def_rk_sw__600_CM 1 100. -1600. 1599.9511 DISPLAY_IDENTIFIER RK2_SOLL_2H ECU_ADDRESS 0xd000de2a FORMAT "%8.3" ARRAY_SIZE 2 MATRIX_DIM 2 1 1 /end MEASUREMENT
/begin MEASUREMENT Rk2_soll_3h "Kraftstoffmenge 2te Einspritzung bei 3fach Einspritzung" SWORD _CNV_R_R_Def_rk_sw__600_CM 1 100. -1600. 1599.9511 DISPLAY_IDENTIFIER RK2_SOLL_3H ECU_ADDRESS 0xd000de2e FORMAT "%8.3" ARRAY_SIZE 2 MATRIX_DIM 2 1 1 /end MEASUREMENT
/begin MEASUREMENT Rk2_soll_st "rel. Kraftstoffmenge zweite Einspritzung im Start" SWORD _CNV_R_R_Def_rk_sw__600_CM 1 100. -1600. 1599.9511 DISPLAY_IDENTIFIER RK2_SOLL_ST ECU_ADDRESS 0xd000de28 FORMAT "%8.3" /end MEASUREMENT
/begin MEASUREMENT Rk2_sollkh_h "rel. Kraftstoffmenge zweite Einspritzung Katheizen" SWORD _CNV_R_R_Def_rk_sw__600_CM 1 100. -1600. 1599.9511 DISPLAY_IDENTIFIER RK2_SOLLKH_H ECU_ADDRESS 0xd000de24 FORMAT "%8.3" /end MEASUREMENT
/begin MEASUREMENT Rk2kor_kh_h "RK f. 2. Einspritzung im Homogen Modus zum Katheizen (korrigiert)" SWORD _CNV_R_R_Def_rk_sw__600_CM 1 100. -1600. 1599.9511 DISPLAY_IDENTIFIER RK2KOR_KH_H ECU_ADDRESS 0xd000de26 FORMAT "%8.3" /end MEASUREMENT
/begin MEASUREMENT Rk3_khkh_s "Anteil rel. Kraftstoffmenge aus 3. Einspr. S zum Katheize" SWORD _CNV_R_R_Def_rk_sw__600_CM 1 100. -1600. 1599.9511 DISPLAY_IDENTIFIER RK3_KHKH_S ECU_ADDRESS 0xd000de08 FORMAT "%8.3" /end MEASUREMENT
/begin MEASUREMENT Rk3_khmdi_s "Rk_soll KH für 3. Einspritzung (schicht)" SWORD _CNV_R_R_Def_rk_sw__600_CM 1 100. -1600. 1599.9511 DISPLAY_IDENTIFIER RK3_KHMDI_S ECU_ADDRESS 0xd000df3e FORMAT "%8.3" /end MEASUREMENT
/begin MEASUREMENT Rk3_khsoll_s "Rk3_khsoll_s" SWORD _CNV_R_R_Def_rk_sw__600_CM 1 100. -1600. 1599.9511 DISPLAY_IDENTIFIER RK3_KHSOLL_S ECU_ADDRESS 0xd000dffa FORMAT "%8.3" /end MEASUREMENT
/begin MEASUREMENT Rk3_soll_3h "Kraftstoffmenge 3te Einspritzung bei 3fach Einspritzung" SWORD _CNV_R_R_Def_rk_sw__600_CM 1 100. -1600. 1599.9511 DISPLAY_IDENTIFIER RK3_SOLL_3H ECU_ADDRESS 0xd000de32 FORMAT "%8.3" ARRAY_SIZE 2 MATRIX_DIM 2 1 1 /end MEASUREMENT
/begin MEASUREMENT Rk3_soll_s "Rk_soll KH für 3. Einspritzung (schicht)" SWORD _CNV_R_R_Def_rk_sw__600_CM 1 100. -1600. 1599.9511 DISPLAY_IDENTIFIER RK3_SOLL_S ECU_ADDRESS 0xd000df40 FORMAT "%8.3" /end MEASUREMENT
/begin MEASUREMENT Rk3maxmdi "Maximal mögliches Rk_soll für 3. Einspritzung (schicht)" SWORD _CNV_R_R_Def_rk_sw__600_CM 1 100. -1600. 1599.9511 DISPLAY_IDENTIFIER RK3MAXMDI ECU_ADDRESS 0xd000df3c FORMAT "%8.3" /end MEASUREMENT
/begin MEASUREMENT Rk_add_inst "DI-Wandfilm gefiltert" SWORD _CNV_R_R_Def_rk_sw__600_CM 1 100. -1600. 1599.9511 DISPLAY_IDENTIFIER RK_ADD_INST ECU_ADDRESS 0xd000de04 FORMAT "%8.3" /end MEASUREMENT
/begin MEASUREMENT Rk_addinst_roh "Rk_add_inst vor Filter (DI-Wandfilm)" SWORD _CNV_R_R_Def_rk_sw__600_CM 1 100. -1600. 1599.9511 DISPLAY_IDENTIFIER RK_ADDINST_ROH ECU_ADDRESS 0xd000de02 FORMAT "%8.3" /end MEASUREMENT
/begin MEASUREMENT Rk_bas_h "rel. Kraftstoffmenge ohne Korrekturen Homogen (Bankweise)" SWORD _CNV_R_R_Def_rk_sw__600_CM 1 100. -1600. 1599.9511 DISPLAY_IDENTIFIER RK_BAS_H ECU_ADDRESS 0xd000de0e FORMAT "%8.3" ARRAY_SIZE 2 MATRIX_DIM 2 1 1 /end MEASUREMENT
/begin MEASUREMENT Rk_bas_hs "Optimales Rk_soll ohne Mdi_bas-Begrenzung (homogen-schicht)" SWORD _CNV_R_R_Def_rk_sw__600_CM 1 100. -1600. 1599.9511 DISPLAY_IDENTIFIER RK_BAS_HS ECU_ADDRESS 0xd000df82 FORMAT "%8.3" /end MEASUREMENT
/begin MEASUREMENT Rk_bas_s "Soll-Rk (schicht)" SWORD _CNV_R_R_Def_rk_sw__600_CM 1 100. -1600. 1599.9511 DISPLAY_IDENTIFIER RK_BAS_S ECU_ADDRESS 0xd000dfe0 FORMAT "%8.3" /end MEASUREMENT
/begin MEASUREMENT Rk_kh "rel. Kraftstoffmenge zum Katheize durch Nacheinspritzung bzw. unverbrannten Kraftstoff" SWORD _CNV_R_R_Def_rk_sw__600_CM 1 100. -1600. 1599.9511 DISPLAY_IDENTIFIER RK_KH ECU_ADDRESS 0xd000de06 FORMAT "%8.3" /end MEASUREMENT
/begin MEASUREMENT Rk_kor_h "Rk_soll mit Wirkungsgrad korrigiert (homogen)" SWORD _CNV_R_R_Def_rk_sw__600_CM 1 100. -1600. 1599.9511 DISPLAY_IDENTIFIER RK_KOR_H ECU_ADDRESS 0xd000df36 FORMAT "%8.3" /end MEASUREMENT
/begin MEASUREMENT Rk_kor_hs "Korrigiertes Rk_soll (homogen-schicht)" SWORD _CNV_R_R_Def_rk_sw__600_CM 1 100. -1600. 1599.9511 DISPLAY_IDENTIFIER RK_KOR_HS ECU_ADDRESS 0xd000df3a FORMAT "%8.3" /end MEASUREMENT
/begin MEASUREMENT Rk_kor_s "Korrigiertes Rk_soll (schicht)" SWORD _CNV_R_R_Def_rk_sw__600_CM 1 100. -1600. 1599.9511 DISPLAY_IDENTIFIER RK_KOR_S ECU_ADDRESS 0xd000df38 FORMAT "%8.3" /end MEASUREMENT
/begin MEASUREMENT Rk_kormd_h "Sollkraftstoffmasse MD-Prior vor Begrenzung" SWORD _CNV_R_R_Def_rk_sw__600_CM 1 100. -1600. 1599.9511 DISPLAY_IDENTIFIER RK_KORMD_H ECU_ADDRESS 0xd000e002 FORMAT "%8.3" /end MEASUREMENT
/begin MEASUREMENT Rk_korres_hs "Korrigiertes Rk_soll mit Momentenreserve (homogen-schicht)" SWORD _CNV_R_R_Def_rk_sw__600_CM 1 100. -1600. 1599.9511 DISPLAY_IDENTIFIER RK_KORRES_HS ECU_ADDRESS 0xd000de48 FORMAT "%8.3" /end MEASUREMENT
/begin MEASUREMENT Rk_korres_s "Korrigiertes Rk_soll mit Momentenreserve (schicht)" SWORD _CNV_R_R_Def_rk_sw__600_CM 1 100. -1600. 1599.9511 DISPLAY_IDENTIFIER RK_KORRES_S ECU_ADDRESS 0xd000de46 FORMAT "%8.3" /end MEASUREMENT
/begin MEASUREMENT Rk_korzw_h "Soll-Kraftstoffmasse ZW-korrigiert (homogen)" SWORD _CNV_R_R_Def_rk_sw__600_CM 1 100. -1600. 1599.9511 DISPLAY_IDENTIFIER RK_KORZW_H ECU_ADDRESS 0xd000df8a FORMAT "%8.3" /end MEASUREMENT
/begin MEASUREMENT Rk_lamreg "rel. Kraftstoffmenge aus Lambdaregelung" SWORD _CNV_R_R_Def_rk_sw__600_CM 1 100. -1600. 1599.9511 DISPLAY_IDENTIFIER RK_LAMREG ECU_ADDRESS 0xd000dfbe FORMAT "%8.3" ARRAY_SIZE 2 MATRIX_DIM 2 1 1 /end MEASUREMENT
/begin MEASUREMENT Rk_laprio_h "rel. Kraftstoffmasse mit Lambda priorisiert bankweise (homogen)" SWORD _CNV_R_R_Def_rk_sw__600_CM 1 100. -1600. 1599.9511 DISPLAY_IDENTIFIER RK_LAPRIO_H ECU_ADDRESS 0xd000dfaa FORMAT "%8.3" ARRAY_SIZE 2 MATRIX_DIM 2 1 1 /end MEASUREMENT
/begin MEASUREMENT Rk_max_h "maximales Rk_soll (homogen)" SWORD _CNV_R_R_Def_rk_sw__600_CM 1 100. -1600. 1599.9511 DISPLAY_IDENTIFIER RK_MAX_H ECU_ADDRESS 0xd000dfae FORMAT "%8.3" /end MEASUREMENT
/begin MEASUREMENT Rk_maxbg_hs "Maximale Begrenzung Rk_soll (homogen-schicht)" SWORD _CNV_R_R_Def_rk_sw__600_CM 1 100. -1600. 1599.9511 DISPLAY_IDENTIFIER RK_MAXBG_HS ECU_ADDRESS 0xd000de44 FORMAT "%8.3" /end MEASUREMENT
/begin MEASUREMENT Rk_maxbg_s "Maximale Begrenzung Rk_soll (schicht)" SWORD _CNV_R_R_Def_rk_sw__600_CM 1 100. -1600. 1599.9511 DISPLAY_IDENTIFIER RK_MAXBG_S ECU_ADDRESS 0xd000de42 FORMAT "%8.3" /end MEASUREMENT
/begin MEASUREMENT Rk_mdprio_h "MD-Prio Rk_soll (homogen)" SWORD _CNV_R_R_Def_rk_sw__600_CM 1 100. -1600. 1599.9511 DISPLAY_IDENTIFIER RK_MDPRIO_H ECU_ADDRESS 0xd000dfb0 FORMAT "%8.3" /end MEASUREMENT
/begin MEASUREMENT Rk_min_h "minimales Rk_soll (homogen)" SWORD _CNV_R_R_Def_rk_sw__600_CM 1 100. -1600. 1599.9511 DISPLAY_IDENTIFIER RK_MIN_H ECU_ADDRESS 0xd000df48 FORMAT "%8.3" /end MEASUREMENT
/begin MEASUREMENT Rk_minbg_hs "Minimale Begrenzung Rk_soll (homogen-schicht)" SWORD _CNV_R_R_Def_rk_sw__600_CM 1 100. -1600. 1599.9511 DISPLAY_IDENTIFIER RK_MINBG_HS ECU_ADDRESS 0xd000df4a FORMAT "%8.3" /end MEASUREMENT
/begin MEASUREMENT Rk_minbg_s "Minimale Begrenzung Rk_soll (schicht)" SWORD _CNV_R_R_Def_rk_sw__600_CM 1 100. -1600. 1599.9511 DISPLAY_IDENTIFIER RK_MINBG_S ECU_ADDRESS 0xd000dfc2 FORMAT "%8.3" /end MEASUREMENT
/begin MEASUREMENT Rk_opt_hs "Optimales Rk_soll (homogen-schicht)" SWORD _CNV_R_R_Def_rk_sw__600_CM 1 100. -1600. 1599.9511 DISPLAY_IDENTIFIER RK_OPT_HS ECU_ADDRESS 0xd000dfc6 FORMAT "%8.3" /end MEASUREMENT
/begin MEASUREMENT Rk_opt_s "Optimales Rk_soll (schicht)" SWORD _CNV_R_R_Def_rk_sw__600_CM 1 100. -1600. 1599.9511 DISPLAY_IDENTIFIER RK_OPT_S ECU_ADDRESS 0xd000dfc4 FORMAT "%8.3" /end MEASUREMENT
/begin MEASUREMENT Rk_optres_hs "Optimales Rk_soll mit Momentenreserve (homogen-schicht)" SWORD _CNV_R_R_Def_rk_sw__600_CM 1 100. -1600. 1599.9511 DISPLAY_IDENTIFIER RK_OPTRES_HS ECU_ADDRESS 0xd000dfca FORMAT "%8.3" /end MEASUREMENT
/begin MEASUREMENT Rk_optres_s "Optimales Rk_soll mit Momentenreserve (schicht)" SWORD _CNV_R_R_Def_rk_sw__600_CM 1 100. -1600. 1599.9511 DISPLAY_IDENTIFIER RK_OPTRES_S ECU_ADDRESS 0xd000dfc8 FORMAT "%8.3" /end MEASUREMENT
/begin MEASUREMENT Rk_soll "rel Soll-Kraftstoffmasse" SWORD _CNV_R_R_Def_rk_sw__600_CM 1 100. -1600. 1599.9511 DISPLAY_IDENTIFIER RK_SOLL ECU_ADDRESS 0xd000de00 FORMAT "%8.3" /end MEASUREMENT
/begin MEASUREMENT Rk_soll_h "rel Soll-Kraftstoffmasse (homogen)" SWORD _CNV_R_R_Def_rk_sw__600_CM 1 100. -1600. 1599.9511 DISPLAY_IDENTIFIER RK_SOLL_H ECU_ADDRESS 0xd000df44 FORMAT "%8.3" /end MEASUREMENT
/begin MEASUREMENT Rk_soll_hs "rel Soll-Kraftstoffmasse (homogen-schicht)" SWORD _CNV_R_R_Def_rk_sw__600_CM 1 100. -1600. 1599.9511 DISPLAY_IDENTIFIER RK_SOLL_HS ECU_ADDRESS 0xd000df46 FORMAT "%8.3" /end MEASUREMENT
/begin MEASUREMENT Rk_soll_s "rel Soll-Kraftstoffmasse (schicht)" SWORD _CNV_R_R_Def_rk_sw__600_CM 1 100. -1600. 1599.9511 DISPLAY_IDENTIFIER RK_SOLL_S ECU_ADDRESS 0xd000df34 FORMAT "%8.3" /end MEASUREMENT
/begin MEASUREMENT Rk_sollm_h "Relative Kraftstoffmasse Mittelwert (homogen)" SWORD _CNV_R_R_Def_rk_sw__600_CM 1 100. -1600. 1599.9511 DISPLAY_IDENTIFIER RK_SOLLM_H ECU_ADDRESS 0xd000de22 FORMAT "%8.3" /end MEASUREMENT
/begin MEASUREMENT Rk_sollm_hs "" SWORD _CNV_R_R_Def_rk_sw__600_CM 1 100. -1600. 1599.9511 DISPLAY_IDENTIFIER RK_SOLLM_HS ECU_ADDRESS 0xd000de0c FORMAT "%8.3" /end MEASUREMENT
/begin MEASUREMENT Rk_sollm_s "" SWORD _CNV_R_R_Def_rk_sw__600_CM 1 100. -1600. 1599.9511 DISPLAY_IDENTIFIER RK_SOLLM_S ECU_ADDRESS 0xd000de0a FORMAT "%8.3" /end MEASUREMENT
/begin MEASUREMENT Rk_sollstart "rel Soll-Kraftstoffmasse im Start" SWORD _CNV_R_R_Def_rk_sw__600_CM 1 100. -1600. 1599.9511 DISPLAY_IDENTIFIER RK_SOLLSTART ECU_ADDRESS 0xd000dfa2 FORMAT "%8.3" /end MEASUREMENT
/begin MEASUREMENT Rk_solltmp_s "Rk_soll Zwischengröße (schicht)" SWORD _CNV_R_R_Def_rk_sw__600_CM 1 100. -1600. 1599.9511 DISPLAY_IDENTIFIER RK_SOLLTMP_S ECU_ADDRESS 0xd000df42 FORMAT "%8.3" /end MEASUREMENT
/begin MEASUREMENT Rk_vlo_hs "Betriebsartgrenze HS aus Brennverfahrens-/MD-Gründen" SWORD _CNV_R_R_Def_rk_sw__600_CM 1 100. -1600. 1599.9511 DISPLAY_IDENTIFIER RK_VLO_HS ECU_ADDRESS 0xd000df70 FORMAT "%8.3" /end MEASUREMENT
/begin MEASUREMENT Rk_vlo_s "Betriebsartgrenze S aus Brennverfahrens-/MD-Gründen" SWORD _CNV_R_R_Def_rk_sw__600_CM 1 100. -1600. 1599.9511 DISPLAY_IDENTIFIER RK_VLO_S ECU_ADDRESS 0xd000df6e FORMAT "%8.3" /end MEASUREMENT
/begin MEASUREMENT Rk_vlu_hs "Betriebsartgrenze HS wieder möglich" SWORD _CNV_R_R_Def_rk_sw__600_CM 1 100. -1600. 1599.9511 DISPLAY_IDENTIFIER RK_VLU_HS ECU_ADDRESS 0xd000dfce FORMAT "%8.3" /end MEASUREMENT
/begin MEASUREMENT Rk_vlu_s "Betriebsartgrenze S wieder möglich" SWORD _CNV_R_R_Def_rk_sw__600_CM 1 100. -1600. 1599.9511 DISPLAY_IDENTIFIER RK_VLU_S ECU_ADDRESS 0xd000dfcc FORMAT "%8.3" /end MEASUREMENT
/begin MEASUREMENT Rksoll_h "Relative Kraftstoffmasse bankweise (homogen)" SWORD _CNV_R_R_Def_rk_sw__600_CM 1 100. -1600. 1599.9511 DISPLAY_IDENTIFIER RKSOLL_H ECU_ADDRESS 0xd000de1e FORMAT "%8.3" ARRAY_SIZE 2 MATRIX_DIM 2 1 1 /end MEASUREMENT
/begin MEASUREMENT Rksoll_h1 "Relative Kraftstoffmasse Bank1 je Einspritzung (homogen)" SWORD _CNV_R_R_Def_rk_sw__600_CM 1 100. -1600. 1599.9511 DISPLAY_IDENTIFIER RKSOLL_H1 ECU_ADDRESS 0xd000de12 FORMAT "%8.3" ARRAY_SIZE 3 MATRIX_DIM 3 1 1 /end MEASUREMENT
/begin MEASUREMENT Rksoll_h2 "Relative Kraftstoffmasse Bank2 je Einspritzung (homogen)" SWORD _CNV_R_R_Def_rk_sw__600_CM 1 100. -1600. 1599.9511 DISPLAY_IDENTIFIER RKSOLL_H2 ECU_ADDRESS 0xd000de18 FORMAT "%8.3" ARRAY_SIZE 3 MATRIX_DIM 3 1 1 /end MEASUREMENT
/begin MEASUREMENT Rksoll_hs "Relative Soll-Kraftstoffmasse je Einspritzung (homogen-schicht)" SWORD _CNV_R_R_Def_rk_sw__600_CM 1 100. -1600. 1599.9511 DISPLAY_IDENTIFIER RKSOLL_HS ECU_ADDRESS 0xd000ded4 FORMAT "%8.3" ARRAY_SIZE 18 MATRIX_DIM 6 3 1 /end MEASUREMENT
/begin MEASUREMENT Rksoll_s "Relative Soll-Kraftstoffmasse je Einspritzung (schicht)" SWORD _CNV_R_R_Def_rk_sw__600_CM 1 100. -1600. 1599.9511 DISPLAY_IDENTIFIER RKSOLL_S ECU_ADDRESS 0xd000deb0 FORMAT "%8.3" ARRAY_SIZE 18 MATRIX_DIM 6 3 1 /end MEASUREMENT
/begin MEASUREMENT Rkte_kh "Anteil TE-Gas das nicht an der Verbrennung teil nimmt" SWORD _CNV_R_R_Def_rk_sw__600_CM 1 100. -1600. 1599.9511 DISPLAY_IDENTIFIER RKTE_KH ECU_ADDRESS 0xd000dfa0 FORMAT "%8.3" /end MEASUREMENT
/begin MEASUREMENT Rkte_kh_s "Anteil an der Tankentlueftungsmenge, die zu einer Exotherme im Kat beitraegt" SWORD _CNV_R_R_Def_rk_sw__600_CM 1 100. -1600. 1599.9511 DISPLAY_IDENTIFIER RKTE_KH_S ECU_ADDRESS 0xd000df9e FORMAT "%8.3" /end MEASUREMENT
/begin MEASUREMENT Rkte_max "Maximal zulässige Kraftstoffmenge über TEV" SWORD _CNV_R_R_Def_rk_sw__600_CM 1 100. -1600. 1599.9511 DISPLAY_IDENTIFIER RKTE_MAX ECU_ADDRESS 0xd000df54 FORMAT "%8.3" /end MEASUREMENT
/begin MEASUREMENT Rkte_md "Momentenrelevanter Teil der Kraftstoffmasse über TEV" SWORD _CNV_R_R_Def_rk_sw__600_CM 1 100. -1600. 1599.9511 DISPLAY_IDENTIFIER RKTE_MD ECU_ADDRESS 0xd000df56 FORMAT "%8.3" /end MEASUREMENT
/begin MEASUREMENT Rkte_md_s "Anteil an der Tankentluftungsmenge, der zum Md beitragt" SWORD _CNV_R_R_Def_rk_sw__600_CM 1 100. -1600. 1599.9511 DISPLAY_IDENTIFIER RKTE_MD_S ECU_ADDRESS 0xd000df9c FORMAT "%8.3" /end MEASUREMENT
/begin MEASUREMENT Schalt_prail "Umschalter Raildruck" UBYTE _CNV_R_R_Def_dez_sl_551_CM 1 100. 0. 255. DISPLAY_IDENTIFIER SCHALT_PRAIL ECU_ADDRESS 0xd000e708 FORMAT "%3.0" /end MEASUREMENT
/begin MEASUREMENT St_anman "Status Antriebsmanagement" UBYTE _CNV_R_R_Def_dez_sl_551_CM 1 100. 0. 255. DISPLAY_IDENTIFIER ST_ANMAN ECU_ADDRESS 0xd000e050 FORMAT "%3.0" /end MEASUREMENT
/begin MEASUREMENT St_anman.B_2fl_gangi "Entprellung Gangi" UBYTE _CNV_S_2_Def_bit_ub_563_CM 1 100. 0. 1. DISPLAY_IDENTIFIER B_2FL_GANGI ECU_ADDRESS 0xd000e050 BIT_MASK 0x20 /end MEASUREMENT
/begin MEASUREMENT St_anman.B_antieb "Triebstrang nicht unterbrochen" UBYTE _CNV_S_2_Def_bit_ub_563_CM 1 100. 0. 1. DISPLAY_IDENTIFIER B_ANTIEB ECU_ADDRESS 0xd000e050 BIT_MASK 0x4 /end MEASUREMENT
/begin MEASUREMENT St_anman.B_antieb_starr "Antrieb starr" UBYTE _CNV_S_2_Def_bit_ub_563_CM 1 100. 0. 1. DISPLAY_IDENTIFIER B_ANTIEB_STARR ECU_ADDRESS 0xd000e050 BIT_MASK 0x2 /end MEASUREMENT
/begin MEASUREMENT St_anman.B_kein_gang "kein Gang eingelegt" UBYTE _CNV_S_2_Def_bit_ub_563_CM 1 100. 0. 1. DISPLAY_IDENTIFIER B_KEIN_GANG ECU_ADDRESS 0xd000e050 BIT_MASK 0x8 /end MEASUREMENT
/begin MEASUREMENT St_anman.B_kupp_int "Kupplung betätigt" UBYTE _CNV_S_2_Def_bit_ub_563_CM 1 100. 0. 1. DISPLAY_IDENTIFIER B_KUPP_INT ECU_ADDRESS 0xd000e050 BIT_MASK 0x40 /end MEASUREMENT
/begin MEASUREMENT St_anman.B_ldm_mdrad "LDM geift ein" UBYTE _CNV_S_2_Def_bit_ub_563_CM 1 100. 0. 1. DISPLAY_IDENTIFIER B_LDM_MDRAD ECU_ADDRESS 0xd000e050 BIT_MASK 0x1 /end MEASUREMENT
/begin MEASUREMENT St_bvmdi "Statuswort BVMDI" UBYTE _CNV_S_17_Def_brenn__704_CM 1 100. 0. 68. DISPLAY_IDENTIFIER ST_BVMDI ECU_ADDRESS 0xd000ddf0 BIT_MASK 0xFF /end MEASUREMENT
/begin MEASUREMENT St_ldm_kupp "Status Kraftschluss" UBYTE _CNV_R_R_Def_dez_sl_551_CM 1 100. 0. 255. DISPLAY_IDENTIFIER ST_LDM_KUPP ECU_ADDRESS 0xd000e052 FORMAT "%3.0" /end MEASUREMENT
/begin MEASUREMENT St_mdimax "Statuswort MDRK" UBYTE _CNV_R_R_Def_dez_sl_551_CM 1 100. 0. 255. DISPLAY_IDENTIFIER ST_MDIMAX ECU_ADDRESS 0xd000df78 FORMAT "%3.0" /end MEASUREMENT
/begin MEASUREMENT St_mdimax.B_khmdoe_ena "Statuswort MDRK" UBYTE _CNV_S_2_Def_bit_ub_563_CM 1 100. 0. 1. DISPLAY_IDENTIFIER B_KHMDOE_ENA ECU_ADDRESS 0xd000df78 BIT_MASK 0x4 /end MEASUREMENT
/begin MEASUREMENT St_mdimax.B_mdimax_hs "Statuswort MDRK" UBYTE _CNV_S_2_Def_bit_ub_563_CM 1 100. 0. 1. DISPLAY_IDENTIFIER B_MDIMAX_HS ECU_ADDRESS 0xd000df78 BIT_MASK 0x1 /end MEASUREMENT
/begin MEASUREMENT St_mdimax.B_mdimax_s "Statuswort MDRK" UBYTE _CNV_S_2_Def_bit_ub_563_CM 1 100. 0. 1. DISPLAY_IDENTIFIER B_MDIMAX_S ECU_ADDRESS 0xd000df78 BIT_MASK 0x2 /end MEASUREMENT
/begin MEASUREMENT St_mdrk "Statuswort MDRK" UBYTE _CNV_R_R_Def_dez_sl_551_CM 1 100. 0. 255. DISPLAY_IDENTIFIER ST_MDRK ECU_ADDRESS 0xd000ddec FORMAT "%3.0" /end MEASUREMENT
/begin MEASUREMENT St_mdrk.B_doe_h "Bedingung Doppeleinspritzung aktiv (homogen)" UBYTE _CNV_S_2_Def_bit_ub_563_CM 1 100. 0. 1. DISPLAY_IDENTIFIER B_DOE_H ECU_ADDRESS 0xd000ddec BIT_MASK 0x40 /end MEASUREMENT
/begin MEASUREMENT St_mdrk.B_doe_hs "Bedingung Doppeleinspritzung aktiv (homogen-schicht)" UBYTE _CNV_S_2_Def_bit_ub_563_CM 1 100. 0. 1. DISPLAY_IDENTIFIER B_DOE_HS ECU_ADDRESS 0xd000ddec BIT_MASK 0x10 /end MEASUREMENT
/begin MEASUREMENT St_mdrk.B_doe_s "Bedingung Doppeleinspritzung aktiv (schicht)" UBYTE _CNV_S_2_Def_bit_ub_563_CM 1 100. 0. 1. DISPLAY_IDENTIFIER B_DOE_S ECU_ADDRESS 0xd000ddec BIT_MASK 0x8 /end MEASUREMENT
/begin MEASUREMENT St_mdrk.B_khmdoe_akt "Bedingung Doppeleinspritzung aktiv (Katheizmanager)" UBYTE _CNV_S_2_Def_bit_ub_563_CM 1 100. 0. 1. DISPLAY_IDENTIFIER B_KHMDOE_AKT ECU_ADDRESS 0xd000ddec BIT_MASK 0x80 /end MEASUREMENT
/begin MEASUREMENT St_mdrk.B_la_prio "Bedingung Vorgabe Rk mit Lambda Priorität" UBYTE _CNV_S_2_Def_bit_ub_563_CM 1 100. 0. 1. DISPLAY_IDENTIFIER B_LA_PRIO ECU_ADDRESS 0xd000ddec BIT_MASK 0x1 /end MEASUREMENT
/begin MEASUREMENT St_mdrk.B_laprio_h "Statuswort MDRK" UBYTE _CNV_S_2_Def_bit_ub_563_CM 1 100. 0. 1. DISPLAY_IDENTIFIER B_LAPRIO_H ECU_ADDRESS 0xd000ddec BIT_MASK 0x20 /end MEASUREMENT
/begin MEASUREMENT St_mdrk.B_rfresmx_ba "Bedingung Füllungsbegrenzung aktiv" UBYTE _CNV_S_2_Def_bit_ub_563_CM 1 100. 0. 1. DISPLAY_IDENTIFIER B_RFRESMX_BA ECU_ADDRESS 0xd000ddec BIT_MASK 0x4 /end MEASUREMENT
/begin MEASUREMENT St_mdrk.B_rk_resmax "Bedingung Momentenreserve kann im Homogenen nich über ZW abgebaut werden" UBYTE _CNV_S_2_Def_bit_ub_563_CM 1 100. 0. 1. DISPLAY_IDENTIFIER B_RK_RESMAX ECU_ADDRESS 0xd000ddec BIT_MASK 0x2 /end MEASUREMENT
/begin MEASUREMENT St_mdrk2 "Statuswort MDRK" UBYTE _CNV_R_R_Def_dez_sl_551_CM 1 100. 0. 255. DISPLAY_IDENTIFIER ST_MDRK2 ECU_ADDRESS 0xd000dded FORMAT "%3.0" /end MEASUREMENT
/begin MEASUREMENT St_mdrk2.B_espr_start "Bedingung B_espr_start" UBYTE _CNV_S_2_Def_bit_ub_563_CM 1 100. 0. 1. DISPLAY_IDENTIFIER B_ESPR_START ECU_ADDRESS 0xd000dded BIT_MASK 0x2 /end MEASUREMENT
/begin MEASUREMENT St_mdrk2.B_hd_start "Bedingung hoher Kraftstoffdruck im Start" UBYTE _CNV_S_2_Def_bit_ub_563_CM 1 100. 0. 1. DISPLAY_IDENTIFIER B_HD_START ECU_ADDRESS 0xd000dded BIT_MASK 0x1 /end MEASUREMENT
/begin MEASUREMENT St_mdrk2.B_klopfen_s "Bedingung B_klopfen_s" UBYTE _CNV_S_2_Def_bit_ub_563_CM 1 100. 0. 1. DISPLAY_IDENTIFIER B_KLOPFEN_S ECU_ADDRESS 0xd000dded BIT_MASK 0x10 /end MEASUREMENT
/begin MEASUREMENT St_mdrk2.B_nesps "Bedingung B_nesps" UBYTE _CNV_S_2_Def_bit_ub_563_CM 1 100. 0. 1. DISPLAY_IDENTIFIER B_NESPS ECU_ADDRESS 0xd000dded BIT_MASK 0x4 /end MEASUREMENT
/begin MEASUREMENT St_mdrk2.B_rfsollfil_dec "Bedingung Rf_soll Filterung aktiv" UBYTE _CNV_S_2_Def_bit_ub_563_CM 1 100. 0. 1. DISPLAY_IDENTIFIER B_RFSOLLFIL_DEC ECU_ADDRESS 0xd000dded BIT_MASK 0x40 /end MEASUREMENT
/begin MEASUREMENT St_mdrk2.B_rfsollfil_inc "Bedingung Rf_soll Filterung aktiv" UBYTE _CNV_S_2_Def_bit_ub_563_CM 1 100. 0. 1. DISPLAY_IDENTIFIER B_RFSOLLFIL_INC ECU_ADDRESS 0xd000dded BIT_MASK 0x20 /end MEASUREMENT
/begin MEASUREMENT St_mdrk2.B_zwladif "Bedingung ZW-Eingriff durch Lambdadiff. aktiv" UBYTE _CNV_S_2_Def_bit_ub_563_CM 1 100. 0. 1. DISPLAY_IDENTIFIER B_ZWLADIF ECU_ADDRESS 0xd000dded BIT_MASK 0x80 /end MEASUREMENT
/begin MEASUREMENT St_mdrk3 "Statuswort MDRK" UBYTE _CNV_R_R_Def_dez_sl_551_CM 1 100. 0. 255. DISPLAY_IDENTIFIER ST_MDRK3 ECU_ADDRESS 0xd000ddee FORMAT "%3.0" /end MEASUREMENT
/begin MEASUREMENT St_mdrk3.B_laprio_abgas "Lambdavorgabe Abgasprior" UBYTE _CNV_S_2_Def_bit_ub_563_CM 1 100. 0. 1. DISPLAY_IDENTIFIER B_LAPRIO_ABGAS ECU_ADDRESS 0xd000ddee BIT_MASK 0x1 /end MEASUREMENT
/begin MEASUREMENT St_mdrk3fach "Statuswort für MDRK 3 fach Einspritzung" UBYTE _CNV_R_R_Def_dez_sl_551_CM 1 100. 0. 255. DISPLAY_IDENTIFIER ST_MDRK3FACH ECU_ADDRESS 0xd000ddf2 FORMAT "%3.0" /end MEASUREMENT
/begin MEASUREMENT St_mdrk3fach.B_rk3h_akt "3fach Einspritzung aktiv" UBYTE _CNV_S_2_Def_bit_ub_563_CM 1 100. 0. 1. DISPLAY_IDENTIFIER B_RK3H_AKT ECU_ADDRESS 0xd000ddf2 BIT_MASK 0x1 /end MEASUREMENT
/begin MEASUREMENT St_rail "Statuswort Raildruckregler" UBYTE _CNV_R_R_Def_dez_sl_551_CM 1 100. 0. 255. DISPLAY_IDENTIFIER ST_RAIL ECU_ADDRESS 0xd000e700 FORMAT "%3.0" /end MEASUREMENT
/begin MEASUREMENT St_rail.B_prailsw "Bedingung Raildruck von BMW verwenden" UBYTE _CNV_S_2_Def_bit_ub_563_CM 1 100. 0. 1. DISPLAY_IDENTIFIER B_PRAILSW ECU_ADDRESS 0xd000e700 BIT_MASK 0x1 /end MEASUREMENT
/begin MEASUREMENT St_railko "Statuswort" UBYTE _CNV_R_R_Def_dez_sl_551_CM 1 100. 0. 255. DISPLAY_IDENTIFIER ST_RAILKO ECU_ADDRESS 0xd000e701 FORMAT "%3.0" /end MEASUREMENT
/begin MEASUREMENT St_railko.B_prail_hs "Quittung Raildruck homogen/schicht" UBYTE _CNV_S_2_Def_bit_ub_563_CM 1 100. 0. 1. DISPLAY_IDENTIFIER B_PRAIL_HS ECU_ADDRESS 0xd000e701 BIT_MASK 0x2 /end MEASUREMENT
/begin MEASUREMENT St_railko.B_prail_s "Quittung Raildruck schicht" UBYTE _CNV_S_2_Def_bit_ub_563_CM 1 100. 0. 1. DISPLAY_IDENTIFIER B_PRAIL_S ECU_ADDRESS 0xd000e701 BIT_MASK 0x1 /end MEASUREMENT
/begin MEASUREMENT St_railko.B_praildoe_h "Quittung Raildruck Doppeleinspritzung homogen" UBYTE _CNV_S_2_Def_bit_ub_563_CM 1 100. 0. 1. DISPLAY_IDENTIFIER B_PRAILDOE_H ECU_ADDRESS 0xd000e701 BIT_MASK 0x4 /end MEASUREMENT
/begin MEASUREMENT St_rf "Status" UBYTE _CNV_R_R_Def_dez_sl_551_CM 1 100. 0. 255. DISPLAY_IDENTIFIER ST_RF ECU_ADDRESS 0xd000ddef FORMAT "%3.0" /end MEASUREMENT
/begin MEASUREMENT St_rf.B_rfmin "Bedingung Minimalbegrenzung Rf aktiv" UBYTE _CNV_S_2_Def_bit_ub_563_CM 1 100. 0. 1. DISPLAY_IDENTIFIER B_RFMIN ECU_ADDRESS 0xd000ddef BIT_MASK 0x1 /end MEASUREMENT
/begin MEASUREMENT St_rkaddinst "Statuswort MDRK, BA-Anreicherung durch Rk_add_inst" UBYTE _CNV_R_R_Def_dez_sl_551_CM 1 100. 0. 255. DISPLAY_IDENTIFIER ST_RKADDINST ECU_ADDRESS 0xd000ddf1 FORMAT "%3.0" /end MEASUREMENT
/begin MEASUREMENT St_rkaddinst.B_rkaddinst_neg "DI Wandfilmkorrektur neg. aktiv" UBYTE _CNV_S_2_Def_bit_ub_563_CM 1 100. 0. 1. DISPLAY_IDENTIFIER B_RKADDINST_NEG ECU_ADDRESS 0xd000ddf1 BIT_MASK 0x2 /end MEASUREMENT
/begin MEASUREMENT St_rkaddinst.B_rkaddinst_on "DI Wandfilmkorrektur aktiv" UBYTE _CNV_S_2_Def_bit_ub_563_CM 1 100. 0. 1. DISPLAY_IDENTIFIER B_RKADDINST_ON ECU_ADDRESS 0xd000ddf1 BIT_MASK 0x4 /end MEASUREMENT
/begin MEASUREMENT St_rkaddinst.B_rkaddinst_pos "DI Wandfilmkorrektur pos. aktiv" UBYTE _CNV_S_2_Def_bit_ub_563_CM 1 100. 0. 1. DISPLAY_IDENTIFIER B_RKADDINST_POS ECU_ADDRESS 0xd000ddf1 BIT_MASK 0x1 /end MEASUREMENT
/begin MEASUREMENT St_rkaddinst.B_rkinst_init "Rk_add_inst Filter mit Rk_addinst_roh initialisieren" UBYTE _CNV_S_2_Def_bit_ub_563_CM 1 100. 0. 1. DISPLAY_IDENTIFIER B_RKINST_INIT ECU_ADDRESS 0xd000ddf1 BIT_MASK 0x10 /end MEASUREMENT
/begin MEASUREMENT St_rkaddinst.B_rkinstpar_neg "DI Wandfilmkorrektur neg. aktiv" UBYTE _CNV_S_2_Def_bit_ub_563_CM 1 100. 0. 1. DISPLAY_IDENTIFIER B_RKINSTPAR_NEG ECU_ADDRESS 0xd000ddf1 BIT_MASK 0x8 /end MEASUREMENT
/begin MEASUREMENT St_vramo "Statuswort" UBYTE _CNV_R_R_Def_dez_sl_551_CM 1 100. 0. 255. DISPLAY_IDENTIFIER ST_VRAMO ECU_ADDRESS 0xd000ccec FORMAT "%3.0" /end MEASUREMENT
/begin MEASUREMENT St_vramo.B_amoaktiv "Hier könnte Ihr Langbezeichner stehen" UBYTE _CNV_S_2_Def_bit_ub_563_CM 1 100. 0. 1. DISPLAY_IDENTIFIER B_AMOAKTIV ECU_ADDRESS 0xd000ccec BIT_MASK 0x1 /end MEASUREMENT
/begin MEASUREMENT St_vramo.B_ndifamo "Bedingung Drehzahldifferenz AMO Ueberschritten" UBYTE _CNV_S_2_Def_bit_ub_563_CM 1 100. 0. 1. DISPLAY_IDENTIFIER B_NDIFAMO ECU_ADDRESS 0xd000ccec BIT_MASK 0x2 /end MEASUREMENT
/begin MEASUREMENT St_vramo.B_ndifamo_old "Bedingung Drehzahldifferenz AMO im letzten Zyklus überschritten" UBYTE _CNV_S_2_Def_bit_ub_563_CM 1 100. 0. 1. DISPLAY_IDENTIFIER B_NDIFAMO_OLD ECU_ADDRESS 0xd000ccec BIT_MASK 0x4 /end MEASUREMENT
/begin MEASUREMENT St_vrkoor_100ms "Statuswort Vrkoor für Bits" UBYTE _CNV_R_R_Def_dez_sl_551_CM 1 100. 0. 255. DISPLAY_IDENTIFIER ST_VRKOOR_100MS ECU_ADDRESS 0xd000cdd8 FORMAT "%3.0" /end MEASUREMENT
/begin MEASUREMENT St_vrkoor_100ms.B_kwerrorvbr "Fehler KW für Verbrennungsregelung" UBYTE _CNV_S_2_Def_bit_ub_563_CM 1 100. 0. 1. DISPLAY_IDENTIFIER B_KWERRORVBR ECU_ADDRESS 0xd000cdd8 BIT_MASK 0x1 /end MEASUREMENT
/begin MEASUREMENT St_vrs_10ms "Statuswort VBR für Bits" UBYTE _CNV_R_R_Def_dez_sl_551_CM 1 100. 0. 255. DISPLAY_IDENTIFIER ST_VRS_10MS ECU_ADDRESS 0xd000cefa FORMAT "%3.0" /end MEASUREMENT
/begin MEASUREMENT St_vrs_10ms.B_sierr "Bedingung Fehler für VVT-sicher gesetzt" UBYTE _CNV_S_2_Def_bit_ub_563_CM 1 100. 0. 1. DISPLAY_IDENTIFIER B_SIERR ECU_ADDRESS 0xd000cefa BIT_MASK 0x1 /end MEASUREMENT
/begin MEASUREMENT St_vrs_10ms.B_sigd "Bedingung Fehler für VVT-sicher gesetzt" UBYTE _CNV_S_2_Def_bit_ub_563_CM 1 100. 0. 1. DISPLAY_IDENTIFIER B_SIGD ECU_ADDRESS 0xd000cefa BIT_MASK 0x2 /end MEASUREMENT
/begin MEASUREMENT St_vrs_gdi_seg "Statuswort VBR für Bits" UBYTE _CNV_R_R_Def_dez_sl_551_CM 1 100. 0. 255. DISPLAY_IDENTIFIER ST_VRS_GDI_SEG ECU_ADDRESS 0xd000cee0 FORMAT "%3.0" /end MEASUREMENT
/begin MEASUREMENT St_vrs_gdi_seg.B_amogr "mindestens eine Motorordnungsgrenzamplitude überschritten" UBYTE _CNV_S_2_Def_bit_ub_563_CM 1 100. 0. 1. DISPLAY_IDENTIFIER B_AMOGR ECU_ADDRESS 0xd000cee0 BIT_MASK 0x80 /end MEASUREMENT
/begin MEASUREMENT St_vrs_gdi_seg.B_auss_hom "Anforderung Umschaltung auf Homogen aus VBR" UBYTE _CNV_S_2_Def_bit_ub_563_CM 1 100. 0. 1. DISPLAY_IDENTIFIER B_AUSS_HOM ECU_ADDRESS 0xd000cee0 BIT_MASK 0x8 /end MEASUREMENT
/begin MEASUREMENT St_vrs_gdi_seg.B_zrseg_ausbzyk "Statuswort VBR für Bits" UBYTE _CNV_S_2_Def_bit_ub_563_CM 1 100. 0. 1. DISPLAY_IDENTIFIER B_ZRSEG_AUSBZYK ECU_ADDRESS 0xd000cee0 BIT_MASK 0x4 /end MEASUREMENT
/begin MEASUREMENT St_vrs_gdi_seg.B_zrseg_ausbzyk_alt "Statuswort VBR für Bits" UBYTE _CNV_S_2_Def_bit_ub_563_CM 1 100. 0. 1. DISPLAY_IDENTIFIER B_ZRSEG_AUSBZYK_ALT ECU_ADDRESS 0xd000cee0 BIT_MASK 0x40 /end MEASUREMENT
/begin MEASUREMENT St_vrs_gdi_seg.B_zrseg_aussa "Statuswort VBR für Bits" UBYTE _CNV_S_2_Def_bit_ub_563_CM 1 100. 0. 1. DISPLAY_IDENTIFIER B_ZRSEG_AUSSA ECU_ADDRESS 0xd000cee0 BIT_MASK 0x1 /end MEASUREMENT
/begin MEASUREMENT St_vrs_gdi_seg.B_zrseg_aussa_alt "Statuswort VBR für Bits" UBYTE _CNV_S_2_Def_bit_ub_563_CM 1 100. 0. 1. DISPLAY_IDENTIFIER B_ZRSEG_AUSSA_ALT ECU_ADDRESS 0xd000cee0 BIT_MASK 0x10 /end MEASUREMENT
/begin MEASUREMENT St_vrs_gdi_seg.B_zrseg_aussb "Statuswort VBR für Bits" UBYTE _CNV_S_2_Def_bit_ub_563_CM 1 100. 0. 1. DISPLAY_IDENTIFIER B_ZRSEG_AUSSB ECU_ADDRESS 0xd000cee0 BIT_MASK 0x2 /end MEASUREMENT
/begin MEASUREMENT St_vrs_gdi_seg.B_zrseg_aussb_alt "Statuswort VBR für Bits" UBYTE _CNV_S_2_Def_bit_ub_563_CM 1 100. 0. 1. DISPLAY_IDENTIFIER B_ZRSEG_AUSSB_ALT ECU_ADDRESS 0xd000cee0 BIT_MASK 0x20 /end MEASUREMENT
/begin MEASUREMENT St_vrs_gdi_seg2 "Statuswort VBR für Bits" UBYTE _CNV_R_R_Def_dez_sl_551_CM 1 100. 0. 255. DISPLAY_IDENTIFIER ST_VRS_GDI_SEG2 ECU_ADDRESS 0xd000cee1 FORMAT "%3.0" /end MEASUREMENT
/begin MEASUREMENT St_vrs_gdi_seg2.B_lurabsti "Verbrennungsstochastik für eine Abmagerung zu hoch" UBYTE _CNV_S_2_Def_bit_ub_563_CM 1 100. 0. 1. DISPLAY_IDENTIFIER B_LURABSTI ECU_ADDRESS 0xd000cee1 BIT_MASK 0x1 /end MEASUREMENT
/begin MEASUREMENT St_wmewapu0 "Statuswort" UBYTE _CNV_R_R_Def_dez_sl_551_CM 1 100. 0. 255. DISPLAY_IDENTIFIER ST_WMEWAPU0 ECU_ADDRESS 0xd000cf84 FORMAT "%3.0" /end MEASUREMENT
/begin MEASUREMENT St_wmewapu0.B_kvaverbr "Hilfsgrösse Berechnung Kraftstoffmassenstrom" UBYTE _CNV_S_2_Def_bit_ub_563_CM 1 100. 0. 1. DISPLAY_IDENTIFIER B_KVAVERBR ECU_ADDRESS 0xd000cf84 BIT_MASK 0x1 /end MEASUREMENT
/begin MEASUREMENT St_wmprio "Statuswort" UBYTE _CNV_R_R_Def_dez_sl_551_CM 1 100. 0. 255. DISPLAY_IDENTIFIER ST_WMPRIO ECU_ADDRESS 0xd000cf88 FORMAT "%3.0" /end MEASUREMENT
/begin MEASUREMENT St_wmprio.B_ewptmwae "Bedingung Abbruch Warmlauf durch Tmot" UBYTE _CNV_S_2_Def_bit_ub_563_CM 1 100. 0. 1. DISPLAY_IDENTIFIER B_EWPTMWAE ECU_ADDRESS 0xd000cf88 BIT_MASK 0x8 /end MEASUREMENT
/begin MEASUREMENT St_wmprio.B_ewpwae "Bedingung Abbruch Warmlauf" UBYTE _CNV_S_2_Def_bit_ub_563_CM 1 100. 0. 1. DISPLAY_IDENTIFIER B_EWPWAE ECU_ADDRESS 0xd000cf88 BIT_MASK 0x1 /end MEASUREMENT
/begin MEASUREMENT St_wmprio.B_fi_eluee "Bedingung Elüfterfehler" UBYTE _CNV_S_2_Def_bit_ub_563_CM 1 100. 0. 1. DISPLAY_IDENTIFIER B_FI_ELUEE ECU_ADDRESS 0xd000cf88 BIT_MASK 0x2 /end MEASUREMENT
/begin MEASUREMENT St_wmprio.B_fi_tmot "Bedingung Tmotfehler" UBYTE _CNV_S_2_Def_bit_ub_563_CM 1 100. 0. 1. DISPLAY_IDENTIFIER B_FI_TMOT ECU_ADDRESS 0xd000cf88 BIT_MASK 0x10 /end MEASUREMENT
/begin MEASUREMENT St_wmprio.B_heiz_prio "Bedingung Heizleistung " UBYTE _CNV_S_2_Def_bit_ub_563_CM 1 100. 0. 1. DISPLAY_IDENTIFIER B_HEIZ_PRIO ECU_ADDRESS 0xd000cf88 BIT_MASK 0x80 /end MEASUREMENT
/begin MEASUREMENT St_wmprio.B_pwg_ist "Bedingung Gaspedal für eine Zeit x " UBYTE _CNV_S_2_Def_bit_ub_563_CM 1 100. 0. 1. DISPLAY_IDENTIFIER B_PWG_IST ECU_ADDRESS 0xd000cf88 BIT_MASK 0x4 /end MEASUREMENT
/begin MEASUREMENT St_wmprio.B_tmheiz "Bedingung Tmot für Heizleistung" UBYTE _CNV_S_2_Def_bit_ub_563_CM 1 100. 0. 1. DISPLAY_IDENTIFIER B_TMHEIZ ECU_ADDRESS 0xd000cf88 BIT_MASK 0x40 /end MEASUREMENT
/begin MEASUREMENT St_wmprio.B_tuheiz "Bedingung Tumg für Heizleistung" UBYTE _CNV_S_2_Def_bit_ub_563_CM 1 100. 0. 1. DISPLAY_IDENTIFIER B_TUHEIZ ECU_ADDRESS 0xd000cf88 BIT_MASK 0x20 /end MEASUREMENT
/begin MEASUREMENT St_wmprio0 "Statuswort" UBYTE _CNV_R_R_Def_dez_sl_551_CM 1 100. 0. 255. DISPLAY_IDENTIFIER ST_WMPRIO0 ECU_ADDRESS 0xd000cf89 FORMAT "%3.0" /end MEASUREMENT
/begin MEASUREMENT St_wmprio0.B_ewp_pe "Bedingung Abbruch Warmlauf durch Motoleistung" UBYTE _CNV_S_2_Def_bit_ub_563_CM 1 100. 0. 1. DISPLAY_IDENTIFIER B_EWP_PE ECU_ADDRESS 0xd000cf89 BIT_MASK 0x1 /end MEASUREMENT
/begin MEASUREMENT St_wmprio0.B_ewp_qs "Bedingung Abbruch Warmlauf durch Wärmestromanforderung IHKA" UBYTE _CNV_S_2_Def_bit_ub_563_CM 1 100. 0. 1. DISPLAY_IDENTIFIER B_EWP_QS ECU_ADDRESS 0xd000cf89 BIT_MASK 0x10 /end MEASUREMENT
/begin MEASUREMENT St_wmprio0.B_ewp_vs "Bedingung Abbruch Warmlauf durch Kraftstoffmenge" UBYTE _CNV_S_2_Def_bit_ub_563_CM 1 100. 0. 1. DISPLAY_IDENTIFIER B_EWP_VS ECU_ADDRESS 0xd000cf89 BIT_MASK 0x2 /end MEASUREMENT
/begin MEASUREMENT St_wmprio0.B_help_pe "Hilfsgrösse B_ewp_pe" UBYTE _CNV_S_2_Def_bit_ub_563_CM 1 100. 0. 1. DISPLAY_IDENTIFIER B_HELP_PE ECU_ADDRESS 0xd000cf89 BIT_MASK 0x4 /end MEASUREMENT
/begin MEASUREMENT St_wmprio0.B_help_qs "Hilfsgrösse B_ewp_qs" UBYTE _CNV_S_2_Def_bit_ub_563_CM 1 100. 0. 1. DISPLAY_IDENTIFIER B_HELP_QS ECU_ADDRESS 0xd000cf89 BIT_MASK 0x20 /end MEASUREMENT
/begin MEASUREMENT St_wmprio0.B_n46 "Bedingung N46B20" UBYTE _CNV_S_2_Def_bit_ub_563_CM 1 100. 0. 1. DISPLAY_IDENTIFIER B_N46 ECU_ADDRESS 0xd000cf89 BIT_MASK 0x8 /end MEASUREMENT
/begin MEASUREMENT St_wmprio0.B_nkwtget "Bedingung Nkw und Tget " UBYTE _CNV_S_2_Def_bit_ub_563_CM 1 100. 0. 1. DISPLAY_IDENTIFIER B_NKWTGET ECU_ADDRESS 0xd000cf89 BIT_MASK 0x80 /end MEASUREMENT
/begin MEASUREMENT St_wmprio0.B_pwg90 "Bedingung Pwg_ist über 90" UBYTE _CNV_S_2_Def_bit_ub_563_CM 1 100. 0. 1. DISPLAY_IDENTIFIER B_PWG90 ECU_ADDRESS 0xd000cf89 BIT_MASK 0x40 /end MEASUREMENT
/begin MEASUREMENT St_wmprio1 "Statuswort" UBYTE _CNV_R_R_Def_dez_sl_551_CM 1 100. 0. 255. DISPLAY_IDENTIFIER ST_WMPRIO1 ECU_ADDRESS 0xd000cf8a FORMAT "%3.0" /end MEASUREMENT
/begin MEASUREMENT St_wmprio1.B_baistewp "Bedingung Ba_ist_ewp zwischen BA 7 und 9" UBYTE _CNV_S_2_Def_bit_ub_563_CM 1 100. 0. 1. DISPLAY_IDENTIFIER B_BAISTEWP ECU_ADDRESS 0xd000cf8a BIT_MASK 0x1 /end MEASUREMENT
/begin MEASUREMENT T_entpr_gang "Entprellzeit Gangi" UWORD _CNV_R_R_Def_td_uw__673_CM 1 100. 0. 655.35 DISPLAY_IDENTIFIER T_ENTPR_GANG ECU_ADDRESS 0xd000e058 FORMAT "%7.2" /end MEASUREMENT
/begin MEASUREMENT Td_kein_gang "Verzögerungszeit" UBYTE _CNV_R_R_Def_td_uw__673_CM 1 100. 0. 2.55 DISPLAY_IDENTIFIER TD_KEIN_GANG ECU_ADDRESS 0xd000e071 FORMAT "%5.2" /end MEASUREMENT
/begin MEASUREMENT Td_kupp_ext "Verzögerungszeit" UBYTE _CNV_R_R_Def_td_uw__673_CM 1 100. 0. 2.55 DISPLAY_IDENTIFIER TD_KUPP_EXT ECU_ADDRESS 0xd000e070 FORMAT "%5.2" /end MEASUREMENT
/begin MEASUREMENT Td_ldm_aus "Verzögerungszeit LDM aus" UWORD _CNV_R_R_Def_td_uw__673_CM 1 100. 0. 655.35 DISPLAY_IDENTIFIER TD_LDM_AUS ECU_ADDRESS 0xd000e05a FORMAT "%7.2" /end MEASUREMENT
/begin MEASUREMENT Td_ldm_aus1 "Verzögerungszeit LDM aus" UWORD _CNV_R_R_Def_td_uw__673_CM 1 100. 0. 655.35 DISPLAY_IDENTIFIER TD_LDM_AUS1 ECU_ADDRESS 0xd000e05c FORMAT "%7.2" /end MEASUREMENT
/begin MEASUREMENT Tkwsoll "Solltemperatur Kühlwasser" SWORD _CNV_R_R_Def_t_sw_q_579_CM 1 100. -327.68 327.67 DISPLAY_IDENTIFIER TKWSOLL ECU_ADDRESS 0xc0000732 FORMAT "%7.2" /end MEASUREMENT
/begin MEASUREMENT Tmot_wm "Tmot für WMK" SWORD _CNV_R_R_Def_t_sw_q_579_CM 1 100. -327.68 327.67 DISPLAY_IDENTIFIER TMOT_WM ECU_ADDRESS 0xc0007982 FORMAT "%7.2" /end MEASUREMENT
/begin MEASUREMENT Tv_kft "Tastverhaeltnis zur Ansteuerung des KFT vor extern-Auswahl" UWORD _CNV_R_R_Def_f_uw_b_555_CM 1 100. 0. 99.9984 DISPLAY_IDENTIFIER TV_KFT ECU_ADDRESS 0xc0000730 FORMAT "%8.3" /end MEASUREMENT
/begin MEASUREMENT Tvkft "Tastverhaeltnis zur Ansteuerung des KFT vor extern-Auswahl" SWORD _CNV_R_R_Def_rel_sw_562_CM 1 100. -100. 99.9969 DISPLAY_IDENTIFIER TVKFT ECU_ADDRESS 0xc0000736 FORMAT "%8.3" /end MEASUREMENT
/begin MEASUREMENT Var_dkg "Variante DKG" UBYTE _CNV_R_R_Def_dez_sl_551_CM 1 100. 0. 255. DISPLAY_IDENTIFIER VAR_DKG ECU_ADDRESS 0xd000e056 FORMAT "%3.0" /end MEASUREMENT
/begin MEASUREMENT Var_hs "Variante Handschalter erkannt" UBYTE _CNV_R_R_Def_dez_sl_551_CM 1 100. 0. 255. DISPLAY_IDENTIFIER VAR_HS ECU_ADDRESS 0xd000e054 FORMAT "%3.0" /end MEASUREMENT
/begin MEASUREMENT Var_ldm "Variante LDM erkannt" UBYTE _CNV_R_R_Def_dez_sl_551_CM 1 100. 0. 255. DISPLAY_IDENTIFIER VAR_LDM ECU_ADDRESS 0xd000e053 FORMAT "%3.0" /end MEASUREMENT
/begin MEASUREMENT Var_smg "Variante SMG erkannt" UBYTE _CNV_R_R_Def_dez_sl_551_CM 1 100. 0. 255. DISPLAY_IDENTIFIER VAR_SMG ECU_ADDRESS 0xd000e055 FORMAT "%3.0" /end MEASUREMENT
/begin MEASUREMENT Vrquo "Mittelwert Quotient zur VR-Schwelle" SWORD _CNV_R_R_Def_f_sw_b_592_CM 1 100. -8. 7.9997 DISPLAY_IDENTIFIER VRQUO ECU_ADDRESS 0xd000cf08 FORMAT "%9.4" /end MEASUREMENT
/begin MEASUREMENT Vrquo1 "Quotient zur VR-Schwelle Bank 1" SWORD _CNV_R_R_Def_f_sw_b_592_CM 1 100. -8. 7.9997 DISPLAY_IDENTIFIER VRQUO1 ECU_ADDRESS 0xd000cf04 FORMAT "%9.4" /end MEASUREMENT
/begin MEASUREMENT Vrquo2 "Quotient zur VR-Schwelle Bank 2" SWORD _CNV_R_R_Def_f_sw_b_592_CM 1 100. -8. 7.9997 DISPLAY_IDENTIFIER VRQUO2 ECU_ADDRESS 0xd000cf06 FORMAT "%9.4" /end MEASUREMENT
/begin MEASUREMENT Vs_ewp_ag "Volumenstromanforderung Automatikgetriebe" UWORD _CNV_R_R_Def_vs_uw__686_CM 1 100. 0. 9999.847400000001 DISPLAY_IDENTIFIER VS_EWP_AG ECU_ADDRESS 0xc0007952 FORMAT "%7.2" /end MEASUREMENT
/begin MEASUREMENT Vs_ewp_mot "Volumenstromanforderung Motor" UWORD _CNV_R_R_Def_vs_uw__686_CM 1 100. 0. 9999.847400000001 DISPLAY_IDENTIFIER VS_EWP_MOT ECU_ADDRESS 0xc0007954 FORMAT "%7.2" /end MEASUREMENT
/begin MEASUREMENT Vs_ewp_of "Volumenstrom Kraftstoff nach Wärmebilanz" UWORD _CNV_R_R_Def_dez_sl_551_CM 1 100. 0. 65535. DISPLAY_IDENTIFIER VS_EWP_OF ECU_ADDRESS 0xc0007956 FORMAT "%5.0" /end MEASUREMENT
/begin MEASUREMENT Vs_ewpkaac "Aktueller Wert aufsummierter Kraftstoffmassenstrom" UWORD _CNV_R_R_Def_f_uw_b_730_CM 1 100. 0. 2999.9542 DISPLAY_IDENTIFIER VS_EWPKAAC ECU_ADDRESS 0xc000799a FORMAT "%7.2" /end MEASUREMENT
/begin MEASUREMENT Vs_ewpvbz "Berechnetes Verbrauchsziel" UWORD _CNV_R_R_Def_dez_sl_551_CM 1 100. 0. 65535. DISPLAY_IDENTIFIER VS_EWPVBZ ECU_ADDRESS 0xc000799c FORMAT "%5.0" /end MEASUREMENT
/begin MEASUREMENT Vskr_ewp_h "Hilfsgrösse Berechnung Vskr_mw" UWORD _CNV_R_R_Def_dez_sl_551_CM 1 100. 0. 65535. DISPLAY_IDENTIFIER VSKR_EWP_H ECU_ADDRESS 0xc0007976 FORMAT "%5.0" /end MEASUREMENT
/begin MEASUREMENT Vskr_ewp_ist "Kraftstoffverbrauch plausibilisiert" UWORD _CNV_R_R_Def_dez_sl_551_CM 1 100. 0. 65535. DISPLAY_IDENTIFIER VSKR_EWP_IST ECU_ADDRESS 0xc0007958 FORMAT "%5.0" /end MEASUREMENT
/begin MEASUREMENT Vskr_mw "Mittelwert Vskr_ewp_ist" UWORD _CNV_R_R_Def_dez_sl_551_CM 1 100. 0. 65535. DISPLAY_IDENTIFIER VSKR_MW ECU_ADDRESS 0xc000795a FORMAT "%5.0" /end MEASUREMENT
/begin MEASUREMENT Vskr_mw_h "Hilfsgrösse Berechnung Vskr_mw" ULONG _CNV_R_R_Def_dez_sl_551_CM 1 100. 0. 8000000. DISPLAY_IDENTIFIER VSKR_MW_H ECU_ADDRESS 0xc0007944 FORMAT "%7.0" /end MEASUREMENT
/begin MEASUREMENT Vskr_mw_h1 "Hilfsgrösse Berechnung Vskr_mw" ULONG _CNV_R_R_Def_dez_sl_551_CM 1 100. 0. 4294967295. DISPLAY_IDENTIFIER VSKR_MW_H1 ECU_ADDRESS 0xc0007948 FORMAT "%7.0" /end MEASUREMENT
/begin MEASUREMENT Vskr_mw_old "Vskr_mw Zwischenspeicher" UWORD _CNV_R_R_Def_dez_sl_551_CM 1 100. 0. 65535. DISPLAY_IDENTIFIER VSKR_MW_OLD ECU_ADDRESS 0xc000795c FORMAT "%5.0" /end MEASUREMENT
/begin MEASUREMENT Vskr_sum "Summenwert Vskr_ewp_ist" ULONG _CNV_R_R_Def_dez_sl_551_CM 1 100. 0. 8000000. DISPLAY_IDENTIFIER VSKR_SUM ECU_ADDRESS 0xc000794c FORMAT "%7.0" /end MEASUREMENT
/begin MEASUREMENT Zaehl_lok "Hilfsgrösse Berechnung Mittelwert Vskr_ewp_ist" UBYTE _CNV_R_R_Def_dez_sl_551_CM 1 100. 0. 255. DISPLAY_IDENTIFIER ZAEHL_LOK ECU_ADDRESS 0xc000795e FORMAT "%3.0" /end MEASUREMENT
/begin MEASUREMENT Zaehl_lok1 "Hilfsgrösse Berechnung Mittelwert Vskr_ewp_ist" UBYTE _CNV_R_R_Def_dez_sl_551_CM 1 100. 0. 255. DISPLAY_IDENTIFIER ZAEHL_LOK1 ECU_ADDRESS 0xc000795f FORMAT "%3.0" /end MEASUREMENT
/begin MEASUREMENT Zaehl_lok1_h "Hilfsgrösse für Zaehl_lok1" UBYTE _CNV_R_R_Def_dez_sl_551_CM 1 100. 0. 255. DISPLAY_IDENTIFIER ZAEHL_LOK1_H ECU_ADDRESS 0xc0007960 FORMAT "%3.0" /end MEASUREMENT
/begin MEASUREMENT Zahler_pwg "Zähler für  Pedalwertgeber" UWORD _CNV_R_R_Def_dez_sl_551_CM 1 100. 0. 65535. DISPLAY_IDENTIFIER ZAHLER_PWG ECU_ADDRESS 0xc000799e FORMAT "%5.0" /end MEASUREMENT
/begin MEASUREMENT Zr_auss_samx "" UWORD _CNV_R_R_Def_dez_sl_551_CM 1 100. 0. 65535. DISPLAY_IDENTIFIER ZR_AUSS_SAMX ECU_ADDRESS 0xd000cf0a FORMAT "%5.0" /end MEASUREMENT
/begin MEASUREMENT Zr_auss_sbmx "" UWORD _CNV_R_R_Def_dez_sl_551_CM 1 100. 0. 65535. DISPLAY_IDENTIFIER ZR_AUSS_SBMX ECU_ADDRESS 0xd000cf0c FORMAT "%5.0" /end MEASUREMENT
/begin MEASUREMENT Zr_aussa_hom "" UWORD _CNV_R_R_Def_dez_sl_551_CM 1 100. 0. 65535. DISPLAY_IDENTIFIER ZR_AUSSA_HOM ECU_ADDRESS 0xc000408c FORMAT "%5.0" /end MEASUREMENT
/begin MEASUREMENT Zr_aussb_hom "" UWORD _CNV_R_R_Def_dez_sl_551_CM 1 100. 0. 65535. DISPLAY_IDENTIFIER ZR_AUSSB_HOM ECU_ADDRESS 0xc000408e FORMAT "%5.0" /end MEASUREMENT
/begin MEASUREMENT Zr_aussb_mx "" UWORD _CNV_R_R_Def_dez_sl_551_CM 1 100. 0. 65535. DISPLAY_IDENTIFIER ZR_AUSSB_MX ECU_ADDRESS 0xd000cf10 FORMAT "%5.0" ARRAY_SIZE 8 MATRIX_DIM 8 1 1 /end MEASUREMENT
/begin MEASUREMENT Zr_aussbzyk_hom "" UWORD _CNV_R_R_Def_dez_sl_551_CM 1 100. 0. 65535. DISPLAY_IDENTIFIER ZR_AUSSBZYK_HOM ECU_ADDRESS 0xc0004090 FORMAT "%5.0" /end MEASUREMENT
/begin MEASUREMENT Zr_zyk_nstart "Zyklen-/Segmentzähler Nachstart" UWORD _CNV_R_R_Def_dez_sl_551_CM 1 100. 0. 65535. DISPLAY_IDENTIFIER ZR_ZYK_NSTART ECU_ADDRESS 0xd000df74 FORMAT "%5.0" /end MEASUREMENT
/begin MEASUREMENT Zrseg_aussa "" UWORD _CNV_R_R_Def_dez_sl_551_CM 1 100. 0. 65535. DISPLAY_IDENTIFIER ZRSEG_AUSSA ECU_ADDRESS 0xd000cf00 FORMAT "%5.0" /end MEASUREMENT
/begin MEASUREMENT Zrseg_aussb "" UWORD _CNV_R_R_Def_dez_sl_551_CM 1 100. 0. 65535. DISPLAY_IDENTIFIER ZRSEG_AUSSB ECU_ADDRESS 0xd000cf02 FORMAT "%5.0" /end MEASUREMENT
/begin CHARACTERISTIC CW_KHM "Codewort KHM" VALUE 0xa0827f50 _REC_VAL_20_u1 99.45 _CNV_R_R_Def_dez_sl_551_CM 0. 255. FORMAT "%3.0" /end CHARACTERISTIC
/begin CHARACTERISTIC CW_MAT_FSICHER "Excenterwinkelkorrektur bei Applikationseingriff Excenterwelle 2" VALUE 0xa0819196 _REC_VAL_20_u1 99.45 _CNV_R_R_Def_dez_sl_551_CM 0. 255. FORMAT "%3.0" /end CHARACTERISTIC
/begin CHARACTERISTIC CW_RF "Auswahl Maxbegrenzung Rf_soll" VALUE 0xa082805a _REC_VAL_20_u1 99.45 _CNV_R_R_Def_dez_sl_551_CM 0. 255. FORMAT "%3.0" /end CHARACTERISTIC
/begin CHARACTERISTIC KF_AGR "" MAP 0xa0827f9c _REC_MAP_52_UBYTE_s2_s2_u2 100. _CNV_R_R_Def_eta_sw_606_CM 0. 100.
 /begin AXIS_DESCR STD_AXIS Nkw _CNV_R_R_Def_n_sw_q_595_CM 8 -32768. 32767. FORMAT "%5.0" /end AXIS_DESCR
 /begin AXIS_DESCR STD_AXIS Agr_rate _CNV_R_R_Def_f_uw_b_555_CM 6 0. 99.9984 /end AXIS_DESCR
/end CHARACTERISTIC
/begin CHARACTERISTIC KF_AMOFAK "Korrekturfaktor für Grenzwert zulässige Motorordnung" MAP 0xa0819130 _REC_MAP_52_UBYTE_u2_s2_u2 15.9997 _CNV_R_R_Def_f_uw_b_559_CM 0. 15.9997 FORMAT "%7.4"
 /begin AXIS_DESCR STD_AXIS Tmot _CNV_R_R_Def_t_sw_q_579_CM 6 -327.68 327.67 FORMAT "%5.2" /end AXIS_DESCR
 /begin AXIS_DESCR STD_AXIS Tn_start_10 _CNV_R_R_Def_td_uw__673_CM 6 0. 655.35 FORMAT "%5.2" /end AXIS_DESCR
/end CHARACTERISTIC
/begin CHARACTERISTIC KF_ETARKTE_S "Volumenwirkungsgrad Tankentlüftung Schicht" MAP 0xa0828c1c _REC_MAP_52_UBYTE_u2_s2_s2 99.99845000000002 _CNV_R_R_Def_eta_uw_615_CM 0. 199.9969
 /begin AXIS_DESCR STD_AXIS Nkw _CNV_R_R_Def_n_sw_q_595_CM 8 -32768. 32767. FORMAT "%5.0" /end AXIS_DESCR
 /begin AXIS_DESCR STD_AXIS Rk1_s _CNV_R_R_Def_rk_sw__600_CM 8 -1600. 1599.9511 /end AXIS_DESCR
/end CHARACTERISTIC
/begin CHARACTERISTIC KF_ETATEMIN_S "min. Tankentlüftungswirkungsgrad Schicht (für Androsselung)" MAP 0xa0828ad4 _REC_MAP_52_UBYTE_u2_s2_s2 99.99845000000002 _CNV_R_R_Def_eta_uw_615_CM 0. 199.9969
 /begin AXIS_DESCR STD_AXIS Nkw _CNV_R_R_Def_n_sw_q_595_CM 8 -32768. 32767. FORMAT "%5.0" /end AXIS_DESCR
 /begin AXIS_DESCR STD_AXIS Rk1_s _CNV_R_R_Def_rk_sw__600_CM 8 -1600. 1599.9511 /end AXIS_DESCR
/end CHARACTERISTIC
/begin CHARACTERISTIC KF_EWPFCL_DI "Wärmebilanzkennfeld DI" MAP 0xa081b044 _REC_MAP_52_u1_s2_s2 0.996 _CNV_R_R_Def_f_ub_b_553_CM 0. 0.996
 /begin AXIS_DESCR STD_AXIS Nkw _CNV_R_R_Def_n_sw_q_595_CM 8 -32768. 32767. FORMAT "%5.0" /end AXIS_DESCR
 /begin AXIS_DESCR STD_AXIS Mdk_ewp _CNV_R_R_Def_m_sw_q_554_CM 6 -3276.8 3276.7 FORMAT "%5.2" /end AXIS_DESCR
/end CHARACTERISTIC
/begin CHARACTERISTIC KF_EWPFCOOL "Wärmebilanzkennfeld" MAP 0xa081b094 _REC_MAP_52_u1_s2_s2 0.996 _CNV_R_R_Def_f_ub_b_553_CM 0. 0.996
 /begin AXIS_DESCR STD_AXIS Nkw _CNV_R_R_Def_n_sw_q_595_CM 8 -32768. 32767. FORMAT "%5.0" /end AXIS_DESCR
 /begin AXIS_DESCR STD_AXIS Mdk_ewp _CNV_R_R_Def_m_sw_q_554_CM 6 -3276.8 3276.7 FORMAT "%5.2" /end AXIS_DESCR
/end CHARACTERISTIC
/begin CHARACTERISTIC KF_FDZWKRVR "Überblendfaktor Klopfregelung aus Verbrennungsregelung" MAP 0xa08192c0 _REC_MAP_52_u1_s2_s2 0.996 _CNV_R_R_Def_f_ub_b_553_CM 0. 0.996
 /begin AXIS_DESCR STD_AXIS Dzw_annm _CNV_R_R_Def_zw_sw__604_CM 6 -50. 60. FORMAT "%4.1" /end AXIS_DESCR
 /begin AXIS_DESCR STD_AXIS Tans _CNV_R_R_Def_t_sw_q_578_CM 4 -3276.8 3276.7 FORMAT "%4.1" /end AXIS_DESCR
/end CHARACTERISTIC
/begin CHARACTERISTIC KF_FFRK2_3H "Ueberblendfaktor für Aufteilungsfaktor 2te Einspritzung bei Dreifacheinspritzung kalt(F=1) warm(F=0)" MAP 0xa0828498 _REC_MAP_52_u1_u2_s2 1. _CNV_R_R_Def_f_ub_b_619_CM 0. 1.
 /begin AXIS_DESCR STD_AXIS Zr_zyk_nstart _CNV_R_R_Def_dez_sl_551_CM 4 0. 65535. FORMAT "%5.0" /end AXIS_DESCR
 /begin AXIS_DESCR STD_AXIS Tmot _CNV_R_R_Def_t_sw_q_579_CM 4 -327.68 327.67 FORMAT "%5.2" /end AXIS_DESCR
/end CHARACTERISTIC
/begin CHARACTERISTIC KF_FFRK2_H "Ueberblendfaktor für Aufteilungsfaktor Doppeleinspritzung kalt(F=1) warm(F=0)" MAP 0xa0828474 _REC_MAP_52_u1_u2_s2 1. _CNV_R_R_Def_f_ub_b_619_CM 0. 1.
 /begin AXIS_DESCR STD_AXIS Zr_zyk_nstart _CNV_R_R_Def_dez_sl_551_CM 4 0. 65535. FORMAT "%5.0" /end AXIS_DESCR
 /begin AXIS_DESCR STD_AXIS Tmot _CNV_R_R_Def_t_sw_q_579_CM 4 -327.68 327.67 FORMAT "%5.2" /end AXIS_DESCR
/end CHARACTERISTIC
/begin CHARACTERISTIC KF_FFRK3_3H "Ueberblendfaktor für Aufteilungsfaktor 3te Einspritzung bei Dreifacheinspritzung kalt(F=1) warm(F=0)" MAP 0xa08284bc _REC_MAP_52_u1_u2_s2 1. _CNV_R_R_Def_f_ub_b_619_CM 0. 1.
 /begin AXIS_DESCR STD_AXIS Zr_zyk_nstart _CNV_R_R_Def_dez_sl_551_CM 4 0. 65535. FORMAT "%5.0" /end AXIS_DESCR
 /begin AXIS_DESCR STD_AXIS Tmot _CNV_R_R_Def_t_sw_q_579_CM 4 -327.68 327.67 FORMAT "%5.2" /end AXIS_DESCR
/end CHARACTERISTIC
/begin CHARACTERISTIC KF_FRK2KOR_KH "Warmlaufkorrektur Katheizmenge" MAP 0xa08284e0 _REC_MAP_52_UBYTE_u2_u2_s2 1.9999 _CNV_R_R_Def_f_uw_b_590_CM 0. 1.9999 FORMAT "%14.5"
 /begin AXIS_DESCR STD_AXIS Tn_start_10 _CNV_R_R_Def_td_uw__673_CM 8 0. 655.35 FORMAT "%5.2" /end AXIS_DESCR
 /begin AXIS_DESCR STD_AXIS Tmot _CNV_R_R_Def_t_sw_q_579_CM 8 -327.68 327.67 FORMAT "%5.2" /end AXIS_DESCR
/end CHARACTERISTIC
/begin CHARACTERISTIC KF_FRK2K_3H "Aufteilungsfaktor 2te Einspritzung bei 3fach Einspritzung" MAP 0xa082a7b8 _REC_MAP_52_UBYTE_u2_s2_s2 1. _CNV_R_R_Def_f_uw_b_622_CM 0. 1. FORMAT "%7.4"
 /begin AXIS_DESCR STD_AXIS Nkw _CNV_R_R_Def_n_sw_q_595_CM 12 -32768. 32767. FORMAT "%5.0" /end AXIS_DESCR
 /begin AXIS_DESCR STD_AXIS Rk_sollm_h _CNV_R_R_Def_rk_sw__600_CM 12 -1600. 1599.9511 /end AXIS_DESCR
/end CHARACTERISTIC
/begin CHARACTERISTIC KF_FRK2K_H "Aufteilungsfaktor Doppeleinspritzung Kalt" MAP 0xa082a510 _REC_MAP_52_UBYTE_u2_s2_s2 1. _CNV_R_R_Def_f_uw_b_622_CM 0. 1. FORMAT "%7.4"
 /begin AXIS_DESCR STD_AXIS Nkw _CNV_R_R_Def_n_sw_q_595_CM 12 -32768. 32767. FORMAT "%5.0" /end AXIS_DESCR
 /begin AXIS_DESCR STD_AXIS Rk_sollm_h _CNV_R_R_Def_rk_sw__600_CM 12 -1600. 1599.9511 /end AXIS_DESCR
/end CHARACTERISTIC
/begin CHARACTERISTIC KF_FRK2_3H "Aufteilungsfaktor 2te Einspritzung bei 3fach Einspritzung" MAP 0xa082a664 _REC_MAP_52_UBYTE_u2_s2_s2 1. _CNV_R_R_Def_f_uw_b_622_CM 0. 1. FORMAT "%7.4"
 /begin AXIS_DESCR STD_AXIS Nkw _CNV_R_R_Def_n_sw_q_595_CM 12 -32768. 32767. FORMAT "%5.0" /end AXIS_DESCR
 /begin AXIS_DESCR STD_AXIS Rk_sollm_h _CNV_R_R_Def_rk_sw__600_CM 12 -1600. 1599.9511 /end AXIS_DESCR
/end CHARACTERISTIC
/begin CHARACTERISTIC KF_FRK2_H "Aufteilungsfaktor Doppeleinspritzung Homogen Warm" MAP 0xa082a3bc _REC_MAP_52_UBYTE_u2_s2_s2 1. _CNV_R_R_Def_f_uw_b_622_CM 0. 1. FORMAT "%7.4"
 /begin AXIS_DESCR STD_AXIS Nkw _CNV_R_R_Def_n_sw_q_595_CM 12 -32768. 32767. FORMAT "%5.0" /end AXIS_DESCR
 /begin AXIS_DESCR STD_AXIS Rk_sollm_h _CNV_R_R_Def_rk_sw__600_CM 12 -1600. 1599.9511 /end AXIS_DESCR
/end CHARACTERISTIC
/begin CHARACTERISTIC KF_FRK3K_3H "Aufteilungsfaktor 3te Einspritzung bei 3fach Einspritzung" MAP 0xa082aa60 _REC_MAP_52_UBYTE_u2_s2_s2 1. _CNV_R_R_Def_f_uw_b_622_CM 0. 1. FORMAT "%7.4"
 /begin AXIS_DESCR STD_AXIS Nkw _CNV_R_R_Def_n_sw_q_595_CM 12 -32768. 32767. FORMAT "%5.0" /end AXIS_DESCR
 /begin AXIS_DESCR STD_AXIS Rk_sollm_h _CNV_R_R_Def_rk_sw__600_CM 12 -1600. 1599.9511 /end AXIS_DESCR
/end CHARACTERISTIC
/begin CHARACTERISTIC KF_FRK3_3H "Aufteilungsfaktor 3te Einspritzung bei 3fach Einspritzung" MAP 0xa082a90c _REC_MAP_52_UBYTE_u2_s2_s2 1. _CNV_R_R_Def_f_uw_b_622_CM 0. 1. FORMAT "%7.4"
 /begin AXIS_DESCR STD_AXIS Nkw _CNV_R_R_Def_n_sw_q_595_CM 12 -32768. 32767. FORMAT "%5.0" /end AXIS_DESCR
 /begin AXIS_DESCR STD_AXIS Rk_sollm_h _CNV_R_R_Def_rk_sw__600_CM 12 -1600. 1599.9511 /end AXIS_DESCR
/end CHARACTERISTIC
/begin CHARACTERISTIC KF_FRKINST_NEG "Gewichtungsfaktor Rk-Gradient bei DI-Wandfilm negativ" MAP 0xa0828628 _REC_MAP_52_UBYTE_u2_s2_s2 15.9997 _CNV_R_R_Def_f_uw_b_559_CM 0. 15.9997 FORMAT "%7.4"
 /begin AXIS_DESCR STD_AXIS Tmot _CNV_R_R_Def_t_sw_q_579_CM 8 -327.68 327.67 FORMAT "%5.2" /end AXIS_DESCR
 /begin AXIS_DESCR STD_AXIS Nkw _CNV_R_R_Def_n_sw_q_595_CM 8 -32768. 32767. FORMAT "%5.0" /end AXIS_DESCR
/end CHARACTERISTIC
/begin CHARACTERISTIC KF_FRKINST_POS "Gewichtungsfaktor Rk-Gradient bei DI-Wandfilm positiv" MAP 0xa0828584 _REC_MAP_52_UBYTE_u2_s2_s2 15.9997 _CNV_R_R_Def_f_uw_b_559_CM 0. 15.9997 FORMAT "%7.4"
 /begin AXIS_DESCR STD_AXIS Tmot _CNV_R_R_Def_t_sw_q_579_CM 8 -327.68 327.67 FORMAT "%5.2" /end AXIS_DESCR
 /begin AXIS_DESCR STD_AXIS Nkw _CNV_R_R_Def_n_sw_q_595_CM 8 -32768. 32767. FORMAT "%5.0" /end AXIS_DESCR
/end CHARACTERISTIC
/begin CHARACTERISTIC KF_FRKKORRF_1 "Vorsteuerungkorrektur Bank 1" MAP 0xa082ae5c _REC_MAP_52_UBYTE_u2_s2_s2 1.9999 _CNV_R_R_Def_f_uw_b_590_CM 0. 1.9999 FORMAT "%14.5"
 /begin AXIS_DESCR STD_AXIS Nkw _CNV_R_R_Def_n_sw_q_595_CM 16 -32768. 32767. FORMAT "%5.0" /end AXIS_DESCR
 /begin AXIS_DESCR STD_AXIS Rf _CNV_R_R_Def_rf_sw__598_CM 16 -327.68 327.67 FORMAT "%7.4" /end AXIS_DESCR
/end CHARACTERISTIC
/begin CHARACTERISTIC KF_FRKKORRF_2 "Vorsteuerungkorrektur Bank 2" MAP 0xa082b0a0 _REC_MAP_52_UBYTE_u2_s2_s2 1.9999 _CNV_R_R_Def_f_uw_b_590_CM 0. 1.9999 FORMAT "%14.5"
 /begin AXIS_DESCR STD_AXIS Nkw _CNV_R_R_Def_n_sw_q_595_CM 16 -32768. 32767. FORMAT "%5.0" /end AXIS_DESCR
 /begin AXIS_DESCR STD_AXIS Rf _CNV_R_R_Def_rf_sw__598_CM 16 -327.68 327.67 FORMAT "%7.4" /end AXIS_DESCR
/end CHARACTERISTIC
/begin CHARACTERISTIC KF_FRKKOR_HS "KF Rk Warmlaufkorrektur (HS)" MAP 0xa0828730 _REC_MAP_52_UBYTE_u2_s2_s2 3.9999 _CNV_R_R_Def_f_sw_b_616_CM 0. 3.9999 FORMAT "%14.5"
 /begin AXIS_DESCR STD_AXIS Nkw _CNV_R_R_Def_n_sw_q_595_CM 8 -32768. 32767. FORMAT "%5.0" /end AXIS_DESCR
 /begin AXIS_DESCR STD_AXIS Rk_soll_hs _CNV_R_R_Def_rk_sw__600_CM 8 -1600. 1599.9511 /end AXIS_DESCR
/end CHARACTERISTIC
/begin CHARACTERISTIC KF_FRKKOR_S "KF Rk Warmlaufkorrektur (S)" MAP 0xa0828838 _REC_MAP_52_UBYTE_u2_s2_s2 3.9999 _CNV_R_R_Def_f_sw_b_616_CM 0. 3.9999 FORMAT "%14.5"
 /begin AXIS_DESCR STD_AXIS Nkw _CNV_R_R_Def_n_sw_q_595_CM 8 -32768. 32767. FORMAT "%5.0" /end AXIS_DESCR
 /begin AXIS_DESCR STD_AXIS Rk_soll_s _CNV_R_R_Def_rk_sw__600_CM 8 -1600. 1599.9511 /end AXIS_DESCR
/end CHARACTERISTIC
/begin CHARACTERISTIC KF_FRKSTRED "Reduktionskennfeld Start" MAP 0xa082b2e4 _REC_MAP_52_UBYTE_u2_u2_s2 1.9999 _CNV_R_R_Def_f_uw_b_590_CM 0. 1.9999 FORMAT "%14.5"
 /begin AXIS_DESCR STD_AXIS Anzzykl_espr _CNV_R_R_Def_dez_sl_551_CM 16 0. 65535. FORMAT "%5.0" /end AXIS_DESCR
 /begin AXIS_DESCR STD_AXIS Tmot _CNV_R_R_Def_t_sw_q_579_CM 6 -327.68 327.67 FORMAT "%5.2" /end AXIS_DESCR
/end CHARACTERISTIC
/begin CHARACTERISTIC KF_FRKTMOT_HS "KF Rk Warmlaufkorrektur abh. von Tmot (HS)" MAP 0xa08286cc _REC_MAP_52_UBYTE_u2_s2_s2 3.9999 _CNV_R_R_Def_f_sw_b_616_CM 0. 3.9999 FORMAT "%14.5"
 /begin AXIS_DESCR STD_AXIS Tmot _CNV_R_R_Def_t_sw_q_579_CM 6 -327.68 327.67 FORMAT "%5.2" /end AXIS_DESCR
 /begin AXIS_DESCR STD_AXIS Tmot_start _CNV_R_R_Def_t_sw_q_579_CM 6 -327.68 327.67 FORMAT "%5.2" /end AXIS_DESCR
/end CHARACTERISTIC
/begin CHARACTERISTIC KF_FRKTMOT_S "KF Rk Warmlaufkorrektur abh. von Tmot (S)" MAP 0xa08287d4 _REC_MAP_52_UBYTE_u2_s2_s2 3.9999 _CNV_R_R_Def_f_sw_b_616_CM 0. 3.9999 FORMAT "%14.5"
 /begin AXIS_DESCR STD_AXIS Tmot _CNV_R_R_Def_t_sw_q_579_CM 6 -327.68 327.67 FORMAT "%5.2" /end AXIS_DESCR
 /begin AXIS_DESCR STD_AXIS Tmot_start _CNV_R_R_Def_t_sw_q_579_CM 6 -327.68 327.67 FORMAT "%5.2" /end AXIS_DESCR
/end CHARACTERISTIC
/begin CHARACTERISTIC KF_FTIZSK_MN "Grenzwert zylinderselektive Gemischkorrektur /Laufruhegleichstellung" MAP 0xa08192f0 _REC_MAP_52_UBYTE_s2_s2_s2 99.9984 _CNV_R_R_Def_frel_s_624_CM -50. 49.9984
 /begin AXIS_DESCR STD_AXIS Rf _CNV_R_R_Def_rf_sw__598_CM 6 -327.68 327.67 FORMAT "%7.4" /end AXIS_DESCR
 /begin AXIS_DESCR STD_AXIS Nkw _CNV_R_R_Def_n_sw_q_595_CM 4 -32768. 32767. FORMAT "%5.0" /end AXIS_DESCR
/end CHARACTERISTIC
/begin CHARACTERISTIC KF_FTMOTVR "Überblendfaktor Tmoteinfluss aus Verbrennungsregelung" MAP 0xa0819280 _REC_MAP_52_u1_s2_s2 0.996 _CNV_R_R_Def_f_ub_b_553_CM 0. 0.996
 /begin AXIS_DESCR STD_AXIS Tmot _CNV_R_R_Def_t_sw_q_579_CM 6 -327.68 327.67 FORMAT "%5.2" /end AXIS_DESCR
 /begin AXIS_DESCR STD_AXIS Tmot_start _CNV_R_R_Def_t_sw_q_579_CM 6 -327.68 327.67 FORMAT "%5.2" /end AXIS_DESCR
/end CHARACTERISTIC
/begin CHARACTERISTIC KF_FTMOTVR_GD "Überblendfaktor Tmoteinfluss aus Verbrennungsregelung Vollhubbetrieb" MAP 0xa0819240 _REC_MAP_52_u1_s2_s2 0.996 _CNV_R_R_Def_f_ub_b_553_CM 0. 0.996
 /begin AXIS_DESCR STD_AXIS Tmot _CNV_R_R_Def_t_sw_q_579_CM 6 -327.68 327.67 FORMAT "%5.2" /end AXIS_DESCR
 /begin AXIS_DESCR STD_AXIS Tmot_start _CNV_R_R_Def_t_sw_q_579_CM 6 -327.68 327.67 FORMAT "%5.2" /end AXIS_DESCR
/end CHARACTERISTIC
/begin CHARACTERISTIC KF_GBTR "Kennfeld geregelter Betrieb" MAP 0xa081b168 _REC_MAP_52_u1_s2_s2 99.45 _CNV_R_R_Def_dez_sl_551_CM 0. 255. FORMAT "%3.0"
 /begin AXIS_DESCR STD_AXIS Nkw _CNV_R_R_Def_n_sw_q_595_CM 8 -32768. 32767. FORMAT "%5.0" /end AXIS_DESCR
 /begin AXIS_DESCR STD_AXIS Mdk_ewp_help _CNV_R_R_Def_m_sw_q_554_CM 6 -3276.8 3276.7 FORMAT "%5.2" /end AXIS_DESCR
/end CHARACTERISTIC
/begin CHARACTERISTIC KF_LABAS_H "Kennfeld Basis Lambda (homogen)" MAP 0xa08288dc _REC_MAP_52_UBYTE_u2_s2_s2 15.9997 _CNV_R_R_Def_f_uw_b_559_CM 0. 15.9997 FORMAT "%7.4"
 /begin AXIS_DESCR STD_AXIS Nkw _CNV_R_R_Def_n_sw_q_595_CM 12 -32768. 32767. FORMAT "%5.0" /end AXIS_DESCR
 /begin AXIS_DESCR STD_AXIS Rk_korzw_h _CNV_R_R_Def_rk_sw__600_CM 12 -1600. 1599.9511 /end AXIS_DESCR
/end CHARACTERISTIC
/begin CHARACTERISTIC KF_LURABSFAK "Wichtung für VR-Schwelle bei stochastisch unruhigen Verbrennugen" MAP 0xa08190cc _REC_MAP_52_UBYTE_u2_s2_u2 1.9999 _CNV_R_R_Def_f_uw_b_590_CM 0. 1.9999 FORMAT "%14.5"
 /begin AXIS_DESCR STD_AXIS Tmot _CNV_R_R_Def_t_sw_q_579_CM 6 -327.68 327.67 FORMAT "%5.2" /end AXIS_DESCR
 /begin AXIS_DESCR STD_AXIS Tn_start_10 _CNV_R_R_Def_td_uw__673_CM 6 0. 655.35 FORMAT "%5.2" /end AXIS_DESCR
/end CHARACTERISTIC
/begin CHARACTERISTIC KF_LURABSMX "Schwelle für stochastisch unruhige Verbrennugen" MAP 0xa0819068 _REC_MAP_52_UBYTE_s2_s2_s2 131.07 _CNV_R_R_Def_f_sw_q_560_CM -3276.8 3276.7 FORMAT "%5.2"
 /begin AXIS_DESCR STD_AXIS Nkw _CNV_R_R_Def_n_sw_q_595_CM 6 -32768. 32767. FORMAT "%5.0" /end AXIS_DESCR
 /begin AXIS_DESCR STD_AXIS Rf _CNV_R_R_Def_rf_sw__598_CM 6 -327.68 327.67 FORMAT "%7.4" /end AXIS_DESCR
/end CHARACTERISTIC
/begin CHARACTERISTIC KF_LURMDIFAK "Wichtung der Lur-Werte bei Laständerungen" MAP 0xa0819004 _REC_MAP_52_UBYTE_u2_s2_s2 1.9999 _CNV_R_R_Def_f_uw_b_590_CM 0. 1.9999 FORMAT "%14.5"
 /begin AXIS_DESCR STD_AXIS Mdi_dif_vz _CNV_R_R_Def_m_sw_q_554_CM 6 -3276.8 3276.7 FORMAT "%5.2" /end AXIS_DESCR
 /begin AXIS_DESCR STD_AXIS Nkw _CNV_R_R_Def_n_sw_q_595_CM 6 -32768. 32767. FORMAT "%5.0" /end AXIS_DESCR
/end CHARACTERISTIC
/begin CHARACTERISTIC KF_MDIBAS_HS "-" MAP 0xa08292c8 _REC_MAP_52_UBYTE_s2_s2_s2 131.07 _CNV_R_R_Def_m_sw_q_554_CM -3276.8 3276.7 FORMAT "%5.2"
 /begin AXIS_DESCR STD_AXIS Nkw _CNV_R_R_Def_n_sw_q_595_CM 10 -32768. 32767. FORMAT "%5.0" /end AXIS_DESCR
 /begin AXIS_DESCR STD_AXIS Rf _CNV_R_R_Def_rf_sw__598_CM 12 -327.68 327.67 FORMAT "%7.4" /end AXIS_DESCR
/end CHARACTERISTIC
/begin CHARACTERISTIC KF_MDIBAS_S "-" MAP 0xa0829088 _REC_MAP_52_UBYTE_s2_s2_s2 131.07 _CNV_R_R_Def_m_sw_q_554_CM -3276.8 3276.7 FORMAT "%5.2"
 /begin AXIS_DESCR STD_AXIS Nkw _CNV_R_R_Def_n_sw_q_595_CM 10 -32768. 32767. FORMAT "%5.0" /end AXIS_DESCR
 /begin AXIS_DESCR STD_AXIS Rf _CNV_R_R_Def_rf_sw__598_CM 12 -327.68 327.67 FORMAT "%7.4" /end AXIS_DESCR
/end CHARACTERISTIC
/begin CHARACTERISTIC KF_MDIMIN_HS "minimal mögliches MDI in HS bei akt. Füllung" MAP 0xa0829748 _REC_MAP_52_UBYTE_s2_s2_s2 131.07 _CNV_R_R_Def_m_sw_q_554_CM -3276.8 3276.7 FORMAT "%5.2"
 /begin AXIS_DESCR STD_AXIS Nkw _CNV_R_R_Def_n_sw_q_595_CM 10 -32768. 32767. FORMAT "%5.0" /end AXIS_DESCR
 /begin AXIS_DESCR STD_AXIS Rf _CNV_R_R_Def_rf_sw__598_CM 12 -327.68 327.67 FORMAT "%7.4" /end AXIS_DESCR
/end CHARACTERISTIC
/begin CHARACTERISTIC KF_MDIMIN_S "minimal mögliches MDI in S bei akt. Füllung" MAP 0xa0829628 _REC_MAP_52_UBYTE_s2_s2_s2 131.07 _CNV_R_R_Def_m_sw_q_554_CM -3276.8 3276.7 FORMAT "%5.2"
 /begin AXIS_DESCR STD_AXIS Nkw _CNV_R_R_Def_n_sw_q_595_CM 10 -32768. 32767. FORMAT "%5.0" /end AXIS_DESCR
 /begin AXIS_DESCR STD_AXIS Rf _CNV_R_R_Def_rf_sw__598_CM 12 -327.68 327.67 FORMAT "%7.4" /end AXIS_DESCR
/end CHARACTERISTIC
/begin CHARACTERISTIC KF_PRAILK_H "Kennfeld RAILDRUCK HOMOGEN KALT " MAP 0xa0833630 _REC_MAP_52_UBYTE_u2_s2_s2 39.9993 _CNV_R_R_Def_p_uw_q_676_CM 0. 39.9993 FORMAT "%7.4"
 /begin AXIS_DESCR STD_AXIS Nkw _CNV_R_R_Def_n_sw_q_595_CM 8 -32768. 32767. FORMAT "%5.0" /end AXIS_DESCR
 /begin AXIS_DESCR STD_AXIS Rk_soll_h _CNV_R_R_Def_rk_sw__600_CM 8 -1600. 1599.9511 /end AXIS_DESCR
/end CHARACTERISTIC
/begin CHARACTERISTIC KF_PRAILNL_H "Kennfeld RAILDRUCK NOTLAUF" MAP 0xa08336d4 _REC_MAP_52_UBYTE_u2_s2_s2 39.9993 _CNV_R_R_Def_p_uw_q_676_CM 0. 39.9993 FORMAT "%7.4"
 /begin AXIS_DESCR STD_AXIS Nkw _CNV_R_R_Def_n_sw_q_595_CM 8 -32768. 32767. FORMAT "%5.0" /end AXIS_DESCR
 /begin AXIS_DESCR STD_AXIS Rk_soll_h _CNV_R_R_Def_rk_sw__600_CM 8 -1600. 1599.9511 /end AXIS_DESCR
/end CHARACTERISTIC
/begin CHARACTERISTIC KF_PRAIL_H "Kennfeld RAILDRUCK HOMOGEN" MAP 0xa0833778 _REC_MAP_52_UBYTE_u2_s2_s2 39.9993 _CNV_R_R_Def_p_uw_q_676_CM 0. 39.9993 FORMAT "%7.4"
 /begin AXIS_DESCR STD_AXIS Nkw _CNV_R_R_Def_n_sw_q_595_CM 8 -32768. 32767. FORMAT "%5.0" /end AXIS_DESCR
 /begin AXIS_DESCR STD_AXIS Rk_soll_h _CNV_R_R_Def_rk_sw__600_CM 8 -1600. 1599.9511 /end AXIS_DESCR
/end CHARACTERISTIC
/begin CHARACTERISTIC KF_PRAIL_HS "Kennfeld RAILDRUCK HOMOGEN-SCHICHT" MAP 0xa083381c _REC_MAP_52_UBYTE_u2_s2_s2 39.9993 _CNV_R_R_Def_p_uw_q_676_CM 0. 39.9993 FORMAT "%7.4"
 /begin AXIS_DESCR STD_AXIS Nkw _CNV_R_R_Def_n_sw_q_595_CM 8 -32768. 32767. FORMAT "%5.0" /end AXIS_DESCR
 /begin AXIS_DESCR STD_AXIS Rk_soll_hs _CNV_R_R_Def_rk_sw__600_CM 8 -1600. 1599.9511 /end AXIS_DESCR
/end CHARACTERISTIC
/begin CHARACTERISTIC KF_PRAIL_HSMIN "Kennfeld RAILDRUCK HOMOGEN-SCHICHT MIN." MAP 0xa08338c0 _REC_MAP_52_UBYTE_u2_s2_s2 39.9993 _CNV_R_R_Def_p_uw_q_676_CM 0. 39.9993 FORMAT "%7.4"
 /begin AXIS_DESCR STD_AXIS Nkw _CNV_R_R_Def_n_sw_q_595_CM 8 -32768. 32767. FORMAT "%5.0" /end AXIS_DESCR
 /begin AXIS_DESCR STD_AXIS Rk_soll_hs _CNV_R_R_Def_rk_sw__600_CM 8 -1600. 1599.9511 /end AXIS_DESCR
/end CHARACTERISTIC
/begin CHARACTERISTIC KF_PRAIL_S "Kennfeld RAILDRUCK SCHICHT" MAP 0xa0833964 _REC_MAP_52_UBYTE_u2_s2_s2 39.9993 _CNV_R_R_Def_p_uw_q_676_CM 0. 39.9993 FORMAT "%7.4"
 /begin AXIS_DESCR STD_AXIS Nkw _CNV_R_R_Def_n_sw_q_595_CM 8 -32768. 32767. FORMAT "%5.0" /end AXIS_DESCR
 /begin AXIS_DESCR STD_AXIS Rk_soll_s _CNV_R_R_Def_rk_sw__600_CM 8 -1600. 1599.9511 /end AXIS_DESCR
/end CHARACTERISTIC
/begin CHARACTERISTIC KF_PRAIL_SMIN "Kennfeld RAILDRUCK SCHICHT MIN." MAP 0xa0833a08 _REC_MAP_52_UBYTE_u2_s2_s2 39.9993 _CNV_R_R_Def_p_uw_q_676_CM 0. 39.9993 FORMAT "%7.4"
 /begin AXIS_DESCR STD_AXIS Nkw _CNV_R_R_Def_n_sw_q_595_CM 8 -32768. 32767. FORMAT "%5.0" /end AXIS_DESCR
 /begin AXIS_DESCR STD_AXIS Rk_soll_s _CNV_R_R_Def_rk_sw__600_CM 8 -1600. 1599.9511 /end AXIS_DESCR
/end CHARACTERISTIC
/begin CHARACTERISTIC KF_RFBASK_S "Soll Luft (S) kalt" MAP 0xa0829cf0 _REC_MAP_52_UBYTE_s2_s2_s2 98.30250000000001 _CNV_R_R_Def_rf_sw__598_CM -327.68 327.67 FORMAT "%7.4"
 /begin AXIS_DESCR STD_AXIS Nkw _CNV_R_R_Def_n_sw_q_595_CM 16 -32768. 32767. FORMAT "%5.0" /end AXIS_DESCR
 /begin AXIS_DESCR STD_AXIS Rk_bas_s _CNV_R_R_Def_rk_sw__600_CM 16 -1600. 1599.9511 /end AXIS_DESCR
/end CHARACTERISTIC
/begin CHARACTERISTIC KF_RFBAS_HS "Optimales Rk_soll ohne Mdi_bas-Begrenzung (homogen-schicht)" MAP 0xa082a178 _REC_MAP_52_UBYTE_s2_s2_s2 98.30250000000001 _CNV_R_R_Def_rf_sw__598_CM -327.68 327.67 FORMAT "%7.4"
 /begin AXIS_DESCR STD_AXIS Nkw _CNV_R_R_Def_n_sw_q_595_CM 16 -32768. 32767. FORMAT "%5.0" /end AXIS_DESCR
 /begin AXIS_DESCR STD_AXIS NO_INPUT_QUANTITY _CNV_R_R_Def_rk_sw__600_CM 16 -1600. 1599.9511 /end AXIS_DESCR
/end CHARACTERISTIC
/begin CHARACTERISTIC KF_RFBAS_S "Soll Luft (S) warm" MAP 0xa0829aac _REC_MAP_52_UBYTE_s2_s2_s2 98.30250000000001 _CNV_R_R_Def_rf_sw__598_CM -327.68 327.67 FORMAT "%7.4"
 /begin AXIS_DESCR STD_AXIS Nkw _CNV_R_R_Def_n_sw_q_595_CM 16 -32768. 32767. FORMAT "%5.0" /end AXIS_DESCR
 /begin AXIS_DESCR STD_AXIS Rk_bas_s _CNV_R_R_Def_rk_sw__600_CM 16 -1600. 1599.9511 /end AXIS_DESCR
/end CHARACTERISTIC
/begin CHARACTERISTIC KF_RFMINKH_S "minimal zul. Füllung beim KH in S" MAP 0xa0828b78 _REC_MAP_52_UBYTE_s2_s2_s2 98.30250000000001 _CNV_R_R_Def_rf_sw__598_CM -327.68 327.67 FORMAT "%7.4"
 /begin AXIS_DESCR STD_AXIS Nkw _CNV_R_R_Def_n_sw_q_595_CM 8 -32768. 32767. FORMAT "%5.0" /end AXIS_DESCR
 /begin AXIS_DESCR STD_AXIS Rk_bas_s _CNV_R_R_Def_rk_sw__600_CM 8 -1600. 1599.9511 /end AXIS_DESCR
/end CHARACTERISTIC
/begin CHARACTERISTIC KF_RFMINSA_1 "-" MAP 0xa082b454 _REC_MAP_52_UBYTE_s2_s2_s2 98.30250000000001 _CNV_R_R_Def_rf_sw__598_CM -327.68 327.67 FORMAT "%7.4"
 /begin AXIS_DESCR STD_AXIS Nkw _CNV_R_R_Def_n_sw_q_595_CM 8 -32768. 32767. FORMAT "%5.0" /end AXIS_DESCR
 /begin AXIS_DESCR STD_AXIS Tmot _CNV_R_R_Def_t_sw_q_579_CM 6 -327.68 327.67 FORMAT "%5.2" /end AXIS_DESCR
/end CHARACTERISTIC
/begin CHARACTERISTIC KF_RFMINTE_S "minimal zul. Füllung bei Tankentluftung in S" MAP 0xa0828a30 _REC_MAP_52_UBYTE_s2_s2_s2 98.30250000000001 _CNV_R_R_Def_rf_sw__598_CM -327.68 327.67 FORMAT "%7.4"
 /begin AXIS_DESCR STD_AXIS Nkw _CNV_R_R_Def_n_sw_q_595_CM 8 -32768. 32767. FORMAT "%5.0" /end AXIS_DESCR
 /begin AXIS_DESCR STD_AXIS Rk_bas_s _CNV_R_R_Def_rk_sw__600_CM 8 -1600. 1599.9511 /end AXIS_DESCR
/end CHARACTERISTIC
/begin CHARACTERISTIC KF_RFMIN_1 "-" MAP 0xa082b3d4 _REC_MAP_52_UBYTE_s2_s2_s2 98.30250000000001 _CNV_R_R_Def_rf_sw__598_CM -327.68 327.67 FORMAT "%7.4"
 /begin AXIS_DESCR STD_AXIS Nkw _CNV_R_R_Def_n_sw_q_595_CM 8 -32768. 32767. FORMAT "%5.0" /end AXIS_DESCR
 /begin AXIS_DESCR STD_AXIS Tmot _CNV_R_R_Def_t_sw_q_579_CM 6 -327.68 327.67 FORMAT "%5.2" /end AXIS_DESCR
/end CHARACTERISTIC
/begin CHARACTERISTIC KF_RFOPT_HS "optimale Füllung HS (für ETA-Berechnung)" MAP 0xa0829f34 _REC_MAP_52_UBYTE_s2_s2_s2 98.30250000000001 _CNV_R_R_Def_rf_sw__598_CM -327.68 327.67 FORMAT "%7.4"
 /begin AXIS_DESCR STD_AXIS Nkw _CNV_R_R_Def_n_sw_q_595_CM 16 -32768. 32767. FORMAT "%5.0" /end AXIS_DESCR
 /begin AXIS_DESCR STD_AXIS NO_INPUT_QUANTITY _CNV_R_R_Def_rk_sw__600_CM 16 -1600. 1599.9511 /end AXIS_DESCR
/end CHARACTERISTIC
/begin CHARACTERISTIC KF_RFOPT_S "optimale Füllung S (für ETA-Berechnung)" MAP 0xa0829868 _REC_MAP_52_UBYTE_s2_s2_s2 98.30250000000001 _CNV_R_R_Def_rf_sw__598_CM -327.68 327.67 FORMAT "%7.4"
 /begin AXIS_DESCR STD_AXIS Nkw _CNV_R_R_Def_n_sw_q_595_CM 16 -32768. 32767. FORMAT "%5.0" /end AXIS_DESCR
 /begin AXIS_DESCR STD_AXIS Rk_opt_s _CNV_R_R_Def_rk_sw__600_CM 16 -1600. 1599.9511 /end AXIS_DESCR
/end CHARACTERISTIC
/begin CHARACTERISTIC KF_RK2_HS "Sollkraftstoffmenge 2. Einspritzung HS" MAP 0xa082ad08 _REC_MAP_52_UBYTE_s2_s2_s2 95.99853300000001 _CNV_R_R_Def_rk_sw__600_CM -1600. 1599.9511
 /begin AXIS_DESCR STD_AXIS Nkw _CNV_R_R_Def_n_sw_q_595_CM 12 -32768. 32767. FORMAT "%5.0" /end AXIS_DESCR
 /begin AXIS_DESCR STD_AXIS Rk_soll_hs _CNV_R_R_Def_rk_sw__600_CM 12 -1600. 1599.9511 /end AXIS_DESCR
/end CHARACTERISTIC
/begin CHARACTERISTIC KF_RK2_S "Sollkraftstoffmenge 2. Einspritzung S" MAP 0xa082abb4 _REC_MAP_52_UBYTE_s2_s2_s2 95.99853300000001 _CNV_R_R_Def_rk_sw__600_CM -1600. 1599.9511
 /begin AXIS_DESCR STD_AXIS Nkw _CNV_R_R_Def_n_sw_q_595_CM 12 -32768. 32767. FORMAT "%5.0" /end AXIS_DESCR
 /begin AXIS_DESCR STD_AXIS Rk_soll_s _CNV_R_R_Def_rk_sw__600_CM 12 -1600. 1599.9511 /end AXIS_DESCR
/end CHARACTERISTIC
/begin CHARACTERISTIC KF_RKMAXBG_HS "Maximale Begrenzung rel. Krafstoffmasse (homogen-schicht)" MAP 0xa08291a8 _REC_MAP_52_UBYTE_s2_s2_s2 95.99853300000001 _CNV_R_R_Def_rk_sw__600_CM -1600. 1599.9511
 /begin AXIS_DESCR STD_AXIS Nkw _CNV_R_R_Def_n_sw_q_595_CM 10 -32768. 32767. FORMAT "%5.0" /end AXIS_DESCR
 /begin AXIS_DESCR STD_AXIS Rf _CNV_R_R_Def_rf_sw__598_CM 12 -327.68 327.67 FORMAT "%7.4" /end AXIS_DESCR
/end CHARACTERISTIC
/begin CHARACTERISTIC KF_RKMAXBG_S "Maximale Begrenzung rel. Krafstoffmasse (schicht)" MAP 0xa0828f68 _REC_MAP_52_UBYTE_s2_s2_s2 95.99853300000001 _CNV_R_R_Def_rk_sw__600_CM -1600. 1599.9511
 /begin AXIS_DESCR STD_AXIS Nkw _CNV_R_R_Def_n_sw_q_595_CM 10 -32768. 32767. FORMAT "%5.0" /end AXIS_DESCR
 /begin AXIS_DESCR STD_AXIS Rf _CNV_R_R_Def_rf_sw__598_CM 12 -327.68 327.67 FORMAT "%7.4" /end AXIS_DESCR
/end CHARACTERISTIC
/begin CHARACTERISTIC KF_RKMINBG_HS "Minimale Begrenzung rel. Krafstoffmasse (homogen-schicht)" MAP 0xa0829508 _REC_MAP_52_UBYTE_s2_s2_s2 95.99853300000001 _CNV_R_R_Def_rk_sw__600_CM -1600. 1599.9511
 /begin AXIS_DESCR STD_AXIS Nkw _CNV_R_R_Def_n_sw_q_595_CM 10 -32768. 32767. FORMAT "%5.0" /end AXIS_DESCR
 /begin AXIS_DESCR STD_AXIS Rf _CNV_R_R_Def_rf_sw__598_CM 12 -327.68 327.67 FORMAT "%7.4" /end AXIS_DESCR
/end CHARACTERISTIC
/begin CHARACTERISTIC KF_RKMINBG_S "Minimale Begrenzung rel. Krafstoffmasse (schicht)" MAP 0xa08293e8 _REC_MAP_52_UBYTE_s2_s2_s2 95.99853300000001 _CNV_R_R_Def_rk_sw__600_CM -1600. 1599.9511
 /begin AXIS_DESCR STD_AXIS Nkw _CNV_R_R_Def_n_sw_q_595_CM 10 -32768. 32767. FORMAT "%5.0" /end AXIS_DESCR
 /begin AXIS_DESCR STD_AXIS Rf _CNV_R_R_Def_rf_sw__598_CM 12 -327.68 327.67 FORMAT "%7.4" /end AXIS_DESCR
/end CHARACTERISTIC
/begin CHARACTERISTIC KF_RKMIN_H "Faktor Krafstoffmasse homogen Bank2" MAP 0xa0828cc0 _REC_MAP_52_UBYTE_s2_s2_s2 95.99853300000001 _CNV_R_R_Def_rk_sw__600_CM -1600. 1599.9511
 /begin AXIS_DESCR STD_AXIS Nkw _CNV_R_R_Def_n_sw_q_595_CM 12 -32768. 32767. FORMAT "%5.0" /end AXIS_DESCR
 /begin AXIS_DESCR STD_AXIS Rf _CNV_R_R_Def_rf_sw__598_CM 12 -327.68 327.67 FORMAT "%7.4" /end AXIS_DESCR
/end CHARACTERISTIC
/begin CHARACTERISTIC KF_RKSTART "Relative Krafstoffmasse im Start" MAP 0xa0828e14 _REC_MAP_52_UBYTE_s2_s2_s2 95.99853300000001 _CNV_R_R_Def_rk_sw__600_CM -1600. 1599.9511
 /begin AXIS_DESCR STD_AXIS Nkw _CNV_R_R_Def_n_sw_q_595_CM 12 -32768. 32767. FORMAT "%5.0" /end AXIS_DESCR
 /begin AXIS_DESCR STD_AXIS Tmot _CNV_R_R_Def_t_sw_q_579_CM 12 -327.68 327.67 FORMAT "%5.2" /end AXIS_DESCR
/end CHARACTERISTIC
/begin CHARACTERISTIC KF_WURAMO "Hier könnte Ihr Langbezeichner stehen" MAP 0xa0818e98 _REC_MAP_52_UBYTE_u2_s2_s2 15.9997 _CNV_R_R_Def_f_uw_b_559_CM 0. 15.9997 FORMAT "%7.4"
 /begin AXIS_DESCR STD_AXIS Amocos40 _CNV_R_R_Def_f_sw_q_560_CM 8 -3276.8 3276.7 FORMAT "%5.2" /end AXIS_DESCR
 /begin AXIS_DESCR STD_AXIS Amosin40 _CNV_R_R_Def_f_sw_q_560_CM 8 -3276.8 3276.7 FORMAT "%5.2" /end AXIS_DESCR
/end CHARACTERISTIC
/begin CHARACTERISTIC KL_AMO05_MX "Grenzwert zulässige DFT 0,5 Motorordnung" CURVE 0xa0818f94 _REC_CUR_TKL_UW_VV__u2_s2 15.9997 _CNV_R_R_Def_f_uw_b_559_CM 0. 15.9997 FORMAT "%7.4"
 /begin AXIS_DESCR STD_AXIS Nkw _CNV_R_R_Def_n_sw_q_595_CM 6 -32768. 32767. FORMAT "%5.0" /end AXIS_DESCR
/end CHARACTERISTIC
/begin CHARACTERISTIC KL_AMO10_MX "Grenzwert zulässige DFT 1,0 Motorordnung" CURVE 0xa0818fb0 _REC_CUR_TKL_UW_VV__u2_s2 15.9997 _CNV_R_R_Def_f_uw_b_559_CM 0. 15.9997 FORMAT "%7.4"
 /begin AXIS_DESCR STD_AXIS Nkw _CNV_R_R_Def_n_sw_q_595_CM 6 -32768. 32767. FORMAT "%5.0" /end AXIS_DESCR
/end CHARACTERISTIC
/begin CHARACTERISTIC KL_AMO15_MX "Grenzwert zulässige DFT 1,5 Motorordnung" CURVE 0xa0818fcc _REC_CUR_TKL_UW_VV__u2_s2 15.9997 _CNV_R_R_Def_f_uw_b_559_CM 0. 15.9997 FORMAT "%7.4"
 /begin AXIS_DESCR STD_AXIS Nkw _CNV_R_R_Def_n_sw_q_595_CM 6 -32768. 32767. FORMAT "%5.0" /end AXIS_DESCR
/end CHARACTERISTIC
/begin CHARACTERISTIC KL_AMO20_MX "Grenzwert zulässige DFT 2,0 Motorordnung" CURVE 0xa0818fe8 _REC_CUR_TKL_UW_VV__u2_s2 15.9997 _CNV_R_R_Def_f_uw_b_559_CM 0. 15.9997 FORMAT "%7.4"
 /begin AXIS_DESCR STD_AXIS Nkw _CNV_R_R_Def_n_sw_q_595_CM 6 -32768. 32767. FORMAT "%5.0" /end AXIS_DESCR
/end CHARACTERISTIC
/begin CHARACTERISTIC KL_DRKMAX_NEG "DI-Wandfilm Auslöseschwelle negativ" CURVE 0xa08280a4 _REC_CUR_TKL_UW_VV__s2_s2 95.99853300000001 _CNV_R_R_Def_rk_sw__600_CM -1600. 1599.9511
 /begin AXIS_DESCR STD_AXIS Tmot _CNV_R_R_Def_t_sw_q_579_CM 8 -327.68 327.67 FORMAT "%5.2" /end AXIS_DESCR
/end CHARACTERISTIC
/begin CHARACTERISTIC KL_DRKMIN_POS "DI-Wandfilm Auslöseschwelle positiv" CURVE 0xa0828080 _REC_CUR_TKL_UW_VV__s2_s2 95.99853300000001 _CNV_R_R_Def_rk_sw__600_CM -1600. 1599.9511
 /begin AXIS_DESCR STD_AXIS Tmot _CNV_R_R_Def_t_sw_q_579_CM 8 -327.68 327.67 FORMAT "%5.2" /end AXIS_DESCR
/end CHARACTERISTIC
/begin CHARACTERISTIC KL_ETAESTE_S "Wichtung d. Volumenwirkungsgrads über Androsselung" CURVE 0xa082817c _REC_CUR_TKL_UW_VV__u2_u2 99.99845000000002 _CNV_R_R_Def_eta_uw_615_CM 0. 199.9969
 /begin AXIS_DESCR STD_AXIS Lamb_es_s _CNV_R_R_Def_f_uw_b_559_CM 8 0. 15.9997 FORMAT "%7.4" /end AXIS_DESCR
/end CHARACTERISTIC
/begin CHARACTERISTIC KL_ETALAMTE_S "Durchbrennwirkungsgrad TE" CURVE 0xa08281a0 _REC_CUR_TKL_UW_VV__u2_u2 99.99845000000002 _CNV_R_R_Def_eta_uw_615_CM 0. 199.9969
 /begin AXIS_DESCR STD_AXIS Lamb_te _CNV_R_R_Def_f_uw_b_559_CM 8 0. 15.9997 FORMAT "%7.4" /end AXIS_DESCR
/end CHARACTERISTIC
/begin CHARACTERISTIC KL_ETARF_HS "Wirkungsgrad Rfopt zu Rkopt (homogen-schicht)" CURVE 0xa0828200 _REC_CUR_TKL_UW_VV__u2_s2 99.99845000000002 _CNV_R_R_Def_eta_uw_615_CM 0. 199.9969
 /begin AXIS_DESCR STD_AXIS Drfopt_hs _CNV_R_R_Def_eta_sw_599_CM 14 -200. 199.9938 /end AXIS_DESCR
/end CHARACTERISTIC
/begin CHARACTERISTIC KL_ETARF_S "Wirkungsgrad Rfopt zu Rkopt (schicht)" CURVE 0xa08281c4 _REC_CUR_TKL_UW_VV__u2_s2 99.99845000000002 _CNV_R_R_Def_eta_uw_615_CM 0. 199.9969
 /begin AXIS_DESCR STD_AXIS Drfopt_s _CNV_R_R_Def_eta_sw_599_CM 14 -200. 199.9938 /end AXIS_DESCR
/end CHARACTERISTIC
/begin CHARACTERISTIC KL_FDPSVR "Überblendfaktor Dpseinfluss aus Verbrennungsregelung" CURVE 0xa08191e8 _REC_CUR_TKL_UW_VV__u1_s2 0.996 _CNV_R_R_Def_f_ub_b_553_CM 0. 0.996
 /begin AXIS_DESCR STD_AXIS Dpsvvtte _CNV_R_R_Def_p_sw_q_576_CM 6 -1280. 1279.9609 FORMAT "%5.2" /end AXIS_DESCR
/end CHARACTERISTIC
/begin CHARACTERISTIC KL_FDRFTE "Wichtungskennlinie für Androsselung aus TE in S" CURVE 0xa0828150 _REC_CUR_TKL_UW_VV__s2_u2 1.9999 _CNV_R_R_Def_f_uw_b_590_CM -1. 0.9999 FORMAT "%14.5"
 /begin AXIS_DESCR STD_AXIS F_etatemin_s _CNV_R_R_Def_eta_uw_615_CM 10 0. 199.9969 /end AXIS_DESCR
/end CHARACTERISTIC
/begin CHARACTERISTIC KL_FMDRESVR "Überblendfaktor Momentenreserve aus Verbrennungsregelung" CURVE 0xa08191fc _REC_CUR_TKL_UW_VV__u1_s2 0.996 _CNV_R_R_Def_f_ub_b_553_CM 0. 0.996
 /begin AXIS_DESCR STD_AXIS Md_res_anf _CNV_R_R_Def_m_sw_q_554_CM 6 -3276.8 3276.7 FORMAT "%5.2" /end AXIS_DESCR
/end CHARACTERISTIC
/begin CHARACTERISTIC KL_FRFBAS_S "Überblendfaktor Soll Luft für Schicht warm/kalt" CURVE 0xa0828110 _REC_CUR_TKL_UW_VV__u1_s2 0.996 _CNV_R_R_Def_f_ub_b_553_CM 0. 0.996
 /begin AXIS_DESCR STD_AXIS Tmot _CNV_R_R_Def_t_sw_q_579_CM 6 -327.68 327.67 FORMAT "%5.2" /end AXIS_DESCR
/end CHARACTERISTIC
/begin CHARACTERISTIC KL_FRK2ST_H "Aufteilungsfaktor Doppeleinspritzung HD-Start" CURVE 0xa0828360 _REC_CUR_TKL_UW_VV__u2_s2 1. _CNV_R_R_Def_f_uw_b_622_CM 0. 1. FORMAT "%7.4"
 /begin AXIS_DESCR STD_AXIS Nkw _CNV_R_R_Def_n_sw_q_595_CM 10 -32768. 32767. FORMAT "%5.0" /end AXIS_DESCR
/end CHARACTERISTIC
/begin CHARACTERISTIC KL_FRK2_VL "Aufteilungsfaktor Doppeleinspritzung Vollast" CURVE 0xa0828440 _REC_CUR_TKL_UW_VV__u2_s2 1. _CNV_R_R_Def_f_uw_b_622_CM 0. 1. FORMAT "%7.4"
 /begin AXIS_DESCR STD_AXIS Nkw _CNV_R_R_Def_n_sw_q_595_CM 12 -32768. 32767. FORMAT "%5.0" /end AXIS_DESCR
/end CHARACTERISTIC
/begin CHARACTERISTIC KL_FRKSTP "Korrekturfaktor Startmenge über Raildruck" CURVE 0xa082838c _REC_CUR_TKL_UW_VV__u2_u2 3.9999 _CNV_R_R_Def_f_sw_b_616_CM 0. 3.9999 FORMAT "%14.5"
 /begin AXIS_DESCR STD_AXIS Prail_ist _CNV_R_R_Def_p_uw_q_676_CM 10 0. 39.9993 FORMAT "%7.4" /end AXIS_DESCR
/end CHARACTERISTIC
/begin CHARACTERISTIC KL_FRKST_ND "Rk-Faktor für ND-Start" CURVE 0xa08283b8 _REC_CUR_TKL_UW_VV__u2_s2 3.9999 _CNV_R_R_Def_f_sw_b_616_CM 0. 3.9999 FORMAT "%14.5"
 /begin AXIS_DESCR STD_AXIS Tmot _CNV_R_R_Def_t_sw_q_579_CM 8 -327.68 327.67 FORMAT "%5.2" /end AXIS_DESCR
/end CHARACTERISTIC
/begin CHARACTERISTIC KL_FRKVL_HS "Höhenkorrektur Umschaltgrenzen HS" CURVE 0xa08283f8 _REC_CUR_TKL_UW_VV__u2_u2 3.9999 _CNV_R_R_Def_f_sw_b_616_CM 0. 3.9999 FORMAT "%14.5"
 /begin AXIS_DESCR STD_AXIS F_tvdkho _CNV_R_R_Def_f_sw_b_616_CM 6 0. 3.9999 FORMAT "%14.5" /end AXIS_DESCR
/end CHARACTERISTIC
/begin CHARACTERISTIC KL_FRKVL_S "Höhenkorrektur Umschaltgrenzen S" CURVE 0xa08283dc _REC_CUR_TKL_UW_VV__u2_u2 3.9999 _CNV_R_R_Def_f_sw_b_616_CM 0. 3.9999 FORMAT "%14.5"
 /begin AXIS_DESCR STD_AXIS F_tvdkho _CNV_R_R_Def_f_sw_b_616_CM 6 0. 3.9999 FORMAT "%14.5" /end AXIS_DESCR
/end CHARACTERISTIC
/begin CHARACTERISTIC KL_FRSTGDEK "Kennlinie Faktor dekrementierung Restgaseinfluss" CURVE 0xa08191d4 _REC_CUR_TKL_UW_VV__u2_s2 0.9999 _CNV_R_R_Def_f_uw_b_571_CM 0. 0.9999 FORMAT "%14.5"
 /begin AXIS_DESCR STD_AXIS Vrquo _CNV_R_R_Def_f_sw_b_592_CM 4 -8. 7.9997 FORMAT "%7.4" /end AXIS_DESCR
/end CHARACTERISTIC
/begin CHARACTERISTIC KL_FRSTGINK "Kennlinie Faktor inkrementierung Restgaseinfluss" CURVE 0xa08191b8 _REC_CUR_TKL_UW_VV__u2_s2 0.9999 _CNV_R_R_Def_f_uw_b_571_CM 0. 0.9999 FORMAT "%14.5"
 /begin AXIS_DESCR STD_AXIS Vrquo _CNV_R_R_Def_f_sw_b_592_CM 6 -8. 7.9997 FORMAT "%7.4" /end AXIS_DESCR
/end CHARACTERISTIC
/begin CHARACTERISTIC KL_FTIZSK_MX "Begrenzung Gemischkorrektur Zylinderselektiv" CURVE 0xa0819210 _REC_CUR_TKL_UW_VV__s2_u2 99.9984 _CNV_R_R_Def_frel_s_624_CM -50. 49.9984
 /begin AXIS_DESCR STD_AXIS NO_INPUT_QUANTITY _CNV_R_R_Def_f_uw_b_559_CM 4 0. 15.9997 FORMAT "%7.4" /end AXIS_DESCR
/end CHARACTERISTIC
/begin CHARACTERISTIC KL_KFT_PLOC "P-Anteil KL fuer Kft_p_loc" CURVE 0xa081b0f0 _REC_CUR_TKL_UW_VV__u2_s2 63.99900000000001 _CNV_R_R_Def_f_uw_b_617_CM 0. 63.999 FORMAT "%7.4"
 /begin AXIS_DESCR STD_AXIS Dtkwsoll _CNV_R_R_Def_t_sw_q_579_CM 4 -327.68 327.67 FORMAT "%5.2" /end AXIS_DESCR
/end CHARACTERISTIC
/begin CHARACTERISTIC KL_KHMAX_S "max. zul Klopfhäufigkeit in S" CURVE 0xa082823c _REC_CUR_TKL_UW_VV__s2_s2 99.99844999999999 _CNV_R_R_Def_f_sw_b_570_CM -100. 99.9969
 /begin AXIS_DESCR STD_AXIS Nkw _CNV_R_R_Def_n_sw_q_595_CM 6 -32768. 32767. FORMAT "%5.0" /end AXIS_DESCR
/end CHARACTERISTIC
/begin CHARACTERISTIC KL_KRKINST_NEG "Filterkonstante DI-Wandfilm Negativ" CURVE 0xa08280ec _REC_CUR_TKL_UW_VV__u2_s2 99.9984 _CNV_R_R_Def_f_uw_b_555_CM 0. 99.9984
 /begin AXIS_DESCR STD_AXIS Nkw _CNV_R_R_Def_n_sw_q_595_CM 8 -32768. 32767. FORMAT "%5.0" /end AXIS_DESCR
/end CHARACTERISTIC
/begin CHARACTERISTIC KL_KRKINST_POS "Filterkonstante DI-Wandfilm Positiv" CURVE 0xa08280c8 _REC_CUR_TKL_UW_VV__u2_s2 99.9984 _CNV_R_R_Def_f_uw_b_555_CM 0. 99.9984
 /begin AXIS_DESCR STD_AXIS Nkw _CNV_R_R_Def_n_sw_q_595_CM 8 -32768. 32767. FORMAT "%5.0" /end AXIS_DESCR
/end CHARACTERISTIC
/begin CHARACTERISTIC KL_LURNORM "Korrektur Lur Werte" CURVE 0xa0818f60 _REC_CUR_TKL_UW_VV__s2_s2 99.83843999999999 _CNV_R_R_Def_f_sw_b_750_CM -128. 127.996
 /begin AXIS_DESCR STD_AXIS Nkw _CNV_R_R_Def_dez_sl_551_CM 12 -32768. 32767. FORMAT "%5.0" /end AXIS_DESCR
/end CHARACTERISTIC
/begin CHARACTERISTIC KL_NMAXGRAD_KUP "N-Gradient zur Erkennung Gang rausgeschoben" CURVE 0xa082b4ec _REC_CUR_TKL_UW_VV__s1_u1 81.60000000000001 _CNV_R_R_Def_ngrd_s_661_CM -4096. 4064. FORMAT "%5.2"
 /begin AXIS_DESCR STD_AXIS Gangi _CNV_R_R_Def_dez_sl_551_CM 8 0. 255. FORMAT "%3.0" /end AXIS_DESCR
/end CHARACTERISTIC
/begin CHARACTERISTIC KL_PRAILVL_H "Raildruck Volllast bei Homogen" CURVE 0xa08335fc _REC_CUR_TKL_UW_VV__u2_s2 39.9993 _CNV_R_R_Def_p_uw_q_676_CM 0. 39.9993 FORMAT "%7.4"
 /begin AXIS_DESCR STD_AXIS Nkw _CNV_R_R_Def_n_sw_q_595_CM 12 -32768. 32767. FORMAT "%5.0" /end AXIS_DESCR
/end CHARACTERISTIC
/begin CHARACTERISTIC KL_PRAIL_MIN "Minimaldruck für Start der Einspritzung" CURVE 0xa0828414 _REC_CUR_TKL_UW_VV__u2_s2 39.9993 _CNV_R_R_Def_p_uw_q_676_CM 0. 39.9993 FORMAT "%7.4"
 /begin AXIS_DESCR STD_AXIS Tmot _CNV_R_R_Def_t_sw_q_579_CM 10 -327.68 327.67 FORMAT "%5.2" /end AXIS_DESCR
/end CHARACTERISTIC
/begin CHARACTERISTIC KL_RFGRDMAX "Wirkungsgrad Rfopt zu Rkopt (schicht)" CURVE 0xa0828124 _REC_CUR_TKL_UW_VV__s2_s2 98.30250000000001 _CNV_R_R_Def_rf_sw__598_CM -327.68 327.67 FORMAT "%7.4"
 /begin AXIS_DESCR STD_AXIS Dmdkw_soll _CNV_R_R_Def_m_sw_q_554_CM 10 -3276.8 3276.7 FORMAT "%5.2" /end AXIS_DESCR
/end CHARACTERISTIC
/begin CHARACTERISTIC KL_RKMINDOE_HS "Umschaltgrenze Doppeleinspitzung HS" CURVE 0xa0828334 _REC_CUR_TKL_UW_VV__s2_s2 95.99853300000001 _CNV_R_R_Def_rk_sw__600_CM -1600. 1599.9511
 /begin AXIS_DESCR STD_AXIS Nkw _CNV_R_R_Def_n_sw_q_595_CM 10 -32768. 32767. FORMAT "%5.0" /end AXIS_DESCR
/end CHARACTERISTIC
/begin CHARACTERISTIC KL_RKMINDOE_S "Umschaltgrenze Doppeleinspitzung S" CURVE 0xa0828308 _REC_CUR_TKL_UW_VV__s2_s2 95.99853300000001 _CNV_R_R_Def_rk_sw__600_CM -1600. 1599.9511
 /begin AXIS_DESCR STD_AXIS Nkw _CNV_R_R_Def_n_sw_q_595_CM 10 -32768. 32767. FORMAT "%5.0" /end AXIS_DESCR
/end CHARACTERISTIC
/begin CHARACTERISTIC KL_RKVLO_HS "Betriebsartgrenze HS aus Brennverfahrens-/MD-Gründen" CURVE 0xa0828284 _REC_CUR_TKL_UW_VV__s2_s2 95.99853300000001 _CNV_R_R_Def_rk_sw__600_CM -1600. 1599.9511
 /begin AXIS_DESCR STD_AXIS Nkw _CNV_R_R_Def_n_sw_q_595_CM 10 -32768. 32767. FORMAT "%5.0" /end AXIS_DESCR
/end CHARACTERISTIC
/begin CHARACTERISTIC KL_RKVLO_S "Betriebsartgrenze S aus Brennverfahrens-/MD-Gründen" CURVE 0xa0828258 _REC_CUR_TKL_UW_VV__s2_s2 95.99853300000001 _CNV_R_R_Def_rk_sw__600_CM -1600. 1599.9511
 /begin AXIS_DESCR STD_AXIS Nkw _CNV_R_R_Def_n_sw_q_595_CM 10 -32768. 32767. FORMAT "%5.0" /end AXIS_DESCR
/end CHARACTERISTIC
/begin CHARACTERISTIC KL_RKVLU_HS "Betriebsartgrenze HS wieder möglich" CURVE 0xa08282dc _REC_CUR_TKL_UW_VV__s2_s2 95.99853300000001 _CNV_R_R_Def_rk_sw__600_CM -1600. 1599.9511
 /begin AXIS_DESCR STD_AXIS Nkw _CNV_R_R_Def_n_sw_q_595_CM 10 -32768. 32767. FORMAT "%5.0" /end AXIS_DESCR
/end CHARACTERISTIC
/begin CHARACTERISTIC KL_RKVLU_S "Betriebsartgrenze S wieder möglich" CURVE 0xa08282b0 _REC_CUR_TKL_UW_VV__s2_s2 95.99853300000001 _CNV_R_R_Def_rk_sw__600_CM -1600. 1599.9511
 /begin AXIS_DESCR STD_AXIS Nkw _CNV_R_R_Def_n_sw_q_595_CM 10 -32768. 32767. FORMAT "%5.0" /end AXIS_DESCR
/end CHARACTERISTIC
/begin CHARACTERISTIC KL_TIZSK_INK "Gemischkorrektur Laufunruhegleichstellung" CURVE 0xa0819224 _REC_CUR_TKL_UW_VV__s2_s2 99.9984 _CNV_R_R_Def_frel_s_624_CM -50. 49.9984
 /begin AXIS_DESCR STD_AXIS NO_INPUT_QUANTITY _CNV_R_R_Def_f_sw_q_560_CM 6 -3276.8 3276.7 FORMAT "%5.2" /end AXIS_DESCR
/end CHARACTERISTIC
/begin CHARACTERISTIC KL_VTANS "KL für Schwell Tans zur Umschaltung in BA-HK" CURVE 0xa081b14c _REC_CUR_TKL_UW_VV__s2_u2 131.07 _CNV_R_R_Def_t_sw_q_578_CM -3276.8 3276.7 FORMAT "%4.1"
 /begin AXIS_DESCR STD_AXIS NO_INPUT_QUANTITY _CNV_R_R_Def_v_uw_q_726_CM 6 0. 360. FORMAT "%5.0" /end AXIS_DESCR
/end CHARACTERISTIC
/begin CHARACTERISTIC KL_V_VSKR "Kennlinie zur Wichtung Kraftstoffverbrauch über V" CURVE 0xa081b034 _REC_CUR_TKL_UW_VV__u1_u2 0.996 _CNV_R_R_Def_f_ub_b_553_CM 0. 0.996
 /begin AXIS_DESCR STD_AXIS V _CNV_R_R_Def_dez_sl_551_CM 4 0. 65535. FORMAT "%5.0" /end AXIS_DESCR
/end CHARACTERISTIC
/begin CHARACTERISTIC KL_ZYKLHD_MAX "Maximale Anzahl Zyklen nach Start für HD-Start" CURVE 0xa082805c _REC_CUR_TKL_UW_VV__u2_s2 0. _CNV_R_R_Def_dez_sl_551_CM 0. 65535. FORMAT "%5.0"
 /begin AXIS_DESCR STD_AXIS Tmot _CNV_R_R_Def_t_sw_q_579_CM 8 -327.68 327.67 FORMAT "%5.2" /end AXIS_DESCR
/end CHARACTERISTIC
/begin CHARACTERISTIC K_BANKWAHL "Tabelle Zuordnung Zylinder zur Bank" VAL_BLK 0xa0818f40 _REC_VAL_2_u1 1. _CNV_R_R_Def_dez_sl_551_CM 1. 2. FORMAT "%3.0" NUMBER 8 /end CHARACTERISTIC
/begin CHARACTERISTIC K_BA_WMAPPL "Auswahl Betriebsart Wärmemanagement" VALUE 0xa081b13c _REC_VAL_20_u1 3.9 _CNV_S_11_Def_ba_wm_569_CM 0. 10. BIT_MASK 0xFF /end CHARACTERISTIC
/begin CHARACTERISTIC K_BEQSANFMN "Schwelle für Qs_anf_klima BA-Befüllen/Entlüften" VALUE 0xa081b13d _REC_VAL_20_u1 99.60930000000001 _CNV_R_R_Def_f_ub_b_586_CM 0. 99.60930000000001 FORMAT "%5.2" /end CHARACTERISTIC
/begin CHARACTERISTIC K_DLASOLL_MAX "Maximale Lambdasolldifferenz Bank 1/2" VALUE 0xa0827f66 _REC_VAL_20_s2 15.9997 _CNV_R_R_Def_f_sw_b_592_CM -8. 7.9997 FORMAT "%7.4" /end CHARACTERISTIC
/begin CHARACTERISTIC K_DMDKW_MX "Schwelle unter dem Rf_soll Filturung erlaubt wird" VALUE 0xa082804c _REC_VAL_20_s2 131.07 _CNV_R_R_Def_m_sw_q_554_CM -3276.8 3276.7 FORMAT "%5.2" /end CHARACTERISTIC
/begin CHARACTERISTIC K_DRFSOLL_FILT "Umschalter Filtermethode Drf_soll" VALUE 0xa0827f5e _REC_VAL_20_u1 5. _CNV_R_R_Def_dez_sl_551_CM 0. 5. FORMAT "%3.0" /end CHARACTERISTIC
/begin CHARACTERISTIC K_DRFTEMX "Maximal zulässige Differenz TE Androsseln" VALUE 0xa082804a _REC_VAL_20_s2 98.30250000000001 _CNV_R_R_Def_rf_sw__598_CM -327.68 327.67 FORMAT "%7.4" /end CHARACTERISTIC
/begin CHARACTERISTIC K_DRKMAX_NEG "Drk-Schwelle DI-Wandfilm negativ" VALUE 0xa0827f74 _REC_VAL_20_s2 95.99853300000001 _CNV_R_R_Def_rk_sw__600_CM -1600. 1599.9511 /end CHARACTERISTIC
/begin CHARACTERISTIC K_DRKMIN_POS "Drk-Schwelle DI-Wandfilm positiv" VALUE 0xa0827f72 _REC_VAL_20_s2 95.99853300000001 _CNV_R_R_Def_rk_sw__600_CM -1600. 1599.9511 /end CHARACTERISTIC
/begin CHARACTERISTIC K_ETAMAX_DOE "max. Zündwinkelwirkungsgrad bei dem DOE zulässig ist" VALUE 0xa082801e _REC_VAL_20_s2 100. _CNV_R_R_Def_eta_sw_606_CM 0. 100. /end CHARACTERISTIC
/begin CHARACTERISTIC K_ETAMAX_SPLIT "" VALUE 0xa0828038 _REC_VAL_20_s2 99.99844999999999 _CNV_R_R_Def_eta_sw_599_CM -200. 199.9938 /end CHARACTERISTIC
/begin CHARACTERISTIC K_ETAMIN_EE "min. Zündwinkelwirkungsgrad bei dem EE wieder zulässig ist" VALUE 0xa082801c _REC_VAL_20_s2 100. _CNV_R_R_Def_eta_sw_606_CM 0. 100. /end CHARACTERISTIC
/begin CHARACTERISTIC K_ETA_EWPGETR "Wirkungsgrad A-Getriebe" VALUE 0xa081b02d _REC_VAL_20_u1 0.996 _CNV_R_R_Def_f_ub_b_553_CM 0. 0.996 /end CHARACTERISTIC
/begin CHARACTERISTIC K_ETA_KH_S "Applikationswert Wirkungsgrad KH (schicht)" VALUE 0xa0828036 _REC_VAL_20_s2 99.99379999999999 _CNV_R_R_Def_eta_sw_599_CM 6.2e-003 199.9938 /end CHARACTERISTIC
/begin CHARACTERISTIC K_EWPACMX "Maximaler wert für Aufsummierte Kraftstoffmenge" VALUE 0xa081b12e _REC_VAL_20_u2 89.998626 _CNV_R_R_Def_f_uw_b_730_CM 0. 2999.9542 FORMAT "%5.2" /end CHARACTERISTIC
/begin CHARACTERISTIC K_EWPTWAlMX "Temperaturschwelle für Ende Warmlauf" VALUE 0xa081b104 _REC_VAL_20_s2 98.30250000000001 _CNV_R_R_Def_t_sw_q_579_CM -327.68 327.67 DISPLAY_IDENTIFIER K_EWPTWALMX FORMAT "%5.2" /end CHARACTERISTIC
/begin CHARACTERISTIC K_EWPWACAL "Kalibrierfaktor für Verbrauchsziel-Berechnung" VALUE 0xa081b106 _REC_VAL_20_s2 98.30250000000001 _CNV_R_R_Def_t_sw_q_579_CM -327.68 327.67 FORMAT "%5.2" /end CHARACTERISTIC
/begin CHARACTERISTIC K_EWPWAKOR "Korrekturfaktor für Verbrauchszielberechnung" VALUE 0xa081b13e _REC_VAL_20_u1 0.9335 _CNV_R_R_Def_f_ub_b_553_CM 6.25e-002 0.996 /end CHARACTERISTIC
/begin CHARACTERISTIC K_EWPWA_B "Temperatur-Wert für Verbrauchszielberechnung" VALUE 0xa081b108 _REC_VAL_20_s2 98.30250000000001 _CNV_R_R_Def_t_sw_q_579_CM -327.68 327.67 FORMAT "%5.2" /end CHARACTERISTIC
/begin CHARACTERISTIC K_EWP_CALV "Faktor für Volumenstromberechnung" VALUE 0xa081b02e _REC_VAL_20_u1 15.9375 _CNV_R_R_Def_f_ub_b_743_CM 0. 15.9375 FORMAT "%5.2" /end CHARACTERISTIC
/begin CHARACTERISTIC K_EWP_MN "Minimalvolumenstrom bei verbrauchsberechneter Größe" VALUE 0xa081b028 _REC_VAL_20_u2 99.998474 _CNV_R_R_Def_vs_uw__686_CM 0. 9999.847400000001 FORMAT "%5.2" /end CHARACTERISTIC
/begin CHARACTERISTIC K_EWP_MX "Maximaler Volumenstrom bei verbrauchsberechneter Größe" VALUE 0xa081b02a _REC_VAL_20_u2 99.998474 _CNV_R_R_Def_vs_uw__686_CM 0. 9999.847400000001 FORMAT "%5.2" /end CHARACTERISTIC
/begin CHARACTERISTIC K_EWP_PE "Leistungsschwelle zum Abbruch BA-Warmlauf" VALUE 0xa081b130 _REC_VAL_20_u2 99.99847 _CNV_R_R_Def_pe_uw__678_CM 0. 999.9847 /end CHARACTERISTIC
/begin CHARACTERISTIC K_EWP_QS "Wärmstromanforderungs Schwelle für verzögerten Warmlaufabbruch " VALUE 0xa081b13f _REC_VAL_20_u1 99.60930000000001 _CNV_R_R_Def_f_ub_b_586_CM 0. 99.60930000000001 FORMAT "%5.2" /end CHARACTERISTIC
/begin CHARACTERISTIC K_EWP_TDPE "Zeitverzögerung für Abbruch BA-Warmlauf" VALUE 0xa081b132 _REC_VAL_20_u2 131.07 _CNV_R_R_Def_td_uw__718_CM 0. 13107. FORMAT "%4.1" /end CHARACTERISTIC
/begin CHARACTERISTIC K_EWP_TDQS "Zeit für Verzögerung Wärmstrom Abbruchanforderung" VALUE 0xa081b134 _REC_VAL_20_u2 51. _CNV_R_R_Def_td_uw__718_CM 0. 51. FORMAT "%4.1" /end CHARACTERISTIC
/begin CHARACTERISTIC K_FAKAMO05 "Hier könnte Ihr Langbezeichner stehen" VALUE 0xa0818e86 _REC_VAL_20_u2 15.9997 _CNV_R_R_Def_f_uw_b_559_CM 0. 15.9997 FORMAT "%7.4" /end CHARACTERISTIC
/begin CHARACTERISTIC K_FAKAMO10 "Hier könnte Ihr Langbezeichner stehen" VALUE 0xa0818e88 _REC_VAL_20_u2 15.9997 _CNV_R_R_Def_f_uw_b_559_CM 0. 15.9997 FORMAT "%7.4" /end CHARACTERISTIC
/begin CHARACTERISTIC K_FAKAMO15 "Hier könnte Ihr Langbezeichner stehen" VALUE 0xa0818e8a _REC_VAL_20_u2 15.9997 _CNV_R_R_Def_f_uw_b_559_CM 0. 15.9997 FORMAT "%7.4" /end CHARACTERISTIC
/begin CHARACTERISTIC K_FAKAMO20 "Hier könnte Ihr Langbezeichner stehen" VALUE 0xa0818e8c _REC_VAL_20_u2 15.9997 _CNV_R_R_Def_f_uw_b_559_CM 0. 15.9997 FORMAT "%7.4" /end CHARACTERISTIC
/begin CHARACTERISTIC K_FAKAMO25 "Hier könnte Ihr Langbezeichner stehen" VALUE 0xa0818e8e _REC_VAL_20_u2 15.9997 _CNV_R_R_Def_f_uw_b_559_CM 0. 15.9997 FORMAT "%7.4" /end CHARACTERISTIC
/begin CHARACTERISTIC K_FAKAMO30 "Hier könnte Ihr Langbezeichner stehen" VALUE 0xa0818e90 _REC_VAL_20_u2 15.9997 _CNV_R_R_Def_f_uw_b_559_CM 0. 15.9997 FORMAT "%7.4" /end CHARACTERISTIC
/begin CHARACTERISTIC K_FAKAMO35 "Hier könnte Ihr Langbezeichner stehen" VALUE 0xa0818e92 _REC_VAL_20_u2 15.9997 _CNV_R_R_Def_f_uw_b_559_CM 0. 15.9997 FORMAT "%7.4" /end CHARACTERISTIC
/begin CHARACTERISTIC K_FAKAMO40 "Hier könnte Ihr Langbezeichner stehen" VALUE 0xa0818e94 _REC_VAL_20_u2 15.9997 _CNV_R_R_Def_f_uw_b_559_CM 0. 15.9997 FORMAT "%7.4" /end CHARACTERISTIC
/begin CHARACTERISTIC K_FATLDYN_MX "Max. F_atldyn für Lambdavorgabe Abgasprior (B_laprio_abgas)" VALUE 0xa0827f5f _REC_VAL_20_u1 0.996 _CNV_R_R_Def_f_ub_b_553_CM 0. 0.996 /end CHARACTERISTIC
/begin CHARACTERISTIC K_FDRFSOLL_FILT "Faktor für Drfsoll-Überhöhung" VALUE 0xa0827f7a _REC_VAL_20_u2 7.9998 _CNV_R_R_Def_f_uw_b_572_CM 0. 7.9998 FORMAT "%7.4" /end CHARACTERISTIC
/begin CHARACTERISTIC K_FRK1_MIN "Minimalanteil 1ste Einspritzung" VALUE 0xa0827f8c _REC_VAL_20_u2 1. _CNV_R_R_Def_f_uw_b_622_CM 0. 1. FORMAT "%7.4" /end CHARACTERISTIC
/begin CHARACTERISTIC K_FRK2APP_3H "Aufteilungsfaktor 2te Einspritzung bei 3fach Einspritzung" VALUE 0xa0827f8a _REC_VAL_20_u2 1. _CNV_R_R_Def_f_uw_b_622_CM 0. 1. FORMAT "%7.4" /end CHARACTERISTIC
/begin CHARACTERISTIC K_FRK2APP_H "Aufteilungsfaktor 2te Einspritzung" VALUE 0xa0827f88 _REC_VAL_20_u2 1. _CNV_R_R_Def_f_uw_b_622_CM 0. 1. FORMAT "%7.4" /end CHARACTERISTIC
/begin CHARACTERISTIC K_FRK3APP_H "Aufteilungsfaktor 3te Einspritzung" VALUE 0xa0827f8e _REC_VAL_20_u2 1. _CNV_R_R_Def_f_uw_b_622_CM 0. 1. FORMAT "%7.4" /end CHARACTERISTIC
/begin CHARACTERISTIC K_FSICHER_MAN "Überblendfaktor VVT sicher für Applikation" VALUE 0xa081919b _REC_VAL_20_u1 0.996 _CNV_R_R_Def_f_ub_b_553_CM 0. 0.996 /end CHARACTERISTIC
/begin CHARACTERISTIC K_FSIERR_INK "Rampe für Überblendfaktor bei HFM/DPS-Sensorfehler (auf und abwärts)" VALUE 0xa0819199 _REC_VAL_20_u1 0.996 _CNV_R_R_Def_f_ub_b_553_CM 0. 0.996 /end CHARACTERISTIC
/begin CHARACTERISTIC K_FV_EWPGETR "Kalibrierfaktor für Volumenstromberechnung Automatikgetriebe" VALUE 0xa081b02f _REC_VAL_20_u1 0.498 _CNV_R_R_Def_f_ub_b_593_CM 0. 0.498 /end CHARACTERISTIC
/begin CHARACTERISTIC K_FZRBK_AUSSA "" VALUE 0xa08191a4 _REC_VAL_20_u2 1.9999 _CNV_R_R_Def_f_uw_b_590_CM 0. 1.9999 FORMAT "%14.5" /end CHARACTERISTIC
/begin CHARACTERISTIC K_FZRZYKB "" VALUE 0xa081919c _REC_VAL_20_u1 99.45 _CNV_R_R_Def_dez_sl_551_CM 0. 255. FORMAT "%3.0" /end CHARACTERISTIC
/begin CHARACTERISTIC K_FZR_AUSSA "" VALUE 0xa08191a2 _REC_VAL_20_u2 1.9999 _CNV_R_R_Def_f_uw_b_590_CM 0. 1.9999 FORMAT "%14.5" /end CHARACTERISTIC
/begin CHARACTERISTIC K_FZR_AUSSB1 "" VALUE 0xa08191a6 _REC_VAL_20_u2 1.9999 _CNV_R_R_Def_f_uw_b_590_CM 0. 1.9999 FORMAT "%14.5" /end CHARACTERISTIC
/begin CHARACTERISTIC K_FZR_AUSSB4 "" VALUE 0xa08191a8 _REC_VAL_20_u2 1.9999 _CNV_R_R_Def_f_uw_b_590_CM 0. 1.9999 FORMAT "%14.5" /end CHARACTERISTIC
/begin CHARACTERISTIC K_IEFFGS_KFS "Schwelle Triebstrangverstärkung zur Erkennung Standabkopplung" VALUE 0xa082b4e0 _REC_VAL_20_u2 102.39842 _CNV_R_R_Def_strv_u_636_CM 0. 511.9921 FORMAT "%5.2" /end CHARACTERISTIC
/begin CHARACTERISTIC K_IEFFSMG_KFS "Schwelle Triebstrangverstärkung zur Erkennung Standabkopplung für SMG" VALUE 0xa082b4e2 _REC_VAL_20_u2 102.39842 _CNV_R_R_Def_strv_u_636_CM 0. 511.9921 FORMAT "%5.2" /end CHARACTERISTIC
/begin CHARACTERISTIC K_KFT_D "D-Anteil KFT-Regler" VALUE 0xa081b0e6 _REC_VAL_20_u2 63.99900000000001 _CNV_R_R_Def_f_uw_b_617_CM 0. 63.999 FORMAT "%7.4" /end CHARACTERISTIC
/begin CHARACTERISTIC K_KFT_I "I-Anteil KFT-Regler" VALUE 0xa081b0e4 _REC_VAL_20_u2 1.9999 _CNV_R_R_Def_f_uw_b_590_CM 0. 1.9999 FORMAT "%14.5" /end CHARACTERISTIC
/begin CHARACTERISTIC K_KFT_IMN "Minimalbegrenzung I-Anteil KFT-Regler" VALUE 0xa081b0ec _REC_VAL_20_s2 99.99844999999999 _CNV_R_R_Def_rel_sw_562_CM -100. 99.9969 /end CHARACTERISTIC
/begin CHARACTERISTIC K_KFT_IMX "Maximalbegrenzung I-Anteil KFT-Regler" VALUE 0xa081b0ee _REC_VAL_20_s2 99.99844999999999 _CNV_R_R_Def_rel_sw_562_CM -100. 99.9969 /end CHARACTERISTIC
/begin CHARACTERISTIC K_KFT_REGMN "Minimalbegrenzung Reglerausgang KFT-Regler" VALUE 0xa081b0e8 _REC_VAL_20_s2 99.99844999999999 _CNV_R_R_Def_rel_sw_562_CM -100. 99.9969 /end CHARACTERISTIC
/begin CHARACTERISTIC K_KFT_REGMX "Maximalbegrenzung Reglerausgang KFT-Regler" VALUE 0xa081b0ea _REC_VAL_20_s2 99.99844999999999 _CNV_R_R_Def_rel_sw_562_CM -100. 99.9969 /end CHARACTERISTIC
/begin CHARACTERISTIC K_KHHYS_S "Klopfhäufigkeitshysterese S" VALUE 0xa0827f96 _REC_VAL_20_s2 99.99844999999999 _CNV_R_R_Def_f_sw_b_570_CM -100. 99.9969 /end CHARACTERISTIC
/begin CHARACTERISTIC K_KRKINST_OFF "Filterzeitkonstante DI-Wandfilm passiv" VALUE 0xa0827f70 _REC_VAL_20_u2 99.9984 _CNV_R_R_Def_f_uw_b_555_CM 0. 99.9984 /end CHARACTERISTIC
/begin CHARACTERISTIC K_LAATLDYN_MX "Max. La_soll für Lambdavorgabe Abgasprior (B_laprio_abgas)" VALUE 0xa0827f60 _REC_VAL_20_u2 15.9997 _CNV_R_R_Def_f_uw_b_559_CM 0. 15.9997 FORMAT "%7.4" /end CHARACTERISTIC
/begin CHARACTERISTIC K_LAMDMAX "Maximales Lambda" VALUE 0xa0828046 _REC_VAL_20_u2 15.9997 _CNV_R_R_Def_f_uw_b_559_CM 0. 15.9997 FORMAT "%7.4" /end CHARACTERISTIC
/begin CHARACTERISTIC K_LAZSK_OFS "Begrenzung zylinderselektive Gemischkorrektur zu Lambda = 1" VALUE 0xa08191b0 _REC_VAL_20_s2 99.9984 _CNV_R_R_Def_frel_s_624_CM -50. 49.9984 /end CHARACTERISTIC
/begin CHARACTERISTIC K_LURABS "Filterkonstante für Lurabs_f Werte" VALUE 0xa0818f4a _REC_VAL_20_u2 0.9999 _CNV_R_R_Def_f_uw_b_571_CM 0. 0.9999 FORMAT "%14.5" /end CHARACTERISTIC
/begin CHARACTERISTIC K_LURDIF "Filterkonstante für Lurdif_f Werte" VALUE 0xa0818f48 _REC_VAL_20_u2 0.9999 _CNV_R_R_Def_f_uw_b_571_CM 0. 0.9999 FORMAT "%14.5" /end CHARACTERISTIC
/begin CHARACTERISTIC K_LURKORGANG "gangabhängige Wichtungstabelle für VR-Schwelle" VAL_BLK 0xa0818f4c _REC_VAL_2_u2 1.9999 _CNV_R_R_Def_f_uw_b_590_CM 0. 1.9999 FORMAT "%14.5" NUMBER 8 /end CHARACTERISTIC
/begin CHARACTERISTIC K_MDIMAXHYS_HS "Mdi-Schwelle" VALUE 0xa082802a _REC_VAL_20_s2 131.07 _CNV_R_R_Def_m_sw_q_554_CM -3276.8 3276.7 FORMAT "%5.2" /end CHARACTERISTIC
/begin CHARACTERISTIC K_MDIMAXHYS_S "Mdi-Schwelle" VALUE 0xa082802c _REC_VAL_20_s2 131.07 _CNV_R_R_Def_m_sw_q_554_CM -3276.8 3276.7 FORMAT "%5.2" /end CHARACTERISTIC
/begin CHARACTERISTIC K_MDIRESHYS_HS "Mdi-Schwelle" VALUE 0xa0828028 _REC_VAL_20_s2 131.07 _CNV_R_R_Def_m_sw_q_554_CM -3276.8 3276.7 FORMAT "%5.2" /end CHARACTERISTIC
/begin CHARACTERISTIC K_MDIRESHYS_S "Mdi-Schwelle" VALUE 0xa0828026 _REC_VAL_20_s2 131.07 _CNV_R_R_Def_m_sw_q_554_CM -3276.8 3276.7 FORMAT "%5.2" /end CHARACTERISTIC
/begin CHARACTERISTIC K_MDIZWSCHW "Mdi-Schwelle" VALUE 0xa0828024 _REC_VAL_20_s2 131.07 _CNV_R_R_Def_m_sw_q_554_CM -3276.8 3276.7 FORMAT "%5.2" /end CHARACTERISTIC
/begin CHARACTERISTIC K_MDI_MX "Schwellwert VR Istmomentsprung" VALUE 0xa0818f5c _REC_VAL_20_s2 131.07 _CNV_R_R_Def_m_sw_q_554_CM -3276.8 3276.7 FORMAT "%5.2" /end CHARACTERISTIC
/begin CHARACTERISTIC K_MDI_VZ "Kennwert für Verzögerung Mdi_dif" VALUE 0xa0818f5e _REC_VAL_20_u1 31. _CNV_R_R_Def_dez_sl_551_CM 1. 32. FORMAT "%3.0" /end CHARACTERISTIC
/begin CHARACTERISTIC K_MDKEWPTDLP "Zeitkonstante für Filterung Mdk_ewp" VALUE 0xa081b136 _REC_VAL_20_u2 131.07 _CNV_R_R_Def_td_uw__718_CM 0. 13107. FORMAT "%4.1" /end CHARACTERISTIC
/begin CHARACTERISTIC K_NAMOAUS "Hier könnte Ihr Langbezeichner stehen" VALUE 0xa0818e80 _REC_VAL_20_s2 0. _CNV_R_R_Def_n_sw_q_595_CM -32768. 32767. FORMAT "%5.0" /end CHARACTERISTIC
/begin CHARACTERISTIC K_ND5Z_FIL "Hier könnte Ihr Langbezeichner stehen" VALUE 0xa0818e96 _REC_VAL_20_u2 0.9999847412109381 _CNV_R_R_Def_f_uw_b_571_CM 0. 0.9999847412109381 FORMAT "%14.5" /end CHARACTERISTIC
/begin CHARACTERISTIC K_NDIFAMO_MN "Grenze Drehzahldifferenz zur Berechnung der Motorordnungsamplituden" VALUE 0xa0818e82 _REC_VAL_20_s2 0. _CNV_R_R_Def_n_sw_q_595_CM -32768. 32767. FORMAT "%5.0" /end CHARACTERISTIC
/begin CHARACTERISTIC K_NDIFAMO_MX "Grenze Drehzahldifferenz zur Berechnung der Motorordnungsamplituden" VALUE 0xa0818e84 _REC_VAL_20_s2 0. _CNV_R_R_Def_n_sw_q_595_CM -32768. 32767. FORMAT "%5.0" /end CHARACTERISTIC
/begin CHARACTERISTIC K_NKW_MN "Drezahlschwelle " VALUE 0xa081b10a _REC_VAL_20_s2 0. _CNV_R_R_Def_n_sw_q_595_CM -32768. 32767. FORMAT "%5.0" /end CHARACTERISTIC
/begin CHARACTERISTIC K_NMIN_LDMAUS "Drehzahl ab der LDM wegen Unterdrehzahl abgeschaltet werden kann" VALUE 0xa082b4e4 _REC_VAL_20_s2 0. _CNV_R_R_Def_n_sw_q_595_CM -32768. 32767. FORMAT "%5.0" /end CHARACTERISTIC
/begin CHARACTERISTIC K_NVRAUS "Drehzahlschwelle Verbrennungsregelung inaktiv" VALUE 0xa0818f3c _REC_VAL_20_s2 0. _CNV_R_R_Def_n_sw_q_595_CM -32768. 32767. FORMAT "%5.0" /end CHARACTERISTIC
/begin CHARACTERISTIC K_PRAILDOE_DIS " Druck bei dem KH-DOE deaktiviert wird" VALUE 0xa08335f0 _REC_VAL_20_u2 39.9993 _CNV_R_R_Def_p_uw_q_676_CM 0. 39.9993 FORMAT "%7.4" /end CHARACTERISTIC
/begin CHARACTERISTIC K_PRAILDOE_ENA " Mindestdruck um KH-DOE zu aktivieren" VALUE 0xa08335f2 _REC_VAL_20_u2 39.9993 _CNV_R_R_Def_p_uw_q_676_CM 0. 39.9993 FORMAT "%7.4" /end CHARACTERISTIC
/begin CHARACTERISTIC K_PRAILMIN_HYS "Hysterese Raildruck Quittungen" VALUE 0xa08335e8 _REC_VAL_20_u2 39.9993 _CNV_R_R_Def_p_uw_q_676_CM 0. 39.9993 FORMAT "%7.4" /end CHARACTERISTIC
/begin CHARACTERISTIC K_PRAIL_ABST " Sollwertvorgabe für RAILDRUCK bei KL.15 aus" VALUE 0xa08335ee _REC_VAL_20_u2 39.9993 _CNV_R_R_Def_p_uw_q_676_CM 0. 39.9993 FORMAT "%7.4" /end CHARACTERISTIC
/begin CHARACTERISTIC K_PRAIL_MAN "Manuelle Sollwertvorgabe für RAILDRUCK" VALUE 0xa08335ea _REC_VAL_20_u2 39.9993 _CNV_R_R_Def_p_uw_q_676_CM 0. 39.9993 FORMAT "%7.4" /end CHARACTERISTIC
/begin CHARACTERISTIC K_PRAIL_ST " Sollwertvorgabe für RAILDRUCK im Start" VALUE 0xa08335ec _REC_VAL_20_u2 39.9993 _CNV_R_R_Def_p_uw_q_676_CM 0. 39.9993 FORMAT "%7.4" /end CHARACTERISTIC
/begin CHARACTERISTIC K_PRIO_WMBA "Priorisierung BA geregelt-Warmlauf-Heizung-Sicherheit-Applikation" VAL_BLK 0xa081b142 _REC_VAL_2_u1 99.45 _CNV_R_R_Def_dez_sl_551_CM 0. 255. FORMAT "%3.0" NUMBER 7 /end CHARACTERISTIC
/begin CHARACTERISTIC K_P_HDSTABBR "Raildruckabbruchgrenze HD-Start" VALUE 0xa0828048 _REC_VAL_20_u2 39.9993 _CNV_R_R_Def_p_uw_q_676_CM 0. 39.9993 FORMAT "%7.4" /end CHARACTERISTIC
/begin CHARACTERISTIC K_RFAPP "Füllungsvorgabe manuell" VALUE 0xa0827f90 _REC_VAL_20_s2 98.30250000000001 _CNV_R_R_Def_rf_sw__598_CM -327.68 327.67 FORMAT "%7.4" /end CHARACTERISTIC
/begin CHARACTERISTIC K_RFMIN_HYS "Hysterese zur Bestimmung B_rfmin" VALUE 0xa082804e _REC_VAL_20_s2 98.30250000000001 _CNV_R_R_Def_rf_sw__598_CM -327.68 327.67 FORMAT "%7.4" /end CHARACTERISTIC
/begin CHARACTERISTIC K_RF_MAX "max. zul. Füllung" VALUE 0xa0827f9a _REC_VAL_20_s2 98.30250000000001 _CNV_R_R_Def_rf_sw__598_CM -327.68 327.67 FORMAT "%7.4" /end CHARACTERISTIC
/begin CHARACTERISTIC K_RK2APP_HS "rel. Kraftstoffmenge zweite Einspritzung HS manuell" VALUE 0xa0827f92 _REC_VAL_20_s2 95.99853300000001 _CNV_R_R_Def_rk_sw__600_CM -1600. 1599.9511 /end CHARACTERISTIC
/begin CHARACTERISTIC K_RK2APP_S "rel. Kraftstoffmenge zweite Einspritzung S manuell" VALUE 0xa0827f94 _REC_VAL_20_s2 95.99853300000001 _CNV_R_R_Def_rk_sw__600_CM -1600. 1599.9511 /end CHARACTERISTIC
/begin CHARACTERISTIC K_RK2MIN_H "" VALUE 0xa082803c _REC_VAL_20_s2 95.99853300000001 _CNV_R_R_Def_rk_sw__600_CM -1600. 1599.9511 /end CHARACTERISTIC
/begin CHARACTERISTIC K_RK2OFF_H "Ausschaltschwelle 2/3 fach Einspritzung" VALUE 0xa0827f64 _REC_VAL_20_s2 95.99853300000001 _CNV_R_R_Def_rk_sw__600_CM -1600. 1599.9511 /end CHARACTERISTIC
/begin CHARACTERISTIC K_RK2ON_H "Einschaltschwelle 2/3 fach Einspritzung" VALUE 0xa0827f62 _REC_VAL_20_s2 95.99853300000001 _CNV_R_R_Def_rk_sw__600_CM -1600. 1599.9511 /end CHARACTERISTIC
/begin CHARACTERISTIC K_RK3APP_S "Applikationswert Krafstoffmasse 3. Einspritzung (schicht)" VALUE 0xa0827f86 _REC_VAL_20_s2 95.99853300000001 _CNV_R_R_Def_rk_sw__600_CM -1600. 1599.9511 /end CHARACTERISTIC
/begin CHARACTERISTIC K_RK3MIN_S "min. rel. Kraftstoffmenge ab der Nacheinspritzung S aktiviert wird" VALUE 0xa082803e _REC_VAL_20_s2 95.99853300000001 _CNV_R_R_Def_rk_sw__600_CM -1600. 1599.9511 /end CHARACTERISTIC
/begin CHARACTERISTIC K_RKADDAPP_H "Applikationswert Krafstoffmasse (homogen)" VALUE 0xa0827f80 _REC_VAL_20_s2 95.99853300000001 _CNV_R_R_Def_rk_sw__600_CM -1600. 1599.9511 /end CHARACTERISTIC
/begin CHARACTERISTIC K_RKAPP_H "Applikationswert Krafstoffmasse (homogen)" VALUE 0xa0827f7e _REC_VAL_20_s2 95.99853300000001 _CNV_R_R_Def_rk_sw__600_CM -1600. 1599.9511 /end CHARACTERISTIC
/begin CHARACTERISTIC K_RKAPP_HS "Applikationswert Krafstoffmasse (homogen-schicht)" VALUE 0xa0827f82 _REC_VAL_20_s2 95.99853300000001 _CNV_R_R_Def_rk_sw__600_CM -1600. 1599.9511 /end CHARACTERISTIC
/begin CHARACTERISTIC K_RKAPP_S "Applikationswert Krafstoffmasse (schicht)" VALUE 0xa0827f84 _REC_VAL_20_s2 95.99853300000001 _CNV_R_R_Def_rk_sw__600_CM -1600. 1599.9511 /end CHARACTERISTIC
/begin CHARACTERISTIC K_RKHYSDOE_HS "Hysterese Umschaltgrenze Doppeleinspitzung HS" VALUE 0xa0828044 _REC_VAL_20_s2 95.99853300000001 _CNV_R_R_Def_rk_sw__600_CM -1600. 1599.9511 /end CHARACTERISTIC
/begin CHARACTERISTIC K_RKHYSDOE_S "Hysterese Umschaltgrenze Doppeleinspitzung S" VALUE 0xa0828040 _REC_VAL_20_s2 95.99853300000001 _CNV_R_R_Def_rk_sw__600_CM -1600. 1599.9511 /end CHARACTERISTIC
/begin CHARACTERISTIC K_RKINSTNEG_MAX "DI-Wandfilm Abschaltschwelle negativ" VALUE 0xa0827f78 _REC_VAL_20_s2 95.99853300000001 _CNV_R_R_Def_rk_sw__600_CM -1600. 1599.9511 /end CHARACTERISTIC
/begin CHARACTERISTIC K_RKINSTPOS_MIN "DI-Wandfilm Abschaltschwelle positiv" VALUE 0xa0827f76 _REC_VAL_20_s2 95.99853300000001 _CNV_R_R_Def_rk_sw__600_CM -1600. 1599.9511 /end CHARACTERISTIC
/begin CHARACTERISTIC K_RKSOLL3APP_H "Applikationswert Krafstoffmasse (homogen)" VALUE 0xa082803a _REC_VAL_20_s2 95.99853300000001 _CNV_R_R_Def_rk_sw__600_CM -1600. 1599.9511 /end CHARACTERISTIC
/begin CHARACTERISTIC K_RKTEVAPP_S "Rktev APPL" VALUE 0xa0828020 _REC_VAL_20_s2 95.99853300000001 _CNV_R_R_Def_rk_sw__600_CM -1600. 1599.9511 /end CHARACTERISTIC
/begin CHARACTERISTIC K_RKTE_MAX "max. zul. Tankentlüftungsmenge" VALUE 0xa0827f7c _REC_VAL_20_s2 95.99853300000001 _CNV_R_R_Def_rk_sw__600_CM -1600. 1599.9511 /end CHARACTERISTIC
/begin CHARACTERISTIC K_TDBAISTEWP "Verzögerungszeit für B_baistewp" VALUE 0xa081b140 _REC_VAL_20_u1 51. _CNV_R_R_Def_td_uw__718_CM 0. 51. FORMAT "%4.1" /end CHARACTERISTIC
/begin CHARACTERISTIC K_TDKEIN_GANG "Zeitverzögerung Erkennung Gang ausgelegt ohne Kupplung" VALUE 0xa082b4dc _REC_VAL_20_u1 2.55 _CNV_R_R_Def_td_uw__673_CM 0. 2.55 FORMAT "%5.2" /end CHARACTERISTIC
/begin CHARACTERISTIC K_TD_KUPPEXT "Zeitverzögerung fallende Flanke B_kupp_ext" VALUE 0xa082b4d9 _REC_VAL_20_u1 2.55 _CNV_R_R_Def_td_uw__673_CM 0. 2.55 FORMAT "%5.2" /end CHARACTERISTIC
/begin CHARACTERISTIC K_TD_LDMAUS "Zeitverzögerung Abschaltung LDM bei B_rschalt" VALUE 0xa082b4e6 _REC_VAL_20_u2 98.30250000000001 _CNV_R_R_Def_td_uw__673_CM 0. 655.35 FORMAT "%5.2" /end CHARACTERISTIC
/begin CHARACTERISTIC K_TD_LDMAUS1 "Zeitverzögerung Abschaltung LDM bei B_hschalt" VALUE 0xa082b4e8 _REC_VAL_20_u2 98.30250000000001 _CNV_R_R_Def_td_uw__673_CM 0. 655.35 FORMAT "%5.2" /end CHARACTERISTIC
/begin CHARACTERISTIC K_TD_MAXRFFIL "Filterungszeit für Rf_soll" VALUE 0xa0828050 _REC_VAL_20_u1 2.55 _CNV_R_R_Def_td_uw__673_CM 0. 2.55 FORMAT "%5.2" /end CHARACTERISTIC
/begin CHARACTERISTIC K_TGBSMX "Tget Schwelle für Erkennung Bauteilschutz" VALUE 0xa081b10c _REC_VAL_20_s2 98.30250000000001 _CNV_R_R_Def_t_sw_q_579_CM -327.68 327.67 FORMAT "%5.2" /end CHARACTERISTIC
/begin CHARACTERISTIC K_TGET_MN "Tget Schwelle für Aufhebung Unterdrückung HK Auswahl" VALUE 0xa081b10e _REC_VAL_20_s2 98.30250000000001 _CNV_R_R_Def_t_sw_q_579_CM -327.68 327.67 FORMAT "%5.2" /end CHARACTERISTIC
/begin CHARACTERISTIC K_TGET_MX "Tget Schwelle für Unterdrückung HK Auswahl" VALUE 0xa081b110 _REC_VAL_20_s2 98.30250000000001 _CNV_R_R_Def_t_sw_q_579_CM -327.68 327.67 FORMAT "%5.2" /end CHARACTERISTIC
/begin CHARACTERISTIC K_TGNFKSMX "Tget Schwelle für Erkennung Notfall Kühlkreislauf" VALUE 0xa081b112 _REC_VAL_20_s2 98.30250000000001 _CNV_R_R_Def_t_sw_q_579_CM -327.68 327.67 FORMAT "%5.2" /end CHARACTERISTIC
/begin CHARACTERISTIC K_TIZSK_ABSMN "Mindestanfettung bei zu hoher Verbrennungsstochastik" VALUE 0xa08191b4 _REC_VAL_20_s2 99.9984 _CNV_R_R_Def_frel_s_624_CM -50. 49.9984 /end CHARACTERISTIC
/begin CHARACTERISTIC K_TIZSK_DEK "Dekrementierung zylinderselektive Gemischkorrektur" VALUE 0xa08191b2 _REC_VAL_20_s2 99.9984 _CNV_R_R_Def_frel_s_624_CM -50. 49.9984 /end CHARACTERISTIC
/begin CHARACTERISTIC K_TMBSMX "Tmot Schwelle für Erkennung BA-Bauteilschutz" VALUE 0xa081b114 _REC_VAL_20_s2 98.30250000000001 _CNV_R_R_Def_t_sw_q_579_CM -327.68 327.67 FORMAT "%5.2" /end CHARACTERISTIC
/begin CHARACTERISTIC K_TMHEIZMN "Schwell Motortemperatur für BA-Heizleistung" VALUE 0xa081b116 _REC_VAL_20_s2 98.30250000000001 _CNV_R_R_Def_t_sw_q_579_CM -327.68 327.67 FORMAT "%5.2" /end CHARACTERISTIC
/begin CHARACTERISTIC K_TMMNPRAIL_K " Tmot min um KF_PRAIL_H zu aktivieren" VALUE 0xa08335f6 _REC_VAL_20_s2 98.30250000000001 _CNV_R_R_Def_t_sw_q_579_CM -327.68 327.67 FORMAT "%5.2" /end CHARACTERISTIC
/begin CHARACTERISTIC K_TMMXPRAIL_K " Tmot max um KF_PRAILK_H zu aktivieren" VALUE 0xa08335f4 _REC_VAL_20_s2 98.30250000000001 _CNV_R_R_Def_t_sw_q_579_CM -327.68 327.67 FORMAT "%5.2" /end CHARACTERISTIC
/begin CHARACTERISTIC K_TMNFKSMX "Tmot Schwelle für Erkennung Notfall Kühlkreislauf" VALUE 0xa081b118 _REC_VAL_20_s2 98.30250000000001 _CNV_R_R_Def_t_sw_q_579_CM -327.68 327.67 FORMAT "%5.2" /end CHARACTERISTIC
/begin CHARACTERISTIC K_TMOTMINHS_HYS "Hyst Tmot-Schwelle für Schicht möglich" VALUE 0xa0828034 _REC_VAL_20_s2 98.30250000000001 _CNV_R_R_Def_t_sw_q_579_CM -327.68 327.67 FORMAT "%5.2" /end CHARACTERISTIC
/begin CHARACTERISTIC K_TMOTMINS_HYS "Hyst Tmot-Schwelle für Schicht möglich" VALUE 0xa0828030 _REC_VAL_20_s2 98.30250000000001 _CNV_R_R_Def_t_sw_q_579_CM -327.68 327.67 FORMAT "%5.2" /end CHARACTERISTIC
/begin CHARACTERISTIC K_TMOTMIN_HDST "minimal Temperatur ab der HD-Start erfolgt" VALUE 0xa0828042 _REC_VAL_20_s2 98.30250000000001 _CNV_R_R_Def_t_sw_q_579_CM -327.68 327.67 FORMAT "%5.2" /end CHARACTERISTIC
/begin CHARACTERISTIC K_TMOTMIN_HS "Tmot-Schwelle für Homogen-Schicht möglich" VALUE 0xa0828032 _REC_VAL_20_s2 98.30250000000001 _CNV_R_R_Def_t_sw_q_579_CM -327.68 327.67 FORMAT "%5.2" /end CHARACTERISTIC
/begin CHARACTERISTIC K_TMOTMIN_S "Tmot-Schwelle für Schicht möglich" VALUE 0xa082802e _REC_VAL_20_s2 98.30250000000001 _CNV_R_R_Def_t_sw_q_579_CM -327.68 327.67 FORMAT "%5.2" /end CHARACTERISTIC
/begin CHARACTERISTIC K_TOBSMX "Toel Schwell für Erkennung BA-Bauteilschutz" VALUE 0xa081b11a _REC_VAL_20_s2 131.07 _CNV_R_R_Def_t_sw_q_578_CM -3276.8 3276.7 FORMAT "%4.1" /end CHARACTERISTIC
/begin CHARACTERISTIC K_TOHKMX "Max. Schwelle für Hysterese Toel im WMPRIO Modul für HK Betrieb" VALUE 0xa081b11c _REC_VAL_20_s2 131.07 _CNV_R_R_Def_t_sw_q_578_CM -3276.8 3276.7 FORMAT "%4.1" /end CHARACTERISTIC
/begin CHARACTERISTIC K_TONFKSMX "Toel Schwelle für Erkennung Notfall Kühlkreislauf" VALUE 0xa081b11e _REC_VAL_20_s2 131.07 _CNV_R_R_Def_t_sw_q_578_CM -3276.8 3276.7 FORMAT "%4.1" /end CHARACTERISTIC
/begin CHARACTERISTIC K_TUHEIZMN "Schwelle Umgebungstemperatur für BA-Heizleistung" VALUE 0xa081b120 _REC_VAL_20_s2 131.07 _CNV_R_R_Def_t_sw_q_578_CM -3276.8 3276.7 FORMAT "%4.1" /end CHARACTERISTIC
/begin CHARACTERISTIC K_T_ENTPRGANG "Entprellzeit Gangi" VALUE 0xa082b4de _REC_VAL_20_u2 98.30250000000001 _CNV_R_R_Def_td_uw__673_CM 0. 655.35 FORMAT "%5.2" /end CHARACTERISTIC
/begin CHARACTERISTIC K_UFAKRKMK "Umrechnungsfaktor Rk nach Mk" VALUE 0xa0827f98 _REC_VAL_20_u2 63.99900000000001 _CNV_R_R_Def_f_uw_b_617_CM 0. 63.999 FORMAT "%7.4" /end CHARACTERISTIC
/begin CHARACTERISTIC K_VNFKSMN "Min. Schwelle für V abhängige Freischaltung FI_ELUEE für Auswahl BA Notfallkühlsystem " VALUE 0xa081b138 _REC_VAL_20_u2 0. _CNV_R_R_Def_v_uw_q_726_CM 0. 65535. FORMAT "%5.0" /end CHARACTERISTIC
/begin CHARACTERISTIC K_VSKR_ZK "Zeitkonstante für Mittelwert Berechnung Kraftstoff" VALUE 0xa081b02c _REC_VAL_20_u1 100.38 _CNV_R_R_Def_td_ub__611_CM 16. 255. FORMAT "%5.2" /end CHARACTERISTIC
/begin CHARACTERISTIC K_WMKVDFAK "Faktor Rechenraster 200ms" VALUE 0xa081b030 _REC_VAL_20_u1 1.8671 _CNV_R_R_Def_f_ub_b_613_CM 0.125 1.9921 /end CHARACTERISTIC
/begin CHARACTERISTIC K_WMTANSHYS "Hysterese für Tans" VALUE 0xa081b122 _REC_VAL_20_s2 131.07 _CNV_R_R_Def_t_sw_q_578_CM -3276.8 3276.7 FORMAT "%4.1" /end CHARACTERISTIC
/begin CHARACTERISTIC K_WMTMTGHYS "WMK Hysterese für Tmot  und Tget" VALUE 0xa081b124 _REC_VAL_20_s2 98.30250000000001 _CNV_R_R_Def_t_sw_q_579_CM -327.68 327.67 FORMAT "%5.2" /end CHARACTERISTIC
/begin CHARACTERISTIC K_WMTM_ER "Ersatzwert für WMK bei Fehler Tmot" VALUE 0xa081b126 _REC_VAL_20_s2 98.30250000000001 _CNV_R_R_Def_t_sw_q_579_CM -327.68 327.67 FORMAT "%5.2" /end CHARACTERISTIC
/begin CHARACTERISTIC K_WMTOHYS "Hysterese für Toel " VALUE 0xa081b128 _REC_VAL_20_s2 131.07 _CNV_R_R_Def_t_sw_q_578_CM -3276.8 3276.7 FORMAT "%4.1" /end CHARACTERISTIC
/begin CHARACTERISTIC K_WMTU_1 "Schwelle Tumg für Auswahl BA High" VALUE 0xa081b12a _REC_VAL_20_s2 131.07 _CNV_R_R_Def_t_sw_q_578_CM -3276.8 3276.7 FORMAT "%4.1" /end CHARACTERISTIC
/begin CHARACTERISTIC K_WMTU_2 "Schwelle Tumg für Auswahl BA High+KFT" VALUE 0xa081b12c _REC_VAL_20_s2 131.07 _CNV_R_R_Def_t_sw_q_578_CM -3276.8 3276.7 FORMAT "%4.1" /end CHARACTERISTIC
/begin CHARACTERISTIC K_ZAEHL_PWG "Startwert Zähler für Pwg_ist Betätigung" VALUE 0xa081b13a _REC_VAL_20_u2 0. _CNV_R_R_Def_dez_sl_551_CM 0. 65535. FORMAT "%5.0" /end CHARACTERISTIC
/begin CHARACTERISTIC K_ZKRFSOLL1 "Filterzeitkonstante Drf_soll-Filter" VALUE 0xa0827f68 _REC_VAL_20_u2 99.9984 _CNV_R_R_Def_f_uw_b_555_CM 0. 99.9984 /end CHARACTERISTIC
/begin CHARACTERISTIC K_ZKRFSOLL2 "Filterzeitkonstante Drf_soll-Filter 2" VALUE 0xa0827f6a _REC_VAL_20_u2 99.9984 _CNV_R_R_Def_f_uw_b_555_CM 0. 99.9984 /end CHARACTERISTIC
/begin CHARACTERISTIC K_ZKRKSOLL1 "Filterzeitkonstante Drk_soll-Filter" VALUE 0xa0827f6c _REC_VAL_20_u2 99.9984 _CNV_R_R_Def_f_uw_b_555_CM 0. 99.9984 /end CHARACTERISTIC
/begin CHARACTERISTIC K_ZKRKSOLL2 "Filterzeitkonstante Drk_soll-Filter 2" VALUE 0xa0827f6e _REC_VAL_20_u2 99.9984 _CNV_R_R_Def_f_uw_b_555_CM 0. 99.9984 /end CHARACTERISTIC
/begin CHARACTERISTIC K_ZK_MDIZWFIL "Mdi-Schwelle" VALUE 0xa0828022 _REC_VAL_20_u2 655.35 _CNV_R_R_Def_zk10ms_715_CM 1.e-002 655.36 FORMAT "%7.4" /end CHARACTERISTIC
/begin CHARACTERISTIC K_ZK_NKWGRAD "Zeitkonstante PT1-Filterung Nkw_grad" VALUE 0xa082b4d8 _REC_VAL_20_u1 0.996 _CNV_R_R_Def_f_ub_b_553_CM 0. 0.996 /end CHARACTERISTIC
/begin CHARACTERISTIC K_ZRSEG_AUSSA "" VALUE 0xa08191aa _REC_VAL_20_u2 0. _CNV_R_R_Def_dez_sl_551_CM 0. 65535. FORMAT "%5.0" /end CHARACTERISTIC
/begin CHARACTERISTIC K_ZRSEG_AUSSB "" VALUE 0xa08191ac _REC_VAL_20_u2 0. _CNV_R_R_Def_dez_sl_551_CM 0. 65535. FORMAT "%5.0" /end CHARACTERISTIC
/begin CHARACTERISTIC K_ZSKABS_MX "Schwelle Laufunruhestochastik FI" VALUE 0xa08191ae _REC_VAL_20_s2 131.07 _CNV_R_R_Def_f_sw_q_560_CM -3276.8 3276.7 FORMAT "%5.2" /end CHARACTERISTIC
/begin CHARACTERISTIC S_DRK_RFSOLL "Konfiguration Drk_soll im HOMOGEN-Betrieb aus Rf" VALUE 0xa0827f53 _REC_VAL_20_u1 1. _CNV_R_R_Def_dez_sl_551_CM 0. 1. FORMAT "%3.0" /end CHARACTERISTIC
/begin CHARACTERISTIC S_DZWKRVRGD "Ausschalten der Kraftstofferkennung im GD-Betrieb für VVT-Sicher" VALUE 0xa0819197 _REC_VAL_20_u1 1. _CNV_R_R_Def_dez_sl_551_CM 0. 1. FORMAT "%3.0" /end CHARACTERISTIC
/begin CHARACTERISTIC S_ESPR_START "" VALUE 0xa0828059 _REC_VAL_20_u1 1. _CNV_R_R_Def_dez_sl_551_CM 0. 1. FORMAT "%3.0" /end CHARACTERISTIC
/begin CHARACTERISTIC S_ETALABAS "Auswahl Soll-Ist-Lambdawirkungsgrad" VALUE 0xa0828057 _REC_VAL_20_u1 1. _CNV_R_R_Def_dez_sl_551_CM 0. 1. FORMAT "%3.0" /end CHARACTERISTIC
/begin CHARACTERISTIC S_ETALAMBDA "" VALUE 0xa0828058 _REC_VAL_20_u1 1. _CNV_R_R_Def_dez_sl_551_CM 0. 1. FORMAT "%3.0" /end CHARACTERISTIC
/begin CHARACTERISTIC S_ETALAMIST "Auswahl Ist-Lambdawirkungsgrad" VALUE 0xa0828056 _REC_VAL_20_u1 1. _CNV_R_R_Def_dez_sl_551_CM 0. 1. FORMAT "%3.0" /end CHARACTERISTIC
/begin CHARACTERISTIC S_EWPDIAG "Schalter für PPP-EWP Diagnose" VALUE 0xa081b141 _REC_VAL_20_u1 1. _CNV_R_R_Def_dez_sl_551_CM 0. 1. FORMAT "%3.0" /end CHARACTERISTIC
/begin CHARACTERISTIC S_FRK2APP_3H "Aufteilungsfaktor 2te Einspritzung aus K_FRK2APP_3H" VALUE 0xa0827f55 _REC_VAL_20_u1 1. _CNV_R_R_Def_dez_sl_551_CM 0. 1. FORMAT "%3.0" /end CHARACTERISTIC
/begin CHARACTERISTIC S_FRK2APP_H "Aufteilungsfaktor 2te Einspritzung aus K_FRK2APP_H" VALUE 0xa0827f54 _REC_VAL_20_u1 1. _CNV_R_R_Def_dez_sl_551_CM 0. 1. FORMAT "%3.0" /end CHARACTERISTIC
/begin CHARACTERISTIC S_FRK2VL_ENA "Freigabe Aufteilungsfaktor Doppeleinspritzung bei Vollast aus Vollast-KF" VALUE 0xa0827f52 _REC_VAL_20_u1 1. _CNV_R_R_Def_dez_sl_551_CM 0. 1. FORMAT "%3.0" /end CHARACTERISTIC
/begin CHARACTERISTIC S_FRK3APP_H "Aufteilungsfaktor 3te Einspritzung aus K_FRK3APP_H" VALUE 0xa0827f56 _REC_VAL_20_u1 1. _CNV_R_R_Def_dez_sl_551_CM 0. 1. FORMAT "%3.0" /end CHARACTERISTIC
/begin CHARACTERISTIC S_FSICHER_MAN "Überblendfaktor VVT sicher für Applikation 0 VVT-optimal / 1 VVT-sicher" VALUE 0xa081919a _REC_VAL_20_u1 1. _CNV_R_R_Def_dez_sl_551_CM 0. 1. FORMAT "%3.0" /end CHARACTERISTIC
/begin CHARACTERISTIC S_GANGWECHSEL_AN "1: Gangwechsel wird für B_antrieb ausgewertet" VALUE 0xa082b4d7 _REC_VAL_20_u1 99.45 _CNV_R_R_Def_dez_sl_551_CM 0. 255. FORMAT "%3.0" /end CHARACTERISTIC
/begin CHARACTERISTIC S_IPM_06 "IPM06 aktiv" VALUE 0xa082b4d4 _REC_VAL_20_u1 99.45 _CNV_R_R_Def_dez_sl_551_CM 0. 255. FORMAT "%3.0" /end CHARACTERISTIC
/begin CHARACTERISTIC S_IPM_BSPORT "Freigabe Umschaltung Pedalauswertung durch Sport-Taster" VALUE 0xa082b4d5 _REC_VAL_20_u1 99.45 _CNV_R_R_Def_dez_sl_551_CM 0. 255. FORMAT "%3.0" /end CHARACTERISTIC
/begin CHARACTERISTIC S_LA_SOLL_KO "Schalter La_soll_ko1/2 = 16" VALUE 0xa0828052 _REC_VAL_20_u1 1. _CNV_R_R_Def_dez_sl_551_CM 0. 1. FORMAT "%3.0" /end CHARACTERISTIC
/begin CHARACTERISTIC S_LA_SPUEL "Schalter Einrechnung Spuelluft" VALUE 0xa082801b _REC_VAL_20_u1 99.45 _CNV_R_R_Def_dez_sl_551_CM 0. 255. FORMAT "%3.0" /end CHARACTERISTIC
/begin CHARACTERISTIC S_LDMAUSHS_AKT "1: Abschaltung LDM (bei B_hschalt) durch B_ldm_off aktiv" VALUE 0xa082b4da _REC_VAL_20_u1 99.45 _CNV_R_R_Def_dez_sl_551_CM 0. 255. FORMAT "%3.0" /end CHARACTERISTIC
/begin CHARACTERISTIC S_LDMAUSRS_AKT "1: Abschaltung LDM (bei B_rschalt) durch B_ldm_off aktiv" VALUE 0xa082b4db _REC_VAL_20_u1 99.45 _CNV_R_R_Def_dez_sl_551_CM 0. 255. FORMAT "%3.0" /end CHARACTERISTIC
/begin CHARACTERISTIC S_MDRKHOM "Schalter MDRK im Zustand homgen aktiv" VALUE 0xa0828053 _REC_VAL_20_u1 1. _CNV_R_R_Def_dez_sl_551_CM 0. 1. FORMAT "%3.0" /end CHARACTERISTIC
/begin CHARACTERISTIC S_MD_RADDYN "1: Md_rad_ist wird immer berechnet" VALUE 0xa082b4d6 _REC_VAL_20_u1 99.45 _CNV_R_R_Def_dez_sl_551_CM 0. 255. FORMAT "%3.0" /end CHARACTERISTIC
/begin CHARACTERISTIC S_PRAILVL_ENA "Schalter für Aktivierung Volllastkennlinie Homogen" VALUE 0xa08335fa _REC_VAL_20_u1 99.45 _CNV_R_R_Def_dez_sl_551_CM 0. 255. FORMAT "%3.0" /end CHARACTERISTIC
/begin CHARACTERISTIC S_PRAIL_ABST "Schalter für Solldruck beim Abstellen aktiv" VALUE 0xa08335fb _REC_VAL_20_u1 99.45 _CNV_R_R_Def_dez_sl_551_CM 0. 255. FORMAT "%3.0" /end CHARACTERISTIC
/begin CHARACTERISTIC S_PRAIL_MAN "Schalter für manuelle Vorgabe Prail_sw" VALUE 0xa08335f8 _REC_VAL_20_u1 99.45 _CNV_R_R_Def_dez_sl_551_CM 0. 255. FORMAT "%3.0" /end CHARACTERISTIC
/begin CHARACTERISTIC S_PRAIL_SW "Schalter für Bedingung B_prailsw" VALUE 0xa08335f9 _REC_VAL_20_u1 99.45 _CNV_R_R_Def_dez_sl_551_CM 0. 255. FORMAT "%3.0" /end CHARACTERISTIC
/begin CHARACTERISTIC S_RFAPP "Schalter Füllungsvorgabe manuell" VALUE 0xa0827f57 _REC_VAL_20_u1 1. _CNV_R_R_Def_dez_sl_551_CM 0. 1. FORMAT "%3.0" /end CHARACTERISTIC
/begin CHARACTERISTIC S_RFSOLLFIL_APP "Schalter Rf_soll Schalter permanent aktivieren" VALUE 0xa0828054 _REC_VAL_20_u1 1. _CNV_R_R_Def_dez_sl_551_CM 0. 1. FORMAT "%3.0" /end CHARACTERISTIC
/begin CHARACTERISTIC S_RFSOLLFIL_ON "Schalter Rf_soll Filterung erlauben" VALUE 0xa0828055 _REC_VAL_20_u1 1. _CNV_R_R_Def_dez_sl_551_CM 0. 1. FORMAT "%3.0" /end CHARACTERISTIC
/begin CHARACTERISTIC S_RK2APP_HS "Schalter rel. Kraftstoffmenge zweite Einspritzung HS manuell" VALUE 0xa0827f59 _REC_VAL_20_u1 1. _CNV_R_R_Def_dez_sl_551_CM 0. 1. FORMAT "%3.0" /end CHARACTERISTIC
/begin CHARACTERISTIC S_RK2APP_S "Schalter rel. Kraftstoffmenge zweite Einspritzung S manuell" VALUE 0xa0827f58 _REC_VAL_20_u1 1. _CNV_R_R_Def_dez_sl_551_CM 0. 1. FORMAT "%3.0" /end CHARACTERISTIC
/begin CHARACTERISTIC S_RK3APP_S "Applikationsschalter Krafstoffmasse 3. Einspritzung (schicht)" VALUE 0xa0827f5d _REC_VAL_20_u1 99.45 _CNV_R_R_Def_dez_sl_551_CM 0. 255. FORMAT "%3.0" /end CHARACTERISTIC
/begin CHARACTERISTIC S_RKAPP_H "Schalter rel. Kraftstoffmenge H manuell" VALUE 0xa0827f5a _REC_VAL_20_u1 1. _CNV_R_R_Def_dez_sl_551_CM 0. 1. FORMAT "%3.0" /end CHARACTERISTIC
/begin CHARACTERISTIC S_RKAPP_HS "Schalter rel. Kraftstoffmenge HS manuell" VALUE 0xa0827f5c _REC_VAL_20_u1 1. _CNV_R_R_Def_dez_sl_551_CM 0. 1. FORMAT "%3.0" /end CHARACTERISTIC
/begin CHARACTERISTIC S_RKAPP_S "Schalter rel. Kraftstoffmenge S manuell" VALUE 0xa0827f5b _REC_VAL_20_u1 1. _CNV_R_R_Def_dez_sl_551_CM 0. 1. FORMAT "%3.0" /end CHARACTERISTIC
/begin CHARACTERISTIC S_RKTEVAPP_S "Schalter Rktev über Applikationskonstant" VALUE 0xa082801a _REC_VAL_20_u1 99.45 _CNV_R_R_Def_dez_sl_551_CM 0. 255. FORMAT "%3.0" /end CHARACTERISTIC
/begin CHARACTERISTIC S_RSTGVRDG "Ausschalten der VBR-Regelung im GD-Betrieb für VVT-Sicher" VALUE 0xa0819194 _REC_VAL_20_u1 1. _CNV_R_R_Def_dez_sl_551_CM 0. 1. FORMAT "%3.0" /end CHARACTERISTIC
/begin CHARACTERISTIC S_SCH_CLC "Schalter Berechnung homogen-schicht und schicht aktiv" VALUE 0xa0827f51 _REC_VAL_20_u1 1. _CNV_R_R_Def_dez_sl_551_CM 0. 1. FORMAT "%3.0" /end CHARACTERISTIC
/begin CHARACTERISTIC S_SIERRDPS "Freischaltung Einrechnung DPS Diagnose in VVT-Sicher" VALUE 0xa081919f _REC_VAL_20_u1 1. _CNV_R_R_Def_dez_sl_551_CM 0. 1. FORMAT "%3.0" /end CHARACTERISTIC
/begin CHARACTERISTIC S_SIERRGD "Ausschalten der Fehlererkennung im GD-Betrieb für VVT-Sicher" VALUE 0xa0819198 _REC_VAL_20_u1 1. _CNV_R_R_Def_dez_sl_551_CM 0. 1. FORMAT "%3.0" /end CHARACTERISTIC
/begin CHARACTERISTIC S_SIERRHFM "Freischaltung Einrechnung HFM Diagnose in VVT-Sicher" VALUE 0xa081919d _REC_VAL_20_u1 1. _CNV_R_R_Def_dez_sl_551_CM 0. 1. FORMAT "%3.0" /end CHARACTERISTIC
/begin CHARACTERISTIC S_SIERRKSD "Freischaltung Einrechnung KSD Diagnose in VVT-Sicher" VALUE 0xa08191a0 _REC_VAL_20_u1 1. _CNV_R_R_Def_dez_sl_551_CM 0. 1. FORMAT "%3.0" /end CHARACTERISTIC
/begin CHARACTERISTIC S_SIERRTMOT "Freischaltung Einrechnung TMOT Diagnose in VVT-Sicher" VALUE 0xa081919e _REC_VAL_20_u1 1. _CNV_R_R_Def_dez_sl_551_CM 0. 1. FORMAT "%3.0" /end CHARACTERISTIC
/begin CHARACTERISTIC S_VRSTIKOR "Freischaltung Kraftstoffkorrektur durch VBR" VALUE 0xa08191a1 _REC_VAL_20_u1 1. _CNV_R_R_Def_dez_sl_551_CM 0. 1. FORMAT "%3.0" /end CHARACTERISTIC
/begin CHARACTERISTIC S_ZRAUS_RESET "Rücksetzen Aussetzerstatistik" VALUE 0xa0819195 _REC_VAL_20_u1 1. _CNV_R_R_Def_dez_sl_551_CM 0. 1. FORMAT "%3.0" /end CHARACTERISTIC
/begin CHARACTERISTIC S_ZWMINFIL_AUS "Schalter Zwmin filter auszuschalten" VALUE 0xa0828051 _REC_VAL_20_u1 1. _CNV_R_R_Def_dez_sl_551_CM 0. 1. FORMAT "%3.0" /end CHARACTERISTIC
/begin COMPU_METHOD _CNV_R_R_Def_dez_sl_551_CM "Def_dez_sl_q1" RAT_FUNC "%6.3" "-" COEFFS 0. 1. 0. 0. 0. 1. /end COMPU_METHOD
/begin COMPU_METHOD _CNV_R_R_Def_f_ub_b_553_CM "Def_f_ub_b1" RAT_FUNC "%6.3" "-" COEFFS 0. 256. 0. 0. 0. 1. /end COMPU_METHOD
/begin COMPU_METHOD _CNV_R_R_Def_m_sw_q_554_CM "Def_m_sw_q0p1" RAT_FUNC "%6.3" "Nm" COEFFS 0. 10. 0. 0. 0. 1. /end COMPU_METHOD
/begin COMPU_METHOD _CNV_R_R_Def_f_uw_b_555_CM "Def_f_uw_b100" RAT_FUNC "%6.3" "%" COEFFS 0. 65536. 0. 0. 0. 100. /end COMPU_METHOD
/begin COMPU_METHOD _CNV_R_R_Def_f_uw_b_559_CM "Def_f_uw_b16" RAT_FUNC "%6.3" "-" COEFFS 0. 65536. 0. 0. 0. 16. /end COMPU_METHOD
/begin COMPU_METHOD _CNV_R_R_Def_f_sw_q_560_CM "Def_f_sw_q0p1" RAT_FUNC "%6.3" "-" COEFFS 0. 10. 0. 0. 0. 1. /end COMPU_METHOD
/begin COMPU_METHOD _CNV_R_R_Def_rel_sw_562_CM "Def_rel_sw_b100" RAT_FUNC "%6.3" "%" COEFFS 0. 32768. 0. 0. 0. 100. /end COMPU_METHOD
/begin COMPU_METHOD _CNV_S_2_Def_bit_ub_563_CM "Def_bit_ub_0" TAB_VERB "%6.3" "-" COMPU_TAB_REF _CNV_S_2_Def_bit_ub_563 /end COMPU_METHOD
/begin COMPU_VTAB _CNV_S_2_Def_bit_ub_563 "Def_bit_ub_0" TAB_VERB 2 0 "FALSE" 1 "TRUE" /end COMPU_VTAB
/begin COMPU_METHOD _CNV_S_11_Def_ba_wm_569_CM "Def_ba_wm" TAB_VERB "%6.3" "-" COMPU_TAB_REF _CNV_S_11_Def_ba_wm_569 /end COMPU_METHOD
/begin COMPU_VTAB _CNV_S_11_Def_ba_wm_569 "Def_ba_wm" TAB_VERB 11 0 "Keine" 1 "WARMLAUF" 2 "ECO" 3 "NORMAL" 4 "HIGH" 5 "HIGH+KFT" 6 "BAUTEILSCHUTZ" 7 "HEIZLEISTUNG" 8 "NOTLAUF" 9 "APPLIKATION" 10 "Befuellen/Entlueften" /end COMPU_VTAB
/begin COMPU_METHOD _CNV_R_R_Def_f_sw_b_570_CM "Def_f_sw_b100" RAT_FUNC "%6.3" "-" COEFFS 0. 32768. 0. 0. 0. 100. /end COMPU_METHOD
/begin COMPU_METHOD _CNV_R_R_Def_f_uw_b_571_CM "Def_f_uw_b1" RAT_FUNC "%6.3" "-" COEFFS 0. 65536. 0. 0. 0. 1. /end COMPU_METHOD
/begin COMPU_METHOD _CNV_R_R_Def_f_uw_b_572_CM "Def_f_uw_b8" RAT_FUNC "%6.3" "-" COEFFS 0. 65536. 0. 0. 0. 8. /end COMPU_METHOD
/begin COMPU_METHOD _CNV_R_R_Def_p_sw_q_576_CM "Def_p_sw_q0p039" RAT_FUNC "%6.3" "hPa" COEFFS 0. 256. 0. 0. 0. 10. /end COMPU_METHOD
/begin COMPU_METHOD _CNV_R_R_Def_t_sw_q_578_CM "Def_t_sw_q0p1" RAT_FUNC "%6.3" "°C" COEFFS 0. 10. 0. 0. 0. 1. /end COMPU_METHOD
/begin COMPU_METHOD _CNV_R_R_Def_t_sw_q_579_CM "Def_t_sw_q0p01" RAT_FUNC "%6.3" "°C" COEFFS 0. 100. 0. 0. 0. 1. /end COMPU_METHOD
/begin COMPU_METHOD _CNV_R_R_Def_f_ub_b_586_CM "Def_f_ub_b100" RAT_FUNC "%6.3" "%" COEFFS 0. 256. 0. 0. 0. 100. /end COMPU_METHOD
/begin COMPU_METHOD _CNV_R_R_Def_f_uw_b_590_CM "Def_f_uw_b2" RAT_FUNC "%6.3" "-" COEFFS 0. 65536. 0. 0. 0. 2. /end COMPU_METHOD
/begin COMPU_METHOD _CNV_R_R_Def_f_sw_b_592_CM "Def_f_sw_b8" RAT_FUNC "%6.3" "-" COEFFS 0. 32768. 0. 0. 0. 8. /end COMPU_METHOD
/begin COMPU_METHOD _CNV_R_R_Def_f_ub_b_593_CM "Def_f_ub_b0p5" RAT_FUNC "%6.3" "-" COEFFS 0. 256. 0. 0. 0. 0.5 /end COMPU_METHOD
/begin COMPU_METHOD _CNV_R_R_Def_n_sw_q_595_CM "Def_n_sw_q1p0" RAT_FUNC "%6.3" "Upm" COEFFS 0. 1. 0. 0. 0. 1. /end COMPU_METHOD
/begin COMPU_METHOD _CNV_R_R_Def_rf_sw__598_CM "Def_rf_sw_q0p01" RAT_FUNC "%6.3" "%" COEFFS 0. 100. 0. 0. 0. 1. /end COMPU_METHOD
/begin COMPU_METHOD _CNV_R_R_Def_eta_sw_599_CM "Def_eta_sw_b200" RAT_FUNC "%6.3" "%" COEFFS 0. 32768. 0. 0. 0. 200. /end COMPU_METHOD
/begin COMPU_METHOD _CNV_R_R_Def_rk_sw__600_CM "Def_rk_sw_b1600" RAT_FUNC "%6.3" "%" COEFFS 0. 2048. 0. 0. 0. 100. /end COMPU_METHOD
/begin COMPU_METHOD _CNV_R_R_Def_zw_sw__604_CM "Def_zw_sw_q0p1" RAT_FUNC "%6.3" "°" COEFFS 0. 10. 0. 0. 0. 1. /end COMPU_METHOD
/begin COMPU_METHOD _CNV_R_R_Def_eta_sw_606_CM "Def_eta_sw_q0p00305" RAT_FUNC "%6.3" "%" COEFFS 0. 32767. 0. 0. 0. 100. /end COMPU_METHOD
/begin COMPU_METHOD _CNV_R_R_Def_td_ub__611_CM "Def_td_ub_q1" RAT_FUNC "%6.3" "s" COEFFS 0. 1. 0. 0. 0. 1. /end COMPU_METHOD
/begin COMPU_METHOD _CNV_R_R_Def_f_ub_b_613_CM "Def_f_ub_b2" RAT_FUNC "%6.3" "-" COEFFS 0. 256. 0. 0. 0. 2. /end COMPU_METHOD
/begin COMPU_METHOD _CNV_R_R_Def_eta_uw_615_CM "Def_eta_uw_b200" RAT_FUNC "%6.3" "%" COEFFS 0. 65536. 0. 0. 0. 200. /end COMPU_METHOD
/begin COMPU_METHOD _CNV_R_R_Def_f_sw_b_616_CM "Def_f_sw_b2" RAT_FUNC "%6.3" "-" COEFFS 0. 65536. 0. 0. 0. 4. /end COMPU_METHOD
/begin COMPU_METHOD _CNV_R_R_Def_f_uw_b_617_CM "Def_f_uw_b64" RAT_FUNC "%6.3" "-" COEFFS 0. 65536. 0. 0. 0. 64. /end COMPU_METHOD
/begin COMPU_METHOD _CNV_R_R_Def_f_ub_b_619_CM "Def_f_ub_b1p0" RAT_FUNC "%6.3" "-" COEFFS 0. 255. 0. 0. 0. 1. /end COMPU_METHOD
/begin COMPU_METHOD _CNV_R_R_Def_f_uw_b_622_CM "Def_f_uw_b1p0" RAT_FUNC "%6.3" "-" COEFFS 0. 65535. 0. 0. 0. 1. /end COMPU_METHOD
/begin COMPU_METHOD _CNV_R_R_Def_frel_s_624_CM "Def_frel_sw_q0p00153" RAT_FUNC "%6.3" "%" COEFFS 0. 32768. 0. 0. 0. 50. /end COMPU_METHOD
/begin COMPU_METHOD _CNV_R_R_Def_strv_u_636_CM "Def_strv_uw_b512" RAT_FUNC "%6.3" "1/m" COEFFS 0. 65536. 0. 0. 0. 512. /end COMPU_METHOD
/begin COMPU_METHOD _CNV_R_R_Def_mk_uw__652_CM "Def_mk_uw_b1389" RAT_FUNC "%6.3" "mg/hub" COEFFS 0. 65535. 0. 0. 0. 1389. /end COMPU_METHOD
/begin COMPU_METHOD _CNV_R_R_Def_n_sw_b_658_CM "Def_n_sw_b256" RAT_FUNC "%6.3" "Upm" COEFFS 0. 128. 0. 0. 0. 1. /end COMPU_METHOD
/begin COMPU_METHOD _CNV_R_R_Def_n_sl_q_660_CM "Def_n_sl_q0p001" RAT_FUNC "%6.3" "Upm" COEFFS 0. 1000. 0. 0. 0. 1. /end COMPU_METHOD
/begin COMPU_METHOD _CNV_R_R_Def_ngrd_s_661_CM "Def_ngrd_sb_q32p0" RAT_FUNC "%6.3" "Upm/s" COEFFS 0. 1. 0. 0. 0. 32. /end COMPU_METHOD
/begin COMPU_METHOD _CNV_R_R_Def_td_uw__673_CM "Def_td_uw_q0p01" RAT_FUNC "%6.3" "s" COEFFS 0. 100. 0. 0. 0. 1. /end COMPU_METHOD
/begin COMPU_METHOD _CNV_R_R_Def_p_uw_q_676_CM "Def_p_uw_q0p0061" RAT_FUNC "%6.3" "MPa" COEFFS 0. 65536. 0. 0. 0. 40. /end COMPU_METHOD
/begin COMPU_METHOD _CNV_R_R_Def_pe_uw__678_CM "Def_pe_uw_b1000" RAT_FUNC "%6.3" "kW" COEFFS 0. 65536. 0. 0. 0. 1000. /end COMPU_METHOD
/begin COMPU_METHOD _CNV_R_R_Def_vs_uw__686_CM "Def_vs_uw_b10000" RAT_FUNC "%6.3" "l/h" COEFFS 0. 65536. 0. 0. 0. 10000. /end COMPU_METHOD
/begin COMPU_METHOD _CNV_S_17_Def_brenn__704_CM "Def_brenn_v_gdi" TAB_VERB "%6.3" "-" COMPU_TAB_REF _CNV_S_17_Def_brenn__704 /end COMPU_METHOD
/begin COMPU_VTAB _CNV_S_17_Def_brenn__704 "Def_brenn_v_gdi" TAB_VERB 17 0 "KEINE" 1 "H" 2 "HS__" 3 "HS_H" 4 "S_____" 5 "S____H" 6 "S_HS__" 7 "S_HS_H" 17 "H___H" 18 "H__HS" 20 "H___S" 33 "HS__H" 34 "HS_HS" 36 "HS__S" 65 "S__H" 66 "S_HS" 68 "S__S" /end COMPU_VTAB
/begin COMPU_METHOD _CNV_R_R_Def_zk10ms_715_CM "Def_zk10ms_uw_b655p36" RAT_FUNC "%6.3" "s" COEFFS 0. 0. 655.36 0. 1. 0. /end COMPU_METHOD
/begin COMPU_METHOD _CNV_R_R_Def_td_uw__718_CM "Def_td_uw_q0p2" RAT_FUNC "%6.3" "s" COEFFS 0. 5. 0. 0. 0. 1. /end COMPU_METHOD
/begin COMPU_METHOD _CNV_R_R_Def_v_uw_q_726_CM "Def_v_uw_q1p0" RAT_FUNC "%6.3" "km/h" COEFFS 0. 1. 0. 0. 0. 1. /end COMPU_METHOD
/begin COMPU_METHOD _CNV_R_R_Def_f_uw_b_730_CM "Def_f_uw_b3000" RAT_FUNC "%6.3" "-" COEFFS 0. 65536. 0. 0. 0. 3000. /end COMPU_METHOD
/begin COMPU_METHOD _CNV_R_R_Def_f_ub_b_743_CM "Def_f_ub_b16" RAT_FUNC "%6.3" "-" COEFFS 0. 256. 0. 0. 0. 16. /end COMPU_METHOD
/begin COMPU_METHOD _CNV_R_R_Def_f_sw_b_750_CM "Def_f_sw_b128" RAT_FUNC "%6.3" "-" COEFFS 0. 32768. 0. 0. 0. 128. /end COMPU_METHOD
/begin RECORD_LAYOUT _REC_VAL_20_u1 FNC_VALUES 1 UBYTE COLUMN_DIR DIRECT /end RECORD_LAYOUT
/begin RECORD_LAYOUT _REC_VAL_20_u2 FNC_VALUES 1 UWORD COLUMN_DIR DIRECT /end RECORD_LAYOUT
/begin RECORD_LAYOUT _REC_VAL_20_s2 FNC_VALUES 1 SWORD COLUMN_DIR DIRECT /end RECORD_LAYOUT
/begin RECORD_LAYOUT _REC_MAP_52_UBYTE_s2_s2_u2 NO_AXIS_PTS_X 1 UBYTE NO_AXIS_PTS_Y 2 UBYTE AXIS_PTS_X 3 SWORD INDEX_INCR DIRECT AXIS_PTS_Y 4 UWORD INDEX_INCR DIRECT FNC_VALUES 5 SWORD COLUMN_DIR DIRECT /end RECORD_LAYOUT
/begin RECORD_LAYOUT _REC_MAP_52_u1_s2_s2 NO_AXIS_PTS_X 1 UBYTE NO_AXIS_PTS_Y 2 UBYTE AXIS_PTS_X 3 SWORD INDEX_INCR DIRECT AXIS_PTS_Y 4 SWORD INDEX_INCR DIRECT FNC_VALUES 5 UBYTE COLUMN_DIR DIRECT /end RECORD_LAYOUT
/begin RECORD_LAYOUT _REC_MAP_52_UBYTE_u2_s2_u2 NO_AXIS_PTS_X 1 UBYTE NO_AXIS_PTS_Y 2 UBYTE AXIS_PTS_X 3 SWORD INDEX_INCR DIRECT AXIS_PTS_Y 4 UWORD INDEX_INCR DIRECT FNC_VALUES 5 UWORD COLUMN_DIR DIRECT /end RECORD_LAYOUT
/begin RECORD_LAYOUT _REC_MAP_52_UBYTE_u2_s2_s2 NO_AXIS_PTS_X 1 UBYTE NO_AXIS_PTS_Y 2 UBYTE AXIS_PTS_X 3 SWORD INDEX_INCR DIRECT AXIS_PTS_Y 4 SWORD INDEX_INCR DIRECT FNC_VALUES 5 UWORD COLUMN_DIR DIRECT /end RECORD_LAYOUT
/begin RECORD_LAYOUT _REC_MAP_52_UBYTE_s2_s2_s2 NO_AXIS_PTS_X 1 UBYTE NO_AXIS_PTS_Y 2 UBYTE AXIS_PTS_X 3 SWORD INDEX_INCR DIRECT AXIS_PTS_Y 4 SWORD INDEX_INCR DIRECT FNC_VALUES 5 SWORD COLUMN_DIR DIRECT /end RECORD_LAYOUT
/begin RECORD_LAYOUT _REC_MAP_52_UBYTE_u2_u2_s2 NO_AXIS_PTS_X 1 UBYTE NO_AXIS_PTS_Y 2 UBYTE AXIS_PTS_X 3 UWORD INDEX_INCR DIRECT AXIS_PTS_Y 4 SWORD INDEX_INCR DIRECT FNC_VALUES 5 UWORD COLUMN_DIR DIRECT /end RECORD_LAYOUT
/begin RECORD_LAYOUT _REC_MAP_52_u1_u2_s2 NO_AXIS_PTS_X 1 UBYTE NO_AXIS_PTS_Y 2 UBYTE AXIS_PTS_X 3 UWORD INDEX_INCR DIRECT AXIS_PTS_Y 4 SWORD INDEX_INCR DIRECT FNC_VALUES 5 UBYTE COLUMN_DIR DIRECT /end RECORD_LAYOUT
/begin RECORD_LAYOUT _REC_CUR_TKL_UW_VV__u2_u2 NO_AXIS_PTS_X 1 UBYTE RESERVED 2 BYTE AXIS_PTS_X 3 UWORD INDEX_INCR DIRECT FNC_VALUES 4 UWORD COLUMN_DIR DIRECT /end RECORD_LAYOUT
/begin RECORD_LAYOUT _REC_CUR_TKL_UW_VV__u2_s2 NO_AXIS_PTS_X 1 UBYTE RESERVED 2 BYTE AXIS_PTS_X 3 SWORD INDEX_INCR DIRECT FNC_VALUES 4 UWORD COLUMN_DIR DIRECT /end RECORD_LAYOUT
/begin RECORD_LAYOUT _REC_CUR_TKL_UW_VV__u1_s2 NO_AXIS_PTS_X 1 UBYTE RESERVED 2 BYTE AXIS_PTS_X 3 SWORD INDEX_INCR DIRECT FNC_VALUES 4 UBYTE COLUMN_DIR DIRECT /end RECORD_LAYOUT
/begin RECORD_LAYOUT _REC_CUR_TKL_UW_VV__s2_s2 NO_AXIS_PTS_X 1 UBYTE RESERVED 2 BYTE AXIS_PTS_X 3 SWORD INDEX_INCR DIRECT FNC_VALUES 4 SWORD COLUMN_DIR DIRECT /end RECORD_LAYOUT
/begin RECORD_LAYOUT _REC_CUR_TKL_UW_VV__u1_u2 NO_AXIS_PTS_X 1 UBYTE RESERVED 2 BYTE AXIS_PTS_X 3 UWORD INDEX_INCR DIRECT FNC_VALUES 4 UBYTE COLUMN_DIR DIRECT /end RECORD_LAYOUT
/begin RECORD_LAYOUT _REC_CUR_TKL_UW_VV__s2_u2 NO_AXIS_PTS_X 1 UBYTE RESERVED 2 BYTE AXIS_PTS_X 3 UWORD INDEX_INCR DIRECT FNC_VALUES 4 SWORD COLUMN_DIR DIRECT /end RECORD_LAYOUT
/begin RECORD_LAYOUT _REC_CUR_TKL_UW_VV__s1_u1 NO_AXIS_PTS_X 1 UBYTE RESERVED 2 BYTE AXIS_PTS_X 3 UBYTE INDEX_INCR DIRECT FNC_VALUES 4 SBYTE COLUMN_DIR DIRECT /end RECORD_LAYOUT
/begin RECORD_LAYOUT _REC_VAL_2_u1 FNC_VALUES 1 UBYTE COLUMN_DIR DIRECT /end RECORD_LAYOUT
/begin RECORD_LAYOUT _REC_VAL_2_u2 FNC_VALUES 1 UWORD COLUMN_DIR DIRECT /end RECORD_LAYOUT
/begin FUNCTION MDRK ""
 /begin DEF_CHARACTERISTIC CW_KHM CW_RF KF_AGR KF_ETARKTE_S KF_ETATEMIN_S KF_FFRK2_3H KF_FFRK2_H KF_FFRK3_3H KF_FRK2KOR_KH KF_FRK2K_3H KF_FRK2K_H KF_FRK2_3H KF_FRK2_H KF_FRK3K_3H KF_FRK3_3H KF_FRKINST_NEG KF_FRKINST_POS KF_FRKKORRF_1 KF_FRKKORRF_2 KF_FRKKOR_HS KF_FRKKOR_S KF_FRKSTRED KF_FRKTMOT_HS KF_FRKTMOT_S KF_LABAS_H KF_MDIBAS_HS KF_MDIBAS_S KF_MDIMIN_HS KF_MDIMIN_S KF_RFBASK_S KF_RFBAS_HS KF_RFBAS_S KF_RFMINKH_S KF_RFMINSA_1 KF_RFMINTE_S KF_RFMIN_1 KF_RFOPT_HS KF_RFOPT_S KF_RK2_HS KF_RK2_S KF_RKMAXBG_HS KF_RKMAXBG_S KF_RKMINBG_HS KF_RKMINBG_S KF_RKMIN_H KF_RKSTART KL_DRKMAX_NEG KL_DRKMIN_POS KL_ETAESTE_S KL_ETALAMTE_S KL_ETARF_HS KL_ETARF_S KL_FDRFTE KL_FRFBAS_S KL_FRK2ST_H KL_FRK2_VL KL_FRKSTP KL_FRKST_ND KL_FRKVL_HS KL_FRKVL_S KL_KHMAX_S KL_KRKINST_NEG KL_KRKINST_POS KL_PRAIL_MIN KL_RFGRDMAX KL_RKMINDOE_HS KL_RKMINDOE_S KL_RKVLO_HS KL_RKVLO_S KL_RKVLU_HS KL_RKVLU_S KL_ZYKLHD_MAX K_DLASOLL_MAX K_DMDKW_MX K_DRFSOLL_FILT K_DRFTEMX K_DRKMAX_NEG K_DRKMIN_POS K_ETAMAX_DOE K_ETAMAX_SPLIT K_ETAMIN_EE K_ETA_KH_S K_FATLDYN_MX K_FDRFSOLL_FILT K_FRK1_MIN K_FRK2APP_3H K_FRK2APP_H K_FRK3APP_H K_KHHYS_S K_KRKINST_OFF K_LAATLDYN_MX K_LAMDMAX K_MDIMAXHYS_HS K_MDIMAXHYS_S K_MDIRESHYS_HS K_MDIRESHYS_S K_MDIZWSCHW K_P_HDSTABBR K_RFAPP K_RFMIN_HYS K_RF_MAX K_RK2APP_HS K_RK2APP_S K_RK2MIN_H K_RK2OFF_H K_RK2ON_H K_RK3APP_S K_RK3MIN_S K_RKADDAPP_H K_RKAPP_H K_RKAPP_HS K_RKAPP_S K_RKHYSDOE_HS K_RKHYSDOE_S K_RKINSTNEG_MAX K_RKINSTPOS_MIN K_RKSOLL3APP_H K_RKTEVAPP_S K_RKTE_MAX K_TD_MAXRFFIL K_TMOTMINHS_HYS K_TMOTMINS_HYS K_TMOTMIN_HDST K_TMOTMIN_HS K_TMOTMIN_S K_UFAKRKMK K_ZKRFSOLL1 K_ZKRFSOLL2 K_ZKRKSOLL1 K_ZKRKSOLL2 K_ZK_MDIZWFIL S_DRK_RFSOLL S_ESPR_START S_ETALABAS S_ETALAMBDA S_ETALAMIST S_FRK2APP_3H S_FRK2APP_H S_FRK2VL_ENA S_FRK3APP_H S_LA_SOLL_KO S_LA_SPUEL S_MDRKHOM S_RFAPP S_RFSOLLFIL_APP S_RFSOLLFIL_ON S_RK2APP_HS S_RK2APP_S S_RK3APP_S S_RKAPP_H S_RKAPP_HS S_RKAPP_S S_RKTEVAPP_S S_SCH_CLC S_ZWMINFIL_AUS /end DEF_CHARACTERISTIC
 /begin OUT_MEASUREMENT Anzzykl_espr Anzzykl_hd Dlasoll_stat12 Drf_soll Drf_te_s Drfopt_hs Drfopt_s Drfoptres_hs Drfoptres_s Drk_soll Eta_bas_s Eta_hs Eta_labas Eta_labas_sol Eta_laber_h Eta_laber_h1 Eta_laber_h2 Eta_lamb_ist Eta_lamb_ist1 Eta_lamb_ist2 Eta_lamb_soll Eta_lamb_soll1 Eta_lamb_soll2 Eta_lambda Eta_lambda_1 Eta_lambda_2 Eta_lamte_s Eta_lasoll Eta_rkte_s Eta_te_s Eta_zwsoll Etarf_hs Etarf_s Etarfres_hs Etarfres_s F_drfte_s F_etatemin_s F_frk2_3h F_frk2_h F_frk3_3h F_rfbas_s F_rk2_3h F_rk2_h F_rk2korkh_h F_rk3_3h F_rkkorrf F_rkkorwl_hs F_rkkorwl_s La_bas_h La_ber_h1 La_ber_h2 La_soll La_sollreg1 La_sollreg2 Lamb_es_s Lamb_te Mdi_bas_hs Mdi_bas_s Mdi_max_hs Mdi_max_s Mdi_min_ba Mdi_min_hs Mdi_min_s Mdi_ressoll Mdi_zw_min Mdi_zw_sollf Mdi_zwmin_fil Mk_hom_soll_1 Mk_hom_soll_2 Mk_soll_h Mk_soll_s Mkzyl_soll_hs Mkzyl_soll_s Rf_agr_s Rf_bas_hs Rf_bas_s Rf_kh_s Rf_lasoll_h Rf_max Rf_mdsoll_h Rf_min Rf_opt_hs Rf_opt_s Rf_optres_hs Rf_optres_s Rf_res_hs Rf_res_s Rf_resmax_ba Rf_resmax_hs Rf_resmax_s Rf_resmin_hs Rf_resmin_s Rf_soll Rf_soll_h Rf_soll_hs Rf_soll_s Rf_te_s Rfgrdmax Rfmin_kh_s Rfmin_te_s Rk1_hs Rk1_s Rk1_tmp_hs Rk1_tmp_s Rk2_hs Rk2_s Rk2_soll_2h Rk2_soll_3h Rk2_soll_st Rk2_sollkh_h Rk2kor_kh_h Rk3_khkh_s Rk3_khmdi_s Rk3_khsoll_s Rk3_soll_3h Rk3_soll_s Rk3maxmdi Rk_add_inst Rk_addinst_roh Rk_bas_h Rk_bas_hs Rk_bas_s Rk_kh Rk_kor_h Rk_kor_hs Rk_kor_s Rk_kormd_h Rk_korres_hs Rk_korres_s Rk_korzw_h Rk_lamreg Rk_laprio_h Rk_max_h Rk_maxbg_hs Rk_maxbg_s Rk_mdprio_h Rk_min_h Rk_minbg_hs Rk_minbg_s Rk_opt_hs Rk_opt_s Rk_optres_hs Rk_optres_s Rk_soll Rk_soll_h Rk_soll_hs Rk_soll_s Rk_sollm_h Rk_sollm_hs Rk_sollm_s Rk_sollstart Rk_solltmp_s Rk_vlo_hs Rk_vlo_s Rk_vlu_hs Rk_vlu_s Rksoll_h Rksoll_h1 Rksoll_h2 Rksoll_hs Rksoll_s Rkte_kh Rkte_kh_s Rkte_max Rkte_md Rkte_md_s St_bvmdi St_mdimax St_mdimax.B_khmdoe_ena St_mdimax.B_mdimax_hs St_mdimax.B_mdimax_s St_mdrk St_mdrk.B_doe_h St_mdrk.B_doe_hs St_mdrk.B_doe_s St_mdrk.B_khmdoe_akt St_mdrk.B_la_prio St_mdrk.B_laprio_h St_mdrk.B_rfresmx_ba St_mdrk.B_rk_resmax St_mdrk2 St_mdrk2.B_espr_start St_mdrk2.B_hd_start St_mdrk2.B_klopfen_s St_mdrk2.B_nesps St_mdrk2.B_rfsollfil_dec St_mdrk2.B_rfsollfil_inc St_mdrk2.B_zwladif St_mdrk3 St_mdrk3.B_laprio_abgas St_mdrk3fach St_mdrk3fach.B_rk3h_akt St_rf St_rf.B_rfmin St_rkaddinst St_rkaddinst.B_rkaddinst_neg St_rkaddinst.B_rkaddinst_on St_rkaddinst.B_rkaddinst_pos St_rkaddinst.B_rkinst_init St_rkaddinst.B_rkinstpar_neg Zr_zyk_nstart /end OUT_MEASUREMENT
 /begin IN_MEASUREMENT Ba_ist Baw_soll Dmdkw_soll Drf_spuel Drfkh_s Eta_ges_f Eta_lako Eta_lamb_bas Eta_mdkh Eta_zwist_m Eta_zwve_m Eta_zylausbas Etazw_hs F_atldyn F_lakor1 F_lakor2 F_start F_tikorzsk F_tvdkho F_vst Khnn Kr_kh La_soll1 La_soll2 La_soll_ko1 La_soll_ko2 La_soll_stat1 La_soll_stat2 Mdi_ist_m Mdi_ml_soll Mdi_opt_l1 Mdi_res_llmx Mdi_soll Mdi_zw_soll Nkw Prail_ist Rf Rf_ig_ist Rf_max_ext Rf_res_max Rf_vl Rk2_kh_h Rk3_kh_s Rktev St_anf_prail St_anf_prail.B_aprail_hom St_anf_prail.B_aprail_ndnotl St_anf_prail.B_prail_h St_anf_prail.B_prailvcv_h St_anf_prail.B_prailvfd_h St_ba_agf St_ba_agf.B_hstoech St_ba_agf.B_khmdoe_anf St_bv_kath St_bv_kath.B_hsplit_akt St_bv_kath.B_nesps_akt St_bvist St_clc St_clc.B_hmm_clc St_clc.B_sch_clc St_kath_ena St_kath_ena.B_hsplit_ena St_kath_ena.B_nesps_ena St_kath_ena.B_verb_h St_kath_ena.B_verb_s St_lamko St_lamko.B_bswl St_lamko.B_lainst_neg St_lamko.B_lainst_pos St_lamko.B_laprio_ko St_mdbafak St_mdbafak.B_hmm_akt St_mdbafak.B_hom_akt St_mdbafak.B_hschicht St_mdbafak.B_la_stopp St_mdbafak.B_la_stopp1 St_mdbafak.B_la_stopp2 St_mdbafak.B_sch_akt St_mdbafak.B_schicht St_mdbafast St_mdbafast.B_beopt_aus St_mdbafast.B_priov_haeng St_mdbafast.B_ums_fast St_mdbanl2 St_mdbanl2.B_gl_ernl St_mdbanl2.B_gl_lanl St_mdbanl2.B_gl_zilnl St_mdbanl2.B_prail_nl St_mdbanl2.B_vdoe_nl St_mdrk2.B_espr_start St_mdrk2.B_hd_start St_mdrk2.B_klopfen_s St_mdrk2.B_nesps St_mdrk2.B_rfsollfil_dec St_mdrk2.B_rfsollfil_inc St_mdrk2.B_zwladif St_mkwchn St_mkwchn.B_kwdreht St_motzustd St_motzustd.B_ll_roh St_motzustd.B_vl St_railko St_railko.B_prail_hs St_railko.B_prail_s St_railko.B_praildoe_h St_sawe St_sawe.B_sa St_sawe.B_sae St_sawe.B_safast St_start St_start.B_jumpstart St_start.B_sta St_start.B_start St_start.B_startende St_start.B_wst St_tevanst St_tevanst.B_tev_zu St_varkat St_varkat.B_varkat St_zwaus St_zwaus.B_zwmin_hs Tmot Tmot_start Tn_start_10 Zr_seg_nstart /end IN_MEASUREMENT
/end FUNCTION
/begin FUNCTION MDSSM ""
 /begin DEF_CHARACTERISTIC KL_NMAXGRAD_KUP K_IEFFGS_KFS K_IEFFSMG_KFS K_NMIN_LDMAUS K_TDKEIN_GANG K_TD_KUPPEXT K_TD_LDMAUS K_TD_LDMAUS1 K_T_ENTPRGANG K_ZK_NKWGRAD S_GANGWECHSEL_AN S_IPM_06 S_IPM_BSPORT S_LDMAUSHS_AKT S_LDMAUSRS_AKT S_MD_RADDYN /end DEF_CHARACTERISTIC
 /begin OUT_MEASUREMENT Gangi_alt Gangi_buf Gangi_entpr Gangi_entpr_alt Md_rad_ist Md_rad_max Md_rad_min Md_rad_minti Mdi_minti Nkw_grad_fpt1 St_anman St_anman.B_2fl_gangi St_anman.B_antieb St_anman.B_antieb_starr St_anman.B_kein_gang St_anman.B_kupp_int St_anman.B_ldm_mdrad St_ldm_kupp T_entpr_gang Td_kein_gang Td_kupp_ext Td_ldm_aus Td_ldm_aus1 Var_dkg Var_hs Var_ldm Var_smg /end OUT_MEASUREMENT
 /begin IN_MEASUREMENT Eta_zw_mint Gangi I_eff_gs I_ges Md_na Mdi_ist_m Mdi_ml_soll Mdi_reib Mdi_zw_soll Mdk_max Mdk_min_f Nkw Nkw_grad Nmax_var Nstat Rf_min St_bgkuppl St_bgkuppl.B_kupp St_bgkuppl.B_kupp1 St_bgkuppl.B_kupp2 St_bgkuppl.B_kupp_ext St_bgkuppl.B_kupp_mod St_fw St_fw.B_hschalt_komb St_fw.B_kupp_extalt St_fw.B_ldm_akt04 St_fw.B_ldm_off St_fw.B_ldm_offhs St_fw.B_ldm_offreg St_fw.B_ldm_offrs St_fw.B_rschalt_komb St_fzg_1 St_kupp_smg St_mdk St_mdk.B_asr_akt St_mdk.B_getr_plus St_mdk.B_md_dynman St_mdk.B_mdk_plus St_mdk.B_msr_aktiv St_mdk.B_san St_mdk.B_siko_akt St_mdk.B_zw_dynman St_mdk1 St_mdk1.B_md_dynman1 St_mdk1.B_mdzw_min1 St_mdk1.B_mdzw_min2 St_mdk1.B_mdzw_plus St_mdk1.B_zwe_ar St_mdk1.B_zwe_fzdyn St_mdk1.B_zwe_kh St_mdk1.B_zwe_kupp St_mdk1.B_zwe_llr St_mdk1.B_zwe_res St_mdk1.B_zwe_resa St_mdk1.B_zwe_sa St_mdk1.B_zwe_start St_wk Var_at /end IN_MEASUREMENT
/end FUNCTION
/begin FUNCTION rail_30_14_ "" /begin SUB_FUNCTION RAILKO /end SUB_FUNCTION /end FUNCTION
/begin FUNCTION RAILKO ""
 /begin DEF_CHARACTERISTIC KF_PRAILK_H KF_PRAILNL_H KF_PRAIL_H KF_PRAIL_HS KF_PRAIL_HSMIN KF_PRAIL_S KF_PRAIL_SMIN KL_PRAILVL_H K_PRAILDOE_DIS K_PRAILDOE_ENA K_PRAILMIN_HYS K_PRAIL_ABST K_PRAIL_MAN K_PRAIL_ST K_TMMNPRAIL_K K_TMMXPRAIL_K S_PRAILVL_ENA S_PRAIL_ABST S_PRAIL_MAN S_PRAIL_SW /end DEF_CHARACTERISTIC
 /begin OUT_MEASUREMENT Prail_h Prail_hs Prail_hs_min Prail_out_s Prail_s Prail_s_min Prail_schalt Prail_soll Prail_sw Schalt_prail St_rail St_rail.B_prailsw St_railko St_railko.B_prail_hs St_railko.B_prail_s St_railko.B_praildoe_h /end OUT_MEASUREMENT
 /begin IN_MEASUREMENT Ba_ist Ba_prio Ba_subist Ba_subprio Nkw P_rail_kh Prail_ist Rk_soll_h Rk_soll_hs Rk_soll_s St_kl15 St_kl15.B_kl15_ep St_kl15.B_kl15_vorab St_mdbanl2 St_mdbanl2.B_gl_ernl St_mdbanl2.B_gl_lanl St_mdbanl2.B_gl_zilnl St_mdbanl2.B_prail_nl St_mdbanl2.B_vdoe_nl St_motzustd St_motzustd.B_ll_roh St_motzustd.B_vl St_rail.B_prailsw St_start St_start.B_jumpstart St_start.B_sta St_start.B_start St_start.B_startende St_start.B_wst Tmot /end IN_MEASUREMENT
/end FUNCTION
/begin FUNCTION vbr_30_48_ "" /begin SUB_FUNCTION VRAMO VRLUR VRS_MD_GDI /end SUB_FUNCTION /end FUNCTION
/begin FUNCTION VRAMO ""
 /begin DEF_CHARACTERISTIC KF_WURAMO K_FAKAMO05 K_FAKAMO10 K_FAKAMO15 K_FAKAMO20 K_FAKAMO25 K_FAKAMO30 K_FAKAMO35 K_FAKAMO40 K_NAMOAUS K_ND5Z_FIL K_NDIFAMO_MN K_NDIFAMO_MX /end DEF_CHARACTERISTIC
 /begin OUT_MEASUREMENT Amo_05 Amo_10 Amo_15 Amo_20 Amo_25 Amo_30 Amo_35 Amo_40 Amocos05 Amocos10 Amocos15 Amocos20 Amocos25 Amocos30 Amocos35 Amocos40 Amocosx11 Amocosx12 Amocosx21 Amocosx22 Amocosx23 Amocosx24 Amocosx5 Amosin05 Amosin10 Amosin15 Amosin20 Amosin25 Amosin30 Amosin35 Amosin40 Amosinx11 Amosinx12 Amosinx21 Amosinx22 Amosinx5 N5z_mw Nd5z_f Nd5z_fil St_vramo St_vramo.B_amoaktiv St_vramo.B_ndifamo St_vramo.B_ndifamo_old /end OUT_MEASUREMENT
 /begin IN_MEASUREMENT Nkw Seg5z Segakt St_pwf St_pwf.B_pwf /end IN_MEASUREMENT
/end FUNCTION
/begin FUNCTION VRLUR ""
 /begin DEF_CHARACTERISTIC KF_AMOFAK KF_LURABSFAK KF_LURABSMX KF_LURMDIFAK KL_AMO05_MX KL_AMO10_MX KL_AMO15_MX KL_AMO20_MX KL_LURNORM K_BANKWAHL K_LURABS K_LURDIF K_LURKORGANG K_MDI_MX K_MDI_VZ K_NVRAUS /end DEF_CHARACTERISTIC
 /begin OUT_MEASUREMENT Amo_05gr Amo_10gr Amo_15gr Amo_20gr Bank_akt F_amogrenz F_lurmdi Lur_alt Lur_ko Lur_mw Lurabs_f Lurabs_mx Lurabs_mx1 Lurabs_mx2 Lurabsgr Lurdif_f Lurdifmw Lurgrd Mdi_dif Mdi_dif_vz Mdi_diftmp St_vrkoor_100ms St_vrkoor_100ms.B_kwerrorvbr /end OUT_MEASUREMENT
 /begin IN_MEASUREMENT Lur Mdi_ist Nkw Rf St_sawe St_sawe.B_sa St_sawe.B_sae St_sawe.B_safast St_vrkoor_seg St_vrkoor_seg.B_vraus St_vrkoor_seg.B_vrkor St_zylab St_zylab.B_zylab1 St_zylab.B_zylab2 Tmot Tn_start_10 /end IN_MEASUREMENT
/end FUNCTION
/begin FUNCTION VRS_MD_GDI ""
 /begin DEF_CHARACTERISTIC CW_MAT_FSICHER KF_FDZWKRVR KF_FTIZSK_MN KF_FTMOTVR KF_FTMOTVR_GD KL_FDPSVR KL_FMDRESVR KL_FRSTGDEK KL_FRSTGINK KL_FTIZSK_MX KL_TIZSK_INK K_FSICHER_MAN K_FSIERR_INK K_FZRBK_AUSSA K_FZRZYKB K_FZR_AUSSA K_FZR_AUSSB1 K_FZR_AUSSB4 K_LAZSK_OFS K_TIZSK_ABSMN K_TIZSK_DEK K_ZRSEG_AUSSA K_ZRSEG_AUSSB K_ZSKABS_MX S_DZWKRVRGD S_FSICHER_MAN S_RSTGVRDG S_SIERRDPS S_SIERRGD S_SIERRHFM S_SIERRKSD S_SIERRTMOT S_VRSTIKOR S_ZRAUS_RESET /end DEF_CHARACTERISTIC
 /begin OUT_MEASUREMENT F_dpsvr F_dzwkrvr F_errvr F_mdresvr F_rstgvr F_sicher_mem F_tikorzsk F_tizsk_mn F_tizsk_mx F_tmotvr La_soll_konv St_vrs_10ms St_vrs_10ms.B_sierr St_vrs_10ms.B_sigd St_vrs_gdi_seg St_vrs_gdi_seg.B_amogr St_vrs_gdi_seg.B_auss_hom St_vrs_gdi_seg.B_zrseg_ausbzyk St_vrs_gdi_seg.B_zrseg_ausbzyk_alt St_vrs_gdi_seg.B_zrseg_aussa St_vrs_gdi_seg.B_zrseg_aussa_alt St_vrs_gdi_seg.B_zrseg_aussb St_vrs_gdi_seg.B_zrseg_aussb_alt St_vrs_gdi_seg2 St_vrs_gdi_seg2.B_lurabsti Vrquo Vrquo1 Vrquo2 Zr_auss_samx Zr_auss_sbmx Zr_aussa_hom Zr_aussb_hom Zr_aussb_mx Zr_aussbzyk_hom Zrseg_aussa Zrseg_aussb /end OUT_MEASUREMENT
 /begin IN_MEASUREMENT Amo_05 Amo_05gr Amo_10 Amo_10gr Amo_15 Amo_15gr Amo_20 Amo_20gr Ba_ist Bank_akt Dpsvvtte Dzw_annm F_sicher_rf F_sicher_zw La_ist1 La_ist2 La_soll Lurabs_f Lurabs_mx1 Lurabs_mx2 Lurabsgr Lurdif_f Md_res_anf Nkw Rf St_auss St_auss.B_auss_b1 St_mdbanl St_mdbanl.B_agrzu_nl St_mdbanl.B_disa_nl St_mdbanl.B_evvt_vsa_nl St_mdbanl.B_evvt_vse_nl St_mdbanl.B_lastopp_nl St_mdbanl.B_tevzu_nl St_mdbanl.B_wesb1h_nl St_mdbanl.B_zw_nl St_pwf St_pwf.B_pwf St_start St_start.B_jumpstart St_start.B_sta St_start.B_start St_start.B_startende St_start.B_wst St_vrkoor_seg St_vrkoor_seg.B_vraus St_vrkoor_seg.B_vrkor Tans Tmot Tmot_start Zr_auss_b Zr_auss_suma Zr_auss_sumb Zr_ausszyk_b4 Zrbk_auss_a Zrbkmx_auss_a Zrmx_auss_a Zrmx_auss_b1 Zrmx_auss_b4 /end IN_MEASUREMENT
/end FUNCTION
/begin FUNCTION wm_30_53_ ""
 /begin SUB_FUNCTION WMEWAPU WMKFT WMPRIO WMSCHALT WMTURBO WMZUSTA WM_NL WM_START /end SUB_FUNCTION
/end FUNCTION
/begin FUNCTION WMEWAPU ""
 /begin DEF_CHARACTERISTIC KF_EWPFCL_DI KF_EWPFCOOL KL_V_VSKR K_ETA_EWPGETR K_EWP_CALV K_EWP_MN K_EWP_MX K_FV_EWPGETR K_VSKR_ZK K_WMKVDFAK /end DEF_CHARACTERISTIC
 /begin OUT_MEASUREMENT Ag_ewp_help_1 Ag_ewp_help_2 Ag_ewp_help_3 Ag_ewp_help_4 Ag_ewp_help_5 F_ewp_co Kvaverbr_h Kvaverbr_h1 Kvaverbr_h2 Kvaverbr_old Mdk_ewp St_wmewapu0 St_wmewapu0.B_kvaverbr Vs_ewp_ag Vs_ewp_mot Vs_ewp_of Vskr_ewp_h Vskr_ewp_ist Vskr_mw Vskr_mw_h Vskr_mw_h1 Vskr_mw_old Vskr_sum Zaehl_lok Zaehl_lok1 Zaehl_lok1_h /end OUT_MEASUREMENT
 /begin IN_MEASUREMENT Kvaverbr Mdi_ist_m Mdi_reib Nkw Nturb St_getriebe St_getriebe.B_autget St_mdbafak St_mdbafak.B_hmm_akt St_mdbafak.B_hom_akt St_mdbafak.B_hschicht St_mdbafak.B_la_stopp St_mdbafak.B_la_stopp1 St_mdbafak.B_la_stopp2 St_mdbafak.B_sch_akt St_mdbafak.B_schicht St_mkwchn St_mkwchn.B_kwdreht V /end IN_MEASUREMENT
/end FUNCTION
/begin FUNCTION WMKFT ""
 /begin DEF_CHARACTERISTIC KL_KFT_PLOC K_KFT_D K_KFT_I K_KFT_IMN K_KFT_IMX K_KFT_REGMN K_KFT_REGMX /end DEF_CHARACTERISTIC
 /begin OUT_MEASUREMENT Dtkwsoll Kft_d Kft_i Kft_p Kft_p_loc Kft_status Tkwsoll Tv_kft Tvkft /end OUT_MEASUREMENT
 /begin IN_MEASUREMENT Tmot /end IN_MEASUREMENT
/end FUNCTION
/begin FUNCTION WMPRIO ""
 /begin DEF_CHARACTERISTIC KF_GBTR KL_VTANS K_BA_WMAPPL K_BEQSANFMN K_EWPACMX K_EWPTWAlMX K_EWPWACAL K_EWPWAKOR K_EWPWA_B K_EWP_PE K_EWP_QS K_EWP_TDPE K_EWP_TDQS K_MDKEWPTDLP K_NKW_MN K_PRIO_WMBA K_TDBAISTEWP K_TGBSMX K_TGET_MN K_TGET_MX K_TGNFKSMX K_TMBSMX K_TMHEIZMN K_TMNFKSMX K_TOBSMX K_TOHKMX K_TONFKSMX K_TUHEIZMN K_VNFKSMN K_WMTANSHYS K_WMTMTGHYS K_WMTM_ER K_WMTOHYS K_WMTU_1 K_WMTU_2 K_ZAEHL_PWG S_EWPDIAG /end DEF_CHARACTERISTIC
 /begin OUT_MEASUREMENT Ba_wm_ist Ba_wm_prio Ba_wm_soll Bapr_wm_appl Bapr_wm_bfel Bapr_wm_bs Bapr_wm_gbtr Bapr_wm_heizl Bapr_wm_nfks Bapr_wm_warm Baw_wm_heizl Mdk_ewp_help Nkw_help_pe Pe St_wmprio St_wmprio.B_ewptmwae St_wmprio.B_ewpwae St_wmprio.B_fi_eluee St_wmprio.B_fi_tmot St_wmprio.B_heiz_prio St_wmprio.B_pwg_ist St_wmprio.B_tmheiz St_wmprio.B_tuheiz St_wmprio0 St_wmprio0.B_ewp_pe St_wmprio0.B_ewp_qs St_wmprio0.B_ewp_vs St_wmprio0.B_help_pe St_wmprio0.B_help_qs St_wmprio0.B_n46 St_wmprio0.B_nkwtget St_wmprio0.B_pwg90 St_wmprio1 St_wmprio1.B_baistewp Tmot_wm Vs_ewpkaac Vs_ewpvbz Zahler_pwg /end OUT_MEASUREMENT
 /begin IN_MEASUREMENT Ba_ist_ewp Mdk_ewp Nkw Pwg_ist Qs_anf_klima St_egs St_egs.B_egs_khl1 St_egs.B_egs_khl2 St_egs.B_fs St_getriebe St_getriebe.B_autget St_kl15 St_kl15.B_kl15_ep St_kl15.B_kl15_vorab St_kr St_kr.B_clradkr St_kr.B_krdws St_kr.B_krndy St_kr.B_zwkraa St_krann_1000ms St_krann_1000ms.B_kftkr St_mkwchn St_mkwchn.B_kwdreht St_wm St_wm.B_hz St_wm.B_korel St_wm.B_lklps_kl1 St_wm.B_lklps_kl2 St_wm.B_nkmtemp St_wmschalt0 St_wmschalt0.B_beende St_wmschalt0.B_hz_wm St_wmschalt0.B_ntlkws_v Tans Tget Tmot Toel Tumg V Vskr_ewp_ist /end IN_MEASUREMENT
/end FUNCTION
/end MODULE
/end PROJECT
