ASAP2_VERSION 1 41
/begin PROJECT MSD85 "Spray Guided DI-System with Piezo Injectors for 8-Cylinder"
/begin HEADER "_default_HeaderComment" PROJECT_NO _91 /end HEADER
/begin MODULE _default_ModuleName "_default_ModuleLongIdentifier"
/begin MOD_COMMON "_default_ModCommonComment" DEPOSIT ABSOLUTE BYTE_ORDER MSB_LAST ALIGNMENT_BYTE 1 ALIGNMENT_WORD 2 ALIGNMENT_LONG 2 ALIGNMENT_FLOAT32_IEEE 2 ALIGNMENT_FLOAT64_IEEE 4 /end MOD_COMMON
/begin MEASUREMENT D_tans_tumg "Differenz Tans zu Tumg" SWORD _CNV_R_R_Def_t_sw_q_578_CM 1 100. -3276.8 3276.7 DISPLAY_IDENTIFIER D_TANS_TUMG ECU_ADDRESS 0xc0007a0c FORMAT "%6.1" /end MEASUREMENT
/begin MEASUREMENT D_tm_tkwsh "Hilfsgrösse Gradient Tmot - Tkwsoll" SWORD _CNV_R_R_Def_t_sw_q_579_CM 1 100. -327.68 327.67 DISPLAY_IDENTIFIER D_TM_TKWSH ECU_ADDRESS 0xc00079b2 FORMAT "%7.2" /end MEASUREMENT
/begin MEASUREMENT D_tmot_tkws "Differenz tmot-tkwsoll" SWORD _CNV_R_R_Def_t_sw_q_579_CM 1 100. -327.68 327.67 DISPLAY_IDENTIFIER D_TMOT_TKWS ECU_ADDRESS 0xc00079b4 FORMAT "%7.2" /end MEASUREMENT
/begin MEASUREMENT D_tmot_tkws2 "Differenz tmot-tkwsoll gefiltert" SWORD _CNV_R_R_Def_t_sw_q_579_CM 1 100. -327.68 327.67 DISPLAY_IDENTIFIER D_TMOT_TKWS2 ECU_ADDRESS 0xc00079b6 FORMAT "%7.2" /end MEASUREMENT
/begin MEASUREMENT Dzw_agr_s "Deltazündwinkel AGR-Korrektur (schicht)" SWORD _CNV_R_R_Def_zw_sw__604_CM 1 100. -50. 60. DISPLAY_IDENTIFIER DZW_AGR_S ECU_ADDRESS 0xd000d0d0 FORMAT "%6.1" /end MEASUREMENT
/begin MEASUREMENT Dzw_hs "Deltazündwinkel (homogen-schicht)" SWORD _CNV_R_R_Def_zw_sw__604_CM 1 100. -50. 60. DISPLAY_IDENTIFIER DZW_HS ECU_ADDRESS 0xd000d0de FORMAT "%6.1" /end MEASUREMENT
/begin MEASUREMENT Dzw_hz "Differenzzündwinkel für Heizleistungseingriff" SBYTE _CNV_R_R_Def_zw_sb__605_CM 1 100. -64. 63.5 DISPLAY_IDENTIFIER DZW_HZ ECU_ADDRESS 0xd000d002 FORMAT "%4.1" /end MEASUREMENT
/begin MEASUREMENT Dzw_kr_gd "Differenzzündwinkel für Klopfen gedrosselter Betrieb" SBYTE _CNV_R_R_Def_zw_sb__605_CM 1 100. -64. 63.5 DISPLAY_IDENTIFIER DZW_KR_GD ECU_ADDRESS 0xd000cfe7 FORMAT "%4.1" /end MEASUREMENT
/begin MEASUREMENT Dzw_kr_hs "Deltazuendwinkel Klopfspätverstellung  homogen-schicht (Regelung + Adaption) " SWORD _CNV_R_R_Def_zw_sw__604_CM 1 100. -50. 60. DISPLAY_IDENTIFIER DZW_KR_HS ECU_ADDRESS 0xd000d0b0 FORMAT "%6.1" ARRAY_SIZE 8 MATRIX_DIM 8 1 1 /end MEASUREMENT
/begin MEASUREMENT Dzw_kr_vt "Differenzzündwinkel für Klopfen VVT Betrieb" SBYTE _CNV_R_R_Def_zw_sb__605_CM 1 100. -64. 63.5 DISPLAY_IDENTIFIER DZW_KR_VT ECU_ADDRESS 0xd000cfe8 FORMAT "%4.1" /end MEASUREMENT
/begin MEASUREMENT Dzw_krt_hs "Deltazündwinkel Temperaturkorrektur für Klopfen (homogen-schicht)" SWORD _CNV_R_R_Def_zw_sw__604_CM 1 100. -50. 60. DISPLAY_IDENTIFIER DZW_KRT_HS ECU_ADDRESS 0xd000d0e6 FORMAT "%6.1" /end MEASUREMENT
/begin MEASUREMENT Dzw_ks "Kein Langbezeichner vergeben" SWORD _CNV_R_R_Def_zw_sw__604_CM 1 100. -3276.8 3276.7 DISPLAY_IDENTIFIER DZW_KS ECU_ADDRESS 0xd000d14e FORMAT "%6.1" /end MEASUREMENT
/begin MEASUREMENT Dzw_lam_kor "Lambdakorrektur Grundzündwinkel" SBYTE _CNV_R_R_Def_zw_sb__605_CM 1 100. -64. 63.5 DISPLAY_IDENTIFIER DZW_LAM_KOR ECU_ADDRESS 0xd000cfe4 FORMAT "%4.1" /end MEASUREMENT
/begin MEASUREMENT Dzw_lam_kor1 "Lambdakorrektur1 Grundzündwinkel GDI " SBYTE _CNV_R_R_Def_zw_sb__605_CM 1 100. -64. 63.5 DISPLAY_IDENTIFIER DZW_LAM_KOR1 ECU_ADDRESS 0xd000cfe5 FORMAT "%4.1" /end MEASUREMENT
/begin MEASUREMENT Dzw_lam_kor2 "Lambdakorrektur2 Grundzündwinkel GDI" SBYTE _CNV_R_R_Def_zw_sb__605_CM 1 100. -64. 63.5 DISPLAY_IDENTIFIER DZW_LAM_KOR2 ECU_ADDRESS 0xd000cfe6 FORMAT "%4.1" /end MEASUREMENT
/begin MEASUREMENT Dzw_min "" SWORD _CNV_R_R_Def_zw_sw__604_CM 1 100. -3276.8 3276.7 DISPLAY_IDENTIFIER DZW_MIN ECU_ADDRESS 0xd000d0ec FORMAT "%6.1" /end MEASUREMENT
/begin MEASUREMENT Dzw_rf_s "Deltazündwinkel (schicht)" SWORD _CNV_R_R_Def_zw_sw__604_CM 1 100. -50. 60. DISPLAY_IDENTIFIER DZW_RF_S ECU_ADDRESS 0xd000d0d8 FORMAT "%6.1" /end MEASUREMENT
/begin MEASUREMENT Dzw_soll "Hier könnte Ihr Langbezeichner stehen" SWORD _CNV_R_R_Def_zw_sw__604_CM 1 100. -3276.8 3276.7 DISPLAY_IDENTIFIER DZW_SOLL ECU_ADDRESS 0xd000d13c FORMAT "%6.1" /end MEASUREMENT
/begin MEASUREMENT Dzw_t1 "Temperaturkorrektur 1 Grundzündwinkel" SBYTE _CNV_R_R_Def_zw_sb__605_CM 1 100. -64. 63.5 DISPLAY_IDENTIFIER DZW_T1 ECU_ADDRESS 0xd000cfe2 FORMAT "%4.1" /end MEASUREMENT
/begin MEASUREMENT Dzw_td98 "Grundzündwinkelkorrektur teilgedrosselt ROZ 98" SBYTE _CNV_R_R_Def_zw_sb__605_CM 1 100. -64. 63.5 DISPLAY_IDENTIFIER DZW_TD98 ECU_ADDRESS 0xd000cfd6 FORMAT "%4.1" /end MEASUREMENT
/begin MEASUREMENT Dzw_vns_gd "Differenzzündwinkel bei Warmlauf gedrosselt" SBYTE _CNV_R_R_Def_zw_sb__605_CM 1 100. -64. 63.5 DISPLAY_IDENTIFIER DZW_VNS_GD ECU_ADDRESS 0xd000cfbe FORMAT "%4.1" /end MEASUREMENT
/begin MEASUREMENT Dzw_vns_vt "Differenzzündwinkel bei Warmlauf VVT Betrieb" SBYTE _CNV_R_R_Def_zw_sb__605_CM 1 100. -64. 63.5 DISPLAY_IDENTIFIER DZW_VNS_VT ECU_ADDRESS 0xd000cfbd FORMAT "%4.1" /end MEASUREMENT
/begin MEASUREMENT Dzw_wl_gd "Differenzzündwinkel bei Warmlauf gedrosselter Betrieb" SBYTE _CNV_R_R_Def_zw_sb__605_CM 1 100. -64. 63.5 DISPLAY_IDENTIFIER DZW_WL_GD ECU_ADDRESS 0xd000cfbf FORMAT "%4.1" /end MEASUREMENT
/begin MEASUREMENT Dzw_wl_hs "Deltazündwinkel bei Warmlauf (homogen-schicht)" SWORD _CNV_R_R_Def_zw_sw__604_CM 1 100. -50. 60. DISPLAY_IDENTIFIER DZW_WL_HS ECU_ADDRESS 0xd000d0e4 FORMAT "%6.1" /end MEASUREMENT
/begin MEASUREMENT Dzw_wl_vt "Differenzzündwinkel bei Warmlauf VVT Betrieb" SBYTE _CNV_R_R_Def_zw_sb__605_CM 1 100. -64. 63.5 DISPLAY_IDENTIFIER DZW_WL_VT ECU_ADDRESS 0xd000cfbc FORMAT "%4.1" /end MEASUREMENT
/begin MEASUREMENT Dzwdyn "Differenzzündwinkel Dynamikkorrektur" SBYTE _CNV_R_R_Def_zw_sb__605_CM 1 100. -64. 63.5 DISPLAY_IDENTIFIER DZWDYN ECU_ADDRESS 0xd000cff6 FORMAT "%4.1" /end MEASUREMENT
/begin MEASUREMENT Dzwdyn_dek "Differenzzündwinkel Dynamikkorrektur Abregelungsdekrement" SBYTE _CNV_R_R_Def_zw_sb__605_CM 1 100. -64. 63.5 DISPLAY_IDENTIFIER DZWDYN_DEK ECU_ADDRESS 0xd000cff8 FORMAT "%4.1" /end MEASUREMENT
/begin MEASUREMENT Dzwdyn_hold "Differenzzündwinkel Dynamikkorrektur Haltewert" SBYTE _CNV_R_R_Def_zw_sb__605_CM 1 100. -64. 63.5 DISPLAY_IDENTIFIER DZWDYN_HOLD ECU_ADDRESS 0xd000cff7 FORMAT "%4.1" /end MEASUREMENT
/begin MEASUREMENT Dzwdynn "Differenzzündwinkel Dynamikkorrektur negative Richtung" SBYTE _CNV_R_R_Def_zw_sb__605_CM 1 100. -64. 63.5 DISPLAY_IDENTIFIER DZWDYNN ECU_ADDRESS 0xd000cfff FORMAT "%4.1" /end MEASUREMENT
/begin MEASUREMENT Dzwdynn_dek "Differenzzündwinkel Dynamikkorrektur Abregelungsdekrement neg. Richtung" SBYTE _CNV_R_R_Def_zw_sb__605_CM 1 100. -64. 63.5 DISPLAY_IDENTIFIER DZWDYNN_DEK ECU_ADDRESS 0xd000d001 FORMAT "%4.1" /end MEASUREMENT
/begin MEASUREMENT Dzwdynn_hold "Differenzzündwinkel Dynamikkorrektur Haltewert negative Richtung" SBYTE _CNV_R_R_Def_zw_sb__605_CM 1 100. -64. 63.5 DISPLAY_IDENTIFIER DZWDYNN_HOLD ECU_ADDRESS 0xd000d000 FORMAT "%4.1" /end MEASUREMENT
/begin MEASUREMENT Dzwo_khwl_gd "Gewichtete Warmlaufkorrektur opt. Zündwinkel bei Katheizen GD-Pfad" SBYTE _CNV_R_R_Def_zw_sb__605_CM 1 100. -64. 63.5 DISPLAY_IDENTIFIER DZWO_KHWL_GD ECU_ADDRESS 0xd000cf9f FORMAT "%4.1" /end MEASUREMENT
/begin MEASUREMENT Dzwo_khwl_vt "Gewichtete Warmlaufkorrektur opt. Zündwinkel bei Katheizen VT-Pfad" SBYTE _CNV_R_R_Def_zw_sb__605_CM 1 100. -64. 63.5 DISPLAY_IDENTIFIER DZWO_KHWL_VT ECU_ADDRESS 0xd000cfa0 FORMAT "%4.1" /end MEASUREMENT
/begin MEASUREMENT Dzwo_lam_kor "Lambdakorrektur optimaler Zündwinkel" SBYTE _CNV_R_R_Def_zw_sb__605_CM 1 100. -64. 63.5 DISPLAY_IDENTIFIER DZWO_LAM_KOR ECU_ADDRESS 0xd000cf93 FORMAT "%4.1" /end MEASUREMENT
/begin MEASUREMENT Dzwo_lam_kor1 "Lambdakorrektur optimaler Zündwinkel Bank 1" SBYTE _CNV_R_R_Def_zw_sb__605_CM 1 100. -64. 63.5 DISPLAY_IDENTIFIER DZWO_LAM_KOR1 ECU_ADDRESS 0xd000cf94 FORMAT "%4.1" /end MEASUREMENT
/begin MEASUREMENT Dzwo_lam_kor2 "Lambdakorrektur optimaler Zündwinkel Bank 2" SBYTE _CNV_R_R_Def_zw_sb__605_CM 1 100. -64. 63.5 DISPLAY_IDENTIFIER DZWO_LAM_KOR2 ECU_ADDRESS 0xd000cf95 FORMAT "%4.1" /end MEASUREMENT
/begin MEASUREMENT Dzwokh_lam_kor "Optimaler Zündwinkel Lambdakorrektur bei Katheizen" SBYTE _CNV_R_R_Def_zw_sb__605_CM 1 100. -64. 63.5 DISPLAY_IDENTIFIER DZWOKH_LAM_KOR ECU_ADDRESS 0xd000cfb8 FORMAT "%4.1" /end MEASUREMENT
/begin MEASUREMENT Dzwokh_lam_kor1 "Optimaler Zündwinkel Lambdakorrektur bei Katheizen Bank 1" SBYTE _CNV_R_R_Def_zw_sb__605_CM 1 100. -64. 63.5 DISPLAY_IDENTIFIER DZWOKH_LAM_KOR1 ECU_ADDRESS 0xd000cfb9 FORMAT "%4.1" /end MEASUREMENT
/begin MEASUREMENT Dzwokh_lam_kor2 "Optimaler Zündwinkel Lambdakorrektur bei Katheizen Bank 2" SBYTE _CNV_R_R_Def_zw_sb__605_CM 1 100. -64. 63.5 DISPLAY_IDENTIFIER DZWOKH_LAM_KOR2 ECU_ADDRESS 0xd000cfba FORMAT "%4.1" /end MEASUREMENT
/begin MEASUREMENT Dzwot "Temperaturkorrektur optimaler Zündwinkel" SBYTE _CNV_R_R_Def_zw_sb__605_CM 1 100. -64. 63.5 DISPLAY_IDENTIFIER DZWOT ECU_ADDRESS 0xd000cf92 FORMAT "%4.1" /end MEASUREMENT
/begin MEASUREMENT Dzwotkh "Temperaturkorrektur opt. Zündwinkel bei Katheizen" SBYTE _CNV_R_R_Def_zw_sb__605_CM 1 100. -64. 63.5 DISPLAY_IDENTIFIER DZWOTKH ECU_ADDRESS 0xd000cf9e FORMAT "%4.1" /end MEASUREMENT
/begin MEASUREMENT Dzwotn "Grundreferenzzündwinkel Temperaturkorrektur normal" SBYTE _CNV_R_R_Def_zw_sb__605_CM 1 100. -64. 63.5 DISPLAY_IDENTIFIER DZWOTN ECU_ADDRESS 0xd000cf9b FORMAT "%4.1" /end MEASUREMENT
/begin MEASUREMENT Dzwt "Temperaturkorrektur Grundzündwinkel" SWORD _CNV_R_R_Def_zw_sw__604_CM 1 100. -50. 60. DISPLAY_IDENTIFIER DZWT ECU_ADDRESS 0xd000cfd2 FORMAT "%6.1" /end MEASUREMENT
/begin MEASUREMENT Dzwt_gd "Temperaturkorrektur Grundzündwinkel gedrosselter Betrieb" SBYTE _CNV_R_R_Def_zw_sb__605_CM 1 100. -64. 63.5 DISPLAY_IDENTIFIER DZWT_GD ECU_ADDRESS 0xd000cfea FORMAT "%4.1" /end MEASUREMENT
/begin MEASUREMENT Dzwt_hs "Temperaturkorrektur Grundzündwinkel (homogen-schicht)" SWORD _CNV_R_R_Def_zw_sw__604_CM 1 100. -50. 60. DISPLAY_IDENTIFIER DZWT_HS ECU_ADDRESS 0xd000d0e2 FORMAT "%6.1" /end MEASUREMENT
/begin MEASUREMENT Dzwt_vt "Temperaturkorrektur Grundzündwinkel VVT Betrieb" SBYTE _CNV_R_R_Def_zw_sb__605_CM 1 100. -64. 63.5 DISPLAY_IDENTIFIER DZWT_VT ECU_ADDRESS 0xd000cfe9 FORMAT "%4.1" /end MEASUREMENT
/begin MEASUREMENT Eta_dzw_sollquad "Hier könnte Ihr Langbezeichner stehen" SWORD _CNV_R_R_Def_eta_sw_606_CM 1 100. -100.003 100. DISPLAY_IDENTIFIER ETA_DZW_SOLLQUAD ECU_ADDRESS 0xd000d140 FORMAT "%8.3" /end MEASUREMENT
/begin MEASUREMENT Eta_zw_min "" SWORD _CNV_R_R_Def_eta_sw_606_CM 1 100. -100.003 100. DISPLAY_IDENTIFIER ETA_ZW_MIN ECU_ADDRESS 0xd000d0ee FORMAT "%8.3" /end MEASUREMENT
/begin MEASUREMENT Eta_zw_mint "" SWORD _CNV_R_R_Def_f_sw_b_570_CM 1 100. -100. 99.9969 DISPLAY_IDENTIFIER ETA_ZW_MINT ECU_ADDRESS 0xd000d0f0 FORMAT "%8.3" /end MEASUREMENT
/begin MEASUREMENT Eta_zw_soll "Hier könnte Ihr Langbezeichner stehen" UWORD _CNV_R_R_Def_eta_uw_615_CM 1 100. 0. 199.9969 DISPLAY_IDENTIFIER ETA_ZW_SOLL ECU_ADDRESS 0xd000d142 FORMAT "%8.3" /end MEASUREMENT
/begin MEASUREMENT Etazw_hs "Zündwinkelwirkungsgrad (homogen-schicht)" UWORD _CNV_R_R_Def_eta_uw_615_CM 1 100. 0. 199.9969 DISPLAY_IDENTIFIER ETAZW_HS ECU_ADDRESS 0xd000d0ac FORMAT "%8.3" /end MEASUREMENT
/begin MEASUREMENT F_dynakt "Faktor Haltezeit Dynamikkorrektur" UBYTE _CNV_R_R_Def_f_ub_b_553_CM 1 100. 0. 0.996 DISPLAY_IDENTIFIER F_DYNAKT ECU_ADDRESS 0xd000cff5 /end MEASUREMENT
/begin MEASUREMENT F_dynnakt "Faktor Haltezeit Dynamikkorrektur negative Richtung" UBYTE _CNV_R_R_Def_f_ub_b_553_CM 1 100. 0. 0.996 DISPLAY_IDENTIFIER F_DYNNAKT ECU_ADDRESS 0xd000cffe /end MEASUREMENT
/begin MEASUREMENT F_dynnvz "Faktor Verzögerungszeit Dynamikkorrektur negative Richtung" UBYTE _CNV_R_R_Def_f_ub_b_553_CM 1 100. 0. 0.996 DISPLAY_IDENTIFIER F_DYNNVZ ECU_ADDRESS 0xd000cffd /end MEASUREMENT
/begin MEASUREMENT F_dynvz "Faktor Verzögerungszeit Dynamikkorrektur" UBYTE _CNV_R_R_Def_f_ub_b_553_CM 1 100. 0. 0.996 DISPLAY_IDENTIFIER F_DYNVZ ECU_ADDRESS 0xd000cff4 /end MEASUREMENT
/begin MEASUREMENT F_dzw_vns_gd "Faktor Überblendung ZW-Korrektur verriegeltes Vanos gedrosselt" UBYTE _CNV_R_R_Def_f_ub_b_553_CM 1 100. 0. 0.996 DISPLAY_IDENTIFIER F_DZW_VNS_GD ECU_ADDRESS 0xd000cfec /end MEASUREMENT
/begin MEASUREMENT F_dzw_vns_vt "Faktor Überblendung ZW-Korrektur verriegeltes Vanos VVT Betrieb" UBYTE _CNV_R_R_Def_f_ub_b_553_CM 1 100. 0. 0.996 DISPLAY_IDENTIFIER F_DZW_VNS_VT ECU_ADDRESS 0xd000cfeb /end MEASUREMENT
/begin MEASUREMENT F_dzwo_khvns "Faktor Überblendung Korrektur opt. Zündwinkel bei Katheizen verriegeltes Vanos" UBYTE _CNV_R_R_Def_f_ub_b_553_CM 1 100. 0. 0.996 DISPLAY_IDENTIFIER F_DZWO_KHVNS ECU_ADDRESS 0xd000cfa1 /end MEASUREMENT
/begin MEASUREMENT F_ewp_ba "Fakto eWAPU" UBYTE _CNV_R_R_Def_f_ub_b_553_CM 1 100. 0. 0.996 DISPLAY_IDENTIFIER F_EWP_BA ECU_ADDRESS 0xc0007a04 /end MEASUREMENT
/begin MEASUREMENT F_ewpw_ba "Fakto eWAPU" UBYTE _CNV_R_R_Def_f_ub_b_553_CM 1 100. 0. 0.996 DISPLAY_IDENTIFIER F_EWPW_BA ECU_ADDRESS 0xc0007a05 /end MEASUREMENT
/begin MEASUREMENT F_kft_ba "Faktor KFT" UBYTE _CNV_R_R_Def_f_ub_b_553_CM 1 100. 0. 0.996 DISPLAY_IDENTIFIER F_KFT_BA ECU_ADDRESS 0xc0007a06 /end MEASUREMENT
/begin MEASUREMENT F_kftw_ba "Faktor KFT" UBYTE _CNV_R_R_Def_f_ub_b_553_CM 1 100. 0. 0.996 DISPLAY_IDENTIFIER F_KFTW_BA ECU_ADDRESS 0xc0007a07 /end MEASUREMENT
/begin MEASUREMENT F_kuehlmx "Faktor nach KF_KUEHLPIMX" UBYTE _CNV_R_R_Def_f_ub_b_553_CM 1 100. 0. 0.996 DISPLAY_IDENTIFIER F_KUEHLMX ECU_ADDRESS 0xc00079e4 /end MEASUREMENT
/begin MEASUREMENT F_kuehln "Leistungsreduzierung bei hoher Drehzahl" UBYTE _CNV_R_R_Def_f_ub_b_613_CM 1 100. 0. 1.9921 DISPLAY_IDENTIFIER F_KUEHLN ECU_ADDRESS 0xc00079e5 /end MEASUREMENT
/begin MEASUREMENT F_kuehls "Berechneter Faktor aus Multiplikation F_kuehlmx und F_kuehln" UBYTE _CNV_R_R_Def_f_ub_b_613_CM 1 100. 0. 1.9921 DISPLAY_IDENTIFIER F_KUEHLS ECU_ADDRESS 0xc00079e6 /end MEASUREMENT
/begin MEASUREMENT F_mdres_wm "Faktor für Momentenvorhalt über Tmot_start und Tn_start_10" UBYTE _CNV_R_R_Def_f_ub_b_553_CM 1 100. 0. 0.996 DISPLAY_IDENTIFIER F_MDRES_WM ECU_ADDRESS 0xc00079e7 /end MEASUREMENT
/begin MEASUREMENT F_nelueft_v "Faktor Fahrgeschwindigkeit für E-Lüfter Ansteuerung" UBYTE _CNV_R_R_Def_f_ub_b_553_CM 1 100. 0. 0.996 DISPLAY_IDENTIFIER F_NELUEFT_V ECU_ADDRESS 0xc00079e8 /end MEASUREMENT
/begin MEASUREMENT F_rfzwv "Faktor Uberblendung Verzögerung Rf" UBYTE _CNV_R_R_Def_f_ub_b_553_CM 1 100. 0. 0.996 DISPLAY_IDENTIFIER F_RFZWV ECU_ADDRESS 0xd000cfed /end MEASUREMENT
/begin MEASUREMENT F_zw_kr_gd "Faktor KR Spätverstellung gedrosselt" UWORD _CNV_R_R_Def_f_uw_b_590_CM 1 100. 0. 1.9999 DISPLAY_IDENTIFIER F_ZW_KR_GD ECU_ADDRESS 0xd000d018 FORMAT "%14.5" /end MEASUREMENT
/begin MEASUREMENT F_zw_kr_vt "Faktor KR Spätverstellung VVT-Betrieb" UWORD _CNV_R_R_Def_f_uw_b_590_CM 1 100. 0. 1.9999 DISPLAY_IDENTIFIER F_ZW_KR_VT ECU_ADDRESS 0xd000d016 FORMAT "%14.5" /end MEASUREMENT
/begin MEASUREMENT F_zw_krt_hs "Faktor ZW-Korrektur für Klopfen (homogen-schicht)" UWORD _CNV_R_R_Def_f_sw_b_616_CM 1 100. 0. 3.9999 DISPLAY_IDENTIFIER F_ZW_KRT_HS ECU_ADDRESS 0xd000d0e8 FORMAT "%14.5" /end MEASUREMENT
/begin MEASUREMENT F_zwbas_s "Überblendfaktor Grundzündwinkel kalt-warm (schicht)" UBYTE _CNV_R_R_Def_f_ub_b_553_CM 1 100. 0. 0.996 DISPLAY_IDENTIFIER F_ZWBAS_S ECU_ADDRESS 0xd000d0d3 /end MEASUREMENT
/begin MEASUREMENT F_zwhz "Einblendungsfaktor Zündwinkeleingriff für Heizleistungssteigerung" UBYTE _CNV_R_R_Def_f_ub_b_553_CM 1 100. 0. 0.996 DISPLAY_IDENTIFIER F_ZWHZ ECU_ADDRESS 0xd000d003 /end MEASUREMENT
/begin MEASUREMENT Hs_help1 "Hilfsgrösse zur Berechnung LKLPS" UBYTE _CNV_R_R_Def_f_ub_b_553_CM 1 100. 0. 0.996 DISPLAY_IDENTIFIER HS_HELP1 ECU_ADDRESS 0xc00079e9 /end MEASUREMENT
/begin MEASUREMENT Hs_help2 "Hilfsgrösse zur Berechnung LKLPS" UBYTE _CNV_R_R_Def_f_ub_b_612_CM 1 100. 0. 31.875 DISPLAY_IDENTIFIER HS_HELP2 ECU_ADDRESS 0xc00079ea FORMAT "%5.2" /end MEASUREMENT
/begin MEASUREMENT Hs_help3 "Hilfsgrösse" SBYTE _CNV_R_R_Def_dez_sl_551_CM 1 100. -128. 127. DISPLAY_IDENTIFIER HS_HELP3 ECU_ADDRESS 0xc00079e2 FORMAT "%3.0" /end MEASUREMENT
/begin MEASUREMENT Hs_help4 "Hilfsgrösse" SBYTE _CNV_R_R_Def_dez_sl_551_CM 1 100. -128. 127. DISPLAY_IDENTIFIER HS_HELP4 ECU_ADDRESS 0xc00079e3 FORMAT "%3.0" /end MEASUREMENT
/begin MEASUREMENT Hs_kelks "Hilfsgrösse" UBYTE _CNV_R_R_Def_f_ub_b_633_CM 1 100. 0. 3.11e-002 DISPLAY_IDENTIFIER HS_KELKS ECU_ADDRESS 0xc00079eb FORMAT "%7.4" /end MEASUREMENT
/begin MEASUREMENT Hs_kelks1 "Hilfsgrösse" UBYTE _CNV_R_R_Def_f_ub_b_633_CM 1 100. 0. 3.11e-002 DISPLAY_IDENTIFIER HS_KELKS1 ECU_ADDRESS 0xc00079ec FORMAT "%7.4" /end MEASUREMENT
/begin MEASUREMENT Md_kuehl_ap "Momentenreduzierung Ba Applikation" SWORD _CNV_R_R_Def_m_sw_q_554_CM 1 100. -3276.8 3276.7 DISPLAY_IDENTIFIER MD_KUEHL_AP ECU_ADDRESS 0xc00079b8 FORMAT "%7.2" /end MEASUREMENT
/begin MEASUREMENT Md_kuehl_wa "Momentenreduzierung Ba Warmlauf" SWORD _CNV_R_R_Def_m_sw_q_554_CM 1 100. -3276.8 3276.7 DISPLAY_IDENTIFIER MD_KUEHL_WA ECU_ADDRESS 0xc00079ba FORMAT "%7.2" /end MEASUREMENT
/begin MEASUREMENT Md_max_acwm "Begrenzungsmoment Klimakompressor" SWORD _CNV_R_R_Def_m_sw_q_554_CM 1 100. -3276.8 3276.7 DISPLAY_IDENTIFIER MD_MAX_ACWM ECU_ADDRESS 0xc00079a8 FORMAT "%7.2" /end MEASUREMENT
/begin MEASUREMENT Mdi_res_he "Momentenreserve WMK in BA Heizleistung" SWORD _CNV_R_R_Def_m_sw_q_554_CM 1 100. -3276.8 3276.7 DISPLAY_IDENTIFIER MDI_RES_HE ECU_ADDRESS 0xc00079bc FORMAT "%7.2" /end MEASUREMENT
/begin MEASUREMENT Mdi_res_he1 "Hilfsgrösse 1 für Momentenreserve WMK in BA HE" SWORD _CNV_R_R_Def_m_sw_q_554_CM 1 100. -3276.8 3276.7 DISPLAY_IDENTIFIER MDI_RES_HE1 ECU_ADDRESS 0xc00079be FORMAT "%7.2" /end MEASUREMENT
/begin MEASUREMENT Mdi_res_he2 "Hilfsgrösse 2 für Momentenreserve WMK in BA HE" SWORD _CNV_R_R_Def_m_sw_q_554_CM 1 100. -3276.8 3276.7 DISPLAY_IDENTIFIER MDI_RES_HE2 ECU_ADDRESS 0xc00079c0 FORMAT "%7.2" /end MEASUREMENT
/begin MEASUREMENT Mdi_res_he3 "Hilfsgrösse 3 für Momentenreserve WMK in BA HE" SWORD _CNV_R_R_Def_m_sw_q_554_CM 1 100. -3276.8 3276.7 DISPLAY_IDENTIFIER MDI_RES_HE3 ECU_ADDRESS 0xc00079c2 FORMAT "%7.2" /end MEASUREMENT
/begin MEASUREMENT Mdi_res_wm "Anforderung Momentenreserve für Wärmemanagement" SWORD _CNV_R_R_Def_m_sw_q_554_CM 1 100. -3276.8 3276.7 DISPLAY_IDENTIFIER MDI_RES_WM ECU_ADDRESS 0xc00079aa FORMAT "%7.2" /end MEASUREMENT
/begin MEASUREMENT Mdi_zwmin_lam "" SWORD _CNV_R_R_Def_zw_sw__604_CM 1 100. -3276.8 3276.7 DISPLAY_IDENTIFIER MDI_ZWMIN_LAM ECU_ADDRESS 0xd000d0f2 FORMAT "%6.1" /end MEASUREMENT
/begin MEASUREMENT Mdk_kuehl_help "Momentenreduzierung BA Bauteilschutz, Notfall" SWORD _CNV_R_R_Def_m_sw_q_554_CM 1 100. -3276.8 3276.7 DISPLAY_IDENTIFIER MDK_KUEHL_HELP ECU_ADDRESS 0xc00079c4 FORMAT "%7.2" /end MEASUREMENT
/begin MEASUREMENT Mdk_kuehl_mx "Leistungsreduzierung Wärmemanagementkoodinator" SWORD _CNV_R_R_Def_m_sw_q_554_CM 1 100. -3276.8 3276.7 DISPLAY_IDENTIFIER MDK_KUEHL_MX ECU_ADDRESS 0xc00079ac FORMAT "%7.2" /end MEASUREMENT
/begin MEASUREMENT Minhubsw "Minhub bei VVT-Motor" SWORD _CNV_R_R_Def_hub_uw_589_CM 1 100. -32.768 32.767 DISPLAY_IDENTIFIER MINHUBSW ECU_ADDRESS 0xd000d01a FORMAT "%8.3" /end MEASUREMENT
/begin MEASUREMENT Nelueft_eco "Tkwsoll für BA-ECO" UBYTE _CNV_R_R_Def_f_ub_b_586_CM 1 100. 0. 99.60930000000001 DISPLAY_IDENTIFIER NELUEFT_ECO ECU_ADDRESS 0xc00079ed FORMAT "%5.2" /end MEASUREMENT
/begin MEASUREMENT Nelueft_ext_h1 "E-Lüfter Ansteuerung vor KL_EL_V" UBYTE _CNV_R_R_Def_f_ub_b_586_CM 1 100. 0. 99.60930000000001 DISPLAY_IDENTIFIER NELUEFT_EXT_H1 ECU_ADDRESS 0xc00079ee FORMAT "%5.2" /end MEASUREMENT
/begin MEASUREMENT Nelueft_ext_h2 "E-Lüfter Ansteuerung nach KL_EL_V" UBYTE _CNV_R_R_Def_f_ub_b_586_CM 1 100. 0. 99.60930000000001 DISPLAY_IDENTIFIER NELUEFT_EXT_H2 ECU_ADDRESS 0xc00079ef FORMAT "%5.2" /end MEASUREMENT
/begin MEASUREMENT Nelueft_ext_h3 "Hilfsgrössen zur Berchnung Nelueft_wa" UBYTE _CNV_R_R_Def_f_ub_b_586_CM 1 100. 0. 99.60930000000001 DISPLAY_IDENTIFIER NELUEFT_EXT_H3 ECU_ADDRESS 0xc00079f0 FORMAT "%5.2" /end MEASUREMENT
/begin MEASUREMENT Nelueft_ext_h4 "Hilfsgrössen zur Berchnung Nelueft_wa" UBYTE _CNV_R_R_Def_f_ub_b_586_CM 1 100. 0. 99.60930000000001 DISPLAY_IDENTIFIER NELUEFT_EXT_H4 ECU_ADDRESS 0xc00079f1 FORMAT "%5.2" /end MEASUREMENT
/begin MEASUREMENT Nelueft_genh "Hilfsgrösse nach Schalter S_EL_GEN" UBYTE _CNV_R_R_Def_f_ub_b_586_CM 1 100. 0. 99.60930000000001 DISPLAY_IDENTIFIER NELUEFT_GENH ECU_ADDRESS 0xc00079f2 FORMAT "%5.2" /end MEASUREMENT
/begin MEASUREMENT Nelueft_h3 "T_eltd_h2 mit Faktor" UBYTE _CNV_R_R_Def_f_ub_b_586_CM 1 100. 0. 99.60930000000001 DISPLAY_IDENTIFIER NELUEFT_H3 ECU_ADDRESS 0xc00079f3 FORMAT "%5.2" /end MEASUREMENT
/begin MEASUREMENT Nelueft_hi "Tkwsoll für BA-HIGH" UBYTE _CNV_R_R_Def_f_ub_b_586_CM 1 100. 0. 99.60930000000001 DISPLAY_IDENTIFIER NELUEFT_HI ECU_ADDRESS 0xc00079f4 FORMAT "%5.2" /end MEASUREMENT
/begin MEASUREMENT Nelueft_hk "Tkwsoll für BA-HIGH+KFT" UBYTE _CNV_R_R_Def_f_ub_b_586_CM 1 100. 0. 99.60930000000001 DISPLAY_IDENTIFIER NELUEFT_HK ECU_ADDRESS 0xc00079f5 FORMAT "%5.2" /end MEASUREMENT
/begin MEASUREMENT Nelueft_i "Hilfsgrösse Ausgang PID-Regler für D_tmot_tkws" UBYTE _CNV_R_R_Def_f_ub_b_586_CM 1 100. 0. 99.60930000000001 DISPLAY_IDENTIFIER NELUEFT_I ECU_ADDRESS 0xc00079f6 FORMAT "%5.2" /end MEASUREMENT
/begin MEASUREMENT Nelueft_khl1 "Hilfsgrösse Ausgang K_EL_KHL1" UBYTE _CNV_R_R_Def_f_ub_b_586_CM 1 100. 0. 99.60930000000001 DISPLAY_IDENTIFIER NELUEFT_KHL1 ECU_ADDRESS 0xc00079f7 FORMAT "%5.2" /end MEASUREMENT
/begin MEASUREMENT Nelueft_llk "Anforderung Elüfter für Ladeluftkühlung" UBYTE _CNV_R_R_Def_f_ub_b_586_CM 1 100. 0. 99.60930000000001 DISPLAY_IDENTIFIER NELUEFT_LLK ECU_ADDRESS 0xc00079ae FORMAT "%5.2" /end MEASUREMENT
/begin MEASUREMENT Nelueft_local "E-Lüfter Sollwert aus Berechnung 1 und 2" UBYTE _CNV_R_R_Def_f_ub_b_586_CM 1 100. 0. 99.60930000000001 DISPLAY_IDENTIFIER NELUEFT_LOCAL ECU_ADDRESS 0xc00079f8 FORMAT "%5.2" /end MEASUREMENT
/begin MEASUREMENT Nelueft_no "Tkwsoll für BA-Normal" UBYTE _CNV_R_R_Def_f_ub_b_586_CM 1 100. 0. 99.60930000000001 DISPLAY_IDENTIFIER NELUEFT_NO ECU_ADDRESS 0xc00079f9 FORMAT "%5.2" /end MEASUREMENT
/begin MEASUREMENT Nelueft_pwm "E-Lüfter PWM Sollwert" UBYTE _CNV_R_R_Def_f_ub_b_586_CM 1 100. 0. 99.60930000000001 DISPLAY_IDENTIFIER NELUEFT_PWM ECU_ADDRESS 0xc00079fa FORMAT "%5.2" /end MEASUREMENT
/begin MEASUREMENT Nelueft_tget "Hilftsgrösse Ausgang KL_EL_TGET" UBYTE _CNV_R_R_Def_f_ub_b_586_CM 1 100. 0. 99.60930000000001 DISPLAY_IDENTIFIER NELUEFT_TGET ECU_ADDRESS 0xc00079fb FORMAT "%5.2" /end MEASUREMENT
/begin MEASUREMENT Nelueft_tka "Hilfsgrösse Ausgang KL_EL_TKA" UBYTE _CNV_R_R_Def_f_ub_b_586_CM 1 100. 0. 99.60930000000001 DISPLAY_IDENTIFIER NELUEFT_TKA ECU_ADDRESS 0xc00079fc FORMAT "%5.2" /end MEASUREMENT
/begin MEASUREMENT Nelueft_tmot "Hilfsgrösse Ausgang KL_EL_TMOT" UBYTE _CNV_R_R_Def_f_ub_b_586_CM 1 100. 0. 99.60930000000001 DISPLAY_IDENTIFIER NELUEFT_TMOT ECU_ADDRESS 0xc00079fd FORMAT "%5.2" /end MEASUREMENT
/begin MEASUREMENT Nelueft_twr1 "Hilftsgrösse Ausgang KL_EL_TWR1" UBYTE _CNV_R_R_Def_f_ub_b_586_CM 1 100. 0. 99.60930000000001 DISPLAY_IDENTIFIER NELUEFT_TWR1 ECU_ADDRESS 0xc00079fe FORMAT "%5.2" /end MEASUREMENT
/begin MEASUREMENT Nelueft_wa "E-Lüfter Ansteuerung in BA Warmlauf" UBYTE _CNV_R_R_Def_f_ub_b_586_CM 1 100. 0. 99.60930000000001 DISPLAY_IDENTIFIER NELUEFT_WA ECU_ADDRESS 0xc00079ff FORMAT "%5.2" /end MEASUREMENT
/begin MEASUREMENT Nelueft_wa_h "Hilfsgrösse e-Lüfter im Warmlauf" UBYTE _CNV_R_R_Def_f_ub_b_586_CM 1 100. 0. 99.60930000000001 DISPLAY_IDENTIFIER NELUEFT_WA_H ECU_ADDRESS 0xc0007a00 FORMAT "%5.2" /end MEASUREMENT
/begin MEASUREMENT Nelueft_wm "Solldrehzahl E-Lüfter Vorgabe WM" UBYTE _CNV_R_R_Def_f_ub_b_586_CM 1 100. 0. 99.60930000000001 DISPLAY_IDENTIFIER NELUEFT_WM ECU_ADDRESS 0xc00079af FORMAT "%5.2" /end MEASUREMENT
/begin MEASUREMENT Newp_2_soll "Solldrehzahl elektrische Wasserpumpe 2" UBYTE _CNV_R_R_Def_dez_sl_551_CM 1 100. 0. 255. DISPLAY_IDENTIFIER NEWP_2_SOLL ECU_ADDRESS 0xc0007a12 FORMAT "%3.0" /end MEASUREMENT
/begin MEASUREMENT Newp_soll "Solldrehzahl für BSD-Schnitstelle" UBYTE _CNV_R_R_Def_dez_sl_551_CM 1 100. 0. 255. DISPLAY_IDENTIFIER NEWP_SOLL ECU_ADDRESS 0xc00079b0 FORMAT "%3.0" /end MEASUREMENT
/begin MEASUREMENT Pi_kuehl_mx_h "Hilfsgrösse zur Leistungsreduzierung durch WMK" UWORD _CNV_R_R_Def_f_uw_b_679_CM 1 100. 0. 2047.9687 DISPLAY_IDENTIFIER PI_KUEHL_MX_H ECU_ADDRESS 0xc00079c8 FORMAT "%7.2" /end MEASUREMENT
/begin MEASUREMENT Qs_anf "Wärmestromanforderung von IHKA " UBYTE _CNV_R_R_Def_f_ub_b_586_CM 1 100. 0. 99.60930000000001 DISPLAY_IDENTIFIER QS_ANF ECU_ADDRESS 0xc0007a01 FORMAT "%5.2" /end MEASUREMENT
/begin MEASUREMENT Qs_anf_sw "Qs_anf_klima in l/h" UWORD _CNV_R_R_Def_vs_uw__686_CM 1 100. 0. 9999.847400000001 DISPLAY_IDENTIFIER QS_ANF_SW ECU_ADDRESS 0xc00079ca FORMAT "%7.2" /end MEASUREMENT
/begin MEASUREMENT Rf_sol_old "alte rel. Sollfüllung" SWORD _CNV_R_R_Def_rf_sw__598_CM 1 100. -327.68 327.67 DISPLAY_IDENTIFIER RF_SOL_OLD ECU_ADDRESS 0xd000d00c FORMAT "%9.4" /end MEASUREMENT
/begin MEASUREMENT Rf_solkrv "verz. rel. Sollfüllung für KR" SWORD _CNV_R_R_Def_rf_sw__598_CM 1 100. -327.68 327.67 DISPLAY_IDENTIFIER RF_SOLKRV ECU_ADDRESS 0xd000d006 FORMAT "%9.4" /end MEASUREMENT
/begin MEASUREMENT Rf_solkrv_hold "gehaltener Wert  rel. Sollfüllung für KR" SWORD _CNV_R_R_Def_rf_sw__598_CM 1 100. -327.68 327.67 DISPLAY_IDENTIFIER RF_SOLKRV_HOLD ECU_ADDRESS 0xd000d012 FORMAT "%9.4" /end MEASUREMENT
/begin MEASUREMENT Rf_solkrv_old "alte verz. rel. Sollfüllung für KR" SWORD _CNV_R_R_Def_rf_sw__598_CM 1 100. -327.68 327.67 DISPLAY_IDENTIFIER RF_SOLKRV_OLD ECU_ADDRESS 0xd000d00e FORMAT "%9.4" /end MEASUREMENT
/begin MEASUREMENT Rf_solkrvf "gef. verz. rel. Sollfüllung für KR" SWORD _CNV_R_R_Def_rf_sw__598_CM 1 100. -327.68 327.67 DISPLAY_IDENTIFIER RF_SOLKRVF ECU_ADDRESS 0xd000cfc8 FORMAT "%9.4" /end MEASUREMENT
/begin MEASUREMENT Rf_solkrvf_old "gef. verz. rel. Sollfüllung für KR" SWORD _CNV_R_R_Def_rf_sw__598_CM 1 100. -327.68 327.67 DISPLAY_IDENTIFIER RF_SOLKRVF_OLD ECU_ADDRESS 0xd000d010 FORMAT "%9.4" /end MEASUREMENT
/begin MEASUREMENT Rf_solkrvfgd "gef. verz. rel. Sollfüllung gedrosselt für KR" SWORD _CNV_R_R_Def_rf_sw__598_CM 1 100. -327.68 327.67 DISPLAY_IDENTIFIER RF_SOLKRVFGD ECU_ADDRESS 0xd000cfca FORMAT "%9.4" /end MEASUREMENT
/begin MEASUREMENT Rf_solkrvgd "verz. rel. Sollfüllung gedrosselt für KR" SWORD _CNV_R_R_Def_rf_sw__598_CM 1 100. -327.68 327.67 DISPLAY_IDENTIFIER RF_SOLKRVGD ECU_ADDRESS 0xd000d008 FORMAT "%9.4" /end MEASUREMENT
/begin MEASUREMENT Rf_solkrvof "verz. rel. Sollfüllung für KR ungefiltert" SWORD _CNV_R_R_Def_rf_sw__598_CM 1 100. -327.68 327.67 DISPLAY_IDENTIFIER RF_SOLKRVOF ECU_ADDRESS 0xd000d00a FORMAT "%9.4" /end MEASUREMENT
/begin MEASUREMENT Rf_zwv "rel. Füllung verzögert für Zündwindelberechnung" SWORD _CNV_R_R_Def_rf_sw__598_CM 1 100. -327.68 327.67 DISPLAY_IDENTIFIER RF_ZWV ECU_ADDRESS 0xd000cfc4 FORMAT "%9.4" /end MEASUREMENT
/begin MEASUREMENT Rfkr "rel. Füllung für KR" SWORD _CNV_R_R_Def_rf_sw__598_CM 1 100. -327.68 327.67 DISPLAY_IDENTIFIER RFKR ECU_ADDRESS 0xd000cfc6 FORMAT "%9.4" /end MEASUREMENT
/begin MEASUREMENT St_wm1 "Statuswort" UBYTE _CNV_R_R_Def_dez_sl_551_CM 1 100. 0. 255. DISPLAY_IDENTIFIER ST_WM1 ECU_ADDRESS 0xd000cf8c FORMAT "%3.0" /end MEASUREMENT
/begin MEASUREMENT St_wm1.B_lklps "Bedingung obere Luftklappen auf (wenn verbaut!)" UBYTE _CNV_S_2_Def_bit_ub_563_CM 1 100. 0. 1. DISPLAY_IDENTIFIER B_LKLPS ECU_ADDRESS 0xd000cf8c BIT_MASK 0x2 /end MEASUREMENT
/begin MEASUREMENT St_wm1.B_lklps1 "Bedingung untere Luftklappe1 auf (wenn verbaut!)" UBYTE _CNV_S_2_Def_bit_ub_563_CM 1 100. 0. 1. DISPLAY_IDENTIFIER B_LKLPS1 ECU_ADDRESS 0xd000cf8c BIT_MASK 0x40 /end MEASUREMENT
/begin MEASUREMENT St_wm1.B_ntlkws "Bedingung Notlauf Kühlkreislauf" UBYTE _CNV_S_2_Def_bit_ub_563_CM 1 100. 0. 1. DISPLAY_IDENTIFIER B_NTLKWS ECU_ADDRESS 0xd000cf8c BIT_MASK 0x4 /end MEASUREMENT
/begin MEASUREMENT St_wm1.B_tmmi_warn1 "Bedingung Wanrlampe (gelb) Stufe1 an MMI" UBYTE _CNV_S_2_Def_bit_ub_563_CM 1 100. 0. 1. DISPLAY_IDENTIFIER B_TMMI_WARN1 ECU_ADDRESS 0xd000cf8c BIT_MASK 0x8 /end MEASUREMENT
/begin MEASUREMENT St_wm1.B_tmmi_warn2 "Bedingung Warnlampe (rot) Stufe 2 an MMI" UBYTE _CNV_S_2_Def_bit_ub_563_CM 1 100. 0. 1. DISPLAY_IDENTIFIER B_TMMI_WARN2 ECU_ADDRESS 0xd000cf8c BIT_MASK 0x10 /end MEASUREMENT
/begin MEASUREMENT St_wm1.B_tmmi_warn3 "Bedingung Hochschalten" UBYTE _CNV_S_2_Def_bit_ub_563_CM 1 100. 0. 1. DISPLAY_IDENTIFIER B_TMMI_WARN3 ECU_ADDRESS 0xd000cf8c BIT_MASK 0x20 /end MEASUREMENT
/begin MEASUREMENT St_wm_nl0 "Statuswort" UBYTE _CNV_R_R_Def_dez_sl_551_CM 1 100. 0. 255. DISPLAY_IDENTIFIER ST_WM_NL0 ECU_ADDRESS 0xc0000740 FORMAT "%3.0" /end MEASUREMENT
/begin MEASUREMENT St_wm_nl0.B_nlewp_b1 "Bedingung für EWAPU Nachlauf bei Tmot > 112°C" UBYTE _CNV_S_2_Def_bit_ub_563_CM 1 100. 0. 1. DISPLAY_IDENTIFIER B_NLEWP_B1 ECU_ADDRESS 0xc0000740 BIT_MASK 0x1 /end MEASUREMENT
/begin MEASUREMENT St_wm_nl0.B_nlewp_b2 "Bedingung für EWAPU Nachlauf bei 106°C >=Tmot <= 112°C" UBYTE _CNV_S_2_Def_bit_ub_563_CM 1 100. 0. 1. DISPLAY_IDENTIFIER B_NLEWP_B2 ECU_ADDRESS 0xc0000740 BIT_MASK 0x2 /end MEASUREMENT
/begin MEASUREMENT St_wm_nl0.B_nlewp_b3 "Bedingung für EWAPU-Sollwert = 0 (abhängig von Tmot)" UBYTE _CNV_S_2_Def_bit_ub_563_CM 1 100. 0. 1. DISPLAY_IDENTIFIER B_NLEWP_B3 ECU_ADDRESS 0xc0000740 BIT_MASK 0x4 /end MEASUREMENT
/begin MEASUREMENT St_wm_nl0.B_nlewp_b4 "Bedingung für EWAPU-Sollwert Rücksetzen (kein Nachlauf)" UBYTE _CNV_S_2_Def_bit_ub_563_CM 1 100. 0. 1. DISPLAY_IDENTIFIER B_NLEWP_B4 ECU_ADDRESS 0xc0000740 BIT_MASK 0x8 /end MEASUREMENT
/begin MEASUREMENT St_wm_nl0.B_nlqs1 "Bedingung für EWAPU-Restwärme kurz" UBYTE _CNV_S_2_Def_bit_ub_563_CM 1 100. 0. 1. DISPLAY_IDENTIFIER B_NLQS1 ECU_ADDRESS 0xc0000740 BIT_MASK 0x10 /end MEASUREMENT
/begin MEASUREMENT St_wm_nl0.B_nlqs2 "Bedingung für EWAPU-Restwärme abgelaufen (Rücksetzen)" UBYTE _CNV_S_2_Def_bit_ub_563_CM 1 100. 0. 1. DISPLAY_IDENTIFIER B_NLQS2 ECU_ADDRESS 0xc0000740 BIT_MASK 0x20 /end MEASUREMENT
/begin MEASUREMENT St_wm_nl0.B_nlqs3 "Bedingung für EWAPU-Restwärme lang" UBYTE _CNV_S_2_Def_bit_ub_563_CM 1 100. 0. 1. DISPLAY_IDENTIFIER B_NLQS3 ECU_ADDRESS 0xc0000740 BIT_MASK 0x40 /end MEASUREMENT
/begin MEASUREMENT St_wm_nl0.B_nlqs4 "Bedingung Qs_anf_klima gesetzt" UBYTE _CNV_S_2_Def_bit_ub_563_CM 1 100. 0. 1. DISPLAY_IDENTIFIER B_NLQS4 ECU_ADDRESS 0xc0000740 BIT_MASK 0x80 /end MEASUREMENT
/begin MEASUREMENT St_wm_nl1 "Statuswort" UBYTE _CNV_R_R_Def_dez_sl_551_CM 1 100. 0. 255. DISPLAY_IDENTIFIER ST_WM_NL1 ECU_ADDRESS 0xc0000741 FORMAT "%3.0" /end MEASUREMENT
/begin MEASUREMENT St_wm_nl1.B_nlqs5 "Rücksetzen EWAPU bei Qs_anf_klima=0" UBYTE _CNV_S_2_Def_bit_ub_563_CM 1 100. 0. 1. DISPLAY_IDENTIFIER B_NLQS5 ECU_ADDRESS 0xc0000741 BIT_MASK 0x1 /end MEASUREMENT
/begin MEASUREMENT St_wmschalt0 "Statuswort" UBYTE _CNV_R_R_Def_dez_sl_551_CM 1 100. 0. 255. DISPLAY_IDENTIFIER ST_WMSCHALT0 ECU_ADDRESS 0xd000cf8d FORMAT "%3.0" /end MEASUREMENT
/begin MEASUREMENT St_wmschalt0.B_beende "Bedingung Befüllenende erreicht" UBYTE _CNV_S_2_Def_bit_ub_563_CM 1 100. 0. 1. DISPLAY_IDENTIFIER B_BEENDE ECU_ADDRESS 0xd000cf8d BIT_MASK 0x20 /end MEASUREMENT
/begin MEASUREMENT St_wmschalt0.B_hz_wm "Anforderung Heizleistung aus Wärmemanagementkoordinator" UBYTE _CNV_S_2_Def_bit_ub_563_CM 1 100. 0. 1. DISPLAY_IDENTIFIER B_HZ_WM ECU_ADDRESS 0xd000cf8d BIT_MASK 0x1 /end MEASUREMENT
/begin MEASUREMENT St_wmschalt0.B_ntlkws_v "Bedingung Freischaltung über Geschwindigkeit " UBYTE _CNV_S_2_Def_bit_ub_563_CM 1 100. 0. 1. DISPLAY_IDENTIFIER B_NTLKWS_V ECU_ADDRESS 0xd000cf8d BIT_MASK 0x40 /end MEASUREMENT
/begin MEASUREMENT St_zwaus "Statuswort ZWAUS" UBYTE _CNV_R_R_Def_dez_sl_551_CM 1 100. 0. 255. DISPLAY_IDENTIFIER ST_ZWAUS ECU_ADDRESS 0xd000d0d2 FORMAT "%3.0" /end MEASUREMENT
/begin MEASUREMENT St_zwaus.B_zwmin_hs "Bedingung ZW-Spätgrenze durch KR unterschritten (homogen-schicht)" UBYTE _CNV_S_2_Def_bit_ub_563_CM 1 100. 0. 1. DISPLAY_IDENTIFIER B_ZWMIN_HS ECU_ADDRESS 0xd000d0d2 BIT_MASK 0x1 /end MEASUREMENT
/begin MEASUREMENT St_zwgrund "Statuswort ZWGRUND" UBYTE _CNV_R_R_Def_dez_sl_551_CM 1 100. 0. 255. DISPLAY_IDENTIFIER ST_ZWGRUND ECU_ADDRESS 0xd000cfc1 FORMAT "%3.0" /end MEASUREMENT
/begin MEASUREMENT St_zwgrund.B_zwdyn "Bedingung Grundzündwinkeldynamik" UBYTE _CNV_S_2_Def_bit_ub_563_CM 1 100. 0. 1. DISPLAY_IDENTIFIER B_ZWDYN ECU_ADDRESS 0xd000cfc1 BIT_MASK 0x1 /end MEASUREMENT
/begin MEASUREMENT St_zwgrund.B_zwdynn "Bedingung Grundzündwinkeldynamik negative Richtung" UBYTE _CNV_S_2_Def_bit_ub_563_CM 1 100. 0. 1. DISPLAY_IDENTIFIER B_ZWDYNN ECU_ADDRESS 0xd000cfc1 BIT_MASK 0x2 /end MEASUREMENT
/begin MEASUREMENT St_zwgrund1 "Statuswort ZWGRUND 1" UBYTE _CNV_R_R_Def_dez_sl_551_CM 1 100. 0. 255. DISPLAY_IDENTIFIER ST_ZWGRUND1 ECU_ADDRESS 0xd000cfd4 FORMAT "%3.0" /end MEASUREMENT
/begin MEASUREMENT St_zwgrund1.B_rfsola "Bedingung alt. Zeitkonstante für Rf_soll-Filter" UBYTE _CNV_S_2_Def_bit_ub_563_CM 1 100. 0. 1. DISPLAY_IDENTIFIER B_RFSOLA ECU_ADDRESS 0xd000cfd4 BIT_MASK 0x4 /end MEASUREMENT
/begin MEASUREMENT St_zwgrund1.B_trigin "Bedingung Triggereingang Grundzündwinkeldynamik" UBYTE _CNV_S_2_Def_bit_ub_563_CM 1 100. 0. 1. DISPLAY_IDENTIFIER B_TRIGIN ECU_ADDRESS 0xd000cfd4 BIT_MASK 0x8 /end MEASUREMENT
/begin MEASUREMENT St_zwgrund1.B_trigout "Bedingung Triggerausgang Grundzündwinkeldynamik" UBYTE _CNV_S_2_Def_bit_ub_563_CM 1 100. 0. 1. DISPLAY_IDENTIFIER B_TRIGOUT ECU_ADDRESS 0xd000cfd4 BIT_MASK 0x10 /end MEASUREMENT
/begin MEASUREMENT St_zwgrund1.B_zwdynakt "Bedingung Haltezeit Dynamikkorrektur" UBYTE _CNV_S_2_Def_bit_ub_563_CM 1 100. 0. 1. DISPLAY_IDENTIFIER B_ZWDYNAKT ECU_ADDRESS 0xd000cfd4 BIT_MASK 0x40 /end MEASUREMENT
/begin MEASUREMENT St_zwgrund1.B_zwdynvz "Bedingung Verzögerung Dynamikkorrektur" UBYTE _CNV_S_2_Def_bit_ub_563_CM 1 100. 0. 1. DISPLAY_IDENTIFIER B_ZWDYNVZ ECU_ADDRESS 0xd000cfd4 BIT_MASK 0x20 /end MEASUREMENT
/begin MEASUREMENT St_zwgrund1.B_zwfall "Bedingung Grundzündwinkel fällt" UBYTE _CNV_S_2_Def_bit_ub_563_CM 1 100. 0. 1. DISPLAY_IDENTIFIER B_ZWFALL ECU_ADDRESS 0xd000cfd4 BIT_MASK 0x2 /end MEASUREMENT
/begin MEASUREMENT St_zwgrund1.B_zwsteig "Bedingung Grundzündwinkel steigt" UBYTE _CNV_S_2_Def_bit_ub_563_CM 1 100. 0. 1. DISPLAY_IDENTIFIER B_ZWSTEIG ECU_ADDRESS 0xd000cfd4 BIT_MASK 0x1 /end MEASUREMENT
/begin MEASUREMENT St_zwgrund2 "Statuswort ZWGRUND 2" UBYTE _CNV_R_R_Def_dez_sl_551_CM 1 100. 0. 255. DISPLAY_IDENTIFIER ST_ZWGRUND2 ECU_ADDRESS 0xd000cfd5 FORMAT "%3.0" /end MEASUREMENT
/begin MEASUREMENT St_zwgrund2.B_triginn "Bedingung Triggereingang Grundzündwinkeldynamik negative Richtung" UBYTE _CNV_S_2_Def_bit_ub_563_CM 1 100. 0. 1. DISPLAY_IDENTIFIER B_TRIGINN ECU_ADDRESS 0xd000cfd5 BIT_MASK 0x4 /end MEASUREMENT
/begin MEASUREMENT St_zwgrund2.B_trigoutn "Bedingung Triggerausgang Grundzündwinkeldynamik negative Richtung" UBYTE _CNV_S_2_Def_bit_ub_563_CM 1 100. 0. 1. DISPLAY_IDENTIFIER B_TRIGOUTN ECU_ADDRESS 0xd000cfd5 BIT_MASK 0x8 /end MEASUREMENT
/begin MEASUREMENT St_zwgrund2.B_zwdynnakt "Bedingung Haltezeit Dynamikkorrektur negative Richtung" UBYTE _CNV_S_2_Def_bit_ub_563_CM 1 100. 0. 1. DISPLAY_IDENTIFIER B_ZWDYNNAKT ECU_ADDRESS 0xd000cfd5 BIT_MASK 0x2 /end MEASUREMENT
/begin MEASUREMENT St_zwgrund2.B_zwdynnvz "Bedingung Verzögerung Dynamikkorrektur negative Richtung" UBYTE _CNV_S_2_Def_bit_ub_563_CM 1 100. 0. 1. DISPLAY_IDENTIFIER B_ZWDYNNVZ ECU_ADDRESS 0xd000cfd5 BIT_MASK 0x1 /end MEASUREMENT
/begin MEASUREMENT St_zwgrundhs "Statuswort St_zwgrundhs" UBYTE _CNV_R_R_Def_dez_sl_551_CM 1 100. 0. 255. DISPLAY_IDENTIFIER ST_ZWGRUNDHS ECU_ADDRESS 0xd000d004 FORMAT "%3.0" /end MEASUREMENT
/begin MEASUREMENT St_zwgrundhs.B_zwhz "Heizleistungssteigerung über Zündwinkel aktiv" UBYTE _CNV_S_2_Def_bit_ub_563_CM 1 100. 0. 1. DISPLAY_IDENTIFIER B_ZWHZ ECU_ADDRESS 0xd000d004 BIT_MASK 0x1 /end MEASUREMENT
/begin MEASUREMENT St_zwks "Statuswort" UBYTE _CNV_R_R_Def_dez_sl_551_CM 1 100. 0. 255. DISPLAY_IDENTIFIER ST_ZWKS ECU_ADDRESS 0xd000d148 FORMAT "%3.0" /end MEASUREMENT
/begin MEASUREMENT St_zwks.B_zwks_err "Kein Langbezeichner vergeben" UBYTE _CNV_S_2_Def_bit_ub_563_CM 1 100. 0. 1. DISPLAY_IDENTIFIER B_ZWKS_ERR ECU_ADDRESS 0xd000d148 BIT_MASK 0x1 /end MEASUREMENT
/begin MEASUREMENT T_dzwdyn "Zeit zw. 2 Dekrementen zur Verländerung Abregelzeit von Dzwdyn" UBYTE _CNV_R_R_Def_td_uw__673_CM 1 100. 0. 2.55 DISPLAY_IDENTIFIER T_DZWDYN ECU_ADDRESS 0xd000cfc2 FORMAT "%5.2" /end MEASUREMENT
/begin MEASUREMENT Td_dynakt "Haltezeit Dynamikkorrektur" UBYTE _CNV_R_R_Def_td_uw__673_CM 1 100. 0. 2.55 DISPLAY_IDENTIFIER TD_DYNAKT ECU_ADDRESS 0xd000cff1 FORMAT "%5.2" /end MEASUREMENT
/begin MEASUREMENT Td_dyndek "Abregelungszeit Dynamikkorrektur" UBYTE _CNV_R_R_Def_td_uw__673_CM 1 100. 0. 2.55 DISPLAY_IDENTIFIER TD_DYNDEK ECU_ADDRESS 0xd000cff2 FORMAT "%5.2" /end MEASUREMENT
/begin MEASUREMENT Td_dynnakt "Haltezeit Dynamikkorrektur negative Richtung" UBYTE _CNV_R_R_Def_td_uw__673_CM 1 100. 0. 2.55 DISPLAY_IDENTIFIER TD_DYNNAKT ECU_ADDRESS 0xd000cffa FORMAT "%5.2" /end MEASUREMENT
/begin MEASUREMENT Td_dynndek "Abregelungszeit Dynamikkorrektur negative Richtung" UBYTE _CNV_R_R_Def_td_uw__673_CM 1 100. 0. 2.55 DISPLAY_IDENTIFIER TD_DYNNDEK ECU_ADDRESS 0xd000cffb FORMAT "%5.2" /end MEASUREMENT
/begin MEASUREMENT Td_dynnvz "Verzögerungszeit Dynamikkorrektur negative Richtung" UBYTE _CNV_R_R_Def_td_uw__673_CM 1 100. 0. 2.55 DISPLAY_IDENTIFIER TD_DYNNVZ ECU_ADDRESS 0xd000cff9 FORMAT "%5.2" /end MEASUREMENT
/begin MEASUREMENT Td_dynvz "Verzögerungszeit Dynamikkorrektur" UBYTE _CNV_R_R_Def_td_uw__673_CM 1 100. 0. 2.55 DISPLAY_IDENTIFIER TD_DYNVZ ECU_ADDRESS 0xd000cff0 FORMAT "%5.2" /end MEASUREMENT
/begin MEASUREMENT Tddrfsol "Haltezeit B_zwdyn" UBYTE _CNV_R_R_Def_td_uw__673_CM 1 100. 0. 2.55 DISPLAY_IDENTIFIER TDDRFSOL ECU_ADDRESS 0xd000cfee FORMAT "%5.2" /end MEASUREMENT
/begin MEASUREMENT Tddrfsol_dyn "Timerzeit Grundzündwinkeldynamik" UBYTE _CNV_R_R_Def_td_uw__673_CM 1 100. 0. 2.55 DISPLAY_IDENTIFIER TDDRFSOL_DYN ECU_ADDRESS 0xd000cff3 FORMAT "%5.2" /end MEASUREMENT
/begin MEASUREMENT Tddrfsoln "Haltezeit B_zwdynn" UBYTE _CNV_R_R_Def_td_uw__673_CM 1 100. 0. 2.55 DISPLAY_IDENTIFIER TDDRFSOLN ECU_ADDRESS 0xd000cfef FORMAT "%5.2" /end MEASUREMENT
/begin MEASUREMENT Tddrfsoln_dyn "Timerzeit Grundzündwinkeldynamik negative Richtung" UBYTE _CNV_R_R_Def_td_uw__673_CM 1 100. 0. 2.55 DISPLAY_IDENTIFIER TDDRFSOLN_DYN ECU_ADDRESS 0xd000cffc FORMAT "%5.2" /end MEASUREMENT
/begin MEASUREMENT Tget_wm "Getriebetemperaturersatzwert Wärmemanagement" SWORD _CNV_R_R_Def_t_sw_q_579_CM 1 100. -327.68 327.67 DISPLAY_IDENTIFIER TGET_WM ECU_ADDRESS 0xc00079c6 FORMAT "%7.2" /end MEASUREMENT
/begin MEASUREMENT Vs_eco_agsw "gefilterter und faktorisierter Volumenstrom automatik Getriebe Sollwert" UWORD _CNV_R_R_Def_vs_uw__686_CM 1 100. 0. 9999.847400000001 DISPLAY_IDENTIFIER VS_ECO_AGSW ECU_ADDRESS 0xc00079cc FORMAT "%7.2" /end MEASUREMENT
/begin MEASUREMENT Vs_eco_motsw "gefilterter und faktoriesierter Volumenstrommotor Sollwert für eWAPU" UWORD _CNV_R_R_Def_vs_uw__686_CM 1 100. 0. 9999.847400000001 DISPLAY_IDENTIFIER VS_ECO_MOTSW ECU_ADDRESS 0xc00079ce FORMAT "%7.2" /end MEASUREMENT
/begin MEASUREMENT Vs_ewp_bsd "Volumenstrom EWP gesamt" UWORD _CNV_R_R_Def_vs_uw__686_CM 1 100. 0. 9999.847400000001 DISPLAY_IDENTIFIER VS_EWP_BSD ECU_ADDRESS 0xc00079d0 FORMAT "%7.2" /end MEASUREMENT
/begin MEASUREMENT Vs_ewp_warml "Volumenstrom Anforderung eWAPU im Warmlauf" UWORD _CNV_R_R_Def_vs_uw__686_CM 1 100. 0. 9999.847400000001 DISPLAY_IDENTIFIER VS_EWP_WARML ECU_ADDRESS 0xc00079d2 FORMAT "%7.2" /end MEASUREMENT
/begin MEASUREMENT Vs_high_agsw "Volumenstromanforderung eWAPU für Highbetrieb" UWORD _CNV_R_R_Def_vs_uw__686_CM 1 100. 0. 9999.847400000001 DISPLAY_IDENTIFIER VS_HIGH_AGSW ECU_ADDRESS 0xc00079d4 FORMAT "%7.2" /end MEASUREMENT
/begin MEASUREMENT Vs_high_motsw "Volumenstromanforderung eWAPU für Highbetriebsart" UWORD _CNV_R_R_Def_vs_uw__686_CM 1 100. 0. 9999.847400000001 DISPLAY_IDENTIFIER VS_HIGH_MOTSW ECU_ADDRESS 0xc00079d6 FORMAT "%7.2" /end MEASUREMENT
/begin MEASUREMENT Vs_hkft_agsw "Volumenstromanforderung AG für High+Kft Betrieb" UWORD _CNV_R_R_Def_vs_uw__686_CM 1 100. 0. 9999.847400000001 DISPLAY_IDENTIFIER VS_HKFT_AGSW ECU_ADDRESS 0xc00079d8 FORMAT "%7.2" /end MEASUREMENT
/begin MEASUREMENT Vs_hkft_motsw "Volumenstromanforderung Motor für High+Kft Betrieb" UWORD _CNV_R_R_Def_vs_uw__686_CM 1 100. 0. 9999.847400000001 DISPLAY_IDENTIFIER VS_HKFT_MOTSW ECU_ADDRESS 0xc00079da FORMAT "%7.2" /end MEASUREMENT
/begin MEASUREMENT Vs_norm_agsw "Volumenstromanforderung automatik Getriebe für Normalbetrieb" UWORD _CNV_R_R_Def_vs_uw__686_CM 1 100. 0. 9999.847400000001 DISPLAY_IDENTIFIER VS_NORM_AGSW ECU_ADDRESS 0xc00079dc FORMAT "%7.2" /end MEASUREMENT
/begin MEASUREMENT Vs_norm_motsw "Volumenstromanforderung Motor für Normalbetrieb" UWORD _CNV_R_R_Def_vs_uw__686_CM 1 100. 0. 9999.847400000001 DISPLAY_IDENTIFIER VS_NORM_MOTSW ECU_ADDRESS 0xc00079de FORMAT "%7.2" /end MEASUREMENT
/begin MEASUREMENT Vskr_help "Hilfsgrösse Kraftstoffverbrauch" UWORD _CNV_R_R_Def_dez_sl_551_CM 1 100. 0. 65535. DISPLAY_IDENTIFIER VSKR_HELP ECU_ADDRESS 0xc0000742 FORMAT "%5.0" /end MEASUREMENT
/begin MEASUREMENT Vskr_mw_nl "Mittelwert Kraftstoffverbrauch im Nachlauf" UWORD _CNV_R_R_Def_dez_sl_551_CM 1 100. 0. 65535. DISPLAY_IDENTIFIER VSKR_MW_NL ECU_ADDRESS 0xc0000744 FORMAT "%5.0" /end MEASUREMENT
/begin MEASUREMENT Zaehl_beug "Zähler Befüllen/Entlüften" UWORD _CNV_R_R_Def_dez_sl_551_CM 1 100. 0. 65535. DISPLAY_IDENTIFIER ZAEHL_BEUG ECU_ADDRESS 0xc00079e0 FORMAT "%5.0" /end MEASUREMENT
/begin MEASUREMENT Zaehl_w_ugwm "" UWORD _CNV_R_R_Def_dez_sl_551_CM 1 100. 0. 65535. DISPLAY_IDENTIFIER ZAEHL_W_UGWM ECU_ADDRESS 0xc0007a08 FORMAT "%5.0" /end MEASUREMENT
/begin MEASUREMENT Zaehler_qsnl "Zähler im Nachlauf u. Wake-up für Qs_anf_klima" UWORD _CNV_R_R_Def_dez_sl_551_CM 1 100. 0. 65535. DISPLAY_IDENTIFIER ZAEHLER_QSNL ECU_ADDRESS 0xc0007a10 FORMAT "%5.0" /end MEASUREMENT
/begin MEASUREMENT Zaehler_ugwm "" UWORD _CNV_R_R_Def_dez_sl_551_CM 1 100. 0. 65535. DISPLAY_IDENTIFIER ZAEHLER_UGWM ECU_ADDRESS 0xc0007a0a FORMAT "%5.0" /end MEASUREMENT
/begin MEASUREMENT Zw_bas "Basiszündwinkel" SWORD _CNV_R_R_Def_zw_sw__604_CM 1 100. -50. 60. DISPLAY_IDENTIFIER ZW_BAS ECU_ADDRESS 0xd000d118 FORMAT "%6.1" /end MEASUREMENT
/begin MEASUREMENT Zw_bas_hs "Grundzündwinkel (homogen-schicht)" SWORD _CNV_R_R_Def_zw_sw__604_CM 1 100. -50. 60. DISPLAY_IDENTIFIER ZW_BAS_HS ECU_ADDRESS 0xd000d0d6 FORMAT "%6.1" /end MEASUREMENT
/begin MEASUREMENT Zw_bas_s "Grundzündwinkel (schicht)" SWORD _CNV_R_R_Def_zw_sw__604_CM 1 100. -50. 60. DISPLAY_IDENTIFIER ZW_BAS_S ECU_ADDRESS 0xd000d0d4 FORMAT "%6.1" /end MEASUREMENT
/begin MEASUREMENT Zw_grund "Grundzündwinkel" SWORD _CNV_R_R_Def_zw_sw__604_CM 1 100. -50. 60. DISPLAY_IDENTIFIER ZW_GRUND ECU_ADDRESS 0xd000cfcc FORMAT "%6.1" /end MEASUREMENT
/begin MEASUREMENT Zw_grund1 "Grundzündwinkel Bank1 GDI" SWORD _CNV_R_R_Def_zw_sw__604_CM 1 100. -50. 60. DISPLAY_IDENTIFIER ZW_GRUND1 ECU_ADDRESS 0xd000cfce FORMAT "%6.1" /end MEASUREMENT
/begin MEASUREMENT Zw_grund2 "Grundzündwinkel Bank2 GDI" SWORD _CNV_R_R_Def_zw_sw__604_CM 1 100. -50. 60. DISPLAY_IDENTIFIER ZW_GRUND2 ECU_ADDRESS 0xd000cfd0 FORMAT "%6.1" /end MEASUREMENT
/begin MEASUREMENT Zw_grund_nks "Kein Langbezeichner vergeben" SWORD _CNV_R_R_Def_zw_sw__604_CM 1 100. -3276.8 3276.7 DISPLAY_IDENTIFIER ZW_GRUND_NKS ECU_ADDRESS 0xd000d14a FORMAT "%6.1" /end MEASUREMENT
/begin MEASUREMENT Zw_grund_vk "Grundzündwinkel vor Korrektur" SBYTE _CNV_R_R_Def_zw_sb__605_CM 1 100. -64. 63.5 DISPLAY_IDENTIFIER ZW_GRUND_VK ECU_ADDRESS 0xd000cfe3 FORMAT "%4.1" /end MEASUREMENT
/begin MEASUREMENT Zw_ist "Ist-Zündwinkel" SWORD _CNV_R_R_Def_zw_sw__604_CM 1 100. -50. 60. DISPLAY_IDENTIFIER ZW_IST ECU_ADDRESS 0xd000d11a FORMAT "%6.1" /end MEASUREMENT
/begin MEASUREMENT Zw_kor_hs "korrigierter Grundzündwinkel (homogen-schicht)" SWORD _CNV_R_R_Def_zw_sw__604_CM 1 100. -50. 60. DISPLAY_IDENTIFIER ZW_KOR_HS ECU_ADDRESS 0xd000d08a FORMAT "%6.1" /end MEASUREMENT
/begin MEASUREMENT Zw_kor_s "korrigierter Grundzündwinkel (schicht)" SWORD _CNV_R_R_Def_zw_sw__604_CM 1 100. -50. 60. DISPLAY_IDENTIFIER ZW_KOR_S ECU_ADDRESS 0xd000d088 FORMAT "%6.1" /end MEASUREMENT
/begin MEASUREMENT Zw_korkr_hs "korrigierter Grundzündwinkel nach Klopfkorrektur (homogen-schicht)" SWORD _CNV_R_R_Def_zw_sw__604_CM 1 100. -50. 60. DISPLAY_IDENTIFIER ZW_KORKR_HS ECU_ADDRESS 0xd000d0c0 FORMAT "%6.1" ARRAY_SIZE 8 MATRIX_DIM 8 1 1 /end MEASUREMENT
/begin MEASUREMENT Zw_korkr_hs_min "Minimalwert aus Array Zw_korkr_hs" SWORD _CNV_R_R_Def_zw_sw__604_CM 1 100. -50. 60. DISPLAY_IDENTIFIER ZW_KORKR_HS_MIN ECU_ADDRESS 0xd000d0ea FORMAT "%6.1" /end MEASUREMENT
/begin MEASUREMENT Zw_ks "Kein Langbezeichner vergeben" SWORD _CNV_R_R_Def_zw_sw__604_CM 1 100. -3276.8 3276.7 DISPLAY_IDENTIFIER ZW_KS ECU_ADDRESS 0xd000d14c FORMAT "%6.1" /end MEASUREMENT
/begin MEASUREMENT Zw_min "" SWORD _CNV_R_R_Def_zw_sw__604_CM 1 100. -3276.8 3276.7 DISPLAY_IDENTIFIER ZW_MIN ECU_ADDRESS 0xd000d0f4 FORMAT "%6.1" /end MEASUREMENT
/begin MEASUREMENT Zw_min_hs "minimal möglicher Zündwinkel (homogen-schicht)" SWORD _CNV_R_R_Def_zw_sw__604_CM 1 100. -50. 60. DISPLAY_IDENTIFIER ZW_MIN_HS ECU_ADDRESS 0xd000d0da FORMAT "%6.1" /end MEASUREMENT
/begin MEASUREMENT Zw_opt "Optimaler Zündwinkel" SWORD _CNV_R_R_Def_zw_sw__604_CM 1 100. -50. 60. DISPLAY_IDENTIFIER ZW_OPT ECU_ADDRESS 0xd000cf90 FORMAT "%6.1" /end MEASUREMENT
/begin MEASUREMENT Zw_opt1 "Optimaler Zündwinkel Bank 1" SWORD _CNV_R_R_Def_zw_sw__604_CM 1 100. -50. 60. DISPLAY_IDENTIFIER ZW_OPT1 ECU_ADDRESS 0xd000cf96 FORMAT "%6.1" /end MEASUREMENT
/begin MEASUREMENT Zw_opt2 "Optimaler Zündwinkel Bank 2" SWORD _CNV_R_R_Def_zw_sw__604_CM 1 100. -50. 60. DISPLAY_IDENTIFIER ZW_OPT2 ECU_ADDRESS 0xd000cf98 FORMAT "%6.1" /end MEASUREMENT
/begin MEASUREMENT Zw_opt_hs "optimaler Zündwinkel (homogen-schicht)" SWORD _CNV_R_R_Def_zw_sw__604_CM 1 100. -50. 60. DISPLAY_IDENTIFIER ZW_OPT_HS ECU_ADDRESS 0xd000d0dc FORMAT "%6.1" /end MEASUREMENT
/begin MEASUREMENT Zw_opt_kh "Optimaler Zündwinkel Katheizen" SBYTE _CNV_R_R_Def_zw_sb__605_CM 1 100. -64. 63.5 DISPLAY_IDENTIFIER ZW_OPT_KH ECU_ADDRESS 0xd000cfa7 FORMAT "%4.1" /end MEASUREMENT
/begin MEASUREMENT Zw_opt_kh1 "Optimaler Zündwinkel Katheizen Bank 1" SBYTE _CNV_R_R_Def_zw_sb__605_CM 1 100. -64. 63.5 DISPLAY_IDENTIFIER ZW_OPT_KH1 ECU_ADDRESS 0xd000cfa8 FORMAT "%4.1" /end MEASUREMENT
/begin MEASUREMENT Zw_opt_kh2 "Optimaler Zündwinkel Katheizen Bank 2" SBYTE _CNV_R_R_Def_zw_sb__605_CM 1 100. -64. 63.5 DISPLAY_IDENTIFIER ZW_OPT_KH2 ECU_ADDRESS 0xd000cfa9 FORMAT "%4.1" /end MEASUREMENT
/begin MEASUREMENT Zw_opt_khgd "Optimaler Zündwinkel Katheizen GD-Pfad" SBYTE _CNV_R_R_Def_zw_sb__605_CM 1 100. -64. 63.5 DISPLAY_IDENTIFIER ZW_OPT_KHGD ECU_ADDRESS 0xd000cfac FORMAT "%4.1" /end MEASUREMENT
/begin MEASUREMENT Zw_opt_khkgd "Optimaler Zündwinkel bei Katheizen kalte Teillast GD-Pfad" SBYTE _CNV_R_R_Def_zw_sb__605_CM 1 100. -64. 63.5 DISPLAY_IDENTIFIER ZW_OPT_KHKGD ECU_ADDRESS 0xd000cfb6 FORMAT "%4.1" /end MEASUREMENT
/begin MEASUREMENT Zw_opt_khkllgd "Optimaler Zündwinkel bei Katheizen kalter Leerlauf GD-Pfad" SBYTE _CNV_R_R_Def_zw_sb__605_CM 1 100. -64. 63.5 DISPLAY_IDENTIFIER ZW_OPT_KHKLLGD ECU_ADDRESS 0xd000cfb4 FORMAT "%4.1" /end MEASUREMENT
/begin MEASUREMENT Zw_opt_khkllvt "Optimaler Zündwinkel bei Katheizen kalter Leerlauf VT-Pfad" SBYTE _CNV_R_R_Def_zw_sb__605_CM 1 100. -64. 63.5 DISPLAY_IDENTIFIER ZW_OPT_KHKLLVT ECU_ADDRESS 0xd000cfb0 FORMAT "%4.1" /end MEASUREMENT
/begin MEASUREMENT Zw_opt_khkvt "Optimaler Zündwinkel bei Katheizen kalte Teillast VT-Pfad" SBYTE _CNV_R_R_Def_zw_sb__605_CM 1 100. -64. 63.5 DISPLAY_IDENTIFIER ZW_OPT_KHKVT ECU_ADDRESS 0xd000cfb2 FORMAT "%4.1" /end MEASUREMENT
/begin MEASUREMENT Zw_opt_khvk "Optimaler Zündwinkel Katheizen vor Korrekturen" SBYTE _CNV_R_R_Def_zw_sb__605_CM 1 100. -64. 63.5 DISPLAY_IDENTIFIER ZW_OPT_KHVK ECU_ADDRESS 0xd000cfaa FORMAT "%4.1" /end MEASUREMENT
/begin MEASUREMENT Zw_opt_khvt "Optimaler Zündwinkel Katheizen VT-Pfad" SBYTE _CNV_R_R_Def_zw_sb__605_CM 1 100. -64. 63.5 DISPLAY_IDENTIFIER ZW_OPT_KHVT ECU_ADDRESS 0xd000cfab FORMAT "%4.1" /end MEASUREMENT
/begin MEASUREMENT Zw_opt_khwgd "Optimaler Zündwinkel bei Katheizen warme Teillast GD-Pfad" SBYTE _CNV_R_R_Def_zw_sb__605_CM 1 100. -64. 63.5 DISPLAY_IDENTIFIER ZW_OPT_KHWGD ECU_ADDRESS 0xd000cfb7 FORMAT "%4.1" /end MEASUREMENT
/begin MEASUREMENT Zw_opt_khwllgd "Optimaler Zündwinkel bei Katheizen warmer Leerlauf GD-Pfad" SBYTE _CNV_R_R_Def_zw_sb__605_CM 1 100. -64. 63.5 DISPLAY_IDENTIFIER ZW_OPT_KHWLLGD ECU_ADDRESS 0xd000cfb5 FORMAT "%4.1" /end MEASUREMENT
/begin MEASUREMENT Zw_opt_khwllvt "Optimaler Zündwinkel bei Katheizen warmer Leerlauf VT-Pfad" SBYTE _CNV_R_R_Def_zw_sb__605_CM 1 100. -64. 63.5 DISPLAY_IDENTIFIER ZW_OPT_KHWLLVT ECU_ADDRESS 0xd000cfb1 FORMAT "%4.1" /end MEASUREMENT
/begin MEASUREMENT Zw_opt_khwvt "Optimaler Zündwinkel bei Katheizen warme Teillast VT-Pfad" SBYTE _CNV_R_R_Def_zw_sb__605_CM 1 100. -64. 63.5 DISPLAY_IDENTIFIER ZW_OPT_KHWVT ECU_ADDRESS 0xd000cfb3 FORMAT "%4.1" /end MEASUREMENT
/begin MEASUREMENT Zw_opt_n "Optimaler Zündwinkel nach Lambakorrektur" SBYTE _CNV_R_R_Def_zw_sb__605_CM 1 100. -64. 63.5 DISPLAY_IDENTIFIER ZW_OPT_N ECU_ADDRESS 0xd000cfad FORMAT "%4.1" /end MEASUREMENT
/begin MEASUREMENT Zw_opt_n1 "Optimaler Zündwinkel nach Lambakorrektur Bank 1" SBYTE _CNV_R_R_Def_zw_sb__605_CM 1 100. -64. 63.5 DISPLAY_IDENTIFIER ZW_OPT_N1 ECU_ADDRESS 0xd000cfae FORMAT "%4.1" /end MEASUREMENT
/begin MEASUREMENT Zw_opt_n2 "Optimaler Zündwinkel nach Lambakorrektur Bank 2" SBYTE _CNV_R_R_Def_zw_sb__605_CM 1 100. -64. 63.5 DISPLAY_IDENTIFIER ZW_OPT_N2 ECU_ADDRESS 0xd000cfaf FORMAT "%4.1" /end MEASUREMENT
/begin MEASUREMENT Zw_opt_nvk "Optimaler Zündwinkel vor Korrekturen" SBYTE _CNV_R_R_Def_zw_sb__605_CM 1 100. -64. 63.5 DISPLAY_IDENTIFIER ZW_OPT_NVK ECU_ADDRESS 0xd000cf9a FORMAT "%4.1" /end MEASUREMENT
/begin MEASUREMENT Zw_opt_nvkgd "Optimaler Zündwinkel vor Korrektur GD-Pfad" SBYTE _CNV_R_R_Def_zw_sb__605_CM 1 100. -64. 63.5 DISPLAY_IDENTIFIER ZW_OPT_NVKGD ECU_ADDRESS 0xd000cfa6 FORMAT "%4.1" /end MEASUREMENT
/begin MEASUREMENT Zw_opt_nvkvt "Optimaler Zündwinkel  vor Korrektur VT-Pfad" SBYTE _CNV_R_R_Def_zw_sb__605_CM 1 100. -64. 63.5 DISPLAY_IDENTIFIER ZW_OPT_NVKVT ECU_ADDRESS 0xd000cfa5 FORMAT "%4.1" /end MEASUREMENT
/begin MEASUREMENT Zw_opt_vtk "Optimaler Zündwinkel vor Temperaturkorrektur" SBYTE _CNV_R_R_Def_zw_sb__605_CM 1 100. -64. 63.5 DISPLAY_IDENTIFIER ZW_OPT_VTK ECU_ADDRESS 0xd000cfa2 FORMAT "%4.1" /end MEASUREMENT
/begin MEASUREMENT Zw_opt_vtk1 "Optimaler Zündwinkel Bank2 vor Temperaturkorrektur" SBYTE _CNV_R_R_Def_zw_sb__605_CM 1 100. -64. 63.5 DISPLAY_IDENTIFIER ZW_OPT_VTK1 ECU_ADDRESS 0xd000cf9d FORMAT "%4.1" /end MEASUREMENT
/begin MEASUREMENT Zw_opt_vtk2 "Optimaler Zündwinkel Bank1 vor Temperaturkorrektur" SBYTE _CNV_R_R_Def_zw_sb__605_CM 1 100. -64. 63.5 DISPLAY_IDENTIFIER ZW_OPT_VTK2 ECU_ADDRESS 0xd000cf9c FORMAT "%4.1" /end MEASUREMENT
/begin MEASUREMENT Zw_opt_vtn "Optimaler Zündwinkel VT-Pfad" SBYTE _CNV_R_R_Def_zw_sb__605_CM 1 100. -64. 63.5 DISPLAY_IDENTIFIER ZW_OPT_VTN ECU_ADDRESS 0xd000cfa4 FORMAT "%4.1" /end MEASUREMENT
/begin MEASUREMENT Zw_opt_vtuesp "Optimaler Zündwinkel Ueberspuelen VT-Pfad" SBYTE _CNV_R_R_Def_zw_sb__605_CM 1 100. -64. 63.5 DISPLAY_IDENTIFIER ZW_OPT_VTUESP ECU_ADDRESS 0xd000cfa3 FORMAT "%4.1" /end MEASUREMENT
/begin MEASUREMENT Zw_out "Zündwinkelarray für Zündwinkelausgabe" SWORD _CNV_R_R_Def_zw_sw__604_CM 1 100. -50. 60. DISPLAY_IDENTIFIER ZW_OUT ECU_ADDRESS 0xd000d108 FORMAT "%6.1" ARRAY_SIZE 8 MATRIX_DIM 8 1 1 /end MEASUREMENT
/begin MEASUREMENT Zw_outmdkr "Zündwinkelarray mit Momenteneingriff und Klopfregeleingriff" SWORD _CNV_R_R_Def_zw_sw__604_CM 1 100. -50. 60. DISPLAY_IDENTIFIER ZW_OUTMDKR ECU_ADDRESS 0xd000d12c FORMAT "%6.1" ARRAY_SIZE 8 MATRIX_DIM 8 1 1 /end MEASUREMENT
/begin MEASUREMENT Zw_soll "Hier könnte Ihr Langbezeichner stehen" SWORD _CNV_R_R_Def_zw_sw__604_CM 1 100. -3276.8 3276.7 DISPLAY_IDENTIFIER ZW_SOLL ECU_ADDRESS 0xd000d13e FORMAT "%6.1" /end MEASUREMENT
/begin MEASUREMENT Zw_soll_hs "Sollzündwinkel (homogen-schicht)" SWORD _CNV_R_R_Def_zw_sw__604_CM 1 100. -50. 60. DISPLAY_IDENTIFIER ZW_SOLL_HS ECU_ADDRESS 0xd000d09c FORMAT "%6.1" ARRAY_SIZE 8 MATRIX_DIM 8 1 1 /end MEASUREMENT
/begin MEASUREMENT Zw_soll_s "Sollzündwinkel (schicht)" SWORD _CNV_R_R_Def_zw_sw__604_CM 1 100. -50. 60. DISPLAY_IDENTIFIER ZW_SOLL_S ECU_ADDRESS 0xd000d08c FORMAT "%6.1" ARRAY_SIZE 8 MATRIX_DIM 8 1 1 /end MEASUREMENT
/begin MEASUREMENT Zw_sollm_hs "gemittelter Sollzündwinkel (homogen-schicht)" SWORD _CNV_R_R_Def_zw_sw__604_CM 1 100. -50. 60. DISPLAY_IDENTIFIER ZW_SOLLM_HS ECU_ADDRESS 0xd000d0e0 FORMAT "%6.1" /end MEASUREMENT
/begin MEASUREMENT Zw_start "Startzündwinkel" SWORD _CNV_R_R_Def_zw_sw__604_CM 1 100. -3276.8 3276.7 DISPLAY_IDENTIFIER ZW_START ECU_ADDRESS 0xd000d144 FORMAT "%6.1" /end MEASUREMENT
/begin MEASUREMENT Zw_timer "Timer für Rf_sol-Modellierung (Grundzündwinkel)" UWORD _CNV_R_R_Def_dez_sl_551_CM 1 100. 0. 65535. DISPLAY_IDENTIFIER ZW_TIMER ECU_ADDRESS 0xd000d014 FORMAT "%5.0" /end MEASUREMENT
/begin MEASUREMENT Zw_ve "Zündwinkelarray vor Momenteneingriff" SWORD _CNV_R_R_Def_zw_sw__604_CM 1 100. -50. 60. DISPLAY_IDENTIFIER ZW_VE ECU_ADDRESS 0xd000d0f8 FORMAT "%6.1" ARRAY_SIZE 8 MATRIX_DIM 8 1 1 /end MEASUREMENT
/begin MEASUREMENT Zw_vkr "Zündwinkelarray vor Klopfeingriff" SWORD _CNV_R_R_Def_zw_sw__604_CM 1 100. -50. 60. DISPLAY_IDENTIFIER ZW_VKR ECU_ADDRESS 0xd000d11c FORMAT "%6.1" ARRAY_SIZE 8 MATRIX_DIM 8 1 1 /end MEASUREMENT
/begin MEASUREMENT Zw_vt98 "Grundzündwinkel VVT ROZ 98" SBYTE _CNV_R_R_Def_zw_sb__605_CM 1 100. -64. 63.5 DISPLAY_IDENTIFIER ZW_VT98 ECU_ADDRESS 0xd000cfde FORMAT "%4.1" /end MEASUREMENT
/begin MEASUREMENT Zw_vtuesp "Grundzündwinkel Ueberspuelen" SBYTE _CNV_R_R_Def_zw_sb__605_CM 1 100. -64. 63.5 DISPLAY_IDENTIFIER ZW_VTUESP ECU_ADDRESS 0xd000cfd8 FORMAT "%4.1" /end MEASUREMENT
/begin MEASUREMENT Zwdyn "dyn. Grundzündwinkel" SBYTE _CNV_R_R_Def_zw_sb__605_CM 1 100. -64. 63.5 DISPLAY_IDENTIFIER ZWDYN ECU_ADDRESS 0xd000cfdd FORMAT "%4.1" /end MEASUREMENT
/begin MEASUREMENT Zwdyn_gd "dyn. Grundzündwinkel gedrosselt" SBYTE _CNV_R_R_Def_zw_sb__605_CM 1 100. -64. 63.5 DISPLAY_IDENTIFIER ZWDYN_GD ECU_ADDRESS 0xd000cfdb FORMAT "%4.1" /end MEASUREMENT
/begin MEASUREMENT Zwdyn_nl "dyn. Grundzündwinkel Notlauf" SBYTE _CNV_R_R_Def_zw_sb__605_CM 1 100. -64. 63.5 DISPLAY_IDENTIFIER ZWDYN_NL ECU_ADDRESS 0xd000cfdc FORMAT "%4.1" /end MEASUREMENT
/begin MEASUREMENT Zwdyn_vt "dyn. Grundzündwinkel VVT-Betrieb" SBYTE _CNV_R_R_Def_zw_sb__605_CM 1 100. -64. 63.5 DISPLAY_IDENTIFIER ZWDYN_VT ECU_ADDRESS 0xd000cfda FORMAT "%4.1" /end MEASUREMENT
/begin MEASUREMENT Zwdyn_vt98 "dyn. Grundzündwinkel VVT ROZ 98" SBYTE _CNV_R_R_Def_zw_sb__605_CM 1 100. -64. 63.5 DISPLAY_IDENTIFIER ZWDYN_VT98 ECU_ADDRESS 0xd000cfd9 FORMAT "%4.1" /end MEASUREMENT
/begin MEASUREMENT Zwdyn_vtuesp "dyn. Grundzündwinkel Ueberspuelen" SBYTE _CNV_R_R_Def_zw_sb__605_CM 1 100. -64. 63.5 DISPLAY_IDENTIFIER ZWDYN_VTUESP ECU_ADDRESS 0xd000cfd7 FORMAT "%4.1" /end MEASUREMENT
/begin MEASUREMENT Zwstat "stat. Grundzündwinkel" SBYTE _CNV_R_R_Def_zw_sb__605_CM 1 100. -64. 63.5 DISPLAY_IDENTIFIER ZWSTAT ECU_ADDRESS 0xd000cfe1 FORMAT "%4.1" /end MEASUREMENT
/begin MEASUREMENT Zwstat_gd "stat. Grundzündwinkel gedrosselt" SBYTE _CNV_R_R_Def_zw_sb__605_CM 1 100. -64. 63.5 DISPLAY_IDENTIFIER ZWSTAT_GD ECU_ADDRESS 0xd000cfdf FORMAT "%4.1" /end MEASUREMENT
/begin MEASUREMENT Zwstat_nl "stat. Grundzündwinkel Notlauf" SBYTE _CNV_R_R_Def_zw_sb__605_CM 1 100. -64. 63.5 DISPLAY_IDENTIFIER ZWSTAT_NL ECU_ADDRESS 0xd000cfe0 FORMAT "%4.1" /end MEASUREMENT
/begin MEASUREMENT Zwstat_vt "stat. Grundzündwinkel VVT" SBYTE _CNV_R_R_Def_zw_sb__605_CM 1 100. -64. 63.5 DISPLAY_IDENTIFIER ZWSTAT_VT ECU_ADDRESS 0xd000cfc0 FORMAT "%4.1" /end MEASUREMENT
/begin CHARACTERISTIC CW_HEIZART "Auswahl Heizleistungsart" VALUE 0xa081b1b8 _REC_VAL_20_u1 99.45 _CNV_R_R_Def_dez_sl_551_CM 0. 255. FORMAT "%3.0" /end CHARACTERISTIC
/begin CHARACTERISTIC CW_ZWDYN "Codewort für Grundzündwinkeldynamik" VALUE 0xa081c4dc _REC_VAL_20_u1 99.45 _CNV_R_R_Def_dez_sl_551_CM 0. 255. FORMAT "%3.0" /end CHARACTERISTIC
/begin CHARACTERISTIC KF_DZWKS "Kein Langbezeichner vergeben" MAP 0xa081e6fc _REC_MAP_52_UBYTE_s2_s2_s2 131.07 _CNV_R_R_Def_zw_sw__604_CM -3276.8 3276.7 FORMAT "%4.1"
 /begin AXIS_DESCR STD_AXIS Nkw _CNV_R_R_Def_n_sw_q_595_CM 6 -32768. 32767. FORMAT "%5.0" /end AXIS_DESCR
 /begin AXIS_DESCR STD_AXIS Rf _CNV_R_R_Def_rf_sw__598_CM 6 -327.68 327.67 FORMAT "%7.4" /end AXIS_DESCR
/end CHARACTERISTIC
/begin CHARACTERISTIC KF_DZWO_KHVNS_GD "Korrektur opt. Zündwinkel bei Katheizen verriegeltes Vanos GD-Pfad" MAP 0xa081c310 _REC_MAP_52_UBYTE_s1_s2_s2 99.45 _CNV_R_R_Def_zw_sb__605_CM -64. 63.5 FORMAT "%4.1"
 /begin AXIS_DESCR STD_AXIS Nkw _CNV_R_R_Def_n_sw_q_595_CM 8 -32768. 32767. FORMAT "%5.0" /end AXIS_DESCR
 /begin AXIS_DESCR STD_AXIS Rf_zwv _CNV_R_R_Def_rf_sw__598_CM 6 -327.68 327.67 FORMAT "%7.4" /end AXIS_DESCR
/end CHARACTERISTIC
/begin CHARACTERISTIC KF_DZWO_KHVNS_VT "Korrektur opt. Zündwinkel bei Katheizen verriegeltes Vanos VT-Pfad" MAP 0xa081c270 _REC_MAP_52_UBYTE_s1_s2_s2 99.45 _CNV_R_R_Def_zw_sb__605_CM -64. 63.5 FORMAT "%4.1"
 /begin AXIS_DESCR STD_AXIS Nkw _CNV_R_R_Def_n_sw_q_595_CM 8 -32768. 32767. FORMAT "%5.0" /end AXIS_DESCR
 /begin AXIS_DESCR STD_AXIS Rf_zwv _CNV_R_R_Def_rf_sw__598_CM 6 -327.68 327.67 FORMAT "%7.4" /end AXIS_DESCR
/end CHARACTERISTIC
/begin CHARACTERISTIC KF_DZWO_KHWL_GD "Warmlaufkorrektur opt. Zündwinkel bei Katheizen GD-Pfad" MAP 0xa081c360 _REC_MAP_52_UBYTE_s1_s2_s2 99.45 _CNV_R_R_Def_zw_sb__605_CM -64. 63.5 FORMAT "%4.1"
 /begin AXIS_DESCR STD_AXIS Nkw _CNV_R_R_Def_n_sw_q_595_CM 8 -32768. 32767. FORMAT "%5.0" /end AXIS_DESCR
 /begin AXIS_DESCR STD_AXIS Rf_zwv _CNV_R_R_Def_rf_sw__598_CM 6 -327.68 327.67 FORMAT "%7.4" /end AXIS_DESCR
/end CHARACTERISTIC
/begin CHARACTERISTIC KF_DZWO_KHWL_VT "Warmlaufkorrektur opt. Zündwinkel bei Katheizen VT-Pfad" MAP 0xa081c2c0 _REC_MAP_52_UBYTE_s1_s2_s2 99.45 _CNV_R_R_Def_zw_sb__605_CM -64. 63.5 FORMAT "%4.1"
 /begin AXIS_DESCR STD_AXIS Nkw _CNV_R_R_Def_n_sw_q_595_CM 8 -32768. 32767. FORMAT "%5.0" /end AXIS_DESCR
 /begin AXIS_DESCR STD_AXIS Rf_zwv _CNV_R_R_Def_rf_sw__598_CM 6 -327.68 327.67 FORMAT "%7.4" /end AXIS_DESCR
/end CHARACTERISTIC
/begin CHARACTERISTIC KF_DZWRF_S "Deltazündwinkel (schicht)" MAP 0xa081e1e0 _REC_MAP_52_UBYTE_s2_s2_s2 100.1 _CNV_R_R_Def_zw_sw__604_CM -50. 60. FORMAT "%4.1"
 /begin AXIS_DESCR STD_AXIS Nkw _CNV_R_R_Def_n_sw_q_595_CM 6 -32768. 32767. FORMAT "%5.0" /end AXIS_DESCR
 /begin AXIS_DESCR STD_AXIS Drfopt_s _CNV_R_R_Def_eta_sw_599_CM 4 -200. 199.9938 /end AXIS_DESCR
/end CHARACTERISTIC
/begin CHARACTERISTIC KF_DZW_DYN "Deltazündwinkel Dynamikkorrektur" MAP 0xa081d5f4 _REC_MAP_52_UBYTE_s1_s2_s2 99.45 _CNV_R_R_Def_zw_sb__605_CM -64. 63.5 FORMAT "%4.1"
 /begin AXIS_DESCR STD_AXIS Nkw _CNV_R_R_Def_n_sw_q_595_CM 4 -32768. 32767. FORMAT "%5.0" /end AXIS_DESCR
 /begin AXIS_DESCR STD_AXIS Rf_zwv _CNV_R_R_Def_rf_sw__598_CM 4 -327.68 327.67 FORMAT "%7.4" /end AXIS_DESCR
/end CHARACTERISTIC
/begin CHARACTERISTIC KF_DZW_DYNN "Deltazündwinkel Dynamikkorrektur negative Richtung" MAP 0xa081d6b0 _REC_MAP_52_UBYTE_s1_s2_s2 99.45 _CNV_R_R_Def_zw_sb__605_CM -64. 63.5 FORMAT "%4.1"
 /begin AXIS_DESCR STD_AXIS Nkw _CNV_R_R_Def_n_sw_q_595_CM 4 -32768. 32767. FORMAT "%5.0" /end AXIS_DESCR
 /begin AXIS_DESCR STD_AXIS Rf_zwv _CNV_R_R_Def_rf_sw__598_CM 4 -327.68 327.67 FORMAT "%7.4" /end AXIS_DESCR
/end CHARACTERISTIC
/begin CHARACTERISTIC KF_DZW_HZ "Deltazündwinkel für Heizleistungssteigerung" MAP 0xa081c684 _REC_MAP_52_UBYTE_s1_s2_s2 99.45 _CNV_R_R_Def_zw_sb__605_CM -64. 63.5 FORMAT "%4.1"
 /begin AXIS_DESCR STD_AXIS Nkw _CNV_R_R_Def_n_sw_q_595_CM 5 -32768. 32767. FORMAT "%5.0" /end AXIS_DESCR
 /begin AXIS_DESCR STD_AXIS Rfkr _CNV_R_R_Def_rf_sw__598_CM 5 -327.68 327.67 FORMAT "%7.4" /end AXIS_DESCR
/end CHARACTERISTIC
/begin CHARACTERISTIC KF_DZW_KRT_HS "Deltazündwinkel Temperaturkorrektur für Klopfen (homogen-schicht)" MAP 0xa081e2a8 _REC_MAP_52_UBYTE_s2_s2_s2 100.1 _CNV_R_R_Def_zw_sw__604_CM -50. 60. FORMAT "%4.1"
 /begin AXIS_DESCR STD_AXIS Nkw _CNV_R_R_Def_n_sw_q_595_CM 8 -32768. 32767. FORMAT "%5.0" /end AXIS_DESCR
 /begin AXIS_DESCR STD_AXIS Rk_soll_hs _CNV_R_R_Def_rk_sw__600_CM 6 -1600. 1599.9511 /end AXIS_DESCR
/end CHARACTERISTIC
/begin CHARACTERISTIC KF_DZW_KR_GD "Deltazündwinkel für KR gedrosselter Betrieb" MAP 0xa081d470 _REC_MAP_52_UBYTE_s1_s2_s2 99.45 _CNV_R_R_Def_zw_sb__605_CM -64. 63.5 FORMAT "%4.1"
 /begin AXIS_DESCR STD_AXIS Nkw _CNV_R_R_Def_n_sw_q_595_CM 8 -32768. 32767. FORMAT "%5.0" /end AXIS_DESCR
 /begin AXIS_DESCR STD_AXIS Rfkr _CNV_R_R_Def_rf_sw__598_CM 6 -327.68 327.67 FORMAT "%7.4" /end AXIS_DESCR
/end CHARACTERISTIC
/begin CHARACTERISTIC KF_DZW_KR_VT "Deltazündwinkel für KR VVT Betrieb" MAP 0xa081d4c0 _REC_MAP_52_UBYTE_s1_s2_s2 99.45 _CNV_R_R_Def_zw_sb__605_CM -64. 63.5 FORMAT "%4.1"
 /begin AXIS_DESCR STD_AXIS Nkw _CNV_R_R_Def_n_sw_q_595_CM 8 -32768. 32767. FORMAT "%5.0" /end AXIS_DESCR
 /begin AXIS_DESCR STD_AXIS Rfkr _CNV_R_R_Def_rf_sw__598_CM 6 -327.68 327.67 FORMAT "%7.4" /end AXIS_DESCR
/end CHARACTERISTIC
/begin CHARACTERISTIC KF_DZW_TD98 "Grundzündwinkelkorrektur teilgedrosselt ROZ 98" MAP 0xa081cc24 _REC_MAP_52_UBYTE_s1_s2_s2 99.45 _CNV_R_R_Def_zw_sb__605_CM -64. 63.5 FORMAT "%4.1"
 /begin AXIS_DESCR STD_AXIS Minhubsw _CNV_R_R_Def_hub_uw_589_CM 8 -32.768 32.767 /end AXIS_DESCR
 /begin AXIS_DESCR STD_AXIS Dpssolfilt _CNV_R_R_Def_p_sw_q_576_CM 8 -1280. 1279.9609 FORMAT "%5.2" /end AXIS_DESCR
/end CHARACTERISTIC
/begin CHARACTERISTIC KF_DZW_VNS_GD "Deltazündwinkel bei Vanoskorr. im gedrosselten Betrieb" MAP 0xa081d3d0 _REC_MAP_52_UBYTE_s1_s2_s2 99.45 _CNV_R_R_Def_zw_sb__605_CM -64. 63.5 FORMAT "%4.1"
 /begin AXIS_DESCR STD_AXIS Nkw _CNV_R_R_Def_n_sw_q_595_CM 8 -32768. 32767. FORMAT "%5.0" /end AXIS_DESCR
 /begin AXIS_DESCR STD_AXIS Rfkr _CNV_R_R_Def_rf_sw__598_CM 6 -327.68 327.67 FORMAT "%7.4" /end AXIS_DESCR
/end CHARACTERISTIC
/begin CHARACTERISTIC KF_DZW_VNS_VT "Deltazündwinkel bei Vanoskorr. im VVT Betrieb" MAP 0xa081d380 _REC_MAP_52_UBYTE_s1_s2_s2 99.45 _CNV_R_R_Def_zw_sb__605_CM -64. 63.5 FORMAT "%4.1"
 /begin AXIS_DESCR STD_AXIS Nkw _CNV_R_R_Def_n_sw_q_595_CM 8 -32768. 32767. FORMAT "%5.0" /end AXIS_DESCR
 /begin AXIS_DESCR STD_AXIS Rfkr _CNV_R_R_Def_rf_sw__598_CM 6 -327.68 327.67 FORMAT "%7.4" /end AXIS_DESCR
/end CHARACTERISTIC
/begin CHARACTERISTIC KF_DZW_WL_GD "Deltazündwinkel bei Warmlauf gedrosselter Betrieb" MAP 0xa081d420 _REC_MAP_52_UBYTE_s1_s2_s2 99.45 _CNV_R_R_Def_zw_sb__605_CM -64. 63.5 FORMAT "%4.1"
 /begin AXIS_DESCR STD_AXIS Nkw _CNV_R_R_Def_n_sw_q_595_CM 8 -32768. 32767. FORMAT "%5.0" /end AXIS_DESCR
 /begin AXIS_DESCR STD_AXIS Rfkr _CNV_R_R_Def_rf_sw__598_CM 6 -327.68 327.67 FORMAT "%7.4" /end AXIS_DESCR
/end CHARACTERISTIC
/begin CHARACTERISTIC KF_DZW_WL_HS "Deltazündwinkel bei Warmlauf (homogen-schicht)" MAP 0xa081e228 _REC_MAP_52_UBYTE_s2_s2_s2 100.1 _CNV_R_R_Def_zw_sw__604_CM -50. 60. FORMAT "%4.1"
 /begin AXIS_DESCR STD_AXIS Nkw _CNV_R_R_Def_n_sw_q_595_CM 8 -32768. 32767. FORMAT "%5.0" /end AXIS_DESCR
 /begin AXIS_DESCR STD_AXIS Rk_soll_hs _CNV_R_R_Def_rk_sw__600_CM 6 -1600. 1599.9511 /end AXIS_DESCR
/end CHARACTERISTIC
/begin CHARACTERISTIC KF_DZW_WL_VT "Deltazündwinkel bei Warmlauf VVT Betrieb" MAP 0xa081d330 _REC_MAP_52_UBYTE_s1_s2_s2 99.45 _CNV_R_R_Def_zw_sb__605_CM -64. 63.5 FORMAT "%4.1"
 /begin AXIS_DESCR STD_AXIS Nkw _CNV_R_R_Def_n_sw_q_595_CM 8 -32768. 32767. FORMAT "%5.0" /end AXIS_DESCR
 /begin AXIS_DESCR STD_AXIS Rfkr _CNV_R_R_Def_rf_sw__598_CM 6 -327.68 327.67 FORMAT "%7.4" /end AXIS_DESCR
/end CHARACTERISTIC
/begin CHARACTERISTIC KF_FDZWKS "Kein Langbezeichner vergeben" MAP 0xa081e760 _REC_MAP_52_UBYTE_u2_s2_s2 7.9998 _CNV_R_R_Def_f_uw_b_572_CM 0. 7.9998 FORMAT "%7.4"
 /begin AXIS_DESCR STD_AXIS Tans _CNV_R_R_Def_t_sw_q_578_CM 6 -3276.8 3276.7 FORMAT "%4.1" /end AXIS_DESCR
 /begin AXIS_DESCR STD_AXIS Tmot _CNV_R_R_Def_t_sw_q_579_CM 6 -327.68 327.67 FORMAT "%5.2" /end AXIS_DESCR
/end CHARACTERISTIC
/begin CHARACTERISTIC KF_FDZWO_KHVNS "Faktor Überblendung Korrektur opt. Zündwinkel bei Katheizen verriegeltes Vanos" MAP 0xa081c478 _REC_MAP_52_u1_s2_s2 0.996 _CNV_R_R_Def_f_ub_b_553_CM 0. 0.996
 /begin AXIS_DESCR STD_AXIS Dvsa_ramp _CNV_R_R_Def_spr_sw_561_CM 8 -3276.8 3276.7 FORMAT "%5.2" /end AXIS_DESCR
 /begin AXIS_DESCR STD_AXIS Dvse_ramp _CNV_R_R_Def_spr_sw_561_CM 8 -3276.8 3276.7 FORMAT "%5.2" /end AXIS_DESCR
/end CHARACTERISTIC
/begin CHARACTERISTIC KF_FDZW_DYN1 "Wichtungsfaktor Dynamikkorrektur über Tans und Dzw_annm für Handschaltgetriebe" MAP 0xa081d618 _REC_MAP_52_u1_s2_s2 0.996 _CNV_R_R_Def_f_ub_b_553_CM 0. 0.996
 /begin AXIS_DESCR STD_AXIS Tans _CNV_R_R_Def_t_sw_q_578_CM 4 -3276.8 3276.7 FORMAT "%4.1" /end AXIS_DESCR
 /begin AXIS_DESCR STD_AXIS Dzw_annm _CNV_R_R_Def_zw_sw__604_CM 4 -50. 60. FORMAT "%4.1" /end AXIS_DESCR
/end CHARACTERISTIC
/begin CHARACTERISTIC KF_FDZW_DYN2 "Wichtungsfaktor Dynamikkorrektur über V und Gangi für Handschaltgetriebe" MAP 0xa081d63c _REC_MAP_52_u1_u1_u2 0.996 _CNV_R_R_Def_f_ub_b_553_CM 0. 0.996
 /begin AXIS_DESCR STD_AXIS Gangi _CNV_R_R_Def_dez_sl_551_CM 6 0. 255. FORMAT "%3.0" /end AXIS_DESCR
 /begin AXIS_DESCR STD_AXIS V _CNV_R_R_Def_v_uw_q_726_CM 4 0. 360. FORMAT "%5.0" /end AXIS_DESCR
/end CHARACTERISTIC
/begin CHARACTERISTIC KF_FDZW_DYN3 "Wichtungsfaktor Dynamikkorrektur über Tans und Dzw_annm für Automatikgetriebe" MAP 0xa081d664 _REC_MAP_52_u1_s2_s2 0.996 _CNV_R_R_Def_f_ub_b_553_CM 0. 0.996
 /begin AXIS_DESCR STD_AXIS Tans _CNV_R_R_Def_t_sw_q_578_CM 4 -3276.8 3276.7 FORMAT "%4.1" /end AXIS_DESCR
 /begin AXIS_DESCR STD_AXIS Dzw_annm _CNV_R_R_Def_zw_sw__604_CM 4 -50. 60. FORMAT "%4.1" /end AXIS_DESCR
/end CHARACTERISTIC
/begin CHARACTERISTIC KF_FDZW_DYN4 "Wichtungsfaktor Dynamikkorrektur über V und Gangi für Automatikgetriebe" MAP 0xa081d688 _REC_MAP_52_u1_u1_u2 0.996 _CNV_R_R_Def_f_ub_b_553_CM 0. 0.996
 /begin AXIS_DESCR STD_AXIS Gangi _CNV_R_R_Def_dez_sl_551_CM 6 0. 255. FORMAT "%3.0" /end AXIS_DESCR
 /begin AXIS_DESCR STD_AXIS V _CNV_R_R_Def_v_uw_q_726_CM 4 0. 360. FORMAT "%5.0" /end AXIS_DESCR
/end CHARACTERISTIC
/begin CHARACTERISTIC KF_FDZW_DYNN1 "Wichtungsfaktor Dynamikkorrektur neg. Richtung über Tans und Dzw_annm für H-Getriebe" MAP 0xa081d6d4 _REC_MAP_52_u1_s2_s2 0.996 _CNV_R_R_Def_f_ub_b_553_CM 0. 0.996
 /begin AXIS_DESCR STD_AXIS Tans _CNV_R_R_Def_t_sw_q_578_CM 4 -3276.8 3276.7 FORMAT "%4.1" /end AXIS_DESCR
 /begin AXIS_DESCR STD_AXIS Dzw_annm _CNV_R_R_Def_zw_sw__604_CM 4 -50. 60. FORMAT "%4.1" /end AXIS_DESCR
/end CHARACTERISTIC
/begin CHARACTERISTIC KF_FDZW_DYNN2 "Wichtungsfaktor Dynamikkorrektur neg. Richtung über V und Gangi für H-Getriebe" MAP 0xa081d6f8 _REC_MAP_52_u1_u1_u2 0.996 _CNV_R_R_Def_f_ub_b_553_CM 0. 0.996
 /begin AXIS_DESCR STD_AXIS Gangi _CNV_R_R_Def_dez_sl_551_CM 6 0. 255. FORMAT "%3.0" /end AXIS_DESCR
 /begin AXIS_DESCR STD_AXIS V _CNV_R_R_Def_v_uw_q_726_CM 4 0. 360. FORMAT "%5.0" /end AXIS_DESCR
/end CHARACTERISTIC
/begin CHARACTERISTIC KF_FDZW_T "KFaktor Zusatztemperaturkorrektur Grundzündwinkel im Dynamikfall" MAP 0xa081d5d8 _REC_MAP_52_u1_s2_s2 1.9921 _CNV_R_R_Def_f_ub_b_613_CM 0. 1.9921
 /begin AXIS_DESCR STD_AXIS Nkw _CNV_R_R_Def_n_sw_q_595_CM 4 -32768. 32767. FORMAT "%5.0" /end AXIS_DESCR
 /begin AXIS_DESCR STD_AXIS Tans _CNV_R_R_Def_t_sw_q_578_CM 3 -3276.8 3276.7 FORMAT "%4.1" /end AXIS_DESCR
/end CHARACTERISTIC
/begin CHARACTERISTIC KF_FDZW_VNS_GD "Faktor Überblendung ZW-Korrektur verriegeltes Vanos gedrosselt" MAP 0xa081c718 _REC_MAP_52_u1_s2_s2 0.996 _CNV_R_R_Def_f_ub_b_553_CM 0. 0.996
 /begin AXIS_DESCR STD_AXIS Dvsa_ramp _CNV_R_R_Def_spr_sw_561_CM 8 -3276.8 3276.7 FORMAT "%5.2" /end AXIS_DESCR
 /begin AXIS_DESCR STD_AXIS Dvse_ramp _CNV_R_R_Def_spr_sw_561_CM 8 -3276.8 3276.7 FORMAT "%5.2" /end AXIS_DESCR
/end CHARACTERISTIC
/begin CHARACTERISTIC KF_FDZW_VNS_VT "Faktor Überblendung ZW-Korrektur verriegeltes Vanos VVT Betrieb" MAP 0xa081c6b4 _REC_MAP_52_u1_s2_s2 0.996 _CNV_R_R_Def_f_ub_b_553_CM 0. 0.996
 /begin AXIS_DESCR STD_AXIS Dvsa_ramp _CNV_R_R_Def_spr_sw_561_CM 8 -3276.8 3276.7 FORMAT "%5.2" /end AXIS_DESCR
 /begin AXIS_DESCR STD_AXIS Dvse_ramp _CNV_R_R_Def_spr_sw_561_CM 8 -3276.8 3276.7 FORMAT "%5.2" /end AXIS_DESCR
/end CHARACTERISTIC
/begin CHARACTERISTIC KF_FZWOKH_LAMKOR "Wichtungsfaktor Lambdakorrektur optimaler Zündwinkel bei Katheizen" MAP 0xa081bdbc _REC_MAP_52_UBYTE_s2_s2_s2 3.9999 _CNV_R_R_Def_f_sw_b_616_CM -2. 1.9999 FORMAT "%14.5"
 /begin AXIS_DESCR STD_AXIS Nkw _CNV_R_R_Def_n_sw_q_595_CM 4 -32768. 32767. FORMAT "%5.0" /end AXIS_DESCR
 /begin AXIS_DESCR STD_AXIS Rf_zwv _CNV_R_R_Def_rf_sw__598_CM 4 -327.68 327.67 FORMAT "%7.4" /end AXIS_DESCR
/end CHARACTERISTIC
/begin CHARACTERISTIC KF_FZWO_KHWL_GD "Faktor Warmlaufkorrektur opt. Zündwinkel bei Katheizen GD-Pfad" MAP 0xa081c414 _REC_MAP_52_UBYTE_s2_u2_s2 3.9999 _CNV_R_R_Def_f_sw_b_616_CM -2. 1.9999 FORMAT "%14.5"
 /begin AXIS_DESCR STD_AXIS Zr_seg_nstart _CNV_R_R_Def_dez_sl_551_CM 6 0. 65535. FORMAT "%5.0" /end AXIS_DESCR
 /begin AXIS_DESCR STD_AXIS Tmot _CNV_R_R_Def_t_sw_q_579_CM 6 -327.68 327.67 FORMAT "%5.2" /end AXIS_DESCR
/end CHARACTERISTIC
/begin CHARACTERISTIC KF_FZWO_KHWL_VT "Faktor Warmlaufkorrektur opt. Zündwinkel bei Katheizen VT-Pfad" MAP 0xa081c3b0 _REC_MAP_52_UBYTE_s2_u2_s2 3.9999 _CNV_R_R_Def_f_sw_b_616_CM -2. 1.9999 FORMAT "%14.5"
 /begin AXIS_DESCR STD_AXIS Zr_seg_nstart _CNV_R_R_Def_dez_sl_551_CM 6 0. 65535. FORMAT "%5.0" /end AXIS_DESCR
 /begin AXIS_DESCR STD_AXIS Tmot _CNV_R_R_Def_t_sw_q_579_CM 6 -327.68 327.67 FORMAT "%5.2" /end AXIS_DESCR
/end CHARACTERISTIC
/begin CHARACTERISTIC KF_FZWO_LAMKOR "Wichtungsfaktor Lambdakorrektur optimaler Zündwinkel" MAP 0xa081bd88 _REC_MAP_52_UBYTE_s2_s2_s2 3.9999 _CNV_R_R_Def_f_sw_b_616_CM -2. 1.9999 FORMAT "%14.5"
 /begin AXIS_DESCR STD_AXIS Nkw _CNV_R_R_Def_n_sw_q_595_CM 4 -32768. 32767. FORMAT "%5.0" /end AXIS_DESCR
 /begin AXIS_DESCR STD_AXIS Rf_zwv _CNV_R_R_Def_rf_sw__598_CM 4 -327.68 327.67 FORMAT "%7.4" /end AXIS_DESCR
/end CHARACTERISTIC
/begin CHARACTERISTIC KF_FZW_KRT_HS "Faktor ZW-Korrektur für Klopfen (homogen-schicht)" MAP 0xa081e328 _REC_MAP_52_UBYTE_u2_s2_s2 3.9999 _CNV_R_R_Def_f_sw_b_616_CM 0. 3.9999 FORMAT "%14.5"
 /begin AXIS_DESCR STD_AXIS Tmot _CNV_R_R_Def_t_sw_q_579_CM 6 -327.68 327.67 FORMAT "%5.2" /end AXIS_DESCR
 /begin AXIS_DESCR STD_AXIS Tans _CNV_R_R_Def_t_sw_q_578_CM 6 -3276.8 3276.7 FORMAT "%4.1" /end AXIS_DESCR
/end CHARACTERISTIC
/begin CHARACTERISTIC KF_FZW_KR_GD "Faktor KR Spätverstellung gedrosselt" MAP 0xa081d298 _REC_MAP_52_UBYTE_u2_s2_s2 1.9999 _CNV_R_R_Def_f_uw_b_590_CM 0. 1.9999 FORMAT "%14.5"
 /begin AXIS_DESCR STD_AXIS Tmot _CNV_R_R_Def_t_sw_q_579_CM 6 -327.68 327.67 FORMAT "%5.2" /end AXIS_DESCR
 /begin AXIS_DESCR STD_AXIS Tans _CNV_R_R_Def_t_sw_q_578_CM 6 -3276.8 3276.7 FORMAT "%4.1" /end AXIS_DESCR
/end CHARACTERISTIC
/begin CHARACTERISTIC KF_FZW_KR_VT "Faktor KR Spätverstellung VVT-Betrieb" MAP 0xa081d234 _REC_MAP_52_UBYTE_u2_s2_s2 1.9999 _CNV_R_R_Def_f_uw_b_590_CM 0. 1.9999 FORMAT "%14.5"
 /begin AXIS_DESCR STD_AXIS Tmot _CNV_R_R_Def_t_sw_q_579_CM 6 -327.68 327.67 FORMAT "%5.2" /end AXIS_DESCR
 /begin AXIS_DESCR STD_AXIS Tans _CNV_R_R_Def_t_sw_q_578_CM 6 -3276.8 3276.7 FORMAT "%4.1" /end AXIS_DESCR
/end CHARACTERISTIC
/begin CHARACTERISTIC KF_FZW_LAMKOR "Faktor Lambdakorrektur Grundzündwinkel" MAP 0xa081d2fc _REC_MAP_52_UBYTE_s2_s2_s2 3.9999 _CNV_R_R_Def_f_sw_b_616_CM -2. 1.9999 FORMAT "%14.5"
 /begin AXIS_DESCR STD_AXIS Nkw _CNV_R_R_Def_n_sw_q_595_CM 4 -32768. 32767. FORMAT "%5.0" /end AXIS_DESCR
 /begin AXIS_DESCR STD_AXIS Rf_zwv _CNV_R_R_Def_rf_sw__598_CM 4 -327.68 327.67 FORMAT "%7.4" /end AXIS_DESCR
/end CHARACTERISTIC
/begin CHARACTERISTIC KF_FZW_WL_GD "Faktor Grundzündwinkelkorrektur im Warmlauf gedrosselter Betrieb" MAP 0xa081d574 _REC_MAP_52_UBYTE_s2_u2_s2 3.9999 _CNV_R_R_Def_f_sw_b_616_CM -2. 1.9999 FORMAT "%14.5"
 /begin AXIS_DESCR STD_AXIS Zr_seg_nstart _CNV_R_R_Def_dez_sl_551_CM 6 0. 65535. FORMAT "%5.0" /end AXIS_DESCR
 /begin AXIS_DESCR STD_AXIS Tmot _CNV_R_R_Def_t_sw_q_579_CM 6 -327.68 327.67 FORMAT "%5.2" /end AXIS_DESCR
/end CHARACTERISTIC
/begin CHARACTERISTIC KF_FZW_WL_HS "Faktor Grundzündwinkelkorrektur im Warmlauf (homogen-schicht)" MAP 0xa081e38c _REC_MAP_52_UBYTE_u2_u2_s2 3.9999 _CNV_R_R_Def_f_sw_b_616_CM 0. 3.9999 FORMAT "%14.5"
 /begin AXIS_DESCR STD_AXIS Zr_seg_nstart _CNV_R_R_Def_dez_sl_551_CM 6 0. 65535. FORMAT "%5.0" /end AXIS_DESCR
 /begin AXIS_DESCR STD_AXIS Tmot _CNV_R_R_Def_t_sw_q_579_CM 6 -327.68 327.67 FORMAT "%5.2" /end AXIS_DESCR
/end CHARACTERISTIC
/begin CHARACTERISTIC KF_FZW_WL_VT "Faktor Grundzündwinkelkorrektur im Warmlauf VVT-Betrieb" MAP 0xa081d510 _REC_MAP_52_UBYTE_s2_u2_s2 3.9999 _CNV_R_R_Def_f_sw_b_616_CM -2. 1.9999 FORMAT "%14.5"
 /begin AXIS_DESCR STD_AXIS Zr_seg_nstart _CNV_R_R_Def_dez_sl_551_CM 6 0. 65535. FORMAT "%5.0" /end AXIS_DESCR
 /begin AXIS_DESCR STD_AXIS Tmot _CNV_R_R_Def_t_sw_q_579_CM 6 -327.68 327.67 FORMAT "%5.2" /end AXIS_DESCR
/end CHARACTERISTIC
/begin CHARACTERISTIC KF_KUEHLPIMX "Kennfeld Leistungsreduzierung über Tmot und Töl" MAP 0xa081b478 _REC_MAP_52_u1_s2_s2 0.996 _CNV_R_R_Def_f_ub_b_553_CM 0. 0.996
 /begin AXIS_DESCR STD_AXIS Tmot _CNV_R_R_Def_t_sw_q_579_CM 8 -327.68 327.67 FORMAT "%5.2" /end AXIS_DESCR
 /begin AXIS_DESCR STD_AXIS Toel _CNV_R_R_Def_t_sw_q_578_CM 8 -3276.8 3276.7 FORMAT "%4.1" /end AXIS_DESCR
/end CHARACTERISTIC
/begin CHARACTERISTIC KF_MDRES_WM "Kennfeld Momentenreserve Wärmemanagement" MAP 0xa081b51c _REC_MAP_52_UBYTE_s2_s2_s2 131.07 _CNV_R_R_Def_m_sw_q_554_CM -3276.8 3276.7 FORMAT "%5.2"
 /begin AXIS_DESCR STD_AXIS Nkw _CNV_R_R_Def_n_sw_q_595_CM 8 -32768. 32767. FORMAT "%5.0" /end AXIS_DESCR
 /begin AXIS_DESCR STD_AXIS Mdi_zw_soll _CNV_R_R_Def_m_sw_q_554_CM 6 -3276.8 3276.7 FORMAT "%5.2" /end AXIS_DESCR
/end CHARACTERISTIC
/begin CHARACTERISTIC KF_TDRFSOLKR "Verzögerung Rf_soll (Anzahl Rechenschritte)" MAP 0xa081c868 _REC_MAP_52_u1_u2_s2 15. _CNV_R_R_Def_dez_sl_551_CM 0. 15. FORMAT "%3.0" /begin AXIS_DESCR STD_AXIS Minhub _CNV_R_R_Def_hub_uw_589_CM 6 0. 65.535 /end AXIS_DESCR
 /begin AXIS_DESCR STD_AXIS Dpssolfilt _CNV_R_R_Def_p_sw_q_576_CM 6 -1280. 1279.9609 FORMAT "%5.2" /end AXIS_DESCR
/end CHARACTERISTIC
/begin CHARACTERISTIC KF_TDRFZW "Verzögerung von Rf auf Rf_zwv" MAP 0xa081c844 _REC_MAP_52_u1_s2_s2 8. _CNV_R_R_Def_dez_sl_551_CM 0. 8. FORMAT "%3.0"
 /begin AXIS_DESCR STD_AXIS Nkw _CNV_R_R_Def_n_sw_q_595_CM 4 -32768. 32767. FORMAT "%5.0" /end AXIS_DESCR
 /begin AXIS_DESCR STD_AXIS Rf _CNV_R_R_Def_rf_sw__598_CM 4 -327.68 327.67 FORMAT "%7.4" /end AXIS_DESCR
/end CHARACTERISTIC
/begin CHARACTERISTIC KF_TMSTMDRES "Kennfeld für Faktor zum Momentenvorhalt für Heizleistungssteigerung" MAP 0xa081b4dc _REC_MAP_52_u1_s2_u2 0.996 _CNV_R_R_Def_f_ub_b_553_CM 0. 0.996
 /begin AXIS_DESCR STD_AXIS Tmot _CNV_R_R_Def_t_sw_q_579_CM 6 -327.68 327.67 FORMAT "%5.2" /end AXIS_DESCR
 /begin AXIS_DESCR STD_AXIS Tn_start_10 _CNV_R_R_Def_td_uw__673_CM 6 0. 655.35 FORMAT "%5.2" /end AXIS_DESCR
/end CHARACTERISTIC
/begin CHARACTERISTIC KF_ZKRFSOLF "Zeitkonstante Rf_soll-Filter fallend" MAP 0xa081c77c _REC_MAP_52_UBYTE_u2_u2_s2 655.35 _CNV_R_R_Def_zk10ms_715_CM 1.e-002 655.36 FORMAT "%7.4" /begin AXIS_DESCR STD_AXIS Minhub _CNV_R_R_Def_hub_uw_589_CM 6 0. 65.535 /end AXIS_DESCR
 /begin AXIS_DESCR STD_AXIS Dpssolfilt _CNV_R_R_Def_p_sw_q_576_CM 6 -1280. 1279.9609 FORMAT "%5.2" /end AXIS_DESCR
/end CHARACTERISTIC
/begin CHARACTERISTIC KF_ZKRFSOLS "Zeitkonstante Rf_soll-Filter steigend" MAP 0xa081c7e0 _REC_MAP_52_UBYTE_u2_u2_s2 655.35 _CNV_R_R_Def_zk10ms_715_CM 1.e-002 655.36 FORMAT "%7.4" /begin AXIS_DESCR STD_AXIS Minhub _CNV_R_R_Def_hub_uw_589_CM 6 0. 65.535 /end AXIS_DESCR
 /begin AXIS_DESCR STD_AXIS Dpssolfilt _CNV_R_R_Def_p_sw_q_576_CM 6 -1280. 1279.9609 FORMAT "%5.2" /end AXIS_DESCR
/end CHARACTERISTIC
/begin CHARACTERISTIC KF_ZWBASDOE_HS "Grundzündwinkel bei Doppeleinspritzung (homogen-schicht)" MAP 0xa081e024 _REC_MAP_52_UBYTE_s2_s2_s2 100.1 _CNV_R_R_Def_zw_sw__604_CM -50. 60. FORMAT "%4.1"
 /begin AXIS_DESCR STD_AXIS Nkw _CNV_R_R_Def_n_sw_q_595_CM 16 -32768. 32767. FORMAT "%5.0" /end AXIS_DESCR
 /begin AXIS_DESCR STD_AXIS Rk_soll_hs _CNV_R_R_Def_rk_sw__600_CM 12 -1600. 1599.9511 /end AXIS_DESCR
/end CHARACTERISTIC
/begin CHARACTERISTIC KF_ZWBASK_S "Grundzündwinkel kalt (schicht)" MAP 0xa081d934 _REC_MAP_52_UBYTE_s2_s2_s2 100.1 _CNV_R_R_Def_zw_sw__604_CM -50. 60. FORMAT "%4.1"
 /begin AXIS_DESCR STD_AXIS Nkw _CNV_R_R_Def_n_sw_q_595_CM 16 -32768. 32767. FORMAT "%5.0" /end AXIS_DESCR
 /begin AXIS_DESCR STD_AXIS Rk_soll_s _CNV_R_R_Def_rk_sw__600_CM 12 -1600. 1599.9511 /end AXIS_DESCR
/end CHARACTERISTIC
/begin CHARACTERISTIC KF_ZWBAS_HS "Grundzündwinkel (homogen-schicht)" MAP 0xa081daf0 _REC_MAP_52_UBYTE_s2_s2_s2 100.1 _CNV_R_R_Def_zw_sw__604_CM -50. 60. FORMAT "%4.1"
 /begin AXIS_DESCR STD_AXIS Nkw _CNV_R_R_Def_n_sw_q_595_CM 16 -32768. 32767. FORMAT "%5.0" /end AXIS_DESCR
 /begin AXIS_DESCR STD_AXIS Rk_soll_hs _CNV_R_R_Def_rk_sw__600_CM 12 -1600. 1599.9511 /end AXIS_DESCR
/end CHARACTERISTIC
/begin CHARACTERISTIC KF_ZWBAS_S "Grundzündwinkel warm (schicht)" MAP 0xa081d778 _REC_MAP_52_UBYTE_s2_s2_s2 100.1 _CNV_R_R_Def_zw_sw__604_CM -50. 60. FORMAT "%4.1"
 /begin AXIS_DESCR STD_AXIS Nkw _CNV_R_R_Def_n_sw_q_595_CM 16 -32768. 32767. FORMAT "%5.0" /end AXIS_DESCR
 /begin AXIS_DESCR STD_AXIS Rk_soll_s _CNV_R_R_Def_rk_sw__600_CM 12 -1600. 1599.9511 /end AXIS_DESCR
/end CHARACTERISTIC
/begin CHARACTERISTIC KF_ZWKS "Kein Langbezeichner vergeben" MAP 0xa081e7c4 _REC_MAP_52_UBYTE_s2_s2_s2 131.07 _CNV_R_R_Def_zw_sw__604_CM -3276.8 3276.7 FORMAT "%4.1"
 /begin AXIS_DESCR STD_AXIS Nkw _CNV_R_R_Def_n_sw_q_595_CM 6 -32768. 32767. FORMAT "%5.0" /end AXIS_DESCR
 /begin AXIS_DESCR STD_AXIS Rf _CNV_R_R_Def_rf_sw__598_CM 6 -327.68 327.67 FORMAT "%7.4" /end AXIS_DESCR
/end CHARACTERISTIC
/begin CHARACTERISTIC KF_ZWMIN_HS "minimal möglicher Zündwinkel (homogen-schicht)" MAP 0xa081dcac _REC_MAP_52_UBYTE_s2_s2_s2 100.1 _CNV_R_R_Def_zw_sw__604_CM -50. 60. FORMAT "%4.1"
 /begin AXIS_DESCR STD_AXIS Nkw _CNV_R_R_Def_n_sw_q_595_CM 16 -32768. 32767. FORMAT "%5.0" /end AXIS_DESCR
 /begin AXIS_DESCR STD_AXIS Rk_soll_hs _CNV_R_R_Def_rk_sw__600_CM 12 -1600. 1599.9511 /end AXIS_DESCR
/end CHARACTERISTIC
/begin CHARACTERISTIC KF_ZWOPT_GD "Optimaler Zündwinkel GD-Pfad" MAP 0xa081ba70 _REC_MAP_52_UBYTE_s1_s2_s2 99.45 _CNV_R_R_Def_zw_sb__605_CM -64. 63.5 FORMAT "%4.1"
 /begin AXIS_DESCR STD_AXIS Nkw _CNV_R_R_Def_n_sw_q_595_CM 20 -32768. 32767. FORMAT "%5.0" /end AXIS_DESCR
 /begin AXIS_DESCR STD_AXIS Rf_zwv _CNV_R_R_Def_rf_sw__598_CM 16 -327.68 327.67 FORMAT "%7.4" /end AXIS_DESCR
/end CHARACTERISTIC
/begin CHARACTERISTIC KF_ZWOPT_GDS "Optimaler Zündwinkel GD-Pfad sicher" MAP 0xa081bbfc _REC_MAP_52_UBYTE_s1_s2_s2 99.45 _CNV_R_R_Def_zw_sb__605_CM -64. 63.5 FORMAT "%4.1"
 /begin AXIS_DESCR STD_AXIS Nkw _CNV_R_R_Def_n_sw_q_595_CM 20 -32768. 32767. FORMAT "%5.0" /end AXIS_DESCR
 /begin AXIS_DESCR STD_AXIS Rf_zwv _CNV_R_R_Def_rf_sw__598_CM 16 -327.68 327.67 FORMAT "%7.4" /end AXIS_DESCR
/end CHARACTERISTIC
/begin CHARACTERISTIC KF_ZWOPT_HS "optimaler Zündwinkel (homogen-schicht)" MAP 0xa081de68 _REC_MAP_52_UBYTE_s2_s2_s2 100.1 _CNV_R_R_Def_zw_sw__604_CM -50. 60. FORMAT "%4.1"
 /begin AXIS_DESCR STD_AXIS Nkw _CNV_R_R_Def_n_sw_q_595_CM 16 -32768. 32767. FORMAT "%5.0" /end AXIS_DESCR
 /begin AXIS_DESCR STD_AXIS Rk_soll_hs _CNV_R_R_Def_rk_sw__600_CM 12 -1600. 1599.9511 /end AXIS_DESCR
/end CHARACTERISTIC
/begin CHARACTERISTIC KF_ZWOPT_VT "Optimaler Zündwinkel VT-Pfad" MAP 0xa081b6f4 _REC_MAP_52_UBYTE_s1_s2_s2 99.45 _CNV_R_R_Def_zw_sb__605_CM -64. 63.5 FORMAT "%4.1"
 /begin AXIS_DESCR STD_AXIS Nkw _CNV_R_R_Def_n_sw_q_595_CM 20 -32768. 32767. FORMAT "%5.0" /end AXIS_DESCR
 /begin AXIS_DESCR STD_AXIS Rf_zwv _CNV_R_R_Def_rf_sw__598_CM 16 -327.68 327.67 FORMAT "%7.4" /end AXIS_DESCR
/end CHARACTERISTIC
/begin CHARACTERISTIC KF_ZWOPT_VTS "Optimaler Zündwinkel VT-Pfad  sicher" MAP 0xa081b880 _REC_MAP_52_UBYTE_s1_s2_s2 99.45 _CNV_R_R_Def_zw_sb__605_CM -64. 63.5 FORMAT "%4.1"
 /begin AXIS_DESCR STD_AXIS Nkw _CNV_R_R_Def_n_sw_q_595_CM 20 -32768. 32767. FORMAT "%5.0" /end AXIS_DESCR
 /begin AXIS_DESCR STD_AXIS Rf_zwv _CNV_R_R_Def_rf_sw__598_CM 16 -327.68 327.67 FORMAT "%7.4" /end AXIS_DESCR
/end CHARACTERISTIC
/begin CHARACTERISTIC KF_ZWOPT_VTUESP "Optimaler Zündwinkel VT-Pfad  Ueberspuelen" MAP 0xa081ba0c _REC_MAP_52_UBYTE_s1_s2_s2 99.45 _CNV_R_R_Def_zw_sb__605_CM -64. 63.5 FORMAT "%4.1"
 /begin AXIS_DESCR STD_AXIS Nkw _CNV_R_R_Def_n_sw_q_595_CM 8 -32768. 32767. FORMAT "%5.0" /end AXIS_DESCR
 /begin AXIS_DESCR STD_AXIS Rf_zwv _CNV_R_R_Def_rf_sw__598_CM 8 -327.68 327.67 FORMAT "%7.4" /end AXIS_DESCR
/end CHARACTERISTIC
/begin CHARACTERISTIC KF_ZWO_KHKGD "Optimaler Zündwinkel bei Katheizen kalte Teillast GD-Pfad" MAP 0xa081c030 _REC_MAP_52_UBYTE_s1_s2_s2 99.45 _CNV_R_R_Def_zw_sb__605_CM -64. 63.5 FORMAT "%4.1"
 /begin AXIS_DESCR STD_AXIS Nkw _CNV_R_R_Def_n_sw_q_595_CM 12 -32768. 32767. FORMAT "%5.0" /end AXIS_DESCR
 /begin AXIS_DESCR STD_AXIS Rf_zwv _CNV_R_R_Def_rf_sw__598_CM 10 -327.68 327.67 FORMAT "%7.4" /end AXIS_DESCR
/end CHARACTERISTIC
/begin CHARACTERISTIC KF_ZWO_KHKLLGD "Optimaler Zündwinkel bei Katheizen kalter Leerlauf GD-Pfad" MAP 0xa081c180 _REC_MAP_52_UBYTE_s1_s2_s2 99.45 _CNV_R_R_Def_zw_sb__605_CM -64. 63.5 FORMAT "%4.1"
 /begin AXIS_DESCR STD_AXIS Nkw _CNV_R_R_Def_n_sw_q_595_CM 8 -32768. 32767. FORMAT "%5.0" /end AXIS_DESCR
 /begin AXIS_DESCR STD_AXIS Rf_zwv _CNV_R_R_Def_rf_sw__598_CM 10 -327.68 327.67 FORMAT "%7.4" /end AXIS_DESCR
/end CHARACTERISTIC
/begin CHARACTERISTIC KF_ZWO_KHKLLVT "Optimaler Zündwinkel  bei Katheizen kalter Leerlauf VT-Pfad" MAP 0xa081bf40 _REC_MAP_52_UBYTE_s1_s2_s2 99.45 _CNV_R_R_Def_zw_sb__605_CM -64. 63.5 FORMAT "%4.1"
 /begin AXIS_DESCR STD_AXIS Nkw _CNV_R_R_Def_n_sw_q_595_CM 8 -32768. 32767. FORMAT "%5.0" /end AXIS_DESCR
 /begin AXIS_DESCR STD_AXIS Rf_zwv _CNV_R_R_Def_rf_sw__598_CM 10 -327.68 327.67 FORMAT "%7.4" /end AXIS_DESCR
/end CHARACTERISTIC
/begin CHARACTERISTIC KF_ZWO_KHKVT "Optimaler Zündwinkel bei Katheizen kalte Teillast VT-Pfad" MAP 0xa081bdf0 _REC_MAP_52_UBYTE_s1_s2_s2 99.45 _CNV_R_R_Def_zw_sb__605_CM -64. 63.5 FORMAT "%4.1"
 /begin AXIS_DESCR STD_AXIS Nkw _CNV_R_R_Def_n_sw_q_595_CM 12 -32768. 32767. FORMAT "%5.0" /end AXIS_DESCR
 /begin AXIS_DESCR STD_AXIS Rf_zwv _CNV_R_R_Def_rf_sw__598_CM 10 -327.68 327.67 FORMAT "%7.4" /end AXIS_DESCR
/end CHARACTERISTIC
/begin CHARACTERISTIC KF_ZWO_KHWGD "Optimaler Zündwinkel bei Katheizen warmer Teillast GD-Pfad" MAP 0xa081c0d8 _REC_MAP_52_UBYTE_s1_s2_s2 99.45 _CNV_R_R_Def_zw_sb__605_CM -64. 63.5 FORMAT "%4.1"
 /begin AXIS_DESCR STD_AXIS Nkw _CNV_R_R_Def_n_sw_q_595_CM 12 -32768. 32767. FORMAT "%5.0" /end AXIS_DESCR
 /begin AXIS_DESCR STD_AXIS Rf_zwv _CNV_R_R_Def_rf_sw__598_CM 10 -327.68 327.67 FORMAT "%7.4" /end AXIS_DESCR
/end CHARACTERISTIC
/begin CHARACTERISTIC KF_ZWO_KHWLLGD "Optimaler Zündwinkel bei Katheizen warmer Leerlauf GD-Pfad" MAP 0xa081c1f8 _REC_MAP_52_UBYTE_s1_s2_s2 99.45 _CNV_R_R_Def_zw_sb__605_CM -64. 63.5 FORMAT "%4.1"
 /begin AXIS_DESCR STD_AXIS Nkw _CNV_R_R_Def_n_sw_q_595_CM 8 -32768. 32767. FORMAT "%5.0" /end AXIS_DESCR
 /begin AXIS_DESCR STD_AXIS Rf_zwv _CNV_R_R_Def_rf_sw__598_CM 10 -327.68 327.67 FORMAT "%7.4" /end AXIS_DESCR
/end CHARACTERISTIC
/begin CHARACTERISTIC KF_ZWO_KHWLLVT "Optimaler Zündwinkel bei Katheizen warmer Leerlauf VT-Pfad" MAP 0xa081bfb8 _REC_MAP_52_UBYTE_s1_s2_s2 99.45 _CNV_R_R_Def_zw_sb__605_CM -64. 63.5 FORMAT "%4.1"
 /begin AXIS_DESCR STD_AXIS Nkw _CNV_R_R_Def_n_sw_q_595_CM 8 -32768. 32767. FORMAT "%5.0" /end AXIS_DESCR
 /begin AXIS_DESCR STD_AXIS Rf_zwv _CNV_R_R_Def_rf_sw__598_CM 10 -327.68 327.67 FORMAT "%7.4" /end AXIS_DESCR
/end CHARACTERISTIC
/begin CHARACTERISTIC KF_ZWO_KHWVT "Optimaler Zündwinkel bei Katheizen warme Teillast VT-Pfad" MAP 0xa081be98 _REC_MAP_52_UBYTE_s1_s2_s2 99.45 _CNV_R_R_Def_zw_sb__605_CM -64. 63.5 FORMAT "%4.1"
 /begin AXIS_DESCR STD_AXIS Nkw _CNV_R_R_Def_n_sw_q_595_CM 12 -32768. 32767. FORMAT "%5.0" /end AXIS_DESCR
 /begin AXIS_DESCR STD_AXIS Rf_zwv _CNV_R_R_Def_rf_sw__598_CM 10 -327.68 327.67 FORMAT "%7.4" /end AXIS_DESCR
/end CHARACTERISTIC
/begin CHARACTERISTIC KF_ZW_GD "Grundzündwinkel gedrosselt" MAP 0xa081cc88 _REC_MAP_52_UBYTE_s1_s2_s2 99.45 _CNV_R_R_Def_zw_sb__605_CM -64. 63.5 FORMAT "%4.1"
 /begin AXIS_DESCR STD_AXIS Nkw _CNV_R_R_Def_n_sw_q_595_CM 20 -32768. 32767. FORMAT "%5.0" /end AXIS_DESCR
 /begin AXIS_DESCR STD_AXIS Rf_zwv _CNV_R_R_Def_rf_sw__598_CM 16 -327.68 327.67 FORMAT "%7.4" /end AXIS_DESCR
/end CHARACTERISTIC
/begin CHARACTERISTIC KF_ZW_GDS "Grundzündwinkel gedrosselt sicher" MAP 0xa081ce14 _REC_MAP_52_UBYTE_s1_s2_s2 99.45 _CNV_R_R_Def_zw_sb__605_CM -64. 63.5 FORMAT "%4.1"
 /begin AXIS_DESCR STD_AXIS Nkw _CNV_R_R_Def_n_sw_q_595_CM 20 -32768. 32767. FORMAT "%5.0" /end AXIS_DESCR
 /begin AXIS_DESCR STD_AXIS Rf_zwv _CNV_R_R_Def_rf_sw__598_CM 16 -327.68 327.67 FORMAT "%7.4" /end AXIS_DESCR
/end CHARACTERISTIC
/begin CHARACTERISTIC KF_ZW_GD_VL "Grundzündwinkel gedrosselt Volllast" MAP 0xa081d1b0 _REC_MAP_52_UBYTE_s1_s2_s2 99.45 _CNV_R_R_Def_zw_sb__605_CM -64. 63.5 FORMAT "%4.1"
 /begin AXIS_DESCR STD_AXIS Nkw _CNV_R_R_Def_n_sw_q_595_CM 20 -32768. 32767. FORMAT "%5.0" /end AXIS_DESCR
 /begin AXIS_DESCR STD_AXIS Rf_zwv _CNV_R_R_Def_rf_sw__598_CM 4 -327.68 327.67 FORMAT "%7.4" /end AXIS_DESCR
/end CHARACTERISTIC
/begin CHARACTERISTIC KF_ZW_MIN "" MAP 0xa081e440 _REC_MAP_52_UBYTE_s2_s2_s2 131.07 _CNV_R_R_Def_zw_sw__604_CM -3276.8 3276.7 FORMAT "%4.1"
 /begin AXIS_DESCR STD_AXIS Rf _CNV_R_R_Def_rf_sw__598_CM 12 -327.68 327.67 FORMAT "%7.4" /end AXIS_DESCR
 /begin AXIS_DESCR STD_AXIS Nkw _CNV_R_R_Def_n_sw_q_595_CM 16 -32768. 32767. FORMAT "%5.0" /end AXIS_DESCR
/end CHARACTERISTIC
/begin CHARACTERISTIC KF_ZW_NL "Grundzündwinkel Notlauf" MAP 0xa081cfa0 _REC_MAP_52_UBYTE_s1_s2_s2 99.45 _CNV_R_R_Def_zw_sb__605_CM -64. 63.5 FORMAT "%4.1"
 /begin AXIS_DESCR STD_AXIS Nkw _CNV_R_R_Def_n_sw_q_595_CM 20 -32768. 32767. FORMAT "%5.0" /end AXIS_DESCR
 /begin AXIS_DESCR STD_AXIS Rf_zwv _CNV_R_R_Def_rf_sw__598_CM 16 -327.68 327.67 FORMAT "%7.4" /end AXIS_DESCR
/end CHARACTERISTIC
/begin CHARACTERISTIC KF_ZW_VT98 "Grundzündwinkel VVT ROZ 98" MAP 0xa081c8a8 _REC_MAP_52_UBYTE_s1_s2_s2 99.45 _CNV_R_R_Def_zw_sb__605_CM -64. 63.5 FORMAT "%4.1"
 /begin AXIS_DESCR STD_AXIS Nkw _CNV_R_R_Def_n_sw_q_595_CM 20 -32768. 32767. FORMAT "%5.0" /end AXIS_DESCR
 /begin AXIS_DESCR STD_AXIS Rf_zwv _CNV_R_R_Def_rf_sw__598_CM 16 -327.68 327.67 FORMAT "%7.4" /end AXIS_DESCR
/end CHARACTERISTIC
/begin CHARACTERISTIC KF_ZW_VT98S "Grundzündwinkel VVT ROZ 98 sicher" MAP 0xa081ca98 _REC_MAP_52_UBYTE_s1_s2_s2 99.45 _CNV_R_R_Def_zw_sb__605_CM -64. 63.5 FORMAT "%4.1"
 /begin AXIS_DESCR STD_AXIS Nkw _CNV_R_R_Def_n_sw_q_595_CM 20 -32768. 32767. FORMAT "%5.0" /end AXIS_DESCR
 /begin AXIS_DESCR STD_AXIS Rf_zwv _CNV_R_R_Def_rf_sw__598_CM 16 -327.68 327.67 FORMAT "%7.4" /end AXIS_DESCR
/end CHARACTERISTIC
/begin CHARACTERISTIC KF_ZW_VTUESP "Grundzündwinkel Ueberspuelen" MAP 0xa081ca34 _REC_MAP_52_UBYTE_s1_s2_s2 99.45 _CNV_R_R_Def_zw_sb__605_CM -64. 63.5 FORMAT "%4.1"
 /begin AXIS_DESCR STD_AXIS Nkw _CNV_R_R_Def_n_sw_q_595_CM 8 -32768. 32767. FORMAT "%5.0" /end AXIS_DESCR
 /begin AXIS_DESCR STD_AXIS Rf_solkrvf _CNV_R_R_Def_rf_sw__598_CM 8 -327.68 327.67 FORMAT "%7.4" /end AXIS_DESCR
/end CHARACTERISTIC
/begin CHARACTERISTIC KF_ZW_VT_VL98 "Grundzündwinkel VVT Volllast ROZ 98" MAP 0xa081d12c _REC_MAP_52_UBYTE_s1_s2_s2 99.45 _CNV_R_R_Def_zw_sb__605_CM -64. 63.5 FORMAT "%4.1"
 /begin AXIS_DESCR STD_AXIS Nkw _CNV_R_R_Def_n_sw_q_595_CM 20 -32768. 32767. FORMAT "%5.0" /end AXIS_DESCR
 /begin AXIS_DESCR STD_AXIS Rf_zwv _CNV_R_R_Def_rf_sw__598_CM 4 -327.68 327.67 FORMAT "%7.4" /end AXIS_DESCR
/end CHARACTERISTIC
/begin CHARACTERISTIC KL_DRFSOL "Drfsol-Schwellwert für Triggerung B_zwdyn Handschaltgetriebe" CURVE 0xa081c5c4 _REC_CUR_TKL_UW_VV__s2_s2 98.30250000000001 _CNV_R_R_Def_rf_sw__598_CM -327.68 327.67 FORMAT "%7.4"
 /begin AXIS_DESCR STD_AXIS Nkw _CNV_R_R_Def_n_sw_q_595_CM 8 -32768. 32767. FORMAT "%5.0" /end AXIS_DESCR
/end CHARACTERISTIC
/begin CHARACTERISTIC KL_DRFSOL1 "Drfsol-Schwellwert für Triggerung B_zwdyn Automatikgetriebe" CURVE 0xa081c5e8 _REC_CUR_TKL_UW_VV__s2_s2 98.30250000000001 _CNV_R_R_Def_rf_sw__598_CM -327.68 327.67 FORMAT "%7.4"
 /begin AXIS_DESCR STD_AXIS Nkw _CNV_R_R_Def_n_sw_q_595_CM 8 -32768. 32767. FORMAT "%5.0" /end AXIS_DESCR
/end CHARACTERISTIC
/begin CHARACTERISTIC KL_DRFSOLN "Drfsol-Schwellwert für Triggerung B_zwdynn" CURVE 0xa081c60c _REC_CUR_TKL_UW_VV__s2_s2 98.30250000000001 _CNV_R_R_Def_rf_sw__598_CM -327.68 327.67 FORMAT "%7.4"
 /begin AXIS_DESCR STD_AXIS Nkw _CNV_R_R_Def_n_sw_q_595_CM 8 -32768. 32767. FORMAT "%5.0" /end AXIS_DESCR
/end CHARACTERISTIC
/begin CHARACTERISTIC KL_DZWOKH_LAMKOR "Lambdakorrektur optimaler Zündwinkel bei Katheizen" CURVE 0xa081b674 _REC_CUR_TKL_UW_VV__s1_u2 99.45 _CNV_R_R_Def_zw_sb__605_CM -64. 63.5 FORMAT "%4.1"
 /begin AXIS_DESCR STD_AXIS La_soll _CNV_R_R_Def_f_uw_b_559_CM 8 0. 15.9997 FORMAT "%7.4" /end AXIS_DESCR
/end CHARACTERISTIC
/begin CHARACTERISTIC KL_DZWO_LAMKOR "Lambdakorrektur optimaler Zündwinkel" CURVE 0xa081b658 _REC_CUR_TKL_UW_VV__s1_u2 99.45 _CNV_R_R_Def_zw_sb__605_CM -64. 63.5 FORMAT "%4.1"
 /begin AXIS_DESCR STD_AXIS La_soll _CNV_R_R_Def_f_uw_b_559_CM 8 0. 15.9997 FORMAT "%7.4" /end AXIS_DESCR
/end CHARACTERISTIC
/begin CHARACTERISTIC KL_DZWQUAD "" CURVE 0xa081e3f0 _REC_CUR_TKL_UW_VV__s2_s2 100.0015 _CNV_R_R_Def_eta_sw_606_CM -100.003 100.
 /begin AXIS_DESCR STD_AXIS Dzw_min _CNV_R_R_Def_zw_sw__604_CM 14 -50. 60. FORMAT "%4.1" /end AXIS_DESCR
/end CHARACTERISTIC
/begin CHARACTERISTIC KL_DZWWURZ "Hier könnte Ihr Langbezeichner stehen" CURVE 0xa081e614 _REC_CUR_TKL_UW_VV__s2_s2 131.07 _CNV_R_R_Def_zw_sw__604_CM -3276.8 3276.7 FORMAT "%4.1"
 /begin AXIS_DESCR STD_AXIS Eta_dzw_sollquad _CNV_R_R_Def_eta_sw_606_CM 14 0. 100. /end AXIS_DESCR
/end CHARACTERISTIC
/begin CHARACTERISTIC KL_DZW_LAMKOR "Lambdakorrektur Grundzündwinkel" CURVE 0xa081c668 _REC_CUR_TKL_UW_VV__s1_u2 99.45 _CNV_R_R_Def_zw_sb__605_CM -64. 63.5 FORMAT "%4.1"
 /begin AXIS_DESCR STD_AXIS La_soll _CNV_R_R_Def_f_uw_b_559_CM 8 0. 15.9997 FORMAT "%7.4" /end AXIS_DESCR
/end CHARACTERISTIC
/begin CHARACTERISTIC KL_EL_I "Kennlinie für I-Anteil für Regler auf D_tmot_tkws zur Ansteuerung e-Lüfter" CURVE 0xa081b2ec _REC_CUR_TKL_UW_VV__u1_s2 51. _CNV_R_R_Def_td_uw__718_CM 0. 51. FORMAT "%4.1"
 /begin AXIS_DESCR STD_AXIS D_tmot_tkws _CNV_R_R_Def_t_sw_q_579_CM 4 -327.68 327.67 FORMAT "%5.2" /end AXIS_DESCR
/end CHARACTERISTIC
/begin CHARACTERISTIC KL_EL_TGET "Kennlinie E-Lüftersollwert über Tget" CURVE 0xa081b3e8 _REC_CUR_TKL_UW_VV__u1_s2 99.60930000000001 _CNV_R_R_Def_f_ub_b_586_CM 0. 99.60930000000001 FORMAT "%5.2"
 /begin AXIS_DESCR STD_AXIS Tget_wm _CNV_R_R_Def_t_sw_q_579_CM 6 -327.68 327.67 FORMAT "%5.2" /end AXIS_DESCR
/end CHARACTERISTIC
/begin CHARACTERISTIC KL_EL_TKA "Kennlinie E-Lüftersollwert über TKA" CURVE 0xa081b3b8 _REC_CUR_TKL_UW_VV__u1_s2 99.60930000000001 _CNV_R_R_Def_f_ub_b_586_CM 0. 99.60930000000001 FORMAT "%5.2"
 /begin AXIS_DESCR STD_AXIS Tka _CNV_R_R_Def_t_sw_q_579_CM 6 -327.68 327.67 FORMAT "%5.2" /end AXIS_DESCR
/end CHARACTERISTIC
/begin CHARACTERISTIC KL_EL_TMOT "Kennlinie Elüfteranforderung über Tmot-Tkwsoll gefiltert" CURVE 0xa081b36c _REC_CUR_TKL_UW_VV__u1_s2 99.60930000000001 _CNV_R_R_Def_f_ub_b_586_CM 0. 99.60930000000001 FORMAT "%5.2"
 /begin AXIS_DESCR STD_AXIS D_tmot_tkws2 _CNV_R_R_Def_t_sw_q_579_CM 12 -327.68 327.67 FORMAT "%5.2" /end AXIS_DESCR
/end CHARACTERISTIC
/begin CHARACTERISTIC KL_EL_TWR1 "Kennlinie E-Lüftersollwert über Tw_r1 (Krümmertemperatur)" CURVE 0xa081b314 _REC_CUR_TKL_UW_VV__u1_s2 99.60930000000001 _CNV_R_R_Def_f_ub_b_586_CM 0. 99.60930000000001 FORMAT "%5.2"
 /begin AXIS_DESCR STD_AXIS Tw_r1 _CNV_R_R_Def_t_sw_q_578_CM 6 -3276.8 3276.7 FORMAT "%4.1" /end AXIS_DESCR
/end CHARACTERISTIC
/begin CHARACTERISTIC KL_EL_V "Kennlinie E-Lüftersollwert über Fahrgeschwindigkeit" CURVE 0xa081b328 _REC_CUR_TKL_UW_VV__u1_u2 0.996 _CNV_R_R_Def_f_ub_b_553_CM 0. 0.996
 /begin AXIS_DESCR STD_AXIS V _CNV_R_R_Def_v_uw_q_726_CM 6 0. 360. FORMAT "%5.0" /end AXIS_DESCR
/end CHARACTERISTIC
/begin CHARACTERISTIC KL_ETAZW_HS "Zündwinkelwirkungsgrad (homogen-schicht)" CURVE 0xa081d72c _REC_CUR_TKL_UW_VV__u2_s2 99.99845000000002 _CNV_R_R_Def_eta_uw_615_CM 0. 199.9969
 /begin AXIS_DESCR STD_AXIS Dzw_hs _CNV_R_R_Def_zw_sw__604_CM 10 -50. 60. FORMAT "%4.1" /end AXIS_DESCR
/end CHARACTERISTIC
/begin CHARACTERISTIC KL_EWP_VBE "Kennlinie zur Ansteuerung EWP in BA Befüllen / Entlüften" CURVE 0xa081b3fc _REC_CUR_TKL_UW_VV__u2_u2 99.998474 _CNV_R_R_Def_vs_uw__686_CM 0. 9999.847400000001 FORMAT "%5.2"
 /begin AXIS_DESCR STD_AXIS NO_INPUT_QUANTITY _CNV_R_R_Def_dez_sl_551_CM 30 0. 65535. FORMAT "%5.0" /end AXIS_DESCR
/end CHARACTERISTIC
/begin CHARACTERISTIC KL_EWP_VBSD "Kennlinie zur Umrechung Volumenstrom EWP in BSD" CURVE 0xa081b394 _REC_CUR_TKL_UW_VV__u1_u2 99.45 _CNV_R_R_Def_dez_sl_551_CM 0. 255. FORMAT "%3.0"
 /begin AXIS_DESCR STD_AXIS Vs_ewp_bsd _CNV_R_R_Def_vs_uw__686_CM 4 0. 9999.847400000001 FORMAT "%5.2" /end AXIS_DESCR
/end CHARACTERISTIC
/begin CHARACTERISTIC KL_FEWPW_BA "Kennlinie Übergang EWP, weich" CURVE 0xa081b5a0 _REC_CUR_TKL_UW_VV__u1_u2 0.996 _CNV_R_R_Def_f_ub_b_553_CM 0. 0.996
 /begin AXIS_DESCR STD_AXIS NO_INPUT_QUANTITY _CNV_R_R_Def_dez_sl_551_CM 10 0. 65535. FORMAT "%5.0" /end AXIS_DESCR
/end CHARACTERISTIC
/begin CHARACTERISTIC KL_FEWP_BA "Kennlinie Übergang EWP, hart" CURVE 0xa081b5c0 _REC_CUR_TKL_UW_VV__u1_u2 0.996 _CNV_R_R_Def_f_ub_b_553_CM 0. 0.996
 /begin AXIS_DESCR STD_AXIS NO_INPUT_QUANTITY _CNV_R_R_Def_dez_sl_551_CM 4 0. 65535. FORMAT "%5.0" /end AXIS_DESCR
/end CHARACTERISTIC
/begin CHARACTERISTIC KL_FKFTW_BA "Kennlinie Übergang KFT, weich" CURVE 0xa081b5e0 _REC_CUR_TKL_UW_VV__u1_u2 0.996 _CNV_R_R_Def_f_ub_b_553_CM 0. 0.996
 /begin AXIS_DESCR STD_AXIS NO_INPUT_QUANTITY _CNV_R_R_Def_dez_sl_551_CM 10 0. 65535. FORMAT "%5.0" /end AXIS_DESCR
/end CHARACTERISTIC
/begin CHARACTERISTIC KL_FKFT_BA "Kennlinie Übergang KFT, hart" CURVE 0xa081b5d0 _REC_CUR_TKL_UW_VV__u1_u2 0.996 _CNV_R_R_Def_f_ub_b_553_CM 0. 0.996
 /begin AXIS_DESCR STD_AXIS NO_INPUT_QUANTITY _CNV_R_R_Def_dez_sl_551_CM 4 0. 65535. FORMAT "%5.0" /end AXIS_DESCR
/end CHARACTERISTIC
/begin CHARACTERISTIC KL_FRFSOL "Faktor Überhöhung Rf_solkrv" CURVE 0xa081c594 _REC_CUR_TKL_UW_VV__u1_s2 1.9921 _CNV_R_R_Def_f_ub_b_613_CM 0. 1.9921
 /begin AXIS_DESCR STD_AXIS Nkw _CNV_R_R_Def_n_sw_q_595_CM 6 -32768. 32767. FORMAT "%5.0" /end AXIS_DESCR
/end CHARACTERISTIC
/begin CHARACTERISTIC KL_FZKRFSOLF "Wichtungsfaktor Zeitkonstante Rf_soll-Filter fallend" CURVE 0xa081c508 _REC_CUR_TKL_UW_VV__u1_s2 7.9687 _CNV_R_R_Def_f_ub_b_694_CM 0. 7.9687 FORMAT "%5.2"
 /begin AXIS_DESCR STD_AXIS Nkw _CNV_R_R_Def_n_sw_q_595_CM 6 -32768. 32767. FORMAT "%5.0" /end AXIS_DESCR
/end CHARACTERISTIC
/begin CHARACTERISTIC KL_FZKRFSOLS "Wichtungsfaktor Zeitkonstante Rf_soll-Filter steigend" CURVE 0xa081c56c _REC_CUR_TKL_UW_VV__u1_s2 7.9687 _CNV_R_R_Def_f_ub_b_694_CM 0. 7.9687 FORMAT "%5.2"
 /begin AXIS_DESCR STD_AXIS Nkw _CNV_R_R_Def_n_sw_q_595_CM 6 -32768. 32767. FORMAT "%5.0" /end AXIS_DESCR
/end CHARACTERISTIC
/begin CHARACTERISTIC KL_FZWBAS_S "Überblendfaktor Grundzündwinkel kalt - warm (schicht)" CURVE 0xa081d758 _REC_CUR_TKL_UW_VV__u1_s2 0.996 _CNV_R_R_Def_f_ub_b_553_CM 0. 0.996
 /begin AXIS_DESCR STD_AXIS Tmot _CNV_R_R_Def_t_sw_q_579_CM 10 -327.68 327.67 FORMAT "%5.2" /end AXIS_DESCR
/end CHARACTERISTIC
/begin CHARACTERISTIC KL_F_DYNAKT "Anteil Haltezeit Dynamikkorrektur" CURVE 0xa081c54c _REC_CUR_TKL_UW_VV__u1_s2 0.996 _CNV_R_R_Def_f_ub_b_553_CM 0. 0.996
 /begin AXIS_DESCR STD_AXIS Nkw _CNV_R_R_Def_n_sw_q_595_CM 4 -32768. 32767. FORMAT "%5.0" /end AXIS_DESCR
/end CHARACTERISTIC
/begin CHARACTERISTIC KL_F_DYNNAKT "Anteil Haltezeit Dynamikkorrektur negative Richtung" CURVE 0xa081c55c _REC_CUR_TKL_UW_VV__u1_s2 0.996 _CNV_R_R_Def_f_ub_b_553_CM 0. 0.996
 /begin AXIS_DESCR STD_AXIS Nkw _CNV_R_R_Def_n_sw_q_595_CM 4 -32768. 32767. FORMAT "%5.0" /end AXIS_DESCR
/end CHARACTERISTIC
/begin CHARACTERISTIC KL_F_DYNNVZ "Anteil Verzögerungszeit Dynamikkorrektur negative Richtung" CURVE 0xa081c52c _REC_CUR_TKL_UW_VV__u1_s2 0.996 _CNV_R_R_Def_f_ub_b_553_CM 0. 0.996
 /begin AXIS_DESCR STD_AXIS Nkw _CNV_R_R_Def_n_sw_q_595_CM 4 -32768. 32767. FORMAT "%5.0" /end AXIS_DESCR
/end CHARACTERISTIC
/begin CHARACTERISTIC KL_F_DYNVZ "Anteil Verzögerungszeit Dynamikkorrektur" CURVE 0xa081c51c _REC_CUR_TKL_UW_VV__u1_s2 0.996 _CNV_R_R_Def_f_ub_b_553_CM 0. 0.996
 /begin AXIS_DESCR STD_AXIS Nkw _CNV_R_R_Def_n_sw_q_595_CM 4 -32768. 32767. FORMAT "%5.0" /end AXIS_DESCR
/end CHARACTERISTIC
/begin CHARACTERISTIC KL_F_RFZWV "Überblendfaktor Rf-Verzögerung für Zündwinkelberechnung" CURVE 0xa081c53c _REC_CUR_TKL_UW_VV__u1_s2 0.996 _CNV_R_R_Def_f_ub_b_553_CM 0. 0.996
 /begin AXIS_DESCR STD_AXIS Nkw _CNV_R_R_Def_n_sw_q_595_CM 4 -32768. 32767. FORMAT "%5.0" /end AXIS_DESCR
/end CHARACTERISTIC
/begin CHARACTERISTIC KL_KFT_HI "Kennlinie KFT-Sollwert über Tumg für BA High" CURVE 0xa081b3a4 _REC_CUR_TKL_UW_VV__s2_s2 98.30250000000001 _CNV_R_R_Def_t_sw_q_579_CM -327.68 327.67 FORMAT "%5.2"
 /begin AXIS_DESCR STD_AXIS Tumg _CNV_R_R_Def_t_sw_q_578_CM 4 -3276.8 3276.7 FORMAT "%4.1" /end AXIS_DESCR
/end CHARACTERISTIC
/begin CHARACTERISTIC KL_KFT_HK "Kennlinie KFT-Sollwert über Tumg für BA High+KFT" CURVE 0xa081b358 _REC_CUR_TKL_UW_VV__s2_s2 98.30250000000001 _CNV_R_R_Def_t_sw_q_579_CM -327.68 327.67 FORMAT "%5.2"
 /begin AXIS_DESCR STD_AXIS Tumg _CNV_R_R_Def_t_sw_q_578_CM 4 -3276.8 3276.7 FORMAT "%4.1" /end AXIS_DESCR
/end CHARACTERISTIC
/begin CHARACTERISTIC KL_KUEHLN "Kennlinie Leistungsreduzierung über Drehzahl" CURVE 0xa081b2fc _REC_CUR_TKL_UW_VV__u1_s2 1.9921 _CNV_R_R_Def_f_ub_b_613_CM 0. 1.9921
 /begin AXIS_DESCR STD_AXIS Nkw _CNV_R_R_Def_n_sw_q_595_CM 7 -32768. 32767. FORMAT "%5.0" /end AXIS_DESCR
/end CHARACTERISTIC
/begin CHARACTERISTIC KL_LLK_EL "Kennlinie zur Bestimmung von Nelueft_llk" CURVE 0xa081b600 _REC_CUR_TKL_UW_VV__u1_s2 99.60930000000001 _CNV_R_R_Def_f_ub_b_586_CM 0. 99.60930000000001 FORMAT "%5.2"
 /begin AXIS_DESCR STD_AXIS D_tans_tumg _CNV_R_R_Def_t_sw_q_578_CM 6 -3276.8 3276.7 FORMAT "%4.1" /end AXIS_DESCR
/end CHARACTERISTIC
/begin CHARACTERISTIC KL_LLK_EWP "Kennlinie zur Bestimmung von Newp_2_soll" CURVE 0xa081b614 _REC_CUR_TKL_UW_VV__u1_s2 99.45 _CNV_R_R_Def_dez_sl_551_CM 0. 255. FORMAT "%3.0"
 /begin AXIS_DESCR STD_AXIS D_tans_tumg _CNV_R_R_Def_t_sw_q_578_CM 6 -3276.8 3276.7 FORMAT "%4.1" /end AXIS_DESCR
/end CHARACTERISTIC
/begin CHARACTERISTIC KL_MAT_BAZW "Zuordnung Eingang Ba-Umschaltung zu Betriebsart" CURVE 0xa081b690 _REC_CUR_TKL_UW_VV__u1_u2 1. _CNV_R_R_Def_dez_sl_551_CM 1. 2. FORMAT "%3.0"
 /begin AXIS_DESCR STD_AXIS Baw_soll _CNV_R_R_Def_dez_sl_551_CM 32 0. 65535. FORMAT "%5.0" /end AXIS_DESCR
/end CHARACTERISTIC
/begin CHARACTERISTIC KL_NEL_PWM "Kennline zur Umrechung E-Lüfter Sollwert in PWM" CURVE 0xa081b3d4 _REC_CUR_TKL_UW_VV__u1_u1 99.60930000000001 _CNV_R_R_Def_f_ub_b_586_CM 0. 99.60930000000001 FORMAT "%5.2"
 /begin AXIS_DESCR STD_AXIS Nelueft_local _CNV_R_R_Def_f_ub_b_586_CM 8 0. 99.60930000000001 FORMAT "%5.2" /end AXIS_DESCR
/end CHARACTERISTIC
/begin CHARACTERISTIC KL_NLELUEFT "Kennlinie Nachlauf E-Lüfter" CURVE 0xa081b63c _REC_CUR_TKL_UW_VV__u2_u2 100. _CNV_R_R_Def_f_ub_b_586_CM 0. 100. FORMAT "%5.2"
 /begin AXIS_DESCR STD_AXIS Vskr_mw_nl _CNV_R_R_Def_dez_sl_551_CM 4 0. 65535. FORMAT "%5.0" /end AXIS_DESCR
/end CHARACTERISTIC
/begin CHARACTERISTIC KL_TD "Anzahl Halteschritte für Rf_solkrv_hold" CURVE 0xa081c5a8 _REC_CUR_TKL_UW_VV__u2_s2 0. _CNV_R_R_Def_dez_sl_551_CM 0. 65535. FORMAT "%5.0"
 /begin AXIS_DESCR STD_AXIS Nkw _CNV_R_R_Def_n_sw_q_595_CM 6 -32768. 32767. FORMAT "%5.0" /end AXIS_DESCR
/end CHARACTERISTIC
/begin CHARACTERISTIC KL_TDDRFSOL "Timerzeit Grundzündwinkeldynamik" CURVE 0xa081c630 _REC_CUR_TKL_UW_VV__u1_s2 2.55 _CNV_R_R_Def_td_uw__673_CM 0. 2.55 FORMAT "%5.2"
 /begin AXIS_DESCR STD_AXIS Nkw _CNV_R_R_Def_n_sw_q_595_CM 8 -32768. 32767. FORMAT "%5.0" /end AXIS_DESCR
/end CHARACTERISTIC
/begin CHARACTERISTIC KL_TDDRFSOLN "Timerzeit Grundzündwinkeldynamik negative Richtung" CURVE 0xa081c64c _REC_CUR_TKL_UW_VV__u1_s2 2.55 _CNV_R_R_Def_td_uw__673_CM 0. 2.55 FORMAT "%5.2"
 /begin AXIS_DESCR STD_AXIS Nkw _CNV_R_R_Def_n_sw_q_595_CM 8 -32768. 32767. FORMAT "%5.0" /end AXIS_DESCR
/end CHARACTERISTIC
/begin CHARACTERISTIC KL_TDRFSOLO "Verzögerung Rf_soll (Anzahl Rechenschritte) über Nkw" CURVE 0xa081c580 _REC_CUR_TKL_UW_VV__u1_s2 15. _CNV_R_R_Def_dez_sl_551_CM 0. 15. FORMAT "%3.0"
 /begin AXIS_DESCR STD_AXIS Nkw _CNV_R_R_Def_n_sw_q_595_CM 6 -32768. 32767. FORMAT "%5.0" /end AXIS_DESCR
/end CHARACTERISTIC
/begin CHARACTERISTIC KL_TGMDKLIMA "Kennline max. Moment Klimakompressor über Tget" CURVE 0xa081b33c _REC_CUR_TKL_UW_VV__s2_s2 131.07 _CNV_R_R_Def_m_sw_q_554_CM -3276.8 3276.7 FORMAT "%5.2"
 /begin AXIS_DESCR STD_AXIS Tget_wm _CNV_R_R_Def_t_sw_q_579_CM 6 -327.68 327.67 FORMAT "%5.2" /end AXIS_DESCR
/end CHARACTERISTIC
/begin CHARACTERISTIC KL_TMMDKLIMA "Kennlinie max. Moment Klimakompressor über Tmot" CURVE 0xa081b2d0 _REC_CUR_TKL_UW_VV__s2_s2 131.07 _CNV_R_R_Def_m_sw_q_554_CM -3276.8 3276.7 FORMAT "%5.2"
 /begin AXIS_DESCR STD_AXIS Tmot _CNV_R_R_Def_t_sw_q_579_CM 6 -327.68 327.67 FORMAT "%5.2" /end AXIS_DESCR
/end CHARACTERISTIC
/begin CHARACTERISTIC KL_TMQSANF "Kennlinie Wärmestromanforderung Klima über Tmot" CURVE 0xa081b3cc _REC_CUR_TKL_UW_VV__u1_s2 0.996 _CNV_R_R_Def_f_ub_b_553_CM 0. 0.996
 /begin AXIS_DESCR STD_AXIS NO_INPUT_QUANTITY _CNV_R_R_Def_t_sw_q_579_CM 2 -327.68 327.67 FORMAT "%5.2" /end AXIS_DESCR
/end CHARACTERISTIC
/begin CHARACTERISTIC KL_TOMDKLIMA "Kennlinie max. Moment Klimakompressor über Toel" CURVE 0xa081b2b4 _REC_CUR_TKL_UW_VV__s2_s2 131.07 _CNV_R_R_Def_m_sw_q_554_CM -3276.8 3276.7 FORMAT "%5.2"
 /begin AXIS_DESCR STD_AXIS Toel _CNV_R_R_Def_t_sw_q_578_CM 6 -3276.8 3276.7 FORMAT "%4.1" /end AXIS_DESCR
/end CHARACTERISTIC
/begin CHARACTERISTIC KL_ZWSTN "Kennlinie für Zuendwinkel beim Start" CURVE 0xa081e650 _REC_CUR_TKL_UW_VV__s2_s2 131.07 _CNV_R_R_Def_zw_sw__604_CM -3276.8 3276.7 FORMAT "%4.1"
 /begin AXIS_DESCR STD_AXIS Nkw _CNV_R_R_Def_n_sw_q_595_CM 6 -32768. 32767. FORMAT "%5.0" /end AXIS_DESCR
/end CHARACTERISTIC
/begin CHARACTERISTIC KL_ZWSTN_VVT "Kennlinie für Zuendwinkel beim Start" CURVE 0xa081e688 _REC_CUR_TKL_UW_VV__s2_s2 131.07 _CNV_R_R_Def_zw_sw__604_CM -3276.8 3276.7 FORMAT "%4.1"
 /begin AXIS_DESCR STD_AXIS Nkw _CNV_R_R_Def_n_sw_q_595_CM 6 -32768. 32767. FORMAT "%5.0" /end AXIS_DESCR
/end CHARACTERISTIC
/begin CHARACTERISTIC KL_ZWSTT "Kennlinie für Zuendwinkel beim Start" CURVE 0xa081e6a4 _REC_CUR_TKL_UW_VV__s2_s2 131.07 _CNV_R_R_Def_zw_sw__604_CM -3276.8 3276.7 FORMAT "%4.1"
 /begin AXIS_DESCR STD_AXIS Tmot_start _CNV_R_R_Def_t_sw_q_579_CM 6 -327.68 327.67 FORMAT "%5.2" /end AXIS_DESCR
/end CHARACTERISTIC
/begin CHARACTERISTIC KL_ZWSTTA "Kennlinie für Zuendwinkeleingriff beim Start" CURVE 0xa081e6dc _REC_CUR_TKL_UW_VV__s2_s2 131.07 _CNV_R_R_Def_zw_sw__604_CM -3276.8 3276.7 FORMAT "%4.1"
 /begin AXIS_DESCR STD_AXIS Tans _CNV_R_R_Def_t_sw_q_578_CM 6 -3276.8 3276.7 FORMAT "%4.1" /end AXIS_DESCR
/end CHARACTERISTIC
/begin CHARACTERISTIC KL_ZWSTTA_VVT "Kennlinie für Zuendwinkeleingriff beim Start" CURVE 0xa081e6c0 _REC_CUR_TKL_UW_VV__s2_s2 131.07 _CNV_R_R_Def_zw_sw__604_CM -3276.8 3276.7 FORMAT "%4.1"
 /begin AXIS_DESCR STD_AXIS Tans _CNV_R_R_Def_t_sw_q_578_CM 6 -3276.8 3276.7 FORMAT "%4.1" /end AXIS_DESCR
/end CHARACTERISTIC
/begin CHARACTERISTIC KL_ZWSTT_VVT "Kennlinie für Zuendwinkel beim Start" CURVE 0xa081e66c _REC_CUR_TKL_UW_VV__s2_s2 131.07 _CNV_R_R_Def_zw_sw__604_CM -3276.8 3276.7 FORMAT "%4.1"
 /begin AXIS_DESCR STD_AXIS Tmot_start _CNV_R_R_Def_t_sw_q_579_CM 6 -327.68 327.67 FORMAT "%5.2" /end AXIS_DESCR
/end CHARACTERISTIC
/begin CHARACTERISTIC KL_ZW_MINTMOT "" CURVE 0xa081e42c _REC_CUR_TKL_UW_VV__s2_s2 131.07 _CNV_R_R_Def_zw_sw__604_CM -3276.8 3276.7 FORMAT "%4.1"
 /begin AXIS_DESCR STD_AXIS Tmot _CNV_R_R_Def_t_sw_q_579_CM 4 -327.68 327.67 FORMAT "%5.2" /end AXIS_DESCR
/end CHARACTERISTIC
/begin CHARACTERISTIC K_BEZAEHLUG "Inkrement für Zähler Laufzeit Befüllen/Entlüften" VALUE 0xa081b1de _REC_VAL_20_u2 0. _CNV_R_R_Def_dez_sl_551_CM 0. 65535. FORMAT "%5.0" /end CHARACTERISTIC
/begin CHARACTERISTIC K_BHZ_AP "Applikationskonstante für Heizleistungsbit (N4x)" VALUE 0xa081b1fc _REC_VAL_20_u1 1. _CNV_R_R_Def_dez_sl_551_CM 0. 1. FORMAT "%3.0" /end CHARACTERISTIC
/begin CHARACTERISTIC K_BLKLPS1_AP "Applikationskonstante für Luftklappe1 (True -> AUF)" VALUE 0xa081b1fd _REC_VAL_20_u1 1. _CNV_R_R_Def_dez_sl_551_CM 0. 1. FORMAT "%3.0" /end CHARACTERISTIC
/begin CHARACTERISTIC K_BLKLPS_AP "Applikationskonstante für Luftklappe auf (True, 1)" VALUE 0xa081b1fe _REC_VAL_20_u1 1. _CNV_R_R_Def_dez_sl_551_CM 0. 1. FORMAT "%3.0" /end CHARACTERISTIC
/begin CHARACTERISTIC K_DRFSOL "Delta Rf_sol" VALUE 0xa081c500 _REC_VAL_20_s2 98.30250000000001 _CNV_R_R_Def_rf_sw__598_CM -327.68 327.67 FORMAT "%7.4" /end CHARACTERISTIC
/begin CHARACTERISTIC K_DRFSOLKRV "Delta Rf_solkrv" VALUE 0xa081c504 _REC_VAL_20_s2 98.30250000000001 _CNV_R_R_Def_rf_sw__598_CM -327.68 327.67 FORMAT "%7.4" /end CHARACTERISTIC
/begin CHARACTERISTIC K_DRFSOLKRVF "Delta Rf_solkrvf" VALUE 0xa081c502 _REC_VAL_20_s2 98.30250000000001 _CNV_R_R_Def_rf_sw__598_CM -327.68 327.67 FORMAT "%7.4" /end CHARACTERISTIC
/begin CHARACTERISTIC K_DZW_HS "Deltazündwinkel (homogen-schicht)" VALUE 0xa081d724 _REC_VAL_20_s2 100.1 _CNV_R_R_Def_zw_sw__604_CM -50. 60. FORMAT "%4.1" /end CHARACTERISTIC
/begin CHARACTERISTIC K_DZW_S "Deltazündwinkel (schicht)" VALUE 0xa081d722 _REC_VAL_20_s2 100.1 _CNV_R_R_Def_zw_sw__604_CM -50. 60. FORMAT "%4.1" /end CHARACTERISTIC
/begin CHARACTERISTIC K_EL_ECO "Faktor für Elüfter BA-ECO" VALUE 0xa081b1ff _REC_VAL_20_u1 7.9687 _CNV_R_R_Def_f_ub_b_694_CM 0. 7.9687 FORMAT "%5.2" /end CHARACTERISTIC
/begin CHARACTERISTIC K_EL_HI "Faktor für Elüfter BA-HIGH" VALUE 0xa081b200 _REC_VAL_20_u1 7.9687 _CNV_R_R_Def_f_ub_b_694_CM 0. 7.9687 FORMAT "%5.2" /end CHARACTERISTIC
/begin CHARACTERISTIC K_EL_HK "Faktor für Elüfter BA-HIGH+KFT" VALUE 0xa081b201 _REC_VAL_20_u1 7.9687 _CNV_R_R_Def_f_ub_b_694_CM 0. 7.9687 FORMAT "%5.2" /end CHARACTERISTIC
/begin CHARACTERISTIC K_EL_KHL1 "E-Lüfter Sollwert bei EGS-Kühlstufe 1" VALUE 0xa081b202 _REC_VAL_20_u1 99.60930000000001 _CNV_R_R_Def_f_ub_b_586_CM 0. 99.60930000000001 FORMAT "%5.2" /end CHARACTERISTIC
/begin CHARACTERISTIC K_EL_LKS0 "Bedingung Luftklappen AUF" VALUE 0xa081b203 _REC_VAL_20_u1 3.11e-002 _CNV_R_R_Def_f_ub_b_633_CM 0. 3.11e-002 FORMAT "%7.4" /end CHARACTERISTIC
/begin CHARACTERISTIC K_EL_LKS1 "Bedingung Luftklappen Unterschiedlich" VALUE 0xa081b204 _REC_VAL_20_u1 3.11e-002 _CNV_R_R_Def_f_ub_b_633_CM 0. 3.11e-002 FORMAT "%7.4" /end CHARACTERISTIC
/begin CHARACTERISTIC K_EL_LKS2 "Beide Luftklappen ZU" VALUE 0xa081b205 _REC_VAL_20_u1 3.11e-002 _CNV_R_R_Def_f_ub_b_633_CM 0. 3.11e-002 FORMAT "%7.4" /end CHARACTERISTIC
/begin CHARACTERISTIC K_EL_NO "Faktor für Elüfter BA-Normal" VALUE 0xa081b206 _REC_VAL_20_u1 7.9687 _CNV_R_R_Def_f_ub_b_694_CM 0. 7.9687 FORMAT "%5.2" /end CHARACTERISTIC
/begin CHARACTERISTIC K_EL_TDLP "Faktor für Tiefpassfilter E-Lüfter Berechnung" VALUE 0xa081b1e0 _REC_VAL_20_u2 131.07 _CNV_R_R_Def_td_uw__718_CM 0. 13107. FORMAT "%4.1" /end CHARACTERISTIC
/begin CHARACTERISTIC K_EL_V0 "Luftmassenstrom in kg/s e-Lüfter bei v=0km/h" VALUE 0xa081b207 _REC_VAL_20_u1 0.9335 _CNV_R_R_Def_f_ub_b_553_CM 6.25e-002 0.996 /end CHARACTERISTIC
/begin CHARACTERISTIC K_ETAZYLAUS_MIN "Schwellwert für Zylinderwirkungsgrad" VALUE 0xa081e610 _REC_VAL_20_s2 100. _CNV_R_R_Def_eta_sw_606_CM 0. 100. /end CHARACTERISTIC
/begin CHARACTERISTIC K_EWPTMST "Schwelle Tmot_start für EWAPU Ansteuerung mit K_EWP_MN1" VALUE 0xa081b1ba _REC_VAL_20_s2 98.30250000000001 _CNV_R_R_Def_t_sw_q_579_CM -327.68 327.67 FORMAT "%5.2" /end CHARACTERISTIC
/begin CHARACTERISTIC K_EWPTUST "Schwelle Tumg für EWAPU Ansteuerung mit K_EWP_MN1" VALUE 0xa081b1bc _REC_VAL_20_s2 131.07 _CNV_R_R_Def_t_sw_q_578_CM -3276.8 3276.7 FORMAT "%4.1" /end CHARACTERISTIC
/begin CHARACTERISTIC K_EWPVSKR1 "Vskr_mw Schwelle 1 für EWAPU Ansteuerung im Nachaluf" VALUE 0xa081b62e _REC_VAL_20_u2 0. _CNV_R_R_Def_dez_sl_551_CM 0. 65535. FORMAT "%5.0" /end CHARACTERISTIC
/begin CHARACTERISTIC K_EWPVSKR2 "Vskr_mw Schwelle 2 für EWAPU Ansteuerung im Nachaluf" VALUE 0xa081b630 _REC_VAL_20_u2 0. _CNV_R_R_Def_dez_sl_551_CM 0. 65535. FORMAT "%5.0" /end CHARACTERISTIC
/begin CHARACTERISTIC K_EWP_AP "Volumenstromanforderung EWP BA Applikation" VALUE 0xa081b1e2 _REC_VAL_20_u2 99.998474 _CNV_R_R_Def_vs_uw__686_CM 0. 9999.847400000001 FORMAT "%5.2" /end CHARACTERISTIC
/begin CHARACTERISTIC K_EWP_EC "Faktor für ECO-Volumenstromberechnung" VALUE 0xa081b1e4 _REC_VAL_20_u2 99.9984 _CNV_R_R_Def_f_uw_b_555_CM 0. 99.9984 /end CHARACTERISTIC
/begin CHARACTERISTIC K_EWP_HI "Faktor für High-Volumenstromberechnung" VALUE 0xa081b1e6 _REC_VAL_20_u2 99.9984 _CNV_R_R_Def_f_uw_b_555_CM 0. 99.9984 /end CHARACTERISTIC
/begin CHARACTERISTIC K_EWP_HK "Faktor für High+Kft Volumenstromberechnung" VALUE 0xa081b1e8 _REC_VAL_20_u2 99.9984 _CNV_R_R_Def_f_uw_b_555_CM 0. 99.9984 /end CHARACTERISTIC
/begin CHARACTERISTIC K_EWP_MDKMN "Schwelle Moment für Umschaltung schnelle EWP-Ansteuerung" VALUE 0xa081b1be _REC_VAL_20_s2 131.07 _CNV_R_R_Def_m_sw_q_554_CM -3276.8 3276.7 FORMAT "%5.2" /end CHARACTERISTIC
/begin CHARACTERISTIC K_EWP_MN1 "Mindestvolumenstrom EWP bei Motorstart unter Schwelltemperatur K_EWPTMST" VALUE 0xa081b1ea _REC_VAL_20_u2 99.998474 _CNV_R_R_Def_vs_uw__686_CM 0. 9999.847400000001 FORMAT "%5.2" /end CHARACTERISTIC
/begin CHARACTERISTIC K_EWP_NO "Faktor für Normal-Volumenstromberechnung" VALUE 0xa081b1ec _REC_VAL_20_u2 99.9984 _CNV_R_R_Def_f_uw_b_555_CM 0. 99.9984 /end CHARACTERISTIC
/begin CHARACTERISTIC K_EWP_TDMD "Zeitkonstante für Erkennung Vollastanforderung" VALUE 0xa081b1ee _REC_VAL_20_u2 131.07 _CNV_R_R_Def_td_uw__718_CM 0. 13107. FORMAT "%4.1" /end CHARACTERISTIC
/begin CHARACTERISTIC K_EWP_WA "Anforderung Volumenstrom BA Warmlauf" VALUE 0xa081b1f0 _REC_VAL_20_u2 99.998474 _CNV_R_R_Def_vs_uw__686_CM 0. 9999.847400000001 FORMAT "%5.2" /end CHARACTERISTIC
/begin CHARACTERISTIC K_FAK_MX "Schwelle für Faktor Bitumschaltung" VALUE 0xa081b208 _REC_VAL_20_u1 0.996 _CNV_R_R_Def_f_ub_b_553_CM 0. 0.996 /end CHARACTERISTIC
/begin CHARACTERISTIC K_FDZWKS "Kein Langbezeichner vergeben" VALUE 0xa081e6f8 _REC_VAL_20_u2 7.9998 _CNV_R_R_Def_f_uw_b_572_CM 0. 7.9998 FORMAT "%7.4" /end CHARACTERISTIC
/begin CHARACTERISTIC K_F_EWPTDLP1 "Filterkonstante EWP niedrige Last" VALUE 0xa081b1f2 _REC_VAL_20_u2 131.07 _CNV_R_R_Def_td_uw__718_CM 0. 13107. FORMAT "%4.1" /end CHARACTERISTIC
/begin CHARACTERISTIC K_F_EWPTDLP2 "Filterkonstante EWP hohe Last" VALUE 0xa081b1f4 _REC_VAL_20_u2 131.07 _CNV_R_R_Def_td_uw__718_CM 0. 13107. FORMAT "%4.1" /end CHARACTERISTIC
/begin CHARACTERISTIC K_F_QSANF "Faktor zur Umrechnung Qs_anf_klima % in l/h für EWAPU" VALUE 0xa081b209 _REC_VAL_20_u1 99.45 _CNV_R_R_Def_dez_ub_685_CM 0. 127.5 /end CHARACTERISTIC
/begin CHARACTERISTIC K_F_QSANFAUT "Faktor zur Umrechnung Qs_anf_klima % in l/h für EWAPU (Automatik)" VALUE 0xa081b20a _REC_VAL_20_u1 99.45 _CNV_R_R_Def_dez_ub_685_CM 0. 127.5 /end CHARACTERISTIC
/begin CHARACTERISTIC K_KFT_AP "Applikationswert für Sollwertvorgabe KFT " VALUE 0xa081b1c0 _REC_VAL_20_s2 98.30250000000001 _CNV_R_R_Def_t_sw_q_579_CM -327.68 327.67 FORMAT "%5.2" /end CHARACTERISTIC
/begin CHARACTERISTIC K_KFT_NK "Sollwertvorgabe für KFT in BA Notfall" VALUE 0xa081b1c2 _REC_VAL_20_s2 98.30250000000001 _CNV_R_R_Def_t_sw_q_579_CM -327.68 327.67 FORMAT "%5.2" /end CHARACTERISTIC
/begin CHARACTERISTIC K_KFT_NO "Sollwertvorgabe für KFT in BA Normal" VALUE 0xa081b1c4 _REC_VAL_20_s2 98.30250000000001 _CNV_R_R_Def_t_sw_q_579_CM -327.68 327.67 FORMAT "%5.2" /end CHARACTERISTIC
/begin CHARACTERISTIC K_KFT_WA "Sollwertvorgabe für KFT in BA Warmlauf" VALUE 0xa081b1c6 _REC_VAL_20_s2 98.30250000000001 _CNV_R_R_Def_t_sw_q_579_CM -327.68 327.67 FORMAT "%5.2" /end CHARACTERISTIC
/begin CHARACTERISTIC K_LKLPS1_MN "Min. Schwelle B_lklps1 rücksetzen" VALUE 0xa081b20b _REC_VAL_20_u1 99.60930000000001 _CNV_R_R_Def_f_ub_b_586_CM 0. 99.60930000000001 FORMAT "%5.2" /end CHARACTERISTIC
/begin CHARACTERISTIC K_LKLPS1_MX "Max. Schwelle B_lklps1 setzen" VALUE 0xa081b20c _REC_VAL_20_u1 99.60930000000001 _CNV_R_R_Def_f_ub_b_586_CM 0. 99.60930000000001 FORMAT "%5.2" /end CHARACTERISTIC
/begin CHARACTERISTIC K_LKLPS_MN "Min. Schwelle B_lklps rücksetzen" VALUE 0xa081b20d _REC_VAL_20_u1 99.60930000000001 _CNV_R_R_Def_f_ub_b_586_CM 0. 99.60930000000001 FORMAT "%5.2" /end CHARACTERISTIC
/begin CHARACTERISTIC K_LKLPS_MX "Max. Schwelle B_lklps setzen" VALUE 0xa081b20e _REC_VAL_20_u1 99.60930000000001 _CNV_R_R_Def_f_ub_b_586_CM 0. 99.60930000000001 FORMAT "%5.2" /end CHARACTERISTIC
/begin CHARACTERISTIC K_MAT_BAZW "Zuordnung Eingang Ba-Umschaltung zu Betriebsart" VAL_BLK 0xa081b650 _REC_VAL_2_u1 1. _CNV_R_R_Def_dez_sl_551_CM 1. 2. FORMAT "%3.0" NUMBER 8 /end CHARACTERISTIC
/begin CHARACTERISTIC K_MAT_BHZ "Vektor für Schaltung Heizleistungsteigerung (gedrosselter Betrieb)" VAL_BLK 0xa081b218 _REC_VAL_2_u1 99.45 _CNV_R_R_Def_dez_sl_551_CM 0. 255. FORMAT "%3.0" NUMBER 12 /end CHARACTERISTIC
/begin CHARACTERISTIC K_MAT_EGS "Vektor für Schaltung Getriebeeingriff" VAL_BLK 0xa081b224 _REC_VAL_2_u1 99.45 _CNV_R_R_Def_dez_sl_551_CM 0. 255. FORMAT "%3.0" NUMBER 12 /end CHARACTERISTIC
/begin CHARACTERISTIC K_MAT_ELUEFT "Vektor für Schaltung E-Lüfter" VAL_BLK 0xa081b230 _REC_VAL_2_u1 99.45 _CNV_R_R_Def_dez_sl_551_CM 0. 255. FORMAT "%3.0" NUMBER 12 /end CHARACTERISTIC
/begin CHARACTERISTIC K_MAT_EWP "Vektor für Schaltung EWP" VAL_BLK 0xa081b23c _REC_VAL_2_u1 99.45 _CNV_R_R_Def_dez_sl_551_CM 0. 255. FORMAT "%3.0" NUMBER 12 /end CHARACTERISTIC
/begin CHARACTERISTIC K_MAT_KFT "Vektor für Schaltung KFT" VAL_BLK 0xa081b248 _REC_VAL_2_u1 99.45 _CNV_R_R_Def_dez_sl_551_CM 0. 255. FORMAT "%3.0" NUMBER 12 /end CHARACTERISTIC
/begin CHARACTERISTIC K_MAT_LKLPS "Vektor für Schaltung Luftklappe" VAL_BLK 0xa081b260 _REC_VAL_2_u1 99.45 _CNV_R_R_Def_dez_sl_551_CM 0. 255. FORMAT "%3.0" NUMBER 12 /end CHARACTERISTIC
/begin CHARACTERISTIC K_MAT_LKLPS1 "Vektor für Schaltung Luftklappe1" VAL_BLK 0xa081b254 _REC_VAL_2_u1 99.45 _CNV_R_R_Def_dez_sl_551_CM 0. 255. FORMAT "%3.0" NUMBER 12 /end CHARACTERISTIC
/begin CHARACTERISTIC K_MAT_MDAC "Vektor für Schaltung Klima-Reduzierung" VAL_BLK 0xa081b26c _REC_VAL_2_u1 99.45 _CNV_R_R_Def_dez_sl_551_CM 0. 255. FORMAT "%3.0" NUMBER 12 /end CHARACTERISTIC
/begin CHARACTERISTIC K_MAT_MDRED "Vektor für Schaltung Leistungsreduzierung" VAL_BLK 0xa081b278 _REC_VAL_2_u1 99.45 _CNV_R_R_Def_dez_sl_551_CM 0. 255. FORMAT "%3.0" NUMBER 12 /end CHARACTERISTIC
/begin CHARACTERISTIC K_MAT_MDRES "Vektor für Schaltung Heizleistungsteigerung (Momentenreserve)" VAL_BLK 0xa081b284 _REC_VAL_2_u1 99.45 _CNV_R_R_Def_dez_sl_551_CM 0. 255. FORMAT "%3.0" NUMBER 12 /end CHARACTERISTIC
/begin CHARACTERISTIC K_MAT_RFKR "Zuordnung Eingang Ba-Umschaltung zu Betriebsart" VAL_BLK 0xa081c4e4 _REC_VAL_2_u1 2. _CNV_R_R_Def_dez_sl_551_CM 1. 3. FORMAT "%3.0" NUMBER 8 /end CHARACTERISTIC
/begin CHARACTERISTIC K_MAT_WARN1 "Vektor für Schaltung gelbe Warnlampe" VAL_BLK 0xa081b290 _REC_VAL_2_u1 99.45 _CNV_R_R_Def_dez_sl_551_CM 0. 255. FORMAT "%3.0" NUMBER 12 /end CHARACTERISTIC
/begin CHARACTERISTIC K_MAT_WARN2 "Vektor für Schaltung rote Warnlampe" VAL_BLK 0xa081b29c _REC_VAL_2_u1 99.45 _CNV_R_R_Def_dez_sl_551_CM 0. 255. FORMAT "%3.0" NUMBER 12 /end CHARACTERISTIC
/begin CHARACTERISTIC K_MAT_WARN3 "Vektor für Schaltung Meldung Hochschalten" VAL_BLK 0xa081b2a8 _REC_VAL_2_u1 99.45 _CNV_R_R_Def_dez_sl_551_CM 0. 255. FORMAT "%3.0" NUMBER 12 /end CHARACTERISTIC
/begin CHARACTERISTIC K_MAT_ZWDYN "Zuordnung Eingang Ba-Umschaltung zu Betriebsart" VAL_BLK 0xa081c4ec _REC_VAL_2_u1 2. _CNV_R_R_Def_dez_sl_551_CM 1. 3. FORMAT "%3.0" NUMBER 8 /end CHARACTERISTIC
/begin CHARACTERISTIC K_MAT_ZWSTAT "Zuordnung Eingang Ba-Umschaltung zu Betriebsart" VAL_BLK 0xa081c4f4 _REC_VAL_2_u1 2. _CNV_R_R_Def_dez_sl_551_CM 1. 3. FORMAT "%3.0" NUMBER 8 /end CHARACTERISTIC
/begin CHARACTERISTIC K_MDKLIMA_AP "Applikationskonstante für Klima-Reduzierung" VALUE 0xa081b1c8 _REC_VAL_20_s2 131.07 _CNV_R_R_Def_m_sw_q_554_CM -3276.8 3276.7 FORMAT "%5.2" /end CHARACTERISTIC
/begin CHARACTERISTIC K_MDKUEHL_AP "Applikationskonstante für Leistungsreduzierung (Moment)" VALUE 0xa081b1ca _REC_VAL_20_s2 131.07 _CNV_R_R_Def_m_sw_q_554_CM -3276.8 3276.7 FORMAT "%5.2" /end CHARACTERISTIC
/begin CHARACTERISTIC K_MDRES_AP "Applikationskonstante für Heizlestungssteigerung (Momenst)" VALUE 0xa081b1cc _REC_VAL_20_s2 131.07 _CNV_R_R_Def_m_sw_q_554_CM -3276.8 3276.7 FORMAT "%5.2" /end CHARACTERISTIC
/begin CHARACTERISTIC K_MMI_ZEIT1 "Zeit1 für Unterdrückung Warnlampe1 nach Motorstart" VALUE 0xa081b1f6 _REC_VAL_20_u2 131.07 _CNV_R_R_Def_td_uw__718_CM 0. 13107. FORMAT "%4.1" /end CHARACTERISTIC
/begin CHARACTERISTIC K_MMI_ZEIT2 "Zeit2  für Unterdrückung Warnlampe2 nach Motorstart" VALUE 0xa081b1f8 _REC_VAL_20_u2 131.07 _CNV_R_R_Def_td_uw__718_CM 0. 13107. FORMAT "%4.1" /end CHARACTERISTIC
/begin CHARACTERISTIC K_NEL_AP "Applikationskonstante für E-Lüfter-Sollwert" VALUE 0xa081b20f _REC_VAL_20_u1 99.60930000000001 _CNV_R_R_Def_f_ub_b_586_CM 0. 99.60930000000001 FORMAT "%5.2" /end CHARACTERISTIC
/begin CHARACTERISTIC K_NEL_NTLKS "E-Lüfter Sollwert für BA Notfall" VALUE 0xa081b210 _REC_VAL_20_u1 99.60930000000001 _CNV_R_R_Def_f_ub_b_586_CM 0. 99.60930000000001 FORMAT "%5.2" /end CHARACTERISTIC
/begin CHARACTERISTIC K_NLEWPMX "Max. EWAPU-Sollwert für Nachlauf und Wake-up" VALUE 0xa081b634 _REC_VAL_20_u1 99.45 _CNV_R_R_Def_dez_sl_551_CM 0. 255. FORMAT "%3.0" /end CHARACTERISTIC
/begin CHARACTERISTIC K_NLKFTMX "Max. KFT-Sollwert im Nachlauf" VALUE 0xa081b628 _REC_VAL_20_s2 98.30250000000001 _CNV_R_R_Def_t_sw_q_579_CM -327.68 327.67 FORMAT "%5.2" /end CHARACTERISTIC
/begin CHARACTERISTIC K_NTLKWS_AP "Applikationskonstante für Getriebeeingriff" VALUE 0xa081b211 _REC_VAL_20_u1 1. _CNV_R_R_Def_dez_sl_551_CM 0. 1. FORMAT "%3.0" /end CHARACTERISTIC
/begin CHARACTERISTIC K_NTLKWS_V "Schwellwert für Freischaltung B_ntlkws über Geschwindigkeit" VALUE 0xa081b1fa _REC_VAL_20_u2 0. _CNV_R_R_Def_v_uw_q_726_CM 0. 65535. FORMAT "%5.0" /end CHARACTERISTIC
/begin CHARACTERISTIC K_QSNLZAEHL "Zählervorgabe für Qs_anf_klima im Nachlauf und Wake-up" VALUE 0xa081b632 _REC_VAL_20_u2 0. _CNV_R_R_Def_dez_sl_551_CM 0. 65535. FORMAT "%5.0" /end CHARACTERISTIC
/begin CHARACTERISTIC K_RESTDELAY "Verzögerungszeit für Qs_anf_klima" VALUE 0xa081b635 _REC_VAL_20_u1 25.5 _CNV_R_R_Def_td_ub__574_CM 0. 25.5 FORMAT "%4.1" /end CHARACTERISTIC
/begin CHARACTERISTIC K_TDRFSOLGD "Verzögerungschritte Rf_soll gedrosselt" VALUE 0xa081c4e2 _REC_VAL_20_u1 15. _CNV_R_R_Def_dez_sl_551_CM 0. 15. FORMAT "%3.0" /end CHARACTERISTIC
/begin CHARACTERISTIC K_TD_DZWDYNDEC "Zeit zw. 2 Dekrementen zur Verländerung Abregelzeit von Dzwdyn" VALUE 0xa081c4fc _REC_VAL_20_u1 2.55 _CNV_R_R_Def_td_uw__673_CM 0. 2.55 FORMAT "%5.2" /end CHARACTERISTIC
/begin CHARACTERISTIC K_TMOT_ELUE "Freigabeschwelle Tmot für Nachlauf Elüfter" VALUE 0xa081b636 _REC_VAL_20_s2 98.30250000000001 _CNV_R_R_Def_t_sw_q_579_CM -327.68 327.67 FORMAT "%5.2" /end CHARACTERISTIC
/begin CHARACTERISTIC K_TMOT_EWP "Freigabeschwelle Tmot für Nachlauf EWP" VALUE 0xa081b62a _REC_VAL_20_s2 98.30250000000001 _CNV_R_R_Def_t_sw_q_579_CM -327.68 327.67 FORMAT "%5.2" /end CHARACTERISTIC
/begin CHARACTERISTIC K_TMWARNMN "Rücknahme Tmot Schwelle für Warnlampen bei E-Lüfter-Fehler" VALUE 0xa081b1ce _REC_VAL_20_s2 98.30250000000001 _CNV_R_R_Def_t_sw_q_579_CM -327.68 327.67 FORMAT "%5.2" /end CHARACTERISTIC
/begin CHARACTERISTIC K_TMWARN_1 "Schwelle für Tmot gelbe Warnlampe" VALUE 0xa081b1d0 _REC_VAL_20_s2 98.30250000000001 _CNV_R_R_Def_t_sw_q_579_CM -327.68 327.67 FORMAT "%5.2" /end CHARACTERISTIC
/begin CHARACTERISTIC K_TMWARN_2 "Schwelle für Tmot rote Warnlampe" VALUE 0xa081b1d2 _REC_VAL_20_s2 98.30250000000001 _CNV_R_R_Def_t_sw_q_579_CM -327.68 327.67 FORMAT "%5.2" /end CHARACTERISTIC
/begin CHARACTERISTIC K_TMWARN_HYS "Hysterese für Tmot, Rücknahme Warnlampen" VALUE 0xa081b1d4 _REC_VAL_20_s2 98.30250000000001 _CNV_R_R_Def_t_sw_q_579_CM -327.68 327.67 FORMAT "%5.2" /end CHARACTERISTIC
/begin CHARACTERISTIC K_TOEL_ELUE "Freigabeschwelle Toel für Nachlauf E-Lüfter" VALUE 0xa081b638 _REC_VAL_20_s2 131.07 _CNV_R_R_Def_t_sw_q_578_CM -3276.8 3276.7 FORMAT "%4.1" /end CHARACTERISTIC
/begin CHARACTERISTIC K_TOEL_EWP "Freigabeschwelle Toel für Nachlauf EWP" VALUE 0xa081b62c _REC_VAL_20_s2 131.07 _CNV_R_R_Def_t_sw_q_578_CM -3276.8 3276.7 FORMAT "%4.1" /end CHARACTERISTIC
/begin CHARACTERISTIC K_TOWARN_1 "Schwelle für Toel gelbe Warnlampe" VALUE 0xa081b1d6 _REC_VAL_20_s2 131.07 _CNV_R_R_Def_t_sw_q_578_CM -3276.8 3276.7 FORMAT "%4.1" /end CHARACTERISTIC
/begin CHARACTERISTIC K_TOWARN_2 "Schwelle für Toel rote Warnlampe" VALUE 0xa081b1d8 _REC_VAL_20_s2 131.07 _CNV_R_R_Def_t_sw_q_578_CM -3276.8 3276.7 FORMAT "%4.1" /end CHARACTERISTIC
/begin CHARACTERISTIC K_TOWARN_3 "Schwelle für Toel Meldung Hochschalten" VALUE 0xa081b1da _REC_VAL_20_s2 131.07 _CNV_R_R_Def_t_sw_q_578_CM -3276.8 3276.7 FORMAT "%4.1" /end CHARACTERISTIC
/begin CHARACTERISTIC K_TOWARN_HYS "Hysterese für Toel, Rücknahme Warnlampen" VALUE 0xa081b1dc _REC_VAL_20_s2 131.07 _CNV_R_R_Def_t_sw_q_578_CM -3276.8 3276.7 FORMAT "%4.1" /end CHARACTERISTIC
/begin CHARACTERISTIC K_WARN1_AP "Applikationskonstante für gelbe Warnlampe" VALUE 0xa081b212 _REC_VAL_20_u1 1. _CNV_R_R_Def_dez_sl_551_CM 0. 1. FORMAT "%3.0" /end CHARACTERISTIC
/begin CHARACTERISTIC K_WARN2_AP "Applikationskonstante für rote Warnlampe" VALUE 0xa081b213 _REC_VAL_20_u1 1. _CNV_R_R_Def_dez_sl_551_CM 0. 1. FORMAT "%3.0" /end CHARACTERISTIC
/begin CHARACTERISTIC K_WARN3_AP "Applikationskonstante für rote Warnlampe" VALUE 0xa081b214 _REC_VAL_20_u1 1. _CNV_R_R_Def_dez_sl_551_CM 0. 1. FORMAT "%3.0" /end CHARACTERISTIC
/begin CHARACTERISTIC K_ZAEHLWE_UG "Zähler Übergang Betriebsart, weich" VALUE 0xa081b59c _REC_VAL_20_u2 0. _CNV_R_R_Def_dez_sl_551_CM 0. 65535. FORMAT "%5.0" /end CHARACTERISTIC
/begin CHARACTERISTIC K_ZAEHL_UG "Zähler Übergang Betriebsart, hart" VALUE 0xa081b59e _REC_VAL_20_u2 0. _CNV_R_R_Def_dez_sl_551_CM 0. 65535. FORMAT "%5.0" /end CHARACTERISTIC
/begin CHARACTERISTIC K_ZKRFSOLGD "Zeitkonstante für Rf_soll-filter (gedrosselt)" VALUE 0xa081c4fe _REC_VAL_20_u2 655.35 _CNV_R_R_Def_zk10ms_715_CM 1.e-002 655.36 FORMAT "%7.4" /end CHARACTERISTIC
/begin CHARACTERISTIC K_ZWAPPL "Zündwinkeloffset für Applikation" VALUE 0xa081e5fc _REC_VAL_20_s2 100.1 _CNV_R_R_Def_zw_sw__604_CM -50. 60. FORMAT "%4.1" /end CHARACTERISTIC
/begin CHARACTERISTIC K_ZWAPPL_ZYL "Zündwinkeloffset zylinderselektiv für Applikation" VAL_BLK 0xa081e600 _REC_VAL_2_s2 100.1 _CNV_R_R_Def_zw_sw__604_CM -50. 60. FORMAT "%4.1" NUMBER 8 /end CHARACTERISTIC
/begin CHARACTERISTIC K_ZWAPP_HS "Applikationszündwinkel (homogen-schicht)" VALUE 0xa081d728 _REC_VAL_20_s2 100.1 _CNV_R_R_Def_zw_sw__604_CM -50. 60. FORMAT "%4.1" /end CHARACTERISTIC
/begin CHARACTERISTIC K_ZWAPP_S "Applikationszündwinkel (schicht)" VALUE 0xa081d726 _REC_VAL_20_s2 100.1 _CNV_R_R_Def_zw_sw__604_CM -50. 60. FORMAT "%4.1" /end CHARACTERISTIC
/begin CHARACTERISTIC K_ZWHZINI "Rampenstartwert für Einblendfaktor ZW-Eingriff Heizleistungssteigerung" VALUE 0xa081c4e1 _REC_VAL_20_u1 0.996 _CNV_R_R_Def_f_ub_b_553_CM 0. 0.996 /end CHARACTERISTIC
/begin CHARACTERISTIC K_ZWHZRAMP "Rampensteigung für ZW-Eingriff Heizleistung" VALUE 0xa081c4e0 _REC_VAL_20_u1 0.996 _CNV_R_R_Def_f_ub_b_553_CM 0. 0.996 /end CHARACTERISTIC
/begin CHARACTERISTIC K_ZWMINHYS_HS "Hysterese für Bedingung ZW-Spätgrenze durch KR unterschritten (homogen-schicht)" VALUE 0xa081d72a _REC_VAL_20_s2 100.1 _CNV_R_R_Def_zw_sw__604_CM -50. 60. FORMAT "%4.1" /end CHARACTERISTIC
/begin CHARACTERISTIC S_DRFFLANKEIN "Schalter zum Einschalten Flankenerkennung B_trigin" VALUE 0xa081c4df _REC_VAL_20_u1 1. _CNV_R_R_Def_dez_sl_551_CM 0. 1. FORMAT "%3.0" /end CHARACTERISTIC
/begin CHARACTERISTIC S_DYNVH_RF "Schalter Grundzündwinkeldynamik Rf-Modellierung über Rf anstatt Rf_solkrvf" VALUE 0xa081c4dd _REC_VAL_20_u1 99.45 _CNV_R_R_Def_dez_sl_551_CM 0. 255. FORMAT "%3.0" /end CHARACTERISTIC
/begin CHARACTERISTIC S_EL_GEN "Schalter zur Deaktivierung Generator Anforderung E-Lüfter " VALUE 0xa081b215 _REC_VAL_20_u1 1. _CNV_R_R_Def_dez_sl_551_CM 0. 1. FORMAT "%3.0" /end CHARACTERISTIC
/begin CHARACTERISTIC S_KKS "Schalter Klappenauswahl" VALUE 0xa081b216 _REC_VAL_20_u1 1. _CNV_R_R_Def_dez_sl_551_CM 0. 1. FORMAT "%3.0" /end CHARACTERISTIC
/begin CHARACTERISTIC S_ZWAPP_HS "Applikationszündwinkel (homogen-schicht)" VALUE 0xa081d721 _REC_VAL_20_u1 1. _CNV_R_R_Def_dez_sl_551_CM 0. 1. FORMAT "%3.0" /end CHARACTERISTIC
/begin CHARACTERISTIC S_ZWAPP_S "Schalter für Applikationszündwinkel (schicht)" VALUE 0xa081d720 _REC_VAL_20_u1 1. _CNV_R_R_Def_dez_sl_551_CM 0. 1. FORMAT "%3.0" /end CHARACTERISTIC
/begin CHARACTERISTIC S_ZWDYNRETRIG "Schalter zum Einschalten der Retriggerung von B_zwdyn " VALUE 0xa081c4de _REC_VAL_20_u1 1. _CNV_R_R_Def_dez_sl_551_CM 0. 1. FORMAT "%3.0" /end CHARACTERISTIC
/begin MEASUREMENT tia_im "Air temperatrure in the intake manifold" UBYTE _CNV_A_R_LINEAR_____17_CM 1 100. -48. 142.5 DISPLAY_IDENTIFIER TIA_IM ECU_ADDRESS 0xd0008649 FORMAT "%6.2" /end MEASUREMENT
/begin MEASUREMENT lv_err_tia_im "Boolean for error currently present which might affect temperature TIA_IM (after debounce)" UBYTE _CNV_S_2_RANGE__0___1_CM 1 100. 0. 1. DISPLAY_IDENTIFIER LV_ERR_TIA_IM ECU_ADDRESS 0xd0008648 BIT_MASK 0x1 /end MEASUREMENT
/begin AXIS_PTS ldpm_tqi_req_tra_1_extc "" 0xa0805b00 tqi_req_tra _REC_AXS_20_u2 1023.96875 _CNV_A_R_LINEAR_____31_CM 6 0. 1023.96875 FORMAT "%7.2" /end AXIS_PTS
/begin AXIS_PTS ldpm_tqi_req_tra_2_extc "" 0xa0805b10 tqi_req_tra _REC_AXS_20_u2 1023.96875 _CNV_A_R_LINEAR_____31_CM 6 0. 1023.96875 FORMAT "%7.2" /end AXIS_PTS
/begin AXIS_PTS ldpm_mff_post_inj_1_extc "" 0xa0805958 online_dummy _REC_AXS_20_u2 1389. _CNV_A_R_LINEAR_____111_CM 6 0. 1389. FORMAT "%7.2" /end AXIS_PTS
/begin AXIS_PTS ldpm_temp_cat_dif_ch_l_1_extc "" 0xa0805aac temp_cat_dif_ch_l _REC_AXS_20_u2 2047.96875 _CNV_A_R_LINEAR_____781_CM 6 -1024. 1023.96875 FORMAT "%11.5" /end AXIS_PTS
/begin AXIS_PTS ldpm_tnt_dif_ch_l_1_extc "" 0xa0805ac8 tnt_dif_ch_l _REC_AXS_20_u2 2047.96875 _CNV_A_R_LINEAR_____781_CM 6 -1024. 1023.96875 FORMAT "%11.5" /end AXIS_PTS
/begin AXIS_PTS ldpm_n_32_7_extc "" 0xa08059ea n_32 _REC_AXS_20_u1 8160. _CNV_A_R_LINEAR_____10_CM 6 0. 8160. FORMAT "%4.0" /end AXIS_PTS
/begin AXIS_PTS ldpm_n_32_8_extc "" 0xa08059f4 n_32 _REC_AXS_20_u1 8160. _CNV_A_R_LINEAR_____10_CM 8 0. 8160. FORMAT "%4.0" /end AXIS_PTS
/begin AXIS_PTS ldpm_maf_1_extc "" 0xa0805934 maf _REC_AXS_20_u2 1389. _CNV_A_R_LINEAR_____111_CM 6 0. 1389. FORMAT "%7.2" /end AXIS_PTS
/begin AXIS_PTS ldpm_maf_2_extc "" 0xa0805944 maf _REC_AXS_20_u2 1389. _CNV_A_R_LINEAR_____111_CM 8 0. 1389. FORMAT "%7.2" /end AXIS_PTS
/begin AXIS_PTS ldpm_fac_maf_rel_egr_cor_1_extc "" 0xa08058d4 fac_maf_rel_egr_cor _REC_AXS_20_u2 300. _CNV_A_R_LINEAR_____226_CM 10 0. 300. FORMAT "%5.1" /end AXIS_PTS
/begin AXIS_PTS ldpm_t_ast_1_extc "IVVT   strategy request for after start catalyst heating with single injection" 0xa0805a34 t_ast _REC_AXS_20_u2 6553.5 _CNV_A_R_LINEAR_____4_CM 8 0. 6553.5 FORMAT "%6.1" /end AXIS_PTS
/begin AXIS_PTS ldpm_mff_sp_mv_1_extc "" 0xa0805968 mff_sp_mv _REC_AXS_20_u2 1389. _CNV_A_R_LINEAR_____111_CM 6 0. 1389. FORMAT "%7.2" /end AXIS_PTS
/begin AXIS_PTS ldpm_mff_sp_mv_2_extc "" 0xa0805978 mff_sp_mv _REC_AXS_20_u2 1389. _CNV_A_R_LINEAR_____111_CM 6 0. 1389. FORMAT "%7.2" /end AXIS_PTS
/begin AXIS_PTS ldpm_n_32_6_extc "" 0xa08059e2 n_32 _REC_AXS_20_u1 8160. _CNV_A_R_LINEAR_____10_CM 6 0. 8160. FORMAT "%4.0" /end AXIS_PTS
/begin AXIS_PTS ldpm_n_32_2_extc "" 0xa08059ca n_32 _REC_AXS_20_u1 8160. _CNV_A_R_LINEAR_____10_CM 6 0. 8160. FORMAT "%4.0" /end AXIS_PTS
/begin AXIS_PTS ldpm_n_32_3_extc "" 0xa08059d2 n_32 _REC_AXS_20_u1 8160. _CNV_A_R_LINEAR_____10_CM 6 0. 8160. FORMAT "%4.0" /end AXIS_PTS
/begin AXIS_PTS ldpm_n_32_5_extc "" 0xa08059da n_32 _REC_AXS_20_u1 8160. _CNV_A_R_LINEAR_____10_CM 6 0. 8160. FORMAT "%4.0" /end AXIS_PTS
/begin AXIS_PTS ldpm_ctr_km_can_1_extc "Threshold of time after start for catalyst heating after start" 0xa08058c8 ctr_km_can _REC_AXS_20_u2 655350. _CNV_A_R_LINEAR_____58_CM 4 0. 655350. FORMAT "%6.0" /end AXIS_PTS
/begin AXIS_PTS ldpm_tco_st_4_extc "" 0xa0805a9a tco_st _REC_AXS_20_u1 190.5 _CNV_A_R_LINEAR_____17_CM 6 -48. 142.5 FORMAT "%6.2" /end AXIS_PTS
/begin AXIS_PTS ldpm_tco_st_5_extc "" 0xa0805aa2 tco_st _REC_AXS_20_u1 190.5 _CNV_A_R_LINEAR_____17_CM 6 -48. 142.5 FORMAT "%6.2" /end AXIS_PTS
/begin AXIS_PTS ldpm_fac_maf_rel_egr_cor_4_extc "" 0xa080591c fac_maf_rel_egr_cor _REC_AXS_20_u2 300. _CNV_A_R_LINEAR_____226_CM 10 0. 300. FORMAT "%5.1" /end AXIS_PTS
/begin AXIS_PTS ldpm_fac_maf_rel_egr_cor_2_extc "" 0xa08058ec fac_maf_rel_egr_cor _REC_AXS_20_u2 300. _CNV_A_R_LINEAR_____226_CM 10 0. 300. FORMAT "%5.1" /end AXIS_PTS
/begin AXIS_PTS ldpm_fac_maf_rel_egr_cor_3_extc "" 0xa0805904 fac_maf_rel_egr_cor _REC_AXS_20_u2 300. _CNV_A_R_LINEAR_____226_CM 10 0. 300. FORMAT "%5.1" /end AXIS_PTS
/begin AXIS_PTS ldpm_tco_5_extc "IVVT   strategy request for after start catalyst heating with single injection" 0xa0805a84 tco _REC_AXS_20_u1 190.5 _CNV_A_R_LINEAR_____17_CM 8 -48. 142.5 FORMAT "%6.2" /end AXIS_PTS
/begin AXIS_PTS ldpm_tco_6_extc "IVVT   strategy request for after start catalyst heating with single injection" 0xa0805a90 tco _REC_AXS_20_u1 190.5 _CNV_A_R_LINEAR_____17_CM 8 -48. 142.5 FORMAT "%6.2" /end AXIS_PTS
/begin AXIS_PTS ldpm_t_ast_4_extc "IVVT   strategy request for after start catalyst heating with single injection" 0xa0805a48 t_ast _REC_AXS_20_u2 6553.5 _CNV_A_R_LINEAR_____4_CM 8 0. 6553.5 FORMAT "%6.1" /end AXIS_PTS
/begin AXIS_PTS ldpm_t_ast_6_extc "IVVT   strategy request for after start catalyst heating with single injection" 0xa0805a70 t_ast _REC_AXS_20_u2 6553.5 _CNV_A_R_LINEAR_____4_CM 8 0. 6553.5 FORMAT "%6.1" /end AXIS_PTS
/begin MEASUREMENT iga_dif_s_ch "Ignition angle difference for stratified catalyst heating with post injection" UBYTE _CNV_A_R_LINEAR_____190_CM 1 100. -35.625 60. DISPLAY_IDENTIFIER IGA_DIF_S_CH ECU_ADDRESS 0xd00075dd FORMAT "%7.3" /end MEASUREMENT
/begin CHARACTERISTIC lc_iga_dif_s_ch_man_act "Activation of manual setting of ignition angle difference for stratified catalyst heating with post injection" VALUE 0xa0805fba _REC_VAL_20_u1 1. _CNV_A_R_LINEAR_____0_CM 0. 1. DISPLAY_IDENTIFIER LC_IGA_DIF_S_CH_MAN_ACT FORMAT "%1.0" /end CHARACTERISTIC
/begin CHARACTERISTIC c_iga_dif_s_ch_man "Manual setting of ignition angle difference for stratified catalyst heating with post injection" VALUE 0xa0805f4c _REC_VAL_20_u1 95.625 _CNV_A_R_LINEAR_____190_CM -35.625 60. DISPLAY_IDENTIFIER C_IGA_DIF_S_CH_MAN FORMAT "%7.3" /end CHARACTERISTIC
/begin AXIS_PTS ldp_mff_post_ip_iga_dif_ch_l "" 0xa0805788 online_dummy _REC_AXS_20_u2 1389. _CNV_A_R_LINEAR_____111_CM 6 0. 1389. FORMAT "%7.2" /end AXIS_PTS
/begin CHARACTERISTIC ip_iga_dif_add_mff_post_ch_l "Mass of post injection depending correction for ignition anlge difference for low load catalyst heating" CURVE 0xa0805e28 _REC_CUR_20_u1_u2 95.625 _CNV_A_R_LINEAR_____190_CM -35.625 60. DISPLAY_IDENTIFIER IP_IGA_DIF_ADD_MFF_POST_CH_L FORMAT "%7.3"
 /begin AXIS_DESCR COM_AXIS online_dummy _CNV_A_R_LINEAR_____111_CM 6 0. 1389. FORMAT "%7.2" AXIS_PTS_REF ldp_mff_post_ip_iga_dif_ch_l /end AXIS_DESCR
/end CHARACTERISTIC
/begin CHARACTERISTIC ip_iga_dif_s_ch_l_bas "Ignition angle difference for stratified low load catalyst heating with post injection" MAP 0xa0810920 _REC_MAP_20_u2_u1_u2 1440. _CNV_A_R_LINEAR_____787_CM -720. 720. DISPLAY_IDENTIFIER IP_IGA_DIF_S_CH_L_BAS FORMAT "%6.1"
 /begin AXIS_DESCR COM_AXIS n_32 _CNV_A_R_LINEAR_____10_CM 6 0. 8160. FORMAT "%4.0" AXIS_PTS_REF ldpm_n_32_6_extc /end AXIS_DESCR
 /begin AXIS_DESCR COM_AXIS mff_sp_mv _CNV_A_R_LINEAR_____111_CM 6 0. 1389. FORMAT "%7.2" AXIS_PTS_REF ldpm_mff_sp_mv_2_extc /end AXIS_DESCR
/end CHARACTERISTIC
/begin CHARACTERISTIC ip_iga_dif_s_ch_ast_bas "Ignition angle difference for stratified catalyst heating with post injection" MAP 0xa08108d8 _REC_MAP_20_u2_u1_u2 1440. _CNV_A_R_LINEAR_____787_CM -720. 720. DISPLAY_IDENTIFIER IP_IGA_DIF_S_CH_AST_BAS FORMAT "%6.1"
 /begin AXIS_DESCR COM_AXIS n_32 _CNV_A_R_LINEAR_____10_CM 6 0. 8160. FORMAT "%4.0" AXIS_PTS_REF ldpm_n_32_2_extc /end AXIS_DESCR
 /begin AXIS_DESCR COM_AXIS mff_sp_mv _CNV_A_R_LINEAR_____111_CM 6 0. 1389. FORMAT "%7.2" AXIS_PTS_REF ldpm_mff_sp_mv_1_extc /end AXIS_DESCR
/end CHARACTERISTIC
/begin MEASUREMENT lamb_sp_ch[0] "Lambda setpoint for catalyst heating - bankselective" UWORD _CNV_A_R_LINEAR_____129_CM 1 100. 0. 31.9990234375 DISPLAY_IDENTIFIER LAMB_SP_CH[0] ECU_ADDRESS 0xd000687c FORMAT "%7.4" /end MEASUREMENT
/begin MEASUREMENT lamb_sp_ch[1] "Lambda setpoint for catalyst heating - bankselective" UWORD _CNV_A_R_LINEAR_____129_CM 1 100. 0. 31.9990234375 DISPLAY_IDENTIFIER LAMB_SP_CH[1] ECU_ADDRESS 0xd000687e FORMAT "%7.4" /end MEASUREMENT
/begin CHARACTERISTIC ip_lamb_ch_ast_hom "Lambda setpoint for homogeneous catalyst heating" MAP 0xa0810a68 _REC_MAP_20_u2_u1_u2 31.9990234375 _CNV_A_R_LINEAR_____129_CM 0. 31.9990234375 DISPLAY_IDENTIFIER IP_LAMB_CH_AST_HOM FORMAT "%7.4"
 /begin AXIS_DESCR COM_AXIS n_32 _CNV_A_R_LINEAR_____10_CM 6 0. 8160. FORMAT "%4.0" AXIS_PTS_REF ldpm_n_32_10_extc /end AXIS_DESCR
 /begin AXIS_DESCR COM_AXIS tqi_req_slow _CNV_A_R_LINEAR_____87_CM 6 -1024. 1023.96875 FORMAT "%11.5" AXIS_PTS_REF ldpm_tqi_req_slow_3_extc /end AXIS_DESCR
/end CHARACTERISTIC
/begin CHARACTERISTIC ip_lamb_ch_ast_hom_is "Lambda setpoint for homogeneous catalyst heating in idle speed" MAP 0xa0805e30 _REC_MAP_20_u2_u1_u2 31.9990234375 _CNV_A_R_LINEAR_____129_CM 0. 31.9990234375 DISPLAY_IDENTIFIER IP_LAMB_CH_AST_HOM_IS FORMAT "%7.4"
 /begin AXIS_DESCR COM_AXIS n_32 _CNV_A_R_LINEAR_____10_CM 4 0. 8160. FORMAT "%4.0" AXIS_PTS_REF ldpm_n_32_9_extc /end AXIS_DESCR
 /begin AXIS_DESCR COM_AXIS tqi_req_slow _CNV_A_R_LINEAR_____87_CM 4 -1024. 1023.96875 FORMAT "%11.5" AXIS_PTS_REF ldpm_tqi_req_slow_4_extc /end AXIS_DESCR
/end CHARACTERISTIC
/begin CHARACTERISTIC ip_lamb_add_ch_ast_hom "T_AST and TCO depending additional correction for lambda setpoint for catalyst heating" MAP 0xa0810968 _REC_MAP_20_u2_u2_u1 31.999023 _CNV_A_R_LINEAR_____788_CM -16. 15.999023 DISPLAY_IDENTIFIER IP_LAMB_ADD_CH_AST_HOM FORMAT "%8.4"
 /begin AXIS_DESCR COM_AXIS t_ast _CNV_A_R_LINEAR_____4_CM 8 0. 6553.5 FORMAT "%6.1" AXIS_PTS_REF ldpm_t_ast_4_extc /end AXIS_DESCR
 /begin AXIS_DESCR COM_AXIS tco _CNV_A_R_LINEAR_____17_CM 8 -48. 142.5 FORMAT "%6.2" AXIS_PTS_REF ldpm_tco_5_extc /end AXIS_DESCR
/end CHARACTERISTIC
/begin CHARACTERISTIC ip_lamb_add_ch_ast_mplh "T_AST and TCO depending additional correction for lambda setpoint for catalyst heating with dual injection" MAP 0xa08109e8 _REC_MAP_20_u2_u2_u1 31.999023 _CNV_A_R_LINEAR_____788_CM -16. 15.999023 DISPLAY_IDENTIFIER IP_LAMB_ADD_CH_AST_MPLH FORMAT "%8.4"
 /begin AXIS_DESCR COM_AXIS t_ast _CNV_A_R_LINEAR_____4_CM 8 0. 6553.5 FORMAT "%6.1" AXIS_PTS_REF ldpm_t_ast_4_extc /end AXIS_DESCR
 /begin AXIS_DESCR COM_AXIS tco _CNV_A_R_LINEAR_____17_CM 8 -48. 142.5 FORMAT "%6.2" AXIS_PTS_REF ldpm_tco_5_extc /end AXIS_DESCR
/end CHARACTERISTIC
/begin CHARACTERISTIC ip_lamb_ch_ast_mplh_is "Lambda setpoint for homogeneous catalyst heating with dual injection in idle speed" MAP 0xa0805e50 _REC_MAP_20_u2_u1_u2 31.9990234375 _CNV_A_R_LINEAR_____129_CM 0. 31.9990234375 DISPLAY_IDENTIFIER IP_LAMB_CH_AST_MPLH_IS FORMAT "%7.4"
 /begin AXIS_DESCR COM_AXIS n_32 _CNV_A_R_LINEAR_____10_CM 4 0. 8160. FORMAT "%4.0" AXIS_PTS_REF ldpm_n_32_9_extc /end AXIS_DESCR
 /begin AXIS_DESCR COM_AXIS tqi_req_slow _CNV_A_R_LINEAR_____87_CM 4 -1024. 1023.96875 FORMAT "%11.5" AXIS_PTS_REF ldpm_tqi_req_slow_4_extc /end AXIS_DESCR
/end CHARACTERISTIC
/begin CHARACTERISTIC ip_lamb_ch_ast_mplh "Lambda setpoint for homogeneous catalyst heating with dual injection" MAP 0xa0810ab0 _REC_MAP_20_u2_u1_u2 31.9990234375 _CNV_A_R_LINEAR_____129_CM 0. 31.9990234375 DISPLAY_IDENTIFIER IP_LAMB_CH_AST_MPLH FORMAT "%7.4"
 /begin AXIS_DESCR COM_AXIS n_32 _CNV_A_R_LINEAR_____10_CM 6 0. 8160. FORMAT "%4.0" AXIS_PTS_REF ldpm_n_32_10_extc /end AXIS_DESCR
 /begin AXIS_DESCR COM_AXIS tqi_req_slow _CNV_A_R_LINEAR_____87_CM 6 -1024. 1023.96875 FORMAT "%11.5" AXIS_PTS_REF ldpm_tqi_req_slow_3_extc /end AXIS_DESCR
/end CHARACTERISTIC
/begin MEASUREMENT lamb_sp_ch_so2p[0] "Lambda setpoint for catalyst heating   bankselective, during desulfation" UWORD _CNV_A_R_LINEAR_____129_CM 1 100. 0. 31.9990234375 DISPLAY_IDENTIFIER LAMB_SP_CH_SO2P[0] ECU_ADDRESS 0xd0006880 FORMAT "%7.4" /end MEASUREMENT
/begin MEASUREMENT lamb_sp_ch_so2p[1] "Lambda setpoint for catalyst heating   bankselective, during desulfation" UWORD _CNV_A_R_LINEAR_____129_CM 1 100. 0. 31.9990234375 DISPLAY_IDENTIFIER LAMB_SP_CH_SO2P[1] ECU_ADDRESS 0xd0006882 FORMAT "%7.4" /end MEASUREMENT
/begin CHARACTERISTIC c_lamb_sp_ch_man[0] "manual setting of lambda setpoint for catalyst heating   bankselective" VALUE 0xa0805f4e _REC_VAL_20_u2 31.9990234375 _CNV_A_R_LINEAR_____129_CM 0. 31.9990234375 DISPLAY_IDENTIFIER C_LAMB_SP_CH_MAN[0] FORMAT "%7.4" /end CHARACTERISTIC
/begin CHARACTERISTIC c_lamb_sp_ch_man[1] "manual setting of lambda setpoint for catalyst heating   bankselective" VALUE 0xa0805f50 _REC_VAL_20_u2 31.9990234375 _CNV_A_R_LINEAR_____129_CM 0. 31.9990234375 DISPLAY_IDENTIFIER C_LAMB_SP_CH_MAN[1] FORMAT "%7.4" /end CHARACTERISTIC
/begin CHARACTERISTIC lc_lamb_sp_ch_man_act "Activation of manual setting of LAMB_SP_CH" VALUE 0xa0805fbd _REC_VAL_20_u1 1. _CNV_S_2_RANGE__0___1_CM 0. 1. DISPLAY_IDENTIFIER LC_LAMB_SP_CH_MAN_ACT /end CHARACTERISTIC
/begin CHARACTERISTIC lc_lamb_sp_ch_so2p_man_act "Activation of manual setting of LAMB_SP_CH_SO2P" VALUE 0xa0805fbe _REC_VAL_20_u1 1. _CNV_S_2_RANGE__0___1_CM 0. 1. DISPLAY_IDENTIFIER LC_LAMB_SP_CH_SO2P_MAN_ACT /end CHARACTERISTIC
/begin CHARACTERISTIC lc_lamb_so2p_fast_ena "Enables using of LAMB_SO2P in case of LV_SO2P_FAST_REQ (fast desulfation without wobble)" VALUE 0xa0805fbc _REC_VAL_20_u1 1. _CNV_S_2_RANGE__0___1_CM 0. 1. DISPLAY_IDENTIFIER LC_LAMB_SO2P_FAST_ENA /end CHARACTERISTIC
/begin AXIS_PTS ldpm_n_32_10_extc "" 0xa08059c2 n_32 _REC_AXS_20_u1 8160. _CNV_A_R_LINEAR_____10_CM 6 0. 8160. FORMAT "%4.0" /end AXIS_PTS
/begin AXIS_PTS ldpm_n_32_9_extc "" 0xa08059fe n_32 _REC_AXS_20_u1 8160. _CNV_A_R_LINEAR_____10_CM 4 0. 8160. FORMAT "%4.0" /end AXIS_PTS
/begin AXIS_PTS ldpm_tqi_req_slow_3_extc "" 0xa0805ae4 tqi_req_slow _REC_AXS_20_u2 2047.96875 _CNV_A_R_LINEAR_____87_CM 6 -1024. 1023.96875 FORMAT "%11.5" /end AXIS_PTS
/begin AXIS_PTS ldpm_tqi_req_slow_4_extc "" 0xa0805af4 tqi_req_slow _REC_AXS_20_u2 2047.96875 _CNV_A_R_LINEAR_____87_CM 4 -1024. 1023.96875 FORMAT "%11.5" /end AXIS_PTS
/begin CHARACTERISTIC ip_mff_sp_2_add_iga_ch "Ignition angle depending correction of fuel mass for second injection pulse" CURVE 0xa0805e7c _REC_CUR_20_u2_u2 1389. _CNV_A_R_LINEAR_____789_CM -694.5 694.5 DISPLAY_IDENTIFIER IP_MFF_SP_2_ADD_IGA_CH FORMAT "%7.2"
 /begin AXIS_DESCR COM_AXIS iga_av_mv_h_rng _CNV_A_R_LINEAR_____132_CM 4 -90. 90. FORMAT "%8.4" AXIS_PTS_REF ldp_iga_h_rng_ip_mff_2_mplh_ch /end AXIS_DESCR
/end CHARACTERISTIC
/begin MEASUREMENT mff_sp_2_mplh_ch "Fuel mass for second injection pulse" UWORD _CNV_A_R_LINEAR_____111_CM 1 100. 0. 1389. DISPLAY_IDENTIFIER MFF_SP_2_MPLH_CH ECU_ADDRESS 0xd0006898 FORMAT "%7.2" /end MEASUREMENT
/begin CHARACTERISTIC c_mff_sp_2_mplh_ch_man "Manual setting of fuel mass for second injection pulse" VALUE 0xa0805f58 _REC_VAL_20_u2 1389. _CNV_A_R_LINEAR_____111_CM 0. 1389. DISPLAY_IDENTIFIER C_MFF_SP_2_MPLH_CH_MAN FORMAT "%7.2" /end CHARACTERISTIC
/begin CHARACTERISTIC lc_mff_sp_2_mplh_ch_man_act "Activation of manual setting of fuel mass for second injection pulse" VALUE 0xa0805fc1 _REC_VAL_20_u1 1. _CNV_S_2_RANGE__0___1_CM 0. 1. DISPLAY_IDENTIFIER LC_MFF_SP_2_MPLH_CH_MAN_ACT /end CHARACTERISTIC
/begin CHARACTERISTIC ip_mff_sp_2_mplh_ch_ast "Basic fuel mass for second injection pulse" MAP 0xa0810c00 _REC_MAP_20_u2_u1_u2 1389. _CNV_A_R_LINEAR_____111_CM 0. 1389. DISPLAY_IDENTIFIER IP_MFF_SP_2_MPLH_CH_AST FORMAT "%7.2"
 /begin AXIS_DESCR COM_AXIS n_32 _CNV_A_R_LINEAR_____10_CM 6 0. 8160. FORMAT "%4.0" AXIS_PTS_REF ldpm_n_32_7_extc /end AXIS_DESCR
 /begin AXIS_DESCR COM_AXIS maf _CNV_A_R_LINEAR_____111_CM 6 0. 1389. FORMAT "%7.2" AXIS_PTS_REF ldpm_maf_1_extc /end AXIS_DESCR
/end CHARACTERISTIC
/begin CHARACTERISTIC ip_mff_sp_2_mplh_ch_so2p "Fuel mass for second injection pulse in desulfation catalyst heating" MAP 0xa0810c48 _REC_MAP_20_u2_u1_u2 1389. _CNV_A_R_LINEAR_____111_CM 0. 1389. DISPLAY_IDENTIFIER IP_MFF_SP_2_MPLH_CH_SO2P FORMAT "%7.2"
 /begin AXIS_DESCR COM_AXIS n_32 _CNV_A_R_LINEAR_____10_CM 8 0. 8160. FORMAT "%4.0" AXIS_PTS_REF ldpm_n_32_8_extc /end AXIS_DESCR
 /begin AXIS_DESCR COM_AXIS maf _CNV_A_R_LINEAR_____111_CM 8 0. 1389. FORMAT "%7.2" AXIS_PTS_REF ldpm_maf_2_extc /end AXIS_DESCR
/end CHARACTERISTIC
/begin AXIS_PTS ldp_iga_h_rng_ip_mff_2_mplh_ch "Ignition angle depending correction of fuel mass for second injection pulse" 0xa0805734 iga_av_mv_h_rng _REC_AXS_20_u2 180. _CNV_A_R_LINEAR_____132_CM 4 -90. 90. FORMAT "%8.4" /end AXIS_PTS
/begin CHARACTERISTIC ip_soi_1_ch_add_tco "Additive value for end of 1st injection related to ignition angle depending on coolant temperature" CURVE 0xa0805ed4 _REC_CUR_20_u2_u1 1440. _CNV_A_R_LINEAR_____787_CM -720. 720. DISPLAY_IDENTIFIER IP_SOI_1_CH_ADD_TCO FORMAT "%6.1"
 /begin AXIS_DESCR COM_AXIS tco _CNV_A_R_LINEAR_____17_CM 6 -48. 142.5 FORMAT "%6.2" AXIS_PTS_REF ldp_tco_ip_soi_1_ch_add_tco /end AXIS_DESCR
/end CHARACTERISTIC
/begin AXIS_PTS ldp_tco_ip_soi_1_ch_add_tco "" 0xa080582e tco _REC_AXS_20_u1 190.5 _CNV_A_R_LINEAR_____17_CM 6 -48. 142.5 FORMAT "%6.2" /end AXIS_PTS
/begin CHARACTERISTIC c_soi_1_mplh_ch_man "Manual setting of start of injection for catalyst heating" VALUE 0xa0805f64 _REC_VAL_20_u2 720. _CNV_A_R_LINEAR_____200_CM 0. 720. DISPLAY_IDENTIFIER C_SOI_1_MPLH_CH_MAN FORMAT "%7.3" /end CHARACTERISTIC
/begin CHARACTERISTIC lc_soi_1_mplh_ch_man_act "Activation of manual setting of start of injection for catalyst heating" VALUE 0xa0805fc2 _REC_VAL_20_u1 1. _CNV_A_R_LINEAR_____0_CM 0. 1. DISPLAY_IDENTIFIER LC_SOI_1_MPLH_CH_MAN_ACT FORMAT "%1.0" /end CHARACTERISTIC
/begin CHARACTERISTIC ip_soi_1_mplh_ch_ast "Basic start of injection for CH" MAP 0xa0810f08 _REC_MAP_20_u2_u1_u2 720. _CNV_A_R_LINEAR_____200_CM 0. 720. DISPLAY_IDENTIFIER IP_SOI_1_MPLH_CH_AST FORMAT "%7.3"
 /begin AXIS_DESCR COM_AXIS n_32 _CNV_A_R_LINEAR_____10_CM 6 0. 8160. FORMAT "%4.0" AXIS_PTS_REF ldpm_n_32_7_extc /end AXIS_DESCR
 /begin AXIS_DESCR COM_AXIS maf _CNV_A_R_LINEAR_____111_CM 6 0. 1389. FORMAT "%7.2" AXIS_PTS_REF ldpm_maf_1_extc /end AXIS_DESCR
/end CHARACTERISTIC
/begin MEASUREMENT soi_1_mplh_ch[0] "start of injection for catalyst heating" UWORD _CNV_A_R_LINEAR_____200_CM 1 100. 0. 720. DISPLAY_IDENTIFIER SOI_1_MPLH_CH[0] ECU_ADDRESS 0xd000689c FORMAT "%7.3" /end MEASUREMENT
/begin MEASUREMENT soi_1_mplh_ch[1] "start of injection for catalyst heating" UWORD _CNV_A_R_LINEAR_____200_CM 1 100. 0. 720. DISPLAY_IDENTIFIER SOI_1_MPLH_CH[1] ECU_ADDRESS 0xd000689e FORMAT "%7.3" /end MEASUREMENT
/begin MEASUREMENT soi_1_mplh_ch[2] "start of injection for catalyst heating" UWORD _CNV_A_R_LINEAR_____200_CM 1 100. 0. 720. DISPLAY_IDENTIFIER SOI_1_MPLH_CH[2] ECU_ADDRESS 0xd00068a0 FORMAT "%7.3" /end MEASUREMENT
/begin MEASUREMENT soi_1_mplh_ch[3] "start of injection for catalyst heating" UWORD _CNV_A_R_LINEAR_____200_CM 1 100. 0. 720. DISPLAY_IDENTIFIER SOI_1_MPLH_CH[3] ECU_ADDRESS 0xd00068a2 FORMAT "%7.3" /end MEASUREMENT
/begin MEASUREMENT soi_1_mplh_ch[4] "start of injection for catalyst heating" UWORD _CNV_A_R_LINEAR_____200_CM 1 100. 0. 720. DISPLAY_IDENTIFIER SOI_1_MPLH_CH[4] ECU_ADDRESS 0xd00068a4 FORMAT "%7.3" /end MEASUREMENT
/begin MEASUREMENT soi_1_mplh_ch[5] "start of injection for catalyst heating" UWORD _CNV_A_R_LINEAR_____200_CM 1 100. 0. 720. DISPLAY_IDENTIFIER SOI_1_MPLH_CH[5] ECU_ADDRESS 0xd00068a6 FORMAT "%7.3" /end MEASUREMENT
/begin MEASUREMENT soi_1_mplh_ch[6] "start of injection for catalyst heating" UWORD _CNV_A_R_LINEAR_____200_CM 1 100. 0. 720. DISPLAY_IDENTIFIER SOI_1_MPLH_CH[6] ECU_ADDRESS 0xd00068a8 FORMAT "%7.3" /end MEASUREMENT
/begin MEASUREMENT soi_1_mplh_ch[7] "start of injection for catalyst heating" UWORD _CNV_A_R_LINEAR_____200_CM 1 100. 0. 720. DISPLAY_IDENTIFIER SOI_1_MPLH_CH[7] ECU_ADDRESS 0xd00068aa FORMAT "%7.3" /end MEASUREMENT
/begin CHARACTERISTIC ip_soi_1_mplh_ch_so2p "Basic start of injection for MPLH during catalyst heating for desulfation" MAP 0xa0810f50 _REC_MAP_20_u2_u1_u2 720. _CNV_A_R_LINEAR_____200_CM 0. 720. DISPLAY_IDENTIFIER IP_SOI_1_MPLH_CH_SO2P FORMAT "%7.3"
 /begin AXIS_DESCR COM_AXIS n_32 _CNV_A_R_LINEAR_____10_CM 8 0. 8160. FORMAT "%4.0" AXIS_PTS_REF ldpm_n_32_8_extc /end AXIS_DESCR
 /begin AXIS_DESCR COM_AXIS maf _CNV_A_R_LINEAR_____111_CM 8 0. 1389. FORMAT "%7.2" AXIS_PTS_REF ldpm_maf_2_extc /end AXIS_DESCR
/end CHARACTERISTIC
/begin CHARACTERISTIC c_eoi_2_delta_mplh_ch_man "Manual setting of end of injection of the second injection for catalyst heating" VALUE 0xa0805f3e _REC_VAL_20_u2 720. _CNV_A_R_LINEAR_____200_CM 0. 720. DISPLAY_IDENTIFIER C_EOI_2_DELTA_MPLH_CH_MAN FORMAT "%7.3" /end CHARACTERISTIC
/begin CHARACTERISTIC lc_eoi_2_delta_mplh_ch_man_act "Activation of manual setting of end of injection of the second injection for catalyst heating" VALUE 0xa0805fb9 _REC_VAL_20_u1 1. _CNV_A_R_LINEAR_____0_CM 0. 1. DISPLAY_IDENTIFIER LC_EOI_2_DELTA_MPLH_CH_MAN_ACT FORMAT "%1.0" /end CHARACTERISTIC
/begin AXIS_PTS ldp_mff_2_ip_eoi_2_mplh_ch_add "" 0xa0805778 mff_sp_2_mplh_ch _REC_AXS_20_u2 1389. _CNV_A_R_LINEAR_____111_CM 6 0. 1389. FORMAT "%7.2" /end AXIS_PTS
/begin CHARACTERISTIC ip_eoi_2_delta_mplh_ch_ast "End of 2nd injection -HOM_DUI-mode- related to ignition angle" MAP 0xa08106b8 _REC_MAP_20_u2_u1_u2 720. _CNV_A_R_LINEAR_____200_CM 0. 720. DISPLAY_IDENTIFIER IP_EOI_2_DELTA_MPLH_CH_AST FORMAT "%7.3"
 /begin AXIS_DESCR COM_AXIS n_32 _CNV_A_R_LINEAR_____10_CM 6 0. 8160. FORMAT "%4.0" AXIS_PTS_REF ldpm_n_32_7_extc /end AXIS_DESCR
 /begin AXIS_DESCR COM_AXIS maf _CNV_A_R_LINEAR_____111_CM 6 0. 1389. FORMAT "%7.2" AXIS_PTS_REF ldpm_maf_1_extc /end AXIS_DESCR
/end CHARACTERISTIC
/begin CHARACTERISTIC ip_eoi_2_mplh_ch_add_mff_2 "Additive value for end of 2nd injection related to ignition angle depending on coolant temperature" CURVE 0xa0805c30 _REC_CUR_20_u2_u2 1440. _CNV_A_R_LINEAR_____787_CM -720. 720. DISPLAY_IDENTIFIER IP_EOI_2_MPLH_CH_ADD_MFF_2 FORMAT "%6.1"
 /begin AXIS_DESCR COM_AXIS mff_sp_2_mplh_ch _CNV_A_R_LINEAR_____111_CM 6 0. 1389. FORMAT "%7.2" AXIS_PTS_REF ldp_mff_2_ip_eoi_2_mplh_ch_add /end AXIS_DESCR
/end CHARACTERISTIC
/begin MEASUREMENT eoi_2_delta_mplh_ch "End of injection of the second injection for catalyst heating" UWORD _CNV_A_R_LINEAR_____200_CM 1 100. 0. 720. DISPLAY_IDENTIFIER EOI_2_DELTA_MPLH_CH ECU_ADDRESS 0xd0006864 FORMAT "%7.3" /end MEASUREMENT
/begin CHARACTERISTIC ip_eoi_2_delta_mplh_ch_so2p "End of 2nd injection in desulfation catalyst heating in homogeneous with split injection- related to ignition angle" MAP 0xa0810700 _REC_MAP_20_u2_u1_u2 720. _CNV_A_R_LINEAR_____200_CM 0. 720. DISPLAY_IDENTIFIER IP_EOI_2_DELTA_MPLH_CH_SO2P FORMAT "%7.3"
 /begin AXIS_DESCR COM_AXIS n_32 _CNV_A_R_LINEAR_____10_CM 8 0. 8160. FORMAT "%4.0" AXIS_PTS_REF ldpm_n_32_8_extc /end AXIS_DESCR
 /begin AXIS_DESCR COM_AXIS maf _CNV_A_R_LINEAR_____111_CM 8 0. 1389. FORMAT "%7.2" AXIS_PTS_REF ldpm_maf_2_extc /end AXIS_DESCR
/end CHARACTERISTIC
/begin MEASUREMENT tq_add_ch "Torque reserve for catalyst heating" SWORD _CNV_A_R_LINEAR_____31_CM 1 100. -1024. 1023.96875 DISPLAY_IDENTIFIER TQ_ADD_CH ECU_ADDRESS 0xd00068d8 FORMAT "%11.5" /end MEASUREMENT
/begin CHARACTERISTIC c_tq_add_ch_hom_man "Manual setting of torque reserve for catalyst heating in homogeneous mode" VALUE 0xa0805f94 _REC_VAL_20_u2 1023.96875 _CNV_A_R_LINEAR_____31_CM 0. 1023.96875 DISPLAY_IDENTIFIER C_TQ_ADD_CH_HOM_MAN FORMAT "%7.2" /end CHARACTERISTIC
/begin CHARACTERISTIC lc_tq_add_ch_hom_man_act "Activation of manual setting of torque reserve for catalyst heating in homogeneous mode" VALUE 0xa0805fc7 _REC_VAL_20_u1 1. _CNV_A_R_LINEAR_____0_CM 0. 1. DISPLAY_IDENTIFIER LC_TQ_ADD_CH_HOM_MAN_ACT FORMAT "%1.0" /end CHARACTERISTIC
/begin CHARACTERISTIC lc_tq_add_ch_mplh_man_act "Activation of manual setting of torque reserve for catalyst heating in homogeneous mode, dual injection" VALUE 0xa0805fc8 _REC_VAL_20_u1 1. _CNV_A_R_LINEAR_____0_CM 0. 1. DISPLAY_IDENTIFIER LC_TQ_ADD_CH_MPLH_MAN_ACT FORMAT "%1.0" /end CHARACTERISTIC
/begin CHARACTERISTIC c_tq_add_ch_lgrd_on "Gradient for TQ_ADD_CH entry ramps" VALUE 0xa0805f9a _REC_VAL_20_u2 1023.96875 _CNV_A_R_LINEAR_____31_CM 0. 1023.96875 DISPLAY_IDENTIFIER C_TQ_ADD_CH_LGRD_ON FORMAT "%7.2" /end CHARACTERISTIC
/begin CHARACTERISTIC c_tq_add_ch_lgrd_off "Gradient for TQ_ADD_CH exit ramp" VALUE 0xa0805f98 _REC_VAL_20_u2 1023.96875 _CNV_A_R_LINEAR_____31_CM 0. 1023.96875 DISPLAY_IDENTIFIER C_TQ_ADD_CH_LGRD_OFF FORMAT "%7.2" /end CHARACTERISTIC
/begin CHARACTERISTIC ip_tq_add_ch_hom_is "Coolant temperature and time after start depending correction TQ_ADD_CH" MAP 0xa08110f0 _REC_MAP_20_u2_u1_u2 2047.96875 _CNV_A_R_LINEAR_____87_CM -1024. 1023.96875 DISPLAY_IDENTIFIER IP_TQ_ADD_CH_HOM_IS FORMAT "%11.5"
 /begin AXIS_DESCR COM_AXIS n_32 _CNV_A_R_LINEAR_____10_CM 6 0. 8160. FORMAT "%4.0" AXIS_PTS_REF ldpm_n_32_5_extc /end AXIS_DESCR
 /begin AXIS_DESCR COM_AXIS tqi_req_tra _CNV_A_R_LINEAR_____31_CM 6 0. 1023.96875 FORMAT "%7.2" AXIS_PTS_REF ldpm_tqi_req_tra_2_extc /end AXIS_DESCR
/end CHARACTERISTIC
/begin CHARACTERISTIC ip_tq_add_ch_mplh_is "Basic torque increase for catalyst heating for homogeneous split" MAP 0xa0811258 _REC_MAP_20_u2_u1_u2 2047.96875 _CNV_A_R_LINEAR_____87_CM -1024. 1023.96875 DISPLAY_IDENTIFIER IP_TQ_ADD_CH_MPLH_IS FORMAT "%11.5"
 /begin AXIS_DESCR COM_AXIS n_32 _CNV_A_R_LINEAR_____10_CM 6 0. 8160. FORMAT "%4.0" AXIS_PTS_REF ldpm_n_32_5_extc /end AXIS_DESCR
 /begin AXIS_DESCR COM_AXIS tqi_req_tra _CNV_A_R_LINEAR_____31_CM 6 0. 1023.96875 FORMAT "%7.2" AXIS_PTS_REF ldpm_tqi_req_tra_2_extc /end AXIS_DESCR
/end CHARACTERISTIC
/begin CHARACTERISTIC c_tq_add_ch_mplh_man "Manual setting of torque reserve for catalyst heating in homogeneous mode with dual injection" VALUE 0xa0805f9c _REC_VAL_20_u2 1023.96875 _CNV_A_R_LINEAR_____31_CM 0. 1023.96875 DISPLAY_IDENTIFIER C_TQ_ADD_CH_MPLH_MAN FORMAT "%7.2" /end CHARACTERISTIC
/begin CHARACTERISTIC c_tq_add_ch_l_lgrd "Limitation gradient for torque reserve in low load cat. heating" VALUE 0xa0805f96 _REC_VAL_20_u2 1023.96875 _CNV_A_R_LINEAR_____31_CM 0. 1023.96875 DISPLAY_IDENTIFIER C_TQ_ADD_CH_L_LGRD FORMAT "%7.2" /end CHARACTERISTIC
/begin CHARACTERISTIC ip_fac_tq_add_ch_l "Difference between cat. temperatures and target temp. depending correction for TQ_ADD_CH_L" MAP 0xa0810848 _REC_MAP_20_u2_u2_u2 1.99996948242188 _CNV_A_R_LINEAR_____9_CM 0. 1.99996948242188 DISPLAY_IDENTIFIER IP_FAC_TQ_ADD_CH_L FORMAT "%7.5"
 /begin AXIS_DESCR COM_AXIS temp_cat_dif_ch_l _CNV_A_R_LINEAR_____781_CM 6 -1024. 1023.96875 FORMAT "%11.5" AXIS_PTS_REF ldpm_temp_cat_dif_ch_l_1_extc /end AXIS_DESCR
 /begin AXIS_DESCR COM_AXIS tnt_dif_ch_l _CNV_A_R_LINEAR_____781_CM 6 -1024. 1023.96875 FORMAT "%11.5" AXIS_PTS_REF ldpm_tnt_dif_ch_l_1_extc /end AXIS_DESCR
/end CHARACTERISTIC
/begin AXIS_PTS ldp_n_32_ip_tq_add_ch_l "" 0xa08057ae n_32 _REC_AXS_20_u1 8160. _CNV_A_R_LINEAR_____10_CM 6 0. 8160. FORMAT "%4.0" /end AXIS_PTS
/begin AXIS_PTS ldp_n_32_ip_tq_add_ch_l_is "" 0xa08057b6 n_32 _REC_AXS_20_u1 8160. _CNV_A_R_LINEAR_____10_CM 6 0. 8160. FORMAT "%4.0" /end AXIS_PTS
/begin AXIS_PTS ldp_tqi_req_ip_tq_add_ch_l "" 0xa0805878 tqi_req_tra _REC_AXS_20_u2 1023.96875 _CNV_A_R_LINEAR_____31_CM 6 0. 1023.96875 FORMAT "%7.2" /end AXIS_PTS
/begin AXIS_PTS ldp_tqi_req_ip_tq_add_ch_l_is "" 0xa0805888 tqi_req_tra _REC_AXS_20_u2 1023.96875 _CNV_A_R_LINEAR_____31_CM 6 0. 1023.96875 FORMAT "%7.2" /end AXIS_PTS
/begin CHARACTERISTIC ip_tq_add_ch_l_hom_is "Torque reserve for low load catalyst heating in idle speed" MAP 0xa0811180 _REC_MAP_20_u2_u1_u2 2047.96875 _CNV_A_R_LINEAR_____87_CM -1024. 1023.96875 DISPLAY_IDENTIFIER IP_TQ_ADD_CH_L_HOM_IS FORMAT "%11.5"
 /begin AXIS_DESCR COM_AXIS n_32 _CNV_A_R_LINEAR_____10_CM 6 0. 8160. FORMAT "%4.0" AXIS_PTS_REF ldp_n_32_ip_tq_add_ch_l_is /end AXIS_DESCR
 /begin AXIS_DESCR COM_AXIS tqi_req_tra _CNV_A_R_LINEAR_____31_CM 6 0. 1023.96875 FORMAT "%7.2" AXIS_PTS_REF ldp_tqi_req_ip_tq_add_ch_l_is /end AXIS_DESCR
/end CHARACTERISTIC
/begin CHARACTERISTIC ip_tq_add_so2p_pctl "Precontrolled torque reserve for desulfation catalyst heating" MAP 0xa08112e8 _REC_MAP_20_u2_u1_u2 2047.96875 _CNV_A_R_LINEAR_____87_CM -1024. 1023.96875 DISPLAY_IDENTIFIER IP_TQ_ADD_SO2P_PCTL FORMAT "%11.5"
 /begin AXIS_DESCR COM_AXIS n_32 _CNV_A_R_LINEAR_____10_CM 6 0. 8160. FORMAT "%4.0" AXIS_PTS_REF ldp_n_32_ip_tq_so2p_pctl /end AXIS_DESCR
 /begin AXIS_DESCR COM_AXIS tqi_req_tra _CNV_A_R_LINEAR_____31_CM 6 0. 1023.96875 FORMAT "%7.2" AXIS_PTS_REF ldp_tqi_req_tra_ip_tq_so2p_pctl /end AXIS_DESCR
/end CHARACTERISTIC
/begin AXIS_PTS ldp_n_32_ip_tq_so2p_pctl "" 0xa08057c6 n_32 _REC_AXS_20_u1 8160. _CNV_A_R_LINEAR_____10_CM 6 0. 8160. FORMAT "%4.0" /end AXIS_PTS
/begin AXIS_PTS ldp_tqi_req_tra_ip_tq_so2p_pctl "" 0xa08058b8 tqi_req_tra _REC_AXS_20_u2 1023.96875 _CNV_A_R_LINEAR_____31_CM 6 0. 1023.96875 FORMAT "%7.2" /end AXIS_PTS
/begin MEASUREMENT tq_add_so2p "Torque reserve for desulfation catalyst heating" SWORD _CNV_A_R_LINEAR_____31_CM 1 100. -1024. 1023.96875 DISPLAY_IDENTIFIER TQ_ADD_SO2P ECU_ADDRESS 0xd00068da FORMAT "%8.2" /end MEASUREMENT
/begin MEASUREMENT tq_add_so2p_i "I share of torque reserve for desulfation catalyst heating" SWORD _CNV_A_R_LINEAR_____790_CM 1 100. -128. 127.9960938 DISPLAY_IDENTIFIER TQ_ADD_SO2P_I ECU_ADDRESS 0xd00068dc FORMAT "%11.5" /end MEASUREMENT
/begin MEASUREMENT tq_add_so2p_p "P share of torque reserve for desulfation catalyst heating" SWORD _CNV_A_R_LINEAR_____790_CM 1 100. -128. 127.9960938 DISPLAY_IDENTIFIER TQ_ADD_SO2P_P ECU_ADDRESS 0xd00068de FORMAT "%11.5" /end MEASUREMENT
/begin MEASUREMENT tq_add_so2p_pctl "Precontrolled torque reserve for desulfation catalyst heating" UWORD _CNV_A_R_LINEAR_____87_CM 1 100. -1024. 1023.96875 DISPLAY_IDENTIFIER TQ_ADD_SO2P_PCTL ECU_ADDRESS 0xd00068e0 FORMAT "%11.5" /end MEASUREMENT
/begin CHARACTERISTIC c_fac_tq_add_so2p_pctl_mplh "factor to weigh the precontrolled torque reserve in case of homogen split   mode" VALUE 0xa0805f42 _REC_VAL_20_u2 31.9990234375 _CNV_A_R_LINEAR_____129_CM 0. 31.9990234375 DISPLAY_IDENTIFIER C_FAC_TQ_ADD_SO2P_PCTL_MPLH FORMAT "%7.4" /end CHARACTERISTIC
/begin CHARACTERISTIC c_tq_add_so2p_i "Correlation constant for the I share of the controller" VALUE 0xa0805f9e _REC_VAL_20_u2 0.9999847412109381 _CNV_A_R_LINEAR_____791_CM 0. 0.9999847412109381 DISPLAY_IDENTIFIER C_TQ_ADD_SO2P_I FORMAT "%11.5" /end CHARACTERISTIC
/begin CHARACTERISTIC c_tq_add_so2p_i_max "Maximium of the I share of the controller" VALUE 0xa0805fa0 _REC_VAL_20_s2 127.997 _CNV_A_R_LINEAR_____792_CM 0. 127.997 DISPLAY_IDENTIFIER C_TQ_ADD_SO2P_I_MAX FORMAT "%11.5" /end CHARACTERISTIC
/begin CHARACTERISTIC c_tq_add_so2p_p "Correlation constant for the P share of the controller" VALUE 0xa0805fa2 _REC_VAL_20_u2 1.99996948242188 _CNV_A_R_LINEAR_____793_CM 0. 1.99996948242188 DISPLAY_IDENTIFIER C_TQ_ADD_SO2P_P FORMAT "%11.5" /end CHARACTERISTIC
/begin CHARACTERISTIC c_tq_add_so2p_p_max "Maximium of the P share of the controller" VALUE 0xa0805fa4 _REC_VAL_20_s2 127.997 _CNV_A_R_LINEAR_____792_CM 0. 127.997 DISPLAY_IDENTIFIER C_TQ_ADD_SO2P_P_MAX FORMAT "%11.5" /end CHARACTERISTIC
/begin CHARACTERISTIC c_tq_add_so2p_ramp_dec "Ramp gradient for gradual decrease of the torque reserve" VALUE 0xa0805fa6 _REC_VAL_20_u2 255.99609375 _CNV_A_R_LINEAR_____794_CM 0. 255.99609375 DISPLAY_IDENTIFIER C_TQ_ADD_SO2P_RAMP_DEC FORMAT "%11.5" /end CHARACTERISTIC
/begin CHARACTERISTIC c_tq_add_so2p_ramp_inc "Ramp gradient for gradual increase of the torque reserve" VALUE 0xa0805fa8 _REC_VAL_20_u2 255.99609375 _CNV_A_R_LINEAR_____794_CM 0. 255.99609375 DISPLAY_IDENTIFIER C_TQ_ADD_SO2P_RAMP_INC FORMAT "%11.5" /end CHARACTERISTIC
/begin AXIS_PTS ldp_tco_st_ip_fac_tq_add_ch_amp "" 0xa0805848 tco_st _REC_AXS_20_u1 190.5 _CNV_A_R_LINEAR_____17_CM 8 -48. 142.5 FORMAT "%6.2" /end AXIS_PTS
/begin AXIS_PTS ldp_amp_ip_fac_tq_add_ch_amp "" 0xa08056e0 amp _REC_AXS_20_u2 5434.25976563 _CNV_A_R_LINEAR_____146_CM 6 0. 5434.25976563 FORMAT "%7.2" /end AXIS_PTS
/begin CHARACTERISTIC ip_fac_tq_add_ch_amp "Reduction of torque reserve due to ambient pressure" MAP 0xa0805cec _REC_MAP_20_u1_u1_u2 0.99609375 _CNV_A_R_LINEAR_____28_CM 0. 0.99609375 DISPLAY_IDENTIFIER IP_FAC_TQ_ADD_CH_AMP FORMAT "%5.3"
 /begin AXIS_DESCR COM_AXIS tco_st _CNV_A_R_LINEAR_____17_CM 8 -48. 142.5 FORMAT "%6.2" AXIS_PTS_REF ldp_tco_st_ip_fac_tq_add_ch_amp /end AXIS_DESCR
 /begin AXIS_DESCR COM_AXIS amp _CNV_A_R_LINEAR_____146_CM 6 0. 5434.25976563 FORMAT "%7.2" AXIS_PTS_REF ldp_amp_ip_fac_tq_add_ch_amp /end AXIS_DESCR
/end CHARACTERISTIC
/begin MEASUREMENT tq_add_so2p_raw "Torque reserve for desulfation catalyst heating   in high resolution" SLONG _CNV_A_R_LINEAR_____795_CM 1 100. -1024. 1024. DISPLAY_IDENTIFIER TQ_ADD_SO2P_RAW ECU_ADDRESS 0xd0005fe0 FORMAT "%7.3" /end MEASUREMENT
/begin AXIS_PTS ldp_n_32_ip_tq_so2p_max "" 0xa08057be n_32 _REC_AXS_20_u1 8160. _CNV_A_R_LINEAR_____10_CM 6 0. 8160. FORMAT "%4.0" /end AXIS_PTS
/begin AXIS_PTS ldp_tqi_req_tra_ip_tq_so2p_max "" 0xa08058a8 tqi_req_tra _REC_AXS_20_u2 1023.96875 _CNV_A_R_LINEAR_____31_CM 6 0. 1023.96875 FORMAT "%7.2" /end AXIS_PTS
/begin CHARACTERISTIC ip_tq_add_so2p_max "Maximum torque reserve for desulfation catalyst heating" MAP 0xa08112a0 _REC_MAP_20_u2_u1_u2 2047.96875 _CNV_A_R_LINEAR_____87_CM -1024. 1023.96875 DISPLAY_IDENTIFIER IP_TQ_ADD_SO2P_MAX FORMAT "%11.5"
 /begin AXIS_DESCR COM_AXIS n_32 _CNV_A_R_LINEAR_____10_CM 6 0. 8160. FORMAT "%4.0" AXIS_PTS_REF ldp_n_32_ip_tq_so2p_max /end AXIS_DESCR
 /begin AXIS_DESCR COM_AXIS tqi_req_tra _CNV_A_R_LINEAR_____31_CM 6 0. 1023.96875 FORMAT "%7.2" AXIS_PTS_REF ldp_tqi_req_tra_ip_tq_so2p_max /end AXIS_DESCR
/end CHARACTERISTIC
/begin CHARACTERISTIC ip_fac_tq_add_ch_hom "Coolant temperature and time after start depending correction TQ_ADD_CH" MAP 0xa0805d20 _REC_MAP_20_u1_u2_u1 0.99609375 _CNV_A_R_LINEAR_____28_CM 0. 0.99609375 DISPLAY_IDENTIFIER IP_FAC_TQ_ADD_CH_HOM FORMAT "%5.3"
 /begin AXIS_DESCR COM_AXIS t_ast _CNV_A_R_LINEAR_____4_CM 8 0. 6553.5 FORMAT "%6.1" AXIS_PTS_REF ldpm_t_ast_1_extc /end AXIS_DESCR
 /begin AXIS_DESCR COM_AXIS tco_st _CNV_A_R_LINEAR_____17_CM 6 -48. 142.5 FORMAT "%6.2" AXIS_PTS_REF ldpm_tco_st_4_extc /end AXIS_DESCR
/end CHARACTERISTIC
/begin CHARACTERISTIC ip_fac_tq_add_ch_hom_at "Coolant temperature and time after start depending correction TQ_ADD_CH, for AT" MAP 0xa0805d50 _REC_MAP_20_u1_u2_u1 0.99609375 _CNV_A_R_LINEAR_____28_CM 0. 0.99609375 DISPLAY_IDENTIFIER IP_FAC_TQ_ADD_CH_HOM_AT FORMAT "%5.3"
 /begin AXIS_DESCR COM_AXIS t_ast _CNV_A_R_LINEAR_____4_CM 8 0. 6553.5 FORMAT "%6.1" AXIS_PTS_REF ldpm_t_ast_1_extc /end AXIS_DESCR
 /begin AXIS_DESCR COM_AXIS tco_st _CNV_A_R_LINEAR_____17_CM 6 -48. 142.5 FORMAT "%6.2" AXIS_PTS_REF ldpm_tco_st_4_extc /end AXIS_DESCR
/end CHARACTERISTIC
/begin CHARACTERISTIC ip_fac_tq_add_ch_mplh "Coolant temperature and time after start depending correction TQ_ADD_CH_HSP" MAP 0xa0805da4 _REC_MAP_20_u1_u2_u1 0.99609375 _CNV_A_R_LINEAR_____28_CM 0. 0.99609375 DISPLAY_IDENTIFIER IP_FAC_TQ_ADD_CH_MPLH FORMAT "%5.3"
 /begin AXIS_DESCR COM_AXIS t_ast _CNV_A_R_LINEAR_____4_CM 8 0. 6553.5 FORMAT "%6.1" AXIS_PTS_REF ldpm_t_ast_1_extc /end AXIS_DESCR
 /begin AXIS_DESCR COM_AXIS tco_st _CNV_A_R_LINEAR_____17_CM 6 -48. 142.5 FORMAT "%6.2" AXIS_PTS_REF ldpm_tco_st_4_extc /end AXIS_DESCR
/end CHARACTERISTIC
/begin CHARACTERISTIC ip_fac_tq_add_ch_mplh_at "Coolant temperature and time after start depending correction TQ_ADD_CH_HSP, for AT" MAP 0xa0805dd4 _REC_MAP_20_u1_u2_u1 0.99609375 _CNV_A_R_LINEAR_____28_CM 0. 0.99609375 DISPLAY_IDENTIFIER IP_FAC_TQ_ADD_CH_MPLH_AT FORMAT "%5.3"
 /begin AXIS_DESCR COM_AXIS t_ast _CNV_A_R_LINEAR_____4_CM 8 0. 6553.5 FORMAT "%6.1" AXIS_PTS_REF ldpm_t_ast_1_extc /end AXIS_DESCR
 /begin AXIS_DESCR COM_AXIS tco_st _CNV_A_R_LINEAR_____17_CM 6 -48. 142.5 FORMAT "%6.2" AXIS_PTS_REF ldpm_tco_st_4_extc /end AXIS_DESCR
/end CHARACTERISTIC
/begin CHARACTERISTIC ip_tq_add_ch_l_hom "Basic torque increase for homogeneous low load catalyst heating" MAP 0xa0811138 _REC_MAP_20_u2_u1_u2 2047.96875 _CNV_A_R_LINEAR_____87_CM -1024. 1023.96875 DISPLAY_IDENTIFIER IP_TQ_ADD_CH_L_HOM FORMAT "%11.5"
 /begin AXIS_DESCR COM_AXIS n_32 _CNV_A_R_LINEAR_____10_CM 6 0. 8160. FORMAT "%4.0" AXIS_PTS_REF ldp_n_32_ip_tq_add_ch_l /end AXIS_DESCR
 /begin AXIS_DESCR COM_AXIS tqi_req_tra _CNV_A_R_LINEAR_____31_CM 6 0. 1023.96875 FORMAT "%7.2" AXIS_PTS_REF ldp_tqi_req_ip_tq_add_ch_l /end AXIS_DESCR
/end CHARACTERISTIC
/begin CHARACTERISTIC ip_tq_add_ch_hom_at "Basic torque reverse for homogeneous catalyst heating with automatic transmission" MAP 0xa08110a8 _REC_MAP_20_u2_u1_u2 2047.96875 _CNV_A_R_LINEAR_____87_CM -1024. 1023.96875 DISPLAY_IDENTIFIER IP_TQ_ADD_CH_HOM_AT FORMAT "%11.5"
 /begin AXIS_DESCR COM_AXIS n_32 _CNV_A_R_LINEAR_____10_CM 6 0. 8160. FORMAT "%4.0" AXIS_PTS_REF ldpm_n_32_3_extc /end AXIS_DESCR
 /begin AXIS_DESCR COM_AXIS tqi_req_tra _CNV_A_R_LINEAR_____31_CM 6 0. 1023.96875 FORMAT "%7.2" AXIS_PTS_REF ldpm_tqi_req_tra_1_extc /end AXIS_DESCR
/end CHARACTERISTIC
/begin CHARACTERISTIC ip_tq_add_ch_mplh "Basic torque increase for catalyst heating at homogeneous split injection" MAP 0xa08111c8 _REC_MAP_20_u2_u1_u2 2047.96875 _CNV_A_R_LINEAR_____87_CM -1024. 1023.96875 DISPLAY_IDENTIFIER IP_TQ_ADD_CH_MPLH FORMAT "%11.5"
 /begin AXIS_DESCR COM_AXIS n_32 _CNV_A_R_LINEAR_____10_CM 6 0. 8160. FORMAT "%4.0" AXIS_PTS_REF ldpm_n_32_3_extc /end AXIS_DESCR
 /begin AXIS_DESCR COM_AXIS tqi_req_tra _CNV_A_R_LINEAR_____31_CM 6 0. 1023.96875 FORMAT "%7.2" AXIS_PTS_REF ldpm_tqi_req_tra_1_extc /end AXIS_DESCR
/end CHARACTERISTIC
/begin CHARACTERISTIC ip_tq_add_ch_mplh_at "Basic torque increase for catalyst heating at homogeneous split injection with automatic transmission" MAP 0xa0811210 _REC_MAP_20_u2_u1_u2 2047.96875 _CNV_A_R_LINEAR_____87_CM -1024. 1023.96875 DISPLAY_IDENTIFIER IP_TQ_ADD_CH_MPLH_AT FORMAT "%11.5"
 /begin AXIS_DESCR COM_AXIS n_32 _CNV_A_R_LINEAR_____10_CM 6 0. 8160. FORMAT "%4.0" AXIS_PTS_REF ldpm_n_32_3_extc /end AXIS_DESCR
 /begin AXIS_DESCR COM_AXIS tqi_req_tra _CNV_A_R_LINEAR_____31_CM 6 0. 1023.96875 FORMAT "%7.2" AXIS_PTS_REF ldpm_tqi_req_tra_1_extc /end AXIS_DESCR
/end CHARACTERISTIC
/begin CHARACTERISTIC ip_tq_add_ch_hom "Basic torque increase for homogeneous catalyst heating" MAP 0xa0811060 _REC_MAP_20_u2_u1_u2 2047.96875 _CNV_A_R_LINEAR_____87_CM -1024. 1023.96875 DISPLAY_IDENTIFIER IP_TQ_ADD_CH_HOM FORMAT "%11.5"
 /begin AXIS_DESCR COM_AXIS n_32 _CNV_A_R_LINEAR_____10_CM 6 0. 8160. FORMAT "%4.0" AXIS_PTS_REF ldpm_n_32_3_extc /end AXIS_DESCR
 /begin AXIS_DESCR COM_AXIS tqi_req_tra _CNV_A_R_LINEAR_____31_CM 6 0. 1023.96875 FORMAT "%7.2" AXIS_PTS_REF ldpm_tqi_req_tra_1_extc /end AXIS_DESCR
/end CHARACTERISTIC
/begin CHARACTERISTIC ip_fac_tq_add_ch_mplh_dri "Factor on torque reserve for homogeneous catalyst heating at engaged drivetrain (only for AT relevant)" MAP 0xa0805e04 _REC_MAP_20_u1_u1_u2 0.99609375 _CNV_A_R_LINEAR_____28_CM 0. 0.99609375 DISPLAY_IDENTIFIER IP_FAC_TQ_ADD_CH_MPLH_DRI FORMAT "%5.3"
 /begin AXIS_DESCR COM_AXIS n_32 _CNV_A_R_LINEAR_____10_CM 6 0. 8160. FORMAT "%4.0" AXIS_PTS_REF ldpm_n_32_3_extc /end AXIS_DESCR
 /begin AXIS_DESCR COM_AXIS tqi_req_tra _CNV_A_R_LINEAR_____31_CM 6 0. 1023.96875 FORMAT "%7.2" AXIS_PTS_REF ldpm_tqi_req_tra_1_extc /end AXIS_DESCR
/end CHARACTERISTIC
/begin CHARACTERISTIC ip_fac_tq_add_ch_hom_dri "Factor on torque reserve for homogeneous catalyst heating at engaged drivetrain (only for AT relevant)" MAP 0xa0805d80 _REC_MAP_20_u1_u1_u2 0.99609375 _CNV_A_R_LINEAR_____28_CM 0. 0.99609375 DISPLAY_IDENTIFIER IP_FAC_TQ_ADD_CH_HOM_DRI FORMAT "%5.3"
 /begin AXIS_DESCR COM_AXIS n_32 _CNV_A_R_LINEAR_____10_CM 6 0. 8160. FORMAT "%4.0" AXIS_PTS_REF ldpm_n_32_3_extc /end AXIS_DESCR
 /begin AXIS_DESCR COM_AXIS tqi_req_tra _CNV_A_R_LINEAR_____31_CM 6 0. 1023.96875 FORMAT "%7.2" AXIS_PTS_REF ldpm_tqi_req_tra_1_extc /end AXIS_DESCR
/end CHARACTERISTIC
/begin CHARACTERISTIC ip_fac_tq_add_ch_ctr_km "Reduction of torque reserve depending on catalyst age" CURVE 0xa0805d1c _REC_CUR_20_u1_u2 0.99609375 _CNV_A_R_LINEAR_____28_CM 0. 0.99609375 DISPLAY_IDENTIFIER IP_FAC_TQ_ADD_CH_CTR_KM FORMAT "%5.3"
 /begin AXIS_DESCR COM_AXIS ctr_km_can _CNV_A_R_LINEAR_____58_CM 4 0. 655350. FORMAT "%6.0" AXIS_PTS_REF ldpm_ctr_km_can_1_extc /end AXIS_DESCR
/end CHARACTERISTIC
/begin AXIS_PTS ldp_n_32_ip_nox_cor_s_hys "" 0xa0807ab6 n_32 _REC_AXS_20_u1 8160. _CNV_A_R_LINEAR_____10_CM 6 0. 8160. FORMAT "%4.0" /end AXIS_PTS
/begin AXIS_PTS ldp_n_32_ip_nox_cor_homs_hys "" 0xa0807aae n_32 _REC_AXS_20_u1 8160. _CNV_A_R_LINEAR_____10_CM 6 0. 8160. FORMAT "%4.0" /end AXIS_PTS
/begin COMPU_METHOD _CNV_A_R_LINEAR_____0_CM "" RAT_FUNC "%6.3" "-" COEFFS 0 1. 0. 0 0 1 /end COMPU_METHOD
/begin COMPU_METHOD _CNV_S_2_RANGE__0___1_CM "" TAB_VERB "%6.3" "-" COMPU_TAB_REF _CNV_S_2_RANGE__0___1 /end COMPU_METHOD
/begin COMPU_VTAB _CNV_S_2_RANGE__0___1 "" TAB_VERB 2 0 "0" 1 "1" /end COMPU_VTAB
/begin COMPU_METHOD _CNV_A_R_LINEAR_____4_CM "" RAT_FUNC "%6.3" "s" COEFFS 0 10. 0. 0 0 1 /end COMPU_METHOD
/begin COMPU_METHOD _CNV_A_R_LINEAR_____9_CM "" RAT_FUNC "%6.3" "-" COEFFS 0 32767.99999999992 0. 0 0 1 /end COMPU_METHOD
/begin COMPU_METHOD _CNV_A_R_LINEAR_____10_CM "" RAT_FUNC "%6.3" "rpm" COEFFS 0 3.125e-002 0. 0 0 1 /end COMPU_METHOD
/begin COMPU_METHOD _CNV_A_R_LINEAR_____17_CM "" RAT_FUNC "%6.3" "°C" COEFFS 0 1.333333333333333 64. 0 0 1 /end COMPU_METHOD
/begin COMPU_METHOD _CNV_A_R_LINEAR_____28_CM "" RAT_FUNC "%6.3" "-" COEFFS 0 256. 0. 0 0 1 /end COMPU_METHOD
/begin COMPU_METHOD _CNV_A_R_LINEAR_____31_CM "" RAT_FUNC "%6.3" "Nm" COEFFS 0 32. 0. 0 0 1 /end COMPU_METHOD
/begin COMPU_METHOD _CNV_A_R_LINEAR_____58_CM "" RAT_FUNC "%6.3" "km" COEFFS 0 0.1 0. 0 0 1 /end COMPU_METHOD
/begin COMPU_METHOD _CNV_A_R_LINEAR_____87_CM "" RAT_FUNC "%6.3" "Nm" COEFFS 0 32. 32768. 0 0 1 /end COMPU_METHOD
/begin COMPU_METHOD _CNV_A_R_LINEAR_____111_CM "" RAT_FUNC "%6.3" "mg/stk" COEFFS 0 47.18142548596112 0. 0 0 1 /end COMPU_METHOD
/begin COMPU_METHOD _CNV_A_R_LINEAR_____129_CM "" RAT_FUNC "%6.3" "-" COEFFS 0 1024. 0. 0 0 1 /end COMPU_METHOD
/begin COMPU_METHOD _CNV_A_R_LINEAR_____132_CM "" RAT_FUNC "%6.3" "°CRK" COEFFS 0 16. 1440. 0 0 1 /end COMPU_METHOD
/begin COMPU_METHOD _CNV_A_R_LINEAR_____146_CM "" RAT_FUNC "%6.3" "hPa" COEFFS 0 12.05960017121163 0. 0 0 1 /end COMPU_METHOD
/begin COMPU_METHOD _CNV_A_R_LINEAR_____190_CM "" RAT_FUNC "%6.3" "°CRK" COEFFS 0 2.666666666666667 95. 0 0 1 /end COMPU_METHOD
/begin COMPU_METHOD _CNV_A_R_LINEAR_____200_CM "" RAT_FUNC "%6.3" "°CRK" COEFFS 0 2.666666666666667 0. 0 0 1 /end COMPU_METHOD
/begin COMPU_METHOD _CNV_A_R_LINEAR_____226_CM "" RAT_FUNC "%6.3" "%" COEFFS 0 10. 0. 0 0 1 /end COMPU_METHOD
/begin COMPU_METHOD _CNV_R_R_Def_dez_sl_551_CM "Def_dez_sl_q1" RAT_FUNC "%6.3" "-" COEFFS 0. 1. 0. 0. 0. 1. /end COMPU_METHOD
/begin COMPU_METHOD _CNV_R_R_Def_f_ub_b_553_CM "Def_f_ub_b1" RAT_FUNC "%6.3" "-" COEFFS 0. 256. 0. 0. 0. 1. /end COMPU_METHOD
/begin COMPU_METHOD _CNV_R_R_Def_m_sw_q_554_CM "Def_m_sw_q0p1" RAT_FUNC "%6.3" "Nm" COEFFS 0. 10. 0. 0. 0. 1. /end COMPU_METHOD
/begin COMPU_METHOD _CNV_R_R_Def_f_uw_b_555_CM "Def_f_uw_b100" RAT_FUNC "%6.3" "%" COEFFS 0. 65536. 0. 0. 0. 100. /end COMPU_METHOD
/begin COMPU_METHOD _CNV_R_R_Def_f_uw_b_559_CM "Def_f_uw_b16" RAT_FUNC "%6.3" "-" COEFFS 0. 65536. 0. 0. 0. 16. /end COMPU_METHOD
/begin COMPU_METHOD _CNV_R_R_Def_spr_sw_561_CM "Def_spr_sw_q0p1" RAT_FUNC "%6.3" "° KW" COEFFS 0. 10. 0. 0. 0. 1. /end COMPU_METHOD
/begin COMPU_METHOD _CNV_S_2_Def_bit_ub_563_CM "Def_bit_ub_0" TAB_VERB "%6.3" "-" COMPU_TAB_REF _CNV_S_2_Def_bit_ub_563 /end COMPU_METHOD
/begin COMPU_VTAB _CNV_S_2_Def_bit_ub_563 "Def_bit_ub_0" TAB_VERB 2 0 "FALSE" 1 "TRUE" /end COMPU_VTAB
/begin COMPU_METHOD _CNV_R_R_Def_f_sw_b_570_CM "Def_f_sw_b100" RAT_FUNC "%6.3" "-" COEFFS 0. 32768. 0. 0. 0. 100. /end COMPU_METHOD
/begin COMPU_METHOD _CNV_R_R_Def_f_uw_b_572_CM "Def_f_uw_b8" RAT_FUNC "%6.3" "-" COEFFS 0. 65536. 0. 0. 0. 8. /end COMPU_METHOD
/begin COMPU_METHOD _CNV_R_R_Def_td_ub__574_CM "Def_td_ub_q0p1" RAT_FUNC "%6.3" "s" COEFFS 0. 10. 0. 0. 0. 1. /end COMPU_METHOD
/begin COMPU_METHOD _CNV_R_R_Def_p_sw_q_576_CM "Def_p_sw_q0p039" RAT_FUNC "%6.3" "hPa" COEFFS 0. 256. 0. 0. 0. 10. /end COMPU_METHOD
/begin COMPU_METHOD _CNV_R_R_Def_t_sw_q_578_CM "Def_t_sw_q0p1" RAT_FUNC "%6.3" "°C" COEFFS 0. 10. 0. 0. 0. 1. /end COMPU_METHOD
/begin COMPU_METHOD _CNV_R_R_Def_t_sw_q_579_CM "Def_t_sw_q0p01" RAT_FUNC "%6.3" "°C" COEFFS 0. 100. 0. 0. 0. 1. /end COMPU_METHOD
/begin COMPU_METHOD _CNV_R_R_Def_f_ub_b_586_CM "Def_f_ub_b100" RAT_FUNC "%6.3" "%" COEFFS 0. 256. 0. 0. 0. 100. /end COMPU_METHOD
/begin COMPU_METHOD _CNV_R_R_Def_hub_uw_589_CM "Def_hub_uw_q0p001" RAT_FUNC "%6.3" "mm" COEFFS 0. 1000. 0. 0. 0. 1. /end COMPU_METHOD
/begin COMPU_METHOD _CNV_R_R_Def_f_uw_b_590_CM "Def_f_uw_b2" RAT_FUNC "%6.3" "-" COEFFS 0. 65536. 0. 0. 0. 2. /end COMPU_METHOD
/begin COMPU_METHOD _CNV_R_R_Def_n_sw_q_595_CM "Def_n_sw_q1p0" RAT_FUNC "%6.3" "Upm" COEFFS 0. 1. 0. 0. 0. 1. /end COMPU_METHOD
/begin COMPU_METHOD _CNV_R_R_Def_rf_sw__598_CM "Def_rf_sw_q0p01" RAT_FUNC "%6.3" "%" COEFFS 0. 100. 0. 0. 0. 1. /end COMPU_METHOD
/begin COMPU_METHOD _CNV_R_R_Def_eta_sw_599_CM "Def_eta_sw_b200" RAT_FUNC "%6.3" "%" COEFFS 0. 32768. 0. 0. 0. 200. /end COMPU_METHOD
/begin COMPU_METHOD _CNV_R_R_Def_rk_sw__600_CM "Def_rk_sw_b1600" RAT_FUNC "%6.3" "%" COEFFS 0. 2048. 0. 0. 0. 100. /end COMPU_METHOD
/begin COMPU_METHOD _CNV_R_R_Def_zw_sw__604_CM "Def_zw_sw_q0p1" RAT_FUNC "%6.3" "°" COEFFS 0. 10. 0. 0. 0. 1. /end COMPU_METHOD
/begin COMPU_METHOD _CNV_R_R_Def_zw_sb__605_CM "Def_zw_sb_q0p5" RAT_FUNC "%6.3" "°" COEFFS 0. 2. 0. 0. 0. 1. /end COMPU_METHOD
/begin COMPU_METHOD _CNV_R_R_Def_eta_sw_606_CM "Def_eta_sw_q0p00305" RAT_FUNC "%6.3" "%" COEFFS 0. 32767. 0. 0. 0. 100. /end COMPU_METHOD
/begin COMPU_METHOD _CNV_R_R_Def_f_ub_b_612_CM "Def_f_ub_b32" RAT_FUNC "%6.3" "-" COEFFS 0. 256. 0. 0. 0. 32. /end COMPU_METHOD
/begin COMPU_METHOD _CNV_R_R_Def_f_ub_b_613_CM "Def_f_ub_b2" RAT_FUNC "%6.3" "-" COEFFS 0. 256. 0. 0. 0. 2. /end COMPU_METHOD
/begin COMPU_METHOD _CNV_R_R_Def_eta_uw_615_CM "Def_eta_uw_b200" RAT_FUNC "%6.3" "%" COEFFS 0. 65536. 0. 0. 0. 200. /end COMPU_METHOD
/begin COMPU_METHOD _CNV_R_R_Def_f_sw_b_616_CM "Def_f_sw_b2" RAT_FUNC "%6.3" "-" COEFFS 0. 65536. 0. 0. 0. 4. /end COMPU_METHOD
/begin COMPU_METHOD _CNV_R_R_Def_f_ub_b_633_CM "Def_f_ub_b0p03125" RAT_FUNC "%6.3" "-" COEFFS 0. 256. 0. 0. 0. 3.125e-002 /end COMPU_METHOD
/begin COMPU_METHOD _CNV_R_R_Def_td_uw__673_CM "Def_td_uw_q0p01" RAT_FUNC "%6.3" "s" COEFFS 0. 100. 0. 0. 0. 1. /end COMPU_METHOD
/begin COMPU_METHOD _CNV_R_R_Def_f_uw_b_679_CM "Def_f_uw_b2048" RAT_FUNC "%6.3" "-" COEFFS 0. 65536. 0. 0. 0. 2048. /end COMPU_METHOD
/begin COMPU_METHOD _CNV_R_R_Def_dez_ub_685_CM "Def_dez_ub_q0p5" RAT_FUNC "%6.3" "-" COEFFS 0. 2. 0. 0. 0. 1. /end COMPU_METHOD
/begin COMPU_METHOD _CNV_R_R_Def_vs_uw__686_CM "Def_vs_uw_b10000" RAT_FUNC "%6.3" "l/h" COEFFS 0. 65536. 0. 0. 0. 10000. /end COMPU_METHOD
/begin COMPU_METHOD _CNV_R_R_Def_f_ub_b_694_CM "Def_f_ub_b8" RAT_FUNC "%6.3" "-" COEFFS 0. 256. 0. 0. 0. 8. /end COMPU_METHOD
/begin COMPU_METHOD _CNV_R_R_Def_zk10ms_715_CM "Def_zk10ms_uw_b655p36" RAT_FUNC "%6.3" "s" COEFFS 0. 0. 655.36 0. 1. 0. /end COMPU_METHOD
/begin COMPU_METHOD _CNV_R_R_Def_td_uw__718_CM "Def_td_uw_q0p2" RAT_FUNC "%6.3" "s" COEFFS 0. 5. 0. 0. 0. 1. /end COMPU_METHOD
/begin COMPU_METHOD _CNV_R_R_Def_v_uw_q_726_CM "Def_v_uw_q1p0" RAT_FUNC "%6.3" "km/h" COEFFS 0. 1. 0. 0. 0. 1. /end COMPU_METHOD
/begin COMPU_METHOD _CNV_A_R_LINEAR_____781_CM "" RAT_FUNC "%6.3" "K" COEFFS 0 32. 32768. 0 0 1 /end COMPU_METHOD
/begin COMPU_METHOD _CNV_A_R_LINEAR_____787_CM "" RAT_FUNC "%6.3" "°CRK" COEFFS 0 2.666666666666667 1920. 0 0 1 /end COMPU_METHOD
/begin COMPU_METHOD _CNV_A_R_LINEAR_____788_CM "" RAT_FUNC "%6.3" "" COEFFS 0 1024.000014000427 16384.00022400684 0 0 1 /end COMPU_METHOD
/begin COMPU_METHOD _CNV_A_R_LINEAR_____789_CM "" RAT_FUNC "%6.3" "mg/stk" COEFFS 0 47.18142548596112 32767.5 0 0 1 /end COMPU_METHOD
/begin COMPU_METHOD _CNV_A_R_LINEAR_____790_CM "" RAT_FUNC "%6.3" "Nm" COEFFS 0 255.9999999499993 -6.400096026482061e-006 0 0 1 /end COMPU_METHOD
/begin COMPU_METHOD _CNV_A_R_LINEAR_____791_CM "" RAT_FUNC "%6.3" "Nm/K" COEFFS 0 65535.99999999996 0. 0 0 1 /end COMPU_METHOD
/begin COMPU_METHOD _CNV_A_R_LINEAR_____792_CM "" RAT_FUNC "%6.3" "Nm" COEFFS 0 255.9999999499992 -6.40009488994675e-006 0 0 1 /end COMPU_METHOD
/begin COMPU_METHOD _CNV_A_R_LINEAR_____793_CM "" RAT_FUNC "%6.3" "Nm/K" COEFFS 0 32767.99999999992 0. 0 0 1 /end COMPU_METHOD
/begin COMPU_METHOD _CNV_A_R_LINEAR_____794_CM "" RAT_FUNC "%6.3" "Nm/100ms" COEFFS 0 256. 0. 0 0 1 /end COMPU_METHOD
/begin COMPU_METHOD _CNV_A_R_LINEAR_____795_CM "" RAT_FUNC "%6.3" "Nm" COEFFS 0 256. 0. 0 0 1 /end COMPU_METHOD
/begin RECORD_LAYOUT _REC_VAL_20_u1 FNC_VALUES 1 UBYTE COLUMN_DIR DIRECT /end RECORD_LAYOUT
/begin RECORD_LAYOUT _REC_VAL_20_u2 FNC_VALUES 1 UWORD COLUMN_DIR DIRECT /end RECORD_LAYOUT
/begin RECORD_LAYOUT _REC_AXS_20_u1 NO_AXIS_PTS_X 1 UBYTE AXIS_PTS_X 2 UBYTE INDEX_INCR DIRECT /end RECORD_LAYOUT
/begin RECORD_LAYOUT _REC_VAL_20_s2 FNC_VALUES 1 SWORD COLUMN_DIR DIRECT /end RECORD_LAYOUT
/begin RECORD_LAYOUT _REC_MAP_20_u2_u2_u1 FNC_VALUES 1 UWORD COLUMN_DIR DIRECT /end RECORD_LAYOUT
/begin RECORD_LAYOUT _REC_AXS_20_u2 NO_AXIS_PTS_X 1 UWORD AXIS_PTS_X 2 UWORD INDEX_INCR DIRECT /end RECORD_LAYOUT
/begin RECORD_LAYOUT _REC_CUR_20_u2_u1 FNC_VALUES 1 UWORD COLUMN_DIR DIRECT /end RECORD_LAYOUT
/begin RECORD_LAYOUT _REC_CUR_20_u2_u2 FNC_VALUES 1 UWORD COLUMN_DIR DIRECT /end RECORD_LAYOUT
/begin RECORD_LAYOUT _REC_CUR_20_u1_u2 FNC_VALUES 1 UBYTE COLUMN_DIR DIRECT /end RECORD_LAYOUT
/begin RECORD_LAYOUT _REC_MAP_20_u2_u2_u2 FNC_VALUES 1 UWORD COLUMN_DIR DIRECT /end RECORD_LAYOUT
/begin RECORD_LAYOUT _REC_MAP_20_u2_u1_u2 FNC_VALUES 1 UWORD COLUMN_DIR DIRECT /end RECORD_LAYOUT
/begin RECORD_LAYOUT _REC_MAP_20_u1_u2_u1 FNC_VALUES 1 UBYTE COLUMN_DIR DIRECT /end RECORD_LAYOUT
/begin RECORD_LAYOUT _REC_MAP_20_u1_u1_u2 FNC_VALUES 1 UBYTE COLUMN_DIR DIRECT /end RECORD_LAYOUT
/begin RECORD_LAYOUT _REC_MAP_52_u1_s2_s2 NO_AXIS_PTS_X 1 UBYTE NO_AXIS_PTS_Y 2 UBYTE AXIS_PTS_X 3 SWORD INDEX_INCR DIRECT AXIS_PTS_Y 4 SWORD INDEX_INCR DIRECT FNC_VALUES 5 UBYTE COLUMN_DIR DIRECT /end RECORD_LAYOUT
/begin RECORD_LAYOUT _REC_MAP_52_UBYTE_u2_s2_s2 NO_AXIS_PTS_X 1 UBYTE NO_AXIS_PTS_Y 2 UBYTE AXIS_PTS_X 3 SWORD INDEX_INCR DIRECT AXIS_PTS_Y 4 SWORD INDEX_INCR DIRECT FNC_VALUES 5 UWORD COLUMN_DIR DIRECT /end RECORD_LAYOUT
/begin RECORD_LAYOUT _REC_MAP_52_UBYTE_s2_s2_s2 NO_AXIS_PTS_X 1 UBYTE NO_AXIS_PTS_Y 2 UBYTE AXIS_PTS_X 3 SWORD INDEX_INCR DIRECT AXIS_PTS_Y 4 SWORD INDEX_INCR DIRECT FNC_VALUES 5 SWORD COLUMN_DIR DIRECT /end RECORD_LAYOUT
/begin RECORD_LAYOUT _REC_MAP_52_UBYTE_u2_u2_s2 NO_AXIS_PTS_X 1 UBYTE NO_AXIS_PTS_Y 2 UBYTE AXIS_PTS_X 3 UWORD INDEX_INCR DIRECT AXIS_PTS_Y 4 SWORD INDEX_INCR DIRECT FNC_VALUES 5 UWORD COLUMN_DIR DIRECT /end RECORD_LAYOUT
/begin RECORD_LAYOUT _REC_MAP_52_u1_u1_u2 NO_AXIS_PTS_X 1 UBYTE NO_AXIS_PTS_Y 2 UBYTE AXIS_PTS_X 3 UBYTE INDEX_INCR DIRECT AXIS_PTS_Y 4 UWORD INDEX_INCR DIRECT FNC_VALUES 5 UBYTE COLUMN_DIR DIRECT /end RECORD_LAYOUT
/begin RECORD_LAYOUT _REC_MAP_52_u1_u2_s2 NO_AXIS_PTS_X 1 UBYTE NO_AXIS_PTS_Y 2 UBYTE AXIS_PTS_X 3 UWORD INDEX_INCR DIRECT AXIS_PTS_Y 4 SWORD INDEX_INCR DIRECT FNC_VALUES 5 UBYTE COLUMN_DIR DIRECT /end RECORD_LAYOUT
/begin RECORD_LAYOUT _REC_MAP_52_UBYTE_s2_u2_s2 NO_AXIS_PTS_X 1 UBYTE NO_AXIS_PTS_Y 2 UBYTE AXIS_PTS_X 3 UWORD INDEX_INCR DIRECT AXIS_PTS_Y 4 SWORD INDEX_INCR DIRECT FNC_VALUES 5 SWORD COLUMN_DIR DIRECT /end RECORD_LAYOUT
/begin RECORD_LAYOUT _REC_MAP_52_UBYTE_s1_s2_s2 NO_AXIS_PTS_X 1 UBYTE NO_AXIS_PTS_Y 2 UBYTE AXIS_PTS_X 3 SWORD INDEX_INCR DIRECT AXIS_PTS_Y 4 SWORD INDEX_INCR DIRECT FNC_VALUES 5 SBYTE COLUMN_DIR DIRECT /end RECORD_LAYOUT
/begin RECORD_LAYOUT _REC_MAP_52_u1_s2_u2 NO_AXIS_PTS_X 1 UBYTE NO_AXIS_PTS_Y 2 UBYTE AXIS_PTS_X 3 SWORD INDEX_INCR DIRECT AXIS_PTS_Y 4 UWORD INDEX_INCR DIRECT FNC_VALUES 5 UBYTE COLUMN_DIR DIRECT /end RECORD_LAYOUT
/begin RECORD_LAYOUT _REC_CUR_TKL_UW_VV__u2_u2 NO_AXIS_PTS_X 1 UBYTE RESERVED 2 BYTE AXIS_PTS_X 3 UWORD INDEX_INCR DIRECT FNC_VALUES 4 UWORD COLUMN_DIR DIRECT /end RECORD_LAYOUT
/begin RECORD_LAYOUT _REC_CUR_TKL_UW_VV__u2_s2 NO_AXIS_PTS_X 1 UBYTE RESERVED 2 BYTE AXIS_PTS_X 3 SWORD INDEX_INCR DIRECT FNC_VALUES 4 UWORD COLUMN_DIR DIRECT /end RECORD_LAYOUT
/begin RECORD_LAYOUT _REC_CUR_TKL_UW_VV__u1_s2 NO_AXIS_PTS_X 1 UBYTE RESERVED 2 BYTE AXIS_PTS_X 3 SWORD INDEX_INCR DIRECT FNC_VALUES 4 UBYTE COLUMN_DIR DIRECT /end RECORD_LAYOUT
/begin RECORD_LAYOUT _REC_CUR_TKL_UW_VV__s2_s2 NO_AXIS_PTS_X 1 UBYTE RESERVED 2 BYTE AXIS_PTS_X 3 SWORD INDEX_INCR DIRECT FNC_VALUES 4 SWORD COLUMN_DIR DIRECT /end RECORD_LAYOUT
/begin RECORD_LAYOUT _REC_CUR_TKL_UW_VV__u1_u2 NO_AXIS_PTS_X 1 UBYTE RESERVED 2 BYTE AXIS_PTS_X 3 UWORD INDEX_INCR DIRECT FNC_VALUES 4 UBYTE COLUMN_DIR DIRECT /end RECORD_LAYOUT
/begin RECORD_LAYOUT _REC_CUR_TKL_UW_VV__u1_u1 NO_AXIS_PTS_X 1 UBYTE RESERVED 2 BYTE AXIS_PTS_X 3 UBYTE INDEX_INCR DIRECT FNC_VALUES 4 UBYTE COLUMN_DIR DIRECT /end RECORD_LAYOUT
/begin RECORD_LAYOUT _REC_CUR_TKL_UW_VV__s1_u2 NO_AXIS_PTS_X 1 UBYTE RESERVED 2 BYTE AXIS_PTS_X 3 UWORD INDEX_INCR DIRECT FNC_VALUES 4 SBYTE COLUMN_DIR DIRECT /end RECORD_LAYOUT
/begin RECORD_LAYOUT _REC_VAL_2_u1 FNC_VALUES 1 UBYTE COLUMN_DIR DIRECT /end RECORD_LAYOUT
/begin RECORD_LAYOUT _REC_VAL_2_s2 FNC_VALUES 1 SWORD COLUMN_DIR DIRECT /end RECORD_LAYOUT
/begin FUNCTION WMSCHALT ""
 /begin DEF_CHARACTERISTIC CW_HEIZART KF_KUEHLPIMX KF_MDRES_WM KF_TMSTMDRES KL_EL_I KL_EL_TGET KL_EL_TKA KL_EL_TMOT KL_EL_TWR1 KL_EL_V KL_EWP_VBE KL_EWP_VBSD KL_KFT_HI KL_KFT_HK KL_KUEHLN KL_NEL_PWM KL_TGMDKLIMA KL_TMMDKLIMA KL_TMQSANF KL_TOMDKLIMA K_BEZAEHLUG K_BHZ_AP K_BLKLPS1_AP K_BLKLPS_AP K_EL_ECO K_EL_HI K_EL_HK K_EL_KHL1 K_EL_LKS0 K_EL_LKS1 K_EL_LKS2 K_EL_NO K_EL_TDLP K_EL_V0 K_EWPTMST K_EWPTUST K_EWP_AP K_EWP_EC K_EWP_HI K_EWP_HK K_EWP_MDKMN K_EWP_MN1 K_EWP_NO K_EWP_TDMD K_EWP_WA K_FAK_MX K_F_EWPTDLP1 K_F_EWPTDLP2 K_F_QSANF K_F_QSANFAUT K_KFT_AP K_KFT_NK K_KFT_NO K_KFT_WA K_LKLPS1_MN K_LKLPS1_MX K_LKLPS_MN K_LKLPS_MX K_MAT_BHZ K_MAT_EGS K_MAT_ELUEFT K_MAT_EWP K_MAT_KFT K_MAT_LKLPS K_MAT_LKLPS1 K_MAT_MDAC K_MAT_MDRED K_MAT_MDRES K_MAT_WARN1 K_MAT_WARN2 K_MAT_WARN3 K_MDKLIMA_AP K_MDKUEHL_AP K_MDRES_AP K_MMI_ZEIT1 K_MMI_ZEIT2 K_NEL_AP K_NEL_NTLKS K_NTLKWS_AP K_NTLKWS_V K_TMWARNMN K_TMWARN_1 K_TMWARN_2 K_TMWARN_HYS K_TOWARN_1 K_TOWARN_2 K_TOWARN_3 K_TOWARN_HYS K_WARN1_AP K_WARN2_AP K_WARN3_AP S_EL_GEN S_KKS /end DEF_CHARACTERISTIC
 /begin REF_CHARACTERISTIC K_EWP_MN K_EWP_MX /end REF_CHARACTERISTIC
 /begin OUT_MEASUREMENT D_tm_tkwsh D_tmot_tkws D_tmot_tkws2 F_kuehlmx F_kuehln F_kuehls F_mdres_wm F_nelueft_v Hs_help1 Hs_help2 Hs_help3 Hs_help4 Hs_kelks Hs_kelks1 Md_kuehl_ap Md_kuehl_wa Md_max_acwm Mdi_res_he Mdi_res_he1 Mdi_res_he2 Mdi_res_he3 Mdi_res_wm Mdk_kuehl_help Mdk_kuehl_mx Nelueft_eco Nelueft_ext_h1 Nelueft_ext_h2 Nelueft_ext_h3 Nelueft_ext_h4 Nelueft_genh Nelueft_h3 Nelueft_hi Nelueft_hk Nelueft_i Nelueft_khl1 Nelueft_llk Nelueft_local Nelueft_no Nelueft_pwm Nelueft_tget Nelueft_tka Nelueft_tmot Nelueft_twr1 Nelueft_wa Nelueft_wa_h Nelueft_wm Newp_soll Pi_kuehl_mx_h Qs_anf Qs_anf_sw St_wm1 St_wm1.B_lklps St_wm1.B_lklps1 St_wm1.B_ntlkws St_wm1.B_tmmi_warn1 St_wm1.B_tmmi_warn2 St_wm1.B_tmmi_warn3 St_wmschalt0 St_wmschalt0.B_beende St_wmschalt0.B_hz_wm St_wmschalt0.B_ntlkws_v Tget_wm Vs_eco_agsw Vs_eco_motsw Vs_ewp_bsd Vs_ewp_warml Vs_high_agsw Vs_high_motsw Vs_hkft_agsw Vs_hkft_motsw Vs_norm_agsw Vs_norm_motsw Zaehl_beug /end OUT_MEASUREMENT
 /begin IN_MEASUREMENT Ba_wm_ist Ba_wm_prio F_ewp_ba F_kft_ba Mdi_zw_soll Mdk_ewp Nelueft_gen Nelueft_klima Nelueft_lenk Nelueft_nox Nkw Qs_anf_klima St_egs St_egs.B_egs_khl1 St_egs.B_egs_khl2 St_egs.B_fs St_getriebe St_getriebe.B_autget St_kl15 St_kl15.B_kl15_ep St_kl15.B_kl15_vorab St_lklps St_lklps.B_lklps_ln St_lklps.B_lklps_ln1 St_mkwchn St_mkwchn.B_kwdreht St_start St_start.B_jumpstart St_start.B_sta St_start.B_start St_start.B_startende St_start.B_wst St_wm1.B_lklps St_wm1.B_lklps1 St_wm1.B_ntlkws St_wm1.B_tmmi_warn1 St_wm1.B_tmmi_warn2 St_wm1.B_tmmi_warn3 Tget Tka Tkwsoll Tmot Tmot_start Tn_start_10 Toel Tumg Tw_r1 V Vs_ewp_ag Vs_ewp_mot /end IN_MEASUREMENT
/end FUNCTION
/begin FUNCTION WMTURBO "" /begin DEF_CHARACTERISTIC KL_LLK_EL KL_LLK_EWP /end DEF_CHARACTERISTIC /begin OUT_MEASUREMENT D_tans_tumg /end OUT_MEASUREMENT /begin IN_MEASUREMENT Nelueft_llk Newp_2_soll Tans Tumg /end IN_MEASUREMENT /end FUNCTION
/begin FUNCTION WMZUSTA ""
 /begin DEF_CHARACTERISTIC KL_FEWPW_BA KL_FEWP_BA KL_FKFTW_BA KL_FKFT_BA K_ZAEHLWE_UG K_ZAEHL_UG /end DEF_CHARACTERISTIC
 /begin OUT_MEASUREMENT F_ewp_ba F_ewpw_ba F_kft_ba F_kftw_ba Zaehl_w_ugwm Zaehler_ugwm /end OUT_MEASUREMENT
 /begin IN_MEASUREMENT Ba_wm_ist Ba_wm_prio Ba_wm_soll /end IN_MEASUREMENT
/end FUNCTION
/begin FUNCTION WM_NL ""
 /begin DEF_CHARACTERISTIC KL_NLELUEFT K_EWPVSKR1 K_EWPVSKR2 K_NLEWPMX K_NLKFTMX K_QSNLZAEHL K_RESTDELAY K_TMOT_ELUE K_TMOT_EWP K_TOEL_ELUE K_TOEL_EWP /end DEF_CHARACTERISTIC
 /begin REF_CHARACTERISTIC K_VSKR_ZK /end REF_CHARACTERISTIC
 /begin OUT_MEASUREMENT Newp_2_soll St_wm_nl0 St_wm_nl0.B_nlewp_b1 St_wm_nl0.B_nlewp_b2 St_wm_nl0.B_nlewp_b3 St_wm_nl0.B_nlewp_b4 St_wm_nl0.B_nlqs1 St_wm_nl0.B_nlqs2 St_wm_nl0.B_nlqs3 St_wm_nl0.B_nlqs4 St_wm_nl1 St_wm_nl1.B_nlqs5 Vskr_help Vskr_mw_nl Zaehler_qsnl /end OUT_MEASUREMENT
 /begin IN_MEASUREMENT Nelueft_wm Newp_soll Qs_anf_klima St_wm1 St_wm1.B_lklps St_wm1.B_lklps1 St_wm1.B_ntlkws St_wm1.B_tmmi_warn1 St_wm1.B_tmmi_warn2 St_wm1.B_tmmi_warn3 Tkwsoll Tmot Toel Vskr_mw Zaehl_lok /end IN_MEASUREMENT
/end FUNCTION
/begin FUNCTION WM_START ""
 /begin REF_CHARACTERISTIC K_EWPVSKR1 K_EWPVSKR2 K_NLEWPMX K_QSNLZAEHL K_RESTDELAY K_TMOT_EWP K_TOEL_EWP K_VSKR_ZK /end REF_CHARACTERISTIC
 /begin IN_MEASUREMENT Newp_soll Qs_anf_klima St_wm_nl0 St_wm_nl0.B_nlewp_b1 St_wm_nl0.B_nlewp_b2 St_wm_nl0.B_nlewp_b3 St_wm_nl0.B_nlewp_b4 St_wm_nl0.B_nlqs1 St_wm_nl0.B_nlqs2 St_wm_nl0.B_nlqs3 St_wm_nl0.B_nlqs4 St_wm_nl1 St_wm_nl1.B_nlqs5 Tmot Toel Vskr_help Vskr_mw Vskr_mw_nl Zaehl_lok Zaehler_qsnl /end IN_MEASUREMENT
/end FUNCTION
/begin FUNCTION zue_30_54_ "" /begin SUB_FUNCTION ZWAUS ZWGRUND ZWKS ZWMIN ZWOPT ZWOUT ZWSOLL ZWSTART /end SUB_FUNCTION /end FUNCTION
/begin FUNCTION ZWAUS ""
 /begin DEF_CHARACTERISTIC KF_DZWRF_S KF_DZW_KRT_HS KF_DZW_WL_HS KF_FZW_KRT_HS KF_FZW_WL_HS KF_ZWBASDOE_HS KF_ZWBASK_S KF_ZWBAS_HS KF_ZWBAS_S KF_ZWMIN_HS KF_ZWOPT_HS KL_ETAZW_HS KL_FZWBAS_S K_DZW_HS K_DZW_S K_ZWAPP_HS K_ZWAPP_S K_ZWMINHYS_HS S_ZWAPP_HS S_ZWAPP_S /end DEF_CHARACTERISTIC
 /begin REF_CHARACTERISTIC CW_KHM S_SCH_CLC /end REF_CHARACTERISTIC
 /begin OUT_MEASUREMENT Dzw_agr_s Dzw_hs Dzw_kr_hs Dzw_krt_hs Dzw_rf_s Dzw_wl_hs Dzwt_hs Etazw_hs F_zw_krt_hs F_zwbas_s St_zwaus St_zwaus.B_zwmin_hs Zw_bas_hs Zw_bas_s Zw_kor_hs Zw_kor_s Zw_korkr_hs Zw_korkr_hs_min Zw_min_hs Zw_opt_hs Zw_soll_hs Zw_soll_s Zw_sollm_hs /end OUT_MEASUREMENT
 /begin IN_MEASUREMENT Drfopt_s Dzw_kh_s Dzw_kr Dzw_krann_hs Nkw Rk_soll_hs Rk_soll_s St_bv_kath St_bv_kath.B_hsplit_akt St_bv_kath.B_nesps_akt St_clc St_clc.B_hmm_clc St_clc.B_sch_clc St_krann_seg St_krann_seg.B_krakt_hs St_krann_seg.B_krein St_krann_seg.B_krzykl_verz St_ti St_ti.B_dosp_akt Tans Tmot Zr_seg_nstart /end IN_MEASUREMENT
/end FUNCTION
/begin FUNCTION ZWGRUND ""
 /begin DEF_CHARACTERISTIC CW_ZWDYN KF_DZW_DYN KF_DZW_DYNN KF_DZW_HZ KF_DZW_KR_GD KF_DZW_KR_VT KF_DZW_TD98 KF_DZW_VNS_GD KF_DZW_VNS_VT KF_DZW_WL_GD KF_DZW_WL_VT KF_FDZW_DYN1 KF_FDZW_DYN2 KF_FDZW_DYN3 KF_FDZW_DYN4 KF_FDZW_DYNN1 KF_FDZW_DYNN2 KF_FDZW_T KF_FDZW_VNS_GD KF_FDZW_VNS_VT KF_FZW_KR_GD KF_FZW_KR_VT KF_FZW_LAMKOR KF_FZW_WL_GD KF_FZW_WL_VT KF_TDRFSOLKR KF_TDRFZW KF_ZKRFSOLF KF_ZKRFSOLS KF_ZW_GD KF_ZW_GDS KF_ZW_GD_VL KF_ZW_NL KF_ZW_VT98 KF_ZW_VT98S KF_ZW_VTUESP KF_ZW_VT_VL98 KL_DRFSOL KL_DRFSOL1 KL_DRFSOLN KL_DZW_LAMKOR KL_FRFSOL KL_FZKRFSOLF KL_FZKRFSOLS KL_F_DYNAKT KL_F_DYNNAKT KL_F_DYNNVZ KL_F_DYNVZ KL_F_RFZWV KL_TD KL_TDDRFSOL KL_TDDRFSOLN KL_TDRFSOLO K_DRFSOL K_DRFSOLKRV K_DRFSOLKRVF K_MAT_RFKR K_MAT_ZWDYN K_MAT_ZWSTAT K_TDRFSOLGD K_TD_DZWDYNDEC K_ZKRFSOLGD K_ZWHZINI K_ZWHZRAMP S_DRFFLANKEIN S_DYNVH_RF S_ZWDYNRETRIG /end DEF_CHARACTERISTIC
 /begin REF_CHARACTERISTIC K_MAT_BAZW /end REF_CHARACTERISTIC
 /begin OUT_MEASUREMENT Dzw_hz Dzw_kr_gd Dzw_kr_vt Dzw_lam_kor Dzw_lam_kor1 Dzw_lam_kor2 Dzw_t1 Dzw_td98 Dzw_vns_gd Dzw_vns_vt Dzw_wl_gd Dzw_wl_vt Dzwdyn Dzwdyn_dek Dzwdyn_hold Dzwdynn Dzwdynn_dek Dzwdynn_hold Dzwt Dzwt_gd Dzwt_vt F_dynakt F_dynnakt F_dynnvz F_dynvz F_dzw_vns_gd F_dzw_vns_vt F_rfzwv F_zw_kr_gd F_zw_kr_vt F_zwhz Minhubsw Rf_sol_old Rf_solkrv Rf_solkrv_hold Rf_solkrv_old Rf_solkrvf Rf_solkrvf_old Rf_solkrvfgd Rf_solkrvgd Rf_solkrvof Rf_zwv Rfkr St_zwgrund St_zwgrund.B_zwdyn St_zwgrund.B_zwdynn St_zwgrund1 St_zwgrund1.B_rfsola St_zwgrund1.B_trigin St_zwgrund1.B_trigout St_zwgrund1.B_zwdynakt St_zwgrund1.B_zwdynvz St_zwgrund1.B_zwfall St_zwgrund1.B_zwsteig St_zwgrund2 St_zwgrund2.B_triginn St_zwgrund2.B_trigoutn St_zwgrund2.B_zwdynnakt St_zwgrund2.B_zwdynnvz St_zwgrundhs St_zwgrundhs.B_zwhz T_dzwdyn Td_dynakt Td_dyndek Td_dynnakt Td_dynndek Td_dynnvz Td_dynvz Tddrfsol Tddrfsol_dyn Tddrfsoln Tddrfsoln_dyn Zw_grund Zw_grund1 Zw_grund2 Zw_grund_vk Zw_timer Zw_vt98 Zw_vtuesp Zwdyn Zwdyn_gd Zwdyn_nl Zwdyn_vt Zwdyn_vt98 Zwdyn_vtuesp Zwstat Zwstat_gd Zwstat_nl Zwstat_vt /end OUT_MEASUREMENT
 /begin IN_MEASUREMENT Ba_ist Ba_soll Dpssolfilt Drf_soll Dvsa_ramp Dvse_ramp Dzw_annm Dzw_krann F_atldyn F_sicher_zw Gangi La_soll La_soll_stat1 La_soll_stat2 Minhub Nkw Rf Rf_soll St_bgkuppl1 St_bgkuppl1.B_ll St_getriebe St_getriebe.B_autget St_mdbanl St_mdbanl.B_agrzu_nl St_mdbanl.B_disa_nl St_mdbanl.B_evvt_vsa_nl St_mdbanl.B_evvt_vse_nl St_mdbanl.B_lastopp_nl St_mdbanl.B_tevzu_nl St_mdbanl.B_wesb1h_nl St_mdbanl.B_zw_nl St_motzustd St_motzustd.B_ll_roh St_motzustd.B_vl St_wmschalt0 St_wmschalt0.B_beende St_wmschalt0.B_hz_wm St_wmschalt0.B_ntlkws_v St_zwgrund.B_zwdyn St_zwgrund.B_zwdynn Tans Tmot V Zr_seg_nstart Zw_grund_nl /end IN_MEASUREMENT
/end FUNCTION
/begin FUNCTION ZWKS "" /begin DEF_CHARACTERISTIC KF_DZWKS KF_FDZWKS KF_ZWKS K_FDZWKS /end DEF_CHARACTERISTIC /begin OUT_MEASUREMENT Dzw_ks St_zwks St_zwks.B_zwks_err Zw_grund_nks Zw_ks /end OUT_MEASUREMENT
 /begin IN_MEASUREMENT Nkw Rf St_kr St_kr.B_clradkr St_kr.B_krdws St_kr.B_krndy St_kr.B_zwkraa St_kr1 St_kr1.B_krakt Tans Tmot Zw_grund /end IN_MEASUREMENT
/end FUNCTION
/begin FUNCTION ZWMIN "" /begin DEF_CHARACTERISTIC KF_ZW_MIN KL_DZWQUAD KL_ZW_MINTMOT /end DEF_CHARACTERISTIC /begin OUT_MEASUREMENT Dzw_min Eta_zw_min Eta_zw_mint Mdi_zwmin_lam Zw_min /end OUT_MEASUREMENT /begin IN_MEASUREMENT Dzw_koeff Mdi_opt_lam Nkw Rf Tmot Zw_opt /end IN_MEASUREMENT /end FUNCTION
/begin FUNCTION ZWOPT ""
 /begin DEF_CHARACTERISTIC KF_DZWO_KHVNS_GD KF_DZWO_KHVNS_VT KF_DZWO_KHWL_GD KF_DZWO_KHWL_VT KF_FDZWO_KHVNS KF_FZWOKH_LAMKOR KF_FZWO_KHWL_GD KF_FZWO_KHWL_VT KF_FZWO_LAMKOR KF_ZWOPT_GD KF_ZWOPT_GDS KF_ZWOPT_VT KF_ZWOPT_VTS KF_ZWOPT_VTUESP KF_ZWO_KHKGD KF_ZWO_KHKLLGD KF_ZWO_KHKLLVT KF_ZWO_KHKVT KF_ZWO_KHWGD KF_ZWO_KHWLLGD KF_ZWO_KHWLLVT KF_ZWO_KHWVT KL_DZWOKH_LAMKOR KL_DZWO_LAMKOR KL_MAT_BAZW K_MAT_BAZW /end DEF_CHARACTERISTIC
 /begin OUT_MEASUREMENT Dzwo_khwl_gd Dzwo_khwl_vt Dzwo_lam_kor Dzwo_lam_kor1 Dzwo_lam_kor2 Dzwokh_lam_kor Dzwokh_lam_kor1 Dzwokh_lam_kor2 Dzwot Dzwotkh Dzwotn F_dzwo_khvns Zw_opt Zw_opt1 Zw_opt2 Zw_opt_kh Zw_opt_kh1 Zw_opt_kh2 Zw_opt_khgd Zw_opt_khkgd Zw_opt_khkllgd Zw_opt_khkllvt Zw_opt_khkvt Zw_opt_khvk Zw_opt_khvt Zw_opt_khwgd Zw_opt_khwllgd Zw_opt_khwllvt Zw_opt_khwvt Zw_opt_n Zw_opt_n1 Zw_opt_n2 Zw_opt_nvk Zw_opt_nvkgd Zw_opt_nvkvt Zw_opt_vtk Zw_opt_vtk1 Zw_opt_vtk2 Zw_opt_vtn Zw_opt_vtuesp /end OUT_MEASUREMENT
 /begin IN_MEASUREMENT Ba_ist Ba_soll Baw_ist Baw_soll Dvsa_ramp Dvse_ramp F_atldyn F_sicher_zw F_wnwkh F_wnwkhk F_wnwkhk_2 F_zw_baw La_soll La_soll_stat1 La_soll_stat2 Nkw Rf_zwv St_bgkuppl1 St_bgkuppl1.B_ll St_mdbanl St_mdbanl.B_agrzu_nl St_mdbanl.B_disa_nl St_mdbanl.B_evvt_vsa_nl St_mdbanl.B_evvt_vse_nl St_mdbanl.B_lastopp_nl St_mdbanl.B_tevzu_nl St_mdbanl.B_wesb1h_nl St_mdbanl.B_zw_nl Tmot Zr_seg_nstart Zw_opt_nl /end IN_MEASUREMENT
/end FUNCTION
/begin FUNCTION ZWOUT "" /begin DEF_CHARACTERISTIC K_ETAZYLAUS_MIN K_ZWAPPL K_ZWAPPL_ZYL /end DEF_CHARACTERISTIC /begin OUT_MEASUREMENT Zw_bas Zw_ist Zw_out Zw_outmdkr Zw_ve Zw_vkr /end OUT_MEASUREMENT
 /begin IN_MEASUREMENT Dzw_kr Dzw_krkorll Eta_zyl_aus St_llr St_llr.B_llrein St_mdk St_mdk.B_asr_akt St_mdk.B_getr_plus St_mdk.B_md_dynman St_mdk.B_mdk_plus St_mdk.B_msr_aktiv St_mdk.B_san St_mdk.B_siko_akt St_mdk.B_zw_dynman St_sawe St_sawe.B_sa St_sawe.B_sae St_sawe.B_safast Zw_grund Zw_min Zw_offkorrvr Zw_soll Zw_start /end IN_MEASUREMENT
/end FUNCTION
/begin FUNCTION ZWSOLL "" /begin DEF_CHARACTERISTIC KL_DZWWURZ /end DEF_CHARACTERISTIC /begin OUT_MEASUREMENT Dzw_soll Eta_dzw_sollquad Eta_zw_soll Zw_soll /end OUT_MEASUREMENT /begin IN_MEASUREMENT Dzw_koeff Eta_zyl_aus Mdi_opt_lam Mdi_zw_soll Zw_opt /end IN_MEASUREMENT /end FUNCTION
/begin FUNCTION ZWSTART ""
 /begin DEF_CHARACTERISTIC KL_ZWSTN KL_ZWSTN_VVT KL_ZWSTT KL_ZWSTTA KL_ZWSTTA_VVT KL_ZWSTT_VVT /end DEF_CHARACTERISTIC
 /begin OUT_MEASUREMENT Zw_start /end OUT_MEASUREMENT
 /begin IN_MEASUREMENT Nkw St_dps St_dps.B_dpsadp St_dps.B_gd St_dps.B_gdst St_dps.B_gdvhub St_start St_start.B_jumpstart St_start.B_sta St_start.B_start St_start.B_startende St_start.B_wst Tans Tmot_start /end IN_MEASUREMENT
/end FUNCTION
/begin FUNCTION AGGR_AIRT_adaptation "" /begin OUT_MEASUREMENT tia_im lv_err_tia_im /end OUT_MEASUREMENT /end FUNCTION
/begin FUNCTION C_6_EXTC "C_6_EXTC"
 /begin DEF_CHARACTERISTIC ldpm_mff_sp_mv_1_extc ldpm_mff_sp_mv_2_extc ldpm_n_32_6_extc /end DEF_CHARACTERISTIC
 /begin SUB_FUNCTION EXTC_Ign_Ang_Diff_Cat_Heat_PI /end SUB_FUNCTION
/end FUNCTION
/begin FUNCTION EXTC_Ign_Ang_Diff_Cat_Heat_PI "_Ign_Ang_Diff_Cat_Heat_PI"
 /begin DEF_CHARACTERISTIC lc_iga_dif_s_ch_man_act c_iga_dif_s_ch_man ldp_mff_post_ip_iga_dif_ch_l ip_iga_dif_add_mff_post_ch_l ip_iga_dif_s_ch_l_bas ip_iga_dif_s_ch_ast_bas /end DEF_CHARACTERISTIC
 /begin OUT_MEASUREMENT iga_dif_s_ch /end OUT_MEASUREMENT
/end FUNCTION
/begin FUNCTION C_D_EXTC "C_D_EXTC"
 /begin DEF_CHARACTERISTIC ldpm_tqi_req_tra_1_extc ldpm_tqi_req_tra_2_extc ldpm_tco_st_4_extc ldpm_tco_st_5_extc /end DEF_CHARACTERISTIC
 /begin SUB_FUNCTION EXTC_Torque_Based_Cat_Heat EXTC_Torque_Based_Catalyst_heading_for_desulfation /end SUB_FUNCTION
/end FUNCTION
/begin FUNCTION EXTC_Torque_Based_Cat_Heat "_Torque_Based_Cat_Heat"
 /begin DEF_CHARACTERISTIC c_tq_add_ch_hom_man lc_tq_add_ch_hom_man_act lc_tq_add_ch_mplh_man_act c_tq_add_ch_lgrd_on c_tq_add_ch_lgrd_off ip_tq_add_ch_hom_is ip_tq_add_ch_mplh_is c_tq_add_ch_mplh_man c_tq_add_ch_l_lgrd ip_fac_tq_add_ch_l ldp_n_32_ip_tq_add_ch_l ldp_n_32_ip_tq_add_ch_l_is ldp_tqi_req_ip_tq_add_ch_l ldp_tqi_req_ip_tq_add_ch_l_is ip_tq_add_ch_l_hom_is ldp_amp_ip_fac_tq_add_ch_amp ip_fac_tq_add_ch_amp ldp_n_32_ip_tq_so2p_max ldp_tqi_req_tra_ip_tq_so2p_max ip_tq_add_so2p_max ip_fac_tq_add_ch_hom ip_fac_tq_add_ch_hom_at ip_fac_tq_add_ch_mplh ip_fac_tq_add_ch_mplh_at ip_tq_add_ch_l_hom ip_tq_add_ch_hom_at ip_tq_add_ch_mplh ip_tq_add_ch_mplh_at ip_tq_add_ch_hom ip_fac_tq_add_ch_mplh_dri ip_fac_tq_add_ch_hom_dri ip_fac_tq_add_ch_ctr_km /end DEF_CHARACTERISTIC
 /begin OUT_MEASUREMENT tq_add_ch tq_add_so2p tq_add_so2p_i tq_add_so2p_p tq_add_so2p_pctl tq_add_so2p_raw /end OUT_MEASUREMENT
/end FUNCTION
/begin FUNCTION EXTC_Torque_Based_Catalyst_heading_for_desulfation ""
 /begin DEF_CHARACTERISTIC ip_tq_add_so2p_pctl ldp_n_32_ip_tq_so2p_pctl ldp_tqi_req_tra_ip_tq_so2p_pctl c_fac_tq_add_so2p_pctl_mplh c_tq_add_so2p_i c_tq_add_so2p_i_max c_tq_add_so2p_p c_tq_add_so2p_p_max c_tq_add_so2p_ramp_dec c_tq_add_so2p_ramp_inc ldp_n_32_ip_nox_cor_s_hys ldp_n_32_ip_nox_cor_homs_hys /end DEF_CHARACTERISTIC
/end FUNCTION
/begin FUNCTION C_7_EXTC "C_7_EXTC"
 /begin DEF_CHARACTERISTIC ldpm_mff_post_inj_1_extc ldpm_n_32_7_extc ldpm_n_32_8_extc ldpm_maf_1_extc ldpm_maf_2_extc ldpm_fac_maf_rel_egr_cor_1_extc ldpm_n_32_2_extc ldpm_n_32_3_extc ldpm_n_32_5_extc ldpm_fac_maf_rel_egr_cor_4_extc ldpm_fac_maf_rel_egr_cor_2_extc ldpm_fac_maf_rel_egr_cor_3_extc ldpm_tco_5_extc ldpm_tco_6_extc ldpm_t_ast_4_extc ldpm_t_ast_6_extc /end DEF_CHARACTERISTIC
 /begin SUB_FUNCTION EXTC_Inj_Phase_Homo_2_Pulse EXTC_Inj_Phase_Homo_1_Pulse EXTC_Lambda_SP_Cat_Heat EXTC_mff_sp_second_inj_hom_cat_heading EXTC_mff_sp_post_inj_hom_cat_heading EXTC_inj_phase_post_inj_cat_heading /end SUB_FUNCTION
/end FUNCTION
/begin FUNCTION EXTC_Inj_Phase_Homo_2_Pulse "_Inj_Phase_Homo_2_Pulse"
 /begin DEF_CHARACTERISTIC c_eoi_2_delta_mplh_ch_man lc_eoi_2_delta_mplh_ch_man_act ldp_mff_2_ip_eoi_2_mplh_ch_add ip_eoi_2_delta_mplh_ch_ast ip_eoi_2_mplh_ch_add_mff_2 ip_eoi_2_delta_mplh_ch_so2p /end DEF_CHARACTERISTIC
 /begin OUT_MEASUREMENT eoi_2_delta_mplh_ch /end OUT_MEASUREMENT
/end FUNCTION
/begin FUNCTION EXTC_Inj_Phase_Homo_1_Pulse "_Inj_Phase_Homo_1_Pulse"
 /begin DEF_CHARACTERISTIC ip_soi_1_ch_add_tco ldp_tco_ip_soi_1_ch_add_tco c_soi_1_mplh_ch_man lc_soi_1_mplh_ch_man_act ip_soi_1_mplh_ch_ast ip_soi_1_mplh_ch_so2p /end DEF_CHARACTERISTIC
 /begin OUT_MEASUREMENT soi_1_mplh_ch[0] soi_1_mplh_ch[1] soi_1_mplh_ch[2] soi_1_mplh_ch[3] soi_1_mplh_ch[4] soi_1_mplh_ch[5] soi_1_mplh_ch[6] soi_1_mplh_ch[7] /end OUT_MEASUREMENT
/end FUNCTION
/begin FUNCTION EXTC_Lambda_SP_Cat_Heat "_Lambda_SP_Cat_Heat"
 /begin DEF_CHARACTERISTIC ip_lamb_ch_ast_hom ip_lamb_ch_ast_hom_is ip_lamb_add_ch_ast_hom ip_lamb_add_ch_ast_mplh ip_lamb_ch_ast_mplh_is ip_lamb_ch_ast_mplh c_lamb_sp_ch_man[0] c_lamb_sp_ch_man[1] lc_lamb_sp_ch_man_act lc_lamb_sp_ch_so2p_man_act lc_lamb_so2p_fast_ena ldpm_n_32_10_extc ldpm_n_32_9_extc ldpm_tqi_req_slow_3_extc ldpm_tqi_req_slow_4_extc /end DEF_CHARACTERISTIC
 /begin OUT_MEASUREMENT lamb_sp_ch[0] lamb_sp_ch[1] lamb_sp_ch_so2p[0] lamb_sp_ch_so2p[1] /end OUT_MEASUREMENT
/end FUNCTION
/begin FUNCTION EXTC_mff_sp_second_inj_hom_cat_heading ""
 /begin DEF_CHARACTERISTIC ip_mff_sp_2_add_iga_ch c_mff_sp_2_mplh_ch_man lc_mff_sp_2_mplh_ch_man_act ip_mff_sp_2_mplh_ch_ast ip_mff_sp_2_mplh_ch_so2p ldp_iga_h_rng_ip_mff_2_mplh_ch /end DEF_CHARACTERISTIC
 /begin OUT_MEASUREMENT mff_sp_2_mplh_ch /end OUT_MEASUREMENT
/end FUNCTION
/end MODULE
/end PROJECT
