ASAP2_VERSION 1 3
/begin PROJECT _725D601B "725D601B"
/begin HEADER "" VERSION "_725D601B" PROJECT_NO _725D601B /end HEADER
/begin MODULE DIM ""
/begin MOD_COMMON "" BYTE_ORDER MSB_FIRST ALIGNMENT_BYTE 1 ALIGNMENT_WORD 2 ALIGNMENT_LONG 2 ALIGNMENT_FLOAT32_IEEE 4 /end MOD_COMMON
/begin CHARACTERISTIC ABSCHKORA "Applikationswert f¸r Korrektur Abschaltung" VALUE 0xFCC614 KwWU16 200.000 fak_q0p004_o100 -100.000 100.000 /end CHARACTERISTIC
/begin CHARACTERISTIC ANZSLPMX "maximal zugelassene Anzahl SLP-Ansteuerungen" VALUE 0xFD55F6 KwUb 255.0 dez 0.00 255.0 FORMAT "%5.1" /end CHARACTERISTIC
/begin CHARACTERISTIC ARY_PRIO "" VAL_BLK 0xFCC39C KwbWS8 7.000 DEZ 0.00 7.000 FORMAT "%5.3" NUMBER 6 /end CHARACTERISTIC
/begin CHARACTERISTIC ARY_PRIOCF "" VAL_BLK 0xFCC3A2 KwbWU8 7.000 DEZ 0.00 7.000 FORMAT "%5.3" NUMBER 7 /end CHARACTERISTIC
/begin CHARACTERISTIC ARY_PWRCF "" VAL_BLK 0xFCC32C KwbWU16 65535.00 DEZ 0.00 65535.00 FORMAT "%8.2" NUMBER 7 /end CHARACTERISTIC
/begin CHARACTERISTIC ARY_PWRDF "" VAL_BLK 0xFCC33A KwbWU16 65535.00 DEZ 0.00 65535.00 FORMAT "%8.2" NUMBER 14 /end CHARACTERISTIC
/begin CHARACTERISTIC ASPRNOTL "Auslasspreizung im Notlauf" VALUE 0xFCD754 KwWU8 204.0 sprzi_q0p8 0.00 204.0 FORMAT "%5.1" /end CHARACTERISTIC
/begin CHARACTERISTIC ASPSAN "zus. Auslasspreizung in Schubabschaltung" CURVE 0xFCD6A6 KlAxU8SstxU16WS16 52428.00 sprzi_q0p8 -26214.40 26213.60 FORMAT "%8.2"
 /begin AXIS_DESCR STD_AXIS nmot_w nmot_uw_q0p25 5 0.00 10000.00 FORMAT "%8.2" DEPOSIT ABSOLUTE /end AXIS_DESCR
/end CHARACTERISTIC
/begin CHARACTERISTIC BILA_OGRZ "" VALUE 0xFCC616 KwWU16 99.99847 rel_uw_b100 0.00 99.99847 FORMAT "%8.5" /end CHARACTERISTIC
/begin CHARACTERISTIC BILA_UGRZ "" VALUE 0xFCC618 KwWU16 99.99847 rel_uw_b100 0.00 99.99847 FORMAT "%8.5" /end CHARACTERISTIC
/begin CHARACTERISTIC B_IFBSAAPP "Appl-para. f¸r Bedingung Fehler vom BSD" VALUE 0xFCC18B KwWU8 255.0 DEZ 0.00 255.0 FORMAT "%5.1" /end CHARACTERISTIC
/begin CHARACTERISTIC B_IFUPLAPP "Apll-par. f¸r Bedg. Fehler vom IBS" VALUE 0xFCC18C KwWU8 255.0 DEZ 0.00 255.0 FORMAT "%5.1" /end CHARACTERISTIC
/begin CHARACTERISTIC B_ULCPAPP "" VALUE 0xFCC3D0 KwWU8 255.0 DEZ 0.00 255.0 FORMAT "%5.1" /end CHARACTERISTIC
/begin CHARACTERISTIC CBATT_DEF "Ersatzwert Batteriekapazit‰t" VALUE 0xFCC498 KwWU8 254.0 DEZ 1.000 255.0 FORMAT "%5.1" /end CHARACTERISTIC
/begin CHARACTERISTIC CDAGR "Codewort DAGR abschalten (EURO-Codierung), CD..=0 -> keine Diagnose" VALUE 0xFCC687 KwUb 255.0 dez 0.00 255.0 FORMAT "%5.1" /end CHARACTERISTIC
/begin CHARACTERISTIC CDDMTL "Codewort DMTL-Diagnose einschalten (EURO-Codierung), CD..=0 -> keine Dia" VALUE 0xFCC688 KwUb 255.0 dez 0.00 255.0 FORMAT "%5.1" /end CHARACTERISTIC
/begin CHARACTERISTIC CDDYLSU "Codewort Diagnose Dynamikverhalten der LSU" VALUE 0xFCC689 KwUb 255.0 dez 0.00 255.0 FORMAT "%5.1" /end CHARACTERISTIC
/begin CHARACTERISTIC CDEFST "Codewort DFSTT abschalten (EURO-Codierung), CD..=0 -> keine Diagnose" VALUE 0xFCC68A KwUb 255.0 dez 0.00 255.0 FORMAT "%5.1" /end CHARACTERISTIC
/begin CHARACTERISTIC CDHELSU "Codewort Diagnose Heizereinkopplung" VALUE 0xFCC68B KwUb 255.0 dez 0.00 255.0 FORMAT "%5.1" /end CHARACTERISTIC
/begin CHARACTERISTIC CDHRLSU "Codewort zum Einschalten der DHRLSU" VALUE 0xFCC68C KwUb 255.0 dez 0.00 255.0 FORMAT "%5.1" /end CHARACTERISTIC
/begin CHARACTERISTIC CDHRLSUE "Codewort zum Einschalten der DHRLSUE" VALUE 0xFCC68D KwUb 255.0 dez 0.00 255.0 FORMAT "%5.1" /end CHARACTERISTIC
/begin CHARACTERISTIC CDHSH "Codewort Heizerdiagnose hinter Kat (CDHSH = 0  => keine Diagnose)" VALUE 0xFCC68E KwUb 255.0 dez 0.00 255.0 FORMAT "%5.1" /end CHARACTERISTIC
/begin CHARACTERISTIC CDHSHE "Eurobit f¸r Diagnose Entstufe Lambdasondenheizung hinter Kat" VALUE 0xFCC68F KwUb 255.0 dez 0.00 255.0 FORMAT "%5.1" /end CHARACTERISTIC
/begin CHARACTERISTIC CDHSV "Codewort Heizerdiagnose vor Kat im (CDHSV = 0  => keine Diagnose)" VALUE 0xFCC690 KwUb 255.0 dez 0.00 255.0 FORMAT "%5.1" /end CHARACTERISTIC
/begin CHARACTERISTIC CDHSVSA "Codewort Heizerdiagnose vor Kat im Schub (CDHSVsa = 0  => keine Diagnose)" VALUE 0xFCC672 KwWU8 255.0 dez 0.00 255.0 FORMAT "%5.1" /end CHARACTERISTIC
/begin CHARACTERISTIC CDICLSU "Codewort Dignose: Auswerte-IC f¸r Breitband-Lambdasonde LSU" VALUE 0xFCC691 KwUb 255.0 dez 0.00 255.0 FORMAT "%5.1" /end CHARACTERISTIC
/begin CHARACTERISTIC CDKAT "Codewort Katalysator-Diagnose im OBDII-Mode (invers: Europa-Mode)" VALUE 0xFCC692 KwUb 255.0 dez 0.00 255.0 FORMAT "%5.1" /end CHARACTERISTIC
/begin CHARACTERISTIC CDKATSP "Codewort Katalysator-Diagnose im OBDII-Mode (invers: Europa-Mode)" VALUE 0xFCC673 KwWU8 255.0 dez 0.00 255.0 FORMAT "%5.1" /end CHARACTERISTIC
/begin CHARACTERISTIC CDKATSPF "Katdiagnose, Freigabe" VALUE 0xFCC674 KwWU8 255.0 dez 0.00 255.0 FORMAT "%5.1" /end CHARACTERISTIC
/begin CHARACTERISTIC CDKVS "Codeword DKVS aktiv/inaktiv, CD..=0 -> keine Diagnose" VALUE 0xFCC693 KwUb 255.0 dez 0.00 255.0 FORMAT "%5.1" /end CHARACTERISTIC
/begin CHARACTERISTIC CDLASH "Codewort Lambdasondenalterungsdiagnose (SHK) im OBDII-Mode (invers: Europa-Mode)" VALUE 0xFCC694 KwUb 255.0 dez 0.00 255.0 FORMAT "%5.1" /end CHARACTERISTIC
/begin CHARACTERISTIC CDLDP "Codewort LDP-Diagnose im OBDII-Modus (invers: Europa-Modus), CD..=0 -> keine Dia" VALUE 0xFCC695 KwUb 255.0 dez 0.00 255.0 FORMAT "%5.1" /end CHARACTERISTIC
/begin CHARACTERISTIC CDLLR "Codewort DLLR abschalten (EURO-Codierung), CD..=0 -> keine Diagnose" VALUE 0xFCC696 KwUb 255.0 dez 0.00 255.0 FORMAT "%5.1" /end CHARACTERISTIC
/begin CHARACTERISTIC CDLSH "Codewort Sondendiagnose hinter Kat im OBDII-Mode (invers: Europa-Mode)" VALUE 0xFCC697 KwUb 255.0 dez 0.00 255.0 FORMAT "%5.1" /end CHARACTERISTIC
/begin CHARACTERISTIC CDLSV "Codewort Sondendiagnose vor KAT im OBDII-Mode" VALUE 0xFCC698 KwUb 255.0 dez 0.00 255.0 FORMAT "%5.1" /end CHARACTERISTIC
/begin CHARACTERISTIC CDLSVV "Codewort Diagnose vertauschte Sonden vor Kat im OBDII-Mode (invers: Europa-Mode)" VALUE 0xFCC699 KwUb 255.0 dez 0.00 255.0 FORMAT "%5.1" /end CHARACTERISTIC
/begin CHARACTERISTIC CDMD "Codewort DMD abschalten (EURO-Codierung), CD..=0 -> keine Diagnose" VALUE 0xFCC69A KwUb 255.0 dez 0.00 255.0 FORMAT "%5.1" /end CHARACTERISTIC
/begin CHARACTERISTIC CDNWS "Codewort DNWS abschalten (EURO-Codierung), CD..=0 -> keine Diagnose" VALUE 0xFCC675 KwWU8 255.0 dez 0.00 255.0 FORMAT "%5.1" /end CHARACTERISTIC
/begin CHARACTERISTIC CDPLLSU "Codewort Plausibilit‰tsdiagnose LSU" VALUE 0xFCC69B KwUb 255.0 dez 0.00 255.0 FORMAT "%5.1" /end CHARACTERISTIC
/begin CHARACTERISTIC CDSALSU "Codewort:  Diagnose Schubabgleich aktiv" VALUE 0xFCC69C KwUb 255.0 dez 0.00 255.0 FORMAT "%5.1" /end CHARACTERISTIC
/begin CHARACTERISTIC CDSLS "Euro-Byte f¸r Diagnose Sekund‰rluft-System" VALUE 0xFCC69D KwUb 255.0 dez 0.00 255.0 FORMAT "%5.1" /end CHARACTERISTIC
/begin CHARACTERISTIC CDSLSFZ "Codewort Fahrzeug mit Sekund‰rluftsystem" VALUE 0xFCC69E KwUb 255.0 dez 0.00 255.0 FORMAT "%5.1" /end CHARACTERISTIC
/begin CHARACTERISTIC CDSWE "Codewort DSWE abschalten (EURO-Codierung), CD..=0 -> keine Diagnose" VALUE 0xFCC69F KwUb 255.0 dez 0.00 255.0 FORMAT "%5.1" /end CHARACTERISTIC
/begin CHARACTERISTIC CDTANKL "Codewort DTANKL abschalten (EURO-Codierung), CD..=0 -> keine Diagnose" VALUE 0xFCC6A0 KwUb 255.0 dez 0.00 255.0 FORMAT "%5.1" /end CHARACTERISTIC
/begin CHARACTERISTIC CDTES "Codewort Tankentl¸ftungsdiagnose abschalten (EURO-Codierung), CD..=0 ->keine Dia" VALUE 0xFCC6A1 KwUb 255.0 dez 0.00 255.0 FORMAT "%5.1" /end CHARACTERISTIC
/begin CHARACTERISTIC CDULSU "Codewort Spannungs¸berwachung stetige Lambdasonde" VALUE 0xFCC6A2 KwUb 255.0 dez 0.00 255.0 FORMAT "%5.1" /end CHARACTERISTIC
/begin CHARACTERISTIC CODINDEX "Codierindex" VALUE 0xFD40FA KwUb 255.0 dez 0.00 255.0 FORMAT "%5.1" /end CHARACTERISTIC
/begin CHARACTERISTIC CTRCBRA "" VALUE 0xFCC3D1 KwWU8 255.0 DEZ 0.00 255.0 FORMAT "%5.1" /end CHARACTERISTIC
/begin CHARACTERISTIC CTRCBRAPP "Steuerung Stromzweige" VALUE 0xFCC3D2 KwWU8 255.0 DEZ 0.00 255.0 FORMAT "%5.1" /end CHARACTERISTIC
/begin CHARACTERISTIC CTRPCOSAPP "Steuerung Standverbraucher" VALUE 0xFCC3D3 KwWU8 3.000 DEZ 0.00 3.000 FORMAT "%5.3" /end CHARACTERISTIC
/begin CHARACTERISTIC CTRPRIOAPP "Steuerung Spitzenreduzierung Prioritaet" VALUE 0xFCC3D4 KwWU8 7.000 DEZ 0.00 7.000 FORMAT "%5.3" /end CHARACTERISTIC
/begin CHARACTERISTIC CTRPWSA "" VALUE 0xFCC3D5 KwWU8 127.5 fak_q0p5 0.00 127.5 FORMAT "%5.1" /end CHARACTERISTIC
/begin CHARACTERISTIC CWALE "Auslauferkennung aktiv" VALUE 0xFCC676 KwWU8 255.0 dez 0.00 255.0 FORMAT "%5.1" /end CHARACTERISTIC
/begin CHARACTERISTIC CWBDE1 "Codewort 1 f¸r BDE" VALUE 0xFCC670 KwWU16 65535.00 dez 0.00 65535.00 FORMAT "%8.2" /end CHARACTERISTIC
/begin CHARACTERISTIC CWCODCAN "Codewort Umschaltung CAN11h/CAN12h" VALUE 0xFCC6A3 KwUb 1.000 dez 11.00 12.00 FORMAT "%5.2" /end CHARACTERISTIC
/begin CHARACTERISTIC CWCODFZG "Codewort Umschaltung Fahrzeugvariante" VALUE 0xFCC6A4 KwUb 255.0 dez 0.00 255.0 FORMAT "%5.1" /end CHARACTERISTIC
/begin CHARACTERISTIC CWERFIL "Codewort zur Auswahl Filtervar. f¸r die Ausgabe von AS.-Fehler an das Scan Tool" VALUE 0xFCC677 KwWU8 255.0 dez 0.00 255.0 FORMAT "%5.1" /end CHARACTERISTIC
/begin CHARACTERISTIC CWFASL "Codewort: Testereingriff Sekund‰rluftdiagnose" VALUE 0xFD55F7 KwUb 255.0 dez 0.00 255.0 FORMAT "%5.1" /end CHARACTERISTIC
/begin CHARACTERISTIC CWGEN "Codewort f¸r Generatorschnittstelle z.B. Unterst¸tzung von 2 Generatoren" VALUE 0xFCC678 KwWU8 255.0 dez 0.00 255.0 FORMAT "%5.1" /end CHARACTERISTIC
/begin CHARACTERISTIC CWGEN1 "Codewort: kein Einfluss des Generatormomentes auf mdverl" VALUE 0xFCC679 KwWU8 255.0 dez 0.00 255.0 FORMAT "%5.1" /end CHARACTERISTIC
/begin CHARACTERISTIC CWGEN2 "Codewort: kein Einfluss des Generatormomentes auf mimin" VALUE 0xFCC67A KwWU8 255.0 dez 0.00 255.0 FORMAT "%5.1" /end CHARACTERISTIC
/begin CHARACTERISTIC CWKMMILSCT "Ausgabe ""Km bei MIL on""  f¸r Scan Tool abschalten (0 = keine Ausgabe in PID $21)" VALUE 0xFCC67B KwWU8 255.0 dez 0.00 255.0 FORMAT "%5.1" /end CHARACTERISTIC
/begin CHARACTERISTIC CWKONABG "Codewort f¸r Konfiguration Abgasbehandlung" VALUE 0xFD40F5 KwUb 255.0 dez 0.00 255.0 FORMAT "%5.1" /end CHARACTERISTIC
/begin CHARACTERISTIC CWKONFLS "Beschreibung der Lambdasondenposition hinter Katalysator im Abgasstrang" VALUE 0xFCC67C KwWU8 255.0 dez 0.00 255.0 FORMAT "%5.1" /end CHARACTERISTIC
/begin CHARACTERISTIC CWKONLS "Codewort f¸r Konfiguration Lambda Sonden" VALUE 0xFCC67D KwWU8 255.0 dez 0.00 255.0 FORMAT "%5.1" /end CHARACTERISTIC
/begin CHARACTERISTIC CWLSHA "Codewort f¸r Lambdasonden hinter KAT Alterung in %DLSAHK" VALUE 0xFCC67E KwWU8 255.0 dez 0.00 255.0 FORMAT "%5.1" /end CHARACTERISTIC
/begin CHARACTERISTIC CWMDAPP "Codewort Applikation ohne Drehmomentfunktionen" VALUE 0xFCC67F KwWU8 255.0 dez 0.00 255.0 FORMAT "%5.1" /end CHARACTERISTIC
/begin CHARACTERISTIC CWMDKOL "Codeword MDKOL: Momentenbegrenzung" VALUE 0xFCC680 KwWU8 255.0 dez 0.00 255.0 FORMAT "%5.1" /end CHARACTERISTIC
/begin CHARACTERISTIC CWNLDGRSTG "Codewort f¸r Drehzalgebernotlauf in der Restgassteuerung" VALUE 0xFCD755 KwWU8 1.000 DEZ 0.00 1.000 FORMAT "%5.3" /end CHARACTERISTIC
/begin CHARACTERISTIC CWNSABG "Codewort Einstellen Leerlauf-Solldrehzahl mit Diagnosetester" VALUE 0xFD40F6 KwUb 255.0 dez 0.00 255.0 FORMAT "%5.1" /end CHARACTERISTIC
/begin CHARACTERISTIC CWOBD "Codewort f¸r Konfiguration OBD Zertifikationsnachweis" VALUE 0xFCC6A5 KwUb 255.0 dez 0.00 255.0 FORMAT "%5.1" /end CHARACTERISTIC
/begin CHARACTERISTIC CWPKAPP "Codewort Applikation Druckreferenz f¸r Kraftstoffdruckregler" VALUE 0xFC77AC KwWU8 255.0 dez 0.00 255.0 FORMAT "%5.1" /end CHARACTERISTIC
/begin CHARACTERISTIC CWPSGER "Codewort Umschaltung Saugrohrdruck von modelliertem auf gerechneten" VALUE 0xFCC681 KwWU8 255.0 dez 0.00 255.0 FORMAT "%5.1" /end CHARACTERISTIC
/begin CHARACTERISTIC CWPWF "Codewort Powerfail" VALUE 0xFCC682 KwWU8 255.0 dez 0.00 255.0 FORMAT "%5.1" /end CHARACTERISTIC
/begin CHARACTERISTIC CWRTFSGID "" VALUE 0xFCC6A9 KwWU8 255.0 default 0.00 255.0 FORMAT "%5.1" /end CHARACTERISTIC
/begin CHARACTERISTIC CWRTFSGMEM "" VALUE 0xFCC6AA KwWU8 255.0 default 0.00 255.0 FORMAT "%5.1" /end CHARACTERISTIC
/begin CHARACTERISTIC CWRTFSGMOD "" VALUE 0xFCC6AB KwWU8 255.0 default 0.00 255.0 FORMAT "%5.1" /end CHARACTERISTIC
/begin CHARACTERISTIC CWSCTMDE "Codewort zum abschalten bestimmter Scan Tool Modes/Services (Bit=0 ->  Mode aus)" VALUE 0xFCC683 KwWU8 255.0 dez 0.00 255.0 FORMAT "%5.1" /end CHARACTERISTIC
/begin CHARACTERISTIC CWSLS "Codewort f¸r Sekund‰rluftsystem" VALUE 0xFCC6A6 KwUb 255.0 dez 0.00 255.0 FORMAT "%5.1" /end CHARACTERISTIC
/begin CHARACTERISTIC CWSLS2 "zweites Codewort f¸r Sekund‰rluftsystem" VALUE 0xFCC6A7 KwUb 255.0 dez 0.00 255.0 FORMAT "%5.1" /end CHARACTERISTIC
/begin CHARACTERISTIC CWTF "Codewort f¸r Konfiguration Temperaturf¸hler" VALUE 0xFCC684 KwWU8 255.0 dez 0.00 255.0 FORMAT "%5.1" /end CHARACTERISTIC
/begin CHARACTERISTIC CWUHR "Codewort f¸r Uhr" VALUE 0xFCC685 KwWU8 255.0 dez 0.00 255.0 FORMAT "%5.1" /end CHARACTERISTIC
/begin CHARACTERISTIC CWVL "Erkennung Vollast ¸ber relativen Fahrerwunsch (CWVL=1)" VALUE 0xFCC686 KwWU8 255.0 dez 0.00 255.0 FORMAT "%5.1" /end CHARACTERISTIC
/begin CHARACTERISTIC C_RESET_PI "PI-Reset-Zeit bei steigender Kl.15 = C_RESET_PI * Taskzeit" VALUE 0xFCC3D6 KwWU8 25.50 t_q0p1 0.00 25.50 FORMAT "%5.2" /end CHARACTERISTIC
/begin CHARACTERISTIC dataID "Identifikationsnummer Datensatz" ASCII 0xFC0210 KwbWU8 255.0 KennText 0.00 255.0 FORMAT "%5.1" NUMBER 51 /end CHARACTERISTIC
/begin CHARACTERISTIC DFFGENAPP "" VALUE 0xFCC3D7 KwWU8 100.0 rel_ub_b100 0.00 100.0 FORMAT "%5.1" /end CHARACTERISTIC
/begin CHARACTERISTIC DFFILTAPP "" VALUE 0xFCC3D8 KwWU8 100.0 rel_ub_b100 0.00 100.0 FORMAT "%5.1" /end CHARACTERISTIC
/begin CHARACTERISTIC DFMAX "Grenze von DF, oberhalb derer die Prio gesetzt werden." VALUE 0xFCC3D9 KwWU8 100.0 rel_ub_b100 0.00 100.0 FORMAT "%5.1" /end CHARACTERISTIC
/begin CHARACTERISTIC DFMIN "DF-Grenze unterhalb derer die Prio geloescht werden." VALUE 0xFCC3DA KwWU8 100.0 rel_ub_b100 0.00 100.0 FORMAT "%5.1" /end CHARACTERISTIC
/begin CHARACTERISTIC DFOVERRIDE "Schwellwert wann Generator als ueberlastet erkannt wird" VALUE 0xFCC18D KwWU8 100.0 rel_ub_b100 0.00 100.0 FORMAT "%5.1" /end CHARACTERISTIC
/begin CHARACTERISTIC DNMOTGLUE "" VALUE 0xFCD756 KwWU8 10200. nmot_ub_q40 0.00 10200. FORMAT "%5.0" /end CHARACTERISTIC
/begin CHARACTERISTIC DPSLV "minimale Druckdifferenz Sekund‰rluftventi" VALUE 0xFD55F8 KwUb 1275. p_ub_q5 0.00 1275. FORMAT "%5.0" /end CHARACTERISTIC
/begin CHARACTERISTIC DSOCA "Applikationsgrˆsse f¸r d_soc" VALUE 0xFCC61A KwWU16 200.000 fak_q0p004_o100 -100.000 100.000 /end CHARACTERISTIC
/begin CHARACTERISTIC DSOCABSCH "Applikationsgrˆsse f¸r d_soc" VALUE 0xFCC61C KwWU16 200.000 fak_q0p004_o100 -100.000 100.000 /end CHARACTERISTIC
/begin CHARACTERISTIC DSOCHYST "Hysterese zur Deaktivierung der Prios bzw. LLDZanh." VALUE 0xFCC3AA KwWU16 200.000 fak_q0p004_o100 -100.000 100.000 /end CHARACTERISTIC
/begin CHARACTERISTIC DSOCPCOS "dsoc-Wert, unterhalb derer die Standverbraucher deaktiviert werden." VALUE 0xFCC3AC KwWU16 200.000 fak_q0p004_o100 -100.000 100.000 /end CHARACTERISTIC
/begin CHARACTERISTIC DTEMN "Min-Schwelle f¸r delta effekt. Einspritzzeit" VALUE 0xFC77A4 KwWU16 65.53500 t1p0usxms 0.00 65.53500 FORMAT "%8.5" /end CHARACTERISTIC
/begin CHARACTERISTIC DTMSPR "Temperaturhysterese f¸r Verstellung Ein- und Auslasspreizung" VALUE 0xFCD757 KwWU8 191.3 temp_ub_q0p75_o48 -48.00 143.3 FORMAT "%5.1" /end CHARACTERISTIC
/begin CHARACTERISTIC DWKRMGLUE "" VALUE 0xFCD758 KwWU8 191.3 zw_ub_q0p75 0.00 191.3 FORMAT "%5.1" /end CHARACTERISTIC
/begin CHARACTERISTIC D_AB_KORR1 "Korrekturkonstante 1 f¸r Abschaltung" VALUE 0xFCC61E KwWU16 200.000 fak_q0p004_o100 -100.000 100.000 /end CHARACTERISTIC
/begin CHARACTERISTIC D_AB_KORR2 "Korrekturkonstante 2 f¸r Abschaltung" VALUE 0xFCC620 KwWU16 200.000 fak_q0p004_o100 -100.000 100.000 /end CHARACTERISTIC
/begin CHARACTERISTIC D_AB_KORR3 "Korrekturkonstante 3 f¸r Abschaltung" VALUE 0xFCC622 KwWU16 200.000 fak_q0p004_o100 -100.000 100.000 /end CHARACTERISTIC
/begin CHARACTERISTIC EHZOLDAPP "PTC-Leistung-Wert manuell, gesetzt durch SPTCOLDMAN und S_PTC_OLD" VALUE 0xFCC3DB KwWU8 127.5 fak_q0p5 0.00 127.5 FORMAT "%5.1" /end CHARACTERISTIC
/begin CHARACTERISTIC ENAPPULCP "Enable ""ultra low cost Powermanagment""" VALUE 0xFCC6A8 KwUb 255.0 dez 0.00 255.0 FORMAT "%5.1" /end CHARACTERISTIC
/begin CHARACTERISTIC ESPRNOTL "Auslasspreizung im Notlauf" VALUE 0xFCD759 KwWU8 204.0 sprzi_q0p8 0.00 204.0 FORMAT "%5.1" /end CHARACTERISTIC
/begin CHARACTERISTIC ESPSAN "zus. Einlasspreizung in Schubabschaltung" CURVE 0xFCD6BC KlAxU8SstxU16WS16 52428.00 sprzi_q0p8 -26214.40 26213.60 FORMAT "%8.2"
 /begin AXIS_DESCR STD_AXIS nmot_w nmot_uw_q0p25 5 0.00 10000.00 FORMAT "%8.2" DEPOSIT ABSOLUTE /end AXIS_DESCR
/end CHARACTERISTIC
/begin CHARACTERISTIC FASTW "Faktor Auslass teilgedrosselt warm" CURVE 0xFCD6E4 KlAxU8SstxU8WU8 0.9961 fakspr_q0p0039 0.00 0.9961
 /begin AXIS_DESCR STD_AXIS tmot temp_ub_q0p75_o48 6 -48.00 143.3 FORMAT "%5.1" DEPOSIT ABSOLUTE /end AXIS_DESCR
/end CHARACTERISTIC
/begin CHARACTERISTIC FASW "Faktor Auslass ungedrosselt warm" CURVE 0xFCD6F1 KlAxU8SstxU8WU8 0.9961 fakspr_q0p0039 0.00 0.9961
 /begin AXIS_DESCR STD_AXIS tmot temp_ub_q0p75_o48 6 -48.00 143.3 FORMAT "%5.1" DEPOSIT ABSOLUTE /end AXIS_DESCR
/end CHARACTERISTIC
/begin CHARACTERISTIC FESTW "Faktor Einlass teilgedrosselt warm" CURVE 0xFCD6FE KlAxU8SstxU8WU8 0.9961 fakspr_q0p0039 0.00 0.9961
 /begin AXIS_DESCR STD_AXIS tmot temp_ub_q0p75_o48 6 -48.00 143.3 FORMAT "%5.1" DEPOSIT ABSOLUTE /end AXIS_DESCR
/end CHARACTERISTIC
/begin CHARACTERISTIC FESW "Faktor Einlass ungedrosselt warm" CURVE 0xFCD70B KlAxU8SstxU8WU8 0.9961 fakspr_q0p0039 0.00 0.9961
 /begin AXIS_DESCR STD_AXIS tmot temp_ub_q0p75_o48 6 -48.00 143.3 FORMAT "%5.1" DEPOSIT ABSOLUTE /end AXIS_DESCR
/end CHARACTERISTIC
/begin CHARACTERISTIC FKKVS "Korrekturfaktor Kraftstoffversorgungssystem" MAP 0xFC76AC KfAxU8AyU8SstxU16SstyU16WU16 2.000000 fak_uw_b16 0.00 2.000000 FORMAT "%8.6"
 /begin AXIS_DESCR STD_AXIS ub spg_ubatt 6 0.00 24.02 FORMAT "%5.2" DEPOSIT ABSOLUTE /end AXIS_DESCR
 /begin AXIS_DESCR STD_AXIS vsskrst fuel_ub_q1 6 0.00 255.0 FORMAT "%5.1" DEPOSIT ABSOLUTE /end AXIS_DESCR
/end CHARACTERISTIC
/begin CHARACTERISTIC FMSL "Faktor Korrektur Sekund‰rluftmasse" VALUE 0xFD55F9 KwUb 1.992 fak_ub_b2 0.00 1.992 FORMAT "%5.3" /end CHARACTERISTIC
/begin CHARACTERISTIC FMSL2 "Faktor Korrektur Sekund‰rluftmasse, Bank 2" VALUE 0xFD55FA KwUb 1.992 fak_ub_b2 0.00 1.992 FORMAT "%5.3" /end CHARACTERISTIC
/begin CHARACTERISTIC FMSLOFF "Schwelle Ausr‰umen der Sekund‰rluft beendet" VALUE 0xFD55FB KwUb 0.9961 fak_ub_b1 0.00 0.9961 /end CHARACTERISTIC
/begin CHARACTERISTIC FMSRHOL "Dichtekorrektur der Sekund‰rluftmasse" CURVE 0xFD5678 KlAUwSstUwWUw 1.999969 fak_uw_b2 0.00 1.999969 FORMAT "%8.6"
 /begin AXIS_DESCR STD_AXIS frhol_w fak_uw_b2 4 0.00 1.999969 FORMAT "%8.6" DEPOSIT ABSOLUTE /end AXIS_DESCR
/end CHARACTERISTIC
/begin CHARACTERISTIC FMSTMOT "tmot- Korrektur der Sekund‰rluftmasse" CURVE 0xFD55FC KlAUbSstUbWUb 1.992 fak_ub_b2 0.00 1.992 FORMAT "%5.3"
 /begin AXIS_DESCR STD_AXIS tmot temp_ub_q0p75_o48 8 -48.00 143.3 FORMAT "%5.1" DEPOSIT ABSOLUTE /end AXIS_DESCR
/end CHARACTERISTIC
/begin CHARACTERISTIC FRHOKRSTTE "Einspritzkorrekutr bei hoher Kraftstofftemperatur" CURVE 0xFC7710 KlAxU8SstxU16WS16 1.999969 fak_sw_b2x 0.00 1.999969 FORMAT "%8.6"
 /begin AXIS_DESCR STD_AXIS tkrst temp_ub_q0p75_o48 6 -48.00 143.3 FORMAT "%5.1" DEPOSIT ABSOLUTE /end AXIS_DESCR
/end CHARACTERISTIC
/begin CHARACTERISTIC FRLFSDP "Einspritzkorrektur bei RLFS" CURVE 0xFC772A KlAxU8SstxS16WS16 1.999969 fak_sw_b2x 0.00 1.999969 FORMAT "%8.6"
 /begin AXIS_DESCR STD_AXIS dpus_w p_q0p039 11 -1280.000 1279.961 FORMAT "%8.3" DEPOSIT ABSOLUTE /end AXIS_DESCR
/end CHARACTERISTIC
/begin CHARACTERISTIC FZG_ON "Betrieb im Fahrzeug" VALUE 0xFD40F7 KwUb 255.0 dez 0.00 255.0 FORMAT "%5.1" /end CHARACTERISTIC
/begin CHARACTERISTIC HKW_dT "1000ms Zeitscheibe" VALUE 0xFCC3AE KwWU16 1.000000 fak_uw_q0p001 0.00 1.000000 FORMAT "%8.6" /end CHARACTERISTIC
/begin CHARACTERISTIC HKW_IKL2 "I-Verst‰rkung unter HKW_IWIN" VALUE 0xFCC3B0 KwWU16 10.00000 fak_uw_q0p001 0.00 10.00000 FORMAT "%8.5" /end CHARACTERISTIC
/begin CHARACTERISTIC HKW_ING2 "negative I-Verst‰rkung ¸ber HKW_IWIN" VALUE 0xFCC3B2 KwWU16 10.00000 fak_uw_q0p001 0.00 10.00000 FORMAT "%8.5" /end CHARACTERISTIC
/begin CHARACTERISTIC HKW_IPG2 "positive I-Verst‰rkung ¸ber HKW_IWIN" VALUE 0xFCC3B4 KwWU16 10.00000 fak_uw_q0p001 0.00 10.00000 FORMAT "%8.5" /end CHARACTERISTIC
/begin CHARACTERISTIC HKW_IWIN2 "Schwelle zur Umschaltung I-Verst‰rkung" VALUE 0xFCC3DC KwWU8 100.0 rel_ub_b100 0.00 100.0 FORMAT "%5.1" /end CHARACTERISTIC
/begin CHARACTERISTIC HKW_NSTMX2 "max. neg. Steigung f¸r die Heizleistung ehz_pw" VALUE 0xFCC3DD KwWU8 100.0 rel_ub_b100 0.00 100.0 FORMAT "%5.1" /end CHARACTERISTIC
/begin CHARACTERISTIC HKW_PIMAX2 "max. Begrenzung f¸r die Heizleistung ehz_pw" VALUE 0xFCC3DE KwWU8 100.0 rel_ub_b100 0.00 100.0 FORMAT "%5.1" /end CHARACTERISTIC
/begin CHARACTERISTIC HKW_PKL2 "P-Verst‰rkung unter HKW_PWIN" VALUE 0xFCC3B6 KwWU16 10.00000 fak_uw_q0p001 0.00 10.00000 FORMAT "%8.5" /end CHARACTERISTIC
/begin CHARACTERISTIC HKW_PNG2 "negative P-Verst‰rkung ¸ber HKW_PWIN" VALUE 0xFCC3B8 KwWU16 10.00000 fak_uw_q0p001 0.00 10.00000 FORMAT "%8.5" /end CHARACTERISTIC
/begin CHARACTERISTIC HKW_PPG2 "positive P-Verst‰rkung ¸ber HKW_PWIN" VALUE 0xFCC3BA KwWU16 10.00000 fak_uw_q0p001 0.00 10.00000 FORMAT "%8.5" /end CHARACTERISTIC
/begin CHARACTERISTIC HKW_PSTMX2 "max. pos. Steigung f¸r die Heizleistung ehz_pw" VALUE 0xFCC3DF KwWU8 100.0 rel_ub_b100 0.00 100.0 FORMAT "%5.1" /end CHARACTERISTIC
/begin CHARACTERISTIC HKW_PWIN2 "Schwelle zur Umschaltung P-Verst‰rkung" VALUE 0xFCC3E0 KwWU8 100.0 rel_ub_b100 0.00 100.0 FORMAT "%5.1" /end CHARACTERISTIC
/begin CHARACTERISTIC HKW_TGL2 "Tiefpass-Zeitkonstante f¸r Bildung der Sollgrˆﬂe Generatorlast" VALUE 0xFCC3E1 KwWU8 25.40 fak_q0p1 0.1000 25.50 FORMAT "%5.2" /end CHARACTERISTIC
/begin CHARACTERISTIC HKW_TRGL2 "Tiefpass-Zeitkonstante f¸r Bildung der Istgrˆﬂe Generatorlast" VALUE 0xFCC3E2 KwWU8 25.40 fak_q0p1 0.1000 25.50 FORMAT "%5.2" /end CHARACTERISTIC
/begin CHARACTERISTIC IBATTAPP "" VALUE 0xFCC3BC KwWU16 1200.00 i_uw_q0p08_o200 -200.000 1000.00 /end CHARACTERISTIC
/begin CHARACTERISTIC IBFBSDAPP "" VALUE 0xFCC3E3 KwWU8 255.0 DEZ 0.00 255.0 FORMAT "%5.1" /end CHARACTERISTIC
/begin CHARACTERISTIC IBSWAKEAPP "Bit, ob IBS Bus wecken darf oder nicht." VALUE 0xFCC3E4 KwWU8 255.0 DEZ 0.00 255.0 FORMAT "%5.1" /end CHARACTERISTIC
/begin CHARACTERISTIC IB_COMMVAL "Anzahl Taskaufrufe zwischen periodischer Abfrage qlad und qelad" VALUE 0xFCC499 KwWU8 255.0 DEZ 0.00 255.0 FORMAT "%5.1" /end CHARACTERISTIC
/begin CHARACTERISTIC IFBSAKAPP "" VALUE 0xFCC3E5 KwWU8 255.0 DEZ 0.00 255.0 FORMAT "%5.1" /end CHARACTERISTIC
/begin CHARACTERISTIC IFUPLAKAPP "" VALUE 0xFCC3E6 KwWU8 255.0 DEZ 0.00 255.0 FORMAT "%5.1" /end CHARACTERISTIC
/begin CHARACTERISTIC IMLSLMN "min. Verh‰ltnisfaktor psum_w/mlsu f¸r Einschaltung SLS" VALUE 0xFD560D KwUb 0.9961 fak_ub_b1 0.00 0.9961 /end CHARACTERISTIC
/begin CHARACTERISTIC IMLSLMX "max. Verh‰ltnisfaktor psum_w/mlsu f¸r Einschaltung SLS" VALUE 0xFD560E KwUb 0.9961 fak_ub_b1 0.00 0.9961 /end CHARACTERISTIC
/begin CHARACTERISTIC IMLSLSA "Schwelle Luftmassenintegral f¸r Anfang Sekund‰rluft im Abgas" VALUE 0xFD568A KwUw 4660.267 m_uw_b4660 0.00 4660.267 FORMAT "%8.3" /end CHARACTERISTIC
/begin CHARACTERISTIC IMLSLSE "Schwelle Luftmassenintegral f¸r Ende Sekund‰rluft im Abgas" VALUE 0xFD568C KwUw 4660.267 m_uw_b4660 0.00 4660.267 FORMAT "%8.3" /end CHARACTERISTIC
/begin CHARACTERISTIC I_FIT_AUSW "Grenzwert Batteriespannung" VALUE 0xFCC624 KwWU16 1200.00 i_uw_q0p08_o200 -200.000 1000.00 /end CHARACTERISTIC
/begin CHARACTERISTIC KBMCNT_APP "" VALUE 0xFCC3E7 KwWU8 25.50 t_q0p1 0.00 25.50 FORMAT "%5.2" /end CHARACTERISTIC
/begin CHARACTERISTIC KDFPTC_LP "K-Faktor des df-Tiefpass Filters zur Berechnung von PTC" VALUE 0xFCC3E8 KwWU8 1.000 fak_ub_q0p00392 0.00 1.000 FORMAT "%5.3" /end CHARACTERISTIC
/begin CHARACTERISTIC KFALLW "Leerlauf Auslasspreizung gedrosselt warm" MAP 0xFCCAD6 GkfWU8 204.0 sprzi_q0p8 0.00 204.0 FORMAT "%5.1"
 /begin AXIS_DESCR COM_AXIS nmot_w nmot_uw_q0p25 12 0.00 16383.75 FORMAT "%8.2" AXIS_PTS_REF RESTNMOT_W /end AXIS_DESCR
 /begin AXIS_DESCR COM_AXIS rlvwrstg_w rel_uw_q0p0234 12 0.00 1535.977 FORMAT "%8.3" AXIS_PTS_REF RESTRLVW_W /end AXIS_DESCR
/end CHARACTERISTIC
/begin CHARACTERISTIC KFASPGLUE "" MAP 0xFCD2B6 KfAxU8AyU8SstxU16SstyU16WU16 52428.00 sprzi_q0p8 0.00 52428.00 FORMAT "%8.2"
 /begin AXIS_DESCR STD_AXIS nmot_w nmot_uw_q0p25 4 0.00 16383.75 FORMAT "%8.2" DEPOSIT ABSOLUTE /end AXIS_DESCR
 /begin AXIS_DESCR STD_AXIS rl_w rel_uw_q0p0234 4 0.00 1535.977 FORMAT "%8.3" DEPOSIT ABSOLUTE /end AXIS_DESCR
/end CHARACTERISTIC
/begin CHARACTERISTIC KFDASTD "Delta Auslasspreizung" MAP 0xFD4F9C KfAxUwAyUwSstxUwSstyUwWSw 52428.00 sprzi_q0p8 -26214.40 26213.60 FORMAT "%8.2"
 /begin AXIS_DESCR STD_AXIS minhub_w hub_uw_q0p001 8 0.00 65.53500 FORMAT "%8.5" DEPOSIT ABSOLUTE /end AXIS_DESCR
 /begin AXIS_DESCR STD_AXIS dpssol_uw p_q0p039 8 0.00 2559.961 FORMAT "%8.3" DEPOSIT ABSOLUTE /end AXIS_DESCR
/end CHARACTERISTIC
/begin CHARACTERISTIC KFDASTDLL "Leerlauf Delta Auslasspreizung" MAP 0xFD5040 KfAxUwAyUwSstxUwSstyUwWSw 52428.00 sprzi_q0p8 -26214.40 26213.60 FORMAT "%8.2"
 /begin AXIS_DESCR STD_AXIS minhub_w hub_uw_q0p001 8 0.00 65.53500 FORMAT "%8.5" DEPOSIT ABSOLUTE /end AXIS_DESCR
 /begin AXIS_DESCR STD_AXIS dpssol_uw p_q0p039 8 0.00 2559.961 FORMAT "%8.3" DEPOSIT ABSOLUTE /end AXIS_DESCR
/end CHARACTERISTIC
/begin CHARACTERISTIC KFDESTD "Delta Einlasspreizung" MAP 0xFD50E4 KfAxUwAyUwSstxUwSstyUwWSw 52428.00 sprzi_q0p8 -26214.40 26213.60 FORMAT "%8.2"
 /begin AXIS_DESCR STD_AXIS minhub_w hub_uw_q0p001 8 0.00 65.53500 FORMAT "%8.5" DEPOSIT ABSOLUTE /end AXIS_DESCR
 /begin AXIS_DESCR STD_AXIS dpssol_uw p_q0p039 8 0.00 2559.961 FORMAT "%8.3" DEPOSIT ABSOLUTE /end AXIS_DESCR
/end CHARACTERISTIC
/begin CHARACTERISTIC KFDESTDLL "Leerlauf Delta Einlasspreizung" MAP 0xFD5188 KfAxUwAyUwSstxUwSstyUwWSw 52428.00 sprzi_q0p8 -26214.40 26213.60 FORMAT "%8.2"
 /begin AXIS_DESCR STD_AXIS minhub_w hub_uw_q0p001 8 0.00 65.53500 FORMAT "%8.5" DEPOSIT ABSOLUTE /end AXIS_DESCR
 /begin AXIS_DESCR STD_AXIS dpssol_uw p_q0p039 8 0.00 2559.961 FORMAT "%8.3" DEPOSIT ABSOLUTE /end AXIS_DESCR
/end CHARACTERISTIC
/begin CHARACTERISTIC KFELLW "Leerlauf Einlasspreizung gedrosselt warm" MAP 0xFCCB66 GkfWU8 204.0 sprzi_q0p8 0.00 204.0 FORMAT "%5.1"
 /begin AXIS_DESCR COM_AXIS nmot_w nmot_uw_q0p25 12 0.00 16383.75 FORMAT "%8.2" AXIS_PTS_REF RESTNMOT_W /end AXIS_DESCR
 /begin AXIS_DESCR COM_AXIS rlvwrstg_w rel_uw_q0p0234 12 0.00 1535.977 FORMAT "%8.3" AXIS_PTS_REF RESTRLVW_W /end AXIS_DESCR
/end CHARACTERISTIC
/begin CHARACTERISTIC KFESPGLUE "" MAP 0xFCD2EA KfAxU8AyU8SstxU16SstyU16WU16 52428.00 sprzi_q0p8 0.00 52428.00 FORMAT "%8.2"
 /begin AXIS_DESCR STD_AXIS nmot_w nmot_uw_q0p25 4 0.00 16383.75 FORMAT "%8.2" DEPOSIT ABSOLUTE /end AXIS_DESCR
 /begin AXIS_DESCR STD_AXIS rl_w rel_uw_q0p0234 4 0.00 1535.977 FORMAT "%8.3" DEPOSIT ABSOLUTE /end AXIS_DESCR
/end CHARACTERISTIC
/begin CHARACTERISTIC KFFMSML "Abgasgegendruckkorrektur der Sekund‰rluftmasse" MAP 0xFD560F KfAxUbAyUbSstxUbSstyUbWUb 1.992 fak_ub_b2 0.00 1.992 FORMAT "%5.3"
 /begin AXIS_DESCR STD_AXIS nmot nmot_ub_q40 8 0.00 10200. FORMAT "%5.0" DEPOSIT ABSOLUTE /end AXIS_DESCR
 /begin AXIS_DESCR STD_AXIS rl rel_ub_q0p75 8 0.00 191.3 FORMAT "%5.1" DEPOSIT ABSOLUTE /end AXIS_DESCR
/end CHARACTERISTIC
/begin CHARACTERISTIC KFKALLW "Leerlauf Auslasspreizung gedrosselt kalt zum Katheizen" MAP 0xFCCBF6 GkfWU8 204.0 sprzi_q0p8 0.00 204.0 FORMAT "%5.1"
 /begin AXIS_DESCR COM_AXIS nmot_w nmot_uw_q0p25 12 0.00 16383.75 FORMAT "%8.2" AXIS_PTS_REF RESTNMOT_W /end AXIS_DESCR
 /begin AXIS_DESCR COM_AXIS rlvwrstg_w rel_uw_q0p0234 12 0.00 1535.977 FORMAT "%8.3" AXIS_PTS_REF RESTRLVW_W /end AXIS_DESCR
/end CHARACTERISTIC
/begin CHARACTERISTIC KFKASOPT "optimale Auslasspreizung kalt teilgedrosselt" MAP 0xFCCC86 GkfWU8 204.0 sprzi_q0p8 0.00 204.0 FORMAT "%5.1"
 /begin AXIS_DESCR COM_AXIS nmot_w nmot_uw_q0p25 12 0.00 16383.75 FORMAT "%8.2" AXIS_PTS_REF RESTNMOT_W /end AXIS_DESCR
 /begin AXIS_DESCR COM_AXIS rlvwrstg_w rel_uw_q0p0234 12 0.00 1535.977 FORMAT "%8.3" AXIS_PTS_REF RESTRLVW_W /end AXIS_DESCR
/end CHARACTERISTIC
/begin CHARACTERISTIC KFKASOPU "optimale Auslasspreizung kalt ungedrosselt" MAP 0xFCCD16 GkfWU8 204.0 sprzi_q0p8 0.00 204.0 FORMAT "%5.1"
 /begin AXIS_DESCR COM_AXIS nmot_w nmot_uw_q0p25 12 0.00 16383.75 FORMAT "%8.2" AXIS_PTS_REF RESTNMOT_W /end AXIS_DESCR
 /begin AXIS_DESCR COM_AXIS rlvwrstg_w rel_uw_q0p0234 12 0.00 1535.977 FORMAT "%8.3" AXIS_PTS_REF RESTRLVW_W /end AXIS_DESCR
/end CHARACTERISTIC
/begin CHARACTERISTIC KFKELLW "Leerlauf Einlasspreizung gedrosselt kalt zum Katheizen" MAP 0xFCCDA6 GkfWU8 204.0 sprzi_q0p8 0.00 204.0 FORMAT "%5.1"
 /begin AXIS_DESCR COM_AXIS nmot_w nmot_uw_q0p25 12 0.00 16383.75 FORMAT "%8.2" AXIS_PTS_REF RESTNMOT_W /end AXIS_DESCR
 /begin AXIS_DESCR COM_AXIS rlvwrstg_w rel_uw_q0p0234 12 0.00 1535.977 FORMAT "%8.3" AXIS_PTS_REF RESTRLVW_W /end AXIS_DESCR
/end CHARACTERISTIC
/begin CHARACTERISTIC KFKESOPT "optimale Einlasspreizung kalt teilgedrosselt" MAP 0xFCCE36 GkfWU8 204.0 sprzi_q0p8 0.00 204.0 FORMAT "%5.1"
 /begin AXIS_DESCR COM_AXIS nmot_w nmot_uw_q0p25 12 0.00 16383.75 FORMAT "%8.2" AXIS_PTS_REF RESTNMOT_W /end AXIS_DESCR
 /begin AXIS_DESCR COM_AXIS rlvwrstg_w rel_uw_q0p0234 12 0.00 1535.977 FORMAT "%8.3" AXIS_PTS_REF RESTRLVW_W /end AXIS_DESCR
/end CHARACTERISTIC
/begin CHARACTERISTIC KFKESOPU "optimale Einlasspreizung kalt ungedrosselt" MAP 0xFCCEC6 GkfWU8 204.0 sprzi_q0p8 0.00 204.0 FORMAT "%5.1"
 /begin AXIS_DESCR COM_AXIS nmot_w nmot_uw_q0p25 12 0.00 16383.75 FORMAT "%8.2" AXIS_PTS_REF RESTNMOT_W /end AXIS_DESCR
 /begin AXIS_DESCR COM_AXIS rlvwrstg_w rel_uw_q0p0234 12 0.00 1535.977 FORMAT "%8.3" AXIS_PTS_REF RESTRLVW_W /end AXIS_DESCR
/end CHARACTERISTIC
/begin CHARACTERISTIC KFPMRIBAT1 "" MAP 0xFCC49E KfAxU8AyU8SstxU8SstyU16WU8 0.25500000 r_q0p1em3 0.00 0.25500000 FORMAT "%10.8"
 /begin AXIS_DESCR STD_AXIS tbatt temp_ub_q0p75_o48 4 -48.00 143.3 FORMAT "%5.1" DEPOSIT ABSOLUTE /end AXIS_DESCR
 /begin AXIS_DESCR STD_AXIS ibatt_w i_uw_q0p08_o200 6 -200.000 1000.00 DEPOSIT ABSOLUTE /end AXIS_DESCR
/end CHARACTERISTIC
/begin CHARACTERISTIC KFPMRIBAT2 "" MAP 0xFCC4C8 KfAxU8AyU8SstxU8SstyU16WU8 0.25500000 r_q0p1em3 0.00 0.25500000 FORMAT "%10.8"
 /begin AXIS_DESCR STD_AXIS tbatt temp_ub_q0p75_o48 4 -48.00 143.3 FORMAT "%5.1" DEPOSIT ABSOLUTE /end AXIS_DESCR
 /begin AXIS_DESCR STD_AXIS ibatt_w i_uw_q0p08_o200 6 -200.000 1000.00 DEPOSIT ABSOLUTE /end AXIS_DESCR
/end CHARACTERISTIC
/begin CHARACTERISTIC KFPMRIBAT3 "" MAP 0xFCC4F2 KfAxU8AyU8SstxU8SstyU16WU8 0.25500000 r_q0p1em3 0.00 0.25500000 FORMAT "%10.8"
 /begin AXIS_DESCR STD_AXIS tbatt temp_ub_q0p75_o48 4 -48.00 143.3 FORMAT "%5.1" DEPOSIT ABSOLUTE /end AXIS_DESCR
 /begin AXIS_DESCR STD_AXIS ibatt_w i_uw_q0p08_o200 6 -200.000 1000.00 DEPOSIT ABSOLUTE /end AXIS_DESCR
/end CHARACTERISTIC
/begin CHARACTERISTIC KFPMRIBAT4 "" MAP 0xFCC51C KfAxU8AyU8SstxU8SstyU16WU8 0.25500000 r_q0p1em3 0.00 0.25500000 FORMAT "%10.8"
 /begin AXIS_DESCR STD_AXIS tbatt temp_ub_q0p75_o48 4 -48.00 143.3 FORMAT "%5.1" DEPOSIT ABSOLUTE /end AXIS_DESCR
 /begin AXIS_DESCR STD_AXIS ibatt_w i_uw_q0p08_o200 6 -200.000 1000.00 DEPOSIT ABSOLUTE /end AXIS_DESCR
/end CHARACTERISTIC
/begin CHARACTERISTIC KFPMRIBAT5 "" MAP 0xFCC546 KfAxU8AyU8SstxU8SstyU16WU8 0.25500000 r_q0p1em3 0.00 0.25500000 FORMAT "%10.8"
 /begin AXIS_DESCR STD_AXIS tbatt temp_ub_q0p75_o48 4 -48.00 143.3 FORMAT "%5.1" DEPOSIT ABSOLUTE /end AXIS_DESCR
 /begin AXIS_DESCR STD_AXIS ibatt_w i_uw_q0p08_o200 6 -200.000 1000.00 DEPOSIT ABSOLUTE /end AXIS_DESCR
/end CHARACTERISTIC
/begin CHARACTERISTIC KFPMRIBAT6 "" MAP 0xFCC570 KfAxU8AyU8SstxU8SstyU16WU8 0.25500000 r_q0p1em3 0.00 0.25500000 FORMAT "%10.8"
 /begin AXIS_DESCR STD_AXIS tbatt temp_ub_q0p75_o48 4 -48.00 143.3 FORMAT "%5.1" DEPOSIT ABSOLUTE /end AXIS_DESCR
 /begin AXIS_DESCR STD_AXIS ibatt_w i_uw_q0p08_o200 6 -200.000 1000.00 DEPOSIT ABSOLUTE /end AXIS_DESCR
/end CHARACTERISTIC
/begin CHARACTERISTIC KFPMRIBAT7 "" MAP 0xFCC59A KfAxU8AyU8SstxU8SstyU16WU8 0.25500000 r_q0p1em3 0.00 0.25500000 FORMAT "%10.8"
 /begin AXIS_DESCR STD_AXIS tbatt temp_ub_q0p75_o48 4 -48.00 143.3 FORMAT "%5.1" DEPOSIT ABSOLUTE /end AXIS_DESCR
 /begin AXIS_DESCR STD_AXIS ibatt_w i_uw_q0p08_o200 6 -200.000 1000.00 DEPOSIT ABSOLUTE /end AXIS_DESCR
/end CHARACTERISTIC
/begin CHARACTERISTIC KFPMRIBAT8 "" MAP 0xFCC5C4 KfAxU8AyU8SstxU8SstyU16WU8 0.25500000 r_q0p1em3 0.00 0.25500000 FORMAT "%10.8"
 /begin AXIS_DESCR STD_AXIS tbatt temp_ub_q0p75_o48 4 -48.00 143.3 FORMAT "%5.1" DEPOSIT ABSOLUTE /end AXIS_DESCR
 /begin AXIS_DESCR STD_AXIS ibatt_w i_uw_q0p08_o200 6 -200.000 1000.00 DEPOSIT ABSOLUTE /end AXIS_DESCR
/end CHARACTERISTIC
/begin CHARACTERISTIC KFSOC0UBIB "Ladezustand in Abh‰ngigkeit von Ruhespannung und Strom" MAP 0xFCC40C KfAxU8AyU8SstxU16SstyU16WU16 99.99847 rel_uw_b100 0.00 99.99847 FORMAT "%8.5"
 /begin AXIS_DESCR STD_AXIS ubatt0 spg_uw_q0p25em3_o6 3 6.0000000 22.383750 FORMAT "%9.6" DEPOSIT ABSOLUTE /end AXIS_DESCR
 /begin AXIS_DESCR STD_AXIS isoc0loc i_uw_q0p02_o200 10 -200.00 1110.7 DEPOSIT ABSOLUTE /end AXIS_DESCR
/end CHARACTERISTIC
/begin CHARACTERISTIC KFSOCLF "Ladefaktor in Abh‰ngigkeit von Temperatur und Ladezustand" MAP 0xFCC466 KfAxU8AyU8SstxU8SstyU16WU8 3.969 fak_uw_b1024 0.01563 3.984 FORMAT "%5.3"
 /begin AXIS_DESCR STD_AXIS tbatt temp_ub_q0p75_o48 3 -48.00 143.3 FORMAT "%5.1" DEPOSIT ABSOLUTE /end AXIS_DESCR
 /begin AXIS_DESCR STD_AXIS soc_b_loc rel_uw_b100 3 0.00 99.99847 FORMAT "%8.5" DEPOSIT ABSOLUTE /end AXIS_DESCR
/end CHARACTERISTIC
/begin CHARACTERISTIC KFUSOLL "Batteriesollspannung aufgrund der Temperatur und soc." MAP 0xFCC16E KfAxU8AyU8SstxU8SstyU16WU8 11.008 spg_ub_q0p064_o6 6.0000 17.008
 /begin AXIS_DESCR STD_AXIS tbatt temp_ub_q0p75_o48 3 -48.00 125.3 FORMAT "%5.1" DEPOSIT ABSOLUTE /end AXIS_DESCR
 /begin AXIS_DESCR STD_AXIS soc_rel rel_uw_b100 3 0.00 99.99847 FORMAT "%8.5" DEPOSIT ABSOLUTE /end AXIS_DESCR
/end CHARACTERISTIC
/begin CHARACTERISTIC KFWALLW "Leerlauf Auslasspreizung gedrosselt warm zum Katheizen""" MAP 0xFCCF56 GkfWU8 204.0 sprzi_q0p8 0.00 204.0 FORMAT "%5.1"
 /begin AXIS_DESCR COM_AXIS nmot_w nmot_uw_q0p25 12 0.00 16383.75 FORMAT "%8.2" AXIS_PTS_REF RESTNMOT_W /end AXIS_DESCR
 /begin AXIS_DESCR COM_AXIS rlvwrstg_w rel_uw_q0p0234 12 0.00 1535.977 FORMAT "%8.3" AXIS_PTS_REF RESTRLVW_W /end AXIS_DESCR
/end CHARACTERISTIC
/begin CHARACTERISTIC KFWASLL "Leerlauf Auslasspreizung" MAP 0xFCD31E KfAxU8AyU8SstxU16SstyU16WU16 204.0000 sprzi_q0p8 0.00 204.0000 FORMAT "%8.4"
 /begin AXIS_DESCR STD_AXIS nmot_w nmot_uw_q0p25 12 0.00 16383.75 FORMAT "%8.2" DEPOSIT ABSOLUTE /end AXIS_DESCR
 /begin AXIS_DESCR STD_AXIS rlvwrstg_w rel_uw_q0p0234 5 0.00 1535.977 FORMAT "%8.3" DEPOSIT ABSOLUTE /end AXIS_DESCR
/end CHARACTERISTIC
/begin CHARACTERISTIC KFWASOPT "optimale Auslasspreizung warm teilgedrosselt" MAP 0xFCCFE6 GkfWU8 204.0 sprzi_q0p8 0.00 204.0 FORMAT "%5.1"
 /begin AXIS_DESCR COM_AXIS nmot_w nmot_uw_q0p25 12 0.00 16383.75 FORMAT "%8.2" AXIS_PTS_REF RESTNMOT_W /end AXIS_DESCR
 /begin AXIS_DESCR COM_AXIS rlvwrstg_w rel_uw_q0p0234 12 0.00 1535.977 FORMAT "%8.3" AXIS_PTS_REF RESTRLVW_W /end AXIS_DESCR
/end CHARACTERISTIC
/begin CHARACTERISTIC KFWASOPU "optimale Auslasspreizung warm ungedrosselt" MAP 0xFCD076 GkfWU8 204.0 sprzi_q0p8 0.00 204.0 FORMAT "%5.1"
 /begin AXIS_DESCR COM_AXIS nmot_w nmot_uw_q0p25 12 0.00 16383.75 FORMAT "%8.2" AXIS_PTS_REF RESTNMOT_W /end AXIS_DESCR
 /begin AXIS_DESCR COM_AXIS rlvwrstg_w rel_uw_q0p0234 12 0.00 1535.977 FORMAT "%8.3" AXIS_PTS_REF RESTRLVW_W /end AXIS_DESCR
/end CHARACTERISTIC
/begin CHARACTERISTIC KFWASVL "Auslasspreizung Vollast abh‰ngig von Drehzahl und Klopfst‰rke" MAP 0xFCD3BC KfAxU8AyU8SstxU16SstyU16WU16 204.0000 sprzi_q0p8 0.00 204.0000 FORMAT "%8.4"
 /begin AXIS_DESCR STD_AXIS nmot_w nmot_uw_q0p25 16 0.00 16383.75 FORMAT "%8.2" DEPOSIT ABSOLUTE /end AXIS_DESCR
 /begin AXIS_DESCR STD_AXIS wkrm zw_ub_qn0p75 2 -191.3 0.00 FORMAT "%5.1" DEPOSIT ABSOLUTE /end AXIS_DESCR
/end CHARACTERISTIC
/begin CHARACTERISTIC KFWASVLT "Kennfeld Vollastspreizung gedrosselt (Auslaﬂseite)" MAP 0xFCD424 KfAxU8AyU8SstxU16SstyU16WU16 204.0000 sprzi_q0p8 0.00 204.0000 FORMAT "%8.4"
 /begin AXIS_DESCR STD_AXIS nmot_w nmot_uw_q0p25 16 0.00 16383.75 FORMAT "%8.2" DEPOSIT ABSOLUTE /end AXIS_DESCR
 /begin AXIS_DESCR STD_AXIS wkrm zw_ub_qn0p75 2 -191.3 0.00 FORMAT "%5.1" DEPOSIT ABSOLUTE /end AXIS_DESCR
/end CHARACTERISTIC
/begin CHARACTERISTIC KFWELLW "Leerlauf Einlasspreizung gedrosselt warm zum Katheizen" MAP 0xFCD106 GkfWU8 204.0 sprzi_q0p8 0.00 204.0 FORMAT "%5.1"
 /begin AXIS_DESCR COM_AXIS nmot_w nmot_uw_q0p25 12 0.00 16383.75 FORMAT "%8.2" AXIS_PTS_REF RESTNMOT_W /end AXIS_DESCR
 /begin AXIS_DESCR COM_AXIS rlvwrstg_w rel_uw_q0p0234 12 0.00 1535.977 FORMAT "%8.3" AXIS_PTS_REF RESTRLVW_W /end AXIS_DESCR
/end CHARACTERISTIC
/begin CHARACTERISTIC KFWESLL "Leerlauf Einlasspreizung" MAP 0xFCD48C KfAxU8AyU8SstxU16SstyU16WU16 204.0000 sprzi_q0p8 0.00 204.0000 FORMAT "%8.4"
 /begin AXIS_DESCR STD_AXIS nmot_w nmot_uw_q0p25 12 0.00 16383.75 FORMAT "%8.2" DEPOSIT ABSOLUTE /end AXIS_DESCR
 /begin AXIS_DESCR STD_AXIS rlvwrstg_w rel_uw_q0p0234 5 0.00 1535.977 FORMAT "%8.3" DEPOSIT ABSOLUTE /end AXIS_DESCR
/end CHARACTERISTIC
/begin CHARACTERISTIC KFWESOPT "optimale Einlasspreizung warm teilgedrosselt" MAP 0xFCD196 GkfWU8 204.0 sprzi_q0p8 0.00 204.0 FORMAT "%5.1"
 /begin AXIS_DESCR COM_AXIS nmot_w nmot_uw_q0p25 12 0.00 16383.75 FORMAT "%8.2" AXIS_PTS_REF RESTNMOT_W /end AXIS_DESCR
 /begin AXIS_DESCR COM_AXIS rlvwrstg_w rel_uw_q0p0234 12 0.00 1535.977 FORMAT "%8.3" AXIS_PTS_REF RESTRLVW_W /end AXIS_DESCR
/end CHARACTERISTIC
/begin CHARACTERISTIC KFWESOPU "optimale Einlasspreizung warm ungedrosselt" MAP 0xFCD226 GkfWU8 204.0 sprzi_q0p8 0.00 204.0 FORMAT "%5.1"
 /begin AXIS_DESCR COM_AXIS nmot_w nmot_uw_q0p25 12 0.00 16383.75 FORMAT "%8.2" AXIS_PTS_REF RESTNMOT_W /end AXIS_DESCR
 /begin AXIS_DESCR COM_AXIS rlvwrstg_w rel_uw_q0p0234 12 0.00 1535.977 FORMAT "%8.3" AXIS_PTS_REF RESTRLVW_W /end AXIS_DESCR
/end CHARACTERISTIC
/begin CHARACTERISTIC KFWESVL "Einlasspreizung Vollast abh‰ngig von Drehzahl und Klopfst‰rke" MAP 0xFCD52A KfAxU8AyU8SstxU16SstyU16WU16 204.0000 sprzi_q0p8 0.00 204.0000 FORMAT "%8.4"
 /begin AXIS_DESCR STD_AXIS nmot_w nmot_uw_q0p25 16 0.00 16383.75 FORMAT "%8.2" DEPOSIT ABSOLUTE /end AXIS_DESCR
 /begin AXIS_DESCR STD_AXIS wkrm zw_ub_qn0p75 2 -191.3 0.00 FORMAT "%5.1" DEPOSIT ABSOLUTE /end AXIS_DESCR
/end CHARACTERISTIC
/begin CHARACTERISTIC KFWESVLT "Kennfeld Vollastspreizung gedrosselt (Einlaﬂseite)" MAP 0xFCD592 KfAxU8AyU8SstxU16SstyU16WU16 204.0000 sprzi_q0p8 0.00 204.0000 FORMAT "%8.4"
 /begin AXIS_DESCR STD_AXIS nmot_w nmot_uw_q0p25 16 0.00 16383.75 FORMAT "%8.2" DEPOSIT ABSOLUTE /end AXIS_DESCR
 /begin AXIS_DESCR STD_AXIS wkrm zw_ub_qn0p75 2 -191.3 0.00 FORMAT "%5.1" DEPOSIT ABSOLUTE /end AXIS_DESCR
/end CHARACTERISTIC
/begin CHARACTERISTIC KFWNWLL "Wichtungsfaktor zur Ausw. der LL KF im Normalbetr. oder zum Katheizen" MAP 0xFCD5FA KfAxU8AyU8SstxU16SstyU16WU16 0.9960938 fakspr_q0p0039 0.00 0.9960938 FORMAT "%9.7"
 /begin AXIS_DESCR STD_AXIS tmot temp_ub_q0p75_o48 4 -48.00 143.3 FORMAT "%5.1" DEPOSIT ABSOLUTE /end AXIS_DESCR
 /begin AXIS_DESCR STD_AXIS tnst_w t10msxs_uw_b655p35 6 0.00 655.3500 FORMAT "%8.4" DEPOSIT ABSOLUTE /end AXIS_DESCR
/end CHARACTERISTIC
/begin CHARACTERISTIC KFWNWLLKH "Wichtungsfaktor zur Ausw. der LL Kennfelder zum Katheizen kalt/warm" MAP 0xFCD642 KfAxU8AyU8SstxU16SstyU16WU16 0.9960938 fakspr_q0p0039 0.00 0.9960938 FORMAT "%9.7"
 /begin AXIS_DESCR STD_AXIS tmot temp_ub_q0p75_o48 6 -48.00 143.3 FORMAT "%5.1" DEPOSIT ABSOLUTE /end AXIS_DESCR
 /begin AXIS_DESCR STD_AXIS tnst_w t10msxs_uw_b655p35 6 0.00 655.3500 FORMAT "%8.4" DEPOSIT ABSOLUTE /end AXIS_DESCR
/end CHARACTERISTIC
/begin CHARACTERISTIC KF_IBTSOLL "Kennfeld Sollstrom aufgrund von Batterietemperatur und ihr Ladezustand." MAP 0xFCC19A KfAxU8AyU8SstxU8SstyU16WU16 1200.00 i_uw_q0p08_o200 -200.000 1000.00
 /begin AXIS_DESCR STD_AXIS tbatt7 temp_ub_q0p75_o48 5 -48.00 125.3 FORMAT "%5.1" DEPOSIT ABSOLUTE /end AXIS_DESCR
 /begin AXIS_DESCR STD_AXIS d_soc fak_q0p004_o100 6 -100.000 100.000 DEPOSIT ABSOLUTE /end AXIS_DESCR
/end CHARACTERISTIC
/begin CHARACTERISTIC KLASPVZ "Einschaltverzˆgerung Auslass abh‰ngig von tmot" CURVE 0xFCD718 KlAxU8SstxU8WU8 255.0 dez 0.00 255.0 FORMAT "%5.1"
 /begin AXIS_DESCR STD_AXIS tmot temp_ub_q0p75_o48 5 -48.00 143.3 FORMAT "%5.1" DEPOSIT ABSOLUTE /end AXIS_DESCR
/end CHARACTERISTIC
/begin CHARACTERISTIC KLESPVZ "Einschaltverzˆgerung Einlass abh‰ngig von tmot""" CURVE 0xFCD723 KlAxU8SstxU8WU8 255.0 DEZ 0.00 255.0 FORMAT "%5.1"
 /begin AXIS_DESCR STD_AXIS tmot temp_ub_q0p75_o48 5 -48.00 143.3 FORMAT "%5.1" DEPOSIT ABSOLUTE /end AXIS_DESCR
/end CHARACTERISTIC
/begin CHARACTERISTIC KLFGENSLP "imlpr-abh‰ngiger Faktor f¸r Generatorsollspannung bei SLP-Betrieb" CURVE 0xFCED24 KlAxU8SstxU8WU8 0.9961 fak_ub_b1 0.00 0.9961 /begin AXIS_DESCR STD_AXIS imlpr fak_ub_b1 6 0.00 0.9961 DEPOSIT ABSOLUTE /end AXIS_DESCR /end CHARACTERISTIC
/begin CHARACTERISTIC KLHKWN2 "Kennlinie f¸r drehzahlabh. Generatorlastsollwerte" CURVE 0xFCC1EA KlAxU8SstxU16WU16 100.0000 rel_ub_b100 0.00 100.0000 FORMAT "%8.4"
 /begin AXIS_DESCR STD_AXIS nmot_w nmot_uw_q0p25 10 0.00 16383.75 FORMAT "%8.2" DEPOSIT ABSOLUTE /end AXIS_DESCR
/end CHARACTERISTIC
/begin CHARACTERISTIC KLKRKTE "Kennlinie f¸r Umrechnung rel. Kraftstoffmasse in eff. Einspritzzeit" CURVE 0xFC7758 KlAxU8SstxU16WU16 0.5000000 rkt_uw_b0p5 0.00 0.5000000 FORMAT "%9.7"
 /begin AXIS_DESCR STD_AXIS rk_w rel_uw_b3072 12 0.00 3071.953 FORMAT "%8.3" DEPOSIT ABSOLUTE /end AXIS_DESCR
/end CHARACTERISTIC
/begin CHARACTERISTIC KLPMSOCVU "SoC-Wert aus der Fitberechnung" CURVE 0xFCC5EE KlAxU8SstxU16WU16 99.99847 rel_uw_b100 0.00 99.99847 FORMAT "%8.5"
 /begin AXIS_DESCR STD_AXIS ubatts2 spg_uw_q0p25em3_o6 3 6.0000000 16.000000 FORMAT "%9.6" DEPOSIT ABSOLUTE /end AXIS_DESCR
/end CHARACTERISTIC
/begin CHARACTERISTIC KLPRIO2PTC "‹bersetzer : Gewichtung der Prios -> Gewichtung f¸r PTC Ansteuerung" CURVE 0xFCC214 KlAxU8SstxU16WU16 200.00000 fak_uw_q0p25o500 -100.00000 100.00000 FORMAT "%9.5"
 /begin AXIS_DESCR STD_AXIS dfprio fak_uw_q0p25o500 5 0.00 450.00000 FORMAT "%9.5" DEPOSIT ABSOLUTE /end AXIS_DESCR
/end CHARACTERISTIC
/begin CHARACTERISTIC KLRLSLSMX "Kennlinie max. rl f¸r Sekund‰rluftsystem" CURVE 0xFD568E KlAUbSstUbWUw 1535.977 rel_uw_q0p0234 0.00 1535.977 FORMAT "%8.3"
 /begin AXIS_DESCR STD_AXIS nmot nmot_ub_q40 5 0.00 10200. FORMAT "%5.0" DEPOSIT ABSOLUTE /end AXIS_DESCR
/end CHARACTERISTIC
/begin CHARACTERISTIC KLSOC0TEMP "Temperaturabh‰ngige Stromkorrektur f¸r Ruhespannungsmessung" CURVE 0xFCC47C KlAxU8SstxU8WU8 1.992 fak_uw_b512 0.00 1.992 FORMAT "%5.3"
 /begin AXIS_DESCR STD_AXIS tsocloc temp_ub_q0p75_o48 5 -48.00 143.3 FORMAT "%5.1" DEPOSIT ABSOLUTE /end AXIS_DESCR
/end CHARACTERISTIC
/begin CHARACTERISTIC KLTSLMX "BMW" CURVE 0xFD569E KlAUbSstUbWUw 655.3500 t10msxs_uw_b655p35 0.00 655.3500 FORMAT "%8.4"
 /begin AXIS_DESCR STD_AXIS tmst temp_ub_q0p75_o48 8 -48.00 143.3 FORMAT "%5.1" DEPOSIT ABSOLUTE /end AXIS_DESCR
/end CHARACTERISTIC
/begin CHARACTERISTIC KLUBATTMAX "batterietemperaturabh. Maximalwert der Generatorsollspannung bei SLP-Betrieb" CURVE 0xFD570E KlAxU8SstxU16WU16 16.00000 spg_sw_q0p001 0.00 16.00000 FORMAT "%8.5"
 /begin AXIS_DESCR STD_AXIS tbattkl temp_ub_q0p75_o48 4 -48.00 143.3 FORMAT "%5.1" DEPOSIT ABSOLUTE /end AXIS_DESCR
/end CHARACTERISTIC
/begin CHARACTERISTIC KLUNSTART "Startspannung abh‰ngig v.Motordrehzahl" CURVE 0xFCC63A KlAxU8SstxU8WU8 16.320 spg_ub_q0p064_o6 6.0000 22.320
 /begin AXIS_DESCR STD_AXIS nnmstart nmot_ub_q10 2 0.00 2550. FORMAT "%5.0" DEPOSIT ABSOLUTE /end AXIS_DESCR
/end CHARACTERISTIC
/begin CHARACTERISTIC KLUSOLL "Batteriesollspannung aufgrund von tbatt" CURVE 0xFCC184 KlAxU8SstxU8WU8 11.008 spg_ub_q0p064_o6 6.0000 17.008
 /begin AXIS_DESCR STD_AXIS tbatt temp_ub_q0p75_o48 3 -48.00 125.3 FORMAT "%5.1" DEPOSIT ABSOLUTE /end AXIS_DESCR
/end CHARACTERISTIC
/begin CHARACTERISTIC KLUTSTART "Startspannung in Abh‰ngigkeit von Temperatur Batterie" CURVE 0xFCC63F KlAxU8SstxU8WS8 16.2560 spg_q0p064 -8.12800 8.12800 FORMAT "%7.5"
 /begin AXIS_DESCR STD_AXIS tbatt temp_ub_q0p75_o48 3 -48.00 143.3 FORMAT "%5.1" DEPOSIT ABSOLUTE /end AXIS_DESCR
/end CHARACTERISTIC
/begin CHARACTERISTIC KLWASLLM "Auslass Leerlauf ¸ber tmot" CURVE 0xFCD72E KlAxU8SstxU8WS8 204.0 sprzi_q0p8 -102.4 101.6 FORMAT "%5.1"
 /begin AXIS_DESCR STD_AXIS tmot temp_ub_q0p75_o48 7 -48.00 143.3 FORMAT "%5.1" DEPOSIT ABSOLUTE /end AXIS_DESCR
/end CHARACTERISTIC
/begin CHARACTERISTIC KLWESLLM "Einlass Leerlauf ¸ber tmot" CURVE 0xFCD73D KlAxU8SstxU8WS8 204.0 sprzi_q0p8 -102.4 101.6 FORMAT "%5.1"
 /begin AXIS_DESCR STD_AXIS tmot temp_ub_q0p75_o48 7 -48.00 143.3 FORMAT "%5.1" DEPOSIT ABSOLUTE /end AXIS_DESCR
/end CHARACTERISTIC
/begin CHARACTERISTIC KL_DFPRIO "df -> Prio ‹bersetzer" CURVE 0xFCC30C KlAxU8SstxU8WU16 200.00000 fak_uw_q0p25o500 -100.00000 100.00000 FORMAT "%9.5"
 /begin AXIS_DESCR STD_AXIS dfpt1filt rel_ub_b100 5 0.00 100.0 FORMAT "%5.1" DEPOSIT ABSOLUTE /end AXIS_DESCR
/end CHARACTERISTIC
/begin CHARACTERISTIC KL_DFPTC "Gefiltertes dffgen zu Prio_Gewichtung -‹bersetzer" CURVE 0xFCC31C KlAxU8SstxU8WU16 200.00000 fak_uw_q0p25o500 -100.00000 100.00000 FORMAT "%9.5"
 /begin AXIS_DESCR STD_AXIS dfpt1ptc rel_ub_b100 5 0.00 100.0 FORMAT "%5.1" DEPOSIT ABSOLUTE /end AXIS_DESCR
/end CHARACTERISTIC
/begin CHARACTERISTIC KL_DSOCPRIO "" CURVE 0xFCC22A KlAxU8SstxU16WU16 16383.750 fak_uw_q0p25o500 -500.00000 15883.750
 /begin AXIS_DESCR STD_AXIS d_soc fak_q0p004_o100 5 -100.000 100.000 DEPOSIT ABSOLUTE /end AXIS_DESCR
/end CHARACTERISTIC
/begin CHARACTERISTIC KL_DSOCPTC "Kennlinie dsoc auf PTC-Ansteuerung ‹bersetzer" CURVE 0xFCC240 KlAxU8SstxU16WU16 300.00000 fak_uw_q0p25o500 -150.00000 150.00000 FORMAT "%9.5"
 /begin AXIS_DESCR STD_AXIS d_soc fak_q0p004_o100 4 -100.000 100.000 DEPOSIT ABSOLUTE /end AXIS_DESCR
/end CHARACTERISTIC
/begin CHARACTERISTIC KL_I2PTC "I-Delta ‹bersetzer zu PTC Ansteuerung" CURVE 0xFCC252 KlAxU8SstxU16WU16 200.00000 fak_uw_q0p25o500 -100.00000 100.00000 FORMAT "%9.5"
 /begin AXIS_DESCR STD_AXIS isolldiff i_uw_q0p08_o200 6 -200.000 2000.00 DEPOSIT ABSOLUTE /end AXIS_DESCR
/end CHARACTERISTIC
/begin CHARACTERISTIC KL_IREST "Leistung der vom Generator noch zur Verf¸gung gestellt werden kann." CURVE 0xFCC26C KlAxU8SstxU16WU16 200.00000 fak_uw_q0p25o500 -100.00000 100.00000 FORMAT "%9.5"
 /begin AXIS_DESCR STD_AXIS pgenrest fak_q0p1 10 0.00 6400.000 FORMAT "%8.3" DEPOSIT ABSOLUTE /end AXIS_DESCR
/end CHARACTERISTIC
/begin CHARACTERISTIC KL_ISOLLPR "Delta-I -> Prio ‹bersetzer" CURVE 0xFCC296 KlAxU8SstxU16WU16 200.00000 fak_uw_q0p25o500 -100.00000 100.00000 FORMAT "%9.5"
 /begin AXIS_DESCR STD_AXIS ibtdiff i_uw_q0p08_o200 6 -200.000 2000.00 DEPOSIT ABSOLUTE /end AXIS_DESCR
/end CHARACTERISTIC
/begin CHARACTERISTIC KL_PTC "PWM-‹bersetzer f¸r PTC-Ansteuerung" CURVE 0xFCC2B0 KlAxU8SstxU16WU16 127.5000 fak_q0p5 0.00 127.5000 FORMAT "%8.4"
 /begin AXIS_DESCR STD_AXIS allptcfilt fak_uw_q0p25o500 5 0.00 550.00000 FORMAT "%9.5" DEPOSIT ABSOLUTE /end AXIS_DESCR
/end CHARACTERISTIC
/begin CHARACTERISTIC KL_SOCPRIO "dsoc -> Prio ‹bersetzer" CURVE 0xFCC2C6 KlAxU8SstxU16WU16 300.00000 fak_uw_q0p25o500 -150.00000 150.00000 FORMAT "%9.5"
 /begin AXIS_DESCR STD_AXIS d_soc fak_q0p004_o100 4 -100.000 100.000 DEPOSIT ABSOLUTE /end AXIS_DESCR
/end CHARACTERISTIC
/begin CHARACTERISTIC KL_SSOC "soc_s in Abh. von tsaison" CURVE 0xFCC602 KlAxU8SstxU16WU16 100.00 fak_q0p002 0.00 100.00 FORMAT "%6.2"
 /begin AXIS_DESCR STD_AXIS t_saison temp_uw_q0p003_o48 4 -48.0000 148.605 DEPOSIT ABSOLUTE /end AXIS_DESCR
/end CHARACTERISTIC
/begin CHARACTERISTIC KL_UBTPRIO "" CURVE 0xFCC2D8 KlAxU8SstxU16WU16 200.00000 fak_uw_q0p25o500 -100.00000 100.00000 FORMAT "%9.5"
 /begin AXIS_DESCR STD_AXIS ubdifffilt spg_q0p977em3_om32 6 -32.000000 31.999023 FORMAT "%9.6" DEPOSIT ABSOLUTE /end AXIS_DESCR
/end CHARACTERISTIC
/begin CHARACTERISTIC KL_UB_PTC "UBatt-Kennlinie f¸r Ansteuerung PTC" CURVE 0xFCC2F2 KlAxU8SstxU16WU16 200.00000 fak_uw_q0p25o500 -100.00000 100.00000 FORMAT "%9.5"
 /begin AXIS_DESCR STD_AXIS ubtpt1ptc spg_q0p977em3_om32 6 -32.000000 31.999023 FORMAT "%9.6" DEPOSIT ABSOLUTE /end AXIS_DESCR
/end CHARACTERISTIC
/begin CHARACTERISTIC KUBPTC_LP "K-Faktor des ubatt-Tiefpass Filters zur Berechnung von PTC" VALUE 0xFCC3BE KwWU16 0.9999847 fak_uw_b1 0.00 0.9999847 FORMAT "%9.7" /end CHARACTERISTIC
/begin CHARACTERISTIC K_DF_LP "K-Faktor des df-Tiefpass Filters zur Berechnung von ctrpwrdf" VALUE 0xFCC3E9 KwWU8 1.000 fak_ub_q0p00392 0.00 1.000 FORMAT "%5.3" /end CHARACTERISTIC
/begin CHARACTERISTIC K_PTC_PI "K-Faktor des PI-Reglers PTC-Ansteuerung" VALUE 0xFCC3EA KwWU8 1.000 fak_ub_q0p00392 0.00 1.000 FORMAT "%5.3" /end CHARACTERISTIC
/begin CHARACTERISTIC K_PWRDF_PI "K-Faktor des PI Reglers zur Berechnung von ctrpwrdf" VALUE 0xFCC3EB KwWU8 1.000 fak_ub_q0p00392 0.00 1.000 FORMAT "%5.3" /end CHARACTERISTIC
/begin CHARACTERISTIC K_UBAT_LP "K-Faktor des ubatt-tiefpass Filters zur Berechnung von ctrpwrdf" VALUE 0xFCC3C0 KwWU16 0.9999847 fak_uw_b1 0.00 0.9999847 FORMAT "%9.7" /end CHARACTERISTIC
/begin CHARACTERISTIC LLPMFILTK "Filterkonstante : Tiefpassfilter DF-Signal" VALUE 0xFCC3EC KwWU8 1.000 fak_ub_q0p00392 0.00 1.000 FORMAT "%5.3" /end CHARACTERISTIC
/begin CHARACTERISTIC MDAPPAS "Schalter Applikation Auslass" VALUE 0xFCD75A KwWU8 255.0 dez 0.00 255.0 FORMAT "%5.1" /end CHARACTERISTIC
/begin CHARACTERISTIC MDAPPES "Schalter Applikation Einlass" VALUE 0xFCD75B KwWU8 255.0 dez 0.00 255.0 FORMAT "%5.1" /end CHARACTERISTIC
/begin CHARACTERISTIC MLSLMX "max. Motor-Luftmasse f¸r Sekund‰rlufteinblasung" VALUE 0xFD56B8 KwUw 6553.500 m_q0p1 0.00 6553.500 FORMAT "%8.3" /end CHARACTERISTIC
/begin CHARACTERISTIC MN_PTC_PI "Minimalwert des PI-Reglers PTC Ansteuerung" VALUE 0xFCC3ED KwWU8 450.000 fak_ub_q5p0 0.00 450.000 /end CHARACTERISTIC
/begin CHARACTERISTIC MN_PWRDFPI "Minimaler Wert PI-Regler df Prio" VALUE 0xFCC3EE KwWU8 450.000 fak_ub_q5p0 0.00 450.000 /end CHARACTERISTIC
/begin CHARACTERISTIC MSLUB "Sekund‰rluftmasse abh‰ngig von der Batteriespannung" CURVE 0xFD56BA KlAUwSstUwWUw 102.3984 m_uw_b102p4 0.00 102.3984 FORMAT "%8.4"
 /begin AXIS_DESCR STD_AXIS ubsqf_w spg_q0p00039 8 0.00 25.59961 FORMAT "%8.5" DEPOSIT ABSOLUTE /end AXIS_DESCR
/end CHARACTERISTIC
/begin CHARACTERISTIC MX_PTC_PI "Maximalwert des PI-Reglers PTC Ansteuerung" VALUE 0xFCC3EF KwWU8 450.000 fak_ub_q5p0 0.00 450.000 /end CHARACTERISTIC
/begin CHARACTERISTIC MX_PWRDFPI "Maximalwert PI_Regler df Prios" VALUE 0xFCC3F0 KwWU8 450.000 fak_ub_q5p0 0.00 450.000 /end CHARACTERISTIC
/begin CHARACTERISTIC NMOTGLUE "" VALUE 0xFCD75C KwWU8 10200. nmot_ub_q40 0.00 10200. FORMAT "%5.0" /end CHARACTERISTIC
/begin CHARACTERISTIC NSWO "Drehzahlschwelle Umschaltg. zur Rechenzeitersparnis" VALUE 0xFD40F8 KwUb 10200. nmot_ub_q40 0.00 10200. FORMAT "%5.0" /end CHARACTERISTIC
/begin CHARACTERISTIC NSWO1 "Drehzahlschwelle 1 Umschaltg. zur Rechenzeitersparnis" VALUE 0xFD40F9 KwUb 10200. nmot_ub_q40 0.00 10200. FORMAT "%5.0" /end CHARACTERISTIC
/begin CHARACTERISTIC OFASPRAP "Offset Applikation Auslass" VALUE 0xFCD74C KwWS16 360.0000 sprzi_q0p8 -180.0000 180.0000 FORMAT "%8.4" /end CHARACTERISTIC
/begin CHARACTERISTIC OFESPRAP "Offset Applikation Einlass" VALUE 0xFCD74E KwWS16 360.0000 sprzi_q0p8 -180.0000 180.0000 FORMAT "%8.4" /end CHARACTERISTIC
/begin CHARACTERISTIC PCOSCHGAPP "" VALUE 0xFCC3F1 KwWU8 255.0 DEZ 0.00 255.0 FORMAT "%5.1" /end CHARACTERISTIC
/begin CHARACTERISTIC PERF_MAXRST "" VALUE 0xFCC6AC KwWU8 255.0 default 0.00 255.0 FORMAT "%5.1" /end CHARACTERISTIC
/begin CHARACTERISTIC PMQ_UX "Ruhespannung Extrapolationsteiler" VALUE 0xFCC49A KwWU8 254.0 DEZ 1.000 255.0 FORMAT "%5.1" /end CHARACTERISTIC
/begin CHARACTERISTIC PMTIMERSQ1 "Startwert Timer f¸r soc_quali" VALUE 0xFCC634 KwWU8 1530. t6minxmin_q6 0.00 1530. FORMAT "%5.0" /end CHARACTERISTIC
/begin CHARACTERISTIC PMUBAT_MAX "Max. zugelassene Batteriespg" VALUE 0xFCC18E KwWU8 11.008 spg_ub_q0p064_o6 6.0000 17.008 /end CHARACTERISTIC
/begin CHARACTERISTIC PMUBAT_MIN "Min. zugelassene Batteriespg" VALUE 0xFCC18F KwWU8 11.008 spg_ub_q0p064_o6 6.0000 17.008 /end CHARACTERISTIC
/begin CHARACTERISTIC PMUGEN_MAX "Max zugelassene Generatorspg" VALUE 0xFCC190 KwWU8 6.375 spg_gencan 10.60 16.98 FORMAT "%5.2" /end CHARACTERISTIC
/begin CHARACTERISTIC PMUGEN_MIN "Min zugelassene Generatorspg" VALUE 0xFCC191 KwWU8 6.375 spg_gencan 10.60 16.98 FORMAT "%5.2" /end CHARACTERISTIC
/begin CHARACTERISTIC PM_TABSMN "Applikationsgrˆsse f¸r Abstellzeit tabsmn_w" VALUE 0xFCC626 KwWU16 65535.00 DEZ 0.00 65535.00 FORMAT "%8.2" /end CHARACTERISTIC
/begin CHARACTERISTIC PRIOCFAPP "Steuerung Spitzenreduzierung Prioritaet Komfort" VALUE 0xFCC3F2 KwWU8 7.000 DEZ 0.00 7.000 FORMAT "%5.3" /end CHARACTERISTIC
/begin CHARACTERISTIC PSAPES "Saugrohrdruck f¸r Applikation Einspritzung" VALUE 0xFC77A6 KwWU16 2559.961 p_q0p039 0.00 2559.961 FORMAT "%8.3" /end CHARACTERISTIC
/begin CHARACTERISTIC PT1SPR "" VALUE 0xFCD75D KwWU8 0.9961 fak_ub_b1 0.00 0.9961 /end CHARACTERISTIC
/begin CHARACTERISTIC PTCPWRAPP "Ansteuerung PWM-Ausgang f¸r PTC-Zuheize" VALUE 0xFCC3F3 KwWU8 127.5 fak_q0p5 0.00 127.5 FORMAT "%5.1" /end CHARACTERISTIC
/begin CHARACTERISTIC PWRCOSAPP "Steuerung Leistung Verbraucher bitcodiert" VALUE 0xFCC3C2 KwWU16 65535.00 DEZ 0.00 65535.00 FORMAT "%8.2" /end CHARACTERISTIC
/begin CHARACTERISTIC PWRSPCSAPP "Steuerung Leistung Sonderbverbraucher" VALUE 0xFCC3F4 KwWU8 127.5 fak_q0p5 0.00 127.5 FORMAT "%5.1" /end CHARACTERISTIC
/begin CHARACTERISTIC QSOCCL1 "Grenze zur Ladezustandsqualit‰tsklasse1" VALUE 0xFCC488 KwWU16 1193.0 qlad_uw_q0p0182 0.00 1193.0 FORMAT "%6.1" /end CHARACTERISTIC
/begin CHARACTERISTIC QSOCCL2 "Grenze zur Ladezustandsqualit‰tsklasse2" VALUE 0xFCC48A KwWU16 1193.0 qlad_uw_q0p0182 0.00 1193.0 FORMAT "%6.1" /end CHARACTERISTIC
/begin CHARACTERISTIC QSOCCL3 "Grenze zur Ladezustandsqualit‰tsklasse3" VALUE 0xFCC628 KwWU16 1193.0 qlad_uw_q0p0182 0.00 1193.0 FORMAT "%6.1" /end CHARACTERISTIC
/begin CHARACTERISTIC QSTARTFGA "Applikationswert f¸r q_startfgk" VALUE 0xFCC62A KwWU16 1193.0 qlad_uw_q0p0182 0.00 1193.0 FORMAT "%6.1" /end CHARACTERISTIC
/begin CHARACTERISTIC Q_BILAPWF "Defaultwert f¸r q_bila nach Powerfail" VALUE 0xFCC494 KwWU32 1193.046 qlad_ul_q2p7Em7 0.00 1193.046 FORMAT "%8.3" /end CHARACTERISTIC
/begin AXIS_PTS RESTNMOT_W "" 0xFCD766 nmot_w SstAU8SstU16 16383.75 nmot_uw_q0p25 12 0.00 16383.75 FORMAT "%8.2" DEPOSIT ABSOLUTE /end AXIS_PTS
/begin AXIS_PTS RESTRLVW_W "" 0xFCD780 rlvwrstg_w SstAU8SstU16 1535.977 rel_uw_q0p0234 12 0.00 1535.977 FORMAT "%8.3" DEPOSIT ABSOLUTE /end AXIS_PTS
/begin CHARACTERISTIC RIN_GRENZ1 "" VALUE 0xFCC64A KwWU8 31.8750 r_q0p125 0.00 31.8750 FORMAT "%7.4" /end CHARACTERISTIC
/begin CHARACTERISTIC RIN_GRENZ2 "" VALUE 0xFCC64B KwWU8 31.8750 r_q0p125 0.00 31.8750 FORMAT "%7.4" /end CHARACTERISTIC
/begin CHARACTERISTIC RIN_GRENZ3 "" VALUE 0xFCC64C KwWU8 31.8750 r_q0p125 0.00 31.8750 FORMAT "%7.4" /end CHARACTERISTIC
/begin CHARACTERISTIC RIN_GRENZ4 "" VALUE 0xFCC64D KwWU8 31.8750 r_q0p125 0.00 31.8750 FORMAT "%7.4" /end CHARACTERISTIC
/begin CHARACTERISTIC RIN_GRENZ5 "" VALUE 0xFCC64E KwWU8 31.8750 r_q0p125 0.00 31.8750 FORMAT "%7.4" /end CHARACTERISTIC
/begin CHARACTERISTIC RIN_GRENZ6 "" VALUE 0xFCC64F KwWU8 31.8750 r_q0p125 0.00 31.8750 FORMAT "%7.4" /end CHARACTERISTIC
/begin CHARACTERISTIC RIN_GRENZ7 "" VALUE 0xFCC650 KwWU8 31.8750 r_q0p125 0.00 31.8750 FORMAT "%7.4" /end CHARACTERISTIC
/begin CHARACTERISTIC RIN_GRENZ8 "" VALUE 0xFCC651 KwWU8 31.8750 r_q0p125 0.00 31.8750 FORMAT "%7.4" /end CHARACTERISTIC
/begin CHARACTERISTIC RQPCOSA "" VALUE 0xFCC3F5 KwWU8 255.0 DEZ 0.00 255.0 FORMAT "%5.1" /end CHARACTERISTIC
/begin CHARACTERISTIC RQPCOSAPP "Anforderung Standverbraucher" VALUE 0xFCC3F6 KwWU8 3.000 DEZ 0.00 3.000 FORMAT "%5.3" /end CHARACTERISTIC
/begin AXIS_PTS SAN12ESUW "SST-Verteilung f¸r den begrenzten Einspritzz‰hler anztib_w" 0xFC144C anztib_w SstAUwSstUw 65535.00 dez 12 0.00 65535.00 FORMAT "%8.2" DEPOSIT ABSOLUTE /end AXIS_PTS
/begin AXIS_PTS SDM05TESB "dmssginr abh‰ngige St¸tzstellen (Anzahl 5)" 0xFC1330 dmssginr SstAU8SstS8 1.992 fak_sb_b1 5 -1.000 0.9922 FORMAT "%5.3" DEPOSIT ABSOLUTE /end AXIS_PTS
/begin AXIS_PTS SEH06KRUW "St¸tzstellenverteilung evhubi_w, 6 Sst." 0xFCF8AA evhubi_w SstASwSstSw 65.53500 hub_uw_q0p001 6 0.00 65.53500 FORMAT "%8.5" DEPOSIT ABSOLUTE /end AXIS_PTS
/begin CHARACTERISTIC SELSPCOSA "" VALUE 0xFCC3F7 KwWU8 255.0 DEZ 0.00 255.0 FORMAT "%5.1" /end CHARACTERISTIC
/begin CHARACTERISTIC SELSPCSAPP "Auswahl Sonderverbraucher" VALUE 0xFCC3F8 KwWU8 15.00 DEZ 0.00 15.00 FORMAT "%5.2" /end CHARACTERISTIC
/begin AXIS_PTS SEZ06TMUB "St¸tzstellenverteilung, Z¸ndwinkelwirkungsgrad" 0xFCF7F8 etazwimt SstAUbSstUb 127.5 rel_ub_b127p5 6 0.00 127.5 FORMAT "%5.1" DEPOSIT ABSOLUTE /end AXIS_PTS
/begin AXIS_PTS SFR04BBUW "St¸tzstellenverteilung Luftdichte f(Ansauglufttemp., Hˆhe) 16-Bit" 0xFC1326 frhol_w SstAU8SstU16 1.999969 fak_uw_b2 4 0.00 1.999969 FORMAT "%8.6" DEPOSIT ABSOLUTE /end AXIS_PTS
/begin AXIS_PTS SGA07MDUB "Gruppenst¸tzstelle Gangabh‰ngig" 0xFCF7FF gangi SstAUbSstUb 255.0 dez 7 0.00 255.0 FORMAT "%5.1" DEPOSIT ABSOLUTE /end AXIS_PTS
/begin AXIS_PTS SGA08MDUB "St¸tzstellenverteilung Ist Gang 8 Sst." 0xFCF807 gangi SstAUbSstUb 255.0 dez 8 0.00 255.0 FORMAT "%5.1" DEPOSIT ABSOLUTE /end AXIS_PTS
/begin AXIS_PTS SKS06ESUB "SST-Verteilung f¸r den Startadaptionsfaktor kstaa" 0xFC1378 kstaa SstAUbSstUb 1.992 fak_ub_b2 6 0.00 1.992 FORMAT "%5.3" DEPOSIT ABSOLUTE /end AXIS_PTS
/begin AXIS_PTS SLX06TMUW "St¸tzstellenverteilung, Lambdasoll" 0xFCF8B8 lamsbg_w SstAUwSstUw 15.99976 fak_uw_b16 6 0.00 15.99976 FORMAT "%8.5" DEPOSIT ABSOLUTE /end AXIS_PTS
/begin AXIS_PTS SLY06TMUW "St¸tzstellenverteilung, Lambdasoll Bank2" 0xFCF8C6 lamsbg2_w SstAUwSstUw 15.99976 fak_uw_b16 6 0.00 15.99976 FORMAT "%8.5" DEPOSIT ABSOLUTE /end AXIS_PTS
/begin AXIS_PTS SMI08DMUB "SST-Verteilung in DMD, 8 Moment-SST" 0xFC1D6C midmd SstAU8SstU8 99.61 rel_ub_b99p6 8 0.00 99.61 FORMAT "%5.2" DEPOSIT ABSOLUTE /end AXIS_PTS
/begin AXIS_PTS SML06TEUB "ml abh‰ngige St¸tzstellen (Anzahl 6)" 0xFCF810 ml SstAUbSstUb 1020. m_ub_b1020 6 0.00 1020. FORMAT "%5.0" DEPOSIT ABSOLUTE /end AXIS_PTS
/begin AXIS_PTS SML06TMUW "St¸tzstellenverteilung, Luftmasse, 6 St¸tzstellen" 0xFCF8D4 ml_w SstAUwSstUw 6553.500 m_uw_b6553p5 6 0.00 6553.500 FORMAT "%8.3" DEPOSIT ABSOLUTE /end AXIS_PTS
/begin AXIS_PTS SML07TMUW "St¸tzstellenverteilung, Luftmasse, 7 St¸tzstellen" 0xFCF8E2 ml_w SstAUwSstUw 6553.500 m_uw_b6553p5 7 0.00 6553.500 FORMAT "%8.3" DEPOSIT ABSOLUTE /end AXIS_PTS
/begin AXIS_PTS SML08LHUB "ml abh‰ngige St¸tzstellen (Anzahl 8)" 0xFCF817 ml SstAUbSstUb 1020. m_ub_b1020 8 0.00 1020. FORMAT "%5.0" DEPOSIT ABSOLUTE /end AXIS_PTS
/begin AXIS_PTS SN16KR1UB "" 0xFC1336 nmot SstAU8SstU8 10200. nmot_ub_q40 16 0.00 10200. FORMAT "%5.0" DEPOSIT ABSOLUTE /end AXIS_PTS
/begin AXIS_PTS SN16KR2UB "" 0xFC1347 nmot SstAU8SstU8 10200. nmot_ub_q40 16 0.00 10200. FORMAT "%5.0" DEPOSIT ABSOLUTE /end AXIS_PTS
/begin AXIS_PTS SNG06LLSB "St¸tzstellenverteilung Drehzahlgradient, 6 Sst." 0xFC137F ngfil SstAUbSstSb 25500. nmotg_sb_q100 6 -12800. 12700. FORMAT "%5.0" DEPOSIT ABSOLUTE /end AXIS_PTS
/begin AXIS_PTS SNG06LLTSB "St¸tzstellenverteilung Drehzahlgradient, 6 Sst." 0xFC1386 ngfil SstAUbSstSb 25500. nmotg_sb_q100 6 -12800. 12700. FORMAT "%5.0" DEPOSIT ABSOLUTE /end AXIS_PTS
/begin AXIS_PTS SNM04TEUB "Motordrehzahl-abh‰ngige St¸tzstellen (Anzahl =4)" 0xFC1358 nmot SstAU8SstU8 10200. nmot_ub_q40 4 0.00 10200. FORMAT "%5.0" DEPOSIT ABSOLUTE /end AXIS_PTS
/begin AXIS_PTS SNM06LLUB "S¸tzstellenverteilung f¸r Motordrehzahl" 0xFC138D nmot SstAUbSstUb 10200. nmot_ub_q40 6 0.00 10200. FORMAT "%5.0" DEPOSIT ABSOLUTE /end AXIS_PTS
/begin AXIS_PTS SNM06MDUW "Rover" 0xFCF8F2 nmot_w SstAUwSstUw 16383.75 nmot_uw_q0p25 6 0.00 16383.75 FORMAT "%8.2" DEPOSIT ABSOLUTE /end AXIS_PTS
/begin AXIS_PTS SNM07ESUB "St¸tzstellenverteilung Drehzahl, 7 Sst." 0xFCF820 nmot SstAUbSstUb 10200. nmot_ub_q40 7 0.00 10200. FORMAT "%5.0" DEPOSIT ABSOLUTE /end AXIS_PTS
/begin AXIS_PTS SNM07LSUW "St¸tzstellenverteilung Reglerparameter LRS" 0xFC1466 nmot_w SstAUwSstUw 16383.75 nmot_uw_q0p25 7 0.00 16383.75 FORMAT "%8.2" DEPOSIT ABSOLUTE /end AXIS_PTS
/begin AXIS_PTS SNM08DMUB "SST-Verteilung in DMD, 8 Drehzahl-SST" 0xFC1D75 nmot SstAU8SstU8 10200. nmot_ub_q40 8 0.00 10200. FORMAT "%5.0" DEPOSIT ABSOLUTE /end AXIS_PTS
/begin AXIS_PTS SNM08DMUW1 "St¸tzstellen KF Fuel-on-Adaption" 0xFC1D5A nmot_w SstAU8SstU16 16383.75 nmot_uw_q0p25 8 0.00 16383.75 FORMAT "%8.2" DEPOSIT ABSOLUTE /end AXIS_PTS
/begin AXIS_PTS SNM08GKUB "St¸tzstellenverteilung Gemischkontrolle 8 nmot St¸tzstellen" 0xFC135D nmot SstAU8SstU8 10200. nmot_ub_q40 8 0.00 10200. FORMAT "%5.0" DEPOSIT ABSOLUTE /end AXIS_PTS
/begin AXIS_PTS SNM08KRUW "St¸tzstellenverteilung Drehzahl, 8 Sst." 0xFCF900 nmot_w SstAUwSstUw 16383.75 nmot_uw_q0p25 8 0.00 16383.75 FORMAT "%8.2" DEPOSIT ABSOLUTE /end AXIS_PTS
/begin AXIS_PTS SNM08LHUB "nmot abh‰ngige St¸tzstellen (Anzahl 8)" 0xFCF828 nmot SstAUbSstUb 10200. nmot_ub_q40 8 0.00 10200. FORMAT "%5.0" DEPOSIT ABSOLUTE /end AXIS_PTS
/begin AXIS_PTS SNM08__UB "St¸tzstellenverteilung Drehzahl, 8 Sst." 0xFC1394 nmot SstAUbSstUb 10200. nmot_ub_q40 8 0.00 10200. FORMAT "%5.0" DEPOSIT ABSOLUTE /end AXIS_PTS
/begin AXIS_PTS SNM10LSUB "St¸tzstellenverteilung Kat-Vorsteuerwert LRS" 0xFC139D nmot SstAUbSstUb 10200. nmot_ub_q40 10 0.00 10200. FORMAT "%5.0" DEPOSIT ABSOLUTE /end AXIS_PTS
/begin AXIS_PTS SNM12ESUB "SST-Verteilung f¸r die Motordrehzahl nmot" 0xFC13A8 nmot SstAUbSstUb 10200. nmot_ub_q40 12 0.00 10200. FORMAT "%5.0" DEPOSIT ABSOLUTE /end AXIS_PTS
/begin AXIS_PTS SNM12FEUB "St¸tzstellen f¸r WDKSMX, WDKUGDN" 0xFC13B5 nmot SstAUbSstUb 10200. nmot_ub_q40 12 0.00 10200. FORMAT "%5.0" DEPOSIT ABSOLUTE /end AXIS_PTS
/begin AXIS_PTS SNM16KRUB "St¸tzstellenverteilung Drehzahl, 16 Sst." 0xFCF831 nmot SstAUbSstUb 10200. nmot_ub_q40 16 0.00 10200. FORMAT "%5.0" DEPOSIT ABSOLUTE /end AXIS_PTS
/begin AXIS_PTS SNM16OPUW "St¸tzstellenverteilung Drehzahl" 0xFC1476 nmot_w SstAUwSstUw 16383.75 nmot_uw_q0p25 16 0.00 16383.75 FORMAT "%8.2" DEPOSIT ABSOLUTE /end AXIS_PTS
/begin AXIS_PTS SNM16ZUUB "St¸tzstellenverteilung Drehzahl, 16 Sst." 0xFC13C2 nmot SstAUbSstUb 10200. nmot_ub_q40 16 0.00 10200. FORMAT "%5.0" DEPOSIT ABSOLUTE /end AXIS_PTS
/begin AXIS_PTS SNM24ZUUB "St¸tzstellenverteilung Drehzahl, 24 Sst." 0xFC13D3 nmot SstAUbSstUb 10200. nmot_ub_q40 24 0.00 10200. FORMAT "%5.0" DEPOSIT ABSOLUTE /end AXIS_PTS
/begin CHARACTERISTIC SOCFITABW "Applikationskonstante zur Abwertung SoC aus der Fitberechnung" VALUE 0xFCC62C KwWU16 99.99847 rel_uw_b100 0.00 99.99847 FORMAT "%8.5" /end CHARACTERISTIC
/begin CHARACTERISTIC SOCFITAPP "Applikationwert Soc aus der Fitberechnung" VALUE 0xFCC5FC KwWU16 99.99847 rel_uw_b100 0.00 99.99847 FORMAT "%8.5" /end CHARACTERISTIC
/begin CHARACTERISTIC SOCFITGRZ "Grenzwert f¸r soc_fit" VALUE 0xFCC62E KwWU16 99.99847 rel_uw_b100 0.00 99.99847 FORMAT "%8.5" /end CHARACTERISTIC
/begin CHARACTERISTIC SOC_BILAWA "Applikationswert soc_bila" VALUE 0xFCC48C KwWU16 99.99847 rel_uw_b100 0.00 99.99847 FORMAT "%8.5" /end CHARACTERISTIC
/begin CHARACTERISTIC SOC_QUALIA "Applikationswert soc_quali" VALUE 0xFCC48E KwWU16 99.99847 rel_uw_b100 0.00 99.99847 FORMAT "%8.5" /end CHARACTERISTIC
/begin CHARACTERISTIC SOC_Q_PWF "Ladezustandsqualit‰t nach Powerfail" VALUE 0xFCC490 KwWU16 1193.0 qlad_uw_q0p0182 0.00 1193.0 FORMAT "%6.1" /end CHARACTERISTIC
/begin CHARACTERISTIC SOC_STAFGA "Applikationswert f¸r SoC aus der Startf‰higkeit" VALUE 0xFCC630 KwWU16 99.99847 rel_uw_b100 0.00 99.99847 FORMAT "%8.5" /end CHARACTERISTIC
/begin AXIS_PTS SQM05TEUB "Luftmassenquotient-abh‰ngige St¸tzstellen (Anzahl =5)" 0xFC13EC qmsdyn SstAUbSstUb 15.94 fak_ub_b16 5 0.00 15.94 FORMAT "%5.2" DEPOSIT ABSOLUTE /end AXIS_PTS
/begin AXIS_PTS SRL04KRUB "St¸tzstellenverteilung relative F¸llung, 4 Sst." 0xFCF842 rl SstAUbSstUb 191.3 rel_ub_q0p75 4 0.00 191.3 FORMAT "%5.1" DEPOSIT ABSOLUTE /end AXIS_PTS
/begin AXIS_PTS SRL06ZUUB "" 0xFC13F2 rl SstAUbSstUb 191.3 rel_ub_q0p75 6 0.00 191.3 FORMAT "%5.1" DEPOSIT ABSOLUTE /end AXIS_PTS
/begin AXIS_PTS SRL08GKUB "St¸tzstellenverteilung Gemischkontrolle 8 rl St¸tzstellen" 0xFC1366 rl SstAU8SstU8 191.3 rel_ub_q0p75 8 0.00 191.3 FORMAT "%5.1" DEPOSIT ABSOLUTE /end AXIS_PTS
/begin AXIS_PTS SRL08LSUW "St¸tzstellenverteilung Reglerparameter" 0xFC1498 rl_w SstAUwSstUw 1535.977 rel_uw_q0p0234 8 0.00 1535.977 FORMAT "%8.3" DEPOSIT ABSOLUTE /end AXIS_PTS
/begin AXIS_PTS SRL10LSUB "St¸tzstellenverteilung Kat-Vorsteuerwert LRS" 0xFC13F9 rl SstAUbSstUb 191.3 rel_ub_q0p75 10 0.00 191.3 FORMAT "%5.1" DEPOSIT ABSOLUTE /end AXIS_PTS
/begin AXIS_PTS SRL12ESUB "Sst-Verteilung f¸r die relative F¸llung rl" 0xFC1404 rl SstAUbSstUb 191.3 rel_ub_q0p75 12 0.00 191.3 FORMAT "%5.1" DEPOSIT ABSOLUTE /end AXIS_PTS
/begin AXIS_PTS SRL12ZUUB "St¸tzstellenverteilung relative Luftf¸llung, 12 St." 0xFC1411 rl SstAUbSstUb 191.3 rel_ub_q0p75 12 0.00 191.3 FORMAT "%5.1" DEPOSIT ABSOLUTE /end AXIS_PTS
/begin AXIS_PTS SRL16ZUUB "St¸tzstellenverteilung relative F¸llung, 16 Sst." 0xFC141E rl SstAUbSstUb 191.3 rel_ub_q0p75 16 0.00 191.3 FORMAT "%5.1" DEPOSIT ABSOLUTE /end AXIS_PTS
/begin AXIS_PTS ST107TMUB "St¸tzstellenverteilung, Starttemperatur an Sonde vorne" 0xFCF847 tabgmst SstAUbSstUb 1275. temp_ub_q5_o50 7 -50.00 1225. FORMAT "%5.0" DEPOSIT ABSOLUTE /end AXIS_PTS
/begin AXIS_PTS ST207TMUB "St¸tzstellenverteilung, Starttemperatur an Sonde vorne, Bank2" 0xFCF84F tabgmst2 SstAUbSstUb 1275. temp_ub_q5_o50 7 -50.00 1225. FORMAT "%5.0" DEPOSIT ABSOLUTE /end AXIS_PTS
/begin AXIS_PTS ST307TMUB "St¸tzstellenverteilung, Starttemperatur an Sonde hinten" 0xFCF857 tkatmst SstAUbSstUb 1275. temp_ub_q5_o50 7 -50.00 1225. FORMAT "%5.0" DEPOSIT ABSOLUTE /end AXIS_PTS
/begin AXIS_PTS ST407TMUB "St¸tzstellenverteilung, Starttemperatur an Sonde hinten, Bank2" 0xFCF85F tkatmst2 SstAUbSstUb 1275. temp_ub_q5_o50 7 -50.00 1225. FORMAT "%5.0" DEPOSIT ABSOLUTE /end AXIS_PTS
/begin AXIS_PTS STA04SAUB "SST-Verteilung f¸r die Ansauglufttemperatur" 0xFC142F tans SstAUbSstUb 191.3 temp_ub_q0p75_o48 4 -48.00 143.3 FORMAT "%5.1" DEPOSIT ABSOLUTE /end AXIS_PTS
/begin AXIS_PTS STA06ESUB "SST-Verteilung f¸r die Ansauglufttemperatur" 0xFCF867 tans SstAUbSstUb 191.3 temp_ub_q0p75_o48 6 -48.00 143.3 FORMAT "%5.1" DEPOSIT ABSOLUTE /end AXIS_PTS
/begin AXIS_PTS STM04FEUB "St¸tzstellenverteilung Motortemperatur" 0xFC1434 tmot SstAUbSstUb 191.3 temp_ub_q0p75_o48 4 -48.00 143.3 FORMAT "%5.1" DEPOSIT ABSOLUTE /end AXIS_PTS
/begin AXIS_PTS STM04SAUB "St¸tzstellenverteilung Motortemperatur, 4 Sst." 0xFC1439 tmot SstAUbSstUb 191.3 temp_ub_q0p75_o48 4 -48.00 143.3 FORMAT "%5.1" DEPOSIT ABSOLUTE /end AXIS_PTS
/begin AXIS_PTS STM05SAUB "St¸tzstellenverteilung" 0xFCF86E tmot SstAUbSstUb 191.3 temp_ub_q0p75_o48 5 -48.00 143.3 FORMAT "%5.1" DEPOSIT ABSOLUTE /end AXIS_PTS
/begin AXIS_PTS STM05TMUB "St¸tzstellenverteilung, Motorstarttemperatur" 0xFCF912 tmst SstAUwSstUw 191.3 temp_ub_q0p75_o48 5 -48.00 143.3 FORMAT "%5.1" DEPOSIT ABSOLUTE /end AXIS_PTS
/begin AXIS_PTS STM06LLTUB "St¸tzstellenverteilung Motortemperatur, 6 Sst." 0xFCF874 tmot SstAUbSstUb 191.3 temp_ub_q0p75_o48 6 -48.00 143.3 FORMAT "%5.1" DEPOSIT ABSOLUTE /end AXIS_PTS
/begin AXIS_PTS STM06LLUB "St¸tzstellenverteilung Motortemperatur, 6 Sst." 0xFCF87B tmot SstAUbSstUb 191.3 temp_ub_q0p75_o48 6 -48.00 143.3 FORMAT "%5.1" DEPOSIT ABSOLUTE /end AXIS_PTS
/begin AXIS_PTS STM06__UB "St¸tzstellenverteilung Motortemperatur, 6 Sst." 0xFCF882 tmot SstAUbSstUb 191.3 temp_ub_q0p75_o48 6 -48.00 143.3 FORMAT "%5.1" DEPOSIT ABSOLUTE /end AXIS_PTS
/begin AXIS_PTS STM08BBUB "St¸tzstellenverteilung Motortemperatur, 8 Sst." 0xFC136F tmot SstAU8SstU8 191.3 temp_ub_q0p75_o48 8 -48.00 143.3 FORMAT "%5.1" DEPOSIT ABSOLUTE /end AXIS_PTS
/begin AXIS_PTS STM08MDUB "St¸tzstellenverteilung: tmot f¸r Drehmomentwandler" 0xFCF889 tmot SstAUbSstUb 191.3 temp_ub_q0p75_o48 8 -48.00 143.3 FORMAT "%5.1" DEPOSIT ABSOLUTE /end AXIS_PTS
/begin AXIS_PTS STM09ESUB "St¸tzstellenverteilung Motortemperatur, 9 Sst." 0xFCF892 tmot SstAUbSstUb 191.3 temp_ub_q0p75_o48 9 -48.00 143.3 FORMAT "%5.1" DEPOSIT ABSOLUTE /end AXIS_PTS
/begin AXIS_PTS STM12ESUB "SST-Verteilung f¸r die Motortemperatur tmot" 0xFCF89C tmot SstAUbSstUb 191.3 temp_ub_q0p75_o48 12 -48.00 143.3 FORMAT "%5.1" DEPOSIT ABSOLUTE /end AXIS_PTS
/begin CHARACTERISTIC STPCOSAPP "Status Standverbraucher" VALUE 0xFCC3F9 KwWU8 3.000 DEZ 0.00 3.000 FORMAT "%5.3" /end CHARACTERISTIC
/begin AXIS_PTS STS12ESUB "SST-Verteilung f¸r Motorstarttemperatur" 0xFC143E tmst SstAUbSstUb 191.3 temp_ub_q0p75_o48 12 -48.00 143.3 FORMAT "%5.1" DEPOSIT ABSOLUTE /end AXIS_PTS
/begin AXIS_PTS SWD06KRSW "St¸tzstellenverteilung DK-Winkel, 6 Sst." 0xFCF91E wdkba_w SstASwSstSw 1599.976 relDK_q0p02441 6 -800.0000 799.9756 FORMAT "%8.4" DEPOSIT ABSOLUTE /end AXIS_PTS
/begin CHARACTERISTIC S_ABSCHK "Schalter f¸r Applikationswert absch_korr" VALUE 0xFCC635 KwWU8 255.0 DEZ 0.00 255.0 FORMAT "%5.1" /end CHARACTERISTIC
/begin CHARACTERISTIC S_ASPSATRU "App. Schalter f¸r dauerhafte zus. Auslassspreizung" VALUE 0xFCD75E KwWU8 1.000 dez 0.00 1.000 FORMAT "%5.3" /end CHARACTERISTIC
/begin CHARACTERISTIC S_BSOCCALC "Enable R¸cksetzten Ruhespannungen IBS" VALUE 0xFCC49B KwWU8 255.0 DEZ 0.00 255.0 FORMAT "%5.1" /end CHARACTERISTIC
/begin CHARACTERISTIC S_B_IFBSAC "manueller Schalter f¸r Fehler BSD" VALUE 0xFCC192 KwWU8 255.0 DEZ 0.00 255.0 FORMAT "%5.1" /end CHARACTERISTIC
/begin CHARACTERISTIC S_B_IFUPLA "manueller Schalter f¸r Fehler IBS" VALUE 0xFCC193 KwWU8 255.0 DEZ 0.00 255.0 FORMAT "%5.1" /end CHARACTERISTIC
/begin CHARACTERISTIC S_DSOCS "Schalter f¸r Applikationswert Delta SoC" VALUE 0xFCC636 KwWU8 255.0 DEZ 0.00 255.0 FORMAT "%5.1" /end CHARACTERISTIC
/begin CHARACTERISTIC S_E65PRIO "Umschalter von Regelungsberechnung auf Logikberechnung der Prios" VALUE 0xFCC3FA KwWU8 255.0 DEZ 0.00 255.0 FORMAT "%5.1" /end CHARACTERISTIC
/begin CHARACTERISTIC S_ENGENSLP "Codewort zum Freischalten der Generatorsollspannung bei SLP-Betrieb" VALUE 0xFD5722 KwWU8 255.0 DEZ 0.00 255.0 FORMAT "%5.1" /end CHARACTERISTIC
/begin CHARACTERISTIC S_ESPSATRU "App. Schalter f¸r dauerhafte zus. Einlassspreizung" VALUE 0xFCD75F KwWU8 1.000 dez 0.00 1.000 FORMAT "%5.3" /end CHARACTERISTIC
/begin CHARACTERISTIC S_IBFBSD7 "" VALUE 0xFCC3FB KwWU8 255.0 DEZ 0.00 255.0 FORMAT "%5.1" /end CHARACTERISTIC
/begin CHARACTERISTIC S_IFBSAK7 "" VALUE 0xFCC3FC KwWU8 255.0 DEZ 0.00 255.0 FORMAT "%5.1" /end CHARACTERISTIC
/begin CHARACTERISTIC S_IFUPLAK7 "" VALUE 0xFCC3FD KwWU8 255.0 DEZ 0.00 255.0 FORMAT "%5.1" /end CHARACTERISTIC
/begin CHARACTERISTIC S_PCOSCHG "" VALUE 0xFCC3FE KwWU8 255.0 DEZ 0.00 255.0 FORMAT "%5.1" /end CHARACTERISTIC
/begin CHARACTERISTIC S_PMMESS "" VALUE 0xFCC3FF KwWU8 255.0 DEZ 0.00 255.0 FORMAT "%5.1" /end CHARACTERISTIC
/begin CHARACTERISTIC S_PMSOCFIT "Schalter zur Applikation SoC aus der Fitberechnung" VALUE 0xFCC600 KwWU8 255.0 DEZ 0.00 255.0 FORMAT "%5.1" /end CHARACTERISTIC
/begin CHARACTERISTIC S_PMSTARTQ "Applikationsschalter f. B_pmstartq" VALUE 0xFCC652 KwWU8 255.0 DEZ 0.00 255.0 FORMAT "%5.1" /end CHARACTERISTIC
/begin CHARACTERISTIC S_PMTABSMN "Schalter f¸r Applikation der Abstellzeit tabsmn_w" VALUE 0xFCC637 KwWU8 255.0 DEZ 0.00 255.0 FORMAT "%5.1" /end CHARACTERISTIC
/begin CHARACTERISTIC S_PM_TEST1 "Applikationsschalter um die Startberechnung auf jeden Fall zu ermˆglichen." VALUE 0xFCC653 KwWU8 255.0 DEZ 0.00 255.0 FORMAT "%5.1" /end CHARACTERISTIC
/begin CHARACTERISTIC S_PRIO_E60 "Manueller Schalter fuer E60-Can Botschaften" VALUE 0xFCC400 KwWU8 255.0 DEZ 0.00 255.0 FORMAT "%5.1" /end CHARACTERISTIC
/begin CHARACTERISTIC S_PRIO_E65 "Manueller Schalter fuer E65-Can Botschaften" VALUE 0xFCC401 KwWU8 255.0 DEZ 0.00 255.0 FORMAT "%5.1" /end CHARACTERISTIC
/begin CHARACTERISTIC S_PTCOLMAN "" VALUE 0xFCC402 KwWU8 255.0 DEZ 0.00 255.0 FORMAT "%5.1" /end CHARACTERISTIC
/begin CHARACTERISTIC S_PTC_OLD "Schalter, aktiviert ehz_pw Berechnung wie im HKW" VALUE 0xFCC403 KwWU8 255.0 DEZ 0.00 255.0 FORMAT "%5.1" /end CHARACTERISTIC
/begin CHARACTERISTIC S_QSTARTFK "Schalter f¸r Applikation q_startfgk" VALUE 0xFCC638 KwWU8 255.0 DEZ 0.00 255.0 FORMAT "%5.1" /end CHARACTERISTIC
/begin CHARACTERISTIC S_RIN "Schalter Applikation Innenwiderstandspr¸fung" VALUE 0xFCC654 KwWU8 255.0 DEZ 0.00 255.0 FORMAT "%5.1" /end CHARACTERISTIC
/begin CHARACTERISTIC S_SOCSTAFK "Schalter f¸r Applikation SoC aus der Startf‰higkeit" VALUE 0xFCC639 KwWU8 255.0 DEZ 0.00 255.0 FORMAT "%5.1" /end CHARACTERISTIC
/begin CHARACTERISTIC S_SOC_BILA "Schalter f¸r Applik. soc_bila" VALUE 0xFCC49C KwWU8 255.0 DEZ 0.00 255.0 FORMAT "%5.1" /end CHARACTERISTIC
/begin CHARACTERISTIC S_SOC_QUAL "Schalter f¸r Applik. soc_quali" VALUE 0xFCC49D KwWU8 255.0 DEZ 0.00 255.0 FORMAT "%5.1" /end CHARACTERISTIC
/begin CHARACTERISTIC S_STARTAW "" VALUE 0xFCC655 KwWU8 255.0 DEZ 0.00 255.0 FORMAT "%5.1" /end CHARACTERISTIC
/begin CHARACTERISTIC S_UIBS "Schalter f¸r UIBS, wenn True dann uibs=UIBSAPP" VALUE 0xFCC194 KwWU8 255.0 DEZ 0.00 255.0 FORMAT "%5.1" /end CHARACTERISTIC
/begin CHARACTERISTIC S_ULCP "" VALUE 0xFCC404 KwWU8 255.0 DEZ 0.00 255.0 FORMAT "%5.1" /end CHARACTERISTIC
/begin CHARACTERISTIC TASLSO "obere Ansauglufttemperaturschwelle f¸r Sekund‰rluftsystem" VALUE 0xFD5661 KwUb 191.3 temp_ub_q0p75_o48 -48.00 143.3 FORMAT "%5.1" /end CHARACTERISTIC
/begin CHARACTERISTIC TASLSU "untere Ansauglufttemperaturschwelle f¸r Sekund‰rluftsystem" VALUE 0xFD5662 KwUb 191.3 temp_ub_q0p75_o48 -48.00 143.3 FORMAT "%5.1" /end CHARACTERISTIC
/begin CHARACTERISTIC TBATTAPP "" VALUE 0xFCC405 KwWU8 173.3 temp_ub_q0p75_o48 -48.00 125.3 FORMAT "%5.1" /end CHARACTERISTIC
/begin CHARACTERISTIC TDDSLA "Dauer Sekund‰rlufteinblasung f¸r Adaptionsphase" VALUE 0xFD5663 KwUb 25.50 t100msxs_ub_b25p5 0.00 25.50 FORMAT "%5.2" /end CHARACTERISTIC
/begin CHARACTERISTIC TDSLKT "Dauer Kurztest Sekund‰rluftdiagnose f¸r Massenmessung" VALUE 0xFD5664 KwUb 25.50 t100msxs_ub_b25p5 0.00 25.50 FORMAT "%5.2" /end CHARACTERISTIC
/begin CHARACTERISTIC TDWHSLPKH "Entprellzeit f¸r erneute Ansteuerung der SLP bei Katheizen" VALUE 0xFD5665 KwUb 25.50 t100msxs_ub_b25p5 0.00 25.50 FORMAT "%5.2" /end CHARACTERISTIC
/begin CHARACTERISTIC TEMIN "minimales TE" VALUE 0xFC77A8 KwWU32 540.000000000 t1p0usxms 0.00 540.000000000 FORMAT "%13.9" /end CHARACTERISTIC
/begin CHARACTERISTIC TFASLAMN "Mindestzeit nach Katheizen f¸r Testeranforderung Sekund‰rluftdiagnose" VALUE 0xFD56DC KwUw 6553.500 t100msxs_uw_b6553p6 0.00 6553.500 FORMAT "%8.3" /end CHARACTERISTIC
/begin CHARACTERISTIC TIME_START "" VALUE 0xFCC646 KwWU16 655.3500 t10msxs_uw_b655p35 0.00 655.3500 FORMAT "%8.4" /end CHARACTERISTIC
/begin CHARACTERISTIC TLMSSLAB "Entprellzeit f¸r Abbruch Sekund‰rluftanfettung" VALUE 0xFD5666 KwUb 25.40 t100msxs_ub_b25p5 0.1000 25.50 FORMAT "%5.2" /end CHARACTERISTIC
/begin CHARACTERISTIC TLMSSLMX "Maximale Zeit f¸r Sekund‰rluftanfettung im Leerlauf" VALUE 0xFD5667 KwUb 255.0 t100msxs_ub_b255 0.00 255.0 FORMAT "%5.1" /end CHARACTERISTIC
/begin CHARACTERISTIC TMASPR "Temperaturschwelle f¸r Verstellung Auslasspreizung" VALUE 0xFCD760 KwWU8 191.3 temp_ub_q0p75_o48 -48.00 143.3 FORMAT "%5.1" /end CHARACTERISTIC
/begin CHARACTERISTIC TMESPR "Temperaturschwelle f¸r Verstellung Einlasspreizung" VALUE 0xFCD761 KwWU8 191.3 temp_ub_q0p75_o48 -48.00 143.3 FORMAT "%5.1" /end CHARACTERISTIC
/begin CHARACTERISTIC TMFASLMN "Motortemperaturschwelle Testeranforderung Sekund‰rluftdiagnose" VALUE 0xFD5668 KwUb 191.3 temp_ub_q0p75_o48 -48.00 143.3 FORMAT "%5.1" /end CHARACTERISTIC
/begin CHARACTERISTIC TMSSLO "obere Starttemperaturschwelle f¸r Sekund‰rluft" VALUE 0xFD5669 KwUb 191.3 temp_ub_q0p75_o48 -48.00 143.3 FORMAT "%5.1" /end CHARACTERISTIC
/begin CHARACTERISTIC TMSSLSTO "obere Temperaturschwelle f¸r Sekund‰rluft im Start" VALUE 0xFD566A KwUb 191.3 temp_ub_q0p75_o48 -48.00 143.3 FORMAT "%5.1" /end CHARACTERISTIC
/begin CHARACTERISTIC TMSSLSTU "untere Temperaturschwelle f¸r Sekund‰rluft im Start" VALUE 0xFD566B KwUb 191.3 temp_ub_q0p75_o48 -48.00 143.3 FORMAT "%5.1" /end CHARACTERISTIC
/begin CHARACTERISTIC TMSSLU "untere Starttemperaturschwelle f¸r Sekund‰rluft" VALUE 0xFD566C KwUb 191.3 temp_ub_q0p75_o48 -48.00 143.3 FORMAT "%5.1" /end CHARACTERISTIC
/begin CHARACTERISTIC TSAISONFIL "Filterkonstante f¸r t_saison" VALUE 0xFCC632 KwWU16 65534.00 DEZ 1.000000 65535.00 FORMAT "%8.2" /end CHARACTERISTIC
/begin CHARACTERISTIC TSLABB "Verweilzeit f¸r Sekund‰rluft- Abbruchbedingung" VALUE 0xFD566D KwUb 25.40 t100msxs_ub_b25p5 0.1000 25.50 FORMAT "%5.2" /end CHARACTERISTIC
/begin CHARACTERISTIC TSLPMN "Mindesteinschaltdauer der Sekund‰rluftpumpe" VALUE 0xFD566E KwUb 25.40 t100msxs_ub_b25p5 0.1000 25.50 FORMAT "%5.2" /end CHARACTERISTIC
/begin CHARACTERISTIC TSLUBST "Entprellzeit f¸r Sekund‰rluft ein im Start bei UBSLSTMN" VALUE 0xFD566F KwUb 25.50 t100msxs_ub_b25p5 0.00 25.50 FORMAT "%5.2" /end CHARACTERISTIC
/begin CHARACTERISTIC TSPSAON "Startwert f¸r Timer f¸r zus. Ein- bzw /Auslassspreizung bei Schubabschaltung" VALUE 0xFD522C KwUw 655.3500 t10msxs_uw_b655p35 0.00 655.3500 FORMAT "%8.4" /end CHARACTERISTIC
/begin CHARACTERISTIC TVASPSA "Startwert f¸r TurnOnDelay Timer f¸r zus. Auslassspreizung bei Schubabschaltung" VALUE 0xFD522E KwUw 655.3500 t10msxs_uw_b655p35 0.00 655.3500 FORMAT "%8.4" /end CHARACTERISTIC
/begin CHARACTERISTIC TVDSLOFF "Zeitverzˆgerung Schlieﬂen Sekund‰rluftventil bei Adaption/Kurztrip" VALUE 0xFD5670 KwUb 25.50 t100msxs_ub_b25p5 0.00 25.50 FORMAT "%5.2" /end CHARACTERISTIC
/begin CHARACTERISTIC TVESPSA "Startwert f¸r TurnOnDelay Timer f¸r zus. Einlassspreizung bei Schubabschaltung" VALUE 0xFD5230 KwUw 655.3500 t10msxs_uw_b655p35 0.00 655.3500 FORMAT "%8.4" /end CHARACTERISTIC
/begin CHARACTERISTIC TVSLVOFF "Zeitverzˆgerung Schlieﬂen Sekund‰rluftventil" VALUE 0xFD5671 KwUb 25.50 t100msxs_ub_b25p5 0.00 25.50 FORMAT "%5.2" /end CHARACTERISTIC
/begin CHARACTERISTIC TVSLVON "Zeitverzˆgerung ÷ffnen Sekund‰rluftventil" VALUE 0xFD5672 KwUb 25.40 t100msxs_ub_b25p5 0.1000 25.50 FORMAT "%5.2" /end CHARACTERISTIC
/begin CHARACTERISTIC TVUB "Spannungskorrektur" CURVE 0xFC778A KlAxU8SstxU16WU16 65.53500 t1p0usxms 0.00 65.53500 FORMAT "%8.5"
 /begin AXIS_DESCR STD_AXIS ub spg_ubatt 6 0.00 24.02 FORMAT "%5.2" DEPOSIT ABSOLUTE /end AXIS_DESCR
/end CHARACTERISTIC
/begin CHARACTERISTIC TWSLPENA "Vergleichswert ber. Wicklungstemp. Sekund‰rluftpumpe" VALUE 0xFD56DE KwUw 1535.977 temp_q0p0234_o273 -273.1500 1262.827 FORMAT "%8.3" /end CHARACTERISTIC
/begin CHARACTERISTIC TWSLPFA "Vergleichswert ber. Wicklungstemp. Sekund‰rluftpumpe f. Diagnose" VALUE 0xFD56E0 KwUw 1535.977 temp_q0p0234_o273 -273.1500 1262.827 FORMAT "%8.3" /end CHARACTERISTIC
/begin CHARACTERISTIC TWSLPOFF "Unterer Einschaltwert f¸r ber. Wicklungstemp. SLP" VALUE 0xFD56E2 KwUw 1535.977 temp_q0p0234_o273 -273.1500 1262.827 FORMAT "%8.3" /end CHARACTERISTIC
/begin CHARACTERISTIC T_B_NMOT "Zeit nach Motorlauf, die stufenweise Berechnung von uibs" VALUE 0xFCC195 KwWU8 255.0 t_q1 0.00 255.0 FORMAT "%5.1" /end CHARACTERISTIC
/begin CHARACTERISTIC T_PMBS "" VALUE 0xFCC406 KwWU8 255.0 DEZ 0.00 255.0 FORMAT "%5.1" /end CHARACTERISTIC
/begin CHARACTERISTIC T_PMUGEN "Zeit f¸r das stufenweise Setzen von uibs" VALUE 0xFCC196 KwWU8 255.0 t_q1 0.00 255.0 FORMAT "%5.1" /end CHARACTERISTIC
/begin CHARACTERISTIC T_PMVS "" VALUE 0xFCC407 KwWU8 255.0 DEZ 0.00 255.0 FORMAT "%5.1" /end CHARACTERISTIC
/begin CHARACTERISTIC T_PTC_PI "T-Faktor des PI-Reglers f¸r PTC-Ansteuerung" VALUE 0xFCC3C4 KwWU16 6553.400 fak_q0p1 0.1000000 6553.500 FORMAT "%8.3" /end CHARACTERISTIC
/begin CHARACTERISTIC T_PWRDF_PI "K-Faktor des PI Reglers zur Berechnung von ctrpwrdf" VALUE 0xFCC3C6 KwWU16 6553.400 fak_q0p1 0.1000000 6553.500 FORMAT "%8.3" /end CHARACTERISTIC
/begin CHARACTERISTIC UBATTAPP "" VALUE 0xFCC3C8 KwWU16 10.000000 spg_uw_q0p25em3_o6 6.0000000 16.000000 FORMAT "%9.6" /end CHARACTERISTIC
/begin CHARACTERISTIC UBSLMN "min. Spannung f¸r Sekund‰rluft ein" VALUE 0xFD56E4 KwUw 25.59961 spg_q0p00039 0.00 25.59961 FORMAT "%8.5" /end CHARACTERISTIC
/begin CHARACTERISTIC UBSLMX "max. Spannung f¸r Sekund‰rluft ein" VALUE 0xFD56E6 KwUw 25.59961 spg_q0p00039 0.00 25.59961 FORMAT "%8.5" /end CHARACTERISTIC
/begin CHARACTERISTIC UBSLSTMN "min.Spannung f¸r Sekund‰rluft ein im Start" VALUE 0xFD56E8 KwUw 25.59961 spg_q0p00039 0.00 25.59961 FORMAT "%8.5" /end CHARACTERISTIC
/begin CHARACTERISTIC UBTAPP "Batteriespannung" VALUE 0xFCC3CA KwWU16 61.425000 spg_uw_q0p015 0.00 61.425000 FORMAT "%9.6" /end CHARACTERISTIC
/begin CHARACTERISTIC UBTLOWMAX "Obere Unterspannungsgrenze" VALUE 0xFCC3CC KwWU16 10.000000 spg_uw_q0p25em3_o6 6.0000000 16.000000 FORMAT "%9.6" /end CHARACTERISTIC
/begin CHARACTERISTIC UBTLOWMIN "untere Unterspannungsgrenze" VALUE 0xFCC3CE KwWU16 10.000000 spg_uw_q0p25em3_o6 6.0000000 16.000000 FORMAT "%9.6" /end CHARACTERISTIC
/begin CHARACTERISTIC UB_GRENZ "" VALUE 0xFCC656 KwWU8 24.02 spg_ubatt 0.00 24.02 FORMAT "%5.2" /end CHARACTERISTIC
/begin CHARACTERISTIC UGENNORM "Generator Normspannung" VALUE 0xFCC197 KwWU8 6.375 spg_gencan 10.60 16.98 FORMAT "%5.2" /end CHARACTERISTIC
/begin CHARACTERISTIC UIBSAPP "Manueller Applikationswert von Uibs an UGENKOR" VALUE 0xFCC198 KwWU8 6.375 spg_gencan 10.60 16.98 FORMAT "%5.2" /end CHARACTERISTIC
/begin CHARACTERISTIC ULEVA "" VALUE 0xFCC408 KwWU8 255.0 DEZ 0.00 255.0 FORMAT "%5.1" /end CHARACTERISTIC
/begin CHARACTERISTIC ULEVAPP "Spannungsebene" VALUE 0xFCC409 KwWU8 15.00 DEZ 0.00 15.00 FORMAT "%5.2" /end CHARACTERISTIC
/begin CHARACTERISTIC ULOWSETAPP "" VALUE 0xFCC40A KwWU8 25.50 t_q0p1 0.00 25.50 FORMAT "%5.2" /end CHARACTERISTIC
/begin CHARACTERISTIC USTARTGRZ "Spannungsgrenzwert f¸r Startauswertung" VALUE 0xFCC648 KwWU16 10.000000 spg_uw_q0p25em3_o6 6.0000000 16.000000 FORMAT "%9.6" /end CHARACTERISTIC
/begin CHARACTERISTIC USTEPMIN "Min. Delta zw. Battsollspg und Battspg damit uibs veraendert wird." VALUE 0xFCC199 KwWU8 12.7500 spg_q0p05 0.00 12.7500 /end CHARACTERISTIC
/begin CHARACTERISTIC U_GENSLP "Generatorsollspannung bei SLP-Betrieb" VALUE 0xFD5720 KwWU16 16.00000 spg_sw_q0p001 0.00 16.00000 FORMAT "%8.5" /end CHARACTERISTIC
/begin CHARACTERISTIC VNS_VZD "" VALUE 0xFCD762 KwWU8 25.50 sprzi_q0p1 0.00 25.50 FORMAT "%5.2" /end CHARACTERISTIC
/begin CHARACTERISTIC VNS_VZZMX "Maximale Anzahl an Nachtriggerungen" VALUE 0xFCD763 KwWU8 255.0 DEZ 0.00 255.0 FORMAT "%5.1" /end CHARACTERISTIC
/begin CHARACTERISTIC VNS_WTZ "Wartezeit" VALUE 0xFCD764 KwWU8 255.0 default 0.00 255.0 FORMAT "%5.1" /end CHARACTERISTIC
/begin CHARACTERISTIC VSLS "Schwelle Fahrzeuggeschwindigkeit f¸r SLS ein" VALUE 0xFD5673 KwUb 318.8 vfzg_ub_q1p25 0.00 318.8 FORMAT "%5.1" /end CHARACTERISTIC
/begin CHARACTERISTIC WGH_PRIO "" VAL_BLK 0xFCC356 KwbWU16 450.25000 fak_uw_q0p25o500 0.00 450.25000 FORMAT "%9.5" NUMBER 7 /end CHARACTERISTIC
/begin CHARACTERISTIC WGH_PRIOCF "" VAL_BLK 0xFCC364 KwbWU16 154.00000 fak_uw_q0p25o500 0.00 154.00000 FORMAT "%9.5" NUMBER 7 /end CHARACTERISTIC
/begin CHARACTERISTIC WGH_PWRCF "" VAL_BLK 0xFCC372 KwbWS16 154.00000 fak_uw_q0p25o500 0.00 154.00000 FORMAT "%9.5" NUMBER 7 /end CHARACTERISTIC
/begin CHARACTERISTIC WGH_PWRDF "" VAL_BLK 0xFCC380 KwbWU16 450.25000 fak_uw_q0p25o500 0.00 450.25000 FORMAT "%9.5" NUMBER 14 /end CHARACTERISTIC
/begin CHARACTERISTIC WKRMGLUE "" VALUE 0xFCD765 KwWU8 191.3 zw_ub_qn0p75 -191.3 0.00 FORMAT "%5.1" /end CHARACTERISTIC
/begin CHARACTERISTIC WNWAIMN "Minimalwert der individuelle NW-Sp‰tanschlagsadaption" VALUE 0xFCD750 KwWU16 180.0000 sprzi_q0p1 0.00 180.0000 FORMAT "%8.4" /end CHARACTERISTIC
/begin CHARACTERISTIC WNWMN "minimaler Nockenwellensollwinkel" VALUE 0xFCD752 KwWU16 180.0000 sprzi_q0p1 0.00 180.0000 FORMAT "%8.4" /end CHARACTERISTIC
/begin CHARACTERISTIC ZFLMSSL "Zeitkonstante Gemischanteil Sekund‰rluft" VALUE 0xFD5674 KwUb 25.4996 zk100msxs_ub_b25p5 0.100392 25.6000 FORMAT "%7.4" /end CHARACTERISTIC
/begin CHARACTERISTIC ZKSLPOFF "Zeitkonstante Runterlauf Sekund‰rluftgebl‰se" VALUE 0xFD5675 KwUb 25.4996 zk100msxs_ub_b25p5 0.100392 25.6000 FORMAT "%7.4" /end CHARACTERISTIC
/begin CHARACTERISTIC ZKSLPON "Zeitkonstante Hochlauf Sekund‰rluftgebl‰se" VALUE 0xFD5676 KwUb 25.4996 zk100msxs_ub_b25p5 0.100392 25.6000 FORMAT "%7.4" /end CHARACTERISTIC
/begin CHARACTERISTIC ZKSLSOFML "Zeitkonstante Ausr‰umen der Sekund‰rluft nach Ventil schlieﬂen" CURVE 0xFD56EA KlAUwSstUwWUw 6553.4999985 zk100msxs_uw_b6553 0.10000152590 6553.6000000 FORMAT "%12.7"
 /begin AXIS_DESCR STD_AXIS ml_w m_uw_b6553p5 4 0.00 6553.500 FORMAT "%8.3" DEPOSIT ABSOLUTE /end AXIS_DESCR
/end CHARACTERISTIC
/begin CHARACTERISTIC ZKSLSONML "Zeitkonstante Einbringen der Sekund‰rluft nach Ventil ˆffnen" CURVE 0xFD56FC KlAUwSstUwWUw 6553.4999985 zk100msxs_uw_b6553 0.10000152590 6553.6000000 FORMAT "%12.7"
 /begin AXIS_DESCR STD_AXIS ml_w m_uw_b6553p5 4 0.00 6553.500 FORMAT "%8.3" DEPOSIT ABSOLUTE /end AXIS_DESCR
/end CHARACTERISTIC
/begin CHARACTERISTIC ZK_PMSOC "Zeitfaktor" VALUE 0xFCC5FE KwWU16 0.9999847 fak_uw_b1 0.00 0.9999847 FORMAT "%9.7" /end CHARACTERISTIC
/begin CHARACTERISTIC ZWNLL "Zeitkonstante f¸r TP Sollwertbed‰mpfung (Ein- und Auslass) nach Motorstart" CURVE 0xFCD6D2 KlAxU8SstxU16WU16 0.9960938 fak_ub_b1 0.00 0.9960938 FORMAT "%9.7"
 /begin AXIS_DESCR STD_AXIS tnst_w t10msxs_uw_b655p35 4 0.00 655.3500 FORMAT "%8.4" DEPOSIT ABSOLUTE /end AXIS_DESCR
/end CHARACTERISTIC
/begin MEASUREMENT absch_korr "Korrekturwert Abschaltung" UWORD fak_q0p004_o100 1 100 -40 40 FORMAT "%7.4" ECU_ADDRESS 0x3FE26C /end MEASUREMENT
/begin MEASUREMENT all2ptc "Gesamtgewichtung f¸r PTC-Ansteuerung" UWORD fak_uw_q0p25o500 1 100 -500 550 FORMAT "%9.5" ECU_ADDRESS 0x4033EA /end MEASUREMENT
/begin MEASUREMENT Allk "Leerlauf Auslasspreizung gedrosselt kalt zum Katheizen" UBYTE sprzi_q0p8 1 100 0 204 FORMAT "%5.1" ECU_ADDRESS 0x4039C8 /end MEASUREMENT
/begin MEASUREMENT allptcfilt "pi-geregelte Gewichtung f¸r PTC-Ansteuerung" UWORD fak_uw_q0p25o500 1 100 0 550 FORMAT "%9.5" ECU_ADDRESS 0x4033EC /end MEASUREMENT
/begin MEASUREMENT Allw "Leerlauf Auslasspreizung gedrosselt warm zum Katheizen" UBYTE sprzi_q0p8 1 100 0 204 FORMAT "%5.1" ECU_ADDRESS 0x4039C9 /end MEASUREMENT
/begin MEASUREMENT anzslp "Einschaltanzahl der Sekund‰rluftpumpe w‰hrend eines Fahrtzykluses" UBYTE dez 1 100 0 255 FORMAT "%5.1" ECU_ADDRESS 0x403760 /end MEASUREMENT
/begin MEASUREMENT Ask "optimale Auslasspreizung kalt ungedrosselt" UBYTE sprzi_q0p8 1 100 0 204 FORMAT "%5.1" ECU_ADDRESS 0x4039CA /end MEASUREMENT
/begin MEASUREMENT Aspr "Sollwert Auslasspreizung" UBYTE sprzi_q0p8 1 100 0 204 FORMAT "%5.1" ECU_ADDRESS 0x4039CB /end MEASUREMENT
/begin MEASUREMENT Asprimx "Max der ist Auslassspreizung" UWORD sprzi_q0p1 1 100 0 6553.5 FORMAT "%8.3" ECU_ADDRESS 0x40369E /end MEASUREMENT
/begin MEASUREMENT Asprl "Auslasspreizung im Leerlauf gedrosselt" UBYTE sprzi_q0p8 1 100 0 204 FORMAT "%5.1" ECU_ADDRESS 0x4039CC /end MEASUREMENT
/begin MEASUREMENT Asprlu "Auslasspreizung im Leerlauf ungedrosselt" UBYTE sprzi_q0p8 1 100 0 204 FORMAT "%5.1" ECU_ADDRESS 0x4039CD /end MEASUREMENT
/begin MEASUREMENT Asprt "Auslasspreizung teilgedrosselt" UBYTE sprzi_q0p8 1 100 0 204 FORMAT "%5.1" ECU_ADDRESS 0x4039CE /end MEASUREMENT
/begin MEASUREMENT Aspru "Auslasspreizung ungedrosselt" UBYTE sprzi_q0p8 1 100 0 204 FORMAT "%5.1" ECU_ADDRESS 0x4039CF /end MEASUREMENT
/begin MEASUREMENT Astk "optimale Auslasspreizung kalt teilgedrosselt" UBYTE sprzi_q0p8 1 100 0 204 FORMAT "%5.1" ECU_ADDRESS 0x4039D0 /end MEASUREMENT
/begin MEASUREMENT Astw "optimale Auslasspreizung warm teilgedrosselt" UBYTE sprzi_q0p8 1 100 0 204 FORMAT "%5.1" ECU_ADDRESS 0x4039D1 /end MEASUREMENT
/begin MEASUREMENT Asw "optimale Auslasspreizung warm ungedrosselt" UBYTE sprzi_q0p8 1 100 0 204 FORMAT "%5.1" ECU_ADDRESS 0x4039D2 /end MEASUREMENT
/begin MEASUREMENT bgCtr "" ULONG dez 1 100 0 4.29497e+009 FORMAT "%13.2" ECU_ADDRESS 0x404B0C /end MEASUREMENT
/begin MEASUREMENT bg_predrive_Ctr "" ULONG dez 1 100 0 4.29497e+009 FORMAT "%13.2" ECU_ADDRESS 0x404B10 /end MEASUREMENT
/begin MEASUREMENT bg_swoff_Ctr "" ULONG dez 1 100 0 4.29497e+009 FORMAT "%13.2" ECU_ADDRESS 0x404B14 /end MEASUREMENT
/begin MEASUREMENT B_abschfit "Bedingung Korrektur Startf‰higkeitsgrenze durchgef¸hrt" UBYTE B_TRUE 1 100 0 1 FORMAT "%13.11" ECU_ADDRESS 0x403490 /end MEASUREMENT
/begin MEASUREMENT B_abstnl "Bedingung Abstellzeitermittlung ¸ber SG-Nachlauf" UBYTE B_TRUE 1 100 0 1 BIT_MASK 0x1 FORMAT "%13.11" ECU_ADDRESS 0x3FC278 /end MEASUREMENT
/begin MEASUREMENT B_anzslpmx "zul‰ssige Anzahl der SLP-Anl‰ufe ist erreicht" UWORD B_TRUE 1 100 0 1 BIT_MASK 0x400 FORMAT "%13.11" ECU_ADDRESS 0x403778 /end MEASUREMENT
/begin MEASUREMENT B_aspan "Zus. Auslasspreizung bei Schubabschaltung" UBYTE B_TRUE 1 100 0 1 FORMAT "%13.11" ECU_ADDRESS 0x403692 /end MEASUREMENT
/begin MEASUREMENT B_auakt "Bedingung Abgasuntersuchung aktiv" UBYTE B_TRUE 1 100 0 1 BIT_MASK 0x1 FORMAT "%13.11" ECU_ADDRESS 0x3FC279 /end MEASUREMENT
/begin MEASUREMENT B_cdagr "Funktion ¸ber Codewort CDAGR freigegeben" UWORD B_TRUE 1 100 0 1 BIT_MASK 0x8000 FORMAT "%13.11" ECU_ADDRESS 0x404254 /end MEASUREMENT
/begin MEASUREMENT B_cdanws "Funktion ¸ber Codewort CDNWS freigegeben (Auslaﬂ)" UBYTE B_TRUE 1 100 0 1 BIT_MASK 0x1 FORMAT "%13.11" ECU_ADDRESS 0x3FC27A /end MEASUREMENT
/begin MEASUREMENT B_cddmtl "Funktionfreigabe per Codewort" UBYTE B_TRUE 1 100 0 1 BIT_MASK 0x1 FORMAT "%13.11" ECU_ADDRESS 0x3FC27B /end MEASUREMENT
/begin MEASUREMENT B_cddylsu "Funktion ¸ber Codewort CDDYLSU freigegeben" UBYTE B_TRUE 1 100 0 1 BIT_MASK 0x1 FORMAT "%13.11" ECU_ADDRESS 0x3FC27C /end MEASUREMENT
/begin MEASUREMENT B_cdenws "Funktion ¸ber Codewort CDNWS freigegeben (Einlaﬂ)" UBYTE B_TRUE 1 100 0 1 BIT_MASK 0x1 FORMAT "%13.11" ECU_ADDRESS 0x3FC27D /end MEASUREMENT
/begin MEASUREMENT B_cdfst "F¸llstandsgeberdiagnose ¸ber Euro-Codewort CDEFST freigeben" UBYTE B_TRUE 1 100 0 1 BIT_MASK 0x1 FORMAT "%13.11" ECU_ADDRESS 0x3FC27E /end MEASUREMENT
/begin MEASUREMENT B_cdhelsu "Funktion ¸ber Codewort CDHELSU freigegeben" UBYTE B_TRUE 1 100 0 1 BIT_MASK 0x1 FORMAT "%13.11" ECU_ADDRESS 0x3FC27F /end MEASUREMENT
/begin MEASUREMENT B_cdhrlsu "Bedingung Funktion %DHRLSU ¸ber CDHRLSU freigegeben" UBYTE B_TRUE 1 100 0 1 BIT_MASK 0x1 FORMAT "%13.11" ECU_ADDRESS 0x3FC280 /end MEASUREMENT
/begin MEASUREMENT B_cdhrlsue "Bedingung: Funktion ¸ber Codewort CDHRLSUE freigeben" UBYTE B_TRUE 1 100 0 1 BIT_MASK 0x1 FORMAT "%13.11" ECU_ADDRESS 0x3FC281 /end MEASUREMENT
/begin MEASUREMENT B_cdhsh "Funktion ¸ber Codewort CDHSH freigegeben" UWORD B_TRUE 1 100 0 1 BIT_MASK 0x80 FORMAT "%13.11" ECU_ADDRESS 0x404254 /end MEASUREMENT
/begin MEASUREMENT B_cdhshe "Funktion ¸ber Codewort CDHSHE freigegeben" UWORD B_TRUE 1 100 0 1 BIT_MASK 0x200 FORMAT "%13.11" ECU_ADDRESS 0x404254 /end MEASUREMENT
/begin MEASUREMENT B_cdhsv "Funktion ¸ber Codewort CDHSV freigegeben" UWORD B_TRUE 1 100 0 1 BIT_MASK 0x40 FORMAT "%13.11" ECU_ADDRESS 0x404254 /end MEASUREMENT
/begin MEASUREMENT B_cdhsvsa "Funktion ¸ber Codewort CDHSVSA freigegeben" UBYTE B_TRUE 1 100 0 1 BIT_MASK 0x1 FORMAT "%13.11" ECU_ADDRESS 0x3FC282 /end MEASUREMENT
/begin MEASUREMENT B_cdiclsu "Bedingung: Funktion ¸ber Codewort CDICLSU freigeben" UBYTE B_TRUE 1 100 0 1 BIT_MASK 0x1 FORMAT "%13.11" ECU_ADDRESS 0x3FC283 /end MEASUREMENT
/begin MEASUREMENT B_cdkat "Funktion ¸ber Codewort CDKAT freigegeben" UWORD B_TRUE 1 100 0 1 BIT_MASK 0x100 FORMAT "%13.11" ECU_ADDRESS 0x404254 /end MEASUREMENT
/begin MEASUREMENT B_cdkatsp "Funktion ¸ber Codewort CDKATSP freigegeben" UBYTE B_TRUE 1 100 0 1 BIT_MASK 0x1 FORMAT "%13.11" ECU_ADDRESS 0x3FC284 /end MEASUREMENT
/begin MEASUREMENT B_cdkatspf "Funktion DKATSP f¸r Feld- bzw. Strassenbetrieb freigegeben" UBYTE B_TRUE 1 100 0 1 BIT_MASK 0x1 FORMAT "%13.11" ECU_ADDRESS 0x3FC285 /end MEASUREMENT
/begin MEASUREMENT B_cdkatspt "Funktion DKATSP f¸r Testerbetrieb freigegeben" UBYTE B_TRUE 1 100 0 1 BIT_MASK 0x1 FORMAT "%13.11" ECU_ADDRESS 0x3FC286 /end MEASUREMENT
/begin MEASUREMENT B_cdkvs "Funktion ¸ber Codewort CDKVS freigegeben" UWORD B_TRUE 1 100 0 1 BIT_MASK 0x800 FORMAT "%13.11" ECU_ADDRESS 0x404254 /end MEASUREMENT
/begin MEASUREMENT B_cdlash "Funktion ¸ber Codewort CDLASH freigegeben" UWORD B_TRUE 1 100 0 1 BIT_MASK 0x40 FORMAT "%13.11" ECU_ADDRESS 0x404256 /end MEASUREMENT
/begin MEASUREMENT B_cdldp "Funktion ¸ber Codewort CDLDP freigegeben" UWORD B_TRUE 1 100 0 1 BIT_MASK 0x4000 FORMAT "%13.11" ECU_ADDRESS 0x404254 /end MEASUREMENT
/begin MEASUREMENT B_cdllr "Funktion ¸ber Codewort CDLLR freigegeben" UWORD B_TRUE 1 100 0 1 BIT_MASK 0x8 FORMAT "%13.11" ECU_ADDRESS 0x404256 /end MEASUREMENT
/begin MEASUREMENT B_cdlsh "Funktion ¸ber Codewort CDLSH freigegeben" UWORD B_TRUE 1 100 0 1 BIT_MASK 0x10 FORMAT "%13.11" ECU_ADDRESS 0x404254 /end MEASUREMENT
/begin MEASUREMENT B_cdlsv "Funktion ¸ber Codewort CDLSV freigegeben" UWORD B_TRUE 1 100 0 1 BIT_MASK 0x8 FORMAT "%13.11" ECU_ADDRESS 0x404254 /end MEASUREMENT
/begin MEASUREMENT B_cdlsvv "Funktion ¸ber Codewort CDLSVV freigegeben" UBYTE B_TRUE 1 100 0 1 BIT_MASK 0x1 FORMAT "%13.11" ECU_ADDRESS 0x3FC287 /end MEASUREMENT
/begin MEASUREMENT B_cdmd "Funktion ¸ber Codewort CDMD freigegeben" UWORD B_TRUE 1 100 0 1 BIT_MASK 0x1 FORMAT "%13.11" ECU_ADDRESS 0x404254 /end MEASUREMENT
/begin MEASUREMENT B_cdnozwte "Zdg.-Eingriff  ¸ber CDTES gesperrt" UWORD B_TRUE 1 100 0 1 BIT_MASK 0x1000 FORMAT "%13.11" ECU_ADDRESS 0x404254 /end MEASUREMENT
/begin MEASUREMENT B_cdpllsu "Bedingung: Funktion ¸ber Codewort CDPLLSU freigeben" UBYTE B_TRUE 1 100 0 1 BIT_MASK 0x1 FORMAT "%13.11" ECU_ADDRESS 0x3FC288 /end MEASUREMENT
/begin MEASUREMENT B_cdsalsu "Bedingung: Diagnosefunktion DSALSU ¸ber Codewort CDSALSU eingeschaltet" UBYTE B_TRUE 1 100 0 1 BIT_MASK 0x1 FORMAT "%13.11" ECU_ADDRESS 0x3FC289 /end MEASUREMENT
/begin MEASUREMENT B_cdsls "Funktion ¸ber Codewort CDSLS freigegeben" UWORD B_TRUE 1 100 0 1 BIT_MASK 0x1 FORMAT "%13.11" ECU_ADDRESS 0x404256 /end MEASUREMENT
/begin MEASUREMENT B_cdswe "Funktion ¸ber Codewort CDSWE freigegeben" UWORD B_TRUE 1 100 0 1 BIT_MASK 0x2 FORMAT "%13.11" ECU_ADDRESS 0x404254 /end MEASUREMENT
/begin MEASUREMENT B_cdtankl "Funktion ¸ber Codewort CDTANKL freigegeben" UWORD B_TRUE 1 100 0 1 BIT_MASK 0x4 FORMAT "%13.11" ECU_ADDRESS 0x404254 /end MEASUREMENT
/begin MEASUREMENT B_cdtes "Funktion ¸ber Codewort CDTES freigegeben" UWORD B_TRUE 1 100 0 1 BIT_MASK 0x2000 FORMAT "%13.11" ECU_ADDRESS 0x404254 /end MEASUREMENT
/begin MEASUREMENT B_cdulsu "Bedingung: Funktion ¸ber Codewort CDULSU freigeben" UBYTE B_TRUE 1 100 0 1 BIT_MASK 0x1 FORMAT "%13.11" ECU_ADDRESS 0x3FC28A /end MEASUREMENT
/begin MEASUREMENT B_cdvvnw "Aktivierung der Diagnose-Sperrung bei VANOS-Fehler" UBYTE B_TRUE 1 100 0 1 BIT_MASK 0x1 FORMAT "%13.11" ECU_ADDRESS 0x3FC28B /end MEASUREMENT
/begin MEASUREMENT B_cwlshdyn "Beding. Abschaltung f¸r Teilfunktion Dynamikpr¸fung Sonde hinter KAT in %DLSAHK" UBYTE B_TRUE 1 100 0 1 BIT_MASK 0x1 FORMAT "%13.11" ECU_ADDRESS 0x3FC28C /end MEASUREMENT
/begin MEASUREMENT B_cwlshmf "Beding. Ein/Abschaltung Schwingungspr¸fung f¸r Einmalpr¸fung Sonde hinter KAT" UBYTE B_TRUE 1 100 0 1 BIT_MASK 0x1 FORMAT "%13.11" ECU_ADDRESS 0x3FC28D /end MEASUREMENT
/begin MEASUREMENT B_cwlshsch "Bedingung Abschaltung f¸r Teilfunktion im Schub Sonde hinter KAT in %DLSAHK" UBYTE B_TRUE 1 100 0 1 BIT_MASK 0x1 FORMAT "%13.11" ECU_ADDRESS 0x3FC28E /end MEASUREMENT
/begin MEASUREMENT B_cwlshvl "Bed. Abschaltung f¸r Teilfunktion im Vollastbetrieb Sonde hinter KAT in %DLSAHK" UBYTE B_TRUE 1 100 0 1 BIT_MASK 0x1 FORMAT "%13.11" ECU_ADDRESS 0x3FC28F /end MEASUREMENT
/begin MEASUREMENT B_cwmdkol "Bedingung MDKOL-Konfiguration f¸r zul‰ssiges Sollmoment" UBYTE B_TRUE 1 100 0 1 BIT_MASK 0x1 FORMAT "%13.11" ECU_ADDRESS 0x3FC290 /end MEASUREMENT
/begin MEASUREMENT B_dknolu "Bedingung: Notluftfahren aktiv" UBYTE B_TRUE 1 100 0 1 BIT_MASK 0x1 FORMAT "%13.11" ECU_ADDRESS 0x3FBFC8 /end MEASUREMENT
/begin MEASUREMENT B_dknot "Bedingung DK-Poti-Notfahren aktiv" UBYTE B_TRUE 1 100 0 1 BIT_MASK 0x1 FORMAT "%13.11" ECU_ADDRESS 0x3FBFC9 /end MEASUREMENT
/begin MEASUREMENT B_dkpiu "Bedingung: irreversible SKA" UBYTE B_TRUE 1 100 0 1 BIT_MASK 0x1 FORMAT "%13.11" ECU_ADDRESS 0x3FBFCA /end MEASUREMENT
/begin MEASUREMENT B_dkpru "Bedingung: reversible SKA" UBYTE B_TRUE 1 100 0 1 BIT_MASK 0x1 FORMAT "%13.11" ECU_ADDRESS 0x3FBFCB /end MEASUREMENT
/begin MEASUREMENT B_dkpu "Bedingung Sicherheitskraftstoffabschaltung (SKA)" UBYTE B_TRUE 1 100 0 1 BIT_MASK 0x1 FORMAT "%13.11" ECU_ADDRESS 0x3FBFCC /end MEASUREMENT
/begin MEASUREMENT B_dkunb "Bedingung: Drosselklappenposition unbekannt" UBYTE B_TRUE 1 100 0 1 BIT_MASK 0x1 FORMAT "%13.11" ECU_ADDRESS 0x3FBFCD /end MEASUREMENT
/begin MEASUREMENT B_dslreset "Bedingung: Zur¸cksetzen Sekund‰rluftadaption/Kurztest" UWORD B_TRUE 1 100 0 1 BIT_MASK 0x2 FORMAT "%13.11" ECU_ADDRESS 0x403778 /end MEASUREMENT
/begin MEASUREMENT B_dslset "Bedingung: Setzen Sekund‰rluftadaption/Kurztest" UWORD B_TRUE 1 100 0 1 BIT_MASK 0x1 FORMAT "%13.11" ECU_ADDRESS 0x403778 /end MEASUREMENT
/begin MEASUREMENT B_dubt "" UBYTE B_TRUE 1 100 0 1 FORMAT "%13.11" ECU_ADDRESS 0x4033D8 /end MEASUREMENT
/begin MEASUREMENT B_ecodcan "Bedingung Fehler Umschaltung CAN11h/CAN12h" UBYTE B_TRUE 1 100 0 1 BIT_MASK 0x1 FORMAT "%13.11" ECU_ADDRESS 0x3FC291 /end MEASUREMENT
/begin MEASUREMENT B_enwake7 "lokales B_enwake" UBYTE B_TRUE 1 100 0 1 FORMAT "%13.11" ECU_ADDRESS 0x4033D9 /end MEASUREMENT
/begin MEASUREMENT B_enwakeup "Bit, ob IBS Bus wecken darf oder nicht." UBYTE B_TRUE 1 100 0 1 FORMAT "%13.11" ECU_ADDRESS 0x4033DA /end MEASUREMENT
/begin MEASUREMENT B_esbhap "Bedingung Umschaltung Einspritzbeginn homogen auf WESBHAP" UBYTE B_TRUE 1 100 0 1 BIT_MASK 0x1 FORMAT "%13.11" ECU_ADDRESS 0x3FC292 /end MEASUREMENT
/begin MEASUREMENT B_espan "Zus. Einlasspreizung bei Schubabschaltung" UBYTE B_TRUE 1 100 0 1 FORMAT "%13.11" ECU_ADDRESS 0x403693 /end MEASUREMENT
/begin MEASUREMENT B_etol "Bedingung Fehler in ÷ltemperatur" UBYTE B_TRUE 1 100 0 1 BIT_MASK 0x1 FORMAT "%13.11" ECU_ADDRESS 0x3FC293 /end MEASUREMENT
/begin MEASUREMENT B_fasla "Bedingung: externe Anforderung an Sekund‰rluft aktiv" UBYTE B_TRUE 1 100 0 1 BIT_MASK 0x1 FORMAT "%13.11" ECU_ADDRESS 0x3FC398 /end MEASUREMENT
/begin MEASUREMENT B_fphubap "Bedingung Hubsteuerung direkt ¸ber Fahrpedal" UBYTE B_TRUE 1 100 0 1 BIT_MASK 0x1 FORMAT "%13.11" ECU_ADDRESS 0x3FC294 /end MEASUREMENT
/begin MEASUREMENT B_fpwdkap "DK-Steuerung direkt ¸ber Fahrpedal" UBYTE B_TRUE 1 100 0 1 BIT_MASK 0x1 FORMAT "%13.11" ECU_ADDRESS 0x3FC295 /end MEASUREMENT
/begin MEASUREMENT B_fzg_on "Bedingung Betrieb im Fahrzeug aktiviert" UBYTE B_TRUE 1 100 0 1 BIT_MASK 0x1 FORMAT "%13.11" ECU_ADDRESS 0x3FC296 /end MEASUREMENT
/begin MEASUREMENT B_gen1 "Bedingung kein Einfluss des Generatormomentes auf mdverl" UBYTE B_TRUE 1 100 0 1 BIT_MASK 0x1 FORMAT "%13.11" ECU_ADDRESS 0x3FC297 /end MEASUREMENT
/begin MEASUREMENT B_gen2 "Bedingung kein Einfluss des Generatormomentes auf mimin" UBYTE B_TRUE 1 100 0 1 BIT_MASK 0x1 FORMAT "%13.11" ECU_ADDRESS 0x3FC298 /end MEASUREMENT
/begin MEASUREMENT B_genclcon "Wird auf true gesetzt wenn Motor und Generator bereits T_B_NMOT-Sekunden laufen." UBYTE B_TRUE 1 100 0 1 FORMAT "%13.11" ECU_ADDRESS 0x4033CA /end MEASUREMENT
/begin MEASUREMENT B_gendef "" UBYTE B_TRUE 1 100 0 1 FORMAT "%13.11" ECU_ADDRESS 0x4033DB /end MEASUREMENT
/begin MEASUREMENT B_genslp "Bedingung SLP-Spannung" UBYTE B_TRUE 1 100 0 1 BIT_MASK 0x1 FORMAT "%13.11" ECU_ADDRESS 0x3FC3A4 /end MEASUREMENT
/begin MEASUREMENT B_glue "" UBYTE B_TRUE 1 100 0 1 FORMAT "%13.11" ECU_ADDRESS 0x403694 /end MEASUREMENT
/begin MEASUREMENT B_hubap "Bedingung Hubsteuerung ¸ber Festwert" UBYTE B_TRUE 1 100 0 1 BIT_MASK 0x1 FORMAT "%13.11" ECU_ADDRESS 0x3FC299 /end MEASUREMENT
/begin MEASUREMENT B_ibfbsd7 "" UBYTE B_TRUE 1 100 0 1 FORMAT "%13.11" ECU_ADDRESS 0x4033DC /end MEASUREMENT
/begin MEASUREMENT B_ibspwf_e "" UBYTE B_TRUE 1 100 0 1 FORMAT "%13.11" ECU_ADDRESS 0x40347A /end MEASUREMENT
/begin MEASUREMENT B_ifbsak7 "" UBYTE B_TRUE 1 100 0 1 FORMAT "%13.11" ECU_ADDRESS 0x4033DD /end MEASUREMENT
/begin MEASUREMENT B_ifbsk7 "" UBYTE B_TRUE 1 100 0 1 FORMAT "%13.11" ECU_ADDRESS 0x4033CB /end MEASUREMENT
/begin MEASUREMENT B_ifplak7 "" UBYTE B_TRUE 1 100 0 1 FORMAT "%13.11" ECU_ADDRESS 0x4033CC /end MEASUREMENT
/begin MEASUREMENT B_ifuplak7 "" UBYTE B_TRUE 1 100 0 1 FORMAT "%13.11" ECU_ADDRESS 0x4033DE /end MEASUREMENT
/begin MEASUREMENT B_i_ska_fr "FR-Fehlerreaktion irreversible SKA (Sicherheits-Kraftstoff-Abschaltung)" UBYTE B_TRUE 1 100 0 1 BIT_MASK 0x1 FORMAT "%13.11" ECU_ADDRESS 0x3FBFCE /end MEASUREMENT
/begin MEASUREMENT B_katfz "Bedingung Kat in Fahrzeug eingebaut" UBYTE B_TRUE 1 100 0 1 BIT_MASK 0x1 FORMAT "%13.11" ECU_ADDRESS 0x3FC29A /end MEASUREMENT
/begin MEASUREMENT B_kl15_old "Dient zur Erkennung einer steigender Flanke B_kl15" UBYTE B_TRUE 1 100 0 1 FORMAT "%13.11" ECU_ADDRESS 0x4033DF /end MEASUREMENT
/begin MEASUREMENT B_kmmilsct "Ausgabe ""km bei MIL on"" f¸r Scan Tool abschalten (0 = keine Ausgabe in PID $21)" UBYTE B_TRUE 1 100 0 1 BIT_MASK 0x1 FORMAT "%13.11" ECU_ADDRESS 0x3FC29B /end MEASUREMENT
/begin MEASUREMENT B_limcalc "" UBYTE B_TRUE 1 100 0 1 FORMAT "%13.11" ECU_ADDRESS 0x4033E0 /end MEASUREMENT
/begin MEASUREMENT B_lmsslof "Bedingung Lambda-Motor-Soll-Sekund‰rluftanteil, Aus" UBYTE B_TRUE 1 100 0 1 BIT_MASK 0x1 FORMAT "%13.11" ECU_ADDRESS 0x3FC399 /end MEASUREMENT
/begin MEASUREMENT B_lsh "Bedingung Lambda-Sonde hinter Kat verbaut" UBYTE B_TRUE 1 100 0 1 BIT_MASK 0x1 FORMAT "%13.11" ECU_ADDRESS 0x3FC29C /end MEASUREMENT
/begin MEASUREMENT B_lsh2 "Bedingung Lambda-Sonde hinter Kat verbaut (Bank2)" UBYTE B_TRUE 1 100 0 1 BIT_MASK 0x1 FORMAT "%13.11" ECU_ADDRESS 0x3FC29D /end MEASUREMENT
/begin MEASUREMENT B_lsv "Bedingung Lambda-Sonde vor Kat verbaut, 1. Sonde nach Auslaﬂ (Bank1)" UBYTE B_TRUE 1 100 0 1 BIT_MASK 0x1 FORMAT "%13.11" ECU_ADDRESS 0x3FC29E /end MEASUREMENT
/begin MEASUREMENT B_lsv2 "Bedingung Lambda-Sonde vor Kat verbaut, 1. Sonde nach Auslaﬂ (Bank2)" UBYTE B_TRUE 1 100 0 1 BIT_MASK 0x1 FORMAT "%13.11" ECU_ADDRESS 0x3FC29F /end MEASUREMENT
/begin MEASUREMENT B_mde8e "Bedingung Mode $08 erlaubt" UBYTE B_TRUE 1 100 0 1 BIT_MASK 0x1 FORMAT "%13.11" ECU_ADDRESS 0x3FC2A0 /end MEASUREMENT
/begin MEASUREMENT B_mde9e "Bedingung Mode $09 erlaubt" UBYTE B_TRUE 1 100 0 1 BIT_MASK 0x1 FORMAT "%13.11" ECU_ADDRESS 0x3FC2A1 /end MEASUREMENT
/begin MEASUREMENT B_mrfavl "Vollasterkennung ¸ber relativen Fahrerwunsch" UBYTE B_TRUE 1 100 0 1 BIT_MASK 0x1 FORMAT "%13.11" ECU_ADDRESS 0x3FC2A2 /end MEASUREMENT
/begin MEASUREMENT B_msloff "Sekund‰rluftmasse ausger‰umt nach Sekund‰rluftphase" UBYTE B_TRUE 1 100 0 1 BIT_MASK 0x1 FORMAT "%13.11" ECU_ADDRESS 0x3FC39A /end MEASUREMENT
/begin MEASUREMENT B_mslon "Sekund‰rluftmasse eingeschwungen nach Start der Sekund‰rluft" UBYTE B_TRUE 1 100 0 1 BIT_MASK 0x1 FORMAT "%13.11" ECU_ADDRESS 0x3FC39B /end MEASUREMENT
/begin MEASUREMENT B_ndsav "Bedingung EEPROM-Emulation aktiv" UBYTE B_TRUE 1 100 0 1 BIT_MASK 0x1 FORMAT "%13.11" ECU_ADDRESS 0x3FC2A3 /end MEASUREMENT
/begin MEASUREMENT B_nokatfz "Bedingung Nicht-KAT Fahrzeug" UBYTE B_TRUE 1 100 0 1 BIT_MASK 0x1 FORMAT "%13.11" ECU_ADDRESS 0x3FC2A4 /end MEASUREMENT
/begin MEASUREMENT B_notlauf "Bedingung Notlauf aufgrund Batt-Unterspannung, Generatorstatus und !B_kl15" UBYTE B_TRUE 1 100 0 1 FORMAT "%13.11" ECU_ADDRESS 0x4033E1 /end MEASUREMENT
/begin MEASUREMENT B_notlu_fr "Anforderung Notluftfahren vom Funktionsrechner" UBYTE B_TRUE 1 100 0 1 BIT_MASK 0x1 FORMAT "%13.11" ECU_ADDRESS 0x3FBFCF /end MEASUREMENT
/begin MEASUREMENT B_nswo1 "Bedingung Drehzahl > NSWO1" UBYTE B_TRUE 1 100 0 1 BIT_MASK 0x1 FORMAT "%13.11" ECU_ADDRESS 0x3FC2A5 /end MEASUREMENT
/begin MEASUREMENT B_nswo2 "Bedingung Drehzahl > NSWO2" UBYTE B_TRUE 1 100 0 1 BIT_MASK 0x1 FORMAT "%13.11" ECU_ADDRESS 0x3FC2A6 /end MEASUREMENT
/begin MEASUREMENT B_nvsaad "0: Vanosadaption Auslaﬂ ist mˆglich/ 1: Vanosadaption Auslaﬂ ist gesperrt" UBYTE B_TRUE 1 100 0 1 FORMAT "%13.11" ECU_ADDRESS 0x403695 /end MEASUREMENT
/begin MEASUREMENT B_nvsead "0: Vanosadaption Einlaﬂ ist mˆglich/ 1: Vanosadaption Einlaﬂ ist gesperrt" UBYTE B_TRUE 1 100 0 1 FORMAT "%13.11" ECU_ADDRESS 0x403696 /end MEASUREMENT
/begin MEASUREMENT B_pcoschg7 "" UBYTE B_TRUE 1 100 0 1 FORMAT "%13.11" ECU_ADDRESS 0x4033E2 /end MEASUREMENT
/begin MEASUREMENT B_PIReset "Bedingung f¸r PI-Reset" UBYTE B_TRUE 1 100 0 1 FORMAT "%13.11" ECU_ADDRESS 0x4033E3 /end MEASUREMENT
/begin MEASUREMENT B_pmbsdanf "Bedingung POWERMANAGMENT BATTERIESPANNUNG Sendeanforderung" UBYTE B_TRUE 1 100 0 1 FORMAT "%13.11" ECU_ADDRESS 0x4033E4 /end MEASUREMENT
/begin MEASUREMENT B_pmsocini "wird beim INIT wahr um den Timer zur¸ckzusetzen" UBYTE B_TRUE 1 100 0 1 FORMAT "%13.11" ECU_ADDRESS 0x403491 /end MEASUREMENT
/begin MEASUREMENT B_pmsqrdy "Bedingung Berechnung Startqualit‰t fertig" UBYTE B_TRUE 1 100 0 1 FORMAT "%13.11" ECU_ADDRESS 0x3FE27C /end MEASUREMENT
/begin MEASUREMENT B_pmstartq "Bedingung Startqualit‰t" UBYTE B_TRUE 1 100 0 1 FORMAT "%13.11" ECU_ADDRESS 0x3FE27D /end MEASUREMENT
/begin MEASUREMENT B_pmvsdanf "Bedingung POWERMANAGMENT VERBRAUCHERSTEUERUNG Sendeanforderung" UBYTE B_TRUE 1 100 0 1 FORMAT "%13.11" ECU_ADDRESS 0x4033E5 /end MEASUREMENT
/begin MEASUREMENT B_pm_fit2 "Bedingung Hilfsvariable Fit 2" UBYTE B_TRUE 1 100 0 1 FORMAT "%13.11" ECU_ADDRESS 0x403492 /end MEASUREMENT
/begin MEASUREMENT B_pm_fit3 "Bedingung Hilfsvariable Fit 3" UBYTE B_TRUE 1 100 0 1 FORMAT "%13.11" ECU_ADDRESS 0x403493 /end MEASUREMENT
/begin MEASUREMENT B_psapp "Bedingung delta Saugrohrdruck Vorsteuerung f¸r Applikation" UBYTE B_TRUE 1 100 0 1 BIT_MASK 0x1 FORMAT "%13.11" ECU_ADDRESS 0x3FC2A7 /end MEASUREMENT
/begin MEASUREMENT B_psger "Bedingung Umschaltung Saugrohrdruck auf gerechnetem" UBYTE B_TRUE 1 100 0 1 BIT_MASK 0x1 FORMAT "%13.11" ECU_ADDRESS 0x3FC2A8 /end MEASUREMENT
/begin MEASUREMENT B_q_start "Bedingung Startqualit‰t vollst‰ndig berechnet" UBYTE B_TRUE 1 100 0 1 FORMAT "%13.11" ECU_ADDRESS 0x403494 /end MEASUREMENT
/begin MEASUREMENT B_resetsta "Bedingung Reset Startauswertung" UBYTE B_TRUE 1 100 0 1 FORMAT "%13.11" ECU_ADDRESS 0x4034A2 /end MEASUREMENT
/begin MEASUREMENT B_sldsl4 "Bedingung: Freigabe Sekund‰rluft f¸r Diagnosephase 4" UWORD B_TRUE 1 100 0 1 BIT_MASK 0x4 FORMAT "%13.11" ECU_ADDRESS 0x403778 /end MEASUREMENT
/begin MEASUREMENT B_slkhof "Bedingung Abschalten der Sekund‰rluftpumpe durch imlpr-Schwelle" UBYTE B_TRUE 1 100 0 1 BIT_MASK 0x1 FORMAT "%13.11" ECU_ADDRESS 0x3FC39C /end MEASUREMENT
/begin MEASUREMENT B_slkt "Bedingung: Freigabe Sekund‰rluft f¸r Kurztest" UWORD B_TRUE 1 100 0 1 BIT_MASK 0x8 FORMAT "%13.11" ECU_ADDRESS 0x403778 /end MEASUREMENT
/begin MEASUREMENT B_slp "Bedingung f¸r Sekund‰rluftpumpe" UBYTE B_TRUE 1 100 0 1 BIT_MASK 0x1 FORMAT "%13.11" ECU_ADDRESS 0x3FC39D /end MEASUREMENT
/begin MEASUREMENT B_slpena "Bedingung Einschalten der Sekund‰rluftpumpe" UWORD B_TRUE 1 100 0 1 BIT_MASK 0x10 FORMAT "%13.11" ECU_ADDRESS 0x403778 /end MEASUREMENT
/begin MEASUREMENT B_slpmn "Mindestbetriebszeit der Sekund‰rluftpumpe" UBYTE B_TRUE 1 100 0 1 BIT_MASK 0x1 FORMAT "%13.11" ECU_ADDRESS 0x3FC39E /end MEASUREMENT
/begin MEASUREMENT B_slpoff "Sekund‰rluftpumpe abgeschaltet" UBYTE B_TRUE 1 100 0 1 BIT_MASK 0x1 FORMAT "%13.11" ECU_ADDRESS 0x3FC39F /end MEASUREMENT
/begin MEASUREMENT B_slpofst "Bedingung f¸r Setzen Flip Flop  B_slpoff" UWORD B_TRUE 1 100 0 1 BIT_MASK 0x20 FORMAT "%13.11" ECU_ADDRESS 0x403778 /end MEASUREMENT
/begin MEASUREMENT B_slpvar "Bedingung Sekund‰rluftpumpe vorhanden" UBYTE B_TRUE 1 100 0 1 BIT_MASK 0x1 FORMAT "%13.11" ECU_ADDRESS 0x3FC2A9 /end MEASUREMENT
/begin MEASUREMENT B_sls "Bedingung Sekund‰rluft aktiv" UBYTE B_TRUE 1 100 0 1 BIT_MASK 0x1 FORMAT "%13.11" ECU_ADDRESS 0x3FC3A0 /end MEASUREMENT
/begin MEASUREMENT B_slsadap "Bedingung: Sekund‰rluftmassenadaption" UBYTE B_TRUE 1 100 0 1 BIT_MASK 0x1 FORMAT "%13.11" ECU_ADDRESS 0x3FC3A1 /end MEASUREMENT
/begin MEASUREMENT B_slsdis "Bedingung f¸r  Abschalten der Sekund‰rluftpumpe" UWORD B_TRUE 1 100 0 1 BIT_MASK 0x80 FORMAT "%13.11" ECU_ADDRESS 0x403778 /end MEASUREMENT
/begin MEASUREMENT B_slserr "Bedingungen sperren Einschalten der Sekund‰rluftpumpe" UWORD B_TRUE 1 100 0 1 BIT_MASK 0x100 FORMAT "%13.11" ECU_ADDRESS 0x403778 /end MEASUREMENT
/begin MEASUREMENT B_slsfz "Bedingung SLS in Fahrzeug eingebaut" UBYTE B_TRUE 1 100 0 1 BIT_MASK 0x1 FORMAT "%13.11" ECU_ADDRESS 0x3FC2AA /end MEASUREMENT
/begin MEASUREMENT B_slsoab "Bedingung SLS ohne Abbruchkriterium durchgef¸hrt" UWORD B_TRUE 1 100 0 1 BIT_MASK 0x200 FORMAT "%13.11" ECU_ADDRESS 0x403778 /end MEASUREMENT
/begin MEASUREMENT B_slsoff "Sekund‰rlufteinblasung nach Ausr‰umen der Sekund‰rluft beendet" UBYTE B_TRUE 1 100 0 1 BIT_MASK 0x1 FORMAT "%13.11" ECU_ADDRESS 0x3FC3A2 /end MEASUREMENT
/begin MEASUREMENT B_slv "Bedingung f¸r Sekund‰rluftventil" UBYTE B_TRUE 1 100 0 1 BIT_MASK 0x1 FORMAT "%13.11" ECU_ADDRESS 0x3FC3A3 /end MEASUREMENT
/begin MEASUREMENT B_slvvar "Bedingung Sekund‰rluftventil vorhanden" UBYTE B_TRUE 1 100 0 1 BIT_MASK 0x1 FORMAT "%13.11" ECU_ADDRESS 0x3FC2AB /end MEASUREMENT
/begin MEASUREMENT B_soccalc "Uo Kalibrierung durchgef¸hrt" UBYTE B_TRUE 1 100 0 1 FORMAT "%13.11" ECU_ADDRESS 0x40347B /end MEASUREMENT
/begin MEASUREMENT B_soc_npl "Bedingung SoC-Wert nicht plausibel" UBYTE B_TRUE 1 100 0 1 FORMAT "%13.11" ECU_ADDRESS 0x403495 /end MEASUREMENT
/begin MEASUREMENT B_soc_pwf "Uo Kalibrierung durchgef¸hrt" UBYTE B_TRUE 1 100 0 1 FORMAT "%13.11" ECU_ADDRESS 0x40347C /end MEASUREMENT
/begin MEASUREMENT B_start "Start" UBYTE B_TRUE 1 100 0 1 FORMAT "%13.11" ECU_ADDRESS 0x403801 /end MEASUREMENT
/begin MEASUREMENT B_temin "Bedingung TEMIN-Begrenzung aktiv, Bank 1" UBYTE B_TRUE 1 100 0 1 BIT_MASK 0x1 FORMAT "%13.11" ECU_ADDRESS 0x403908 /end MEASUREMENT
/begin MEASUREMENT B_temin2 "Bedingung TEMIN-Begrenzung aktiv, Bank 2" UBYTE B_TRUE 1 100 0 1 BIT_MASK 0x2 FORMAT "%13.11" ECU_ADDRESS 0x403908 /end MEASUREMENT
/begin MEASUREMENT B_tfu "Bedingung Temperaturf¸hler Umgebung vorhanden" UBYTE B_TRUE 1 100 0 1 BIT_MASK 0x1 FORMAT "%13.11" ECU_ADDRESS 0x3FC2AC /end MEASUREMENT
/begin MEASUREMENT B_ubtlow "Bedingung Batterie in Unterspannungszustand" UBYTE B_TRUE 1 100 0 1 FORMAT "%13.11" ECU_ADDRESS 0x4033E6 /end MEASUREMENT
/begin MEASUREMENT B_uhrrmin "Bedingung Uhr mit relativem Minutenz‰hler" UBYTE B_TRUE 1 100 0 1 BIT_MASK 0x1 FORMAT "%13.11" ECU_ADDRESS 0x3FC2AD /end MEASUREMENT
/begin MEASUREMENT B_uhrrsec "Bedingung Uhr mit relativem Sekundenz‰hler" UBYTE B_TRUE 1 100 0 1 BIT_MASK 0x1 FORMAT "%13.11" ECU_ADDRESS 0x3FC2AE /end MEASUREMENT
/begin MEASUREMENT B_ulcp "Bedingung Variante ""ultra low cost powermanagment""" UBYTE B_TRUE 1 100 0 1 BIT_MASK 0x4 FORMAT "%13.11" ECU_ADDRESS 0x3FE285 /end MEASUREMENT
/begin MEASUREMENT B_ulcp7 "" UBYTE B_TRUE 1 100 0 1 FORMAT "%13.11" ECU_ADDRESS 0x4033E7 /end MEASUREMENT
/begin MEASUREMENT B_uloreset "Bedingung Batterie nicht mehr in Unterspannungszustand" UBYTE B_TRUE 1 100 0 1 FORMAT "%13.11" ECU_ADDRESS 0x4033E8 /end MEASUREMENT
/begin MEASUREMENT B_vsast "" UBYTE B_TRUE 1 100 0 1 FORMAT "%13.11" ECU_ADDRESS 0x403697 /end MEASUREMENT
/begin MEASUREMENT B_vsest "" UBYTE B_TRUE 1 100 0 1 FORMAT "%13.11" ECU_ADDRESS 0x403698 /end MEASUREMENT
/begin MEASUREMENT B_vzare "" UBYTE B_TRUE 1 100 0 1 FORMAT "%13.11" ECU_ADDRESS 0x403699 /end MEASUREMENT
/begin MEASUREMENT B_vzere "" UBYTE B_TRUE 1 100 0 1 FORMAT "%13.11" ECU_ADDRESS 0x40369A /end MEASUREMENT
/begin MEASUREMENT B_wdksapcw "DK-Steuerung ¸ber Festwert, Bit 1 hat Priorit‰t" UBYTE B_TRUE 1 100 0 1 BIT_MASK 0x1 FORMAT "%13.11" ECU_ADDRESS 0x3FC2AF /end MEASUREMENT
/begin MEASUREMENT B_whslpkh "" UWORD B_TRUE 1 100 0 1 BIT_MASK 0x800 FORMAT "%13.11" ECU_ADDRESS 0x403778 /end MEASUREMENT
/begin MEASUREMENT B_wnwmnbe "minimaler Adaptionsgrenzwert erreicht, Sollwertbegrenzung aktiv" UBYTE B_TRUE 1 100 0 1 FORMAT "%13.11" ECU_ADDRESS 0x40369B /end MEASUREMENT
/begin MEASUREMENT B_zwappl "Bedingung Z¸ndwinkelapplikation ohne Drehmomenteingriffe" UBYTE B_TRUE 1 100 0 1 BIT_MASK 0x1 FORMAT "%13.11" ECU_ADDRESS 0x3FC2B0 /end MEASUREMENT
/begin MEASUREMENT cbatt_lo "Nennkapazit‰t Batterie, lokal" UBYTE DEZ 1 100 20 150 FORMAT "%5.1" ECU_ADDRESS 0x40348A /end MEASUREMENT
/begin MEASUREMENT cd_bits1_w "" UWORD dez 1 100 0 65535 FORMAT "%8.2" ECU_ADDRESS 0x404254 /end MEASUREMENT
/begin MEASUREMENT cd_bits2_w "" UWORD dez 1 100 0 65535 FORMAT "%8.2" ECU_ADDRESS 0x404256 /end MEASUREMENT
/begin MEASUREMENT codcan "Umschaltung CAN11h/CAN12h (BMW)" UBYTE dez 1 100 0 255 FORMAT "%5.1" ECU_ADDRESS 0x3FE282 /end MEASUREMENT
/begin MEASUREMENT codcancpl "Komplement der Umschaltinfo CAN11/CAN12 (BMW)" UBYTE dez 1 100 0 255 FORMAT "%5.1" ECU_ADDRESS 0x3FE283 /end MEASUREMENT
/begin MEASUREMENT codfzg "Kodierung Fahrzeugvariante" UBYTE dez 1 100 0 255 FORMAT "%5.1" ECU_ADDRESS 0x3FE284 /end MEASUREMENT
/begin MEASUREMENT common_rt "" ULONG dez 1 100 0 4.29497e+009 FORMAT "%13.2" ECU_ADDRESS 0x404BA8 /end MEASUREMENT
/begin MEASUREMENT ctrcbr "Steuerung Stromzweige" UBYTE DEZ 1 100 0 255 FORMAT "%5.1" ECU_ADDRESS 0x403448 /end MEASUREMENT
/begin MEASUREMENT ctrcbr7 "lokales ctrcbr" UBYTE DEZ 1 100 0 255 FORMAT "%5.1" ECU_ADDRESS 0x403449 /end MEASUREMENT
/begin MEASUREMENT ctrcbrmem "" UBYTE DEZ 1 100 0 255 FORMAT "%5.1" ECU_ADDRESS 0x40344A /end MEASUREMENT
/begin MEASUREMENT ctrpcos "Steuerung Standverbraucher" UBYTE DEZ 1 100 0 3 FORMAT "%5.3" ECU_ADDRESS 0x40344B /end MEASUREMENT
/begin MEASUREMENT ctrpcos7 "lokales ctrpcos" UBYTE DEZ 1 100 0 3 FORMAT "%5.3" ECU_ADDRESS 0x3FE258 /end MEASUREMENT
/begin MEASUREMENT ctrpcosmem "" UBYTE DEZ 1 100 0 3 FORMAT "%5.3" ECU_ADDRESS 0x40344C /end MEASUREMENT
/begin MEASUREMENT ctrprio "Steuerung Spitzenreduzierung Priorit‰t" UBYTE DEZ 1 100 0 7 FORMAT "%5.3" ECU_ADDRESS 0x40344D /end MEASUREMENT
/begin MEASUREMENT ctrprio7 "lokales ctrprio" UBYTE DEZ 1 100 0 7 FORMAT "%5.3" ECU_ADDRESS 0x40344E /end MEASUREMENT
/begin MEASUREMENT ctrpriocf "Steuerung Spitzenreduzierung Priorit‰t Komfort" UBYTE DEZ 1 100 0 7 FORMAT "%5.3" ECU_ADDRESS 0x40344F /end MEASUREMENT
/begin MEASUREMENT ctrpriocf7 "lokales ctrpriocf" UBYTE DEZ 1 100 0 7 FORMAT "%5.3" ECU_ADDRESS 0x403450 /end MEASUREMENT
/begin MEASUREMENT ctrpriocfm "" UBYTE DEZ 1 100 0 7 FORMAT "%5.3" ECU_ADDRESS 0x403451 /end MEASUREMENT
/begin MEASUREMENT ctrpriomem "" UBYTE DEZ 1 100 0 7 FORMAT "%5.3" ECU_ADDRESS 0x403452 /end MEASUREMENT
/begin MEASUREMENT ctrpwrcf "Komfort-Teil von ctrpwrcos" UWORD DEZ 1 100 0 65535 FORMAT "%8.2" ECU_ADDRESS 0x4033EE /end MEASUREMENT
/begin MEASUREMENT ctrpwrcos "Steuerung Leistung Verbraucher" UWORD DEZ 1 100 0 65535 FORMAT "%8.2" ECU_ADDRESS 0x4033F0 /end MEASUREMENT
/begin MEASUREMENT ctrpwrcos7 "lokales ctrpwrcos" UWORD DEZ 1 100 0 65535 FORMAT "%8.2" ECU_ADDRESS 0x4033F2 /end MEASUREMENT
/begin MEASUREMENT ctrpwrdf "df-Teil von ctrpwrcos" UWORD DEZ 1 100 0 65535 FORMAT "%8.2" ECU_ADDRESS 0x4033F4 /end MEASUREMENT
/begin MEASUREMENT ctrpwrmem "" UWORD DEZ 1 100 0 65535 FORMAT "%8.2" ECU_ADDRESS 0x4033F6 /end MEASUREMENT
/begin MEASUREMENT ctrpwspcos "Steuerung Leistung Sonderverbraucher" UBYTE fak_q0p5 1 100 0 127.5 FORMAT "%5.1" ECU_ADDRESS 0x403453 /end MEASUREMENT
/begin MEASUREMENT ctrpwspcs7 "lokales ctrpwspcos" UBYTE fak_q0p5 1 100 0 127.5 FORMAT "%5.1" ECU_ADDRESS 0x403454 /end MEASUREMENT
/begin MEASUREMENT cw_erfil "Status Codewort Filtervariante f¸r Ausgabe der AS-Fehler an GST" UBYTE dez 1 100 0 255 FORMAT "%5.1" ECU_ADDRESS 0x403CDF /end MEASUREMENT
/begin MEASUREMENT dastd "Delta Auslasspreizung durch Differenzdruck im Saugrohr" SWORD sprzi_q0p8 1 100 -26214.4 26213.6 FORMAT "%8.2" ECU_ADDRESS 0x404854 /end MEASUREMENT
/begin MEASUREMENT dastdll "Leerlauf Delta Auslasspreizung durch Differenzdruck im Saugrohr" SWORD sprzi_q0p8 1 100 -26214.4 26213.6 FORMAT "%8.2" ECU_ADDRESS 0x404856 /end MEASUREMENT
/begin MEASUREMENT destd "Delta Einlasspreizung durch Differenzdruck im Saugrohr" SWORD sprzi_q0p8 1 100 -26214.4 26213.6 FORMAT "%8.2" ECU_ADDRESS 0x404858 /end MEASUREMENT
/begin MEASUREMENT destdll "Leerlauf Delta Auslasspreizung durch Differenzdruck im Saugrohr" SWORD sprzi_q0p8 1 100 -26214.4 26213.6 FORMAT "%8.2" ECU_ADDRESS 0x40485A /end MEASUREMENT
/begin MEASUREMENT df2pi "DF-Gewichtung auf Prios" UWORD fak_uw_q0p25o500 1 100 -100 100 FORMAT "%9.5" ECU_ADDRESS 0x4033F8 /end MEASUREMENT
/begin MEASUREMENT dfall2pi "Gesamtgewichtung auf Prios" UWORD fak_uw_q0p25o500 1 100 -500 500 FORMAT "%9.5" ECU_ADDRESS 0x4033FA /end MEASUREMENT
/begin MEASUREMENT dfallpi "PI-Geregelte Gesamtgewichtung auf Prios" UWORD fak_uw_q0p25o500 1 100 0 450 FORMAT "%9.5" ECU_ADDRESS 0x4033FC /end MEASUREMENT
/begin MEASUREMENT dffgen7 "" UBYTE rel_ub_b100 1 100 0 100 FORMAT "%5.1" ECU_ADDRESS 0x403455 /end MEASUREMENT
/begin MEASUREMENT dff_filt7 "lokales dffgenflit" UBYTE rel_ub_b100 1 100 0 100 FORMAT "%5.1" ECU_ADDRESS 0x403456 /end MEASUREMENT
/begin MEASUREMENT dfgenfilt "‹ber PT-1 gefiltertes dffgen-Signal" UBYTE rel_ub_b100 1 100 0 100 FORMAT "%5.1" ECU_ADDRESS 0x403457 /end MEASUREMENT
/begin MEASUREMENT dfpi2ptc "Gewichtung der Prios -> Gewichtung f¸r PTC Ansteuerung" UWORD fak_uw_q0p25o500 1 100 -100 100 FORMAT "%9.5" ECU_ADDRESS 0x4033FE /end MEASUREMENT
/begin MEASUREMENT dfprio "" UWORD fak_uw_q0p25o500 1 100 0 450 FORMAT "%9.5" ECU_ADDRESS 0x403400 /end MEASUREMENT
/begin MEASUREMENT dfpt1filt "dffgen PT-1 gefiltert" UBYTE rel_ub_b100 1 100 0 100 FORMAT "%5.1" ECU_ADDRESS 0x403458 /end MEASUREMENT
/begin MEASUREMENT dfpt1ptc "PT1 gefiltertes DF Signal f¸r PTC Ansteuerung" UBYTE rel_ub_b100 1 100 0 100 FORMAT "%5.1" ECU_ADDRESS 0x403459 /end MEASUREMENT
/begin MEASUREMENT dfpt1_2ptc "gefiltertes dffgen Gewichtung auf PTC-Ansteuerung" UWORD fak_uw_q0p25o500 1 100 -100 100 FORMAT "%9.5" ECU_ADDRESS 0x403402 /end MEASUREMENT
/begin MEASUREMENT dlOvrunCtr "" UWORD dez 1 100 0 65535 FORMAT "%8.2" ECU_ADDRESS 0x3FE280 /end MEASUREMENT
/begin MEASUREMENT dpus_w "Delta Druck Umgebung Saugrohr" SWORD p_q0p039 1 100 -1280 1279.96 FORMAT "%8.3" ECU_ADDRESS 0x40465E /end MEASUREMENT
/begin MEASUREMENT dr_reg_resetBuffer "" ULONG default 1 100 0 4.29497e+009 FORMAT "%13.2" ARRAY_SIZE 60 ECU_ADDRESS 0x3FCBE0 /end MEASUREMENT
/begin MEASUREMENT dr_reg_resetBuffer_cnt "" UWORD default 1 100 0 65535 FORMAT "%8.2" ECU_ADDRESS 0x3FCCD8 /end MEASUREMENT
/begin MEASUREMENT dr_reg_resetBuffer_idx "" UWORD default 1 100 0 65535 FORMAT "%8.2" ECU_ADDRESS 0x3FCCD4 /end MEASUREMENT
/begin MEASUREMENT dr_reg_resetTimestampBuffer "" ULONG default 1 100 0 4.29497e+009 FORMAT "%13.2" ARRAY_SIZE 10 ECU_ADDRESS 0x3FCCE0 /end MEASUREMENT
/begin MEASUREMENT dr_reg_resetTimestampBuffer_idx "" UWORD default 1 100 0 65535 FORMAT "%8.2" ECU_ADDRESS 0x3FCD0C /end MEASUREMENT
/begin MEASUREMENT dsoc2pi "Batterieladezustand-Gewichtung auf Prios" UWORD fak_uw_q0p25o500 1 100 -150 150 FORMAT "%9.5" ECU_ADDRESS 0x403404 /end MEASUREMENT
/begin MEASUREMENT dsoc2ptc "dsoc Gewichtung auf PTC-Ansteuerung" UWORD fak_uw_q0p25o500 1 100 -150 150 FORMAT "%9.5" ECU_ADDRESS 0x403406 /end MEASUREMENT
/begin MEASUREMENT d_qelad "Delta Kapazit‰t entladen" UWORD qlad_uw_q0p0182 1 100 0 1193.03 FORMAT "%6.1" ECU_ADDRESS 0x40347E /end MEASUREMENT
/begin MEASUREMENT d_qlad "Delta Kapazit‰t geladen" UWORD qlad_uw_q0p0182 1 100 0 1193.03 FORMAT "%6.1" ECU_ADDRESS 0x403480 /end MEASUREMENT
/begin MEASUREMENT d_soc "Abstand zur Startf‰higkeitsgrenze" UWORD fak_q0p004_o100 1 100 -100 100 ECU_ADDRESS 0x3FE26E /end MEASUREMENT
/begin MEASUREMENT d_socw "Delta SoC" UWORD fak_q0p004_o100 1 100 -100 100 ECU_ADDRESS 0x403498 /end MEASUREMENT
/begin MEASUREMENT d_socw_1 "Delta SoC" UWORD rel_uw_b100 1 100 0 99.9985 FORMAT "%8.5" ECU_ADDRESS 0x40349A /end MEASUREMENT
/begin MEASUREMENT ehz_pwloc2 "" UBYTE rel_ub_b100 1 100 0 100 FORMAT "%5.1" ECU_ADDRESS 0x40345A /end MEASUREMENT
/begin MEASUREMENT Ellk "Leerlauf Einlasspreizung gedrosselt kalt zum Katheizen" UBYTE sprzi_q0p8 1 100 0 204 FORMAT "%5.1" ECU_ADDRESS 0x4039D3 /end MEASUREMENT
/begin MEASUREMENT Ellw "Leerlauf Einlasspreizung gedrosselt warm zum Katheizen" UBYTE sprzi_q0p8 1 100 0 204 FORMAT "%5.1" ECU_ADDRESS 0x4039D4 /end MEASUREMENT
/begin MEASUREMENT Esk "optimale Einlasspreizung kalt ungedrosselt" UBYTE sprzi_q0p8 1 100 0 204 FORMAT "%5.1" ECU_ADDRESS 0x4039D5 /end MEASUREMENT
/begin MEASUREMENT Espr "Sollwert Einlasspreizung" UBYTE sprzi_q0p8 1 100 0 204 FORMAT "%5.1" ECU_ADDRESS 0x4039D6 /end MEASUREMENT
/begin MEASUREMENT Esprimx "Max der ist Einlassspreizung" UWORD sprzi_q0p1 1 100 0 6553.5 FORMAT "%8.3" ECU_ADDRESS 0x4036A0 /end MEASUREMENT
/begin MEASUREMENT Esprl "Leerlauf Einlasspreizung gedrosselt" UBYTE sprzi_q0p8 1 100 0 204 FORMAT "%5.1" ECU_ADDRESS 0x4039D7 /end MEASUREMENT
/begin MEASUREMENT Esprlu "Leerlauf Einlasspreizung ungedrosselt" UBYTE sprzi_q0p8 1 100 0 204 FORMAT "%5.1" ECU_ADDRESS 0x4039D8 /end MEASUREMENT
/begin MEASUREMENT Esprt "Einlasspreizung teilgedrosselt" UBYTE sprzi_q0p8 1 100 0 204 FORMAT "%5.1" ECU_ADDRESS 0x4039D9 /end MEASUREMENT
/begin MEASUREMENT Espru "Einlasspreizung ungedrosselt" UBYTE sprzi_q0p8 1 100 0 204 FORMAT "%5.1" ECU_ADDRESS 0x4039DA /end MEASUREMENT
/begin MEASUREMENT esst_san12esuw "" ULONG dez 1 100 0 4.29497e+009 FORMAT "%13.2" ECU_ADDRESS 0x4048C8 /end MEASUREMENT
/begin MEASUREMENT esst_sdm05tesb "" ULONG dez 1 100 0 4.29497e+009 FORMAT "%13.2" ECU_ADDRESS 0x4048CC /end MEASUREMENT
/begin MEASUREMENT esst_seh06kruw "" ULONG dez 1 100 0 4.29497e+009 FORMAT "%13.2" ECU_ADDRESS 0x4048D0 /end MEASUREMENT
/begin MEASUREMENT esst_sez06tmub "" ULONG dez 1 100 0 4.29497e+009 FORMAT "%13.2" ECU_ADDRESS 0x4048D4 /end MEASUREMENT
/begin MEASUREMENT esst_sfr04bbuw "" ULONG dez 1 100 0 4.29497e+009 FORMAT "%13.2" ECU_ADDRESS 0x4048D8 /end MEASUREMENT
/begin MEASUREMENT esst_sga07mdub "" ULONG dez 1 100 0 4.29497e+009 FORMAT "%13.2" ECU_ADDRESS 0x4048DC /end MEASUREMENT
/begin MEASUREMENT esst_sga08mdub "" ULONG dez 1 100 0 4.29497e+009 FORMAT "%13.2" ECU_ADDRESS 0x4048E0 /end MEASUREMENT
/begin MEASUREMENT esst_sks06esub "" ULONG dez 1 100 0 4.29497e+009 FORMAT "%13.2" ECU_ADDRESS 0x4048E4 /end MEASUREMENT
/begin MEASUREMENT esst_slx06tmuw "" ULONG dez 1 100 0 4.29497e+009 FORMAT "%13.2" ECU_ADDRESS 0x4048E8 /end MEASUREMENT
/begin MEASUREMENT esst_sly06tmuw "" ULONG dez 1 100 0 4.29497e+009 FORMAT "%13.2" ECU_ADDRESS 0x4048EC /end MEASUREMENT
/begin MEASUREMENT esst_smi08dmub "" ULONG dez 1 100 0 4.29497e+009 FORMAT "%13.2" ECU_ADDRESS 0x4049D4 /end MEASUREMENT
/begin MEASUREMENT esst_sml06teub "" ULONG dez 1 100 0 4.29497e+009 FORMAT "%13.2" ECU_ADDRESS 0x4048F0 /end MEASUREMENT
/begin MEASUREMENT esst_sml06tmuw "" ULONG dez 1 100 0 4.29497e+009 FORMAT "%13.2" ECU_ADDRESS 0x4048F4 /end MEASUREMENT
/begin MEASUREMENT esst_sml07tmuw "" ULONG dez 1 100 0 4.29497e+009 FORMAT "%13.2" ECU_ADDRESS 0x4048F8 /end MEASUREMENT
/begin MEASUREMENT esst_sml08lhub "" ULONG dez 1 100 0 4.29497e+009 FORMAT "%13.2" ECU_ADDRESS 0x4048FC /end MEASUREMENT
/begin MEASUREMENT esst_sn16kr1ub "" ULONG dez 1 100 0 4.29497e+009 FORMAT "%13.2" ECU_ADDRESS 0x404900 /end MEASUREMENT
/begin MEASUREMENT esst_sn16kr2ub "" ULONG dez 1 100 0 4.29497e+009 FORMAT "%13.2" ECU_ADDRESS 0x404904 /end MEASUREMENT
/begin MEASUREMENT esst_sng06llsb "" ULONG dez 1 100 0 4.29497e+009 FORMAT "%13.2" ECU_ADDRESS 0x404908 /end MEASUREMENT
/begin MEASUREMENT esst_sng06lltsb "" ULONG dez 1 100 0 4.29497e+009 FORMAT "%13.2" ECU_ADDRESS 0x40490C /end MEASUREMENT
/begin MEASUREMENT esst_snm04teub "" ULONG dez 1 100 0 4.29497e+009 FORMAT "%13.2" ECU_ADDRESS 0x404910 /end MEASUREMENT
/begin MEASUREMENT esst_snm06llub "" ULONG dez 1 100 0 4.29497e+009 FORMAT "%13.2" ECU_ADDRESS 0x404914 /end MEASUREMENT
/begin MEASUREMENT esst_snm06mduw "" ULONG dez 1 100 0 4.29497e+009 FORMAT "%13.2" ECU_ADDRESS 0x404918 /end MEASUREMENT
/begin MEASUREMENT esst_snm07esub "" ULONG dez 1 100 0 4.29497e+009 FORMAT "%13.2" ECU_ADDRESS 0x40491C /end MEASUREMENT
/begin MEASUREMENT esst_snm07lsuw "" ULONG dez 1 100 0 4.29497e+009 FORMAT "%13.2" ECU_ADDRESS 0x404920 /end MEASUREMENT
/begin MEASUREMENT esst_snm08dmub "" ULONG dez 1 100 0 4.29497e+009 FORMAT "%13.2" ECU_ADDRESS 0x4049D8 /end MEASUREMENT
/begin MEASUREMENT esst_snm08dmuw1 "" ULONG dez 1 100 0 4.29497e+009 FORMAT "%13.2" ECU_ADDRESS 0x4049DC /end MEASUREMENT
/begin MEASUREMENT esst_snm08gkub "" ULONG dez 1 100 0 4.29497e+009 FORMAT "%13.2" ECU_ADDRESS 0x404924 /end MEASUREMENT
/begin MEASUREMENT esst_snm08kruw "" ULONG dez 1 100 0 4.29497e+009 FORMAT "%13.2" ECU_ADDRESS 0x404928 /end MEASUREMENT
/begin MEASUREMENT esst_snm08lhub "" ULONG dez 1 100 0 4.29497e+009 FORMAT "%13.2" ECU_ADDRESS 0x40492C /end MEASUREMENT
/begin MEASUREMENT esst_snm08__ub "" ULONG dez 1 100 0 4.29497e+009 FORMAT "%13.2" ECU_ADDRESS 0x404930 /end MEASUREMENT
/begin MEASUREMENT esst_snm10lsub "" ULONG dez 1 100 0 4.29497e+009 FORMAT "%13.2" ECU_ADDRESS 0x404934 /end MEASUREMENT
/begin MEASUREMENT esst_snm12esub "" ULONG dez 1 100 0 4.29497e+009 FORMAT "%13.2" ECU_ADDRESS 0x404938 /end MEASUREMENT
/begin MEASUREMENT esst_snm12feub "" ULONG dez 1 100 0 4.29497e+009 FORMAT "%13.2" ECU_ADDRESS 0x40493C /end MEASUREMENT
/begin MEASUREMENT esst_snm16krub "" ULONG dez 1 100 0 4.29497e+009 FORMAT "%13.2" ECU_ADDRESS 0x404940 /end MEASUREMENT
/begin MEASUREMENT esst_snm16opuw "" ULONG dez 1 100 0 4.29497e+009 FORMAT "%13.2" ECU_ADDRESS 0x404944 /end MEASUREMENT
/begin MEASUREMENT esst_snm16zuub "" ULONG dez 1 100 0 4.29497e+009 FORMAT "%13.2" ECU_ADDRESS 0x404948 /end MEASUREMENT
/begin MEASUREMENT esst_snm24zuub "" ULONG dez 1 100 0 4.29497e+009 FORMAT "%13.2" ECU_ADDRESS 0x40494C /end MEASUREMENT
/begin MEASUREMENT esst_sqm05teub "" ULONG dez 1 100 0 4.29497e+009 FORMAT "%13.2" ECU_ADDRESS 0x404950 /end MEASUREMENT
/begin MEASUREMENT esst_srl04krub "" ULONG dez 1 100 0 4.29497e+009 FORMAT "%13.2" ECU_ADDRESS 0x404954 /end MEASUREMENT
/begin MEASUREMENT esst_srl06zuub "" ULONG dez 1 100 0 4.29497e+009 FORMAT "%13.2" ECU_ADDRESS 0x404958 /end MEASUREMENT
/begin MEASUREMENT esst_srl08gkub "" ULONG dez 1 100 0 4.29497e+009 FORMAT "%13.2" ECU_ADDRESS 0x40495C /end MEASUREMENT
/begin MEASUREMENT esst_srl08lsuw "" ULONG dez 1 100 0 4.29497e+009 FORMAT "%13.2" ECU_ADDRESS 0x404960 /end MEASUREMENT
/begin MEASUREMENT esst_srl10lsub "" ULONG dez 1 100 0 4.29497e+009 FORMAT "%13.2" ECU_ADDRESS 0x404964 /end MEASUREMENT
/begin MEASUREMENT esst_srl12esub "" ULONG dez 1 100 0 4.29497e+009 FORMAT "%13.2" ECU_ADDRESS 0x404968 /end MEASUREMENT
/begin MEASUREMENT esst_srl12zuub "" ULONG dez 1 100 0 4.29497e+009 FORMAT "%13.2" ECU_ADDRESS 0x40496C /end MEASUREMENT
/begin MEASUREMENT esst_srl16zuub "" ULONG dez 1 100 0 4.29497e+009 FORMAT "%13.2" ECU_ADDRESS 0x404970 /end MEASUREMENT
/begin MEASUREMENT esst_sst_restgas12_nmot_w "" ULONG dez 1 100 0 4.29497e+009 FORMAT "%13.2" ECU_ADDRESS 0x404C10 /end MEASUREMENT
/begin MEASUREMENT esst_sst_restgas12_rlvw_w "" ULONG dez 1 100 0 4.29497e+009 FORMAT "%13.2" ECU_ADDRESS 0x404C14 /end MEASUREMENT
/begin MEASUREMENT esst_sst_restgas16_nmot_w "" ULONG dez 1 100 0 4.29497e+009 FORMAT "%13.2" ECU_ADDRESS 0x404C18 /end MEASUREMENT
/begin MEASUREMENT esst_sst_restgas16_rlvw_w "" ULONG dez 1 100 0 4.29497e+009 FORMAT "%13.2" ECU_ADDRESS 0x404C1C /end MEASUREMENT
/begin MEASUREMENT esst_st107tmub "" ULONG dez 1 100 0 4.29497e+009 FORMAT "%13.2" ECU_ADDRESS 0x404974 /end MEASUREMENT
/begin MEASUREMENT esst_st207tmub "" ULONG dez 1 100 0 4.29497e+009 FORMAT "%13.2" ECU_ADDRESS 0x404978 /end MEASUREMENT
/begin MEASUREMENT esst_st307tmub "" ULONG dez 1 100 0 4.29497e+009 FORMAT "%13.2" ECU_ADDRESS 0x40497C /end MEASUREMENT
/begin MEASUREMENT esst_st407tmub "" ULONG dez 1 100 0 4.29497e+009 FORMAT "%13.2" ECU_ADDRESS 0x404980 /end MEASUREMENT
/begin MEASUREMENT esst_sta04saub "" ULONG dez 1 100 0 4.29497e+009 FORMAT "%13.2" ECU_ADDRESS 0x404984 /end MEASUREMENT
/begin MEASUREMENT esst_sta06esub "" ULONG dez 1 100 0 4.29497e+009 FORMAT "%13.2" ECU_ADDRESS 0x404988 /end MEASUREMENT
/begin MEASUREMENT esst_stm04feub "" ULONG dez 1 100 0 4.29497e+009 FORMAT "%13.2" ECU_ADDRESS 0x40498C /end MEASUREMENT
/begin MEASUREMENT esst_stm04saub "" ULONG dez 1 100 0 4.29497e+009 FORMAT "%13.2" ECU_ADDRESS 0x404990 /end MEASUREMENT
/begin MEASUREMENT esst_stm05saub "" ULONG dez 1 100 0 4.29497e+009 FORMAT "%13.2" ECU_ADDRESS 0x404994 /end MEASUREMENT
/begin MEASUREMENT esst_stm05tmub "" ULONG dez 1 100 0 4.29497e+009 FORMAT "%13.2" ECU_ADDRESS 0x404998 /end MEASUREMENT
/begin MEASUREMENT esst_stm06lltub "" ULONG dez 1 100 0 4.29497e+009 FORMAT "%13.2" ECU_ADDRESS 0x40499C /end MEASUREMENT
/begin MEASUREMENT esst_stm06llub "" ULONG dez 1 100 0 4.29497e+009 FORMAT "%13.2" ECU_ADDRESS 0x4049A0 /end MEASUREMENT
/begin MEASUREMENT esst_stm06__ub "" ULONG dez 1 100 0 4.29497e+009 FORMAT "%13.2" ECU_ADDRESS 0x4049A4 /end MEASUREMENT
/begin MEASUREMENT esst_stm08bbub "" ULONG dez 1 100 0 4.29497e+009 FORMAT "%13.2" ECU_ADDRESS 0x4049A8 /end MEASUREMENT
/begin MEASUREMENT esst_stm08mdub "" ULONG dez 1 100 0 4.29497e+009 FORMAT "%13.2" ECU_ADDRESS 0x4049AC /end MEASUREMENT
/begin MEASUREMENT esst_stm09esub "" ULONG dez 1 100 0 4.29497e+009 FORMAT "%13.2" ECU_ADDRESS 0x4049B0 /end MEASUREMENT
/begin MEASUREMENT esst_stm12esub "" ULONG dez 1 100 0 4.29497e+009 FORMAT "%13.2" ECU_ADDRESS 0x4049B4 /end MEASUREMENT
/begin MEASUREMENT esst_sts12esub "" ULONG dez 1 100 0 4.29497e+009 FORMAT "%13.2" ECU_ADDRESS 0x4049B8 /end MEASUREMENT
/begin MEASUREMENT esst_swd06krsw "" ULONG dez 1 100 0 4.29497e+009 FORMAT "%13.2" ECU_ADDRESS 0x4049BC /end MEASUREMENT
/begin MEASUREMENT Estk "optimale Einlasspreizung kalt teilgedrosselt" UBYTE sprzi_q0p8 1 100 0 204 FORMAT "%5.1" ECU_ADDRESS 0x4039DB /end MEASUREMENT
/begin MEASUREMENT Estw "optimale Einlasspreizung warm teilgedrosselt" UBYTE sprzi_q0p8 1 100 0 204 FORMAT "%5.1" ECU_ADDRESS 0x4039DC /end MEASUREMENT
/begin MEASUREMENT Esw "optimale Einlasspreizung warm ungedrosselt" UBYTE sprzi_q0p8 1 100 0 204 FORMAT "%5.1" ECU_ADDRESS 0x4039DD /end MEASUREMENT
/begin MEASUREMENT Eswll "optimale Einlasspreizung warm ungedrosselt im Leerlauf" UBYTE sprzi_q0p8 1 100 0 204 FORMAT "%5.1" ECU_ADDRESS 0x4039DE /end MEASUREMENT
/begin MEASUREMENT Fastw_aus "Faktor Auslass teilgedrosselt" UBYTE fakspr_q0p0039 1 100 0 0.996094 ECU_ADDRESS 0x4039DF /end MEASUREMENT
/begin MEASUREMENT Fasw_aus "Faktor Auslass ungedrosselt" UBYTE fakspr_q0p0039 1 100 0 0.996094 ECU_ADDRESS 0x4039E0 /end MEASUREMENT
/begin MEASUREMENT fcmclrCtr "" ULONG dez 1 100 0 4.29497e+009 FORMAT "%13.2" ECU_ADDRESS 0x404B18 /end MEASUREMENT
/begin MEASUREMENT Festw_aus "Faktor Einlass teilgedrosselt" UBYTE fakspr_q0p0039 1 100 0 0.996094 ECU_ADDRESS 0x4039E1 /end MEASUREMENT
/begin MEASUREMENT Fesw_aus "Faktor Einlass ungedrosselt" UBYTE fakspr_q0p0039 1 100 0 0.996094 ECU_ADDRESS 0x4039E2 /end MEASUREMENT
/begin MEASUREMENT fhkrst_w "Einspritzkorrektur bei hoher Kraftstofftemperatur" SWORD fak_sw_b2x 1 100 0 1.99997 FORMAT "%8.6" ECU_ADDRESS 0x402DDC /end MEASUREMENT
/begin MEASUREMENT firstsynchroCtr "" ULONG dez 1 100 0 4.29497e+009 FORMAT "%13.2" ECU_ADDRESS 0x404B1C /end MEASUREMENT
/begin MEASUREMENT flamsl2_w "Faktor Lambda‰nderung durch Sekund‰rluft, Bank 2" UWORD fak_uw_b16 1 100 0 15.9998 FORMAT "%8.5" ECU_ADDRESS 0x40376C /end MEASUREMENT
/begin MEASUREMENT flamsl_w "Faktor Lambda‰nderung durch Sekund‰rluft" UWORD fak_uw_b16 1 100 0 15.9998 FORMAT "%8.5" ECU_ADDRESS 0x40376E /end MEASUREMENT
/begin MEASUREMENT flmssl "Faktor Lambda-Motor-Soll-Sekund‰rluftanteil" UBYTE fak_ub_b1 1 100 0 0.996094 ECU_ADDRESS 0x403761 /end MEASUREMENT
/begin MEASUREMENT fmsagd "Korrekturfaktor Abgasgegendruck der Sekund‰rluftmasse" UBYTE fak_ub_b2 1 100 0 1.99219 FORMAT "%5.3" ECU_ADDRESS 0x403762 /end MEASUREMENT
/begin MEASUREMENT fmsldyn "Faktor Dynamikbeschreibung Sekund‰rluft" UBYTE fak_ub_b1 1 100 0 0.996094 ECU_ADDRESS 0x403763 /end MEASUREMENT
/begin MEASUREMENT fmslrho "Dichtekorrektur der Sekund‰rluftmasse" UBYTE fak_ub_b2 1 100 0 1.99219 FORMAT "%5.3" ECU_ADDRESS 0x403764 /end MEASUREMENT
/begin MEASUREMENT fmsltm "tmot- Korrektur der Sekund‰rluftmasse" UBYTE fak_ub_b2 1 100 0 1.99219 FORMAT "%5.3" ECU_ADDRESS 0x403765 /end MEASUREMENT
/begin MEASUREMENT frkte_w "Faktor Umrechnung rel. Kraftstoffmasse rk in effekt. Einspritzzeit te" UWORD fak_uw_b16 1 100 0 1 FORMAT "%8.6" ECU_ADDRESS 0x404660 /end MEASUREMENT
/begin MEASUREMENT frlfsdp_w "Einspritzzeitkorrektur bei returnless Systemen" SWORD fak_sw_b2x 1 100 0 1.99997 FORMAT "%8.6" ECU_ADDRESS 0x402DDE /end MEASUREMENT
/begin MEASUREMENT FsgIdCounter "" UWORD dez 1 100 0 65535 FORMAT "%8.2" ECU_ADDRESS 0x4047AE /end MEASUREMENT
/begin MEASUREMENT FsgIdMemCounter "" UWORD dez 1 100 0 65535 FORMAT "%8.2" ECU_ADDRESS 0x4047B2 /end MEASUREMENT
/begin MEASUREMENT FsgMemCounter "" UWORD dez 1 100 0 65535 FORMAT "%8.2" ECU_ADDRESS 0x4047B0 /end MEASUREMENT
/begin MEASUREMENT fslpdyn "Faktor Dynamikbeschreibung Sekund‰rluftpumpe" UBYTE fak_ub_b1 1 100 0 0.996094 ECU_ADDRESS 0x403766 /end MEASUREMENT
/begin MEASUREMENT ftek2_w "Korrekturfaktor f¸r effektive Einspritzzeit, Bank 2" UWORD fak_uw_b16 1 100 0 1.99976 FORMAT "%8.6" ECU_ADDRESS 0x402DE0 /end MEASUREMENT
/begin MEASUREMENT ftek_w "Korrekturfaktor f¸r effektive Einspritzzeit" UWORD fak_uw_b16 1 100 0 1.99976 FORMAT "%8.6" ECU_ADDRESS 0x402DE2 /end MEASUREMENT
/begin MEASUREMENT hkw_iant2 "I-Anteil" SWORD rel_ub_b100 1 100 -100 100 FORMAT "%8.4" ECU_ADDRESS 0x403408 /end MEASUREMENT
/begin MEASUREMENT hkw_ki2 "I-Verst‰rkung" UWORD fak_uw_q0p001 1 100 0 10 FORMAT "%8.5" ECU_ADDRESS 0x40340A /end MEASUREMENT
/begin MEASUREMENT hkw_kp2 "P-Verst‰rkung" UWORD fak_uw_q0p001 1 100 0 10 FORMAT "%8.5" ECU_ADDRESS 0x40340C /end MEASUREMENT
/begin MEASUREMENT hkw_lpgv2 "gefilterte Generatorlast" UBYTE rel_ub_b100 1 100 0 100 FORMAT "%5.1" ECU_ADDRESS 0x40345B /end MEASUREMENT
/begin MEASUREMENT hkw_pant2 "P-Anteil" SWORD rel_ub_b100 1 100 -1000 1000 FORMAT "%8.3" ECU_ADDRESS 0x40340E /end MEASUREMENT
/begin MEASUREMENT hkw_pi2 "PI-Anteil" SWORD rel_ub_b100 1 100 -2000 2000 FORMAT "%8.3" ECU_ADDRESS 0x403410 /end MEASUREMENT
/begin MEASUREMENT hkw_rdiff2 "Regeldifferenz" UBYTE rel_ub_b100 1 100 0 100 FORMAT "%5.1" ECU_ADDRESS 0x40345C /end MEASUREMENT
/begin MEASUREMENT hkw_sel_i2 "I-Verst‰rkungsauswahl" UBYTE DEZ 1 100 0 10 FORMAT "%5.2" ECU_ADDRESS 0x40345D /end MEASUREMENT
/begin MEASUREMENT hkw_sel_p2 "P-Verst arkungsauswahl" UBYTE DEZ 1 100 0 10 FORMAT "%5.2" ECU_ADDRESS 0x40345E /end MEASUREMENT
/begin MEASUREMENT hkw_sv2 "Sollgrˆﬂe Generatorlast" UBYTE rel_ub_b100 1 100 0 100 FORMAT "%5.1" ECU_ADDRESS 0x40345F /end MEASUREMENT
/begin MEASUREMENT hw1Ctr "" ULONG dez 1 100 0 4.29497e+009 FORMAT "%13.2" ECU_ADDRESS 0x404B20 /end MEASUREMENT
/begin MEASUREMENT hw2Ctr "" ULONG dez 1 100 0 4.29497e+009 FORMAT "%13.2" ECU_ADDRESS 0x404B24 /end MEASUREMENT
/begin MEASUREMENT hw3Ctr "" ULONG dez 1 100 0 4.29497e+009 FORMAT "%13.2" ECU_ADDRESS 0x404B28 /end MEASUREMENT
/begin MEASUREMENT hw4Ctr "" ULONG dez 1 100 0 4.29497e+009 FORMAT "%13.2" ECU_ADDRESS 0x404B2C /end MEASUREMENT
/begin MEASUREMENT ibatt_w7 "" UWORD i_uw_q0p08_o200 1 100 -200 1000 ECU_ADDRESS 0x403412 /end MEASUREMENT
/begin MEASUREMENT ibtdiff "Diff. zw. Ibatt_w und Ibatt_soll" UWORD i_uw_q0p08_o200 1 100 -200 2000 ECU_ADDRESS 0x403414 /end MEASUREMENT
/begin MEASUREMENT ibtdiff2pi "Batterie-soll-strom Gewichtung auf Prios" UWORD fak_uw_q0p25o500 1 100 -100 100 FORMAT "%9.5" ECU_ADDRESS 0x403416 /end MEASUREMENT
/begin MEASUREMENT ibtsoll "" UWORD i_uw_q0p08_o200 1 100 -200 1000 ECU_ADDRESS 0x403418 /end MEASUREMENT
/begin MEASUREMENT ib_commcnt "Z‰hler Taskaufrufe zwischen periodischer Abfrage qlad und qelad" UBYTE DEZ 1 100 0 255 FORMAT "%5.1" ECU_ADDRESS 0x40348B /end MEASUREMENT
/begin MEASUREMENT ib_commsta "Statemaschine zeiger zur Abfrage qlad und qelad" UBYTE DEZ 1 100 0 255 FORMAT "%5.1" ECU_ADDRESS 0x40348C /end MEASUREMENT
/begin MEASUREMENT idelta "Differenz der Startstrˆme" UWORD i_ub_q0p02 1 100 0.02 1000 FORMAT "%7.2" ECU_ADDRESS 0x4047AA /end MEASUREMENT
/begin MEASUREMENT idiff2ptc "idiff Gewichtung auf die PTC-Ansteuerung" UWORD fak_uw_q0p25o500 1 100 -100 100 FORMAT "%9.5" ECU_ADDRESS 0x40341A /end MEASUREMENT
/begin MEASUREMENT igenrest "Generatorrestleistung in Ampere" UBYTE igen_ub_q1 1 100 0 255 FORMAT "%5.1" ECU_ADDRESS 0x403460 /end MEASUREMENT
/begin MEASUREMENT imlsla_w "Luftmassenintegral f¸r Einbringen der Sekund‰rluft" UWORD m_uw_b4660 1 100 0 4660.27 FORMAT "%8.3" ECU_ADDRESS 0x403770 /end MEASUREMENT
/begin MEASUREMENT imlsle_w "Luftmassenintegral f¸r Ende der Sekund‰rluft im Abgas" UWORD m_uw_b4660 1 100 0 4660.27 FORMAT "%8.3" ECU_ADDRESS 0x403772 /end MEASUREMENT
/begin MEASUREMENT ind_priocf "" UBYTE DEZ 1 100 0 6 FORMAT "%5.3" ECU_ADDRESS 0x403461 /end MEASUREMENT
/begin MEASUREMENT ind_priodf "" UBYTE DEZ 1 100 0 6 FORMAT "%5.3" ECU_ADDRESS 0x403462 /end MEASUREMENT
/begin MEASUREMENT ind_pwrcf "" UBYTE DEZ 1 100 0 6 FORMAT "%5.3" ECU_ADDRESS 0x403463 /end MEASUREMENT
/begin MEASUREMENT ind_pwrcos "" UBYTE DEZ 1 100 0 13 FORMAT "%5.2" ECU_ADDRESS 0x403464 /end MEASUREMENT
/begin MEASUREMENT ini1_predrive_Ctr "" ULONG dez 1 100 0 4.29497e+009 FORMAT "%13.2" ECU_ADDRESS 0x404B30 /end MEASUREMENT
/begin MEASUREMENT ini2_predrive_Ctr "" ULONG dez 1 100 0 4.29497e+009 FORMAT "%13.2" ECU_ADDRESS 0x404B34 /end MEASUREMENT
/begin MEASUREMENT inisynchroCtr "" ULONG dez 1 100 0 4.29497e+009 FORMAT "%13.2" ECU_ADDRESS 0x404B38 /end MEASUREMENT
/begin MEASUREMENT inisynct_w "Z‰hler f¸r Initialisierungsdurchl‰ufe" UWORD dez 1 100 0 65535 FORMAT "%8.2" ECU_ADDRESS 0x4047AC /end MEASUREMENT
/begin MEASUREMENT isoc0loc "Batteriestrom zum Zeitpunkt der Ruhespannungsmessung (lokal)" UWORD i_uw_q0p02_o200 1 100 -200 1110.7 ECU_ADDRESS 0x403482 /end MEASUREMENT
/begin MEASUREMENT isoll "Isoll aufgrund von dsoc und tbatt auf PTC Ansteuerung" UWORD i_uw_q0p08_o200 1 100 -200 1000 ECU_ADDRESS 0x40341C /end MEASUREMENT
/begin MEASUREMENT isolldiff "Differenz isoll - ibatt_w f¸r PTC Ansteuerung" UWORD i_uw_q0p08_o200 1 100 -200 1000 ECU_ADDRESS 0x40341E /end MEASUREMENT
/begin MEASUREMENT i_zyl "Zylinderzuordnung bei Stereo Regelung" UBYTE dez 1 100 0 8 FORMAT "%5.3" ECU_ADDRESS 0x403907 /end MEASUREMENT
/begin MEASUREMENT kalevcnt "" UBYTE DEZ 1 100 0 255 FORMAT "%5.1" ECU_ADDRESS 0x40348D /end MEASUREMENT
/begin MEASUREMENT kbmcount "" UBYTE t_q0p1 1 100 0 25.5 FORMAT "%5.2" ECU_ADDRESS 0x403465 /end MEASUREMENT
/begin MEASUREMENT ko2vk2_w "Korrekturfaktor f¸r Funktionspumstrom LSU aus Schubabgleich, Bank2" UWORD fak_uw_b16 1 100 0 15.9998 FORMAT "%8.5" ECU_ADDRESS 0x403EC4 /end MEASUREMENT
/begin MEASUREMENT ko2vk_w "Korrekturfaktor f¸r Funktionspumstrom LSU aus Schubabgleich" UWORD fak_uw_b16 1 100 0 15.9998 FORMAT "%8.5" ECU_ADDRESS 0x403EC6 /end MEASUREMENT
/begin MEASUREMENT krkte_w "Umrechnung relative Kraftstoffmasse rk in effektive Einspritzzeit te" UWORD rkt_uw_b0p5 1 100 0 0.5 FORMAT "%9.7" ECU_ADDRESS 0x404662 /end MEASUREMENT
/begin MEASUREMENT lv_var_bn "Bedingung Bordnetzvariante CAN12" UBYTE B_TRUE 1 100 0 1 BIT_MASK 0x2 FORMAT "%13.11" ECU_ADDRESS 0x3FE285 /end MEASUREMENT
/begin MEASUREMENT lv_var_veh "Bedingung Fahrzeugvariante E65" UBYTE B_TRUE 1 100 0 1 BIT_MASK 0x1 FORMAT "%13.11" ECU_ADDRESS 0x3FE285 /end MEASUREMENT
/begin MEASUREMENT mem "" UBYTE fak_q0p5 1 100 0 127.5 FORMAT "%5.1" ECU_ADDRESS 0x403466 /end MEASUREMENT
/begin MEASUREMENT memprio1 "" UWORD fak_uw_b512 1 100 0 511.992 FORMAT "%8.4" ECU_ADDRESS 0x403420 /end MEASUREMENT
/begin MEASUREMENT memprio2 "" UWORD fak_uw_b512 1 100 0 511.992 FORMAT "%8.4" ECU_ADDRESS 0x403422 /end MEASUREMENT
/begin MEASUREMENT memptc1 "" UWORD fak_uw_b512 1 100 0 511.992 FORMAT "%8.4" ECU_ADDRESS 0x403424 /end MEASUREMENT
/begin MEASUREMENT memptc2 "" UWORD fak_uw_b512 1 100 0 511.992 FORMAT "%8.4" ECU_ADDRESS 0x403426 /end MEASUREMENT
/begin MEASUREMENT midmd "Referenzmoment f¸r Aussetzererkennung" UBYTE rel_ub_b99p6 1 100 0 99.6094 FORMAT "%5.2" ECU_ADDRESS 0x403881 /end MEASUREMENT
/begin MEASUREMENT midmd_f "Referenzmoment f¸r Aussetzererkennung" FLOAT32_IEEE fak_r32_1 1 100 0 4.29497e+009 FORMAT "%27.16" ECU_ADDRESS 0x3FAC98 /end MEASUREMENT
/begin MEASUREMENT midmd_w "Referenzmoment f¸r Aussetzererkennung" UWORD rel_uw_b100 1 100 0 99.9985 FORMAT "%8.5" ECU_ADDRESS 0x404408 /end MEASUREMENT
/begin MEASUREMENT msl "Sekund‰rluftmassenstrom" UBYTE m_ub_q0p4 1 100 0 102 FORMAT "%5.1" ECU_ADDRESS 0x403767 /end MEASUREMENT
/begin MEASUREMENT msl2 "Sekund‰rluftmasse Bank 2" UBYTE m_ub_q0p4 1 100 0 102 FORMAT "%5.1" ECU_ADDRESS 0x403768 /end MEASUREMENT
/begin MEASUREMENT msl2_w "Sekund‰rluftmasse Bank 2 16-Bit Wert" UWORD m_uw_b6553p5 1 100 0 6553.5 FORMAT "%8.3" ECU_ADDRESS 0x403774 /end MEASUREMENT
/begin MEASUREMENT mslpub "Sekund‰rluftmassenstrom, batteriespannungsabh‰ngig" UBYTE m_ub_q0p4 1 100 0 102 FORMAT "%5.1" ECU_ADDRESS 0x403769 /end MEASUREMENT
/begin MEASUREMENT mslstat "statischer Sekund‰rluftmassenstrom" UBYTE m_ub_q0p4 1 100 0 102 FORMAT "%5.1" ECU_ADDRESS 0x40376A /end MEASUREMENT
/begin MEASUREMENT msl_w "Sekund‰rluftmassenstrom 16-Bit Wert" UWORD m_uw_b6553p5 1 100 0 6553.5 FORMAT "%8.3" ECU_ADDRESS 0x403776 /end MEASUREMENT
/begin MEASUREMENT nnmstart "" UBYTE nmot_ub_q10 1 100 0 2550 FORMAT "%5.0" ECU_ADDRESS 0x4039AA /end MEASUREMENT
/begin MEASUREMENT o2adap2_w "Adaptiertes O2-Konzentration-Signal nach erfolgreichem Schubabgleich, Bank2" SWORD relO2_q9p765Em4 1 100 -32 31.999 FORMAT "%8.5" ECU_ADDRESS 0x403EC8 /end MEASUREMENT
/begin MEASUREMENT o2adap_w "Adaptiertes O2-Konzentration-Signal nach erfolgreichem Schubabgleich" SWORD relO2_q9p765Em4 1 100 -32 31.999 FORMAT "%8.5" ECU_ADDRESS 0x403ECA /end MEASUREMENT
/begin MEASUREMENT performance "" UBYTE rel_ub_b100 1 100 0 99.6094 FORMAT "%5.2" ECU_ADDRESS 0x4039B1 /end MEASUREMENT
/begin MEASUREMENT performance_max "" UBYTE rel_ub_b100 1 100 0 99.6094 FORMAT "%5.2" ECU_ADDRESS 0x3FE286 /end MEASUREMENT
/begin MEASUREMENT pgen2ptc "Gewichtung der Generatorrestleistung f¸r PTC-Ansteuerung" UWORD fak_uw_q0p25o500 1 100 -100 100 FORMAT "%9.5" ECU_ADDRESS 0x403428 /end MEASUREMENT
/begin MEASUREMENT pgenrest "Generatorrestleistung (igenrest*ubatt_w)" UWORD fak_q0p1 1 100 0 6400 FORMAT "%8.3" ECU_ADDRESS 0x40342A /end MEASUREMENT
/begin MEASUREMENT picntr "" UBYTE t_q0p1 1 100 0 25.5 FORMAT "%5.2" ECU_ADDRESS 0x403467 /end MEASUREMENT
/begin MEASUREMENT pmbscount "" UBYTE DEZ 1 100 0 255 FORMAT "%5.1" ECU_ADDRESS 0x403468 /end MEASUREMENT
/begin MEASUREMENT pmsoc_help "Hilfsvariable f¸r SoC aus der Startf‰higkeitsberechnung" UWORD fak_q0p002 1 100 0 100 FORMAT "%6.2" ECU_ADDRESS 0x40349C /end MEASUREMENT
/begin MEASUREMENT pmstartsta "Schalter f¸r Ablaufsteuerung" UBYTE DEZ 1 100 0 255 FORMAT "%5.1" ECU_ADDRESS 0x4039AB /end MEASUREMENT
/begin MEASUREMENT pmvscount "" UBYTE DEZ 1 100 0 255 FORMAT "%5.1" ECU_ADDRESS 0x403469 /end MEASUREMENT
/begin MEASUREMENT pm_ibslog "" UBYTE B_TRUE 1 100 0 1 FORMAT "%13.11" ECU_ADDRESS 0x403496 /end MEASUREMENT
/begin MEASUREMENT pm_tsrdy "Status Berechnung Tsaison" UBYTE B_TRUE 1 100 0 1 FORMAT "%13.11" ECU_ADDRESS 0x3FE26A /end MEASUREMENT
/begin MEASUREMENT prokonAusBitsNov1 "" UBYTE dez 1 100 0 255 FORMAT "%5.1" ECU_ADDRESS 0x3FE285 /end MEASUREMENT
/begin MEASUREMENT pses_w "Saugrohrdruck ¸ber Verstellsystem korrigiert" UWORD p_q0p039 1 100 0 2559.96 FORMAT "%8.3" ECU_ADDRESS 0x402DE4 /end MEASUREMENT
/begin MEASUREMENT ptc_pwr "Maximale Leistung, die der PTC einstellen darf." UBYTE fak_q0p5 1 100 0 127.5 FORMAT "%5.1" ECU_ADDRESS 0x40346A /end MEASUREMENT
/begin MEASUREMENT ptc_pwr7 "lokales ptc_pwr" UBYTE fak_q0p5 1 100 0 127.5 FORMAT "%5.1" ECU_ADDRESS 0x40346B /end MEASUREMENT
/begin MEASUREMENT qeladold "Kapazit‰t Entladen vor Abstellen" UWORD qlad_uw_q0p0182 1 100 0 1193.03 FORMAT "%6.1" ECU_ADDRESS 0x3FE25C /end MEASUREMENT
/begin MEASUREMENT qladold "Kapazit‰t Getladen vor Abstellen" UWORD qlad_uw_q0p0182 1 100 0 1193.03 FORMAT "%6.1" ECU_ADDRESS 0x3FE25E /end MEASUREMENT
/begin MEASUREMENT q_bila "Kapazit‰t Batterie (long)" ULONG qlad_ul_q2p7Em7 1 100 0 150 FORMAT "%8.4" ECU_ADDRESS 0x3FE264 /end MEASUREMENT
/begin MEASUREMENT q_startfgk "Abstand zur Startf‰higkeitsgrenze" UWORD qlad_uw_q0p0182 1 100 0 1193.03 FORMAT "%6.1" ECU_ADDRESS 0x3FE270 /end MEASUREMENT
/begin MEASUREMENT r1000msCtr "" ULONG dez 1 100 0 4.29497e+009 FORMAT "%13.2" ECU_ADDRESS 0x404B3C /end MEASUREMENT
/begin MEASUREMENT r1000ms_predrive_Ctr "" ULONG dez 1 100 0 4.29497e+009 FORMAT "%13.2" ECU_ADDRESS 0x404B40 /end MEASUREMENT
/begin MEASUREMENT r1000ms_swoff_Ctr "" ULONG dez 1 100 0 4.29497e+009 FORMAT "%13.2" ECU_ADDRESS 0x404B44 /end MEASUREMENT
/begin MEASUREMENT r100msCtr "" ULONG dez 1 100 0 4.29497e+009 FORMAT "%13.2" ECU_ADDRESS 0x404B48 /end MEASUREMENT
/begin MEASUREMENT r100ms_predrive_Ctr "" ULONG dez 1 100 0 4.29497e+009 FORMAT "%13.2" ECU_ADDRESS 0x404B4C /end MEASUREMENT
/begin MEASUREMENT r100ms_swoff_Ctr "" ULONG dez 1 100 0 4.29497e+009 FORMAT "%13.2" ECU_ADDRESS 0x404B50 /end MEASUREMENT
/begin MEASUREMENT r10msCtr "10ms-Raster-Z‰hler der Funktion" ULONG dez 1 100 0 4.29497e+009 FORMAT "%13.2" ECU_ADDRESS 0x404B54 /end MEASUREMENT
/begin MEASUREMENT r10ms_predrive_Ctr "" ULONG dez 1 100 0 4.29497e+009 FORMAT "%13.2" ECU_ADDRESS 0x404B58 /end MEASUREMENT
/begin MEASUREMENT r10ms_swoff_Ctr "" ULONG dez 1 100 0 4.29497e+009 FORMAT "%13.2" ECU_ADDRESS 0x404B5C /end MEASUREMENT
/begin MEASUREMENT r1msCtr "Z‰hler f¸r 1ms Abl‰ufe" ULONG dez 1 100 0 4.29497e+009 FORMAT "%13.2" ECU_ADDRESS 0x404B60 /end MEASUREMENT
/begin MEASUREMENT r1ms_all_Ctr "" ULONG dez 1 100 0 4.29497e+009 FORMAT "%13.2" ECU_ADDRESS 0x404B64 /end MEASUREMENT
/begin MEASUREMENT r1ms_predrive_Ctr "" ULONG dez 1 100 0 4.29497e+009 FORMAT "%13.2" ECU_ADDRESS 0x404B68 /end MEASUREMENT
/begin MEASUREMENT r1ms_swoff_Ctr "" ULONG dez 1 100 0 4.29497e+009 FORMAT "%13.2" ECU_ADDRESS 0x404B6C /end MEASUREMENT
/begin MEASUREMENT r200msCtr "" ULONG dez 1 100 0 4.29497e+009 FORMAT "%13.2" ECU_ADDRESS 0x404B70 /end MEASUREMENT
/begin MEASUREMENT r200ms_predrive_Ctr "" ULONG dez 1 100 0 4.29497e+009 FORMAT "%13.2" ECU_ADDRESS 0x404B74 /end MEASUREMENT
/begin MEASUREMENT r200ms_swoff_Ctr "" ULONG dez 1 100 0 4.29497e+009 FORMAT "%13.2" ECU_ADDRESS 0x404B78 /end MEASUREMENT
/begin MEASUREMENT r20msCtr "" ULONG dez 1 100 0 4.29497e+009 FORMAT "%13.2" ECU_ADDRESS 0x404B7C /end MEASUREMENT
/begin MEASUREMENT r20ms_predrive_Ctr "" ULONG dez 1 100 0 4.29497e+009 FORMAT "%13.2" ECU_ADDRESS 0x404B80 /end MEASUREMENT
/begin MEASUREMENT r20ms_swoff_Ctr "" ULONG dez 1 100 0 4.29497e+009 FORMAT "%13.2" ECU_ADDRESS 0x404B84 /end MEASUREMENT
/begin MEASUREMENT r2msCtr "" ULONG dez 1 100 0 4.29497e+009 FORMAT "%13.2" ECU_ADDRESS 0x404B88 /end MEASUREMENT
/begin MEASUREMENT r2ms_predrive_Ctr "" ULONG dez 1 100 0 4.29497e+009 FORMAT "%13.2" ECU_ADDRESS 0x404B8C /end MEASUREMENT
/begin MEASUREMENT r2ms_swoff_Ctr "" ULONG dez 1 100 0 4.29497e+009 FORMAT "%13.2" ECU_ADDRESS 0x404B90 /end MEASUREMENT
/begin MEASUREMENT r50msCtr "" ULONG dez 1 100 0 4.29497e+009 FORMAT "%13.2" ECU_ADDRESS 0x404B94 /end MEASUREMENT
/begin MEASUREMENT r50ms_predrive_Ctr "" ULONG dez 1 100 0 4.29497e+009 FORMAT "%13.2" ECU_ADDRESS 0x404B98 /end MEASUREMENT
/begin MEASUREMENT r50ms_swoff_Ctr "" ULONG dez 1 100 0 4.29497e+009 FORMAT "%13.2" ECU_ADDRESS 0x404B9C /end MEASUREMENT
/begin MEASUREMENT rasfak "Korrekturfaktor f¸r Rasteraufweitung (10ms-Raster und grˆﬂer)" UBYTE fak_ub_b2 1 100 0 1.99219 FORMAT "%5.3" ECU_ADDRESS 0x403CDE /end MEASUREMENT
/begin MEASUREMENT rin_grenzh "" UBYTE r_q0p125 1 100 0 31.875 FORMAT "%7.4" ECU_ADDRESS 0x4039AC /end MEASUREMENT
/begin MEASUREMENT rin_start "Innenwiderstand Batterie beim Start" UBYTE r_q0p125 1 100 0 31.875 FORMAT "%7.4" ECU_ADDRESS 0x4039AD /end MEASUREMENT
/begin MEASUREMENT rkteAusBitssyn "" UBYTE dez 1 100 0 255 FORMAT "%5.1" ECU_ADDRESS 0x403908 /end MEASUREMENT
/begin MEASUREMENT rlvwrstg_w "" UWORD rel_uw_q0p0234 1 100 0 1535.98 FORMAT "%8.3" ECU_ADDRESS 0x40485C /end MEASUREMENT
/begin MEASUREMENT rqpcos "Anforderung Standverbraucher" UBYTE DEZ 1 100 0 3 FORMAT "%5.3" ECU_ADDRESS 0x40346C /end MEASUREMENT
/begin MEASUREMENT rqpcos7 "lokales rqpcos" UBYTE DEZ 1 100 0 3 FORMAT "%5.3" ECU_ADDRESS 0x40346D /end MEASUREMENT
/begin MEASUREMENT rqpcosmem "" UBYTE DEZ 1 100 0 3 FORMAT "%5.3" ECU_ADDRESS 0x40346E /end MEASUREMENT
/begin MEASUREMENT RSThyst1 "Hysterese Einlaﬂseite" UBYTE B_TRUE 1 100 0 1 FORMAT "%13.11" ECU_ADDRESS 0x40369C /end MEASUREMENT
/begin MEASUREMENT RSThyst2 "Hysterese Auslaﬂseite" UBYTE B_TRUE 1 100 0 1 FORMAT "%13.11" ECU_ADDRESS 0x40369D /end MEASUREMENT
/begin MEASUREMENT rt_1000ms "" UWORD t1p0usxms 1 100 0 65.535 FORMAT "%8.5" ECU_ADDRESS 0x4047B4 /end MEASUREMENT
/begin MEASUREMENT rt_100ms "" UWORD t1p0usxms 1 100 0 65.535 FORMAT "%8.5" ECU_ADDRESS 0x4047B6 /end MEASUREMENT
/begin MEASUREMENT rt_100msModAkt "" ULONG rel_uw_q0p001 1 100 0 4.29497e+006 FORMAT "%13.5" ECU_ADDRESS 0x404BAC /end MEASUREMENT
/begin MEASUREMENT rt_100mss "" ULONG rel_uw_q0p001 1 100 0 4.29497e+006 FORMAT "%13.5" ECU_ADDRESS 0x404BB0 /end MEASUREMENT
/begin MEASUREMENT rt_10ms "" UWORD t1p0usxms 1 100 0 65.535 FORMAT "%8.5" ECU_ADDRESS 0x4047B8 /end MEASUREMENT
/begin MEASUREMENT rt_10msModAkt "" ULONG rel_uw_q0p001 1 100 0 4.29497e+006 FORMAT "%13.5" ECU_ADDRESS 0x404BB4 /end MEASUREMENT
/begin MEASUREMENT rt_10mss "" ULONG rel_uw_q0p001 1 100 0 4.29497e+006 FORMAT "%13.5" ECU_ADDRESS 0x404BB8 /end MEASUREMENT
/begin MEASUREMENT rt_1ms "" UWORD t1p0usxms 1 100 0 65.535 FORMAT "%8.5" ECU_ADDRESS 0x4047BA /end MEASUREMENT
/begin MEASUREMENT rt_1msModAkt "" ULONG rel_uw_q0p001 1 100 0 4.29497e+006 FORMAT "%13.5" ECU_ADDRESS 0x404BBC /end MEASUREMENT
/begin MEASUREMENT rt_1mss "" ULONG rel_uw_q0p001 1 100 0 4.29497e+006 FORMAT "%13.5" ECU_ADDRESS 0x404BC0 /end MEASUREMENT
/begin MEASUREMENT rt_200ms "" UWORD t1p0usxms 1 100 0 65.535 FORMAT "%8.5" ECU_ADDRESS 0x4047BC /end MEASUREMENT
/begin MEASUREMENT rt_20ms "" UWORD t1p0usxms 1 100 0 65.535 FORMAT "%8.5" ECU_ADDRESS 0x4047BE /end MEASUREMENT
/begin MEASUREMENT rt_20msModAkt "" ULONG rel_uw_q0p001 1 100 0 4.29497e+006 FORMAT "%13.5" ECU_ADDRESS 0x404BC4 /end MEASUREMENT
/begin MEASUREMENT rt_20mss "" ULONG rel_uw_q0p001 1 100 0 4.29497e+006 FORMAT "%13.5" ECU_ADDRESS 0x404BC8 /end MEASUREMENT
/begin MEASUREMENT rt_2ms "" UWORD t1p0usxms 1 100 0 65.535 FORMAT "%8.5" ECU_ADDRESS 0x4047C0 /end MEASUREMENT
/begin MEASUREMENT rt_2msModAkt "" ULONG rel_uw_q0p001 1 100 0 4.29497e+006 FORMAT "%13.5" ECU_ADDRESS 0x404BCC /end MEASUREMENT
/begin MEASUREMENT rt_2mss "" ULONG rel_uw_q0p001 1 100 0 4.29497e+006 FORMAT "%13.5" ECU_ADDRESS 0x404BD0 /end MEASUREMENT
/begin MEASUREMENT rt_50ms "" UWORD t1p0usxms 1 100 0 65.535 FORMAT "%8.5" ECU_ADDRESS 0x4047C2 /end MEASUREMENT
/begin MEASUREMENT rt_50msModAkt "" ULONG rel_uw_q0p001 1 100 0 4.29497e+006 FORMAT "%13.5" ECU_ADDRESS 0x404BD4 /end MEASUREMENT
/begin MEASUREMENT rt_50mss "" ULONG rel_uw_q0p001 1 100 0 4.29497e+006 FORMAT "%13.5" ECU_ADDRESS 0x404BD8 /end MEASUREMENT
/begin MEASUREMENT rt_5ms "" UWORD t1p0usxms 1 100 0 65.535 FORMAT "%8.5" ECU_ADDRESS 0x4047C4 /end MEASUREMENT
/begin MEASUREMENT rt_5msModAkt "" ULONG rel_uw_q0p001 1 100 0 4.29497e+006 FORMAT "%13.5" ECU_ADDRESS 0x404BDC /end MEASUREMENT
/begin MEASUREMENT rt_5mss "" ULONG rel_uw_q0p001 1 100 0 4.29497e+006 FORMAT "%13.5" ECU_ADDRESS 0x404BE0 /end MEASUREMENT
/begin MEASUREMENT rt_bg "" UWORD txms_uw_q0p0004 1 100 0 26.214 FORMAT "%8.5" ECU_ADDRESS 0x4047C6 /end MEASUREMENT
/begin MEASUREMENT rt_bg_brutto "" UWORD txms_uw_q0p0032 1 100 0 209.712 FORMAT "%8.4" ECU_ADDRESS 0x4047C8 /end MEASUREMENT
/begin MEASUREMENT rt_bg_brutto_max "" UWORD txms_uw_q0p0032 1 100 0 209.712 FORMAT "%8.4" ECU_ADDRESS 0x4047CA /end MEASUREMENT
/begin MEASUREMENT rt_hw1 "" UWORD t1p0usxms 1 100 0 65.535 FORMAT "%8.5" ECU_ADDRESS 0x4047CC /end MEASUREMENT
/begin MEASUREMENT rt_hw1s "" ULONG rel_uw_q0p001 1 100 0 4.29497e+006 FORMAT "%13.5" ECU_ADDRESS 0x404BE4 /end MEASUREMENT
/begin MEASUREMENT rt_hw2 "" UWORD t1p0usxms 1 100 0 65.535 FORMAT "%8.5" ECU_ADDRESS 0x4047CE /end MEASUREMENT
/begin MEASUREMENT rt_hw2s "" ULONG rel_uw_q0p001 1 100 0 4.29497e+006 FORMAT "%13.5" ECU_ADDRESS 0x404BE8 /end MEASUREMENT
/begin MEASUREMENT rt_hw3 "" UWORD t1p0usxms 1 100 0 65.535 FORMAT "%8.5" ECU_ADDRESS 0x4047D0 /end MEASUREMENT
/begin MEASUREMENT rt_hw3s "" ULONG rel_uw_q0p001 1 100 0 4.29497e+006 FORMAT "%13.5" ECU_ADDRESS 0x404BEC /end MEASUREMENT
/begin MEASUREMENT rt_hw4 "" UWORD t1p0usxms 1 100 0 65.535 FORMAT "%8.5" ECU_ADDRESS 0x4047D2 /end MEASUREMENT
/begin MEASUREMENT rt_hw4s "" ULONG rel_uw_q0p001 1 100 0 4.29497e+006 FORMAT "%13.5" ECU_ADDRESS 0x404BF0 /end MEASUREMENT
/begin MEASUREMENT rt_ModAkt "" ULONG rel_uw_q0p001 1 100 0 4.29497e+006 FORMAT "%13.5" ECU_ADDRESS 0x404BF4 /end MEASUREMENT
/begin MEASUREMENT rt_res5v "" UWORD t1p0usxms 1 100 0 65.535 FORMAT "%8.5" ECU_ADDRESS 0x4047D4 /end MEASUREMENT
/begin MEASUREMENT rt_syn "" UWORD t1p0usxms 1 100 0 65.535 FORMAT "%8.5" ECU_ADDRESS 0x4047D6 /end MEASUREMENT
/begin MEASUREMENT rt_synModAkt "" ULONG rel_uw_q0p001 1 100 0 4.29497e+006 FORMAT "%13.5" ECU_ADDRESS 0x404BF8 /end MEASUREMENT
/begin MEASUREMENT rt_syns "" ULONG rel_uw_q0p001 1 100 0 4.29497e+006 FORMAT "%13.5" ECU_ADDRESS 0x404BFC /end MEASUREMENT
/begin MEASUREMENT rt_taskCamshaft1 "" UWORD t1p0usxms 1 100 0 65.535 FORMAT "%8.5" ECU_ADDRESS 0x4047D8 /end MEASUREMENT
/begin MEASUREMENT rt_taskCamshaft2 "" UWORD t1p0usxms 1 100 0 65.535 FORMAT "%8.5" ECU_ADDRESS 0x4047DA /end MEASUREMENT
/begin MEASUREMENT rt_taskCamshaft3 "" UWORD t1p0usxms 1 100 0 65.535 FORMAT "%8.5" ECU_ADDRESS 0x4047DC /end MEASUREMENT
/begin MEASUREMENT rt_taskCamshaft4 "" UWORD t1p0usxms 1 100 0 65.535 FORMAT "%8.5" ECU_ADDRESS 0x4047DE /end MEASUREMENT
/begin MEASUREMENT rt_taskEveryToothIntISR "" UWORD t1p0usxms 1 100 0 65.535 FORMAT "%8.5" ECU_ADDRESS 0x4047E0 /end MEASUREMENT
/begin MEASUREMENT rt_umtask "" UWORD t1p0usxms 1 100 0 65.535 FORMAT "%8.5" ECU_ADDRESS 0x4047E2 /end MEASUREMENT
/begin MEASUREMENT runtimeBoot_us "" ULONG t_q0p001_ms 1 100 0 4.29497e+006 FORMAT "%13.5" ECU_ADDRESS 0x4034D0 /end MEASUREMENT
/begin MEASUREMENT runtimeIniIni2_us "" ULONG t_q0p001_ms 1 100 0 4.29497e+006 FORMAT "%13.5" ECU_ADDRESS 0x4034D4 /end MEASUREMENT
/begin MEASUREMENT runtimeIni_us "" ULONG t_q0p001_ms 1 100 0 4.29497e+006 FORMAT "%13.5" ECU_ADDRESS 0x4034D8 /end MEASUREMENT
/begin MEASUREMENT selspcos "Auswahl Sonderverbraucher" UBYTE DEZ 1 100 0 15 FORMAT "%5.2" ECU_ADDRESS 0x40346F /end MEASUREMENT
/begin MEASUREMENT selspcos7 "" UBYTE DEZ 1 100 0 15 FORMAT "%5.2" ECU_ADDRESS 0x403470 /end MEASUREMENT
/begin MEASUREMENT selspcosme "" UBYTE DEZ 1 100 0 15 FORMAT "%5.2" ECU_ADDRESS 0x403471 /end MEASUREMENT
/begin MEASUREMENT SLSlokBits "" UWORD dez 1 100 0 65535 FORMAT "%8.2" ECU_ADDRESS 0x403778 /end MEASUREMENT
/begin MEASUREMENT soc_bila "SoC aus Bilanzierung" UWORD rel_uw_b100 1 100 0 99.9985 FORMAT "%8.5" ECU_ADDRESS 0x403484 /end MEASUREMENT
/begin MEASUREMENT soc_b_loc "lokal soc_bila f. KFSOCLF" UWORD rel_uw_b100 1 100 0 99.9985 FORMAT "%8.5" ECU_ADDRESS 0x3FE260 /end MEASUREMENT
/begin MEASUREMENT soc_fit "SoC aus der Fitformel" UWORD rel_uw_b100 1 100 0 99.9985 FORMAT "%8.5" ECU_ADDRESS 0x3FE268 /end MEASUREMENT
/begin MEASUREMENT soc_korr "Korrekturwert soc_bila" UWORD fak_q0p004_o100 1 100 -100 100 ECU_ADDRESS 0x3FE272 /end MEASUREMENT
/begin MEASUREMENT soc_quali "Z‰hler Genauigkeit Ladeztustandsbestimmung" UWORD qlad_uw_q0p0182 1 100 0 1193.03 FORMAT "%6.1" ECU_ADDRESS 0x403486 /end MEASUREMENT
/begin MEASUREMENT soc_q_kor "Korrekturwert Genauigkeit Ladezustandsbestimmung" UWORD qlad_uw_q0p0182 1 100 0 1193.03 FORMAT "%6.1" ECU_ADDRESS 0x3FE274 /end MEASUREMENT
/begin MEASUREMENT soc_q_loc "lokaler Z‰hler Genauigkeit Ladeztustandsbestimmung" UWORD qlad_uw_q0p0182 1 100 0 1193.03 FORMAT "%6.1" ECU_ADDRESS 0x3FE262 /end MEASUREMENT
/begin MEASUREMENT soc_rel "Relativz‰hler f¸r Ladezustand SoC" UWORD rel_uw_b100 1 100 0 99.9985 FORMAT "%8.5" ECU_ADDRESS 0x3FE276 /end MEASUREMENT
/begin MEASUREMENT soc_stfgk "Startf‰higkeitsgrenze" UWORD rel_uw_b100 1 100 0 99.9985 FORMAT "%8.5" ECU_ADDRESS 0x3FE278 /end MEASUREMENT
/begin MEASUREMENT soc_stfgkw "SoC Startf‰higkeit" UWORD rel_uw_b100 1 100 0 99.9985 FORMAT "%8.5" ECU_ADDRESS 0x40349E /end MEASUREMENT
/begin MEASUREMENT stpcos "Status Standverbraucher" UBYTE DEZ 1 100 0 3 FORMAT "%5.3" ECU_ADDRESS 0x403472 /end MEASUREMENT
/begin MEASUREMENT stpcos7 "lokales stpcos" UBYTE DEZ 1 100 0 3 FORMAT "%5.3" ECU_ADDRESS 0x3FE259 /end MEASUREMENT
/begin MEASUREMENT stpcosmem "" UBYTE DEZ 1 100 0 3 FORMAT "%5.3" ECU_ADDRESS 0x403473 /end MEASUREMENT
/begin MEASUREMENT synchroCtr "Synchroraster-Counter" ULONG dez 1 100 0 4.29497e+009 FORMAT "%13.2" ECU_ADDRESS 0x404BA0 /end MEASUREMENT
/begin MEASUREMENT synchroSwoffCtr "" ULONG dez 1 100 0 4.29497e+009 FORMAT "%13.2" ECU_ADDRESS 0x404BA4 /end MEASUREMENT
/begin MEASUREMENT tbatt7 "" UBYTE temp_ub_q0p75_o48 1 100 -48 125.25 FORMAT "%5.1" ECU_ADDRESS 0x403474 /end MEASUREMENT
/begin MEASUREMENT tbattkl "Batterietemperatur f¸r KL" UBYTE temp_ub_q0p75_o48 1 100 -48 143.25 FORMAT "%5.1" ECU_ADDRESS 0x40377C /end MEASUREMENT
/begin MEASUREMENT te2_l "effektive Einspritzzeit (long), Bank 2" ULONG t1p0usxms 1 100 0 450 FORMAT "%13.9" ECU_ADDRESS 0x404A58 /end MEASUREMENT
/begin MEASUREMENT te2_w "Effektive Einspritzzeit Bank2 (word)" UWORD t8p0usxms 1 100 0 524.28 FORMAT "%8.4" ECU_ADDRESS 0x404664 /end MEASUREMENT
/begin MEASUREMENT tevfa2_l "effektive Einspritzzeit vor Feinabgleich (longword) Bank 2" ULONG t1p0usxms 1 100 0 450 FORMAT "%13.9" ECU_ADDRESS 0x404A5C /end MEASUREMENT
/begin MEASUREMENT tevfa_l "effektive Einspritzzeit vor Feinabgleich (longword)" ULONG t1p0usxms 1 100 0 450 FORMAT "%13.9" ECU_ADDRESS 0x404A60 /end MEASUREMENT
/begin MEASUREMENT tez_l "effektive Einspritzzeit (long) zylinderindividuell" ULONG t1p0usxms 1 100 0 450 FORMAT "%13.9" ARRAY_SIZE 8 ECU_ADDRESS 0x404A64 /end MEASUREMENT
/begin MEASUREMENT te_l "effektive Einspritzzeit (long)" ULONG t1p0usxms 1 100 0 450 FORMAT "%13.9" ECU_ADDRESS 0x404A84 /end MEASUREMENT
/begin MEASUREMENT te_w "Effektive Einspritzzeit (word)" UWORD t8p0usxms 1 100 0 524.28 FORMAT "%8.4" ECU_ADDRESS 0x404666 /end MEASUREMENT
/begin MEASUREMENT tsaisonalt "letzter Wert Saisontemperatur" UWORD temp_uw_q0p003_o48 1 100 -48 148.605 ECU_ADDRESS 0x4034A0 /end MEASUREMENT
/begin MEASUREMENT tsocloc "Batterietemperatur zum Zeitpunkt der Ruhespannungsmessung (lokal)" UBYTE temp_ub_q0p75_o48 1 100 -48 143.25 FORMAT "%5.1" ECU_ADDRESS 0x40348E /end MEASUREMENT
/begin MEASUREMENT tvu_w "Batteriespannungskorrektur" UWORD t1p0usxms 1 100 0 65.535 FORMAT "%8.5" ECU_ADDRESS 0x404668 /end MEASUREMENT
/begin MEASUREMENT t_bnmotakt "Zeit nachdem der Motor laeuft, hoert nach T_B_NMOT Sekunden auf." UBYTE t_q1 1 100 0 255 FORMAT "%5.1" ECU_ADDRESS 0x4033D0 /end MEASUREMENT
/begin MEASUREMENT t_delta "Zeit, seit letzem Prozessaufruf" UBYTE t_q1 1 100 0 255 FORMAT "%5.1" ECU_ADDRESS 0x4033D1 /end MEASUREMENT
/begin MEASUREMENT t_saison "Saison -Temperatur" UWORD temp_uw_q0p003_o48 1 100 -48 148.605 ECU_ADDRESS 0x3FE27A /end MEASUREMENT
/begin MEASUREMENT ubatt0 "Aus Wertetripel ausgew‰hlter Ruhespannungswert" UWORD spg_uw_q0p25em3_o6 1 100 6 22.3837 FORMAT "%9.6" ECU_ADDRESS 0x403488 /end MEASUREMENT
/begin MEASUREMENT ubatts2 "Hilfswert2 Spannung aus Fitberechnung" UWORD spg_uw_q0p25em3_o6 1 100 6 16 FORMAT "%9.6" ECU_ADDRESS 0x4047A8 /end MEASUREMENT
/begin MEASUREMENT ubattsoll "Batteriesollspannung aufgrund Batterietemperatur und Batt.-ladezustand" UWORD spg_uw_q0p25em3_o6 1 100 6 16 FORMAT "%9.6" ECU_ADDRESS 0x4033CE /end MEASUREMENT
/begin MEASUREMENT ubattsoll7 "lokales ubattsoll" UBYTE spg_ub_q0p064_o6 1 100 6 17.008 ECU_ADDRESS 0x4033D2 /end MEASUREMENT
/begin MEASUREMENT ubatt_w7 "" UWORD spg_uw_q0p25em3_o6 1 100 6 16 FORMAT "%9.6" ECU_ADDRESS 0x40342C /end MEASUREMENT
/begin MEASUREMENT ubdiff "" UWORD spg_q0p977em3_om32 1 100 -32 31.999 FORMAT "%9.6" ECU_ADDRESS 0x40342E /end MEASUREMENT
/begin MEASUREMENT ubdiff2pi "Ubatt-Differenz-Gewichtung auf Prios" UWORD fak_uw_q0p25o500 1 100 -100 100 FORMAT "%9.5" ECU_ADDRESS 0x403430 /end MEASUREMENT
/begin MEASUREMENT ubdifffilt "Differenz von ubattsoll(Temperatur,Soc) und ubatt aktuell." UWORD spg_q0p977em3_om32 1 100 -32 31.999 FORMAT "%9.6" ECU_ADDRESS 0x403432 /end MEASUREMENT
/begin MEASUREMENT ubdiffptc "Differenz zw. Ubatt_soll und Ubatt_w" UWORD spg_q0p977em3_om32 1 100 -32 31.999 FORMAT "%9.6" ECU_ADDRESS 0x403434 /end MEASUREMENT
/begin MEASUREMENT ubt "Gibt die momentane Batteriespannung an." UWORD spg_uw_q0p015 1 100 0 61.425 FORMAT "%9.6" ECU_ADDRESS 0x403436 /end MEASUREMENT
/begin MEASUREMENT ubt7 "" UWORD spg_uw_q0p015 1 100 0 61.425 FORMAT "%9.6" ECU_ADDRESS 0x403438 /end MEASUREMENT
/begin MEASUREMENT ubt7mem "" UWORD spg_uw_q0p015_o491 1 100 -61.425 61.425 FORMAT "%9.6" ECU_ADDRESS 0x40343A /end MEASUREMENT
/begin MEASUREMENT ubt7old "" UWORD spg_uw_q0p015 1 100 0 61.425 FORMAT "%9.6" ECU_ADDRESS 0x40343C /end MEASUREMENT
/begin MEASUREMENT ubtpt12ptc "Ubatt Gewichtung f¸r PTC Ansteuerung" UWORD fak_uw_q0p25o500 1 100 -100 100 FORMAT "%9.5" ECU_ADDRESS 0x40343E /end MEASUREMENT
/begin MEASUREMENT ubtpt1ptc "PT1 gefiltertes Ubatt f¸r PTC Ansteuerung" UWORD spg_q0p977em3_om32 1 100 -32 31.999 FORMAT "%9.6" ECU_ADDRESS 0x403440 /end MEASUREMENT
/begin MEASUREMENT ub_old "" UBYTE spg_ubatt 1 100 0 24.021 FORMAT "%5.2" ECU_ADDRESS 0x4034A3 /end MEASUREMENT
/begin MEASUREMENT udelta "Delta zw. Battsollspg und Battspg" SBYTE spg_q0p064 1 100 -8.192 8.128 FORMAT "%7.5" ECU_ADDRESS 0x4033D3 /end MEASUREMENT
/begin MEASUREMENT udeltaabs "Absolutwert von udelta" UBYTE spg_q0p064 1 100 0 16.32 ECU_ADDRESS 0x4033D4 /end MEASUREMENT
/begin MEASUREMENT udeltaabsc "" ULONG spg_uw_q0p015 1 100 0 61.425 FORMAT "%9.6" ECU_ADDRESS 0x403444 /end MEASUREMENT
/begin MEASUREMENT udeltac "" UWORD spg_uw_q0p015_o491 1 100 -491.505 491.52 FORMAT "%9.5" ECU_ADDRESS 0x403442 /end MEASUREMENT
/begin MEASUREMENT ugenslp "Generatorsollspannung bei SLP-Betrieb" UWORD spg_sw_q0p001 1 100 0 16 FORMAT "%8.5" ECU_ADDRESS 0x40377A /end MEASUREMENT
/begin MEASUREMENT uibs "Generatorspannungsvorgabe von IBS" UBYTE spg_gencan 1 100 10.6 16.975 FORMAT "%5.2" ECU_ADDRESS 0x4033D5 /end MEASUREMENT
/begin MEASUREMENT uibs7 "lokales uibs" UBYTE spg_gencan 1 100 10.6 16.975 FORMAT "%5.2" ECU_ADDRESS 0x4033D6 /end MEASUREMENT
/begin MEASUREMENT ulev "Spannungsebene" UBYTE DEZ 1 100 0 15 FORMAT "%5.2" ECU_ADDRESS 0x403475 /end MEASUREMENT
/begin MEASUREMENT ulev7 "lokales ulev" UBYTE DEZ 1 100 0 15 FORMAT "%5.2" ECU_ADDRESS 0x403476 /end MEASUREMENT
/begin MEASUREMENT ulevmem "" UBYTE DEZ 1 100 0 15 FORMAT "%5.2" ECU_ADDRESS 0x403477 /end MEASUREMENT
/begin MEASUREMENT ulow "Unterspannungsstatus : 0=i.O, 1=in between, 2=unterspannung" UBYTE DEZ 1 100 0 255 FORMAT "%5.1" ECU_ADDRESS 0x403478 /end MEASUREMENT
/begin MEASUREMENT ulowtimer "Zeit zur Unterspannungserkennung * Taskzeit (50*100ms = 5sec)" UBYTE t_q0p1 1 100 0 25.5 FORMAT "%5.2" ECU_ADDRESS 0x403479 /end MEASUREMENT
/begin MEASUREMENT u_grenz "Grenzwert Spannung" UBYTE spg_ub_q0p064_o6 1 100 6 22.32 ECU_ADDRESS 0x4039AE /end MEASUREMENT
/begin MEASUREMENT Vsa_vzt "" UBYTE dez 1 100 0 255 FORMAT "%5.1" ECU_ADDRESS 0x4036A2 /end MEASUREMENT
/begin MEASUREMENT Vsa_vzz "Erfolgte Anzahl an Nachtriggerungen (Einlaﬂseite)" UBYTE dez 1 100 0 255 FORMAT "%5.1" ECU_ADDRESS 0x4036A3 /end MEASUREMENT
/begin MEASUREMENT Vse_admn "" UWORD sprzi_q0p1 1 100 0 180 FORMAT "%8.4" ECU_ADDRESS 0x40485E /end MEASUREMENT
/begin MEASUREMENT Vse_sprn "Normspreizung Einlass" UWORD sprzi_q0p1 1 100 0 6553.5 FORMAT "%8.3" ECU_ADDRESS 0x404860 /end MEASUREMENT
/begin MEASUREMENT Vse_vzt "" UBYTE DEZ 1 100 0 255 FORMAT "%5.1" ECU_ADDRESS 0x4036A4 /end MEASUREMENT
/begin MEASUREMENT Vse_vzz "Erfolgte Anzahl an Nachtriggerungen (Auslaﬂseite)" UBYTE DEZ 1 100 0 255 FORMAT "%5.1" ECU_ADDRESS 0x4036A5 /end MEASUREMENT
/begin MEASUREMENT Wnwllkh_aus "" UBYTE fakspr_q0p0039 1 100 0 0.996094 ECU_ADDRESS 0x4039E3 /end MEASUREMENT
/begin MEASUREMENT Wnwll_aus "Wichtungsfaktor zur Auswahl der LL KF im Normalbetr. oder zum Katheizen" UBYTE fakspr_q0p0039 1 100 0 0.996094 ECU_ADDRESS 0x4039E4 /end MEASUREMENT
/begin MEASUREMENT wnwsmn "minimaler Einlassollspreizung mit Adaptionsgrenze" UWORD sprzi_q0p1 1 100 0 180 FORMAT "%8.4" ECU_ADDRESS 0x404862 /end MEASUREMENT
/begin MEASUREMENT zwnll_aus "Zeitkonst. f¸r TP Sollwertbed‰mpfung (Ein- und Auslass) nach Motorstart" UBYTE fak_ub_b1 1 100 0 0.996094 ECU_ADDRESS 0x4039E5 /end MEASUREMENT
/begin MEASUREMENT zzbank "Zylinderzuordnung zu Einspritzb‰nken" UBYTE dez 1 100 0 255 FORMAT "%5.1" ECU_ADDRESS 0x4034DC /end MEASUREMENT
/begin FUNCTION PMPRSVCALC "1.60"
 /begin DEF_CHARACTERISTIC ARY_PRIO ARY_PRIOCF ARY_PWRCF ARY_PWRDF B_ULCPAPP CTRCBRA CTRCBRAPP CTRPCOSAPP CTRPRIOAPP CTRPWSA C_RESET_PI DFFGENAPP DFFILTAPP DFMAX DFMIN DSOCHYST DSOCPCOS EHZOLDAPP HKW_dT HKW_IKL2 HKW_ING2 HKW_IPG2 HKW_IWIN2 HKW_NSTMX2 HKW_PIMAX2 HKW_PKL2 HKW_PNG2 HKW_PPG2 HKW_PSTMX2 HKW_PWIN2 HKW_TGL2 HKW_TRGL2 IBATTAPP IBFBSDAPP IBSWAKEAPP IFBSAKAPP IFUPLAKAPP KBMCNT_APP KDFPTC_LP KF_IBTSOLL KLHKWN2 KLPRIO2PTC KL_DFPRIO KL_DFPTC KL_DSOCPRIO KL_DSOCPTC KL_I2PTC KL_IREST KL_ISOLLPR KL_PTC KL_SOCPRIO KL_UBTPRIO KL_UB_PTC KUBPTC_LP K_DF_LP K_PTC_PI K_PWRDF_PI K_UBAT_LP LLPMFILTK MN_PTC_PI MN_PWRDFPI MX_PTC_PI MX_PWRDFPI PCOSCHGAPP PRIOCFAPP PTCPWRAPP PWRCOSAPP PWRSPCSAPP RQPCOSA RQPCOSAPP SELSPCOSA SELSPCSAPP STPCOSAPP S_E65PRIO S_IBFBSD7 S_IFBSAK7 S_IFUPLAK7 S_PCOSCHG S_PMMESS S_PRIO_E60 S_PRIO_E65 S_PTCOLMAN S_PTC_OLD S_ULCP TBATTAPP T_PMBS T_PMVS T_PTC_PI T_PWRDF_PI UBATTAPP UBTAPP UBTLOWMAX UBTLOWMIN ULEVA ULEVAPP ULOWSETAPP WGH_PRIO WGH_PRIOCF WGH_PWRCF WGH_PWRDF /end DEF_CHARACTERISTIC
 /begin IN_MEASUREMENT B_fapmmess B_genfprl B_ibfbsd B_ifbsak B_ifebsak B_ifisak B_ifsysak B_iftempak B_ifuplak B_ifusak B_kl15 B_nmot B_pcoschg B_soc_npl B_startfgk B_ulcp dffgen d_soc genitemp ibatt_w nmot_w st_i_gen tbatt ubattsoll ubatt_w /end IN_MEASUREMENT
 /begin OUT_MEASUREMENT allptcfilt B_enwakeup B_pmbsdanf B_pmvsdanf ctrcbr ctrpcos ctrprio ctrpriocf ctrpwrcos ctrpwspcos dfallpi dfgenfilt dfprio dfpt1filt dfpt1ptc ibtdiff isolldiff pgenrest ptc_pwr rqpcos selspcos stpcos ubdifffilt ubt ubtpt1ptc ulev /end OUT_MEASUREMENT
 /begin LOC_MEASUREMENT all2ptc B_dubt B_enwake7 B_gendef B_ibfbsd7 B_ifbsak7 B_ifuplak7 B_kl15_old B_limcalc B_notlauf B_pcoschg7 B_PIReset B_ubtlow B_ulcp7 B_uloreset ctrcbr7 ctrcbrmem ctrpcos7 ctrpcosmem ctrprio7 ctrpriocf7 ctrpriocfm ctrpriomem ctrpwrcf ctrpwrcos7 ctrpwrdf ctrpwrmem ctrpwspcs7 df2pi dfall2pi dffgen7 dff_filt7 dfpi2ptc dfpt1_2ptc dsoc2pi dsoc2ptc ehz_pwloc2 hkw_iant2 hkw_ki2 hkw_kp2 hkw_lpgv2 hkw_pant2 hkw_pi2 hkw_rdiff2 hkw_sel_i2 hkw_sel_p2 hkw_sv2 ibatt_w7 ibtdiff2pi ibtsoll idiff2ptc igenrest ind_priocf ind_priodf ind_pwrcf ind_pwrcos isoll kbmcount mem memprio1 memprio2 memptc1 memptc2 pgen2ptc picntr pmbscount pmvscount ptc_pwr7 rqpcos7 rqpcosmem selspcos7 selspcosme stpcos7 stpcosmem tbatt7 ubatt_w7 ubdiff ubdiff2pi ubdiffptc ubt7 ubt7mem ubt7old ubtpt12ptc udeltaabsc udeltac ulev7 ulevmem ulow ulowtimer /end LOC_MEASUREMENT
/end FUNCTION
/begin FUNCTION PMSOCCALC "1.40"
 /begin DEF_CHARACTERISTIC CBATT_DEF IB_COMMVAL KFSOC0UBIB KFSOCLF KLSOC0TEMP PMQ_UX QSOCCL1 QSOCCL2 Q_BILAPWF SOC_BILAWA SOC_QUALIA SOC_Q_PWF S_BSOCCALC S_SOC_BILA S_SOC_QUAL /end DEF_CHARACTERISTIC
 /begin IN_MEASUREMENT B_ibspwf B_pwf cbattnenn ibs_msgind ibs_msgrdy ibs_msgsta ibs_msgwri ibs_start isoc0 qelad qeladsoc0 qlad qladsoc0 tbatt tbattsoc0 u1soc0 u2soc0 u3soc0 /end IN_MEASUREMENT
 /begin OUT_MEASUREMENT isoc0loc kalevcnt soc_bila soc_quali tsocloc /end OUT_MEASUREMENT
 /begin LOC_MEASUREMENT B_ibspwf_e B_soccalc B_soc_pwf cbatt_lo d_qelad d_qlad ib_commcnt ib_commsta qeladold qladold q_bila soc_b_loc soc_q_loc ubatt0 /end LOC_MEASUREMENT
/end FUNCTION
/begin FUNCTION PMSOCFIT "1.50"
 /begin DEF_CHARACTERISTIC KFPMRIBAT1 KFPMRIBAT2 KFPMRIBAT3 KFPMRIBAT4 KFPMRIBAT5 KFPMRIBAT6 KFPMRIBAT7 KFPMRIBAT8 KLPMSOCVU SOCFITAPP S_PMSOCFIT ZK_PMSOC /end DEF_CHARACTERISTIC
 /begin REF_CHARACTERISTIC I_FIT_AUSW /end REF_CHARACTERISTIC
 /begin IN_MEASUREMENT batt_index ibatt_w soc_rel tbatt ubatt_w /end IN_MEASUREMENT
 /begin OUT_MEASUREMENT soc_fit /end OUT_MEASUREMENT
 /begin LOC_MEASUREMENT ubatts2 /end LOC_MEASUREMENT
/end FUNCTION
/begin FUNCTION PMSOCKOR "1.40"
 /begin DEF_CHARACTERISTIC ABSCHKORA BILA_OGRZ BILA_UGRZ DSOCA DSOCABSCH D_AB_KORR1 D_AB_KORR2 D_AB_KORR3 I_FIT_AUSW KL_SSOC PMTIMERSQ1 PM_TABSMN QSOCCL3 QSTARTFGA SOCFITABW SOCFITGRZ SOC_STAFGA S_ABSCHK S_DSOCS S_PMTABSMN S_QSTARTFK S_SOCSTAFK TSAISONFIL /end DEF_CHARACTERISTIC
 /begin REF_CHARACTERISTIC QSOCCL1 QSOCCL2 /end REF_CHARACTERISTIC
 /begin IN_MEASUREMENT B_pmsqrdy B_pmstartq B_pwf cbattnenn ibatt_w ibs_msgind ibs_msgsta ibs_msgwri ibs_start soc_bila soc_fit soc_quali tabsmn_w tbatt_max tbatt_min /end IN_MEASUREMENT
 /begin OUT_MEASUREMENT B_soc_npl d_soc q_startfgk soc_rel soc_stfgk t_saison /end OUT_MEASUREMENT
 /begin LOC_MEASUREMENT absch_korr B_abschfit B_pmsocini B_pm_fit2 B_pm_fit3 B_q_start d_socw d_socw_1 pmsoc_help pm_ibslog pm_tsrdy soc_korr soc_q_kor soc_stfgkw tsaisonalt /end LOC_MEASUREMENT
/end FUNCTION
/begin FUNCTION PMSOCSTART "1.50"
 /begin DEF_CHARACTERISTIC KLUNSTART KLUTSTART RIN_GRENZ1 RIN_GRENZ2 RIN_GRENZ3 RIN_GRENZ4 RIN_GRENZ5 RIN_GRENZ6 RIN_GRENZ7 RIN_GRENZ8 S_PMSTARTQ S_PM_TEST1 S_RIN S_STARTAW TIME_START UB_GRENZ USTARTGRZ /end DEF_CHARACTERISTIC
 /begin IN_MEASUREMENT batt_index B_nmot B_strtaw ibs_msgind ibs_msgrdy ibs_msgsta ibs_msgwri ibs_start itnstart ivorstart nmot_w tbatt ub utnstart uvorstart /end IN_MEASUREMENT
 /begin OUT_MEASUREMENT B_pmsqrdy B_pmstartq /end OUT_MEASUREMENT
 /begin LOC_MEASUREMENT B_resetsta B_start idelta nnmstart pmstartsta rin_grenzh rin_start ub_old u_grenz /end LOC_MEASUREMENT
/end FUNCTION
/begin FUNCTION PMUGENCALC "1.40"
 /begin DEF_CHARACTERISTIC B_IFBSAAPP B_IFUPLAPP DFOVERRIDE KFUSOLL KLUSOLL PMUBAT_MAX PMUBAT_MIN PMUGEN_MAX PMUGEN_MIN S_B_IFBSAC S_B_IFUPLA S_UIBS T_B_NMOT T_PMUGEN UGENNORM UIBSAPP USTEPMIN /end DEF_CHARACTERISTIC
 /begin IN_MEASUREMENT B_genfprl B_ibfbsd B_ifbsak B_ifebsak B_ifsysak B_iftempak B_ifuplak B_ifusak B_nmot B_soc_npl dfgenfilt soc_rel tbatt ubatt_w /end IN_MEASUREMENT
 /begin OUT_MEASUREMENT ubattsoll uibs /end OUT_MEASUREMENT
 /begin LOC_MEASUREMENT B_genclcon B_ifbsk7 B_ifplak7 t_bnmotakt t_delta ubattsoll7 udelta udeltaabs uibs7 /end LOC_MEASUREMENT
/end FUNCTION
/begin FUNCTION PROCESS "" /begin IN_MEASUREMENT B_nachl B_nachlauf B_norm B_wakeup codcan nmot /end IN_MEASUREMENT
 /begin OUT_MEASUREMENT bgCtr bg_predrive_Ctr bg_swoff_Ctr dlOvrunCtr fcmclrCtr firstsynchroCtr hw1Ctr hw2Ctr hw3Ctr hw4Ctr ini1_predrive_Ctr ini2_predrive_Ctr inisynchroCtr inisynct_w r1000msCtr r1000ms_predrive_Ctr r1000ms_swoff_Ctr r100msCtr r100ms_predrive_Ctr r100ms_swoff_Ctr r10msCtr r10ms_predrive_Ctr r10ms_swoff_Ctr r1msCtr r1ms_all_Ctr r1ms_predrive_Ctr r1ms_swoff_Ctr r200msCtr r200ms_predrive_Ctr r200ms_swoff_Ctr r20msCtr r20ms_predrive_Ctr r20ms_swoff_Ctr r2msCtr r2ms_predrive_Ctr r2ms_swoff_Ctr r50msCtr r50ms_predrive_Ctr r50ms_swoff_Ctr rasfak synchroCtr synchroSwoffCtr /end OUT_MEASUREMENT
 /begin LOC_MEASUREMENT runtimeBoot_us runtimeIniIni2_us runtimeIni_us /end LOC_MEASUREMENT
/end FUNCTION
/begin FUNCTION PROKON "110.50    Projektkonfiguration"
 /begin DEF_CHARACTERISTIC CDAGR CDDMTL CDDYLSU CDEFST CDHELSU CDHRLSU CDHRLSUE CDHSH CDHSHE CDHSV CDHSVSA CDICLSU CDKAT CDKATSP CDKATSPF CDKVS CDLASH CDLDP CDLLR CDLSH CDLSV CDLSVV CDMD CDNWS CDPLLSU CDSALSU CDSLS CDSLSFZ CDSWE CDTANKL CDTES CDULSU CWALE CWBDE1 CWCODCAN CWCODFZG CWERFIL CWGEN CWGEN1 CWGEN2 CWKMMILSCT CWKONABG CWKONFLS CWKONLS CWLSHA CWMDAPP CWMDKOL CWNSABG CWOBD CWPSGER CWPWF CWSCTMDE CWSLS CWSLS2 CWTF CWUHR CWVL ENAPPULCP FZG_ON NSWO NSWO1 /end DEF_CHARACTERISTIC
 /begin IN_MEASUREMENT B_ibsdetec nmot /end IN_MEASUREMENT
 /begin OUT_MEASUREMENT B_abstnl B_auakt B_cdagr B_cdanws B_cddmtl B_cddylsu B_cdenws B_cdfst B_cdhelsu B_cdhrlsu B_cdhrlsue B_cdhsh B_cdhshe B_cdhsv B_cdhsvsa B_cdiclsu B_cdkat B_cdkatsp B_cdkatspf B_cdkatspt B_cdkvs B_cdlash B_cdldp B_cdllr B_cdlsh B_cdlsv B_cdlsvv B_cdmd B_cdnozwte B_cdpllsu B_cdsalsu B_cdsls B_cdswe B_cdtankl B_cdtes B_cdulsu B_cdvvnw B_cwlshdyn B_cwlshmf B_cwlshsch B_cwlshvl B_cwmdkol B_ecodcan B_esbhap B_etol B_fphubap B_fpwdkap B_fzg_on B_gen1 B_gen2 B_hubap B_katfz B_kmmilsct B_lsh B_lsh2 B_lsv B_lsv2 B_mde8e B_mde9e B_mrfavl B_ndsav B_nokatfz B_nswo1 B_nswo2 B_psapp B_psger B_slpvar B_slsfz B_slvvar B_tfu B_uhrrmin B_uhrrsec B_ulcp B_wdksapcw B_zwappl cd_bits1_w cd_bits2_w codcan codcancpl codfzg cw_erfil lv_var_bn lv_var_veh prokonAusBitsNov1 zzbank /end OUT_MEASUREMENT
/end FUNCTION
/begin FUNCTION RESET_MON ""
 /begin OUT_MEASUREMENT dr_reg_resetBuffer dr_reg_resetBuffer_cnt dr_reg_resetBuffer_idx dr_reg_resetTimestampBuffer dr_reg_resetTimestampBuffer_idx /end OUT_MEASUREMENT
/end FUNCTION
/begin FUNCTION restgas "restgas.exported"
 /begin DEF_CHARACTERISTIC ASPRNOTL ASPSAN CWNLDGRSTG DNMOTGLUE DTMSPR DWKRMGLUE ESPRNOTL ESPSAN FASTW FASW FESTW FESW KFALLW KFASPGLUE KFDASTD KFDASTDLL KFDESTD KFDESTDLL KFELLW KFESPGLUE KFKALLW KFKASOPT KFKASOPU KFKELLW KFKESOPT KFKESOPU KFWALLW KFWASLL KFWASOPT KFWASOPU KFWASVL KFWASVLT KFWELLW KFWESLL KFWESOPT KFWESOPU KFWESVL KFWESVLT KFWNWLL KFWNWLLKH KLASPVZ KLESPVZ KLWASLLM KLWESLLM MDAPPAS MDAPPES NMOTGLUE OFASPRAP OFESPRAP PT1SPR RESTNMOT_W RESTRLVW_W S_ASPSATRU S_ESPSATRU TMASPR TMESPR TSPSAON TVASPSA TVESPSA VNS_VZD VNS_VZZMX VNS_WTZ WKRMGLUE WNWAIMN WNWMN ZWNLL /end DEF_CHARACTERISTIC
 /begin REF_CHARACTERISTIC SPRZG_AN /end REF_CHARACTERISTIC
 /begin IN_MEASUREMENT B_btvsa B_btvse B_gd B_kl15 B_ll B_nldg B_sa B_stend B_vl B_vvtnotl dpsfak dpssol_uw E_vvt_vsa E_vvt_vse minhub_w nmot nmot_w rlvwvns_w rlvw_w rl_w tmot tnst_w Vsa2spri Vsa_btsoll Vsa_spri Vsa_sprs Vse2adp Vse2spri Vse_adp Vse_btsoll Vse_spri Vse_sprs wkrm /end IN_MEASUREMENT
 /begin OUT_MEASUREMENT Aspr Asprl Asprlu B_glue B_nvsaad B_nvsead B_wnwmnbe Espr Esprl Esprlu esst_sst_restgas12_nmot_w esst_sst_restgas12_rlvw_w esst_sst_restgas16_nmot_w esst_sst_restgas16_rlvw_w Fastw_aus Festw_aus Vse_sprn /end OUT_MEASUREMENT
 /begin LOC_MEASUREMENT Allk Allw Ask Asprimx Asprt Aspru Astk Astw Asw B_aspan B_espan B_vsast B_vsest B_vzare B_vzere dastd dastdll destd destdll Ellk Ellw Esk Esprimx Esprt Espru Estk Estw Esw Eswll Fasw_aus Fesw_aus rlvwrstg_w RSThyst1 RSThyst2 Vsa_vzt Vsa_vzz Vse_admn Vse_vzt Vse_vzz Wnwllkh_aus Wnwll_aus wnwsmn zwnll_aus /end LOC_MEASUREMENT
/end FUNCTION
/begin FUNCTION RKTE "2.80      Berechnung effektive Einspritzdauer aus relativer Kraftstoffmasse rk"
 /begin DEF_CHARACTERISTIC CWPKAPP DTEMN FKKVS FRHOKRSTTE FRLFSDP KLKRKTE PSAPES TEMIN TVUB /end DEF_CHARACTERISTIC
 /begin IN_MEASUREMENT B_stend dpsddss_w evz_austot fkez ps_w rk2_w rkwez_w rk_w tkrst ub vsfpses vsskrst /end IN_MEASUREMENT
 /begin OUT_MEASUREMENT B_temin B_temin2 frkte_w krkte_w rkteAusBitssyn te2_l te2_w tez_l te_l te_w tvu_w /end OUT_MEASUREMENT
 /begin LOC_MEASUREMENT dpus_w fhkrst_w frlfsdp_w ftek2_w ftek_w i_zyl pses_w tevfa2_l tevfa_l /end LOC_MEASUREMENT
/end FUNCTION
/begin FUNCTION RUNTIME "" /begin DEF_CHARACTERISTIC CWRTFSGID CWRTFSGMEM CWRTFSGMOD PERF_MAXRST /end DEF_CHARACTERISTIC /begin IN_MEASUREMENT nmot /end IN_MEASUREMENT
 /begin OUT_MEASUREMENT common_rt FsgIdCounter FsgIdMemCounter FsgMemCounter performance performance_max rt_1000ms rt_100ms rt_100msModAkt rt_100mss rt_10ms rt_10msModAkt rt_10mss rt_1ms rt_1msModAkt rt_1mss rt_200ms rt_20ms rt_20msModAkt rt_20mss rt_2ms rt_2msModAkt rt_2mss rt_50ms rt_50msModAkt rt_50mss rt_5ms rt_5msModAkt rt_5mss rt_bg rt_bg_brutto rt_bg_brutto_max rt_hw1 rt_hw1s rt_hw2 rt_hw2s rt_hw3 rt_hw3s rt_hw4 rt_hw4s rt_ModAkt rt_res5v rt_syn rt_synModAkt rt_syns rt_taskCamshaft1 rt_taskCamshaft2 rt_taskCamshaft3 rt_taskCamshaft4 rt_taskEveryToothIntISR rt_umtask /end OUT_MEASUREMENT
/end FUNCTION
/begin FUNCTION SALSU "100.10    Schubabgleich LSU" /begin IN_MEASUREMENT o2vk2_w o2vk_w /end IN_MEASUREMENT /begin OUT_MEASUREMENT ko2vk2_w ko2vk_w o2adap2_w o2adap_w /end OUT_MEASUREMENT /end FUNCTION
/begin FUNCTION SG_IDENT "" /begin DEF_CHARACTERISTIC CODINDEX dataID /end DEF_CHARACTERISTIC /end FUNCTION
/begin FUNCTION SLS "116.50    Sekund‰rluftsteuerung"
 /begin DEF_CHARACTERISTIC ANZSLPMX CWFASL DPSLV FMSL FMSL2 FMSLOFF FMSRHOL FMSTMOT IMLSLMN IMLSLMX IMLSLSA IMLSLSE KFFMSML KLRLSLSMX KLTSLMX MLSLMX MSLUB TASLSO TASLSU TDDSLA TDSLKT TDWHSLPKH TFASLAMN TLMSSLAB TLMSSLMX TMFASLMN TMSSLO TMSSLSTO TMSSLSTU TMSSLU TSLABB TSLPMN TSLUBST TVDSLOFF TVSLVOFF TVSLVON TWSLPENA TWSLPFA TWSLPOFF UBSLMN UBSLMX UBSLSTMN VSLS ZFLMSSL ZKSLPOFF ZKSLPON ZKSLSOFML ZKSLSONML /end DEF_CHARACTERISTIC
 /begin REF_CHARACTERISTIC CWDSLSAD CWSLS CWSLS2 /end REF_CHARACTERISTIC
 /begin IN_MEASUREMENT B_atmtpl B_brems B_dslfa B_dslsp4 B_dspe B_dwg B_fa B_fasls B_fs B_kh B_kha B_khab B_kuppl B_ll B_mslmn B_nmot B_sla B_slsfz B_st B_stend fmsla fmsla2 frhol_w imlpr mlbb2_w mlbb_w ml_w nmot ps_w pu rl rlsol_w statetwslp tans tmot tmst tnst_w twslp_w ubsqf_w vfzg /end IN_MEASUREMENT
 /begin OUT_MEASUREMENT anzslp B_anzslpmx B_fasla B_lmsslof B_msloff B_mslon B_slkhof B_slp B_slpmn B_slpoff B_sls B_slsadap B_slsoab B_slsoff B_slv flamsl2_w flamsl_w flmssl fmsldyn fmslrho fslpdyn msl msl2 msl2_w mslstat msl_w /end OUT_MEASUREMENT
 /begin LOC_MEASUREMENT B_dslreset B_dslset B_sldsl4 B_slkt B_slpena B_slpofst B_slsdis B_slserr B_whslpkh fmsagd fmsltm imlsla_w imlsle_w mslpub SLSlokBits /end LOC_MEASUREMENT
/end FUNCTION
/begin FUNCTION SLSUGEN "1.20" /begin DEF_CHARACTERISTIC KLFGENSLP KLUBATTMAX S_ENGENSLP U_GENSLP /end DEF_CHARACTERISTIC
 /begin IN_MEASUREMENT B_dslfa B_fasls B_slp codcan codfzg imlpr tbatt tbattpm tbatt_lb /end IN_MEASUREMENT
 /begin OUT_MEASUREMENT B_genslp ugenslp /end OUT_MEASUREMENT
 /begin LOC_MEASUREMENT tbattkl /end LOC_MEASUREMENT
/end FUNCTION
/begin FUNCTION SREAKT "7.70      EGAS: Sicherheitskonzept, Fehlerreaktionen"
 /begin IN_MEASUREMENT B_appnolu B_dkp1e B_dkp2e B_dkpaw B_dlrbe B_dlrpide B_fproab B_fprzab B_i_ska_um B_nlpne B_ubdve B_ub_ok B_umauab B_wdksive /end IN_MEASUREMENT
 /begin OUT_MEASUREMENT B_dknolu B_dknot B_dkpiu B_dkpru B_dkpu B_i_ska_fr B_notlu_fr /end OUT_MEASUREMENT
 /begin LOC_MEASUREMENT B_dkunb /end LOC_MEASUREMENT
/end FUNCTION
/begin FUNCTION SSTBER "1.10"
 /begin DEF_CHARACTERISTIC SAN12ESUW SDM05TESB SEH06KRUW SEZ06TMUB SFR04BBUW SGA07MDUB SGA08MDUB SKS06ESUB SLX06TMUW SLY06TMUW SML06TEUB SML06TMUW SML07TMUW SML08LHUB SN16KR1UB SN16KR2UB SNG06LLSB SNG06LLTSB SNM04TEUB SNM06LLUB SNM06MDUW SNM07ESUB SNM07LSUW SNM08GKUB SNM08KRUW SNM08LHUB SNM08__UB SNM10LSUB SNM12ESUB SNM12FEUB SNM16KRUB SNM16OPUW SNM16ZUUB SNM24ZUUB SQM05TEUB SRL04KRUB SRL06ZUUB SRL08GKUB SRL08LSUW SRL10LSUB SRL12ESUB SRL12ZUUB SRL16ZUUB ST107TMUB ST207TMUB ST307TMUB ST407TMUB STA04SAUB STA06ESUB STM04FEUB STM04SAUB STM05SAUB STM05TMUB STM06LLTUB STM06LLUB STM06__UB STM08BBUB STM08MDUB STM09ESUB STM12ESUB STS12ESUB SWD06KRSW /end DEF_CHARACTERISTIC
 /begin REF_CHARACTERISTIC S_ZNDRLP /end REF_CHARACTERISTIC
 /begin IN_MEASUREMENT anztib_w dmssginr etazwimt evhubi_w frhol_w gangi kstaa lamsbg2_w lamsbg_w ml ml_w ngfil nmot nmot_w qmsdyn rl rlp rl_w tabgmst tabgmst2 tans tkatmst tkatmst2 tmot tmst wdkba_w wped /end IN_MEASUREMENT
 /begin OUT_MEASUREMENT esst_san12esuw esst_sdm05tesb esst_seh06kruw esst_sez06tmub esst_sfr04bbuw esst_sga07mdub esst_sga08mdub esst_sks06esub esst_slx06tmuw esst_sly06tmuw esst_sml06teub esst_sml06tmuw esst_sml07tmuw esst_sml08lhub esst_sn16kr1ub esst_sn16kr2ub esst_sng06llsb esst_sng06lltsb esst_snm04teub esst_snm06llub esst_snm06mduw esst_snm07esub esst_snm07lsuw esst_snm08gkub esst_snm08kruw esst_snm08lhub esst_snm08__ub esst_snm10lsub esst_snm12esub esst_snm12feub esst_snm16krub esst_snm16opuw esst_snm16zuub esst_snm24zuub esst_sqm05teub esst_srl04krub esst_srl06zuub esst_srl08gkub esst_srl08lsuw esst_srl10lsub esst_srl12esub esst_srl12zuub esst_srl16zuub esst_st107tmub esst_st207tmub esst_st307tmub esst_st407tmub esst_sta04saub esst_sta06esub esst_stm04feub esst_stm04saub esst_stm05saub esst_stm05tmub esst_stm06lltub esst_stm06llub esst_stm06__ub esst_stm08bbub esst_stm08mdub esst_stm09esub esst_stm12esub esst_sts12esub esst_swd06krsw /end OUT_MEASUREMENT
/end FUNCTION
/begin FUNCTION SSTDMD "2.30      Diagnose misfire detection: St¸tzstellenverteilungen" /begin DEF_CHARACTERISTIC SMI08DMUB SNM08DMUB SNM08DMUW1 /end DEF_CHARACTERISTIC /begin IN_MEASUREMENT B_mdzgstp miautget_w nmot nmot_w /end IN_MEASUREMENT
 /begin OUT_MEASUREMENT esst_smi08dmub esst_snm08dmub esst_snm08dmuw1 midmd midmd_f midmd_w /end OUT_MEASUREMENT
/end FUNCTION
/begin COMPU_METHOD B_TRUE "boolsche Zust‰nde, positive Logik" TAB_VERB "%6.3" "" COMPU_TAB_REF B_TRUE /end COMPU_METHOD
/begin COMPU_VTAB B_TRUE "boolsche Zust‰nde, positive Logik" TAB_VERB 2 0 "----" 1 "TRUE" /end COMPU_VTAB
/begin COMPU_METHOD DEZ "1 : 1 Umrechnug (dez/hex)" RAT_FUNC "%6.2" "" COEFFS 0 1 0 0 0 1 /end COMPU_METHOD
/begin COMPU_METHOD dez "1 : 1 Umrechnug (dez/hex)" RAT_FUNC "%6.2" "" COEFFS 0 1 0 0 0 1 /end COMPU_METHOD
/begin COMPU_METHOD fakspr_q0p0039 "" RAT_FUNC "%6.4" "" COEFFS 0 256 0 0 0 1 /end COMPU_METHOD
/begin COMPU_METHOD fak_q0p002 "" RAT_FUNC "%6.4" "%" COEFFS 0 500 0 0 0 1 /end COMPU_METHOD
/begin COMPU_METHOD fak_q0p004_o100 "" RAT_FUNC "%7.3" "%" COEFFS 0 1 100 0 0 0.004 /end COMPU_METHOD
/begin COMPU_METHOD fak_q0p1 "" RAT_FUNC "%6.3" "-" COEFFS 0 1 0 0 0 0.1 /end COMPU_METHOD
/begin COMPU_METHOD fak_q0p5 "" RAT_FUNC "%6.3" "-" COEFFS 0 1 0 0 0 0.5 /end COMPU_METHOD
/begin COMPU_METHOD fak_r32_1 "" RAT_FUNC "%27.13" "-" COEFFS 0 1 0 0 0 1 /end COMPU_METHOD
/begin COMPU_METHOD fak_sb_b1 "" RAT_FUNC "%6.4" "-" COEFFS 0 256 0 0 0 2 /end COMPU_METHOD
/begin COMPU_METHOD fak_sw_b2x "" RAT_FUNC "%6.3" "-" COEFFS 0 32768 -32768 0 0 1 /end COMPU_METHOD
/begin COMPU_METHOD fak_ub_b1 "" RAT_FUNC "%6.4" "-" COEFFS 0 256 0 0 0 1 /end COMPU_METHOD
/begin COMPU_METHOD fak_ub_b16 "" RAT_FUNC "%6.4" "-" COEFFS 0 256 0 0 0 16 /end COMPU_METHOD
/begin COMPU_METHOD fak_ub_b2 "" RAT_FUNC "%6.4" "-" COEFFS 0 256 0 0 0 2 /end COMPU_METHOD
/begin COMPU_METHOD fak_ub_q0p00392 "" RAT_FUNC "%6.4" "-" COEFFS 0 255 0 0 0 1 /end COMPU_METHOD
/begin COMPU_METHOD fak_ub_q5p0 "" RAT_FUNC "%7.3" "" COEFFS 0 1 0 0 0 5 /end COMPU_METHOD
/begin COMPU_METHOD fak_uw_b1 "" RAT_FUNC "%7.6" "-" COEFFS 0 65536 0 0 0 1 /end COMPU_METHOD
/begin COMPU_METHOD fak_uw_b1024 "" RAT_FUNC "%6.4" "-" COEFFS 0 65536 0 0 0 1024 /end COMPU_METHOD
/begin COMPU_METHOD fak_uw_b16 "" RAT_FUNC "%6.5" "-" COEFFS 0 65536 0 0 0 16 /end COMPU_METHOD
/begin COMPU_METHOD fak_uw_b2 "" RAT_FUNC "%7.6" "-" COEFFS 0 65536 0 0 0 2 /end COMPU_METHOD
/begin COMPU_METHOD fak_uw_b512 "" RAT_FUNC "%6.4" "-" COEFFS 0 65536 0 0 0 512 /end COMPU_METHOD
/begin COMPU_METHOD fak_uw_q0p001 "" RAT_FUNC "%6.5" "-" COEFFS 0 65536 0 0 0 65.536 /end COMPU_METHOD
/begin COMPU_METHOD fak_uw_q0p25o500 "" RAT_FUNC "%9.3" "" COEFFS 0 1 500 0 0 0.25 /end COMPU_METHOD
/begin COMPU_METHOD fuel_ub_q1 "" RAT_FUNC "%6.2" "l" COEFFS 0 1 0 0 0 1 /end COMPU_METHOD
/begin COMPU_METHOD hub_uw_q0p001 "" RAT_FUNC "%6.5" "mm" COEFFS 0 1000 0 0 0 1 /end COMPU_METHOD
/begin COMPU_METHOD igen_ub_q1 "" RAT_FUNC "%6.2" "" COEFFS 0 1 0 0 0 1 /end COMPU_METHOD
/begin COMPU_METHOD i_ub_q0p02 "" RAT_FUNC "%7.4" "A" COEFFS 0 1 0 0 0 0.02 /end COMPU_METHOD
/begin COMPU_METHOD i_uw_q0p02_o200 "" RAT_FUNC "%6.1" "A" COEFFS 0 1 200 0 0 0.02 /end COMPU_METHOD
/begin COMPU_METHOD i_uw_q0p08_o200 "" RAT_FUNC "%7.2" "A" COEFFS 0 1 200 0 0 0.08 /end COMPU_METHOD
/begin COMPU_METHOD KennText "" RAT_FUNC "%6.2" "" COEFFS 0 1 0 0 0 1 /end COMPU_METHOD
/begin COMPU_METHOD m_q0p1 "" RAT_FUNC "%6.3" "kg/h" COEFFS 0 10 0 0 0 1 /end COMPU_METHOD
/begin COMPU_METHOD m_ub_b1020 "" RAT_FUNC "%6.2" "kg/h" COEFFS 0 1 0 0 0 4 /end COMPU_METHOD
/begin COMPU_METHOD m_ub_q0p4 "" RAT_FUNC "%6.3" "kg/h" COEFFS 0 1 0 0 0 0.4 /end COMPU_METHOD
/begin COMPU_METHOD m_uw_b102p4 "" RAT_FUNC "%6.4" "kg/h" COEFFS 0 65536 0 0 0 102.4 /end COMPU_METHOD
/begin COMPU_METHOD m_uw_b4660 "" RAT_FUNC "%6.4" "g" COEFFS 0 3600 0 0 0 256 /end COMPU_METHOD
/begin COMPU_METHOD m_uw_b6553p5 "" RAT_FUNC "%6.3" "kg/h" COEFFS 0 1 0 0 0 0.1 /end COMPU_METHOD
/begin COMPU_METHOD nmotg_sb_q100 "" RAT_FUNC "%6.0" "1/min/s" COEFFS 0 1 0 0 0 100 /end COMPU_METHOD
/begin COMPU_METHOD nmot_ub_q10 "" RAT_FUNC "%6.1" "1/min" COEFFS 0 1 0 0 0 10 /end COMPU_METHOD
/begin COMPU_METHOD nmot_ub_q40 "" RAT_FUNC "%6.1" "1/min" COEFFS 0 1 0 0 0 40 /end COMPU_METHOD
/begin COMPU_METHOD nmot_uw_q0p25 "" RAT_FUNC "%6.3" "1/min" COEFFS 0 1 0 0 0 0.25 /end COMPU_METHOD
/begin COMPU_METHOD p_q0p039 "" RAT_FUNC "%6.4" "hPa" COEFFS 0 256 0 0 0 10 /end COMPU_METHOD
/begin COMPU_METHOD p_ub_q5 "" RAT_FUNC "%6.2" "hPa" COEFFS 0 1 0 0 0 5 /end COMPU_METHOD
/begin COMPU_METHOD qlad_ul_q2p7Em7 "" RAT_FUNC "%10.9" "mAs" COEFFS 0 3600000 0 0 0 1 /end COMPU_METHOD
/begin COMPU_METHOD qlad_uw_q0p0182 "" RAT_FUNC "%6.4" "Ah" COEFFS 0 3600000 0 0 0 65536 /end COMPU_METHOD
/begin COMPU_METHOD relDK_q0p02441 "" RAT_FUNC "%6.4" "%DK" COEFFS 0 65536 0 0 0 1600 /end COMPU_METHOD
/begin COMPU_METHOD relO2_q9p765Em4 "" RAT_FUNC "%6.5" "% O2" COEFFS 0 1024 0 0 0 1 /end COMPU_METHOD
/begin COMPU_METHOD rel_ub_b100 "" RAT_FUNC "%6.3" "%" COEFFS 0 256 0 0 0 100 /end COMPU_METHOD
/begin COMPU_METHOD rel_ub_b127p5 "" RAT_FUNC "%6.3" "%" COEFFS 0 2 0 0 0 1 /end COMPU_METHOD
/begin COMPU_METHOD rel_ub_b99p6 "" RAT_FUNC "%6.3" "%" COEFFS 0 256 0 0 0 100 /end COMPU_METHOD
/begin COMPU_METHOD rel_ub_q0p75 "" RAT_FUNC "%6.3" "%" COEFFS 0 1 0 0 0 0.75 /end COMPU_METHOD
/begin COMPU_METHOD rel_uw_b100 "" RAT_FUNC "%6.4" "%" COEFFS 0 65536 0 0 0 100 /end COMPU_METHOD
/begin COMPU_METHOD rel_uw_b3072 "" RAT_FUNC "%6.4" "%" COEFFS 0 65536 0 0 0 3072 /end COMPU_METHOD
/begin COMPU_METHOD rel_uw_q0p001 "" RAT_FUNC "%6.5" "%" COEFFS 0 1000 0 0 0 1 /end COMPU_METHOD
/begin COMPU_METHOD rel_uw_q0p0234 "" RAT_FUNC "%6.4" "%" COEFFS 0 32 0 0 0 0.75 /end COMPU_METHOD
/begin COMPU_METHOD rkt_uw_b0p5 "" RAT_FUNC "%6.5" "" COEFFS 0 65536 0 0 0 32 /end COMPU_METHOD
/begin COMPU_METHOD r_q0p125 "" RAT_FUNC "%7.3" "mOhm" COEFFS 0 256 0 0 0 32 /end COMPU_METHOD
/begin COMPU_METHOD r_q0p1em3 "" RAT_FUNC "%9.6" "Ohm" COEFFS 0 1000 0 0 0 1 /end COMPU_METHOD
/begin COMPU_METHOD spg_gencan "" RAT_FUNC "%6.2" "V" COEFFS 0 40 -424 0 0 1 /end COMPU_METHOD
/begin COMPU_METHOD spg_q0p00039 "" RAT_FUNC "%6.5" "V" COEFFS 0 1 0 0 0 0.000390625 /end COMPU_METHOD
/begin COMPU_METHOD spg_q0p05 "" RAT_FUNC "%7.4" "V" COEFFS 0 20 0 0 0 1 /end COMPU_METHOD
/begin COMPU_METHOD spg_q0p064 "" RAT_FUNC "%7.4" "V" COEFFS 0 1 0 0 0 0.064 /end COMPU_METHOD
/begin COMPU_METHOD spg_q0p977em3_om32 "" RAT_FUNC "%9.4" "" COEFFS 0 1 32 0 0 0.0009765625 /end COMPU_METHOD
/begin COMPU_METHOD spg_sw_q0p001 "" RAT_FUNC "%6.5" "V" COEFFS 0 1000 0 0 0 1 /end COMPU_METHOD
/begin COMPU_METHOD spg_ubatt "" RAT_FUNC "%6.3" "V" COEFFS 0 1 0 0 0 0.0942 /end COMPU_METHOD
/begin COMPU_METHOD spg_ub_q0p064_o6 "" RAT_FUNC "%6.3" "V" COEFFS 0 1 -6 0 0 0.064 /end COMPU_METHOD
/begin COMPU_METHOD spg_uw_q0p015 "" RAT_FUNC "%9.5" "V" COEFFS 0 1 0 0 0 0.015 /end COMPU_METHOD
/begin COMPU_METHOD spg_uw_q0p015_o491 "" RAT_FUNC "%9.3" "V" COEFFS 0 1 491.505 0 0 0.015 /end COMPU_METHOD
/begin COMPU_METHOD spg_uw_q0p25em3_o6 "" RAT_FUNC "%9.5" "V" COEFFS 0 1 -6 0 0 0.00025 /end COMPU_METHOD
/begin COMPU_METHOD sprzi_q0p1 "" RAT_FUNC "%6.3" "Grad KW" COEFFS 0 10 0 0 0 1 /end COMPU_METHOD
/begin COMPU_METHOD sprzi_q0p8 "" RAT_FUNC "%6.2" "Grad KW" COEFFS 0 1 0 0 0 0.8 /end COMPU_METHOD
/begin COMPU_METHOD t100msxs_ub_b255 "" RAT_FUNC "%6.2" "s" COEFFS 0 1 0 0 0 1 /end COMPU_METHOD
/begin COMPU_METHOD t100msxs_ub_b25p5 "" RAT_FUNC "%6.3" "s" COEFFS 0 1 0 0 0 0.1 /end COMPU_METHOD
/begin COMPU_METHOD t100msxs_uw_b6553p6 "" RAT_FUNC "%6.3" "s" COEFFS 0 10 0 0 0 1 /end COMPU_METHOD
/begin COMPU_METHOD t10msxs_uw_b655p35 "" RAT_FUNC "%6.4" "s" COEFFS 0 1 0 0 0 0.01 /end COMPU_METHOD
/begin COMPU_METHOD t1p0usxms "" RAT_FUNC "%6.5" "ms" COEFFS 0 1000 0 0 0 1 /end COMPU_METHOD
/begin COMPU_METHOD t6minxmin_q6 "" RAT_FUNC "%6.2" "min" COEFFS 0 1 0 0 0 6 /end COMPU_METHOD
/begin COMPU_METHOD t8p0usxms "" RAT_FUNC "%6.4" "ms" COEFFS 0 1000 0 0 0 8 /end COMPU_METHOD
/begin COMPU_METHOD temp_q0p0234_o273 "" RAT_FUNC "%6.1" "Grad C" COEFFS 0 1 273.15 0 0 0.0234375 /end COMPU_METHOD
/begin COMPU_METHOD temp_ub_q0p75_o48 "" RAT_FUNC "%6.2" "Grad C" COEFFS 0 1 48 0 0 0.75 /end COMPU_METHOD
/begin COMPU_METHOD temp_ub_q5_o50 "" RAT_FUNC "%6.2" "Grad C" COEFFS 0 1 50 0 0 5 /end COMPU_METHOD
/begin COMPU_METHOD temp_uw_q0p003_o48 "" RAT_FUNC "%7.3" "∞C" COEFFS 0 1 48 0 0 0.003 /end COMPU_METHOD
/begin COMPU_METHOD txms_uw_q0p0004 "" RAT_FUNC "%6.5" "ms" COEFFS 0 2500 0 0 0 1 /end COMPU_METHOD
/begin COMPU_METHOD txms_uw_q0p0032 "" RAT_FUNC "%6.4" "ms" COEFFS 0 625 0 0 0 2 /end COMPU_METHOD
/begin COMPU_METHOD t_q0p001_ms "" RAT_FUNC "%6.5" "ms" COEFFS 0 1 0 0 0 0.001 /end COMPU_METHOD
/begin COMPU_METHOD t_q0p1 "" RAT_FUNC "%6.3" "s" COEFFS 0 10 0 0 0 1 /end COMPU_METHOD
/begin COMPU_METHOD t_q1 "" RAT_FUNC "%6.2" "s" COEFFS 0 1 0 0 0 1 /end COMPU_METHOD
/begin COMPU_METHOD vfzg_ub_q1p25 "" RAT_FUNC "%6.2" "km/h" COEFFS 0 1 0 0 0 1.25 /end COMPU_METHOD
/begin COMPU_METHOD zk100msxs_ub_b25p5 "" RAT_FUNC "%6.3" "s" COEFFS 0 0 256 0 10 0 /end COMPU_METHOD
/begin COMPU_METHOD zk100msxs_uw_b6553 "" RAT_FUNC "%6.1" "s" COEFFS 0 0 65536 0 10 0 /end COMPU_METHOD
/begin COMPU_METHOD zw_ub_q0p75 "" RAT_FUNC "%6.3" "Grad KW" COEFFS 0 255 0 0 0 191.25 /end COMPU_METHOD
/begin COMPU_METHOD zw_ub_qn0p75 "" RAT_FUNC "%6.4" "Grad KW" COEFFS 0 1 0 0 0 -0.75 /end COMPU_METHOD
/begin COMPU_METHOD default "" RAT_FUNC "%6.2" "" COEFFS 0 1 0 0 0 1 /end COMPU_METHOD
/begin RECORD_LAYOUT GkfWU8 FNC_VALUES 1 UBYTE COLUMN_DIR DIRECT /end RECORD_LAYOUT
/begin RECORD_LAYOUT KfAxU8AyU8SstxU16SstyU16WU16 NO_AXIS_PTS_X 1 UWORD NO_AXIS_PTS_Y 2 UWORD AXIS_PTS_X 3 UWORD INDEX_INCR DIRECT AXIS_PTS_Y 4 UWORD INDEX_INCR DIRECT FNC_VALUES 5 UWORD COLUMN_DIR DIRECT /end RECORD_LAYOUT
/begin RECORD_LAYOUT KfAxU8AyU8SstxU8SstyU16WU16 NO_AXIS_PTS_X 1 UBYTE NO_AXIS_PTS_Y 2 UBYTE AXIS_PTS_X 3 UBYTE INDEX_INCR DIRECT AXIS_PTS_Y 4 UWORD INDEX_INCR DIRECT FNC_VALUES 5 UWORD COLUMN_DIR DIRECT /end RECORD_LAYOUT
/begin RECORD_LAYOUT KfAxU8AyU8SstxU8SstyU16WU8 NO_AXIS_PTS_X 1 UBYTE NO_AXIS_PTS_Y 2 UBYTE AXIS_PTS_X 3 UBYTE INDEX_INCR DIRECT AXIS_PTS_Y 4 UWORD INDEX_INCR DIRECT FNC_VALUES 5 UBYTE COLUMN_DIR DIRECT /end RECORD_LAYOUT
/begin RECORD_LAYOUT KfAxUbAyUbSstxUbSstyUbWUb NO_AXIS_PTS_X 1 UBYTE NO_AXIS_PTS_Y 2 UBYTE AXIS_PTS_X 3 UBYTE INDEX_INCR DIRECT AXIS_PTS_Y 4 UBYTE INDEX_INCR DIRECT FNC_VALUES 5 UBYTE COLUMN_DIR DIRECT /end RECORD_LAYOUT
/begin RECORD_LAYOUT KfAxUwAyUwSstxUwSstyUwWSw NO_AXIS_PTS_X 1 UWORD NO_AXIS_PTS_Y 2 UWORD AXIS_PTS_X 3 UWORD INDEX_INCR DIRECT AXIS_PTS_Y 4 UWORD INDEX_INCR DIRECT FNC_VALUES 5 SWORD COLUMN_DIR DIRECT /end RECORD_LAYOUT
/begin RECORD_LAYOUT KlAUbSstUbWUb NO_AXIS_PTS_X 1 UBYTE AXIS_PTS_X 2 UBYTE INDEX_INCR DIRECT FNC_VALUES 3 UBYTE COLUMN_DIR DIRECT /end RECORD_LAYOUT
/begin RECORD_LAYOUT KlAUbSstUbWUw NO_AXIS_PTS_X 1 UBYTE AXIS_PTS_X 2 UBYTE INDEX_INCR DIRECT FNC_VALUES 3 UWORD COLUMN_DIR DIRECT /end RECORD_LAYOUT
/begin RECORD_LAYOUT KlAUwSstUwWUw NO_AXIS_PTS_X 1 UWORD AXIS_PTS_X 2 UWORD INDEX_INCR DIRECT FNC_VALUES 3 UWORD COLUMN_DIR DIRECT /end RECORD_LAYOUT
/begin RECORD_LAYOUT KlAxU8SstxS16WS16 NO_AXIS_PTS_X 1 SWORD AXIS_PTS_X 2 SWORD INDEX_INCR DIRECT FNC_VALUES 3 SWORD COLUMN_DIR DIRECT /end RECORD_LAYOUT
/begin RECORD_LAYOUT KlAxU8SstxU16WS16 NO_AXIS_PTS_X 1 UWORD AXIS_PTS_X 2 UWORD INDEX_INCR DIRECT FNC_VALUES 3 SWORD COLUMN_DIR DIRECT /end RECORD_LAYOUT
/begin RECORD_LAYOUT KlAxU8SstxU16WU16 NO_AXIS_PTS_X 1 UWORD AXIS_PTS_X 2 UWORD INDEX_INCR DIRECT FNC_VALUES 3 UWORD COLUMN_DIR DIRECT /end RECORD_LAYOUT
/begin RECORD_LAYOUT KlAxU8SstxU8WS8 NO_AXIS_PTS_X 1 UBYTE AXIS_PTS_X 2 UBYTE INDEX_INCR DIRECT FNC_VALUES 3 SBYTE COLUMN_DIR DIRECT /end RECORD_LAYOUT
/begin RECORD_LAYOUT KlAxU8SstxU8WU16 NO_AXIS_PTS_X 1 UBYTE AXIS_PTS_X 2 UBYTE INDEX_INCR DIRECT FNC_VALUES 3 UWORD COLUMN_DIR DIRECT /end RECORD_LAYOUT
/begin RECORD_LAYOUT KlAxU8SstxU8WU8 NO_AXIS_PTS_X 1 UBYTE AXIS_PTS_X 2 UBYTE INDEX_INCR DIRECT FNC_VALUES 3 UBYTE COLUMN_DIR DIRECT /end RECORD_LAYOUT
/begin RECORD_LAYOUT KwbWS16 FNC_VALUES 1 SWORD COLUMN_DIR DIRECT /end RECORD_LAYOUT
/begin RECORD_LAYOUT KwbWS8 FNC_VALUES 1 SBYTE COLUMN_DIR DIRECT /end RECORD_LAYOUT
/begin RECORD_LAYOUT KwbWU16 FNC_VALUES 1 UWORD COLUMN_DIR DIRECT /end RECORD_LAYOUT
/begin RECORD_LAYOUT KwbWU8 FNC_VALUES 1 UBYTE COLUMN_DIR DIRECT /end RECORD_LAYOUT
/begin RECORD_LAYOUT KwUb FNC_VALUES 1 UBYTE COLUMN_DIR DIRECT /end RECORD_LAYOUT
/begin RECORD_LAYOUT KwUw FNC_VALUES 1 UWORD COLUMN_DIR DIRECT /end RECORD_LAYOUT
/begin RECORD_LAYOUT KwWS16 FNC_VALUES 1 SWORD COLUMN_DIR DIRECT /end RECORD_LAYOUT
/begin RECORD_LAYOUT KwWU16 FNC_VALUES 1 UWORD COLUMN_DIR DIRECT /end RECORD_LAYOUT
/begin RECORD_LAYOUT KwWU32 FNC_VALUES 1 ULONG COLUMN_DIR DIRECT /end RECORD_LAYOUT
/begin RECORD_LAYOUT KwWU8 FNC_VALUES 1 UBYTE COLUMN_DIR DIRECT /end RECORD_LAYOUT
/begin RECORD_LAYOUT SstASwSstSw NO_AXIS_PTS_X 1 SWORD AXIS_PTS_X 2 SWORD INDEX_INCR DIRECT /end RECORD_LAYOUT
/begin RECORD_LAYOUT SstAU8SstS8 NO_AXIS_PTS_X 1 SBYTE AXIS_PTS_X 2 SBYTE INDEX_INCR DIRECT /end RECORD_LAYOUT
/begin RECORD_LAYOUT SstAU8SstU16 NO_AXIS_PTS_X 1 UWORD AXIS_PTS_X 2 UWORD INDEX_INCR DIRECT /end RECORD_LAYOUT
/begin RECORD_LAYOUT SstAU8SstU8 NO_AXIS_PTS_X 1 UBYTE AXIS_PTS_X 2 UBYTE INDEX_INCR DIRECT /end RECORD_LAYOUT
/begin RECORD_LAYOUT SstAUbSstSb NO_AXIS_PTS_X 1 UBYTE AXIS_PTS_X 2 SBYTE INDEX_INCR DIRECT /end RECORD_LAYOUT
/begin RECORD_LAYOUT SstAUbSstUb NO_AXIS_PTS_X 1 UBYTE AXIS_PTS_X 2 UBYTE INDEX_INCR DIRECT /end RECORD_LAYOUT
/begin RECORD_LAYOUT SstAUwSstUw NO_AXIS_PTS_X 1 UWORD AXIS_PTS_X 2 UWORD INDEX_INCR DIRECT /end RECORD_LAYOUT
/end MODULE
/end PROJECT
